ASAP2_VERSION 1 51
/begin PROJECT ZHBC8600 "Gen2_BMW_System_Supplier_Lib"
/begin MODULE CPP ""
/begin MOD_COMMON "" BYTE_ORDER MSB_FIRST ALIGNMENT_BYTE 1 ALIGNMENT_WORD 2 ALIGNMENT_LONG 4 ALIGNMENT_FLOAT32_IEEE 4 ALIGNMENT_FLOAT64_IEEE 1 /end MOD_COMMON
/begin COMPU_METHOD EH_STANDARD_S4_S3 "int = ((phys * 1) / 1) - (0) -" RAT_FUNC "%1.0" "-" COEFFS 0 1 0 0 0 1 /end COMPU_METHOD
/begin COMPU_METHOD SAB_M250_S2_S3 "int = ((phys * 250) / 1) - (0) -" RAT_FUNC "%4.3" "-" COEFFS 0 250 0 0 0 1 /end COMPU_METHOD
/begin COMPU_METHOD SAB_M_0245NM10000_S2_S3 "int = ((phys * 10000) / 245) - (0) Nm" RAT_FUNC "%5.4" "Nm" COEFFS 0 40.8163265306 0 0 0 1 /end COMPU_METHOD
/begin COMPU_METHOD SAB_M_100KG_S2_S3 "int = ((phys * 1) / 100) - (0) kg" RAT_FUNC "%4.3" "kg" COEFFS 0 0.01 0 0 0 1 /end COMPU_METHOD
/begin COMPU_METHOD SAB_M_10NM_S2_S3 "int = ((phys * 1) / 10) - (0) Nm" RAT_FUNC "%4.3" "Nm" COEFFS 0 0.1 0 0 0 1 /end COMPU_METHOD
/begin COMPU_METHOD SAB_M_15NM_S2_S3 "int = ((phys * 1) / 15) - (0) Nm" RAT_FUNC "%4.3" "Nm" COEFFS 0 0.0666666666667 0 0 0 1 /end COMPU_METHOD
/begin COMPU_METHOD SAB_M_1NM_KOMP_S2_S3 "int = ((phys * 1) / 1) - (0) Nm" RAT_FUNC "%1.0" "Nm" COEFFS 0 1 0 0 0 1 /end COMPU_METHOD
/begin COMPU_METHOD SAB_M_1NM_M100_S2_S3 "int = ((phys * 1) / 1) - (-100) Nm" RAT_FUNC "%1.0" "Nm" COEFFS 0 1 100 0 0 1 /end COMPU_METHOD
/begin COMPU_METHOD SAB_M_1NM_M511_S2_S3 "int = ((phys * 1) / 1) - (-511) Nm" RAT_FUNC "%1.0" "Nm" COEFFS 0 1 511 0 0 1 /end COMPU_METHOD
/begin COMPU_METHOD SAB_M_200KG_P500_S2_S3 "int = ((phys * 10) / 2000) - (25) kg" RAT_FUNC "%1.0" "kg" COEFFS 0 0.005 -25 0 0 1 /end COMPU_METHOD
/begin COMPU_METHOD SAB_M_2KG_S2_S3 "int = ((phys * 1) / 2) - (0) kg" RAT_FUNC "%4.3" "kg" COEFFS 0 0.5 0 0 0 1 /end COMPU_METHOD
/begin COMPU_METHOD SAB_M_2NM_M100_S2_S3 "int = ((phys * 1) / 2) - (-50) Nm" RAT_FUNC "%4.3" "Nm" COEFFS 0 0.5 50 0 0 1 /end COMPU_METHOD
/begin COMPU_METHOD SAB_M_2NM_S2_S3 "int = ((phys * 1) / 2) - (0) Nm" RAT_FUNC "%4.3" "Nm" COEFFS 0 0.5 0 0 0 1 /end COMPU_METHOD
/begin COMPU_METHOD SAB_M_32KG_S2_S3 "int = ((phys * 1) / 32) - (0) kg" RAT_FUNC "%1.0" "kg" COEFFS 0 0.03125 0 0 0 1 /end COMPU_METHOD
/begin COMPU_METHOD SAB_M_37NM100_M12124_S2_S3 "int = ((phys * 100) / 37) - (-32768) Nm" RAT_FUNC "%4.3" "Nm" COEFFS 0 2.7027027027 32768 0 0 1 /end COMPU_METHOD
/begin COMPU_METHOD SAB_M_3NM_S2_S3 "int = ((phys * 1) / 3) - (0) Nm" RAT_FUNC "%4.3" "Nm" COEFFS 0 0.333333333333 0 0 0 1 /end COMPU_METHOD
/begin COMPU_METHOD SAB_M_4NM_M511_S2_S3 "int = ((phys * 4) / 1) - (-2044) Nm" RAT_FUNC "%4.3" "Nm" COEFFS 0 4 2044 0 0 1 /end COMPU_METHOD
/begin COMPU_METHOD SAB_M_592NM100_M12124_S2_S3 "int = ((phys * 100) / 592) - (-2048) Nm" RAT_FUNC "%4.3" "Nm" COEFFS 0 0.168918918919 2048 0 0 1 /end COMPU_METHOD
/begin COMPU_METHOD SAB_M_5NM10_M16384_S2_S3 "int = ((phys * 10) / 5) - (-32768) Nm" RAT_FUNC "%4.3" "Nm" COEFFS 0 2 32768 0 0 1 /end COMPU_METHOD
/begin COMPU_METHOD SAB_M_5NM10_M400_S2_S3 "int = ((phys * 10) / 5) - (-800) Nm" RAT_FUNC "%4.3" "Nm" COEFFS 0 2 800 0 0 1 /end COMPU_METHOD
/begin COMPU_METHOD SAB_M_5NM10_M6400_S2_S3 "int = ((phys * 10) / 5) - (-12800) Nm" RAT_FUNC "%4.3" "Nm" COEFFS 0 2 12800 0 0 1 /end COMPU_METHOD
/begin COMPU_METHOD SAB_M_5NM10_S2_S3 "int = ((phys * 10) / 5) - (0) Nm" RAT_FUNC "%4.3" "Nm" COEFFS 0 2 0 0 0 1 /end COMPU_METHOD
/begin COMPU_METHOD SAB_M_5NM_S2_S3 "int = ((phys * 5) / 1) - (0) Nm" RAT_FUNC "%4.3" "Nm" COEFFS 0 5 0 0 0 1 /end COMPU_METHOD
/begin COMPU_METHOD SAB_M_NM10_S2_S3 "int = ((phys * 10) / 1) - (0) Nm" RAT_FUNC "%4.3" "Nm" COEFFS 0 10 0 0 0 1 /end COMPU_METHOD
/begin COMPU_METHOD SAB_M_NM16_M2048_S2_S3 "int = ((phys * 16) / 1) - (-32768) Nm" RAT_FUNC "%4.3" "Nm" COEFFS 0 16 32768 0 0 1 /end COMPU_METHOD
/begin COMPU_METHOD SAB_M_NM16_S2_S3 "int = ((phys * 16) / 1) - (0) Nm" RAT_FUNC "%4.3" "Nm" COEFFS 0 16 0 0 0 1 /end COMPU_METHOD
/begin COMPU_METHOD SAB_M_NM2_M800_S2_S3 "int = ((phys * 2) / 1) - (-800) Nm" RAT_FUNC "%4.3" "Nm" COEFFS 0 2 800 0 0 1 /end COMPU_METHOD
/begin COMPU_METHOD SAB_M_NM2_M_S2_S3 "int = ((phys * 2) / 1) - (0) Nm" RAT_FUNC "%4.3" "Nm" COEFFS 0 2 0 0 0 1 /end COMPU_METHOD
/begin COMPU_METHOD SAB_M_NM4_M500_S2_S3 "int = ((phys * 4) / 1) - (-2000) Nm" RAT_FUNC "%4.3" "Nm" COEFFS 0 4 2000 0 0 1 /end COMPU_METHOD
/begin COMPU_METHOD SAB_M_NM4_M511_S2_S3 "int = ((phys * 4) / 1) - (-2044) Nm" RAT_FUNC "%4.3" "Nm" COEFFS 0 4 2044 0 0 1 /end COMPU_METHOD
/begin COMPU_METHOD SAB_M_NM4_S2_S3 "int = ((phys * 4) / 1) - (0) Nm" RAT_FUNC "%4.3" "Nm" COEFFS 0 4 0 0 0 1 /end COMPU_METHOD
/begin COMPU_METHOD SAB_M_NM50_S2_S3 "int = ((phys * 50) / 1) - (0) Nm" RAT_FUNC "%4.3" "Nm" COEFFS 0 50 0 0 0 1 /end COMPU_METHOD
/begin COMPU_METHOD SAB_M_NM5_S2_S3 "int = ((phys * 5) / 1) - (0) Nm" RAT_FUNC "%4.3" "Nm" COEFFS 0 5 0 0 0 1 /end COMPU_METHOD
/begin COMPU_METHOD SAB_M_NM8_S2_S3 "int = ((phys * 8) / 1) - (0) Nm" RAT_FUNC "%4.3" "Nm" COEFFS 0 8 0 0 0 1 /end COMPU_METHOD
/begin COMPU_METHOD SAB_M_NM_M100_S2_S3 "int = ((phys * 1) / 1) - (-100) Nm" RAT_FUNC "%1.0" "Nm" COEFFS 0 1 100 0 0 1 /end COMPU_METHOD
/begin COMPU_METHOD SAB_M_NM_M1021_S2_S3 "int = ((phys * 1) / 1) - (-1021) Nm" RAT_FUNC "%1.0" "Nm" COEFFS 0 1 1021 0 0 1 /end COMPU_METHOD
/begin MEASUREMENT ZFEH_EepromData.di_obd_iumpr_comp_active_time[96] "error code related component active time [0 .. 254-1]" UBYTE EH_STANDARD_S4_S3 1 100 0 255 ECU_ADDRESS 0xFFF832C0 DISPLAY_IDENTIFIER di_obd_iumpr_comp_active_time[96].ZFEH_EepromData /end MEASUREMENT
/begin MEASUREMENT ZFEH_EepromData.di_obd_iumpr_comp_active_time[97] "error code related component active time [0 .. 254-1]" UBYTE EH_STANDARD_S4_S3 1 100 0 255 ECU_ADDRESS 0xFFF832C1 DISPLAY_IDENTIFIER di_obd_iumpr_comp_active_time[97].ZFEH_EepromData /end MEASUREMENT
/begin MEASUREMENT ZFEH_EepromData.di_obd_iumpr_comp_active_time[98] "error code related component active time [0 .. 254-1]" UBYTE EH_STANDARD_S4_S3 1 100 0 255 ECU_ADDRESS 0xFFF832C2 DISPLAY_IDENTIFIER di_obd_iumpr_comp_active_time[98].ZFEH_EepromData /end MEASUREMENT
/begin MEASUREMENT ZFEH_EepromData.di_obd_iumpr_comp_active_time[99] "error code related component active time [0 .. 254-1]" UBYTE EH_STANDARD_S4_S3 1 100 0 255 ECU_ADDRESS 0xFFF832C3 DISPLAY_IDENTIFIER di_obd_iumpr_comp_active_time[99].ZFEH_EepromData /end MEASUREMENT
/begin MEASUREMENT ZFEH_EepromData.di_obd_iumpr_comp_active_time[9] "error code related component active time [0 .. 254-1]" UBYTE EH_STANDARD_S4_S3 1 100 0 255 ECU_ADDRESS 0xFFF83269 DISPLAY_IDENTIFIER di_obd_iumpr_comp_active_time[9].ZFEH_EepromData /end MEASUREMENT
/begin MEASUREMENT ZFEH_EepromData.di_obd_iumpr_denominator[0] "error code related denominator [0 .. 254-1]" UWORD EH_STANDARD_S4_S3 1 100 0 65535 ECU_ADDRESS 0xFFF82F66 DISPLAY_IDENTIFIER di_obd_iumpr_denominator[0].ZFEH_EepromData /end MEASUREMENT
/begin MEASUREMENT ZFEH_EepromData.di_obd_iumpr_denominator[100] "error code related denominator [0 .. 254-1]" UWORD EH_STANDARD_S4_S3 1 100 0 65535 ECU_ADDRESS 0xFFF8302E DISPLAY_IDENTIFIER di_obd_iumpr_denominator[100].ZFEH_EepromData /end MEASUREMENT
/begin MEASUREMENT ZFEH_EepromData.di_obd_iumpr_denominator[101] "error code related denominator [0 .. 254-1]" UWORD EH_STANDARD_S4_S3 1 100 0 65535 ECU_ADDRESS 0xFFF83030 DISPLAY_IDENTIFIER di_obd_iumpr_denominator[101].ZFEH_EepromData /end MEASUREMENT
/begin MEASUREMENT ZFEH_EepromData.di_obd_iumpr_denominator[102] "error code related denominator [0 .. 254-1]" UWORD EH_STANDARD_S4_S3 1 100 0 65535 ECU_ADDRESS 0xFFF83032 DISPLAY_IDENTIFIER di_obd_iumpr_denominator[102].ZFEH_EepromData /end MEASUREMENT
/begin MEASUREMENT ZFEH_EepromData.di_obd_iumpr_denominator[103] "error code related denominator [0 .. 254-1]" UWORD EH_STANDARD_S4_S3 1 100 0 65535 ECU_ADDRESS 0xFFF83034 DISPLAY_IDENTIFIER di_obd_iumpr_denominator[103].ZFEH_EepromData /end MEASUREMENT
/begin MEASUREMENT ZFEH_EepromData.di_obd_iumpr_denominator[104] "error code related denominator [0 .. 254-1]" UWORD EH_STANDARD_S4_S3 1 100 0 65535 ECU_ADDRESS 0xFFF83036 DISPLAY_IDENTIFIER di_obd_iumpr_denominator[104].ZFEH_EepromData /end MEASUREMENT
/begin MEASUREMENT ZFEH_EepromData.di_obd_iumpr_denominator[105] "error code related denominator [0 .. 254-1]" UWORD EH_STANDARD_S4_S3 1 100 0 65535 ECU_ADDRESS 0xFFF83038 DISPLAY_IDENTIFIER di_obd_iumpr_denominator[105].ZFEH_EepromData /end MEASUREMENT
/begin MEASUREMENT ZFEH_EepromData.di_obd_iumpr_denominator[106] "error code related denominator [0 .. 254-1]" UWORD EH_STANDARD_S4_S3 1 100 0 65535 ECU_ADDRESS 0xFFF8303A DISPLAY_IDENTIFIER di_obd_iumpr_denominator[106].ZFEH_EepromData /end MEASUREMENT
/begin MEASUREMENT ZFEH_EepromData.di_obd_iumpr_denominator[107] "error code related denominator [0 .. 254-1]" UWORD EH_STANDARD_S4_S3 1 100 0 65535 ECU_ADDRESS 0xFFF8303C DISPLAY_IDENTIFIER di_obd_iumpr_denominator[107].ZFEH_EepromData /end MEASUREMENT
/begin MEASUREMENT ZFEH_EepromData.di_obd_iumpr_denominator[108] "error code related denominator [0 .. 254-1]" UWORD EH_STANDARD_S4_S3 1 100 0 65535 ECU_ADDRESS 0xFFF8303E DISPLAY_IDENTIFIER di_obd_iumpr_denominator[108].ZFEH_EepromData /end MEASUREMENT
/begin MEASUREMENT ZFEH_EepromData.di_obd_iumpr_denominator[109] "error code related denominator [0 .. 254-1]" UWORD EH_STANDARD_S4_S3 1 100 0 65535 ECU_ADDRESS 0xFFF83040 DISPLAY_IDENTIFIER di_obd_iumpr_denominator[109].ZFEH_EepromData /end MEASUREMENT
/begin MEASUREMENT ZFEH_EepromData.di_obd_iumpr_denominator[10] "error code related denominator [0 .. 254-1]" UWORD EH_STANDARD_S4_S3 1 100 0 65535 ECU_ADDRESS 0xFFF82F7A DISPLAY_IDENTIFIER di_obd_iumpr_denominator[10].ZFEH_EepromData /end MEASUREMENT
/begin MEASUREMENT ZFEH_EepromData.di_obd_iumpr_denominator[110] "error code related denominator [0 .. 254-1]" UWORD EH_STANDARD_S4_S3 1 100 0 65535 ECU_ADDRESS 0xFFF83042 DISPLAY_IDENTIFIER di_obd_iumpr_denominator[110].ZFEH_EepromData /end MEASUREMENT
/begin MEASUREMENT ZFEH_EepromData.di_obd_iumpr_denominator[111] "error code related denominator [0 .. 254-1]" UWORD EH_STANDARD_S4_S3 1 100 0 65535 ECU_ADDRESS 0xFFF83044 DISPLAY_IDENTIFIER di_obd_iumpr_denominator[111].ZFEH_EepromData /end MEASUREMENT
/begin MEASUREMENT ZFEH_EepromData.di_obd_iumpr_denominator[112] "error code related denominator [0 .. 254-1]" UWORD EH_STANDARD_S4_S3 1 100 0 65535 ECU_ADDRESS 0xFFF83046 DISPLAY_IDENTIFIER di_obd_iumpr_denominator[112].ZFEH_EepromData /end MEASUREMENT
/begin MEASUREMENT ZFEH_EepromData.di_obd_iumpr_denominator[113] "error code related denominator [0 .. 254-1]" UWORD EH_STANDARD_S4_S3 1 100 0 65535 ECU_ADDRESS 0xFFF83048 DISPLAY_IDENTIFIER di_obd_iumpr_denominator[113].ZFEH_EepromData /end MEASUREMENT
/begin MEASUREMENT ZFEH_EepromData.di_obd_iumpr_denominator[114] "error code related denominator [0 .. 254-1]" UWORD EH_STANDARD_S4_S3 1 100 0 65535 ECU_ADDRESS 0xFFF8304A DISPLAY_IDENTIFIER di_obd_iumpr_denominator[114].ZFEH_EepromData /end MEASUREMENT
/begin MEASUREMENT ZFEH_EepromData.di_obd_iumpr_denominator[115] "error code related denominator [0 .. 254-1]" UWORD EH_STANDARD_S4_S3 1 100 0 65535 ECU_ADDRESS 0xFFF8304C DISPLAY_IDENTIFIER di_obd_iumpr_denominator[115].ZFEH_EepromData /end MEASUREMENT
/begin MEASUREMENT ZFEH_EepromData.di_obd_iumpr_denominator[116] "error code related denominator [0 .. 254-1]" UWORD EH_STANDARD_S4_S3 1 100 0 65535 ECU_ADDRESS 0xFFF8304E DISPLAY_IDENTIFIER di_obd_iumpr_denominator[116].ZFEH_EepromData /end MEASUREMENT
/begin MEASUREMENT ZFEH_EepromData.di_obd_iumpr_denominator[117] "error code related denominator [0 .. 254-1]" UWORD EH_STANDARD_S4_S3 1 100 0 65535 ECU_ADDRESS 0xFFF83050 DISPLAY_IDENTIFIER di_obd_iumpr_denominator[117].ZFEH_EepromData /end MEASUREMENT
/begin MEASUREMENT ZFEH_EepromData.di_obd_iumpr_denominator[118] "error code related denominator [0 .. 254-1]" UWORD EH_STANDARD_S4_S3 1 100 0 65535 ECU_ADDRESS 0xFFF83052 DISPLAY_IDENTIFIER di_obd_iumpr_denominator[118].ZFEH_EepromData /end MEASUREMENT
/begin MEASUREMENT ZFEH_EepromData.di_obd_iumpr_denominator[119] "error code related denominator [0 .. 254-1]" UWORD EH_STANDARD_S4_S3 1 100 0 65535 ECU_ADDRESS 0xFFF83054 DISPLAY_IDENTIFIER di_obd_iumpr_denominator[119].ZFEH_EepromData /end MEASUREMENT
/begin MEASUREMENT ZFEH_EepromData.di_obd_iumpr_denominator[11] "error code related denominator [0 .. 254-1]" UWORD EH_STANDARD_S4_S3 1 100 0 65535 ECU_ADDRESS 0xFFF82F7C DISPLAY_IDENTIFIER di_obd_iumpr_denominator[11].ZFEH_EepromData /end MEASUREMENT
/begin MEASUREMENT ZFEH_EepromData.di_obd_iumpr_denominator[120] "error code related denominator [0 .. 254-1]" UWORD EH_STANDARD_S4_S3 1 100 0 65535 ECU_ADDRESS 0xFFF83056 DISPLAY_IDENTIFIER di_obd_iumpr_denominator[120].ZFEH_EepromData /end MEASUREMENT
/begin MEASUREMENT ZFEH_EepromData.di_obd_iumpr_denominator[121] "error code related denominator [0 .. 254-1]" UWORD EH_STANDARD_S4_S3 1 100 0 65535 ECU_ADDRESS 0xFFF83058 DISPLAY_IDENTIFIER di_obd_iumpr_denominator[121].ZFEH_EepromData /end MEASUREMENT
/begin MEASUREMENT ZFEH_EepromData.di_obd_iumpr_denominator[122] "error code related denominator [0 .. 254-1]" UWORD EH_STANDARD_S4_S3 1 100 0 65535 ECU_ADDRESS 0xFFF8305A DISPLAY_IDENTIFIER di_obd_iumpr_denominator[122].ZFEH_EepromData /end MEASUREMENT
/begin MEASUREMENT ZFEH_EepromData.di_obd_iumpr_denominator[123] "error code related denominator [0 .. 254-1]" UWORD EH_STANDARD_S4_S3 1 100 0 65535 ECU_ADDRESS 0xFFF8305C DISPLAY_IDENTIFIER di_obd_iumpr_denominator[123].ZFEH_EepromData /end MEASUREMENT
/begin MEASUREMENT ZFEH_EepromData.di_obd_iumpr_denominator[124] "error code related denominator [0 .. 254-1]" UWORD EH_STANDARD_S4_S3 1 100 0 65535 ECU_ADDRESS 0xFFF8305E DISPLAY_IDENTIFIER di_obd_iumpr_denominator[124].ZFEH_EepromData /end MEASUREMENT
/begin MEASUREMENT ZFEH_EepromData.di_obd_iumpr_denominator[125] "error code related denominator [0 .. 254-1]" UWORD EH_STANDARD_S4_S3 1 100 0 65535 ECU_ADDRESS 0xFFF83060 DISPLAY_IDENTIFIER di_obd_iumpr_denominator[125].ZFEH_EepromData /end MEASUREMENT
/begin MEASUREMENT ZFEH_EepromData.di_obd_iumpr_denominator[126] "error code related denominator [0 .. 254-1]" UWORD EH_STANDARD_S4_S3 1 100 0 65535 ECU_ADDRESS 0xFFF83062 DISPLAY_IDENTIFIER di_obd_iumpr_denominator[126].ZFEH_EepromData /end MEASUREMENT
/begin MEASUREMENT ZFEH_EepromData.di_obd_iumpr_denominator[127] "error code related denominator [0 .. 254-1]" UWORD EH_STANDARD_S4_S3 1 100 0 65535 ECU_ADDRESS 0xFFF83064 DISPLAY_IDENTIFIER di_obd_iumpr_denominator[127].ZFEH_EepromData /end MEASUREMENT
/begin MEASUREMENT ZFEH_EepromData.di_obd_iumpr_denominator[128] "error code related denominator [0 .. 254-1]" UWORD EH_STANDARD_S4_S3 1 100 0 65535 ECU_ADDRESS 0xFFF83066 DISPLAY_IDENTIFIER di_obd_iumpr_denominator[128].ZFEH_EepromData /end MEASUREMENT
/begin MEASUREMENT ZFEH_EepromData.di_obd_iumpr_denominator[129] "error code related denominator [0 .. 254-1]" UWORD EH_STANDARD_S4_S3 1 100 0 65535 ECU_ADDRESS 0xFFF83068 DISPLAY_IDENTIFIER di_obd_iumpr_denominator[129].ZFEH_EepromData /end MEASUREMENT
/begin MEASUREMENT ZFEH_EepromData.di_obd_iumpr_denominator[12] "error code related denominator [0 .. 254-1]" UWORD EH_STANDARD_S4_S3 1 100 0 65535 ECU_ADDRESS 0xFFF82F7E DISPLAY_IDENTIFIER di_obd_iumpr_denominator[12].ZFEH_EepromData /end MEASUREMENT
/begin MEASUREMENT ZFEH_EepromData.di_obd_iumpr_denominator[130] "error code related denominator [0 .. 254-1]" UWORD EH_STANDARD_S4_S3 1 100 0 65535 ECU_ADDRESS 0xFFF8306A DISPLAY_IDENTIFIER di_obd_iumpr_denominator[130].ZFEH_EepromData /end MEASUREMENT
/begin MEASUREMENT ZFEH_EepromData.di_obd_iumpr_denominator[131] "error code related denominator [0 .. 254-1]" UWORD EH_STANDARD_S4_S3 1 100 0 65535 ECU_ADDRESS 0xFFF8306C DISPLAY_IDENTIFIER di_obd_iumpr_denominator[131].ZFEH_EepromData /end MEASUREMENT
/begin MEASUREMENT ZFEH_EepromData.di_obd_iumpr_denominator[132] "error code related denominator [0 .. 254-1]" UWORD EH_STANDARD_S4_S3 1 100 0 65535 ECU_ADDRESS 0xFFF8306E DISPLAY_IDENTIFIER di_obd_iumpr_denominator[132].ZFEH_EepromData /end MEASUREMENT
/begin MEASUREMENT ZFEH_EepromData.di_obd_iumpr_denominator[133] "error code related denominator [0 .. 254-1]" UWORD EH_STANDARD_S4_S3 1 100 0 65535 ECU_ADDRESS 0xFFF83070 DISPLAY_IDENTIFIER di_obd_iumpr_denominator[133].ZFEH_EepromData /end MEASUREMENT
/begin MEASUREMENT ZFEH_EepromData.di_obd_iumpr_denominator[134] "error code related denominator [0 .. 254-1]" UWORD EH_STANDARD_S4_S3 1 100 0 65535 ECU_ADDRESS 0xFFF83072 DISPLAY_IDENTIFIER di_obd_iumpr_denominator[134].ZFEH_EepromData /end MEASUREMENT
/begin MEASUREMENT ZFEH_EepromData.di_obd_iumpr_denominator[135] "error code related denominator [0 .. 254-1]" UWORD EH_STANDARD_S4_S3 1 100 0 65535 ECU_ADDRESS 0xFFF83074 DISPLAY_IDENTIFIER di_obd_iumpr_denominator[135].ZFEH_EepromData /end MEASUREMENT
/begin MEASUREMENT ZFEH_EepromData.di_obd_iumpr_denominator[136] "error code related denominator [0 .. 254-1]" UWORD EH_STANDARD_S4_S3 1 100 0 65535 ECU_ADDRESS 0xFFF83076 DISPLAY_IDENTIFIER di_obd_iumpr_denominator[136].ZFEH_EepromData /end MEASUREMENT
/begin MEASUREMENT ZFEH_EepromData.di_obd_iumpr_denominator[137] "error code related denominator [0 .. 254-1]" UWORD EH_STANDARD_S4_S3 1 100 0 65535 ECU_ADDRESS 0xFFF83078 DISPLAY_IDENTIFIER di_obd_iumpr_denominator[137].ZFEH_EepromData /end MEASUREMENT
/begin MEASUREMENT ZFEH_EepromData.di_obd_iumpr_denominator[138] "error code related denominator [0 .. 254-1]" UWORD EH_STANDARD_S4_S3 1 100 0 65535 ECU_ADDRESS 0xFFF8307A DISPLAY_IDENTIFIER di_obd_iumpr_denominator[138].ZFEH_EepromData /end MEASUREMENT
/begin MEASUREMENT ZFEH_EepromData.di_obd_iumpr_denominator[139] "error code related denominator [0 .. 254-1]" UWORD EH_STANDARD_S4_S3 1 100 0 65535 ECU_ADDRESS 0xFFF8307C DISPLAY_IDENTIFIER di_obd_iumpr_denominator[139].ZFEH_EepromData /end MEASUREMENT
/begin MEASUREMENT ZFEH_EepromData.di_obd_iumpr_denominator[13] "error code related denominator [0 .. 254-1]" UWORD EH_STANDARD_S4_S3 1 100 0 65535 ECU_ADDRESS 0xFFF82F80 DISPLAY_IDENTIFIER di_obd_iumpr_denominator[13].ZFEH_EepromData /end MEASUREMENT
/begin MEASUREMENT ZFEH_EepromData.di_obd_iumpr_denominator[140] "error code related denominator [0 .. 254-1]" UWORD EH_STANDARD_S4_S3 1 100 0 65535 ECU_ADDRESS 0xFFF8307E DISPLAY_IDENTIFIER di_obd_iumpr_denominator[140].ZFEH_EepromData /end MEASUREMENT
/begin MEASUREMENT ZFEH_EepromData.di_obd_iumpr_denominator[141] "error code related denominator [0 .. 254-1]" UWORD EH_STANDARD_S4_S3 1 100 0 65535 ECU_ADDRESS 0xFFF83080 DISPLAY_IDENTIFIER di_obd_iumpr_denominator[141].ZFEH_EepromData /end MEASUREMENT
/begin MEASUREMENT ZFEH_EepromData.di_obd_iumpr_denominator[142] "error code related denominator [0 .. 254-1]" UWORD EH_STANDARD_S4_S3 1 100 0 65535 ECU_ADDRESS 0xFFF83082 DISPLAY_IDENTIFIER di_obd_iumpr_denominator[142].ZFEH_EepromData /end MEASUREMENT
/begin MEASUREMENT ZFEH_EepromData.di_obd_iumpr_denominator[143] "error code related denominator [0 .. 254-1]" UWORD EH_STANDARD_S4_S3 1 100 0 65535 ECU_ADDRESS 0xFFF83084 DISPLAY_IDENTIFIER di_obd_iumpr_denominator[143].ZFEH_EepromData /end MEASUREMENT
/begin MEASUREMENT ZFEH_EepromData.di_obd_iumpr_denominator[144] "error code related denominator [0 .. 254-1]" UWORD EH_STANDARD_S4_S3 1 100 0 65535 ECU_ADDRESS 0xFFF83086 DISPLAY_IDENTIFIER di_obd_iumpr_denominator[144].ZFEH_EepromData /end MEASUREMENT
/begin MEASUREMENT ZFEH_EepromData.di_obd_iumpr_denominator[145] "error code related denominator [0 .. 254-1]" UWORD EH_STANDARD_S4_S3 1 100 0 65535 ECU_ADDRESS 0xFFF83088 DISPLAY_IDENTIFIER di_obd_iumpr_denominator[145].ZFEH_EepromData /end MEASUREMENT
/begin MEASUREMENT ZFEH_EepromData.di_obd_iumpr_denominator[146] "error code related denominator [0 .. 254-1]" UWORD EH_STANDARD_S4_S3 1 100 0 65535 ECU_ADDRESS 0xFFF8308A DISPLAY_IDENTIFIER di_obd_iumpr_denominator[146].ZFEH_EepromData /end MEASUREMENT
/begin MEASUREMENT ZFEH_EepromData.di_obd_iumpr_denominator[147] "error code related denominator [0 .. 254-1]" UWORD EH_STANDARD_S4_S3 1 100 0 65535 ECU_ADDRESS 0xFFF8308C DISPLAY_IDENTIFIER di_obd_iumpr_denominator[147].ZFEH_EepromData /end MEASUREMENT
/begin MEASUREMENT ZFEH_EepromData.di_obd_iumpr_denominator[148] "error code related denominator [0 .. 254-1]" UWORD EH_STANDARD_S4_S3 1 100 0 65535 ECU_ADDRESS 0xFFF8308E DISPLAY_IDENTIFIER di_obd_iumpr_denominator[148].ZFEH_EepromData /end MEASUREMENT
/begin MEASUREMENT ZFEH_EepromData.di_obd_iumpr_denominator[149] "error code related denominator [0 .. 254-1]" UWORD EH_STANDARD_S4_S3 1 100 0 65535 ECU_ADDRESS 0xFFF83090 DISPLAY_IDENTIFIER di_obd_iumpr_denominator[149].ZFEH_EepromData /end MEASUREMENT
/begin MEASUREMENT ZFEH_EepromData.di_obd_iumpr_denominator[14] "error code related denominator [0 .. 254-1]" UWORD EH_STANDARD_S4_S3 1 100 0 65535 ECU_ADDRESS 0xFFF82F82 DISPLAY_IDENTIFIER di_obd_iumpr_denominator[14].ZFEH_EepromData /end MEASUREMENT
/begin MEASUREMENT ZFEH_EepromData.di_obd_iumpr_denominator[150] "error code related denominator [0 .. 254-1]" UWORD EH_STANDARD_S4_S3 1 100 0 65535 ECU_ADDRESS 0xFFF83092 DISPLAY_IDENTIFIER di_obd_iumpr_denominator[150].ZFEH_EepromData /end MEASUREMENT
/begin MEASUREMENT ZFEH_EepromData.di_obd_iumpr_denominator[151] "error code related denominator [0 .. 254-1]" UWORD EH_STANDARD_S4_S3 1 100 0 65535 ECU_ADDRESS 0xFFF83094 DISPLAY_IDENTIFIER di_obd_iumpr_denominator[151].ZFEH_EepromData /end MEASUREMENT
/begin MEASUREMENT ZFEH_EepromData.di_obd_iumpr_denominator[152] "error code related denominator [0 .. 254-1]" UWORD EH_STANDARD_S4_S3 1 100 0 65535 ECU_ADDRESS 0xFFF83096 DISPLAY_IDENTIFIER di_obd_iumpr_denominator[152].ZFEH_EepromData /end MEASUREMENT
/begin MEASUREMENT ZFEH_EepromData.di_obd_iumpr_denominator[153] "error code related denominator [0 .. 254-1]" UWORD EH_STANDARD_S4_S3 1 100 0 65535 ECU_ADDRESS 0xFFF83098 DISPLAY_IDENTIFIER di_obd_iumpr_denominator[153].ZFEH_EepromData /end MEASUREMENT
/begin MEASUREMENT ZFEH_EepromData.di_obd_iumpr_denominator[154] "error code related denominator [0 .. 254-1]" UWORD EH_STANDARD_S4_S3 1 100 0 65535 ECU_ADDRESS 0xFFF8309A DISPLAY_IDENTIFIER di_obd_iumpr_denominator[154].ZFEH_EepromData /end MEASUREMENT
/begin MEASUREMENT ZFEH_EepromData.di_obd_iumpr_denominator[155] "error code related denominator [0 .. 254-1]" UWORD EH_STANDARD_S4_S3 1 100 0 65535 ECU_ADDRESS 0xFFF8309C DISPLAY_IDENTIFIER di_obd_iumpr_denominator[155].ZFEH_EepromData /end MEASUREMENT
/begin MEASUREMENT ZFEH_EepromData.di_obd_iumpr_denominator[156] "error code related denominator [0 .. 254-1]" UWORD EH_STANDARD_S4_S3 1 100 0 65535 ECU_ADDRESS 0xFFF8309E DISPLAY_IDENTIFIER di_obd_iumpr_denominator[156].ZFEH_EepromData /end MEASUREMENT
/begin MEASUREMENT ZFEH_EepromData.di_obd_iumpr_denominator[157] "error code related denominator [0 .. 254-1]" UWORD EH_STANDARD_S4_S3 1 100 0 65535 ECU_ADDRESS 0xFFF830A0 DISPLAY_IDENTIFIER di_obd_iumpr_denominator[157].ZFEH_EepromData /end MEASUREMENT
/begin MEASUREMENT ZFEH_EepromData.di_obd_iumpr_denominator[158] "error code related denominator [0 .. 254-1]" UWORD EH_STANDARD_S4_S3 1 100 0 65535 ECU_ADDRESS 0xFFF830A2 DISPLAY_IDENTIFIER di_obd_iumpr_denominator[158].ZFEH_EepromData /end MEASUREMENT
/begin MEASUREMENT ZFEH_EepromData.di_obd_iumpr_denominator[159] "error code related denominator [0 .. 254-1]" UWORD EH_STANDARD_S4_S3 1 100 0 65535 ECU_ADDRESS 0xFFF830A4 DISPLAY_IDENTIFIER di_obd_iumpr_denominator[159].ZFEH_EepromData /end MEASUREMENT
/begin MEASUREMENT ZFEH_EepromData.di_obd_iumpr_denominator[15] "error code related denominator [0 .. 254-1]" UWORD EH_STANDARD_S4_S3 1 100 0 65535 ECU_ADDRESS 0xFFF82F84 DISPLAY_IDENTIFIER di_obd_iumpr_denominator[15].ZFEH_EepromData /end MEASUREMENT
/begin MEASUREMENT ZFEH_EepromData.di_obd_iumpr_denominator[160] "error code related denominator [0 .. 254-1]" UWORD EH_STANDARD_S4_S3 1 100 0 65535 ECU_ADDRESS 0xFFF830A6 DISPLAY_IDENTIFIER di_obd_iumpr_denominator[160].ZFEH_EepromData /end MEASUREMENT
/begin MEASUREMENT ZFEH_EepromData.di_obd_iumpr_denominator[161] "error code related denominator [0 .. 254-1]" UWORD EH_STANDARD_S4_S3 1 100 0 65535 ECU_ADDRESS 0xFFF830A8 DISPLAY_IDENTIFIER di_obd_iumpr_denominator[161].ZFEH_EepromData /end MEASUREMENT
/begin MEASUREMENT ZFEH_EepromData.di_obd_iumpr_denominator[162] "error code related denominator [0 .. 254-1]" UWORD EH_STANDARD_S4_S3 1 100 0 65535 ECU_ADDRESS 0xFFF830AA DISPLAY_IDENTIFIER di_obd_iumpr_denominator[162].ZFEH_EepromData /end MEASUREMENT
/begin MEASUREMENT ZFEH_EepromData.di_obd_iumpr_denominator[163] "error code related denominator [0 .. 254-1]" UWORD EH_STANDARD_S4_S3 1 100 0 65535 ECU_ADDRESS 0xFFF830AC DISPLAY_IDENTIFIER di_obd_iumpr_denominator[163].ZFEH_EepromData /end MEASUREMENT
/begin MEASUREMENT ZFEH_EepromData.di_obd_iumpr_denominator[164] "error code related denominator [0 .. 254-1]" UWORD EH_STANDARD_S4_S3 1 100 0 65535 ECU_ADDRESS 0xFFF830AE DISPLAY_IDENTIFIER di_obd_iumpr_denominator[164].ZFEH_EepromData /end MEASUREMENT
/begin MEASUREMENT ZFEH_EepromData.di_obd_iumpr_denominator[165] "error code related denominator [0 .. 254-1]" UWORD EH_STANDARD_S4_S3 1 100 0 65535 ECU_ADDRESS 0xFFF830B0 DISPLAY_IDENTIFIER di_obd_iumpr_denominator[165].ZFEH_EepromData /end MEASUREMENT
/begin MEASUREMENT ZFEH_EepromData.di_obd_iumpr_denominator[166] "error code related denominator [0 .. 254-1]" UWORD EH_STANDARD_S4_S3 1 100 0 65535 ECU_ADDRESS 0xFFF830B2 DISPLAY_IDENTIFIER di_obd_iumpr_denominator[166].ZFEH_EepromData /end MEASUREMENT
/begin MEASUREMENT ZFEH_EepromData.di_obd_iumpr_denominator[167] "error code related denominator [0 .. 254-1]" UWORD EH_STANDARD_S4_S3 1 100 0 65535 ECU_ADDRESS 0xFFF830B4 DISPLAY_IDENTIFIER di_obd_iumpr_denominator[167].ZFEH_EepromData /end MEASUREMENT
/begin MEASUREMENT ZFEH_EepromData.di_obd_iumpr_denominator[168] "error code related denominator [0 .. 254-1]" UWORD EH_STANDARD_S4_S3 1 100 0 65535 ECU_ADDRESS 0xFFF830B6 DISPLAY_IDENTIFIER di_obd_iumpr_denominator[168].ZFEH_EepromData /end MEASUREMENT
/begin MEASUREMENT ZFEH_EepromData.di_obd_iumpr_denominator[169] "error code related denominator [0 .. 254-1]" UWORD EH_STANDARD_S4_S3 1 100 0 65535 ECU_ADDRESS 0xFFF830B8 DISPLAY_IDENTIFIER di_obd_iumpr_denominator[169].ZFEH_EepromData /end MEASUREMENT
/begin MEASUREMENT ZFEH_EepromData.di_obd_iumpr_denominator[16] "error code related denominator [0 .. 254-1]" UWORD EH_STANDARD_S4_S3 1 100 0 65535 ECU_ADDRESS 0xFFF82F86 DISPLAY_IDENTIFIER di_obd_iumpr_denominator[16].ZFEH_EepromData /end MEASUREMENT
/begin MEASUREMENT ZFEH_EepromData.di_obd_iumpr_denominator[170] "error code related denominator [0 .. 254-1]" UWORD EH_STANDARD_S4_S3 1 100 0 65535 ECU_ADDRESS 0xFFF830BA DISPLAY_IDENTIFIER di_obd_iumpr_denominator[170].ZFEH_EepromData /end MEASUREMENT
/begin MEASUREMENT ZFEH_EepromData.di_obd_iumpr_denominator[171] "error code related denominator [0 .. 254-1]" UWORD EH_STANDARD_S4_S3 1 100 0 65535 ECU_ADDRESS 0xFFF830BC DISPLAY_IDENTIFIER di_obd_iumpr_denominator[171].ZFEH_EepromData /end MEASUREMENT
/begin MEASUREMENT ZFEH_EepromData.di_obd_iumpr_denominator[172] "error code related denominator [0 .. 254-1]" UWORD EH_STANDARD_S4_S3 1 100 0 65535 ECU_ADDRESS 0xFFF830BE DISPLAY_IDENTIFIER di_obd_iumpr_denominator[172].ZFEH_EepromData /end MEASUREMENT
/begin MEASUREMENT ZFEH_EepromData.di_obd_iumpr_denominator[173] "error code related denominator [0 .. 254-1]" UWORD EH_STANDARD_S4_S3 1 100 0 65535 ECU_ADDRESS 0xFFF830C0 DISPLAY_IDENTIFIER di_obd_iumpr_denominator[173].ZFEH_EepromData /end MEASUREMENT
/begin MEASUREMENT ZFEH_EepromData.di_obd_iumpr_denominator[174] "error code related denominator [0 .. 254-1]" UWORD EH_STANDARD_S4_S3 1 100 0 65535 ECU_ADDRESS 0xFFF830C2 DISPLAY_IDENTIFIER di_obd_iumpr_denominator[174].ZFEH_EepromData /end MEASUREMENT
/begin MEASUREMENT ZFEH_EepromData.di_obd_iumpr_denominator[175] "error code related denominator [0 .. 254-1]" UWORD EH_STANDARD_S4_S3 1 100 0 65535 ECU_ADDRESS 0xFFF830C4 DISPLAY_IDENTIFIER di_obd_iumpr_denominator[175].ZFEH_EepromData /end MEASUREMENT
/begin MEASUREMENT ZFEH_EepromData.di_obd_iumpr_denominator[176] "error code related denominator [0 .. 254-1]" UWORD EH_STANDARD_S4_S3 1 100 0 65535 ECU_ADDRESS 0xFFF830C6 DISPLAY_IDENTIFIER di_obd_iumpr_denominator[176].ZFEH_EepromData /end MEASUREMENT
/begin MEASUREMENT ZFEH_EepromData.di_obd_iumpr_denominator[177] "error code related denominator [0 .. 254-1]" UWORD EH_STANDARD_S4_S3 1 100 0 65535 ECU_ADDRESS 0xFFF830C8 DISPLAY_IDENTIFIER di_obd_iumpr_denominator[177].ZFEH_EepromData /end MEASUREMENT
/begin MEASUREMENT ZFEH_EepromData.di_obd_iumpr_denominator[178] "error code related denominator [0 .. 254-1]" UWORD EH_STANDARD_S4_S3 1 100 0 65535 ECU_ADDRESS 0xFFF830CA DISPLAY_IDENTIFIER di_obd_iumpr_denominator[178].ZFEH_EepromData /end MEASUREMENT
/begin MEASUREMENT ZFEH_EepromData.di_obd_iumpr_denominator[179] "error code related denominator [0 .. 254-1]" UWORD EH_STANDARD_S4_S3 1 100 0 65535 ECU_ADDRESS 0xFFF830CC DISPLAY_IDENTIFIER di_obd_iumpr_denominator[179].ZFEH_EepromData /end MEASUREMENT
/begin MEASUREMENT ZFEH_EepromData.di_obd_iumpr_denominator[17] "error code related denominator [0 .. 254-1]" UWORD EH_STANDARD_S4_S3 1 100 0 65535 ECU_ADDRESS 0xFFF82F88 DISPLAY_IDENTIFIER di_obd_iumpr_denominator[17].ZFEH_EepromData /end MEASUREMENT
/begin MEASUREMENT ZFEH_EepromData.di_obd_iumpr_denominator[180] "error code related denominator [0 .. 254-1]" UWORD EH_STANDARD_S4_S3 1 100 0 65535 ECU_ADDRESS 0xFFF830CE DISPLAY_IDENTIFIER di_obd_iumpr_denominator[180].ZFEH_EepromData /end MEASUREMENT
/begin MEASUREMENT ZFEH_EepromData.di_obd_iumpr_denominator[181] "error code related denominator [0 .. 254-1]" UWORD EH_STANDARD_S4_S3 1 100 0 65535 ECU_ADDRESS 0xFFF830D0 DISPLAY_IDENTIFIER di_obd_iumpr_denominator[181].ZFEH_EepromData /end MEASUREMENT
/begin MEASUREMENT ZFEH_EepromData.di_obd_iumpr_denominator[182] "error code related denominator [0 .. 254-1]" UWORD EH_STANDARD_S4_S3 1 100 0 65535 ECU_ADDRESS 0xFFF830D2 DISPLAY_IDENTIFIER di_obd_iumpr_denominator[182].ZFEH_EepromData /end MEASUREMENT
/begin MEASUREMENT ZFEH_EepromData.di_obd_iumpr_denominator[183] "error code related denominator [0 .. 254-1]" UWORD EH_STANDARD_S4_S3 1 100 0 65535 ECU_ADDRESS 0xFFF830D4 DISPLAY_IDENTIFIER di_obd_iumpr_denominator[183].ZFEH_EepromData /end MEASUREMENT
/begin MEASUREMENT ZFEH_EepromData.di_obd_iumpr_denominator[184] "error code related denominator [0 .. 254-1]" UWORD EH_STANDARD_S4_S3 1 100 0 65535 ECU_ADDRESS 0xFFF830D6 DISPLAY_IDENTIFIER di_obd_iumpr_denominator[184].ZFEH_EepromData /end MEASUREMENT
/begin MEASUREMENT ZFEH_EepromData.di_obd_iumpr_denominator[185] "error code related denominator [0 .. 254-1]" UWORD EH_STANDARD_S4_S3 1 100 0 65535 ECU_ADDRESS 0xFFF830D8 DISPLAY_IDENTIFIER di_obd_iumpr_denominator[185].ZFEH_EepromData /end MEASUREMENT
/begin MEASUREMENT ZFEH_EepromData.di_obd_iumpr_denominator[186] "error code related denominator [0 .. 254-1]" UWORD EH_STANDARD_S4_S3 1 100 0 65535 ECU_ADDRESS 0xFFF830DA DISPLAY_IDENTIFIER di_obd_iumpr_denominator[186].ZFEH_EepromData /end MEASUREMENT
/begin MEASUREMENT ZFEH_EepromData.di_obd_iumpr_denominator[187] "error code related denominator [0 .. 254-1]" UWORD EH_STANDARD_S4_S3 1 100 0 65535 ECU_ADDRESS 0xFFF830DC DISPLAY_IDENTIFIER di_obd_iumpr_denominator[187].ZFEH_EepromData /end MEASUREMENT
/begin MEASUREMENT ZFEH_EepromData.di_obd_iumpr_denominator[188] "error code related denominator [0 .. 254-1]" UWORD EH_STANDARD_S4_S3 1 100 0 65535 ECU_ADDRESS 0xFFF830DE DISPLAY_IDENTIFIER di_obd_iumpr_denominator[188].ZFEH_EepromData /end MEASUREMENT
/begin MEASUREMENT ZFEH_EepromData.di_obd_iumpr_denominator[189] "error code related denominator [0 .. 254-1]" UWORD EH_STANDARD_S4_S3 1 100 0 65535 ECU_ADDRESS 0xFFF830E0 DISPLAY_IDENTIFIER di_obd_iumpr_denominator[189].ZFEH_EepromData /end MEASUREMENT
/begin MEASUREMENT ZFEH_EepromData.di_obd_iumpr_denominator[18] "error code related denominator [0 .. 254-1]" UWORD EH_STANDARD_S4_S3 1 100 0 65535 ECU_ADDRESS 0xFFF82F8A DISPLAY_IDENTIFIER di_obd_iumpr_denominator[18].ZFEH_EepromData /end MEASUREMENT
/begin MEASUREMENT ZFEH_EepromData.di_obd_iumpr_denominator[190] "error code related denominator [0 .. 254-1]" UWORD EH_STANDARD_S4_S3 1 100 0 65535 ECU_ADDRESS 0xFFF830E2 DISPLAY_IDENTIFIER di_obd_iumpr_denominator[190].ZFEH_EepromData /end MEASUREMENT
/begin MEASUREMENT ZFEH_EepromData.di_obd_iumpr_denominator[191] "error code related denominator [0 .. 254-1]" UWORD EH_STANDARD_S4_S3 1 100 0 65535 ECU_ADDRESS 0xFFF830E4 DISPLAY_IDENTIFIER di_obd_iumpr_denominator[191].ZFEH_EepromData /end MEASUREMENT
/begin MEASUREMENT ZFEH_EepromData.di_obd_iumpr_denominator[192] "error code related denominator [0 .. 254-1]" UWORD EH_STANDARD_S4_S3 1 100 0 65535 ECU_ADDRESS 0xFFF830E6 DISPLAY_IDENTIFIER di_obd_iumpr_denominator[192].ZFEH_EepromData /end MEASUREMENT
/begin MEASUREMENT ZFEH_EepromData.di_obd_iumpr_denominator[193] "error code related denominator [0 .. 254-1]" UWORD EH_STANDARD_S4_S3 1 100 0 65535 ECU_ADDRESS 0xFFF830E8 DISPLAY_IDENTIFIER di_obd_iumpr_denominator[193].ZFEH_EepromData /end MEASUREMENT
/begin MEASUREMENT ZFEH_EepromData.di_obd_iumpr_denominator[194] "error code related denominator [0 .. 254-1]" UWORD EH_STANDARD_S4_S3 1 100 0 65535 ECU_ADDRESS 0xFFF830EA DISPLAY_IDENTIFIER di_obd_iumpr_denominator[194].ZFEH_EepromData /end MEASUREMENT
/begin MEASUREMENT ZFEH_EepromData.di_obd_iumpr_denominator[195] "error code related denominator [0 .. 254-1]" UWORD EH_STANDARD_S4_S3 1 100 0 65535 ECU_ADDRESS 0xFFF830EC DISPLAY_IDENTIFIER di_obd_iumpr_denominator[195].ZFEH_EepromData /end MEASUREMENT
/begin MEASUREMENT ZFEH_EepromData.di_obd_iumpr_denominator[196] "error code related denominator [0 .. 254-1]" UWORD EH_STANDARD_S4_S3 1 100 0 65535 ECU_ADDRESS 0xFFF830EE DISPLAY_IDENTIFIER di_obd_iumpr_denominator[196].ZFEH_EepromData /end MEASUREMENT
/begin MEASUREMENT ZFEH_EepromData.di_obd_iumpr_denominator[197] "error code related denominator [0 .. 254-1]" UWORD EH_STANDARD_S4_S3 1 100 0 65535 ECU_ADDRESS 0xFFF830F0 DISPLAY_IDENTIFIER di_obd_iumpr_denominator[197].ZFEH_EepromData /end MEASUREMENT
/begin MEASUREMENT ZFEH_EepromData.di_obd_iumpr_denominator[198] "error code related denominator [0 .. 254-1]" UWORD EH_STANDARD_S4_S3 1 100 0 65535 ECU_ADDRESS 0xFFF830F2 DISPLAY_IDENTIFIER di_obd_iumpr_denominator[198].ZFEH_EepromData /end MEASUREMENT
/begin MEASUREMENT ZFEH_EepromData.di_obd_iumpr_denominator[199] "error code related denominator [0 .. 254-1]" UWORD EH_STANDARD_S4_S3 1 100 0 65535 ECU_ADDRESS 0xFFF830F4 DISPLAY_IDENTIFIER di_obd_iumpr_denominator[199].ZFEH_EepromData /end MEASUREMENT
/begin MEASUREMENT ZFEH_EepromData.di_obd_iumpr_denominator[19] "error code related denominator [0 .. 254-1]" UWORD EH_STANDARD_S4_S3 1 100 0 65535 ECU_ADDRESS 0xFFF82F8C DISPLAY_IDENTIFIER di_obd_iumpr_denominator[19].ZFEH_EepromData /end MEASUREMENT
/begin MEASUREMENT ZFEH_EepromData.di_obd_iumpr_denominator[1] "error code related denominator [0 .. 254-1]" UWORD EH_STANDARD_S4_S3 1 100 0 65535 ECU_ADDRESS 0xFFF82F68 DISPLAY_IDENTIFIER di_obd_iumpr_denominator[1].ZFEH_EepromData /end MEASUREMENT
/begin MEASUREMENT ZFEH_EepromData.di_obd_iumpr_denominator[200] "error code related denominator [0 .. 254-1]" UWORD EH_STANDARD_S4_S3 1 100 0 65535 ECU_ADDRESS 0xFFF830F6 DISPLAY_IDENTIFIER di_obd_iumpr_denominator[200].ZFEH_EepromData /end MEASUREMENT
/begin MEASUREMENT ZFEH_EepromData.di_obd_iumpr_denominator[201] "error code related denominator [0 .. 254-1]" UWORD EH_STANDARD_S4_S3 1 100 0 65535 ECU_ADDRESS 0xFFF830F8 DISPLAY_IDENTIFIER di_obd_iumpr_denominator[201].ZFEH_EepromData /end MEASUREMENT
/begin MEASUREMENT ZFEH_EepromData.di_obd_iumpr_denominator[202] "error code related denominator [0 .. 254-1]" UWORD EH_STANDARD_S4_S3 1 100 0 65535 ECU_ADDRESS 0xFFF830FA DISPLAY_IDENTIFIER di_obd_iumpr_denominator[202].ZFEH_EepromData /end MEASUREMENT
/begin MEASUREMENT ZFEH_EepromData.di_obd_iumpr_denominator[203] "error code related denominator [0 .. 254-1]" UWORD EH_STANDARD_S4_S3 1 100 0 65535 ECU_ADDRESS 0xFFF830FC DISPLAY_IDENTIFIER di_obd_iumpr_denominator[203].ZFEH_EepromData /end MEASUREMENT
/begin MEASUREMENT ZFEH_EepromData.di_obd_iumpr_denominator[204] "error code related denominator [0 .. 254-1]" UWORD EH_STANDARD_S4_S3 1 100 0 65535 ECU_ADDRESS 0xFFF830FE DISPLAY_IDENTIFIER di_obd_iumpr_denominator[204].ZFEH_EepromData /end MEASUREMENT
/begin MEASUREMENT ZFEH_EepromData.di_obd_iumpr_denominator[205] "error code related denominator [0 .. 254-1]" UWORD EH_STANDARD_S4_S3 1 100 0 65535 ECU_ADDRESS 0xFFF83100 DISPLAY_IDENTIFIER di_obd_iumpr_denominator[205].ZFEH_EepromData /end MEASUREMENT
/begin MEASUREMENT ZFEH_EepromData.di_obd_iumpr_denominator[206] "error code related denominator [0 .. 254-1]" UWORD EH_STANDARD_S4_S3 1 100 0 65535 ECU_ADDRESS 0xFFF83102 DISPLAY_IDENTIFIER di_obd_iumpr_denominator[206].ZFEH_EepromData /end MEASUREMENT
/begin MEASUREMENT ZFEH_EepromData.di_obd_iumpr_denominator[207] "error code related denominator [0 .. 254-1]" UWORD EH_STANDARD_S4_S3 1 100 0 65535 ECU_ADDRESS 0xFFF83104 DISPLAY_IDENTIFIER di_obd_iumpr_denominator[207].ZFEH_EepromData /end MEASUREMENT
/begin MEASUREMENT ZFEH_EepromData.di_obd_iumpr_denominator[208] "error code related denominator [0 .. 254-1]" UWORD EH_STANDARD_S4_S3 1 100 0 65535 ECU_ADDRESS 0xFFF83106 DISPLAY_IDENTIFIER di_obd_iumpr_denominator[208].ZFEH_EepromData /end MEASUREMENT
/begin MEASUREMENT ZFEH_EepromData.di_obd_iumpr_denominator[209] "error code related denominator [0 .. 254-1]" UWORD EH_STANDARD_S4_S3 1 100 0 65535 ECU_ADDRESS 0xFFF83108 DISPLAY_IDENTIFIER di_obd_iumpr_denominator[209].ZFEH_EepromData /end MEASUREMENT
/begin MEASUREMENT ZFEH_EepromData.di_obd_iumpr_denominator[20] "error code related denominator [0 .. 254-1]" UWORD EH_STANDARD_S4_S3 1 100 0 65535 ECU_ADDRESS 0xFFF82F8E DISPLAY_IDENTIFIER di_obd_iumpr_denominator[20].ZFEH_EepromData /end MEASUREMENT
/begin MEASUREMENT ZFEH_EepromData.di_obd_iumpr_denominator[210] "error code related denominator [0 .. 254-1]" UWORD EH_STANDARD_S4_S3 1 100 0 65535 ECU_ADDRESS 0xFFF8310A DISPLAY_IDENTIFIER di_obd_iumpr_denominator[210].ZFEH_EepromData /end MEASUREMENT
/begin MEASUREMENT ZFEH_EepromData.di_obd_iumpr_denominator[211] "error code related denominator [0 .. 254-1]" UWORD EH_STANDARD_S4_S3 1 100 0 65535 ECU_ADDRESS 0xFFF8310C DISPLAY_IDENTIFIER di_obd_iumpr_denominator[211].ZFEH_EepromData /end MEASUREMENT
/begin MEASUREMENT ZFEH_EepromData.di_obd_iumpr_denominator[212] "error code related denominator [0 .. 254-1]" UWORD EH_STANDARD_S4_S3 1 100 0 65535 ECU_ADDRESS 0xFFF8310E DISPLAY_IDENTIFIER di_obd_iumpr_denominator[212].ZFEH_EepromData /end MEASUREMENT
/begin MEASUREMENT ZFEH_EepromData.di_obd_iumpr_denominator[213] "error code related denominator [0 .. 254-1]" UWORD EH_STANDARD_S4_S3 1 100 0 65535 ECU_ADDRESS 0xFFF83110 DISPLAY_IDENTIFIER di_obd_iumpr_denominator[213].ZFEH_EepromData /end MEASUREMENT
/begin MEASUREMENT ZFEH_EepromData.di_obd_iumpr_denominator[214] "error code related denominator [0 .. 254-1]" UWORD EH_STANDARD_S4_S3 1 100 0 65535 ECU_ADDRESS 0xFFF83112 DISPLAY_IDENTIFIER di_obd_iumpr_denominator[214].ZFEH_EepromData /end MEASUREMENT
/begin MEASUREMENT ZFEH_EepromData.di_obd_iumpr_denominator[215] "error code related denominator [0 .. 254-1]" UWORD EH_STANDARD_S4_S3 1 100 0 65535 ECU_ADDRESS 0xFFF83114 DISPLAY_IDENTIFIER di_obd_iumpr_denominator[215].ZFEH_EepromData /end MEASUREMENT
/begin MEASUREMENT ZFEH_EepromData.di_obd_iumpr_denominator[216] "error code related denominator [0 .. 254-1]" UWORD EH_STANDARD_S4_S3 1 100 0 65535 ECU_ADDRESS 0xFFF83116 DISPLAY_IDENTIFIER di_obd_iumpr_denominator[216].ZFEH_EepromData /end MEASUREMENT
/begin MEASUREMENT ZFEH_EepromData.di_obd_iumpr_denominator[217] "error code related denominator [0 .. 254-1]" UWORD EH_STANDARD_S4_S3 1 100 0 65535 ECU_ADDRESS 0xFFF83118 DISPLAY_IDENTIFIER di_obd_iumpr_denominator[217].ZFEH_EepromData /end MEASUREMENT
/begin MEASUREMENT ZFEH_EepromData.di_obd_iumpr_denominator[218] "error code related denominator [0 .. 254-1]" UWORD EH_STANDARD_S4_S3 1 100 0 65535 ECU_ADDRESS 0xFFF8311A DISPLAY_IDENTIFIER di_obd_iumpr_denominator[218].ZFEH_EepromData /end MEASUREMENT
/begin MEASUREMENT ZFEH_EepromData.di_obd_iumpr_denominator[219] "error code related denominator [0 .. 254-1]" UWORD EH_STANDARD_S4_S3 1 100 0 65535 ECU_ADDRESS 0xFFF8311C DISPLAY_IDENTIFIER di_obd_iumpr_denominator[219].ZFEH_EepromData /end MEASUREMENT
/begin MEASUREMENT ZFEH_EepromData.di_obd_iumpr_denominator[21] "error code related denominator [0 .. 254-1]" UWORD EH_STANDARD_S4_S3 1 100 0 65535 ECU_ADDRESS 0xFFF82F90 DISPLAY_IDENTIFIER di_obd_iumpr_denominator[21].ZFEH_EepromData /end MEASUREMENT
/begin MEASUREMENT ZFEH_EepromData.di_obd_iumpr_denominator[220] "error code related denominator [0 .. 254-1]" UWORD EH_STANDARD_S4_S3 1 100 0 65535 ECU_ADDRESS 0xFFF8311E DISPLAY_IDENTIFIER di_obd_iumpr_denominator[220].ZFEH_EepromData /end MEASUREMENT
/begin MEASUREMENT ZFEH_EepromData.di_obd_iumpr_denominator[221] "error code related denominator [0 .. 254-1]" UWORD EH_STANDARD_S4_S3 1 100 0 65535 ECU_ADDRESS 0xFFF83120 DISPLAY_IDENTIFIER di_obd_iumpr_denominator[221].ZFEH_EepromData /end MEASUREMENT
/begin MEASUREMENT ZFEH_EepromData.di_obd_iumpr_denominator[222] "error code related denominator [0 .. 254-1]" UWORD EH_STANDARD_S4_S3 1 100 0 65535 ECU_ADDRESS 0xFFF83122 DISPLAY_IDENTIFIER di_obd_iumpr_denominator[222].ZFEH_EepromData /end MEASUREMENT
/begin MEASUREMENT ZFEH_EepromData.di_obd_iumpr_denominator[223] "error code related denominator [0 .. 254-1]" UWORD EH_STANDARD_S4_S3 1 100 0 65535 ECU_ADDRESS 0xFFF83124 DISPLAY_IDENTIFIER di_obd_iumpr_denominator[223].ZFEH_EepromData /end MEASUREMENT
/begin MEASUREMENT ZFEH_EepromData.di_obd_iumpr_denominator[224] "error code related denominator [0 .. 254-1]" UWORD EH_STANDARD_S4_S3 1 100 0 65535 ECU_ADDRESS 0xFFF83126 DISPLAY_IDENTIFIER di_obd_iumpr_denominator[224].ZFEH_EepromData /end MEASUREMENT
/begin MEASUREMENT ZFEH_EepromData.di_obd_iumpr_denominator[225] "error code related denominator [0 .. 254-1]" UWORD EH_STANDARD_S4_S3 1 100 0 65535 ECU_ADDRESS 0xFFF83128 DISPLAY_IDENTIFIER di_obd_iumpr_denominator[225].ZFEH_EepromData /end MEASUREMENT
/begin MEASUREMENT ZFEH_EepromData.di_obd_iumpr_denominator[226] "error code related denominator [0 .. 254-1]" UWORD EH_STANDARD_S4_S3 1 100 0 65535 ECU_ADDRESS 0xFFF8312A DISPLAY_IDENTIFIER di_obd_iumpr_denominator[226].ZFEH_EepromData /end MEASUREMENT
/begin MEASUREMENT ZFEH_EepromData.di_obd_iumpr_denominator[227] "error code related denominator [0 .. 254-1]" UWORD EH_STANDARD_S4_S3 1 100 0 65535 ECU_ADDRESS 0xFFF8312C DISPLAY_IDENTIFIER di_obd_iumpr_denominator[227].ZFEH_EepromData /end MEASUREMENT
/begin MEASUREMENT ZFEH_EepromData.di_obd_iumpr_denominator[228] "error code related denominator [0 .. 254-1]" UWORD EH_STANDARD_S4_S3 1 100 0 65535 ECU_ADDRESS 0xFFF8312E DISPLAY_IDENTIFIER di_obd_iumpr_denominator[228].ZFEH_EepromData /end MEASUREMENT
/begin MEASUREMENT ZFEH_EepromData.di_obd_iumpr_denominator[229] "error code related denominator [0 .. 254-1]" UWORD EH_STANDARD_S4_S3 1 100 0 65535 ECU_ADDRESS 0xFFF83130 DISPLAY_IDENTIFIER di_obd_iumpr_denominator[229].ZFEH_EepromData /end MEASUREMENT
/begin MEASUREMENT ZFEH_EepromData.di_obd_iumpr_denominator[22] "error code related denominator [0 .. 254-1]" UWORD EH_STANDARD_S4_S3 1 100 0 65535 ECU_ADDRESS 0xFFF82F92 DISPLAY_IDENTIFIER di_obd_iumpr_denominator[22].ZFEH_EepromData /end MEASUREMENT
/begin MEASUREMENT ZFEH_EepromData.di_obd_iumpr_denominator[230] "error code related denominator [0 .. 254-1]" UWORD EH_STANDARD_S4_S3 1 100 0 65535 ECU_ADDRESS 0xFFF83132 DISPLAY_IDENTIFIER di_obd_iumpr_denominator[230].ZFEH_EepromData /end MEASUREMENT
/begin MEASUREMENT ZFEH_EepromData.di_obd_iumpr_denominator[231] "error code related denominator [0 .. 254-1]" UWORD EH_STANDARD_S4_S3 1 100 0 65535 ECU_ADDRESS 0xFFF83134 DISPLAY_IDENTIFIER di_obd_iumpr_denominator[231].ZFEH_EepromData /end MEASUREMENT
/begin MEASUREMENT ZFEH_EepromData.di_obd_iumpr_denominator[232] "error code related denominator [0 .. 254-1]" UWORD EH_STANDARD_S4_S3 1 100 0 65535 ECU_ADDRESS 0xFFF83136 DISPLAY_IDENTIFIER di_obd_iumpr_denominator[232].ZFEH_EepromData /end MEASUREMENT
/begin MEASUREMENT ZFEH_EepromData.di_obd_iumpr_denominator[233] "error code related denominator [0 .. 254-1]" UWORD EH_STANDARD_S4_S3 1 100 0 65535 ECU_ADDRESS 0xFFF83138 DISPLAY_IDENTIFIER di_obd_iumpr_denominator[233].ZFEH_EepromData /end MEASUREMENT
/begin MEASUREMENT ZFEH_EepromData.di_obd_iumpr_denominator[234] "error code related denominator [0 .. 254-1]" UWORD EH_STANDARD_S4_S3 1 100 0 65535 ECU_ADDRESS 0xFFF8313A DISPLAY_IDENTIFIER di_obd_iumpr_denominator[234].ZFEH_EepromData /end MEASUREMENT
/begin MEASUREMENT ZFEH_EepromData.di_obd_iumpr_denominator[235] "error code related denominator [0 .. 254-1]" UWORD EH_STANDARD_S4_S3 1 100 0 65535 ECU_ADDRESS 0xFFF8313C DISPLAY_IDENTIFIER di_obd_iumpr_denominator[235].ZFEH_EepromData /end MEASUREMENT
/begin MEASUREMENT ZFEH_EepromData.di_obd_iumpr_denominator[236] "error code related denominator [0 .. 254-1]" UWORD EH_STANDARD_S4_S3 1 100 0 65535 ECU_ADDRESS 0xFFF8313E DISPLAY_IDENTIFIER di_obd_iumpr_denominator[236].ZFEH_EepromData /end MEASUREMENT
/begin MEASUREMENT ZFEH_EepromData.di_obd_iumpr_denominator[237] "error code related denominator [0 .. 254-1]" UWORD EH_STANDARD_S4_S3 1 100 0 65535 ECU_ADDRESS 0xFFF83140 DISPLAY_IDENTIFIER di_obd_iumpr_denominator[237].ZFEH_EepromData /end MEASUREMENT
/begin MEASUREMENT ZFEH_EepromData.di_obd_iumpr_denominator[238] "error code related denominator [0 .. 254-1]" UWORD EH_STANDARD_S4_S3 1 100 0 65535 ECU_ADDRESS 0xFFF83142 DISPLAY_IDENTIFIER di_obd_iumpr_denominator[238].ZFEH_EepromData /end MEASUREMENT
/begin MEASUREMENT ZFEH_EepromData.di_obd_iumpr_denominator[239] "error code related denominator [0 .. 254-1]" UWORD EH_STANDARD_S4_S3 1 100 0 65535 ECU_ADDRESS 0xFFF83144 DISPLAY_IDENTIFIER di_obd_iumpr_denominator[239].ZFEH_EepromData /end MEASUREMENT
/begin MEASUREMENT ZFEH_EepromData.di_obd_iumpr_denominator[23] "error code related denominator [0 .. 254-1]" UWORD EH_STANDARD_S4_S3 1 100 0 65535 ECU_ADDRESS 0xFFF82F94 DISPLAY_IDENTIFIER di_obd_iumpr_denominator[23].ZFEH_EepromData /end MEASUREMENT
/begin MEASUREMENT ZFEH_EepromData.di_obd_iumpr_denominator[240] "error code related denominator [0 .. 254-1]" UWORD EH_STANDARD_S4_S3 1 100 0 65535 ECU_ADDRESS 0xFFF83146 DISPLAY_IDENTIFIER di_obd_iumpr_denominator[240].ZFEH_EepromData /end MEASUREMENT
/begin MEASUREMENT ZFEH_EepromData.di_obd_iumpr_denominator[241] "error code related denominator [0 .. 254-1]" UWORD EH_STANDARD_S4_S3 1 100 0 65535 ECU_ADDRESS 0xFFF83148 DISPLAY_IDENTIFIER di_obd_iumpr_denominator[241].ZFEH_EepromData /end MEASUREMENT
/begin MEASUREMENT ZFEH_EepromData.di_obd_iumpr_denominator[242] "error code related denominator [0 .. 254-1]" UWORD EH_STANDARD_S4_S3 1 100 0 65535 ECU_ADDRESS 0xFFF8314A DISPLAY_IDENTIFIER di_obd_iumpr_denominator[242].ZFEH_EepromData /end MEASUREMENT
/begin MEASUREMENT ZFEH_EepromData.di_obd_iumpr_denominator[243] "error code related denominator [0 .. 254-1]" UWORD EH_STANDARD_S4_S3 1 100 0 65535 ECU_ADDRESS 0xFFF8314C DISPLAY_IDENTIFIER di_obd_iumpr_denominator[243].ZFEH_EepromData /end MEASUREMENT
/begin MEASUREMENT ZFEH_EepromData.di_obd_iumpr_denominator[244] "error code related denominator [0 .. 254-1]" UWORD EH_STANDARD_S4_S3 1 100 0 65535 ECU_ADDRESS 0xFFF8314E DISPLAY_IDENTIFIER di_obd_iumpr_denominator[244].ZFEH_EepromData /end MEASUREMENT
/begin MEASUREMENT ZFEH_EepromData.di_obd_iumpr_denominator[245] "error code related denominator [0 .. 254-1]" UWORD EH_STANDARD_S4_S3 1 100 0 65535 ECU_ADDRESS 0xFFF83150 DISPLAY_IDENTIFIER di_obd_iumpr_denominator[245].ZFEH_EepromData /end MEASUREMENT
/begin MEASUREMENT ZFEH_EepromData.di_obd_iumpr_denominator[246] "error code related denominator [0 .. 254-1]" UWORD EH_STANDARD_S4_S3 1 100 0 65535 ECU_ADDRESS 0xFFF83152 DISPLAY_IDENTIFIER di_obd_iumpr_denominator[246].ZFEH_EepromData /end MEASUREMENT
/begin MEASUREMENT ZFEH_EepromData.di_obd_iumpr_denominator[247] "error code related denominator [0 .. 254-1]" UWORD EH_STANDARD_S4_S3 1 100 0 65535 ECU_ADDRESS 0xFFF83154 DISPLAY_IDENTIFIER di_obd_iumpr_denominator[247].ZFEH_EepromData /end MEASUREMENT
/begin MEASUREMENT ZFEH_EepromData.di_obd_iumpr_denominator[248] "error code related denominator [0 .. 254-1]" UWORD EH_STANDARD_S4_S3 1 100 0 65535 ECU_ADDRESS 0xFFF83156 DISPLAY_IDENTIFIER di_obd_iumpr_denominator[248].ZFEH_EepromData /end MEASUREMENT
/begin MEASUREMENT ZFEH_EepromData.di_obd_iumpr_denominator[249] "error code related denominator [0 .. 254-1]" UWORD EH_STANDARD_S4_S3 1 100 0 65535 ECU_ADDRESS 0xFFF83158 DISPLAY_IDENTIFIER di_obd_iumpr_denominator[249].ZFEH_EepromData /end MEASUREMENT
/begin MEASUREMENT ZFEH_EepromData.di_obd_iumpr_denominator[24] "error code related denominator [0 .. 254-1]" UWORD EH_STANDARD_S4_S3 1 100 0 65535 ECU_ADDRESS 0xFFF82F96 DISPLAY_IDENTIFIER di_obd_iumpr_denominator[24].ZFEH_EepromData /end MEASUREMENT
/begin MEASUREMENT ZFEH_EepromData.di_obd_iumpr_denominator[250] "error code related denominator [0 .. 254-1]" UWORD EH_STANDARD_S4_S3 1 100 0 65535 ECU_ADDRESS 0xFFF8315A DISPLAY_IDENTIFIER di_obd_iumpr_denominator[250].ZFEH_EepromData /end MEASUREMENT
/begin MEASUREMENT ZFEH_EepromData.di_obd_iumpr_denominator[251] "error code related denominator [0 .. 254-1]" UWORD EH_STANDARD_S4_S3 1 100 0 65535 ECU_ADDRESS 0xFFF8315C DISPLAY_IDENTIFIER di_obd_iumpr_denominator[251].ZFEH_EepromData /end MEASUREMENT
/begin MEASUREMENT ZFEH_EepromData.di_obd_iumpr_denominator[252] "error code related denominator [0 .. 254-1]" UWORD EH_STANDARD_S4_S3 1 100 0 65535 ECU_ADDRESS 0xFFF8315E DISPLAY_IDENTIFIER di_obd_iumpr_denominator[252].ZFEH_EepromData /end MEASUREMENT
/begin MEASUREMENT ZFEH_EepromData.di_obd_iumpr_denominator[253] "error code related denominator [0 .. 254-1]" UWORD EH_STANDARD_S4_S3 1 100 0 65535 ECU_ADDRESS 0xFFF83160 DISPLAY_IDENTIFIER di_obd_iumpr_denominator[253].ZFEH_EepromData /end MEASUREMENT
/begin MEASUREMENT ZFEH_EepromData.di_obd_iumpr_denominator[25] "error code related denominator [0 .. 254-1]" UWORD EH_STANDARD_S4_S3 1 100 0 65535 ECU_ADDRESS 0xFFF82F98 DISPLAY_IDENTIFIER di_obd_iumpr_denominator[25].ZFEH_EepromData /end MEASUREMENT
/begin MEASUREMENT ZFEH_EepromData.di_obd_iumpr_denominator[26] "error code related denominator [0 .. 254-1]" UWORD EH_STANDARD_S4_S3 1 100 0 65535 ECU_ADDRESS 0xFFF82F9A DISPLAY_IDENTIFIER di_obd_iumpr_denominator[26].ZFEH_EepromData /end MEASUREMENT
/begin MEASUREMENT ZFEH_EepromData.di_obd_iumpr_denominator[27] "error code related denominator [0 .. 254-1]" UWORD EH_STANDARD_S4_S3 1 100 0 65535 ECU_ADDRESS 0xFFF82F9C DISPLAY_IDENTIFIER di_obd_iumpr_denominator[27].ZFEH_EepromData /end MEASUREMENT
/begin MEASUREMENT ZFEH_EepromData.di_obd_iumpr_denominator[28] "error code related denominator [0 .. 254-1]" UWORD EH_STANDARD_S4_S3 1 100 0 65535 ECU_ADDRESS 0xFFF82F9E DISPLAY_IDENTIFIER di_obd_iumpr_denominator[28].ZFEH_EepromData /end MEASUREMENT
/begin MEASUREMENT ZFEH_EepromData.di_obd_iumpr_denominator[29] "error code related denominator [0 .. 254-1]" UWORD EH_STANDARD_S4_S3 1 100 0 65535 ECU_ADDRESS 0xFFF82FA0 DISPLAY_IDENTIFIER di_obd_iumpr_denominator[29].ZFEH_EepromData /end MEASUREMENT
/begin MEASUREMENT ZFEH_EepromData.di_obd_iumpr_denominator[2] "error code related denominator [0 .. 254-1]" UWORD EH_STANDARD_S4_S3 1 100 0 65535 ECU_ADDRESS 0xFFF82F6A DISPLAY_IDENTIFIER di_obd_iumpr_denominator[2].ZFEH_EepromData /end MEASUREMENT
/begin MEASUREMENT ZFEH_EepromData.di_obd_iumpr_denominator[30] "error code related denominator [0 .. 254-1]" UWORD EH_STANDARD_S4_S3 1 100 0 65535 ECU_ADDRESS 0xFFF82FA2 DISPLAY_IDENTIFIER di_obd_iumpr_denominator[30].ZFEH_EepromData /end MEASUREMENT
/begin MEASUREMENT ZFEH_EepromData.di_obd_iumpr_denominator[31] "error code related denominator [0 .. 254-1]" UWORD EH_STANDARD_S4_S3 1 100 0 65535 ECU_ADDRESS 0xFFF82FA4 DISPLAY_IDENTIFIER di_obd_iumpr_denominator[31].ZFEH_EepromData /end MEASUREMENT
/begin MEASUREMENT ZFEH_EepromData.di_obd_iumpr_denominator[32] "error code related denominator [0 .. 254-1]" UWORD EH_STANDARD_S4_S3 1 100 0 65535 ECU_ADDRESS 0xFFF82FA6 DISPLAY_IDENTIFIER di_obd_iumpr_denominator[32].ZFEH_EepromData /end MEASUREMENT
/begin MEASUREMENT ZFEH_EepromData.di_obd_iumpr_denominator[33] "error code related denominator [0 .. 254-1]" UWORD EH_STANDARD_S4_S3 1 100 0 65535 ECU_ADDRESS 0xFFF82FA8 DISPLAY_IDENTIFIER di_obd_iumpr_denominator[33].ZFEH_EepromData /end MEASUREMENT
/begin MEASUREMENT ZFEH_EepromData.di_obd_iumpr_denominator[34] "error code related denominator [0 .. 254-1]" UWORD EH_STANDARD_S4_S3 1 100 0 65535 ECU_ADDRESS 0xFFF82FAA DISPLAY_IDENTIFIER di_obd_iumpr_denominator[34].ZFEH_EepromData /end MEASUREMENT
/begin MEASUREMENT ZFEH_EepromData.di_obd_iumpr_denominator[35] "error code related denominator [0 .. 254-1]" UWORD EH_STANDARD_S4_S3 1 100 0 65535 ECU_ADDRESS 0xFFF82FAC DISPLAY_IDENTIFIER di_obd_iumpr_denominator[35].ZFEH_EepromData /end MEASUREMENT
/begin MEASUREMENT ZFEH_EepromData.di_obd_iumpr_denominator[36] "error code related denominator [0 .. 254-1]" UWORD EH_STANDARD_S4_S3 1 100 0 65535 ECU_ADDRESS 0xFFF82FAE DISPLAY_IDENTIFIER di_obd_iumpr_denominator[36].ZFEH_EepromData /end MEASUREMENT
/begin MEASUREMENT ZFEH_EepromData.di_obd_iumpr_denominator[37] "error code related denominator [0 .. 254-1]" UWORD EH_STANDARD_S4_S3 1 100 0 65535 ECU_ADDRESS 0xFFF82FB0 DISPLAY_IDENTIFIER di_obd_iumpr_denominator[37].ZFEH_EepromData /end MEASUREMENT
/begin MEASUREMENT ZFEH_EepromData.di_obd_iumpr_denominator[38] "error code related denominator [0 .. 254-1]" UWORD EH_STANDARD_S4_S3 1 100 0 65535 ECU_ADDRESS 0xFFF82FB2 DISPLAY_IDENTIFIER di_obd_iumpr_denominator[38].ZFEH_EepromData /end MEASUREMENT
/begin MEASUREMENT ZFEH_EepromData.di_obd_iumpr_denominator[39] "error code related denominator [0 .. 254-1]" UWORD EH_STANDARD_S4_S3 1 100 0 65535 ECU_ADDRESS 0xFFF82FB4 DISPLAY_IDENTIFIER di_obd_iumpr_denominator[39].ZFEH_EepromData /end MEASUREMENT
/begin MEASUREMENT ZFEH_EepromData.di_obd_iumpr_denominator[3] "error code related denominator [0 .. 254-1]" UWORD EH_STANDARD_S4_S3 1 100 0 65535 ECU_ADDRESS 0xFFF82F6C DISPLAY_IDENTIFIER di_obd_iumpr_denominator[3].ZFEH_EepromData /end MEASUREMENT
/begin MEASUREMENT ZFEH_EepromData.di_obd_iumpr_denominator[40] "error code related denominator [0 .. 254-1]" UWORD EH_STANDARD_S4_S3 1 100 0 65535 ECU_ADDRESS 0xFFF82FB6 DISPLAY_IDENTIFIER di_obd_iumpr_denominator[40].ZFEH_EepromData /end MEASUREMENT
/begin MEASUREMENT ZFEH_EepromData.di_obd_iumpr_denominator[41] "error code related denominator [0 .. 254-1]" UWORD EH_STANDARD_S4_S3 1 100 0 65535 ECU_ADDRESS 0xFFF82FB8 DISPLAY_IDENTIFIER di_obd_iumpr_denominator[41].ZFEH_EepromData /end MEASUREMENT
/begin MEASUREMENT ZFEH_EepromData.di_obd_iumpr_denominator[42] "error code related denominator [0 .. 254-1]" UWORD EH_STANDARD_S4_S3 1 100 0 65535 ECU_ADDRESS 0xFFF82FBA DISPLAY_IDENTIFIER di_obd_iumpr_denominator[42].ZFEH_EepromData /end MEASUREMENT
/begin MEASUREMENT ZFEH_EepromData.di_obd_iumpr_denominator[43] "error code related denominator [0 .. 254-1]" UWORD EH_STANDARD_S4_S3 1 100 0 65535 ECU_ADDRESS 0xFFF82FBC DISPLAY_IDENTIFIER di_obd_iumpr_denominator[43].ZFEH_EepromData /end MEASUREMENT
/begin MEASUREMENT ZFEH_EepromData.di_obd_iumpr_denominator[44] "error code related denominator [0 .. 254-1]" UWORD EH_STANDARD_S4_S3 1 100 0 65535 ECU_ADDRESS 0xFFF82FBE DISPLAY_IDENTIFIER di_obd_iumpr_denominator[44].ZFEH_EepromData /end MEASUREMENT
/begin MEASUREMENT ZFEH_EepromData.di_obd_iumpr_denominator[45] "error code related denominator [0 .. 254-1]" UWORD EH_STANDARD_S4_S3 1 100 0 65535 ECU_ADDRESS 0xFFF82FC0 DISPLAY_IDENTIFIER di_obd_iumpr_denominator[45].ZFEH_EepromData /end MEASUREMENT
/begin MEASUREMENT ZFEH_EepromData.di_obd_iumpr_denominator[46] "error code related denominator [0 .. 254-1]" UWORD EH_STANDARD_S4_S3 1 100 0 65535 ECU_ADDRESS 0xFFF82FC2 DISPLAY_IDENTIFIER di_obd_iumpr_denominator[46].ZFEH_EepromData /end MEASUREMENT
/begin MEASUREMENT ZFEH_EepromData.di_obd_iumpr_denominator[47] "error code related denominator [0 .. 254-1]" UWORD EH_STANDARD_S4_S3 1 100 0 65535 ECU_ADDRESS 0xFFF82FC4 DISPLAY_IDENTIFIER di_obd_iumpr_denominator[47].ZFEH_EepromData /end MEASUREMENT
/begin MEASUREMENT ZFEH_EepromData.di_obd_iumpr_denominator[48] "error code related denominator [0 .. 254-1]" UWORD EH_STANDARD_S4_S3 1 100 0 65535 ECU_ADDRESS 0xFFF82FC6 DISPLAY_IDENTIFIER di_obd_iumpr_denominator[48].ZFEH_EepromData /end MEASUREMENT
/begin MEASUREMENT ZFEH_EepromData.di_obd_iumpr_denominator[49] "error code related denominator [0 .. 254-1]" UWORD EH_STANDARD_S4_S3 1 100 0 65535 ECU_ADDRESS 0xFFF82FC8 DISPLAY_IDENTIFIER di_obd_iumpr_denominator[49].ZFEH_EepromData /end MEASUREMENT
/begin MEASUREMENT ZFEH_EepromData.di_obd_iumpr_denominator[4] "error code related denominator [0 .. 254-1]" UWORD EH_STANDARD_S4_S3 1 100 0 65535 ECU_ADDRESS 0xFFF82F6E DISPLAY_IDENTIFIER di_obd_iumpr_denominator[4].ZFEH_EepromData /end MEASUREMENT
/begin MEASUREMENT ZFEH_EepromData.di_obd_iumpr_denominator[50] "error code related denominator [0 .. 254-1]" UWORD EH_STANDARD_S4_S3 1 100 0 65535 ECU_ADDRESS 0xFFF82FCA DISPLAY_IDENTIFIER di_obd_iumpr_denominator[50].ZFEH_EepromData /end MEASUREMENT
/begin MEASUREMENT ZFEH_EepromData.di_obd_iumpr_denominator[51] "error code related denominator [0 .. 254-1]" UWORD EH_STANDARD_S4_S3 1 100 0 65535 ECU_ADDRESS 0xFFF82FCC DISPLAY_IDENTIFIER di_obd_iumpr_denominator[51].ZFEH_EepromData /end MEASUREMENT
/begin MEASUREMENT ZFEH_EepromData.di_obd_iumpr_denominator[52] "error code related denominator [0 .. 254-1]" UWORD EH_STANDARD_S4_S3 1 100 0 65535 ECU_ADDRESS 0xFFF82FCE DISPLAY_IDENTIFIER di_obd_iumpr_denominator[52].ZFEH_EepromData /end MEASUREMENT
/begin MEASUREMENT ZFEH_EepromData.di_obd_iumpr_denominator[53] "error code related denominator [0 .. 254-1]" UWORD EH_STANDARD_S4_S3 1 100 0 65535 ECU_ADDRESS 0xFFF82FD0 DISPLAY_IDENTIFIER di_obd_iumpr_denominator[53].ZFEH_EepromData /end MEASUREMENT
/begin MEASUREMENT ZFEH_EepromData.di_obd_iumpr_denominator[54] "error code related denominator [0 .. 254-1]" UWORD EH_STANDARD_S4_S3 1 100 0 65535 ECU_ADDRESS 0xFFF82FD2 DISPLAY_IDENTIFIER di_obd_iumpr_denominator[54].ZFEH_EepromData /end MEASUREMENT
/begin MEASUREMENT ZFEH_EepromData.di_obd_iumpr_denominator[55] "error code related denominator [0 .. 254-1]" UWORD EH_STANDARD_S4_S3 1 100 0 65535 ECU_ADDRESS 0xFFF82FD4 DISPLAY_IDENTIFIER di_obd_iumpr_denominator[55].ZFEH_EepromData /end MEASUREMENT
/begin MEASUREMENT ZFEH_EepromData.di_obd_iumpr_denominator[56] "error code related denominator [0 .. 254-1]" UWORD EH_STANDARD_S4_S3 1 100 0 65535 ECU_ADDRESS 0xFFF82FD6 DISPLAY_IDENTIFIER di_obd_iumpr_denominator[56].ZFEH_EepromData /end MEASUREMENT
/begin MEASUREMENT ZFEH_EepromData.di_obd_iumpr_denominator[57] "error code related denominator [0 .. 254-1]" UWORD EH_STANDARD_S4_S3 1 100 0 65535 ECU_ADDRESS 0xFFF82FD8 DISPLAY_IDENTIFIER di_obd_iumpr_denominator[57].ZFEH_EepromData /end MEASUREMENT
/begin MEASUREMENT ZFEH_EepromData.di_obd_iumpr_denominator[58] "error code related denominator [0 .. 254-1]" UWORD EH_STANDARD_S4_S3 1 100 0 65535 ECU_ADDRESS 0xFFF82FDA DISPLAY_IDENTIFIER di_obd_iumpr_denominator[58].ZFEH_EepromData /end MEASUREMENT
/begin MEASUREMENT ZFEH_EepromData.di_obd_iumpr_denominator[59] "error code related denominator [0 .. 254-1]" UWORD EH_STANDARD_S4_S3 1 100 0 65535 ECU_ADDRESS 0xFFF82FDC DISPLAY_IDENTIFIER di_obd_iumpr_denominator[59].ZFEH_EepromData /end MEASUREMENT
/begin MEASUREMENT ZFEH_EepromData.di_obd_iumpr_denominator[5] "error code related denominator [0 .. 254-1]" UWORD EH_STANDARD_S4_S3 1 100 0 65535 ECU_ADDRESS 0xFFF82F70 DISPLAY_IDENTIFIER di_obd_iumpr_denominator[5].ZFEH_EepromData /end MEASUREMENT
/begin MEASUREMENT ZFEH_EepromData.di_obd_iumpr_denominator[60] "error code related denominator [0 .. 254-1]" UWORD EH_STANDARD_S4_S3 1 100 0 65535 ECU_ADDRESS 0xFFF82FDE DISPLAY_IDENTIFIER di_obd_iumpr_denominator[60].ZFEH_EepromData /end MEASUREMENT
/begin MEASUREMENT ZFEH_EepromData.di_obd_iumpr_denominator[61] "error code related denominator [0 .. 254-1]" UWORD EH_STANDARD_S4_S3 1 100 0 65535 ECU_ADDRESS 0xFFF82FE0 DISPLAY_IDENTIFIER di_obd_iumpr_denominator[61].ZFEH_EepromData /end MEASUREMENT
/begin MEASUREMENT ZFEH_EepromData.di_obd_iumpr_denominator[62] "error code related denominator [0 .. 254-1]" UWORD EH_STANDARD_S4_S3 1 100 0 65535 ECU_ADDRESS 0xFFF82FE2 DISPLAY_IDENTIFIER di_obd_iumpr_denominator[62].ZFEH_EepromData /end MEASUREMENT
/begin MEASUREMENT ZFEH_EepromData.di_obd_iumpr_denominator[63] "error code related denominator [0 .. 254-1]" UWORD EH_STANDARD_S4_S3 1 100 0 65535 ECU_ADDRESS 0xFFF82FE4 DISPLAY_IDENTIFIER di_obd_iumpr_denominator[63].ZFEH_EepromData /end MEASUREMENT
/begin MEASUREMENT ZFEH_EepromData.di_obd_iumpr_denominator[64] "error code related denominator [0 .. 254-1]" UWORD EH_STANDARD_S4_S3 1 100 0 65535 ECU_ADDRESS 0xFFF82FE6 DISPLAY_IDENTIFIER di_obd_iumpr_denominator[64].ZFEH_EepromData /end MEASUREMENT
/begin MEASUREMENT ZFEH_EepromData.di_obd_iumpr_denominator[65] "error code related denominator [0 .. 254-1]" UWORD EH_STANDARD_S4_S3 1 100 0 65535 ECU_ADDRESS 0xFFF82FE8 DISPLAY_IDENTIFIER di_obd_iumpr_denominator[65].ZFEH_EepromData /end MEASUREMENT
/begin MEASUREMENT ZFEH_EepromData.di_obd_iumpr_denominator[66] "error code related denominator [0 .. 254-1]" UWORD EH_STANDARD_S4_S3 1 100 0 65535 ECU_ADDRESS 0xFFF82FEA DISPLAY_IDENTIFIER di_obd_iumpr_denominator[66].ZFEH_EepromData /end MEASUREMENT
/begin MEASUREMENT ZFEH_EepromData.di_obd_iumpr_denominator[67] "error code related denominator [0 .. 254-1]" UWORD EH_STANDARD_S4_S3 1 100 0 65535 ECU_ADDRESS 0xFFF82FEC DISPLAY_IDENTIFIER di_obd_iumpr_denominator[67].ZFEH_EepromData /end MEASUREMENT
/begin MEASUREMENT ZFEH_EepromData.di_obd_iumpr_denominator[68] "error code related denominator [0 .. 254-1]" UWORD EH_STANDARD_S4_S3 1 100 0 65535 ECU_ADDRESS 0xFFF82FEE DISPLAY_IDENTIFIER di_obd_iumpr_denominator[68].ZFEH_EepromData /end MEASUREMENT
/begin MEASUREMENT ZFEH_EepromData.di_obd_iumpr_denominator[69] "error code related denominator [0 .. 254-1]" UWORD EH_STANDARD_S4_S3 1 100 0 65535 ECU_ADDRESS 0xFFF82FF0 DISPLAY_IDENTIFIER di_obd_iumpr_denominator[69].ZFEH_EepromData /end MEASUREMENT
/begin MEASUREMENT ZFEH_EepromData.di_obd_iumpr_denominator[6] "error code related denominator [0 .. 254-1]" UWORD EH_STANDARD_S4_S3 1 100 0 65535 ECU_ADDRESS 0xFFF82F72 DISPLAY_IDENTIFIER di_obd_iumpr_denominator[6].ZFEH_EepromData /end MEASUREMENT
/begin MEASUREMENT ZFEH_EepromData.di_obd_iumpr_denominator[70] "error code related denominator [0 .. 254-1]" UWORD EH_STANDARD_S4_S3 1 100 0 65535 ECU_ADDRESS 0xFFF82FF2 DISPLAY_IDENTIFIER di_obd_iumpr_denominator[70].ZFEH_EepromData /end MEASUREMENT
/begin MEASUREMENT ZFEH_EepromData.di_obd_iumpr_denominator[71] "error code related denominator [0 .. 254-1]" UWORD EH_STANDARD_S4_S3 1 100 0 65535 ECU_ADDRESS 0xFFF82FF4 DISPLAY_IDENTIFIER di_obd_iumpr_denominator[71].ZFEH_EepromData /end MEASUREMENT
/begin MEASUREMENT ZFEH_EepromData.di_obd_iumpr_denominator[72] "error code related denominator [0 .. 254-1]" UWORD EH_STANDARD_S4_S3 1 100 0 65535 ECU_ADDRESS 0xFFF82FF6 DISPLAY_IDENTIFIER di_obd_iumpr_denominator[72].ZFEH_EepromData /end MEASUREMENT
/begin MEASUREMENT ZFEH_EepromData.di_obd_iumpr_denominator[73] "error code related denominator [0 .. 254-1]" UWORD EH_STANDARD_S4_S3 1 100 0 65535 ECU_ADDRESS 0xFFF82FF8 DISPLAY_IDENTIFIER di_obd_iumpr_denominator[73].ZFEH_EepromData /end MEASUREMENT
/begin MEASUREMENT ZFEH_EepromData.di_obd_iumpr_denominator[74] "error code related denominator [0 .. 254-1]" UWORD EH_STANDARD_S4_S3 1 100 0 65535 ECU_ADDRESS 0xFFF82FFA DISPLAY_IDENTIFIER di_obd_iumpr_denominator[74].ZFEH_EepromData /end MEASUREMENT
/begin MEASUREMENT ZFEH_EepromData.di_obd_iumpr_denominator[75] "error code related denominator [0 .. 254-1]" UWORD EH_STANDARD_S4_S3 1 100 0 65535 ECU_ADDRESS 0xFFF82FFC DISPLAY_IDENTIFIER di_obd_iumpr_denominator[75].ZFEH_EepromData /end MEASUREMENT
/begin MEASUREMENT ZFEH_EepromData.di_obd_iumpr_denominator[76] "error code related denominator [0 .. 254-1]" UWORD EH_STANDARD_S4_S3 1 100 0 65535 ECU_ADDRESS 0xFFF82FFE DISPLAY_IDENTIFIER di_obd_iumpr_denominator[76].ZFEH_EepromData /end MEASUREMENT
/begin MEASUREMENT ZFEH_EepromData.di_obd_iumpr_denominator[77] "error code related denominator [0 .. 254-1]" UWORD EH_STANDARD_S4_S3 1 100 0 65535 ECU_ADDRESS 0xFFF83000 DISPLAY_IDENTIFIER di_obd_iumpr_denominator[77].ZFEH_EepromData /end MEASUREMENT
/begin MEASUREMENT ZFEH_EepromData.di_obd_iumpr_denominator[78] "error code related denominator [0 .. 254-1]" UWORD EH_STANDARD_S4_S3 1 100 0 65535 ECU_ADDRESS 0xFFF83002 DISPLAY_IDENTIFIER di_obd_iumpr_denominator[78].ZFEH_EepromData /end MEASUREMENT
/begin MEASUREMENT ZFEH_EepromData.di_obd_iumpr_denominator[79] "error code related denominator [0 .. 254-1]" UWORD EH_STANDARD_S4_S3 1 100 0 65535 ECU_ADDRESS 0xFFF83004 DISPLAY_IDENTIFIER di_obd_iumpr_denominator[79].ZFEH_EepromData /end MEASUREMENT
/begin MEASUREMENT ZFEH_EepromData.di_obd_iumpr_denominator[7] "error code related denominator [0 .. 254-1]" UWORD EH_STANDARD_S4_S3 1 100 0 65535 ECU_ADDRESS 0xFFF82F74 DISPLAY_IDENTIFIER di_obd_iumpr_denominator[7].ZFEH_EepromData /end MEASUREMENT
/begin MEASUREMENT ZFEH_EepromData.di_obd_iumpr_denominator[80] "error code related denominator [0 .. 254-1]" UWORD EH_STANDARD_S4_S3 1 100 0 65535 ECU_ADDRESS 0xFFF83006 DISPLAY_IDENTIFIER di_obd_iumpr_denominator[80].ZFEH_EepromData /end MEASUREMENT
/begin MEASUREMENT ZFEH_EepromData.di_obd_iumpr_denominator[81] "error code related denominator [0 .. 254-1]" UWORD EH_STANDARD_S4_S3 1 100 0 65535 ECU_ADDRESS 0xFFF83008 DISPLAY_IDENTIFIER di_obd_iumpr_denominator[81].ZFEH_EepromData /end MEASUREMENT
/begin MEASUREMENT ZFEH_EepromData.di_obd_iumpr_denominator[82] "error code related denominator [0 .. 254-1]" UWORD EH_STANDARD_S4_S3 1 100 0 65535 ECU_ADDRESS 0xFFF8300A DISPLAY_IDENTIFIER di_obd_iumpr_denominator[82].ZFEH_EepromData /end MEASUREMENT
/begin MEASUREMENT ZFEH_EepromData.di_obd_iumpr_denominator[83] "error code related denominator [0 .. 254-1]" UWORD EH_STANDARD_S4_S3 1 100 0 65535 ECU_ADDRESS 0xFFF8300C DISPLAY_IDENTIFIER di_obd_iumpr_denominator[83].ZFEH_EepromData /end MEASUREMENT
/begin MEASUREMENT ZFEH_EepromData.di_obd_iumpr_denominator[84] "error code related denominator [0 .. 254-1]" UWORD EH_STANDARD_S4_S3 1 100 0 65535 ECU_ADDRESS 0xFFF8300E DISPLAY_IDENTIFIER di_obd_iumpr_denominator[84].ZFEH_EepromData /end MEASUREMENT
/begin MEASUREMENT ZFEH_EepromData.di_obd_iumpr_denominator[85] "error code related denominator [0 .. 254-1]" UWORD EH_STANDARD_S4_S3 1 100 0 65535 ECU_ADDRESS 0xFFF83010 DISPLAY_IDENTIFIER di_obd_iumpr_denominator[85].ZFEH_EepromData /end MEASUREMENT
/begin MEASUREMENT ZFEH_EepromData.di_obd_iumpr_denominator[86] "error code related denominator [0 .. 254-1]" UWORD EH_STANDARD_S4_S3 1 100 0 65535 ECU_ADDRESS 0xFFF83012 DISPLAY_IDENTIFIER di_obd_iumpr_denominator[86].ZFEH_EepromData /end MEASUREMENT
/begin MEASUREMENT ZFEH_EepromData.di_obd_iumpr_denominator[87] "error code related denominator [0 .. 254-1]" UWORD EH_STANDARD_S4_S3 1 100 0 65535 ECU_ADDRESS 0xFFF83014 DISPLAY_IDENTIFIER di_obd_iumpr_denominator[87].ZFEH_EepromData /end MEASUREMENT
/begin MEASUREMENT ZFEH_EepromData.di_obd_iumpr_denominator[88] "error code related denominator [0 .. 254-1]" UWORD EH_STANDARD_S4_S3 1 100 0 65535 ECU_ADDRESS 0xFFF83016 DISPLAY_IDENTIFIER di_obd_iumpr_denominator[88].ZFEH_EepromData /end MEASUREMENT
/begin MEASUREMENT ZFEH_EepromData.di_obd_iumpr_denominator[89] "error code related denominator [0 .. 254-1]" UWORD EH_STANDARD_S4_S3 1 100 0 65535 ECU_ADDRESS 0xFFF83018 DISPLAY_IDENTIFIER di_obd_iumpr_denominator[89].ZFEH_EepromData /end MEASUREMENT
/begin MEASUREMENT ZFEH_EepromData.di_obd_iumpr_denominator[8] "error code related denominator [0 .. 254-1]" UWORD EH_STANDARD_S4_S3 1 100 0 65535 ECU_ADDRESS 0xFFF82F76 DISPLAY_IDENTIFIER di_obd_iumpr_denominator[8].ZFEH_EepromData /end MEASUREMENT
/begin MEASUREMENT ZFEH_EepromData.di_obd_iumpr_denominator[90] "error code related denominator [0 .. 254-1]" UWORD EH_STANDARD_S4_S3 1 100 0 65535 ECU_ADDRESS 0xFFF8301A DISPLAY_IDENTIFIER di_obd_iumpr_denominator[90].ZFEH_EepromData /end MEASUREMENT
/begin MEASUREMENT ZFEH_EepromData.di_obd_iumpr_denominator[91] "error code related denominator [0 .. 254-1]" UWORD EH_STANDARD_S4_S3 1 100 0 65535 ECU_ADDRESS 0xFFF8301C DISPLAY_IDENTIFIER di_obd_iumpr_denominator[91].ZFEH_EepromData /end MEASUREMENT
/begin MEASUREMENT ZFEH_EepromData.di_obd_iumpr_denominator[92] "error code related denominator [0 .. 254-1]" UWORD EH_STANDARD_S4_S3 1 100 0 65535 ECU_ADDRESS 0xFFF8301E DISPLAY_IDENTIFIER di_obd_iumpr_denominator[92].ZFEH_EepromData /end MEASUREMENT
/begin MEASUREMENT ZFEH_EepromData.di_obd_iumpr_denominator[93] "error code related denominator [0 .. 254-1]" UWORD EH_STANDARD_S4_S3 1 100 0 65535 ECU_ADDRESS 0xFFF83020 DISPLAY_IDENTIFIER di_obd_iumpr_denominator[93].ZFEH_EepromData /end MEASUREMENT
/begin MEASUREMENT ZFEH_EepromData.di_obd_iumpr_denominator[94] "error code related denominator [0 .. 254-1]" UWORD EH_STANDARD_S4_S3 1 100 0 65535 ECU_ADDRESS 0xFFF83022 DISPLAY_IDENTIFIER di_obd_iumpr_denominator[94].ZFEH_EepromData /end MEASUREMENT
/begin MEASUREMENT ZFEH_EepromData.di_obd_iumpr_denominator[95] "error code related denominator [0 .. 254-1]" UWORD EH_STANDARD_S4_S3 1 100 0 65535 ECU_ADDRESS 0xFFF83024 DISPLAY_IDENTIFIER di_obd_iumpr_denominator[95].ZFEH_EepromData /end MEASUREMENT
/begin MEASUREMENT ZFEH_EepromData.di_obd_iumpr_denominator[96] "error code related denominator [0 .. 254-1]" UWORD EH_STANDARD_S4_S3 1 100 0 65535 ECU_ADDRESS 0xFFF83026 DISPLAY_IDENTIFIER di_obd_iumpr_denominator[96].ZFEH_EepromData /end MEASUREMENT
/begin MEASUREMENT ZFEH_EepromData.di_obd_iumpr_denominator[97] "error code related denominator [0 .. 254-1]" UWORD EH_STANDARD_S4_S3 1 100 0 65535 ECU_ADDRESS 0xFFF83028 DISPLAY_IDENTIFIER di_obd_iumpr_denominator[97].ZFEH_EepromData /end MEASUREMENT
/begin MEASUREMENT ZFEH_EepromData.di_obd_iumpr_denominator[98] "error code related denominator [0 .. 254-1]" UWORD EH_STANDARD_S4_S3 1 100 0 65535 ECU_ADDRESS 0xFFF8302A DISPLAY_IDENTIFIER di_obd_iumpr_denominator[98].ZFEH_EepromData /end MEASUREMENT
/begin MEASUREMENT ZFEH_EepromData.di_obd_iumpr_denominator[99] "error code related denominator [0 .. 254-1]" UWORD EH_STANDARD_S4_S3 1 100 0 65535 ECU_ADDRESS 0xFFF8302C DISPLAY_IDENTIFIER di_obd_iumpr_denominator[99].ZFEH_EepromData /end MEASUREMENT
/begin MEASUREMENT ZFEH_EepromData.di_obd_iumpr_denominator[9] "error code related denominator [0 .. 254-1]" UWORD EH_STANDARD_S4_S3 1 100 0 65535 ECU_ADDRESS 0xFFF82F78 DISPLAY_IDENTIFIER di_obd_iumpr_denominator[9].ZFEH_EepromData /end MEASUREMENT
/begin MEASUREMENT ZFEH_EepromData.di_obd_iumpr_gen_den "OBD monitoring conditions encountered counts (General Denominator)" UWORD EH_STANDARD_S4_S3 1 100 0 65535 ECU_ADDRESS 0xFFF82D64 DISPLAY_IDENTIFIER di_obd_iumpr_gen_den.ZFEH_EepromData /end MEASUREMENT
/begin MEASUREMENT ZFEH_EepromData.di_obd_iumpr_ign_cycle "OBD ignition cycle counter (Number of engine starts)" UWORD EH_STANDARD_S4_S3 1 100 0 65535 ECU_ADDRESS 0xFFF82D66 DISPLAY_IDENTIFIER di_obd_iumpr_ign_cycle.ZFEH_EepromData /end MEASUREMENT
/begin MEASUREMENT ZFEH_EepromData.di_obd_iumpr_numerator[0] "error code related numerator [0 .. 254-1]" UWORD EH_STANDARD_S4_S3 1 100 0 65535 ECU_ADDRESS 0xFFF82D6A DISPLAY_IDENTIFIER di_obd_iumpr_numerator[0].ZFEH_EepromData /end MEASUREMENT
/begin MEASUREMENT ZFEH_EepromData.di_obd_iumpr_numerator[100] "error code related numerator [0 .. 254-1]" UWORD EH_STANDARD_S4_S3 1 100 0 65535 ECU_ADDRESS 0xFFF82E32 DISPLAY_IDENTIFIER di_obd_iumpr_numerator[100].ZFEH_EepromData /end MEASUREMENT
/begin MEASUREMENT ZFEH_EepromData.di_obd_iumpr_numerator[101] "error code related numerator [0 .. 254-1]" UWORD EH_STANDARD_S4_S3 1 100 0 65535 ECU_ADDRESS 0xFFF82E34 DISPLAY_IDENTIFIER di_obd_iumpr_numerator[101].ZFEH_EepromData /end MEASUREMENT
/begin MEASUREMENT ZFEH_EepromData.di_obd_iumpr_numerator[102] "error code related numerator [0 .. 254-1]" UWORD EH_STANDARD_S4_S3 1 100 0 65535 ECU_ADDRESS 0xFFF82E36 DISPLAY_IDENTIFIER di_obd_iumpr_numerator[102].ZFEH_EepromData /end MEASUREMENT
/begin MEASUREMENT ZFEH_EepromData.di_obd_iumpr_numerator[103] "error code related numerator [0 .. 254-1]" UWORD EH_STANDARD_S4_S3 1 100 0 65535 ECU_ADDRESS 0xFFF82E38 DISPLAY_IDENTIFIER di_obd_iumpr_numerator[103].ZFEH_EepromData /end MEASUREMENT
/begin MEASUREMENT ZFEH_EepromData.di_obd_iumpr_numerator[104] "error code related numerator [0 .. 254-1]" UWORD EH_STANDARD_S4_S3 1 100 0 65535 ECU_ADDRESS 0xFFF82E3A DISPLAY_IDENTIFIER di_obd_iumpr_numerator[104].ZFEH_EepromData /end MEASUREMENT
/begin MEASUREMENT ZFEH_EepromData.di_obd_iumpr_numerator[105] "error code related numerator [0 .. 254-1]" UWORD EH_STANDARD_S4_S3 1 100 0 65535 ECU_ADDRESS 0xFFF82E3C DISPLAY_IDENTIFIER di_obd_iumpr_numerator[105].ZFEH_EepromData /end MEASUREMENT
/begin MEASUREMENT ZFEH_EepromData.di_obd_iumpr_numerator[106] "error code related numerator [0 .. 254-1]" UWORD EH_STANDARD_S4_S3 1 100 0 65535 ECU_ADDRESS 0xFFF82E3E DISPLAY_IDENTIFIER di_obd_iumpr_numerator[106].ZFEH_EepromData /end MEASUREMENT
/begin MEASUREMENT ZFEH_EepromData.di_obd_iumpr_numerator[107] "error code related numerator [0 .. 254-1]" UWORD EH_STANDARD_S4_S3 1 100 0 65535 ECU_ADDRESS 0xFFF82E40 DISPLAY_IDENTIFIER di_obd_iumpr_numerator[107].ZFEH_EepromData /end MEASUREMENT
/begin MEASUREMENT ZFEH_EepromData.di_obd_iumpr_numerator[108] "error code related numerator [0 .. 254-1]" UWORD EH_STANDARD_S4_S3 1 100 0 65535 ECU_ADDRESS 0xFFF82E42 DISPLAY_IDENTIFIER di_obd_iumpr_numerator[108].ZFEH_EepromData /end MEASUREMENT
/begin MEASUREMENT ZFEH_EepromData.di_obd_iumpr_numerator[109] "error code related numerator [0 .. 254-1]" UWORD EH_STANDARD_S4_S3 1 100 0 65535 ECU_ADDRESS 0xFFF82E44 DISPLAY_IDENTIFIER di_obd_iumpr_numerator[109].ZFEH_EepromData /end MEASUREMENT
/begin MEASUREMENT ZFEH_EepromData.di_obd_iumpr_numerator[10] "error code related numerator [0 .. 254-1]" UWORD EH_STANDARD_S4_S3 1 100 0 65535 ECU_ADDRESS 0xFFF82D7E DISPLAY_IDENTIFIER di_obd_iumpr_numerator[10].ZFEH_EepromData /end MEASUREMENT
/begin MEASUREMENT ZFEH_EepromData.di_obd_iumpr_numerator[110] "error code related numerator [0 .. 254-1]" UWORD EH_STANDARD_S4_S3 1 100 0 65535 ECU_ADDRESS 0xFFF82E46 DISPLAY_IDENTIFIER di_obd_iumpr_numerator[110].ZFEH_EepromData /end MEASUREMENT
/begin MEASUREMENT ZFEH_EepromData.di_obd_iumpr_numerator[111] "error code related numerator [0 .. 254-1]" UWORD EH_STANDARD_S4_S3 1 100 0 65535 ECU_ADDRESS 0xFFF82E48 DISPLAY_IDENTIFIER di_obd_iumpr_numerator[111].ZFEH_EepromData /end MEASUREMENT
/begin MEASUREMENT ZFEH_EepromData.di_obd_iumpr_numerator[112] "error code related numerator [0 .. 254-1]" UWORD EH_STANDARD_S4_S3 1 100 0 65535 ECU_ADDRESS 0xFFF82E4A DISPLAY_IDENTIFIER di_obd_iumpr_numerator[112].ZFEH_EepromData /end MEASUREMENT
/begin MEASUREMENT ZFEH_EepromData.di_obd_iumpr_numerator[113] "error code related numerator [0 .. 254-1]" UWORD EH_STANDARD_S4_S3 1 100 0 65535 ECU_ADDRESS 0xFFF82E4C DISPLAY_IDENTIFIER di_obd_iumpr_numerator[113].ZFEH_EepromData /end MEASUREMENT
/begin MEASUREMENT ZFEH_EepromData.di_obd_iumpr_numerator[114] "error code related numerator [0 .. 254-1]" UWORD EH_STANDARD_S4_S3 1 100 0 65535 ECU_ADDRESS 0xFFF82E4E DISPLAY_IDENTIFIER di_obd_iumpr_numerator[114].ZFEH_EepromData /end MEASUREMENT
/begin MEASUREMENT ZFEH_EepromData.di_obd_iumpr_numerator[115] "error code related numerator [0 .. 254-1]" UWORD EH_STANDARD_S4_S3 1 100 0 65535 ECU_ADDRESS 0xFFF82E50 DISPLAY_IDENTIFIER di_obd_iumpr_numerator[115].ZFEH_EepromData /end MEASUREMENT
/begin MEASUREMENT ZFEH_EepromData.di_obd_iumpr_numerator[116] "error code related numerator [0 .. 254-1]" UWORD EH_STANDARD_S4_S3 1 100 0 65535 ECU_ADDRESS 0xFFF82E52 DISPLAY_IDENTIFIER di_obd_iumpr_numerator[116].ZFEH_EepromData /end MEASUREMENT
/begin MEASUREMENT ZFEH_EepromData.di_obd_iumpr_numerator[117] "error code related numerator [0 .. 254-1]" UWORD EH_STANDARD_S4_S3 1 100 0 65535 ECU_ADDRESS 0xFFF82E54 DISPLAY_IDENTIFIER di_obd_iumpr_numerator[117].ZFEH_EepromData /end MEASUREMENT
/begin MEASUREMENT ZFEH_EepromData.di_obd_iumpr_numerator[118] "error code related numerator [0 .. 254-1]" UWORD EH_STANDARD_S4_S3 1 100 0 65535 ECU_ADDRESS 0xFFF82E56 DISPLAY_IDENTIFIER di_obd_iumpr_numerator[118].ZFEH_EepromData /end MEASUREMENT
/begin MEASUREMENT ZFEH_EepromData.di_obd_iumpr_numerator[119] "error code related numerator [0 .. 254-1]" UWORD EH_STANDARD_S4_S3 1 100 0 65535 ECU_ADDRESS 0xFFF82E58 DISPLAY_IDENTIFIER di_obd_iumpr_numerator[119].ZFEH_EepromData /end MEASUREMENT
/begin MEASUREMENT ZFEH_EepromData.di_obd_iumpr_numerator[11] "error code related numerator [0 .. 254-1]" UWORD EH_STANDARD_S4_S3 1 100 0 65535 ECU_ADDRESS 0xFFF82D80 DISPLAY_IDENTIFIER di_obd_iumpr_numerator[11].ZFEH_EepromData /end MEASUREMENT
/begin MEASUREMENT ZFEH_EepromData.di_obd_iumpr_numerator[120] "error code related numerator [0 .. 254-1]" UWORD EH_STANDARD_S4_S3 1 100 0 65535 ECU_ADDRESS 0xFFF82E5A DISPLAY_IDENTIFIER di_obd_iumpr_numerator[120].ZFEH_EepromData /end MEASUREMENT
/begin MEASUREMENT ZFEH_EepromData.di_obd_iumpr_numerator[121] "error code related numerator [0 .. 254-1]" UWORD EH_STANDARD_S4_S3 1 100 0 65535 ECU_ADDRESS 0xFFF82E5C DISPLAY_IDENTIFIER di_obd_iumpr_numerator[121].ZFEH_EepromData /end MEASUREMENT
/begin MEASUREMENT ZFEH_EepromData.di_obd_iumpr_numerator[122] "error code related numerator [0 .. 254-1]" UWORD EH_STANDARD_S4_S3 1 100 0 65535 ECU_ADDRESS 0xFFF82E5E DISPLAY_IDENTIFIER di_obd_iumpr_numerator[122].ZFEH_EepromData /end MEASUREMENT
/begin MEASUREMENT ZFEH_EepromData.di_obd_iumpr_numerator[123] "error code related numerator [0 .. 254-1]" UWORD EH_STANDARD_S4_S3 1 100 0 65535 ECU_ADDRESS 0xFFF82E60 DISPLAY_IDENTIFIER di_obd_iumpr_numerator[123].ZFEH_EepromData /end MEASUREMENT
/begin MEASUREMENT ZFEH_EepromData.di_obd_iumpr_numerator[124] "error code related numerator [0 .. 254-1]" UWORD EH_STANDARD_S4_S3 1 100 0 65535 ECU_ADDRESS 0xFFF82E62 DISPLAY_IDENTIFIER di_obd_iumpr_numerator[124].ZFEH_EepromData /end MEASUREMENT
/begin MEASUREMENT ZFEH_EepromData.di_obd_iumpr_numerator[125] "error code related numerator [0 .. 254-1]" UWORD EH_STANDARD_S4_S3 1 100 0 65535 ECU_ADDRESS 0xFFF82E64 DISPLAY_IDENTIFIER di_obd_iumpr_numerator[125].ZFEH_EepromData /end MEASUREMENT
/begin MEASUREMENT ZFEH_EepromData.di_obd_iumpr_numerator[126] "error code related numerator [0 .. 254-1]" UWORD EH_STANDARD_S4_S3 1 100 0 65535 ECU_ADDRESS 0xFFF82E66 DISPLAY_IDENTIFIER di_obd_iumpr_numerator[126].ZFEH_EepromData /end MEASUREMENT
/begin MEASUREMENT ZFEH_EepromData.di_obd_iumpr_numerator[127] "error code related numerator [0 .. 254-1]" UWORD EH_STANDARD_S4_S3 1 100 0 65535 ECU_ADDRESS 0xFFF82E68 DISPLAY_IDENTIFIER di_obd_iumpr_numerator[127].ZFEH_EepromData /end MEASUREMENT
/begin MEASUREMENT ZFEH_EepromData.di_obd_iumpr_numerator[128] "error code related numerator [0 .. 254-1]" UWORD EH_STANDARD_S4_S3 1 100 0 65535 ECU_ADDRESS 0xFFF82E6A DISPLAY_IDENTIFIER di_obd_iumpr_numerator[128].ZFEH_EepromData /end MEASUREMENT
/begin MEASUREMENT ZFEH_EepromData.di_obd_iumpr_numerator[129] "error code related numerator [0 .. 254-1]" UWORD EH_STANDARD_S4_S3 1 100 0 65535 ECU_ADDRESS 0xFFF82E6C DISPLAY_IDENTIFIER di_obd_iumpr_numerator[129].ZFEH_EepromData /end MEASUREMENT
/begin MEASUREMENT ZFEH_EepromData.di_obd_iumpr_numerator[12] "error code related numerator [0 .. 254-1]" UWORD EH_STANDARD_S4_S3 1 100 0 65535 ECU_ADDRESS 0xFFF82D82 DISPLAY_IDENTIFIER di_obd_iumpr_numerator[12].ZFEH_EepromData /end MEASUREMENT
/begin MEASUREMENT ZFEH_EepromData.di_obd_iumpr_numerator[130] "error code related numerator [0 .. 254-1]" UWORD EH_STANDARD_S4_S3 1 100 0 65535 ECU_ADDRESS 0xFFF82E6E DISPLAY_IDENTIFIER di_obd_iumpr_numerator[130].ZFEH_EepromData /end MEASUREMENT
/begin MEASUREMENT ZFEH_EepromData.di_obd_iumpr_numerator[131] "error code related numerator [0 .. 254-1]" UWORD EH_STANDARD_S4_S3 1 100 0 65535 ECU_ADDRESS 0xFFF82E70 DISPLAY_IDENTIFIER di_obd_iumpr_numerator[131].ZFEH_EepromData /end MEASUREMENT
/begin MEASUREMENT ZFEH_EepromData.di_obd_iumpr_numerator[132] "error code related numerator [0 .. 254-1]" UWORD EH_STANDARD_S4_S3 1 100 0 65535 ECU_ADDRESS 0xFFF82E72 DISPLAY_IDENTIFIER di_obd_iumpr_numerator[132].ZFEH_EepromData /end MEASUREMENT
/begin MEASUREMENT ZFEH_EepromData.di_obd_iumpr_numerator[133] "error code related numerator [0 .. 254-1]" UWORD EH_STANDARD_S4_S3 1 100 0 65535 ECU_ADDRESS 0xFFF82E74 DISPLAY_IDENTIFIER di_obd_iumpr_numerator[133].ZFEH_EepromData /end MEASUREMENT
/begin MEASUREMENT ZFEH_EepromData.di_obd_iumpr_numerator[134] "error code related numerator [0 .. 254-1]" UWORD EH_STANDARD_S4_S3 1 100 0 65535 ECU_ADDRESS 0xFFF82E76 DISPLAY_IDENTIFIER di_obd_iumpr_numerator[134].ZFEH_EepromData /end MEASUREMENT
/begin MEASUREMENT ZFEH_EepromData.di_obd_iumpr_numerator[135] "error code related numerator [0 .. 254-1]" UWORD EH_STANDARD_S4_S3 1 100 0 65535 ECU_ADDRESS 0xFFF82E78 DISPLAY_IDENTIFIER di_obd_iumpr_numerator[135].ZFEH_EepromData /end MEASUREMENT
/begin MEASUREMENT ZFEH_EepromData.di_obd_iumpr_numerator[136] "error code related numerator [0 .. 254-1]" UWORD EH_STANDARD_S4_S3 1 100 0 65535 ECU_ADDRESS 0xFFF82E7A DISPLAY_IDENTIFIER di_obd_iumpr_numerator[136].ZFEH_EepromData /end MEASUREMENT
/begin MEASUREMENT ZFEH_EepromData.di_obd_iumpr_numerator[137] "error code related numerator [0 .. 254-1]" UWORD EH_STANDARD_S4_S3 1 100 0 65535 ECU_ADDRESS 0xFFF82E7C DISPLAY_IDENTIFIER di_obd_iumpr_numerator[137].ZFEH_EepromData /end MEASUREMENT
/begin MEASUREMENT ZFEH_EepromData.di_obd_iumpr_numerator[138] "error code related numerator [0 .. 254-1]" UWORD EH_STANDARD_S4_S3 1 100 0 65535 ECU_ADDRESS 0xFFF82E7E DISPLAY_IDENTIFIER di_obd_iumpr_numerator[138].ZFEH_EepromData /end MEASUREMENT
/begin MEASUREMENT ZFEH_EepromData.di_obd_iumpr_numerator[139] "error code related numerator [0 .. 254-1]" UWORD EH_STANDARD_S4_S3 1 100 0 65535 ECU_ADDRESS 0xFFF82E80 DISPLAY_IDENTIFIER di_obd_iumpr_numerator[139].ZFEH_EepromData /end MEASUREMENT
/begin MEASUREMENT ZFEH_EepromData.di_obd_iumpr_numerator[13] "error code related numerator [0 .. 254-1]" UWORD EH_STANDARD_S4_S3 1 100 0 65535 ECU_ADDRESS 0xFFF82D84 DISPLAY_IDENTIFIER di_obd_iumpr_numerator[13].ZFEH_EepromData /end MEASUREMENT
/begin MEASUREMENT ZFEH_EepromData.di_obd_iumpr_numerator[140] "error code related numerator [0 .. 254-1]" UWORD EH_STANDARD_S4_S3 1 100 0 65535 ECU_ADDRESS 0xFFF82E82 DISPLAY_IDENTIFIER di_obd_iumpr_numerator[140].ZFEH_EepromData /end MEASUREMENT
/begin MEASUREMENT ZFEH_EepromData.di_obd_iumpr_numerator[141] "error code related numerator [0 .. 254-1]" UWORD EH_STANDARD_S4_S3 1 100 0 65535 ECU_ADDRESS 0xFFF82E84 DISPLAY_IDENTIFIER di_obd_iumpr_numerator[141].ZFEH_EepromData /end MEASUREMENT
/begin MEASUREMENT ZFEH_EepromData.di_obd_iumpr_numerator[142] "error code related numerator [0 .. 254-1]" UWORD EH_STANDARD_S4_S3 1 100 0 65535 ECU_ADDRESS 0xFFF82E86 DISPLAY_IDENTIFIER di_obd_iumpr_numerator[142].ZFEH_EepromData /end MEASUREMENT
/begin MEASUREMENT ZFEH_EepromData.di_obd_iumpr_numerator[143] "error code related numerator [0 .. 254-1]" UWORD EH_STANDARD_S4_S3 1 100 0 65535 ECU_ADDRESS 0xFFF82E88 DISPLAY_IDENTIFIER di_obd_iumpr_numerator[143].ZFEH_EepromData /end MEASUREMENT
/begin MEASUREMENT ZFEH_EepromData.di_obd_iumpr_numerator[144] "error code related numerator [0 .. 254-1]" UWORD EH_STANDARD_S4_S3 1 100 0 65535 ECU_ADDRESS 0xFFF82E8A DISPLAY_IDENTIFIER di_obd_iumpr_numerator[144].ZFEH_EepromData /end MEASUREMENT
/begin MEASUREMENT ZFEH_EepromData.di_obd_iumpr_numerator[145] "error code related numerator [0 .. 254-1]" UWORD EH_STANDARD_S4_S3 1 100 0 65535 ECU_ADDRESS 0xFFF82E8C DISPLAY_IDENTIFIER di_obd_iumpr_numerator[145].ZFEH_EepromData /end MEASUREMENT
/begin MEASUREMENT ZFEH_EepromData.di_obd_iumpr_numerator[146] "error code related numerator [0 .. 254-1]" UWORD EH_STANDARD_S4_S3 1 100 0 65535 ECU_ADDRESS 0xFFF82E8E DISPLAY_IDENTIFIER di_obd_iumpr_numerator[146].ZFEH_EepromData /end MEASUREMENT
/begin MEASUREMENT ZFEH_EepromData.di_obd_iumpr_numerator[147] "error code related numerator [0 .. 254-1]" UWORD EH_STANDARD_S4_S3 1 100 0 65535 ECU_ADDRESS 0xFFF82E90 DISPLAY_IDENTIFIER di_obd_iumpr_numerator[147].ZFEH_EepromData /end MEASUREMENT
/begin MEASUREMENT ZFEH_EepromData.di_obd_iumpr_numerator[148] "error code related numerator [0 .. 254-1]" UWORD EH_STANDARD_S4_S3 1 100 0 65535 ECU_ADDRESS 0xFFF82E92 DISPLAY_IDENTIFIER di_obd_iumpr_numerator[148].ZFEH_EepromData /end MEASUREMENT
/begin MEASUREMENT ZFEH_EepromData.di_obd_iumpr_numerator[149] "error code related numerator [0 .. 254-1]" UWORD EH_STANDARD_S4_S3 1 100 0 65535 ECU_ADDRESS 0xFFF82E94 DISPLAY_IDENTIFIER di_obd_iumpr_numerator[149].ZFEH_EepromData /end MEASUREMENT
/begin MEASUREMENT ZFEH_EepromData.di_obd_iumpr_numerator[14] "error code related numerator [0 .. 254-1]" UWORD EH_STANDARD_S4_S3 1 100 0 65535 ECU_ADDRESS 0xFFF82D86 DISPLAY_IDENTIFIER di_obd_iumpr_numerator[14].ZFEH_EepromData /end MEASUREMENT
/begin MEASUREMENT ZFEH_EepromData.di_obd_iumpr_numerator[150] "error code related numerator [0 .. 254-1]" UWORD EH_STANDARD_S4_S3 1 100 0 65535 ECU_ADDRESS 0xFFF82E96 DISPLAY_IDENTIFIER di_obd_iumpr_numerator[150].ZFEH_EepromData /end MEASUREMENT
/begin MEASUREMENT ZFEH_EepromData.di_obd_iumpr_numerator[151] "error code related numerator [0 .. 254-1]" UWORD EH_STANDARD_S4_S3 1 100 0 65535 ECU_ADDRESS 0xFFF82E98 DISPLAY_IDENTIFIER di_obd_iumpr_numerator[151].ZFEH_EepromData /end MEASUREMENT
/begin MEASUREMENT ZFEH_EepromData.di_obd_iumpr_numerator[152] "error code related numerator [0 .. 254-1]" UWORD EH_STANDARD_S4_S3 1 100 0 65535 ECU_ADDRESS 0xFFF82E9A DISPLAY_IDENTIFIER di_obd_iumpr_numerator[152].ZFEH_EepromData /end MEASUREMENT
/begin MEASUREMENT ZFEH_EepromData.di_obd_iumpr_numerator[153] "error code related numerator [0 .. 254-1]" UWORD EH_STANDARD_S4_S3 1 100 0 65535 ECU_ADDRESS 0xFFF82E9C DISPLAY_IDENTIFIER di_obd_iumpr_numerator[153].ZFEH_EepromData /end MEASUREMENT
/begin MEASUREMENT ZFEH_EepromData.di_obd_iumpr_numerator[154] "error code related numerator [0 .. 254-1]" UWORD EH_STANDARD_S4_S3 1 100 0 65535 ECU_ADDRESS 0xFFF82E9E DISPLAY_IDENTIFIER di_obd_iumpr_numerator[154].ZFEH_EepromData /end MEASUREMENT
/begin MEASUREMENT ZFEH_EepromData.di_obd_iumpr_numerator[155] "error code related numerator [0 .. 254-1]" UWORD EH_STANDARD_S4_S3 1 100 0 65535 ECU_ADDRESS 0xFFF82EA0 DISPLAY_IDENTIFIER di_obd_iumpr_numerator[155].ZFEH_EepromData /end MEASUREMENT
/begin MEASUREMENT ZFEH_EepromData.di_obd_iumpr_numerator[156] "error code related numerator [0 .. 254-1]" UWORD EH_STANDARD_S4_S3 1 100 0 65535 ECU_ADDRESS 0xFFF82EA2 DISPLAY_IDENTIFIER di_obd_iumpr_numerator[156].ZFEH_EepromData /end MEASUREMENT
/begin MEASUREMENT ZFEH_EepromData.di_obd_iumpr_numerator[157] "error code related numerator [0 .. 254-1]" UWORD EH_STANDARD_S4_S3 1 100 0 65535 ECU_ADDRESS 0xFFF82EA4 DISPLAY_IDENTIFIER di_obd_iumpr_numerator[157].ZFEH_EepromData /end MEASUREMENT
/begin MEASUREMENT ZFEH_EepromData.di_obd_iumpr_numerator[158] "error code related numerator [0 .. 254-1]" UWORD EH_STANDARD_S4_S3 1 100 0 65535 ECU_ADDRESS 0xFFF82EA6 DISPLAY_IDENTIFIER di_obd_iumpr_numerator[158].ZFEH_EepromData /end MEASUREMENT
/begin MEASUREMENT ZFEH_EepromData.di_obd_iumpr_numerator[159] "error code related numerator [0 .. 254-1]" UWORD EH_STANDARD_S4_S3 1 100 0 65535 ECU_ADDRESS 0xFFF82EA8 DISPLAY_IDENTIFIER di_obd_iumpr_numerator[159].ZFEH_EepromData /end MEASUREMENT
/begin MEASUREMENT ZFEH_EepromData.di_obd_iumpr_numerator[15] "error code related numerator [0 .. 254-1]" UWORD EH_STANDARD_S4_S3 1 100 0 65535 ECU_ADDRESS 0xFFF82D88 DISPLAY_IDENTIFIER di_obd_iumpr_numerator[15].ZFEH_EepromData /end MEASUREMENT
/begin MEASUREMENT ZFEH_EepromData.di_obd_iumpr_numerator[160] "error code related numerator [0 .. 254-1]" UWORD EH_STANDARD_S4_S3 1 100 0 65535 ECU_ADDRESS 0xFFF82EAA DISPLAY_IDENTIFIER di_obd_iumpr_numerator[160].ZFEH_EepromData /end MEASUREMENT
/begin MEASUREMENT ZFEH_EepromData.di_obd_iumpr_numerator[161] "error code related numerator [0 .. 254-1]" UWORD EH_STANDARD_S4_S3 1 100 0 65535 ECU_ADDRESS 0xFFF82EAC DISPLAY_IDENTIFIER di_obd_iumpr_numerator[161].ZFEH_EepromData /end MEASUREMENT
/begin MEASUREMENT ZFEH_EepromData.di_obd_iumpr_numerator[162] "error code related numerator [0 .. 254-1]" UWORD EH_STANDARD_S4_S3 1 100 0 65535 ECU_ADDRESS 0xFFF82EAE DISPLAY_IDENTIFIER di_obd_iumpr_numerator[162].ZFEH_EepromData /end MEASUREMENT
/begin MEASUREMENT ZFEH_EepromData.di_obd_iumpr_numerator[163] "error code related numerator [0 .. 254-1]" UWORD EH_STANDARD_S4_S3 1 100 0 65535 ECU_ADDRESS 0xFFF82EB0 DISPLAY_IDENTIFIER di_obd_iumpr_numerator[163].ZFEH_EepromData /end MEASUREMENT
/begin MEASUREMENT ZFEH_EepromData.di_obd_iumpr_numerator[164] "error code related numerator [0 .. 254-1]" UWORD EH_STANDARD_S4_S3 1 100 0 65535 ECU_ADDRESS 0xFFF82EB2 DISPLAY_IDENTIFIER di_obd_iumpr_numerator[164].ZFEH_EepromData /end MEASUREMENT
/begin MEASUREMENT ZFEH_EepromData.di_obd_iumpr_numerator[165] "error code related numerator [0 .. 254-1]" UWORD EH_STANDARD_S4_S3 1 100 0 65535 ECU_ADDRESS 0xFFF82EB4 DISPLAY_IDENTIFIER di_obd_iumpr_numerator[165].ZFEH_EepromData /end MEASUREMENT
/begin MEASUREMENT ZFEH_EepromData.di_obd_iumpr_numerator[166] "error code related numerator [0 .. 254-1]" UWORD EH_STANDARD_S4_S3 1 100 0 65535 ECU_ADDRESS 0xFFF82EB6 DISPLAY_IDENTIFIER di_obd_iumpr_numerator[166].ZFEH_EepromData /end MEASUREMENT
/begin MEASUREMENT ZFEH_EepromData.di_obd_iumpr_numerator[167] "error code related numerator [0 .. 254-1]" UWORD EH_STANDARD_S4_S3 1 100 0 65535 ECU_ADDRESS 0xFFF82EB8 DISPLAY_IDENTIFIER di_obd_iumpr_numerator[167].ZFEH_EepromData /end MEASUREMENT
/begin MEASUREMENT ZFEH_EepromData.di_obd_iumpr_numerator[168] "error code related numerator [0 .. 254-1]" UWORD EH_STANDARD_S4_S3 1 100 0 65535 ECU_ADDRESS 0xFFF82EBA DISPLAY_IDENTIFIER di_obd_iumpr_numerator[168].ZFEH_EepromData /end MEASUREMENT
/begin MEASUREMENT ZFEH_EepromData.di_obd_iumpr_numerator[169] "error code related numerator [0 .. 254-1]" UWORD EH_STANDARD_S4_S3 1 100 0 65535 ECU_ADDRESS 0xFFF82EBC DISPLAY_IDENTIFIER di_obd_iumpr_numerator[169].ZFEH_EepromData /end MEASUREMENT
/begin MEASUREMENT ZFEH_EepromData.di_obd_iumpr_numerator[16] "error code related numerator [0 .. 254-1]" UWORD EH_STANDARD_S4_S3 1 100 0 65535 ECU_ADDRESS 0xFFF82D8A DISPLAY_IDENTIFIER di_obd_iumpr_numerator[16].ZFEH_EepromData /end MEASUREMENT
/begin MEASUREMENT ZFEH_EepromData.di_obd_iumpr_numerator[170] "error code related numerator [0 .. 254-1]" UWORD EH_STANDARD_S4_S3 1 100 0 65535 ECU_ADDRESS 0xFFF82EBE DISPLAY_IDENTIFIER di_obd_iumpr_numerator[170].ZFEH_EepromData /end MEASUREMENT
/begin MEASUREMENT ZFEH_EepromData.di_obd_iumpr_numerator[171] "error code related numerator [0 .. 254-1]" UWORD EH_STANDARD_S4_S3 1 100 0 65535 ECU_ADDRESS 0xFFF82EC0 DISPLAY_IDENTIFIER di_obd_iumpr_numerator[171].ZFEH_EepromData /end MEASUREMENT
/begin MEASUREMENT ZFEH_EepromData.di_obd_iumpr_numerator[172] "error code related numerator [0 .. 254-1]" UWORD EH_STANDARD_S4_S3 1 100 0 65535 ECU_ADDRESS 0xFFF82EC2 DISPLAY_IDENTIFIER di_obd_iumpr_numerator[172].ZFEH_EepromData /end MEASUREMENT
/begin MEASUREMENT ZFEH_EepromData.di_obd_iumpr_numerator[173] "error code related numerator [0 .. 254-1]" UWORD EH_STANDARD_S4_S3 1 100 0 65535 ECU_ADDRESS 0xFFF82EC4 DISPLAY_IDENTIFIER di_obd_iumpr_numerator[173].ZFEH_EepromData /end MEASUREMENT
/begin MEASUREMENT ZFEH_EepromData.di_obd_iumpr_numerator[174] "error code related numerator [0 .. 254-1]" UWORD EH_STANDARD_S4_S3 1 100 0 65535 ECU_ADDRESS 0xFFF82EC6 DISPLAY_IDENTIFIER di_obd_iumpr_numerator[174].ZFEH_EepromData /end MEASUREMENT
/begin MEASUREMENT ZFEH_EepromData.di_obd_iumpr_numerator[175] "error code related numerator [0 .. 254-1]" UWORD EH_STANDARD_S4_S3 1 100 0 65535 ECU_ADDRESS 0xFFF82EC8 DISPLAY_IDENTIFIER di_obd_iumpr_numerator[175].ZFEH_EepromData /end MEASUREMENT
/begin MEASUREMENT ZFEH_EepromData.di_obd_iumpr_numerator[176] "error code related numerator [0 .. 254-1]" UWORD EH_STANDARD_S4_S3 1 100 0 65535 ECU_ADDRESS 0xFFF82ECA DISPLAY_IDENTIFIER di_obd_iumpr_numerator[176].ZFEH_EepromData /end MEASUREMENT
/begin MEASUREMENT ZFEH_EepromData.di_obd_iumpr_numerator[177] "error code related numerator [0 .. 254-1]" UWORD EH_STANDARD_S4_S3 1 100 0 65535 ECU_ADDRESS 0xFFF82ECC DISPLAY_IDENTIFIER di_obd_iumpr_numerator[177].ZFEH_EepromData /end MEASUREMENT
/begin MEASUREMENT ZFEH_EepromData.di_obd_iumpr_numerator[178] "error code related numerator [0 .. 254-1]" UWORD EH_STANDARD_S4_S3 1 100 0 65535 ECU_ADDRESS 0xFFF82ECE DISPLAY_IDENTIFIER di_obd_iumpr_numerator[178].ZFEH_EepromData /end MEASUREMENT
/begin MEASUREMENT ZFEH_EepromData.di_obd_iumpr_numerator[179] "error code related numerator [0 .. 254-1]" UWORD EH_STANDARD_S4_S3 1 100 0 65535 ECU_ADDRESS 0xFFF82ED0 DISPLAY_IDENTIFIER di_obd_iumpr_numerator[179].ZFEH_EepromData /end MEASUREMENT
/begin MEASUREMENT ZFEH_EepromData.di_obd_iumpr_numerator[17] "error code related numerator [0 .. 254-1]" UWORD EH_STANDARD_S4_S3 1 100 0 65535 ECU_ADDRESS 0xFFF82D8C DISPLAY_IDENTIFIER di_obd_iumpr_numerator[17].ZFEH_EepromData /end MEASUREMENT
/begin MEASUREMENT ZFEH_EepromData.di_obd_iumpr_numerator[180] "error code related numerator [0 .. 254-1]" UWORD EH_STANDARD_S4_S3 1 100 0 65535 ECU_ADDRESS 0xFFF82ED2 DISPLAY_IDENTIFIER di_obd_iumpr_numerator[180].ZFEH_EepromData /end MEASUREMENT
/begin MEASUREMENT ZFEH_EepromData.di_obd_iumpr_numerator[181] "error code related numerator [0 .. 254-1]" UWORD EH_STANDARD_S4_S3 1 100 0 65535 ECU_ADDRESS 0xFFF82ED4 DISPLAY_IDENTIFIER di_obd_iumpr_numerator[181].ZFEH_EepromData /end MEASUREMENT
/begin MEASUREMENT ZFEH_EepromData.di_obd_iumpr_numerator[182] "error code related numerator [0 .. 254-1]" UWORD EH_STANDARD_S4_S3 1 100 0 65535 ECU_ADDRESS 0xFFF82ED6 DISPLAY_IDENTIFIER di_obd_iumpr_numerator[182].ZFEH_EepromData /end MEASUREMENT
/begin MEASUREMENT ZFEH_EepromData.di_obd_iumpr_numerator[183] "error code related numerator [0 .. 254-1]" UWORD EH_STANDARD_S4_S3 1 100 0 65535 ECU_ADDRESS 0xFFF82ED8 DISPLAY_IDENTIFIER di_obd_iumpr_numerator[183].ZFEH_EepromData /end MEASUREMENT
/begin MEASUREMENT ZFEH_EepromData.di_obd_iumpr_numerator[184] "error code related numerator [0 .. 254-1]" UWORD EH_STANDARD_S4_S3 1 100 0 65535 ECU_ADDRESS 0xFFF82EDA DISPLAY_IDENTIFIER di_obd_iumpr_numerator[184].ZFEH_EepromData /end MEASUREMENT
/begin MEASUREMENT ZFEH_EepromData.di_obd_iumpr_numerator[185] "error code related numerator [0 .. 254-1]" UWORD EH_STANDARD_S4_S3 1 100 0 65535 ECU_ADDRESS 0xFFF82EDC DISPLAY_IDENTIFIER di_obd_iumpr_numerator[185].ZFEH_EepromData /end MEASUREMENT
/begin MEASUREMENT ZFEH_EepromData.di_obd_iumpr_numerator[186] "error code related numerator [0 .. 254-1]" UWORD EH_STANDARD_S4_S3 1 100 0 65535 ECU_ADDRESS 0xFFF82EDE DISPLAY_IDENTIFIER di_obd_iumpr_numerator[186].ZFEH_EepromData /end MEASUREMENT
/begin MEASUREMENT ZFEH_EepromData.di_obd_iumpr_numerator[187] "error code related numerator [0 .. 254-1]" UWORD EH_STANDARD_S4_S3 1 100 0 65535 ECU_ADDRESS 0xFFF82EE0 DISPLAY_IDENTIFIER di_obd_iumpr_numerator[187].ZFEH_EepromData /end MEASUREMENT
/begin MEASUREMENT ZFEH_EepromData.di_obd_iumpr_numerator[188] "error code related numerator [0 .. 254-1]" UWORD EH_STANDARD_S4_S3 1 100 0 65535 ECU_ADDRESS 0xFFF82EE2 DISPLAY_IDENTIFIER di_obd_iumpr_numerator[188].ZFEH_EepromData /end MEASUREMENT
/begin MEASUREMENT ZFEH_EepromData.di_obd_iumpr_numerator[189] "error code related numerator [0 .. 254-1]" UWORD EH_STANDARD_S4_S3 1 100 0 65535 ECU_ADDRESS 0xFFF82EE4 DISPLAY_IDENTIFIER di_obd_iumpr_numerator[189].ZFEH_EepromData /end MEASUREMENT
/begin MEASUREMENT ZFEH_EepromData.di_obd_iumpr_numerator[18] "error code related numerator [0 .. 254-1]" UWORD EH_STANDARD_S4_S3 1 100 0 65535 ECU_ADDRESS 0xFFF82D8E DISPLAY_IDENTIFIER di_obd_iumpr_numerator[18].ZFEH_EepromData /end MEASUREMENT
/begin MEASUREMENT ZFEH_EepromData.di_obd_iumpr_numerator[190] "error code related numerator [0 .. 254-1]" UWORD EH_STANDARD_S4_S3 1 100 0 65535 ECU_ADDRESS 0xFFF82EE6 DISPLAY_IDENTIFIER di_obd_iumpr_numerator[190].ZFEH_EepromData /end MEASUREMENT
/begin MEASUREMENT ZFEH_EepromData.di_obd_iumpr_numerator[191] "error code related numerator [0 .. 254-1]" UWORD EH_STANDARD_S4_S3 1 100 0 65535 ECU_ADDRESS 0xFFF82EE8 DISPLAY_IDENTIFIER di_obd_iumpr_numerator[191].ZFEH_EepromData /end MEASUREMENT
/begin MEASUREMENT ZFEH_EepromData.di_obd_iumpr_numerator[192] "error code related numerator [0 .. 254-1]" UWORD EH_STANDARD_S4_S3 1 100 0 65535 ECU_ADDRESS 0xFFF82EEA DISPLAY_IDENTIFIER di_obd_iumpr_numerator[192].ZFEH_EepromData /end MEASUREMENT
/begin MEASUREMENT ZFEH_EepromData.di_obd_iumpr_numerator[193] "error code related numerator [0 .. 254-1]" UWORD EH_STANDARD_S4_S3 1 100 0 65535 ECU_ADDRESS 0xFFF82EEC DISPLAY_IDENTIFIER di_obd_iumpr_numerator[193].ZFEH_EepromData /end MEASUREMENT
/begin MEASUREMENT ZFEH_EepromData.di_obd_iumpr_numerator[194] "error code related numerator [0 .. 254-1]" UWORD EH_STANDARD_S4_S3 1 100 0 65535 ECU_ADDRESS 0xFFF82EEE DISPLAY_IDENTIFIER di_obd_iumpr_numerator[194].ZFEH_EepromData /end MEASUREMENT
/begin MEASUREMENT ZFEH_EepromData.di_obd_iumpr_numerator[195] "error code related numerator [0 .. 254-1]" UWORD EH_STANDARD_S4_S3 1 100 0 65535 ECU_ADDRESS 0xFFF82EF0 DISPLAY_IDENTIFIER di_obd_iumpr_numerator[195].ZFEH_EepromData /end MEASUREMENT
/begin MEASUREMENT ZFEH_EepromData.di_obd_iumpr_numerator[196] "error code related numerator [0 .. 254-1]" UWORD EH_STANDARD_S4_S3 1 100 0 65535 ECU_ADDRESS 0xFFF82EF2 DISPLAY_IDENTIFIER di_obd_iumpr_numerator[196].ZFEH_EepromData /end MEASUREMENT
/begin MEASUREMENT ZFEH_EepromData.di_obd_iumpr_numerator[197] "error code related numerator [0 .. 254-1]" UWORD EH_STANDARD_S4_S3 1 100 0 65535 ECU_ADDRESS 0xFFF82EF4 DISPLAY_IDENTIFIER di_obd_iumpr_numerator[197].ZFEH_EepromData /end MEASUREMENT
/begin MEASUREMENT ZFEH_EepromData.di_obd_iumpr_numerator[198] "error code related numerator [0 .. 254-1]" UWORD EH_STANDARD_S4_S3 1 100 0 65535 ECU_ADDRESS 0xFFF82EF6 DISPLAY_IDENTIFIER di_obd_iumpr_numerator[198].ZFEH_EepromData /end MEASUREMENT
/begin MEASUREMENT ZFEH_EepromData.di_obd_iumpr_numerator[199] "error code related numerator [0 .. 254-1]" UWORD EH_STANDARD_S4_S3 1 100 0 65535 ECU_ADDRESS 0xFFF82EF8 DISPLAY_IDENTIFIER di_obd_iumpr_numerator[199].ZFEH_EepromData /end MEASUREMENT
/begin MEASUREMENT ZFEH_EepromData.di_obd_iumpr_numerator[19] "error code related numerator [0 .. 254-1]" UWORD EH_STANDARD_S4_S3 1 100 0 65535 ECU_ADDRESS 0xFFF82D90 DISPLAY_IDENTIFIER di_obd_iumpr_numerator[19].ZFEH_EepromData /end MEASUREMENT
/begin MEASUREMENT ZFEH_EepromData.di_obd_iumpr_numerator[1] "error code related numerator [0 .. 254-1]" UWORD EH_STANDARD_S4_S3 1 100 0 65535 ECU_ADDRESS 0xFFF82D6C DISPLAY_IDENTIFIER di_obd_iumpr_numerator[1].ZFEH_EepromData /end MEASUREMENT
/begin MEASUREMENT ZFEH_EepromData.di_obd_iumpr_numerator[200] "error code related numerator [0 .. 254-1]" UWORD EH_STANDARD_S4_S3 1 100 0 65535 ECU_ADDRESS 0xFFF82EFA DISPLAY_IDENTIFIER di_obd_iumpr_numerator[200].ZFEH_EepromData /end MEASUREMENT
/begin MEASUREMENT ZFEH_EepromData.di_obd_iumpr_numerator[201] "error code related numerator [0 .. 254-1]" UWORD EH_STANDARD_S4_S3 1 100 0 65535 ECU_ADDRESS 0xFFF82EFC DISPLAY_IDENTIFIER di_obd_iumpr_numerator[201].ZFEH_EepromData /end MEASUREMENT
/begin MEASUREMENT ZFEH_EepromData.di_obd_iumpr_numerator[202] "error code related numerator [0 .. 254-1]" UWORD EH_STANDARD_S4_S3 1 100 0 65535 ECU_ADDRESS 0xFFF82EFE DISPLAY_IDENTIFIER di_obd_iumpr_numerator[202].ZFEH_EepromData /end MEASUREMENT
/begin MEASUREMENT ZFEH_EepromData.di_obd_iumpr_numerator[203] "error code related numerator [0 .. 254-1]" UWORD EH_STANDARD_S4_S3 1 100 0 65535 ECU_ADDRESS 0xFFF82F00 DISPLAY_IDENTIFIER di_obd_iumpr_numerator[203].ZFEH_EepromData /end MEASUREMENT
/begin MEASUREMENT ZFEH_EepromData.di_obd_iumpr_numerator[204] "error code related numerator [0 .. 254-1]" UWORD EH_STANDARD_S4_S3 1 100 0 65535 ECU_ADDRESS 0xFFF82F02 DISPLAY_IDENTIFIER di_obd_iumpr_numerator[204].ZFEH_EepromData /end MEASUREMENT
/begin MEASUREMENT ZFEH_EepromData.di_obd_iumpr_numerator[205] "error code related numerator [0 .. 254-1]" UWORD EH_STANDARD_S4_S3 1 100 0 65535 ECU_ADDRESS 0xFFF82F04 DISPLAY_IDENTIFIER di_obd_iumpr_numerator[205].ZFEH_EepromData /end MEASUREMENT
/begin MEASUREMENT ZFEH_EepromData.di_obd_iumpr_numerator[206] "error code related numerator [0 .. 254-1]" UWORD EH_STANDARD_S4_S3 1 100 0 65535 ECU_ADDRESS 0xFFF82F06 DISPLAY_IDENTIFIER di_obd_iumpr_numerator[206].ZFEH_EepromData /end MEASUREMENT
/begin MEASUREMENT ZFEH_EepromData.di_obd_iumpr_numerator[207] "error code related numerator [0 .. 254-1]" UWORD EH_STANDARD_S4_S3 1 100 0 65535 ECU_ADDRESS 0xFFF82F08 DISPLAY_IDENTIFIER di_obd_iumpr_numerator[207].ZFEH_EepromData /end MEASUREMENT
/begin MEASUREMENT ZFEH_EepromData.di_obd_iumpr_numerator[208] "error code related numerator [0 .. 254-1]" UWORD EH_STANDARD_S4_S3 1 100 0 65535 ECU_ADDRESS 0xFFF82F0A DISPLAY_IDENTIFIER di_obd_iumpr_numerator[208].ZFEH_EepromData /end MEASUREMENT
/begin MEASUREMENT ZFEH_EepromData.di_obd_iumpr_numerator[209] "error code related numerator [0 .. 254-1]" UWORD EH_STANDARD_S4_S3 1 100 0 65535 ECU_ADDRESS 0xFFF82F0C DISPLAY_IDENTIFIER di_obd_iumpr_numerator[209].ZFEH_EepromData /end MEASUREMENT
/begin MEASUREMENT ZFEH_EepromData.di_obd_iumpr_numerator[20] "error code related numerator [0 .. 254-1]" UWORD EH_STANDARD_S4_S3 1 100 0 65535 ECU_ADDRESS 0xFFF82D92 DISPLAY_IDENTIFIER di_obd_iumpr_numerator[20].ZFEH_EepromData /end MEASUREMENT
/begin MEASUREMENT ZFEH_EepromData.di_obd_iumpr_numerator[210] "error code related numerator [0 .. 254-1]" UWORD EH_STANDARD_S4_S3 1 100 0 65535 ECU_ADDRESS 0xFFF82F0E DISPLAY_IDENTIFIER di_obd_iumpr_numerator[210].ZFEH_EepromData /end MEASUREMENT
/begin MEASUREMENT ZFEH_EepromData.di_obd_iumpr_numerator[211] "error code related numerator [0 .. 254-1]" UWORD EH_STANDARD_S4_S3 1 100 0 65535 ECU_ADDRESS 0xFFF82F10 DISPLAY_IDENTIFIER di_obd_iumpr_numerator[211].ZFEH_EepromData /end MEASUREMENT
/begin MEASUREMENT ZFEH_EepromData.di_obd_iumpr_numerator[212] "error code related numerator [0 .. 254-1]" UWORD EH_STANDARD_S4_S3 1 100 0 65535 ECU_ADDRESS 0xFFF82F12 DISPLAY_IDENTIFIER di_obd_iumpr_numerator[212].ZFEH_EepromData /end MEASUREMENT
/begin MEASUREMENT ZFEH_EepromData.di_obd_iumpr_numerator[213] "error code related numerator [0 .. 254-1]" UWORD EH_STANDARD_S4_S3 1 100 0 65535 ECU_ADDRESS 0xFFF82F14 DISPLAY_IDENTIFIER di_obd_iumpr_numerator[213].ZFEH_EepromData /end MEASUREMENT
/begin MEASUREMENT ZFEH_EepromData.di_obd_iumpr_numerator[214] "error code related numerator [0 .. 254-1]" UWORD EH_STANDARD_S4_S3 1 100 0 65535 ECU_ADDRESS 0xFFF82F16 DISPLAY_IDENTIFIER di_obd_iumpr_numerator[214].ZFEH_EepromData /end MEASUREMENT
/begin MEASUREMENT ZFEH_EepromData.di_obd_iumpr_numerator[215] "error code related numerator [0 .. 254-1]" UWORD EH_STANDARD_S4_S3 1 100 0 65535 ECU_ADDRESS 0xFFF82F18 DISPLAY_IDENTIFIER di_obd_iumpr_numerator[215].ZFEH_EepromData /end MEASUREMENT
/begin MEASUREMENT ZFEH_EepromData.di_obd_iumpr_numerator[216] "error code related numerator [0 .. 254-1]" UWORD EH_STANDARD_S4_S3 1 100 0 65535 ECU_ADDRESS 0xFFF82F1A DISPLAY_IDENTIFIER di_obd_iumpr_numerator[216].ZFEH_EepromData /end MEASUREMENT
/begin MEASUREMENT ZFEH_EepromData.di_obd_iumpr_numerator[217] "error code related numerator [0 .. 254-1]" UWORD EH_STANDARD_S4_S3 1 100 0 65535 ECU_ADDRESS 0xFFF82F1C DISPLAY_IDENTIFIER di_obd_iumpr_numerator[217].ZFEH_EepromData /end MEASUREMENT
/begin MEASUREMENT ZFEH_EepromData.di_obd_iumpr_numerator[218] "error code related numerator [0 .. 254-1]" UWORD EH_STANDARD_S4_S3 1 100 0 65535 ECU_ADDRESS 0xFFF82F1E DISPLAY_IDENTIFIER di_obd_iumpr_numerator[218].ZFEH_EepromData /end MEASUREMENT
/begin MEASUREMENT ZFEH_EepromData.di_obd_iumpr_numerator[219] "error code related numerator [0 .. 254-1]" UWORD EH_STANDARD_S4_S3 1 100 0 65535 ECU_ADDRESS 0xFFF82F20 DISPLAY_IDENTIFIER di_obd_iumpr_numerator[219].ZFEH_EepromData /end MEASUREMENT
/begin MEASUREMENT ZFEH_EepromData.di_obd_iumpr_numerator[21] "error code related numerator [0 .. 254-1]" UWORD EH_STANDARD_S4_S3 1 100 0 65535 ECU_ADDRESS 0xFFF82D94 DISPLAY_IDENTIFIER di_obd_iumpr_numerator[21].ZFEH_EepromData /end MEASUREMENT
/begin MEASUREMENT ZFEH_EepromData.di_obd_iumpr_numerator[220] "error code related numerator [0 .. 254-1]" UWORD EH_STANDARD_S4_S3 1 100 0 65535 ECU_ADDRESS 0xFFF82F22 DISPLAY_IDENTIFIER di_obd_iumpr_numerator[220].ZFEH_EepromData /end MEASUREMENT
/begin MEASUREMENT ZFEH_EepromData.di_obd_iumpr_numerator[221] "error code related numerator [0 .. 254-1]" UWORD EH_STANDARD_S4_S3 1 100 0 65535 ECU_ADDRESS 0xFFF82F24 DISPLAY_IDENTIFIER di_obd_iumpr_numerator[221].ZFEH_EepromData /end MEASUREMENT
/begin MEASUREMENT ZFEH_EepromData.di_obd_iumpr_numerator[222] "error code related numerator [0 .. 254-1]" UWORD EH_STANDARD_S4_S3 1 100 0 65535 ECU_ADDRESS 0xFFF82F26 DISPLAY_IDENTIFIER di_obd_iumpr_numerator[222].ZFEH_EepromData /end MEASUREMENT
/begin MEASUREMENT ZFEH_EepromData.di_obd_iumpr_numerator[223] "error code related numerator [0 .. 254-1]" UWORD EH_STANDARD_S4_S3 1 100 0 65535 ECU_ADDRESS 0xFFF82F28 DISPLAY_IDENTIFIER di_obd_iumpr_numerator[223].ZFEH_EepromData /end MEASUREMENT
/begin MEASUREMENT ZFEH_EepromData.di_obd_iumpr_numerator[224] "error code related numerator [0 .. 254-1]" UWORD EH_STANDARD_S4_S3 1 100 0 65535 ECU_ADDRESS 0xFFF82F2A DISPLAY_IDENTIFIER di_obd_iumpr_numerator[224].ZFEH_EepromData /end MEASUREMENT
/begin MEASUREMENT ZFEH_EepromData.di_obd_iumpr_numerator[225] "error code related numerator [0 .. 254-1]" UWORD EH_STANDARD_S4_S3 1 100 0 65535 ECU_ADDRESS 0xFFF82F2C DISPLAY_IDENTIFIER di_obd_iumpr_numerator[225].ZFEH_EepromData /end MEASUREMENT
/begin MEASUREMENT ZFEH_EepromData.di_obd_iumpr_numerator[226] "error code related numerator [0 .. 254-1]" UWORD EH_STANDARD_S4_S3 1 100 0 65535 ECU_ADDRESS 0xFFF82F2E DISPLAY_IDENTIFIER di_obd_iumpr_numerator[226].ZFEH_EepromData /end MEASUREMENT
/begin MEASUREMENT ZFEH_EepromData.di_obd_iumpr_numerator[227] "error code related numerator [0 .. 254-1]" UWORD EH_STANDARD_S4_S3 1 100 0 65535 ECU_ADDRESS 0xFFF82F30 DISPLAY_IDENTIFIER di_obd_iumpr_numerator[227].ZFEH_EepromData /end MEASUREMENT
/begin MEASUREMENT ZFEH_EepromData.di_obd_iumpr_numerator[228] "error code related numerator [0 .. 254-1]" UWORD EH_STANDARD_S4_S3 1 100 0 65535 ECU_ADDRESS 0xFFF82F32 DISPLAY_IDENTIFIER di_obd_iumpr_numerator[228].ZFEH_EepromData /end MEASUREMENT
/begin MEASUREMENT ZFEH_EepromData.di_obd_iumpr_numerator[229] "error code related numerator [0 .. 254-1]" UWORD EH_STANDARD_S4_S3 1 100 0 65535 ECU_ADDRESS 0xFFF82F34 DISPLAY_IDENTIFIER di_obd_iumpr_numerator[229].ZFEH_EepromData /end MEASUREMENT
/begin MEASUREMENT ZFEH_EepromData.di_obd_iumpr_numerator[22] "error code related numerator [0 .. 254-1]" UWORD EH_STANDARD_S4_S3 1 100 0 65535 ECU_ADDRESS 0xFFF82D96 DISPLAY_IDENTIFIER di_obd_iumpr_numerator[22].ZFEH_EepromData /end MEASUREMENT
/begin MEASUREMENT ZFEH_EepromData.di_obd_iumpr_numerator[230] "error code related numerator [0 .. 254-1]" UWORD EH_STANDARD_S4_S3 1 100 0 65535 ECU_ADDRESS 0xFFF82F36 DISPLAY_IDENTIFIER di_obd_iumpr_numerator[230].ZFEH_EepromData /end MEASUREMENT
/begin MEASUREMENT ZFEH_EepromData.di_obd_iumpr_numerator[231] "error code related numerator [0 .. 254-1]" UWORD EH_STANDARD_S4_S3 1 100 0 65535 ECU_ADDRESS 0xFFF82F38 DISPLAY_IDENTIFIER di_obd_iumpr_numerator[231].ZFEH_EepromData /end MEASUREMENT
/begin MEASUREMENT ZFEH_EepromData.di_obd_iumpr_numerator[232] "error code related numerator [0 .. 254-1]" UWORD EH_STANDARD_S4_S3 1 100 0 65535 ECU_ADDRESS 0xFFF82F3A DISPLAY_IDENTIFIER di_obd_iumpr_numerator[232].ZFEH_EepromData /end MEASUREMENT
/begin MEASUREMENT ZFEH_EepromData.di_obd_iumpr_numerator[233] "error code related numerator [0 .. 254-1]" UWORD EH_STANDARD_S4_S3 1 100 0 65535 ECU_ADDRESS 0xFFF82F3C DISPLAY_IDENTIFIER di_obd_iumpr_numerator[233].ZFEH_EepromData /end MEASUREMENT
/begin MEASUREMENT ZFEH_EepromData.di_obd_iumpr_numerator[234] "error code related numerator [0 .. 254-1]" UWORD EH_STANDARD_S4_S3 1 100 0 65535 ECU_ADDRESS 0xFFF82F3E DISPLAY_IDENTIFIER di_obd_iumpr_numerator[234].ZFEH_EepromData /end MEASUREMENT
/begin MEASUREMENT ZFEH_EepromData.di_obd_iumpr_numerator[235] "error code related numerator [0 .. 254-1]" UWORD EH_STANDARD_S4_S3 1 100 0 65535 ECU_ADDRESS 0xFFF82F40 DISPLAY_IDENTIFIER di_obd_iumpr_numerator[235].ZFEH_EepromData /end MEASUREMENT
/begin MEASUREMENT ZFEH_EepromData.di_obd_iumpr_numerator[236] "error code related numerator [0 .. 254-1]" UWORD EH_STANDARD_S4_S3 1 100 0 65535 ECU_ADDRESS 0xFFF82F42 DISPLAY_IDENTIFIER di_obd_iumpr_numerator[236].ZFEH_EepromData /end MEASUREMENT
/begin MEASUREMENT ZFEH_EepromData.di_obd_iumpr_numerator[237] "error code related numerator [0 .. 254-1]" UWORD EH_STANDARD_S4_S3 1 100 0 65535 ECU_ADDRESS 0xFFF82F44 DISPLAY_IDENTIFIER di_obd_iumpr_numerator[237].ZFEH_EepromData /end MEASUREMENT
/begin MEASUREMENT ZFEH_EepromData.di_obd_iumpr_numerator[238] "error code related numerator [0 .. 254-1]" UWORD EH_STANDARD_S4_S3 1 100 0 65535 ECU_ADDRESS 0xFFF82F46 DISPLAY_IDENTIFIER di_obd_iumpr_numerator[238].ZFEH_EepromData /end MEASUREMENT
/begin MEASUREMENT ZFEH_EepromData.di_obd_iumpr_numerator[239] "error code related numerator [0 .. 254-1]" UWORD EH_STANDARD_S4_S3 1 100 0 65535 ECU_ADDRESS 0xFFF82F48 DISPLAY_IDENTIFIER di_obd_iumpr_numerator[239].ZFEH_EepromData /end MEASUREMENT
/begin MEASUREMENT ZFEH_EepromData.di_obd_iumpr_numerator[23] "error code related numerator [0 .. 254-1]" UWORD EH_STANDARD_S4_S3 1 100 0 65535 ECU_ADDRESS 0xFFF82D98 DISPLAY_IDENTIFIER di_obd_iumpr_numerator[23].ZFEH_EepromData /end MEASUREMENT
/begin MEASUREMENT ZFEH_EepromData.di_obd_iumpr_numerator[240] "error code related numerator [0 .. 254-1]" UWORD EH_STANDARD_S4_S3 1 100 0 65535 ECU_ADDRESS 0xFFF82F4A DISPLAY_IDENTIFIER di_obd_iumpr_numerator[240].ZFEH_EepromData /end MEASUREMENT
/begin MEASUREMENT ZFEH_EepromData.di_obd_iumpr_numerator[241] "error code related numerator [0 .. 254-1]" UWORD EH_STANDARD_S4_S3 1 100 0 65535 ECU_ADDRESS 0xFFF82F4C DISPLAY_IDENTIFIER di_obd_iumpr_numerator[241].ZFEH_EepromData /end MEASUREMENT
/begin MEASUREMENT ZFEH_EepromData.di_obd_iumpr_numerator[242] "error code related numerator [0 .. 254-1]" UWORD EH_STANDARD_S4_S3 1 100 0 65535 ECU_ADDRESS 0xFFF82F4E DISPLAY_IDENTIFIER di_obd_iumpr_numerator[242].ZFEH_EepromData /end MEASUREMENT
/begin MEASUREMENT ZFEH_EepromData.di_obd_iumpr_numerator[243] "error code related numerator [0 .. 254-1]" UWORD EH_STANDARD_S4_S3 1 100 0 65535 ECU_ADDRESS 0xFFF82F50 DISPLAY_IDENTIFIER di_obd_iumpr_numerator[243].ZFEH_EepromData /end MEASUREMENT
/begin MEASUREMENT ZFEH_EepromData.di_obd_iumpr_numerator[244] "error code related numerator [0 .. 254-1]" UWORD EH_STANDARD_S4_S3 1 100 0 65535 ECU_ADDRESS 0xFFF82F52 DISPLAY_IDENTIFIER di_obd_iumpr_numerator[244].ZFEH_EepromData /end MEASUREMENT
/begin MEASUREMENT ZFEH_EepromData.di_obd_iumpr_numerator[245] "error code related numerator [0 .. 254-1]" UWORD EH_STANDARD_S4_S3 1 100 0 65535 ECU_ADDRESS 0xFFF82F54 DISPLAY_IDENTIFIER di_obd_iumpr_numerator[245].ZFEH_EepromData /end MEASUREMENT
/begin MEASUREMENT ZFEH_EepromData.di_obd_iumpr_numerator[246] "error code related numerator [0 .. 254-1]" UWORD EH_STANDARD_S4_S3 1 100 0 65535 ECU_ADDRESS 0xFFF82F56 DISPLAY_IDENTIFIER di_obd_iumpr_numerator[246].ZFEH_EepromData /end MEASUREMENT
/begin MEASUREMENT ZFEH_EepromData.di_obd_iumpr_numerator[247] "error code related numerator [0 .. 254-1]" UWORD EH_STANDARD_S4_S3 1 100 0 65535 ECU_ADDRESS 0xFFF82F58 DISPLAY_IDENTIFIER di_obd_iumpr_numerator[247].ZFEH_EepromData /end MEASUREMENT
/begin MEASUREMENT ZFEH_EepromData.di_obd_iumpr_numerator[248] "error code related numerator [0 .. 254-1]" UWORD EH_STANDARD_S4_S3 1 100 0 65535 ECU_ADDRESS 0xFFF82F5A DISPLAY_IDENTIFIER di_obd_iumpr_numerator[248].ZFEH_EepromData /end MEASUREMENT
/begin MEASUREMENT ZFEH_EepromData.di_obd_iumpr_numerator[249] "error code related numerator [0 .. 254-1]" UWORD EH_STANDARD_S4_S3 1 100 0 65535 ECU_ADDRESS 0xFFF82F5C DISPLAY_IDENTIFIER di_obd_iumpr_numerator[249].ZFEH_EepromData /end MEASUREMENT
/begin MEASUREMENT ZFEH_EepromData.di_obd_iumpr_numerator[24] "error code related numerator [0 .. 254-1]" UWORD EH_STANDARD_S4_S3 1 100 0 65535 ECU_ADDRESS 0xFFF82D9A DISPLAY_IDENTIFIER di_obd_iumpr_numerator[24].ZFEH_EepromData /end MEASUREMENT
/begin MEASUREMENT ZFEH_EepromData.di_obd_iumpr_numerator[250] "error code related numerator [0 .. 254-1]" UWORD EH_STANDARD_S4_S3 1 100 0 65535 ECU_ADDRESS 0xFFF82F5E DISPLAY_IDENTIFIER di_obd_iumpr_numerator[250].ZFEH_EepromData /end MEASUREMENT
/begin MEASUREMENT ZFEH_EepromData.di_obd_iumpr_numerator[251] "error code related numerator [0 .. 254-1]" UWORD EH_STANDARD_S4_S3 1 100 0 65535 ECU_ADDRESS 0xFFF82F60 DISPLAY_IDENTIFIER di_obd_iumpr_numerator[251].ZFEH_EepromData /end MEASUREMENT
/begin MEASUREMENT ZFEH_EepromData.di_obd_iumpr_numerator[252] "error code related numerator [0 .. 254-1]" UWORD EH_STANDARD_S4_S3 1 100 0 65535 ECU_ADDRESS 0xFFF82F62 DISPLAY_IDENTIFIER di_obd_iumpr_numerator[252].ZFEH_EepromData /end MEASUREMENT
/begin MEASUREMENT ZFEH_EepromData.di_obd_iumpr_numerator[253] "error code related numerator [0 .. 254-1]" UWORD EH_STANDARD_S4_S3 1 100 0 65535 ECU_ADDRESS 0xFFF82F64 DISPLAY_IDENTIFIER di_obd_iumpr_numerator[253].ZFEH_EepromData /end MEASUREMENT
/begin MEASUREMENT ZFEH_EepromData.di_obd_iumpr_numerator[25] "error code related numerator [0 .. 254-1]" UWORD EH_STANDARD_S4_S3 1 100 0 65535 ECU_ADDRESS 0xFFF82D9C DISPLAY_IDENTIFIER di_obd_iumpr_numerator[25].ZFEH_EepromData /end MEASUREMENT
/begin MEASUREMENT ZFEH_EepromData.di_obd_iumpr_numerator[26] "error code related numerator [0 .. 254-1]" UWORD EH_STANDARD_S4_S3 1 100 0 65535 ECU_ADDRESS 0xFFF82D9E DISPLAY_IDENTIFIER di_obd_iumpr_numerator[26].ZFEH_EepromData /end MEASUREMENT
/begin MEASUREMENT ZFEH_EepromData.di_obd_iumpr_numerator[27] "error code related numerator [0 .. 254-1]" UWORD EH_STANDARD_S4_S3 1 100 0 65535 ECU_ADDRESS 0xFFF82DA0 DISPLAY_IDENTIFIER di_obd_iumpr_numerator[27].ZFEH_EepromData /end MEASUREMENT
/begin MEASUREMENT ZFEH_EepromData.di_obd_iumpr_numerator[28] "error code related numerator [0 .. 254-1]" UWORD EH_STANDARD_S4_S3 1 100 0 65535 ECU_ADDRESS 0xFFF82DA2 DISPLAY_IDENTIFIER di_obd_iumpr_numerator[28].ZFEH_EepromData /end MEASUREMENT
/begin MEASUREMENT ZFEH_EepromData.di_obd_iumpr_numerator[29] "error code related numerator [0 .. 254-1]" UWORD EH_STANDARD_S4_S3 1 100 0 65535 ECU_ADDRESS 0xFFF82DA4 DISPLAY_IDENTIFIER di_obd_iumpr_numerator[29].ZFEH_EepromData /end MEASUREMENT
/begin MEASUREMENT ZFEH_EepromData.di_obd_iumpr_numerator[2] "error code related numerator [0 .. 254-1]" UWORD EH_STANDARD_S4_S3 1 100 0 65535 ECU_ADDRESS 0xFFF82D6E DISPLAY_IDENTIFIER di_obd_iumpr_numerator[2].ZFEH_EepromData /end MEASUREMENT
/begin MEASUREMENT ZFEH_EepromData.di_obd_iumpr_numerator[30] "error code related numerator [0 .. 254-1]" UWORD EH_STANDARD_S4_S3 1 100 0 65535 ECU_ADDRESS 0xFFF82DA6 DISPLAY_IDENTIFIER di_obd_iumpr_numerator[30].ZFEH_EepromData /end MEASUREMENT
/begin MEASUREMENT ZFEH_EepromData.di_obd_iumpr_numerator[31] "error code related numerator [0 .. 254-1]" UWORD EH_STANDARD_S4_S3 1 100 0 65535 ECU_ADDRESS 0xFFF82DA8 DISPLAY_IDENTIFIER di_obd_iumpr_numerator[31].ZFEH_EepromData /end MEASUREMENT
/begin MEASUREMENT ZFEH_EepromData.di_obd_iumpr_numerator[32] "error code related numerator [0 .. 254-1]" UWORD EH_STANDARD_S4_S3 1 100 0 65535 ECU_ADDRESS 0xFFF82DAA DISPLAY_IDENTIFIER di_obd_iumpr_numerator[32].ZFEH_EepromData /end MEASUREMENT
/begin MEASUREMENT ZFEH_EepromData.di_obd_iumpr_numerator[33] "error code related numerator [0 .. 254-1]" UWORD EH_STANDARD_S4_S3 1 100 0 65535 ECU_ADDRESS 0xFFF82DAC DISPLAY_IDENTIFIER di_obd_iumpr_numerator[33].ZFEH_EepromData /end MEASUREMENT
/begin MEASUREMENT ZFEH_EepromData.di_obd_iumpr_numerator[34] "error code related numerator [0 .. 254-1]" UWORD EH_STANDARD_S4_S3 1 100 0 65535 ECU_ADDRESS 0xFFF82DAE DISPLAY_IDENTIFIER di_obd_iumpr_numerator[34].ZFEH_EepromData /end MEASUREMENT
/begin MEASUREMENT ZFEH_EepromData.di_obd_iumpr_numerator[35] "error code related numerator [0 .. 254-1]" UWORD EH_STANDARD_S4_S3 1 100 0 65535 ECU_ADDRESS 0xFFF82DB0 DISPLAY_IDENTIFIER di_obd_iumpr_numerator[35].ZFEH_EepromData /end MEASUREMENT
/begin MEASUREMENT ZFEH_EepromData.di_obd_iumpr_numerator[36] "error code related numerator [0 .. 254-1]" UWORD EH_STANDARD_S4_S3 1 100 0 65535 ECU_ADDRESS 0xFFF82DB2 DISPLAY_IDENTIFIER di_obd_iumpr_numerator[36].ZFEH_EepromData /end MEASUREMENT
/begin MEASUREMENT ZFEH_EepromData.di_obd_iumpr_numerator[37] "error code related numerator [0 .. 254-1]" UWORD EH_STANDARD_S4_S3 1 100 0 65535 ECU_ADDRESS 0xFFF82DB4 DISPLAY_IDENTIFIER di_obd_iumpr_numerator[37].ZFEH_EepromData /end MEASUREMENT
/begin MEASUREMENT ZFEH_EepromData.di_obd_iumpr_numerator[38] "error code related numerator [0 .. 254-1]" UWORD EH_STANDARD_S4_S3 1 100 0 65535 ECU_ADDRESS 0xFFF82DB6 DISPLAY_IDENTIFIER di_obd_iumpr_numerator[38].ZFEH_EepromData /end MEASUREMENT
/begin MEASUREMENT ZFEH_EepromData.di_obd_iumpr_numerator[39] "error code related numerator [0 .. 254-1]" UWORD EH_STANDARD_S4_S3 1 100 0 65535 ECU_ADDRESS 0xFFF82DB8 DISPLAY_IDENTIFIER di_obd_iumpr_numerator[39].ZFEH_EepromData /end MEASUREMENT
/begin MEASUREMENT ZFEH_EepromData.di_obd_iumpr_numerator[3] "error code related numerator [0 .. 254-1]" UWORD EH_STANDARD_S4_S3 1 100 0 65535 ECU_ADDRESS 0xFFF82D70 DISPLAY_IDENTIFIER di_obd_iumpr_numerator[3].ZFEH_EepromData /end MEASUREMENT
/begin MEASUREMENT ZFEH_EepromData.di_obd_iumpr_numerator[40] "error code related numerator [0 .. 254-1]" UWORD EH_STANDARD_S4_S3 1 100 0 65535 ECU_ADDRESS 0xFFF82DBA DISPLAY_IDENTIFIER di_obd_iumpr_numerator[40].ZFEH_EepromData /end MEASUREMENT
/begin MEASUREMENT ZFEH_EepromData.di_obd_iumpr_numerator[41] "error code related numerator [0 .. 254-1]" UWORD EH_STANDARD_S4_S3 1 100 0 65535 ECU_ADDRESS 0xFFF82DBC DISPLAY_IDENTIFIER di_obd_iumpr_numerator[41].ZFEH_EepromData /end MEASUREMENT
/begin MEASUREMENT ZFEH_EepromData.di_obd_iumpr_numerator[42] "error code related numerator [0 .. 254-1]" UWORD EH_STANDARD_S4_S3 1 100 0 65535 ECU_ADDRESS 0xFFF82DBE DISPLAY_IDENTIFIER di_obd_iumpr_numerator[42].ZFEH_EepromData /end MEASUREMENT
/begin MEASUREMENT ZFEH_EepromData.di_obd_iumpr_numerator[43] "error code related numerator [0 .. 254-1]" UWORD EH_STANDARD_S4_S3 1 100 0 65535 ECU_ADDRESS 0xFFF82DC0 DISPLAY_IDENTIFIER di_obd_iumpr_numerator[43].ZFEH_EepromData /end MEASUREMENT
/begin MEASUREMENT ZFEH_EepromData.di_obd_iumpr_numerator[44] "error code related numerator [0 .. 254-1]" UWORD EH_STANDARD_S4_S3 1 100 0 65535 ECU_ADDRESS 0xFFF82DC2 DISPLAY_IDENTIFIER di_obd_iumpr_numerator[44].ZFEH_EepromData /end MEASUREMENT
/begin MEASUREMENT ZFEH_EepromData.di_obd_iumpr_numerator[45] "error code related numerator [0 .. 254-1]" UWORD EH_STANDARD_S4_S3 1 100 0 65535 ECU_ADDRESS 0xFFF82DC4 DISPLAY_IDENTIFIER di_obd_iumpr_numerator[45].ZFEH_EepromData /end MEASUREMENT
/begin MEASUREMENT ZFEH_EepromData.di_obd_iumpr_numerator[46] "error code related numerator [0 .. 254-1]" UWORD EH_STANDARD_S4_S3 1 100 0 65535 ECU_ADDRESS 0xFFF82DC6 DISPLAY_IDENTIFIER di_obd_iumpr_numerator[46].ZFEH_EepromData /end MEASUREMENT
/begin MEASUREMENT ZFEH_EepromData.di_obd_iumpr_numerator[47] "error code related numerator [0 .. 254-1]" UWORD EH_STANDARD_S4_S3 1 100 0 65535 ECU_ADDRESS 0xFFF82DC8 DISPLAY_IDENTIFIER di_obd_iumpr_numerator[47].ZFEH_EepromData /end MEASUREMENT
/begin MEASUREMENT ZFEH_EepromData.di_obd_iumpr_numerator[48] "error code related numerator [0 .. 254-1]" UWORD EH_STANDARD_S4_S3 1 100 0 65535 ECU_ADDRESS 0xFFF82DCA DISPLAY_IDENTIFIER di_obd_iumpr_numerator[48].ZFEH_EepromData /end MEASUREMENT
/begin MEASUREMENT ZFEH_EepromData.di_obd_iumpr_numerator[49] "error code related numerator [0 .. 254-1]" UWORD EH_STANDARD_S4_S3 1 100 0 65535 ECU_ADDRESS 0xFFF82DCC DISPLAY_IDENTIFIER di_obd_iumpr_numerator[49].ZFEH_EepromData /end MEASUREMENT
/begin MEASUREMENT ZFEH_EepromData.di_obd_iumpr_numerator[4] "error code related numerator [0 .. 254-1]" UWORD EH_STANDARD_S4_S3 1 100 0 65535 ECU_ADDRESS 0xFFF82D72 DISPLAY_IDENTIFIER di_obd_iumpr_numerator[4].ZFEH_EepromData /end MEASUREMENT
/begin MEASUREMENT ZFEH_EepromData.di_obd_iumpr_numerator[50] "error code related numerator [0 .. 254-1]" UWORD EH_STANDARD_S4_S3 1 100 0 65535 ECU_ADDRESS 0xFFF82DCE DISPLAY_IDENTIFIER di_obd_iumpr_numerator[50].ZFEH_EepromData /end MEASUREMENT
/begin MEASUREMENT ZFEH_EepromData.di_obd_iumpr_numerator[51] "error code related numerator [0 .. 254-1]" UWORD EH_STANDARD_S4_S3 1 100 0 65535 ECU_ADDRESS 0xFFF82DD0 DISPLAY_IDENTIFIER di_obd_iumpr_numerator[51].ZFEH_EepromData /end MEASUREMENT
/begin MEASUREMENT ZFEH_EepromData.di_obd_iumpr_numerator[52] "error code related numerator [0 .. 254-1]" UWORD EH_STANDARD_S4_S3 1 100 0 65535 ECU_ADDRESS 0xFFF82DD2 DISPLAY_IDENTIFIER di_obd_iumpr_numerator[52].ZFEH_EepromData /end MEASUREMENT
/begin MEASUREMENT ZFEH_EepromData.di_obd_iumpr_numerator[53] "error code related numerator [0 .. 254-1]" UWORD EH_STANDARD_S4_S3 1 100 0 65535 ECU_ADDRESS 0xFFF82DD4 DISPLAY_IDENTIFIER di_obd_iumpr_numerator[53].ZFEH_EepromData /end MEASUREMENT
/begin MEASUREMENT ZFEH_EepromData.di_obd_iumpr_numerator[54] "error code related numerator [0 .. 254-1]" UWORD EH_STANDARD_S4_S3 1 100 0 65535 ECU_ADDRESS 0xFFF82DD6 DISPLAY_IDENTIFIER di_obd_iumpr_numerator[54].ZFEH_EepromData /end MEASUREMENT
/begin MEASUREMENT ZFEH_EepromData.di_obd_iumpr_numerator[55] "error code related numerator [0 .. 254-1]" UWORD EH_STANDARD_S4_S3 1 100 0 65535 ECU_ADDRESS 0xFFF82DD8 DISPLAY_IDENTIFIER di_obd_iumpr_numerator[55].ZFEH_EepromData /end MEASUREMENT
/begin MEASUREMENT ZFEH_EepromData.di_obd_iumpr_numerator[56] "error code related numerator [0 .. 254-1]" UWORD EH_STANDARD_S4_S3 1 100 0 65535 ECU_ADDRESS 0xFFF82DDA DISPLAY_IDENTIFIER di_obd_iumpr_numerator[56].ZFEH_EepromData /end MEASUREMENT
/begin MEASUREMENT ZFEH_EepromData.di_obd_iumpr_numerator[57] "error code related numerator [0 .. 254-1]" UWORD EH_STANDARD_S4_S3 1 100 0 65535 ECU_ADDRESS 0xFFF82DDC DISPLAY_IDENTIFIER di_obd_iumpr_numerator[57].ZFEH_EepromData /end MEASUREMENT
/begin MEASUREMENT ZFEH_EepromData.di_obd_iumpr_numerator[58] "error code related numerator [0 .. 254-1]" UWORD EH_STANDARD_S4_S3 1 100 0 65535 ECU_ADDRESS 0xFFF82DDE DISPLAY_IDENTIFIER di_obd_iumpr_numerator[58].ZFEH_EepromData /end MEASUREMENT
/begin MEASUREMENT ZFEH_EepromData.di_obd_iumpr_numerator[59] "error code related numerator [0 .. 254-1]" UWORD EH_STANDARD_S4_S3 1 100 0 65535 ECU_ADDRESS 0xFFF82DE0 DISPLAY_IDENTIFIER di_obd_iumpr_numerator[59].ZFEH_EepromData /end MEASUREMENT
/begin MEASUREMENT ZFEH_EepromData.di_obd_iumpr_numerator[5] "error code related numerator [0 .. 254-1]" UWORD EH_STANDARD_S4_S3 1 100 0 65535 ECU_ADDRESS 0xFFF82D74 DISPLAY_IDENTIFIER di_obd_iumpr_numerator[5].ZFEH_EepromData /end MEASUREMENT
/begin MEASUREMENT ZFEH_EepromData.di_obd_iumpr_numerator[60] "error code related numerator [0 .. 254-1]" UWORD EH_STANDARD_S4_S3 1 100 0 65535 ECU_ADDRESS 0xFFF82DE2 DISPLAY_IDENTIFIER di_obd_iumpr_numerator[60].ZFEH_EepromData /end MEASUREMENT
/begin MEASUREMENT ZFEH_EepromData.di_obd_iumpr_numerator[61] "error code related numerator [0 .. 254-1]" UWORD EH_STANDARD_S4_S3 1 100 0 65535 ECU_ADDRESS 0xFFF82DE4 DISPLAY_IDENTIFIER di_obd_iumpr_numerator[61].ZFEH_EepromData /end MEASUREMENT
/begin MEASUREMENT ZFEH_EepromData.di_obd_iumpr_numerator[62] "error code related numerator [0 .. 254-1]" UWORD EH_STANDARD_S4_S3 1 100 0 65535 ECU_ADDRESS 0xFFF82DE6 DISPLAY_IDENTIFIER di_obd_iumpr_numerator[62].ZFEH_EepromData /end MEASUREMENT
/begin MEASUREMENT ZFEH_EepromData.di_obd_iumpr_numerator[63] "error code related numerator [0 .. 254-1]" UWORD EH_STANDARD_S4_S3 1 100 0 65535 ECU_ADDRESS 0xFFF82DE8 DISPLAY_IDENTIFIER di_obd_iumpr_numerator[63].ZFEH_EepromData /end MEASUREMENT
/begin MEASUREMENT ZFEH_EepromData.di_obd_iumpr_numerator[64] "error code related numerator [0 .. 254-1]" UWORD EH_STANDARD_S4_S3 1 100 0 65535 ECU_ADDRESS 0xFFF82DEA DISPLAY_IDENTIFIER di_obd_iumpr_numerator[64].ZFEH_EepromData /end MEASUREMENT
/begin MEASUREMENT ZFEH_EepromData.di_obd_iumpr_numerator[65] "error code related numerator [0 .. 254-1]" UWORD EH_STANDARD_S4_S3 1 100 0 65535 ECU_ADDRESS 0xFFF82DEC DISPLAY_IDENTIFIER di_obd_iumpr_numerator[65].ZFEH_EepromData /end MEASUREMENT
/begin MEASUREMENT ZFEH_EepromData.di_obd_iumpr_numerator[66] "error code related numerator [0 .. 254-1]" UWORD EH_STANDARD_S4_S3 1 100 0 65535 ECU_ADDRESS 0xFFF82DEE DISPLAY_IDENTIFIER di_obd_iumpr_numerator[66].ZFEH_EepromData /end MEASUREMENT
/begin MEASUREMENT ZFEH_EepromData.di_obd_iumpr_numerator[67] "error code related numerator [0 .. 254-1]" UWORD EH_STANDARD_S4_S3 1 100 0 65535 ECU_ADDRESS 0xFFF82DF0 DISPLAY_IDENTIFIER di_obd_iumpr_numerator[67].ZFEH_EepromData /end MEASUREMENT
/begin MEASUREMENT ZFEH_EepromData.di_obd_iumpr_numerator[68] "error code related numerator [0 .. 254-1]" UWORD EH_STANDARD_S4_S3 1 100 0 65535 ECU_ADDRESS 0xFFF82DF2 DISPLAY_IDENTIFIER di_obd_iumpr_numerator[68].ZFEH_EepromData /end MEASUREMENT
/begin MEASUREMENT ZFEH_EepromData.di_obd_iumpr_numerator[69] "error code related numerator [0 .. 254-1]" UWORD EH_STANDARD_S4_S3 1 100 0 65535 ECU_ADDRESS 0xFFF82DF4 DISPLAY_IDENTIFIER di_obd_iumpr_numerator[69].ZFEH_EepromData /end MEASUREMENT
/begin MEASUREMENT ZFEH_EepromData.di_obd_iumpr_numerator[6] "error code related numerator [0 .. 254-1]" UWORD EH_STANDARD_S4_S3 1 100 0 65535 ECU_ADDRESS 0xFFF82D76 DISPLAY_IDENTIFIER di_obd_iumpr_numerator[6].ZFEH_EepromData /end MEASUREMENT
/begin MEASUREMENT ZFEH_EepromData.di_obd_iumpr_numerator[70] "error code related numerator [0 .. 254-1]" UWORD EH_STANDARD_S4_S3 1 100 0 65535 ECU_ADDRESS 0xFFF82DF6 DISPLAY_IDENTIFIER di_obd_iumpr_numerator[70].ZFEH_EepromData /end MEASUREMENT
/begin MEASUREMENT ZFEH_EepromData.di_obd_iumpr_numerator[71] "error code related numerator [0 .. 254-1]" UWORD EH_STANDARD_S4_S3 1 100 0 65535 ECU_ADDRESS 0xFFF82DF8 DISPLAY_IDENTIFIER di_obd_iumpr_numerator[71].ZFEH_EepromData /end MEASUREMENT
/begin MEASUREMENT ZFEH_EepromData.di_obd_iumpr_numerator[72] "error code related numerator [0 .. 254-1]" UWORD EH_STANDARD_S4_S3 1 100 0 65535 ECU_ADDRESS 0xFFF82DFA DISPLAY_IDENTIFIER di_obd_iumpr_numerator[72].ZFEH_EepromData /end MEASUREMENT
/begin MEASUREMENT ZFEH_EepromData.di_obd_iumpr_numerator[73] "error code related numerator [0 .. 254-1]" UWORD EH_STANDARD_S4_S3 1 100 0 65535 ECU_ADDRESS 0xFFF82DFC DISPLAY_IDENTIFIER di_obd_iumpr_numerator[73].ZFEH_EepromData /end MEASUREMENT
/begin MEASUREMENT ZFEH_EepromData.di_obd_iumpr_numerator[74] "error code related numerator [0 .. 254-1]" UWORD EH_STANDARD_S4_S3 1 100 0 65535 ECU_ADDRESS 0xFFF82DFE DISPLAY_IDENTIFIER di_obd_iumpr_numerator[74].ZFEH_EepromData /end MEASUREMENT
/begin MEASUREMENT ZFEH_EepromData.di_obd_iumpr_numerator[75] "error code related numerator [0 .. 254-1]" UWORD EH_STANDARD_S4_S3 1 100 0 65535 ECU_ADDRESS 0xFFF82E00 DISPLAY_IDENTIFIER di_obd_iumpr_numerator[75].ZFEH_EepromData /end MEASUREMENT
/begin MEASUREMENT ZFEH_EepromData.di_obd_iumpr_numerator[76] "error code related numerator [0 .. 254-1]" UWORD EH_STANDARD_S4_S3 1 100 0 65535 ECU_ADDRESS 0xFFF82E02 DISPLAY_IDENTIFIER di_obd_iumpr_numerator[76].ZFEH_EepromData /end MEASUREMENT
/begin MEASUREMENT ZFEH_EepromData.di_obd_iumpr_numerator[77] "error code related numerator [0 .. 254-1]" UWORD EH_STANDARD_S4_S3 1 100 0 65535 ECU_ADDRESS 0xFFF82E04 DISPLAY_IDENTIFIER di_obd_iumpr_numerator[77].ZFEH_EepromData /end MEASUREMENT
/begin MEASUREMENT ZFEH_EepromData.di_obd_iumpr_numerator[78] "error code related numerator [0 .. 254-1]" UWORD EH_STANDARD_S4_S3 1 100 0 65535 ECU_ADDRESS 0xFFF82E06 DISPLAY_IDENTIFIER di_obd_iumpr_numerator[78].ZFEH_EepromData /end MEASUREMENT
/begin MEASUREMENT ZFEH_EepromData.di_obd_iumpr_numerator[79] "error code related numerator [0 .. 254-1]" UWORD EH_STANDARD_S4_S3 1 100 0 65535 ECU_ADDRESS 0xFFF82E08 DISPLAY_IDENTIFIER di_obd_iumpr_numerator[79].ZFEH_EepromData /end MEASUREMENT
/begin MEASUREMENT ZFEH_EepromData.di_obd_iumpr_numerator[7] "error code related numerator [0 .. 254-1]" UWORD EH_STANDARD_S4_S3 1 100 0 65535 ECU_ADDRESS 0xFFF82D78 DISPLAY_IDENTIFIER di_obd_iumpr_numerator[7].ZFEH_EepromData /end MEASUREMENT
/begin MEASUREMENT ZFEH_EepromData.di_obd_iumpr_numerator[80] "error code related numerator [0 .. 254-1]" UWORD EH_STANDARD_S4_S3 1 100 0 65535 ECU_ADDRESS 0xFFF82E0A DISPLAY_IDENTIFIER di_obd_iumpr_numerator[80].ZFEH_EepromData /end MEASUREMENT
/begin MEASUREMENT ZFEH_EepromData.di_obd_iumpr_numerator[81] "error code related numerator [0 .. 254-1]" UWORD EH_STANDARD_S4_S3 1 100 0 65535 ECU_ADDRESS 0xFFF82E0C DISPLAY_IDENTIFIER di_obd_iumpr_numerator[81].ZFEH_EepromData /end MEASUREMENT
/begin MEASUREMENT ZFEH_EepromData.di_obd_iumpr_numerator[82] "error code related numerator [0 .. 254-1]" UWORD EH_STANDARD_S4_S3 1 100 0 65535 ECU_ADDRESS 0xFFF82E0E DISPLAY_IDENTIFIER di_obd_iumpr_numerator[82].ZFEH_EepromData /end MEASUREMENT
/begin MEASUREMENT ZFEH_EepromData.di_obd_iumpr_numerator[83] "error code related numerator [0 .. 254-1]" UWORD EH_STANDARD_S4_S3 1 100 0 65535 ECU_ADDRESS 0xFFF82E10 DISPLAY_IDENTIFIER di_obd_iumpr_numerator[83].ZFEH_EepromData /end MEASUREMENT
/begin MEASUREMENT ZFEH_EepromData.di_obd_iumpr_numerator[84] "error code related numerator [0 .. 254-1]" UWORD EH_STANDARD_S4_S3 1 100 0 65535 ECU_ADDRESS 0xFFF82E12 DISPLAY_IDENTIFIER di_obd_iumpr_numerator[84].ZFEH_EepromData /end MEASUREMENT
/begin MEASUREMENT ZFEH_EepromData.di_obd_iumpr_numerator[85] "error code related numerator [0 .. 254-1]" UWORD EH_STANDARD_S4_S3 1 100 0 65535 ECU_ADDRESS 0xFFF82E14 DISPLAY_IDENTIFIER di_obd_iumpr_numerator[85].ZFEH_EepromData /end MEASUREMENT
/begin MEASUREMENT ZFEH_EepromData.di_obd_iumpr_numerator[86] "error code related numerator [0 .. 254-1]" UWORD EH_STANDARD_S4_S3 1 100 0 65535 ECU_ADDRESS 0xFFF82E16 DISPLAY_IDENTIFIER di_obd_iumpr_numerator[86].ZFEH_EepromData /end MEASUREMENT
/begin MEASUREMENT ZFEH_EepromData.di_obd_iumpr_numerator[87] "error code related numerator [0 .. 254-1]" UWORD EH_STANDARD_S4_S3 1 100 0 65535 ECU_ADDRESS 0xFFF82E18 DISPLAY_IDENTIFIER di_obd_iumpr_numerator[87].ZFEH_EepromData /end MEASUREMENT
/begin MEASUREMENT ZFEH_EepromData.di_obd_iumpr_numerator[88] "error code related numerator [0 .. 254-1]" UWORD EH_STANDARD_S4_S3 1 100 0 65535 ECU_ADDRESS 0xFFF82E1A DISPLAY_IDENTIFIER di_obd_iumpr_numerator[88].ZFEH_EepromData /end MEASUREMENT
/begin MEASUREMENT ZFEH_EepromData.di_obd_iumpr_numerator[89] "error code related numerator [0 .. 254-1]" UWORD EH_STANDARD_S4_S3 1 100 0 65535 ECU_ADDRESS 0xFFF82E1C DISPLAY_IDENTIFIER di_obd_iumpr_numerator[89].ZFEH_EepromData /end MEASUREMENT
/begin MEASUREMENT ZFEH_EepromData.di_obd_iumpr_numerator[8] "error code related numerator [0 .. 254-1]" UWORD EH_STANDARD_S4_S3 1 100 0 65535 ECU_ADDRESS 0xFFF82D7A DISPLAY_IDENTIFIER di_obd_iumpr_numerator[8].ZFEH_EepromData /end MEASUREMENT
/begin MEASUREMENT ZFEH_EepromData.di_obd_iumpr_numerator[90] "error code related numerator [0 .. 254-1]" UWORD EH_STANDARD_S4_S3 1 100 0 65535 ECU_ADDRESS 0xFFF82E1E DISPLAY_IDENTIFIER di_obd_iumpr_numerator[90].ZFEH_EepromData /end MEASUREMENT
/begin MEASUREMENT ZFEH_EepromData.di_obd_iumpr_numerator[91] "error code related numerator [0 .. 254-1]" UWORD EH_STANDARD_S4_S3 1 100 0 65535 ECU_ADDRESS 0xFFF82E20 DISPLAY_IDENTIFIER di_obd_iumpr_numerator[91].ZFEH_EepromData /end MEASUREMENT
/begin MEASUREMENT ZFEH_EepromData.di_obd_iumpr_numerator[92] "error code related numerator [0 .. 254-1]" UWORD EH_STANDARD_S4_S3 1 100 0 65535 ECU_ADDRESS 0xFFF82E22 DISPLAY_IDENTIFIER di_obd_iumpr_numerator[92].ZFEH_EepromData /end MEASUREMENT
/begin MEASUREMENT ZFEH_EepromData.di_obd_iumpr_numerator[93] "error code related numerator [0 .. 254-1]" UWORD EH_STANDARD_S4_S3 1 100 0 65535 ECU_ADDRESS 0xFFF82E24 DISPLAY_IDENTIFIER di_obd_iumpr_numerator[93].ZFEH_EepromData /end MEASUREMENT
/begin MEASUREMENT ZFEH_EepromData.di_obd_iumpr_numerator[94] "error code related numerator [0 .. 254-1]" UWORD EH_STANDARD_S4_S3 1 100 0 65535 ECU_ADDRESS 0xFFF82E26 DISPLAY_IDENTIFIER di_obd_iumpr_numerator[94].ZFEH_EepromData /end MEASUREMENT
/begin MEASUREMENT ZFEH_EepromData.di_obd_iumpr_numerator[95] "error code related numerator [0 .. 254-1]" UWORD EH_STANDARD_S4_S3 1 100 0 65535 ECU_ADDRESS 0xFFF82E28 DISPLAY_IDENTIFIER di_obd_iumpr_numerator[95].ZFEH_EepromData /end MEASUREMENT
/begin MEASUREMENT ZFEH_EepromData.di_obd_iumpr_numerator[96] "error code related numerator [0 .. 254-1]" UWORD EH_STANDARD_S4_S3 1 100 0 65535 ECU_ADDRESS 0xFFF82E2A DISPLAY_IDENTIFIER di_obd_iumpr_numerator[96].ZFEH_EepromData /end MEASUREMENT
/begin MEASUREMENT ZFEH_EepromData.di_obd_iumpr_numerator[97] "error code related numerator [0 .. 254-1]" UWORD EH_STANDARD_S4_S3 1 100 0 65535 ECU_ADDRESS 0xFFF82E2C DISPLAY_IDENTIFIER di_obd_iumpr_numerator[97].ZFEH_EepromData /end MEASUREMENT
/begin MEASUREMENT ZFEH_EepromData.di_obd_iumpr_numerator[98] "error code related numerator [0 .. 254-1]" UWORD EH_STANDARD_S4_S3 1 100 0 65535 ECU_ADDRESS 0xFFF82E2E DISPLAY_IDENTIFIER di_obd_iumpr_numerator[98].ZFEH_EepromData /end MEASUREMENT
/begin MEASUREMENT ZFEH_EepromData.di_obd_iumpr_numerator[99] "error code related numerator [0 .. 254-1]" UWORD EH_STANDARD_S4_S3 1 100 0 65535 ECU_ADDRESS 0xFFF82E30 DISPLAY_IDENTIFIER di_obd_iumpr_numerator[99].ZFEH_EepromData /end MEASUREMENT
/begin MEASUREMENT ZFEH_EepromData.di_obd_iumpr_numerator[9] "error code related numerator [0 .. 254-1]" UWORD EH_STANDARD_S4_S3 1 100 0 65535 ECU_ADDRESS 0xFFF82D7C DISPLAY_IDENTIFIER di_obd_iumpr_numerator[9].ZFEH_EepromData /end MEASUREMENT
/begin MEASUREMENT ZFEH_EepromData.di_obd_readiness[0] "general readiness information of the errors (bitcoded) [0 .. 16-1]" UWORD EH_STANDARD_S4_S3 1 100 0 65535 ECU_ADDRESS 0xFFF82CB0 DISPLAY_IDENTIFIER di_obd_readiness[0].ZFEH_EepromData /end MEASUREMENT
/begin MEASUREMENT ZFEH_EepromData.di_obd_readiness[10] "general readiness information of the errors (bitcoded) [0 .. 16-1]" UWORD EH_STANDARD_S4_S3 1 100 0 65535 ECU_ADDRESS 0xFFF82CC4 DISPLAY_IDENTIFIER di_obd_readiness[10].ZFEH_EepromData /end MEASUREMENT
/begin MEASUREMENT ZFEH_EepromData.di_obd_readiness[11] "general readiness information of the errors (bitcoded) [0 .. 16-1]" UWORD EH_STANDARD_S4_S3 1 100 0 65535 ECU_ADDRESS 0xFFF82CC6 DISPLAY_IDENTIFIER di_obd_readiness[11].ZFEH_EepromData /end MEASUREMENT
/begin MEASUREMENT ZFEH_EepromData.di_obd_readiness[12] "general readiness information of the errors (bitcoded) [0 .. 16-1]" UWORD EH_STANDARD_S4_S3 1 100 0 65535 ECU_ADDRESS 0xFFF82CC8 DISPLAY_IDENTIFIER di_obd_readiness[12].ZFEH_EepromData /end MEASUREMENT
/begin MEASUREMENT ZFEH_EepromData.di_obd_readiness[13] "general readiness information of the errors (bitcoded) [0 .. 16-1]" UWORD EH_STANDARD_S4_S3 1 100 0 65535 ECU_ADDRESS 0xFFF82CCA DISPLAY_IDENTIFIER di_obd_readiness[13].ZFEH_EepromData /end MEASUREMENT
/begin MEASUREMENT ZFEH_EepromData.di_obd_readiness[14] "general readiness information of the errors (bitcoded) [0 .. 16-1]" UWORD EH_STANDARD_S4_S3 1 100 0 65535 ECU_ADDRESS 0xFFF82CCC DISPLAY_IDENTIFIER di_obd_readiness[14].ZFEH_EepromData /end MEASUREMENT
/begin MEASUREMENT ZFEH_EepromData.di_obd_readiness[15] "general readiness information of the errors (bitcoded) [0 .. 16-1]" UWORD EH_STANDARD_S4_S3 1 100 0 65535 ECU_ADDRESS 0xFFF82CCE DISPLAY_IDENTIFIER di_obd_readiness[15].ZFEH_EepromData /end MEASUREMENT
/begin MEASUREMENT ZFEH_EepromData.di_obd_readiness[1] "general readiness information of the errors (bitcoded) [0 .. 16-1]" UWORD EH_STANDARD_S4_S3 1 100 0 65535 ECU_ADDRESS 0xFFF82CB2 DISPLAY_IDENTIFIER di_obd_readiness[1].ZFEH_EepromData /end MEASUREMENT
/begin MEASUREMENT ZFEH_EepromData.di_obd_readiness[2] "general readiness information of the errors (bitcoded) [0 .. 16-1]" UWORD EH_STANDARD_S4_S3 1 100 0 65535 ECU_ADDRESS 0xFFF82CB4 DISPLAY_IDENTIFIER di_obd_readiness[2].ZFEH_EepromData /end MEASUREMENT
/begin MEASUREMENT ZFEH_EepromData.di_obd_readiness[3] "general readiness information of the errors (bitcoded) [0 .. 16-1]" UWORD EH_STANDARD_S4_S3 1 100 0 65535 ECU_ADDRESS 0xFFF82CB6 DISPLAY_IDENTIFIER di_obd_readiness[3].ZFEH_EepromData /end MEASUREMENT
/begin MEASUREMENT ZFEH_EepromData.di_obd_readiness[4] "general readiness information of the errors (bitcoded) [0 .. 16-1]" UWORD EH_STANDARD_S4_S3 1 100 0 65535 ECU_ADDRESS 0xFFF82CB8 DISPLAY_IDENTIFIER di_obd_readiness[4].ZFEH_EepromData /end MEASUREMENT
/begin MEASUREMENT ZFEH_EepromData.di_obd_readiness[5] "general readiness information of the errors (bitcoded) [0 .. 16-1]" UWORD EH_STANDARD_S4_S3 1 100 0 65535 ECU_ADDRESS 0xFFF82CBA DISPLAY_IDENTIFIER di_obd_readiness[5].ZFEH_EepromData /end MEASUREMENT
/begin MEASUREMENT ZFEH_EepromData.di_obd_readiness[6] "general readiness information of the errors (bitcoded) [0 .. 16-1]" UWORD EH_STANDARD_S4_S3 1 100 0 65535 ECU_ADDRESS 0xFFF82CBC DISPLAY_IDENTIFIER di_obd_readiness[6].ZFEH_EepromData /end MEASUREMENT
/begin MEASUREMENT ZFEH_EepromData.di_obd_readiness[7] "general readiness information of the errors (bitcoded) [0 .. 16-1]" UWORD EH_STANDARD_S4_S3 1 100 0 65535 ECU_ADDRESS 0xFFF82CBE DISPLAY_IDENTIFIER di_obd_readiness[7].ZFEH_EepromData /end MEASUREMENT
/begin MEASUREMENT ZFEH_EepromData.di_obd_readiness[8] "general readiness information of the errors (bitcoded) [0 .. 16-1]" UWORD EH_STANDARD_S4_S3 1 100 0 65535 ECU_ADDRESS 0xFFF82CC0 DISPLAY_IDENTIFIER di_obd_readiness[8].ZFEH_EepromData /end MEASUREMENT
/begin MEASUREMENT ZFEH_EepromData.di_obd_readiness[9] "general readiness information of the errors (bitcoded) [0 .. 16-1]" UWORD EH_STANDARD_S4_S3 1 100 0 65535 ECU_ADDRESS 0xFFF82CC2 DISPLAY_IDENTIFIER di_obd_readiness[9].ZFEH_EepromData /end MEASUREMENT
/begin MEASUREMENT ZFEH_EepromData.di_roe_new_entries_sent[0] "information of already sent RoE information (bitcoded) [0 .. 16-1]" UWORD EH_STANDARD_S4_S3 1 100 0 65535 ECU_ADDRESS 0xFFF8341E DISPLAY_IDENTIFIER di_roe_new_entries_sent[0].ZFEH_EepromData /end MEASUREMENT
/begin MEASUREMENT ZFEH_EepromData.di_roe_new_entries_sent[10] "information of already sent RoE information (bitcoded) [0 .. 16-1]" UWORD EH_STANDARD_S4_S3 1 100 0 65535 ECU_ADDRESS 0xFFF83432 DISPLAY_IDENTIFIER di_roe_new_entries_sent[10].ZFEH_EepromData /end MEASUREMENT
/begin MEASUREMENT ZFEH_EepromData.di_roe_new_entries_sent[11] "information of already sent RoE information (bitcoded) [0 .. 16-1]" UWORD EH_STANDARD_S4_S3 1 100 0 65535 ECU_ADDRESS 0xFFF83434 DISPLAY_IDENTIFIER di_roe_new_entries_sent[11].ZFEH_EepromData /end MEASUREMENT
/begin MEASUREMENT ZFEH_EepromData.di_roe_new_entries_sent[12] "information of already sent RoE information (bitcoded) [0 .. 16-1]" UWORD EH_STANDARD_S4_S3 1 100 0 65535 ECU_ADDRESS 0xFFF83436 DISPLAY_IDENTIFIER di_roe_new_entries_sent[12].ZFEH_EepromData /end MEASUREMENT
/begin MEASUREMENT ZFEH_EepromData.di_roe_new_entries_sent[13] "information of already sent RoE information (bitcoded) [0 .. 16-1]" UWORD EH_STANDARD_S4_S3 1 100 0 65535 ECU_ADDRESS 0xFFF83438 DISPLAY_IDENTIFIER di_roe_new_entries_sent[13].ZFEH_EepromData /end MEASUREMENT
/begin MEASUREMENT ZFEH_EepromData.di_roe_new_entries_sent[14] "information of already sent RoE information (bitcoded) [0 .. 16-1]" UWORD EH_STANDARD_S4_S3 1 100 0 65535 ECU_ADDRESS 0xFFF8343A DISPLAY_IDENTIFIER di_roe_new_entries_sent[14].ZFEH_EepromData /end MEASUREMENT
/begin MEASUREMENT ZFEH_EepromData.di_roe_new_entries_sent[15] "information of already sent RoE information (bitcoded) [0 .. 16-1]" UWORD EH_STANDARD_S4_S3 1 100 0 65535 ECU_ADDRESS 0xFFF8343C DISPLAY_IDENTIFIER di_roe_new_entries_sent[15].ZFEH_EepromData /end MEASUREMENT
/begin MEASUREMENT ZFEH_EepromData.di_roe_new_entries_sent[1] "information of already sent RoE information (bitcoded) [0 .. 16-1]" UWORD EH_STANDARD_S4_S3 1 100 0 65535 ECU_ADDRESS 0xFFF83420 DISPLAY_IDENTIFIER di_roe_new_entries_sent[1].ZFEH_EepromData /end MEASUREMENT
/begin MEASUREMENT ZFEH_EepromData.di_roe_new_entries_sent[2] "information of already sent RoE information (bitcoded) [0 .. 16-1]" UWORD EH_STANDARD_S4_S3 1 100 0 65535 ECU_ADDRESS 0xFFF83422 DISPLAY_IDENTIFIER di_roe_new_entries_sent[2].ZFEH_EepromData /end MEASUREMENT
/begin MEASUREMENT ZFEH_EepromData.di_roe_new_entries_sent[3] "information of already sent RoE information (bitcoded) [0 .. 16-1]" UWORD EH_STANDARD_S4_S3 1 100 0 65535 ECU_ADDRESS 0xFFF83424 DISPLAY_IDENTIFIER di_roe_new_entries_sent[3].ZFEH_EepromData /end MEASUREMENT
/begin MEASUREMENT ZFEH_EepromData.di_roe_new_entries_sent[4] "information of already sent RoE information (bitcoded) [0 .. 16-1]" UWORD EH_STANDARD_S4_S3 1 100 0 65535 ECU_ADDRESS 0xFFF83426 DISPLAY_IDENTIFIER di_roe_new_entries_sent[4].ZFEH_EepromData /end MEASUREMENT
/begin MEASUREMENT ZFEH_EepromData.di_roe_new_entries_sent[5] "information of already sent RoE information (bitcoded) [0 .. 16-1]" UWORD EH_STANDARD_S4_S3 1 100 0 65535 ECU_ADDRESS 0xFFF83428 DISPLAY_IDENTIFIER di_roe_new_entries_sent[5].ZFEH_EepromData /end MEASUREMENT
/begin MEASUREMENT ZFEH_EepromData.di_roe_new_entries_sent[6] "information of already sent RoE information (bitcoded) [0 .. 16-1]" UWORD EH_STANDARD_S4_S3 1 100 0 65535 ECU_ADDRESS 0xFFF8342A DISPLAY_IDENTIFIER di_roe_new_entries_sent[6].ZFEH_EepromData /end MEASUREMENT
/begin MEASUREMENT ZFEH_EepromData.di_roe_new_entries_sent[7] "information of already sent RoE information (bitcoded) [0 .. 16-1]" UWORD EH_STANDARD_S4_S3 1 100 0 65535 ECU_ADDRESS 0xFFF8342C DISPLAY_IDENTIFIER di_roe_new_entries_sent[7].ZFEH_EepromData /end MEASUREMENT
/begin MEASUREMENT ZFEH_EepromData.di_roe_new_entries_sent[8] "information of already sent RoE information (bitcoded) [0 .. 16-1]" UWORD EH_STANDARD_S4_S3 1 100 0 65535 ECU_ADDRESS 0xFFF8342E DISPLAY_IDENTIFIER di_roe_new_entries_sent[8].ZFEH_EepromData /end MEASUREMENT
/begin MEASUREMENT ZFEH_EepromData.di_roe_new_entries_sent[9] "information of already sent RoE information (bitcoded) [0 .. 16-1]" UWORD EH_STANDARD_S4_S3 1 100 0 65535 ECU_ADDRESS 0xFFF83430 DISPLAY_IDENTIFIER di_roe_new_entries_sent[9].ZFEH_EepromData /end MEASUREMENT
/begin MEASUREMENT ZFEH_EepromData.di_statusOfDTC[0] "status of DTC of error code [0 .. 254-1]" UBYTE EH_STANDARD_S4_S3 1 100 0 255 ECU_ADDRESS 0xFFF82B38 DISPLAY_IDENTIFIER di_statusOfDTC[0].ZFEH_EepromData /end MEASUREMENT
/begin MEASUREMENT ZFEH_EepromData.di_statusOfDTC[100] "status of DTC of error code [0 .. 254-1]" UBYTE EH_STANDARD_S4_S3 1 100 0 255 ECU_ADDRESS 0xFFF82B9C DISPLAY_IDENTIFIER di_statusOfDTC[100].ZFEH_EepromData /end MEASUREMENT
/begin MEASUREMENT ZFEH_EepromData.di_statusOfDTC[101] "status of DTC of error code [0 .. 254-1]" UBYTE EH_STANDARD_S4_S3 1 100 0 255 ECU_ADDRESS 0xFFF82B9D DISPLAY_IDENTIFIER di_statusOfDTC[101].ZFEH_EepromData /end MEASUREMENT
/begin MEASUREMENT ZFEH_EepromData.di_statusOfDTC[102] "status of DTC of error code [0 .. 254-1]" UBYTE EH_STANDARD_S4_S3 1 100 0 255 ECU_ADDRESS 0xFFF82B9E DISPLAY_IDENTIFIER di_statusOfDTC[102].ZFEH_EepromData /end MEASUREMENT
/begin MEASUREMENT ZFEH_EepromData.di_statusOfDTC[103] "status of DTC of error code [0 .. 254-1]" UBYTE EH_STANDARD_S4_S3 1 100 0 255 ECU_ADDRESS 0xFFF82B9F DISPLAY_IDENTIFIER di_statusOfDTC[103].ZFEH_EepromData /end MEASUREMENT
/begin MEASUREMENT ZFEH_EepromData.di_statusOfDTC[104] "status of DTC of error code [0 .. 254-1]" UBYTE EH_STANDARD_S4_S3 1 100 0 255 ECU_ADDRESS 0xFFF82BA0 DISPLAY_IDENTIFIER di_statusOfDTC[104].ZFEH_EepromData /end MEASUREMENT
/begin MEASUREMENT ZFEH_EepromData.di_statusOfDTC[105] "status of DTC of error code [0 .. 254-1]" UBYTE EH_STANDARD_S4_S3 1 100 0 255 ECU_ADDRESS 0xFFF82BA1 DISPLAY_IDENTIFIER di_statusOfDTC[105].ZFEH_EepromData /end MEASUREMENT
/begin MEASUREMENT ZFEH_EepromData.di_statusOfDTC[106] "status of DTC of error code [0 .. 254-1]" UBYTE EH_STANDARD_S4_S3 1 100 0 255 ECU_ADDRESS 0xFFF82BA2 DISPLAY_IDENTIFIER di_statusOfDTC[106].ZFEH_EepromData /end MEASUREMENT
/begin MEASUREMENT ZFEH_EepromData.di_statusOfDTC[107] "status of DTC of error code [0 .. 254-1]" UBYTE EH_STANDARD_S4_S3 1 100 0 255 ECU_ADDRESS 0xFFF82BA3 DISPLAY_IDENTIFIER di_statusOfDTC[107].ZFEH_EepromData /end MEASUREMENT
/begin MEASUREMENT ZFEH_EepromData.di_statusOfDTC[108] "status of DTC of error code [0 .. 254-1]" UBYTE EH_STANDARD_S4_S3 1 100 0 255 ECU_ADDRESS 0xFFF82BA4 DISPLAY_IDENTIFIER di_statusOfDTC[108].ZFEH_EepromData /end MEASUREMENT
/begin MEASUREMENT ZFEH_EepromData.di_statusOfDTC[109] "status of DTC of error code [0 .. 254-1]" UBYTE EH_STANDARD_S4_S3 1 100 0 255 ECU_ADDRESS 0xFFF82BA5 DISPLAY_IDENTIFIER di_statusOfDTC[109].ZFEH_EepromData /end MEASUREMENT
/begin MEASUREMENT ZFEH_EepromData.di_statusOfDTC[10] "status of DTC of error code [0 .. 254-1]" UBYTE EH_STANDARD_S4_S3 1 100 0 255 ECU_ADDRESS 0xFFF82B42 DISPLAY_IDENTIFIER di_statusOfDTC[10].ZFEH_EepromData /end MEASUREMENT
/begin MEASUREMENT ZFEH_EepromData.di_statusOfDTC[110] "status of DTC of error code [0 .. 254-1]" UBYTE EH_STANDARD_S4_S3 1 100 0 255 ECU_ADDRESS 0xFFF82BA6 DISPLAY_IDENTIFIER di_statusOfDTC[110].ZFEH_EepromData /end MEASUREMENT
/begin MEASUREMENT ZFEH_EepromData.di_statusOfDTC[111] "status of DTC of error code [0 .. 254-1]" UBYTE EH_STANDARD_S4_S3 1 100 0 255 ECU_ADDRESS 0xFFF82BA7 DISPLAY_IDENTIFIER di_statusOfDTC[111].ZFEH_EepromData /end MEASUREMENT
/begin MEASUREMENT ZFEH_EepromData.di_statusOfDTC[112] "status of DTC of error code [0 .. 254-1]" UBYTE EH_STANDARD_S4_S3 1 100 0 255 ECU_ADDRESS 0xFFF82BA8 DISPLAY_IDENTIFIER di_statusOfDTC[112].ZFEH_EepromData /end MEASUREMENT
/begin MEASUREMENT ZFEH_EepromData.di_statusOfDTC[113] "status of DTC of error code [0 .. 254-1]" UBYTE EH_STANDARD_S4_S3 1 100 0 255 ECU_ADDRESS 0xFFF82BA9 DISPLAY_IDENTIFIER di_statusOfDTC[113].ZFEH_EepromData /end MEASUREMENT
/begin MEASUREMENT ZFEH_EepromData.di_statusOfDTC[114] "status of DTC of error code [0 .. 254-1]" UBYTE EH_STANDARD_S4_S3 1 100 0 255 ECU_ADDRESS 0xFFF82BAA DISPLAY_IDENTIFIER di_statusOfDTC[114].ZFEH_EepromData /end MEASUREMENT
/begin MEASUREMENT ZFEH_EepromData.di_statusOfDTC[115] "status of DTC of error code [0 .. 254-1]" UBYTE EH_STANDARD_S4_S3 1 100 0 255 ECU_ADDRESS 0xFFF82BAB DISPLAY_IDENTIFIER di_statusOfDTC[115].ZFEH_EepromData /end MEASUREMENT
/begin MEASUREMENT ZFEH_EepromData.di_statusOfDTC[116] "status of DTC of error code [0 .. 254-1]" UBYTE EH_STANDARD_S4_S3 1 100 0 255 ECU_ADDRESS 0xFFF82BAC DISPLAY_IDENTIFIER di_statusOfDTC[116].ZFEH_EepromData /end MEASUREMENT
/begin MEASUREMENT ZFEH_EepromData.di_statusOfDTC[117] "status of DTC of error code [0 .. 254-1]" UBYTE EH_STANDARD_S4_S3 1 100 0 255 ECU_ADDRESS 0xFFF82BAD DISPLAY_IDENTIFIER di_statusOfDTC[117].ZFEH_EepromData /end MEASUREMENT
/begin MEASUREMENT ZFEH_EepromData.di_statusOfDTC[118] "status of DTC of error code [0 .. 254-1]" UBYTE EH_STANDARD_S4_S3 1 100 0 255 ECU_ADDRESS 0xFFF82BAE DISPLAY_IDENTIFIER di_statusOfDTC[118].ZFEH_EepromData /end MEASUREMENT
/begin MEASUREMENT ZFEH_EepromData.di_statusOfDTC[119] "status of DTC of error code [0 .. 254-1]" UBYTE EH_STANDARD_S4_S3 1 100 0 255 ECU_ADDRESS 0xFFF82BAF DISPLAY_IDENTIFIER di_statusOfDTC[119].ZFEH_EepromData /end MEASUREMENT
/begin MEASUREMENT ZFEH_EepromData.di_statusOfDTC[11] "status of DTC of error code [0 .. 254-1]" UBYTE EH_STANDARD_S4_S3 1 100 0 255 ECU_ADDRESS 0xFFF82B43 DISPLAY_IDENTIFIER di_statusOfDTC[11].ZFEH_EepromData /end MEASUREMENT
/begin MEASUREMENT ZFEH_EepromData.di_statusOfDTC[120] "status of DTC of error code [0 .. 254-1]" UBYTE EH_STANDARD_S4_S3 1 100 0 255 ECU_ADDRESS 0xFFF82BB0 DISPLAY_IDENTIFIER di_statusOfDTC[120].ZFEH_EepromData /end MEASUREMENT
/begin MEASUREMENT ZFEH_EepromData.di_statusOfDTC[121] "status of DTC of error code [0 .. 254-1]" UBYTE EH_STANDARD_S4_S3 1 100 0 255 ECU_ADDRESS 0xFFF82BB1 DISPLAY_IDENTIFIER di_statusOfDTC[121].ZFEH_EepromData /end MEASUREMENT
/begin MEASUREMENT ZFEH_EepromData.di_statusOfDTC[122] "status of DTC of error code [0 .. 254-1]" UBYTE EH_STANDARD_S4_S3 1 100 0 255 ECU_ADDRESS 0xFFF82BB2 DISPLAY_IDENTIFIER di_statusOfDTC[122].ZFEH_EepromData /end MEASUREMENT
/begin MEASUREMENT ZFEH_EepromData.di_statusOfDTC[123] "status of DTC of error code [0 .. 254-1]" UBYTE EH_STANDARD_S4_S3 1 100 0 255 ECU_ADDRESS 0xFFF82BB3 DISPLAY_IDENTIFIER di_statusOfDTC[123].ZFEH_EepromData /end MEASUREMENT
/begin MEASUREMENT ZFEH_EepromData.di_statusOfDTC[124] "status of DTC of error code [0 .. 254-1]" UBYTE EH_STANDARD_S4_S3 1 100 0 255 ECU_ADDRESS 0xFFF82BB4 DISPLAY_IDENTIFIER di_statusOfDTC[124].ZFEH_EepromData /end MEASUREMENT
/begin MEASUREMENT ZFEH_EepromData.di_statusOfDTC[125] "status of DTC of error code [0 .. 254-1]" UBYTE EH_STANDARD_S4_S3 1 100 0 255 ECU_ADDRESS 0xFFF82BB5 DISPLAY_IDENTIFIER di_statusOfDTC[125].ZFEH_EepromData /end MEASUREMENT
/begin MEASUREMENT ZFEH_EepromData.di_statusOfDTC[126] "status of DTC of error code [0 .. 254-1]" UBYTE EH_STANDARD_S4_S3 1 100 0 255 ECU_ADDRESS 0xFFF82BB6 DISPLAY_IDENTIFIER di_statusOfDTC[126].ZFEH_EepromData /end MEASUREMENT
/begin MEASUREMENT ZFEH_EepromData.di_statusOfDTC[127] "status of DTC of error code [0 .. 254-1]" UBYTE EH_STANDARD_S4_S3 1 100 0 255 ECU_ADDRESS 0xFFF82BB7 DISPLAY_IDENTIFIER di_statusOfDTC[127].ZFEH_EepromData /end MEASUREMENT
/begin MEASUREMENT ZFEH_EepromData.di_statusOfDTC[128] "status of DTC of error code [0 .. 254-1]" UBYTE EH_STANDARD_S4_S3 1 100 0 255 ECU_ADDRESS 0xFFF82BB8 DISPLAY_IDENTIFIER di_statusOfDTC[128].ZFEH_EepromData /end MEASUREMENT
/begin MEASUREMENT ZFEH_EepromData.di_statusOfDTC[129] "status of DTC of error code [0 .. 254-1]" UBYTE EH_STANDARD_S4_S3 1 100 0 255 ECU_ADDRESS 0xFFF82BB9 DISPLAY_IDENTIFIER di_statusOfDTC[129].ZFEH_EepromData /end MEASUREMENT
/begin MEASUREMENT ZFEH_EepromData.di_statusOfDTC[12] "status of DTC of error code [0 .. 254-1]" UBYTE EH_STANDARD_S4_S3 1 100 0 255 ECU_ADDRESS 0xFFF82B44 DISPLAY_IDENTIFIER di_statusOfDTC[12].ZFEH_EepromData /end MEASUREMENT
/begin MEASUREMENT ZFEH_EepromData.di_statusOfDTC[130] "status of DTC of error code [0 .. 254-1]" UBYTE EH_STANDARD_S4_S3 1 100 0 255 ECU_ADDRESS 0xFFF82BBA DISPLAY_IDENTIFIER di_statusOfDTC[130].ZFEH_EepromData /end MEASUREMENT
/begin MEASUREMENT ZFEH_EepromData.di_statusOfDTC[131] "status of DTC of error code [0 .. 254-1]" UBYTE EH_STANDARD_S4_S3 1 100 0 255 ECU_ADDRESS 0xFFF82BBB DISPLAY_IDENTIFIER di_statusOfDTC[131].ZFEH_EepromData /end MEASUREMENT
/begin MEASUREMENT ZFEH_EepromData.di_statusOfDTC[132] "status of DTC of error code [0 .. 254-1]" UBYTE EH_STANDARD_S4_S3 1 100 0 255 ECU_ADDRESS 0xFFF82BBC DISPLAY_IDENTIFIER di_statusOfDTC[132].ZFEH_EepromData /end MEASUREMENT
/begin MEASUREMENT ZFEH_EepromData.di_statusOfDTC[133] "status of DTC of error code [0 .. 254-1]" UBYTE EH_STANDARD_S4_S3 1 100 0 255 ECU_ADDRESS 0xFFF82BBD DISPLAY_IDENTIFIER di_statusOfDTC[133].ZFEH_EepromData /end MEASUREMENT
/begin MEASUREMENT ZFEH_EepromData.di_statusOfDTC[134] "status of DTC of error code [0 .. 254-1]" UBYTE EH_STANDARD_S4_S3 1 100 0 255 ECU_ADDRESS 0xFFF82BBE DISPLAY_IDENTIFIER di_statusOfDTC[134].ZFEH_EepromData /end MEASUREMENT
/begin MEASUREMENT ZFEH_EepromData.di_statusOfDTC[135] "status of DTC of error code [0 .. 254-1]" UBYTE EH_STANDARD_S4_S3 1 100 0 255 ECU_ADDRESS 0xFFF82BBF DISPLAY_IDENTIFIER di_statusOfDTC[135].ZFEH_EepromData /end MEASUREMENT
/begin MEASUREMENT ZFEH_EepromData.di_statusOfDTC[136] "status of DTC of error code [0 .. 254-1]" UBYTE EH_STANDARD_S4_S3 1 100 0 255 ECU_ADDRESS 0xFFF82BC0 DISPLAY_IDENTIFIER di_statusOfDTC[136].ZFEH_EepromData /end MEASUREMENT
/begin MEASUREMENT ZFEH_EepromData.di_statusOfDTC[137] "status of DTC of error code [0 .. 254-1]" UBYTE EH_STANDARD_S4_S3 1 100 0 255 ECU_ADDRESS 0xFFF82BC1 DISPLAY_IDENTIFIER di_statusOfDTC[137].ZFEH_EepromData /end MEASUREMENT
/begin MEASUREMENT ZFEH_EepromData.di_statusOfDTC[138] "status of DTC of error code [0 .. 254-1]" UBYTE EH_STANDARD_S4_S3 1 100 0 255 ECU_ADDRESS 0xFFF82BC2 DISPLAY_IDENTIFIER di_statusOfDTC[138].ZFEH_EepromData /end MEASUREMENT
/begin MEASUREMENT ZFEH_EepromData.di_statusOfDTC[139] "status of DTC of error code [0 .. 254-1]" UBYTE EH_STANDARD_S4_S3 1 100 0 255 ECU_ADDRESS 0xFFF82BC3 DISPLAY_IDENTIFIER di_statusOfDTC[139].ZFEH_EepromData /end MEASUREMENT
/begin MEASUREMENT ZFEH_EepromData.di_statusOfDTC[13] "status of DTC of error code [0 .. 254-1]" UBYTE EH_STANDARD_S4_S3 1 100 0 255 ECU_ADDRESS 0xFFF82B45 DISPLAY_IDENTIFIER di_statusOfDTC[13].ZFEH_EepromData /end MEASUREMENT
/begin MEASUREMENT ZFEH_EepromData.di_statusOfDTC[140] "status of DTC of error code [0 .. 254-1]" UBYTE EH_STANDARD_S4_S3 1 100 0 255 ECU_ADDRESS 0xFFF82BC4 DISPLAY_IDENTIFIER di_statusOfDTC[140].ZFEH_EepromData /end MEASUREMENT
/begin MEASUREMENT ZFEH_EepromData.di_statusOfDTC[141] "status of DTC of error code [0 .. 254-1]" UBYTE EH_STANDARD_S4_S3 1 100 0 255 ECU_ADDRESS 0xFFF82BC5 DISPLAY_IDENTIFIER di_statusOfDTC[141].ZFEH_EepromData /end MEASUREMENT
/begin MEASUREMENT ZFEH_EepromData.di_statusOfDTC[142] "status of DTC of error code [0 .. 254-1]" UBYTE EH_STANDARD_S4_S3 1 100 0 255 ECU_ADDRESS 0xFFF82BC6 DISPLAY_IDENTIFIER di_statusOfDTC[142].ZFEH_EepromData /end MEASUREMENT
/begin MEASUREMENT ZFEH_EepromData.di_statusOfDTC[143] "status of DTC of error code [0 .. 254-1]" UBYTE EH_STANDARD_S4_S3 1 100 0 255 ECU_ADDRESS 0xFFF82BC7 DISPLAY_IDENTIFIER di_statusOfDTC[143].ZFEH_EepromData /end MEASUREMENT
/begin MEASUREMENT ZFEH_EepromData.di_statusOfDTC[144] "status of DTC of error code [0 .. 254-1]" UBYTE EH_STANDARD_S4_S3 1 100 0 255 ECU_ADDRESS 0xFFF82BC8 DISPLAY_IDENTIFIER di_statusOfDTC[144].ZFEH_EepromData /end MEASUREMENT
/begin MEASUREMENT ZFEH_EepromData.di_statusOfDTC[145] "status of DTC of error code [0 .. 254-1]" UBYTE EH_STANDARD_S4_S3 1 100 0 255 ECU_ADDRESS 0xFFF82BC9 DISPLAY_IDENTIFIER di_statusOfDTC[145].ZFEH_EepromData /end MEASUREMENT
/begin MEASUREMENT ZFEH_EepromData.di_statusOfDTC[146] "status of DTC of error code [0 .. 254-1]" UBYTE EH_STANDARD_S4_S3 1 100 0 255 ECU_ADDRESS 0xFFF82BCA DISPLAY_IDENTIFIER di_statusOfDTC[146].ZFEH_EepromData /end MEASUREMENT
/begin MEASUREMENT ZFEH_EepromData.di_statusOfDTC[147] "status of DTC of error code [0 .. 254-1]" UBYTE EH_STANDARD_S4_S3 1 100 0 255 ECU_ADDRESS 0xFFF82BCB DISPLAY_IDENTIFIER di_statusOfDTC[147].ZFEH_EepromData /end MEASUREMENT
/begin MEASUREMENT ZFEH_EepromData.di_statusOfDTC[148] "status of DTC of error code [0 .. 254-1]" UBYTE EH_STANDARD_S4_S3 1 100 0 255 ECU_ADDRESS 0xFFF82BCC DISPLAY_IDENTIFIER di_statusOfDTC[148].ZFEH_EepromData /end MEASUREMENT
/begin MEASUREMENT ZFEH_EepromData.di_statusOfDTC[149] "status of DTC of error code [0 .. 254-1]" UBYTE EH_STANDARD_S4_S3 1 100 0 255 ECU_ADDRESS 0xFFF82BCD DISPLAY_IDENTIFIER di_statusOfDTC[149].ZFEH_EepromData /end MEASUREMENT
/begin MEASUREMENT ZFEH_EepromData.di_statusOfDTC[14] "status of DTC of error code [0 .. 254-1]" UBYTE EH_STANDARD_S4_S3 1 100 0 255 ECU_ADDRESS 0xFFF82B46 DISPLAY_IDENTIFIER di_statusOfDTC[14].ZFEH_EepromData /end MEASUREMENT
/begin MEASUREMENT ZFEH_EepromData.di_statusOfDTC[150] "status of DTC of error code [0 .. 254-1]" UBYTE EH_STANDARD_S4_S3 1 100 0 255 ECU_ADDRESS 0xFFF82BCE DISPLAY_IDENTIFIER di_statusOfDTC[150].ZFEH_EepromData /end MEASUREMENT
/begin MEASUREMENT ZFEH_EepromData.di_statusOfDTC[151] "status of DTC of error code [0 .. 254-1]" UBYTE EH_STANDARD_S4_S3 1 100 0 255 ECU_ADDRESS 0xFFF82BCF DISPLAY_IDENTIFIER di_statusOfDTC[151].ZFEH_EepromData /end MEASUREMENT
/begin MEASUREMENT ZFEH_EepromData.di_statusOfDTC[152] "status of DTC of error code [0 .. 254-1]" UBYTE EH_STANDARD_S4_S3 1 100 0 255 ECU_ADDRESS 0xFFF82BD0 DISPLAY_IDENTIFIER di_statusOfDTC[152].ZFEH_EepromData /end MEASUREMENT
/begin MEASUREMENT ZFEH_EepromData.di_statusOfDTC[153] "status of DTC of error code [0 .. 254-1]" UBYTE EH_STANDARD_S4_S3 1 100 0 255 ECU_ADDRESS 0xFFF82BD1 DISPLAY_IDENTIFIER di_statusOfDTC[153].ZFEH_EepromData /end MEASUREMENT
/begin MEASUREMENT ZFEH_EepromData.di_statusOfDTC[154] "status of DTC of error code [0 .. 254-1]" UBYTE EH_STANDARD_S4_S3 1 100 0 255 ECU_ADDRESS 0xFFF82BD2 DISPLAY_IDENTIFIER di_statusOfDTC[154].ZFEH_EepromData /end MEASUREMENT
/begin MEASUREMENT ZFEH_EepromData.di_statusOfDTC[155] "status of DTC of error code [0 .. 254-1]" UBYTE EH_STANDARD_S4_S3 1 100 0 255 ECU_ADDRESS 0xFFF82BD3 DISPLAY_IDENTIFIER di_statusOfDTC[155].ZFEH_EepromData /end MEASUREMENT
/begin MEASUREMENT ZFEH_EepromData.di_statusOfDTC[156] "status of DTC of error code [0 .. 254-1]" UBYTE EH_STANDARD_S4_S3 1 100 0 255 ECU_ADDRESS 0xFFF82BD4 DISPLAY_IDENTIFIER di_statusOfDTC[156].ZFEH_EepromData /end MEASUREMENT
/begin MEASUREMENT ZFEH_EepromData.di_statusOfDTC[157] "status of DTC of error code [0 .. 254-1]" UBYTE EH_STANDARD_S4_S3 1 100 0 255 ECU_ADDRESS 0xFFF82BD5 DISPLAY_IDENTIFIER di_statusOfDTC[157].ZFEH_EepromData /end MEASUREMENT
/begin MEASUREMENT ZFEH_EepromData.di_statusOfDTC[158] "status of DTC of error code [0 .. 254-1]" UBYTE EH_STANDARD_S4_S3 1 100 0 255 ECU_ADDRESS 0xFFF82BD6 DISPLAY_IDENTIFIER di_statusOfDTC[158].ZFEH_EepromData /end MEASUREMENT
/begin MEASUREMENT ZFEH_EepromData.di_statusOfDTC[159] "status of DTC of error code [0 .. 254-1]" UBYTE EH_STANDARD_S4_S3 1 100 0 255 ECU_ADDRESS 0xFFF82BD7 DISPLAY_IDENTIFIER di_statusOfDTC[159].ZFEH_EepromData /end MEASUREMENT
/begin MEASUREMENT ZFEH_EepromData.di_statusOfDTC[15] "status of DTC of error code [0 .. 254-1]" UBYTE EH_STANDARD_S4_S3 1 100 0 255 ECU_ADDRESS 0xFFF82B47 DISPLAY_IDENTIFIER di_statusOfDTC[15].ZFEH_EepromData /end MEASUREMENT
/begin MEASUREMENT ZFEH_EepromData.di_statusOfDTC[160] "status of DTC of error code [0 .. 254-1]" UBYTE EH_STANDARD_S4_S3 1 100 0 255 ECU_ADDRESS 0xFFF82BD8 DISPLAY_IDENTIFIER di_statusOfDTC[160].ZFEH_EepromData /end MEASUREMENT
/begin MEASUREMENT ZFEH_EepromData.di_statusOfDTC[161] "status of DTC of error code [0 .. 254-1]" UBYTE EH_STANDARD_S4_S3 1 100 0 255 ECU_ADDRESS 0xFFF82BD9 DISPLAY_IDENTIFIER di_statusOfDTC[161].ZFEH_EepromData /end MEASUREMENT
/begin MEASUREMENT ZFEH_EepromData.di_statusOfDTC[162] "status of DTC of error code [0 .. 254-1]" UBYTE EH_STANDARD_S4_S3 1 100 0 255 ECU_ADDRESS 0xFFF82BDA DISPLAY_IDENTIFIER di_statusOfDTC[162].ZFEH_EepromData /end MEASUREMENT
/begin MEASUREMENT ZFEH_EepromData.di_statusOfDTC[163] "status of DTC of error code [0 .. 254-1]" UBYTE EH_STANDARD_S4_S3 1 100 0 255 ECU_ADDRESS 0xFFF82BDB DISPLAY_IDENTIFIER di_statusOfDTC[163].ZFEH_EepromData /end MEASUREMENT
/begin MEASUREMENT ZFEH_EepromData.di_statusOfDTC[164] "status of DTC of error code [0 .. 254-1]" UBYTE EH_STANDARD_S4_S3 1 100 0 255 ECU_ADDRESS 0xFFF82BDC DISPLAY_IDENTIFIER di_statusOfDTC[164].ZFEH_EepromData /end MEASUREMENT
/begin MEASUREMENT ZFEH_EepromData.di_statusOfDTC[165] "status of DTC of error code [0 .. 254-1]" UBYTE EH_STANDARD_S4_S3 1 100 0 255 ECU_ADDRESS 0xFFF82BDD DISPLAY_IDENTIFIER di_statusOfDTC[165].ZFEH_EepromData /end MEASUREMENT
/begin MEASUREMENT ZFEH_EepromData.di_statusOfDTC[166] "status of DTC of error code [0 .. 254-1]" UBYTE EH_STANDARD_S4_S3 1 100 0 255 ECU_ADDRESS 0xFFF82BDE DISPLAY_IDENTIFIER di_statusOfDTC[166].ZFEH_EepromData /end MEASUREMENT
/begin MEASUREMENT ZFEH_EepromData.di_statusOfDTC[167] "status of DTC of error code [0 .. 254-1]" UBYTE EH_STANDARD_S4_S3 1 100 0 255 ECU_ADDRESS 0xFFF82BDF DISPLAY_IDENTIFIER di_statusOfDTC[167].ZFEH_EepromData /end MEASUREMENT
/begin MEASUREMENT ZFEH_EepromData.di_statusOfDTC[168] "status of DTC of error code [0 .. 254-1]" UBYTE EH_STANDARD_S4_S3 1 100 0 255 ECU_ADDRESS 0xFFF82BE0 DISPLAY_IDENTIFIER di_statusOfDTC[168].ZFEH_EepromData /end MEASUREMENT
/begin MEASUREMENT ZFEH_EepromData.di_statusOfDTC[169] "status of DTC of error code [0 .. 254-1]" UBYTE EH_STANDARD_S4_S3 1 100 0 255 ECU_ADDRESS 0xFFF82BE1 DISPLAY_IDENTIFIER di_statusOfDTC[169].ZFEH_EepromData /end MEASUREMENT
/begin MEASUREMENT ZFEH_EepromData.di_statusOfDTC[16] "status of DTC of error code [0 .. 254-1]" UBYTE EH_STANDARD_S4_S3 1 100 0 255 ECU_ADDRESS 0xFFF82B48 DISPLAY_IDENTIFIER di_statusOfDTC[16].ZFEH_EepromData /end MEASUREMENT
/begin MEASUREMENT ZFEH_EepromData.di_statusOfDTC[170] "status of DTC of error code [0 .. 254-1]" UBYTE EH_STANDARD_S4_S3 1 100 0 255 ECU_ADDRESS 0xFFF82BE2 DISPLAY_IDENTIFIER di_statusOfDTC[170].ZFEH_EepromData /end MEASUREMENT
/begin MEASUREMENT ZFEH_EepromData.di_statusOfDTC[171] "status of DTC of error code [0 .. 254-1]" UBYTE EH_STANDARD_S4_S3 1 100 0 255 ECU_ADDRESS 0xFFF82BE3 DISPLAY_IDENTIFIER di_statusOfDTC[171].ZFEH_EepromData /end MEASUREMENT
/begin MEASUREMENT ZFEH_EepromData.di_statusOfDTC[172] "status of DTC of error code [0 .. 254-1]" UBYTE EH_STANDARD_S4_S3 1 100 0 255 ECU_ADDRESS 0xFFF82BE4 DISPLAY_IDENTIFIER di_statusOfDTC[172].ZFEH_EepromData /end MEASUREMENT
/begin MEASUREMENT ZFEH_EepromData.di_statusOfDTC[173] "status of DTC of error code [0 .. 254-1]" UBYTE EH_STANDARD_S4_S3 1 100 0 255 ECU_ADDRESS 0xFFF82BE5 DISPLAY_IDENTIFIER di_statusOfDTC[173].ZFEH_EepromData /end MEASUREMENT
/begin MEASUREMENT ZFEH_EepromData.di_statusOfDTC[174] "status of DTC of error code [0 .. 254-1]" UBYTE EH_STANDARD_S4_S3 1 100 0 255 ECU_ADDRESS 0xFFF82BE6 DISPLAY_IDENTIFIER di_statusOfDTC[174].ZFEH_EepromData /end MEASUREMENT
/begin MEASUREMENT ZFEH_EepromData.di_statusOfDTC[175] "status of DTC of error code [0 .. 254-1]" UBYTE EH_STANDARD_S4_S3 1 100 0 255 ECU_ADDRESS 0xFFF82BE7 DISPLAY_IDENTIFIER di_statusOfDTC[175].ZFEH_EepromData /end MEASUREMENT
/begin MEASUREMENT ZFEH_EepromData.di_statusOfDTC[176] "status of DTC of error code [0 .. 254-1]" UBYTE EH_STANDARD_S4_S3 1 100 0 255 ECU_ADDRESS 0xFFF82BE8 DISPLAY_IDENTIFIER di_statusOfDTC[176].ZFEH_EepromData /end MEASUREMENT
/begin MEASUREMENT ZFEH_EepromData.di_statusOfDTC[177] "status of DTC of error code [0 .. 254-1]" UBYTE EH_STANDARD_S4_S3 1 100 0 255 ECU_ADDRESS 0xFFF82BE9 DISPLAY_IDENTIFIER di_statusOfDTC[177].ZFEH_EepromData /end MEASUREMENT
/begin MEASUREMENT ZFEH_EepromData.di_statusOfDTC[178] "status of DTC of error code [0 .. 254-1]" UBYTE EH_STANDARD_S4_S3 1 100 0 255 ECU_ADDRESS 0xFFF82BEA DISPLAY_IDENTIFIER di_statusOfDTC[178].ZFEH_EepromData /end MEASUREMENT
/begin MEASUREMENT ZFEH_EepromData.di_statusOfDTC[179] "status of DTC of error code [0 .. 254-1]" UBYTE EH_STANDARD_S4_S3 1 100 0 255 ECU_ADDRESS 0xFFF82BEB DISPLAY_IDENTIFIER di_statusOfDTC[179].ZFEH_EepromData /end MEASUREMENT
/begin MEASUREMENT ZFEH_EepromData.di_statusOfDTC[17] "status of DTC of error code [0 .. 254-1]" UBYTE EH_STANDARD_S4_S3 1 100 0 255 ECU_ADDRESS 0xFFF82B49 DISPLAY_IDENTIFIER di_statusOfDTC[17].ZFEH_EepromData /end MEASUREMENT
/begin MEASUREMENT ZFEH_EepromData.di_statusOfDTC[180] "status of DTC of error code [0 .. 254-1]" UBYTE EH_STANDARD_S4_S3 1 100 0 255 ECU_ADDRESS 0xFFF82BEC DISPLAY_IDENTIFIER di_statusOfDTC[180].ZFEH_EepromData /end MEASUREMENT
/begin MEASUREMENT ZFEH_EepromData.di_statusOfDTC[181] "status of DTC of error code [0 .. 254-1]" UBYTE EH_STANDARD_S4_S3 1 100 0 255 ECU_ADDRESS 0xFFF82BED DISPLAY_IDENTIFIER di_statusOfDTC[181].ZFEH_EepromData /end MEASUREMENT
/begin MEASUREMENT ZFEH_EepromData.di_statusOfDTC[182] "status of DTC of error code [0 .. 254-1]" UBYTE EH_STANDARD_S4_S3 1 100 0 255 ECU_ADDRESS 0xFFF82BEE DISPLAY_IDENTIFIER di_statusOfDTC[182].ZFEH_EepromData /end MEASUREMENT
/begin MEASUREMENT ZFEH_EepromData.di_statusOfDTC[183] "status of DTC of error code [0 .. 254-1]" UBYTE EH_STANDARD_S4_S3 1 100 0 255 ECU_ADDRESS 0xFFF82BEF DISPLAY_IDENTIFIER di_statusOfDTC[183].ZFEH_EepromData /end MEASUREMENT
/begin MEASUREMENT ZFEH_EepromData.di_statusOfDTC[184] "status of DTC of error code [0 .. 254-1]" UBYTE EH_STANDARD_S4_S3 1 100 0 255 ECU_ADDRESS 0xFFF82BF0 DISPLAY_IDENTIFIER di_statusOfDTC[184].ZFEH_EepromData /end MEASUREMENT
/begin MEASUREMENT ZFEH_EepromData.di_statusOfDTC[185] "status of DTC of error code [0 .. 254-1]" UBYTE EH_STANDARD_S4_S3 1 100 0 255 ECU_ADDRESS 0xFFF82BF1 DISPLAY_IDENTIFIER di_statusOfDTC[185].ZFEH_EepromData /end MEASUREMENT
/begin MEASUREMENT ZFEH_EepromData.di_statusOfDTC[186] "status of DTC of error code [0 .. 254-1]" UBYTE EH_STANDARD_S4_S3 1 100 0 255 ECU_ADDRESS 0xFFF82BF2 DISPLAY_IDENTIFIER di_statusOfDTC[186].ZFEH_EepromData /end MEASUREMENT
/begin MEASUREMENT ZFEH_EepromData.di_statusOfDTC[187] "status of DTC of error code [0 .. 254-1]" UBYTE EH_STANDARD_S4_S3 1 100 0 255 ECU_ADDRESS 0xFFF82BF3 DISPLAY_IDENTIFIER di_statusOfDTC[187].ZFEH_EepromData /end MEASUREMENT
/begin MEASUREMENT ZFEH_EepromData.di_statusOfDTC[188] "status of DTC of error code [0 .. 254-1]" UBYTE EH_STANDARD_S4_S3 1 100 0 255 ECU_ADDRESS 0xFFF82BF4 DISPLAY_IDENTIFIER di_statusOfDTC[188].ZFEH_EepromData /end MEASUREMENT
/begin MEASUREMENT ZFEH_EepromData.di_statusOfDTC[189] "status of DTC of error code [0 .. 254-1]" UBYTE EH_STANDARD_S4_S3 1 100 0 255 ECU_ADDRESS 0xFFF82BF5 DISPLAY_IDENTIFIER di_statusOfDTC[189].ZFEH_EepromData /end MEASUREMENT
/begin MEASUREMENT ZFEH_EepromData.di_statusOfDTC[18] "status of DTC of error code [0 .. 254-1]" UBYTE EH_STANDARD_S4_S3 1 100 0 255 ECU_ADDRESS 0xFFF82B4A DISPLAY_IDENTIFIER di_statusOfDTC[18].ZFEH_EepromData /end MEASUREMENT
/begin MEASUREMENT ZFEH_EepromData.di_statusOfDTC[190] "status of DTC of error code [0 .. 254-1]" UBYTE EH_STANDARD_S4_S3 1 100 0 255 ECU_ADDRESS 0xFFF82BF6 DISPLAY_IDENTIFIER di_statusOfDTC[190].ZFEH_EepromData /end MEASUREMENT
/begin MEASUREMENT ZFEH_EepromData.di_statusOfDTC[191] "status of DTC of error code [0 .. 254-1]" UBYTE EH_STANDARD_S4_S3 1 100 0 255 ECU_ADDRESS 0xFFF82BF7 DISPLAY_IDENTIFIER di_statusOfDTC[191].ZFEH_EepromData /end MEASUREMENT
/begin MEASUREMENT ZFEH_EepromData.di_statusOfDTC[192] "status of DTC of error code [0 .. 254-1]" UBYTE EH_STANDARD_S4_S3 1 100 0 255 ECU_ADDRESS 0xFFF82BF8 DISPLAY_IDENTIFIER di_statusOfDTC[192].ZFEH_EepromData /end MEASUREMENT
/begin MEASUREMENT ZFEH_EepromData.di_statusOfDTC[193] "status of DTC of error code [0 .. 254-1]" UBYTE EH_STANDARD_S4_S3 1 100 0 255 ECU_ADDRESS 0xFFF82BF9 DISPLAY_IDENTIFIER di_statusOfDTC[193].ZFEH_EepromData /end MEASUREMENT
/begin MEASUREMENT ZFEH_EepromData.di_statusOfDTC[194] "status of DTC of error code [0 .. 254-1]" UBYTE EH_STANDARD_S4_S3 1 100 0 255 ECU_ADDRESS 0xFFF82BFA DISPLAY_IDENTIFIER di_statusOfDTC[194].ZFEH_EepromData /end MEASUREMENT
/begin MEASUREMENT ZFEH_EepromData.di_statusOfDTC[195] "status of DTC of error code [0 .. 254-1]" UBYTE EH_STANDARD_S4_S3 1 100 0 255 ECU_ADDRESS 0xFFF82BFB DISPLAY_IDENTIFIER di_statusOfDTC[195].ZFEH_EepromData /end MEASUREMENT
/begin MEASUREMENT ZFEH_EepromData.di_statusOfDTC[196] "status of DTC of error code [0 .. 254-1]" UBYTE EH_STANDARD_S4_S3 1 100 0 255 ECU_ADDRESS 0xFFF82BFC DISPLAY_IDENTIFIER di_statusOfDTC[196].ZFEH_EepromData /end MEASUREMENT
/begin MEASUREMENT ZFEH_EepromData.di_statusOfDTC[197] "status of DTC of error code [0 .. 254-1]" UBYTE EH_STANDARD_S4_S3 1 100 0 255 ECU_ADDRESS 0xFFF82BFD DISPLAY_IDENTIFIER di_statusOfDTC[197].ZFEH_EepromData /end MEASUREMENT
/begin MEASUREMENT ZFEH_EepromData.di_statusOfDTC[198] "status of DTC of error code [0 .. 254-1]" UBYTE EH_STANDARD_S4_S3 1 100 0 255 ECU_ADDRESS 0xFFF82BFE DISPLAY_IDENTIFIER di_statusOfDTC[198].ZFEH_EepromData /end MEASUREMENT
/begin MEASUREMENT ZFEH_EepromData.di_statusOfDTC[199] "status of DTC of error code [0 .. 254-1]" UBYTE EH_STANDARD_S4_S3 1 100 0 255 ECU_ADDRESS 0xFFF82BFF DISPLAY_IDENTIFIER di_statusOfDTC[199].ZFEH_EepromData /end MEASUREMENT
/begin MEASUREMENT ZFEH_EepromData.di_statusOfDTC[19] "status of DTC of error code [0 .. 254-1]" UBYTE EH_STANDARD_S4_S3 1 100 0 255 ECU_ADDRESS 0xFFF82B4B DISPLAY_IDENTIFIER di_statusOfDTC[19].ZFEH_EepromData /end MEASUREMENT
/begin MEASUREMENT ZFEH_EepromData.di_statusOfDTC[1] "status of DTC of error code [0 .. 254-1]" UBYTE EH_STANDARD_S4_S3 1 100 0 255 ECU_ADDRESS 0xFFF82B39 DISPLAY_IDENTIFIER di_statusOfDTC[1].ZFEH_EepromData /end MEASUREMENT
/begin MEASUREMENT ZFEH_EepromData.di_statusOfDTC[200] "status of DTC of error code [0 .. 254-1]" UBYTE EH_STANDARD_S4_S3 1 100 0 255 ECU_ADDRESS 0xFFF82C00 DISPLAY_IDENTIFIER di_statusOfDTC[200].ZFEH_EepromData /end MEASUREMENT
/begin MEASUREMENT ZFEH_EepromData.di_statusOfDTC[201] "status of DTC of error code [0 .. 254-1]" UBYTE EH_STANDARD_S4_S3 1 100 0 255 ECU_ADDRESS 0xFFF82C01 DISPLAY_IDENTIFIER di_statusOfDTC[201].ZFEH_EepromData /end MEASUREMENT
/begin MEASUREMENT ZFEH_EepromData.di_statusOfDTC[202] "status of DTC of error code [0 .. 254-1]" UBYTE EH_STANDARD_S4_S3 1 100 0 255 ECU_ADDRESS 0xFFF82C02 DISPLAY_IDENTIFIER di_statusOfDTC[202].ZFEH_EepromData /end MEASUREMENT
/begin MEASUREMENT ZFEH_EepromData.di_statusOfDTC[203] "status of DTC of error code [0 .. 254-1]" UBYTE EH_STANDARD_S4_S3 1 100 0 255 ECU_ADDRESS 0xFFF82C03 DISPLAY_IDENTIFIER di_statusOfDTC[203].ZFEH_EepromData /end MEASUREMENT
/begin MEASUREMENT ZFEH_EepromData.di_statusOfDTC[204] "status of DTC of error code [0 .. 254-1]" UBYTE EH_STANDARD_S4_S3 1 100 0 255 ECU_ADDRESS 0xFFF82C04 DISPLAY_IDENTIFIER di_statusOfDTC[204].ZFEH_EepromData /end MEASUREMENT
/begin MEASUREMENT ZFEH_EepromData.di_statusOfDTC[205] "status of DTC of error code [0 .. 254-1]" UBYTE EH_STANDARD_S4_S3 1 100 0 255 ECU_ADDRESS 0xFFF82C05 DISPLAY_IDENTIFIER di_statusOfDTC[205].ZFEH_EepromData /end MEASUREMENT
/begin MEASUREMENT ZFEH_EepromData.di_statusOfDTC[206] "status of DTC of error code [0 .. 254-1]" UBYTE EH_STANDARD_S4_S3 1 100 0 255 ECU_ADDRESS 0xFFF82C06 DISPLAY_IDENTIFIER di_statusOfDTC[206].ZFEH_EepromData /end MEASUREMENT
/begin MEASUREMENT ZFEH_EepromData.di_statusOfDTC[207] "status of DTC of error code [0 .. 254-1]" UBYTE EH_STANDARD_S4_S3 1 100 0 255 ECU_ADDRESS 0xFFF82C07 DISPLAY_IDENTIFIER di_statusOfDTC[207].ZFEH_EepromData /end MEASUREMENT
/begin MEASUREMENT ZFEH_EepromData.di_statusOfDTC[208] "status of DTC of error code [0 .. 254-1]" UBYTE EH_STANDARD_S4_S3 1 100 0 255 ECU_ADDRESS 0xFFF82C08 DISPLAY_IDENTIFIER di_statusOfDTC[208].ZFEH_EepromData /end MEASUREMENT
/begin MEASUREMENT ZFEH_EepromData.di_statusOfDTC[209] "status of DTC of error code [0 .. 254-1]" UBYTE EH_STANDARD_S4_S3 1 100 0 255 ECU_ADDRESS 0xFFF82C09 DISPLAY_IDENTIFIER di_statusOfDTC[209].ZFEH_EepromData /end MEASUREMENT
/begin MEASUREMENT ZFEH_EepromData.di_statusOfDTC[20] "status of DTC of error code [0 .. 254-1]" UBYTE EH_STANDARD_S4_S3 1 100 0 255 ECU_ADDRESS 0xFFF82B4C DISPLAY_IDENTIFIER di_statusOfDTC[20].ZFEH_EepromData /end MEASUREMENT
/begin MEASUREMENT ZFEH_EepromData.di_statusOfDTC[210] "status of DTC of error code [0 .. 254-1]" UBYTE EH_STANDARD_S4_S3 1 100 0 255 ECU_ADDRESS 0xFFF82C0A DISPLAY_IDENTIFIER di_statusOfDTC[210].ZFEH_EepromData /end MEASUREMENT
/begin MEASUREMENT ZFEH_EepromData.di_statusOfDTC[211] "status of DTC of error code [0 .. 254-1]" UBYTE EH_STANDARD_S4_S3 1 100 0 255 ECU_ADDRESS 0xFFF82C0B DISPLAY_IDENTIFIER di_statusOfDTC[211].ZFEH_EepromData /end MEASUREMENT
/begin MEASUREMENT ZFEH_EepromData.di_statusOfDTC[212] "status of DTC of error code [0 .. 254-1]" UBYTE EH_STANDARD_S4_S3 1 100 0 255 ECU_ADDRESS 0xFFF82C0C DISPLAY_IDENTIFIER di_statusOfDTC[212].ZFEH_EepromData /end MEASUREMENT
/begin MEASUREMENT ZFEH_EepromData.di_statusOfDTC[213] "status of DTC of error code [0 .. 254-1]" UBYTE EH_STANDARD_S4_S3 1 100 0 255 ECU_ADDRESS 0xFFF82C0D DISPLAY_IDENTIFIER di_statusOfDTC[213].ZFEH_EepromData /end MEASUREMENT
/begin MEASUREMENT ZFEH_EepromData.di_statusOfDTC[214] "status of DTC of error code [0 .. 254-1]" UBYTE EH_STANDARD_S4_S3 1 100 0 255 ECU_ADDRESS 0xFFF82C0E DISPLAY_IDENTIFIER di_statusOfDTC[214].ZFEH_EepromData /end MEASUREMENT
/begin MEASUREMENT ZFEH_EepromData.di_statusOfDTC[215] "status of DTC of error code [0 .. 254-1]" UBYTE EH_STANDARD_S4_S3 1 100 0 255 ECU_ADDRESS 0xFFF82C0F DISPLAY_IDENTIFIER di_statusOfDTC[215].ZFEH_EepromData /end MEASUREMENT
/begin MEASUREMENT ZFEH_EepromData.di_statusOfDTC[216] "status of DTC of error code [0 .. 254-1]" UBYTE EH_STANDARD_S4_S3 1 100 0 255 ECU_ADDRESS 0xFFF82C10 DISPLAY_IDENTIFIER di_statusOfDTC[216].ZFEH_EepromData /end MEASUREMENT
/begin MEASUREMENT ZFEH_EepromData.di_statusOfDTC[217] "status of DTC of error code [0 .. 254-1]" UBYTE EH_STANDARD_S4_S3 1 100 0 255 ECU_ADDRESS 0xFFF82C11 DISPLAY_IDENTIFIER di_statusOfDTC[217].ZFEH_EepromData /end MEASUREMENT
/begin MEASUREMENT ZFEH_EepromData.di_statusOfDTC[218] "status of DTC of error code [0 .. 254-1]" UBYTE EH_STANDARD_S4_S3 1 100 0 255 ECU_ADDRESS 0xFFF82C12 DISPLAY_IDENTIFIER di_statusOfDTC[218].ZFEH_EepromData /end MEASUREMENT
/begin MEASUREMENT ZFEH_EepromData.di_statusOfDTC[219] "status of DTC of error code [0 .. 254-1]" UBYTE EH_STANDARD_S4_S3 1 100 0 255 ECU_ADDRESS 0xFFF82C13 DISPLAY_IDENTIFIER di_statusOfDTC[219].ZFEH_EepromData /end MEASUREMENT
/begin MEASUREMENT ZFEH_EepromData.di_statusOfDTC[21] "status of DTC of error code [0 .. 254-1]" UBYTE EH_STANDARD_S4_S3 1 100 0 255 ECU_ADDRESS 0xFFF82B4D DISPLAY_IDENTIFIER di_statusOfDTC[21].ZFEH_EepromData /end MEASUREMENT
/begin MEASUREMENT ZFEH_EepromData.di_statusOfDTC[220] "status of DTC of error code [0 .. 254-1]" UBYTE EH_STANDARD_S4_S3 1 100 0 255 ECU_ADDRESS 0xFFF82C14 DISPLAY_IDENTIFIER di_statusOfDTC[220].ZFEH_EepromData /end MEASUREMENT
/begin MEASUREMENT ZFEH_EepromData.di_statusOfDTC[221] "status of DTC of error code [0 .. 254-1]" UBYTE EH_STANDARD_S4_S3 1 100 0 255 ECU_ADDRESS 0xFFF82C15 DISPLAY_IDENTIFIER di_statusOfDTC[221].ZFEH_EepromData /end MEASUREMENT
/begin MEASUREMENT ZFEH_EepromData.di_statusOfDTC[222] "status of DTC of error code [0 .. 254-1]" UBYTE EH_STANDARD_S4_S3 1 100 0 255 ECU_ADDRESS 0xFFF82C16 DISPLAY_IDENTIFIER di_statusOfDTC[222].ZFEH_EepromData /end MEASUREMENT
/begin MEASUREMENT ZFEH_EepromData.di_statusOfDTC[223] "status of DTC of error code [0 .. 254-1]" UBYTE EH_STANDARD_S4_S3 1 100 0 255 ECU_ADDRESS 0xFFF82C17 DISPLAY_IDENTIFIER di_statusOfDTC[223].ZFEH_EepromData /end MEASUREMENT
/begin MEASUREMENT ZFEH_EepromData.di_statusOfDTC[224] "status of DTC of error code [0 .. 254-1]" UBYTE EH_STANDARD_S4_S3 1 100 0 255 ECU_ADDRESS 0xFFF82C18 DISPLAY_IDENTIFIER di_statusOfDTC[224].ZFEH_EepromData /end MEASUREMENT
/begin MEASUREMENT ZFEH_EepromData.di_statusOfDTC[225] "status of DTC of error code [0 .. 254-1]" UBYTE EH_STANDARD_S4_S3 1 100 0 255 ECU_ADDRESS 0xFFF82C19 DISPLAY_IDENTIFIER di_statusOfDTC[225].ZFEH_EepromData /end MEASUREMENT
/begin MEASUREMENT ZFEH_EepromData.di_statusOfDTC[226] "status of DTC of error code [0 .. 254-1]" UBYTE EH_STANDARD_S4_S3 1 100 0 255 ECU_ADDRESS 0xFFF82C1A DISPLAY_IDENTIFIER di_statusOfDTC[226].ZFEH_EepromData /end MEASUREMENT
/begin MEASUREMENT ZFEH_EepromData.di_statusOfDTC[227] "status of DTC of error code [0 .. 254-1]" UBYTE EH_STANDARD_S4_S3 1 100 0 255 ECU_ADDRESS 0xFFF82C1B DISPLAY_IDENTIFIER di_statusOfDTC[227].ZFEH_EepromData /end MEASUREMENT
/begin MEASUREMENT ZFEH_EepromData.di_statusOfDTC[228] "status of DTC of error code [0 .. 254-1]" UBYTE EH_STANDARD_S4_S3 1 100 0 255 ECU_ADDRESS 0xFFF82C1C DISPLAY_IDENTIFIER di_statusOfDTC[228].ZFEH_EepromData /end MEASUREMENT
/begin MEASUREMENT ZFEH_EepromData.di_statusOfDTC[229] "status of DTC of error code [0 .. 254-1]" UBYTE EH_STANDARD_S4_S3 1 100 0 255 ECU_ADDRESS 0xFFF82C1D DISPLAY_IDENTIFIER di_statusOfDTC[229].ZFEH_EepromData /end MEASUREMENT
/begin MEASUREMENT ZFEH_EepromData.di_statusOfDTC[22] "status of DTC of error code [0 .. 254-1]" UBYTE EH_STANDARD_S4_S3 1 100 0 255 ECU_ADDRESS 0xFFF82B4E DISPLAY_IDENTIFIER di_statusOfDTC[22].ZFEH_EepromData /end MEASUREMENT
/begin MEASUREMENT ZFEH_EepromData.di_statusOfDTC[230] "status of DTC of error code [0 .. 254-1]" UBYTE EH_STANDARD_S4_S3 1 100 0 255 ECU_ADDRESS 0xFFF82C1E DISPLAY_IDENTIFIER di_statusOfDTC[230].ZFEH_EepromData /end MEASUREMENT
/begin MEASUREMENT ZFEH_EepromData.di_statusOfDTC[231] "status of DTC of error code [0 .. 254-1]" UBYTE EH_STANDARD_S4_S3 1 100 0 255 ECU_ADDRESS 0xFFF82C1F DISPLAY_IDENTIFIER di_statusOfDTC[231].ZFEH_EepromData /end MEASUREMENT
/begin MEASUREMENT ZFEH_EepromData.di_statusOfDTC[232] "status of DTC of error code [0 .. 254-1]" UBYTE EH_STANDARD_S4_S3 1 100 0 255 ECU_ADDRESS 0xFFF82C20 DISPLAY_IDENTIFIER di_statusOfDTC[232].ZFEH_EepromData /end MEASUREMENT
/begin MEASUREMENT ZFEH_EepromData.di_statusOfDTC[233] "status of DTC of error code [0 .. 254-1]" UBYTE EH_STANDARD_S4_S3 1 100 0 255 ECU_ADDRESS 0xFFF82C21 DISPLAY_IDENTIFIER di_statusOfDTC[233].ZFEH_EepromData /end MEASUREMENT
/begin MEASUREMENT ZFEH_EepromData.di_statusOfDTC[234] "status of DTC of error code [0 .. 254-1]" UBYTE EH_STANDARD_S4_S3 1 100 0 255 ECU_ADDRESS 0xFFF82C22 DISPLAY_IDENTIFIER di_statusOfDTC[234].ZFEH_EepromData /end MEASUREMENT
/begin MEASUREMENT ZFEH_EepromData.di_statusOfDTC[235] "status of DTC of error code [0 .. 254-1]" UBYTE EH_STANDARD_S4_S3 1 100 0 255 ECU_ADDRESS 0xFFF82C23 DISPLAY_IDENTIFIER di_statusOfDTC[235].ZFEH_EepromData /end MEASUREMENT
/begin MEASUREMENT ZFEH_EepromData.di_statusOfDTC[236] "status of DTC of error code [0 .. 254-1]" UBYTE EH_STANDARD_S4_S3 1 100 0 255 ECU_ADDRESS 0xFFF82C24 DISPLAY_IDENTIFIER di_statusOfDTC[236].ZFEH_EepromData /end MEASUREMENT
/begin MEASUREMENT ZFEH_EepromData.di_statusOfDTC[237] "status of DTC of error code [0 .. 254-1]" UBYTE EH_STANDARD_S4_S3 1 100 0 255 ECU_ADDRESS 0xFFF82C25 DISPLAY_IDENTIFIER di_statusOfDTC[237].ZFEH_EepromData /end MEASUREMENT
/begin MEASUREMENT ZFEH_EepromData.di_statusOfDTC[238] "status of DTC of error code [0 .. 254-1]" UBYTE EH_STANDARD_S4_S3 1 100 0 255 ECU_ADDRESS 0xFFF82C26 DISPLAY_IDENTIFIER di_statusOfDTC[238].ZFEH_EepromData /end MEASUREMENT
/begin MEASUREMENT ZFEH_EepromData.di_statusOfDTC[239] "status of DTC of error code [0 .. 254-1]" UBYTE EH_STANDARD_S4_S3 1 100 0 255 ECU_ADDRESS 0xFFF82C27 DISPLAY_IDENTIFIER di_statusOfDTC[239].ZFEH_EepromData /end MEASUREMENT
/begin MEASUREMENT ZFEH_EepromData.di_statusOfDTC[23] "status of DTC of error code [0 .. 254-1]" UBYTE EH_STANDARD_S4_S3 1 100 0 255 ECU_ADDRESS 0xFFF82B4F DISPLAY_IDENTIFIER di_statusOfDTC[23].ZFEH_EepromData /end MEASUREMENT
/begin MEASUREMENT ZFEH_EepromData.di_statusOfDTC[240] "status of DTC of error code [0 .. 254-1]" UBYTE EH_STANDARD_S4_S3 1 100 0 255 ECU_ADDRESS 0xFFF82C28 DISPLAY_IDENTIFIER di_statusOfDTC[240].ZFEH_EepromData /end MEASUREMENT
/begin MEASUREMENT ZFEH_EepromData.di_statusOfDTC[241] "status of DTC of error code [0 .. 254-1]" UBYTE EH_STANDARD_S4_S3 1 100 0 255 ECU_ADDRESS 0xFFF82C29 DISPLAY_IDENTIFIER di_statusOfDTC[241].ZFEH_EepromData /end MEASUREMENT
/begin MEASUREMENT ZFEH_EepromData.di_statusOfDTC[242] "status of DTC of error code [0 .. 254-1]" UBYTE EH_STANDARD_S4_S3 1 100 0 255 ECU_ADDRESS 0xFFF82C2A DISPLAY_IDENTIFIER di_statusOfDTC[242].ZFEH_EepromData /end MEASUREMENT
/begin MEASUREMENT ZFEH_EepromData.di_statusOfDTC[243] "status of DTC of error code [0 .. 254-1]" UBYTE EH_STANDARD_S4_S3 1 100 0 255 ECU_ADDRESS 0xFFF82C2B DISPLAY_IDENTIFIER di_statusOfDTC[243].ZFEH_EepromData /end MEASUREMENT
/begin MEASUREMENT ZFEH_EepromData.di_statusOfDTC[244] "status of DTC of error code [0 .. 254-1]" UBYTE EH_STANDARD_S4_S3 1 100 0 255 ECU_ADDRESS 0xFFF82C2C DISPLAY_IDENTIFIER di_statusOfDTC[244].ZFEH_EepromData /end MEASUREMENT
/begin MEASUREMENT ZFEH_EepromData.di_statusOfDTC[245] "status of DTC of error code [0 .. 254-1]" UBYTE EH_STANDARD_S4_S3 1 100 0 255 ECU_ADDRESS 0xFFF82C2D DISPLAY_IDENTIFIER di_statusOfDTC[245].ZFEH_EepromData /end MEASUREMENT
/begin MEASUREMENT ZFEH_EepromData.di_statusOfDTC[246] "status of DTC of error code [0 .. 254-1]" UBYTE EH_STANDARD_S4_S3 1 100 0 255 ECU_ADDRESS 0xFFF82C2E DISPLAY_IDENTIFIER di_statusOfDTC[246].ZFEH_EepromData /end MEASUREMENT
/begin MEASUREMENT ZFEH_EepromData.di_statusOfDTC[247] "status of DTC of error code [0 .. 254-1]" UBYTE EH_STANDARD_S4_S3 1 100 0 255 ECU_ADDRESS 0xFFF82C2F DISPLAY_IDENTIFIER di_statusOfDTC[247].ZFEH_EepromData /end MEASUREMENT
/begin MEASUREMENT ZFEH_EepromData.di_statusOfDTC[248] "status of DTC of error code [0 .. 254-1]" UBYTE EH_STANDARD_S4_S3 1 100 0 255 ECU_ADDRESS 0xFFF82C30 DISPLAY_IDENTIFIER di_statusOfDTC[248].ZFEH_EepromData /end MEASUREMENT
/begin MEASUREMENT ZFEH_EepromData.di_statusOfDTC[249] "status of DTC of error code [0 .. 254-1]" UBYTE EH_STANDARD_S4_S3 1 100 0 255 ECU_ADDRESS 0xFFF82C31 DISPLAY_IDENTIFIER di_statusOfDTC[249].ZFEH_EepromData /end MEASUREMENT
/begin MEASUREMENT ZFEH_EepromData.di_statusOfDTC[24] "status of DTC of error code [0 .. 254-1]" UBYTE EH_STANDARD_S4_S3 1 100 0 255 ECU_ADDRESS 0xFFF82B50 DISPLAY_IDENTIFIER di_statusOfDTC[24].ZFEH_EepromData /end MEASUREMENT
/begin MEASUREMENT ZFEH_EepromData.di_statusOfDTC[250] "status of DTC of error code [0 .. 254-1]" UBYTE EH_STANDARD_S4_S3 1 100 0 255 ECU_ADDRESS 0xFFF82C32 DISPLAY_IDENTIFIER di_statusOfDTC[250].ZFEH_EepromData /end MEASUREMENT
/begin MEASUREMENT ZFEH_EepromData.di_statusOfDTC[251] "status of DTC of error code [0 .. 254-1]" UBYTE EH_STANDARD_S4_S3 1 100 0 255 ECU_ADDRESS 0xFFF82C33 DISPLAY_IDENTIFIER di_statusOfDTC[251].ZFEH_EepromData /end MEASUREMENT
/begin MEASUREMENT ZFEH_EepromData.di_statusOfDTC[252] "status of DTC of error code [0 .. 254-1]" UBYTE EH_STANDARD_S4_S3 1 100 0 255 ECU_ADDRESS 0xFFF82C34 DISPLAY_IDENTIFIER di_statusOfDTC[252].ZFEH_EepromData /end MEASUREMENT
/begin MEASUREMENT ZFEH_EepromData.di_statusOfDTC[253] "status of DTC of error code [0 .. 254-1]" UBYTE EH_STANDARD_S4_S3 1 100 0 255 ECU_ADDRESS 0xFFF82C35 DISPLAY_IDENTIFIER di_statusOfDTC[253].ZFEH_EepromData /end MEASUREMENT
/begin MEASUREMENT ZFEH_EepromData.di_statusOfDTC[25] "status of DTC of error code [0 .. 254-1]" UBYTE EH_STANDARD_S4_S3 1 100 0 255 ECU_ADDRESS 0xFFF82B51 DISPLAY_IDENTIFIER di_statusOfDTC[25].ZFEH_EepromData /end MEASUREMENT
/begin MEASUREMENT ZFEH_EepromData.di_statusOfDTC[26] "status of DTC of error code [0 .. 254-1]" UBYTE EH_STANDARD_S4_S3 1 100 0 255 ECU_ADDRESS 0xFFF82B52 DISPLAY_IDENTIFIER di_statusOfDTC[26].ZFEH_EepromData /end MEASUREMENT
/begin MEASUREMENT ZFEH_EepromData.di_statusOfDTC[27] "status of DTC of error code [0 .. 254-1]" UBYTE EH_STANDARD_S4_S3 1 100 0 255 ECU_ADDRESS 0xFFF82B53 DISPLAY_IDENTIFIER di_statusOfDTC[27].ZFEH_EepromData /end MEASUREMENT
/begin MEASUREMENT ZFEH_EepromData.di_statusOfDTC[28] "status of DTC of error code [0 .. 254-1]" UBYTE EH_STANDARD_S4_S3 1 100 0 255 ECU_ADDRESS 0xFFF82B54 DISPLAY_IDENTIFIER di_statusOfDTC[28].ZFEH_EepromData /end MEASUREMENT
/begin MEASUREMENT ZFEH_EepromData.di_statusOfDTC[29] "status of DTC of error code [0 .. 254-1]" UBYTE EH_STANDARD_S4_S3 1 100 0 255 ECU_ADDRESS 0xFFF82B55 DISPLAY_IDENTIFIER di_statusOfDTC[29].ZFEH_EepromData /end MEASUREMENT
/begin MEASUREMENT ZFEH_EepromData.di_statusOfDTC[2] "status of DTC of error code [0 .. 254-1]" UBYTE EH_STANDARD_S4_S3 1 100 0 255 ECU_ADDRESS 0xFFF82B3A DISPLAY_IDENTIFIER di_statusOfDTC[2].ZFEH_EepromData /end MEASUREMENT
/begin MEASUREMENT ZFEH_EepromData.di_statusOfDTC[30] "status of DTC of error code [0 .. 254-1]" UBYTE EH_STANDARD_S4_S3 1 100 0 255 ECU_ADDRESS 0xFFF82B56 DISPLAY_IDENTIFIER di_statusOfDTC[30].ZFEH_EepromData /end MEASUREMENT
/begin MEASUREMENT ZFEH_EepromData.di_statusOfDTC[31] "status of DTC of error code [0 .. 254-1]" UBYTE EH_STANDARD_S4_S3 1 100 0 255 ECU_ADDRESS 0xFFF82B57 DISPLAY_IDENTIFIER di_statusOfDTC[31].ZFEH_EepromData /end MEASUREMENT
/begin MEASUREMENT ZFEH_EepromData.di_statusOfDTC[32] "status of DTC of error code [0 .. 254-1]" UBYTE EH_STANDARD_S4_S3 1 100 0 255 ECU_ADDRESS 0xFFF82B58 DISPLAY_IDENTIFIER di_statusOfDTC[32].ZFEH_EepromData /end MEASUREMENT
/begin MEASUREMENT ZFEH_EepromData.di_statusOfDTC[33] "status of DTC of error code [0 .. 254-1]" UBYTE EH_STANDARD_S4_S3 1 100 0 255 ECU_ADDRESS 0xFFF82B59 DISPLAY_IDENTIFIER di_statusOfDTC[33].ZFEH_EepromData /end MEASUREMENT
/begin MEASUREMENT ZFEH_EepromData.di_statusOfDTC[34] "status of DTC of error code [0 .. 254-1]" UBYTE EH_STANDARD_S4_S3 1 100 0 255 ECU_ADDRESS 0xFFF82B5A DISPLAY_IDENTIFIER di_statusOfDTC[34].ZFEH_EepromData /end MEASUREMENT
/begin MEASUREMENT ZFEH_EepromData.di_statusOfDTC[35] "status of DTC of error code [0 .. 254-1]" UBYTE EH_STANDARD_S4_S3 1 100 0 255 ECU_ADDRESS 0xFFF82B5B DISPLAY_IDENTIFIER di_statusOfDTC[35].ZFEH_EepromData /end MEASUREMENT
/begin MEASUREMENT ZFEH_EepromData.di_statusOfDTC[36] "status of DTC of error code [0 .. 254-1]" UBYTE EH_STANDARD_S4_S3 1 100 0 255 ECU_ADDRESS 0xFFF82B5C DISPLAY_IDENTIFIER di_statusOfDTC[36].ZFEH_EepromData /end MEASUREMENT
/begin MEASUREMENT ZFEH_EepromData.di_statusOfDTC[37] "status of DTC of error code [0 .. 254-1]" UBYTE EH_STANDARD_S4_S3 1 100 0 255 ECU_ADDRESS 0xFFF82B5D DISPLAY_IDENTIFIER di_statusOfDTC[37].ZFEH_EepromData /end MEASUREMENT
/begin MEASUREMENT ZFEH_EepromData.di_statusOfDTC[38] "status of DTC of error code [0 .. 254-1]" UBYTE EH_STANDARD_S4_S3 1 100 0 255 ECU_ADDRESS 0xFFF82B5E DISPLAY_IDENTIFIER di_statusOfDTC[38].ZFEH_EepromData /end MEASUREMENT
/begin MEASUREMENT ZFEH_EepromData.di_statusOfDTC[39] "status of DTC of error code [0 .. 254-1]" UBYTE EH_STANDARD_S4_S3 1 100 0 255 ECU_ADDRESS 0xFFF82B5F DISPLAY_IDENTIFIER di_statusOfDTC[39].ZFEH_EepromData /end MEASUREMENT
/begin MEASUREMENT ZFEH_EepromData.di_statusOfDTC[3] "status of DTC of error code [0 .. 254-1]" UBYTE EH_STANDARD_S4_S3 1 100 0 255 ECU_ADDRESS 0xFFF82B3B DISPLAY_IDENTIFIER di_statusOfDTC[3].ZFEH_EepromData /end MEASUREMENT
/begin MEASUREMENT ZFEH_EepromData.di_statusOfDTC[40] "status of DTC of error code [0 .. 254-1]" UBYTE EH_STANDARD_S4_S3 1 100 0 255 ECU_ADDRESS 0xFFF82B60 DISPLAY_IDENTIFIER di_statusOfDTC[40].ZFEH_EepromData /end MEASUREMENT
/begin MEASUREMENT ZFEH_EepromData.di_statusOfDTC[41] "status of DTC of error code [0 .. 254-1]" UBYTE EH_STANDARD_S4_S3 1 100 0 255 ECU_ADDRESS 0xFFF82B61 DISPLAY_IDENTIFIER di_statusOfDTC[41].ZFEH_EepromData /end MEASUREMENT
/begin MEASUREMENT ZFEH_EepromData.di_statusOfDTC[42] "status of DTC of error code [0 .. 254-1]" UBYTE EH_STANDARD_S4_S3 1 100 0 255 ECU_ADDRESS 0xFFF82B62 DISPLAY_IDENTIFIER di_statusOfDTC[42].ZFEH_EepromData /end MEASUREMENT
/begin MEASUREMENT ZFEH_EepromData.di_statusOfDTC[43] "status of DTC of error code [0 .. 254-1]" UBYTE EH_STANDARD_S4_S3 1 100 0 255 ECU_ADDRESS 0xFFF82B63 DISPLAY_IDENTIFIER di_statusOfDTC[43].ZFEH_EepromData /end MEASUREMENT
/begin MEASUREMENT ZFEH_EepromData.di_statusOfDTC[44] "status of DTC of error code [0 .. 254-1]" UBYTE EH_STANDARD_S4_S3 1 100 0 255 ECU_ADDRESS 0xFFF82B64 DISPLAY_IDENTIFIER di_statusOfDTC[44].ZFEH_EepromData /end MEASUREMENT
/begin MEASUREMENT ZFEH_EepromData.di_statusOfDTC[45] "status of DTC of error code [0 .. 254-1]" UBYTE EH_STANDARD_S4_S3 1 100 0 255 ECU_ADDRESS 0xFFF82B65 DISPLAY_IDENTIFIER di_statusOfDTC[45].ZFEH_EepromData /end MEASUREMENT
/begin MEASUREMENT ZFEH_EepromData.di_statusOfDTC[46] "status of DTC of error code [0 .. 254-1]" UBYTE EH_STANDARD_S4_S3 1 100 0 255 ECU_ADDRESS 0xFFF82B66 DISPLAY_IDENTIFIER di_statusOfDTC[46].ZFEH_EepromData /end MEASUREMENT
/begin MEASUREMENT ZFEH_EepromData.di_statusOfDTC[47] "status of DTC of error code [0 .. 254-1]" UBYTE EH_STANDARD_S4_S3 1 100 0 255 ECU_ADDRESS 0xFFF82B67 DISPLAY_IDENTIFIER di_statusOfDTC[47].ZFEH_EepromData /end MEASUREMENT
/begin MEASUREMENT ZFEH_EepromData.di_statusOfDTC[48] "status of DTC of error code [0 .. 254-1]" UBYTE EH_STANDARD_S4_S3 1 100 0 255 ECU_ADDRESS 0xFFF82B68 DISPLAY_IDENTIFIER di_statusOfDTC[48].ZFEH_EepromData /end MEASUREMENT
/begin MEASUREMENT ZFEH_EepromData.di_statusOfDTC[49] "status of DTC of error code [0 .. 254-1]" UBYTE EH_STANDARD_S4_S3 1 100 0 255 ECU_ADDRESS 0xFFF82B69 DISPLAY_IDENTIFIER di_statusOfDTC[49].ZFEH_EepromData /end MEASUREMENT
/begin MEASUREMENT ZFEH_EepromData.di_statusOfDTC[4] "status of DTC of error code [0 .. 254-1]" UBYTE EH_STANDARD_S4_S3 1 100 0 255 ECU_ADDRESS 0xFFF82B3C DISPLAY_IDENTIFIER di_statusOfDTC[4].ZFEH_EepromData /end MEASUREMENT
/begin MEASUREMENT ZFEH_EepromData.di_statusOfDTC[50] "status of DTC of error code [0 .. 254-1]" UBYTE EH_STANDARD_S4_S3 1 100 0 255 ECU_ADDRESS 0xFFF82B6A DISPLAY_IDENTIFIER di_statusOfDTC[50].ZFEH_EepromData /end MEASUREMENT
/begin MEASUREMENT ZFEH_EepromData.di_statusOfDTC[51] "status of DTC of error code [0 .. 254-1]" UBYTE EH_STANDARD_S4_S3 1 100 0 255 ECU_ADDRESS 0xFFF82B6B DISPLAY_IDENTIFIER di_statusOfDTC[51].ZFEH_EepromData /end MEASUREMENT
/begin MEASUREMENT ZFEH_EepromData.di_statusOfDTC[52] "status of DTC of error code [0 .. 254-1]" UBYTE EH_STANDARD_S4_S3 1 100 0 255 ECU_ADDRESS 0xFFF82B6C DISPLAY_IDENTIFIER di_statusOfDTC[52].ZFEH_EepromData /end MEASUREMENT
/begin MEASUREMENT ZFEH_EepromData.di_statusOfDTC[53] "status of DTC of error code [0 .. 254-1]" UBYTE EH_STANDARD_S4_S3 1 100 0 255 ECU_ADDRESS 0xFFF82B6D DISPLAY_IDENTIFIER di_statusOfDTC[53].ZFEH_EepromData /end MEASUREMENT
/begin MEASUREMENT ZFEH_EepromData.di_statusOfDTC[54] "status of DTC of error code [0 .. 254-1]" UBYTE EH_STANDARD_S4_S3 1 100 0 255 ECU_ADDRESS 0xFFF82B6E DISPLAY_IDENTIFIER di_statusOfDTC[54].ZFEH_EepromData /end MEASUREMENT
/begin MEASUREMENT ZFEH_EepromData.di_statusOfDTC[55] "status of DTC of error code [0 .. 254-1]" UBYTE EH_STANDARD_S4_S3 1 100 0 255 ECU_ADDRESS 0xFFF82B6F DISPLAY_IDENTIFIER di_statusOfDTC[55].ZFEH_EepromData /end MEASUREMENT
/begin MEASUREMENT ZFEH_EepromData.di_statusOfDTC[56] "status of DTC of error code [0 .. 254-1]" UBYTE EH_STANDARD_S4_S3 1 100 0 255 ECU_ADDRESS 0xFFF82B70 DISPLAY_IDENTIFIER di_statusOfDTC[56].ZFEH_EepromData /end MEASUREMENT
/begin MEASUREMENT ZFEH_EepromData.di_statusOfDTC[57] "status of DTC of error code [0 .. 254-1]" UBYTE EH_STANDARD_S4_S3 1 100 0 255 ECU_ADDRESS 0xFFF82B71 DISPLAY_IDENTIFIER di_statusOfDTC[57].ZFEH_EepromData /end MEASUREMENT
/begin MEASUREMENT ZFEH_EepromData.di_statusOfDTC[58] "status of DTC of error code [0 .. 254-1]" UBYTE EH_STANDARD_S4_S3 1 100 0 255 ECU_ADDRESS 0xFFF82B72 DISPLAY_IDENTIFIER di_statusOfDTC[58].ZFEH_EepromData /end MEASUREMENT
/begin MEASUREMENT ZFEH_EepromData.di_statusOfDTC[59] "status of DTC of error code [0 .. 254-1]" UBYTE EH_STANDARD_S4_S3 1 100 0 255 ECU_ADDRESS 0xFFF82B73 DISPLAY_IDENTIFIER di_statusOfDTC[59].ZFEH_EepromData /end MEASUREMENT
/begin MEASUREMENT ZFEH_EepromData.di_statusOfDTC[5] "status of DTC of error code [0 .. 254-1]" UBYTE EH_STANDARD_S4_S3 1 100 0 255 ECU_ADDRESS 0xFFF82B3D DISPLAY_IDENTIFIER di_statusOfDTC[5].ZFEH_EepromData /end MEASUREMENT
/begin MEASUREMENT ZFEH_EepromData.di_statusOfDTC[60] "status of DTC of error code [0 .. 254-1]" UBYTE EH_STANDARD_S4_S3 1 100 0 255 ECU_ADDRESS 0xFFF82B74 DISPLAY_IDENTIFIER di_statusOfDTC[60].ZFEH_EepromData /end MEASUREMENT
/begin MEASUREMENT ZFEH_EepromData.di_statusOfDTC[61] "status of DTC of error code [0 .. 254-1]" UBYTE EH_STANDARD_S4_S3 1 100 0 255 ECU_ADDRESS 0xFFF82B75 DISPLAY_IDENTIFIER di_statusOfDTC[61].ZFEH_EepromData /end MEASUREMENT
/begin MEASUREMENT ZFEH_EepromData.di_statusOfDTC[62] "status of DTC of error code [0 .. 254-1]" UBYTE EH_STANDARD_S4_S3 1 100 0 255 ECU_ADDRESS 0xFFF82B76 DISPLAY_IDENTIFIER di_statusOfDTC[62].ZFEH_EepromData /end MEASUREMENT
/begin MEASUREMENT ZFEH_EepromData.di_statusOfDTC[63] "status of DTC of error code [0 .. 254-1]" UBYTE EH_STANDARD_S4_S3 1 100 0 255 ECU_ADDRESS 0xFFF82B77 DISPLAY_IDENTIFIER di_statusOfDTC[63].ZFEH_EepromData /end MEASUREMENT
/begin MEASUREMENT ZFEH_EepromData.di_statusOfDTC[64] "status of DTC of error code [0 .. 254-1]" UBYTE EH_STANDARD_S4_S3 1 100 0 255 ECU_ADDRESS 0xFFF82B78 DISPLAY_IDENTIFIER di_statusOfDTC[64].ZFEH_EepromData /end MEASUREMENT
/begin MEASUREMENT ZFEH_EepromData.di_statusOfDTC[65] "status of DTC of error code [0 .. 254-1]" UBYTE EH_STANDARD_S4_S3 1 100 0 255 ECU_ADDRESS 0xFFF82B79 DISPLAY_IDENTIFIER di_statusOfDTC[65].ZFEH_EepromData /end MEASUREMENT
/begin MEASUREMENT ZFEH_EepromData.di_statusOfDTC[66] "status of DTC of error code [0 .. 254-1]" UBYTE EH_STANDARD_S4_S3 1 100 0 255 ECU_ADDRESS 0xFFF82B7A DISPLAY_IDENTIFIER di_statusOfDTC[66].ZFEH_EepromData /end MEASUREMENT
/begin MEASUREMENT ZFEH_EepromData.di_statusOfDTC[67] "status of DTC of error code [0 .. 254-1]" UBYTE EH_STANDARD_S4_S3 1 100 0 255 ECU_ADDRESS 0xFFF82B7B DISPLAY_IDENTIFIER di_statusOfDTC[67].ZFEH_EepromData /end MEASUREMENT
/begin MEASUREMENT ZFEH_EepromData.di_statusOfDTC[68] "status of DTC of error code [0 .. 254-1]" UBYTE EH_STANDARD_S4_S3 1 100 0 255 ECU_ADDRESS 0xFFF82B7C DISPLAY_IDENTIFIER di_statusOfDTC[68].ZFEH_EepromData /end MEASUREMENT
/begin MEASUREMENT ZFEH_EepromData.di_statusOfDTC[69] "status of DTC of error code [0 .. 254-1]" UBYTE EH_STANDARD_S4_S3 1 100 0 255 ECU_ADDRESS 0xFFF82B7D DISPLAY_IDENTIFIER di_statusOfDTC[69].ZFEH_EepromData /end MEASUREMENT
/begin MEASUREMENT ZFEH_EepromData.di_statusOfDTC[6] "status of DTC of error code [0 .. 254-1]" UBYTE EH_STANDARD_S4_S3 1 100 0 255 ECU_ADDRESS 0xFFF82B3E DISPLAY_IDENTIFIER di_statusOfDTC[6].ZFEH_EepromData /end MEASUREMENT
/begin MEASUREMENT ZFEH_EepromData.di_statusOfDTC[70] "status of DTC of error code [0 .. 254-1]" UBYTE EH_STANDARD_S4_S3 1 100 0 255 ECU_ADDRESS 0xFFF82B7E DISPLAY_IDENTIFIER di_statusOfDTC[70].ZFEH_EepromData /end MEASUREMENT
/begin MEASUREMENT ZFEH_EepromData.di_statusOfDTC[71] "status of DTC of error code [0 .. 254-1]" UBYTE EH_STANDARD_S4_S3 1 100 0 255 ECU_ADDRESS 0xFFF82B7F DISPLAY_IDENTIFIER di_statusOfDTC[71].ZFEH_EepromData /end MEASUREMENT
/begin MEASUREMENT ZFEH_EepromData.di_statusOfDTC[72] "status of DTC of error code [0 .. 254-1]" UBYTE EH_STANDARD_S4_S3 1 100 0 255 ECU_ADDRESS 0xFFF82B80 DISPLAY_IDENTIFIER di_statusOfDTC[72].ZFEH_EepromData /end MEASUREMENT
/begin MEASUREMENT ZFEH_EepromData.di_statusOfDTC[73] "status of DTC of error code [0 .. 254-1]" UBYTE EH_STANDARD_S4_S3 1 100 0 255 ECU_ADDRESS 0xFFF82B81 DISPLAY_IDENTIFIER di_statusOfDTC[73].ZFEH_EepromData /end MEASUREMENT
/begin MEASUREMENT ZFEH_EepromData.di_statusOfDTC[74] "status of DTC of error code [0 .. 254-1]" UBYTE EH_STANDARD_S4_S3 1 100 0 255 ECU_ADDRESS 0xFFF82B82 DISPLAY_IDENTIFIER di_statusOfDTC[74].ZFEH_EepromData /end MEASUREMENT
/begin MEASUREMENT ZFEH_EepromData.di_statusOfDTC[75] "status of DTC of error code [0 .. 254-1]" UBYTE EH_STANDARD_S4_S3 1 100 0 255 ECU_ADDRESS 0xFFF82B83 DISPLAY_IDENTIFIER di_statusOfDTC[75].ZFEH_EepromData /end MEASUREMENT
/begin MEASUREMENT ZFEH_EepromData.di_statusOfDTC[76] "status of DTC of error code [0 .. 254-1]" UBYTE EH_STANDARD_S4_S3 1 100 0 255 ECU_ADDRESS 0xFFF82B84 DISPLAY_IDENTIFIER di_statusOfDTC[76].ZFEH_EepromData /end MEASUREMENT
/begin MEASUREMENT ZFEH_EepromData.di_statusOfDTC[77] "status of DTC of error code [0 .. 254-1]" UBYTE EH_STANDARD_S4_S3 1 100 0 255 ECU_ADDRESS 0xFFF82B85 DISPLAY_IDENTIFIER di_statusOfDTC[77].ZFEH_EepromData /end MEASUREMENT
/begin MEASUREMENT ZFEH_EepromData.di_statusOfDTC[78] "status of DTC of error code [0 .. 254-1]" UBYTE EH_STANDARD_S4_S3 1 100 0 255 ECU_ADDRESS 0xFFF82B86 DISPLAY_IDENTIFIER di_statusOfDTC[78].ZFEH_EepromData /end MEASUREMENT
/begin MEASUREMENT ZFEH_EepromData.di_statusOfDTC[79] "status of DTC of error code [0 .. 254-1]" UBYTE EH_STANDARD_S4_S3 1 100 0 255 ECU_ADDRESS 0xFFF82B87 DISPLAY_IDENTIFIER di_statusOfDTC[79].ZFEH_EepromData /end MEASUREMENT
/begin MEASUREMENT ZFEH_EepromData.di_statusOfDTC[7] "status of DTC of error code [0 .. 254-1]" UBYTE EH_STANDARD_S4_S3 1 100 0 255 ECU_ADDRESS 0xFFF82B3F DISPLAY_IDENTIFIER di_statusOfDTC[7].ZFEH_EepromData /end MEASUREMENT
/begin MEASUREMENT ZFEH_EepromData.di_statusOfDTC[80] "status of DTC of error code [0 .. 254-1]" UBYTE EH_STANDARD_S4_S3 1 100 0 255 ECU_ADDRESS 0xFFF82B88 DISPLAY_IDENTIFIER di_statusOfDTC[80].ZFEH_EepromData /end MEASUREMENT
/begin MEASUREMENT ZFEH_EepromData.di_statusOfDTC[81] "status of DTC of error code [0 .. 254-1]" UBYTE EH_STANDARD_S4_S3 1 100 0 255 ECU_ADDRESS 0xFFF82B89 DISPLAY_IDENTIFIER di_statusOfDTC[81].ZFEH_EepromData /end MEASUREMENT
/begin MEASUREMENT ZFEH_EepromData.di_statusOfDTC[82] "status of DTC of error code [0 .. 254-1]" UBYTE EH_STANDARD_S4_S3 1 100 0 255 ECU_ADDRESS 0xFFF82B8A DISPLAY_IDENTIFIER di_statusOfDTC[82].ZFEH_EepromData /end MEASUREMENT
/begin MEASUREMENT ZFEH_EepromData.di_statusOfDTC[83] "status of DTC of error code [0 .. 254-1]" UBYTE EH_STANDARD_S4_S3 1 100 0 255 ECU_ADDRESS 0xFFF82B8B DISPLAY_IDENTIFIER di_statusOfDTC[83].ZFEH_EepromData /end MEASUREMENT
/begin MEASUREMENT ZFEH_EepromData.di_statusOfDTC[84] "status of DTC of error code [0 .. 254-1]" UBYTE EH_STANDARD_S4_S3 1 100 0 255 ECU_ADDRESS 0xFFF82B8C DISPLAY_IDENTIFIER di_statusOfDTC[84].ZFEH_EepromData /end MEASUREMENT
/begin MEASUREMENT ZFEH_EepromData.di_statusOfDTC[85] "status of DTC of error code [0 .. 254-1]" UBYTE EH_STANDARD_S4_S3 1 100 0 255 ECU_ADDRESS 0xFFF82B8D DISPLAY_IDENTIFIER di_statusOfDTC[85].ZFEH_EepromData /end MEASUREMENT
/begin MEASUREMENT ZFEH_EepromData.di_statusOfDTC[86] "status of DTC of error code [0 .. 254-1]" UBYTE EH_STANDARD_S4_S3 1 100 0 255 ECU_ADDRESS 0xFFF82B8E DISPLAY_IDENTIFIER di_statusOfDTC[86].ZFEH_EepromData /end MEASUREMENT
/end MODULE
/end PROJECT
