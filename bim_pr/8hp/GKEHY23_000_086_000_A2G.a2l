ASAP2_VERSION 1 51
/begin PROJECT ZHBC8600 "Gen2_BMW_System_Supplier_Lib"
/begin MODULE CPP ""
/begin MOD_COMMON "" BYTE_ORDER MSB_FIRST ALIGNMENT_BYTE 1 ALIGNMENT_WORD 2 ALIGNMENT_LONG 4 ALIGNMENT_FLOAT32_IEEE 4 ALIGNMENT_FLOAT64_IEEE 1 /end MOD_COMMON
/begin COMPU_VTAB _CNV_S_2_Enum_EFLAN_268_S2 "" TAB_VERB 2 0 "Steigend_oder_Gleich" 1 "Fallend" DEFAULT_VALUE "" /end COMPU_VTAB
/begin COMPU_VTAB _CNV_S_2_Enum_EMINM_258_S2 "" TAB_VERB 2 0 "MIN_NAB" 1 "MAX_NAB" DEFAULT_VALUE "" /end COMPU_VTAB
/begin COMPU_VTAB B_TRUE_S1 "boolean states, positive logic" TAB_VERB 2 0 "FALSE" 1 "TRUE" DEFAULT_VALUE "xxxxx" /end COMPU_VTAB
/begin COMPU_VTAB CanNmAppl_stBcTxA_t_M "" TAB_VERB 2 0 "CANNM_BCTXA_DISABLED" 1 "CANNM_BCTXA_ENABLED" DEFAULT_VALUE "xxxxx" /end COMPU_VTAB
/begin COMPU_VTAB Nm_StateType_t_M "" TAB_VERB 5 0 "NM_STATE_BUS_SLEEP" 1 "NM_STATE_PREPARE_BUS_SLEEP" 2 "NM_STATE_READY_SLEEP" 3 "NM_STATE_NORMAL_OPERATION" 4 "NM_STATE_REPEAT_MESSAGE" DEFAULT_VALUE "xxxxx" /end COMPU_VTAB
/begin COMPU_VTAB Q_SIG_S1 "signal quality information" TAB_VERB 9 0 "init" 1 "not_available" 2 "no_source" 3 "fix" 4 "fix_source" 5 "model_based" 6 "diff_source" 7 "ok_disturbed" 8 "ok" DEFAULT_VALUE "xxxxx" /end COMPU_VTAB
/begin COMPU_VTAB X_ASCII_M "BYTE to ASCII" TAB_VERB 86 32 " " 33 "!" 35 "#" 36 "$" 37 "%" 38 "&" 40 "(" 41 ")" 42 "*" 43 "+" 45 "-" 46 "." 47 "/" 48 "0" 49 "1" 50 "2" 51 "3" 52 "4" 53 "5" 54 "6" 55 "7" 56 "8" 57 "9" 58 ":" 59 ";" 60 "<" 61 "=" 62 ">" 63 "?" 64 "@" 65 "A" 66 "B" 67 "C" 68 "D" 69 "E" 70 "F" 71 "G" 72 "H" 73 "I" 74 "J" 75 "K" 76 "L" 77 "M" 78 "N" 79 "O" 80 "P" 81 "Q" 82 "R" 83 "S" 84 "T" 85 "U" 86 "V" 87 "W" 88 "X" 89 "Y" 90 "Z" 91 "[" 93 "]" 96 "a" 97 "b" 98 "c" 99 "d" 100 "e" 101 "f" 102 "g" 103 "h" 104 "i" 105 "j" 106 "k" 107 "l" 108 "m" 109 "n" 110 "o" 111 "p" 112 "q" 113 "r" 114 "s" 115 "t" 116 "u" 117 "v" 118 "w" 119 "x" 120 "y" 121 "z" 123 "{" 125 "}" DEFAULT_VALUE "_" /end COMPU_VTAB
/begin COMPU_METHOD _CNV_R_R_Umr_freq_143_CM_S2 "" RAT_FUNC "%6.3" "Hz" COEFFS 0 1 0 0 0 1 /end COMPU_METHOD
/begin COMPU_METHOD _CNV_R_R_Umr_trmp_145_CM_S2 "" RAT_FUNC "%6.3" "trmp" COEFFS 0 16 0 0 0 1 /end COMPU_METHOD
/begin COMPU_METHOD _CNV_S_2_Enum_EFLAN_268_CM_S2 "" TAB_VERB "%6.3" "" COMPU_TAB_REF _CNV_S_2_Enum_EFLAN_268_S2 /end COMPU_METHOD
/begin COMPU_METHOD _CNV_S_2_Enum_EMINM_258_CM_S2 "" TAB_VERB "%6.3" "" COMPU_TAB_REF _CNV_S_2_Enum_EMINM_258_S2 /end COMPU_METHOD
/begin COMPU_METHOD B_TRUE_S1 "boolean states, positive logic" TAB_VERB "%6.3" "" COMPU_TAB_REF B_TRUE_S1 /end COMPU_METHOD
/begin COMPU_METHOD CanNmAppl_stBcTxA_t_M "" TAB_VERB "%6.3" "" COMPU_TAB_REF CanNmAppl_stBcTxA_t_M /end COMPU_METHOD
/begin COMPU_METHOD I0_0001_S1 "[0.0001A] current" RAT_FUNC "%7.6" "A" COEFFS 0 10000 0 0 0 1 /end COMPU_METHOD
/begin COMPU_METHOD Nm_StateType_t_M "" TAB_VERB "%6.3" "" COMPU_TAB_REF Nm_StateType_t_M /end COMPU_METHOD
/begin COMPU_METHOD Q_SIG_S1 "signal quality information" TAB_VERB "%6.3" "" COMPU_TAB_REF Q_SIG_S1 /end COMPU_METHOD
/begin COMPU_METHOD R0_0001_S1 "[0.0001]" RAT_FUNC "%7.6" "" COEFFS 0 10000 0 0 0 1 /end COMPU_METHOD
/begin COMPU_METHOD R0_001_S1 "[0.001]" RAT_FUNC "%6.5" "" COEFFS 0 1000 0 0 0 1 /end COMPU_METHOD
/begin COMPU_METHOD R0_1_P_S1 "[0.1%]" RAT_FUNC "%6.3" "%" COEFFS 0 10 0 0 0 1 /end COMPU_METHOD
/begin COMPU_METHOD RES0_001_S1 "[0.001ohm] resistance" RAT_FUNC "%6.5" "Ohm" COEFFS 0 1000 0 0 0 1 /end COMPU_METHOD
/begin COMPU_METHOD T0_0078125_S1 "[0.0078125°C] temperature" RAT_FUNC "%6.4" "°C" COEFFS 0 128 0 0 0 1 /end COMPU_METHOD
/begin COMPU_METHOD T0_0625_S1 "[0.0625°C] temperature" RAT_FUNC "%6.4" "°C" COEFFS 0 16 0 0 0 1 /end COMPU_METHOD
/begin COMPU_METHOD T1_OFFS_40_S1 "[1°C -40°C] temperature" RAT_FUNC "%6.2" "°C" COEFFS 0 1 40 0 0 1 /end COMPU_METHOD
/begin COMPU_METHOD TI0_00025_M_S1 "[0.00025ms] time" RAT_FUNC "%6.5" "ms" COEFFS 0 4000 0 0 0 1 /end COMPU_METHOD
/begin COMPU_METHOD TI0_001_M_S1 "[0.001ms] time" RAT_FUNC "%6.5" "ms" COEFFS 0 1000 0 0 0 1 /end COMPU_METHOD
/begin COMPU_METHOD TI0_001_S1 "[0.001s] time" RAT_FUNC "%6.5" "s" COEFFS 0 1000 0 0 0 1 /end COMPU_METHOD
/begin COMPU_METHOD TI0_01_M "[0.01s] time" RAT_FUNC "%6.4" "s" COEFFS 0 100 0 0 0 1 /end COMPU_METHOD
/begin COMPU_METHOD TI0_1_H_S1 "[0.1h] time" RAT_FUNC "%6.3" "h" COEFFS 0 10 0 0 0 1 /end COMPU_METHOD
/begin COMPU_METHOD TI0_1_M "[0.1s] time" RAT_FUNC "%6.3" "s" COEFFS 0 10 0 0 0 1 /end COMPU_METHOD
/begin COMPU_METHOD TI1_CYCLE_M "[0.1s] resolution in multiples of 100ms task" RAT_FUNC "%6.3" "s" COEFFS 0 10 0 0 0 1 /end COMPU_METHOD
/begin COMPU_METHOD TI1_CYCLE_S1 "[0.1s] resolution in multiples of 100ms task" RAT_FUNC "%6.3" "s" COEFFS 0 10 0 0 0 1 /end COMPU_METHOD
/begin COMPU_METHOD TI1_H_S1 "[0.1h] time" RAT_FUNC "%6.2" "h" COEFFS 0 1 0 0 0 1 /end COMPU_METHOD
/begin COMPU_METHOD TI1_M "[1s] time" RAT_FUNC "%6.2" "s" COEFFS 0 1 0 0 0 1 /end COMPU_METHOD
/begin COMPU_METHOD TI1_M_CYCLE_M "[ms] resolution in multiples of main task (time*ROS_NUM_MNTSK_100MS_SY/100.0ms)" RAT_FUNC "%6.2" "ms" COEFFS 0 0.2 0 0 0 1 /end COMPU_METHOD
/begin COMPU_METHOD TI1_M_CYCLE_S1 "[ms] resolution in multiples of main task (time*ROS_NUM_MNTSK_100MS_SY/100.0ms)" RAT_FUNC "%6.2" "ms" COEFFS 0 0.2 0 0 0 1 /end COMPU_METHOD
/begin COMPU_METHOD TI1_M_S1 "[1ms] time" RAT_FUNC "%6.2" "ms" COEFFS 0 1 0 0 0 1 /end COMPU_METHOD
/begin COMPU_METHOD TI1_MIN_S1 "[min] time" RAT_FUNC "%6.2" "min" COEFFS 0 1 0 0 0 1 /end COMPU_METHOD
/begin COMPU_METHOD TI1_S1 "[1s] time" RAT_FUNC "%6.2" "s" COEFFS 0 1 0 0 0 1 /end COMPU_METHOD
/begin COMPU_METHOD TI1_U_S1 "[1µs] time" RAT_FUNC "%6.2" "µs" COEFFS 0 1 0 0 0 1 /end COMPU_METHOD
/begin COMPU_METHOD U0_001_M "[0.001V] voltage" RAT_FUNC "%6.5" "V" COEFFS 0 1000 0 0 0 1 /end COMPU_METHOD
/begin COMPU_METHOD U0_001_S1 "[0.001V] voltage" RAT_FUNC "%6.5" "V" COEFFS 0 1000 0 0 0 1 /end COMPU_METHOD
/begin COMPU_METHOD X1_M "[1] no unit" RAT_FUNC "%6.2" "" COEFFS 0 1 0 0 0 1 /end COMPU_METHOD
/begin COMPU_METHOD X1_S1 "[1] no unit" RAT_FUNC "%6.2" "" COEFFS 0 1 0 0 0 1 /end COMPU_METHOD
/begin COMPU_METHOD X_ASCII_M "BYTE to ASCII" TAB_VERB "%6.3" "" COMPU_TAB_REF X_ASCII_M /end COMPU_METHOD
/begin CHARACTERISTIC AtfPrfl_qtAtfMin_C "F9306: Minimum quality for undisturbed ATF temperature (no SERAP)" VALUE 0x1918E4 AblGLKWub_S1 8 Q_SIG_S1 0 8 FORMAT "%13.11" /end CHARACTERISTIC
/begin CHARACTERISTIC AtfPrfl_tAtf_C "F9306: ATF temperature profile thresholds (no SERAP)" VAL_BLK 0x1914E8 AblGLKWBsw_S1 210 T0_0625_S1 -40 170 MATRIX_DIM 11 1 1 FORMAT "%8.4" /end CHARACTERISTIC
/begin MEASUREMENT AtfPrfl_tMax "F9306: Maximum undisturbed temperature seen" SWORD T0_0625_S1 1 100 -40 170 ECU_ADDRESS 0xFFF9346C FORMAT "%8.4" /end MEASUREMENT
/begin MEASUREMENT AtfPrfl_ti "F9306: Array for ATF temperature profile, highest index used for disturbed temperatures" ULONG TI1_S1 1 100 0 4294967295 ECU_ADDRESS 0xFFF92B74 FORMAT "%13.2" MATRIX_DIM 13 1 1 /end MEASUREMENT
/begin MEASUREMENT AtfPrfl_tiBuf "F9306: ATF temperature counter intermediate buffer" UWORD TI1_M_S1 1 100 0 65535 ECU_ADDRESS 0xFFF9346A FORMAT "%8.2" /end MEASUREMENT
/begin MEASUREMENT CAN_tiPowerup "F9175: CAN Powerup Check timer" UBYTE TI1_M_CYCLE_M 1 100 0 1275 ECU_ADDRESS 0xFFF94225 FORMAT "%5.0" /end MEASUREMENT
/begin CHARACTERISTIC CAN_tiPowerup_C "F9175: Maximal delay between SW initialization and GET_IGNITION returning ON after powerup." VALUE 0x1918C9 AblGLKWub_M 1275 TI1_M_CYCLE_M 0 1275 FORMAT "%5.0" /end CHARACTERISTIC
/begin CHARACTERISTIC COM_swtICFshPrg_C "F4100: calibration switch to enable the InCircuit flash programming in MP devices" VALUE 0x1918C7 AblGLKWub_M 255 X1_M 0 255 FORMAT "%5.1" /end CHARACTERISTIC
/begin MEASUREMENT COM_xBbRefId "F9260: Systemhouse identifier for test only, BB version. 8 characters ASCII" UBYTE X_ASCII_M 1 100 32 125 ECU_ADDRESS 0xFFF90988 FORMAT "%13.9" MATRIX_DIM 8 1 1 /end MEASUREMENT
/begin MEASUREMENT COM_xBcRefId "F9260: Systemhouse identifier for test only, BC version. 8 characters ASCII" UBYTE X_ASCII_M 1 100 32 125 ECU_ADDRESS 0xFFF90990 FORMAT "%13.9" MATRIX_DIM 8 1 1 /end MEASUREMENT
/begin MEASUREMENT COM_xPrgRefIdMeas "F9260: Systemhouse identifier for test only, name. 8 characters ASCII" UBYTE X_ASCII_M 1 100 32 125 ECU_ADDRESS 0xFFF8400C FORMAT "%13.9" MATRIX_DIM 8 1 1 /end MEASUREMENT
/begin MEASUREMENT COM_xPrgVersMeas "F9260: Systemhouse identifier for test only, build version. 8 characters ASCII" UBYTE X_ASCII_M 1 100 32 125 ECU_ADDRESS 0xFFF84014 FORMAT "%13.9" MATRIX_DIM 8 1 1 /end MEASUREMENT
/begin MEASUREMENT COM_xSbRefId "F9260: Systemhouse identifier for test only, SB Version. 8 characters ASCII" UBYTE X_ASCII_M 1 100 32 125 ECU_ADDRESS 0xFFF90980 FORMAT "%13.9" MATRIX_DIM 8 1 1 /end MEASUREMENT
/begin MEASUREMENT CPUID_stChip "F2635: CPU info: B0:emul,B23:0=150nm,1=90nm, B5:old-EE, B7:missing-ID" UBYTE X1_S1 1 100 0 255 ECU_ADDRESS 0xFFF9412D FORMAT "%5.1" /end MEASUREMENT
/begin MEASUREMENT CPUID_stSize "F2635: CPU size info: B01:RAM 0=64k,1=128k,2=176k,3=256k, B23:0=CAN-AB,1=ABC,2=ABCD, B45:ROM 0=1-2MB,1=2-3MB,2=3-4MB, B6:Flexr B7:EE 0=4*8k,1=16*8k" UBYTE X1_S1 1 100 0 255 ECU_ADDRESS 0xFFF9412E FORMAT "%5.1" /end MEASUREMENT
/begin MEASUREMENT CPU_bPbusClk "F2635: P-Bus Clock setting (0=20MHz, 1=40MHz)" UBYTE X1_S1 1 100 0 255 ECU_ADDRESS 0xFFF94130 FORMAT "%5.1" /end MEASUREMENT
/begin MEASUREMENT CPU_numSel "F2635: CPU variant information: 0=undef 1=SH7251x (150nm), 2=SH7254x (90nm)" UBYTE X1_S1 1 100 0 255 ECU_ADDRESS 0xFFF9412F FORMAT "%5.1" /end MEASUREMENT
/begin MEASUREMENT CanA_EwsMsgRx "Cyclic buffer for EWS CAN frames received on A CAN" UBYTE X1_M 1 100 0 255 ECU_ADDRESS 0xFFF937E0 FORMAT "%5.1" MATRIX_DIM 179 1 1 /end MEASUREMENT
/begin MEASUREMENT CanA_stEwsRx "State of EWS reception on A CAN" UBYTE X1_M 1 100 0 255 ECU_ADDRESS 0xFFF93A1B FORMAT "%5.1" /end MEASUREMENT
/begin MEASUREMENT CanFA_EwsMsgRx "Cyclic buffer for EWS CAN frames received on FA CAN" UBYTE X1_M 1 100 0 255 ECU_ADDRESS 0xFFF93893 FORMAT "%5.1" MATRIX_DIM 179 1 1 /end MEASUREMENT
/begin MEASUREMENT CanFA_stEwsRx "State of EWS reception on FA CAN" UBYTE X1_M 1 100 0 255 ECU_ADDRESS 0xFFF93A1C FORMAT "%5.1" /end MEASUREMENT
/begin MEASUREMENT CanNmAppl_var_s[0].msgCnt_RxIndication_u16 "CanNmAppl_var_s / msg counter for Rx Indication of CanNm PDUs" UWORD X1_M 1 100 0 65535 ECU_ADDRESS 0xFFF92080 FORMAT "%8.2" /end MEASUREMENT
/begin MEASUREMENT CanNmAppl_var_s[0].msgCnt_TxConfirmation_u16 "CanNmAppl_var_s / msg counter for confirmed transmission of own CanNm PDUs" UWORD X1_M 1 100 0 65535 ECU_ADDRESS 0xFFF9207E FORMAT "%8.2" /end MEASUREMENT
/begin MEASUREMENT CanNmAppl_var_s[0].stBcTxA "CanNmAppl_var_s / Confirmation of Bus Communication state (Tx of Appl messages enabled/disabled)" UBYTE CanNmAppl_stBcTxA_t_M 1 100 0 1 ECU_ADDRESS 0xFFF9207C FORMAT "%13.11" /end MEASUREMENT
/begin MEASUREMENT CanNmAppl_var_s[1].msgCnt_RxIndication_u16 "CanNmAppl_var_s / msg counter for Rx Indication of CanNm PDUs" UWORD X1_M 1 100 0 65535 ECU_ADDRESS 0xFFF92086 FORMAT "%8.2" /end MEASUREMENT
/begin MEASUREMENT CanNmAppl_var_s[1].msgCnt_TxConfirmation_u16 "CanNmAppl_var_s / msg counter for confirmed transmission of own CanNm PDUs" UWORD X1_M 1 100 0 65535 ECU_ADDRESS 0xFFF92084 FORMAT "%8.2" /end MEASUREMENT
/begin MEASUREMENT CanNmAppl_var_s[1].stBcTxA "CanNmAppl_var_s / Confirmation of Bus Communication state (Tx of Appl messages enabled/disabled)" UBYTE CanNmAppl_stBcTxA_t_M 1 100 0 1 ECU_ADDRESS 0xFFF92082 FORMAT "%13.11" /end MEASUREMENT
/begin MEASUREMENT CanNm_var_s[0].dRxUserData_u8 "CanNm_var_s (implementation in generated c-source in cannm_auto_conf.c) / copy of received user data" UBYTE X1_M 1 100 0 255 ECU_ADDRESS 0xFFF927A0 FORMAT "%5.1" MATRIX_DIM 4 1 1 /end MEASUREMENT
/begin MEASUREMENT CanNm_var_s[0].dSendBuffer_s "CanNm_var_s (implementation in generated c-source in cannm_auto_conf.c) / buffer for transmission data" UBYTE X1_M 1 100 0 255 ECU_ADDRESS 0xFFF927A4 FORMAT "%5.1" MATRIX_DIM 7 1 1 /end MEASUREMENT
/begin MEASUREMENT CanNm_var_s[0].numNodeIdOfLastMsg "CanNm_var_s (implementation in generated c-source in cannm_auto_conf.c) / node id of last received NM-message" UBYTE X1_M 1 100 0 255 ECU_ADDRESS 0xFFF927AB FORMAT "%5.1" /end MEASUREMENT
/begin MEASUREMENT CanNm_var_s[0].stCanNmFlags_b32 "CanNm_var_s (implementation in generated c-source in cannm_auto_conf.c) / status flags for CanNm" ULONG X1_M 1 100 0 4294967295 ECU_ADDRESS 0xFFF9279C FORMAT "%13.2" /end MEASUREMENT
/begin MEASUREMENT CanNm_var_s[0].tiMsgCycleTime_Offset_u32 "CanNm_var_s (implementation in generated c-source in cannm_auto_conf.c) / ticks with MsgCycleTime+CycleOffset" ULONG X1_M 1 100 0 4294967295 ECU_ADDRESS 0xFFF92798 FORMAT "%13.2" /end MEASUREMENT
/begin MEASUREMENT CanNm_var_s[0].tiMsg_Cycle_Time_u32 "CanNm_var_s (implementation in generated c-source in cannm_auto_conf.c) / ticks for monitoring Msg Cycle Time" ULONG X1_M 1 100 0 4294967295 ECU_ADDRESS 0xFFF92790 FORMAT "%13.2" /end MEASUREMENT
/begin MEASUREMENT CanNm_var_s[0].tiMsg_Timeout_Time_u32 "CanNm_var_s (implementation in generated c-source in cannm_auto_conf.c) / ticks for monitoring Msg Timeout Time" ULONG X1_M 1 100 0 4294967295 ECU_ADDRESS 0xFFF92794 FORMAT "%13.2" /end MEASUREMENT
/begin MEASUREMENT Can_EwsMsgTx "Buffer for CAN frames" UBYTE X1_M 1 100 0 255 ECU_ADDRESS 0xFFF9372D FORMAT "%5.1" MATRIX_DIM 179 1 1 /end MEASUREMENT
/begin MEASUREMENT Can_MsgBuffer_u8 "F2675: CAN buffer assigned to a message object (BIT765:CAN-node, Bit0-4:message buffer no.) (the number of actually available objects might be less) (internal only)" UBYTE X1_M 1 100 0 255 ECU_ADDRESS 0xFFF93E5A FORMAT "%5.1" MATRIX_DIM 256 1 1 /end MEASUREMENT
/begin MEASUREMENT Can_MsgInBuffer_u16 "F2675: Message object number assigned to a physical CAN buffer (CANA:idx=0-31,CANB:idx=32-63,CANC:idx=64-95) (internal only)" UWORD X1_M 1 100 0 65535 ECU_ADDRESS 0xFFF93C3C FORMAT "%8.2" MATRIX_DIM 96 1 1 /end MEASUREMENT
/begin MEASUREMENT Can_MsgStatus_u8 "F2675: status of a CAN message object (B2:disabled, B3:node-TX-stop) (internal only)" UBYTE X1_M 1 100 0 255 ECU_ADDRESS 0xFFF93EC1 FORMAT "%5.1" MATRIX_DIM 256 1 1 /end MEASUREMENT
/begin MEASUREMENT Can_NodeBaudrate_u32 "F2675: Current node baudrate (in Baud) (internal only)" ULONG X1_M 1 100 0 4294967295 ECU_ADDRESS 0xFFF93D1C FORMAT "%13.2" MATRIX_DIM 3 1 1 /end MEASUREMENT
/begin MEASUREMENT Can_NodeStatus_u16 "F2675: Current node status B0:Busoff,B1:Error-Warn,B8:Node disable,B9:TX-off (internal only)" UWORD X1_M 1 100 0 65535 ECU_ADDRESS 0xFFF93E52 FORMAT "%8.2" MATRIX_DIM 3 1 1 /end MEASUREMENT
/begin MEASUREMENT Can_stEwsTx "State EWS transmission" UBYTE X1_M 1 100 0 255 ECU_ADDRESS 0xFFF93A1D FORMAT "%5.1" /end MEASUREMENT
/begin CHARACTERISTIC ChpPrfl_qtChpMin_C "F9305: Minimum quality for undisturbed chip temperature (no SERAP)" VALUE 0x1918E5 AblGLKWub_S1 8 Q_SIG_S1 0 8 FORMAT "%13.11" /end CHARACTERISTIC
/begin CHARACTERISTIC ChpPrfl_tChp_C "F9305: Chip temperature profile thresholds (no SERAP)" VAL_BLK 0x1914FE AblGLKWBsw_S1 210 T0_0625_S1 -40 170 MATRIX_DIM 11 1 1 FORMAT "%8.4" /end CHARACTERISTIC
/begin MEASUREMENT ChpPrfl_tMax "F9305: Maximum undisturbed temperature seen" SWORD T0_0625_S1 1 100 -40 170 ECU_ADDRESS 0xFFF93470 FORMAT "%8.4" /end MEASUREMENT
/begin MEASUREMENT ChpPrfl_ti "F9305: Array for chip temperature profile, highest index used for disturbed temperatures" ULONG TI1_S1 1 100 0 4294967295 ECU_ADDRESS 0xFFF92BA8 FORMAT "%13.2" MATRIX_DIM 13 1 1 /end MEASUREMENT
/begin MEASUREMENT ChpPrfl_tiBuf "F9305: Chip temperature counter intermediate buffer" UWORD TI1_M_S1 1 100 0 65535 ECU_ADDRESS 0xFFF9346E FORMAT "%8.2" /end MEASUREMENT
/begin MEASUREMENT ComCtl_stIfcTxCom "F4480: interface for Tx control handled by COM" UBYTE X1_M 1 100 0 255 ECU_ADDRESS 0xFFF9370B FORMAT "%5.1" /end MEASUREMENT
/begin MEASUREMENT ComCtl_stLstRun "F4480: state of last run" UBYTE X1_M 1 100 0 255 ECU_ADDRESS 0xFFF9370C FORMAT "%5.1" /end MEASUREMENT
/begin MEASUREMENT ComCtl_stRxTxCom "F4480: array for communication control handled by COM" UBYTE X1_M 1 100 0 255 ECU_ADDRESS 0xFFF92094 FORMAT "%5.1" MATRIX_DIM 24 1 1 /end MEASUREMENT
/begin MEASUREMENT ComCtl_stRxTxNm "F4480: array for communication control handled by NM" UBYTE X1_M 1 100 0 255 ECU_ADDRESS 0xFFF920AC FORMAT "%5.1" MATRIX_DIM 24 1 1 /end MEASUREMENT
/begin MEASUREMENT ComCtl_stRxTxUsd "F4480: used array for communication control" UBYTE X1_M 1 100 0 255 ECU_ADDRESS 0xFFF920C4 FORMAT "%5.1" MATRIX_DIM 24 1 1 /end MEASUREMENT
/begin CHARACTERISTIC ComCtl_swtLoLimUsd_C "F4480: Switch for activation of battery voltage threshold" VALUE 0x1918C8 AblGLKWub_M 255 X1_M 0 255 FORMAT "%5.1" /end CHARACTERISTIC
/begin CHARACTERISTIC ComCtl_uLoLim_C "F4480: lower limit of battery voltage for communication" VALUE 0x1914BC AblGLKWuw_M 65.535 U0_001_M 0 65.535 FORMAT "%8.5" /end CHARACTERISTIC
/begin MEASUREMENT Cpu_stChkCfgReg "F2655: CPU register configuration check status (B0=performed, B1-B31:error bits)" ULONG X1_S1 1 100 0 4294967295 ECU_ADDRESS 0xFFF94100 FORMAT "%13.2" /end MEASUREMENT
/begin CHARACTERISTIC DSM_ERR_bClrIni "F3500: Switch to clear fault buffer in initialization (TRUE: clear buffer) (no SERAP)" VALUE 0x1918E6 AblGLKWub_S1 1 B_TRUE_S1 0 1 FORMAT "%13.11" /end CHARACTERISTIC
/begin MEASUREMENT DSM_ERR_ctEntry "F3500: Number of entries in buffer" UBYTE X1_S1 1 100 0 20 ECU_ADDRESS 0xFFF93B03 FORMAT "%5.2" /end MEASUREMENT
/begin MEASUREMENT DSM_ERR_ctErr "F3500: Error counter" UWORD X1_S1 1 100 0 65535 ECU_ADDRESS 0xFFF942B0 FORMAT "%8.2" MATRIX_DIM 20 1 1 /end MEASUREMENT
/begin MEASUREMENT DSM_ERR_numFctId "F3500: Function identification number" ULONG X1_S1 1 100 0 4294967295 ECU_ADDRESS 0xFFF942D8 FORMAT "%13.2" MATRIX_DIM 20 1 1 /end MEASUREMENT
/begin MEASUREMENT DSM_ERR_stErr "F3500: Error indication bits" UWORD X1_S1 1 100 0 65535 ECU_ADDRESS 0xFFF94328 FORMAT "%8.2" MATRIX_DIM 20 1 1 /end MEASUREMENT
/begin MEASUREMENT ECC_RAM_adEccErr "F2755: Last ECC-RAM error address which has reported an error (32bit aligned)" ULONG X1_S1 1 100 0 4294967295 ECU_ADDRESS 0xFFF93F68 FORMAT "%13.2" /end MEASUREMENT
/begin MEASUREMENT ECC_RAM_numEccErr "F2755: number of registered bit ECC-error corrections per observation period - if this number exceeds threshold a resed occurs" ULONG X1_S1 1 100 0 4294967295 ECU_ADDRESS 0xFFF80C80 FORMAT "%13.2" /end MEASUREMENT
/begin MEASUREMENT ECC_RAM_stEccTst "F2755: last memorized ECC-Test status B0-3: (2 = Test was not executed, 1 = Test was passed,0=Test was executed and failed) B4-7: alive counter " UBYTE X1_S1 1 100 0 255 ECU_ADDRESS 0xFFF94143 FORMAT "%5.1" /end MEASUREMENT
/begin MEASUREMENT ECC_ROM_stEccTst "F2755: last memorized ECC-Test status B0-3: (2 = Test was not executed, 1 = Test was passed,0=Test was executed and failed) B4-7: alive counter " UBYTE X1_S1 1 100 0 255 ECU_ADDRESS 0xFFF94144 FORMAT "%5.1" /end MEASUREMENT
/begin MEASUREMENT EELLD_Status_s.adOp_u32 "F2741: EELLD status details / " ULONG X1_S1 1 100 0 4294967295 ECU_ADDRESS 0xFFF9407C FORMAT "%13.2" /end MEASUREMENT
/begin MEASUREMENT EELLD_Status_s.ctErr_u16 "F2741: EELLD status details / " UWORD X1_S1 1 100 0 65535 ECU_ADDRESS 0xFFF94078 FORMAT "%8.2" /end MEASUREMENT
/begin MEASUREMENT EELLD_Status_s.numOffs_u16 "F2741: EELLD status details / " UWORD X1_S1 1 100 0 65535 ECU_ADDRESS 0xFFF94076 FORMAT "%8.2" /end MEASUREMENT
/begin MEASUREMENT EELLD_Status_s.numSec_u8 "F2741: EELLD status details / " UBYTE X1_S1 1 100 0 255 ECU_ADDRESS 0xFFF94074 FORMAT "%5.1" /end MEASUREMENT
/begin MEASUREMENT EELLD_Status_s.numSize_u8 "F2741: EELLD status details / " UBYTE X1_S1 1 100 0 255 ECU_ADDRESS 0xFFF94075 FORMAT "%5.1" /end MEASUREMENT
/begin MEASUREMENT EELLD_Status_s.reserved "F2741: EELLD status details / " UWORD X1_S1 1 100 0 65535 ECU_ADDRESS 0xFFF9407A FORMAT "%8.2" /end MEASUREMENT
/begin MEASUREMENT EELLD_Status_s.stMode_u8 "F2741: EELLD status details / " UBYTE X1_S1 1 100 0 255 ECU_ADDRESS 0xFFF94070 FORMAT "%5.1" /end MEASUREMENT
/begin MEASUREMENT EELLD_Status_s.stOp_u8 "F2741: EELLD status details / " UBYTE X1_S1 1 100 0 255 ECU_ADDRESS 0xFFF94071 FORMAT "%5.1" /end MEASUREMENT
/begin MEASUREMENT EELLD_Status_s.stReq_u8 "F2741: EELLD status details / " UBYTE X1_S1 1 100 0 255 ECU_ADDRESS 0xFFF94072 FORMAT "%5.1" /end MEASUREMENT
/begin MEASUREMENT EELLD_Status_s.stSuspReq_u8 "F2741: EELLD status details / " UBYTE X1_S1 1 100 0 255 ECU_ADDRESS 0xFFF94073 FORMAT "%5.1" /end MEASUREMENT
/begin MEASUREMENT FCU_numFirmware "F2742: Firmware version information - ASCII-representation (3 digit)" ULONG X1_S1 1 100 0 4294967295 ECU_ADDRESS 0xFFF94054 FORMAT "%13.2" /end MEASUREMENT
/begin MEASUREMENT FCU_s.ctCpy "F2742: FCU status details / " UWORD X1_S1 1 100 0 65535 ECU_ADDRESS 0xFFF94044 FORMAT "%8.2" /end MEASUREMENT
/begin MEASUREMENT FCU_s.ctOff "F2742: FCU status details / " UBYTE X1_S1 1 100 0 255 ECU_ADDRESS 0xFFF94042 FORMAT "%5.1" /end MEASUREMENT
/begin MEASUREMENT FCU_s.reserved "F2742: FCU status details / " UBYTE X1_S1 1 100 0 255 ECU_ADDRESS 0xFFF94047 FORMAT "%5.1" /end MEASUREMENT
/begin MEASUREMENT FCU_s.stErrDetail "F2742: FCU status details / " UBYTE X1_S1 1 100 0 255 ECU_ADDRESS 0xFFF94046 FORMAT "%5.1" /end MEASUREMENT
/begin MEASUREMENT FCU_s.stInit "F2742: FCU status details / " UBYTE X1_S1 1 100 0 255 ECU_ADDRESS 0xFFF94043 FORMAT "%5.1" /end MEASUREMENT
/begin MEASUREMENT FCU_s.stReq "F2742: FCU status details / " UBYTE X1_S1 1 100 0 255 ECU_ADDRESS 0xFFF94041 FORMAT "%5.1" /end MEASUREMENT
/begin MEASUREMENT FCU_s.state "F2742: FCU status details / " UBYTE X1_S1 1 100 0 255 ECU_ADDRESS 0xFFF94040 FORMAT "%5.1" /end MEASUREMENT
/begin MEASUREMENT GEH_ctStrt "F9200: System startup counter" UWORD X1_S1 1 100 0 65535 ECU_ADDRESS 0xFFF80E0C FORMAT "%8.2" /end MEASUREMENT
/begin MEASUREMENT GEH_sLstExcp "F9200: Last exception information" UBYTE X1_S1 1 100 0 255 ECU_ADDRESS 0xFFF80E13 FORMAT "%5.1" /end MEASUREMENT
/begin MEASUREMENT GEH_sReg_Valid "F9200: Status of exception storage, valid marker" UWORD X1_S1 1 100 0 65535 ECU_ADDRESS 0xFFF80E0E FORMAT "%8.2" /end MEASUREMENT
/begin MEASUREMENT GEH_xRegBuf_Ind "F9200: Index for ring buffer" UBYTE X1_S1 1 100 0 255 ECU_ADDRESS 0xFFF80E12 FORMAT "%5.1" /end MEASUREMENT
/begin MEASUREMENT GEH_xRegBuf_PC "F9200: Program counter for next command at time of last exceptions, ring buffer" ULONG X1_S1 1 100 0 4294967295 ECU_ADDRESS 0xFFF80D50 FORMAT "%13.2" MATRIX_DIM 10 1 1 /end MEASUREMENT
/begin MEASUREMENT GEH_xRegBuf_Par1 "F9200: 1st parameter passed by the calling function, zero in case of CPU exceptions, ring buffer" ULONG X1_S1 1 100 0 4294967295 ECU_ADDRESS 0xFFF80D28 FORMAT "%13.2" MATRIX_DIM 10 1 1 /end MEASUREMENT
/begin MEASUREMENT GEH_xRegBuf_SP "F9200: Stack pointer at time of last exceptions, ring buffer" ULONG X1_S1 1 100 0 4294967295 ECU_ADDRESS 0xFFF80D78 FORMAT "%13.2" MATRIX_DIM 10 1 1 /end MEASUREMENT
/begin MEASUREMENT GEH_xRegBuf_Vec "F9200: Vector (subset) of last exceptions, ring buffer" UWORD X1_S1 1 100 0 65535 ECU_ADDRESS 0xFFF80DA0 FORMAT "%8.2" MATRIX_DIM 10 1 1 /end MEASUREMENT
/begin MEASUREMENT GEH_xReg_FPSCR "F9200: FPU status register at time of last exception" ULONG X1_S1 1 100 0 4294967295 ECU_ADDRESS 0xFFF80DB4 FORMAT "%13.2" /end MEASUREMENT
/begin MEASUREMENT GEH_xReg_PC "F9200: Program counter for next command at time of last exception" ULONG X1_S1 1 100 0 4294967295 ECU_ADDRESS 0xFFF80DB8 FORMAT "%13.2" /end MEASUREMENT
/begin MEASUREMENT GEH_xReg_PR "F9200: Procedure register for next command at time of last exception" ULONG X1_S1 1 100 0 4294967295 ECU_ADDRESS 0xFFF80DBC FORMAT "%13.2" /end MEASUREMENT
/begin MEASUREMENT GEH_xReg_Par1 "F9200: 1st parameter passed by the calling function, zero in case of CPU exceptions" ULONG X1_S1 1 100 0 4294967295 ECU_ADDRESS 0xFFF80DC8 FORMAT "%13.2" /end MEASUREMENT
/begin MEASUREMENT GEH_xReg_SP "F9200: Stack pointer at time of last exception" ULONG X1_S1 1 100 0 4294967295 ECU_ADDRESS 0xFFF80DC0 FORMAT "%13.2" /end MEASUREMENT
/begin MEASUREMENT GEH_xReg_SR "F9200: Status register at time of last exception" ULONG X1_S1 1 100 0 4294967295 ECU_ADDRESS 0xFFF80DC4 FORMAT "%13.2" /end MEASUREMENT
/begin MEASUREMENT GEH_xReg_Stck "F9200: Stack buffer  at time of last exception" ULONG X1_S1 1 100 0 4294967295 ECU_ADDRESS 0xFFF80DCC FORMAT "%13.2" MATRIX_DIM 16 1 1 /end MEASUREMENT
/begin MEASUREMENT GEH_xReg_Vec "F9200: Vector (subset) of last exception" UWORD X1_S1 1 100 0 65535 ECU_ADDRESS 0xFFF80E10 FORMAT "%8.2" /end MEASUREMENT
/begin MEASUREMENT GmoHot_qtAct "F3010: Status of temperature sensors (0:INI,1:OK,2:ERROR)" UBYTE X1_S1 1 100 0 255 ECU_ADDRESS 0xFFF93B39 FORMAT "%5.1" /end MEASUREMENT
/begin CHARACTERISTIC GmoHot_qtChp1Min_C "F3010: Minimum quality for CG temperature (no SERAP)" VALUE 0x191926 AblGLKWub_S1 8 Q_SIG_S1 0 8 FORMAT "%13.11" /end CHARACTERISTIC
/begin CHARACTERISTIC GmoHot_qtChp2Min_C "F3010: Minimum quality for LM7x temperature (no SERAP)" VALUE 0x191927 AblGLKWub_S1 8 Q_SIG_S1 0 8 FORMAT "%13.11" /end CHARACTERISTIC
/begin MEASUREMENT GmoHot_stFault "F3010: Errortypes of hot shutdown function" UWORD X1_S1 1 100 0 65535 ECU_ADDRESS 0xFFF93512 FORMAT "%8.2" /end MEASUREMENT
/begin MEASUREMENT GmoHot_stHot "F3010: Internal state of hot shutdown function" UBYTE X1_S1 1 100 0 255 ECU_ADDRESS 0xFFF93B3A FORMAT "%5.1" /end MEASUREMENT
/begin MEASUREMENT GmoHot_stHotExt "F3010: Current state of hot shutdown function (0:INI,1:NORMAL,2:HOT)" UBYTE X1_S1 1 100 0 255 ECU_ADDRESS 0xFFF93B3B FORMAT "%5.1" /end MEASUREMENT
/begin MEASUREMENT GmoHot_stTstCond "F3010: Testconditions of hot shutdown function" UWORD X1_S1 1 100 0 65535 ECU_ADDRESS 0xFFF93514 FORMAT "%8.2" /end MEASUREMENT
/begin MEASUREMENT GmoHot_tAct "F3010: Actual temperature with tolerance" SWORD T0_0625_S1 1 100 -2048 2047.938 ECU_ADDRESS 0xFFF93516 FORMAT "%8.3" /end MEASUREMENT
/begin CHARACTERISTIC GmoHot_tBattDepSdnTempINI_C "F3010: Battery-voltage dependent Shutdown temperature in INI" CURVE 0x1915B2 AblGLKLsw_S1 255 T0_0625_S1 -40 215
 /begin AXIS_DESCR STD_AXIS GmoHot_uBatt U0_001_S1 4 0 32 DEPOSIT ABSOLUTE FORMAT "%8.5" /end AXIS_DESCR
 FORMAT "%8.4" /end CHARACTERISTIC
/begin CHARACTERISTIC GmoHot_tBattDepSdnTemp_C "F3010: Battery-voltage dependent Shutdown temperature" CURVE 0x1915C4 AblGLKLsw_S1 255 T0_0625_S1 -40 215
 /begin AXIS_DESCR STD_AXIS GmoHot_uBatt U0_001_S1 4 0 32 DEPOSIT ABSOLUTE FORMAT "%8.5" /end AXIS_DESCR
 FORMAT "%8.4" /end CHARACTERISTIC
/begin CHARACTERISTIC GmoHot_tChp1SensTolc_C "F3010: CG sensor tolerance" VALUE 0x1915D6 AblGLKWsw_S1 40 T0_0625_S1 -20 20 FORMAT "%8.5" /end CHARACTERISTIC
/begin CHARACTERISTIC GmoHot_tChp2SensTolc_C "F3010: LM7x sensor tolerance" VALUE 0x1915D8 AblGLKWsw_S1 40 T0_0625_S1 -20 20 FORMAT "%8.5" /end CHARACTERISTIC
/begin MEASUREMENT GmoHot_tLim "F3010: Shutdown temperature limit" SWORD T0_0625_S1 1 100 -2048 2047.938 ECU_ADDRESS 0xFFF93518 FORMAT "%8.3" /end MEASUREMENT
/begin CHARACTERISTIC GmoHot_tM3DepSdnTemp_C "F3010: M3-voltage dependent shutdown temperature" CURVE 0x1915E2 AblGLKLsw_S1 255 T0_0625_S1 -40 215
 /begin AXIS_DESCR STD_AXIS GmoHot_uM3 U0_001_S1 3 0 32 DEPOSIT ABSOLUTE FORMAT "%8.5" /end AXIS_DESCR
 FORMAT "%8.4" /end CHARACTERISTIC
/begin MEASUREMENT GmoHot_tiAtfDly "F3010: Delay timer for ATF sensor initialization" UWORD TI1_M_CYCLE_S1 1 100 0 65535 ECU_ADDRESS 0xFFF94188 FORMAT "%8.2" /end MEASUREMENT
/begin MEASUREMENT GmoHot_tiGenDly "F3010: General timer for hot shutdown functionality" UWORD TI1_M_CYCLE_S1 1 100 0 65535 ECU_ADDRESS 0xFFF9418A FORMAT "%8.2" /end MEASUREMENT
/begin CHARACTERISTIC GmoHot_tiGenDlyDSM_C "F3010: Delay time for DSM reaction" VALUE 0x1915DA AblGLKWuw_S1 100 TI1_M_CYCLE_S1 0 100 FORMAT "%8.4" /end CHARACTERISTIC
/begin CHARACTERISTIC GmoHot_tiGenDlyEE_C "F3010: Delay time for EEPROM update" VALUE 0x1915DC AblGLKWuw_S1 20000 TI1_M_CYCLE_S1 0 20000 FORMAT "%8.2" /end CHARACTERISTIC
/begin CHARACTERISTIC GmoHot_tiGenDlyHot_C "F3010: Filter time for hot state" VALUE 0x1915DE AblGLKWuw_S1 5000 TI1_M_CYCLE_S1 0 5000 FORMAT "%8.3" /end CHARACTERISTIC
/begin CHARACTERISTIC GmoHot_tiGenDlyInit_C "F3010: Delay time for sensor initialization" VALUE 0x1915E0 AblGLKWuw_S1 5000 TI1_M_CYCLE_S1 0 5000 FORMAT "%8.3" /end CHARACTERISTIC
/begin MEASUREMENT GmoHot_uBatt "F3010: Battery voltage used for calc. hot shutdown limit" SWORD U0_001_S1 1 100 0 32 ECU_ADDRESS 0xFFF9351A FORMAT "%8.5" /end MEASUREMENT
/begin MEASUREMENT GmoHot_uM3 "F3010: M3 voltage used for calc. hot shutdown limit" SWORD U0_001_S1 1 100 0 32 ECU_ADDRESS 0xFFF9351C FORMAT "%8.5" /end MEASUREMENT
/begin CHARACTERISTIC GmoHot_uUpLimHotCond_C "F3010: Upper limit for overvoltage detection in hot mode" VALUE 0x1915F0 AblGLKWuw_S1 32 U0_001_S1 0 32 FORMAT "%8.5" /end CHARACTERISTIC
/begin MEASUREMENT GmoHot_xReqSwtOffPs "F3010: Request switch-off power stages (0xA5 = switch-off request enabled, 0x5A = switch-off request disabled)" UBYTE X1_S1 1 100 0 255 ECU_ADDRESS 0xFFF84C19 FORMAT "%5.1" /end MEASUREMENT
/begin MEASUREMENT GmoRst_stFaultCus "F9155: Customer specific fault occurred" UBYTE X1_S1 1 100 0 255 ECU_ADDRESS 0xFFF80D21 FORMAT "%5.1" /end MEASUREMENT
/begin MEASUREMENT GmoRst_st_UndrVltg "F9155: Status macro GET_UNDERVOLTAGE_TC" UWORD X1_S1 1 100 0 65535 ECU_ADDRESS 0xFFF80D02 FORMAT "%8.2" /end MEASUREMENT
/begin MEASUREMENT Gmo_Rst_st "F3040: Status of information collecting about reset" UBYTE X1_S1 1 100 0 255 ECU_ADDRESS 0xFFF93B3C FORMAT "%5.1" /end MEASUREMENT
/begin MEASUREMENT Gmo_Rst_stFaultSup "F3040: Fault status of supplier error" UWORD X1_S1 1 100 0 65535 ECU_ADDRESS 0xFFF9351E FORMAT "%8.2" /end MEASUREMENT
/begin MEASUREMENT Gmo_Rst_stTstCondSup "F3040: Test conditions of supplier fault" UWORD X1_S1 1 100 0 65535 ECU_ADDRESS 0xFFF93520 FORMAT "%8.2" /end MEASUREMENT
/begin MEASUREMENT I14229_stOrigInit "F4100: state of original initialisation MISC channel" UBYTE X1_M 1 100 0 255 ECU_ADDRESS 0xFFF93705 FORMAT "%5.1" /end MEASUREMENT
/begin MEASUREMENT I14229_xInitDne "F4100: MISC channel initialisation done" UBYTE X1_M 1 100 0 255 ECU_ADDRESS 0xFFF93706 FORMAT "%5.1" /end MEASUREMENT
/begin CHARACTERISTIC I15031APPL_TimeoutLimit "F4205: Time for OBD communication timeout" VALUE 0x191928 AblGLKWub_M 119 TI1_M 1 120 FORMAT "%5.1" /end CHARACTERISTIC
/begin MEASUREMENT IO_ctmsgAPP3 "F9175: counter for 3.ZF-Applikations message" UBYTE X1_M 1 100 0 255 ECU_ADDRESS 0xFFF9397A FORMAT "%5.1" /end MEASUREMENT
/begin MEASUREMENT IO_ctmsgAPP4 "F9175: counter for 4.ZF-Applikations message" UBYTE X1_M 1 100 0 255 ECU_ADDRESS 0xFFF9397B FORMAT "%5.1" /end MEASUREMENT
/begin MEASUREMENT IO_ctmsgAPP8 "F9175: counter for 8.ZF-Applikations message" UBYTE X1_M 1 100 0 255 ECU_ADDRESS 0xFFF9397C FORMAT "%5.1" /end MEASUREMENT
/begin MEASUREMENT IO_ctmsgNM_ACAN "F4450: counter for NM message" UBYTE X1_M 1 100 0 255 ECU_ADDRESS 0xFFF93AAD FORMAT "%5.1" /end MEASUREMENT
/begin MEASUREMENT IO_ctmsgNM_FACAN "F4450: counter for NM message" UBYTE X1_M 1 100 0 255 ECU_ADDRESS 0xFFF93AAE FORMAT "%5.1" /end MEASUREMENT
/begin MEASUREMENT IO_ctmsgService "F9175: counter for Service message" UBYTE X1_M 1 100 0 255 ECU_ADDRESS 0xFFF9397D FORMAT "%5.1" /end MEASUREMENT
/begin MEASUREMENT LftCnt_ti "F9300: TCU lifetime counter - total" ULONG TI1_S1 1 100 0 4294967295 ECU_ADDRESS 0xFFF92BDC FORMAT "%13.2" /end MEASUREMENT
/begin MEASUREMENT LftCnt_tiBuf "F9300: TCU lifetime counter intermediate buffer" UWORD TI1_M_S1 1 100 0 65535 ECU_ADDRESS 0xFFF93472 FORMAT "%8.2" /end MEASUREMENT
/begin MEASUREMENT LftCnt_ti_Hour "F9300: TCU lifetime counter - hours" UWORD TI1_H_S1 1 100 0 65535 ECU_ADDRESS 0xFFF93474 FORMAT "%8.2" /end MEASUREMENT
/begin MEASUREMENT LftCnt_ti_Min "F9300: TCU lifetime counter - minutes" UBYTE TI1_MIN_S1 1 100 0 255 ECU_ADDRESS 0xFFF93B04 FORMAT "%5.1" /end MEASUREMENT
/begin MEASUREMENT LftCnt_ti_Sec "F9300: TCU lifetime counter - seconds" UBYTE TI1_S1 1 100 0 255 ECU_ADDRESS 0xFFF93B05 FORMAT "%5.1" /end MEASUREMENT
/begin MEASUREMENT Lvl2Mon_idxFaultBuf "F6050: Pointer to the next free element of the level 2 fault ring buffer" UBYTE X1_S1 1 100 0 255 ECU_ADDRESS 0xFFF943B9 FORMAT "%5.1" /end MEASUREMENT
/begin MEASUREMENT Lvl2Mon_stLvl2Fault "F6050: Display of level 2 faults (bitcoded)" ULONG X1_S1 1 100 0 4294967295 ECU_ADDRESS 0xFFF94808 FORMAT "%13.2" /end MEASUREMENT
/begin MEASUREMENT Lvl2Mon_xFaultBufLvl2Id_a "F6050: ID of the fault reporting level 2 function" ULONG X1_S1 1 100 0 4294967295 ECU_ADDRESS 0xFFF94380 FORMAT "%13.2" MATRIX_DIM 5 1 1 /end MEASUREMENT
/begin MEASUREMENT Lvl2Mon_xFaultBufLvl2Info_a "F6050: Internal additional information about the level 2 fault (optional)" UBYTE X1_S1 1 100 0 255 ECU_ADDRESS 0xFFF943BA FORMAT "%5.1" MATRIX_DIM 5 1 1 /end MEASUREMENT
/begin MEASUREMENT MCorAdc_ctErr "F6020: Error counter" UBYTE X1_S1 1 100 0 255 ECU_ADDRESS 0xFFF94917 FORMAT "%5.1" /end MEASUREMENT
/begin CHARACTERISTIC MCorAdc_ctErrDb_C "F6020: Error debounce time (multiples of SAF task invokations) (no SERAP)" VALUE 0x19191A AblGLKWub_S1 2 X1_S1 1 3 FORMAT "%5.3" /end CHARACTERISTIC
/begin MEASUREMENT MCorAdc_efADCTst "F6020: Indicate a current error is present" UBYTE B_TRUE_S1 1 100 0 1 ECU_ADDRESS 0xFFF939E4 FORMAT "%13.11" /end MEASUREMENT
/begin MEASUREMENT MCorAdc_stAdcFault "F6020: status MCor ADC test (Bit0=Vasic out of range, Bit1=VDD3 difference out of range, Bit2=VDD3 out of range, Bit3=diagnostic channel out of range)" UBYTE X1_S1 1 100 0 255 ECU_ADDRESS 0xFFF93B31 FORMAT "%5.1" /end MEASUREMENT
/begin CHARACTERISTIC MCorAdc_uDiagDiffMax_C "F6020: Max. voltage difference of the Diag. ch. whereas no error will report to SAF (no SERAP)" VALUE 0x19158E AblGLKWuw_S1 60 X1_S1 0 60 FORMAT "%8.5" /end CHARACTERISTIC
/begin CHARACTERISTIC MCorAdc_uM3Min_C "F6020: Threshold voltage of M3 under which MCor diagnostic is disabled for old cg124 (no SERAP)" VALUE 0x191590 AblGLKWuw_S1 0.9 U0_001_S1 5.6 6.5 FORMAT "%8.6" /end CHARACTERISTIC
/begin CHARACTERISTIC MCorAdc_uVasicMax_C "F6020: Upper threshold voltage whereas an error will report to SAF when Vasic exceeds this voltage (no SERAP)" VALUE 0x191592 AblGLKWuw_S1 0.7 U0_001_S1 5.3 6 FORMAT "%8.6" /end CHARACTERISTIC
/begin CHARACTERISTIC MCorAdc_uVasicMin_C "F6020: Lower threshold voltage whereas an error will report to SAF when Vasic remain under this voltage (no SERAP)" VALUE 0x191594 AblGLKWuw_S1 0.2 U0_001_S1 4.5 4.7 FORMAT "%8.6" /end CHARACTERISTIC
/begin CHARACTERISTIC MCorAdc_uVdd3DiffMax_C "F6020: Max. Difference voltage whereas an error will report to SAF when difference voltage between VDD3 and VDD3 alternative exceeds this value (no SERAP)" VALUE 0x191596 AblGLKWuw_S1 0.39 U0_001_S1 0.01 0.4 FORMAT "%9.7" /end CHARACTERISTIC
/begin CHARACTERISTIC MCorAdc_uVdd3Max_C "F6020: Upper threshold voltage whereas an error will report to SAF when Vdd3 exceeds this voltage (no SERAP)" VALUE 0x191598 AblGLKWuw_S1 0.37 U0_001_S1 3.43 3.8 FORMAT "%8.6" /end CHARACTERISTIC
/begin CHARACTERISTIC MCorAdc_uVdd3Min_C "F6020: Min. voltage of VDD3 whereas no error will report to SAF (no SERAP)" VALUE 0x19159A AblGLKWuw_S1 0.32 U0_001_S1 2.8 3.12 FORMAT "%8.6" /end CHARACTERISTIC
/begin CHARACTERISTIC MCorMmm_ctErrDbEcc_C "F6040: Error debounce time for the MCOR ECC error (multiple of main task time) (no SERAP)" VALUE 0x19191B AblGLKWub_S1 2 X1_S1 1 3 FORMAT "%5.3" /end CHARACTERISTIC
/begin CHARACTERISTIC MCorMmm_ctErrDbReg_C "F6040: Error debounce time for the MCOR REG error (multiple of main task time) (no SERAP)" VALUE 0x19191C AblGLKWub_S1 2 X1_S1 1 3 FORMAT "%5.3" /end CHARACTERISTIC
/begin MEASUREMENT MCorMmm_ctErrEcc "F6040: Error counter Ecc Core Monitor" UBYTE X1_S1 1 100 0 255 ECU_ADDRESS 0xFFF94918 FORMAT "%5.1" /end MEASUREMENT
/begin MEASUREMENT MCorMmm_ctErrReg "F6040: Error counter register Core Monitor" UBYTE X1_S1 1 100 0 255 ECU_ADDRESS 0xFFF94919 FORMAT "%5.1" /end MEASUREMENT
/begin MEASUREMENT MCorMmm_stEccFault "F6040: status Ecc test (BIT0: test completed after last call;BIT1: RAM-ECC-Test failed;BIT2: RAM-ECC-Interrupt-Test failed; BIT4: ROM-ECC-Test failed)" UBYTE X1_S1 1 100 0 255 ECU_ADDRESS 0xFFF80D23 FORMAT "%5.1" /end MEASUREMENT
/begin MEASUREMENT MCorMmm_stRegFault "F6040: status register test (0:test not yet performed;1:test passed successfully; others: error information available in Bits 1 to 31)" ULONG X1_S1 1 100 0 4294967295 ECU_ADDRESS 0xFFF80CF8 FORMAT "%13.2" /end MEASUREMENT
/begin MEASUREMENT MCorSpi_bErrFlg "F6030: Indicator for current SPI error" UBYTE B_TRUE_S1 1 100 0 1 ECU_ADDRESS 0xFFF80D24 FORMAT "%13.11" /end MEASUREMENT
/begin MEASUREMENT MCorSpi_ctErr "F6030: Error counter SPI Core Monitor" UBYTE X1_S1 1 100 0 255 ECU_ADDRESS 0xFFF9491A FORMAT "%5.1" /end MEASUREMENT
/begin CHARACTERISTIC MCorSpi_ctErrDb_C "F6030: Error debounce time for the MCOR SPI error (multiple of main task time) (no SERAP)" VALUE 0x19191D AblGLKWub_S1 2 X1_S1 1 3 FORMAT "%5.3" /end CHARACTERISTIC
/begin MEASUREMENT MCor_ctCorTst "F6010: Choice counter for core test functions (0-15)" UBYTE X1_S1 1 100 0 255 ECU_ADDRESS 0xFFF94916 FORMAT "%5.1" /end MEASUREMENT
/begin MEASUREMENT MCor_stIntMCorFault "F6010: Display of internal MCor fault at IWD partial response (Bit0=coretest fault,Bit1=ECC fault,Bit2=MISR test fault)" UBYTE X1_S1 1 100 0 255 ECU_ADDRESS 0xFFF80D22 FORMAT "%5.1" /end MEASUREMENT
/begin MEASUREMENT MCor_stMCorFault "F6010: Display of core monitor faults (Bit0= ADC test fault,Bit 1 = Level 2 monitor fault,Bit 2 = SPI test fault,Bit 3 = ECC test fault,Bit 4 = configuration register check fault)" UWORD X1_S1 1 100 0 65535 ECU_ADDRESS 0xFFF948E2 FORMAT "%8.2" /end MEASUREMENT
/begin CHARACTERISTIC MCor_swtFaultEntryReq_C "F6010: Enable/Disable MCor fault entry request to error handler (bitcoded) (no SERAP)" VALUE 0x191919 AblGLKWub_S1 255 X1_S1 0 255 FORMAT "%5.1" /end CHARACTERISTIC
/begin MEASUREMENT MCor_xWdPartResp "F6010: IWD partial reponse core monitor module" ULONG X1_S1 1 100 0 4294967295 ECU_ADDRESS 0xFFF92C5C FORMAT "%13.2" /end MEASUREMENT
/begin MEASUREMENT Nm_var_s[0].nmNodeIdListStatus_b "Nm_var_s (implementation in generated c-source in nm_auto_conf.c) / status of Node Identifier list" ULONG X1_M 1 100 0 4294967295 ECU_ADDRESS 0xFFF92744 FORMAT "%13.2" /end MEASUREMENT
/begin MEASUREMENT Nm_var_s[0].nmRemoteSleepInd_b "Nm_var_s (implementation in generated c-source in nm_auto_conf.c) / status of remote sleep indication" ULONG X1_M 1 100 0 4294967295 ECU_ADDRESS 0xFFF92740 FORMAT "%13.2" /end MEASUREMENT
/begin MEASUREMENT Nm_var_s[0].numSizeOfNodeIdList_u8 "Nm_var_s (implementation in generated c-source in nm_auto_conf.c) / size of Node Id list" UBYTE X1_M 1 100 0 255 ECU_ADDRESS 0xFFF9273C FORMAT "%5.1" /end MEASUREMENT
/begin MEASUREMENT Nm_var_s[0].stNmFlags_b32 "Nm_var_s (implementation in generated c-source in nm_auto_conf.c) / status flags for NM" ULONG X1_M 1 100 0 4294967295 ECU_ADDRESS 0xFFF92724 FORMAT "%13.2" /end MEASUREMENT
/begin MEASUREMENT Nm_var_s[0].stNmState_e "Nm_var_s (implementation in generated c-source in nm_auto_conf.c) / state machine of the generic NM" ULONG Nm_StateType_t_M 1 100 0 4 ECU_ADDRESS 0xFFF92748 FORMAT "%13.11" /end MEASUREMENT
/begin MEASUREMENT Nm_var_s[0].tiNmNodeDetectionLockTime_u32 "Nm_var_s (implementation in generated c-source in nm_auto_conf.c) / timer for monitoring node detection lock time" ULONG X1_M 1 100 0 4294967295 ECU_ADDRESS 0xFFF92728 FORMAT "%13.2" /end MEASUREMENT
/begin MEASUREMENT Nm_var_s[0].tiNmRepeatMessageTime_u32 "Nm_var_s (implementation in generated c-source in nm_auto_conf.c) / timer for monitoring repeat message time" ULONG X1_M 1 100 0 4294967295 ECU_ADDRESS 0xFFF92738 FORMAT "%13.2" /end MEASUREMENT
/begin MEASUREMENT Nm_var_s[0].tiNmTimeoutTime_u32 "Nm_var_s (implementation in generated c-source in nm_auto_conf.c) / timer for monitoring NM timeout" ULONG X1_M 1 100 0 4294967295 ECU_ADDRESS 0xFFF92730 FORMAT "%13.2" /end MEASUREMENT
/begin MEASUREMENT Nm_var_s[0].tiNmWaitBusSleepTime_u32 "Nm_var_s (implementation in generated c-source in nm_auto_conf.c) / timer for monitoring wait sleep timeout" ULONG X1_M 1 100 0 4294967295 ECU_ADDRESS 0xFFF92734 FORMAT "%13.2" /end MEASUREMENT
/begin MEASUREMENT Nm_var_s[0].tiRemoteSleepIndTime_u32 "Nm_var_s (implementation in generated c-source in nm_auto_conf.c) / timer for monitoring remote sleep inidcation" ULONG X1_M 1 100 0 4294967295 ECU_ADDRESS 0xFFF9272C FORMAT "%13.2" /end MEASUREMENT
/begin CHARACTERISTIC OutMCrntFdbk_facCor_C[0] "F2864: Correction factor per actuator dependent on oil temperature" CURVE 0x190FCC AblGLKLsw_S1 20 R0_1_P_S1 90 110
 /begin AXIS_DESCR STD_AXIS OutMRstn_tAtfRef T0_0625_S1 2 -40 215 DEPOSIT ABSOLUTE FORMAT "%8.4" /end AXIS_DESCR
 FORMAT "%8.4" /end CHARACTERISTIC
/begin CHARACTERISTIC OutMCrntFdbk_facCor_C[1] "F2864: Correction factor per actuator dependent on oil temperature" CURVE 0x190FD6 AblGLKLsw_S1 20 R0_1_P_S1 90 110
 /begin AXIS_DESCR STD_AXIS OutMRstn_tAtfRef T0_0625_S1 2 -40 215 DEPOSIT ABSOLUTE FORMAT "%8.4" /end AXIS_DESCR
 FORMAT "%8.4" /end CHARACTERISTIC
/begin CHARACTERISTIC OutMCrntFdbk_facCor_C[2] "F2864: Correction factor per actuator dependent on oil temperature" CURVE 0x190FE0 AblGLKLsw_S1 20 R0_1_P_S1 90 110
 /begin AXIS_DESCR STD_AXIS OutMRstn_tAtfRef T0_0625_S1 2 -40 215 DEPOSIT ABSOLUTE FORMAT "%8.4" /end AXIS_DESCR
 FORMAT "%8.4" /end CHARACTERISTIC
/begin CHARACTERISTIC OutMCrntFdbk_facCor_C[3] "F2864: Correction factor per actuator dependent on oil temperature" CURVE 0x190FEA AblGLKLsw_S1 20 R0_1_P_S1 90 110
 /begin AXIS_DESCR STD_AXIS OutMRstn_tAtfRef T0_0625_S1 2 -40 215 DEPOSIT ABSOLUTE FORMAT "%8.4" /end AXIS_DESCR
 FORMAT "%8.4" /end CHARACTERISTIC
/begin CHARACTERISTIC OutMCrntFdbk_facCor_C[4] "F2864: Correction factor per actuator dependent on oil temperature" CURVE 0x190FF4 AblGLKLsw_S1 20 R0_1_P_S1 90 110
 /begin AXIS_DESCR STD_AXIS OutMRstn_tAtfRef T0_0625_S1 2 -40 215 DEPOSIT ABSOLUTE FORMAT "%8.4" /end AXIS_DESCR
 FORMAT "%8.4" /end CHARACTERISTIC
/begin CHARACTERISTIC OutMCrntFdbk_facCor_C[5] "F2864: Correction factor per actuator dependent on oil temperature" CURVE 0x190FFE AblGLKLsw_S1 20 R0_1_P_S1 90 110
 /begin AXIS_DESCR STD_AXIS OutMRstn_tAtfRef T0_0625_S1 2 -40 215 DEPOSIT ABSOLUTE FORMAT "%8.4" /end AXIS_DESCR
 FORMAT "%8.4" /end CHARACTERISTIC
/begin CHARACTERISTIC OutMCrntFdbk_facCor_C[6] "F2864: Correction factor per actuator dependent on oil temperature" CURVE 0x191008 AblGLKLsw_S1 20 R0_1_P_S1 90 110
 /begin AXIS_DESCR STD_AXIS OutMRstn_tAtfRef T0_0625_S1 2 -40 215 DEPOSIT ABSOLUTE FORMAT "%8.4" /end AXIS_DESCR
 FORMAT "%8.4" /end CHARACTERISTIC
/begin CHARACTERISTIC OutMCrntFdbk_facCor_C[7] "F2864: Correction factor per actuator dependent on oil temperature" CURVE 0x191012 AblGLKLsw_S1 20 R0_1_P_S1 90 110
 /begin AXIS_DESCR STD_AXIS OutMRstn_tAtfRef T0_0625_S1 2 -40 215 DEPOSIT ABSOLUTE FORMAT "%8.4" /end AXIS_DESCR
 FORMAT "%8.4" /end CHARACTERISTIC
/begin CHARACTERISTIC OutMCrntFdbk_facCor_C[8] "F2864: Correction factor per actuator dependent on oil temperature" CURVE 0x19101C AblGLKLsw_S1 20 R0_1_P_S1 90 110
 /begin AXIS_DESCR STD_AXIS OutMRstn_tAtfRef T0_0625_S1 2 -40 215 DEPOSIT ABSOLUTE FORMAT "%8.4" /end AXIS_DESCR
 FORMAT "%8.4" /end CHARACTERISTIC
/begin CHARACTERISTIC OutMCrntFdbk_facCor_C[9] "F2864: Correction factor per actuator dependent on oil temperature" CURVE 0x191026 AblGLKLsw_S1 20 R0_1_P_S1 90 110
 /begin AXIS_DESCR STD_AXIS OutMRstn_tAtfRef T0_0625_S1 2 -40 215 DEPOSIT ABSOLUTE FORMAT "%8.4" /end AXIS_DESCR
 FORMAT "%8.4" /end CHARACTERISTIC
/begin MEASUREMENT OutMCrntFdbk_iCalc "F2864: Calculated current value of PWM feedback signal" UWORD I0_0001_S1 1 100 0 3.2 ECU_ADDRESS 0xFFF92F48 FORMAT "%8.6" MATRIX_DIM 10 1 1 /end MEASUREMENT
/begin CHARACTERISTIC OutMCrntFdbk_uDio_C[0] "F2864: Forward voltage of freewheeling diode dependent on chip temperature" CURVE 0x191030 AblGLKLsw_S1 0.7 U0_001_S1 0.3 1
 /begin AXIS_DESCR STD_AXIS OutMRstn_tChpRef T0_0625_S1 4 -40 215 DEPOSIT ABSOLUTE FORMAT "%8.4" /end AXIS_DESCR
 FORMAT "%8.6" /end CHARACTERISTIC
/begin CHARACTERISTIC OutMCrntFdbk_uDio_C[1] "F2864: Forward voltage of freewheeling diode dependent on chip temperature" CURVE 0x191042 AblGLKLsw_S1 0.7 U0_001_S1 0.3 1
 /begin AXIS_DESCR STD_AXIS OutMRstn_tChpRef T0_0625_S1 4 -40 215 DEPOSIT ABSOLUTE FORMAT "%8.4" /end AXIS_DESCR
 FORMAT "%8.6" /end CHARACTERISTIC
/begin CHARACTERISTIC OutMCrntFdbk_uDio_C[2] "F2864: Forward voltage of freewheeling diode dependent on chip temperature" CURVE 0x191054 AblGLKLsw_S1 0.7 U0_001_S1 0.3 1
 /begin AXIS_DESCR STD_AXIS OutMRstn_tChpRef T0_0625_S1 4 -40 215 DEPOSIT ABSOLUTE FORMAT "%8.4" /end AXIS_DESCR
 FORMAT "%8.6" /end CHARACTERISTIC
/begin CHARACTERISTIC OutMCrntFdbk_uDio_C[3] "F2864: Forward voltage of freewheeling diode dependent on chip temperature" CURVE 0x191066 AblGLKLsw_S1 0.7 U0_001_S1 0.3 1
 /begin AXIS_DESCR STD_AXIS OutMRstn_tChpRef T0_0625_S1 4 -40 215 DEPOSIT ABSOLUTE FORMAT "%8.4" /end AXIS_DESCR
 FORMAT "%8.6" /end CHARACTERISTIC
/begin CHARACTERISTIC OutMCrntFdbk_uDio_C[4] "F2864: Forward voltage of freewheeling diode dependent on chip temperature" CURVE 0x191078 AblGLKLsw_S1 0.7 U0_001_S1 0.3 1
 /begin AXIS_DESCR STD_AXIS OutMRstn_tChpRef T0_0625_S1 4 -40 215 DEPOSIT ABSOLUTE FORMAT "%8.4" /end AXIS_DESCR
 FORMAT "%8.6" /end CHARACTERISTIC
/begin CHARACTERISTIC OutMCrntFdbk_uDio_C[5] "F2864: Forward voltage of freewheeling diode dependent on chip temperature" CURVE 0x19108A AblGLKLsw_S1 0.7 U0_001_S1 0.3 1
 /begin AXIS_DESCR STD_AXIS OutMRstn_tChpRef T0_0625_S1 4 -40 215 DEPOSIT ABSOLUTE FORMAT "%8.4" /end AXIS_DESCR
 FORMAT "%8.6" /end CHARACTERISTIC
/begin CHARACTERISTIC OutMCrntFdbk_uDio_C[6] "F2864: Forward voltage of freewheeling diode dependent on chip temperature" CURVE 0x19109C AblGLKLsw_S1 0.7 U0_001_S1 0.3 1
 /begin AXIS_DESCR STD_AXIS OutMRstn_tChpRef T0_0625_S1 4 -40 215 DEPOSIT ABSOLUTE FORMAT "%8.4" /end AXIS_DESCR
 FORMAT "%8.6" /end CHARACTERISTIC
/begin CHARACTERISTIC OutMCrntFdbk_uDio_C[7] "F2864: Forward voltage of freewheeling diode dependent on chip temperature" CURVE 0x1910AE AblGLKLsw_S1 0.7 U0_001_S1 0.3 1
 /begin AXIS_DESCR STD_AXIS OutMRstn_tChpRef T0_0625_S1 4 -40 215 DEPOSIT ABSOLUTE FORMAT "%8.4" /end AXIS_DESCR
 FORMAT "%8.6" /end CHARACTERISTIC
/begin CHARACTERISTIC OutMCrntFdbk_uDio_C[8] "F2864: Forward voltage of freewheeling diode dependent on chip temperature" CURVE 0x1910C0 AblGLKLsw_S1 0.7 U0_001_S1 0.3 1
 /begin AXIS_DESCR STD_AXIS OutMRstn_tChpRef T0_0625_S1 4 -40 215 DEPOSIT ABSOLUTE FORMAT "%8.4" /end AXIS_DESCR
 FORMAT "%8.6" /end CHARACTERISTIC
/begin CHARACTERISTIC OutMCrntFdbk_uDio_C[9] "F2864: Forward voltage of freewheeling diode dependent on chip temperature" CURVE 0x1910D2 AblGLKLsw_S1 0.7 U0_001_S1 0.3 1
 /begin AXIS_DESCR STD_AXIS OutMRstn_tChpRef T0_0625_S1 4 -40 215 DEPOSIT ABSOLUTE FORMAT "%8.4" /end AXIS_DESCR
 FORMAT "%8.6" /end CHARACTERISTIC
/begin MEASUREMENT OutMDth_bDthEnblReq "F2861: Enable the dither output" UBYTE B_TRUE_S1 1 100 0 1 ECU_ADDRESS 0xFFF93534 FORMAT "%13.11" MATRIX_DIM 10 1 1 /end MEASUREMENT
/begin MEASUREMENT OutMDth_bPerChngPrvnt "F2861: Prevent the period change in current situation" UBYTE B_TRUE_S1 1 100 0 1 ECU_ADDRESS 0xFFF93B59 FORMAT "%13.11" /end MEASUREMENT
/begin CHARACTERISTIC OutMDth_facAtfFlt_C "F2861: Filter constant for Atf-temperature" VALUE 0x191634 AblGLKWsw_S1 1 R0_0001_S1 0 1 FORMAT "%8.6" /end CHARACTERISTIC
/begin MEASUREMENT OutMDth_iDthAmp "F2861: Dither amplitude (0.1mA resolution)" UWORD I0_0001_S1 1 100 0 6.5535 ECU_ADDRESS 0xFFF92F00 FORMAT "%8.6" MATRIX_DIM 10 1 1 /end MEASUREMENT
/begin CHARACTERISTIC OutMDth_iDthAmpChngThres_C "F2861: Threshold to detect change in dither amplitude" VAL_BLK 0x190590 AblGLKWBuw_S1 6.5535 I0_0001_S1 0 6.5535 MATRIX_DIM 10 1 1 FORMAT "%8.6" /end CHARACTERISTIC
/begin CHARACTERISTIC OutMDth_iDthAmpGrad_C "F2861: gradient for dither amplitude limitation" VAL_BLK 0x1905A4 AblGLKWBuw_S1 3.2 I0_0001_S1 0 3.2 MATRIX_DIM 10 1 1 FORMAT "%8.6" /end CHARACTERISTIC
/begin MEASUREMENT OutMDth_iDthAmpLimSply "F2861: Dither amplitude limitation dependent on supply voltage and Atf temperature" UWORD I0_0001_S1 1 100 0 6.5535 ECU_ADDRESS 0xFFF9353E FORMAT "%8.6" /end MEASUREMENT
/begin CHARACTERISTIC OutMDth_iDthAmpLimSply_C "F2861: Dither amplitude limitation depending on supply voltage and Atf temperature" MAP 0x191642 AblGLKFsw_S1 6.5535 I0_0001_S1 -3.2768 3.2767
 /begin AXIS_DESCR STD_AXIS OutMDth_tAtfFlt T0_0625_S1 5 -2048 2047.938 DEPOSIT ABSOLUTE FORMAT "%8.3" /end AXIS_DESCR
 /begin AXIS_DESCR STD_AXIS OutMDth_uSplyDmy U0_001_S1 5 -32.768 32.767 DEPOSIT ABSOLUTE FORMAT "%8.5" /end AXIS_DESCR
 FORMAT "%8.6" /end CHARACTERISTIC
/begin CHARACTERISTIC OutMDth_iDthAmpOnThres_C "F2861: Threshold for the dither On/Off recognition" VAL_BLK 0x1905B8 AblGLKWBuw_S1 6.5535 I0_0001_S1 0 6.5535 MATRIX_DIM 10 1 1 FORMAT "%8.6" /end CHARACTERISTIC
/begin MEASUREMENT OutMDth_iDthAmpReq "F2861: Dither amplitude request (>1000mA:no request) (0.1mA resolution)" UWORD I0_0001_S1 1 100 0 6.5535 ECU_ADDRESS 0xFFF92F14 FORMAT "%8.6" MATRIX_DIM 10 1 1 /end MEASUREMENT
/begin CHARACTERISTIC OutMDth_iDthAmp_C[0] "F2861: Dither amplitude settings depending on output current and tAtf" MAP 0x1905E0 AblGLKFsw_S1 6.5535 I0_0001_S1 -3.2768 3.2767
 /begin AXIS_DESCR STD_AXIS OutMDth_tAtfFlt T0_0625_S1 5 -2048 2047.938 DEPOSIT ABSOLUTE FORMAT "%8.3" /end AXIS_DESCR
 /begin AXIS_DESCR STD_AXIS OutMDth_iInDmy I0_0001_S1 20 -3.2768 3.2767 DEPOSIT ABSOLUTE FORMAT "%8.6" /end AXIS_DESCR
 FORMAT "%8.6" /end CHARACTERISTIC
/begin CHARACTERISTIC OutMDth_iDthAmp_C[1] "F2861: Dither amplitude settings depending on output current and tAtf" MAP 0x1906DE AblGLKFsw_S1 6.5535 I0_0001_S1 -3.2768 3.2767
 /begin AXIS_DESCR STD_AXIS OutMDth_tAtfFlt T0_0625_S1 5 -2048 2047.938 DEPOSIT ABSOLUTE FORMAT "%8.3" /end AXIS_DESCR
 /begin AXIS_DESCR STD_AXIS OutMDth_iInDmy I0_0001_S1 20 -3.2768 3.2767 DEPOSIT ABSOLUTE FORMAT "%8.6" /end AXIS_DESCR
 FORMAT "%8.6" /end CHARACTERISTIC
/begin CHARACTERISTIC OutMDth_iDthAmp_C[2] "F2861: Dither amplitude settings depending on output current and tAtf" MAP 0x1907DC AblGLKFsw_S1 6.5535 I0_0001_S1 -3.2768 3.2767
 /begin AXIS_DESCR STD_AXIS OutMDth_tAtfFlt T0_0625_S1 5 -2048 2047.938 DEPOSIT ABSOLUTE FORMAT "%8.3" /end AXIS_DESCR
 /begin AXIS_DESCR STD_AXIS OutMDth_iInDmy I0_0001_S1 20 -3.2768 3.2767 DEPOSIT ABSOLUTE FORMAT "%8.6" /end AXIS_DESCR
 FORMAT "%8.6" /end CHARACTERISTIC
/begin CHARACTERISTIC OutMDth_iDthAmp_C[3] "F2861: Dither amplitude settings depending on output current and tAtf" MAP 0x1908DA AblGLKFsw_S1 6.5535 I0_0001_S1 -3.2768 3.2767
 /begin AXIS_DESCR STD_AXIS OutMDth_tAtfFlt T0_0625_S1 5 -2048 2047.938 DEPOSIT ABSOLUTE FORMAT "%8.3" /end AXIS_DESCR
 /begin AXIS_DESCR STD_AXIS OutMDth_iInDmy I0_0001_S1 20 -3.2768 3.2767 DEPOSIT ABSOLUTE FORMAT "%8.6" /end AXIS_DESCR
 FORMAT "%8.6" /end CHARACTERISTIC
/begin CHARACTERISTIC OutMDth_iDthAmp_C[4] "F2861: Dither amplitude settings depending on output current and tAtf" MAP 0x1909D8 AblGLKFsw_S1 6.5535 I0_0001_S1 -3.2768 3.2767
 /begin AXIS_DESCR STD_AXIS OutMDth_tAtfFlt T0_0625_S1 5 -2048 2047.938 DEPOSIT ABSOLUTE FORMAT "%8.3" /end AXIS_DESCR
 /begin AXIS_DESCR STD_AXIS OutMDth_iInDmy I0_0001_S1 20 -3.2768 3.2767 DEPOSIT ABSOLUTE FORMAT "%8.6" /end AXIS_DESCR
 FORMAT "%8.6" /end CHARACTERISTIC
/begin CHARACTERISTIC OutMDth_iDthAmp_C[5] "F2861: Dither amplitude settings depending on output current and tAtf" MAP 0x190AD6 AblGLKFsw_S1 6.5535 I0_0001_S1 -3.2768 3.2767
 /begin AXIS_DESCR STD_AXIS OutMDth_tAtfFlt T0_0625_S1 5 -2048 2047.938 DEPOSIT ABSOLUTE FORMAT "%8.3" /end AXIS_DESCR
 /begin AXIS_DESCR STD_AXIS OutMDth_iInDmy I0_0001_S1 20 -3.2768 3.2767 DEPOSIT ABSOLUTE FORMAT "%8.6" /end AXIS_DESCR
 FORMAT "%8.6" /end CHARACTERISTIC
/begin CHARACTERISTIC OutMDth_iDthAmp_C[6] "F2861: Dither amplitude settings depending on output current and tAtf" MAP 0x190BD4 AblGLKFsw_S1 6.5535 I0_0001_S1 -3.2768 3.2767
 /begin AXIS_DESCR STD_AXIS OutMDth_tAtfFlt T0_0625_S1 5 -2048 2047.938 DEPOSIT ABSOLUTE FORMAT "%8.3" /end AXIS_DESCR
 /begin AXIS_DESCR STD_AXIS OutMDth_iInDmy I0_0001_S1 20 -3.2768 3.2767 DEPOSIT ABSOLUTE FORMAT "%8.6" /end AXIS_DESCR
 FORMAT "%8.6" /end CHARACTERISTIC
/begin CHARACTERISTIC OutMDth_iDthAmp_C[7] "F2861: Dither amplitude settings depending on output current and tAtf" MAP 0x190CD2 AblGLKFsw_S1 6.5535 I0_0001_S1 -3.2768 3.2767
 /begin AXIS_DESCR STD_AXIS OutMDth_tAtfFlt T0_0625_S1 5 -2048 2047.938 DEPOSIT ABSOLUTE FORMAT "%8.3" /end AXIS_DESCR
 /begin AXIS_DESCR STD_AXIS OutMDth_iInDmy I0_0001_S1 20 -3.2768 3.2767 DEPOSIT ABSOLUTE FORMAT "%8.6" /end AXIS_DESCR
 FORMAT "%8.6" /end CHARACTERISTIC
/begin CHARACTERISTIC OutMDth_iDthAmp_C[8] "F2861: Dither amplitude settings depending on output current and tAtf" MAP 0x190DD0 AblGLKFsw_S1 6.5535 I0_0001_S1 -3.2768 3.2767
 /begin AXIS_DESCR STD_AXIS OutMDth_tAtfFlt T0_0625_S1 5 -2048 2047.938 DEPOSIT ABSOLUTE FORMAT "%8.3" /end AXIS_DESCR
 /begin AXIS_DESCR STD_AXIS OutMDth_iInDmy I0_0001_S1 20 -3.2768 3.2767 DEPOSIT ABSOLUTE FORMAT "%8.6" /end AXIS_DESCR
 FORMAT "%8.6" /end CHARACTERISTIC
/begin CHARACTERISTIC OutMDth_iDthAmp_C[9] "F2861: Dither amplitude settings depending on output current and tAtf" MAP 0x190ECE AblGLKFsw_S1 6.5535 I0_0001_S1 -3.2768 3.2767
 /begin AXIS_DESCR STD_AXIS OutMDth_tAtfFlt T0_0625_S1 5 -2048 2047.938 DEPOSIT ABSOLUTE FORMAT "%8.3" /end AXIS_DESCR
 /begin AXIS_DESCR STD_AXIS OutMDth_iInDmy I0_0001_S1 20 -3.2768 3.2767 DEPOSIT ABSOLUTE FORMAT "%8.6" /end AXIS_DESCR
 FORMAT "%8.6" /end CHARACTERISTIC
/begin MEASUREMENT OutMDth_iInDmy "F2861: Current value which is used for dither calculation (dummy for characteristic field)" SWORD I0_0001_S1 1 100 -3.2768 3.2767 ECU_ADDRESS 0xFFF93540 FORMAT "%8.6" /end MEASUREMENT
/begin CHARACTERISTIC OutMDth_iInGradMax_C "F2861: max. current value gradient" VAL_BLK 0x1905CC AblGLKWBuw_S1 3.2 I0_0001_S1 0 3.2 MATRIX_DIM 10 1 1 FORMAT "%8.6" /end CHARACTERISTIC
/begin MEASUREMENT OutMDth_stDthAmpChng "F2861: Bit Array indicating dither amplitude change per dither channel" ULONG X1_S1 1 100 0 4294967295 ECU_ADDRESS 0xFFF92F28 FORMAT "%13.2" /end MEASUREMENT
/begin CHARACTERISTIC OutMDth_stDthAmpLimAvl_C "F2861: Activate Dither amplitude limitation [B0: Chn0, B1: Chn1, ...; 0=not active, 1=active]" VALUE 0x191636 AblGLKWuw_S1 65535 X1_S1 0 65535 FORMAT "%8.2" /end CHARACTERISTIC
/begin MEASUREMENT OutMDth_stDthAmpOn "F2861: Bit Array indicating dither amplitude On/Off per dither channel" ULONG X1_S1 1 100 0 4294967295 ECU_ADDRESS 0xFFF92F2C FORMAT "%13.2" /end MEASUREMENT
/begin MEASUREMENT OutMDth_stDthPerChng "F2861: Bit Array indicating Dither period change per dither group" UWORD X1_S1 1 100 0 65535 ECU_ADDRESS 0xFFF93542 FORMAT "%8.2" /end MEASUREMENT
/begin MEASUREMENT OutMDth_tAtfFlt "F2861: Current Atf-temperature as reference value (Filtered)" SWORD T0_0625_S1 1 100 -2048 2047.938 ECU_ADDRESS 0xFFF93544 FORMAT "%8.3" /end MEASUREMENT
/begin CHARACTERISTIC OutMDth_tPerTempHi_C "F2861: Threshold for the high temperature periode (no SERAP)" VAL_BLK 0x191628 AblGLKWBsw_S1 255 T0_0625_S1 -40 215 MATRIX_DIM 3 1 1 FORMAT "%8.4" /end CHARACTERISTIC
/begin CHARACTERISTIC OutMDth_tPerTempLo_C "F2861: Threshold for the low temperature periode (no SERAP)" VAL_BLK 0x19162E AblGLKWBsw_S1 255 T0_0625_S1 -40 215 MATRIX_DIM 3 1 1 FORMAT "%8.4" /end CHARACTERISTIC
/begin MEASUREMENT OutMDth_tiDthPer "F2861: Dither period" UWORD TI0_001_M_S1 1 100 0 0.032 ECU_ADDRESS 0xFFF93546 FORMAT "%10.8" MATRIX_DIM 3 1 1 /end MEASUREMENT
/begin MEASUREMENT OutMDth_tiMinSwtOff "F2861: Timer for the min. switch off duration of the dither amplitude at a large current change" UBYTE TI1_M_CYCLE_S1 1 100 0 1275 ECU_ADDRESS 0xFFF941DE FORMAT "%5.0" MATRIX_DIM 10 1 1 /end MEASUREMENT
/begin CHARACTERISTIC OutMDth_tiMinSwtOff_C "F2861: Timer reload value for the min. switch off duration" VAL_BLK 0x191638 AblGLKWBub_S1 1275 TI1_M_CYCLE_S1 0 1275 MATRIX_DIM 10 1 1 FORMAT "%5.0" /end CHARACTERISTIC
/begin CHARACTERISTIC OutMDth_tiPerTempHi_C "F2861: Dither period for high temperatures (no SERAP)" VAL_BLK 0x19161C AblGLKWBuw_S1 65.535 TI0_001_M_S1 0 65.535 MATRIX_DIM 3 1 1 FORMAT "%8.5" /end CHARACTERISTIC
/begin CHARACTERISTIC OutMDth_tiPerTempLo_C "F2861: Dither period for low temperatures (no SERAP)" VAL_BLK 0x191622 AblGLKWBuw_S1 65.535 TI0_001_M_S1 0 65.535 MATRIX_DIM 3 1 1 FORMAT "%8.5" /end CHARACTERISTIC
/begin MEASUREMENT OutMDth_uSplyDmy "F2861: Supply voltage for a selected channel (dummy value is only for characteristic curve; not saved for each channel)" SWORD U0_001_S1 1 100 -32.768 32.767 ECU_ADDRESS 0xFFF9354C FORMAT "%8.5" /end MEASUREMENT
/begin MEASUREMENT OutMEe_iCc08Comp "F2862: Current compensation value from EEPROM" SWORD I0_0001_S1 1 100 -3.2768 3.2767 ECU_ADDRESS 0xFFF92F30 FORMAT "%8.6" MATRIX_DIM 10 1 1 /end MEASUREMENT
/begin MEASUREMENT OutMEe_stCc08Avl "F2862: Flag to signal that EEPROM current values are valid" ULONG X1_S1 1 100 0 4294967295 ECU_ADDRESS 0xFFF92F44 FORMAT "%13.2" /end MEASUREMENT
/begin CHARACTERISTIC OutMRstn_facActrWuFlt1_C "F2863: 1.PT1-filter constant for self-heating of actuator" VAL_BLK 0x1910E4 AblGLKWBuw_S1 1 R0_0001_S1 0 1 MATRIX_DIM 10 1 1 FORMAT "%8.6" /end CHARACTERISTIC
/begin CHARACTERISTIC OutMRstn_facActrWuFlt2_C "F2863: 2.PT1-filter constant for self-heating of actuator" VAL_BLK 0x1910F8 AblGLKWBuw_S1 1 R0_0001_S1 0 1 MATRIX_DIM 10 1 1 FORMAT "%8.6" /end CHARACTERISTIC
/begin CHARACTERISTIC OutMRstn_facActrWuFlt_C "F2863: Rating factor of PT1-filters for actuator self-heating" VAL_BLK 0x19110C AblGLKWBuw_S1 1 R0_0001_S1 0 1 MATRIX_DIM 10 1 1 FORMAT "%8.6" /end CHARACTERISTIC
/begin CHARACTERISTIC OutMRstn_facAtfFlt_C "F2863: PT1-filter constant for oil temperature of actuator" VALUE 0x19168C AblGLKWuw_S1 1 R0_0001_S1 0 1 FORMAT "%8.6" /end CHARACTERISTIC
/begin CHARACTERISTIC OutMRstn_iActrWuRef_C "F2863: Reference current value for calculation of self-heating" VALUE 0x19168E AblGLKWuw_S1 3.17 I0_0001_S1 0.03 3.2 FORMAT "%8.6" /end CHARACTERISTIC
/begin CHARACTERISTIC OutMRstn_resActr20_C "F2863: Internal resistance of actuator for reference temperature 20°C" VAL_BLK 0x191120 AblGLKWBuw_S1 32 RES0_001_S1 0 32 MATRIX_DIM 10 1 1 FORMAT "%8.5" /end CHARACTERISTIC
/begin MEASUREMENT OutMRstn_resActrMod "F2863: Calculated resistance for current feedback calculation" UWORD RES0_001_S1 1 100 0 32 ECU_ADDRESS 0xFFF92F5C FORMAT "%8.5" MATRIX_DIM 10 1 1 /end MEASUREMENT
/begin CHARACTERISTIC OutMRstn_resRmn_C "F2863: Remaining resistances on the measuring path (wire + contact)" VAL_BLK 0x191134 AblGLKWBuw_S1 3 RES0_001_S1 0 3 MATRIX_DIM 10 1 1 FORMAT "%8.6" /end CHARACTERISTIC
/begin CHARACTERISTIC OutMRstn_resSht_C[0] "F2863: Measured shunt dependent on chip temperature" CURVE 0x191148 AblGLKLsw_S1 1 RES0_001_S1 0 1
 /begin AXIS_DESCR STD_AXIS OutMRstn_tChpRef T0_0625_S1 4 -40 215 DEPOSIT ABSOLUTE FORMAT "%8.4" /end AXIS_DESCR
 FORMAT "%8.6" /end CHARACTERISTIC
/begin CHARACTERISTIC OutMRstn_resSht_C[1] "F2863: Measured shunt dependent on chip temperature" CURVE 0x19115A AblGLKLsw_S1 1 RES0_001_S1 0 1
 /begin AXIS_DESCR STD_AXIS OutMRstn_tChpRef T0_0625_S1 4 -40 215 DEPOSIT ABSOLUTE FORMAT "%8.4" /end AXIS_DESCR
 FORMAT "%8.6" /end CHARACTERISTIC
/begin CHARACTERISTIC OutMRstn_resSht_C[2] "F2863: Measured shunt dependent on chip temperature" CURVE 0x19116C AblGLKLsw_S1 1 RES0_001_S1 0 1
 /begin AXIS_DESCR STD_AXIS OutMRstn_tChpRef T0_0625_S1 4 -40 215 DEPOSIT ABSOLUTE FORMAT "%8.4" /end AXIS_DESCR
 FORMAT "%8.6" /end CHARACTERISTIC
/begin CHARACTERISTIC OutMRstn_resSht_C[3] "F2863: Measured shunt dependent on chip temperature" CURVE 0x19117E AblGLKLsw_S1 1 RES0_001_S1 0 1
 /begin AXIS_DESCR STD_AXIS OutMRstn_tChpRef T0_0625_S1 4 -40 215 DEPOSIT ABSOLUTE FORMAT "%8.4" /end AXIS_DESCR
 FORMAT "%8.6" /end CHARACTERISTIC
/begin CHARACTERISTIC OutMRstn_resSht_C[4] "F2863: Measured shunt dependent on chip temperature" CURVE 0x191190 AblGLKLsw_S1 1 RES0_001_S1 0 1
 /begin AXIS_DESCR STD_AXIS OutMRstn_tChpRef T0_0625_S1 4 -40 215 DEPOSIT ABSOLUTE FORMAT "%8.4" /end AXIS_DESCR
 FORMAT "%8.6" /end CHARACTERISTIC
/begin CHARACTERISTIC OutMRstn_resSht_C[5] "F2863: Measured shunt dependent on chip temperature" CURVE 0x1911A2 AblGLKLsw_S1 1 RES0_001_S1 0 1
 /begin AXIS_DESCR STD_AXIS OutMRstn_tChpRef T0_0625_S1 4 -40 215 DEPOSIT ABSOLUTE FORMAT "%8.4" /end AXIS_DESCR
 FORMAT "%8.6" /end CHARACTERISTIC
/begin CHARACTERISTIC OutMRstn_resSht_C[6] "F2863: Measured shunt dependent on chip temperature" CURVE 0x1911B4 AblGLKLsw_S1 1 RES0_001_S1 0 1
 /begin AXIS_DESCR STD_AXIS OutMRstn_tChpRef T0_0625_S1 4 -40 215 DEPOSIT ABSOLUTE FORMAT "%8.4" /end AXIS_DESCR
 FORMAT "%8.6" /end CHARACTERISTIC
/begin CHARACTERISTIC OutMRstn_resSht_C[7] "F2863: Measured shunt dependent on chip temperature" CURVE 0x1911C6 AblGLKLsw_S1 1 RES0_001_S1 0 1
 /begin AXIS_DESCR STD_AXIS OutMRstn_tChpRef T0_0625_S1 4 -40 215 DEPOSIT ABSOLUTE FORMAT "%8.4" /end AXIS_DESCR
 FORMAT "%8.6" /end CHARACTERISTIC
/begin CHARACTERISTIC OutMRstn_resSht_C[8] "F2863: Measured shunt dependent on chip temperature" CURVE 0x1911D8 AblGLKLsw_S1 1 RES0_001_S1 0 1
 /begin AXIS_DESCR STD_AXIS OutMRstn_tChpRef T0_0625_S1 4 -40 215 DEPOSIT ABSOLUTE FORMAT "%8.4" /end AXIS_DESCR
 FORMAT "%8.6" /end CHARACTERISTIC
/begin CHARACTERISTIC OutMRstn_resSht_C[9] "F2863: Measured shunt dependent on chip temperature" CURVE 0x1911EA AblGLKLsw_S1 1 RES0_001_S1 0 1
 /begin AXIS_DESCR STD_AXIS OutMRstn_tChpRef T0_0625_S1 4 -40 215 DEPOSIT ABSOLUTE FORMAT "%8.4" /end AXIS_DESCR
 FORMAT "%8.6" /end CHARACTERISTIC
/begin MEASUREMENT OutMRstn_tActrWuFlt "F2863: Actuator temperature filtered" UWORD T0_0078125_S1 1 100 0 215 ECU_ADDRESS 0xFFF92F70 FORMAT "%8.4" MATRIX_DIM 10 1 1 /end MEASUREMENT
/begin MEASUREMENT OutMRstn_tActrWuFlt1 "F2863: First interim value of PT1-filter of the actuator temperature" UWORD T0_0078125_S1 1 100 0 215 ECU_ADDRESS 0xFFF92F84 FORMAT "%8.4" MATRIX_DIM 10 1 1 /end MEASUREMENT
/begin MEASUREMENT OutMRstn_tActrWuFlt2 "F2863: Second interim value of PT1-filter of the actuator temperature" UWORD T0_0078125_S1 1 100 0 215 ECU_ADDRESS 0xFFF92F98 FORMAT "%8.4" MATRIX_DIM 10 1 1 /end MEASUREMENT
/begin CHARACTERISTIC OutMRstn_tActrWu_C[0] "F2863: Self-heating of actuator because of electric power dissipation at 850mA" CURVE 0x1911FC AblGLKLsw_S1 40 T0_0078125_S1 0 40
 /begin AXIS_DESCR STD_AXIS OutMRstn_tAtfRef T0_0625_S1 3 -40 215 DEPOSIT ABSOLUTE FORMAT "%8.4" /end AXIS_DESCR
 FORMAT "%8.5" /end CHARACTERISTIC
/begin CHARACTERISTIC OutMRstn_tActrWu_C[1] "F2863: Self-heating of actuator because of electric power dissipation at 850mA" CURVE 0x19120A AblGLKLsw_S1 40 T0_0078125_S1 0 40
 /begin AXIS_DESCR STD_AXIS OutMRstn_tAtfRef T0_0625_S1 3 -40 215 DEPOSIT ABSOLUTE FORMAT "%8.4" /end AXIS_DESCR
 FORMAT "%8.5" /end CHARACTERISTIC
/begin CHARACTERISTIC OutMRstn_tActrWu_C[2] "F2863: Self-heating of actuator because of electric power dissipation at 850mA" CURVE 0x191218 AblGLKLsw_S1 40 T0_0078125_S1 0 40
 /begin AXIS_DESCR STD_AXIS OutMRstn_tAtfRef T0_0625_S1 3 -40 215 DEPOSIT ABSOLUTE FORMAT "%8.4" /end AXIS_DESCR
 FORMAT "%8.5" /end CHARACTERISTIC
/begin CHARACTERISTIC OutMRstn_tActrWu_C[3] "F2863: Self-heating of actuator because of electric power dissipation at 850mA" CURVE 0x191226 AblGLKLsw_S1 40 T0_0078125_S1 0 40
 /begin AXIS_DESCR STD_AXIS OutMRstn_tAtfRef T0_0625_S1 3 -40 215 DEPOSIT ABSOLUTE FORMAT "%8.4" /end AXIS_DESCR
 FORMAT "%8.5" /end CHARACTERISTIC
/begin CHARACTERISTIC OutMRstn_tActrWu_C[4] "F2863: Self-heating of actuator because of electric power dissipation at 850mA" CURVE 0x191234 AblGLKLsw_S1 40 T0_0078125_S1 0 40
 /begin AXIS_DESCR STD_AXIS OutMRstn_tAtfRef T0_0625_S1 3 -40 215 DEPOSIT ABSOLUTE FORMAT "%8.4" /end AXIS_DESCR
 FORMAT "%8.5" /end CHARACTERISTIC
/begin CHARACTERISTIC OutMRstn_tActrWu_C[5] "F2863: Self-heating of actuator because of electric power dissipation at 850mA" CURVE 0x191242 AblGLKLsw_S1 40 T0_0078125_S1 0 40
 /begin AXIS_DESCR STD_AXIS OutMRstn_tAtfRef T0_0625_S1 3 -40 215 DEPOSIT ABSOLUTE FORMAT "%8.4" /end AXIS_DESCR
 FORMAT "%8.5" /end CHARACTERISTIC
/begin CHARACTERISTIC OutMRstn_tActrWu_C[6] "F2863: Self-heating of actuator because of electric power dissipation at 850mA" CURVE 0x191250 AblGLKLsw_S1 40 T0_0078125_S1 0 40
 /begin AXIS_DESCR STD_AXIS OutMRstn_tAtfRef T0_0625_S1 3 -40 215 DEPOSIT ABSOLUTE FORMAT "%8.4" /end AXIS_DESCR
 FORMAT "%8.5" /end CHARACTERISTIC
/begin CHARACTERISTIC OutMRstn_tActrWu_C[7] "F2863: Self-heating of actuator because of electric power dissipation at 850mA" CURVE 0x19125E AblGLKLsw_S1 40 T0_0078125_S1 0 40
 /begin AXIS_DESCR STD_AXIS OutMRstn_tAtfRef T0_0625_S1 3 -40 215 DEPOSIT ABSOLUTE FORMAT "%8.4" /end AXIS_DESCR
 FORMAT "%8.5" /end CHARACTERISTIC
/begin CHARACTERISTIC OutMRstn_tActrWu_C[8] "F2863: Self-heating of actuator because of electric power dissipation at 850mA" CURVE 0x19126C AblGLKLsw_S1 40 T0_0078125_S1 0 40
 /begin AXIS_DESCR STD_AXIS OutMRstn_tAtfRef T0_0625_S1 3 -40 215 DEPOSIT ABSOLUTE FORMAT "%8.4" /end AXIS_DESCR
 FORMAT "%8.5" /end CHARACTERISTIC
/begin CHARACTERISTIC OutMRstn_tActrWu_C[9] "F2863: Self-heating of actuator because of electric power dissipation at 850mA" CURVE 0x19127A AblGLKLsw_S1 40 T0_0078125_S1 0 40
 /begin AXIS_DESCR STD_AXIS OutMRstn_tAtfRef T0_0625_S1 3 -40 215 DEPOSIT ABSOLUTE FORMAT "%8.4" /end AXIS_DESCR
 FORMAT "%8.5" /end CHARACTERISTIC
/begin MEASUREMENT OutMRstn_tAtfFlt "F2863: Oil temperature filtered" SWORD T0_0078125_S1 1 100 -40 215 ECU_ADDRESS 0xFFF948E4 FORMAT "%8.4" /end MEASUREMENT
/begin MEASUREMENT OutMRstn_tAtfRef "F2863: Oil temperature" SWORD T0_0625_S1 1 100 -40 215 ECU_ADDRESS 0xFFF948E6 FORMAT "%8.4" /end MEASUREMENT
/begin MEASUREMENT OutMRstn_tChpRef "F2863: Chip temperature" SWORD T0_0625_S1 1 100 -40 215 ECU_ADDRESS 0xFFF9354E FORMAT "%8.4" /end MEASUREMENT
/begin MEASUREMENT OutMRstn_tiCalcRate "F2863: Timer for resistance task rate" UWORD TI1_M_CYCLE_S1 1 100 0 255 ECU_ADDRESS 0xFFF9418C FORMAT "%8.4" /end MEASUREMENT
/begin CHARACTERISTIC OutPCc08Tolc_facCc08GradLimHi_C "F2531: Factor of the current gradient monitoring (upper limit)" CURVE 0x191736 AblGLKLsw_S1 10 R0_001_S1 0 10
 /begin AXIS_DESCR STD_AXIS OutPCc08Tolc_iCc08GradDmy I0_0001_S1 9 -3.2 3.2 DEPOSIT ABSOLUTE FORMAT "%8.6" /end AXIS_DESCR
 FORMAT "%8.5" /end CHARACTERISTIC
/begin CHARACTERISTIC OutPCc08Tolc_facCc08GradLimLo_C "F2531: Factor of the current gradient monitoring (lower limit)" CURVE 0x19175C AblGLKLsw_S1 10 R0_001_S1 0 10
 /begin AXIS_DESCR STD_AXIS OutPCc08Tolc_iCc08GradDmy I0_0001_S1 9 -3.2 3.2 DEPOSIT ABSOLUTE FORMAT "%8.6" /end AXIS_DESCR
 FORMAT "%8.5" /end CHARACTERISTIC
/begin CHARACTERISTIC OutPCc08Tolc_iCc08CrntGen_C "F2531: Current tolerance expansion if other VFS change their current control" VALUE 0x191782 AblGLKWuw_S1 0.3 I0_0001_S1 0 0.3 FORMAT "%9.7" /end CHARACTERISTIC
/begin CHARACTERISTIC OutPCc08Tolc_iCc08DthAmpOn_C "F2531: Current tolerance expansion with dither active" VAL_BLK 0x1913F0 AblGLKWBuw_S1 1 I0_0001_S1 0 1 MATRIX_DIM 10 1 1 FORMAT "%8.6" /end CHARACTERISTIC
/begin MEASUREMENT OutPCc08Tolc_iCc08Grad "F2531: Current gradient (absolute)" SWORD I0_0001_S1 1 100 -3.2 3.2 ECU_ADDRESS 0xFFF93100 FORMAT "%8.6" MATRIX_DIM 10 1 1 /end MEASUREMENT
/begin CHARACTERISTIC OutPCc08Tolc_iCc08GradAbsHi_C "F2531: Current limit  for gradient diagnosis (high range)" VAL_BLK 0x191404 AblGLKWBuw_S1 3.2 I0_0001_S1 0 3.2 MATRIX_DIM 10 1 1 FORMAT "%8.6" /end CHARACTERISTIC
/begin CHARACTERISTIC OutPCc08Tolc_iCc08GradAbsLo_C "F2531: Current limit  for gradient diagnosis (low range)" VAL_BLK 0x191418 AblGLKWBuw_S1 3.2 I0_0001_S1 0 3.2 MATRIX_DIM 10 1 1 FORMAT "%8.6" /end CHARACTERISTIC
/begin MEASUREMENT OutPCc08Tolc_iCc08GradDmy "F2531: Current gradient (dummy for charcteristic line)" SWORD I0_0001_S1 1 100 -3.2 3.2 ECU_ADDRESS 0xFFF9365E FORMAT "%8.6" /end MEASUREMENT
/begin CHARACTERISTIC OutPCc08Tolc_iCc08GradLimMax_C "F2531: Maximally possible current gradient for the diagnosis" VAL_BLK 0x19142C AblGLKWBuw_S1 1 I0_0001_S1 0 1 MATRIX_DIM 10 1 1 FORMAT "%8.6" /end CHARACTERISTIC
/begin CHARACTERISTIC OutPCc08Tolc_iCc08Noi_C "F2531: Current tolerance expansion if noise was detected on battery supply" VALUE 0x191784 AblGLKWuw_S1 0.3 I0_0001_S1 0 0.3 FORMAT "%9.7" /end CHARACTERISTIC
/begin CHARACTERISTIC OutPCc08Tolc_iCc08RngLim_C "F2531: Band edge for high / low current distinction" VALUE 0x191786 AblGLKWuw_S1 1 I0_0001_S1 0 1 FORMAT "%8.6" /end CHARACTERISTIC
/begin CHARACTERISTIC OutPCc08Tolc_iCc08TempIncor_C "F2531: Current tolerance expansion if temperature sensor deliver incorrect values" VALUE 0x191788 AblGLKWuw_S1 0.3 I0_0001_S1 0 0.3 FORMAT "%9.7" /end CHARACTERISTIC
/begin MEASUREMENT OutPCc08Tolc_iCc08TolcLimHi "F2531: High limit of tolerance deviation of current input" UWORD I0_0001_S1 1 100 0 3.2 ECU_ADDRESS 0xFFF93114 FORMAT "%8.6" MATRIX_DIM 10 1 1 /end MEASUREMENT
/begin MEASUREMENT OutPCc08Tolc_iCc08TolcLimLo "F2531: Low limit of tolerance deviation of current input" UWORD I0_0001_S1 1 100 0 3.2 ECU_ADDRESS 0xFFF93128 FORMAT "%8.6" MATRIX_DIM 10 1 1 /end MEASUREMENT
/begin CHARACTERISTIC OutPCc08Tolc_iCc08TolcRngHi_C "F2531: Current deviation to detect an error while high current range" VALUE 0x19178A AblGLKWuw_S1 0.5 I0_0001_S1 0 0.5 FORMAT "%9.7" /end CHARACTERISTIC
/begin CHARACTERISTIC OutPCc08Tolc_iCc08TolcRngLo_C "F2531: Current deviation to detect an error while low current range" VALUE 0x19178C AblGLKWuw_S1 0.5 I0_0001_S1 0 0.5 FORMAT "%9.7" /end CHARACTERISTIC
/begin CHARACTERISTIC OutPCc08Tolc_stCc08GradRng_C "F2531: Selection switch of current gradient diagnosis: 0=off, 1=low range only, 2=high range only, 3=low and high range" VAL_BLK 0x19178E AblGLKWBub_S1 3 X1_S1 0 3 MATRIX_DIM 10 1 1 FORMAT "%5.3" /end CHARACTERISTIC
/begin CHARACTERISTIC OutPCc08Tolc_stCc08TolcRng_C "F2531: Selection switch of current monitoring range: 0=off, 1=low range only, 2=high range only, 3=low and high range" VAL_BLK 0x191798 AblGLKWBub_S1 3 X1_S1 0 3 MATRIX_DIM 10 1 1 FORMAT "%5.3" /end CHARACTERISTIC
/begin MEASUREMENT OutPCc08Tolc_tiCc08DthAmpOn "F2531: timer for dither active lengthening time" UBYTE TI1_M_CYCLE_S1 1 100 0 1275 ECU_ADDRESS 0xFFF94210 FORMAT "%5.0" MATRIX_DIM 10 1 1 /end MEASUREMENT
/begin CHARACTERISTIC OutPCc08Tolc_tiCc08DthAmpOn_C "F2531: dither active lengthening time for current tolerance expansion" VAL_BLK 0x1917A2 AblGLKWBub_S1 1275 TI1_M_CYCLE_S1 0 1275 MATRIX_DIM 10 1 1 FORMAT "%5.0" /end CHARACTERISTIC
/begin MEASUREMENT OutPCc08Tolc_tiCc08DthChng "F2531: Lag timer for dither frequence or amplitude change" UBYTE TI1_M_CYCLE_S1 1 100 0 1275 ECU_ADDRESS 0xFFF9421A FORMAT "%5.0" MATRIX_DIM 10 1 1 /end MEASUREMENT
/begin CHARACTERISTIC OutPCc08Tolc_tiCc08DthChng_C "F2531: lag time for dither frequence or amplitude change" VAL_BLK 0x1917AC AblGLKWBub_S1 1275 TI1_M_CYCLE_S1 0 1275 MATRIX_DIM 10 1 1 FORMAT "%5.0" /end CHARACTERISTIC
/begin MEASUREMENT OutPCc08Tolc_tiCc08GradHi "F2531: Lag counter for current gradient diagnosis (high range)" UWORD TI1_M_CYCLE_S1 1 100 0 327675 ECU_ADDRESS 0xFFF94158 FORMAT "%8.1" MATRIX_DIM 10 1 1 /end MEASUREMENT
/begin CHARACTERISTIC OutPCc08Tolc_tiCc08GradHi_C "F2531: Start value lag counter for current gradient diagnosis (high range)" CURVE 0x1917B6 AblGLKLsw_S1 200 TI1_M_CYCLE_S1 0 200
 /begin AXIS_DESCR STD_AXIS OutPCc08Tolc_iCc08GradDmy I0_0001_S1 9 -3.2 3.2 DEPOSIT ABSOLUTE FORMAT "%8.6" /end AXIS_DESCR
 FORMAT "%8.4" /end CHARACTERISTIC
/begin MEASUREMENT OutPCc08Tolc_tiCc08GradLo "F2531: Lag counter for current gradient diagnosis (low range)" UWORD TI1_M_CYCLE_S1 1 100 0 327675 ECU_ADDRESS 0xFFF9416C FORMAT "%8.1" MATRIX_DIM 10 1 1 /end MEASUREMENT
/begin CHARACTERISTIC OutPCc08Tolc_tiCc08GradLo_C "F2531: Start value lag counter for current gradient diagnosis (low range)" CURVE 0x1917DC AblGLKLsw_S1 200 TI1_M_CYCLE_S1 0 200
 /begin AXIS_DESCR STD_AXIS OutPCc08Tolc_iCc08GradDmy I0_0001_S1 9 -3.2 3.2 DEPOSIT ABSOLUTE FORMAT "%8.6" /end AXIS_DESCR
 FORMAT "%8.4" /end CHARACTERISTIC
/begin MEASUREMENT OutPCc08Tolc_tiCc08Noi "F2531: Lag counter for current tolerance expansion if noise was detected on battery supply" UBYTE TI1_M_CYCLE_S1 1 100 0 255 ECU_ADDRESS 0xFFF9424A FORMAT "%5.1" /end MEASUREMENT
/begin CHARACTERISTIC OutPCc08Tolc_tiCc08Noi_C "F2531: Start value of lag counter for current tolerance expansion if noise was detected on battery supply" VALUE 0x1919EC AblGLKWub_S1 255 TI1_M_CYCLE_S1 0 255 FORMAT "%5.1" /end CHARACTERISTIC
/begin MEASUREMENT OutPPclkCtl_stPclk "F2545: Internal status of the Pclk [B0: Hi, B1: Lo, B2: OnOff, B3: OnAftOff, B4: Pclk was OFF, B5: Monitoring locked]" UBYTE X1_S1 1 100 0 255 ECU_ADDRESS 0xFFF93B6B FORMAT "%5.1" /end MEASUREMENT
/begin MEASUREMENT OutPPclkCtl_stPclkCtl "F2545: Request to switch ON or OFF the Pclk [0x0=Default, 0x55=ON, 0xAA=OFF]" UBYTE X1_S1 1 100 0 255 ECU_ADDRESS 0xFFF93B6C FORMAT "%5.1" /end MEASUREMENT
/begin MEASUREMENT OutPPclkCtl_stPclkOpsOn "F2545: Request of Pclk mode [0x11=INIT, 0x33=ACTIVE_ON]" UBYTE X1_S1 1 100 0 255 ECU_ADDRESS 0xFFF93B6D FORMAT "%5.1" /end MEASUREMENT
/begin MEASUREMENT OutPPclkCtl_stPclkTst "F2545: Request to set the test status [0x0=Test done, 0xAA=Test request, 0x55=Test locked]" UBYTE X1_S1 1 100 0 255 ECU_ADDRESS 0xFFF93B6E FORMAT "%5.1" /end MEASUREMENT
/begin MEASUREMENT OutPPclkMon_stPclkFault "F2545: Variable to measure the faults of the Pclk monitoring system. This variable is bit coded for further information take a look in the docu!" UWORD X1_S1 1 100 0 65535 ECU_ADDRESS 0xFFF93660 FORMAT "%8.2" /end MEASUREMENT
/begin MEASUREMENT OutPPclkMon_stPclkTstCond "F2545: Variable to measure the test conditions of the Pclk monitoring system. This variable is bit coded for further information take a look in the docu!" UWORD X1_S1 1 100 0 65535 ECU_ADDRESS 0xFFF93662 FORMAT "%8.2" /end MEASUREMENT
/begin MEASUREMENT OutPStlkIn_stStlkChpLine "F2550: Stores the position lever info. Needed to verify if it is allowed to activate the starter lock" UBYTE X1_S1 1 100 0 63 ECU_ADDRESS 0xFFF93B95 FORMAT "%5.2" /end MEASUREMENT
/begin MEASUREMENT OutPStlkIn_stStlkPlrInfo "F2550: Status of current and last program cycle, if the starter lock should be off or on" UBYTE X1_S1 1 100 0 15 ECU_ADDRESS 0xFFF93B96 FORMAT "%5.2" /end MEASUREMENT
/begin CHARACTERISTIC OutPStlkIn_stStlkSelSply_C "F2550: Selection for Stlk supply [-2=T30, -1=T15]" VALUE 0x1919FC AblGLKWsb_S1 1 X1_S1 -2 -1 FORMAT "%5.3" /end CHARACTERISTIC
/begin MEASUREMENT OutPStlkIn_tiStlkOff "F2550: Remaining monitoring delay from the starter lock state on to off" UWORD TI1_M_CYCLE_S1 1 100 0 327675 ECU_ADDRESS 0xFFF941A2 FORMAT "%8.1" /end MEASUREMENT
/begin CHARACTERISTIC OutPStlkIn_tiStlkOff_C "F2550: Monitoring delay if the starter lock state changes from on to off" VALUE 0x19186E AblGLKWuw_S1 327675 TI1_M_CYCLE_S1 0 327675 FORMAT "%8.1" /end CHARACTERISTIC
/begin MEASUREMENT OutPStlkIn_tiStlkOn "F2550: Remaining monitoring delay from the starter lock state off to on" UBYTE TI1_M_CYCLE_S1 1 100 0 1275 ECU_ADDRESS 0xFFF94257 FORMAT "%5.0" /end MEASUREMENT
/begin CHARACTERISTIC OutPStlkIn_tiStlkOn_C "F2550: Monitoring delay if the starter lock state changes from off to on" VALUE 0x1919FD AblGLKWub_S1 1275 TI1_M_CYCLE_S1 0 1275 FORMAT "%5.0" /end CHARACTERISTIC
/begin CHARACTERISTIC OutPStlkIn_uStlkStrtJmp_C "F2550: Read back voltage jump of the starter lock signal" VALUE 0x191870 AblGLKWuw_S1 32 U0_001_S1 0 32 FORMAT "%8.5" /end CHARACTERISTIC
/begin MEASUREMENT OutPStlkIn_uStlkStrtRly "F2550: Read back voltage of the starter lock signal" UWORD U0_001_S1 1 100 0 32 ECU_ADDRESS 0xFFF93668 FORMAT "%8.5" /end MEASUREMENT
/begin MEASUREMENT OutPStlkMon_stStlkFault "F2525: Status of fault [B2: SB, B3: SG, B8: LO, B9: HI]" UWORD X1_S1 1 100 0 65535 ECU_ADDRESS 0xFFF9366A FORMAT "%8.2" /end MEASUREMENT
/begin CHARACTERISTIC OutPStlkMon_stStlkSelSwt_C "F2550: Selection status to use Stlk as low or high side switch [0=Lss, 1=Hss]" VALUE 0x1919FE AblGLKWub_S1 1 X1_S1 0 1 FORMAT "%5.3" /end CHARACTERISTIC
/begin MEASUREMENT OutPStlkMon_stStlkTstCond "F2550: Status of test condition [B2: SB, B3: SG, B8: LO, B9: HI]" UWORD X1_S1 1 100 0 65535 ECU_ADDRESS 0xFFF9366C FORMAT "%8.2" /end MEASUREMENT
/begin CHARACTERISTIC OutPStlkMon_stStlkTstCond_C "F2550: Enable test condition [B2: SB, B3: SG, B8: LO, B9: HI; 0=Off, 1=On]" VALUE 0x191872 AblGLKWuw_S1 65535 X1_S1 0 65535 FORMAT "%8.2" /end CHARACTERISTIC
/begin CHARACTERISTIC OutPStlkMon_uStlkTstLo_C "F2550: Lower voltage threshold of test condition" VALUE 0x191874 AblGLKWuw_S1 14 U0_001_S1 0 14 FORMAT "%8.5" /end CHARACTERISTIC
/begin CHARACTERISTIC OutPStlkMon_uStlkTstSB_C "F2550: Voltage threshold for short to battery detection" VALUE 0x191876 AblGLKWuw_S1 13 U0_001_S1 1 14 FORMAT "%8.5" /end CHARACTERISTIC
/begin CHARACTERISTIC OutPStlkMon_uStlkTstSG_C "F2550: Voltage threshold for short to ground detection" VALUE 0x191878 AblGLKWuw_S1 5 U0_001_S1 0 5 FORMAT "%8.6" /end CHARACTERISTIC
/begin CHARACTERISTIC OutPStlkOut_bStlkCtl_C "F2550: Enable starter lock control via interface [0=Off, 1=On]" VALUE 0x191916 AblGLKWub_S1 1 X1_S1 0 1 FORMAT "%5.3" /end CHARACTERISTIC
/begin MEASUREMENT OutPStlkOut_bStlkOut "F2550: Status of starter lock control [0=Off, 1=On]" UBYTE B_TRUE_S1 1 100 0 1 ECU_ADDRESS 0xFFF93B2C FORMAT "%13.11" /end MEASUREMENT
/begin MEASUREMENT OutPStlkOut_bStlkSpiOff "F2550: Switch off starter lock signal via SPI [0=Off, 1=On]" UBYTE B_TRUE_S1 1 100 0 1 ECU_ADDRESS 0xFFF93B2D FORMAT "%13.11" /end MEASUREMENT
/begin MEASUREMENT OutPStlkOut_stStlk "F2550: Input status of starter lock control" UBYTE X1_S1 1 100 0 3 ECU_ADDRESS 0xFFF93B2E FORMAT "%5.3" /end MEASUREMENT
/begin MEASUREMENT OutPStlkOut_tiStlkCtl "F2550: Timer in which the starter lock signal is hold on its value" UWORD TI1_M_CYCLE_S1 1 100 0 327675 ECU_ADDRESS 0xFFF94184 FORMAT "%8.1" /end MEASUREMENT
/begin CHARACTERISTIC OutPStlkOut_tiStlkCtl_C "F2550: Start value of timer in which the starter lock signal is hold on its value" VALUE 0x19158A AblGLKWuw_S1 327675 TI1_M_CYCLE_S1 0 327675 FORMAT "%8.1" /end CHARACTERISTIC
/begin MEASUREMENT OutPStlkOut_tiStlkHwAck "F2550: Delay timer untill the HW has acknowledged the control signal" UWORD TI1_M_CYCLE_S1 1 100 0 327675 ECU_ADDRESS 0xFFF94186 FORMAT "%8.1" /end MEASUREMENT
/begin CHARACTERISTIC OutPStlkOut_tiStlkHwAck_C "F2550: Start value for delay timer untill the HW has acknowledged the control signal" VALUE 0x19158C AblGLKWuw_S1 327675 TI1_M_CYCLE_S1 0 327675 FORMAT "%8.1" /end CHARACTERISTIC
/begin MEASUREMENT PFCCtl_numMemArSizeUsd "F6100: Size of used memory space for PFC configuration (activation phase) [4byte]" UWORD X1_S1 1 100 0 65535 ECU_ADDRESS 0xFFF935D4 FORMAT "%8.2" /end MEASUREMENT
/begin MEASUREMENT PFCMn_bVldInfoPerm_a "F6100: Valid flag of stored fault information (non-volatile)" UBYTE X1_S1 1 100 0 255 ECU_ADDRESS 0xFFF94394 FORMAT "%5.1" MATRIX_DIM 2 1 1 /end MEASUREMENT
/begin MEASUREMENT PFCMn_bVldInfo_a "F6100: Valid flag of stored fault information" UBYTE X1_S1 1 100 0 255 ECU_ADDRESS 0xFFF80CFE FORMAT "%5.1" MATRIX_DIM 2 1 1 /end MEASUREMENT
/begin MEASUREMENT PFCMn_ctMdul "F6100: Number of currently activated program flow monitors" UWORD X1_S1 1 100 0 65535 ECU_ADDRESS 0xFFF933B6 FORMAT "%8.2" /end MEASUREMENT
/begin MEASUREMENT PFCMn_idxInfoNxt "F6100: Index for next fault information storage" UBYTE X1_S1 1 100 0 1 ECU_ADDRESS 0xFFF80D1F FORMAT "%5.3" /end MEASUREMENT
/begin MEASUREMENT PFCMn_idxInfoNxtPerm "F6100: Index for next fault information storage (non-volatile)" UBYTE X1_S1 1 100 0 1 ECU_ADDRESS 0xFFF943B8 FORMAT "%5.3" /end MEASUREMENT
/begin MEASUREMENT PFCMn_numFlwIdInfoPerm_a "F6100: Program flow ID which has caused the fault (non-volatile)" UBYTE X1_S1 1 100 0 255 ECU_ADDRESS 0xFFF94396 FORMAT "%5.1" MATRIX_DIM 2 1 1 /end MEASUREMENT
/begin MEASUREMENT PFCMn_numFlwIdInfo_a "F6100: Program flow ID which has caused the fault" UBYTE X1_S1 1 100 0 255 ECU_ADDRESS 0xFFF80D00 FORMAT "%5.1" MATRIX_DIM 2 1 1 /end MEASUREMENT
/begin MEASUREMENT PFCMn_numId1InfoPerm_a "F6100: Check point ID which has caused the fault (non-volatile)" ULONG X1_S1 1 100 0 4294967295 ECU_ADDRESS 0xFFF942A0 FORMAT "%13.2" MATRIX_DIM 2 1 1 /end MEASUREMENT
/begin MEASUREMENT PFCMn_numId1Info_a "F6100: Check point ID which has caused the fault" ULONG X1_S1 1 100 0 4294967295 ECU_ADDRESS 0xFFF80CE8 FORMAT "%13.2" MATRIX_DIM 2 1 1 /end MEASUREMENT
/begin MEASUREMENT PFCMn_numId2InfoPerm_a "F6100: ID of check point which was reached directly before the fault (non-volatile)" ULONG X1_S1 1 100 0 4294967295 ECU_ADDRESS 0xFFF942A8 FORMAT "%13.2" MATRIX_DIM 2 1 1 /end MEASUREMENT
/begin MEASUREMENT PFCMn_numId2Info_a "F6100: ID of check point which was reached directly before the fault" ULONG X1_S1 1 100 0 4294967295 ECU_ADDRESS 0xFFF80CF0 FORMAT "%13.2" MATRIX_DIM 2 1 1 /end MEASUREMENT
/begin MEASUREMENT RLim_cntRstCnt "F6260: Current value of reset counter" ULONG X1_S1 1 100 0 4294967295 ECU_ADDRESS 0xFFF92A1C FORMAT "%13.2" /end MEASUREMENT
/begin CHARACTERISTIC RLim_numLimThres_C "F6260: Threshold for the reset counter to limit the system functionality (no SERAP)" VALUE 0x1904DC AblGLKWul_S1 11 X1_S1 4 15 FORMAT "%13.10" /end CHARACTERISTIC
/begin CHARACTERISTIC RLim_swtClrMode_C "F6260: Switch to change the clearing behaviour of the reset counter (0=reset to 0, otherwise=decrement by 1) (no SERAP)" VALUE 0x1918CC AblGLKWub_S1 255 X1_S1 0 255 FORMAT "%5.1" /end CHARACTERISTIC
/begin CHARACTERISTIC RLim_swtClrShOffEnbl_C "F6260: Switch to enable the clearing of the reset counter before system shutdown (0=hold counter, otherwise=clear counter) (no SERAP)" VALUE 0x1918CD AblGLKWub_S1 255 X1_S1 0 255 FORMAT "%5.1" /end CHARACTERISTIC
/begin CHARACTERISTIC RLim_swtLimFeatDisbl_C "F6260: Switch to disable the feature to limit the system functionality (0xA5=limitation feature disable, otherwise=limitation feature enabled) (no SERAP)" VALUE 0x1918CE AblGLKWub_S1 255 X1_S1 0 255 FORMAT "%5.1" /end CHARACTERISTIC
/begin CHARACTERISTIC SFRM_CC08_bTolSprdcFault_C "F6250: SFRM configuration bitfield for tolerate sporadic faults (no SERAP)" VALUE 0x19159C AblGLKWuw_S1 65535 X1_S1 0 65535 FORMAT "%8.2" /end CHARACTERISTIC
/begin CHARACTERISTIC SFRM_GMO_bTolSprdcFault_C "F6250: SFRM configuration bitfield for tolerate sporadic faults (no SERAP)" VALUE 0x19159E AblGLKWuw_S1 65535 X1_S1 0 65535 FORMAT "%8.2" /end CHARACTERISTIC
/begin CHARACTERISTIC SFRM_LSS_bTolSprdcFault_C "F6250: SFRM configuration bitfield for tolerate sporadic faults (no SERAP)" VALUE 0x1915A0 AblGLKWuw_S1 65535 X1_S1 0 65535 FORMAT "%8.2" /end CHARACTERISTIC
/begin CHARACTERISTIC SFRM_PSPLY_bTolSprdcFault_C "F6250: SFRM configuration bitfield for tolerate sporadic faults (no SERAP)" VALUE 0x1915A2 AblGLKWuw_S1 65535 X1_S1 0 65535 FORMAT "%8.2" /end CHARACTERISTIC
/begin CHARACTERISTIC SFRM_SAF_bTolSprdcFault_C "F6250: SFRM configuration bitfield for tolerate sporadic faults (no SERAP)" VALUE 0x1915A4 AblGLKWuw_S1 65535 X1_S1 0 65535 FORMAT "%8.2" /end CHARACTERISTIC
/begin MEASUREMENT SFRM_stInfoCC08_a "F6250: SFRM timer information for CC08 per channel" ULONG X1_S1 1 100 0 4294967295 ECU_ADDRESS 0xFFF9480C FORMAT "%13.2" MATRIX_DIM 10 1 1 /end MEASUREMENT
/begin MEASUREMENT SFRM_stInfoGMO_a "F6250: SFRM timer information for GMO per channel" ULONG X1_S1 1 100 0 4294967295 ECU_ADDRESS 0xFFF94834 FORMAT "%13.2" /end MEASUREMENT
/begin MEASUREMENT SFRM_stInfoLSS_a "F6250: SFRM timer information for LSS per channel" ULONG X1_S1 1 100 0 4294967295 ECU_ADDRESS 0xFFF94838 FORMAT "%13.2" MATRIX_DIM 5 1 1 /end MEASUREMENT
/begin MEASUREMENT SFRM_stInfoPSPLY_a "F6250: SFRM timer information for power supply per channel" ULONG X1_S1 1 100 0 4294967295 ECU_ADDRESS 0xFFF9484C FORMAT "%13.2" MATRIX_DIM 2 1 1 /end MEASUREMENT
/begin MEASUREMENT SFRM_stInfoSAF_a "F6250:  SFRM timer information for SAF per channel" ULONG X1_S1 1 100 0 4294967295 ECU_ADDRESS 0xFFF94854 FORMAT "%13.2" MATRIX_DIM 4 1 1 /end MEASUREMENT
/begin CHARACTERISTIC SFRM_swtSrv_C "F6250: SFRM service switch (0x5A = not active, all other values = active)" VALUE 0x191924 AblGLKWub_S1 255 X1_S1 0 255 FORMAT "%5.1" /end CHARACTERISTIC
/begin MEASUREMENT SFRM_tiDwnTmrCC08_a "F6250: SFRM Down-Timer for CC08 per channel" UBYTE TI1_M_CYCLE_S1 1 100 0 1275 ECU_ADDRESS 0xFFF941D2 FORMAT "%5.0" MATRIX_DIM 10 1 1 /end MEASUREMENT
/begin MEASUREMENT SFRM_tiDwnTmrGMO_a "F6250: SFRM Down-Timer for GMO per channel" UBYTE TI1_M_CYCLE_S1 1 100 0 1275 ECU_ADDRESS 0xFFF9423B FORMAT "%5.0" /end MEASUREMENT
/begin MEASUREMENT SFRM_tiDwnTmrLSS_a "F6250: SFRM Down-Timer for LSS per channel" UBYTE TI1_M_CYCLE_S1 1 100 0 1275 ECU_ADDRESS 0xFFF9423C FORMAT "%5.0" MATRIX_DIM 5 1 1 /end MEASUREMENT
/begin MEASUREMENT SFRM_tiDwnTmrPSPLY_a "F6250: SFRM Down-Timer for power supply per channel" UBYTE TI1_M_CYCLE_S1 1 100 0 1275 ECU_ADDRESS 0xFFF941DC FORMAT "%5.0" MATRIX_DIM 2 1 1 /end MEASUREMENT
/begin MEASUREMENT SFRM_tiDwnTmrSAF_a "F6250: SFRM Down-Timer for SAF per channel" UBYTE TI1_M_CYCLE_S1 1 100 0 1275 ECU_ADDRESS 0xFFF941A4 FORMAT "%5.0" MATRIX_DIM 4 1 1 /end MEASUREMENT
/begin CHARACTERISTIC SFRM_tiFailLtcyTCC08_C "F6250: SFRM configuration failure latency time for CC08 in ms (no SERAP)" VAL_BLK 0x1915A6 AblGLKWBub_S1 1275 TI1_M_CYCLE_S1 0 1275 MATRIX_DIM 10 1 1 FORMAT "%5.0" /end CHARACTERISTIC
/begin CHARACTERISTIC SFRM_tiFailLtcyTDFE_C "F6250: SFRM configuration failure latency time for direct-fault-entry in ms" VALUE 0x191925 AblGLKWub_S1 50 TI1_M_CYCLE_S1 0 50 FORMAT "%5.2" /end CHARACTERISTIC
/begin CHARACTERISTIC SFRM_tiFailLtcyTGMO_C "F6250: SFRM configuration failure latency time for GMO in ms (no SERAP)" VAL_BLK 0x19191E AblGLKWBub_S1 1275 TI1_M_CYCLE_S1 0 1275 MATRIX_DIM 1 1 1 FORMAT "%5.0" /end CHARACTERISTIC
/begin CHARACTERISTIC SFRM_tiFailLtcyTLSS_C "F6250: SFRM configuration failure latency time for LSS in ms (no SERAP)" VAL_BLK 0x19191F AblGLKWBub_S1 1275 TI1_M_CYCLE_S1 0 1275 MATRIX_DIM 5 1 1 FORMAT "%5.0" /end CHARACTERISTIC
/begin CHARACTERISTIC SFRM_tiFailLtcyTPSPLY_C "F6250: SFRM configuration failure latency time for power supply in ms (no SERAP)" VAL_BLK 0x1915B0 AblGLKWBub_S1 1275 TI1_M_CYCLE_S1 0 1275 MATRIX_DIM 2 1 1 FORMAT "%5.0" /end CHARACTERISTIC
/begin CHARACTERISTIC SFRM_tiFailLtcyTSAF_C "F6250: SFRM configuration failure latency time for SAF in ms (no SERAP)" VAL_BLK 0x19056C AblGLKWBub_S1 1275 TI1_M_CYCLE_S1 0 1275 MATRIX_DIM 4 1 1 FORMAT "%5.0" /end CHARACTERISTIC
/begin MEASUREMENT SFRM_tiUpTmrCC08_a "F6250: SFRM Up-Timer for CC08 per channel" UWORD TI1_M_CYCLE_S1 1 100 0 327675 ECU_ADDRESS 0xFFF94258 FORMAT "%8.1" MATRIX_DIM 10 1 1 /end MEASUREMENT
/begin MEASUREMENT SFRM_tiUpTmrGMO_a "F6250: SFRM Up-Timer for GMO per channel" UWORD TI1_M_CYCLE_S1 1 100 0 327675 ECU_ADDRESS 0xFFF94278 FORMAT "%8.1" /end MEASUREMENT
/begin MEASUREMENT SFRM_tiUpTmrLSS_a "F6250: SFRM Up-Timer for LSS per channel" UWORD TI1_M_CYCLE_S1 1 100 0 327675 ECU_ADDRESS 0xFFF9427A FORMAT "%8.1" MATRIX_DIM 5 1 1 /end MEASUREMENT
/begin MEASUREMENT SFRM_tiUpTmrPSPLY_a "F6250: SFRM Up-Timer for power supply per channel" UWORD TI1_M_CYCLE_S1 1 100 0 327675 ECU_ADDRESS 0xFFF9426C FORMAT "%8.1" MATRIX_DIM 2 1 1 /end MEASUREMENT
/begin MEASUREMENT SFRM_tiUpTmrSAF_a "F6250: SFRM Up-Timer for SAF per channel" UWORD TI1_M_CYCLE_S1 1 100 0 327675 ECU_ADDRESS 0xFFF94270 FORMAT "%8.1" MATRIX_DIM 4 1 1 /end MEASUREMENT
/begin CHARACTERISTIC SWI_SET_PIN "F9140: selection which SW partner has access to the debug pins (1=HWL,2=SYS,3-8=ZF,9=OEM)" VALUE 0x1918DA AblGLKWub_S1 255 X1_S1 0 255 FORMAT "%5.1" /end CHARACTERISTIC
/begin MEASUREMENT SafRam_Tst16 "F6060: SAF RAM test variable 16 bit" UWORD X1_S1 1 100 0 65535 ECU_ADDRESS 0xFFF9488E FORMAT "%8.2" /end MEASUREMENT
/begin MEASUREMENT SafRam_Tst32 "F6060: SAF RAM test variable 32 bit" ULONG X1_S1 1 100 0 4294967295 ECU_ADDRESS 0xFFF947D8 FORMAT "%13.2" /end MEASUREMENT
/begin MEASUREMENT SafRam_Tst8 "F6060: SAF RAM test variable 8 bit" UBYTE X1_S1 1 100 0 255 ECU_ADDRESS 0xFFF948F5 FORMAT "%5.1" /end MEASUREMENT
/begin MEASUREMENT SafRam_adDbgCpl "F6060: Address of failing complement" ULONG X1_S1 1 100 0 4294967295 ECU_ADDRESS 0xFFF80C84 FORMAT "%13.2" MATRIX_DIM 5 1 1 /end MEASUREMENT
/begin MEASUREMENT SafRam_adDbgOrig "F6060: Address of failing original" ULONG X1_S1 1 100 0 4294967295 ECU_ADDRESS 0xFFF80C98 FORMAT "%13.2" MATRIX_DIM 5 1 1 /end MEASUREMENT
/begin MEASUREMENT SafRam_datDbgCpl "F6060: failing complement" ULONG X1_S1 1 100 0 4294967295 ECU_ADDRESS 0xFFF80CAC FORMAT "%13.2" MATRIX_DIM 5 1 1 /end MEASUREMENT
/begin MEASUREMENT SafRam_datDbgOrig "F6060: Failing original" ULONG X1_S1 1 100 0 4294967295 ECU_ADDRESS 0xFFF80CC0 FORMAT "%13.2" MATRIX_DIM 5 1 1 /end MEASUREMENT
/begin MEASUREMENT SafRam_idxDbg "F6060: Index of latest failure information" UBYTE X1_S1 1 100 0 255 ECU_ADDRESS 0xFFF80D15 FORMAT "%5.1" /end MEASUREMENT
/begin MEASUREMENT SafRam_xDbgInfo "F6060: Failure info" UBYTE X1_S1 1 100 0 255 ECU_ADDRESS 0xFFF80D16 FORMAT "%5.1" MATRIX_DIM 5 1 1 /end MEASUREMENT
/begin MEASUREMENT Saf_stFaultInfo_A "F6000: SAF environmental condition A" UWORD X1_S1 1 100 0 65535 ECU_ADDRESS 0xFFF9350E FORMAT "%8.2" /end MEASUREMENT
/begin MEASUREMENT Saf_stFaultInfo_B "F6000: SAF environmental condition B" UWORD X1_S1 1 100 0 65535 ECU_ADDRESS 0xFFF93510 FORMAT "%8.2" /end MEASUREMENT
/begin MEASUREMENT Saf_stFaultInfo_C "F6000: SAF environmental condition C" UBYTE X1_S1 1 100 0 255 ECU_ADDRESS 0xFFF93B32 FORMAT "%5.1" /end MEASUREMENT
/begin MEASUREMENT Saf_stFaultInfo_D "F6000: SAF environmental condition D" ULONG X1_S1 1 100 0 4294967295 ECU_ADDRESS 0xFFF92E40 FORMAT "%13.2" /end MEASUREMENT
/begin MEASUREMENT Sfrm_bErrHndlr "F6250: Status error handler at SFRM fault (FALSE = error handler ready, TRUE = error handler not ready)" UBYTE B_TRUE_S1 1 100 0 1 ECU_ADDRESS 0xFFF943BF FORMAT "%13.11" /end MEASUREMENT
/begin MEASUREMENT Sfrm_idFaultSrcChn "F6250: Faulty channel of SFRM User" UBYTE X1_S1 1 100 0 255 ECU_ADDRESS 0xFFF943C0 FORMAT "%5.1" /end MEASUREMENT
/begin MEASUREMENT Sfrm_idFaultSrcUsr "" UBYTE X1_S1 1 100 0 255 ECU_ADDRESS 0xFFF943C1 FORMAT "%5.1" /end MEASUREMENT
/begin MEASUREMENT Sfrm_xReqSwtOffPs "F6250: Request switch-off power stages (0xA5 = switch-off request enabled, 0x5A = switch-off request disabled)" UBYTE X1_S1 1 100 0 255 ECU_ADDRESS 0xFFF9491B FORMAT "%5.1" /end MEASUREMENT
/begin MEASUREMENT Sfrm_xReqSwtOffPsInt "F6250: Status internal SFRM fault reaction (0xA5 = SFRM fault reaction active, 0x5A = SFRM fault reaction not active)" UBYTE X1_S1 1 100 0 255 ECU_ADDRESS 0xFFF93B33 FORMAT "%5.1" /end MEASUREMENT
/begin CHARACTERISTIC ShrCal_ActvIC2OnFcc_C "F9110: Activate InCircuit2 on FCC-Devices [0xAA: IC2 active; others: IC2 inactive;] (no SERAP)" VALUE 0x1918E2 AblGLKWub_S1 255 X1_S1 0 255 FORMAT "%5.1" /end CHARACTERISTIC
/begin CHARACTERISTIC ShrCal_SlctSeramMth_C "F9110: Select SERAM calibration method [0x2: CCP; 0x4: XCP; other values not allowed!] (no SERAP)" VALUE 0x1918E3 AblGLKWub_S1 4 X1_S1 0 4 FORMAT "%5.3" /end CHARACTERISTIC
/begin MEASUREMENT ShrGmoHot_stChp2Chp1 "F9156: Status of temperature sensors at time of hot shut down (B01:tChp2,B23:tChp1;00=Ok,01=subst.,10=error)" UBYTE X1_S1 1 100 0 255 ECU_ADDRESS 0xFFF93B40 FORMAT "%5.1" /end MEASUREMENT
/begin MEASUREMENT ShrGmoHot_tChp1 "F9156: Chip temperature (CG130) at time of hot shut down" UBYTE T1_OFFS_40_S1 1 100 -40 215 ECU_ADDRESS 0xFFF93B41 FORMAT "%5.1" /end MEASUREMENT
/begin MEASUREMENT ShrGmoHot_tChp2 "F9156: Chip temperature (LM71) at time of hot shut down" UBYTE T1_OFFS_40_S1 1 100 -40 215 ECU_ADDRESS 0xFFF93B42 FORMAT "%5.1" /end MEASUREMENT
/begin MEASUREMENT ShrGmoHot_tHot "F9156: Temperature threshold at time of hot shut down" UBYTE T1_OFFS_40_S1 1 100 -40 215 ECU_ADDRESS 0xFFF93B43 FORMAT "%5.1" /end MEASUREMENT
/begin MEASUREMENT ShrGmoRst_xReg_Par "F9155: Parameter of last exception" ULONG X1_S1 1 100 0 4294967295 ECU_ADDRESS 0xFFF92AD4 FORMAT "%13.2" /end MEASUREMENT
/begin MEASUREMENT ShrGmoRst_xReg_Vec "F9155: Vector (subset) of last exception" UWORD X1_S1 1 100 0 65535 ECU_ADDRESS 0xFFF933DE FORMAT "%8.2" /end MEASUREMENT
/begin MEASUREMENT ShrOut_stFaultInfo_A "F9140: Environment condition for KFC_WDOG" UWORD X1_S1 1 100 0 65535 ECU_ADDRESS 0xFFF933FC FORMAT "%8.2" /end MEASUREMENT
/begin MEASUREMENT ShrOut_stFaultInfo_B "F9140: Environment condition for KFC_WDOG" UWORD X1_S1 1 100 0 65535 ECU_ADDRESS 0xFFF933FE FORMAT "%8.2" /end MEASUREMENT
/begin MEASUREMENT ShrSaf_stFaultInfo_A "F9110: Environment condition for KFC_MCCOMP" UBYTE X1_S1 1 100 0 255 ECU_ADDRESS 0xFFF93B44 FORMAT "%5.1" /end MEASUREMENT
/begin MEASUREMENT ShrSaf_stFaultInfo_B "F9110: Environment condition for KFC_MCCOMP" ULONG X1_S1 1 100 0 4294967295 ECU_ADDRESS 0xFFF92EFC FORMAT "%13.2" /end MEASUREMENT
/begin MEASUREMENT ShrSrv_bDsmRdy "F9110: Ready status of DSM" UBYTE B_TRUE_S1 1 100 0 1 ECU_ADDRESS 0xFFF939BF FORMAT "%13.11" /end MEASUREMENT
/begin CHARACTERISTIC ShrSrv_bDsmRdyByp_C "F9110: Ignore customer DSM ready status [0=no, others=DSM permanently ready] (no SERAP)" VALUE 0x1918CA AblGLKWub_S1 1 B_TRUE_S1 0 1 FORMAT "%13.11" /end CHARACTERISTIC
/begin MEASUREMENT ShrSrv_bDsmRdyCus "F9110: Ready status of customer DSM" UBYTE B_TRUE_S1 1 100 0 1 ECU_ADDRESS 0xFFF939C0 FORMAT "%13.11" /end MEASUREMENT
/begin MEASUREMENT ShrVar_EEP_s.datCPS "ShrVar_EEP_s / CPS (CodierPruefStempel)" UBYTE X1_M 1 100 0 255 ECU_ADDRESS 0xFFF83534 FORMAT "%5.1" MATRIX_DIM 7 1 1 /end MEASUREMENT
/begin MEASUREMENT ShrVar_EEP_s.datCafId "ShrVar_EEP_s / CAF ID" UBYTE X1_M 1 100 0 255 ECU_ADDRESS 0xFFF834A8 FORMAT "%5.1" MATRIX_DIM 8 1 1 /end MEASUREMENT
/begin MEASUREMENT ShrVar_EEP_s.datVarCod_1 "ShrVar_EEP_s / variant coding data 1" UBYTE X1_M 1 100 0 255 ECU_ADDRESS 0xFFF8348D FORMAT "%5.1" MATRIX_DIM 2 1 1 /end MEASUREMENT
/begin MEASUREMENT ShrVar_EEP_s.datVarCod_2 "ShrVar_EEP_s / variant coding data 2" UBYTE X1_M 1 100 0 255 ECU_ADDRESS 0xFFF8348F FORMAT "%5.1" MATRIX_DIM 2 1 1 /end MEASUREMENT
/begin MEASUREMENT ShrVar_EEP_s.xChsCod "ShrVar_EEP_s / Checksum Code" ULONG X1_M 1 100 0 4294967295 ECU_ADDRESS 0xFFF834A0 FORMAT "%13.2" /end MEASUREMENT
/begin MEASUREMENT ShrVar_EEP_s.xChsDat "ShrVar_EEP_s / Checksum Data" ULONG X1_M 1 100 0 4294967295 ECU_ADDRESS 0xFFF834A4 FORMAT "%13.2" /end MEASUREMENT
/begin MEASUREMENT ShrVar_EEP_s.xStructId "ShrVar_EEP_s / structure identifier" UBYTE X1_M 1 100 0 255 ECU_ADDRESS 0xFFF8348C FORMAT "%5.1" /end MEASUREMENT
/begin MEASUREMENT ShrVar_datCPS "F9150: CodierPruefStempel (last 7 Bytes of VIN)" UBYTE X1_M 1 100 0 255 ECU_ADDRESS 0xFFF93961 FORMAT "%5.1" MATRIX_DIM 7 1 1 /end MEASUREMENT
/begin MEASUREMENT ShrVar_datCodApplFileId "F9150: Coding Application File Identifier" UBYTE X1_M 1 100 0 255 ECU_ADDRESS 0xFFF9214C FORMAT "%5.1" MATRIX_DIM 8 1 1 /end MEASUREMENT
/begin MEASUREMENT ShrVar_datVarCod_1 "F9150: variant coding data 1" UBYTE X1_M 1 100 0 255 ECU_ADDRESS 0xFFF94892 FORMAT "%5.1" MATRIX_DIM 2 1 1 /end MEASUREMENT
/begin MEASUREMENT ShrVar_datVarCod_2 "F9150: variant coding data 2" UBYTE X1_M 1 100 0 255 ECU_ADDRESS 0xFFF94894 FORMAT "%5.1" MATRIX_DIM 2 1 1 /end MEASUREMENT
/begin MEASUREMENT ShrVar_idWrDat "F9150: identifier written by WriteDataByIdentifier" UWORD X1_M 1 100 0 65535 ECU_ADDRESS 0xFFF9338A FORMAT "%8.2" /end MEASUREMENT
/begin MEASUREMENT ShrVar_stCodSesActv "F9150: state coding session active" UBYTE X1_M 1 100 0 255 ECU_ADDRESS 0xFFF93968 FORMAT "%5.1" /end MEASUREMENT
/begin MEASUREMENT ShrVar_stComDly "F9150: state of communication delay" UBYTE X1_M 1 100 0 255 ECU_ADDRESS 0xFFF84BEB FORMAT "%5.1" /end MEASUREMENT
/begin MEASUREMENT ShrVar_stInit "F9150: state variant coding initialisation" UBYTE X1_M 1 100 0 255 ECU_ADDRESS 0xFFF93969 FORMAT "%5.1" /end MEASUREMENT
/begin MEASUREMENT ShrVar_stOrigInit "F9150: state of original initialisation" UBYTE X1_M 1 100 0 255 ECU_ADDRESS 0xFFF9396A FORMAT "%5.1" /end MEASUREMENT
/begin MEASUREMENT ShrVar_stUpdEEP "F9150: state variant coding eeprom update" UBYTE X1_M 1 100 0 255 ECU_ADDRESS 0xFFF9396B FORMAT "%5.1" /end MEASUREMENT
/begin MEASUREMENT ShrVar_stWrSucCPS "F9150: state CPS written successful in coding session" UBYTE X1_M 1 100 0 255 ECU_ADDRESS 0xFFF9396C FORMAT "%5.1" /end MEASUREMENT
/begin MEASUREMENT ShrVar_tiWaitErrHndlr "F9150: timer for error handler waiting time" UWORD TI1_M_CYCLE_M 1 100 0 327675 ECU_ADDRESS 0xFFF94180 FORMAT "%8.1" /end MEASUREMENT
/begin CHARACTERISTIC ShrVar_tiWaitErrHndlr_C "F9150: waiting time for error handler" VALUE 0x1914C4 AblGLKWuw_M 327675 TI1_M_CYCLE_M 0 327675 FORMAT "%8.1" /end CHARACTERISTIC
/begin MEASUREMENT ShrVar_tiWaitVIN "F9150: timer for VIN waiting time" UWORD TI1_M_CYCLE_M 1 100 0 327675 ECU_ADDRESS 0xFFF94182 FORMAT "%8.1" /end MEASUREMENT
/begin CHARACTERISTIC ShrVar_tiWaitVIN_C "F9150: waiting time for VIN" VALUE 0x1914C6 AblGLKWuw_M 327675 TI1_M_CYCLE_M 0 327675 FORMAT "%8.1" /end CHARACTERISTIC
/begin MEASUREMENT ShrVar_xBcOrigInit "F9150: customer boot info of flash programming" UBYTE X1_M 1 100 0 255 ECU_ADDRESS 0xFFF9396D FORMAT "%5.1" /end MEASUREMENT
/begin MEASUREMENT ShrVar_xCanVIN "F9150: VIN from CAN" UBYTE X1_M 1 100 0 255 ECU_ADDRESS 0xFFF9396E FORMAT "%5.1" MATRIX_DIM 7 1 1 /end MEASUREMENT
/begin MEASUREMENT ShrVar_xCanVINRxFlg "F9150: VIN from CAN receive flags" UBYTE X1_M 1 100 0 255 ECU_ADDRESS 0xFFF93975 FORMAT "%5.1" /end MEASUREMENT
/begin MEASUREMENT ShrVar_xChsOrigInit "F9150: checksum change is causing initialisation" UBYTE X1_M 1 100 0 255 ECU_ADDRESS 0xFFF93976 FORMAT "%5.1" /end MEASUREMENT
/begin MEASUREMENT ShrVar_xInitDne "F9150: variant coding initialisation done" UBYTE X1_M 1 100 0 255 ECU_ADDRESS 0xFFF93977 FORMAT "%5.1" /end MEASUREMENT
/begin MEASUREMENT ShrVar_xVarCodChkDne "F9150: variant coding check done" UBYTE X1_M 1 100 0 255 ECU_ADDRESS 0xFFF93978 FORMAT "%5.1" /end MEASUREMENT
/begin MEASUREMENT SpiHa_ctErrUnit "F2641: Error counter of the SPI-bus systems (index=bus-number) (wrap-around!) (Attention: index can be greater than the actual number of SPI channels available in the system)" UWORD X1_S1 1 100 0 65535 ECU_ADDRESS 0xFFF93C34 FORMAT "%8.2" MATRIX_DIM 3 1 1 /end MEASUREMENT
/begin MEASUREMENT SrvShrFA_efErrDisplay "F9151: error flag display actual gear (FA-CAN)" UBYTE X1_M 1 100 0 255 ECU_ADDRESS 0xFFF93A19 FORMAT "%5.1" /end MEASUREMENT
/begin MEASUREMENT SrvShrFA_efErrLimpHome "F9151: error flag for signal error-type of hybrid control unit (FACAN)" UBYTE X1_M 1 100 0 255 ECU_ADDRESS 0xFFF93AA0 FORMAT "%5.1" /end MEASUREMENT
/begin MEASUREMENT SrvShrFA_efErrTaRPM "F9151: error flag for signal target RPM combustion-engine (FACAN)" UBYTE X1_M 1 100 0 255 ECU_ADDRESS 0xFFF93AA8 FORMAT "%5.1" /end MEASUREMENT
/begin MEASUREMENT SrvShrFA_efErrTaRPMin "F9151: error flag for signal idling RPM boost request (FACAN)" UBYTE X1_M 1 100 0 255 ECU_ADDRESS 0xFFF93AAA FORMAT "%5.1" /end MEASUREMENT
/begin MEASUREMENT SrvShr_BETRSTD "F9110: operation duration in CRU operating state" ULONG TI1_MIN_S1 1 100 0 4294967295 ECU_ADDRESS 0xFFF92B5C FORMAT "%13.2" /end MEASUREMENT
/begin MEASUREMENT SrvShr_BETRSTD_INCL_STDBY "F9110: operation duration in CRU/LPH/SBY operating state" ULONG TI0_1_H_S1 1 100 0 429496729.5 ECU_ADDRESS 0xFFF92B60 FORMAT "%13.3" /end MEASUREMENT
/begin MEASUREMENT SrvShr_BS_MODE "F9170: current operating system mode (0=INIT, 1=SBY/HLD, 2=CRU, 3=LPH)" UBYTE X1_M 1 100 0 255 ECU_ADDRESS 0xFFF936AB FORMAT "%5.1" /end MEASUREMENT
/begin MEASUREMENT SrvShr_CAN_ACTIVE "F9170: at least one CAN-bus is active (B0:yes,B4-B7: internal)" UBYTE X1_M 1 100 0 255 ECU_ADDRESS 0xFFF93727 FORMAT "%5.1" /end MEASUREMENT
/begin MEASUREMENT SrvShr_CAN_BusComReq "F9170: Bus Communication request from Application Layer (b0:Nm chn1; b1:Nm chn2; b2-b7:not used at the moment; " UBYTE X1_M 1 100 0 255 ECU_ADDRESS 0xFFF93728 FORMAT "%5.1" /end MEASUREMENT
/begin MEASUREMENT SrvShr_CAN_BusComReqS "F9170: Bus Communication request state (b0:Nm chn1; b1:Nm chn2; b2-b3:not used at the moment; b4-b7: counter which inc on each req/rel Bus Communication)" UBYTE X1_M 1 100 0 255 ECU_ADDRESS 0xFFF93729 FORMAT "%5.1" /end MEASUREMENT
/begin MEASUREMENT SrvShr_CAN_ERROR_PIN "F9120: CAN current error status via pin info (0=no error, 1=error)" UBYTE X1_S1 1 100 0 255 ECU_ADDRESS 0xFFF93AB5 FORMAT "%5.1" /end MEASUREMENT
/begin MEASUREMENT SrvShr_CAN_WAKE_UP "F9120: CAN wakeup detected (only if available) (0=no, 1=yes)" UBYTE X1_S1 1 100 0 255 ECU_ADDRESS 0xFFF93AB6 FORMAT "%5.1" /end MEASUREMENT
/begin MEASUREMENT SrvShr_CCHIP1_RAW "F9120: measured CHIP1-temperature" UBYTE T1_OFFS_40_S1 1 100 -40 215 ECU_ADDRESS 0xFFF93AEC FORMAT "%5.1" /end MEASUREMENT
/begin MEASUREMENT SrvShr_CCHIP1_RAW_DI_RDY "F9120: CHIP1-sensor diagnosis status valid" UBYTE X1_S1 1 100 0 255 ECU_ADDRESS 0xFFF93AED FORMAT "%5.1" /end MEASUREMENT
/begin MEASUREMENT SrvShr_CCHIP1_RAW_ESTATUS "F9120: CHIP1-sensor electrical status (0=ok, B3:PLAUS,B5:LOW,B6:HIGH)" UBYTE X1_S1 1 100 0 255 ECU_ADDRESS 0xFFF93AEE FORMAT "%5.1" /end MEASUREMENT
/begin MEASUREMENT SrvShr_CCHIP2_RAW "F9120: measured CHIP2-temperature" UBYTE T1_OFFS_40_S1 1 100 -40 215 ECU_ADDRESS 0xFFF93AEF FORMAT "%5.1" /end MEASUREMENT
/begin MEASUREMENT SrvShr_CCHIP2_RAW_DI_RDY "F9120: CHIP2-sensor diagnosis status valid" UBYTE X1_S1 1 100 0 255 ECU_ADDRESS 0xFFF93AF0 FORMAT "%5.1" /end MEASUREMENT
/begin MEASUREMENT SrvShr_CCHIP2_RAW_ESTATUS "F9120: CHIP2-sensor electrical status (0=ok, B5:LOW,B6:HIGH,B7:INITO)" UBYTE X1_S1 1 100 0 255 ECU_ADDRESS 0xFFF93AF1 FORMAT "%5.1" /end MEASUREMENT
/begin MEASUREMENT SrvShr_CGT_RAW "F9120: measured ATF-temperature" UBYTE T1_OFFS_40_S1 1 100 -40 215 ECU_ADDRESS 0xFFF93AF2 FORMAT "%5.1" /end MEASUREMENT
/begin MEASUREMENT SrvShr_CGT_RAW_DI_RDY "F9120: Atf-sensor diagnosis status valid" UBYTE X1_S1 1 100 0 255 ECU_ADDRESS 0xFFF93AF3 FORMAT "%5.1" /end MEASUREMENT
/begin MEASUREMENT SrvShr_CGT_RAW_ESTATUS "F9120: Atf-sensor electrical status (0=ok, B0:SG,B1:SB,B2:OP,B7:others)" UBYTE X1_S1 1 100 0 255 ECU_ADDRESS 0xFFF93AF4 FORMAT "%5.1" /end MEASUREMENT
/begin MEASUREMENT SrvShr_CanEwsDataLength "Data bytes of EWS rx message" UBYTE X1_M 1 100 0 255 ECU_ADDRESS 0xFFF93A1E FORMAT "%5.1" /end MEASUREMENT
/begin MEASUREMENT SrvShr_CanEwsRxBuff "Data of EWS rx message" UBYTE X1_M 1 100 0 255 ECU_ADDRESS 0xFFF93A1F FORMAT "%5.1" MATRIX_DIM 129 1 1 /end MEASUREMENT
/begin MEASUREMENT SrvShr_DC_TRQ "F9120: PWM duty of torque input" UWORD R0_1_P_S1 1 100 0 6553.5 ECU_ADDRESS 0xFFF933F8 FORMAT "%8.3" /end MEASUREMENT
/begin MEASUREMENT SrvShr_DC_TRQ_ESTATUS "F9120: diagnosis information of PWM torque input (B0:SG,B1:SB,B2:OP, B3:wrong period)" UBYTE X1_S1 1 100 0 255 ECU_ADDRESS 0xFFF93AB7 FORMAT "%5.1" /end MEASUREMENT
/begin MEASUREMENT SrvShr_DITHER_FREQ_LOCK "F9140: lock dither frequency switching (0=frequency switching allowed,1=frequency switching locked,others ignored" UBYTE X1_S1 1 100 0 255 ECU_ADDRESS 0xFFF93AC8 FORMAT "%5.1" /end MEASUREMENT
/begin MEASUREMENT SrvShr_FET_ACTIVE "F9140: status of FET (0:off,1:on,2:int.fault,3:test,4:low batt)" UBYTE X1_S1 1 100 0 255 ECU_ADDRESS 0xFFF84B88 FORMAT "%5.1" MATRIX_DIM 2 1 1 /end MEASUREMENT
/begin MEASUREMENT SrvShr_FET_ACTIVE_KOMP "F9140: status of FET complement (255:off,254:on,253:int.fault,252:test,251:low batt)" UBYTE X1_S1 1 100 0 255 ECU_ADDRESS 0xFFF84B8A FORMAT "%5.1" MATRIX_DIM 2 1 1 /end MEASUREMENT
/begin MEASUREMENT SrvShr_FrFltCc08 "F9140: Forced error entry Cc08 (Bit0:VFS0,...)" UWORD X1_S1 1 100 0 65535 ECU_ADDRESS 0xFFF93404 FORMAT "%8.2" /end MEASUREMENT
/begin CHARACTERISTIC SrvShr_FrFltCc08_C "F9140: forced error entry active (Bit0=SG, Bit1=SB)" VAL_BLK 0x1914DC AblGLKWBub_S1 3 X1_S1 0 3 MATRIX_DIM 10 1 1 FORMAT "%5.3" /end CHARACTERISTIC
/begin MEASUREMENT SrvShr_FrFltLss "F9140: Forced error entry Lss (Bit0:LSS0,...)" UWORD X1_S1 1 100 0 65535 ECU_ADDRESS 0xFFF93406 FORMAT "%8.2" /end MEASUREMENT
/begin CHARACTERISTIC SrvShr_FrFltLss_C "F9140: forced error entry active (Bit0=SG, Bit1=SB)" VAL_BLK 0x1918DC AblGLKWBub_S1 3 X1_S1 0 3 MATRIX_DIM 5 1 1 FORMAT "%5.3" /end CHARACTERISTIC
/begin MEASUREMENT SrvShr_FrFltPSply "F9140: Flag for forced error entries on low sides" UBYTE B_TRUE_S1 1 100 0 1 ECU_ADDRESS 0xFFF93408 FORMAT "%13.11" MATRIX_DIM 2 1 1 /end MEASUREMENT
/begin MEASUREMENT SrvShr_IN0 "F9120: Digital status of IN0 line" UBYTE X1_S1 1 100 0 255 ECU_ADDRESS 0xFFF93B49 FORMAT "%5.1" /end MEASUREMENT
/begin MEASUREMENT SrvShr_IN0_ESTATUS "F9120: bitcoded diagnosis status of IN0 line (0=no error)" UBYTE X1_S1 1 100 0 255 ECU_ADDRESS 0xFFF93B4A FORMAT "%5.1" /end MEASUREMENT
/begin MEASUREMENT SrvShr_LX "F9120: measured position information (idx=2/3=park information)" UBYTE X1_S1 1 100 0 255 ECU_ADDRESS 0xFFF84B04 FORMAT "%5.1" MATRIX_DIM 4 1 1 /end MEASUREMENT
/begin MEASUREMENT SrvShr_LX_DI_RDY "F9120: position information diagnosis status valid" UBYTE X1_S1 1 100 0 255 ECU_ADDRESS 0xFFF92B08 FORMAT "%5.1" MATRIX_DIM 4 1 1 /end MEASUREMENT
/begin MEASUREMENT SrvShr_LX_ESTATUS "F9120: position information electrical status (0=ok, B0:SG,B1:SB,B2:OP,B3:undef)" UBYTE X1_S1 1 100 0 255 ECU_ADDRESS 0xFFF84B08 FORMAT "%5.1" MATRIX_DIM 4 1 1 /end MEASUREMENT
/begin MEASUREMENT SrvShr_LX_ESTATUS_KOMP "F9120: complementary position information electrical status" UBYTE X1_S1 1 100 0 255 ECU_ADDRESS 0xFFF84B0C FORMAT "%5.1" MATRIX_DIM 4 1 1 /end MEASUREMENT
/begin MEASUREMENT SrvShr_LX_KOMP "F9120: complementary position information" UBYTE X1_S1 1 100 0 255 ECU_ADDRESS 0xFFF84B10 FORMAT "%5.1" MATRIX_DIM 4 1 1 /end MEASUREMENT
/begin MEASUREMENT SrvShr_NAB_DI_RDY "F9120: transmission output speed diagnosis status valid" UBYTE X1_S1 1 100 0 255 ECU_ADDRESS 0xFFF93AF9 FORMAT "%5.1" /end MEASUREMENT
/begin MEASUREMENT SrvShr_NAB_ESTATUS "F9120: transmission output speed electrical status (0=ok, B0:SG,B1:SB,B2:OP)" UBYTE X1_S1 1 100 0 255 ECU_ADDRESS 0xFFF93AFA FORMAT "%5.1" /end MEASUREMENT
/begin MEASUREMENT SrvShr_NAB_PULSE_WIDTH "F9120: transmission output speed direction pulse width" UBYTE TI1_U_S1 1 100 0 255 ECU_ADDRESS 0xFFF93AFB FORMAT "%5.1" /end MEASUREMENT
/begin MEASUREMENT SrvShr_NAB_SUM_PULSES "F9120: transmission output speed pulse counter since last detected signal edge" UBYTE X1_S1 1 100 0 255 ECU_ADDRESS 0xFFF93AFC FORMAT "%5.1" /end MEASUREMENT
/begin MEASUREMENT SrvShr_NAB_SUM_PULSE_TIME "F9120: transmission output speed time difference to last detected signal edge" ULONG TI1_U_S1 1 100 0 4294967295 ECU_ADDRESS 0xFFF92B70 FORMAT "%13.2" /end MEASUREMENT
/begin MEASUREMENT SrvShr_NT_DI_RDY "F9120: transmission input speed diagnosis status valid" UBYTE X1_S1 1 100 0 255 ECU_ADDRESS 0xFFF93AF5 FORMAT "%5.1" /end MEASUREMENT
/begin MEASUREMENT SrvShr_NT_ESTATUS "F9120: transmission input speed electrical status (0=ok, B0:SG,B1:SB,B2:OP)" UBYTE X1_S1 1 100 0 255 ECU_ADDRESS 0xFFF93AF6 FORMAT "%5.1" /end MEASUREMENT
/begin MEASUREMENT SrvShr_NT_PULSE_WIDTH "F9120: transmission input speed direction pulse width" UBYTE TI1_U_S1 1 100 0 255 ECU_ADDRESS 0xFFF93AF7 FORMAT "%5.1" /end MEASUREMENT
/begin MEASUREMENT SrvShr_NT_SUM_PULSES "F9120: transmission input speed pulse counter since last detected signal edge" UBYTE X1_S1 1 100 0 255 ECU_ADDRESS 0xFFF93AF8 FORMAT "%5.1" /end MEASUREMENT
/begin MEASUREMENT SrvShr_NT_SUM_PULSE_TIME "F9120: transmission input speed time difference to last detected signal edge" ULONG TI1_U_S1 1 100 0 4294967295 ECU_ADDRESS 0xFFF92B6C FORMAT "%13.2" /end MEASUREMENT
/begin MEASUREMENT SrvShr_OUT0_AKT "F9140: model-based current feedback" UWORD I0_0001_S1 1 100 0 6.5535 ECU_ADDRESS 0xFFF9340A FORMAT "%8.6" /end MEASUREMENT
/begin MEASUREMENT SrvShr_OUT0_DI_RDY "F9140: test condition information of VFS current (B0:SG,B1:SB,B2:OP,B5:LOW,B6:HIGH,B4:undef)" UBYTE X1_S1 1 100 0 255 ECU_ADDRESS 0xFFF93AC9 FORMAT "%5.1" /end MEASUREMENT
/begin MEASUREMENT SrvShr_OUT0_ESTATUS "F9140: diagnosis information of VFS current (B0:SG,B1:SB,B2:OP,B5:LOW,B6:HIGH,B4:undef)" UBYTE X1_S1 1 100 0 255 ECU_ADDRESS 0xFFF93ACA FORMAT "%5.1" /end MEASUREMENT
/begin MEASUREMENT SrvShr_OUT10_AKT "F9140: output control state or feedback" UWORD X1_S1 1 100 0 65535 ECU_ADDRESS 0xFFF9340C FORMAT "%8.2" /end MEASUREMENT
/begin MEASUREMENT SrvShr_OUT10_DI_OFF "F9140: switch output and diagnosis off for solenoid (1=off, others normal mode)" UBYTE X1_S1 1 100 0 255 ECU_ADDRESS 0xFFF948FA FORMAT "%5.1" /end MEASUREMENT
/begin MEASUREMENT SrvShr_OUT10_DI_OFFCpl "F9140: switch output and diagnosis off for solenoid, complement (254=off, others normal mode)" UBYTE X1_S1 1 100 0 255 ECU_ADDRESS 0xFFF9476E FORMAT "%5.1" /end MEASUREMENT
/begin MEASUREMENT SrvShr_OUT10_DI_RDY "F9140: test condition information of solenoid (B0:SG,B1:SB,B2:OP,B4:undef)" UBYTE X1_S1 1 100 0 255 ECU_ADDRESS 0xFFF93ACB FORMAT "%5.1" /end MEASUREMENT
/begin MEASUREMENT SrvShr_OUT10_ESTATUS "F9140: diagnosis information of solenoid (B0:SG,B1:SB,B2:OP,B4:undef)" UBYTE X1_S1 1 100 0 255 ECU_ADDRESS 0xFFF93ACC FORMAT "%5.1" /end MEASUREMENT
/begin MEASUREMENT SrvShr_OUT11_AKT "F9140: output control state" UWORD X1_S1 1 100 0 65535 ECU_ADDRESS 0xFFF9340E FORMAT "%8.2" /end MEASUREMENT
/begin MEASUREMENT SrvShr_OUT11_DI_RDY "F9140: test condition information of solenoid (B0:SG,B1:SB,B2:OP,B4:undef)" UBYTE X1_S1 1 100 0 255 ECU_ADDRESS 0xFFF93ACD FORMAT "%5.1" /end MEASUREMENT
/begin MEASUREMENT SrvShr_OUT11_ESTATUS "F9140: diagnosis information of solenoid (B0:SG,B1:SB,B2:OP,B4:undef)" UBYTE X1_S1 1 100 0 255 ECU_ADDRESS 0xFFF93ACE FORMAT "%5.1" /end MEASUREMENT
/begin MEASUREMENT SrvShr_OUT12_AKT "F9140: output control state" UWORD X1_S1 1 100 0 65535 ECU_ADDRESS 0xFFF93410 FORMAT "%8.2" /end MEASUREMENT
/begin MEASUREMENT SrvShr_OUT12_DI_RDY "F9140: test condition information of solenoid (B0:SG,B1:SB,B2:OP,B4:undef)" UBYTE X1_S1 1 100 0 255 ECU_ADDRESS 0xFFF93ACF FORMAT "%5.1" /end MEASUREMENT
/begin MEASUREMENT SrvShr_OUT12_ESTATUS "F9140: diagnosis information of solenoid (B0:SG,B1:SB,B2:OP,B4:undef)" UBYTE X1_S1 1 100 0 255 ECU_ADDRESS 0xFFF93AD0 FORMAT "%5.1" /end MEASUREMENT
/begin MEASUREMENT SrvShr_OUT13_AKT "F9140: output control state" UWORD X1_S1 1 100 0 65535 ECU_ADDRESS 0xFFF93412 FORMAT "%8.2" /end MEASUREMENT
/begin MEASUREMENT SrvShr_OUT13_DI_OFF "F9140: switch output and diagnosis off for solenoid (1=off, others normal mode)" UBYTE X1_S1 1 100 0 255 ECU_ADDRESS 0xFFF948FB FORMAT "%5.1" /end MEASUREMENT
/begin MEASUREMENT SrvShr_OUT13_DI_OFFCpl "F9140: switch output and diagnosis off for solenoid, complement (254=off, others normal mode)" UBYTE X1_S1 1 100 0 255 ECU_ADDRESS 0xFFF9476F FORMAT "%5.1" /end MEASUREMENT
/begin MEASUREMENT SrvShr_OUT13_DI_RDY "F9140: test condition information of solenoid (B0:SG,B1:SB,B2:OP,B4:undef)" UBYTE X1_S1 1 100 0 255 ECU_ADDRESS 0xFFF93AD1 FORMAT "%5.1" /end MEASUREMENT
/begin MEASUREMENT SrvShr_OUT13_ESTATUS "F9140: diagnosis information of solenoid (B0:SG,B1:SB,B2:OP,B4:undef)" UBYTE X1_S1 1 100 0 255 ECU_ADDRESS 0xFFF93AD2 FORMAT "%5.1" /end MEASUREMENT
/begin MEASUREMENT SrvShr_OUT14_AKT "F9140: output control state" UWORD X1_S1 1 100 0 65535 ECU_ADDRESS 0xFFF93414 FORMAT "%8.2" /end MEASUREMENT
/begin MEASUREMENT SrvShr_OUT14_DI_RDY "F9140: test condition information of solenoid (B0:SG,B1:SB,B2:OP,B4:undef)" UBYTE X1_S1 1 100 0 255 ECU_ADDRESS 0xFFF93AD3 FORMAT "%5.1" /end MEASUREMENT
/begin MEASUREMENT SrvShr_OUT14_ESTATUS "F9140: diagnosis information of solenoid (B0:SG,B1:SB,B2:OP,B4:undef)" UBYTE X1_S1 1 100 0 255 ECU_ADDRESS 0xFFF93AD4 FORMAT "%5.1" /end MEASUREMENT
/begin MEASUREMENT SrvShr_OUT1_AKT "F9140: model-based current feedback" UWORD I0_0001_S1 1 100 0 6.5535 ECU_ADDRESS 0xFFF93416 FORMAT "%8.6" /end MEASUREMENT
/begin MEASUREMENT SrvShr_OUT1_DI_RDY "F9140: test condition information of VFS current (B0:SG,B1:SB,B2:OP,B5:LOW,B6:HIGH,B4:undef)" UBYTE X1_S1 1 100 0 255 ECU_ADDRESS 0xFFF93AD5 FORMAT "%5.1" /end MEASUREMENT
/begin MEASUREMENT SrvShr_OUT1_ESTATUS "F9140: diagnosis information of VFS current (B0:SG,B1:SB,B2:OP,B5:LOW,B6:HIGH,B4:undef)" UBYTE X1_S1 1 100 0 255 ECU_ADDRESS 0xFFF93AD6 FORMAT "%5.1" /end MEASUREMENT
/begin MEASUREMENT SrvShr_OUT2_AKT "F9140: model-based current feedback" UWORD I0_0001_S1 1 100 0 6.5535 ECU_ADDRESS 0xFFF93418 FORMAT "%8.6" /end MEASUREMENT
/begin MEASUREMENT SrvShr_OUT2_DI_RDY "F9140: test condition information of VFS current (B0:SG,B1:SB,B2:OP,B5:LOW,B6:HIGH,B4:undef)" UBYTE X1_S1 1 100 0 255 ECU_ADDRESS 0xFFF93AD7 FORMAT "%5.1" /end MEASUREMENT
/begin MEASUREMENT SrvShr_OUT2_ESTATUS "F9140: diagnosis information of VFS current (B0:SG,B1:SB,B2:OP,B5:LOW,B6:HIGH,B4:undef)" UBYTE X1_S1 1 100 0 255 ECU_ADDRESS 0xFFF93AD8 FORMAT "%5.1" /end MEASUREMENT
/begin MEASUREMENT SrvShr_OUT3_AKT "F9140: model-based current feedback" UWORD I0_0001_S1 1 100 0 6.5535 ECU_ADDRESS 0xFFF9341A FORMAT "%8.6" /end MEASUREMENT
/begin MEASUREMENT SrvShr_OUT3_DI_RDY "F9140: test condition information of VFS current (B0:SG,B1:SB,B2:OP,B5:LOW,B6:HIGH,B4:undef)" UBYTE X1_S1 1 100 0 255 ECU_ADDRESS 0xFFF93AD9 FORMAT "%5.1" /end MEASUREMENT
/begin MEASUREMENT SrvShr_OUT3_ESTATUS "F9140: diagnosis information of VFS current (B0:SG,B1:SB,B2:OP,B5:LOW,B6:HIGH,B4:undef)" UBYTE X1_S1 1 100 0 255 ECU_ADDRESS 0xFFF93ADA FORMAT "%5.1" /end MEASUREMENT
/begin MEASUREMENT SrvShr_OUT4_AKT "F9140: model-based current feedback" UWORD I0_0001_S1 1 100 0 6.5535 ECU_ADDRESS 0xFFF9341C FORMAT "%8.6" /end MEASUREMENT
/begin MEASUREMENT SrvShr_OUT4_DI_RDY "F9140: test condition information of VFS current (B0:SG,B1:SB,B2:OP,B5:LOW,B6:HIGH,B4:undef)" UBYTE X1_S1 1 100 0 255 ECU_ADDRESS 0xFFF93ADB FORMAT "%5.1" /end MEASUREMENT
/begin MEASUREMENT SrvShr_OUT4_ESTATUS "F9140: diagnosis information of VFS current (B0:SG,B1:SB,B2:OP,B5:LOW,B6:HIGH,B4:undef)" UBYTE X1_S1 1 100 0 255 ECU_ADDRESS 0xFFF93ADC FORMAT "%5.1" /end MEASUREMENT
/begin MEASUREMENT SrvShr_OUT5_AKT "F9140: model-based current feedback" UWORD I0_0001_S1 1 100 0 6.5535 ECU_ADDRESS 0xFFF9341E FORMAT "%8.6" /end MEASUREMENT
/begin MEASUREMENT SrvShr_OUT5_DI_RDY "F9140: test condition information of VFS current (B0:SG,B1:SB,B2:OP,B5:LOW,B6:HIGH,B4:undef)" UBYTE X1_S1 1 100 0 255 ECU_ADDRESS 0xFFF93ADD FORMAT "%5.1" /end MEASUREMENT
/begin MEASUREMENT SrvShr_OUT5_ESTATUS "F9140: diagnosis information of VFS current (B0:SG,B1:SB,B2:OP,B5:LOW,B6:HIGH,B4:undef)" UBYTE X1_S1 1 100 0 255 ECU_ADDRESS 0xFFF93ADE FORMAT "%5.1" /end MEASUREMENT
/begin MEASUREMENT SrvShr_OUT6_AKT "F9140: model-based current feedback" UWORD I0_0001_S1 1 100 0 6.5535 ECU_ADDRESS 0xFFF93420 FORMAT "%8.6" /end MEASUREMENT
/begin MEASUREMENT SrvShr_OUT6_DI_RDY "F9140: test condition information of VFS current (B0:SG,B1:SB,B2:OP,B5:LOW,B6:HIGH,B4:undef)" UBYTE X1_S1 1 100 0 255 ECU_ADDRESS 0xFFF93ADF FORMAT "%5.1" /end MEASUREMENT
/begin MEASUREMENT SrvShr_OUT6_ESTATUS "F9140: diagnosis information of VFS current (B0:SG,B1:SB,B2:OP,B5:LOW,B6:HIGH,B4:undef)" UBYTE X1_S1 1 100 0 255 ECU_ADDRESS 0xFFF93AE0 FORMAT "%5.1" /end MEASUREMENT
/begin MEASUREMENT SrvShr_OUT7_AKT "F9140: model-based current feedback" UWORD I0_0001_S1 1 100 0 6.5535 ECU_ADDRESS 0xFFF93422 FORMAT "%8.6" /end MEASUREMENT
/begin MEASUREMENT SrvShr_OUT7_DI_RDY "F9140: test condition information of VFS current (B0:SG,B1:SB,B2:OP,B5:LOW,B6:HIGH,B4:undef)" UBYTE X1_S1 1 100 0 255 ECU_ADDRESS 0xFFF93AE1 FORMAT "%5.1" /end MEASUREMENT
/begin MEASUREMENT SrvShr_OUT7_ESTATUS "F9140: diagnosis information of VFS current (B0:SG,B1:SB,B2:OP,B5:LOW,B6:HIGH,B4:undef)" UBYTE X1_S1 1 100 0 255 ECU_ADDRESS 0xFFF93AE2 FORMAT "%5.1" /end MEASUREMENT
/begin MEASUREMENT SrvShr_OUT8_AKT "F9140: model-based current feedback" UWORD I0_0001_S1 1 100 0 6.5535 ECU_ADDRESS 0xFFF93424 FORMAT "%8.6" /end MEASUREMENT
/begin MEASUREMENT SrvShr_OUT8_DI_RDY "F9140: test condition information of VFS current (B0:SG,B1:SB,B2:OP,B5:LOW,B6:HIGH,B4:undef)" UBYTE X1_S1 1 100 0 255 ECU_ADDRESS 0xFFF93AE3 FORMAT "%5.1" /end MEASUREMENT
/begin MEASUREMENT SrvShr_OUT8_ESTATUS "F9140: diagnosis information of VFS current (B0:SG,B1:SB,B2:OP,B5:LOW,B6:HIGH,B4:undef)" UBYTE X1_S1 1 100 0 255 ECU_ADDRESS 0xFFF93AE4 FORMAT "%5.1" /end MEASUREMENT
/begin MEASUREMENT SrvShr_OUT9_AKT "F9140: model-based current feedback" UWORD I0_0001_S1 1 100 0 6.5535 ECU_ADDRESS 0xFFF93426 FORMAT "%8.6" /end MEASUREMENT
/begin MEASUREMENT SrvShr_OUT9_DI_RDY "F9140: test condition information of VFS current (B0:SG,B1:SB,B2:OP,B5:LOW,B6:HIGH,B4:undef)" UBYTE X1_S1 1 100 0 255 ECU_ADDRESS 0xFFF93AE5 FORMAT "%5.1" /end MEASUREMENT
/begin MEASUREMENT SrvShr_OUT9_ESTATUS "F9140: diagnosis information of VFS current (B0:SG,B1:SB,B2:OP,B5:LOW,B6:HIGH,B4:undef)" UBYTE X1_S1 1 100 0 255 ECU_ADDRESS 0xFFF93AE6 FORMAT "%5.1" /end MEASUREMENT
/begin MEASUREMENT SrvShr_OUT_DITHER_ACTIVE "F9140: dither amplitude control (0=off, 1=by HW supplier, 2=by interface SET_OUT#_DITHER_AMP, others ignored" UBYTE X1_S1 1 100 0 255 ECU_ADDRESS 0xFFF93428 FORMAT "%5.1" MATRIX_DIM 10 1 1 /end MEASUREMENT
/begin MEASUREMENT SrvShr_OUT_DITHER_AMP "F9140: dither amplitude" UWORD I0_0001_S1 1 100 0 6.5535 ECU_ADDRESS 0xFFF92B14 FORMAT "%8.6" MATRIX_DIM 10 1 1 /end MEASUREMENT
/begin MEASUREMENT SrvShr_POSINFO_MULTIPLICATOR "F9140: position information multiplier" UBYTE X1_S1 1 100 0 255 ECU_ADDRESS 0xFFF936B9 FORMAT "%5.1" /end MEASUREMENT
/begin MEASUREMENT SrvShr_RND32_EWS4 "F9110: seed for random number" ULONG X1_S1 1 100 0 4294967295 ECU_ADDRESS 0xFFF92AD8 FORMAT "%13.2" MATRIX_DIM 4 1 1 /end MEASUREMENT
/begin MEASUREMENT SrvShr_SENSORINIT_DONE "F9140: sensor supply initialization done (B0=yes,B4=temp.reinit requested)" UBYTE X1_S1 1 100 0 255 ECU_ADDRESS 0xFFF93AC3 FORMAT "%5.1" /end MEASUREMENT
/begin MEASUREMENT SrvShr_SHUTDOWN "F9140: requested shutdown info (0=no request,1=normal shutdown,2=fast shutdown)" UBYTE X1_S1 1 100 0 255 ECU_ADDRESS 0xFFF93AC4 FORMAT "%5.1" /end MEASUREMENT
/begin MEASUREMENT SrvShr_START_INHIBITOR_STATUS "F9140: starter lock control (0=lock,1=N,2=P,3=init)" UBYTE X1_S1 1 100 0 255 ECU_ADDRESS 0xFFF93AC5 FORMAT "%5.1" /end MEASUREMENT
/begin MEASUREMENT SrvShr_ST_ILK_ERRM_FZM_CanSigRec "F9120: Vehicle State Manager: CAN signal received" UBYTE X1_M 1 100 0 255 ECU_ADDRESS 0xFFF9395D FORMAT "%5.1" /end MEASUREMENT
/begin MEASUREMENT SrvShr_SysTimeInc_Counter "F9120: System time client: Timer to count til next increment of system time" UWORD TI0_01_M 1 100 0 655.35 ECU_ADDRESS 0xFFF93384 FORMAT "%8.4" /end MEASUREMENT
/begin MEASUREMENT SrvShr_SysTimeOut_Counter "F9120: System time client: Timeout counter" UWORD TI0_01_M 1 100 0 655.35 ECU_ADDRESS 0xFFF93386 FORMAT "%8.4" /end MEASUREMENT
/begin MEASUREMENT SrvShr_SysTime_BusOff "F9120: System time client: CAN bus not active" UBYTE X1_M 1 100 0 255 ECU_ADDRESS 0xFFF93958 FORMAT "%5.1" /end MEASUREMENT
/begin MEASUREMENT SrvShr_SysTime_CANSig "F9120: System time client: raw signal value from CAN" ULONG TI1_M 1 100 0 4294967295 ECU_ADDRESS 0xFFF92148 FORMAT "%13.2" /end MEASUREMENT
/begin MEASUREMENT SrvShr_SysTime_CanSigRec "F9120: System time client: CAN signal received" UBYTE X1_M 1 100 0 255 ECU_ADDRESS 0xFFF93959 FORMAT "%5.1" /end MEASUREMENT
/begin MEASUREMENT SrvShr_SysTime_NextState "F9120: System time client: State pointer" UBYTE X1_M 1 100 0 255 ECU_ADDRESS 0xFFF9395A FORMAT "%5.1" /end MEASUREMENT
/begin MEASUREMENT SrvShr_SysTime_SigRec "F9120: System time client: Signal got from CAN IO" UBYTE X1_M 1 100 0 255 ECU_ADDRESS 0xFFF9395B FORMAT "%5.1" /end MEASUREMENT
/begin MEASUREMENT SrvShr_SysTime_SigValid "F9120: System time client: CAN signal valid - no error value" UBYTE X1_M 1 100 0 255 ECU_ADDRESS 0xFFF9395C FORMAT "%5.1" /end MEASUREMENT
/begin MEASUREMENT SrvShr_SystemTime "F9120: System time client: System time" ULONG TI1_M 1 100 0 4294967295 ECU_ADDRESS 0xFFF92144 FORMAT "%13.2" /end MEASUREMENT
/begin MEASUREMENT SrvShr_TIPINFO_HIGHIMPULS_MAX "F9120: high pulse maximum timing (limited to 65.5ms)" UWORD TI1_U_S1 1 100 0 65535 ECU_ADDRESS 0xFFF93334 FORMAT "%8.2" /end MEASUREMENT
/begin MEASUREMENT SrvShr_TIPINFO_HIGHIMPULS_MIN "F9120: high pulse minimum timing (limited to 65.5ms)" UWORD TI1_U_S1 1 100 0 65535 ECU_ADDRESS 0xFFF93336 FORMAT "%8.2" /end MEASUREMENT
/begin MEASUREMENT SrvShr_TIPINFO_LOWIMPULS_MAX "F9120: low pulse maximum timing (limited to 65.5ms)" UWORD TI1_U_S1 1 100 0 65535 ECU_ADDRESS 0xFFF93338 FORMAT "%8.2" /end MEASUREMENT
/begin MEASUREMENT SrvShr_TIPINFO_LOWIMPULS_MIN "F9120: low pulse minimum timing (limited to 65.5ms)" UWORD TI1_U_S1 1 100 0 65535 ECU_ADDRESS 0xFFF9333A FORMAT "%8.2" /end MEASUREMENT
/begin MEASUREMENT SrvShr_TIPINFO_MULTIPLICATOR "F9120: tip information multiplier (0=no info, 255=timing error, 1-15:multipl.)" UBYTE X1_S1 1 100 0 255 ECU_ADDRESS 0xFFF936B8 FORMAT "%5.1" /end MEASUREMENT
/begin MEASUREMENT SrvShr_TIP_ANALOG_DI_RDY "F9120: test condition for analog Tap diagnosis" UBYTE X1_S1 1 100 0 255 ECU_ADDRESS 0xFFF93B53 FORMAT "%5.1" /end MEASUREMENT
/begin MEASUREMENT SrvShr_TIP_ANALOG_ESTATUS "F9120: bitcoded diagnosis status of analog Tap-line (B0:SG,B1:SB,B2:OP,B3:PLAUSI)" UBYTE X1_S1 1 100 0 255 ECU_ADDRESS 0xFFF93B54 FORMAT "%5.1" /end MEASUREMENT
/begin MEASUREMENT SrvShr_TIP_MINUS_ANALOG "F9120: Status of analog Tap (FALSE=off, TRUE=on)" UBYTE X1_S1 1 100 0 255 ECU_ADDRESS 0xFFF93B55 FORMAT "%5.1" /end MEASUREMENT
/begin MEASUREMENT SrvShr_TIP_MINUS_PIN "F9120: Digital status of TapMinus line" UBYTE X1_S1 1 100 0 255 ECU_ADDRESS 0xFFF93B4B FORMAT "%5.1" /end MEASUREMENT
/begin MEASUREMENT SrvShr_TIP_MINUS_PIN_ESTATUS "F9120: bitcoded diagnosis status of TapMinus line (0=no error)" UBYTE X1_S1 1 100 0 255 ECU_ADDRESS 0xFFF93B4C FORMAT "%5.1" /end MEASUREMENT
/begin MEASUREMENT SrvShr_TIP_PIN_DI_RDY "F9120: test condition for TabPlus/Minus diagnosis" UBYTE X1_S1 1 100 0 255 ECU_ADDRESS 0xFFF93B4D FORMAT "%5.1" /end MEASUREMENT
/begin MEASUREMENT SrvShr_TIP_PLUS_ANALOG "F9120: Status of analog Tap (FALSE=off, TRUE=on)" UBYTE X1_S1 1 100 0 255 ECU_ADDRESS 0xFFF93B56 FORMAT "%5.1" /end MEASUREMENT
/begin MEASUREMENT SrvShr_TIP_PLUS_PIN "F9120: Digital status of TapPlus line" UBYTE X1_S1 1 100 0 255 ECU_ADDRESS 0xFFF93B4E FORMAT "%5.1" /end MEASUREMENT
/begin MEASUREMENT SrvShr_TIP_PLUS_PIN_ESTATUS "F9120: bitcoded diagnosis status of TapPlus line (0=no error)" UBYTE X1_S1 1 100 0 255 ECU_ADDRESS 0xFFF93B4F FORMAT "%5.1" /end MEASUREMENT
/begin CHARACTERISTIC SrvShr_TSysErrorTimeOut_C "F9120: System time client: Threshold to store a fault" VALUE 0x1914BE AblGLKWuw_M 655.35 TI0_01_M 0 655.35 FORMAT "%8.4" /end CHARACTERISTIC
/begin CHARACTERISTIC SrvShr_TSysMsgTimeOut_C "F9120: System time client: Threshold to start internal inc of system time" VALUE 0x1914C0 AblGLKWuw_M 655.35 TI0_01_M 0 655.35 FORMAT "%8.4" /end CHARACTERISTIC
/begin CHARACTERISTIC SrvShr_TSysTimeInc_C "F9120: System time client: Threshold to control internal of system time" VALUE 0x1914C2 AblGLKWuw_M 655.35 TI0_01_M 0 655.35 FORMAT "%8.4" /end CHARACTERISTIC
/begin MEASUREMENT SrvShr_UBATT_FILT "F9120: measured battery voltage" UWORD U0_001_S1 1 100 0 65.535 ECU_ADDRESS 0xFFF93460 FORMAT "%8.5" /end MEASUREMENT
/begin MEASUREMENT SrvShr_UDRMV1 "F9120: measured actuator-power-supply 1" UWORD U0_001_S1 1 100 0 65.535 ECU_ADDRESS 0xFFF93462 FORMAT "%8.5" /end MEASUREMENT
/begin MEASUREMENT SrvShr_UDRMV2 "F9120: measured actuator-power-supply 2" UWORD U0_001_S1 1 100 0 65.535 ECU_ADDRESS 0xFFF93464 FORMAT "%8.5" /end MEASUREMENT
/begin MEASUREMENT SrvShr_USENSOR "F9120: measured sensor-power-supply" UWORD U0_001_S1 1 100 0 65.535 ECU_ADDRESS 0xFFF93466 FORMAT "%8.5" /end MEASUREMENT
/begin MEASUREMENT SrvShr_USENSOR_DI_RDY "F9120: sensor supply diagnosis status valid" UBYTE X1_S1 1 100 0 255 ECU_ADDRESS 0xFFF93B02 FORMAT "%5.1" /end MEASUREMENT
/begin MEASUREMENT SrvShr_USENSOR_ESTATUS "F9120: sensor supply electrical status (B2:OP via connected sensors,B5:ZUKL/SG,B6:ZUGR/SB)" UBYTE X1_S1 1 100 0 255 ECU_ADDRESS 0xFFF84C0D FORMAT "%5.1" /end MEASUREMENT
/begin MEASUREMENT SrvShr_USENSOR_ESTATUS_KOMP "F9120: complementary sensor supply electrical status" UBYTE X1_S1 1 100 0 255 ECU_ADDRESS 0xFFF84C0E FORMAT "%5.1" /end MEASUREMENT
/begin MEASUREMENT SrvShr_U_IN0 "F9120: Voltage of IN0" UWORD U0_001_S1 1 100 0 25 ECU_ADDRESS 0xFFF93526 FORMAT "%8.5" /end MEASUREMENT
/begin MEASUREMENT SrvShr_U_IN1 "F9120: Voltage of IN1" UWORD U0_001_S1 1 100 0 25 ECU_ADDRESS 0xFFF93528 FORMAT "%8.5" /end MEASUREMENT
/begin MEASUREMENT SrvShr_U_IN2 "F9120: Voltage of IN2" UWORD U0_001_S1 1 100 0 25 ECU_ADDRESS 0xFFF9352A FORMAT "%8.5" /end MEASUREMENT
/begin MEASUREMENT SrvShr_U_IN3 "F9120: Voltage of IN3" UWORD U0_001_S1 1 100 0 5 ECU_ADDRESS 0xFFF9352E FORMAT "%8.6" /end MEASUREMENT
/begin MEASUREMENT SrvShr_U_KL15_PIN "F9120: analog KL15 pin information" UWORD U0_001_S1 1 100 0 65.535 ECU_ADDRESS 0xFFF933FA FORMAT "%8.5" /end MEASUREMENT
/begin MEASUREMENT SrvShr_U_PN_RAW "F9120: measured PN-pin voltage" UWORD U0_001_S1 1 100 0 65.535 ECU_ADDRESS 0xFFF93468 FORMAT "%8.5" /end MEASUREMENT
/begin MEASUREMENT SrvShr_VSMC_EvalCANFltStoreState "F9120: Vehicle State Manager: State Pointer CAN evaluation" UBYTE X1_M 1 100 0 255 ECU_ADDRESS 0xFFF9395E FORMAT "%5.1" /end MEASUREMENT
/begin MEASUREMENT SrvShr_VSMC_EvalCANFltStoreTimer "F9120: Vehicle State Manager: Timer CAN evaluation" UWORD TI0_01_M 1 100 0 655.35 ECU_ADDRESS 0xFFF93388 FORMAT "%8.4" /end MEASUREMENT
/begin MEASUREMENT SrvShr_VSMC_InhibitFltStore "F9120: Vehicle State Manager: Stored Status Fault inhibit" UBYTE X1_M 1 100 0 255 ECU_ADDRESS 0xFFF9395F FORMAT "%5.1" /end MEASUREMENT
/begin MEASUREMENT SrvShr_VSMC_StatusBusruhe "F9120: Vehicle State Manager: Stored Status Busruhe" UBYTE X1_M 1 100 0 255 ECU_ADDRESS 0xFFF93960 FORMAT "%5.1" /end MEASUREMENT
/begin MEASUREMENT SrvShr_WDOG_DI_RDY "F9140: test condition related to the safety system" UBYTE X1_S1 1 100 0 255 ECU_ADDRESS 0xFFF93AC6 FORMAT "%5.1" /end MEASUREMENT
/begin MEASUREMENT SrvShr_WDOG_ESTATUS "F9140: error status information related to the safety system (B0:INIT,B1:DN,B2:PCLK,B3:WD-HW,B4:WD-SW)" UBYTE X1_S1 1 100 0 255 ECU_ADDRESS 0xFFF93AC7 FORMAT "%5.1" /end MEASUREMENT
/begin MEASUREMENT SrvShr_bPSplyDsmRd "F9140: Semaphore flag for Psply error reporting" UBYTE B_TRUE_S1 1 100 0 1 ECU_ADDRESS 0xFFF93402 FORMAT "%13.11" MATRIX_DIM 2 1 1 /end MEASUREMENT
/begin MEASUREMENT SrvShr_bSSplyExtFault "F9120: flag for additional fault status (SSply external detection)" UBYTE B_TRUE_S1 1 100 0 1 ECU_ADDRESS 0xFFF93AFD FORMAT "%13.11" /end MEASUREMENT
/begin MEASUREMENT SrvShr_bSSplyExtTest "F9120: flag for additional test condition (SSply external detection)" UBYTE B_TRUE_S1 1 100 0 1 ECU_ADDRESS 0xFFF93AFE FORMAT "%13.11" /end MEASUREMENT
/begin MEASUREMENT SrvShr_bSSplyReq "F9140: current sensor supply request (has to be toggled before a new one is accepted)" UBYTE X1_S1 1 100 0 255 ECU_ADDRESS 0xFFF93AC2 FORMAT "%5.1" /end MEASUREMENT
/begin MEASUREMENT SrvShr_ctPFCCfg_a "F9110: Number of currently configured check points (idx. 0=10ms tasks, 1=20ms tasks, 2=30ms tasks)" UWORD X1_S1 1 100 0 65535 ECU_ADDRESS 0xFFF933E0 FORMAT "%8.2" MATRIX_DIM 3 1 1 /end MEASUREMENT
/begin MEASUREMENT SrvShr_ctSdnFast "F9140: free running counter for fast shutdown requests" UWORD X1_S1 1 100 0 65535 ECU_ADDRESS 0xFFF94398 FORMAT "%8.2" /end MEASUREMENT
/begin MEASUREMENT SrvShr_efErrCTrqRpm "F9151: error flag for signal operation change in TRQ/RPM control (ACAN)" UBYTE X1_M 1 100 0 255 ECU_ADDRESS 0xFFF93A18 FORMAT "%5.1" /end MEASUREMENT
/begin MEASUREMENT SrvShr_efErrDisplay "F9151: error flag display actual gear (A-CAN)" UBYTE X1_M 1 100 0 255 ECU_ADDRESS 0xFFF93A1A FORMAT "%5.1" /end MEASUREMENT
/begin MEASUREMENT SrvShr_efErrNegMe "F9151: error flag negative engine intervention" UBYTE X1_M 1 100 0 255 ECU_ADDRESS 0xFFF93AA1 FORMAT "%5.1" /end MEASUREMENT
/begin MEASUREMENT SrvShr_efErrPosMe "F9151: error flag positive engine intervention" UBYTE X1_M 1 100 0 255 ECU_ADDRESS 0xFFF93AA2 FORMAT "%5.1" /end MEASUREMENT
/begin MEASUREMENT SrvShr_efErrRPM "F9151: error flag turbines speed and output shaft speed (A-CAN)" UBYTE X1_M 1 100 0 255 ECU_ADDRESS 0xFFF93AA7 FORMAT "%5.1" /end MEASUREMENT
/begin MEASUREMENT SrvShr_efErrTRLoss "F9151: error flag for signal torque loss (ACAN)" UBYTE X1_M 1 100 0 255 ECU_ADDRESS 0xFFF93AAC FORMAT "%5.1" /end MEASUREMENT
/begin MEASUREMENT SrvShr_efErrTaRPMEM "F9151: error flag for signal target RPM EM (ACAN)" UBYTE X1_M 1 100 0 255 ECU_ADDRESS 0xFFF93AA9 FORMAT "%5.1" /end MEASUREMENT
/begin MEASUREMENT SrvShr_efErrTaRPMin "F9151: error flag for signal idling RPM boost request (ACAN)" UBYTE X1_M 1 100 0 255 ECU_ADDRESS 0xFFF93AAB FORMAT "%5.1" /end MEASUREMENT
/begin CHARACTERISTIC SrvShr_facTipInfoHigh_C "F9120: signal is considered plausible if 1/threshold <= Thigh_new/Thigh_old <= threshold (no SERAP)" VALUE 0x190450 AblGLKWr32_S1 0.2 X1_S1 0.9 1.1 FORMAT "%10.8" /end CHARACTERISTIC
/begin CHARACTERISTIC SrvShr_facTipInfoMul_C "F9120: signal is considered plausible if 1/threshold <= Tlow_new/Thigh*num <= threshold (no SERAP)" VALUE 0x190454 AblGLKWr32_S1 0.2 X1_S1 0.9 1.1 FORMAT "%10.8" /end CHARACTERISTIC
/begin MEASUREMENT SrvShr_iOUT "F9140: requested output current" UWORD I0_0001_S1 1 100 0 6.5535 ECU_ADDRESS 0xFFF84B8C FORMAT "%8.6" MATRIX_DIM 15 1 1 /end MEASUREMENT
/begin MEASUREMENT SrvShr_iOUT_KOMP "F9140: requested output current (complement)" UWORD I0_0001_S1 1 100 0 6.5535 ECU_ADDRESS 0xFFF84BAA FORMAT "%8.6" MATRIX_DIM 15 1 1 /end MEASUREMENT
/begin CHARACTERISTIC SrvShr_iSol1_C "F9140: current characteristic to control Sol1 by pressure regulator stage (no SERAP)" VAL_BLK 0x1904F4 AblGLKWBuw_S1 2 I0_0001_S1 0 2 MATRIX_DIM 6 1 1 FORMAT "%8.6" /end CHARACTERISTIC
/begin CHARACTERISTIC SrvShr_idxSol1_C "F9140: OUT-Channel used as on/off solenoid output (no SERAP)" VALUE 0x1918DB AblGLKWub_S1 255 X1_S1 0 255 FORMAT "%5.1" /end CHARACTERISTIC
/begin MEASUREMENT SrvShr_idxTapAnaRng "F9120: Current analog range of tap input line" UBYTE X1_S1 1 100 0 15 ECU_ADDRESS 0xFFF93B50 FORMAT "%5.2" /end MEASUREMENT
/begin MEASUREMENT SrvShr_idxTapAnaRngOld "F9120: Analog range of tap input line from last cycle" UBYTE X1_S1 1 100 0 15 ECU_ADDRESS 0xFFF93B51 FORMAT "%5.2" /end MEASUREMENT
/begin MEASUREMENT SrvShr_idxTapAnaRngUse "F9120: Used analog tap range for setting interface signals" UBYTE X1_S1 1 100 0 15 ECU_ADDRESS 0xFFF93B52 FORMAT "%5.2" /end MEASUREMENT
/begin MEASUREMENT SrvShr_numErrNegMe "F9151: counter error negative engine intervention" UBYTE X1_M 1 100 0 255 ECU_ADDRESS 0xFFF93AA3 FORMAT "%5.1" /end MEASUREMENT
/begin CHARACTERISTIC SrvShr_numErrNegMe_C "F9151: Threshold for error negative engine intervention" VALUE 0x1918CF AblGLKWub_M 255 X1_M 0 255 FORMAT "%5.1" /end CHARACTERISTIC
/begin MEASUREMENT SrvShr_numErrNoNegMe "F9151: counter error no negative engine intervention" UBYTE X1_M 1 100 0 255 ECU_ADDRESS 0xFFF93AA4 FORMAT "%5.1" /end MEASUREMENT
/begin CHARACTERISTIC SrvShr_numErrNoNegMe_C "F9151: Threshold for error no negative engine intervention" VALUE 0x1918D0 AblGLKWub_M 255 X1_M 0 255 FORMAT "%5.1" /end CHARACTERISTIC
/begin MEASUREMENT SrvShr_numErrNoPosMe "F9151: counter error no positive engine intervention" UBYTE X1_M 1 100 0 255 ECU_ADDRESS 0xFFF93AA5 FORMAT "%5.1" /end MEASUREMENT
/begin CHARACTERISTIC SrvShr_numErrNoPosMe_C "F9151: Threshold for error no positive engine intervention" VALUE 0x1918D1 AblGLKWub_M 255 X1_M 0 255 FORMAT "%5.1" /end CHARACTERISTIC
/begin MEASUREMENT SrvShr_numErrPosMe "F9151: counter error positive engine intervention" UBYTE X1_M 1 100 0 255 ECU_ADDRESS 0xFFF93AA6 FORMAT "%5.1" /end MEASUREMENT
/begin CHARACTERISTIC SrvShr_numErrPosMe_C "F9151: Threshold for error positive engine intervention" VALUE 0x1918D2 AblGLKWub_M 255 X1_M 0 255 FORMAT "%5.1" /end CHARACTERISTIC
/begin MEASUREMENT SrvShr_numMemArSizeUsd_a "F9110: Size of used memory space for PFC configuration (activation phase) (idx. 0=10ms tasks, 1=20ms tasks, 2=30ms tasks) [4byte]" UWORD X1_S1 1 100 0 65535 ECU_ADDRESS 0xFFF933E6 FORMAT "%8.2" MATRIX_DIM 3 1 1 /end MEASUREMENT
/begin MEASUREMENT SrvShr_numMemArSize_a "F9110: Size of passed memory space for PFC configuration (activation phase) (idx. 0=10ms tasks, 1=20ms tasks, 2=30ms tasks) [4byte]" UWORD X1_S1 1 100 0 65535 ECU_ADDRESS 0xFFF933EC FORMAT "%8.2" MATRIX_DIM 3 1 1 /end MEASUREMENT
/begin MEASUREMENT SrvShr_numPFCCfgMax_a "F9110: Maximal number of configurable check points (idx. 0=10ms tasks, 1=20ms tasks, 2=30ms tasks)" UWORD X1_S1 1 100 0 65535 ECU_ADDRESS 0xFFF933F2 FORMAT "%8.2" MATRIX_DIM 3 1 1 /end MEASUREMENT
/begin CHARACTERISTIC SrvShr_rTrqMax_C "F9120: maximum value for PWM ratio" VALUE 0x1914CC AblGLKWuw_S1 100 R0_1_P_S1 0 100 FORMAT "%8.4" /end CHARACTERISTIC
/begin CHARACTERISTIC SrvShr_rTrqMin_C "F9120: minimum value for PWM ratio" VALUE 0x1914CE AblGLKWuw_S1 100 R0_1_P_S1 0 100 FORMAT "%8.4" /end CHARACTERISTIC
/begin CHARACTERISTIC SrvShr_rTrqOff_C "F9120: reported value in case PWM ratio measurement is deactivated (no SERAP)" VALUE 0x1914CA AblGLKWuw_S1 100 R0_1_P_S1 0 100 FORMAT "%8.4" /end CHARACTERISTIC
/begin MEASUREMENT SrvShr_stAtf_Fault "F9120: bitcoded Atf/CGT fault status (memorized information)" UWORD X1_S1 1 100 0 65535 ECU_ADDRESS 0xFFF93454 FORMAT "%8.2" /end MEASUREMENT
/begin MEASUREMENT SrvShr_stCc08_Fault "F9140: bit coded Cc08 fault status (memorized information)" UWORD X1_S1 1 100 0 65535 ECU_ADDRESS 0xFFF92B28 FORMAT "%8.2" MATRIX_DIM 10 1 1 /end MEASUREMENT
/begin MEASUREMENT SrvShr_stCc08_KFA "F9140: fault type reported to DI_FILTER (B0-B3:KFA, B4=OK, B6:direct, B7:KFC2 instead KFC1)" UBYTE X1_S1 1 100 0 255 ECU_ADDRESS 0xFFF93432 FORMAT "%5.1" MATRIX_DIM 10 1 1 /end MEASUREMENT
/begin MEASUREMENT SrvShr_stCc08_Test "F9140: Cc08 test condition bitmask" UWORD X1_S1 1 100 0 65535 ECU_ADDRESS 0xFFF92B3C FORMAT "%8.2" MATRIX_DIM 10 1 1 /end MEASUREMENT
/begin MEASUREMENT SrvShr_stChp1_Fault "F9120: bitcoded Chp1/CCHIP1 fault status (memorized information)" UWORD X1_S1 1 100 0 65535 ECU_ADDRESS 0xFFF93456 FORMAT "%8.2" /end MEASUREMENT
/begin MEASUREMENT SrvShr_stFaultMCCOMP "F9110: Faults of fault code KFC_MCCOMP" UBYTE X1_S1 1 100 0 255 ECU_ADDRESS 0xFFF93B45 FORMAT "%5.1" /end MEASUREMENT
/begin MEASUREMENT SrvShr_stFaultSFRM "F9110: Faults of fault code KFC_SFRM" UBYTE X1_S1 1 100 0 255 ECU_ADDRESS 0xFFF93B46 FORMAT "%5.1" /end MEASUREMENT
/begin MEASUREMENT SrvShr_stLss_Fault "F9140: bit coded Lss fault status (memorized information)" UWORD X1_S1 1 100 0 65535 ECU_ADDRESS 0xFFF9343C FORMAT "%8.2" MATRIX_DIM 5 1 1 /end MEASUREMENT
/begin MEASUREMENT SrvShr_stLss_KFA "F9140: fault type reported to DI_FILTER (B0-B3:KFA, B4=OK, B6:direct, B7:KFC2 instead KFC1)" UBYTE X1_S1 1 100 0 255 ECU_ADDRESS 0xFFF93AE7 FORMAT "%5.1" MATRIX_DIM 5 1 1 /end MEASUREMENT
/begin MEASUREMENT SrvShr_stLss_Test "F9140: Lss test condition bitmask" UWORD X1_S1 1 100 0 65535 ECU_ADDRESS 0xFFF93446 FORMAT "%8.2" MATRIX_DIM 5 1 1 /end MEASUREMENT
/begin MEASUREMENT SrvShr_stPSply "F9140: requested PSply configuration (0=off,1=on)" UBYTE X1_S1 1 100 0 255 ECU_ADDRESS 0xFFF93450 FORMAT "%5.1" MATRIX_DIM 2 1 1 /end MEASUREMENT
/begin MEASUREMENT SrvShr_stPSply_Fault "F9140: bit coded PSply fault status (memorized information)" UWORD X1_S1 1 100 0 65535 ECU_ADDRESS 0xFFF92B50 FORMAT "%8.2" MATRIX_DIM 2 1 1 /end MEASUREMENT
/begin MEASUREMENT SrvShr_stPSply_KFA "F9140: fault type reported to DI_FILTER (B0-B3:KFA, B4=OK, B6:direct, B7:KFC2 instead KFC1)" UBYTE X1_S1 1 100 0 255 ECU_ADDRESS 0xFFF93452 FORMAT "%5.1" MATRIX_DIM 2 1 1 /end MEASUREMENT
/begin MEASUREMENT SrvShr_stPSply_Test "F9140: PSply test condition bitmask" UWORD X1_S1 1 100 0 65535 ECU_ADDRESS 0xFFF92B54 FORMAT "%8.2" MATRIX_DIM 2 1 1 /end MEASUREMENT
/begin MEASUREMENT SrvShr_stPsns_Fault "F9120: bit coded Psns/Lx fault status (memorized information)" UWORD X1_S1 1 100 0 65535 ECU_ADDRESS 0xFFF92B0C FORMAT "%8.2" MATRIX_DIM 4 1 1 /end MEASUREMENT
/begin MEASUREMENT SrvShr_stRomFault "F9110: Bit map for detected checksum faults" UWORD X1_S1 1 100 0 65535 ECU_ADDRESS 0xFFF93398 FORMAT "%8.2" /end MEASUREMENT
/begin MEASUREMENT SrvShr_stSSplyExtFault "F9120: bit coded fault status of connected sensors (0:NT 1:NAB)" UBYTE X1_S1 1 100 0 255 ECU_ADDRESS 0xFFF93AFF FORMAT "%5.1" /end MEASUREMENT
/begin MEASUREMENT SrvShr_stSSplyExtFaultOld "F9120: last state of SrvShr_stSSplyExtFault" UBYTE X1_S1 1 100 0 255 ECU_ADDRESS 0xFFF93B00 FORMAT "%5.1" /end MEASUREMENT
/begin MEASUREMENT SrvShr_stSSply_Fault "F9120: bit coded SSply fault status" UWORD X1_S1 1 100 0 65535 ECU_ADDRESS 0xFFF9345C FORMAT "%8.2" /end MEASUREMENT
/begin MEASUREMENT SrvShr_stSSply_KFA "F9120: fault type reported to DI_FILTER (B0-B3:KFA, B4=OK)" UBYTE X1_S1 1 100 0 255 ECU_ADDRESS 0xFFF93B01 FORMAT "%5.1" /end MEASUREMENT
/begin MEASUREMENT SrvShr_stSSply_Test "F9120: SSply test condition bitmask" UWORD X1_S1 1 100 0 65535 ECU_ADDRESS 0xFFF9345E FORMAT "%8.2" /end MEASUREMENT
/begin MEASUREMENT SrvShr_stSdnWakFilt "F9140: wake filter" UWORD X1_S1 1 100 0 65535 ECU_ADDRESS 0xFFF93400 FORMAT "%8.2" /end MEASUREMENT
/begin CHARACTERISTIC SrvShr_stSdnWakFilt_C "F9140: bitmask for Wake=low detection (number of program cycles) (valid-values=0x1,0x3,0x7,0xF,0x1F,0x3F,0x7F,0xFF,0x1FF,0x3FF,0x7FF,0xFFF,0x1FFF,0x3FFF,0x7FFF,0xFFFF)" VALUE 0x1914D6 AblGLKWuw_S1 65534 X1_S1 0 65535 FORMAT "%8.2" /end CHARACTERISTIC
/begin CHARACTERISTIC SrvShr_stTapAnaEval_C "F9120: TapAnalog status assignment for each voltage area (B0:SG,B1:SB,B2:OP,B3:PLAUS,B8:TapPlus,B9:TapMinus,B10:unchanged) (no SERAP)" VAL_BLK 0x190570 AblGLKWBuw_S1 65535 X1_S1 0 65535 MATRIX_DIM 16 1 1 FORMAT "%8.2" /end CHARACTERISTIC
/begin MEASUREMENT SrvShr_stTipInfo "F9120: Bit coded status info (B0=no timeout/init,B1=new signal,B2=multiplier-error,B3=comparison-error,B4=Th-error)" UBYTE X1_S1 1 100 0 255 ECU_ADDRESS 0xFFF936B7 FORMAT "%5.1" /end MEASUREMENT
/begin MEASUREMENT SrvShr_stTis_Fault "F9120: bitcoded Tis/NT fault status (memorized information)" UWORD X1_S1 1 100 0 65535 ECU_ADDRESS 0xFFF93458 FORMAT "%8.2" /end MEASUREMENT
/begin MEASUREMENT SrvShr_stTos_Fault "F9120: bitcoded Tos/NAB fault status (memorized information)" UWORD X1_S1 1 100 0 65535 ECU_ADDRESS 0xFFF9345A FORMAT "%8.2" /end MEASUREMENT
/begin MEASUREMENT SrvShr_stTstMCCOMP "F9110: Test conditions of fault code KFC_MCCOMP" UBYTE X1_S1 1 100 0 255 ECU_ADDRESS 0xFFF93B47 FORMAT "%5.1" /end MEASUREMENT
/begin MEASUREMENT SrvShr_stTstSFRM "F9110: Test conditions of fault code KFC_SFRM" UBYTE X1_S1 1 100 0 255 ECU_ADDRESS 0xFFF93B48 FORMAT "%5.1" /end MEASUREMENT
/begin CHARACTERISTIC SrvShr_swtBypOn_C "F9140: activation switch for bypassing OUT11 (0x5AA5=on) (no SERAP)" VALUE 0x1914D8 AblGLKWuw_S1 65535 X1_S1 0 65535 FORMAT "%8.2" /end CHARACTERISTIC
/begin CHARACTERISTIC SrvShr_swtFdbkAdcOut10_C "F9140: Activation of special feedback determination from ADC-result classification (27381=on) (no SERAP)" VALUE 0x1914DA AblGLKWuw_S1 65535 X1_S1 0 65535 FORMAT "%8.2" /end CHARACTERISTIC
/begin CHARACTERISTIC SrvShr_swtTrqOn_C "F9120: activation switch for (FALSE=off, TRUE=on)" VALUE 0x1914D0 AblGLKWuw_S1 1 B_TRUE_S1 0 1 FORMAT "%13.11" /end CHARACTERISTIC
/begin CHARACTERISTIC SrvShr_tSubsChpOfs_C "F9120: Temperature offset for the ATF substitution by CHP - MUST have the same value as InpPAtfL3_tSubsChpOfs_C!" VALUE 0x19187A AblGLKWsw_S1 100 T0_0625_S1 -50 50 FORMAT "%8.5" /end CHARACTERISTIC
/begin MEASUREMENT SrvShr_tiFrFlt "F9140: Timer to check error entry on PSply after start up" UBYTE TI1_M_CYCLE_S1 1 100 0 1275 ECU_ADDRESS 0xFFF941A8 FORMAT "%5.0" MATRIX_DIM 2 1 1 /end MEASUREMENT
/begin CHARACTERISTIC SrvShr_tiFrFlt_C "F9140: Start value to check error entry on PSply after start up" VAL_BLK 0x1914E6 AblGLKWBub_S1 1275 TI1_M_CYCLE_S1 0 1275 MATRIX_DIM 2 1 1 FORMAT "%5.0" /end CHARACTERISTIC
/begin MEASUREMENT SrvShr_tiOpCruTemp "F9110: time measurement of CRU operation" ULONG TI0_001_S1 1 100 0 4294967.295 ECU_ADDRESS 0xFFF92B64 FORMAT "%13.5" /end MEASUREMENT
/begin MEASUREMENT SrvShr_tiOpTemp "F9110: time measurement of SBY/CRU/LPH operation" ULONG TI0_001_S1 1 100 0 4294967.295 ECU_ADDRESS 0xFFF92B68 FORMAT "%13.5" /end MEASUREMENT
/begin MEASUREMENT SrvShr_tiSSplyExtChk "F9120: timer to detect simultaneous fault in connected sensors" UBYTE TI1_M_CYCLE_S1 1 100 0 1275 ECU_ADDRESS 0xFFF9422D FORMAT "%5.0" /end MEASUREMENT
/begin CHARACTERISTIC SrvShr_tiSSplyExtChk_C "F9120: timer to detect simultaneous fault in connected sensors" VALUE 0x1918E1 AblGLKWub_S1 1275 TI1_M_CYCLE_S1 0 1275 FORMAT "%5.0" /end CHARACTERISTIC
/begin MEASUREMENT SrvShr_tiTapAnaRngStb "F9120: Analog Tap input: Timer for not changed analog range" UBYTE TI1_M_CYCLE_S1 1 100 0 1275 ECU_ADDRESS 0xFFF94241 FORMAT "%5.0" /end MEASUREMENT
/begin CHARACTERISTIC SrvShr_tiTapAnaRngStb_C "F9120: Reload value for analog Tap range not changed timer: SrvShr_tiTapAnaRngStb. If reached: SrvShr_idxTapAnaRngUse = SrvShr_idxTapAnaRng (no SERAP)" VALUE 0x1919D6 AblGLKWub_S1 1275 TI1_M_CYCLE_S1 0 1275 FORMAT "%5.0" /end CHARACTERISTIC
/begin MEASUREMENT SrvShr_tiTipInfoHigh "F9120: currently registered high-time (raw info)" ULONG TI1_U_S1 1 100 0 4294967295 ECU_ADDRESS 0xFFF916EC FORMAT "%13.2" /end MEASUREMENT
/begin MEASUREMENT SrvShr_tiTipInfoHighLast "F9120: previously registered high-time (raw info)" ULONG TI1_U_S1 1 100 0 4294967295 ECU_ADDRESS 0xFFF916F0 FORMAT "%13.2" /end MEASUREMENT
/begin CHARACTERISTIC SrvShr_tiTipInfoHigh_C "F9120: Timing limits for Tip-Info-High Duration (idx0=low-limit, idx1=high-limit) (no SERAP)" VAL_BLK 0x190458 AblGLKWBuw_S1 10000 TI1_U_S1 1000 11000 MATRIX_DIM 2 1 1 FORMAT "%8.2" /end CHARACTERISTIC
/begin MEASUREMENT SrvShr_tiTipInfoLow "F9120: currently registered low-time (raw info)" ULONG TI1_U_S1 1 100 0 4294967295 ECU_ADDRESS 0xFFF916F4 FORMAT "%13.2" /end MEASUREMENT
/begin MEASUREMENT SrvShr_tiTipInfoMeas "F9120: Measurement counter to reinitialize the MIN/MAX measurement" UWORD TI1_CYCLE_S1 1 100 0 6553.5 ECU_ADDRESS 0xFFF9414A FORMAT "%8.3" /end MEASUREMENT
/begin CHARACTERISTIC SrvShr_tiTipInfoMeas_C "F9120: Measurement period for MIN/MAX value (0=infinite) (no SERAP)" VALUE 0x1914B2 AblGLKWuw_S1 6553.5 TI1_CYCLE_S1 0 6553.5 FORMAT "%8.3" /end CHARACTERISTIC
/begin CHARACTERISTIC SrvShr_tiTrqPerMax_C "F9120: maximum period acceptable for PWM ratio measurement" VALUE 0x1914D2 AblGLKWuw_S1 16.3828 TI0_00025_M_S1 0.001 16.38375 FORMAT "%8.5" /end CHARACTERISTIC
/begin CHARACTERISTIC SrvShr_tiTrqPerMin_C "F9120: minimum period acceptable for PWM ratio measurement" VALUE 0x1914D4 AblGLKWuw_S1 16.3828 TI0_00025_M_S1 0.001 16.38375 FORMAT "%8.5" /end CHARACTERISTIC
/begin CHARACTERISTIC SrvShr_uIn0ThresHigh_C "F9120: Digitalization threshold of IN0 line (higher voltage ->off) (no SERAP)" VALUE 0x1915F2 AblGLKWuw_S1 25 U0_001_S1 0 25 FORMAT "%8.5" /end CHARACTERISTIC
/begin CHARACTERISTIC SrvShr_uIn0ThresLow_C "F9120: Digitalization threshold of IN0 line (lower voltage ->on) (no SERAP)" VALUE 0x1915F4 AblGLKWuw_S1 25 U0_001_S1 0 25 FORMAT "%8.5" /end CHARACTERISTIC
/begin MEASUREMENT SrvShr_uTapAna "F9120: Voltage of analog tap line" UWORD U0_001_S1 1 100 0 65.535 ECU_ADDRESS 0xFFF9352C FORMAT "%8.5" /end MEASUREMENT
/begin CHARACTERISTIC SrvShr_uTapAnaEval_C "F9120: TapAnalog threshold for status area evaluation (compared to SrvShr_uTapAna) -> status bytes in SrvShr_stTapAnaEval_C (no SERAP)" VAL_BLK 0x1915FE AblGLKWBuw_S1 25 U0_001_S1 0 25 MATRIX_DIM 15 1 1 FORMAT "%8.5" /end CHARACTERISTIC
/begin CHARACTERISTIC SrvShr_uTapMinusThresHigh_C "F9120: Digitalization threshold of TapMinus line (higher voltage ->off) (no SERAP)" VALUE 0x1915F6 AblGLKWuw_S1 25 U0_001_S1 0 25 FORMAT "%8.5" /end CHARACTERISTIC
/begin CHARACTERISTIC SrvShr_uTapMinusThresLow_C "F9120: Digitalization threshold of TapMinus line (lower voltage ->on) (no SERAP)" VALUE 0x1915F8 AblGLKWuw_S1 25 U0_001_S1 0 25 FORMAT "%8.5" /end CHARACTERISTIC
/begin CHARACTERISTIC SrvShr_uTapPlusThresHigh_C "F9120: Digitalization threshold of TapPlus line (higher voltage ->off) (no SERAP)" VALUE 0x1915FA AblGLKWuw_S1 25 U0_001_S1 0 25 FORMAT "%8.5" /end CHARACTERISTIC
/begin CHARACTERISTIC SrvShr_uTapPlusThresLow_C "F9120: Digitalization threshold of TapPlus line (lower voltage ->on) (no SERAP)" VALUE 0x1915FC AblGLKWuw_S1 25 U0_001_S1 0 25 FORMAT "%8.5" /end CHARACTERISTIC
/begin MEASUREMENT SrvStrtT_ti "F9310: Time stamps of TCU start up" ULONG TI0_001_M_S1 1 100 0 200 ECU_ADDRESS 0xFFF80C64 FORMAT "%13.9" MATRIX_DIM 7 1 1 /end MEASUREMENT
/begin MEASUREMENT SrvUtl_idLibHw_Build "F9260: Component identifier for test only, build version. 4 characters BCD" UWORD X1_S1 1 100 0 65535 ECU_ADDRESS 0xFFF84B7E FORMAT "%8.2" /end MEASUREMENT
/begin MEASUREMENT SrvUtl_idLibHw_Name "F9260: Component identifier for test only, name. 6 characters ASCII" UBYTE X1_S1 1 100 0 255 ECU_ADDRESS 0xFFF84B78 FORMAT "%5.1" MATRIX_DIM 6 1 1 /end MEASUREMENT
/begin MEASUREMENT TPRT_bTOutCtlActv "F4410: Flag, timeout control is active / not active (<>0 =active)" UBYTE X1_M 1 100 0 1 ECU_ADDRESS 0xFFF93A14 FORMAT "%5.3" /end MEASUREMENT
/begin MEASUREMENT TPRT_sCanMsgNew "F4410: State machine, shows the request of a new CAN message for TPRT (or overflow)" UBYTE X1_M 1 100 0 2 ECU_ADDRESS 0xFFF93A15 FORMAT "%5.3" /end MEASUREMENT
/begin MEASUREMENT TPRT_sOuCtrl "F4410: State machine for output control via OuCd" UBYTE X1_M 1 100 0 2 ECU_ADDRESS 0xFFF93A16 FORMAT "%5.3" /end MEASUREMENT
/begin MEASUREMENT TPRT_sScyLvl "F4410: Test protocol security level, state machine" UBYTE X1_M 1 100 0 3 ECU_ADDRESS 0xFFF93A17 FORMAT "%5.3" /end MEASUREMENT
/begin MEASUREMENT TPRT_tiComTOut "F4410: Timeout counter for TPRT communication timeout" UWORD TI1_CYCLE_M 1 100 0 6553.5 ECU_ADDRESS 0xFFF9414C FORMAT "%8.3" /end MEASUREMENT
/begin CHARACTERISTIC TPRT_tiComTOutStrt "F4410: Time for TPRT communication timeout" VALUE 0x1914C8 AblGLKWuw_M 9 TI0_1_M 1 10 FORMAT "%8.5" /end CHARACTERISTIC
/begin MEASUREMENT TPRT_xCanMsgBufIn "F4410: Buffer for TPRT input message CAN" UBYTE X1_M 1 100 0 255 ECU_ADDRESS 0xFFF92A3C FORMAT "%5.1" MATRIX_DIM 8 1 1 /end MEASUREMENT
/begin MEASUREMENT TPRT_xCanMsgBufOut "F4410: Buffer for TPRT output message CAN" UBYTE X1_M 1 100 0 255 ECU_ADDRESS 0xFFF92A44 FORMAT "%5.1" MATRIX_DIM 8 1 1 /end MEASUREMENT
/begin MEASUREMENT TPRT_xMemDpBuf "F4410: Buffer for test protocol memory dump" UBYTE X1_M 1 100 0 255 ECU_ADDRESS 0xFFF92A4C FORMAT "%5.1" MATRIX_DIM 100 1 1 /end MEASUREMENT
/begin MEASUREMENT TPRT_xSigValOff "F4410: Special output, signal value for signal OFF (e.g. current)" UWORD X1_M 1 100 0 65535 ECU_ADDRESS 0xFFF933C4 FORMAT "%8.2" /end MEASUREMENT
/begin MEASUREMENT TPRT_xSigValOn "F4410: Special output, signal value for signal ON (e.g. current)" UWORD X1_M 1 100 0 65535 ECU_ADDRESS 0xFFF933C6 FORMAT "%8.2" /end MEASUREMENT
/begin MEASUREMENT TPRT_xSrv_Seed "F4410: Data array to save the seed for later key calculation" UBYTE X1_M 1 100 0 255 ECU_ADDRESS 0xFFF92AB0 FORMAT "%5.1" MATRIX_DIM 8 1 1 /end MEASUREMENT
/begin MEASUREMENT WdCtlStd_sComMode "F6200: IWD communication mode - standard mode (0x0=valid response + timing too early, 0x7=valid response + timing too late, 0x19=invalid response + correct timing, 0x1E=valid response + correct timing, 0x2A=synchronization request)" UBYTE X1_S1 1 100 0 42 ECU_ADDRESS 0xFFF94921 FORMAT "%5.2" /end MEASUREMENT
/begin MEASUREMENT WdIpt_ctTOut "F6200: Timeout counter / status (0=counter is disabled, 1=timeout has occured, otherwise counter is running (current value = value - 1))" UBYTE X1_S1 1 100 0 255 ECU_ADDRESS 0xFFF93B97 FORMAT "%5.1" /end MEASUREMENT
/begin CHARACTERISTIC WdIpt_numTOutTolc_C "F6200: Timeout tolerance value (measured in active process execution cycles)" VALUE 0x1919FF AblGLKWub_S1 5 X1_S1 0 5 FORMAT "%5.3" /end CHARACTERISTIC
/begin MEASUREMENT WdIpt_sComMode "F6200: IWD communication mode during IPT mode (0x0=SYNC, 0x7=DECR and 0x19=INCR)" UBYTE X1_S1 1 100 0 25 ECU_ADDRESS 0xFFF93B98 FORMAT "%5.2" /end MEASUREMENT
/begin MEASUREMENT WdIpt_sTgtLvlReq "F6200: Requested IWD target level (0x0=Level C, 0x3=Level B, 0x5=Level A)" UBYTE X1_S1 1 100 0 5 ECU_ADDRESS 0xFFF94922 FORMAT "%5.3" /end MEASUREMENT
/begin MEASUREMENT WdMnExtd_bFrstT "F6200: Flag for current run mode active the first time (TRUE=run mode active the first time, FALSE=otherwise)" UBYTE B_TRUE_S1 1 100 0 1 ECU_ADDRESS 0xFFF9491E FORMAT "%13.11" /end MEASUREMENT
/begin MEASUREMENT WdMnExtd_ctTskExe "F6200: Base task execution counter" UBYTE X1_S1 1 100 0 255 ECU_ADDRESS 0xFFF9491F FORMAT "%5.1" /end MEASUREMENT
/begin CHARACTERISTIC WdMnExtd_numTskExe_C "F6200: Number of base task executions during the monitoring time (no SERAP)" VALUE 0x1919DE AblGLKWub_S1 49 X1_S1 1 50 FORMAT "%5.2" /end CHARACTERISTIC
/begin MEASUREMENT WdMnExtd_sRunMode "F6200: Current IWD handling mode (0x0=STRT, 0x8=INIT, 0x12=NONOP, 0x23=OP, 0x34=ACTIVE_OFF, 0x45=ACTIVE_ON)" UBYTE X1_S1 1 100 0 69 ECU_ADDRESS 0xFFF94920 FORMAT "%5.2" /end MEASUREMENT
/begin MEASUREMENT WdMnExtd_stFaultBuf "F6200: The fault bit vector buffer (faults that shall be delivered to the error handler)" UWORD X1_S1 1 100 0 65535 ECU_ADDRESS 0xFFF935D6 FORMAT "%8.2" /end MEASUREMENT
/begin MEASUREMENT WdMnExtd_stTstBuf "F6200: The test condition bit vector buffer (test conditions for the faults that shall be delivered to the error handler)" UWORD X1_S1 1 100 0 65535 ECU_ADDRESS 0xFFF935D8 FORMAT "%8.2" /end MEASUREMENT
/begin CHARACTERISTIC WdMnExtd_stWdStatsClr_C "F6200: Switch to clear the statistic watchdog (IWD and WDT) data (value has to change from 1 to 2 to initiate the clearing up)" VALUE 0x1919DF AblGLKWub_S1 2 X1_S1 0 2 FORMAT "%5.3" /end CHARACTERISTIC
/begin MEASUREMENT WdMnExtd_tiTskMonDiffT "F6200: Difference between base task monitoring reference time and current system time [tick]" ULONG X1_S1 1 100 0 4294967295 ECU_ADDRESS 0xFFF93074 FORMAT "%13.2" /end MEASUREMENT
/begin MEASUREMENT WdMnExtd_tiTskMonRefT "F6200: Reference time of the base task monitoring [tick]" ULONG X1_S1 1 100 0 4294967295 ECU_ADDRESS 0xFFF94880 FORMAT "%13.2" /end MEASUREMENT
/begin CHARACTERISTIC WdMnExtd_tiTskMonT_C "F6200: Monitoring time of the base task monitoring (no SERAP)" VALUE 0x1912C8 AblGLKWul_S1 4294970000 TI1_U_S1 0 4294967295 FORMAT "%13.2" /end CHARACTERISTIC
/begin MEASUREMENT WdResp_adMdulMonFault_ps "F6200: Address of monitored module which at last has cause the checksum fault" ULONG X1_S1 1 100 0 4294967295 ECU_ADDRESS 0xFFF92E44 FORMAT "%13.2" /end MEASUREMENT
/begin MEASUREMENT WdResp_ctCyclCnt "F6200: Number of process execution cycles since last update of the monitored module data structures" UBYTE X1_S1 1 100 0 127 ECU_ADDRESS 0xFFF93B34 FORMAT "%5.1" /end MEASUREMENT
/begin MEASUREMENT WdResp_ctCyclCntRmn "F6200: Number of remaining process execution cycles until next update of the monitored module data structures" UBYTE X1_S1 1 100 0 127 ECU_ADDRESS 0xFFF93B35 FORMAT "%5.1" /end MEASUREMENT
/begin MEASUREMENT WdResp_ctMdulMonCnt "F6200: Number of currently monitored modules" UBYTE X1_S1 1 100 0 127 ECU_ADDRESS 0xFFF93B36 FORMAT "%5.1" /end MEASUREMENT
/begin MEASUREMENT WdResp_numCyclCntUpd "F6200: Buffered number of process execution cycles until next update of the monitored module data structures" UBYTE X1_S1 1 100 0 127 ECU_ADDRESS 0xFFF93B37 FORMAT "%5.1" /end MEASUREMENT
/begin MEASUREMENT WdResp_xKey "F6200: Encryption key for an encrypted IWD response references" ULONG X1_S1 1 100 0 4294967295 ECU_ADDRESS 0xFFF92E48 FORMAT "%13.2" /end MEASUREMENT
/begin MEASUREMENT WdResp_xListKey "F6200: Current global list key" UBYTE X1_S1 1 100 0 255 ECU_ADDRESS 0xFFF93B38 FORMAT "%5.1" /end MEASUREMENT
/begin MEASUREMENT WdSrv_ctIdl "F6200: Counter for idle time" UBYTE X1_S1 1 100 0 255 ECU_ADDRESS 0xFFF948F6 FORMAT "%5.1" /end MEASUREMENT
/begin MEASUREMENT WdSrv_ctNoDatErrCnt "F6200: Fault counter for missing (SPI) data from the ECE respectively IWD (counter will be healed down if the fault condition(s) will disappear)" UBYTE X1_S1 1 100 0 255 ECU_ADDRESS 0xFFF936F0 FORMAT "%5.1" /end MEASUREMENT
/begin MEASUREMENT WdSrv_ctSPIErrCnt "F6200: Fault counter for failed SPI communication (counter will be healed down if the fault condition(s) will disappear)" UBYTE X1_S1 1 100 0 255 ECU_ADDRESS 0xFFF936F1 FORMAT "%5.1" /end MEASUREMENT
/begin MEASUREMENT WdSrv_ctSyncErrCnt "F6200: Fault counter for unexpected communication faults between IWD and CPU (counter will be healed down if the fault condition(s) will disappear)" UBYTE X1_S1 1 100 0 255 ECU_ADDRESS 0xFFF936F2 FORMAT "%5.1" /end MEASUREMENT
/begin MEASUREMENT WdSrv_ctSyncErrCntStats "F6200: Statistic fault counter for unexpected communication faults between IWD and CPU" UWORD X1_S1 1 100 0 65535 ECU_ADDRESS 0xFFF9336E FORMAT "%8.2" /end MEASUREMENT
/begin MEASUREMENT WdSrv_ctWdErrCnt "F6200: CPU side copy of the IWD internal error counter" UBYTE X1_S1 1 100 0 7 ECU_ADDRESS 0xFFF936F3 FORMAT "%5.3" /end MEASUREMENT
/begin MEASUREMENT WdSrv_ctWdErrCntMax "F6200: Maximal reached value of the CPU side copy of the IWD internal error counter" UBYTE X1_S1 1 100 0 7 ECU_ADDRESS 0xFFF943B7 FORMAT "%5.3" /end MEASUREMENT
/begin MEASUREMENT WdSrv_ctWdErrCntRef "F6200: Reference error counter for comparison with IWD internal error counter" UBYTE X1_S1 1 100 0 7 ECU_ADDRESS 0xFFF936F4 FORMAT "%5.3" /end MEASUREMENT
/begin MEASUREMENT WdSrv_sRespMdfyMode "F6200: Response manipulation mode (0x0=too early + correct response, 0x7=too late + correct response, 0x19=correct in time + incorrect response, 0x1E=correct in time + correct response)" UBYTE X1_S1 1 100 0 30 ECU_ADDRESS 0xFFF948F7 FORMAT "%5.2" /end MEASUREMENT
/begin MEASUREMENT WdSrv_sSrvSt "F6200: State of communication between CPU and IWD (0x0=communication is ready, 0x7=communication is active, 0x19=communication is active with an additional waiting cycle)" UBYTE X1_S1 1 100 0 25 ECU_ADDRESS 0xFFF936F5 FORMAT "%5.2" /end MEASUREMENT
/begin MEASUREMENT WdSrv_sSyncSt "F6200: Synchronization state (derived from difference between counter WdSrv_ctWdErrCnt and WdSrv_ctWdErrCntRef) (0x0=counters show the same values, 0x7=counters show (possibly) different values, 0x19=synchronization request is currently in progress)" UBYTE X1_S1 1 100 0 25 ECU_ADDRESS 0xFFF936F6 FORMAT "%5.2" /end MEASUREMENT
/begin MEASUREMENT WdSrv_stWdStRef "F6200: Reference status for comparison with the IWD status (subset of the SPI register REQUHI)" UBYTE X1_S1 1 100 0 255 ECU_ADDRESS 0xFFF936F7 FORMAT "%5.1" /end MEASUREMENT
/begin MEASUREMENT WdSrv_tiConst "F6200: Timing constants" UWORD TI1_U_S1 1 100 0 65535 ECU_ADDRESS 0xFFF93370 FORMAT "%8.2" MATRIX_DIM 5 1 1 /end MEASUREMENT
/begin MEASUREMENT WdSrv_tiSyncTCurr "F6200: Timestamp of last (current) IWD synchronization event [tick]" ULONG X1_S1 1 100 0 4294967295 ECU_ADDRESS 0xFFF91F98 FORMAT "%13.2" /end MEASUREMENT
/begin MEASUREMENT WdSrv_tiTmr "F6200: Timer till communication to IWD must be finish [tick]" ULONG X1_S1 1 100 0 4294967295 ECU_ADDRESS 0xFFF91F9C FORMAT "%13.2" /end MEASUREMENT
/begin MEASUREMENT WdSrv_tiWdRespT "F6200: CPU side copy of the IWD response time" UWORD TI0_001_M_S1 1 100 0 65.535 ECU_ADDRESS 0xFFF9337A FORMAT "%8.5" /end MEASUREMENT
/begin MEASUREMENT WdSrv_tiWdRespTReq "F6200: Requested IWD response time. If a response time change is completely done (successful or erroneous), the value of this attribute will be equivalent to attribute value of WdSrv_tiWdRespT (after unit conversion) [200us]" UBYTE X1_S1 1 100 0 63 ECU_ADDRESS 0xFFF948F8 FORMAT "%5.2" /end MEASUREMENT
/begin MEASUREMENT WdSrv_tiWdRespTReqQue "F6200: Queued requested IWD response time [200us]" UBYTE X1_S1 1 100 0 63 ECU_ADDRESS 0xFFF948F9 FORMAT "%5.2" /end MEASUREMENT
/begin MEASUREMENT WdSrv_xWdReq "F6200: CPU side copy of the IWD request" UBYTE X1_S1 1 100 0 15 ECU_ADDRESS 0xFFF936F8 FORMAT "%5.2" /end MEASUREMENT
/begin MEASUREMENT WdSrv_xWdResp "F6200: Current total response to IWD" ULONG X1_S1 1 100 0 4294967295 ECU_ADDRESS 0xFFF91FA0 FORMAT "%13.2" /end MEASUREMENT
/begin MEASUREMENT WdUtl_sLstECURstSrc_a "F6200: Possible source of last ECU reset (idx. 0 by communication SW, idx. 1 by response calculation SW) (0x0=unknown, 0x1=CPU-IWD synchronization, 0x2=PFC checksum, 0x3=MCor checksum, 0x4=other checksum, 0xFF=undefined, 0x5 - 0xFE=see documentation)." UBYTE X1_S1 1 100 0 255 ECU_ADDRESS 0xFFF9337C FORMAT "%5.1" MATRIX_DIM 2 1 1 /end MEASUREMENT
/begin MEASUREMENT WdUtl_stDbgFlgStats "F6200: Statistic debug flag vector" UBYTE X1_S1 1 100 0 255 ECU_ADDRESS 0xFFF936F9 FORMAT "%5.1" /end MEASUREMENT
/begin MEASUREMENT WdUtl_stFault "F6200: The fault bit vector (only shows the currently occurred faults)" UWORD X1_S1 1 100 0 65535 ECU_ADDRESS 0xFFF94890 FORMAT "%8.2" /end MEASUREMENT
/begin MEASUREMENT WdUtl_stTst "F6200: The test condition bit vector for the faults (only shows the currently condition)" UWORD X1_S1 1 100 0 65535 ECU_ADDRESS 0xFFF9337E FORMAT "%8.2" /end MEASUREMENT
/begin MEASUREMENT ZF_APP1_CAN_Flag "F9175: semaphor flag for 1.ZF-Applikations message" UBYTE X1_M 1 100 0 255 ECU_ADDRESS 0xFFF9397E FORMAT "%5.1" /end MEASUREMENT
/begin MEASUREMENT ZF_APP2_CAN_Flag "F9175: semaphor flag for 2.ZF-Applikations message" UBYTE X1_M 1 100 0 255 ECU_ADDRESS 0xFFF9397F FORMAT "%5.1" /end MEASUREMENT
/begin MEASUREMENT ZF_APP3_CAN_Flag "F9175: semaphor flag for 3.ZF-Applikations message" UBYTE X1_M 1 100 0 255 ECU_ADDRESS 0xFFF93980 FORMAT "%5.1" /end MEASUREMENT
/begin MEASUREMENT ZF_APP4_CAN_Flag "F9175: semaphor flag for 4.ZF-Applikations message" UBYTE X1_M 1 100 0 255 ECU_ADDRESS 0xFFF93981 FORMAT "%5.1" /end MEASUREMENT
/begin MEASUREMENT ZF_APP5_CAN_Flag "F9175: semaphor flag for 5.ZF-Applikations message" UBYTE X1_M 1 100 0 255 ECU_ADDRESS 0xFFF93982 FORMAT "%5.1" /end MEASUREMENT
/begin MEASUREMENT ZF_APP6_CAN_Flag "F9175: semaphor flag for 6.ZF-Applikations message" UBYTE X1_M 1 100 0 255 ECU_ADDRESS 0xFFF93983 FORMAT "%5.1" /end MEASUREMENT
/begin MEASUREMENT ZF_APP7_CAN_Flag "F9175: semaphor flag for 7.ZF-Applikations message" UBYTE X1_M 1 100 0 255 ECU_ADDRESS 0xFFF93984 FORMAT "%5.1" /end MEASUREMENT
/begin MEASUREMENT ZF_APP8_CAN_Flag "F9175: semaphor flag for 8.ZF-Applikations message" UBYTE X1_M 1 100 0 255 ECU_ADDRESS 0xFFF93985 FORMAT "%5.1" /end MEASUREMENT
/begin MEASUREMENT ZF_APP9_CAN_Flag "F9175: semaphor flag for 9.ZF-Applikations message" UBYTE X1_M 1 100 0 255 ECU_ADDRESS 0xFFF93986 FORMAT "%5.1" /end MEASUREMENT
/begin MEASUREMENT ZF_APP_AZG_Selection "F9175: selected CAN line for AZG (0: not selected yet, 1: FA-CAN, 2: A-CAN)" UBYTE X1_M 1 100 0 255 ECU_ADDRESS 0xFFF80D1C FORMAT "%5.1" /end MEASUREMENT
/begin MEASUREMENT ZF_SERVICE_CAN_Flag "F9175: semaphor flag for ZF-SERVICE-Applikations message" UBYTE X1_M 1 100 0 255 ECU_ADDRESS 0xFFF93987 FORMAT "%5.1" /end MEASUREMENT
/begin MEASUREMENT can_flags "F2671: CAN driver internal flags (B0:node disabled, B3:ACK-error, B4:Bus-disconnect-detect) (internal only)" UBYTE X1_M 1 100 0 255 ECU_ADDRESS 0xFFF94131 FORMAT "%5.1" MATRIX_DIM 3 1 1 /end MEASUREMENT
/begin MEASUREMENT can_msgbuffers_enabled "F2671: bitmask of CAN message buffers enabled (0=disabled, 1=enabled) (internal)" ULONG X1_M 1 100 0 4294967295 ECU_ADDRESS 0xFFF93F80 FORMAT "%13.2" MATRIX_DIM 3 1 1 /end MEASUREMENT
/begin MEASUREMENT can_msgbuffers_extid "F2671: CAN bitmask extended ID (0=STD, 1=EXT)" ULONG X1_M 1 100 0 4294967295 ECU_ADDRESS 0xFFF93F98 FORMAT "%13.2" MATRIX_DIM 3 1 1 /end MEASUREMENT
/begin MEASUREMENT can_msgbuffers_rxtx "F2671: CAN bitmask RX/TX direction (0=RX, 1=TX)" ULONG X1_M 1 100 0 4294967295 ECU_ADDRESS 0xFFF93F8C FORMAT "%13.2" MATRIX_DIM 3 1 1 /end MEASUREMENT
/begin MEASUREMENT can_msginterrupts "F2671: CAN Buffer interrupt enabled bitmask (0=disabled, 1=enabled)" ULONG X1_M 1 100 0 4294967295 ECU_ADDRESS 0xFFF93FA4 FORMAT "%13.2" MATRIX_DIM 3 1 1 /end MEASUREMENT
/begin MEASUREMENT can_node_operationmode "F2671: CAN node operation mode (0=HALT, 2=LISTEN, 3=NORMAL)" UBYTE X1_M 1 100 0 255 ECU_ADDRESS 0xFFF94134 FORMAT "%5.1" MATRIX_DIM 3 1 1 /end MEASUREMENT
/begin MEASUREMENT can_nodeinterruptmask "F2671: CAN node interrupt mask (low-active!) (corresponds to IMR register)" UWORD X1_M 1 100 0 65535 ECU_ADDRESS 0xFFF94122 FORMAT "%8.2" MATRIX_DIM 3 1 1 /end MEASUREMENT
/begin MEASUREMENT can_nodestate_cur "F2671: current CAN node state (0=HALT, 2=LISTEN, 3=NORMAL, +16=NOTX  +128=transition)" UBYTE X1_M 1 100 0 255 ECU_ADDRESS 0xFFF94137 FORMAT "%5.1" MATRIX_DIM 3 1 1 /end MEASUREMENT
/begin MEASUREMENT can_nodestate_req "F2671: requested CAN node state (0=HALT, 2=LISTEN, 3=NORMAL)" UBYTE X1_M 1 100 0 255 ECU_ADDRESS 0xFFF9413A FORMAT "%5.1" MATRIX_DIM 3 1 1 /end MEASUREMENT
/begin MEASUREMENT gmoRstFaultTypCus "F9155: Customer specific fault type" UBYTE X1_S1 1 100 0 255 ECU_ADDRESS 0xFFF80D20 FORMAT "%5.1" /end MEASUREMENT
/begin MEASUREMENT gmoRstFaultTypCusStrd "F9155: Stored customer specific fault type" UBYTE X1_S1 1 100 0 255 ECU_ADDRESS 0xFFF93AB3 FORMAT "%5.1" /end MEASUREMENT
/begin MEASUREMENT gmoRstSpecTstCondSupStrd "F9155: Stored specific test condition" UBYTE X1_S1 1 100 0 255 ECU_ADDRESS 0xFFF93AB4 FORMAT "%5.1" /end MEASUREMENT
/begin FUNCTION F2531_OutPCc08Tolc "F2531: Current tolerance calculation"
 /begin DEF_CHARACTERISTIC OutPCc08Tolc_facCc08GradLimHi_C OutPCc08Tolc_facCc08GradLimLo_C OutPCc08Tolc_iCc08CrntGen_C OutPCc08Tolc_iCc08DthAmpOn_C OutPCc08Tolc_iCc08GradAbsHi_C OutPCc08Tolc_iCc08GradAbsLo_C OutPCc08Tolc_iCc08GradLimMax_C OutPCc08Tolc_iCc08Noi_C OutPCc08Tolc_iCc08RngLim_C OutPCc08Tolc_iCc08TempIncor_C OutPCc08Tolc_iCc08TolcRngHi_C OutPCc08Tolc_iCc08TolcRngLo_C OutPCc08Tolc_stCc08GradRng_C OutPCc08Tolc_stCc08TolcRng_C OutPCc08Tolc_tiCc08DthAmpOn_C OutPCc08Tolc_tiCc08DthChng_C OutPCc08Tolc_tiCc08GradHi_C OutPCc08Tolc_tiCc08GradLo_C OutPCc08Tolc_tiCc08Noi_C /end DEF_CHARACTERISTIC
 /begin OUT_MEASUREMENT OutPCc08Tolc_iCc08Grad OutPCc08Tolc_iCc08GradDmy OutPCc08Tolc_iCc08TolcLimHi OutPCc08Tolc_iCc08TolcLimLo OutPCc08Tolc_tiCc08DthAmpOn OutPCc08Tolc_tiCc08DthChng OutPCc08Tolc_tiCc08GradHi OutPCc08Tolc_tiCc08GradLo OutPCc08Tolc_tiCc08Noi /end OUT_MEASUREMENT
/end FUNCTION
/begin FUNCTION F2545_OutPPclkCtl "F2545: Main Pclk class. It is the entrance point from the interfaces"
 /begin OUT_MEASUREMENT OutPPclkCtl_stPclk OutPPclkCtl_stPclkCtl OutPPclkCtl_stPclkOpsOn OutPPclkCtl_stPclkTst /end OUT_MEASUREMENT
/end FUNCTION
/begin FUNCTION F2545_OutPPclkMon "F2545: This is the monitoring functionality of the Pclk" /begin OUT_MEASUREMENT OutPPclkMon_stPclkFault OutPPclkMon_stPclkTstCond /end OUT_MEASUREMENT /end FUNCTION
/begin FUNCTION F2550_OutPStlkIn "F2550: This class provides the possibility to get the position of the transmission selector lever."
 /begin DEF_CHARACTERISTIC OutPStlkIn_stStlkSelSply_C OutPStlkIn_tiStlkOff_C OutPStlkIn_tiStlkOn_C OutPStlkIn_uStlkStrtJmp_C /end DEF_CHARACTERISTIC
 /begin OUT_MEASUREMENT OutPStlkIn_stStlkChpLine OutPStlkIn_stStlkPlrInfo OutPStlkIn_tiStlkOff OutPStlkIn_tiStlkOn OutPStlkIn_uStlkStrtRly /end OUT_MEASUREMENT
/end FUNCTION
/begin FUNCTION F2550_OutPStlkMon "F2550: This is the monitoring functionality of the Stlk"
 /begin DEF_CHARACTERISTIC OutPStlkMon_stStlkSelSwt_C OutPStlkMon_stStlkTstCond_C OutPStlkMon_uStlkTstLo_C OutPStlkMon_uStlkTstSB_C OutPStlkMon_uStlkTstSG_C /end DEF_CHARACTERISTIC
 /begin OUT_MEASUREMENT OutPStlkMon_stStlkFault OutPStlkMon_stStlkTstCond /end OUT_MEASUREMENT
/end FUNCTION
/begin FUNCTION F2550_OutPStlkOut "F2550: Control functionality to calculate the starter lock signal"
 /begin DEF_CHARACTERISTIC OutPStlkOut_bStlkCtl_C OutPStlkOut_tiStlkCtl_C OutPStlkOut_tiStlkHwAck_C /end DEF_CHARACTERISTIC
 /begin OUT_MEASUREMENT OutPStlkOut_bStlkOut OutPStlkOut_bStlkSpiOff OutPStlkOut_stStlk OutPStlkOut_tiStlkCtl OutPStlkOut_tiStlkHwAck /end OUT_MEASUREMENT
/end FUNCTION
/begin FUNCTION F2635_CPUID_M "F2635: CPU Identification" /begin OUT_MEASUREMENT CPUID_stChip CPUID_stSize CPU_bPbusClk CPU_numSel /end OUT_MEASUREMENT /end FUNCTION
/begin FUNCTION F2641_SPIHA "F2641: SPI handler status variable" /begin OUT_MEASUREMENT SpiHa_ctErrUnit /end OUT_MEASUREMENT /end FUNCTION
/begin FUNCTION F2655_CPU_CHKCFG_M "F2655: CPU Configuration Verification" /begin OUT_MEASUREMENT Cpu_stChkCfgReg /end OUT_MEASUREMENT /end FUNCTION
/begin FUNCTION F2671_CANDRV "F2671: CAN Driver measurement variables"
 /begin OUT_MEASUREMENT can_flags can_msgbuffers_enabled can_msgbuffers_extid can_msgbuffers_rxtx can_msginterrupts can_node_operationmode can_nodeinterruptmask can_nodestate_cur can_nodestate_req /end OUT_MEASUREMENT
/end FUNCTION
/begin FUNCTION F2675_CAN_M "F2675: CAN Handler measurement variables"
 /begin OUT_MEASUREMENT Can_MsgBuffer_u8 Can_MsgInBuffer_u16 Can_MsgStatus_u8 Can_NodeBaudrate_u32 Can_NodeStatus_u16 /end OUT_MEASUREMENT
/end FUNCTION
/begin FUNCTION F2741_EELLD_M "F2741: EELLD measurement variables"
 /begin OUT_MEASUREMENT EELLD_Status_s.adOp_u32 EELLD_Status_s.ctErr_u16 EELLD_Status_s.numOffs_u16 EELLD_Status_s.numSec_u8 EELLD_Status_s.numSize_u8 EELLD_Status_s.reserved EELLD_Status_s.stMode_u8 EELLD_Status_s.stOp_u8 EELLD_Status_s.stReq_u8 EELLD_Status_s.stSuspReq_u8 /end OUT_MEASUREMENT
/end FUNCTION
/begin FUNCTION F2742_FCU_M "F2742: FCU measurement variables"
 /begin OUT_MEASUREMENT FCU_numFirmware FCU_s.ctCpy FCU_s.ctOff FCU_s.reserved FCU_s.stErrDetail FCU_s.stInit FCU_s.stReq FCU_s.state /end OUT_MEASUREMENT
/end FUNCTION
/begin FUNCTION F2755_ECC_M "F2755: ECC-ROM/RAM handling (measurement only)"
 /begin OUT_MEASUREMENT ECC_RAM_adEccErr ECC_RAM_numEccErr ECC_RAM_stEccTst ECC_ROM_stEccTst /end OUT_MEASUREMENT
/end FUNCTION
/begin FUNCTION F2861_OutMDth "F2861: Dither Control and related Matching Functions"
 /begin DEF_CHARACTERISTIC OutMDth_facAtfFlt_C OutMDth_iDthAmpChngThres_C OutMDth_iDthAmpGrad_C OutMDth_iDthAmpLimSply_C OutMDth_iDthAmpOnThres_C OutMDth_iDthAmp_C[0] OutMDth_iDthAmp_C[1] OutMDth_iDthAmp_C[2] OutMDth_iDthAmp_C[3] OutMDth_iDthAmp_C[4] OutMDth_iDthAmp_C[5] OutMDth_iDthAmp_C[6] OutMDth_iDthAmp_C[7] OutMDth_iDthAmp_C[8] OutMDth_iDthAmp_C[9] OutMDth_iInGradMax_C OutMDth_stDthAmpLimAvl_C OutMDth_tPerTempHi_C OutMDth_tPerTempLo_C OutMDth_tiMinSwtOff_C OutMDth_tiPerTempHi_C OutMDth_tiPerTempLo_C /end DEF_CHARACTERISTIC
 /begin OUT_MEASUREMENT OutMDth_bDthEnblReq OutMDth_bPerChngPrvnt OutMDth_iDthAmp OutMDth_iDthAmpLimSply OutMDth_iDthAmpReq OutMDth_iInDmy OutMDth_stDthAmpChng OutMDth_stDthAmpOn OutMDth_stDthPerChng OutMDth_tAtfFlt OutMDth_tiDthPer OutMDth_tiMinSwtOff OutMDth_uSplyDmy /end OUT_MEASUREMENT
/end FUNCTION
/begin FUNCTION F2862_OutMEe "F2862: Read the adjustment current value from EEPROM" /begin OUT_MEASUREMENT OutMEe_iCc08Comp OutMEe_stCc08Avl /end OUT_MEASUREMENT /end FUNCTION
/begin FUNCTION F2863_OutMRstn "F2863: Resistance calculation for current control"
 /begin DEF_CHARACTERISTIC OutMRstn_facActrWuFlt1_C OutMRstn_facActrWuFlt2_C OutMRstn_facActrWuFlt_C OutMRstn_facAtfFlt_C OutMRstn_iActrWuRef_C OutMRstn_resActr20_C OutMRstn_resRmn_C OutMRstn_resSht_C[0] OutMRstn_resSht_C[1] OutMRstn_resSht_C[2] OutMRstn_resSht_C[3] OutMRstn_resSht_C[4] OutMRstn_resSht_C[5] OutMRstn_resSht_C[6] OutMRstn_resSht_C[7] OutMRstn_resSht_C[8] OutMRstn_resSht_C[9] OutMRstn_tActrWu_C[0] OutMRstn_tActrWu_C[1] OutMRstn_tActrWu_C[2] OutMRstn_tActrWu_C[3] OutMRstn_tActrWu_C[4] OutMRstn_tActrWu_C[5] OutMRstn_tActrWu_C[6] OutMRstn_tActrWu_C[7] OutMRstn_tActrWu_C[8] OutMRstn_tActrWu_C[9] /end DEF_CHARACTERISTIC
 /begin OUT_MEASUREMENT OutMRstn_resActrMod OutMRstn_tActrWuFlt OutMRstn_tActrWuFlt1 OutMRstn_tActrWuFlt2 OutMRstn_tAtfFlt OutMRstn_tAtfRef OutMRstn_tChpRef OutMRstn_tiCalcRate /end OUT_MEASUREMENT
/end FUNCTION
/begin FUNCTION F2864_OutMCrntFdbk "F2864: Calculation of measured current"
 /begin DEF_CHARACTERISTIC OutMCrntFdbk_facCor_C[0] OutMCrntFdbk_facCor_C[1] OutMCrntFdbk_facCor_C[2] OutMCrntFdbk_facCor_C[3] OutMCrntFdbk_facCor_C[4] OutMCrntFdbk_facCor_C[5] OutMCrntFdbk_facCor_C[6] OutMCrntFdbk_facCor_C[7] OutMCrntFdbk_facCor_C[8] OutMCrntFdbk_facCor_C[9] OutMCrntFdbk_uDio_C[0] OutMCrntFdbk_uDio_C[1] OutMCrntFdbk_uDio_C[2] OutMCrntFdbk_uDio_C[3] OutMCrntFdbk_uDio_C[4] OutMCrntFdbk_uDio_C[5] OutMCrntFdbk_uDio_C[6] OutMCrntFdbk_uDio_C[7] OutMCrntFdbk_uDio_C[8] OutMCrntFdbk_uDio_C[9] /end DEF_CHARACTERISTIC
 /begin IN_MEASUREMENT OutMRstn_resActrMod OutMRstn_tAtfRef OutMRstn_tChpRef /end IN_MEASUREMENT
 /begin OUT_MEASUREMENT OutMCrntFdbk_iCalc /end OUT_MEASUREMENT
/end FUNCTION
/begin FUNCTION F3010_GMOHOT "F3010 : Configuration of hot shutdown"
 /begin DEF_CHARACTERISTIC GmoHot_qtChp1Min_C GmoHot_qtChp2Min_C GmoHot_tBattDepSdnTempINI_C GmoHot_tBattDepSdnTemp_C GmoHot_tChp1SensTolc_C GmoHot_tChp2SensTolc_C GmoHot_tM3DepSdnTemp_C GmoHot_tiGenDlyDSM_C GmoHot_tiGenDlyEE_C GmoHot_tiGenDlyHot_C GmoHot_tiGenDlyInit_C GmoHot_uUpLimHotCond_C /end DEF_CHARACTERISTIC
 /begin OUT_MEASUREMENT GmoHot_qtAct GmoHot_stFault GmoHot_stHot GmoHot_stHotExt GmoHot_stTstCond GmoHot_tAct GmoHot_tLim GmoHot_tiAtfDly GmoHot_tiGenDly GmoHot_uBatt GmoHot_uM3 GmoHot_xReqSwtOffPs /end OUT_MEASUREMENT
/end FUNCTION
/begin FUNCTION F3040_Gmo_Rst "F3040: Reset Monitoring" /begin OUT_MEASUREMENT Gmo_Rst_st Gmo_Rst_stFaultSup Gmo_Rst_stTstCondSup /end OUT_MEASUREMENT /end FUNCTION
/begin FUNCTION F3500_DSMERRLOG "F3500: Error logger " /begin DEF_CHARACTERISTIC DSM_ERR_bClrIni /end DEF_CHARACTERISTIC
 /begin OUT_MEASUREMENT DSM_ERR_ctEntry DSM_ERR_ctErr DSM_ERR_numFctId DSM_ERR_stErr /end OUT_MEASUREMENT
/end FUNCTION
/begin FUNCTION F4100_I14229_APPL "F4100: Calibration data for UDS" /begin DEF_CHARACTERISTIC COM_swtICFshPrg_C /end DEF_CHARACTERISTIC /begin OUT_MEASUREMENT I14229_stOrigInit I14229_xInitDne /end OUT_MEASUREMENT /end FUNCTION
/begin FUNCTION F4205_I15031APPL "F4205: OBD-configuration" /begin DEF_CHARACTERISTIC I15031APPL_TimeoutLimit /end DEF_CHARACTERISTIC /end FUNCTION
/begin FUNCTION F4410_TPRTData "F4410: Test Protocol Data Structures" /begin DEF_CHARACTERISTIC TPRT_tiComTOutStrt /end DEF_CHARACTERISTIC
 /begin OUT_MEASUREMENT TPRT_bTOutCtlActv TPRT_sCanMsgNew TPRT_sOuCtrl TPRT_sScyLvl TPRT_tiComTOut TPRT_xCanMsgBufIn TPRT_xCanMsgBufOut TPRT_xMemDpBuf TPRT_xSigValOff TPRT_xSigValOn TPRT_xSrv_Seed /end OUT_MEASUREMENT
/end FUNCTION
/begin FUNCTION F4450_CAN_NM "F2050: CAN interface" /begin OUT_MEASUREMENT IO_ctmsgNM_ACAN IO_ctmsgNM_FACAN /end OUT_MEASUREMENT /end FUNCTION
/begin FUNCTION F4450_Nm "F4450: Nm"
 /begin LOC_MEASUREMENT Nm_var_s[0].nmNodeIdListStatus_b Nm_var_s[0].nmRemoteSleepInd_b Nm_var_s[0].numSizeOfNodeIdList_u8 Nm_var_s[0].stNmFlags_b32 Nm_var_s[0].stNmState_e Nm_var_s[0].tiNmNodeDetectionLockTime_u32 Nm_var_s[0].tiNmRepeatMessageTime_u32 Nm_var_s[0].tiNmTimeoutTime_u32 Nm_var_s[0].tiNmWaitBusSleepTime_u32 Nm_var_s[0].tiRemoteSleepIndTime_u32 /end LOC_MEASUREMENT
/end FUNCTION
/begin FUNCTION F4451_CanNm "F4451: CanNm"
 /begin LOC_MEASUREMENT CanNm_var_s[0].dRxUserData_u8 CanNm_var_s[0].dSendBuffer_s CanNm_var_s[0].numNodeIdOfLastMsg CanNm_var_s[0].stCanNmFlags_b32 CanNm_var_s[0].tiMsgCycleTime_Offset_u32 CanNm_var_s[0].tiMsg_Cycle_Time_u32 CanNm_var_s[0].tiMsg_Timeout_Time_u32 /end LOC_MEASUREMENT
/end FUNCTION
/begin FUNCTION F4451_CanNmAppl "F4451: CanNmAppl"
 /begin LOC_MEASUREMENT CanNmAppl_var_s[0].msgCnt_RxIndication_u16 CanNmAppl_var_s[0].msgCnt_TxConfirmation_u16 CanNmAppl_var_s[0].stBcTxA CanNmAppl_var_s[1].msgCnt_RxIndication_u16 CanNmAppl_var_s[1].msgCnt_TxConfirmation_u16 CanNmAppl_var_s[1].stBcTxA /end LOC_MEASUREMENT
/end FUNCTION
/begin FUNCTION F4480_COMCTL "F4480: Communication Control" /begin DEF_CHARACTERISTIC ComCtl_swtLoLimUsd_C ComCtl_uLoLim_C /end DEF_CHARACTERISTIC
 /begin OUT_MEASUREMENT ComCtl_stIfcTxCom ComCtl_stLstRun ComCtl_stRxTxCom ComCtl_stRxTxNm ComCtl_stRxTxUsd /end OUT_MEASUREMENT
/end FUNCTION
/begin FUNCTION F6000_SAF "F6000: SAF General"
 /begin OUT_MEASUREMENT Saf_stFaultInfo_A Saf_stFaultInfo_B Saf_stFaultInfo_C Saf_stFaultInfo_D /end OUT_MEASUREMENT
/end FUNCTION
/begin FUNCTION F6010_MCOR "F6010: Core monitoring" /begin DEF_CHARACTERISTIC MCor_swtFaultEntryReq_C /end DEF_CHARACTERISTIC
 /begin OUT_MEASUREMENT MCor_ctCorTst MCor_stIntMCorFault MCor_stMCorFault MCor_xWdPartResp /end OUT_MEASUREMENT
/end FUNCTION
/begin FUNCTION F6020_MCOR_ADC "F6020: ADC Core Monitor"
 /begin DEF_CHARACTERISTIC MCorAdc_ctErrDb_C MCorAdc_uDiagDiffMax_C MCorAdc_uM3Min_C MCorAdc_uVasicMax_C MCorAdc_uVasicMin_C MCorAdc_uVdd3DiffMax_C MCorAdc_uVdd3Max_C MCorAdc_uVdd3Min_C /end DEF_CHARACTERISTIC
 /begin OUT_MEASUREMENT MCorAdc_ctErr MCorAdc_efADCTst MCorAdc_stAdcFault /end OUT_MEASUREMENT
/end FUNCTION
/begin FUNCTION F6030_MCOR_SPI "F6030: SPI Core Monitor" /begin DEF_CHARACTERISTIC MCorSpi_ctErrDb_C /end DEF_CHARACTERISTIC /begin OUT_MEASUREMENT MCorSpi_bErrFlg MCorSpi_ctErr /end OUT_MEASUREMENT /end FUNCTION
/begin FUNCTION F6040_MCOR_MMM "F6040: MMM Core Monitor" /begin DEF_CHARACTERISTIC MCorMmm_ctErrDbEcc_C MCorMmm_ctErrDbReg_C /end DEF_CHARACTERISTIC
 /begin OUT_MEASUREMENT MCorMmm_ctErrEcc MCorMmm_ctErrReg MCorMmm_stEccFault MCorMmm_stRegFault /end OUT_MEASUREMENT
/end FUNCTION
/begin FUNCTION F6050_LVL2MON "F6050: Level 2 monitoring"
 /begin OUT_MEASUREMENT Lvl2Mon_idxFaultBuf Lvl2Mon_stLvl2Fault Lvl2Mon_xFaultBufLvl2Id_a Lvl2Mon_xFaultBufLvl2Info_a /end OUT_MEASUREMENT
/end FUNCTION
/begin FUNCTION F6060_SafRam "F6060: SAF RAM monitoring"
 /begin OUT_MEASUREMENT SafRam_Tst16 SafRam_Tst32 SafRam_Tst8 SafRam_adDbgCpl SafRam_adDbgOrig SafRam_datDbgCpl SafRam_datDbgOrig SafRam_idxDbg SafRam_xDbgInfo /end OUT_MEASUREMENT
/end FUNCTION
/begin FUNCTION F6100_PFCCtl "F6100: Controller of the Program Flow Control (variant b)" /begin OUT_MEASUREMENT PFCCtl_numMemArSizeUsd /end OUT_MEASUREMENT /end FUNCTION
/begin FUNCTION F6100_PFCMn "F6100: Monitoring of program flows (variant b)"
 /begin OUT_MEASUREMENT PFCMn_bVldInfoPerm_a PFCMn_bVldInfo_a PFCMn_ctMdul PFCMn_idxInfoNxt PFCMn_idxInfoNxtPerm PFCMn_numFlwIdInfoPerm_a PFCMn_numFlwIdInfo_a PFCMn_numId1InfoPerm_a PFCMn_numId1Info_a PFCMn_numId2InfoPerm_a PFCMn_numId2Info_a /end OUT_MEASUREMENT
/end FUNCTION
/begin FUNCTION F6200_WdCtlStd "F6200: WD Communication Controller - Standard" /begin OUT_MEASUREMENT WdCtlStd_sComMode /end OUT_MEASUREMENT /end FUNCTION
/begin FUNCTION F6200_WdIpt "F6200: WD Communication Controller - IPT" /begin DEF_CHARACTERISTIC WdIpt_numTOutTolc_C /end DEF_CHARACTERISTIC /begin OUT_MEASUREMENT WdIpt_ctTOut WdIpt_sComMode WdIpt_sTgtLvlReq /end OUT_MEASUREMENT /end FUNCTION
/begin FUNCTION F6200_WdMnExtd "F6200: WD Handling Mode Controller - Extended"
 /begin DEF_CHARACTERISTIC WdMnExtd_numTskExe_C WdMnExtd_stWdStatsClr_C WdMnExtd_tiTskMonT_C /end DEF_CHARACTERISTIC
 /begin OUT_MEASUREMENT WdMnExtd_bFrstT WdMnExtd_ctTskExe WdMnExtd_sRunMode WdMnExtd_stFaultBuf WdMnExtd_stTstBuf WdMnExtd_tiTskMonDiffT WdMnExtd_tiTskMonRefT /end OUT_MEASUREMENT
/end FUNCTION
/begin FUNCTION F6200_WdResp "F6200: WD Response Calculator (fix process activation interval)"
 /begin OUT_MEASUREMENT WdResp_adMdulMonFault_ps WdResp_ctCyclCnt WdResp_ctCyclCntRmn WdResp_ctMdulMonCnt WdResp_numCyclCntUpd WdResp_xKey WdResp_xListKey /end OUT_MEASUREMENT
/end FUNCTION
/begin FUNCTION F6200_WdSrv "F6200: IWD communication service (extended functionality)"
 /begin OUT_MEASUREMENT WdSrv_ctIdl WdSrv_ctNoDatErrCnt WdSrv_ctSPIErrCnt WdSrv_ctSyncErrCnt WdSrv_ctSyncErrCntStats WdSrv_ctWdErrCnt WdSrv_ctWdErrCntMax WdSrv_ctWdErrCntRef WdSrv_sRespMdfyMode WdSrv_sSrvSt WdSrv_sSyncSt WdSrv_stWdStRef WdSrv_tiConst WdSrv_tiSyncTCurr WdSrv_tiTmr WdSrv_tiWdRespT WdSrv_tiWdRespTReq WdSrv_tiWdRespTReqQue WdSrv_xWdReq WdSrv_xWdResp /end OUT_MEASUREMENT
/end FUNCTION
/begin FUNCTION F6200_WdUtl "F6200: Utilities and helper functions"
 /begin OUT_MEASUREMENT WdUtl_sLstECURstSrc_a WdUtl_stDbgFlgStats WdUtl_stFault WdUtl_stTst /end OUT_MEASUREMENT
/end FUNCTION
/begin FUNCTION F6250_SFRM "F6250: SFRM configuration"
 /begin DEF_CHARACTERISTIC SFRM_CC08_bTolSprdcFault_C SFRM_GMO_bTolSprdcFault_C SFRM_LSS_bTolSprdcFault_C SFRM_PSPLY_bTolSprdcFault_C SFRM_SAF_bTolSprdcFault_C SFRM_swtSrv_C SFRM_tiFailLtcyTCC08_C SFRM_tiFailLtcyTDFE_C SFRM_tiFailLtcyTGMO_C SFRM_tiFailLtcyTLSS_C SFRM_tiFailLtcyTPSPLY_C SFRM_tiFailLtcyTSAF_C /end DEF_CHARACTERISTIC
 /begin OUT_MEASUREMENT SFRM_stInfoCC08_a SFRM_stInfoGMO_a SFRM_stInfoLSS_a SFRM_stInfoPSPLY_a SFRM_stInfoSAF_a SFRM_tiDwnTmrCC08_a SFRM_tiDwnTmrGMO_a SFRM_tiDwnTmrLSS_a SFRM_tiDwnTmrPSPLY_a SFRM_tiDwnTmrSAF_a SFRM_tiUpTmrCC08_a SFRM_tiUpTmrGMO_a SFRM_tiUpTmrLSS_a SFRM_tiUpTmrPSPLY_a SFRM_tiUpTmrSAF_a Sfrm_bErrHndlr Sfrm_idFaultSrcChn Sfrm_idFaultSrcUsr Sfrm_xReqSwtOffPs Sfrm_xReqSwtOffPsInt /end OUT_MEASUREMENT
/end FUNCTION
/begin FUNCTION F6260_RLIM "F6260: Reset Limitation"
 /begin DEF_CHARACTERISTIC RLim_numLimThres_C RLim_swtClrMode_C RLim_swtClrShOffEnbl_C RLim_swtLimFeatDisbl_C /end DEF_CHARACTERISTIC
 /begin OUT_MEASUREMENT RLim_cntRstCnt /end OUT_MEASUREMENT
/end FUNCTION
/begin FUNCTION F9110_ShrCal "F9110: Application values for ZF SW calibration sharing inteface" /begin DEF_CHARACTERISTIC ShrCal_ActvIC2OnFcc_C ShrCal_SlctSeramMth_C /end DEF_CHARACTERISTIC /end FUNCTION
/begin FUNCTION F9110_SHRDSM "F9110: Interface for customer DSM" /begin DEF_CHARACTERISTIC ShrSrv_bDsmRdyByp_C /end DEF_CHARACTERISTIC /begin OUT_MEASUREMENT ShrSrv_bDsmRdy ShrSrv_bDsmRdyCus /end OUT_MEASUREMENT /end FUNCTION
/begin FUNCTION F9110_SHRINTERN "F9110: Internal Signals SW sharing" /begin OUT_MEASUREMENT SrvShr_RND32_EWS4 /end OUT_MEASUREMENT /end FUNCTION
/begin FUNCTION F9110_SHRPFC "F9110: Software sharing interface for main function PFC"
 /begin OUT_MEASUREMENT SrvShr_ctPFCCfg_a SrvShr_numMemArSizeUsd_a SrvShr_numMemArSize_a SrvShr_numPFCCfgMax_a /end OUT_MEASUREMENT
/end FUNCTION
/begin FUNCTION F9110_SHRROM "F9110: Rom Checksum Test Function" /begin OUT_MEASUREMENT SrvShr_stRomFault /end OUT_MEASUREMENT /end FUNCTION
/begin FUNCTION F9110_SHRSAF "F9110: Software sharing interface for subsystem SAF"
 /begin OUT_MEASUREMENT ShrSaf_stFaultInfo_A ShrSaf_stFaultInfo_B SrvShr_stFaultMCCOMP SrvShr_stFaultSFRM SrvShr_stTstMCCOMP SrvShr_stTstSFRM /end OUT_MEASUREMENT
/end FUNCTION
/begin FUNCTION F9110_SHRTIME "F9110: Timing Handling within SW sharing"
 /begin OUT_MEASUREMENT SrvShr_BETRSTD SrvShr_BETRSTD_INCL_STDBY SrvShr_tiOpCruTemp SrvShr_tiOpTemp /end OUT_MEASUREMENT
/end FUNCTION
/begin FUNCTION F9120_INPPEXT "F9120: Temperature Measurement SW sharing" /begin DEF_CHARACTERISTIC SrvShr_tSubsChpOfs_C /end DEF_CHARACTERISTIC /end FUNCTION
/begin FUNCTION F9120_SHRBMW "F9120: BMW specific misc. functions"
 /begin DEF_CHARACTERISTIC SrvShr_TSysErrorTimeOut_C SrvShr_TSysMsgTimeOut_C SrvShr_TSysTimeInc_C /end DEF_CHARACTERISTIC
 /begin OUT_MEASUREMENT SrvShr_SysTimeInc_Counter SrvShr_SysTimeOut_Counter SrvShr_SysTime_BusOff SrvShr_SysTime_CANSig SrvShr_SysTime_CanSigRec SrvShr_SysTime_NextState SrvShr_SysTime_SigRec SrvShr_SysTime_SigValid SrvShr_SystemTime /end OUT_MEASUREMENT
/end FUNCTION
/begin FUNCTION F9120_SHRBYPINP "F9120: Input 2 Wire Interface as Bypass"
 /begin DEF_CHARACTERISTIC SrvShr_facTipInfoHigh_C SrvShr_facTipInfoMul_C SrvShr_tiTipInfoHigh_C SrvShr_tiTipInfoMeas_C /end DEF_CHARACTERISTIC
 /begin OUT_MEASUREMENT SrvShr_TIPINFO_HIGHIMPULS_MAX SrvShr_TIPINFO_HIGHIMPULS_MIN SrvShr_TIPINFO_LOWIMPULS_MAX SrvShr_TIPINFO_LOWIMPULS_MIN SrvShr_TIPINFO_MULTIPLICATOR SrvShr_stTipInfo SrvShr_tiTipInfoHigh SrvShr_tiTipInfoHighLast SrvShr_tiTipInfoLow SrvShr_tiTipInfoMeas /end OUT_MEASUREMENT
/end FUNCTION
/begin FUNCTION F9120_SHRINP "F9120: General Input Signals SW sharing"
 /begin DEF_CHARACTERISTIC SrvShr_rTrqMax_C SrvShr_rTrqMin_C SrvShr_rTrqOff_C SrvShr_swtTrqOn_C SrvShr_tiTrqPerMax_C SrvShr_tiTrqPerMin_C /end DEF_CHARACTERISTIC
 /begin OUT_MEASUREMENT SrvShr_CAN_ERROR_PIN SrvShr_CAN_WAKE_UP SrvShr_DC_TRQ SrvShr_DC_TRQ_ESTATUS SrvShr_U_KL15_PIN /end OUT_MEASUREMENT
/end FUNCTION
/begin FUNCTION F9120_SHRPSNS "F9120: Position Lines SW sharing"
 /begin OUT_MEASUREMENT SrvShr_LX SrvShr_LX_DI_RDY SrvShr_LX_ESTATUS SrvShr_LX_ESTATUS_KOMP SrvShr_LX_KOMP SrvShr_stPsns_Fault /end OUT_MEASUREMENT
/end FUNCTION
/begin FUNCTION F9120_SHRTAP "F9120: Input Signals available via Software Sharing Interface"
 /begin DEF_CHARACTERISTIC SrvShr_uIn0ThresHigh_C SrvShr_uIn0ThresLow_C SrvShr_uTapMinusThresHigh_C SrvShr_uTapMinusThresLow_C SrvShr_uTapPlusThresHigh_C SrvShr_uTapPlusThresLow_C /end DEF_CHARACTERISTIC
 /begin OUT_MEASUREMENT SrvShr_IN0 SrvShr_IN0_ESTATUS SrvShr_TIP_MINUS_PIN SrvShr_TIP_MINUS_PIN_ESTATUS SrvShr_TIP_PIN_DI_RDY SrvShr_TIP_PLUS_PIN SrvShr_TIP_PLUS_PIN_ESTATUS SrvShr_U_IN0 SrvShr_U_IN1 SrvShr_U_IN2 /end OUT_MEASUREMENT
/end FUNCTION
/begin FUNCTION F9120_SHRTAPA "F9120: Input Signals available via Software Sharing Interface" /begin REF_CHARACTERISTIC ECE_idxAdcOpt_C /end REF_CHARACTERISTIC
 /begin DEF_CHARACTERISTIC SrvShr_stTapAnaEval_C SrvShr_tiTapAnaRngStb_C SrvShr_uTapAnaEval_C /end DEF_CHARACTERISTIC
 /begin IN_MEASUREMENT ECE_uAdcA /end IN_MEASUREMENT
 /begin OUT_MEASUREMENT SrvShr_TIP_ANALOG_DI_RDY SrvShr_TIP_ANALOG_ESTATUS SrvShr_TIP_MINUS_ANALOG SrvShr_TIP_PLUS_ANALOG SrvShr_U_IN3 SrvShr_idxTapAnaRng SrvShr_idxTapAnaRngOld SrvShr_idxTapAnaRngUse SrvShr_tiTapAnaRngStb SrvShr_uTapAna /end OUT_MEASUREMENT
/end FUNCTION
/begin FUNCTION F9120_SHRTEMP "F9120: Temperature Measurement SW sharing"
 /begin OUT_MEASUREMENT SrvShr_CCHIP1_RAW SrvShr_CCHIP1_RAW_DI_RDY SrvShr_CCHIP1_RAW_ESTATUS SrvShr_CCHIP2_RAW SrvShr_CCHIP2_RAW_DI_RDY SrvShr_CCHIP2_RAW_ESTATUS SrvShr_CGT_RAW SrvShr_CGT_RAW_DI_RDY SrvShr_CGT_RAW_ESTATUS SrvShr_stAtf_Fault SrvShr_stChp1_Fault /end OUT_MEASUREMENT
/end FUNCTION
/begin FUNCTION F9120_SHRTIS "F9120: Transmission Input Speed SW sharing"
 /begin OUT_MEASUREMENT SrvShr_NT_DI_RDY SrvShr_NT_ESTATUS SrvShr_NT_PULSE_WIDTH SrvShr_NT_SUM_PULSES SrvShr_NT_SUM_PULSE_TIME SrvShr_stTis_Fault /end OUT_MEASUREMENT
/end FUNCTION
/begin FUNCTION F9120_SHRTOS "F9120: Transmission Output Speed SW sharing"
 /begin OUT_MEASUREMENT SrvShr_NAB_DI_RDY SrvShr_NAB_ESTATUS SrvShr_NAB_PULSE_WIDTH SrvShr_NAB_SUM_PULSES SrvShr_NAB_SUM_PULSE_TIME SrvShr_stTos_Fault /end OUT_MEASUREMENT
/end FUNCTION
/begin FUNCTION F9120_SHRVOLT "F9120: Voltage Measurement SW sharing" /begin DEF_CHARACTERISTIC SrvShr_tiSSplyExtChk_C /end DEF_CHARACTERISTIC
 /begin OUT_MEASUREMENT SrvShr_UBATT_FILT SrvShr_UDRMV1 SrvShr_UDRMV2 SrvShr_USENSOR SrvShr_USENSOR_DI_RDY SrvShr_USENSOR_ESTATUS SrvShr_USENSOR_ESTATUS_KOMP SrvShr_U_PN_RAW SrvShr_bSSplyExtFault SrvShr_bSSplyExtTest SrvShr_stSSplyExtFault SrvShr_stSSplyExtFaultOld SrvShr_stSSply_Fault SrvShr_stSSply_KFA SrvShr_stSSply_Test SrvShr_tiSSplyExtChk /end OUT_MEASUREMENT
/end FUNCTION
/begin FUNCTION F9120_SHRVSMBMW "F9120: BMW specific Vehicle State Manager"
 /begin OUT_MEASUREMENT SrvShr_ST_ILK_ERRM_FZM_CanSigRec SrvShr_VSMC_EvalCANFltStoreState SrvShr_VSMC_EvalCANFltStoreTimer SrvShr_VSMC_InhibitFltStore SrvShr_VSMC_StatusBusruhe /end OUT_MEASUREMENT
/end FUNCTION
/begin FUNCTION F9140_SHRBYPOUT "F9140: Output 2 Wire Interface as Bypass" /begin OUT_MEASUREMENT SrvShr_POSINFO_MULTIPLICATOR /end OUT_MEASUREMENT /end FUNCTION
/begin FUNCTION F9140_SHROUT "F9140: Output Signals available via Software Sharing Interface" /begin DEF_CHARACTERISTIC SWI_SET_PIN SrvShr_stSdnWakFilt_C /end DEF_CHARACTERISTIC
 /begin OUT_MEASUREMENT ShrOut_stFaultInfo_A ShrOut_stFaultInfo_B SrvShr_SENSORINIT_DONE SrvShr_SHUTDOWN SrvShr_START_INHIBITOR_STATUS SrvShr_WDOG_DI_RDY SrvShr_WDOG_ESTATUS SrvShr_bSSplyReq SrvShr_ctSdnFast SrvShr_stSdnWakFilt /end OUT_MEASUREMENT
/end FUNCTION
/begin FUNCTION F9140_SHRSOLVFS "F9140: Output Signals available via Software Sharing Interface"
 /begin DEF_CHARACTERISTIC SrvShr_FrFltCc08_C SrvShr_FrFltLss_C SrvShr_iSol1_C SrvShr_idxSol1_C SrvShr_swtBypOn_C SrvShr_swtFdbkAdcOut10_C SrvShr_tiFrFlt_C /end DEF_CHARACTERISTIC
 /begin OUT_MEASUREMENT SrvShr_DITHER_FREQ_LOCK SrvShr_FET_ACTIVE SrvShr_FET_ACTIVE_KOMP SrvShr_FrFltCc08 SrvShr_FrFltLss SrvShr_FrFltPSply SrvShr_OUT0_AKT SrvShr_OUT0_DI_RDY SrvShr_OUT0_ESTATUS SrvShr_OUT10_AKT SrvShr_OUT10_DI_OFF SrvShr_OUT10_DI_OFFCpl SrvShr_OUT10_DI_RDY SrvShr_OUT10_ESTATUS SrvShr_OUT11_AKT SrvShr_OUT11_DI_RDY SrvShr_OUT11_ESTATUS SrvShr_OUT12_AKT SrvShr_OUT12_DI_RDY SrvShr_OUT12_ESTATUS SrvShr_OUT13_AKT SrvShr_OUT13_DI_OFF SrvShr_OUT13_DI_OFFCpl SrvShr_OUT13_DI_RDY SrvShr_OUT13_ESTATUS SrvShr_OUT14_AKT SrvShr_OUT14_DI_RDY SrvShr_OUT14_ESTATUS SrvShr_OUT1_AKT SrvShr_OUT1_DI_RDY SrvShr_OUT1_ESTATUS SrvShr_OUT2_AKT SrvShr_OUT2_DI_RDY SrvShr_OUT2_ESTATUS SrvShr_OUT3_AKT SrvShr_OUT3_DI_RDY SrvShr_OUT3_ESTATUS SrvShr_OUT4_AKT SrvShr_OUT4_DI_RDY SrvShr_OUT4_ESTATUS SrvShr_OUT5_AKT SrvShr_OUT5_DI_RDY SrvShr_OUT5_ESTATUS SrvShr_OUT6_AKT SrvShr_OUT6_DI_RDY SrvShr_OUT6_ESTATUS SrvShr_OUT7_AKT SrvShr_OUT7_DI_RDY SrvShr_OUT7_ESTATUS SrvShr_OUT8_AKT SrvShr_OUT8_DI_RDY SrvShr_OUT8_ESTATUS SrvShr_OUT9_AKT SrvShr_OUT9_DI_RDY SrvShr_OUT9_ESTATUS SrvShr_OUT_DITHER_ACTIVE SrvShr_OUT_DITHER_AMP SrvShr_bPSplyDsmRd SrvShr_iOUT SrvShr_iOUT_KOMP SrvShr_stCc08_Fault SrvShr_stCc08_KFA SrvShr_stCc08_Test SrvShr_stLss_Fault SrvShr_stLss_KFA SrvShr_stLss_Test SrvShr_stPSply SrvShr_stPSply_Fault SrvShr_stPSply_KFA SrvShr_stPSply_Test SrvShr_tiFrFlt /end OUT_MEASUREMENT
/end FUNCTION
/begin FUNCTION F9150_SHRVAR "F9150: variant coding" /begin DEF_CHARACTERISTIC ShrVar_tiWaitErrHndlr_C ShrVar_tiWaitVIN_C /end DEF_CHARACTERISTIC
 /begin OUT_MEASUREMENT ShrVar_datCPS ShrVar_datCodApplFileId ShrVar_datVarCod_1 ShrVar_datVarCod_2 ShrVar_idWrDat ShrVar_stCodSesActv ShrVar_stComDly ShrVar_stInit ShrVar_stOrigInit ShrVar_stUpdEEP ShrVar_stWrSucCPS ShrVar_tiWaitErrHndlr ShrVar_tiWaitVIN ShrVar_xBcOrigInit ShrVar_xCanVIN ShrVar_xCanVINRxFlg ShrVar_xChsOrigInit ShrVar_xInitDne ShrVar_xVarCodChkDne /end OUT_MEASUREMENT
/end FUNCTION
/begin FUNCTION F9150_SHRVAR_EEPIFC "F9150: variant coding channel"
 /begin LOC_MEASUREMENT ShrVar_EEP_s.datCPS ShrVar_EEP_s.datCafId ShrVar_EEP_s.datVarCod_1 ShrVar_EEP_s.datVarCod_2 ShrVar_EEP_s.xChsCod ShrVar_EEP_s.xChsDat ShrVar_EEP_s.xStructId /end LOC_MEASUREMENT
/end FUNCTION
/begin FUNCTION F9151_SHRCANCTRQRPM "F9151: Customer specific CAN message check" /begin OUT_MEASUREMENT SrvShr_efErrCTrqRpm /end OUT_MEASUREMENT /end FUNCTION
/begin FUNCTION F9151_SHRCANDISP "F9151: Customer specific CAN message check" /begin OUT_MEASUREMENT SrvShrFA_efErrDisplay SrvShr_efErrDisplay /end OUT_MEASUREMENT /end FUNCTION
/begin FUNCTION F9151_SHRCANEWS "F9151: EWS4 message service on CAN"
 /begin OUT_MEASUREMENT CanA_EwsMsgRx CanA_stEwsRx CanFA_EwsMsgRx CanFA_stEwsRx Can_EwsMsgTx Can_stEwsTx SrvShr_CanEwsDataLength SrvShr_CanEwsRxBuff /end OUT_MEASUREMENT
/end FUNCTION
/begin FUNCTION F9151_SHRCANLIMPHOME "F9151: Customer specific CAN message check" /begin OUT_MEASUREMENT SrvShrFA_efErrLimpHome /end OUT_MEASUREMENT /end FUNCTION
/begin FUNCTION F9151_SHRCANPOSME "F9151: Customer specific CAN message check"
 /begin DEF_CHARACTERISTIC SrvShr_numErrNegMe_C SrvShr_numErrNoNegMe_C SrvShr_numErrNoPosMe_C SrvShr_numErrPosMe_C /end DEF_CHARACTERISTIC
 /begin OUT_MEASUREMENT SrvShr_efErrNegMe SrvShr_efErrPosMe SrvShr_numErrNegMe SrvShr_numErrNoNegMe SrvShr_numErrNoPosMe SrvShr_numErrPosMe /end OUT_MEASUREMENT
/end FUNCTION
/begin FUNCTION F9151_SHRCANRPM "F9151: Customer specific CAN message check" /begin OUT_MEASUREMENT SrvShr_efErrRPM /end OUT_MEASUREMENT /end FUNCTION
/begin FUNCTION F9151_SHRCANTARPM "F9151: Customer specific CAN message monitoring" /begin OUT_MEASUREMENT SrvShrFA_efErrTaRPM /end OUT_MEASUREMENT /end FUNCTION
/begin FUNCTION F9151_SHRCANTARPMEM "F9151: Customer specific CAN message check" /begin OUT_MEASUREMENT SrvShr_efErrTaRPMEM /end OUT_MEASUREMENT /end FUNCTION
/begin FUNCTION F9151_SHRCANTARPMIN "F9151: Customer specific CAN message check" /begin OUT_MEASUREMENT SrvShrFA_efErrTaRPMin SrvShr_efErrTaRPMin /end OUT_MEASUREMENT /end FUNCTION
/begin FUNCTION F9151_SHRCANTRLOSS "F9151: Customer specific CAN message check" /begin OUT_MEASUREMENT SrvShr_efErrTRLoss /end OUT_MEASUREMENT /end FUNCTION
/begin FUNCTION F9155_SHRGMORST "F9155: Reset monitoring interface within SW sharing"
 /begin OUT_MEASUREMENT GmoRst_stFaultCus GmoRst_st_UndrVltg ShrGmoRst_xReg_Par ShrGmoRst_xReg_Vec gmoRstFaultTypCus gmoRstFaultTypCusStrd gmoRstSpecTstCondSupStrd /end OUT_MEASUREMENT
/end FUNCTION
/begin FUNCTION F9156_SHRGMOHOT "F9156: Hot shut down monitoring interface within SW sharing"
 /begin OUT_MEASUREMENT ShrGmoHot_stChp2Chp1 ShrGmoHot_tChp1 ShrGmoHot_tChp2 ShrGmoHot_tHot /end OUT_MEASUREMENT
/end FUNCTION
/begin FUNCTION F9170_SHRCAN "F9170: CAN system interface"
 /begin OUT_MEASUREMENT SrvShr_CAN_ACTIVE SrvShr_CAN_BusComReq SrvShr_CAN_BusComReqS /end OUT_MEASUREMENT
/end FUNCTION
/begin FUNCTION F9170_SHRROS "F9170: Operating system interface" /begin OUT_MEASUREMENT SrvShr_BS_MODE /end OUT_MEASUREMENT /end FUNCTION
/begin FUNCTION F9175_CAN_SHR "F9175: CAN system interface" /begin DEF_CHARACTERISTIC CAN_tiPowerup_C /end DEF_CHARACTERISTIC
 /begin OUT_MEASUREMENT CAN_tiPowerup IO_ctmsgAPP3 IO_ctmsgAPP4 IO_ctmsgAPP8 IO_ctmsgService ZF_APP1_CAN_Flag ZF_APP2_CAN_Flag ZF_APP3_CAN_Flag ZF_APP4_CAN_Flag ZF_APP5_CAN_Flag ZF_APP6_CAN_Flag ZF_APP7_CAN_Flag ZF_APP8_CAN_Flag ZF_APP9_CAN_Flag ZF_APP_AZG_Selection ZF_SERVICE_CAN_Flag /end OUT_MEASUREMENT
/end FUNCTION
/begin FUNCTION F9200_GEH "F9200: General exception handler"
 /begin OUT_MEASUREMENT GEH_ctStrt GEH_sLstExcp GEH_sReg_Valid GEH_xRegBuf_Ind GEH_xRegBuf_PC GEH_xRegBuf_Par1 GEH_xRegBuf_SP GEH_xRegBuf_Vec GEH_xReg_FPSCR GEH_xReg_PC GEH_xReg_PR GEH_xReg_Par1 GEH_xReg_SP GEH_xReg_SR GEH_xReg_Stck GEH_xReg_Vec /end OUT_MEASUREMENT
/end FUNCTION
/begin FUNCTION F9260_ID_DEF "F9260: Systemhouse Identification"
 /begin OUT_MEASUREMENT COM_xBbRefId COM_xBcRefId COM_xPrgRefIdMeas COM_xPrgVersMeas COM_xSbRefId /end OUT_MEASUREMENT
/end FUNCTION
/begin FUNCTION F9260_IDLIBHW "F9260: Hardware Library Identification" /begin OUT_MEASUREMENT SrvUtl_idLibHw_Build SrvUtl_idLibHw_Name /end OUT_MEASUREMENT /end FUNCTION
/begin FUNCTION F9300_LFTCNT "F9300: TCU lifetime counter"
 /begin OUT_MEASUREMENT LftCnt_ti LftCnt_tiBuf LftCnt_ti_Hour LftCnt_ti_Min LftCnt_ti_Sec /end OUT_MEASUREMENT
/end FUNCTION
/begin FUNCTION F9305_CHPPRFL "F9305: Chip Temperature Profile" /begin DEF_CHARACTERISTIC ChpPrfl_qtChpMin_C ChpPrfl_tChp_C /end DEF_CHARACTERISTIC /begin OUT_MEASUREMENT ChpPrfl_tMax ChpPrfl_ti ChpPrfl_tiBuf /end OUT_MEASUREMENT /end FUNCTION
/begin FUNCTION F9306_ATFPRFL "F9306: ATF Temperature Profile" /begin DEF_CHARACTERISTIC AtfPrfl_qtAtfMin_C AtfPrfl_tAtf_C /end DEF_CHARACTERISTIC /begin OUT_MEASUREMENT AtfPrfl_tMax AtfPrfl_ti AtfPrfl_tiBuf /end OUT_MEASUREMENT /end FUNCTION
/begin FUNCTION F9310_SRVSTRTT "F9310: TCU start up timing" /begin OUT_MEASUREMENT SrvStrtT_ti /end OUT_MEASUREMENT /end FUNCTION
/begin FUNCTION Funktionskomponenten "Funktionskomponenten" /begin SUB_FUNCTION Funktionskomponenten.cSignale /end SUB_FUNCTION /end FUNCTION
/begin RECORD_LAYOUT AblGLKFsw_S1 FNC_VALUES 5 SWORD ROW_DIR DIRECT AXIS_PTS_X 2 SWORD INDEX_INCR DIRECT AXIS_PTS_Y 4 SWORD INDEX_INCR DIRECT NO_AXIS_PTS_X 1 SWORD NO_AXIS_PTS_Y 3 SWORD /end RECORD_LAYOUT
/begin RECORD_LAYOUT AblGLKLsw_S1 FNC_VALUES 3 SWORD COLUMN_DIR DIRECT AXIS_PTS_X 2 SWORD INDEX_INCR DIRECT NO_AXIS_PTS_X 1 SWORD /end RECORD_LAYOUT
/begin RECORD_LAYOUT AblGLKWBsw_S1 FNC_VALUES 1 SWORD COLUMN_DIR DIRECT /end RECORD_LAYOUT
/begin RECORD_LAYOUT AblGLKWBub_S1 FNC_VALUES 1 UBYTE COLUMN_DIR DIRECT /end RECORD_LAYOUT
/begin RECORD_LAYOUT AblGLKWBuw_S1 FNC_VALUES 1 UWORD COLUMN_DIR DIRECT /end RECORD_LAYOUT
/begin RECORD_LAYOUT AblGLKWr32_S1 FNC_VALUES 1 FLOAT32_IEEE COLUMN_DIR DIRECT /end RECORD_LAYOUT
/begin RECORD_LAYOUT AblGLKWsb_S1 FNC_VALUES 1 SBYTE COLUMN_DIR DIRECT /end RECORD_LAYOUT
/begin RECORD_LAYOUT AblGLKWsw_S1 FNC_VALUES 1 SWORD COLUMN_DIR DIRECT /end RECORD_LAYOUT
/begin RECORD_LAYOUT AblGLKWub_M FNC_VALUES 1 UBYTE COLUMN_DIR DIRECT /end RECORD_LAYOUT
/begin RECORD_LAYOUT AblGLKWub_S1 FNC_VALUES 1 UBYTE COLUMN_DIR DIRECT /end RECORD_LAYOUT
/begin RECORD_LAYOUT AblGLKWul_S1 FNC_VALUES 1 ULONG COLUMN_DIR DIRECT /end RECORD_LAYOUT
/begin RECORD_LAYOUT AblGLKWuw_M FNC_VALUES 1 UWORD COLUMN_DIR DIRECT /end RECORD_LAYOUT
/begin RECORD_LAYOUT AblGLKWuw_S1 FNC_VALUES 1 UWORD COLUMN_DIR DIRECT /end RECORD_LAYOUT
/end MODULE
/end PROJECT
