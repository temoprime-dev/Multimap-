ASAP2_VERSION 1 51
/begin PROJECT ZHBC8600 "Gen2_BMW_System_Supplier_Lib"
/begin MODULE CPP ""
/begin MOD_COMMON "" BYTE_ORDER MSB_FIRST ALIGNMENT_BYTE 1 ALIGNMENT_WORD 2 ALIGNMENT_LONG 4 ALIGNMENT_FLOAT32_IEEE 4 ALIGNMENT_FLOAT64_IEEE 1 /end MOD_COMMON
/begin COMPU_METHOD SAB2_0025PROZENT_S3_S3 "int = ((phys * 1000) / 25) - (0) %" RAT_FUNC "%4.3" "%" COEFFS 0 40 0 0 0 1 /end COMPU_METHOD
/begin COMPU_METHOD SAB2_0125PROZENT_S3_S3 "int = ((phys * 1000) / 125) - (0) %" RAT_FUNC "%4.3" "%" COEFFS 0 8 0 0 0 1 /end COMPU_METHOD
/begin COMPU_METHOD SAB2_039063PROZENT_S3_S3 "int = ((phys * 100000) / 39063) - (0) %" RAT_FUNC "%4.3" "%" COEFFS 0 2.55996723242 0 0 0 1 /end COMPU_METHOD
/begin COMPU_METHOD UMR___1_100_0_S5_S3 "int = ((phys * 100) / 1) - (0) [-]" RAT_FUNC "%3.2" "[-]" COEFFS 0 100 0 0 0 1 /end COMPU_METHOD
/begin COMPU_METHOD UMR_BAR__1_1000_0_S5_S3 "int = ((phys * 1000) / 1) - (0) [bar]" RAT_FUNC "%4.3" "[bar]" COEFFS 0 1000 0 0 0 1 /end COMPU_METHOD
/begin COMPU_METHOD UMR_BAR_SEC_1_10_0_S5_S3 "int = ((phys * 10) / 1) - (0) [bar/s]" RAT_FUNC "%2.1" "[bar/s]" COEFFS 0 10 0 0 0 1 /end COMPU_METHOD
/begin COMPU_METHOD UMR_GRADC__1_1_M40_S5_S3 "int = ((phys * 1) / 1) - (-40) [°C]" RAT_FUNC "%1.0" "[°C]" COEFFS 0 1 40 0 0 1 /end COMPU_METHOD
/begin COMPU_METHOD UMR_MBARMINSEC_10MSEC_1_1_0_S5_S3 "int = ((phys * 1) / 1) - (0) [0,00031mbar/(10ms/(min*s))]" RAT_FUNC "%1.0" "[0,00031mbar/(10ms/(min*s))]" COEFFS 0 1 0 0 0 1 /end COMPU_METHOD
/begin COMPU_METHOD UMR_MBARMINSEC__1_1_0_S5_S3 "int = ((phys * 1) / 1) - (0) [0,02mbar/(1/(min*s))]" RAT_FUNC "%1.0" "[0,02mbar/(1/(min*s))]" COEFFS 0 1 0 0 0 1 /end COMPU_METHOD
/begin COMPU_METHOD UMR_MSEC__10_1_0_S5_S3 "int = ((phys * 1) / 10) - (0) [ms]" RAT_FUNC "%1.0" "[ms]" COEFFS 0 0.1 0 0 0 1 /end COMPU_METHOD
/begin COMPU_METHOD UMR_MSEC__10_1_M128_S5_S3 "int = ((phys * 1) / 10) - (-128) [ms]" RAT_FUNC "%1.0" "[ms]" COEFFS 0 0.1 128 0 0 1 /end COMPU_METHOD
/begin COMPU_METHOD UMR_NM__1_1_0_S5_S3 "int = ((phys * 1) / 1) - (0) [Nm]" RAT_FUNC "%1.0" "[Nm]" COEFFS 0 1 0 0 0 1 /end COMPU_METHOD
/begin COMPU_METHOD UMR_NM__6_1_M34_S5_S3 "int = ((phys * 1) / 6) - (-34) [Nm]" RAT_FUNC "%1.0" "[Nm]" COEFFS 0 0.166666666667 34 0 0 1 /end COMPU_METHOD
/begin COMPU_METHOD UMR_U_MIN_1_1_0_S5_S3 "int = ((phys * 1) / 1) - (0) [U/min]" RAT_FUNC "%1.0" "[U/min]" COEFFS 0 1 0 0 0 1 /end COMPU_METHOD
/begin COMPU_METHOD UMR_U_MIN_32_1_0_S5_S3 "int = ((phys * 1) / 32) - (0) [U/min]" RAT_FUNC "%1.0" "[U/min]" COEFFS 0 0.03125 0 0 0 1 /end COMPU_METHOD
/begin COMPU_METHOD UMR_U_MINSEC2_1_1_0_S5_S3 "int = ((phys * 1) / 1) - (0) [U/(min*s^2)]" RAT_FUNC "%1.0" "[U/(min*s^2)]" COEFFS 0 1 0 0 0 1 /end COMPU_METHOD
/begin CHARACTERISTIC KF_PKABFOLNACH64MRS43 "Schaltdruck ab.Kupplung fuer Folgeschaltung nach MRS" MAP 0x1B2A24 ZF_kf_si16_S5_S3 12.75 UMR_BAR__1_1000_0_S5_S3 0 12.75
 /begin AXIS_DESCR STD_AXIS NO_INPUT_QUANTITY UMR_U_MIN_32_1_0_S5_S3 8 0 8160 DEPOSIT ABSOLUTE /end AXIS_DESCR
 /begin AXIS_DESCR STD_AXIS zff_atsys._.iSignale._.obj.sig_m_t UMR_NM__1_1_0_S5_S3 10 -200 1300 DEPOSIT ABSOLUTE /end AXIS_DESCR
/end CHARACTERISTIC
/begin CHARACTERISTIC KF_PKABFOLNACH64MRS43SP "Schaltdruck ab.Kupplung fuer verkuerzte Folgeschaltung nach MRS" MAP 0x1B2BBC ZF_kf_si16_S5_S3 12.75 UMR_BAR__1_1000_0_S5_S3 0 12.75
 /begin AXIS_DESCR STD_AXIS NO_INPUT_QUANTITY UMR_U_MIN_32_1_0_S5_S3 8 0 8160 DEPOSIT ABSOLUTE /end AXIS_DESCR
 /begin AXIS_DESCR STD_AXIS zff_atsys._.iSignale._.obj.sig_m_t UMR_NM__1_1_0_S5_S3 10 -200 1300 DEPOSIT ABSOLUTE /end AXIS_DESCR
/end CHARACTERISTIC
/begin CHARACTERISTIC KF_PKABFOLNACH64MRS43SPORT "Schaltdruck ab.Kupplung fuer verkuerzte Folgeschaltung nach DRS" MAP 0x1B2C88 ZF_kf_si16_S5_S3 12.75 UMR_BAR__1_1000_0_S5_S3 0 12.75
 /begin AXIS_DESCR STD_AXIS NO_INPUT_QUANTITY UMR_U_MIN_32_1_0_S5_S3 8 0 8160 DEPOSIT ABSOLUTE /end AXIS_DESCR
 /begin AXIS_DESCR STD_AXIS zff_atsys._.iSignale._.obj.sig_m_t UMR_NM__1_1_0_S5_S3 10 -200 1300 DEPOSIT ABSOLUTE /end AXIS_DESCR
/end CHARACTERISTIC
/begin CHARACTERISTIC KF_PKABFOLNACH64MRS43_EL "Schaltdruck ab.Kupplung fuer Folgeschaltung nach MRS" MAP 0x1B2AF0 ZF_kf_si16_S5_S3 12.75 UMR_BAR__1_1000_0_S5_S3 0 12.75
 /begin AXIS_DESCR STD_AXIS NO_INPUT_QUANTITY UMR_U_MIN_32_1_0_S5_S3 8 0 8160 DEPOSIT ABSOLUTE /end AXIS_DESCR
 /begin AXIS_DESCR STD_AXIS zff_atsys._.iSignale._.obj.sig_m_t UMR_NM__1_1_0_S5_S3 10 -200 1300 DEPOSIT ABSOLUTE /end AXIS_DESCR
/end CHARACTERISTIC
/begin CHARACTERISTIC KF_PKABFOLNACH84MRS43 "Schaltdruck ab.Kupplung fuer Folgeschaltung nach DRS" MAP 0x1B26F4 ZF_kf_si16_S5_S3 12.75 UMR_BAR__1_1000_0_S5_S3 0 12.75
 /begin AXIS_DESCR STD_AXIS NO_INPUT_QUANTITY UMR_U_MIN_32_1_0_S5_S3 8 0 8160 DEPOSIT ABSOLUTE /end AXIS_DESCR
 /begin AXIS_DESCR STD_AXIS zff_atsys._.iSignale._.obj.sig_m_t UMR_NM__1_1_0_S5_S3 10 -200 1300 DEPOSIT ABSOLUTE /end AXIS_DESCR
/end CHARACTERISTIC
/begin CHARACTERISTIC KF_PKABFOLNACH84MRS43SP "Schaltdruck ab.Kupplung fuer verkuerzte Folgeschaltung nach DRS" MAP 0x1B288C ZF_kf_si16_S5_S3 12.75 UMR_BAR__1_1000_0_S5_S3 0 12.75
 /begin AXIS_DESCR STD_AXIS NO_INPUT_QUANTITY UMR_U_MIN_32_1_0_S5_S3 8 0 8160 DEPOSIT ABSOLUTE /end AXIS_DESCR
 /begin AXIS_DESCR STD_AXIS zff_atsys._.iSignale._.obj.sig_m_t UMR_NM__1_1_0_S5_S3 10 -200 1300 DEPOSIT ABSOLUTE /end AXIS_DESCR
/end CHARACTERISTIC
/begin CHARACTERISTIC KF_PKABFOLNACH84MRS43SPORT "Schaltdruck ab.Kupplung fuer verkuerzte Folgeschaltung nach DRS" MAP 0x1B2958 ZF_kf_si16_S5_S3 12.75 UMR_BAR__1_1000_0_S5_S3 0 12.75
 /begin AXIS_DESCR STD_AXIS NO_INPUT_QUANTITY UMR_U_MIN_32_1_0_S5_S3 8 0 8160 DEPOSIT ABSOLUTE /end AXIS_DESCR
 /begin AXIS_DESCR STD_AXIS zff_atsys._.iSignale._.obj.sig_m_t UMR_NM__1_1_0_S5_S3 10 -200 1300 DEPOSIT ABSOLUTE /end AXIS_DESCR
/end CHARACTERISTIC
/begin CHARACTERISTIC KF_PKABFOLNACH84MRS43_EL "Schaltdruck ab.Kupplung fuer Folgeschaltung nach DRS" MAP 0x1B27C0 ZF_kf_si16_S5_S3 12.75 UMR_BAR__1_1000_0_S5_S3 0 12.75
 /begin AXIS_DESCR STD_AXIS NO_INPUT_QUANTITY UMR_U_MIN_32_1_0_S5_S3 8 0 8160 DEPOSIT ABSOLUTE /end AXIS_DESCR
 /begin AXIS_DESCR STD_AXIS zff_atsys._.iSignale._.obj.sig_m_t UMR_NM__1_1_0_S5_S3 10 -200 1300 DEPOSIT ABSOLUTE /end AXIS_DESCR
/end CHARACTERISTIC
/begin CHARACTERISTIC KF_PKABFOLNACHMRS21 "Schaltdruck ab.Kupplung fuer Folgeschaltung nach MRS" MAP 0x1B3160 ZF_kf_si16_S5_S3 12.75 UMR_BAR__1_1000_0_S5_S3 0 12.75
 /begin AXIS_DESCR STD_AXIS NO_INPUT_QUANTITY UMR_U_MIN_32_1_0_S5_S3 8 0 8160 DEPOSIT ABSOLUTE /end AXIS_DESCR
 /begin AXIS_DESCR STD_AXIS zff_atsys._.iSignale._.obj.sig_m_t UMR_NM__1_1_0_S5_S3 10 -200 1300 DEPOSIT ABSOLUTE /end AXIS_DESCR
/end CHARACTERISTIC
/begin CHARACTERISTIC KF_PKABFOLNACHMRS21_EL "Schaltdruck ab.Kupplung fuer Folgeschaltung nach MRS" MAP 0x1B322C ZF_kf_si16_S5_S3 12.75 UMR_BAR__1_1000_0_S5_S3 0 12.75
 /begin AXIS_DESCR STD_AXIS NO_INPUT_QUANTITY UMR_U_MIN_32_1_0_S5_S3 8 0 8160 DEPOSIT ABSOLUTE /end AXIS_DESCR
 /begin AXIS_DESCR STD_AXIS zff_atsys._.iSignale._.obj.sig_m_t UMR_NM__1_1_0_S5_S3 10 -200 1300 DEPOSIT ABSOLUTE /end AXIS_DESCR
/end CHARACTERISTIC
/begin CHARACTERISTIC KF_PKABFOLNACHMRS32 "Schaltdruck ab.Kupplung fuer Folgeschaltung nach MRS" MAP 0x1B386C ZF_kf_si16_S5_S3 12.75 UMR_BAR__1_1000_0_S5_S3 0 12.75
 /begin AXIS_DESCR STD_AXIS NO_INPUT_QUANTITY UMR_U_MIN_32_1_0_S5_S3 8 0 8160 DEPOSIT ABSOLUTE /end AXIS_DESCR
 /begin AXIS_DESCR STD_AXIS zff_atsys._.iSignale._.obj.sig_m_t UMR_NM__1_1_0_S5_S3 10 -200 1300 DEPOSIT ABSOLUTE /end AXIS_DESCR
/end CHARACTERISTIC
/begin CHARACTERISTIC KF_PKABFOLNACHMRS32_EL "Schaltdruck ab.Kupplung fuer Folgeschaltung nach MRS" MAP 0x1B3938 ZF_kf_si16_S5_S3 12.75 UMR_BAR__1_1000_0_S5_S3 0 12.75
 /begin AXIS_DESCR STD_AXIS NO_INPUT_QUANTITY UMR_U_MIN_32_1_0_S5_S3 8 0 8160 DEPOSIT ABSOLUTE /end AXIS_DESCR
 /begin AXIS_DESCR STD_AXIS zff_atsys._.iSignale._.obj.sig_m_t UMR_NM__1_1_0_S5_S3 10 -200 1300 DEPOSIT ABSOLUTE /end AXIS_DESCR
/end CHARACTERISTIC
/begin CHARACTERISTIC KF_PKABFOLNACHMRS54 "Schaltdruck ab.Kupplung fuer Folgeschaltung nach MRS" MAP 0x1B4340 ZF_kf_si16_S5_S3 12.75 UMR_BAR__1_1000_0_S5_S3 0 12.75
 /begin AXIS_DESCR STD_AXIS NO_INPUT_QUANTITY UMR_U_MIN_32_1_0_S5_S3 8 0 8160 DEPOSIT ABSOLUTE /end AXIS_DESCR
 /begin AXIS_DESCR STD_AXIS zff_atsys._.iSignale._.obj.sig_m_t UMR_NM__1_1_0_S5_S3 10 -200 1300 DEPOSIT ABSOLUTE /end AXIS_DESCR
/end CHARACTERISTIC
/begin CHARACTERISTIC KF_PKABFOLNACHMRS54_EL "Schaltdruck ab.Kupplung fuer Folgeschaltung nach MRS" MAP 0x1B440C ZF_kf_si16_S5_S3 12.75 UMR_BAR__1_1000_0_S5_S3 0 12.75
 /begin AXIS_DESCR STD_AXIS NO_INPUT_QUANTITY UMR_U_MIN_32_1_0_S5_S3 8 0 8160 DEPOSIT ABSOLUTE /end AXIS_DESCR
 /begin AXIS_DESCR STD_AXIS zff_atsys._.iSignale._.obj.sig_m_t UMR_NM__1_1_0_S5_S3 10 -200 1300 DEPOSIT ABSOLUTE /end AXIS_DESCR
/end CHARACTERISTIC
/begin CHARACTERISTIC KF_PKABFOLNACHMRS65 "Schaltdruck ab.Kupplung fuer Folgeschaltung nach MRS" MAP 0x1B4A4C ZF_kf_si16_S5_S3 12.75 UMR_BAR__1_1000_0_S5_S3 0 12.75
 /begin AXIS_DESCR STD_AXIS NO_INPUT_QUANTITY UMR_U_MIN_32_1_0_S5_S3 8 0 8160 DEPOSIT ABSOLUTE /end AXIS_DESCR
 /begin AXIS_DESCR STD_AXIS zff_atsys._.iSignale._.obj.sig_m_t UMR_NM__1_1_0_S5_S3 10 -200 1300 DEPOSIT ABSOLUTE /end AXIS_DESCR
/end CHARACTERISTIC
/begin CHARACTERISTIC KF_PKABFOLNACHMRS65_EL "Schaltdruck ab.Kupplung fuer Folgeschaltung nach MRS" MAP 0x1B4B18 ZF_kf_si16_S5_S3 12.75 UMR_BAR__1_1000_0_S5_S3 0 12.75
 /begin AXIS_DESCR STD_AXIS NO_INPUT_QUANTITY UMR_U_MIN_32_1_0_S5_S3 8 0 8160 DEPOSIT ABSOLUTE /end AXIS_DESCR
 /begin AXIS_DESCR STD_AXIS zff_atsys._.iSignale._.obj.sig_m_t UMR_NM__1_1_0_S5_S3 10 -200 1300 DEPOSIT ABSOLUTE /end AXIS_DESCR
/end CHARACTERISTIC
/begin CHARACTERISTIC KF_PKABFOLNACHMRS76 "Schaltdruck ab.Kupplung fuer Folgeschaltung nach MRS" MAP 0x1B5158 ZF_kf_si16_S5_S3 12.75 UMR_BAR__1_1000_0_S5_S3 0 12.75
 /begin AXIS_DESCR STD_AXIS NO_INPUT_QUANTITY UMR_U_MIN_32_1_0_S5_S3 8 0 8160 DEPOSIT ABSOLUTE /end AXIS_DESCR
 /begin AXIS_DESCR STD_AXIS zff_atsys._.iSignale._.obj.sig_m_t UMR_NM__1_1_0_S5_S3 10 -200 1300 DEPOSIT ABSOLUTE /end AXIS_DESCR
/end CHARACTERISTIC
/begin CHARACTERISTIC KF_PKABFOLNACHMRS76_EL "Schaltdruck ab.Kupplung fuer Folgeschaltung nach MRS" MAP 0x1B5224 ZF_kf_si16_S5_S3 12.75 UMR_BAR__1_1000_0_S5_S3 0 12.75
 /begin AXIS_DESCR STD_AXIS NO_INPUT_QUANTITY UMR_U_MIN_32_1_0_S5_S3 8 0 8160 DEPOSIT ABSOLUTE /end AXIS_DESCR
 /begin AXIS_DESCR STD_AXIS zff_atsys._.iSignale._.obj.sig_m_t UMR_NM__1_1_0_S5_S3 10 -200 1300 DEPOSIT ABSOLUTE /end AXIS_DESCR
/end CHARACTERISTIC
/begin CHARACTERISTIC KF_PKABFOLNACHMRS87 "Schaltdruck ab.Kupplung fuer Folgeschaltung nach MRS" MAP 0x1B5864 ZF_kf_si16_S5_S3 12.75 UMR_BAR__1_1000_0_S5_S3 0 12.75
 /begin AXIS_DESCR STD_AXIS NO_INPUT_QUANTITY UMR_U_MIN_32_1_0_S5_S3 8 0 8160 DEPOSIT ABSOLUTE /end AXIS_DESCR
 /begin AXIS_DESCR STD_AXIS zff_atsys._.iSignale._.obj.sig_m_t UMR_NM__1_1_0_S5_S3 10 -200 1300 DEPOSIT ABSOLUTE /end AXIS_DESCR
/end CHARACTERISTIC
/begin CHARACTERISTIC KF_PKABFOLNACHMRS87_EL "Schaltdruck ab.Kupplung fuer Folgeschaltung nach MRS" MAP 0x1B5930 ZF_kf_si16_S5_S3 12.75 UMR_BAR__1_1000_0_S5_S3 0 12.75
 /begin AXIS_DESCR STD_AXIS NO_INPUT_QUANTITY UMR_U_MIN_32_1_0_S5_S3 8 0 8160 DEPOSIT ABSOLUTE /end AXIS_DESCR
 /begin AXIS_DESCR STD_AXIS zff_atsys._.iSignale._.obj.sig_m_t UMR_NM__1_1_0_S5_S3 10 -200 1300 DEPOSIT ABSOLUTE /end AXIS_DESCR
/end CHARACTERISTIC
/begin CHARACTERISTIC KF_PKABFOLNACHMRSSP21 "Schaltdruck ab.Kupplung fuer verkuerzte Folgeschaltung nach MRS" MAP 0x1B3490 ZF_kf_si16_S5_S3 12.75 UMR_BAR__1_1000_0_S5_S3 0 12.75
 /begin AXIS_DESCR STD_AXIS NO_INPUT_QUANTITY UMR_U_MIN_32_1_0_S5_S3 8 0 8160 DEPOSIT ABSOLUTE /end AXIS_DESCR
 /begin AXIS_DESCR STD_AXIS zff_atsys._.iSignale._.obj.sig_m_t UMR_NM__1_1_0_S5_S3 10 -200 1300 DEPOSIT ABSOLUTE /end AXIS_DESCR
/end CHARACTERISTIC
/begin CHARACTERISTIC KF_PKABFOLNACHMRSSP32 "Schaltdruck ab.Kupplung fuer verkuerzte Folgeschaltung nach MRS" MAP 0x1B3B9C ZF_kf_si16_S5_S3 12.75 UMR_BAR__1_1000_0_S5_S3 0 12.75
 /begin AXIS_DESCR STD_AXIS NO_INPUT_QUANTITY UMR_U_MIN_32_1_0_S5_S3 8 0 8160 DEPOSIT ABSOLUTE /end AXIS_DESCR
 /begin AXIS_DESCR STD_AXIS zff_atsys._.iSignale._.obj.sig_m_t UMR_NM__1_1_0_S5_S3 10 -200 1300 DEPOSIT ABSOLUTE /end AXIS_DESCR
/end CHARACTERISTIC
/begin CHARACTERISTIC KF_PKABFOLNACHMRSSP54 "Schaltdruck ab.Kupplung fuer verkuerzte Folgeschaltung nach MRS" MAP 0x1B4670 ZF_kf_si16_S5_S3 12.75 UMR_BAR__1_1000_0_S5_S3 0 12.75
 /begin AXIS_DESCR STD_AXIS NO_INPUT_QUANTITY UMR_U_MIN_32_1_0_S5_S3 8 0 8160 DEPOSIT ABSOLUTE /end AXIS_DESCR
 /begin AXIS_DESCR STD_AXIS zff_atsys._.iSignale._.obj.sig_m_t UMR_NM__1_1_0_S5_S3 10 -200 1300 DEPOSIT ABSOLUTE /end AXIS_DESCR
/end CHARACTERISTIC
/begin CHARACTERISTIC KF_PKABFOLNACHMRSSP65 "Schaltdruck ab.Kupplung fuer verkuerzte Folgeschaltung nach MRS" MAP 0x1B4D7C ZF_kf_si16_S5_S3 12.75 UMR_BAR__1_1000_0_S5_S3 0 12.75
 /begin AXIS_DESCR STD_AXIS NO_INPUT_QUANTITY UMR_U_MIN_32_1_0_S5_S3 8 0 8160 DEPOSIT ABSOLUTE /end AXIS_DESCR
 /begin AXIS_DESCR STD_AXIS zff_atsys._.iSignale._.obj.sig_m_t UMR_NM__1_1_0_S5_S3 10 -200 1300 DEPOSIT ABSOLUTE /end AXIS_DESCR
/end CHARACTERISTIC
/begin CHARACTERISTIC KF_PKABFOLNACHMRSSP76 "Schaltdruck ab.Kupplung fuer verkuerzte Folgeschaltung nach MRS" MAP 0x1B5488 ZF_kf_si16_S5_S3 12.75 UMR_BAR__1_1000_0_S5_S3 0 12.75
 /begin AXIS_DESCR STD_AXIS NO_INPUT_QUANTITY UMR_U_MIN_32_1_0_S5_S3 8 0 8160 DEPOSIT ABSOLUTE /end AXIS_DESCR
 /begin AXIS_DESCR STD_AXIS zff_atsys._.iSignale._.obj.sig_m_t UMR_NM__1_1_0_S5_S3 10 -200 1300 DEPOSIT ABSOLUTE /end AXIS_DESCR
/end CHARACTERISTIC
/begin CHARACTERISTIC KF_PKABFOLNACHMRSSP87 "Schaltdruck ab.Kupplung fuer verkuerzte Folgeschaltung nach MRS" MAP 0x1B5B94 ZF_kf_si16_S5_S3 12.75 UMR_BAR__1_1000_0_S5_S3 0 12.75
 /begin AXIS_DESCR STD_AXIS NO_INPUT_QUANTITY UMR_U_MIN_32_1_0_S5_S3 8 0 8160 DEPOSIT ABSOLUTE /end AXIS_DESCR
 /begin AXIS_DESCR STD_AXIS zff_atsys._.iSignale._.obj.sig_m_t UMR_NM__1_1_0_S5_S3 10 -200 1300 DEPOSIT ABSOLUTE /end AXIS_DESCR
/end CHARACTERISTIC
/begin CHARACTERISTIC KF_PKABFOLNACHMRSSPORT21 "Schaltdruck ab.Kupplung fuer verkuerzte Folgeschaltung nach MRS" MAP 0x1B355C ZF_kf_si16_S5_S3 12.75 UMR_BAR__1_1000_0_S5_S3 0 12.75
 /begin AXIS_DESCR STD_AXIS NO_INPUT_QUANTITY UMR_U_MIN_32_1_0_S5_S3 8 0 8160 DEPOSIT ABSOLUTE /end AXIS_DESCR
 /begin AXIS_DESCR STD_AXIS zff_atsys._.iSignale._.obj.sig_m_t UMR_NM__1_1_0_S5_S3 10 -200 1300 DEPOSIT ABSOLUTE /end AXIS_DESCR
/end CHARACTERISTIC
/begin CHARACTERISTIC KF_PKABFOLNACHMRSSPORT32 "Schaltdruck ab.Kupplung fuer verkuerzte Folgeschaltung nach MRS" MAP 0x1B3C68 ZF_kf_si16_S5_S3 12.75 UMR_BAR__1_1000_0_S5_S3 0 12.75
 /begin AXIS_DESCR STD_AXIS NO_INPUT_QUANTITY UMR_U_MIN_32_1_0_S5_S3 8 0 8160 DEPOSIT ABSOLUTE /end AXIS_DESCR
 /begin AXIS_DESCR STD_AXIS zff_atsys._.iSignale._.obj.sig_m_t UMR_NM__1_1_0_S5_S3 10 -200 1300 DEPOSIT ABSOLUTE /end AXIS_DESCR
/end CHARACTERISTIC
/begin CHARACTERISTIC KF_PKABFOLNACHMRSSPORT54 "Schaltdruck ab.Kupplung fuer verkuerzte Folgeschaltung nach MRS" MAP 0x1B473C ZF_kf_si16_S5_S3 12.75 UMR_BAR__1_1000_0_S5_S3 0 12.75
 /begin AXIS_DESCR STD_AXIS NO_INPUT_QUANTITY UMR_U_MIN_32_1_0_S5_S3 8 0 8160 DEPOSIT ABSOLUTE /end AXIS_DESCR
 /begin AXIS_DESCR STD_AXIS zff_atsys._.iSignale._.obj.sig_m_t UMR_NM__1_1_0_S5_S3 10 -200 1300 DEPOSIT ABSOLUTE /end AXIS_DESCR
/end CHARACTERISTIC
/begin CHARACTERISTIC KF_PKABFOLNACHMRSSPORT65 "Schaltdruck ab.Kupplung fuer verkuerzte Folgeschaltung nach MRS" MAP 0x1B4E48 ZF_kf_si16_S5_S3 12.75 UMR_BAR__1_1000_0_S5_S3 0 12.75
 /begin AXIS_DESCR STD_AXIS NO_INPUT_QUANTITY UMR_U_MIN_32_1_0_S5_S3 8 0 8160 DEPOSIT ABSOLUTE /end AXIS_DESCR
 /begin AXIS_DESCR STD_AXIS zff_atsys._.iSignale._.obj.sig_m_t UMR_NM__1_1_0_S5_S3 10 -200 1300 DEPOSIT ABSOLUTE /end AXIS_DESCR
/end CHARACTERISTIC
/begin CHARACTERISTIC KF_PKABFOLNACHMRSSPORT76 "Schaltdruck ab.Kupplung fuer verkuerzte Folgeschaltung nach MRS" MAP 0x1B5554 ZF_kf_si16_S5_S3 12.75 UMR_BAR__1_1000_0_S5_S3 0 12.75
 /begin AXIS_DESCR STD_AXIS NO_INPUT_QUANTITY UMR_U_MIN_32_1_0_S5_S3 8 0 8160 DEPOSIT ABSOLUTE /end AXIS_DESCR
 /begin AXIS_DESCR STD_AXIS zff_atsys._.iSignale._.obj.sig_m_t UMR_NM__1_1_0_S5_S3 10 -200 1300 DEPOSIT ABSOLUTE /end AXIS_DESCR
/end CHARACTERISTIC
/begin CHARACTERISTIC KF_PKABFOLNACHMRSSPORT87 "Schaltdruck ab.Kupplung fuer verkuerzte Folgeschaltung nach MRS" MAP 0x1B5C60 ZF_kf_si16_S5_S3 12.75 UMR_BAR__1_1000_0_S5_S3 0 12.75
 /begin AXIS_DESCR STD_AXIS NO_INPUT_QUANTITY UMR_U_MIN_32_1_0_S5_S3 8 0 8160 DEPOSIT ABSOLUTE /end AXIS_DESCR
 /begin AXIS_DESCR STD_AXIS zff_atsys._.iSignale._.obj.sig_m_t UMR_NM__1_1_0_S5_S3 10 -200 1300 DEPOSIT ABSOLUTE /end AXIS_DESCR
/end CHARACTERISTIC
/begin CHARACTERISTIC KF_PKABFOLNACHRS21 "Schaltdruck ab.Kupplung fuer Folgeschaltung" MAP 0x1B2FC8 ZF_kf_si16_S5_S3 12.75 UMR_BAR__1_1000_0_S5_S3 0 12.75
 /begin AXIS_DESCR STD_AXIS NO_INPUT_QUANTITY UMR_U_MIN_32_1_0_S5_S3 8 0 8160 DEPOSIT ABSOLUTE /end AXIS_DESCR
 /begin AXIS_DESCR STD_AXIS zff_atsys._.iSignale._.obj.sig_m_t UMR_NM__1_1_0_S5_S3 10 -200 1300 DEPOSIT ABSOLUTE /end AXIS_DESCR
/end CHARACTERISTIC
/begin CHARACTERISTIC KF_PKABFOLNACHRS21_EL "Schaltdruck ab.Kupplung fuer Folgeschaltung" MAP 0x1B3094 ZF_kf_si16_S5_S3 12.75 UMR_BAR__1_1000_0_S5_S3 0 12.75
 /begin AXIS_DESCR STD_AXIS NO_INPUT_QUANTITY UMR_U_MIN_32_1_0_S5_S3 8 0 8160 DEPOSIT ABSOLUTE /end AXIS_DESCR
 /begin AXIS_DESCR STD_AXIS zff_atsys._.iSignale._.obj.sig_m_t UMR_NM__1_1_0_S5_S3 10 -200 1300 DEPOSIT ABSOLUTE /end AXIS_DESCR
/end CHARACTERISTIC
/begin CHARACTERISTIC KF_PKABFOLNACHRS32 "Schaltdruck ab.Kupplung fuer Folgeschaltung" MAP 0x1B36D4 ZF_kf_si16_S5_S3 12.75 UMR_BAR__1_1000_0_S5_S3 0 12.75
 /begin AXIS_DESCR STD_AXIS NO_INPUT_QUANTITY UMR_U_MIN_32_1_0_S5_S3 8 0 8160 DEPOSIT ABSOLUTE /end AXIS_DESCR
 /begin AXIS_DESCR STD_AXIS zff_atsys._.iSignale._.obj.sig_m_t UMR_NM__1_1_0_S5_S3 10 -200 1300 DEPOSIT ABSOLUTE /end AXIS_DESCR
/end CHARACTERISTIC
/begin CHARACTERISTIC KF_PKABFOLNACHRS32_EL "Schaltdruck ab.Kupplung fuer Folgeschaltung" MAP 0x1B37A0 ZF_kf_si16_S5_S3 12.75 UMR_BAR__1_1000_0_S5_S3 0 12.75
 /begin AXIS_DESCR STD_AXIS NO_INPUT_QUANTITY UMR_U_MIN_32_1_0_S5_S3 8 0 8160 DEPOSIT ABSOLUTE /end AXIS_DESCR
 /begin AXIS_DESCR STD_AXIS zff_atsys._.iSignale._.obj.sig_m_t UMR_NM__1_1_0_S5_S3 10 -200 1300 DEPOSIT ABSOLUTE /end AXIS_DESCR
/end CHARACTERISTIC
/begin CHARACTERISTIC KF_PKABFOLNACHRS43 "Schaltdruck ab.Kupplung fuer Folgeschaltung" MAP 0x1B3DCC ZF_kf_si16_S5_S3 12.75 UMR_BAR__1_1000_0_S5_S3 0 12.75
 /begin AXIS_DESCR STD_AXIS NO_INPUT_QUANTITY UMR_U_MIN_32_1_0_S5_S3 8 0 8160 DEPOSIT ABSOLUTE /end AXIS_DESCR
 /begin AXIS_DESCR STD_AXIS zff_atsys._.iSignale._.obj.sig_m_t UMR_NM__1_1_0_S5_S3 10 -200 1300 DEPOSIT ABSOLUTE /end AXIS_DESCR
/end CHARACTERISTIC
/begin CHARACTERISTIC KF_PKABFOLNACHRS43_EL "Schaltdruck ab.Kupplung fuer Folgeschaltung" MAP 0x1B3E98 ZF_kf_si16_S5_S3 12.75 UMR_BAR__1_1000_0_S5_S3 0 12.75
 /begin AXIS_DESCR STD_AXIS NO_INPUT_QUANTITY UMR_U_MIN_32_1_0_S5_S3 8 0 8160 DEPOSIT ABSOLUTE /end AXIS_DESCR
 /begin AXIS_DESCR STD_AXIS zff_atsys._.iSignale._.obj.sig_m_t UMR_NM__1_1_0_S5_S3 10 -200 1300 DEPOSIT ABSOLUTE /end AXIS_DESCR
/end CHARACTERISTIC
/begin CHARACTERISTIC KF_PKABFOLNACHRS54 "Schaltdruck ab.Kupplung fuer Folgeschaltung" MAP 0x1B41A8 ZF_kf_si16_S5_S3 12.75 UMR_BAR__1_1000_0_S5_S3 0 12.75
 /begin AXIS_DESCR STD_AXIS NO_INPUT_QUANTITY UMR_U_MIN_32_1_0_S5_S3 8 0 8160 DEPOSIT ABSOLUTE /end AXIS_DESCR
 /begin AXIS_DESCR STD_AXIS zff_atsys._.iSignale._.obj.sig_m_t UMR_NM__1_1_0_S5_S3 10 -200 1300 DEPOSIT ABSOLUTE /end AXIS_DESCR
/end CHARACTERISTIC
/begin CHARACTERISTIC KF_PKABFOLNACHRS54_EL "Schaltdruck ab.Kupplung fuer Folgeschaltung" MAP 0x1B4274 ZF_kf_si16_S5_S3 12.75 UMR_BAR__1_1000_0_S5_S3 0 12.75
 /begin AXIS_DESCR STD_AXIS NO_INPUT_QUANTITY UMR_U_MIN_32_1_0_S5_S3 8 0 8160 DEPOSIT ABSOLUTE /end AXIS_DESCR
 /begin AXIS_DESCR STD_AXIS zff_atsys._.iSignale._.obj.sig_m_t UMR_NM__1_1_0_S5_S3 10 -200 1300 DEPOSIT ABSOLUTE /end AXIS_DESCR
/end CHARACTERISTIC
/begin CHARACTERISTIC KF_PKABFOLNACHRS65 "Schaltdruck ab.Kupplung fuer Folgeschaltung" MAP 0x1B48B4 ZF_kf_si16_S5_S3 12.75 UMR_BAR__1_1000_0_S5_S3 0 12.75
 /begin AXIS_DESCR STD_AXIS NO_INPUT_QUANTITY UMR_U_MIN_32_1_0_S5_S3 8 0 8160 DEPOSIT ABSOLUTE /end AXIS_DESCR
 /begin AXIS_DESCR STD_AXIS zff_atsys._.iSignale._.obj.sig_m_t UMR_NM__1_1_0_S5_S3 10 -200 1300 DEPOSIT ABSOLUTE /end AXIS_DESCR
/end CHARACTERISTIC
/begin CHARACTERISTIC KF_PKABFOLNACHRS65_EL "Schaltdruck ab.Kupplung fuer Folgeschaltung" MAP 0x1B4980 ZF_kf_si16_S5_S3 12.75 UMR_BAR__1_1000_0_S5_S3 0 12.75
 /begin AXIS_DESCR STD_AXIS NO_INPUT_QUANTITY UMR_U_MIN_32_1_0_S5_S3 8 0 8160 DEPOSIT ABSOLUTE /end AXIS_DESCR
 /begin AXIS_DESCR STD_AXIS zff_atsys._.iSignale._.obj.sig_m_t UMR_NM__1_1_0_S5_S3 10 -200 1300 DEPOSIT ABSOLUTE /end AXIS_DESCR
/end CHARACTERISTIC
/begin CHARACTERISTIC KF_PKABFOLNACHRS76 "Schaltdruck ab.Kupplung fuer Folgeschaltung" MAP 0x1B4FC0 ZF_kf_si16_S5_S3 12.75 UMR_BAR__1_1000_0_S5_S3 0 12.75
 /begin AXIS_DESCR STD_AXIS NO_INPUT_QUANTITY UMR_U_MIN_32_1_0_S5_S3 8 0 8160 DEPOSIT ABSOLUTE /end AXIS_DESCR
 /begin AXIS_DESCR STD_AXIS zff_atsys._.iSignale._.obj.sig_m_t UMR_NM__1_1_0_S5_S3 10 -200 1300 DEPOSIT ABSOLUTE /end AXIS_DESCR
/end CHARACTERISTIC
/begin CHARACTERISTIC KF_PKABFOLNACHRS76_EL "Schaltdruck ab.Kupplung fuer Folgeschaltung" MAP 0x1B508C ZF_kf_si16_S5_S3 12.75 UMR_BAR__1_1000_0_S5_S3 0 12.75
 /begin AXIS_DESCR STD_AXIS NO_INPUT_QUANTITY UMR_U_MIN_32_1_0_S5_S3 8 0 8160 DEPOSIT ABSOLUTE /end AXIS_DESCR
 /begin AXIS_DESCR STD_AXIS zff_atsys._.iSignale._.obj.sig_m_t UMR_NM__1_1_0_S5_S3 10 -200 1300 DEPOSIT ABSOLUTE /end AXIS_DESCR
/end CHARACTERISTIC
/begin CHARACTERISTIC KF_PKABFOLNACHRS87 "Schaltdruck ab.Kupplung fuer Folgeschaltung" MAP 0x1B56CC ZF_kf_si16_S5_S3 12.75 UMR_BAR__1_1000_0_S5_S3 0 12.75
 /begin AXIS_DESCR STD_AXIS NO_INPUT_QUANTITY UMR_U_MIN_32_1_0_S5_S3 8 0 8160 DEPOSIT ABSOLUTE /end AXIS_DESCR
 /begin AXIS_DESCR STD_AXIS zff_atsys._.iSignale._.obj.sig_m_t UMR_NM__1_1_0_S5_S3 10 -200 1300 DEPOSIT ABSOLUTE /end AXIS_DESCR
/end CHARACTERISTIC
/begin CHARACTERISTIC KF_PKABFOLNACHRS87_EL "Schaltdruck ab.Kupplung fuer Folgeschaltung" MAP 0x1B5798 ZF_kf_si16_S5_S3 12.75 UMR_BAR__1_1000_0_S5_S3 0 12.75
 /begin AXIS_DESCR STD_AXIS NO_INPUT_QUANTITY UMR_U_MIN_32_1_0_S5_S3 8 0 8160 DEPOSIT ABSOLUTE /end AXIS_DESCR
 /begin AXIS_DESCR STD_AXIS zff_atsys._.iSignale._.obj.sig_m_t UMR_NM__1_1_0_S5_S3 10 -200 1300 DEPOSIT ABSOLUTE /end AXIS_DESCR
/end CHARACTERISTIC
/begin CHARACTERISTIC KF_PKABFOLNACHRSSP21 "Schaltdruck KAB fuer verkuerzte Folgeschaltung" MAP 0x1B32F8 ZF_kf_si16_S5_S3 12.75 UMR_BAR__1_1000_0_S5_S3 0 12.75
 /begin AXIS_DESCR STD_AXIS NO_INPUT_QUANTITY UMR_U_MIN_32_1_0_S5_S3 8 0 8160 DEPOSIT ABSOLUTE /end AXIS_DESCR
 /begin AXIS_DESCR STD_AXIS zff_atsys._.iSignale._.obj.sig_m_t UMR_NM__1_1_0_S5_S3 10 -200 1300 DEPOSIT ABSOLUTE /end AXIS_DESCR
/end CHARACTERISTIC
/begin CHARACTERISTIC KF_PKABFOLNACHRSSP32 "Schaltdruck KAB fuer verkuerzte Folgeschaltung" MAP 0x1B3A04 ZF_kf_si16_S5_S3 12.75 UMR_BAR__1_1000_0_S5_S3 0 12.75
 /begin AXIS_DESCR STD_AXIS NO_INPUT_QUANTITY UMR_U_MIN_32_1_0_S5_S3 8 0 8160 DEPOSIT ABSOLUTE /end AXIS_DESCR
 /begin AXIS_DESCR STD_AXIS zff_atsys._.iSignale._.obj.sig_m_t UMR_NM__1_1_0_S5_S3 10 -200 1300 DEPOSIT ABSOLUTE /end AXIS_DESCR
/end CHARACTERISTIC
/begin CHARACTERISTIC KF_PKABFOLNACHRSSP43 "Schaltdruck KAB fuer verkuerzte Folgeschaltung" MAP 0x1B3F64 ZF_kf_si16_S5_S3 12.75 UMR_BAR__1_1000_0_S5_S3 0 12.75
 /begin AXIS_DESCR STD_AXIS NO_INPUT_QUANTITY UMR_U_MIN_32_1_0_S5_S3 8 0 8160 DEPOSIT ABSOLUTE /end AXIS_DESCR
 /begin AXIS_DESCR STD_AXIS zff_atsys._.iSignale._.obj.sig_m_t UMR_NM__1_1_0_S5_S3 10 -200 1300 DEPOSIT ABSOLUTE /end AXIS_DESCR
/end CHARACTERISTIC
/begin CHARACTERISTIC KF_PKABFOLNACHRSSP54 "Schaltdruck KAB fuer verkuerzte Folgeschaltung" MAP 0x1B44D8 ZF_kf_si16_S5_S3 12.75 UMR_BAR__1_1000_0_S5_S3 0 12.75
 /begin AXIS_DESCR STD_AXIS NO_INPUT_QUANTITY UMR_U_MIN_32_1_0_S5_S3 8 0 8160 DEPOSIT ABSOLUTE /end AXIS_DESCR
 /begin AXIS_DESCR STD_AXIS zff_atsys._.iSignale._.obj.sig_m_t UMR_NM__1_1_0_S5_S3 10 -200 1300 DEPOSIT ABSOLUTE /end AXIS_DESCR
/end CHARACTERISTIC
/begin CHARACTERISTIC KF_PKABFOLNACHRSSP65 "Schaltdruck KAB fuer verkuerzte Folgeschaltung" MAP 0x1B4BE4 ZF_kf_si16_S5_S3 12.75 UMR_BAR__1_1000_0_S5_S3 0 12.75
 /begin AXIS_DESCR STD_AXIS NO_INPUT_QUANTITY UMR_U_MIN_32_1_0_S5_S3 8 0 8160 DEPOSIT ABSOLUTE /end AXIS_DESCR
 /begin AXIS_DESCR STD_AXIS zff_atsys._.iSignale._.obj.sig_m_t UMR_NM__1_1_0_S5_S3 10 -200 1300 DEPOSIT ABSOLUTE /end AXIS_DESCR
/end CHARACTERISTIC
/begin CHARACTERISTIC KF_PKABFOLNACHRSSP76 "Schaltdruck KAB fuer verkuerzte Folgeschaltung" MAP 0x1B52F0 ZF_kf_si16_S5_S3 12.75 UMR_BAR__1_1000_0_S5_S3 0 12.75
 /begin AXIS_DESCR STD_AXIS NO_INPUT_QUANTITY UMR_U_MIN_32_1_0_S5_S3 8 0 8160 DEPOSIT ABSOLUTE /end AXIS_DESCR
 /begin AXIS_DESCR STD_AXIS zff_atsys._.iSignale._.obj.sig_m_t UMR_NM__1_1_0_S5_S3 10 -200 1300 DEPOSIT ABSOLUTE /end AXIS_DESCR
/end CHARACTERISTIC
/begin CHARACTERISTIC KF_PKABFOLNACHRSSP87 "Schaltdruck KAB fuer verkuerzte Folgeschaltung" MAP 0x1B59FC ZF_kf_si16_S5_S3 12.75 UMR_BAR__1_1000_0_S5_S3 0 12.75
 /begin AXIS_DESCR STD_AXIS NO_INPUT_QUANTITY UMR_U_MIN_32_1_0_S5_S3 8 0 8160 DEPOSIT ABSOLUTE /end AXIS_DESCR
 /begin AXIS_DESCR STD_AXIS zff_atsys._.iSignale._.obj.sig_m_t UMR_NM__1_1_0_S5_S3 10 -200 1300 DEPOSIT ABSOLUTE /end AXIS_DESCR
/end CHARACTERISTIC
/begin CHARACTERISTIC KF_PKABFOLNACHRSSPORT21 "Schaltdruck KAB fuer verkuerzte Folgeschaltung" MAP 0x1B33C4 ZF_kf_si16_S5_S3 12.75 UMR_BAR__1_1000_0_S5_S3 0 12.75
 /begin AXIS_DESCR STD_AXIS NO_INPUT_QUANTITY UMR_U_MIN_32_1_0_S5_S3 8 0 8160 DEPOSIT ABSOLUTE /end AXIS_DESCR
 /begin AXIS_DESCR STD_AXIS zff_atsys._.iSignale._.obj.sig_m_t UMR_NM__1_1_0_S5_S3 10 -200 1300 DEPOSIT ABSOLUTE /end AXIS_DESCR
/end CHARACTERISTIC
/begin CHARACTERISTIC KF_PKABFOLNACHRSSPORT32 "Schaltdruck KAB fuer verkuerzte Folgeschaltung" MAP 0x1B3AD0 ZF_kf_si16_S5_S3 12.75 UMR_BAR__1_1000_0_S5_S3 0 12.75
 /begin AXIS_DESCR STD_AXIS NO_INPUT_QUANTITY UMR_U_MIN_32_1_0_S5_S3 8 0 8160 DEPOSIT ABSOLUTE /end AXIS_DESCR
 /begin AXIS_DESCR STD_AXIS zff_atsys._.iSignale._.obj.sig_m_t UMR_NM__1_1_0_S5_S3 10 -200 1300 DEPOSIT ABSOLUTE /end AXIS_DESCR
/end CHARACTERISTIC
/begin CHARACTERISTIC KF_PKABFOLNACHRSSPORT43 "Schaltdruck KAB fuer verkuerzte Folgeschaltung" MAP 0x1B4030 ZF_kf_si16_S5_S3 12.75 UMR_BAR__1_1000_0_S5_S3 0 12.75
 /begin AXIS_DESCR STD_AXIS NO_INPUT_QUANTITY UMR_U_MIN_32_1_0_S5_S3 8 0 8160 DEPOSIT ABSOLUTE /end AXIS_DESCR
 /begin AXIS_DESCR STD_AXIS zff_atsys._.iSignale._.obj.sig_m_t UMR_NM__1_1_0_S5_S3 10 -200 1300 DEPOSIT ABSOLUTE /end AXIS_DESCR
/end CHARACTERISTIC
/begin CHARACTERISTIC KF_PKABFOLNACHRSSPORT54 "Schaltdruck KAB fuer verkuerzte Folgeschaltung" MAP 0x1B45A4 ZF_kf_si16_S5_S3 12.75 UMR_BAR__1_1000_0_S5_S3 0 12.75
 /begin AXIS_DESCR STD_AXIS NO_INPUT_QUANTITY UMR_U_MIN_32_1_0_S5_S3 8 0 8160 DEPOSIT ABSOLUTE /end AXIS_DESCR
 /begin AXIS_DESCR STD_AXIS zff_atsys._.iSignale._.obj.sig_m_t UMR_NM__1_1_0_S5_S3 10 -200 1300 DEPOSIT ABSOLUTE /end AXIS_DESCR
/end CHARACTERISTIC
/begin CHARACTERISTIC KF_PKABFOLNACHRSSPORT65 "Schaltdruck KAB fuer verkuerzte Folgeschaltung" MAP 0x1B4CB0 ZF_kf_si16_S5_S3 12.75 UMR_BAR__1_1000_0_S5_S3 0 12.75
 /begin AXIS_DESCR STD_AXIS NO_INPUT_QUANTITY UMR_U_MIN_32_1_0_S5_S3 8 0 8160 DEPOSIT ABSOLUTE /end AXIS_DESCR
 /begin AXIS_DESCR STD_AXIS zff_atsys._.iSignale._.obj.sig_m_t UMR_NM__1_1_0_S5_S3 10 -200 1300 DEPOSIT ABSOLUTE /end AXIS_DESCR
/end CHARACTERISTIC
/begin CHARACTERISTIC KF_PKABFOLNACHRSSPORT76 "Schaltdruck KAB fuer verkuerzte Folgeschaltung" MAP 0x1B53BC ZF_kf_si16_S5_S3 12.75 UMR_BAR__1_1000_0_S5_S3 0 12.75
 /begin AXIS_DESCR STD_AXIS NO_INPUT_QUANTITY UMR_U_MIN_32_1_0_S5_S3 8 0 8160 DEPOSIT ABSOLUTE /end AXIS_DESCR
 /begin AXIS_DESCR STD_AXIS zff_atsys._.iSignale._.obj.sig_m_t UMR_NM__1_1_0_S5_S3 10 -200 1300 DEPOSIT ABSOLUTE /end AXIS_DESCR
/end CHARACTERISTIC
/begin CHARACTERISTIC KF_PKABFOLNACHRSSPORT87 "Schaltdruck KAB fuer verkuerzte Folgeschaltung" MAP 0x1B5AC8 ZF_kf_si16_S5_S3 12.75 UMR_BAR__1_1000_0_S5_S3 0 12.75
 /begin AXIS_DESCR STD_AXIS NO_INPUT_QUANTITY UMR_U_MIN_32_1_0_S5_S3 8 0 8160 DEPOSIT ABSOLUTE /end AXIS_DESCR
 /begin AXIS_DESCR STD_AXIS zff_atsys._.iSignale._.obj.sig_m_t UMR_NM__1_1_0_S5_S3 10 -200 1300 DEPOSIT ABSOLUTE /end AXIS_DESCR
/end CHARACTERISTIC
/begin CHARACTERISTIC KF_POGANDNMOTNTV2_1 "Druckoffset f(n_mot-n_t, timer) 2. NKL Gangauslegen" MAP 0x1B5E4C ZF_kf_si16_S5_S3 12.75 UMR_BAR__1_1000_0_S5_S3 -6.4 6.35
 /begin AXIS_DESCR STD_AXIS iSasZentr.nd_nmot_nt UMR_U_MIN_1_1_0_S5_S3 4 -16320 16320 DEPOSIT ABSOLUTE /end AXIS_DESCR
 /begin AXIS_DESCR STD_AXIS NO_INPUT_QUANTITY UMR_MSEC__10_1_0_S5_S3 4 0 2540 DEPOSIT ABSOLUTE /end AXIS_DESCR
/end CHARACTERISTIC
/begin CHARACTERISTIC KF_POGANDNMOTNTV2_2 "Druckoffset f(n_mot-n_t, timer) 2. NKL Gangauslegen" MAP 0x1B5F6C ZF_kf_si16_S5_S3 12.75 UMR_BAR__1_1000_0_S5_S3 -6.4 6.35
 /begin AXIS_DESCR STD_AXIS iSasZentr.nd_nmot_nt UMR_U_MIN_1_1_0_S5_S3 4 -16320 16320 DEPOSIT ABSOLUTE /end AXIS_DESCR
 /begin AXIS_DESCR STD_AXIS NO_INPUT_QUANTITY UMR_MSEC__10_1_0_S5_S3 4 0 2540 DEPOSIT ABSOLUTE /end AXIS_DESCR
/end CHARACTERISTIC
/begin CHARACTERISTIC KF_POGANDNMOTNTV2_3 "Druckoffset f(n_mot-n_t, timer) 2. NKL Gangauslegen" MAP 0x1B608C ZF_kf_si16_S5_S3 12.75 UMR_BAR__1_1000_0_S5_S3 -6.4 6.35
 /begin AXIS_DESCR STD_AXIS iSasZentr.nd_nmot_nt UMR_U_MIN_1_1_0_S5_S3 4 -16320 16320 DEPOSIT ABSOLUTE /end AXIS_DESCR
 /begin AXIS_DESCR STD_AXIS NO_INPUT_QUANTITY UMR_MSEC__10_1_0_S5_S3 4 0 2540 DEPOSIT ABSOLUTE /end AXIS_DESCR
/end CHARACTERISTIC
/begin CHARACTERISTIC KF_POGANDNMOTNTV2_4 "Druckoffset f(n_mot-n_t, timer) 2. NKL Gangauslegen" MAP 0x1B61AC ZF_kf_si16_S5_S3 12.75 UMR_BAR__1_1000_0_S5_S3 -6.4 6.35
 /begin AXIS_DESCR STD_AXIS iSasZentr.nd_nmot_nt UMR_U_MIN_1_1_0_S5_S3 4 -16320 16320 DEPOSIT ABSOLUTE /end AXIS_DESCR
 /begin AXIS_DESCR STD_AXIS NO_INPUT_QUANTITY UMR_MSEC__10_1_0_S5_S3 4 0 2540 DEPOSIT ABSOLUTE /end AXIS_DESCR
/end CHARACTERISTIC
/begin CHARACTERISTIC KF_POGANDNMOTNTV2_5 "Druckoffset f(n_mot-n_t, timer) 2. NKL Gangauslegen" MAP 0x1B62CC ZF_kf_si16_S5_S3 12.75 UMR_BAR__1_1000_0_S5_S3 -6.4 6.35
 /begin AXIS_DESCR STD_AXIS iSasZentr.nd_nmot_nt UMR_U_MIN_1_1_0_S5_S3 4 -16320 16320 DEPOSIT ABSOLUTE /end AXIS_DESCR
 /begin AXIS_DESCR STD_AXIS NO_INPUT_QUANTITY UMR_MSEC__10_1_0_S5_S3 4 0 2540 DEPOSIT ABSOLUTE /end AXIS_DESCR
/end CHARACTERISTIC
/begin CHARACTERISTIC KF_POGANDNMOTNTV2_6 "Druckoffset f(n_mot-n_t, timer) 2. NKL Gangauslegen" MAP 0x1B63EC ZF_kf_si16_S5_S3 12.75 UMR_BAR__1_1000_0_S5_S3 -6.4 6.35
 /begin AXIS_DESCR STD_AXIS iSasZentr.nd_nmot_nt UMR_U_MIN_1_1_0_S5_S3 4 -16320 16320 DEPOSIT ABSOLUTE /end AXIS_DESCR
 /begin AXIS_DESCR STD_AXIS NO_INPUT_QUANTITY UMR_MSEC__10_1_0_S5_S3 4 0 2540 DEPOSIT ABSOLUTE /end AXIS_DESCR
/end CHARACTERISTIC
/begin CHARACTERISTIC KF_POGANDNMOTNTV2_7 "Druckoffset f(n_mot-n_t, timer) 2. NKL Gangauslegen" MAP 0x1B650C ZF_kf_si16_S5_S3 12.75 UMR_BAR__1_1000_0_S5_S3 -6.4 6.35
 /begin AXIS_DESCR STD_AXIS iSasZentr.nd_nmot_nt UMR_U_MIN_1_1_0_S5_S3 4 -16320 16320 DEPOSIT ABSOLUTE /end AXIS_DESCR
 /begin AXIS_DESCR STD_AXIS NO_INPUT_QUANTITY UMR_MSEC__10_1_0_S5_S3 4 0 2540 DEPOSIT ABSOLUTE /end AXIS_DESCR
/end CHARACTERISTIC
/begin CHARACTERISTIC KF_POGANDNMOTNTV2_8 "Druckoffset f(n_mot-n_t, timer) 2. NKL Gangauslegen" MAP 0x1B662C ZF_kf_si16_S5_S3 12.75 UMR_BAR__1_1000_0_S5_S3 -6.4 6.35
 /begin AXIS_DESCR STD_AXIS iSasZentr.nd_nmot_nt UMR_U_MIN_1_1_0_S5_S3 4 -16320 16320 DEPOSIT ABSOLUTE /end AXIS_DESCR
 /begin AXIS_DESCR STD_AXIS NO_INPUT_QUANTITY UMR_MSEC__10_1_0_S5_S3 4 0 2540 DEPOSIT ABSOLUTE /end AXIS_DESCR
/end CHARACTERISTIC
/begin CHARACTERISTIC KF_POGANDNMOTNTV2_R "Druckoffset f(n_mot-n_t, timer) 2. NKL Gangauslegen" MAP 0x1B5D2C ZF_kf_si16_S5_S3 12.75 UMR_BAR__1_1000_0_S5_S3 -6.4 6.35
 /begin AXIS_DESCR STD_AXIS iSasZentr.nd_nmot_nt UMR_U_MIN_1_1_0_S5_S3 4 -16320 16320 DEPOSIT ABSOLUTE /end AXIS_DESCR
 /begin AXIS_DESCR STD_AXIS NO_INPUT_QUANTITY UMR_MSEC__10_1_0_S5_S3 4 0 2540 DEPOSIT ABSOLUTE /end AXIS_DESCR
/end CHARACTERISTIC
/begin CHARACTERISTIC KF_POGANDNMOTNT_1 "Druckoffset f(n_mot-n_t, timer) Gangauslegen" MAP 0x1B5ED4 ZF_kf_si16_S5_S3 12.75 UMR_BAR__1_1000_0_S5_S3 -6.4 6.35
 /begin AXIS_DESCR STD_AXIS iSasZentr.nd_nmot_nt UMR_U_MIN_1_1_0_S5_S3 4 -16320 16320 DEPOSIT ABSOLUTE /end AXIS_DESCR
 /begin AXIS_DESCR STD_AXIS NO_INPUT_QUANTITY UMR_MSEC__10_1_0_S5_S3 4 0 2540 DEPOSIT ABSOLUTE /end AXIS_DESCR
/end CHARACTERISTIC
/begin CHARACTERISTIC KF_POGANDNMOTNT_2 "Druckoffset f(n_mot-n_t, timer) Gangauslegen" MAP 0x1B5FF4 ZF_kf_si16_S5_S3 12.75 UMR_BAR__1_1000_0_S5_S3 -6.4 6.35
 /begin AXIS_DESCR STD_AXIS iSasZentr.nd_nmot_nt UMR_U_MIN_1_1_0_S5_S3 4 -16320 16320 DEPOSIT ABSOLUTE /end AXIS_DESCR
 /begin AXIS_DESCR STD_AXIS NO_INPUT_QUANTITY UMR_MSEC__10_1_0_S5_S3 4 0 2540 DEPOSIT ABSOLUTE /end AXIS_DESCR
/end CHARACTERISTIC
/begin CHARACTERISTIC KF_POGANDNMOTNT_3 "Druckoffset f(n_mot-n_t, timer) Gangauslegen" MAP 0x1B6114 ZF_kf_si16_S5_S3 12.75 UMR_BAR__1_1000_0_S5_S3 -6.4 6.35
 /begin AXIS_DESCR STD_AXIS iSasZentr.nd_nmot_nt UMR_U_MIN_1_1_0_S5_S3 4 -16320 16320 DEPOSIT ABSOLUTE /end AXIS_DESCR
 /begin AXIS_DESCR STD_AXIS NO_INPUT_QUANTITY UMR_MSEC__10_1_0_S5_S3 4 0 2540 DEPOSIT ABSOLUTE /end AXIS_DESCR
/end CHARACTERISTIC
/begin CHARACTERISTIC KF_POGANDNMOTNT_4 "Druckoffset f(n_mot-n_t, timer) Gangauslegen" MAP 0x1B6234 ZF_kf_si16_S5_S3 12.75 UMR_BAR__1_1000_0_S5_S3 -6.4 6.35
 /begin AXIS_DESCR STD_AXIS iSasZentr.nd_nmot_nt UMR_U_MIN_1_1_0_S5_S3 4 -16320 16320 DEPOSIT ABSOLUTE /end AXIS_DESCR
 /begin AXIS_DESCR STD_AXIS NO_INPUT_QUANTITY UMR_MSEC__10_1_0_S5_S3 4 0 2540 DEPOSIT ABSOLUTE /end AXIS_DESCR
/end CHARACTERISTIC
/begin CHARACTERISTIC KF_POGANDNMOTNT_5 "Druckoffset f(n_mot-n_t, timer) Gangauslegen" MAP 0x1B6354 ZF_kf_si16_S5_S3 12.75 UMR_BAR__1_1000_0_S5_S3 -6.4 6.35
 /begin AXIS_DESCR STD_AXIS iSasZentr.nd_nmot_nt UMR_U_MIN_1_1_0_S5_S3 4 -16320 16320 DEPOSIT ABSOLUTE /end AXIS_DESCR
 /begin AXIS_DESCR STD_AXIS NO_INPUT_QUANTITY UMR_MSEC__10_1_0_S5_S3 4 0 2540 DEPOSIT ABSOLUTE /end AXIS_DESCR
/end CHARACTERISTIC
/begin CHARACTERISTIC KF_POGANDNMOTNT_6 "Druckoffset f(n_mot-n_t, timer) Gangauslegen" MAP 0x1B6474 ZF_kf_si16_S5_S3 12.75 UMR_BAR__1_1000_0_S5_S3 -6.4 6.35
 /begin AXIS_DESCR STD_AXIS iSasZentr.nd_nmot_nt UMR_U_MIN_1_1_0_S5_S3 4 -16320 16320 DEPOSIT ABSOLUTE /end AXIS_DESCR
 /begin AXIS_DESCR STD_AXIS NO_INPUT_QUANTITY UMR_MSEC__10_1_0_S5_S3 4 0 2540 DEPOSIT ABSOLUTE /end AXIS_DESCR
/end CHARACTERISTIC
/begin CHARACTERISTIC KF_POGANDNMOTNT_7 "Druckoffset f(n_mot-n_t, timer) Gangauslegen" MAP 0x1B6594 ZF_kf_si16_S5_S3 12.75 UMR_BAR__1_1000_0_S5_S3 -6.4 6.35
 /begin AXIS_DESCR STD_AXIS iSasZentr.nd_nmot_nt UMR_U_MIN_1_1_0_S5_S3 4 -16320 16320 DEPOSIT ABSOLUTE /end AXIS_DESCR
 /begin AXIS_DESCR STD_AXIS NO_INPUT_QUANTITY UMR_MSEC__10_1_0_S5_S3 4 0 2540 DEPOSIT ABSOLUTE /end AXIS_DESCR
/end CHARACTERISTIC
/begin CHARACTERISTIC KF_POGANDNMOTNT_8 "Druckoffset f(n_mot-n_t, timer) Gangauslegen" MAP 0x1B66B4 ZF_kf_si16_S5_S3 12.75 UMR_BAR__1_1000_0_S5_S3 -6.4 6.35
 /begin AXIS_DESCR STD_AXIS iSasZentr.nd_nmot_nt UMR_U_MIN_1_1_0_S5_S3 4 -16320 16320 DEPOSIT ABSOLUTE /end AXIS_DESCR
 /begin AXIS_DESCR STD_AXIS NO_INPUT_QUANTITY UMR_MSEC__10_1_0_S5_S3 4 0 2540 DEPOSIT ABSOLUTE /end AXIS_DESCR
/end CHARACTERISTIC
/begin CHARACTERISTIC KF_POGANDNMOTNT_R "Druckoffset f(n_mot-n_t, timer) Gangauslegen" MAP 0x1B5DB4 ZF_kf_si16_S5_S3 12.75 UMR_BAR__1_1000_0_S5_S3 -6.4 6.35
 /begin AXIS_DESCR STD_AXIS iSasZentr.nd_nmot_nt UMR_U_MIN_1_1_0_S5_S3 4 -16320 16320 DEPOSIT ABSOLUTE /end AXIS_DESCR
 /begin AXIS_DESCR STD_AXIS NO_INPUT_QUANTITY UMR_MSEC__10_1_0_S5_S3 4 0 2540 DEPOSIT ABSOLUTE /end AXIS_DESCR
/end CHARACTERISTIC
/begin CHARACTERISTIC KF_PRAGACGV2_1 "Druckkennfeld abschaltende Kupplung 2. NKL Gangauslegen" MAP 0x1B5E84 ZF_kf_si16_S5_S3 12.75 UMR_BAR__1_1000_0_S5_S3 0 12.75
 /begin AXIS_DESCR STD_AXIS zff_atsys._.iSignale._.obj.sig_c_getr UMR_GRADC__1_1_M40_S5_S3 5 -40 150 DEPOSIT ABSOLUTE /end AXIS_DESCR
 /begin AXIS_DESCR STD_AXIS NO_INPUT_QUANTITY UMR_MSEC__10_1_0_S5_S3 5 0 2540 DEPOSIT ABSOLUTE /end AXIS_DESCR
/end CHARACTERISTIC
/begin CHARACTERISTIC KF_PRAGACGV2_2 "Druckkennfeld abschaltende Kupplung 2. NKL Gangauslegen" MAP 0x1B5FA4 ZF_kf_si16_S5_S3 12.75 UMR_BAR__1_1000_0_S5_S3 0 12.75
 /begin AXIS_DESCR STD_AXIS zff_atsys._.iSignale._.obj.sig_c_getr UMR_GRADC__1_1_M40_S5_S3 5 -40 150 DEPOSIT ABSOLUTE /end AXIS_DESCR
 /begin AXIS_DESCR STD_AXIS NO_INPUT_QUANTITY UMR_MSEC__10_1_0_S5_S3 5 0 2540 DEPOSIT ABSOLUTE /end AXIS_DESCR
/end CHARACTERISTIC
/begin CHARACTERISTIC KF_PRAGACGV2_3 "Druckkennfeld abschaltende Kupplung 2. NKL Gangauslegen" MAP 0x1B60C4 ZF_kf_si16_S5_S3 12.75 UMR_BAR__1_1000_0_S5_S3 0 12.75
 /begin AXIS_DESCR STD_AXIS zff_atsys._.iSignale._.obj.sig_c_getr UMR_GRADC__1_1_M40_S5_S3 5 -40 150 DEPOSIT ABSOLUTE /end AXIS_DESCR
 /begin AXIS_DESCR STD_AXIS NO_INPUT_QUANTITY UMR_MSEC__10_1_0_S5_S3 5 0 2540 DEPOSIT ABSOLUTE /end AXIS_DESCR
/end CHARACTERISTIC
/begin CHARACTERISTIC KF_PRAGACGV2_4 "Druckkennfeld abschaltende Kupplung 2. NKL Gangauslegen" MAP 0x1B61E4 ZF_kf_si16_S5_S3 12.75 UMR_BAR__1_1000_0_S5_S3 0 12.75
 /begin AXIS_DESCR STD_AXIS zff_atsys._.iSignale._.obj.sig_c_getr UMR_GRADC__1_1_M40_S5_S3 5 -40 150 DEPOSIT ABSOLUTE /end AXIS_DESCR
 /begin AXIS_DESCR STD_AXIS NO_INPUT_QUANTITY UMR_MSEC__10_1_0_S5_S3 5 0 2540 DEPOSIT ABSOLUTE /end AXIS_DESCR
/end CHARACTERISTIC
/begin CHARACTERISTIC KF_PRAGACGV2_5 "Druckkennfeld abschaltende Kupplung 2. NKL Gangauslegen" MAP 0x1B6304 ZF_kf_si16_S5_S3 12.75 UMR_BAR__1_1000_0_S5_S3 0 12.75
 /begin AXIS_DESCR STD_AXIS zff_atsys._.iSignale._.obj.sig_c_getr UMR_GRADC__1_1_M40_S5_S3 5 -40 150 DEPOSIT ABSOLUTE /end AXIS_DESCR
 /begin AXIS_DESCR STD_AXIS NO_INPUT_QUANTITY UMR_MSEC__10_1_0_S5_S3 5 0 2540 DEPOSIT ABSOLUTE /end AXIS_DESCR
/end CHARACTERISTIC
/begin CHARACTERISTIC KF_PRAGACGV2_6 "Druckkennfeld abschaltende Kupplung 2. NKL Gangauslegen" MAP 0x1B6424 ZF_kf_si16_S5_S3 12.75 UMR_BAR__1_1000_0_S5_S3 0 12.75
 /begin AXIS_DESCR STD_AXIS zff_atsys._.iSignale._.obj.sig_c_getr UMR_GRADC__1_1_M40_S5_S3 5 -40 150 DEPOSIT ABSOLUTE /end AXIS_DESCR
 /begin AXIS_DESCR STD_AXIS NO_INPUT_QUANTITY UMR_MSEC__10_1_0_S5_S3 5 0 2540 DEPOSIT ABSOLUTE /end AXIS_DESCR
/end CHARACTERISTIC
/begin CHARACTERISTIC KF_PRAGACGV2_7 "Druckkennfeld abschaltende Kupplung 2. NKL Gangauslegen" MAP 0x1B6544 ZF_kf_si16_S5_S3 12.75 UMR_BAR__1_1000_0_S5_S3 0 12.75
 /begin AXIS_DESCR STD_AXIS zff_atsys._.iSignale._.obj.sig_c_getr UMR_GRADC__1_1_M40_S5_S3 5 -40 150 DEPOSIT ABSOLUTE /end AXIS_DESCR
 /begin AXIS_DESCR STD_AXIS NO_INPUT_QUANTITY UMR_MSEC__10_1_0_S5_S3 5 0 2540 DEPOSIT ABSOLUTE /end AXIS_DESCR
/end CHARACTERISTIC
/begin CHARACTERISTIC KF_PRAGACGV2_8 "Druckkennfeld abschaltende Kupplung 2. NKL Gangauslegen" MAP 0x1B6664 ZF_kf_si16_S5_S3 12.75 UMR_BAR__1_1000_0_S5_S3 0 12.75
 /begin AXIS_DESCR STD_AXIS zff_atsys._.iSignale._.obj.sig_c_getr UMR_GRADC__1_1_M40_S5_S3 5 -40 150 DEPOSIT ABSOLUTE /end AXIS_DESCR
 /begin AXIS_DESCR STD_AXIS NO_INPUT_QUANTITY UMR_MSEC__10_1_0_S5_S3 5 0 2540 DEPOSIT ABSOLUTE /end AXIS_DESCR
/end CHARACTERISTIC
/begin CHARACTERISTIC KF_PRAGACGV2_R "Druckkennfeld abschaltende Kupplung 2. NKL Gangauslegen" MAP 0x1B5D64 ZF_kf_si16_S5_S3 12.75 UMR_BAR__1_1000_0_S5_S3 0 12.75
 /begin AXIS_DESCR STD_AXIS zff_atsys._.iSignale._.obj.sig_c_getr UMR_GRADC__1_1_M40_S5_S3 5 -40 150 DEPOSIT ABSOLUTE /end AXIS_DESCR
 /begin AXIS_DESCR STD_AXIS NO_INPUT_QUANTITY UMR_MSEC__10_1_0_S5_S3 5 0 2540 DEPOSIT ABSOLUTE /end AXIS_DESCR
/end CHARACTERISTIC
/begin CHARACTERISTIC KF_PRAGACG_1 "Druckkennfeld abschaltende Kupplung Gangauslegen" MAP 0x1B5F0C ZF_kf_si16_S5_S3 12.75 UMR_BAR__1_1000_0_S5_S3 -6.4 6.35
 /begin AXIS_DESCR STD_AXIS zff_atsys._.iSignale._.obj.sig_c_getr UMR_GRADC__1_1_M40_S5_S3 5 -40 150 DEPOSIT ABSOLUTE /end AXIS_DESCR
 /begin AXIS_DESCR STD_AXIS NO_INPUT_QUANTITY UMR_MSEC__10_1_0_S5_S3 5 0 2540 DEPOSIT ABSOLUTE /end AXIS_DESCR
/end CHARACTERISTIC
/begin CHARACTERISTIC KF_PRAGACG_2 "Druckkennfeld abschaltende Kupplung Gangauslegen" MAP 0x1B602C ZF_kf_si16_S5_S3 12.75 UMR_BAR__1_1000_0_S5_S3 -6.4 6.35
 /begin AXIS_DESCR STD_AXIS zff_atsys._.iSignale._.obj.sig_c_getr UMR_GRADC__1_1_M40_S5_S3 5 -40 150 DEPOSIT ABSOLUTE /end AXIS_DESCR
 /begin AXIS_DESCR STD_AXIS NO_INPUT_QUANTITY UMR_MSEC__10_1_0_S5_S3 5 0 2540 DEPOSIT ABSOLUTE /end AXIS_DESCR
/end CHARACTERISTIC
/begin CHARACTERISTIC KF_PRAGACG_3 "Druckkennfeld abschaltende Kupplung Gangauslegen" MAP 0x1B614C ZF_kf_si16_S5_S3 12.75 UMR_BAR__1_1000_0_S5_S3 -6.4 6.35
 /begin AXIS_DESCR STD_AXIS zff_atsys._.iSignale._.obj.sig_c_getr UMR_GRADC__1_1_M40_S5_S3 5 -40 150 DEPOSIT ABSOLUTE /end AXIS_DESCR
 /begin AXIS_DESCR STD_AXIS NO_INPUT_QUANTITY UMR_MSEC__10_1_0_S5_S3 5 0 2540 DEPOSIT ABSOLUTE /end AXIS_DESCR
/end CHARACTERISTIC
/begin CHARACTERISTIC KF_PRAGACG_4 "Druckkennfeld abschaltende Kupplung Gangauslegen" MAP 0x1B626C ZF_kf_si16_S5_S3 12.75 UMR_BAR__1_1000_0_S5_S3 -6.4 6.35
 /begin AXIS_DESCR STD_AXIS zff_atsys._.iSignale._.obj.sig_c_getr UMR_GRADC__1_1_M40_S5_S3 5 -40 150 DEPOSIT ABSOLUTE /end AXIS_DESCR
 /begin AXIS_DESCR STD_AXIS NO_INPUT_QUANTITY UMR_MSEC__10_1_0_S5_S3 5 0 2540 DEPOSIT ABSOLUTE /end AXIS_DESCR
/end CHARACTERISTIC
/begin CHARACTERISTIC KF_PRAGACG_5 "Druckkennfeld abschaltende Kupplung Gangauslegen" MAP 0x1B638C ZF_kf_si16_S5_S3 12.75 UMR_BAR__1_1000_0_S5_S3 -6.4 6.35
 /begin AXIS_DESCR STD_AXIS zff_atsys._.iSignale._.obj.sig_c_getr UMR_GRADC__1_1_M40_S5_S3 5 -40 150 DEPOSIT ABSOLUTE /end AXIS_DESCR
 /begin AXIS_DESCR STD_AXIS NO_INPUT_QUANTITY UMR_MSEC__10_1_0_S5_S3 5 0 2540 DEPOSIT ABSOLUTE /end AXIS_DESCR
/end CHARACTERISTIC
/begin CHARACTERISTIC KF_PRAGACG_6 "Druckkennfeld abschaltende Kupplung Gangauslegen" MAP 0x1B64AC ZF_kf_si16_S5_S3 12.75 UMR_BAR__1_1000_0_S5_S3 -6.4 6.35
 /begin AXIS_DESCR STD_AXIS zff_atsys._.iSignale._.obj.sig_c_getr UMR_GRADC__1_1_M40_S5_S3 5 -40 150 DEPOSIT ABSOLUTE /end AXIS_DESCR
 /begin AXIS_DESCR STD_AXIS NO_INPUT_QUANTITY UMR_MSEC__10_1_0_S5_S3 5 0 2540 DEPOSIT ABSOLUTE /end AXIS_DESCR
/end CHARACTERISTIC
/begin CHARACTERISTIC KF_PRAGACG_7 "Druckkennfeld abschaltende Kupplung Gangauslegen" MAP 0x1B65CC ZF_kf_si16_S5_S3 12.75 UMR_BAR__1_1000_0_S5_S3 -6.4 6.35
 /begin AXIS_DESCR STD_AXIS zff_atsys._.iSignale._.obj.sig_c_getr UMR_GRADC__1_1_M40_S5_S3 5 -40 150 DEPOSIT ABSOLUTE /end AXIS_DESCR
 /begin AXIS_DESCR STD_AXIS NO_INPUT_QUANTITY UMR_MSEC__10_1_0_S5_S3 5 0 2540 DEPOSIT ABSOLUTE /end AXIS_DESCR
/end CHARACTERISTIC
/begin CHARACTERISTIC KF_PRAGACG_8 "Druckkennfeld abschaltende Kupplung Gangauslegen" MAP 0x1B66EC ZF_kf_si16_S5_S3 12.75 UMR_BAR__1_1000_0_S5_S3 -6.4 6.35
 /begin AXIS_DESCR STD_AXIS zff_atsys._.iSignale._.obj.sig_c_getr UMR_GRADC__1_1_M40_S5_S3 5 -40 150 DEPOSIT ABSOLUTE /end AXIS_DESCR
 /begin AXIS_DESCR STD_AXIS NO_INPUT_QUANTITY UMR_MSEC__10_1_0_S5_S3 5 0 2540 DEPOSIT ABSOLUTE /end AXIS_DESCR
/end CHARACTERISTIC
/begin CHARACTERISTIC KF_PRAGACG_R "Druckkennfeld abschaltende Kupplung Gangauslegen" MAP 0x1B5DEC ZF_kf_si16_S5_S3 12.75 UMR_BAR__1_1000_0_S5_S3 -6.4 6.35
 /begin AXIS_DESCR STD_AXIS zff_atsys._.iSignale._.obj.sig_c_getr UMR_GRADC__1_1_M40_S5_S3 5 -40 150 DEPOSIT ABSOLUTE /end AXIS_DESCR
 /begin AXIS_DESCR STD_AXIS NO_INPUT_QUANTITY UMR_MSEC__10_1_0_S5_S3 5 0 2540 DEPOSIT ABSOLUTE /end AXIS_DESCR
/end CHARACTERISTIC
/begin CHARACTERISTIC KF_THKABMTCG12 "Zeitoffset Ende Haltephase KAB fuer HS" MAP 0x1B686C ZF_kf_ui8_S5_S3 2000 UMR_MSEC__10_1_M128_S5_S3 -1000 1000
 /begin AXIS_DESCR STD_AXIS zff_atsys._.iSignale._.obj.sig_m_t8 UMR_NM__6_1_M34_S5_S3 8 -204 1326 DEPOSIT ABSOLUTE /end AXIS_DESCR
 /begin AXIS_DESCR STD_AXIS zff_atsys._.iSignale._.obj.sig_c_getr UMR_GRADC__1_1_M40_S5_S3 8 -40 150 DEPOSIT ABSOLUTE /end AXIS_DESCR
/end CHARACTERISTIC
/begin CHARACTERISTIC KF_THKABMTCG12_EL "Zeitoffset Ende Haltephase KAB fuer HS" MAP 0x1B68C4 ZF_kf_ui8_S5_S3 2000 UMR_MSEC__10_1_M128_S5_S3 -1000 1000
 /begin AXIS_DESCR STD_AXIS zff_atsys._.iSignale._.obj.sig_m_t8 UMR_NM__6_1_M34_S5_S3 8 -204 1326 DEPOSIT ABSOLUTE /end AXIS_DESCR
 /begin AXIS_DESCR STD_AXIS zff_atsys._.iSignale._.obj.sig_c_getr UMR_GRADC__1_1_M40_S5_S3 8 -40 150 DEPOSIT ABSOLUTE /end AXIS_DESCR
/end CHARACTERISTIC
/begin CHARACTERISTIC KF_THKABMTCG23 "Zeitoffset Ende Haltephase KAB fuer HS" MAP 0x1B6A4C ZF_kf_ui8_S5_S3 2000 UMR_MSEC__10_1_M128_S5_S3 -1000 1000
 /begin AXIS_DESCR STD_AXIS zff_atsys._.iSignale._.obj.sig_m_t8 UMR_NM__6_1_M34_S5_S3 8 -204 1326 DEPOSIT ABSOLUTE /end AXIS_DESCR
 /begin AXIS_DESCR STD_AXIS zff_atsys._.iSignale._.obj.sig_c_getr UMR_GRADC__1_1_M40_S5_S3 8 -40 150 DEPOSIT ABSOLUTE /end AXIS_DESCR
/end CHARACTERISTIC
/begin CHARACTERISTIC KF_THKABMTCG23_EL "Zeitoffset Ende Haltephase KAB fuer HS" MAP 0x1B6AA4 ZF_kf_ui8_S5_S3 2000 UMR_MSEC__10_1_M128_S5_S3 -1000 1000
 /begin AXIS_DESCR STD_AXIS zff_atsys._.iSignale._.obj.sig_m_t8 UMR_NM__6_1_M34_S5_S3 8 -204 1326 DEPOSIT ABSOLUTE /end AXIS_DESCR
 /begin AXIS_DESCR STD_AXIS zff_atsys._.iSignale._.obj.sig_c_getr UMR_GRADC__1_1_M40_S5_S3 8 -40 150 DEPOSIT ABSOLUTE /end AXIS_DESCR
/end CHARACTERISTIC
/begin CHARACTERISTIC KF_THKABMTCG34 "Zeitoffset Ende Haltephase KAB fuer HS" MAP 0x1B6C2C ZF_kf_ui8_S5_S3 2000 UMR_MSEC__10_1_M128_S5_S3 -1000 1000
 /begin AXIS_DESCR STD_AXIS zff_atsys._.iSignale._.obj.sig_m_t8 UMR_NM__6_1_M34_S5_S3 8 -204 1326 DEPOSIT ABSOLUTE /end AXIS_DESCR
 /begin AXIS_DESCR STD_AXIS zff_atsys._.iSignale._.obj.sig_c_getr UMR_GRADC__1_1_M40_S5_S3 8 -40 150 DEPOSIT ABSOLUTE /end AXIS_DESCR
/end CHARACTERISTIC
/begin CHARACTERISTIC KF_THKABMTCG34_EL "Zeitoffset Ende Haltephase KAB fuer HS" MAP 0x1B6C84 ZF_kf_ui8_S5_S3 2000 UMR_MSEC__10_1_M128_S5_S3 -1000 1000
 /begin AXIS_DESCR STD_AXIS zff_atsys._.iSignale._.obj.sig_m_t8 UMR_NM__6_1_M34_S5_S3 8 -204 1326 DEPOSIT ABSOLUTE /end AXIS_DESCR
 /begin AXIS_DESCR STD_AXIS zff_atsys._.iSignale._.obj.sig_c_getr UMR_GRADC__1_1_M40_S5_S3 8 -40 150 DEPOSIT ABSOLUTE /end AXIS_DESCR
/end CHARACTERISTIC
/begin CHARACTERISTIC KF_THKABMTCG45 "Zeitoffset Ende Haltephase KAB fuer HS" MAP 0x1B6E0C ZF_kf_ui8_S5_S3 2000 UMR_MSEC__10_1_M128_S5_S3 -1000 1000
 /begin AXIS_DESCR STD_AXIS zff_atsys._.iSignale._.obj.sig_m_t8 UMR_NM__6_1_M34_S5_S3 8 -204 1326 DEPOSIT ABSOLUTE /end AXIS_DESCR
 /begin AXIS_DESCR STD_AXIS zff_atsys._.iSignale._.obj.sig_c_getr UMR_GRADC__1_1_M40_S5_S3 8 -40 150 DEPOSIT ABSOLUTE /end AXIS_DESCR
/end CHARACTERISTIC
/begin CHARACTERISTIC KF_THKABMTCG45_EL "Zeitoffset Ende Haltephase KAB fuer HS" MAP 0x1B6E64 ZF_kf_ui8_S5_S3 2000 UMR_MSEC__10_1_M128_S5_S3 -1000 1000
 /begin AXIS_DESCR STD_AXIS zff_atsys._.iSignale._.obj.sig_m_t8 UMR_NM__6_1_M34_S5_S3 8 -204 1326 DEPOSIT ABSOLUTE /end AXIS_DESCR
 /begin AXIS_DESCR STD_AXIS zff_atsys._.iSignale._.obj.sig_c_getr UMR_GRADC__1_1_M40_S5_S3 8 -40 150 DEPOSIT ABSOLUTE /end AXIS_DESCR
/end CHARACTERISTIC
/begin CHARACTERISTIC KF_THKABMTCG56 "Zeitoffset Ende Haltephase KAB fuer HS" MAP 0x1B6FEC ZF_kf_ui8_S5_S3 2000 UMR_MSEC__10_1_M128_S5_S3 -1000 1000
 /begin AXIS_DESCR STD_AXIS zff_atsys._.iSignale._.obj.sig_m_t8 UMR_NM__6_1_M34_S5_S3 8 -204 1326 DEPOSIT ABSOLUTE /end AXIS_DESCR
 /begin AXIS_DESCR STD_AXIS zff_atsys._.iSignale._.obj.sig_c_getr UMR_GRADC__1_1_M40_S5_S3 8 -40 150 DEPOSIT ABSOLUTE /end AXIS_DESCR
/end CHARACTERISTIC
/begin CHARACTERISTIC KF_THKABMTCG56_EL "Zeitoffset Ende Haltephase KAB fuer HS" MAP 0x1B7044 ZF_kf_ui8_S5_S3 2000 UMR_MSEC__10_1_M128_S5_S3 -1000 1000
 /begin AXIS_DESCR STD_AXIS zff_atsys._.iSignale._.obj.sig_m_t8 UMR_NM__6_1_M34_S5_S3 8 -204 1326 DEPOSIT ABSOLUTE /end AXIS_DESCR
 /begin AXIS_DESCR STD_AXIS zff_atsys._.iSignale._.obj.sig_c_getr UMR_GRADC__1_1_M40_S5_S3 8 -40 150 DEPOSIT ABSOLUTE /end AXIS_DESCR
/end CHARACTERISTIC
/begin CHARACTERISTIC KF_THKABMTCG67 "Zeitoffset Ende Haltephase KAB fuer HS" MAP 0x1B71CC ZF_kf_ui8_S5_S3 2000 UMR_MSEC__10_1_M128_S5_S3 -1000 1000
 /begin AXIS_DESCR STD_AXIS zff_atsys._.iSignale._.obj.sig_m_t8 UMR_NM__6_1_M34_S5_S3 8 -204 1326 DEPOSIT ABSOLUTE /end AXIS_DESCR
 /begin AXIS_DESCR STD_AXIS zff_atsys._.iSignale._.obj.sig_c_getr UMR_GRADC__1_1_M40_S5_S3 8 -40 150 DEPOSIT ABSOLUTE /end AXIS_DESCR
/end CHARACTERISTIC
/begin CHARACTERISTIC KF_THKABMTCG67_EL "Zeitoffset Ende Haltephase KAB fuer HS" MAP 0x1B7224 ZF_kf_ui8_S5_S3 2000 UMR_MSEC__10_1_M128_S5_S3 -1000 1000
 /begin AXIS_DESCR STD_AXIS zff_atsys._.iSignale._.obj.sig_m_t8 UMR_NM__6_1_M34_S5_S3 8 -204 1326 DEPOSIT ABSOLUTE /end AXIS_DESCR
 /begin AXIS_DESCR STD_AXIS zff_atsys._.iSignale._.obj.sig_c_getr UMR_GRADC__1_1_M40_S5_S3 8 -40 150 DEPOSIT ABSOLUTE /end AXIS_DESCR
/end CHARACTERISTIC
/begin CHARACTERISTIC KF_THKABMTCG78 "Zeitoffset Ende Haltephase KAB fuer HS" MAP 0x1B73AC ZF_kf_ui8_S5_S3 2000 UMR_MSEC__10_1_M128_S5_S3 -1000 1000
 /begin AXIS_DESCR STD_AXIS zff_atsys._.iSignale._.obj.sig_m_t8 UMR_NM__6_1_M34_S5_S3 8 -204 1326 DEPOSIT ABSOLUTE /end AXIS_DESCR
 /begin AXIS_DESCR STD_AXIS zff_atsys._.iSignale._.obj.sig_c_getr UMR_GRADC__1_1_M40_S5_S3 8 -40 150 DEPOSIT ABSOLUTE /end AXIS_DESCR
/end CHARACTERISTIC
/begin CHARACTERISTIC KF_THKABMTCG78_EL "Zeitoffset Ende Haltephase KAB fuer HS" MAP 0x1B7404 ZF_kf_ui8_S5_S3 2000 UMR_MSEC__10_1_M128_S5_S3 -1000 1000
 /begin AXIS_DESCR STD_AXIS zff_atsys._.iSignale._.obj.sig_m_t8 UMR_NM__6_1_M34_S5_S3 8 -204 1326 DEPOSIT ABSOLUTE /end AXIS_DESCR
 /begin AXIS_DESCR STD_AXIS zff_atsys._.iSignale._.obj.sig_c_getr UMR_GRADC__1_1_M40_S5_S3 8 -40 150 DEPOSIT ABSOLUTE /end AXIS_DESCR
/end CHARACTERISTIC
/begin CHARACTERISTIC KF_THKABMTCGESTART12 "Zeitoffset Ende Haltephase KAB fuer HS" MAP 0x1B2D54 ZF_kf_ui8_S5_S3 2000 UMR_MSEC__10_1_M128_S5_S3 -1000 1000
 /begin AXIS_DESCR STD_AXIS zff_atsys._.iSignale._.obj.sig_m_t8 UMR_NM__6_1_M34_S5_S3 8 -204 1326 DEPOSIT ABSOLUTE /end AXIS_DESCR
 /begin AXIS_DESCR STD_AXIS zff_atsys._.iSignale._.obj.sig_c_getr UMR_GRADC__1_1_M40_S5_S3 8 -40 150 DEPOSIT ABSOLUTE /end AXIS_DESCR
/end CHARACTERISTIC
/begin CHARACTERISTIC KF_THKABMTCGSP12 "Zeitoffset Ende Haltephase KAB fuer HS" MAP 0x1B74FC ZF_kf_ui8_S5_S3 2000 UMR_MSEC__10_1_M128_S5_S3 -1000 1000
 /begin AXIS_DESCR STD_AXIS zff_atsys._.iSignale._.obj.sig_m_t8 UMR_NM__6_1_M34_S5_S3 8 -204 1326 DEPOSIT ABSOLUTE /end AXIS_DESCR
 /begin AXIS_DESCR STD_AXIS zff_atsys._.iSignale._.obj.sig_c_getr UMR_GRADC__1_1_M40_S5_S3 8 -40 150 DEPOSIT ABSOLUTE /end AXIS_DESCR
/end CHARACTERISTIC
/begin CHARACTERISTIC KF_THKABMTCGSP23 "Zeitoffset Ende Haltephase KAB fuer HS" MAP 0x1B75F4 ZF_kf_ui8_S5_S3 2000 UMR_MSEC__10_1_M128_S5_S3 -1000 1000
 /begin AXIS_DESCR STD_AXIS zff_atsys._.iSignale._.obj.sig_m_t8 UMR_NM__6_1_M34_S5_S3 8 -204 1326 DEPOSIT ABSOLUTE /end AXIS_DESCR
 /begin AXIS_DESCR STD_AXIS zff_atsys._.iSignale._.obj.sig_c_getr UMR_GRADC__1_1_M40_S5_S3 8 -40 150 DEPOSIT ABSOLUTE /end AXIS_DESCR
/end CHARACTERISTIC
/begin CHARACTERISTIC KF_THKABMTCGSP34 "Zeitoffset Ende Haltephase KAB fuer HS" MAP 0x1B76EC ZF_kf_ui8_S5_S3 2000 UMR_MSEC__10_1_M128_S5_S3 -1000 1000
 /begin AXIS_DESCR STD_AXIS zff_atsys._.iSignale._.obj.sig_m_t8 UMR_NM__6_1_M34_S5_S3 8 -204 1326 DEPOSIT ABSOLUTE /end AXIS_DESCR
 /begin AXIS_DESCR STD_AXIS zff_atsys._.iSignale._.obj.sig_c_getr UMR_GRADC__1_1_M40_S5_S3 8 -40 150 DEPOSIT ABSOLUTE /end AXIS_DESCR
/end CHARACTERISTIC
/begin CHARACTERISTIC KF_THKABMTCGSP45 "Zeitoffset Ende Haltephase KAB fuer HS" MAP 0x1B77E4 ZF_kf_ui8_S5_S3 2000 UMR_MSEC__10_1_M128_S5_S3 -1000 1000
 /begin AXIS_DESCR STD_AXIS zff_atsys._.iSignale._.obj.sig_m_t8 UMR_NM__6_1_M34_S5_S3 8 -204 1326 DEPOSIT ABSOLUTE /end AXIS_DESCR
 /begin AXIS_DESCR STD_AXIS zff_atsys._.iSignale._.obj.sig_c_getr UMR_GRADC__1_1_M40_S5_S3 8 -40 150 DEPOSIT ABSOLUTE /end AXIS_DESCR
/end CHARACTERISTIC
/begin CHARACTERISTIC KF_THKABMTCGSP56 "Zeitoffset Ende Haltephase KAB fuer HS" MAP 0x1B78DC ZF_kf_ui8_S5_S3 2000 UMR_MSEC__10_1_M128_S5_S3 -1000 1000
 /begin AXIS_DESCR STD_AXIS zff_atsys._.iSignale._.obj.sig_m_t8 UMR_NM__6_1_M34_S5_S3 8 -204 1326 DEPOSIT ABSOLUTE /end AXIS_DESCR
 /begin AXIS_DESCR STD_AXIS zff_atsys._.iSignale._.obj.sig_c_getr UMR_GRADC__1_1_M40_S5_S3 8 -40 150 DEPOSIT ABSOLUTE /end AXIS_DESCR
/end CHARACTERISTIC
/begin CHARACTERISTIC KF_THKABMTCGSP67 "Zeitoffset Ende Haltephase KAB fuer HS" MAP 0x1B79D4 ZF_kf_ui8_S5_S3 2000 UMR_MSEC__10_1_M128_S5_S3 -1000 1000
 /begin AXIS_DESCR STD_AXIS zff_atsys._.iSignale._.obj.sig_m_t8 UMR_NM__6_1_M34_S5_S3 8 -204 1326 DEPOSIT ABSOLUTE /end AXIS_DESCR
 /begin AXIS_DESCR STD_AXIS zff_atsys._.iSignale._.obj.sig_c_getr UMR_GRADC__1_1_M40_S5_S3 8 -40 150 DEPOSIT ABSOLUTE /end AXIS_DESCR
/end CHARACTERISTIC
/begin CHARACTERISTIC KF_THKABMTCGSP78 "Zeitoffset Ende Haltephase KAB fuer HS" MAP 0x1B7ACC ZF_kf_ui8_S5_S3 2000 UMR_MSEC__10_1_M128_S5_S3 -1000 1000
 /begin AXIS_DESCR STD_AXIS zff_atsys._.iSignale._.obj.sig_m_t8 UMR_NM__6_1_M34_S5_S3 8 -204 1326 DEPOSIT ABSOLUTE /end AXIS_DESCR
 /begin AXIS_DESCR STD_AXIS zff_atsys._.iSignale._.obj.sig_c_getr UMR_GRADC__1_1_M40_S5_S3 8 -40 150 DEPOSIT ABSOLUTE /end AXIS_DESCR
/end CHARACTERISTIC
/begin CHARACTERISTIC KF_TPKABMTCG12 "Zeitoffset Ende Rampe auf Schaltdruck KAB fuer HS" MAP 0x1B674C ZF_kf_ui8_S5_S3 2000 UMR_MSEC__10_1_M128_S5_S3 -1000 1000
 /begin AXIS_DESCR STD_AXIS zff_atsys._.iSignale._.obj.sig_m_t8 UMR_NM__6_1_M34_S5_S3 8 -204 1326 DEPOSIT ABSOLUTE /end AXIS_DESCR
 /begin AXIS_DESCR STD_AXIS zff_atsys._.iSignale._.obj.sig_c_getr UMR_GRADC__1_1_M40_S5_S3 8 -40 150 DEPOSIT ABSOLUTE /end AXIS_DESCR
/end CHARACTERISTIC
/begin CHARACTERISTIC KF_TPKABMTCG12_EL "Zeitoffset Ende Rampe auf Schaltdruck KAB fuer HS" MAP 0x1B67A4 ZF_kf_ui8_S5_S3 2000 UMR_MSEC__10_1_M128_S5_S3 -1000 1000
 /begin AXIS_DESCR STD_AXIS zff_atsys._.iSignale._.obj.sig_m_t8 UMR_NM__6_1_M34_S5_S3 8 -204 1326 DEPOSIT ABSOLUTE /end AXIS_DESCR
 /begin AXIS_DESCR STD_AXIS zff_atsys._.iSignale._.obj.sig_c_getr UMR_GRADC__1_1_M40_S5_S3 8 -40 150 DEPOSIT ABSOLUTE /end AXIS_DESCR
/end CHARACTERISTIC
/begin CHARACTERISTIC KF_TPKABMTCG23 "Zeitoffset Ende Rampe auf Schaltdruck KAB fuer HS" MAP 0x1B692C ZF_kf_ui8_S5_S3 2000 UMR_MSEC__10_1_M128_S5_S3 -1000 1000
 /begin AXIS_DESCR STD_AXIS zff_atsys._.iSignale._.obj.sig_m_t8 UMR_NM__6_1_M34_S5_S3 8 -204 1326 DEPOSIT ABSOLUTE /end AXIS_DESCR
 /begin AXIS_DESCR STD_AXIS zff_atsys._.iSignale._.obj.sig_c_getr UMR_GRADC__1_1_M40_S5_S3 8 -40 150 DEPOSIT ABSOLUTE /end AXIS_DESCR
/end CHARACTERISTIC
/begin CHARACTERISTIC KF_TPKABMTCG23_EL "Zeitoffset Ende Rampe auf Schaltdruck KAB fuer HS" MAP 0x1B6984 ZF_kf_ui8_S5_S3 2000 UMR_MSEC__10_1_M128_S5_S3 -1000 1000
 /begin AXIS_DESCR STD_AXIS zff_atsys._.iSignale._.obj.sig_m_t8 UMR_NM__6_1_M34_S5_S3 8 -204 1326 DEPOSIT ABSOLUTE /end AXIS_DESCR
 /begin AXIS_DESCR STD_AXIS zff_atsys._.iSignale._.obj.sig_c_getr UMR_GRADC__1_1_M40_S5_S3 8 -40 150 DEPOSIT ABSOLUTE /end AXIS_DESCR
/end CHARACTERISTIC
/begin CHARACTERISTIC KF_TPKABMTCG34 "Zeitoffset Ende Rampe auf Schaltdruck KAB fuer HS" MAP 0x1B6B0C ZF_kf_ui8_S5_S3 2000 UMR_MSEC__10_1_M128_S5_S3 -1000 1000
 /begin AXIS_DESCR STD_AXIS zff_atsys._.iSignale._.obj.sig_m_t8 UMR_NM__6_1_M34_S5_S3 8 -204 1326 DEPOSIT ABSOLUTE /end AXIS_DESCR
 /begin AXIS_DESCR STD_AXIS zff_atsys._.iSignale._.obj.sig_c_getr UMR_GRADC__1_1_M40_S5_S3 8 -40 150 DEPOSIT ABSOLUTE /end AXIS_DESCR
/end CHARACTERISTIC
/begin CHARACTERISTIC KF_TPKABMTCG34_EL "Zeitoffset Ende Rampe auf Schaltdruck KAB fuer HS" MAP 0x1B6B64 ZF_kf_ui8_S5_S3 2000 UMR_MSEC__10_1_M128_S5_S3 -1000 1000
 /begin AXIS_DESCR STD_AXIS zff_atsys._.iSignale._.obj.sig_m_t8 UMR_NM__6_1_M34_S5_S3 8 -204 1326 DEPOSIT ABSOLUTE /end AXIS_DESCR
 /begin AXIS_DESCR STD_AXIS zff_atsys._.iSignale._.obj.sig_c_getr UMR_GRADC__1_1_M40_S5_S3 8 -40 150 DEPOSIT ABSOLUTE /end AXIS_DESCR
/end CHARACTERISTIC
/begin CHARACTERISTIC KF_TPKABMTCG45 "Zeitoffset Ende Rampe auf Schaltdruck KAB fuer HS" MAP 0x1B6CEC ZF_kf_ui8_S5_S3 2000 UMR_MSEC__10_1_M128_S5_S3 -1000 1000
 /begin AXIS_DESCR STD_AXIS zff_atsys._.iSignale._.obj.sig_m_t8 UMR_NM__6_1_M34_S5_S3 8 -204 1326 DEPOSIT ABSOLUTE /end AXIS_DESCR
 /begin AXIS_DESCR STD_AXIS zff_atsys._.iSignale._.obj.sig_c_getr UMR_GRADC__1_1_M40_S5_S3 8 -40 150 DEPOSIT ABSOLUTE /end AXIS_DESCR
/end CHARACTERISTIC
/begin CHARACTERISTIC KF_TPKABMTCG45_EL "Zeitoffset Ende Rampe auf Schaltdruck KAB fuer HS" MAP 0x1B6D44 ZF_kf_ui8_S5_S3 2000 UMR_MSEC__10_1_M128_S5_S3 -1000 1000
 /begin AXIS_DESCR STD_AXIS zff_atsys._.iSignale._.obj.sig_m_t8 UMR_NM__6_1_M34_S5_S3 8 -204 1326 DEPOSIT ABSOLUTE /end AXIS_DESCR
 /begin AXIS_DESCR STD_AXIS zff_atsys._.iSignale._.obj.sig_c_getr UMR_GRADC__1_1_M40_S5_S3 8 -40 150 DEPOSIT ABSOLUTE /end AXIS_DESCR
/end CHARACTERISTIC
/begin CHARACTERISTIC KF_TPKABMTCG56 "Zeitoffset Ende Rampe auf Schaltdruck KAB fuer HS" MAP 0x1B6ECC ZF_kf_ui8_S5_S3 2000 UMR_MSEC__10_1_M128_S5_S3 -1000 1000
 /begin AXIS_DESCR STD_AXIS zff_atsys._.iSignale._.obj.sig_m_t8 UMR_NM__6_1_M34_S5_S3 8 -204 1326 DEPOSIT ABSOLUTE /end AXIS_DESCR
 /begin AXIS_DESCR STD_AXIS zff_atsys._.iSignale._.obj.sig_c_getr UMR_GRADC__1_1_M40_S5_S3 8 -40 150 DEPOSIT ABSOLUTE /end AXIS_DESCR
/end CHARACTERISTIC
/begin CHARACTERISTIC KF_TPKABMTCG56_EL "Zeitoffset Ende Rampe auf Schaltdruck KAB fuer HS" MAP 0x1B6F24 ZF_kf_ui8_S5_S3 2000 UMR_MSEC__10_1_M128_S5_S3 -1000 1000
 /begin AXIS_DESCR STD_AXIS zff_atsys._.iSignale._.obj.sig_m_t8 UMR_NM__6_1_M34_S5_S3 8 -204 1326 DEPOSIT ABSOLUTE /end AXIS_DESCR
 /begin AXIS_DESCR STD_AXIS zff_atsys._.iSignale._.obj.sig_c_getr UMR_GRADC__1_1_M40_S5_S3 8 -40 150 DEPOSIT ABSOLUTE /end AXIS_DESCR
/end CHARACTERISTIC
/begin CHARACTERISTIC KF_TPKABMTCG67 "Zeitoffset Ende Rampe auf Schaltdruck KAB fuer HS" MAP 0x1B70AC ZF_kf_ui8_S5_S3 2000 UMR_MSEC__10_1_M128_S5_S3 -1000 1000
 /begin AXIS_DESCR STD_AXIS zff_atsys._.iSignale._.obj.sig_m_t8 UMR_NM__6_1_M34_S5_S3 8 -204 1326 DEPOSIT ABSOLUTE /end AXIS_DESCR
 /begin AXIS_DESCR STD_AXIS zff_atsys._.iSignale._.obj.sig_c_getr UMR_GRADC__1_1_M40_S5_S3 8 -40 150 DEPOSIT ABSOLUTE /end AXIS_DESCR
/end CHARACTERISTIC
/begin CHARACTERISTIC KF_TPKABMTCG67_EL "Zeitoffset Ende Rampe auf Schaltdruck KAB fuer HS" MAP 0x1B7104 ZF_kf_ui8_S5_S3 2000 UMR_MSEC__10_1_M128_S5_S3 -1000 1000
 /begin AXIS_DESCR STD_AXIS zff_atsys._.iSignale._.obj.sig_m_t8 UMR_NM__6_1_M34_S5_S3 8 -204 1326 DEPOSIT ABSOLUTE /end AXIS_DESCR
 /begin AXIS_DESCR STD_AXIS zff_atsys._.iSignale._.obj.sig_c_getr UMR_GRADC__1_1_M40_S5_S3 8 -40 150 DEPOSIT ABSOLUTE /end AXIS_DESCR
/end CHARACTERISTIC
/begin CHARACTERISTIC KF_TPKABMTCG78 "Zeitoffset Ende Rampe auf Schaltdruck KAB fuer HS" MAP 0x1B728C ZF_kf_ui8_S5_S3 2000 UMR_MSEC__10_1_M128_S5_S3 -1000 1000
 /begin AXIS_DESCR STD_AXIS zff_atsys._.iSignale._.obj.sig_m_t8 UMR_NM__6_1_M34_S5_S3 8 -204 1326 DEPOSIT ABSOLUTE /end AXIS_DESCR
 /begin AXIS_DESCR STD_AXIS zff_atsys._.iSignale._.obj.sig_c_getr UMR_GRADC__1_1_M40_S5_S3 8 -40 150 DEPOSIT ABSOLUTE /end AXIS_DESCR
/end CHARACTERISTIC
/begin CHARACTERISTIC KF_TPKABMTCG78_EL "Zeitoffset Ende Rampe auf Schaltdruck KAB fuer HS" MAP 0x1B72E4 ZF_kf_ui8_S5_S3 2000 UMR_MSEC__10_1_M128_S5_S3 -1000 1000
 /begin AXIS_DESCR STD_AXIS zff_atsys._.iSignale._.obj.sig_m_t8 UMR_NM__6_1_M34_S5_S3 8 -204 1326 DEPOSIT ABSOLUTE /end AXIS_DESCR
 /begin AXIS_DESCR STD_AXIS zff_atsys._.iSignale._.obj.sig_c_getr UMR_GRADC__1_1_M40_S5_S3 8 -40 150 DEPOSIT ABSOLUTE /end AXIS_DESCR
/end CHARACTERISTIC
/begin CHARACTERISTIC KF_TPKABMTCGESTART12 "Zeitoffset Ende Rampe auf Schaltdruck KAB fuer HS" MAP 0x1B2DAC ZF_kf_ui8_S5_S3 2000 UMR_MSEC__10_1_M128_S5_S3 -1000 1000
 /begin AXIS_DESCR STD_AXIS zff_atsys._.iSignale._.obj.sig_m_t8 UMR_NM__6_1_M34_S5_S3 8 -204 1326 DEPOSIT ABSOLUTE /end AXIS_DESCR
 /begin AXIS_DESCR STD_AXIS zff_atsys._.iSignale._.obj.sig_c_getr UMR_GRADC__1_1_M40_S5_S3 8 -40 150 DEPOSIT ABSOLUTE /end AXIS_DESCR
/end CHARACTERISTIC
/begin CHARACTERISTIC KF_TPKABMTCGSP12 "Zeitoffset Ende Rampe auf Schaltdruck KAB fuer HS" MAP 0x1B746C ZF_kf_ui8_S5_S3 2000 UMR_MSEC__10_1_M128_S5_S3 -1000 1000
 /begin AXIS_DESCR STD_AXIS zff_atsys._.iSignale._.obj.sig_m_t8 UMR_NM__6_1_M34_S5_S3 8 -204 1326 DEPOSIT ABSOLUTE /end AXIS_DESCR
 /begin AXIS_DESCR STD_AXIS zff_atsys._.iSignale._.obj.sig_c_getr UMR_GRADC__1_1_M40_S5_S3 8 -40 150 DEPOSIT ABSOLUTE /end AXIS_DESCR
/end CHARACTERISTIC
/begin CHARACTERISTIC KF_TPKABMTCGSP23 "Zeitoffset Ende Rampe auf Schaltdruck KAB fuer HS" MAP 0x1B7564 ZF_kf_ui8_S5_S3 2000 UMR_MSEC__10_1_M128_S5_S3 -1000 1000
 /begin AXIS_DESCR STD_AXIS zff_atsys._.iSignale._.obj.sig_m_t8 UMR_NM__6_1_M34_S5_S3 8 -204 1326 DEPOSIT ABSOLUTE /end AXIS_DESCR
 /begin AXIS_DESCR STD_AXIS zff_atsys._.iSignale._.obj.sig_c_getr UMR_GRADC__1_1_M40_S5_S3 8 -40 150 DEPOSIT ABSOLUTE /end AXIS_DESCR
/end CHARACTERISTIC
/begin CHARACTERISTIC KF_TPKABMTCGSP34 "Zeitoffset Ende Rampe auf Schaltdruck KAB fuer HS" MAP 0x1B765C ZF_kf_ui8_S5_S3 2000 UMR_MSEC__10_1_M128_S5_S3 -1000 1000
 /begin AXIS_DESCR STD_AXIS zff_atsys._.iSignale._.obj.sig_m_t8 UMR_NM__6_1_M34_S5_S3 8 -204 1326 DEPOSIT ABSOLUTE /end AXIS_DESCR
 /begin AXIS_DESCR STD_AXIS zff_atsys._.iSignale._.obj.sig_c_getr UMR_GRADC__1_1_M40_S5_S3 8 -40 150 DEPOSIT ABSOLUTE /end AXIS_DESCR
/end CHARACTERISTIC
/begin CHARACTERISTIC KF_TPKABMTCGSP45 "Zeitoffset Ende Rampe auf Schaltdruck KAB fuer HS" MAP 0x1B7754 ZF_kf_ui8_S5_S3 2000 UMR_MSEC__10_1_M128_S5_S3 -1000 1000
 /begin AXIS_DESCR STD_AXIS zff_atsys._.iSignale._.obj.sig_m_t8 UMR_NM__6_1_M34_S5_S3 8 -204 1326 DEPOSIT ABSOLUTE /end AXIS_DESCR
 /begin AXIS_DESCR STD_AXIS zff_atsys._.iSignale._.obj.sig_c_getr UMR_GRADC__1_1_M40_S5_S3 8 -40 150 DEPOSIT ABSOLUTE /end AXIS_DESCR
/end CHARACTERISTIC
/begin CHARACTERISTIC KF_TPKABMTCGSP56 "Zeitoffset Ende Rampe auf Schaltdruck KAB fuer HS" MAP 0x1B784C ZF_kf_ui8_S5_S3 2000 UMR_MSEC__10_1_M128_S5_S3 -1000 1000
 /begin AXIS_DESCR STD_AXIS zff_atsys._.iSignale._.obj.sig_m_t8 UMR_NM__6_1_M34_S5_S3 8 -204 1326 DEPOSIT ABSOLUTE /end AXIS_DESCR
 /begin AXIS_DESCR STD_AXIS zff_atsys._.iSignale._.obj.sig_c_getr UMR_GRADC__1_1_M40_S5_S3 8 -40 150 DEPOSIT ABSOLUTE /end AXIS_DESCR
/end CHARACTERISTIC
/begin CHARACTERISTIC KF_TPKABMTCGSP67 "Zeitoffset Ende Rampe auf Schaltdruck KAB fuer HS" MAP 0x1B7944 ZF_kf_ui8_S5_S3 2000 UMR_MSEC__10_1_M128_S5_S3 -1000 1000
 /begin AXIS_DESCR STD_AXIS zff_atsys._.iSignale._.obj.sig_m_t8 UMR_NM__6_1_M34_S5_S3 8 -204 1326 DEPOSIT ABSOLUTE /end AXIS_DESCR
 /begin AXIS_DESCR STD_AXIS zff_atsys._.iSignale._.obj.sig_c_getr UMR_GRADC__1_1_M40_S5_S3 8 -40 150 DEPOSIT ABSOLUTE /end AXIS_DESCR
/end CHARACTERISTIC
/begin CHARACTERISTIC KF_TPKABMTCGSP78 "Zeitoffset Ende Rampe auf Schaltdruck KAB fuer HS" MAP 0x1B7A3C ZF_kf_ui8_S5_S3 2000 UMR_MSEC__10_1_M128_S5_S3 -1000 1000
 /begin AXIS_DESCR STD_AXIS zff_atsys._.iSignale._.obj.sig_m_t8 UMR_NM__6_1_M34_S5_S3 8 -204 1326 DEPOSIT ABSOLUTE /end AXIS_DESCR
 /begin AXIS_DESCR STD_AXIS zff_atsys._.iSignale._.obj.sig_c_getr UMR_GRADC__1_1_M40_S5_S3 8 -40 150 DEPOSIT ABSOLUTE /end AXIS_DESCR
/end CHARACTERISTIC
/begin CHARACTERISTIC KI_GLSKAB32 "Integralfaktor PID-Regler GLS" VALUE 0x1D87F8 ZF_kw_ui16_S5_S3 10000 UMR_MBARMINSEC_10MSEC_1_1_0_S5_S3 0 10000 /end CHARACTERISTIC
/begin CHARACTERISTIC KI_GLSKAB32_EL "Integralfaktor PID-Regler GLS" VALUE 0x1D87FA ZF_kw_ui16_S5_S3 10000 UMR_MBARMINSEC_10MSEC_1_1_0_S5_S3 0 10000 /end CHARACTERISTIC
/begin CHARACTERISTIC KI_GLSKAB43 "Integralfaktor PID-Regler GLS" VALUE 0x1D881C ZF_kw_ui16_S5_S3 10000 UMR_MBARMINSEC_10MSEC_1_1_0_S5_S3 0 10000 /end CHARACTERISTIC
/begin CHARACTERISTIC KI_GLSKAB43_EL "Integralfaktor PID-Regler GLS" VALUE 0x1D881E ZF_kw_ui16_S5_S3 10000 UMR_MBARMINSEC_10MSEC_1_1_0_S5_S3 0 10000 /end CHARACTERISTIC
/begin CHARACTERISTIC KI_GLSKAB54 "Integralfaktor PID-Regler GLS" VALUE 0x1D8840 ZF_kw_ui16_S5_S3 10000 UMR_MBARMINSEC_10MSEC_1_1_0_S5_S3 0 10000 /end CHARACTERISTIC
/begin CHARACTERISTIC KI_GLSKAB54_EL "Integralfaktor PID-Regler GLS" VALUE 0x1D8842 ZF_kw_ui16_S5_S3 10000 UMR_MBARMINSEC_10MSEC_1_1_0_S5_S3 0 10000 /end CHARACTERISTIC
/begin CHARACTERISTIC KI_GLSKAB65 "Integralfaktor PID-Regler GLS" VALUE 0x1D8864 ZF_kw_ui16_S5_S3 10000 UMR_MBARMINSEC_10MSEC_1_1_0_S5_S3 0 10000 /end CHARACTERISTIC
/begin CHARACTERISTIC KI_GLSKAB65_EL "Integralfaktor PID-Regler GLS" VALUE 0x1D8866 ZF_kw_ui16_S5_S3 10000 UMR_MBARMINSEC_10MSEC_1_1_0_S5_S3 0 10000 /end CHARACTERISTIC
/begin CHARACTERISTIC KI_GLSKAB76 "Integralfaktor PID-Regler GLS" VALUE 0x1D8888 ZF_kw_ui16_S5_S3 10000 UMR_MBARMINSEC_10MSEC_1_1_0_S5_S3 0 10000 /end CHARACTERISTIC
/begin CHARACTERISTIC KI_GLSKAB76_EL "Integralfaktor PID-Regler GLS" VALUE 0x1D888A ZF_kw_ui16_S5_S3 10000 UMR_MBARMINSEC_10MSEC_1_1_0_S5_S3 0 10000 /end CHARACTERISTIC
/begin CHARACTERISTIC KI_GLSKAB87 "Integralfaktor PID-Regler GLS" VALUE 0x1D88AC ZF_kw_ui16_S5_S3 10000 UMR_MBARMINSEC_10MSEC_1_1_0_S5_S3 0 10000 /end CHARACTERISTIC
/begin CHARACTERISTIC KI_GLSKAB87_EL "Integralfaktor PID-Regler GLS" VALUE 0x1D88AE ZF_kw_ui16_S5_S3 10000 UMR_MBARMINSEC_10MSEC_1_1_0_S5_S3 0 10000 /end CHARACTERISTIC
/begin CHARACTERISTIC KI_GLSKABSP42 "Integralfaktor PID-Regler GLS" VALUE 0x1D88F4 ZF_kw_ui16_S5_S3 10000 UMR_MBARMINSEC_10MSEC_1_1_0_S5_S3 0 10000 /end CHARACTERISTIC
/begin CHARACTERISTIC KI_GLSKABSP42_EL "Integralfaktor PID-Regler GLS" VALUE 0x1D88F6 ZF_kw_ui16_S5_S3 10000 UMR_MBARMINSEC_10MSEC_1_1_0_S5_S3 0 10000 /end CHARACTERISTIC
/begin CHARACTERISTIC KI_GLSKABSP51 "Integralfaktor PID-Regler GLS" VALUE 0x1D8918 ZF_kw_ui16_S5_S3 10000 UMR_MBARMINSEC_10MSEC_1_1_0_S5_S3 0 10000 /end CHARACTERISTIC
/begin CHARACTERISTIC KI_GLSKABSP51_EL "Integralfaktor PID-Regler GLS" VALUE 0x1D891A ZF_kw_ui16_S5_S3 10000 UMR_MBARMINSEC_10MSEC_1_1_0_S5_S3 0 10000 /end CHARACTERISTIC
/begin CHARACTERISTIC KI_GLSKABSP53 "Integralfaktor PID-Regler GLS" VALUE 0x1D893C ZF_kw_ui16_S5_S3 10000 UMR_MBARMINSEC_10MSEC_1_1_0_S5_S3 0 10000 /end CHARACTERISTIC
/begin CHARACTERISTIC KI_GLSKABSP53_EL "Integralfaktor PID-Regler GLS" VALUE 0x1D893E ZF_kw_ui16_S5_S3 10000 UMR_MBARMINSEC_10MSEC_1_1_0_S5_S3 0 10000 /end CHARACTERISTIC
/begin CHARACTERISTIC KI_GLSKABSP63 "Integralfaktor PID-Regler GLS" VALUE 0x1D8960 ZF_kw_ui16_S5_S3 10000 UMR_MBARMINSEC_10MSEC_1_1_0_S5_S3 0 10000 /end CHARACTERISTIC
/begin CHARACTERISTIC KI_GLSKABSP63_EL "Integralfaktor PID-Regler GLS" VALUE 0x1D8962 ZF_kw_ui16_S5_S3 10000 UMR_MBARMINSEC_10MSEC_1_1_0_S5_S3 0 10000 /end CHARACTERISTIC
/begin CHARACTERISTIC KI_GLSKABSP64 "Integralfaktor PID-Regler GLS" VALUE 0x1D8984 ZF_kw_ui16_S5_S3 10000 UMR_MBARMINSEC_10MSEC_1_1_0_S5_S3 0 10000 /end CHARACTERISTIC
/begin CHARACTERISTIC KI_GLSKABSP64_EL "Integralfaktor PID-Regler GLS" VALUE 0x1D8986 ZF_kw_ui16_S5_S3 10000 UMR_MBARMINSEC_10MSEC_1_1_0_S5_S3 0 10000 /end CHARACTERISTIC
/begin CHARACTERISTIC KI_GLSKABSP71 "Integralfaktor PID-Regler GLS" VALUE 0x1D89A8 ZF_kw_ui16_S5_S3 10000 UMR_MBARMINSEC_10MSEC_1_1_0_S5_S3 0 10000 /end CHARACTERISTIC
/begin CHARACTERISTIC KI_GLSKABSP71_EL "Integralfaktor PID-Regler GLS" VALUE 0x1D89AA ZF_kw_ui16_S5_S3 10000 UMR_MBARMINSEC_10MSEC_1_1_0_S5_S3 0 10000 /end CHARACTERISTIC
/begin CHARACTERISTIC KI_GLSKABSP75 "Integralfaktor PID-Regler GLS" VALUE 0x1D89CC ZF_kw_ui16_S5_S3 10000 UMR_MBARMINSEC_10MSEC_1_1_0_S5_S3 0 10000 /end CHARACTERISTIC
/begin CHARACTERISTIC KI_GLSKABSP75_EL "Integralfaktor PID-Regler GLS" VALUE 0x1D89CE ZF_kw_ui16_S5_S3 10000 UMR_MBARMINSEC_10MSEC_1_1_0_S5_S3 0 10000 /end CHARACTERISTIC
/begin CHARACTERISTIC KI_GLSKABSP82 "Integralfaktor PID-Regler GLS" VALUE 0x1D89F0 ZF_kw_ui16_S5_S3 10000 UMR_MBARMINSEC_10MSEC_1_1_0_S5_S3 0 10000 /end CHARACTERISTIC
/begin CHARACTERISTIC KI_GLSKABSP82_EL "Integralfaktor PID-Regler GLS" VALUE 0x1D89F2 ZF_kw_ui16_S5_S3 10000 UMR_MBARMINSEC_10MSEC_1_1_0_S5_S3 0 10000 /end CHARACTERISTIC
/begin CHARACTERISTIC KI_GLSKABSP84 "Integralfaktor PID-Regler GLS" VALUE 0x1D8A14 ZF_kw_ui16_S5_S3 10000 UMR_MBARMINSEC_10MSEC_1_1_0_S5_S3 0 10000 /end CHARACTERISTIC
/begin CHARACTERISTIC KI_GLSKABSP84_EL "Integralfaktor PID-Regler GLS" VALUE 0x1D8A16 ZF_kw_ui16_S5_S3 10000 UMR_MBARMINSEC_10MSEC_1_1_0_S5_S3 0 10000 /end CHARACTERISTIC
/begin CHARACTERISTIC KI_GLSKABSP86 "Integralfaktor PID-Regler GLS" VALUE 0x1D8A38 ZF_kw_ui16_S5_S3 10000 UMR_MBARMINSEC_10MSEC_1_1_0_S5_S3 0 10000 /end CHARACTERISTIC
/begin CHARACTERISTIC KI_GLSKABSP86_EL "Integralfaktor PID-Regler GLS" VALUE 0x1D8A3A ZF_kw_ui16_S5_S3 10000 UMR_MBARMINSEC_10MSEC_1_1_0_S5_S3 0 10000 /end CHARACTERISTIC
/begin CHARACTERISTIC KI_GLSKZU32 "I-Faktor PID-Regler GLS" VALUE 0x1D87E0 ZF_kw_ui16_S5_S3 10000 UMR_MBARMINSEC_10MSEC_1_1_0_S5_S3 0 10000 /end CHARACTERISTIC
/begin CHARACTERISTIC KI_GLSKZU32_EL "I-Faktor PID-Regler GLS" VALUE 0x1D87E2 ZF_kw_ui16_S5_S3 10000 UMR_MBARMINSEC_10MSEC_1_1_0_S5_S3 0 10000 /end CHARACTERISTIC
/begin CHARACTERISTIC KI_GLSKZU43 "I-Faktor PID-Regler GLS" VALUE 0x1D8804 ZF_kw_ui16_S5_S3 10000 UMR_MBARMINSEC_10MSEC_1_1_0_S5_S3 0 10000 /end CHARACTERISTIC
/begin CHARACTERISTIC KI_GLSKZU43_EL "I-Faktor PID-Regler GLS" VALUE 0x1D8806 ZF_kw_ui16_S5_S3 10000 UMR_MBARMINSEC_10MSEC_1_1_0_S5_S3 0 10000 /end CHARACTERISTIC
/begin CHARACTERISTIC KI_GLSKZU54 "I-Faktor PID-Regler GLS" VALUE 0x1D8828 ZF_kw_ui16_S5_S3 10000 UMR_MBARMINSEC_10MSEC_1_1_0_S5_S3 0 10000 /end CHARACTERISTIC
/begin CHARACTERISTIC KI_GLSKZU54_EL "I-Faktor PID-Regler GLS" VALUE 0x1D882A ZF_kw_ui16_S5_S3 10000 UMR_MBARMINSEC_10MSEC_1_1_0_S5_S3 0 10000 /end CHARACTERISTIC
/begin CHARACTERISTIC KI_GLSKZU65 "I-Faktor PID-Regler GLS" VALUE 0x1D884C ZF_kw_ui16_S5_S3 10000 UMR_MBARMINSEC_10MSEC_1_1_0_S5_S3 0 10000 /end CHARACTERISTIC
/begin CHARACTERISTIC KI_GLSKZU65_EL "I-Faktor PID-Regler GLS" VALUE 0x1D884E ZF_kw_ui16_S5_S3 10000 UMR_MBARMINSEC_10MSEC_1_1_0_S5_S3 0 10000 /end CHARACTERISTIC
/begin CHARACTERISTIC KI_GLSKZU76 "I-Faktor PID-Regler GLS" VALUE 0x1D8870 ZF_kw_ui16_S5_S3 10000 UMR_MBARMINSEC_10MSEC_1_1_0_S5_S3 0 10000 /end CHARACTERISTIC
/begin CHARACTERISTIC KI_GLSKZU76_EL "I-Faktor PID-Regler GLS" VALUE 0x1D8872 ZF_kw_ui16_S5_S3 10000 UMR_MBARMINSEC_10MSEC_1_1_0_S5_S3 0 10000 /end CHARACTERISTIC
/begin CHARACTERISTIC KI_GLSKZU87 "I-Faktor PID-Regler GLS" VALUE 0x1D8894 ZF_kw_ui16_S5_S3 10000 UMR_MBARMINSEC_10MSEC_1_1_0_S5_S3 0 10000 /end CHARACTERISTIC
/begin CHARACTERISTIC KI_GLSKZU87_EL "I-Faktor PID-Regler GLS" VALUE 0x1D8896 ZF_kw_ui16_S5_S3 10000 UMR_MBARMINSEC_10MSEC_1_1_0_S5_S3 0 10000 /end CHARACTERISTIC
/begin CHARACTERISTIC KI_GLSKZUSP42 "I-Faktor PID-Regler GLS" VALUE 0x1D88DC ZF_kw_ui16_S5_S3 10000 UMR_MBARMINSEC_10MSEC_1_1_0_S5_S3 0 10000 /end CHARACTERISTIC
/begin CHARACTERISTIC KI_GLSKZUSP42_EL "I-Faktor PID-Regler GLS" VALUE 0x1D88DE ZF_kw_ui16_S5_S3 10000 UMR_MBARMINSEC_10MSEC_1_1_0_S5_S3 0 10000 /end CHARACTERISTIC
/begin CHARACTERISTIC KI_GLSKZUSP51 "I-Faktor PID-Regler GLS" VALUE 0x1D8900 ZF_kw_ui16_S5_S3 10000 UMR_MBARMINSEC_10MSEC_1_1_0_S5_S3 0 10000 /end CHARACTERISTIC
/begin CHARACTERISTIC KI_GLSKZUSP51_EL "I-Faktor PID-Regler GLS" VALUE 0x1D8902 ZF_kw_ui16_S5_S3 10000 UMR_MBARMINSEC_10MSEC_1_1_0_S5_S3 0 10000 /end CHARACTERISTIC
/begin CHARACTERISTIC KI_GLSKZUSP53 "I-Faktor PID-Regler GLS" VALUE 0x1D8924 ZF_kw_ui16_S5_S3 10000 UMR_MBARMINSEC_10MSEC_1_1_0_S5_S3 0 10000 /end CHARACTERISTIC
/begin CHARACTERISTIC KI_GLSKZUSP53_EL "I-Faktor PID-Regler GLS" VALUE 0x1D8926 ZF_kw_ui16_S5_S3 10000 UMR_MBARMINSEC_10MSEC_1_1_0_S5_S3 0 10000 /end CHARACTERISTIC
/begin CHARACTERISTIC KI_GLSKZUSP63 "I-Faktor PID-Regler GLS" VALUE 0x1D8948 ZF_kw_ui16_S5_S3 10000 UMR_MBARMINSEC_10MSEC_1_1_0_S5_S3 0 10000 /end CHARACTERISTIC
/begin CHARACTERISTIC KI_GLSKZUSP63_EL "I-Faktor PID-Regler GLS" VALUE 0x1D894A ZF_kw_ui16_S5_S3 10000 UMR_MBARMINSEC_10MSEC_1_1_0_S5_S3 0 10000 /end CHARACTERISTIC
/begin CHARACTERISTIC KI_GLSKZUSP64 "I-Faktor PID-Regler GLS" VALUE 0x1D896C ZF_kw_ui16_S5_S3 10000 UMR_MBARMINSEC_10MSEC_1_1_0_S5_S3 0 10000 /end CHARACTERISTIC
/begin CHARACTERISTIC KI_GLSKZUSP64_EL "I-Faktor PID-Regler GLS" VALUE 0x1D896E ZF_kw_ui16_S5_S3 10000 UMR_MBARMINSEC_10MSEC_1_1_0_S5_S3 0 10000 /end CHARACTERISTIC
/begin CHARACTERISTIC KI_GLSKZUSP71 "I-Faktor PID-Regler GLS" VALUE 0x1D8990 ZF_kw_ui16_S5_S3 10000 UMR_MBARMINSEC_10MSEC_1_1_0_S5_S3 0 10000 /end CHARACTERISTIC
/begin CHARACTERISTIC KI_GLSKZUSP71_EL "I-Faktor PID-Regler GLS" VALUE 0x1D8992 ZF_kw_ui16_S5_S3 10000 UMR_MBARMINSEC_10MSEC_1_1_0_S5_S3 0 10000 /end CHARACTERISTIC
/begin CHARACTERISTIC KI_GLSKZUSP75 "I-Faktor PID-Regler GLS" VALUE 0x1D89B4 ZF_kw_ui16_S5_S3 10000 UMR_MBARMINSEC_10MSEC_1_1_0_S5_S3 0 10000 /end CHARACTERISTIC
/begin CHARACTERISTIC KI_GLSKZUSP75_EL "I-Faktor PID-Regler GLS" VALUE 0x1D89B6 ZF_kw_ui16_S5_S3 10000 UMR_MBARMINSEC_10MSEC_1_1_0_S5_S3 0 10000 /end CHARACTERISTIC
/begin CHARACTERISTIC KI_GLSKZUSP82 "I-Faktor PID-Regler GLS" VALUE 0x1D89D8 ZF_kw_ui16_S5_S3 10000 UMR_MBARMINSEC_10MSEC_1_1_0_S5_S3 0 10000 /end CHARACTERISTIC
/begin CHARACTERISTIC KI_GLSKZUSP82_EL "I-Faktor PID-Regler GLS" VALUE 0x1D89DA ZF_kw_ui16_S5_S3 10000 UMR_MBARMINSEC_10MSEC_1_1_0_S5_S3 0 10000 /end CHARACTERISTIC
/begin CHARACTERISTIC KI_GLSKZUSP84 "I-Faktor PID-Regler GLS" VALUE 0x1D89FC ZF_kw_ui16_S5_S3 10000 UMR_MBARMINSEC_10MSEC_1_1_0_S5_S3 0 10000 /end CHARACTERISTIC
/begin CHARACTERISTIC KI_GLSKZUSP84_EL "I-Faktor PID-Regler GLS" VALUE 0x1D89FE ZF_kw_ui16_S5_S3 10000 UMR_MBARMINSEC_10MSEC_1_1_0_S5_S3 0 10000 /end CHARACTERISTIC
/begin CHARACTERISTIC KI_GLSKZUSP86 "I-Faktor PID-Regler GLS" VALUE 0x1D8A20 ZF_kw_ui16_S5_S3 10000 UMR_MBARMINSEC_10MSEC_1_1_0_S5_S3 0 10000 /end CHARACTERISTIC
/begin CHARACTERISTIC KI_GLSKZUSP86_EL "I-Faktor PID-Regler GLS" VALUE 0x1D8A22 ZF_kw_ui16_S5_S3 10000 UMR_MBARMINSEC_10MSEC_1_1_0_S5_S3 0 10000 /end CHARACTERISTIC
/begin CHARACTERISTIC KL_FCGPOGA_1 "Druckoffset Faktor Gangauslegen" CURVE 0x1B5F5C ZF_kl_ui8_S5_S3 1 UMR___1_100_0_S5_S3 0 1
 /begin AXIS_DESCR STD_AXIS zff_atsys._.iSignale._.obj.sig_c_getr UMR_GRADC__1_1_M40_S5_S3 6 -40 215 DEPOSIT ABSOLUTE /end AXIS_DESCR
/end CHARACTERISTIC
/begin CHARACTERISTIC KL_FCGPOGA_2 "Druckoffset Faktor Gangauslegen" CURVE 0x1B607C ZF_kl_ui8_S5_S3 1 UMR___1_100_0_S5_S3 0 1
 /begin AXIS_DESCR STD_AXIS zff_atsys._.iSignale._.obj.sig_c_getr UMR_GRADC__1_1_M40_S5_S3 6 -40 215 DEPOSIT ABSOLUTE /end AXIS_DESCR
/end CHARACTERISTIC
/begin CHARACTERISTIC KL_FCGPOGA_3 "Druckoffset Faktor Gangauslegen" CURVE 0x1B619C ZF_kl_ui8_S5_S3 1 UMR___1_100_0_S5_S3 0 1
 /begin AXIS_DESCR STD_AXIS zff_atsys._.iSignale._.obj.sig_c_getr UMR_GRADC__1_1_M40_S5_S3 6 -40 215 DEPOSIT ABSOLUTE /end AXIS_DESCR
/end CHARACTERISTIC
/begin CHARACTERISTIC KL_FCGPOGA_4 "Druckoffset Faktor Gangauslegen" CURVE 0x1B62BC ZF_kl_ui8_S5_S3 1 UMR___1_100_0_S5_S3 0 1
 /begin AXIS_DESCR STD_AXIS zff_atsys._.iSignale._.obj.sig_c_getr UMR_GRADC__1_1_M40_S5_S3 6 -40 215 DEPOSIT ABSOLUTE /end AXIS_DESCR
/end CHARACTERISTIC
/begin CHARACTERISTIC KL_FCGPOGA_5 "Druckoffset Faktor Gangauslegen" CURVE 0x1B63DC ZF_kl_ui8_S5_S3 1 UMR___1_100_0_S5_S3 0 1
 /begin AXIS_DESCR STD_AXIS zff_atsys._.iSignale._.obj.sig_c_getr UMR_GRADC__1_1_M40_S5_S3 6 -40 215 DEPOSIT ABSOLUTE /end AXIS_DESCR
/end CHARACTERISTIC
/begin CHARACTERISTIC KL_FCGPOGA_6 "Druckoffset Faktor Gangauslegen" CURVE 0x1B64FC ZF_kl_ui8_S5_S3 1 UMR___1_100_0_S5_S3 0 1
 /begin AXIS_DESCR STD_AXIS zff_atsys._.iSignale._.obj.sig_c_getr UMR_GRADC__1_1_M40_S5_S3 6 -40 215 DEPOSIT ABSOLUTE /end AXIS_DESCR
/end CHARACTERISTIC
/begin CHARACTERISTIC KL_FCGPOGA_7 "Druckoffset Faktor Gangauslegen" CURVE 0x1B661C ZF_kl_ui8_S5_S3 1 UMR___1_100_0_S5_S3 0 1
 /begin AXIS_DESCR STD_AXIS zff_atsys._.iSignale._.obj.sig_c_getr UMR_GRADC__1_1_M40_S5_S3 6 -40 215 DEPOSIT ABSOLUTE /end AXIS_DESCR
/end CHARACTERISTIC
/begin CHARACTERISTIC KL_FCGPOGA_8 "Druckoffset Faktor Gangauslegen" CURVE 0x1B673C ZF_kl_ui8_S5_S3 1 UMR___1_100_0_S5_S3 0 1
 /begin AXIS_DESCR STD_AXIS zff_atsys._.iSignale._.obj.sig_c_getr UMR_GRADC__1_1_M40_S5_S3 6 -40 215 DEPOSIT ABSOLUTE /end AXIS_DESCR
/end CHARACTERISTIC
/begin CHARACTERISTIC KL_FCGPOGA_R "Druckoffset Faktor Gangauslegen" CURVE 0x1B5E3C ZF_kl_ui8_S5_S3 1 UMR___1_100_0_S5_S3 0 1
 /begin AXIS_DESCR STD_AXIS zff_atsys._.iSignale._.obj.sig_c_getr UMR_GRADC__1_1_M40_S5_S3 6 -40 215 DEPOSIT ABSOLUTE /end AXIS_DESCR
/end CHARACTERISTIC
/begin CHARACTERISTIC KL_PGOKABFOLNACHMRS21 "Druckgradient in Abhaengigkeit von m_t fuer Folgeschaltung" CURVE 0x1B2F4C ZF_kl_si16_S5_S3 200 UMR_BAR_SEC_1_10_0_S5_S3 -100 100
 /begin AXIS_DESCR STD_AXIS zff_atsys._.iSignale._.obj.sig_m_t UMR_NM__1_1_0_S5_S3 6 -200 1300 DEPOSIT ABSOLUTE /end AXIS_DESCR
/end CHARACTERISTIC
/begin CHARACTERISTIC KL_PGOKABFOLNACHMRS32 "Druckgradient in Abhaengigkeit von m_t fuer Folgeschaltung" CURVE 0x1B3658 ZF_kl_si16_S5_S3 200 UMR_BAR_SEC_1_10_0_S5_S3 -100 100
 /begin AXIS_DESCR STD_AXIS zff_atsys._.iSignale._.obj.sig_m_t UMR_NM__1_1_0_S5_S3 6 -200 1300 DEPOSIT ABSOLUTE /end AXIS_DESCR
/end CHARACTERISTIC
/begin CHARACTERISTIC KL_PGOKABFOLNACHMRS43 "Druckgradient in Abhaengigkeit von m_t fuer Folgeschaltung" CURVE 0x1B3D64 ZF_kl_si16_S5_S3 200 UMR_BAR_SEC_1_10_0_S5_S3 -100 100
 /begin AXIS_DESCR STD_AXIS zff_atsys._.iSignale._.obj.sig_m_t UMR_NM__1_1_0_S5_S3 6 -200 1300 DEPOSIT ABSOLUTE /end AXIS_DESCR
/end CHARACTERISTIC
/begin CHARACTERISTIC KL_PGOKABFOLNACHMRS54 "Druckgradient in Abhaengigkeit von m_t fuer Folgeschaltung" CURVE 0x1B412C ZF_kl_si16_S5_S3 200 UMR_BAR_SEC_1_10_0_S5_S3 -100 100
 /begin AXIS_DESCR STD_AXIS zff_atsys._.iSignale._.obj.sig_m_t UMR_NM__1_1_0_S5_S3 6 -200 1300 DEPOSIT ABSOLUTE /end AXIS_DESCR
/end CHARACTERISTIC
/begin CHARACTERISTIC KL_PGOKABFOLNACHMRS65 "Druckgradient in Abhaengigkeit von m_t fuer Folgeschaltung" CURVE 0x1B4838 ZF_kl_si16_S5_S3 200 UMR_BAR_SEC_1_10_0_S5_S3 -100 100
 /begin AXIS_DESCR STD_AXIS zff_atsys._.iSignale._.obj.sig_m_t UMR_NM__1_1_0_S5_S3 6 -200 1300 DEPOSIT ABSOLUTE /end AXIS_DESCR
/end CHARACTERISTIC
/begin CHARACTERISTIC KL_PGOKABFOLNACHMRS76 "Druckgradient in Abhaengigkeit von m_t fuer Folgeschaltung" CURVE 0x1B4F44 ZF_kl_si16_S5_S3 200 UMR_BAR_SEC_1_10_0_S5_S3 -100 100
 /begin AXIS_DESCR STD_AXIS zff_atsys._.iSignale._.obj.sig_m_t UMR_NM__1_1_0_S5_S3 6 -200 1300 DEPOSIT ABSOLUTE /end AXIS_DESCR
/end CHARACTERISTIC
/begin CHARACTERISTIC KL_PGOKABFOLNACHMRS87 "Druckgradient in Abhaengigkeit von m_t fuer Folgeschaltung" CURVE 0x1B5650 ZF_kl_si16_S5_S3 200 UMR_BAR_SEC_1_10_0_S5_S3 -100 100
 /begin AXIS_DESCR STD_AXIS zff_atsys._.iSignale._.obj.sig_m_t UMR_NM__1_1_0_S5_S3 6 -200 1300 DEPOSIT ABSOLUTE /end AXIS_DESCR
/end CHARACTERISTIC
/begin CHARACTERISTIC KL_PGOKABFOLNACHRS21 "Druckgradient in Abhaengigkeit von m_t fuer Folgeschaltung" CURVE 0x1B2F30 ZF_kl_si16_S5_S3 200 UMR_BAR_SEC_1_10_0_S5_S3 -100 100
 /begin AXIS_DESCR STD_AXIS zff_atsys._.iSignale._.obj.sig_m_t UMR_NM__1_1_0_S5_S3 6 -200 1300 DEPOSIT ABSOLUTE /end AXIS_DESCR
/end CHARACTERISTIC
/begin CHARACTERISTIC KL_PGOKABFOLNACHRS32 "Druckgradient in Abhaengigkeit von m_t fuer Folgeschaltung" CURVE 0x1B363C ZF_kl_si16_S5_S3 200 UMR_BAR_SEC_1_10_0_S5_S3 -100 100
 /begin AXIS_DESCR STD_AXIS zff_atsys._.iSignale._.obj.sig_m_t UMR_NM__1_1_0_S5_S3 6 -200 1300 DEPOSIT ABSOLUTE /end AXIS_DESCR
/end CHARACTERISTIC
/begin CHARACTERISTIC KL_PGOKABFOLNACHRS43 "Druckgradient in Abhaengigkeit von m_t fuer Folgeschaltung" CURVE 0x1B3D48 ZF_kl_si16_S5_S3 200 UMR_BAR_SEC_1_10_0_S5_S3 -100 100
 /begin AXIS_DESCR STD_AXIS zff_atsys._.iSignale._.obj.sig_m_t UMR_NM__1_1_0_S5_S3 6 -200 1300 DEPOSIT ABSOLUTE /end AXIS_DESCR
/end CHARACTERISTIC
/begin CHARACTERISTIC KL_PGOKABFOLNACHRS54 "Druckgradient in Abhaengigkeit von m_t fuer Folgeschaltung" CURVE 0x1B4110 ZF_kl_si16_S5_S3 200 UMR_BAR_SEC_1_10_0_S5_S3 -100 100
 /begin AXIS_DESCR STD_AXIS zff_atsys._.iSignale._.obj.sig_m_t UMR_NM__1_1_0_S5_S3 6 -200 1300 DEPOSIT ABSOLUTE /end AXIS_DESCR
/end CHARACTERISTIC
/begin CHARACTERISTIC KL_PGOKABFOLNACHRS65 "Druckgradient in Abhaengigkeit von m_t fuer Folgeschaltung" CURVE 0x1B481C ZF_kl_si16_S5_S3 200 UMR_BAR_SEC_1_10_0_S5_S3 -100 100
 /begin AXIS_DESCR STD_AXIS zff_atsys._.iSignale._.obj.sig_m_t UMR_NM__1_1_0_S5_S3 6 -200 1300 DEPOSIT ABSOLUTE /end AXIS_DESCR
/end CHARACTERISTIC
/begin CHARACTERISTIC KL_PGOKABFOLNACHRS76 "Druckgradient in Abhaengigkeit von m_t fuer Folgeschaltung" CURVE 0x1B4F28 ZF_kl_si16_S5_S3 200 UMR_BAR_SEC_1_10_0_S5_S3 -100 100
 /begin AXIS_DESCR STD_AXIS zff_atsys._.iSignale._.obj.sig_m_t UMR_NM__1_1_0_S5_S3 6 -200 1300 DEPOSIT ABSOLUTE /end AXIS_DESCR
/end CHARACTERISTIC
/begin CHARACTERISTIC KL_PGOKABFOLNACHRS87 "Druckgradient in Abhaengigkeit von m_t fuer Folgeschaltung" CURVE 0x1B5634 ZF_kl_si16_S5_S3 200 UMR_BAR_SEC_1_10_0_S5_S3 -100 100
 /begin AXIS_DESCR STD_AXIS zff_atsys._.iSignale._.obj.sig_m_t UMR_NM__1_1_0_S5_S3 6 -200 1300 DEPOSIT ABSOLUTE /end AXIS_DESCR
/end CHARACTERISTIC
/begin CHARACTERISTIC KL_PGRASYNKABFOLNACHMRS21 "Druckgradient Wegschalten KAB fuer Folgeschaltung" CURVE 0x1B2F84 ZF_kl_si16_S5_S3 100 UMR_BAR_SEC_1_10_0_S5_S3 -100 0
 /begin AXIS_DESCR STD_AXIS zff_atsys._.iSignale._.obj.sig_m_t UMR_NM__1_1_0_S5_S3 6 -200 1300 DEPOSIT ABSOLUTE /end AXIS_DESCR
/end CHARACTERISTIC
/begin CHARACTERISTIC KL_PGRASYNKABFOLNACHMRS32 "Druckgradient Wegschalten KAB fuer Folgeschaltung" CURVE 0x1B3690 ZF_kl_si16_S5_S3 100 UMR_BAR_SEC_1_10_0_S5_S3 -100 0
 /begin AXIS_DESCR STD_AXIS zff_atsys._.iSignale._.obj.sig_m_t UMR_NM__1_1_0_S5_S3 6 -200 1300 DEPOSIT ABSOLUTE /end AXIS_DESCR
/end CHARACTERISTIC
/begin CHARACTERISTIC KL_PGRASYNKABFOLNACHMRS43 "Druckgradient Wegschalten KAB fuer Folgeschaltung" CURVE 0x1B3D9C ZF_kl_si16_S5_S3 100 UMR_BAR_SEC_1_10_0_S5_S3 -100 0
 /begin AXIS_DESCR STD_AXIS zff_atsys._.iSignale._.obj.sig_m_t UMR_NM__1_1_0_S5_S3 6 -200 1300 DEPOSIT ABSOLUTE /end AXIS_DESCR
/end CHARACTERISTIC
/begin CHARACTERISTIC KL_PGRASYNKABFOLNACHMRS54 "Druckgradient Wegschalten KAB fuer Folgeschaltung" CURVE 0x1B4164 ZF_kl_si16_S5_S3 100 UMR_BAR_SEC_1_10_0_S5_S3 -100 0
 /begin AXIS_DESCR STD_AXIS zff_atsys._.iSignale._.obj.sig_m_t UMR_NM__1_1_0_S5_S3 6 -200 1300 DEPOSIT ABSOLUTE /end AXIS_DESCR
/end CHARACTERISTIC
/begin CHARACTERISTIC KL_PGRASYNKABFOLNACHMRS65 "Druckgradient Wegschalten KAB fuer Folgeschaltung" CURVE 0x1B4870 ZF_kl_si16_S5_S3 100 UMR_BAR_SEC_1_10_0_S5_S3 -100 0
 /begin AXIS_DESCR STD_AXIS zff_atsys._.iSignale._.obj.sig_m_t UMR_NM__1_1_0_S5_S3 6 -200 1300 DEPOSIT ABSOLUTE /end AXIS_DESCR
/end CHARACTERISTIC
/begin CHARACTERISTIC KL_PGRASYNKABFOLNACHMRS76 "Druckgradient Wegschalten KAB fuer Folgeschaltung" CURVE 0x1B4F7C ZF_kl_si16_S5_S3 100 UMR_BAR_SEC_1_10_0_S5_S3 -100 0
 /begin AXIS_DESCR STD_AXIS zff_atsys._.iSignale._.obj.sig_m_t UMR_NM__1_1_0_S5_S3 6 -200 1300 DEPOSIT ABSOLUTE /end AXIS_DESCR
/end CHARACTERISTIC
/begin CHARACTERISTIC KL_PGRASYNKABFOLNACHMRS87 "Druckgradient Wegschalten KAB fuer Folgeschaltung" CURVE 0x1B5688 ZF_kl_si16_S5_S3 100 UMR_BAR_SEC_1_10_0_S5_S3 -100 0
 /begin AXIS_DESCR STD_AXIS zff_atsys._.iSignale._.obj.sig_m_t UMR_NM__1_1_0_S5_S3 6 -200 1300 DEPOSIT ABSOLUTE /end AXIS_DESCR
/end CHARACTERISTIC
/begin CHARACTERISTIC KL_PGRASYNKABFOLNACHRS21 "Druckgradient Wegschalten KAB fuer Folgeschaltung" CURVE 0x1B2F68 ZF_kl_si16_S5_S3 100 UMR_BAR_SEC_1_10_0_S5_S3 -100 0
 /begin AXIS_DESCR STD_AXIS zff_atsys._.iSignale._.obj.sig_m_t UMR_NM__1_1_0_S5_S3 6 -200 1300 DEPOSIT ABSOLUTE /end AXIS_DESCR
/end CHARACTERISTIC
/begin CHARACTERISTIC KL_PGRASYNKABFOLNACHRS32 "Druckgradient Wegschalten KAB fuer Folgeschaltung" CURVE 0x1B3674 ZF_kl_si16_S5_S3 100 UMR_BAR_SEC_1_10_0_S5_S3 -100 0
 /begin AXIS_DESCR STD_AXIS zff_atsys._.iSignale._.obj.sig_m_t UMR_NM__1_1_0_S5_S3 6 -200 1300 DEPOSIT ABSOLUTE /end AXIS_DESCR
/end CHARACTERISTIC
/begin CHARACTERISTIC KL_PGRASYNKABFOLNACHRS43 "Druckgradient Wegschalten KAB fuer Folgeschaltung" CURVE 0x1B3D80 ZF_kl_si16_S5_S3 100 UMR_BAR_SEC_1_10_0_S5_S3 -100 0
 /begin AXIS_DESCR STD_AXIS zff_atsys._.iSignale._.obj.sig_m_t UMR_NM__1_1_0_S5_S3 6 -200 1300 DEPOSIT ABSOLUTE /end AXIS_DESCR
/end CHARACTERISTIC
/begin CHARACTERISTIC KL_PGRASYNKABFOLNACHRS54 "Druckgradient Wegschalten KAB fuer Folgeschaltung" CURVE 0x1B4148 ZF_kl_si16_S5_S3 100 UMR_BAR_SEC_1_10_0_S5_S3 -100 0
 /begin AXIS_DESCR STD_AXIS zff_atsys._.iSignale._.obj.sig_m_t UMR_NM__1_1_0_S5_S3 6 -200 1300 DEPOSIT ABSOLUTE /end AXIS_DESCR
/end CHARACTERISTIC
/begin CHARACTERISTIC KL_PGRASYNKABFOLNACHRS65 "Druckgradient Wegschalten KAB fuer Folgeschaltung" CURVE 0x1B4854 ZF_kl_si16_S5_S3 100 UMR_BAR_SEC_1_10_0_S5_S3 -100 0
 /begin AXIS_DESCR STD_AXIS zff_atsys._.iSignale._.obj.sig_m_t UMR_NM__1_1_0_S5_S3 6 -200 1300 DEPOSIT ABSOLUTE /end AXIS_DESCR
/end CHARACTERISTIC
/begin CHARACTERISTIC KL_PGRASYNKABFOLNACHRS76 "Druckgradient Wegschalten KAB fuer Folgeschaltung" CURVE 0x1B4F60 ZF_kl_si16_S5_S3 100 UMR_BAR_SEC_1_10_0_S5_S3 -100 0
 /begin AXIS_DESCR STD_AXIS zff_atsys._.iSignale._.obj.sig_m_t UMR_NM__1_1_0_S5_S3 6 -200 1300 DEPOSIT ABSOLUTE /end AXIS_DESCR
/end CHARACTERISTIC
/begin CHARACTERISTIC KL_PGRASYNKABFOLNACHRS87 "Druckgradient Wegschalten KAB fuer Folgeschaltung" CURVE 0x1B566C ZF_kl_si16_S5_S3 100 UMR_BAR_SEC_1_10_0_S5_S3 -100 0
 /begin AXIS_DESCR STD_AXIS zff_atsys._.iSignale._.obj.sig_m_t UMR_NM__1_1_0_S5_S3 6 -200 1300 DEPOSIT ABSOLUTE /end AXIS_DESCR
/end CHARACTERISTIC
/begin CHARACTERISTIC KL_PHKABMT12 "Haltedruck abschaltende Kupplung bei HS" CURVE 0x1B6824 ZF_kl_si16_S5_S3 22 UMR_BAR__1_1000_0_S5_S3 0 22
 /begin AXIS_DESCR STD_AXIS zff_atsys._.iSignale._.obj.sig_m_t UMR_NM__1_1_0_S5_S3 8 -200 1300 DEPOSIT ABSOLUTE /end AXIS_DESCR
/end CHARACTERISTIC
/begin CHARACTERISTIC KL_PHKABMT12_EL "Haltedruck abschaltende Kupplung bei HS" CURVE 0x1B6848 ZF_kl_si16_S5_S3 22 UMR_BAR__1_1000_0_S5_S3 0 22
 /begin AXIS_DESCR STD_AXIS zff_atsys._.iSignale._.obj.sig_m_t UMR_NM__1_1_0_S5_S3 8 -200 1300 DEPOSIT ABSOLUTE /end AXIS_DESCR
/end CHARACTERISTIC
/begin CHARACTERISTIC KL_PHKABMT23 "Haltedruck abschaltende Kupplung bei HS" CURVE 0x1B6A04 ZF_kl_si16_S5_S3 22 UMR_BAR__1_1000_0_S5_S3 0 22
 /begin AXIS_DESCR STD_AXIS zff_atsys._.iSignale._.obj.sig_m_t UMR_NM__1_1_0_S5_S3 8 -200 1300 DEPOSIT ABSOLUTE /end AXIS_DESCR
/end CHARACTERISTIC
/begin CHARACTERISTIC KL_PHKABMT23_EL "Haltedruck abschaltende Kupplung bei HS" CURVE 0x1B6A28 ZF_kl_si16_S5_S3 22 UMR_BAR__1_1000_0_S5_S3 0 22
 /begin AXIS_DESCR STD_AXIS zff_atsys._.iSignale._.obj.sig_m_t UMR_NM__1_1_0_S5_S3 8 -200 1300 DEPOSIT ABSOLUTE /end AXIS_DESCR
/end CHARACTERISTIC
/begin CHARACTERISTIC KL_PHKABMT34 "Haltedruck abschaltende Kupplung bei HS" CURVE 0x1B6BE4 ZF_kl_si16_S5_S3 22 UMR_BAR__1_1000_0_S5_S3 0 22
 /begin AXIS_DESCR STD_AXIS zff_atsys._.iSignale._.obj.sig_m_t UMR_NM__1_1_0_S5_S3 8 -200 1300 DEPOSIT ABSOLUTE /end AXIS_DESCR
/end CHARACTERISTIC
/begin CHARACTERISTIC KL_PHKABMT34_EL "Haltedruck abschaltende Kupplung bei HS" CURVE 0x1B6C08 ZF_kl_si16_S5_S3 22 UMR_BAR__1_1000_0_S5_S3 0 22
 /begin AXIS_DESCR STD_AXIS zff_atsys._.iSignale._.obj.sig_m_t UMR_NM__1_1_0_S5_S3 8 -200 1300 DEPOSIT ABSOLUTE /end AXIS_DESCR
/end CHARACTERISTIC
/begin CHARACTERISTIC KL_PHKABMT45 "Haltedruck abschaltende Kupplung bei HS" CURVE 0x1B6DC4 ZF_kl_si16_S5_S3 22 UMR_BAR__1_1000_0_S5_S3 0 22
 /begin AXIS_DESCR STD_AXIS zff_atsys._.iSignale._.obj.sig_m_t UMR_NM__1_1_0_S5_S3 8 -200 1300 DEPOSIT ABSOLUTE /end AXIS_DESCR
/end CHARACTERISTIC
/begin CHARACTERISTIC KL_PHKABMT45_EL "Haltedruck abschaltende Kupplung bei HS" CURVE 0x1B6DE8 ZF_kl_si16_S5_S3 22 UMR_BAR__1_1000_0_S5_S3 0 22
 /begin AXIS_DESCR STD_AXIS zff_atsys._.iSignale._.obj.sig_m_t UMR_NM__1_1_0_S5_S3 8 -200 1300 DEPOSIT ABSOLUTE /end AXIS_DESCR
/end CHARACTERISTIC
/begin CHARACTERISTIC KL_PHKABMT56 "Haltedruck abschaltende Kupplung bei HS" CURVE 0x1B6FA4 ZF_kl_si16_S5_S3 22 UMR_BAR__1_1000_0_S5_S3 0 22
 /begin AXIS_DESCR STD_AXIS zff_atsys._.iSignale._.obj.sig_m_t UMR_NM__1_1_0_S5_S3 8 -200 1300 DEPOSIT ABSOLUTE /end AXIS_DESCR
/end CHARACTERISTIC
/begin CHARACTERISTIC KL_PHKABMT56_EL "Haltedruck abschaltende Kupplung bei HS" CURVE 0x1B6FC8 ZF_kl_si16_S5_S3 22 UMR_BAR__1_1000_0_S5_S3 0 22
 /begin AXIS_DESCR STD_AXIS zff_atsys._.iSignale._.obj.sig_m_t UMR_NM__1_1_0_S5_S3 8 -200 1300 DEPOSIT ABSOLUTE /end AXIS_DESCR
/end CHARACTERISTIC
/begin CHARACTERISTIC KL_PHKABMT67 "Haltedruck abschaltende Kupplung bei HS" CURVE 0x1B7184 ZF_kl_si16_S5_S3 22 UMR_BAR__1_1000_0_S5_S3 0 22
 /begin AXIS_DESCR STD_AXIS zff_atsys._.iSignale._.obj.sig_m_t UMR_NM__1_1_0_S5_S3 8 -200 1300 DEPOSIT ABSOLUTE /end AXIS_DESCR
/end CHARACTERISTIC
/begin CHARACTERISTIC KL_PHKABMT67_EL "Haltedruck abschaltende Kupplung bei HS" CURVE 0x1B71A8 ZF_kl_si16_S5_S3 22 UMR_BAR__1_1000_0_S5_S3 0 22
 /begin AXIS_DESCR STD_AXIS zff_atsys._.iSignale._.obj.sig_m_t UMR_NM__1_1_0_S5_S3 8 -200 1300 DEPOSIT ABSOLUTE /end AXIS_DESCR
/end CHARACTERISTIC
/begin CHARACTERISTIC KL_PHKABMT78 "Haltedruck abschaltende Kupplung bei HS" CURVE 0x1B7364 ZF_kl_si16_S5_S3 22 UMR_BAR__1_1000_0_S5_S3 0 22
 /begin AXIS_DESCR STD_AXIS zff_atsys._.iSignale._.obj.sig_m_t UMR_NM__1_1_0_S5_S3 8 -200 1300 DEPOSIT ABSOLUTE /end AXIS_DESCR
/end CHARACTERISTIC
/begin CHARACTERISTIC KL_PHKABMT78_EL "Haltedruck abschaltende Kupplung bei HS" CURVE 0x1B7388 ZF_kl_si16_S5_S3 22 UMR_BAR__1_1000_0_S5_S3 0 22
 /begin AXIS_DESCR STD_AXIS zff_atsys._.iSignale._.obj.sig_m_t UMR_NM__1_1_0_S5_S3 8 -200 1300 DEPOSIT ABSOLUTE /end AXIS_DESCR
/end CHARACTERISTIC
/begin CHARACTERISTIC KL_PHKABMTSP12 "Haltedruck abschaltende Kupplung bei HS" CURVE 0x1B74D8 ZF_kl_si16_S5_S3 22 UMR_BAR__1_1000_0_S5_S3 0 22
 /begin AXIS_DESCR STD_AXIS zff_atsys._.iSignale._.obj.sig_m_t UMR_NM__1_1_0_S5_S3 8 -200 1300 DEPOSIT ABSOLUTE /end AXIS_DESCR
/end CHARACTERISTIC
/begin CHARACTERISTIC KL_PHKABMTSP23 "Haltedruck abschaltende Kupplung bei HS" CURVE 0x1B75D0 ZF_kl_si16_S5_S3 22 UMR_BAR__1_1000_0_S5_S3 0 22
 /begin AXIS_DESCR STD_AXIS zff_atsys._.iSignale._.obj.sig_m_t UMR_NM__1_1_0_S5_S3 8 -200 1300 DEPOSIT ABSOLUTE /end AXIS_DESCR
/end CHARACTERISTIC
/begin CHARACTERISTIC KL_PHKABMTSP34 "Haltedruck abschaltende Kupplung bei HS" CURVE 0x1B76C8 ZF_kl_si16_S5_S3 22 UMR_BAR__1_1000_0_S5_S3 0 22
 /begin AXIS_DESCR STD_AXIS zff_atsys._.iSignale._.obj.sig_m_t UMR_NM__1_1_0_S5_S3 8 -200 1300 DEPOSIT ABSOLUTE /end AXIS_DESCR
/end CHARACTERISTIC
/begin CHARACTERISTIC KL_PHKABMTSP45 "Haltedruck abschaltende Kupplung bei HS" CURVE 0x1B77C0 ZF_kl_si16_S5_S3 22 UMR_BAR__1_1000_0_S5_S3 0 22
 /begin AXIS_DESCR STD_AXIS zff_atsys._.iSignale._.obj.sig_m_t UMR_NM__1_1_0_S5_S3 8 -200 1300 DEPOSIT ABSOLUTE /end AXIS_DESCR
/end CHARACTERISTIC
/begin CHARACTERISTIC KL_PHKABMTSP56 "Haltedruck abschaltende Kupplung bei HS" CURVE 0x1B78B8 ZF_kl_si16_S5_S3 22 UMR_BAR__1_1000_0_S5_S3 0 22
 /begin AXIS_DESCR STD_AXIS zff_atsys._.iSignale._.obj.sig_m_t UMR_NM__1_1_0_S5_S3 8 -200 1300 DEPOSIT ABSOLUTE /end AXIS_DESCR
/end CHARACTERISTIC
/begin CHARACTERISTIC KL_PHKABMTSP67 "Haltedruck abschaltende Kupplung bei HS" CURVE 0x1B79B0 ZF_kl_si16_S5_S3 22 UMR_BAR__1_1000_0_S5_S3 0 22
 /begin AXIS_DESCR STD_AXIS zff_atsys._.iSignale._.obj.sig_m_t UMR_NM__1_1_0_S5_S3 8 -200 1300 DEPOSIT ABSOLUTE /end AXIS_DESCR
/end CHARACTERISTIC
/begin CHARACTERISTIC KL_PHKABMTSP78 "Haltedruck abschaltende Kupplung bei HS" CURVE 0x1B7AA8 ZF_kl_si16_S5_S3 22 UMR_BAR__1_1000_0_S5_S3 0 22
 /begin AXIS_DESCR STD_AXIS zff_atsys._.iSignale._.obj.sig_m_t UMR_NM__1_1_0_S5_S3 8 -200 1300 DEPOSIT ABSOLUTE /end AXIS_DESCR
/end CHARACTERISTIC
/begin CHARACTERISTIC KL_POKABCG12 "Temp. abhängiger Druckoffset auf Schaltdruck KAB fuer HS" CURVE 0x1B691C ZF_kl_si16_S5_S3 2.5 UMR_BAR__1_1000_0_S5_S3 -1.25 1.25
 /begin AXIS_DESCR STD_AXIS zff_atsys._.iSignale._.obj.sig_c_getr UMR_GRADC__1_1_M40_S5_S3 3 -40 150 DEPOSIT ABSOLUTE /end AXIS_DESCR
/end CHARACTERISTIC
/begin CHARACTERISTIC KL_POKABCG23 "Temp. abhängiger Druckoffset auf Schaltdruck KAB fuer HS" CURVE 0x1B6AFC ZF_kl_si16_S5_S3 2.5 UMR_BAR__1_1000_0_S5_S3 -1.25 1.25
 /begin AXIS_DESCR STD_AXIS zff_atsys._.iSignale._.obj.sig_c_getr UMR_GRADC__1_1_M40_S5_S3 3 -40 150 DEPOSIT ABSOLUTE /end AXIS_DESCR
/end CHARACTERISTIC
/begin CHARACTERISTIC KL_POKABCG34 "Temp. abhängiger Druckoffset auf Schaltdruck KAB fuer HS" CURVE 0x1B6CDC ZF_kl_si16_S5_S3 2.5 UMR_BAR__1_1000_0_S5_S3 -1.25 1.25
 /begin AXIS_DESCR STD_AXIS zff_atsys._.iSignale._.obj.sig_c_getr UMR_GRADC__1_1_M40_S5_S3 3 -40 150 DEPOSIT ABSOLUTE /end AXIS_DESCR
/end CHARACTERISTIC
/begin CHARACTERISTIC KL_POKABCG45 "Temp. abhängiger Druckoffset auf Schaltdruck KAB fuer HS" CURVE 0x1B6EBC ZF_kl_si16_S5_S3 2.5 UMR_BAR__1_1000_0_S5_S3 -1.25 1.25
 /begin AXIS_DESCR STD_AXIS zff_atsys._.iSignale._.obj.sig_c_getr UMR_GRADC__1_1_M40_S5_S3 3 -40 150 DEPOSIT ABSOLUTE /end AXIS_DESCR
/end CHARACTERISTIC
/begin CHARACTERISTIC KL_POKABCG56 "Temp. abhängiger Druckoffset auf Schaltdruck KAB fuer HS" CURVE 0x1B709C ZF_kl_si16_S5_S3 2.5 UMR_BAR__1_1000_0_S5_S3 -1.25 1.25
 /begin AXIS_DESCR STD_AXIS zff_atsys._.iSignale._.obj.sig_c_getr UMR_GRADC__1_1_M40_S5_S3 3 -40 150 DEPOSIT ABSOLUTE /end AXIS_DESCR
/end CHARACTERISTIC
/begin CHARACTERISTIC KL_POKABCG67 "Temp. abhängiger Druckoffset auf Schaltdruck KAB fuer HS" CURVE 0x1B727C ZF_kl_si16_S5_S3 2.5 UMR_BAR__1_1000_0_S5_S3 -1.25 1.25
 /begin AXIS_DESCR STD_AXIS zff_atsys._.iSignale._.obj.sig_c_getr UMR_GRADC__1_1_M40_S5_S3 3 -40 150 DEPOSIT ABSOLUTE /end AXIS_DESCR
/end CHARACTERISTIC
/begin CHARACTERISTIC KL_POKABCG78 "Temp. abhängiger Druckoffset auf Schaltdruck KAB fuer HS" CURVE 0x1B745C ZF_kl_si16_S5_S3 2.5 UMR_BAR__1_1000_0_S5_S3 -1.25 1.25
 /begin AXIS_DESCR STD_AXIS zff_atsys._.iSignale._.obj.sig_c_getr UMR_GRADC__1_1_M40_S5_S3 3 -40 150 DEPOSIT ABSOLUTE /end AXIS_DESCR
/end CHARACTERISTIC
/begin CHARACTERISTIC KL_POKABCGSP12 "Temp. abhängiger Druckoffset auf Schaltdruck KAB fuer HS" CURVE 0x1B7554 ZF_kl_si16_S5_S3 2.5 UMR_BAR__1_1000_0_S5_S3 -1.25 1.25
 /begin AXIS_DESCR STD_AXIS zff_atsys._.iSignale._.obj.sig_c_getr UMR_GRADC__1_1_M40_S5_S3 3 -40 150 DEPOSIT ABSOLUTE /end AXIS_DESCR
/end CHARACTERISTIC
/begin CHARACTERISTIC KL_POKABCGSP23 "Temp. abhängiger Druckoffset auf Schaltdruck KAB fuer HS" CURVE 0x1B764C ZF_kl_si16_S5_S3 2.5 UMR_BAR__1_1000_0_S5_S3 -1.25 1.25
 /begin AXIS_DESCR STD_AXIS zff_atsys._.iSignale._.obj.sig_c_getr UMR_GRADC__1_1_M40_S5_S3 3 -40 150 DEPOSIT ABSOLUTE /end AXIS_DESCR
/end CHARACTERISTIC
/begin CHARACTERISTIC KL_POKABCGSP34 "Temp. abhängiger Druckoffset auf Schaltdruck KAB fuer HS" CURVE 0x1B7744 ZF_kl_si16_S5_S3 2.5 UMR_BAR__1_1000_0_S5_S3 -1.25 1.25
 /begin AXIS_DESCR STD_AXIS zff_atsys._.iSignale._.obj.sig_c_getr UMR_GRADC__1_1_M40_S5_S3 3 -40 150 DEPOSIT ABSOLUTE /end AXIS_DESCR
/end CHARACTERISTIC
/begin CHARACTERISTIC KL_POKABCGSP45 "Temp. abhängiger Druckoffset auf Schaltdruck KAB fuer HS" CURVE 0x1B783C ZF_kl_si16_S5_S3 2.5 UMR_BAR__1_1000_0_S5_S3 -1.25 1.25
 /begin AXIS_DESCR STD_AXIS zff_atsys._.iSignale._.obj.sig_c_getr UMR_GRADC__1_1_M40_S5_S3 3 -40 150 DEPOSIT ABSOLUTE /end AXIS_DESCR
/end CHARACTERISTIC
/begin CHARACTERISTIC KL_POKABCGSP56 "Temp. abhängiger Druckoffset auf Schaltdruck KAB fuer HS" CURVE 0x1B7934 ZF_kl_si16_S5_S3 2.5 UMR_BAR__1_1000_0_S5_S3 -1.25 1.25
 /begin AXIS_DESCR STD_AXIS zff_atsys._.iSignale._.obj.sig_c_getr UMR_GRADC__1_1_M40_S5_S3 3 -40 150 DEPOSIT ABSOLUTE /end AXIS_DESCR
/end CHARACTERISTIC
/begin CHARACTERISTIC KL_POKABCGSP67 "Temp. abhängiger Druckoffset auf Schaltdruck KAB fuer HS" CURVE 0x1B7A2C ZF_kl_si16_S5_S3 2.5 UMR_BAR__1_1000_0_S5_S3 -1.25 1.25
 /begin AXIS_DESCR STD_AXIS zff_atsys._.iSignale._.obj.sig_c_getr UMR_GRADC__1_1_M40_S5_S3 3 -40 150 DEPOSIT ABSOLUTE /end AXIS_DESCR
/end CHARACTERISTIC
/begin CHARACTERISTIC KL_POKABCGSP78 "Temp. abhängiger Druckoffset auf Schaltdruck KAB fuer HS" CURVE 0x1B7B24 ZF_kl_si16_S5_S3 2.5 UMR_BAR__1_1000_0_S5_S3 -1.25 1.25
 /begin AXIS_DESCR STD_AXIS zff_atsys._.iSignale._.obj.sig_c_getr UMR_GRADC__1_1_M40_S5_S3 3 -40 150 DEPOSIT ABSOLUTE /end AXIS_DESCR
/end CHARACTERISTIC
/begin CHARACTERISTIC KL_POKABV12 "Druckoffset Folgeschaltung in Abhaengigkeit von m_t" CURVE 0x1B2E18 ZF_kl_si16_S5_S3 12 UMR_BAR__1_1000_0_S5_S3 -6 6
 /begin AXIS_DESCR STD_AXIS zff_atsys._.iSignale._.obj.sig_m_t UMR_NM__1_1_0_S5_S3 4 -200 1300 DEPOSIT ABSOLUTE /end AXIS_DESCR
/end CHARACTERISTIC
/begin CHARACTERISTIC KL_POKABV21 "Druckoffset Folgeschaltung in Abhaengigkeit von m_t" CURVE 0x1B2F1C ZF_kl_si16_S5_S3 12 UMR_BAR__1_1000_0_S5_S3 -6 6
 /begin AXIS_DESCR STD_AXIS zff_atsys._.iSignale._.obj.sig_m_t UMR_NM__1_1_0_S5_S3 4 -200 1300 DEPOSIT ABSOLUTE /end AXIS_DESCR
/end CHARACTERISTIC
/begin CHARACTERISTIC KL_POKABV23 "Druckoffset Folgeschaltung in Abhaengigkeit von m_t" CURVE 0x1B2E40 ZF_kl_si16_S5_S3 12 UMR_BAR__1_1000_0_S5_S3 -6 6
 /begin AXIS_DESCR STD_AXIS zff_atsys._.iSignale._.obj.sig_m_t UMR_NM__1_1_0_S5_S3 4 -200 1300 DEPOSIT ABSOLUTE /end AXIS_DESCR
/end CHARACTERISTIC
/begin CHARACTERISTIC KL_POKABV32 "Druckoffset Folgeschaltung in Abhaengigkeit von m_t" CURVE 0x1B3628 ZF_kl_si16_S5_S3 12 UMR_BAR__1_1000_0_S5_S3 -6 6
 /begin AXIS_DESCR STD_AXIS zff_atsys._.iSignale._.obj.sig_m_t UMR_NM__1_1_0_S5_S3 4 -200 1300 DEPOSIT ABSOLUTE /end AXIS_DESCR
/end CHARACTERISTIC
/begin CHARACTERISTIC KL_POKABV34 "Druckoffset Folgeschaltung in Abhaengigkeit von m_t" CURVE 0x1B2E68 ZF_kl_si16_S5_S3 12 UMR_BAR__1_1000_0_S5_S3 -6 6
 /begin AXIS_DESCR STD_AXIS zff_atsys._.iSignale._.obj.sig_m_t UMR_NM__1_1_0_S5_S3 4 -200 1300 DEPOSIT ABSOLUTE /end AXIS_DESCR
/end CHARACTERISTIC
/begin CHARACTERISTIC KL_POKABV43 "Druckoffset Folgeschaltung in Abhaengigkeit von m_t" CURVE 0x1B3D34 ZF_kl_si16_S5_S3 12 UMR_BAR__1_1000_0_S5_S3 -6 6
 /begin AXIS_DESCR STD_AXIS zff_atsys._.iSignale._.obj.sig_m_t UMR_NM__1_1_0_S5_S3 4 -200 1300 DEPOSIT ABSOLUTE /end AXIS_DESCR
/end CHARACTERISTIC
/begin CHARACTERISTIC KL_POKABV45 "Druckoffset Folgeschaltung in Abhaengigkeit von m_t" CURVE 0x1B2E90 ZF_kl_si16_S5_S3 12 UMR_BAR__1_1000_0_S5_S3 -6 6
 /begin AXIS_DESCR STD_AXIS zff_atsys._.iSignale._.obj.sig_m_t UMR_NM__1_1_0_S5_S3 4 -200 1300 DEPOSIT ABSOLUTE /end AXIS_DESCR
/end CHARACTERISTIC
/begin CHARACTERISTIC KL_POKABV54 "Druckoffset Folgeschaltung in Abhaengigkeit von m_t" CURVE 0x1B40FC ZF_kl_si16_S5_S3 12 UMR_BAR__1_1000_0_S5_S3 -6 6
 /begin AXIS_DESCR STD_AXIS zff_atsys._.iSignale._.obj.sig_m_t UMR_NM__1_1_0_S5_S3 4 -200 1300 DEPOSIT ABSOLUTE /end AXIS_DESCR
/end CHARACTERISTIC
/begin CHARACTERISTIC KL_POKABV56 "Druckoffset Folgeschaltung in Abhaengigkeit von m_t" CURVE 0x1B2EB8 ZF_kl_si16_S5_S3 12 UMR_BAR__1_1000_0_S5_S3 -6 6
 /begin AXIS_DESCR STD_AXIS zff_atsys._.iSignale._.obj.sig_m_t UMR_NM__1_1_0_S5_S3 4 -200 1300 DEPOSIT ABSOLUTE /end AXIS_DESCR
/end CHARACTERISTIC
/begin CHARACTERISTIC KL_POKABV65 "Druckoffset Folgeschaltung in Abhaengigkeit von m_t" CURVE 0x1B4808 ZF_kl_si16_S5_S3 12 UMR_BAR__1_1000_0_S5_S3 -6 6
 /begin AXIS_DESCR STD_AXIS zff_atsys._.iSignale._.obj.sig_m_t UMR_NM__1_1_0_S5_S3 4 -200 1300 DEPOSIT ABSOLUTE /end AXIS_DESCR
/end CHARACTERISTIC
/begin CHARACTERISTIC KL_POKABV67 "Druckoffset Folgeschaltung in Abhaengigkeit von m_t" CURVE 0x1B2EE0 ZF_kl_si16_S5_S3 12 UMR_BAR__1_1000_0_S5_S3 -6 6
 /begin AXIS_DESCR STD_AXIS zff_atsys._.iSignale._.obj.sig_m_t UMR_NM__1_1_0_S5_S3 4 -200 1300 DEPOSIT ABSOLUTE /end AXIS_DESCR
/end CHARACTERISTIC
/begin CHARACTERISTIC KL_POKABV76 "Druckoffset Folgeschaltung in Abhaengigkeit von m_t" CURVE 0x1B4F14 ZF_kl_si16_S5_S3 12 UMR_BAR__1_1000_0_S5_S3 -6 6
 /begin AXIS_DESCR STD_AXIS zff_atsys._.iSignale._.obj.sig_m_t UMR_NM__1_1_0_S5_S3 4 -200 1300 DEPOSIT ABSOLUTE /end AXIS_DESCR
/end CHARACTERISTIC
/begin CHARACTERISTIC KL_POKABV78 "Druckoffset Folgeschaltung in Abhaengigkeit von m_t" CURVE 0x1B2F08 ZF_kl_si16_S5_S3 12 UMR_BAR__1_1000_0_S5_S3 -6 6
 /begin AXIS_DESCR STD_AXIS zff_atsys._.iSignale._.obj.sig_m_t UMR_NM__1_1_0_S5_S3 4 -200 1300 DEPOSIT ABSOLUTE /end AXIS_DESCR
/end CHARACTERISTIC
/begin CHARACTERISTIC KL_POKABV87 "Druckoffset Folgeschaltung in Abhaengigkeit von m_t" CURVE 0x1B5620 ZF_kl_si16_S5_S3 12 UMR_BAR__1_1000_0_S5_S3 -6 6
 /begin AXIS_DESCR STD_AXIS zff_atsys._.iSignale._.obj.sig_m_t UMR_NM__1_1_0_S5_S3 4 -200 1300 DEPOSIT ABSOLUTE /end AXIS_DESCR
/end CHARACTERISTIC
/begin CHARACTERISTIC KL_TOPKABND12 "Zeitoffset f(nd_synistgang) Ende Rampe auf Schaltdruck KAB fuer HS" CURVE 0x1B67FC ZF_kl_si16_S5_S3 1000 UMR_MSEC__10_1_0_S5_S3 0 1000
 /begin AXIS_DESCR STD_AXIS iSasZentr.iSchaltend.nd_synistgang UMR_U_MIN_1_1_0_S5_S3 4 -8000 8000 DEPOSIT ABSOLUTE /end AXIS_DESCR
/end CHARACTERISTIC
/begin CHARACTERISTIC KL_TOPKABND12_EL "Zeitoffset f(nd_synistgang) Ende Rampe auf Schaltdruck KAB fuer HS" CURVE 0x1B6810 ZF_kl_si16_S5_S3 1000 UMR_MSEC__10_1_0_S5_S3 0 1000
 /begin AXIS_DESCR STD_AXIS iSasZentr.iSchaltend.nd_synistgang UMR_U_MIN_1_1_0_S5_S3 4 -8000 8000 DEPOSIT ABSOLUTE /end AXIS_DESCR
/end CHARACTERISTIC
/begin CHARACTERISTIC KL_TOPKABND23 "Zeitoffset f(nd_synistgang) Ende Rampe auf Schaltdruck KAB fuer HS" CURVE 0x1B69DC ZF_kl_si16_S5_S3 1000 UMR_MSEC__10_1_0_S5_S3 0 1000
 /begin AXIS_DESCR STD_AXIS iSasZentr.iSchaltend.nd_synistgang UMR_U_MIN_1_1_0_S5_S3 4 -8000 8000 DEPOSIT ABSOLUTE /end AXIS_DESCR
/end CHARACTERISTIC
/begin CHARACTERISTIC KL_TOPKABND23_EL "Zeitoffset f(nd_synistgang) Ende Rampe auf Schaltdruck KAB fuer HS" CURVE 0x1B69F0 ZF_kl_si16_S5_S3 1000 UMR_MSEC__10_1_0_S5_S3 0 1000
 /begin AXIS_DESCR STD_AXIS iSasZentr.iSchaltend.nd_synistgang UMR_U_MIN_1_1_0_S5_S3 4 -8000 8000 DEPOSIT ABSOLUTE /end AXIS_DESCR
/end CHARACTERISTIC
/begin CHARACTERISTIC KL_TOPKABND34 "Zeitoffset f(nd_synistgang) Ende Rampe auf Schaltdruck KAB fuer HS" CURVE 0x1B6BBC ZF_kl_si16_S5_S3 1000 UMR_MSEC__10_1_0_S5_S3 0 1000
 /begin AXIS_DESCR STD_AXIS iSasZentr.iSchaltend.nd_synistgang UMR_U_MIN_1_1_0_S5_S3 4 -8000 8000 DEPOSIT ABSOLUTE /end AXIS_DESCR
/end CHARACTERISTIC
/begin CHARACTERISTIC KL_TOPKABND34_EL "Zeitoffset f(nd_synistgang) Ende Rampe auf Schaltdruck KAB fuer HS" CURVE 0x1B6BD0 ZF_kl_si16_S5_S3 1000 UMR_MSEC__10_1_0_S5_S3 0 1000
 /begin AXIS_DESCR STD_AXIS iSasZentr.iSchaltend.nd_synistgang UMR_U_MIN_1_1_0_S5_S3 4 -8000 8000 DEPOSIT ABSOLUTE /end AXIS_DESCR
/end CHARACTERISTIC
/begin CHARACTERISTIC KL_TOPKABND45 "Zeitoffset f(nd_synistgang) Ende Rampe auf Schaltdruck KAB fuer HS" CURVE 0x1B6D9C ZF_kl_si16_S5_S3 1000 UMR_MSEC__10_1_0_S5_S3 0 1000
 /begin AXIS_DESCR STD_AXIS iSasZentr.iSchaltend.nd_synistgang UMR_U_MIN_1_1_0_S5_S3 4 -8000 8000 DEPOSIT ABSOLUTE /end AXIS_DESCR
/end CHARACTERISTIC
/begin CHARACTERISTIC KL_TOPKABND45_EL "Zeitoffset f(nd_synistgang) Ende Rampe auf Schaltdruck KAB fuer HS" CURVE 0x1B6DB0 ZF_kl_si16_S5_S3 1000 UMR_MSEC__10_1_0_S5_S3 0 1000
 /begin AXIS_DESCR STD_AXIS iSasZentr.iSchaltend.nd_synistgang UMR_U_MIN_1_1_0_S5_S3 4 -8000 8000 DEPOSIT ABSOLUTE /end AXIS_DESCR
/end CHARACTERISTIC
/begin CHARACTERISTIC KL_TOPKABND56 "Zeitoffset f(nd_synistgang) Ende Rampe auf Schaltdruck KAB fuer HS" CURVE 0x1B6F7C ZF_kl_si16_S5_S3 1000 UMR_MSEC__10_1_0_S5_S3 0 1000
 /begin AXIS_DESCR STD_AXIS iSasZentr.iSchaltend.nd_synistgang UMR_U_MIN_1_1_0_S5_S3 4 -8000 8000 DEPOSIT ABSOLUTE /end AXIS_DESCR
/end CHARACTERISTIC
/begin CHARACTERISTIC KL_TOPKABND56_EL "Zeitoffset f(nd_synistgang) Ende Rampe auf Schaltdruck KAB fuer HS" CURVE 0x1B6F90 ZF_kl_si16_S5_S3 1000 UMR_MSEC__10_1_0_S5_S3 0 1000
 /begin AXIS_DESCR STD_AXIS iSasZentr.iSchaltend.nd_synistgang UMR_U_MIN_1_1_0_S5_S3 4 -8000 8000 DEPOSIT ABSOLUTE /end AXIS_DESCR
/end CHARACTERISTIC
/begin CHARACTERISTIC KL_TOPKABND67 "Zeitoffset f(nd_synistgang) Ende Rampe auf Schaltdruck KAB fuer HS" CURVE 0x1B715C ZF_kl_si16_S5_S3 1000 UMR_MSEC__10_1_0_S5_S3 0 1000
 /begin AXIS_DESCR STD_AXIS iSasZentr.iSchaltend.nd_synistgang UMR_U_MIN_1_1_0_S5_S3 4 -8000 8000 DEPOSIT ABSOLUTE /end AXIS_DESCR
/end CHARACTERISTIC
/begin CHARACTERISTIC KL_TOPKABND67_EL "Zeitoffset f(nd_synistgang) Ende Rampe auf Schaltdruck KAB fuer HS" CURVE 0x1B7170 ZF_kl_si16_S5_S3 1000 UMR_MSEC__10_1_0_S5_S3 0 1000
 /begin AXIS_DESCR STD_AXIS iSasZentr.iSchaltend.nd_synistgang UMR_U_MIN_1_1_0_S5_S3 4 -8000 8000 DEPOSIT ABSOLUTE /end AXIS_DESCR
/end CHARACTERISTIC
/begin CHARACTERISTIC KL_TOPKABND78 "Zeitoffset f(nd_synistgang) Ende Rampe auf Schaltdruck KAB fuer HS" CURVE 0x1B733C ZF_kl_si16_S5_S3 1000 UMR_MSEC__10_1_0_S5_S3 0 1000
 /begin AXIS_DESCR STD_AXIS iSasZentr.iSchaltend.nd_synistgang UMR_U_MIN_1_1_0_S5_S3 4 -8000 8000 DEPOSIT ABSOLUTE /end AXIS_DESCR
/end CHARACTERISTIC
/begin CHARACTERISTIC KL_TOPKABND78_EL "Zeitoffset f(nd_synistgang) Ende Rampe auf Schaltdruck KAB fuer HS" CURVE 0x1B7350 ZF_kl_si16_S5_S3 1000 UMR_MSEC__10_1_0_S5_S3 0 1000
 /begin AXIS_DESCR STD_AXIS iSasZentr.iSchaltend.nd_synistgang UMR_U_MIN_1_1_0_S5_S3 4 -8000 8000 DEPOSIT ABSOLUTE /end AXIS_DESCR
/end CHARACTERISTIC
/begin CHARACTERISTIC KL_TOPKABNDSP12 "Zeitoffset f(nd_synistgang) Ende Rampe auf Schaltdruck KAB fuer HS" CURVE 0x1B74C4 ZF_kl_si16_S5_S3 1000 UMR_MSEC__10_1_0_S5_S3 0 1000
 /begin AXIS_DESCR STD_AXIS iSasZentr.iSchaltend.nd_synistgang UMR_U_MIN_1_1_0_S5_S3 4 -8000 8000 DEPOSIT ABSOLUTE /end AXIS_DESCR
/end CHARACTERISTIC
/begin CHARACTERISTIC KL_TOPKABNDSP23 "Zeitoffset f(nd_synistgang) Ende Rampe auf Schaltdruck KAB fuer HS" CURVE 0x1B75BC ZF_kl_si16_S5_S3 1000 UMR_MSEC__10_1_0_S5_S3 0 1000
 /begin AXIS_DESCR STD_AXIS iSasZentr.iSchaltend.nd_synistgang UMR_U_MIN_1_1_0_S5_S3 4 -8000 8000 DEPOSIT ABSOLUTE /end AXIS_DESCR
/end CHARACTERISTIC
/begin CHARACTERISTIC KL_TOPKABNDSP34 "Zeitoffset f(nd_synistgang) Ende Rampe auf Schaltdruck KAB fuer HS" CURVE 0x1B76B4 ZF_kl_si16_S5_S3 1000 UMR_MSEC__10_1_0_S5_S3 0 1000
 /begin AXIS_DESCR STD_AXIS iSasZentr.iSchaltend.nd_synistgang UMR_U_MIN_1_1_0_S5_S3 4 -8000 8000 DEPOSIT ABSOLUTE /end AXIS_DESCR
/end CHARACTERISTIC
/begin CHARACTERISTIC KL_TOPKABNDSP45 "Zeitoffset f(nd_synistgang) Ende Rampe auf Schaltdruck KAB fuer HS" CURVE 0x1B77AC ZF_kl_si16_S5_S3 1000 UMR_MSEC__10_1_0_S5_S3 0 1000
 /begin AXIS_DESCR STD_AXIS iSasZentr.iSchaltend.nd_synistgang UMR_U_MIN_1_1_0_S5_S3 4 -8000 8000 DEPOSIT ABSOLUTE /end AXIS_DESCR
/end CHARACTERISTIC
/begin CHARACTERISTIC KL_TOPKABNDSP56 "Zeitoffset f(nd_synistgang) Ende Rampe auf Schaltdruck KAB fuer HS" CURVE 0x1B78A4 ZF_kl_si16_S5_S3 1000 UMR_MSEC__10_1_0_S5_S3 0 1000
 /begin AXIS_DESCR STD_AXIS iSasZentr.iSchaltend.nd_synistgang UMR_U_MIN_1_1_0_S5_S3 4 -8000 8000 DEPOSIT ABSOLUTE /end AXIS_DESCR
/end CHARACTERISTIC
/begin CHARACTERISTIC KL_TOPKABNDSP67 "Zeitoffset f(nd_synistgang) Ende Rampe auf Schaltdruck KAB fuer HS" CURVE 0x1B799C ZF_kl_si16_S5_S3 1000 UMR_MSEC__10_1_0_S5_S3 0 1000
 /begin AXIS_DESCR STD_AXIS iSasZentr.iSchaltend.nd_synistgang UMR_U_MIN_1_1_0_S5_S3 4 -8000 8000 DEPOSIT ABSOLUTE /end AXIS_DESCR
/end CHARACTERISTIC
/begin CHARACTERISTIC KL_TOPKABNDSP78 "Zeitoffset f(nd_synistgang) Ende Rampe auf Schaltdruck KAB fuer HS" CURVE 0x1B7A94 ZF_kl_si16_S5_S3 1000 UMR_MSEC__10_1_0_S5_S3 0 1000
 /begin AXIS_DESCR STD_AXIS iSasZentr.iSchaltend.nd_synistgang UMR_U_MIN_1_1_0_S5_S3 4 -8000 8000 DEPOSIT ABSOLUTE /end AXIS_DESCR
/end CHARACTERISTIC
/begin CHARACTERISTIC KL_TSYNMTKABV12 "Zeit vor sync. Ende Haltephase vorb. KAB" CURVE 0x1B2E04 ZF_kl_si16_S5_S3 5000 UMR_MSEC__10_1_0_S5_S3 -5000 0
 /begin AXIS_DESCR STD_AXIS zff_atsys._.iSignale._.obj.sig_m_t UMR_NM__1_1_0_S5_S3 4 -200 1300 DEPOSIT ABSOLUTE /end AXIS_DESCR
/end CHARACTERISTIC
/begin CHARACTERISTIC KL_TSYNMTKABV21 "Zeit vor sync. Ende Haltephase vorb. KAB" CURVE 0x1B2FA0 ZF_kl_si16_S5_S3 5000 UMR_MSEC__10_1_0_S5_S3 -5000 0
 /begin AXIS_DESCR STD_AXIS zff_atsys._.iSignale._.obj.sig_m_t UMR_NM__1_1_0_S5_S3 4 -200 1300 DEPOSIT ABSOLUTE /end AXIS_DESCR
/end CHARACTERISTIC
/begin CHARACTERISTIC KL_TSYNMTKABV23 "Zeit vor sync. Ende Haltephase vorb. KAB" CURVE 0x1B2E2C ZF_kl_si16_S5_S3 5000 UMR_MSEC__10_1_0_S5_S3 -5000 0
 /begin AXIS_DESCR STD_AXIS zff_atsys._.iSignale._.obj.sig_m_t UMR_NM__1_1_0_S5_S3 4 -200 1300 DEPOSIT ABSOLUTE /end AXIS_DESCR
/end CHARACTERISTIC
/begin CHARACTERISTIC KL_TSYNMTKABV32 "Zeit vor sync. Ende Haltephase vorb. KAB" CURVE 0x1B36AC ZF_kl_si16_S5_S3 5000 UMR_MSEC__10_1_0_S5_S3 -5000 0
 /begin AXIS_DESCR STD_AXIS zff_atsys._.iSignale._.obj.sig_m_t UMR_NM__1_1_0_S5_S3 4 -200 1300 DEPOSIT ABSOLUTE /end AXIS_DESCR
/end CHARACTERISTIC
/begin CHARACTERISTIC KL_TSYNMTKABV34 "Zeit vor sync. Ende Haltephase vorb. KAB" CURVE 0x1B2E54 ZF_kl_si16_S5_S3 5000 UMR_MSEC__10_1_0_S5_S3 -5000 0
 /begin AXIS_DESCR STD_AXIS zff_atsys._.iSignale._.obj.sig_m_t UMR_NM__1_1_0_S5_S3 4 -200 1300 DEPOSIT ABSOLUTE /end AXIS_DESCR
/end CHARACTERISTIC
/begin CHARACTERISTIC KL_TSYNMTKABV43 "Zeit vor sync. Ende Haltephase vorb. KAB" CURVE 0x1B3DB8 ZF_kl_si16_S5_S3 5000 UMR_MSEC__10_1_0_S5_S3 -5000 0
 /begin AXIS_DESCR STD_AXIS zff_atsys._.iSignale._.obj.sig_m_t UMR_NM__1_1_0_S5_S3 4 -200 1300 DEPOSIT ABSOLUTE /end AXIS_DESCR
/end CHARACTERISTIC
/begin CHARACTERISTIC KL_TSYNMTKABV45 "Zeit vor sync. Ende Haltephase vorb. KAB" CURVE 0x1B2E7C ZF_kl_si16_S5_S3 5000 UMR_MSEC__10_1_0_S5_S3 -5000 0
 /begin AXIS_DESCR STD_AXIS zff_atsys._.iSignale._.obj.sig_m_t UMR_NM__1_1_0_S5_S3 4 -200 1300 DEPOSIT ABSOLUTE /end AXIS_DESCR
/end CHARACTERISTIC
/begin CHARACTERISTIC KL_TSYNMTKABV54 "Zeit vor sync. Ende Haltephase vorb. KAB" CURVE 0x1B4180 ZF_kl_si16_S5_S3 5000 UMR_MSEC__10_1_0_S5_S3 -5000 0
 /begin AXIS_DESCR STD_AXIS zff_atsys._.iSignale._.obj.sig_m_t UMR_NM__1_1_0_S5_S3 4 -200 1300 DEPOSIT ABSOLUTE /end AXIS_DESCR
/end CHARACTERISTIC
/begin CHARACTERISTIC KL_TSYNMTKABV56 "Zeit vor sync. Ende Haltephase vorb. KAB" CURVE 0x1B2EA4 ZF_kl_si16_S5_S3 5000 UMR_MSEC__10_1_0_S5_S3 -5000 0
 /begin AXIS_DESCR STD_AXIS zff_atsys._.iSignale._.obj.sig_m_t UMR_NM__1_1_0_S5_S3 4 -200 1300 DEPOSIT ABSOLUTE /end AXIS_DESCR
/end CHARACTERISTIC
/begin CHARACTERISTIC KL_TSYNMTKABV65 "Zeit vor sync. Ende Haltephase vorb. KAB" CURVE 0x1B488C ZF_kl_si16_S5_S3 5000 UMR_MSEC__10_1_0_S5_S3 -5000 0
 /begin AXIS_DESCR STD_AXIS zff_atsys._.iSignale._.obj.sig_m_t UMR_NM__1_1_0_S5_S3 4 -200 1300 DEPOSIT ABSOLUTE /end AXIS_DESCR
/end CHARACTERISTIC
/begin CHARACTERISTIC KL_TSYNMTKABV67 "Zeit vor sync. Ende Haltephase vorb. KAB" CURVE 0x1B2ECC ZF_kl_si16_S5_S3 5000 UMR_MSEC__10_1_0_S5_S3 -5000 0
 /begin AXIS_DESCR STD_AXIS zff_atsys._.iSignale._.obj.sig_m_t UMR_NM__1_1_0_S5_S3 4 -200 1300 DEPOSIT ABSOLUTE /end AXIS_DESCR
/end CHARACTERISTIC
/begin CHARACTERISTIC KL_TSYNMTKABV76 "Zeit vor sync. Ende Haltephase vorb. KAB" CURVE 0x1B4F98 ZF_kl_si16_S5_S3 5000 UMR_MSEC__10_1_0_S5_S3 -5000 0
 /begin AXIS_DESCR STD_AXIS zff_atsys._.iSignale._.obj.sig_m_t UMR_NM__1_1_0_S5_S3 4 -200 1300 DEPOSIT ABSOLUTE /end AXIS_DESCR
/end CHARACTERISTIC
/begin CHARACTERISTIC KL_TSYNMTKABV78 "Zeit vor sync. Ende Haltephase vorb. KAB" CURVE 0x1B2EF4 ZF_kl_si16_S5_S3 5000 UMR_MSEC__10_1_0_S5_S3 -5000 0
 /begin AXIS_DESCR STD_AXIS zff_atsys._.iSignale._.obj.sig_m_t UMR_NM__1_1_0_S5_S3 4 -200 1300 DEPOSIT ABSOLUTE /end AXIS_DESCR
/end CHARACTERISTIC
/begin CHARACTERISTIC KL_TSYNMTKABV87 "Zeit vor sync. Ende Haltephase vorb. KAB" CURVE 0x1B56A4 ZF_kl_si16_S5_S3 5000 UMR_MSEC__10_1_0_S5_S3 -5000 0
 /begin AXIS_DESCR STD_AXIS zff_atsys._.iSignale._.obj.sig_m_t UMR_NM__1_1_0_S5_S3 4 -200 1300 DEPOSIT ABSOLUTE /end AXIS_DESCR
/end CHARACTERISTIC
/begin CHARACTERISTIC KL_TSYNMTKABVFOLNACH64MRS43 "Zeit vor sync. Ende Haltephase vorb. KAB" CURVE 0x1B26E0 ZF_kl_si16_S5_S3 5000 UMR_MSEC__10_1_0_S5_S3 -5000 0
 /begin AXIS_DESCR STD_AXIS zff_atsys._.iSignale._.obj.sig_m_t UMR_NM__1_1_0_S5_S3 4 -200 1300 DEPOSIT ABSOLUTE /end AXIS_DESCR
/end CHARACTERISTIC
/begin CHARACTERISTIC KL_TSYNMTKABVFOLNACH84MRS43 "Zeit vor sync. Ende Haltephase vorb. KAB" CURVE 0x1B26CC ZF_kl_si16_S5_S3 5000 UMR_MSEC__10_1_0_S5_S3 -5000 0
 /begin AXIS_DESCR STD_AXIS zff_atsys._.iSignale._.obj.sig_m_t UMR_NM__1_1_0_S5_S3 4 -200 1300 DEPOSIT ABSOLUTE /end AXIS_DESCR
/end CHARACTERISTIC
/begin CHARACTERISTIC KL_TSYNMTKABVFOLNACHMRS21 "Zeit vor sync. Ende Haltephase vorb. KAB" CURVE 0x1B2FB4 ZF_kl_si16_S5_S3 5000 UMR_MSEC__10_1_0_S5_S3 -5000 0
 /begin AXIS_DESCR STD_AXIS zff_atsys._.iSignale._.obj.sig_m_t UMR_NM__1_1_0_S5_S3 4 -200 1300 DEPOSIT ABSOLUTE /end AXIS_DESCR
/end CHARACTERISTIC
/begin CHARACTERISTIC KL_TSYNMTKABVFOLNACHMRS32 "Zeit vor sync. Ende Haltephase vorb. KAB" CURVE 0x1B36C0 ZF_kl_si16_S5_S3 5000 UMR_MSEC__10_1_0_S5_S3 -5000 0
 /begin AXIS_DESCR STD_AXIS zff_atsys._.iSignale._.obj.sig_m_t UMR_NM__1_1_0_S5_S3 4 -200 1300 DEPOSIT ABSOLUTE /end AXIS_DESCR
/end CHARACTERISTIC
/begin CHARACTERISTIC KL_TSYNMTKABVFOLNACHMRS54 "Zeit vor sync. Ende Haltephase vorb. KAB" CURVE 0x1B4194 ZF_kl_si16_S5_S3 5000 UMR_MSEC__10_1_0_S5_S3 -5000 0
 /begin AXIS_DESCR STD_AXIS zff_atsys._.iSignale._.obj.sig_m_t UMR_NM__1_1_0_S5_S3 4 -200 1300 DEPOSIT ABSOLUTE /end AXIS_DESCR
/end CHARACTERISTIC
/begin CHARACTERISTIC KL_TSYNMTKABVFOLNACHMRS65 "Zeit vor sync. Ende Haltephase vorb. KAB" CURVE 0x1B48A0 ZF_kl_si16_S5_S3 5000 UMR_MSEC__10_1_0_S5_S3 -5000 0
 /begin AXIS_DESCR STD_AXIS zff_atsys._.iSignale._.obj.sig_m_t UMR_NM__1_1_0_S5_S3 4 -200 1300 DEPOSIT ABSOLUTE /end AXIS_DESCR
/end CHARACTERISTIC
/begin CHARACTERISTIC KL_TSYNMTKABVFOLNACHMRS76 "Zeit vor sync. Ende Haltephase vorb. KAB" CURVE 0x1B4FAC ZF_kl_si16_S5_S3 5000 UMR_MSEC__10_1_0_S5_S3 -5000 0
 /begin AXIS_DESCR STD_AXIS zff_atsys._.iSignale._.obj.sig_m_t UMR_NM__1_1_0_S5_S3 4 -200 1300 DEPOSIT ABSOLUTE /end AXIS_DESCR
/end CHARACTERISTIC
/begin CHARACTERISTIC KL_TSYNMTKABVFOLNACHMRS87 "Zeit vor sync. Ende Haltephase vorb. KAB" CURVE 0x1B56B8 ZF_kl_si16_S5_S3 5000 UMR_MSEC__10_1_0_S5_S3 -5000 0
 /begin AXIS_DESCR STD_AXIS zff_atsys._.iSignale._.obj.sig_m_t UMR_NM__1_1_0_S5_S3 4 -200 1300 DEPOSIT ABSOLUTE /end AXIS_DESCR
/end CHARACTERISTIC
/begin CHARACTERISTIC KL_TVGLSKZUCG32 "Verzoegerungszeit GLS-Beginn" CURVE 0x1B2600 ZF_kl_ui8_S5_S3 2540 UMR_MSEC__10_1_0_S5_S3 0 2540
 /begin AXIS_DESCR STD_AXIS zff_atsys._.iSignale._.obj.sig_c_getr UMR_GRADC__1_1_M40_S5_S3 3 -40 150 DEPOSIT ABSOLUTE /end AXIS_DESCR
/end CHARACTERISTIC
/begin CHARACTERISTIC KL_TVGLSKZUCG43 "Verzoegerungszeit GLS-Beginn" CURVE 0x1B260C ZF_kl_ui8_S5_S3 2540 UMR_MSEC__10_1_0_S5_S3 0 2540
 /begin AXIS_DESCR STD_AXIS zff_atsys._.iSignale._.obj.sig_c_getr UMR_GRADC__1_1_M40_S5_S3 3 -40 150 DEPOSIT ABSOLUTE /end AXIS_DESCR
/end CHARACTERISTIC
/begin CHARACTERISTIC KL_TVGLSKZUCG54 "Verzoegerungszeit GLS-Beginn" CURVE 0x1B2618 ZF_kl_ui8_S5_S3 2540 UMR_MSEC__10_1_0_S5_S3 0 2540
 /begin AXIS_DESCR STD_AXIS zff_atsys._.iSignale._.obj.sig_c_getr UMR_GRADC__1_1_M40_S5_S3 3 -40 150 DEPOSIT ABSOLUTE /end AXIS_DESCR
/end CHARACTERISTIC
/begin CHARACTERISTIC KL_TVGLSKZUCG65 "Verzoegerungszeit GLS-Beginn" CURVE 0x1B2624 ZF_kl_ui8_S5_S3 2540 UMR_MSEC__10_1_0_S5_S3 0 2540
 /begin AXIS_DESCR STD_AXIS zff_atsys._.iSignale._.obj.sig_c_getr UMR_GRADC__1_1_M40_S5_S3 3 -40 150 DEPOSIT ABSOLUTE /end AXIS_DESCR
/end CHARACTERISTIC
/begin CHARACTERISTIC KL_TVGLSKZUCG76 "Verzoegerungszeit GLS-Beginn" CURVE 0x1B2630 ZF_kl_ui8_S5_S3 2540 UMR_MSEC__10_1_0_S5_S3 0 2540
 /begin AXIS_DESCR STD_AXIS zff_atsys._.iSignale._.obj.sig_c_getr UMR_GRADC__1_1_M40_S5_S3 3 -40 150 DEPOSIT ABSOLUTE /end AXIS_DESCR
/end CHARACTERISTIC
/begin CHARACTERISTIC KL_TVGLSKZUCG87 "Verzoegerungszeit GLS-Beginn" CURVE 0x1B263C ZF_kl_ui8_S5_S3 2540 UMR_MSEC__10_1_0_S5_S3 0 2540
 /begin AXIS_DESCR STD_AXIS zff_atsys._.iSignale._.obj.sig_c_getr UMR_GRADC__1_1_M40_S5_S3 3 -40 150 DEPOSIT ABSOLUTE /end AXIS_DESCR
/end CHARACTERISTIC
/begin CHARACTERISTIC KL_TVGLSKZUCGSP42 "Verzoegerungszeit GLS-Beginn" CURVE 0x1B2654 ZF_kl_ui8_S5_S3 2540 UMR_MSEC__10_1_0_S5_S3 0 2540
 /begin AXIS_DESCR STD_AXIS zff_atsys._.iSignale._.obj.sig_c_getr UMR_GRADC__1_1_M40_S5_S3 3 -40 150 DEPOSIT ABSOLUTE /end AXIS_DESCR
/end CHARACTERISTIC
/begin CHARACTERISTIC KL_TVGLSKZUCGSP51 "Verzoegerungszeit GLS-Beginn" CURVE 0x1B2660 ZF_kl_ui8_S5_S3 2540 UMR_MSEC__10_1_0_S5_S3 0 2540
 /begin AXIS_DESCR STD_AXIS zff_atsys._.iSignale._.obj.sig_c_getr UMR_GRADC__1_1_M40_S5_S3 3 -40 150 DEPOSIT ABSOLUTE /end AXIS_DESCR
/end CHARACTERISTIC
/begin CHARACTERISTIC KL_TVGLSKZUCGSP53 "Verzoegerungszeit GLS-Beginn" CURVE 0x1B266C ZF_kl_ui8_S5_S3 2540 UMR_MSEC__10_1_0_S5_S3 0 2540
 /begin AXIS_DESCR STD_AXIS zff_atsys._.iSignale._.obj.sig_c_getr UMR_GRADC__1_1_M40_S5_S3 3 -40 150 DEPOSIT ABSOLUTE /end AXIS_DESCR
/end CHARACTERISTIC
/begin CHARACTERISTIC KL_TVGLSKZUCGSP63 "Verzoegerungszeit GLS-Beginn" CURVE 0x1B2678 ZF_kl_ui8_S5_S3 2540 UMR_MSEC__10_1_0_S5_S3 0 2540
 /begin AXIS_DESCR STD_AXIS zff_atsys._.iSignale._.obj.sig_c_getr UMR_GRADC__1_1_M40_S5_S3 3 -40 150 DEPOSIT ABSOLUTE /end AXIS_DESCR
/end CHARACTERISTIC
/begin CHARACTERISTIC KL_TVGLSKZUCGSP64 "Verzoegerungszeit GLS-Beginn" CURVE 0x1B2684 ZF_kl_ui8_S5_S3 2540 UMR_MSEC__10_1_0_S5_S3 0 2540
 /begin AXIS_DESCR STD_AXIS zff_atsys._.iSignale._.obj.sig_c_getr UMR_GRADC__1_1_M40_S5_S3 3 -40 150 DEPOSIT ABSOLUTE /end AXIS_DESCR
/end CHARACTERISTIC
/begin CHARACTERISTIC KL_TVGLSKZUCGSP71 "Verzoegerungszeit GLS-Beginn" CURVE 0x1B2690 ZF_kl_ui8_S5_S3 2540 UMR_MSEC__10_1_0_S5_S3 0 2540
 /begin AXIS_DESCR STD_AXIS zff_atsys._.iSignale._.obj.sig_c_getr UMR_GRADC__1_1_M40_S5_S3 3 -40 150 DEPOSIT ABSOLUTE /end AXIS_DESCR
/end CHARACTERISTIC
/begin CHARACTERISTIC KL_TVGLSKZUCGSP75 "Verzoegerungszeit GLS-Beginn" CURVE 0x1B269C ZF_kl_ui8_S5_S3 2540 UMR_MSEC__10_1_0_S5_S3 0 2540
 /begin AXIS_DESCR STD_AXIS zff_atsys._.iSignale._.obj.sig_c_getr UMR_GRADC__1_1_M40_S5_S3 3 -40 150 DEPOSIT ABSOLUTE /end AXIS_DESCR
/end CHARACTERISTIC
/begin CHARACTERISTIC KL_TVGLSKZUCGSP82 "Verzoegerungszeit GLS-Beginn" CURVE 0x1B26A8 ZF_kl_ui8_S5_S3 2540 UMR_MSEC__10_1_0_S5_S3 0 2540
 /begin AXIS_DESCR STD_AXIS zff_atsys._.iSignale._.obj.sig_c_getr UMR_GRADC__1_1_M40_S5_S3 3 -40 150 DEPOSIT ABSOLUTE /end AXIS_DESCR
/end CHARACTERISTIC
/begin CHARACTERISTIC KL_TVGLSKZUCGSP84 "Verzoegerungszeit GLS-Beginn" CURVE 0x1B26B4 ZF_kl_ui8_S5_S3 2540 UMR_MSEC__10_1_0_S5_S3 0 2540
 /begin AXIS_DESCR STD_AXIS zff_atsys._.iSignale._.obj.sig_c_getr UMR_GRADC__1_1_M40_S5_S3 3 -40 150 DEPOSIT ABSOLUTE /end AXIS_DESCR
/end CHARACTERISTIC
/begin CHARACTERISTIC KL_TVGLSKZUCGSP86 "Verzoegerungszeit GLS-Beginn" CURVE 0x1B26C0 ZF_kl_ui8_S5_S3 2540 UMR_MSEC__10_1_0_S5_S3 0 2540
 /begin AXIS_DESCR STD_AXIS zff_atsys._.iSignale._.obj.sig_c_getr UMR_GRADC__1_1_M40_S5_S3 3 -40 150 DEPOSIT ABSOLUTE /end AXIS_DESCR
/end CHARACTERISTIC
/begin CHARACTERISTIC KP_GLSKAB32 "Proportionalfaktor PID-Regler GLS" VALUE 0x1D87FC ZF_kw_ui16_S5_S3 10000 UMR_MBARMINSEC__1_1_0_S5_S3 0 10000 /end CHARACTERISTIC
/begin CHARACTERISTIC KP_GLSKAB32_EL "Proportionalfaktor PID-Regler GLS" VALUE 0x1D87FE ZF_kw_ui16_S5_S3 10000 UMR_MBARMINSEC__1_1_0_S5_S3 0 10000 /end CHARACTERISTIC
/begin CHARACTERISTIC KP_GLSKAB43 "Proportionalfaktor PID-Regler GLS" VALUE 0x1D8820 ZF_kw_ui16_S5_S3 10000 UMR_MBARMINSEC__1_1_0_S5_S3 0 10000 /end CHARACTERISTIC
/begin CHARACTERISTIC KP_GLSKAB43_EL "Proportionalfaktor PID-Regler GLS" VALUE 0x1D8822 ZF_kw_ui16_S5_S3 10000 UMR_MBARMINSEC__1_1_0_S5_S3 0 10000 /end CHARACTERISTIC
/begin CHARACTERISTIC KP_GLSKAB54 "Proportionalfaktor PID-Regler GLS" VALUE 0x1D8844 ZF_kw_ui16_S5_S3 10000 UMR_MBARMINSEC__1_1_0_S5_S3 0 10000 /end CHARACTERISTIC
/begin CHARACTERISTIC KP_GLSKAB54_EL "Proportionalfaktor PID-Regler GLS" VALUE 0x1D8846 ZF_kw_ui16_S5_S3 10000 UMR_MBARMINSEC__1_1_0_S5_S3 0 10000 /end CHARACTERISTIC
/begin CHARACTERISTIC KP_GLSKAB65 "Proportionalfaktor PID-Regler GLS" VALUE 0x1D8868 ZF_kw_ui16_S5_S3 10000 UMR_MBARMINSEC__1_1_0_S5_S3 0 10000 /end CHARACTERISTIC
/begin CHARACTERISTIC KP_GLSKAB65_EL "Proportionalfaktor PID-Regler GLS" VALUE 0x1D886A ZF_kw_ui16_S5_S3 10000 UMR_MBARMINSEC__1_1_0_S5_S3 0 10000 /end CHARACTERISTIC
/begin CHARACTERISTIC KP_GLSKAB76 "Proportionalfaktor PID-Regler GLS" VALUE 0x1D888C ZF_kw_ui16_S5_S3 10000 UMR_MBARMINSEC__1_1_0_S5_S3 0 10000 /end CHARACTERISTIC
/begin CHARACTERISTIC KP_GLSKAB76_EL "Proportionalfaktor PID-Regler GLS" VALUE 0x1D888E ZF_kw_ui16_S5_S3 10000 UMR_MBARMINSEC__1_1_0_S5_S3 0 10000 /end CHARACTERISTIC
/begin CHARACTERISTIC KP_GLSKAB87 "Proportionalfaktor PID-Regler GLS" VALUE 0x1D88B0 ZF_kw_ui16_S5_S3 10000 UMR_MBARMINSEC__1_1_0_S5_S3 0 10000 /end CHARACTERISTIC
/begin CHARACTERISTIC KP_GLSKAB87_EL "Proportionalfaktor PID-Regler GLS" VALUE 0x1D88B2 ZF_kw_ui16_S5_S3 10000 UMR_MBARMINSEC__1_1_0_S5_S3 0 10000 /end CHARACTERISTIC
/begin CHARACTERISTIC KP_GLSKABSP42 "Proportionalfaktor PID-Regler GLS" VALUE 0x1D88F8 ZF_kw_ui16_S5_S3 10000 UMR_MBARMINSEC__1_1_0_S5_S3 0 10000 /end CHARACTERISTIC
/begin CHARACTERISTIC KP_GLSKABSP42_EL "Proportionalfaktor PID-Regler GLS" VALUE 0x1D88FA ZF_kw_ui16_S5_S3 10000 UMR_MBARMINSEC__1_1_0_S5_S3 0 10000 /end CHARACTERISTIC
/begin CHARACTERISTIC KP_GLSKABSP51 "Proportionalfaktor PID-Regler GLS" VALUE 0x1D891C ZF_kw_ui16_S5_S3 10000 UMR_MBARMINSEC__1_1_0_S5_S3 0 10000 /end CHARACTERISTIC
/begin CHARACTERISTIC KP_GLSKABSP51_EL "Proportionalfaktor PID-Regler GLS" VALUE 0x1D891E ZF_kw_ui16_S5_S3 10000 UMR_MBARMINSEC__1_1_0_S5_S3 0 10000 /end CHARACTERISTIC
/begin CHARACTERISTIC KP_GLSKABSP53 "Proportionalfaktor PID-Regler GLS" VALUE 0x1D8940 ZF_kw_ui16_S5_S3 10000 UMR_MBARMINSEC__1_1_0_S5_S3 0 10000 /end CHARACTERISTIC
/begin CHARACTERISTIC KP_GLSKABSP53_EL "Proportionalfaktor PID-Regler GLS" VALUE 0x1D8942 ZF_kw_ui16_S5_S3 10000 UMR_MBARMINSEC__1_1_0_S5_S3 0 10000 /end CHARACTERISTIC
/begin CHARACTERISTIC KP_GLSKABSP63 "Proportionalfaktor PID-Regler GLS" VALUE 0x1D8964 ZF_kw_ui16_S5_S3 10000 UMR_MBARMINSEC__1_1_0_S5_S3 0 10000 /end CHARACTERISTIC
/begin CHARACTERISTIC KP_GLSKABSP63_EL "Proportionalfaktor PID-Regler GLS" VALUE 0x1D8966 ZF_kw_ui16_S5_S3 10000 UMR_MBARMINSEC__1_1_0_S5_S3 0 10000 /end CHARACTERISTIC
/begin CHARACTERISTIC KP_GLSKABSP64 "Proportionalfaktor PID-Regler GLS" VALUE 0x1D8988 ZF_kw_ui16_S5_S3 10000 UMR_MBARMINSEC__1_1_0_S5_S3 0 10000 /end CHARACTERISTIC
/begin CHARACTERISTIC KP_GLSKABSP64_EL "Proportionalfaktor PID-Regler GLS" VALUE 0x1D898A ZF_kw_ui16_S5_S3 10000 UMR_MBARMINSEC__1_1_0_S5_S3 0 10000 /end CHARACTERISTIC
/begin CHARACTERISTIC KP_GLSKABSP71 "Proportionalfaktor PID-Regler GLS" VALUE 0x1D89AC ZF_kw_ui16_S5_S3 10000 UMR_MBARMINSEC__1_1_0_S5_S3 0 10000 /end CHARACTERISTIC
/begin CHARACTERISTIC KP_GLSKABSP71_EL "Proportionalfaktor PID-Regler GLS" VALUE 0x1D89AE ZF_kw_ui16_S5_S3 10000 UMR_MBARMINSEC__1_1_0_S5_S3 0 10000 /end CHARACTERISTIC
/begin CHARACTERISTIC KP_GLSKABSP75 "Proportionalfaktor PID-Regler GLS" VALUE 0x1D89D0 ZF_kw_ui16_S5_S3 10000 UMR_MBARMINSEC__1_1_0_S5_S3 0 10000 /end CHARACTERISTIC
/begin CHARACTERISTIC KP_GLSKABSP75_EL "Proportionalfaktor PID-Regler GLS" VALUE 0x1D89D2 ZF_kw_ui16_S5_S3 10000 UMR_MBARMINSEC__1_1_0_S5_S3 0 10000 /end CHARACTERISTIC
/begin CHARACTERISTIC KP_GLSKABSP82 "Proportionalfaktor PID-Regler GLS" VALUE 0x1D89F4 ZF_kw_ui16_S5_S3 10000 UMR_MBARMINSEC__1_1_0_S5_S3 0 10000 /end CHARACTERISTIC
/begin CHARACTERISTIC KP_GLSKABSP82_EL "Proportionalfaktor PID-Regler GLS" VALUE 0x1D89F6 ZF_kw_ui16_S5_S3 10000 UMR_MBARMINSEC__1_1_0_S5_S3 0 10000 /end CHARACTERISTIC
/begin CHARACTERISTIC KP_GLSKABSP84 "Proportionalfaktor PID-Regler GLS" VALUE 0x1D8A18 ZF_kw_ui16_S5_S3 10000 UMR_MBARMINSEC__1_1_0_S5_S3 0 10000 /end CHARACTERISTIC
/begin CHARACTERISTIC KP_GLSKABSP84_EL "Proportionalfaktor PID-Regler GLS" VALUE 0x1D8A1A ZF_kw_ui16_S5_S3 10000 UMR_MBARMINSEC__1_1_0_S5_S3 0 10000 /end CHARACTERISTIC
/begin CHARACTERISTIC KP_GLSKABSP86 "Proportionalfaktor PID-Regler GLS" VALUE 0x1D8A3C ZF_kw_ui16_S5_S3 10000 UMR_MBARMINSEC__1_1_0_S5_S3 0 10000 /end CHARACTERISTIC
/begin CHARACTERISTIC KP_GLSKABSP86_EL "Proportionalfaktor PID-Regler GLS" VALUE 0x1D8A3E ZF_kw_ui16_S5_S3 10000 UMR_MBARMINSEC__1_1_0_S5_S3 0 10000 /end CHARACTERISTIC
/begin CHARACTERISTIC KP_GLSKZU32 "P-Faktor PID-Regler GLS" VALUE 0x1D87E4 ZF_kw_ui16_S5_S3 10000 UMR_MBARMINSEC__1_1_0_S5_S3 0 10000 /end CHARACTERISTIC
/begin CHARACTERISTIC KP_GLSKZU32_EL "P-Faktor PID-Regler GLS" VALUE 0x1D87E6 ZF_kw_ui16_S5_S3 10000 UMR_MBARMINSEC__1_1_0_S5_S3 0 10000 /end CHARACTERISTIC
/begin CHARACTERISTIC KP_GLSKZU43 "P-Faktor PID-Regler GLS" VALUE 0x1D8808 ZF_kw_ui16_S5_S3 10000 UMR_MBARMINSEC__1_1_0_S5_S3 0 10000 /end CHARACTERISTIC
/begin CHARACTERISTIC KP_GLSKZU43_EL "P-Faktor PID-Regler GLS" VALUE 0x1D880A ZF_kw_ui16_S5_S3 10000 UMR_MBARMINSEC__1_1_0_S5_S3 0 10000 /end CHARACTERISTIC
/begin CHARACTERISTIC KP_GLSKZU54 "P-Faktor PID-Regler GLS" VALUE 0x1D882C ZF_kw_ui16_S5_S3 10000 UMR_MBARMINSEC__1_1_0_S5_S3 0 10000 /end CHARACTERISTIC
/begin CHARACTERISTIC KP_GLSKZU54_EL "P-Faktor PID-Regler GLS" VALUE 0x1D882E ZF_kw_ui16_S5_S3 10000 UMR_MBARMINSEC__1_1_0_S5_S3 0 10000 /end CHARACTERISTIC
/begin CHARACTERISTIC KP_GLSKZU65 "P-Faktor PID-Regler GLS" VALUE 0x1D8850 ZF_kw_ui16_S5_S3 10000 UMR_MBARMINSEC__1_1_0_S5_S3 0 10000 /end CHARACTERISTIC
/begin CHARACTERISTIC KP_GLSKZU65_EL "P-Faktor PID-Regler GLS" VALUE 0x1D8852 ZF_kw_ui16_S5_S3 10000 UMR_MBARMINSEC__1_1_0_S5_S3 0 10000 /end CHARACTERISTIC
/begin CHARACTERISTIC KP_GLSKZU76 "P-Faktor PID-Regler GLS" VALUE 0x1D8874 ZF_kw_ui16_S5_S3 10000 UMR_MBARMINSEC__1_1_0_S5_S3 0 10000 /end CHARACTERISTIC
/begin CHARACTERISTIC KP_GLSKZU76_EL "P-Faktor PID-Regler GLS" VALUE 0x1D8876 ZF_kw_ui16_S5_S3 10000 UMR_MBARMINSEC__1_1_0_S5_S3 0 10000 /end CHARACTERISTIC
/begin CHARACTERISTIC KP_GLSKZU87 "P-Faktor PID-Regler GLS" VALUE 0x1D8898 ZF_kw_ui16_S5_S3 10000 UMR_MBARMINSEC__1_1_0_S5_S3 0 10000 /end CHARACTERISTIC
/begin CHARACTERISTIC KP_GLSKZU87_EL "P-Faktor PID-Regler GLS" VALUE 0x1D889A ZF_kw_ui16_S5_S3 10000 UMR_MBARMINSEC__1_1_0_S5_S3 0 10000 /end CHARACTERISTIC
/begin CHARACTERISTIC KP_GLSKZUSP42 "P-Faktor PID-Regler GLS" VALUE 0x1D88E0 ZF_kw_ui16_S5_S3 10000 UMR_MBARMINSEC__1_1_0_S5_S3 0 10000 /end CHARACTERISTIC
/begin CHARACTERISTIC KP_GLSKZUSP42_EL "P-Faktor PID-Regler GLS" VALUE 0x1D88E2 ZF_kw_ui16_S5_S3 10000 UMR_MBARMINSEC__1_1_0_S5_S3 0 10000 /end CHARACTERISTIC
/begin CHARACTERISTIC KP_GLSKZUSP51 "P-Faktor PID-Regler GLS" VALUE 0x1D8904 ZF_kw_ui16_S5_S3 10000 UMR_MBARMINSEC__1_1_0_S5_S3 0 10000 /end CHARACTERISTIC
/begin CHARACTERISTIC KP_GLSKZUSP51_EL "P-Faktor PID-Regler GLS" VALUE 0x1D8906 ZF_kw_ui16_S5_S3 10000 UMR_MBARMINSEC__1_1_0_S5_S3 0 10000 /end CHARACTERISTIC
/begin CHARACTERISTIC KP_GLSKZUSP53 "P-Faktor PID-Regler GLS" VALUE 0x1D8928 ZF_kw_ui16_S5_S3 10000 UMR_MBARMINSEC__1_1_0_S5_S3 0 10000 /end CHARACTERISTIC
/begin CHARACTERISTIC KP_GLSKZUSP53_EL "P-Faktor PID-Regler GLS" VALUE 0x1D892A ZF_kw_ui16_S5_S3 10000 UMR_MBARMINSEC__1_1_0_S5_S3 0 10000 /end CHARACTERISTIC
/begin CHARACTERISTIC KP_GLSKZUSP63 "P-Faktor PID-Regler GLS" VALUE 0x1D894C ZF_kw_ui16_S5_S3 10000 UMR_MBARMINSEC__1_1_0_S5_S3 0 10000 /end CHARACTERISTIC
/begin CHARACTERISTIC KP_GLSKZUSP63_EL "P-Faktor PID-Regler GLS" VALUE 0x1D894E ZF_kw_ui16_S5_S3 10000 UMR_MBARMINSEC__1_1_0_S5_S3 0 10000 /end CHARACTERISTIC
/begin CHARACTERISTIC KP_GLSKZUSP64 "P-Faktor PID-Regler GLS" VALUE 0x1D8970 ZF_kw_ui16_S5_S3 10000 UMR_MBARMINSEC__1_1_0_S5_S3 0 10000 /end CHARACTERISTIC
/begin CHARACTERISTIC KP_GLSKZUSP64_EL "P-Faktor PID-Regler GLS" VALUE 0x1D8972 ZF_kw_ui16_S5_S3 10000 UMR_MBARMINSEC__1_1_0_S5_S3 0 10000 /end CHARACTERISTIC
/begin CHARACTERISTIC KP_GLSKZUSP71 "P-Faktor PID-Regler GLS" VALUE 0x1D8994 ZF_kw_ui16_S5_S3 10000 UMR_MBARMINSEC__1_1_0_S5_S3 0 10000 /end CHARACTERISTIC
/begin CHARACTERISTIC KP_GLSKZUSP71_EL "P-Faktor PID-Regler GLS" VALUE 0x1D8996 ZF_kw_ui16_S5_S3 10000 UMR_MBARMINSEC__1_1_0_S5_S3 0 10000 /end CHARACTERISTIC
/begin CHARACTERISTIC KP_GLSKZUSP75 "P-Faktor PID-Regler GLS" VALUE 0x1D89B8 ZF_kw_ui16_S5_S3 10000 UMR_MBARMINSEC__1_1_0_S5_S3 0 10000 /end CHARACTERISTIC
/begin CHARACTERISTIC KP_GLSKZUSP75_EL "P-Faktor PID-Regler GLS" VALUE 0x1D89BA ZF_kw_ui16_S5_S3 10000 UMR_MBARMINSEC__1_1_0_S5_S3 0 10000 /end CHARACTERISTIC
/begin CHARACTERISTIC KP_GLSKZUSP82 "P-Faktor PID-Regler GLS" VALUE 0x1D89DC ZF_kw_ui16_S5_S3 10000 UMR_MBARMINSEC__1_1_0_S5_S3 0 10000 /end CHARACTERISTIC
/begin CHARACTERISTIC KP_GLSKZUSP82_EL "P-Faktor PID-Regler GLS" VALUE 0x1D89DE ZF_kw_ui16_S5_S3 10000 UMR_MBARMINSEC__1_1_0_S5_S3 0 10000 /end CHARACTERISTIC
/begin CHARACTERISTIC KP_GLSKZUSP84 "P-Faktor PID-Regler GLS" VALUE 0x1D8A00 ZF_kw_ui16_S5_S3 10000 UMR_MBARMINSEC__1_1_0_S5_S3 0 10000 /end CHARACTERISTIC
/begin CHARACTERISTIC KP_GLSKZUSP84_EL "P-Faktor PID-Regler GLS" VALUE 0x1D8A02 ZF_kw_ui16_S5_S3 10000 UMR_MBARMINSEC__1_1_0_S5_S3 0 10000 /end CHARACTERISTIC
/begin CHARACTERISTIC KP_GLSKZUSP86 "P-Faktor PID-Regler GLS" VALUE 0x1D8A24 ZF_kw_ui16_S5_S3 10000 UMR_MBARMINSEC__1_1_0_S5_S3 0 10000 /end CHARACTERISTIC
/begin CHARACTERISTIC KP_GLSKZUSP86_EL "P-Faktor PID-Regler GLS" VALUE 0x1D8A26 ZF_kw_ui16_S5_S3 10000 UMR_MBARMINSEC__1_1_0_S5_S3 0 10000 /end CHARACTERISTIC
/begin CHARACTERISTIC K_WNGGRGLSPKAB32 "Korrekturfaktor, wenn gemessene Schleifzeit zu gross (oberhalb der Toleranz) bei Regelung KAB" VALUE 0x1D87EC ZF_kw_ui16_S5_S3 65530 UMR_U_MINSEC2_1_1_0_S5_S3 0 65530 /end CHARACTERISTIC
/begin CHARACTERISTIC K_WNGGRGLSPKAB32_EL "Korrekturfaktor, wenn gemessene Schleifzeit zu gross (oberhalb der Toleranz) bei Regelung KAB" VALUE 0x1D87EE ZF_kw_ui16_S5_S3 65530 UMR_U_MINSEC2_1_1_0_S5_S3 0 65530 /end CHARACTERISTIC
/begin CHARACTERISTIC K_WNGGRGLSPKAB43 "Korrekturfaktor, wenn gemessene Schleifzeit zu gross (oberhalb der Toleranz) bei Regelung KAB" VALUE 0x1D8810 ZF_kw_ui16_S5_S3 65530 UMR_U_MINSEC2_1_1_0_S5_S3 0 65530 /end CHARACTERISTIC
/begin CHARACTERISTIC K_WNGGRGLSPKAB43_EL "Korrekturfaktor, wenn gemessene Schleifzeit zu gross (oberhalb der Toleranz) bei Regelung KAB" VALUE 0x1D8812 ZF_kw_ui16_S5_S3 65530 UMR_U_MINSEC2_1_1_0_S5_S3 0 65530 /end CHARACTERISTIC
/begin CHARACTERISTIC K_WNGGRGLSPKAB54 "Korrekturfaktor, wenn gemessene Schleifzeit zu gross (oberhalb der Toleranz) bei Regelung KAB" VALUE 0x1D8834 ZF_kw_ui16_S5_S3 65530 UMR_U_MINSEC2_1_1_0_S5_S3 0 65530 /end CHARACTERISTIC
/begin CHARACTERISTIC K_WNGGRGLSPKAB54_EL "Korrekturfaktor, wenn gemessene Schleifzeit zu gross (oberhalb der Toleranz) bei Regelung KAB" VALUE 0x1D8836 ZF_kw_ui16_S5_S3 65530 UMR_U_MINSEC2_1_1_0_S5_S3 0 65530 /end CHARACTERISTIC
/begin CHARACTERISTIC K_WNGGRGLSPKAB65 "Korrekturfaktor, wenn gemessene Schleifzeit zu gross (oberhalb der Toleranz) bei Regelung KAB" VALUE 0x1D8858 ZF_kw_ui16_S5_S3 65530 UMR_U_MINSEC2_1_1_0_S5_S3 0 65530 /end CHARACTERISTIC
/begin CHARACTERISTIC K_WNGGRGLSPKAB65_EL "Korrekturfaktor, wenn gemessene Schleifzeit zu gross (oberhalb der Toleranz) bei Regelung KAB" VALUE 0x1D885A ZF_kw_ui16_S5_S3 65530 UMR_U_MINSEC2_1_1_0_S5_S3 0 65530 /end CHARACTERISTIC
/begin CHARACTERISTIC K_WNGGRGLSPKAB76 "Korrekturfaktor, wenn gemessene Schleifzeit zu gross (oberhalb der Toleranz) bei Regelung KAB" VALUE 0x1D887C ZF_kw_ui16_S5_S3 65530 UMR_U_MINSEC2_1_1_0_S5_S3 0 65530 /end CHARACTERISTIC
/begin CHARACTERISTIC K_WNGGRGLSPKAB76_EL "Korrekturfaktor, wenn gemessene Schleifzeit zu gross (oberhalb der Toleranz) bei Regelung KAB" VALUE 0x1D887E ZF_kw_ui16_S5_S3 65530 UMR_U_MINSEC2_1_1_0_S5_S3 0 65530 /end CHARACTERISTIC
/begin CHARACTERISTIC K_WNGGRGLSPKAB87 "Korrekturfaktor, wenn gemessene Schleifzeit zu gross (oberhalb der Toleranz) bei Regelung KAB" VALUE 0x1D88A0 ZF_kw_ui16_S5_S3 65530 UMR_U_MINSEC2_1_1_0_S5_S3 0 65530 /end CHARACTERISTIC
/begin CHARACTERISTIC K_WNGGRGLSPKAB87_EL "Korrekturfaktor, wenn gemessene Schleifzeit zu gross (oberhalb der Toleranz) bei Regelung KAB" VALUE 0x1D88A2 ZF_kw_ui16_S5_S3 65530 UMR_U_MINSEC2_1_1_0_S5_S3 0 65530 /end CHARACTERISTIC
/begin CHARACTERISTIC K_WNGGRGLSPKABSP42 "Korrekturfaktor, wenn gemessene Schleifzeit zu gross (oberhalb der Toleranz) bei Regelung KAB" VALUE 0x1D88E8 ZF_kw_ui16_S5_S3 65530 UMR_U_MINSEC2_1_1_0_S5_S3 0 65530 /end CHARACTERISTIC
/begin CHARACTERISTIC K_WNGGRGLSPKABSP42_EL "Korrekturfaktor, wenn gemessene Schleifzeit zu gross (oberhalb der Toleranz) bei Regelung KAB" VALUE 0x1D88EA ZF_kw_ui16_S5_S3 65530 UMR_U_MINSEC2_1_1_0_S5_S3 0 65530 /end CHARACTERISTIC
/begin CHARACTERISTIC K_WNGGRGLSPKABSP51 "Korrekturfaktor, wenn gemessene Schleifzeit zu gross (oberhalb der Toleranz) bei Regelung KAB" VALUE 0x1D890C ZF_kw_ui16_S5_S3 65530 UMR_U_MINSEC2_1_1_0_S5_S3 0 65530 /end CHARACTERISTIC
/begin CHARACTERISTIC K_WNGGRGLSPKABSP51_EL "Korrekturfaktor, wenn gemessene Schleifzeit zu gross (oberhalb der Toleranz) bei Regelung KAB" VALUE 0x1D890E ZF_kw_ui16_S5_S3 65530 UMR_U_MINSEC2_1_1_0_S5_S3 0 65530 /end CHARACTERISTIC
/begin CHARACTERISTIC K_WNGGRGLSPKABSP53 "Korrekturfaktor, wenn gemessene Schleifzeit zu gross (oberhalb der Toleranz) bei Regelung KAB" VALUE 0x1D8930 ZF_kw_ui16_S5_S3 65530 UMR_U_MINSEC2_1_1_0_S5_S3 0 65530 /end CHARACTERISTIC
/begin CHARACTERISTIC K_WNGGRGLSPKABSP53_EL "Korrekturfaktor, wenn gemessene Schleifzeit zu gross (oberhalb der Toleranz) bei Regelung KAB" VALUE 0x1D8932 ZF_kw_ui16_S5_S3 65530 UMR_U_MINSEC2_1_1_0_S5_S3 0 65530 /end CHARACTERISTIC
/begin CHARACTERISTIC K_WNGGRGLSPKABSP63 "Korrekturfaktor, wenn gemessene Schleifzeit zu gross (oberhalb der Toleranz) bei Regelung KAB" VALUE 0x1D8954 ZF_kw_ui16_S5_S3 65530 UMR_U_MINSEC2_1_1_0_S5_S3 0 65530 /end CHARACTERISTIC
/begin CHARACTERISTIC K_WNGGRGLSPKABSP63_EL "Korrekturfaktor, wenn gemessene Schleifzeit zu gross (oberhalb der Toleranz) bei Regelung KAB" VALUE 0x1D8956 ZF_kw_ui16_S5_S3 65530 UMR_U_MINSEC2_1_1_0_S5_S3 0 65530 /end CHARACTERISTIC
/begin CHARACTERISTIC K_WNGGRGLSPKABSP64 "Korrekturfaktor, wenn gemessene Schleifzeit zu gross (oberhalb der Toleranz) bei Regelung KAB" VALUE 0x1D8978 ZF_kw_ui16_S5_S3 65530 UMR_U_MINSEC2_1_1_0_S5_S3 0 65530 /end CHARACTERISTIC
/begin CHARACTERISTIC K_WNGGRGLSPKABSP64_EL "Korrekturfaktor, wenn gemessene Schleifzeit zu gross (oberhalb der Toleranz) bei Regelung KAB" VALUE 0x1D897A ZF_kw_ui16_S5_S3 65530 UMR_U_MINSEC2_1_1_0_S5_S3 0 65530 /end CHARACTERISTIC
/begin CHARACTERISTIC K_WNGGRGLSPKABSP71 "Korrekturfaktor, wenn gemessene Schleifzeit zu gross (oberhalb der Toleranz) bei Regelung KAB" VALUE 0x1D899C ZF_kw_ui16_S5_S3 65530 UMR_U_MINSEC2_1_1_0_S5_S3 0 65530 /end CHARACTERISTIC
/begin CHARACTERISTIC K_WNGGRGLSPKABSP71_EL "Korrekturfaktor, wenn gemessene Schleifzeit zu gross (oberhalb der Toleranz) bei Regelung KAB" VALUE 0x1D899E ZF_kw_ui16_S5_S3 65530 UMR_U_MINSEC2_1_1_0_S5_S3 0 65530 /end CHARACTERISTIC
/begin CHARACTERISTIC K_WNGGRGLSPKABSP75 "Korrekturfaktor, wenn gemessene Schleifzeit zu gross (oberhalb der Toleranz) bei Regelung KAB" VALUE 0x1D89C0 ZF_kw_ui16_S5_S3 65530 UMR_U_MINSEC2_1_1_0_S5_S3 0 65530 /end CHARACTERISTIC
/begin CHARACTERISTIC K_WNGGRGLSPKABSP75_EL "Korrekturfaktor, wenn gemessene Schleifzeit zu gross (oberhalb der Toleranz) bei Regelung KAB" VALUE 0x1D89C2 ZF_kw_ui16_S5_S3 65530 UMR_U_MINSEC2_1_1_0_S5_S3 0 65530 /end CHARACTERISTIC
/begin CHARACTERISTIC K_WNGGRGLSPKABSP82 "Korrekturfaktor, wenn gemessene Schleifzeit zu gross (oberhalb der Toleranz) bei Regelung KAB" VALUE 0x1D89E4 ZF_kw_ui16_S5_S3 65530 UMR_U_MINSEC2_1_1_0_S5_S3 0 65530 /end CHARACTERISTIC
/begin CHARACTERISTIC K_WNGGRGLSPKABSP82_EL "Korrekturfaktor, wenn gemessene Schleifzeit zu gross (oberhalb der Toleranz) bei Regelung KAB" VALUE 0x1D89E6 ZF_kw_ui16_S5_S3 65530 UMR_U_MINSEC2_1_1_0_S5_S3 0 65530 /end CHARACTERISTIC
/begin CHARACTERISTIC K_WNGGRGLSPKABSP84 "Korrekturfaktor, wenn gemessene Schleifzeit zu gross (oberhalb der Toleranz) bei Regelung KAB" VALUE 0x1D8A08 ZF_kw_ui16_S5_S3 65530 UMR_U_MINSEC2_1_1_0_S5_S3 0 65530 /end CHARACTERISTIC
/begin CHARACTERISTIC K_WNGGRGLSPKABSP84_EL "Korrekturfaktor, wenn gemessene Schleifzeit zu gross (oberhalb der Toleranz) bei Regelung KAB" VALUE 0x1D8A0A ZF_kw_ui16_S5_S3 65530 UMR_U_MINSEC2_1_1_0_S5_S3 0 65530 /end CHARACTERISTIC
/begin CHARACTERISTIC K_WNGGRGLSPKABSP86 "Korrekturfaktor, wenn gemessene Schleifzeit zu gross (oberhalb der Toleranz) bei Regelung KAB" VALUE 0x1D8A2C ZF_kw_ui16_S5_S3 65530 UMR_U_MINSEC2_1_1_0_S5_S3 0 65530 /end CHARACTERISTIC
/begin CHARACTERISTIC K_WNGGRGLSPKABSP86_EL "Korrekturfaktor, wenn gemessene Schleifzeit zu gross (oberhalb der Toleranz) bei Regelung KAB" VALUE 0x1D8A2E ZF_kw_ui16_S5_S3 65530 UMR_U_MINSEC2_1_1_0_S5_S3 0 65530 /end CHARACTERISTIC
/begin CHARACTERISTIC K_WNGGRGLSPKZU32 "Korrekturfaktor, wenn gemessene Schleifzeit zu gross (oberhalb der Toleranz) bei Regelung KZU" VALUE 0x1D87E8 ZF_kw_ui16_S5_S3 65530 UMR_U_MINSEC2_1_1_0_S5_S3 0 65530 /end CHARACTERISTIC
/begin CHARACTERISTIC K_WNGGRGLSPKZU32_EL "Korrekturfaktor, wenn gemessene Schleifzeit zu gross (oberhalb der Toleranz) bei Regelung KZU" VALUE 0x1D87EA ZF_kw_ui16_S5_S3 65530 UMR_U_MINSEC2_1_1_0_S5_S3 0 65530 /end CHARACTERISTIC
/begin CHARACTERISTIC K_WNGGRGLSPKZU43 "Korrekturfaktor, wenn gemessene Schleifzeit zu gross (oberhalb der Toleranz) bei Regelung KZU" VALUE 0x1D880C ZF_kw_ui16_S5_S3 65530 UMR_U_MINSEC2_1_1_0_S5_S3 0 65530 /end CHARACTERISTIC
/begin CHARACTERISTIC K_WNGGRGLSPKZU43_EL "Korrekturfaktor, wenn gemessene Schleifzeit zu gross (oberhalb der Toleranz) bei Regelung KZU" VALUE 0x1D880E ZF_kw_ui16_S5_S3 65530 UMR_U_MINSEC2_1_1_0_S5_S3 0 65530 /end CHARACTERISTIC
/begin CHARACTERISTIC K_WNGGRGLSPKZU54 "Korrekturfaktor, wenn gemessene Schleifzeit zu gross (oberhalb der Toleranz) bei Regelung KZU" VALUE 0x1D8830 ZF_kw_ui16_S5_S3 65530 UMR_U_MINSEC2_1_1_0_S5_S3 0 65530 /end CHARACTERISTIC
/begin CHARACTERISTIC K_WNGGRGLSPKZU54_EL "Korrekturfaktor, wenn gemessene Schleifzeit zu gross (oberhalb der Toleranz) bei Regelung KZU" VALUE 0x1D8832 ZF_kw_ui16_S5_S3 65530 UMR_U_MINSEC2_1_1_0_S5_S3 0 65530 /end CHARACTERISTIC
/begin CHARACTERISTIC K_WNGGRGLSPKZU65 "Korrekturfaktor, wenn gemessene Schleifzeit zu gross (oberhalb der Toleranz) bei Regelung KZU" VALUE 0x1D8854 ZF_kw_ui16_S5_S3 65530 UMR_U_MINSEC2_1_1_0_S5_S3 0 65530 /end CHARACTERISTIC
/begin CHARACTERISTIC K_WNGGRGLSPKZU65_EL "Korrekturfaktor, wenn gemessene Schleifzeit zu gross (oberhalb der Toleranz) bei Regelung KZU" VALUE 0x1D8856 ZF_kw_ui16_S5_S3 65530 UMR_U_MINSEC2_1_1_0_S5_S3 0 65530 /end CHARACTERISTIC
/begin CHARACTERISTIC K_WNGGRGLSPKZU76 "Korrekturfaktor, wenn gemessene Schleifzeit zu gross (oberhalb der Toleranz) bei Regelung KZU" VALUE 0x1D8878 ZF_kw_ui16_S5_S3 65530 UMR_U_MINSEC2_1_1_0_S5_S3 0 65530 /end CHARACTERISTIC
/begin CHARACTERISTIC K_WNGGRGLSPKZU76_EL "Korrekturfaktor, wenn gemessene Schleifzeit zu gross (oberhalb der Toleranz) bei Regelung KZU" VALUE 0x1D887A ZF_kw_ui16_S5_S3 65530 UMR_U_MINSEC2_1_1_0_S5_S3 0 65530 /end CHARACTERISTIC
/begin CHARACTERISTIC K_WNGGRGLSPKZU87 "Korrekturfaktor, wenn gemessene Schleifzeit zu gross (oberhalb der Toleranz) bei Regelung KZU" VALUE 0x1D889C ZF_kw_ui16_S5_S3 65530 UMR_U_MINSEC2_1_1_0_S5_S3 0 65530 /end CHARACTERISTIC
/begin CHARACTERISTIC K_WNGGRGLSPKZU87_EL "Korrekturfaktor, wenn gemessene Schleifzeit zu gross (oberhalb der Toleranz) bei Regelung KZU" VALUE 0x1D889E ZF_kw_ui16_S5_S3 65530 UMR_U_MINSEC2_1_1_0_S5_S3 0 65530 /end CHARACTERISTIC
/begin CHARACTERISTIC K_WNGGRGLSPKZUSP42 "Korrekturfaktor, wenn gemessene Schleifzeit zu gross (oberhalb der Toleranz) bei Regelung KZU" VALUE 0x1D88E4 ZF_kw_ui16_S5_S3 65530 UMR_U_MINSEC2_1_1_0_S5_S3 0 65530 /end CHARACTERISTIC
/begin CHARACTERISTIC K_WNGGRGLSPKZUSP42_EL "Korrekturfaktor, wenn gemessene Schleifzeit zu gross (oberhalb der Toleranz) bei Regelung KZU" VALUE 0x1D88E6 ZF_kw_ui16_S5_S3 65530 UMR_U_MINSEC2_1_1_0_S5_S3 0 65530 /end CHARACTERISTIC
/begin CHARACTERISTIC K_WNGGRGLSPKZUSP51 "Korrekturfaktor, wenn gemessene Schleifzeit zu gross (oberhalb der Toleranz) bei Regelung KZU" VALUE 0x1D8908 ZF_kw_ui16_S5_S3 65530 UMR_U_MINSEC2_1_1_0_S5_S3 0 65530 /end CHARACTERISTIC
/begin CHARACTERISTIC K_WNGGRGLSPKZUSP51_EL "Korrekturfaktor, wenn gemessene Schleifzeit zu gross (oberhalb der Toleranz) bei Regelung KZU" VALUE 0x1D890A ZF_kw_ui16_S5_S3 65530 UMR_U_MINSEC2_1_1_0_S5_S3 0 65530 /end CHARACTERISTIC
/begin CHARACTERISTIC K_WNGGRGLSPKZUSP53 "Korrekturfaktor, wenn gemessene Schleifzeit zu gross (oberhalb der Toleranz) bei Regelung KZU" VALUE 0x1D892C ZF_kw_ui16_S5_S3 65530 UMR_U_MINSEC2_1_1_0_S5_S3 0 65530 /end CHARACTERISTIC
/begin CHARACTERISTIC K_WNGGRGLSPKZUSP53_EL "Korrekturfaktor, wenn gemessene Schleifzeit zu gross (oberhalb der Toleranz) bei Regelung KZU" VALUE 0x1D892E ZF_kw_ui16_S5_S3 65530 UMR_U_MINSEC2_1_1_0_S5_S3 0 65530 /end CHARACTERISTIC
/begin CHARACTERISTIC K_WNGGRGLSPKZUSP63 "Korrekturfaktor, wenn gemessene Schleifzeit zu gross (oberhalb der Toleranz) bei Regelung KZU" VALUE 0x1D8950 ZF_kw_ui16_S5_S3 65530 UMR_U_MINSEC2_1_1_0_S5_S3 0 65530 /end CHARACTERISTIC
/begin CHARACTERISTIC K_WNGGRGLSPKZUSP63_EL "Korrekturfaktor, wenn gemessene Schleifzeit zu gross (oberhalb der Toleranz) bei Regelung KZU" VALUE 0x1D8952 ZF_kw_ui16_S5_S3 65530 UMR_U_MINSEC2_1_1_0_S5_S3 0 65530 /end CHARACTERISTIC
/begin CHARACTERISTIC K_WNGGRGLSPKZUSP64 "Korrekturfaktor, wenn gemessene Schleifzeit zu gross (oberhalb der Toleranz) bei Regelung KZU" VALUE 0x1D8974 ZF_kw_ui16_S5_S3 65530 UMR_U_MINSEC2_1_1_0_S5_S3 0 65530 /end CHARACTERISTIC
/begin CHARACTERISTIC K_WNGGRGLSPKZUSP64_EL "Korrekturfaktor, wenn gemessene Schleifzeit zu gross (oberhalb der Toleranz) bei Regelung KZU" VALUE 0x1D8976 ZF_kw_ui16_S5_S3 65530 UMR_U_MINSEC2_1_1_0_S5_S3 0 65530 /end CHARACTERISTIC
/begin CHARACTERISTIC K_WNGGRGLSPKZUSP71 "Korrekturfaktor, wenn gemessene Schleifzeit zu gross (oberhalb der Toleranz) bei Regelung KZU" VALUE 0x1D8998 ZF_kw_ui16_S5_S3 65530 UMR_U_MINSEC2_1_1_0_S5_S3 0 65530 /end CHARACTERISTIC
/begin CHARACTERISTIC K_WNGGRGLSPKZUSP71_EL "Korrekturfaktor, wenn gemessene Schleifzeit zu gross (oberhalb der Toleranz) bei Regelung KZU" VALUE 0x1D899A ZF_kw_ui16_S5_S3 65530 UMR_U_MINSEC2_1_1_0_S5_S3 0 65530 /end CHARACTERISTIC
/begin CHARACTERISTIC K_WNGGRGLSPKZUSP75 "Korrekturfaktor, wenn gemessene Schleifzeit zu gross (oberhalb der Toleranz) bei Regelung KZU" VALUE 0x1D89BC ZF_kw_ui16_S5_S3 65530 UMR_U_MINSEC2_1_1_0_S5_S3 0 65530 /end CHARACTERISTIC
/begin CHARACTERISTIC K_WNGGRGLSPKZUSP75_EL "Korrekturfaktor, wenn gemessene Schleifzeit zu gross (oberhalb der Toleranz) bei Regelung KZU" VALUE 0x1D89BE ZF_kw_ui16_S5_S3 65530 UMR_U_MINSEC2_1_1_0_S5_S3 0 65530 /end CHARACTERISTIC
/begin CHARACTERISTIC K_WNGGRGLSPKZUSP82 "Korrekturfaktor, wenn gemessene Schleifzeit zu gross (oberhalb der Toleranz) bei Regelung KZU" VALUE 0x1D89E0 ZF_kw_ui16_S5_S3 65530 UMR_U_MINSEC2_1_1_0_S5_S3 0 65530 /end CHARACTERISTIC
/begin CHARACTERISTIC K_WNGGRGLSPKZUSP82_EL "Korrekturfaktor, wenn gemessene Schleifzeit zu gross (oberhalb der Toleranz) bei Regelung KZU" VALUE 0x1D89E2 ZF_kw_ui16_S5_S3 65530 UMR_U_MINSEC2_1_1_0_S5_S3 0 65530 /end CHARACTERISTIC
/begin CHARACTERISTIC K_WNGGRGLSPKZUSP84 "Korrekturfaktor, wenn gemessene Schleifzeit zu gross (oberhalb der Toleranz) bei Regelung KZU" VALUE 0x1D8A04 ZF_kw_ui16_S5_S3 65530 UMR_U_MINSEC2_1_1_0_S5_S3 0 65530 /end CHARACTERISTIC
/begin CHARACTERISTIC K_WNGGRGLSPKZUSP84_EL "Korrekturfaktor, wenn gemessene Schleifzeit zu gross (oberhalb der Toleranz) bei Regelung KZU" VALUE 0x1D8A06 ZF_kw_ui16_S5_S3 65530 UMR_U_MINSEC2_1_1_0_S5_S3 0 65530 /end CHARACTERISTIC
/begin CHARACTERISTIC K_WNGGRGLSPKZUSP86 "Korrekturfaktor, wenn gemessene Schleifzeit zu gross (oberhalb der Toleranz) bei Regelung KZU" VALUE 0x1D8A28 ZF_kw_ui16_S5_S3 65530 UMR_U_MINSEC2_1_1_0_S5_S3 0 65530 /end CHARACTERISTIC
/begin CHARACTERISTIC K_WNGGRGLSPKZUSP86_EL "Korrekturfaktor, wenn gemessene Schleifzeit zu gross (oberhalb der Toleranz) bei Regelung KZU" VALUE 0x1D8A2A ZF_kw_ui16_S5_S3 65530 UMR_U_MINSEC2_1_1_0_S5_S3 0 65530 /end CHARACTERISTIC
/begin CHARACTERISTIC K_WNGKLGLSPKAB32 "Korrekturfaktor, wenn gemessene Schleifzeit zu klein (unterhalb der Toleranz) bei Regelung KAB" VALUE 0x1D87F4 ZF_kw_ui16_S5_S3 65530 UMR_U_MINSEC2_1_1_0_S5_S3 0 65530 /end CHARACTERISTIC
/begin CHARACTERISTIC K_WNGKLGLSPKAB32_EL "Korrekturfaktor, wenn gemessene Schleifzeit zu klein (unterhalb der Toleranz) bei Regelung KAB" VALUE 0x1D87F6 ZF_kw_ui16_S5_S3 65530 UMR_U_MINSEC2_1_1_0_S5_S3 0 65530 /end CHARACTERISTIC
/begin CHARACTERISTIC K_WNGKLGLSPKAB43 "Korrekturfaktor, wenn gemessene Schleifzeit zu klein (unterhalb der Toleranz) bei Regelung KAB" VALUE 0x1D8818 ZF_kw_ui16_S5_S3 65530 UMR_U_MINSEC2_1_1_0_S5_S3 0 65530 /end CHARACTERISTIC
/begin CHARACTERISTIC K_WNGKLGLSPKAB43_EL "Korrekturfaktor, wenn gemessene Schleifzeit zu klein (unterhalb der Toleranz) bei Regelung KAB" VALUE 0x1D881A ZF_kw_ui16_S5_S3 65530 UMR_U_MINSEC2_1_1_0_S5_S3 0 65530 /end CHARACTERISTIC
/begin CHARACTERISTIC K_WNGKLGLSPKAB54 "Korrekturfaktor, wenn gemessene Schleifzeit zu klein (unterhalb der Toleranz) bei Regelung KAB" VALUE 0x1D883C ZF_kw_ui16_S5_S3 65530 UMR_U_MINSEC2_1_1_0_S5_S3 0 65530 /end CHARACTERISTIC
/begin CHARACTERISTIC K_WNGKLGLSPKAB54_EL "Korrekturfaktor, wenn gemessene Schleifzeit zu klein (unterhalb der Toleranz) bei Regelung KAB" VALUE 0x1D883E ZF_kw_ui16_S5_S3 65530 UMR_U_MINSEC2_1_1_0_S5_S3 0 65530 /end CHARACTERISTIC
/begin CHARACTERISTIC K_WNGKLGLSPKAB65 "Korrekturfaktor, wenn gemessene Schleifzeit zu klein (unterhalb der Toleranz) bei Regelung KAB" VALUE 0x1D8860 ZF_kw_ui16_S5_S3 65530 UMR_U_MINSEC2_1_1_0_S5_S3 0 65530 /end CHARACTERISTIC
/begin CHARACTERISTIC K_WNGKLGLSPKAB65_EL "Korrekturfaktor, wenn gemessene Schleifzeit zu klein (unterhalb der Toleranz) bei Regelung KAB" VALUE 0x1D8862 ZF_kw_ui16_S5_S3 65530 UMR_U_MINSEC2_1_1_0_S5_S3 0 65530 /end CHARACTERISTIC
/begin CHARACTERISTIC K_WNGKLGLSPKAB76 "Korrekturfaktor, wenn gemessene Schleifzeit zu klein (unterhalb der Toleranz) bei Regelung KAB" VALUE 0x1D8884 ZF_kw_ui16_S5_S3 65530 UMR_U_MINSEC2_1_1_0_S5_S3 0 65530 /end CHARACTERISTIC
/begin CHARACTERISTIC K_WNGKLGLSPKAB76_EL "Korrekturfaktor, wenn gemessene Schleifzeit zu klein (unterhalb der Toleranz) bei Regelung KAB" VALUE 0x1D8886 ZF_kw_ui16_S5_S3 65530 UMR_U_MINSEC2_1_1_0_S5_S3 0 65530 /end CHARACTERISTIC
/begin CHARACTERISTIC K_WNGKLGLSPKAB87 "Korrekturfaktor, wenn gemessene Schleifzeit zu klein (unterhalb der Toleranz) bei Regelung KAB" VALUE 0x1D88A8 ZF_kw_ui16_S5_S3 65530 UMR_U_MINSEC2_1_1_0_S5_S3 0 65530 /end CHARACTERISTIC
/begin CHARACTERISTIC K_WNGKLGLSPKAB87_EL "Korrekturfaktor, wenn gemessene Schleifzeit zu klein (unterhalb der Toleranz) bei Regelung KAB" VALUE 0x1D88AA ZF_kw_ui16_S5_S3 65530 UMR_U_MINSEC2_1_1_0_S5_S3 0 65530 /end CHARACTERISTIC
/begin CHARACTERISTIC K_WNGKLGLSPKABSP42 "Korrekturfaktor, wenn gemessene Schleifzeit zu klein (unterhalb der Toleranz) bei Regelung KAB" VALUE 0x1D88F0 ZF_kw_ui16_S5_S3 65530 UMR_U_MINSEC2_1_1_0_S5_S3 0 65530 /end CHARACTERISTIC
/begin CHARACTERISTIC K_WNGKLGLSPKABSP42_EL "Korrekturfaktor, wenn gemessene Schleifzeit zu klein (unterhalb der Toleranz) bei Regelung KAB" VALUE 0x1D88F2 ZF_kw_ui16_S5_S3 65530 UMR_U_MINSEC2_1_1_0_S5_S3 0 65530 /end CHARACTERISTIC
/begin CHARACTERISTIC K_WNGKLGLSPKABSP51 "Korrekturfaktor, wenn gemessene Schleifzeit zu klein (unterhalb der Toleranz) bei Regelung KAB" VALUE 0x1D8914 ZF_kw_ui16_S5_S3 65530 UMR_U_MINSEC2_1_1_0_S5_S3 0 65530 /end CHARACTERISTIC
/begin CHARACTERISTIC K_WNGKLGLSPKABSP51_EL "Korrekturfaktor, wenn gemessene Schleifzeit zu klein (unterhalb der Toleranz) bei Regelung KAB" VALUE 0x1D8916 ZF_kw_ui16_S5_S3 65530 UMR_U_MINSEC2_1_1_0_S5_S3 0 65530 /end CHARACTERISTIC
/begin CHARACTERISTIC K_WNGKLGLSPKABSP53 "Korrekturfaktor, wenn gemessene Schleifzeit zu klein (unterhalb der Toleranz) bei Regelung KAB" VALUE 0x1D8938 ZF_kw_ui16_S5_S3 65530 UMR_U_MINSEC2_1_1_0_S5_S3 0 65530 /end CHARACTERISTIC
/begin CHARACTERISTIC K_WNGKLGLSPKABSP53_EL "Korrekturfaktor, wenn gemessene Schleifzeit zu klein (unterhalb der Toleranz) bei Regelung KAB" VALUE 0x1D893A ZF_kw_ui16_S5_S3 65530 UMR_U_MINSEC2_1_1_0_S5_S3 0 65530 /end CHARACTERISTIC
/begin CHARACTERISTIC K_WNGKLGLSPKABSP63 "Korrekturfaktor, wenn gemessene Schleifzeit zu klein (unterhalb der Toleranz) bei Regelung KAB" VALUE 0x1D895C ZF_kw_ui16_S5_S3 65530 UMR_U_MINSEC2_1_1_0_S5_S3 0 65530 /end CHARACTERISTIC
/begin CHARACTERISTIC K_WNGKLGLSPKABSP63_EL "Korrekturfaktor, wenn gemessene Schleifzeit zu klein (unterhalb der Toleranz) bei Regelung KAB" VALUE 0x1D895E ZF_kw_ui16_S5_S3 65530 UMR_U_MINSEC2_1_1_0_S5_S3 0 65530 /end CHARACTERISTIC
/begin CHARACTERISTIC K_WNGKLGLSPKABSP64 "Korrekturfaktor, wenn gemessene Schleifzeit zu klein (unterhalb der Toleranz) bei Regelung KAB" VALUE 0x1D8980 ZF_kw_ui16_S5_S3 65530 UMR_U_MINSEC2_1_1_0_S5_S3 0 65530 /end CHARACTERISTIC
/begin CHARACTERISTIC K_WNGKLGLSPKABSP64_EL "Korrekturfaktor, wenn gemessene Schleifzeit zu klein (unterhalb der Toleranz) bei Regelung KAB" VALUE 0x1D8982 ZF_kw_ui16_S5_S3 65530 UMR_U_MINSEC2_1_1_0_S5_S3 0 65530 /end CHARACTERISTIC
/begin CHARACTERISTIC K_WNGKLGLSPKABSP71 "Korrekturfaktor, wenn gemessene Schleifzeit zu klein (unterhalb der Toleranz) bei Regelung KAB" VALUE 0x1D89A4 ZF_kw_ui16_S5_S3 65530 UMR_U_MINSEC2_1_1_0_S5_S3 0 65530 /end CHARACTERISTIC
/begin CHARACTERISTIC K_WNGKLGLSPKABSP71_EL "Korrekturfaktor, wenn gemessene Schleifzeit zu klein (unterhalb der Toleranz) bei Regelung KAB" VALUE 0x1D89A6 ZF_kw_ui16_S5_S3 65530 UMR_U_MINSEC2_1_1_0_S5_S3 0 65530 /end CHARACTERISTIC
/begin CHARACTERISTIC K_WNGKLGLSPKABSP75 "Korrekturfaktor, wenn gemessene Schleifzeit zu klein (unterhalb der Toleranz) bei Regelung KAB" VALUE 0x1D89C8 ZF_kw_ui16_S5_S3 65530 UMR_U_MINSEC2_1_1_0_S5_S3 0 65530 /end CHARACTERISTIC
/begin CHARACTERISTIC K_WNGKLGLSPKABSP75_EL "Korrekturfaktor, wenn gemessene Schleifzeit zu klein (unterhalb der Toleranz) bei Regelung KAB" VALUE 0x1D89CA ZF_kw_ui16_S5_S3 65530 UMR_U_MINSEC2_1_1_0_S5_S3 0 65530 /end CHARACTERISTIC
/begin CHARACTERISTIC K_WNGKLGLSPKABSP82 "Korrekturfaktor, wenn gemessene Schleifzeit zu klein (unterhalb der Toleranz) bei Regelung KAB" VALUE 0x1D89EC ZF_kw_ui16_S5_S3 65530 UMR_U_MINSEC2_1_1_0_S5_S3 0 65530 /end CHARACTERISTIC
/begin CHARACTERISTIC K_WNGKLGLSPKABSP82_EL "Korrekturfaktor, wenn gemessene Schleifzeit zu klein (unterhalb der Toleranz) bei Regelung KAB" VALUE 0x1D89EE ZF_kw_ui16_S5_S3 65530 UMR_U_MINSEC2_1_1_0_S5_S3 0 65530 /end CHARACTERISTIC
/begin CHARACTERISTIC K_WNGKLGLSPKABSP84 "Korrekturfaktor, wenn gemessene Schleifzeit zu klein (unterhalb der Toleranz) bei Regelung KAB" VALUE 0x1D8A10 ZF_kw_ui16_S5_S3 65530 UMR_U_MINSEC2_1_1_0_S5_S3 0 65530 /end CHARACTERISTIC
/begin CHARACTERISTIC K_WNGKLGLSPKABSP84_EL "Korrekturfaktor, wenn gemessene Schleifzeit zu klein (unterhalb der Toleranz) bei Regelung KAB" VALUE 0x1D8A12 ZF_kw_ui16_S5_S3 65530 UMR_U_MINSEC2_1_1_0_S5_S3 0 65530 /end CHARACTERISTIC
/begin CHARACTERISTIC K_WNGKLGLSPKABSP86 "Korrekturfaktor, wenn gemessene Schleifzeit zu klein (unterhalb der Toleranz) bei Regelung KAB" VALUE 0x1D8A34 ZF_kw_ui16_S5_S3 65530 UMR_U_MINSEC2_1_1_0_S5_S3 0 65530 /end CHARACTERISTIC
/begin CHARACTERISTIC K_WNGKLGLSPKABSP86_EL "Korrekturfaktor, wenn gemessene Schleifzeit zu klein (unterhalb der Toleranz) bei Regelung KAB" VALUE 0x1D8A36 ZF_kw_ui16_S5_S3 65530 UMR_U_MINSEC2_1_1_0_S5_S3 0 65530 /end CHARACTERISTIC
/begin CHARACTERISTIC K_WNGKLGLSPKZU32 "Korrekturfaktor, wenn gemessene Schleifzeit zu klein (unterhalb der Toleranz) bei Regelung KZU" VALUE 0x1D87F0 ZF_kw_ui16_S5_S3 65530 UMR_U_MINSEC2_1_1_0_S5_S3 0 65530 /end CHARACTERISTIC
/begin CHARACTERISTIC K_WNGKLGLSPKZU32_EL "Korrekturfaktor, wenn gemessene Schleifzeit zu klein (unterhalb der Toleranz) bei Regelung KZU" VALUE 0x1D87F2 ZF_kw_ui16_S5_S3 65530 UMR_U_MINSEC2_1_1_0_S5_S3 0 65530 /end CHARACTERISTIC
/begin CHARACTERISTIC K_WNGKLGLSPKZU43 "Korrekturfaktor, wenn gemessene Schleifzeit zu klein (unterhalb der Toleranz) bei Regelung KZU" VALUE 0x1D8814 ZF_kw_ui16_S5_S3 65530 UMR_U_MINSEC2_1_1_0_S5_S3 0 65530 /end CHARACTERISTIC
/begin CHARACTERISTIC K_WNGKLGLSPKZU43_EL "Korrekturfaktor, wenn gemessene Schleifzeit zu klein (unterhalb der Toleranz) bei Regelung KZU" VALUE 0x1D8816 ZF_kw_ui16_S5_S3 65530 UMR_U_MINSEC2_1_1_0_S5_S3 0 65530 /end CHARACTERISTIC
/begin CHARACTERISTIC K_WNGKLGLSPKZU54 "Korrekturfaktor, wenn gemessene Schleifzeit zu klein (unterhalb der Toleranz) bei Regelung KZU" VALUE 0x1D8838 ZF_kw_ui16_S5_S3 65530 UMR_U_MINSEC2_1_1_0_S5_S3 0 65530 /end CHARACTERISTIC
/begin CHARACTERISTIC K_WNGKLGLSPKZU54_EL "Korrekturfaktor, wenn gemessene Schleifzeit zu klein (unterhalb der Toleranz) bei Regelung KZU" VALUE 0x1D883A ZF_kw_ui16_S5_S3 65530 UMR_U_MINSEC2_1_1_0_S5_S3 0 65530 /end CHARACTERISTIC
/begin CHARACTERISTIC K_WNGKLGLSPKZU65 "Korrekturfaktor, wenn gemessene Schleifzeit zu klein (unterhalb der Toleranz) bei Regelung KZU" VALUE 0x1D885C ZF_kw_ui16_S5_S3 65530 UMR_U_MINSEC2_1_1_0_S5_S3 0 65530 /end CHARACTERISTIC
/begin CHARACTERISTIC K_WNGKLGLSPKZU65_EL "Korrekturfaktor, wenn gemessene Schleifzeit zu klein (unterhalb der Toleranz) bei Regelung KZU" VALUE 0x1D885E ZF_kw_ui16_S5_S3 65530 UMR_U_MINSEC2_1_1_0_S5_S3 0 65530 /end CHARACTERISTIC
/begin CHARACTERISTIC K_WNGKLGLSPKZU76 "Korrekturfaktor, wenn gemessene Schleifzeit zu klein (unterhalb der Toleranz) bei Regelung KZU" VALUE 0x1D8880 ZF_kw_ui16_S5_S3 65530 UMR_U_MINSEC2_1_1_0_S5_S3 0 65530 /end CHARACTERISTIC
/begin CHARACTERISTIC K_WNGKLGLSPKZU76_EL "Korrekturfaktor, wenn gemessene Schleifzeit zu klein (unterhalb der Toleranz) bei Regelung KZU" VALUE 0x1D8882 ZF_kw_ui16_S5_S3 65530 UMR_U_MINSEC2_1_1_0_S5_S3 0 65530 /end CHARACTERISTIC
/begin CHARACTERISTIC K_WNGKLGLSPKZU87 "Korrekturfaktor, wenn gemessene Schleifzeit zu klein (unterhalb der Toleranz) bei Regelung KZU" VALUE 0x1D88A4 ZF_kw_ui16_S5_S3 65530 UMR_U_MINSEC2_1_1_0_S5_S3 0 65530 /end CHARACTERISTIC
/begin CHARACTERISTIC K_WNGKLGLSPKZU87_EL "Korrekturfaktor, wenn gemessene Schleifzeit zu klein (unterhalb der Toleranz) bei Regelung KZU" VALUE 0x1D88A6 ZF_kw_ui16_S5_S3 65530 UMR_U_MINSEC2_1_1_0_S5_S3 0 65530 /end CHARACTERISTIC
/begin CHARACTERISTIC K_WNGKLGLSPKZUSP42 "Korrekturfaktor, wenn gemessene Schleifzeit zu klein (unterhalb der Toleranz) bei Regelung KZU" VALUE 0x1D88EC ZF_kw_ui16_S5_S3 65530 UMR_U_MINSEC2_1_1_0_S5_S3 0 65530 /end CHARACTERISTIC
/begin CHARACTERISTIC K_WNGKLGLSPKZUSP42_EL "Korrekturfaktor, wenn gemessene Schleifzeit zu klein (unterhalb der Toleranz) bei Regelung KZU" VALUE 0x1D88EE ZF_kw_ui16_S5_S3 65530 UMR_U_MINSEC2_1_1_0_S5_S3 0 65530 /end CHARACTERISTIC
/begin CHARACTERISTIC K_WNGKLGLSPKZUSP51 "Korrekturfaktor, wenn gemessene Schleifzeit zu klein (unterhalb der Toleranz) bei Regelung KZU" VALUE 0x1D8910 ZF_kw_ui16_S5_S3 65530 UMR_U_MINSEC2_1_1_0_S5_S3 0 65530 /end CHARACTERISTIC
/begin CHARACTERISTIC K_WNGKLGLSPKZUSP51_EL "Korrekturfaktor, wenn gemessene Schleifzeit zu klein (unterhalb der Toleranz) bei Regelung KZU" VALUE 0x1D8912 ZF_kw_ui16_S5_S3 65530 UMR_U_MINSEC2_1_1_0_S5_S3 0 65530 /end CHARACTERISTIC
/begin CHARACTERISTIC K_WNGKLGLSPKZUSP53 "Korrekturfaktor, wenn gemessene Schleifzeit zu klein (unterhalb der Toleranz) bei Regelung KZU" VALUE 0x1D8934 ZF_kw_ui16_S5_S3 65530 UMR_U_MINSEC2_1_1_0_S5_S3 0 65530 /end CHARACTERISTIC
/begin CHARACTERISTIC K_WNGKLGLSPKZUSP53_EL "Korrekturfaktor, wenn gemessene Schleifzeit zu klein (unterhalb der Toleranz) bei Regelung KZU" VALUE 0x1D8936 ZF_kw_ui16_S5_S3 65530 UMR_U_MINSEC2_1_1_0_S5_S3 0 65530 /end CHARACTERISTIC
/begin CHARACTERISTIC K_WNGKLGLSPKZUSP63 "Korrekturfaktor, wenn gemessene Schleifzeit zu klein (unterhalb der Toleranz) bei Regelung KZU" VALUE 0x1D8958 ZF_kw_ui16_S5_S3 65530 UMR_U_MINSEC2_1_1_0_S5_S3 0 65530 /end CHARACTERISTIC
/begin CHARACTERISTIC K_WNGKLGLSPKZUSP63_EL "Korrekturfaktor, wenn gemessene Schleifzeit zu klein (unterhalb der Toleranz) bei Regelung KZU" VALUE 0x1D895A ZF_kw_ui16_S5_S3 65530 UMR_U_MINSEC2_1_1_0_S5_S3 0 65530 /end CHARACTERISTIC
/begin CHARACTERISTIC K_WNGKLGLSPKZUSP64 "Korrekturfaktor, wenn gemessene Schleifzeit zu klein (unterhalb der Toleranz) bei Regelung KZU" VALUE 0x1D897C ZF_kw_ui16_S5_S3 65530 UMR_U_MINSEC2_1_1_0_S5_S3 0 65530 /end CHARACTERISTIC
/begin CHARACTERISTIC K_WNGKLGLSPKZUSP64_EL "Korrekturfaktor, wenn gemessene Schleifzeit zu klein (unterhalb der Toleranz) bei Regelung KZU" VALUE 0x1D897E ZF_kw_ui16_S5_S3 65530 UMR_U_MINSEC2_1_1_0_S5_S3 0 65530 /end CHARACTERISTIC
/begin CHARACTERISTIC K_WNGKLGLSPKZUSP71 "Korrekturfaktor, wenn gemessene Schleifzeit zu klein (unterhalb der Toleranz) bei Regelung KZU" VALUE 0x1D89A0 ZF_kw_ui16_S5_S3 65530 UMR_U_MINSEC2_1_1_0_S5_S3 0 65530 /end CHARACTERISTIC
/begin CHARACTERISTIC K_WNGKLGLSPKZUSP71_EL "Korrekturfaktor, wenn gemessene Schleifzeit zu klein (unterhalb der Toleranz) bei Regelung KZU" VALUE 0x1D89A2 ZF_kw_ui16_S5_S3 65530 UMR_U_MINSEC2_1_1_0_S5_S3 0 65530 /end CHARACTERISTIC
/begin CHARACTERISTIC K_WNGKLGLSPKZUSP75 "Korrekturfaktor, wenn gemessene Schleifzeit zu klein (unterhalb der Toleranz) bei Regelung KZU" VALUE 0x1D89C4 ZF_kw_ui16_S5_S3 65530 UMR_U_MINSEC2_1_1_0_S5_S3 0 65530 /end CHARACTERISTIC
/begin CHARACTERISTIC K_WNGKLGLSPKZUSP75_EL "Korrekturfaktor, wenn gemessene Schleifzeit zu klein (unterhalb der Toleranz) bei Regelung KZU" VALUE 0x1D89C6 ZF_kw_ui16_S5_S3 65530 UMR_U_MINSEC2_1_1_0_S5_S3 0 65530 /end CHARACTERISTIC
/begin CHARACTERISTIC K_WNGKLGLSPKZUSP82 "Korrekturfaktor, wenn gemessene Schleifzeit zu klein (unterhalb der Toleranz) bei Regelung KZU" VALUE 0x1D89E8 ZF_kw_ui16_S5_S3 65530 UMR_U_MINSEC2_1_1_0_S5_S3 0 65530 /end CHARACTERISTIC
/begin CHARACTERISTIC K_WNGKLGLSPKZUSP82_EL "Korrekturfaktor, wenn gemessene Schleifzeit zu klein (unterhalb der Toleranz) bei Regelung KZU" VALUE 0x1D89EA ZF_kw_ui16_S5_S3 65530 UMR_U_MINSEC2_1_1_0_S5_S3 0 65530 /end CHARACTERISTIC
/begin CHARACTERISTIC K_WNGKLGLSPKZUSP84 "Korrekturfaktor, wenn gemessene Schleifzeit zu klein (unterhalb der Toleranz) bei Regelung KZU" VALUE 0x1D8A0C ZF_kw_ui16_S5_S3 65530 UMR_U_MINSEC2_1_1_0_S5_S3 0 65530 /end CHARACTERISTIC
/begin CHARACTERISTIC K_WNGKLGLSPKZUSP84_EL "Korrekturfaktor, wenn gemessene Schleifzeit zu klein (unterhalb der Toleranz) bei Regelung KZU" VALUE 0x1D8A0E ZF_kw_ui16_S5_S3 65530 UMR_U_MINSEC2_1_1_0_S5_S3 0 65530 /end CHARACTERISTIC
/begin CHARACTERISTIC K_WNGKLGLSPKZUSP86 "Korrekturfaktor, wenn gemessene Schleifzeit zu klein (unterhalb der Toleranz) bei Regelung KZU" VALUE 0x1D8A30 ZF_kw_ui16_S5_S3 65530 UMR_U_MINSEC2_1_1_0_S5_S3 0 65530 /end CHARACTERISTIC
/begin CHARACTERISTIC K_WNGKLGLSPKZUSP86_EL "Korrekturfaktor, wenn gemessene Schleifzeit zu klein (unterhalb der Toleranz) bei Regelung KZU" VALUE 0x1D8A32 ZF_kw_ui16_S5_S3 65530 UMR_U_MINSEC2_1_1_0_S5_S3 0 65530 /end CHARACTERISTIC
/begin CHARACTERISTIC ND_GLSRS32 "Drehzahlkriterium Start Regelung bei RS" VALUE 0x1D87DE ZF_kw_ui16_S5_S3 8000 UMR_U_MIN_1_1_0_S5_S3 0 8000 /end CHARACTERISTIC
/begin CHARACTERISTIC ND_GLSRS43 "Drehzahlkriterium Start Regelung bei RS" VALUE 0x1D8802 ZF_kw_ui16_S5_S3 8000 UMR_U_MIN_1_1_0_S5_S3 0 8000 /end CHARACTERISTIC
/begin CHARACTERISTIC ND_GLSRS54 "Drehzahlkriterium Start Regelung bei RS" VALUE 0x1D8826 ZF_kw_ui16_S5_S3 8000 UMR_U_MIN_1_1_0_S5_S3 0 8000 /end CHARACTERISTIC
/begin CHARACTERISTIC ND_GLSRS65 "Drehzahlkriterium Start Regelung bei RS" VALUE 0x1D884A ZF_kw_ui16_S5_S3 8000 UMR_U_MIN_1_1_0_S5_S3 0 8000 /end CHARACTERISTIC
/begin CHARACTERISTIC ND_GLSRS76 "Drehzahlkriterium Start Regelung bei RS" VALUE 0x1D886E ZF_kw_ui16_S5_S3 8000 UMR_U_MIN_1_1_0_S5_S3 0 8000 /end CHARACTERISTIC
/begin CHARACTERISTIC ND_GLSRS87 "Drehzahlkriterium Start Regelung bei RS" VALUE 0x1D8892 ZF_kw_ui16_S5_S3 8000 UMR_U_MIN_1_1_0_S5_S3 0 8000 /end CHARACTERISTIC
/begin CHARACTERISTIC ND_GLSRSSP42 "Drehzahlkriterium Start Regelung bei RS" VALUE 0x1D88DA ZF_kw_ui16_S5_S3 8000 UMR_U_MIN_1_1_0_S5_S3 0 8000 /end CHARACTERISTIC
/begin CHARACTERISTIC ND_GLSRSSP51 "Drehzahlkriterium Start Regelung bei RS" VALUE 0x1D88FE ZF_kw_ui16_S5_S3 8000 UMR_U_MIN_1_1_0_S5_S3 0 8000 /end CHARACTERISTIC
/begin CHARACTERISTIC ND_GLSRSSP53 "Drehzahlkriterium Start Regelung bei RS" VALUE 0x1D8922 ZF_kw_ui16_S5_S3 8000 UMR_U_MIN_1_1_0_S5_S3 0 8000 /end CHARACTERISTIC
/begin CHARACTERISTIC ND_GLSRSSP63 "Drehzahlkriterium Start Regelung bei RS" VALUE 0x1D8946 ZF_kw_ui16_S5_S3 8000 UMR_U_MIN_1_1_0_S5_S3 0 8000 /end CHARACTERISTIC
/begin CHARACTERISTIC ND_GLSRSSP64 "Drehzahlkriterium Start Regelung bei RS" VALUE 0x1D896A ZF_kw_ui16_S5_S3 8000 UMR_U_MIN_1_1_0_S5_S3 0 8000 /end CHARACTERISTIC
/begin CHARACTERISTIC ND_GLSRSSP71 "Drehzahlkriterium Start Regelung bei RS" VALUE 0x1D898E ZF_kw_ui16_S5_S3 8000 UMR_U_MIN_1_1_0_S5_S3 0 8000 /end CHARACTERISTIC
/begin CHARACTERISTIC ND_GLSRSSP75 "Drehzahlkriterium Start Regelung bei RS" VALUE 0x1D89B2 ZF_kw_ui16_S5_S3 8000 UMR_U_MIN_1_1_0_S5_S3 0 8000 /end CHARACTERISTIC
/begin CHARACTERISTIC ND_GLSRSSP82 "Drehzahlkriterium Start Regelung bei RS" VALUE 0x1D89D6 ZF_kw_ui16_S5_S3 8000 UMR_U_MIN_1_1_0_S5_S3 0 8000 /end CHARACTERISTIC
/begin CHARACTERISTIC ND_GLSRSSP84 "Drehzahlkriterium Start Regelung bei RS" VALUE 0x1D89FA ZF_kw_ui16_S5_S3 8000 UMR_U_MIN_1_1_0_S5_S3 0 8000 /end CHARACTERISTIC
/begin CHARACTERISTIC ND_GLSRSSP86 "Drehzahlkriterium Start Regelung bei RS" VALUE 0x1D8A1E ZF_kw_ui16_S5_S3 8000 UMR_U_MIN_1_1_0_S5_S3 0 8000 /end CHARACTERISTIC
/begin CHARACTERISTIC PO_ABBGLSHSZ32 "Schaltdruckoffset nach Umstellung einer HSZ in eine RSZ waehrend der GLS-Phase" VALUE 0x1D8800 ZF_kw_si16_S5_S3 12 UMR_BAR__1_1000_0_S5_S3 -6 6 /end CHARACTERISTIC
/begin CHARACTERISTIC PO_ABBGLSHSZ43 "Schaltdruckoffset nach Umstellung einer HSZ in eine RSZ waehrend der GLS-Phase" VALUE 0x1D8824 ZF_kw_si16_S5_S3 12 UMR_BAR__1_1000_0_S5_S3 -6 6 /end CHARACTERISTIC
/begin CHARACTERISTIC PO_ABBGLSHSZ54 "Schaltdruckoffset nach Umstellung einer HSZ in eine RSZ waehrend der GLS-Phase" VALUE 0x1D8848 ZF_kw_si16_S5_S3 12 UMR_BAR__1_1000_0_S5_S3 -6 6 /end CHARACTERISTIC
/begin CHARACTERISTIC PO_ABBGLSHSZ65 "Schaltdruckoffset nach Umstellung einer HSZ in eine RSZ waehrend der GLS-Phase" VALUE 0x1D886C ZF_kw_si16_S5_S3 12 UMR_BAR__1_1000_0_S5_S3 -6 6 /end CHARACTERISTIC
/begin CHARACTERISTIC PO_ABBGLSHSZ76 "Schaltdruckoffset nach Umstellung einer HSZ in eine RSZ waehrend der GLS-Phase" VALUE 0x1D8890 ZF_kw_si16_S5_S3 12 UMR_BAR__1_1000_0_S5_S3 -6 6 /end CHARACTERISTIC
/begin CHARACTERISTIC PO_ABBGLSHSZ87 "Schaltdruckoffset nach Umstellung einer HSZ in eine RSZ waehrend der GLS-Phase" VALUE 0x1D88B4 ZF_kw_si16_S5_S3 12 UMR_BAR__1_1000_0_S5_S3 -6 6 /end CHARACTERISTIC
/begin CHARACTERISTIC PO_ABBGLSHSZSP42 "Schaltdruckoffset nach Umstellung einer HSZ in eine RSZ waehrend der GLS-Phase" VALUE 0x1D88FC ZF_kw_si16_S5_S3 12 UMR_BAR__1_1000_0_S5_S3 -6 6 /end CHARACTERISTIC
/begin CHARACTERISTIC PO_ABBGLSHSZSP51 "Schaltdruckoffset nach Umstellung einer HSZ in eine RSZ waehrend der GLS-Phase" VALUE 0x1D8920 ZF_kw_si16_S5_S3 12 UMR_BAR__1_1000_0_S5_S3 -6 6 /end CHARACTERISTIC
/begin CHARACTERISTIC PO_ABBGLSHSZSP53 "Schaltdruckoffset nach Umstellung einer HSZ in eine RSZ waehrend der GLS-Phase" VALUE 0x1D8944 ZF_kw_si16_S5_S3 12 UMR_BAR__1_1000_0_S5_S3 -6 6 /end CHARACTERISTIC
/begin CHARACTERISTIC PO_ABBGLSHSZSP63 "Schaltdruckoffset nach Umstellung einer HSZ in eine RSZ waehrend der GLS-Phase" VALUE 0x1D8968 ZF_kw_si16_S5_S3 12 UMR_BAR__1_1000_0_S5_S3 -6 6 /end CHARACTERISTIC
/begin CHARACTERISTIC PO_ABBGLSHSZSP64 "Schaltdruckoffset nach Umstellung einer HSZ in eine RSZ waehrend der GLS-Phase" VALUE 0x1D898C ZF_kw_si16_S5_S3 12 UMR_BAR__1_1000_0_S5_S3 -6 6 /end CHARACTERISTIC
/begin CHARACTERISTIC PO_ABBGLSHSZSP71 "Schaltdruckoffset nach Umstellung einer HSZ in eine RSZ waehrend der GLS-Phase" VALUE 0x1D89B0 ZF_kw_si16_S5_S3 12 UMR_BAR__1_1000_0_S5_S3 -6 6 /end CHARACTERISTIC
/begin CHARACTERISTIC PO_ABBGLSHSZSP75 "Schaltdruckoffset nach Umstellung einer HSZ in eine RSZ waehrend der GLS-Phase" VALUE 0x1D89D4 ZF_kw_si16_S5_S3 12 UMR_BAR__1_1000_0_S5_S3 -6 6 /end CHARACTERISTIC
/begin CHARACTERISTIC PO_ABBGLSHSZSP82 "Schaltdruckoffset nach Umstellung einer HSZ in eine RSZ waehrend der GLS-Phase" VALUE 0x1D89F8 ZF_kw_si16_S5_S3 12 UMR_BAR__1_1000_0_S5_S3 -6 6 /end CHARACTERISTIC
/begin CHARACTERISTIC PO_ABBGLSHSZSP84 "Schaltdruckoffset nach Umstellung einer HSZ in eine RSZ waehrend der GLS-Phase" VALUE 0x1D8A1C ZF_kw_si16_S5_S3 12 UMR_BAR__1_1000_0_S5_S3 -6 6 /end CHARACTERISTIC
/begin CHARACTERISTIC PO_ABBGLSHSZSP86 "Schaltdruckoffset nach Umstellung einer HSZ in eine RSZ waehrend der GLS-Phase" VALUE 0x1D8A40 ZF_kw_si16_S5_S3 12 UMR_BAR__1_1000_0_S5_S3 -6 6 /end CHARACTERISTIC
/begin CHARACTERISTIC TD_STOLGLS32 "max. tol. Schleifzeitdifferenz GLS" VALUE 0x1D7946 ZF_kw_ui8_S5_S3 2540 UMR_MSEC__10_1_0_S5_S3 0 2540 /end CHARACTERISTIC
/begin CHARACTERISTIC TD_STOLGLS32_EL "max. tol. Schleifzeitdifferenz GLS" VALUE 0x1D7947 ZF_kw_ui8_S5_S3 2540 UMR_MSEC__10_1_0_S5_S3 0 2540 /end CHARACTERISTIC
/begin CHARACTERISTIC TD_STOLGLS43 "max. tol. Schleifzeitdifferenz GLS" VALUE 0x1D7948 ZF_kw_ui8_S5_S3 2540 UMR_MSEC__10_1_0_S5_S3 0 2540 /end CHARACTERISTIC
/begin CHARACTERISTIC TD_STOLGLS43_EL "max. tol. Schleifzeitdifferenz GLS" VALUE 0x1D7949 ZF_kw_ui8_S5_S3 2540 UMR_MSEC__10_1_0_S5_S3 0 2540 /end CHARACTERISTIC
/begin CHARACTERISTIC TD_STOLGLS54 "max. tol. Schleifzeitdifferenz GLS" VALUE 0x1D794A ZF_kw_ui8_S5_S3 2540 UMR_MSEC__10_1_0_S5_S3 0 2540 /end CHARACTERISTIC
/begin CHARACTERISTIC TD_STOLGLS54_EL "max. tol. Schleifzeitdifferenz GLS" VALUE 0x1D794B ZF_kw_ui8_S5_S3 2540 UMR_MSEC__10_1_0_S5_S3 0 2540 /end CHARACTERISTIC
/begin CHARACTERISTIC TD_STOLGLS65 "max. tol. Schleifzeitdifferenz GLS" VALUE 0x1D794C ZF_kw_ui8_S5_S3 2540 UMR_MSEC__10_1_0_S5_S3 0 2540 /end CHARACTERISTIC
/begin CHARACTERISTIC TD_STOLGLS65_EL "max. tol. Schleifzeitdifferenz GLS" VALUE 0x1D794D ZF_kw_ui8_S5_S3 2540 UMR_MSEC__10_1_0_S5_S3 0 2540 /end CHARACTERISTIC
/begin CHARACTERISTIC TD_STOLGLS76 "max. tol. Schleifzeitdifferenz GLS" VALUE 0x1D794E ZF_kw_ui8_S5_S3 2540 UMR_MSEC__10_1_0_S5_S3 0 2540 /end CHARACTERISTIC
/begin CHARACTERISTIC TD_STOLGLS76_EL "max. tol. Schleifzeitdifferenz GLS" VALUE 0x1D794F ZF_kw_ui8_S5_S3 2540 UMR_MSEC__10_1_0_S5_S3 0 2540 /end CHARACTERISTIC
/begin CHARACTERISTIC TD_STOLGLS87 "max. tol. Schleifzeitdifferenz GLS" VALUE 0x1D7950 ZF_kw_ui8_S5_S3 2540 UMR_MSEC__10_1_0_S5_S3 0 2540 /end CHARACTERISTIC
/begin CHARACTERISTIC TD_STOLGLS87_EL "max. tol. Schleifzeitdifferenz GLS" VALUE 0x1D7951 ZF_kw_ui8_S5_S3 2540 UMR_MSEC__10_1_0_S5_S3 0 2540 /end CHARACTERISTIC
/begin CHARACTERISTIC TD_STOLGLSSP42 "max. tol. Schleifzeitdifferenz GLS" VALUE 0x1D7954 ZF_kw_ui8_S5_S3 2540 UMR_MSEC__10_1_0_S5_S3 0 2540 /end CHARACTERISTIC
/begin CHARACTERISTIC TD_STOLGLSSP42_EL "max. tol. Schleifzeitdifferenz GLS" VALUE 0x1D7955 ZF_kw_ui8_S5_S3 2540 UMR_MSEC__10_1_0_S5_S3 0 2540 /end CHARACTERISTIC
/begin CHARACTERISTIC TD_STOLGLSSP51 "max. tol. Schleifzeitdifferenz GLS" VALUE 0x1D7956 ZF_kw_ui8_S5_S3 2540 UMR_MSEC__10_1_0_S5_S3 0 2540 /end CHARACTERISTIC
/begin CHARACTERISTIC TD_STOLGLSSP51_EL "max. tol. Schleifzeitdifferenz GLS" VALUE 0x1D7957 ZF_kw_ui8_S5_S3 2540 UMR_MSEC__10_1_0_S5_S3 0 2540 /end CHARACTERISTIC
/begin CHARACTERISTIC TD_STOLGLSSP53 "max. tol. Schleifzeitdifferenz GLS" VALUE 0x1D7958 ZF_kw_ui8_S5_S3 2540 UMR_MSEC__10_1_0_S5_S3 0 2540 /end CHARACTERISTIC
/begin CHARACTERISTIC TD_STOLGLSSP53_EL "max. tol. Schleifzeitdifferenz GLS" VALUE 0x1D7959 ZF_kw_ui8_S5_S3 2540 UMR_MSEC__10_1_0_S5_S3 0 2540 /end CHARACTERISTIC
/begin CHARACTERISTIC TD_STOLGLSSP63 "max. tol. Schleifzeitdifferenz GLS" VALUE 0x1D795A ZF_kw_ui8_S5_S3 2540 UMR_MSEC__10_1_0_S5_S3 0 2540 /end CHARACTERISTIC
/begin CHARACTERISTIC TD_STOLGLSSP63_EL "max. tol. Schleifzeitdifferenz GLS" VALUE 0x1D795B ZF_kw_ui8_S5_S3 2540 UMR_MSEC__10_1_0_S5_S3 0 2540 /end CHARACTERISTIC
/begin CHARACTERISTIC TD_STOLGLSSP64 "max. tol. Schleifzeitdifferenz GLS" VALUE 0x1D795C ZF_kw_ui8_S5_S3 2540 UMR_MSEC__10_1_0_S5_S3 0 2540 /end CHARACTERISTIC
/begin CHARACTERISTIC TD_STOLGLSSP64_EL "max. tol. Schleifzeitdifferenz GLS" VALUE 0x1D795D ZF_kw_ui8_S5_S3 2540 UMR_MSEC__10_1_0_S5_S3 0 2540 /end CHARACTERISTIC
/begin CHARACTERISTIC TD_STOLGLSSP71 "max. tol. Schleifzeitdifferenz GLS" VALUE 0x1D795E ZF_kw_ui8_S5_S3 2540 UMR_MSEC__10_1_0_S5_S3 0 2540 /end CHARACTERISTIC
/begin CHARACTERISTIC TD_STOLGLSSP71_EL "max. tol. Schleifzeitdifferenz GLS" VALUE 0x1D795F ZF_kw_ui8_S5_S3 2540 UMR_MSEC__10_1_0_S5_S3 0 2540 /end CHARACTERISTIC
/begin CHARACTERISTIC TD_STOLGLSSP75 "max. tol. Schleifzeitdifferenz GLS" VALUE 0x1D7960 ZF_kw_ui8_S5_S3 2540 UMR_MSEC__10_1_0_S5_S3 0 2540 /end CHARACTERISTIC
/begin CHARACTERISTIC TD_STOLGLSSP75_EL "max. tol. Schleifzeitdifferenz GLS" VALUE 0x1D7961 ZF_kw_ui8_S5_S3 2540 UMR_MSEC__10_1_0_S5_S3 0 2540 /end CHARACTERISTIC
/begin CHARACTERISTIC TD_STOLGLSSP82 "max. tol. Schleifzeitdifferenz GLS" VALUE 0x1D7962 ZF_kw_ui8_S5_S3 2540 UMR_MSEC__10_1_0_S5_S3 0 2540 /end CHARACTERISTIC
/begin CHARACTERISTIC TD_STOLGLSSP82_EL "max. tol. Schleifzeitdifferenz GLS" VALUE 0x1D7963 ZF_kw_ui8_S5_S3 2540 UMR_MSEC__10_1_0_S5_S3 0 2540 /end CHARACTERISTIC
/begin CHARACTERISTIC TD_STOLGLSSP84 "max. tol. Schleifzeitdifferenz GLS" VALUE 0x1D7964 ZF_kw_ui8_S5_S3 2540 UMR_MSEC__10_1_0_S5_S3 0 2540 /end CHARACTERISTIC
/begin CHARACTERISTIC TD_STOLGLSSP84_EL "max. tol. Schleifzeitdifferenz GLS" VALUE 0x1D7965 ZF_kw_ui8_S5_S3 2540 UMR_MSEC__10_1_0_S5_S3 0 2540 /end CHARACTERISTIC
/begin CHARACTERISTIC TD_STOLGLSSP86 "max. tol. Schleifzeitdifferenz GLS" VALUE 0x1D7966 ZF_kw_ui8_S5_S3 2540 UMR_MSEC__10_1_0_S5_S3 0 2540 /end CHARACTERISTIC
/begin CHARACTERISTIC TD_STOLGLSSP86_EL "max. tol. Schleifzeitdifferenz GLS" VALUE 0x1D7967 ZF_kw_ui8_S5_S3 2540 UMR_MSEC__10_1_0_S5_S3 0 2540 /end CHARACTERISTIC
/begin CHARACTERISTIC T_RAABV12 "Zeit Rampe auf Schaltdruck" VALUE 0x1D796A ZF_kw_ui8_S5_S3 2540 UMR_MSEC__10_1_0_S5_S3 0 2540 /end CHARACTERISTIC
/begin CHARACTERISTIC T_RAABV21 "Zeit Rampe auf Schaltdruck" VALUE 0x1D7971 ZF_kw_ui8_S5_S3 2540 UMR_MSEC__10_1_0_S5_S3 0 2540 /end CHARACTERISTIC
/begin CHARACTERISTIC T_RAABV23 "Zeit Rampe auf Schaltdruck" VALUE 0x1D796B ZF_kw_ui8_S5_S3 2540 UMR_MSEC__10_1_0_S5_S3 0 2540 /end CHARACTERISTIC
/begin CHARACTERISTIC T_RAABV32 "Zeit Rampe auf Schaltdruck" VALUE 0x1D7973 ZF_kw_ui8_S5_S3 2540 UMR_MSEC__10_1_0_S5_S3 0 2540 /end CHARACTERISTIC
/begin CHARACTERISTIC T_RAABV34 "Zeit Rampe auf Schaltdruck" VALUE 0x1D796C ZF_kw_ui8_S5_S3 2540 UMR_MSEC__10_1_0_S5_S3 0 2540 /end CHARACTERISTIC
/begin CHARACTERISTIC T_RAABV43 "Zeit Rampe auf Schaltdruck" VALUE 0x1D7975 ZF_kw_ui8_S5_S3 2540 UMR_MSEC__10_1_0_S5_S3 0 2540 /end CHARACTERISTIC
/begin CHARACTERISTIC T_RAABV45 "Zeit Rampe auf Schaltdruck" VALUE 0x1D796D ZF_kw_ui8_S5_S3 2540 UMR_MSEC__10_1_0_S5_S3 0 2540 /end CHARACTERISTIC
/begin CHARACTERISTIC T_RAABV54 "Zeit Rampe auf Schaltdruck" VALUE 0x1D7976 ZF_kw_ui8_S5_S3 2540 UMR_MSEC__10_1_0_S5_S3 0 2540 /end CHARACTERISTIC
/begin CHARACTERISTIC T_RAABV56 "Zeit Rampe auf Schaltdruck" VALUE 0x1D796E ZF_kw_ui8_S5_S3 2540 UMR_MSEC__10_1_0_S5_S3 0 2540 /end CHARACTERISTIC
/begin CHARACTERISTIC T_RAABV65 "Zeit Rampe auf Schaltdruck" VALUE 0x1D7978 ZF_kw_ui8_S5_S3 2540 UMR_MSEC__10_1_0_S5_S3 0 2540 /end CHARACTERISTIC
/begin CHARACTERISTIC T_RAABV67 "Zeit Rampe auf Schaltdruck" VALUE 0x1D796F ZF_kw_ui8_S5_S3 2540 UMR_MSEC__10_1_0_S5_S3 0 2540 /end CHARACTERISTIC
/begin CHARACTERISTIC T_RAABV76 "Zeit Rampe auf Schaltdruck" VALUE 0x1D797A ZF_kw_ui8_S5_S3 2540 UMR_MSEC__10_1_0_S5_S3 0 2540 /end CHARACTERISTIC
/begin CHARACTERISTIC T_RAABV78 "Zeit Rampe auf Schaltdruck" VALUE 0x1D7970 ZF_kw_ui8_S5_S3 2540 UMR_MSEC__10_1_0_S5_S3 0 2540 /end CHARACTERISTIC
/begin CHARACTERISTIC T_RAABV87 "Zeit Rampe auf Schaltdruck" VALUE 0x1D797C ZF_kw_ui8_S5_S3 2540 UMR_MSEC__10_1_0_S5_S3 0 2540 /end CHARACTERISTIC
/begin CHARACTERISTIC T_RAABVFOLNACH64MRS43 "Zeit Rampe auf Schaltdruck" VALUE 0x1D7969 ZF_kw_ui8_S5_S3 2540 UMR_MSEC__10_1_0_S5_S3 0 2540 /end CHARACTERISTIC
/begin CHARACTERISTIC T_RAABVFOLNACH84MRS43 "Zeit Rampe auf Schaltdruck" VALUE 0x1D7968 ZF_kw_ui8_S5_S3 2540 UMR_MSEC__10_1_0_S5_S3 0 2540 /end CHARACTERISTIC
/begin CHARACTERISTIC T_RAABVFOLNACHMRS21 "Zeit Rampe auf Schaltdruck" VALUE 0x1D7972 ZF_kw_ui8_S5_S3 2540 UMR_MSEC__10_1_0_S5_S3 0 2540 /end CHARACTERISTIC
/begin CHARACTERISTIC T_RAABVFOLNACHMRS32 "Zeit Rampe auf Schaltdruck" VALUE 0x1D7974 ZF_kw_ui8_S5_S3 2540 UMR_MSEC__10_1_0_S5_S3 0 2540 /end CHARACTERISTIC
/begin CHARACTERISTIC T_RAABVFOLNACHMRS54 "Zeit Rampe auf Schaltdruck" VALUE 0x1D7977 ZF_kw_ui8_S5_S3 2540 UMR_MSEC__10_1_0_S5_S3 0 2540 /end CHARACTERISTIC
/begin CHARACTERISTIC T_RAABVFOLNACHMRS65 "Zeit Rampe auf Schaltdruck" VALUE 0x1D7979 ZF_kw_ui8_S5_S3 2540 UMR_MSEC__10_1_0_S5_S3 0 2540 /end CHARACTERISTIC
/begin CHARACTERISTIC T_RAABVFOLNACHMRS76 "Zeit Rampe auf Schaltdruck" VALUE 0x1D797B ZF_kw_ui8_S5_S3 2540 UMR_MSEC__10_1_0_S5_S3 0 2540 /end CHARACTERISTIC
/begin CHARACTERISTIC T_RAABVFOLNACHMRS87 "Zeit Rampe auf Schaltdruck" VALUE 0x1D797D ZF_kw_ui8_S5_S3 2540 UMR_MSEC__10_1_0_S5_S3 0 2540 /end CHARACTERISTIC
/begin CHARACTERISTIC T_VKABHS12 "Verzögerungszeit abschaltende Kupplung bei HS" VALUE 0x1D797E ZF_kw_ui8_S5_S3 2000 UMR_MSEC__10_1_0_S5_S3 0 2000 /end CHARACTERISTIC
/begin CHARACTERISTIC T_VKABHS23 "Verzögerungszeit abschaltende Kupplung bei HS" VALUE 0x1D797F ZF_kw_ui8_S5_S3 2000 UMR_MSEC__10_1_0_S5_S3 0 2000 /end CHARACTERISTIC
/begin CHARACTERISTIC T_VKABHS34 "Verzögerungszeit abschaltende Kupplung bei HS" VALUE 0x1D7980 ZF_kw_ui8_S5_S3 2000 UMR_MSEC__10_1_0_S5_S3 0 2000 /end CHARACTERISTIC
/begin CHARACTERISTIC T_VKABHS45 "Verzögerungszeit abschaltende Kupplung bei HS" VALUE 0x1D7981 ZF_kw_ui8_S5_S3 2000 UMR_MSEC__10_1_0_S5_S3 0 2000 /end CHARACTERISTIC
/begin CHARACTERISTIC T_VKABHS56 "Verzögerungszeit abschaltende Kupplung bei HS" VALUE 0x1D7982 ZF_kw_ui8_S5_S3 2000 UMR_MSEC__10_1_0_S5_S3 0 2000 /end CHARACTERISTIC
/begin CHARACTERISTIC T_VKABHS67 "Verzögerungszeit abschaltende Kupplung bei HS" VALUE 0x1D7983 ZF_kw_ui8_S5_S3 2000 UMR_MSEC__10_1_0_S5_S3 0 2000 /end CHARACTERISTIC
/begin CHARACTERISTIC T_VKABHS78 "Verzögerungszeit abschaltende Kupplung bei HS" VALUE 0x1D7984 ZF_kw_ui8_S5_S3 2000 UMR_MSEC__10_1_0_S5_S3 0 2000 /end CHARACTERISTIC
/begin CHARACTERISTIC T_VKABHSSP12 "Verzögerungszeit abschaltende Kupplung bei HS" VALUE 0x1D7985 ZF_kw_ui8_S5_S3 2000 UMR_MSEC__10_1_0_S5_S3 0 2000 /end CHARACTERISTIC
/begin CHARACTERISTIC T_VKABHSSP23 "Verzögerungszeit abschaltende Kupplung bei HS" VALUE 0x1D7986 ZF_kw_ui8_S5_S3 2000 UMR_MSEC__10_1_0_S5_S3 0 2000 /end CHARACTERISTIC
/begin CHARACTERISTIC T_VKABHSSP34 "Verzögerungszeit abschaltende Kupplung bei HS" VALUE 0x1D7987 ZF_kw_ui8_S5_S3 2000 UMR_MSEC__10_1_0_S5_S3 0 2000 /end CHARACTERISTIC
/begin CHARACTERISTIC T_VKABHSSP45 "Verzögerungszeit abschaltende Kupplung bei HS" VALUE 0x1D7988 ZF_kw_ui8_S5_S3 2000 UMR_MSEC__10_1_0_S5_S3 0 2000 /end CHARACTERISTIC
/begin CHARACTERISTIC T_VKABHSSP56 "Verzögerungszeit abschaltende Kupplung bei HS" VALUE 0x1D7989 ZF_kw_ui8_S5_S3 2000 UMR_MSEC__10_1_0_S5_S3 0 2000 /end CHARACTERISTIC
/begin CHARACTERISTIC T_VKABHSSP67 "Verzögerungszeit abschaltende Kupplung bei HS" VALUE 0x1D798A ZF_kw_ui8_S5_S3 2000 UMR_MSEC__10_1_0_S5_S3 0 2000 /end CHARACTERISTIC
/begin CHARACTERISTIC T_VKABHSSP78 "Verzögerungszeit abschaltende Kupplung bei HS" VALUE 0x1D798B ZF_kw_ui8_S5_S3 2000 UMR_MSEC__10_1_0_S5_S3 0 2000 /end CHARACTERISTIC
/begin FUNCTION jSasGlsRSS32_Fktn "Applikationesgroessen Instanz jSasGlsRSS32"
 /begin DEF_CHARACTERISTIC KI_GLSKAB32 KI_GLSKAB32_EL KI_GLSKZU32 KI_GLSKZU32_EL KL_TVGLSKZUCG32 KP_GLSKAB32 KP_GLSKAB32_EL KP_GLSKZU32 KP_GLSKZU32_EL K_WNGGRGLSPKAB32 K_WNGGRGLSPKAB32_EL K_WNGGRGLSPKZU32 K_WNGGRGLSPKZU32_EL K_WNGKLGLSPKAB32 K_WNGKLGLSPKAB32_EL K_WNGKLGLSPKZU32 K_WNGKLGLSPKZU32_EL ND_GLSRS32 PO_ABBGLSHSZ32 TD_STOLGLS32 TD_STOLGLS32_EL /end DEF_CHARACTERISTIC
/end FUNCTION
/begin FUNCTION jSasGlsRSS42_Fktn "Applikationesgroessen Instanz jSasGlsRSS42"
 /begin DEF_CHARACTERISTIC KI_GLSKABSP42 KI_GLSKABSP42_EL KI_GLSKZUSP42 KI_GLSKZUSP42_EL KL_TVGLSKZUCGSP42 KP_GLSKABSP42 KP_GLSKABSP42_EL KP_GLSKZUSP42 KP_GLSKZUSP42_EL K_WNGGRGLSPKABSP42 K_WNGGRGLSPKABSP42_EL K_WNGGRGLSPKZUSP42 K_WNGGRGLSPKZUSP42_EL K_WNGKLGLSPKABSP42 K_WNGKLGLSPKABSP42_EL K_WNGKLGLSPKZUSP42 K_WNGKLGLSPKZUSP42_EL ND_GLSRSSP42 PO_ABBGLSHSZSP42 TD_STOLGLSSP42 TD_STOLGLSSP42_EL /end DEF_CHARACTERISTIC
/end FUNCTION
/begin FUNCTION jSasGlsRSS43_Fktn "Applikationesgroessen Instanz jSasGlsRSS43"
 /begin DEF_CHARACTERISTIC KI_GLSKAB43 KI_GLSKAB43_EL KI_GLSKZU43 KI_GLSKZU43_EL KL_TVGLSKZUCG43 KP_GLSKAB43 KP_GLSKAB43_EL KP_GLSKZU43 KP_GLSKZU43_EL K_WNGGRGLSPKAB43 K_WNGGRGLSPKAB43_EL K_WNGGRGLSPKZU43 K_WNGGRGLSPKZU43_EL K_WNGKLGLSPKAB43 K_WNGKLGLSPKAB43_EL K_WNGKLGLSPKZU43 K_WNGKLGLSPKZU43_EL ND_GLSRS43 PO_ABBGLSHSZ43 TD_STOLGLS43 TD_STOLGLS43_EL /end DEF_CHARACTERISTIC
/end FUNCTION
/begin FUNCTION jSasGlsRSS51_Fktn "Applikationesgroessen Instanz jSasGlsRSS51"
 /begin DEF_CHARACTERISTIC KI_GLSKABSP51 KI_GLSKABSP51_EL KI_GLSKZUSP51 KI_GLSKZUSP51_EL KL_TVGLSKZUCGSP51 KP_GLSKABSP51 KP_GLSKABSP51_EL KP_GLSKZUSP51 KP_GLSKZUSP51_EL K_WNGGRGLSPKABSP51 K_WNGGRGLSPKABSP51_EL K_WNGGRGLSPKZUSP51 K_WNGGRGLSPKZUSP51_EL K_WNGKLGLSPKABSP51 K_WNGKLGLSPKABSP51_EL K_WNGKLGLSPKZUSP51 K_WNGKLGLSPKZUSP51_EL ND_GLSRSSP51 PO_ABBGLSHSZSP51 TD_STOLGLSSP51 TD_STOLGLSSP51_EL /end DEF_CHARACTERISTIC
/end FUNCTION
/begin FUNCTION jSasGlsRSS53_Fktn "Applikationesgroessen Instanz jSasGlsRSS53"
 /begin DEF_CHARACTERISTIC KI_GLSKABSP53 KI_GLSKABSP53_EL KI_GLSKZUSP53 KI_GLSKZUSP53_EL KL_TVGLSKZUCGSP53 KP_GLSKABSP53 KP_GLSKABSP53_EL KP_GLSKZUSP53 KP_GLSKZUSP53_EL K_WNGGRGLSPKABSP53 K_WNGGRGLSPKABSP53_EL K_WNGGRGLSPKZUSP53 K_WNGGRGLSPKZUSP53_EL K_WNGKLGLSPKABSP53 K_WNGKLGLSPKABSP53_EL K_WNGKLGLSPKZUSP53 K_WNGKLGLSPKZUSP53_EL ND_GLSRSSP53 PO_ABBGLSHSZSP53 TD_STOLGLSSP53 TD_STOLGLSSP53_EL /end DEF_CHARACTERISTIC
/end FUNCTION
/begin FUNCTION jSasGlsRSS54_Fktn "Applikationesgroessen Instanz jSasGlsRSS54"
 /begin DEF_CHARACTERISTIC KI_GLSKAB54 KI_GLSKAB54_EL KI_GLSKZU54 KI_GLSKZU54_EL KL_TVGLSKZUCG54 KP_GLSKAB54 KP_GLSKAB54_EL KP_GLSKZU54 KP_GLSKZU54_EL K_WNGGRGLSPKAB54 K_WNGGRGLSPKAB54_EL K_WNGGRGLSPKZU54 K_WNGGRGLSPKZU54_EL K_WNGKLGLSPKAB54 K_WNGKLGLSPKAB54_EL K_WNGKLGLSPKZU54 K_WNGKLGLSPKZU54_EL ND_GLSRS54 PO_ABBGLSHSZ54 TD_STOLGLS54 TD_STOLGLS54_EL /end DEF_CHARACTERISTIC
/end FUNCTION
/begin FUNCTION jSasGlsRSS63_Fktn "Applikationesgroessen Instanz jSasGlsRSS63"
 /begin DEF_CHARACTERISTIC KI_GLSKABSP63 KI_GLSKABSP63_EL KI_GLSKZUSP63 KI_GLSKZUSP63_EL KL_TVGLSKZUCGSP63 KP_GLSKABSP63 KP_GLSKABSP63_EL KP_GLSKZUSP63 KP_GLSKZUSP63_EL K_WNGGRGLSPKABSP63 K_WNGGRGLSPKABSP63_EL K_WNGGRGLSPKZUSP63 K_WNGGRGLSPKZUSP63_EL K_WNGKLGLSPKABSP63 K_WNGKLGLSPKABSP63_EL K_WNGKLGLSPKZUSP63 K_WNGKLGLSPKZUSP63_EL ND_GLSRSSP63 PO_ABBGLSHSZSP63 TD_STOLGLSSP63 TD_STOLGLSSP63_EL /end DEF_CHARACTERISTIC
/end FUNCTION
/begin FUNCTION jSasGlsRSS64_Fktn "Applikationesgroessen Instanz jSasGlsRSS64"
 /begin DEF_CHARACTERISTIC KI_GLSKABSP64 KI_GLSKABSP64_EL KI_GLSKZUSP64 KI_GLSKZUSP64_EL KL_TVGLSKZUCGSP64 KP_GLSKABSP64 KP_GLSKABSP64_EL KP_GLSKZUSP64 KP_GLSKZUSP64_EL K_WNGGRGLSPKABSP64 K_WNGGRGLSPKABSP64_EL K_WNGGRGLSPKZUSP64 K_WNGGRGLSPKZUSP64_EL K_WNGKLGLSPKABSP64 K_WNGKLGLSPKABSP64_EL K_WNGKLGLSPKZUSP64 K_WNGKLGLSPKZUSP64_EL ND_GLSRSSP64 PO_ABBGLSHSZSP64 TD_STOLGLSSP64 TD_STOLGLSSP64_EL /end DEF_CHARACTERISTIC
/end FUNCTION
/begin FUNCTION jSasGlsRSS65_Fktn "Applikationesgroessen Instanz jSasGlsRSS65"
 /begin DEF_CHARACTERISTIC KI_GLSKAB65 KI_GLSKAB65_EL KI_GLSKZU65 KI_GLSKZU65_EL KL_TVGLSKZUCG65 KP_GLSKAB65 KP_GLSKAB65_EL KP_GLSKZU65 KP_GLSKZU65_EL K_WNGGRGLSPKAB65 K_WNGGRGLSPKAB65_EL K_WNGGRGLSPKZU65 K_WNGGRGLSPKZU65_EL K_WNGKLGLSPKAB65 K_WNGKLGLSPKAB65_EL K_WNGKLGLSPKZU65 K_WNGKLGLSPKZU65_EL ND_GLSRS65 PO_ABBGLSHSZ65 TD_STOLGLS65 TD_STOLGLS65_EL /end DEF_CHARACTERISTIC
/end FUNCTION
/begin FUNCTION jSasGlsRSS71_Fktn "Applikationesgroessen Instanz jSasGlsRSS71"
 /begin DEF_CHARACTERISTIC KI_GLSKABSP71 KI_GLSKABSP71_EL KI_GLSKZUSP71 KI_GLSKZUSP71_EL KL_TVGLSKZUCGSP71 KP_GLSKABSP71 KP_GLSKABSP71_EL KP_GLSKZUSP71 KP_GLSKZUSP71_EL K_WNGGRGLSPKABSP71 K_WNGGRGLSPKABSP71_EL K_WNGGRGLSPKZUSP71 K_WNGGRGLSPKZUSP71_EL K_WNGKLGLSPKABSP71 K_WNGKLGLSPKABSP71_EL K_WNGKLGLSPKZUSP71 K_WNGKLGLSPKZUSP71_EL ND_GLSRSSP71 PO_ABBGLSHSZSP71 TD_STOLGLSSP71 TD_STOLGLSSP71_EL /end DEF_CHARACTERISTIC
/end FUNCTION
/begin FUNCTION jSasGlsRSS75_Fktn "Applikationesgroessen Instanz jSasGlsRSS75"
 /begin DEF_CHARACTERISTIC KI_GLSKABSP75 KI_GLSKABSP75_EL KI_GLSKZUSP75 KI_GLSKZUSP75_EL KL_TVGLSKZUCGSP75 KP_GLSKABSP75 KP_GLSKABSP75_EL KP_GLSKZUSP75 KP_GLSKZUSP75_EL K_WNGGRGLSPKABSP75 K_WNGGRGLSPKABSP75_EL K_WNGGRGLSPKZUSP75 K_WNGGRGLSPKZUSP75_EL K_WNGKLGLSPKABSP75 K_WNGKLGLSPKABSP75_EL K_WNGKLGLSPKZUSP75 K_WNGKLGLSPKZUSP75_EL ND_GLSRSSP75 PO_ABBGLSHSZSP75 TD_STOLGLSSP75 TD_STOLGLSSP75_EL /end DEF_CHARACTERISTIC
/end FUNCTION
/begin FUNCTION jSasGlsRSS76_Fktn "Applikationesgroessen Instanz jSasGlsRSS76"
 /begin DEF_CHARACTERISTIC KI_GLSKAB76 KI_GLSKAB76_EL KI_GLSKZU76 KI_GLSKZU76_EL KL_TVGLSKZUCG76 KP_GLSKAB76 KP_GLSKAB76_EL KP_GLSKZU76 KP_GLSKZU76_EL K_WNGGRGLSPKAB76 K_WNGGRGLSPKAB76_EL K_WNGGRGLSPKZU76 K_WNGGRGLSPKZU76_EL K_WNGKLGLSPKAB76 K_WNGKLGLSPKAB76_EL K_WNGKLGLSPKZU76 K_WNGKLGLSPKZU76_EL ND_GLSRS76 PO_ABBGLSHSZ76 TD_STOLGLS76 TD_STOLGLS76_EL /end DEF_CHARACTERISTIC
/end FUNCTION
/begin FUNCTION jSasGlsRSS82_Fktn "Applikationesgroessen Instanz jSasGlsRSS82"
 /begin DEF_CHARACTERISTIC KI_GLSKABSP82 KI_GLSKABSP82_EL KI_GLSKZUSP82 KI_GLSKZUSP82_EL KL_TVGLSKZUCGSP82 KP_GLSKABSP82 KP_GLSKABSP82_EL KP_GLSKZUSP82 KP_GLSKZUSP82_EL K_WNGGRGLSPKABSP82 K_WNGGRGLSPKABSP82_EL K_WNGGRGLSPKZUSP82 K_WNGGRGLSPKZUSP82_EL K_WNGKLGLSPKABSP82 K_WNGKLGLSPKABSP82_EL K_WNGKLGLSPKZUSP82 K_WNGKLGLSPKZUSP82_EL ND_GLSRSSP82 PO_ABBGLSHSZSP82 TD_STOLGLSSP82 TD_STOLGLSSP82_EL /end DEF_CHARACTERISTIC
/end FUNCTION
/begin FUNCTION jSasGlsRSS84_Fktn "Applikationesgroessen Instanz jSasGlsRSS84"
 /begin DEF_CHARACTERISTIC KI_GLSKABSP84 KI_GLSKABSP84_EL KI_GLSKZUSP84 KI_GLSKZUSP84_EL KL_TVGLSKZUCGSP84 KP_GLSKABSP84 KP_GLSKABSP84_EL KP_GLSKZUSP84 KP_GLSKZUSP84_EL K_WNGGRGLSPKABSP84 K_WNGGRGLSPKABSP84_EL K_WNGGRGLSPKZUSP84 K_WNGGRGLSPKZUSP84_EL K_WNGKLGLSPKABSP84 K_WNGKLGLSPKABSP84_EL K_WNGKLGLSPKZUSP84 K_WNGKLGLSPKZUSP84_EL ND_GLSRSSP84 PO_ABBGLSHSZSP84 TD_STOLGLSSP84 TD_STOLGLSSP84_EL /end DEF_CHARACTERISTIC
/end FUNCTION
/begin FUNCTION jSasGlsRSS86_Fktn "Applikationesgroessen Instanz jSasGlsRSS86"
 /begin DEF_CHARACTERISTIC KI_GLSKABSP86 KI_GLSKABSP86_EL KI_GLSKZUSP86 KI_GLSKZUSP86_EL KL_TVGLSKZUCGSP86 KP_GLSKABSP86 KP_GLSKABSP86_EL KP_GLSKZUSP86 KP_GLSKZUSP86_EL K_WNGGRGLSPKABSP86 K_WNGGRGLSPKABSP86_EL K_WNGGRGLSPKZUSP86 K_WNGGRGLSPKZUSP86_EL K_WNGKLGLSPKABSP86 K_WNGKLGLSPKABSP86_EL K_WNGKLGLSPKZUSP86 K_WNGKLGLSPKZUSP86_EL ND_GLSRSSP86 PO_ABBGLSHSZSP86 TD_STOLGLSSP86 TD_STOLGLSSP86_EL /end DEF_CHARACTERISTIC
/end FUNCTION
/begin FUNCTION jSasGlsRSS87_Fktn "Applikationesgroessen Instanz jSasGlsRSS87"
 /begin DEF_CHARACTERISTIC KI_GLSKAB87 KI_GLSKAB87_EL KI_GLSKZU87 KI_GLSKZU87_EL KL_TVGLSKZUCG87 KP_GLSKAB87 KP_GLSKAB87_EL KP_GLSKZU87 KP_GLSKZU87_EL K_WNGGRGLSPKAB87 K_WNGGRGLSPKAB87_EL K_WNGGRGLSPKZU87 K_WNGGRGLSPKZU87_EL K_WNGKLGLSPKAB87 K_WNGKLGLSPKAB87_EL K_WNGKLGLSPKZU87 K_WNGKLGLSPKZU87_EL ND_GLSRS87 PO_ABBGLSHSZ87 TD_STOLGLS87 TD_STOLGLS87_EL /end DEF_CHARACTERISTIC
/end FUNCTION
/begin FUNCTION jSasKabAl_Fktn "Applikationesgroessen Instanz jSasKabAl"
 /begin DEF_CHARACTERISTIC KF_PKABFOLNACH64MRS43 KF_PKABFOLNACH64MRS43SP KF_PKABFOLNACH64MRS43SPORT KF_PKABFOLNACH64MRS43_EL KF_PKABFOLNACH84MRS43 KF_PKABFOLNACH84MRS43SP KF_PKABFOLNACH84MRS43SPORT KF_PKABFOLNACH84MRS43_EL KF_THKABMTCGESTART12 KF_TPKABMTCGESTART12 KL_TSYNMTKABVFOLNACH64MRS43 KL_TSYNMTKABVFOLNACH84MRS43 T_RAABVFOLNACH64MRS43 T_RAABVFOLNACH84MRS43 /end DEF_CHARACTERISTIC
/end FUNCTION
/begin FUNCTION jSasKabEHS12_Fktn "Applikationesgroessen Instanz jSasKabEHS12" /begin DEF_CHARACTERISTIC KL_POKABV12 KL_TSYNMTKABV12 T_RAABV12 /end DEF_CHARACTERISTIC /end FUNCTION
/begin FUNCTION jSasKabEHS23_Fktn "Applikationesgroessen Instanz jSasKabEHS23" /begin DEF_CHARACTERISTIC KL_POKABV23 KL_TSYNMTKABV23 T_RAABV23 /end DEF_CHARACTERISTIC /end FUNCTION
/begin FUNCTION jSasKabEHS34_Fktn "Applikationesgroessen Instanz jSasKabEHS34" /begin DEF_CHARACTERISTIC KL_POKABV34 KL_TSYNMTKABV34 T_RAABV34 /end DEF_CHARACTERISTIC /end FUNCTION
/begin FUNCTION jSasKabEHS45_Fktn "Applikationesgroessen Instanz jSasKabEHS45" /begin DEF_CHARACTERISTIC KL_POKABV45 KL_TSYNMTKABV45 T_RAABV45 /end DEF_CHARACTERISTIC /end FUNCTION
/begin FUNCTION jSasKabEHS56_Fktn "Applikationesgroessen Instanz jSasKabEHS56" /begin DEF_CHARACTERISTIC KL_POKABV56 KL_TSYNMTKABV56 T_RAABV56 /end DEF_CHARACTERISTIC /end FUNCTION
/begin FUNCTION jSasKabEHS67_Fktn "Applikationesgroessen Instanz jSasKabEHS67" /begin DEF_CHARACTERISTIC KL_POKABV67 KL_TSYNMTKABV67 T_RAABV67 /end DEF_CHARACTERISTIC /end FUNCTION
/begin FUNCTION jSasKabEHS78_Fktn "Applikationesgroessen Instanz jSasKabEHS78" /begin DEF_CHARACTERISTIC KL_POKABV78 KL_TSYNMTKABV78 T_RAABV78 /end DEF_CHARACTERISTIC /end FUNCTION
/begin FUNCTION jSasKabERS21_Fktn "Applikationesgroessen Instanz jSasKabERS21"
 /begin DEF_CHARACTERISTIC KF_PKABFOLNACHMRS21 KF_PKABFOLNACHMRS21_EL KF_PKABFOLNACHMRSSP21 KF_PKABFOLNACHMRSSPORT21 KF_PKABFOLNACHRS21 KF_PKABFOLNACHRS21_EL KF_PKABFOLNACHRSSP21 KF_PKABFOLNACHRSSPORT21 KL_PGOKABFOLNACHMRS21 KL_PGOKABFOLNACHRS21 KL_PGRASYNKABFOLNACHMRS21 KL_PGRASYNKABFOLNACHRS21 KL_POKABV21 KL_TSYNMTKABV21 KL_TSYNMTKABVFOLNACHMRS21 T_RAABV21 T_RAABVFOLNACHMRS21 /end DEF_CHARACTERISTIC
/end FUNCTION
/begin FUNCTION jSasKabERS32_Fktn "Applikationesgroessen Instanz jSasKabERS32"
 /begin DEF_CHARACTERISTIC KF_PKABFOLNACHMRS32 KF_PKABFOLNACHMRS32_EL KF_PKABFOLNACHMRSSP32 KF_PKABFOLNACHMRSSPORT32 KF_PKABFOLNACHRS32 KF_PKABFOLNACHRS32_EL KF_PKABFOLNACHRSSP32 KF_PKABFOLNACHRSSPORT32 KL_PGOKABFOLNACHMRS32 KL_PGOKABFOLNACHRS32 KL_PGRASYNKABFOLNACHMRS32 KL_PGRASYNKABFOLNACHRS32 KL_POKABV32 KL_TSYNMTKABV32 KL_TSYNMTKABVFOLNACHMRS32 T_RAABV32 T_RAABVFOLNACHMRS32 /end DEF_CHARACTERISTIC
/end FUNCTION
/begin FUNCTION jSasKabERS43_Fktn "Applikationesgroessen Instanz jSasKabERS43"
 /begin DEF_CHARACTERISTIC KF_PKABFOLNACHRS43 KF_PKABFOLNACHRS43_EL KF_PKABFOLNACHRSSP43 KF_PKABFOLNACHRSSPORT43 KL_PGOKABFOLNACHMRS43 KL_PGOKABFOLNACHRS43 KL_PGRASYNKABFOLNACHMRS43 KL_PGRASYNKABFOLNACHRS43 KL_POKABV43 KL_TSYNMTKABV43 T_RAABV43 /end DEF_CHARACTERISTIC
/end FUNCTION
/begin FUNCTION jSasKabERS54_Fktn "Applikationesgroessen Instanz jSasKabERS54"
 /begin DEF_CHARACTERISTIC KF_PKABFOLNACHMRS54 KF_PKABFOLNACHMRS54_EL KF_PKABFOLNACHMRSSP54 KF_PKABFOLNACHMRSSPORT54 KF_PKABFOLNACHRS54 KF_PKABFOLNACHRS54_EL KF_PKABFOLNACHRSSP54 KF_PKABFOLNACHRSSPORT54 KL_PGOKABFOLNACHMRS54 KL_PGOKABFOLNACHRS54 KL_PGRASYNKABFOLNACHMRS54 KL_PGRASYNKABFOLNACHRS54 KL_POKABV54 KL_TSYNMTKABV54 KL_TSYNMTKABVFOLNACHMRS54 T_RAABV54 T_RAABVFOLNACHMRS54 /end DEF_CHARACTERISTIC
/end FUNCTION
/begin FUNCTION jSasKabERS65_Fktn "Applikationesgroessen Instanz jSasKabERS65"
 /begin DEF_CHARACTERISTIC KF_PKABFOLNACHMRS65 KF_PKABFOLNACHMRS65_EL KF_PKABFOLNACHMRSSP65 KF_PKABFOLNACHMRSSPORT65 KF_PKABFOLNACHRS65 KF_PKABFOLNACHRS65_EL KF_PKABFOLNACHRSSP65 KF_PKABFOLNACHRSSPORT65 KL_PGOKABFOLNACHMRS65 KL_PGOKABFOLNACHRS65 KL_PGRASYNKABFOLNACHMRS65 KL_PGRASYNKABFOLNACHRS65 KL_POKABV65 KL_TSYNMTKABV65 KL_TSYNMTKABVFOLNACHMRS65 T_RAABV65 T_RAABVFOLNACHMRS65 /end DEF_CHARACTERISTIC
/end FUNCTION
/begin FUNCTION jSasKabERS76_Fktn "Applikationesgroessen Instanz jSasKabERS76"
 /begin DEF_CHARACTERISTIC KF_PKABFOLNACHMRS76 KF_PKABFOLNACHMRS76_EL KF_PKABFOLNACHMRSSP76 KF_PKABFOLNACHMRSSPORT76 KF_PKABFOLNACHRS76 KF_PKABFOLNACHRS76_EL KF_PKABFOLNACHRSSP76 KF_PKABFOLNACHRSSPORT76 KL_PGOKABFOLNACHMRS76 KL_PGOKABFOLNACHRS76 KL_PGRASYNKABFOLNACHMRS76 KL_PGRASYNKABFOLNACHRS76 KL_POKABV76 KL_TSYNMTKABV76 KL_TSYNMTKABVFOLNACHMRS76 T_RAABV76 T_RAABVFOLNACHMRS76 /end DEF_CHARACTERISTIC
/end FUNCTION
/begin FUNCTION jSasKabERS87_Fktn "Applikationesgroessen Instanz jSasKabERS87"
 /begin DEF_CHARACTERISTIC KF_PKABFOLNACHMRS87 KF_PKABFOLNACHMRS87_EL KF_PKABFOLNACHMRSSP87 KF_PKABFOLNACHMRSSPORT87 KF_PKABFOLNACHRS87 KF_PKABFOLNACHRS87_EL KF_PKABFOLNACHRSSP87 KF_PKABFOLNACHRSSPORT87 KL_PGOKABFOLNACHMRS87 KL_PGOKABFOLNACHRS87 KL_PGRASYNKABFOLNACHMRS87 KL_PGRASYNKABFOLNACHRS87 KL_POKABV87 KL_TSYNMTKABV87 KL_TSYNMTKABVFOLNACHMRS87 T_RAABV87 T_RAABVFOLNACHMRS87 /end DEF_CHARACTERISTIC
/end FUNCTION
/begin FUNCTION jSasKabGeG1_Fktn "Applikationesgroessen Instanz jSasKabGeG1"
 /begin DEF_CHARACTERISTIC KF_POGANDNMOTNTV2_1 KF_POGANDNMOTNT_1 KF_PRAGACGV2_1 KF_PRAGACG_1 KL_FCGPOGA_1 /end DEF_CHARACTERISTIC
/end FUNCTION
/begin FUNCTION jSasKabGeG2_Fktn "Applikationesgroessen Instanz jSasKabGeG2"
 /begin DEF_CHARACTERISTIC KF_POGANDNMOTNTV2_2 KF_POGANDNMOTNT_2 KF_PRAGACGV2_2 KF_PRAGACG_2 KL_FCGPOGA_2 /end DEF_CHARACTERISTIC
/end FUNCTION
/begin FUNCTION jSasKabGeG3_Fktn "Applikationesgroessen Instanz jSasKabGeG3"
 /begin DEF_CHARACTERISTIC KF_POGANDNMOTNTV2_3 KF_POGANDNMOTNT_3 KF_PRAGACGV2_3 KF_PRAGACG_3 KL_FCGPOGA_3 /end DEF_CHARACTERISTIC
/end FUNCTION
/begin FUNCTION jSasKabGeG4_Fktn "Applikationesgroessen Instanz jSasKabGeG4"
 /begin DEF_CHARACTERISTIC KF_POGANDNMOTNTV2_4 KF_POGANDNMOTNT_4 KF_PRAGACGV2_4 KF_PRAGACG_4 KL_FCGPOGA_4 /end DEF_CHARACTERISTIC
/end FUNCTION
/begin FUNCTION jSasKabGeG5_Fktn "Applikationesgroessen Instanz jSasKabGeG5"
 /begin DEF_CHARACTERISTIC KF_POGANDNMOTNTV2_5 KF_POGANDNMOTNT_5 KF_PRAGACGV2_5 KF_PRAGACG_5 KL_FCGPOGA_5 /end DEF_CHARACTERISTIC
/end FUNCTION
/begin FUNCTION jSasKabGeG6_Fktn "Applikationesgroessen Instanz jSasKabGeG6"
 /begin DEF_CHARACTERISTIC KF_POGANDNMOTNTV2_6 KF_POGANDNMOTNT_6 KF_PRAGACGV2_6 KF_PRAGACG_6 KL_FCGPOGA_6 /end DEF_CHARACTERISTIC
/end FUNCTION
/begin FUNCTION jSasKabGeG7_Fktn "Applikationesgroessen Instanz jSasKabGeG7"
 /begin DEF_CHARACTERISTIC KF_POGANDNMOTNTV2_7 KF_POGANDNMOTNT_7 KF_PRAGACGV2_7 KF_PRAGACG_7 KL_FCGPOGA_7 /end DEF_CHARACTERISTIC
/end FUNCTION
/begin FUNCTION jSasKabGeG8_Fktn "Applikationesgroessen Instanz jSasKabGeG8"
 /begin DEF_CHARACTERISTIC KF_POGANDNMOTNTV2_8 KF_POGANDNMOTNT_8 KF_PRAGACGV2_8 KF_PRAGACG_8 KL_FCGPOGA_8 /end DEF_CHARACTERISTIC
/end FUNCTION
/begin FUNCTION jSasKabGeGR_Fktn "Applikationesgroessen Instanz jSasKabGeGR"
 /begin DEF_CHARACTERISTIC KF_POGANDNMOTNTV2_R KF_POGANDNMOTNT_R KF_PRAGACGV2_R KF_PRAGACG_R KL_FCGPOGA_R /end DEF_CHARACTERISTIC
/end FUNCTION
/begin FUNCTION jSasKabHSP112_Fktn "Applikationesgroessen Instanz jSasKabHSP112"
 /begin DEF_CHARACTERISTIC KF_THKABMTCG12 KF_THKABMTCG12_EL KF_TPKABMTCG12 KF_TPKABMTCG12_EL KL_PHKABMT12 KL_PHKABMT12_EL KL_POKABCG12 KL_TOPKABND12 KL_TOPKABND12_EL T_VKABHS12 /end DEF_CHARACTERISTIC
/end FUNCTION
/begin FUNCTION jSasKabHSP123_Fktn "Applikationesgroessen Instanz jSasKabHSP123"
 /begin DEF_CHARACTERISTIC KF_THKABMTCG23 KF_THKABMTCG23_EL KF_TPKABMTCG23 KF_TPKABMTCG23_EL KL_PHKABMT23 KL_PHKABMT23_EL KL_POKABCG23 KL_TOPKABND23 KL_TOPKABND23_EL T_VKABHS23 /end DEF_CHARACTERISTIC
/end FUNCTION
/begin FUNCTION jSasKabHSP134_Fktn "Applikationesgroessen Instanz jSasKabHSP134"
 /begin DEF_CHARACTERISTIC KF_THKABMTCG34 KF_THKABMTCG34_EL KF_TPKABMTCG34 KF_TPKABMTCG34_EL KL_PHKABMT34 KL_PHKABMT34_EL KL_POKABCG34 KL_TOPKABND34 KL_TOPKABND34_EL T_VKABHS34 /end DEF_CHARACTERISTIC
/end FUNCTION
/begin FUNCTION jSasKabHSP145_Fktn "Applikationesgroessen Instanz jSasKabHSP145"
 /begin DEF_CHARACTERISTIC KF_THKABMTCG45 KF_THKABMTCG45_EL KF_TPKABMTCG45 KF_TPKABMTCG45_EL KL_PHKABMT45 KL_PHKABMT45_EL KL_POKABCG45 KL_TOPKABND45 KL_TOPKABND45_EL T_VKABHS45 /end DEF_CHARACTERISTIC
/end FUNCTION
/begin FUNCTION jSasKabHSP156_Fktn "Applikationesgroessen Instanz jSasKabHSP156"
 /begin DEF_CHARACTERISTIC KF_THKABMTCG56 KF_THKABMTCG56_EL KF_TPKABMTCG56 KF_TPKABMTCG56_EL KL_PHKABMT56 KL_PHKABMT56_EL KL_POKABCG56 KL_TOPKABND56 KL_TOPKABND56_EL T_VKABHS56 /end DEF_CHARACTERISTIC
/end FUNCTION
/begin FUNCTION jSasKabHSP167_Fktn "Applikationesgroessen Instanz jSasKabHSP167"
 /begin DEF_CHARACTERISTIC KF_THKABMTCG67 KF_THKABMTCG67_EL KF_TPKABMTCG67 KF_TPKABMTCG67_EL KL_PHKABMT67 KL_PHKABMT67_EL KL_POKABCG67 KL_TOPKABND67 KL_TOPKABND67_EL T_VKABHS67 /end DEF_CHARACTERISTIC
/end FUNCTION
/begin FUNCTION jSasKabHSP178_Fktn "Applikationesgroessen Instanz jSasKabHSP178"
 /begin DEF_CHARACTERISTIC KF_THKABMTCG78 KF_THKABMTCG78_EL KF_TPKABMTCG78 KF_TPKABMTCG78_EL KL_PHKABMT78 KL_PHKABMT78_EL KL_POKABCG78 KL_TOPKABND78 KL_TOPKABND78_EL T_VKABHS78 /end DEF_CHARACTERISTIC
/end FUNCTION
/begin FUNCTION jSasKabHSP212_Fktn "Applikationesgroessen Instanz jSasKabHSP212"
 /begin DEF_CHARACTERISTIC KF_THKABMTCGSP12 KF_TPKABMTCGSP12 KL_PHKABMTSP12 KL_POKABCGSP12 KL_TOPKABNDSP12 T_VKABHSSP12 /end DEF_CHARACTERISTIC
/end FUNCTION
/begin FUNCTION jSasKabHSP223_Fktn "Applikationesgroessen Instanz jSasKabHSP223"
 /begin DEF_CHARACTERISTIC KF_THKABMTCGSP23 KF_TPKABMTCGSP23 KL_PHKABMTSP23 KL_POKABCGSP23 KL_TOPKABNDSP23 T_VKABHSSP23 /end DEF_CHARACTERISTIC
/end FUNCTION
/begin FUNCTION jSasKabHSP234_Fktn "Applikationesgroessen Instanz jSasKabHSP234"
 /begin DEF_CHARACTERISTIC KF_THKABMTCGSP34 KF_TPKABMTCGSP34 KL_PHKABMTSP34 KL_POKABCGSP34 KL_TOPKABNDSP34 T_VKABHSSP34 /end DEF_CHARACTERISTIC
/end FUNCTION
/begin FUNCTION jSasKabHSP245_Fktn "Applikationesgroessen Instanz jSasKabHSP245"
 /begin DEF_CHARACTERISTIC KF_THKABMTCGSP45 KF_TPKABMTCGSP45 KL_PHKABMTSP45 KL_POKABCGSP45 KL_TOPKABNDSP45 T_VKABHSSP45 /end DEF_CHARACTERISTIC
/end FUNCTION
/begin FUNCTION jSasKabHSP256_Fktn "Applikationesgroessen Instanz jSasKabHSP256"
 /begin DEF_CHARACTERISTIC KF_THKABMTCGSP56 KF_TPKABMTCGSP56 KL_PHKABMTSP56 KL_POKABCGSP56 KL_TOPKABNDSP56 T_VKABHSSP56 /end DEF_CHARACTERISTIC
/end FUNCTION
/begin FUNCTION jSasKabHSP267_Fktn "Applikationesgroessen Instanz jSasKabHSP267"
 /begin DEF_CHARACTERISTIC KF_THKABMTCGSP67 KF_TPKABMTCGSP67 KL_PHKABMTSP67 KL_POKABCGSP67 KL_TOPKABNDSP67 T_VKABHSSP67 /end DEF_CHARACTERISTIC
/end FUNCTION
/begin FUNCTION jSasKabHSP278_Fktn "Applikationesgroessen Instanz jSasKabHSP278"
 /begin DEF_CHARACTERISTIC KF_THKABMTCGSP78 KF_TPKABMTCGSP78 KL_PHKABMTSP78 KL_POKABCGSP78 KL_TOPKABNDSP78 T_VKABHSSP78 /end DEF_CHARACTERISTIC
/end FUNCTION
/begin RECORD_LAYOUT ZF_kf_si16_S5_S3 FNC_VALUES 5 SWORD ROW_DIR DIRECT AXIS_PTS_X 3 SWORD INDEX_INCR DIRECT AXIS_PTS_Y 4 SWORD INDEX_INCR DIRECT NO_AXIS_PTS_X 1 ULONG NO_AXIS_PTS_Y 2 ULONG /end RECORD_LAYOUT
/begin RECORD_LAYOUT ZF_kf_ui8_S5_S3 FNC_VALUES 5 UBYTE ROW_DIR DIRECT AXIS_PTS_X 3 UBYTE INDEX_INCR DIRECT AXIS_PTS_Y 4 UBYTE INDEX_INCR DIRECT NO_AXIS_PTS_X 1 ULONG NO_AXIS_PTS_Y 2 ULONG /end RECORD_LAYOUT
/begin RECORD_LAYOUT ZF_kl_si16_S5_S3 FNC_VALUES 3 SWORD COLUMN_DIR DIRECT AXIS_PTS_X 2 SWORD INDEX_INCR DIRECT NO_AXIS_PTS_X 1 ULONG /end RECORD_LAYOUT
/begin RECORD_LAYOUT ZF_kl_ui8_S5_S3 FNC_VALUES 3 UBYTE COLUMN_DIR DIRECT AXIS_PTS_X 2 UBYTE INDEX_INCR DIRECT NO_AXIS_PTS_X 1 ULONG /end RECORD_LAYOUT
/begin RECORD_LAYOUT ZF_kw_si16_S5_S3 FNC_VALUES 1 SWORD COLUMN_DIR DIRECT /end RECORD_LAYOUT
/begin RECORD_LAYOUT ZF_kw_ui16_S5_S3 FNC_VALUES 1 UWORD COLUMN_DIR DIRECT /end RECORD_LAYOUT
/begin RECORD_LAYOUT ZF_kw_ui8_S5_S3 FNC_VALUES 1 UBYTE COLUMN_DIR DIRECT /end RECORD_LAYOUT
/end MODULE
/end PROJECT
