ASAP2_VERSION 1 51
/begin PROJECT ZHBC8600 "Gen2_BMW_System_Supplier_Lib"
/begin MODULE CPP ""
/begin MOD_COMMON "" BYTE_ORDER MSB_FIRST ALIGNMENT_BYTE 1 ALIGNMENT_WORD 2 ALIGNMENT_LONG 4 ALIGNMENT_FLOAT32_IEEE 4 ALIGNMENT_FLOAT64_IEEE 1 /end MOD_COMMON
/begin COMPU_VTAB _CNV_S_2_Enum_EAGS_18_S2 "" TAB_VERB 2 0 "A_AGS" 1 "S_AGS" DEFAULT_VALUE "" /end COMPU_VTAB
/begin COMPU_VTAB _CNV_S_2_Enum_EBABA_46_S2 "" TAB_VERB 2 0 "W_STEIGUNG_FILT" 1 "W_STEIGUNG_FILT_SLOW" DEFAULT_VALUE "" /end COMPU_VTAB
/begin COMPU_VTAB _CNV_S_2_Enum_EHEIS_125_S2 "" TAB_VERB 2 0 "Kennfeld" 1 "Druck_oder_Temperatur" DEFAULT_VALUE "" /end COMPU_VTAB
/begin COMPU_VTAB _CNV_S_3_Enum_EANH_51_S2 "" TAB_VERB 3 0 "KEIN_ANHAENGER" 1 "ANHAENGER" 2 "ANHAENGER_ODER_KEIN_ANHAENGER" DEFAULT_VALUE "" /end COMPU_VTAB
/begin COMPU_VTAB _CNV_S_3_Enum_ECODA_232_S2 "" TAB_VERB 3 0 "SIGNAL_UEBERNAHME" 1 "COD_ALLRAD" 2 "COD_KEIN_ALLRAD" DEFAULT_VALUE "" /end COMPU_VTAB
/begin COMPU_VTAB _CNV_S_3_Enum_ECODG_233_S2 "" TAB_VERB 3 0 "SIGNAL_UEBERNAHME" 1 "COD_SPORTSCHALTER" 2 "COD_KEIN_SPORTSCHALTER" DEFAULT_VALUE "" /end COMPU_VTAB
/begin COMPU_VTAB _CNV_S_3_Enum_ECODM_234_S2 "" TAB_VERB 3 0 "SIGNAL_UEBERNAHME" 1 "COD_MAB_0" 2 "COD_MAB_1" DEFAULT_VALUE "" /end COMPU_VTAB
/begin COMPU_VTAB _CNV_S_3_Enum_ECODS_235_S2 "" TAB_VERB 3 0 "SIGNAL_UEBERNAHME" 1 "COD_STOPGO_0" 2 "COD_STOPGO_1" DEFAULT_VALUE "" /end COMPU_VTAB
/begin COMPU_VTAB _CNV_S_3_Enum_EDMRA_243_S2 "" TAB_VERB 3 0 "DM_AB_FWS_FILT" 1 "DM_AB_FWSKOR_FILTFAST" 2 "DM_AB_FWSKOR_FILTSLOW" DEFAULT_VALUE "" /end COMPU_VTAB
/begin COMPU_VTAB _CNV_S_3_Enum_EDRIV_237_S2 "" TAB_VERB 3 0 "SIGNAL_AUS" 1 "DRIVEDYNAMICS" 2 "DRIVELOGIC" DEFAULT_VALUE "" /end COMPU_VTAB
/begin COMPU_VTAB _CNV_S_3_Enum_EDSCM_39_S2 "" TAB_VERB 3 0 "DSC_NOT_USED" 1 "BEI_DSC_PASSIV" 2 "BEI_DTC_ODER_DSC_PASSIVE" DEFAULT_VALUE "" /end COMPU_VTAB
/begin COMPU_VTAB _CNV_S_3_Enum_EHKOR_203_S2 "" TAB_VERB 3 0 "KEINE" 1 "HKOR_NORM" 2 "HKOR_KF" DEFAULT_VALUE "" /end COMPU_VTAB
/begin COMPU_VTAB _CNV_S_3_Enum_EMOT__181_S2 "" TAB_VERB 3 0 "MOT_SCHUB_IDX1" 1 "MOT_SCHUB_IDX2" 2 "MOT_SCHUB_IDX3" DEFAULT_VALUE "" /end COMPU_VTAB
/begin COMPU_VTAB _CNV_S_3_Enum_EPMA_83_S2 "" TAB_VERB 3 0 "KEINE_PMA_VORGABE" 1 "PMA_GANG_1" 2 "PMA_GANG_2" DEFAULT_VALUE "" /end COMPU_VTAB
/begin COMPU_VTAB _CNV_S_3_Enum_EQSHI_177_S2 "" TAB_VERB 3 0 "QS0_MODAFB" 1 "QS1_MODAFB" 2 "KEINE_BEEINFLUSSUNG" DEFAULT_VALUE "" /end COMPU_VTAB
/begin COMPU_VTAB _CNV_S_3_Enum_ESIGN_69_S2 "" TAB_VERB 3 0 "SIGNAL_AUS" 1 "SIGNAL_EIN" 2 "SIGNAL_UEBERNAHME" DEFAULT_VALUE "" /end COMPU_VTAB
/begin COMPU_VTAB _CNV_S_3_Enum_ESKLK_98_S2 "" TAB_VERB 3 0 "MAX_SCHWELLE" 1 "MAX_ENTFAELLT" 2 "MAX_HSEARLIERLATER" DEFAULT_VALUE "" /end COMPU_VTAB
/begin COMPU_VTAB _CNV_S_4_Enum_EDSCA_52_S2 "" TAB_VERB 4 0 "DSC_STAT_ALLE" 1 "DSC_PASSIV" 2 "DTC_ACTIV" 3 "DTC_ACTIV_ODER_DSC_PASSIV" DEFAULT_VALUE "" /end COMPU_VTAB
/begin COMPU_VTAB _CNV_S_4_Enum_EDSCB_49_S2 "" TAB_VERB 4 0 "ALLE_DSC_STAT" 1 "NUR_DSC_ACTIVE" 2 "DSC_ACTIVE_ODER_DTC_ACTIVE" 3 "DTC_ACTIVE_ODER_DSC_PASSIVE" DEFAULT_VALUE "" /end COMPU_VTAB
/begin COMPU_VTAB _CNV_S_4_Enum_ESIGN_68_S2 "" TAB_VERB 4 0 "SIGNAL_AUS" 1 "SIGNAL_EIN" 2 "SIGNAL_UEBERNAHME" 3 "SIGNAL_PLAUSI" DEFAULT_VALUE "" /end COMPU_VTAB
/begin COMPU_VTAB _CNV_S_5_Enum_ECODV_236_S2 "" TAB_VERB 5 0 "SIGNAL_UEBERNAHME" 1 "COD_VMAX_IDX0" 2 "COD_VMAX_IDX1" 3 "COD_VMAX_IDX2" 4 "COD_VMAX_IDX3" DEFAULT_VALUE "" /end COMPU_VTAB
/begin COMPU_VTAB _CNV_S_5_Enum_EMOT__180_S2 "" TAB_VERB 5 0 "MOT_IDX1" 1 "MOT_IDX2" 2 "MOT_IDX3" 3 "MOT_IDX4" 4 "MOT_IDX5" DEFAULT_VALUE "" /end COMPU_VTAB
/begin COMPU_VTAB _CNV_S_5_Enum_EMOTS_226_S2 "" TAB_VERB 5 0 "KEIN_MOTSTART" 1 "START_SGR" 2 "START_EM" 3 "START_SGR_EM" 4 "START_RS" DEFAULT_VALUE "" /end COMPU_VTAB
/begin COMPU_VTAB _CNV_S_9_Enum_EGANG_21_S2 "" TAB_VERB 9 0 "GANG_1" 1 "GANG_2" 2 "GANG_3" 3 "GANG_4" 4 "GANG_5" 5 "GANG_6" 6 "GANG_7" 7 "GANG_8" 8 "GANG_9" DEFAULT_VALUE "" /end COMPU_VTAB
/begin COMPU_VTAB _CNV_S_9_Enum_EMAPD_212_S2 "" TAB_VERB 9 0 "LMODE_DL" 1 "FDC_DL" 2 "FDS_BASIS" 3 "FDS_KOMFORT" 4 "FDS_TRAKTION" 5 "FDS_SPORT" 6 "FDS_SPORT_PLUS" 7 "FDS_RACE" 8 "FDS_ECO" DEFAULT_VALUE "" /end COMPU_VTAB
/begin COMPU_VTAB _CNV_S_9_Enum_EMAPD_213_S2 "" TAB_VERB 9 0 "LMODE_DL_Simulate" 1 "FDC_DL_Simulate" 2 "FDS_BASIS_Simulate" 3 "FDS_KOMFORT_Simulate" 4 "FDS_TRAKTION_Simulate" 5 "FDS_SPORT_Simulate" 6 "FDS_SPORT_PLUS_Simulate" 7 "FDS_RACE_Simulate" 8 "FDS_ECO_Simulate" DEFAULT_VALUE "" /end COMPU_VTAB
/begin COMPU_METHOD _CNV_R_R_Umr_1000_z_12_CM_S2 "" RAT_FUNC "%6.3" "s" COEFFS 0 1000 0 0 0 1 /end COMPU_METHOD
/begin COMPU_METHOD _CNV_R_R_Umr_100_zu_42_CM_S2 "" RAT_FUNC "%6.3" "" COEFFS 0 100 0 0 0 1 /end COMPU_METHOD
/begin COMPU_METHOD _CNV_R_R_Umr_10_zu__117_CM_S2 "" RAT_FUNC "%6.3" "s" COEFFS 0 10 0 0 0 1 /end COMPU_METHOD
/begin COMPU_METHOD _CNV_R_R_Umr_10_zu__9_CM_S2 "" RAT_FUNC "%6.3" "%" COEFFS 0 10 0 0 0 1 /end COMPU_METHOD
/begin COMPU_METHOD _CNV_R_R_Umr_1_zu_1_124_CM_S2 "" RAT_FUNC "%6.3" "s" COEFFS 0 1 0 0 0 1 /end COMPU_METHOD
/begin COMPU_METHOD _CNV_R_R_Umr_1_zu_1_1_CM_S2 "" RAT_FUNC "%6.3" "°C" COEFFS 0 1 0 0 0 1 /end COMPU_METHOD
/begin COMPU_METHOD _CNV_R_R_Umr_1_zu_1_2_CM_S2 "" RAT_FUNC "%6.3" "" COEFFS 0 1 0 0 0 1 /end COMPU_METHOD
/begin COMPU_METHOD _CNV_R_R_Umr_1_zu_1_30_CM_S2 "" RAT_FUNC "%6.3" "%" COEFFS 0 1 0 0 0 1 /end COMPU_METHOD
/begin COMPU_METHOD _CNV_R_R_Umr_1_zu_1_3_CM_S2 "" RAT_FUNC "%6.3" "U/min" COEFFS 0 1 0 0 0 1 /end COMPU_METHOD
/begin COMPU_METHOD _CNV_R_R_Umr_1_zu_1_67_CM_S2 "" RAT_FUNC "%6.3" "ms" COEFFS 0 0.1 0 0 0 1 /end COMPU_METHOD
/begin COMPU_METHOD _CNV_R_R_Umr_1_zu_1_6_CM_S2 "" RAT_FUNC "%6.3" "ms" COEFFS 0 1 0 0 0 1 /end COMPU_METHOD
/begin COMPU_METHOD _CNV_R_R_Umr_1_zu_1_8_CM_S2 "" RAT_FUNC "%6.3" "km/h" COEFFS 0 1 0 0 0 1 /end COMPU_METHOD
/begin COMPU_METHOD _CNV_R_R_Umr_1_zu_2_132_CM_S2 "" RAT_FUNC "%6.3" "" COEFFS 0 0.05 0 0 0 1 /end COMPU_METHOD
/begin COMPU_METHOD _CNV_R_R_Umr_1_zu_2_135_CM_S2 "" RAT_FUNC "%6.3" "ms" COEFFS 0 0.05 0 0 0 1 /end COMPU_METHOD
/begin COMPU_METHOD _CNV_S_2_Enum_EAGS_18_CM_S2 "" TAB_VERB "%6.3" "" COMPU_TAB_REF _CNV_S_2_Enum_EAGS_18_S2 /end COMPU_METHOD
/begin COMPU_METHOD _CNV_S_2_Enum_EBABA_46_CM_S2 "" TAB_VERB "%6.3" "" COMPU_TAB_REF _CNV_S_2_Enum_EBABA_46_S2 /end COMPU_METHOD
/begin COMPU_METHOD _CNV_S_2_Enum_EHEIS_125_CM_S2 "" TAB_VERB "%6.3" "" COMPU_TAB_REF _CNV_S_2_Enum_EHEIS_125_S2 /end COMPU_METHOD
/begin COMPU_METHOD _CNV_S_3_Enum_EANH_51_CM_S2 "" TAB_VERB "%6.3" "" COMPU_TAB_REF _CNV_S_3_Enum_EANH_51_S2 /end COMPU_METHOD
/begin COMPU_METHOD _CNV_S_3_Enum_ECODA_232_CM_S2 "" TAB_VERB "%6.3" "" COMPU_TAB_REF _CNV_S_3_Enum_ECODA_232_S2 /end COMPU_METHOD
/begin COMPU_METHOD _CNV_S_3_Enum_ECODG_233_CM_S2 "" TAB_VERB "%6.3" "" COMPU_TAB_REF _CNV_S_3_Enum_ECODG_233_S2 /end COMPU_METHOD
/begin COMPU_METHOD _CNV_S_3_Enum_ECODM_234_CM_S2 "" TAB_VERB "%6.3" "" COMPU_TAB_REF _CNV_S_3_Enum_ECODM_234_S2 /end COMPU_METHOD
/begin COMPU_METHOD _CNV_S_3_Enum_ECODS_235_CM_S2 "" TAB_VERB "%6.3" "" COMPU_TAB_REF _CNV_S_3_Enum_ECODS_235_S2 /end COMPU_METHOD
/begin COMPU_METHOD _CNV_S_3_Enum_EDMRA_243_CM_S2 "" TAB_VERB "%6.3" "" COMPU_TAB_REF _CNV_S_3_Enum_EDMRA_243_S2 /end COMPU_METHOD
/begin COMPU_METHOD _CNV_S_3_Enum_EDRIV_237_CM_S2 "" TAB_VERB "%6.3" "" COMPU_TAB_REF _CNV_S_3_Enum_EDRIV_237_S2 /end COMPU_METHOD
/begin COMPU_METHOD _CNV_S_3_Enum_EDSCM_39_CM_S2 "" TAB_VERB "%6.3" "" COMPU_TAB_REF _CNV_S_3_Enum_EDSCM_39_S2 /end COMPU_METHOD
/begin COMPU_METHOD _CNV_S_3_Enum_EHKOR_203_CM_S2 "" TAB_VERB "%6.3" "" COMPU_TAB_REF _CNV_S_3_Enum_EHKOR_203_S2 /end COMPU_METHOD
/begin COMPU_METHOD _CNV_S_3_Enum_EMOT__181_CM_S2 "" TAB_VERB "%6.3" "" COMPU_TAB_REF _CNV_S_3_Enum_EMOT__181_S2 /end COMPU_METHOD
/begin COMPU_METHOD _CNV_S_3_Enum_EPMA_83_CM_S2 "" TAB_VERB "%6.3" "" COMPU_TAB_REF _CNV_S_3_Enum_EPMA_83_S2 /end COMPU_METHOD
/begin COMPU_METHOD _CNV_S_3_Enum_EQSHI_177_CM_S2 "" TAB_VERB "%6.3" "" COMPU_TAB_REF _CNV_S_3_Enum_EQSHI_177_S2 /end COMPU_METHOD
/begin COMPU_METHOD _CNV_S_3_Enum_ESIGN_69_CM_S2 "" TAB_VERB "%6.3" "" COMPU_TAB_REF _CNV_S_3_Enum_ESIGN_69_S2 /end COMPU_METHOD
/begin COMPU_METHOD _CNV_S_3_Enum_ESKLK_98_CM_S2 "" TAB_VERB "%6.3" "" COMPU_TAB_REF _CNV_S_3_Enum_ESKLK_98_S2 /end COMPU_METHOD
/begin COMPU_METHOD _CNV_S_4_Enum_EDSCA_52_CM_S2 "" TAB_VERB "%6.3" "" COMPU_TAB_REF _CNV_S_4_Enum_EDSCA_52_S2 /end COMPU_METHOD
/begin COMPU_METHOD _CNV_S_4_Enum_EDSCB_49_CM_S2 "" TAB_VERB "%6.3" "" COMPU_TAB_REF _CNV_S_4_Enum_EDSCB_49_S2 /end COMPU_METHOD
/begin COMPU_METHOD _CNV_S_4_Enum_ESIGN_68_CM_S2 "" TAB_VERB "%6.3" "" COMPU_TAB_REF _CNV_S_4_Enum_ESIGN_68_S2 /end COMPU_METHOD
/begin COMPU_METHOD _CNV_S_5_Enum_ECODV_236_CM_S2 "" TAB_VERB "%6.3" "" COMPU_TAB_REF _CNV_S_5_Enum_ECODV_236_S2 /end COMPU_METHOD
/begin COMPU_METHOD _CNV_S_5_Enum_EMOT__180_CM_S2 "" TAB_VERB "%6.3" "" COMPU_TAB_REF _CNV_S_5_Enum_EMOT__180_S2 /end COMPU_METHOD
/begin COMPU_METHOD _CNV_S_5_Enum_EMOTS_226_CM_S2 "" TAB_VERB "%6.3" "" COMPU_TAB_REF _CNV_S_5_Enum_EMOTS_226_S2 /end COMPU_METHOD
/begin COMPU_METHOD _CNV_S_9_Enum_EGANG_21_CM_S2 "" TAB_VERB "%6.3" "" COMPU_TAB_REF _CNV_S_9_Enum_EGANG_21_S2 /end COMPU_METHOD
/begin COMPU_METHOD _CNV_S_9_Enum_EMAPD_212_CM_S2 "" TAB_VERB "%6.3" "" COMPU_TAB_REF _CNV_S_9_Enum_EMAPD_212_S2 /end COMPU_METHOD
/begin COMPU_METHOD _CNV_S_9_Enum_EMAPD_213_CM_S2 "" TAB_VERB "%6.3" "" COMPU_TAB_REF _CNV_S_9_Enum_EMAPD_213_S2 /end COMPU_METHOD
/begin COMPU_METHOD EH_STANDARD_S4_S3 "int = ((phys * 1) / 1) - (0) -" RAT_FUNC "%1.0" "-" COEFFS 0 1 0 0 0 1 /end COMPU_METHOD
/begin COMPU_METHOD SAB_GRAD4_M124_S2_S3 "int = ((phys * 4) / 1) - (-124) Grad" RAT_FUNC "%4.3" "Grad" COEFFS 0 4 124 0 0 1 /end COMPU_METHOD
/begin COMPU_METHOD SAB_HOUR_S2_S3 "int = ((phys * 1) / 1) - (0) hour" RAT_FUNC "%1.0" "hour" COEFFS 0 1 0 0 0 1 /end COMPU_METHOD
/begin COMPU_METHOD SAB_I_100MA_S2_S3 "int = ((phys * 1) / 100) - (0) mA" RAT_FUNC "%4.3" "mA" COEFFS 0 0.01 0 0 0 1 /end COMPU_METHOD
/begin COMPU_METHOD SAB_I_10MA_M10000_S2_S3 "int = ((phys * 1) / 10) - (-10000) mA" RAT_FUNC "%4.3" "mA" COEFFS 0 0.1 10000 0 0 1 /end COMPU_METHOD
/begin COMPU_METHOD SAB_I_10MA_S2_S3 "int = ((phys * 1) / 10) - (0) mA" RAT_FUNC "%4.3" "mA" COEFFS 0 0.1 0 0 0 1 /end COMPU_METHOD
/begin COMPU_METHOD SAB_I_1A_S2_S3 "int = ((phys * 1) / 1) - (0) A" RAT_FUNC "%1.0" "A" COEFFS 0 1 0 0 0 1 /end COMPU_METHOD
/begin COMPU_METHOD SAB_I_I10000_S2_S3 "int = ((phys * 10000) / 1) - (0) none" RAT_FUNC "%6.5" "none" COEFFS 0 10000 0 0 0 1 /end COMPU_METHOD
/begin COMPU_METHOD SAB_INC_M2000_S2_S3 "int = ((phys * 1) / 1) - (-2000) -" RAT_FUNC "%1.0" "-" COEFFS 0 1 2000 0 0 1 /end COMPU_METHOD
/begin COMPU_METHOD SAB_K100_KOMP_S2_S3 "int = ((phys * 100) / 1) - (0) -" RAT_FUNC "%4.3" "-" COEFFS 0 100 0 0 0 1 /end COMPU_METHOD
/begin COMPU_METHOD SAB_K1024_S2_S3 "int = ((phys * 1024) / 1) - (0) -" RAT_FUNC "%6.5" "-" COEFFS 0 1024 0 0 0 1 /end COMPU_METHOD
/begin COMPU_METHOD SAB_K128_S2_S3 "int = ((phys * 128) / 1) - (0) -" RAT_FUNC "%4.3" "-" COEFFS 0 128 0 0 0 1 /end COMPU_METHOD
/begin COMPU_METHOD SAB_K1_M2000_S2_S3 "int = ((phys * 1) / 1) - (2000) year" RAT_FUNC "%1.0" "year" COEFFS 0 1 -2000 0 0 1 /end COMPU_METHOD
/begin COMPU_METHOD SAB_K250_S2_S3 "int = ((phys * 250) / 1) - (0) none" RAT_FUNC "%4.3" "none" COEFFS 0 250 0 0 0 1 /end COMPU_METHOD
/begin COMPU_METHOD SAB_K8_S2_S3 "int = ((phys * 8) / 1) - (0) -" RAT_FUNC "%4.3" "-" COEFFS 0 8 0 0 0 1 /end COMPU_METHOD
/begin COMPU_METHOD SAB_K_M128_S2_S3 "int = ((phys * 1) / 1) - (-128) (none)" RAT_FUNC "%1.0" "(none)" COEFFS 0 1 128 0 0 1 /end COMPU_METHOD
/begin COMPU_METHOD SAB_KG_100KG_S2_S3 "int = ((phys * 1) / 100) - (0) kg" RAT_FUNC "%4.3" "kg" COEFFS 0 0.01 0 0 0 1 /end COMPU_METHOD
/begin COMPU_METHOD SAB_KG_32KG_S2_S3 "int = ((phys * 1) / 32) - (0) kg" RAT_FUNC "%4.3" "kg" COEFFS 0 0.03125 0 0 0 1 /end COMPU_METHOD
/begin COMPU_METHOD SAB_KM_10_S2_S3 "int = ((phys * 1) / 10) - (0) km" RAT_FUNC "%4.3" "km" COEFFS 0 0.1 0 0 0 1 /end COMPU_METHOD
/begin COMPU_METHOD SAB_L_10M_S2_S3 "int = ((phys * 1) / 10) - (0) m" RAT_FUNC "%4.3" "m" COEFFS 0 0.1 0 0 0 1 /end COMPU_METHOD
/begin COMPU_METHOD SAB_L_KM100_S2_S3 "int = ((phys * 100) / 1) - (0) km" RAT_FUNC "%4.3" "km" COEFFS 0 100 0 0 0 1 /end COMPU_METHOD
/begin COMPU_METHOD SAB_L_KM1_S2_S3 "int = ((phys * 10) / 1) - (0) km" RAT_FUNC "%4.3" "km" COEFFS 0 10 0 0 0 1 /end COMPU_METHOD
/begin COMPU_METHOD SAB_L_KM8_S2_S3 "int = ((phys * 8) / 1) - (0) km" RAT_FUNC "%4.3" "km" COEFFS 0 8 0 0 0 1 /end COMPU_METHOD
/begin COMPU_METHOD SAB_L_M128_S2_S3 "int = ((phys * 128) / 1) - (0) m" RAT_FUNC "%4.3" "m" COEFFS 0 128 0 0 0 1 /end COMPU_METHOD
/begin COMPU_METHOD SAB_L_M512_S2_S3 "int = ((phys * 512) / 1) - (0) km" RAT_FUNC "%4.3" "km" COEFFS 0 512 0 0 0 1 /end COMPU_METHOD
/begin COMPU_METHOD SAB_L_M6554_S2_S3 "int = ((phys * 6554) / 1) - (0) m" RAT_FUNC "%7.6" "m" COEFFS 0 6554 0 0 0 1 /end COMPU_METHOD
/begin COMPU_METHOD SAB_L_MHENRY10_S2_S3 "int = ((phys * 10) / 1) - (0) Henry" RAT_FUNC "%4.3" "Henry" COEFFS 0 10 0 0 0 1 /end COMPU_METHOD
/begin COMPU_METHOD SAB_L_MM100_S2_S3 "int = ((phys * 100) / 1) - (0) mm" RAT_FUNC "%4.3" "mm" COEFFS 0 100 0 0 0 1 /end COMPU_METHOD
/begin COMPU_METHOD SAB_L_MM10_S2_S3 "int = ((phys * 10) / 1) - (0) mm" RAT_FUNC "%4.3" "mm" COEFFS 0 10 0 0 0 1 /end COMPU_METHOD
/begin COMPU_METHOD SAB_L_MM1_M127_S2_S3 "int = ((phys * 1) / 1) - (-127) mm" RAT_FUNC "%1.0" "mm" COEFFS 0 1 127 0 0 1 /end COMPU_METHOD
/begin COMPU_METHOD SAB_L_MM_S2_S3 "int = ((phys * 1) / 1) - (0) mm" RAT_FUNC "%1.0" "mm" COEFFS 0 1 0 0 0 1 /end COMPU_METHOD
/begin COMPU_METHOD SAB_M10_S2_S3 "int = ((phys * 10) / 1) - (0) -" RAT_FUNC "%4.3" "-" COEFFS 0 10 0 0 0 1 /end COMPU_METHOD
/begin COMPU_METHOD SAB_M125_S2_S3 "int = ((phys * 1) / 1) - (-125) -" RAT_FUNC "%1.0" "-" COEFFS 0 1 125 0 0 1 /end COMPU_METHOD
/begin CHARACTERISTIC XTAB9X9T_GRADIENT_DYNDZM_1 "" MAP 0x1D939D _REC_A1MAP_9_u1_u1_u1_S2 5100 _CNV_R_R_Umr_1_zu_2_132_CM_S2 0 5100
 /begin AXIS_DESCR FIX_AXIS Z_GANG_ZIEL_DYNDZM _CNV_S_9_Enum_EGANG_21_CM_S2 9 0 8 READ_ONLY FIX_AXIS_PAR_DIST 0 1 9 /end AXIS_DESCR
 /begin AXIS_DESCR FIX_AXIS Z_GANG_IST _CNV_S_9_Enum_EGANG_21_CM_S2 9 0 8 READ_ONLY FIX_AXIS_PAR_DIST 0 1 9 /end AXIS_DESCR
/end CHARACTERISTIC
/begin CHARACTERISTIC XTAB9X9T_GRADIENT_DYNDZM_2 "" MAP 0x1D93EE _REC_A1MAP_9_u1_u1_u1_S2 5100 _CNV_R_R_Umr_1_zu_2_132_CM_S2 0 5100
 /begin AXIS_DESCR FIX_AXIS Z_GANG_ZIEL_DYNDZM _CNV_S_9_Enum_EGANG_21_CM_S2 9 0 8 READ_ONLY FIX_AXIS_PAR_DIST 0 1 9 /end AXIS_DESCR
 /begin AXIS_DESCR FIX_AXIS Z_GANG_IST _CNV_S_9_Enum_EGANG_21_CM_S2 9 0 8 READ_ONLY FIX_AXIS_PAR_DIST 0 1 9 /end AXIS_DESCR
/end CHARACTERISTIC
/begin CHARACTERISTIC XTAB9X9T_WARTEZEIT_DYNDZM_0 "" MAP 0x1D943F _REC_A1MAP_9_u1_u1_u1_S2 5100 _CNV_R_R_Umr_1_zu_2_132_CM_S2 0 5100
 /begin AXIS_DESCR FIX_AXIS Z_GANG_ZIEL_DYNDZM _CNV_S_9_Enum_EGANG_21_CM_S2 9 0 8 READ_ONLY FIX_AXIS_PAR_DIST 0 1 9 /end AXIS_DESCR
 /begin AXIS_DESCR FIX_AXIS Z_GANG_IST _CNV_S_9_Enum_EGANG_21_CM_S2 9 0 8 READ_ONLY FIX_AXIS_PAR_DIST 0 1 9 /end AXIS_DESCR
/end CHARACTERISTIC
/begin CHARACTERISTIC XTAB9X9T_WARTEZEIT_DYNDZM_1 "" MAP 0x1D9490 _REC_A1MAP_9_u1_u1_u1_S2 5100 _CNV_R_R_Umr_1_zu_2_132_CM_S2 0 5100
 /begin AXIS_DESCR FIX_AXIS Z_GANG_ZIEL_DYNDZM _CNV_S_9_Enum_EGANG_21_CM_S2 9 0 8 READ_ONLY FIX_AXIS_PAR_DIST 0 1 9 /end AXIS_DESCR
 /begin AXIS_DESCR FIX_AXIS Z_GANG_IST _CNV_S_9_Enum_EGANG_21_CM_S2 9 0 8 READ_ONLY FIX_AXIS_PAR_DIST 0 1 9 /end AXIS_DESCR
/end CHARACTERISTIC
/begin CHARACTERISTIC XTAB9X9T_WARTEZEIT_DYNDZM_2 "" MAP 0x1D94E1 _REC_A1MAP_9_u1_u1_u1_S2 5100 _CNV_R_R_Umr_1_zu_2_132_CM_S2 0 5100
 /begin AXIS_DESCR FIX_AXIS Z_GANG_ZIEL_DYNDZM _CNV_S_9_Enum_EGANG_21_CM_S2 9 0 8 READ_ONLY FIX_AXIS_PAR_DIST 0 1 9 /end AXIS_DESCR
 /begin AXIS_DESCR FIX_AXIS Z_GANG_IST _CNV_S_9_Enum_EGANG_21_CM_S2 9 0 8 READ_ONLY FIX_AXIS_PAR_DIST 0 1 9 /end AXIS_DESCR
/end CHARACTERISTIC
/begin CHARACTERISTIC XTAB9Z_DRIVELOGICIDX_MAP "" CURVE 0x1D956F _REC_A1CUR_30_u1_u1_S2 8 _CNV_S_9_Enum_EMAPD_213_CM_S2 0 8
 /begin AXIS_DESCR FIX_AXIS Z_DL_IDX _CNV_S_9_Enum_EMAPD_212_CM_S2 9 0 8 READ_ONLY FIX_AXIS_PAR_DIST 0 1 9 /end AXIS_DESCR
/end CHARACTERISTIC
/begin CHARACTERISTIC XTAB9Z_GANGMIN_RSSEQ_BAB "" CURVE 0x1D9782 _REC_A1CUR_30_u1_u1_S2 8 _CNV_S_9_Enum_EGANG_21_CM_S2 0 8
 /begin AXIS_DESCR FIX_AXIS Z_GANG_ZIEL _CNV_S_9_Enum_EGANG_21_CM_S2 9 0 8 READ_ONLY FIX_AXIS_PAR_DIST 0 1 9 /end AXIS_DESCR
/end CHARACTERISTIC
/begin CHARACTERISTIC XTAB9Z_GANGWHL_AZG "" CURVE 0x1D8F4C _REC_A1CUR_30_u1_u1_S2 255 _CNV_R_R_Umr_1_zu_1_2_CM_S2 0 255
 /begin AXIS_DESCR FIX_AXIS Z_GANG_IST _CNV_S_9_Enum_EGANG_21_CM_S2 9 0 8 READ_ONLY FIX_AXIS_PAR_DIST 0 1 9 /end AXIS_DESCR
 FORMAT "%2.0" /end CHARACTERISTIC
/begin CHARACTERISTIC XTAB9Z_GANG_HSURE_ADAPT "" CURVE 0x1D95A0 _REC_A1CUR_30_u1_u1_S2 1 _CNV_R_R_Umr_1_zu_1_2_CM_S2 0 1
 /begin AXIS_DESCR FIX_AXIS Z_GANG_ZIEL_HSURE _CNV_S_9_Enum_EGANG_21_CM_S2 9 0 8 READ_ONLY FIX_AXIS_PAR_DIST 0 1 9 /end AXIS_DESCR
/end CHARACTERISTIC
/begin CHARACTERISTIC XTAB9Z_GANG_KDRS_STEPS "" CURVE 0x1DE5BC _REC_S7CUR_53_u2_u2_S2 8 _CNV_S_9_Enum_EGANG_21_CM_S2 0 8
 /begin AXIS_DESCR STD_AXIS N_AB _CNV_R_R_Umr_1_zu_1_3_CM_S2 9 0 20000 DEPOSIT ABSOLUTE FORMAT "%2.0" /end AXIS_DESCR
/end CHARACTERISTIC
/begin CHARACTERISTIC XTAB9Z_GANG_MARS_DBM "" CURVE 0x1D913F _REC_A1CUR_30_u1_u1_S2 8 _CNV_S_9_Enum_EGANG_21_CM_S2 0 8
 /begin AXIS_DESCR FIX_AXIS Z_GANG_ZIEL_DBM _CNV_S_9_Enum_EGANG_21_CM_S2 9 0 8 READ_ONLY FIX_AXIS_PAR_DIST 0 1 9 /end AXIS_DESCR
/end CHARACTERISTIC
/begin CHARACTERISTIC XTAB9Z_GANG_VFZG "" CURVE 0x1DE5E2 _REC_S7CUR_53_u2_u2_S2 8 _CNV_S_9_Enum_EGANG_21_CM_S2 0 8
 /begin AXIS_DESCR STD_AXIS V_FZG _CNV_R_R_Umr_1_zu_1_8_CM_S2 9 0 400 DEPOSIT ABSOLUTE FORMAT "%2.0" /end AXIS_DESCR
/end CHARACTERISTIC
/begin CHARACTERISTIC XTAB9Z_HSUKS_IDX "" CURVE 0x1D97B2 _REC_A1CUR_30_u1_u1_S2 5 _CNV_R_R_Umr_1_zu_1_2_CM_S2 0 5
 /begin AXIS_DESCR FIX_AXIS Z_GANG_ZIEL _CNV_S_9_Enum_EGANG_21_CM_S2 9 0 8 READ_ONLY /begin FIX_AXIS_PAR_LIST 0 1 2 3 4 5 6 7 8 /end FIX_AXIS_PAR_LIST /end AXIS_DESCR
 FORMAT "%2.0" /end CHARACTERISTIC
/begin CHARACTERISTIC XTAB9Z_IDX_MMOTPOTSCHUB_ZKA "" CURVE 0x1D972A _REC_A1CUR_30_u1_u2_S2 2 _CNV_S_3_Enum_EMOT__181_CM_S2 0 2
 /begin AXIS_DESCR FIX_AXIS NO_INPUT_QUANTITY _CNV_S_9_Enum_EGANG_21_CM_S2 9 0 8 READ_ONLY FIX_AXIS_PAR_DIST 0 1 9 /end AXIS_DESCR
/end CHARACTERISTIC
/begin CHARACTERISTIC XTAB9Z_IDX_MMOTPOTZUG_ZKA "" CURVE 0x1D9733 _REC_A1CUR_30_u1_u2_S2 4 _CNV_S_5_Enum_EMOT__180_CM_S2 0 4
 /begin AXIS_DESCR FIX_AXIS NO_INPUT_QUANTITY _CNV_S_9_Enum_EGANG_21_CM_S2 9 0 8 READ_ONLY FIX_AXIS_PAR_DIST 0 1 9 /end AXIS_DESCR
/end CHARACTERISTIC
/begin CHARACTERISTIC XTAB9_HSURESCHLUPF_IDX "" CURVE 0x1D95CB _REC_A1CUR_30_u1_u1_S2 2 _CNV_R_R_Umr_1_zu_1_2_CM_S2 0 2
 /begin AXIS_DESCR FIX_AXIS Z_GANG_ZIEL_HSURE _CNV_S_9_Enum_EGANG_21_CM_S2 9 0 8 READ_ONLY FIX_AXIS_PAR_DIST 0 1 9 /end AXIS_DESCR
 FORMAT "%2.0" /end CHARACTERISTIC
/begin CHARACTERISTIC XTAB9_RELATION_N_VAHA_DOWN "" CURVE 0x1D960E _REC_A1CUR_30_u1_u1_S2 2 _CNV_R_R_Umr_100_zu_42_CM_S2 0 2
 /begin AXIS_DESCR FIX_AXIS Z_GANG_ZIEL _CNV_S_9_Enum_EGANG_21_CM_S2 9 0 8 READ_ONLY FIX_AXIS_PAR_DIST 0 1 9 /end AXIS_DESCR
 FORMAT "%4.2" /end CHARACTERISTIC
/begin CHARACTERISTIC XTAB9_RELATION_N_VAHA_UP "" CURVE 0x1D9617 _REC_A1CUR_30_u1_u1_S2 2 _CNV_R_R_Umr_100_zu_42_CM_S2 0 2
 /begin AXIS_DESCR FIX_AXIS Z_GANG_ZIEL _CNV_S_9_Enum_EGANG_21_CM_S2 9 0 8 READ_ONLY FIX_AXIS_PAR_DIST 0 1 9 /end AXIS_DESCR
 FORMAT "%4.2" /end CHARACTERISTIC
/begin CHARACTERISTIC XTEMP_APPL_KS "" VALUE 0x1DF346 _REC_S1VAL_1_s2_S2 500 _CNV_R_R_Umr_1_zu_1_1_CM_S2 0 500 FORMAT "%2.0" /end CHARACTERISTIC
/begin CHARACTERISTIC XTEMP_MAX_HSUKS "" VALUE 0x1E27B6 _REC_S1VAL_1_u2_S2 500 _CNV_R_R_Umr_1_zu_1_1_CM_S2 0 500 FORMAT "%2.0" /end CHARACTERISTIC
/begin CHARACTERISTIC XTEMP_MIN_HSUKS "" VALUE 0x1E27B8 _REC_S1VAL_1_u2_S2 500 _CNV_R_R_Umr_1_zu_1_1_CM_S2 0 500 FORMAT "%2.0" /end CHARACTERISTIC
/begin CHARACTERISTIC XTEMP_UMG_SIMULATE "" VALUE 0x1DF342 _REC_S1VAL_1_s2_S2 400 _CNV_R_R_Umr_1_zu_1_1_CM_S2 -200 200 FORMAT "%2.0" /end CHARACTERISTIC
/begin CHARACTERISTIC XT_ABBRUCH_DYNDZM "" VALUE 0x1DEA9C _REC_S1VAL_1_u2_S2 2000 _CNV_R_R_Umr_1_zu_1_6_CM_S2 0 2000 FORMAT "%2.0" /end CHARACTERISTIC
/begin CHARACTERISTIC XT_ABREGLER_DECPERIOD "" VALUE 0x1DF3B0 _REC_S1VAL_1_u2_S2 65535 _CNV_R_R_Umr_1_zu_1_6_CM_S2 0 65535 FORMAT "%2.0" /end CHARACTERISTIC
/begin CHARACTERISTIC XT_ABS_EINMUELOW "" VALUE 0x1DCA50 _REC_S1VAL_1_u4_S2 2147480000 _CNV_R_R_Umr_1_zu_1_6_CM_S2 0 2147483647 FORMAT "%2.0" /end CHARACTERISTIC
/begin CHARACTERISTIC XT_ANGLEICH_UMSCHALT_DYNDZM "" VALUE 0x1D953E _REC_S1VAL_1_u1_S2 5100 _CNV_R_R_Umr_1_zu_2_135_CM_S2 0 5100 FORMAT "%2.0" /end CHARACTERISTIC
/begin CHARACTERISTIC XT_A_RADABSFILT "" VALUE 0x1DC55C _REC_S1VAL_1_u4_S2 2147480000 _CNV_R_R_Umr_1_zu_1_6_CM_S2 0 2147483647 FORMAT "%2.0" /end CHARACTERISTIC
/begin CHARACTERISTIC XT_BAB_FGR "" VALUE 0x1DD66C _REC_S1VAL_1_u4_S2 2147480000 _CNV_R_R_Umr_1_zu_1_6_CM_S2 0 2147483647 FORMAT "%2.0" /end CHARACTERISTIC
/begin CHARACTERISTIC XT_BERGANH "" VALUE 0x1DC1C0 _REC_S1VAL_1_u4_S2 2147480000 _CNV_R_R_Umr_1_zu_1_6_CM_S2 0 2147483647 FORMAT "%2.0" /end CHARACTERISTIC
/begin CHARACTERISTIC XT_BPL "" VALUE 0x1DDE44 _REC_S1VAL_1_u4_S2 2147480000 _CNV_R_R_Umr_1_zu_1_6_CM_S2 0 2147483647 FORMAT "%2.0" /end CHARACTERISTIC
/begin CHARACTERISTIC XT_B_SCHLUPF "" VALUE 0x1DCA54 _REC_S1VAL_1_u4_S2 2147480000 _CNV_R_R_Umr_1_zu_1_6_CM_S2 0 2147483647 FORMAT "%2.0" /end CHARACTERISTIC
/begin CHARACTERISTIC XT_DELTA_BEW_GMMOTFW "" VALUE 0x1D959C _REC_S1VAL_1_u1_S2 70 _CNV_R_R_Umr_1_zu_1_67_CM_S2 10 80 FORMAT "%2.0" /end CHARACTERISTIC
/begin CHARACTERISTIC XT_DERS "" VALUE 0x1E26FC _REC_S1VAL_1_u2_S2 10000 _CNV_R_R_Umr_1_zu_1_6_CM_S2 0 10000 FORMAT "%2.0" /end CHARACTERISTIC
/begin CHARACTERISTIC XT_DSC_EINMUELOW "" VALUE 0x1DCA58 _REC_S1VAL_1_u4_S2 2147480000 _CNV_R_R_Umr_1_zu_1_6_CM_S2 0 2147483647 FORMAT "%2.0" /end CHARACTERISTIC
/begin CHARACTERISTIC XT_DUE_AUS "" VALUE 0x1E2716 _REC_S1VAL_1_u2_S2 65535 _CNV_R_R_Umr_1_zu_1_6_CM_S2 0 65535 FORMAT "%2.0" /end CHARACTERISTIC
/begin CHARACTERISTIC XT_DUE_EIN "" VALUE 0x1E2718 _REC_S1VAL_1_u2_S2 65535 _CNV_R_R_Umr_1_zu_1_6_CM_S2 0 65535 FORMAT "%2.0" /end CHARACTERISTIC
/begin CHARACTERISTIC XT_DYNAMIKZYK "" VALUE 0x1DE426 _REC_S1VAL_1_u2_S2 65535 _CNV_R_R_Umr_1_zu_1_124_CM_S2 0 65535 FORMAT "%2.0" /end CHARACTERISTIC
/begin CHARACTERISTIC XT_EIN_BAB "" VALUE 0x1DC1BC _REC_S1VAL_1_u4_S2 2147480000 _CNV_R_R_Umr_1_zu_1_6_CM_S2 0 2147483647 FORMAT "%2.0" /end CHARACTERISTIC
/begin CHARACTERISTIC XT_GANG_ZIEL_STPTRsport "" VALUE 0x1DC108 _REC_S1VAL_1_u4_S2 2147480000 _CNV_R_R_Umr_1_zu_1_6_CM_S2 0 2147483647 FORMAT "%2.0" /end CHARACTERISTIC
/begin CHARACTERISTIC XT_GM_LDM_SOLL "" VALUE 0x1DF34A _REC_S1VAL_1_u2_S2 2500 _CNV_R_R_Umr_1_zu_1_67_CM_S2 0 2500 FORMAT "%2.0" /end CHARACTERISTIC
/begin CHARACTERISTIC XT_GWFP_LASTWE_DYNDZM "" VALUE 0x1DC4F4 _REC_S1VAL_1_u4_S2 1000000 _CNV_R_R_Umr_1_zu_1_6_CM_S2 0 1000000 FORMAT "%2.0" /end CHARACTERISTIC
/begin CHARACTERISTIC XT_GWFP_SPA "" VALUE 0x1E2108 _REC_S1VAL_1_u2_S2 10000 _CNV_R_R_Umr_1_zu_1_6_CM_S2 0 10000 FORMAT "%2.0" /end CHARACTERISTIC
/begin CHARACTERISTIC XT_HSPV_NGE_ZKA "" VALUE 0x1E24A4 _REC_S1VAL_1_s2_S2 1000 _CNV_R_R_Umr_1_zu_1_124_CM_S2 0 1000 FORMAT "%2.0" /end CHARACTERISTIC
/begin CHARACTERISTIC XT_HSRS_SPA "" VALUE 0x1E210A _REC_S1VAL_1_u2_S2 10000 _CNV_R_R_Umr_1_zu_1_6_CM_S2 0 10000 FORMAT "%2.0" /end CHARACTERISTIC
/begin CHARACTERISTIC XT_HSURENL "" VALUE 0x1D95C8 _REC_S1VAL_1_u1_S2 25.5 _CNV_R_R_Umr_10_zu__117_CM_S2 0 25.5 FORMAT "%3.1" /end CHARACTERISTIC
/begin CHARACTERISTIC XT_HSURE_DECPERIOD "" VALUE 0x1DEDE2 _REC_S1VAL_1_u2_S2 65535 _CNV_R_R_Umr_1_zu_1_6_CM_S2 0 65535 FORMAT "%2.0" /end CHARACTERISTIC
/begin CHARACTERISTIC XT_HSURE_SCHLUPF_AUS "" VALUE 0x1DF168 _REC_S1VAL_1_u2_S2 65535 _CNV_R_R_Umr_1_zu_1_6_CM_S2 0 65535 FORMAT "%2.0" /end CHARACTERISTIC
/begin CHARACTERISTIC XT_KURVE_BEW "" VALUE 0x1DD980 _REC_S1VAL_1_u4_S2 2147480000 _CNV_R_R_Umr_1_zu_1_6_CM_S2 0 2147483647 FORMAT "%2.0" /end CHARACTERISTIC
/begin CHARACTERISTIC XT_KURVE_LDMNACHL "" CURVE 0x1DC950 _REC_A1CUR_30_u4_u1_S2 4294970000 _CNV_R_R_Umr_1_zu_1_6_CM_S2 0 4294967295
 /begin AXIS_DESCR FIX_AXIS Z_AGS_MODBEDEL _CNV_S_2_Enum_EAGS_18_CM_S2 2 0 1 READ_ONLY FIX_AXIS_PAR_DIST 0 1 2 /end AXIS_DESCR
 FORMAT "%2.0" /end CHARACTERISTIC
/begin CHARACTERISTIC XT_LDMBAB_ENBL "" VALUE 0x1DF34C _REC_S1VAL_1_u2_S2 65535 _CNV_R_R_Umr_1_zu_1_6_CM_S2 0 65535 FORMAT "%2.0" /end CHARACTERISTIC
/begin CHARACTERISTIC XT_MAX_DYNDZM_HS_WARTEZEIT_P1 "" VALUE 0x1DEA9E _REC_S1VAL_1_u2_S2 2000 _CNV_R_R_Umr_1_zu_1_6_CM_S2 0 2000 FORMAT "%2.0" /end CHARACTERISTIC
/begin CHARACTERISTIC XT_MAX_DYNDZM_RS_WARTEZEIT_P1 "" VALUE 0x1DEAA0 _REC_S1VAL_1_u2_S2 2000 _CNV_R_R_Umr_1_zu_1_6_CM_S2 0 2000 FORMAT "%2.0" /end CHARACTERISTIC
/begin CHARACTERISTIC XT_MAX_WL "" VALUE 0x1DD598 _REC_S1VAL_1_u4_S2 2147480 _CNV_R_R_Umr_1000_z_12_CM_S2 0 2147483.647 FORMAT "%5.3" /end CHARACTERISTIC
/begin CHARACTERISTIC XT_MAX_WL2 "" VALUE 0x1DD590 _REC_S1VAL_1_u4_S2 2147480 _CNV_R_R_Umr_1000_z_12_CM_S2 0 2147483.647 FORMAT "%5.3" /end CHARACTERISTIC
/begin CHARACTERISTIC XT_MAX_WLPRED "" VALUE 0x1DD594 _REC_S1VAL_1_u4_S2 2147480 _CNV_R_R_Umr_1000_z_12_CM_S2 0 2147483.647 FORMAT "%5.3" /end CHARACTERISTIC
/begin CHARACTERISTIC XT_MDSSCHUB "" VALUE 0x1E288E _REC_S1VAL_1_u2_S2 1000 _CNV_R_R_Umr_1_zu_1_124_CM_S2 0 1000 FORMAT "%2.0" /end CHARACTERISTIC
/begin CHARACTERISTIC XT_MDSSCHUB_REGEN "" VALUE 0x1E2890 _REC_S1VAL_1_u2_S2 1000 _CNV_R_R_Umr_1_zu_1_124_CM_S2 0 1000 FORMAT "%2.0" /end CHARACTERISTIC
/begin CHARACTERISTIC XT_MFRSZ "" VALUE 0x1DD670 _REC_S1VAL_1_u4_S2 2147480000 _CNV_R_R_Umr_1_zu_1_6_CM_S2 0 2147483647 FORMAT "%2.0" /end CHARACTERISTIC
/begin CHARACTERISTIC XT_MIN_DYNDZM_HS_WARTEZEIT_P1 "" VALUE 0x1DEAA2 _REC_S1VAL_1_u2_S2 2000 _CNV_R_R_Umr_1_zu_1_6_CM_S2 0 2000 FORMAT "%2.0" /end CHARACTERISTIC
/begin CHARACTERISTIC XT_MIN_DYNDZM_RS_WARTEZEIT_P1 "" VALUE 0x1DEAA4 _REC_S1VAL_1_u2_S2 2000 _CNV_R_R_Umr_1_zu_1_6_CM_S2 0 2000 FORMAT "%2.0" /end CHARACTERISTIC
/begin CHARACTERISTIC XT_MIN_LV "" VALUE 0x1DCA5C _REC_S1VAL_1_u4_S2 2147480000 _CNV_R_R_Umr_1_zu_1_6_CM_S2 0 2147483647 FORMAT "%2.0" /end CHARACTERISTIC
/begin CHARACTERISTIC XT_MUELOWAUS_LAST "" VALUE 0x1DCA60 _REC_S1VAL_1_u4_S2 2147480000 _CNV_R_R_Umr_1_zu_1_6_CM_S2 0 2147483647 FORMAT "%2.0" /end CHARACTERISTIC
/begin CHARACTERISTIC XT_MUELOW_AUS "" VALUE 0x1DCA64 _REC_S1VAL_1_u4_S2 2147480000 _CNV_R_R_Umr_1_zu_1_6_CM_S2 0 2147483647 FORMAT "%2.0" /end CHARACTERISTIC
/begin CHARACTERISTIC XT_NACHLAUF_EINLENK "" VALUE 0x1DC958 _REC_S1VAL_1_u4_S2 2147480000 _CNV_R_R_Umr_1_zu_1_6_CM_S2 0 2147483647 FORMAT "%2.0" /end CHARACTERISTIC
/begin CHARACTERISTIC XT_NACHLAUF_QS3 "" VALUE 0x1DE3E6 _REC_S1VAL_1_u2_S2 1024 _CNV_R_R_Umr_1_zu_1_124_CM_S2 0 1024 FORMAT "%2.0" /end CHARACTERISTIC
/begin CHARACTERISTIC XT_NACHL_LDM_DYNAMIC2 "" VALUE 0x1DC984 _REC_S1VAL_1_u4_S2 2147480000 _CNV_R_R_Umr_1_zu_1_6_CM_S2 0 2147483647 FORMAT "%2.0" /end CHARACTERISTIC
/begin CHARACTERISTIC XT_OVERRIDE_GANG "" VALUE 0x1DF344 _REC_S1VAL_1_s2_S2 3000 _CNV_R_R_Umr_1_zu_1_6_CM_S2 0 3000 FORMAT "%2.0" /end CHARACTERISTIC
/begin CHARACTERISTIC XT_PADDLE_AUS "" VALUE 0x1DD58C _REC_S1VAL_1_u4_S2 4294970000 _CNV_R_R_Umr_1_zu_1_6_CM_S2 0 4294967295 FORMAT "%2.0" /end CHARACTERISTIC
/begin CHARACTERISTIC XT_PRUEF1_VALIDFWS "" VALUE 0x1DEC9A _REC_S1VAL_1_u2_S2 1000 _CNV_R_R_Umr_1_zu_1_67_CM_S2 0 1000 /end CHARACTERISTIC
/begin CHARACTERISTIC XT_PRUEF2_VALIDFWS "" VALUE 0x1DEC9C _REC_S1VAL_1_s2_S2 1000 _CNV_R_R_Umr_1_zu_1_67_CM_S2 0 1000 FORMAT "%2.0" /end CHARACTERISTIC
/begin CHARACTERISTIC XT_QSHIFTMFRS_WAIT "" VALUE 0x1DD4BC _REC_S1VAL_1_u4_S2 2147480000 _CNV_R_R_Umr_1_zu_1_6_CM_S2 0 2147483647 FORMAT "%2.0" /end CHARACTERISTIC
/begin CHARACTERISTIC XT_REG_ASCNACHL "" VALUE 0x1DC12C _REC_S1VAL_1_u4_S2 2147480000 _CNV_R_R_Umr_1_zu_1_6_CM_S2 0 2147483647 FORMAT "%2.0" /end CHARACTERISTIC
/begin CHARACTERISTIC XT_RS_SEQ "" VALUE 0x1DCA44 _REC_S1VAL_1_u4_S2 2147480000 _CNV_R_R_Umr_1_zu_1_6_CM_S2 0 2147483647 FORMAT "%2.0" /end CHARACTERISTIC
/begin CHARACTERISTIC XT_SCHLUPF_NACHL "" VALUE 0x1DCA68 _REC_S1VAL_1_u4_S2 2147480000 _CNV_R_R_Umr_1_zu_1_6_CM_S2 0 2147483647 FORMAT "%2.0" /end CHARACTERISTIC
/begin CHARACTERISTIC XT_SCHLUPF_NACHLZWEI "" VALUE 0x1DF462 _REC_S1VAL_1_u2_S2 65535 _CNV_R_R_Umr_1_zu_1_6_CM_S2 0 65535 FORMAT "%2.0" /end CHARACTERISTIC
/begin CHARACTERISTIC XT_SEQUENZER_ZKA "" VALUE 0x1DD60C _REC_S1VAL_1_s4_S2 3000 _CNV_R_R_Umr_1_zu_1_6_CM_S2 0 3000 FORMAT "%2.0" /end CHARACTERISTIC
/begin CHARACTERISTIC XT_SEQ_TIMER_RSU_DSCERR "" VALUE 0x1DE3D2 _REC_S1VAL_1_u2_S2 1000 _CNV_R_R_Umr_1_zu_1_6_CM_S2 0 1000 FORMAT "%2.0" /end CHARACTERISTIC
/begin CHARACTERISTIC XT_SERP_NACHLAUF "" VALUE 0x1DC95C _REC_S1VAL_1_u4_S2 2147480000 _CNV_R_R_Umr_1_zu_1_6_CM_S2 0 2147483647 FORMAT "%2.0" /end CHARACTERISTIC
/begin CHARACTERISTIC XT_SG "" VALUE 0x1E2152 _REC_S1VAL_1_u2_S2 3600 _CNV_R_R_Umr_1_zu_1_124_CM_S2 0 3600 FORMAT "%2.0" /end CHARACTERISTIC
/begin CHARACTERISTIC XT_SPEICHER_TIPP_MINUS "" VALUE 0x1DE616 _REC_S1VAL_1_u2_S2 10000 _CNV_R_R_Umr_1_zu_1_6_CM_S2 0 10000 FORMAT "%2.0" /end CHARACTERISTIC
/begin CHARACTERISTIC XT_SPERR_FWSVALID_MSASTART "" VALUE 0x1DECAC _REC_S1VAL_1_u2_S2 5000 _CNV_R_R_Umr_1_zu_1_6_CM_S2 0 5000 FORMAT "%2.0" /end CHARACTERISTIC
/begin CHARACTERISTIC XT_SPERR_RSZBAB "" VALUE 0x1DD674 _REC_S1VAL_1_u4_S2 2147480000 _CNV_R_R_Umr_1_zu_1_6_CM_S2 0 2147483647 FORMAT "%2.0" /end CHARACTERISTIC
/begin CHARACTERISTIC XT_SPERR_SPA "" VALUE 0x1E210C _REC_S1VAL_1_u2_S2 10000 _CNV_R_R_Umr_1_zu_1_6_CM_S2 0 10000 FORMAT "%2.0" /end CHARACTERISTIC
/begin CHARACTERISTIC XT_STABKRI_ZKA "" VALUE 0x1E248E _REC_S1VAL_1_u2_S2 30000 _CNV_R_R_Umr_1_zu_1_6_CM_S2 0 30000 FORMAT "%2.0" /end CHARACTERISTIC
/begin CHARACTERISTIC XT_STARTLM "" VALUE 0x1DC988 _REC_S1VAL_1_u4_S2 2147480000 _CNV_R_R_Umr_1_zu_1_6_CM_S2 0 2147483647 FORMAT "%2.0" /end CHARACTERISTIC
/begin CHARACTERISTIC XT_STEIGUNG_FILT "" VALUE 0x1E2130 _REC_S1VAL_1_u2_S2 3000 _CNV_R_R_Umr_1_zu_1_6_CM_S2 0 3000 FORMAT "%2.0" /end CHARACTERISTIC
/begin CHARACTERISTIC XT_TID_AUSSTIEG "" VALUE 0x1DDD7C _REC_S1VAL_1_u4_S2 2147480000 _CNV_R_R_Umr_1_zu_1_6_CM_S2 0 2147483647 FORMAT "%2.0" /end CHARACTERISTIC
/begin CHARACTERISTIC XT_TIPP_SPA "" VALUE 0x1E210E _REC_S1VAL_1_u2_S2 10000 _CNV_R_R_Umr_1_zu_1_6_CM_S2 0 10000 FORMAT "%2.0" /end CHARACTERISTIC
/begin CHARACTERISTIC XT_TIPP_STEPS "" VALUE 0x1DC10C _REC_S1VAL_1_u4_S2 2147480000 _CNV_R_R_Umr_1_zu_1_6_CM_S2 0 2147483647 FORMAT "%2.0" /end CHARACTERISTIC
/begin CHARACTERISTIC XT_VALIDFWS_BREMS "" VALUE 0x1DEC9E _REC_S1VAL_1_u2_S2 65000 _CNV_R_R_Umr_1_zu_1_6_CM_S2 0 65000 FORMAT "%2.0" /end CHARACTERISTIC
/begin CHARACTERISTIC XT_VALIDFWS_BREMS_FLANKE "" VALUE 0x1DECA0 _REC_S1VAL_1_u2_S2 1000 _CNV_R_R_Umr_1_zu_1_6_CM_S2 0 1000 FORMAT "%2.0" /end CHARACTERISTIC
/begin CHARACTERISTIC XT_VALIDFWS_GWFP "" VALUE 0x1DECA2 _REC_S1VAL_1_u2_S2 65535 _CNV_R_R_Umr_1_zu_1_6_CM_S2 0 65535 FORMAT "%2.0" /end CHARACTERISTIC
/begin CHARACTERISTIC XT_VM_MOTISTFW_HKOR "" VALUE 0x1DED40 _REC_S1VAL_1_u2_S2 2500 _CNV_R_R_Umr_1_zu_1_6_CM_S2 0 2500 FORMAT "%2.0" /end CHARACTERISTIC
/begin CHARACTERISTIC XT_VORWAHL "" VALUE 0x1DE618 _REC_S1VAL_1_u2_S2 65512 _CNV_R_R_Umr_1_zu_1_6_CM_S2 0 65512 FORMAT "%2.0" /end CHARACTERISTIC
/begin CHARACTERISTIC XT_V_RSZBAB "" VALUE 0x1DD678 _REC_S1VAL_1_u4_S2 2147480000 _CNV_R_R_Umr_1_zu_1_6_CM_S2 0 2147483647 FORMAT "%2.0" /end CHARACTERISTIC
/begin CHARACTERISTIC XT_WAIT_DDRS "" VALUE 0x1E269A _REC_S1VAL_1_u2_S2 1000 _CNV_R_R_Umr_1_zu_1_6_CM_S2 0 1000 FORMAT "%2.0" /end CHARACTERISTIC
/begin CHARACTERISTIC XT_WAIT_RS "" VALUE 0x1DCA48 _REC_S1VAL_1_u4_S2 2147480000 _CNV_R_R_Umr_1_zu_1_6_CM_S2 0 2147483647 FORMAT "%2.0" /end CHARACTERISTIC
/begin CHARACTERISTIC XT_WDKKD_SPA "" VALUE 0x1E2110 _REC_S1VAL_1_u2_S2 10000 _CNV_R_R_Umr_1_zu_1_6_CM_S2 0 10000 FORMAT "%2.0" /end CHARACTERISTIC
/begin CHARACTERISTIC XT_ZWANG_HSRS_STPTRsport "" VALUE 0x1DC110 _REC_S1VAL_1_u4_S2 2147480000 _CNV_R_R_Umr_1_zu_1_6_CM_S2 0 2147483647 FORMAT "%2.0" /end CHARACTERISTIC
/begin CHARACTERISTIC XVM_MOTISTFW_FILT_INGEW "" VALUE 0x1D959D _REC_S1VAL_1_u1_S2 250 _CNV_R_R_Umr_1_zu_1_2_CM_S2 0 250 FORMAT "%2.0" /end CHARACTERISTIC
/begin CHARACTERISTIC XVM_MOTISTFW_FILT_OUTGEW "" VALUE 0x1D959E _REC_S1VAL_1_u1_S2 250 _CNV_R_R_Umr_1_zu_1_2_CM_S2 0 250 FORMAT "%2.0" /end CHARACTERISTIC
/begin CHARACTERISTIC XVM_MOT_HKORGEW "" VALUE 0x1DED42 _REC_S1VAL_1_u2_S2 65535 _CNV_R_R_Umr_1_zu_1_2_CM_S2 0 65535 FORMAT "%2.0" /end CHARACTERISTIC
/begin CHARACTERISTIC XVM_MOT_HKORMAX "" VALUE 0x1DED44 _REC_S1VAL_1_u2_S2 200 _CNV_R_R_Umr_1_zu_1_30_CM_S2 0 200 FORMAT "%2.0" /end CHARACTERISTIC
/begin CHARACTERISTIC XVM_MOT_HKORMIN "" VALUE 0x1DED46 _REC_S1VAL_1_u2_S2 200 _CNV_R_R_Umr_1_zu_1_30_CM_S2 0 200 FORMAT "%2.0" /end CHARACTERISTIC
/begin CHARACTERISTIC XVM_MOT_HKORROHGEW "" VALUE 0x1DED48 _REC_S1VAL_1_u2_S2 65535 _CNV_R_R_Umr_1_zu_1_2_CM_S2 0 65535 FORMAT "%2.0" /end CHARACTERISTIC
/begin CHARACTERISTIC XV_FZGOHNEABS_INGEW "" VALUE 0x1DECBA _REC_S1VAL_1_u2_S2 65535 _CNV_R_R_Umr_1_zu_1_2_CM_S2 0 65535 FORMAT "%2.0" /end CHARACTERISTIC
/begin CHARACTERISTIC XV_FZGOHNEABS_OUTGEW "" VALUE 0x1DECBC _REC_S1VAL_1_u2_S2 65535 _CNV_R_R_Umr_1_zu_1_2_CM_S2 0 65535 FORMAT "%2.0" /end CHARACTERISTIC
/begin CHARACTERISTIC XV_FZG_COG_OUTGEW "" VALUE 0x1DECBE _REC_S1VAL_1_u2_S2 65535 _CNV_R_R_Umr_1_zu_1_2_CM_S2 0 65535 FORMAT "%2.0" /end CHARACTERISTIC
/begin CHARACTERISTIC XV_FZG_INGEW "" VALUE 0x1DECC0 _REC_S1VAL_1_u2_S2 65535 _CNV_R_R_Umr_1_zu_1_2_CM_S2 0 65535 FORMAT "%2.0" /end CHARACTERISTIC
/begin CHARACTERISTIC XV_FZG_OUTGEW "" VALUE 0x1DECC2 _REC_S1VAL_1_u2_S2 65535 _CNV_R_R_Umr_1_zu_1_2_CM_S2 0 65535 FORMAT "%2.0" /end CHARACTERISTIC
/begin CHARACTERISTIC XW_DKKD_BPL "" CURVE 0x1DDE40 _REC_A1CUR_30_u2_u1_S2 110 _CNV_R_R_Umr_10_zu__9_CM_S2 0 110
 /begin AXIS_DESCR FIX_AXIS Z_AGS_MODBEDEL _CNV_S_2_Enum_EAGS_18_CM_S2 2 0 1 READ_ONLY FIX_AXIS_PAR_DIST 0 1 2 /end AXIS_DESCR
 FORMAT "%3.1" /end CHARACTERISTIC
/begin CHARACTERISTIC XW_DKKD_SCHUBSCHLEPP "" VALUE 0x1E265C _REC_S1VAL_1_u2_S2 110 _CNV_R_R_Umr_10_zu__9_CM_S2 0 110 FORMAT "%3.1" /end CHARACTERISTIC
/begin CHARACTERISTIC XW_DK_LIMITLDMAAGS "" VALUE 0x1DDEE6 _REC_S1VAL_1_u2_S2 110 _CNV_R_R_Umr_10_zu__9_CM_S2 0 110 FORMAT "%3.1" /end CHARACTERISTIC
/begin CHARACTERISTIC XW_DK_LIMITLDMSAGS "" VALUE 0x1DDEE8 _REC_S1VAL_1_u2_S2 110 _CNV_R_R_Umr_10_zu__9_CM_S2 0 110 FORMAT "%3.1" /end CHARACTERISTIC
/begin CHARACTERISTIC XW_DK_LINEAR "" CURVE 0x1DE8C2 _REC_S7CUR_53_u2_u2_S2 110 _CNV_R_R_Umr_10_zu__9_CM_S2 0 110
 /begin AXIS_DESCR STD_AXIS W_DKKD _CNV_R_R_Umr_10_zu__9_CM_S2 7 0 110 DEPOSIT ABSOLUTE FORMAT "%3.1" /end AXIS_DESCR
 FORMAT "%3.1" /end CHARACTERISTIC
/begin CHARACTERISTIC XW_LWVA_EFF_FILTINGEW "" VALUE 0x1DF34E _REC_S1VAL_1_s2_S2 499 _CNV_R_R_Umr_1_zu_1_2_CM_S2 1 500 FORMAT "%2.0" /end CHARACTERISTIC
/begin CHARACTERISTIC XW_LWVA_EFF_FILTOUTGEW "" VALUE 0x1DF350 _REC_S1VAL_1_s2_S2 500 _CNV_R_R_Umr_1_zu_1_2_CM_S2 0 500 FORMAT "%2.0" /end CHARACTERISTIC
/begin CHARACTERISTIC XW_STEIGUNG_INGEW "" VALUE 0x1E2132 _REC_S1VAL_1_s2_S2 32767 _CNV_R_R_Umr_1_zu_1_2_CM_S2 0 32767 FORMAT "%2.0" /end CHARACTERISTIC
/begin CHARACTERISTIC XW_STEIGUNG_KORFILT_SLOW_INGEW "" VALUE 0x1DE7BE _REC_S1VAL_1_s2_S2 32767 _CNV_R_R_Umr_1_zu_1_2_CM_S2 0 32767 FORMAT "%2.0" /end CHARACTERISTIC
/begin CHARACTERISTIC XW_STEIGUNG_KORFILT_SLOW_OUTGEW "" VALUE 0x1DE7C0 _REC_S1VAL_1_s2_S2 32767 _CNV_R_R_Umr_1_zu_1_2_CM_S2 0 32767 FORMAT "%2.0" /end CHARACTERISTIC
/begin CHARACTERISTIC XW_STEIGUNG_OUTGEW "" VALUE 0x1E2134 _REC_S1VAL_1_s2_S2 32767 _CNV_R_R_Umr_1_zu_1_2_CM_S2 0 32767 FORMAT "%2.0" /end CHARACTERISTIC
/begin CHARACTERISTIC XZ_ABS_SOURCE "" VALUE 0x1D95FB _REC_S1VAL_1_u1_S2 2 _CNV_S_3_Enum_ESIGN_69_CM_S2 0 2 /end CHARACTERISTIC
/begin CHARACTERISTIC XZ_AFU_SOURCE "" VALUE 0x1D95FC _REC_S1VAL_1_u1_S2 2 _CNV_S_3_Enum_ESIGN_69_CM_S2 0 2 /end CHARACTERISTIC
/begin CHARACTERISTIC XZ_ANFAHRGANG_PMA "" VALUE 0x1D8F49 _REC_S1VAL_1_u1_S2 2 _CNV_S_3_Enum_EPMA_83_CM_S2 0 2 /end CHARACTERISTIC
/begin CHARACTERISTIC XZ_ANHAENGER_ANFGANG2 "" VALUE 0x1D9123 _REC_S1VAL_1_u1_S2 2 _CNV_S_3_Enum_EANH_51_CM_S2 0 2 /end CHARACTERISTIC
/begin CHARACTERISTIC XZ_ANZAHL_QS3 "" VALUE 0x1E20C0 _REC_S1VAL_1_u2_S2 1024 _CNV_R_R_Umr_1_zu_1_2_CM_S2 0 1024 FORMAT "%2.0" /end CHARACTERISTIC
/begin CHARACTERISTIC XZ_BERECHNUNG_GANG_DBM "" VALUE 0x1D8F3D _REC_S1VAL_1_u1_S2 1 _CNV_R_R_Umr_1_zu_1_2_CM_S2 0 1 FORMAT "%2.0" /end CHARACTERISTIC
/begin CHARACTERISTIC XZ_COD_ALLRAD_SOURCE "" VALUE 0x1D913A _REC_S1VAL_1_u1_S2 2 _CNV_S_3_Enum_ECODA_232_CM_S2 0 2 /end CHARACTERISTIC
/begin CHARACTERISTIC XZ_COD_GETRTYP_SOURCE "" VALUE 0x1D913B _REC_S1VAL_1_u1_S2 2 _CNV_S_3_Enum_ECODG_233_CM_S2 0 2 /end CHARACTERISTIC
/begin CHARACTERISTIC XZ_COD_MAB_SOURCE "" VALUE 0x1D913C _REC_S1VAL_1_u1_S2 2 _CNV_S_3_Enum_ECODM_234_CM_S2 0 2 /end CHARACTERISTIC
/begin CHARACTERISTIC XZ_COD_STOPGO "" VALUE 0x1D913D _REC_S1VAL_1_u1_S2 2 _CNV_S_3_Enum_ECODS_235_CM_S2 0 2 /end CHARACTERISTIC
/begin CHARACTERISTIC XZ_COD_VMAX_SOURCE "" VALUE 0x1D913E _REC_S1VAL_1_u1_S2 4 _CNV_S_5_Enum_ECODV_236_CM_S2 0 4 /end CHARACTERISTIC
/begin CHARACTERISTIC XZ_DERS_WAIT "" VALUE 0x1D979F _REC_S1VAL_1_u1_S2 2 _CNV_R_R_Umr_1_zu_1_2_CM_S2 0 2 FORMAT "%2.0" /end CHARACTERISTIC
/begin CHARACTERISTIC XZ_DM_RAD_FWS_FILT "" VALUE 0x1D9588 _REC_S1VAL_1_u1_S2 2 _CNV_S_3_Enum_EDMRA_243_CM_S2 0 2 /end CHARACTERISTIC
/begin CHARACTERISTIC XZ_DRIVELOGIC_SOURCE "" VALUE 0x1D9579 _REC_S1VAL_1_u1_S2 2 _CNV_S_3_Enum_EDRIV_237_CM_S2 0 2 /end CHARACTERISTIC
/begin CHARACTERISTIC XZ_DSC_FLM "" VALUE 0x1D9124 _REC_S1VAL_1_u1_S2 3 _CNV_S_4_Enum_EDSCA_52_CM_S2 0 3 /end CHARACTERISTIC
/begin CHARACTERISTIC XZ_DSC_TASTER_BRS "" VALUE 0x1D9138 _REC_S1VAL_1_u1_S2 3 _CNV_S_4_Enum_EDSCB_49_CM_S2 0 3 /end CHARACTERISTIC
/begin CHARACTERISTIC XZ_DSC_TASTER_MUELOW_AUS "" VALUE 0x1D963A _REC_S1VAL_1_u1_S2 2 _CNV_S_3_Enum_EDSCM_39_CM_S2 0 2 /end CHARACTERISTIC
/begin CHARACTERISTIC XZ_DYNAMIK_IDXMAX "" VALUE 0x1D9104 _REC_S1VAL_1_u1_S2 50 _CNV_R_R_Umr_1_zu_1_2_CM_S2 0 50 FORMAT "%2.0" /end CHARACTERISTIC
/begin CHARACTERISTIC XZ_DYNAMIK_IDX_DEFAULT "" VALUE 0x1D9105 _REC_S1VAL_1_u1_S2 50 _CNV_R_R_Umr_1_zu_1_2_CM_S2 0 50 FORMAT "%2.0" /end CHARACTERISTIC
/begin CHARACTERISTIC XZ_DYNAMIK_QS3 "" VALUE 0x1D9106 _REC_S1VAL_1_u1_S2 255 _CNV_R_R_Umr_1_zu_1_2_CM_S2 0 255 FORMAT "%2.0" /end CHARACTERISTIC
/begin CHARACTERISTIC XZ_DYNSPV_GLBENBL "" VALUE 0x1D958F _REC_S1VAL_1_u1_S2 2 _CNV_R_R_Umr_1_zu_1_2_CM_S2 0 2 FORMAT "%2.0" /end CHARACTERISTIC
/begin CHARACTERISTIC XZ_EM_DAEMPFUNG_SOURCE "" VALUE 0x1D9603 _REC_S1VAL_1_u1_S2 2 _CNV_S_3_Enum_ESIGN_69_CM_S2 0 2 /end CHARACTERISTIC
/begin CHARACTERISTIC XZ_EM_PRD_REKUP_BAB "" VALUE 0x1D978B _REC_S1VAL_1_u1_S2 4 _CNV_R_R_Umr_1_zu_1_2_CM_S2 0 4 FORMAT "%2.0" /end CHARACTERISTIC
/begin CHARACTERISTIC XZ_FDC_SOURCE "" VALUE 0x1D957A _REC_S1VAL_1_u1_S2 2 _CNV_S_3_Enum_ESIGN_69_CM_S2 0 2 /end CHARACTERISTIC
/begin CHARACTERISTIC XZ_GANG_MAXARSFWS_DBM "" VALUE 0x1D8F3E _REC_S1VAL_1_u1_S2 8 _CNV_S_9_Enum_EGANG_21_CM_S2 0 8 /end CHARACTERISTIC
/begin CHARACTERISTIC XZ_GANG_MAXR "" VALUE 0x1D95ED _REC_S1VAL_1_u1_S2 8 _CNV_S_9_Enum_EGANG_21_CM_S2 0 8 /end CHARACTERISTIC
/begin CHARACTERISTIC XZ_GANG_MAXSCHLUPFRS "" VALUE 0x1D9631 _REC_S1VAL_1_u1_S2 8 _CNV_S_9_Enum_EGANG_21_CM_S2 0 8 /end CHARACTERISTIC
/begin CHARACTERISTIC XZ_GANG_MAX_MSA "" VALUE 0x1D8F7C _REC_S1VAL_1_u1_S2 8 _CNV_S_9_Enum_EGANG_21_CM_S2 0 8 /end CHARACTERISTIC
/begin CHARACTERISTIC XZ_GANG_MINARS_DBM "" VALUE 0x1D8F3F _REC_S1VAL_1_u1_S2 8 _CNV_S_9_Enum_EGANG_21_CM_S2 0 8 /end CHARACTERISTIC
/begin CHARACTERISTIC XZ_GANG_MINBABMUELOW "" VALUE 0x1D978E _REC_S1VAL_1_u1_S2 8 _CNV_S_9_Enum_EGANG_21_CM_S2 0 8 /end CHARACTERISTIC
/begin CHARACTERISTIC XZ_GANG_MINBRSMUELOW "" VALUE 0x1D9139 _REC_S1VAL_1_u1_S2 8 _CNV_S_9_Enum_EGANG_21_CM_S2 0 8 /end CHARACTERISTIC
/begin CHARACTERISTIC XZ_GANG_MINCGT_DBM "" VALUE 0x1D8F40 _REC_S1VAL_1_u1_S2 8 _CNV_S_9_Enum_EGANG_21_CM_S2 0 8 /end CHARACTERISTIC
/begin CHARACTERISTIC XZ_GANG_MINCMOPLUFT_DBM "" VALUE 0x1D8F41 _REC_S1VAL_1_u1_S2 8 _CNV_S_9_Enum_EGANG_21_CM_S2 0 8 /end CHARACTERISTIC
/begin CHARACTERISTIC XZ_GANG_MINHKOR_ZKA "" VALUE 0x1D977E _REC_S1VAL_1_u1_S2 8 _CNV_S_9_Enum_EGANG_21_CM_S2 0 8 /end CHARACTERISTIC
/begin CHARACTERISTIC XZ_GANG_MINSOLLLL_DBM "" VALUE 0x1D8F42 _REC_S1VAL_1_u1_S2 8 _CNV_S_9_Enum_EGANG_21_CM_S2 0 8 /end CHARACTERISTIC
/begin CHARACTERISTIC XZ_GANG_MINVMSTART_DBM "" VALUE 0x1D8F43 _REC_S1VAL_1_u1_S2 8 _CNV_S_9_Enum_EGANG_21_CM_S2 0 8 /end CHARACTERISTIC
/begin CHARACTERISTIC XZ_GEARREDUCTION_SOURCE "" VALUE 0x1D9605 _REC_S1VAL_1_u1_S2 2 _CNV_S_3_Enum_ESIGN_69_CM_S2 0 2 /end CHARACTERISTIC
/begin CHARACTERISTIC XZ_HEISSHOCH_SOURCE "" VALUE 0x1D971F _REC_S1VAL_1_u1_S2 1 _CNV_S_2_Enum_EHEIS_125_CM_S2 0 1 /end CHARACTERISTIC
/begin CHARACTERISTIC XZ_HKOR_SOURCE "" VALUE 0x1D959F _REC_S1VAL_1_u1_S2 2 _CNV_S_3_Enum_EHKOR_203_CM_S2 0 2 /end CHARACTERISTIC
/begin CHARACTERISTIC XZ_HS_ANZAHL_QS3 "" VALUE 0x1D9107 _REC_S1VAL_1_u1_S2 2 _CNV_R_R_Umr_1_zu_1_2_CM_S2 0 2 FORMAT "%2.0" /end CHARACTERISTIC
/begin CHARACTERISTIC XZ_IDXGRBDYN_SSINITDEF "" VALUE 0x1D8F7A _REC_S1VAL_1_u1_S2 15 _CNV_R_R_Umr_1_zu_1_2_CM_S2 0 15 /end CHARACTERISTIC
/begin CHARACTERISTIC XZ_K0_IST_DYNDZM "" VALUE 0x1D97A8 _REC_S1VAL_1_u1_S2 5 _CNV_R_R_Umr_1_zu_1_2_CM_S2 0 5 FORMAT "%2.0" /end CHARACTERISTIC
/begin CHARACTERISTIC XZ_LDMBAB_ENBLSOURCE "" VALUE 0x1D960A _REC_S1VAL_1_u1_S2 3 _CNV_S_4_Enum_ESIGN_68_CM_S2 0 3 /end CHARACTERISTIC
/begin CHARACTERISTIC XZ_LDM_DYNAMIC2_SOURCE "" VALUE 0x1D960B _REC_S1VAL_1_u1_S2 2 _CNV_S_3_Enum_ESIGN_69_CM_S2 0 2 /end CHARACTERISTIC
/begin CHARACTERISTIC XZ_MEM1_MIN_ZKA "" VALUE 0x1D976C _REC_S1VAL_1_u1_S2 2 _CNV_R_R_Umr_1_zu_1_2_CM_S2 0 2 FORMAT "%2.0" /end CHARACTERISTIC
/begin CHARACTERISTIC XZ_MOTSTART_TYP_SIMULATE "" VALUE 0x1D9604 _REC_S1VAL_1_u1_S2 4 _CNV_S_5_Enum_EMOTS_226_CM_S2 0 4 /end CHARACTERISTIC
/begin CHARACTERISTIC XZ_M_COMPRISE_SSINITDEF "" VALUE 0x1D8F72 _REC_S1VAL_1_u1_S2 3 _CNV_R_R_Umr_1_zu_1_2_CM_S2 0 3 /end CHARACTERISTIC
/begin CHARACTERISTIC XZ_M_REKUPRS_DBM "" VALUE 0x1D8F44 _REC_S1VAL_1_u1_S2 2 _CNV_R_R_Umr_1_zu_1_2_CM_S2 0 2 FORMAT "%2.0" /end CHARACTERISTIC
/begin CHARACTERISTIC XZ_NMOMAXRED_SOURCE "" VALUE 0x1D95FD _REC_S1VAL_1_u1_S2 2 _CNV_S_3_Enum_ESIGN_69_CM_S2 0 2 /end CHARACTERISTIC
/begin CHARACTERISTIC XZ_POWERSWITCH_SOURCE "" VALUE 0x1D95FE _REC_S1VAL_1_u1_S2 2 _CNV_S_3_Enum_ESIGN_69_CM_S2 0 2 /end CHARACTERISTIC
/begin CHARACTERISTIC XZ_PRUEF_MODBEDEL_DBM "" VALUE 0x1D8F45 _REC_S1VAL_1_u1_S2 3 _CNV_R_R_Umr_1_zu_1_2_CM_S2 0 3 /end CHARACTERISTIC
/begin CHARACTERISTIC XZ_QS3_HSZIELKD_FLM "" VALUE 0x1D9646 _REC_S1VAL_1_u1_S2 255 _CNV_R_R_Umr_1_zu_1_2_CM_S2 0 255 /end CHARACTERISTIC
/begin CHARACTERISTIC XZ_QSHIFT_RSMAX_MODAFB "" VALUE 0x1D910C _REC_S1VAL_1_u1_S2 2 _CNV_S_3_Enum_EQSHI_177_CM_S2 0 2 /end CHARACTERISTIC
/begin CHARACTERISTIC XZ_RES_ANZAHL_QS3 "" VALUE 0x1D8F46 _REC_S1VAL_1_u1_S2 1 _CNV_R_R_Umr_1_zu_1_2_CM_S2 0 1 FORMAT "%2.0" /end CHARACTERISTIC
/begin CHARACTERISTIC XZ_SOURCE_NOTLAUF_AEP "" VALUE 0x1D95E8 _REC_S1VAL_1_u1_S2 2 _CNV_S_3_Enum_ESIGN_69_CM_S2 0 2 /end CHARACTERISTIC
/begin CHARACTERISTIC XZ_SOURCE_NOTLAUF_EM_HIGH "" VALUE 0x1D95E9 _REC_S1VAL_1_u1_S2 2 _CNV_S_3_Enum_ESIGN_69_CM_S2 0 2 /end CHARACTERISTIC
/begin CHARACTERISTIC XZ_SOURCE_NOTLAUF_EM_LOW "" VALUE 0x1D95EA _REC_S1VAL_1_u1_S2 2 _CNV_S_3_Enum_ESIGN_69_CM_S2 0 2 /end CHARACTERISTIC
/begin CHARACTERISTIC XZ_SOURCE_OVERRIDE_GANG "" VALUE 0x1D95FF _REC_S1VAL_1_u1_S2 4 _CNV_R_R_Umr_1_zu_1_2_CM_S2 0 4 FORMAT "%2.0" /end CHARACTERISTIC
/begin CHARACTERISTIC XZ_SPAREGEN_SOURCE "" VALUE 0x1D9606 _REC_S1VAL_1_u1_S2 2 _CNV_S_3_Enum_ESIGN_69_CM_S2 0 2 /end CHARACTERISTIC
/begin CHARACTERISTIC XZ_STATUS_ANTRIEB_FZG_BAB "" VALUE 0x1D978C _REC_S1VAL_1_u1_S2 255 _CNV_R_R_Umr_1_zu_1_2_CM_S2 0 255 FORMAT "%2.0" /end CHARACTERISTIC
/begin CHARACTERISTIC XZ_USE_BABAUS_SIGNAL "" VALUE 0x1D912E _REC_S1VAL_1_u1_S2 1 _CNV_S_2_Enum_EBABA_46_CM_S2 0 1 /end CHARACTERISTIC
/begin CHARACTERISTIC XZ_USE_SKLKORSOURCE "" VALUE 0x1D912B _REC_S1VAL_1_u1_S2 2 _CNV_S_3_Enum_ESKLK_98_CM_S2 0 2 /end CHARACTERISTIC
/begin CHARACTERISTIC XZ_VFZG_PLAUSI_SOURCE "" VALUE 0x1D9607 _REC_S1VAL_1_u1_S2 2 _CNV_S_3_Enum_ESIGN_69_CM_S2 0 2 /end CHARACTERISTIC
/begin CHARACTERISTIC XZ_WDKVIRT_SOURCE "" VALUE 0x1D9600 _REC_S1VAL_1_u1_S2 2 _CNV_S_3_Enum_ESIGN_69_CM_S2 0 2 /end CHARACTERISTIC
/begin CHARACTERISTIC XZ_ZKA_IDX_SSINITDEF "" VALUE 0x1D8F73 _REC_S1VAL_1_u1_S2 15 _CNV_R_R_Umr_1_zu_1_2_CM_S2 0 15 /end CHARACTERISTIC
/begin MEASUREMENT ZFEH_CarbHandler.st_f_ResponsePending "state of the OBD response handler 0=response sent without delay 1=response pending" UBYTE EH_STANDARD_S4_S3 1 100 0 1 ECU_ADDRESS 0xFFF8AD1C DISPLAY_IDENTIFIER st_f_ResponsePending.ZFEH_CarbHandler /end MEASUREMENT
/begin MEASUREMENT ZFEH_CvnCalculation.CompLength "already calculated length of CVN" ULONG EH_STANDARD_S4_S3 1 100 0 4294967295 ECU_ADDRESS 0xFFF8AD44 DISPLAY_IDENTIFIER CompLength.ZFEH_CvnCalculation /end MEASUREMENT
/begin MEASUREMENT ZFEH_CvnCalculation.Crc32 "CRC value of CRC calculation" ULONG EH_STANDARD_S4_S3 1 100 0 4294967295 ECU_ADDRESS 0xFFF8AD48 DISPLAY_IDENTIFIER Crc32.ZFEH_CvnCalculation /end MEASUREMENT
/begin MEASUREMENT ZFEH_CvnCalculation.CrcCompLength "max. length of data block" ULONG EH_STANDARD_S4_S3 1 100 0 4294967295 ECU_ADDRESS 0xFFF8AD3C DISPLAY_IDENTIFIER CrcCompLength.ZFEH_CvnCalculation /end MEASUREMENT
/begin MEASUREMENT ZFEH_CvnCalculation.Cvn "last calculated CVN" ULONG EH_STANDARD_S4_S3 1 100 0 4294967295 ECU_ADDRESS 0xFFF8AD38 DISPLAY_IDENTIFIER Cvn.ZFEH_CvnCalculation /end MEASUREMENT
/begin MEASUREMENT ZFEH_CvnCalculation.CvnState "State of CVN State machine" UBYTE EH_STANDARD_S4_S3 1 100 0 255 ECU_ADDRESS 0xFFF8AD4C DISPLAY_IDENTIFIER CvnState.ZFEH_CvnCalculation /end MEASUREMENT
/begin MEASUREMENT ZFEH_CvnCalculation.Length "Length data block to be computed" ULONG EH_STANDARD_S4_S3 1 100 0 4294967295 ECU_ADDRESS 0xFFF8AD40 DISPLAY_IDENTIFIER Length.ZFEH_CvnCalculation /end MEASUREMENT
/begin MEASUREMENT ZFEH_Diagnosis.ctl_CalibrateableTestCond "conditions for calibratable subst functions fulfilled" UWORD EH_STANDARD_S4_S3 1 100 0 65535 ECU_ADDRESS 0xFFF8ACCA DISPLAY_IDENTIFIER ctl_CalibrateableTestCond.ZFEH_Diagnosis /end MEASUREMENT
/begin MEASUREMENT ZFEH_Diagnosis.ctl_QuitSubstFunct "conditions for quitting subst functions fulfilled" UWORD EH_STANDARD_S4_S3 1 100 0 65535 ECU_ADDRESS 0xFFF8ACC8 DISPLAY_IDENTIFIER ctl_QuitSubstFunct.ZFEH_Diagnosis /end MEASUREMENT
/begin MEASUREMENT ZFEH_Diagnosis.gl_err_rea "all active fault-reactions and protection-reactions (lower 32 bit)" ULONG EH_STANDARD_S4_S3 1 100 0 4294967295 ECU_ADDRESS 0xFFF8ACC0 DISPLAY_IDENTIFIER gl_err_rea.ZFEH_Diagnosis /end MEASUREMENT
/begin MEASUREMENT ZFEH_Diagnosis.gl_err_rea_hi "all active fault-reactions and protection-reactions (upper 32 bit)" ULONG EH_STANDARD_S4_S3 1 100 0 4294967295 ECU_ADDRESS 0xFFF8ACC4 DISPLAY_IDENTIFIER gl_err_rea_hi.ZFEH_Diagnosis /end MEASUREMENT
/begin MEASUREMENT ZFEH_Eeprom.cnt_CheckEeData "Counts the calls of the function CheckEeData" UWORD EH_STANDARD_S4_S3 1 100 0 65535 ECU_ADDRESS 0xFFF8ACD2 DISPLAY_IDENTIFIER cnt_CheckEeData.ZFEH_Eeprom /end MEASUREMENT
/begin MEASUREMENT ZFEH_Eeprom.cnt_EEinit "Counts the calls of the Macro _SET_ZFEH_EEPROM_INIT_ZYKLISCH" UWORD EH_STANDARD_S4_S3 1 100 0 65535 ECU_ADDRESS 0xFFF8ACD0 DISPLAY_IDENTIFIER cnt_EEinit.ZFEH_Eeprom /end MEASUREMENT
/begin MEASUREMENT ZFEH_Eeprom.cnt_EEvalid "Counts the calls of the Macro _GET_ZFEH_EEPROM_VALID" UWORD EH_STANDARD_S4_S3 1 100 0 65535 ECU_ADDRESS 0xFFF8ACCC DISPLAY_IDENTIFIER cnt_EEvalid.ZFEH_Eeprom /end MEASUREMENT
/begin MEASUREMENT ZFEH_Eeprom.cnt_SetDefaultData "Counts the calls of the function SetDefaultData" UWORD EH_STANDARD_S4_S3 1 100 0 65535 ECU_ADDRESS 0xFFF8ACD6 DISPLAY_IDENTIFIER cnt_SetDefaultData.ZFEH_Eeprom /end MEASUREMENT
/begin MEASUREMENT ZFEH_Eeprom.cnt_SetDefaultDataIgnored "Counts the ignored calls of the function SetDefaultData" UWORD EH_STANDARD_S4_S3 1 100 0 65535 ECU_ADDRESS 0xFFF8ACD8 DISPLAY_IDENTIFIER cnt_SetDefaultDataIgnored.ZFEH_Eeprom /end MEASUREMENT
/begin MEASUREMENT ZFEH_Eeprom.st_CheckEeData "last state of the function CheckEeData" UBYTE EH_STANDARD_S4_S3 1 100 0 255 ECU_ADDRESS 0xFFF8ACD4 DISPLAY_IDENTIFIER st_CheckEeData.ZFEH_Eeprom /end MEASUREMENT
/begin MEASUREMENT ZFEH_Eeprom.st_EEvalid "Return value of the Macro _GET_ZFEH_EEPROM_VALID (VALID=1, INVALID=0)" UWORD EH_STANDARD_S4_S3 1 100 0 65535 ECU_ADDRESS 0xFFF8ACCE DISPLAY_IDENTIFIER st_EEvalid.ZFEH_Eeprom /end MEASUREMENT
/begin MEASUREMENT ZFEH_EepromData.di_obd_dc_specific_readiness[0] "driving cycle specific readiness information of the errors (bitcoded) [0 .. 16-1]" UWORD EH_STANDARD_S4_S3 1 100 0 65535 ECU_ADDRESS 0xFFF82CD0 DISPLAY_IDENTIFIER di_obd_dc_specific_readiness[0].ZFEH_EepromData /end MEASUREMENT
/begin MEASUREMENT ZFEH_EepromData.di_obd_dc_specific_readiness[10] "driving cycle specific readiness information of the errors (bitcoded) [0 .. 16-1]" UWORD EH_STANDARD_S4_S3 1 100 0 65535 ECU_ADDRESS 0xFFF82CE4 DISPLAY_IDENTIFIER di_obd_dc_specific_readiness[10].ZFEH_EepromData /end MEASUREMENT
/begin MEASUREMENT ZFEH_EepromData.di_obd_dc_specific_readiness[11] "driving cycle specific readiness information of the errors (bitcoded) [0 .. 16-1]" UWORD EH_STANDARD_S4_S3 1 100 0 65535 ECU_ADDRESS 0xFFF82CE6 DISPLAY_IDENTIFIER di_obd_dc_specific_readiness[11].ZFEH_EepromData /end MEASUREMENT
/begin MEASUREMENT ZFEH_EepromData.di_obd_dc_specific_readiness[12] "driving cycle specific readiness information of the errors (bitcoded) [0 .. 16-1]" UWORD EH_STANDARD_S4_S3 1 100 0 65535 ECU_ADDRESS 0xFFF82CE8 DISPLAY_IDENTIFIER di_obd_dc_specific_readiness[12].ZFEH_EepromData /end MEASUREMENT
/begin MEASUREMENT ZFEH_EepromData.di_obd_dc_specific_readiness[13] "driving cycle specific readiness information of the errors (bitcoded) [0 .. 16-1]" UWORD EH_STANDARD_S4_S3 1 100 0 65535 ECU_ADDRESS 0xFFF82CEA DISPLAY_IDENTIFIER di_obd_dc_specific_readiness[13].ZFEH_EepromData /end MEASUREMENT
/begin MEASUREMENT ZFEH_EepromData.di_obd_dc_specific_readiness[14] "driving cycle specific readiness information of the errors (bitcoded) [0 .. 16-1]" UWORD EH_STANDARD_S4_S3 1 100 0 65535 ECU_ADDRESS 0xFFF82CEC DISPLAY_IDENTIFIER di_obd_dc_specific_readiness[14].ZFEH_EepromData /end MEASUREMENT
/begin MEASUREMENT ZFEH_EepromData.di_obd_dc_specific_readiness[15] "driving cycle specific readiness information of the errors (bitcoded) [0 .. 16-1]" UWORD EH_STANDARD_S4_S3 1 100 0 65535 ECU_ADDRESS 0xFFF82CEE DISPLAY_IDENTIFIER di_obd_dc_specific_readiness[15].ZFEH_EepromData /end MEASUREMENT
/begin MEASUREMENT ZFEH_EepromData.di_obd_dc_specific_readiness[1] "driving cycle specific readiness information of the errors (bitcoded) [0 .. 16-1]" UWORD EH_STANDARD_S4_S3 1 100 0 65535 ECU_ADDRESS 0xFFF82CD2 DISPLAY_IDENTIFIER di_obd_dc_specific_readiness[1].ZFEH_EepromData /end MEASUREMENT
/begin MEASUREMENT ZFEH_EepromData.di_obd_dc_specific_readiness[2] "driving cycle specific readiness information of the errors (bitcoded) [0 .. 16-1]" UWORD EH_STANDARD_S4_S3 1 100 0 65535 ECU_ADDRESS 0xFFF82CD4 DISPLAY_IDENTIFIER di_obd_dc_specific_readiness[2].ZFEH_EepromData /end MEASUREMENT
/begin MEASUREMENT ZFEH_EepromData.di_obd_dc_specific_readiness[3] "driving cycle specific readiness information of the errors (bitcoded) [0 .. 16-1]" UWORD EH_STANDARD_S4_S3 1 100 0 65535 ECU_ADDRESS 0xFFF82CD6 DISPLAY_IDENTIFIER di_obd_dc_specific_readiness[3].ZFEH_EepromData /end MEASUREMENT
/begin MEASUREMENT ZFEH_EepromData.di_obd_dc_specific_readiness[4] "driving cycle specific readiness information of the errors (bitcoded) [0 .. 16-1]" UWORD EH_STANDARD_S4_S3 1 100 0 65535 ECU_ADDRESS 0xFFF82CD8 DISPLAY_IDENTIFIER di_obd_dc_specific_readiness[4].ZFEH_EepromData /end MEASUREMENT
/begin MEASUREMENT ZFEH_EepromData.di_obd_dc_specific_readiness[5] "driving cycle specific readiness information of the errors (bitcoded) [0 .. 16-1]" UWORD EH_STANDARD_S4_S3 1 100 0 65535 ECU_ADDRESS 0xFFF82CDA DISPLAY_IDENTIFIER di_obd_dc_specific_readiness[5].ZFEH_EepromData /end MEASUREMENT
/begin MEASUREMENT ZFEH_EepromData.di_obd_dc_specific_readiness[6] "driving cycle specific readiness information of the errors (bitcoded) [0 .. 16-1]" UWORD EH_STANDARD_S4_S3 1 100 0 65535 ECU_ADDRESS 0xFFF82CDC DISPLAY_IDENTIFIER di_obd_dc_specific_readiness[6].ZFEH_EepromData /end MEASUREMENT
/begin MEASUREMENT ZFEH_EepromData.di_obd_dc_specific_readiness[7] "driving cycle specific readiness information of the errors (bitcoded) [0 .. 16-1]" UWORD EH_STANDARD_S4_S3 1 100 0 65535 ECU_ADDRESS 0xFFF82CDE DISPLAY_IDENTIFIER di_obd_dc_specific_readiness[7].ZFEH_EepromData /end MEASUREMENT
/begin MEASUREMENT ZFEH_EepromData.di_obd_dc_specific_readiness[8] "driving cycle specific readiness information of the errors (bitcoded) [0 .. 16-1]" UWORD EH_STANDARD_S4_S3 1 100 0 65535 ECU_ADDRESS 0xFFF82CE0 DISPLAY_IDENTIFIER di_obd_dc_specific_readiness[8].ZFEH_EepromData /end MEASUREMENT
/begin MEASUREMENT ZFEH_EepromData.di_obd_dc_specific_readiness[9] "driving cycle specific readiness information of the errors (bitcoded) [0 .. 16-1]" UWORD EH_STANDARD_S4_S3 1 100 0 65535 ECU_ADDRESS 0xFFF82CE2 DISPLAY_IDENTIFIER di_obd_dc_specific_readiness[9].ZFEH_EepromData /end MEASUREMENT
/begin MEASUREMENT ZFEH_EepromData.di_obd_iumpr_comp_active_count[0] "error code related component active counter [0 .. 254-1]" UBYTE EH_STANDARD_S4_S3 1 100 0 255 ECU_ADDRESS 0xFFF83162 DISPLAY_IDENTIFIER di_obd_iumpr_comp_active_count[0].ZFEH_EepromData /end MEASUREMENT
/begin MEASUREMENT ZFEH_EepromData.di_obd_iumpr_comp_active_count[100] "error code related component active counter [0 .. 254-1]" UBYTE EH_STANDARD_S4_S3 1 100 0 255 ECU_ADDRESS 0xFFF831C6 DISPLAY_IDENTIFIER di_obd_iumpr_comp_active_count[100].ZFEH_EepromData /end MEASUREMENT
/begin MEASUREMENT ZFEH_EepromData.di_obd_iumpr_comp_active_count[101] "error code related component active counter [0 .. 254-1]" UBYTE EH_STANDARD_S4_S3 1 100 0 255 ECU_ADDRESS 0xFFF831C7 DISPLAY_IDENTIFIER di_obd_iumpr_comp_active_count[101].ZFEH_EepromData /end MEASUREMENT
/begin MEASUREMENT ZFEH_EepromData.di_obd_iumpr_comp_active_count[102] "error code related component active counter [0 .. 254-1]" UBYTE EH_STANDARD_S4_S3 1 100 0 255 ECU_ADDRESS 0xFFF831C8 DISPLAY_IDENTIFIER di_obd_iumpr_comp_active_count[102].ZFEH_EepromData /end MEASUREMENT
/begin MEASUREMENT ZFEH_EepromData.di_obd_iumpr_comp_active_count[103] "error code related component active counter [0 .. 254-1]" UBYTE EH_STANDARD_S4_S3 1 100 0 255 ECU_ADDRESS 0xFFF831C9 DISPLAY_IDENTIFIER di_obd_iumpr_comp_active_count[103].ZFEH_EepromData /end MEASUREMENT
/begin MEASUREMENT ZFEH_EepromData.di_obd_iumpr_comp_active_count[104] "error code related component active counter [0 .. 254-1]" UBYTE EH_STANDARD_S4_S3 1 100 0 255 ECU_ADDRESS 0xFFF831CA DISPLAY_IDENTIFIER di_obd_iumpr_comp_active_count[104].ZFEH_EepromData /end MEASUREMENT
/begin MEASUREMENT ZFEH_EepromData.di_obd_iumpr_comp_active_count[105] "error code related component active counter [0 .. 254-1]" UBYTE EH_STANDARD_S4_S3 1 100 0 255 ECU_ADDRESS 0xFFF831CB DISPLAY_IDENTIFIER di_obd_iumpr_comp_active_count[105].ZFEH_EepromData /end MEASUREMENT
/begin MEASUREMENT ZFEH_EepromData.di_obd_iumpr_comp_active_count[106] "error code related component active counter [0 .. 254-1]" UBYTE EH_STANDARD_S4_S3 1 100 0 255 ECU_ADDRESS 0xFFF831CC DISPLAY_IDENTIFIER di_obd_iumpr_comp_active_count[106].ZFEH_EepromData /end MEASUREMENT
/begin MEASUREMENT ZFEH_EepromData.di_obd_iumpr_comp_active_count[107] "error code related component active counter [0 .. 254-1]" UBYTE EH_STANDARD_S4_S3 1 100 0 255 ECU_ADDRESS 0xFFF831CD DISPLAY_IDENTIFIER di_obd_iumpr_comp_active_count[107].ZFEH_EepromData /end MEASUREMENT
/begin MEASUREMENT ZFEH_EepromData.di_obd_iumpr_comp_active_count[108] "error code related component active counter [0 .. 254-1]" UBYTE EH_STANDARD_S4_S3 1 100 0 255 ECU_ADDRESS 0xFFF831CE DISPLAY_IDENTIFIER di_obd_iumpr_comp_active_count[108].ZFEH_EepromData /end MEASUREMENT
/begin MEASUREMENT ZFEH_EepromData.di_obd_iumpr_comp_active_count[109] "error code related component active counter [0 .. 254-1]" UBYTE EH_STANDARD_S4_S3 1 100 0 255 ECU_ADDRESS 0xFFF831CF DISPLAY_IDENTIFIER di_obd_iumpr_comp_active_count[109].ZFEH_EepromData /end MEASUREMENT
/begin MEASUREMENT ZFEH_EepromData.di_obd_iumpr_comp_active_count[10] "error code related component active counter [0 .. 254-1]" UBYTE EH_STANDARD_S4_S3 1 100 0 255 ECU_ADDRESS 0xFFF8316C DISPLAY_IDENTIFIER di_obd_iumpr_comp_active_count[10].ZFEH_EepromData /end MEASUREMENT
/begin MEASUREMENT ZFEH_EepromData.di_obd_iumpr_comp_active_count[110] "error code related component active counter [0 .. 254-1]" UBYTE EH_STANDARD_S4_S3 1 100 0 255 ECU_ADDRESS 0xFFF831D0 DISPLAY_IDENTIFIER di_obd_iumpr_comp_active_count[110].ZFEH_EepromData /end MEASUREMENT
/begin MEASUREMENT ZFEH_EepromData.di_obd_iumpr_comp_active_count[111] "error code related component active counter [0 .. 254-1]" UBYTE EH_STANDARD_S4_S3 1 100 0 255 ECU_ADDRESS 0xFFF831D1 DISPLAY_IDENTIFIER di_obd_iumpr_comp_active_count[111].ZFEH_EepromData /end MEASUREMENT
/begin MEASUREMENT ZFEH_EepromData.di_obd_iumpr_comp_active_count[112] "error code related component active counter [0 .. 254-1]" UBYTE EH_STANDARD_S4_S3 1 100 0 255 ECU_ADDRESS 0xFFF831D2 DISPLAY_IDENTIFIER di_obd_iumpr_comp_active_count[112].ZFEH_EepromData /end MEASUREMENT
/begin MEASUREMENT ZFEH_EepromData.di_obd_iumpr_comp_active_count[113] "error code related component active counter [0 .. 254-1]" UBYTE EH_STANDARD_S4_S3 1 100 0 255 ECU_ADDRESS 0xFFF831D3 DISPLAY_IDENTIFIER di_obd_iumpr_comp_active_count[113].ZFEH_EepromData /end MEASUREMENT
/begin MEASUREMENT ZFEH_EepromData.di_obd_iumpr_comp_active_count[114] "error code related component active counter [0 .. 254-1]" UBYTE EH_STANDARD_S4_S3 1 100 0 255 ECU_ADDRESS 0xFFF831D4 DISPLAY_IDENTIFIER di_obd_iumpr_comp_active_count[114].ZFEH_EepromData /end MEASUREMENT
/begin MEASUREMENT ZFEH_EepromData.di_obd_iumpr_comp_active_count[115] "error code related component active counter [0 .. 254-1]" UBYTE EH_STANDARD_S4_S3 1 100 0 255 ECU_ADDRESS 0xFFF831D5 DISPLAY_IDENTIFIER di_obd_iumpr_comp_active_count[115].ZFEH_EepromData /end MEASUREMENT
/begin MEASUREMENT ZFEH_EepromData.di_obd_iumpr_comp_active_count[116] "error code related component active counter [0 .. 254-1]" UBYTE EH_STANDARD_S4_S3 1 100 0 255 ECU_ADDRESS 0xFFF831D6 DISPLAY_IDENTIFIER di_obd_iumpr_comp_active_count[116].ZFEH_EepromData /end MEASUREMENT
/begin MEASUREMENT ZFEH_EepromData.di_obd_iumpr_comp_active_count[117] "error code related component active counter [0 .. 254-1]" UBYTE EH_STANDARD_S4_S3 1 100 0 255 ECU_ADDRESS 0xFFF831D7 DISPLAY_IDENTIFIER di_obd_iumpr_comp_active_count[117].ZFEH_EepromData /end MEASUREMENT
/begin MEASUREMENT ZFEH_EepromData.di_obd_iumpr_comp_active_count[118] "error code related component active counter [0 .. 254-1]" UBYTE EH_STANDARD_S4_S3 1 100 0 255 ECU_ADDRESS 0xFFF831D8 DISPLAY_IDENTIFIER di_obd_iumpr_comp_active_count[118].ZFEH_EepromData /end MEASUREMENT
/begin MEASUREMENT ZFEH_EepromData.di_obd_iumpr_comp_active_count[119] "error code related component active counter [0 .. 254-1]" UBYTE EH_STANDARD_S4_S3 1 100 0 255 ECU_ADDRESS 0xFFF831D9 DISPLAY_IDENTIFIER di_obd_iumpr_comp_active_count[119].ZFEH_EepromData /end MEASUREMENT
/begin MEASUREMENT ZFEH_EepromData.di_obd_iumpr_comp_active_count[11] "error code related component active counter [0 .. 254-1]" UBYTE EH_STANDARD_S4_S3 1 100 0 255 ECU_ADDRESS 0xFFF8316D DISPLAY_IDENTIFIER di_obd_iumpr_comp_active_count[11].ZFEH_EepromData /end MEASUREMENT
/begin MEASUREMENT ZFEH_EepromData.di_obd_iumpr_comp_active_count[120] "error code related component active counter [0 .. 254-1]" UBYTE EH_STANDARD_S4_S3 1 100 0 255 ECU_ADDRESS 0xFFF831DA DISPLAY_IDENTIFIER di_obd_iumpr_comp_active_count[120].ZFEH_EepromData /end MEASUREMENT
/begin MEASUREMENT ZFEH_EepromData.di_obd_iumpr_comp_active_count[121] "error code related component active counter [0 .. 254-1]" UBYTE EH_STANDARD_S4_S3 1 100 0 255 ECU_ADDRESS 0xFFF831DB DISPLAY_IDENTIFIER di_obd_iumpr_comp_active_count[121].ZFEH_EepromData /end MEASUREMENT
/begin MEASUREMENT ZFEH_EepromData.di_obd_iumpr_comp_active_count[122] "error code related component active counter [0 .. 254-1]" UBYTE EH_STANDARD_S4_S3 1 100 0 255 ECU_ADDRESS 0xFFF831DC DISPLAY_IDENTIFIER di_obd_iumpr_comp_active_count[122].ZFEH_EepromData /end MEASUREMENT
/begin MEASUREMENT ZFEH_EepromData.di_obd_iumpr_comp_active_count[123] "error code related component active counter [0 .. 254-1]" UBYTE EH_STANDARD_S4_S3 1 100 0 255 ECU_ADDRESS 0xFFF831DD DISPLAY_IDENTIFIER di_obd_iumpr_comp_active_count[123].ZFEH_EepromData /end MEASUREMENT
/begin MEASUREMENT ZFEH_EepromData.di_obd_iumpr_comp_active_count[124] "error code related component active counter [0 .. 254-1]" UBYTE EH_STANDARD_S4_S3 1 100 0 255 ECU_ADDRESS 0xFFF831DE DISPLAY_IDENTIFIER di_obd_iumpr_comp_active_count[124].ZFEH_EepromData /end MEASUREMENT
/begin MEASUREMENT ZFEH_EepromData.di_obd_iumpr_comp_active_count[125] "error code related component active counter [0 .. 254-1]" UBYTE EH_STANDARD_S4_S3 1 100 0 255 ECU_ADDRESS 0xFFF831DF DISPLAY_IDENTIFIER di_obd_iumpr_comp_active_count[125].ZFEH_EepromData /end MEASUREMENT
/begin MEASUREMENT ZFEH_EepromData.di_obd_iumpr_comp_active_count[126] "error code related component active counter [0 .. 254-1]" UBYTE EH_STANDARD_S4_S3 1 100 0 255 ECU_ADDRESS 0xFFF831E0 DISPLAY_IDENTIFIER di_obd_iumpr_comp_active_count[126].ZFEH_EepromData /end MEASUREMENT
/begin MEASUREMENT ZFEH_EepromData.di_obd_iumpr_comp_active_count[127] "error code related component active counter [0 .. 254-1]" UBYTE EH_STANDARD_S4_S3 1 100 0 255 ECU_ADDRESS 0xFFF831E1 DISPLAY_IDENTIFIER di_obd_iumpr_comp_active_count[127].ZFEH_EepromData /end MEASUREMENT
/begin MEASUREMENT ZFEH_EepromData.di_obd_iumpr_comp_active_count[128] "error code related component active counter [0 .. 254-1]" UBYTE EH_STANDARD_S4_S3 1 100 0 255 ECU_ADDRESS 0xFFF831E2 DISPLAY_IDENTIFIER di_obd_iumpr_comp_active_count[128].ZFEH_EepromData /end MEASUREMENT
/begin MEASUREMENT ZFEH_EepromData.di_obd_iumpr_comp_active_count[129] "error code related component active counter [0 .. 254-1]" UBYTE EH_STANDARD_S4_S3 1 100 0 255 ECU_ADDRESS 0xFFF831E3 DISPLAY_IDENTIFIER di_obd_iumpr_comp_active_count[129].ZFEH_EepromData /end MEASUREMENT
/begin MEASUREMENT ZFEH_EepromData.di_obd_iumpr_comp_active_count[12] "error code related component active counter [0 .. 254-1]" UBYTE EH_STANDARD_S4_S3 1 100 0 255 ECU_ADDRESS 0xFFF8316E DISPLAY_IDENTIFIER di_obd_iumpr_comp_active_count[12].ZFEH_EepromData /end MEASUREMENT
/begin MEASUREMENT ZFEH_EepromData.di_obd_iumpr_comp_active_count[130] "error code related component active counter [0 .. 254-1]" UBYTE EH_STANDARD_S4_S3 1 100 0 255 ECU_ADDRESS 0xFFF831E4 DISPLAY_IDENTIFIER di_obd_iumpr_comp_active_count[130].ZFEH_EepromData /end MEASUREMENT
/begin MEASUREMENT ZFEH_EepromData.di_obd_iumpr_comp_active_count[131] "error code related component active counter [0 .. 254-1]" UBYTE EH_STANDARD_S4_S3 1 100 0 255 ECU_ADDRESS 0xFFF831E5 DISPLAY_IDENTIFIER di_obd_iumpr_comp_active_count[131].ZFEH_EepromData /end MEASUREMENT
/begin MEASUREMENT ZFEH_EepromData.di_obd_iumpr_comp_active_count[132] "error code related component active counter [0 .. 254-1]" UBYTE EH_STANDARD_S4_S3 1 100 0 255 ECU_ADDRESS 0xFFF831E6 DISPLAY_IDENTIFIER di_obd_iumpr_comp_active_count[132].ZFEH_EepromData /end MEASUREMENT
/begin MEASUREMENT ZFEH_EepromData.di_obd_iumpr_comp_active_count[133] "error code related component active counter [0 .. 254-1]" UBYTE EH_STANDARD_S4_S3 1 100 0 255 ECU_ADDRESS 0xFFF831E7 DISPLAY_IDENTIFIER di_obd_iumpr_comp_active_count[133].ZFEH_EepromData /end MEASUREMENT
/begin MEASUREMENT ZFEH_EepromData.di_obd_iumpr_comp_active_count[134] "error code related component active counter [0 .. 254-1]" UBYTE EH_STANDARD_S4_S3 1 100 0 255 ECU_ADDRESS 0xFFF831E8 DISPLAY_IDENTIFIER di_obd_iumpr_comp_active_count[134].ZFEH_EepromData /end MEASUREMENT
/begin MEASUREMENT ZFEH_EepromData.di_obd_iumpr_comp_active_count[135] "error code related component active counter [0 .. 254-1]" UBYTE EH_STANDARD_S4_S3 1 100 0 255 ECU_ADDRESS 0xFFF831E9 DISPLAY_IDENTIFIER di_obd_iumpr_comp_active_count[135].ZFEH_EepromData /end MEASUREMENT
/begin MEASUREMENT ZFEH_EepromData.di_obd_iumpr_comp_active_count[136] "error code related component active counter [0 .. 254-1]" UBYTE EH_STANDARD_S4_S3 1 100 0 255 ECU_ADDRESS 0xFFF831EA DISPLAY_IDENTIFIER di_obd_iumpr_comp_active_count[136].ZFEH_EepromData /end MEASUREMENT
/begin MEASUREMENT ZFEH_EepromData.di_obd_iumpr_comp_active_count[137] "error code related component active counter [0 .. 254-1]" UBYTE EH_STANDARD_S4_S3 1 100 0 255 ECU_ADDRESS 0xFFF831EB DISPLAY_IDENTIFIER di_obd_iumpr_comp_active_count[137].ZFEH_EepromData /end MEASUREMENT
/begin MEASUREMENT ZFEH_EepromData.di_obd_iumpr_comp_active_count[138] "error code related component active counter [0 .. 254-1]" UBYTE EH_STANDARD_S4_S3 1 100 0 255 ECU_ADDRESS 0xFFF831EC DISPLAY_IDENTIFIER di_obd_iumpr_comp_active_count[138].ZFEH_EepromData /end MEASUREMENT
/begin MEASUREMENT ZFEH_EepromData.di_obd_iumpr_comp_active_count[139] "error code related component active counter [0 .. 254-1]" UBYTE EH_STANDARD_S4_S3 1 100 0 255 ECU_ADDRESS 0xFFF831ED DISPLAY_IDENTIFIER di_obd_iumpr_comp_active_count[139].ZFEH_EepromData /end MEASUREMENT
/begin MEASUREMENT ZFEH_EepromData.di_obd_iumpr_comp_active_count[13] "error code related component active counter [0 .. 254-1]" UBYTE EH_STANDARD_S4_S3 1 100 0 255 ECU_ADDRESS 0xFFF8316F DISPLAY_IDENTIFIER di_obd_iumpr_comp_active_count[13].ZFEH_EepromData /end MEASUREMENT
/begin MEASUREMENT ZFEH_EepromData.di_obd_iumpr_comp_active_count[140] "error code related component active counter [0 .. 254-1]" UBYTE EH_STANDARD_S4_S3 1 100 0 255 ECU_ADDRESS 0xFFF831EE DISPLAY_IDENTIFIER di_obd_iumpr_comp_active_count[140].ZFEH_EepromData /end MEASUREMENT
/begin MEASUREMENT ZFEH_EepromData.di_obd_iumpr_comp_active_count[141] "error code related component active counter [0 .. 254-1]" UBYTE EH_STANDARD_S4_S3 1 100 0 255 ECU_ADDRESS 0xFFF831EF DISPLAY_IDENTIFIER di_obd_iumpr_comp_active_count[141].ZFEH_EepromData /end MEASUREMENT
/begin MEASUREMENT ZFEH_EepromData.di_obd_iumpr_comp_active_count[142] "error code related component active counter [0 .. 254-1]" UBYTE EH_STANDARD_S4_S3 1 100 0 255 ECU_ADDRESS 0xFFF831F0 DISPLAY_IDENTIFIER di_obd_iumpr_comp_active_count[142].ZFEH_EepromData /end MEASUREMENT
/begin MEASUREMENT ZFEH_EepromData.di_obd_iumpr_comp_active_count[143] "error code related component active counter [0 .. 254-1]" UBYTE EH_STANDARD_S4_S3 1 100 0 255 ECU_ADDRESS 0xFFF831F1 DISPLAY_IDENTIFIER di_obd_iumpr_comp_active_count[143].ZFEH_EepromData /end MEASUREMENT
/begin MEASUREMENT ZFEH_EepromData.di_obd_iumpr_comp_active_count[144] "error code related component active counter [0 .. 254-1]" UBYTE EH_STANDARD_S4_S3 1 100 0 255 ECU_ADDRESS 0xFFF831F2 DISPLAY_IDENTIFIER di_obd_iumpr_comp_active_count[144].ZFEH_EepromData /end MEASUREMENT
/begin MEASUREMENT ZFEH_EepromData.di_obd_iumpr_comp_active_count[145] "error code related component active counter [0 .. 254-1]" UBYTE EH_STANDARD_S4_S3 1 100 0 255 ECU_ADDRESS 0xFFF831F3 DISPLAY_IDENTIFIER di_obd_iumpr_comp_active_count[145].ZFEH_EepromData /end MEASUREMENT
/begin MEASUREMENT ZFEH_EepromData.di_obd_iumpr_comp_active_count[146] "error code related component active counter [0 .. 254-1]" UBYTE EH_STANDARD_S4_S3 1 100 0 255 ECU_ADDRESS 0xFFF831F4 DISPLAY_IDENTIFIER di_obd_iumpr_comp_active_count[146].ZFEH_EepromData /end MEASUREMENT
/begin MEASUREMENT ZFEH_EepromData.di_obd_iumpr_comp_active_count[147] "error code related component active counter [0 .. 254-1]" UBYTE EH_STANDARD_S4_S3 1 100 0 255 ECU_ADDRESS 0xFFF831F5 DISPLAY_IDENTIFIER di_obd_iumpr_comp_active_count[147].ZFEH_EepromData /end MEASUREMENT
/begin MEASUREMENT ZFEH_EepromData.di_obd_iumpr_comp_active_count[148] "error code related component active counter [0 .. 254-1]" UBYTE EH_STANDARD_S4_S3 1 100 0 255 ECU_ADDRESS 0xFFF831F6 DISPLAY_IDENTIFIER di_obd_iumpr_comp_active_count[148].ZFEH_EepromData /end MEASUREMENT
/begin MEASUREMENT ZFEH_EepromData.di_obd_iumpr_comp_active_count[149] "error code related component active counter [0 .. 254-1]" UBYTE EH_STANDARD_S4_S3 1 100 0 255 ECU_ADDRESS 0xFFF831F7 DISPLAY_IDENTIFIER di_obd_iumpr_comp_active_count[149].ZFEH_EepromData /end MEASUREMENT
/begin MEASUREMENT ZFEH_EepromData.di_obd_iumpr_comp_active_count[14] "error code related component active counter [0 .. 254-1]" UBYTE EH_STANDARD_S4_S3 1 100 0 255 ECU_ADDRESS 0xFFF83170 DISPLAY_IDENTIFIER di_obd_iumpr_comp_active_count[14].ZFEH_EepromData /end MEASUREMENT
/begin MEASUREMENT ZFEH_EepromData.di_obd_iumpr_comp_active_count[150] "error code related component active counter [0 .. 254-1]" UBYTE EH_STANDARD_S4_S3 1 100 0 255 ECU_ADDRESS 0xFFF831F8 DISPLAY_IDENTIFIER di_obd_iumpr_comp_active_count[150].ZFEH_EepromData /end MEASUREMENT
/begin MEASUREMENT ZFEH_EepromData.di_obd_iumpr_comp_active_count[151] "error code related component active counter [0 .. 254-1]" UBYTE EH_STANDARD_S4_S3 1 100 0 255 ECU_ADDRESS 0xFFF831F9 DISPLAY_IDENTIFIER di_obd_iumpr_comp_active_count[151].ZFEH_EepromData /end MEASUREMENT
/begin MEASUREMENT ZFEH_EepromData.di_obd_iumpr_comp_active_count[152] "error code related component active counter [0 .. 254-1]" UBYTE EH_STANDARD_S4_S3 1 100 0 255 ECU_ADDRESS 0xFFF831FA DISPLAY_IDENTIFIER di_obd_iumpr_comp_active_count[152].ZFEH_EepromData /end MEASUREMENT
/begin MEASUREMENT ZFEH_EepromData.di_obd_iumpr_comp_active_count[153] "error code related component active counter [0 .. 254-1]" UBYTE EH_STANDARD_S4_S3 1 100 0 255 ECU_ADDRESS 0xFFF831FB DISPLAY_IDENTIFIER di_obd_iumpr_comp_active_count[153].ZFEH_EepromData /end MEASUREMENT
/begin MEASUREMENT ZFEH_EepromData.di_obd_iumpr_comp_active_count[154] "error code related component active counter [0 .. 254-1]" UBYTE EH_STANDARD_S4_S3 1 100 0 255 ECU_ADDRESS 0xFFF831FC DISPLAY_IDENTIFIER di_obd_iumpr_comp_active_count[154].ZFEH_EepromData /end MEASUREMENT
/begin MEASUREMENT ZFEH_EepromData.di_obd_iumpr_comp_active_count[155] "error code related component active counter [0 .. 254-1]" UBYTE EH_STANDARD_S4_S3 1 100 0 255 ECU_ADDRESS 0xFFF831FD DISPLAY_IDENTIFIER di_obd_iumpr_comp_active_count[155].ZFEH_EepromData /end MEASUREMENT
/begin MEASUREMENT ZFEH_EepromData.di_obd_iumpr_comp_active_count[156] "error code related component active counter [0 .. 254-1]" UBYTE EH_STANDARD_S4_S3 1 100 0 255 ECU_ADDRESS 0xFFF831FE DISPLAY_IDENTIFIER di_obd_iumpr_comp_active_count[156].ZFEH_EepromData /end MEASUREMENT
/begin MEASUREMENT ZFEH_EepromData.di_obd_iumpr_comp_active_count[157] "error code related component active counter [0 .. 254-1]" UBYTE EH_STANDARD_S4_S3 1 100 0 255 ECU_ADDRESS 0xFFF831FF DISPLAY_IDENTIFIER di_obd_iumpr_comp_active_count[157].ZFEH_EepromData /end MEASUREMENT
/begin MEASUREMENT ZFEH_EepromData.di_obd_iumpr_comp_active_count[158] "error code related component active counter [0 .. 254-1]" UBYTE EH_STANDARD_S4_S3 1 100 0 255 ECU_ADDRESS 0xFFF83200 DISPLAY_IDENTIFIER di_obd_iumpr_comp_active_count[158].ZFEH_EepromData /end MEASUREMENT
/begin MEASUREMENT ZFEH_EepromData.di_obd_iumpr_comp_active_count[159] "error code related component active counter [0 .. 254-1]" UBYTE EH_STANDARD_S4_S3 1 100 0 255 ECU_ADDRESS 0xFFF83201 DISPLAY_IDENTIFIER di_obd_iumpr_comp_active_count[159].ZFEH_EepromData /end MEASUREMENT
/begin MEASUREMENT ZFEH_EepromData.di_obd_iumpr_comp_active_count[15] "error code related component active counter [0 .. 254-1]" UBYTE EH_STANDARD_S4_S3 1 100 0 255 ECU_ADDRESS 0xFFF83171 DISPLAY_IDENTIFIER di_obd_iumpr_comp_active_count[15].ZFEH_EepromData /end MEASUREMENT
/begin MEASUREMENT ZFEH_EepromData.di_obd_iumpr_comp_active_count[160] "error code related component active counter [0 .. 254-1]" UBYTE EH_STANDARD_S4_S3 1 100 0 255 ECU_ADDRESS 0xFFF83202 DISPLAY_IDENTIFIER di_obd_iumpr_comp_active_count[160].ZFEH_EepromData /end MEASUREMENT
/begin MEASUREMENT ZFEH_EepromData.di_obd_iumpr_comp_active_count[161] "error code related component active counter [0 .. 254-1]" UBYTE EH_STANDARD_S4_S3 1 100 0 255 ECU_ADDRESS 0xFFF83203 DISPLAY_IDENTIFIER di_obd_iumpr_comp_active_count[161].ZFEH_EepromData /end MEASUREMENT
/begin MEASUREMENT ZFEH_EepromData.di_obd_iumpr_comp_active_count[162] "error code related component active counter [0 .. 254-1]" UBYTE EH_STANDARD_S4_S3 1 100 0 255 ECU_ADDRESS 0xFFF83204 DISPLAY_IDENTIFIER di_obd_iumpr_comp_active_count[162].ZFEH_EepromData /end MEASUREMENT
/begin MEASUREMENT ZFEH_EepromData.di_obd_iumpr_comp_active_count[163] "error code related component active counter [0 .. 254-1]" UBYTE EH_STANDARD_S4_S3 1 100 0 255 ECU_ADDRESS 0xFFF83205 DISPLAY_IDENTIFIER di_obd_iumpr_comp_active_count[163].ZFEH_EepromData /end MEASUREMENT
/begin MEASUREMENT ZFEH_EepromData.di_obd_iumpr_comp_active_count[164] "error code related component active counter [0 .. 254-1]" UBYTE EH_STANDARD_S4_S3 1 100 0 255 ECU_ADDRESS 0xFFF83206 DISPLAY_IDENTIFIER di_obd_iumpr_comp_active_count[164].ZFEH_EepromData /end MEASUREMENT
/begin MEASUREMENT ZFEH_EepromData.di_obd_iumpr_comp_active_count[165] "error code related component active counter [0 .. 254-1]" UBYTE EH_STANDARD_S4_S3 1 100 0 255 ECU_ADDRESS 0xFFF83207 DISPLAY_IDENTIFIER di_obd_iumpr_comp_active_count[165].ZFEH_EepromData /end MEASUREMENT
/begin MEASUREMENT ZFEH_EepromData.di_obd_iumpr_comp_active_count[166] "error code related component active counter [0 .. 254-1]" UBYTE EH_STANDARD_S4_S3 1 100 0 255 ECU_ADDRESS 0xFFF83208 DISPLAY_IDENTIFIER di_obd_iumpr_comp_active_count[166].ZFEH_EepromData /end MEASUREMENT
/begin MEASUREMENT ZFEH_EepromData.di_obd_iumpr_comp_active_count[167] "error code related component active counter [0 .. 254-1]" UBYTE EH_STANDARD_S4_S3 1 100 0 255 ECU_ADDRESS 0xFFF83209 DISPLAY_IDENTIFIER di_obd_iumpr_comp_active_count[167].ZFEH_EepromData /end MEASUREMENT
/begin MEASUREMENT ZFEH_EepromData.di_obd_iumpr_comp_active_count[168] "error code related component active counter [0 .. 254-1]" UBYTE EH_STANDARD_S4_S3 1 100 0 255 ECU_ADDRESS 0xFFF8320A DISPLAY_IDENTIFIER di_obd_iumpr_comp_active_count[168].ZFEH_EepromData /end MEASUREMENT
/begin MEASUREMENT ZFEH_EepromData.di_obd_iumpr_comp_active_count[169] "error code related component active counter [0 .. 254-1]" UBYTE EH_STANDARD_S4_S3 1 100 0 255 ECU_ADDRESS 0xFFF8320B DISPLAY_IDENTIFIER di_obd_iumpr_comp_active_count[169].ZFEH_EepromData /end MEASUREMENT
/begin MEASUREMENT ZFEH_EepromData.di_obd_iumpr_comp_active_count[16] "error code related component active counter [0 .. 254-1]" UBYTE EH_STANDARD_S4_S3 1 100 0 255 ECU_ADDRESS 0xFFF83172 DISPLAY_IDENTIFIER di_obd_iumpr_comp_active_count[16].ZFEH_EepromData /end MEASUREMENT
/begin MEASUREMENT ZFEH_EepromData.di_obd_iumpr_comp_active_count[170] "error code related component active counter [0 .. 254-1]" UBYTE EH_STANDARD_S4_S3 1 100 0 255 ECU_ADDRESS 0xFFF8320C DISPLAY_IDENTIFIER di_obd_iumpr_comp_active_count[170].ZFEH_EepromData /end MEASUREMENT
/begin MEASUREMENT ZFEH_EepromData.di_obd_iumpr_comp_active_count[171] "error code related component active counter [0 .. 254-1]" UBYTE EH_STANDARD_S4_S3 1 100 0 255 ECU_ADDRESS 0xFFF8320D DISPLAY_IDENTIFIER di_obd_iumpr_comp_active_count[171].ZFEH_EepromData /end MEASUREMENT
/begin MEASUREMENT ZFEH_EepromData.di_obd_iumpr_comp_active_count[172] "error code related component active counter [0 .. 254-1]" UBYTE EH_STANDARD_S4_S3 1 100 0 255 ECU_ADDRESS 0xFFF8320E DISPLAY_IDENTIFIER di_obd_iumpr_comp_active_count[172].ZFEH_EepromData /end MEASUREMENT
/begin MEASUREMENT ZFEH_EepromData.di_obd_iumpr_comp_active_count[173] "error code related component active counter [0 .. 254-1]" UBYTE EH_STANDARD_S4_S3 1 100 0 255 ECU_ADDRESS 0xFFF8320F DISPLAY_IDENTIFIER di_obd_iumpr_comp_active_count[173].ZFEH_EepromData /end MEASUREMENT
/begin MEASUREMENT ZFEH_EepromData.di_obd_iumpr_comp_active_count[174] "error code related component active counter [0 .. 254-1]" UBYTE EH_STANDARD_S4_S3 1 100 0 255 ECU_ADDRESS 0xFFF83210 DISPLAY_IDENTIFIER di_obd_iumpr_comp_active_count[174].ZFEH_EepromData /end MEASUREMENT
/begin MEASUREMENT ZFEH_EepromData.di_obd_iumpr_comp_active_count[175] "error code related component active counter [0 .. 254-1]" UBYTE EH_STANDARD_S4_S3 1 100 0 255 ECU_ADDRESS 0xFFF83211 DISPLAY_IDENTIFIER di_obd_iumpr_comp_active_count[175].ZFEH_EepromData /end MEASUREMENT
/begin MEASUREMENT ZFEH_EepromData.di_obd_iumpr_comp_active_count[176] "error code related component active counter [0 .. 254-1]" UBYTE EH_STANDARD_S4_S3 1 100 0 255 ECU_ADDRESS 0xFFF83212 DISPLAY_IDENTIFIER di_obd_iumpr_comp_active_count[176].ZFEH_EepromData /end MEASUREMENT
/begin MEASUREMENT ZFEH_EepromData.di_obd_iumpr_comp_active_count[177] "error code related component active counter [0 .. 254-1]" UBYTE EH_STANDARD_S4_S3 1 100 0 255 ECU_ADDRESS 0xFFF83213 DISPLAY_IDENTIFIER di_obd_iumpr_comp_active_count[177].ZFEH_EepromData /end MEASUREMENT
/begin MEASUREMENT ZFEH_EepromData.di_obd_iumpr_comp_active_count[178] "error code related component active counter [0 .. 254-1]" UBYTE EH_STANDARD_S4_S3 1 100 0 255 ECU_ADDRESS 0xFFF83214 DISPLAY_IDENTIFIER di_obd_iumpr_comp_active_count[178].ZFEH_EepromData /end MEASUREMENT
/begin MEASUREMENT ZFEH_EepromData.di_obd_iumpr_comp_active_count[179] "error code related component active counter [0 .. 254-1]" UBYTE EH_STANDARD_S4_S3 1 100 0 255 ECU_ADDRESS 0xFFF83215 DISPLAY_IDENTIFIER di_obd_iumpr_comp_active_count[179].ZFEH_EepromData /end MEASUREMENT
/begin MEASUREMENT ZFEH_EepromData.di_obd_iumpr_comp_active_count[17] "error code related component active counter [0 .. 254-1]" UBYTE EH_STANDARD_S4_S3 1 100 0 255 ECU_ADDRESS 0xFFF83173 DISPLAY_IDENTIFIER di_obd_iumpr_comp_active_count[17].ZFEH_EepromData /end MEASUREMENT
/begin MEASUREMENT ZFEH_EepromData.di_obd_iumpr_comp_active_count[180] "error code related component active counter [0 .. 254-1]" UBYTE EH_STANDARD_S4_S3 1 100 0 255 ECU_ADDRESS 0xFFF83216 DISPLAY_IDENTIFIER di_obd_iumpr_comp_active_count[180].ZFEH_EepromData /end MEASUREMENT
/begin MEASUREMENT ZFEH_EepromData.di_obd_iumpr_comp_active_count[181] "error code related component active counter [0 .. 254-1]" UBYTE EH_STANDARD_S4_S3 1 100 0 255 ECU_ADDRESS 0xFFF83217 DISPLAY_IDENTIFIER di_obd_iumpr_comp_active_count[181].ZFEH_EepromData /end MEASUREMENT
/begin MEASUREMENT ZFEH_EepromData.di_obd_iumpr_comp_active_count[182] "error code related component active counter [0 .. 254-1]" UBYTE EH_STANDARD_S4_S3 1 100 0 255 ECU_ADDRESS 0xFFF83218 DISPLAY_IDENTIFIER di_obd_iumpr_comp_active_count[182].ZFEH_EepromData /end MEASUREMENT
/begin MEASUREMENT ZFEH_EepromData.di_obd_iumpr_comp_active_count[183] "error code related component active counter [0 .. 254-1]" UBYTE EH_STANDARD_S4_S3 1 100 0 255 ECU_ADDRESS 0xFFF83219 DISPLAY_IDENTIFIER di_obd_iumpr_comp_active_count[183].ZFEH_EepromData /end MEASUREMENT
/begin MEASUREMENT ZFEH_EepromData.di_obd_iumpr_comp_active_count[184] "error code related component active counter [0 .. 254-1]" UBYTE EH_STANDARD_S4_S3 1 100 0 255 ECU_ADDRESS 0xFFF8321A DISPLAY_IDENTIFIER di_obd_iumpr_comp_active_count[184].ZFEH_EepromData /end MEASUREMENT
/begin MEASUREMENT ZFEH_EepromData.di_obd_iumpr_comp_active_count[185] "error code related component active counter [0 .. 254-1]" UBYTE EH_STANDARD_S4_S3 1 100 0 255 ECU_ADDRESS 0xFFF8321B DISPLAY_IDENTIFIER di_obd_iumpr_comp_active_count[185].ZFEH_EepromData /end MEASUREMENT
/begin MEASUREMENT ZFEH_EepromData.di_obd_iumpr_comp_active_count[186] "error code related component active counter [0 .. 254-1]" UBYTE EH_STANDARD_S4_S3 1 100 0 255 ECU_ADDRESS 0xFFF8321C DISPLAY_IDENTIFIER di_obd_iumpr_comp_active_count[186].ZFEH_EepromData /end MEASUREMENT
/begin MEASUREMENT ZFEH_EepromData.di_obd_iumpr_comp_active_count[187] "error code related component active counter [0 .. 254-1]" UBYTE EH_STANDARD_S4_S3 1 100 0 255 ECU_ADDRESS 0xFFF8321D DISPLAY_IDENTIFIER di_obd_iumpr_comp_active_count[187].ZFEH_EepromData /end MEASUREMENT
/begin MEASUREMENT ZFEH_EepromData.di_obd_iumpr_comp_active_count[188] "error code related component active counter [0 .. 254-1]" UBYTE EH_STANDARD_S4_S3 1 100 0 255 ECU_ADDRESS 0xFFF8321E DISPLAY_IDENTIFIER di_obd_iumpr_comp_active_count[188].ZFEH_EepromData /end MEASUREMENT
/begin MEASUREMENT ZFEH_EepromData.di_obd_iumpr_comp_active_count[189] "error code related component active counter [0 .. 254-1]" UBYTE EH_STANDARD_S4_S3 1 100 0 255 ECU_ADDRESS 0xFFF8321F DISPLAY_IDENTIFIER di_obd_iumpr_comp_active_count[189].ZFEH_EepromData /end MEASUREMENT
/begin MEASUREMENT ZFEH_EepromData.di_obd_iumpr_comp_active_count[18] "error code related component active counter [0 .. 254-1]" UBYTE EH_STANDARD_S4_S3 1 100 0 255 ECU_ADDRESS 0xFFF83174 DISPLAY_IDENTIFIER di_obd_iumpr_comp_active_count[18].ZFEH_EepromData /end MEASUREMENT
/begin MEASUREMENT ZFEH_EepromData.di_obd_iumpr_comp_active_count[190] "error code related component active counter [0 .. 254-1]" UBYTE EH_STANDARD_S4_S3 1 100 0 255 ECU_ADDRESS 0xFFF83220 DISPLAY_IDENTIFIER di_obd_iumpr_comp_active_count[190].ZFEH_EepromData /end MEASUREMENT
/begin MEASUREMENT ZFEH_EepromData.di_obd_iumpr_comp_active_count[191] "error code related component active counter [0 .. 254-1]" UBYTE EH_STANDARD_S4_S3 1 100 0 255 ECU_ADDRESS 0xFFF83221 DISPLAY_IDENTIFIER di_obd_iumpr_comp_active_count[191].ZFEH_EepromData /end MEASUREMENT
/begin MEASUREMENT ZFEH_EepromData.di_obd_iumpr_comp_active_count[192] "error code related component active counter [0 .. 254-1]" UBYTE EH_STANDARD_S4_S3 1 100 0 255 ECU_ADDRESS 0xFFF83222 DISPLAY_IDENTIFIER di_obd_iumpr_comp_active_count[192].ZFEH_EepromData /end MEASUREMENT
/begin MEASUREMENT ZFEH_EepromData.di_obd_iumpr_comp_active_count[193] "error code related component active counter [0 .. 254-1]" UBYTE EH_STANDARD_S4_S3 1 100 0 255 ECU_ADDRESS 0xFFF83223 DISPLAY_IDENTIFIER di_obd_iumpr_comp_active_count[193].ZFEH_EepromData /end MEASUREMENT
/begin MEASUREMENT ZFEH_EepromData.di_obd_iumpr_comp_active_count[194] "error code related component active counter [0 .. 254-1]" UBYTE EH_STANDARD_S4_S3 1 100 0 255 ECU_ADDRESS 0xFFF83224 DISPLAY_IDENTIFIER di_obd_iumpr_comp_active_count[194].ZFEH_EepromData /end MEASUREMENT
/begin MEASUREMENT ZFEH_EepromData.di_obd_iumpr_comp_active_count[195] "error code related component active counter [0 .. 254-1]" UBYTE EH_STANDARD_S4_S3 1 100 0 255 ECU_ADDRESS 0xFFF83225 DISPLAY_IDENTIFIER di_obd_iumpr_comp_active_count[195].ZFEH_EepromData /end MEASUREMENT
/begin MEASUREMENT ZFEH_EepromData.di_obd_iumpr_comp_active_count[196] "error code related component active counter [0 .. 254-1]" UBYTE EH_STANDARD_S4_S3 1 100 0 255 ECU_ADDRESS 0xFFF83226 DISPLAY_IDENTIFIER di_obd_iumpr_comp_active_count[196].ZFEH_EepromData /end MEASUREMENT
/begin MEASUREMENT ZFEH_EepromData.di_obd_iumpr_comp_active_count[197] "error code related component active counter [0 .. 254-1]" UBYTE EH_STANDARD_S4_S3 1 100 0 255 ECU_ADDRESS 0xFFF83227 DISPLAY_IDENTIFIER di_obd_iumpr_comp_active_count[197].ZFEH_EepromData /end MEASUREMENT
/begin MEASUREMENT ZFEH_EepromData.di_obd_iumpr_comp_active_count[198] "error code related component active counter [0 .. 254-1]" UBYTE EH_STANDARD_S4_S3 1 100 0 255 ECU_ADDRESS 0xFFF83228 DISPLAY_IDENTIFIER di_obd_iumpr_comp_active_count[198].ZFEH_EepromData /end MEASUREMENT
/begin MEASUREMENT ZFEH_EepromData.di_obd_iumpr_comp_active_count[199] "error code related component active counter [0 .. 254-1]" UBYTE EH_STANDARD_S4_S3 1 100 0 255 ECU_ADDRESS 0xFFF83229 DISPLAY_IDENTIFIER di_obd_iumpr_comp_active_count[199].ZFEH_EepromData /end MEASUREMENT
/begin MEASUREMENT ZFEH_EepromData.di_obd_iumpr_comp_active_count[19] "error code related component active counter [0 .. 254-1]" UBYTE EH_STANDARD_S4_S3 1 100 0 255 ECU_ADDRESS 0xFFF83175 DISPLAY_IDENTIFIER di_obd_iumpr_comp_active_count[19].ZFEH_EepromData /end MEASUREMENT
/begin MEASUREMENT ZFEH_EepromData.di_obd_iumpr_comp_active_count[1] "error code related component active counter [0 .. 254-1]" UBYTE EH_STANDARD_S4_S3 1 100 0 255 ECU_ADDRESS 0xFFF83163 DISPLAY_IDENTIFIER di_obd_iumpr_comp_active_count[1].ZFEH_EepromData /end MEASUREMENT
/begin MEASUREMENT ZFEH_EepromData.di_obd_iumpr_comp_active_count[200] "error code related component active counter [0 .. 254-1]" UBYTE EH_STANDARD_S4_S3 1 100 0 255 ECU_ADDRESS 0xFFF8322A DISPLAY_IDENTIFIER di_obd_iumpr_comp_active_count[200].ZFEH_EepromData /end MEASUREMENT
/begin MEASUREMENT ZFEH_EepromData.di_obd_iumpr_comp_active_count[201] "error code related component active counter [0 .. 254-1]" UBYTE EH_STANDARD_S4_S3 1 100 0 255 ECU_ADDRESS 0xFFF8322B DISPLAY_IDENTIFIER di_obd_iumpr_comp_active_count[201].ZFEH_EepromData /end MEASUREMENT
/begin MEASUREMENT ZFEH_EepromData.di_obd_iumpr_comp_active_count[202] "error code related component active counter [0 .. 254-1]" UBYTE EH_STANDARD_S4_S3 1 100 0 255 ECU_ADDRESS 0xFFF8322C DISPLAY_IDENTIFIER di_obd_iumpr_comp_active_count[202].ZFEH_EepromData /end MEASUREMENT
/begin MEASUREMENT ZFEH_EepromData.di_obd_iumpr_comp_active_count[203] "error code related component active counter [0 .. 254-1]" UBYTE EH_STANDARD_S4_S3 1 100 0 255 ECU_ADDRESS 0xFFF8322D DISPLAY_IDENTIFIER di_obd_iumpr_comp_active_count[203].ZFEH_EepromData /end MEASUREMENT
/begin MEASUREMENT ZFEH_EepromData.di_obd_iumpr_comp_active_count[204] "error code related component active counter [0 .. 254-1]" UBYTE EH_STANDARD_S4_S3 1 100 0 255 ECU_ADDRESS 0xFFF8322E DISPLAY_IDENTIFIER di_obd_iumpr_comp_active_count[204].ZFEH_EepromData /end MEASUREMENT
/begin MEASUREMENT ZFEH_EepromData.di_obd_iumpr_comp_active_count[205] "error code related component active counter [0 .. 254-1]" UBYTE EH_STANDARD_S4_S3 1 100 0 255 ECU_ADDRESS 0xFFF8322F DISPLAY_IDENTIFIER di_obd_iumpr_comp_active_count[205].ZFEH_EepromData /end MEASUREMENT
/begin MEASUREMENT ZFEH_EepromData.di_obd_iumpr_comp_active_count[206] "error code related component active counter [0 .. 254-1]" UBYTE EH_STANDARD_S4_S3 1 100 0 255 ECU_ADDRESS 0xFFF83230 DISPLAY_IDENTIFIER di_obd_iumpr_comp_active_count[206].ZFEH_EepromData /end MEASUREMENT
/begin MEASUREMENT ZFEH_EepromData.di_obd_iumpr_comp_active_count[207] "error code related component active counter [0 .. 254-1]" UBYTE EH_STANDARD_S4_S3 1 100 0 255 ECU_ADDRESS 0xFFF83231 DISPLAY_IDENTIFIER di_obd_iumpr_comp_active_count[207].ZFEH_EepromData /end MEASUREMENT
/begin MEASUREMENT ZFEH_EepromData.di_obd_iumpr_comp_active_count[208] "error code related component active counter [0 .. 254-1]" UBYTE EH_STANDARD_S4_S3 1 100 0 255 ECU_ADDRESS 0xFFF83232 DISPLAY_IDENTIFIER di_obd_iumpr_comp_active_count[208].ZFEH_EepromData /end MEASUREMENT
/begin MEASUREMENT ZFEH_EepromData.di_obd_iumpr_comp_active_count[209] "error code related component active counter [0 .. 254-1]" UBYTE EH_STANDARD_S4_S3 1 100 0 255 ECU_ADDRESS 0xFFF83233 DISPLAY_IDENTIFIER di_obd_iumpr_comp_active_count[209].ZFEH_EepromData /end MEASUREMENT
/begin MEASUREMENT ZFEH_EepromData.di_obd_iumpr_comp_active_count[20] "error code related component active counter [0 .. 254-1]" UBYTE EH_STANDARD_S4_S3 1 100 0 255 ECU_ADDRESS 0xFFF83176 DISPLAY_IDENTIFIER di_obd_iumpr_comp_active_count[20].ZFEH_EepromData /end MEASUREMENT
/begin MEASUREMENT ZFEH_EepromData.di_obd_iumpr_comp_active_count[210] "error code related component active counter [0 .. 254-1]" UBYTE EH_STANDARD_S4_S3 1 100 0 255 ECU_ADDRESS 0xFFF83234 DISPLAY_IDENTIFIER di_obd_iumpr_comp_active_count[210].ZFEH_EepromData /end MEASUREMENT
/begin MEASUREMENT ZFEH_EepromData.di_obd_iumpr_comp_active_count[211] "error code related component active counter [0 .. 254-1]" UBYTE EH_STANDARD_S4_S3 1 100 0 255 ECU_ADDRESS 0xFFF83235 DISPLAY_IDENTIFIER di_obd_iumpr_comp_active_count[211].ZFEH_EepromData /end MEASUREMENT
/begin MEASUREMENT ZFEH_EepromData.di_obd_iumpr_comp_active_count[212] "error code related component active counter [0 .. 254-1]" UBYTE EH_STANDARD_S4_S3 1 100 0 255 ECU_ADDRESS 0xFFF83236 DISPLAY_IDENTIFIER di_obd_iumpr_comp_active_count[212].ZFEH_EepromData /end MEASUREMENT
/begin MEASUREMENT ZFEH_EepromData.di_obd_iumpr_comp_active_count[213] "error code related component active counter [0 .. 254-1]" UBYTE EH_STANDARD_S4_S3 1 100 0 255 ECU_ADDRESS 0xFFF83237 DISPLAY_IDENTIFIER di_obd_iumpr_comp_active_count[213].ZFEH_EepromData /end MEASUREMENT
/begin MEASUREMENT ZFEH_EepromData.di_obd_iumpr_comp_active_count[214] "error code related component active counter [0 .. 254-1]" UBYTE EH_STANDARD_S4_S3 1 100 0 255 ECU_ADDRESS 0xFFF83238 DISPLAY_IDENTIFIER di_obd_iumpr_comp_active_count[214].ZFEH_EepromData /end MEASUREMENT
/begin MEASUREMENT ZFEH_EepromData.di_obd_iumpr_comp_active_count[215] "error code related component active counter [0 .. 254-1]" UBYTE EH_STANDARD_S4_S3 1 100 0 255 ECU_ADDRESS 0xFFF83239 DISPLAY_IDENTIFIER di_obd_iumpr_comp_active_count[215].ZFEH_EepromData /end MEASUREMENT
/begin MEASUREMENT ZFEH_EepromData.di_obd_iumpr_comp_active_count[216] "error code related component active counter [0 .. 254-1]" UBYTE EH_STANDARD_S4_S3 1 100 0 255 ECU_ADDRESS 0xFFF8323A DISPLAY_IDENTIFIER di_obd_iumpr_comp_active_count[216].ZFEH_EepromData /end MEASUREMENT
/begin MEASUREMENT ZFEH_EepromData.di_obd_iumpr_comp_active_count[217] "error code related component active counter [0 .. 254-1]" UBYTE EH_STANDARD_S4_S3 1 100 0 255 ECU_ADDRESS 0xFFF8323B DISPLAY_IDENTIFIER di_obd_iumpr_comp_active_count[217].ZFEH_EepromData /end MEASUREMENT
/begin MEASUREMENT ZFEH_EepromData.di_obd_iumpr_comp_active_count[218] "error code related component active counter [0 .. 254-1]" UBYTE EH_STANDARD_S4_S3 1 100 0 255 ECU_ADDRESS 0xFFF8323C DISPLAY_IDENTIFIER di_obd_iumpr_comp_active_count[218].ZFEH_EepromData /end MEASUREMENT
/begin MEASUREMENT ZFEH_EepromData.di_obd_iumpr_comp_active_count[219] "error code related component active counter [0 .. 254-1]" UBYTE EH_STANDARD_S4_S3 1 100 0 255 ECU_ADDRESS 0xFFF8323D DISPLAY_IDENTIFIER di_obd_iumpr_comp_active_count[219].ZFEH_EepromData /end MEASUREMENT
/begin MEASUREMENT ZFEH_EepromData.di_obd_iumpr_comp_active_count[21] "error code related component active counter [0 .. 254-1]" UBYTE EH_STANDARD_S4_S3 1 100 0 255 ECU_ADDRESS 0xFFF83177 DISPLAY_IDENTIFIER di_obd_iumpr_comp_active_count[21].ZFEH_EepromData /end MEASUREMENT
/begin MEASUREMENT ZFEH_EepromData.di_obd_iumpr_comp_active_count[220] "error code related component active counter [0 .. 254-1]" UBYTE EH_STANDARD_S4_S3 1 100 0 255 ECU_ADDRESS 0xFFF8323E DISPLAY_IDENTIFIER di_obd_iumpr_comp_active_count[220].ZFEH_EepromData /end MEASUREMENT
/begin MEASUREMENT ZFEH_EepromData.di_obd_iumpr_comp_active_count[221] "error code related component active counter [0 .. 254-1]" UBYTE EH_STANDARD_S4_S3 1 100 0 255 ECU_ADDRESS 0xFFF8323F DISPLAY_IDENTIFIER di_obd_iumpr_comp_active_count[221].ZFEH_EepromData /end MEASUREMENT
/begin MEASUREMENT ZFEH_EepromData.di_obd_iumpr_comp_active_count[222] "error code related component active counter [0 .. 254-1]" UBYTE EH_STANDARD_S4_S3 1 100 0 255 ECU_ADDRESS 0xFFF83240 DISPLAY_IDENTIFIER di_obd_iumpr_comp_active_count[222].ZFEH_EepromData /end MEASUREMENT
/begin MEASUREMENT ZFEH_EepromData.di_obd_iumpr_comp_active_count[223] "error code related component active counter [0 .. 254-1]" UBYTE EH_STANDARD_S4_S3 1 100 0 255 ECU_ADDRESS 0xFFF83241 DISPLAY_IDENTIFIER di_obd_iumpr_comp_active_count[223].ZFEH_EepromData /end MEASUREMENT
/begin MEASUREMENT ZFEH_EepromData.di_obd_iumpr_comp_active_count[224] "error code related component active counter [0 .. 254-1]" UBYTE EH_STANDARD_S4_S3 1 100 0 255 ECU_ADDRESS 0xFFF83242 DISPLAY_IDENTIFIER di_obd_iumpr_comp_active_count[224].ZFEH_EepromData /end MEASUREMENT
/begin MEASUREMENT ZFEH_EepromData.di_obd_iumpr_comp_active_count[225] "error code related component active counter [0 .. 254-1]" UBYTE EH_STANDARD_S4_S3 1 100 0 255 ECU_ADDRESS 0xFFF83243 DISPLAY_IDENTIFIER di_obd_iumpr_comp_active_count[225].ZFEH_EepromData /end MEASUREMENT
/begin MEASUREMENT ZFEH_EepromData.di_obd_iumpr_comp_active_count[226] "error code related component active counter [0 .. 254-1]" UBYTE EH_STANDARD_S4_S3 1 100 0 255 ECU_ADDRESS 0xFFF83244 DISPLAY_IDENTIFIER di_obd_iumpr_comp_active_count[226].ZFEH_EepromData /end MEASUREMENT
/begin MEASUREMENT ZFEH_EepromData.di_obd_iumpr_comp_active_count[227] "error code related component active counter [0 .. 254-1]" UBYTE EH_STANDARD_S4_S3 1 100 0 255 ECU_ADDRESS 0xFFF83245 DISPLAY_IDENTIFIER di_obd_iumpr_comp_active_count[227].ZFEH_EepromData /end MEASUREMENT
/begin MEASUREMENT ZFEH_EepromData.di_obd_iumpr_comp_active_count[228] "error code related component active counter [0 .. 254-1]" UBYTE EH_STANDARD_S4_S3 1 100 0 255 ECU_ADDRESS 0xFFF83246 DISPLAY_IDENTIFIER di_obd_iumpr_comp_active_count[228].ZFEH_EepromData /end MEASUREMENT
/begin MEASUREMENT ZFEH_EepromData.di_obd_iumpr_comp_active_count[229] "error code related component active counter [0 .. 254-1]" UBYTE EH_STANDARD_S4_S3 1 100 0 255 ECU_ADDRESS 0xFFF83247 DISPLAY_IDENTIFIER di_obd_iumpr_comp_active_count[229].ZFEH_EepromData /end MEASUREMENT
/begin MEASUREMENT ZFEH_EepromData.di_obd_iumpr_comp_active_count[22] "error code related component active counter [0 .. 254-1]" UBYTE EH_STANDARD_S4_S3 1 100 0 255 ECU_ADDRESS 0xFFF83178 DISPLAY_IDENTIFIER di_obd_iumpr_comp_active_count[22].ZFEH_EepromData /end MEASUREMENT
/begin MEASUREMENT ZFEH_EepromData.di_obd_iumpr_comp_active_count[230] "error code related component active counter [0 .. 254-1]" UBYTE EH_STANDARD_S4_S3 1 100 0 255 ECU_ADDRESS 0xFFF83248 DISPLAY_IDENTIFIER di_obd_iumpr_comp_active_count[230].ZFEH_EepromData /end MEASUREMENT
/begin MEASUREMENT ZFEH_EepromData.di_obd_iumpr_comp_active_count[231] "error code related component active counter [0 .. 254-1]" UBYTE EH_STANDARD_S4_S3 1 100 0 255 ECU_ADDRESS 0xFFF83249 DISPLAY_IDENTIFIER di_obd_iumpr_comp_active_count[231].ZFEH_EepromData /end MEASUREMENT
/begin MEASUREMENT ZFEH_EepromData.di_obd_iumpr_comp_active_count[232] "error code related component active counter [0 .. 254-1]" UBYTE EH_STANDARD_S4_S3 1 100 0 255 ECU_ADDRESS 0xFFF8324A DISPLAY_IDENTIFIER di_obd_iumpr_comp_active_count[232].ZFEH_EepromData /end MEASUREMENT
/begin MEASUREMENT ZFEH_EepromData.di_obd_iumpr_comp_active_count[233] "error code related component active counter [0 .. 254-1]" UBYTE EH_STANDARD_S4_S3 1 100 0 255 ECU_ADDRESS 0xFFF8324B DISPLAY_IDENTIFIER di_obd_iumpr_comp_active_count[233].ZFEH_EepromData /end MEASUREMENT
/begin MEASUREMENT ZFEH_EepromData.di_obd_iumpr_comp_active_count[234] "error code related component active counter [0 .. 254-1]" UBYTE EH_STANDARD_S4_S3 1 100 0 255 ECU_ADDRESS 0xFFF8324C DISPLAY_IDENTIFIER di_obd_iumpr_comp_active_count[234].ZFEH_EepromData /end MEASUREMENT
/begin MEASUREMENT ZFEH_EepromData.di_obd_iumpr_comp_active_count[235] "error code related component active counter [0 .. 254-1]" UBYTE EH_STANDARD_S4_S3 1 100 0 255 ECU_ADDRESS 0xFFF8324D DISPLAY_IDENTIFIER di_obd_iumpr_comp_active_count[235].ZFEH_EepromData /end MEASUREMENT
/begin MEASUREMENT ZFEH_EepromData.di_obd_iumpr_comp_active_count[236] "error code related component active counter [0 .. 254-1]" UBYTE EH_STANDARD_S4_S3 1 100 0 255 ECU_ADDRESS 0xFFF8324E DISPLAY_IDENTIFIER di_obd_iumpr_comp_active_count[236].ZFEH_EepromData /end MEASUREMENT
/begin MEASUREMENT ZFEH_EepromData.di_obd_iumpr_comp_active_count[237] "error code related component active counter [0 .. 254-1]" UBYTE EH_STANDARD_S4_S3 1 100 0 255 ECU_ADDRESS 0xFFF8324F DISPLAY_IDENTIFIER di_obd_iumpr_comp_active_count[237].ZFEH_EepromData /end MEASUREMENT
/begin MEASUREMENT ZFEH_EepromData.di_obd_iumpr_comp_active_count[238] "error code related component active counter [0 .. 254-1]" UBYTE EH_STANDARD_S4_S3 1 100 0 255 ECU_ADDRESS 0xFFF83250 DISPLAY_IDENTIFIER di_obd_iumpr_comp_active_count[238].ZFEH_EepromData /end MEASUREMENT
/begin MEASUREMENT ZFEH_EepromData.di_obd_iumpr_comp_active_count[239] "error code related component active counter [0 .. 254-1]" UBYTE EH_STANDARD_S4_S3 1 100 0 255 ECU_ADDRESS 0xFFF83251 DISPLAY_IDENTIFIER di_obd_iumpr_comp_active_count[239].ZFEH_EepromData /end MEASUREMENT
/begin MEASUREMENT ZFEH_EepromData.di_obd_iumpr_comp_active_count[23] "error code related component active counter [0 .. 254-1]" UBYTE EH_STANDARD_S4_S3 1 100 0 255 ECU_ADDRESS 0xFFF83179 DISPLAY_IDENTIFIER di_obd_iumpr_comp_active_count[23].ZFEH_EepromData /end MEASUREMENT
/begin MEASUREMENT ZFEH_EepromData.di_obd_iumpr_comp_active_count[240] "error code related component active counter [0 .. 254-1]" UBYTE EH_STANDARD_S4_S3 1 100 0 255 ECU_ADDRESS 0xFFF83252 DISPLAY_IDENTIFIER di_obd_iumpr_comp_active_count[240].ZFEH_EepromData /end MEASUREMENT
/begin MEASUREMENT ZFEH_EepromData.di_obd_iumpr_comp_active_count[241] "error code related component active counter [0 .. 254-1]" UBYTE EH_STANDARD_S4_S3 1 100 0 255 ECU_ADDRESS 0xFFF83253 DISPLAY_IDENTIFIER di_obd_iumpr_comp_active_count[241].ZFEH_EepromData /end MEASUREMENT
/begin MEASUREMENT ZFEH_EepromData.di_obd_iumpr_comp_active_count[242] "error code related component active counter [0 .. 254-1]" UBYTE EH_STANDARD_S4_S3 1 100 0 255 ECU_ADDRESS 0xFFF83254 DISPLAY_IDENTIFIER di_obd_iumpr_comp_active_count[242].ZFEH_EepromData /end MEASUREMENT
/begin MEASUREMENT ZFEH_EepromData.di_obd_iumpr_comp_active_count[243] "error code related component active counter [0 .. 254-1]" UBYTE EH_STANDARD_S4_S3 1 100 0 255 ECU_ADDRESS 0xFFF83255 DISPLAY_IDENTIFIER di_obd_iumpr_comp_active_count[243].ZFEH_EepromData /end MEASUREMENT
/begin MEASUREMENT ZFEH_EepromData.di_obd_iumpr_comp_active_count[244] "error code related component active counter [0 .. 254-1]" UBYTE EH_STANDARD_S4_S3 1 100 0 255 ECU_ADDRESS 0xFFF83256 DISPLAY_IDENTIFIER di_obd_iumpr_comp_active_count[244].ZFEH_EepromData /end MEASUREMENT
/begin MEASUREMENT ZFEH_EepromData.di_obd_iumpr_comp_active_count[245] "error code related component active counter [0 .. 254-1]" UBYTE EH_STANDARD_S4_S3 1 100 0 255 ECU_ADDRESS 0xFFF83257 DISPLAY_IDENTIFIER di_obd_iumpr_comp_active_count[245].ZFEH_EepromData /end MEASUREMENT
/begin MEASUREMENT ZFEH_EepromData.di_obd_iumpr_comp_active_count[246] "error code related component active counter [0 .. 254-1]" UBYTE EH_STANDARD_S4_S3 1 100 0 255 ECU_ADDRESS 0xFFF83258 DISPLAY_IDENTIFIER di_obd_iumpr_comp_active_count[246].ZFEH_EepromData /end MEASUREMENT
/begin MEASUREMENT ZFEH_EepromData.di_obd_iumpr_comp_active_count[247] "error code related component active counter [0 .. 254-1]" UBYTE EH_STANDARD_S4_S3 1 100 0 255 ECU_ADDRESS 0xFFF83259 DISPLAY_IDENTIFIER di_obd_iumpr_comp_active_count[247].ZFEH_EepromData /end MEASUREMENT
/begin MEASUREMENT ZFEH_EepromData.di_obd_iumpr_comp_active_count[248] "error code related component active counter [0 .. 254-1]" UBYTE EH_STANDARD_S4_S3 1 100 0 255 ECU_ADDRESS 0xFFF8325A DISPLAY_IDENTIFIER di_obd_iumpr_comp_active_count[248].ZFEH_EepromData /end MEASUREMENT
/begin MEASUREMENT ZFEH_EepromData.di_obd_iumpr_comp_active_count[249] "error code related component active counter [0 .. 254-1]" UBYTE EH_STANDARD_S4_S3 1 100 0 255 ECU_ADDRESS 0xFFF8325B DISPLAY_IDENTIFIER di_obd_iumpr_comp_active_count[249].ZFEH_EepromData /end MEASUREMENT
/begin MEASUREMENT ZFEH_EepromData.di_obd_iumpr_comp_active_count[24] "error code related component active counter [0 .. 254-1]" UBYTE EH_STANDARD_S4_S3 1 100 0 255 ECU_ADDRESS 0xFFF8317A DISPLAY_IDENTIFIER di_obd_iumpr_comp_active_count[24].ZFEH_EepromData /end MEASUREMENT
/begin MEASUREMENT ZFEH_EepromData.di_obd_iumpr_comp_active_count[250] "error code related component active counter [0 .. 254-1]" UBYTE EH_STANDARD_S4_S3 1 100 0 255 ECU_ADDRESS 0xFFF8325C DISPLAY_IDENTIFIER di_obd_iumpr_comp_active_count[250].ZFEH_EepromData /end MEASUREMENT
/begin MEASUREMENT ZFEH_EepromData.di_obd_iumpr_comp_active_count[251] "error code related component active counter [0 .. 254-1]" UBYTE EH_STANDARD_S4_S3 1 100 0 255 ECU_ADDRESS 0xFFF8325D DISPLAY_IDENTIFIER di_obd_iumpr_comp_active_count[251].ZFEH_EepromData /end MEASUREMENT
/begin MEASUREMENT ZFEH_EepromData.di_obd_iumpr_comp_active_count[252] "error code related component active counter [0 .. 254-1]" UBYTE EH_STANDARD_S4_S3 1 100 0 255 ECU_ADDRESS 0xFFF8325E DISPLAY_IDENTIFIER di_obd_iumpr_comp_active_count[252].ZFEH_EepromData /end MEASUREMENT
/begin MEASUREMENT ZFEH_EepromData.di_obd_iumpr_comp_active_count[253] "error code related component active counter [0 .. 254-1]" UBYTE EH_STANDARD_S4_S3 1 100 0 255 ECU_ADDRESS 0xFFF8325F DISPLAY_IDENTIFIER di_obd_iumpr_comp_active_count[253].ZFEH_EepromData /end MEASUREMENT
/begin MEASUREMENT ZFEH_EepromData.di_obd_iumpr_comp_active_count[25] "error code related component active counter [0 .. 254-1]" UBYTE EH_STANDARD_S4_S3 1 100 0 255 ECU_ADDRESS 0xFFF8317B DISPLAY_IDENTIFIER di_obd_iumpr_comp_active_count[25].ZFEH_EepromData /end MEASUREMENT
/begin MEASUREMENT ZFEH_EepromData.di_obd_iumpr_comp_active_count[26] "error code related component active counter [0 .. 254-1]" UBYTE EH_STANDARD_S4_S3 1 100 0 255 ECU_ADDRESS 0xFFF8317C DISPLAY_IDENTIFIER di_obd_iumpr_comp_active_count[26].ZFEH_EepromData /end MEASUREMENT
/begin MEASUREMENT ZFEH_EepromData.di_obd_iumpr_comp_active_count[27] "error code related component active counter [0 .. 254-1]" UBYTE EH_STANDARD_S4_S3 1 100 0 255 ECU_ADDRESS 0xFFF8317D DISPLAY_IDENTIFIER di_obd_iumpr_comp_active_count[27].ZFEH_EepromData /end MEASUREMENT
/begin MEASUREMENT ZFEH_EepromData.di_obd_iumpr_comp_active_count[28] "error code related component active counter [0 .. 254-1]" UBYTE EH_STANDARD_S4_S3 1 100 0 255 ECU_ADDRESS 0xFFF8317E DISPLAY_IDENTIFIER di_obd_iumpr_comp_active_count[28].ZFEH_EepromData /end MEASUREMENT
/begin MEASUREMENT ZFEH_EepromData.di_obd_iumpr_comp_active_count[29] "error code related component active counter [0 .. 254-1]" UBYTE EH_STANDARD_S4_S3 1 100 0 255 ECU_ADDRESS 0xFFF8317F DISPLAY_IDENTIFIER di_obd_iumpr_comp_active_count[29].ZFEH_EepromData /end MEASUREMENT
/begin MEASUREMENT ZFEH_EepromData.di_obd_iumpr_comp_active_count[2] "error code related component active counter [0 .. 254-1]" UBYTE EH_STANDARD_S4_S3 1 100 0 255 ECU_ADDRESS 0xFFF83164 DISPLAY_IDENTIFIER di_obd_iumpr_comp_active_count[2].ZFEH_EepromData /end MEASUREMENT
/begin MEASUREMENT ZFEH_EepromData.di_obd_iumpr_comp_active_count[30] "error code related component active counter [0 .. 254-1]" UBYTE EH_STANDARD_S4_S3 1 100 0 255 ECU_ADDRESS 0xFFF83180 DISPLAY_IDENTIFIER di_obd_iumpr_comp_active_count[30].ZFEH_EepromData /end MEASUREMENT
/begin MEASUREMENT ZFEH_EepromData.di_obd_iumpr_comp_active_count[31] "error code related component active counter [0 .. 254-1]" UBYTE EH_STANDARD_S4_S3 1 100 0 255 ECU_ADDRESS 0xFFF83181 DISPLAY_IDENTIFIER di_obd_iumpr_comp_active_count[31].ZFEH_EepromData /end MEASUREMENT
/begin MEASUREMENT ZFEH_EepromData.di_obd_iumpr_comp_active_count[32] "error code related component active counter [0 .. 254-1]" UBYTE EH_STANDARD_S4_S3 1 100 0 255 ECU_ADDRESS 0xFFF83182 DISPLAY_IDENTIFIER di_obd_iumpr_comp_active_count[32].ZFEH_EepromData /end MEASUREMENT
/begin MEASUREMENT ZFEH_EepromData.di_obd_iumpr_comp_active_count[33] "error code related component active counter [0 .. 254-1]" UBYTE EH_STANDARD_S4_S3 1 100 0 255 ECU_ADDRESS 0xFFF83183 DISPLAY_IDENTIFIER di_obd_iumpr_comp_active_count[33].ZFEH_EepromData /end MEASUREMENT
/begin MEASUREMENT ZFEH_EepromData.di_obd_iumpr_comp_active_count[34] "error code related component active counter [0 .. 254-1]" UBYTE EH_STANDARD_S4_S3 1 100 0 255 ECU_ADDRESS 0xFFF83184 DISPLAY_IDENTIFIER di_obd_iumpr_comp_active_count[34].ZFEH_EepromData /end MEASUREMENT
/begin MEASUREMENT ZFEH_EepromData.di_obd_iumpr_comp_active_count[35] "error code related component active counter [0 .. 254-1]" UBYTE EH_STANDARD_S4_S3 1 100 0 255 ECU_ADDRESS 0xFFF83185 DISPLAY_IDENTIFIER di_obd_iumpr_comp_active_count[35].ZFEH_EepromData /end MEASUREMENT
/begin MEASUREMENT ZFEH_EepromData.di_obd_iumpr_comp_active_count[36] "error code related component active counter [0 .. 254-1]" UBYTE EH_STANDARD_S4_S3 1 100 0 255 ECU_ADDRESS 0xFFF83186 DISPLAY_IDENTIFIER di_obd_iumpr_comp_active_count[36].ZFEH_EepromData /end MEASUREMENT
/begin MEASUREMENT ZFEH_EepromData.di_obd_iumpr_comp_active_count[37] "error code related component active counter [0 .. 254-1]" UBYTE EH_STANDARD_S4_S3 1 100 0 255 ECU_ADDRESS 0xFFF83187 DISPLAY_IDENTIFIER di_obd_iumpr_comp_active_count[37].ZFEH_EepromData /end MEASUREMENT
/begin MEASUREMENT ZFEH_EepromData.di_obd_iumpr_comp_active_count[38] "error code related component active counter [0 .. 254-1]" UBYTE EH_STANDARD_S4_S3 1 100 0 255 ECU_ADDRESS 0xFFF83188 DISPLAY_IDENTIFIER di_obd_iumpr_comp_active_count[38].ZFEH_EepromData /end MEASUREMENT
/begin MEASUREMENT ZFEH_EepromData.di_obd_iumpr_comp_active_count[39] "error code related component active counter [0 .. 254-1]" UBYTE EH_STANDARD_S4_S3 1 100 0 255 ECU_ADDRESS 0xFFF83189 DISPLAY_IDENTIFIER di_obd_iumpr_comp_active_count[39].ZFEH_EepromData /end MEASUREMENT
/begin MEASUREMENT ZFEH_EepromData.di_obd_iumpr_comp_active_count[3] "error code related component active counter [0 .. 254-1]" UBYTE EH_STANDARD_S4_S3 1 100 0 255 ECU_ADDRESS 0xFFF83165 DISPLAY_IDENTIFIER di_obd_iumpr_comp_active_count[3].ZFEH_EepromData /end MEASUREMENT
/begin MEASUREMENT ZFEH_EepromData.di_obd_iumpr_comp_active_count[40] "error code related component active counter [0 .. 254-1]" UBYTE EH_STANDARD_S4_S3 1 100 0 255 ECU_ADDRESS 0xFFF8318A DISPLAY_IDENTIFIER di_obd_iumpr_comp_active_count[40].ZFEH_EepromData /end MEASUREMENT
/begin MEASUREMENT ZFEH_EepromData.di_obd_iumpr_comp_active_count[41] "error code related component active counter [0 .. 254-1]" UBYTE EH_STANDARD_S4_S3 1 100 0 255 ECU_ADDRESS 0xFFF8318B DISPLAY_IDENTIFIER di_obd_iumpr_comp_active_count[41].ZFEH_EepromData /end MEASUREMENT
/begin MEASUREMENT ZFEH_EepromData.di_obd_iumpr_comp_active_count[42] "error code related component active counter [0 .. 254-1]" UBYTE EH_STANDARD_S4_S3 1 100 0 255 ECU_ADDRESS 0xFFF8318C DISPLAY_IDENTIFIER di_obd_iumpr_comp_active_count[42].ZFEH_EepromData /end MEASUREMENT
/begin MEASUREMENT ZFEH_EepromData.di_obd_iumpr_comp_active_count[43] "error code related component active counter [0 .. 254-1]" UBYTE EH_STANDARD_S4_S3 1 100 0 255 ECU_ADDRESS 0xFFF8318D DISPLAY_IDENTIFIER di_obd_iumpr_comp_active_count[43].ZFEH_EepromData /end MEASUREMENT
/begin MEASUREMENT ZFEH_EepromData.di_obd_iumpr_comp_active_count[44] "error code related component active counter [0 .. 254-1]" UBYTE EH_STANDARD_S4_S3 1 100 0 255 ECU_ADDRESS 0xFFF8318E DISPLAY_IDENTIFIER di_obd_iumpr_comp_active_count[44].ZFEH_EepromData /end MEASUREMENT
/begin MEASUREMENT ZFEH_EepromData.di_obd_iumpr_comp_active_count[45] "error code related component active counter [0 .. 254-1]" UBYTE EH_STANDARD_S4_S3 1 100 0 255 ECU_ADDRESS 0xFFF8318F DISPLAY_IDENTIFIER di_obd_iumpr_comp_active_count[45].ZFEH_EepromData /end MEASUREMENT
/begin MEASUREMENT ZFEH_EepromData.di_obd_iumpr_comp_active_count[46] "error code related component active counter [0 .. 254-1]" UBYTE EH_STANDARD_S4_S3 1 100 0 255 ECU_ADDRESS 0xFFF83190 DISPLAY_IDENTIFIER di_obd_iumpr_comp_active_count[46].ZFEH_EepromData /end MEASUREMENT
/begin MEASUREMENT ZFEH_EepromData.di_obd_iumpr_comp_active_count[47] "error code related component active counter [0 .. 254-1]" UBYTE EH_STANDARD_S4_S3 1 100 0 255 ECU_ADDRESS 0xFFF83191 DISPLAY_IDENTIFIER di_obd_iumpr_comp_active_count[47].ZFEH_EepromData /end MEASUREMENT
/begin MEASUREMENT ZFEH_EepromData.di_obd_iumpr_comp_active_count[48] "error code related component active counter [0 .. 254-1]" UBYTE EH_STANDARD_S4_S3 1 100 0 255 ECU_ADDRESS 0xFFF83192 DISPLAY_IDENTIFIER di_obd_iumpr_comp_active_count[48].ZFEH_EepromData /end MEASUREMENT
/begin MEASUREMENT ZFEH_EepromData.di_obd_iumpr_comp_active_count[49] "error code related component active counter [0 .. 254-1]" UBYTE EH_STANDARD_S4_S3 1 100 0 255 ECU_ADDRESS 0xFFF83193 DISPLAY_IDENTIFIER di_obd_iumpr_comp_active_count[49].ZFEH_EepromData /end MEASUREMENT
/begin MEASUREMENT ZFEH_EepromData.di_obd_iumpr_comp_active_count[4] "error code related component active counter [0 .. 254-1]" UBYTE EH_STANDARD_S4_S3 1 100 0 255 ECU_ADDRESS 0xFFF83166 DISPLAY_IDENTIFIER di_obd_iumpr_comp_active_count[4].ZFEH_EepromData /end MEASUREMENT
/begin MEASUREMENT ZFEH_EepromData.di_obd_iumpr_comp_active_count[50] "error code related component active counter [0 .. 254-1]" UBYTE EH_STANDARD_S4_S3 1 100 0 255 ECU_ADDRESS 0xFFF83194 DISPLAY_IDENTIFIER di_obd_iumpr_comp_active_count[50].ZFEH_EepromData /end MEASUREMENT
/begin MEASUREMENT ZFEH_EepromData.di_obd_iumpr_comp_active_count[51] "error code related component active counter [0 .. 254-1]" UBYTE EH_STANDARD_S4_S3 1 100 0 255 ECU_ADDRESS 0xFFF83195 DISPLAY_IDENTIFIER di_obd_iumpr_comp_active_count[51].ZFEH_EepromData /end MEASUREMENT
/begin MEASUREMENT ZFEH_EepromData.di_obd_iumpr_comp_active_count[52] "error code related component active counter [0 .. 254-1]" UBYTE EH_STANDARD_S4_S3 1 100 0 255 ECU_ADDRESS 0xFFF83196 DISPLAY_IDENTIFIER di_obd_iumpr_comp_active_count[52].ZFEH_EepromData /end MEASUREMENT
/begin MEASUREMENT ZFEH_EepromData.di_obd_iumpr_comp_active_count[53] "error code related component active counter [0 .. 254-1]" UBYTE EH_STANDARD_S4_S3 1 100 0 255 ECU_ADDRESS 0xFFF83197 DISPLAY_IDENTIFIER di_obd_iumpr_comp_active_count[53].ZFEH_EepromData /end MEASUREMENT
/begin MEASUREMENT ZFEH_EepromData.di_obd_iumpr_comp_active_count[54] "error code related component active counter [0 .. 254-1]" UBYTE EH_STANDARD_S4_S3 1 100 0 255 ECU_ADDRESS 0xFFF83198 DISPLAY_IDENTIFIER di_obd_iumpr_comp_active_count[54].ZFEH_EepromData /end MEASUREMENT
/begin MEASUREMENT ZFEH_EepromData.di_obd_iumpr_comp_active_count[55] "error code related component active counter [0 .. 254-1]" UBYTE EH_STANDARD_S4_S3 1 100 0 255 ECU_ADDRESS 0xFFF83199 DISPLAY_IDENTIFIER di_obd_iumpr_comp_active_count[55].ZFEH_EepromData /end MEASUREMENT
/begin MEASUREMENT ZFEH_EepromData.di_obd_iumpr_comp_active_count[56] "error code related component active counter [0 .. 254-1]" UBYTE EH_STANDARD_S4_S3 1 100 0 255 ECU_ADDRESS 0xFFF8319A DISPLAY_IDENTIFIER di_obd_iumpr_comp_active_count[56].ZFEH_EepromData /end MEASUREMENT
/begin MEASUREMENT ZFEH_EepromData.di_obd_iumpr_comp_active_count[57] "error code related component active counter [0 .. 254-1]" UBYTE EH_STANDARD_S4_S3 1 100 0 255 ECU_ADDRESS 0xFFF8319B DISPLAY_IDENTIFIER di_obd_iumpr_comp_active_count[57].ZFEH_EepromData /end MEASUREMENT
/begin MEASUREMENT ZFEH_EepromData.di_obd_iumpr_comp_active_count[58] "error code related component active counter [0 .. 254-1]" UBYTE EH_STANDARD_S4_S3 1 100 0 255 ECU_ADDRESS 0xFFF8319C DISPLAY_IDENTIFIER di_obd_iumpr_comp_active_count[58].ZFEH_EepromData /end MEASUREMENT
/begin MEASUREMENT ZFEH_EepromData.di_obd_iumpr_comp_active_count[59] "error code related component active counter [0 .. 254-1]" UBYTE EH_STANDARD_S4_S3 1 100 0 255 ECU_ADDRESS 0xFFF8319D DISPLAY_IDENTIFIER di_obd_iumpr_comp_active_count[59].ZFEH_EepromData /end MEASUREMENT
/begin MEASUREMENT ZFEH_EepromData.di_obd_iumpr_comp_active_count[5] "error code related component active counter [0 .. 254-1]" UBYTE EH_STANDARD_S4_S3 1 100 0 255 ECU_ADDRESS 0xFFF83167 DISPLAY_IDENTIFIER di_obd_iumpr_comp_active_count[5].ZFEH_EepromData /end MEASUREMENT
/begin MEASUREMENT ZFEH_EepromData.di_obd_iumpr_comp_active_count[60] "error code related component active counter [0 .. 254-1]" UBYTE EH_STANDARD_S4_S3 1 100 0 255 ECU_ADDRESS 0xFFF8319E DISPLAY_IDENTIFIER di_obd_iumpr_comp_active_count[60].ZFEH_EepromData /end MEASUREMENT
/begin MEASUREMENT ZFEH_EepromData.di_obd_iumpr_comp_active_count[61] "error code related component active counter [0 .. 254-1]" UBYTE EH_STANDARD_S4_S3 1 100 0 255 ECU_ADDRESS 0xFFF8319F DISPLAY_IDENTIFIER di_obd_iumpr_comp_active_count[61].ZFEH_EepromData /end MEASUREMENT
/begin MEASUREMENT ZFEH_EepromData.di_obd_iumpr_comp_active_count[62] "error code related component active counter [0 .. 254-1]" UBYTE EH_STANDARD_S4_S3 1 100 0 255 ECU_ADDRESS 0xFFF831A0 DISPLAY_IDENTIFIER di_obd_iumpr_comp_active_count[62].ZFEH_EepromData /end MEASUREMENT
/begin MEASUREMENT ZFEH_EepromData.di_obd_iumpr_comp_active_count[63] "error code related component active counter [0 .. 254-1]" UBYTE EH_STANDARD_S4_S3 1 100 0 255 ECU_ADDRESS 0xFFF831A1 DISPLAY_IDENTIFIER di_obd_iumpr_comp_active_count[63].ZFEH_EepromData /end MEASUREMENT
/begin MEASUREMENT ZFEH_EepromData.di_obd_iumpr_comp_active_count[64] "error code related component active counter [0 .. 254-1]" UBYTE EH_STANDARD_S4_S3 1 100 0 255 ECU_ADDRESS 0xFFF831A2 DISPLAY_IDENTIFIER di_obd_iumpr_comp_active_count[64].ZFEH_EepromData /end MEASUREMENT
/begin MEASUREMENT ZFEH_EepromData.di_obd_iumpr_comp_active_count[65] "error code related component active counter [0 .. 254-1]" UBYTE EH_STANDARD_S4_S3 1 100 0 255 ECU_ADDRESS 0xFFF831A3 DISPLAY_IDENTIFIER di_obd_iumpr_comp_active_count[65].ZFEH_EepromData /end MEASUREMENT
/begin MEASUREMENT ZFEH_EepromData.di_obd_iumpr_comp_active_count[66] "error code related component active counter [0 .. 254-1]" UBYTE EH_STANDARD_S4_S3 1 100 0 255 ECU_ADDRESS 0xFFF831A4 DISPLAY_IDENTIFIER di_obd_iumpr_comp_active_count[66].ZFEH_EepromData /end MEASUREMENT
/begin MEASUREMENT ZFEH_EepromData.di_obd_iumpr_comp_active_count[67] "error code related component active counter [0 .. 254-1]" UBYTE EH_STANDARD_S4_S3 1 100 0 255 ECU_ADDRESS 0xFFF831A5 DISPLAY_IDENTIFIER di_obd_iumpr_comp_active_count[67].ZFEH_EepromData /end MEASUREMENT
/begin MEASUREMENT ZFEH_EepromData.di_obd_iumpr_comp_active_count[68] "error code related component active counter [0 .. 254-1]" UBYTE EH_STANDARD_S4_S3 1 100 0 255 ECU_ADDRESS 0xFFF831A6 DISPLAY_IDENTIFIER di_obd_iumpr_comp_active_count[68].ZFEH_EepromData /end MEASUREMENT
/begin MEASUREMENT ZFEH_EepromData.di_obd_iumpr_comp_active_count[69] "error code related component active counter [0 .. 254-1]" UBYTE EH_STANDARD_S4_S3 1 100 0 255 ECU_ADDRESS 0xFFF831A7 DISPLAY_IDENTIFIER di_obd_iumpr_comp_active_count[69].ZFEH_EepromData /end MEASUREMENT
/begin MEASUREMENT ZFEH_EepromData.di_obd_iumpr_comp_active_count[6] "error code related component active counter [0 .. 254-1]" UBYTE EH_STANDARD_S4_S3 1 100 0 255 ECU_ADDRESS 0xFFF83168 DISPLAY_IDENTIFIER di_obd_iumpr_comp_active_count[6].ZFEH_EepromData /end MEASUREMENT
/begin MEASUREMENT ZFEH_EepromData.di_obd_iumpr_comp_active_count[70] "error code related component active counter [0 .. 254-1]" UBYTE EH_STANDARD_S4_S3 1 100 0 255 ECU_ADDRESS 0xFFF831A8 DISPLAY_IDENTIFIER di_obd_iumpr_comp_active_count[70].ZFEH_EepromData /end MEASUREMENT
/begin MEASUREMENT ZFEH_EepromData.di_obd_iumpr_comp_active_count[71] "error code related component active counter [0 .. 254-1]" UBYTE EH_STANDARD_S4_S3 1 100 0 255 ECU_ADDRESS 0xFFF831A9 DISPLAY_IDENTIFIER di_obd_iumpr_comp_active_count[71].ZFEH_EepromData /end MEASUREMENT
/begin MEASUREMENT ZFEH_EepromData.di_obd_iumpr_comp_active_count[72] "error code related component active counter [0 .. 254-1]" UBYTE EH_STANDARD_S4_S3 1 100 0 255 ECU_ADDRESS 0xFFF831AA DISPLAY_IDENTIFIER di_obd_iumpr_comp_active_count[72].ZFEH_EepromData /end MEASUREMENT
/begin MEASUREMENT ZFEH_EepromData.di_obd_iumpr_comp_active_count[73] "error code related component active counter [0 .. 254-1]" UBYTE EH_STANDARD_S4_S3 1 100 0 255 ECU_ADDRESS 0xFFF831AB DISPLAY_IDENTIFIER di_obd_iumpr_comp_active_count[73].ZFEH_EepromData /end MEASUREMENT
/begin MEASUREMENT ZFEH_EepromData.di_obd_iumpr_comp_active_count[74] "error code related component active counter [0 .. 254-1]" UBYTE EH_STANDARD_S4_S3 1 100 0 255 ECU_ADDRESS 0xFFF831AC DISPLAY_IDENTIFIER di_obd_iumpr_comp_active_count[74].ZFEH_EepromData /end MEASUREMENT
/begin MEASUREMENT ZFEH_EepromData.di_obd_iumpr_comp_active_count[75] "error code related component active counter [0 .. 254-1]" UBYTE EH_STANDARD_S4_S3 1 100 0 255 ECU_ADDRESS 0xFFF831AD DISPLAY_IDENTIFIER di_obd_iumpr_comp_active_count[75].ZFEH_EepromData /end MEASUREMENT
/begin MEASUREMENT ZFEH_EepromData.di_obd_iumpr_comp_active_count[76] "error code related component active counter [0 .. 254-1]" UBYTE EH_STANDARD_S4_S3 1 100 0 255 ECU_ADDRESS 0xFFF831AE DISPLAY_IDENTIFIER di_obd_iumpr_comp_active_count[76].ZFEH_EepromData /end MEASUREMENT
/begin MEASUREMENT ZFEH_EepromData.di_obd_iumpr_comp_active_count[77] "error code related component active counter [0 .. 254-1]" UBYTE EH_STANDARD_S4_S3 1 100 0 255 ECU_ADDRESS 0xFFF831AF DISPLAY_IDENTIFIER di_obd_iumpr_comp_active_count[77].ZFEH_EepromData /end MEASUREMENT
/begin MEASUREMENT ZFEH_EepromData.di_obd_iumpr_comp_active_count[78] "error code related component active counter [0 .. 254-1]" UBYTE EH_STANDARD_S4_S3 1 100 0 255 ECU_ADDRESS 0xFFF831B0 DISPLAY_IDENTIFIER di_obd_iumpr_comp_active_count[78].ZFEH_EepromData /end MEASUREMENT
/begin MEASUREMENT ZFEH_EepromData.di_obd_iumpr_comp_active_count[79] "error code related component active counter [0 .. 254-1]" UBYTE EH_STANDARD_S4_S3 1 100 0 255 ECU_ADDRESS 0xFFF831B1 DISPLAY_IDENTIFIER di_obd_iumpr_comp_active_count[79].ZFEH_EepromData /end MEASUREMENT
/begin MEASUREMENT ZFEH_EepromData.di_obd_iumpr_comp_active_count[7] "error code related component active counter [0 .. 254-1]" UBYTE EH_STANDARD_S4_S3 1 100 0 255 ECU_ADDRESS 0xFFF83169 DISPLAY_IDENTIFIER di_obd_iumpr_comp_active_count[7].ZFEH_EepromData /end MEASUREMENT
/begin MEASUREMENT ZFEH_EepromData.di_obd_iumpr_comp_active_count[80] "error code related component active counter [0 .. 254-1]" UBYTE EH_STANDARD_S4_S3 1 100 0 255 ECU_ADDRESS 0xFFF831B2 DISPLAY_IDENTIFIER di_obd_iumpr_comp_active_count[80].ZFEH_EepromData /end MEASUREMENT
/begin MEASUREMENT ZFEH_EepromData.di_obd_iumpr_comp_active_count[81] "error code related component active counter [0 .. 254-1]" UBYTE EH_STANDARD_S4_S3 1 100 0 255 ECU_ADDRESS 0xFFF831B3 DISPLAY_IDENTIFIER di_obd_iumpr_comp_active_count[81].ZFEH_EepromData /end MEASUREMENT
/begin MEASUREMENT ZFEH_EepromData.di_obd_iumpr_comp_active_count[82] "error code related component active counter [0 .. 254-1]" UBYTE EH_STANDARD_S4_S3 1 100 0 255 ECU_ADDRESS 0xFFF831B4 DISPLAY_IDENTIFIER di_obd_iumpr_comp_active_count[82].ZFEH_EepromData /end MEASUREMENT
/begin MEASUREMENT ZFEH_EepromData.di_obd_iumpr_comp_active_count[83] "error code related component active counter [0 .. 254-1]" UBYTE EH_STANDARD_S4_S3 1 100 0 255 ECU_ADDRESS 0xFFF831B5 DISPLAY_IDENTIFIER di_obd_iumpr_comp_active_count[83].ZFEH_EepromData /end MEASUREMENT
/begin MEASUREMENT ZFEH_EepromData.di_obd_iumpr_comp_active_count[84] "error code related component active counter [0 .. 254-1]" UBYTE EH_STANDARD_S4_S3 1 100 0 255 ECU_ADDRESS 0xFFF831B6 DISPLAY_IDENTIFIER di_obd_iumpr_comp_active_count[84].ZFEH_EepromData /end MEASUREMENT
/begin MEASUREMENT ZFEH_EepromData.di_obd_iumpr_comp_active_count[85] "error code related component active counter [0 .. 254-1]" UBYTE EH_STANDARD_S4_S3 1 100 0 255 ECU_ADDRESS 0xFFF831B7 DISPLAY_IDENTIFIER di_obd_iumpr_comp_active_count[85].ZFEH_EepromData /end MEASUREMENT
/begin MEASUREMENT ZFEH_EepromData.di_obd_iumpr_comp_active_count[86] "error code related component active counter [0 .. 254-1]" UBYTE EH_STANDARD_S4_S3 1 100 0 255 ECU_ADDRESS 0xFFF831B8 DISPLAY_IDENTIFIER di_obd_iumpr_comp_active_count[86].ZFEH_EepromData /end MEASUREMENT
/begin MEASUREMENT ZFEH_EepromData.di_obd_iumpr_comp_active_count[87] "error code related component active counter [0 .. 254-1]" UBYTE EH_STANDARD_S4_S3 1 100 0 255 ECU_ADDRESS 0xFFF831B9 DISPLAY_IDENTIFIER di_obd_iumpr_comp_active_count[87].ZFEH_EepromData /end MEASUREMENT
/begin MEASUREMENT ZFEH_EepromData.di_obd_iumpr_comp_active_count[88] "error code related component active counter [0 .. 254-1]" UBYTE EH_STANDARD_S4_S3 1 100 0 255 ECU_ADDRESS 0xFFF831BA DISPLAY_IDENTIFIER di_obd_iumpr_comp_active_count[88].ZFEH_EepromData /end MEASUREMENT
/begin MEASUREMENT ZFEH_EepromData.di_obd_iumpr_comp_active_count[89] "error code related component active counter [0 .. 254-1]" UBYTE EH_STANDARD_S4_S3 1 100 0 255 ECU_ADDRESS 0xFFF831BB DISPLAY_IDENTIFIER di_obd_iumpr_comp_active_count[89].ZFEH_EepromData /end MEASUREMENT
/begin MEASUREMENT ZFEH_EepromData.di_obd_iumpr_comp_active_count[8] "error code related component active counter [0 .. 254-1]" UBYTE EH_STANDARD_S4_S3 1 100 0 255 ECU_ADDRESS 0xFFF8316A DISPLAY_IDENTIFIER di_obd_iumpr_comp_active_count[8].ZFEH_EepromData /end MEASUREMENT
/begin MEASUREMENT ZFEH_EepromData.di_obd_iumpr_comp_active_count[90] "error code related component active counter [0 .. 254-1]" UBYTE EH_STANDARD_S4_S3 1 100 0 255 ECU_ADDRESS 0xFFF831BC DISPLAY_IDENTIFIER di_obd_iumpr_comp_active_count[90].ZFEH_EepromData /end MEASUREMENT
/begin MEASUREMENT ZFEH_EepromData.di_obd_iumpr_comp_active_count[91] "error code related component active counter [0 .. 254-1]" UBYTE EH_STANDARD_S4_S3 1 100 0 255 ECU_ADDRESS 0xFFF831BD DISPLAY_IDENTIFIER di_obd_iumpr_comp_active_count[91].ZFEH_EepromData /end MEASUREMENT
/begin MEASUREMENT ZFEH_EepromData.di_obd_iumpr_comp_active_count[92] "error code related component active counter [0 .. 254-1]" UBYTE EH_STANDARD_S4_S3 1 100 0 255 ECU_ADDRESS 0xFFF831BE DISPLAY_IDENTIFIER di_obd_iumpr_comp_active_count[92].ZFEH_EepromData /end MEASUREMENT
/begin MEASUREMENT ZFEH_EepromData.di_obd_iumpr_comp_active_count[93] "error code related component active counter [0 .. 254-1]" UBYTE EH_STANDARD_S4_S3 1 100 0 255 ECU_ADDRESS 0xFFF831BF DISPLAY_IDENTIFIER di_obd_iumpr_comp_active_count[93].ZFEH_EepromData /end MEASUREMENT
/begin MEASUREMENT ZFEH_EepromData.di_obd_iumpr_comp_active_count[94] "error code related component active counter [0 .. 254-1]" UBYTE EH_STANDARD_S4_S3 1 100 0 255 ECU_ADDRESS 0xFFF831C0 DISPLAY_IDENTIFIER di_obd_iumpr_comp_active_count[94].ZFEH_EepromData /end MEASUREMENT
/begin MEASUREMENT ZFEH_EepromData.di_obd_iumpr_comp_active_count[95] "error code related component active counter [0 .. 254-1]" UBYTE EH_STANDARD_S4_S3 1 100 0 255 ECU_ADDRESS 0xFFF831C1 DISPLAY_IDENTIFIER di_obd_iumpr_comp_active_count[95].ZFEH_EepromData /end MEASUREMENT
/begin MEASUREMENT ZFEH_EepromData.di_obd_iumpr_comp_active_count[96] "error code related component active counter [0 .. 254-1]" UBYTE EH_STANDARD_S4_S3 1 100 0 255 ECU_ADDRESS 0xFFF831C2 DISPLAY_IDENTIFIER di_obd_iumpr_comp_active_count[96].ZFEH_EepromData /end MEASUREMENT
/begin MEASUREMENT ZFEH_EepromData.di_obd_iumpr_comp_active_count[97] "error code related component active counter [0 .. 254-1]" UBYTE EH_STANDARD_S4_S3 1 100 0 255 ECU_ADDRESS 0xFFF831C3 DISPLAY_IDENTIFIER di_obd_iumpr_comp_active_count[97].ZFEH_EepromData /end MEASUREMENT
/begin MEASUREMENT ZFEH_EepromData.di_obd_iumpr_comp_active_count[98] "error code related component active counter [0 .. 254-1]" UBYTE EH_STANDARD_S4_S3 1 100 0 255 ECU_ADDRESS 0xFFF831C4 DISPLAY_IDENTIFIER di_obd_iumpr_comp_active_count[98].ZFEH_EepromData /end MEASUREMENT
/begin MEASUREMENT ZFEH_EepromData.di_obd_iumpr_comp_active_count[99] "error code related component active counter [0 .. 254-1]" UBYTE EH_STANDARD_S4_S3 1 100 0 255 ECU_ADDRESS 0xFFF831C5 DISPLAY_IDENTIFIER di_obd_iumpr_comp_active_count[99].ZFEH_EepromData /end MEASUREMENT
/begin MEASUREMENT ZFEH_EepromData.di_obd_iumpr_comp_active_count[9] "error code related component active counter [0 .. 254-1]" UBYTE EH_STANDARD_S4_S3 1 100 0 255 ECU_ADDRESS 0xFFF8316B DISPLAY_IDENTIFIER di_obd_iumpr_comp_active_count[9].ZFEH_EepromData /end MEASUREMENT
/begin MEASUREMENT ZFEH_EepromData.di_obd_iumpr_comp_active_lock[0] "information that denominator is locked by component not active (bitcoded error codes) [0 .. 16-1]" UWORD EH_STANDARD_S4_S3 1 100 0 65535 ECU_ADDRESS 0xFFF8335E DISPLAY_IDENTIFIER di_obd_iumpr_comp_active_lock[0].ZFEH_EepromData /end MEASUREMENT
/begin MEASUREMENT ZFEH_EepromData.di_obd_iumpr_comp_active_lock[10] "information that denominator is locked by component not active (bitcoded error codes) [0 .. 16-1]" UWORD EH_STANDARD_S4_S3 1 100 0 65535 ECU_ADDRESS 0xFFF83372 DISPLAY_IDENTIFIER di_obd_iumpr_comp_active_lock[10].ZFEH_EepromData /end MEASUREMENT
/begin MEASUREMENT ZFEH_EepromData.di_obd_iumpr_comp_active_lock[11] "information that denominator is locked by component not active (bitcoded error codes) [0 .. 16-1]" UWORD EH_STANDARD_S4_S3 1 100 0 65535 ECU_ADDRESS 0xFFF83374 DISPLAY_IDENTIFIER di_obd_iumpr_comp_active_lock[11].ZFEH_EepromData /end MEASUREMENT
/begin MEASUREMENT ZFEH_EepromData.di_obd_iumpr_comp_active_lock[12] "information that denominator is locked by component not active (bitcoded error codes) [0 .. 16-1]" UWORD EH_STANDARD_S4_S3 1 100 0 65535 ECU_ADDRESS 0xFFF83376 DISPLAY_IDENTIFIER di_obd_iumpr_comp_active_lock[12].ZFEH_EepromData /end MEASUREMENT
/begin MEASUREMENT ZFEH_EepromData.di_obd_iumpr_comp_active_lock[13] "information that denominator is locked by component not active (bitcoded error codes) [0 .. 16-1]" UWORD EH_STANDARD_S4_S3 1 100 0 65535 ECU_ADDRESS 0xFFF83378 DISPLAY_IDENTIFIER di_obd_iumpr_comp_active_lock[13].ZFEH_EepromData /end MEASUREMENT
/begin MEASUREMENT ZFEH_EepromData.di_obd_iumpr_comp_active_lock[14] "information that denominator is locked by component not active (bitcoded error codes) [0 .. 16-1]" UWORD EH_STANDARD_S4_S3 1 100 0 65535 ECU_ADDRESS 0xFFF8337A DISPLAY_IDENTIFIER di_obd_iumpr_comp_active_lock[14].ZFEH_EepromData /end MEASUREMENT
/begin MEASUREMENT ZFEH_EepromData.di_obd_iumpr_comp_active_lock[15] "information that denominator is locked by component not active (bitcoded error codes) [0 .. 16-1]" UWORD EH_STANDARD_S4_S3 1 100 0 65535 ECU_ADDRESS 0xFFF8337C DISPLAY_IDENTIFIER di_obd_iumpr_comp_active_lock[15].ZFEH_EepromData /end MEASUREMENT
/begin MEASUREMENT ZFEH_EepromData.di_obd_iumpr_comp_active_lock[1] "information that denominator is locked by component not active (bitcoded error codes) [0 .. 16-1]" UWORD EH_STANDARD_S4_S3 1 100 0 65535 ECU_ADDRESS 0xFFF83360 DISPLAY_IDENTIFIER di_obd_iumpr_comp_active_lock[1].ZFEH_EepromData /end MEASUREMENT
/begin MEASUREMENT ZFEH_EepromData.di_obd_iumpr_comp_active_lock[2] "information that denominator is locked by component not active (bitcoded error codes) [0 .. 16-1]" UWORD EH_STANDARD_S4_S3 1 100 0 65535 ECU_ADDRESS 0xFFF83362 DISPLAY_IDENTIFIER di_obd_iumpr_comp_active_lock[2].ZFEH_EepromData /end MEASUREMENT
/begin MEASUREMENT ZFEH_EepromData.di_obd_iumpr_comp_active_lock[3] "information that denominator is locked by component not active (bitcoded error codes) [0 .. 16-1]" UWORD EH_STANDARD_S4_S3 1 100 0 65535 ECU_ADDRESS 0xFFF83364 DISPLAY_IDENTIFIER di_obd_iumpr_comp_active_lock[3].ZFEH_EepromData /end MEASUREMENT
/begin MEASUREMENT ZFEH_EepromData.di_obd_iumpr_comp_active_lock[4] "information that denominator is locked by component not active (bitcoded error codes) [0 .. 16-1]" UWORD EH_STANDARD_S4_S3 1 100 0 65535 ECU_ADDRESS 0xFFF83366 DISPLAY_IDENTIFIER di_obd_iumpr_comp_active_lock[4].ZFEH_EepromData /end MEASUREMENT
/begin MEASUREMENT ZFEH_EepromData.di_obd_iumpr_comp_active_lock[5] "information that denominator is locked by component not active (bitcoded error codes) [0 .. 16-1]" UWORD EH_STANDARD_S4_S3 1 100 0 65535 ECU_ADDRESS 0xFFF83368 DISPLAY_IDENTIFIER di_obd_iumpr_comp_active_lock[5].ZFEH_EepromData /end MEASUREMENT
/begin MEASUREMENT ZFEH_EepromData.di_obd_iumpr_comp_active_lock[6] "information that denominator is locked by component not active (bitcoded error codes) [0 .. 16-1]" UWORD EH_STANDARD_S4_S3 1 100 0 65535 ECU_ADDRESS 0xFFF8336A DISPLAY_IDENTIFIER di_obd_iumpr_comp_active_lock[6].ZFEH_EepromData /end MEASUREMENT
/begin MEASUREMENT ZFEH_EepromData.di_obd_iumpr_comp_active_lock[7] "information that denominator is locked by component not active (bitcoded error codes) [0 .. 16-1]" UWORD EH_STANDARD_S4_S3 1 100 0 65535 ECU_ADDRESS 0xFFF8336C DISPLAY_IDENTIFIER di_obd_iumpr_comp_active_lock[7].ZFEH_EepromData /end MEASUREMENT
/begin MEASUREMENT ZFEH_EepromData.di_obd_iumpr_comp_active_lock[8] "information that denominator is locked by component not active (bitcoded error codes) [0 .. 16-1]" UWORD EH_STANDARD_S4_S3 1 100 0 65535 ECU_ADDRESS 0xFFF8336E DISPLAY_IDENTIFIER di_obd_iumpr_comp_active_lock[8].ZFEH_EepromData /end MEASUREMENT
/begin MEASUREMENT ZFEH_EepromData.di_obd_iumpr_comp_active_lock[9] "information that denominator is locked by component not active (bitcoded error codes) [0 .. 16-1]" UWORD EH_STANDARD_S4_S3 1 100 0 65535 ECU_ADDRESS 0xFFF83370 DISPLAY_IDENTIFIER di_obd_iumpr_comp_active_lock[9].ZFEH_EepromData /end MEASUREMENT
/begin MEASUREMENT ZFEH_EepromData.di_obd_iumpr_comp_active_time[0] "error code related component active time [0 .. 254-1]" UBYTE EH_STANDARD_S4_S3 1 100 0 255 ECU_ADDRESS 0xFFF83260 DISPLAY_IDENTIFIER di_obd_iumpr_comp_active_time[0].ZFEH_EepromData /end MEASUREMENT
/begin MEASUREMENT ZFEH_EepromData.di_obd_iumpr_comp_active_time[100] "error code related component active time [0 .. 254-1]" UBYTE EH_STANDARD_S4_S3 1 100 0 255 ECU_ADDRESS 0xFFF832C4 DISPLAY_IDENTIFIER di_obd_iumpr_comp_active_time[100].ZFEH_EepromData /end MEASUREMENT
/begin MEASUREMENT ZFEH_EepromData.di_obd_iumpr_comp_active_time[101] "error code related component active time [0 .. 254-1]" UBYTE EH_STANDARD_S4_S3 1 100 0 255 ECU_ADDRESS 0xFFF832C5 DISPLAY_IDENTIFIER di_obd_iumpr_comp_active_time[101].ZFEH_EepromData /end MEASUREMENT
/begin MEASUREMENT ZFEH_EepromData.di_obd_iumpr_comp_active_time[102] "error code related component active time [0 .. 254-1]" UBYTE EH_STANDARD_S4_S3 1 100 0 255 ECU_ADDRESS 0xFFF832C6 DISPLAY_IDENTIFIER di_obd_iumpr_comp_active_time[102].ZFEH_EepromData /end MEASUREMENT
/begin MEASUREMENT ZFEH_EepromData.di_obd_iumpr_comp_active_time[103] "error code related component active time [0 .. 254-1]" UBYTE EH_STANDARD_S4_S3 1 100 0 255 ECU_ADDRESS 0xFFF832C7 DISPLAY_IDENTIFIER di_obd_iumpr_comp_active_time[103].ZFEH_EepromData /end MEASUREMENT
/begin MEASUREMENT ZFEH_EepromData.di_obd_iumpr_comp_active_time[104] "error code related component active time [0 .. 254-1]" UBYTE EH_STANDARD_S4_S3 1 100 0 255 ECU_ADDRESS 0xFFF832C8 DISPLAY_IDENTIFIER di_obd_iumpr_comp_active_time[104].ZFEH_EepromData /end MEASUREMENT
/begin MEASUREMENT ZFEH_EepromData.di_obd_iumpr_comp_active_time[105] "error code related component active time [0 .. 254-1]" UBYTE EH_STANDARD_S4_S3 1 100 0 255 ECU_ADDRESS 0xFFF832C9 DISPLAY_IDENTIFIER di_obd_iumpr_comp_active_time[105].ZFEH_EepromData /end MEASUREMENT
/begin MEASUREMENT ZFEH_EepromData.di_obd_iumpr_comp_active_time[106] "error code related component active time [0 .. 254-1]" UBYTE EH_STANDARD_S4_S3 1 100 0 255 ECU_ADDRESS 0xFFF832CA DISPLAY_IDENTIFIER di_obd_iumpr_comp_active_time[106].ZFEH_EepromData /end MEASUREMENT
/begin MEASUREMENT ZFEH_EepromData.di_obd_iumpr_comp_active_time[107] "error code related component active time [0 .. 254-1]" UBYTE EH_STANDARD_S4_S3 1 100 0 255 ECU_ADDRESS 0xFFF832CB DISPLAY_IDENTIFIER di_obd_iumpr_comp_active_time[107].ZFEH_EepromData /end MEASUREMENT
/begin MEASUREMENT ZFEH_EepromData.di_obd_iumpr_comp_active_time[108] "error code related component active time [0 .. 254-1]" UBYTE EH_STANDARD_S4_S3 1 100 0 255 ECU_ADDRESS 0xFFF832CC DISPLAY_IDENTIFIER di_obd_iumpr_comp_active_time[108].ZFEH_EepromData /end MEASUREMENT
/begin MEASUREMENT ZFEH_EepromData.di_obd_iumpr_comp_active_time[109] "error code related component active time [0 .. 254-1]" UBYTE EH_STANDARD_S4_S3 1 100 0 255 ECU_ADDRESS 0xFFF832CD DISPLAY_IDENTIFIER di_obd_iumpr_comp_active_time[109].ZFEH_EepromData /end MEASUREMENT
/begin MEASUREMENT ZFEH_EepromData.di_obd_iumpr_comp_active_time[10] "error code related component active time [0 .. 254-1]" UBYTE EH_STANDARD_S4_S3 1 100 0 255 ECU_ADDRESS 0xFFF8326A DISPLAY_IDENTIFIER di_obd_iumpr_comp_active_time[10].ZFEH_EepromData /end MEASUREMENT
/begin MEASUREMENT ZFEH_EepromData.di_obd_iumpr_comp_active_time[110] "error code related component active time [0 .. 254-1]" UBYTE EH_STANDARD_S4_S3 1 100 0 255 ECU_ADDRESS 0xFFF832CE DISPLAY_IDENTIFIER di_obd_iumpr_comp_active_time[110].ZFEH_EepromData /end MEASUREMENT
/begin MEASUREMENT ZFEH_EepromData.di_obd_iumpr_comp_active_time[111] "error code related component active time [0 .. 254-1]" UBYTE EH_STANDARD_S4_S3 1 100 0 255 ECU_ADDRESS 0xFFF832CF DISPLAY_IDENTIFIER di_obd_iumpr_comp_active_time[111].ZFEH_EepromData /end MEASUREMENT
/begin MEASUREMENT ZFEH_EepromData.di_obd_iumpr_comp_active_time[112] "error code related component active time [0 .. 254-1]" UBYTE EH_STANDARD_S4_S3 1 100 0 255 ECU_ADDRESS 0xFFF832D0 DISPLAY_IDENTIFIER di_obd_iumpr_comp_active_time[112].ZFEH_EepromData /end MEASUREMENT
/begin MEASUREMENT ZFEH_EepromData.di_obd_iumpr_comp_active_time[113] "error code related component active time [0 .. 254-1]" UBYTE EH_STANDARD_S4_S3 1 100 0 255 ECU_ADDRESS 0xFFF832D1 DISPLAY_IDENTIFIER di_obd_iumpr_comp_active_time[113].ZFEH_EepromData /end MEASUREMENT
/begin MEASUREMENT ZFEH_EepromData.di_obd_iumpr_comp_active_time[114] "error code related component active time [0 .. 254-1]" UBYTE EH_STANDARD_S4_S3 1 100 0 255 ECU_ADDRESS 0xFFF832D2 DISPLAY_IDENTIFIER di_obd_iumpr_comp_active_time[114].ZFEH_EepromData /end MEASUREMENT
/begin MEASUREMENT ZFEH_EepromData.di_obd_iumpr_comp_active_time[115] "error code related component active time [0 .. 254-1]" UBYTE EH_STANDARD_S4_S3 1 100 0 255 ECU_ADDRESS 0xFFF832D3 DISPLAY_IDENTIFIER di_obd_iumpr_comp_active_time[115].ZFEH_EepromData /end MEASUREMENT
/begin MEASUREMENT ZFEH_EepromData.di_obd_iumpr_comp_active_time[116] "error code related component active time [0 .. 254-1]" UBYTE EH_STANDARD_S4_S3 1 100 0 255 ECU_ADDRESS 0xFFF832D4 DISPLAY_IDENTIFIER di_obd_iumpr_comp_active_time[116].ZFEH_EepromData /end MEASUREMENT
/begin MEASUREMENT ZFEH_EepromData.di_obd_iumpr_comp_active_time[117] "error code related component active time [0 .. 254-1]" UBYTE EH_STANDARD_S4_S3 1 100 0 255 ECU_ADDRESS 0xFFF832D5 DISPLAY_IDENTIFIER di_obd_iumpr_comp_active_time[117].ZFEH_EepromData /end MEASUREMENT
/begin MEASUREMENT ZFEH_EepromData.di_obd_iumpr_comp_active_time[118] "error code related component active time [0 .. 254-1]" UBYTE EH_STANDARD_S4_S3 1 100 0 255 ECU_ADDRESS 0xFFF832D6 DISPLAY_IDENTIFIER di_obd_iumpr_comp_active_time[118].ZFEH_EepromData /end MEASUREMENT
/begin MEASUREMENT ZFEH_EepromData.di_obd_iumpr_comp_active_time[119] "error code related component active time [0 .. 254-1]" UBYTE EH_STANDARD_S4_S3 1 100 0 255 ECU_ADDRESS 0xFFF832D7 DISPLAY_IDENTIFIER di_obd_iumpr_comp_active_time[119].ZFEH_EepromData /end MEASUREMENT
/begin MEASUREMENT ZFEH_EepromData.di_obd_iumpr_comp_active_time[11] "error code related component active time [0 .. 254-1]" UBYTE EH_STANDARD_S4_S3 1 100 0 255 ECU_ADDRESS 0xFFF8326B DISPLAY_IDENTIFIER di_obd_iumpr_comp_active_time[11].ZFEH_EepromData /end MEASUREMENT
/begin MEASUREMENT ZFEH_EepromData.di_obd_iumpr_comp_active_time[120] "error code related component active time [0 .. 254-1]" UBYTE EH_STANDARD_S4_S3 1 100 0 255 ECU_ADDRESS 0xFFF832D8 DISPLAY_IDENTIFIER di_obd_iumpr_comp_active_time[120].ZFEH_EepromData /end MEASUREMENT
/begin MEASUREMENT ZFEH_EepromData.di_obd_iumpr_comp_active_time[121] "error code related component active time [0 .. 254-1]" UBYTE EH_STANDARD_S4_S3 1 100 0 255 ECU_ADDRESS 0xFFF832D9 DISPLAY_IDENTIFIER di_obd_iumpr_comp_active_time[121].ZFEH_EepromData /end MEASUREMENT
/begin MEASUREMENT ZFEH_EepromData.di_obd_iumpr_comp_active_time[122] "error code related component active time [0 .. 254-1]" UBYTE EH_STANDARD_S4_S3 1 100 0 255 ECU_ADDRESS 0xFFF832DA DISPLAY_IDENTIFIER di_obd_iumpr_comp_active_time[122].ZFEH_EepromData /end MEASUREMENT
/begin MEASUREMENT ZFEH_EepromData.di_obd_iumpr_comp_active_time[123] "error code related component active time [0 .. 254-1]" UBYTE EH_STANDARD_S4_S3 1 100 0 255 ECU_ADDRESS 0xFFF832DB DISPLAY_IDENTIFIER di_obd_iumpr_comp_active_time[123].ZFEH_EepromData /end MEASUREMENT
/begin MEASUREMENT ZFEH_EepromData.di_obd_iumpr_comp_active_time[124] "error code related component active time [0 .. 254-1]" UBYTE EH_STANDARD_S4_S3 1 100 0 255 ECU_ADDRESS 0xFFF832DC DISPLAY_IDENTIFIER di_obd_iumpr_comp_active_time[124].ZFEH_EepromData /end MEASUREMENT
/begin MEASUREMENT ZFEH_EepromData.di_obd_iumpr_comp_active_time[125] "error code related component active time [0 .. 254-1]" UBYTE EH_STANDARD_S4_S3 1 100 0 255 ECU_ADDRESS 0xFFF832DD DISPLAY_IDENTIFIER di_obd_iumpr_comp_active_time[125].ZFEH_EepromData /end MEASUREMENT
/begin MEASUREMENT ZFEH_EepromData.di_obd_iumpr_comp_active_time[126] "error code related component active time [0 .. 254-1]" UBYTE EH_STANDARD_S4_S3 1 100 0 255 ECU_ADDRESS 0xFFF832DE DISPLAY_IDENTIFIER di_obd_iumpr_comp_active_time[126].ZFEH_EepromData /end MEASUREMENT
/begin MEASUREMENT ZFEH_EepromData.di_obd_iumpr_comp_active_time[127] "error code related component active time [0 .. 254-1]" UBYTE EH_STANDARD_S4_S3 1 100 0 255 ECU_ADDRESS 0xFFF832DF DISPLAY_IDENTIFIER di_obd_iumpr_comp_active_time[127].ZFEH_EepromData /end MEASUREMENT
/begin MEASUREMENT ZFEH_EepromData.di_obd_iumpr_comp_active_time[128] "error code related component active time [0 .. 254-1]" UBYTE EH_STANDARD_S4_S3 1 100 0 255 ECU_ADDRESS 0xFFF832E0 DISPLAY_IDENTIFIER di_obd_iumpr_comp_active_time[128].ZFEH_EepromData /end MEASUREMENT
/begin MEASUREMENT ZFEH_EepromData.di_obd_iumpr_comp_active_time[129] "error code related component active time [0 .. 254-1]" UBYTE EH_STANDARD_S4_S3 1 100 0 255 ECU_ADDRESS 0xFFF832E1 DISPLAY_IDENTIFIER di_obd_iumpr_comp_active_time[129].ZFEH_EepromData /end MEASUREMENT
/begin MEASUREMENT ZFEH_EepromData.di_obd_iumpr_comp_active_time[12] "error code related component active time [0 .. 254-1]" UBYTE EH_STANDARD_S4_S3 1 100 0 255 ECU_ADDRESS 0xFFF8326C DISPLAY_IDENTIFIER di_obd_iumpr_comp_active_time[12].ZFEH_EepromData /end MEASUREMENT
/begin MEASUREMENT ZFEH_EepromData.di_obd_iumpr_comp_active_time[130] "error code related component active time [0 .. 254-1]" UBYTE EH_STANDARD_S4_S3 1 100 0 255 ECU_ADDRESS 0xFFF832E2 DISPLAY_IDENTIFIER di_obd_iumpr_comp_active_time[130].ZFEH_EepromData /end MEASUREMENT
/begin MEASUREMENT ZFEH_EepromData.di_obd_iumpr_comp_active_time[131] "error code related component active time [0 .. 254-1]" UBYTE EH_STANDARD_S4_S3 1 100 0 255 ECU_ADDRESS 0xFFF832E3 DISPLAY_IDENTIFIER di_obd_iumpr_comp_active_time[131].ZFEH_EepromData /end MEASUREMENT
/begin MEASUREMENT ZFEH_EepromData.di_obd_iumpr_comp_active_time[132] "error code related component active time [0 .. 254-1]" UBYTE EH_STANDARD_S4_S3 1 100 0 255 ECU_ADDRESS 0xFFF832E4 DISPLAY_IDENTIFIER di_obd_iumpr_comp_active_time[132].ZFEH_EepromData /end MEASUREMENT
/begin MEASUREMENT ZFEH_EepromData.di_obd_iumpr_comp_active_time[133] "error code related component active time [0 .. 254-1]" UBYTE EH_STANDARD_S4_S3 1 100 0 255 ECU_ADDRESS 0xFFF832E5 DISPLAY_IDENTIFIER di_obd_iumpr_comp_active_time[133].ZFEH_EepromData /end MEASUREMENT
/begin MEASUREMENT ZFEH_EepromData.di_obd_iumpr_comp_active_time[134] "error code related component active time [0 .. 254-1]" UBYTE EH_STANDARD_S4_S3 1 100 0 255 ECU_ADDRESS 0xFFF832E6 DISPLAY_IDENTIFIER di_obd_iumpr_comp_active_time[134].ZFEH_EepromData /end MEASUREMENT
/begin MEASUREMENT ZFEH_EepromData.di_obd_iumpr_comp_active_time[135] "error code related component active time [0 .. 254-1]" UBYTE EH_STANDARD_S4_S3 1 100 0 255 ECU_ADDRESS 0xFFF832E7 DISPLAY_IDENTIFIER di_obd_iumpr_comp_active_time[135].ZFEH_EepromData /end MEASUREMENT
/begin MEASUREMENT ZFEH_EepromData.di_obd_iumpr_comp_active_time[136] "error code related component active time [0 .. 254-1]" UBYTE EH_STANDARD_S4_S3 1 100 0 255 ECU_ADDRESS 0xFFF832E8 DISPLAY_IDENTIFIER di_obd_iumpr_comp_active_time[136].ZFEH_EepromData /end MEASUREMENT
/begin MEASUREMENT ZFEH_EepromData.di_obd_iumpr_comp_active_time[137] "error code related component active time [0 .. 254-1]" UBYTE EH_STANDARD_S4_S3 1 100 0 255 ECU_ADDRESS 0xFFF832E9 DISPLAY_IDENTIFIER di_obd_iumpr_comp_active_time[137].ZFEH_EepromData /end MEASUREMENT
/begin MEASUREMENT ZFEH_EepromData.di_obd_iumpr_comp_active_time[138] "error code related component active time [0 .. 254-1]" UBYTE EH_STANDARD_S4_S3 1 100 0 255 ECU_ADDRESS 0xFFF832EA DISPLAY_IDENTIFIER di_obd_iumpr_comp_active_time[138].ZFEH_EepromData /end MEASUREMENT
/begin MEASUREMENT ZFEH_EepromData.di_obd_iumpr_comp_active_time[139] "error code related component active time [0 .. 254-1]" UBYTE EH_STANDARD_S4_S3 1 100 0 255 ECU_ADDRESS 0xFFF832EB DISPLAY_IDENTIFIER di_obd_iumpr_comp_active_time[139].ZFEH_EepromData /end MEASUREMENT
/begin MEASUREMENT ZFEH_EepromData.di_obd_iumpr_comp_active_time[13] "error code related component active time [0 .. 254-1]" UBYTE EH_STANDARD_S4_S3 1 100 0 255 ECU_ADDRESS 0xFFF8326D DISPLAY_IDENTIFIER di_obd_iumpr_comp_active_time[13].ZFEH_EepromData /end MEASUREMENT
/begin MEASUREMENT ZFEH_EepromData.di_obd_iumpr_comp_active_time[140] "error code related component active time [0 .. 254-1]" UBYTE EH_STANDARD_S4_S3 1 100 0 255 ECU_ADDRESS 0xFFF832EC DISPLAY_IDENTIFIER di_obd_iumpr_comp_active_time[140].ZFEH_EepromData /end MEASUREMENT
/begin MEASUREMENT ZFEH_EepromData.di_obd_iumpr_comp_active_time[141] "error code related component active time [0 .. 254-1]" UBYTE EH_STANDARD_S4_S3 1 100 0 255 ECU_ADDRESS 0xFFF832ED DISPLAY_IDENTIFIER di_obd_iumpr_comp_active_time[141].ZFEH_EepromData /end MEASUREMENT
/begin MEASUREMENT ZFEH_EepromData.di_obd_iumpr_comp_active_time[142] "error code related component active time [0 .. 254-1]" UBYTE EH_STANDARD_S4_S3 1 100 0 255 ECU_ADDRESS 0xFFF832EE DISPLAY_IDENTIFIER di_obd_iumpr_comp_active_time[142].ZFEH_EepromData /end MEASUREMENT
/begin MEASUREMENT ZFEH_EepromData.di_obd_iumpr_comp_active_time[143] "error code related component active time [0 .. 254-1]" UBYTE EH_STANDARD_S4_S3 1 100 0 255 ECU_ADDRESS 0xFFF832EF DISPLAY_IDENTIFIER di_obd_iumpr_comp_active_time[143].ZFEH_EepromData /end MEASUREMENT
/begin MEASUREMENT ZFEH_EepromData.di_obd_iumpr_comp_active_time[144] "error code related component active time [0 .. 254-1]" UBYTE EH_STANDARD_S4_S3 1 100 0 255 ECU_ADDRESS 0xFFF832F0 DISPLAY_IDENTIFIER di_obd_iumpr_comp_active_time[144].ZFEH_EepromData /end MEASUREMENT
/begin MEASUREMENT ZFEH_EepromData.di_obd_iumpr_comp_active_time[145] "error code related component active time [0 .. 254-1]" UBYTE EH_STANDARD_S4_S3 1 100 0 255 ECU_ADDRESS 0xFFF832F1 DISPLAY_IDENTIFIER di_obd_iumpr_comp_active_time[145].ZFEH_EepromData /end MEASUREMENT
/begin MEASUREMENT ZFEH_EepromData.di_obd_iumpr_comp_active_time[146] "error code related component active time [0 .. 254-1]" UBYTE EH_STANDARD_S4_S3 1 100 0 255 ECU_ADDRESS 0xFFF832F2 DISPLAY_IDENTIFIER di_obd_iumpr_comp_active_time[146].ZFEH_EepromData /end MEASUREMENT
/begin MEASUREMENT ZFEH_EepromData.di_obd_iumpr_comp_active_time[147] "error code related component active time [0 .. 254-1]" UBYTE EH_STANDARD_S4_S3 1 100 0 255 ECU_ADDRESS 0xFFF832F3 DISPLAY_IDENTIFIER di_obd_iumpr_comp_active_time[147].ZFEH_EepromData /end MEASUREMENT
/begin MEASUREMENT ZFEH_EepromData.di_obd_iumpr_comp_active_time[148] "error code related component active time [0 .. 254-1]" UBYTE EH_STANDARD_S4_S3 1 100 0 255 ECU_ADDRESS 0xFFF832F4 DISPLAY_IDENTIFIER di_obd_iumpr_comp_active_time[148].ZFEH_EepromData /end MEASUREMENT
/begin MEASUREMENT ZFEH_EepromData.di_obd_iumpr_comp_active_time[149] "error code related component active time [0 .. 254-1]" UBYTE EH_STANDARD_S4_S3 1 100 0 255 ECU_ADDRESS 0xFFF832F5 DISPLAY_IDENTIFIER di_obd_iumpr_comp_active_time[149].ZFEH_EepromData /end MEASUREMENT
/begin MEASUREMENT ZFEH_EepromData.di_obd_iumpr_comp_active_time[14] "error code related component active time [0 .. 254-1]" UBYTE EH_STANDARD_S4_S3 1 100 0 255 ECU_ADDRESS 0xFFF8326E DISPLAY_IDENTIFIER di_obd_iumpr_comp_active_time[14].ZFEH_EepromData /end MEASUREMENT
/begin MEASUREMENT ZFEH_EepromData.di_obd_iumpr_comp_active_time[150] "error code related component active time [0 .. 254-1]" UBYTE EH_STANDARD_S4_S3 1 100 0 255 ECU_ADDRESS 0xFFF832F6 DISPLAY_IDENTIFIER di_obd_iumpr_comp_active_time[150].ZFEH_EepromData /end MEASUREMENT
/begin MEASUREMENT ZFEH_EepromData.di_obd_iumpr_comp_active_time[151] "error code related component active time [0 .. 254-1]" UBYTE EH_STANDARD_S4_S3 1 100 0 255 ECU_ADDRESS 0xFFF832F7 DISPLAY_IDENTIFIER di_obd_iumpr_comp_active_time[151].ZFEH_EepromData /end MEASUREMENT
/begin MEASUREMENT ZFEH_EepromData.di_obd_iumpr_comp_active_time[152] "error code related component active time [0 .. 254-1]" UBYTE EH_STANDARD_S4_S3 1 100 0 255 ECU_ADDRESS 0xFFF832F8 DISPLAY_IDENTIFIER di_obd_iumpr_comp_active_time[152].ZFEH_EepromData /end MEASUREMENT
/begin MEASUREMENT ZFEH_EepromData.di_obd_iumpr_comp_active_time[153] "error code related component active time [0 .. 254-1]" UBYTE EH_STANDARD_S4_S3 1 100 0 255 ECU_ADDRESS 0xFFF832F9 DISPLAY_IDENTIFIER di_obd_iumpr_comp_active_time[153].ZFEH_EepromData /end MEASUREMENT
/begin MEASUREMENT ZFEH_EepromData.di_obd_iumpr_comp_active_time[154] "error code related component active time [0 .. 254-1]" UBYTE EH_STANDARD_S4_S3 1 100 0 255 ECU_ADDRESS 0xFFF832FA DISPLAY_IDENTIFIER di_obd_iumpr_comp_active_time[154].ZFEH_EepromData /end MEASUREMENT
/begin MEASUREMENT ZFEH_EepromData.di_obd_iumpr_comp_active_time[155] "error code related component active time [0 .. 254-1]" UBYTE EH_STANDARD_S4_S3 1 100 0 255 ECU_ADDRESS 0xFFF832FB DISPLAY_IDENTIFIER di_obd_iumpr_comp_active_time[155].ZFEH_EepromData /end MEASUREMENT
/begin MEASUREMENT ZFEH_EepromData.di_obd_iumpr_comp_active_time[156] "error code related component active time [0 .. 254-1]" UBYTE EH_STANDARD_S4_S3 1 100 0 255 ECU_ADDRESS 0xFFF832FC DISPLAY_IDENTIFIER di_obd_iumpr_comp_active_time[156].ZFEH_EepromData /end MEASUREMENT
/begin MEASUREMENT ZFEH_EepromData.di_obd_iumpr_comp_active_time[157] "error code related component active time [0 .. 254-1]" UBYTE EH_STANDARD_S4_S3 1 100 0 255 ECU_ADDRESS 0xFFF832FD DISPLAY_IDENTIFIER di_obd_iumpr_comp_active_time[157].ZFEH_EepromData /end MEASUREMENT
/begin MEASUREMENT ZFEH_EepromData.di_obd_iumpr_comp_active_time[158] "error code related component active time [0 .. 254-1]" UBYTE EH_STANDARD_S4_S3 1 100 0 255 ECU_ADDRESS 0xFFF832FE DISPLAY_IDENTIFIER di_obd_iumpr_comp_active_time[158].ZFEH_EepromData /end MEASUREMENT
/begin MEASUREMENT ZFEH_EepromData.di_obd_iumpr_comp_active_time[159] "error code related component active time [0 .. 254-1]" UBYTE EH_STANDARD_S4_S3 1 100 0 255 ECU_ADDRESS 0xFFF832FF DISPLAY_IDENTIFIER di_obd_iumpr_comp_active_time[159].ZFEH_EepromData /end MEASUREMENT
/begin MEASUREMENT ZFEH_EepromData.di_obd_iumpr_comp_active_time[15] "error code related component active time [0 .. 254-1]" UBYTE EH_STANDARD_S4_S3 1 100 0 255 ECU_ADDRESS 0xFFF8326F DISPLAY_IDENTIFIER di_obd_iumpr_comp_active_time[15].ZFEH_EepromData /end MEASUREMENT
/begin MEASUREMENT ZFEH_EepromData.di_obd_iumpr_comp_active_time[160] "error code related component active time [0 .. 254-1]" UBYTE EH_STANDARD_S4_S3 1 100 0 255 ECU_ADDRESS 0xFFF83300 DISPLAY_IDENTIFIER di_obd_iumpr_comp_active_time[160].ZFEH_EepromData /end MEASUREMENT
/begin MEASUREMENT ZFEH_EepromData.di_obd_iumpr_comp_active_time[161] "error code related component active time [0 .. 254-1]" UBYTE EH_STANDARD_S4_S3 1 100 0 255 ECU_ADDRESS 0xFFF83301 DISPLAY_IDENTIFIER di_obd_iumpr_comp_active_time[161].ZFEH_EepromData /end MEASUREMENT
/begin MEASUREMENT ZFEH_EepromData.di_obd_iumpr_comp_active_time[162] "error code related component active time [0 .. 254-1]" UBYTE EH_STANDARD_S4_S3 1 100 0 255 ECU_ADDRESS 0xFFF83302 DISPLAY_IDENTIFIER di_obd_iumpr_comp_active_time[162].ZFEH_EepromData /end MEASUREMENT
/begin MEASUREMENT ZFEH_EepromData.di_obd_iumpr_comp_active_time[163] "error code related component active time [0 .. 254-1]" UBYTE EH_STANDARD_S4_S3 1 100 0 255 ECU_ADDRESS 0xFFF83303 DISPLAY_IDENTIFIER di_obd_iumpr_comp_active_time[163].ZFEH_EepromData /end MEASUREMENT
/begin MEASUREMENT ZFEH_EepromData.di_obd_iumpr_comp_active_time[164] "error code related component active time [0 .. 254-1]" UBYTE EH_STANDARD_S4_S3 1 100 0 255 ECU_ADDRESS 0xFFF83304 DISPLAY_IDENTIFIER di_obd_iumpr_comp_active_time[164].ZFEH_EepromData /end MEASUREMENT
/begin MEASUREMENT ZFEH_EepromData.di_obd_iumpr_comp_active_time[165] "error code related component active time [0 .. 254-1]" UBYTE EH_STANDARD_S4_S3 1 100 0 255 ECU_ADDRESS 0xFFF83305 DISPLAY_IDENTIFIER di_obd_iumpr_comp_active_time[165].ZFEH_EepromData /end MEASUREMENT
/begin MEASUREMENT ZFEH_EepromData.di_obd_iumpr_comp_active_time[166] "error code related component active time [0 .. 254-1]" UBYTE EH_STANDARD_S4_S3 1 100 0 255 ECU_ADDRESS 0xFFF83306 DISPLAY_IDENTIFIER di_obd_iumpr_comp_active_time[166].ZFEH_EepromData /end MEASUREMENT
/begin MEASUREMENT ZFEH_EepromData.di_obd_iumpr_comp_active_time[167] "error code related component active time [0 .. 254-1]" UBYTE EH_STANDARD_S4_S3 1 100 0 255 ECU_ADDRESS 0xFFF83307 DISPLAY_IDENTIFIER di_obd_iumpr_comp_active_time[167].ZFEH_EepromData /end MEASUREMENT
/begin MEASUREMENT ZFEH_EepromData.di_obd_iumpr_comp_active_time[168] "error code related component active time [0 .. 254-1]" UBYTE EH_STANDARD_S4_S3 1 100 0 255 ECU_ADDRESS 0xFFF83308 DISPLAY_IDENTIFIER di_obd_iumpr_comp_active_time[168].ZFEH_EepromData /end MEASUREMENT
/begin MEASUREMENT ZFEH_EepromData.di_obd_iumpr_comp_active_time[169] "error code related component active time [0 .. 254-1]" UBYTE EH_STANDARD_S4_S3 1 100 0 255 ECU_ADDRESS 0xFFF83309 DISPLAY_IDENTIFIER di_obd_iumpr_comp_active_time[169].ZFEH_EepromData /end MEASUREMENT
/begin MEASUREMENT ZFEH_EepromData.di_obd_iumpr_comp_active_time[16] "error code related component active time [0 .. 254-1]" UBYTE EH_STANDARD_S4_S3 1 100 0 255 ECU_ADDRESS 0xFFF83270 DISPLAY_IDENTIFIER di_obd_iumpr_comp_active_time[16].ZFEH_EepromData /end MEASUREMENT
/begin MEASUREMENT ZFEH_EepromData.di_obd_iumpr_comp_active_time[170] "error code related component active time [0 .. 254-1]" UBYTE EH_STANDARD_S4_S3 1 100 0 255 ECU_ADDRESS 0xFFF8330A DISPLAY_IDENTIFIER di_obd_iumpr_comp_active_time[170].ZFEH_EepromData /end MEASUREMENT
/begin MEASUREMENT ZFEH_EepromData.di_obd_iumpr_comp_active_time[171] "error code related component active time [0 .. 254-1]" UBYTE EH_STANDARD_S4_S3 1 100 0 255 ECU_ADDRESS 0xFFF8330B DISPLAY_IDENTIFIER di_obd_iumpr_comp_active_time[171].ZFEH_EepromData /end MEASUREMENT
/begin MEASUREMENT ZFEH_EepromData.di_obd_iumpr_comp_active_time[172] "error code related component active time [0 .. 254-1]" UBYTE EH_STANDARD_S4_S3 1 100 0 255 ECU_ADDRESS 0xFFF8330C DISPLAY_IDENTIFIER di_obd_iumpr_comp_active_time[172].ZFEH_EepromData /end MEASUREMENT
/begin MEASUREMENT ZFEH_EepromData.di_obd_iumpr_comp_active_time[173] "error code related component active time [0 .. 254-1]" UBYTE EH_STANDARD_S4_S3 1 100 0 255 ECU_ADDRESS 0xFFF8330D DISPLAY_IDENTIFIER di_obd_iumpr_comp_active_time[173].ZFEH_EepromData /end MEASUREMENT
/begin MEASUREMENT ZFEH_EepromData.di_obd_iumpr_comp_active_time[174] "error code related component active time [0 .. 254-1]" UBYTE EH_STANDARD_S4_S3 1 100 0 255 ECU_ADDRESS 0xFFF8330E DISPLAY_IDENTIFIER di_obd_iumpr_comp_active_time[174].ZFEH_EepromData /end MEASUREMENT
/begin MEASUREMENT ZFEH_EepromData.di_obd_iumpr_comp_active_time[175] "error code related component active time [0 .. 254-1]" UBYTE EH_STANDARD_S4_S3 1 100 0 255 ECU_ADDRESS 0xFFF8330F DISPLAY_IDENTIFIER di_obd_iumpr_comp_active_time[175].ZFEH_EepromData /end MEASUREMENT
/begin MEASUREMENT ZFEH_EepromData.di_obd_iumpr_comp_active_time[176] "error code related component active time [0 .. 254-1]" UBYTE EH_STANDARD_S4_S3 1 100 0 255 ECU_ADDRESS 0xFFF83310 DISPLAY_IDENTIFIER di_obd_iumpr_comp_active_time[176].ZFEH_EepromData /end MEASUREMENT
/begin MEASUREMENT ZFEH_EepromData.di_obd_iumpr_comp_active_time[177] "error code related component active time [0 .. 254-1]" UBYTE EH_STANDARD_S4_S3 1 100 0 255 ECU_ADDRESS 0xFFF83311 DISPLAY_IDENTIFIER di_obd_iumpr_comp_active_time[177].ZFEH_EepromData /end MEASUREMENT
/begin MEASUREMENT ZFEH_EepromData.di_obd_iumpr_comp_active_time[178] "error code related component active time [0 .. 254-1]" UBYTE EH_STANDARD_S4_S3 1 100 0 255 ECU_ADDRESS 0xFFF83312 DISPLAY_IDENTIFIER di_obd_iumpr_comp_active_time[178].ZFEH_EepromData /end MEASUREMENT
/begin MEASUREMENT ZFEH_EepromData.di_obd_iumpr_comp_active_time[179] "error code related component active time [0 .. 254-1]" UBYTE EH_STANDARD_S4_S3 1 100 0 255 ECU_ADDRESS 0xFFF83313 DISPLAY_IDENTIFIER di_obd_iumpr_comp_active_time[179].ZFEH_EepromData /end MEASUREMENT
/begin MEASUREMENT ZFEH_EepromData.di_obd_iumpr_comp_active_time[17] "error code related component active time [0 .. 254-1]" UBYTE EH_STANDARD_S4_S3 1 100 0 255 ECU_ADDRESS 0xFFF83271 DISPLAY_IDENTIFIER di_obd_iumpr_comp_active_time[17].ZFEH_EepromData /end MEASUREMENT
/begin MEASUREMENT ZFEH_EepromData.di_obd_iumpr_comp_active_time[180] "error code related component active time [0 .. 254-1]" UBYTE EH_STANDARD_S4_S3 1 100 0 255 ECU_ADDRESS 0xFFF83314 DISPLAY_IDENTIFIER di_obd_iumpr_comp_active_time[180].ZFEH_EepromData /end MEASUREMENT
/begin MEASUREMENT ZFEH_EepromData.di_obd_iumpr_comp_active_time[181] "error code related component active time [0 .. 254-1]" UBYTE EH_STANDARD_S4_S3 1 100 0 255 ECU_ADDRESS 0xFFF83315 DISPLAY_IDENTIFIER di_obd_iumpr_comp_active_time[181].ZFEH_EepromData /end MEASUREMENT
/begin MEASUREMENT ZFEH_EepromData.di_obd_iumpr_comp_active_time[182] "error code related component active time [0 .. 254-1]" UBYTE EH_STANDARD_S4_S3 1 100 0 255 ECU_ADDRESS 0xFFF83316 DISPLAY_IDENTIFIER di_obd_iumpr_comp_active_time[182].ZFEH_EepromData /end MEASUREMENT
/begin MEASUREMENT ZFEH_EepromData.di_obd_iumpr_comp_active_time[183] "error code related component active time [0 .. 254-1]" UBYTE EH_STANDARD_S4_S3 1 100 0 255 ECU_ADDRESS 0xFFF83317 DISPLAY_IDENTIFIER di_obd_iumpr_comp_active_time[183].ZFEH_EepromData /end MEASUREMENT
/begin MEASUREMENT ZFEH_EepromData.di_obd_iumpr_comp_active_time[184] "error code related component active time [0 .. 254-1]" UBYTE EH_STANDARD_S4_S3 1 100 0 255 ECU_ADDRESS 0xFFF83318 DISPLAY_IDENTIFIER di_obd_iumpr_comp_active_time[184].ZFEH_EepromData /end MEASUREMENT
/begin MEASUREMENT ZFEH_EepromData.di_obd_iumpr_comp_active_time[185] "error code related component active time [0 .. 254-1]" UBYTE EH_STANDARD_S4_S3 1 100 0 255 ECU_ADDRESS 0xFFF83319 DISPLAY_IDENTIFIER di_obd_iumpr_comp_active_time[185].ZFEH_EepromData /end MEASUREMENT
/begin MEASUREMENT ZFEH_EepromData.di_obd_iumpr_comp_active_time[186] "error code related component active time [0 .. 254-1]" UBYTE EH_STANDARD_S4_S3 1 100 0 255 ECU_ADDRESS 0xFFF8331A DISPLAY_IDENTIFIER di_obd_iumpr_comp_active_time[186].ZFEH_EepromData /end MEASUREMENT
/begin MEASUREMENT ZFEH_EepromData.di_obd_iumpr_comp_active_time[187] "error code related component active time [0 .. 254-1]" UBYTE EH_STANDARD_S4_S3 1 100 0 255 ECU_ADDRESS 0xFFF8331B DISPLAY_IDENTIFIER di_obd_iumpr_comp_active_time[187].ZFEH_EepromData /end MEASUREMENT
/begin MEASUREMENT ZFEH_EepromData.di_obd_iumpr_comp_active_time[188] "error code related component active time [0 .. 254-1]" UBYTE EH_STANDARD_S4_S3 1 100 0 255 ECU_ADDRESS 0xFFF8331C DISPLAY_IDENTIFIER di_obd_iumpr_comp_active_time[188].ZFEH_EepromData /end MEASUREMENT
/begin MEASUREMENT ZFEH_EepromData.di_obd_iumpr_comp_active_time[189] "error code related component active time [0 .. 254-1]" UBYTE EH_STANDARD_S4_S3 1 100 0 255 ECU_ADDRESS 0xFFF8331D DISPLAY_IDENTIFIER di_obd_iumpr_comp_active_time[189].ZFEH_EepromData /end MEASUREMENT
/begin MEASUREMENT ZFEH_EepromData.di_obd_iumpr_comp_active_time[18] "error code related component active time [0 .. 254-1]" UBYTE EH_STANDARD_S4_S3 1 100 0 255 ECU_ADDRESS 0xFFF83272 DISPLAY_IDENTIFIER di_obd_iumpr_comp_active_time[18].ZFEH_EepromData /end MEASUREMENT
/begin MEASUREMENT ZFEH_EepromData.di_obd_iumpr_comp_active_time[190] "error code related component active time [0 .. 254-1]" UBYTE EH_STANDARD_S4_S3 1 100 0 255 ECU_ADDRESS 0xFFF8331E DISPLAY_IDENTIFIER di_obd_iumpr_comp_active_time[190].ZFEH_EepromData /end MEASUREMENT
/begin MEASUREMENT ZFEH_EepromData.di_obd_iumpr_comp_active_time[191] "error code related component active time [0 .. 254-1]" UBYTE EH_STANDARD_S4_S3 1 100 0 255 ECU_ADDRESS 0xFFF8331F DISPLAY_IDENTIFIER di_obd_iumpr_comp_active_time[191].ZFEH_EepromData /end MEASUREMENT
/begin MEASUREMENT ZFEH_EepromData.di_obd_iumpr_comp_active_time[192] "error code related component active time [0 .. 254-1]" UBYTE EH_STANDARD_S4_S3 1 100 0 255 ECU_ADDRESS 0xFFF83320 DISPLAY_IDENTIFIER di_obd_iumpr_comp_active_time[192].ZFEH_EepromData /end MEASUREMENT
/begin MEASUREMENT ZFEH_EepromData.di_obd_iumpr_comp_active_time[193] "error code related component active time [0 .. 254-1]" UBYTE EH_STANDARD_S4_S3 1 100 0 255 ECU_ADDRESS 0xFFF83321 DISPLAY_IDENTIFIER di_obd_iumpr_comp_active_time[193].ZFEH_EepromData /end MEASUREMENT
/begin MEASUREMENT ZFEH_EepromData.di_obd_iumpr_comp_active_time[194] "error code related component active time [0 .. 254-1]" UBYTE EH_STANDARD_S4_S3 1 100 0 255 ECU_ADDRESS 0xFFF83322 DISPLAY_IDENTIFIER di_obd_iumpr_comp_active_time[194].ZFEH_EepromData /end MEASUREMENT
/begin MEASUREMENT ZFEH_EepromData.di_obd_iumpr_comp_active_time[195] "error code related component active time [0 .. 254-1]" UBYTE EH_STANDARD_S4_S3 1 100 0 255 ECU_ADDRESS 0xFFF83323 DISPLAY_IDENTIFIER di_obd_iumpr_comp_active_time[195].ZFEH_EepromData /end MEASUREMENT
/begin MEASUREMENT ZFEH_EepromData.di_obd_iumpr_comp_active_time[196] "error code related component active time [0 .. 254-1]" UBYTE EH_STANDARD_S4_S3 1 100 0 255 ECU_ADDRESS 0xFFF83324 DISPLAY_IDENTIFIER di_obd_iumpr_comp_active_time[196].ZFEH_EepromData /end MEASUREMENT
/begin MEASUREMENT ZFEH_EepromData.di_obd_iumpr_comp_active_time[197] "error code related component active time [0 .. 254-1]" UBYTE EH_STANDARD_S4_S3 1 100 0 255 ECU_ADDRESS 0xFFF83325 DISPLAY_IDENTIFIER di_obd_iumpr_comp_active_time[197].ZFEH_EepromData /end MEASUREMENT
/begin MEASUREMENT ZFEH_EepromData.di_obd_iumpr_comp_active_time[198] "error code related component active time [0 .. 254-1]" UBYTE EH_STANDARD_S4_S3 1 100 0 255 ECU_ADDRESS 0xFFF83326 DISPLAY_IDENTIFIER di_obd_iumpr_comp_active_time[198].ZFEH_EepromData /end MEASUREMENT
/begin MEASUREMENT ZFEH_EepromData.di_obd_iumpr_comp_active_time[199] "error code related component active time [0 .. 254-1]" UBYTE EH_STANDARD_S4_S3 1 100 0 255 ECU_ADDRESS 0xFFF83327 DISPLAY_IDENTIFIER di_obd_iumpr_comp_active_time[199].ZFEH_EepromData /end MEASUREMENT
/begin MEASUREMENT ZFEH_EepromData.di_obd_iumpr_comp_active_time[19] "error code related component active time [0 .. 254-1]" UBYTE EH_STANDARD_S4_S3 1 100 0 255 ECU_ADDRESS 0xFFF83273 DISPLAY_IDENTIFIER di_obd_iumpr_comp_active_time[19].ZFEH_EepromData /end MEASUREMENT
/begin MEASUREMENT ZFEH_EepromData.di_obd_iumpr_comp_active_time[1] "error code related component active time [0 .. 254-1]" UBYTE EH_STANDARD_S4_S3 1 100 0 255 ECU_ADDRESS 0xFFF83261 DISPLAY_IDENTIFIER di_obd_iumpr_comp_active_time[1].ZFEH_EepromData /end MEASUREMENT
/begin MEASUREMENT ZFEH_EepromData.di_obd_iumpr_comp_active_time[200] "error code related component active time [0 .. 254-1]" UBYTE EH_STANDARD_S4_S3 1 100 0 255 ECU_ADDRESS 0xFFF83328 DISPLAY_IDENTIFIER di_obd_iumpr_comp_active_time[200].ZFEH_EepromData /end MEASUREMENT
/begin MEASUREMENT ZFEH_EepromData.di_obd_iumpr_comp_active_time[201] "error code related component active time [0 .. 254-1]" UBYTE EH_STANDARD_S4_S3 1 100 0 255 ECU_ADDRESS 0xFFF83329 DISPLAY_IDENTIFIER di_obd_iumpr_comp_active_time[201].ZFEH_EepromData /end MEASUREMENT
/begin MEASUREMENT ZFEH_EepromData.di_obd_iumpr_comp_active_time[202] "error code related component active time [0 .. 254-1]" UBYTE EH_STANDARD_S4_S3 1 100 0 255 ECU_ADDRESS 0xFFF8332A DISPLAY_IDENTIFIER di_obd_iumpr_comp_active_time[202].ZFEH_EepromData /end MEASUREMENT
/begin MEASUREMENT ZFEH_EepromData.di_obd_iumpr_comp_active_time[203] "error code related component active time [0 .. 254-1]" UBYTE EH_STANDARD_S4_S3 1 100 0 255 ECU_ADDRESS 0xFFF8332B DISPLAY_IDENTIFIER di_obd_iumpr_comp_active_time[203].ZFEH_EepromData /end MEASUREMENT
/begin MEASUREMENT ZFEH_EepromData.di_obd_iumpr_comp_active_time[204] "error code related component active time [0 .. 254-1]" UBYTE EH_STANDARD_S4_S3 1 100 0 255 ECU_ADDRESS 0xFFF8332C DISPLAY_IDENTIFIER di_obd_iumpr_comp_active_time[204].ZFEH_EepromData /end MEASUREMENT
/begin MEASUREMENT ZFEH_EepromData.di_obd_iumpr_comp_active_time[205] "error code related component active time [0 .. 254-1]" UBYTE EH_STANDARD_S4_S3 1 100 0 255 ECU_ADDRESS 0xFFF8332D DISPLAY_IDENTIFIER di_obd_iumpr_comp_active_time[205].ZFEH_EepromData /end MEASUREMENT
/begin MEASUREMENT ZFEH_EepromData.di_obd_iumpr_comp_active_time[206] "error code related component active time [0 .. 254-1]" UBYTE EH_STANDARD_S4_S3 1 100 0 255 ECU_ADDRESS 0xFFF8332E DISPLAY_IDENTIFIER di_obd_iumpr_comp_active_time[206].ZFEH_EepromData /end MEASUREMENT
/begin MEASUREMENT ZFEH_EepromData.di_obd_iumpr_comp_active_time[207] "error code related component active time [0 .. 254-1]" UBYTE EH_STANDARD_S4_S3 1 100 0 255 ECU_ADDRESS 0xFFF8332F DISPLAY_IDENTIFIER di_obd_iumpr_comp_active_time[207].ZFEH_EepromData /end MEASUREMENT
/begin MEASUREMENT ZFEH_EepromData.di_obd_iumpr_comp_active_time[208] "error code related component active time [0 .. 254-1]" UBYTE EH_STANDARD_S4_S3 1 100 0 255 ECU_ADDRESS 0xFFF83330 DISPLAY_IDENTIFIER di_obd_iumpr_comp_active_time[208].ZFEH_EepromData /end MEASUREMENT
/begin MEASUREMENT ZFEH_EepromData.di_obd_iumpr_comp_active_time[209] "error code related component active time [0 .. 254-1]" UBYTE EH_STANDARD_S4_S3 1 100 0 255 ECU_ADDRESS 0xFFF83331 DISPLAY_IDENTIFIER di_obd_iumpr_comp_active_time[209].ZFEH_EepromData /end MEASUREMENT
/begin MEASUREMENT ZFEH_EepromData.di_obd_iumpr_comp_active_time[20] "error code related component active time [0 .. 254-1]" UBYTE EH_STANDARD_S4_S3 1 100 0 255 ECU_ADDRESS 0xFFF83274 DISPLAY_IDENTIFIER di_obd_iumpr_comp_active_time[20].ZFEH_EepromData /end MEASUREMENT
/begin MEASUREMENT ZFEH_EepromData.di_obd_iumpr_comp_active_time[210] "error code related component active time [0 .. 254-1]" UBYTE EH_STANDARD_S4_S3 1 100 0 255 ECU_ADDRESS 0xFFF83332 DISPLAY_IDENTIFIER di_obd_iumpr_comp_active_time[210].ZFEH_EepromData /end MEASUREMENT
/begin MEASUREMENT ZFEH_EepromData.di_obd_iumpr_comp_active_time[211] "error code related component active time [0 .. 254-1]" UBYTE EH_STANDARD_S4_S3 1 100 0 255 ECU_ADDRESS 0xFFF83333 DISPLAY_IDENTIFIER di_obd_iumpr_comp_active_time[211].ZFEH_EepromData /end MEASUREMENT
/begin MEASUREMENT ZFEH_EepromData.di_obd_iumpr_comp_active_time[212] "error code related component active time [0 .. 254-1]" UBYTE EH_STANDARD_S4_S3 1 100 0 255 ECU_ADDRESS 0xFFF83334 DISPLAY_IDENTIFIER di_obd_iumpr_comp_active_time[212].ZFEH_EepromData /end MEASUREMENT
/begin MEASUREMENT ZFEH_EepromData.di_obd_iumpr_comp_active_time[213] "error code related component active time [0 .. 254-1]" UBYTE EH_STANDARD_S4_S3 1 100 0 255 ECU_ADDRESS 0xFFF83335 DISPLAY_IDENTIFIER di_obd_iumpr_comp_active_time[213].ZFEH_EepromData /end MEASUREMENT
/begin MEASUREMENT ZFEH_EepromData.di_obd_iumpr_comp_active_time[214] "error code related component active time [0 .. 254-1]" UBYTE EH_STANDARD_S4_S3 1 100 0 255 ECU_ADDRESS 0xFFF83336 DISPLAY_IDENTIFIER di_obd_iumpr_comp_active_time[214].ZFEH_EepromData /end MEASUREMENT
/begin MEASUREMENT ZFEH_EepromData.di_obd_iumpr_comp_active_time[215] "error code related component active time [0 .. 254-1]" UBYTE EH_STANDARD_S4_S3 1 100 0 255 ECU_ADDRESS 0xFFF83337 DISPLAY_IDENTIFIER di_obd_iumpr_comp_active_time[215].ZFEH_EepromData /end MEASUREMENT
/begin MEASUREMENT ZFEH_EepromData.di_obd_iumpr_comp_active_time[216] "error code related component active time [0 .. 254-1]" UBYTE EH_STANDARD_S4_S3 1 100 0 255 ECU_ADDRESS 0xFFF83338 DISPLAY_IDENTIFIER di_obd_iumpr_comp_active_time[216].ZFEH_EepromData /end MEASUREMENT
/begin MEASUREMENT ZFEH_EepromData.di_obd_iumpr_comp_active_time[217] "error code related component active time [0 .. 254-1]" UBYTE EH_STANDARD_S4_S3 1 100 0 255 ECU_ADDRESS 0xFFF83339 DISPLAY_IDENTIFIER di_obd_iumpr_comp_active_time[217].ZFEH_EepromData /end MEASUREMENT
/begin MEASUREMENT ZFEH_EepromData.di_obd_iumpr_comp_active_time[218] "error code related component active time [0 .. 254-1]" UBYTE EH_STANDARD_S4_S3 1 100 0 255 ECU_ADDRESS 0xFFF8333A DISPLAY_IDENTIFIER di_obd_iumpr_comp_active_time[218].ZFEH_EepromData /end MEASUREMENT
/begin MEASUREMENT ZFEH_EepromData.di_obd_iumpr_comp_active_time[219] "error code related component active time [0 .. 254-1]" UBYTE EH_STANDARD_S4_S3 1 100 0 255 ECU_ADDRESS 0xFFF8333B DISPLAY_IDENTIFIER di_obd_iumpr_comp_active_time[219].ZFEH_EepromData /end MEASUREMENT
/begin MEASUREMENT ZFEH_EepromData.di_obd_iumpr_comp_active_time[21] "error code related component active time [0 .. 254-1]" UBYTE EH_STANDARD_S4_S3 1 100 0 255 ECU_ADDRESS 0xFFF83275 DISPLAY_IDENTIFIER di_obd_iumpr_comp_active_time[21].ZFEH_EepromData /end MEASUREMENT
/begin MEASUREMENT ZFEH_EepromData.di_obd_iumpr_comp_active_time[220] "error code related component active time [0 .. 254-1]" UBYTE EH_STANDARD_S4_S3 1 100 0 255 ECU_ADDRESS 0xFFF8333C DISPLAY_IDENTIFIER di_obd_iumpr_comp_active_time[220].ZFEH_EepromData /end MEASUREMENT
/begin MEASUREMENT ZFEH_EepromData.di_obd_iumpr_comp_active_time[221] "error code related component active time [0 .. 254-1]" UBYTE EH_STANDARD_S4_S3 1 100 0 255 ECU_ADDRESS 0xFFF8333D DISPLAY_IDENTIFIER di_obd_iumpr_comp_active_time[221].ZFEH_EepromData /end MEASUREMENT
/begin MEASUREMENT ZFEH_EepromData.di_obd_iumpr_comp_active_time[222] "error code related component active time [0 .. 254-1]" UBYTE EH_STANDARD_S4_S3 1 100 0 255 ECU_ADDRESS 0xFFF8333E DISPLAY_IDENTIFIER di_obd_iumpr_comp_active_time[222].ZFEH_EepromData /end MEASUREMENT
/begin MEASUREMENT ZFEH_EepromData.di_obd_iumpr_comp_active_time[223] "error code related component active time [0 .. 254-1]" UBYTE EH_STANDARD_S4_S3 1 100 0 255 ECU_ADDRESS 0xFFF8333F DISPLAY_IDENTIFIER di_obd_iumpr_comp_active_time[223].ZFEH_EepromData /end MEASUREMENT
/begin MEASUREMENT ZFEH_EepromData.di_obd_iumpr_comp_active_time[224] "error code related component active time [0 .. 254-1]" UBYTE EH_STANDARD_S4_S3 1 100 0 255 ECU_ADDRESS 0xFFF83340 DISPLAY_IDENTIFIER di_obd_iumpr_comp_active_time[224].ZFEH_EepromData /end MEASUREMENT
/begin MEASUREMENT ZFEH_EepromData.di_obd_iumpr_comp_active_time[225] "error code related component active time [0 .. 254-1]" UBYTE EH_STANDARD_S4_S3 1 100 0 255 ECU_ADDRESS 0xFFF83341 DISPLAY_IDENTIFIER di_obd_iumpr_comp_active_time[225].ZFEH_EepromData /end MEASUREMENT
/begin MEASUREMENT ZFEH_EepromData.di_obd_iumpr_comp_active_time[226] "error code related component active time [0 .. 254-1]" UBYTE EH_STANDARD_S4_S3 1 100 0 255 ECU_ADDRESS 0xFFF83342 DISPLAY_IDENTIFIER di_obd_iumpr_comp_active_time[226].ZFEH_EepromData /end MEASUREMENT
/begin MEASUREMENT ZFEH_EepromData.di_obd_iumpr_comp_active_time[227] "error code related component active time [0 .. 254-1]" UBYTE EH_STANDARD_S4_S3 1 100 0 255 ECU_ADDRESS 0xFFF83343 DISPLAY_IDENTIFIER di_obd_iumpr_comp_active_time[227].ZFEH_EepromData /end MEASUREMENT
/begin MEASUREMENT ZFEH_EepromData.di_obd_iumpr_comp_active_time[228] "error code related component active time [0 .. 254-1]" UBYTE EH_STANDARD_S4_S3 1 100 0 255 ECU_ADDRESS 0xFFF83344 DISPLAY_IDENTIFIER di_obd_iumpr_comp_active_time[228].ZFEH_EepromData /end MEASUREMENT
/begin MEASUREMENT ZFEH_EepromData.di_obd_iumpr_comp_active_time[229] "error code related component active time [0 .. 254-1]" UBYTE EH_STANDARD_S4_S3 1 100 0 255 ECU_ADDRESS 0xFFF83345 DISPLAY_IDENTIFIER di_obd_iumpr_comp_active_time[229].ZFEH_EepromData /end MEASUREMENT
/begin MEASUREMENT ZFEH_EepromData.di_obd_iumpr_comp_active_time[22] "error code related component active time [0 .. 254-1]" UBYTE EH_STANDARD_S4_S3 1 100 0 255 ECU_ADDRESS 0xFFF83276 DISPLAY_IDENTIFIER di_obd_iumpr_comp_active_time[22].ZFEH_EepromData /end MEASUREMENT
/begin MEASUREMENT ZFEH_EepromData.di_obd_iumpr_comp_active_time[230] "error code related component active time [0 .. 254-1]" UBYTE EH_STANDARD_S4_S3 1 100 0 255 ECU_ADDRESS 0xFFF83346 DISPLAY_IDENTIFIER di_obd_iumpr_comp_active_time[230].ZFEH_EepromData /end MEASUREMENT
/begin MEASUREMENT ZFEH_EepromData.di_obd_iumpr_comp_active_time[231] "error code related component active time [0 .. 254-1]" UBYTE EH_STANDARD_S4_S3 1 100 0 255 ECU_ADDRESS 0xFFF83347 DISPLAY_IDENTIFIER di_obd_iumpr_comp_active_time[231].ZFEH_EepromData /end MEASUREMENT
/begin MEASUREMENT ZFEH_EepromData.di_obd_iumpr_comp_active_time[232] "error code related component active time [0 .. 254-1]" UBYTE EH_STANDARD_S4_S3 1 100 0 255 ECU_ADDRESS 0xFFF83348 DISPLAY_IDENTIFIER di_obd_iumpr_comp_active_time[232].ZFEH_EepromData /end MEASUREMENT
/begin MEASUREMENT ZFEH_EepromData.di_obd_iumpr_comp_active_time[233] "error code related component active time [0 .. 254-1]" UBYTE EH_STANDARD_S4_S3 1 100 0 255 ECU_ADDRESS 0xFFF83349 DISPLAY_IDENTIFIER di_obd_iumpr_comp_active_time[233].ZFEH_EepromData /end MEASUREMENT
/begin MEASUREMENT ZFEH_EepromData.di_obd_iumpr_comp_active_time[234] "error code related component active time [0 .. 254-1]" UBYTE EH_STANDARD_S4_S3 1 100 0 255 ECU_ADDRESS 0xFFF8334A DISPLAY_IDENTIFIER di_obd_iumpr_comp_active_time[234].ZFEH_EepromData /end MEASUREMENT
/begin MEASUREMENT ZFEH_EepromData.di_obd_iumpr_comp_active_time[235] "error code related component active time [0 .. 254-1]" UBYTE EH_STANDARD_S4_S3 1 100 0 255 ECU_ADDRESS 0xFFF8334B DISPLAY_IDENTIFIER di_obd_iumpr_comp_active_time[235].ZFEH_EepromData /end MEASUREMENT
/begin MEASUREMENT ZFEH_EepromData.di_obd_iumpr_comp_active_time[236] "error code related component active time [0 .. 254-1]" UBYTE EH_STANDARD_S4_S3 1 100 0 255 ECU_ADDRESS 0xFFF8334C DISPLAY_IDENTIFIER di_obd_iumpr_comp_active_time[236].ZFEH_EepromData /end MEASUREMENT
/begin MEASUREMENT ZFEH_EepromData.di_obd_iumpr_comp_active_time[237] "error code related component active time [0 .. 254-1]" UBYTE EH_STANDARD_S4_S3 1 100 0 255 ECU_ADDRESS 0xFFF8334D DISPLAY_IDENTIFIER di_obd_iumpr_comp_active_time[237].ZFEH_EepromData /end MEASUREMENT
/begin MEASUREMENT ZFEH_EepromData.di_obd_iumpr_comp_active_time[238] "error code related component active time [0 .. 254-1]" UBYTE EH_STANDARD_S4_S3 1 100 0 255 ECU_ADDRESS 0xFFF8334E DISPLAY_IDENTIFIER di_obd_iumpr_comp_active_time[238].ZFEH_EepromData /end MEASUREMENT
/begin MEASUREMENT ZFEH_EepromData.di_obd_iumpr_comp_active_time[239] "error code related component active time [0 .. 254-1]" UBYTE EH_STANDARD_S4_S3 1 100 0 255 ECU_ADDRESS 0xFFF8334F DISPLAY_IDENTIFIER di_obd_iumpr_comp_active_time[239].ZFEH_EepromData /end MEASUREMENT
/begin MEASUREMENT ZFEH_EepromData.di_obd_iumpr_comp_active_time[23] "error code related component active time [0 .. 254-1]" UBYTE EH_STANDARD_S4_S3 1 100 0 255 ECU_ADDRESS 0xFFF83277 DISPLAY_IDENTIFIER di_obd_iumpr_comp_active_time[23].ZFEH_EepromData /end MEASUREMENT
/begin MEASUREMENT ZFEH_EepromData.di_obd_iumpr_comp_active_time[240] "error code related component active time [0 .. 254-1]" UBYTE EH_STANDARD_S4_S3 1 100 0 255 ECU_ADDRESS 0xFFF83350 DISPLAY_IDENTIFIER di_obd_iumpr_comp_active_time[240].ZFEH_EepromData /end MEASUREMENT
/begin MEASUREMENT ZFEH_EepromData.di_obd_iumpr_comp_active_time[241] "error code related component active time [0 .. 254-1]" UBYTE EH_STANDARD_S4_S3 1 100 0 255 ECU_ADDRESS 0xFFF83351 DISPLAY_IDENTIFIER di_obd_iumpr_comp_active_time[241].ZFEH_EepromData /end MEASUREMENT
/begin MEASUREMENT ZFEH_EepromData.di_obd_iumpr_comp_active_time[242] "error code related component active time [0 .. 254-1]" UBYTE EH_STANDARD_S4_S3 1 100 0 255 ECU_ADDRESS 0xFFF83352 DISPLAY_IDENTIFIER di_obd_iumpr_comp_active_time[242].ZFEH_EepromData /end MEASUREMENT
/begin MEASUREMENT ZFEH_EepromData.di_obd_iumpr_comp_active_time[243] "error code related component active time [0 .. 254-1]" UBYTE EH_STANDARD_S4_S3 1 100 0 255 ECU_ADDRESS 0xFFF83353 DISPLAY_IDENTIFIER di_obd_iumpr_comp_active_time[243].ZFEH_EepromData /end MEASUREMENT
/begin MEASUREMENT ZFEH_EepromData.di_obd_iumpr_comp_active_time[244] "error code related component active time [0 .. 254-1]" UBYTE EH_STANDARD_S4_S3 1 100 0 255 ECU_ADDRESS 0xFFF83354 DISPLAY_IDENTIFIER di_obd_iumpr_comp_active_time[244].ZFEH_EepromData /end MEASUREMENT
/begin MEASUREMENT ZFEH_EepromData.di_obd_iumpr_comp_active_time[245] "error code related component active time [0 .. 254-1]" UBYTE EH_STANDARD_S4_S3 1 100 0 255 ECU_ADDRESS 0xFFF83355 DISPLAY_IDENTIFIER di_obd_iumpr_comp_active_time[245].ZFEH_EepromData /end MEASUREMENT
/begin MEASUREMENT ZFEH_EepromData.di_obd_iumpr_comp_active_time[246] "error code related component active time [0 .. 254-1]" UBYTE EH_STANDARD_S4_S3 1 100 0 255 ECU_ADDRESS 0xFFF83356 DISPLAY_IDENTIFIER di_obd_iumpr_comp_active_time[246].ZFEH_EepromData /end MEASUREMENT
/begin MEASUREMENT ZFEH_EepromData.di_obd_iumpr_comp_active_time[247] "error code related component active time [0 .. 254-1]" UBYTE EH_STANDARD_S4_S3 1 100 0 255 ECU_ADDRESS 0xFFF83357 DISPLAY_IDENTIFIER di_obd_iumpr_comp_active_time[247].ZFEH_EepromData /end MEASUREMENT
/begin MEASUREMENT ZFEH_EepromData.di_obd_iumpr_comp_active_time[248] "error code related component active time [0 .. 254-1]" UBYTE EH_STANDARD_S4_S3 1 100 0 255 ECU_ADDRESS 0xFFF83358 DISPLAY_IDENTIFIER di_obd_iumpr_comp_active_time[248].ZFEH_EepromData /end MEASUREMENT
/begin MEASUREMENT ZFEH_EepromData.di_obd_iumpr_comp_active_time[249] "error code related component active time [0 .. 254-1]" UBYTE EH_STANDARD_S4_S3 1 100 0 255 ECU_ADDRESS 0xFFF83359 DISPLAY_IDENTIFIER di_obd_iumpr_comp_active_time[249].ZFEH_EepromData /end MEASUREMENT
/begin MEASUREMENT ZFEH_EepromData.di_obd_iumpr_comp_active_time[24] "error code related component active time [0 .. 254-1]" UBYTE EH_STANDARD_S4_S3 1 100 0 255 ECU_ADDRESS 0xFFF83278 DISPLAY_IDENTIFIER di_obd_iumpr_comp_active_time[24].ZFEH_EepromData /end MEASUREMENT
/begin MEASUREMENT ZFEH_EepromData.di_obd_iumpr_comp_active_time[250] "error code related component active time [0 .. 254-1]" UBYTE EH_STANDARD_S4_S3 1 100 0 255 ECU_ADDRESS 0xFFF8335A DISPLAY_IDENTIFIER di_obd_iumpr_comp_active_time[250].ZFEH_EepromData /end MEASUREMENT
/begin MEASUREMENT ZFEH_EepromData.di_obd_iumpr_comp_active_time[251] "error code related component active time [0 .. 254-1]" UBYTE EH_STANDARD_S4_S3 1 100 0 255 ECU_ADDRESS 0xFFF8335B DISPLAY_IDENTIFIER di_obd_iumpr_comp_active_time[251].ZFEH_EepromData /end MEASUREMENT
/begin MEASUREMENT ZFEH_EepromData.di_obd_iumpr_comp_active_time[252] "error code related component active time [0 .. 254-1]" UBYTE EH_STANDARD_S4_S3 1 100 0 255 ECU_ADDRESS 0xFFF8335C DISPLAY_IDENTIFIER di_obd_iumpr_comp_active_time[252].ZFEH_EepromData /end MEASUREMENT
/begin MEASUREMENT ZFEH_EepromData.di_obd_iumpr_comp_active_time[253] "error code related component active time [0 .. 254-1]" UBYTE EH_STANDARD_S4_S3 1 100 0 255 ECU_ADDRESS 0xFFF8335D DISPLAY_IDENTIFIER di_obd_iumpr_comp_active_time[253].ZFEH_EepromData /end MEASUREMENT
/begin MEASUREMENT ZFEH_EepromData.di_obd_iumpr_comp_active_time[25] "error code related component active time [0 .. 254-1]" UBYTE EH_STANDARD_S4_S3 1 100 0 255 ECU_ADDRESS 0xFFF83279 DISPLAY_IDENTIFIER di_obd_iumpr_comp_active_time[25].ZFEH_EepromData /end MEASUREMENT
/begin MEASUREMENT ZFEH_EepromData.di_obd_iumpr_comp_active_time[26] "error code related component active time [0 .. 254-1]" UBYTE EH_STANDARD_S4_S3 1 100 0 255 ECU_ADDRESS 0xFFF8327A DISPLAY_IDENTIFIER di_obd_iumpr_comp_active_time[26].ZFEH_EepromData /end MEASUREMENT
/begin MEASUREMENT ZFEH_EepromData.di_obd_iumpr_comp_active_time[27] "error code related component active time [0 .. 254-1]" UBYTE EH_STANDARD_S4_S3 1 100 0 255 ECU_ADDRESS 0xFFF8327B DISPLAY_IDENTIFIER di_obd_iumpr_comp_active_time[27].ZFEH_EepromData /end MEASUREMENT
/begin MEASUREMENT ZFEH_EepromData.di_obd_iumpr_comp_active_time[28] "error code related component active time [0 .. 254-1]" UBYTE EH_STANDARD_S4_S3 1 100 0 255 ECU_ADDRESS 0xFFF8327C DISPLAY_IDENTIFIER di_obd_iumpr_comp_active_time[28].ZFEH_EepromData /end MEASUREMENT
/begin MEASUREMENT ZFEH_EepromData.di_obd_iumpr_comp_active_time[29] "error code related component active time [0 .. 254-1]" UBYTE EH_STANDARD_S4_S3 1 100 0 255 ECU_ADDRESS 0xFFF8327D DISPLAY_IDENTIFIER di_obd_iumpr_comp_active_time[29].ZFEH_EepromData /end MEASUREMENT
/begin MEASUREMENT ZFEH_EepromData.di_obd_iumpr_comp_active_time[2] "error code related component active time [0 .. 254-1]" UBYTE EH_STANDARD_S4_S3 1 100 0 255 ECU_ADDRESS 0xFFF83262 DISPLAY_IDENTIFIER di_obd_iumpr_comp_active_time[2].ZFEH_EepromData /end MEASUREMENT
/begin MEASUREMENT ZFEH_EepromData.di_obd_iumpr_comp_active_time[30] "error code related component active time [0 .. 254-1]" UBYTE EH_STANDARD_S4_S3 1 100 0 255 ECU_ADDRESS 0xFFF8327E DISPLAY_IDENTIFIER di_obd_iumpr_comp_active_time[30].ZFEH_EepromData /end MEASUREMENT
/begin MEASUREMENT ZFEH_EepromData.di_obd_iumpr_comp_active_time[31] "error code related component active time [0 .. 254-1]" UBYTE EH_STANDARD_S4_S3 1 100 0 255 ECU_ADDRESS 0xFFF8327F DISPLAY_IDENTIFIER di_obd_iumpr_comp_active_time[31].ZFEH_EepromData /end MEASUREMENT
/begin MEASUREMENT ZFEH_EepromData.di_obd_iumpr_comp_active_time[32] "error code related component active time [0 .. 254-1]" UBYTE EH_STANDARD_S4_S3 1 100 0 255 ECU_ADDRESS 0xFFF83280 DISPLAY_IDENTIFIER di_obd_iumpr_comp_active_time[32].ZFEH_EepromData /end MEASUREMENT
/begin MEASUREMENT ZFEH_EepromData.di_obd_iumpr_comp_active_time[33] "error code related component active time [0 .. 254-1]" UBYTE EH_STANDARD_S4_S3 1 100 0 255 ECU_ADDRESS 0xFFF83281 DISPLAY_IDENTIFIER di_obd_iumpr_comp_active_time[33].ZFEH_EepromData /end MEASUREMENT
/begin MEASUREMENT ZFEH_EepromData.di_obd_iumpr_comp_active_time[34] "error code related component active time [0 .. 254-1]" UBYTE EH_STANDARD_S4_S3 1 100 0 255 ECU_ADDRESS 0xFFF83282 DISPLAY_IDENTIFIER di_obd_iumpr_comp_active_time[34].ZFEH_EepromData /end MEASUREMENT
/begin MEASUREMENT ZFEH_EepromData.di_obd_iumpr_comp_active_time[35] "error code related component active time [0 .. 254-1]" UBYTE EH_STANDARD_S4_S3 1 100 0 255 ECU_ADDRESS 0xFFF83283 DISPLAY_IDENTIFIER di_obd_iumpr_comp_active_time[35].ZFEH_EepromData /end MEASUREMENT
/begin MEASUREMENT ZFEH_EepromData.di_obd_iumpr_comp_active_time[36] "error code related component active time [0 .. 254-1]" UBYTE EH_STANDARD_S4_S3 1 100 0 255 ECU_ADDRESS 0xFFF83284 DISPLAY_IDENTIFIER di_obd_iumpr_comp_active_time[36].ZFEH_EepromData /end MEASUREMENT
/begin MEASUREMENT ZFEH_EepromData.di_obd_iumpr_comp_active_time[37] "error code related component active time [0 .. 254-1]" UBYTE EH_STANDARD_S4_S3 1 100 0 255 ECU_ADDRESS 0xFFF83285 DISPLAY_IDENTIFIER di_obd_iumpr_comp_active_time[37].ZFEH_EepromData /end MEASUREMENT
/begin MEASUREMENT ZFEH_EepromData.di_obd_iumpr_comp_active_time[38] "error code related component active time [0 .. 254-1]" UBYTE EH_STANDARD_S4_S3 1 100 0 255 ECU_ADDRESS 0xFFF83286 DISPLAY_IDENTIFIER di_obd_iumpr_comp_active_time[38].ZFEH_EepromData /end MEASUREMENT
/begin MEASUREMENT ZFEH_EepromData.di_obd_iumpr_comp_active_time[39] "error code related component active time [0 .. 254-1]" UBYTE EH_STANDARD_S4_S3 1 100 0 255 ECU_ADDRESS 0xFFF83287 DISPLAY_IDENTIFIER di_obd_iumpr_comp_active_time[39].ZFEH_EepromData /end MEASUREMENT
/begin MEASUREMENT ZFEH_EepromData.di_obd_iumpr_comp_active_time[3] "error code related component active time [0 .. 254-1]" UBYTE EH_STANDARD_S4_S3 1 100 0 255 ECU_ADDRESS 0xFFF83263 DISPLAY_IDENTIFIER di_obd_iumpr_comp_active_time[3].ZFEH_EepromData /end MEASUREMENT
/begin MEASUREMENT ZFEH_EepromData.di_obd_iumpr_comp_active_time[40] "error code related component active time [0 .. 254-1]" UBYTE EH_STANDARD_S4_S3 1 100 0 255 ECU_ADDRESS 0xFFF83288 DISPLAY_IDENTIFIER di_obd_iumpr_comp_active_time[40].ZFEH_EepromData /end MEASUREMENT
/begin MEASUREMENT ZFEH_EepromData.di_obd_iumpr_comp_active_time[41] "error code related component active time [0 .. 254-1]" UBYTE EH_STANDARD_S4_S3 1 100 0 255 ECU_ADDRESS 0xFFF83289 DISPLAY_IDENTIFIER di_obd_iumpr_comp_active_time[41].ZFEH_EepromData /end MEASUREMENT
/begin MEASUREMENT ZFEH_EepromData.di_obd_iumpr_comp_active_time[42] "error code related component active time [0 .. 254-1]" UBYTE EH_STANDARD_S4_S3 1 100 0 255 ECU_ADDRESS 0xFFF8328A DISPLAY_IDENTIFIER di_obd_iumpr_comp_active_time[42].ZFEH_EepromData /end MEASUREMENT
/begin MEASUREMENT ZFEH_EepromData.di_obd_iumpr_comp_active_time[43] "error code related component active time [0 .. 254-1]" UBYTE EH_STANDARD_S4_S3 1 100 0 255 ECU_ADDRESS 0xFFF8328B DISPLAY_IDENTIFIER di_obd_iumpr_comp_active_time[43].ZFEH_EepromData /end MEASUREMENT
/begin MEASUREMENT ZFEH_EepromData.di_obd_iumpr_comp_active_time[44] "error code related component active time [0 .. 254-1]" UBYTE EH_STANDARD_S4_S3 1 100 0 255 ECU_ADDRESS 0xFFF8328C DISPLAY_IDENTIFIER di_obd_iumpr_comp_active_time[44].ZFEH_EepromData /end MEASUREMENT
/begin MEASUREMENT ZFEH_EepromData.di_obd_iumpr_comp_active_time[45] "error code related component active time [0 .. 254-1]" UBYTE EH_STANDARD_S4_S3 1 100 0 255 ECU_ADDRESS 0xFFF8328D DISPLAY_IDENTIFIER di_obd_iumpr_comp_active_time[45].ZFEH_EepromData /end MEASUREMENT
/begin MEASUREMENT ZFEH_EepromData.di_obd_iumpr_comp_active_time[46] "error code related component active time [0 .. 254-1]" UBYTE EH_STANDARD_S4_S3 1 100 0 255 ECU_ADDRESS 0xFFF8328E DISPLAY_IDENTIFIER di_obd_iumpr_comp_active_time[46].ZFEH_EepromData /end MEASUREMENT
/begin MEASUREMENT ZFEH_EepromData.di_obd_iumpr_comp_active_time[47] "error code related component active time [0 .. 254-1]" UBYTE EH_STANDARD_S4_S3 1 100 0 255 ECU_ADDRESS 0xFFF8328F DISPLAY_IDENTIFIER di_obd_iumpr_comp_active_time[47].ZFEH_EepromData /end MEASUREMENT
/begin MEASUREMENT ZFEH_EepromData.di_obd_iumpr_comp_active_time[48] "error code related component active time [0 .. 254-1]" UBYTE EH_STANDARD_S4_S3 1 100 0 255 ECU_ADDRESS 0xFFF83290 DISPLAY_IDENTIFIER di_obd_iumpr_comp_active_time[48].ZFEH_EepromData /end MEASUREMENT
/begin MEASUREMENT ZFEH_EepromData.di_obd_iumpr_comp_active_time[49] "error code related component active time [0 .. 254-1]" UBYTE EH_STANDARD_S4_S3 1 100 0 255 ECU_ADDRESS 0xFFF83291 DISPLAY_IDENTIFIER di_obd_iumpr_comp_active_time[49].ZFEH_EepromData /end MEASUREMENT
/begin MEASUREMENT ZFEH_EepromData.di_obd_iumpr_comp_active_time[4] "error code related component active time [0 .. 254-1]" UBYTE EH_STANDARD_S4_S3 1 100 0 255 ECU_ADDRESS 0xFFF83264 DISPLAY_IDENTIFIER di_obd_iumpr_comp_active_time[4].ZFEH_EepromData /end MEASUREMENT
/begin MEASUREMENT ZFEH_EepromData.di_obd_iumpr_comp_active_time[50] "error code related component active time [0 .. 254-1]" UBYTE EH_STANDARD_S4_S3 1 100 0 255 ECU_ADDRESS 0xFFF83292 DISPLAY_IDENTIFIER di_obd_iumpr_comp_active_time[50].ZFEH_EepromData /end MEASUREMENT
/begin MEASUREMENT ZFEH_EepromData.di_obd_iumpr_comp_active_time[51] "error code related component active time [0 .. 254-1]" UBYTE EH_STANDARD_S4_S3 1 100 0 255 ECU_ADDRESS 0xFFF83293 DISPLAY_IDENTIFIER di_obd_iumpr_comp_active_time[51].ZFEH_EepromData /end MEASUREMENT
/begin MEASUREMENT ZFEH_EepromData.di_obd_iumpr_comp_active_time[52] "error code related component active time [0 .. 254-1]" UBYTE EH_STANDARD_S4_S3 1 100 0 255 ECU_ADDRESS 0xFFF83294 DISPLAY_IDENTIFIER di_obd_iumpr_comp_active_time[52].ZFEH_EepromData /end MEASUREMENT
/begin MEASUREMENT ZFEH_EepromData.di_obd_iumpr_comp_active_time[53] "error code related component active time [0 .. 254-1]" UBYTE EH_STANDARD_S4_S3 1 100 0 255 ECU_ADDRESS 0xFFF83295 DISPLAY_IDENTIFIER di_obd_iumpr_comp_active_time[53].ZFEH_EepromData /end MEASUREMENT
/begin MEASUREMENT ZFEH_EepromData.di_obd_iumpr_comp_active_time[54] "error code related component active time [0 .. 254-1]" UBYTE EH_STANDARD_S4_S3 1 100 0 255 ECU_ADDRESS 0xFFF83296 DISPLAY_IDENTIFIER di_obd_iumpr_comp_active_time[54].ZFEH_EepromData /end MEASUREMENT
/begin MEASUREMENT ZFEH_EepromData.di_obd_iumpr_comp_active_time[55] "error code related component active time [0 .. 254-1]" UBYTE EH_STANDARD_S4_S3 1 100 0 255 ECU_ADDRESS 0xFFF83297 DISPLAY_IDENTIFIER di_obd_iumpr_comp_active_time[55].ZFEH_EepromData /end MEASUREMENT
/begin MEASUREMENT ZFEH_EepromData.di_obd_iumpr_comp_active_time[56] "error code related component active time [0 .. 254-1]" UBYTE EH_STANDARD_S4_S3 1 100 0 255 ECU_ADDRESS 0xFFF83298 DISPLAY_IDENTIFIER di_obd_iumpr_comp_active_time[56].ZFEH_EepromData /end MEASUREMENT
/begin MEASUREMENT ZFEH_EepromData.di_obd_iumpr_comp_active_time[57] "error code related component active time [0 .. 254-1]" UBYTE EH_STANDARD_S4_S3 1 100 0 255 ECU_ADDRESS 0xFFF83299 DISPLAY_IDENTIFIER di_obd_iumpr_comp_active_time[57].ZFEH_EepromData /end MEASUREMENT
/begin MEASUREMENT ZFEH_EepromData.di_obd_iumpr_comp_active_time[58] "error code related component active time [0 .. 254-1]" UBYTE EH_STANDARD_S4_S3 1 100 0 255 ECU_ADDRESS 0xFFF8329A DISPLAY_IDENTIFIER di_obd_iumpr_comp_active_time[58].ZFEH_EepromData /end MEASUREMENT
/begin MEASUREMENT ZFEH_EepromData.di_obd_iumpr_comp_active_time[59] "error code related component active time [0 .. 254-1]" UBYTE EH_STANDARD_S4_S3 1 100 0 255 ECU_ADDRESS 0xFFF8329B DISPLAY_IDENTIFIER di_obd_iumpr_comp_active_time[59].ZFEH_EepromData /end MEASUREMENT
/begin MEASUREMENT ZFEH_EepromData.di_obd_iumpr_comp_active_time[5] "error code related component active time [0 .. 254-1]" UBYTE EH_STANDARD_S4_S3 1 100 0 255 ECU_ADDRESS 0xFFF83265 DISPLAY_IDENTIFIER di_obd_iumpr_comp_active_time[5].ZFEH_EepromData /end MEASUREMENT
/begin MEASUREMENT ZFEH_EepromData.di_obd_iumpr_comp_active_time[60] "error code related component active time [0 .. 254-1]" UBYTE EH_STANDARD_S4_S3 1 100 0 255 ECU_ADDRESS 0xFFF8329C DISPLAY_IDENTIFIER di_obd_iumpr_comp_active_time[60].ZFEH_EepromData /end MEASUREMENT
/begin MEASUREMENT ZFEH_EepromData.di_obd_iumpr_comp_active_time[61] "error code related component active time [0 .. 254-1]" UBYTE EH_STANDARD_S4_S3 1 100 0 255 ECU_ADDRESS 0xFFF8329D DISPLAY_IDENTIFIER di_obd_iumpr_comp_active_time[61].ZFEH_EepromData /end MEASUREMENT
/begin MEASUREMENT ZFEH_EepromData.di_obd_iumpr_comp_active_time[62] "error code related component active time [0 .. 254-1]" UBYTE EH_STANDARD_S4_S3 1 100 0 255 ECU_ADDRESS 0xFFF8329E DISPLAY_IDENTIFIER di_obd_iumpr_comp_active_time[62].ZFEH_EepromData /end MEASUREMENT
/begin MEASUREMENT ZFEH_EepromData.di_obd_iumpr_comp_active_time[63] "error code related component active time [0 .. 254-1]" UBYTE EH_STANDARD_S4_S3 1 100 0 255 ECU_ADDRESS 0xFFF8329F DISPLAY_IDENTIFIER di_obd_iumpr_comp_active_time[63].ZFEH_EepromData /end MEASUREMENT
/begin MEASUREMENT ZFEH_EepromData.di_obd_iumpr_comp_active_time[64] "error code related component active time [0 .. 254-1]" UBYTE EH_STANDARD_S4_S3 1 100 0 255 ECU_ADDRESS 0xFFF832A0 DISPLAY_IDENTIFIER di_obd_iumpr_comp_active_time[64].ZFEH_EepromData /end MEASUREMENT
/begin MEASUREMENT ZFEH_EepromData.di_obd_iumpr_comp_active_time[65] "error code related component active time [0 .. 254-1]" UBYTE EH_STANDARD_S4_S3 1 100 0 255 ECU_ADDRESS 0xFFF832A1 DISPLAY_IDENTIFIER di_obd_iumpr_comp_active_time[65].ZFEH_EepromData /end MEASUREMENT
/begin MEASUREMENT ZFEH_EepromData.di_obd_iumpr_comp_active_time[66] "error code related component active time [0 .. 254-1]" UBYTE EH_STANDARD_S4_S3 1 100 0 255 ECU_ADDRESS 0xFFF832A2 DISPLAY_IDENTIFIER di_obd_iumpr_comp_active_time[66].ZFEH_EepromData /end MEASUREMENT
/begin MEASUREMENT ZFEH_EepromData.di_obd_iumpr_comp_active_time[67] "error code related component active time [0 .. 254-1]" UBYTE EH_STANDARD_S4_S3 1 100 0 255 ECU_ADDRESS 0xFFF832A3 DISPLAY_IDENTIFIER di_obd_iumpr_comp_active_time[67].ZFEH_EepromData /end MEASUREMENT
/begin MEASUREMENT ZFEH_EepromData.di_obd_iumpr_comp_active_time[68] "error code related component active time [0 .. 254-1]" UBYTE EH_STANDARD_S4_S3 1 100 0 255 ECU_ADDRESS 0xFFF832A4 DISPLAY_IDENTIFIER di_obd_iumpr_comp_active_time[68].ZFEH_EepromData /end MEASUREMENT
/begin MEASUREMENT ZFEH_EepromData.di_obd_iumpr_comp_active_time[69] "error code related component active time [0 .. 254-1]" UBYTE EH_STANDARD_S4_S3 1 100 0 255 ECU_ADDRESS 0xFFF832A5 DISPLAY_IDENTIFIER di_obd_iumpr_comp_active_time[69].ZFEH_EepromData /end MEASUREMENT
/begin MEASUREMENT ZFEH_EepromData.di_obd_iumpr_comp_active_time[6] "error code related component active time [0 .. 254-1]" UBYTE EH_STANDARD_S4_S3 1 100 0 255 ECU_ADDRESS 0xFFF83266 DISPLAY_IDENTIFIER di_obd_iumpr_comp_active_time[6].ZFEH_EepromData /end MEASUREMENT
/begin MEASUREMENT ZFEH_EepromData.di_obd_iumpr_comp_active_time[70] "error code related component active time [0 .. 254-1]" UBYTE EH_STANDARD_S4_S3 1 100 0 255 ECU_ADDRESS 0xFFF832A6 DISPLAY_IDENTIFIER di_obd_iumpr_comp_active_time[70].ZFEH_EepromData /end MEASUREMENT
/begin MEASUREMENT ZFEH_EepromData.di_obd_iumpr_comp_active_time[71] "error code related component active time [0 .. 254-1]" UBYTE EH_STANDARD_S4_S3 1 100 0 255 ECU_ADDRESS 0xFFF832A7 DISPLAY_IDENTIFIER di_obd_iumpr_comp_active_time[71].ZFEH_EepromData /end MEASUREMENT
/begin MEASUREMENT ZFEH_EepromData.di_obd_iumpr_comp_active_time[72] "error code related component active time [0 .. 254-1]" UBYTE EH_STANDARD_S4_S3 1 100 0 255 ECU_ADDRESS 0xFFF832A8 DISPLAY_IDENTIFIER di_obd_iumpr_comp_active_time[72].ZFEH_EepromData /end MEASUREMENT
/begin MEASUREMENT ZFEH_EepromData.di_obd_iumpr_comp_active_time[73] "error code related component active time [0 .. 254-1]" UBYTE EH_STANDARD_S4_S3 1 100 0 255 ECU_ADDRESS 0xFFF832A9 DISPLAY_IDENTIFIER di_obd_iumpr_comp_active_time[73].ZFEH_EepromData /end MEASUREMENT
/begin MEASUREMENT ZFEH_EepromData.di_obd_iumpr_comp_active_time[74] "error code related component active time [0 .. 254-1]" UBYTE EH_STANDARD_S4_S3 1 100 0 255 ECU_ADDRESS 0xFFF832AA DISPLAY_IDENTIFIER di_obd_iumpr_comp_active_time[74].ZFEH_EepromData /end MEASUREMENT
/begin MEASUREMENT ZFEH_EepromData.di_obd_iumpr_comp_active_time[75] "error code related component active time [0 .. 254-1]" UBYTE EH_STANDARD_S4_S3 1 100 0 255 ECU_ADDRESS 0xFFF832AB DISPLAY_IDENTIFIER di_obd_iumpr_comp_active_time[75].ZFEH_EepromData /end MEASUREMENT
/begin MEASUREMENT ZFEH_EepromData.di_obd_iumpr_comp_active_time[76] "error code related component active time [0 .. 254-1]" UBYTE EH_STANDARD_S4_S3 1 100 0 255 ECU_ADDRESS 0xFFF832AC DISPLAY_IDENTIFIER di_obd_iumpr_comp_active_time[76].ZFEH_EepromData /end MEASUREMENT
/begin MEASUREMENT ZFEH_EepromData.di_obd_iumpr_comp_active_time[77] "error code related component active time [0 .. 254-1]" UBYTE EH_STANDARD_S4_S3 1 100 0 255 ECU_ADDRESS 0xFFF832AD DISPLAY_IDENTIFIER di_obd_iumpr_comp_active_time[77].ZFEH_EepromData /end MEASUREMENT
/begin MEASUREMENT ZFEH_EepromData.di_obd_iumpr_comp_active_time[78] "error code related component active time [0 .. 254-1]" UBYTE EH_STANDARD_S4_S3 1 100 0 255 ECU_ADDRESS 0xFFF832AE DISPLAY_IDENTIFIER di_obd_iumpr_comp_active_time[78].ZFEH_EepromData /end MEASUREMENT
/begin MEASUREMENT ZFEH_EepromData.di_obd_iumpr_comp_active_time[79] "error code related component active time [0 .. 254-1]" UBYTE EH_STANDARD_S4_S3 1 100 0 255 ECU_ADDRESS 0xFFF832AF DISPLAY_IDENTIFIER di_obd_iumpr_comp_active_time[79].ZFEH_EepromData /end MEASUREMENT
/begin MEASUREMENT ZFEH_EepromData.di_obd_iumpr_comp_active_time[7] "error code related component active time [0 .. 254-1]" UBYTE EH_STANDARD_S4_S3 1 100 0 255 ECU_ADDRESS 0xFFF83267 DISPLAY_IDENTIFIER di_obd_iumpr_comp_active_time[7].ZFEH_EepromData /end MEASUREMENT
/begin MEASUREMENT ZFEH_EepromData.di_obd_iumpr_comp_active_time[80] "error code related component active time [0 .. 254-1]" UBYTE EH_STANDARD_S4_S3 1 100 0 255 ECU_ADDRESS 0xFFF832B0 DISPLAY_IDENTIFIER di_obd_iumpr_comp_active_time[80].ZFEH_EepromData /end MEASUREMENT
/begin MEASUREMENT ZFEH_EepromData.di_obd_iumpr_comp_active_time[81] "error code related component active time [0 .. 254-1]" UBYTE EH_STANDARD_S4_S3 1 100 0 255 ECU_ADDRESS 0xFFF832B1 DISPLAY_IDENTIFIER di_obd_iumpr_comp_active_time[81].ZFEH_EepromData /end MEASUREMENT
/begin MEASUREMENT ZFEH_EepromData.di_obd_iumpr_comp_active_time[82] "error code related component active time [0 .. 254-1]" UBYTE EH_STANDARD_S4_S3 1 100 0 255 ECU_ADDRESS 0xFFF832B2 DISPLAY_IDENTIFIER di_obd_iumpr_comp_active_time[82].ZFEH_EepromData /end MEASUREMENT
/begin MEASUREMENT ZFEH_EepromData.di_obd_iumpr_comp_active_time[83] "error code related component active time [0 .. 254-1]" UBYTE EH_STANDARD_S4_S3 1 100 0 255 ECU_ADDRESS 0xFFF832B3 DISPLAY_IDENTIFIER di_obd_iumpr_comp_active_time[83].ZFEH_EepromData /end MEASUREMENT
/begin MEASUREMENT ZFEH_EepromData.di_obd_iumpr_comp_active_time[84] "error code related component active time [0 .. 254-1]" UBYTE EH_STANDARD_S4_S3 1 100 0 255 ECU_ADDRESS 0xFFF832B4 DISPLAY_IDENTIFIER di_obd_iumpr_comp_active_time[84].ZFEH_EepromData /end MEASUREMENT
/begin MEASUREMENT ZFEH_EepromData.di_obd_iumpr_comp_active_time[85] "error code related component active time [0 .. 254-1]" UBYTE EH_STANDARD_S4_S3 1 100 0 255 ECU_ADDRESS 0xFFF832B5 DISPLAY_IDENTIFIER di_obd_iumpr_comp_active_time[85].ZFEH_EepromData /end MEASUREMENT
/begin MEASUREMENT ZFEH_EepromData.di_obd_iumpr_comp_active_time[86] "error code related component active time [0 .. 254-1]" UBYTE EH_STANDARD_S4_S3 1 100 0 255 ECU_ADDRESS 0xFFF832B6 DISPLAY_IDENTIFIER di_obd_iumpr_comp_active_time[86].ZFEH_EepromData /end MEASUREMENT
/begin MEASUREMENT ZFEH_EepromData.di_obd_iumpr_comp_active_time[87] "error code related component active time [0 .. 254-1]" UBYTE EH_STANDARD_S4_S3 1 100 0 255 ECU_ADDRESS 0xFFF832B7 DISPLAY_IDENTIFIER di_obd_iumpr_comp_active_time[87].ZFEH_EepromData /end MEASUREMENT
/begin MEASUREMENT ZFEH_EepromData.di_obd_iumpr_comp_active_time[88] "error code related component active time [0 .. 254-1]" UBYTE EH_STANDARD_S4_S3 1 100 0 255 ECU_ADDRESS 0xFFF832B8 DISPLAY_IDENTIFIER di_obd_iumpr_comp_active_time[88].ZFEH_EepromData /end MEASUREMENT
/begin MEASUREMENT ZFEH_EepromData.di_obd_iumpr_comp_active_time[89] "error code related component active time [0 .. 254-1]" UBYTE EH_STANDARD_S4_S3 1 100 0 255 ECU_ADDRESS 0xFFF832B9 DISPLAY_IDENTIFIER di_obd_iumpr_comp_active_time[89].ZFEH_EepromData /end MEASUREMENT
/begin MEASUREMENT ZFEH_EepromData.di_obd_iumpr_comp_active_time[8] "error code related component active time [0 .. 254-1]" UBYTE EH_STANDARD_S4_S3 1 100 0 255 ECU_ADDRESS 0xFFF83268 DISPLAY_IDENTIFIER di_obd_iumpr_comp_active_time[8].ZFEH_EepromData /end MEASUREMENT
/begin MEASUREMENT ZFEH_EepromData.di_obd_iumpr_comp_active_time[90] "error code related component active time [0 .. 254-1]" UBYTE EH_STANDARD_S4_S3 1 100 0 255 ECU_ADDRESS 0xFFF832BA DISPLAY_IDENTIFIER di_obd_iumpr_comp_active_time[90].ZFEH_EepromData /end MEASUREMENT
/begin MEASUREMENT ZFEH_EepromData.di_obd_iumpr_comp_active_time[91] "error code related component active time [0 .. 254-1]" UBYTE EH_STANDARD_S4_S3 1 100 0 255 ECU_ADDRESS 0xFFF832BB DISPLAY_IDENTIFIER di_obd_iumpr_comp_active_time[91].ZFEH_EepromData /end MEASUREMENT
/begin MEASUREMENT ZFEH_EepromData.di_obd_iumpr_comp_active_time[92] "error code related component active time [0 .. 254-1]" UBYTE EH_STANDARD_S4_S3 1 100 0 255 ECU_ADDRESS 0xFFF832BC DISPLAY_IDENTIFIER di_obd_iumpr_comp_active_time[92].ZFEH_EepromData /end MEASUREMENT
/begin MEASUREMENT ZFEH_EepromData.di_obd_iumpr_comp_active_time[93] "error code related component active time [0 .. 254-1]" UBYTE EH_STANDARD_S4_S3 1 100 0 255 ECU_ADDRESS 0xFFF832BD DISPLAY_IDENTIFIER di_obd_iumpr_comp_active_time[93].ZFEH_EepromData /end MEASUREMENT
/begin MEASUREMENT ZFEH_EepromData.di_obd_iumpr_comp_active_time[94] "error code related component active time [0 .. 254-1]" UBYTE EH_STANDARD_S4_S3 1 100 0 255 ECU_ADDRESS 0xFFF832BE DISPLAY_IDENTIFIER di_obd_iumpr_comp_active_time[94].ZFEH_EepromData /end MEASUREMENT
/begin MEASUREMENT ZFEH_EepromData.di_obd_iumpr_comp_active_time[95] "error code related component active time [0 .. 254-1]" UBYTE EH_STANDARD_S4_S3 1 100 0 255 ECU_ADDRESS 0xFFF832BF DISPLAY_IDENTIFIER di_obd_iumpr_comp_active_time[95].ZFEH_EepromData /end MEASUREMENT
/begin RECORD_LAYOUT _REC_A1CUR_30_u1_u1_S2 FNC_VALUES 1 UBYTE COLUMN_DIR DIRECT /end RECORD_LAYOUT
/begin RECORD_LAYOUT _REC_A1CUR_30_u1_u2_S2 FNC_VALUES 1 UBYTE COLUMN_DIR DIRECT /end RECORD_LAYOUT
/begin RECORD_LAYOUT _REC_A1CUR_30_u2_u1_S2 FNC_VALUES 1 UWORD COLUMN_DIR DIRECT /end RECORD_LAYOUT
/begin RECORD_LAYOUT _REC_A1CUR_30_u4_u1_S2 FNC_VALUES 1 ULONG COLUMN_DIR DIRECT /end RECORD_LAYOUT
/begin RECORD_LAYOUT _REC_A1MAP_9_u1_u1_u1_S2 FNC_VALUES 1 UBYTE COLUMN_DIR DIRECT /end RECORD_LAYOUT
/begin RECORD_LAYOUT _REC_S1VAL_1_s2_S2 FNC_VALUES 1 SWORD COLUMN_DIR DIRECT /end RECORD_LAYOUT
/begin RECORD_LAYOUT _REC_S1VAL_1_s4_S2 FNC_VALUES 1 SLONG COLUMN_DIR DIRECT /end RECORD_LAYOUT
/begin RECORD_LAYOUT _REC_S1VAL_1_u1_S2 FNC_VALUES 1 UBYTE COLUMN_DIR DIRECT /end RECORD_LAYOUT
/begin RECORD_LAYOUT _REC_S1VAL_1_u2_S2 FNC_VALUES 1 UWORD COLUMN_DIR DIRECT /end RECORD_LAYOUT
/begin RECORD_LAYOUT _REC_S1VAL_1_u4_S2 FNC_VALUES 1 ULONG COLUMN_DIR DIRECT /end RECORD_LAYOUT
/begin RECORD_LAYOUT _REC_S7CUR_53_u2_u2_S2 FNC_VALUES 3 UWORD COLUMN_DIR DIRECT AXIS_PTS_X 2 UWORD INDEX_INCR DIRECT NO_AXIS_PTS_X 1 UBYTE /end RECORD_LAYOUT
/end MODULE
/end PROJECT
