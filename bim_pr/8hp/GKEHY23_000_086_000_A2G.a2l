ASAP2_VERSION 1 51
/begin PROJECT ZHBC8600 "Gen2_BMW_System_Supplier_Lib"
/begin MODULE CPP ""
/begin MOD_COMMON "" BYTE_ORDER MSB_FIRST ALIGNMENT_BYTE 1 ALIGNMENT_WORD 2 ALIGNMENT_LONG 4 ALIGNMENT_FLOAT32_IEEE 4 ALIGNMENT_FLOAT64_IEEE 1 /end MOD_COMMON
/begin COMPU_VTAB _CNV_S_2_Enum_ECONT_43_S2 "" TAB_VERB 2 0 "PRUEFEN_WARTEZEIT" 1 "PRUEFEN_V_ZUNAHME" DEFAULT_VALUE "" /end COMPU_VTAB
/begin COMPU_VTAB _CNV_S_3_Enum_ECONT_267_S2 "" TAB_VERB 3 0 "PRUEFUNG_ENDE" 1 "PRUEFUNG_START" 2 "PRUEFUNG_NEU" DEFAULT_VALUE "" /end COMPU_VTAB
/begin COMPU_VTAB _CNV_S_3_Enum_ECONT_44_S2 "" TAB_VERB 3 0 "SETZEN_RSZ_FLAG" 1 "WARTEN_SCHALTUNGSENDE" 2 "PRUEFEN_SPERRZEIT" DEFAULT_VALUE "" /end COMPU_VTAB
/begin COMPU_VTAB _CNV_S_3_Enum_EGV_195_S2 "" TAB_VERB 3 0 "INITIALISIERUNG" 1 "GANGFINDUNG_AKTIV" 2 "SCHALTPUNKTSTEUERUNG_AKTIV" DEFAULT_VALUE "" /end COMPU_VTAB
/begin COMPU_VTAB _CNV_S_3_Enum_EQSHI_170_S2 "" TAB_VERB 3 0 "INIT_QSHIFT" 1 "WAIT_QSHIFT" 2 "ACTIVE_QSHIFT" DEFAULT_VALUE "" /end COMPU_VTAB
/begin COMPU_VTAB _CNV_S_4_Enum_EGB_56_S2 "" TAB_VERB 4 0 "TRIGGER_1_KFE" 1 "TRIGGER_2_KFE" 2 "GET_MAX_WERT_KFE" 3 "MAX_WERT_CHECK_KFE" DEFAULT_VALUE "" /end COMPU_VTAB
/begin COMPU_METHOD _CNV_R_R_Umr_100_zu_204_CM_S2 "" RAT_FUNC "%6.3" "m*m/s*s*s*s" COEFFS 0 100 0 0 0 1 /end COMPU_METHOD
/begin COMPU_METHOD _CNV_R_R_Umr_10_zu__37_CM_S2 "" RAT_FUNC "%6.3" "m/s*s" COEFFS 0 10 0 0 0 1 /end COMPU_METHOD
/begin COMPU_METHOD _CNV_R_R_Umr_10_zu__9_CM_S2 "" RAT_FUNC "%6.3" "%" COEFFS 0 10 0 0 0 1 /end COMPU_METHOD
/begin COMPU_METHOD _CNV_R_R_Umr_1_zu_1_205_CM_S2 "" RAT_FUNC "%6.3" "0.1g" COEFFS 0 1 0 0 0 1 /end COMPU_METHOD
/begin COMPU_METHOD _CNV_R_R_Umr_1_zu_1_2_CM_S2 "" RAT_FUNC "%6.3" "" COEFFS 0 1 0 0 0 1 /end COMPU_METHOD
/begin COMPU_METHOD _CNV_R_R_Umr_1_zu_1_3_CM_S2 "" RAT_FUNC "%6.3" "U/min" COEFFS 0 1 0 0 0 1 /end COMPU_METHOD
/begin COMPU_METHOD _CNV_R_R_Umr_32_zu__147_CM_S2 "" RAT_FUNC "%6.3" "m/s*s" COEFFS 0 32 0 0 0 1 /end COMPU_METHOD
/begin COMPU_METHOD _CNV_S_2_Enum_ECONT_43_CM_S2 "" TAB_VERB "%6.3" "" COMPU_TAB_REF _CNV_S_2_Enum_ECONT_43_S2 /end COMPU_METHOD
/begin COMPU_METHOD _CNV_S_3_Enum_ECONT_267_CM_S2 "" TAB_VERB "%6.3" "" COMPU_TAB_REF _CNV_S_3_Enum_ECONT_267_S2 /end COMPU_METHOD
/begin COMPU_METHOD _CNV_S_3_Enum_ECONT_44_CM_S2 "" TAB_VERB "%6.3" "" COMPU_TAB_REF _CNV_S_3_Enum_ECONT_44_S2 /end COMPU_METHOD
/begin COMPU_METHOD _CNV_S_3_Enum_EGV_195_CM_S2 "" TAB_VERB "%6.3" "" COMPU_TAB_REF _CNV_S_3_Enum_EGV_195_S2 /end COMPU_METHOD
/begin COMPU_METHOD _CNV_S_3_Enum_EQSHI_170_CM_S2 "" TAB_VERB "%6.3" "" COMPU_TAB_REF _CNV_S_3_Enum_EQSHI_170_S2 /end COMPU_METHOD
/begin COMPU_METHOD _CNV_S_4_Enum_EGB_56_CM_S2 "" TAB_VERB "%6.3" "" COMPU_TAB_REF _CNV_S_4_Enum_EGB_56_S2 /end COMPU_METHOD
/begin COMPU_METHOD SAB2_M_1NM_M32000_S3_S3 "int = ((phys * 1) / 1) - (-32000) Nm" RAT_FUNC "%1.0" "Nm" COEFFS 0 1 32000 0 0 1 /end COMPU_METHOD
/begin COMPU_METHOD SAB2_M_2NM_M100_S3_S3 "int = ((phys * 1) / 2) - (-50) Nm" RAT_FUNC "%4.3" "Nm" COEFFS 0 0.5 50 0 0 1 /end COMPU_METHOD
/begin COMPU_METHOD SAB2_M_37NM100_M12124_S3_S3 "int = ((phys * 100) / 37) - (-32768) Nm" RAT_FUNC "%4.3" "Nm" COEFFS 0 2.7027027027 32768 0 0 1 /end COMPU_METHOD
/begin COMPU_METHOD SAB2_M_592NM100_M12124_S3_S3 "int = ((phys * 100) / 592) - (-2048) Nm" RAT_FUNC "%4.3" "Nm" COEFFS 0 0.168918918919 2048 0 0 1 /end COMPU_METHOD
/begin COMPU_METHOD SAB2_M_NM10_S3_S3 "int = ((phys * 10) / 1) - (0) Nm" RAT_FUNC "%4.3" "Nm" COEFFS 0 10 0 0 0 1 /end COMPU_METHOD
/begin COMPU_METHOD SAB2_M_NM16_M2048_S3_S3 "int = ((phys * 16) / 1) - (-32768) Nm" RAT_FUNC "%4.3" "Nm" COEFFS 0 16 32768 0 0 1 /end COMPU_METHOD
/begin COMPU_METHOD SAB2_M_NM2_M800_S3_S3 "int = ((phys * 2) / 1) - (-800) Nm" RAT_FUNC "%4.3" "Nm" COEFFS 0 2 800 0 0 1 /end COMPU_METHOD
/begin COMPU_METHOD SAB2_M_NM2_S3_S3 "int = ((phys * 2) / 1) - (0) Nm" RAT_FUNC "%4.3" "Nm" COEFFS 0 2 0 0 0 1 /end COMPU_METHOD
/begin COMPU_METHOD SAB2_M_NM4_M2000_S3_S3 "int = ((phys * 4) / 1) - (-2000) Nm" RAT_FUNC "%4.3" "Nm" COEFFS 0 4 2000 0 0 1 /end COMPU_METHOD
/begin COMPU_METHOD SAB2_M_NM50_S3_S3 "int = ((phys * 50) / 1) - (0) Nm" RAT_FUNC "%4.3" "Nm" COEFFS 0 50 0 0 0 1 /end COMPU_METHOD
/begin COMPU_METHOD SAB2_M_NM5_S3_S3 "int = ((phys * 5) / 1) - (0) Nm" RAT_FUNC "%4.3" "Nm" COEFFS 0 5 0 0 0 1 /end COMPU_METHOD
/begin COMPU_METHOD SAB2_M_NM8_S3_S3 "int = ((phys * 8) / 1) - (0) Nm" RAT_FUNC "%4.3" "Nm" COEFFS 0 8 0 0 0 1 /end COMPU_METHOD
/begin COMPU_METHOD SAB2_M_NM_M100_S3_S3 "int = ((phys * 1) / 1) - (-100) Nm" RAT_FUNC "%1.0" "Nm" COEFFS 0 1 100 0 0 1 /end COMPU_METHOD
/begin COMPU_METHOD SAB2_M_NM_M1023_S3_S3 "int = ((phys * 1) / 1) - (-1023) Nm" RAT_FUNC "%1.0" "Nm" COEFFS 0 1 1023 0 0 1 /end COMPU_METHOD
/begin COMPU_METHOD SAB2_M_NM_M2048_S3_S3 "int = ((phys * 1) / 1) - (-2048) Nm" RAT_FUNC "%1.0" "Nm" COEFFS 0 1 2048 0 0 1 /end COMPU_METHOD
/begin COMPU_METHOD SAB2_M_NM_M500_S3_S3 "int = ((phys * 1) / 1) - (-500) Nm" RAT_FUNC "%1.0" "Nm" COEFFS 0 1 500 0 0 1 /end COMPU_METHOD
/begin COMPU_METHOD SAB2_M_NM_M511_S3_S3 "int = ((phys * 1) / 1) - (-511) Nm" RAT_FUNC "%1.0" "Nm" COEFFS 0 1 511 0 0 1 /end COMPU_METHOD
/begin COMPU_METHOD SAB2_MG_10NMS_S3_S3 "int = ((phys * 1) / 10) - (0) Nm/s" RAT_FUNC "%4.3" "Nm/s" COEFFS 0 0.1 0 0 0 1 /end COMPU_METHOD
/begin COMPU_METHOD SAB2_MG_1NMS_S3_S3 "int = ((phys * 1) / 1) - (0) Nm/s" RAT_FUNC "%1.0" "Nm/s" COEFFS 0 1 0 0 0 1 /end COMPU_METHOD
/begin COMPU_METHOD SAB2_N_25RPM_S3_S3 "int = ((phys * 1) / 25) - (0) 1/min" RAT_FUNC "%4.3" "1/min" COEFFS 0 0.04 0 0 0 1 /end COMPU_METHOD
/begin COMPU_METHOD SAB2_N_2RPM_S3_S3 "int = ((phys * 1) / 2) - (0) 1/min" RAT_FUNC "%4.3" "1/min" COEFFS 0 0.5 0 0 0 1 /end COMPU_METHOD
/begin COMPU_METHOD SAB2_N_32RPM_S3_S3 "int = ((phys * 1) / 32) - (0) 1/min" RAT_FUNC "%4.3" "1/min" COEFFS 0 0.03125 0 0 0 1 /end COMPU_METHOD
/begin COMPU_METHOD SAB2_N_4RPM_P125_S3_S3 "int = ((phys * 1) / 4) - (125) 1/min" RAT_FUNC "%4.3" "1/min" COEFFS 0 0.25 -125 0 0 1 /end COMPU_METHOD
/begin COMPU_METHOD SBW_STANDARD_S1_S3 "int = ((phys * 1) / 1) - (0) -" RAT_FUNC "%1.0" "-" COEFFS 0 1 0 0 0 1 /end COMPU_METHOD
/begin COMPU_METHOD SBW_TIMER_10MS_S1_S3 "int = ((phys * 1) / 10) - (0) ms" RAT_FUNC "%1.0" "ms" COEFFS 0 0.1 0 0 0 1 /end COMPU_METHOD
/begin COMPU_METHOD UMR___1_1_0_S5_S3 "int = ((phys * 1) / 1) - (0) [-]" RAT_FUNC "%1.0" "[-]" COEFFS 0 1 0 0 0 1 /end COMPU_METHOD
/begin COMPU_METHOD UMR_MBAR__10_1_0_S5_S3 "int = ((phys * 1) / 10) - (0) [mbar]" RAT_FUNC "%1.0" "[mbar]" COEFFS 0 0.1 0 0 0 1 /end COMPU_METHOD
/begin COMPU_METHOD UMR_MBAR__1_1_0_S5_S3 "int = ((phys * 1) / 1) - (0) [mbar]" RAT_FUNC "%1.0" "[mbar]" COEFFS 0 1 0 0 0 1 /end COMPU_METHOD
/begin COMPU_METHOD UMR_MSEC__1_1_0_S5_S3 "int = ((phys * 1) / 1) - (0) [ms]" RAT_FUNC "%1.0" "[ms]" COEFFS 0 1 0 0 0 1 /end COMPU_METHOD
/begin COMPU_METHOD UMR_NM_BAR_1_1_0_S5_S3 "int = ((phys * 1) / 1) - (0) [Nm/bar]" RAT_FUNC "%1.0" "[Nm/bar]" COEFFS 0 1 0 0 0 1 /end COMPU_METHOD
/begin COMPU_METHOD UMR_SEC__1_1_0_S5_S3 "int = ((phys * 1) / 1) - (0) [s]" RAT_FUNC "%1.0" "[s]" COEFFS 0 1 0 0 0 1 /end COMPU_METHOD
/begin CHARACTERISTIC A112 "" CURVE 0x1DFA32 _REC_A1CUR_1_u2_u2_S2 15000 _CNV_R_R_Umr_1_zu_1_3_CM_S2 0 15000
 /begin AXIS_DESCR COM_AXIS W_DKKD _CNV_R_R_Umr_10_zu__9_CM_S2 15 0 120 DEPOSIT ABSOLUTE FORMAT "%3.1" AXIS_PTS_REF SSTSKL_A1 /end AXIS_DESCR
 FORMAT "%2.0" /end CHARACTERISTIC
/begin CHARACTERISTIC A121 "" CURVE 0x1DFA50 _REC_A1CUR_1_u2_u2_S2 15000 _CNV_R_R_Umr_1_zu_1_3_CM_S2 0 15000
 /begin AXIS_DESCR COM_AXIS W_DKKD _CNV_R_R_Umr_10_zu__9_CM_S2 15 0 120 DEPOSIT ABSOLUTE FORMAT "%3.1" AXIS_PTS_REF SSTSKL_A1 /end AXIS_DESCR
 FORMAT "%2.0" /end CHARACTERISTIC
/begin CHARACTERISTIC A123 "" CURVE 0x1DFA6E _REC_A1CUR_1_u2_u2_S2 15000 _CNV_R_R_Umr_1_zu_1_3_CM_S2 0 15000
 /begin AXIS_DESCR COM_AXIS W_DKKD _CNV_R_R_Umr_10_zu__9_CM_S2 15 0 120 DEPOSIT ABSOLUTE FORMAT "%3.1" AXIS_PTS_REF SSTSKL_A1 /end AXIS_DESCR
 FORMAT "%2.0" /end CHARACTERISTIC
/begin CHARACTERISTIC A132 "" CURVE 0x1DFA8C _REC_A1CUR_1_u2_u2_S2 15000 _CNV_R_R_Umr_1_zu_1_3_CM_S2 0 15000
 /begin AXIS_DESCR COM_AXIS W_DKKD _CNV_R_R_Umr_10_zu__9_CM_S2 15 0 120 DEPOSIT ABSOLUTE FORMAT "%3.1" AXIS_PTS_REF SSTSKL_A1 /end AXIS_DESCR
 FORMAT "%2.0" /end CHARACTERISTIC
/begin CHARACTERISTIC A134 "" CURVE 0x1DFAAA _REC_A1CUR_1_u2_u2_S2 15000 _CNV_R_R_Umr_1_zu_1_3_CM_S2 0 15000
 /begin AXIS_DESCR COM_AXIS W_DKKD _CNV_R_R_Umr_10_zu__9_CM_S2 15 0 120 DEPOSIT ABSOLUTE FORMAT "%3.1" AXIS_PTS_REF SSTSKL_A1 /end AXIS_DESCR
 FORMAT "%2.0" /end CHARACTERISTIC
/begin CHARACTERISTIC A143 "" CURVE 0x1DFAC8 _REC_A1CUR_1_u2_u2_S2 15000 _CNV_R_R_Umr_1_zu_1_3_CM_S2 0 15000
 /begin AXIS_DESCR COM_AXIS W_DKKD _CNV_R_R_Umr_10_zu__9_CM_S2 15 0 120 DEPOSIT ABSOLUTE FORMAT "%3.1" AXIS_PTS_REF SSTSKL_A1 /end AXIS_DESCR
 FORMAT "%2.0" /end CHARACTERISTIC
/begin CHARACTERISTIC A145 "" CURVE 0x1DFAE6 _REC_A1CUR_1_u2_u2_S2 15000 _CNV_R_R_Umr_1_zu_1_3_CM_S2 0 15000
 /begin AXIS_DESCR COM_AXIS W_DKKD _CNV_R_R_Umr_10_zu__9_CM_S2 15 0 120 DEPOSIT ABSOLUTE FORMAT "%3.1" AXIS_PTS_REF SSTSKL_A1 /end AXIS_DESCR
 FORMAT "%2.0" /end CHARACTERISTIC
/begin CHARACTERISTIC A154 "" CURVE 0x1DFB04 _REC_A1CUR_1_u2_u2_S2 15000 _CNV_R_R_Umr_1_zu_1_3_CM_S2 0 15000
 /begin AXIS_DESCR COM_AXIS W_DKKD _CNV_R_R_Umr_10_zu__9_CM_S2 15 0 120 DEPOSIT ABSOLUTE FORMAT "%3.1" AXIS_PTS_REF SSTSKL_A1 /end AXIS_DESCR
 FORMAT "%2.0" /end CHARACTERISTIC
/begin CHARACTERISTIC A156 "" CURVE 0x1DFB22 _REC_A1CUR_1_u2_u2_S2 15000 _CNV_R_R_Umr_1_zu_1_3_CM_S2 0 15000
 /begin AXIS_DESCR COM_AXIS W_DKKD _CNV_R_R_Umr_10_zu__9_CM_S2 15 0 120 DEPOSIT ABSOLUTE FORMAT "%3.1" AXIS_PTS_REF SSTSKL_A1 /end AXIS_DESCR
 FORMAT "%2.0" /end CHARACTERISTIC
/begin CHARACTERISTIC A165 "" CURVE 0x1DFB40 _REC_A1CUR_1_u2_u2_S2 15000 _CNV_R_R_Umr_1_zu_1_3_CM_S2 0 15000
 /begin AXIS_DESCR COM_AXIS W_DKKD _CNV_R_R_Umr_10_zu__9_CM_S2 15 0 120 DEPOSIT ABSOLUTE FORMAT "%3.1" AXIS_PTS_REF SSTSKL_A1 /end AXIS_DESCR
 FORMAT "%2.0" /end CHARACTERISTIC
/begin CHARACTERISTIC A167 "" CURVE 0x1E12CE _REC_A1CUR_1_u2_u2_S2 15000 _CNV_R_R_Umr_1_zu_1_3_CM_S2 0 15000
 /begin AXIS_DESCR COM_AXIS W_DKKD _CNV_R_R_Umr_10_zu__9_CM_S2 15 0 120 DEPOSIT ABSOLUTE FORMAT "%3.1" AXIS_PTS_REF SSTSKL_A1 /end AXIS_DESCR
 FORMAT "%2.0" /end CHARACTERISTIC
/begin CHARACTERISTIC A176 "" CURVE 0x1E12EC _REC_A1CUR_1_u2_u2_S2 15000 _CNV_R_R_Umr_1_zu_1_3_CM_S2 0 15000
 /begin AXIS_DESCR COM_AXIS W_DKKD _CNV_R_R_Umr_10_zu__9_CM_S2 15 0 120 DEPOSIT ABSOLUTE FORMAT "%3.1" AXIS_PTS_REF SSTSKL_A1 /end AXIS_DESCR
 FORMAT "%2.0" /end CHARACTERISTIC
/begin CHARACTERISTIC A178 "" CURVE 0x1E17BA _REC_A1CUR_1_u2_u2_S2 15000 _CNV_R_R_Umr_1_zu_1_3_CM_S2 0 15000
 /begin AXIS_DESCR COM_AXIS W_DKKD _CNV_R_R_Umr_10_zu__9_CM_S2 15 0 120 DEPOSIT ABSOLUTE FORMAT "%3.1" AXIS_PTS_REF SSTSKL_A1 /end AXIS_DESCR
 FORMAT "%2.0" /end CHARACTERISTIC
/begin CHARACTERISTIC A187 "" CURVE 0x1E17D8 _REC_A1CUR_1_u2_u2_S2 15000 _CNV_R_R_Umr_1_zu_1_3_CM_S2 0 15000
 /begin AXIS_DESCR COM_AXIS W_DKKD _CNV_R_R_Umr_10_zu__9_CM_S2 15 0 120 DEPOSIT ABSOLUTE FORMAT "%3.1" AXIS_PTS_REF SSTSKL_A1 /end AXIS_DESCR
 FORMAT "%2.0" /end CHARACTERISTIC
/begin CHARACTERISTIC A212 "" CURVE 0x1DFB5E _REC_A1CUR_1_u2_u2_S2 15000 _CNV_R_R_Umr_1_zu_1_3_CM_S2 0 15000
 /begin AXIS_DESCR COM_AXIS W_DKKD _CNV_R_R_Umr_10_zu__9_CM_S2 15 0 120 DEPOSIT ABSOLUTE FORMAT "%3.1" AXIS_PTS_REF SSTSKL_A2 /end AXIS_DESCR
 FORMAT "%2.0" /end CHARACTERISTIC
/begin CHARACTERISTIC A221 "" CURVE 0x1DFB7C _REC_A1CUR_1_u2_u2_S2 15000 _CNV_R_R_Umr_1_zu_1_3_CM_S2 0 15000
 /begin AXIS_DESCR COM_AXIS W_DKKD _CNV_R_R_Umr_10_zu__9_CM_S2 15 0 120 DEPOSIT ABSOLUTE FORMAT "%3.1" AXIS_PTS_REF SSTSKL_A2 /end AXIS_DESCR
 FORMAT "%2.0" /end CHARACTERISTIC
/begin CHARACTERISTIC A223 "" CURVE 0x1DFB9A _REC_A1CUR_1_u2_u2_S2 15000 _CNV_R_R_Umr_1_zu_1_3_CM_S2 0 15000
 /begin AXIS_DESCR COM_AXIS W_DKKD _CNV_R_R_Umr_10_zu__9_CM_S2 15 0 120 DEPOSIT ABSOLUTE FORMAT "%3.1" AXIS_PTS_REF SSTSKL_A2 /end AXIS_DESCR
 FORMAT "%2.0" /end CHARACTERISTIC
/begin CHARACTERISTIC A232 "" CURVE 0x1DFBB8 _REC_A1CUR_1_u2_u2_S2 15000 _CNV_R_R_Umr_1_zu_1_3_CM_S2 0 15000
 /begin AXIS_DESCR COM_AXIS W_DKKD _CNV_R_R_Umr_10_zu__9_CM_S2 15 0 120 DEPOSIT ABSOLUTE FORMAT "%3.1" AXIS_PTS_REF SSTSKL_A2 /end AXIS_DESCR
 FORMAT "%2.0" /end CHARACTERISTIC
/begin CHARACTERISTIC A234 "" CURVE 0x1DFBD6 _REC_A1CUR_1_u2_u2_S2 15000 _CNV_R_R_Umr_1_zu_1_3_CM_S2 0 15000
 /begin AXIS_DESCR COM_AXIS W_DKKD _CNV_R_R_Umr_10_zu__9_CM_S2 15 0 120 DEPOSIT ABSOLUTE FORMAT "%3.1" AXIS_PTS_REF SSTSKL_A2 /end AXIS_DESCR
 FORMAT "%2.0" /end CHARACTERISTIC
/begin CHARACTERISTIC A243 "" CURVE 0x1DFBF4 _REC_A1CUR_1_u2_u2_S2 15000 _CNV_R_R_Umr_1_zu_1_3_CM_S2 0 15000
 /begin AXIS_DESCR COM_AXIS W_DKKD _CNV_R_R_Umr_10_zu__9_CM_S2 15 0 120 DEPOSIT ABSOLUTE FORMAT "%3.1" AXIS_PTS_REF SSTSKL_A2 /end AXIS_DESCR
 FORMAT "%2.0" /end CHARACTERISTIC
/begin CHARACTERISTIC A245 "" CURVE 0x1DFC12 _REC_A1CUR_1_u2_u2_S2 15000 _CNV_R_R_Umr_1_zu_1_3_CM_S2 0 15000
 /begin AXIS_DESCR COM_AXIS W_DKKD _CNV_R_R_Umr_10_zu__9_CM_S2 15 0 120 DEPOSIT ABSOLUTE FORMAT "%3.1" AXIS_PTS_REF SSTSKL_A2 /end AXIS_DESCR
 FORMAT "%2.0" /end CHARACTERISTIC
/begin CHARACTERISTIC A254 "" CURVE 0x1DFC30 _REC_A1CUR_1_u2_u2_S2 15000 _CNV_R_R_Umr_1_zu_1_3_CM_S2 0 15000
 /begin AXIS_DESCR COM_AXIS W_DKKD _CNV_R_R_Umr_10_zu__9_CM_S2 15 0 120 DEPOSIT ABSOLUTE FORMAT "%3.1" AXIS_PTS_REF SSTSKL_A2 /end AXIS_DESCR
 FORMAT "%2.0" /end CHARACTERISTIC
/begin CHARACTERISTIC A256 "" CURVE 0x1DFC4E _REC_A1CUR_1_u2_u2_S2 15000 _CNV_R_R_Umr_1_zu_1_3_CM_S2 0 15000
 /begin AXIS_DESCR COM_AXIS W_DKKD _CNV_R_R_Umr_10_zu__9_CM_S2 15 0 120 DEPOSIT ABSOLUTE FORMAT "%3.1" AXIS_PTS_REF SSTSKL_A2 /end AXIS_DESCR
 FORMAT "%2.0" /end CHARACTERISTIC
/begin CHARACTERISTIC A265 "" CURVE 0x1DFC6C _REC_A1CUR_1_u2_u2_S2 15000 _CNV_R_R_Umr_1_zu_1_3_CM_S2 0 15000
 /begin AXIS_DESCR COM_AXIS W_DKKD _CNV_R_R_Umr_10_zu__9_CM_S2 15 0 120 DEPOSIT ABSOLUTE FORMAT "%3.1" AXIS_PTS_REF SSTSKL_A2 /end AXIS_DESCR
 FORMAT "%2.0" /end CHARACTERISTIC
/begin CHARACTERISTIC A267 "" CURVE 0x1E130A _REC_A1CUR_1_u2_u2_S2 15000 _CNV_R_R_Umr_1_zu_1_3_CM_S2 0 15000
 /begin AXIS_DESCR COM_AXIS W_DKKD _CNV_R_R_Umr_10_zu__9_CM_S2 15 0 120 DEPOSIT ABSOLUTE FORMAT "%3.1" AXIS_PTS_REF SSTSKL_A2 /end AXIS_DESCR
 FORMAT "%2.0" /end CHARACTERISTIC
/begin CHARACTERISTIC A276 "" CURVE 0x1E1328 _REC_A1CUR_1_u2_u2_S2 15000 _CNV_R_R_Umr_1_zu_1_3_CM_S2 0 15000
 /begin AXIS_DESCR COM_AXIS W_DKKD _CNV_R_R_Umr_10_zu__9_CM_S2 15 0 120 DEPOSIT ABSOLUTE FORMAT "%3.1" AXIS_PTS_REF SSTSKL_A2 /end AXIS_DESCR
 FORMAT "%2.0" /end CHARACTERISTIC
/begin CHARACTERISTIC A278 "" CURVE 0x1E17F6 _REC_A1CUR_1_u2_u2_S2 15000 _CNV_R_R_Umr_1_zu_1_3_CM_S2 0 15000
 /begin AXIS_DESCR COM_AXIS W_DKKD _CNV_R_R_Umr_10_zu__9_CM_S2 15 0 120 DEPOSIT ABSOLUTE FORMAT "%3.1" AXIS_PTS_REF SSTSKL_A2 /end AXIS_DESCR
 FORMAT "%2.0" /end CHARACTERISTIC
/begin CHARACTERISTIC A287 "" CURVE 0x1E1814 _REC_A1CUR_1_u2_u2_S2 15000 _CNV_R_R_Umr_1_zu_1_3_CM_S2 0 15000
 /begin AXIS_DESCR COM_AXIS W_DKKD _CNV_R_R_Umr_10_zu__9_CM_S2 15 0 120 DEPOSIT ABSOLUTE FORMAT "%3.1" AXIS_PTS_REF SSTSKL_A2 /end AXIS_DESCR
 FORMAT "%2.0" /end CHARACTERISTIC
/begin CHARACTERISTIC A312 "" CURVE 0x1DFC8A _REC_A1CUR_1_u2_u2_S2 15000 _CNV_R_R_Umr_1_zu_1_3_CM_S2 0 15000
 /begin AXIS_DESCR COM_AXIS W_DKKD _CNV_R_R_Umr_10_zu__9_CM_S2 15 0 120 DEPOSIT ABSOLUTE FORMAT "%3.1" AXIS_PTS_REF SSTSKL_A3 /end AXIS_DESCR
 FORMAT "%2.0" /end CHARACTERISTIC
/begin CHARACTERISTIC A321 "" CURVE 0x1DFCA8 _REC_A1CUR_1_u2_u2_S2 15000 _CNV_R_R_Umr_1_zu_1_3_CM_S2 0 15000
 /begin AXIS_DESCR COM_AXIS W_DKKD _CNV_R_R_Umr_10_zu__9_CM_S2 15 0 120 DEPOSIT ABSOLUTE FORMAT "%3.1" AXIS_PTS_REF SSTSKL_A3 /end AXIS_DESCR
 FORMAT "%2.0" /end CHARACTERISTIC
/begin CHARACTERISTIC A323 "" CURVE 0x1DFCC6 _REC_A1CUR_1_u2_u2_S2 15000 _CNV_R_R_Umr_1_zu_1_3_CM_S2 0 15000
 /begin AXIS_DESCR COM_AXIS W_DKKD _CNV_R_R_Umr_10_zu__9_CM_S2 15 0 120 DEPOSIT ABSOLUTE FORMAT "%3.1" AXIS_PTS_REF SSTSKL_A3 /end AXIS_DESCR
 FORMAT "%2.0" /end CHARACTERISTIC
/begin CHARACTERISTIC A332 "" CURVE 0x1DFCE4 _REC_A1CUR_1_u2_u2_S2 15000 _CNV_R_R_Umr_1_zu_1_3_CM_S2 0 15000
 /begin AXIS_DESCR COM_AXIS W_DKKD _CNV_R_R_Umr_10_zu__9_CM_S2 15 0 120 DEPOSIT ABSOLUTE FORMAT "%3.1" AXIS_PTS_REF SSTSKL_A3 /end AXIS_DESCR
 FORMAT "%2.0" /end CHARACTERISTIC
/begin CHARACTERISTIC A334 "" CURVE 0x1DFD02 _REC_A1CUR_1_u2_u2_S2 15000 _CNV_R_R_Umr_1_zu_1_3_CM_S2 0 15000
 /begin AXIS_DESCR COM_AXIS W_DKKD _CNV_R_R_Umr_10_zu__9_CM_S2 15 0 120 DEPOSIT ABSOLUTE FORMAT "%3.1" AXIS_PTS_REF SSTSKL_A3 /end AXIS_DESCR
 FORMAT "%2.0" /end CHARACTERISTIC
/begin CHARACTERISTIC A343 "" CURVE 0x1DFD20 _REC_A1CUR_1_u2_u2_S2 15000 _CNV_R_R_Umr_1_zu_1_3_CM_S2 0 15000
 /begin AXIS_DESCR COM_AXIS W_DKKD _CNV_R_R_Umr_10_zu__9_CM_S2 15 0 120 DEPOSIT ABSOLUTE FORMAT "%3.1" AXIS_PTS_REF SSTSKL_A3 /end AXIS_DESCR
 FORMAT "%2.0" /end CHARACTERISTIC
/begin CHARACTERISTIC A345 "" CURVE 0x1DFD3E _REC_A1CUR_1_u2_u2_S2 15000 _CNV_R_R_Umr_1_zu_1_3_CM_S2 0 15000
 /begin AXIS_DESCR COM_AXIS W_DKKD _CNV_R_R_Umr_10_zu__9_CM_S2 15 0 120 DEPOSIT ABSOLUTE FORMAT "%3.1" AXIS_PTS_REF SSTSKL_A3 /end AXIS_DESCR
 FORMAT "%2.0" /end CHARACTERISTIC
/begin CHARACTERISTIC A354 "" CURVE 0x1DFD5C _REC_A1CUR_1_u2_u2_S2 15000 _CNV_R_R_Umr_1_zu_1_3_CM_S2 0 15000
 /begin AXIS_DESCR COM_AXIS W_DKKD _CNV_R_R_Umr_10_zu__9_CM_S2 15 0 120 DEPOSIT ABSOLUTE FORMAT "%3.1" AXIS_PTS_REF SSTSKL_A3 /end AXIS_DESCR
 FORMAT "%2.0" /end CHARACTERISTIC
/begin CHARACTERISTIC A356 "" CURVE 0x1DFD7A _REC_A1CUR_1_u2_u2_S2 15000 _CNV_R_R_Umr_1_zu_1_3_CM_S2 0 15000
 /begin AXIS_DESCR COM_AXIS W_DKKD _CNV_R_R_Umr_10_zu__9_CM_S2 15 0 120 DEPOSIT ABSOLUTE FORMAT "%3.1" AXIS_PTS_REF SSTSKL_A3 /end AXIS_DESCR
 FORMAT "%2.0" /end CHARACTERISTIC
/begin CHARACTERISTIC A365 "" CURVE 0x1DFD98 _REC_A1CUR_1_u2_u2_S2 15000 _CNV_R_R_Umr_1_zu_1_3_CM_S2 0 15000
 /begin AXIS_DESCR COM_AXIS W_DKKD _CNV_R_R_Umr_10_zu__9_CM_S2 15 0 120 DEPOSIT ABSOLUTE FORMAT "%3.1" AXIS_PTS_REF SSTSKL_A3 /end AXIS_DESCR
 FORMAT "%2.0" /end CHARACTERISTIC
/begin CHARACTERISTIC A367 "" CURVE 0x1E1346 _REC_A1CUR_1_u2_u2_S2 15000 _CNV_R_R_Umr_1_zu_1_3_CM_S2 0 15000
 /begin AXIS_DESCR COM_AXIS W_DKKD _CNV_R_R_Umr_10_zu__9_CM_S2 15 0 120 DEPOSIT ABSOLUTE FORMAT "%3.1" AXIS_PTS_REF SSTSKL_A3 /end AXIS_DESCR
 FORMAT "%2.0" /end CHARACTERISTIC
/begin CHARACTERISTIC A376 "" CURVE 0x1E1364 _REC_A1CUR_1_u2_u2_S2 15000 _CNV_R_R_Umr_1_zu_1_3_CM_S2 0 15000
 /begin AXIS_DESCR COM_AXIS W_DKKD _CNV_R_R_Umr_10_zu__9_CM_S2 15 0 120 DEPOSIT ABSOLUTE FORMAT "%3.1" AXIS_PTS_REF SSTSKL_A3 /end AXIS_DESCR
 FORMAT "%2.0" /end CHARACTERISTIC
/begin CHARACTERISTIC A378 "" CURVE 0x1E1832 _REC_A1CUR_1_u2_u2_S2 15000 _CNV_R_R_Umr_1_zu_1_3_CM_S2 0 15000
 /begin AXIS_DESCR COM_AXIS W_DKKD _CNV_R_R_Umr_10_zu__9_CM_S2 15 0 120 DEPOSIT ABSOLUTE FORMAT "%3.1" AXIS_PTS_REF SSTSKL_A3 /end AXIS_DESCR
 FORMAT "%2.0" /end CHARACTERISTIC
/begin CHARACTERISTIC A387 "" CURVE 0x1E1850 _REC_A1CUR_1_u2_u2_S2 15000 _CNV_R_R_Umr_1_zu_1_3_CM_S2 0 15000
 /begin AXIS_DESCR COM_AXIS W_DKKD _CNV_R_R_Umr_10_zu__9_CM_S2 15 0 120 DEPOSIT ABSOLUTE FORMAT "%3.1" AXIS_PTS_REF SSTSKL_A3 /end AXIS_DESCR
 FORMAT "%2.0" /end CHARACTERISTIC
/begin CHARACTERISTIC A412 "" CURVE 0x1DFDB6 _REC_A1CUR_1_u2_u2_S2 15000 _CNV_R_R_Umr_1_zu_1_3_CM_S2 0 15000
 /begin AXIS_DESCR COM_AXIS W_DKKD _CNV_R_R_Umr_10_zu__9_CM_S2 15 0 120 DEPOSIT ABSOLUTE FORMAT "%3.1" AXIS_PTS_REF SSTSKL_A4 /end AXIS_DESCR
 FORMAT "%2.0" /end CHARACTERISTIC
/begin CHARACTERISTIC A421 "" CURVE 0x1DFDD4 _REC_A1CUR_1_u2_u2_S2 15000 _CNV_R_R_Umr_1_zu_1_3_CM_S2 0 15000
 /begin AXIS_DESCR COM_AXIS W_DKKD _CNV_R_R_Umr_10_zu__9_CM_S2 15 0 120 DEPOSIT ABSOLUTE FORMAT "%3.1" AXIS_PTS_REF SSTSKL_A4 /end AXIS_DESCR
 FORMAT "%2.0" /end CHARACTERISTIC
/begin CHARACTERISTIC A423 "" CURVE 0x1DFDF2 _REC_A1CUR_1_u2_u2_S2 15000 _CNV_R_R_Umr_1_zu_1_3_CM_S2 0 15000
 /begin AXIS_DESCR COM_AXIS W_DKKD _CNV_R_R_Umr_10_zu__9_CM_S2 15 0 120 DEPOSIT ABSOLUTE FORMAT "%3.1" AXIS_PTS_REF SSTSKL_A4 /end AXIS_DESCR
 FORMAT "%2.0" /end CHARACTERISTIC
/begin CHARACTERISTIC A432 "" CURVE 0x1DFE10 _REC_A1CUR_1_u2_u2_S2 15000 _CNV_R_R_Umr_1_zu_1_3_CM_S2 0 15000
 /begin AXIS_DESCR COM_AXIS W_DKKD _CNV_R_R_Umr_10_zu__9_CM_S2 15 0 120 DEPOSIT ABSOLUTE FORMAT "%3.1" AXIS_PTS_REF SSTSKL_A4 /end AXIS_DESCR
 FORMAT "%2.0" /end CHARACTERISTIC
/begin CHARACTERISTIC A434 "" CURVE 0x1DFE2E _REC_A1CUR_1_u2_u2_S2 15000 _CNV_R_R_Umr_1_zu_1_3_CM_S2 0 15000
 /begin AXIS_DESCR COM_AXIS W_DKKD _CNV_R_R_Umr_10_zu__9_CM_S2 15 0 120 DEPOSIT ABSOLUTE FORMAT "%3.1" AXIS_PTS_REF SSTSKL_A4 /end AXIS_DESCR
 FORMAT "%2.0" /end CHARACTERISTIC
/begin CHARACTERISTIC A443 "" CURVE 0x1DFE4C _REC_A1CUR_1_u2_u2_S2 15000 _CNV_R_R_Umr_1_zu_1_3_CM_S2 0 15000
 /begin AXIS_DESCR COM_AXIS W_DKKD _CNV_R_R_Umr_10_zu__9_CM_S2 15 0 120 DEPOSIT ABSOLUTE FORMAT "%3.1" AXIS_PTS_REF SSTSKL_A4 /end AXIS_DESCR
 FORMAT "%2.0" /end CHARACTERISTIC
/begin CHARACTERISTIC A445 "" CURVE 0x1DFE6A _REC_A1CUR_1_u2_u2_S2 15000 _CNV_R_R_Umr_1_zu_1_3_CM_S2 0 15000
 /begin AXIS_DESCR COM_AXIS W_DKKD _CNV_R_R_Umr_10_zu__9_CM_S2 15 0 120 DEPOSIT ABSOLUTE FORMAT "%3.1" AXIS_PTS_REF SSTSKL_A4 /end AXIS_DESCR
 FORMAT "%2.0" /end CHARACTERISTIC
/begin CHARACTERISTIC A454 "" CURVE 0x1DFE88 _REC_A1CUR_1_u2_u2_S2 15000 _CNV_R_R_Umr_1_zu_1_3_CM_S2 0 15000
 /begin AXIS_DESCR COM_AXIS W_DKKD _CNV_R_R_Umr_10_zu__9_CM_S2 15 0 120 DEPOSIT ABSOLUTE FORMAT "%3.1" AXIS_PTS_REF SSTSKL_A4 /end AXIS_DESCR
 FORMAT "%2.0" /end CHARACTERISTIC
/begin CHARACTERISTIC A456 "" CURVE 0x1DFEA6 _REC_A1CUR_1_u2_u2_S2 15000 _CNV_R_R_Umr_1_zu_1_3_CM_S2 0 15000
 /begin AXIS_DESCR COM_AXIS W_DKKD _CNV_R_R_Umr_10_zu__9_CM_S2 15 0 120 DEPOSIT ABSOLUTE FORMAT "%3.1" AXIS_PTS_REF SSTSKL_A4 /end AXIS_DESCR
 FORMAT "%2.0" /end CHARACTERISTIC
/begin CHARACTERISTIC A465 "" CURVE 0x1DFEC4 _REC_A1CUR_1_u2_u2_S2 15000 _CNV_R_R_Umr_1_zu_1_3_CM_S2 0 15000
 /begin AXIS_DESCR COM_AXIS W_DKKD _CNV_R_R_Umr_10_zu__9_CM_S2 15 0 120 DEPOSIT ABSOLUTE FORMAT "%3.1" AXIS_PTS_REF SSTSKL_A4 /end AXIS_DESCR
 FORMAT "%2.0" /end CHARACTERISTIC
/begin CHARACTERISTIC A467 "" CURVE 0x1E1382 _REC_A1CUR_1_u2_u2_S2 15000 _CNV_R_R_Umr_1_zu_1_3_CM_S2 0 15000
 /begin AXIS_DESCR COM_AXIS W_DKKD _CNV_R_R_Umr_10_zu__9_CM_S2 15 0 120 DEPOSIT ABSOLUTE FORMAT "%3.1" AXIS_PTS_REF SSTSKL_A4 /end AXIS_DESCR
 FORMAT "%2.0" /end CHARACTERISTIC
/begin CHARACTERISTIC A476 "" CURVE 0x1E13A0 _REC_A1CUR_1_u2_u2_S2 15000 _CNV_R_R_Umr_1_zu_1_3_CM_S2 0 15000
 /begin AXIS_DESCR COM_AXIS W_DKKD _CNV_R_R_Umr_10_zu__9_CM_S2 15 0 120 DEPOSIT ABSOLUTE FORMAT "%3.1" AXIS_PTS_REF SSTSKL_A4 /end AXIS_DESCR
 FORMAT "%2.0" /end CHARACTERISTIC
/begin CHARACTERISTIC A478 "" CURVE 0x1E186E _REC_A1CUR_1_u2_u2_S2 15000 _CNV_R_R_Umr_1_zu_1_3_CM_S2 0 15000
 /begin AXIS_DESCR COM_AXIS W_DKKD _CNV_R_R_Umr_10_zu__9_CM_S2 15 0 120 DEPOSIT ABSOLUTE FORMAT "%3.1" AXIS_PTS_REF SSTSKL_A4 /end AXIS_DESCR
 FORMAT "%2.0" /end CHARACTERISTIC
/begin CHARACTERISTIC A487 "" CURVE 0x1E188C _REC_A1CUR_1_u2_u2_S2 15000 _CNV_R_R_Umr_1_zu_1_3_CM_S2 0 15000
 /begin AXIS_DESCR COM_AXIS W_DKKD _CNV_R_R_Umr_10_zu__9_CM_S2 15 0 120 DEPOSIT ABSOLUTE FORMAT "%3.1" AXIS_PTS_REF SSTSKL_A4 /end AXIS_DESCR
 FORMAT "%2.0" /end CHARACTERISTIC
/begin CHARACTERISTIC A512 "" CURVE 0x1DFEE2 _REC_A1CUR_1_u2_u2_S2 15000 _CNV_R_R_Umr_1_zu_1_3_CM_S2 0 15000
 /begin AXIS_DESCR COM_AXIS W_DKKD _CNV_R_R_Umr_10_zu__9_CM_S2 15 0 120 DEPOSIT ABSOLUTE FORMAT "%3.1" AXIS_PTS_REF SSTSKL_A5 /end AXIS_DESCR
 FORMAT "%2.0" /end CHARACTERISTIC
/begin CHARACTERISTIC A521 "" CURVE 0x1DFF00 _REC_A1CUR_1_u2_u2_S2 15000 _CNV_R_R_Umr_1_zu_1_3_CM_S2 0 15000
 /begin AXIS_DESCR COM_AXIS W_DKKD _CNV_R_R_Umr_10_zu__9_CM_S2 15 0 120 DEPOSIT ABSOLUTE FORMAT "%3.1" AXIS_PTS_REF SSTSKL_A5 /end AXIS_DESCR
 FORMAT "%2.0" /end CHARACTERISTIC
/begin CHARACTERISTIC A523 "" CURVE 0x1DFF1E _REC_A1CUR_1_u2_u2_S2 15000 _CNV_R_R_Umr_1_zu_1_3_CM_S2 0 15000
 /begin AXIS_DESCR COM_AXIS W_DKKD _CNV_R_R_Umr_10_zu__9_CM_S2 15 0 120 DEPOSIT ABSOLUTE FORMAT "%3.1" AXIS_PTS_REF SSTSKL_A5 /end AXIS_DESCR
 FORMAT "%2.0" /end CHARACTERISTIC
/begin CHARACTERISTIC A532 "" CURVE 0x1DFF3C _REC_A1CUR_1_u2_u2_S2 15000 _CNV_R_R_Umr_1_zu_1_3_CM_S2 0 15000
 /begin AXIS_DESCR COM_AXIS W_DKKD _CNV_R_R_Umr_10_zu__9_CM_S2 15 0 120 DEPOSIT ABSOLUTE FORMAT "%3.1" AXIS_PTS_REF SSTSKL_A5 /end AXIS_DESCR
 FORMAT "%2.0" /end CHARACTERISTIC
/begin CHARACTERISTIC A534 "" CURVE 0x1DFF5A _REC_A1CUR_1_u2_u2_S2 15000 _CNV_R_R_Umr_1_zu_1_3_CM_S2 0 15000
 /begin AXIS_DESCR COM_AXIS W_DKKD _CNV_R_R_Umr_10_zu__9_CM_S2 15 0 120 DEPOSIT ABSOLUTE FORMAT "%3.1" AXIS_PTS_REF SSTSKL_A5 /end AXIS_DESCR
 FORMAT "%2.0" /end CHARACTERISTIC
/begin CHARACTERISTIC A543 "" CURVE 0x1DFF78 _REC_A1CUR_1_u2_u2_S2 15000 _CNV_R_R_Umr_1_zu_1_3_CM_S2 0 15000
 /begin AXIS_DESCR COM_AXIS W_DKKD _CNV_R_R_Umr_10_zu__9_CM_S2 15 0 120 DEPOSIT ABSOLUTE FORMAT "%3.1" AXIS_PTS_REF SSTSKL_A5 /end AXIS_DESCR
 FORMAT "%2.0" /end CHARACTERISTIC
/begin CHARACTERISTIC A545 "" CURVE 0x1DFF96 _REC_A1CUR_1_u2_u2_S2 15000 _CNV_R_R_Umr_1_zu_1_3_CM_S2 0 15000
 /begin AXIS_DESCR COM_AXIS W_DKKD _CNV_R_R_Umr_10_zu__9_CM_S2 15 0 120 DEPOSIT ABSOLUTE FORMAT "%3.1" AXIS_PTS_REF SSTSKL_A5 /end AXIS_DESCR
 FORMAT "%2.0" /end CHARACTERISTIC
/begin CHARACTERISTIC A554 "" CURVE 0x1DFFB4 _REC_A1CUR_1_u2_u2_S2 15000 _CNV_R_R_Umr_1_zu_1_3_CM_S2 0 15000
 /begin AXIS_DESCR COM_AXIS W_DKKD _CNV_R_R_Umr_10_zu__9_CM_S2 15 0 120 DEPOSIT ABSOLUTE FORMAT "%3.1" AXIS_PTS_REF SSTSKL_A5 /end AXIS_DESCR
 FORMAT "%2.0" /end CHARACTERISTIC
/begin CHARACTERISTIC A556 "" CURVE 0x1DFFD2 _REC_A1CUR_1_u2_u2_S2 15000 _CNV_R_R_Umr_1_zu_1_3_CM_S2 0 15000
 /begin AXIS_DESCR COM_AXIS W_DKKD _CNV_R_R_Umr_10_zu__9_CM_S2 15 0 120 DEPOSIT ABSOLUTE FORMAT "%3.1" AXIS_PTS_REF SSTSKL_A5 /end AXIS_DESCR
 FORMAT "%2.0" /end CHARACTERISTIC
/begin CHARACTERISTIC A565 "" CURVE 0x1DFFF0 _REC_A1CUR_1_u2_u2_S2 15000 _CNV_R_R_Umr_1_zu_1_3_CM_S2 0 15000
 /begin AXIS_DESCR COM_AXIS W_DKKD _CNV_R_R_Umr_10_zu__9_CM_S2 15 0 120 DEPOSIT ABSOLUTE FORMAT "%3.1" AXIS_PTS_REF SSTSKL_A5 /end AXIS_DESCR
 FORMAT "%2.0" /end CHARACTERISTIC
/begin CHARACTERISTIC A567 "" CURVE 0x1E13BE _REC_A1CUR_1_u2_u2_S2 15000 _CNV_R_R_Umr_1_zu_1_3_CM_S2 0 15000
 /begin AXIS_DESCR COM_AXIS W_DKKD _CNV_R_R_Umr_10_zu__9_CM_S2 15 0 120 DEPOSIT ABSOLUTE FORMAT "%3.1" AXIS_PTS_REF SSTSKL_A5 /end AXIS_DESCR
 FORMAT "%2.0" /end CHARACTERISTIC
/begin CHARACTERISTIC A576 "" CURVE 0x1E13DC _REC_A1CUR_1_u2_u2_S2 15000 _CNV_R_R_Umr_1_zu_1_3_CM_S2 0 15000
 /begin AXIS_DESCR COM_AXIS W_DKKD _CNV_R_R_Umr_10_zu__9_CM_S2 15 0 120 DEPOSIT ABSOLUTE FORMAT "%3.1" AXIS_PTS_REF SSTSKL_A5 /end AXIS_DESCR
 FORMAT "%2.0" /end CHARACTERISTIC
/begin CHARACTERISTIC A578 "" CURVE 0x1E18AA _REC_A1CUR_1_u2_u2_S2 15000 _CNV_R_R_Umr_1_zu_1_3_CM_S2 0 15000
 /begin AXIS_DESCR COM_AXIS W_DKKD _CNV_R_R_Umr_10_zu__9_CM_S2 15 0 120 DEPOSIT ABSOLUTE FORMAT "%3.1" AXIS_PTS_REF SSTSKL_A5 /end AXIS_DESCR
 FORMAT "%2.0" /end CHARACTERISTIC
/begin CHARACTERISTIC A587 "" CURVE 0x1E18C8 _REC_A1CUR_1_u2_u2_S2 15000 _CNV_R_R_Umr_1_zu_1_3_CM_S2 0 15000
 /begin AXIS_DESCR COM_AXIS W_DKKD _CNV_R_R_Umr_10_zu__9_CM_S2 15 0 120 DEPOSIT ABSOLUTE FORMAT "%3.1" AXIS_PTS_REF SSTSKL_A5 /end AXIS_DESCR
 FORMAT "%2.0" /end CHARACTERISTIC
/begin MEASUREMENT A_FZG "" UWORD _CNV_R_R_Umr_10_zu__37_CM_S2 1 0 0 6553.5 ECU_ADDRESS 0xFFF8E444 FORMAT "%3.1" /end MEASUREMENT
/begin MEASUREMENT A_FZGSQ "" UWORD _CNV_R_R_Umr_100_zu_204_CM_S2 1 0 0 655.35 ECU_ADDRESS 0xFFF8E446 FORMAT "%4.2" /end MEASUREMENT
/begin MEASUREMENT A_L "" SWORD _CNV_R_R_Umr_10_zu__37_CM_S2 1 0 -3276.8 3276.7 ECU_ADDRESS 0xFFF8E448 FORMAT "%3.1" /end MEASUREMENT
/begin MEASUREMENT A_L_75MS "" SWORD _CNV_R_R_Umr_10_zu__37_CM_S2 1 0 -3276.8 3276.7 ECU_ADDRESS 0xFFF8E44A FORMAT "%3.1" /end MEASUREMENT
/begin MEASUREMENT A_L_75MSFILT "" SWORD _CNV_R_R_Umr_10_zu__37_CM_S2 1 0 -3276.8 3276.7 ECU_ADDRESS 0xFFF8E44C FORMAT "%3.1" /end MEASUREMENT
/begin MEASUREMENT A_L_75MSFILTREST "" SWORD _CNV_R_R_Umr_10_zu__37_CM_S2 1 0 -3276.8 3276.7 ECU_ADDRESS 0xFFF8E44E FORMAT "%3.1" /end MEASUREMENT
/begin MEASUREMENT A_L_75MSMUELOW "" SWORD _CNV_R_R_Umr_10_zu__37_CM_S2 1 0 -3276.8 3276.7 ECU_ADDRESS 0xFFF8E450 FORMAT "%3.1" /end MEASUREMENT
/begin MEASUREMENT A_L_75MSMUELOWFILT "" SWORD _CNV_R_R_Umr_10_zu__37_CM_S2 1 0 -3276.8 3276.7 ECU_ADDRESS 0xFFF8E452 FORMAT "%3.1" /end MEASUREMENT
/begin MEASUREMENT A_L_75MSMUELOWFILTREST "" SWORD _CNV_R_R_Umr_10_zu__37_CM_S2 1 0 -3276.8 3276.7 ECU_ADDRESS 0xFFF8E454 FORMAT "%3.1" /end MEASUREMENT
/begin MEASUREMENT A_L_FILT "" SWORD _CNV_R_R_Umr_10_zu__37_CM_S2 1 0 -3276.8 3276.7 ECU_ADDRESS 0xFFF8E456 FORMAT "%3.1" /end MEASUREMENT
/begin MEASUREMENT A_L_FILTREST "" SWORD _CNV_R_R_Umr_10_zu__37_CM_S2 1 0 -3276.8 3276.7 ECU_ADDRESS 0xFFF8E458 FORMAT "%3.1" /end MEASUREMENT
/begin MEASUREMENT A_L_MUELOW "" SWORD _CNV_R_R_Umr_10_zu__37_CM_S2 1 0 -3276.8 3276.7 ECU_ADDRESS 0xFFF8E45A FORMAT "%3.1" /end MEASUREMENT
/begin MEASUREMENT A_L_NF "" SWORD _CNV_R_R_Umr_10_zu__37_CM_S2 1 0 -3276.8 3276.7 ECU_ADDRESS 0xFFF8E45C FORMAT "%3.1" /end MEASUREMENT
/begin MEASUREMENT A_L_NFMUELOW "" SWORD _CNV_R_R_Umr_10_zu__37_CM_S2 1 0 -3276.8 3276.7 ECU_ADDRESS 0xFFF8E45E FORMAT "%3.1" /end MEASUREMENT
/begin MEASUREMENT A_L_REF "" SWORD _CNV_R_R_Umr_32_zu__147_CM_S2 1 0 -1024 1023.96875 ECU_ADDRESS 0xFFF8E68E FORMAT "%4.2" /end MEASUREMENT
/begin MEASUREMENT A_L_REFFILT "" SWORD _CNV_R_R_Umr_32_zu__147_CM_S2 1 0 -1024 1023.96875 ECU_ADDRESS 0xFFF8E460 FORMAT "%4.2" /end MEASUREMENT
/begin MEASUREMENT A_L_REFFILTREST "" SWORD _CNV_R_R_Umr_32_zu__147_CM_S2 1 0 -1024 1023.96875 ECU_ADDRESS 0xFFF8E462 FORMAT "%4.2" /end MEASUREMENT
/begin MEASUREMENT A_L_REF_ROH "" SWORD _CNV_R_R_Umr_1_zu_1_2_CM_S2 1 0 -32768 32767 ECU_ADDRESS 0xFFF8E362 /end MEASUREMENT
/begin MEASUREMENT A_Q "" SWORD _CNV_R_R_Umr_10_zu__37_CM_S2 1 0 -3276.8 3276.7 ECU_ADDRESS 0xFFF8E464 FORMAT "%3.1" /end MEASUREMENT
/begin MEASUREMENT A_QGIER "" SWORD _CNV_R_R_Umr_10_zu__37_CM_S2 1 0 -3276.8 3276.7 ECU_ADDRESS 0xFFF8E466 FORMAT "%3.1" /end MEASUREMENT
/begin MEASUREMENT A_QGIER_FILT "" SWORD _CNV_R_R_Umr_10_zu__37_CM_S2 1 0 -3276.8 3276.7 ECU_ADDRESS 0xFFF8E468 FORMAT "%3.1" /end MEASUREMENT
/begin MEASUREMENT A_QGIER_FILTREST "" SWORD _CNV_R_R_Umr_10_zu__37_CM_S2 1 0 -3276.8 3276.7 ECU_ADDRESS 0xFFF8E46A FORMAT "%3.1" /end MEASUREMENT
/begin MEASUREMENT A_Q_FAKT "" ULONG _CNV_R_R_Umr_1_zu_1_2_CM_S2 1 0 0 4294967295 ECU_ADDRESS 0xFFF8EE40 FORMAT "%2.0" /end MEASUREMENT
/begin MEASUREMENT A_Q_FILT "" SWORD _CNV_R_R_Umr_10_zu__37_CM_S2 1 0 -3276.8 3276.7 ECU_ADDRESS 0xFFF8E46C FORMAT "%3.1" /end MEASUREMENT
/begin MEASUREMENT A_Q_FILTINT "" SWORD _CNV_R_R_Umr_10_zu__37_CM_S2 1 0 -3276.8 3276.7 ECU_ADDRESS 0xFFF8E46E FORMAT "%3.1" /end MEASUREMENT
/begin MEASUREMENT A_Q_FILTINTREST "" SWORD _CNV_R_R_Umr_10_zu__37_CM_S2 1 0 -3276.8 3276.7 ECU_ADDRESS 0xFFF8E470 FORMAT "%3.1" /end MEASUREMENT
/begin MEASUREMENT A_Q_KURVE "" SWORD _CNV_R_R_Umr_10_zu__37_CM_S2 1 0 -3276.8 3276.7 ECU_ADDRESS 0xFFF8E682 FORMAT "%3.1" /end MEASUREMENT
/begin MEASUREMENT A_Q_KURVEBUF "" SWORD _CNV_R_R_Umr_10_zu__37_CM_S2 1 0 -3276.8 3276.7 ECU_ADDRESS 0xFFF8F070 FORMAT "%3.1" MATRIX_DIM 20 1 1 /end MEASUREMENT
/begin MEASUREMENT A_Q_KURVE_GEW "" SWORD _CNV_R_R_Umr_10_zu__37_CM_S2 1 0 -3000 3000 ECU_ADDRESS 0xFFF8E65A FORMAT "%3.1" /end MEASUREMENT
/begin MEASUREMENT A_Q_REF "" SWORD _CNV_R_R_Umr_32_zu__147_CM_S2 1 0 -1024 1023.96875 ECU_ADDRESS 0xFFF8E690 FORMAT "%4.2" /end MEASUREMENT
/begin MEASUREMENT A_Q_REFINT "" SWORD _CNV_R_R_Umr_10_zu__37_CM_S2 1 0 -3276.8 3276.7 ECU_ADDRESS 0xFFF8E472 FORMAT "%3.1" /end MEASUREMENT
/begin MEASUREMENT A_Q_REF_ROH "" SWORD _CNV_R_R_Umr_1_zu_1_2_CM_S2 1 0 -32768 32767 ECU_ADDRESS 0xFFF8E364 /end MEASUREMENT
/begin MEASUREMENT A_RAD_BRFAKT "" UWORD _CNV_R_R_Umr_1_zu_1_2_CM_S2 1 0 0 65535 ECU_ADDRESS 0xFFF8E474 FORMAT "%2.0" /end MEASUREMENT
/begin MEASUREMENT A_RAD_VL "" SWORD _CNV_R_R_Umr_1_zu_1_205_CM_S2 1 0 -32768 32767 ECU_ADDRESS 0xFFF8E54E FORMAT "%3.1" /end MEASUREMENT
/begin MEASUREMENT A_RAD_VR "" SWORD _CNV_R_R_Umr_1_zu_1_205_CM_S2 1 0 -32768 32767 ECU_ADDRESS 0xFFF8E550 FORMAT "%3.1" /end MEASUREMENT
/begin MEASUREMENT AdaGlsDRS.KF1.BewSchaltCtr "EepromStd[2674 ... 2685]: GLS Adaption Bewertungszaehler Doppel-Rueck-Schaltungen Kennfeld 1 [(x=6/UMR___1_1_0)]" UWORD UMR___1_1_0_S5_S3 1 100 0 65535 ECU_ADDRESS 0xFFF81AAA DISPLAY_IDENTIFIER BewSchaltCtr.KF1.AdaGlsDRS MATRIX_DIM 6 1 1 /end MEASUREMENT
/begin MEASUREMENT AdaGlsDRS.KF1.Speicher "EepromStd[2290 ... 2673]: GLS Adaption Doppel-Rueck-Schaltungen Kennfeld 1 [(x=8/UMR_NM__1_1_0),(y=8/UMR_U_MIN_1_1_0),(z=6/UMR___1_1_0)]" SBYTE UMR_MBAR__10_1_0_S5_S3 1 100 -1280 1270 ECU_ADDRESS 0xFFF8192A DISPLAY_IDENTIFIER Speicher.KF1.AdaGlsDRS MATRIX_DIM 384 1 1 /end MEASUREMENT
/begin MEASUREMENT AdaGlsDRS.KF2.BewSchaltCtr "EepromStd[3070 ... 3081]: GLS Adaption Bewertungszaehler Doppel-Rueck-Schaltungen Kennfeld 2 [(x=6/UMR___1_1_0)]" UWORD UMR___1_1_0_S5_S3 1 100 0 65535 ECU_ADDRESS 0xFFF81C36 DISPLAY_IDENTIFIER BewSchaltCtr.KF2.AdaGlsDRS MATRIX_DIM 6 1 1 /end MEASUREMENT
/begin MEASUREMENT AdaGlsDRS.KF2.Speicher "EepromStd[2686 ... 3069]: GLS Adaption Doppel-Rueck-Schaltungen Kennfeld 2 [(x=8/UMR_NM__1_1_0),(y=8/UMR_U_MIN_1_1_0),(z=6/UMR___1_1_0)]" SBYTE UMR_MBAR__10_1_0_S5_S3 1 100 -1280 1270 ECU_ADDRESS 0xFFF81AB6 DISPLAY_IDENTIFIER Speicher.KF2.AdaGlsDRS MATRIX_DIM 384 1 1 /end MEASUREMENT
/begin MEASUREMENT AdaGlsEHS.KF1.BewSchaltCtr "EepromStd[882 ... 895]: GLS Adaption Bewertungszaehler Einzel-Hoch-Schaltungen Kennfeld 1 [(x=7/UMR___1_1_0)]" UWORD UMR___1_1_0_S5_S3 1 100 0 65535 ECU_ADDRESS 0xFFF813AA DISPLAY_IDENTIFIER BewSchaltCtr.KF1.AdaGlsEHS MATRIX_DIM 7 1 1 /end MEASUREMENT
/begin MEASUREMENT AdaGlsEHS.KF1.Speicher "EepromStd[434 ... 881]: GLS Adaption Einzel-Hoch-Schaltungen Kennfeld 1 [(x=8/UMR_NM__1_1_0),(y=8/UMR_U_MIN_1_1_0),(z=7/UMR___1_1_0)]" SBYTE UMR_MBAR__10_1_0_S5_S3 1 100 -1280 1270 ECU_ADDRESS 0xFFF811EA DISPLAY_IDENTIFIER Speicher.KF1.AdaGlsEHS MATRIX_DIM 448 1 1 /end MEASUREMENT
/begin MEASUREMENT AdaGlsEHS.KF2.BewSchaltCtr "EepromStd[1344 ... 1357]: GLS Adaption Bewertungszaehler Einzel-Hoch-Schaltungen Kennfeld 2 [(x=7/UMR___1_1_0)]" UWORD UMR___1_1_0_S5_S3 1 100 0 65535 ECU_ADDRESS 0xFFF81578 DISPLAY_IDENTIFIER BewSchaltCtr.KF2.AdaGlsEHS MATRIX_DIM 7 1 1 /end MEASUREMENT
/begin MEASUREMENT AdaGlsEHS.KF2.Speicher "EepromStd[896 ... 1343]: GLS Adaption Einzel-Hoch-Schaltungen Kennfeld 2 [(x=8/UMR_NM__1_1_0),(y=8/UMR_U_MIN_1_1_0),(z=7/UMR___1_1_0)]" SBYTE UMR_MBAR__10_1_0_S5_S3 1 100 -1280 1270 ECU_ADDRESS 0xFFF813B8 DISPLAY_IDENTIFIER Speicher.KF2.AdaGlsEHS MATRIX_DIM 448 1 1 /end MEASUREMENT
/begin MEASUREMENT AdaGlsERS.KF1.BewSchaltCtr "EepromStd[1810 ... 1823]: GLS Adaption Bewertungszaehler Einzel-Rueck-Schaltungen Kennfeld 1 [(x=7/UMR___1_1_0)]" UWORD UMR___1_1_0_S5_S3 1 100 0 65535 ECU_ADDRESS 0xFFF8174A DISPLAY_IDENTIFIER BewSchaltCtr.KF1.AdaGlsERS MATRIX_DIM 7 1 1 /end MEASUREMENT
/begin MEASUREMENT AdaGlsERS.KF1.Speicher "EepromStd[1362 ... 1809]: GLS Adaption Einzel-Rueck-Schaltungen Kennfeld 1 [(x=8/UMR_NM__1_1_0),(y=8/UMR_U_MIN_1_1_0),(z=7/UMR___1_1_0)]" SBYTE UMR_MBAR__10_1_0_S5_S3 1 100 -1280 1270 ECU_ADDRESS 0xFFF8158A DISPLAY_IDENTIFIER Speicher.KF1.AdaGlsERS MATRIX_DIM 448 1 1 /end MEASUREMENT
/begin MEASUREMENT AdaGlsERS.KF2.BewSchaltCtr "EepromStd[2272 ... 2285]: GLS Adaption Bewertungszaehler Einzel-Rueck-Schaltungen Kennfeld 2 [(x=7/UMR___1_1_0)]" UWORD UMR___1_1_0_S5_S3 1 100 0 65535 ECU_ADDRESS 0xFFF81918 DISPLAY_IDENTIFIER BewSchaltCtr.KF2.AdaGlsERS MATRIX_DIM 7 1 1 /end MEASUREMENT
/begin MEASUREMENT AdaGlsERS.KF2.Speicher "EepromStd[1824 ... 2271]: GLS Adaption Einzel-Rueck-Schaltungen Kennfeld 2 [(x=8/UMR_NM__1_1_0),(y=8/UMR_U_MIN_1_1_0),(z=7/UMR___1_1_0)]" SBYTE UMR_MBAR__10_1_0_S5_S3 1 100 -1280 1270 ECU_ADDRESS 0xFFF81758 DISPLAY_IDENTIFIER Speicher.KF2.AdaGlsERS MATRIX_DIM 448 1 1 /end MEASUREMENT
/begin MEASUREMENT AdaGlsNFRS.KF1.BewSchaltCtr "EepromStd[3206 ... 3215]: GLS Adaption Bewertungszaehler N-Fach-Rueck-Schaltungen Kennfeld 1 [(x=5/UMR___1_1_0)]" UWORD UMR___1_1_0_S5_S3 1 100 0 65535 ECU_ADDRESS 0xFFF81CBE DISPLAY_IDENTIFIER BewSchaltCtr.KF1.AdaGlsNFRS MATRIX_DIM 5 1 1 /end MEASUREMENT
/begin MEASUREMENT AdaGlsNFRS.KF1.Speicher "EepromStd[3086 ... 3205]: GLS Adaption N-Fach-Rueck-Schaltungen Kennfeld 1 [(x=6/UMR_NM__1_1_0),(y=4/UMR_U_MIN_1_1_0),(z=5/UMR___1_1_0)]" SBYTE UMR_MBAR__10_1_0_S5_S3 1 100 -1280 1270 ECU_ADDRESS 0xFFF81C46 DISPLAY_IDENTIFIER Speicher.KF1.AdaGlsNFRS MATRIX_DIM 120 1 1 /end MEASUREMENT
/begin MEASUREMENT AdaGlsNFRS.KF2.BewSchaltCtr "EepromStd[3336 ... 3345]: GLS Adaption Bewertungszaehler N-Fach-Rueck-Schaltungen Kennfeld 2 [(x=5/UMR___1_1_0)]" UWORD UMR___1_1_0_S5_S3 1 100 0 65535 ECU_ADDRESS 0xFFF81D40 DISPLAY_IDENTIFIER BewSchaltCtr.KF2.AdaGlsNFRS MATRIX_DIM 5 1 1 /end MEASUREMENT
/begin MEASUREMENT AdaGlsNFRS.KF2.Speicher "EepromStd[3216 ... 3335]: GLS Adaption N-Fach-Rueck-Schaltungen Kennfeld 2 [(x=6/UMR_NM__1_1_0),(y=4/UMR_U_MIN_1_1_0),(z=5/UMR___1_1_0)]" SBYTE UMR_MBAR__10_1_0_S5_S3 1 100 -1280 1270 ECU_ADDRESS 0xFFF81CC8 DISPLAY_IDENTIFIER Speicher.KF2.AdaGlsNFRS MATRIX_DIM 120 1 1 /end MEASUREMENT
/begin MEASUREMENT AdaIae.Daten.BewCtr "EepromStd[3352 ... 3353]: IAE Anlegepunkt Adaption: Bewertungszaehler [(x=1/UMR___1_1_0)]" UWORD UMR___1_1_0_S5_S3 1 100 0 65535 ECU_ADDRESS 0xFFF81D50 DISPLAY_IDENTIFIER BewCtr.Daten.AdaIae /end MEASUREMENT
/begin MEASUREMENT AdaIae.Daten.Speicher "EepromStd[3350 ... 3351]: IAE Anlegepunkt Adaptions-Speicher [(x=1/UMR___1_1_0)]" SWORD UMR_MBAR__1_1_0_S5_S3 1 100 -32768 32767 ECU_ADDRESS 0xFFF81D4E DISPLAY_IDENTIFIER Speicher.Daten.AdaIae /end MEASUREMENT
/begin MEASUREMENT AdaIae.Iae.AnfahrCtr "EepromStd[3354 ... 3355]: IAE Anlegepunkt Adaption: Anfahrzaehler IAE [(x=1/UMR___1_1_0)]" UWORD UMR___1_1_0_S5_S3 1 100 0 65535 ECU_ADDRESS 0xFFF81D52 DISPLAY_IDENTIFIER AnfahrCtr.Iae.AdaIae /end MEASUREMENT
/begin MEASUREMENT AdaIae.Kup.SchaltCtr "EepromStd[3356 ... 3357]: IAE Anlegepunkt Adaption: Schaltungszaehler der Iae-Kup [(x=1/UMR___1_1_0)]" UWORD UMR___1_1_0_S5_S3 1 100 0 65535 ECU_ADDRESS 0xFFF81D54 DISPLAY_IDENTIFIER SchaltCtr.Kup.AdaIae /end MEASUREMENT
/begin MEASUREMENT AdaIaeuf.Daten.Speicher "EepromStd[3362 ... 3397]: IAE Uebertragungsfaehigkeits Adaptions-Speicher [(x=6/UMR_U_MIN_1_1_0),(y=6/UMR_NM__1_1_0)]" SBYTE UMR_NM_BAR_1_1_0_S5_S3 1 100 -128 127 ECU_ADDRESS 0xFFF81D5A DISPLAY_IDENTIFIER Speicher.Daten.AdaIaeuf MATRIX_DIM 36 1 1 /end MEASUREMENT
/begin MEASUREMENT AdaIaeufRead.Daten.Speicher "BPRam[10 ... 45]: IAE Uebertragungsfaehigkeits Adaptions-Speicher [(x=6/UMR_U_MIN_1_1_0),(y=6/UMR_NM__1_1_0)]" SBYTE UMR_NM_BAR_1_1_0_S5_S3 1 100 -128 127 ECU_ADDRESS 0xFFF83602 DISPLAY_IDENTIFIER Speicher.Daten.AdaIaeufRead MATRIX_DIM 36 1 1 /end MEASUREMENT
/begin MEASUREMENT AdaK0.PF.PruefCtr "EepromStd[3404 ... 3405]: K0-Fuelldruck-Adaption: Pruefzaehler [(x=1/UMR___1_1_0)]" UWORD UMR___1_1_0_S5_S3 1 100 0 65535 ECU_ADDRESS 0xFFF81D84 DISPLAY_IDENTIFIER PruefCtr.PF.AdaK0 /end MEASUREMENT
/begin MEASUREMENT AdaK0.PF.SchaltCtr "EepromStd[3402 ... 3403]: K0-Fuelldruck-Adaption: Schaltungszaehler [(x=1/UMR___1_1_0)]" UWORD UMR___1_1_0_S5_S3 1 100 0 65535 ECU_ADDRESS 0xFFF81D82 DISPLAY_IDENTIFIER SchaltCtr.PF.AdaK0 /end MEASUREMENT
/begin MEASUREMENT AdaK0.PF.Speicher "EepromStd[3406 ... 3407]: K0-Fuelldruck-Adaptionswert [(x=1/UMR___1_1_0)]" SWORD UMR_MBAR__1_1_0_S5_S3 1 100 -32768 32767 ECU_ADDRESS 0xFFF81D86 DISPLAY_IDENTIFIER Speicher.PF.AdaK0 /end MEASUREMENT
/begin MEASUREMENT AdaK0.TSF.PruefCtr "EepromStd[3410 ... 3411]: K0-Schnellfuellzeit-Adaption Pruefzaehler [(x=1/UMR___1_1_0)]" UWORD UMR___1_1_0_S5_S3 1 100 0 65535 ECU_ADDRESS 0xFFF81D8A DISPLAY_IDENTIFIER PruefCtr.TSF.AdaK0 /end MEASUREMENT
/begin MEASUREMENT AdaK0.TSF.SchaltCtr "EepromStd[3408 ... 3409]: K0-Schnellfuellzeit-Adaption Schaltungszaehler [(x=1/UMR___1_1_0)]" UWORD UMR___1_1_0_S5_S3 1 100 0 65535 ECU_ADDRESS 0xFFF81D88 DISPLAY_IDENTIFIER SchaltCtr.TSF.AdaK0 /end MEASUREMENT
/begin MEASUREMENT AdaK0.TSF.Speicher "EepromStd[3412 ... 3413]: K0-Schnellfuellzeit-Adaptionswert [(x=1/UMR___1_1_0)]" SWORD UMR_MSEC__1_1_0_S5_S3 1 100 -32768 32767 ECU_ADDRESS 0xFFF81D8C DISPLAY_IDENTIFIER Speicher.TSF.AdaK0 /end MEASUREMENT
/begin MEASUREMENT AdaK0.Timer.Lock "EepromStd[3414 ... 3415]: Timer um K0-Puls-Ada wegen Urluft zu sperren [(x=1/UMR___1_1_0)]" UWORD UMR_SEC__1_1_0_S5_S3 1 100 0 65535 ECU_ADDRESS 0xFFF81D8E DISPLAY_IDENTIFIER Lock.Timer.AdaK0 /end MEASUREMENT
/begin MEASUREMENT AdaK0.Timer.Maxlock "EepromStd[3416 ... 3417]: Maxzeit-Timer K0-Puls-Ada wegen Urluft sperren [(x=1/UMR___1_1_0)]" UWORD UMR_SEC__1_1_0_S5_S3 1 100 0 65535 ECU_ADDRESS 0xFFF81D90 DISPLAY_IDENTIFIER Maxlock.Timer.AdaK0 /end MEASUREMENT
/begin MEASUREMENT AdaKup.AdaBE.GlsKf1 "EepromStd[330 ... 379]: Beeinflussungsadaption alle Schaltungen Kennfeld 1 [(x=25/UMR___1_1_0)]" SWORD UMR_MBAR__1_1_0_S5_S3 1 100 -32768 32767 ECU_ADDRESS 0xFFF81182 DISPLAY_IDENTIFIER GlsKf1.AdaBE.AdaKup MATRIX_DIM 25 1 1 /end MEASUREMENT
/begin MEASUREMENT AdaKup.AdaBE.GlsKf2 "EepromStd[380 ... 429]: Beeinflussungsadaption alle Schaltungen Kennfeld 2 [(x=25/UMR___1_1_0)]" SWORD UMR_MBAR__1_1_0_S5_S3 1 100 -32768 32767 ECU_ADDRESS 0xFFF811B4 DISPLAY_IDENTIFIER GlsKf2.AdaBE.AdaKup MATRIX_DIM 25 1 1 /end MEASUREMENT
/begin MEASUREMENT AdaKup.PF.PruefCtr "EepromStd[280 ... 289]: Kup-Fuelldruck-Adaption: Pruefzaehler [(x=5/UMR___1_1_0)]" UWORD UMR___1_1_0_S5_S3 1 100 0 65535 ECU_ADDRESS 0xFFF81150 DISPLAY_IDENTIFIER PruefCtr.PF.AdaKup MATRIX_DIM 5 1 1 /end MEASUREMENT
/begin MEASUREMENT AdaKup.PF.SchaltCtr "EepromStd[270 ... 279]: Kup-Fuelldruck-Adaption: Schaltungszaehler [(x=5/UMR___1_1_0)]" UWORD UMR___1_1_0_S5_S3 1 100 0 65535 ECU_ADDRESS 0xFFF81146 DISPLAY_IDENTIFIER SchaltCtr.PF.AdaKup MATRIX_DIM 5 1 1 /end MEASUREMENT
/begin MEASUREMENT AdaKup.PF.Speicher "EepromStd[290 ... 299]: Kup-Fuelldruck-Adaptionswert [(x=5/UMR___1_1_0)]" SWORD UMR_MBAR__1_1_0_S5_S3 1 100 -32768 32767 ECU_ADDRESS 0xFFF8115A DISPLAY_IDENTIFIER Speicher.PF.AdaKup MATRIX_DIM 5 1 1 /end MEASUREMENT
/begin MEASUREMENT AdaKup.TSF.PruefCtr "EepromStd[310 ... 319]: Kup-Schnellfuellzeit-Adaption Pruefzaehler [(x=5/UMR___1_1_0)]" UWORD UMR___1_1_0_S5_S3 1 100 0 65535 ECU_ADDRESS 0xFFF8116E DISPLAY_IDENTIFIER PruefCtr.TSF.AdaKup MATRIX_DIM 5 1 1 /end MEASUREMENT
/begin MEASUREMENT AdaKup.TSF.SchaltCtr "EepromStd[300 ... 309]: Kup-Schnellfuellzeit-Adaption Schaltungszaehler [(x=5/UMR___1_1_0)]" UWORD UMR___1_1_0_S5_S3 1 100 0 65535 ECU_ADDRESS 0xFFF81164 DISPLAY_IDENTIFIER SchaltCtr.TSF.AdaKup MATRIX_DIM 5 1 1 /end MEASUREMENT
/begin MEASUREMENT AdaKup.TSF.Speicher "EepromStd[320 ... 329]: Kup-Schnellfuellzeit-Adaptionswert [(x=5/UMR___1_1_0)]" SWORD UMR_MSEC__1_1_0_S5_S3 1 100 -32768 32767 ECU_ADDRESS 0xFFF81178 DISPLAY_IDENTIFIER Speicher.TSF.AdaKup MATRIX_DIM 5 1 1 /end MEASUREMENT
/begin MEASUREMENT AutoPos.PosAuto "Auto Position P or N" UBYTE SBW_STANDARD_S1_S3 1 100 0 8 ECU_ADDRESS 0xFFF898CC DISPLAY_IDENTIFIER PosAuto.AutoPos /end MEASUREMENT
/begin MEASUREMENT AutoPos.f_CC_AutoPosPByDriverLeaveCar "CCMessage by AutoPosP caused by Driver leave Car Flag for CC-Message: 557" UBYTE SBW_STANDARD_S1_S3 1 100 0 1 BIT_MASK 0x1 ECU_ADDRESS 0xFFF898CF DISPLAY_IDENTIFIER f_CC_AutoPosPByDriverLeaveCar.AutoPos /end MEASUREMENT
/begin MEASUREMENT AutoPos.f_NoAutoPEMFHelp "Indicates that AutoP for EMF help message is ignored" UBYTE SBW_STANDARD_S1_S3 1 100 0 1 BIT_MASK 0x1 ECU_ADDRESS 0xFFF898CE DISPLAY_IDENTIFIER f_NoAutoPEMFHelp.AutoPos /end MEASUREMENT
/begin MEASUREMENT AutoPos.f_SpdBelowOrEqP_Th "indicates that v_Vehspd is below D_v_AutoP_Uth" UBYTE SBW_STANDARD_S1_S3 1 100 0 1 BIT_MASK 0x1 ECU_ADDRESS 0xFFF898D0 DISPLAY_IDENTIFIER f_SpdBelowOrEqP_Th.AutoPos /end MEASUREMENT
/begin MEASUREMENT AutoPos.st_AutoPosEvent "Indicates which auto pos event has changed autoposition" UBYTE SBW_STANDARD_S1_S3 1 100 0 255 ECU_ADDRESS 0xFFF898CD DISPLAY_IDENTIFIER st_AutoPosEvent.AutoPos /end MEASUREMENT
/begin MEASUREMENT BPDaten.SchlafMV.ResetErkennungPosVUeb "BPRam[4 ... 5]: Batterie gepuferte Daten: Reset Erkennung PosV Ueberwachung [(x=1/UMR___1_1_0)]" UWORD UMR___1_1_0_S5_S3 1 100 0 65535 ECU_ADDRESS 0xFFF835FC DISPLAY_IDENTIFIER ResetErkennungPosVUeb.SchlafMV.BPDaten /end MEASUREMENT
/begin MEASUREMENT CCMsg.IDEmpty.cCC_ID._.MsgOnceSent "State of CC-ID Operating Sequence" UBYTE SBW_STANDARD_S1_S3 1 100 0 1 BIT_MASK 0x1 ECU_ADDRESS 0xFFF89CA8 DISPLAY_IDENTIFIER MsgOnceSent._.cCC_ID.IDEmpty.CCMsg /end MEASUREMENT
/begin MEASUREMENT CCMsg.IDEmpty.cCC_ID._.MyIdx "Sequential Index of the CC-ID to access tables" UBYTE SBW_STANDARD_S1_S3 1 100 1 255 ECU_ADDRESS 0xFFF89CA4 DISPLAY_IDENTIFIER MyIdx._.cCC_ID.IDEmpty.CCMsg /end MEASUREMENT
/begin MEASUREMENT CCMsg.IDEmpty.cCC_ID._.f_ID_Locked "Flag: Interlocked by other ID" UBYTE SBW_STANDARD_S1_S3 1 100 0 1 BIT_MASK 0x1 ECU_ADDRESS 0xFFF89CA5 DISPLAY_IDENTIFIER f_ID_Locked._.cCC_ID.IDEmpty.CCMsg /end MEASUREMENT
/begin MEASUREMENT CCMsg.IDEmpty.cCC_ID._.f_ID_Reset "Flag: Premature Reset" UBYTE SBW_STANDARD_S1_S3 1 100 0 1 BIT_MASK 0x1 ECU_ADDRESS 0xFFF89CA6 DISPLAY_IDENTIFIER f_ID_Reset._.cCC_ID.IDEmpty.CCMsg /end MEASUREMENT
/begin MEASUREMENT CCMsg.IDEmpty.cCC_ID._.st_ID "State of CC-ID Operating Sequence" UBYTE SBW_STANDARD_S1_S3 1 100 1 255 ECU_ADDRESS 0xFFF89CA7 DISPLAY_IDENTIFIER st_ID._.cCC_ID.IDEmpty.CCMsg /end MEASUREMENT
/begin MEASUREMENT CCMsg.IDEmpty.cCC_ID._.tmr_ID_CycleTime.f_IsExpired "test_timer" UBYTE SBW_STANDARD_S1_S3 1 100 0 255 ECU_ADDRESS 0xFFF89CB0 DISPLAY_IDENTIFIER f_IsExpired.tmr_ID_CycleTime._.cCC_ID.IDEmpty.CCMsg /end MEASUREMENT
/begin MEASUREMENT CCMsg.IDEmpty.cCC_ID._.tmr_ID_CycleTime.time "test_timer" UWORD SBW_TIMER_10MS_S1_S3 1 100 0 655350 ECU_ADDRESS 0xFFF89CAE DISPLAY_IDENTIFIER time.tmr_ID_CycleTime._.cCC_ID.IDEmpty.CCMsg /end MEASUREMENT
/begin MEASUREMENT CCMsg.IDEmpty.cCC_ID._.tmr_ID_HoldCC.f_IsExpired "test_timer" UBYTE SBW_STANDARD_S1_S3 1 100 0 255 ECU_ADDRESS 0xFFF89CB8 DISPLAY_IDENTIFIER f_IsExpired.tmr_ID_HoldCC._.cCC_ID.IDEmpty.CCMsg /end MEASUREMENT
/begin MEASUREMENT CCMsg.IDEmpty.cCC_ID._.tmr_ID_HoldCC.time "test_timer" UWORD SBW_TIMER_10MS_S1_S3 1 100 0 655350 ECU_ADDRESS 0xFFF89CB6 DISPLAY_IDENTIFIER time.tmr_ID_HoldCC._.cCC_ID.IDEmpty.CCMsg /end MEASUREMENT
/begin MEASUREMENT CCMsg.IDEmpty.cCC_ID._.tmr_ID_MinTime.f_IsExpired "test_timer" UBYTE SBW_STANDARD_S1_S3 1 100 0 255 ECU_ADDRESS 0xFFF89CB4 DISPLAY_IDENTIFIER f_IsExpired.tmr_ID_MinTime._.cCC_ID.IDEmpty.CCMsg /end MEASUREMENT
/begin MEASUREMENT CCMsg.IDEmpty.cCC_ID._.tmr_ID_MinTime.time "test_timer" UWORD SBW_TIMER_10MS_S1_S3 1 100 0 655350 ECU_ADDRESS 0xFFF89CB2 DISPLAY_IDENTIFIER time.tmr_ID_MinTime._.cCC_ID.IDEmpty.CCMsg /end MEASUREMENT
/begin MEASUREMENT CCMsg.IDEmpty.cCC_ID._.tmr_ID_delay.f_IsExpired "test_timer" UBYTE SBW_STANDARD_S1_S3 1 100 0 255 ECU_ADDRESS 0xFFF89CAC DISPLAY_IDENTIFIER f_IsExpired.tmr_ID_delay._.cCC_ID.IDEmpty.CCMsg /end MEASUREMENT
/begin MEASUREMENT CCMsg.IDEmpty.cCC_ID._.tmr_ID_delay.time "test_timer" UWORD SBW_TIMER_10MS_S1_S3 1 100 0 655350 ECU_ADDRESS 0xFFF89CAA DISPLAY_IDENTIFIER time.tmr_ID_delay._.cCC_ID.IDEmpty.CCMsg /end MEASUREMENT
/begin MEASUREMENT CCMsg.ID_DrvLeavesCar.cCC_ID._.MsgOnceSent "State of CC-ID Operating Sequence" UBYTE SBW_STANDARD_S1_S3 1 100 0 1 BIT_MASK 0x1 ECU_ADDRESS 0xFFF89B88 DISPLAY_IDENTIFIER MsgOnceSent._.cCC_ID.ID_DrvLeavesCar.CCMsg /end MEASUREMENT
/begin MEASUREMENT CCMsg.ID_DrvLeavesCar.cCC_ID._.MyIdx "Sequential Index of the CC-ID to access tables" UBYTE SBW_STANDARD_S1_S3 1 100 1 255 ECU_ADDRESS 0xFFF89B84 DISPLAY_IDENTIFIER MyIdx._.cCC_ID.ID_DrvLeavesCar.CCMsg /end MEASUREMENT
/begin MEASUREMENT CCMsg.ID_DrvLeavesCar.cCC_ID._.f_ID_Locked "Flag: Interlocked by other ID" UBYTE SBW_STANDARD_S1_S3 1 100 0 1 BIT_MASK 0x1 ECU_ADDRESS 0xFFF89B85 DISPLAY_IDENTIFIER f_ID_Locked._.cCC_ID.ID_DrvLeavesCar.CCMsg /end MEASUREMENT
/begin MEASUREMENT CCMsg.ID_DrvLeavesCar.cCC_ID._.f_ID_Reset "Flag: Premature Reset" UBYTE SBW_STANDARD_S1_S3 1 100 0 1 BIT_MASK 0x1 ECU_ADDRESS 0xFFF89B86 DISPLAY_IDENTIFIER f_ID_Reset._.cCC_ID.ID_DrvLeavesCar.CCMsg /end MEASUREMENT
/begin MEASUREMENT CCMsg.ID_DrvLeavesCar.cCC_ID._.st_ID "State of CC-ID Operating Sequence" UBYTE SBW_STANDARD_S1_S3 1 100 1 255 ECU_ADDRESS 0xFFF89B87 DISPLAY_IDENTIFIER st_ID._.cCC_ID.ID_DrvLeavesCar.CCMsg /end MEASUREMENT
/begin MEASUREMENT CCMsg.ID_DrvLeavesCar.cCC_ID._.tmr_ID_CycleTime.f_IsExpired "test_timer" UBYTE SBW_STANDARD_S1_S3 1 100 0 255 ECU_ADDRESS 0xFFF89B90 DISPLAY_IDENTIFIER f_IsExpired.tmr_ID_CycleTime._.cCC_ID.ID_DrvLeavesCar.CCMsg /end MEASUREMENT
/begin MEASUREMENT CCMsg.ID_DrvLeavesCar.cCC_ID._.tmr_ID_CycleTime.time "test_timer" UWORD SBW_TIMER_10MS_S1_S3 1 100 0 655350 ECU_ADDRESS 0xFFF89B8E DISPLAY_IDENTIFIER time.tmr_ID_CycleTime._.cCC_ID.ID_DrvLeavesCar.CCMsg /end MEASUREMENT
/begin MEASUREMENT CCMsg.ID_DrvLeavesCar.cCC_ID._.tmr_ID_HoldCC.f_IsExpired "test_timer" UBYTE SBW_STANDARD_S1_S3 1 100 0 255 ECU_ADDRESS 0xFFF89B98 DISPLAY_IDENTIFIER f_IsExpired.tmr_ID_HoldCC._.cCC_ID.ID_DrvLeavesCar.CCMsg /end MEASUREMENT
/begin MEASUREMENT CCMsg.ID_DrvLeavesCar.cCC_ID._.tmr_ID_HoldCC.time "test_timer" UWORD SBW_TIMER_10MS_S1_S3 1 100 0 655350 ECU_ADDRESS 0xFFF89B96 DISPLAY_IDENTIFIER time.tmr_ID_HoldCC._.cCC_ID.ID_DrvLeavesCar.CCMsg /end MEASUREMENT
/begin MEASUREMENT CCMsg.ID_DrvLeavesCar.cCC_ID._.tmr_ID_MinTime.f_IsExpired "test_timer" UBYTE SBW_STANDARD_S1_S3 1 100 0 255 ECU_ADDRESS 0xFFF89B94 DISPLAY_IDENTIFIER f_IsExpired.tmr_ID_MinTime._.cCC_ID.ID_DrvLeavesCar.CCMsg /end MEASUREMENT
/begin MEASUREMENT CCMsg.ID_DrvLeavesCar.cCC_ID._.tmr_ID_MinTime.time "test_timer" UWORD SBW_TIMER_10MS_S1_S3 1 100 0 655350 ECU_ADDRESS 0xFFF89B92 DISPLAY_IDENTIFIER time.tmr_ID_MinTime._.cCC_ID.ID_DrvLeavesCar.CCMsg /end MEASUREMENT
/begin MEASUREMENT CCMsg.ID_DrvLeavesCar.cCC_ID._.tmr_ID_delay.f_IsExpired "test_timer" UBYTE SBW_STANDARD_S1_S3 1 100 0 255 ECU_ADDRESS 0xFFF89B8C DISPLAY_IDENTIFIER f_IsExpired.tmr_ID_delay._.cCC_ID.ID_DrvLeavesCar.CCMsg /end MEASUREMENT
/begin MEASUREMENT CCMsg.ID_DrvLeavesCar.cCC_ID._.tmr_ID_delay.time "test_timer" UWORD SBW_TIMER_10MS_S1_S3 1 100 0 655350 ECU_ADDRESS 0xFFF89B8A DISPLAY_IDENTIFIER time.tmr_ID_delay._.cCC_ID.ID_DrvLeavesCar.CCMsg /end MEASUREMENT
/begin MEASUREMENT CCMsg.ID_DrvLeavesCar.f_ID_DrvLeavesCar "Flag for CC-Msgs" UBYTE SBW_STANDARD_S1_S3 1 100 0 1 BIT_MASK 0x1 ECU_ADDRESS 0xFFF89BA0 DISPLAY_IDENTIFIER f_ID_DrvLeavesCar.ID_DrvLeavesCar.CCMsg /end MEASUREMENT
/begin MEASUREMENT CCMsg.ID_DrvLeavesCar.f_PrematureReset "Indicates that premature Reset may be possible" UBYTE SBW_STANDARD_S1_S3 1 100 0 1 BIT_MASK 0x1 ECU_ADDRESS 0xFFF89BA1 DISPLAY_IDENTIFIER f_PrematureReset.ID_DrvLeavesCar.CCMsg /end MEASUREMENT
/begin MEASUREMENT CCMsg.ID_DrvLeavesCar_BeltLocked.cCC_ID._.MsgOnceSent "State of CC-ID Operating Sequence" UBYTE SBW_STANDARD_S1_S3 1 100 0 1 BIT_MASK 0x1 ECU_ADDRESS 0xFFF89C88 DISPLAY_IDENTIFIER MsgOnceSent._.cCC_ID.ID_DrvLeavesCar_BeltLocked.CCMsg /end MEASUREMENT
/begin MEASUREMENT CCMsg.ID_DrvLeavesCar_BeltLocked.cCC_ID._.MyIdx "Sequential Index of the CC-ID to access tables" UBYTE SBW_STANDARD_S1_S3 1 100 1 255 ECU_ADDRESS 0xFFF89C84 DISPLAY_IDENTIFIER MyIdx._.cCC_ID.ID_DrvLeavesCar_BeltLocked.CCMsg /end MEASUREMENT
/begin MEASUREMENT CCMsg.ID_DrvLeavesCar_BeltLocked.cCC_ID._.f_ID_Locked "Flag: Interlocked by other ID" UBYTE SBW_STANDARD_S1_S3 1 100 0 1 BIT_MASK 0x1 ECU_ADDRESS 0xFFF89C85 DISPLAY_IDENTIFIER f_ID_Locked._.cCC_ID.ID_DrvLeavesCar_BeltLocked.CCMsg /end MEASUREMENT
/begin MEASUREMENT CCMsg.ID_DrvLeavesCar_BeltLocked.cCC_ID._.f_ID_Reset "Flag: Premature Reset" UBYTE SBW_STANDARD_S1_S3 1 100 0 1 BIT_MASK 0x1 ECU_ADDRESS 0xFFF89C86 DISPLAY_IDENTIFIER f_ID_Reset._.cCC_ID.ID_DrvLeavesCar_BeltLocked.CCMsg /end MEASUREMENT
/begin MEASUREMENT CCMsg.ID_DrvLeavesCar_BeltLocked.cCC_ID._.st_ID "State of CC-ID Operating Sequence" UBYTE SBW_STANDARD_S1_S3 1 100 1 255 ECU_ADDRESS 0xFFF89C87 DISPLAY_IDENTIFIER st_ID._.cCC_ID.ID_DrvLeavesCar_BeltLocked.CCMsg /end MEASUREMENT
/begin MEASUREMENT CCMsg.ID_DrvLeavesCar_BeltLocked.cCC_ID._.tmr_ID_CycleTime.f_IsExpired "test_timer" UBYTE SBW_STANDARD_S1_S3 1 100 0 255 ECU_ADDRESS 0xFFF89C90 DISPLAY_IDENTIFIER f_IsExpired.tmr_ID_CycleTime._.cCC_ID.ID_DrvLeavesCar_BeltLocked.CCMsg /end MEASUREMENT
/begin MEASUREMENT CCMsg.ID_DrvLeavesCar_BeltLocked.cCC_ID._.tmr_ID_CycleTime.time "test_timer" UWORD SBW_TIMER_10MS_S1_S3 1 100 0 655350 ECU_ADDRESS 0xFFF89C8E DISPLAY_IDENTIFIER time.tmr_ID_CycleTime._.cCC_ID.ID_DrvLeavesCar_BeltLocked.CCMsg /end MEASUREMENT
/begin MEASUREMENT CCMsg.ID_DrvLeavesCar_BeltLocked.cCC_ID._.tmr_ID_HoldCC.f_IsExpired "test_timer" UBYTE SBW_STANDARD_S1_S3 1 100 0 255 ECU_ADDRESS 0xFFF89C98 DISPLAY_IDENTIFIER f_IsExpired.tmr_ID_HoldCC._.cCC_ID.ID_DrvLeavesCar_BeltLocked.CCMsg /end MEASUREMENT
/begin MEASUREMENT CCMsg.ID_DrvLeavesCar_BeltLocked.cCC_ID._.tmr_ID_HoldCC.time "test_timer" UWORD SBW_TIMER_10MS_S1_S3 1 100 0 655350 ECU_ADDRESS 0xFFF89C96 DISPLAY_IDENTIFIER time.tmr_ID_HoldCC._.cCC_ID.ID_DrvLeavesCar_BeltLocked.CCMsg /end MEASUREMENT
/begin MEASUREMENT CCMsg.ID_DrvLeavesCar_BeltLocked.cCC_ID._.tmr_ID_MinTime.f_IsExpired "test_timer" UBYTE SBW_STANDARD_S1_S3 1 100 0 255 ECU_ADDRESS 0xFFF89C94 DISPLAY_IDENTIFIER f_IsExpired.tmr_ID_MinTime._.cCC_ID.ID_DrvLeavesCar_BeltLocked.CCMsg /end MEASUREMENT
/begin MEASUREMENT CCMsg.ID_DrvLeavesCar_BeltLocked.cCC_ID._.tmr_ID_MinTime.time "test_timer" UWORD SBW_TIMER_10MS_S1_S3 1 100 0 655350 ECU_ADDRESS 0xFFF89C92 DISPLAY_IDENTIFIER time.tmr_ID_MinTime._.cCC_ID.ID_DrvLeavesCar_BeltLocked.CCMsg /end MEASUREMENT
/begin MEASUREMENT CCMsg.ID_DrvLeavesCar_BeltLocked.cCC_ID._.tmr_ID_delay.f_IsExpired "test_timer" UBYTE SBW_STANDARD_S1_S3 1 100 0 255 ECU_ADDRESS 0xFFF89C8C DISPLAY_IDENTIFIER f_IsExpired.tmr_ID_delay._.cCC_ID.ID_DrvLeavesCar_BeltLocked.CCMsg /end MEASUREMENT
/begin MEASUREMENT CCMsg.ID_DrvLeavesCar_BeltLocked.cCC_ID._.tmr_ID_delay.time "test_timer" UWORD SBW_TIMER_10MS_S1_S3 1 100 0 655350 ECU_ADDRESS 0xFFF89C8A DISPLAY_IDENTIFIER time.tmr_ID_delay._.cCC_ID.ID_DrvLeavesCar_BeltLocked.CCMsg /end MEASUREMENT
/begin MEASUREMENT CCMsg.ID_DrvLeavesCar_BeltLocked.f_ID_DrvLeavesCar_BeltLocked "Flag for CC-Msgs" UBYTE SBW_STANDARD_S1_S3 1 100 0 1 BIT_MASK 0x1 ECU_ADDRESS 0xFFF89CA0 DISPLAY_IDENTIFIER f_ID_DrvLeavesCar_BeltLocked.ID_DrvLeavesCar_BeltLocked.CCMsg /end MEASUREMENT
/begin MEASUREMENT CCMsg.ID_GearboxWarning1.cCC_ID._.MsgOnceSent "State of CC-ID Operating Sequence" UBYTE SBW_STANDARD_S1_S3 1 100 0 1 BIT_MASK 0x1 ECU_ADDRESS 0xFFF89C08 DISPLAY_IDENTIFIER MsgOnceSent._.cCC_ID.ID_GearboxWarning1.CCMsg /end MEASUREMENT
/begin MEASUREMENT CCMsg.ID_GearboxWarning1.cCC_ID._.MyIdx "Sequential Index of the CC-ID to access tables" UBYTE SBW_STANDARD_S1_S3 1 100 1 255 ECU_ADDRESS 0xFFF89C04 DISPLAY_IDENTIFIER MyIdx._.cCC_ID.ID_GearboxWarning1.CCMsg /end MEASUREMENT
/begin MEASUREMENT CCMsg.ID_GearboxWarning1.cCC_ID._.f_ID_Locked "Flag: Interlocked by other ID" UBYTE SBW_STANDARD_S1_S3 1 100 0 1 BIT_MASK 0x1 ECU_ADDRESS 0xFFF89C05 DISPLAY_IDENTIFIER f_ID_Locked._.cCC_ID.ID_GearboxWarning1.CCMsg /end MEASUREMENT
/begin MEASUREMENT CCMsg.ID_GearboxWarning1.cCC_ID._.f_ID_Reset "Flag: Premature Reset" UBYTE SBW_STANDARD_S1_S3 1 100 0 1 BIT_MASK 0x1 ECU_ADDRESS 0xFFF89C06 DISPLAY_IDENTIFIER f_ID_Reset._.cCC_ID.ID_GearboxWarning1.CCMsg /end MEASUREMENT
/begin MEASUREMENT CCMsg.ID_GearboxWarning1.cCC_ID._.st_ID "State of CC-ID Operating Sequence" UBYTE SBW_STANDARD_S1_S3 1 100 1 255 ECU_ADDRESS 0xFFF89C07 DISPLAY_IDENTIFIER st_ID._.cCC_ID.ID_GearboxWarning1.CCMsg /end MEASUREMENT
/begin MEASUREMENT CCMsg.ID_GearboxWarning1.cCC_ID._.tmr_ID_CycleTime.f_IsExpired "test_timer" UBYTE SBW_STANDARD_S1_S3 1 100 0 255 ECU_ADDRESS 0xFFF89C10 DISPLAY_IDENTIFIER f_IsExpired.tmr_ID_CycleTime._.cCC_ID.ID_GearboxWarning1.CCMsg /end MEASUREMENT
/begin MEASUREMENT CCMsg.ID_GearboxWarning1.cCC_ID._.tmr_ID_CycleTime.time "test_timer" UWORD SBW_TIMER_10MS_S1_S3 1 100 0 655350 ECU_ADDRESS 0xFFF89C0E DISPLAY_IDENTIFIER time.tmr_ID_CycleTime._.cCC_ID.ID_GearboxWarning1.CCMsg /end MEASUREMENT
/begin MEASUREMENT CCMsg.ID_GearboxWarning1.cCC_ID._.tmr_ID_HoldCC.f_IsExpired "test_timer" UBYTE SBW_STANDARD_S1_S3 1 100 0 255 ECU_ADDRESS 0xFFF89C18 DISPLAY_IDENTIFIER f_IsExpired.tmr_ID_HoldCC._.cCC_ID.ID_GearboxWarning1.CCMsg /end MEASUREMENT
/begin MEASUREMENT CCMsg.ID_GearboxWarning1.cCC_ID._.tmr_ID_HoldCC.time "test_timer" UWORD SBW_TIMER_10MS_S1_S3 1 100 0 655350 ECU_ADDRESS 0xFFF89C16 DISPLAY_IDENTIFIER time.tmr_ID_HoldCC._.cCC_ID.ID_GearboxWarning1.CCMsg /end MEASUREMENT
/begin MEASUREMENT CCMsg.ID_GearboxWarning1.cCC_ID._.tmr_ID_MinTime.f_IsExpired "test_timer" UBYTE SBW_STANDARD_S1_S3 1 100 0 255 ECU_ADDRESS 0xFFF89C14 DISPLAY_IDENTIFIER f_IsExpired.tmr_ID_MinTime._.cCC_ID.ID_GearboxWarning1.CCMsg /end MEASUREMENT
/begin MEASUREMENT CCMsg.ID_GearboxWarning1.cCC_ID._.tmr_ID_MinTime.time "test_timer" UWORD SBW_TIMER_10MS_S1_S3 1 100 0 655350 ECU_ADDRESS 0xFFF89C12 DISPLAY_IDENTIFIER time.tmr_ID_MinTime._.cCC_ID.ID_GearboxWarning1.CCMsg /end MEASUREMENT
/begin MEASUREMENT CCMsg.ID_GearboxWarning1.cCC_ID._.tmr_ID_delay.f_IsExpired "test_timer" UBYTE SBW_STANDARD_S1_S3 1 100 0 255 ECU_ADDRESS 0xFFF89C0C DISPLAY_IDENTIFIER f_IsExpired.tmr_ID_delay._.cCC_ID.ID_GearboxWarning1.CCMsg /end MEASUREMENT
/begin MEASUREMENT CCMsg.ID_GearboxWarning1.cCC_ID._.tmr_ID_delay.time "test_timer" UWORD SBW_TIMER_10MS_S1_S3 1 100 0 655350 ECU_ADDRESS 0xFFF89C0A DISPLAY_IDENTIFIER time.tmr_ID_delay._.cCC_ID.ID_GearboxWarning1.CCMsg /end MEASUREMENT
/begin MEASUREMENT CCMsg.ID_GearboxWarning1.f_ID_GearboxWarning1 "Flag for CC-Msgs" UBYTE SBW_STANDARD_S1_S3 1 100 0 1 BIT_MASK 0x1 ECU_ADDRESS 0xFFF89C20 DISPLAY_IDENTIFIER f_ID_GearboxWarning1.ID_GearboxWarning1.CCMsg /end MEASUREMENT
/begin MEASUREMENT CCMsg.ID_GearboxWarning2.cCC_ID._.MsgOnceSent "State of CC-ID Operating Sequence" UBYTE SBW_STANDARD_S1_S3 1 100 0 1 BIT_MASK 0x1 ECU_ADDRESS 0xFFF89BE8 DISPLAY_IDENTIFIER MsgOnceSent._.cCC_ID.ID_GearboxWarning2.CCMsg /end MEASUREMENT
/begin MEASUREMENT CCMsg.ID_GearboxWarning2.cCC_ID._.MyIdx "Sequential Index of the CC-ID to access tables" UBYTE SBW_STANDARD_S1_S3 1 100 1 255 ECU_ADDRESS 0xFFF89BE4 DISPLAY_IDENTIFIER MyIdx._.cCC_ID.ID_GearboxWarning2.CCMsg /end MEASUREMENT
/begin MEASUREMENT CCMsg.ID_GearboxWarning2.cCC_ID._.f_ID_Locked "Flag: Interlocked by other ID" UBYTE SBW_STANDARD_S1_S3 1 100 0 1 BIT_MASK 0x1 ECU_ADDRESS 0xFFF89BE5 DISPLAY_IDENTIFIER f_ID_Locked._.cCC_ID.ID_GearboxWarning2.CCMsg /end MEASUREMENT
/begin MEASUREMENT CCMsg.ID_GearboxWarning2.cCC_ID._.f_ID_Reset "Flag: Premature Reset" UBYTE SBW_STANDARD_S1_S3 1 100 0 1 BIT_MASK 0x1 ECU_ADDRESS 0xFFF89BE6 DISPLAY_IDENTIFIER f_ID_Reset._.cCC_ID.ID_GearboxWarning2.CCMsg /end MEASUREMENT
/begin MEASUREMENT CCMsg.ID_GearboxWarning2.cCC_ID._.st_ID "State of CC-ID Operating Sequence" UBYTE SBW_STANDARD_S1_S3 1 100 1 255 ECU_ADDRESS 0xFFF89BE7 DISPLAY_IDENTIFIER st_ID._.cCC_ID.ID_GearboxWarning2.CCMsg /end MEASUREMENT
/begin MEASUREMENT CCMsg.ID_GearboxWarning2.cCC_ID._.tmr_ID_CycleTime.f_IsExpired "test_timer" UBYTE SBW_STANDARD_S1_S3 1 100 0 255 ECU_ADDRESS 0xFFF89BF0 DISPLAY_IDENTIFIER f_IsExpired.tmr_ID_CycleTime._.cCC_ID.ID_GearboxWarning2.CCMsg /end MEASUREMENT
/begin MEASUREMENT CCMsg.ID_GearboxWarning2.cCC_ID._.tmr_ID_CycleTime.time "test_timer" UWORD SBW_TIMER_10MS_S1_S3 1 100 0 655350 ECU_ADDRESS 0xFFF89BEE DISPLAY_IDENTIFIER time.tmr_ID_CycleTime._.cCC_ID.ID_GearboxWarning2.CCMsg /end MEASUREMENT
/begin MEASUREMENT CCMsg.ID_GearboxWarning2.cCC_ID._.tmr_ID_HoldCC.f_IsExpired "test_timer" UBYTE SBW_STANDARD_S1_S3 1 100 0 255 ECU_ADDRESS 0xFFF89BF8 DISPLAY_IDENTIFIER f_IsExpired.tmr_ID_HoldCC._.cCC_ID.ID_GearboxWarning2.CCMsg /end MEASUREMENT
/begin MEASUREMENT CCMsg.ID_GearboxWarning2.cCC_ID._.tmr_ID_HoldCC.time "test_timer" UWORD SBW_TIMER_10MS_S1_S3 1 100 0 655350 ECU_ADDRESS 0xFFF89BF6 DISPLAY_IDENTIFIER time.tmr_ID_HoldCC._.cCC_ID.ID_GearboxWarning2.CCMsg /end MEASUREMENT
/begin MEASUREMENT CCMsg.ID_GearboxWarning2.cCC_ID._.tmr_ID_MinTime.f_IsExpired "test_timer" UBYTE SBW_STANDARD_S1_S3 1 100 0 255 ECU_ADDRESS 0xFFF89BF4 DISPLAY_IDENTIFIER f_IsExpired.tmr_ID_MinTime._.cCC_ID.ID_GearboxWarning2.CCMsg /end MEASUREMENT
/begin MEASUREMENT CCMsg.ID_GearboxWarning2.cCC_ID._.tmr_ID_MinTime.time "test_timer" UWORD SBW_TIMER_10MS_S1_S3 1 100 0 655350 ECU_ADDRESS 0xFFF89BF2 DISPLAY_IDENTIFIER time.tmr_ID_MinTime._.cCC_ID.ID_GearboxWarning2.CCMsg /end MEASUREMENT
/begin MEASUREMENT CCMsg.ID_GearboxWarning2.cCC_ID._.tmr_ID_delay.f_IsExpired "test_timer" UBYTE SBW_STANDARD_S1_S3 1 100 0 255 ECU_ADDRESS 0xFFF89BEC DISPLAY_IDENTIFIER f_IsExpired.tmr_ID_delay._.cCC_ID.ID_GearboxWarning2.CCMsg /end MEASUREMENT
/begin MEASUREMENT CCMsg.ID_GearboxWarning2.cCC_ID._.tmr_ID_delay.time "test_timer" UWORD SBW_TIMER_10MS_S1_S3 1 100 0 655350 ECU_ADDRESS 0xFFF89BEA DISPLAY_IDENTIFIER time.tmr_ID_delay._.cCC_ID.ID_GearboxWarning2.CCMsg /end MEASUREMENT
/begin MEASUREMENT CCMsg.ID_GearboxWarning2.f_ID_GearboxWarning2 "Flag for CC-Msgs" UBYTE SBW_STANDARD_S1_S3 1 100 0 1 BIT_MASK 0x1 ECU_ADDRESS 0xFFF89C00 DISPLAY_IDENTIFIER f_ID_GearboxWarning2.ID_GearboxWarning2.CCMsg /end MEASUREMENT
/begin MEASUREMENT CCMsg.ID_GongBadOp.cCC_ID._.MsgOnceSent "State of CC-ID Operating Sequence" UBYTE SBW_STANDARD_S1_S3 1 100 0 1 BIT_MASK 0x1 ECU_ADDRESS 0xFFF89B48 DISPLAY_IDENTIFIER MsgOnceSent._.cCC_ID.ID_GongBadOp.CCMsg /end MEASUREMENT
/begin MEASUREMENT CCMsg.ID_GongBadOp.cCC_ID._.MyIdx "Sequential Index of the CC-ID to access tables" UBYTE SBW_STANDARD_S1_S3 1 100 1 255 ECU_ADDRESS 0xFFF89B44 DISPLAY_IDENTIFIER MyIdx._.cCC_ID.ID_GongBadOp.CCMsg /end MEASUREMENT
/begin MEASUREMENT CCMsg.ID_GongBadOp.cCC_ID._.f_ID_Locked "Flag: Interlocked by other ID" UBYTE SBW_STANDARD_S1_S3 1 100 0 1 BIT_MASK 0x1 ECU_ADDRESS 0xFFF89B45 DISPLAY_IDENTIFIER f_ID_Locked._.cCC_ID.ID_GongBadOp.CCMsg /end MEASUREMENT
/begin MEASUREMENT CCMsg.ID_GongBadOp.cCC_ID._.f_ID_Reset "Flag: Premature Reset" UBYTE SBW_STANDARD_S1_S3 1 100 0 1 BIT_MASK 0x1 ECU_ADDRESS 0xFFF89B46 DISPLAY_IDENTIFIER f_ID_Reset._.cCC_ID.ID_GongBadOp.CCMsg /end MEASUREMENT
/begin MEASUREMENT CCMsg.ID_GongBadOp.cCC_ID._.st_ID "State of CC-ID Operating Sequence" UBYTE SBW_STANDARD_S1_S3 1 100 1 255 ECU_ADDRESS 0xFFF89B47 DISPLAY_IDENTIFIER st_ID._.cCC_ID.ID_GongBadOp.CCMsg /end MEASUREMENT
/begin MEASUREMENT CCMsg.ID_GongBadOp.cCC_ID._.tmr_ID_CycleTime.f_IsExpired "test_timer" UBYTE SBW_STANDARD_S1_S3 1 100 0 255 ECU_ADDRESS 0xFFF89B50 DISPLAY_IDENTIFIER f_IsExpired.tmr_ID_CycleTime._.cCC_ID.ID_GongBadOp.CCMsg /end MEASUREMENT
/begin MEASUREMENT CCMsg.ID_GongBadOp.cCC_ID._.tmr_ID_CycleTime.time "test_timer" UWORD SBW_TIMER_10MS_S1_S3 1 100 0 655350 ECU_ADDRESS 0xFFF89B4E DISPLAY_IDENTIFIER time.tmr_ID_CycleTime._.cCC_ID.ID_GongBadOp.CCMsg /end MEASUREMENT
/begin MEASUREMENT CCMsg.ID_GongBadOp.cCC_ID._.tmr_ID_HoldCC.f_IsExpired "test_timer" UBYTE SBW_STANDARD_S1_S3 1 100 0 255 ECU_ADDRESS 0xFFF89B58 DISPLAY_IDENTIFIER f_IsExpired.tmr_ID_HoldCC._.cCC_ID.ID_GongBadOp.CCMsg /end MEASUREMENT
/begin MEASUREMENT CCMsg.ID_GongBadOp.cCC_ID._.tmr_ID_HoldCC.time "test_timer" UWORD SBW_TIMER_10MS_S1_S3 1 100 0 655350 ECU_ADDRESS 0xFFF89B56 DISPLAY_IDENTIFIER time.tmr_ID_HoldCC._.cCC_ID.ID_GongBadOp.CCMsg /end MEASUREMENT
/begin MEASUREMENT CCMsg.ID_GongBadOp.cCC_ID._.tmr_ID_MinTime.f_IsExpired "test_timer" UBYTE SBW_STANDARD_S1_S3 1 100 0 255 ECU_ADDRESS 0xFFF89B54 DISPLAY_IDENTIFIER f_IsExpired.tmr_ID_MinTime._.cCC_ID.ID_GongBadOp.CCMsg /end MEASUREMENT
/begin MEASUREMENT CCMsg.ID_GongBadOp.cCC_ID._.tmr_ID_MinTime.time "test_timer" UWORD SBW_TIMER_10MS_S1_S3 1 100 0 655350 ECU_ADDRESS 0xFFF89B52 DISPLAY_IDENTIFIER time.tmr_ID_MinTime._.cCC_ID.ID_GongBadOp.CCMsg /end MEASUREMENT
/begin MEASUREMENT CCMsg.ID_GongBadOp.cCC_ID._.tmr_ID_delay.f_IsExpired "test_timer" UBYTE SBW_STANDARD_S1_S3 1 100 0 255 ECU_ADDRESS 0xFFF89B4C DISPLAY_IDENTIFIER f_IsExpired.tmr_ID_delay._.cCC_ID.ID_GongBadOp.CCMsg /end MEASUREMENT
/begin MEASUREMENT CCMsg.ID_GongBadOp.cCC_ID._.tmr_ID_delay.time "test_timer" UWORD SBW_TIMER_10MS_S1_S3 1 100 0 655350 ECU_ADDRESS 0xFFF89B4A DISPLAY_IDENTIFIER time.tmr_ID_delay._.cCC_ID.ID_GongBadOp.CCMsg /end MEASUREMENT
/begin MEASUREMENT CCMsg.ID_GongBadOp.f_ID_GongBadOp "Flag for CC-Msgs" UBYTE SBW_STANDARD_S1_S3 1 100 0 1 BIT_MASK 0x1 ECU_ADDRESS 0xFFF89B60 DISPLAY_IDENTIFIER f_ID_GongBadOp.ID_GongBadOp.CCMsg /end MEASUREMENT
/begin MEASUREMENT CCMsg.ID_GongInMechLimp.cCC_ID._.MsgOnceSent "State of CC-ID Operating Sequence" UBYTE SBW_STANDARD_S1_S3 1 100 0 1 BIT_MASK 0x1 ECU_ADDRESS 0xFFF89B28 DISPLAY_IDENTIFIER MsgOnceSent._.cCC_ID.ID_GongInMechLimp.CCMsg /end MEASUREMENT
/begin MEASUREMENT CCMsg.ID_GongInMechLimp.cCC_ID._.MyIdx "Sequential Index of the CC-ID to access tables" UBYTE SBW_STANDARD_S1_S3 1 100 1 255 ECU_ADDRESS 0xFFF89B24 DISPLAY_IDENTIFIER MyIdx._.cCC_ID.ID_GongInMechLimp.CCMsg /end MEASUREMENT
/begin MEASUREMENT CCMsg.ID_GongInMechLimp.cCC_ID._.f_ID_Locked "Flag: Interlocked by other ID" UBYTE SBW_STANDARD_S1_S3 1 100 0 1 BIT_MASK 0x1 ECU_ADDRESS 0xFFF89B25 DISPLAY_IDENTIFIER f_ID_Locked._.cCC_ID.ID_GongInMechLimp.CCMsg /end MEASUREMENT
/begin MEASUREMENT CCMsg.ID_GongInMechLimp.cCC_ID._.f_ID_Reset "Flag: Premature Reset" UBYTE SBW_STANDARD_S1_S3 1 100 0 1 BIT_MASK 0x1 ECU_ADDRESS 0xFFF89B26 DISPLAY_IDENTIFIER f_ID_Reset._.cCC_ID.ID_GongInMechLimp.CCMsg /end MEASUREMENT
/begin MEASUREMENT CCMsg.ID_GongInMechLimp.cCC_ID._.st_ID "State of CC-ID Operating Sequence" UBYTE SBW_STANDARD_S1_S3 1 100 1 255 ECU_ADDRESS 0xFFF89B27 DISPLAY_IDENTIFIER st_ID._.cCC_ID.ID_GongInMechLimp.CCMsg /end MEASUREMENT
/begin MEASUREMENT CCMsg.ID_GongInMechLimp.cCC_ID._.tmr_ID_CycleTime.f_IsExpired "test_timer" UBYTE SBW_STANDARD_S1_S3 1 100 0 255 ECU_ADDRESS 0xFFF89B30 DISPLAY_IDENTIFIER f_IsExpired.tmr_ID_CycleTime._.cCC_ID.ID_GongInMechLimp.CCMsg /end MEASUREMENT
/begin MEASUREMENT CCMsg.ID_GongInMechLimp.cCC_ID._.tmr_ID_CycleTime.time "test_timer" UWORD SBW_TIMER_10MS_S1_S3 1 100 0 655350 ECU_ADDRESS 0xFFF89B2E DISPLAY_IDENTIFIER time.tmr_ID_CycleTime._.cCC_ID.ID_GongInMechLimp.CCMsg /end MEASUREMENT
/begin MEASUREMENT CCMsg.ID_GongInMechLimp.cCC_ID._.tmr_ID_HoldCC.f_IsExpired "test_timer" UBYTE SBW_STANDARD_S1_S3 1 100 0 255 ECU_ADDRESS 0xFFF89B38 DISPLAY_IDENTIFIER f_IsExpired.tmr_ID_HoldCC._.cCC_ID.ID_GongInMechLimp.CCMsg /end MEASUREMENT
/begin MEASUREMENT CCMsg.ID_GongInMechLimp.cCC_ID._.tmr_ID_HoldCC.time "test_timer" UWORD SBW_TIMER_10MS_S1_S3 1 100 0 655350 ECU_ADDRESS 0xFFF89B36 DISPLAY_IDENTIFIER time.tmr_ID_HoldCC._.cCC_ID.ID_GongInMechLimp.CCMsg /end MEASUREMENT
/begin MEASUREMENT CCMsg.ID_GongInMechLimp.cCC_ID._.tmr_ID_MinTime.f_IsExpired "test_timer" UBYTE SBW_STANDARD_S1_S3 1 100 0 255 ECU_ADDRESS 0xFFF89B34 DISPLAY_IDENTIFIER f_IsExpired.tmr_ID_MinTime._.cCC_ID.ID_GongInMechLimp.CCMsg /end MEASUREMENT
/begin MEASUREMENT CCMsg.ID_GongInMechLimp.cCC_ID._.tmr_ID_MinTime.time "test_timer" UWORD SBW_TIMER_10MS_S1_S3 1 100 0 655350 ECU_ADDRESS 0xFFF89B32 DISPLAY_IDENTIFIER time.tmr_ID_MinTime._.cCC_ID.ID_GongInMechLimp.CCMsg /end MEASUREMENT
/begin MEASUREMENT CCMsg.ID_GongInMechLimp.cCC_ID._.tmr_ID_delay.f_IsExpired "test_timer" UBYTE SBW_STANDARD_S1_S3 1 100 0 255 ECU_ADDRESS 0xFFF89B2C DISPLAY_IDENTIFIER f_IsExpired.tmr_ID_delay._.cCC_ID.ID_GongInMechLimp.CCMsg /end MEASUREMENT
/begin MEASUREMENT CCMsg.ID_GongInMechLimp.cCC_ID._.tmr_ID_delay.time "test_timer" UWORD SBW_TIMER_10MS_S1_S3 1 100 0 655350 ECU_ADDRESS 0xFFF89B2A DISPLAY_IDENTIFIER time.tmr_ID_delay._.cCC_ID.ID_GongInMechLimp.CCMsg /end MEASUREMENT
/begin MEASUREMENT CCMsg.ID_GongInMechLimp.f_ID_GongInMechLimp "Flag for CC-Msgs" UBYTE SBW_STANDARD_S1_S3 1 100 0 1 BIT_MASK 0x1 ECU_ADDRESS 0xFFF89B40 DISPLAY_IDENTIFIER f_ID_GongInMechLimp.ID_GongInMechLimp.CCMsg /end MEASUREMENT
/begin MEASUREMENT CCMsg.ID_GongWrongDrvDir.cCC_ID._.MsgOnceSent "State of CC-ID Operating Sequence" UBYTE SBW_STANDARD_S1_S3 1 100 0 1 BIT_MASK 0x1 ECU_ADDRESS 0xFFF89B08 DISPLAY_IDENTIFIER MsgOnceSent._.cCC_ID.ID_GongWrongDrvDir.CCMsg /end MEASUREMENT
/begin MEASUREMENT CCMsg.ID_GongWrongDrvDir.cCC_ID._.MyIdx "Sequential Index of the CC-ID to access tables" UBYTE SBW_STANDARD_S1_S3 1 100 1 255 ECU_ADDRESS 0xFFF89B04 DISPLAY_IDENTIFIER MyIdx._.cCC_ID.ID_GongWrongDrvDir.CCMsg /end MEASUREMENT
/begin MEASUREMENT CCMsg.ID_GongWrongDrvDir.cCC_ID._.f_ID_Locked "Flag: Interlocked by other ID" UBYTE SBW_STANDARD_S1_S3 1 100 0 1 BIT_MASK 0x1 ECU_ADDRESS 0xFFF89B05 DISPLAY_IDENTIFIER f_ID_Locked._.cCC_ID.ID_GongWrongDrvDir.CCMsg /end MEASUREMENT
/begin MEASUREMENT CCMsg.ID_GongWrongDrvDir.cCC_ID._.f_ID_Reset "Flag: Premature Reset" UBYTE SBW_STANDARD_S1_S3 1 100 0 1 BIT_MASK 0x1 ECU_ADDRESS 0xFFF89B06 DISPLAY_IDENTIFIER f_ID_Reset._.cCC_ID.ID_GongWrongDrvDir.CCMsg /end MEASUREMENT
/begin MEASUREMENT CCMsg.ID_GongWrongDrvDir.cCC_ID._.st_ID "State of CC-ID Operating Sequence" UBYTE SBW_STANDARD_S1_S3 1 100 1 255 ECU_ADDRESS 0xFFF89B07 DISPLAY_IDENTIFIER st_ID._.cCC_ID.ID_GongWrongDrvDir.CCMsg /end MEASUREMENT
/begin MEASUREMENT CCMsg.ID_GongWrongDrvDir.cCC_ID._.tmr_ID_CycleTime.f_IsExpired "test_timer" UBYTE SBW_STANDARD_S1_S3 1 100 0 255 ECU_ADDRESS 0xFFF89B10 DISPLAY_IDENTIFIER f_IsExpired.tmr_ID_CycleTime._.cCC_ID.ID_GongWrongDrvDir.CCMsg /end MEASUREMENT
/begin MEASUREMENT CCMsg.ID_GongWrongDrvDir.cCC_ID._.tmr_ID_CycleTime.time "test_timer" UWORD SBW_TIMER_10MS_S1_S3 1 100 0 655350 ECU_ADDRESS 0xFFF89B0E DISPLAY_IDENTIFIER time.tmr_ID_CycleTime._.cCC_ID.ID_GongWrongDrvDir.CCMsg /end MEASUREMENT
/begin MEASUREMENT CCMsg.ID_GongWrongDrvDir.cCC_ID._.tmr_ID_HoldCC.f_IsExpired "test_timer" UBYTE SBW_STANDARD_S1_S3 1 100 0 255 ECU_ADDRESS 0xFFF89B18 DISPLAY_IDENTIFIER f_IsExpired.tmr_ID_HoldCC._.cCC_ID.ID_GongWrongDrvDir.CCMsg /end MEASUREMENT
/begin MEASUREMENT CCMsg.ID_GongWrongDrvDir.cCC_ID._.tmr_ID_HoldCC.time "test_timer" UWORD SBW_TIMER_10MS_S1_S3 1 100 0 655350 ECU_ADDRESS 0xFFF89B16 DISPLAY_IDENTIFIER time.tmr_ID_HoldCC._.cCC_ID.ID_GongWrongDrvDir.CCMsg /end MEASUREMENT
/begin MEASUREMENT CCMsg.ID_GongWrongDrvDir.cCC_ID._.tmr_ID_MinTime.f_IsExpired "test_timer" UBYTE SBW_STANDARD_S1_S3 1 100 0 255 ECU_ADDRESS 0xFFF89B14 DISPLAY_IDENTIFIER f_IsExpired.tmr_ID_MinTime._.cCC_ID.ID_GongWrongDrvDir.CCMsg /end MEASUREMENT
/begin MEASUREMENT CCMsg.ID_GongWrongDrvDir.cCC_ID._.tmr_ID_MinTime.time "test_timer" UWORD SBW_TIMER_10MS_S1_S3 1 100 0 655350 ECU_ADDRESS 0xFFF89B12 DISPLAY_IDENTIFIER time.tmr_ID_MinTime._.cCC_ID.ID_GongWrongDrvDir.CCMsg /end MEASUREMENT
/begin MEASUREMENT CCMsg.ID_GongWrongDrvDir.cCC_ID._.tmr_ID_delay.f_IsExpired "test_timer" UBYTE SBW_STANDARD_S1_S3 1 100 0 255 ECU_ADDRESS 0xFFF89B0C DISPLAY_IDENTIFIER f_IsExpired.tmr_ID_delay._.cCC_ID.ID_GongWrongDrvDir.CCMsg /end MEASUREMENT
/begin MEASUREMENT CCMsg.ID_GongWrongDrvDir.cCC_ID._.tmr_ID_delay.time "test_timer" UWORD SBW_TIMER_10MS_S1_S3 1 100 0 655350 ECU_ADDRESS 0xFFF89B0A DISPLAY_IDENTIFIER time.tmr_ID_delay._.cCC_ID.ID_GongWrongDrvDir.CCMsg /end MEASUREMENT
/begin MEASUREMENT CCMsg.ID_GongWrongDrvDir.f_ID_GongWrongDrvDir "Flag for CC-Msgs" UBYTE SBW_STANDARD_S1_S3 1 100 0 1 BIT_MASK 0x1 ECU_ADDRESS 0xFFF89B20 DISPLAY_IDENTIFIER f_ID_GongWrongDrvDir.ID_GongWrongDrvDir.CCMsg /end MEASUREMENT
/begin MEASUREMENT CCMsg.ID_Hotmode1.cCC_ID._.MsgOnceSent "State of CC-ID Operating Sequence" UBYTE SBW_STANDARD_S1_S3 1 100 0 1 BIT_MASK 0x1 ECU_ADDRESS 0xFFF89988 DISPLAY_IDENTIFIER MsgOnceSent._.cCC_ID.ID_Hotmode1.CCMsg /end MEASUREMENT
/begin MEASUREMENT CCMsg.ID_Hotmode1.cCC_ID._.MyIdx "Sequential Index of the CC-ID to access tables" UBYTE SBW_STANDARD_S1_S3 1 100 1 255 ECU_ADDRESS 0xFFF89984 DISPLAY_IDENTIFIER MyIdx._.cCC_ID.ID_Hotmode1.CCMsg /end MEASUREMENT
/begin MEASUREMENT CCMsg.ID_Hotmode1.cCC_ID._.f_ID_Locked "Flag: Interlocked by other ID" UBYTE SBW_STANDARD_S1_S3 1 100 0 1 BIT_MASK 0x1 ECU_ADDRESS 0xFFF89985 DISPLAY_IDENTIFIER f_ID_Locked._.cCC_ID.ID_Hotmode1.CCMsg /end MEASUREMENT
/begin MEASUREMENT CCMsg.ID_Hotmode1.cCC_ID._.f_ID_Reset "Flag: Premature Reset" UBYTE SBW_STANDARD_S1_S3 1 100 0 1 BIT_MASK 0x1 ECU_ADDRESS 0xFFF89986 DISPLAY_IDENTIFIER f_ID_Reset._.cCC_ID.ID_Hotmode1.CCMsg /end MEASUREMENT
/begin MEASUREMENT CCMsg.ID_Hotmode1.cCC_ID._.st_ID "State of CC-ID Operating Sequence" UBYTE SBW_STANDARD_S1_S3 1 100 1 255 ECU_ADDRESS 0xFFF89987 DISPLAY_IDENTIFIER st_ID._.cCC_ID.ID_Hotmode1.CCMsg /end MEASUREMENT
/begin MEASUREMENT CCMsg.ID_Hotmode1.cCC_ID._.tmr_ID_CycleTime.f_IsExpired "test_timer" UBYTE SBW_STANDARD_S1_S3 1 100 0 255 ECU_ADDRESS 0xFFF89990 DISPLAY_IDENTIFIER f_IsExpired.tmr_ID_CycleTime._.cCC_ID.ID_Hotmode1.CCMsg /end MEASUREMENT
/begin MEASUREMENT CCMsg.ID_Hotmode1.cCC_ID._.tmr_ID_CycleTime.time "test_timer" UWORD SBW_TIMER_10MS_S1_S3 1 100 0 655350 ECU_ADDRESS 0xFFF8998E DISPLAY_IDENTIFIER time.tmr_ID_CycleTime._.cCC_ID.ID_Hotmode1.CCMsg /end MEASUREMENT
/begin MEASUREMENT CCMsg.ID_Hotmode1.cCC_ID._.tmr_ID_HoldCC.f_IsExpired "test_timer" UBYTE SBW_STANDARD_S1_S3 1 100 0 255 ECU_ADDRESS 0xFFF89998 DISPLAY_IDENTIFIER f_IsExpired.tmr_ID_HoldCC._.cCC_ID.ID_Hotmode1.CCMsg /end MEASUREMENT
/begin MEASUREMENT CCMsg.ID_Hotmode1.cCC_ID._.tmr_ID_HoldCC.time "test_timer" UWORD SBW_TIMER_10MS_S1_S3 1 100 0 655350 ECU_ADDRESS 0xFFF89996 DISPLAY_IDENTIFIER time.tmr_ID_HoldCC._.cCC_ID.ID_Hotmode1.CCMsg /end MEASUREMENT
/begin MEASUREMENT CCMsg.ID_Hotmode1.cCC_ID._.tmr_ID_MinTime.f_IsExpired "test_timer" UBYTE SBW_STANDARD_S1_S3 1 100 0 255 ECU_ADDRESS 0xFFF89994 DISPLAY_IDENTIFIER f_IsExpired.tmr_ID_MinTime._.cCC_ID.ID_Hotmode1.CCMsg /end MEASUREMENT
/begin MEASUREMENT CCMsg.ID_Hotmode1.cCC_ID._.tmr_ID_MinTime.time "test_timer" UWORD SBW_TIMER_10MS_S1_S3 1 100 0 655350 ECU_ADDRESS 0xFFF89992 DISPLAY_IDENTIFIER time.tmr_ID_MinTime._.cCC_ID.ID_Hotmode1.CCMsg /end MEASUREMENT
/begin MEASUREMENT CCMsg.ID_Hotmode1.cCC_ID._.tmr_ID_delay.f_IsExpired "test_timer" UBYTE SBW_STANDARD_S1_S3 1 100 0 255 ECU_ADDRESS 0xFFF8998C DISPLAY_IDENTIFIER f_IsExpired.tmr_ID_delay._.cCC_ID.ID_Hotmode1.CCMsg /end MEASUREMENT
/begin MEASUREMENT CCMsg.ID_Hotmode1.cCC_ID._.tmr_ID_delay.time "test_timer" UWORD SBW_TIMER_10MS_S1_S3 1 100 0 655350 ECU_ADDRESS 0xFFF8998A DISPLAY_IDENTIFIER time.tmr_ID_delay._.cCC_ID.ID_Hotmode1.CCMsg /end MEASUREMENT
/begin MEASUREMENT CCMsg.ID_Hotmode1.f_ID_Hotmode1 "Flag for CC-Msgs" UBYTE SBW_STANDARD_S1_S3 1 100 0 1 BIT_MASK 0x1 ECU_ADDRESS 0xFFF899A0 DISPLAY_IDENTIFIER f_ID_Hotmode1.ID_Hotmode1.CCMsg /end MEASUREMENT
/begin MEASUREMENT CCMsg.ID_Hotmode2.cCC_ID._.MsgOnceSent "State of CC-ID Operating Sequence" UBYTE SBW_STANDARD_S1_S3 1 100 0 1 BIT_MASK 0x1 ECU_ADDRESS 0xFFF89B68 DISPLAY_IDENTIFIER MsgOnceSent._.cCC_ID.ID_Hotmode2.CCMsg /end MEASUREMENT
/begin MEASUREMENT CCMsg.ID_Hotmode2.cCC_ID._.MyIdx "Sequential Index of the CC-ID to access tables" UBYTE SBW_STANDARD_S1_S3 1 100 1 255 ECU_ADDRESS 0xFFF89B64 DISPLAY_IDENTIFIER MyIdx._.cCC_ID.ID_Hotmode2.CCMsg /end MEASUREMENT
/begin MEASUREMENT CCMsg.ID_Hotmode2.cCC_ID._.f_ID_Locked "Flag: Interlocked by other ID" UBYTE SBW_STANDARD_S1_S3 1 100 0 1 BIT_MASK 0x1 ECU_ADDRESS 0xFFF89B65 DISPLAY_IDENTIFIER f_ID_Locked._.cCC_ID.ID_Hotmode2.CCMsg /end MEASUREMENT
/begin MEASUREMENT CCMsg.ID_Hotmode2.cCC_ID._.f_ID_Reset "Flag: Premature Reset" UBYTE SBW_STANDARD_S1_S3 1 100 0 1 BIT_MASK 0x1 ECU_ADDRESS 0xFFF89B66 DISPLAY_IDENTIFIER f_ID_Reset._.cCC_ID.ID_Hotmode2.CCMsg /end MEASUREMENT
/begin MEASUREMENT CCMsg.ID_Hotmode2.cCC_ID._.st_ID "State of CC-ID Operating Sequence" UBYTE SBW_STANDARD_S1_S3 1 100 1 255 ECU_ADDRESS 0xFFF89B67 DISPLAY_IDENTIFIER st_ID._.cCC_ID.ID_Hotmode2.CCMsg /end MEASUREMENT
/begin MEASUREMENT CCMsg.ID_Hotmode2.cCC_ID._.tmr_ID_CycleTime.f_IsExpired "test_timer" UBYTE SBW_STANDARD_S1_S3 1 100 0 255 ECU_ADDRESS 0xFFF89B70 DISPLAY_IDENTIFIER f_IsExpired.tmr_ID_CycleTime._.cCC_ID.ID_Hotmode2.CCMsg /end MEASUREMENT
/begin MEASUREMENT CCMsg.ID_Hotmode2.cCC_ID._.tmr_ID_CycleTime.time "test_timer" UWORD SBW_TIMER_10MS_S1_S3 1 100 0 655350 ECU_ADDRESS 0xFFF89B6E DISPLAY_IDENTIFIER time.tmr_ID_CycleTime._.cCC_ID.ID_Hotmode2.CCMsg /end MEASUREMENT
/begin MEASUREMENT CCMsg.ID_Hotmode2.cCC_ID._.tmr_ID_HoldCC.f_IsExpired "test_timer" UBYTE SBW_STANDARD_S1_S3 1 100 0 255 ECU_ADDRESS 0xFFF89B78 DISPLAY_IDENTIFIER f_IsExpired.tmr_ID_HoldCC._.cCC_ID.ID_Hotmode2.CCMsg /end MEASUREMENT
/begin MEASUREMENT CCMsg.ID_Hotmode2.cCC_ID._.tmr_ID_HoldCC.time "test_timer" UWORD SBW_TIMER_10MS_S1_S3 1 100 0 655350 ECU_ADDRESS 0xFFF89B76 DISPLAY_IDENTIFIER time.tmr_ID_HoldCC._.cCC_ID.ID_Hotmode2.CCMsg /end MEASUREMENT
/begin MEASUREMENT CCMsg.ID_Hotmode2.cCC_ID._.tmr_ID_MinTime.f_IsExpired "test_timer" UBYTE SBW_STANDARD_S1_S3 1 100 0 255 ECU_ADDRESS 0xFFF89B74 DISPLAY_IDENTIFIER f_IsExpired.tmr_ID_MinTime._.cCC_ID.ID_Hotmode2.CCMsg /end MEASUREMENT
/begin MEASUREMENT CCMsg.ID_Hotmode2.cCC_ID._.tmr_ID_MinTime.time "test_timer" UWORD SBW_TIMER_10MS_S1_S3 1 100 0 655350 ECU_ADDRESS 0xFFF89B72 DISPLAY_IDENTIFIER time.tmr_ID_MinTime._.cCC_ID.ID_Hotmode2.CCMsg /end MEASUREMENT
/begin MEASUREMENT CCMsg.ID_Hotmode2.cCC_ID._.tmr_ID_delay.f_IsExpired "test_timer" UBYTE SBW_STANDARD_S1_S3 1 100 0 255 ECU_ADDRESS 0xFFF89B6C DISPLAY_IDENTIFIER f_IsExpired.tmr_ID_delay._.cCC_ID.ID_Hotmode2.CCMsg /end MEASUREMENT
/begin MEASUREMENT CCMsg.ID_Hotmode2.cCC_ID._.tmr_ID_delay.time "test_timer" UWORD SBW_TIMER_10MS_S1_S3 1 100 0 655350 ECU_ADDRESS 0xFFF89B6A DISPLAY_IDENTIFIER time.tmr_ID_delay._.cCC_ID.ID_Hotmode2.CCMsg /end MEASUREMENT
/begin MEASUREMENT CCMsg.ID_Hotmode2.f_ID_Hotmode2 "Flag for CC-Msgs" UBYTE SBW_STANDARD_S1_S3 1 100 0 1 BIT_MASK 0x1 ECU_ADDRESS 0xFFF89B80 DISPLAY_IDENTIFIER f_ID_Hotmode2.ID_Hotmode2.CCMsg /end MEASUREMENT
/begin MEASUREMENT CCMsg.ID_Hotmode3.cCC_ID._.MsgOnceSent "State of CC-ID Operating Sequence" UBYTE SBW_STANDARD_S1_S3 1 100 0 1 BIT_MASK 0x1 ECU_ADDRESS 0xFFF899A8 DISPLAY_IDENTIFIER MsgOnceSent._.cCC_ID.ID_Hotmode3.CCMsg /end MEASUREMENT
/begin MEASUREMENT CCMsg.ID_Hotmode3.cCC_ID._.MyIdx "Sequential Index of the CC-ID to access tables" UBYTE SBW_STANDARD_S1_S3 1 100 1 255 ECU_ADDRESS 0xFFF899A4 DISPLAY_IDENTIFIER MyIdx._.cCC_ID.ID_Hotmode3.CCMsg /end MEASUREMENT
/begin MEASUREMENT CCMsg.ID_Hotmode3.cCC_ID._.f_ID_Locked "Flag: Interlocked by other ID" UBYTE SBW_STANDARD_S1_S3 1 100 0 1 BIT_MASK 0x1 ECU_ADDRESS 0xFFF899A5 DISPLAY_IDENTIFIER f_ID_Locked._.cCC_ID.ID_Hotmode3.CCMsg /end MEASUREMENT
/begin MEASUREMENT CCMsg.ID_Hotmode3.cCC_ID._.f_ID_Reset "Flag: Premature Reset" UBYTE SBW_STANDARD_S1_S3 1 100 0 1 BIT_MASK 0x1 ECU_ADDRESS 0xFFF899A6 DISPLAY_IDENTIFIER f_ID_Reset._.cCC_ID.ID_Hotmode3.CCMsg /end MEASUREMENT
/begin MEASUREMENT CCMsg.ID_Hotmode3.cCC_ID._.st_ID "State of CC-ID Operating Sequence" UBYTE SBW_STANDARD_S1_S3 1 100 1 255 ECU_ADDRESS 0xFFF899A7 DISPLAY_IDENTIFIER st_ID._.cCC_ID.ID_Hotmode3.CCMsg /end MEASUREMENT
/begin MEASUREMENT CCMsg.ID_Hotmode3.cCC_ID._.tmr_ID_CycleTime.f_IsExpired "test_timer" UBYTE SBW_STANDARD_S1_S3 1 100 0 255 ECU_ADDRESS 0xFFF899B0 DISPLAY_IDENTIFIER f_IsExpired.tmr_ID_CycleTime._.cCC_ID.ID_Hotmode3.CCMsg /end MEASUREMENT
/begin MEASUREMENT CCMsg.ID_Hotmode3.cCC_ID._.tmr_ID_CycleTime.time "test_timer" UWORD SBW_TIMER_10MS_S1_S3 1 100 0 655350 ECU_ADDRESS 0xFFF899AE DISPLAY_IDENTIFIER time.tmr_ID_CycleTime._.cCC_ID.ID_Hotmode3.CCMsg /end MEASUREMENT
/begin MEASUREMENT CCMsg.ID_Hotmode3.cCC_ID._.tmr_ID_HoldCC.f_IsExpired "test_timer" UBYTE SBW_STANDARD_S1_S3 1 100 0 255 ECU_ADDRESS 0xFFF899B8 DISPLAY_IDENTIFIER f_IsExpired.tmr_ID_HoldCC._.cCC_ID.ID_Hotmode3.CCMsg /end MEASUREMENT
/begin MEASUREMENT CCMsg.ID_Hotmode3.cCC_ID._.tmr_ID_HoldCC.time "test_timer" UWORD SBW_TIMER_10MS_S1_S3 1 100 0 655350 ECU_ADDRESS 0xFFF899B6 DISPLAY_IDENTIFIER time.tmr_ID_HoldCC._.cCC_ID.ID_Hotmode3.CCMsg /end MEASUREMENT
/begin MEASUREMENT CCMsg.ID_Hotmode3.cCC_ID._.tmr_ID_MinTime.f_IsExpired "test_timer" UBYTE SBW_STANDARD_S1_S3 1 100 0 255 ECU_ADDRESS 0xFFF899B4 DISPLAY_IDENTIFIER f_IsExpired.tmr_ID_MinTime._.cCC_ID.ID_Hotmode3.CCMsg /end MEASUREMENT
/begin MEASUREMENT CCMsg.ID_Hotmode3.cCC_ID._.tmr_ID_MinTime.time "test_timer" UWORD SBW_TIMER_10MS_S1_S3 1 100 0 655350 ECU_ADDRESS 0xFFF899B2 DISPLAY_IDENTIFIER time.tmr_ID_MinTime._.cCC_ID.ID_Hotmode3.CCMsg /end MEASUREMENT
/begin MEASUREMENT CCMsg.ID_Hotmode3.cCC_ID._.tmr_ID_delay.f_IsExpired "test_timer" UBYTE SBW_STANDARD_S1_S3 1 100 0 255 ECU_ADDRESS 0xFFF899AC DISPLAY_IDENTIFIER f_IsExpired.tmr_ID_delay._.cCC_ID.ID_Hotmode3.CCMsg /end MEASUREMENT
/begin MEASUREMENT CCMsg.ID_Hotmode3.cCC_ID._.tmr_ID_delay.time "test_timer" UWORD SBW_TIMER_10MS_S1_S3 1 100 0 655350 ECU_ADDRESS 0xFFF899AA DISPLAY_IDENTIFIER time.tmr_ID_delay._.cCC_ID.ID_Hotmode3.CCMsg /end MEASUREMENT
/begin MEASUREMENT CCMsg.ID_Hotmode3.f_ID_Hotmode3 "Flag for CC-Msgs" UBYTE SBW_STANDARD_S1_S3 1 100 0 1 BIT_MASK 0x1 ECU_ADDRESS 0xFFF899C0 DISPLAY_IDENTIFIER f_ID_Hotmode3.ID_Hotmode3.CCMsg /end MEASUREMENT
/begin MEASUREMENT CCMsg.ID_IgnitionError.cCC_ID._.MsgOnceSent "State of CC-ID Operating Sequence" UBYTE SBW_STANDARD_S1_S3 1 100 0 1 BIT_MASK 0x1 ECU_ADDRESS 0xFFF89C68 DISPLAY_IDENTIFIER MsgOnceSent._.cCC_ID.ID_IgnitionError.CCMsg /end MEASUREMENT
/begin MEASUREMENT CCMsg.ID_IgnitionError.cCC_ID._.MyIdx "Sequential Index of the CC-ID to access tables" UBYTE SBW_STANDARD_S1_S3 1 100 1 255 ECU_ADDRESS 0xFFF89C64 DISPLAY_IDENTIFIER MyIdx._.cCC_ID.ID_IgnitionError.CCMsg /end MEASUREMENT
/begin MEASUREMENT CCMsg.ID_IgnitionError.cCC_ID._.f_ID_Locked "Flag: Interlocked by other ID" UBYTE SBW_STANDARD_S1_S3 1 100 0 1 BIT_MASK 0x1 ECU_ADDRESS 0xFFF89C65 DISPLAY_IDENTIFIER f_ID_Locked._.cCC_ID.ID_IgnitionError.CCMsg /end MEASUREMENT
/begin MEASUREMENT CCMsg.ID_IgnitionError.cCC_ID._.f_ID_Reset "Flag: Premature Reset" UBYTE SBW_STANDARD_S1_S3 1 100 0 1 BIT_MASK 0x1 ECU_ADDRESS 0xFFF89C66 DISPLAY_IDENTIFIER f_ID_Reset._.cCC_ID.ID_IgnitionError.CCMsg /end MEASUREMENT
/begin MEASUREMENT CCMsg.ID_IgnitionError.cCC_ID._.st_ID "State of CC-ID Operating Sequence" UBYTE SBW_STANDARD_S1_S3 1 100 1 255 ECU_ADDRESS 0xFFF89C67 DISPLAY_IDENTIFIER st_ID._.cCC_ID.ID_IgnitionError.CCMsg /end MEASUREMENT
/begin MEASUREMENT CCMsg.ID_IgnitionError.cCC_ID._.tmr_ID_CycleTime.f_IsExpired "test_timer" UBYTE SBW_STANDARD_S1_S3 1 100 0 255 ECU_ADDRESS 0xFFF89C70 DISPLAY_IDENTIFIER f_IsExpired.tmr_ID_CycleTime._.cCC_ID.ID_IgnitionError.CCMsg /end MEASUREMENT
/begin MEASUREMENT CCMsg.ID_IgnitionError.cCC_ID._.tmr_ID_CycleTime.time "test_timer" UWORD SBW_TIMER_10MS_S1_S3 1 100 0 655350 ECU_ADDRESS 0xFFF89C6E DISPLAY_IDENTIFIER time.tmr_ID_CycleTime._.cCC_ID.ID_IgnitionError.CCMsg /end MEASUREMENT
/begin MEASUREMENT CCMsg.ID_IgnitionError.cCC_ID._.tmr_ID_HoldCC.f_IsExpired "test_timer" UBYTE SBW_STANDARD_S1_S3 1 100 0 255 ECU_ADDRESS 0xFFF89C78 DISPLAY_IDENTIFIER f_IsExpired.tmr_ID_HoldCC._.cCC_ID.ID_IgnitionError.CCMsg /end MEASUREMENT
/begin MEASUREMENT CCMsg.ID_IgnitionError.cCC_ID._.tmr_ID_HoldCC.time "test_timer" UWORD SBW_TIMER_10MS_S1_S3 1 100 0 655350 ECU_ADDRESS 0xFFF89C76 DISPLAY_IDENTIFIER time.tmr_ID_HoldCC._.cCC_ID.ID_IgnitionError.CCMsg /end MEASUREMENT
/begin MEASUREMENT CCMsg.ID_IgnitionError.cCC_ID._.tmr_ID_MinTime.f_IsExpired "test_timer" UBYTE SBW_STANDARD_S1_S3 1 100 0 255 ECU_ADDRESS 0xFFF89C74 DISPLAY_IDENTIFIER f_IsExpired.tmr_ID_MinTime._.cCC_ID.ID_IgnitionError.CCMsg /end MEASUREMENT
/begin MEASUREMENT CCMsg.ID_IgnitionError.cCC_ID._.tmr_ID_MinTime.time "test_timer" UWORD SBW_TIMER_10MS_S1_S3 1 100 0 655350 ECU_ADDRESS 0xFFF89C72 DISPLAY_IDENTIFIER time.tmr_ID_MinTime._.cCC_ID.ID_IgnitionError.CCMsg /end MEASUREMENT
/begin MEASUREMENT CCMsg.ID_IgnitionError.cCC_ID._.tmr_ID_delay.f_IsExpired "test_timer" UBYTE SBW_STANDARD_S1_S3 1 100 0 255 ECU_ADDRESS 0xFFF89C6C DISPLAY_IDENTIFIER f_IsExpired.tmr_ID_delay._.cCC_ID.ID_IgnitionError.CCMsg /end MEASUREMENT
/begin MEASUREMENT CCMsg.ID_IgnitionError.cCC_ID._.tmr_ID_delay.time "test_timer" UWORD SBW_TIMER_10MS_S1_S3 1 100 0 655350 ECU_ADDRESS 0xFFF89C6A DISPLAY_IDENTIFIER time.tmr_ID_delay._.cCC_ID.ID_IgnitionError.CCMsg /end MEASUREMENT
/begin MEASUREMENT CCMsg.ID_IgnitionError.f_ID_IgnitionError "Flag for CC-Msgs" UBYTE SBW_STANDARD_S1_S3 1 100 0 1 BIT_MASK 0x1 ECU_ADDRESS 0xFFF89C80 DISPLAY_IDENTIFIER f_ID_IgnitionError.ID_IgnitionError.CCMsg /end MEASUREMENT
/begin MEASUREMENT CCMsg.ID_MechLimpInD.cCC_ID._.MsgOnceSent "State of CC-ID Operating Sequence" UBYTE SBW_STANDARD_S1_S3 1 100 0 1 BIT_MASK 0x1 ECU_ADDRESS 0xFFF899E8 DISPLAY_IDENTIFIER MsgOnceSent._.cCC_ID.ID_MechLimpInD.CCMsg /end MEASUREMENT
/begin MEASUREMENT CCMsg.ID_MechLimpInD.cCC_ID._.MyIdx "Sequential Index of the CC-ID to access tables" UBYTE SBW_STANDARD_S1_S3 1 100 1 255 ECU_ADDRESS 0xFFF899E4 DISPLAY_IDENTIFIER MyIdx._.cCC_ID.ID_MechLimpInD.CCMsg /end MEASUREMENT
/begin MEASUREMENT CCMsg.ID_MechLimpInD.cCC_ID._.f_ID_Locked "Flag: Interlocked by other ID" UBYTE SBW_STANDARD_S1_S3 1 100 0 1 BIT_MASK 0x1 ECU_ADDRESS 0xFFF899E5 DISPLAY_IDENTIFIER f_ID_Locked._.cCC_ID.ID_MechLimpInD.CCMsg /end MEASUREMENT
/begin MEASUREMENT CCMsg.ID_MechLimpInD.cCC_ID._.f_ID_Reset "Flag: Premature Reset" UBYTE SBW_STANDARD_S1_S3 1 100 0 1 BIT_MASK 0x1 ECU_ADDRESS 0xFFF899E6 DISPLAY_IDENTIFIER f_ID_Reset._.cCC_ID.ID_MechLimpInD.CCMsg /end MEASUREMENT
/begin MEASUREMENT CCMsg.ID_MechLimpInD.cCC_ID._.st_ID "State of CC-ID Operating Sequence" UBYTE SBW_STANDARD_S1_S3 1 100 1 255 ECU_ADDRESS 0xFFF899E7 DISPLAY_IDENTIFIER st_ID._.cCC_ID.ID_MechLimpInD.CCMsg /end MEASUREMENT
/begin MEASUREMENT CCMsg.ID_MechLimpInD.cCC_ID._.tmr_ID_CycleTime.f_IsExpired "test_timer" UBYTE SBW_STANDARD_S1_S3 1 100 0 255 ECU_ADDRESS 0xFFF899F0 DISPLAY_IDENTIFIER f_IsExpired.tmr_ID_CycleTime._.cCC_ID.ID_MechLimpInD.CCMsg /end MEASUREMENT
/begin MEASUREMENT CCMsg.ID_MechLimpInD.cCC_ID._.tmr_ID_CycleTime.time "test_timer" UWORD SBW_TIMER_10MS_S1_S3 1 100 0 655350 ECU_ADDRESS 0xFFF899EE DISPLAY_IDENTIFIER time.tmr_ID_CycleTime._.cCC_ID.ID_MechLimpInD.CCMsg /end MEASUREMENT
/begin MEASUREMENT CCMsg.ID_MechLimpInD.cCC_ID._.tmr_ID_HoldCC.f_IsExpired "test_timer" UBYTE SBW_STANDARD_S1_S3 1 100 0 255 ECU_ADDRESS 0xFFF899F8 DISPLAY_IDENTIFIER f_IsExpired.tmr_ID_HoldCC._.cCC_ID.ID_MechLimpInD.CCMsg /end MEASUREMENT
/begin MEASUREMENT CCMsg.ID_MechLimpInD.cCC_ID._.tmr_ID_HoldCC.time "test_timer" UWORD SBW_TIMER_10MS_S1_S3 1 100 0 655350 ECU_ADDRESS 0xFFF899F6 DISPLAY_IDENTIFIER time.tmr_ID_HoldCC._.cCC_ID.ID_MechLimpInD.CCMsg /end MEASUREMENT
/begin MEASUREMENT CCMsg.ID_MechLimpInD.cCC_ID._.tmr_ID_MinTime.f_IsExpired "test_timer" UBYTE SBW_STANDARD_S1_S3 1 100 0 255 ECU_ADDRESS 0xFFF899F4 DISPLAY_IDENTIFIER f_IsExpired.tmr_ID_MinTime._.cCC_ID.ID_MechLimpInD.CCMsg /end MEASUREMENT
/begin MEASUREMENT CCMsg.ID_MechLimpInD.cCC_ID._.tmr_ID_MinTime.time "test_timer" UWORD SBW_TIMER_10MS_S1_S3 1 100 0 655350 ECU_ADDRESS 0xFFF899F2 DISPLAY_IDENTIFIER time.tmr_ID_MinTime._.cCC_ID.ID_MechLimpInD.CCMsg /end MEASUREMENT
/begin MEASUREMENT CCMsg.ID_MechLimpInD.cCC_ID._.tmr_ID_delay.f_IsExpired "test_timer" UBYTE SBW_STANDARD_S1_S3 1 100 0 255 ECU_ADDRESS 0xFFF899EC DISPLAY_IDENTIFIER f_IsExpired.tmr_ID_delay._.cCC_ID.ID_MechLimpInD.CCMsg /end MEASUREMENT
/begin MEASUREMENT CCMsg.ID_MechLimpInD.cCC_ID._.tmr_ID_delay.time "test_timer" UWORD SBW_TIMER_10MS_S1_S3 1 100 0 655350 ECU_ADDRESS 0xFFF899EA DISPLAY_IDENTIFIER time.tmr_ID_delay._.cCC_ID.ID_MechLimpInD.CCMsg /end MEASUREMENT
/begin MEASUREMENT CCMsg.ID_MechLimpInD.f_ID_MechLimpInD "Flag for CC-Msgs" UBYTE SBW_STANDARD_S1_S3 1 100 0 1 BIT_MASK 0x1 ECU_ADDRESS 0xFFF89A00 DISPLAY_IDENTIFIER f_ID_MechLimpInD.ID_MechLimpInD.CCMsg /end MEASUREMENT
/begin MEASUREMENT CCMsg.ID_MechLimpInP.cCC_ID._.MsgOnceSent "State of CC-ID Operating Sequence" UBYTE SBW_STANDARD_S1_S3 1 100 0 1 BIT_MASK 0x1 ECU_ADDRESS 0xFFF899C8 DISPLAY_IDENTIFIER MsgOnceSent._.cCC_ID.ID_MechLimpInP.CCMsg /end MEASUREMENT
/begin MEASUREMENT CCMsg.ID_MechLimpInP.cCC_ID._.MyIdx "Sequential Index of the CC-ID to access tables" UBYTE SBW_STANDARD_S1_S3 1 100 1 255 ECU_ADDRESS 0xFFF899C4 DISPLAY_IDENTIFIER MyIdx._.cCC_ID.ID_MechLimpInP.CCMsg /end MEASUREMENT
/begin MEASUREMENT CCMsg.ID_MechLimpInP.cCC_ID._.f_ID_Locked "Flag: Interlocked by other ID" UBYTE SBW_STANDARD_S1_S3 1 100 0 1 BIT_MASK 0x1 ECU_ADDRESS 0xFFF899C5 DISPLAY_IDENTIFIER f_ID_Locked._.cCC_ID.ID_MechLimpInP.CCMsg /end MEASUREMENT
/begin MEASUREMENT CCMsg.ID_MechLimpInP.cCC_ID._.f_ID_Reset "Flag: Premature Reset" UBYTE SBW_STANDARD_S1_S3 1 100 0 1 BIT_MASK 0x1 ECU_ADDRESS 0xFFF899C6 DISPLAY_IDENTIFIER f_ID_Reset._.cCC_ID.ID_MechLimpInP.CCMsg /end MEASUREMENT
/begin MEASUREMENT CCMsg.ID_MechLimpInP.cCC_ID._.st_ID "State of CC-ID Operating Sequence" UBYTE SBW_STANDARD_S1_S3 1 100 1 255 ECU_ADDRESS 0xFFF899C7 DISPLAY_IDENTIFIER st_ID._.cCC_ID.ID_MechLimpInP.CCMsg /end MEASUREMENT
/begin MEASUREMENT CCMsg.ID_MechLimpInP.cCC_ID._.tmr_ID_CycleTime.f_IsExpired "test_timer" UBYTE SBW_STANDARD_S1_S3 1 100 0 255 ECU_ADDRESS 0xFFF899D0 DISPLAY_IDENTIFIER f_IsExpired.tmr_ID_CycleTime._.cCC_ID.ID_MechLimpInP.CCMsg /end MEASUREMENT
/begin MEASUREMENT CCMsg.ID_MechLimpInP.cCC_ID._.tmr_ID_CycleTime.time "test_timer" UWORD SBW_TIMER_10MS_S1_S3 1 100 0 655350 ECU_ADDRESS 0xFFF899CE DISPLAY_IDENTIFIER time.tmr_ID_CycleTime._.cCC_ID.ID_MechLimpInP.CCMsg /end MEASUREMENT
/begin MEASUREMENT CCMsg.ID_MechLimpInP.cCC_ID._.tmr_ID_HoldCC.f_IsExpired "test_timer" UBYTE SBW_STANDARD_S1_S3 1 100 0 255 ECU_ADDRESS 0xFFF899D8 DISPLAY_IDENTIFIER f_IsExpired.tmr_ID_HoldCC._.cCC_ID.ID_MechLimpInP.CCMsg /end MEASUREMENT
/begin MEASUREMENT CCMsg.ID_MechLimpInP.cCC_ID._.tmr_ID_HoldCC.time "test_timer" UWORD SBW_TIMER_10MS_S1_S3 1 100 0 655350 ECU_ADDRESS 0xFFF899D6 DISPLAY_IDENTIFIER time.tmr_ID_HoldCC._.cCC_ID.ID_MechLimpInP.CCMsg /end MEASUREMENT
/begin MEASUREMENT CCMsg.ID_MechLimpInP.cCC_ID._.tmr_ID_MinTime.f_IsExpired "test_timer" UBYTE SBW_STANDARD_S1_S3 1 100 0 255 ECU_ADDRESS 0xFFF899D4 DISPLAY_IDENTIFIER f_IsExpired.tmr_ID_MinTime._.cCC_ID.ID_MechLimpInP.CCMsg /end MEASUREMENT
/begin MEASUREMENT CCMsg.ID_MechLimpInP.cCC_ID._.tmr_ID_MinTime.time "test_timer" UWORD SBW_TIMER_10MS_S1_S3 1 100 0 655350 ECU_ADDRESS 0xFFF899D2 DISPLAY_IDENTIFIER time.tmr_ID_MinTime._.cCC_ID.ID_MechLimpInP.CCMsg /end MEASUREMENT
/begin MEASUREMENT CCMsg.ID_MechLimpInP.cCC_ID._.tmr_ID_delay.f_IsExpired "test_timer" UBYTE SBW_STANDARD_S1_S3 1 100 0 255 ECU_ADDRESS 0xFFF899CC DISPLAY_IDENTIFIER f_IsExpired.tmr_ID_delay._.cCC_ID.ID_MechLimpInP.CCMsg /end MEASUREMENT
/begin MEASUREMENT CCMsg.ID_MechLimpInP.cCC_ID._.tmr_ID_delay.time "test_timer" UWORD SBW_TIMER_10MS_S1_S3 1 100 0 655350 ECU_ADDRESS 0xFFF899CA DISPLAY_IDENTIFIER time.tmr_ID_delay._.cCC_ID.ID_MechLimpInP.CCMsg /end MEASUREMENT
/begin MEASUREMENT CCMsg.ID_MechLimpInP.f_ID_MechLimpInP "Flag for CC-Msgs" UBYTE SBW_STANDARD_S1_S3 1 100 0 1 BIT_MASK 0x1 ECU_ADDRESS 0xFFF899E0 DISPLAY_IDENTIFIER f_ID_MechLimpInP.ID_MechLimpInP.CCMsg /end MEASUREMENT
/begin MEASUREMENT CCMsg.ID_PS_Abuse.cCC_ID._.MsgOnceSent "State of CC-ID Operating Sequence" UBYTE SBW_STANDARD_S1_S3 1 100 0 1 BIT_MASK 0x1 ECU_ADDRESS 0xFFF89C28 DISPLAY_IDENTIFIER MsgOnceSent._.cCC_ID.ID_PS_Abuse.CCMsg /end MEASUREMENT
/begin MEASUREMENT CCMsg.ID_PS_Abuse.cCC_ID._.MyIdx "Sequential Index of the CC-ID to access tables" UBYTE SBW_STANDARD_S1_S3 1 100 1 255 ECU_ADDRESS 0xFFF89C24 DISPLAY_IDENTIFIER MyIdx._.cCC_ID.ID_PS_Abuse.CCMsg /end MEASUREMENT
/begin MEASUREMENT CCMsg.ID_PS_Abuse.cCC_ID._.f_ID_Locked "Flag: Interlocked by other ID" UBYTE SBW_STANDARD_S1_S3 1 100 0 1 BIT_MASK 0x1 ECU_ADDRESS 0xFFF89C25 DISPLAY_IDENTIFIER f_ID_Locked._.cCC_ID.ID_PS_Abuse.CCMsg /end MEASUREMENT
/begin MEASUREMENT CCMsg.ID_PS_Abuse.cCC_ID._.f_ID_Reset "Flag: Premature Reset" UBYTE SBW_STANDARD_S1_S3 1 100 0 1 BIT_MASK 0x1 ECU_ADDRESS 0xFFF89C26 DISPLAY_IDENTIFIER f_ID_Reset._.cCC_ID.ID_PS_Abuse.CCMsg /end MEASUREMENT
/begin MEASUREMENT CCMsg.ID_PS_Abuse.cCC_ID._.st_ID "State of CC-ID Operating Sequence" UBYTE SBW_STANDARD_S1_S3 1 100 1 255 ECU_ADDRESS 0xFFF89C27 DISPLAY_IDENTIFIER st_ID._.cCC_ID.ID_PS_Abuse.CCMsg /end MEASUREMENT
/begin MEASUREMENT CCMsg.ID_PS_Abuse.cCC_ID._.tmr_ID_CycleTime.f_IsExpired "test_timer" UBYTE SBW_STANDARD_S1_S3 1 100 0 255 ECU_ADDRESS 0xFFF89C30 DISPLAY_IDENTIFIER f_IsExpired.tmr_ID_CycleTime._.cCC_ID.ID_PS_Abuse.CCMsg /end MEASUREMENT
/begin MEASUREMENT CCMsg.ID_PS_Abuse.cCC_ID._.tmr_ID_CycleTime.time "test_timer" UWORD SBW_TIMER_10MS_S1_S3 1 100 0 655350 ECU_ADDRESS 0xFFF89C2E DISPLAY_IDENTIFIER time.tmr_ID_CycleTime._.cCC_ID.ID_PS_Abuse.CCMsg /end MEASUREMENT
/begin MEASUREMENT CCMsg.ID_PS_Abuse.cCC_ID._.tmr_ID_HoldCC.f_IsExpired "test_timer" UBYTE SBW_STANDARD_S1_S3 1 100 0 255 ECU_ADDRESS 0xFFF89C38 DISPLAY_IDENTIFIER f_IsExpired.tmr_ID_HoldCC._.cCC_ID.ID_PS_Abuse.CCMsg /end MEASUREMENT
/begin MEASUREMENT CCMsg.ID_PS_Abuse.cCC_ID._.tmr_ID_HoldCC.time "test_timer" UWORD SBW_TIMER_10MS_S1_S3 1 100 0 655350 ECU_ADDRESS 0xFFF89C36 DISPLAY_IDENTIFIER time.tmr_ID_HoldCC._.cCC_ID.ID_PS_Abuse.CCMsg /end MEASUREMENT
/begin MEASUREMENT CCMsg.ID_PS_Abuse.cCC_ID._.tmr_ID_MinTime.f_IsExpired "test_timer" UBYTE SBW_STANDARD_S1_S3 1 100 0 255 ECU_ADDRESS 0xFFF89C34 DISPLAY_IDENTIFIER f_IsExpired.tmr_ID_MinTime._.cCC_ID.ID_PS_Abuse.CCMsg /end MEASUREMENT
/begin MEASUREMENT CCMsg.ID_PS_Abuse.cCC_ID._.tmr_ID_MinTime.time "test_timer" UWORD SBW_TIMER_10MS_S1_S3 1 100 0 655350 ECU_ADDRESS 0xFFF89C32 DISPLAY_IDENTIFIER time.tmr_ID_MinTime._.cCC_ID.ID_PS_Abuse.CCMsg /end MEASUREMENT
/begin MEASUREMENT CCMsg.ID_PS_Abuse.cCC_ID._.tmr_ID_delay.f_IsExpired "test_timer" UBYTE SBW_STANDARD_S1_S3 1 100 0 255 ECU_ADDRESS 0xFFF89C2C DISPLAY_IDENTIFIER f_IsExpired.tmr_ID_delay._.cCC_ID.ID_PS_Abuse.CCMsg /end MEASUREMENT
/begin MEASUREMENT CCMsg.ID_PS_Abuse.cCC_ID._.tmr_ID_delay.time "test_timer" UWORD SBW_TIMER_10MS_S1_S3 1 100 0 655350 ECU_ADDRESS 0xFFF89C2A DISPLAY_IDENTIFIER time.tmr_ID_delay._.cCC_ID.ID_PS_Abuse.CCMsg /end MEASUREMENT
/begin MEASUREMENT CCMsg.ID_PS_Abuse.f_ID_PS_Abuse "Flag for CC-Msgs" UBYTE SBW_STANDARD_S1_S3 1 100 0 1 BIT_MASK 0x1 ECU_ADDRESS 0xFFF89C40 DISPLAY_IDENTIFIER f_ID_PS_Abuse.ID_PS_Abuse.CCMsg /end MEASUREMENT
/begin MEASUREMENT CCMsg.ID_P_ButtonError.cCC_ID._.MsgOnceSent "State of CC-ID Operating Sequence" UBYTE SBW_STANDARD_S1_S3 1 100 0 1 BIT_MASK 0x1 ECU_ADDRESS 0xFFF89BC8 DISPLAY_IDENTIFIER MsgOnceSent._.cCC_ID.ID_P_ButtonError.CCMsg /end MEASUREMENT
/begin MEASUREMENT CCMsg.ID_P_ButtonError.cCC_ID._.MyIdx "Sequential Index of the CC-ID to access tables" UBYTE SBW_STANDARD_S1_S3 1 100 1 255 ECU_ADDRESS 0xFFF89BC4 DISPLAY_IDENTIFIER MyIdx._.cCC_ID.ID_P_ButtonError.CCMsg /end MEASUREMENT
/begin MEASUREMENT CCMsg.ID_P_ButtonError.cCC_ID._.f_ID_Locked "Flag: Interlocked by other ID" UBYTE SBW_STANDARD_S1_S3 1 100 0 1 BIT_MASK 0x1 ECU_ADDRESS 0xFFF89BC5 DISPLAY_IDENTIFIER f_ID_Locked._.cCC_ID.ID_P_ButtonError.CCMsg /end MEASUREMENT
/begin MEASUREMENT CCMsg.ID_P_ButtonError.cCC_ID._.f_ID_Reset "Flag: Premature Reset" UBYTE SBW_STANDARD_S1_S3 1 100 0 1 BIT_MASK 0x1 ECU_ADDRESS 0xFFF89BC6 DISPLAY_IDENTIFIER f_ID_Reset._.cCC_ID.ID_P_ButtonError.CCMsg /end MEASUREMENT
/begin MEASUREMENT CCMsg.ID_P_ButtonError.cCC_ID._.st_ID "State of CC-ID Operating Sequence" UBYTE SBW_STANDARD_S1_S3 1 100 1 255 ECU_ADDRESS 0xFFF89BC7 DISPLAY_IDENTIFIER st_ID._.cCC_ID.ID_P_ButtonError.CCMsg /end MEASUREMENT
/begin MEASUREMENT CCMsg.ID_P_ButtonError.cCC_ID._.tmr_ID_CycleTime.f_IsExpired "test_timer" UBYTE SBW_STANDARD_S1_S3 1 100 0 255 ECU_ADDRESS 0xFFF89BD0 DISPLAY_IDENTIFIER f_IsExpired.tmr_ID_CycleTime._.cCC_ID.ID_P_ButtonError.CCMsg /end MEASUREMENT
/begin MEASUREMENT CCMsg.ID_P_ButtonError.cCC_ID._.tmr_ID_CycleTime.time "test_timer" UWORD SBW_TIMER_10MS_S1_S3 1 100 0 655350 ECU_ADDRESS 0xFFF89BCE DISPLAY_IDENTIFIER time.tmr_ID_CycleTime._.cCC_ID.ID_P_ButtonError.CCMsg /end MEASUREMENT
/begin MEASUREMENT CCMsg.ID_P_ButtonError.cCC_ID._.tmr_ID_HoldCC.f_IsExpired "test_timer" UBYTE SBW_STANDARD_S1_S3 1 100 0 255 ECU_ADDRESS 0xFFF89BD8 DISPLAY_IDENTIFIER f_IsExpired.tmr_ID_HoldCC._.cCC_ID.ID_P_ButtonError.CCMsg /end MEASUREMENT
/begin MEASUREMENT CCMsg.ID_P_ButtonError.cCC_ID._.tmr_ID_HoldCC.time "test_timer" UWORD SBW_TIMER_10MS_S1_S3 1 100 0 655350 ECU_ADDRESS 0xFFF89BD6 DISPLAY_IDENTIFIER time.tmr_ID_HoldCC._.cCC_ID.ID_P_ButtonError.CCMsg /end MEASUREMENT
/begin MEASUREMENT CCMsg.ID_P_ButtonError.cCC_ID._.tmr_ID_MinTime.f_IsExpired "test_timer" UBYTE SBW_STANDARD_S1_S3 1 100 0 255 ECU_ADDRESS 0xFFF89BD4 DISPLAY_IDENTIFIER f_IsExpired.tmr_ID_MinTime._.cCC_ID.ID_P_ButtonError.CCMsg /end MEASUREMENT
/begin MEASUREMENT CCMsg.ID_P_ButtonError.cCC_ID._.tmr_ID_MinTime.time "test_timer" UWORD SBW_TIMER_10MS_S1_S3 1 100 0 655350 ECU_ADDRESS 0xFFF89BD2 DISPLAY_IDENTIFIER time.tmr_ID_MinTime._.cCC_ID.ID_P_ButtonError.CCMsg /end MEASUREMENT
/begin MEASUREMENT CCMsg.ID_P_ButtonError.cCC_ID._.tmr_ID_delay.f_IsExpired "test_timer" UBYTE SBW_STANDARD_S1_S3 1 100 0 255 ECU_ADDRESS 0xFFF89BCC DISPLAY_IDENTIFIER f_IsExpired.tmr_ID_delay._.cCC_ID.ID_P_ButtonError.CCMsg /end MEASUREMENT
/begin MEASUREMENT CCMsg.ID_P_ButtonError.cCC_ID._.tmr_ID_delay.time "test_timer" UWORD SBW_TIMER_10MS_S1_S3 1 100 0 655350 ECU_ADDRESS 0xFFF89BCA DISPLAY_IDENTIFIER time.tmr_ID_delay._.cCC_ID.ID_P_ButtonError.CCMsg /end MEASUREMENT
/begin MEASUREMENT CCMsg.ID_P_ButtonError.f_ID_P_ButtonError "Flag for CC-Msgs" UBYTE SBW_STANDARD_S1_S3 1 100 0 1 BIT_MASK 0x1 ECU_ADDRESS 0xFFF89BE0 DISPLAY_IDENTIFIER f_ID_P_ButtonError.ID_P_ButtonError.CCMsg /end MEASUREMENT
/begin MEASUREMENT CCMsg.ID_ParkLockFault.cCC_ID._.MsgOnceSent "State of CC-ID Operating Sequence" UBYTE SBW_STANDARD_S1_S3 1 100 0 1 BIT_MASK 0x1 ECU_ADDRESS 0xFFF89A48 DISPLAY_IDENTIFIER MsgOnceSent._.cCC_ID.ID_ParkLockFault.CCMsg /end MEASUREMENT
/begin MEASUREMENT CCMsg.ID_ParkLockFault.cCC_ID._.MyIdx "Sequential Index of the CC-ID to access tables" UBYTE SBW_STANDARD_S1_S3 1 100 1 255 ECU_ADDRESS 0xFFF89A44 DISPLAY_IDENTIFIER MyIdx._.cCC_ID.ID_ParkLockFault.CCMsg /end MEASUREMENT
/begin MEASUREMENT CCMsg.ID_ParkLockFault.cCC_ID._.f_ID_Locked "Flag: Interlocked by other ID" UBYTE SBW_STANDARD_S1_S3 1 100 0 1 BIT_MASK 0x1 ECU_ADDRESS 0xFFF89A45 DISPLAY_IDENTIFIER f_ID_Locked._.cCC_ID.ID_ParkLockFault.CCMsg /end MEASUREMENT
/begin MEASUREMENT CCMsg.ID_ParkLockFault.cCC_ID._.f_ID_Reset "Flag: Premature Reset" UBYTE SBW_STANDARD_S1_S3 1 100 0 1 BIT_MASK 0x1 ECU_ADDRESS 0xFFF89A46 DISPLAY_IDENTIFIER f_ID_Reset._.cCC_ID.ID_ParkLockFault.CCMsg /end MEASUREMENT
/begin MEASUREMENT CCMsg.ID_ParkLockFault.cCC_ID._.st_ID "State of CC-ID Operating Sequence" UBYTE SBW_STANDARD_S1_S3 1 100 1 255 ECU_ADDRESS 0xFFF89A47 DISPLAY_IDENTIFIER st_ID._.cCC_ID.ID_ParkLockFault.CCMsg /end MEASUREMENT
/begin MEASUREMENT CCMsg.ID_ParkLockFault.cCC_ID._.tmr_ID_CycleTime.f_IsExpired "test_timer" UBYTE SBW_STANDARD_S1_S3 1 100 0 255 ECU_ADDRESS 0xFFF89A50 DISPLAY_IDENTIFIER f_IsExpired.tmr_ID_CycleTime._.cCC_ID.ID_ParkLockFault.CCMsg /end MEASUREMENT
/begin MEASUREMENT CCMsg.ID_ParkLockFault.cCC_ID._.tmr_ID_CycleTime.time "test_timer" UWORD SBW_TIMER_10MS_S1_S3 1 100 0 655350 ECU_ADDRESS 0xFFF89A4E DISPLAY_IDENTIFIER time.tmr_ID_CycleTime._.cCC_ID.ID_ParkLockFault.CCMsg /end MEASUREMENT
/begin MEASUREMENT CCMsg.ID_ParkLockFault.cCC_ID._.tmr_ID_HoldCC.f_IsExpired "test_timer" UBYTE SBW_STANDARD_S1_S3 1 100 0 255 ECU_ADDRESS 0xFFF89A58 DISPLAY_IDENTIFIER f_IsExpired.tmr_ID_HoldCC._.cCC_ID.ID_ParkLockFault.CCMsg /end MEASUREMENT
/begin MEASUREMENT CCMsg.ID_ParkLockFault.cCC_ID._.tmr_ID_HoldCC.time "test_timer" UWORD SBW_TIMER_10MS_S1_S3 1 100 0 655350 ECU_ADDRESS 0xFFF89A56 DISPLAY_IDENTIFIER time.tmr_ID_HoldCC._.cCC_ID.ID_ParkLockFault.CCMsg /end MEASUREMENT
/begin MEASUREMENT CCMsg.ID_ParkLockFault.cCC_ID._.tmr_ID_MinTime.f_IsExpired "test_timer" UBYTE SBW_STANDARD_S1_S3 1 100 0 255 ECU_ADDRESS 0xFFF89A54 DISPLAY_IDENTIFIER f_IsExpired.tmr_ID_MinTime._.cCC_ID.ID_ParkLockFault.CCMsg /end MEASUREMENT
/begin MEASUREMENT CCMsg.ID_ParkLockFault.cCC_ID._.tmr_ID_MinTime.time "test_timer" UWORD SBW_TIMER_10MS_S1_S3 1 100 0 655350 ECU_ADDRESS 0xFFF89A52 DISPLAY_IDENTIFIER time.tmr_ID_MinTime._.cCC_ID.ID_ParkLockFault.CCMsg /end MEASUREMENT
/begin MEASUREMENT CCMsg.ID_ParkLockFault.cCC_ID._.tmr_ID_delay.f_IsExpired "test_timer" UBYTE SBW_STANDARD_S1_S3 1 100 0 255 ECU_ADDRESS 0xFFF89A4C DISPLAY_IDENTIFIER f_IsExpired.tmr_ID_delay._.cCC_ID.ID_ParkLockFault.CCMsg /end MEASUREMENT
/begin MEASUREMENT CCMsg.ID_ParkLockFault.cCC_ID._.tmr_ID_delay.time "test_timer" UWORD SBW_TIMER_10MS_S1_S3 1 100 0 655350 ECU_ADDRESS 0xFFF89A4A DISPLAY_IDENTIFIER time.tmr_ID_delay._.cCC_ID.ID_ParkLockFault.CCMsg /end MEASUREMENT
/begin MEASUREMENT CCMsg.ID_ParkLockFault.f_ID_ParkLockFault "Flag for CC-Msgs" UBYTE SBW_STANDARD_S1_S3 1 100 0 1 BIT_MASK 0x1 ECU_ADDRESS 0xFFF89A60 DISPLAY_IDENTIFIER f_ID_ParkLockFault.ID_ParkLockFault.CCMsg /end MEASUREMENT
/begin MEASUREMENT CCMsg.ID_ParkLockFault_IEP_On.cCC_ID._.MsgOnceSent "State of CC-ID Operating Sequence" UBYTE SBW_STANDARD_S1_S3 1 100 0 1 BIT_MASK 0x1 ECU_ADDRESS 0xFFF89A88 DISPLAY_IDENTIFIER MsgOnceSent._.cCC_ID.ID_ParkLockFault_IEP_On.CCMsg /end MEASUREMENT
/begin MEASUREMENT CCMsg.ID_ParkLockFault_IEP_On.cCC_ID._.MyIdx "Sequential Index of the CC-ID to access tables" UBYTE SBW_STANDARD_S1_S3 1 100 1 255 ECU_ADDRESS 0xFFF89A84 DISPLAY_IDENTIFIER MyIdx._.cCC_ID.ID_ParkLockFault_IEP_On.CCMsg /end MEASUREMENT
/begin MEASUREMENT CCMsg.ID_ParkLockFault_IEP_On.cCC_ID._.f_ID_Locked "Flag: Interlocked by other ID" UBYTE SBW_STANDARD_S1_S3 1 100 0 1 BIT_MASK 0x1 ECU_ADDRESS 0xFFF89A85 DISPLAY_IDENTIFIER f_ID_Locked._.cCC_ID.ID_ParkLockFault_IEP_On.CCMsg /end MEASUREMENT
/begin MEASUREMENT CCMsg.ID_ParkLockFault_IEP_On.cCC_ID._.f_ID_Reset "Flag: Premature Reset" UBYTE SBW_STANDARD_S1_S3 1 100 0 1 BIT_MASK 0x1 ECU_ADDRESS 0xFFF89A86 DISPLAY_IDENTIFIER f_ID_Reset._.cCC_ID.ID_ParkLockFault_IEP_On.CCMsg /end MEASUREMENT
/begin MEASUREMENT CCMsg.ID_ParkLockFault_IEP_On.cCC_ID._.st_ID "State of CC-ID Operating Sequence" UBYTE SBW_STANDARD_S1_S3 1 100 1 255 ECU_ADDRESS 0xFFF89A87 DISPLAY_IDENTIFIER st_ID._.cCC_ID.ID_ParkLockFault_IEP_On.CCMsg /end MEASUREMENT
/begin MEASUREMENT CCMsg.ID_ParkLockFault_IEP_On.cCC_ID._.tmr_ID_CycleTime.f_IsExpired "test_timer" UBYTE SBW_STANDARD_S1_S3 1 100 0 255 ECU_ADDRESS 0xFFF89A90 DISPLAY_IDENTIFIER f_IsExpired.tmr_ID_CycleTime._.cCC_ID.ID_ParkLockFault_IEP_On.CCMsg /end MEASUREMENT
/begin MEASUREMENT CCMsg.ID_ParkLockFault_IEP_On.cCC_ID._.tmr_ID_CycleTime.time "test_timer" UWORD SBW_TIMER_10MS_S1_S3 1 100 0 655350 ECU_ADDRESS 0xFFF89A8E DISPLAY_IDENTIFIER time.tmr_ID_CycleTime._.cCC_ID.ID_ParkLockFault_IEP_On.CCMsg /end MEASUREMENT
/begin MEASUREMENT CCMsg.ID_ParkLockFault_IEP_On.cCC_ID._.tmr_ID_HoldCC.f_IsExpired "test_timer" UBYTE SBW_STANDARD_S1_S3 1 100 0 255 ECU_ADDRESS 0xFFF89A98 DISPLAY_IDENTIFIER f_IsExpired.tmr_ID_HoldCC._.cCC_ID.ID_ParkLockFault_IEP_On.CCMsg /end MEASUREMENT
/begin MEASUREMENT CCMsg.ID_ParkLockFault_IEP_On.cCC_ID._.tmr_ID_HoldCC.time "test_timer" UWORD SBW_TIMER_10MS_S1_S3 1 100 0 655350 ECU_ADDRESS 0xFFF89A96 DISPLAY_IDENTIFIER time.tmr_ID_HoldCC._.cCC_ID.ID_ParkLockFault_IEP_On.CCMsg /end MEASUREMENT
/begin MEASUREMENT CCMsg.ID_ParkLockFault_IEP_On.cCC_ID._.tmr_ID_MinTime.f_IsExpired "test_timer" UBYTE SBW_STANDARD_S1_S3 1 100 0 255 ECU_ADDRESS 0xFFF89A94 DISPLAY_IDENTIFIER f_IsExpired.tmr_ID_MinTime._.cCC_ID.ID_ParkLockFault_IEP_On.CCMsg /end MEASUREMENT
/begin MEASUREMENT CCMsg.ID_ParkLockFault_IEP_On.cCC_ID._.tmr_ID_MinTime.time "test_timer" UWORD SBW_TIMER_10MS_S1_S3 1 100 0 655350 ECU_ADDRESS 0xFFF89A92 DISPLAY_IDENTIFIER time.tmr_ID_MinTime._.cCC_ID.ID_ParkLockFault_IEP_On.CCMsg /end MEASUREMENT
/begin MEASUREMENT CCMsg.ID_ParkLockFault_IEP_On.cCC_ID._.tmr_ID_delay.f_IsExpired "test_timer" UBYTE SBW_STANDARD_S1_S3 1 100 0 255 ECU_ADDRESS 0xFFF89A8C DISPLAY_IDENTIFIER f_IsExpired.tmr_ID_delay._.cCC_ID.ID_ParkLockFault_IEP_On.CCMsg /end MEASUREMENT
/begin MEASUREMENT CCMsg.ID_ParkLockFault_IEP_On.cCC_ID._.tmr_ID_delay.time "test_timer" UWORD SBW_TIMER_10MS_S1_S3 1 100 0 655350 ECU_ADDRESS 0xFFF89A8A DISPLAY_IDENTIFIER time.tmr_ID_delay._.cCC_ID.ID_ParkLockFault_IEP_On.CCMsg /end MEASUREMENT
/begin MEASUREMENT CCMsg.ID_ParkLockFault_IEP_On.f_ID_ParkLockFault_IEP_On "Flag for CC-Msgs" UBYTE SBW_STANDARD_S1_S3 1 100 0 1 BIT_MASK 0x1 ECU_ADDRESS 0xFFF89AA0 DISPLAY_IDENTIFIER f_ID_ParkLockFault_IEP_On.ID_ParkLockFault_IEP_On.CCMsg /end MEASUREMENT
/begin MEASUREMENT CCMsg.ID_ParkLockFault_InMechLimp.cCC_ID._.MsgOnceSent "State of CC-ID Operating Sequence" UBYTE SBW_STANDARD_S1_S3 1 100 0 1 BIT_MASK 0x1 ECU_ADDRESS 0xFFF89A68 DISPLAY_IDENTIFIER MsgOnceSent._.cCC_ID.ID_ParkLockFault_InMechLimp.CCMsg /end MEASUREMENT
/begin MEASUREMENT CCMsg.ID_ParkLockFault_InMechLimp.cCC_ID._.MyIdx "Sequential Index of the CC-ID to access tables" UBYTE SBW_STANDARD_S1_S3 1 100 1 255 ECU_ADDRESS 0xFFF89A64 DISPLAY_IDENTIFIER MyIdx._.cCC_ID.ID_ParkLockFault_InMechLimp.CCMsg /end MEASUREMENT
/begin MEASUREMENT CCMsg.ID_ParkLockFault_InMechLimp.cCC_ID._.f_ID_Locked "Flag: Interlocked by other ID" UBYTE SBW_STANDARD_S1_S3 1 100 0 1 BIT_MASK 0x1 ECU_ADDRESS 0xFFF89A65 DISPLAY_IDENTIFIER f_ID_Locked._.cCC_ID.ID_ParkLockFault_InMechLimp.CCMsg /end MEASUREMENT
/begin MEASUREMENT CCMsg.ID_ParkLockFault_InMechLimp.cCC_ID._.f_ID_Reset "Flag: Premature Reset" UBYTE SBW_STANDARD_S1_S3 1 100 0 1 BIT_MASK 0x1 ECU_ADDRESS 0xFFF89A66 DISPLAY_IDENTIFIER f_ID_Reset._.cCC_ID.ID_ParkLockFault_InMechLimp.CCMsg /end MEASUREMENT
/begin MEASUREMENT CCMsg.ID_ParkLockFault_InMechLimp.cCC_ID._.st_ID "State of CC-ID Operating Sequence" UBYTE SBW_STANDARD_S1_S3 1 100 1 255 ECU_ADDRESS 0xFFF89A67 DISPLAY_IDENTIFIER st_ID._.cCC_ID.ID_ParkLockFault_InMechLimp.CCMsg /end MEASUREMENT
/begin MEASUREMENT CCMsg.ID_ParkLockFault_InMechLimp.cCC_ID._.tmr_ID_CycleTime.f_IsExpired "test_timer" UBYTE SBW_STANDARD_S1_S3 1 100 0 255 ECU_ADDRESS 0xFFF89A70 DISPLAY_IDENTIFIER f_IsExpired.tmr_ID_CycleTime._.cCC_ID.ID_ParkLockFault_InMechLimp.CCMsg /end MEASUREMENT
/begin MEASUREMENT CCMsg.ID_ParkLockFault_InMechLimp.cCC_ID._.tmr_ID_CycleTime.time "test_timer" UWORD SBW_TIMER_10MS_S1_S3 1 100 0 655350 ECU_ADDRESS 0xFFF89A6E DISPLAY_IDENTIFIER time.tmr_ID_CycleTime._.cCC_ID.ID_ParkLockFault_InMechLimp.CCMsg /end MEASUREMENT
/begin MEASUREMENT CCMsg.ID_ParkLockFault_InMechLimp.cCC_ID._.tmr_ID_HoldCC.f_IsExpired "test_timer" UBYTE SBW_STANDARD_S1_S3 1 100 0 255 ECU_ADDRESS 0xFFF89A78 DISPLAY_IDENTIFIER f_IsExpired.tmr_ID_HoldCC._.cCC_ID.ID_ParkLockFault_InMechLimp.CCMsg /end MEASUREMENT
/begin MEASUREMENT CCMsg.ID_ParkLockFault_InMechLimp.cCC_ID._.tmr_ID_HoldCC.time "test_timer" UWORD SBW_TIMER_10MS_S1_S3 1 100 0 655350 ECU_ADDRESS 0xFFF89A76 DISPLAY_IDENTIFIER time.tmr_ID_HoldCC._.cCC_ID.ID_ParkLockFault_InMechLimp.CCMsg /end MEASUREMENT
/begin MEASUREMENT CCMsg.ID_ParkLockFault_InMechLimp.cCC_ID._.tmr_ID_MinTime.f_IsExpired "test_timer" UBYTE SBW_STANDARD_S1_S3 1 100 0 255 ECU_ADDRESS 0xFFF89A74 DISPLAY_IDENTIFIER f_IsExpired.tmr_ID_MinTime._.cCC_ID.ID_ParkLockFault_InMechLimp.CCMsg /end MEASUREMENT
/begin MEASUREMENT CCMsg.ID_ParkLockFault_InMechLimp.cCC_ID._.tmr_ID_MinTime.time "test_timer" UWORD SBW_TIMER_10MS_S1_S3 1 100 0 655350 ECU_ADDRESS 0xFFF89A72 DISPLAY_IDENTIFIER time.tmr_ID_MinTime._.cCC_ID.ID_ParkLockFault_InMechLimp.CCMsg /end MEASUREMENT
/begin MEASUREMENT CCMsg.ID_ParkLockFault_InMechLimp.cCC_ID._.tmr_ID_delay.f_IsExpired "test_timer" UBYTE SBW_STANDARD_S1_S3 1 100 0 255 ECU_ADDRESS 0xFFF89A6C DISPLAY_IDENTIFIER f_IsExpired.tmr_ID_delay._.cCC_ID.ID_ParkLockFault_InMechLimp.CCMsg /end MEASUREMENT
/begin MEASUREMENT CCMsg.ID_ParkLockFault_InMechLimp.cCC_ID._.tmr_ID_delay.time "test_timer" UWORD SBW_TIMER_10MS_S1_S3 1 100 0 655350 ECU_ADDRESS 0xFFF89A6A DISPLAY_IDENTIFIER time.tmr_ID_delay._.cCC_ID.ID_ParkLockFault_InMechLimp.CCMsg /end MEASUREMENT
/begin MEASUREMENT CCMsg.ID_ParkLockFault_InMechLimp.f_ID_ParkLockFault_InMechLimp "Flag for CC-Msgs" UBYTE SBW_STANDARD_S1_S3 1 100 0 1 BIT_MASK 0x1 ECU_ADDRESS 0xFFF89A80 DISPLAY_IDENTIFIER f_ID_ParkLockFault_InMechLimp.ID_ParkLockFault_InMechLimp.CCMsg /end MEASUREMENT
/begin MEASUREMENT CCMsg.ID_PosN_Warning.cCC_ID._.MsgOnceSent "State of CC-ID Operating Sequence" UBYTE SBW_STANDARD_S1_S3 1 100 0 1 BIT_MASK 0x1 ECU_ADDRESS 0xFFF89AA8 DISPLAY_IDENTIFIER MsgOnceSent._.cCC_ID.ID_PosN_Warning.CCMsg /end MEASUREMENT
/begin MEASUREMENT CCMsg.ID_PosN_Warning.cCC_ID._.MyIdx "Sequential Index of the CC-ID to access tables" UBYTE SBW_STANDARD_S1_S3 1 100 1 255 ECU_ADDRESS 0xFFF89AA4 DISPLAY_IDENTIFIER MyIdx._.cCC_ID.ID_PosN_Warning.CCMsg /end MEASUREMENT
/begin MEASUREMENT CCMsg.ID_PosN_Warning.cCC_ID._.f_ID_Locked "Flag: Interlocked by other ID" UBYTE SBW_STANDARD_S1_S3 1 100 0 1 BIT_MASK 0x1 ECU_ADDRESS 0xFFF89AA5 DISPLAY_IDENTIFIER f_ID_Locked._.cCC_ID.ID_PosN_Warning.CCMsg /end MEASUREMENT
/begin MEASUREMENT CCMsg.ID_PosN_Warning.cCC_ID._.f_ID_Reset "Flag: Premature Reset" UBYTE SBW_STANDARD_S1_S3 1 100 0 1 BIT_MASK 0x1 ECU_ADDRESS 0xFFF89AA6 DISPLAY_IDENTIFIER f_ID_Reset._.cCC_ID.ID_PosN_Warning.CCMsg /end MEASUREMENT
/begin MEASUREMENT CCMsg.ID_PosN_Warning.cCC_ID._.st_ID "State of CC-ID Operating Sequence" UBYTE SBW_STANDARD_S1_S3 1 100 1 255 ECU_ADDRESS 0xFFF89AA7 DISPLAY_IDENTIFIER st_ID._.cCC_ID.ID_PosN_Warning.CCMsg /end MEASUREMENT
/begin MEASUREMENT CCMsg.ID_PosN_Warning.cCC_ID._.tmr_ID_CycleTime.f_IsExpired "test_timer" UBYTE SBW_STANDARD_S1_S3 1 100 0 255 ECU_ADDRESS 0xFFF89AB0 DISPLAY_IDENTIFIER f_IsExpired.tmr_ID_CycleTime._.cCC_ID.ID_PosN_Warning.CCMsg /end MEASUREMENT
/begin MEASUREMENT CCMsg.ID_PosN_Warning.cCC_ID._.tmr_ID_CycleTime.time "test_timer" UWORD SBW_TIMER_10MS_S1_S3 1 100 0 655350 ECU_ADDRESS 0xFFF89AAE DISPLAY_IDENTIFIER time.tmr_ID_CycleTime._.cCC_ID.ID_PosN_Warning.CCMsg /end MEASUREMENT
/begin MEASUREMENT CCMsg.ID_PosN_Warning.cCC_ID._.tmr_ID_HoldCC.f_IsExpired "test_timer" UBYTE SBW_STANDARD_S1_S3 1 100 0 255 ECU_ADDRESS 0xFFF89AB8 DISPLAY_IDENTIFIER f_IsExpired.tmr_ID_HoldCC._.cCC_ID.ID_PosN_Warning.CCMsg /end MEASUREMENT
/begin MEASUREMENT CCMsg.ID_PosN_Warning.cCC_ID._.tmr_ID_HoldCC.time "test_timer" UWORD SBW_TIMER_10MS_S1_S3 1 100 0 655350 ECU_ADDRESS 0xFFF89AB6 DISPLAY_IDENTIFIER time.tmr_ID_HoldCC._.cCC_ID.ID_PosN_Warning.CCMsg /end MEASUREMENT
/begin MEASUREMENT CCMsg.ID_PosN_Warning.cCC_ID._.tmr_ID_MinTime.f_IsExpired "test_timer" UBYTE SBW_STANDARD_S1_S3 1 100 0 255 ECU_ADDRESS 0xFFF89AB4 DISPLAY_IDENTIFIER f_IsExpired.tmr_ID_MinTime._.cCC_ID.ID_PosN_Warning.CCMsg /end MEASUREMENT
/begin MEASUREMENT CCMsg.ID_PosN_Warning.cCC_ID._.tmr_ID_MinTime.time "test_timer" UWORD SBW_TIMER_10MS_S1_S3 1 100 0 655350 ECU_ADDRESS 0xFFF89AB2 DISPLAY_IDENTIFIER time.tmr_ID_MinTime._.cCC_ID.ID_PosN_Warning.CCMsg /end MEASUREMENT
/begin MEASUREMENT CCMsg.ID_PosN_Warning.cCC_ID._.tmr_ID_delay.f_IsExpired "test_timer" UBYTE SBW_STANDARD_S1_S3 1 100 0 255 ECU_ADDRESS 0xFFF89AAC DISPLAY_IDENTIFIER f_IsExpired.tmr_ID_delay._.cCC_ID.ID_PosN_Warning.CCMsg /end MEASUREMENT
/begin MEASUREMENT CCMsg.ID_PosN_Warning.cCC_ID._.tmr_ID_delay.time "test_timer" UWORD SBW_TIMER_10MS_S1_S3 1 100 0 655350 ECU_ADDRESS 0xFFF89AAA DISPLAY_IDENTIFIER time.tmr_ID_delay._.cCC_ID.ID_PosN_Warning.CCMsg /end MEASUREMENT
/begin MEASUREMENT CCMsg.ID_PosN_Warning.f_ID_PosN_Warning "Flag for CC-Msgs" UBYTE SBW_STANDARD_S1_S3 1 100 0 1 BIT_MASK 0x1 ECU_ADDRESS 0xFFF89AC0 DISPLAY_IDENTIFIER f_ID_PosN_Warning.ID_PosN_Warning.CCMsg /end MEASUREMENT
/begin MEASUREMENT CCMsg.ID_ShiftWithoutBrakeWarning.cCC_ID._.MsgOnceSent "State of CC-ID Operating Sequence" UBYTE SBW_STANDARD_S1_S3 1 100 0 1 BIT_MASK 0x1 ECU_ADDRESS 0xFFF89AE8 DISPLAY_IDENTIFIER MsgOnceSent._.cCC_ID.ID_ShiftWithoutBrakeWarning.CCMsg /end MEASUREMENT
/begin MEASUREMENT CCMsg.ID_ShiftWithoutBrakeWarning.cCC_ID._.MyIdx "Sequential Index of the CC-ID to access tables" UBYTE SBW_STANDARD_S1_S3 1 100 1 255 ECU_ADDRESS 0xFFF89AE4 DISPLAY_IDENTIFIER MyIdx._.cCC_ID.ID_ShiftWithoutBrakeWarning.CCMsg /end MEASUREMENT
/begin MEASUREMENT CCMsg.ID_ShiftWithoutBrakeWarning.cCC_ID._.f_ID_Locked "Flag: Interlocked by other ID" UBYTE SBW_STANDARD_S1_S3 1 100 0 1 BIT_MASK 0x1 ECU_ADDRESS 0xFFF89AE5 DISPLAY_IDENTIFIER f_ID_Locked._.cCC_ID.ID_ShiftWithoutBrakeWarning.CCMsg /end MEASUREMENT
/begin MEASUREMENT CCMsg.ID_ShiftWithoutBrakeWarning.cCC_ID._.f_ID_Reset "Flag: Premature Reset" UBYTE SBW_STANDARD_S1_S3 1 100 0 1 BIT_MASK 0x1 ECU_ADDRESS 0xFFF89AE6 DISPLAY_IDENTIFIER f_ID_Reset._.cCC_ID.ID_ShiftWithoutBrakeWarning.CCMsg /end MEASUREMENT
/begin MEASUREMENT CCMsg.ID_ShiftWithoutBrakeWarning.cCC_ID._.st_ID "State of CC-ID Operating Sequence" UBYTE SBW_STANDARD_S1_S3 1 100 1 255 ECU_ADDRESS 0xFFF89AE7 DISPLAY_IDENTIFIER st_ID._.cCC_ID.ID_ShiftWithoutBrakeWarning.CCMsg /end MEASUREMENT
/begin MEASUREMENT CCMsg.ID_ShiftWithoutBrakeWarning.cCC_ID._.tmr_ID_CycleTime.f_IsExpired "test_timer" UBYTE SBW_STANDARD_S1_S3 1 100 0 255 ECU_ADDRESS 0xFFF89AF0 DISPLAY_IDENTIFIER f_IsExpired.tmr_ID_CycleTime._.cCC_ID.ID_ShiftWithoutBrakeWarning.CCMsg /end MEASUREMENT
/begin MEASUREMENT CCMsg.ID_ShiftWithoutBrakeWarning.cCC_ID._.tmr_ID_CycleTime.time "test_timer" UWORD SBW_TIMER_10MS_S1_S3 1 100 0 655350 ECU_ADDRESS 0xFFF89AEE DISPLAY_IDENTIFIER time.tmr_ID_CycleTime._.cCC_ID.ID_ShiftWithoutBrakeWarning.CCMsg /end MEASUREMENT
/begin MEASUREMENT CCMsg.ID_ShiftWithoutBrakeWarning.cCC_ID._.tmr_ID_HoldCC.f_IsExpired "test_timer" UBYTE SBW_STANDARD_S1_S3 1 100 0 255 ECU_ADDRESS 0xFFF89AF8 DISPLAY_IDENTIFIER f_IsExpired.tmr_ID_HoldCC._.cCC_ID.ID_ShiftWithoutBrakeWarning.CCMsg /end MEASUREMENT
/begin MEASUREMENT CCMsg.ID_ShiftWithoutBrakeWarning.cCC_ID._.tmr_ID_HoldCC.time "test_timer" UWORD SBW_TIMER_10MS_S1_S3 1 100 0 655350 ECU_ADDRESS 0xFFF89AF6 DISPLAY_IDENTIFIER time.tmr_ID_HoldCC._.cCC_ID.ID_ShiftWithoutBrakeWarning.CCMsg /end MEASUREMENT
/begin MEASUREMENT CCMsg.ID_ShiftWithoutBrakeWarning.cCC_ID._.tmr_ID_MinTime.f_IsExpired "test_timer" UBYTE SBW_STANDARD_S1_S3 1 100 0 255 ECU_ADDRESS 0xFFF89AF4 DISPLAY_IDENTIFIER f_IsExpired.tmr_ID_MinTime._.cCC_ID.ID_ShiftWithoutBrakeWarning.CCMsg /end MEASUREMENT
/begin MEASUREMENT CCMsg.ID_ShiftWithoutBrakeWarning.cCC_ID._.tmr_ID_MinTime.time "test_timer" UWORD SBW_TIMER_10MS_S1_S3 1 100 0 655350 ECU_ADDRESS 0xFFF89AF2 DISPLAY_IDENTIFIER time.tmr_ID_MinTime._.cCC_ID.ID_ShiftWithoutBrakeWarning.CCMsg /end MEASUREMENT
/begin MEASUREMENT CCMsg.ID_ShiftWithoutBrakeWarning.cCC_ID._.tmr_ID_delay.f_IsExpired "test_timer" UBYTE SBW_STANDARD_S1_S3 1 100 0 255 ECU_ADDRESS 0xFFF89AEC DISPLAY_IDENTIFIER f_IsExpired.tmr_ID_delay._.cCC_ID.ID_ShiftWithoutBrakeWarning.CCMsg /end MEASUREMENT
/begin MEASUREMENT CCMsg.ID_ShiftWithoutBrakeWarning.cCC_ID._.tmr_ID_delay.time "test_timer" UWORD SBW_TIMER_10MS_S1_S3 1 100 0 655350 ECU_ADDRESS 0xFFF89AEA DISPLAY_IDENTIFIER time.tmr_ID_delay._.cCC_ID.ID_ShiftWithoutBrakeWarning.CCMsg /end MEASUREMENT
/begin MEASUREMENT CCMsg.ID_ShiftWithoutBrakeWarning.f_ID_ShiftWithoutBrakeWarning "Flag for CC-Msgs" UBYTE SBW_STANDARD_S1_S3 1 100 0 1 BIT_MASK 0x1 ECU_ADDRESS 0xFFF89B00 DISPLAY_IDENTIFIER f_ID_ShiftWithoutBrakeWarning.ID_ShiftWithoutBrakeWarning.CCMsg /end MEASUREMENT
/begin MEASUREMENT CCMsg.ID_ShifterError.cCC_ID._.MsgOnceSent "State of CC-ID Operating Sequence" UBYTE SBW_STANDARD_S1_S3 1 100 0 1 BIT_MASK 0x1 ECU_ADDRESS 0xFFF89BA8 DISPLAY_IDENTIFIER MsgOnceSent._.cCC_ID.ID_ShifterError.CCMsg /end MEASUREMENT
/begin MEASUREMENT CCMsg.ID_ShifterError.cCC_ID._.MyIdx "Sequential Index of the CC-ID to access tables" UBYTE SBW_STANDARD_S1_S3 1 100 1 255 ECU_ADDRESS 0xFFF89BA4 DISPLAY_IDENTIFIER MyIdx._.cCC_ID.ID_ShifterError.CCMsg /end MEASUREMENT
/begin MEASUREMENT CCMsg.ID_ShifterError.cCC_ID._.f_ID_Locked "Flag: Interlocked by other ID" UBYTE SBW_STANDARD_S1_S3 1 100 0 1 BIT_MASK 0x1 ECU_ADDRESS 0xFFF89BA5 DISPLAY_IDENTIFIER f_ID_Locked._.cCC_ID.ID_ShifterError.CCMsg /end MEASUREMENT
/begin MEASUREMENT CCMsg.ID_ShifterError.cCC_ID._.f_ID_Reset "Flag: Premature Reset" UBYTE SBW_STANDARD_S1_S3 1 100 0 1 BIT_MASK 0x1 ECU_ADDRESS 0xFFF89BA6 DISPLAY_IDENTIFIER f_ID_Reset._.cCC_ID.ID_ShifterError.CCMsg /end MEASUREMENT
/begin MEASUREMENT CCMsg.ID_ShifterError.cCC_ID._.st_ID "State of CC-ID Operating Sequence" UBYTE SBW_STANDARD_S1_S3 1 100 1 255 ECU_ADDRESS 0xFFF89BA7 DISPLAY_IDENTIFIER st_ID._.cCC_ID.ID_ShifterError.CCMsg /end MEASUREMENT
/begin MEASUREMENT CCMsg.ID_ShifterError.cCC_ID._.tmr_ID_CycleTime.f_IsExpired "test_timer" UBYTE SBW_STANDARD_S1_S3 1 100 0 255 ECU_ADDRESS 0xFFF89BB0 DISPLAY_IDENTIFIER f_IsExpired.tmr_ID_CycleTime._.cCC_ID.ID_ShifterError.CCMsg /end MEASUREMENT
/begin MEASUREMENT CCMsg.ID_ShifterError.cCC_ID._.tmr_ID_CycleTime.time "test_timer" UWORD SBW_TIMER_10MS_S1_S3 1 100 0 655350 ECU_ADDRESS 0xFFF89BAE DISPLAY_IDENTIFIER time.tmr_ID_CycleTime._.cCC_ID.ID_ShifterError.CCMsg /end MEASUREMENT
/begin MEASUREMENT CCMsg.ID_ShifterError.cCC_ID._.tmr_ID_HoldCC.f_IsExpired "test_timer" UBYTE SBW_STANDARD_S1_S3 1 100 0 255 ECU_ADDRESS 0xFFF89BB8 DISPLAY_IDENTIFIER f_IsExpired.tmr_ID_HoldCC._.cCC_ID.ID_ShifterError.CCMsg /end MEASUREMENT
/begin MEASUREMENT CCMsg.ID_ShifterError.cCC_ID._.tmr_ID_HoldCC.time "test_timer" UWORD SBW_TIMER_10MS_S1_S3 1 100 0 655350 ECU_ADDRESS 0xFFF89BB6 DISPLAY_IDENTIFIER time.tmr_ID_HoldCC._.cCC_ID.ID_ShifterError.CCMsg /end MEASUREMENT
/begin MEASUREMENT CCMsg.ID_ShifterError.cCC_ID._.tmr_ID_MinTime.f_IsExpired "test_timer" UBYTE SBW_STANDARD_S1_S3 1 100 0 255 ECU_ADDRESS 0xFFF89BB4 DISPLAY_IDENTIFIER f_IsExpired.tmr_ID_MinTime._.cCC_ID.ID_ShifterError.CCMsg /end MEASUREMENT
/begin MEASUREMENT CCMsg.ID_ShifterError.cCC_ID._.tmr_ID_MinTime.time "test_timer" UWORD SBW_TIMER_10MS_S1_S3 1 100 0 655350 ECU_ADDRESS 0xFFF89BB2 DISPLAY_IDENTIFIER time.tmr_ID_MinTime._.cCC_ID.ID_ShifterError.CCMsg /end MEASUREMENT
/begin MEASUREMENT CCMsg.ID_ShifterError.cCC_ID._.tmr_ID_delay.f_IsExpired "test_timer" UBYTE SBW_STANDARD_S1_S3 1 100 0 255 ECU_ADDRESS 0xFFF89BAC DISPLAY_IDENTIFIER f_IsExpired.tmr_ID_delay._.cCC_ID.ID_ShifterError.CCMsg /end MEASUREMENT
/begin MEASUREMENT CCMsg.ID_ShifterError.cCC_ID._.tmr_ID_delay.time "test_timer" UWORD SBW_TIMER_10MS_S1_S3 1 100 0 655350 ECU_ADDRESS 0xFFF89BAA DISPLAY_IDENTIFIER time.tmr_ID_delay._.cCC_ID.ID_ShifterError.CCMsg /end MEASUREMENT
/begin MEASUREMENT CCMsg.ID_ShifterError.f_ID_ShifterError "Flag for CC-Msgs" UBYTE SBW_STANDARD_S1_S3 1 100 0 1 BIT_MASK 0x1 ECU_ADDRESS 0xFFF89BC0 DISPLAY_IDENTIFIER f_ID_ShifterError.ID_ShifterError.CCMsg /end MEASUREMENT
/begin MEASUREMENT CCMsg.ID_ShiftlockBrakeWarning.cCC_ID._.MsgOnceSent "State of CC-ID Operating Sequence" UBYTE SBW_STANDARD_S1_S3 1 100 0 1 BIT_MASK 0x1 ECU_ADDRESS 0xFFF89AC8 DISPLAY_IDENTIFIER MsgOnceSent._.cCC_ID.ID_ShiftlockBrakeWarning.CCMsg /end MEASUREMENT
/begin MEASUREMENT CCMsg.ID_ShiftlockBrakeWarning.cCC_ID._.MyIdx "Sequential Index of the CC-ID to access tables" UBYTE SBW_STANDARD_S1_S3 1 100 1 255 ECU_ADDRESS 0xFFF89AC4 DISPLAY_IDENTIFIER MyIdx._.cCC_ID.ID_ShiftlockBrakeWarning.CCMsg /end MEASUREMENT
/begin MEASUREMENT CCMsg.ID_ShiftlockBrakeWarning.cCC_ID._.f_ID_Locked "Flag: Interlocked by other ID" UBYTE SBW_STANDARD_S1_S3 1 100 0 1 BIT_MASK 0x1 ECU_ADDRESS 0xFFF89AC5 DISPLAY_IDENTIFIER f_ID_Locked._.cCC_ID.ID_ShiftlockBrakeWarning.CCMsg /end MEASUREMENT
/begin MEASUREMENT CCMsg.ID_ShiftlockBrakeWarning.cCC_ID._.f_ID_Reset "Flag: Premature Reset" UBYTE SBW_STANDARD_S1_S3 1 100 0 1 BIT_MASK 0x1 ECU_ADDRESS 0xFFF89AC6 DISPLAY_IDENTIFIER f_ID_Reset._.cCC_ID.ID_ShiftlockBrakeWarning.CCMsg /end MEASUREMENT
/begin MEASUREMENT CCMsg.ID_ShiftlockBrakeWarning.cCC_ID._.st_ID "State of CC-ID Operating Sequence" UBYTE SBW_STANDARD_S1_S3 1 100 1 255 ECU_ADDRESS 0xFFF89AC7 DISPLAY_IDENTIFIER st_ID._.cCC_ID.ID_ShiftlockBrakeWarning.CCMsg /end MEASUREMENT
/begin MEASUREMENT CCMsg.ID_ShiftlockBrakeWarning.cCC_ID._.tmr_ID_CycleTime.f_IsExpired "test_timer" UBYTE SBW_STANDARD_S1_S3 1 100 0 255 ECU_ADDRESS 0xFFF89AD0 DISPLAY_IDENTIFIER f_IsExpired.tmr_ID_CycleTime._.cCC_ID.ID_ShiftlockBrakeWarning.CCMsg /end MEASUREMENT
/begin MEASUREMENT CCMsg.ID_ShiftlockBrakeWarning.cCC_ID._.tmr_ID_CycleTime.time "test_timer" UWORD SBW_TIMER_10MS_S1_S3 1 100 0 655350 ECU_ADDRESS 0xFFF89ACE DISPLAY_IDENTIFIER time.tmr_ID_CycleTime._.cCC_ID.ID_ShiftlockBrakeWarning.CCMsg /end MEASUREMENT
/begin MEASUREMENT CCMsg.ID_ShiftlockBrakeWarning.cCC_ID._.tmr_ID_HoldCC.f_IsExpired "test_timer" UBYTE SBW_STANDARD_S1_S3 1 100 0 255 ECU_ADDRESS 0xFFF89AD8 DISPLAY_IDENTIFIER f_IsExpired.tmr_ID_HoldCC._.cCC_ID.ID_ShiftlockBrakeWarning.CCMsg /end MEASUREMENT
/begin MEASUREMENT CCMsg.ID_ShiftlockBrakeWarning.cCC_ID._.tmr_ID_HoldCC.time "test_timer" UWORD SBW_TIMER_10MS_S1_S3 1 100 0 655350 ECU_ADDRESS 0xFFF89AD6 DISPLAY_IDENTIFIER time.tmr_ID_HoldCC._.cCC_ID.ID_ShiftlockBrakeWarning.CCMsg /end MEASUREMENT
/begin MEASUREMENT CCMsg.ID_ShiftlockBrakeWarning.cCC_ID._.tmr_ID_MinTime.f_IsExpired "test_timer" UBYTE SBW_STANDARD_S1_S3 1 100 0 255 ECU_ADDRESS 0xFFF89AD4 DISPLAY_IDENTIFIER f_IsExpired.tmr_ID_MinTime._.cCC_ID.ID_ShiftlockBrakeWarning.CCMsg /end MEASUREMENT
/begin MEASUREMENT CCMsg.ID_ShiftlockBrakeWarning.cCC_ID._.tmr_ID_MinTime.time "test_timer" UWORD SBW_TIMER_10MS_S1_S3 1 100 0 655350 ECU_ADDRESS 0xFFF89AD2 DISPLAY_IDENTIFIER time.tmr_ID_MinTime._.cCC_ID.ID_ShiftlockBrakeWarning.CCMsg /end MEASUREMENT
/begin MEASUREMENT CCMsg.ID_ShiftlockBrakeWarning.cCC_ID._.tmr_ID_delay.f_IsExpired "test_timer" UBYTE SBW_STANDARD_S1_S3 1 100 0 255 ECU_ADDRESS 0xFFF89ACC DISPLAY_IDENTIFIER f_IsExpired.tmr_ID_delay._.cCC_ID.ID_ShiftlockBrakeWarning.CCMsg /end MEASUREMENT
/begin MEASUREMENT CCMsg.ID_ShiftlockBrakeWarning.cCC_ID._.tmr_ID_delay.time "test_timer" UWORD SBW_TIMER_10MS_S1_S3 1 100 0 655350 ECU_ADDRESS 0xFFF89ACA DISPLAY_IDENTIFIER time.tmr_ID_delay._.cCC_ID.ID_ShiftlockBrakeWarning.CCMsg /end MEASUREMENT
/begin MEASUREMENT CCMsg.ID_ShiftlockBrakeWarning.f_ID_ShiftlockBrakeWarning "Flag for CC-Msgs" UBYTE SBW_STANDARD_S1_S3 1 100 0 1 BIT_MASK 0x1 ECU_ADDRESS 0xFFF89AE0 DISPLAY_IDENTIFIER f_ID_ShiftlockBrakeWarning.ID_ShiftlockBrakeWarning.CCMsg /end MEASUREMENT
/begin MEASUREMENT CCMsg.ID_Speed2HighForDrvReqP.cCC_ID._.MsgOnceSent "State of CC-ID Operating Sequence" UBYTE SBW_STANDARD_S1_S3 1 100 0 1 BIT_MASK 0x1 ECU_ADDRESS 0xFFF89A08 DISPLAY_IDENTIFIER MsgOnceSent._.cCC_ID.ID_Speed2HighForDrvReqP.CCMsg /end MEASUREMENT
/begin MEASUREMENT CCMsg.ID_Speed2HighForDrvReqP.cCC_ID._.MyIdx "Sequential Index of the CC-ID to access tables" UBYTE SBW_STANDARD_S1_S3 1 100 1 255 ECU_ADDRESS 0xFFF89A04 DISPLAY_IDENTIFIER MyIdx._.cCC_ID.ID_Speed2HighForDrvReqP.CCMsg /end MEASUREMENT
/begin MEASUREMENT CCMsg.ID_Speed2HighForDrvReqP.cCC_ID._.f_ID_Locked "Flag: Interlocked by other ID" UBYTE SBW_STANDARD_S1_S3 1 100 0 1 BIT_MASK 0x1 ECU_ADDRESS 0xFFF89A05 DISPLAY_IDENTIFIER f_ID_Locked._.cCC_ID.ID_Speed2HighForDrvReqP.CCMsg /end MEASUREMENT
/begin MEASUREMENT CCMsg.ID_Speed2HighForDrvReqP.cCC_ID._.f_ID_Reset "Flag: Premature Reset" UBYTE SBW_STANDARD_S1_S3 1 100 0 1 BIT_MASK 0x1 ECU_ADDRESS 0xFFF89A06 DISPLAY_IDENTIFIER f_ID_Reset._.cCC_ID.ID_Speed2HighForDrvReqP.CCMsg /end MEASUREMENT
/begin MEASUREMENT CCMsg.ID_Speed2HighForDrvReqP.cCC_ID._.st_ID "State of CC-ID Operating Sequence" UBYTE SBW_STANDARD_S1_S3 1 100 1 255 ECU_ADDRESS 0xFFF89A07 DISPLAY_IDENTIFIER st_ID._.cCC_ID.ID_Speed2HighForDrvReqP.CCMsg /end MEASUREMENT
/begin MEASUREMENT CCMsg.ID_Speed2HighForDrvReqP.cCC_ID._.tmr_ID_CycleTime.f_IsExpired "test_timer" UBYTE SBW_STANDARD_S1_S3 1 100 0 255 ECU_ADDRESS 0xFFF89A10 DISPLAY_IDENTIFIER f_IsExpired.tmr_ID_CycleTime._.cCC_ID.ID_Speed2HighForDrvReqP.CCMsg /end MEASUREMENT
/begin MEASUREMENT CCMsg.ID_Speed2HighForDrvReqP.cCC_ID._.tmr_ID_CycleTime.time "test_timer" UWORD SBW_TIMER_10MS_S1_S3 1 100 0 655350 ECU_ADDRESS 0xFFF89A0E DISPLAY_IDENTIFIER time.tmr_ID_CycleTime._.cCC_ID.ID_Speed2HighForDrvReqP.CCMsg /end MEASUREMENT
/begin MEASUREMENT CCMsg.ID_Speed2HighForDrvReqP.cCC_ID._.tmr_ID_HoldCC.f_IsExpired "test_timer" UBYTE SBW_STANDARD_S1_S3 1 100 0 255 ECU_ADDRESS 0xFFF89A18 DISPLAY_IDENTIFIER f_IsExpired.tmr_ID_HoldCC._.cCC_ID.ID_Speed2HighForDrvReqP.CCMsg /end MEASUREMENT
/begin MEASUREMENT CCMsg.ID_Speed2HighForDrvReqP.cCC_ID._.tmr_ID_HoldCC.time "test_timer" UWORD SBW_TIMER_10MS_S1_S3 1 100 0 655350 ECU_ADDRESS 0xFFF89A16 DISPLAY_IDENTIFIER time.tmr_ID_HoldCC._.cCC_ID.ID_Speed2HighForDrvReqP.CCMsg /end MEASUREMENT
/begin MEASUREMENT CCMsg.ID_Speed2HighForDrvReqP.cCC_ID._.tmr_ID_MinTime.f_IsExpired "test_timer" UBYTE SBW_STANDARD_S1_S3 1 100 0 255 ECU_ADDRESS 0xFFF89A14 DISPLAY_IDENTIFIER f_IsExpired.tmr_ID_MinTime._.cCC_ID.ID_Speed2HighForDrvReqP.CCMsg /end MEASUREMENT
/begin MEASUREMENT CCMsg.ID_Speed2HighForDrvReqP.cCC_ID._.tmr_ID_MinTime.time "test_timer" UWORD SBW_TIMER_10MS_S1_S3 1 100 0 655350 ECU_ADDRESS 0xFFF89A12 DISPLAY_IDENTIFIER time.tmr_ID_MinTime._.cCC_ID.ID_Speed2HighForDrvReqP.CCMsg /end MEASUREMENT
/begin MEASUREMENT CCMsg.ID_Speed2HighForDrvReqP.cCC_ID._.tmr_ID_delay.f_IsExpired "test_timer" UBYTE SBW_STANDARD_S1_S3 1 100 0 255 ECU_ADDRESS 0xFFF89A0C DISPLAY_IDENTIFIER f_IsExpired.tmr_ID_delay._.cCC_ID.ID_Speed2HighForDrvReqP.CCMsg /end MEASUREMENT
/begin MEASUREMENT CCMsg.ID_Speed2HighForDrvReqP.cCC_ID._.tmr_ID_delay.time "test_timer" UWORD SBW_TIMER_10MS_S1_S3 1 100 0 655350 ECU_ADDRESS 0xFFF89A0A DISPLAY_IDENTIFIER time.tmr_ID_delay._.cCC_ID.ID_Speed2HighForDrvReqP.CCMsg /end MEASUREMENT
/begin MEASUREMENT CCMsg.ID_Speed2HighForDrvReqP.f_ID_Speed2HighForDrvReqP "Flag for CC-Msgs" UBYTE SBW_STANDARD_S1_S3 1 100 0 1 BIT_MASK 0x1 ECU_ADDRESS 0xFFF89A20 DISPLAY_IDENTIFIER f_ID_Speed2HighForDrvReqP.ID_Speed2HighForDrvReqP.CCMsg /end MEASUREMENT
/begin MEASUREMENT CCMsg.ID_Speed2HighInPosP.cCC_ID._.MsgOnceSent "State of CC-ID Operating Sequence" UBYTE SBW_STANDARD_S1_S3 1 100 0 1 BIT_MASK 0x1 ECU_ADDRESS 0xFFF89A28 DISPLAY_IDENTIFIER MsgOnceSent._.cCC_ID.ID_Speed2HighInPosP.CCMsg /end MEASUREMENT
/begin MEASUREMENT CCMsg.ID_Speed2HighInPosP.cCC_ID._.MyIdx "Sequential Index of the CC-ID to access tables" UBYTE SBW_STANDARD_S1_S3 1 100 1 255 ECU_ADDRESS 0xFFF89A24 DISPLAY_IDENTIFIER MyIdx._.cCC_ID.ID_Speed2HighInPosP.CCMsg /end MEASUREMENT
/begin MEASUREMENT CCMsg.ID_Speed2HighInPosP.cCC_ID._.f_ID_Locked "Flag: Interlocked by other ID" UBYTE SBW_STANDARD_S1_S3 1 100 0 1 BIT_MASK 0x1 ECU_ADDRESS 0xFFF89A25 DISPLAY_IDENTIFIER f_ID_Locked._.cCC_ID.ID_Speed2HighInPosP.CCMsg /end MEASUREMENT
/begin MEASUREMENT CCMsg.ID_Speed2HighInPosP.cCC_ID._.f_ID_Reset "Flag: Premature Reset" UBYTE SBW_STANDARD_S1_S3 1 100 0 1 BIT_MASK 0x1 ECU_ADDRESS 0xFFF89A26 DISPLAY_IDENTIFIER f_ID_Reset._.cCC_ID.ID_Speed2HighInPosP.CCMsg /end MEASUREMENT
/begin MEASUREMENT CCMsg.ID_Speed2HighInPosP.cCC_ID._.st_ID "State of CC-ID Operating Sequence" UBYTE SBW_STANDARD_S1_S3 1 100 1 255 ECU_ADDRESS 0xFFF89A27 DISPLAY_IDENTIFIER st_ID._.cCC_ID.ID_Speed2HighInPosP.CCMsg /end MEASUREMENT
/begin MEASUREMENT CCMsg.ID_Speed2HighInPosP.cCC_ID._.tmr_ID_CycleTime.f_IsExpired "test_timer" UBYTE SBW_STANDARD_S1_S3 1 100 0 255 ECU_ADDRESS 0xFFF89A30 DISPLAY_IDENTIFIER f_IsExpired.tmr_ID_CycleTime._.cCC_ID.ID_Speed2HighInPosP.CCMsg /end MEASUREMENT
/begin MEASUREMENT CCMsg.ID_Speed2HighInPosP.cCC_ID._.tmr_ID_CycleTime.time "test_timer" UWORD SBW_TIMER_10MS_S1_S3 1 100 0 655350 ECU_ADDRESS 0xFFF89A2E DISPLAY_IDENTIFIER time.tmr_ID_CycleTime._.cCC_ID.ID_Speed2HighInPosP.CCMsg /end MEASUREMENT
/begin MEASUREMENT CCMsg.ID_Speed2HighInPosP.cCC_ID._.tmr_ID_HoldCC.f_IsExpired "test_timer" UBYTE SBW_STANDARD_S1_S3 1 100 0 255 ECU_ADDRESS 0xFFF89A38 DISPLAY_IDENTIFIER f_IsExpired.tmr_ID_HoldCC._.cCC_ID.ID_Speed2HighInPosP.CCMsg /end MEASUREMENT
/begin MEASUREMENT CCMsg.ID_Speed2HighInPosP.cCC_ID._.tmr_ID_HoldCC.time "test_timer" UWORD SBW_TIMER_10MS_S1_S3 1 100 0 655350 ECU_ADDRESS 0xFFF89A36 DISPLAY_IDENTIFIER time.tmr_ID_HoldCC._.cCC_ID.ID_Speed2HighInPosP.CCMsg /end MEASUREMENT
/begin MEASUREMENT CCMsg.ID_Speed2HighInPosP.cCC_ID._.tmr_ID_MinTime.f_IsExpired "test_timer" UBYTE SBW_STANDARD_S1_S3 1 100 0 255 ECU_ADDRESS 0xFFF89A34 DISPLAY_IDENTIFIER f_IsExpired.tmr_ID_MinTime._.cCC_ID.ID_Speed2HighInPosP.CCMsg /end MEASUREMENT
/begin MEASUREMENT CCMsg.ID_Speed2HighInPosP.cCC_ID._.tmr_ID_MinTime.time "test_timer" UWORD SBW_TIMER_10MS_S1_S3 1 100 0 655350 ECU_ADDRESS 0xFFF89A32 DISPLAY_IDENTIFIER time.tmr_ID_MinTime._.cCC_ID.ID_Speed2HighInPosP.CCMsg /end MEASUREMENT
/begin MEASUREMENT CCMsg.ID_Speed2HighInPosP.cCC_ID._.tmr_ID_delay.f_IsExpired "test_timer" UBYTE SBW_STANDARD_S1_S3 1 100 0 255 ECU_ADDRESS 0xFFF89A2C DISPLAY_IDENTIFIER f_IsExpired.tmr_ID_delay._.cCC_ID.ID_Speed2HighInPosP.CCMsg /end MEASUREMENT
/begin MEASUREMENT CCMsg.ID_Speed2HighInPosP.cCC_ID._.tmr_ID_delay.time "test_timer" UWORD SBW_TIMER_10MS_S1_S3 1 100 0 655350 ECU_ADDRESS 0xFFF89A2A DISPLAY_IDENTIFIER time.tmr_ID_delay._.cCC_ID.ID_Speed2HighInPosP.CCMsg /end MEASUREMENT
/begin MEASUREMENT CCMsg.ID_Speed2HighInPosP.f_ID_Speed2HighInPosP "Flag for CC-Msgs" UBYTE SBW_STANDARD_S1_S3 1 100 0 1 BIT_MASK 0x1 ECU_ADDRESS 0xFFF89A40 DISPLAY_IDENTIFIER f_ID_Speed2HighInPosP.ID_Speed2HighInPosP.CCMsg /end MEASUREMENT
/begin MEASUREMENT CCMsg.ID_V_ImplausibleInPosP.cCC_ID._.MsgOnceSent "State of CC-ID Operating Sequence" UBYTE SBW_STANDARD_S1_S3 1 100 0 1 BIT_MASK 0x1 ECU_ADDRESS 0xFFF89C48 DISPLAY_IDENTIFIER MsgOnceSent._.cCC_ID.ID_V_ImplausibleInPosP.CCMsg /end MEASUREMENT
/begin MEASUREMENT CCMsg.ID_V_ImplausibleInPosP.cCC_ID._.MyIdx "Sequential Index of the CC-ID to access tables" UBYTE SBW_STANDARD_S1_S3 1 100 1 255 ECU_ADDRESS 0xFFF89C44 DISPLAY_IDENTIFIER MyIdx._.cCC_ID.ID_V_ImplausibleInPosP.CCMsg /end MEASUREMENT
/begin MEASUREMENT CCMsg.ID_V_ImplausibleInPosP.cCC_ID._.f_ID_Locked "Flag: Interlocked by other ID" UBYTE SBW_STANDARD_S1_S3 1 100 0 1 BIT_MASK 0x1 ECU_ADDRESS 0xFFF89C45 DISPLAY_IDENTIFIER f_ID_Locked._.cCC_ID.ID_V_ImplausibleInPosP.CCMsg /end MEASUREMENT
/begin MEASUREMENT CCMsg.ID_V_ImplausibleInPosP.cCC_ID._.f_ID_Reset "Flag: Premature Reset" UBYTE SBW_STANDARD_S1_S3 1 100 0 1 BIT_MASK 0x1 ECU_ADDRESS 0xFFF89C46 DISPLAY_IDENTIFIER f_ID_Reset._.cCC_ID.ID_V_ImplausibleInPosP.CCMsg /end MEASUREMENT
/begin MEASUREMENT CCMsg.ID_V_ImplausibleInPosP.cCC_ID._.st_ID "State of CC-ID Operating Sequence" UBYTE SBW_STANDARD_S1_S3 1 100 1 255 ECU_ADDRESS 0xFFF89C47 DISPLAY_IDENTIFIER st_ID._.cCC_ID.ID_V_ImplausibleInPosP.CCMsg /end MEASUREMENT
/begin MEASUREMENT CCMsg.ID_V_ImplausibleInPosP.cCC_ID._.tmr_ID_CycleTime.f_IsExpired "test_timer" UBYTE SBW_STANDARD_S1_S3 1 100 0 255 ECU_ADDRESS 0xFFF89C50 DISPLAY_IDENTIFIER f_IsExpired.tmr_ID_CycleTime._.cCC_ID.ID_V_ImplausibleInPosP.CCMsg /end MEASUREMENT
/begin MEASUREMENT CCMsg.ID_V_ImplausibleInPosP.cCC_ID._.tmr_ID_CycleTime.time "test_timer" UWORD SBW_TIMER_10MS_S1_S3 1 100 0 655350 ECU_ADDRESS 0xFFF89C4E DISPLAY_IDENTIFIER time.tmr_ID_CycleTime._.cCC_ID.ID_V_ImplausibleInPosP.CCMsg /end MEASUREMENT
/begin MEASUREMENT CCMsg.ID_V_ImplausibleInPosP.cCC_ID._.tmr_ID_HoldCC.f_IsExpired "test_timer" UBYTE SBW_STANDARD_S1_S3 1 100 0 255 ECU_ADDRESS 0xFFF89C58 DISPLAY_IDENTIFIER f_IsExpired.tmr_ID_HoldCC._.cCC_ID.ID_V_ImplausibleInPosP.CCMsg /end MEASUREMENT
/begin MEASUREMENT CCMsg.ID_V_ImplausibleInPosP.cCC_ID._.tmr_ID_HoldCC.time "test_timer" UWORD SBW_TIMER_10MS_S1_S3 1 100 0 655350 ECU_ADDRESS 0xFFF89C56 DISPLAY_IDENTIFIER time.tmr_ID_HoldCC._.cCC_ID.ID_V_ImplausibleInPosP.CCMsg /end MEASUREMENT
/begin MEASUREMENT CCMsg.ID_V_ImplausibleInPosP.cCC_ID._.tmr_ID_MinTime.f_IsExpired "test_timer" UBYTE SBW_STANDARD_S1_S3 1 100 0 255 ECU_ADDRESS 0xFFF89C54 DISPLAY_IDENTIFIER f_IsExpired.tmr_ID_MinTime._.cCC_ID.ID_V_ImplausibleInPosP.CCMsg /end MEASUREMENT
/begin MEASUREMENT CCMsg.ID_V_ImplausibleInPosP.cCC_ID._.tmr_ID_MinTime.time "test_timer" UWORD SBW_TIMER_10MS_S1_S3 1 100 0 655350 ECU_ADDRESS 0xFFF89C52 DISPLAY_IDENTIFIER time.tmr_ID_MinTime._.cCC_ID.ID_V_ImplausibleInPosP.CCMsg /end MEASUREMENT
/begin MEASUREMENT CCMsg.ID_V_ImplausibleInPosP.cCC_ID._.tmr_ID_delay.f_IsExpired "test_timer" UBYTE SBW_STANDARD_S1_S3 1 100 0 255 ECU_ADDRESS 0xFFF89C4C DISPLAY_IDENTIFIER f_IsExpired.tmr_ID_delay._.cCC_ID.ID_V_ImplausibleInPosP.CCMsg /end MEASUREMENT
/begin MEASUREMENT CCMsg.ID_V_ImplausibleInPosP.cCC_ID._.tmr_ID_delay.time "test_timer" UWORD SBW_TIMER_10MS_S1_S3 1 100 0 655350 ECU_ADDRESS 0xFFF89C4A DISPLAY_IDENTIFIER time.tmr_ID_delay._.cCC_ID.ID_V_ImplausibleInPosP.CCMsg /end MEASUREMENT
/begin MEASUREMENT CCMsg.ID_V_ImplausibleInPosP.f_ID_V_ImplausibleInPosP "Flag for CC-Msgs" UBYTE SBW_STANDARD_S1_S3 1 100 0 1 BIT_MASK 0x1 ECU_ADDRESS 0xFFF89C60 DISPLAY_IDENTIFIER f_ID_V_ImplausibleInPosP.ID_V_ImplausibleInPosP.CCMsg /end MEASUREMENT
/begin MEASUREMENT CCMsgBPRAM.Bitmask_MsgSendHigh_Buf "Higher bitmask of cc message send (32-39)" UBYTE SBW_STANDARD_S1_S3 1 100 0 255 ECU_ADDRESS 0xFFF835EC DISPLAY_IDENTIFIER Bitmask_MsgSendHigh_Buf.CCMsgBPRAM /end MEASUREMENT
/begin MEASUREMENT CCMsgBPRAM.Bitmask_MsgSendHigh_Buf_ "Complement of higher bitmask of cc message send (32-39)" UBYTE SBW_STANDARD_S1_S3 1 100 0 255 ECU_ADDRESS 0xFFF835ED DISPLAY_IDENTIFIER Bitmask_MsgSendHigh_Buf_.CCMsgBPRAM /end MEASUREMENT
/begin MEASUREMENT CCMsgBPRAM.Bitmask_MsgSendLow_Buf "Lower bitmask of cc message send (0-31)" ULONG SBW_STANDARD_S1_S3 1 100 0 4294967295 ECU_ADDRESS 0xFFF835E4 DISPLAY_IDENTIFIER Bitmask_MsgSendLow_Buf.CCMsgBPRAM /end MEASUREMENT
/begin MEASUREMENT CCMsgBPRAM.Bitmask_MsgSendLow_Buf_ "Complement of lower bitmask of cc message send (0-31)" ULONG SBW_STANDARD_S1_S3 1 100 0 4294967295 ECU_ADDRESS 0xFFF835E8 DISPLAY_IDENTIFIER Bitmask_MsgSendLow_Buf_.CCMsgBPRAM /end MEASUREMENT
/begin MEASUREMENT CONTROL_DMRS_PRUEFUNG "" UWORD _CNV_S_3_Enum_ECONT_267_CM_S2 1 0 0 2 ECU_ADDRESS 0xFFF8E476 /end MEASUREMENT
/begin MEASUREMENT CONTROL_EIN_NAB_BAB "" UWORD _CNV_S_2_Enum_ECONT_43_CM_S2 1 0 0 1 ECU_ADDRESS 0xFFF8E428 /end MEASUREMENT
/begin MEASUREMENT CONTROL_GV "" UWORD _CNV_S_3_Enum_EGV_195_CM_S2 1 0 0 2 ECU_ADDRESS 0xFFF8E222 /end MEASUREMENT
/begin MEASUREMENT CONTROL_KFE "" UWORD _CNV_S_4_Enum_EGB_56_CM_S2 1 0 0 3 ECU_ADDRESS 0xFFF8E876 /end MEASUREMENT
/begin MEASUREMENT CONTROL_QSHIFT_GWFP1 "" UWORD _CNV_S_3_Enum_EQSHI_170_CM_S2 1 0 0 2 ECU_ADDRESS 0xFFF8E76C /end MEASUREMENT
/begin MEASUREMENT CONTROL_QSHIFT_GWFP2 "" UWORD _CNV_S_3_Enum_EQSHI_170_CM_S2 1 0 0 2 ECU_ADDRESS 0xFFF8E76E /end MEASUREMENT
/begin MEASUREMENT CONTROL_QSHIFT_MFRS "" UWORD _CNV_S_3_Enum_EQSHI_170_CM_S2 1 0 0 2 ECU_ADDRESS 0xFFF8E770 /end MEASUREMENT
/begin MEASUREMENT CONTROL_RSZ_BAB "" UWORD _CNV_S_3_Enum_ECONT_44_CM_S2 1 0 0 2 ECU_ADDRESS 0xFFF8E846 /end MEASUREMENT
/begin MEASUREMENT CONTROL_USESERP_BGH "" UWORD _CNV_R_R_Umr_1_zu_1_2_CM_S2 1 0 0 1 ECU_ADDRESS 0xFFF8E436 /end MEASUREMENT
/begin AXIS_PTS SSTSKL_A1 "" 0x1DD0F0 W_DKKD _REC_A2AXS_31_u2_S2 120 _CNV_R_R_Umr_10_zu__9_CM_S2 15 0 120 DEPOSIT ABSOLUTE FORMAT "%3.1" /end AXIS_PTS
/begin AXIS_PTS SSTSKL_A2 "" 0x1DD110 W_DKKD _REC_A2AXS_31_u2_S2 120 _CNV_R_R_Umr_10_zu__9_CM_S2 15 0 120 DEPOSIT ABSOLUTE FORMAT "%3.1" /end AXIS_PTS
/begin AXIS_PTS SSTSKL_A3 "" 0x1DD130 W_DKKD _REC_A2AXS_31_u2_S2 120 _CNV_R_R_Umr_10_zu__9_CM_S2 15 0 120 DEPOSIT ABSOLUTE FORMAT "%3.1" /end AXIS_PTS
/begin AXIS_PTS SSTSKL_A4 "" 0x1DD150 W_DKKD _REC_A2AXS_31_u2_S2 120 _CNV_R_R_Umr_10_zu__9_CM_S2 15 0 120 DEPOSIT ABSOLUTE FORMAT "%3.1" /end AXIS_PTS
/begin AXIS_PTS SSTSKL_A5 "" 0x1DD170 W_DKKD _REC_A2AXS_31_u2_S2 120 _CNV_R_R_Umr_10_zu__9_CM_S2 15 0 120 DEPOSIT ABSOLUTE FORMAT "%3.1" /end AXIS_PTS
/begin FUNCTION zff_EH_Obd "desc_en"
 /begin IN_MEASUREMENT ZFEH_EepromData.di_obd_iumpr_comp_active_count[0] ZFEH_EepromData.di_obd_iumpr_comp_active_count[100] ZFEH_EepromData.di_obd_iumpr_comp_active_count[101] ZFEH_EepromData.di_obd_iumpr_comp_active_count[102] ZFEH_EepromData.di_obd_iumpr_comp_active_count[103] ZFEH_EepromData.di_obd_iumpr_comp_active_count[104] ZFEH_EepromData.di_obd_iumpr_comp_active_count[105] ZFEH_EepromData.di_obd_iumpr_comp_active_count[106] ZFEH_EepromData.di_obd_iumpr_comp_active_count[107] ZFEH_EepromData.di_obd_iumpr_comp_active_count[108] ZFEH_EepromData.di_obd_iumpr_comp_active_count[109] ZFEH_EepromData.di_obd_iumpr_comp_active_count[10] ZFEH_EepromData.di_obd_iumpr_comp_active_count[110] ZFEH_EepromData.di_obd_iumpr_comp_active_count[111] ZFEH_EepromData.di_obd_iumpr_comp_active_count[112] ZFEH_EepromData.di_obd_iumpr_comp_active_count[113] ZFEH_EepromData.di_obd_iumpr_comp_active_count[114] ZFEH_EepromData.di_obd_iumpr_comp_active_count[115] ZFEH_EepromData.di_obd_iumpr_comp_active_count[116] ZFEH_EepromData.di_obd_iumpr_comp_active_count[117] ZFEH_EepromData.di_obd_iumpr_comp_active_count[118] ZFEH_EepromData.di_obd_iumpr_comp_active_count[119] ZFEH_EepromData.di_obd_iumpr_comp_active_count[11] ZFEH_EepromData.di_obd_iumpr_comp_active_count[120] ZFEH_EepromData.di_obd_iumpr_comp_active_count[121] ZFEH_EepromData.di_obd_iumpr_comp_active_count[122] ZFEH_EepromData.di_obd_iumpr_comp_active_count[123] ZFEH_EepromData.di_obd_iumpr_comp_active_count[124] ZFEH_EepromData.di_obd_iumpr_comp_active_count[125] ZFEH_EepromData.di_obd_iumpr_comp_active_count[126] ZFEH_EepromData.di_obd_iumpr_comp_active_count[127] ZFEH_EepromData.di_obd_iumpr_comp_active_count[128] ZFEH_EepromData.di_obd_iumpr_comp_active_count[129] ZFEH_EepromData.di_obd_iumpr_comp_active_count[12] ZFEH_EepromData.di_obd_iumpr_comp_active_count[130] ZFEH_EepromData.di_obd_iumpr_comp_active_count[131] ZFEH_EepromData.di_obd_iumpr_comp_active_count[132] ZFEH_EepromData.di_obd_iumpr_comp_active_count[133] ZFEH_EepromData.di_obd_iumpr_comp_active_count[134] ZFEH_EepromData.di_obd_iumpr_comp_active_count[135] ZFEH_EepromData.di_obd_iumpr_comp_active_count[136] ZFEH_EepromData.di_obd_iumpr_comp_active_count[137] ZFEH_EepromData.di_obd_iumpr_comp_active_count[138] ZFEH_EepromData.di_obd_iumpr_comp_active_count[139] ZFEH_EepromData.di_obd_iumpr_comp_active_count[13] ZFEH_EepromData.di_obd_iumpr_comp_active_count[140] ZFEH_EepromData.di_obd_iumpr_comp_active_count[141] ZFEH_EepromData.di_obd_iumpr_comp_active_count[142] ZFEH_EepromData.di_obd_iumpr_comp_active_count[143] ZFEH_EepromData.di_obd_iumpr_comp_active_count[144] ZFEH_EepromData.di_obd_iumpr_comp_active_count[145] ZFEH_EepromData.di_obd_iumpr_comp_active_count[146] ZFEH_EepromData.di_obd_iumpr_comp_active_count[147] ZFEH_EepromData.di_obd_iumpr_comp_active_count[148] ZFEH_EepromData.di_obd_iumpr_comp_active_count[149] ZFEH_EepromData.di_obd_iumpr_comp_active_count[14] ZFEH_EepromData.di_obd_iumpr_comp_active_count[150] ZFEH_EepromData.di_obd_iumpr_comp_active_count[151] ZFEH_EepromData.di_obd_iumpr_comp_active_count[152] ZFEH_EepromData.di_obd_iumpr_comp_active_count[153] ZFEH_EepromData.di_obd_iumpr_comp_active_count[154] ZFEH_EepromData.di_obd_iumpr_comp_active_count[155] ZFEH_EepromData.di_obd_iumpr_comp_active_count[156] ZFEH_EepromData.di_obd_iumpr_comp_active_count[157] ZFEH_EepromData.di_obd_iumpr_comp_active_count[158] ZFEH_EepromData.di_obd_iumpr_comp_active_count[159] ZFEH_EepromData.di_obd_iumpr_comp_active_count[15] ZFEH_EepromData.di_obd_iumpr_comp_active_count[160] ZFEH_EepromData.di_obd_iumpr_comp_active_count[161] ZFEH_EepromData.di_obd_iumpr_comp_active_count[162] ZFEH_EepromData.di_obd_iumpr_comp_active_count[163] ZFEH_EepromData.di_obd_iumpr_comp_active_count[164] ZFEH_EepromData.di_obd_iumpr_comp_active_count[165] ZFEH_EepromData.di_obd_iumpr_comp_active_count[166] ZFEH_EepromData.di_obd_iumpr_comp_active_count[167] ZFEH_EepromData.di_obd_iumpr_comp_active_count[168] ZFEH_EepromData.di_obd_iumpr_comp_active_count[169] ZFEH_EepromData.di_obd_iumpr_comp_active_count[16] ZFEH_EepromData.di_obd_iumpr_comp_active_count[170] ZFEH_EepromData.di_obd_iumpr_comp_active_count[171] ZFEH_EepromData.di_obd_iumpr_comp_active_count[172] ZFEH_EepromData.di_obd_iumpr_comp_active_count[173] ZFEH_EepromData.di_obd_iumpr_comp_active_count[174] ZFEH_EepromData.di_obd_iumpr_comp_active_count[175] ZFEH_EepromData.di_obd_iumpr_comp_active_count[176] ZFEH_EepromData.di_obd_iumpr_comp_active_count[177] ZFEH_EepromData.di_obd_iumpr_comp_active_count[178] ZFEH_EepromData.di_obd_iumpr_comp_active_count[179] ZFEH_EepromData.di_obd_iumpr_comp_active_count[17] ZFEH_EepromData.di_obd_iumpr_comp_active_count[180] ZFEH_EepromData.di_obd_iumpr_comp_active_count[181] ZFEH_EepromData.di_obd_iumpr_comp_active_count[182] ZFEH_EepromData.di_obd_iumpr_comp_active_count[183] ZFEH_EepromData.di_obd_iumpr_comp_active_count[184] ZFEH_EepromData.di_obd_iumpr_comp_active_count[185] ZFEH_EepromData.di_obd_iumpr_comp_active_count[186] ZFEH_EepromData.di_obd_iumpr_comp_active_count[187] ZFEH_EepromData.di_obd_iumpr_comp_active_count[188] ZFEH_EepromData.di_obd_iumpr_comp_active_count[189] ZFEH_EepromData.di_obd_iumpr_comp_active_count[18] ZFEH_EepromData.di_obd_iumpr_comp_active_count[190] ZFEH_EepromData.di_obd_iumpr_comp_active_count[191] ZFEH_EepromData.di_obd_iumpr_comp_active_count[192] ZFEH_EepromData.di_obd_iumpr_comp_active_count[193] ZFEH_EepromData.di_obd_iumpr_comp_active_count[194] ZFEH_EepromData.di_obd_iumpr_comp_active_count[195] ZFEH_EepromData.di_obd_iumpr_comp_active_count[196] ZFEH_EepromData.di_obd_iumpr_comp_active_count[197] ZFEH_EepromData.di_obd_iumpr_comp_active_count[198] ZFEH_EepromData.di_obd_iumpr_comp_active_count[199] ZFEH_EepromData.di_obd_iumpr_comp_active_count[19] ZFEH_EepromData.di_obd_iumpr_comp_active_count[1] ZFEH_EepromData.di_obd_iumpr_comp_active_count[200] ZFEH_EepromData.di_obd_iumpr_comp_active_count[201] ZFEH_EepromData.di_obd_iumpr_comp_active_count[202] ZFEH_EepromData.di_obd_iumpr_comp_active_count[203] ZFEH_EepromData.di_obd_iumpr_comp_active_count[204] ZFEH_EepromData.di_obd_iumpr_comp_active_count[205] ZFEH_EepromData.di_obd_iumpr_comp_active_count[206] ZFEH_EepromData.di_obd_iumpr_comp_active_count[207] ZFEH_EepromData.di_obd_iumpr_comp_active_count[208] ZFEH_EepromData.di_obd_iumpr_comp_active_count[209] ZFEH_EepromData.di_obd_iumpr_comp_active_count[20] ZFEH_EepromData.di_obd_iumpr_comp_active_count[210] ZFEH_EepromData.di_obd_iumpr_comp_active_count[211] ZFEH_EepromData.di_obd_iumpr_comp_active_count[212] ZFEH_EepromData.di_obd_iumpr_comp_active_count[213] ZFEH_EepromData.di_obd_iumpr_comp_active_count[214] ZFEH_EepromData.di_obd_iumpr_comp_active_count[215] ZFEH_EepromData.di_obd_iumpr_comp_active_count[216] ZFEH_EepromData.di_obd_iumpr_comp_active_count[217] ZFEH_EepromData.di_obd_iumpr_comp_active_count[218] ZFEH_EepromData.di_obd_iumpr_comp_active_count[219] ZFEH_EepromData.di_obd_iumpr_comp_active_count[21] ZFEH_EepromData.di_obd_iumpr_comp_active_count[220] ZFEH_EepromData.di_obd_iumpr_comp_active_count[221] ZFEH_EepromData.di_obd_iumpr_comp_active_count[222] ZFEH_EepromData.di_obd_iumpr_comp_active_count[223] ZFEH_EepromData.di_obd_iumpr_comp_active_count[224] ZFEH_EepromData.di_obd_iumpr_comp_active_count[225] ZFEH_EepromData.di_obd_iumpr_comp_active_count[226] ZFEH_EepromData.di_obd_iumpr_comp_active_count[227] ZFEH_EepromData.di_obd_iumpr_comp_active_count[228] ZFEH_EepromData.di_obd_iumpr_comp_active_count[229] ZFEH_EepromData.di_obd_iumpr_comp_active_count[22] ZFEH_EepromData.di_obd_iumpr_comp_active_count[230] ZFEH_EepromData.di_obd_iumpr_comp_active_count[231] ZFEH_EepromData.di_obd_iumpr_comp_active_count[232] ZFEH_EepromData.di_obd_iumpr_comp_active_count[233] ZFEH_EepromData.di_obd_iumpr_comp_active_count[234] ZFEH_EepromData.di_obd_iumpr_comp_active_count[235] ZFEH_EepromData.di_obd_iumpr_comp_active_count[236] ZFEH_EepromData.di_obd_iumpr_comp_active_count[237] ZFEH_EepromData.di_obd_iumpr_comp_active_count[238] ZFEH_EepromData.di_obd_iumpr_comp_active_count[239] ZFEH_EepromData.di_obd_iumpr_comp_active_count[23] ZFEH_EepromData.di_obd_iumpr_comp_active_count[240] ZFEH_EepromData.di_obd_iumpr_comp_active_count[241] ZFEH_EepromData.di_obd_iumpr_comp_active_count[242] ZFEH_EepromData.di_obd_iumpr_comp_active_count[243] ZFEH_EepromData.di_obd_iumpr_comp_active_count[244] ZFEH_EepromData.di_obd_iumpr_comp_active_count[245] ZFEH_EepromData.di_obd_iumpr_comp_active_count[246] ZFEH_EepromData.di_obd_iumpr_comp_active_count[247] ZFEH_EepromData.di_obd_iumpr_comp_active_count[248] ZFEH_EepromData.di_obd_iumpr_comp_active_count[249] ZFEH_EepromData.di_obd_iumpr_comp_active_count[24] ZFEH_EepromData.di_obd_iumpr_comp_active_count[250] ZFEH_EepromData.di_obd_iumpr_comp_active_count[251] ZFEH_EepromData.di_obd_iumpr_comp_active_count[252] ZFEH_EepromData.di_obd_iumpr_comp_active_count[253] ZFEH_EepromData.di_obd_iumpr_comp_active_count[25] ZFEH_EepromData.di_obd_iumpr_comp_active_count[26] ZFEH_EepromData.di_obd_iumpr_comp_active_count[27] ZFEH_EepromData.di_obd_iumpr_comp_active_count[28] ZFEH_EepromData.di_obd_iumpr_comp_active_count[29] ZFEH_EepromData.di_obd_iumpr_comp_active_count[2] ZFEH_EepromData.di_obd_iumpr_comp_active_count[30] ZFEH_EepromData.di_obd_iumpr_comp_active_count[31] ZFEH_EepromData.di_obd_iumpr_comp_active_count[32] ZFEH_EepromData.di_obd_iumpr_comp_active_count[33] ZFEH_EepromData.di_obd_iumpr_comp_active_count[34] ZFEH_EepromData.di_obd_iumpr_comp_active_count[35] ZFEH_EepromData.di_obd_iumpr_comp_active_count[36] ZFEH_EepromData.di_obd_iumpr_comp_active_count[37] ZFEH_EepromData.di_obd_iumpr_comp_active_count[38] ZFEH_EepromData.di_obd_iumpr_comp_active_count[39] ZFEH_EepromData.di_obd_iumpr_comp_active_count[3] ZFEH_EepromData.di_obd_iumpr_comp_active_count[40] ZFEH_EepromData.di_obd_iumpr_comp_active_count[41] ZFEH_EepromData.di_obd_iumpr_comp_active_count[42] ZFEH_EepromData.di_obd_iumpr_comp_active_count[43] ZFEH_EepromData.di_obd_iumpr_comp_active_count[44] ZFEH_EepromData.di_obd_iumpr_comp_active_count[45] ZFEH_EepromData.di_obd_iumpr_comp_active_count[46] ZFEH_EepromData.di_obd_iumpr_comp_active_count[47] ZFEH_EepromData.di_obd_iumpr_comp_active_count[48] ZFEH_EepromData.di_obd_iumpr_comp_active_count[49] ZFEH_EepromData.di_obd_iumpr_comp_active_count[4] ZFEH_EepromData.di_obd_iumpr_comp_active_count[50] ZFEH_EepromData.di_obd_iumpr_comp_active_count[51] ZFEH_EepromData.di_obd_iumpr_comp_active_count[52] ZFEH_EepromData.di_obd_iumpr_comp_active_count[53] ZFEH_EepromData.di_obd_iumpr_comp_active_count[54] ZFEH_EepromData.di_obd_iumpr_comp_active_count[55] ZFEH_EepromData.di_obd_iumpr_comp_active_count[56] ZFEH_EepromData.di_obd_iumpr_comp_active_count[57] ZFEH_EepromData.di_obd_iumpr_comp_active_count[58] ZFEH_EepromData.di_obd_iumpr_comp_active_count[59] ZFEH_EepromData.di_obd_iumpr_comp_active_count[5] ZFEH_EepromData.di_obd_iumpr_comp_active_count[60] ZFEH_EepromData.di_obd_iumpr_comp_active_count[61] ZFEH_EepromData.di_obd_iumpr_comp_active_count[62] ZFEH_EepromData.di_obd_iumpr_comp_active_count[63] ZFEH_EepromData.di_obd_iumpr_comp_active_count[64] ZFEH_EepromData.di_obd_iumpr_comp_active_count[65] ZFEH_EepromData.di_obd_iumpr_comp_active_count[66] ZFEH_EepromData.di_obd_iumpr_comp_active_count[67] ZFEH_EepromData.di_obd_iumpr_comp_active_count[68] ZFEH_EepromData.di_obd_iumpr_comp_active_count[69] ZFEH_EepromData.di_obd_iumpr_comp_active_count[6] ZFEH_EepromData.di_obd_iumpr_comp_active_count[70] ZFEH_EepromData.di_obd_iumpr_comp_active_count[71] ZFEH_EepromData.di_obd_iumpr_comp_active_count[72] ZFEH_EepromData.di_obd_iumpr_comp_active_count[73] ZFEH_EepromData.di_obd_iumpr_comp_active_count[74] ZFEH_EepromData.di_obd_iumpr_comp_active_count[75] ZFEH_EepromData.di_obd_iumpr_comp_active_count[76] ZFEH_EepromData.di_obd_iumpr_comp_active_count[77] ZFEH_EepromData.di_obd_iumpr_comp_active_count[78] ZFEH_EepromData.di_obd_iumpr_comp_active_count[79] ZFEH_EepromData.di_obd_iumpr_comp_active_count[7] ZFEH_EepromData.di_obd_iumpr_comp_active_count[80] ZFEH_EepromData.di_obd_iumpr_comp_active_count[81] ZFEH_EepromData.di_obd_iumpr_comp_active_count[82] ZFEH_EepromData.di_obd_iumpr_comp_active_count[83] ZFEH_EepromData.di_obd_iumpr_comp_active_count[84] ZFEH_EepromData.di_obd_iumpr_comp_active_count[85] ZFEH_EepromData.di_obd_iumpr_comp_active_count[86] ZFEH_EepromData.di_obd_iumpr_comp_active_count[87] ZFEH_EepromData.di_obd_iumpr_comp_active_count[88] ZFEH_EepromData.di_obd_iumpr_comp_active_count[89] ZFEH_EepromData.di_obd_iumpr_comp_active_count[8] ZFEH_EepromData.di_obd_iumpr_comp_active_count[90] ZFEH_EepromData.di_obd_iumpr_comp_active_count[91] ZFEH_EepromData.di_obd_iumpr_comp_active_count[92] ZFEH_EepromData.di_obd_iumpr_comp_active_count[93] ZFEH_EepromData.di_obd_iumpr_comp_active_count[94] ZFEH_EepromData.di_obd_iumpr_comp_active_count[95] ZFEH_EepromData.di_obd_iumpr_comp_active_count[96] ZFEH_EepromData.di_obd_iumpr_comp_active_count[97] ZFEH_EepromData.di_obd_iumpr_comp_active_count[98] ZFEH_EepromData.di_obd_iumpr_comp_active_count[99] ZFEH_EepromData.di_obd_iumpr_comp_active_count[9] ZFEH_EepromData.di_obd_iumpr_comp_active_lock[0] ZFEH_EepromData.di_obd_iumpr_comp_active_lock[10] ZFEH_EepromData.di_obd_iumpr_comp_active_lock[11] ZFEH_EepromData.di_obd_iumpr_comp_active_lock[12] ZFEH_EepromData.di_obd_iumpr_comp_active_lock[13] ZFEH_EepromData.di_obd_iumpr_comp_active_lock[14] ZFEH_EepromData.di_obd_iumpr_comp_active_lock[15] ZFEH_EepromData.di_obd_iumpr_comp_active_lock[1] ZFEH_EepromData.di_obd_iumpr_comp_active_lock[2] ZFEH_EepromData.di_obd_iumpr_comp_active_lock[3] ZFEH_EepromData.di_obd_iumpr_comp_active_lock[4] ZFEH_EepromData.di_obd_iumpr_comp_active_lock[5] ZFEH_EepromData.di_obd_iumpr_comp_active_lock[6] ZFEH_EepromData.di_obd_iumpr_comp_active_lock[7] ZFEH_EepromData.di_obd_iumpr_comp_active_lock[8] ZFEH_EepromData.di_obd_iumpr_comp_active_lock[9] ZFEH_EepromData.di_obd_iumpr_comp_active_time[0] ZFEH_EepromData.di_obd_iumpr_comp_active_time[100] ZFEH_EepromData.di_obd_iumpr_comp_active_time[101] ZFEH_EepromData.di_obd_iumpr_comp_active_time[102] ZFEH_EepromData.di_obd_iumpr_comp_active_time[103] ZFEH_EepromData.di_obd_iumpr_comp_active_time[104] ZFEH_EepromData.di_obd_iumpr_comp_active_time[105] ZFEH_EepromData.di_obd_iumpr_comp_active_time[106] ZFEH_EepromData.di_obd_iumpr_comp_active_time[107] ZFEH_EepromData.di_obd_iumpr_comp_active_time[108] ZFEH_EepromData.di_obd_iumpr_comp_active_time[109] ZFEH_EepromData.di_obd_iumpr_comp_active_time[10] ZFEH_EepromData.di_obd_iumpr_comp_active_time[110] ZFEH_EepromData.di_obd_iumpr_comp_active_time[111] ZFEH_EepromData.di_obd_iumpr_comp_active_time[112] ZFEH_EepromData.di_obd_iumpr_comp_active_time[113] ZFEH_EepromData.di_obd_iumpr_comp_active_time[114] ZFEH_EepromData.di_obd_iumpr_comp_active_time[115] ZFEH_EepromData.di_obd_iumpr_comp_active_time[116] ZFEH_EepromData.di_obd_iumpr_comp_active_time[117] ZFEH_EepromData.di_obd_iumpr_comp_active_time[118] ZFEH_EepromData.di_obd_iumpr_comp_active_time[119] ZFEH_EepromData.di_obd_iumpr_comp_active_time[11] ZFEH_EepromData.di_obd_iumpr_comp_active_time[120] ZFEH_EepromData.di_obd_iumpr_comp_active_time[121] ZFEH_EepromData.di_obd_iumpr_comp_active_time[122] ZFEH_EepromData.di_obd_iumpr_comp_active_time[123] ZFEH_EepromData.di_obd_iumpr_comp_active_time[124] ZFEH_EepromData.di_obd_iumpr_comp_active_time[125] ZFEH_EepromData.di_obd_iumpr_comp_active_time[126] ZFEH_EepromData.di_obd_iumpr_comp_active_time[127] ZFEH_EepromData.di_obd_iumpr_comp_active_time[128] ZFEH_EepromData.di_obd_iumpr_comp_active_time[129] ZFEH_EepromData.di_obd_iumpr_comp_active_time[12] ZFEH_EepromData.di_obd_iumpr_comp_active_time[130] ZFEH_EepromData.di_obd_iumpr_comp_active_time[131] ZFEH_EepromData.di_obd_iumpr_comp_active_time[132] ZFEH_EepromData.di_obd_iumpr_comp_active_time[133] ZFEH_EepromData.di_obd_iumpr_comp_active_time[134] ZFEH_EepromData.di_obd_iumpr_comp_active_time[135] ZFEH_EepromData.di_obd_iumpr_comp_active_time[136] ZFEH_EepromData.di_obd_iumpr_comp_active_time[137] ZFEH_EepromData.di_obd_iumpr_comp_active_time[138] ZFEH_EepromData.di_obd_iumpr_comp_active_time[139] ZFEH_EepromData.di_obd_iumpr_comp_active_time[13] ZFEH_EepromData.di_obd_iumpr_comp_active_time[140] ZFEH_EepromData.di_obd_iumpr_comp_active_time[141] ZFEH_EepromData.di_obd_iumpr_comp_active_time[142] ZFEH_EepromData.di_obd_iumpr_comp_active_time[143] ZFEH_EepromData.di_obd_iumpr_comp_active_time[144] ZFEH_EepromData.di_obd_iumpr_comp_active_time[145] ZFEH_EepromData.di_obd_iumpr_comp_active_time[146] ZFEH_EepromData.di_obd_iumpr_comp_active_time[147] ZFEH_EepromData.di_obd_iumpr_comp_active_time[148] ZFEH_EepromData.di_obd_iumpr_comp_active_time[149] ZFEH_EepromData.di_obd_iumpr_comp_active_time[14] ZFEH_EepromData.di_obd_iumpr_comp_active_time[150] ZFEH_EepromData.di_obd_iumpr_comp_active_time[151] ZFEH_EepromData.di_obd_iumpr_comp_active_time[152] ZFEH_EepromData.di_obd_iumpr_comp_active_time[153] ZFEH_EepromData.di_obd_iumpr_comp_active_time[154] ZFEH_EepromData.di_obd_iumpr_comp_active_time[155] ZFEH_EepromData.di_obd_iumpr_comp_active_time[156] ZFEH_EepromData.di_obd_iumpr_comp_active_time[157] ZFEH_EepromData.di_obd_iumpr_comp_active_time[158] ZFEH_EepromData.di_obd_iumpr_comp_active_time[159] ZFEH_EepromData.di_obd_iumpr_comp_active_time[15] ZFEH_EepromData.di_obd_iumpr_comp_active_time[160] ZFEH_EepromData.di_obd_iumpr_comp_active_time[161] ZFEH_EepromData.di_obd_iumpr_comp_active_time[162] ZFEH_EepromData.di_obd_iumpr_comp_active_time[163] ZFEH_EepromData.di_obd_iumpr_comp_active_time[164] ZFEH_EepromData.di_obd_iumpr_comp_active_time[165] ZFEH_EepromData.di_obd_iumpr_comp_active_time[166] ZFEH_EepromData.di_obd_iumpr_comp_active_time[167] ZFEH_EepromData.di_obd_iumpr_comp_active_time[168] ZFEH_EepromData.di_obd_iumpr_comp_active_time[169] ZFEH_EepromData.di_obd_iumpr_comp_active_time[16] ZFEH_EepromData.di_obd_iumpr_comp_active_time[170] ZFEH_EepromData.di_obd_iumpr_comp_active_time[171] ZFEH_EepromData.di_obd_iumpr_comp_active_time[172] ZFEH_EepromData.di_obd_iumpr_comp_active_time[173] ZFEH_EepromData.di_obd_iumpr_comp_active_time[174] ZFEH_EepromData.di_obd_iumpr_comp_active_time[175] ZFEH_EepromData.di_obd_iumpr_comp_active_time[176] ZFEH_EepromData.di_obd_iumpr_comp_active_time[177] ZFEH_EepromData.di_obd_iumpr_comp_active_time[178] ZFEH_EepromData.di_obd_iumpr_comp_active_time[179] ZFEH_EepromData.di_obd_iumpr_comp_active_time[17] ZFEH_EepromData.di_obd_iumpr_comp_active_time[180] ZFEH_EepromData.di_obd_iumpr_comp_active_time[181] ZFEH_EepromData.di_obd_iumpr_comp_active_time[182] ZFEH_EepromData.di_obd_iumpr_comp_active_time[183] ZFEH_EepromData.di_obd_iumpr_comp_active_time[184] ZFEH_EepromData.di_obd_iumpr_comp_active_time[185] ZFEH_EepromData.di_obd_iumpr_comp_active_time[186] ZFEH_EepromData.di_obd_iumpr_comp_active_time[187] ZFEH_EepromData.di_obd_iumpr_comp_active_time[188] ZFEH_EepromData.di_obd_iumpr_comp_active_time[189] ZFEH_EepromData.di_obd_iumpr_comp_active_time[18] ZFEH_EepromData.di_obd_iumpr_comp_active_time[190] ZFEH_EepromData.di_obd_iumpr_comp_active_time[191] ZFEH_EepromData.di_obd_iumpr_comp_active_time[192] ZFEH_EepromData.di_obd_iumpr_comp_active_time[193] ZFEH_EepromData.di_obd_iumpr_comp_active_time[194] ZFEH_EepromData.di_obd_iumpr_comp_active_time[195] ZFEH_EepromData.di_obd_iumpr_comp_active_time[196] ZFEH_EepromData.di_obd_iumpr_comp_active_time[197] ZFEH_EepromData.di_obd_iumpr_comp_active_time[198] ZFEH_EepromData.di_obd_iumpr_comp_active_time[199] ZFEH_EepromData.di_obd_iumpr_comp_active_time[19] ZFEH_EepromData.di_obd_iumpr_comp_active_time[1] ZFEH_EepromData.di_obd_iumpr_comp_active_time[200] ZFEH_EepromData.di_obd_iumpr_comp_active_time[201] ZFEH_EepromData.di_obd_iumpr_comp_active_time[202] ZFEH_EepromData.di_obd_iumpr_comp_active_time[203] ZFEH_EepromData.di_obd_iumpr_comp_active_time[204] ZFEH_EepromData.di_obd_iumpr_comp_active_time[205] ZFEH_EepromData.di_obd_iumpr_comp_active_time[206] ZFEH_EepromData.di_obd_iumpr_comp_active_time[207] ZFEH_EepromData.di_obd_iumpr_comp_active_time[208] ZFEH_EepromData.di_obd_iumpr_comp_active_time[209] ZFEH_EepromData.di_obd_iumpr_comp_active_time[20] ZFEH_EepromData.di_obd_iumpr_comp_active_time[210] ZFEH_EepromData.di_obd_iumpr_comp_active_time[211] ZFEH_EepromData.di_obd_iumpr_comp_active_time[212] ZFEH_EepromData.di_obd_iumpr_comp_active_time[213] ZFEH_EepromData.di_obd_iumpr_comp_active_time[214] ZFEH_EepromData.di_obd_iumpr_comp_active_time[215] ZFEH_EepromData.di_obd_iumpr_comp_active_time[216] ZFEH_EepromData.di_obd_iumpr_comp_active_time[217] ZFEH_EepromData.di_obd_iumpr_comp_active_time[218] ZFEH_EepromData.di_obd_iumpr_comp_active_time[219] ZFEH_EepromData.di_obd_iumpr_comp_active_time[21] ZFEH_EepromData.di_obd_iumpr_comp_active_time[220] ZFEH_EepromData.di_obd_iumpr_comp_active_time[221] ZFEH_EepromData.di_obd_iumpr_comp_active_time[222] ZFEH_EepromData.di_obd_iumpr_comp_active_time[223] ZFEH_EepromData.di_obd_iumpr_comp_active_time[224] ZFEH_EepromData.di_obd_iumpr_comp_active_time[225] ZFEH_EepromData.di_obd_iumpr_comp_active_time[226] ZFEH_EepromData.di_obd_iumpr_comp_active_time[227] ZFEH_EepromData.di_obd_iumpr_comp_active_time[228] ZFEH_EepromData.di_obd_iumpr_comp_active_time[229] ZFEH_EepromData.di_obd_iumpr_comp_active_time[22] ZFEH_EepromData.di_obd_iumpr_comp_active_time[230] ZFEH_EepromData.di_obd_iumpr_comp_active_time[231] ZFEH_EepromData.di_obd_iumpr_comp_active_time[232] ZFEH_EepromData.di_obd_iumpr_comp_active_time[233] ZFEH_EepromData.di_obd_iumpr_comp_active_time[234] ZFEH_EepromData.di_obd_iumpr_comp_active_time[235] ZFEH_EepromData.di_obd_iumpr_comp_active_time[236] ZFEH_EepromData.di_obd_iumpr_comp_active_time[237] ZFEH_EepromData.di_obd_iumpr_comp_active_time[238] ZFEH_EepromData.di_obd_iumpr_comp_active_time[239] ZFEH_EepromData.di_obd_iumpr_comp_active_time[23] ZFEH_EepromData.di_obd_iumpr_comp_active_time[240] ZFEH_EepromData.di_obd_iumpr_comp_active_time[241] ZFEH_EepromData.di_obd_iumpr_comp_active_time[242] ZFEH_EepromData.di_obd_iumpr_comp_active_time[243] ZFEH_EepromData.di_obd_iumpr_comp_active_time[244] ZFEH_EepromData.di_obd_iumpr_comp_active_time[245] ZFEH_EepromData.di_obd_iumpr_comp_active_time[246] ZFEH_EepromData.di_obd_iumpr_comp_active_time[247] ZFEH_EepromData.di_obd_iumpr_comp_active_time[248] ZFEH_EepromData.di_obd_iumpr_comp_active_time[249] ZFEH_EepromData.di_obd_iumpr_comp_active_time[24] ZFEH_EepromData.di_obd_iumpr_comp_active_time[250] ZFEH_EepromData.di_obd_iumpr_comp_active_time[251] ZFEH_EepromData.di_obd_iumpr_comp_active_time[252] ZFEH_EepromData.di_obd_iumpr_comp_active_time[253] ZFEH_EepromData.di_obd_iumpr_comp_active_time[25] ZFEH_EepromData.di_obd_iumpr_comp_active_time[26] ZFEH_EepromData.di_obd_iumpr_comp_active_time[27] ZFEH_EepromData.di_obd_iumpr_comp_active_time[28] ZFEH_EepromData.di_obd_iumpr_comp_active_time[29] ZFEH_EepromData.di_obd_iumpr_comp_active_time[2] ZFEH_EepromData.di_obd_iumpr_comp_active_time[30] ZFEH_EepromData.di_obd_iumpr_comp_active_time[31] ZFEH_EepromData.di_obd_iumpr_comp_active_time[32] ZFEH_EepromData.di_obd_iumpr_comp_active_time[33] ZFEH_EepromData.di_obd_iumpr_comp_active_time[34] ZFEH_EepromData.di_obd_iumpr_comp_active_time[35] ZFEH_EepromData.di_obd_iumpr_comp_active_time[36] ZFEH_EepromData.di_obd_iumpr_comp_active_time[37] ZFEH_EepromData.di_obd_iumpr_comp_active_time[38] ZFEH_EepromData.di_obd_iumpr_comp_active_time[39] ZFEH_EepromData.di_obd_iumpr_comp_active_time[3] ZFEH_EepromData.di_obd_iumpr_comp_active_time[40] ZFEH_EepromData.di_obd_iumpr_comp_active_time[41] ZFEH_EepromData.di_obd_iumpr_comp_active_time[42] ZFEH_EepromData.di_obd_iumpr_comp_active_time[43] ZFEH_EepromData.di_obd_iumpr_comp_active_time[44] ZFEH_EepromData.di_obd_iumpr_comp_active_time[45] ZFEH_EepromData.di_obd_iumpr_comp_active_time[46] ZFEH_EepromData.di_obd_iumpr_comp_active_time[47] ZFEH_EepromData.di_obd_iumpr_comp_active_time[48] ZFEH_EepromData.di_obd_iumpr_comp_active_time[49] ZFEH_EepromData.di_obd_iumpr_comp_active_time[4] ZFEH_EepromData.di_obd_iumpr_comp_active_time[50] ZFEH_EepromData.di_obd_iumpr_comp_active_time[51] ZFEH_EepromData.di_obd_iumpr_comp_active_time[52] ZFEH_EepromData.di_obd_iumpr_comp_active_time[53] ZFEH_EepromData.di_obd_iumpr_comp_active_time[54] ZFEH_EepromData.di_obd_iumpr_comp_active_time[55] ZFEH_EepromData.di_obd_iumpr_comp_active_time[56] ZFEH_EepromData.di_obd_iumpr_comp_active_time[57] ZFEH_EepromData.di_obd_iumpr_comp_active_time[58] ZFEH_EepromData.di_obd_iumpr_comp_active_time[59] ZFEH_EepromData.di_obd_iumpr_comp_active_time[5] ZFEH_EepromData.di_obd_iumpr_comp_active_time[60] ZFEH_EepromData.di_obd_iumpr_comp_active_time[61] ZFEH_EepromData.di_obd_iumpr_comp_active_time[62] ZFEH_EepromData.di_obd_iumpr_comp_active_time[63] ZFEH_EepromData.di_obd_iumpr_comp_active_time[64] ZFEH_EepromData.di_obd_iumpr_comp_active_time[65] ZFEH_EepromData.di_obd_iumpr_comp_active_time[66] ZFEH_EepromData.di_obd_iumpr_comp_active_time[67] ZFEH_EepromData.di_obd_iumpr_comp_active_time[68] ZFEH_EepromData.di_obd_iumpr_comp_active_time[69] ZFEH_EepromData.di_obd_iumpr_comp_active_time[6] ZFEH_EepromData.di_obd_iumpr_comp_active_time[70] ZFEH_EepromData.di_obd_iumpr_comp_active_time[71] ZFEH_EepromData.di_obd_iumpr_comp_active_time[72] ZFEH_EepromData.di_obd_iumpr_comp_active_time[73] ZFEH_EepromData.di_obd_iumpr_comp_active_time[74] ZFEH_EepromData.di_obd_iumpr_comp_active_time[75] ZFEH_EepromData.di_obd_iumpr_comp_active_time[76] ZFEH_EepromData.di_obd_iumpr_comp_active_time[77] ZFEH_EepromData.di_obd_iumpr_comp_active_time[78] ZFEH_EepromData.di_obd_iumpr_comp_active_time[79] ZFEH_EepromData.di_obd_iumpr_comp_active_time[7] ZFEH_EepromData.di_obd_iumpr_comp_active_time[80] ZFEH_EepromData.di_obd_iumpr_comp_active_time[81] ZFEH_EepromData.di_obd_iumpr_comp_active_time[82] ZFEH_EepromData.di_obd_iumpr_comp_active_time[83] ZFEH_EepromData.di_obd_iumpr_comp_active_time[84] ZFEH_EepromData.di_obd_iumpr_comp_active_time[85] ZFEH_EepromData.di_obd_iumpr_comp_active_time[86] ZFEH_EepromData.di_obd_iumpr_comp_active_time[87] ZFEH_EepromData.di_obd_iumpr_comp_active_time[88] ZFEH_EepromData.di_obd_iumpr_comp_active_time[89] ZFEH_EepromData.di_obd_iumpr_comp_active_time[8] ZFEH_EepromData.di_obd_iumpr_comp_active_time[90] ZFEH_EepromData.di_obd_iumpr_comp_active_time[91] ZFEH_EepromData.di_obd_iumpr_comp_active_time[92] ZFEH_EepromData.di_obd_iumpr_comp_active_time[93] ZFEH_EepromData.di_obd_iumpr_comp_active_time[94] ZFEH_EepromData.di_obd_iumpr_comp_active_time[95] ZFEH_EepromData.di_obd_iumpr_comp_active_time[96] ZFEH_EepromData.di_obd_iumpr_comp_active_time[97] ZFEH_EepromData.di_obd_iumpr_comp_active_time[98] ZFEH_EepromData.di_obd_iumpr_comp_active_time[99] ZFEH_EepromData.di_obd_iumpr_comp_active_time[9] ZFEH_EepromData.di_obd_iumpr_denominator[0] ZFEH_EepromData.di_obd_iumpr_denominator[100] ZFEH_EepromData.di_obd_iumpr_denominator[101] ZFEH_EepromData.di_obd_iumpr_denominator[102] ZFEH_EepromData.di_obd_iumpr_denominator[103] ZFEH_EepromData.di_obd_iumpr_denominator[104] ZFEH_EepromData.di_obd_iumpr_denominator[105] ZFEH_EepromData.di_obd_iumpr_denominator[106] ZFEH_EepromData.di_obd_iumpr_denominator[107] ZFEH_EepromData.di_obd_iumpr_denominator[108] ZFEH_EepromData.di_obd_iumpr_denominator[109] ZFEH_EepromData.di_obd_iumpr_denominator[10] ZFEH_EepromData.di_obd_iumpr_denominator[110] ZFEH_EepromData.di_obd_iumpr_denominator[111] ZFEH_EepromData.di_obd_iumpr_denominator[112] ZFEH_EepromData.di_obd_iumpr_denominator[113] ZFEH_EepromData.di_obd_iumpr_denominator[114] ZFEH_EepromData.di_obd_iumpr_denominator[115] ZFEH_EepromData.di_obd_iumpr_denominator[116] ZFEH_EepromData.di_obd_iumpr_denominator[117] ZFEH_EepromData.di_obd_iumpr_denominator[118] ZFEH_EepromData.di_obd_iumpr_denominator[119] ZFEH_EepromData.di_obd_iumpr_denominator[11] ZFEH_EepromData.di_obd_iumpr_denominator[120] ZFEH_EepromData.di_obd_iumpr_denominator[121] ZFEH_EepromData.di_obd_iumpr_denominator[122] ZFEH_EepromData.di_obd_iumpr_denominator[123] ZFEH_EepromData.di_obd_iumpr_denominator[124] ZFEH_EepromData.di_obd_iumpr_denominator[125] ZFEH_EepromData.di_obd_iumpr_denominator[126] ZFEH_EepromData.di_obd_iumpr_denominator[127] ZFEH_EepromData.di_obd_iumpr_denominator[128] ZFEH_EepromData.di_obd_iumpr_denominator[129] ZFEH_EepromData.di_obd_iumpr_denominator[12] ZFEH_EepromData.di_obd_iumpr_denominator[130] ZFEH_EepromData.di_obd_iumpr_denominator[131] ZFEH_EepromData.di_obd_iumpr_denominator[132] ZFEH_EepromData.di_obd_iumpr_denominator[133] ZFEH_EepromData.di_obd_iumpr_denominator[134] ZFEH_EepromData.di_obd_iumpr_denominator[135] ZFEH_EepromData.di_obd_iumpr_denominator[136] ZFEH_EepromData.di_obd_iumpr_denominator[137] ZFEH_EepromData.di_obd_iumpr_denominator[138] ZFEH_EepromData.di_obd_iumpr_denominator[139] ZFEH_EepromData.di_obd_iumpr_denominator[13] ZFEH_EepromData.di_obd_iumpr_denominator[140] ZFEH_EepromData.di_obd_iumpr_denominator[141] ZFEH_EepromData.di_obd_iumpr_denominator[142] ZFEH_EepromData.di_obd_iumpr_denominator[143] ZFEH_EepromData.di_obd_iumpr_denominator[144] ZFEH_EepromData.di_obd_iumpr_denominator[145] ZFEH_EepromData.di_obd_iumpr_denominator[146] ZFEH_EepromData.di_obd_iumpr_denominator[147] ZFEH_EepromData.di_obd_iumpr_denominator[148] ZFEH_EepromData.di_obd_iumpr_denominator[149] ZFEH_EepromData.di_obd_iumpr_denominator[14] ZFEH_EepromData.di_obd_iumpr_denominator[150] ZFEH_EepromData.di_obd_iumpr_denominator[151] ZFEH_EepromData.di_obd_iumpr_denominator[152] ZFEH_EepromData.di_obd_iumpr_denominator[153] ZFEH_EepromData.di_obd_iumpr_denominator[154] ZFEH_EepromData.di_obd_iumpr_denominator[155] ZFEH_EepromData.di_obd_iumpr_denominator[156] ZFEH_EepromData.di_obd_iumpr_denominator[157] ZFEH_EepromData.di_obd_iumpr_denominator[158] ZFEH_EepromData.di_obd_iumpr_denominator[159] ZFEH_EepromData.di_obd_iumpr_denominator[15] ZFEH_EepromData.di_obd_iumpr_denominator[160] ZFEH_EepromData.di_obd_iumpr_denominator[161] ZFEH_EepromData.di_obd_iumpr_denominator[162] ZFEH_EepromData.di_obd_iumpr_denominator[163] ZFEH_EepromData.di_obd_iumpr_denominator[164] ZFEH_EepromData.di_obd_iumpr_denominator[165] ZFEH_EepromData.di_obd_iumpr_denominator[166] ZFEH_EepromData.di_obd_iumpr_denominator[167] ZFEH_EepromData.di_obd_iumpr_denominator[168] ZFEH_EepromData.di_obd_iumpr_denominator[169] ZFEH_EepromData.di_obd_iumpr_denominator[16] ZFEH_EepromData.di_obd_iumpr_denominator[170] ZFEH_EepromData.di_obd_iumpr_denominator[171] ZFEH_EepromData.di_obd_iumpr_denominator[172] ZFEH_EepromData.di_obd_iumpr_denominator[173] ZFEH_EepromData.di_obd_iumpr_denominator[174] ZFEH_EepromData.di_obd_iumpr_denominator[175] ZFEH_EepromData.di_obd_iumpr_denominator[176] ZFEH_EepromData.di_obd_iumpr_denominator[177] ZFEH_EepromData.di_obd_iumpr_denominator[178] ZFEH_EepromData.di_obd_iumpr_denominator[179] ZFEH_EepromData.di_obd_iumpr_denominator[17] ZFEH_EepromData.di_obd_iumpr_denominator[180] ZFEH_EepromData.di_obd_iumpr_denominator[181] ZFEH_EepromData.di_obd_iumpr_denominator[182] ZFEH_EepromData.di_obd_iumpr_denominator[183] ZFEH_EepromData.di_obd_iumpr_denominator[184] ZFEH_EepromData.di_obd_iumpr_denominator[185] ZFEH_EepromData.di_obd_iumpr_denominator[186] ZFEH_EepromData.di_obd_iumpr_denominator[187] ZFEH_EepromData.di_obd_iumpr_denominator[188] ZFEH_EepromData.di_obd_iumpr_denominator[189] ZFEH_EepromData.di_obd_iumpr_denominator[18] ZFEH_EepromData.di_obd_iumpr_denominator[190] ZFEH_EepromData.di_obd_iumpr_denominator[191] ZFEH_EepromData.di_obd_iumpr_denominator[192] ZFEH_EepromData.di_obd_iumpr_denominator[193] ZFEH_EepromData.di_obd_iumpr_denominator[194] ZFEH_EepromData.di_obd_iumpr_denominator[195] ZFEH_EepromData.di_obd_iumpr_denominator[196] ZFEH_EepromData.di_obd_iumpr_denominator[197] ZFEH_EepromData.di_obd_iumpr_denominator[198] ZFEH_EepromData.di_obd_iumpr_denominator[199] ZFEH_EepromData.di_obd_iumpr_denominator[19] ZFEH_EepromData.di_obd_iumpr_denominator[1] ZFEH_EepromData.di_obd_iumpr_denominator[200] ZFEH_EepromData.di_obd_iumpr_denominator[201] ZFEH_EepromData.di_obd_iumpr_denominator[202] ZFEH_EepromData.di_obd_iumpr_denominator[203] ZFEH_EepromData.di_obd_iumpr_denominator[204] ZFEH_EepromData.di_obd_iumpr_denominator[205] ZFEH_EepromData.di_obd_iumpr_denominator[206] ZFEH_EepromData.di_obd_iumpr_denominator[207] ZFEH_EepromData.di_obd_iumpr_denominator[208] ZFEH_EepromData.di_obd_iumpr_denominator[209] ZFEH_EepromData.di_obd_iumpr_denominator[20] ZFEH_EepromData.di_obd_iumpr_denominator[210] ZFEH_EepromData.di_obd_iumpr_denominator[211] ZFEH_EepromData.di_obd_iumpr_denominator[212] ZFEH_EepromData.di_obd_iumpr_denominator[213] ZFEH_EepromData.di_obd_iumpr_denominator[214] ZFEH_EepromData.di_obd_iumpr_denominator[215] ZFEH_EepromData.di_obd_iumpr_denominator[216] ZFEH_EepromData.di_obd_iumpr_denominator[217] ZFEH_EepromData.di_obd_iumpr_denominator[218] ZFEH_EepromData.di_obd_iumpr_denominator[219] ZFEH_EepromData.di_obd_iumpr_denominator[21] ZFEH_EepromData.di_obd_iumpr_denominator[220] ZFEH_EepromData.di_obd_iumpr_denominator[221] ZFEH_EepromData.di_obd_iumpr_denominator[222] ZFEH_EepromData.di_obd_iumpr_denominator[223] ZFEH_EepromData.di_obd_iumpr_denominator[224] ZFEH_EepromData.di_obd_iumpr_denominator[225] ZFEH_EepromData.di_obd_iumpr_denominator[226] ZFEH_EepromData.di_obd_iumpr_denominator[227] ZFEH_EepromData.di_obd_iumpr_denominator[228] ZFEH_EepromData.di_obd_iumpr_denominator[229] ZFEH_EepromData.di_obd_iumpr_denominator[22] ZFEH_EepromData.di_obd_iumpr_denominator[230] ZFEH_EepromData.di_obd_iumpr_denominator[231] ZFEH_EepromData.di_obd_iumpr_denominator[232] ZFEH_EepromData.di_obd_iumpr_denominator[233] ZFEH_EepromData.di_obd_iumpr_denominator[234] ZFEH_EepromData.di_obd_iumpr_denominator[235] ZFEH_EepromData.di_obd_iumpr_denominator[236] ZFEH_EepromData.di_obd_iumpr_denominator[237] ZFEH_EepromData.di_obd_iumpr_denominator[238] ZFEH_EepromData.di_obd_iumpr_denominator[239] ZFEH_EepromData.di_obd_iumpr_denominator[23] ZFEH_EepromData.di_obd_iumpr_denominator[240] ZFEH_EepromData.di_obd_iumpr_denominator[241] ZFEH_EepromData.di_obd_iumpr_denominator[242] ZFEH_EepromData.di_obd_iumpr_denominator[243] ZFEH_EepromData.di_obd_iumpr_denominator[244] ZFEH_EepromData.di_obd_iumpr_denominator[245] ZFEH_EepromData.di_obd_iumpr_denominator[246] ZFEH_EepromData.di_obd_iumpr_denominator[247] ZFEH_EepromData.di_obd_iumpr_denominator[248] ZFEH_EepromData.di_obd_iumpr_denominator[249] ZFEH_EepromData.di_obd_iumpr_denominator[24] ZFEH_EepromData.di_obd_iumpr_denominator[250] ZFEH_EepromData.di_obd_iumpr_denominator[251] ZFEH_EepromData.di_obd_iumpr_denominator[252] ZFEH_EepromData.di_obd_iumpr_denominator[253] ZFEH_EepromData.di_obd_iumpr_denominator[25] ZFEH_EepromData.di_obd_iumpr_denominator[26] ZFEH_EepromData.di_obd_iumpr_denominator[27] ZFEH_EepromData.di_obd_iumpr_denominator[28] ZFEH_EepromData.di_obd_iumpr_denominator[29] ZFEH_EepromData.di_obd_iumpr_denominator[2] ZFEH_EepromData.di_obd_iumpr_denominator[30] ZFEH_EepromData.di_obd_iumpr_denominator[31] ZFEH_EepromData.di_obd_iumpr_denominator[32] ZFEH_EepromData.di_obd_iumpr_denominator[33] ZFEH_EepromData.di_obd_iumpr_denominator[34] ZFEH_EepromData.di_obd_iumpr_denominator[35] ZFEH_EepromData.di_obd_iumpr_denominator[36] ZFEH_EepromData.di_obd_iumpr_denominator[37] ZFEH_EepromData.di_obd_iumpr_denominator[38] ZFEH_EepromData.di_obd_iumpr_denominator[39] ZFEH_EepromData.di_obd_iumpr_denominator[3] ZFEH_EepromData.di_obd_iumpr_denominator[40] ZFEH_EepromData.di_obd_iumpr_denominator[41] ZFEH_EepromData.di_obd_iumpr_denominator[42] ZFEH_EepromData.di_obd_iumpr_denominator[43] ZFEH_EepromData.di_obd_iumpr_denominator[44] ZFEH_EepromData.di_obd_iumpr_denominator[45] ZFEH_EepromData.di_obd_iumpr_denominator[46] ZFEH_EepromData.di_obd_iumpr_denominator[47] ZFEH_EepromData.di_obd_iumpr_denominator[48] ZFEH_EepromData.di_obd_iumpr_denominator[49] ZFEH_EepromData.di_obd_iumpr_denominator[4] ZFEH_EepromData.di_obd_iumpr_denominator[50] ZFEH_EepromData.di_obd_iumpr_denominator[51] ZFEH_EepromData.di_obd_iumpr_denominator[52] ZFEH_EepromData.di_obd_iumpr_denominator[53] ZFEH_EepromData.di_obd_iumpr_denominator[54] ZFEH_EepromData.di_obd_iumpr_denominator[55] ZFEH_EepromData.di_obd_iumpr_denominator[56] ZFEH_EepromData.di_obd_iumpr_denominator[57] ZFEH_EepromData.di_obd_iumpr_denominator[58] ZFEH_EepromData.di_obd_iumpr_denominator[59] ZFEH_EepromData.di_obd_iumpr_denominator[5] ZFEH_EepromData.di_obd_iumpr_denominator[60] ZFEH_EepromData.di_obd_iumpr_denominator[61] ZFEH_EepromData.di_obd_iumpr_denominator[62] ZFEH_EepromData.di_obd_iumpr_denominator[63] ZFEH_EepromData.di_obd_iumpr_denominator[64] ZFEH_EepromData.di_obd_iumpr_denominator[65] ZFEH_EepromData.di_obd_iumpr_denominator[66] ZFEH_EepromData.di_obd_iumpr_denominator[67] ZFEH_EepromData.di_obd_iumpr_denominator[68] ZFEH_EepromData.di_obd_iumpr_denominator[69] ZFEH_EepromData.di_obd_iumpr_denominator[6] ZFEH_EepromData.di_obd_iumpr_denominator[70] ZFEH_EepromData.di_obd_iumpr_denominator[71] ZFEH_EepromData.di_obd_iumpr_denominator[72] ZFEH_EepromData.di_obd_iumpr_denominator[73] ZFEH_EepromData.di_obd_iumpr_denominator[74] ZFEH_EepromData.di_obd_iumpr_denominator[75] ZFEH_EepromData.di_obd_iumpr_denominator[76] ZFEH_EepromData.di_obd_iumpr_denominator[77] ZFEH_EepromData.di_obd_iumpr_denominator[78] ZFEH_EepromData.di_obd_iumpr_denominator[79] ZFEH_EepromData.di_obd_iumpr_denominator[7] ZFEH_EepromData.di_obd_iumpr_denominator[80] ZFEH_EepromData.di_obd_iumpr_denominator[81] ZFEH_EepromData.di_obd_iumpr_denominator[82] ZFEH_EepromData.di_obd_iumpr_denominator[83] ZFEH_EepromData.di_obd_iumpr_denominator[84] ZFEH_EepromData.di_obd_iumpr_denominator[85] ZFEH_EepromData.di_obd_iumpr_denominator[86] ZFEH_EepromData.di_obd_iumpr_denominator[87] ZFEH_EepromData.di_obd_iumpr_denominator[88] ZFEH_EepromData.di_obd_iumpr_denominator[89] ZFEH_EepromData.di_obd_iumpr_denominator[8] ZFEH_EepromData.di_obd_iumpr_denominator[90] ZFEH_EepromData.di_obd_iumpr_denominator[91] ZFEH_EepromData.di_obd_iumpr_denominator[92] ZFEH_EepromData.di_obd_iumpr_denominator[93] ZFEH_EepromData.di_obd_iumpr_denominator[94] ZFEH_EepromData.di_obd_iumpr_denominator[95] ZFEH_EepromData.di_obd_iumpr_denominator[96] ZFEH_EepromData.di_obd_iumpr_denominator[97] ZFEH_EepromData.di_obd_iumpr_denominator[98] ZFEH_EepromData.di_obd_iumpr_denominator[99] ZFEH_EepromData.di_obd_iumpr_denominator[9] ZFEH_EepromData.di_obd_iumpr_gen_den ZFEH_EepromData.di_obd_iumpr_ign_cycle ZFEH_EepromData.di_obd_iumpr_numerator[0] ZFEH_EepromData.di_obd_iumpr_numerator[100] ZFEH_EepromData.di_obd_iumpr_numerator[101] ZFEH_EepromData.di_obd_iumpr_numerator[102] ZFEH_EepromData.di_obd_iumpr_numerator[103] ZFEH_EepromData.di_obd_iumpr_numerator[104] ZFEH_EepromData.di_obd_iumpr_numerator[105] ZFEH_EepromData.di_obd_iumpr_numerator[106] ZFEH_EepromData.di_obd_iumpr_numerator[107] ZFEH_EepromData.di_obd_iumpr_numerator[108] ZFEH_EepromData.di_obd_iumpr_numerator[109] ZFEH_EepromData.di_obd_iumpr_numerator[10] ZFEH_EepromData.di_obd_iumpr_numerator[110] ZFEH_EepromData.di_obd_iumpr_numerator[111] ZFEH_EepromData.di_obd_iumpr_numerator[112] ZFEH_EepromData.di_obd_iumpr_numerator[113] ZFEH_EepromData.di_obd_iumpr_numerator[114] ZFEH_EepromData.di_obd_iumpr_numerator[115] ZFEH_EepromData.di_obd_iumpr_numerator[116] ZFEH_EepromData.di_obd_iumpr_numerator[117] ZFEH_EepromData.di_obd_iumpr_numerator[118] ZFEH_EepromData.di_obd_iumpr_numerator[119] ZFEH_EepromData.di_obd_iumpr_numerator[11] ZFEH_EepromData.di_obd_iumpr_numerator[120] ZFEH_EepromData.di_obd_iumpr_numerator[121] ZFEH_EepromData.di_obd_iumpr_numerator[122] ZFEH_EepromData.di_obd_iumpr_numerator[123] ZFEH_EepromData.di_obd_iumpr_numerator[124] ZFEH_EepromData.di_obd_iumpr_numerator[125] ZFEH_EepromData.di_obd_iumpr_numerator[126] ZFEH_EepromData.di_obd_iumpr_numerator[127] ZFEH_EepromData.di_obd_iumpr_numerator[128] ZFEH_EepromData.di_obd_iumpr_numerator[129] ZFEH_EepromData.di_obd_iumpr_numerator[12] ZFEH_EepromData.di_obd_iumpr_numerator[130] ZFEH_EepromData.di_obd_iumpr_numerator[131] ZFEH_EepromData.di_obd_iumpr_numerator[132] ZFEH_EepromData.di_obd_iumpr_numerator[133] ZFEH_EepromData.di_obd_iumpr_numerator[134] ZFEH_EepromData.di_obd_iumpr_numerator[135] ZFEH_EepromData.di_obd_iumpr_numerator[136] ZFEH_EepromData.di_obd_iumpr_numerator[137] ZFEH_EepromData.di_obd_iumpr_numerator[138] ZFEH_EepromData.di_obd_iumpr_numerator[139] ZFEH_EepromData.di_obd_iumpr_numerator[13] ZFEH_EepromData.di_obd_iumpr_numerator[140] ZFEH_EepromData.di_obd_iumpr_numerator[141] ZFEH_EepromData.di_obd_iumpr_numerator[142] ZFEH_EepromData.di_obd_iumpr_numerator[143] ZFEH_EepromData.di_obd_iumpr_numerator[144] ZFEH_EepromData.di_obd_iumpr_numerator[145] ZFEH_EepromData.di_obd_iumpr_numerator[146] ZFEH_EepromData.di_obd_iumpr_numerator[147] ZFEH_EepromData.di_obd_iumpr_numerator[148] ZFEH_EepromData.di_obd_iumpr_numerator[149] ZFEH_EepromData.di_obd_iumpr_numerator[14] ZFEH_EepromData.di_obd_iumpr_numerator[150] ZFEH_EepromData.di_obd_iumpr_numerator[151] ZFEH_EepromData.di_obd_iumpr_numerator[152] ZFEH_EepromData.di_obd_iumpr_numerator[153] ZFEH_EepromData.di_obd_iumpr_numerator[154] ZFEH_EepromData.di_obd_iumpr_numerator[155] ZFEH_EepromData.di_obd_iumpr_numerator[156] ZFEH_EepromData.di_obd_iumpr_numerator[157] ZFEH_EepromData.di_obd_iumpr_numerator[158] ZFEH_EepromData.di_obd_iumpr_numerator[159] ZFEH_EepromData.di_obd_iumpr_numerator[15] ZFEH_EepromData.di_obd_iumpr_numerator[160] ZFEH_EepromData.di_obd_iumpr_numerator[161] ZFEH_EepromData.di_obd_iumpr_numerator[162] ZFEH_EepromData.di_obd_iumpr_numerator[163] ZFEH_EepromData.di_obd_iumpr_numerator[164] ZFEH_EepromData.di_obd_iumpr_numerator[165] ZFEH_EepromData.di_obd_iumpr_numerator[166] ZFEH_EepromData.di_obd_iumpr_numerator[167] ZFEH_EepromData.di_obd_iumpr_numerator[168] ZFEH_EepromData.di_obd_iumpr_numerator[169] ZFEH_EepromData.di_obd_iumpr_numerator[16] ZFEH_EepromData.di_obd_iumpr_numerator[170] ZFEH_EepromData.di_obd_iumpr_numerator[171] ZFEH_EepromData.di_obd_iumpr_numerator[172] ZFEH_EepromData.di_obd_iumpr_numerator[173] ZFEH_EepromData.di_obd_iumpr_numerator[174] ZFEH_EepromData.di_obd_iumpr_numerator[175] ZFEH_EepromData.di_obd_iumpr_numerator[176] ZFEH_EepromData.di_obd_iumpr_numerator[177] ZFEH_EepromData.di_obd_iumpr_numerator[178] ZFEH_EepromData.di_obd_iumpr_numerator[179] ZFEH_EepromData.di_obd_iumpr_numerator[17] ZFEH_EepromData.di_obd_iumpr_numerator[180] ZFEH_EepromData.di_obd_iumpr_numerator[181] ZFEH_EepromData.di_obd_iumpr_numerator[182] ZFEH_EepromData.di_obd_iumpr_numerator[183] ZFEH_EepromData.di_obd_iumpr_numerator[184] ZFEH_EepromData.di_obd_iumpr_numerator[185] ZFEH_EepromData.di_obd_iumpr_numerator[186] ZFEH_EepromData.di_obd_iumpr_numerator[187] ZFEH_EepromData.di_obd_iumpr_numerator[188] ZFEH_EepromData.di_obd_iumpr_numerator[189] ZFEH_EepromData.di_obd_iumpr_numerator[18] ZFEH_EepromData.di_obd_iumpr_numerator[190] ZFEH_EepromData.di_obd_iumpr_numerator[191] ZFEH_EepromData.di_obd_iumpr_numerator[192] ZFEH_EepromData.di_obd_iumpr_numerator[193] ZFEH_EepromData.di_obd_iumpr_numerator[194] ZFEH_EepromData.di_obd_iumpr_numerator[195] ZFEH_EepromData.di_obd_iumpr_numerator[196] ZFEH_EepromData.di_obd_iumpr_numerator[197] ZFEH_EepromData.di_obd_iumpr_numerator[198] ZFEH_EepromData.di_obd_iumpr_numerator[199] ZFEH_EepromData.di_obd_iumpr_numerator[19] ZFEH_EepromData.di_obd_iumpr_numerator[1] ZFEH_EepromData.di_obd_iumpr_numerator[200] ZFEH_EepromData.di_obd_iumpr_numerator[201] ZFEH_EepromData.di_obd_iumpr_numerator[202] ZFEH_EepromData.di_obd_iumpr_numerator[203] ZFEH_EepromData.di_obd_iumpr_numerator[204] ZFEH_EepromData.di_obd_iumpr_numerator[205] ZFEH_EepromData.di_obd_iumpr_numerator[206] ZFEH_EepromData.di_obd_iumpr_numerator[207] ZFEH_EepromData.di_obd_iumpr_numerator[208] ZFEH_EepromData.di_obd_iumpr_numerator[209] ZFEH_EepromData.di_obd_iumpr_numerator[20] ZFEH_EepromData.di_obd_iumpr_numerator[210] ZFEH_EepromData.di_obd_iumpr_numerator[211] ZFEH_EepromData.di_obd_iumpr_numerator[212] ZFEH_EepromData.di_obd_iumpr_numerator[213] ZFEH_EepromData.di_obd_iumpr_numerator[214] ZFEH_EepromData.di_obd_iumpr_numerator[215] ZFEH_EepromData.di_obd_iumpr_numerator[216] ZFEH_EepromData.di_obd_iumpr_numerator[217] ZFEH_EepromData.di_obd_iumpr_numerator[218] ZFEH_EepromData.di_obd_iumpr_numerator[219] ZFEH_EepromData.di_obd_iumpr_numerator[21] ZFEH_EepromData.di_obd_iumpr_numerator[220] ZFEH_EepromData.di_obd_iumpr_numerator[221] ZFEH_EepromData.di_obd_iumpr_numerator[222] ZFEH_EepromData.di_obd_iumpr_numerator[223] ZFEH_EepromData.di_obd_iumpr_numerator[224] ZFEH_EepromData.di_obd_iumpr_numerator[225] ZFEH_EepromData.di_obd_iumpr_numerator[226] ZFEH_EepromData.di_obd_iumpr_numerator[227] ZFEH_EepromData.di_obd_iumpr_numerator[228] ZFEH_EepromData.di_obd_iumpr_numerator[229] ZFEH_EepromData.di_obd_iumpr_numerator[22] ZFEH_EepromData.di_obd_iumpr_numerator[230] ZFEH_EepromData.di_obd_iumpr_numerator[231] ZFEH_EepromData.di_obd_iumpr_numerator[232] ZFEH_EepromData.di_obd_iumpr_numerator[233] ZFEH_EepromData.di_obd_iumpr_numerator[234] ZFEH_EepromData.di_obd_iumpr_numerator[235] ZFEH_EepromData.di_obd_iumpr_numerator[236] ZFEH_EepromData.di_obd_iumpr_numerator[237] ZFEH_EepromData.di_obd_iumpr_numerator[238] ZFEH_EepromData.di_obd_iumpr_numerator[239] ZFEH_EepromData.di_obd_iumpr_numerator[23] ZFEH_EepromData.di_obd_iumpr_numerator[240] ZFEH_EepromData.di_obd_iumpr_numerator[241] ZFEH_EepromData.di_obd_iumpr_numerator[242] ZFEH_EepromData.di_obd_iumpr_numerator[243] ZFEH_EepromData.di_obd_iumpr_numerator[244] ZFEH_EepromData.di_obd_iumpr_numerator[245] ZFEH_EepromData.di_obd_iumpr_numerator[246] ZFEH_EepromData.di_obd_iumpr_numerator[247] ZFEH_EepromData.di_obd_iumpr_numerator[248] ZFEH_EepromData.di_obd_iumpr_numerator[249] ZFEH_EepromData.di_obd_iumpr_numerator[24] ZFEH_EepromData.di_obd_iumpr_numerator[250] ZFEH_EepromData.di_obd_iumpr_numerator[251] ZFEH_EepromData.di_obd_iumpr_numerator[252] ZFEH_EepromData.di_obd_iumpr_numerator[253] ZFEH_EepromData.di_obd_iumpr_numerator[25] ZFEH_EepromData.di_obd_iumpr_numerator[26] ZFEH_EepromData.di_obd_iumpr_numerator[27] ZFEH_EepromData.di_obd_iumpr_numerator[28] ZFEH_EepromData.di_obd_iumpr_numerator[29] ZFEH_EepromData.di_obd_iumpr_numerator[2] ZFEH_EepromData.di_obd_iumpr_numerator[30] ZFEH_EepromData.di_obd_iumpr_numerator[31] ZFEH_EepromData.di_obd_iumpr_numerator[32] ZFEH_EepromData.di_obd_iumpr_numerator[33] ZFEH_EepromData.di_obd_iumpr_numerator[34] ZFEH_EepromData.di_obd_iumpr_numerator[35] ZFEH_EepromData.di_obd_iumpr_numerator[36] ZFEH_EepromData.di_obd_iumpr_numerator[37] ZFEH_EepromData.di_obd_iumpr_numerator[38] ZFEH_EepromData.di_obd_iumpr_numerator[39] ZFEH_EepromData.di_obd_iumpr_numerator[3] ZFEH_EepromData.di_obd_iumpr_numerator[40] ZFEH_EepromData.di_obd_iumpr_numerator[41] ZFEH_EepromData.di_obd_iumpr_numerator[42] ZFEH_EepromData.di_obd_iumpr_numerator[43] ZFEH_EepromData.di_obd_iumpr_numerator[44] ZFEH_EepromData.di_obd_iumpr_numerator[45] ZFEH_EepromData.di_obd_iumpr_numerator[46] ZFEH_EepromData.di_obd_iumpr_numerator[47] ZFEH_EepromData.di_obd_iumpr_numerator[48] ZFEH_EepromData.di_obd_iumpr_numerator[49] ZFEH_EepromData.di_obd_iumpr_numerator[4] ZFEH_EepromData.di_obd_iumpr_numerator[50] ZFEH_EepromData.di_obd_iumpr_numerator[51] ZFEH_EepromData.di_obd_iumpr_numerator[52] ZFEH_EepromData.di_obd_iumpr_numerator[53] ZFEH_EepromData.di_obd_iumpr_numerator[54] ZFEH_EepromData.di_obd_iumpr_numerator[55] ZFEH_EepromData.di_obd_iumpr_numerator[56] ZFEH_EepromData.di_obd_iumpr_numerator[57] ZFEH_EepromData.di_obd_iumpr_numerator[58] ZFEH_EepromData.di_obd_iumpr_numerator[59] ZFEH_EepromData.di_obd_iumpr_numerator[5] ZFEH_EepromData.di_obd_iumpr_numerator[60] ZFEH_EepromData.di_obd_iumpr_numerator[61] ZFEH_EepromData.di_obd_iumpr_numerator[62] ZFEH_EepromData.di_obd_iumpr_numerator[63] ZFEH_EepromData.di_obd_iumpr_numerator[64] ZFEH_EepromData.di_obd_iumpr_numerator[65] ZFEH_EepromData.di_obd_iumpr_numerator[66] ZFEH_EepromData.di_obd_iumpr_numerator[67] ZFEH_EepromData.di_obd_iumpr_numerator[68] ZFEH_EepromData.di_obd_iumpr_numerator[69] ZFEH_EepromData.di_obd_iumpr_numerator[6] ZFEH_EepromData.di_obd_iumpr_numerator[70] ZFEH_EepromData.di_obd_iumpr_numerator[71] ZFEH_EepromData.di_obd_iumpr_numerator[72] ZFEH_EepromData.di_obd_iumpr_numerator[73] ZFEH_EepromData.di_obd_iumpr_numerator[74] ZFEH_EepromData.di_obd_iumpr_numerator[75] ZFEH_EepromData.di_obd_iumpr_numerator[76] ZFEH_EepromData.di_obd_iumpr_numerator[77] ZFEH_EepromData.di_obd_iumpr_numerator[78] ZFEH_EepromData.di_obd_iumpr_numerator[79] ZFEH_EepromData.di_obd_iumpr_numerator[7] ZFEH_EepromData.di_obd_iumpr_numerator[80] ZFEH_EepromData.di_obd_iumpr_numerator[81] ZFEH_EepromData.di_obd_iumpr_numerator[82] ZFEH_EepromData.di_obd_iumpr_numerator[83] ZFEH_EepromData.di_obd_iumpr_numerator[84] ZFEH_EepromData.di_obd_iumpr_numerator[85] ZFEH_EepromData.di_obd_iumpr_numerator[86] ZFEH_EepromData.di_obd_iumpr_numerator[87] ZFEH_EepromData.di_obd_iumpr_numerator[88] ZFEH_EepromData.di_obd_iumpr_numerator[89] ZFEH_EepromData.di_obd_iumpr_numerator[8] ZFEH_EepromData.di_obd_iumpr_numerator[90] ZFEH_EepromData.di_obd_iumpr_numerator[91] ZFEH_EepromData.di_obd_iumpr_numerator[92] ZFEH_EepromData.di_obd_iumpr_numerator[93] ZFEH_EepromData.di_obd_iumpr_numerator[94] ZFEH_EepromData.di_obd_iumpr_numerator[95] ZFEH_EepromData.di_obd_iumpr_numerator[96] ZFEH_EepromData.di_obd_iumpr_numerator[97] ZFEH_EepromData.di_obd_iumpr_numerator[98] ZFEH_EepromData.di_obd_iumpr_numerator[99] ZFEH_EepromData.di_obd_iumpr_numerator[9] ZFEH_Obd.di_obd_abs_throttle_pos ZFEH_Obd.di_obd_calc_load ZFEH_Obd.di_obd_dist_travel_MIL_active ZFEH_Obd.di_obd_dist_travel_since_DTC_clr ZFEH_Obd.di_obd_distance ZFEH_Obd.di_obd_eng_cool_temp ZFEH_Obd.di_obd_eng_speed ZFEH_Obd.di_obd_ext_dc ZFEH_Obd.di_obd_ext_eng_run ZFEH_Obd.di_obd_ext_wuc ZFEH_Obd.di_obd_ff_available ZFEH_Obd.di_obd_mil_req ZFEH_Obd.di_obd_new_dc ZFEH_Obd.di_obd_new_dc_next_ign_on ZFEH_Obd.di_obd_new_wuc ZFEH_Obd.di_obd_pedalpos ZFEH_Obd.di_obd_ready_dc_specific_total ZFEH_Obd.di_obd_ready_total ZFEH_Obd.di_obd_time_eng_run_MIL_active ZFEH_Obd.di_obd_time_since_DTC_clr ZFEH_Obd.di_obd_time_since_eng_start ZFEH_Obd.di_obd_vehicle_speed ZFEH_Obd.di_obd_voltage ZFEH_Obd.di_obd_wuc_since_DTC_clr ZFEH_Obd.di_obd_wuc_start_temp ZFEH_Obd.di_obd_wuc_without_MIL ZFEH_Obd.iv_di_obd_abs_throttle_pos ZFEH_Obd.iv_di_obd_abs_throttle_pos_status ZFEH_Obd.iv_di_obd_backup_abs_throttle_pos ZFEH_Obd.iv_di_obd_backup_abs_throttle_pos_status ZFEH_Obd.iv_di_obd_backup_calc_load ZFEH_Obd.iv_di_obd_backup_calc_load_status ZFEH_Obd.iv_di_obd_calc_load ZFEH_Obd.iv_di_obd_calc_load_status ZFEH_Obd.iv_di_obd_distance ZFEH_Obd.iv_di_obd_eng_cool_temp ZFEH_Obd.iv_di_obd_eng_cool_temp_status ZFEH_Obd.iv_di_obd_eng_speed ZFEH_Obd.iv_di_obd_eng_speed_status ZFEH_Obd.iv_di_obd_pedalpos ZFEH_Obd.iv_di_obd_pedalpos_status ZFEH_Obd.iv_di_obd_time_ms ZFEH_Obd.iv_di_obd_vehicle_speed ZFEH_Obd.iv_di_obd_vehicle_speed_status ZFEH_Obd.iv_di_obd_voltage di_obd_norm_trip_B di_obd_vehicleIdleTime di_obd_vehicleOperationTime /end IN_MEASUREMENT
/end FUNCTION
/begin FUNCTION zff_EH_ObdErrorMemoryInformation "desc_en"
 /begin IN_MEASUREMENT ZFEH_EepromData.ydiObdMemory_xau16.obd_errorcode ZFEH_EepromData.ydiObdMemory_xau16.obd_errortype ZFEH_EepromData.ydiObdMemory_xau16.obd_freezeframes[0] ZFEH_EepromData.ydiObdMemory_xau16.obd_freezeframes[10] ZFEH_EepromData.ydiObdMemory_xau16.obd_freezeframes[11] ZFEH_EepromData.ydiObdMemory_xau16.obd_freezeframes[12] ZFEH_EepromData.ydiObdMemory_xau16.obd_freezeframes[13] ZFEH_EepromData.ydiObdMemory_xau16.obd_freezeframes[14] ZFEH_EepromData.ydiObdMemory_xau16.obd_freezeframes[15] ZFEH_EepromData.ydiObdMemory_xau16.obd_freezeframes[16] ZFEH_EepromData.ydiObdMemory_xau16.obd_freezeframes[17] ZFEH_EepromData.ydiObdMemory_xau16.obd_freezeframes[18] ZFEH_EepromData.ydiObdMemory_xau16.obd_freezeframes[19] ZFEH_EepromData.ydiObdMemory_xau16.obd_freezeframes[1] ZFEH_EepromData.ydiObdMemory_xau16.obd_freezeframes[2] ZFEH_EepromData.ydiObdMemory_xau16.obd_freezeframes[3] ZFEH_EepromData.ydiObdMemory_xau16.obd_freezeframes[4] ZFEH_EepromData.ydiObdMemory_xau16.obd_freezeframes[5] ZFEH_EepromData.ydiObdMemory_xau16.obd_freezeframes[6] ZFEH_EepromData.ydiObdMemory_xau16.obd_freezeframes[7] ZFEH_EepromData.ydiObdMemory_xau16.obd_freezeframes[8] ZFEH_EepromData.ydiObdMemory_xau16.obd_freezeframes[9] /end IN_MEASUREMENT
/end FUNCTION
/begin FUNCTION zff_EH_Statemachine "desc_en"
 /begin IN_MEASUREMENT ZFEH_Statemachine.st_errorhandler ZFEH_Statemachine.typeOfStartUp /end IN_MEASUREMENT
/end FUNCTION
/begin FUNCTION zff_SABIN "data of signal processing" /begin SUB_FUNCTION zff_SABIN_Messgroessen zff_SABIN_Applikationsgroessen /end SUB_FUNCTION /end FUNCTION
/begin FUNCTION zff_SABIN_Applikationsgroessen "all calibration values of signal processing"
 /begin SUB_FUNCTION dData_zf_SAB_EEpromZentralHandler_Fktn dData_zf_SAB_ActuatorSignalsIn_Fktn dData_zf_SAB_BootJump_Fktn dData_zf_SAB_ExtBrakeInterventionIn_Fktn dData_zf_SAB_CAN_Handling_Fktn dData_zf_SAB_CAN_SwitchingIn_Fktn dData_zf_SAB_Coding_Fktn dData_zf_SAB_ComConditionsIn_Fktn dData_zf_SAB_CrankShaftCurTorqueIn_Fktn dData_zf_SAB_DrivingDirectionIn_Fktn dData_zf_SAB_EmergencyGearInfo_Fktn dData_zf_SAB_EngineCoolantTempIn_Fktn dData_zf_SAB_EngineIdleSpeedReqIn_Fktn dData_zf_SAB_EngineSignalDiagnosis_Fktn dData_zf_SAB_GearLeverDiagnosis_Fktn dData_zf_SAB_GearLimitation_Fktn dData_zf_SAB_HybridGearboxReadyToDriveIn_Fktn dData_zf_SAB_InclinationIn_Fktn dData_zf_SAB_OBD_CyclesIn_Fktn dData_zf_SAB_OSModeSwitchingOut_Fktn dData_zf_SAB_PowerdownIn_Fktn dData_zf_SAB_ReadECUIdentification_Fktn dData_zf_SAB_RearAxleRatioIn_Fktn dData_zf_SAB_RollPreventIn_Fktn dData_zf_SAB_RoutineControl_UDS_Fktn dData_zf_SAB_BackToNormalFunctionViaReset_Fktn dData_zf_SAB_BrakePedalIn_Fktn dData_zf_SAB_BrakeTorqueIn_Fktn dData_zf_SAB_DesiredTorqueIn_Fktn dData_zf_SAB_DoorStatusIn_Fktn dData_zf_SAB_DriverSeatStatusIn_Fktn dData_zf_SAB_EngineSpeedIn_Fktn dData_zf_SAB_EngineSpeedRedIn_Fktn dData_zf_SAB_EngineTorqueIn_Fktn dData_zf_SAB_FpDkVpIn_Fktn dData_zf_SAB_GearBoxState_Fktn dData_zf_SAB_GearboxTempIn_Fktn dData_zf_SAB_GearLeverIn_Fktn dData_zf_SAB_GearRatioByCurrents_Fktn dData_zf_SAB_HybridVehicleReadyToDriveIn_Fktn dData_zf_SAB_IgnitionStatusIn_Fktn dData_zf_SAB_MSAIn_Fktn dData_zf_SAB_ParklockSensorIn_Fktn dData_zf_SAB_ParkManeuverAssistant_Fktn dData_zf_SAB_RPM_Diagnosis_Fktn dData_zf_SAB_RPM_SensingIn_Fktn dData_zf_SAB_SensorSupplyMonitoring_Fktn dData_zf_SAB_SpeedPlausibilityIn_Fktn dData_zf_SAB_TempDiagnosis_Fktn dData_zf_SAB_TransmissionOutputSpeedIn_Fktn dData_zf_SAB_TurbineSpeedIn_Fktn dData_zf_SAB_TurbineSpeedVirtualIn_Fktn dData_zf_SAB_VehicleSpeedIn_Fktn dData_zf_SAB_SportButtonIn_Fktn dData_zf_SAB_SubstTempIn_Fktn dData_zf_SAB_TimeEGSOffIn_Fktn dData_zf_SAB_TipTasterIn_Fktn dData_zf_SAB_TorqueReserveIn_Fktn dData_zf_SAB_TurbineTorqueIn_Fktn dData_zf_SAB_VoltageMonitoringOut_Fktn dData_zf_SAB_WheelIn_Fktn dData_zf_SAB_AzgDriver_Fktn dData_zf_SAB_LayerAGS_Fktn dData_zf_SAB_PMA_ErrorHandling_Fktn /end SUB_FUNCTION
/end FUNCTION
/begin FUNCTION zff_SABIN_Messgroessen "all measurements of signal processing"
 /begin SUB_FUNCTION zf_SABin_Timer zf_SAB_AzgDriver zf_SAB_Interfo zf_SAB_Timer zf_SAB_RPM_SensingIn zf_SABin_Interfi zf_SAB_Eeprom zf_SAB_EngineSpeedIn zf_SAB_IgnitionStatusIn zf_SAB_RoutineControlUDS zf_SAB_ABSIn zf_SAB_ActuatorSignalsIn zf_SAB_ASCIn zf_SAB_ASCPasIn zf_SAB_BackToNormalFunctionViaReset zf_SAB_OBD_CyclesIn zf_SAB_SpeedPlausibilityIn zf_SAB_LowModeDriveIn zf_SAB_FullThrottleTorqueIn zf_SAB_GearRatioByCurrents_fl zf_SAB_GearRatioByCurrents zf_SAB_BrakePedalIn zf_SAB_CAN_SwitchingIn zf_SAB_ChargeConditionIn zf_SAB_Coding zf_SAB_OSModeSwitchingOut zf_SAB_EngineCoolantTempIn zf_SAB_GearboxTempInFl zf_SAB_GearboxTempIn zf_SAB_TempDiagnosis_AT zf_SAB_FpDkVpIn zf_SAB_FlagTrailerInfoIn zf_SAB_DrivingStateIn zf_SAB_DrivingSpeedControlIn zf_SAB_HybridControlIn zf_SAB_HybridGearboxReadyToDriveIn zf_SAB_HybridOpModeEMIn zf_SAB_HybridVehicleReadyToDriveIn zf_SAB_YawIn zf_SAB_LDMDesiredTorqueIn zf_SAB_HDCIn zf_SAB_FlagKickDownIn zf_SAB_AccelerationLongIn zf_SAB_AmbConditionsIn zf_SAB_DistanceIn zf_SAB_FrictionIn zf_SAB_CrankShaftCurTorqueIn zf_SAB_EngineTorqueInFl zf_SAB_EngineTorqueIn zf_SAB_TorqueReserveIn zf_SAB_DesiredTorqueIn zf_SAB_FuelCutoffActiveIn zf_SAB_EngineIdleSpeedReqIn zf_SAB_BaroPressureIn zf_SAB_HybridSignalsIn zf_SAB_ExtBrakeInterventionIn zf_SAB_BrakeTorqueIn zf_SAB_AccelerationAcrossIn zf_SAB_AfuReqIn zf_SAB_RearAxleRatioIn zf_SAB_DynRunRadiusIn zf_SAB_WarmUpIn zf_SAB_VehicleSpeedIn zf_SAB_MaxTorquePredictionEMIn zf_SAB_SteeringWheelAngleIn zf_SAB_SubstTempIn zf_SAB_TransmissionOutputSpeedIn zf_SAB_WheelIn zf_SAB_RollPreventIn zf_SAB_ParkingBrakeIn zf_SAB_ParkManeuverAssistant zf_SAB_RegPartFilterIn zf_SAB_DrivingDirectionIn zf_SAB_TempDiagnosis_Fl zf_SAB_TempDiagnosis zf_SAB_TempExternIn zf_SAB_IgnitionKeyStatusIn zf_SAB_DriverSeatStatusIn zf_SAB_ShiftlockRequestExternalIn zf_SAB_EngineInterventionLimitIn zf_SAB_TurbineSpeedVirtualIn zf_SAB_TurbineSpeedIn zf_SAB_ParklockStatusIn zf_SAB_ParklockSensorIn zf_SAB_TractionControlIn zf_SAB_DoorStatusIn zf_SAB_SpeedometerSpeedIn zf_SAB_InclinationIn zf_SAB_GearLeverIn zf_SAB_SportButtonIn zf_SAB_VoltageMonitoringOut zf_SAB_CAN_Handling zf_SAB_MSAIn zf_SAB_MSAOut zf_SAB_PowerdownIn zf_SAB_TipTasterIn zf_SAB_GearLimitation zf_SAB_EmergencyGearInfo zf_SAB_RPM_Diagnosis zf_SAB_EstVehicleWeightIn zf_SAB_CurWheelTrqIn zf_SAB_TurbineTorqueIn zf_SAB_TimeEGSOffIn zf_SAB_EEpromZentralHandler zf_SAB_ComConditionsIn zf_SAB_LayerAGS zf_SAB_GearBoxState zf_SAB_EngineSignalDiagnosis zf_SAB_EngineSpeedRedIn zf_SAB_SensorSupplyMonitoring zf_SAB_BootJump zf_SAB_EngineIdleIn zf_SAB_PMA_ErrorHandling /end SUB_FUNCTION
/end FUNCTION
/begin FUNCTION zff_SABOUT "data of signal processing" /begin SUB_FUNCTION zff_SABOUT_Messgroessen zff_SABOUT_Applikationsgroessen /end SUB_FUNCTION /end FUNCTION
/begin FUNCTION zff_SABOUT_Applikationsgroessen "all calibration values of signal processing"
 /begin SUB_FUNCTION dData_zf_SAB2_EngineInterventionMonitoringOut_Fktn dData_zf_SAB2_GearboxReinforcementOut_Fktn dData_zf_SAB2_PumpIntakeTorqueOut_Fktn dData_zf_SAB2_ShiftingActiveOut_Fktn dData_zf_SAB2_EngineInterventionOut_Fktn dData_zf_SAB2_ErrorEntryOut_Fktn dData_zf_SAB2_GearboxTorqueOut_Fktn dData_zf_SAB2_HybridSignalsOut_Fktn dData_zf_SAB2_TorqueConverterOut_Fktn /end SUB_FUNCTION
/end FUNCTION
/begin FUNCTION zff_SABOUT_Messgroessen "all measurements of signal processing"
 /begin SUB_FUNCTION zf_SAB2_EngineInterventionOut_Fl zf_SAB2_EngineInterventionOut zf_SAB2_EngIdleRaiseReqOut zf_SAB2_Timer zf_SAB2_GearboxTorqueOut zf_SAB2_ConfEGSACCOut zf_SAB2_CoolingReqOut zf_SAB2_DashboardInfoOut zf_SAB2_EngineInterventionMonitoringOut zf_HNS_TIMER zf_SAB2_ErrorEntryOut_Fl zf_SAB2_ErrorEntryOut zf_SAB2_GearboxLossesOut zf_SAB2_Interfi zf_SAB2_GearboxReinforcementOut zf_SAB2_HybridControlOut zf_SAB2_HybridSignalsOut zf_SAB2_MIL_RequestOut zf_SAB2_MStartLimitationOut zf_SAB2_NICActiveOut zf_SAB2_PumpIntakeTorqueOut zf_SAB2_ShiftingActiveOut zf_SAB2_SynEngineSpeedOut zf_SAB2_TorqueConverterOut /end SUB_FUNCTION
/end FUNCTION
/begin FUNCTION zff_SBW "data of E/M-Schaltung" /begin SUB_FUNCTION zff_SBW_Messgroessen zff_SBW_Applikationsgroessen /end SUB_FUNCTION /end FUNCTION
/begin FUNCTION zff_SBW_Applikationsgroessen "all calibration values of E/M-Schaltung"
 /begin SUB_FUNCTION dData_zff_ABK_MODEIN_Fktn dData_zff_ABK_RELTOABS_Fktn dData_zff_ABK_KOMBI_MSG_Fktn dData_zff_ABK_KOMBIMSGPOS_Fktn dData_zff_ABK_KOMBIMSGMODE_Fktn dData_zff_ABK_KOMBIMSGGEAR_Fktn dData_zff_ABK_KOMBIMSGFLASH_Fktn dData_zff_ABK_SHIFTLOCK_Fktn dData_zff_ABK_SIGNALS_Fktn dData_zff_ABK_ENGINESIGNALS_Fktn dData_zff_ABK_SIGCOND_Fktn dData_zff_ABK_DRVPRESENCEDETECTOR_Fktn dData_zff_ABK_STARTERRELEASEDELAY_Fktn dData_zff_ABK_DEBOUNCEDRVREQ_Fktn dData_zff_ABK_STOREDRVREQ_Fktn dData_zff_ABK_MODE_Fktn dData_zff_ABK_MODECHTABLE_Fktn dData_zff_ABK_DIAGPOS_Fktn dData_zff_ABK_POS_INITPOS_Fktn dData_zff_ABK_FASREQ2POS_Fktn dData_zff_ABK_AUTOPOS_Fktn dData_zff_ABK_CC_MSG_Fktn dData_zff_ABK_SrvcMsgHandler_Fktn dData_zff_ABK_CARWASHMODE_Fktn dData_zff_ABK_LEVEL2DIAG_Fktn dData_zff_ABK_POWERDOWN_Fktn dData_zff_ABK_EWS4_Fktn /end SUB_FUNCTION
/end FUNCTION
/begin FUNCTION zff_SBW_Messgroessen "all measurements of E/M-Schaltung"
 /begin SUB_FUNCTION zff_ABK_TIMER zff_ABK_SIGNALS zff_ABK_ENGINESIGNALS zff_ABK_PAKCONFIG zff_ABK_DRVPRESENCEDETECTOR zff_ABK_EWS4 zff_ABK_EEPROM zff_ABK_SIGNAL_CONDITIONING zff_ABK_INTERFI zff_ABK_DISPATCH zff_ABK_CARWASHMODE zff_ABK_MODE zff_ABK_MODEIN zff_ABK_RELTOABS zff_ABK_MULTACCESS zff_ABK_DEBOUNCEDRVREQ zff_ABK_STOREDRVREQ zff_ABK_DIAGPOS zff_ABK_AUTOPOS zff_ABK_POS_INITPOS zff_ABK_DRVREQ2POS zff_ABK_FASREQ2POS zff_ABK_SHIFTLOCK zff_ABK_KOMBI_MSG zff_ABK_KOMBIMSGPOS zff_ABK_KOMBIMSGMODE zff_ABK_KOMBIMSGGEAR zff_ABK_KOMBIMSGFLASH zff_ABK_KOMBIMSGOUTBMW zff_ABK_POWERDOWN zff_ABK_SRVCMSGHANDLER zff_ABK_CC_MSG zff_ABK_LEVEL2DIAG zff_ABK_TESTERACCESS zff_ABK_INTOSCALLSRAM zff_ABK_STARTERRELEASE zff_ABK_STARTERRELEASEBMW zff_ABK_STARTERRELEASEBPRAM zff_ABK_STATISTICCOUNTER zff_ABK_GEARBOXSTATE /end SUB_FUNCTION
/end FUNCTION
/begin RECORD_LAYOUT _REC_A1CUR_1_u2_u2_S2 FNC_VALUES 1 UWORD COLUMN_DIR DIRECT /end RECORD_LAYOUT
/begin RECORD_LAYOUT _REC_A2AXS_31_u2_S2 AXIS_PTS_X 2 UWORD INDEX_INCR DIRECT NO_AXIS_PTS_X 1 UWORD /end RECORD_LAYOUT
/end MODULE
/end PROJECT
