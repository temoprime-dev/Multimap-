ASAP2_VERSION 1 51
/begin PROJECT ZHBC8600 "Gen2_BMW_System_Supplier_Lib"
/begin MODULE CPP ""
/begin MOD_COMMON "" BYTE_ORDER MSB_FIRST ALIGNMENT_BYTE 1 ALIGNMENT_WORD 2 ALIGNMENT_LONG 4 ALIGNMENT_FLOAT32_IEEE 4 ALIGNMENT_FLOAT64_IEEE 1 /end MOD_COMMON
/begin COMPU_METHOD SAB2_1000K4016_M32_S3_S3 "int = ((phys * 4016) / 1000) - (-127) -" RAT_FUNC "%4.3" "-" COEFFS 0 4.016 127 0 0 1 /end COMPU_METHOD
/begin COMPU_METHOD SAB2_100PROZENT254_S3_S3 "int = ((phys * 254) / 100) - (0) %" RAT_FUNC "%4.3" "%" COEFFS 0 2.54 0 0 0 1 /end COMPU_METHOD
/begin COMPU_METHOD UMR___1_100_0_S5_S3 "int = ((phys * 100) / 1) - (0) [-]" RAT_FUNC "%3.2" "[-]" COEFFS 0 100 0 0 0 1 /end COMPU_METHOD
/begin COMPU_METHOD UMR___1_1_0_S5_S3 "int = ((phys * 1) / 1) - (0) [-]" RAT_FUNC "%1.0" "[-]" COEFFS 0 1 0 0 0 1 /end COMPU_METHOD
/begin COMPU_METHOD UMR_BAR__1_1000_0_S5_S3 "int = ((phys * 1000) / 1) - (0) [bar]" RAT_FUNC "%4.3" "[bar]" COEFFS 0 1000 0 0 0 1 /end COMPU_METHOD
/begin COMPU_METHOD UMR_BAR_SEC_1_10_0_S5_S3 "int = ((phys * 10) / 1) - (0) [bar/s]" RAT_FUNC "%2.1" "[bar/s]" COEFFS 0 10 0 0 0 1 /end COMPU_METHOD
/begin COMPU_METHOD UMR_GRADC__1_1_M40_S5_S3 "int = ((phys * 1) / 1) - (-40) [°C]" RAT_FUNC "%1.0" "[°C]" COEFFS 0 1 40 0 0 1 /end COMPU_METHOD
/begin COMPU_METHOD UMR_MBAR_SEC_1_1_0_S5_S3 "int = ((phys * 1) / 1) - (0) [mbar/s]" RAT_FUNC "%1.0" "[mbar/s]" COEFFS 0 1 0 0 0 1 /end COMPU_METHOD
/begin COMPU_METHOD UMR_MSEC__10_1_0_S5_S3 "int = ((phys * 1) / 10) - (0) [ms]" RAT_FUNC "%1.0" "[ms]" COEFFS 0 0.1 0 0 0 1 /end COMPU_METHOD
/begin COMPU_METHOD UMR_MSEC__10_1_M128_S5_S3 "int = ((phys * 1) / 10) - (-128) [ms]" RAT_FUNC "%1.0" "[ms]" COEFFS 0 0.1 128 0 0 1 /end COMPU_METHOD
/begin COMPU_METHOD UMR_NM__1_1_0_S5_S3 "int = ((phys * 1) / 1) - (0) [Nm]" RAT_FUNC "%1.0" "[Nm]" COEFFS 0 1 0 0 0 1 /end COMPU_METHOD
/begin COMPU_METHOD UMR_NM__6_1_M34_S5_S3 "int = ((phys * 1) / 6) - (-34) [Nm]" RAT_FUNC "%1.0" "[Nm]" COEFFS 0 0.166666666667 34 0 0 1 /end COMPU_METHOD
/begin COMPU_METHOD UMR_PROZENT__20_51_0_S5_S3 "int = ((phys * 51) / 20) - (0) [%]" RAT_FUNC "%5.4" "[%]" COEFFS 0 2.55 0 0 0 1 /end COMPU_METHOD
/begin COMPU_METHOD UMR_U_MIN_1_1_0_S5_S3 "int = ((phys * 1) / 1) - (0) [U/min]" RAT_FUNC "%1.0" "[U/min]" COEFFS 0 1 0 0 0 1 /end COMPU_METHOD
/begin COMPU_METHOD UMR_U_MIN_32_1_0_S5_S3 "int = ((phys * 1) / 32) - (0) [U/min]" RAT_FUNC "%1.0" "[U/min]" COEFFS 0 0.03125 0 0 0 1 /end COMPU_METHOD
/begin COMPU_METHOD UMR_U_MINSEC_1_1_0_S5_S3 "int = ((phys * 1) / 1) - (0) [U/(min*s)]" RAT_FUNC "%1.0" "[U/(min*s)]" COEFFS 0 1 0 0 0 1 /end COMPU_METHOD
/begin CHARACTERISTIC DKIS_RNDDNR "Drosselklappenschwelle Sofkt. bei RND bzw. DNR" VALUE 0x1D7A4D ZF_kw_ui8_S5_S3 100 UMR_PROZENT__20_51_0_S5_S3 0 100 /end CHARACTERISTIC
/begin CHARACTERISTIC F_PRAHKABSPORT84 "Druckfaktor waehrend Rampe auf Schaltdruck" VALUE 0x1D7A23 ZF_kw_ui8_S5_S3 1 UMR___1_100_0_S5_S3 0 1 /end CHARACTERISTIC
/begin CHARACTERISTIC F_PRAHKABSPORT86 "Druckfaktor waehrend Rampe auf Schaltdruck" VALUE 0x1D7A26 ZF_kw_ui8_S5_S3 1 UMR___1_100_0_S5_S3 0 1 /end CHARACTERISTIC
/begin CHARACTERISTIC F_PRAHKABSPORT87 "Druckfaktor waehrend Rampe auf Schaltdruck" VALUE 0x1D7A05 ZF_kw_ui8_S5_S3 1 UMR___1_100_0_S5_S3 0 1 /end CHARACTERISTIC
/begin CHARACTERISTIC F_PRA_1 "Druckfaktor waehrend Rampe auf Schaltdruck" VALUE 0x1D7A5B ZF_kw_ui8_S5_S3 1 UMR___1_100_0_S5_S3 0 1 /end CHARACTERISTIC
/begin CHARACTERISTIC F_PRA_2 "Druckfaktor waehrend Rampe auf Schaltdruck" VALUE 0x1D7A63 ZF_kw_ui8_S5_S3 1 UMR___1_100_0_S5_S3 0 1 /end CHARACTERISTIC
/begin CHARACTERISTIC F_PRA_3 "Druckfaktor waehrend Rampe auf Schaltdruck" VALUE 0x1D7A6B ZF_kw_ui8_S5_S3 1 UMR___1_100_0_S5_S3 0 1 /end CHARACTERISTIC
/begin CHARACTERISTIC F_PRA_4 "Druckfaktor waehrend Rampe auf Schaltdruck" VALUE 0x1D7A73 ZF_kw_ui8_S5_S3 1 UMR___1_100_0_S5_S3 0 1 /end CHARACTERISTIC
/begin CHARACTERISTIC F_PRA_5 "Druckfaktor waehrend Rampe auf Schaltdruck" VALUE 0x1D7A7B ZF_kw_ui8_S5_S3 1 UMR___1_100_0_S5_S3 0 1 /end CHARACTERISTIC
/begin CHARACTERISTIC F_PRA_6 "Druckfaktor waehrend Rampe auf Schaltdruck" VALUE 0x1D7A83 ZF_kw_ui8_S5_S3 1 UMR___1_100_0_S5_S3 0 1 /end CHARACTERISTIC
/begin CHARACTERISTIC F_TRAHKABSPORT84 "Zeitfaktor waehrend Rampe auf Schaltdruck" VALUE 0x1D7A24 ZF_kw_ui8_S5_S3 1 UMR___1_100_0_S5_S3 0 1 /end CHARACTERISTIC
/begin CHARACTERISTIC F_TRAHKABSPORT86 "Zeitfaktor waehrend Rampe auf Schaltdruck" VALUE 0x1D7A27 ZF_kw_ui8_S5_S3 1 UMR___1_100_0_S5_S3 0 1 /end CHARACTERISTIC
/begin CHARACTERISTIC F_TRAHKABSPORT87 "Zeitfaktor waehrend Rampe auf Schaltdruck" VALUE 0x1D7A06 ZF_kw_ui8_S5_S3 1 UMR___1_100_0_S5_S3 0 1 /end CHARACTERISTIC
/begin CHARACTERISTIC F_TRA_1 "Zeitfaktor waehrend Rampe auf Schaltdruck" VALUE 0x1D7A5C ZF_kw_ui8_S5_S3 1 UMR___1_100_0_S5_S3 0 1 /end CHARACTERISTIC
/begin CHARACTERISTIC F_TRA_2 "Zeitfaktor waehrend Rampe auf Schaltdruck" VALUE 0x1D7A64 ZF_kw_ui8_S5_S3 1 UMR___1_100_0_S5_S3 0 1 /end CHARACTERISTIC
/begin CHARACTERISTIC F_TRA_3 "Zeitfaktor waehrend Rampe auf Schaltdruck" VALUE 0x1D7A6C ZF_kw_ui8_S5_S3 1 UMR___1_100_0_S5_S3 0 1 /end CHARACTERISTIC
/begin CHARACTERISTIC F_TRA_4 "Zeitfaktor waehrend Rampe auf Schaltdruck" VALUE 0x1D7A74 ZF_kw_ui8_S5_S3 1 UMR___1_100_0_S5_S3 0 1 /end CHARACTERISTIC
/begin CHARACTERISTIC F_TRA_5 "Zeitfaktor waehrend Rampe auf Schaltdruck" VALUE 0x1D7A7C ZF_kw_ui8_S5_S3 1 UMR___1_100_0_S5_S3 0 1 /end CHARACTERISTIC
/begin CHARACTERISTIC F_TRA_6 "Zeitfaktor waehrend Rampe auf Schaltdruck" VALUE 0x1D7A84 ZF_kw_ui8_S5_S3 1 UMR___1_100_0_S5_S3 0 1 /end CHARACTERISTIC
/begin CHARACTERISTIC KF_PKABNDNMOTNTCGD2NR "Druckstartwert Sofkt. Kupplung B bei RND" MAP 0x1BEEC4 ZF_kf_si16_S5_S3 2 UMR_BAR__1_1000_0_S5_S3 0 2
 /begin AXIS_DESCR STD_AXIS iSasZentr.nd_nmot_nt UMR_U_MIN_1_1_0_S5_S3 3 -16320 16320 DEPOSIT ABSOLUTE /end AXIS_DESCR
 /begin AXIS_DESCR STD_AXIS zff_atsys._.iSignale._.obj.sig_c_getr UMR_GRADC__1_1_M40_S5_S3 2 -40 150 DEPOSIT ABSOLUTE /end AXIS_DESCR
/end CHARACTERISTIC
/begin CHARACTERISTIC KF_PKABNDNMOTNTCGDNR "Druckstartwert Sofkt. Kupplung B bei RND" MAP 0x1BEE44 ZF_kf_si16_S5_S3 2 UMR_BAR__1_1000_0_S5_S3 0 2
 /begin AXIS_DESCR STD_AXIS iSasZentr.nd_nmot_nt UMR_U_MIN_1_1_0_S5_S3 3 -16320 16320 DEPOSIT ABSOLUTE /end AXIS_DESCR
 /begin AXIS_DESCR STD_AXIS zff_atsys._.iSignale._.obj.sig_c_getr UMR_GRADC__1_1_M40_S5_S3 2 -40 150 DEPOSIT ABSOLUTE /end AXIS_DESCR
/end CHARACTERISTIC
/begin CHARACTERISTIC KF_PKABNDNMOTNTCGDNRV2 "Druckstartwert Sofkt. Kupplung B bei RND" MAP 0x1BEE84 ZF_kf_si16_S5_S3 2 UMR_BAR__1_1000_0_S5_S3 0 2
 /begin AXIS_DESCR STD_AXIS iSasZentr.nd_nmot_nt UMR_U_MIN_1_1_0_S5_S3 3 -16320 16320 DEPOSIT ABSOLUTE /end AXIS_DESCR
 /begin AXIS_DESCR STD_AXIS zff_atsys._.iSignale._.obj.sig_c_getr UMR_GRADC__1_1_M40_S5_S3 2 -40 150 DEPOSIT ABSOLUTE /end AXIS_DESCR
/end CHARACTERISTIC
/begin CHARACTERISTIC KF_PKABNDNMOTNTCGRND "Druckstartwert Sofkt. Kupplung B bei RND" MAP 0x1BEE64 ZF_kf_si16_S5_S3 2 UMR_BAR__1_1000_0_S5_S3 0 2
 /begin AXIS_DESCR STD_AXIS iSasZentr.nd_nmot_nt UMR_U_MIN_1_1_0_S5_S3 3 -16320 16320 DEPOSIT ABSOLUTE /end AXIS_DESCR
 /begin AXIS_DESCR STD_AXIS zff_atsys._.iSignale._.obj.sig_c_getr UMR_GRADC__1_1_M40_S5_S3 2 -40 150 DEPOSIT ABSOLUTE /end AXIS_DESCR
/end CHARACTERISTIC
/begin CHARACTERISTIC KF_PKABNDNMOTNTCGRNDV2 "Druckstartwert Sofkt. Kupplung B bei RND" MAP 0x1BEEA4 ZF_kf_si16_S5_S3 2 UMR_BAR__1_1000_0_S5_S3 0 2
 /begin AXIS_DESCR STD_AXIS iSasZentr.nd_nmot_nt UMR_U_MIN_1_1_0_S5_S3 3 -16320 16320 DEPOSIT ABSOLUTE /end AXIS_DESCR
 /begin AXIS_DESCR STD_AXIS zff_atsys._.iSignale._.obj.sig_c_getr UMR_GRADC__1_1_M40_S5_S3 2 -40 150 DEPOSIT ABSOLUTE /end AXIS_DESCR
/end CHARACTERISTIC
/begin CHARACTERISTIC KF_PKABSPORT84 "Schaltdruck abschaltende Kupplung" MAP 0x1BD67C ZF_kf_si16_S5_S3 12.75 UMR_BAR__1_1000_0_S5_S3 0 12.75
 /begin AXIS_DESCR STD_AXIS iSasZentr.iSchaltend.n_tkf UMR_U_MIN_32_1_0_S5_S3 8 0 8160 DEPOSIT ABSOLUTE /end AXIS_DESCR
 /begin AXIS_DESCR STD_AXIS zff_atsys._.iSignale._.obj.sig_m_t UMR_NM__1_1_0_S5_S3 10 -200 1300 DEPOSIT ABSOLUTE /end AXIS_DESCR
/end CHARACTERISTIC
/begin CHARACTERISTIC KF_PKABSPORT86 "Schaltdruck abschaltende Kupplung" MAP 0x1BD834 ZF_kf_si16_S5_S3 12.75 UMR_BAR__1_1000_0_S5_S3 0 12.75
 /begin AXIS_DESCR STD_AXIS iSasZentr.iSchaltend.n_tkf UMR_U_MIN_32_1_0_S5_S3 8 0 8160 DEPOSIT ABSOLUTE /end AXIS_DESCR
 /begin AXIS_DESCR STD_AXIS zff_atsys._.iSignale._.obj.sig_m_t UMR_NM__1_1_0_S5_S3 10 -200 1300 DEPOSIT ABSOLUTE /end AXIS_DESCR
/end CHARACTERISTIC
/begin CHARACTERISTIC KF_PKABSPORT87 "Schaltdruck abschaltende Kupplung" MAP 0x1BC54C ZF_kf_si16_S5_S3 12.75 UMR_BAR__1_1000_0_S5_S3 0 12.75
 /begin AXIS_DESCR STD_AXIS iSasZentr.iSchaltend.n_tkf UMR_U_MIN_32_1_0_S5_S3 8 0 8160 DEPOSIT ABSOLUTE /end AXIS_DESCR
 /begin AXIS_DESCR STD_AXIS zff_atsys._.iSignale._.obj.sig_m_t UMR_NM__1_1_0_S5_S3 10 -200 1300 DEPOSIT ABSOLUTE /end AXIS_DESCR
/end CHARACTERISTIC
/begin CHARACTERISTIC KF_PKZU_1 "Schaltdruck zuschaltende Kupplung" MAP 0x1BFAC4 ZF_kf_si16_S5_S3 12.75 UMR_BAR__1_1000_0_S5_S3 0 12.75
 /begin AXIS_DESCR STD_AXIS iSasZentr.iSchaltend.n_tkf UMR_U_MIN_32_1_0_S5_S3 8 0 8160 DEPOSIT ABSOLUTE /end AXIS_DESCR
 /begin AXIS_DESCR STD_AXIS zff_atsys._.iSignale._.obj.sig_m_t UMR_NM__1_1_0_S5_S3 10 -200 1300 DEPOSIT ABSOLUTE /end AXIS_DESCR
/end CHARACTERISTIC
/begin CHARACTERISTIC KF_PKZU_2 "Schaltdruck zuschaltende Kupplung" MAP 0x1BFFF4 ZF_kf_si16_S5_S3 12.75 UMR_BAR__1_1000_0_S5_S3 0 12.75
 /begin AXIS_DESCR STD_AXIS iSasZentr.iSchaltend.n_tkf UMR_U_MIN_32_1_0_S5_S3 8 0 8160 DEPOSIT ABSOLUTE /end AXIS_DESCR
 /begin AXIS_DESCR STD_AXIS zff_atsys._.iSignale._.obj.sig_m_t UMR_NM__1_1_0_S5_S3 10 -200 1300 DEPOSIT ABSOLUTE /end AXIS_DESCR
/end CHARACTERISTIC
/begin CHARACTERISTIC KF_PKZU_3 "Schaltdruck zuschaltende Kupplung" MAP 0x1C0524 ZF_kf_si16_S5_S3 12.75 UMR_BAR__1_1000_0_S5_S3 0 12.75
 /begin AXIS_DESCR STD_AXIS iSasZentr.iSchaltend.n_tkf UMR_U_MIN_32_1_0_S5_S3 8 0 8160 DEPOSIT ABSOLUTE /end AXIS_DESCR
 /begin AXIS_DESCR STD_AXIS zff_atsys._.iSignale._.obj.sig_m_t UMR_NM__1_1_0_S5_S3 10 -200 1300 DEPOSIT ABSOLUTE /end AXIS_DESCR
/end CHARACTERISTIC
/begin CHARACTERISTIC KF_PKZU_4 "Schaltdruck zuschaltende Kupplung" MAP 0x1C0A54 ZF_kf_si16_S5_S3 12.75 UMR_BAR__1_1000_0_S5_S3 0 12.75
 /begin AXIS_DESCR STD_AXIS iSasZentr.iSchaltend.n_tkf UMR_U_MIN_32_1_0_S5_S3 8 0 8160 DEPOSIT ABSOLUTE /end AXIS_DESCR
 /begin AXIS_DESCR STD_AXIS zff_atsys._.iSignale._.obj.sig_m_t UMR_NM__1_1_0_S5_S3 10 -200 1300 DEPOSIT ABSOLUTE /end AXIS_DESCR
/end CHARACTERISTIC
/begin CHARACTERISTIC KF_PKZU_5 "Schaltdruck zuschaltende Kupplung" MAP 0x1C0F84 ZF_kf_si16_S5_S3 12.75 UMR_BAR__1_1000_0_S5_S3 0 12.75
 /begin AXIS_DESCR STD_AXIS iSasZentr.iSchaltend.n_tkf UMR_U_MIN_32_1_0_S5_S3 8 0 8160 DEPOSIT ABSOLUTE /end AXIS_DESCR
 /begin AXIS_DESCR STD_AXIS zff_atsys._.iSignale._.obj.sig_m_t UMR_NM__1_1_0_S5_S3 10 -200 1300 DEPOSIT ABSOLUTE /end AXIS_DESCR
/end CHARACTERISTIC
/begin CHARACTERISTIC KF_PKZU_6 "Schaltdruck zuschaltende Kupplung" MAP 0x1C14B4 ZF_kf_si16_S5_S3 12.75 UMR_BAR__1_1000_0_S5_S3 0 12.75
 /begin AXIS_DESCR STD_AXIS iSasZentr.iSchaltend.n_tkf UMR_U_MIN_32_1_0_S5_S3 8 0 8160 DEPOSIT ABSOLUTE /end AXIS_DESCR
 /begin AXIS_DESCR STD_AXIS zff_atsys._.iSignale._.obj.sig_m_t UMR_NM__1_1_0_S5_S3 10 -200 1300 DEPOSIT ABSOLUTE /end AXIS_DESCR
/end CHARACTERISTIC
/begin CHARACTERISTIC KF_PODKIMOTSOLLNMOTGE_1 "Druckoffset Fuell- und Schaltdruck" MAP 0x1BF78C ZF_kf_si16_S5_S3 22 UMR_BAR__1_1000_0_S5_S3 0 22
 /begin AXIS_DESCR STD_AXIS zff_atsys._.iSignale._.obj.sig_dki_mmotsoll UMR___1_1_0_S5_S3 5 -400 1640 DEPOSIT ABSOLUTE /end AXIS_DESCR
 /begin AXIS_DESCR STD_AXIS zff_atsys._.iSignale._.obj.sig_n_mot UMR_U_MIN_1_1_0_S5_S3 5 0 8160 DEPOSIT ABSOLUTE /end AXIS_DESCR
/end CHARACTERISTIC
/begin CHARACTERISTIC KF_PODKIMOTSOLLNMOTGE_2 "Druckoffset Fuell- und Schaltdruck" MAP 0x1BFCBC ZF_kf_si16_S5_S3 22 UMR_BAR__1_1000_0_S5_S3 0 22
 /begin AXIS_DESCR STD_AXIS zff_atsys._.iSignale._.obj.sig_dki_mmotsoll UMR___1_1_0_S5_S3 5 -400 1640 DEPOSIT ABSOLUTE /end AXIS_DESCR
 /begin AXIS_DESCR STD_AXIS zff_atsys._.iSignale._.obj.sig_n_mot UMR_U_MIN_1_1_0_S5_S3 5 0 8160 DEPOSIT ABSOLUTE /end AXIS_DESCR
/end CHARACTERISTIC
/begin CHARACTERISTIC KF_PODKIMOTSOLLNMOTGE_3 "Druckoffset Fuell- und Schaltdruck" MAP 0x1C01EC ZF_kf_si16_S5_S3 22 UMR_BAR__1_1000_0_S5_S3 0 22
 /begin AXIS_DESCR STD_AXIS zff_atsys._.iSignale._.obj.sig_dki_mmotsoll UMR___1_1_0_S5_S3 5 -400 1640 DEPOSIT ABSOLUTE /end AXIS_DESCR
 /begin AXIS_DESCR STD_AXIS zff_atsys._.iSignale._.obj.sig_n_mot UMR_U_MIN_1_1_0_S5_S3 5 0 8160 DEPOSIT ABSOLUTE /end AXIS_DESCR
/end CHARACTERISTIC
/begin CHARACTERISTIC KF_PODKIMOTSOLLNMOTGE_4 "Druckoffset Fuell- und Schaltdruck" MAP 0x1C071C ZF_kf_si16_S5_S3 22 UMR_BAR__1_1000_0_S5_S3 0 22
 /begin AXIS_DESCR STD_AXIS zff_atsys._.iSignale._.obj.sig_dki_mmotsoll UMR___1_1_0_S5_S3 5 -400 1640 DEPOSIT ABSOLUTE /end AXIS_DESCR
 /begin AXIS_DESCR STD_AXIS zff_atsys._.iSignale._.obj.sig_n_mot UMR_U_MIN_1_1_0_S5_S3 5 0 8160 DEPOSIT ABSOLUTE /end AXIS_DESCR
/end CHARACTERISTIC
/begin CHARACTERISTIC KF_PODKIMOTSOLLNMOTGE_5 "Druckoffset Fuell- und Schaltdruck" MAP 0x1C0C4C ZF_kf_si16_S5_S3 22 UMR_BAR__1_1000_0_S5_S3 0 22
 /begin AXIS_DESCR STD_AXIS zff_atsys._.iSignale._.obj.sig_dki_mmotsoll UMR___1_1_0_S5_S3 5 -400 1640 DEPOSIT ABSOLUTE /end AXIS_DESCR
 /begin AXIS_DESCR STD_AXIS zff_atsys._.iSignale._.obj.sig_n_mot UMR_U_MIN_1_1_0_S5_S3 5 0 8160 DEPOSIT ABSOLUTE /end AXIS_DESCR
/end CHARACTERISTIC
/begin CHARACTERISTIC KF_PODKIMOTSOLLNMOTGE_6 "Druckoffset Fuell- und Schaltdruck" MAP 0x1C117C ZF_kf_si16_S5_S3 22 UMR_BAR__1_1000_0_S5_S3 0 22
 /begin AXIS_DESCR STD_AXIS zff_atsys._.iSignale._.obj.sig_dki_mmotsoll UMR___1_1_0_S5_S3 5 -400 1640 DEPOSIT ABSOLUTE /end AXIS_DESCR
 /begin AXIS_DESCR STD_AXIS zff_atsys._.iSignale._.obj.sig_n_mot UMR_U_MIN_1_1_0_S5_S3 5 0 8160 DEPOSIT ABSOLUTE /end AXIS_DESCR
/end CHARACTERISTIC
/begin CHARACTERISTIC KF_PODKIMOTSOLLNMOTGE_ECO_1 "Druckoffset Fuell- und Schaltdruck bei ECO-Mode" MAP 0x1BF7DC ZF_kf_si16_S5_S3 22 UMR_BAR__1_1000_0_S5_S3 0 22
 /begin AXIS_DESCR STD_AXIS zff_atsys._.iSignale._.obj.sig_dki_mmotsoll UMR___1_1_0_S5_S3 5 -400 1640 DEPOSIT ABSOLUTE /end AXIS_DESCR
 /begin AXIS_DESCR STD_AXIS zff_atsys._.iSignale._.obj.sig_n_mot UMR_U_MIN_1_1_0_S5_S3 5 0 8160 DEPOSIT ABSOLUTE /end AXIS_DESCR
/end CHARACTERISTIC
/begin CHARACTERISTIC KF_PODKIMOTSOLLNMOTGE_ECO_2 "Druckoffset Fuell- und Schaltdruck bei ECO-Mode" MAP 0x1BFD0C ZF_kf_si16_S5_S3 22 UMR_BAR__1_1000_0_S5_S3 0 22
 /begin AXIS_DESCR STD_AXIS zff_atsys._.iSignale._.obj.sig_dki_mmotsoll UMR___1_1_0_S5_S3 5 -400 1640 DEPOSIT ABSOLUTE /end AXIS_DESCR
 /begin AXIS_DESCR STD_AXIS zff_atsys._.iSignale._.obj.sig_n_mot UMR_U_MIN_1_1_0_S5_S3 5 0 8160 DEPOSIT ABSOLUTE /end AXIS_DESCR
/end CHARACTERISTIC
/begin CHARACTERISTIC KF_PODKIMOTSOLLNMOTGE_ECO_3 "Druckoffset Fuell- und Schaltdruck bei ECO-Mode" MAP 0x1C023C ZF_kf_si16_S5_S3 22 UMR_BAR__1_1000_0_S5_S3 0 22
 /begin AXIS_DESCR STD_AXIS zff_atsys._.iSignale._.obj.sig_dki_mmotsoll UMR___1_1_0_S5_S3 5 -400 1640 DEPOSIT ABSOLUTE /end AXIS_DESCR
 /begin AXIS_DESCR STD_AXIS zff_atsys._.iSignale._.obj.sig_n_mot UMR_U_MIN_1_1_0_S5_S3 5 0 8160 DEPOSIT ABSOLUTE /end AXIS_DESCR
/end CHARACTERISTIC
/begin CHARACTERISTIC KF_PODKIMOTSOLLNMOTGE_ECO_4 "Druckoffset Fuell- und Schaltdruck bei ECO-Mode" MAP 0x1C076C ZF_kf_si16_S5_S3 22 UMR_BAR__1_1000_0_S5_S3 0 22
 /begin AXIS_DESCR STD_AXIS zff_atsys._.iSignale._.obj.sig_dki_mmotsoll UMR___1_1_0_S5_S3 5 -400 1640 DEPOSIT ABSOLUTE /end AXIS_DESCR
 /begin AXIS_DESCR STD_AXIS zff_atsys._.iSignale._.obj.sig_n_mot UMR_U_MIN_1_1_0_S5_S3 5 0 8160 DEPOSIT ABSOLUTE /end AXIS_DESCR
/end CHARACTERISTIC
/begin CHARACTERISTIC KF_PODKIMOTSOLLNMOTGE_ECO_5 "Druckoffset Fuell- und Schaltdruck bei ECO-Mode" MAP 0x1C0C9C ZF_kf_si16_S5_S3 22 UMR_BAR__1_1000_0_S5_S3 0 22
 /begin AXIS_DESCR STD_AXIS zff_atsys._.iSignale._.obj.sig_dki_mmotsoll UMR___1_1_0_S5_S3 5 -400 1640 DEPOSIT ABSOLUTE /end AXIS_DESCR
 /begin AXIS_DESCR STD_AXIS zff_atsys._.iSignale._.obj.sig_n_mot UMR_U_MIN_1_1_0_S5_S3 5 0 8160 DEPOSIT ABSOLUTE /end AXIS_DESCR
/end CHARACTERISTIC
/begin CHARACTERISTIC KF_PODKIMOTSOLLNMOTGE_ECO_6 "Druckoffset Fuell- und Schaltdruck bei ECO-Mode" MAP 0x1C11CC ZF_kf_si16_S5_S3 22 UMR_BAR__1_1000_0_S5_S3 0 22
 /begin AXIS_DESCR STD_AXIS zff_atsys._.iSignale._.obj.sig_dki_mmotsoll UMR___1_1_0_S5_S3 5 -400 1640 DEPOSIT ABSOLUTE /end AXIS_DESCR
 /begin AXIS_DESCR STD_AXIS zff_atsys._.iSignale._.obj.sig_n_mot UMR_U_MIN_1_1_0_S5_S3 5 0 8160 DEPOSIT ABSOLUTE /end AXIS_DESCR
/end CHARACTERISTIC
/begin CHARACTERISTIC KF_POFMTNESTART12 "Kennfeld Fuelldruckoffset(n_t, m_t)" MAP 0x1BEEF0 ZF_kf_si16_S5_S3 12.75 UMR_BAR__1_1000_0_S5_S3 -6.4 6.35
 /begin AXIS_DESCR STD_AXIS zff_atsys._.iSignale._.obj.sig_n_t UMR_U_MIN_1_1_0_S5_S3 4 0 8160 DEPOSIT ABSOLUTE /end AXIS_DESCR
 /begin AXIS_DESCR STD_AXIS zff_atsys._.iSignale._.obj.sig_m_t UMR_NM__1_1_0_S5_S3 6 -200 1300 DEPOSIT ABSOLUTE /end AXIS_DESCR
/end CHARACTERISTIC
/begin CHARACTERISTIC KF_POFMTNFUELLRED_1 "Kennfeld Fuelldruckoffset(n_t, m_t)" MAP 0x1BF850 ZF_kf_si16_S5_S3 12.75 UMR_BAR__1_1000_0_S5_S3 -6.4 6.35
 /begin AXIS_DESCR STD_AXIS iSasZentr.iSchaltend.nd_syn UMR_U_MIN_1_1_0_S5_S3 4 -8000 8000 DEPOSIT ABSOLUTE /end AXIS_DESCR
 /begin AXIS_DESCR STD_AXIS zff_atsys._.iSignale._.obj.sig_m_t UMR_NM__1_1_0_S5_S3 6 -200 1300 DEPOSIT ABSOLUTE /end AXIS_DESCR
/end CHARACTERISTIC
/begin CHARACTERISTIC KF_POFMTNFUELLRED_2 "Kennfeld Fuelldruckoffset(n_t, m_t)" MAP 0x1BFD80 ZF_kf_si16_S5_S3 12.75 UMR_BAR__1_1000_0_S5_S3 -6.4 6.35
 /begin AXIS_DESCR STD_AXIS iSasZentr.iSchaltend.nd_syn UMR_U_MIN_1_1_0_S5_S3 4 -8000 8000 DEPOSIT ABSOLUTE /end AXIS_DESCR
 /begin AXIS_DESCR STD_AXIS zff_atsys._.iSignale._.obj.sig_m_t UMR_NM__1_1_0_S5_S3 6 -200 1300 DEPOSIT ABSOLUTE /end AXIS_DESCR
/end CHARACTERISTIC
/begin CHARACTERISTIC KF_POFMTNFUELLRED_3 "Kennfeld Fuelldruckoffset(n_t, m_t)" MAP 0x1C02B0 ZF_kf_si16_S5_S3 12.75 UMR_BAR__1_1000_0_S5_S3 -6.4 6.35
 /begin AXIS_DESCR STD_AXIS iSasZentr.iSchaltend.nd_syn UMR_U_MIN_1_1_0_S5_S3 4 -8000 8000 DEPOSIT ABSOLUTE /end AXIS_DESCR
 /begin AXIS_DESCR STD_AXIS zff_atsys._.iSignale._.obj.sig_m_t UMR_NM__1_1_0_S5_S3 6 -200 1300 DEPOSIT ABSOLUTE /end AXIS_DESCR
/end CHARACTERISTIC
/begin CHARACTERISTIC KF_POFMTNFUELLRED_4 "Kennfeld Fuelldruckoffset(n_t, m_t)" MAP 0x1C07E0 ZF_kf_si16_S5_S3 12.75 UMR_BAR__1_1000_0_S5_S3 -6.4 6.35
 /begin AXIS_DESCR STD_AXIS iSasZentr.iSchaltend.nd_syn UMR_U_MIN_1_1_0_S5_S3 4 -8000 8000 DEPOSIT ABSOLUTE /end AXIS_DESCR
 /begin AXIS_DESCR STD_AXIS zff_atsys._.iSignale._.obj.sig_m_t UMR_NM__1_1_0_S5_S3 6 -200 1300 DEPOSIT ABSOLUTE /end AXIS_DESCR
/end CHARACTERISTIC
/begin CHARACTERISTIC KF_POFMTNFUELLRED_5 "Kennfeld Fuelldruckoffset(n_t, m_t)" MAP 0x1C0D10 ZF_kf_si16_S5_S3 12.75 UMR_BAR__1_1000_0_S5_S3 -6.4 6.35
 /begin AXIS_DESCR STD_AXIS iSasZentr.iSchaltend.nd_syn UMR_U_MIN_1_1_0_S5_S3 4 -8000 8000 DEPOSIT ABSOLUTE /end AXIS_DESCR
 /begin AXIS_DESCR STD_AXIS zff_atsys._.iSignale._.obj.sig_m_t UMR_NM__1_1_0_S5_S3 6 -200 1300 DEPOSIT ABSOLUTE /end AXIS_DESCR
/end CHARACTERISTIC
/begin CHARACTERISTIC KF_POFMTNFUELLRED_6 "Kennfeld Fuelldruckoffset(n_t, m_t)" MAP 0x1C1240 ZF_kf_si16_S5_S3 12.75 UMR_BAR__1_1000_0_S5_S3 -6.4 6.35
 /begin AXIS_DESCR STD_AXIS iSasZentr.iSchaltend.nd_syn UMR_U_MIN_1_1_0_S5_S3 4 -8000 8000 DEPOSIT ABSOLUTE /end AXIS_DESCR
 /begin AXIS_DESCR STD_AXIS zff_atsys._.iSignale._.obj.sig_m_t UMR_NM__1_1_0_S5_S3 6 -200 1300 DEPOSIT ABSOLUTE /end AXIS_DESCR
/end CHARACTERISTIC
/begin CHARACTERISTIC KF_POFMTN_1 "Kennfeld Fuelldruckoffset(nd_syn, m_t)" MAP 0x1BF89C ZF_kf_si16_S5_S3 12.75 UMR_BAR__1_1000_0_S5_S3 -6.4 6.35
 /begin AXIS_DESCR STD_AXIS iSasZentr.iSchaltend.nd_syn UMR_U_MIN_1_1_0_S5_S3 4 -8000 8000 DEPOSIT ABSOLUTE /end AXIS_DESCR
 /begin AXIS_DESCR STD_AXIS zff_atsys._.iSignale._.obj.sig_m_t UMR_NM__1_1_0_S5_S3 6 -200 1300 DEPOSIT ABSOLUTE /end AXIS_DESCR
/end CHARACTERISTIC
/begin CHARACTERISTIC KF_POFMTN_2 "Kennfeld Fuelldruckoffset(nd_syn, m_t)" MAP 0x1BFDCC ZF_kf_si16_S5_S3 12.75 UMR_BAR__1_1000_0_S5_S3 -6.4 6.35
 /begin AXIS_DESCR STD_AXIS iSasZentr.iSchaltend.nd_syn UMR_U_MIN_1_1_0_S5_S3 4 -8000 8000 DEPOSIT ABSOLUTE /end AXIS_DESCR
 /begin AXIS_DESCR STD_AXIS zff_atsys._.iSignale._.obj.sig_m_t UMR_NM__1_1_0_S5_S3 6 -200 1300 DEPOSIT ABSOLUTE /end AXIS_DESCR
/end CHARACTERISTIC
/begin CHARACTERISTIC KF_POFMTN_3 "Kennfeld Fuelldruckoffset(nd_syn, m_t)" MAP 0x1C02FC ZF_kf_si16_S5_S3 12.75 UMR_BAR__1_1000_0_S5_S3 -6.4 6.35
 /begin AXIS_DESCR STD_AXIS iSasZentr.iSchaltend.nd_syn UMR_U_MIN_1_1_0_S5_S3 4 -8000 8000 DEPOSIT ABSOLUTE /end AXIS_DESCR
 /begin AXIS_DESCR STD_AXIS zff_atsys._.iSignale._.obj.sig_m_t UMR_NM__1_1_0_S5_S3 6 -200 1300 DEPOSIT ABSOLUTE /end AXIS_DESCR
/end CHARACTERISTIC
/begin CHARACTERISTIC KF_POFMTN_4 "Kennfeld Fuelldruckoffset(nd_syn, m_t)" MAP 0x1C082C ZF_kf_si16_S5_S3 12.75 UMR_BAR__1_1000_0_S5_S3 -6.4 6.35
 /begin AXIS_DESCR STD_AXIS iSasZentr.iSchaltend.nd_syn UMR_U_MIN_1_1_0_S5_S3 4 -8000 8000 DEPOSIT ABSOLUTE /end AXIS_DESCR
 /begin AXIS_DESCR STD_AXIS zff_atsys._.iSignale._.obj.sig_m_t UMR_NM__1_1_0_S5_S3 6 -200 1300 DEPOSIT ABSOLUTE /end AXIS_DESCR
/end CHARACTERISTIC
/begin CHARACTERISTIC KF_POFMTN_5 "Kennfeld Fuelldruckoffset(nd_syn, m_t)" MAP 0x1C0D5C ZF_kf_si16_S5_S3 12.75 UMR_BAR__1_1000_0_S5_S3 -6.4 6.35
 /begin AXIS_DESCR STD_AXIS iSasZentr.iSchaltend.nd_syn UMR_U_MIN_1_1_0_S5_S3 4 -8000 8000 DEPOSIT ABSOLUTE /end AXIS_DESCR
 /begin AXIS_DESCR STD_AXIS zff_atsys._.iSignale._.obj.sig_m_t UMR_NM__1_1_0_S5_S3 6 -200 1300 DEPOSIT ABSOLUTE /end AXIS_DESCR
/end CHARACTERISTIC
/begin CHARACTERISTIC KF_POFMTN_6 "Kennfeld Fuelldruckoffset(nd_syn, m_t)" MAP 0x1C128C ZF_kf_si16_S5_S3 12.75 UMR_BAR__1_1000_0_S5_S3 -6.4 6.35
 /begin AXIS_DESCR STD_AXIS iSasZentr.iSchaltend.nd_syn UMR_U_MIN_1_1_0_S5_S3 4 -8000 8000 DEPOSIT ABSOLUTE /end AXIS_DESCR
 /begin AXIS_DESCR STD_AXIS zff_atsys._.iSignale._.obj.sig_m_t UMR_NM__1_1_0_S5_S3 6 -200 1300 DEPOSIT ABSOLUTE /end AXIS_DESCR
/end CHARACTERISTIC
/begin CHARACTERISTIC KF_POHINSYNKABSPORT84 "Kennfeld Haltedruckoffset(n_tkf, m_t) bei Haltephase in Synchron" MAP 0x1BD754 ZF_kf_si16_S5_S3 12.75 UMR_BAR__1_1000_0_S5_S3 -6.4 6.35
 /begin AXIS_DESCR STD_AXIS iSasZentr.iSchaltend.n_tkf UMR_U_MIN_32_1_0_S5_S3 6 0 8160 DEPOSIT ABSOLUTE /end AXIS_DESCR
 /begin AXIS_DESCR STD_AXIS zff_atsys._.iSignale._.obj.sig_m_t UMR_NM__1_1_0_S5_S3 6 -200 1300 DEPOSIT ABSOLUTE /end AXIS_DESCR
/end CHARACTERISTIC
/begin CHARACTERISTIC KF_POHINSYNKABSPORT86 "Kennfeld Haltedruckoffset(n_tkf, m_t) bei Haltephase in Synchron" MAP 0x1BD90C ZF_kf_si16_S5_S3 12.75 UMR_BAR__1_1000_0_S5_S3 -6.4 6.35
 /begin AXIS_DESCR STD_AXIS iSasZentr.iSchaltend.n_tkf UMR_U_MIN_32_1_0_S5_S3 6 0 8160 DEPOSIT ABSOLUTE /end AXIS_DESCR
 /begin AXIS_DESCR STD_AXIS zff_atsys._.iSignale._.obj.sig_m_t UMR_NM__1_1_0_S5_S3 6 -200 1300 DEPOSIT ABSOLUTE /end AXIS_DESCR
/end CHARACTERISTIC
/begin CHARACTERISTIC KF_POHINSYNKABSPORT87 "Kennfeld Haltedruckoffset(n_tkf, m_t) bei Haltephase in Synchron" MAP 0x1BC624 ZF_kf_si16_S5_S3 12.75 UMR_BAR__1_1000_0_S5_S3 -6.4 6.35
 /begin AXIS_DESCR STD_AXIS iSasZentr.iSchaltend.n_tkf UMR_U_MIN_32_1_0_S5_S3 6 0 8160 DEPOSIT ABSOLUTE /end AXIS_DESCR
 /begin AXIS_DESCR STD_AXIS zff_atsys._.iSignale._.obj.sig_m_t UMR_NM__1_1_0_S5_S3 6 -200 1300 DEPOSIT ABSOLUTE /end AXIS_DESCR
/end CHARACTERISTIC
/begin CHARACTERISTIC KF_POMLASTCGV2_1 "Momentenabhaengiger Druckoffset in FA der 2. nichtkraftschliessende KZU" MAP 0x1BFBBC ZF_kf_si16_S5_S3 3 UMR_BAR__1_1000_0_S5_S3 0 3
 /begin AXIS_DESCR STD_AXIS NO_INPUT_QUANTITY UMR_NM__1_1_0_S5_S3 5 -200 1300 DEPOSIT ABSOLUTE /end AXIS_DESCR
 /begin AXIS_DESCR STD_AXIS zff_atsys._.iSignale._.obj.sig_c_getr UMR_GRADC__1_1_M40_S5_S3 4 -40 150 DEPOSIT ABSOLUTE /end AXIS_DESCR
/end CHARACTERISTIC
/begin CHARACTERISTIC KF_POMLASTCGV2_2 "Momentenabhaengiger Druckoffset in FA der 2. nichtkraftschliessende KZU" MAP 0x1C00EC ZF_kf_si16_S5_S3 3 UMR_BAR__1_1000_0_S5_S3 0 3
 /begin AXIS_DESCR STD_AXIS NO_INPUT_QUANTITY UMR_NM__1_1_0_S5_S3 5 -200 1300 DEPOSIT ABSOLUTE /end AXIS_DESCR
 /begin AXIS_DESCR STD_AXIS zff_atsys._.iSignale._.obj.sig_c_getr UMR_GRADC__1_1_M40_S5_S3 4 -40 150 DEPOSIT ABSOLUTE /end AXIS_DESCR
/end CHARACTERISTIC
/begin CHARACTERISTIC KF_POMLASTCGV2_3 "Momentenabhaengiger Druckoffset in FA der 2. nichtkraftschliessende KZU" MAP 0x1C061C ZF_kf_si16_S5_S3 3 UMR_BAR__1_1000_0_S5_S3 0 3
 /begin AXIS_DESCR STD_AXIS NO_INPUT_QUANTITY UMR_NM__1_1_0_S5_S3 5 -200 1300 DEPOSIT ABSOLUTE /end AXIS_DESCR
 /begin AXIS_DESCR STD_AXIS zff_atsys._.iSignale._.obj.sig_c_getr UMR_GRADC__1_1_M40_S5_S3 4 -40 150 DEPOSIT ABSOLUTE /end AXIS_DESCR
/end CHARACTERISTIC
/begin CHARACTERISTIC KF_POMLASTCGV2_4 "Momentenabhaengiger Druckoffset in FA der 2. nichtkraftschliessende KZU" MAP 0x1C0B4C ZF_kf_si16_S5_S3 3 UMR_BAR__1_1000_0_S5_S3 0 3
 /begin AXIS_DESCR STD_AXIS NO_INPUT_QUANTITY UMR_NM__1_1_0_S5_S3 5 -200 1300 DEPOSIT ABSOLUTE /end AXIS_DESCR
 /begin AXIS_DESCR STD_AXIS zff_atsys._.iSignale._.obj.sig_c_getr UMR_GRADC__1_1_M40_S5_S3 4 -40 150 DEPOSIT ABSOLUTE /end AXIS_DESCR
/end CHARACTERISTIC
/begin CHARACTERISTIC KF_POMLASTCGV2_5 "Momentenabhaengiger Druckoffset in FA der 2. nichtkraftschliessende KZU" MAP 0x1C107C ZF_kf_si16_S5_S3 3 UMR_BAR__1_1000_0_S5_S3 0 3
 /begin AXIS_DESCR STD_AXIS NO_INPUT_QUANTITY UMR_NM__1_1_0_S5_S3 5 -200 1300 DEPOSIT ABSOLUTE /end AXIS_DESCR
 /begin AXIS_DESCR STD_AXIS zff_atsys._.iSignale._.obj.sig_c_getr UMR_GRADC__1_1_M40_S5_S3 4 -40 150 DEPOSIT ABSOLUTE /end AXIS_DESCR
/end CHARACTERISTIC
/begin CHARACTERISTIC KF_POMLASTCGV2_6 "Momentenabhaengiger Druckoffset in FA der 2. nichtkraftschliessende KZU" MAP 0x1C15AC ZF_kf_si16_S5_S3 3 UMR_BAR__1_1000_0_S5_S3 0 3
 /begin AXIS_DESCR STD_AXIS NO_INPUT_QUANTITY UMR_NM__1_1_0_S5_S3 5 -200 1300 DEPOSIT ABSOLUTE /end AXIS_DESCR
 /begin AXIS_DESCR STD_AXIS zff_atsys._.iSignale._.obj.sig_c_getr UMR_GRADC__1_1_M40_S5_S3 4 -40 150 DEPOSIT ABSOLUTE /end AXIS_DESCR
/end CHARACTERISTIC
/begin CHARACTERISTIC KF_POTNDSYNV2_1 "Differenzdrehzahlabhaengiger Druckoffset in FA der 2. nichtkraftschliessende KZU" MAP 0x1BFC00 ZF_kf_si16_S5_S3 3 UMR_BAR__1_1000_0_S5_S3 0 3
 /begin AXIS_DESCR STD_AXIS NO_INPUT_QUANTITY UMR_MSEC__10_1_0_S5_S3 6 0 2540 DEPOSIT ABSOLUTE /end AXIS_DESCR
 /begin AXIS_DESCR STD_AXIS NO_INPUT_QUANTITY UMR_U_MIN_1_1_0_S5_S3 8 -8160 8160 DEPOSIT ABSOLUTE /end AXIS_DESCR
/end CHARACTERISTIC
/begin CHARACTERISTIC KF_POTNDSYNV2_2 "Differenzdrehzahlabhaengiger Druckoffset in FA der 2. nichtkraftschliessende KZU" MAP 0x1C0130 ZF_kf_si16_S5_S3 3 UMR_BAR__1_1000_0_S5_S3 0 3
 /begin AXIS_DESCR STD_AXIS NO_INPUT_QUANTITY UMR_MSEC__10_1_0_S5_S3 6 0 2540 DEPOSIT ABSOLUTE /end AXIS_DESCR
 /begin AXIS_DESCR STD_AXIS NO_INPUT_QUANTITY UMR_U_MIN_1_1_0_S5_S3 8 -8160 8160 DEPOSIT ABSOLUTE /end AXIS_DESCR
/end CHARACTERISTIC
/begin CHARACTERISTIC KF_POTNDSYNV2_3 "Differenzdrehzahlabhaengiger Druckoffset in FA der 2. nichtkraftschliessende KZU" MAP 0x1C0660 ZF_kf_si16_S5_S3 3 UMR_BAR__1_1000_0_S5_S3 0 3
 /begin AXIS_DESCR STD_AXIS NO_INPUT_QUANTITY UMR_MSEC__10_1_0_S5_S3 6 0 2540 DEPOSIT ABSOLUTE /end AXIS_DESCR
 /begin AXIS_DESCR STD_AXIS NO_INPUT_QUANTITY UMR_U_MIN_1_1_0_S5_S3 8 -8160 8160 DEPOSIT ABSOLUTE /end AXIS_DESCR
/end CHARACTERISTIC
/begin CHARACTERISTIC KF_POTNDSYNV2_4 "Differenzdrehzahlabhaengiger Druckoffset in FA der 2. nichtkraftschliessende KZU" MAP 0x1C0B90 ZF_kf_si16_S5_S3 3 UMR_BAR__1_1000_0_S5_S3 0 3
 /begin AXIS_DESCR STD_AXIS NO_INPUT_QUANTITY UMR_MSEC__10_1_0_S5_S3 6 0 2540 DEPOSIT ABSOLUTE /end AXIS_DESCR
 /begin AXIS_DESCR STD_AXIS NO_INPUT_QUANTITY UMR_U_MIN_1_1_0_S5_S3 8 -8160 8160 DEPOSIT ABSOLUTE /end AXIS_DESCR
/end CHARACTERISTIC
/begin CHARACTERISTIC KF_POTNDSYNV2_5 "Differenzdrehzahlabhaengiger Druckoffset in FA der 2. nichtkraftschliessende KZU" MAP 0x1C10C0 ZF_kf_si16_S5_S3 3 UMR_BAR__1_1000_0_S5_S3 0 3
 /begin AXIS_DESCR STD_AXIS NO_INPUT_QUANTITY UMR_MSEC__10_1_0_S5_S3 6 0 2540 DEPOSIT ABSOLUTE /end AXIS_DESCR
 /begin AXIS_DESCR STD_AXIS NO_INPUT_QUANTITY UMR_U_MIN_1_1_0_S5_S3 8 -8160 8160 DEPOSIT ABSOLUTE /end AXIS_DESCR
/end CHARACTERISTIC
/begin CHARACTERISTIC KF_POTNDSYNV2_6 "Differenzdrehzahlabhaengiger Druckoffset in FA der 2. nichtkraftschliessende KZU" MAP 0x1C15F0 ZF_kf_si16_S5_S3 3 UMR_BAR__1_1000_0_S5_S3 0 3
 /begin AXIS_DESCR STD_AXIS NO_INPUT_QUANTITY UMR_MSEC__10_1_0_S5_S3 6 0 2540 DEPOSIT ABSOLUTE /end AXIS_DESCR
 /begin AXIS_DESCR STD_AXIS NO_INPUT_QUANTITY UMR_U_MIN_1_1_0_S5_S3 8 -8160 8160 DEPOSIT ABSOLUTE /end AXIS_DESCR
/end CHARACTERISTIC
/begin CHARACTERISTIC KF_TFMTNTESTART12 "Fuellzeit" MAP 0x1BEF50 ZF_kf_si16_S5_S3 2540 UMR_MSEC__10_1_0_S5_S3 0 2540
 /begin AXIS_DESCR STD_AXIS zff_atsys._.iSignale._.obj.sig_m_t UMR_NM__1_1_0_S5_S3 10 -200 1300 DEPOSIT ABSOLUTE /end AXIS_DESCR
 /begin AXIS_DESCR STD_AXIS zff_atsys._.iSignale._.obj.sig_n_t UMR_U_MIN_1_1_0_S5_S3 3 0 8160 DEPOSIT ABSOLUTE /end AXIS_DESCR
/end CHARACTERISTIC
/begin CHARACTERISTIC KF_TOHKABK0MTNT21 "Zeitoffset auf Ende SF K0 fuer Haltephase" MAP 0x1BDA14 ZF_kf_ui8_S5_S3 1000 UMR_MSEC__10_1_0_S5_S3 0 1000
 /begin AXIS_DESCR STD_AXIS zff_atsys._.iSignale._.obj.sig_n_t8 UMR_U_MIN_32_1_0_S5_S3 4 0 8160 DEPOSIT ABSOLUTE /end AXIS_DESCR
 /begin AXIS_DESCR STD_AXIS zff_atsys._.iSignale._.obj.sig_m_t8 UMR_NM__6_1_M34_S5_S3 6 -204 1326 DEPOSIT ABSOLUTE /end AXIS_DESCR
/end CHARACTERISTIC
/begin CHARACTERISTIC KF_TOHKABK0MTNT32 "Zeitoffset auf Ende SF K0 fuer Haltephase" MAP 0x1BDB3C ZF_kf_ui8_S5_S3 1000 UMR_MSEC__10_1_0_S5_S3 0 1000
 /begin AXIS_DESCR STD_AXIS zff_atsys._.iSignale._.obj.sig_n_t8 UMR_U_MIN_32_1_0_S5_S3 4 0 8160 DEPOSIT ABSOLUTE /end AXIS_DESCR
 /begin AXIS_DESCR STD_AXIS zff_atsys._.iSignale._.obj.sig_m_t8 UMR_NM__6_1_M34_S5_S3 6 -204 1326 DEPOSIT ABSOLUTE /end AXIS_DESCR
/end CHARACTERISTIC
/begin CHARACTERISTIC KF_TOHKABK0MTNT43 "Zeitoffset auf Ende SF K0 fuer Haltephase" MAP 0x1BDC64 ZF_kf_ui8_S5_S3 1000 UMR_MSEC__10_1_0_S5_S3 0 1000
 /begin AXIS_DESCR STD_AXIS zff_atsys._.iSignale._.obj.sig_n_t8 UMR_U_MIN_32_1_0_S5_S3 4 0 8160 DEPOSIT ABSOLUTE /end AXIS_DESCR
 /begin AXIS_DESCR STD_AXIS zff_atsys._.iSignale._.obj.sig_m_t8 UMR_NM__6_1_M34_S5_S3 6 -204 1326 DEPOSIT ABSOLUTE /end AXIS_DESCR
/end CHARACTERISTIC
/begin CHARACTERISTIC KF_TOHKABK0MTNT54 "Zeitoffset auf Ende SF K0 fuer Haltephase" MAP 0x1BDD8C ZF_kf_ui8_S5_S3 1000 UMR_MSEC__10_1_0_S5_S3 0 1000
 /begin AXIS_DESCR STD_AXIS zff_atsys._.iSignale._.obj.sig_n_t8 UMR_U_MIN_32_1_0_S5_S3 4 0 8160 DEPOSIT ABSOLUTE /end AXIS_DESCR
 /begin AXIS_DESCR STD_AXIS zff_atsys._.iSignale._.obj.sig_m_t8 UMR_NM__6_1_M34_S5_S3 6 -204 1326 DEPOSIT ABSOLUTE /end AXIS_DESCR
/end CHARACTERISTIC
/begin CHARACTERISTIC KF_TOHKABK0MTNT65 "Zeitoffset auf Ende SF K0 fuer Haltephase" MAP 0x1BDEB4 ZF_kf_ui8_S5_S3 1000 UMR_MSEC__10_1_0_S5_S3 0 1000
 /begin AXIS_DESCR STD_AXIS zff_atsys._.iSignale._.obj.sig_n_t8 UMR_U_MIN_32_1_0_S5_S3 4 0 8160 DEPOSIT ABSOLUTE /end AXIS_DESCR
 /begin AXIS_DESCR STD_AXIS zff_atsys._.iSignale._.obj.sig_m_t8 UMR_NM__6_1_M34_S5_S3 6 -204 1326 DEPOSIT ABSOLUTE /end AXIS_DESCR
/end CHARACTERISTIC
/begin CHARACTERISTIC KF_TOHKABK0MTNT76 "Zeitoffset auf Ende SF K0 fuer Haltephase" MAP 0x1BDFDC ZF_kf_ui8_S5_S3 1000 UMR_MSEC__10_1_0_S5_S3 0 1000
 /begin AXIS_DESCR STD_AXIS zff_atsys._.iSignale._.obj.sig_n_t8 UMR_U_MIN_32_1_0_S5_S3 4 0 8160 DEPOSIT ABSOLUTE /end AXIS_DESCR
 /begin AXIS_DESCR STD_AXIS zff_atsys._.iSignale._.obj.sig_m_t8 UMR_NM__6_1_M34_S5_S3 6 -204 1326 DEPOSIT ABSOLUTE /end AXIS_DESCR
/end CHARACTERISTIC
/begin CHARACTERISTIC KF_TOHKABK0MTNT87 "Zeitoffset auf Ende SF K0 fuer Haltephase" MAP 0x1BE104 ZF_kf_ui8_S5_S3 1000 UMR_MSEC__10_1_0_S5_S3 0 1000
 /begin AXIS_DESCR STD_AXIS zff_atsys._.iSignale._.obj.sig_n_t8 UMR_U_MIN_32_1_0_S5_S3 4 0 8160 DEPOSIT ABSOLUTE /end AXIS_DESCR
 /begin AXIS_DESCR STD_AXIS zff_atsys._.iSignale._.obj.sig_m_t8 UMR_NM__6_1_M34_S5_S3 6 -204 1326 DEPOSIT ABSOLUTE /end AXIS_DESCR
/end CHARACTERISTIC
/begin CHARACTERISTIC KF_TOHKABK0MTNTSP31 "Zeitoffset auf Ende SF K0 fuer Haltephase" MAP 0x1BE22C ZF_kf_ui8_S5_S3 1000 UMR_MSEC__10_1_0_S5_S3 0 1000
 /begin AXIS_DESCR STD_AXIS zff_atsys._.iSignale._.obj.sig_n_t8 UMR_U_MIN_32_1_0_S5_S3 4 0 8160 DEPOSIT ABSOLUTE /end AXIS_DESCR
 /begin AXIS_DESCR STD_AXIS zff_atsys._.iSignale._.obj.sig_m_t8 UMR_NM__6_1_M34_S5_S3 6 -204 1326 DEPOSIT ABSOLUTE /end AXIS_DESCR
/end CHARACTERISTIC
/begin CHARACTERISTIC KF_TOHKABK0MTNTSP42 "Zeitoffset auf Ende SF K0 fuer Haltephase" MAP 0x1BE354 ZF_kf_ui8_S5_S3 1000 UMR_MSEC__10_1_0_S5_S3 0 1000
 /begin AXIS_DESCR STD_AXIS zff_atsys._.iSignale._.obj.sig_n_t8 UMR_U_MIN_32_1_0_S5_S3 4 0 8160 DEPOSIT ABSOLUTE /end AXIS_DESCR
 /begin AXIS_DESCR STD_AXIS zff_atsys._.iSignale._.obj.sig_m_t8 UMR_NM__6_1_M34_S5_S3 6 -204 1326 DEPOSIT ABSOLUTE /end AXIS_DESCR
/end CHARACTERISTIC
/begin CHARACTERISTIC KF_TOHKABK0MTNTSP51 "Zeitoffset auf Ende SF K0 fuer Haltephase" MAP 0x1BE47C ZF_kf_ui8_S5_S3 1000 UMR_MSEC__10_1_0_S5_S3 0 1000
 /begin AXIS_DESCR STD_AXIS zff_atsys._.iSignale._.obj.sig_n_t8 UMR_U_MIN_32_1_0_S5_S3 4 0 8160 DEPOSIT ABSOLUTE /end AXIS_DESCR
 /begin AXIS_DESCR STD_AXIS zff_atsys._.iSignale._.obj.sig_m_t8 UMR_NM__6_1_M34_S5_S3 6 -204 1326 DEPOSIT ABSOLUTE /end AXIS_DESCR
/end CHARACTERISTIC
/begin CHARACTERISTIC KF_TOHKABK0MTNTSP53 "Zeitoffset auf Ende SF K0 fuer Haltephase" MAP 0x1BE5A4 ZF_kf_ui8_S5_S3 1000 UMR_MSEC__10_1_0_S5_S3 0 1000
 /begin AXIS_DESCR STD_AXIS zff_atsys._.iSignale._.obj.sig_n_t8 UMR_U_MIN_32_1_0_S5_S3 4 0 8160 DEPOSIT ABSOLUTE /end AXIS_DESCR
 /begin AXIS_DESCR STD_AXIS zff_atsys._.iSignale._.obj.sig_m_t8 UMR_NM__6_1_M34_S5_S3 6 -204 1326 DEPOSIT ABSOLUTE /end AXIS_DESCR
/end CHARACTERISTIC
/begin CHARACTERISTIC KF_TOHKABK0MTNTSP63 "Zeitoffset auf Ende SF K0 fuer Haltephase" MAP 0x1BE6CC ZF_kf_ui8_S5_S3 1000 UMR_MSEC__10_1_0_S5_S3 0 1000
 /begin AXIS_DESCR STD_AXIS zff_atsys._.iSignale._.obj.sig_n_t8 UMR_U_MIN_32_1_0_S5_S3 4 0 8160 DEPOSIT ABSOLUTE /end AXIS_DESCR
 /begin AXIS_DESCR STD_AXIS zff_atsys._.iSignale._.obj.sig_m_t8 UMR_NM__6_1_M34_S5_S3 6 -204 1326 DEPOSIT ABSOLUTE /end AXIS_DESCR
/end CHARACTERISTIC
/begin CHARACTERISTIC KF_TOHKABK0MTNTSP64 "Zeitoffset auf Ende SF K0 fuer Haltephase" MAP 0x1BE7F4 ZF_kf_ui8_S5_S3 1000 UMR_MSEC__10_1_0_S5_S3 0 1000
 /begin AXIS_DESCR STD_AXIS zff_atsys._.iSignale._.obj.sig_n_t8 UMR_U_MIN_32_1_0_S5_S3 4 0 8160 DEPOSIT ABSOLUTE /end AXIS_DESCR
 /begin AXIS_DESCR STD_AXIS zff_atsys._.iSignale._.obj.sig_m_t8 UMR_NM__6_1_M34_S5_S3 6 -204 1326 DEPOSIT ABSOLUTE /end AXIS_DESCR
/end CHARACTERISTIC
/begin CHARACTERISTIC KF_TOHKABK0MTNTSP71 "Zeitoffset auf Ende SF K0 fuer Haltephase" MAP 0x1BE91C ZF_kf_ui8_S5_S3 1000 UMR_MSEC__10_1_0_S5_S3 0 1000
 /begin AXIS_DESCR STD_AXIS zff_atsys._.iSignale._.obj.sig_n_t8 UMR_U_MIN_32_1_0_S5_S3 4 0 8160 DEPOSIT ABSOLUTE /end AXIS_DESCR
 /begin AXIS_DESCR STD_AXIS zff_atsys._.iSignale._.obj.sig_m_t8 UMR_NM__6_1_M34_S5_S3 6 -204 1326 DEPOSIT ABSOLUTE /end AXIS_DESCR
/end CHARACTERISTIC
/begin CHARACTERISTIC KF_TOHKABK0MTNTSP75 "Zeitoffset auf Ende SF K0 fuer Haltephase" MAP 0x1BEA44 ZF_kf_ui8_S5_S3 1000 UMR_MSEC__10_1_0_S5_S3 0 1000
 /begin AXIS_DESCR STD_AXIS zff_atsys._.iSignale._.obj.sig_n_t8 UMR_U_MIN_32_1_0_S5_S3 4 0 8160 DEPOSIT ABSOLUTE /end AXIS_DESCR
 /begin AXIS_DESCR STD_AXIS zff_atsys._.iSignale._.obj.sig_m_t8 UMR_NM__6_1_M34_S5_S3 6 -204 1326 DEPOSIT ABSOLUTE /end AXIS_DESCR
/end CHARACTERISTIC
/begin CHARACTERISTIC KF_TOHKABK0MTNTSP82 "Zeitoffset auf Ende SF K0 fuer Haltephase" MAP 0x1BEB6C ZF_kf_ui8_S5_S3 1000 UMR_MSEC__10_1_0_S5_S3 0 1000
 /begin AXIS_DESCR STD_AXIS zff_atsys._.iSignale._.obj.sig_n_t8 UMR_U_MIN_32_1_0_S5_S3 4 0 8160 DEPOSIT ABSOLUTE /end AXIS_DESCR
 /begin AXIS_DESCR STD_AXIS zff_atsys._.iSignale._.obj.sig_m_t8 UMR_NM__6_1_M34_S5_S3 6 -204 1326 DEPOSIT ABSOLUTE /end AXIS_DESCR
/end CHARACTERISTIC
/begin CHARACTERISTIC KF_TOHKABK0MTNTSP84 "Zeitoffset auf Ende SF K0 fuer Haltephase" MAP 0x1BEDBC ZF_kf_ui8_S5_S3 1000 UMR_MSEC__10_1_0_S5_S3 0 1000
 /begin AXIS_DESCR STD_AXIS zff_atsys._.iSignale._.obj.sig_n_t8 UMR_U_MIN_32_1_0_S5_S3 4 0 8160 DEPOSIT ABSOLUTE /end AXIS_DESCR
 /begin AXIS_DESCR STD_AXIS zff_atsys._.iSignale._.obj.sig_m_t8 UMR_NM__6_1_M34_S5_S3 6 -204 1326 DEPOSIT ABSOLUTE /end AXIS_DESCR
/end CHARACTERISTIC
/begin CHARACTERISTIC KF_TOHKABK0MTNTSP86 "Zeitoffset auf Ende SF K0 fuer Haltephase" MAP 0x1BEC94 ZF_kf_ui8_S5_S3 1000 UMR_MSEC__10_1_0_S5_S3 0 1000
 /begin AXIS_DESCR STD_AXIS zff_atsys._.iSignale._.obj.sig_n_t8 UMR_U_MIN_32_1_0_S5_S3 4 0 8160 DEPOSIT ABSOLUTE /end AXIS_DESCR
 /begin AXIS_DESCR STD_AXIS zff_atsys._.iSignale._.obj.sig_m_t8 UMR_NM__6_1_M34_S5_S3 6 -204 1326 DEPOSIT ABSOLUTE /end AXIS_DESCR
/end CHARACTERISTIC
/begin CHARACTERISTIC KF_TOHKABMTNTSPORT84 "Zeitoffset auf Ende SF fuer Haltephase" MAP 0x1BD624 ZF_kf_ui8_S5_S3 2000 UMR_MSEC__10_1_M128_S5_S3 -1000 1000
 /begin AXIS_DESCR STD_AXIS zff_atsys._.iSignale._.obj.sig_n_t8 UMR_U_MIN_32_1_0_S5_S3 4 0 8160 DEPOSIT ABSOLUTE /end AXIS_DESCR
 /begin AXIS_DESCR STD_AXIS zff_atsys._.iSignale._.obj.sig_m_t8 UMR_NM__6_1_M34_S5_S3 6 -204 1326 DEPOSIT ABSOLUTE /end AXIS_DESCR
/end CHARACTERISTIC
/begin CHARACTERISTIC KF_TOHKABMTNTSPORT86 "Zeitoffset auf Ende SF fuer Haltephase" MAP 0x1BD7DC ZF_kf_ui8_S5_S3 2000 UMR_MSEC__10_1_M128_S5_S3 -1000 1000
 /begin AXIS_DESCR STD_AXIS zff_atsys._.iSignale._.obj.sig_n_t8 UMR_U_MIN_32_1_0_S5_S3 4 0 8160 DEPOSIT ABSOLUTE /end AXIS_DESCR
 /begin AXIS_DESCR STD_AXIS zff_atsys._.iSignale._.obj.sig_m_t8 UMR_NM__6_1_M34_S5_S3 6 -204 1326 DEPOSIT ABSOLUTE /end AXIS_DESCR
/end CHARACTERISTIC
/begin CHARACTERISTIC KF_TOHKABMTNTSPORT87 "Zeitoffset auf Ende SF fuer Haltephase" MAP 0x1BC4F4 ZF_kf_ui8_S5_S3 2000 UMR_MSEC__10_1_M128_S5_S3 -1000 1000
 /begin AXIS_DESCR STD_AXIS zff_atsys._.iSignale._.obj.sig_n_t8 UMR_U_MIN_32_1_0_S5_S3 4 0 8160 DEPOSIT ABSOLUTE /end AXIS_DESCR
 /begin AXIS_DESCR STD_AXIS zff_atsys._.iSignale._.obj.sig_m_t8 UMR_NM__6_1_M34_S5_S3 6 -204 1326 DEPOSIT ABSOLUTE /end AXIS_DESCR
/end CHARACTERISTIC
/begin CHARACTERISTIC KF_TRAMTCG_1 "Kennlinie Zeit 1. Rampe der zuschaltenden Kupplung" MAP 0x1BFB90 ZF_kf_ui8_S5_S3 2540 UMR_MSEC__10_1_0_S5_S3 0 2540
 /begin AXIS_DESCR STD_AXIS zff_atsys._.iSignale._.obj.sig_m_t8 UMR_NM__6_1_M34_S5_S3 4 -204 1326 DEPOSIT ABSOLUTE /end AXIS_DESCR
 /begin AXIS_DESCR STD_AXIS zff_atsys._.iSignale._.obj.sig_c_getr UMR_GRADC__1_1_M40_S5_S3 4 -40 150 DEPOSIT ABSOLUTE /end AXIS_DESCR
/end CHARACTERISTIC
/begin CHARACTERISTIC KF_TRAMTCG_2 "Kennlinie Zeit 1. Rampe der zuschaltenden Kupplung" MAP 0x1C00C0 ZF_kf_ui8_S5_S3 2540 UMR_MSEC__10_1_0_S5_S3 0 2540
 /begin AXIS_DESCR STD_AXIS zff_atsys._.iSignale._.obj.sig_m_t8 UMR_NM__6_1_M34_S5_S3 4 -204 1326 DEPOSIT ABSOLUTE /end AXIS_DESCR
 /begin AXIS_DESCR STD_AXIS zff_atsys._.iSignale._.obj.sig_c_getr UMR_GRADC__1_1_M40_S5_S3 4 -40 150 DEPOSIT ABSOLUTE /end AXIS_DESCR
/end CHARACTERISTIC
/begin CHARACTERISTIC KF_TRAMTCG_3 "Kennlinie Zeit 1. Rampe der zuschaltenden Kupplung" MAP 0x1C05F0 ZF_kf_ui8_S5_S3 2540 UMR_MSEC__10_1_0_S5_S3 0 2540
 /begin AXIS_DESCR STD_AXIS zff_atsys._.iSignale._.obj.sig_m_t8 UMR_NM__6_1_M34_S5_S3 4 -204 1326 DEPOSIT ABSOLUTE /end AXIS_DESCR
 /begin AXIS_DESCR STD_AXIS zff_atsys._.iSignale._.obj.sig_c_getr UMR_GRADC__1_1_M40_S5_S3 4 -40 150 DEPOSIT ABSOLUTE /end AXIS_DESCR
/end CHARACTERISTIC
/begin CHARACTERISTIC KF_TRAMTCG_4 "Kennlinie Zeit 1. Rampe der zuschaltenden Kupplung" MAP 0x1C0B20 ZF_kf_ui8_S5_S3 2540 UMR_MSEC__10_1_0_S5_S3 0 2540
 /begin AXIS_DESCR STD_AXIS zff_atsys._.iSignale._.obj.sig_m_t8 UMR_NM__6_1_M34_S5_S3 4 -204 1326 DEPOSIT ABSOLUTE /end AXIS_DESCR
 /begin AXIS_DESCR STD_AXIS zff_atsys._.iSignale._.obj.sig_c_getr UMR_GRADC__1_1_M40_S5_S3 4 -40 150 DEPOSIT ABSOLUTE /end AXIS_DESCR
/end CHARACTERISTIC
/begin CHARACTERISTIC KF_TRAMTCG_5 "Kennlinie Zeit 1. Rampe der zuschaltenden Kupplung" MAP 0x1C1050 ZF_kf_ui8_S5_S3 2540 UMR_MSEC__10_1_0_S5_S3 0 2540
 /begin AXIS_DESCR STD_AXIS zff_atsys._.iSignale._.obj.sig_m_t8 UMR_NM__6_1_M34_S5_S3 4 -204 1326 DEPOSIT ABSOLUTE /end AXIS_DESCR
 /begin AXIS_DESCR STD_AXIS zff_atsys._.iSignale._.obj.sig_c_getr UMR_GRADC__1_1_M40_S5_S3 4 -40 150 DEPOSIT ABSOLUTE /end AXIS_DESCR
/end CHARACTERISTIC
/begin CHARACTERISTIC KF_TRAMTCG_6 "Kennlinie Zeit 1. Rampe der zuschaltenden Kupplung" MAP 0x1C1580 ZF_kf_ui8_S5_S3 2540 UMR_MSEC__10_1_0_S5_S3 0 2540
 /begin AXIS_DESCR STD_AXIS zff_atsys._.iSignale._.obj.sig_m_t8 UMR_NM__6_1_M34_S5_S3 4 -204 1326 DEPOSIT ABSOLUTE /end AXIS_DESCR
 /begin AXIS_DESCR STD_AXIS zff_atsys._.iSignale._.obj.sig_c_getr UMR_GRADC__1_1_M40_S5_S3 4 -40 150 DEPOSIT ABSOLUTE /end AXIS_DESCR
/end CHARACTERISTIC
/begin CHARACTERISTIC KF_TVKABK0MTNMOTRS21 "Verzögerungszeit abschaltende Kupplung bei RS und K0" MAP 0x1BDA40 ZF_kf_ui8_S5_S3 2000 UMR_MSEC__10_1_0_S5_S3 0 2000
 /begin AXIS_DESCR STD_AXIS zff_atsys._.iSignale._.obj.sig_m_t8 UMR_NM__6_1_M34_S5_S3 4 -204 1326 DEPOSIT ABSOLUTE /end AXIS_DESCR
 /begin AXIS_DESCR STD_AXIS zff_atsys._.iSignale._.obj.sig_n_mot8 UMR_U_MIN_32_1_0_S5_S3 4 0 8160 DEPOSIT ABSOLUTE /end AXIS_DESCR
/end CHARACTERISTIC
/begin CHARACTERISTIC KF_TVKABK0MTNMOTRS32 "Verzögerungszeit abschaltende Kupplung bei RS und K0" MAP 0x1BDB68 ZF_kf_ui8_S5_S3 2000 UMR_MSEC__10_1_0_S5_S3 0 2000
 /begin AXIS_DESCR STD_AXIS zff_atsys._.iSignale._.obj.sig_m_t8 UMR_NM__6_1_M34_S5_S3 4 -204 1326 DEPOSIT ABSOLUTE /end AXIS_DESCR
 /begin AXIS_DESCR STD_AXIS zff_atsys._.iSignale._.obj.sig_n_mot8 UMR_U_MIN_32_1_0_S5_S3 4 0 8160 DEPOSIT ABSOLUTE /end AXIS_DESCR
/end CHARACTERISTIC
/begin CHARACTERISTIC KF_TVKABK0MTNMOTRS43 "Verzögerungszeit abschaltende Kupplung bei RS und K0" MAP 0x1BDC90 ZF_kf_ui8_S5_S3 2000 UMR_MSEC__10_1_0_S5_S3 0 2000
 /begin AXIS_DESCR STD_AXIS zff_atsys._.iSignale._.obj.sig_m_t8 UMR_NM__6_1_M34_S5_S3 4 -204 1326 DEPOSIT ABSOLUTE /end AXIS_DESCR
 /begin AXIS_DESCR STD_AXIS zff_atsys._.iSignale._.obj.sig_n_mot8 UMR_U_MIN_32_1_0_S5_S3 4 0 8160 DEPOSIT ABSOLUTE /end AXIS_DESCR
/end CHARACTERISTIC
/begin CHARACTERISTIC KF_TVKABK0MTNMOTRS54 "Verzögerungszeit abschaltende Kupplung bei RS und K0" MAP 0x1BDDB8 ZF_kf_ui8_S5_S3 2000 UMR_MSEC__10_1_0_S5_S3 0 2000
 /begin AXIS_DESCR STD_AXIS zff_atsys._.iSignale._.obj.sig_m_t8 UMR_NM__6_1_M34_S5_S3 4 -204 1326 DEPOSIT ABSOLUTE /end AXIS_DESCR
 /begin AXIS_DESCR STD_AXIS zff_atsys._.iSignale._.obj.sig_n_mot8 UMR_U_MIN_32_1_0_S5_S3 4 0 8160 DEPOSIT ABSOLUTE /end AXIS_DESCR
/end CHARACTERISTIC
/begin CHARACTERISTIC KF_TVKABK0MTNMOTRS65 "Verzögerungszeit abschaltende Kupplung bei RS und K0" MAP 0x1BDEE0 ZF_kf_ui8_S5_S3 2000 UMR_MSEC__10_1_0_S5_S3 0 2000
 /begin AXIS_DESCR STD_AXIS zff_atsys._.iSignale._.obj.sig_m_t8 UMR_NM__6_1_M34_S5_S3 4 -204 1326 DEPOSIT ABSOLUTE /end AXIS_DESCR
 /begin AXIS_DESCR STD_AXIS zff_atsys._.iSignale._.obj.sig_n_mot8 UMR_U_MIN_32_1_0_S5_S3 4 0 8160 DEPOSIT ABSOLUTE /end AXIS_DESCR
/end CHARACTERISTIC
/begin CHARACTERISTIC KF_TVKABK0MTNMOTRS76 "Verzögerungszeit abschaltende Kupplung bei RS und K0" MAP 0x1BE008 ZF_kf_ui8_S5_S3 2000 UMR_MSEC__10_1_0_S5_S3 0 2000
 /begin AXIS_DESCR STD_AXIS zff_atsys._.iSignale._.obj.sig_m_t8 UMR_NM__6_1_M34_S5_S3 4 -204 1326 DEPOSIT ABSOLUTE /end AXIS_DESCR
 /begin AXIS_DESCR STD_AXIS zff_atsys._.iSignale._.obj.sig_n_mot8 UMR_U_MIN_32_1_0_S5_S3 4 0 8160 DEPOSIT ABSOLUTE /end AXIS_DESCR
/end CHARACTERISTIC
/begin CHARACTERISTIC KF_TVKABK0MTNMOTRS87 "Verzögerungszeit abschaltende Kupplung bei RS und K0" MAP 0x1BE130 ZF_kf_ui8_S5_S3 2000 UMR_MSEC__10_1_0_S5_S3 0 2000
 /begin AXIS_DESCR STD_AXIS zff_atsys._.iSignale._.obj.sig_m_t8 UMR_NM__6_1_M34_S5_S3 4 -204 1326 DEPOSIT ABSOLUTE /end AXIS_DESCR
 /begin AXIS_DESCR STD_AXIS zff_atsys._.iSignale._.obj.sig_n_mot8 UMR_U_MIN_32_1_0_S5_S3 4 0 8160 DEPOSIT ABSOLUTE /end AXIS_DESCR
/end CHARACTERISTIC
/begin CHARACTERISTIC KF_TVKABK0MTNMOTRSSP31 "Verzögerungszeit abschaltende Kupplung bei RS und K0" MAP 0x1BE258 ZF_kf_ui8_S5_S3 2000 UMR_MSEC__10_1_0_S5_S3 0 2000
 /begin AXIS_DESCR STD_AXIS zff_atsys._.iSignale._.obj.sig_m_t8 UMR_NM__6_1_M34_S5_S3 4 -204 1326 DEPOSIT ABSOLUTE /end AXIS_DESCR
 /begin AXIS_DESCR STD_AXIS zff_atsys._.iSignale._.obj.sig_n_mot8 UMR_U_MIN_32_1_0_S5_S3 4 0 8160 DEPOSIT ABSOLUTE /end AXIS_DESCR
/end CHARACTERISTIC
/begin CHARACTERISTIC KF_TVKABK0MTNMOTRSSP42 "Verzögerungszeit abschaltende Kupplung bei RS und K0" MAP 0x1BE380 ZF_kf_ui8_S5_S3 2000 UMR_MSEC__10_1_0_S5_S3 0 2000
 /begin AXIS_DESCR STD_AXIS zff_atsys._.iSignale._.obj.sig_m_t8 UMR_NM__6_1_M34_S5_S3 4 -204 1326 DEPOSIT ABSOLUTE /end AXIS_DESCR
 /begin AXIS_DESCR STD_AXIS zff_atsys._.iSignale._.obj.sig_n_mot8 UMR_U_MIN_32_1_0_S5_S3 4 0 8160 DEPOSIT ABSOLUTE /end AXIS_DESCR
/end CHARACTERISTIC
/begin CHARACTERISTIC KF_TVKABK0MTNMOTRSSP51 "Verzögerungszeit abschaltende Kupplung bei RS und K0" MAP 0x1BE4A8 ZF_kf_ui8_S5_S3 2000 UMR_MSEC__10_1_0_S5_S3 0 2000
 /begin AXIS_DESCR STD_AXIS zff_atsys._.iSignale._.obj.sig_m_t8 UMR_NM__6_1_M34_S5_S3 4 -204 1326 DEPOSIT ABSOLUTE /end AXIS_DESCR
 /begin AXIS_DESCR STD_AXIS zff_atsys._.iSignale._.obj.sig_n_mot8 UMR_U_MIN_32_1_0_S5_S3 4 0 8160 DEPOSIT ABSOLUTE /end AXIS_DESCR
/end CHARACTERISTIC
/begin CHARACTERISTIC KF_TVKABK0MTNMOTRSSP53 "Verzögerungszeit abschaltende Kupplung bei RS und K0" MAP 0x1BE5D0 ZF_kf_ui8_S5_S3 2000 UMR_MSEC__10_1_0_S5_S3 0 2000
 /begin AXIS_DESCR STD_AXIS zff_atsys._.iSignale._.obj.sig_m_t8 UMR_NM__6_1_M34_S5_S3 4 -204 1326 DEPOSIT ABSOLUTE /end AXIS_DESCR
 /begin AXIS_DESCR STD_AXIS zff_atsys._.iSignale._.obj.sig_n_mot8 UMR_U_MIN_32_1_0_S5_S3 4 0 8160 DEPOSIT ABSOLUTE /end AXIS_DESCR
/end CHARACTERISTIC
/begin CHARACTERISTIC KF_TVKABK0MTNMOTRSSP63 "Verzögerungszeit abschaltende Kupplung bei RS und K0" MAP 0x1BE6F8 ZF_kf_ui8_S5_S3 2000 UMR_MSEC__10_1_0_S5_S3 0 2000
 /begin AXIS_DESCR STD_AXIS zff_atsys._.iSignale._.obj.sig_m_t8 UMR_NM__6_1_M34_S5_S3 4 -204 1326 DEPOSIT ABSOLUTE /end AXIS_DESCR
 /begin AXIS_DESCR STD_AXIS zff_atsys._.iSignale._.obj.sig_n_mot8 UMR_U_MIN_32_1_0_S5_S3 4 0 8160 DEPOSIT ABSOLUTE /end AXIS_DESCR
/end CHARACTERISTIC
/begin CHARACTERISTIC KF_TVKABK0MTNMOTRSSP64 "Verzögerungszeit abschaltende Kupplung bei RS und K0" MAP 0x1BE820 ZF_kf_ui8_S5_S3 2000 UMR_MSEC__10_1_0_S5_S3 0 2000
 /begin AXIS_DESCR STD_AXIS zff_atsys._.iSignale._.obj.sig_m_t8 UMR_NM__6_1_M34_S5_S3 4 -204 1326 DEPOSIT ABSOLUTE /end AXIS_DESCR
 /begin AXIS_DESCR STD_AXIS zff_atsys._.iSignale._.obj.sig_n_mot8 UMR_U_MIN_32_1_0_S5_S3 4 0 8160 DEPOSIT ABSOLUTE /end AXIS_DESCR
/end CHARACTERISTIC
/begin CHARACTERISTIC KF_TVKABK0MTNMOTRSSP71 "Verzögerungszeit abschaltende Kupplung bei RS und K0" MAP 0x1BE948 ZF_kf_ui8_S5_S3 2000 UMR_MSEC__10_1_0_S5_S3 0 2000
 /begin AXIS_DESCR STD_AXIS zff_atsys._.iSignale._.obj.sig_m_t8 UMR_NM__6_1_M34_S5_S3 4 -204 1326 DEPOSIT ABSOLUTE /end AXIS_DESCR
 /begin AXIS_DESCR STD_AXIS zff_atsys._.iSignale._.obj.sig_n_mot8 UMR_U_MIN_32_1_0_S5_S3 4 0 8160 DEPOSIT ABSOLUTE /end AXIS_DESCR
/end CHARACTERISTIC
/begin CHARACTERISTIC KF_TVKABK0MTNMOTRSSP75 "Verzögerungszeit abschaltende Kupplung bei RS und K0" MAP 0x1BEA70 ZF_kf_ui8_S5_S3 2000 UMR_MSEC__10_1_0_S5_S3 0 2000
 /begin AXIS_DESCR STD_AXIS zff_atsys._.iSignale._.obj.sig_m_t8 UMR_NM__6_1_M34_S5_S3 4 -204 1326 DEPOSIT ABSOLUTE /end AXIS_DESCR
 /begin AXIS_DESCR STD_AXIS zff_atsys._.iSignale._.obj.sig_n_mot8 UMR_U_MIN_32_1_0_S5_S3 4 0 8160 DEPOSIT ABSOLUTE /end AXIS_DESCR
/end CHARACTERISTIC
/begin CHARACTERISTIC KF_TVKABK0MTNMOTRSSP82 "Verzögerungszeit abschaltende Kupplung bei RS und K0" MAP 0x1BEB98 ZF_kf_ui8_S5_S3 2000 UMR_MSEC__10_1_0_S5_S3 0 2000
 /begin AXIS_DESCR STD_AXIS zff_atsys._.iSignale._.obj.sig_m_t8 UMR_NM__6_1_M34_S5_S3 4 -204 1326 DEPOSIT ABSOLUTE /end AXIS_DESCR
 /begin AXIS_DESCR STD_AXIS zff_atsys._.iSignale._.obj.sig_n_mot8 UMR_U_MIN_32_1_0_S5_S3 4 0 8160 DEPOSIT ABSOLUTE /end AXIS_DESCR
/end CHARACTERISTIC
/begin CHARACTERISTIC KF_TVKABK0MTNMOTRSSP84 "Verzögerungszeit abschaltende Kupplung bei RS und K0" MAP 0x1BEDE8 ZF_kf_ui8_S5_S3 2000 UMR_MSEC__10_1_0_S5_S3 0 2000
 /begin AXIS_DESCR STD_AXIS zff_atsys._.iSignale._.obj.sig_m_t8 UMR_NM__6_1_M34_S5_S3 4 -204 1326 DEPOSIT ABSOLUTE /end AXIS_DESCR
 /begin AXIS_DESCR STD_AXIS zff_atsys._.iSignale._.obj.sig_n_mot8 UMR_U_MIN_32_1_0_S5_S3 4 0 8160 DEPOSIT ABSOLUTE /end AXIS_DESCR
/end CHARACTERISTIC
/begin CHARACTERISTIC KF_TVKABK0MTNMOTRSSP86 "Verzögerungszeit abschaltende Kupplung bei RS und K0" MAP 0x1BECC0 ZF_kf_ui8_S5_S3 2000 UMR_MSEC__10_1_0_S5_S3 0 2000
 /begin AXIS_DESCR STD_AXIS zff_atsys._.iSignale._.obj.sig_m_t8 UMR_NM__6_1_M34_S5_S3 4 -204 1326 DEPOSIT ABSOLUTE /end AXIS_DESCR
 /begin AXIS_DESCR STD_AXIS zff_atsys._.iSignale._.obj.sig_n_mot8 UMR_U_MIN_32_1_0_S5_S3 4 0 8160 DEPOSIT ABSOLUTE /end AXIS_DESCR
/end CHARACTERISTIC
/begin CHARACTERISTIC KF_TVKABMTNMOTRSSPORT84 "Verzögerungszeit abschaltende Kupplung bei RS" MAP 0x1BD65C ZF_kf_ui8_S5_S3 2000 UMR_MSEC__10_1_0_S5_S3 0 2000
 /begin AXIS_DESCR STD_AXIS zff_atsys._.iSignale._.obj.sig_m_t8 UMR_NM__6_1_M34_S5_S3 4 -204 1326 DEPOSIT ABSOLUTE /end AXIS_DESCR
 /begin AXIS_DESCR STD_AXIS zff_atsys._.iSignale._.obj.sig_n_mot8 UMR_U_MIN_32_1_0_S5_S3 4 0 8160 DEPOSIT ABSOLUTE /end AXIS_DESCR
/end CHARACTERISTIC
/begin CHARACTERISTIC KF_TVKABMTNMOTRSSPORT86 "Verzögerungszeit abschaltende Kupplung bei RS" MAP 0x1BD814 ZF_kf_ui8_S5_S3 2000 UMR_MSEC__10_1_0_S5_S3 0 2000
 /begin AXIS_DESCR STD_AXIS zff_atsys._.iSignale._.obj.sig_m_t8 UMR_NM__6_1_M34_S5_S3 4 -204 1326 DEPOSIT ABSOLUTE /end AXIS_DESCR
 /begin AXIS_DESCR STD_AXIS zff_atsys._.iSignale._.obj.sig_n_mot8 UMR_U_MIN_32_1_0_S5_S3 4 0 8160 DEPOSIT ABSOLUTE /end AXIS_DESCR
/end CHARACTERISTIC
/begin CHARACTERISTIC KF_TVKABMTNMOTRSSPORT87 "Verzögerungszeit abschaltende Kupplung bei RS" MAP 0x1BC52C ZF_kf_ui8_S5_S3 2000 UMR_MSEC__10_1_0_S5_S3 0 2000
 /begin AXIS_DESCR STD_AXIS zff_atsys._.iSignale._.obj.sig_m_t8 UMR_NM__6_1_M34_S5_S3 4 -204 1326 DEPOSIT ABSOLUTE /end AXIS_DESCR
 /begin AXIS_DESCR STD_AXIS zff_atsys._.iSignale._.obj.sig_n_mot8 UMR_U_MIN_32_1_0_S5_S3 4 0 8160 DEPOSIT ABSOLUTE /end AXIS_DESCR
/end CHARACTERISTIC
/begin CHARACTERISTIC KL_FPOCGHINSYNKAB21 "Temperaturabhängige Gewichtung des Haltedruckoffsets" CURVE 0x1BD9A4 ZF_kl_ui8_S5_S3 1 UMR___1_100_0_S5_S3 0 1
 /begin AXIS_DESCR STD_AXIS zff_atsys._.iSignale._.obj.sig_c_getr UMR_GRADC__1_1_M40_S5_S3 4 -40 150 DEPOSIT ABSOLUTE /end AXIS_DESCR
/end CHARACTERISTIC
/begin CHARACTERISTIC KL_FPOCGHINSYNKAB32 "Temperaturabhängige Gewichtung des Haltedruckoffsets" CURVE 0x1BDACC ZF_kl_ui8_S5_S3 1 UMR___1_100_0_S5_S3 0 1
 /begin AXIS_DESCR STD_AXIS zff_atsys._.iSignale._.obj.sig_c_getr UMR_GRADC__1_1_M40_S5_S3 4 -40 150 DEPOSIT ABSOLUTE /end AXIS_DESCR
/end CHARACTERISTIC
/begin CHARACTERISTIC KL_FPOCGHINSYNKAB43 "Temperaturabhängige Gewichtung des Haltedruckoffsets" CURVE 0x1BDBF4 ZF_kl_ui8_S5_S3 1 UMR___1_100_0_S5_S3 0 1
 /begin AXIS_DESCR STD_AXIS zff_atsys._.iSignale._.obj.sig_c_getr UMR_GRADC__1_1_M40_S5_S3 4 -40 150 DEPOSIT ABSOLUTE /end AXIS_DESCR
/end CHARACTERISTIC
/begin CHARACTERISTIC KL_FPOCGHINSYNKAB54 "Temperaturabhängige Gewichtung des Haltedruckoffsets" CURVE 0x1BDD1C ZF_kl_ui8_S5_S3 1 UMR___1_100_0_S5_S3 0 1
 /begin AXIS_DESCR STD_AXIS zff_atsys._.iSignale._.obj.sig_c_getr UMR_GRADC__1_1_M40_S5_S3 4 -40 150 DEPOSIT ABSOLUTE /end AXIS_DESCR
/end CHARACTERISTIC
/begin CHARACTERISTIC KL_FPOCGHINSYNKAB65 "Temperaturabhängige Gewichtung des Haltedruckoffsets" CURVE 0x1BDE44 ZF_kl_ui8_S5_S3 1 UMR___1_100_0_S5_S3 0 1
 /begin AXIS_DESCR STD_AXIS zff_atsys._.iSignale._.obj.sig_c_getr UMR_GRADC__1_1_M40_S5_S3 4 -40 150 DEPOSIT ABSOLUTE /end AXIS_DESCR
/end CHARACTERISTIC
/begin CHARACTERISTIC KL_FPOCGHINSYNKAB76 "Temperaturabhängige Gewichtung des Haltedruckoffsets" CURVE 0x1BDF6C ZF_kl_ui8_S5_S3 1 UMR___1_100_0_S5_S3 0 1
 /begin AXIS_DESCR STD_AXIS zff_atsys._.iSignale._.obj.sig_c_getr UMR_GRADC__1_1_M40_S5_S3 4 -40 150 DEPOSIT ABSOLUTE /end AXIS_DESCR
/end CHARACTERISTIC
/begin CHARACTERISTIC KL_FPOCGHINSYNKAB87 "Temperaturabhängige Gewichtung des Haltedruckoffsets" CURVE 0x1BE094 ZF_kl_ui8_S5_S3 1 UMR___1_100_0_S5_S3 0 1
 /begin AXIS_DESCR STD_AXIS zff_atsys._.iSignale._.obj.sig_c_getr UMR_GRADC__1_1_M40_S5_S3 4 -40 150 DEPOSIT ABSOLUTE /end AXIS_DESCR
/end CHARACTERISTIC
/begin CHARACTERISTIC KL_FPOCGHINSYNKABSP31 "Temperaturabhängige Gewichtung des Haltedruckoffsets" CURVE 0x1BE1BC ZF_kl_ui8_S5_S3 1 UMR___1_100_0_S5_S3 0 1
 /begin AXIS_DESCR STD_AXIS zff_atsys._.iSignale._.obj.sig_c_getr UMR_GRADC__1_1_M40_S5_S3 4 -40 150 DEPOSIT ABSOLUTE /end AXIS_DESCR
/end CHARACTERISTIC
/begin CHARACTERISTIC KL_FPOCGHINSYNKABSP42 "Temperaturabhängige Gewichtung des Haltedruckoffsets" CURVE 0x1BE2E4 ZF_kl_ui8_S5_S3 1 UMR___1_100_0_S5_S3 0 1
 /begin AXIS_DESCR STD_AXIS zff_atsys._.iSignale._.obj.sig_c_getr UMR_GRADC__1_1_M40_S5_S3 4 -40 150 DEPOSIT ABSOLUTE /end AXIS_DESCR
/end CHARACTERISTIC
/begin CHARACTERISTIC KL_FPOCGHINSYNKABSP51 "Temperaturabhängige Gewichtung des Haltedruckoffsets" CURVE 0x1BE40C ZF_kl_ui8_S5_S3 1 UMR___1_100_0_S5_S3 0 1
 /begin AXIS_DESCR STD_AXIS zff_atsys._.iSignale._.obj.sig_c_getr UMR_GRADC__1_1_M40_S5_S3 4 -40 150 DEPOSIT ABSOLUTE /end AXIS_DESCR
/end CHARACTERISTIC
/begin CHARACTERISTIC KL_FPOCGHINSYNKABSP53 "Temperaturabhängige Gewichtung des Haltedruckoffsets" CURVE 0x1BE534 ZF_kl_ui8_S5_S3 1 UMR___1_100_0_S5_S3 0 1
 /begin AXIS_DESCR STD_AXIS zff_atsys._.iSignale._.obj.sig_c_getr UMR_GRADC__1_1_M40_S5_S3 4 -40 150 DEPOSIT ABSOLUTE /end AXIS_DESCR
/end CHARACTERISTIC
/begin CHARACTERISTIC KL_FPOCGHINSYNKABSP63 "Temperaturabhängige Gewichtung des Haltedruckoffsets" CURVE 0x1BE65C ZF_kl_ui8_S5_S3 1 UMR___1_100_0_S5_S3 0 1
 /begin AXIS_DESCR STD_AXIS zff_atsys._.iSignale._.obj.sig_c_getr UMR_GRADC__1_1_M40_S5_S3 4 -40 150 DEPOSIT ABSOLUTE /end AXIS_DESCR
/end CHARACTERISTIC
/begin CHARACTERISTIC KL_FPOCGHINSYNKABSP64 "Temperaturabhängige Gewichtung des Haltedruckoffsets" CURVE 0x1BE784 ZF_kl_ui8_S5_S3 1 UMR___1_100_0_S5_S3 0 1
 /begin AXIS_DESCR STD_AXIS zff_atsys._.iSignale._.obj.sig_c_getr UMR_GRADC__1_1_M40_S5_S3 4 -40 150 DEPOSIT ABSOLUTE /end AXIS_DESCR
/end CHARACTERISTIC
/begin CHARACTERISTIC KL_FPOCGHINSYNKABSP71 "Temperaturabhängige Gewichtung des Haltedruckoffsets" CURVE 0x1BE8AC ZF_kl_ui8_S5_S3 1 UMR___1_100_0_S5_S3 0 1
 /begin AXIS_DESCR STD_AXIS zff_atsys._.iSignale._.obj.sig_c_getr UMR_GRADC__1_1_M40_S5_S3 4 -40 150 DEPOSIT ABSOLUTE /end AXIS_DESCR
/end CHARACTERISTIC
/begin CHARACTERISTIC KL_FPOCGHINSYNKABSP75 "Temperaturabhängige Gewichtung des Haltedruckoffsets" CURVE 0x1BE9D4 ZF_kl_ui8_S5_S3 1 UMR___1_100_0_S5_S3 0 1
 /begin AXIS_DESCR STD_AXIS zff_atsys._.iSignale._.obj.sig_c_getr UMR_GRADC__1_1_M40_S5_S3 4 -40 150 DEPOSIT ABSOLUTE /end AXIS_DESCR
/end CHARACTERISTIC
/begin CHARACTERISTIC KL_FPOCGHINSYNKABSP82 "Temperaturabhängige Gewichtung des Haltedruckoffsets" CURVE 0x1BEAFC ZF_kl_ui8_S5_S3 1 UMR___1_100_0_S5_S3 0 1
 /begin AXIS_DESCR STD_AXIS zff_atsys._.iSignale._.obj.sig_c_getr UMR_GRADC__1_1_M40_S5_S3 4 -40 150 DEPOSIT ABSOLUTE /end AXIS_DESCR
/end CHARACTERISTIC
/begin CHARACTERISTIC KL_FPOCGHINSYNKABSP84 "Temperaturabhängige Gewichtung des Haltedruckoffsets" CURVE 0x1BED4C ZF_kl_ui8_S5_S3 1 UMR___1_100_0_S5_S3 0 1
 /begin AXIS_DESCR STD_AXIS zff_atsys._.iSignale._.obj.sig_c_getr UMR_GRADC__1_1_M40_S5_S3 4 -40 150 DEPOSIT ABSOLUTE /end AXIS_DESCR
/end CHARACTERISTIC
/begin CHARACTERISTIC KL_FPOCGHINSYNKABSP86 "Temperaturabhängige Gewichtung des Haltedruckoffsets" CURVE 0x1BEC24 ZF_kl_ui8_S5_S3 1 UMR___1_100_0_S5_S3 0 1
 /begin AXIS_DESCR STD_AXIS zff_atsys._.iSignale._.obj.sig_c_getr UMR_GRADC__1_1_M40_S5_S3 4 -40 150 DEPOSIT ABSOLUTE /end AXIS_DESCR
/end CHARACTERISTIC
/begin CHARACTERISTIC KL_FPOTNDSYNV2_1 "Temp. abhaengiger Faktor fuer Druckoffset waehrend FA 2. nichtkraftschliessende KZU" CURVE 0x1BFC84 ZF_kl_ui8_S5_S3 1 UMR___1_100_0_S5_S3 0 1
 /begin AXIS_DESCR STD_AXIS zff_atsys._.iSignale._.obj.sig_c_getr UMR_GRADC__1_1_M40_S5_S3 5 -40 150 DEPOSIT ABSOLUTE /end AXIS_DESCR
/end CHARACTERISTIC
/begin CHARACTERISTIC KL_FPOTNDSYNV2_2 "Temp. abhaengiger Faktor fuer Druckoffset waehrend FA 2. nichtkraftschliessende KZU" CURVE 0x1C01B4 ZF_kl_ui8_S5_S3 1 UMR___1_100_0_S5_S3 0 1
 /begin AXIS_DESCR STD_AXIS zff_atsys._.iSignale._.obj.sig_c_getr UMR_GRADC__1_1_M40_S5_S3 5 -40 150 DEPOSIT ABSOLUTE /end AXIS_DESCR
/end CHARACTERISTIC
/begin CHARACTERISTIC KL_FPOTNDSYNV2_3 "Temp. abhaengiger Faktor fuer Druckoffset waehrend FA 2. nichtkraftschliessende KZU" CURVE 0x1C06E4 ZF_kl_ui8_S5_S3 1 UMR___1_100_0_S5_S3 0 1
 /begin AXIS_DESCR STD_AXIS zff_atsys._.iSignale._.obj.sig_c_getr UMR_GRADC__1_1_M40_S5_S3 5 -40 150 DEPOSIT ABSOLUTE /end AXIS_DESCR
/end CHARACTERISTIC
/begin CHARACTERISTIC KL_FPOTNDSYNV2_4 "Temp. abhaengiger Faktor fuer Druckoffset waehrend FA 2. nichtkraftschliessende KZU" CURVE 0x1C0C14 ZF_kl_ui8_S5_S3 1 UMR___1_100_0_S5_S3 0 1
 /begin AXIS_DESCR STD_AXIS zff_atsys._.iSignale._.obj.sig_c_getr UMR_GRADC__1_1_M40_S5_S3 5 -40 150 DEPOSIT ABSOLUTE /end AXIS_DESCR
/end CHARACTERISTIC
/begin CHARACTERISTIC KL_FPOTNDSYNV2_5 "Temp. abhaengiger Faktor fuer Druckoffset waehrend FA 2. nichtkraftschliessende KZU" CURVE 0x1C1144 ZF_kl_ui8_S5_S3 1 UMR___1_100_0_S5_S3 0 1
 /begin AXIS_DESCR STD_AXIS zff_atsys._.iSignale._.obj.sig_c_getr UMR_GRADC__1_1_M40_S5_S3 5 -40 150 DEPOSIT ABSOLUTE /end AXIS_DESCR
/end CHARACTERISTIC
/begin CHARACTERISTIC KL_FPOTNDSYNV2_6 "Temp. abhaengiger Faktor fuer Druckoffset waehrend FA 2. nichtkraftschliessende KZU" CURVE 0x1C1674 ZF_kl_ui8_S5_S3 1 UMR___1_100_0_S5_S3 0 1
 /begin AXIS_DESCR STD_AXIS zff_atsys._.iSignale._.obj.sig_c_getr UMR_GRADC__1_1_M40_S5_S3 5 -40 150 DEPOSIT ABSOLUTE /end AXIS_DESCR
/end CHARACTERISTIC
/begin CHARACTERISTIC KL_PGOFCGV2_1 "Gradient Offset Fuelldruck 2. nicht kraftschl. Kup." CURVE 0x1BF780 ZF_kl_ui8_S5_S3 5 UMR_BAR_SEC_1_10_0_S5_S3 0 5
 /begin AXIS_DESCR STD_AXIS zff_atsys._.iSignale._.obj.sig_c_getr UMR_GRADC__1_1_M40_S5_S3 4 -40 150 DEPOSIT ABSOLUTE /end AXIS_DESCR
/end CHARACTERISTIC
/begin CHARACTERISTIC KL_PGOFCGV2_2 "Gradient Offset Fuelldruck 2. nicht kraftschl. Kup." CURVE 0x1BFCB0 ZF_kl_ui8_S5_S3 5 UMR_BAR_SEC_1_10_0_S5_S3 0 5
 /begin AXIS_DESCR STD_AXIS zff_atsys._.iSignale._.obj.sig_c_getr UMR_GRADC__1_1_M40_S5_S3 4 -40 150 DEPOSIT ABSOLUTE /end AXIS_DESCR
/end CHARACTERISTIC
/begin CHARACTERISTIC KL_PGOFCGV2_3 "Gradient Offset Fuelldruck 2. nicht kraftschl. Kup." CURVE 0x1C01E0 ZF_kl_ui8_S5_S3 5 UMR_BAR_SEC_1_10_0_S5_S3 0 5
 /begin AXIS_DESCR STD_AXIS zff_atsys._.iSignale._.obj.sig_c_getr UMR_GRADC__1_1_M40_S5_S3 4 -40 150 DEPOSIT ABSOLUTE /end AXIS_DESCR
/end CHARACTERISTIC
/begin CHARACTERISTIC KL_PGOFCGV2_4 "Gradient Offset Fuelldruck 2. nicht kraftschl. Kup." CURVE 0x1C0710 ZF_kl_ui8_S5_S3 5 UMR_BAR_SEC_1_10_0_S5_S3 0 5
 /begin AXIS_DESCR STD_AXIS zff_atsys._.iSignale._.obj.sig_c_getr UMR_GRADC__1_1_M40_S5_S3 4 -40 150 DEPOSIT ABSOLUTE /end AXIS_DESCR
/end CHARACTERISTIC
/begin CHARACTERISTIC KL_PGOFCGV2_5 "Gradient Offset Fuelldruck 2. nicht kraftschl. Kup." CURVE 0x1C0C40 ZF_kl_ui8_S5_S3 5 UMR_BAR_SEC_1_10_0_S5_S3 0 5
 /begin AXIS_DESCR STD_AXIS zff_atsys._.iSignale._.obj.sig_c_getr UMR_GRADC__1_1_M40_S5_S3 4 -40 150 DEPOSIT ABSOLUTE /end AXIS_DESCR
/end CHARACTERISTIC
/begin CHARACTERISTIC KL_PGOFCGV2_6 "Gradient Offset Fuelldruck 2. nicht kraftschl. Kup." CURVE 0x1C1170 ZF_kl_ui8_S5_S3 5 UMR_BAR_SEC_1_10_0_S5_S3 0 5
 /begin AXIS_DESCR STD_AXIS zff_atsys._.iSignale._.obj.sig_c_getr UMR_GRADC__1_1_M40_S5_S3 4 -40 150 DEPOSIT ABSOLUTE /end AXIS_DESCR
/end CHARACTERISTIC
/begin CHARACTERISTIC KL_PGOFMTESTART12 "Gradient Druckoffset Fuellphase" CURVE 0x1BEF3C ZF_kl_si16_S5_S3 200 UMR_BAR_SEC_1_10_0_S5_S3 -100 100
 /begin AXIS_DESCR STD_AXIS zff_atsys._.iSignale._.obj.sig_m_t UMR_NM__1_1_0_S5_S3 4 -200 1300 DEPOSIT ABSOLUTE /end AXIS_DESCR
/end CHARACTERISTIC
/begin CHARACTERISTIC KL_PGOFMT_1 "Gradient Druckoffset Fuellphase" CURVE 0x1BF82C ZF_kl_si16_S5_S3 200 UMR_BAR_SEC_1_10_0_S5_S3 -100 100
 /begin AXIS_DESCR STD_AXIS zff_atsys._.iSignale._.obj.sig_m_t UMR_NM__1_1_0_S5_S3 4 -200 1300 DEPOSIT ABSOLUTE /end AXIS_DESCR
/end CHARACTERISTIC
/begin CHARACTERISTIC KL_PGOFMT_2 "Gradient Druckoffset Fuellphase" CURVE 0x1BFD5C ZF_kl_si16_S5_S3 200 UMR_BAR_SEC_1_10_0_S5_S3 -100 100
 /begin AXIS_DESCR STD_AXIS zff_atsys._.iSignale._.obj.sig_m_t UMR_NM__1_1_0_S5_S3 4 -200 1300 DEPOSIT ABSOLUTE /end AXIS_DESCR
/end CHARACTERISTIC
/begin CHARACTERISTIC KL_PGOFMT_3 "Gradient Druckoffset Fuellphase" CURVE 0x1C028C ZF_kl_si16_S5_S3 200 UMR_BAR_SEC_1_10_0_S5_S3 -100 100
 /begin AXIS_DESCR STD_AXIS zff_atsys._.iSignale._.obj.sig_m_t UMR_NM__1_1_0_S5_S3 4 -200 1300 DEPOSIT ABSOLUTE /end AXIS_DESCR
/end CHARACTERISTIC
/begin CHARACTERISTIC KL_PGOFMT_4 "Gradient Druckoffset Fuellphase" CURVE 0x1C07BC ZF_kl_si16_S5_S3 200 UMR_BAR_SEC_1_10_0_S5_S3 -100 100
 /begin AXIS_DESCR STD_AXIS zff_atsys._.iSignale._.obj.sig_m_t UMR_NM__1_1_0_S5_S3 4 -200 1300 DEPOSIT ABSOLUTE /end AXIS_DESCR
/end CHARACTERISTIC
/begin CHARACTERISTIC KL_PGOFMT_5 "Gradient Druckoffset Fuellphase" CURVE 0x1C0CEC ZF_kl_si16_S5_S3 200 UMR_BAR_SEC_1_10_0_S5_S3 -100 100
 /begin AXIS_DESCR STD_AXIS zff_atsys._.iSignale._.obj.sig_m_t UMR_NM__1_1_0_S5_S3 4 -200 1300 DEPOSIT ABSOLUTE /end AXIS_DESCR
/end CHARACTERISTIC
/begin CHARACTERISTIC KL_PGOFMT_6 "Gradient Druckoffset Fuellphase" CURVE 0x1C121C ZF_kl_si16_S5_S3 200 UMR_BAR_SEC_1_10_0_S5_S3 -100 100
 /begin AXIS_DESCR STD_AXIS zff_atsys._.iSignale._.obj.sig_m_t UMR_NM__1_1_0_S5_S3 4 -200 1300 DEPOSIT ABSOLUTE /end AXIS_DESCR
/end CHARACTERISTIC
/begin CHARACTERISTIC KL_PGOKAB21 "Druckgradient in Abhaengigkeit von m_t" CURVE 0x1BD988 ZF_kl_si16_S5_S3 200 UMR_BAR_SEC_1_10_0_S5_S3 -100 100
 /begin AXIS_DESCR STD_AXIS zff_atsys._.iSignale._.obj.sig_m_t UMR_NM__1_1_0_S5_S3 6 -200 1300 DEPOSIT ABSOLUTE /end AXIS_DESCR
/end CHARACTERISTIC
/begin CHARACTERISTIC KL_PGOKAB32 "Druckgradient in Abhaengigkeit von m_t" CURVE 0x1BDAB0 ZF_kl_si16_S5_S3 200 UMR_BAR_SEC_1_10_0_S5_S3 -100 100
 /begin AXIS_DESCR STD_AXIS zff_atsys._.iSignale._.obj.sig_m_t UMR_NM__1_1_0_S5_S3 6 -200 1300 DEPOSIT ABSOLUTE /end AXIS_DESCR
/end CHARACTERISTIC
/begin CHARACTERISTIC KL_PGOKAB43 "Druckgradient in Abhaengigkeit von m_t" CURVE 0x1BDBD8 ZF_kl_si16_S5_S3 200 UMR_BAR_SEC_1_10_0_S5_S3 -100 100
 /begin AXIS_DESCR STD_AXIS zff_atsys._.iSignale._.obj.sig_m_t UMR_NM__1_1_0_S5_S3 6 -200 1300 DEPOSIT ABSOLUTE /end AXIS_DESCR
/end CHARACTERISTIC
/begin CHARACTERISTIC KL_PGOKAB54 "Druckgradient in Abhaengigkeit von m_t" CURVE 0x1BDD00 ZF_kl_si16_S5_S3 200 UMR_BAR_SEC_1_10_0_S5_S3 -100 100
 /begin AXIS_DESCR STD_AXIS zff_atsys._.iSignale._.obj.sig_m_t UMR_NM__1_1_0_S5_S3 6 -200 1300 DEPOSIT ABSOLUTE /end AXIS_DESCR
/end CHARACTERISTIC
/begin CHARACTERISTIC KL_PGOKAB65 "Druckgradient in Abhaengigkeit von m_t" CURVE 0x1BDE28 ZF_kl_si16_S5_S3 200 UMR_BAR_SEC_1_10_0_S5_S3 -100 100
 /begin AXIS_DESCR STD_AXIS zff_atsys._.iSignale._.obj.sig_m_t UMR_NM__1_1_0_S5_S3 6 -200 1300 DEPOSIT ABSOLUTE /end AXIS_DESCR
/end CHARACTERISTIC
/begin CHARACTERISTIC KL_PGOKAB76 "Druckgradient in Abhaengigkeit von m_t" CURVE 0x1BDF50 ZF_kl_si16_S5_S3 200 UMR_BAR_SEC_1_10_0_S5_S3 -100 100
 /begin AXIS_DESCR STD_AXIS zff_atsys._.iSignale._.obj.sig_m_t UMR_NM__1_1_0_S5_S3 6 -200 1300 DEPOSIT ABSOLUTE /end AXIS_DESCR
/end CHARACTERISTIC
/begin CHARACTERISTIC KL_PGOKAB87 "Druckgradient in Abhaengigkeit von m_t" CURVE 0x1BE078 ZF_kl_si16_S5_S3 200 UMR_BAR_SEC_1_10_0_S5_S3 -100 100
 /begin AXIS_DESCR STD_AXIS zff_atsys._.iSignale._.obj.sig_m_t UMR_NM__1_1_0_S5_S3 6 -200 1300 DEPOSIT ABSOLUTE /end AXIS_DESCR
/end CHARACTERISTIC
/begin CHARACTERISTIC KL_PGOKABSP31 "Druckgradient in Abhaengigkeit von m_t" CURVE 0x1BE1A0 ZF_kl_si16_S5_S3 200 UMR_BAR_SEC_1_10_0_S5_S3 -100 100
 /begin AXIS_DESCR STD_AXIS zff_atsys._.iSignale._.obj.sig_m_t UMR_NM__1_1_0_S5_S3 6 -200 1300 DEPOSIT ABSOLUTE /end AXIS_DESCR
/end CHARACTERISTIC
/begin CHARACTERISTIC KL_PGOKABSP42 "Druckgradient in Abhaengigkeit von m_t" CURVE 0x1BE2C8 ZF_kl_si16_S5_S3 200 UMR_BAR_SEC_1_10_0_S5_S3 -100 100
 /begin AXIS_DESCR STD_AXIS zff_atsys._.iSignale._.obj.sig_m_t UMR_NM__1_1_0_S5_S3 6 -200 1300 DEPOSIT ABSOLUTE /end AXIS_DESCR
/end CHARACTERISTIC
/begin CHARACTERISTIC KL_PGOKABSP51 "Druckgradient in Abhaengigkeit von m_t" CURVE 0x1BE3F0 ZF_kl_si16_S5_S3 200 UMR_BAR_SEC_1_10_0_S5_S3 -100 100
 /begin AXIS_DESCR STD_AXIS zff_atsys._.iSignale._.obj.sig_m_t UMR_NM__1_1_0_S5_S3 6 -200 1300 DEPOSIT ABSOLUTE /end AXIS_DESCR
/end CHARACTERISTIC
/begin CHARACTERISTIC KL_PGOKABSP53 "Druckgradient in Abhaengigkeit von m_t" CURVE 0x1BE518 ZF_kl_si16_S5_S3 200 UMR_BAR_SEC_1_10_0_S5_S3 -100 100
 /begin AXIS_DESCR STD_AXIS zff_atsys._.iSignale._.obj.sig_m_t UMR_NM__1_1_0_S5_S3 6 -200 1300 DEPOSIT ABSOLUTE /end AXIS_DESCR
/end CHARACTERISTIC
/begin CHARACTERISTIC KL_PGOKABSP63 "Druckgradient in Abhaengigkeit von m_t" CURVE 0x1BE640 ZF_kl_si16_S5_S3 200 UMR_BAR_SEC_1_10_0_S5_S3 -100 100
 /begin AXIS_DESCR STD_AXIS zff_atsys._.iSignale._.obj.sig_m_t UMR_NM__1_1_0_S5_S3 6 -200 1300 DEPOSIT ABSOLUTE /end AXIS_DESCR
/end CHARACTERISTIC
/begin CHARACTERISTIC KL_PGOKABSP64 "Druckgradient in Abhaengigkeit von m_t" CURVE 0x1BE768 ZF_kl_si16_S5_S3 200 UMR_BAR_SEC_1_10_0_S5_S3 -100 100
 /begin AXIS_DESCR STD_AXIS zff_atsys._.iSignale._.obj.sig_m_t UMR_NM__1_1_0_S5_S3 6 -200 1300 DEPOSIT ABSOLUTE /end AXIS_DESCR
/end CHARACTERISTIC
/begin CHARACTERISTIC KL_PGOKABSP71 "Druckgradient in Abhaengigkeit von m_t" CURVE 0x1BE890 ZF_kl_si16_S5_S3 200 UMR_BAR_SEC_1_10_0_S5_S3 -100 100
 /begin AXIS_DESCR STD_AXIS zff_atsys._.iSignale._.obj.sig_m_t UMR_NM__1_1_0_S5_S3 6 -200 1300 DEPOSIT ABSOLUTE /end AXIS_DESCR
/end CHARACTERISTIC
/begin CHARACTERISTIC KL_PGOKABSP75 "Druckgradient in Abhaengigkeit von m_t" CURVE 0x1BE9B8 ZF_kl_si16_S5_S3 200 UMR_BAR_SEC_1_10_0_S5_S3 -100 100
 /begin AXIS_DESCR STD_AXIS zff_atsys._.iSignale._.obj.sig_m_t UMR_NM__1_1_0_S5_S3 6 -200 1300 DEPOSIT ABSOLUTE /end AXIS_DESCR
/end CHARACTERISTIC
/begin CHARACTERISTIC KL_PGOKABSP82 "Druckgradient in Abhaengigkeit von m_t" CURVE 0x1BEAE0 ZF_kl_si16_S5_S3 200 UMR_BAR_SEC_1_10_0_S5_S3 -100 100
 /begin AXIS_DESCR STD_AXIS zff_atsys._.iSignale._.obj.sig_m_t UMR_NM__1_1_0_S5_S3 6 -200 1300 DEPOSIT ABSOLUTE /end AXIS_DESCR
/end CHARACTERISTIC
/begin CHARACTERISTIC KL_PGOKABSP84 "Druckgradient in Abhaengigkeit von m_t" CURVE 0x1BED30 ZF_kl_si16_S5_S3 200 UMR_BAR_SEC_1_10_0_S5_S3 -100 100
 /begin AXIS_DESCR STD_AXIS zff_atsys._.iSignale._.obj.sig_m_t UMR_NM__1_1_0_S5_S3 6 -200 1300 DEPOSIT ABSOLUTE /end AXIS_DESCR
/end CHARACTERISTIC
/begin CHARACTERISTIC KL_PGOKABSP86 "Druckgradient in Abhaengigkeit von m_t" CURVE 0x1BEC08 ZF_kl_si16_S5_S3 200 UMR_BAR_SEC_1_10_0_S5_S3 -100 100
 /begin AXIS_DESCR STD_AXIS zff_atsys._.iSignale._.obj.sig_m_t UMR_NM__1_1_0_S5_S3 6 -200 1300 DEPOSIT ABSOLUTE /end AXIS_DESCR
/end CHARACTERISTIC
/begin CHARACTERISTIC KL_PGOKZUNAB_1 "Schaltdruckgradienten Offset f(n_ab)" CURVE 0x1BFBB0 ZF_kl_si16_S5_S3 200 UMR_BAR_SEC_1_10_0_S5_S3 -100 100
 /begin AXIS_DESCR STD_AXIS zff_atsys._.iSignale._.obj.sig_n_ab UMR_U_MIN_1_1_0_S5_S3 2 0 8160 DEPOSIT ABSOLUTE /end AXIS_DESCR
/end CHARACTERISTIC
/begin CHARACTERISTIC KL_PGOKZUNAB_2 "Schaltdruckgradienten Offset f(n_ab)" CURVE 0x1C00E0 ZF_kl_si16_S5_S3 200 UMR_BAR_SEC_1_10_0_S5_S3 -100 100
 /begin AXIS_DESCR STD_AXIS zff_atsys._.iSignale._.obj.sig_n_ab UMR_U_MIN_1_1_0_S5_S3 2 0 8160 DEPOSIT ABSOLUTE /end AXIS_DESCR
/end CHARACTERISTIC
/begin CHARACTERISTIC KL_PGOKZUNAB_3 "Schaltdruckgradienten Offset f(n_ab)" CURVE 0x1C0610 ZF_kl_si16_S5_S3 200 UMR_BAR_SEC_1_10_0_S5_S3 -100 100
 /begin AXIS_DESCR STD_AXIS zff_atsys._.iSignale._.obj.sig_n_ab UMR_U_MIN_1_1_0_S5_S3 2 0 8160 DEPOSIT ABSOLUTE /end AXIS_DESCR
/end CHARACTERISTIC
/begin CHARACTERISTIC KL_PGOKZUNAB_4 "Schaltdruckgradienten Offset f(n_ab)" CURVE 0x1C0B40 ZF_kl_si16_S5_S3 200 UMR_BAR_SEC_1_10_0_S5_S3 -100 100
 /begin AXIS_DESCR STD_AXIS zff_atsys._.iSignale._.obj.sig_n_ab UMR_U_MIN_1_1_0_S5_S3 2 0 8160 DEPOSIT ABSOLUTE /end AXIS_DESCR
/end CHARACTERISTIC
/begin CHARACTERISTIC KL_PGOKZUNAB_5 "Schaltdruckgradienten Offset f(n_ab)" CURVE 0x1C1070 ZF_kl_si16_S5_S3 200 UMR_BAR_SEC_1_10_0_S5_S3 -100 100
 /begin AXIS_DESCR STD_AXIS zff_atsys._.iSignale._.obj.sig_n_ab UMR_U_MIN_1_1_0_S5_S3 2 0 8160 DEPOSIT ABSOLUTE /end AXIS_DESCR
/end CHARACTERISTIC
/begin CHARACTERISTIC KL_PGOKZUNAB_6 "Schaltdruckgradienten Offset f(n_ab)" CURVE 0x1C15A0 ZF_kl_si16_S5_S3 200 UMR_BAR_SEC_1_10_0_S5_S3 -100 100
 /begin AXIS_DESCR STD_AXIS zff_atsys._.iSignale._.obj.sig_n_ab UMR_U_MIN_1_1_0_S5_S3 2 0 8160 DEPOSIT ABSOLUTE /end AXIS_DESCR
/end CHARACTERISTIC
/begin CHARACTERISTIC KL_PGOKZU_1 "Druckgradient in Abhaengigkeit von m_t" CURVE 0x1BF8E8 ZF_kl_si16_S5_S3 200 UMR_BAR_SEC_1_10_0_S5_S3 -100 100
 /begin AXIS_DESCR STD_AXIS zff_atsys._.iSignale._.obj.sig_m_t UMR_NM__1_1_0_S5_S3 6 -200 1300 DEPOSIT ABSOLUTE /end AXIS_DESCR
/end CHARACTERISTIC
/begin CHARACTERISTIC KL_PGOKZU_2 "Druckgradient in Abhaengigkeit von m_t" CURVE 0x1BFE18 ZF_kl_si16_S5_S3 200 UMR_BAR_SEC_1_10_0_S5_S3 -100 100
 /begin AXIS_DESCR STD_AXIS zff_atsys._.iSignale._.obj.sig_m_t UMR_NM__1_1_0_S5_S3 6 -200 1300 DEPOSIT ABSOLUTE /end AXIS_DESCR
/end CHARACTERISTIC
/begin CHARACTERISTIC KL_PGOKZU_3 "Druckgradient in Abhaengigkeit von m_t" CURVE 0x1C0348 ZF_kl_si16_S5_S3 200 UMR_BAR_SEC_1_10_0_S5_S3 -100 100
 /begin AXIS_DESCR STD_AXIS zff_atsys._.iSignale._.obj.sig_m_t UMR_NM__1_1_0_S5_S3 6 -200 1300 DEPOSIT ABSOLUTE /end AXIS_DESCR
/end CHARACTERISTIC
/begin CHARACTERISTIC KL_PGOKZU_4 "Druckgradient in Abhaengigkeit von m_t" CURVE 0x1C0878 ZF_kl_si16_S5_S3 200 UMR_BAR_SEC_1_10_0_S5_S3 -100 100
 /begin AXIS_DESCR STD_AXIS zff_atsys._.iSignale._.obj.sig_m_t UMR_NM__1_1_0_S5_S3 6 -200 1300 DEPOSIT ABSOLUTE /end AXIS_DESCR
/end CHARACTERISTIC
/begin CHARACTERISTIC KL_PGOKZU_5 "Druckgradient in Abhaengigkeit von m_t" CURVE 0x1C0DA8 ZF_kl_si16_S5_S3 200 UMR_BAR_SEC_1_10_0_S5_S3 -100 100
 /begin AXIS_DESCR STD_AXIS zff_atsys._.iSignale._.obj.sig_m_t UMR_NM__1_1_0_S5_S3 6 -200 1300 DEPOSIT ABSOLUTE /end AXIS_DESCR
/end CHARACTERISTIC
/begin CHARACTERISTIC KL_PGOKZU_6 "Druckgradient in Abhaengigkeit von m_t" CURVE 0x1C12D8 ZF_kl_si16_S5_S3 200 UMR_BAR_SEC_1_10_0_S5_S3 -100 100
 /begin AXIS_DESCR STD_AXIS zff_atsys._.iSignale._.obj.sig_m_t UMR_NM__1_1_0_S5_S3 6 -200 1300 DEPOSIT ABSOLUTE /end AXIS_DESCR
/end CHARACTERISTIC
/begin CHARACTERISTIC KL_PGRASYNKAB21 "Druckgradient Wegschalten abschaltende Kupplung" CURVE 0x1BD9B0 ZF_kl_si16_S5_S3 100 UMR_BAR_SEC_1_10_0_S5_S3 -100 0
 /begin AXIS_DESCR STD_AXIS zff_atsys._.iSignale._.obj.sig_m_t UMR_NM__1_1_0_S5_S3 6 -200 1300 DEPOSIT ABSOLUTE /end AXIS_DESCR
/end CHARACTERISTIC
/begin CHARACTERISTIC KL_PGRASYNKAB32 "Druckgradient Wegschalten abschaltende Kupplung" CURVE 0x1BDAD8 ZF_kl_si16_S5_S3 100 UMR_BAR_SEC_1_10_0_S5_S3 -100 0
 /begin AXIS_DESCR STD_AXIS zff_atsys._.iSignale._.obj.sig_m_t UMR_NM__1_1_0_S5_S3 6 -200 1300 DEPOSIT ABSOLUTE /end AXIS_DESCR
/end CHARACTERISTIC
/begin CHARACTERISTIC KL_PGRASYNKAB43 "Druckgradient Wegschalten abschaltende Kupplung" CURVE 0x1BDC00 ZF_kl_si16_S5_S3 100 UMR_BAR_SEC_1_10_0_S5_S3 -100 0
 /begin AXIS_DESCR STD_AXIS zff_atsys._.iSignale._.obj.sig_m_t UMR_NM__1_1_0_S5_S3 6 -200 1300 DEPOSIT ABSOLUTE /end AXIS_DESCR
/end CHARACTERISTIC
/begin CHARACTERISTIC KL_PGRASYNKAB54 "Druckgradient Wegschalten abschaltende Kupplung" CURVE 0x1BDD28 ZF_kl_si16_S5_S3 100 UMR_BAR_SEC_1_10_0_S5_S3 -100 0
 /begin AXIS_DESCR STD_AXIS zff_atsys._.iSignale._.obj.sig_m_t UMR_NM__1_1_0_S5_S3 6 -200 1300 DEPOSIT ABSOLUTE /end AXIS_DESCR
/end CHARACTERISTIC
/begin CHARACTERISTIC KL_PGRASYNKAB65 "Druckgradient Wegschalten abschaltende Kupplung" CURVE 0x1BDE50 ZF_kl_si16_S5_S3 100 UMR_BAR_SEC_1_10_0_S5_S3 -100 0
 /begin AXIS_DESCR STD_AXIS zff_atsys._.iSignale._.obj.sig_m_t UMR_NM__1_1_0_S5_S3 6 -200 1300 DEPOSIT ABSOLUTE /end AXIS_DESCR
/end CHARACTERISTIC
/begin CHARACTERISTIC KL_PGRASYNKAB76 "Druckgradient Wegschalten abschaltende Kupplung" CURVE 0x1BDF78 ZF_kl_si16_S5_S3 100 UMR_BAR_SEC_1_10_0_S5_S3 -100 0
 /begin AXIS_DESCR STD_AXIS zff_atsys._.iSignale._.obj.sig_m_t UMR_NM__1_1_0_S5_S3 6 -200 1300 DEPOSIT ABSOLUTE /end AXIS_DESCR
/end CHARACTERISTIC
/begin CHARACTERISTIC KL_PGRASYNKAB87 "Druckgradient Wegschalten abschaltende Kupplung" CURVE 0x1BE0A0 ZF_kl_si16_S5_S3 100 UMR_BAR_SEC_1_10_0_S5_S3 -100 0
 /begin AXIS_DESCR STD_AXIS zff_atsys._.iSignale._.obj.sig_m_t UMR_NM__1_1_0_S5_S3 6 -200 1300 DEPOSIT ABSOLUTE /end AXIS_DESCR
/end CHARACTERISTIC
/begin CHARACTERISTIC KL_PGRASYNKABSP31 "Druckgradient Wegschalten abschaltende Kupplung" CURVE 0x1BE1C8 ZF_kl_si16_S5_S3 100 UMR_BAR_SEC_1_10_0_S5_S3 -100 0
 /begin AXIS_DESCR STD_AXIS zff_atsys._.iSignale._.obj.sig_m_t UMR_NM__1_1_0_S5_S3 6 -200 1300 DEPOSIT ABSOLUTE /end AXIS_DESCR
/end CHARACTERISTIC
/begin CHARACTERISTIC KL_PGRASYNKABSP42 "Druckgradient Wegschalten abschaltende Kupplung" CURVE 0x1BE2F0 ZF_kl_si16_S5_S3 100 UMR_BAR_SEC_1_10_0_S5_S3 -100 0
 /begin AXIS_DESCR STD_AXIS zff_atsys._.iSignale._.obj.sig_m_t UMR_NM__1_1_0_S5_S3 6 -200 1300 DEPOSIT ABSOLUTE /end AXIS_DESCR
/end CHARACTERISTIC
/begin CHARACTERISTIC KL_PGRASYNKABSP51 "Druckgradient Wegschalten abschaltende Kupplung" CURVE 0x1BE418 ZF_kl_si16_S5_S3 100 UMR_BAR_SEC_1_10_0_S5_S3 -100 0
 /begin AXIS_DESCR STD_AXIS zff_atsys._.iSignale._.obj.sig_m_t UMR_NM__1_1_0_S5_S3 6 -200 1300 DEPOSIT ABSOLUTE /end AXIS_DESCR
/end CHARACTERISTIC
/begin CHARACTERISTIC KL_PGRASYNKABSP53 "Druckgradient Wegschalten abschaltende Kupplung" CURVE 0x1BE540 ZF_kl_si16_S5_S3 100 UMR_BAR_SEC_1_10_0_S5_S3 -100 0
 /begin AXIS_DESCR STD_AXIS zff_atsys._.iSignale._.obj.sig_m_t UMR_NM__1_1_0_S5_S3 6 -200 1300 DEPOSIT ABSOLUTE /end AXIS_DESCR
/end CHARACTERISTIC
/begin CHARACTERISTIC KL_PGRASYNKABSP63 "Druckgradient Wegschalten abschaltende Kupplung" CURVE 0x1BE668 ZF_kl_si16_S5_S3 100 UMR_BAR_SEC_1_10_0_S5_S3 -100 0
 /begin AXIS_DESCR STD_AXIS zff_atsys._.iSignale._.obj.sig_m_t UMR_NM__1_1_0_S5_S3 6 -200 1300 DEPOSIT ABSOLUTE /end AXIS_DESCR
/end CHARACTERISTIC
/begin CHARACTERISTIC KL_PGRASYNKABSP64 "Druckgradient Wegschalten abschaltende Kupplung" CURVE 0x1BE790 ZF_kl_si16_S5_S3 100 UMR_BAR_SEC_1_10_0_S5_S3 -100 0
 /begin AXIS_DESCR STD_AXIS zff_atsys._.iSignale._.obj.sig_m_t UMR_NM__1_1_0_S5_S3 6 -200 1300 DEPOSIT ABSOLUTE /end AXIS_DESCR
/end CHARACTERISTIC
/begin CHARACTERISTIC KL_PGRASYNKABSP71 "Druckgradient Wegschalten abschaltende Kupplung" CURVE 0x1BE8B8 ZF_kl_si16_S5_S3 100 UMR_BAR_SEC_1_10_0_S5_S3 -100 0
 /begin AXIS_DESCR STD_AXIS zff_atsys._.iSignale._.obj.sig_m_t UMR_NM__1_1_0_S5_S3 6 -200 1300 DEPOSIT ABSOLUTE /end AXIS_DESCR
/end CHARACTERISTIC
/begin CHARACTERISTIC KL_PGRASYNKABSP75 "Druckgradient Wegschalten abschaltende Kupplung" CURVE 0x1BE9E0 ZF_kl_si16_S5_S3 100 UMR_BAR_SEC_1_10_0_S5_S3 -100 0
 /begin AXIS_DESCR STD_AXIS zff_atsys._.iSignale._.obj.sig_m_t UMR_NM__1_1_0_S5_S3 6 -200 1300 DEPOSIT ABSOLUTE /end AXIS_DESCR
/end CHARACTERISTIC
/begin CHARACTERISTIC KL_PGRASYNKABSP82 "Druckgradient Wegschalten abschaltende Kupplung" CURVE 0x1BEB08 ZF_kl_si16_S5_S3 100 UMR_BAR_SEC_1_10_0_S5_S3 -100 0
 /begin AXIS_DESCR STD_AXIS zff_atsys._.iSignale._.obj.sig_m_t UMR_NM__1_1_0_S5_S3 6 -200 1300 DEPOSIT ABSOLUTE /end AXIS_DESCR
/end CHARACTERISTIC
/begin CHARACTERISTIC KL_PGRASYNKABSP84 "Druckgradient Wegschalten abschaltende Kupplung" CURVE 0x1BED58 ZF_kl_si16_S5_S3 100 UMR_BAR_SEC_1_10_0_S5_S3 -100 0
 /begin AXIS_DESCR STD_AXIS zff_atsys._.iSignale._.obj.sig_m_t UMR_NM__1_1_0_S5_S3 6 -200 1300 DEPOSIT ABSOLUTE /end AXIS_DESCR
/end CHARACTERISTIC
/begin CHARACTERISTIC KL_PGRASYNKABSP86 "Druckgradient Wegschalten abschaltende Kupplung" CURVE 0x1BEC30 ZF_kl_si16_S5_S3 100 UMR_BAR_SEC_1_10_0_S5_S3 -100 0
 /begin AXIS_DESCR STD_AXIS zff_atsys._.iSignale._.obj.sig_m_t UMR_NM__1_1_0_S5_S3 6 -200 1300 DEPOSIT ABSOLUTE /end AXIS_DESCR
/end CHARACTERISTIC
/begin CHARACTERISTIC KL_PGRASYNKABWS21 "Druckgradient Wegschalten abschaltende Kupplung bei Weiterschaltung" CURVE 0x1BD9CC ZF_kl_si16_S5_S3 100 UMR_BAR_SEC_1_10_0_S5_S3 -100 0
 /begin AXIS_DESCR STD_AXIS zff_atsys._.iSignale._.obj.sig_m_t UMR_NM__1_1_0_S5_S3 6 -200 1300 DEPOSIT ABSOLUTE /end AXIS_DESCR
/end CHARACTERISTIC
/begin CHARACTERISTIC KL_PGRASYNKABWS32 "Druckgradient Wegschalten abschaltende Kupplung bei Weiterschaltung" CURVE 0x1BDAF4 ZF_kl_si16_S5_S3 100 UMR_BAR_SEC_1_10_0_S5_S3 -100 0
 /begin AXIS_DESCR STD_AXIS zff_atsys._.iSignale._.obj.sig_m_t UMR_NM__1_1_0_S5_S3 6 -200 1300 DEPOSIT ABSOLUTE /end AXIS_DESCR
/end CHARACTERISTIC
/begin CHARACTERISTIC KL_PGRASYNKABWS43 "Druckgradient Wegschalten abschaltende Kupplung bei Weiterschaltung" CURVE 0x1BDC1C ZF_kl_si16_S5_S3 100 UMR_BAR_SEC_1_10_0_S5_S3 -100 0
 /begin AXIS_DESCR STD_AXIS zff_atsys._.iSignale._.obj.sig_m_t UMR_NM__1_1_0_S5_S3 6 -200 1300 DEPOSIT ABSOLUTE /end AXIS_DESCR
/end CHARACTERISTIC
/begin CHARACTERISTIC KL_PGRASYNKABWS54 "Druckgradient Wegschalten abschaltende Kupplung bei Weiterschaltung" CURVE 0x1BDD44 ZF_kl_si16_S5_S3 100 UMR_BAR_SEC_1_10_0_S5_S3 -100 0
 /begin AXIS_DESCR STD_AXIS zff_atsys._.iSignale._.obj.sig_m_t UMR_NM__1_1_0_S5_S3 6 -200 1300 DEPOSIT ABSOLUTE /end AXIS_DESCR
/end CHARACTERISTIC
/begin CHARACTERISTIC KL_PGRASYNKABWS65 "Druckgradient Wegschalten abschaltende Kupplung bei Weiterschaltung" CURVE 0x1BDE6C ZF_kl_si16_S5_S3 100 UMR_BAR_SEC_1_10_0_S5_S3 -100 0
 /begin AXIS_DESCR STD_AXIS zff_atsys._.iSignale._.obj.sig_m_t UMR_NM__1_1_0_S5_S3 6 -200 1300 DEPOSIT ABSOLUTE /end AXIS_DESCR
/end CHARACTERISTIC
/begin CHARACTERISTIC KL_PGRASYNKABWS76 "Druckgradient Wegschalten abschaltende Kupplung bei Weiterschaltung" CURVE 0x1BDF94 ZF_kl_si16_S5_S3 100 UMR_BAR_SEC_1_10_0_S5_S3 -100 0
 /begin AXIS_DESCR STD_AXIS zff_atsys._.iSignale._.obj.sig_m_t UMR_NM__1_1_0_S5_S3 6 -200 1300 DEPOSIT ABSOLUTE /end AXIS_DESCR
/end CHARACTERISTIC
/begin CHARACTERISTIC KL_PGRASYNKABWS87 "Druckgradient Wegschalten abschaltende Kupplung bei Weiterschaltung" CURVE 0x1BE0BC ZF_kl_si16_S5_S3 100 UMR_BAR_SEC_1_10_0_S5_S3 -100 0
 /begin AXIS_DESCR STD_AXIS zff_atsys._.iSignale._.obj.sig_m_t UMR_NM__1_1_0_S5_S3 6 -200 1300 DEPOSIT ABSOLUTE /end AXIS_DESCR
/end CHARACTERISTIC
/begin CHARACTERISTIC KL_PGRASYNKABWSSP31 "Druckgradient Wegschalten abschaltende Kupplung bei Weiterschaltung" CURVE 0x1BE1E4 ZF_kl_si16_S5_S3 100 UMR_BAR_SEC_1_10_0_S5_S3 -100 0
 /begin AXIS_DESCR STD_AXIS zff_atsys._.iSignale._.obj.sig_m_t UMR_NM__1_1_0_S5_S3 6 -200 1300 DEPOSIT ABSOLUTE /end AXIS_DESCR
/end CHARACTERISTIC
/begin CHARACTERISTIC KL_PGRASYNKABWSSP42 "Druckgradient Wegschalten abschaltende Kupplung bei Weiterschaltung" CURVE 0x1BE30C ZF_kl_si16_S5_S3 100 UMR_BAR_SEC_1_10_0_S5_S3 -100 0
 /begin AXIS_DESCR STD_AXIS zff_atsys._.iSignale._.obj.sig_m_t UMR_NM__1_1_0_S5_S3 6 -200 1300 DEPOSIT ABSOLUTE /end AXIS_DESCR
/end CHARACTERISTIC
/begin CHARACTERISTIC KL_PGRASYNKABWSSP51 "Druckgradient Wegschalten abschaltende Kupplung bei Weiterschaltung" CURVE 0x1BE434 ZF_kl_si16_S5_S3 100 UMR_BAR_SEC_1_10_0_S5_S3 -100 0
 /begin AXIS_DESCR STD_AXIS zff_atsys._.iSignale._.obj.sig_m_t UMR_NM__1_1_0_S5_S3 6 -200 1300 DEPOSIT ABSOLUTE /end AXIS_DESCR
/end CHARACTERISTIC
/begin CHARACTERISTIC KL_PGRASYNKABWSSP53 "Druckgradient Wegschalten abschaltende Kupplung bei Weiterschaltung" CURVE 0x1BE55C ZF_kl_si16_S5_S3 100 UMR_BAR_SEC_1_10_0_S5_S3 -100 0
 /begin AXIS_DESCR STD_AXIS zff_atsys._.iSignale._.obj.sig_m_t UMR_NM__1_1_0_S5_S3 6 -200 1300 DEPOSIT ABSOLUTE /end AXIS_DESCR
/end CHARACTERISTIC
/begin CHARACTERISTIC KL_PGRASYNKABWSSP63 "Druckgradient Wegschalten abschaltende Kupplung bei Weiterschaltung" CURVE 0x1BE684 ZF_kl_si16_S5_S3 100 UMR_BAR_SEC_1_10_0_S5_S3 -100 0
 /begin AXIS_DESCR STD_AXIS zff_atsys._.iSignale._.obj.sig_m_t UMR_NM__1_1_0_S5_S3 6 -200 1300 DEPOSIT ABSOLUTE /end AXIS_DESCR
/end CHARACTERISTIC
/begin CHARACTERISTIC KL_PGRASYNKABWSSP64 "Druckgradient Wegschalten abschaltende Kupplung bei Weiterschaltung" CURVE 0x1BE7AC ZF_kl_si16_S5_S3 100 UMR_BAR_SEC_1_10_0_S5_S3 -100 0
 /begin AXIS_DESCR STD_AXIS zff_atsys._.iSignale._.obj.sig_m_t UMR_NM__1_1_0_S5_S3 6 -200 1300 DEPOSIT ABSOLUTE /end AXIS_DESCR
/end CHARACTERISTIC
/begin CHARACTERISTIC KL_PGRASYNKABWSSP71 "Druckgradient Wegschalten abschaltende Kupplung bei Weiterschaltung" CURVE 0x1BE8D4 ZF_kl_si16_S5_S3 100 UMR_BAR_SEC_1_10_0_S5_S3 -100 0
 /begin AXIS_DESCR STD_AXIS zff_atsys._.iSignale._.obj.sig_m_t UMR_NM__1_1_0_S5_S3 6 -200 1300 DEPOSIT ABSOLUTE /end AXIS_DESCR
/end CHARACTERISTIC
/begin CHARACTERISTIC KL_PGRASYNKABWSSP75 "Druckgradient Wegschalten abschaltende Kupplung bei Weiterschaltung" CURVE 0x1BE9FC ZF_kl_si16_S5_S3 100 UMR_BAR_SEC_1_10_0_S5_S3 -100 0
 /begin AXIS_DESCR STD_AXIS zff_atsys._.iSignale._.obj.sig_m_t UMR_NM__1_1_0_S5_S3 6 -200 1300 DEPOSIT ABSOLUTE /end AXIS_DESCR
/end CHARACTERISTIC
/begin CHARACTERISTIC KL_PGRASYNKABWSSP82 "Druckgradient Wegschalten abschaltende Kupplung bei Weiterschaltung" CURVE 0x1BEB24 ZF_kl_si16_S5_S3 100 UMR_BAR_SEC_1_10_0_S5_S3 -100 0
 /begin AXIS_DESCR STD_AXIS zff_atsys._.iSignale._.obj.sig_m_t UMR_NM__1_1_0_S5_S3 6 -200 1300 DEPOSIT ABSOLUTE /end AXIS_DESCR
/end CHARACTERISTIC
/begin CHARACTERISTIC KL_PGRASYNKABWSSP84 "Druckgradient Wegschalten abschaltende Kupplung bei Weiterschaltung" CURVE 0x1BED74 ZF_kl_si16_S5_S3 100 UMR_BAR_SEC_1_10_0_S5_S3 -100 0
 /begin AXIS_DESCR STD_AXIS zff_atsys._.iSignale._.obj.sig_m_t UMR_NM__1_1_0_S5_S3 6 -200 1300 DEPOSIT ABSOLUTE /end AXIS_DESCR
/end CHARACTERISTIC
/begin CHARACTERISTIC KL_PGRASYNKABWSSP86 "Druckgradient Wegschalten abschaltende Kupplung bei Weiterschaltung" CURVE 0x1BEC4C ZF_kl_si16_S5_S3 100 UMR_BAR_SEC_1_10_0_S5_S3 -100 0
 /begin AXIS_DESCR STD_AXIS zff_atsys._.iSignale._.obj.sig_m_t UMR_NM__1_1_0_S5_S3 6 -200 1300 DEPOSIT ABSOLUTE /end AXIS_DESCR
/end CHARACTERISTIC
/begin CHARACTERISTIC KL_PGRASYNNAB_1 "Schliessrampenradient f(n_ab)" CURVE 0x1BF920 ZF_kl_si16_S5_S3 200 UMR_BAR_SEC_1_10_0_S5_S3 -100 100
 /begin AXIS_DESCR STD_AXIS zff_atsys._.iSignale._.obj.sig_n_ab UMR_U_MIN_1_1_0_S5_S3 2 0 8160 DEPOSIT ABSOLUTE /end AXIS_DESCR
/end CHARACTERISTIC
/begin CHARACTERISTIC KL_PGRASYNNAB_2 "Schliessrampenradient f(n_ab)" CURVE 0x1BFE50 ZF_kl_si16_S5_S3 200 UMR_BAR_SEC_1_10_0_S5_S3 -100 100
 /begin AXIS_DESCR STD_AXIS zff_atsys._.iSignale._.obj.sig_n_ab UMR_U_MIN_1_1_0_S5_S3 2 0 8160 DEPOSIT ABSOLUTE /end AXIS_DESCR
/end CHARACTERISTIC
/begin CHARACTERISTIC KL_PGRASYNNAB_3 "Schliessrampenradient f(n_ab)" CURVE 0x1C0380 ZF_kl_si16_S5_S3 200 UMR_BAR_SEC_1_10_0_S5_S3 -100 100
 /begin AXIS_DESCR STD_AXIS zff_atsys._.iSignale._.obj.sig_n_ab UMR_U_MIN_1_1_0_S5_S3 2 0 8160 DEPOSIT ABSOLUTE /end AXIS_DESCR
/end CHARACTERISTIC
/begin CHARACTERISTIC KL_PGRASYNNAB_4 "Schliessrampenradient f(n_ab)" CURVE 0x1C08B0 ZF_kl_si16_S5_S3 200 UMR_BAR_SEC_1_10_0_S5_S3 -100 100
 /begin AXIS_DESCR STD_AXIS zff_atsys._.iSignale._.obj.sig_n_ab UMR_U_MIN_1_1_0_S5_S3 2 0 8160 DEPOSIT ABSOLUTE /end AXIS_DESCR
/end CHARACTERISTIC
/begin CHARACTERISTIC KL_PGRASYNNAB_5 "Schliessrampenradient f(n_ab)" CURVE 0x1C0DE0 ZF_kl_si16_S5_S3 200 UMR_BAR_SEC_1_10_0_S5_S3 -100 100
 /begin AXIS_DESCR STD_AXIS zff_atsys._.iSignale._.obj.sig_n_ab UMR_U_MIN_1_1_0_S5_S3 2 0 8160 DEPOSIT ABSOLUTE /end AXIS_DESCR
/end CHARACTERISTIC
/begin CHARACTERISTIC KL_PGRASYNNAB_6 "Schliessrampenradient f(n_ab)" CURVE 0x1C1310 ZF_kl_si16_S5_S3 200 UMR_BAR_SEC_1_10_0_S5_S3 -100 100
 /begin AXIS_DESCR STD_AXIS zff_atsys._.iSignale._.obj.sig_n_ab UMR_U_MIN_1_1_0_S5_S3 2 0 8160 DEPOSIT ABSOLUTE /end AXIS_DESCR
/end CHARACTERISTIC
/begin CHARACTERISTIC KL_PGRASYNV1_1 "Schliessrampenradient 1. nichtkraftschl. Kupplung" CURVE 0x1BF92C ZF_kl_si16_S5_S3 1000 UMR_BAR_SEC_1_10_0_S5_S3 0 1000
 /begin AXIS_DESCR STD_AXIS zff_atsys._.iSignale._.obj.sig_m_t UMR_NM__1_1_0_S5_S3 6 -200 1300 DEPOSIT ABSOLUTE /end AXIS_DESCR
/end CHARACTERISTIC
/begin CHARACTERISTIC KL_PGRASYNV1_2 "Schliessrampenradient 1. nichtkraftschl. Kupplung" CURVE 0x1BFE5C ZF_kl_si16_S5_S3 1000 UMR_BAR_SEC_1_10_0_S5_S3 0 1000
 /begin AXIS_DESCR STD_AXIS zff_atsys._.iSignale._.obj.sig_m_t UMR_NM__1_1_0_S5_S3 6 -200 1300 DEPOSIT ABSOLUTE /end AXIS_DESCR
/end CHARACTERISTIC
/begin CHARACTERISTIC KL_PGRASYNV1_3 "Schliessrampenradient 1. nichtkraftschl. Kupplung" CURVE 0x1C038C ZF_kl_si16_S5_S3 1000 UMR_BAR_SEC_1_10_0_S5_S3 0 1000
 /begin AXIS_DESCR STD_AXIS zff_atsys._.iSignale._.obj.sig_m_t UMR_NM__1_1_0_S5_S3 6 -200 1300 DEPOSIT ABSOLUTE /end AXIS_DESCR
/end CHARACTERISTIC
/begin CHARACTERISTIC KL_PGRASYNV1_4 "Schliessrampenradient 1. nichtkraftschl. Kupplung" CURVE 0x1C08BC ZF_kl_si16_S5_S3 1000 UMR_BAR_SEC_1_10_0_S5_S3 0 1000
 /begin AXIS_DESCR STD_AXIS zff_atsys._.iSignale._.obj.sig_m_t UMR_NM__1_1_0_S5_S3 6 -200 1300 DEPOSIT ABSOLUTE /end AXIS_DESCR
/end CHARACTERISTIC
/begin CHARACTERISTIC KL_PGRASYNV1_5 "Schliessrampenradient 1. nichtkraftschl. Kupplung" CURVE 0x1C0DEC ZF_kl_si16_S5_S3 1000 UMR_BAR_SEC_1_10_0_S5_S3 0 1000
 /begin AXIS_DESCR STD_AXIS zff_atsys._.iSignale._.obj.sig_m_t UMR_NM__1_1_0_S5_S3 6 -200 1300 DEPOSIT ABSOLUTE /end AXIS_DESCR
/end CHARACTERISTIC
/begin CHARACTERISTIC KL_PGRASYNV1_6 "Schliessrampenradient 1. nichtkraftschl. Kupplung" CURVE 0x1C131C ZF_kl_si16_S5_S3 1000 UMR_BAR_SEC_1_10_0_S5_S3 0 1000
 /begin AXIS_DESCR STD_AXIS zff_atsys._.iSignale._.obj.sig_m_t UMR_NM__1_1_0_S5_S3 6 -200 1300 DEPOSIT ABSOLUTE /end AXIS_DESCR
/end CHARACTERISTIC
/begin CHARACTERISTIC KL_PGRASYNV2_1 "Schliessrampenradient 2. nichtkraftschl. Kupplung" CURVE 0x1BF958 ZF_kl_si16_S5_S3 1000 UMR_BAR_SEC_1_10_0_S5_S3 0 1000
 /begin AXIS_DESCR STD_AXIS zff_atsys._.iSignale._.obj.sig_m_t UMR_NM__1_1_0_S5_S3 6 -200 1300 DEPOSIT ABSOLUTE /end AXIS_DESCR
/end CHARACTERISTIC
/begin CHARACTERISTIC KL_PGRASYNV2_2 "Schliessrampenradient 2. nichtkraftschl. Kupplung" CURVE 0x1BFE88 ZF_kl_si16_S5_S3 1000 UMR_BAR_SEC_1_10_0_S5_S3 0 1000
 /begin AXIS_DESCR STD_AXIS zff_atsys._.iSignale._.obj.sig_m_t UMR_NM__1_1_0_S5_S3 6 -200 1300 DEPOSIT ABSOLUTE /end AXIS_DESCR
/end CHARACTERISTIC
/begin CHARACTERISTIC KL_PGRASYNV2_3 "Schliessrampenradient 2. nichtkraftschl. Kupplung" CURVE 0x1C03B8 ZF_kl_si16_S5_S3 1000 UMR_BAR_SEC_1_10_0_S5_S3 0 1000
 /begin AXIS_DESCR STD_AXIS zff_atsys._.iSignale._.obj.sig_m_t UMR_NM__1_1_0_S5_S3 6 -200 1300 DEPOSIT ABSOLUTE /end AXIS_DESCR
/end CHARACTERISTIC
/begin CHARACTERISTIC KL_PGRASYNV2_4 "Schliessrampenradient 2. nichtkraftschl. Kupplung" CURVE 0x1C08E8 ZF_kl_si16_S5_S3 1000 UMR_BAR_SEC_1_10_0_S5_S3 0 1000
 /begin AXIS_DESCR STD_AXIS zff_atsys._.iSignale._.obj.sig_m_t UMR_NM__1_1_0_S5_S3 6 -200 1300 DEPOSIT ABSOLUTE /end AXIS_DESCR
/end CHARACTERISTIC
/begin CHARACTERISTIC KL_PGRASYNV2_5 "Schliessrampenradient 2. nichtkraftschl. Kupplung" CURVE 0x1C0E18 ZF_kl_si16_S5_S3 1000 UMR_BAR_SEC_1_10_0_S5_S3 0 1000
 /begin AXIS_DESCR STD_AXIS zff_atsys._.iSignale._.obj.sig_m_t UMR_NM__1_1_0_S5_S3 6 -200 1300 DEPOSIT ABSOLUTE /end AXIS_DESCR
/end CHARACTERISTIC
/begin CHARACTERISTIC KL_PGRASYNV2_6 "Schliessrampenradient 2. nichtkraftschl. Kupplung" CURVE 0x1C1348 ZF_kl_si16_S5_S3 1000 UMR_BAR_SEC_1_10_0_S5_S3 0 1000
 /begin AXIS_DESCR STD_AXIS zff_atsys._.iSignale._.obj.sig_m_t UMR_NM__1_1_0_S5_S3 6 -200 1300 DEPOSIT ABSOLUTE /end AXIS_DESCR
/end CHARACTERISTIC
/begin CHARACTERISTIC KL_PGRASYN_1 "Schliessrampenradient f(m_t)" CURVE 0x1BF904 ZF_kl_si16_S5_S3 6553.4 UMR_BAR_SEC_1_10_0_S5_S3 -3276.7 3276.7
 /begin AXIS_DESCR STD_AXIS zff_atsys._.iSignale._.obj.sig_m_t UMR_NM__1_1_0_S5_S3 6 -200 1300 DEPOSIT ABSOLUTE /end AXIS_DESCR
/end CHARACTERISTIC
/begin CHARACTERISTIC KL_PGRASYN_2 "Schliessrampenradient f(m_t)" CURVE 0x1BFE34 ZF_kl_si16_S5_S3 6553.4 UMR_BAR_SEC_1_10_0_S5_S3 -3276.7 3276.7
 /begin AXIS_DESCR STD_AXIS zff_atsys._.iSignale._.obj.sig_m_t UMR_NM__1_1_0_S5_S3 6 -200 1300 DEPOSIT ABSOLUTE /end AXIS_DESCR
/end CHARACTERISTIC
/begin CHARACTERISTIC KL_PGRASYN_3 "Schliessrampenradient f(m_t)" CURVE 0x1C0364 ZF_kl_si16_S5_S3 6553.4 UMR_BAR_SEC_1_10_0_S5_S3 -3276.7 3276.7
 /begin AXIS_DESCR STD_AXIS zff_atsys._.iSignale._.obj.sig_m_t UMR_NM__1_1_0_S5_S3 6 -200 1300 DEPOSIT ABSOLUTE /end AXIS_DESCR
/end CHARACTERISTIC
/begin CHARACTERISTIC KL_PGRASYN_4 "Schliessrampenradient f(m_t)" CURVE 0x1C0894 ZF_kl_si16_S5_S3 6553.4 UMR_BAR_SEC_1_10_0_S5_S3 -3276.7 3276.7
 /begin AXIS_DESCR STD_AXIS zff_atsys._.iSignale._.obj.sig_m_t UMR_NM__1_1_0_S5_S3 6 -200 1300 DEPOSIT ABSOLUTE /end AXIS_DESCR
/end CHARACTERISTIC
/begin CHARACTERISTIC KL_PGRASYN_5 "Schliessrampenradient f(m_t)" CURVE 0x1C0DC4 ZF_kl_si16_S5_S3 6553.4 UMR_BAR_SEC_1_10_0_S5_S3 -3276.7 3276.7
 /begin AXIS_DESCR STD_AXIS zff_atsys._.iSignale._.obj.sig_m_t UMR_NM__1_1_0_S5_S3 6 -200 1300 DEPOSIT ABSOLUTE /end AXIS_DESCR
/end CHARACTERISTIC
/begin CHARACTERISTIC KL_PGRASYN_6 "Schliessrampenradient f(m_t)" CURVE 0x1C12F4 ZF_kl_si16_S5_S3 6553.4 UMR_BAR_SEC_1_10_0_S5_S3 -3276.7 3276.7
 /begin AXIS_DESCR STD_AXIS zff_atsys._.iSignale._.obj.sig_m_t UMR_NM__1_1_0_S5_S3 6 -200 1300 DEPOSIT ABSOLUTE /end AXIS_DESCR
/end CHARACTERISTIC
/begin CHARACTERISTIC KL_POFCGV1_1 "Kennlinie Fuelldruckoffset" CURVE 0x1BFA30 ZF_kl_si16_S5_S3 12.75 UMR_BAR__1_1000_0_S5_S3 -6.4 6.35
 /begin AXIS_DESCR STD_AXIS zff_atsys._.iSignale._.obj.sig_c_getr UMR_GRADC__1_1_M40_S5_S3 10 -40 150 DEPOSIT ABSOLUTE /end AXIS_DESCR
/end CHARACTERISTIC
/begin CHARACTERISTIC KL_POFCGV1_2 "Kennlinie Fuelldruckoffset" CURVE 0x1BFF60 ZF_kl_si16_S5_S3 12.75 UMR_BAR__1_1000_0_S5_S3 -6.4 6.35
 /begin AXIS_DESCR STD_AXIS zff_atsys._.iSignale._.obj.sig_c_getr UMR_GRADC__1_1_M40_S5_S3 10 -40 150 DEPOSIT ABSOLUTE /end AXIS_DESCR
/end CHARACTERISTIC
/begin CHARACTERISTIC KL_POFCGV1_3 "Kennlinie Fuelldruckoffset" CURVE 0x1C0490 ZF_kl_si16_S5_S3 12.75 UMR_BAR__1_1000_0_S5_S3 -6.4 6.35
 /begin AXIS_DESCR STD_AXIS zff_atsys._.iSignale._.obj.sig_c_getr UMR_GRADC__1_1_M40_S5_S3 10 -40 150 DEPOSIT ABSOLUTE /end AXIS_DESCR
/end CHARACTERISTIC
/begin CHARACTERISTIC KL_POFCGV1_4 "Kennlinie Fuelldruckoffset" CURVE 0x1C09C0 ZF_kl_si16_S5_S3 12.75 UMR_BAR__1_1000_0_S5_S3 -6.4 6.35
 /begin AXIS_DESCR STD_AXIS zff_atsys._.iSignale._.obj.sig_c_getr UMR_GRADC__1_1_M40_S5_S3 10 -40 150 DEPOSIT ABSOLUTE /end AXIS_DESCR
/end CHARACTERISTIC
/begin CHARACTERISTIC KL_POFCGV1_5 "Kennlinie Fuelldruckoffset" CURVE 0x1C0EF0 ZF_kl_si16_S5_S3 12.75 UMR_BAR__1_1000_0_S5_S3 -6.4 6.35
 /begin AXIS_DESCR STD_AXIS zff_atsys._.iSignale._.obj.sig_c_getr UMR_GRADC__1_1_M40_S5_S3 10 -40 150 DEPOSIT ABSOLUTE /end AXIS_DESCR
/end CHARACTERISTIC
/begin CHARACTERISTIC KL_POFCGV1_6 "Kennlinie Fuelldruckoffset" CURVE 0x1C1420 ZF_kl_si16_S5_S3 12.75 UMR_BAR__1_1000_0_S5_S3 -6.4 6.35
 /begin AXIS_DESCR STD_AXIS zff_atsys._.iSignale._.obj.sig_c_getr UMR_GRADC__1_1_M40_S5_S3 10 -40 150 DEPOSIT ABSOLUTE /end AXIS_DESCR
/end CHARACTERISTIC
/begin CHARACTERISTIC KL_POFCGV2_1 "Kennlinie Fuelldruckoffset" CURVE 0x1BFA5C ZF_kl_si16_S5_S3 12.75 UMR_BAR__1_1000_0_S5_S3 -6.4 6.35
 /begin AXIS_DESCR STD_AXIS zff_atsys._.iSignale._.obj.sig_c_getr UMR_GRADC__1_1_M40_S5_S3 10 -40 150 DEPOSIT ABSOLUTE /end AXIS_DESCR
/end CHARACTERISTIC
/begin CHARACTERISTIC KL_POFCGV2_2 "Kennlinie Fuelldruckoffset" CURVE 0x1BFF8C ZF_kl_si16_S5_S3 12.75 UMR_BAR__1_1000_0_S5_S3 -6.4 6.35
 /begin AXIS_DESCR STD_AXIS zff_atsys._.iSignale._.obj.sig_c_getr UMR_GRADC__1_1_M40_S5_S3 10 -40 150 DEPOSIT ABSOLUTE /end AXIS_DESCR
/end CHARACTERISTIC
/begin CHARACTERISTIC KL_POFCGV2_3 "Kennlinie Fuelldruckoffset" CURVE 0x1C04BC ZF_kl_si16_S5_S3 12.75 UMR_BAR__1_1000_0_S5_S3 -6.4 6.35
 /begin AXIS_DESCR STD_AXIS zff_atsys._.iSignale._.obj.sig_c_getr UMR_GRADC__1_1_M40_S5_S3 10 -40 150 DEPOSIT ABSOLUTE /end AXIS_DESCR
/end CHARACTERISTIC
/begin CHARACTERISTIC KL_POFCGV2_4 "Kennlinie Fuelldruckoffset" CURVE 0x1C09EC ZF_kl_si16_S5_S3 12.75 UMR_BAR__1_1000_0_S5_S3 -6.4 6.35
 /begin AXIS_DESCR STD_AXIS zff_atsys._.iSignale._.obj.sig_c_getr UMR_GRADC__1_1_M40_S5_S3 10 -40 150 DEPOSIT ABSOLUTE /end AXIS_DESCR
/end CHARACTERISTIC
/begin CHARACTERISTIC KL_POFCGV2_5 "Kennlinie Fuelldruckoffset" CURVE 0x1C0F1C ZF_kl_si16_S5_S3 12.75 UMR_BAR__1_1000_0_S5_S3 -6.4 6.35
 /begin AXIS_DESCR STD_AXIS zff_atsys._.iSignale._.obj.sig_c_getr UMR_GRADC__1_1_M40_S5_S3 10 -40 150 DEPOSIT ABSOLUTE /end AXIS_DESCR
/end CHARACTERISTIC
/begin CHARACTERISTIC KL_POFCGV2_6 "Kennlinie Fuelldruckoffset" CURVE 0x1C144C ZF_kl_si16_S5_S3 12.75 UMR_BAR__1_1000_0_S5_S3 -6.4 6.35
 /begin AXIS_DESCR STD_AXIS zff_atsys._.iSignale._.obj.sig_c_getr UMR_GRADC__1_1_M40_S5_S3 10 -40 150 DEPOSIT ABSOLUTE /end AXIS_DESCR
/end CHARACTERISTIC
/begin CHARACTERISTIC KL_POFCG_1 "Kennlinie Fuelldruckoffset" CURVE 0x1BFA04 ZF_kl_si16_S5_S3 12.75 UMR_BAR__1_1000_0_S5_S3 -6.4 6.35
 /begin AXIS_DESCR STD_AXIS zff_atsys._.iSignale._.obj.sig_c_getr UMR_GRADC__1_1_M40_S5_S3 10 -40 150 DEPOSIT ABSOLUTE /end AXIS_DESCR
/end CHARACTERISTIC
/begin CHARACTERISTIC KL_POFCG_2 "Kennlinie Fuelldruckoffset" CURVE 0x1BFF34 ZF_kl_si16_S5_S3 12.75 UMR_BAR__1_1000_0_S5_S3 -6.4 6.35
 /begin AXIS_DESCR STD_AXIS zff_atsys._.iSignale._.obj.sig_c_getr UMR_GRADC__1_1_M40_S5_S3 10 -40 150 DEPOSIT ABSOLUTE /end AXIS_DESCR
/end CHARACTERISTIC
/begin CHARACTERISTIC KL_POFCG_3 "Kennlinie Fuelldruckoffset" CURVE 0x1C0464 ZF_kl_si16_S5_S3 12.75 UMR_BAR__1_1000_0_S5_S3 -6.4 6.35
 /begin AXIS_DESCR STD_AXIS zff_atsys._.iSignale._.obj.sig_c_getr UMR_GRADC__1_1_M40_S5_S3 10 -40 150 DEPOSIT ABSOLUTE /end AXIS_DESCR
/end CHARACTERISTIC
/begin CHARACTERISTIC KL_POFCG_4 "Kennlinie Fuelldruckoffset" CURVE 0x1C0994 ZF_kl_si16_S5_S3 12.75 UMR_BAR__1_1000_0_S5_S3 -6.4 6.35
 /begin AXIS_DESCR STD_AXIS zff_atsys._.iSignale._.obj.sig_c_getr UMR_GRADC__1_1_M40_S5_S3 10 -40 150 DEPOSIT ABSOLUTE /end AXIS_DESCR
/end CHARACTERISTIC
/begin CHARACTERISTIC KL_POFCG_5 "Kennlinie Fuelldruckoffset" CURVE 0x1C0EC4 ZF_kl_si16_S5_S3 12.75 UMR_BAR__1_1000_0_S5_S3 -6.4 6.35
 /begin AXIS_DESCR STD_AXIS zff_atsys._.iSignale._.obj.sig_c_getr UMR_GRADC__1_1_M40_S5_S3 10 -40 150 DEPOSIT ABSOLUTE /end AXIS_DESCR
/end CHARACTERISTIC
/begin CHARACTERISTIC KL_POFCG_6 "Kennlinie Fuelldruckoffset" CURVE 0x1C13F4 ZF_kl_si16_S5_S3 12.75 UMR_BAR__1_1000_0_S5_S3 -6.4 6.35
 /begin AXIS_DESCR STD_AXIS zff_atsys._.iSignale._.obj.sig_c_getr UMR_GRADC__1_1_M40_S5_S3 10 -40 150 DEPOSIT ABSOLUTE /end AXIS_DESCR
/end CHARACTERISTIC
/begin CHARACTERISTIC KL_POHKABSPORT84 "Druckoffset waehrend Haltedruckphase" CURVE 0x1BD604 ZF_kl_si16_S5_S3 12.75 UMR_BAR__1_1000_0_S5_S3 -6.4 6.35
 /begin AXIS_DESCR STD_AXIS zff_atsys._.iSignale._.obj.sig_m_t8 UMR_NM__6_1_M34_S5_S3 4 -204 1326 DEPOSIT ABSOLUTE /end AXIS_DESCR
/end CHARACTERISTIC
/begin CHARACTERISTIC KL_POHKABSPORT86 "Druckoffset waehrend Haltedruckphase" CURVE 0x1BD7BC ZF_kl_si16_S5_S3 12.75 UMR_BAR__1_1000_0_S5_S3 -6.4 6.35
 /begin AXIS_DESCR STD_AXIS zff_atsys._.iSignale._.obj.sig_m_t8 UMR_NM__6_1_M34_S5_S3 4 -204 1326 DEPOSIT ABSOLUTE /end AXIS_DESCR
/end CHARACTERISTIC
/begin CHARACTERISTIC KL_POHKABSPORT87 "Druckoffset waehrend Haltedruckphase" CURVE 0x1BC4D4 ZF_kl_si16_S5_S3 12.75 UMR_BAR__1_1000_0_S5_S3 -6.4 6.35
 /begin AXIS_DESCR STD_AXIS zff_atsys._.iSignale._.obj.sig_m_t8 UMR_NM__6_1_M34_S5_S3 4 -204 1326 DEPOSIT ABSOLUTE /end AXIS_DESCR
/end CHARACTERISTIC
/begin CHARACTERISTIC KL_POKABCG21 "Schaltdruckoffset" CURVE 0x1BD9E8 ZF_kl_si16_S5_S3 12.75 UMR_BAR__1_1000_0_S5_S3 -6.4 6.35
 /begin AXIS_DESCR STD_AXIS zff_atsys._.iSignale._.obj.sig_c_getr UMR_GRADC__1_1_M40_S5_S3 10 -40 150 DEPOSIT ABSOLUTE /end AXIS_DESCR
/end CHARACTERISTIC
/begin CHARACTERISTIC KL_POKABCG32 "Schaltdruckoffset" CURVE 0x1BDB10 ZF_kl_si16_S5_S3 12.75 UMR_BAR__1_1000_0_S5_S3 -6.4 6.35
 /begin AXIS_DESCR STD_AXIS zff_atsys._.iSignale._.obj.sig_c_getr UMR_GRADC__1_1_M40_S5_S3 10 -40 150 DEPOSIT ABSOLUTE /end AXIS_DESCR
/end CHARACTERISTIC
/begin CHARACTERISTIC KL_POKABCG43 "Schaltdruckoffset" CURVE 0x1BDC38 ZF_kl_si16_S5_S3 12.75 UMR_BAR__1_1000_0_S5_S3 -6.4 6.35
 /begin AXIS_DESCR STD_AXIS zff_atsys._.iSignale._.obj.sig_c_getr UMR_GRADC__1_1_M40_S5_S3 10 -40 150 DEPOSIT ABSOLUTE /end AXIS_DESCR
/end CHARACTERISTIC
/begin CHARACTERISTIC KL_POKABCG54 "Schaltdruckoffset" CURVE 0x1BDD60 ZF_kl_si16_S5_S3 12.75 UMR_BAR__1_1000_0_S5_S3 -6.4 6.35
 /begin AXIS_DESCR STD_AXIS zff_atsys._.iSignale._.obj.sig_c_getr UMR_GRADC__1_1_M40_S5_S3 10 -40 150 DEPOSIT ABSOLUTE /end AXIS_DESCR
/end CHARACTERISTIC
/begin CHARACTERISTIC KL_POKABCG65 "Schaltdruckoffset" CURVE 0x1BDE88 ZF_kl_si16_S5_S3 12.75 UMR_BAR__1_1000_0_S5_S3 -6.4 6.35
 /begin AXIS_DESCR STD_AXIS zff_atsys._.iSignale._.obj.sig_c_getr UMR_GRADC__1_1_M40_S5_S3 10 -40 150 DEPOSIT ABSOLUTE /end AXIS_DESCR
/end CHARACTERISTIC
/begin CHARACTERISTIC KL_POKABCG76 "Schaltdruckoffset" CURVE 0x1BDFB0 ZF_kl_si16_S5_S3 12.75 UMR_BAR__1_1000_0_S5_S3 -6.4 6.35
 /begin AXIS_DESCR STD_AXIS zff_atsys._.iSignale._.obj.sig_c_getr UMR_GRADC__1_1_M40_S5_S3 10 -40 150 DEPOSIT ABSOLUTE /end AXIS_DESCR
/end CHARACTERISTIC
/begin CHARACTERISTIC KL_POKABCG87 "Schaltdruckoffset" CURVE 0x1BE0D8 ZF_kl_si16_S5_S3 12.75 UMR_BAR__1_1000_0_S5_S3 -6.4 6.35
 /begin AXIS_DESCR STD_AXIS zff_atsys._.iSignale._.obj.sig_c_getr UMR_GRADC__1_1_M40_S5_S3 10 -40 150 DEPOSIT ABSOLUTE /end AXIS_DESCR
/end CHARACTERISTIC
/begin CHARACTERISTIC KL_POKABCGSP31 "Schaltdruckoffset" CURVE 0x1BE200 ZF_kl_si16_S5_S3 12.75 UMR_BAR__1_1000_0_S5_S3 -6.4 6.35
 /begin AXIS_DESCR STD_AXIS zff_atsys._.iSignale._.obj.sig_c_getr UMR_GRADC__1_1_M40_S5_S3 10 -40 150 DEPOSIT ABSOLUTE /end AXIS_DESCR
/end CHARACTERISTIC
/begin CHARACTERISTIC KL_POKABCGSP42 "Schaltdruckoffset" CURVE 0x1BE328 ZF_kl_si16_S5_S3 12.75 UMR_BAR__1_1000_0_S5_S3 -6.4 6.35
 /begin AXIS_DESCR STD_AXIS zff_atsys._.iSignale._.obj.sig_c_getr UMR_GRADC__1_1_M40_S5_S3 10 -40 150 DEPOSIT ABSOLUTE /end AXIS_DESCR
/end CHARACTERISTIC
/begin CHARACTERISTIC KL_POKABCGSP51 "Schaltdruckoffset" CURVE 0x1BE450 ZF_kl_si16_S5_S3 12.75 UMR_BAR__1_1000_0_S5_S3 -6.4 6.35
 /begin AXIS_DESCR STD_AXIS zff_atsys._.iSignale._.obj.sig_c_getr UMR_GRADC__1_1_M40_S5_S3 10 -40 150 DEPOSIT ABSOLUTE /end AXIS_DESCR
/end CHARACTERISTIC
/begin CHARACTERISTIC KL_POKABCGSP53 "Schaltdruckoffset" CURVE 0x1BE578 ZF_kl_si16_S5_S3 12.75 UMR_BAR__1_1000_0_S5_S3 -6.4 6.35
 /begin AXIS_DESCR STD_AXIS zff_atsys._.iSignale._.obj.sig_c_getr UMR_GRADC__1_1_M40_S5_S3 10 -40 150 DEPOSIT ABSOLUTE /end AXIS_DESCR
/end CHARACTERISTIC
/begin CHARACTERISTIC KL_POKABCGSP63 "Schaltdruckoffset" CURVE 0x1BE6A0 ZF_kl_si16_S5_S3 12.75 UMR_BAR__1_1000_0_S5_S3 -6.4 6.35
 /begin AXIS_DESCR STD_AXIS zff_atsys._.iSignale._.obj.sig_c_getr UMR_GRADC__1_1_M40_S5_S3 10 -40 150 DEPOSIT ABSOLUTE /end AXIS_DESCR
/end CHARACTERISTIC
/begin CHARACTERISTIC KL_POKABCGSP64 "Schaltdruckoffset" CURVE 0x1BE7C8 ZF_kl_si16_S5_S3 12.75 UMR_BAR__1_1000_0_S5_S3 -6.4 6.35
 /begin AXIS_DESCR STD_AXIS zff_atsys._.iSignale._.obj.sig_c_getr UMR_GRADC__1_1_M40_S5_S3 10 -40 150 DEPOSIT ABSOLUTE /end AXIS_DESCR
/end CHARACTERISTIC
/begin CHARACTERISTIC KL_POKABCGSP71 "Schaltdruckoffset" CURVE 0x1BE8F0 ZF_kl_si16_S5_S3 12.75 UMR_BAR__1_1000_0_S5_S3 -6.4 6.35
 /begin AXIS_DESCR STD_AXIS zff_atsys._.iSignale._.obj.sig_c_getr UMR_GRADC__1_1_M40_S5_S3 10 -40 150 DEPOSIT ABSOLUTE /end AXIS_DESCR
/end CHARACTERISTIC
/begin CHARACTERISTIC KL_POKABCGSP75 "Schaltdruckoffset" CURVE 0x1BEA18 ZF_kl_si16_S5_S3 12.75 UMR_BAR__1_1000_0_S5_S3 -6.4 6.35
 /begin AXIS_DESCR STD_AXIS zff_atsys._.iSignale._.obj.sig_c_getr UMR_GRADC__1_1_M40_S5_S3 10 -40 150 DEPOSIT ABSOLUTE /end AXIS_DESCR
/end CHARACTERISTIC
/begin CHARACTERISTIC KL_POKABCGSP82 "Schaltdruckoffset" CURVE 0x1BEB40 ZF_kl_si16_S5_S3 12.75 UMR_BAR__1_1000_0_S5_S3 -6.4 6.35
 /begin AXIS_DESCR STD_AXIS zff_atsys._.iSignale._.obj.sig_c_getr UMR_GRADC__1_1_M40_S5_S3 10 -40 150 DEPOSIT ABSOLUTE /end AXIS_DESCR
/end CHARACTERISTIC
/begin CHARACTERISTIC KL_POKABCGSP84 "Schaltdruckoffset" CURVE 0x1BED90 ZF_kl_si16_S5_S3 12.75 UMR_BAR__1_1000_0_S5_S3 -6.4 6.35
 /begin AXIS_DESCR STD_AXIS zff_atsys._.iSignale._.obj.sig_c_getr UMR_GRADC__1_1_M40_S5_S3 10 -40 150 DEPOSIT ABSOLUTE /end AXIS_DESCR
/end CHARACTERISTIC
/begin CHARACTERISTIC KL_POKABCGSP86 "Schaltdruckoffset" CURVE 0x1BEC68 ZF_kl_si16_S5_S3 12.75 UMR_BAR__1_1000_0_S5_S3 -6.4 6.35
 /begin AXIS_DESCR STD_AXIS zff_atsys._.iSignale._.obj.sig_c_getr UMR_GRADC__1_1_M40_S5_S3 10 -40 150 DEPOSIT ABSOLUTE /end AXIS_DESCR
/end CHARACTERISTIC
/begin CHARACTERISTIC KL_POKABMDMOTSOLL21 "Schaltdruckoffset in Abhaengigkeit von md_motsoll_sas" CURVE 0x1BDA80 ZF_kl_si16_S5_S3 12.75 UMR_BAR__1_1000_0_S5_S3 -6.4 6.35
 /begin AXIS_DESCR STD_AXIS NO_INPUT_QUANTITY UMR_NM__1_1_0_S5_S3 6 -1500 1500 DEPOSIT ABSOLUTE /end AXIS_DESCR
/end CHARACTERISTIC
/begin CHARACTERISTIC KL_POKABMDMOTSOLL32 "Schaltdruckoffset in Abhaengigkeit von md_motsoll_sas" CURVE 0x1BDBA8 ZF_kl_si16_S5_S3 12.75 UMR_BAR__1_1000_0_S5_S3 -6.4 6.35
 /begin AXIS_DESCR STD_AXIS NO_INPUT_QUANTITY UMR_NM__1_1_0_S5_S3 6 -1500 1500 DEPOSIT ABSOLUTE /end AXIS_DESCR
/end CHARACTERISTIC
/begin CHARACTERISTIC KL_POKABMDMOTSOLL43 "Schaltdruckoffset in Abhaengigkeit von md_motsoll_sas" CURVE 0x1BDCD0 ZF_kl_si16_S5_S3 12.75 UMR_BAR__1_1000_0_S5_S3 -6.4 6.35
 /begin AXIS_DESCR STD_AXIS NO_INPUT_QUANTITY UMR_NM__1_1_0_S5_S3 6 -1500 1500 DEPOSIT ABSOLUTE /end AXIS_DESCR
/end CHARACTERISTIC
/begin CHARACTERISTIC KL_POKABMDMOTSOLL54 "Schaltdruckoffset in Abhaengigkeit von md_motsoll_sas" CURVE 0x1BDDF8 ZF_kl_si16_S5_S3 12.75 UMR_BAR__1_1000_0_S5_S3 -6.4 6.35
 /begin AXIS_DESCR STD_AXIS NO_INPUT_QUANTITY UMR_NM__1_1_0_S5_S3 6 -1500 1500 DEPOSIT ABSOLUTE /end AXIS_DESCR
/end CHARACTERISTIC
/begin CHARACTERISTIC KL_POKABMDMOTSOLL65 "Schaltdruckoffset in Abhaengigkeit von md_motsoll_sas" CURVE 0x1BDF20 ZF_kl_si16_S5_S3 12.75 UMR_BAR__1_1000_0_S5_S3 -6.4 6.35
 /begin AXIS_DESCR STD_AXIS NO_INPUT_QUANTITY UMR_NM__1_1_0_S5_S3 6 -1500 1500 DEPOSIT ABSOLUTE /end AXIS_DESCR
/end CHARACTERISTIC
/begin CHARACTERISTIC KL_POKABMDMOTSOLL76 "Schaltdruckoffset in Abhaengigkeit von md_motsoll_sas" CURVE 0x1BE048 ZF_kl_si16_S5_S3 12.75 UMR_BAR__1_1000_0_S5_S3 -6.4 6.35
 /begin AXIS_DESCR STD_AXIS NO_INPUT_QUANTITY UMR_NM__1_1_0_S5_S3 6 -1500 1500 DEPOSIT ABSOLUTE /end AXIS_DESCR
/end CHARACTERISTIC
/begin CHARACTERISTIC KL_POKABMDMOTSOLL87 "Schaltdruckoffset in Abhaengigkeit von md_motsoll_sas" CURVE 0x1BE170 ZF_kl_si16_S5_S3 12.75 UMR_BAR__1_1000_0_S5_S3 -6.4 6.35
 /begin AXIS_DESCR STD_AXIS NO_INPUT_QUANTITY UMR_NM__1_1_0_S5_S3 6 -1500 1500 DEPOSIT ABSOLUTE /end AXIS_DESCR
/end CHARACTERISTIC
/begin CHARACTERISTIC KL_POKABMDMOTSOLLSP31 "Schaltdruckoffset in Abhaengigkeit von md_motsoll_sas" CURVE 0x1BE298 ZF_kl_si16_S5_S3 12.75 UMR_BAR__1_1000_0_S5_S3 -6.4 6.35
 /begin AXIS_DESCR STD_AXIS NO_INPUT_QUANTITY UMR_NM__1_1_0_S5_S3 6 -1500 1500 DEPOSIT ABSOLUTE /end AXIS_DESCR
/end CHARACTERISTIC
/begin CHARACTERISTIC KL_POKABMDMOTSOLLSP42 "Schaltdruckoffset in Abhaengigkeit von md_motsoll_sas" CURVE 0x1BE3C0 ZF_kl_si16_S5_S3 12.75 UMR_BAR__1_1000_0_S5_S3 -6.4 6.35
 /begin AXIS_DESCR STD_AXIS NO_INPUT_QUANTITY UMR_NM__1_1_0_S5_S3 6 -1500 1500 DEPOSIT ABSOLUTE /end AXIS_DESCR
/end CHARACTERISTIC
/begin CHARACTERISTIC KL_POKABMDMOTSOLLSP51 "Schaltdruckoffset in Abhaengigkeit von md_motsoll_sas" CURVE 0x1BE4E8 ZF_kl_si16_S5_S3 12.75 UMR_BAR__1_1000_0_S5_S3 -6.4 6.35
 /begin AXIS_DESCR STD_AXIS NO_INPUT_QUANTITY UMR_NM__1_1_0_S5_S3 6 -1500 1500 DEPOSIT ABSOLUTE /end AXIS_DESCR
/end CHARACTERISTIC
/begin CHARACTERISTIC KL_POKABMDMOTSOLLSP53 "Schaltdruckoffset in Abhaengigkeit von md_motsoll_sas" CURVE 0x1BE610 ZF_kl_si16_S5_S3 12.75 UMR_BAR__1_1000_0_S5_S3 -6.4 6.35
 /begin AXIS_DESCR STD_AXIS NO_INPUT_QUANTITY UMR_NM__1_1_0_S5_S3 6 -1500 1500 DEPOSIT ABSOLUTE /end AXIS_DESCR
/end CHARACTERISTIC
/begin CHARACTERISTIC KL_POKABMDMOTSOLLSP63 "Schaltdruckoffset in Abhaengigkeit von md_motsoll_sas" CURVE 0x1BE738 ZF_kl_si16_S5_S3 12.75 UMR_BAR__1_1000_0_S5_S3 -6.4 6.35
 /begin AXIS_DESCR STD_AXIS NO_INPUT_QUANTITY UMR_NM__1_1_0_S5_S3 6 -1500 1500 DEPOSIT ABSOLUTE /end AXIS_DESCR
/end CHARACTERISTIC
/begin CHARACTERISTIC KL_POKABMDMOTSOLLSP64 "Schaltdruckoffset in Abhaengigkeit von md_motsoll_sas" CURVE 0x1BE860 ZF_kl_si16_S5_S3 12.75 UMR_BAR__1_1000_0_S5_S3 -6.4 6.35
 /begin AXIS_DESCR STD_AXIS NO_INPUT_QUANTITY UMR_NM__1_1_0_S5_S3 6 -1500 1500 DEPOSIT ABSOLUTE /end AXIS_DESCR
/end CHARACTERISTIC
/begin CHARACTERISTIC KL_POKABMDMOTSOLLSP71 "Schaltdruckoffset in Abhaengigkeit von md_motsoll_sas" CURVE 0x1BE988 ZF_kl_si16_S5_S3 12.75 UMR_BAR__1_1000_0_S5_S3 -6.4 6.35
 /begin AXIS_DESCR STD_AXIS NO_INPUT_QUANTITY UMR_NM__1_1_0_S5_S3 6 -1500 1500 DEPOSIT ABSOLUTE /end AXIS_DESCR
/end CHARACTERISTIC
/begin CHARACTERISTIC KL_POKABMDMOTSOLLSP75 "Schaltdruckoffset in Abhaengigkeit von md_motsoll_sas" CURVE 0x1BEAB0 ZF_kl_si16_S5_S3 12.75 UMR_BAR__1_1000_0_S5_S3 -6.4 6.35
 /begin AXIS_DESCR STD_AXIS NO_INPUT_QUANTITY UMR_NM__1_1_0_S5_S3 6 -1500 1500 DEPOSIT ABSOLUTE /end AXIS_DESCR
/end CHARACTERISTIC
/begin CHARACTERISTIC KL_POKABMDMOTSOLLSP82 "Schaltdruckoffset in Abhaengigkeit von md_motsoll_sas" CURVE 0x1BEBD8 ZF_kl_si16_S5_S3 12.75 UMR_BAR__1_1000_0_S5_S3 -6.4 6.35
 /begin AXIS_DESCR STD_AXIS NO_INPUT_QUANTITY UMR_NM__1_1_0_S5_S3 6 -1500 1500 DEPOSIT ABSOLUTE /end AXIS_DESCR
/end CHARACTERISTIC
/begin CHARACTERISTIC KL_POKABMDMOTSOLLSP84 "Schaltdruckoffset in Abhaengigkeit von md_motsoll_sas" CURVE 0x1BEE28 ZF_kl_si16_S5_S3 12.75 UMR_BAR__1_1000_0_S5_S3 -6.4 6.35
 /begin AXIS_DESCR STD_AXIS NO_INPUT_QUANTITY UMR_NM__1_1_0_S5_S3 6 -1500 1500 DEPOSIT ABSOLUTE /end AXIS_DESCR
/end CHARACTERISTIC
/begin CHARACTERISTIC KL_POKABMDMOTSOLLSP86 "Schaltdruckoffset in Abhaengigkeit von md_motsoll_sas" CURVE 0x1BED00 ZF_kl_si16_S5_S3 12.75 UMR_BAR__1_1000_0_S5_S3 -6.4 6.35
 /begin AXIS_DESCR STD_AXIS NO_INPUT_QUANTITY UMR_NM__1_1_0_S5_S3 6 -1500 1500 DEPOSIT ABSOLUTE /end AXIS_DESCR
/end CHARACTERISTIC
/begin CHARACTERISTIC KL_POKABNGAB21 "Druckoffset in Abhaengigkeit von ng_ab" CURVE 0x1BD974 ZF_kl_si16_S5_S3 12 UMR_BAR__1_1000_0_S5_S3 -6 6
 /begin AXIS_DESCR STD_AXIS iItfInput.ng_ab UMR_U_MINSEC_1_1_0_S5_S3 4 -5000 1000 DEPOSIT ABSOLUTE /end AXIS_DESCR
/end CHARACTERISTIC
/begin CHARACTERISTIC KL_POKABNGAB32 "Druckoffset in Abhaengigkeit von ng_ab" CURVE 0x1BDA9C ZF_kl_si16_S5_S3 12 UMR_BAR__1_1000_0_S5_S3 -6 6
 /begin AXIS_DESCR STD_AXIS iItfInput.ng_ab UMR_U_MINSEC_1_1_0_S5_S3 4 -5000 1000 DEPOSIT ABSOLUTE /end AXIS_DESCR
/end CHARACTERISTIC
/begin CHARACTERISTIC KL_POKABNGAB43 "Druckoffset in Abhaengigkeit von ng_ab" CURVE 0x1BDBC4 ZF_kl_si16_S5_S3 12 UMR_BAR__1_1000_0_S5_S3 -6 6
 /begin AXIS_DESCR STD_AXIS iItfInput.ng_ab UMR_U_MINSEC_1_1_0_S5_S3 4 -5000 1000 DEPOSIT ABSOLUTE /end AXIS_DESCR
/end CHARACTERISTIC
/begin CHARACTERISTIC KL_POKABNGAB54 "Druckoffset in Abhaengigkeit von ng_ab" CURVE 0x1BDCEC ZF_kl_si16_S5_S3 12 UMR_BAR__1_1000_0_S5_S3 -6 6
 /begin AXIS_DESCR STD_AXIS iItfInput.ng_ab UMR_U_MINSEC_1_1_0_S5_S3 4 -5000 1000 DEPOSIT ABSOLUTE /end AXIS_DESCR
/end CHARACTERISTIC
/begin CHARACTERISTIC KL_POKABNGAB65 "Druckoffset in Abhaengigkeit von ng_ab" CURVE 0x1BDE14 ZF_kl_si16_S5_S3 12 UMR_BAR__1_1000_0_S5_S3 -6 6
 /begin AXIS_DESCR STD_AXIS iItfInput.ng_ab UMR_U_MINSEC_1_1_0_S5_S3 4 -5000 1000 DEPOSIT ABSOLUTE /end AXIS_DESCR
/end CHARACTERISTIC
/begin CHARACTERISTIC KL_POKABNGAB76 "Druckoffset in Abhaengigkeit von ng_ab" CURVE 0x1BDF3C ZF_kl_si16_S5_S3 12 UMR_BAR__1_1000_0_S5_S3 -6 6
 /begin AXIS_DESCR STD_AXIS iItfInput.ng_ab UMR_U_MINSEC_1_1_0_S5_S3 4 -5000 1000 DEPOSIT ABSOLUTE /end AXIS_DESCR
/end CHARACTERISTIC
/begin CHARACTERISTIC KL_POKABNGAB87 "Druckoffset in Abhaengigkeit von ng_ab" CURVE 0x1BE064 ZF_kl_si16_S5_S3 12 UMR_BAR__1_1000_0_S5_S3 -6 6
 /begin AXIS_DESCR STD_AXIS iItfInput.ng_ab UMR_U_MINSEC_1_1_0_S5_S3 4 -5000 1000 DEPOSIT ABSOLUTE /end AXIS_DESCR
/end CHARACTERISTIC
/begin CHARACTERISTIC KL_POKABNGABSP31 "Druckoffset in Abhaengigkeit von ng_ab" CURVE 0x1BE18C ZF_kl_si16_S5_S3 12 UMR_BAR__1_1000_0_S5_S3 -6 6
 /begin AXIS_DESCR STD_AXIS iItfInput.ng_ab UMR_U_MINSEC_1_1_0_S5_S3 4 -5000 1000 DEPOSIT ABSOLUTE /end AXIS_DESCR
/end CHARACTERISTIC
/begin CHARACTERISTIC KL_POKABNGABSP42 "Druckoffset in Abhaengigkeit von ng_ab" CURVE 0x1BE2B4 ZF_kl_si16_S5_S3 12 UMR_BAR__1_1000_0_S5_S3 -6 6
 /begin AXIS_DESCR STD_AXIS iItfInput.ng_ab UMR_U_MINSEC_1_1_0_S5_S3 4 -5000 1000 DEPOSIT ABSOLUTE /end AXIS_DESCR
/end CHARACTERISTIC
/begin CHARACTERISTIC KL_POKABNGABSP51 "Druckoffset in Abhaengigkeit von ng_ab" CURVE 0x1BE3DC ZF_kl_si16_S5_S3 12 UMR_BAR__1_1000_0_S5_S3 -6 6
 /begin AXIS_DESCR STD_AXIS iItfInput.ng_ab UMR_U_MINSEC_1_1_0_S5_S3 4 -5000 1000 DEPOSIT ABSOLUTE /end AXIS_DESCR
/end CHARACTERISTIC
/begin CHARACTERISTIC KL_POKABNGABSP53 "Druckoffset in Abhaengigkeit von ng_ab" CURVE 0x1BE504 ZF_kl_si16_S5_S3 12 UMR_BAR__1_1000_0_S5_S3 -6 6
 /begin AXIS_DESCR STD_AXIS iItfInput.ng_ab UMR_U_MINSEC_1_1_0_S5_S3 4 -5000 1000 DEPOSIT ABSOLUTE /end AXIS_DESCR
/end CHARACTERISTIC
/begin CHARACTERISTIC KL_POKABNGABSP63 "Druckoffset in Abhaengigkeit von ng_ab" CURVE 0x1BE62C ZF_kl_si16_S5_S3 12 UMR_BAR__1_1000_0_S5_S3 -6 6
 /begin AXIS_DESCR STD_AXIS iItfInput.ng_ab UMR_U_MINSEC_1_1_0_S5_S3 4 -5000 1000 DEPOSIT ABSOLUTE /end AXIS_DESCR
/end CHARACTERISTIC
/begin CHARACTERISTIC KL_POKABNGABSP64 "Druckoffset in Abhaengigkeit von ng_ab" CURVE 0x1BE754 ZF_kl_si16_S5_S3 12 UMR_BAR__1_1000_0_S5_S3 -6 6
 /begin AXIS_DESCR STD_AXIS iItfInput.ng_ab UMR_U_MINSEC_1_1_0_S5_S3 4 -5000 1000 DEPOSIT ABSOLUTE /end AXIS_DESCR
/end CHARACTERISTIC
/begin CHARACTERISTIC KL_POKABNGABSP71 "Druckoffset in Abhaengigkeit von ng_ab" CURVE 0x1BE87C ZF_kl_si16_S5_S3 12 UMR_BAR__1_1000_0_S5_S3 -6 6
 /begin AXIS_DESCR STD_AXIS iItfInput.ng_ab UMR_U_MINSEC_1_1_0_S5_S3 4 -5000 1000 DEPOSIT ABSOLUTE /end AXIS_DESCR
/end CHARACTERISTIC
/begin CHARACTERISTIC KL_POKABNGABSP75 "Druckoffset in Abhaengigkeit von ng_ab" CURVE 0x1BE9A4 ZF_kl_si16_S5_S3 12 UMR_BAR__1_1000_0_S5_S3 -6 6
 /begin AXIS_DESCR STD_AXIS iItfInput.ng_ab UMR_U_MINSEC_1_1_0_S5_S3 4 -5000 1000 DEPOSIT ABSOLUTE /end AXIS_DESCR
/end CHARACTERISTIC
/begin CHARACTERISTIC KL_POKABNGABSP82 "Druckoffset in Abhaengigkeit von ng_ab" CURVE 0x1BEACC ZF_kl_si16_S5_S3 12 UMR_BAR__1_1000_0_S5_S3 -6 6
 /begin AXIS_DESCR STD_AXIS iItfInput.ng_ab UMR_U_MINSEC_1_1_0_S5_S3 4 -5000 1000 DEPOSIT ABSOLUTE /end AXIS_DESCR
/end CHARACTERISTIC
/begin CHARACTERISTIC KL_POKABNGABSP84 "Druckoffset in Abhaengigkeit von ng_ab" CURVE 0x1BED1C ZF_kl_si16_S5_S3 12 UMR_BAR__1_1000_0_S5_S3 -6 6
 /begin AXIS_DESCR STD_AXIS iItfInput.ng_ab UMR_U_MINSEC_1_1_0_S5_S3 4 -5000 1000 DEPOSIT ABSOLUTE /end AXIS_DESCR
/end CHARACTERISTIC
/begin CHARACTERISTIC KL_POKABNGABSP86 "Druckoffset in Abhaengigkeit von ng_ab" CURVE 0x1BEBF4 ZF_kl_si16_S5_S3 12 UMR_BAR__1_1000_0_S5_S3 -6 6
 /begin AXIS_DESCR STD_AXIS iItfInput.ng_ab UMR_U_MINSEC_1_1_0_S5_S3 4 -5000 1000 DEPOSIT ABSOLUTE /end AXIS_DESCR
/end CHARACTERISTIC
/begin CHARACTERISTIC KL_POKZUCG_1 "Schaltdruckoffset" CURVE 0x1BFA88 ZF_kl_si16_S5_S3 12.75 UMR_BAR__1_1000_0_S5_S3 -6.4 6.35
 /begin AXIS_DESCR STD_AXIS zff_atsys._.iSignale._.obj.sig_c_getr UMR_GRADC__1_1_M40_S5_S3 10 -40 150 DEPOSIT ABSOLUTE /end AXIS_DESCR
/end CHARACTERISTIC
/begin CHARACTERISTIC KL_POKZUCG_2 "Schaltdruckoffset" CURVE 0x1BFFB8 ZF_kl_si16_S5_S3 12.75 UMR_BAR__1_1000_0_S5_S3 -6.4 6.35
 /begin AXIS_DESCR STD_AXIS zff_atsys._.iSignale._.obj.sig_c_getr UMR_GRADC__1_1_M40_S5_S3 10 -40 150 DEPOSIT ABSOLUTE /end AXIS_DESCR
/end CHARACTERISTIC
/begin CHARACTERISTIC KL_POKZUCG_3 "Schaltdruckoffset" CURVE 0x1C04E8 ZF_kl_si16_S5_S3 12.75 UMR_BAR__1_1000_0_S5_S3 -6.4 6.35
 /begin AXIS_DESCR STD_AXIS zff_atsys._.iSignale._.obj.sig_c_getr UMR_GRADC__1_1_M40_S5_S3 10 -40 150 DEPOSIT ABSOLUTE /end AXIS_DESCR
/end CHARACTERISTIC
/begin CHARACTERISTIC KL_POKZUCG_4 "Schaltdruckoffset" CURVE 0x1C0A18 ZF_kl_si16_S5_S3 12.75 UMR_BAR__1_1000_0_S5_S3 -6.4 6.35
 /begin AXIS_DESCR STD_AXIS zff_atsys._.iSignale._.obj.sig_c_getr UMR_GRADC__1_1_M40_S5_S3 10 -40 150 DEPOSIT ABSOLUTE /end AXIS_DESCR
/end CHARACTERISTIC
/begin CHARACTERISTIC KL_POKZUCG_5 "Schaltdruckoffset" CURVE 0x1C0F48 ZF_kl_si16_S5_S3 12.75 UMR_BAR__1_1000_0_S5_S3 -6.4 6.35
 /begin AXIS_DESCR STD_AXIS zff_atsys._.iSignale._.obj.sig_c_getr UMR_GRADC__1_1_M40_S5_S3 10 -40 150 DEPOSIT ABSOLUTE /end AXIS_DESCR
/end CHARACTERISTIC
/begin CHARACTERISTIC KL_POKZUCG_6 "Schaltdruckoffset" CURVE 0x1C1478 ZF_kl_si16_S5_S3 12.75 UMR_BAR__1_1000_0_S5_S3 -6.4 6.35
 /begin AXIS_DESCR STD_AXIS zff_atsys._.iSignale._.obj.sig_c_getr UMR_GRADC__1_1_M40_S5_S3 10 -40 150 DEPOSIT ABSOLUTE /end AXIS_DESCR
/end CHARACTERISTIC
/begin CHARACTERISTIC KL_POLASTDKIV2_1 "Druckoffset auf Fülldruck zweites nichtkraftschließendes Schaltelement" CURVE 0x1BFC94 ZF_kl_si16_S5_S3 6 UMR_BAR__1_1000_0_S5_S3 0 6
 /begin AXIS_DESCR STD_AXIS zff_atsys._.iSignale._.obj.sig_dki UMR_PROZENT__20_51_0_S5_S3 6 0 100 DEPOSIT ABSOLUTE /end AXIS_DESCR
/end CHARACTERISTIC
/begin CHARACTERISTIC KL_POLASTDKIV2_2 "Druckoffset auf Fülldruck zweites nichtkraftschließendes Schaltelement" CURVE 0x1C01C4 ZF_kl_si16_S5_S3 6 UMR_BAR__1_1000_0_S5_S3 0 6
 /begin AXIS_DESCR STD_AXIS zff_atsys._.iSignale._.obj.sig_dki UMR_PROZENT__20_51_0_S5_S3 6 0 100 DEPOSIT ABSOLUTE /end AXIS_DESCR
/end CHARACTERISTIC
/begin CHARACTERISTIC KL_POLASTDKIV2_3 "Druckoffset auf Fülldruck zweites nichtkraftschließendes Schaltelement" CURVE 0x1C06F4 ZF_kl_si16_S5_S3 6 UMR_BAR__1_1000_0_S5_S3 0 6
 /begin AXIS_DESCR STD_AXIS zff_atsys._.iSignale._.obj.sig_dki UMR_PROZENT__20_51_0_S5_S3 6 0 100 DEPOSIT ABSOLUTE /end AXIS_DESCR
/end CHARACTERISTIC
/begin CHARACTERISTIC KL_POLASTDKIV2_4 "Druckoffset auf Fülldruck zweites nichtkraftschließendes Schaltelement" CURVE 0x1C0C24 ZF_kl_si16_S5_S3 6 UMR_BAR__1_1000_0_S5_S3 0 6
 /begin AXIS_DESCR STD_AXIS zff_atsys._.iSignale._.obj.sig_dki UMR_PROZENT__20_51_0_S5_S3 6 0 100 DEPOSIT ABSOLUTE /end AXIS_DESCR
/end CHARACTERISTIC
/begin CHARACTERISTIC KL_POLASTDKIV2_5 "Druckoffset auf Fülldruck zweites nichtkraftschließendes Schaltelement" CURVE 0x1C1154 ZF_kl_si16_S5_S3 6 UMR_BAR__1_1000_0_S5_S3 0 6
 /begin AXIS_DESCR STD_AXIS zff_atsys._.iSignale._.obj.sig_dki UMR_PROZENT__20_51_0_S5_S3 6 0 100 DEPOSIT ABSOLUTE /end AXIS_DESCR
/end CHARACTERISTIC
/begin CHARACTERISTIC KL_POLASTDKIV2_6 "Druckoffset auf Fülldruck zweites nichtkraftschließendes Schaltelement" CURVE 0x1C1684 ZF_kl_si16_S5_S3 6 UMR_BAR__1_1000_0_S5_S3 0 6
 /begin AXIS_DESCR STD_AXIS zff_atsys._.iSignale._.obj.sig_dki UMR_PROZENT__20_51_0_S5_S3 6 0 100 DEPOSIT ABSOLUTE /end AXIS_DESCR
/end CHARACTERISTIC
/begin CHARACTERISTIC KL_PORAKZU_1 "Schaltdruckoffset" CURVE 0x1BF840 ZF_kl_si16_S5_S3 12.75 UMR_BAR__1_1000_0_S5_S3 -6.4 6.35
 /begin AXIS_DESCR STD_AXIS NO_INPUT_QUANTITY UMR_MSEC__10_1_0_S5_S3 3 0 2540 DEPOSIT ABSOLUTE /end AXIS_DESCR
/end CHARACTERISTIC
/begin CHARACTERISTIC KL_PORAKZU_2 "Schaltdruckoffset" CURVE 0x1BFD70 ZF_kl_si16_S5_S3 12.75 UMR_BAR__1_1000_0_S5_S3 -6.4 6.35
 /begin AXIS_DESCR STD_AXIS NO_INPUT_QUANTITY UMR_MSEC__10_1_0_S5_S3 3 0 2540 DEPOSIT ABSOLUTE /end AXIS_DESCR
/end CHARACTERISTIC
/begin CHARACTERISTIC KL_PORAKZU_3 "Schaltdruckoffset" CURVE 0x1C02A0 ZF_kl_si16_S5_S3 12.75 UMR_BAR__1_1000_0_S5_S3 -6.4 6.35
 /begin AXIS_DESCR STD_AXIS NO_INPUT_QUANTITY UMR_MSEC__10_1_0_S5_S3 3 0 2540 DEPOSIT ABSOLUTE /end AXIS_DESCR
/end CHARACTERISTIC
/begin CHARACTERISTIC KL_PORAKZU_4 "Schaltdruckoffset" CURVE 0x1C07D0 ZF_kl_si16_S5_S3 12.75 UMR_BAR__1_1000_0_S5_S3 -6.4 6.35
 /begin AXIS_DESCR STD_AXIS NO_INPUT_QUANTITY UMR_MSEC__10_1_0_S5_S3 3 0 2540 DEPOSIT ABSOLUTE /end AXIS_DESCR
/end CHARACTERISTIC
/begin CHARACTERISTIC KL_PORAKZU_5 "Schaltdruckoffset" CURVE 0x1C0D00 ZF_kl_si16_S5_S3 12.75 UMR_BAR__1_1000_0_S5_S3 -6.4 6.35
 /begin AXIS_DESCR STD_AXIS NO_INPUT_QUANTITY UMR_MSEC__10_1_0_S5_S3 3 0 2540 DEPOSIT ABSOLUTE /end AXIS_DESCR
/end CHARACTERISTIC
/begin CHARACTERISTIC KL_PORAKZU_6 "Schaltdruckoffset" CURVE 0x1C1230 ZF_kl_si16_S5_S3 12.75 UMR_BAR__1_1000_0_S5_S3 -6.4 6.35
 /begin AXIS_DESCR STD_AXIS NO_INPUT_QUANTITY UMR_MSEC__10_1_0_S5_S3 3 0 2540 DEPOSIT ABSOLUTE /end AXIS_DESCR
/end CHARACTERISTIC
/begin CHARACTERISTIC KL_PORASYNV1_1 "Schliessrampendruckoffset 1. nichtkraftschl. Kupplung" CURVE 0x1BF948 ZF_kl_si16_S5_S3 12.75 UMR_BAR__1_1000_0_S5_S3 0 12.75
 /begin AXIS_DESCR STD_AXIS NO_INPUT_QUANTITY UMR_MSEC__10_1_0_S5_S3 3 0 2540 DEPOSIT ABSOLUTE /end AXIS_DESCR
/end CHARACTERISTIC
/begin CHARACTERISTIC KL_PORASYNV1_2 "Schliessrampendruckoffset 1. nichtkraftschl. Kupplung" CURVE 0x1BFE78 ZF_kl_si16_S5_S3 12.75 UMR_BAR__1_1000_0_S5_S3 0 12.75
 /begin AXIS_DESCR STD_AXIS NO_INPUT_QUANTITY UMR_MSEC__10_1_0_S5_S3 3 0 2540 DEPOSIT ABSOLUTE /end AXIS_DESCR
/end CHARACTERISTIC
/begin CHARACTERISTIC KL_PORASYNV1_3 "Schliessrampendruckoffset 1. nichtkraftschl. Kupplung" CURVE 0x1C03A8 ZF_kl_si16_S5_S3 12.75 UMR_BAR__1_1000_0_S5_S3 0 12.75
 /begin AXIS_DESCR STD_AXIS NO_INPUT_QUANTITY UMR_MSEC__10_1_0_S5_S3 3 0 2540 DEPOSIT ABSOLUTE /end AXIS_DESCR
/end CHARACTERISTIC
/begin CHARACTERISTIC KL_PORASYNV1_4 "Schliessrampendruckoffset 1. nichtkraftschl. Kupplung" CURVE 0x1C08D8 ZF_kl_si16_S5_S3 12.75 UMR_BAR__1_1000_0_S5_S3 0 12.75
 /begin AXIS_DESCR STD_AXIS NO_INPUT_QUANTITY UMR_MSEC__10_1_0_S5_S3 3 0 2540 DEPOSIT ABSOLUTE /end AXIS_DESCR
/end CHARACTERISTIC
/begin CHARACTERISTIC KL_PORASYNV1_5 "Schliessrampendruckoffset 1. nichtkraftschl. Kupplung" CURVE 0x1C0E08 ZF_kl_si16_S5_S3 12.75 UMR_BAR__1_1000_0_S5_S3 0 12.75
 /begin AXIS_DESCR STD_AXIS NO_INPUT_QUANTITY UMR_MSEC__10_1_0_S5_S3 3 0 2540 DEPOSIT ABSOLUTE /end AXIS_DESCR
/end CHARACTERISTIC
/begin CHARACTERISTIC KL_PORASYNV1_6 "Schliessrampendruckoffset 1. nichtkraftschl. Kupplung" CURVE 0x1C1338 ZF_kl_si16_S5_S3 12.75 UMR_BAR__1_1000_0_S5_S3 0 12.75
 /begin AXIS_DESCR STD_AXIS NO_INPUT_QUANTITY UMR_MSEC__10_1_0_S5_S3 3 0 2540 DEPOSIT ABSOLUTE /end AXIS_DESCR
/end CHARACTERISTIC
/begin CHARACTERISTIC KL_PORASYNV2_1 "Schliessrampendruckoffset 2. nichtkraftschl. Kupplung" CURVE 0x1BF974 ZF_kl_si16_S5_S3 12.75 UMR_BAR__1_1000_0_S5_S3 0 12.75
 /begin AXIS_DESCR STD_AXIS NO_INPUT_QUANTITY UMR_MSEC__10_1_0_S5_S3 3 0 2540 DEPOSIT ABSOLUTE /end AXIS_DESCR
/end CHARACTERISTIC
/begin CHARACTERISTIC KL_PORASYNV2_2 "Schliessrampendruckoffset 2. nichtkraftschl. Kupplung" CURVE 0x1BFEA4 ZF_kl_si16_S5_S3 12.75 UMR_BAR__1_1000_0_S5_S3 0 12.75
 /begin AXIS_DESCR STD_AXIS NO_INPUT_QUANTITY UMR_MSEC__10_1_0_S5_S3 3 0 2540 DEPOSIT ABSOLUTE /end AXIS_DESCR
/end CHARACTERISTIC
/begin CHARACTERISTIC KL_PORASYNV2_3 "Schliessrampendruckoffset 2. nichtkraftschl. Kupplung" CURVE 0x1C03D4 ZF_kl_si16_S5_S3 12.75 UMR_BAR__1_1000_0_S5_S3 0 12.75
 /begin AXIS_DESCR STD_AXIS NO_INPUT_QUANTITY UMR_MSEC__10_1_0_S5_S3 3 0 2540 DEPOSIT ABSOLUTE /end AXIS_DESCR
/end CHARACTERISTIC
/begin CHARACTERISTIC KL_PORASYNV2_4 "Schliessrampendruckoffset 2. nichtkraftschl. Kupplung" CURVE 0x1C0904 ZF_kl_si16_S5_S3 12.75 UMR_BAR__1_1000_0_S5_S3 0 12.75
 /begin AXIS_DESCR STD_AXIS NO_INPUT_QUANTITY UMR_MSEC__10_1_0_S5_S3 3 0 2540 DEPOSIT ABSOLUTE /end AXIS_DESCR
/end CHARACTERISTIC
/begin CHARACTERISTIC KL_PORASYNV2_5 "Schliessrampendruckoffset 2. nichtkraftschl. Kupplung" CURVE 0x1C0E34 ZF_kl_si16_S5_S3 12.75 UMR_BAR__1_1000_0_S5_S3 0 12.75
 /begin AXIS_DESCR STD_AXIS NO_INPUT_QUANTITY UMR_MSEC__10_1_0_S5_S3 3 0 2540 DEPOSIT ABSOLUTE /end AXIS_DESCR
/end CHARACTERISTIC
/begin CHARACTERISTIC KL_PORASYNV2_6 "Schliessrampendruckoffset 2. nichtkraftschl. Kupplung" CURVE 0x1C1364 ZF_kl_si16_S5_S3 12.75 UMR_BAR__1_1000_0_S5_S3 0 12.75
 /begin AXIS_DESCR STD_AXIS NO_INPUT_QUANTITY UMR_MSEC__10_1_0_S5_S3 3 0 2540 DEPOSIT ABSOLUTE /end AXIS_DESCR
/end CHARACTERISTIC
/begin CHARACTERISTIC KL_PORASYN_1 "Rampe n.Syn.->letz.Stuetz.y PMAX" CURVE 0x1BFAB4 ZF_kl_si16_S5_S3 12.75 UMR_BAR__1_1000_0_S5_S3 0 12.75
 /begin AXIS_DESCR STD_AXIS NO_INPUT_QUANTITY UMR_MSEC__10_1_0_S5_S3 3 0 2540 DEPOSIT ABSOLUTE /end AXIS_DESCR
/end CHARACTERISTIC
/begin CHARACTERISTIC KL_PORASYN_2 "Rampe n.Syn.->letz.Stuetz.y PMAX" CURVE 0x1BFFE4 ZF_kl_si16_S5_S3 12.75 UMR_BAR__1_1000_0_S5_S3 0 12.75
 /begin AXIS_DESCR STD_AXIS NO_INPUT_QUANTITY UMR_MSEC__10_1_0_S5_S3 3 0 2540 DEPOSIT ABSOLUTE /end AXIS_DESCR
/end CHARACTERISTIC
/begin CHARACTERISTIC KL_PORASYN_3 "Rampe n.Syn.->letz.Stuetz.y PMAX" CURVE 0x1C0514 ZF_kl_si16_S5_S3 12.75 UMR_BAR__1_1000_0_S5_S3 0 12.75
 /begin AXIS_DESCR STD_AXIS NO_INPUT_QUANTITY UMR_MSEC__10_1_0_S5_S3 3 0 2540 DEPOSIT ABSOLUTE /end AXIS_DESCR
/end CHARACTERISTIC
/begin CHARACTERISTIC KL_PORASYN_4 "Rampe n.Syn.->letz.Stuetz.y PMAX" CURVE 0x1C0A44 ZF_kl_si16_S5_S3 12.75 UMR_BAR__1_1000_0_S5_S3 0 12.75
 /begin AXIS_DESCR STD_AXIS NO_INPUT_QUANTITY UMR_MSEC__10_1_0_S5_S3 3 0 2540 DEPOSIT ABSOLUTE /end AXIS_DESCR
/end CHARACTERISTIC
/begin CHARACTERISTIC KL_PORASYN_5 "Rampe n.Syn.->letz.Stuetz.y PMAX" CURVE 0x1C0F74 ZF_kl_si16_S5_S3 12.75 UMR_BAR__1_1000_0_S5_S3 0 12.75
 /begin AXIS_DESCR STD_AXIS NO_INPUT_QUANTITY UMR_MSEC__10_1_0_S5_S3 3 0 2540 DEPOSIT ABSOLUTE /end AXIS_DESCR
/end CHARACTERISTIC
/begin CHARACTERISTIC KL_PORASYN_6 "Rampe n.Syn.->letz.Stuetz.y PMAX" CURVE 0x1C14A4 ZF_kl_si16_S5_S3 12.75 UMR_BAR__1_1000_0_S5_S3 0 12.75
 /begin AXIS_DESCR STD_AXIS NO_INPUT_QUANTITY UMR_MSEC__10_1_0_S5_S3 3 0 2540 DEPOSIT ABSOLUTE /end AXIS_DESCR
/end CHARACTERISTIC
/begin CHARACTERISTIC KL_POZUSTARTK021 "KAB Offset waehrend Zustart K0" CURVE 0x1BDA60 ZF_kl_si16_S5_S3 6.4 UMR_BAR__1_1000_0_S5_S3 0 6.4
 /begin AXIS_DESCR STD_AXIS zff_atsys._.iSignale._.obj.sig_m_t UMR_NM__1_1_0_S5_S3 4 -200 1300 DEPOSIT ABSOLUTE /end AXIS_DESCR
/end CHARACTERISTIC
/begin CHARACTERISTIC KL_POZUSTARTK032 "KAB Offset waehrend Zustart K0" CURVE 0x1BDB88 ZF_kl_si16_S5_S3 6.4 UMR_BAR__1_1000_0_S5_S3 0 6.4
 /begin AXIS_DESCR STD_AXIS zff_atsys._.iSignale._.obj.sig_m_t UMR_NM__1_1_0_S5_S3 4 -200 1300 DEPOSIT ABSOLUTE /end AXIS_DESCR
/end CHARACTERISTIC
/begin CHARACTERISTIC KL_POZUSTARTK043 "KAB Offset waehrend Zustart K0" CURVE 0x1BDCB0 ZF_kl_si16_S5_S3 6.4 UMR_BAR__1_1000_0_S5_S3 0 6.4
 /begin AXIS_DESCR STD_AXIS zff_atsys._.iSignale._.obj.sig_m_t UMR_NM__1_1_0_S5_S3 4 -200 1300 DEPOSIT ABSOLUTE /end AXIS_DESCR
/end CHARACTERISTIC
/begin CHARACTERISTIC KL_POZUSTARTK054 "KAB Offset waehrend Zustart K0" CURVE 0x1BDDD8 ZF_kl_si16_S5_S3 6.4 UMR_BAR__1_1000_0_S5_S3 0 6.4
 /begin AXIS_DESCR STD_AXIS zff_atsys._.iSignale._.obj.sig_m_t UMR_NM__1_1_0_S5_S3 4 -200 1300 DEPOSIT ABSOLUTE /end AXIS_DESCR
/end CHARACTERISTIC
/begin CHARACTERISTIC KL_POZUSTARTK065 "KAB Offset waehrend Zustart K0" CURVE 0x1BDF00 ZF_kl_si16_S5_S3 6.4 UMR_BAR__1_1000_0_S5_S3 0 6.4
 /begin AXIS_DESCR STD_AXIS zff_atsys._.iSignale._.obj.sig_m_t UMR_NM__1_1_0_S5_S3 4 -200 1300 DEPOSIT ABSOLUTE /end AXIS_DESCR
/end CHARACTERISTIC
/begin CHARACTERISTIC KL_POZUSTARTK076 "KAB Offset waehrend Zustart K0" CURVE 0x1BE028 ZF_kl_si16_S5_S3 6.4 UMR_BAR__1_1000_0_S5_S3 0 6.4
 /begin AXIS_DESCR STD_AXIS zff_atsys._.iSignale._.obj.sig_m_t UMR_NM__1_1_0_S5_S3 4 -200 1300 DEPOSIT ABSOLUTE /end AXIS_DESCR
/end CHARACTERISTIC
/begin CHARACTERISTIC KL_POZUSTARTK087 "KAB Offset waehrend Zustart K0" CURVE 0x1BE150 ZF_kl_si16_S5_S3 6.4 UMR_BAR__1_1000_0_S5_S3 0 6.4
 /begin AXIS_DESCR STD_AXIS zff_atsys._.iSignale._.obj.sig_m_t UMR_NM__1_1_0_S5_S3 4 -200 1300 DEPOSIT ABSOLUTE /end AXIS_DESCR
/end CHARACTERISTIC
/begin CHARACTERISTIC KL_POZUSTARTK0SP31 "KAB Offset waehrend Zustart K0" CURVE 0x1BE278 ZF_kl_si16_S5_S3 6.4 UMR_BAR__1_1000_0_S5_S3 0 6.4
 /begin AXIS_DESCR STD_AXIS zff_atsys._.iSignale._.obj.sig_m_t UMR_NM__1_1_0_S5_S3 4 -200 1300 DEPOSIT ABSOLUTE /end AXIS_DESCR
/end CHARACTERISTIC
/begin CHARACTERISTIC KL_POZUSTARTK0SP42 "KAB Offset waehrend Zustart K0" CURVE 0x1BE3A0 ZF_kl_si16_S5_S3 6.4 UMR_BAR__1_1000_0_S5_S3 0 6.4
 /begin AXIS_DESCR STD_AXIS zff_atsys._.iSignale._.obj.sig_m_t UMR_NM__1_1_0_S5_S3 4 -200 1300 DEPOSIT ABSOLUTE /end AXIS_DESCR
/end CHARACTERISTIC
/begin CHARACTERISTIC KL_POZUSTARTK0SP51 "KAB Offset waehrend Zustart K0" CURVE 0x1BE4C8 ZF_kl_si16_S5_S3 6.4 UMR_BAR__1_1000_0_S5_S3 0 6.4
 /begin AXIS_DESCR STD_AXIS zff_atsys._.iSignale._.obj.sig_m_t UMR_NM__1_1_0_S5_S3 4 -200 1300 DEPOSIT ABSOLUTE /end AXIS_DESCR
/end CHARACTERISTIC
/begin CHARACTERISTIC KL_POZUSTARTK0SP53 "KAB Offset waehrend Zustart K0" CURVE 0x1BE5F0 ZF_kl_si16_S5_S3 6.4 UMR_BAR__1_1000_0_S5_S3 0 6.4
 /begin AXIS_DESCR STD_AXIS zff_atsys._.iSignale._.obj.sig_m_t UMR_NM__1_1_0_S5_S3 4 -200 1300 DEPOSIT ABSOLUTE /end AXIS_DESCR
/end CHARACTERISTIC
/begin CHARACTERISTIC KL_POZUSTARTK0SP63 "KAB Offset waehrend Zustart K0" CURVE 0x1BE718 ZF_kl_si16_S5_S3 6.4 UMR_BAR__1_1000_0_S5_S3 0 6.4
 /begin AXIS_DESCR STD_AXIS zff_atsys._.iSignale._.obj.sig_m_t UMR_NM__1_1_0_S5_S3 4 -200 1300 DEPOSIT ABSOLUTE /end AXIS_DESCR
/end CHARACTERISTIC
/begin CHARACTERISTIC KL_POZUSTARTK0SP64 "KAB Offset waehrend Zustart K0" CURVE 0x1BE840 ZF_kl_si16_S5_S3 6.4 UMR_BAR__1_1000_0_S5_S3 0 6.4
 /begin AXIS_DESCR STD_AXIS zff_atsys._.iSignale._.obj.sig_m_t UMR_NM__1_1_0_S5_S3 4 -200 1300 DEPOSIT ABSOLUTE /end AXIS_DESCR
/end CHARACTERISTIC
/begin CHARACTERISTIC KL_POZUSTARTK0SP71 "KAB Offset waehrend Zustart K0" CURVE 0x1BE968 ZF_kl_si16_S5_S3 6.4 UMR_BAR__1_1000_0_S5_S3 0 6.4
 /begin AXIS_DESCR STD_AXIS zff_atsys._.iSignale._.obj.sig_m_t UMR_NM__1_1_0_S5_S3 4 -200 1300 DEPOSIT ABSOLUTE /end AXIS_DESCR
/end CHARACTERISTIC
/begin CHARACTERISTIC KL_POZUSTARTK0SP75 "KAB Offset waehrend Zustart K0" CURVE 0x1BEA90 ZF_kl_si16_S5_S3 6.4 UMR_BAR__1_1000_0_S5_S3 0 6.4
 /begin AXIS_DESCR STD_AXIS zff_atsys._.iSignale._.obj.sig_m_t UMR_NM__1_1_0_S5_S3 4 -200 1300 DEPOSIT ABSOLUTE /end AXIS_DESCR
/end CHARACTERISTIC
/begin CHARACTERISTIC KL_POZUSTARTK0SP82 "KAB Offset waehrend Zustart K0" CURVE 0x1BEBB8 ZF_kl_si16_S5_S3 6.4 UMR_BAR__1_1000_0_S5_S3 0 6.4
 /begin AXIS_DESCR STD_AXIS zff_atsys._.iSignale._.obj.sig_m_t UMR_NM__1_1_0_S5_S3 4 -200 1300 DEPOSIT ABSOLUTE /end AXIS_DESCR
/end CHARACTERISTIC
/begin CHARACTERISTIC KL_POZUSTARTK0SP84 "KAB Offset waehrend Zustart K0" CURVE 0x1BEE08 ZF_kl_si16_S5_S3 6.4 UMR_BAR__1_1000_0_S5_S3 0 6.4
 /begin AXIS_DESCR STD_AXIS zff_atsys._.iSignale._.obj.sig_m_t UMR_NM__1_1_0_S5_S3 4 -200 1300 DEPOSIT ABSOLUTE /end AXIS_DESCR
/end CHARACTERISTIC
/begin CHARACTERISTIC KL_POZUSTARTK0SP86 "KAB Offset waehrend Zustart K0" CURVE 0x1BECE0 ZF_kl_si16_S5_S3 6.4 UMR_BAR__1_1000_0_S5_S3 0 6.4
 /begin AXIS_DESCR STD_AXIS zff_atsys._.iSignale._.obj.sig_m_t UMR_NM__1_1_0_S5_S3 4 -200 1300 DEPOSIT ABSOLUTE /end AXIS_DESCR
/end CHARACTERISTIC
/begin CHARACTERISTIC KL_TFCGGE_1 "Fuellzeit" CURVE 0x1BF9B0 ZF_kl_ui16_S5_S3 2540 UMR_MSEC__10_1_0_S5_S3 0 2540
 /begin AXIS_DESCR STD_AXIS zff_atsys._.iSignale._.obj.sig_c_getr UMR_GRADC__1_1_M40_S5_S3 10 -40 210 DEPOSIT ABSOLUTE /end AXIS_DESCR
/end CHARACTERISTIC
/begin CHARACTERISTIC KL_TFCGGE_2 "Fuellzeit" CURVE 0x1BFEE0 ZF_kl_ui16_S5_S3 2540 UMR_MSEC__10_1_0_S5_S3 0 2540
 /begin AXIS_DESCR STD_AXIS zff_atsys._.iSignale._.obj.sig_c_getr UMR_GRADC__1_1_M40_S5_S3 10 -40 210 DEPOSIT ABSOLUTE /end AXIS_DESCR
/end CHARACTERISTIC
/begin CHARACTERISTIC KL_TFCGGE_3 "Fuellzeit" CURVE 0x1C0410 ZF_kl_ui16_S5_S3 2540 UMR_MSEC__10_1_0_S5_S3 0 2540
 /begin AXIS_DESCR STD_AXIS zff_atsys._.iSignale._.obj.sig_c_getr UMR_GRADC__1_1_M40_S5_S3 10 -40 210 DEPOSIT ABSOLUTE /end AXIS_DESCR
/end CHARACTERISTIC
/begin CHARACTERISTIC KL_TFCGGE_4 "Fuellzeit" CURVE 0x1C0940 ZF_kl_ui16_S5_S3 2540 UMR_MSEC__10_1_0_S5_S3 0 2540
 /begin AXIS_DESCR STD_AXIS zff_atsys._.iSignale._.obj.sig_c_getr UMR_GRADC__1_1_M40_S5_S3 10 -40 210 DEPOSIT ABSOLUTE /end AXIS_DESCR
/end CHARACTERISTIC
/begin CHARACTERISTIC KL_TFCGGE_5 "Fuellzeit" CURVE 0x1C0E70 ZF_kl_ui16_S5_S3 2540 UMR_MSEC__10_1_0_S5_S3 0 2540
 /begin AXIS_DESCR STD_AXIS zff_atsys._.iSignale._.obj.sig_c_getr UMR_GRADC__1_1_M40_S5_S3 10 -40 210 DEPOSIT ABSOLUTE /end AXIS_DESCR
/end CHARACTERISTIC
/begin CHARACTERISTIC KL_TFCGGE_6 "Fuellzeit" CURVE 0x1C13A0 ZF_kl_ui16_S5_S3 2540 UMR_MSEC__10_1_0_S5_S3 0 2540
 /begin AXIS_DESCR STD_AXIS zff_atsys._.iSignale._.obj.sig_c_getr UMR_GRADC__1_1_M40_S5_S3 10 -40 210 DEPOSIT ABSOLUTE /end AXIS_DESCR
/end CHARACTERISTIC
/begin CHARACTERISTIC KL_TFCGV2_1 "Fuellzeit GE 2. nicht kraftschl. Kupplung" CURVE 0x1BF9F0 ZF_kl_ui16_S5_S3 2540 UMR_MSEC__10_1_0_S5_S3 0 2540
 /begin AXIS_DESCR STD_AXIS zff_atsys._.iSignale._.obj.sig_c_getr UMR_GRADC__1_1_M40_S5_S3 4 -40 210 DEPOSIT ABSOLUTE /end AXIS_DESCR
/end CHARACTERISTIC
/begin CHARACTERISTIC KL_TFCGV2_2 "Fuellzeit GE 2. nicht kraftschl. Kupplung" CURVE 0x1BFF20 ZF_kl_ui16_S5_S3 2540 UMR_MSEC__10_1_0_S5_S3 0 2540
 /begin AXIS_DESCR STD_AXIS zff_atsys._.iSignale._.obj.sig_c_getr UMR_GRADC__1_1_M40_S5_S3 4 -40 210 DEPOSIT ABSOLUTE /end AXIS_DESCR
/end CHARACTERISTIC
/begin CHARACTERISTIC KL_TFCGV2_3 "Fuellzeit GE 2. nicht kraftschl. Kupplung" CURVE 0x1C0450 ZF_kl_ui16_S5_S3 2540 UMR_MSEC__10_1_0_S5_S3 0 2540
 /begin AXIS_DESCR STD_AXIS zff_atsys._.iSignale._.obj.sig_c_getr UMR_GRADC__1_1_M40_S5_S3 4 -40 210 DEPOSIT ABSOLUTE /end AXIS_DESCR
/end CHARACTERISTIC
/begin CHARACTERISTIC KL_TFCGV2_4 "Fuellzeit GE 2. nicht kraftschl. Kupplung" CURVE 0x1C0980 ZF_kl_ui16_S5_S3 2540 UMR_MSEC__10_1_0_S5_S3 0 2540
 /begin AXIS_DESCR STD_AXIS zff_atsys._.iSignale._.obj.sig_c_getr UMR_GRADC__1_1_M40_S5_S3 4 -40 210 DEPOSIT ABSOLUTE /end AXIS_DESCR
/end CHARACTERISTIC
/begin CHARACTERISTIC KL_TFCGV2_5 "Fuellzeit GE 2. nicht kraftschl. Kupplung" CURVE 0x1C0EB0 ZF_kl_ui16_S5_S3 2540 UMR_MSEC__10_1_0_S5_S3 0 2540
 /begin AXIS_DESCR STD_AXIS zff_atsys._.iSignale._.obj.sig_c_getr UMR_GRADC__1_1_M40_S5_S3 4 -40 210 DEPOSIT ABSOLUTE /end AXIS_DESCR
/end CHARACTERISTIC
/begin CHARACTERISTIC KL_TFCGV2_6 "Fuellzeit GE 2. nicht kraftschl. Kupplung" CURVE 0x1C13E0 ZF_kl_ui16_S5_S3 2540 UMR_MSEC__10_1_0_S5_S3 0 2540
 /begin AXIS_DESCR STD_AXIS zff_atsys._.iSignale._.obj.sig_c_getr UMR_GRADC__1_1_M40_S5_S3 4 -40 210 DEPOSIT ABSOLUTE /end AXIS_DESCR
/end CHARACTERISTIC
/begin CHARACTERISTIC KL_TFV1_1 "Fuellzeit GE 1. nicht kraftschl. Kupplung" CURVE 0x1BF9DC ZF_kl_ui16_S5_S3 2540 UMR_MSEC__10_1_0_S5_S3 0 2540
 /begin AXIS_DESCR STD_AXIS zff_atsys._.iSignale._.obj.sig_n_ab UMR_U_MIN_1_1_0_S5_S3 4 0 8160 DEPOSIT ABSOLUTE /end AXIS_DESCR
/end CHARACTERISTIC
/begin CHARACTERISTIC KL_TFV1_2 "Fuellzeit GE 1. nicht kraftschl. Kupplung" CURVE 0x1BFF0C ZF_kl_ui16_S5_S3 2540 UMR_MSEC__10_1_0_S5_S3 0 2540
 /begin AXIS_DESCR STD_AXIS zff_atsys._.iSignale._.obj.sig_n_ab UMR_U_MIN_1_1_0_S5_S3 4 0 8160 DEPOSIT ABSOLUTE /end AXIS_DESCR
/end CHARACTERISTIC
/begin CHARACTERISTIC KL_TFV1_3 "Fuellzeit GE 1. nicht kraftschl. Kupplung" CURVE 0x1C043C ZF_kl_ui16_S5_S3 2540 UMR_MSEC__10_1_0_S5_S3 0 2540
 /begin AXIS_DESCR STD_AXIS zff_atsys._.iSignale._.obj.sig_n_ab UMR_U_MIN_1_1_0_S5_S3 4 0 8160 DEPOSIT ABSOLUTE /end AXIS_DESCR
/end CHARACTERISTIC
/begin CHARACTERISTIC KL_TFV1_4 "Fuellzeit GE 1. nicht kraftschl. Kupplung" CURVE 0x1C096C ZF_kl_ui16_S5_S3 2540 UMR_MSEC__10_1_0_S5_S3 0 2540
 /begin AXIS_DESCR STD_AXIS zff_atsys._.iSignale._.obj.sig_n_ab UMR_U_MIN_1_1_0_S5_S3 4 0 8160 DEPOSIT ABSOLUTE /end AXIS_DESCR
/end CHARACTERISTIC
/begin CHARACTERISTIC KL_TFV1_5 "Fuellzeit GE 1. nicht kraftschl. Kupplung" CURVE 0x1C0E9C ZF_kl_ui16_S5_S3 2540 UMR_MSEC__10_1_0_S5_S3 0 2540
 /begin AXIS_DESCR STD_AXIS zff_atsys._.iSignale._.obj.sig_n_ab UMR_U_MIN_1_1_0_S5_S3 4 0 8160 DEPOSIT ABSOLUTE /end AXIS_DESCR
/end CHARACTERISTIC
/begin CHARACTERISTIC KL_TFV1_6 "Fuellzeit GE 1. nicht kraftschl. Kupplung" CURVE 0x1C13CC ZF_kl_ui16_S5_S3 2540 UMR_MSEC__10_1_0_S5_S3 0 2540
 /begin AXIS_DESCR STD_AXIS zff_atsys._.iSignale._.obj.sig_n_ab UMR_U_MIN_1_1_0_S5_S3 4 0 8160 DEPOSIT ABSOLUTE /end AXIS_DESCR
/end CHARACTERISTIC
/begin CHARACTERISTIC KL_TOVKZUCG_1 "Offset auf Verzoegerungszeit kraftschliessende KZU" CURVE 0x1BF984 ZF_kl_ui8_S5_S3 2540 UMR_MSEC__10_1_0_S5_S3 0 2540
 /begin AXIS_DESCR STD_AXIS zff_atsys._.iSignale._.obj.sig_c_getr UMR_GRADC__1_1_M40_S5_S3 4 -40 150 DEPOSIT ABSOLUTE /end AXIS_DESCR
/end CHARACTERISTIC
/begin CHARACTERISTIC KL_TOVKZUCG_2 "Offset auf Verzoegerungszeit kraftschliessende KZU" CURVE 0x1BFEB4 ZF_kl_ui8_S5_S3 2540 UMR_MSEC__10_1_0_S5_S3 0 2540
 /begin AXIS_DESCR STD_AXIS zff_atsys._.iSignale._.obj.sig_c_getr UMR_GRADC__1_1_M40_S5_S3 4 -40 150 DEPOSIT ABSOLUTE /end AXIS_DESCR
/end CHARACTERISTIC
/begin CHARACTERISTIC KL_TOVKZUCG_3 "Offset auf Verzoegerungszeit kraftschliessende KZU" CURVE 0x1C03E4 ZF_kl_ui8_S5_S3 2540 UMR_MSEC__10_1_0_S5_S3 0 2540
 /begin AXIS_DESCR STD_AXIS zff_atsys._.iSignale._.obj.sig_c_getr UMR_GRADC__1_1_M40_S5_S3 4 -40 150 DEPOSIT ABSOLUTE /end AXIS_DESCR
/end CHARACTERISTIC
/begin CHARACTERISTIC KL_TOVKZUCG_4 "Offset auf Verzoegerungszeit kraftschliessende KZU" CURVE 0x1C0914 ZF_kl_ui8_S5_S3 2540 UMR_MSEC__10_1_0_S5_S3 0 2540
 /begin AXIS_DESCR STD_AXIS zff_atsys._.iSignale._.obj.sig_c_getr UMR_GRADC__1_1_M40_S5_S3 4 -40 150 DEPOSIT ABSOLUTE /end AXIS_DESCR
/end CHARACTERISTIC
/begin CHARACTERISTIC KL_TOVKZUCG_5 "Offset auf Verzoegerungszeit kraftschliessende KZU" CURVE 0x1C0E44 ZF_kl_ui8_S5_S3 2540 UMR_MSEC__10_1_0_S5_S3 0 2540
 /begin AXIS_DESCR STD_AXIS zff_atsys._.iSignale._.obj.sig_c_getr UMR_GRADC__1_1_M40_S5_S3 4 -40 150 DEPOSIT ABSOLUTE /end AXIS_DESCR
/end CHARACTERISTIC
/begin CHARACTERISTIC KL_TOVKZUCG_6 "Offset auf Verzoegerungszeit kraftschliessende KZU" CURVE 0x1C1374 ZF_kl_ui8_S5_S3 2540 UMR_MSEC__10_1_0_S5_S3 0 2540
 /begin AXIS_DESCR STD_AXIS zff_atsys._.iSignale._.obj.sig_c_getr UMR_GRADC__1_1_M40_S5_S3 4 -40 150 DEPOSIT ABSOLUTE /end AXIS_DESCR
/end CHARACTERISTIC
/begin CHARACTERISTIC KL_TRAHKABSPORT84 "Zeit fuer Rampe auf Schaltdruck" CURVE 0x1BD618 ZF_kl_ui8_S5_S3 2540 UMR_MSEC__10_1_0_S5_S3 0 2540
 /begin AXIS_DESCR STD_AXIS zff_atsys._.iSignale._.obj.sig_m_t8 UMR_NM__6_1_M34_S5_S3 4 -204 1326 DEPOSIT ABSOLUTE /end AXIS_DESCR
/end CHARACTERISTIC
/begin CHARACTERISTIC KL_TRAHKABSPORT86 "Zeit fuer Rampe auf Schaltdruck" CURVE 0x1BD7D0 ZF_kl_ui8_S5_S3 2540 UMR_MSEC__10_1_0_S5_S3 0 2540
 /begin AXIS_DESCR STD_AXIS zff_atsys._.iSignale._.obj.sig_m_t8 UMR_NM__6_1_M34_S5_S3 4 -204 1326 DEPOSIT ABSOLUTE /end AXIS_DESCR
/end CHARACTERISTIC
/begin CHARACTERISTIC KL_TRAHKABSPORT87 "Zeit fuer Rampe auf Schaltdruck" CURVE 0x1BC4E8 ZF_kl_ui8_S5_S3 2540 UMR_MSEC__10_1_0_S5_S3 0 2540
 /begin AXIS_DESCR STD_AXIS zff_atsys._.iSignale._.obj.sig_m_t8 UMR_NM__6_1_M34_S5_S3 4 -204 1326 DEPOSIT ABSOLUTE /end AXIS_DESCR
/end CHARACTERISTIC
/begin CHARACTERISTIC KL_TRAMTHINSYNKABSPORT84 "Zeit fuer Abschalten KAB nach Haltephase in Synchron" CURVE 0x1BD748 ZF_kl_ui8_S5_S3 2550 UMR_MSEC__10_1_0_S5_S3 0 2550
 /begin AXIS_DESCR STD_AXIS zff_atsys._.iSignale._.obj.sig_m_t8 UMR_NM__6_1_M34_S5_S3 4 -204 1326 DEPOSIT ABSOLUTE /end AXIS_DESCR
/end CHARACTERISTIC
/begin CHARACTERISTIC KL_TRAMTHINSYNKABSPORT86 "Zeit fuer Abschalten KAB nach Haltephase in Synchron" CURVE 0x1BD900 ZF_kl_ui8_S5_S3 2550 UMR_MSEC__10_1_0_S5_S3 0 2550
 /begin AXIS_DESCR STD_AXIS zff_atsys._.iSignale._.obj.sig_m_t8 UMR_NM__6_1_M34_S5_S3 4 -204 1326 DEPOSIT ABSOLUTE /end AXIS_DESCR
/end CHARACTERISTIC
/begin CHARACTERISTIC KL_TRAMTHINSYNKABSPORT87 "Zeit fuer Abschalten KAB nach Haltephase in Synchron" CURVE 0x1BC618 ZF_kl_ui8_S5_S3 2550 UMR_MSEC__10_1_0_S5_S3 0 2550
 /begin AXIS_DESCR STD_AXIS zff_atsys._.iSignale._.obj.sig_m_t8 UMR_NM__6_1_M34_S5_S3 4 -204 1326 DEPOSIT ABSOLUTE /end AXIS_DESCR
/end CHARACTERISTIC
/begin CHARACTERISTIC KL_TRAZUSTARTK021 "Druckrampe KAB Offset nach Zustart K0" CURVE 0x1BDA74 ZF_kl_ui8_S5_S3 2540 UMR_MSEC__10_1_0_S5_S3 0 2540
 /begin AXIS_DESCR STD_AXIS zff_atsys._.iSignale._.obj.sig_m_t8 UMR_NM__6_1_M34_S5_S3 4 -204 1326 DEPOSIT ABSOLUTE /end AXIS_DESCR
/end CHARACTERISTIC
/begin CHARACTERISTIC KL_TRAZUSTARTK032 "Druckrampe KAB Offset nach Zustart K0" CURVE 0x1BDB9C ZF_kl_ui8_S5_S3 2540 UMR_MSEC__10_1_0_S5_S3 0 2540
 /begin AXIS_DESCR STD_AXIS zff_atsys._.iSignale._.obj.sig_m_t8 UMR_NM__6_1_M34_S5_S3 4 -204 1326 DEPOSIT ABSOLUTE /end AXIS_DESCR
/end CHARACTERISTIC
/begin CHARACTERISTIC KL_TRAZUSTARTK043 "Druckrampe KAB Offset nach Zustart K0" CURVE 0x1BDCC4 ZF_kl_ui8_S5_S3 2540 UMR_MSEC__10_1_0_S5_S3 0 2540
 /begin AXIS_DESCR STD_AXIS zff_atsys._.iSignale._.obj.sig_m_t8 UMR_NM__6_1_M34_S5_S3 4 -204 1326 DEPOSIT ABSOLUTE /end AXIS_DESCR
/end CHARACTERISTIC
/begin CHARACTERISTIC KL_TRAZUSTARTK054 "Druckrampe KAB Offset nach Zustart K0" CURVE 0x1BDDEC ZF_kl_ui8_S5_S3 2540 UMR_MSEC__10_1_0_S5_S3 0 2540
 /begin AXIS_DESCR STD_AXIS zff_atsys._.iSignale._.obj.sig_m_t8 UMR_NM__6_1_M34_S5_S3 4 -204 1326 DEPOSIT ABSOLUTE /end AXIS_DESCR
/end CHARACTERISTIC
/begin CHARACTERISTIC KL_TRAZUSTARTK065 "Druckrampe KAB Offset nach Zustart K0" CURVE 0x1BDF14 ZF_kl_ui8_S5_S3 2540 UMR_MSEC__10_1_0_S5_S3 0 2540
 /begin AXIS_DESCR STD_AXIS zff_atsys._.iSignale._.obj.sig_m_t8 UMR_NM__6_1_M34_S5_S3 4 -204 1326 DEPOSIT ABSOLUTE /end AXIS_DESCR
/end CHARACTERISTIC
/begin CHARACTERISTIC KL_TRAZUSTARTK076 "Druckrampe KAB Offset nach Zustart K0" CURVE 0x1BE03C ZF_kl_ui8_S5_S3 2540 UMR_MSEC__10_1_0_S5_S3 0 2540
 /begin AXIS_DESCR STD_AXIS zff_atsys._.iSignale._.obj.sig_m_t8 UMR_NM__6_1_M34_S5_S3 4 -204 1326 DEPOSIT ABSOLUTE /end AXIS_DESCR
/end CHARACTERISTIC
/begin CHARACTERISTIC KL_TRAZUSTARTK087 "Druckrampe KAB Offset nach Zustart K0" CURVE 0x1BE164 ZF_kl_ui8_S5_S3 2540 UMR_MSEC__10_1_0_S5_S3 0 2540
 /begin AXIS_DESCR STD_AXIS zff_atsys._.iSignale._.obj.sig_m_t8 UMR_NM__6_1_M34_S5_S3 4 -204 1326 DEPOSIT ABSOLUTE /end AXIS_DESCR
/end CHARACTERISTIC
/begin CHARACTERISTIC KL_TRAZUSTARTK0SP31 "Druckrampe KAB Offset nach Zustart K0" CURVE 0x1BE28C ZF_kl_ui8_S5_S3 2540 UMR_MSEC__10_1_0_S5_S3 0 2540
 /begin AXIS_DESCR STD_AXIS zff_atsys._.iSignale._.obj.sig_m_t8 UMR_NM__6_1_M34_S5_S3 4 -204 1326 DEPOSIT ABSOLUTE /end AXIS_DESCR
/end CHARACTERISTIC
/begin CHARACTERISTIC KL_TRAZUSTARTK0SP42 "Druckrampe KAB Offset nach Zustart K0" CURVE 0x1BE3B4 ZF_kl_ui8_S5_S3 2540 UMR_MSEC__10_1_0_S5_S3 0 2540
 /begin AXIS_DESCR STD_AXIS zff_atsys._.iSignale._.obj.sig_m_t8 UMR_NM__6_1_M34_S5_S3 4 -204 1326 DEPOSIT ABSOLUTE /end AXIS_DESCR
/end CHARACTERISTIC
/begin CHARACTERISTIC KL_TRAZUSTARTK0SP51 "Druckrampe KAB Offset nach Zustart K0" CURVE 0x1BE4DC ZF_kl_ui8_S5_S3 2540 UMR_MSEC__10_1_0_S5_S3 0 2540
 /begin AXIS_DESCR STD_AXIS zff_atsys._.iSignale._.obj.sig_m_t8 UMR_NM__6_1_M34_S5_S3 4 -204 1326 DEPOSIT ABSOLUTE /end AXIS_DESCR
/end CHARACTERISTIC
/begin CHARACTERISTIC KL_TRAZUSTARTK0SP53 "Druckrampe KAB Offset nach Zustart K0" CURVE 0x1BE604 ZF_kl_ui8_S5_S3 2540 UMR_MSEC__10_1_0_S5_S3 0 2540
 /begin AXIS_DESCR STD_AXIS zff_atsys._.iSignale._.obj.sig_m_t8 UMR_NM__6_1_M34_S5_S3 4 -204 1326 DEPOSIT ABSOLUTE /end AXIS_DESCR
/end CHARACTERISTIC
/begin CHARACTERISTIC KL_TRAZUSTARTK0SP63 "Druckrampe KAB Offset nach Zustart K0" CURVE 0x1BE72C ZF_kl_ui8_S5_S3 2540 UMR_MSEC__10_1_0_S5_S3 0 2540
 /begin AXIS_DESCR STD_AXIS zff_atsys._.iSignale._.obj.sig_m_t8 UMR_NM__6_1_M34_S5_S3 4 -204 1326 DEPOSIT ABSOLUTE /end AXIS_DESCR
/end CHARACTERISTIC
/begin CHARACTERISTIC KL_TRAZUSTARTK0SP64 "Druckrampe KAB Offset nach Zustart K0" CURVE 0x1BE854 ZF_kl_ui8_S5_S3 2540 UMR_MSEC__10_1_0_S5_S3 0 2540
 /begin AXIS_DESCR STD_AXIS zff_atsys._.iSignale._.obj.sig_m_t8 UMR_NM__6_1_M34_S5_S3 4 -204 1326 DEPOSIT ABSOLUTE /end AXIS_DESCR
/end CHARACTERISTIC
/begin CHARACTERISTIC KL_TRAZUSTARTK0SP71 "Druckrampe KAB Offset nach Zustart K0" CURVE 0x1BE97C ZF_kl_ui8_S5_S3 2540 UMR_MSEC__10_1_0_S5_S3 0 2540
 /begin AXIS_DESCR STD_AXIS zff_atsys._.iSignale._.obj.sig_m_t8 UMR_NM__6_1_M34_S5_S3 4 -204 1326 DEPOSIT ABSOLUTE /end AXIS_DESCR
/end CHARACTERISTIC
/begin CHARACTERISTIC KL_TRAZUSTARTK0SP75 "Druckrampe KAB Offset nach Zustart K0" CURVE 0x1BEAA4 ZF_kl_ui8_S5_S3 2540 UMR_MSEC__10_1_0_S5_S3 0 2540
 /begin AXIS_DESCR STD_AXIS zff_atsys._.iSignale._.obj.sig_m_t8 UMR_NM__6_1_M34_S5_S3 4 -204 1326 DEPOSIT ABSOLUTE /end AXIS_DESCR
/end CHARACTERISTIC
/begin CHARACTERISTIC KL_TRAZUSTARTK0SP82 "Druckrampe KAB Offset nach Zustart K0" CURVE 0x1BEBCC ZF_kl_ui8_S5_S3 2540 UMR_MSEC__10_1_0_S5_S3 0 2540
 /begin AXIS_DESCR STD_AXIS zff_atsys._.iSignale._.obj.sig_m_t8 UMR_NM__6_1_M34_S5_S3 4 -204 1326 DEPOSIT ABSOLUTE /end AXIS_DESCR
/end CHARACTERISTIC
/begin CHARACTERISTIC KL_TRAZUSTARTK0SP84 "Druckrampe KAB Offset nach Zustart K0" CURVE 0x1BEE1C ZF_kl_ui8_S5_S3 2540 UMR_MSEC__10_1_0_S5_S3 0 2540
 /begin AXIS_DESCR STD_AXIS zff_atsys._.iSignale._.obj.sig_m_t8 UMR_NM__6_1_M34_S5_S3 4 -204 1326 DEPOSIT ABSOLUTE /end AXIS_DESCR
/end CHARACTERISTIC
/begin CHARACTERISTIC KL_TRAZUSTARTK0SP86 "Druckrampe KAB Offset nach Zustart K0" CURVE 0x1BECF4 ZF_kl_ui8_S5_S3 2540 UMR_MSEC__10_1_0_S5_S3 0 2540
 /begin AXIS_DESCR STD_AXIS zff_atsys._.iSignale._.obj.sig_m_t8 UMR_NM__6_1_M34_S5_S3 4 -204 1326 DEPOSIT ABSOLUTE /end AXIS_DESCR
/end CHARACTERISTIC
/begin CHARACTERISTIC KL_TSYNMTFKZUV12 "Zeit vor sync. Ende Fuellausgleich vorb. KZU" CURVE 0x1BEFC4 ZF_kl_ui8_S5_S3 1280 UMR_MSEC__10_1_M128_S5_S3 -1280 0
 /begin AXIS_DESCR STD_AXIS zff_atsys._.iSignale._.obj.sig_m_t8 UMR_NM__6_1_M34_S5_S3 4 -204 1326 DEPOSIT ABSOLUTE /end AXIS_DESCR
/end CHARACTERISTIC
/begin CHARACTERISTIC KL_TSYNMTFKZUV23 "Zeit vor sync. Ende Fuellausgleich vorb. KZU" CURVE 0x1BEFE4 ZF_kl_ui8_S5_S3 1280 UMR_MSEC__10_1_M128_S5_S3 -1280 0
 /begin AXIS_DESCR STD_AXIS zff_atsys._.iSignale._.obj.sig_m_t8 UMR_NM__6_1_M34_S5_S3 4 -204 1326 DEPOSIT ABSOLUTE /end AXIS_DESCR
/end CHARACTERISTIC
/begin CHARACTERISTIC KL_TSYNMTFKZUV34 "Zeit vor sync. Ende Fuellausgleich vorb. KZU" CURVE 0x1BF004 ZF_kl_ui8_S5_S3 1280 UMR_MSEC__10_1_M128_S5_S3 -1280 0
 /begin AXIS_DESCR STD_AXIS zff_atsys._.iSignale._.obj.sig_m_t8 UMR_NM__6_1_M34_S5_S3 4 -204 1326 DEPOSIT ABSOLUTE /end AXIS_DESCR
/end CHARACTERISTIC
/begin CHARACTERISTIC KL_TSYNMTFKZUV45 "Zeit vor sync. Ende Fuellausgleich vorb. KZU" CURVE 0x1BF024 ZF_kl_ui8_S5_S3 1280 UMR_MSEC__10_1_M128_S5_S3 -1280 0
 /begin AXIS_DESCR STD_AXIS zff_atsys._.iSignale._.obj.sig_m_t8 UMR_NM__6_1_M34_S5_S3 4 -204 1326 DEPOSIT ABSOLUTE /end AXIS_DESCR
/end CHARACTERISTIC
/begin CHARACTERISTIC KL_TSYNMTFKZUV56 "Zeit vor sync. Ende Fuellausgleich vorb. KZU" CURVE 0x1BF044 ZF_kl_ui8_S5_S3 1280 UMR_MSEC__10_1_M128_S5_S3 -1280 0
 /begin AXIS_DESCR STD_AXIS zff_atsys._.iSignale._.obj.sig_m_t8 UMR_NM__6_1_M34_S5_S3 4 -204 1326 DEPOSIT ABSOLUTE /end AXIS_DESCR
/end CHARACTERISTIC
/begin CHARACTERISTIC KL_TSYNMTFKZUV67 "Zeit vor sync. Ende Fuellausgleich vorb. KZU" CURVE 0x1BF064 ZF_kl_ui8_S5_S3 1280 UMR_MSEC__10_1_M128_S5_S3 -1280 0
 /begin AXIS_DESCR STD_AXIS zff_atsys._.iSignale._.obj.sig_m_t8 UMR_NM__6_1_M34_S5_S3 4 -204 1326 DEPOSIT ABSOLUTE /end AXIS_DESCR
/end CHARACTERISTIC
/begin CHARACTERISTIC KL_TSYNMTFKZUV78 "Zeit vor sync. Ende Fuellausgleich vorb. KZU" CURVE 0x1BF084 ZF_kl_ui8_S5_S3 1280 UMR_MSEC__10_1_M128_S5_S3 -1280 0
 /begin AXIS_DESCR STD_AXIS zff_atsys._.iSignale._.obj.sig_m_t8 UMR_NM__6_1_M34_S5_S3 4 -204 1326 DEPOSIT ABSOLUTE /end AXIS_DESCR
/end CHARACTERISTIC
/begin CHARACTERISTIC KL_TSYNMTKABSPORT84 "Zeit vor sync. Ende Schaltdruck KAB" CURVE 0x1BD650 ZF_kl_ui8_S5_S3 1280 UMR_MSEC__10_1_M128_S5_S3 -1280 0
 /begin AXIS_DESCR STD_AXIS zff_atsys._.iSignale._.obj.sig_m_t8 UMR_NM__6_1_M34_S5_S3 4 -204 1326 DEPOSIT ABSOLUTE /end AXIS_DESCR
/end CHARACTERISTIC
/begin CHARACTERISTIC KL_TSYNMTKABSPORT86 "Zeit vor sync. Ende Schaltdruck KAB" CURVE 0x1BD808 ZF_kl_ui8_S5_S3 1280 UMR_MSEC__10_1_M128_S5_S3 -1280 0
 /begin AXIS_DESCR STD_AXIS zff_atsys._.iSignale._.obj.sig_m_t8 UMR_NM__6_1_M34_S5_S3 4 -204 1326 DEPOSIT ABSOLUTE /end AXIS_DESCR
/end CHARACTERISTIC
/begin CHARACTERISTIC KL_TSYNMTKABSPORT87 "Zeit vor sync. Ende Schaltdruck KAB" CURVE 0x1BC520 ZF_kl_ui8_S5_S3 1280 UMR_MSEC__10_1_M128_S5_S3 -1280 0
 /begin AXIS_DESCR STD_AXIS zff_atsys._.iSignale._.obj.sig_m_t8 UMR_NM__6_1_M34_S5_S3 4 -204 1326 DEPOSIT ABSOLUTE /end AXIS_DESCR
/end CHARACTERISTIC
/begin CHARACTERISTIC KL_TSYNMTKZUSFV12 "Zeit vor sync. Start Schnellfuellung vorb. KZU" CURVE 0x1BEFB0 ZF_kl_si16_S5_S3 5000 UMR_MSEC__10_1_0_S5_S3 -5000 0
 /begin AXIS_DESCR STD_AXIS zff_atsys._.iSignale._.obj.sig_m_t UMR_NM__1_1_0_S5_S3 4 -200 1300 DEPOSIT ABSOLUTE /end AXIS_DESCR
/end CHARACTERISTIC
/begin CHARACTERISTIC KL_TSYNMTKZUSFV21 "Zeit vor sync. Start Schnellfuellung vorb. KZU" CURVE 0x1BF090 ZF_kl_si16_S5_S3 5000 UMR_MSEC__10_1_0_S5_S3 -5000 0
 /begin AXIS_DESCR STD_AXIS zff_atsys._.iSignale._.obj.sig_m_t UMR_NM__1_1_0_S5_S3 4 -200 1300 DEPOSIT ABSOLUTE /end AXIS_DESCR
/end CHARACTERISTIC
/begin CHARACTERISTIC KL_TSYNMTKZUSFV23 "Zeit vor sync. Start Schnellfuellung vorb. KZU" CURVE 0x1BEFD0 ZF_kl_si16_S5_S3 5000 UMR_MSEC__10_1_0_S5_S3 -5000 0
 /begin AXIS_DESCR STD_AXIS zff_atsys._.iSignale._.obj.sig_m_t UMR_NM__1_1_0_S5_S3 4 -200 1300 DEPOSIT ABSOLUTE /end AXIS_DESCR
/end CHARACTERISTIC
/begin CHARACTERISTIC KL_TSYNMTKZUSFV32 "Zeit vor sync. Start Schnellfuellung vorb. KZU" CURVE 0x1BF0D0 ZF_kl_si16_S5_S3 5000 UMR_MSEC__10_1_0_S5_S3 -5000 0
 /begin AXIS_DESCR STD_AXIS zff_atsys._.iSignale._.obj.sig_m_t UMR_NM__1_1_0_S5_S3 4 -200 1300 DEPOSIT ABSOLUTE /end AXIS_DESCR
/end CHARACTERISTIC
/begin CHARACTERISTIC KL_TSYNMTKZUSFV34 "Zeit vor sync. Start Schnellfuellung vorb. KZU" CURVE 0x1BEFF0 ZF_kl_si16_S5_S3 5000 UMR_MSEC__10_1_0_S5_S3 -5000 0
 /begin AXIS_DESCR STD_AXIS zff_atsys._.iSignale._.obj.sig_m_t UMR_NM__1_1_0_S5_S3 4 -200 1300 DEPOSIT ABSOLUTE /end AXIS_DESCR
/end CHARACTERISTIC
/begin CHARACTERISTIC KL_TSYNMTKZUSFV43 "Zeit vor sync. Start Schnellfuellung vorb. KZU" CURVE 0x1BF110 ZF_kl_si16_S5_S3 5000 UMR_MSEC__10_1_0_S5_S3 -5000 0
 /begin AXIS_DESCR STD_AXIS zff_atsys._.iSignale._.obj.sig_m_t UMR_NM__1_1_0_S5_S3 4 -200 1300 DEPOSIT ABSOLUTE /end AXIS_DESCR
/end CHARACTERISTIC
/begin CHARACTERISTIC KL_TSYNMTKZUSFV45 "Zeit vor sync. Start Schnellfuellung vorb. KZU" CURVE 0x1BF010 ZF_kl_si16_S5_S3 5000 UMR_MSEC__10_1_0_S5_S3 -5000 0
 /begin AXIS_DESCR STD_AXIS zff_atsys._.iSignale._.obj.sig_m_t UMR_NM__1_1_0_S5_S3 4 -200 1300 DEPOSIT ABSOLUTE /end AXIS_DESCR
/end CHARACTERISTIC
/begin CHARACTERISTIC KL_TSYNMTKZUSFV54 "Zeit vor sync. Start Schnellfuellung vorb. KZU" CURVE 0x1BF150 ZF_kl_si16_S5_S3 5000 UMR_MSEC__10_1_0_S5_S3 -5000 0
 /begin AXIS_DESCR STD_AXIS zff_atsys._.iSignale._.obj.sig_m_t UMR_NM__1_1_0_S5_S3 4 -200 1300 DEPOSIT ABSOLUTE /end AXIS_DESCR
/end CHARACTERISTIC
/begin CHARACTERISTIC KL_TSYNMTKZUSFV56 "Zeit vor sync. Start Schnellfuellung vorb. KZU" CURVE 0x1BF030 ZF_kl_si16_S5_S3 5000 UMR_MSEC__10_1_0_S5_S3 -5000 0
 /begin AXIS_DESCR STD_AXIS zff_atsys._.iSignale._.obj.sig_m_t UMR_NM__1_1_0_S5_S3 4 -200 1300 DEPOSIT ABSOLUTE /end AXIS_DESCR
/end CHARACTERISTIC
/begin CHARACTERISTIC KL_TSYNMTKZUSFV65 "Zeit vor sync. Start Schnellfuellung vorb. KZU" CURVE 0x1BF190 ZF_kl_si16_S5_S3 5000 UMR_MSEC__10_1_0_S5_S3 -5000 0
 /begin AXIS_DESCR STD_AXIS zff_atsys._.iSignale._.obj.sig_m_t UMR_NM__1_1_0_S5_S3 4 -200 1300 DEPOSIT ABSOLUTE /end AXIS_DESCR
/end CHARACTERISTIC
/begin CHARACTERISTIC KL_TSYNMTKZUSFV67 "Zeit vor sync. Start Schnellfuellung vorb. KZU" CURVE 0x1BF050 ZF_kl_si16_S5_S3 5000 UMR_MSEC__10_1_0_S5_S3 -5000 0
 /begin AXIS_DESCR STD_AXIS zff_atsys._.iSignale._.obj.sig_m_t UMR_NM__1_1_0_S5_S3 4 -200 1300 DEPOSIT ABSOLUTE /end AXIS_DESCR
/end CHARACTERISTIC
/begin CHARACTERISTIC KL_TSYNMTKZUSFV76 "Zeit vor sync. Start Schnellfuellung vorb. KZU" CURVE 0x1BF1D0 ZF_kl_si16_S5_S3 5000 UMR_MSEC__10_1_0_S5_S3 -5000 0
 /begin AXIS_DESCR STD_AXIS zff_atsys._.iSignale._.obj.sig_m_t UMR_NM__1_1_0_S5_S3 4 -200 1300 DEPOSIT ABSOLUTE /end AXIS_DESCR
/end CHARACTERISTIC
/begin CHARACTERISTIC KL_TSYNMTKZUSFV78 "Zeit vor sync. Start Schnellfuellung vorb. KZU" CURVE 0x1BF070 ZF_kl_si16_S5_S3 5000 UMR_MSEC__10_1_0_S5_S3 -5000 0
 /begin AXIS_DESCR STD_AXIS zff_atsys._.iSignale._.obj.sig_m_t UMR_NM__1_1_0_S5_S3 4 -200 1300 DEPOSIT ABSOLUTE /end AXIS_DESCR
/end CHARACTERISTIC
/begin CHARACTERISTIC KL_TSYNMTKZUSFV87 "Zeit vor sync. Start Schnellfuellung vorb. KZU" CURVE 0x1BF210 ZF_kl_si16_S5_S3 5000 UMR_MSEC__10_1_0_S5_S3 -5000 0
 /begin AXIS_DESCR STD_AXIS zff_atsys._.iSignale._.obj.sig_m_t UMR_NM__1_1_0_S5_S3 4 -200 1300 DEPOSIT ABSOLUTE /end AXIS_DESCR
/end CHARACTERISTIC
/begin CHARACTERISTIC KL_TSYNMTKZUSFVFOLNACHMRS21 "Zeit vor sync. Start Schnellfuellung vorb. KZU" CURVE 0x1BF0A4 ZF_kl_si16_S5_S3 5000 UMR_MSEC__10_1_0_S5_S3 -5000 0
 /begin AXIS_DESCR STD_AXIS zff_atsys._.iSignale._.obj.sig_m_t UMR_NM__1_1_0_S5_S3 4 -200 1300 DEPOSIT ABSOLUTE /end AXIS_DESCR
/end CHARACTERISTIC
/begin CHARACTERISTIC KL_TSYNMTKZUSFVFOLNACHMRS32 "Zeit vor sync. Start Schnellfuellung vorb. KZU" CURVE 0x1BF0E4 ZF_kl_si16_S5_S3 5000 UMR_MSEC__10_1_0_S5_S3 -5000 0
 /begin AXIS_DESCR STD_AXIS zff_atsys._.iSignale._.obj.sig_m_t UMR_NM__1_1_0_S5_S3 4 -200 1300 DEPOSIT ABSOLUTE /end AXIS_DESCR
/end CHARACTERISTIC
/begin CHARACTERISTIC KL_TSYNMTKZUSFVFOLNACHMRS43 "Zeit vor sync. Start Schnellfuellung vorb. KZU" CURVE 0x1BF124 ZF_kl_si16_S5_S3 5000 UMR_MSEC__10_1_0_S5_S3 -5000 0
 /begin AXIS_DESCR STD_AXIS zff_atsys._.iSignale._.obj.sig_m_t UMR_NM__1_1_0_S5_S3 4 -200 1300 DEPOSIT ABSOLUTE /end AXIS_DESCR
/end CHARACTERISTIC
/begin CHARACTERISTIC KL_TSYNMTKZUSFVFOLNACHMRS54 "Zeit vor sync. Start Schnellfuellung vorb. KZU" CURVE 0x1BF164 ZF_kl_si16_S5_S3 5000 UMR_MSEC__10_1_0_S5_S3 -5000 0
 /begin AXIS_DESCR STD_AXIS zff_atsys._.iSignale._.obj.sig_m_t UMR_NM__1_1_0_S5_S3 4 -200 1300 DEPOSIT ABSOLUTE /end AXIS_DESCR
/end CHARACTERISTIC
/begin CHARACTERISTIC KL_TSYNMTKZUSFVFOLNACHMRS65 "Zeit vor sync. Start Schnellfuellung vorb. KZU" CURVE 0x1BF1A4 ZF_kl_si16_S5_S3 5000 UMR_MSEC__10_1_0_S5_S3 -5000 0
 /begin AXIS_DESCR STD_AXIS zff_atsys._.iSignale._.obj.sig_m_t UMR_NM__1_1_0_S5_S3 4 -200 1300 DEPOSIT ABSOLUTE /end AXIS_DESCR
/end CHARACTERISTIC
/begin CHARACTERISTIC KL_TSYNMTKZUSFVFOLNACHMRS76 "Zeit vor sync. Start Schnellfuellung vorb. KZU" CURVE 0x1BF1E4 ZF_kl_si16_S5_S3 5000 UMR_MSEC__10_1_0_S5_S3 -5000 0
 /begin AXIS_DESCR STD_AXIS zff_atsys._.iSignale._.obj.sig_m_t UMR_NM__1_1_0_S5_S3 4 -200 1300 DEPOSIT ABSOLUTE /end AXIS_DESCR
/end CHARACTERISTIC
/begin CHARACTERISTIC KL_TSYNMTKZUSFVFOLNACHMRS87 "Zeit vor sync. Start Schnellfuellung vorb. KZU" CURVE 0x1BF224 ZF_kl_si16_S5_S3 5000 UMR_MSEC__10_1_0_S5_S3 -5000 0
 /begin AXIS_DESCR STD_AXIS zff_atsys._.iSignale._.obj.sig_m_t UMR_NM__1_1_0_S5_S3 4 -200 1300 DEPOSIT ABSOLUTE /end AXIS_DESCR
/end CHARACTERISTIC
/begin CHARACTERISTIC KL_TSYNMTTRAKZUV21 "Zeit vor sync. Ende Fuellausgleich vorb. KZU" CURVE 0x1BF0B8 ZF_kl_ui8_S5_S3 1280 UMR_MSEC__10_1_M128_S5_S3 -1280 0
 /begin AXIS_DESCR STD_AXIS zff_atsys._.iSignale._.obj.sig_m_t8 UMR_NM__6_1_M34_S5_S3 4 -204 1326 DEPOSIT ABSOLUTE /end AXIS_DESCR
/end CHARACTERISTIC
/begin CHARACTERISTIC KL_TSYNMTTRAKZUV32 "Zeit vor sync. Ende Fuellausgleich vorb. KZU" CURVE 0x1BF0F8 ZF_kl_ui8_S5_S3 1280 UMR_MSEC__10_1_M128_S5_S3 -1280 0
 /begin AXIS_DESCR STD_AXIS zff_atsys._.iSignale._.obj.sig_m_t8 UMR_NM__6_1_M34_S5_S3 4 -204 1326 DEPOSIT ABSOLUTE /end AXIS_DESCR
/end CHARACTERISTIC
/begin CHARACTERISTIC KL_TSYNMTTRAKZUV43 "Zeit vor sync. Ende Fuellausgleich vorb. KZU" CURVE 0x1BF138 ZF_kl_ui8_S5_S3 1280 UMR_MSEC__10_1_M128_S5_S3 -1280 0
 /begin AXIS_DESCR STD_AXIS zff_atsys._.iSignale._.obj.sig_m_t8 UMR_NM__6_1_M34_S5_S3 4 -204 1326 DEPOSIT ABSOLUTE /end AXIS_DESCR
/end CHARACTERISTIC
/begin CHARACTERISTIC KL_TSYNMTTRAKZUV54 "Zeit vor sync. Ende Fuellausgleich vorb. KZU" CURVE 0x1BF178 ZF_kl_ui8_S5_S3 1280 UMR_MSEC__10_1_M128_S5_S3 -1280 0
 /begin AXIS_DESCR STD_AXIS zff_atsys._.iSignale._.obj.sig_m_t8 UMR_NM__6_1_M34_S5_S3 4 -204 1326 DEPOSIT ABSOLUTE /end AXIS_DESCR
/end CHARACTERISTIC
/begin CHARACTERISTIC KL_TSYNMTTRAKZUV65 "Zeit vor sync. Ende Fuellausgleich vorb. KZU" CURVE 0x1BF1B8 ZF_kl_ui8_S5_S3 1280 UMR_MSEC__10_1_M128_S5_S3 -1280 0
 /begin AXIS_DESCR STD_AXIS zff_atsys._.iSignale._.obj.sig_m_t8 UMR_NM__6_1_M34_S5_S3 4 -204 1326 DEPOSIT ABSOLUTE /end AXIS_DESCR
/end CHARACTERISTIC
/begin CHARACTERISTIC KL_TSYNMTTRAKZUV76 "Zeit vor sync. Ende Fuellausgleich vorb. KZU" CURVE 0x1BF1F8 ZF_kl_ui8_S5_S3 1280 UMR_MSEC__10_1_M128_S5_S3 -1280 0
 /begin AXIS_DESCR STD_AXIS zff_atsys._.iSignale._.obj.sig_m_t8 UMR_NM__6_1_M34_S5_S3 4 -204 1326 DEPOSIT ABSOLUTE /end AXIS_DESCR
/end CHARACTERISTIC
/begin CHARACTERISTIC KL_TSYNMTTRAKZUV87 "Zeit vor sync. Ende Fuellausgleich vorb. KZU" CURVE 0x1BF238 ZF_kl_ui8_S5_S3 1280 UMR_MSEC__10_1_M128_S5_S3 -1280 0
 /begin AXIS_DESCR STD_AXIS zff_atsys._.iSignale._.obj.sig_m_t8 UMR_NM__6_1_M34_S5_S3 4 -204 1326 DEPOSIT ABSOLUTE /end AXIS_DESCR
/end CHARACTERISTIC
/begin CHARACTERISTIC KL_TSYNMTTRAKZUVFOLNACHMRS21 "Zeit vor sync. Ende Fuellausgleich vorb. KZU" CURVE 0x1BF0C4 ZF_kl_ui8_S5_S3 1280 UMR_MSEC__10_1_M128_S5_S3 -1280 0
 /begin AXIS_DESCR STD_AXIS zff_atsys._.iSignale._.obj.sig_m_t8 UMR_NM__6_1_M34_S5_S3 4 -204 1326 DEPOSIT ABSOLUTE /end AXIS_DESCR
/end CHARACTERISTIC
/begin CHARACTERISTIC KL_TSYNMTTRAKZUVFOLNACHMRS32 "Zeit vor sync. Ende Fuellausgleich vorb. KZU" CURVE 0x1BF104 ZF_kl_ui8_S5_S3 1280 UMR_MSEC__10_1_M128_S5_S3 -1280 0
 /begin AXIS_DESCR STD_AXIS zff_atsys._.iSignale._.obj.sig_m_t8 UMR_NM__6_1_M34_S5_S3 4 -204 1326 DEPOSIT ABSOLUTE /end AXIS_DESCR
/end CHARACTERISTIC
/begin CHARACTERISTIC KL_TSYNMTTRAKZUVFOLNACHMRS43 "Zeit vor sync. Ende Fuellausgleich vorb. KZU" CURVE 0x1BF144 ZF_kl_ui8_S5_S3 1280 UMR_MSEC__10_1_M128_S5_S3 -1280 0
 /begin AXIS_DESCR STD_AXIS zff_atsys._.iSignale._.obj.sig_m_t8 UMR_NM__6_1_M34_S5_S3 4 -204 1326 DEPOSIT ABSOLUTE /end AXIS_DESCR
/end CHARACTERISTIC
/begin CHARACTERISTIC KL_TSYNMTTRAKZUVFOLNACHMRS54 "Zeit vor sync. Ende Fuellausgleich vorb. KZU" CURVE 0x1BF184 ZF_kl_ui8_S5_S3 1280 UMR_MSEC__10_1_M128_S5_S3 -1280 0
 /begin AXIS_DESCR STD_AXIS zff_atsys._.iSignale._.obj.sig_m_t8 UMR_NM__6_1_M34_S5_S3 4 -204 1326 DEPOSIT ABSOLUTE /end AXIS_DESCR
/end CHARACTERISTIC
/begin CHARACTERISTIC KL_TSYNMTTRAKZUVFOLNACHMRS65 "Zeit vor sync. Ende Fuellausgleich vorb. KZU" CURVE 0x1BF1C4 ZF_kl_ui8_S5_S3 1280 UMR_MSEC__10_1_M128_S5_S3 -1280 0
 /begin AXIS_DESCR STD_AXIS zff_atsys._.iSignale._.obj.sig_m_t8 UMR_NM__6_1_M34_S5_S3 4 -204 1326 DEPOSIT ABSOLUTE /end AXIS_DESCR
/end CHARACTERISTIC
/begin CHARACTERISTIC KL_TSYNMTTRAKZUVFOLNACHMRS76 "Zeit vor sync. Ende Fuellausgleich vorb. KZU" CURVE 0x1BF204 ZF_kl_ui8_S5_S3 1280 UMR_MSEC__10_1_M128_S5_S3 -1280 0
 /begin AXIS_DESCR STD_AXIS zff_atsys._.iSignale._.obj.sig_m_t8 UMR_NM__6_1_M34_S5_S3 4 -204 1326 DEPOSIT ABSOLUTE /end AXIS_DESCR
/end CHARACTERISTIC
/begin CHARACTERISTIC KL_TSYNMTTRAKZUVFOLNACHMRS87 "Zeit vor sync. Ende Fuellausgleich vorb. KZU" CURVE 0x1BF244 ZF_kl_ui8_S5_S3 1280 UMR_MSEC__10_1_M128_S5_S3 -1280 0
 /begin AXIS_DESCR STD_AXIS zff_atsys._.iSignale._.obj.sig_m_t8 UMR_NM__6_1_M34_S5_S3 4 -204 1326 DEPOSIT ABSOLUTE /end AXIS_DESCR
/end CHARACTERISTIC
/begin CHARACTERISTIC KL_TVKZUCGV2_1 "Verzoegerungszeit 2. nichtkraftschliessende KZU" CURVE 0x1BF9A4 ZF_kl_ui8_S5_S3 2540 UMR_MSEC__10_1_0_S5_S3 0 2540
 /begin AXIS_DESCR STD_AXIS zff_atsys._.iSignale._.obj.sig_c_getr UMR_GRADC__1_1_M40_S5_S3 4 -40 150 DEPOSIT ABSOLUTE /end AXIS_DESCR
/end CHARACTERISTIC
/begin CHARACTERISTIC KL_TVKZUCGV2_2 "Verzoegerungszeit 2. nichtkraftschliessende KZU" CURVE 0x1BFED4 ZF_kl_ui8_S5_S3 2540 UMR_MSEC__10_1_0_S5_S3 0 2540
 /begin AXIS_DESCR STD_AXIS zff_atsys._.iSignale._.obj.sig_c_getr UMR_GRADC__1_1_M40_S5_S3 4 -40 150 DEPOSIT ABSOLUTE /end AXIS_DESCR
/end CHARACTERISTIC
/begin CHARACTERISTIC KL_TVKZUCGV2_3 "Verzoegerungszeit 2. nichtkraftschliessende KZU" CURVE 0x1C0404 ZF_kl_ui8_S5_S3 2540 UMR_MSEC__10_1_0_S5_S3 0 2540
 /begin AXIS_DESCR STD_AXIS zff_atsys._.iSignale._.obj.sig_c_getr UMR_GRADC__1_1_M40_S5_S3 4 -40 150 DEPOSIT ABSOLUTE /end AXIS_DESCR
/end CHARACTERISTIC
/begin CHARACTERISTIC KL_TVKZUCGV2_4 "Verzoegerungszeit 2. nichtkraftschliessende KZU" CURVE 0x1C0934 ZF_kl_ui8_S5_S3 2540 UMR_MSEC__10_1_0_S5_S3 0 2540
 /begin AXIS_DESCR STD_AXIS zff_atsys._.iSignale._.obj.sig_c_getr UMR_GRADC__1_1_M40_S5_S3 4 -40 150 DEPOSIT ABSOLUTE /end AXIS_DESCR
/end CHARACTERISTIC
/begin CHARACTERISTIC KL_TVKZUCGV2_5 "Verzoegerungszeit 2. nichtkraftschliessende KZU" CURVE 0x1C0E64 ZF_kl_ui8_S5_S3 2540 UMR_MSEC__10_1_0_S5_S3 0 2540
 /begin AXIS_DESCR STD_AXIS zff_atsys._.iSignale._.obj.sig_c_getr UMR_GRADC__1_1_M40_S5_S3 4 -40 150 DEPOSIT ABSOLUTE /end AXIS_DESCR
/end CHARACTERISTIC
/begin CHARACTERISTIC KL_TVKZUCGV2_6 "Verzoegerungszeit 2. nichtkraftschliessende KZU" CURVE 0x1C1394 ZF_kl_ui8_S5_S3 2540 UMR_MSEC__10_1_0_S5_S3 0 2540
 /begin AXIS_DESCR STD_AXIS zff_atsys._.iSignale._.obj.sig_c_getr UMR_GRADC__1_1_M40_S5_S3 4 -40 150 DEPOSIT ABSOLUTE /end AXIS_DESCR
/end CHARACTERISTIC
/begin CHARACTERISTIC KL_TVKZU_1 "Verzoegerungszeit kraftschliessende KZU" CURVE 0x1BF990 ZF_kl_ui16_S5_S3 2540 UMR_MSEC__10_1_0_S5_S3 0 2540
 /begin AXIS_DESCR STD_AXIS zff_atsys._.iSignale._.obj.sig_n_ab UMR_U_MIN_1_1_0_S5_S3 4 0 8160 DEPOSIT ABSOLUTE /end AXIS_DESCR
/end CHARACTERISTIC
/begin CHARACTERISTIC KL_TVKZU_2 "Verzoegerungszeit kraftschliessende KZU" CURVE 0x1BFEC0 ZF_kl_ui16_S5_S3 2540 UMR_MSEC__10_1_0_S5_S3 0 2540
 /begin AXIS_DESCR STD_AXIS zff_atsys._.iSignale._.obj.sig_n_ab UMR_U_MIN_1_1_0_S5_S3 4 0 8160 DEPOSIT ABSOLUTE /end AXIS_DESCR
/end CHARACTERISTIC
/begin CHARACTERISTIC KL_TVKZU_3 "Verzoegerungszeit kraftschliessende KZU" CURVE 0x1C03F0 ZF_kl_ui16_S5_S3 2540 UMR_MSEC__10_1_0_S5_S3 0 2540
 /begin AXIS_DESCR STD_AXIS zff_atsys._.iSignale._.obj.sig_n_ab UMR_U_MIN_1_1_0_S5_S3 4 0 8160 DEPOSIT ABSOLUTE /end AXIS_DESCR
/end CHARACTERISTIC
/begin CHARACTERISTIC KL_TVKZU_4 "Verzoegerungszeit kraftschliessende KZU" CURVE 0x1C0920 ZF_kl_ui16_S5_S3 2540 UMR_MSEC__10_1_0_S5_S3 0 2540
 /begin AXIS_DESCR STD_AXIS zff_atsys._.iSignale._.obj.sig_n_ab UMR_U_MIN_1_1_0_S5_S3 4 0 8160 DEPOSIT ABSOLUTE /end AXIS_DESCR
/end CHARACTERISTIC
/begin CHARACTERISTIC KL_TVKZU_5 "Verzoegerungszeit kraftschliessende KZU" CURVE 0x1C0E50 ZF_kl_ui16_S5_S3 2540 UMR_MSEC__10_1_0_S5_S3 0 2540
 /begin AXIS_DESCR STD_AXIS zff_atsys._.iSignale._.obj.sig_n_ab UMR_U_MIN_1_1_0_S5_S3 4 0 8160 DEPOSIT ABSOLUTE /end AXIS_DESCR
/end CHARACTERISTIC
/begin CHARACTERISTIC KL_TVKZU_6 "Verzoegerungszeit kraftschliessende KZU" CURVE 0x1C1380 ZF_kl_ui16_S5_S3 2540 UMR_MSEC__10_1_0_S5_S3 0 2540
 /begin AXIS_DESCR STD_AXIS zff_atsys._.iSignale._.obj.sig_n_ab UMR_U_MIN_1_1_0_S5_S3 4 0 8160 DEPOSIT ABSOLUTE /end AXIS_DESCR
/end CHARACTERISTIC
/begin CHARACTERISTIC NS_ABRNDDNR "Abtriebsdrehzahlschwelle Sofkt. bei RND bzw. DNR" VALUE 0x1D8A6C ZF_kw_ui16_S5_S3 2500 UMR_U_MIN_1_1_0_S5_S3 0 2500 /end CHARACTERISTIC
/begin CHARACTERISTIC NS_GENDSYNIAE_1 "Drehzahlschwelle Endebedingung Fuellausgleich 2. nichtkraftschliessende KZU" VALUE 0x1D8A8C ZF_kw_si16_S5_S3 16000 UMR_U_MIN_1_1_0_S5_S3 -8000 8000 /end CHARACTERISTIC
/begin CHARACTERISTIC NS_GENDSYNIAE_2 "Drehzahlschwelle Endebedingung Fuellausgleich 2. nichtkraftschliessende KZU" VALUE 0x1D8A8E ZF_kw_si16_S5_S3 16000 UMR_U_MIN_1_1_0_S5_S3 -8000 8000 /end CHARACTERISTIC
/begin CHARACTERISTIC NS_GENDSYNIAE_3 "Drehzahlschwelle Endebedingung Fuellausgleich 2. nichtkraftschliessende KZU" VALUE 0x1D8A90 ZF_kw_si16_S5_S3 16000 UMR_U_MIN_1_1_0_S5_S3 -8000 8000 /end CHARACTERISTIC
/begin CHARACTERISTIC NS_GENDSYNIAE_4 "Drehzahlschwelle Endebedingung Fuellausgleich 2. nichtkraftschliessende KZU" VALUE 0x1D8A92 ZF_kw_si16_S5_S3 16000 UMR_U_MIN_1_1_0_S5_S3 -8000 8000 /end CHARACTERISTIC
/begin CHARACTERISTIC NS_GENDSYNIAE_5 "Drehzahlschwelle Endebedingung Fuellausgleich 2. nichtkraftschliessende KZU" VALUE 0x1D8A94 ZF_kw_si16_S5_S3 16000 UMR_U_MIN_1_1_0_S5_S3 -8000 8000 /end CHARACTERISTIC
/begin CHARACTERISTIC NS_GENDSYNIAE_6 "Drehzahlschwelle Endebedingung Fuellausgleich 2. nichtkraftschliessende KZU" VALUE 0x1D8A96 ZF_kw_si16_S5_S3 16000 UMR_U_MIN_1_1_0_S5_S3 -8000 8000 /end CHARACTERISTIC
/begin CHARACTERISTIC NS_MOTRNDDNR "Motordrehzahlschwelle Sofkt. bei RND bzw. DNR" VALUE 0x1D8A6E ZF_kw_ui16_S5_S3 5000 UMR_U_MIN_1_1_0_S5_S3 0 5000 /end CHARACTERISTIC
/begin CHARACTERISTIC NS_TABBRRNDDNR "Turbinendrehzahlschwelle Abbruchgradient Sofkt. bei RND bzw. DNR" VALUE 0x1D8A70 ZF_kw_ui16_S5_S3 8160 UMR_U_MIN_1_1_0_S5_S3 0 8160 /end CHARACTERISTIC
/begin CHARACTERISTIC PG_KABABBRD2NR "Druckgradient Abbruch Kuppl. B Sofkt. KAB bei R-N-D" VALUE 0x1D8A88 ZF_kw_si16_S5_S3 31900 UMR_MBAR_SEC_1_1_0_S5_S3 -32000 -100 /end CHARACTERISTIC
/begin CHARACTERISTIC PG_KABABBRDNR "Druckgradient Abbruch Kuppl. B Sofkt. KAB bei R-N-D" VALUE 0x1D8A78 ZF_kw_si16_S5_S3 31900 UMR_MBAR_SEC_1_1_0_S5_S3 -32000 -100 /end CHARACTERISTIC
/begin CHARACTERISTIC PG_KABABBRDNRV2 "Druckgradient Abbruch Kuppl. B Sofkt. KAB bei R-N-D" VALUE 0x1D8A80 ZF_kw_si16_S5_S3 31900 UMR_MBAR_SEC_1_1_0_S5_S3 -32000 -100 /end CHARACTERISTIC
/begin CHARACTERISTIC PG_KABABBRRND "Druckgradient Abbruch Kuppl. B Sofkt. KAB bei R-N-D" VALUE 0x1D8A7C ZF_kw_si16_S5_S3 31900 UMR_MBAR_SEC_1_1_0_S5_S3 -32000 -100 /end CHARACTERISTIC
/begin CHARACTERISTIC PG_KABABBRRNDV2 "Druckgradient Abbruch Kuppl. B Sofkt. KAB bei R-N-D" VALUE 0x1D8A84 ZF_kw_si16_S5_S3 31900 UMR_MBAR_SEC_1_1_0_S5_S3 -32000 -100 /end CHARACTERISTIC
/begin CHARACTERISTIC PG_KABD2NR "Druckgradient Kuppl. B KAB bei R-N-D" VALUE 0x1D8A86 ZF_kw_si16_S5_S3 31900 UMR_MBAR_SEC_1_1_0_S5_S3 -32000 -100 /end CHARACTERISTIC
/begin CHARACTERISTIC PG_KABDNR "Druckgradient Kuppl. B KAB bei R-N-D" VALUE 0x1D8A76 ZF_kw_si16_S5_S3 31900 UMR_MBAR_SEC_1_1_0_S5_S3 -32000 -100 /end CHARACTERISTIC
/begin CHARACTERISTIC PG_KABDNRV2 "Druckgradient Kuppl. B KAB bei R-N-D" VALUE 0x1D8A7E ZF_kw_si16_S5_S3 31900 UMR_MBAR_SEC_1_1_0_S5_S3 -32000 -100 /end CHARACTERISTIC
/begin CHARACTERISTIC PG_KABRND "Druckgradient Kuppl. B KAB bei R-N-D" VALUE 0x1D8A7A ZF_kw_si16_S5_S3 31900 UMR_MBAR_SEC_1_1_0_S5_S3 -32000 -100 /end CHARACTERISTIC
/begin CHARACTERISTIC PG_KABRNDV2 "Druckgradient Kuppl. B KAB bei R-N-D" VALUE 0x1D8A82 ZF_kw_si16_S5_S3 31900 UMR_MBAR_SEC_1_1_0_S5_S3 -32000 -100 /end CHARACTERISTIC
/begin CHARACTERISTIC PG_OFV1_1 "Gradient Offset Fuelldruck 1.nicht kraftschl. Kup." VALUE 0x1D7A56 ZF_kw_ui8_S5_S3 5 UMR_BAR_SEC_1_10_0_S5_S3 0 5 /end CHARACTERISTIC
/begin CHARACTERISTIC PG_OFV1_2 "Gradient Offset Fuelldruck 1.nicht kraftschl. Kup." VALUE 0x1D7A5E ZF_kw_ui8_S5_S3 5 UMR_BAR_SEC_1_10_0_S5_S3 0 5 /end CHARACTERISTIC
/begin CHARACTERISTIC PG_OFV1_3 "Gradient Offset Fuelldruck 1.nicht kraftschl. Kup." VALUE 0x1D7A66 ZF_kw_ui8_S5_S3 5 UMR_BAR_SEC_1_10_0_S5_S3 0 5 /end CHARACTERISTIC
/begin CHARACTERISTIC PG_OFV1_4 "Gradient Offset Fuelldruck 1.nicht kraftschl. Kup." VALUE 0x1D7A6E ZF_kw_ui8_S5_S3 5 UMR_BAR_SEC_1_10_0_S5_S3 0 5 /end CHARACTERISTIC
/begin CHARACTERISTIC PG_OFV1_5 "Gradient Offset Fuelldruck 1.nicht kraftschl. Kup." VALUE 0x1D7A76 ZF_kw_ui8_S5_S3 5 UMR_BAR_SEC_1_10_0_S5_S3 0 5 /end CHARACTERISTIC
/begin CHARACTERISTIC PG_OFV1_6 "Gradient Offset Fuelldruck 1.nicht kraftschl. Kup." VALUE 0x1D7A7E ZF_kw_ui8_S5_S3 5 UMR_BAR_SEC_1_10_0_S5_S3 0 5 /end CHARACTERISTIC
/begin CHARACTERISTIC PO_NKLKPLD2NR "Druckoffset auf NKL Element des vorherigen GA auf minimalen Fuelldruck bei D2NR" VALUE 0x1D8A74 ZF_kw_si16_S5_S3 12.75 UMR_BAR__1_1000_0_S5_S3 0 12.75 /end CHARACTERISTIC
/begin CHARACTERISTIC PO_NKLKPLRND2 "Druckoffset auf NKL Element des vorherigen GA auf minimalen Fuelldruck bei RND2" VALUE 0x1D8A72 ZF_kw_si16_S5_S3 12.75 UMR_BAR__1_1000_0_S5_S3 0 12.75 /end CHARACTERISTIC
/begin CHARACTERISTIC TAB_SWI_POKZUFOL "Schalter für Entscheidung Druckoffset bei Folgesch." CURVE 0x1BEEE4 ZF_tab_ui8_S5_S3 2 UMR___1_1_0_S5_S3 0 2
 /begin AXIS_DESCR FIX_AXIS iSasZentr.iVorbereitend.iKzu.kup_kzu UMR___1_1_0_S5_S3 5 1 5 READ_ONLY FIX_AXIS_PAR_DIST 1 1 5 /end AXIS_DESCR
/end CHARACTERISTIC
/begin CHARACTERISTIC TO_TSYNHINSYNS21 "Zeitoffset nach Synchron für Dauer Haltephase in Syn. KAB" VALUE 0x1D7A29 ZF_kw_ui8_S5_S3 2540 UMR_MSEC__10_1_0_S5_S3 0 2540 /end CHARACTERISTIC
/begin CHARACTERISTIC TO_TSYNHINSYNS32 "Zeitoffset nach Synchron für Dauer Haltephase in Syn. KAB" VALUE 0x1D7A2B ZF_kw_ui8_S5_S3 2540 UMR_MSEC__10_1_0_S5_S3 0 2540 /end CHARACTERISTIC
/begin CHARACTERISTIC TO_TSYNHINSYNS43 "Zeitoffset nach Synchron für Dauer Haltephase in Syn. KAB" VALUE 0x1D7A2D ZF_kw_ui8_S5_S3 2540 UMR_MSEC__10_1_0_S5_S3 0 2540 /end CHARACTERISTIC
/begin CHARACTERISTIC TO_TSYNHINSYNS54 "Zeitoffset nach Synchron für Dauer Haltephase in Syn. KAB" VALUE 0x1D7A2F ZF_kw_ui8_S5_S3 2540 UMR_MSEC__10_1_0_S5_S3 0 2540 /end CHARACTERISTIC
/begin CHARACTERISTIC TO_TSYNHINSYNS65 "Zeitoffset nach Synchron für Dauer Haltephase in Syn. KAB" VALUE 0x1D7A31 ZF_kw_ui8_S5_S3 2540 UMR_MSEC__10_1_0_S5_S3 0 2540 /end CHARACTERISTIC
/begin CHARACTERISTIC TO_TSYNHINSYNS76 "Zeitoffset nach Synchron für Dauer Haltephase in Syn. KAB" VALUE 0x1D7A33 ZF_kw_ui8_S5_S3 2540 UMR_MSEC__10_1_0_S5_S3 0 2540 /end CHARACTERISTIC
/begin CHARACTERISTIC TO_TSYNHINSYNS87 "Zeitoffset nach Synchron für Dauer Haltephase in Syn. KAB" VALUE 0x1D7A35 ZF_kw_ui8_S5_S3 2540 UMR_MSEC__10_1_0_S5_S3 0 2540 /end CHARACTERISTIC
/begin CHARACTERISTIC TO_TSYNHINSYNSSP31 "Zeitoffset nach Synchron für Dauer Haltephase in Syn. KAB" VALUE 0x1D7A37 ZF_kw_ui8_S5_S3 2540 UMR_MSEC__10_1_0_S5_S3 0 2540 /end CHARACTERISTIC
/begin CHARACTERISTIC TO_TSYNHINSYNSSP42 "Zeitoffset nach Synchron für Dauer Haltephase in Syn. KAB" VALUE 0x1D7A39 ZF_kw_ui8_S5_S3 2540 UMR_MSEC__10_1_0_S5_S3 0 2540 /end CHARACTERISTIC
/begin CHARACTERISTIC TO_TSYNHINSYNSSP51 "Zeitoffset nach Synchron für Dauer Haltephase in Syn. KAB" VALUE 0x1D7A3B ZF_kw_ui8_S5_S3 2540 UMR_MSEC__10_1_0_S5_S3 0 2540 /end CHARACTERISTIC
/begin CHARACTERISTIC TO_TSYNHINSYNSSP53 "Zeitoffset nach Synchron für Dauer Haltephase in Syn. KAB" VALUE 0x1D7A3D ZF_kw_ui8_S5_S3 2540 UMR_MSEC__10_1_0_S5_S3 0 2540 /end CHARACTERISTIC
/begin CHARACTERISTIC TO_TSYNHINSYNSSP63 "Zeitoffset nach Synchron für Dauer Haltephase in Syn. KAB" VALUE 0x1D7A3F ZF_kw_ui8_S5_S3 2540 UMR_MSEC__10_1_0_S5_S3 0 2540 /end CHARACTERISTIC
/begin CHARACTERISTIC TO_TSYNHINSYNSSP64 "Zeitoffset nach Synchron für Dauer Haltephase in Syn. KAB" VALUE 0x1D7A41 ZF_kw_ui8_S5_S3 2540 UMR_MSEC__10_1_0_S5_S3 0 2540 /end CHARACTERISTIC
/begin CHARACTERISTIC TO_TSYNHINSYNSSP71 "Zeitoffset nach Synchron für Dauer Haltephase in Syn. KAB" VALUE 0x1D7A43 ZF_kw_ui8_S5_S3 2540 UMR_MSEC__10_1_0_S5_S3 0 2540 /end CHARACTERISTIC
/begin CHARACTERISTIC TO_TSYNHINSYNSSP75 "Zeitoffset nach Synchron für Dauer Haltephase in Syn. KAB" VALUE 0x1D7A45 ZF_kw_ui8_S5_S3 2540 UMR_MSEC__10_1_0_S5_S3 0 2540 /end CHARACTERISTIC
/begin CHARACTERISTIC TO_TSYNHINSYNSSP82 "Zeitoffset nach Synchron für Dauer Haltephase in Syn. KAB" VALUE 0x1D7A47 ZF_kw_ui8_S5_S3 2540 UMR_MSEC__10_1_0_S5_S3 0 2540 /end CHARACTERISTIC
/begin CHARACTERISTIC TO_TSYNHINSYNSSP84 "Zeitoffset nach Synchron für Dauer Haltephase in Syn. KAB" VALUE 0x1D7A4B ZF_kw_ui8_S5_S3 2540 UMR_MSEC__10_1_0_S5_S3 0 2540 /end CHARACTERISTIC
/begin CHARACTERISTIC TO_TSYNHINSYNSSP86 "Zeitoffset nach Synchron für Dauer Haltephase in Syn. KAB" VALUE 0x1D7A49 ZF_kw_ui8_S5_S3 2540 UMR_MSEC__10_1_0_S5_S3 0 2540 /end CHARACTERISTIC
/begin CHARACTERISTIC T_FFUELLRED_1 "Fuellzeit reduzierte Befüllung" VALUE 0x1D7A58 ZF_kw_ui8_S5_S3 2540 UMR_MSEC__10_1_0_S5_S3 0 2540 /end CHARACTERISTIC
/begin CHARACTERISTIC T_FFUELLRED_2 "Fuellzeit reduzierte Befüllung" VALUE 0x1D7A60 ZF_kw_ui8_S5_S3 2540 UMR_MSEC__10_1_0_S5_S3 0 2540 /end CHARACTERISTIC
/begin CHARACTERISTIC T_FFUELLRED_3 "Fuellzeit reduzierte Befüllung" VALUE 0x1D7A68 ZF_kw_ui8_S5_S3 2540 UMR_MSEC__10_1_0_S5_S3 0 2540 /end CHARACTERISTIC
/begin CHARACTERISTIC T_FFUELLRED_4 "Fuellzeit reduzierte Befüllung" VALUE 0x1D7A70 ZF_kw_ui8_S5_S3 2540 UMR_MSEC__10_1_0_S5_S3 0 2540 /end CHARACTERISTIC
/begin CHARACTERISTIC T_FFUELLRED_5 "Fuellzeit reduzierte Befüllung" VALUE 0x1D7A78 ZF_kw_ui8_S5_S3 2540 UMR_MSEC__10_1_0_S5_S3 0 2540 /end CHARACTERISTIC
/begin CHARACTERISTIC T_FFUELLRED_6 "Fuellzeit reduzierte Befüllung" VALUE 0x1D7A80 ZF_kw_ui8_S5_S3 2540 UMR_MSEC__10_1_0_S5_S3 0 2540 /end CHARACTERISTIC
/begin CHARACTERISTIC T_HINSYNSPORT84 "Zeit fuer Ende Haltephase in Synchron KZU/KAB" VALUE 0x1D7A25 ZF_kw_ui8_S5_S3 2540 UMR_MSEC__10_1_0_S5_S3 0 2540 /end CHARACTERISTIC
/begin CHARACTERISTIC T_HINSYNSPORT86 "Zeit fuer Ende Haltephase in Synchron KZU/KAB" VALUE 0x1D7A28 ZF_kw_ui8_S5_S3 2540 UMR_MSEC__10_1_0_S5_S3 0 2540 /end CHARACTERISTIC
/begin CHARACTERISTIC T_HINSYNSPORT87 "Zeit fuer Ende Haltephase in Synchron KZU/KAB" VALUE 0x1D7A07 ZF_kw_ui8_S5_S3 2540 UMR_MSEC__10_1_0_S5_S3 0 2540 /end CHARACTERISTIC
/begin CHARACTERISTIC T_SYNKABWS21 "Zeit vor sync. Ende Schaltdruck KAB bei Weiterschaltung" VALUE 0x1D7A2A ZF_kw_ui8_S5_S3 1280 UMR_MSEC__10_1_M128_S5_S3 -1280 0 /end CHARACTERISTIC
/begin CHARACTERISTIC T_SYNKABWS32 "Zeit vor sync. Ende Schaltdruck KAB bei Weiterschaltung" VALUE 0x1D7A2C ZF_kw_ui8_S5_S3 1280 UMR_MSEC__10_1_M128_S5_S3 -1280 0 /end CHARACTERISTIC
/begin CHARACTERISTIC T_SYNKABWS43 "Zeit vor sync. Ende Schaltdruck KAB bei Weiterschaltung" VALUE 0x1D7A2E ZF_kw_ui8_S5_S3 1280 UMR_MSEC__10_1_M128_S5_S3 -1280 0 /end CHARACTERISTIC
/begin CHARACTERISTIC T_SYNKABWS54 "Zeit vor sync. Ende Schaltdruck KAB bei Weiterschaltung" VALUE 0x1D7A30 ZF_kw_ui8_S5_S3 1280 UMR_MSEC__10_1_M128_S5_S3 -1280 0 /end CHARACTERISTIC
/begin CHARACTERISTIC T_SYNKABWS65 "Zeit vor sync. Ende Schaltdruck KAB bei Weiterschaltung" VALUE 0x1D7A32 ZF_kw_ui8_S5_S3 1280 UMR_MSEC__10_1_M128_S5_S3 -1280 0 /end CHARACTERISTIC
/begin CHARACTERISTIC T_SYNKABWS76 "Zeit vor sync. Ende Schaltdruck KAB bei Weiterschaltung" VALUE 0x1D7A34 ZF_kw_ui8_S5_S3 1280 UMR_MSEC__10_1_M128_S5_S3 -1280 0 /end CHARACTERISTIC
/begin CHARACTERISTIC T_SYNKABWS87 "Zeit vor sync. Ende Schaltdruck KAB bei Weiterschaltung" VALUE 0x1D7A36 ZF_kw_ui8_S5_S3 1280 UMR_MSEC__10_1_M128_S5_S3 -1280 0 /end CHARACTERISTIC
/begin CHARACTERISTIC T_SYNKABWSSP31 "Zeit vor sync. Ende Schaltdruck KAB bei Weiterschaltung" VALUE 0x1D7A38 ZF_kw_ui8_S5_S3 1280 UMR_MSEC__10_1_M128_S5_S3 -1280 0 /end CHARACTERISTIC
/begin CHARACTERISTIC T_SYNKABWSSP42 "Zeit vor sync. Ende Schaltdruck KAB bei Weiterschaltung" VALUE 0x1D7A3A ZF_kw_ui8_S5_S3 1280 UMR_MSEC__10_1_M128_S5_S3 -1280 0 /end CHARACTERISTIC
/begin CHARACTERISTIC T_SYNKABWSSP51 "Zeit vor sync. Ende Schaltdruck KAB bei Weiterschaltung" VALUE 0x1D7A3C ZF_kw_ui8_S5_S3 1280 UMR_MSEC__10_1_M128_S5_S3 -1280 0 /end CHARACTERISTIC
/begin CHARACTERISTIC T_SYNKABWSSP53 "Zeit vor sync. Ende Schaltdruck KAB bei Weiterschaltung" VALUE 0x1D7A3E ZF_kw_ui8_S5_S3 1280 UMR_MSEC__10_1_M128_S5_S3 -1280 0 /end CHARACTERISTIC
/begin CHARACTERISTIC T_SYNKABWSSP63 "Zeit vor sync. Ende Schaltdruck KAB bei Weiterschaltung" VALUE 0x1D7A40 ZF_kw_ui8_S5_S3 1280 UMR_MSEC__10_1_M128_S5_S3 -1280 0 /end CHARACTERISTIC
/begin CHARACTERISTIC T_SYNKABWSSP64 "Zeit vor sync. Ende Schaltdruck KAB bei Weiterschaltung" VALUE 0x1D7A42 ZF_kw_ui8_S5_S3 1280 UMR_MSEC__10_1_M128_S5_S3 -1280 0 /end CHARACTERISTIC
/begin CHARACTERISTIC T_SYNKABWSSP71 "Zeit vor sync. Ende Schaltdruck KAB bei Weiterschaltung" VALUE 0x1D7A44 ZF_kw_ui8_S5_S3 1280 UMR_MSEC__10_1_M128_S5_S3 -1280 0 /end CHARACTERISTIC
/begin CHARACTERISTIC T_SYNKABWSSP75 "Zeit vor sync. Ende Schaltdruck KAB bei Weiterschaltung" VALUE 0x1D7A46 ZF_kw_ui8_S5_S3 1280 UMR_MSEC__10_1_M128_S5_S3 -1280 0 /end CHARACTERISTIC
/begin CHARACTERISTIC T_SYNKABWSSP82 "Zeit vor sync. Ende Schaltdruck KAB bei Weiterschaltung" VALUE 0x1D7A48 ZF_kw_ui8_S5_S3 1280 UMR_MSEC__10_1_M128_S5_S3 -1280 0 /end CHARACTERISTIC
/begin CHARACTERISTIC T_SYNKABWSSP84 "Zeit vor sync. Ende Schaltdruck KAB bei Weiterschaltung" VALUE 0x1D7A4C ZF_kw_ui8_S5_S3 1280 UMR_MSEC__10_1_M128_S5_S3 -1280 0 /end CHARACTERISTIC
/begin CHARACTERISTIC T_SYNKABWSSP86 "Zeit vor sync. Ende Schaltdruck KAB bei Weiterschaltung" VALUE 0x1D7A4A ZF_kw_ui8_S5_S3 1280 UMR_MSEC__10_1_M128_S5_S3 -1280 0 /end CHARACTERISTIC
/begin CHARACTERISTIC T_SYNRAKZU_1 "Zeit vor sync. Ende Schaltdruck/Start 3. Rampe KZU" VALUE 0x1D7A5A ZF_kw_ui8_S5_S3 1280 UMR_MSEC__10_1_M128_S5_S3 -1280 0 /end CHARACTERISTIC
/begin CHARACTERISTIC T_SYNRAKZU_2 "Zeit vor sync. Ende Schaltdruck/Start 3. Rampe KZU" VALUE 0x1D7A62 ZF_kw_ui8_S5_S3 1280 UMR_MSEC__10_1_M128_S5_S3 -1280 0 /end CHARACTERISTIC
/begin CHARACTERISTIC T_SYNRAKZU_3 "Zeit vor sync. Ende Schaltdruck/Start 3. Rampe KZU" VALUE 0x1D7A6A ZF_kw_ui8_S5_S3 1280 UMR_MSEC__10_1_M128_S5_S3 -1280 0 /end CHARACTERISTIC
/begin CHARACTERISTIC T_SYNRAKZU_4 "Zeit vor sync. Ende Schaltdruck/Start 3. Rampe KZU" VALUE 0x1D7A72 ZF_kw_ui8_S5_S3 1280 UMR_MSEC__10_1_M128_S5_S3 -1280 0 /end CHARACTERISTIC
/begin CHARACTERISTIC T_SYNRAKZU_5 "Zeit vor sync. Ende Schaltdruck/Start 3. Rampe KZU" VALUE 0x1D7A7A ZF_kw_ui8_S5_S3 1280 UMR_MSEC__10_1_M128_S5_S3 -1280 0 /end CHARACTERISTIC
/begin CHARACTERISTIC T_SYNRAKZU_6 "Zeit vor sync. Ende Schaltdruck/Start 3. Rampe KZU" VALUE 0x1D7A82 ZF_kw_ui8_S5_S3 1280 UMR_MSEC__10_1_M128_S5_S3 -1280 0 /end CHARACTERISTIC
/begin CHARACTERISTIC T_SYN_1 "Verweilzeit in Synchron zum Start Max.Rampe" VALUE 0x1D7A59 ZF_kw_ui8_S5_S3 2540 UMR_MSEC__10_1_0_S5_S3 0 2540 /end CHARACTERISTIC
/begin CHARACTERISTIC T_SYN_2 "Verweilzeit in Synchron zum Start Max.Rampe" VALUE 0x1D7A61 ZF_kw_ui8_S5_S3 2540 UMR_MSEC__10_1_0_S5_S3 0 2540 /end CHARACTERISTIC
/begin CHARACTERISTIC T_SYN_3 "Verweilzeit in Synchron zum Start Max.Rampe" VALUE 0x1D7A69 ZF_kw_ui8_S5_S3 2540 UMR_MSEC__10_1_0_S5_S3 0 2540 /end CHARACTERISTIC
/begin CHARACTERISTIC T_SYN_4 "Verweilzeit in Synchron zum Start Max.Rampe" VALUE 0x1D7A71 ZF_kw_ui8_S5_S3 2540 UMR_MSEC__10_1_0_S5_S3 0 2540 /end CHARACTERISTIC
/begin CHARACTERISTIC T_SYN_5 "Verweilzeit in Synchron zum Start Max.Rampe" VALUE 0x1D7A79 ZF_kw_ui8_S5_S3 2540 UMR_MSEC__10_1_0_S5_S3 0 2540 /end CHARACTERISTIC
/begin CHARACTERISTIC T_SYN_6 "Verweilzeit in Synchron zum Start Max.Rampe" VALUE 0x1D7A81 ZF_kw_ui8_S5_S3 2540 UMR_MSEC__10_1_0_S5_S3 0 2540 /end CHARACTERISTIC
/begin CHARACTERISTIC T_VGEIAE_1 "Verzoegerung Drehzahlschwelle GE Hybrid" VALUE 0x1D7A5D ZF_kw_ui8_S5_S3 2540 UMR_MSEC__10_1_0_S5_S3 0 2540 /end CHARACTERISTIC
/begin CHARACTERISTIC T_VGEIAE_2 "Verzoegerung Drehzahlschwelle GE Hybrid" VALUE 0x1D7A65 ZF_kw_ui8_S5_S3 2540 UMR_MSEC__10_1_0_S5_S3 0 2540 /end CHARACTERISTIC
/begin CHARACTERISTIC T_VGEIAE_3 "Verzoegerung Drehzahlschwelle GE Hybrid" VALUE 0x1D7A6D ZF_kw_ui8_S5_S3 2540 UMR_MSEC__10_1_0_S5_S3 0 2540 /end CHARACTERISTIC
/begin CHARACTERISTIC T_VGEIAE_4 "Verzoegerung Drehzahlschwelle GE Hybrid" VALUE 0x1D7A75 ZF_kw_ui8_S5_S3 2540 UMR_MSEC__10_1_0_S5_S3 0 2540 /end CHARACTERISTIC
/begin CHARACTERISTIC T_VGEIAE_5 "Verzoegerung Drehzahlschwelle GE Hybrid" VALUE 0x1D7A7D ZF_kw_ui8_S5_S3 2540 UMR_MSEC__10_1_0_S5_S3 0 2540 /end CHARACTERISTIC
/begin CHARACTERISTIC T_VGEIAE_6 "Verzoegerung Drehzahlschwelle GE Hybrid" VALUE 0x1D7A85 ZF_kw_ui8_S5_S3 2540 UMR_MSEC__10_1_0_S5_S3 0 2540 /end CHARACTERISTIC
/begin CHARACTERISTIC T_VKZUV2_1 "Verzoegerungszeit 2. nicht kraftschliessende KZU" VALUE 0x1D7A57 ZF_kw_ui8_S5_S3 2540 UMR_MSEC__10_1_0_S5_S3 0 2540 /end CHARACTERISTIC
/begin CHARACTERISTIC T_VKZUV2_2 "Verzoegerungszeit 2. nicht kraftschliessende KZU" VALUE 0x1D7A5F ZF_kw_ui8_S5_S3 2540 UMR_MSEC__10_1_0_S5_S3 0 2540 /end CHARACTERISTIC
/begin CHARACTERISTIC T_VKZUV2_3 "Verzoegerungszeit 2. nicht kraftschliessende KZU" VALUE 0x1D7A67 ZF_kw_ui8_S5_S3 2540 UMR_MSEC__10_1_0_S5_S3 0 2540 /end CHARACTERISTIC
/begin CHARACTERISTIC T_VKZUV2_4 "Verzoegerungszeit 2. nicht kraftschliessende KZU" VALUE 0x1D7A6F ZF_kw_ui8_S5_S3 2540 UMR_MSEC__10_1_0_S5_S3 0 2540 /end CHARACTERISTIC
/begin CHARACTERISTIC T_VKZUV2_5 "Verzoegerungszeit 2. nicht kraftschliessende KZU" VALUE 0x1D7A77 ZF_kw_ui8_S5_S3 2540 UMR_MSEC__10_1_0_S5_S3 0 2540 /end CHARACTERISTIC
/begin CHARACTERISTIC T_VKZUV2_6 "Verzoegerungszeit 2. nicht kraftschliessende KZU" VALUE 0x1D7A7F ZF_kw_ui8_S5_S3 2540 UMR_MSEC__10_1_0_S5_S3 0 2540 /end CHARACTERISTIC
/begin FUNCTION jSasKabRSP384_Fktn "Applikationesgroessen Instanz jSasKabRSP384"
 /begin DEF_CHARACTERISTIC F_PRAHKABSPORT84 F_TRAHKABSPORT84 KF_PKABSPORT84 KF_POHINSYNKABSPORT84 KF_TOHKABMTNTSPORT84 KF_TVKABMTNMOTRSSPORT84 KL_POHKABSPORT84 KL_TRAHKABSPORT84 KL_TRAMTHINSYNKABSPORT84 KL_TSYNMTKABSPORT84 T_HINSYNSPORT84 /end DEF_CHARACTERISTIC
/end FUNCTION
/begin FUNCTION jSasKabRSP386_Fktn "Applikationesgroessen Instanz jSasKabRSP386"
 /begin DEF_CHARACTERISTIC F_PRAHKABSPORT86 F_TRAHKABSPORT86 KF_PKABSPORT86 KF_POHINSYNKABSPORT86 KF_TOHKABMTNTSPORT86 KF_TVKABMTNMOTRSSPORT86 KL_POHKABSPORT86 KL_TRAHKABSPORT86 KL_TRAMTHINSYNKABSPORT86 KL_TSYNMTKABSPORT86 T_HINSYNSPORT86 /end DEF_CHARACTERISTIC
/end FUNCTION
/begin FUNCTION jSasKabRSP387_Fktn "Applikationesgroessen Instanz jSasKabRSP387"
 /begin DEF_CHARACTERISTIC F_PRAHKABSPORT87 F_TRAHKABSPORT87 KF_PKABSPORT87 KF_POHINSYNKABSPORT87 KF_TOHKABMTNTSPORT87 KF_TVKABMTNMOTRSSPORT87 KL_POHKABSPORT87 KL_TRAHKABSPORT87 KL_TRAMTHINSYNKABSPORT87 KL_TSYNMTKABSPORT87 T_HINSYNSPORT87 /end DEF_CHARACTERISTIC
/end FUNCTION
/begin FUNCTION jSasKabRSS21_Fktn "Applikationesgroessen Instanz jSasKabRSS21"
 /begin DEF_CHARACTERISTIC KF_TOHKABK0MTNT21 KF_TVKABK0MTNMOTRS21 KL_FPOCGHINSYNKAB21 KL_PGOKAB21 KL_PGRASYNKAB21 KL_PGRASYNKABWS21 KL_POKABCG21 KL_POKABMDMOTSOLL21 KL_POKABNGAB21 KL_POZUSTARTK021 KL_TRAZUSTARTK021 TO_TSYNHINSYNS21 T_SYNKABWS21 /end DEF_CHARACTERISTIC
/end FUNCTION
/begin FUNCTION jSasKabRSS31_Fktn "Applikationesgroessen Instanz jSasKabRSS31"
 /begin DEF_CHARACTERISTIC KF_TOHKABK0MTNTSP31 KF_TVKABK0MTNMOTRSSP31 KL_FPOCGHINSYNKABSP31 KL_PGOKABSP31 KL_PGRASYNKABSP31 KL_PGRASYNKABWSSP31 KL_POKABCGSP31 KL_POKABMDMOTSOLLSP31 KL_POKABNGABSP31 KL_POZUSTARTK0SP31 KL_TRAZUSTARTK0SP31 TO_TSYNHINSYNSSP31 T_SYNKABWSSP31 /end DEF_CHARACTERISTIC
/end FUNCTION
/begin FUNCTION jSasKabRSS32_Fktn "Applikationesgroessen Instanz jSasKabRSS32"
 /begin DEF_CHARACTERISTIC KF_TOHKABK0MTNT32 KF_TVKABK0MTNMOTRS32 KL_FPOCGHINSYNKAB32 KL_PGOKAB32 KL_PGRASYNKAB32 KL_PGRASYNKABWS32 KL_POKABCG32 KL_POKABMDMOTSOLL32 KL_POKABNGAB32 KL_POZUSTARTK032 KL_TRAZUSTARTK032 TO_TSYNHINSYNS32 T_SYNKABWS32 /end DEF_CHARACTERISTIC
/end FUNCTION
/begin FUNCTION jSasKabRSS42_Fktn "Applikationesgroessen Instanz jSasKabRSS42"
 /begin DEF_CHARACTERISTIC KF_TOHKABK0MTNTSP42 KF_TVKABK0MTNMOTRSSP42 KL_FPOCGHINSYNKABSP42 KL_PGOKABSP42 KL_PGRASYNKABSP42 KL_PGRASYNKABWSSP42 KL_POKABCGSP42 KL_POKABMDMOTSOLLSP42 KL_POKABNGABSP42 KL_POZUSTARTK0SP42 KL_TRAZUSTARTK0SP42 TO_TSYNHINSYNSSP42 T_SYNKABWSSP42 /end DEF_CHARACTERISTIC
/end FUNCTION
/begin FUNCTION jSasKabRSS43_Fktn "Applikationesgroessen Instanz jSasKabRSS43"
 /begin DEF_CHARACTERISTIC KF_TOHKABK0MTNT43 KF_TVKABK0MTNMOTRS43 KL_FPOCGHINSYNKAB43 KL_PGOKAB43 KL_PGRASYNKAB43 KL_PGRASYNKABWS43 KL_POKABCG43 KL_POKABMDMOTSOLL43 KL_POKABNGAB43 KL_POZUSTARTK043 KL_TRAZUSTARTK043 TO_TSYNHINSYNS43 T_SYNKABWS43 /end DEF_CHARACTERISTIC
/end FUNCTION
/begin FUNCTION jSasKabRSS51_Fktn "Applikationesgroessen Instanz jSasKabRSS51"
 /begin DEF_CHARACTERISTIC KF_TOHKABK0MTNTSP51 KF_TVKABK0MTNMOTRSSP51 KL_FPOCGHINSYNKABSP51 KL_PGOKABSP51 KL_PGRASYNKABSP51 KL_PGRASYNKABWSSP51 KL_POKABCGSP51 KL_POKABMDMOTSOLLSP51 KL_POKABNGABSP51 KL_POZUSTARTK0SP51 KL_TRAZUSTARTK0SP51 TO_TSYNHINSYNSSP51 T_SYNKABWSSP51 /end DEF_CHARACTERISTIC
/end FUNCTION
/begin FUNCTION jSasKabRSS53_Fktn "Applikationesgroessen Instanz jSasKabRSS53"
 /begin DEF_CHARACTERISTIC KF_TOHKABK0MTNTSP53 KF_TVKABK0MTNMOTRSSP53 KL_FPOCGHINSYNKABSP53 KL_PGOKABSP53 KL_PGRASYNKABSP53 KL_PGRASYNKABWSSP53 KL_POKABCGSP53 KL_POKABMDMOTSOLLSP53 KL_POKABNGABSP53 KL_POZUSTARTK0SP53 KL_TRAZUSTARTK0SP53 TO_TSYNHINSYNSSP53 T_SYNKABWSSP53 /end DEF_CHARACTERISTIC
/end FUNCTION
/begin FUNCTION jSasKabRSS54_Fktn "Applikationesgroessen Instanz jSasKabRSS54"
 /begin DEF_CHARACTERISTIC KF_TOHKABK0MTNT54 KF_TVKABK0MTNMOTRS54 KL_FPOCGHINSYNKAB54 KL_PGOKAB54 KL_PGRASYNKAB54 KL_PGRASYNKABWS54 KL_POKABCG54 KL_POKABMDMOTSOLL54 KL_POKABNGAB54 KL_POZUSTARTK054 KL_TRAZUSTARTK054 TO_TSYNHINSYNS54 T_SYNKABWS54 /end DEF_CHARACTERISTIC
/end FUNCTION
/begin FUNCTION jSasKabRSS63_Fktn "Applikationesgroessen Instanz jSasKabRSS63"
 /begin DEF_CHARACTERISTIC KF_TOHKABK0MTNTSP63 KF_TVKABK0MTNMOTRSSP63 KL_FPOCGHINSYNKABSP63 KL_PGOKABSP63 KL_PGRASYNKABSP63 KL_PGRASYNKABWSSP63 KL_POKABCGSP63 KL_POKABMDMOTSOLLSP63 KL_POKABNGABSP63 KL_POZUSTARTK0SP63 KL_TRAZUSTARTK0SP63 TO_TSYNHINSYNSSP63 T_SYNKABWSSP63 /end DEF_CHARACTERISTIC
/end FUNCTION
/begin FUNCTION jSasKabRSS64_Fktn "Applikationesgroessen Instanz jSasKabRSS64"
 /begin DEF_CHARACTERISTIC KF_TOHKABK0MTNTSP64 KF_TVKABK0MTNMOTRSSP64 KL_FPOCGHINSYNKABSP64 KL_PGOKABSP64 KL_PGRASYNKABSP64 KL_PGRASYNKABWSSP64 KL_POKABCGSP64 KL_POKABMDMOTSOLLSP64 KL_POKABNGABSP64 KL_POZUSTARTK0SP64 KL_TRAZUSTARTK0SP64 TO_TSYNHINSYNSSP64 T_SYNKABWSSP64 /end DEF_CHARACTERISTIC
/end FUNCTION
/begin FUNCTION jSasKabRSS65_Fktn "Applikationesgroessen Instanz jSasKabRSS65"
 /begin DEF_CHARACTERISTIC KF_TOHKABK0MTNT65 KF_TVKABK0MTNMOTRS65 KL_FPOCGHINSYNKAB65 KL_PGOKAB65 KL_PGRASYNKAB65 KL_PGRASYNKABWS65 KL_POKABCG65 KL_POKABMDMOTSOLL65 KL_POKABNGAB65 KL_POZUSTARTK065 KL_TRAZUSTARTK065 TO_TSYNHINSYNS65 T_SYNKABWS65 /end DEF_CHARACTERISTIC
/end FUNCTION
/begin FUNCTION jSasKabRSS71_Fktn "Applikationesgroessen Instanz jSasKabRSS71"
 /begin DEF_CHARACTERISTIC KF_TOHKABK0MTNTSP71 KF_TVKABK0MTNMOTRSSP71 KL_FPOCGHINSYNKABSP71 KL_PGOKABSP71 KL_PGRASYNKABSP71 KL_PGRASYNKABWSSP71 KL_POKABCGSP71 KL_POKABMDMOTSOLLSP71 KL_POKABNGABSP71 KL_POZUSTARTK0SP71 KL_TRAZUSTARTK0SP71 TO_TSYNHINSYNSSP71 T_SYNKABWSSP71 /end DEF_CHARACTERISTIC
/end FUNCTION
/begin FUNCTION jSasKabRSS75_Fktn "Applikationesgroessen Instanz jSasKabRSS75"
 /begin DEF_CHARACTERISTIC KF_TOHKABK0MTNTSP75 KF_TVKABK0MTNMOTRSSP75 KL_FPOCGHINSYNKABSP75 KL_PGOKABSP75 KL_PGRASYNKABSP75 KL_PGRASYNKABWSSP75 KL_POKABCGSP75 KL_POKABMDMOTSOLLSP75 KL_POKABNGABSP75 KL_POZUSTARTK0SP75 KL_TRAZUSTARTK0SP75 TO_TSYNHINSYNSSP75 T_SYNKABWSSP75 /end DEF_CHARACTERISTIC
/end FUNCTION
/begin FUNCTION jSasKabRSS76_Fktn "Applikationesgroessen Instanz jSasKabRSS76"
 /begin DEF_CHARACTERISTIC KF_TOHKABK0MTNT76 KF_TVKABK0MTNMOTRS76 KL_FPOCGHINSYNKAB76 KL_PGOKAB76 KL_PGRASYNKAB76 KL_PGRASYNKABWS76 KL_POKABCG76 KL_POKABMDMOTSOLL76 KL_POKABNGAB76 KL_POZUSTARTK076 KL_TRAZUSTARTK076 TO_TSYNHINSYNS76 T_SYNKABWS76 /end DEF_CHARACTERISTIC
/end FUNCTION
/begin FUNCTION jSasKabRSS82_Fktn "Applikationesgroessen Instanz jSasKabRSS82"
 /begin DEF_CHARACTERISTIC KF_TOHKABK0MTNTSP82 KF_TVKABK0MTNMOTRSSP82 KL_FPOCGHINSYNKABSP82 KL_PGOKABSP82 KL_PGRASYNKABSP82 KL_PGRASYNKABWSSP82 KL_POKABCGSP82 KL_POKABMDMOTSOLLSP82 KL_POKABNGABSP82 KL_POZUSTARTK0SP82 KL_TRAZUSTARTK0SP82 TO_TSYNHINSYNSSP82 T_SYNKABWSSP82 /end DEF_CHARACTERISTIC
/end FUNCTION
/begin FUNCTION jSasKabRSS84_Fktn "Applikationesgroessen Instanz jSasKabRSS84"
 /begin DEF_CHARACTERISTIC KF_TOHKABK0MTNTSP84 KF_TVKABK0MTNMOTRSSP84 KL_FPOCGHINSYNKABSP84 KL_PGOKABSP84 KL_PGRASYNKABSP84 KL_PGRASYNKABWSSP84 KL_POKABCGSP84 KL_POKABMDMOTSOLLSP84 KL_POKABNGABSP84 KL_POZUSTARTK0SP84 KL_TRAZUSTARTK0SP84 TO_TSYNHINSYNSSP84 T_SYNKABWSSP84 /end DEF_CHARACTERISTIC
/end FUNCTION
/begin FUNCTION jSasKabRSS86_Fktn "Applikationesgroessen Instanz jSasKabRSS86"
 /begin DEF_CHARACTERISTIC KF_TOHKABK0MTNTSP86 KF_TVKABK0MTNMOTRSSP86 KL_FPOCGHINSYNKABSP86 KL_PGOKABSP86 KL_PGRASYNKABSP86 KL_PGRASYNKABWSSP86 KL_POKABCGSP86 KL_POKABMDMOTSOLLSP86 KL_POKABNGABSP86 KL_POZUSTARTK0SP86 KL_TRAZUSTARTK0SP86 TO_TSYNHINSYNSSP86 T_SYNKABWSSP86 /end DEF_CHARACTERISTIC
/end FUNCTION
/begin FUNCTION jSasKabRSS87_Fktn "Applikationesgroessen Instanz jSasKabRSS87"
 /begin DEF_CHARACTERISTIC KF_TOHKABK0MTNT87 KF_TVKABK0MTNMOTRS87 KL_FPOCGHINSYNKAB87 KL_PGOKAB87 KL_PGRASYNKAB87 KL_PGRASYNKABWS87 KL_POKABCG87 KL_POKABMDMOTSOLL87 KL_POKABNGAB87 KL_POZUSTARTK087 KL_TRAZUSTARTK087 TO_TSYNHINSYNS87 T_SYNKABWS87 /end DEF_CHARACTERISTIC
/end FUNCTION
/begin FUNCTION jSasKflwe_Fktn "Applikationesgroessen Instanz jSasKflwe"
 /begin DEF_CHARACTERISTIC DKIS_RNDDNR NS_ABRNDDNR NS_MOTRNDDNR NS_TABBRRNDDNR PO_NKLKPLD2NR PO_NKLKPLRND2 /end DEF_CHARACTERISTIC
/end FUNCTION
/begin FUNCTION jSasKflweWD2NR_Fktn "Applikationesgroessen Instanz jSasKflweWD2NR" /begin DEF_CHARACTERISTIC KF_PKABNDNMOTNTCGD2NR PG_KABABBRD2NR PG_KABD2NR /end DEF_CHARACTERISTIC /end FUNCTION
/begin FUNCTION jSasKflweWDNR_Fktn "Applikationesgroessen Instanz jSasKflweWDNR" /begin DEF_CHARACTERISTIC KF_PKABNDNMOTNTCGDNR PG_KABABBRDNR PG_KABDNR /end DEF_CHARACTERISTIC /end FUNCTION
/begin FUNCTION jSasKflweWDNRV2_Fktn "Applikationesgroessen Instanz jSasKflweWDNRV2" /begin DEF_CHARACTERISTIC KF_PKABNDNMOTNTCGDNRV2 PG_KABABBRDNRV2 PG_KABDNRV2 /end DEF_CHARACTERISTIC /end FUNCTION
/begin FUNCTION jSasKflweWRND_Fktn "Applikationesgroessen Instanz jSasKflweWRND" /begin DEF_CHARACTERISTIC KF_PKABNDNMOTNTCGRND PG_KABABBRRND PG_KABRND /end DEF_CHARACTERISTIC /end FUNCTION
/begin FUNCTION jSasKflweWRNDV2_Fktn "Applikationesgroessen Instanz jSasKflweWRNDV2" /begin DEF_CHARACTERISTIC KF_PKABNDNMOTNTCGRNDV2 PG_KABABBRRNDV2 PG_KABRNDV2 /end DEF_CHARACTERISTIC /end FUNCTION
/begin FUNCTION jSasKzuAl_Fktn "Applikationesgroessen Instanz jSasKzuAl"
 /begin DEF_CHARACTERISTIC KF_POFMTNESTART12 KF_TFMTNTESTART12 KL_PGOFMTESTART12 TAB_SWI_POKZUFOL /end DEF_CHARACTERISTIC
/end FUNCTION
/begin FUNCTION jSasKzuEHS12_Fktn "Applikationesgroessen Instanz jSasKzuEHS12" /begin DEF_CHARACTERISTIC KL_TSYNMTFKZUV12 KL_TSYNMTKZUSFV12 /end DEF_CHARACTERISTIC /end FUNCTION
/begin FUNCTION jSasKzuEHS23_Fktn "Applikationesgroessen Instanz jSasKzuEHS23" /begin DEF_CHARACTERISTIC KL_TSYNMTFKZUV23 KL_TSYNMTKZUSFV23 /end DEF_CHARACTERISTIC /end FUNCTION
/begin FUNCTION jSasKzuEHS34_Fktn "Applikationesgroessen Instanz jSasKzuEHS34" /begin DEF_CHARACTERISTIC KL_TSYNMTFKZUV34 KL_TSYNMTKZUSFV34 /end DEF_CHARACTERISTIC /end FUNCTION
/begin FUNCTION jSasKzuEHS45_Fktn "Applikationesgroessen Instanz jSasKzuEHS45" /begin DEF_CHARACTERISTIC KL_TSYNMTFKZUV45 KL_TSYNMTKZUSFV45 /end DEF_CHARACTERISTIC /end FUNCTION
/begin FUNCTION jSasKzuEHS56_Fktn "Applikationesgroessen Instanz jSasKzuEHS56" /begin DEF_CHARACTERISTIC KL_TSYNMTFKZUV56 KL_TSYNMTKZUSFV56 /end DEF_CHARACTERISTIC /end FUNCTION
/begin FUNCTION jSasKzuEHS67_Fktn "Applikationesgroessen Instanz jSasKzuEHS67" /begin DEF_CHARACTERISTIC KL_TSYNMTFKZUV67 KL_TSYNMTKZUSFV67 /end DEF_CHARACTERISTIC /end FUNCTION
/begin FUNCTION jSasKzuEHS78_Fktn "Applikationesgroessen Instanz jSasKzuEHS78" /begin DEF_CHARACTERISTIC KL_TSYNMTFKZUV78 KL_TSYNMTKZUSFV78 /end DEF_CHARACTERISTIC /end FUNCTION
/begin FUNCTION jSasKzuERS21_Fktn "Applikationesgroessen Instanz jSasKzuERS21"
 /begin DEF_CHARACTERISTIC KL_TSYNMTKZUSFV21 KL_TSYNMTKZUSFVFOLNACHMRS21 KL_TSYNMTTRAKZUV21 KL_TSYNMTTRAKZUVFOLNACHMRS21 /end DEF_CHARACTERISTIC
/end FUNCTION
/begin FUNCTION jSasKzuERS32_Fktn "Applikationesgroessen Instanz jSasKzuERS32"
 /begin DEF_CHARACTERISTIC KL_TSYNMTKZUSFV32 KL_TSYNMTKZUSFVFOLNACHMRS32 KL_TSYNMTTRAKZUV32 KL_TSYNMTTRAKZUVFOLNACHMRS32 /end DEF_CHARACTERISTIC
/end FUNCTION
/begin FUNCTION jSasKzuERS43_Fktn "Applikationesgroessen Instanz jSasKzuERS43"
 /begin DEF_CHARACTERISTIC KL_TSYNMTKZUSFV43 KL_TSYNMTKZUSFVFOLNACHMRS43 KL_TSYNMTTRAKZUV43 KL_TSYNMTTRAKZUVFOLNACHMRS43 /end DEF_CHARACTERISTIC
/end FUNCTION
/begin FUNCTION jSasKzuERS54_Fktn "Applikationesgroessen Instanz jSasKzuERS54"
 /begin DEF_CHARACTERISTIC KL_TSYNMTKZUSFV54 KL_TSYNMTKZUSFVFOLNACHMRS54 KL_TSYNMTTRAKZUV54 KL_TSYNMTTRAKZUVFOLNACHMRS54 /end DEF_CHARACTERISTIC
/end FUNCTION
/begin FUNCTION jSasKzuERS65_Fktn "Applikationesgroessen Instanz jSasKzuERS65"
 /begin DEF_CHARACTERISTIC KL_TSYNMTKZUSFV65 KL_TSYNMTKZUSFVFOLNACHMRS65 KL_TSYNMTTRAKZUV65 KL_TSYNMTTRAKZUVFOLNACHMRS65 /end DEF_CHARACTERISTIC
/end FUNCTION
/begin FUNCTION jSasKzuERS76_Fktn "Applikationesgroessen Instanz jSasKzuERS76"
 /begin DEF_CHARACTERISTIC KL_TSYNMTKZUSFV76 KL_TSYNMTKZUSFVFOLNACHMRS76 KL_TSYNMTTRAKZUV76 KL_TSYNMTTRAKZUVFOLNACHMRS76 /end DEF_CHARACTERISTIC
/end FUNCTION
/begin FUNCTION jSasKzuERS87_Fktn "Applikationesgroessen Instanz jSasKzuERS87"
 /begin DEF_CHARACTERISTIC KL_TSYNMTKZUSFV87 KL_TSYNMTKZUSFVFOLNACHMRS87 KL_TSYNMTTRAKZUV87 KL_TSYNMTTRAKZUVFOLNACHMRS87 /end DEF_CHARACTERISTIC
/end FUNCTION
/begin FUNCTION jSasKzuGeG1_Fktn "Applikationesgroessen Instanz jSasKzuGeG1"
 /begin DEF_CHARACTERISTIC F_PRA_1 F_TRA_1 KF_PKZU_1 KF_PODKIMOTSOLLNMOTGE_1 KF_PODKIMOTSOLLNMOTGE_ECO_1 KF_POFMTNFUELLRED_1 KF_POFMTN_1 KF_POMLASTCGV2_1 KF_POTNDSYNV2_1 KF_TRAMTCG_1 KL_FPOTNDSYNV2_1 KL_PGOFCGV2_1 KL_PGOFMT_1 KL_PGOKZUNAB_1 KL_PGOKZU_1 KL_PGRASYNNAB_1 KL_PGRASYNV1_1 KL_PGRASYNV2_1 KL_PGRASYN_1 KL_POFCGV1_1 KL_POFCGV2_1 KL_POFCG_1 KL_POKZUCG_1 KL_POLASTDKIV2_1 KL_PORAKZU_1 KL_PORASYNV1_1 KL_PORASYNV2_1 KL_PORASYN_1 KL_TFCGGE_1 KL_TFCGV2_1 KL_TFV1_1 KL_TOVKZUCG_1 KL_TVKZUCGV2_1 KL_TVKZU_1 NS_GENDSYNIAE_1 PG_OFV1_1 T_FFUELLRED_1 T_SYNRAKZU_1 T_SYN_1 T_VGEIAE_1 T_VKZUV2_1 /end DEF_CHARACTERISTIC
/end FUNCTION
/begin FUNCTION jSasKzuGeG2_Fktn "Applikationesgroessen Instanz jSasKzuGeG2"
 /begin DEF_CHARACTERISTIC F_PRA_2 F_TRA_2 KF_PKZU_2 KF_PODKIMOTSOLLNMOTGE_2 KF_PODKIMOTSOLLNMOTGE_ECO_2 KF_POFMTNFUELLRED_2 KF_POFMTN_2 KF_POMLASTCGV2_2 KF_POTNDSYNV2_2 KF_TRAMTCG_2 KL_FPOTNDSYNV2_2 KL_PGOFCGV2_2 KL_PGOFMT_2 KL_PGOKZUNAB_2 KL_PGOKZU_2 KL_PGRASYNNAB_2 KL_PGRASYNV1_2 KL_PGRASYNV2_2 KL_PGRASYN_2 KL_POFCGV1_2 KL_POFCGV2_2 KL_POFCG_2 KL_POKZUCG_2 KL_POLASTDKIV2_2 KL_PORAKZU_2 KL_PORASYNV1_2 KL_PORASYNV2_2 KL_PORASYN_2 KL_TFCGGE_2 KL_TFCGV2_2 KL_TFV1_2 KL_TOVKZUCG_2 KL_TVKZUCGV2_2 KL_TVKZU_2 NS_GENDSYNIAE_2 PG_OFV1_2 T_FFUELLRED_2 T_SYNRAKZU_2 T_SYN_2 T_VGEIAE_2 T_VKZUV2_2 /end DEF_CHARACTERISTIC
/end FUNCTION
/begin FUNCTION jSasKzuGeG3_Fktn "Applikationesgroessen Instanz jSasKzuGeG3"
 /begin DEF_CHARACTERISTIC F_PRA_3 F_TRA_3 KF_PKZU_3 KF_PODKIMOTSOLLNMOTGE_3 KF_PODKIMOTSOLLNMOTGE_ECO_3 KF_POFMTNFUELLRED_3 KF_POFMTN_3 KF_POMLASTCGV2_3 KF_POTNDSYNV2_3 KF_TRAMTCG_3 KL_FPOTNDSYNV2_3 KL_PGOFCGV2_3 KL_PGOFMT_3 KL_PGOKZUNAB_3 KL_PGOKZU_3 KL_PGRASYNNAB_3 KL_PGRASYNV1_3 KL_PGRASYNV2_3 KL_PGRASYN_3 KL_POFCGV1_3 KL_POFCGV2_3 KL_POFCG_3 KL_POKZUCG_3 KL_POLASTDKIV2_3 KL_PORAKZU_3 KL_PORASYNV1_3 KL_PORASYNV2_3 KL_PORASYN_3 KL_TFCGGE_3 KL_TFCGV2_3 KL_TFV1_3 KL_TOVKZUCG_3 KL_TVKZUCGV2_3 KL_TVKZU_3 NS_GENDSYNIAE_3 PG_OFV1_3 T_FFUELLRED_3 T_SYNRAKZU_3 T_SYN_3 T_VGEIAE_3 T_VKZUV2_3 /end DEF_CHARACTERISTIC
/end FUNCTION
/begin FUNCTION jSasKzuGeG4_Fktn "Applikationesgroessen Instanz jSasKzuGeG4"
 /begin DEF_CHARACTERISTIC F_PRA_4 F_TRA_4 KF_PKZU_4 KF_PODKIMOTSOLLNMOTGE_4 KF_PODKIMOTSOLLNMOTGE_ECO_4 KF_POFMTNFUELLRED_4 KF_POFMTN_4 KF_POMLASTCGV2_4 KF_POTNDSYNV2_4 KF_TRAMTCG_4 KL_FPOTNDSYNV2_4 KL_PGOFCGV2_4 KL_PGOFMT_4 KL_PGOKZUNAB_4 KL_PGOKZU_4 KL_PGRASYNNAB_4 KL_PGRASYNV1_4 KL_PGRASYNV2_4 KL_PGRASYN_4 KL_POFCGV1_4 KL_POFCGV2_4 KL_POFCG_4 KL_POKZUCG_4 KL_POLASTDKIV2_4 KL_PORAKZU_4 KL_PORASYNV1_4 KL_PORASYNV2_4 KL_PORASYN_4 KL_TFCGGE_4 KL_TFCGV2_4 KL_TFV1_4 KL_TOVKZUCG_4 KL_TVKZUCGV2_4 KL_TVKZU_4 NS_GENDSYNIAE_4 PG_OFV1_4 T_FFUELLRED_4 T_SYNRAKZU_4 T_SYN_4 T_VGEIAE_4 T_VKZUV2_4 /end DEF_CHARACTERISTIC
/end FUNCTION
/begin FUNCTION jSasKzuGeG5_Fktn "Applikationesgroessen Instanz jSasKzuGeG5"
 /begin DEF_CHARACTERISTIC F_PRA_5 F_TRA_5 KF_PKZU_5 KF_PODKIMOTSOLLNMOTGE_5 KF_PODKIMOTSOLLNMOTGE_ECO_5 KF_POFMTNFUELLRED_5 KF_POFMTN_5 KF_POMLASTCGV2_5 KF_POTNDSYNV2_5 KF_TRAMTCG_5 KL_FPOTNDSYNV2_5 KL_PGOFCGV2_5 KL_PGOFMT_5 KL_PGOKZUNAB_5 KL_PGOKZU_5 KL_PGRASYNNAB_5 KL_PGRASYNV1_5 KL_PGRASYNV2_5 KL_PGRASYN_5 KL_POFCGV1_5 KL_POFCGV2_5 KL_POFCG_5 KL_POKZUCG_5 KL_POLASTDKIV2_5 KL_PORAKZU_5 KL_PORASYNV1_5 KL_PORASYNV2_5 KL_PORASYN_5 KL_TFCGGE_5 KL_TFCGV2_5 KL_TFV1_5 KL_TOVKZUCG_5 KL_TVKZUCGV2_5 KL_TVKZU_5 NS_GENDSYNIAE_5 PG_OFV1_5 T_FFUELLRED_5 T_SYNRAKZU_5 T_SYN_5 T_VGEIAE_5 T_VKZUV2_5 /end DEF_CHARACTERISTIC
/end FUNCTION
/begin FUNCTION jSasKzuGeG6_Fktn "Applikationesgroessen Instanz jSasKzuGeG6"
 /begin DEF_CHARACTERISTIC F_PRA_6 F_TRA_6 KF_PKZU_6 KF_PODKIMOTSOLLNMOTGE_6 KF_PODKIMOTSOLLNMOTGE_ECO_6 KF_POFMTNFUELLRED_6 KF_POFMTN_6 KF_POMLASTCGV2_6 KF_POTNDSYNV2_6 KF_TRAMTCG_6 KL_FPOTNDSYNV2_6 KL_PGOFCGV2_6 KL_PGOFMT_6 KL_PGOKZUNAB_6 KL_PGOKZU_6 KL_PGRASYNNAB_6 KL_PGRASYNV1_6 KL_PGRASYNV2_6 KL_PGRASYN_6 KL_POFCGV1_6 KL_POFCGV2_6 KL_POFCG_6 KL_POKZUCG_6 KL_POLASTDKIV2_6 KL_PORAKZU_6 KL_PORASYNV1_6 KL_PORASYNV2_6 KL_PORASYN_6 KL_TFCGGE_6 KL_TFCGV2_6 KL_TFV1_6 KL_TOVKZUCG_6 KL_TVKZUCGV2_6 KL_TVKZU_6 NS_GENDSYNIAE_6 PG_OFV1_6 T_FFUELLRED_6 T_SYNRAKZU_6 T_SYN_6 T_VGEIAE_6 T_VKZUV2_6 /end DEF_CHARACTERISTIC
/end FUNCTION
/begin RECORD_LAYOUT ZF_kf_si16_S5_S3 FNC_VALUES 5 SWORD ROW_DIR DIRECT AXIS_PTS_X 3 SWORD INDEX_INCR DIRECT AXIS_PTS_Y 4 SWORD INDEX_INCR DIRECT NO_AXIS_PTS_X 1 ULONG NO_AXIS_PTS_Y 2 ULONG /end RECORD_LAYOUT
/begin RECORD_LAYOUT ZF_kf_ui8_S5_S3 FNC_VALUES 5 UBYTE ROW_DIR DIRECT AXIS_PTS_X 3 UBYTE INDEX_INCR DIRECT AXIS_PTS_Y 4 UBYTE INDEX_INCR DIRECT NO_AXIS_PTS_X 1 ULONG NO_AXIS_PTS_Y 2 ULONG /end RECORD_LAYOUT
/begin RECORD_LAYOUT ZF_kl_si16_S5_S3 FNC_VALUES 3 SWORD COLUMN_DIR DIRECT AXIS_PTS_X 2 SWORD INDEX_INCR DIRECT NO_AXIS_PTS_X 1 ULONG /end RECORD_LAYOUT
/begin RECORD_LAYOUT ZF_kl_ui16_S5_S3 FNC_VALUES 3 UWORD COLUMN_DIR DIRECT AXIS_PTS_X 2 UWORD INDEX_INCR DIRECT NO_AXIS_PTS_X 1 ULONG /end RECORD_LAYOUT
/begin RECORD_LAYOUT ZF_kl_ui8_S5_S3 FNC_VALUES 3 UBYTE COLUMN_DIR DIRECT AXIS_PTS_X 2 UBYTE INDEX_INCR DIRECT NO_AXIS_PTS_X 1 ULONG /end RECORD_LAYOUT
/begin RECORD_LAYOUT ZF_kw_si16_S5_S3 FNC_VALUES 1 SWORD COLUMN_DIR DIRECT /end RECORD_LAYOUT
/begin RECORD_LAYOUT ZF_kw_ui16_S5_S3 FNC_VALUES 1 UWORD COLUMN_DIR DIRECT /end RECORD_LAYOUT
/begin RECORD_LAYOUT ZF_kw_ui8_S5_S3 FNC_VALUES 1 UBYTE COLUMN_DIR DIRECT /end RECORD_LAYOUT
/begin RECORD_LAYOUT ZF_tab_ui8_S5_S3 FNC_VALUES 2 UBYTE COLUMN_DIR DIRECT NO_AXIS_PTS_X 1 ULONG /end RECORD_LAYOUT
/end MODULE
/end PROJECT
