ASAP2_VERSION 1 51
/begin PROJECT ZHBC8600 "Gen2_BMW_System_Supplier_Lib"
/begin MODULE CPP ""
/begin MOD_COMMON "" BYTE_ORDER MSB_FIRST ALIGNMENT_BYTE 1 ALIGNMENT_WORD 2 ALIGNMENT_LONG 4 ALIGNMENT_FLOAT32_IEEE 4 ALIGNMENT_FLOAT64_IEEE 1 /end MOD_COMMON
/begin COMPU_VTAB CONV_TAB_E_FEHLERIEP_S6_S3 "Conversion table" TAB_VERB 2 0 "NORMALBETRIEB" 1 "FEHLER" DEFAULT_VALUE "" /end COMPU_VTAB
/begin COMPU_VTAB CONV_TAB_E_HYBFKT_S6_S3 "Conversion table" TAB_VERB 16 0 "PASSIV" 1 "ANKOPPELN_VM" 2 "ABKOPPELN_VM" 3 "GANGEINLEGEN" 4 "GANGAUSLEGEN" 5 "OHNABLAUFFKT" 6 "DIREKTSTART" 7 "VM_ZUSTART" 8 "ABSTELLEN_VM" 9 "NICHTDEFINIERT_4" 10 "VM_SCHLEPPSTART" 11 "VM_NOTSTART" 12 "VM_EIN" 13 "VM_AUS" 14 "NICHTDEFINIERT_3" 15 "FEHLER" DEFAULT_VALUE "" /end COMPU_VTAB
/begin COMPU_VTAB CONV_TAB_E_POS_S6_S3 "Conversion table" TAB_VERB 9 0 "D1" 1 "D2" 2 "D3" 3 "D4" 4 "D5" 5 "D" 6 "N" 7 "R" 8 "P" DEFAULT_VALUE "" /end COMPU_VTAB
/begin COMPU_VTAB CONV_TAB_E_SIGSTATUS_S6_S3 "Conversion table" TAB_VERB 3 0 "SIGNAL_OK" 1 "ERSATZWERT" 2 "SIGNAL_FEHLER" DEFAULT_VALUE "" /end COMPU_VTAB
/begin COMPU_VTAB CONV_TAB_E_STATUSADA_S6_S3 "Conversion table" TAB_VERB 3 0 "KEINADAPTION" 1 "TOUCHPOINT_ADAPTION" 2 "REIBWERT_ADAPTION" DEFAULT_VALUE "" /end COMPU_VTAB
/begin COMPU_VTAB CONV_TAB_E_STATUSIAE_S6_S3 "Conversion table" TAB_VERB 9 0 "NICHTDEFINIERT" 1 "OFFEN" 2 "ANGELEGT" 3 "ANFAHREN" 4 "ENTKOPPELT" 5 "ENTKOPPELT_ANFAHREN" 6 "SYNCHRONISIEREN" 7 "GESCHLOSSEN" 8 "OEFFNEN" DEFAULT_VALUE "" /end COMPU_VTAB
/begin COMPU_VTAB CONV_TAB_E_STATUSIEP_S6_S3 "Conversion table" TAB_VERB 5 0 "AUS" 1 "SLEEP" 2 "LP1" 3 "LP2" 4 "LP3" DEFAULT_VALUE "" /end COMPU_VTAB
/begin COMPU_VTAB CONV_TAB_E_STATUSK0_S6_S3 "Conversion table" TAB_VERB 6 0 "OFFEN" 1 "ANGELEGT" 2 "DRUCKSTELLUNG" 3 "SCHLUPFGEREGELT" 4 "GEREGELTGESCHL" 5 "GESCHLOSSEN" DEFAULT_VALUE "" /end COMPU_VTAB
/begin COMPU_VTAB CONV_TAB_E_STATUSKSL_S6_S3 "Conversion table" TAB_VERB 7 0 "KEIN_KRAFTSCHLUSS" 1 "VORW_AUF_ABBAUEND" 2 "VORWAERTS" 3 "RUECKW_AUF_ABBAUEND" 4 "RUECKWAERTS" 5 "VORWAERTS_SCHLUPF" 6 "RUECKWAERTS_SCHLUPF" DEFAULT_VALUE "" /end COMPU_VTAB
/begin COMPU_VTAB CONV_TAB_E_STATUSPSY_S6_S3 "Conversion table" TAB_VERB 5 0 "AUS" 1 "NICHTDEFINIERT" 2 "LP1" 3 "LP2" 4 "LP3" DEFAULT_VALUE "" /end COMPU_VTAB
/begin COMPU_VTAB CONV_TAB_E_STBZHAS_S6_S3 "Conversion table" TAB_VERB 16 0 "INIT_INAKTIV" 1 "ANGEKOPPELT" 2 "ENTKOPPELT" 3 "EFAHREN" 4 "STOP" 5 "LADEN" 6 "ENTK_VMEIN" 7 "EFAHREN_VMEIN" 8 "HYBRID" 9 "NICHTDEFINIERT_1" 10 "NICHTDEFINIERT_2" 11 "NICHTDEFINIERT_3" 12 "NICHTDEFINIERT_4" 13 "NICHTDEFINIERT_5" 14 "INIT_KL15" 15 "FEHLER" DEFAULT_VALUE "" /end COMPU_VTAB
/begin COMPU_VTAB CONV_TAB_E_ZIEP_S6_S3 "Conversion table" TAB_VERB 5 0 "AUS" 1 "SLEEP" 2 "LP1" 3 "LP2" 4 "LP3" DEFAULT_VALUE "" /end COMPU_VTAB
/begin COMPU_VTAB CONV_TAB_E_ZK0_S6_S3 "Conversion table" TAB_VERB 6 0 "OEFFNENSW" 1 "BEFUELLEN" 2 "DRUCKSTELLUNG" 3 "SCHLUPFREGELUNG" 4 "GEREGELTGESCHL" 5 "GESCHLOSSEN" DEFAULT_VALUE "" /end COMPU_VTAB
/begin COMPU_VTAB CONV_TAB_E_ZK0FSTIN_S6_S3 "Conversion table" TAB_VERB 4 0 "OFFEN" 1 "SCHLUPFGEREGELT" 2 "GEREGELTGESCHL" 3 "GESCHLOSSEN" DEFAULT_VALUE "" /end COMPU_VTAB
/begin COMPU_VTAB CONV_TAB_E_ZMODUSIAE_S6_S3 "Conversion table" TAB_VERB 3 0 "EFAHREN_SCHLUPF" 1 "EFAHREN_KRAFTSCHL" 2 "HYBRIDFAHREN" DEFAULT_VALUE "" /end COMPU_VTAB
/begin COMPU_VTAB CONV_TAB_E_ZMODUSIEP_S6_S3 "Conversion table" TAB_VERB 5 0 "KEINVORGABE" 1 "AUS" 2 "LP1" 3 "LP2" 4 "LP3" DEFAULT_VALUE "" /end COMPU_VTAB
/begin COMPU_VTAB CONV_TAB_E_ZNLLSOLL_S6_S3 "Conversion table" TAB_VERB 3 0 "KEINANF" 1 "ANF_ADAP" 2 "ANF_ALLG" DEFAULT_VALUE "" /end COMPU_VTAB
/begin COMPU_METHOD b_int_S6_S3 "Bit Feld" RAT_FUNC "%10.0" "-" COEFFS 0 1 0 0 0 1 /end COMPU_METHOD
/begin COMPU_METHOD c_int_S6_S3 "Temperatur" RAT_FUNC "%12.6" "°C" COEFFS 0 1 0 0 0 1 /end COMPU_METHOD
/begin COMPU_METHOD E_FEHLERIEP_S6_S3 "" TAB_VERB "%12.6" "" COMPU_TAB_REF CONV_TAB_E_FEHLERIEP_S6_S3 /end COMPU_METHOD
/begin COMPU_METHOD E_HYBFKT_S6_S3 "" TAB_VERB "%12.6" "" COMPU_TAB_REF CONV_TAB_E_HYBFKT_S6_S3 /end COMPU_METHOD
/begin COMPU_METHOD E_POS_S6_S3 "" TAB_VERB "%12.6" "" COMPU_TAB_REF CONV_TAB_E_POS_S6_S3 /end COMPU_METHOD
/begin COMPU_METHOD E_SIGSTATUS_S6_S3 "" TAB_VERB "%12.6" "" COMPU_TAB_REF CONV_TAB_E_SIGSTATUS_S6_S3 /end COMPU_METHOD
/begin COMPU_METHOD E_STATUSADA_S6_S3 "" TAB_VERB "%12.6" "" COMPU_TAB_REF CONV_TAB_E_STATUSADA_S6_S3 /end COMPU_METHOD
/begin COMPU_METHOD E_STATUSIAE_S6_S3 "" TAB_VERB "%12.6" "" COMPU_TAB_REF CONV_TAB_E_STATUSIAE_S6_S3 /end COMPU_METHOD
/begin COMPU_METHOD E_STATUSIEP_S6_S3 "" TAB_VERB "%12.6" "" COMPU_TAB_REF CONV_TAB_E_STATUSIEP_S6_S3 /end COMPU_METHOD
/begin COMPU_METHOD E_STATUSK0_S6_S3 "" TAB_VERB "%12.6" "" COMPU_TAB_REF CONV_TAB_E_STATUSK0_S6_S3 /end COMPU_METHOD
/begin COMPU_METHOD E_STATUSKSL_S6_S3 "" TAB_VERB "%12.6" "" COMPU_TAB_REF CONV_TAB_E_STATUSKSL_S6_S3 /end COMPU_METHOD
/begin COMPU_METHOD E_STATUSPSY_S6_S3 "" TAB_VERB "%12.6" "" COMPU_TAB_REF CONV_TAB_E_STATUSPSY_S6_S3 /end COMPU_METHOD
/begin COMPU_METHOD E_STBZHAS_S6_S3 "" TAB_VERB "%12.6" "" COMPU_TAB_REF CONV_TAB_E_STBZHAS_S6_S3 /end COMPU_METHOD
/begin COMPU_METHOD E_ZIEP_S6_S3 "" TAB_VERB "%12.6" "" COMPU_TAB_REF CONV_TAB_E_ZIEP_S6_S3 /end COMPU_METHOD
/begin COMPU_METHOD E_ZK0_S6_S3 "" TAB_VERB "%12.6" "" COMPU_TAB_REF CONV_TAB_E_ZK0_S6_S3 /end COMPU_METHOD
/begin COMPU_METHOD E_ZK0FSTIN_S6_S3 "" TAB_VERB "%12.6" "" COMPU_TAB_REF CONV_TAB_E_ZK0FSTIN_S6_S3 /end COMPU_METHOD
/begin COMPU_METHOD E_ZMODUSIAE_S6_S3 "" TAB_VERB "%12.6" "" COMPU_TAB_REF CONV_TAB_E_ZMODUSIAE_S6_S3 /end COMPU_METHOD
/begin COMPU_METHOD E_ZMODUSIEP_S6_S3 "" TAB_VERB "%12.6" "" COMPU_TAB_REF CONV_TAB_E_ZMODUSIEP_S6_S3 /end COMPU_METHOD
/begin COMPU_METHOD E_ZNLLSOLL_S6_S3 "" TAB_VERB "%12.6" "" COMPU_TAB_REF CONV_TAB_E_ZNLLSOLL_S6_S3 /end COMPU_METHOD
/begin COMPU_METHOD n_fl_S6_S3 "Drehzahl" RAT_FUNC "%12.6" "1/min" COEFFS 0 1 0 0 0 1 /end COMPU_METHOD
/begin COMPU_METHOD ng_fl_S6_S3 "Drehzahlgradient" RAT_FUNC "%12.6" "1/min/s" COEFFS 0 1 0 0 0 1 /end COMPU_METHOD
/begin COMPU_METHOD p_fl_S6_S3 "Druck" RAT_FUNC "%12.6" "bar" COEFFS 0 1 0 0 0 1 /end COMPU_METHOD
/begin COMPU_METHOD phi_fl_S6_S3 "Winkel" RAT_FUNC "%12.6" "rad" COEFFS 0 1 0 0 0 1 /end COMPU_METHOD
/begin COMPU_METHOD SAB2_C_CMO_3CEL4_M48_S3_S3 "int = ((phys * 4) / 3) - (-48) Grad Celsius" RAT_FUNC "%4.3" "Grad Celsius" COEFFS 0 1.33333333333 48 0 0 1 /end COMPU_METHOD
/begin COMPU_METHOD SAB2_C_TEMPEXTERN_CEL2_M40_S3_S3 "int = ((phys * 2) / 1) - (-80) Grad Celsius" RAT_FUNC "%4.3" "Grad Celsius" COEFFS 0 2 80 0 0 1 /end COMPU_METHOD
/begin COMPU_METHOD SAB2_DISTSENS_S3_S3 "int = ((phys * 256) / 1) - (0) mm" RAT_FUNC "%4.3" "mm" COEFFS 0 256 0 0 0 1 /end COMPU_METHOD
/begin COMPU_METHOD SAB2_I_1A_S3_S3 "int = ((phys * 1) / 1) - (0) A" RAT_FUNC "%1.0" "A" COEFFS 0 1 0 0 0 1 /end COMPU_METHOD
/begin COMPU_METHOD SAB2_I_MA10_S3_S3 "int = ((phys * 10) / 1) - (0) mA" RAT_FUNC "%4.3" "mA" COEFFS 0 10 0 0 0 1 /end COMPU_METHOD
/begin COMPU_METHOD t_fl_S6_S3 "Zeit" RAT_FUNC "%12.6" "s" COEFFS 0 1 0 0 0 1 /end COMPU_METHOD
/begin COMPU_METHOD t_int_h_S6_S3 "Zeit" RAT_FUNC "%6.2" "s" COEFFS 0 100 0 0 0 1 /end COMPU_METHOD
/begin COMPU_METHOD t_int_S6_S3 "Zeit" RAT_FUNC "%11.2" "s" COEFFS 0 100 0 0 0 1 /end COMPU_METHOD
/begin COMPU_METHOD trq_fl_a_S6_S3 "Moment" RAT_FUNC "%12.6" "Nm" COEFFS 0 1 0 0 0 1 /end COMPU_METHOD
/begin COMPU_METHOD trqg_fl_c_S6_S3 "Momentengradient" RAT_FUNC "%12.6" "Nm/s" COEFFS 0 1 0 0 0 1 /end COMPU_METHOD
/begin COMPU_METHOD v_fl_S6_S3 "Geschwindigkeit" RAT_FUNC "%12.6" "km/h" COEFFS 0 1 0 0 0 1 /end COMPU_METHOD
/begin COMPU_METHOD vg_fl_S6_S3 "Geschwindigkeitsgradient" RAT_FUNC "%12.6" "km/h/s" COEFFS 0 1 0 0 0 1 /end COMPU_METHOD
/begin COMPU_METHOD void_fl_S6_S3 "ohne Umrechnung" RAT_FUNC "%12.6" "-" COEFFS 0 1 0 0 0 1 /end COMPU_METHOD
/begin COMPU_METHOD void_int_b_S6_S3 "ohne Umrechnung" RAT_FUNC "%5.0" "-" COEFFS 0 1 0 0 0 1 /end COMPU_METHOD
/begin COMPU_METHOD void_int_e_S6_S3 "ohne Umrechnung" RAT_FUNC "%1.0" "-" COEFFS 0 1 0 0 0 1 /end COMPU_METHOD
/begin COMPU_METHOD void_int_S6_S3 "ohne Umrechnung" RAT_FUNC "%3.0" "-" COEFFS 0 1 0 0 0 1 /end COMPU_METHOD
/begin COMPU_METHOD VOID_SCALING_f_S6_S3 "Void scaling for unscaled variables" RAT_FUNC "%12.6" "" COEFFS 0 1 0 0 0 1 /end COMPU_METHOD
/begin COMPU_METHOD VOID_SCALING_g_S6_S3 "Void scaling for unscaled variables" RAT_FUNC "%3.0" "" COEFFS 0 1 0 0 0 1 /end COMPU_METHOD
/begin COMPU_METHOD VOID_SCALING_S6_S3 "Void scaling for unscaled variables" RAT_FUNC "%1.0" "" COEFFS 0 1 0 0 0 1 /end COMPU_METHOD
/begin CHARACTERISTIC FK_NGEM_ANK "Filterkonstante zur Bestimmung des EM-Drehzahlgradienten beim Ankoppeln" VALUE 0x1D0EBC FLOAT32_IEEE_COL_DIRECT_S6_S3 0 void_fl_S6_S3 0 1 /end CHARACTERISTIC
/begin CHARACTERISTIC FK_NGVM_AST_ABST "Zusätzliche PT1-Filterung von ng_vm_in zum Vergleich mit der VM-Drehzahlgradientenschwelle zur Vorgabe K0 OEFFNENSW im Zustand VM-Abstellen beim VM Abstellen" VALUE 0x1D0D28 FLOAT32_IEEE_COL_DIRECT_S6_S3 0 ng_fl_S6_S3 0 5 /end CHARACTERISTIC
/begin CHARACTERISTIC FK_NSOLLVM_KON_ANK "Filterung der VM-Solldrehzahl ab dem Zustand Konditionieren beim Ankoppeln" VALUE 0x1D0EC0 FLOAT32_IEEE_COL_DIRECT_S6_S3 0 void_fl_S6_S3 0 1 /end CHARACTERISTIC
/begin CHARACTERISTIC KF_FFKMSTOERKPL_ABO_W "Faktor auf KF_FFKMSTOERKPL_ANS = f(z_ablaufvariante_has_stg,status_k0_in)" MAP 0x1CFE94 FLOAT32_IEEE_COL_DIRECT_S6_S3 0 trq_fl_a_S6_S3 0 100
 /begin AXIS_DESCR COM_AXIS m_mot_in trq_fl_a_S6_S3 8 -3.40282e+038 3.40282e+038 DEPOSIT ABSOLUTE AXIS_PTS_REF KF_FFKMSTOERKPL_ABO_X /end AXIS_DESCR
 /begin AXIS_DESCR COM_AXIS status_k0_in void_int_S6_S3 6 0 255 DEPOSIT ABSOLUTE AXIS_PTS_REF KF_FFKMSTOERKPL_ABO_Y /end AXIS_DESCR
/end CHARACTERISTIC
/begin AXIS_PTS KF_FFKMSTOERKPL_ABO_X "X-Achse: m_mot_in" 0x1CFF54 m_mot_in FLOAT32_IEEE_X_INCR_DIRECT_S6_S3 0 trq_fl_a_S6_S3 8 -3.40282e+038 3.40282e+038 DEPOSIT ABSOLUTE /end AXIS_PTS
/begin AXIS_PTS KF_FFKMSTOERKPL_ABO_Y "Y-Achse: status_k0_in" 0x1D8C20 status_k0_in UBYTE_X_INCR_DIRECT_S6_S3 0 void_int_S6_S3 6 0 255 DEPOSIT ABSOLUTE /end AXIS_PTS
/begin CHARACTERISTIC KF_FKMSTOERKPL_ABO_W "Filterzeitkonstante m_stoer_k0_em =f(c_getriebe_egs_in, m_stoer_k0_em_fil)" MAP 0x1CFF74 FLOAT32_IEEE_COL_DIRECT_S6_S3 0 t_fl_S6_S3 -3.40282e+038 3.40282e+038
 /begin AXIS_DESCR COM_AXIS c_getriebe_egs_in c_int_S6_S3 8 -3.40282e+038 3.40282e+038 DEPOSIT ABSOLUTE AXIS_PTS_REF KF_FKMSTOERKPL_ABO_X /end AXIS_DESCR
 /begin AXIS_DESCR COM_AXIS NO_INPUT_QUANTITY trq_fl_a_S6_S3 8 -3.40282e+038 3.40282e+038 DEPOSIT ABSOLUTE AXIS_PTS_REF KF_FKMSTOERKPL_ABO_Y /end AXIS_DESCR
/end CHARACTERISTIC
/begin AXIS_PTS KF_FKMSTOERKPL_ABO_X "X-Achse: c_getriebe_egs_in" 0x1D0074 c_getriebe_egs_in FLOAT32_IEEE_X_INCR_DIRECT_S6_S3 0 c_int_S6_S3 8 -3.40282e+038 3.40282e+038 DEPOSIT ABSOLUTE /end AXIS_PTS
/begin AXIS_PTS KF_FKMSTOERKPL_ABO_Y "Y-Achse: m_stoer_k0_em_fil" 0x1D0094 NO_INPUT_QUANTITY FLOAT32_IEEE_X_INCR_DIRECT_S6_S3 0 trq_fl_a_S6_S3 8 -3.40282e+038 3.40282e+038 DEPOSIT ABSOLUTE /end AXIS_PTS
/begin CHARACTERISTIC KF_FMOSTOERKPL_ABO_W "Faktor für KF_15OMSTOERKPL_ANS" MAP 0x1D00B4 FLOAT32_IEEE_COL_DIRECT_S6_S3 0 void_fl_S6_S3 -3.40282e+038 3.40282e+038
 /begin AXIS_DESCR COM_AXIS nd_k0_in t_fl_S6_S3 10 -3.40282e+038 3.40282e+038 DEPOSIT ABSOLUTE AXIS_PTS_REF KF_FMOSTOERKPL_ABO_X /end AXIS_DESCR
 /begin AXIS_DESCR COM_AXIS n_em_in trq_fl_a_S6_S3 8 -3.40282e+038 3.40282e+038 DEPOSIT ABSOLUTE AXIS_PTS_REF KF_FMOSTOERKPL_ABO_Y /end AXIS_DESCR
/end CHARACTERISTIC
/begin AXIS_PTS KF_FMOSTOERKPL_ABO_X "X-Achse:t_mstoerk0emfil_ans" 0x1D01F4 nd_k0_in FLOAT32_IEEE_X_INCR_DIRECT_S6_S3 0 t_fl_S6_S3 10 -3.40282e+038 3.40282e+038 DEPOSIT ABSOLUTE /end AXIS_PTS
/begin AXIS_PTS KF_FMOSTOERKPL_ABO_Y "Y-Achse: m_stoer_k0_em_has_alt" 0x1D021C n_em_in FLOAT32_IEEE_X_INCR_DIRECT_S6_S3 0 trq_fl_a_S6_S3 8 -3.40282e+038 3.40282e+038 DEPOSIT ABSOLUTE /end AXIS_PTS
/begin CHARACTERISTIC KF_FMSTOERKPL_ABO_W "Faktor zur Berechnung EM-Vorsteuermoment vor PT2 Filter" MAP 0x1D023C FLOAT32_IEEE_COL_DIRECT_S6_S3 0 void_fl_S6_S3 0 1
 /begin AXIS_DESCR COM_AXIS NO_INPUT_QUANTITY t_fl_S6_S3 10 -3.40282e+038 3.40282e+038 DEPOSIT ABSOLUTE AXIS_PTS_REF KF_FMSTOERKPL_ABO_X /end AXIS_DESCR
 /begin AXIS_DESCR COM_AXIS NO_INPUT_QUANTITY trq_fl_a_S6_S3 8 -3.40282e+038 3.40282e+038 DEPOSIT ABSOLUTE AXIS_PTS_REF KF_FMSTOERKPL_ABO_Y /end AXIS_DESCR
/end CHARACTERISTIC
/begin AXIS_PTS KF_FMSTOERKPL_ABO_X "X-Achse: Norm. Zeit aus Timer t_mstoerk0emfil" 0x1D037C NO_INPUT_QUANTITY FLOAT32_IEEE_X_INCR_DIRECT_S6_S3 0 t_fl_S6_S3 10 -3.40282e+038 3.40282e+038 DEPOSIT ABSOLUTE /end AXIS_PTS
/begin AXIS_PTS KF_FMSTOERKPL_ABO_Y "Y-Achse: m_stoer_k0_em_has_alt" 0x1D03A4 NO_INPUT_QUANTITY FLOAT32_IEEE_X_INCR_DIRECT_S6_S3 0 trq_fl_a_S6_S3 8 -3.40282e+038 3.40282e+038 DEPOSIT ABSOLUTE /end AXIS_PTS
/begin CHARACTERISTIC KF_FMSTOERND_VMS_ABO_W "Bestimmung k_mtoer" MAP 0x1D03C4 FLOAT32_IEEE_COL_DIRECT_S6_S3 0 void_fl_S6_S3 -3.40282e+038 3.40282e+038
 /begin AXIS_DESCR COM_AXIS nd_k0_in n_fl_S6_S3 10 -3.40282e+038 3.40282e+038 DEPOSIT ABSOLUTE AXIS_PTS_REF KF_FMSTOERND_VMS_ABO_X /end AXIS_DESCR
 /begin AXIS_DESCR COM_AXIS n_em_in n_fl_S6_S3 8 -3.40282e+038 3.40282e+038 DEPOSIT ABSOLUTE AXIS_PTS_REF KF_FMSTOERND_VMS_ABO_Y /end AXIS_DESCR
/end CHARACTERISTIC
/begin AXIS_PTS KF_FMSTOERND_VMS_ABO_X "X-Achse: nd_k0_in" 0x1D0504 nd_k0_in FLOAT32_IEEE_X_INCR_DIRECT_S6_S3 0 n_fl_S6_S3 10 -3.40282e+038 3.40282e+038 DEPOSIT ABSOLUTE /end AXIS_PTS
/begin AXIS_PTS KF_FMSTOERND_VMS_ABO_Y "Y-Achse: n_em_in" 0x1D052C n_em_in FLOAT32_IEEE_X_INCR_DIRECT_S6_S3 0 n_fl_S6_S3 8 -3.40282e+038 3.40282e+038 DEPOSIT ABSOLUTE /end AXIS_PTS
/begin CHARACTERISTIC KF_KOLBPOSINITTIMER_ABO_W "Kolbenpositionsschwelle zur Aktiveriung von m_stoer_k0_em_fil in Prozent" MAP 0x1D0CD4 UBYTE_COL_DIRECT_S6_S3 0 void_int_S6_S3 0 100
 /begin AXIS_DESCR COM_AXIS c_getriebe_egs_in c_int_S6_S3 8 -3.40282e+038 3.40282e+038 DEPOSIT ABSOLUTE AXIS_PTS_REF KF_KOLBPOSINITTIMER_ABO_X /end AXIS_DESCR
 /begin AXIS_DESCR COM_AXIS NO_INPUT_QUANTITY trq_fl_a_S6_S3 8 -3.40282e+038 3.40282e+038 DEPOSIT ABSOLUTE AXIS_PTS_REF KF_KOLBPOSINITTIMER_ABO_Y /end AXIS_DESCR
/end CHARACTERISTIC
/begin AXIS_PTS KF_KOLBPOSINITTIMER_ABO_X "X-Achse: c_getriebe_egs_in" 0x1D054C c_getriebe_egs_in FLOAT32_IEEE_X_INCR_DIRECT_S6_S3 0 c_int_S6_S3 8 -3.40282e+038 3.40282e+038 DEPOSIT ABSOLUTE /end AXIS_PTS
/begin AXIS_PTS KF_KOLBPOSINITTIMER_ABO_Y "Y-Achse: m_soll_k0_has_alt" 0x1D056C NO_INPUT_QUANTITY FLOAT32_IEEE_X_INCR_DIRECT_S6_S3 0 trq_fl_a_S6_S3 8 -3.40282e+038 3.40282e+038 DEPOSIT ABSOLUTE /end AXIS_PTS
/begin CHARACTERISTIC KF_MGK0MODHASMAX_SCL_ANK_W "W-Achse: Max. Gradient des mod. K0-Moments der HAS beim K0-Schliessen beim Ankoppeln" MAP 0x1D0F8C FLOAT32_IEEE_COL_DIRECT_S6_S3 0 trqg_fl_c_S6_S3 -3.40282e+038 3.40282e+038
 /begin AXIS_DESCR COM_AXIS NO_INPUT_QUANTITY trq_fl_a_S6_S3 6 -3.40282e+038 3.40282e+038 DEPOSIT ABSOLUTE AXIS_PTS_REF KF_MGK0MODHASMAX_SCL_ANK_X /end AXIS_DESCR
 /begin AXIS_DESCR COM_AXIS NO_INPUT_QUANTITY void_int_S6_S3 3 0 15 DEPOSIT ABSOLUTE AXIS_PTS_REF KF_MGK0MODHASMAX_SCL_ANK_Y /end AXIS_DESCR
/end CHARACTERISTIC
/begin AXIS_PTS KF_MGK0MODHASMAX_SCL_ANK_X "x-Achse: m_ziel_vm_ank" 0x1D0FD4 NO_INPUT_QUANTITY FLOAT32_IEEE_X_INCR_DIRECT_S6_S3 0 trq_fl_a_S6_S3 6 -3.40282e+038 3.40282e+038 DEPOSIT ABSOLUTE /end AXIS_PTS
/begin AXIS_PTS KF_MGK0MODHASMAX_SCL_ANK_Y "Y-Achse: z_ablaufvariante_has_stg" 0x1D7CE4 NO_INPUT_QUANTITY UBYTE_X_INCR_DIRECT_S6_S3 0 void_int_S6_S3 3 0 15 DEPOSIT ABSOLUTE /end AXIS_PTS
/begin CHARACTERISTIC KF_MGK0NDK0M_SYN_ANK_W "Gradient des K0-Sollmoments in Abhängigkeit der K0 Differenzdrehzahl und dem VM Zielmoment beim K0 Synchronisieren beim Ankoppeln" MAP 0x1D0FEC FLOAT32_IEEE_COL_DIRECT_S6_S3 0 trqg_fl_c_S6_S3 0 50000
 /begin AXIS_DESCR COM_AXIS NO_INPUT_QUANTITY n_fl_S6_S3 7 -3.40282e+038 3.40282e+038 DEPOSIT ABSOLUTE AXIS_PTS_REF KF_MGK0NDK0M_SYN_ANK_X /end AXIS_DESCR
 /begin AXIS_DESCR COM_AXIS NO_INPUT_QUANTITY trq_fl_a_S6_S3 9 -3.40282e+038 3.40282e+038 DEPOSIT ABSOLUTE AXIS_PTS_REF KF_MGK0NDK0M_SYN_ANK_Y /end AXIS_DESCR
/end CHARACTERISTIC
/begin AXIS_PTS KF_MGK0NDK0M_SYN_ANK_X "Gradient des K0-Sollmoments in Abhängigkeit der K0 Differenzdrehzahl und dem VM Zielmoment beim K0 Synchronisieren beim Ankoppeln" 0x1D10E8 NO_INPUT_QUANTITY FLOAT32_IEEE_X_INCR_DIRECT_S6_S3 0 n_fl_S6_S3 7 -3.40282e+038 3.40282e+038 DEPOSIT ABSOLUTE /end AXIS_PTS
/begin AXIS_PTS KF_MGK0NDK0M_SYN_ANK_Y "Gradient des K0-Sollmoments in Abhängigkeit der K0 Differenzdrehzahl und dem VM Zielmoment beim K0 Synchronisieren beim Ankoppeln" 0x1D1104 NO_INPUT_QUANTITY FLOAT32_IEEE_X_INCR_DIRECT_S6_S3 0 trq_fl_a_S6_S3 9 -3.40282e+038 3.40282e+038 DEPOSIT ABSOLUTE /end AXIS_PTS
/begin CHARACTERISTIC KF_MGK0NDK0NGVM_SYN_ANK_W "Gradient des K0-Sollmoments in Abhängigkeit der K0 Differenzdrehzahl und des VM Drehzahlgradienten beim K0 Synchronisieren beim Ankoppeln" MAP 0x1D1128 FLOAT32_IEEE_COL_DIRECT_S6_S3 0 trqg_fl_c_S6_S3 0 50000
 /begin AXIS_DESCR COM_AXIS NO_INPUT_QUANTITY n_fl_S6_S3 7 -3.40282e+038 3.40282e+038 DEPOSIT ABSOLUTE AXIS_PTS_REF KF_MGK0NDK0NGVM_SYN_ANK_X /end AXIS_DESCR
 /begin AXIS_DESCR COM_AXIS NO_INPUT_QUANTITY ng_fl_S6_S3 9 -3.40282e+038 3.40282e+038 DEPOSIT ABSOLUTE AXIS_PTS_REF KF_MGK0NDK0NGVM_SYN_ANK_Y /end AXIS_DESCR
/end CHARACTERISTIC
/begin AXIS_PTS KF_MGK0NDK0NGVM_SYN_ANK_X "Gradient des K0-Sollmoments in Abhängigkeit der K0 Differenzdrehzahl und des VM Drehzahlgradienten beim K0 Synchronisieren beim Ankoppeln" 0x1D1224 NO_INPUT_QUANTITY FLOAT32_IEEE_X_INCR_DIRECT_S6_S3 0 n_fl_S6_S3 7 -3.40282e+038 3.40282e+038 DEPOSIT ABSOLUTE /end AXIS_PTS
/begin AXIS_PTS KF_MGK0NDK0NGVM_SYN_ANK_Y "Gradient des K0-Sollmoments in Abhängigkeit der K0 Differenzdrehzahl und des VM Drehzahlgradienten beim K0 Synchronisieren beim Ankoppeln" 0x1D1240 NO_INPUT_QUANTITY FLOAT32_IEEE_X_INCR_DIRECT_S6_S3 0 ng_fl_S6_S3 9 -3.40282e+038 3.40282e+038 DEPOSIT ABSOLUTE /end AXIS_PTS
/begin CHARACTERISTIC KF_MGSOLLK0CVMABST_KOE_ABO_W "Sollmomentgradient für die K0 oeffnen" MAP 0x1D058C FLOAT32_IEEE_COL_DIRECT_S6_S3 0 trq_fl_a_S6_S3 -3.40282e+038 3.40282e+038
 /begin AXIS_DESCR COM_AXIS NO_INPUT_QUANTITY c_int_S6_S3 8 -3.40282e+038 3.40282e+038 DEPOSIT ABSOLUTE AXIS_PTS_REF KF_MGSOLLK0CVMABST_KOE_ABO_X /end AXIS_DESCR
 /begin AXIS_DESCR COM_AXIS NO_INPUT_QUANTITY phi_fl_S6_S3 8 -3.40282e+038 3.40282e+038 DEPOSIT ABSOLUTE AXIS_PTS_REF KF_MGSOLLK0CVMABST_KOE_ABO_Y /end AXIS_DESCR
/end CHARACTERISTIC
/begin AXIS_PTS KF_MGSOLLK0CVMABST_KOE_ABO_X "X-Achse: c_cm_in" 0x1D068C NO_INPUT_QUANTITY FLOAT32_IEEE_X_INCR_DIRECT_S6_S3 0 c_int_S6_S3 8 -3.40282e+038 3.40282e+038 DEPOSIT ABSOLUTE /end AXIS_PTS
/begin AXIS_PTS KF_MGSOLLK0CVMABST_KOE_ABO_Y "Y-Achse: abstellpos_vm_in" 0x1D06AC NO_INPUT_QUANTITY FLOAT32_IEEE_X_INCR_DIRECT_S6_S3 0 phi_fl_S6_S3 8 -3.40282e+038 3.40282e+038 DEPOSIT ABSOLUTE /end AXIS_PTS
/begin CHARACTERISTIC KF_MGSOLLK0HASMAX_SCL_ANK_W "W-Achse: Max. Gradient des K0-Sollmoments der HAS beim K0-Schliessen beim Ankoppeln" MAP 0x1D1264 FLOAT32_IEEE_COL_DIRECT_S6_S3 0 n_fl_S6_S3 -3.40282e+038 3.40282e+038
 /begin AXIS_DESCR COM_AXIS NO_INPUT_QUANTITY trq_fl_a_S6_S3 6 -3.40282e+038 3.40282e+038 DEPOSIT ABSOLUTE AXIS_PTS_REF KF_MGSOLLK0HASMAX_SCL_ANK_X /end AXIS_DESCR
 /begin AXIS_DESCR COM_AXIS NO_INPUT_QUANTITY void_int_S6_S3 3 0 15 DEPOSIT ABSOLUTE AXIS_PTS_REF KF_MGSOLLK0HASMAX_SCL_ANK_Y /end AXIS_DESCR
/end CHARACTERISTIC
/begin AXIS_PTS KF_MGSOLLK0HASMAX_SCL_ANK_X "x-Achse: m_ziel_vm_ank" 0x1D12AC NO_INPUT_QUANTITY FLOAT32_IEEE_X_INCR_DIRECT_S6_S3 0 trq_fl_a_S6_S3 6 -3.40282e+038 3.40282e+038 DEPOSIT ABSOLUTE /end AXIS_PTS
/begin AXIS_PTS KF_MGSOLLK0HASMAX_SCL_ANK_Y "Y-Achse: z_ablaufvariante_has_stg" 0x1D7CE7 NO_INPUT_QUANTITY UBYTE_X_INCR_DIRECT_S6_S3 0 void_int_S6_S3 3 0 15 DEPOSIT ABSOLUTE /end AXIS_PTS
/begin CHARACTERISTIC KF_MGZIELK0RAMPCVMABST_AND_ABO_W "Zielmomentgradient der K0 während der Rampe in ABO" MAP 0x1D06CC FLOAT32_IEEE_COL_DIRECT_S6_S3 0 trq_fl_a_S6_S3 -3.40282e+038 3.40282e+038
 /begin AXIS_DESCR COM_AXIS NO_INPUT_QUANTITY c_int_S6_S3 8 -3.40282e+038 3.40282e+038 DEPOSIT ABSOLUTE AXIS_PTS_REF KF_MGZIELK0RAMPCVMABST_AND_ABO_X /end AXIS_DESCR
 /begin AXIS_DESCR COM_AXIS NO_INPUT_QUANTITY phi_fl_S6_S3 8 -3.40282e+038 3.40282e+038 DEPOSIT ABSOLUTE AXIS_PTS_REF KF_MGZIELK0RAMPCVMABST_AND_ABO_Y /end AXIS_DESCR
/end CHARACTERISTIC
/begin AXIS_PTS KF_MGZIELK0RAMPCVMABST_AND_ABO_X "X-Achse: c_cm_in" 0x1D07CC NO_INPUT_QUANTITY FLOAT32_IEEE_X_INCR_DIRECT_S6_S3 0 c_int_S6_S3 8 -3.40282e+038 3.40282e+038 DEPOSIT ABSOLUTE /end AXIS_PTS
/begin AXIS_PTS KF_MGZIELK0RAMPCVMABST_AND_ABO_Y "Y-Achse: abstellpos_vm_in" 0x1D07EC NO_INPUT_QUANTITY FLOAT32_IEEE_X_INCR_DIRECT_S6_S3 0 phi_fl_S6_S3 8 -3.40282e+038 3.40282e+038 DEPOSIT ABSOLUTE /end AXIS_PTS
/begin CHARACTERISTIC KF_MOSTOERKPL_ABO_W "Momentoffset auf m_stoer_k0_em_has = f(z_ablaufvariante_has_stg, status_k0_in)" MAP 0x1D080C FLOAT32_IEEE_COL_DIRECT_S6_S3 0 trq_fl_a_S6_S3 0 100
 /begin AXIS_DESCR COM_AXIS m_mot_in trq_fl_a_S6_S3 8 -3.40282e+038 3.40282e+038 DEPOSIT ABSOLUTE AXIS_PTS_REF KF_MOSTOERKPL_ABO_X /end AXIS_DESCR
 /begin AXIS_DESCR COM_AXIS status_k0_in void_int_S6_S3 6 0 255 DEPOSIT ABSOLUTE AXIS_PTS_REF KF_MOSTOERKPL_ABO_Y /end AXIS_DESCR
/end CHARACTERISTIC
/begin AXIS_PTS KF_MOSTOERKPL_ABO_X "X-Achse: m_mot_in" 0x1D08CC m_mot_in FLOAT32_IEEE_X_INCR_DIRECT_S6_S3 0 trq_fl_a_S6_S3 8 -3.40282e+038 3.40282e+038 DEPOSIT ABSOLUTE /end AXIS_PTS
/begin AXIS_PTS KF_MOSTOERKPL_ABO_Y "Y-Achse: status_k0_in" 0x1D8C26 status_k0_in UBYTE_X_INCR_DIRECT_S6_S3 0 void_int_S6_S3 6 0 255 DEPOSIT ABSOLUTE /end AXIS_PTS
/begin CHARACTERISTIC KF_MZIELK0RAMPCVMABST_AND_ABO_W "Zielmoment der K0 während der Rampe in ABO" MAP 0x1D08EC FLOAT32_IEEE_COL_DIRECT_S6_S3 0 trq_fl_a_S6_S3 -3.40282e+038 3.40282e+038
 /begin AXIS_DESCR COM_AXIS NO_INPUT_QUANTITY c_int_S6_S3 8 -3.40282e+038 3.40282e+038 DEPOSIT ABSOLUTE AXIS_PTS_REF KF_MZIELK0RAMPCVMABST_AND_ABO_X /end AXIS_DESCR
 /begin AXIS_DESCR COM_AXIS NO_INPUT_QUANTITY phi_fl_S6_S3 8 -3.40282e+038 3.40282e+038 DEPOSIT ABSOLUTE AXIS_PTS_REF KF_MZIELK0RAMPCVMABST_AND_ABO_Y /end AXIS_DESCR
/end CHARACTERISTIC
/begin AXIS_PTS KF_MZIELK0RAMPCVMABST_AND_ABO_X "X-Achse: c_cm_in" 0x1D09EC NO_INPUT_QUANTITY FLOAT32_IEEE_X_INCR_DIRECT_S6_S3 0 c_int_S6_S3 8 -3.40282e+038 3.40282e+038 DEPOSIT ABSOLUTE /end AXIS_PTS
/begin AXIS_PTS KF_MZIELK0RAMPCVMABST_AND_ABO_Y "Y-Achse: abstellpos_vm_in" 0x1D0A0C NO_INPUT_QUANTITY FLOAT32_IEEE_X_INCR_DIRECT_S6_S3 0 phi_fl_S6_S3 8 -3.40282e+038 3.40282e+038 DEPOSIT ABSOLUTE /end AXIS_PTS
/begin CHARACTERISTIC KF_MZIELK0STATCVMABST_AND_ABO_W "Zielmoment der K0 vor der Rampe in ABO" MAP 0x1D0A2C FLOAT32_IEEE_COL_DIRECT_S6_S3 0 trq_fl_a_S6_S3 -3.40282e+038 3.40282e+038
 /begin AXIS_DESCR COM_AXIS NO_INPUT_QUANTITY c_int_S6_S3 8 -3.40282e+038 3.40282e+038 DEPOSIT ABSOLUTE AXIS_PTS_REF KF_MZIELK0STATCVMABST_AND_ABO_X /end AXIS_DESCR
 /begin AXIS_DESCR COM_AXIS NO_INPUT_QUANTITY phi_fl_S6_S3 8 -3.40282e+038 3.40282e+038 DEPOSIT ABSOLUTE AXIS_PTS_REF KF_MZIELK0STATCVMABST_AND_ABO_Y /end AXIS_DESCR
/end CHARACTERISTIC
/begin AXIS_PTS KF_MZIELK0STATCVMABST_AND_ABO_X "X-Achse: c_cm_in" 0x1D0B2C NO_INPUT_QUANTITY FLOAT32_IEEE_X_INCR_DIRECT_S6_S3 0 c_int_S6_S3 8 -3.40282e+038 3.40282e+038 DEPOSIT ABSOLUTE /end AXIS_PTS
/begin AXIS_PTS KF_MZIELK0STATCVMABST_AND_ABO_Y "Y-Achse: abstellpos_vm_in" 0x1D0B4C NO_INPUT_QUANTITY FLOAT32_IEEE_X_INCR_DIRECT_S6_S3 0 phi_fl_S6_S3 8 -3.40282e+038 3.40282e+038 DEPOSIT ABSOLUTE /end AXIS_PTS
/begin CHARACTERISTIC KF_NDEMNSOLLVM_SAK_ANK_W "Differenzdrehzahl zum Abbau des Dreh-zahloffset auf die Basis-Drehzahl zur Berechnung des Zielwerts der VM Soll-drehzahl beim Ankoppeln" MAP 0x1D12C4 FLOAT32_IEEE_COL_DIRECT_S6_S3 0 n_fl_S6_S3 -3.40282e+038 3.40282e+038
 /begin AXIS_DESCR COM_AXIS NO_INPUT_QUANTITY n_fl_S6_S3 10 -3.40282e+038 3.40282e+038 DEPOSIT ABSOLUTE AXIS_PTS_REF KF_NDEMNSOLLVM_SAK_ANK_X /end AXIS_DESCR
 /begin AXIS_DESCR COM_AXIS NO_INPUT_QUANTITY trq_fl_a_S6_S3 10 -3.40282e+038 3.40282e+038 DEPOSIT ABSOLUTE AXIS_PTS_REF KF_NDEMNSOLLVM_SAK_ANK_Y /end AXIS_DESCR
/end CHARACTERISTIC
/begin AXIS_PTS KF_NDEMNSOLLVM_SAK_ANK_X "Differenzdrehzahl zum Abbau des Dreh-zahloffset auf die Basis-Drehzahl zur Berechnung des Zielwerts der VM Soll-drehzahl beim Ankoppeln" 0x1D1454 NO_INPUT_QUANTITY FLOAT32_IEEE_X_INCR_DIRECT_S6_S3 0 n_fl_S6_S3 10 -3.40282e+038 3.40282e+038 DEPOSIT ABSOLUTE /end AXIS_PTS
/begin AXIS_PTS KF_NDEMNSOLLVM_SAK_ANK_Y "Differenzdrehzahl zum Abbau des Dreh-zahloffset auf die Basis-Drehzahl zur Berechnung des Zielwerts der VM Soll-drehzahl beim Ankoppeln" 0x1D147C NO_INPUT_QUANTITY FLOAT32_IEEE_X_INCR_DIRECT_S6_S3 0 trq_fl_a_S6_S3 10 -3.40282e+038 3.40282e+038 DEPOSIT ABSOLUTE /end AXIS_PTS
/begin CHARACTERISTIC KF_NGEMMODRSMAX_SYN_ANK_W "Maximaler Gradient der modifizierten EM-Drehzahl als Basisdrehzahl zur Be-stimmung der VM Solldrehzahl bei RS beim K0 Synchronisieren beim Ankoppeln" MAP 0x1D14A4 FLOAT32_IEEE_COL_DIRECT_S6_S3 0 ng_fl_S6_S3 0 50000
 /begin AXIS_DESCR COM_AXIS NO_INPUT_QUANTITY n_fl_S6_S3 5 -3.40282e+038 3.40282e+038 DEPOSIT ABSOLUTE AXIS_PTS_REF KF_NGEMMODRSMAX_SYN_ANK_X /end AXIS_DESCR
 /begin AXIS_DESCR COM_AXIS nd_sec_iae_syn_ank n_fl_S6_S3 4 -3.40282e+038 3.40282e+038 DEPOSIT ABSOLUTE AXIS_PTS_REF KF_NGEMMODRSMAX_SYN_ANK_Y /end AXIS_DESCR
/end CHARACTERISTIC
/begin AXIS_PTS KF_NGEMMODRSMAX_SYN_ANK_X "Maximaler Gradient der modifizierten EM-Drehzahl als Basisdrehzahl zur Be-stimmung der VM Solldrehzahl bei RS beim K0 Synchronisieren beim Ankoppeln" 0x1D14F4 NO_INPUT_QUANTITY FLOAT32_IEEE_X_INCR_DIRECT_S6_S3 0 n_fl_S6_S3 5 -3.40282e+038 3.40282e+038 DEPOSIT ABSOLUTE /end AXIS_PTS
/begin AXIS_PTS KF_NGEMMODRSMAX_SYN_ANK_Y "Maximaler Gradient der modifizierten EM-Drehzahl als Basisdrehzahl zur Be-stimmung der VM Solldrehzahl bei RS beim K0 Synchronisieren beim Ankoppeln" 0x1D1508 nd_sec_iae_syn_ank FLOAT32_IEEE_X_INCR_DIRECT_S6_S3 0 n_fl_S6_S3 4 -3.40282e+038 3.40282e+038 DEPOSIT ABSOLUTE /end AXIS_PTS
/begin CHARACTERISTIC KF_NOEMNSOLLVM_SAK_ANK_W "Drehzahloffset auf die Basis-Drehzahl zur Berechnung des Zielwerts der VM Soll-drehzahl beim Ankoppeln" MAP 0x1D1518 FLOAT32_IEEE_COL_DIRECT_S6_S3 0 n_fl_S6_S3 -3.40282e+038 3.40282e+038
 /begin AXIS_DESCR COM_AXIS NO_INPUT_QUANTITY n_fl_S6_S3 10 -3.40282e+038 3.40282e+038 DEPOSIT ABSOLUTE AXIS_PTS_REF KF_NOEMNSOLLVM_SAK_ANK_X /end AXIS_DESCR
 /begin AXIS_DESCR COM_AXIS NO_INPUT_QUANTITY n_fl_S6_S3 10 -3.40282e+038 3.40282e+038 DEPOSIT ABSOLUTE AXIS_PTS_REF KF_NOEMNSOLLVM_SAK_ANK_Y /end AXIS_DESCR
/end CHARACTERISTIC
/begin AXIS_PTS KF_NOEMNSOLLVM_SAK_ANK_X "Drehzahloffset auf die Basis-Drehzahl zur Berechnung des Zielwerts der VM Soll-drehzahl beim Ankoppeln" 0x1D16A8 NO_INPUT_QUANTITY FLOAT32_IEEE_X_INCR_DIRECT_S6_S3 0 n_fl_S6_S3 10 -3.40282e+038 3.40282e+038 DEPOSIT ABSOLUTE /end AXIS_PTS
/begin AXIS_PTS KF_NOEMNSOLLVM_SAK_ANK_Y "Drehzahloffset auf die Basis-Drehzahl zur Berechnung des Zielwerts der VM Soll-drehzahl beim Ankoppeln" 0x1D16D0 NO_INPUT_QUANTITY FLOAT32_IEEE_X_INCR_DIRECT_S6_S3 0 n_fl_S6_S3 10 -3.40282e+038 3.40282e+038 DEPOSIT ABSOLUTE /end AXIS_PTS
/begin CHARACTERISTIC KF_NSEMBED_GAB_ABST_W "EM-Drehzahlschwelle als Übergangsbe-dingung nach 'VM-Abstellen' d.h. zum Öffnen der K0 in Abhängigkeit der Getrie-beöltemperatur und der VM-Temperatur im Zustand 'VM geführt Abstellen' beim VM Abstellen" MAP 0x1D0DC0 FLOAT32_IEEE_COL_DIRECT_S6_S3 0 n_fl_S6_S3 0 10000
 /begin AXIS_DESCR COM_AXIS NO_INPUT_QUANTITY c_int_S6_S3 5 -3.40282e+038 3.40282e+038 DEPOSIT ABSOLUTE AXIS_PTS_REF KF_NSEMBED_GAB_ABST_X /end AXIS_DESCR
 /begin AXIS_DESCR COM_AXIS NO_INPUT_QUANTITY c_int_S6_S3 4 -3.40282e+038 3.40282e+038 DEPOSIT ABSOLUTE AXIS_PTS_REF KF_NSEMBED_GAB_ABST_Y /end AXIS_DESCR
/end CHARACTERISTIC
/begin AXIS_PTS KF_NSEMBED_GAB_ABST_X "" 0x1D0E10 NO_INPUT_QUANTITY FLOAT32_IEEE_X_INCR_DIRECT_S6_S3 0 c_int_S6_S3 5 -3.40282e+038 3.40282e+038 DEPOSIT ABSOLUTE /end AXIS_PTS
/begin AXIS_PTS KF_NSEMBED_GAB_ABST_Y "" 0x1D0E24 NO_INPUT_QUANTITY FLOAT32_IEEE_X_INCR_DIRECT_S6_S3 0 c_int_S6_S3 4 -3.40282e+038 3.40282e+038 DEPOSIT ABSOLUTE /end AXIS_PTS
/begin CHARACTERISTIC KF_TVMSTOERK0EMFIL_ABO_W "Timerzeit zur Aktiveriung von m_stoer_k0_em_fil, begrenzt auf min. 20ms" MAP 0x1D0B6C FLOAT32_IEEE_COL_DIRECT_S6_S3 0 t_fl_S6_S3 0.02 1
 /begin AXIS_DESCR COM_AXIS c_getriebe_egs_in c_int_S6_S3 8 -3.40282e+038 3.40282e+038 DEPOSIT ABSOLUTE AXIS_PTS_REF KF_TVMSTOERK0EMFIL_ABO_X /end AXIS_DESCR
 /begin AXIS_DESCR COM_AXIS NO_INPUT_QUANTITY trq_fl_a_S6_S3 8 -3.40282e+038 3.40282e+038 DEPOSIT ABSOLUTE AXIS_PTS_REF KF_TVMSTOERK0EMFIL_ABO_Y /end AXIS_DESCR
/end CHARACTERISTIC
/begin AXIS_PTS KF_TVMSTOERK0EMFIL_ABO_X "X-Achse: c_getriebe_egs_in" 0x1D0C6C c_getriebe_egs_in FLOAT32_IEEE_X_INCR_DIRECT_S6_S3 0 c_int_S6_S3 8 -3.40282e+038 3.40282e+038 DEPOSIT ABSOLUTE /end AXIS_PTS
/begin AXIS_PTS KF_TVMSTOERK0EMFIL_ABO_Y "Y-Achse: m_soll_k0_has_alt" 0x1D0C8C NO_INPUT_QUANTITY FLOAT32_IEEE_X_INCR_DIRECT_S6_S3 0 trq_fl_a_S6_S3 8 -3.40282e+038 3.40282e+038 DEPOSIT ABSOLUTE /end AXIS_PTS
/begin AXIS_PTS KL_1NOSOLLEM_DRS_X "Drehzahloffset auf die LL-Drehzahl des Verbrennungsmotors in Abhängigkeit von der Verbrennungsmotorkühlwassertemperatur" 0x1D18CC NO_INPUT_QUANTITY FLOAT32_IEEE_X_INCR_DIRECT_S6_S3 0 n_fl_S6_S3 5 -3.40282e+038 3.40282e+038 DEPOSIT ABSOLUTE /end AXIS_PTS
/begin CHARACTERISTIC KL_1NOSOLLEM_DRS_Y "Drehzahloffset auf die LL-Drehzahl des Verbrennungsmotors in Abhängigkeit von der Verbrennungsmotorkühlwassertemperatur" CURVE 0x1D18E0 FLOAT32_IEEE_COL_DIRECT_S6_S3 0 n_fl_S6_S3 -3.40282e+038 3.40282e+038
 /begin AXIS_DESCR COM_AXIS NO_INPUT_QUANTITY n_fl_S6_S3 5 -3.40282e+038 3.40282e+038 DEPOSIT ABSOLUTE AXIS_PTS_REF KL_1NOSOLLEM_DRS_X /end AXIS_DESCR
/end CHARACTERISTIC
/begin AXIS_PTS KL_MK0MODINIT_LAU_ABK_X "Basismoment zur Initialisierung des modifizierten K0 Moments in Abhängigkeit des VM-Sollmoments im Zustand 'Last-Übernahme' beim Abkoppeln" 0x1CFE04 NO_INPUT_QUANTITY FLOAT32_IEEE_X_INCR_DIRECT_S6_S3 0 trq_fl_a_S6_S3 6 -1000 1000 DEPOSIT ABSOLUTE /end AXIS_PTS
/begin CHARACTERISTIC KL_MK0MODINIT_LAU_ABK_Y "Basismoment zur Initialisierung des modifizierten K0 Moments in Abhängigkeit des VM-Sollmoments im Zustand Last-Übernahme beim Abkoppeln" CURVE 0x1CFE1C FLOAT32_IEEE_COL_DIRECT_S6_S3 0 trq_fl_a_S6_S3 -1000 1000
 /begin AXIS_DESCR COM_AXIS NO_INPUT_QUANTITY trq_fl_a_S6_S3 6 -1000 1000 DEPOSIT ABSOLUTE AXIS_PTS_REF KL_MK0MODINIT_LAU_ABK_X /end AXIS_DESCR
/end CHARACTERISTIC
/begin AXIS_PTS KL_MK0MODINIT_LAU_ABST_X "Basismoment zur Initialisierung des modifizierten K0 Moments in Abhängigkeit des VM-Sollmoments im Zustand Last-Übernahme beim Abstellen" 0x1D0E34 NO_INPUT_QUANTITY FLOAT32_IEEE_X_INCR_DIRECT_S6_S3 0 trq_fl_a_S6_S3 6 -1000 1000 DEPOSIT ABSOLUTE /end AXIS_PTS
/begin CHARACTERISTIC KL_MK0MODINIT_LAU_ABST_Y "Basismoment zur Initialisierung des modi-fizierten K0 Moments in Abhängigkeit des VM-Sollmoments im Zustand Last-Übernahme beim Abstellen" CURVE 0x1D0E4C FLOAT32_IEEE_COL_DIRECT_S6_S3 0 trq_fl_a_S6_S3 -1000 1000
 /begin AXIS_DESCR COM_AXIS NO_INPUT_QUANTITY trq_fl_a_S6_S3 6 -1000 1000 DEPOSIT ABSOLUTE AXIS_PTS_REF KL_MK0MODINIT_LAU_ABST_X /end AXIS_DESCR
/end CHARACTERISTIC
/begin AXIS_PTS KL_MOSOLLK0MVM_LAU_ABK_X "Offset auf den Betrag des VM-Basismoments zur Berechnung  des K0-Sollmoments bei der Lastübernahme beim Abkoppeln" 0x1CFE34 NO_INPUT_QUANTITY FLOAT32_IEEE_X_INCR_DIRECT_S6_S3 0 trq_fl_a_S6_S3 6 -3.40282e+038 3.40282e+038 DEPOSIT ABSOLUTE /end AXIS_PTS
/begin CHARACTERISTIC KL_MOSOLLK0MVM_LAU_ABK_Y "Offset auf den Betrag des VM-Basismoments zur Berechnung  des K0-Sollmoments bei der Lastübernahme beim Abkoppeln" CURVE 0x1CFE4C FLOAT32_IEEE_COL_DIRECT_S6_S3 0 trq_fl_a_S6_S3 -1000 1000
 /begin AXIS_DESCR COM_AXIS NO_INPUT_QUANTITY trq_fl_a_S6_S3 6 -3.40282e+038 3.40282e+038 DEPOSIT ABSOLUTE AXIS_PTS_REF KL_MOSOLLK0MVM_LAU_ABK_X /end AXIS_DESCR
/end CHARACTERISTIC
/begin AXIS_PTS KL_MOSOLLK0MVM_LAU_ABST_X "Offset auf den Betrag des VM-Basismoments zur Berechnung  des K0-Sollmoments im Zustand Last-Übernahme beim VM Abstellen" 0x1D0E64 NO_INPUT_QUANTITY FLOAT32_IEEE_X_INCR_DIRECT_S6_S3 0 trq_fl_a_S6_S3 6 -1000 1000 DEPOSIT ABSOLUTE /end AXIS_PTS
/begin CHARACTERISTIC KL_MOSOLLK0MVM_LAU_ABST_Y "Offset auf den Betrag des VM-Basismoments zur Berechnung  des K0-Sollmoments im Zustand Last-Übernahme beim VM Abstellen" CURVE 0x1D0E7C FLOAT32_IEEE_COL_DIRECT_S6_S3 0 trq_fl_a_S6_S3 -1000 1000
 /begin AXIS_DESCR COM_AXIS NO_INPUT_QUANTITY trq_fl_a_S6_S3 6 -1000 1000 DEPOSIT ABSOLUTE AXIS_PTS_REF KL_MOSOLLK0MVM_LAU_ABST_X /end AXIS_DESCR
/end CHARACTERISTIC
/begin AXIS_PTS KL_MSOLLK0BEF_KON_ANK_X "Vorgabe des K0-Sollmoments in der Füllausgleichsphase in Anhängigkeit des VM-Zielmoments im Zustand Konditionie-ren beim Ankoppeln" 0x1D16F8 NO_INPUT_QUANTITY FLOAT32_IEEE_X_INCR_DIRECT_S6_S3 0 trq_fl_a_S6_S3 5 -3.40282e+038 3.40282e+038 DEPOSIT ABSOLUTE /end AXIS_PTS
/begin CHARACTERISTIC KL_MSOLLK0BEF_KON_ANK_Y "Vorgabe des K0-Sollmoments in der Füllausgleichsphase in Anhängigkeit des VM-Zielmoments im Zustand Konditionieren beim Ankoppeln" CURVE 0x1D170C FLOAT32_IEEE_COL_DIRECT_S6_S3 0 trq_fl_a_S6_S3 0 100
 /begin AXIS_DESCR COM_AXIS NO_INPUT_QUANTITY trq_fl_a_S6_S3 5 -3.40282e+038 3.40282e+038 DEPOSIT ABSOLUTE AXIS_PTS_REF KL_MSOLLK0BEF_KON_ANK_X /end AXIS_DESCR
/end CHARACTERISTIC
/begin AXIS_PTS KL_MSOLLK0BEF_SAK_ANK_X "Vorgabe des K0-Sollmoments in der Füllausgleichsphase in Anhängigkeit des VM-Zielmoments im Zustand Schaltung aktiv beim Ankoppeln" 0x1D1720 NO_INPUT_QUANTITY FLOAT32_IEEE_X_INCR_DIRECT_S6_S3 0 trq_fl_a_S6_S3 5 -3.40282e+038 3.40282e+038 DEPOSIT ABSOLUTE /end AXIS_PTS
/begin CHARACTERISTIC KL_MSOLLK0BEF_SAK_ANK_Y "Vorgabe des K0-Sollmoments in der Füllausgleichsphase in Anhängigkeit des VM-Zielmoments im Zustand Schaltung aktiv beim Ankoppeln" CURVE 0x1D1734 FLOAT32_IEEE_COL_DIRECT_S6_S3 0 trq_fl_a_S6_S3 0 100
 /begin AXIS_DESCR COM_AXIS NO_INPUT_QUANTITY trq_fl_a_S6_S3 5 -3.40282e+038 3.40282e+038 DEPOSIT ABSOLUTE AXIS_PTS_REF KL_MSOLLK0BEF_SAK_ANK_X /end AXIS_DESCR
/end CHARACTERISTIC
/begin AXIS_PTS KL_MSOLLK0MIN_SYN_ANK_X "Minimalwert zur Initialisierung des K0-Sollmoments in Abhängigkeit des VM-Zielmoments im Zustand K0 Synchronisieren beim Ankoppeln" 0x1D1748 NO_INPUT_QUANTITY FLOAT32_IEEE_X_INCR_DIRECT_S6_S3 0 trq_fl_a_S6_S3 5 0 1000 DEPOSIT ABSOLUTE /end AXIS_PTS
/begin CHARACTERISTIC KL_MSOLLK0MIN_SYN_ANK_Y "Minimalwert zur Initialisierung des K0-Sollmoments in Abhängigkeit des VM-Zielmoments im Zustand K0 Synchronisieren beim Ankoppeln" CURVE 0x1D175C FLOAT32_IEEE_COL_DIRECT_S6_S3 0 trq_fl_a_S6_S3 0 100
 /begin AXIS_DESCR COM_AXIS NO_INPUT_QUANTITY trq_fl_a_S6_S3 5 0 1000 DEPOSIT ABSOLUTE AXIS_PTS_REF KL_MSOLLK0MIN_SYN_ANK_X /end AXIS_DESCR
/end CHARACTERISTIC
/begin AXIS_PTS KL_MSOLLK0ZIEL_GAB_ABST_X "Zielwert des K0-Sollmoments in Abhän-gigkeit des Betrags des EM-Istmoments im Zustand 'VM geführt Abstellen' beim VM Abstellen" 0x1D0E94 NO_INPUT_QUANTITY FLOAT32_IEEE_X_INCR_DIRECT_S6_S3 0 trq_fl_a_S6_S3 5 -3.40282e+038 3.40282e+038 DEPOSIT ABSOLUTE /end AXIS_PTS
/begin CHARACTERISTIC KL_MSOLLK0ZIEL_GAB_ABST_Y "Zielwert des K0-Sollmoments in Abhän-gigkeit des Betrags des EM-Istmoments im Zustand 'VM geführt Abstellen' beim VM Abstellen" CURVE 0x1D0EA8 FLOAT32_IEEE_COL_DIRECT_S6_S3 0 trq_fl_a_S6_S3 -1000 1000
 /begin AXIS_DESCR COM_AXIS NO_INPUT_QUANTITY trq_fl_a_S6_S3 5 -3.40282e+038 3.40282e+038 DEPOSIT ABSOLUTE AXIS_PTS_REF KL_MSOLLK0ZIEL_GAB_ABST_X /end AXIS_DESCR
/end CHARACTERISTIC
/begin AXIS_PTS KL_MSSOLLEMAKTIVSTKRAFTFL_ABO_X "X-Achse: status_kraftfluss_egs_in" 0x1D8C2C NO_INPUT_QUANTITY UBYTE_X_INCR_DIRECT_S6_S3 0 void_int_S6_S3 10 0 99 DEPOSIT ABSOLUTE /end AXIS_PTS
/begin CHARACTERISTIC KL_MSSOLLEMAKTIVSTKRAFTFL_ABO_Y "Flag zur Deaktivierung des Timers für mstoerk0em" CURVE 0x1D8C36 UBYTE_COL_DIRECT_S6_S3 0 void_int_S6_S3 0 1
 /begin AXIS_DESCR COM_AXIS NO_INPUT_QUANTITY void_int_S6_S3 10 0 99 DEPOSIT ABSOLUTE AXIS_PTS_REF KL_MSSOLLEMAKTIVSTKRAFTFL_ABO_X /end AXIS_DESCR
/end CHARACTERISTIC
/begin AXIS_PTS KL_MSSOLLEMAKTIV_ABO_X "X-Achse: istgang_egs_in" 0x1D8C40 NO_INPUT_QUANTITY SBYTE_X_INCR_DIRECT_S6_S3 0 void_int_S6_S3 10 -1 10 DEPOSIT ABSOLUTE /end AXIS_PTS
/begin CHARACTERISTIC KL_MSSOLLEMAKTIV_ABO_Y "Momentschwelle für Aktiveriung EM-Sollmomentüberwachung" CURVE 0x1D0CAC FLOAT32_IEEE_COL_DIRECT_S6_S3 0 trq_fl_a_S6_S3 -3.40282e+038 3.40282e+038
 /begin AXIS_DESCR COM_AXIS NO_INPUT_QUANTITY void_int_S6_S3 10 -1 10 DEPOSIT ABSOLUTE AXIS_PTS_REF KL_MSSOLLEMAKTIV_ABO_X /end AXIS_DESCR
/end CHARACTERISTIC
/begin AXIS_PTS KL_MVMVOLLASTSAUG_SYN_ANK_X "x-Achse: n_vm_in" 0x1D1770 NO_INPUT_QUANTITY FLOAT32_IEEE_X_INCR_DIRECT_S6_S3 0 n_fl_S6_S3 10 -3.40282e+038 3.40282e+038 DEPOSIT ABSOLUTE /end AXIS_PTS
/begin CHARACTERISTIC KL_MVMVOLLASTSAUG_SYN_ANK_Y "Y-Achse: Max. Saug-Volllastmoment des VM" CURVE 0x1D1798 FLOAT32_IEEE_COL_DIRECT_S6_S3 0 trq_fl_a_S6_S3 -3.40282e+038 3.40282e+038
 /begin AXIS_DESCR COM_AXIS NO_INPUT_QUANTITY n_fl_S6_S3 10 -3.40282e+038 3.40282e+038 DEPOSIT ABSOLUTE AXIS_PTS_REF KL_MVMVOLLASTSAUG_SYN_ANK_X /end AXIS_DESCR
/end CHARACTERISTIC
/begin AXIS_PTS KL_MZIELK0_SYN_ANK_X "Festlegung des K0 Zielmoments zur Bestimmung des K0 Sollmoments im Zustand K0 Synchronisieren beim Ankoppeln in Abhängigkeit des VM Zielmoments" 0x1D17C0 NO_INPUT_QUANTITY FLOAT32_IEEE_X_INCR_DIRECT_S6_S3 0 trq_fl_a_S6_S3 10 -3.40282e+038 3.40282e+038 DEPOSIT ABSOLUTE /end AXIS_PTS
/begin CHARACTERISTIC KL_MZIELK0_SYN_ANK_Y "Festlegung des K0 Zielmoments zur Bestimmung des K0 Sollmoments im Zustand K0 Synchronisieren beim Ankoppeln in Abhängigkeit des VM Zielmoments" CURVE 0x1D17E8 FLOAT32_IEEE_COL_DIRECT_S6_S3 0 trq_fl_a_S6_S3 -3.40282e+038 3.40282e+038
 /begin AXIS_DESCR COM_AXIS NO_INPUT_QUANTITY trq_fl_a_S6_S3 10 -3.40282e+038 3.40282e+038 DEPOSIT ABSOLUTE AXIS_PTS_REF KL_MZIELK0_SYN_ANK_X /end AXIS_DESCR
/end CHARACTERISTIC
/begin AXIS_PTS KL_NDGSK0SYNCERK_SYN_ANK_X "x-Achse: m_ziel_vm_has" 0x1D1810 NO_INPUT_QUANTITY FLOAT32_IEEE_X_INCR_DIRECT_S6_S3 0 trq_fl_a_S6_S3 10 -3.40282e+038 3.40282e+038 DEPOSIT ABSOLUTE /end AXIS_PTS
/begin CHARACTERISTIC KL_NDGSK0SYNCERK_SYN_ANK_Y "Y-Achse: Schwelle für ndg_k0_in zur Weiterschaltung in Phase K0-Schliessen" CURVE 0x1D1838 FLOAT32_IEEE_COL_DIRECT_S6_S3 0 ng_fl_S6_S3 -3.40282e+038 3.40282e+038
 /begin AXIS_DESCR COM_AXIS NO_INPUT_QUANTITY trq_fl_a_S6_S3 10 -3.40282e+038 3.40282e+038 DEPOSIT ABSOLUTE AXIS_PTS_REF KL_NDGSK0SYNCERK_SYN_ANK_X /end AXIS_DESCR
/end CHARACTERISTIC
/begin AXIS_PTS KL_NDSK0SYNCERK_SYN_ANK_X "Schwellwert zur Erkennung Synchron beim Ankoppeln in Abhängigkeit des EM Drehzahlgradienten" 0x1D1860 NO_INPUT_QUANTITY FLOAT32_IEEE_X_INCR_DIRECT_S6_S3 0 trq_fl_a_S6_S3 5 -3.40282e+038 3.40282e+038 DEPOSIT ABSOLUTE /end AXIS_PTS
/begin CHARACTERISTIC KL_NDSK0SYNCERK_SYN_ANK_Y "Schwellwert zur Erkennung Synchron beim Ankoppeln in Abhängigkeit des EM Drehzahlgradienten" CURVE 0x1D1874 FLOAT32_IEEE_COL_DIRECT_S6_S3 0 n_fl_S6_S3 -3.40282e+038 3.40282e+038
 /begin AXIS_DESCR COM_AXIS NO_INPUT_QUANTITY trq_fl_a_S6_S3 5 -3.40282e+038 3.40282e+038 DEPOSIT ABSOLUTE AXIS_PTS_REF KL_NDSK0SYNCERK_SYN_ANK_X /end AXIS_DESCR
/end CHARACTERISTIC
/begin AXIS_PTS KL_TK0SYNCERKUMS_SYN_ANK_X "Zeit bis zur Umschaltung der Differenz-drehzahlschwelle zur Erkennung Syn-chron beim Ankoppeln in Abhängigkeit des VM Zielmoments" 0x1D1888 NO_INPUT_QUANTITY FLOAT32_IEEE_X_INCR_DIRECT_S6_S3 0 trq_fl_a_S6_S3 5 -3.40282e+038 3.40282e+038 DEPOSIT ABSOLUTE /end AXIS_PTS
/begin CHARACTERISTIC KL_TK0SYNCERKUMS_SYN_ANK_Y "Zeit bis zur Umschaltung der Differenz-drehzahlschwelle zur Erkennung Syn-chron beim Ankoppeln in Abhängigkeit des VM Zielmoments" CURVE 0x1D189C FLOAT32_IEEE_COL_DIRECT_S6_S3 0 t_fl_S6_S3 -3.40282e+038 3.40282e+038
 /begin AXIS_DESCR COM_AXIS NO_INPUT_QUANTITY trq_fl_a_S6_S3 5 -3.40282e+038 3.40282e+038 DEPOSIT ABSOLUTE AXIS_PTS_REF KL_TK0SYNCERKUMS_SYN_ANK_X /end AXIS_DESCR
/end CHARACTERISTIC
/begin CHARACTERISTIC KOLBENP_MOMRAMPE_AKT_AND_ABO "Bei überschreiten der Schwelle wird Timer gestartet. Nach Ablauf des Timers startet die Momentrampe" VALUE 0x1CFE6C FLOAT32_IEEE_COL_DIRECT_S6_S3 0 void_fl_S6_S3 -3.40282e+038 3.40282e+038 /end CHARACTERISTIC
/begin CHARACTERISTIC K_MSTOERKPL_AND_ABO "Gewichtungsfaktor auf das Kupplungsmoment zur Berechnung des Störmoments im Zustand KON" VALUE 0x1CFE70 FLOAT32_IEEE_COL_DIRECT_S6_S3 0 void_fl_S6_S3 -3.40282e+038 3.40282e+038 /end CHARACTERISTIC
/begin CHARACTERISTIC K_MZIELNOEMSOLLVM_SAK_ANK "Gewichtungsfaktor für das VM-Zielmoment der HAS aus der Fahrpedal-Interpretation zur Bestimmung der VM-Solldrehzahl der HAS beim Ankoppeln" VALUE 0x1D7CC7 UBYTE_COL_DIRECT_S6_S3 0 void_int_S6_S3 0 255 /end CHARACTERISTIC
/begin CHARACTERISTIC K_NOEMNSOLLVMOKS_KON_ANK "Faktor zur Gewichtung des Drehzahloff-set bei der  Bestimmung der VM-Solldrehzahl ohne Kraftschluss ab dem Zustand Konditionieren und im Zustand Schaltung aktiv beim Ankoppeln" VALUE 0x1D0EC4 FLOAT32_IEEE_COL_DIRECT_S6_S3 0 void_fl_S6_S3 0 1 /end CHARACTERISTIC
/begin CHARACTERISTIC K_SVH_RESET_ABB_ANK "Rücksetzen einer Schaltverhinderung während VM-Ankoppeln beim Abbruch Ankoppeln (255 = alle Arten von Schal-tungen zurücksetzen, 0 = keine Schaltung zurücksetzen).  Bit-Codierung siehe Handbuch" VALUE 0x1D7CC8 UBYTE_COL_DIRECT_S6_S3 0 void_int_S6_S3 0 255 /end CHARACTERISTIC
/begin CHARACTERISTIC K_SVH_RESET_AST_ABST "Rücksetzen einer Schaltverhinderung während VM-Abstellen im Zustand Abstellen (255 = alle Arten von Schaltungen zurücksetzen, 0 = keine Schaltung zurücksetzen)  Bit-Codierung siehe Handbuch" VALUE 0x1D7CAF UBYTE_COL_DIRECT_S6_S3 0 void_int_S6_S3 0 255 /end CHARACTERISTIC
/begin CHARACTERISTIC K_SVH_RESET_KOE_ABK "Rücksetzen einer Schaltverhinderung während Abkoppeln im Zustand K0-Oeffnen  (255 = alle Arten von Schaltungen zurücksetzen, 0 = keine Schaltung zurücksetzen) -> Bit-Codierung siehe Handbuch" VALUE 0x1D7C97 UBYTE_COL_DIRECT_S6_S3 0 void_int_S6_S3 0 255 /end CHARACTERISTIC
/begin CHARACTERISTIC K_SVH_RESET_KON_ANK "Rücksetzen einer Schaltverhinderung während VM-Ankoppeln beim Konditionieren (255 = alle Arten von Schaltungen zurücksetzen, 0 = keine Schaltung zurücksetzen). Bit-Codierung siehe Handbuch" VALUE 0x1D7CC9 UBYTE_COL_DIRECT_S6_S3 0 void_int_S6_S3 0 255 /end CHARACTERISTIC
/begin CHARACTERISTIC K_SVH_RESET_KSA_ABK "Rücksetzen einer Schaltverhinderung während Abkoppeln im Zustand Schliessen Abbruch  (255 = alle Arten von Schaltungen zurücksetzen, 0 = keine Schaltung zurücksetzen) -> Bit-Codierung siehe Handbuch" VALUE 0x1D7C98 UBYTE_COL_DIRECT_S6_S3 0 void_int_S6_S3 0 255 /end CHARACTERISTIC
/begin CHARACTERISTIC K_SVH_RESET_LAU_ABK "Rücksetzen einer Schaltverhinderung während Abkoppeln im Zustand Last Uebernahme  (255 = alle Arten von Schaltungen zurücksetzen, 0 = keine Schaltung zurücksetzen) -> Bit-Codierung siehe Handbuch" VALUE 0x1D7C99 UBYTE_COL_DIRECT_S6_S3 0 void_int_S6_S3 0 255 /end CHARACTERISTIC
/begin CHARACTERISTIC K_SVH_RESET_LAU_ABST "Rücksetzen einer Schaltverhinderung während VM-Abstellen im Zustand Last Uebernahme mit EM (255 = alle Arten von Schaltungen zurücksetzen, 0 = keine Schaltung zurücksetzen)  Bit-Codierung siehe Handbuch" VALUE 0x1D7CB0 UBYTE_COL_DIRECT_S6_S3 0 void_int_S6_S3 0 255 /end CHARACTERISTIC
/begin CHARACTERISTIC K_SVH_RESET_SAK_ABST "Rücksetzen einer Schaltverhinderung während VM-Abstellen im Zustand Last Uebernahme mit EM (255 = alle Arten von Schaltungen zurücksetzen, 0 = keine Schaltung zurücksetzen)  Bit-Codierung siehe Handbuch" VALUE 0x1D7CB1 UBYTE_COL_DIRECT_S6_S3 0 void_int_S6_S3 0 255 /end CHARACTERISTIC
/begin CHARACTERISTIC K_SVH_RESET_SAK_ANK "Bedingtes Rücksetzen einer Schaltverhinderung während VM-Ankoppeln bei Schaltung aktiv (255 = alle Arten von Schaltungen zurücksetzen, 0 = keine Schaltung zurücksetzen). Bit-Codierung siehe Handbuch" VALUE 0x1D7CCA UBYTE_COL_DIRECT_S6_S3 0 void_int_S6_S3 0 255 /end CHARACTERISTIC
/begin CHARACTERISTIC K_SVH_RESET_SCL_ANK "Rücksetzen einer Schaltverhinderung während VM-Ankoppeln beim K0-Schliessen (255 = alle Arten von Schaltungen zurücksetzen, 0 = keine Schaltung zurücksetzen). Bit-Codierung siehe Handbuch" VALUE 0x1D7CCB UBYTE_COL_DIRECT_S6_S3 0 void_int_S6_S3 0 255 /end CHARACTERISTIC
/begin CHARACTERISTIC K_SVH_RESET_SRT_ABST "Rücksetzen einer Schaltverhinderung während VM-Abstellen im Zustand Start (255 = alle Arten von Schaltungen zurücksetzen, 0 = keine Schaltung zurücksetzen)  Bit-Codierung siehe Handbuch" VALUE 0x1D7CB2 UBYTE_COL_DIRECT_S6_S3 0 void_int_S6_S3 0 255 /end CHARACTERISTIC
/begin CHARACTERISTIC K_SVH_RESET_SRT_ANK "Bedingtes Rücksetzen einer Schaltverhinderung während VM-Ankoppeln bei Zustand Start (255 = alle Arten von Schaltungen zurücksetzen, 0 = keine Schaltung zurücksetzen). Bit-Codierung siehe Handbuch" VALUE 0x1D7CCC UBYTE_COL_DIRECT_S6_S3 0 void_int_S6_S3 0 255 /end CHARACTERISTIC
/begin CHARACTERISTIC K_SVH_RESET_SYN_ANK "Rücksetzen einer Schaltverhinderung während VM-Ankoppeln beim K0-Synchronisieren (255 = alle Arten von Schaltungen zurücksetzen, 0 = keine Schaltung zurücksetzen). Bit-Codierung siehe Handbuch" VALUE 0x1D7CCD UBYTE_COL_DIRECT_S6_S3 0 void_int_S6_S3 0 255 /end CHARACTERISTIC
/begin CHARACTERISTIC K_SVH_RESET_UAB_ABK "Rücksetzen einer Schaltverhinderung während Abkoppeln im Zustand Uebergabe Abbruch  (255 = alle Arten von Schaltungen zurücksetzen, 0 = keine Schaltung zurücksetzen) -> Bit-Codierung siehe Handbuch" VALUE 0x1D7C9C UBYTE_COL_DIRECT_S6_S3 0 void_int_S6_S3 0 255 /end CHARACTERISTIC
/begin CHARACTERISTIC K_SVH_RESET_UEB_ABK "Rücksetzen einer Schaltverhinderung während Abkoppeln im Zustand Uebergabe  (255 = alle Arten von Schaltungen zurücksetzen, 0 = keine Schaltung zurücksetzen) -> Bit-Codierung siehe Handbuch" VALUE 0x1D7C9D UBYTE_COL_DIRECT_S6_S3 0 void_int_S6_S3 0 255 /end CHARACTERISTIC
/begin CHARACTERISTIC MDS_MOTBREMSREKU_LAU_ABST "Differenzmomentschwelle (m_min_vm_in - m_vm_in) zur Erkennung der aktiven Bremsrekuperation im Zustand 'Last-Übernahme' beim VM Abstellen" VALUE 0x1D0D2C FLOAT32_IEEE_COL_DIRECT_S6_S3 0 trq_fl_a_S6_S3 -1000 1000 /end CHARACTERISTIC
/begin CHARACTERISTIC MDS_ZIELK0NSOLLVMINIT_SYN_ANK "Differenz zwischen K0-Zielmoment und K0-Zielmoment aus dem letzten Task zur Initialisierung der VM-Solldrehzahl beim Ankoppeln" VALUE 0x1D0EC8 FLOAT32_IEEE_COL_DIRECT_S6_S3 0 trq_fl_a_S6_S3 0 1000 /end CHARACTERISTIC
/begin CHARACTERISTIC MD_ZIELSOLLK0_SYN_ANK "Differenz zwischen K0-Ziel- und Sollmoment zur Init. der VM-Solldrehzahl beim Ankoppeln" VALUE 0x1D0ECC FLOAT32_IEEE_COL_DIRECT_S6_S3 0 trq_fl_a_S6_S3 -1000 1000 /end CHARACTERISTIC
/begin CHARACTERISTIC MGS_WUNSCHFPW_SYN_ANK "Gradientschwelle zur Init. der VM-Solldrehzahl beim VM bzw. K0-Syn. beinm Ankoppeln" VALUE 0x1D0ED0 FLOAT32_IEEE_COL_DIRECT_S6_S3 0 trq_fl_a_S6_S3 -25000 25000 /end CHARACTERISTIC
/begin CHARACTERISTIC MG_1MMAXEM_DRS "Gradient für maximale Grenze Regler EM" VALUE 0x1D18B0 FLOAT32_IEEE_COL_DIRECT_S6_S3 0 trqg_fl_c_S6_S3 -3.40282e+038 3.40282e+038 /end CHARACTERISTIC
/begin CHARACTERISTIC MG_1MMINEM_DRS "Gradient für minimale Grenze Regler EM" VALUE 0x1D18B4 FLOAT32_IEEE_COL_DIRECT_S6_S3 0 trqg_fl_c_S6_S3 -3.40282e+038 3.40282e+038 /end CHARACTERISTIC
/begin CHARACTERISTIC MG_K0MODHASMAXABBR_SCL_ANK "Maximaler Gradienten des modifizierten K0-Moments der HAS bei einem direkten Übergang STR nach SCL im Zustand K0-Schliessen beim Ankoppeln" VALUE 0x1D0ED4 FLOAT32_IEEE_COL_DIRECT_S6_S3 0 trqg_fl_c_S6_S3 0 50000 /end CHARACTERISTIC
/begin CHARACTERISTIC MG_K0MODHASMAXK0SREG_SCL_ANK "Maximaler Gradienten des modifizierten K0-Moments der HAS bei aktiver K0 Schlupfregelung im Zustand K0-Schliessen beim Ankoppeln" VALUE 0x1D0ED8 FLOAT32_IEEE_COL_DIRECT_S6_S3 0 trqg_fl_c_S6_S3 0 50000 /end CHARACTERISTIC
/begin CHARACTERISTIC MG_K0MODHASSAREKU_LAU_ABST "Gradient zum Abbau des modifizierten K0-Moments bei aktiver VM Schubab-schaltung und aktiver Bremsrekuperation im Zustand 'Last-Übernahme' beim VM Abstellen" VALUE 0x1D0D30 FLOAT32_IEEE_COL_DIRECT_S6_S3 0 trqg_fl_c_S6_S3 -10000 0 /end CHARACTERISTIC
/begin CHARACTERISTIC MG_K0MODHASSA_LAU_ABST "Gradient zum Abbau des modifizierten K0-Moments bei aktiver VM Schubab-schaltung im Zustand 'Last-Übernahme' beim VM Abstellen" VALUE 0x1D0D34 FLOAT32_IEEE_COL_DIRECT_S6_S3 0 trqg_fl_c_S6_S3 -10000 0 /end CHARACTERISTIC
/begin CHARACTERISTIC MG_K0MODHAS_LAU_ABK "Gradient zum Abbau des modifizierten K0-Moments im Zustand 'Last-Übernahme' beim Abkoppeln" VALUE 0x1CFDB4 FLOAT32_IEEE_COL_DIRECT_S6_S3 0 trqg_fl_c_S6_S3 -10000 0 /end CHARACTERISTIC
/begin CHARACTERISTIC MG_K0MODHAS_LAU_ABST "Gradient zum Abbau des modifizierten K0-Moments im Zustand Last-Übernahme beim VM Abstellen" VALUE 0x1D0D38 FLOAT32_IEEE_COL_DIRECT_S6_S3 0 trqg_fl_c_S6_S3 -10000 0 /end CHARACTERISTIC
/begin CHARACTERISTIC MG_K0MODMAXMAX_SYN_ANK "Maximaler Gradienten des Maximalwerts des modifizierten K0-Moments der HAS im Zustand K0-Synchronisieren beim Ankoppeln" VALUE 0x1D0EDC FLOAT32_IEEE_COL_DIRECT_S6_S3 0 trqg_fl_c_S6_S3 0 50000 /end CHARACTERISTIC
/begin CHARACTERISTIC MG_K0SYNCMK0ERHDIAG_SYN_ANK "Gradient des K0 Sollmoments diagnoseseitiger Anhebung des K0-Sollmoments im Zustand K0 Synchronisieren beim VM Ankoppeln" VALUE 0x1D0EE0 FLOAT32_IEEE_COL_DIRECT_S6_S3 0 trqg_fl_c_S6_S3 0 10000 /end CHARACTERISTIC
/begin CHARACTERISTIC MG_K0SYNCVMVOLLAST_SYN_ANK "Gradient zum K0-Sync. bei K0-Moment über der Saugvolllastkennlinie der VM" VALUE 0x1D0EE4 FLOAT32_IEEE_COL_DIRECT_S6_S3 0 trqg_fl_c_S6_S3 -10000 10000 /end CHARACTERISTIC
/begin CHARACTERISTIC MG_SOLLK0HASMAXABBR_SCL_ANK "Maximaler Gradienten des K0-Sollmoments der HAS bei einem direkten Übergang STR nach SCL im Zustand K0-Schliessen beim Ankoppeln" VALUE 0x1D0EE8 FLOAT32_IEEE_COL_DIRECT_S6_S3 0 trqg_fl_c_S6_S3 0 50000 /end CHARACTERISTIC
/begin CHARACTERISTIC MG_SOLLK0MIN_SYN_ANK "Minimaler Gradient des K0-Sollmoments im Zustand K0 Synchronisieren beim Ankoppeln" VALUE 0x1D0EEC FLOAT32_IEEE_COL_DIRECT_S6_S3 0 trqg_fl_c_S6_S3 -10000 0 /end CHARACTERISTIC
/begin CHARACTERISTIC MG_SOLLK0NEG_GAB_ABST "Gradient zum Abbau des K0 Sollmoments im Zustand 'VM geführt Abstellen' beim VM Abstellen" VALUE 0x1D0D3C FLOAT32_IEEE_COL_DIRECT_S6_S3 0 trqg_fl_c_S6_S3 -10000 0 /end CHARACTERISTIC
/begin CHARACTERISTIC MG_SOLLK0POS_GAB_ABST "Gradient zum Anheben des K0 Sollmo-ments im Zustand 'VM geführt Abstellen' beim VM Abstellen" VALUE 0x1D0D40 FLOAT32_IEEE_COL_DIRECT_S6_S3 0 trqg_fl_c_S6_S3 0 10000 /end CHARACTERISTIC
/begin CHARACTERISTIC MG_SOLLK0_ABB_ANK "Gradienten für das K0-Sollmoments der HAS im Zustand 'Abbruch Ankoppeln' beim Ankoppeln" VALUE 0x1D0EF0 FLOAT32_IEEE_COL_DIRECT_S6_S3 0 trqg_fl_c_S6_S3 0 50000 /end CHARACTERISTIC
/begin CHARACTERISTIC MG_SOLLK0_ABB_NOS "Gradienten für das K0-Sollmoments der HAS im Zustand Abbruch Nostart beim Notstart" VALUE 0x1D18FC FLOAT32_IEEE_COL_DIRECT_S6_S3 0 trqg_fl_c_S6_S3 0 50000 /end CHARACTERISTIC
/begin CHARACTERISTIC MO_K0MODHASK0OEFFNEN_LAU_ABK "Offset auf das modifizierte K0-Moment als Übergangsbedingung nach 'K0-Öffnen' im Zustand 'Last-Übernahme' beim Abkoppeln" VALUE 0x1CFDB8 FLOAT32_IEEE_COL_DIRECT_S6_S3 0 trq_fl_a_S6_S3 -1000 1000 /end CHARACTERISTIC
/begin CHARACTERISTIC MO_K0MODHASK0OEFFNEN_LAU_ABST "Offset auf das modifizierte K0-Moment als Übergangsbedingung nach K0-Öffnen im Zustand Last-Übernahme beim VM Abstellen" VALUE 0x1D0D44 FLOAT32_IEEE_COL_DIRECT_S6_S3 0 trq_fl_a_S6_S3 -1000 1000 /end CHARACTERISTIC
/begin CHARACTERISTIC MO_K0OEFFNENBED_LAU_ABST "Offset auf das K0 Sollmoment zur Abfrage des K0-Moments als Übergangsbedingung nach K0-Öffnen im Zustand Last-Übernahme beim VM Abstellen" VALUE 0x1D0D48 FLOAT32_IEEE_COL_DIRECT_S6_S3 0 trq_fl_a_S6_S3 -1000 1000 /end CHARACTERISTIC
/begin CHARACTERISTIC MO_K0REGELN_GAB_ABST "Offset auf das K0-.Moment zur Initialisie-rung des K0-Sollmoments beim Wechsel SCHLUPFREGELUNG nach DRUCK-STELLUNG im Zustand 'VM geführt Ab-stellen' beim VM Abstellen" VALUE 0x1D0D4C FLOAT32_IEEE_COL_DIRECT_S6_S3 0 trq_fl_a_S6_S3 -1000 1000 /end CHARACTERISTIC
/begin CHARACTERISTIC MO_K0REGELN_KOE_ABK "Offset auf das K0-.Moment zur Initialisierung des K0-Sollmoments beim Wechsel SCHLUPFREGELUNG nach DRUCKSTELLUNG im Zustand 'K0-Öffnen' beim Abkoppeln" VALUE 0x1CFDC0 FLOAT32_IEEE_COL_DIRECT_S6_S3 0 trq_fl_a_S6_S3 -1000 1000 /end CHARACTERISTIC
/begin CHARACTERISTIC MO_K0REGELN_KOE_ABST "Offset auf das K0-.Moment zur Initialisierung des K0-Sollmoments beim Wechsel SCHLUPFREGELUNG nach DRUCKSTELLUNG im Zustand K0-Öffnen beim VM Abstellen" VALUE 0x1D0D50 FLOAT32_IEEE_COL_DIRECT_S6_S3 0 trq_fl_a_S6_S3 -1000 1000 /end CHARACTERISTIC
/begin CHARACTERISTIC MO_SOLLK0BEGRK0SREG_LAU_ABST "Offset auf das K0-Istmoment zur Bestim-mung des Begrenzungsmoment des K0 Sollmoments bei vor dem Ablauf aktiver K0 Schlupfregelung und unterdrückter Aktivierung der K0 Schlupfregelung im Zustand 'Last-Übernahme' beim VM Ab-stellen" VALUE 0x1D0D54 FLOAT32_IEEE_COL_DIRECT_S6_S3 0 trq_fl_a_S6_S3 -1000 1000 /end CHARACTERISTIC
/begin CHARACTERISTIC MO_SOLLVMHSTBED_SCL_ANK "Ofset auf das VM-Sollmoment der HST zun Vergleich mit dem K0_Solmoment der HAS als Aktivierungsbed. Ansteuerung K0-Schliessen beim Ankoppeln" VALUE 0x1D0EF4 FLOAT32_IEEE_COL_DIRECT_S6_S3 0 trq_fl_a_S6_S3 -10000 10000 /end CHARACTERISTIC
/begin CHARACTERISTIC MO_SOLLVMHSTMSOLLK0_SCL_ANK "OfFset auf das VML-Sollmoment der HST zun Vergleich mit dem K0_Solmoment der HAS als Aktivierungsbed. Ansteuerung K0-Schliessen beim Ankoppeln" VALUE 0x1D0EF8 FLOAT32_IEEE_COL_DIRECT_S6_S3 0 trq_fl_a_S6_S3 -10000 10000 /end CHARACTERISTIC
/begin CHARACTERISTIC MO_SOLLVMLHSTBED_SCL_ANK "Ofset auf das VML-Sollmoment der HST zun Vergleich mit dem K0_Solmoment der HAS als Aktivierungsbed. Ansteuerung K0-Schliessen beim Ankoppeln" VALUE 0x1D0EFC FLOAT32_IEEE_COL_DIRECT_S6_S3 0 trq_fl_a_S6_S3 -10000 10000 /end CHARACTERISTIC
/begin CHARACTERISTIC MO_SOLLVMLHSTMSOLLK0_SCL_ANK "Ofset auf das VML-Sollmoment der HST zun Vergleich mit dem K0_Solmoment der HAS als Aktivierungsbed. Ansteuerung K0-Schliessen beim Ankoppeln" VALUE 0x1D0F00 FLOAT32_IEEE_COL_DIRECT_S6_S3 0 trq_fl_a_S6_S3 -10000 10000 /end CHARACTERISTIC
/begin CHARACTERISTIC MO_VMK0ZUBED_KSA_ABK "Offset auf das VM-Moment zum Vergleich mit dem K0-Moment als Übergangsbedingung nach 'Übergabe Abbruch' im Zustand 'K0-Schließen Abbruch' beim Abkoppeln" VALUE 0x1CFDC4 FLOAT32_IEEE_COL_DIRECT_S6_S3 0 trq_fl_a_S6_S3 -1000 1000 /end CHARACTERISTIC
/begin CHARACTERISTIC MO_VMK0ZUBED_KSA_ABST "Offset auf das VM-Moment zum Vergleich mit dem K0-Moment als Übergangsbedingung nach Übergabe Abbruch im Zustand K0-Schließen Abbruch beim VM Abstellen" VALUE 0x1D0D58 FLOAT32_IEEE_COL_DIRECT_S6_S3 0 trq_fl_a_S6_S3 -1000 1000 /end CHARACTERISTIC
/begin CHARACTERISTIC MO_VMMGSOLLK0_SYN_ANK "Offset zur Reduzierung des VM-Istmoments bei der Bestimmung des K0 Gradienten beim Ankoppeln" VALUE 0x1D0F04 FLOAT32_IEEE_COL_DIRECT_S6_S3 0 trq_fl_a_S6_S3 -10000 10000 /end CHARACTERISTIC
/begin CHARACTERISTIC MS_K0BED_ABB_ANK "K0-Momentenschwelle als Übergangsbedingung nach 'Übergabe Abkoppeln Abbruch' im Zustand 'Ankoppeln Abbruch' beim Ankoppeln" VALUE 0x1D0F08 FLOAT32_IEEE_COL_DIRECT_S6_S3 0 trq_fl_a_S6_S3 -1000 1000 /end CHARACTERISTIC
/begin CHARACTERISTIC MS_K0BED_AST_ABST "K0-Momentenschwelle als Übergangsbedingung nach Übergabe  in Verbindung mit K0 Status OFFEN im Zustand VM-Abstellen beim VM Abstellen " VALUE 0x1D0D5C FLOAT32_IEEE_COL_DIRECT_S6_S3 0 trq_fl_a_S6_S3 -1000 1000 /end CHARACTERISTIC
/begin CHARACTERISTIC MS_K0OEFFNENBED_LAU_ABST "K0-Momentschwelle als Übergangsbedingung nach K0-Öffnen im Zustand Last-Übernahme beim VM Abstellen" VALUE 0x1D0D60 FLOAT32_IEEE_COL_DIRECT_S6_S3 0 trq_fl_a_S6_S3 -1000 1000 /end CHARACTERISTIC
/begin CHARACTERISTIC MS_K0SCHLBED_SRT_ANK "Momentenschwelle für K0 für direkten Übergang nach K0-Schließen bei Abbruch Abstellen beim Ankoppeln" VALUE 0x1D0F0C FLOAT32_IEEE_COL_DIRECT_S6_S3 0 trq_fl_a_S6_S3 -1000 1000 /end CHARACTERISTIC
/begin CHARACTERISTIC MS_K0VMABKBED_KOE_ABK "Schwelle des K0-Moments als Übergangsbedingung nach 'Übergabe' im Zustand 'K0-Öffnen' beim Abkoppeln" VALUE 0x1CFDCC FLOAT32_IEEE_COL_DIRECT_S6_S3 0 trq_fl_a_S6_S3 -1000 1000 /end CHARACTERISTIC
/begin CHARACTERISTIC MS_K0VMABSTBED_KOE_ABST "Schwelle des K0-Momants als Übergangsbedingung nach VM-Abstellen im Zustand K0-Öffnen beim VM Abstellen" VALUE 0x1D0D64 FLOAT32_IEEE_COL_DIRECT_S6_S3 0 trq_fl_a_S6_S3 -1000 1000 /end CHARACTERISTIC
/begin CHARACTERISTIC MS_RESEM_AND_ABO "Minmalwert für m_soll_res_em im Zustand KON" VALUE 0x1CFE78 FLOAT32_IEEE_COL_DIRECT_S6_S3 0 trq_fl_a_S6_S3 0 200 /end CHARACTERISTIC
/begin CHARACTERISTIC MS_RESEM_SRT_ABO "Minmalwert für m_soll_res_em im Zustand SRT" VALUE 0x1CFE7C FLOAT32_IEEE_COL_DIRECT_S6_S3 0 trq_fl_a_S6_S3 0 200 /end CHARACTERISTIC
/begin CHARACTERISTIC MS_SOLLK0K0SREG_SYN_ANK "Schwelle für das K0-Sollmoment der HAS als Basisbedingung für die Anforde-rung der Aktivierung der K0-Schlupfregelung im Zustand K0 Synchro-nisieren beim Ankoppeln" VALUE 0x1D0F10 FLOAT32_IEEE_COL_DIRECT_S6_S3 0 trq_fl_a_S6_S3 -1000 1000 /end CHARACTERISTIC
/begin CHARACTERISTIC MS_VMK0OEFFNEN_LAU_ABK "Schwelle für den Betrag des VM Moments als Übergangsbedingung nach 'K0-Öffnen' im Zustand 'Last-Übernahme' beim Abkoppeln" VALUE 0x1CFDD0 FLOAT32_IEEE_COL_DIRECT_S6_S3 0 trq_fl_a_S6_S3 -1000 1000 /end CHARACTERISTIC
/begin CHARACTERISTIC MS_VMK0OEFFNEN_LAU_ABST "Schwelle für den Betrag des VM Moments als Übergangsbedingung nach K0-Öffnen im Zustand Last-Übernahme beim VM Abstellen" VALUE 0x1D0D68 FLOAT32_IEEE_COL_DIRECT_S6_S3 0 trq_fl_a_S6_S3 -1000 1000 /end CHARACTERISTIC
/begin CHARACTERISTIC MS_ZIELVMHASK0HYS_KON_ANK "Schwelle für das VM-Zielmoment zum Setzen des K0-Hystereseflags der HAS im Zustand 'Konditionieren' beim Ankoppeln" VALUE 0x1D0F14 FLOAT32_IEEE_COL_DIRECT_S6_S3 0 trq_fl_a_S6_S3 -1000 1000 /end CHARACTERISTIC
/begin CHARACTERISTIC MS_ZIELVMK0SREG_SYN_ANK "Schwelle für das VM-Zielmoment als Basisbedingung für die Anforderung der Aktivierung der K0-Schlupfregelung im Zustand K0 Synchronisieren beim Ankoppeln" VALUE 0x1D0F18 FLOAT32_IEEE_COL_DIRECT_S6_S3 0 trq_fl_a_S6_S3 -1000 1000 /end CHARACTERISTIC
/begin CHARACTERISTIC MS_ZMSOLLEMAKTIV_ABO "Momentenschwelle in der Phase Konditionieren bis K0 synchronisieren für die Aktivierung z_m_soll_em_has (Eingagnsgrösse m_soll_em_has)" VALUE 0x1CFE80 FLOAT32_IEEE_COL_DIRECT_S6_S3 0 trq_fl_a_S6_S3 0 1000 /end CHARACTERISTIC
/begin CHARACTERISTIC M_K0MODHAS_ZIEL_LAU_ABK "Zielwert beim gradientenbegrenzten Absenken des modifizierten K0-Moments in den Zuständen 'Last-Übernahme' und 'K0-Öffnen' beim Abkoppeln" VALUE 0x1CFDD4 FLOAT32_IEEE_COL_DIRECT_S6_S3 0 trq_fl_a_S6_S3 -1000 1000 /end CHARACTERISTIC
/begin CHARACTERISTIC M_K0MODHAS_ZIEL_LAU_ABST "Zielwert beim gradientenbegrenzten Ab-senken des modifizierten K0-Moments in den Zuständen Last-Übernahme und K0-Öffnen beim VM Abstellen" VALUE 0x1D0D6C FLOAT32_IEEE_COL_DIRECT_S6_S3 0 trq_fl_a_S6_S3 -1000 1000 /end CHARACTERISTIC
/begin CHARACTERISTIC M_K0MODMIN_SAK_ABST "Minimalwert des modifizierten K0-Moments im Zustand 'Schaltung aktiv' beim VM Abstellen" VALUE 0x1D0D70 FLOAT32_IEEE_COL_DIRECT_S6_S3 0 trq_fl_a_S6_S3 -1000 1000 /end CHARACTERISTIC
/begin CHARACTERISTIC M_K0MODMIN_SRT_ABST "Minimalwert des modifizierten K0-Moments im Zustand 'Start' beim VM Abstellen" VALUE 0x1D0D74 FLOAT32_IEEE_COL_DIRECT_S6_S3 0 trq_fl_a_S6_S3 -1000 1000 /end CHARACTERISTIC
/begin CHARACTERISTIC NDGS_K0K0SREG_SYN_ANK "Maximaler Betrag des K0-Differenzdrehzahlgradienten zur Bestimmung des Zeitpunkts der Anforderung der Aktivierung der K0-Schlupfregelung im Zustand K0 Synchronisieren beim Ankoppeln" VALUE 0x1D0F1C FLOAT32_IEEE_COL_DIRECT_S6_S3 0 ng_fl_S6_S3 0 10000 /end CHARACTERISTIC
/begin CHARACTERISTIC NDGS_K0SYNCERK_SYN_ANK "Differenzdrehzahlradient zur Weiterschaltung Richtung K0-Schliessen" VALUE 0x1D0F20 FLOAT32_IEEE_COL_DIRECT_S6_S3 0 ng_fl_S6_S3 -3.40282e+038 3.40282e+038 /end CHARACTERISTIC
/begin CHARACTERISTIC NDS_K0GESCHL_SCL_ANK "Drehzahldifferenzschwelle Kupplung K0 zur Überprüfung K0-Geschlossen beim Ankoppeln" VALUE 0x1D0F24 FLOAT32_IEEE_COL_DIRECT_S6_S3 0 n_fl_S6_S3 -3.40282e+038 3.40282e+038 /end CHARACTERISTIC
/begin CHARACTERISTIC NDS_K0K0SREG_SYN_ANK "K0-Differenzdrehzahlschwelle zur Bestimmung des Zeitpunkts der Anforderung der Aktivierung der K0-Schlupfregelung im Zustand K0 Synchronisieren beim Ankoppeln" VALUE 0x1D0F28 FLOAT32_IEEE_COL_DIRECT_S6_S3 0 n_fl_S6_S3 0 10000 /end CHARACTERISTIC
/begin CHARACTERISTIC NDS_K0SCHLBED_SRT_ANK "Maximale K0-Differenzdrehzahl für direk-ten Übergang nach K0-Schließen bei Abbruch Abstellen beim Ankoppeln" VALUE 0x1D0F2C FLOAT32_IEEE_COL_DIRECT_S6_S3 0 n_fl_S6_S3 -10000 10000 /end CHARACTERISTIC
/begin CHARACTERISTIC NDS_K0SYNCERKMAX_SYN_ANK "Schwellwert nach Umschaltung der Diffe-renzdrehzahl zur Erkennung Synchron beim Ankoppeln" VALUE 0x1D0F30 FLOAT32_IEEE_COL_DIRECT_S6_S3 0 n_fl_S6_S3 0 10000 /end CHARACTERISTIC
/begin CHARACTERISTIC NDS_K0VMABKBED_KOE_ABK "Schwelle des Betrags der K0-Differenzdrehzahl als Übergangsbedingung nach 'Übergabe' im Zustand 'K0-Öffnen' beim Abkoppeln" VALUE 0x1CFDE0 FLOAT32_IEEE_COL_DIRECT_S6_S3 0 n_fl_S6_S3 0 10000 /end CHARACTERISTIC
/begin CHARACTERISTIC NDS_K0VMABSTBED_KOE_ABST "Schwelle des Betrags der K0-Differenzdrehzahl als Übergangsbedingung nach VM-Abstellen im Zustand K0-Öffnen beim VM Abstellen" VALUE 0x1D0D78 FLOAT32_IEEE_COL_DIRECT_S6_S3 0 n_fl_S6_S3 0 10000 /end CHARACTERISTIC
/begin CHARACTERISTIC NDS_SOLLEM_DRS "Abschaltschwelle Direktstart" VALUE 0x1D18B8 FLOAT32_IEEE_COL_DIRECT_S6_S3 0 n_fl_S6_S3 -3.40282e+038 3.40282e+038 /end CHARACTERISTIC
/begin CHARACTERISTIC NDS_VMNEMBED_KON_ANK "Schwellwert der Differenzdrehzahl zwischen VM und EM Drehzahl als Übergangsbedingung nach K0 Synchronisieren im Zustand Konditionieren beim Ankoppeln" VALUE 0x1D0F34 FLOAT32_IEEE_COL_DIRECT_S6_S3 0 n_fl_S6_S3 -10000 0 /end CHARACTERISTIC
/begin CHARACTERISTIC NDS_VMNEMK0HYSMIN_KON_ANK "Mindestdifferenzdrehzahl zwischen VM und EM Drehzahl bei Eintritt in die K0 Druckstellung als Basisbedingung zur  Rücknahme des K0-Hystereseflags im Zustand 'Konditionieren' beim Ankoppeln" VALUE 0x1D0F38 FLOAT32_IEEE_COL_DIRECT_S6_S3 0 n_fl_S6_S3 -10000 10000 /end CHARACTERISTIC
/begin CHARACTERISTIC NDS_VMNEMK0HYS_KON_ANK "Schwellwert der Differenzdrehzahl zwischen VM und EM Drehzahl zur Aktivierung der Logik zur Rücknahme des K0-Hystereseflags im Zustand 'Konditionieren' beim Ankoppeln" VALUE 0x1D0F3C FLOAT32_IEEE_COL_DIRECT_S6_S3 0 n_fl_S6_S3 -10000 10000 /end CHARACTERISTIC
/begin CHARACTERISTIC ND_ZIELK0K0SREG_SYN_ANK "K0-Zieldifferenzdrehzahl zur Bestimmung der VM-Solldrehzahl bei der Aktivierung der K0-Schlupfregelung im Zustand K0 Synchronisieren beim Ankoppeln" VALUE 0x1D0F40 FLOAT32_IEEE_COL_DIRECT_S6_S3 0 n_fl_S6_S3 0 10000 /end CHARACTERISTIC
/begin CHARACTERISTIC NGS_VMK0OEFFNEN_AST_ABST "VM Drehzahlgradientenschwelle zur Vorgabe K0 OEFFNENSW im Zustand VM-Abstellen beim VM Abstellen" VALUE 0x1D0D7C FLOAT32_IEEE_COL_DIRECT_S6_S3 0 ng_fl_S6_S3 -10000 10000 /end CHARACTERISTIC
/begin CHARACTERISTIC NGS_VMSYNCERK_SYN_ANK "Verbrennerdrehzahlgradient zur Weiterschaltung Richtung K0-Schliessen" VALUE 0x1D0F44 FLOAT32_IEEE_COL_DIRECT_S6_S3 0 ng_fl_S6_S3 -3.40282e+038 3.40282e+038 /end CHARACTERISTIC
/begin CHARACTERISTIC NG_1SOLLEM_DRS "Maximaler Gradient Solldrehzahl EM" VALUE 0x1D18BC FLOAT32_IEEE_COL_DIRECT_S6_S3 0 ng_fl_S6_S3 -3.40282e+038 3.40282e+038 /end CHARACTERISTIC
/begin CHARACTERISTIC NG_EMMODRSMIN_SYN_ANK "Minimaler Gradient der modifizierten EM-Drehzahl als Basisdrehzahl zur Bestimmung der VM Solldrehzahl bei RS beim K0 Synchronisieren beim Ankoppeln" VALUE 0x1D0F48 FLOAT32_IEEE_COL_DIRECT_S6_S3 0 ng_fl_S6_S3 -50000 0 /end CHARACTERISTIC
/begin CHARACTERISTIC NOS_EMNSOLLVMK0SREG_SYN_ANK "Schwelle des Drehzahloffsets der VM-Solldrehzahl zur EM-Drehzahl zur Bestimmung des Zeitpunkts der Anforderung der Aktivierung der K0-Schlupfregelung im Zustand K0 Synchronisieren beim Ankoppeln" VALUE 0x1D0F4C FLOAT32_IEEE_COL_DIRECT_S6_S3 0 n_fl_S6_S3 0 10000 /end CHARACTERISTIC
/begin CHARACTERISTIC NOS_EMNSOLLVM_SYN_ANK "Schwelle zur Initialisierung des Timers für die Umschaltung der Differenzdrehzahl-schwelle zur Erkennung Synchron beim Ankoppeln" VALUE 0x1D0F50 FLOAT32_IEEE_COL_DIRECT_S6_S3 0 n_fl_S6_S3 0 10000 /end CHARACTERISTIC
/begin CHARACTERISTIC NS_EMMINBED_KOE_ABK "EM Drehzahlschwelle zur Erkennung 'EM fällt zu stark ab' als Übergangsbedingung nach 'Übergabe' im Zustand 'K0-Öffnen' beim Abkoppeln" VALUE 0x1CFDE4 FLOAT32_IEEE_COL_DIRECT_S6_S3 0 n_fl_S6_S3 0 10000 /end CHARACTERISTIC
/begin CHARACTERISTIC NS_EMMINBED_KOE_ABST "EM Drehzahlschwelle zur Erkennung 'EM fällt zu früh ab' als Übergangsbedingung nach 'VM-Abstellen'  im Zustand 'K0-Öffnen' beim VM Abstellen" VALUE 0x1D0D80 FLOAT32_IEEE_COL_DIRECT_S6_S3 0 n_fl_S6_S3 0 10000 /end CHARACTERISTIC
/begin CHARACTERISTIC NS_EMMINBED_LAU_ABK "EM Drehzahlschwelle zur Erkennung 'EM fällt zu stark ab' als Übergangsbedingung nach 'Übergabe' im Zustand 'Last-Übernahme' beim Abkoppeln" VALUE 0x1CFDE8 FLOAT32_IEEE_COL_DIRECT_S6_S3 0 n_fl_S6_S3 0 10000 /end CHARACTERISTIC
/begin CHARACTERISTIC NS_EMMINBED_LAU_ABST "EM Drehzahlschwelle zur Erkennung 'EM fällt zu früh ab' als Übergangsbedingung nach 'K0-Öffnen' im Zustand 'Last-Übernahme' beim VM Abstellen" VALUE 0x1D0D84 FLOAT32_IEEE_COL_DIRECT_S6_S3 0 n_fl_S6_S3 0 10000 /end CHARACTERISTIC
/begin CHARACTERISTIC NS_EMMINBED_SAK_ABK "EM Drehzahlschwelle zur Erkennung 'EM fällt zu stark ab' als Übergangsbedingung nach 'Last Übernahme' im Zustand  'Schaltung aktiv'  beim Abkoppeln" VALUE 0x1CFDEC FLOAT32_IEEE_COL_DIRECT_S6_S3 0 n_fl_S6_S3 0 10000 /end CHARACTERISTIC
/begin CHARACTERISTIC NS_EMMINBED_SAK_ABST "EM Drehzahlschwelle zur Erkennung 'EM fällt zu früh ab' als Übergangsbedingung nach 'Last-Übernahme' im Zustand  'Schaltung Aktiv'  beim VM Abstellen" VALUE 0x1D0D88 FLOAT32_IEEE_COL_DIRECT_S6_S3 0 n_fl_S6_S3 0 10000 /end CHARACTERISTIC
/begin CHARACTERISTIC NS_EMMINBED_SCL_ANK "EM-Drehzahlschwelle zur Erkennung EM läuft noch als Übergangsbedingung nach Übergabe im Zustand K0 Schliessen beim Ankoppeln" VALUE 0x1D0F54 FLOAT32_IEEE_COL_DIRECT_S6_S3 0 n_fl_S6_S3 0 2000 /end CHARACTERISTIC
/begin CHARACTERISTIC NS_EMMINBED_SYN_ANK "EM-Drehzahlschwelle zur Erkennung 'EM läuft noch' als Übergangsbedingung nach K0-Schliessen im Zustand K0 Synchroni-sieren beim Ankoppeln" VALUE 0x1D0F58 FLOAT32_IEEE_COL_DIRECT_S6_S3 0 n_fl_S6_S3 0 2000 /end CHARACTERISTIC
/begin CHARACTERISTIC NS_MINEMGABBED_LAU_ABST "Schwellwert  der minimalen EM Drehzahl der Leerlaufsimulation als Übergangsbe-dingung nach 'VM geführt Abstellen' im Zustand 'Last-Übernahme' beim VM Ab-stellen" VALUE 0x1D0D8C FLOAT32_IEEE_COL_DIRECT_S6_S3 0 n_fl_S6_S3 0 10000 /end CHARACTERISTIC
/begin CHARACTERISTIC NS_MINPSYSEMGABBED_LAU_ABST "Schwellwert  der minimalen EM Drehzahl zur Sicherstellung Ölversorgung als Ü-bergangsbedingung nach 'VM geführt Abstellen' im Zustand 'Last-Übernahme' beim VM Abstellen" VALUE 0x1D0D90 FLOAT32_IEEE_COL_DIRECT_S6_S3 0 n_fl_S6_S3 0 10000 /end CHARACTERISTIC
/begin CHARACTERISTIC NS_VMAUSBED_AST_ABST "VM Drehzahlschwelle zur Erkennung VM-aus als Übergangsbedingung nach Übergabe im Zustand VM-Abstellen beim VM Abstellen" VALUE 0x1D0D94 FLOAT32_IEEE_COL_DIRECT_S6_S3 0 n_fl_S6_S3 0 10000 /end CHARACTERISTIC
/begin CHARACTERISTIC NS_VMEINBED_KON_ANK "VM-Drehzahlschwelle zur Absicherung VM läuft als Übergangsbedingung von Konditionieren nach Synchronisieren beim Ankoppeln" VALUE 0x1D0F5C FLOAT32_IEEE_COL_DIRECT_S6_S3 0 n_fl_S6_S3 0 2000 /end CHARACTERISTIC
/begin CHARACTERISTIC NS_VMK0OEFFNEN_AST_ABST "VM Drehzahlschwelle zur Vorgabe K0 OEFFNENSW im Zustand VM-Abstellen beim VM Abstellen" VALUE 0x1D0D98 FLOAT32_IEEE_COL_DIRECT_S6_S3 0 n_fl_S6_S3 0 1000 /end CHARACTERISTIC
/begin CHARACTERISTIC N_MINEMNSOLLVM_KON_ANK "Minimale EM-Drehzahl als Basis für die Bestimmung der VM-Solldrehzahl ab dem Zustand Konditionieren und im Zu-stand Schaltung aktiv beim Ankoppeln" VALUE 0x1D0F60 FLOAT32_IEEE_COL_DIRECT_S6_S3 0 n_fl_S6_S3 0 2000 /end CHARACTERISTIC
/begin MEASUREMENT SFOp_ABK105_isActive_ "" UBYTE VOID_SCALING_S6_S3 1 100 0 1 ECU_ADDRESS 0xFFF8629E /end MEASUREMENT
/begin MEASUREMENT SFOp_ABK69_out_ "" FLOAT32_IEEE VOID_SCALING_f_S6_S3 1 100 -3.40282e+038 3.40282e+038 ECU_ADDRESS 0xFFF965B8 /end MEASUREMENT
/begin MEASUREMENT SFOp_ABK70_isActive_ "" UBYTE VOID_SCALING_S6_S3 1 100 0 1 ECU_ADDRESS 0xFFF8629F /end MEASUREMENT
/begin MEASUREMENT SFOp_ABK81_isActive_ "" UBYTE VOID_SCALING_S6_S3 1 100 0 1 ECU_ADDRESS 0xFFF862A0 /end MEASUREMENT
/begin MEASUREMENT SFOp_ABK90_isActive_ "" UBYTE VOID_SCALING_S6_S3 1 100 0 1 ECU_ADDRESS 0xFFF862A1 /end MEASUREMENT
/begin MEASUREMENT SFOp_ABK91_out_ "" FLOAT32_IEEE VOID_SCALING_f_S6_S3 1 100 -3.40282e+038 3.40282e+038 ECU_ADDRESS 0xFFF965CC /end MEASUREMENT
/begin MEASUREMENT SFOp_ABK92_isActive_ "" UBYTE VOID_SCALING_S6_S3 1 100 0 1 ECU_ADDRESS 0xFFF862A2 /end MEASUREMENT
/begin MEASUREMENT SFOp_ABO71_out_ "" FLOAT32_IEEE VOID_SCALING_f_S6_S3 1 100 -3.40282e+038 3.40282e+038 ECU_ADDRESS 0xFFF96618 /end MEASUREMENT
/begin MEASUREMENT SFOp_ABO88_out_ "" FLOAT32_IEEE VOID_SCALING_f_S6_S3 1 100 -3.40282e+038 3.40282e+038 ECU_ADDRESS 0xFFF96628 /end MEASUREMENT
/begin MEASUREMENT SFOp_ABST108_out_ "" FLOAT32_IEEE VOID_SCALING_f_S6_S3 1 100 -3.40282e+038 3.40282e+038 ECU_ADDRESS 0xFFF96648 /end MEASUREMENT
/begin MEASUREMENT SFOp_ABST120_out_ "" FLOAT32_IEEE VOID_SCALING_f_S6_S3 1 100 -3.40282e+038 3.40282e+038 ECU_ADDRESS 0xFFF96654 /end MEASUREMENT
/begin MEASUREMENT SFOp_ABST12_KF_NSEMBED_GAB_ABST "" FLOAT32_IEEE VOID_SCALING_f_S6_S3 1 100 -3.40282e+038 3.40282e+038 ECU_ADDRESS 0xFFF96640 /end MEASUREMENT
/begin MEASUREMENT SFOp_ANK102_isActive_ "" UBYTE VOID_SCALING_S6_S3 1 100 0 1 ECU_ADDRESS 0xFFF863A0 /end MEASUREMENT
/begin MEASUREMENT SFOp_ANK104_out_ "" FLOAT32_IEEE VOID_SCALING_f_S6_S3 1 100 -3.40282e+038 3.40282e+038 ECU_ADDRESS 0xFFF966DC /end MEASUREMENT
/begin MEASUREMENT SFOp_ANK128_KL_MZIELK0_SYN_ANK "" FLOAT32_IEEE VOID_SCALING_f_S6_S3 1 100 -3.40282e+038 3.40282e+038 ECU_ADDRESS 0xFFF9669C /end MEASUREMENT
/begin MEASUREMENT SFOp_ANK128_KL__LLK0MIN_SYN_ANK "" FLOAT32_IEEE VOID_SCALING_f_S6_S3 1 100 -3.40282e+038 3.40282e+038 ECU_ADDRESS 0xFFF966A0 /end MEASUREMENT
/begin MEASUREMENT SFOp_ANK129_KL__SYNCERK_SYN_ANK "" FLOAT32_IEEE VOID_SCALING_f_S6_S3 1 100 -3.40282e+038 3.40282e+038 ECU_ADDRESS 0xFFF966A4 /end MEASUREMENT
/begin MEASUREMENT SFOp_ANK132_isActive_ "" UBYTE VOID_SCALING_S6_S3 1 100 0 1 ECU_ADDRESS 0xFFF863A3 /end MEASUREMENT
/begin MEASUREMENT SFOp_ANK148_KF__NSOLLVM_SAK_ANK "" FLOAT32_IEEE VOID_SCALING_f_S6_S3 1 100 -3.40282e+038 3.40282e+038 ECU_ADDRESS 0xFFF966A8 /end MEASUREMENT
/begin MEASUREMENT SFOp_ANK148_KF__NSOLLVM_SAK_A_a "" FLOAT32_IEEE VOID_SCALING_f_S6_S3 1 100 -3.40282e+038 3.40282e+038 ECU_ADDRESS 0xFFF966AC /end MEASUREMENT
/begin MEASUREMENT SFOp_ANK150_KF__ODRSMAX_SYN_ANK "" FLOAT32_IEEE VOID_SCALING_f_S6_S3 1 100 -3.40282e+038 3.40282e+038 ECU_ADDRESS 0xFFF966B0 /end MEASUREMENT
/begin MEASUREMENT SFOp_ANK153_isActive_ "" UBYTE VOID_SCALING_S6_S3 1 100 0 1 ECU_ADDRESS 0xFFF863A6 /end MEASUREMENT
/begin MEASUREMENT SFOp_ANK163_KF__DK0NGVM_SYN_ANK "" FLOAT32_IEEE VOID_SCALING_f_S6_S3 1 100 -3.40282e+038 3.40282e+038 ECU_ADDRESS 0xFFF966B4 /end MEASUREMENT
/begin MEASUREMENT SFOp_ANK163_KF__K0NDK0M_SYN_ANK "" FLOAT32_IEEE VOID_SCALING_f_S6_S3 1 100 -3.40282e+038 3.40282e+038 ECU_ADDRESS 0xFFF966B8 /end MEASUREMENT
/begin MEASUREMENT SFOp_ANK163_KL__ASTSAUG_SYN_ANK "" FLOAT32_IEEE VOID_SCALING_f_S6_S3 1 100 -3.40282e+038 3.40282e+038 ECU_ADDRESS 0xFFF966BC /end MEASUREMENT
/begin MEASUREMENT SFOp_ANK164_out_ "" FLOAT32_IEEE VOID_SCALING_f_S6_S3 1 100 -3.40282e+038 3.40282e+038 ECU_ADDRESS 0xFFF96714 /end MEASUREMENT
/begin MEASUREMENT SFOp_ANK172_isActive_ "" UBYTE VOID_SCALING_S6_S3 1 100 0 1 ECU_ADDRESS 0xFFF863A7 /end MEASUREMENT
/begin MEASUREMENT SFOp_ANK173_KL__CERKUMS_SYN_ANK "" FLOAT32_IEEE VOID_SCALING_f_S6_S3 1 100 -3.40282e+038 3.40282e+038 ECU_ADDRESS 0xFFF966C0 /end MEASUREMENT
/begin MEASUREMENT SFOp_ANK176_isActive_ "" UBYTE VOID_SCALING_S6_S3 1 100 0 1 ECU_ADDRESS 0xFFF863A8 /end MEASUREMENT
/begin MEASUREMENT SFOp_ANK185_KL__LLK0BEF_KON_ANK "" FLOAT32_IEEE VOID_SCALING_f_S6_S3 1 100 -3.40282e+038 3.40282e+038 ECU_ADDRESS 0xFFF966C4 /end MEASUREMENT
/begin MEASUREMENT SFOp_ANK186_KF__NSOLLVM_SAK_ANK "" FLOAT32_IEEE VOID_SCALING_f_S6_S3 1 100 -3.40282e+038 3.40282e+038 ECU_ADDRESS 0xFFF966C8 /end MEASUREMENT
/begin MEASUREMENT SFOp_ANK195_KF__NSOLLVM_SAK_ANK "" FLOAT32_IEEE VOID_SCALING_f_S6_S3 1 100 -3.40282e+038 3.40282e+038 ECU_ADDRESS 0xFFF966CC /end MEASUREMENT
/begin MEASUREMENT SFOp_ANK196_KL__LLK0BEF_SAK_ANK "" FLOAT32_IEEE VOID_SCALING_f_S6_S3 1 100 -3.40282e+038 3.40282e+038 ECU_ADDRESS 0xFFF966D0 /end MEASUREMENT
/begin MEASUREMENT SFOp_ANK197_isActive_ "" UBYTE VOID_SCALING_S6_S3 1 100 0 1 ECU_ADDRESS 0xFFF863A9 /end MEASUREMENT
/begin MEASUREMENT SFOp_ANK54_xp_ "" FLOAT32_IEEE VOID_SCALING_f_S6_S3 1 100 -3.40282e+038 3.40282e+038 ECU_ADDRESS 0xFFF96738 /end MEASUREMENT
/begin MEASUREMENT SFOp_ANK89_isActive_ "" UBYTE VOID_SCALING_S6_S3 1 100 0 1 ECU_ADDRESS 0xFFF863AA /end MEASUREMENT
/begin MEASUREMENT SFOp_DRS63_isActive_ "" UBYTE VOID_SCALING_S6_S3 1 100 0 1 ECU_ADDRESS 0xFFF96DA8 /end MEASUREMENT
/begin MEASUREMENT SFOp_DRS80_isActive_ "" UBYTE VOID_SCALING_S6_S3 1 100 0 1 ECU_ADDRESS 0xFFF96DA9 /end MEASUREMENT
/begin MEASUREMENT SFOp_DRS93_Switch2 "" UBYTE VOID_SCALING_g_S6_S3 1 100 0 255 ECU_ADDRESS 0xFFF96DA7 /end MEASUREMENT
/begin MEASUREMENT SFOp_NOS46_isActive_ "" UBYTE VOID_SCALING_S6_S3 1 100 0 1 ECU_ADDRESS 0xFFF96DAD /end MEASUREMENT
/begin MEASUREMENT SFOp_NOS61_isActive_ "" UBYTE VOID_SCALING_S6_S3 1 100 0 1 ECU_ADDRESS 0xFFF86452 /end MEASUREMENT
/begin MEASUREMENT SFOp_NOS75_isActive_ "" UBYTE VOID_SCALING_S6_S3 1 100 0 1 ECU_ADDRESS 0xFFF96DAE /end MEASUREMENT
/begin MEASUREMENT SFOp_NOS77_out_ "" FLOAT32_IEEE VOID_SCALING_f_S6_S3 1 100 -3.40282e+038 3.40282e+038 ECU_ADDRESS 0xFFF96824 /end MEASUREMENT
/begin MEASUREMENT SFOp_NOS78_isActive_ "" UBYTE VOID_SCALING_S6_S3 1 100 0 1 ECU_ADDRESS 0xFFF86453 /end MEASUREMENT
/begin CHARACTERISTIC STATUS_ABL_ABBRFKT_SRT_ANK "Projektspezifische Statusrückmeldung an HST beim Aufruf als Abbruchfunktion im Zustand Start beim Ankoppeln" VALUE 0x1D7CCE UBYTE_COL_DIRECT_S6_S3 0 void_int_S6_S3 0 255 /end CHARACTERISTIC
/begin CHARACTERISTIC STATUS_ABL_ABBRUCH_AKTIV "Status Ablauf Abbruch aktiv" VALUE 0x1D7428 UBYTE_COL_DIRECT_S6_S3 0 void_int_S6_S3 0 255 /end CHARACTERISTIC
/begin CHARACTERISTIC STATUS_ABL_ABBRUCH_FERTIG "Status Ablauf Abbruch fertig" VALUE 0x1D7429 UBYTE_COL_DIRECT_S6_S3 0 void_int_S6_S3 0 255 /end CHARACTERISTIC
/begin CHARACTERISTIC STATUS_ABL_AND_ABO "Projektspezifische Vorgabe des Zahlenwerts für den Ablaufstatus status_ablauf_has in den einzelnen Zuständen eines Hybridablaufs" VALUE 0x1D7CAA UBYTE_COL_DIRECT_S6_S3 0 void_int_S6_S3 0 255 /end CHARACTERISTIC
/begin CHARACTERISTIC STATUS_ABL_AST_ABST "Projektspezifische Statusrückmeldung an HST im Zustand VM-Abstellen beim VM Abstellen" VALUE 0x1D7CB3 UBYTE_COL_DIRECT_S6_S3 0 void_int_S6_S3 0 255 /end CHARACTERISTIC
/begin CHARACTERISTIC STATUS_ABL_GAB_ABST "Projektspezifische Statusrückmeldung an HST im Zustand 'VM geführt Abstellen' beim VM Abstellen" VALUE 0x1D7CB4 UBYTE_COL_DIRECT_S6_S3 0 void_int_S6_S3 0 255 /end CHARACTERISTIC
/begin CHARACTERISTIC STATUS_ABL_GEFABST_AST_ABST "Projektspezifische Statusrückmeldung an HST bei vorherigem 'Geführten Abstellen' im Zustand 'VM-Abstellen' beim VM Ab-stellen" VALUE 0x1D7CB5 UBYTE_COL_DIRECT_S6_S3 0 void_int_S6_S3 0 255 /end CHARACTERISTIC
/begin CHARACTERISTIC STATUS_ABL_KOE_ABK "Projektspezifische Statusrückmeldung an HST im Zustand 'K0-Öffnen' beim Abkoppeln" VALUE 0x1D7C9E UBYTE_COL_DIRECT_S6_S3 0 void_int_S6_S3 0 255 /end CHARACTERISTIC
/begin CHARACTERISTIC STATUS_ABL_KOE_ABO "Projektspezifische Vorgabe des Zahlenwerts für den Ablaufstatus status_ablauf_has in den einzelnen Zuständen eines Hybridablaufs" VALUE 0x1D7CAB UBYTE_COL_DIRECT_S6_S3 0 void_int_S6_S3 0 255 /end CHARACTERISTIC
/begin CHARACTERISTIC STATUS_ABL_KOE_ABST "Projektspezifische Statusrückmeldung an HST im Zustand K0-Öffnen beim VM Abstellen" VALUE 0x1D7CB6 UBYTE_COL_DIRECT_S6_S3 0 void_int_S6_S3 0 255 /end CHARACTERISTIC
/begin CHARACTERISTIC STATUS_ABL_KON_ANK "Kodierung status_ablauf_has im Zustand Konditioieren" VALUE 0x1D7CCF UBYTE_COL_DIRECT_S6_S3 0 void_int_S6_S3 0 15 /end CHARACTERISTIC
/begin CHARACTERISTIC STATUS_ABL_KON_NOS "Statusrückmeldung der HAS an HSTim Zustand Konditionieren" VALUE 0x1D7CEA UBYTE_COL_DIRECT_S6_S3 0 void_int_S6_S3 0 15 /end CHARACTERISTIC
/begin CHARACTERISTIC STATUS_ABL_LAU_ABK "Projektspezifische Statusrückmeldung an HST im Zustand 'Last-Übernahme' beim Abkoppeln" VALUE 0x1D7C9F UBYTE_COL_DIRECT_S6_S3 0 void_int_S6_S3 0 255 /end CHARACTERISTIC
/begin CHARACTERISTIC STATUS_ABL_LAU_ABST "Projektspezifische Statusrückmeldung an HST im Zustand Last-Übernahme beim VM Abstellen" VALUE 0x1D7CB7 UBYTE_COL_DIRECT_S6_S3 0 void_int_S6_S3 0 255 /end CHARACTERISTIC
/begin CHARACTERISTIC STATUS_ABL_NST_NOS "Statusrückmeldung der HAS an HSTim Zustand Notstarten" VALUE 0x1D7CEB UBYTE_COL_DIRECT_S6_S3 0 void_int_S6_S3 0 15 /end CHARACTERISTIC
/begin CHARACTERISTIC STATUS_ABL_SAK_ABK "Projektspezifische Statusrückmeldung an HST im Zustand 'Schaltung aktiv' beim Abkoppeln" VALUE 0x1D7CA0 UBYTE_COL_DIRECT_S6_S3 0 void_int_S6_S3 0 255 /end CHARACTERISTIC
/begin CHARACTERISTIC STATUS_ABL_SAK_ABST "Projektspezifische Statusrückmeldung an HST im Zustand 'Schaltung Aktiv' beim VM Abstellen" VALUE 0x1D7CB8 UBYTE_COL_DIRECT_S6_S3 0 void_int_S6_S3 0 255 /end CHARACTERISTIC
/begin CHARACTERISTIC STATUS_ABL_SAK_ANK "Kodierung status_ablauf_has im Zustand Schaltung_aktiv" VALUE 0x1D7CD0 UBYTE_COL_DIRECT_S6_S3 0 void_int_S6_S3 0 15 /end CHARACTERISTIC
/begin CHARACTERISTIC STATUS_ABL_SCL_ANK "Projektspezifische Statusrückmeldung an HST im Zustand K0-Schliessen beim Ankoppeln" VALUE 0x1D7CD1 UBYTE_COL_DIRECT_S6_S3 0 void_int_S6_S3 0 255 /end CHARACTERISTIC
/begin CHARACTERISTIC STATUS_ABL_SCL_NOS "Statusrückmeldung der HAS an HSTim Zustand K0-Schließen" VALUE 0x1D7CEC UBYTE_COL_DIRECT_S6_S3 0 void_int_S6_S3 0 15 /end CHARACTERISTIC
/begin CHARACTERISTIC STATUS_ABL_SRT_ABST "Projektspezifische Statusrückmeldung an HST im Zustand Start beim VM Abstellen" VALUE 0x1D7CB9 UBYTE_COL_DIRECT_S6_S3 0 void_int_S6_S3 0 255 /end CHARACTERISTIC
/begin CHARACTERISTIC STATUS_ABL_SRT_NOS "Statusrückmeldung der HAS an HST im Zustand Start (st_start)" VALUE 0x1D7CED UBYTE_COL_DIRECT_S6_S3 0 void_int_S6_S3 0 15 /end CHARACTERISTIC
/begin CHARACTERISTIC STATUS_ABL_SYN_ANK "Kodierung status_ablauf_has im Zustand Synchronisieren" VALUE 0x1D7CD2 UBYTE_COL_DIRECT_S6_S3 0 void_int_S6_S3 0 15 /end CHARACTERISTIC
/begin CHARACTERISTIC SWI_ABBRUCH_AKTIV_ABK "Schalter für die Aktivierung des Abbruchs Ablauf Abkoppeln" VALUE 0x1D7CA2 UBYTE_COL_DIRECT_S6_S3 0 void_int_e_S6_S3 0 1 /end CHARACTERISTIC
/begin CHARACTERISTIC SWI_ABBRUCH_AKTIV_ABST "SWI für die Aktivierung des Abbruch Ablauf Abstellen" VALUE 0x1D7CBA UBYTE_COL_DIRECT_S6_S3 0 void_int_S6_S3 0 1 /end CHARACTERISTIC
/begin CHARACTERISTIC SWI_ABBRUCH_AKTIV_ANK "Schalter für die Aktivierung des Abbruch Ablauf Ankoppeln" VALUE 0x1D7CD3 UBYTE_COL_DIRECT_S6_S3 0 void_int_e_S6_S3 0 1 /end CHARACTERISTIC
/begin CHARACTERISTIC SWI_ABLAUFVAR_SYN_ANK "Umschaltung der Bed. für cd_k0sync_schliessen" VALUE 0x1D7CD4 UBYTE_COL_DIRECT_S6_S3 0 void_int_e_S6_S3 0 1 /end CHARACTERISTIC
/begin CHARACTERISTIC SWI_K0ANSTEUERUNG_AST_ABST "Schalter zur Festlegung der K0 Ansteuerung bei Kraftfluss vorhanden im Zustand VM-Abstellen beim VM Abstellen: 1 = DRUCKSTELLUNG, 0 = OEFFNENSW" VALUE 0x1D7CBB UBYTE_COL_DIRECT_S6_S3 0 void_int_S6_S3 0 1 /end CHARACTERISTIC
/begin CHARACTERISTIC SWI_K0SREGAKTIV_LAU_ABK "Bedingte Aktivierung der K0 Schlupfregelung im Zustand 'Last-Übernahme' beim Abkoppeln" VALUE 0x1D7CA3 UBYTE_COL_DIRECT_S6_S3 0 void_int_e_S6_S3 0 1 /end CHARACTERISTIC
/begin CHARACTERISTIC SWI_K0SREGAKTIV_LAU_ABST "Bedingte Aktivierung der K0 Schlupfrege-lung in der Ansteuervariante 2 im Zustand 'Last-Übernahme' beim VM Abstellen" VALUE 0x1D7CBC UBYTE_COL_DIRECT_S6_S3 0 void_int_S6_S3 0 1 /end CHARACTERISTIC
/begin CHARACTERISTIC SWI_K0SREGBASIS_SYN_ANK "Aktivierung und Konfiguration der Aktivie-rung der K0 Schlupfregelung beim K0 Synchronisieren beim Ankoppeln: bit0 = K0SREG aktiv, bit1 = Berücksichtigung IAE, bit2 = Ber. Schaltung, bit3 = Ber. FST" VALUE 0x1D7CD5 UBYTE_COL_DIRECT_S6_S3 0 void_int_S6_S3 0 15 /end CHARACTERISTIC
/begin CHARACTERISTIC SWI_KFMGK0AUSWAHL_SYN_ANK "Schalter zum Umschalten von KF_MGK0NDK0..." VALUE 0x1D7CD6 UBYTE_COL_DIRECT_S6_S3 0 void_int_e_S6_S3 0 1 /end CHARACTERISTIC
/begin CHARACTERISTIC SWI_KLMK0MODINIT_LAU_ABK "Auswahl der Y-Achse für KL_MK0MODINIT_LAU_ABK zur Initialisie-rung des modifizierten K0-Istmoments im Zustand 'Last-Übernahme' beim Abkoppeln: 0 = m_soll_vm_hst_in, 1 = m_soll_vm_l_hst_in" VALUE 0x1D7CA4 UBYTE_COL_DIRECT_S6_S3 0 void_int_e_S6_S3 0 1 /end CHARACTERISTIC
/begin CHARACTERISTIC SWI_KLMK0MODINIT_LAU_ABST "Auswahl der Y-Achse für KL_MK0MODINIT_LAU_ABST zur Initialisierung des modifizierten K0-Istmoments im Zustand Last-Übernahme beim VM Abstellen: 0 = m_soll_vm_hst_in, 1 = m_soll_vm_l_hst_in" VALUE 0x1D7CBD UBYTE_COL_DIRECT_S6_S3 0 void_int_S6_S3 0 1 /end CHARACTERISTIC
/begin CHARACTERISTIC SWI_MK0MODBEGR_KON_ANK "Aktivierung der Nullsetzung des modifizierten K0-Moments der HAS im Zustand 'Konditionieren' beim Ankoppeln" VALUE 0x1D7CD7 UBYTE_COL_DIRECT_S6_S3 0 void_int_e_S6_S3 0 1 /end CHARACTERISTIC
/begin CHARACTERISTIC SWI_MK0MODBEGR_SAK_ANK "Aktivierung der Nullsetzung des modifizierten K0-Moments der HAS im Zustand 'Schaltung aktiv' beim Ankoppeln" VALUE 0x1D7CD8 UBYTE_COL_DIRECT_S6_S3 0 void_int_e_S6_S3 0 1 /end CHARACTERISTIC
/begin CHARACTERISTIC SWI_MK0MODBEGR_SYN_ANK "Aktivierung der Maximalwertbegrenzung des modifizierten K0-Moments der HAS im Zustand K0-Synchronisieren beim Ankoppeln" VALUE 0x1D7CD9 UBYTE_COL_DIRECT_S6_S3 0 void_int_e_S6_S3 0 1 /end CHARACTERISTIC
/begin CHARACTERISTIC SWI_MK0MODINIT_LAU_ABK "Auswahl des VM-Basismoments für die Initialisierung des modifizierten K0 Moments im Zustand 'Last-Übernahme' beim Abkop-peln: 0 = m_soll_vm_hst_in bzw. m_soll_vm_l_hst_in , 1 = m_vm_in" VALUE 0x1D7CA5 UBYTE_COL_DIRECT_S6_S3 0 void_int_e_S6_S3 0 1 /end CHARACTERISTIC
/begin CHARACTERISTIC SWI_MK0MODINIT_LAU_ABST "Auswahl des VM-Basismoments für die Initialisierung des modifizierten K0 Mo-ments im Zustand Last-Übernahme beim VM Abstellen: 0 = m_soll_vm_hst_in bzw. m_soll_vm_l_hst_in , 1 = m_vm_in" VALUE 0x1D7CBE UBYTE_COL_DIRECT_S6_S3 0 void_int_S6_S3 0 1 /end CHARACTERISTIC
/begin CHARACTERISTIC SWI_MSOLLK0BASIS_LAU_ABK "Auswahl des VM-Basismoments für die Bestimmung des K0-Moments im Zustand 'Last-Übernahme' beim Abkoppeln: 0 = m_soll_vm_hst_in, 1 = m_vm_in" VALUE 0x1D7CA6 UBYTE_COL_DIRECT_S6_S3 0 void_int_e_S6_S3 0 1 /end CHARACTERISTIC
/begin CHARACTERISTIC SWI_MSOLLK0BASIS_LAU_ABST "Auswahl des VM-Basismoments für die Bestimmung des K0-Moments im Zustand Last-Übernahme beim VM Abstellen: 0 = m_soll_vm_hst_in, 1 = m_vm_in" VALUE 0x1D7CBF UBYTE_COL_DIRECT_S6_S3 0 void_int_S6_S3 0 1 /end CHARACTERISTIC
/begin CHARACTERISTIC SWI_STATUSABL_SAVM_LAU_ABST "Schalter zur Beeinflussung des Ablaufstatus entsprechend aktiver VM Schubab-schaltung im Zustand 'Last-Übernahme' beim VM Abstellen" VALUE 0x1D7CC0 UBYTE_COL_DIRECT_S6_S3 0 void_int_S6_S3 0 1 /end CHARACTERISTIC
/begin CHARACTERISTIC SWI_STATUSK0K0SREG_LAU_ABK "Schalter zur Aktivierung der Berücksichtigung des K0 Status SCHLUPFGEREGELT bei der bedingten Aktivierung der K0 Schlupfregelung im Zustand 'Last-Übernahme' beim VM Abkoppeln" VALUE 0x1D7CA7 UBYTE_COL_DIRECT_S6_S3 0 void_int_S6_S3 0 1 /end CHARACTERISTIC
/begin CHARACTERISTIC SWI_STATUSK0K0SREG_LAU_ABST "Schalter zur Aktivierung der Berücksichti-gung des K0 Status SCHLUPFGERE-GELT bei der bedingten Aktivierung der K0 Schlupfregelung im Zustand 'Last-Übernahme' beim VM Abstellen" VALUE 0x1D7CC1 UBYTE_COL_DIRECT_S6_S3 0 void_int_S6_S3 0 1 /end CHARACTERISTIC
/begin CHARACTERISTIC SWI_ZK0REGELN_LAU_ABST "Schalter zur Vorgabe des K0 Ansteuer-modus  GESCHLOSSEN in der Ansteu-ervariante 1 im Zustand 'Last-Übernahme' beim VM Abstellen" VALUE 0x1D7CC2 UBYTE_COL_DIRECT_S6_S3 0 void_int_S6_S3 0 1 /end CHARACTERISTIC
/begin CHARACTERISTIC SWI_ZMODUSVMN_ANK "Flag für Aktivierung Drehzahlvorgabe VM" VALUE 0x1D7CDA UBYTE_COL_DIRECT_S6_S3 0 void_int_e_S6_S3 0 1 /end CHARACTERISTIC
/begin CHARACTERISTIC SWI_ZMODUSVMN_SAK_ANK "Flag für Aktivierung Drehzahlvorgabe VM im Zustand Schaltung_aktiv" VALUE 0x1D7CDB UBYTE_COL_DIRECT_S6_S3 0 void_int_e_S6_S3 0 1 /end CHARACTERISTIC
/begin CHARACTERISTIC SWI_ZMSOLLEM_ABO "SWI Vorgabe Sollmoment EM Konditionieren" VALUE 0x1D7CAD UBYTE_COL_DIRECT_S6_S3 0 void_int_S6_S3 0 255 /end CHARACTERISTIC
/begin CHARACTERISTIC SWI_ZPHYSK0_ABB_ANK "SWI für die Hysteresekompensation K0 im Zustand 'Ankoppeln Abbruch' beim Ankoppeln: 0 = Druckanteil p_hys_k0_has inaktiv, 1 = Druckanteil p_hys_k0_has aktiv" VALUE 0x1D7CDC UBYTE_COL_DIRECT_S6_S3 0 void_int_e_S6_S3 0 1 /end CHARACTERISTIC
/begin CHARACTERISTIC SWI_ZPHYSK0_KON_ANK "Schalter für Hysteresekompensation der K0, 0...Druckanteil p_hys_k0_has inaktiv im Zustand Konditionieren" VALUE 0x1D7CDD UBYTE_COL_DIRECT_S6_S3 0 void_int_e_S6_S3 0 1 /end CHARACTERISTIC
/begin CHARACTERISTIC SWI_ZPHYSK0_KON_NOS "Schalter zur (De)Aktivierung der K0-Hysteresekompensation im Zustand Konditionieren" VALUE 0x1D7CF0 UBYTE_COL_DIRECT_S6_S3 0 void_int_e_S6_S3 0 1 /end CHARACTERISTIC
/begin CHARACTERISTIC SWI_ZPHYSK0_KSA_ABK "Schalter zur Beeinflussung  der K0-Hysterese ZPHYSK0" VALUE 0x1D7CA8 UBYTE_COL_DIRECT_S6_S3 0 void_int_e_S6_S3 0 1 /end CHARACTERISTIC
/begin CHARACTERISTIC SWI_ZPHYSK0_KSA_ABST "Schalter für die Hysteresekompensation K0 im Zustand K0-Schließen Abbruch beim VM Abstellen: 0 = Druckanteil p_hys_k0_has inaktiv, 1 = Druckanteil p_hys_k0_has aktiv" VALUE 0x1D7CC3 UBYTE_COL_DIRECT_S6_S3 0 void_int_S6_S3 0 1 /end CHARACTERISTIC
/begin CHARACTERISTIC SWI_ZPHYSK0_SAK_ANK "SWI für die Hysteresekompensation K0 im Zustand Schaltung aktiv beim VM-Ankoppeln: 0 = Druckanteil p_hys_k0_has inaktiv, 1 = Druckanteil p_hys_k0_has aktiv" VALUE 0x1D7CDE UBYTE_COL_DIRECT_S6_S3 0 void_int_e_S6_S3 0 1 /end CHARACTERISTIC
/begin CHARACTERISTIC SWI_ZPHYSK0_SCL_ANK "SWI für die Hysteresekompensation K0 im Zustand K0-Schliessen beim VM-Ankoppeln: 0 = Druckanteil p_hys_k0_has inaktiv, 1 = Druckanteil p_hys_k0_has aktiv" VALUE 0x1D7CDF UBYTE_COL_DIRECT_S6_S3 0 void_int_e_S6_S3 0 1 /end CHARACTERISTIC
/begin CHARACTERISTIC SWI_ZPHYSK0_SCL_NOS "Schalter zur (De)Aktivierung der K0-Hysteresekompensation im Zustand K0-Schliessen" VALUE 0x1D7CF2 UBYTE_COL_DIRECT_S6_S3 0 void_int_e_S6_S3 0 1 /end CHARACTERISTIC
/begin CHARACTERISTIC SWI_ZPHYSK0_SRT_ABO "SWI für die Hysteresekompensation K0 im Zustand Start: 0 : Druckanteil p_hys_k0_has inaktiv 1 : Druckanteil p_hys_k0_has aktiv" VALUE 0x1D7CAE UBYTE_COL_DIRECT_S6_S3 0 void_int_S6_S3 0 255 /end CHARACTERISTIC
/begin CHARACTERISTIC SWI_ZPHYSK0_SRT_ANK "SWI für die Hysteresekompensation K0 im Zustand Start beim Ankoppeln: 0 = Druckanteil p_hys_k0_has inaktiv, 1 = Druckanteil p_hys_k0_has aktiv" VALUE 0x1D7CE0 UBYTE_COL_DIRECT_S6_S3 0 void_int_e_S6_S3 0 1 /end CHARACTERISTIC
/begin CHARACTERISTIC SWI_ZPHYSK0_SRT_NOS "Schalter zur (De)Aktivierung der K0-Hysteresekompensation im Zustand Start" VALUE 0x1D7CF3 UBYTE_COL_DIRECT_S6_S3 0 void_int_e_S6_S3 0 1 /end CHARACTERISTIC
/begin CHARACTERISTIC SWI_ZPHYSK0_SYN_ANK "SWI für die Hysteresekompensation K0 im Zustand K0-Synchronisierenbeim VM-Ankoppeln: 0 = Druckanteil p_hys_k0_has inaktiv, 1 = Druckanteil p_hys_k0_has aktiv" VALUE 0x1D7CE1 UBYTE_COL_DIRECT_S6_S3 0 void_int_e_S6_S3 0 1 /end CHARACTERISTIC
/begin CHARACTERISTIC SWI_ZPHYSK0_UAB_ABST "Schalter für die Hysteresekompensation K0 im Zustand Übergabe Abbruch beim VM Abstellen: 0 = Druckanteil p_hys_k0_has inaktiv, 1 = Druckanteil p_hys_k0_has aktiv" VALUE 0x1D7CC4 UBYTE_COL_DIRECT_S6_S3 0 void_int_S6_S3 0 1 /end CHARACTERISTIC
/begin CHARACTERISTIC SWI_ZPHYSK0_UEB_ANK "SWI für die Hysteresekompensation K0 im Zustand Übergabe beim VM-Ankoppeln: 0 = Druckanteil p_hys_k0_has inaktiv, 1 = Druckanteil p_hys_k0_has aktiv" VALUE 0x1D7CE2 UBYTE_COL_DIRECT_S6_S3 0 void_int_e_S6_S3 0 1 /end CHARACTERISTIC
/begin CHARACTERISTIC TAB_MGSOLLK0ABLVAR_KOE_ABK "Gradient des K0 Sollmoments in Abhängigkeit der Ablaufvariante der Zustandssteuerung im Zustand 'K0-Öffnen' beim Abkoppeln" VAL_BLK 0x1CFDA0 FLOAT32_IEEE_COL_DIRECT_S6_S3 0 trqg_fl_c_S6_S3 -25000 0 MATRIX_DIM 5 1 1 /end CHARACTERISTIC
/begin CHARACTERISTIC TAB_MGSOLLK0ABLVAR_KOE_ABST "Gradient des K0 Sollmoments in Abhängigkeit der Ablaufvariante der Zustandssteuerung im Zustand K0-Öffnen beim VM Abstellen" VAL_BLK 0x1D0D14 FLOAT32_IEEE_COL_DIRECT_S6_S3 0 trqg_fl_c_S6_S3 -25000 0 MATRIX_DIM 5 1 1 /end CHARACTERISTIC
/begin CHARACTERISTIC T_1MAX_DRS "" VALUE 0x1D18C0 FLOAT32_IEEE_COL_DIRECT_S6_S3 0 t_fl_S6_S3 -3.40282e+038 3.40282e+038 /end CHARACTERISTIC
/begin CHARACTERISTIC T_2MAX_DRS "" VALUE 0x1D18C4 FLOAT32_IEEE_COL_DIRECT_S6_S3 0 t_fl_S6_S3 -3.40282e+038 3.40282e+038 /end CHARACTERISTIC
/begin CHARACTERISTIC T_K0SREGBASISMAX_SYN_ANK "Maximalzeit zum Setzen der Basisbedin-gung zur Aktivierung der K0-Schlupfregelung im Zustand K0 Synchronisieren beim Ankoppeln" VALUE 0x1D0F64 FLOAT32_IEEE_COL_DIRECT_S6_S3 0 t_fl_S6_S3 0 10 /end CHARACTERISTIC
/begin CHARACTERISTIC T_MAX_ABB_ANK "Maximale Verweildauer im Zustand 'Ankoppeln Abbruch' beim Ankoppeln" VALUE 0x1D0F68 FLOAT32_IEEE_COL_DIRECT_S6_S3 0 t_fl_S6_S3 0 10 /end CHARACTERISTIC
/begin CHARACTERISTIC T_MAX_ABB_NOS "Maximale Verweildauer im Zustand Abbruch beim Notstart" VALUE 0x1D1928 FLOAT32_IEEE_COL_DIRECT_S6_S3 0 t_fl_S6_S3 0 10 /end CHARACTERISTIC
/begin CHARACTERISTIC T_MAX_AND_ABO "Zeit für Füllausgleichsphase K0" VALUE 0x1CFE84 FLOAT32_IEEE_COL_DIRECT_S6_S3 0 t_fl_S6_S3 -3.40282e+038 3.40282e+038 /end CHARACTERISTIC
/begin CHARACTERISTIC T_MAX_AST_ABST "Maximale Verweildauer im Zustand VM-Abstellen beim VM Abstellen" VALUE 0x1D0D9C FLOAT32_IEEE_COL_DIRECT_S6_S3 0 t_fl_S6_S3 0 10 /end CHARACTERISTIC
/begin CHARACTERISTIC T_MAX_GAB_ABST "Maximale Verweildauer im Zustand 'VM geführt Abstellen' beim VM Abstellen" VALUE 0x1D0DA0 FLOAT32_IEEE_COL_DIRECT_S6_S3 0 t_fl_S6_S3 0 10 /end CHARACTERISTIC
/begin CHARACTERISTIC T_MAX_GEFABST_AST_ABST "Maximale Verweildauer bei vorherigem 'Geführten Abstellen' im Zustand 'VM-Abstellen' beim VM Abstellen" VALUE 0x1D0DA4 FLOAT32_IEEE_COL_DIRECT_S6_S3 0 t_fl_S6_S3 0 10 /end CHARACTERISTIC
/begin CHARACTERISTIC T_MAX_KOE_ABK "Maximale Verweildauer im Zustand 'K0-Öffnen' beim Abkoppeln" VALUE 0x1CFDF0 FLOAT32_IEEE_COL_DIRECT_S6_S3 0 t_fl_S6_S3 0 10 /end CHARACTERISTIC
/begin CHARACTERISTIC T_MAX_KOE_ABO "Maximalzeit im Zustand SLST Abbr." VALUE 0x1CFE88 FLOAT32_IEEE_COL_DIRECT_S6_S3 0 t_fl_S6_S3 0 10 /end CHARACTERISTIC
/begin CHARACTERISTIC T_MAX_KOE_ABST "Maximale Verweildauer im Zustand K0-Öffnen beim VM Abstellen" VALUE 0x1D0DA8 FLOAT32_IEEE_COL_DIRECT_S6_S3 0 t_fl_S6_S3 0 10 /end CHARACTERISTIC
/begin CHARACTERISTIC T_MAX_KSA_ABK "Maximale Verweildauer im Zustand 'K0-Schließen Abbruch' beim Abkoppeln" VALUE 0x1CFDF4 FLOAT32_IEEE_COL_DIRECT_S6_S3 0 t_fl_S6_S3 0 10 /end CHARACTERISTIC
/begin CHARACTERISTIC T_MAX_KSA_ABST "Maximale Verweildauer im Zustand K0-Schließen Abbruch beim VM Abstellen" VALUE 0x1D0DAC FLOAT32_IEEE_COL_DIRECT_S6_S3 0 t_fl_S6_S3 0 10 /end CHARACTERISTIC
/begin CHARACTERISTIC T_MAX_LAU_ABK "Maximale Verweildauer im Zustand 'Last-Übernahme' beim Abkoppeln" VALUE 0x1CFDF8 FLOAT32_IEEE_COL_DIRECT_S6_S3 0 t_fl_S6_S3 0 10 /end CHARACTERISTIC
/begin CHARACTERISTIC T_MAX_LAU_ABST "Maximale Verweildauer im Zustand Last-Übernahme beim VM Abstellen" VALUE 0x1D0DB0 FLOAT32_IEEE_COL_DIRECT_S6_S3 0 t_fl_S6_S3 0 10 /end CHARACTERISTIC
/begin CHARACTERISTIC T_MAX_SAK_ABST "Maximale Verweildauer im Zustand 'Schaltung Aktiv' beim VM Abstellen" VALUE 0x1D0DB4 FLOAT32_IEEE_COL_DIRECT_S6_S3 0 t_fl_S6_S3 0 10 /end CHARACTERISTIC
/begin CHARACTERISTIC T_MAX_SAK_ANK "Max. Verweildauer im Zustand Schaltung_aktiv beim Ankoppeln" VALUE 0x1D0F6C FLOAT32_IEEE_COL_DIRECT_S6_S3 0 t_fl_S6_S3 0 10 /end CHARACTERISTIC
/begin CHARACTERISTIC T_MAX_SCL_ANK "Max. Verweildauer im Zustand K0-Schliessen beim Ankoppeln" VALUE 0x1D0F70 FLOAT32_IEEE_COL_DIRECT_S6_S3 0 t_fl_S6_S3 0 10 /end CHARACTERISTIC
/begin CHARACTERISTIC T_MAX_SCL_NOS "maximale Verweildauer im Zustand K0-Schliessen (152)" VALUE 0x1D1930 FLOAT32_IEEE_COL_DIRECT_S6_S3 0 t_fl_S6_S3 0 10 /end CHARACTERISTIC
/begin CHARACTERISTIC T_MK0MODZIEL_SCL_ANK "Dauer der Berücksichtigung des K0 Istmoments als Zielmoment für das modi-fizierte K0 Ist-Moment beim K0-Schliessen beim Ankoppeln" VALUE 0x1D0F74 FLOAT32_IEEE_COL_DIRECT_S6_S3 0 t_fl_S6_S3 0 10 /end CHARACTERISTIC
/begin CHARACTERISTIC T_MK0STARTRAMPE_AND_ABO "Timer zur Aktivierung der Rampe" VALUE 0x1CFE8C FLOAT32_IEEE_COL_DIRECT_S6_S3 0 t_fl_S6_S3 -3.40282e+038 3.40282e+038 /end CHARACTERISTIC
/begin CHARACTERISTIC T_MSOLLEMAKTIV_ABO "Überwachung Ausgabe m_soll_em_has (Max.-Zeit)" VALUE 0x1CFE90 FLOAT32_IEEE_COL_DIRECT_S6_S3 0 t_fl_S6_S3 -3.40282e+038 3.40282e+038 /end CHARACTERISTIC
/begin CHARACTERISTIC T_MSOLLK0ANSTMAX_SCL_ANK "Timer zur Überwachung der max. Dauer der K0-Ansteuerung HAS beim K0-Schliessen" VALUE 0x1D0F78 FLOAT32_IEEE_COL_DIRECT_S6_S3 0 t_fl_S6_S3 -3.40282e+038 3.40282e+038 /end CHARACTERISTIC
/begin CHARACTERISTIC T_NDGK0K0SREGMIN_SYN_ANK "Mindestdauer bei der Abfrage des K0-Differenzdrehzahlgradienten zur Bestimmung des Zeitpunkt der Anforderung der Aktivierung der K0-Schlupfregelung im Zustand K0 Synchronisieren beim Ankoppeln" VALUE 0x1D0F7C FLOAT32_IEEE_COL_DIRECT_S6_S3 0 t_fl_S6_S3 0 5 /end CHARACTERISTIC
/begin CHARACTERISTIC T_NGSVMK0OEFFNEN_AST_ABST "Verzögerungszeit zur Abfrage der VM Drehzahlgradientenschwelle zur Vorgabe K0 OEFFNENSW im Zustand VM-Abstellen beim VM Abstellen" VALUE 0x1D0DB8 FLOAT32_IEEE_COL_DIRECT_S6_S3 0 t_fl_S6_S3 0 10 /end CHARACTERISTIC
/begin CHARACTERISTIC T_PT1NSOLLEM_DRS "Filterzeitkonstante für Solldrehzahl EM" VALUE 0x1D18C8 FLOAT32_IEEE_COL_DIRECT_S6_S3 0 t_fl_S6_S3 -3.40282e+038 3.40282e+038 /end CHARACTERISTIC
/begin CHARACTERISTIC T_VK0OEFFNEN_LAU_ABST "Verzögerungszeit als Übergangsbedingung nach K0-Öffnen im Zustand Last-Übernahme beim VM Abstellen" VALUE 0x1D0DBC FLOAT32_IEEE_COL_DIRECT_S6_S3 0 t_fl_S6_S3 0 5 /end CHARACTERISTIC
/begin CHARACTERISTIC T_VK0SREGAKTIV_SYN_ANK "Verzögerungszeit zur Aktivierung der K0-Schlupfregelung nach Eintritt in den Zustand K0 Synchronisieren beim Ankoppeln" VALUE 0x1D0F80 FLOAT32_IEEE_COL_DIRECT_S6_S3 0 t_fl_S6_S3 0 5 /end CHARACTERISTIC
/begin CHARACTERISTIC T_VK0SYNCERK_SYN_ANK "Verzögerungszeit der K0-Synchron-Erkennung im Zustand K0 Synchronisieren beim Ankoppeln" VALUE 0x1D0F84 FLOAT32_IEEE_COL_DIRECT_S6_S3 0 t_fl_S6_S3 0 10 /end CHARACTERISTIC
/begin CHARACTERISTIC T_VMDZIELSOLLK0_SYN_ANK "Verzögerungszeit zur Init. der VM-Solldrehzahl bei geringer Momentdif. zwischen K0" VALUE 0x1D0F88 FLOAT32_IEEE_COL_DIRECT_S6_S3 0 t_fl_S6_S3 0 5 /end CHARACTERISTIC
/begin CHARACTERISTIC T_VZK0OEFFNEN_LAU_ABK "Verzögerungszeit als Übergangsbedingung nach 'K0-Öffnen' im Zustand 'Last-Übernahme' beim Abkoppeln" VALUE 0x1CFE00 FLOAT32_IEEE_COL_DIRECT_S6_S3 0 t_fl_S6_S3 0 5 /end CHARACTERISTIC
/begin CHARACTERISTIC Z_ABLAUFVARIANTE_GEFABST_ABST "Anforderung der Variante Geführtes Ab-stellen durch die HAS Zustandssteuerung (OML) beim VM Abstellen (z_ablaufvariante_has_stg) " VALUE 0x1D7CC5 UBYTE_COL_DIRECT_S6_S3 0 void_int_S6_S3 0 100 /end CHARACTERISTIC
/begin CHARACTERISTIC Z_ABLAUFVARIANTE_K0SOEF_ABST "Anforderung der Variante K0 Schnelloeffnen durch die HAS Zustandssteuerung (OML) beim VM Abstellen (z_ablaufvariante_has_stg) " VALUE 0x1D7CC6 UBYTE_COL_DIRECT_S6_S3 0 void_int_S6_S3 0 100 /end CHARACTERISTIC
/begin CHARACTERISTIC Z_ABLAUF_ABBRUCH_ANK "Anzeige eines Abbruchs durch die Strategieanpassung" VALUE 0x1D7CE3 UBYTE_COL_DIRECT_S6_S3 0 void_int_S6_S3 0 255 /end CHARACTERISTIC
/begin MEASUREMENT abstellpos_vm_in "Abstellposition VM vor nächstem ZOT" UBYTE void_int_S6_S3 1 100 0 180 ECU_ADDRESS 0xFFF86698 /end MEASUREMENT
/begin MEASUREMENT abstellpos_vm_status_in "Status Abstellposition VM" UBYTE void_int_S6_S3 1 100 0 2 ECU_ADDRESS 0xFFF86699 /end MEASUREMENT
/begin MEASUREMENT c_getriebe_egs_in "" FLOAT32_IEEE c_int_S6_S3 1 100 -40 215 ECU_ADDRESS 0xFFF85DDC /end MEASUREMENT
/begin MEASUREMENT c_vm_in "" FLOAT32_IEEE c_int_S6_S3 1 100 -3.40282e+038 3.40282e+038 ECU_ADDRESS 0xFFF85E38 /end MEASUREMENT
/begin MEASUREMENT gangwechsel_egs_in "Flag während laufender Schaltung, bei synchron verlassen bis synchron erreicht" UBYTE void_int_S6_S3 1 100 0 1 ECU_ADDRESS 0xFFF86677 /end MEASUREMENT
/begin MEASUREMENT i_istgang_egs "" FLOAT32_IEEE void_fl_S6_S3 1 100 0 8 ECU_ADDRESS 0xFFF85D8C /end MEASUREMENT
/begin MEASUREMENT i_zielgang_egs "" FLOAT32_IEEE void_fl_S6_S3 1 100 0 8 ECU_ADDRESS 0xFFF85D90 /end MEASUREMENT
/begin MEASUREMENT istgang_egs_in "" SBYTE void_int_S6_S3 1 100 -128 127 ECU_ADDRESS 0xFFF86678 /end MEASUREMENT
/begin MEASUREMENT m_em_in "" FLOAT32_IEEE trq_fl_a_S6_S3 1 100 -1024 1024 ECU_ADDRESS 0xFFF85DE0 /end MEASUREMENT
/begin MEASUREMENT m_iae_in "" FLOAT32_IEEE trq_fl_a_S6_S3 1 100 -32768 32767 ECU_ADDRESS 0xFFF85DE4 /end MEASUREMENT
/begin MEASUREMENT m_k0_in "" FLOAT32_IEEE trq_fl_a_S6_S3 1 100 -32768 32767 ECU_ADDRESS 0xFFF85DE8 /end MEASUREMENT
/begin MEASUREMENT m_k0_mber_has_sbe "K0-Moment der HAS zur Motormomentbegrenzung in der SAB" FLOAT32_IEEE trq_fl_a_S6_S3 1 100 -3.40282e+038 3.40282e+038 ECU_ADDRESS 0xFFF85DC4 /end MEASUREMENT
/begin MEASUREMENT m_k0_mod_has_fkt "" FLOAT32_IEEE trq_fl_a_S6_S3 1 100 -1200 1200 ECU_ADDRESS 0xFFF85D4C /end MEASUREMENT
/begin MEASUREMENT m_k0_mod_max_syn_ank "Maximalwert des modifizierten K0-Istmoments der HAS beim K0 Synchronisieren beim Ankoppeln" FLOAT32_IEEE trq_fl_a_S6_S3 1 100 -3.40282e+038 3.40282e+038 ECU_ADDRESS 0xFFF9674C /end MEASUREMENT
/begin MEASUREMENT m_max_dyn_em_in "" FLOAT32_IEEE trq_fl_a_S6_S3 1 100 -32768 32767 ECU_ADDRESS 0xFFF85DEC /end MEASUREMENT
/begin MEASUREMENT m_min_dyn_em_in "" FLOAT32_IEEE trq_fl_a_S6_S3 1 100 -3.40282e+038 3.40282e+038 ECU_ADDRESS 0xFFF85DF0 /end MEASUREMENT
/begin MEASUREMENT m_min_vm_in "" FLOAT32_IEEE trq_fl_a_S6_S3 1 100 -3.40282e+038 3.40282e+038 ECU_ADDRESS 0xFFF85E3C /end MEASUREMENT
/begin MEASUREMENT m_mot_in "" FLOAT32_IEEE trq_fl_a_S6_S3 1 100 -1024 1024 ECU_ADDRESS 0xFFF85DF4 /end MEASUREMENT
/begin MEASUREMENT m_motmax_has "" FLOAT32_IEEE trq_fl_a_S6_S3 1 100 -1200 1200 ECU_ADDRESS 0xFFF85DC8 /end MEASUREMENT
/begin MEASUREMENT m_soll_em_hst_in "" FLOAT32_IEEE trq_fl_a_S6_S3 1 100 -32768 32767 ECU_ADDRESS 0xFFF85DF8 /end MEASUREMENT
/begin MEASUREMENT m_soll_k0_has_fkt "" FLOAT32_IEEE trq_fl_a_S6_S3 1 100 -1200 1200 ECU_ADDRESS 0xFFF85D60 /end MEASUREMENT
/begin MEASUREMENT m_soll_res_em_bas_sbe "" FLOAT32_IEEE trq_fl_a_S6_S3 1 100 -3.40282e+038 3.40282e+038 ECU_ADDRESS 0xFFF85DCC /end MEASUREMENT
/begin MEASUREMENT m_soll_res_em_has_sbe "" FLOAT32_IEEE trq_fl_a_S6_S3 1 100 -3.40282e+038 3.40282e+038 ECU_ADDRESS 0xFFF85DD0 /end MEASUREMENT
/begin MEASUREMENT m_soll_vm_hst_in "" FLOAT32_IEEE trq_fl_a_S6_S3 1 100 -32768 32767 ECU_ADDRESS 0xFFF85DFC /end MEASUREMENT
/begin MEASUREMENT m_soll_vm_l_hst_in "" FLOAT32_IEEE trq_fl_a_S6_S3 1 100 -3.40282e+038 3.40282e+038 ECU_ADDRESS 0xFFF85E40 /end MEASUREMENT
/begin MEASUREMENT m_sollk0begrk0sreg_lau_abst "Begrenzung des K0 Sollmoments bei vor dem Ab-lauf aktiver K0 Schlupfregelung und unterdrückter Aktivierung der K0 Schlupfregelung im Zustand 'Last-Übernahme' beim VM Abstellen" FLOAT32_IEEE trq_fl_a_S6_S3 1 100 -1000 1000 ECU_ADDRESS 0xFFF854D8 /end MEASUREMENT
/begin MEASUREMENT m_stoer_k0_em_fil_abo "Gefiltertes Stoermoment der K0 im Schleppstart" FLOAT32_IEEE trq_fl_a_S6_S3 1 100 -3.40282e+038 3.40282e+038 ECU_ADDRESS 0xFFF965E4 /end MEASUREMENT
/begin MEASUREMENT m_vm_in "" FLOAT32_IEEE trq_fl_a_S6_S3 1 100 -1024 1023.5 ECU_ADDRESS 0xFFF85E00 /end MEASUREMENT
/begin MEASUREMENT m_vm_start_in "" FLOAT32_IEEE trq_fl_a_S6_S3 1 100 -1024 1023.5 ECU_ADDRESS 0xFFF85E04 /end MEASUREMENT
/begin MEASUREMENT m_wunsch_fpw_hst_fil "" FLOAT32_IEEE trqg_fl_c_S6_S3 1 100 -2000 2000 ECU_ADDRESS 0xFFF85D94 /end MEASUREMENT
/begin MEASUREMENT m_wunsch_fpw_hst_in "" FLOAT32_IEEE trq_fl_a_S6_S3 1 100 -3.40282e+038 3.40282e+038 ECU_ADDRESS 0xFFF85E44 /end MEASUREMENT
/begin MEASUREMENT m_wunsch_fpw_in "" FLOAT32_IEEE trq_fl_a_S6_S3 1 100 -32768 32767 ECU_ADDRESS 0xFFF85E08 /end MEASUREMENT
/begin MEASUREMENT m_ziel_k0_ank "Zielmoment der Trennkupplung K0 beim Ankoppeln" FLOAT32_IEEE trq_fl_a_S6_S3 1 100 -3.40282e+038 3.40282e+038 ECU_ADDRESS 0xFFF96750 /end MEASUREMENT
/begin MEASUREMENT mg_k0_mod_max_ank "Max. Gradienten des mod. K0-Moments der HAS beim K0-Schliessen beim Ankoppeln" FLOAT32_IEEE trqg_fl_c_S6_S3 1 100 0 50000 ECU_ADDRESS 0xFFF96754 /end MEASUREMENT
/begin MEASUREMENT mg_soll_k0_max_ank "Max. Gradienten des K0-Sollmoments der HAS beim K0-Schliessen beim Ankoppeln" FLOAT32_IEEE trqg_fl_c_S6_S3 1 100 0 50000 ECU_ADDRESS 0xFFF96758 /end MEASUREMENT
/begin MEASUREMENT mg_soll_k0_syn_ank "Gradient des K0-Sollmoments beim K0 Synchronisieren beim Ankoppeln" FLOAT32_IEEE trqg_fl_c_S6_S3 1 100 -3.40282e+038 3.40282e+038 ECU_ADDRESS 0xFFF9675C /end MEASUREMENT
/begin MEASUREMENT mg_wunsch_fpw "" FLOAT32_IEEE trqg_fl_c_S6_S3 1 100 -2000 2000 ECU_ADDRESS 0xFFF85D98 /end MEASUREMENT
/begin MEASUREMENT mg_wunsch_fpw_hst "" FLOAT32_IEEE trqg_fl_c_S6_S3 1 100 -2000 2000 ECU_ADDRESS 0xFFF85D9C /end MEASUREMENT
/begin MEASUREMENT msollresem_stat_abo_mes "Gem. in Input nach Getr. Subsystem" FLOAT32_IEEE trq_fl_a_S6_S3 1 100 -3.40282e+038 3.40282e+038 ECU_ADDRESS 0xFFF965E8 /end MEASUREMENT
/begin MEASUREMENT n_ab_egs_in "" FLOAT32_IEEE n_fl_S6_S3 1 100 0 65535 ECU_ADDRESS 0xFFF85E0C /end MEASUREMENT
/begin MEASUREMENT n_em_in "" FLOAT32_IEEE n_fl_S6_S3 1 100 -3.40282e+038 3.40282e+038 ECU_ADDRESS 0xFFF85E10 /end MEASUREMENT
/begin MEASUREMENT n_em_mod_syn_ank "Modifizierte EM-Drehzahl als Basisdrehzahl zur Be-stimmung der VM Solldrehzahl bei RS beim K0 Syn-chronisieren beim Ankoppeln" FLOAT32_IEEE n_fl_S6_S3 1 100 -3.40282e+038 3.40282e+038 ECU_ADDRESS 0xFFF96760 /end MEASUREMENT
/begin MEASUREMENT n_em_ref_syn_ank "EM Referenzdrehzahl zur Bestimmung der modifizierten EM-Drehzahl als Basisdrehzahl zur Bestimmung der VM Solldrehzahl bei RS beim K0 Synchronisieren beim Ankoppeln" FLOAT32_IEEE n_fl_S6_S3 1 100 -3.40282e+038 3.40282e+038 ECU_ADDRESS 0xFFF96764 /end MEASUREMENT
/begin MEASUREMENT n_min_em_has_sbe "Minimale EM Drehzahl der Leerlaufsimulation der HAS (LLS)" FLOAT32_IEEE n_fl_S6_S3 1 100 -32767 32767 ECU_ADDRESS 0xFFF85DD4 /end MEASUREMENT
/begin MEASUREMENT n_min_psys_em_has_sbe "Minimale EM Drehzahl zur Sicherstellung Ölversorgung" FLOAT32_IEEE n_fl_S6_S3 1 100 -32767 32767 ECU_ADDRESS 0xFFF85DA0 /end MEASUREMENT
/begin MEASUREMENT n_mot_soll_iae_in "" FLOAT32_IEEE n_fl_S6_S3 1 100 -3.40282e+038 3.40282e+038 ECU_ADDRESS 0xFFF85E14 /end MEASUREMENT
/begin MEASUREMENT n_sec_iae "" FLOAT32_IEEE n_fl_S6_S3 1 100 -10000 10000 ECU_ADDRESS 0xFFF85DA4 /end MEASUREMENT
/begin MEASUREMENT n_sec_iae_ist_ank "Abtriebsseitige IAE-Drehzahl bezogen auf den Getriebeeeingang und den aktuellen  Istgang während einer Schaltung beim Ankoppeln" FLOAT32_IEEE n_fl_S6_S3 1 100 -3.40282e+038 3.40282e+038 ECU_ADDRESS 0xFFF96768 /end MEASUREMENT
/begin MEASUREMENT n_sec_iae_ziel_ank "Abtriebsseitige IAE-Drehzahl bezogen auf den Getriebeeingang und den aktuellen Zielgang während einer Schaltung beim Ankoppeln" FLOAT32_IEEE n_fl_S6_S3 1 100 -3.40282e+038 3.40282e+038 ECU_ADDRESS 0xFFF9676C /end MEASUREMENT
/begin MEASUREMENT n_soll_em_hst_in "" FLOAT32_IEEE n_fl_S6_S3 1 100 -3.40282e+038 3.40282e+038 ECU_ADDRESS 0xFFF85E48 /end MEASUREMENT
/begin MEASUREMENT n_soll_ll_vm_in "" FLOAT32_IEEE n_fl_S6_S3 1 100 0 2540 ECU_ADDRESS 0xFFF85E18 /end MEASUREMENT
/begin MEASUREMENT n_t_egs_in "" FLOAT32_IEEE n_fl_S6_S3 1 100 0 65535 ECU_ADDRESS 0xFFF85E1C /end MEASUREMENT
/begin MEASUREMENT n_vm_in "" FLOAT32_IEEE n_fl_S6_S3 1 100 0 65535 ECU_ADDRESS 0xFFF85E20 /end MEASUREMENT
/begin MEASUREMENT nd_iae "" FLOAT32_IEEE n_fl_S6_S3 1 100 -10000 10000 ECU_ADDRESS 0xFFF85DA8 /end MEASUREMENT
/begin MEASUREMENT nd_k0_in "" FLOAT32_IEEE n_fl_S6_S3 1 100 -10000 10000 ECU_ADDRESS 0xFFF85DAC /end MEASUREMENT
/begin MEASUREMENT nd_sec_iae_syn_ank "Abtriebsseitiger IAE-Drehzahlsprung bezogen auf den Getriebeeeingang während einer Schaltung im Zustand K0 Synchronisieren beim Ankoppeln" FLOAT32_IEEE n_fl_S6_S3 1 100 -3.40282e+038 3.40282e+038 ECU_ADDRESS 0xFFF96770 /end MEASUREMENT
/begin MEASUREMENT ndg_k0_in "" FLOAT32_IEEE ng_fl_S6_S3 1 100 -10000 10000 ECU_ADDRESS 0xFFF85DB0 /end MEASUREMENT
/begin MEASUREMENT nds_k0syncerk_syn_ank "Wirksame Differenzdrehzahlschwelle zur Erkennung Synchron beim Ankoppeln" FLOAT32_IEEE n_fl_S6_S3 1 100 -3.40282e+038 3.40282e+038 ECU_ADDRESS 0xFFF96774 /end MEASUREMENT
/begin MEASUREMENT ng_em_ank "EM-Drehzahlgradient beim Ankoppeln" FLOAT32_IEEE ng_fl_S6_S3 1 100 -10000 10000 ECU_ADDRESS 0xFFF96778 /end MEASUREMENT
/begin MEASUREMENT ng_emmodrsmax_syn_ank "Maximaler Gradient der modifizierten EM-Drehzahl als Basisdrehzahl zur Bestimmung der VM Solldrehzahl bei RS beim K0 Synchronisieren beim Ankoppeln" FLOAT32_IEEE ng_fl_S6_S3 1 100 -3.40282e+038 3.40282e+038 ECU_ADDRESS 0xFFF9677C /end MEASUREMENT
/begin MEASUREMENT ng_vm "" FLOAT32_IEEE ng_fl_S6_S3 1 100 -10000 10000 ECU_ADDRESS 0xFFF85DB4 /end MEASUREMENT
/begin MEASUREMENT ng_vm_gef_ast_abst "Gefilterter VM Drehzahlgradient im Zustand \"VM-Abstellen\" beim VM Abstellen" FLOAT32_IEEE ng_fl_S6_S3 1 100 -30000 30000 ECU_ADDRESS 0xFFF854DC /end MEASUREMENT
/begin MEASUREMENT osmode_next_in "" UBYTE void_int_S6_S3 1 100 1 3 ECU_ADDRESS 0xFFF86679 /end MEASUREMENT
/begin MEASUREMENT p_bremse_fzg_in "" FLOAT32_IEEE p_fl_S6_S3 1 100 -32000 0 ECU_ADDRESS 0xFFF85E24 /end MEASUREMENT
/begin MEASUREMENT phi_neigung_in "Fahrzeug-Neigungswinkel" FLOAT32_IEEE void_fl_S6_S3 1 100 -3.40282e+038 3.40282e+038 ECU_ADDRESS 0xFFF85E28 /end MEASUREMENT
/begin MEASUREMENT pos_egs_in "Waehlhebelposition" UBYTE E_POS_S6_S3 1 100 0 8 ECU_ADDRESS 0xFFF8667A /end MEASUREMENT
/begin MEASUREMENT sollgang_egs_in "" SBYTE void_int_S6_S3 1 100 -128 127 ECU_ADDRESS 0xFFF8667B /end MEASUREMENT
/begin MEASUREMENT st_OMLID_act_stg "Innere Zustände der OML" UWORD void_int_b_S6_S3 1 100 0 4999 ECU_ADDRESS 0xFFF860CA /end MEASUREMENT
/begin MEASUREMENT st_ist_bz_has_stg "Istzustand OML" UBYTE E_STBZHAS_S6_S3 1 100 0 15 ECU_ADDRESS 0xFFF86635 /end MEASUREMENT
/begin MEASUREMENT st_soll_bz_has_hst "interner HST Soll-Betriebszustand der Strategieanpassung (variantenunabhaengig)" UBYTE void_int_S6_S3 1 100 0 1 ECU_ADDRESS 0xFFF8669A /end MEASUREMENT
/begin MEASUREMENT st_ziel_bz_has_stg "Zielzustand OML" UBYTE E_STBZHAS_S6_S3 1 100 0 15 ECU_ADDRESS 0xFFF86636 /end MEASUREMENT
/begin MEASUREMENT status_alaengs_adaoff_in "Information, ob die Adaptionen aufgrund erkannter Laengsbeschleunigung deaktiviert wird. 0 = Adaption aktiv aufgrund erkannter Laengsbeschleunigung
1 = Adaption inaktiv aufgrund nicht erkannter Laengsbeschleunigung" UBYTE void_int_S6_S3 1 100 0 1 ECU_ADDRESS 0xFFF8667C /end MEASUREMENT
/begin MEASUREMENT status_betriebsbereit_hst_in "" UBYTE void_int_S6_S3 1 100 0 1 ECU_ADDRESS 0xFFF8669B /end MEASUREMENT
/begin MEASUREMENT status_efahren_has_sbe "Status E-Fahren der HAS zur Festlegung der entsprechenden Portout-Größe in der HAS Signalaufbereitung_Out" UBYTE void_int_S6_S3 1 100 0 1 ECU_ADDRESS 0xFFF8665A /end MEASUREMENT
/begin MEASUREMENT status_fehler15_eh_diagin "Info vom Errorhandler ob Ersatzfkt. aktiv" UBYTE void_int_S6_S3 1 100 0 1 ECU_ADDRESS 0xFFF8662E /end MEASUREMENT
/begin MEASUREMENT status_fehler_iep_in "" UBYTE E_FEHLERIEP_S6_S3 1 100 0 1 ECU_ADDRESS 0xFFF8667D /end MEASUREMENT
/begin MEASUREMENT status_iae_adap_in "Status der Adaption des Integrierten Anfahrelements IAE" UBYTE E_STATUSADA_S6_S3 1 100 0 2 ECU_ADDRESS 0xFFF8667E /end MEASUREMENT
/begin MEASUREMENT status_iae_in "" UBYTE E_STATUSIAE_S6_S3 1 100 0 8 ECU_ADDRESS 0xFFF8667F /end MEASUREMENT
/begin MEASUREMENT status_iep_in "" UBYTE E_STATUSIEP_S6_S3 1 100 0 4 ECU_ADDRESS 0xFFF86680 /end MEASUREMENT
/begin MEASUREMENT status_k0_adap_in "" UBYTE E_STATUSADA_S6_S3 1 100 0 2 ECU_ADDRESS 0xFFF86681 /end MEASUREMENT
/begin MEASUREMENT status_k0_in "" UBYTE E_STATUSK0_S6_S3 1 100 0 5 ECU_ADDRESS 0xFFF86682 /end MEASUREMENT
/begin MEASUREMENT status_k0sreg_lau_abk "Status der bedingten Aktivierung der K0 Schlupfregelung im Zustand 'Last-Übernahme' beim Abkoppeln" UBYTE void_int_S6_S3 1 100 0 1 ECU_ADDRESS 0xFFF96DA0 /end MEASUREMENT
/begin MEASUREMENT status_k0sreg_lau_abst "Status der bedingten Aktivierung der K0 Schlupfregelung im Zustand Last-Übernahme beim VM Abstellen" UBYTE void_int_S6_S3 1 100 0 10 ECU_ADDRESS 0xFFF8632D /end MEASUREMENT
/begin MEASUREMENT status_kl15_in "" UBYTE void_int_S6_S3 1 100 0 1 ECU_ADDRESS 0xFFF8669C /end MEASUREMENT
/begin MEASUREMENT status_kolbenpos_k0_in "" UBYTE void_int_S6_S3 1 100 0 255 ECU_ADDRESS 0xFFF86683 /end MEASUREMENT
/begin MEASUREMENT status_kraftfluss_egs_in "" UBYTE E_STATUSKSL_S6_S3 1 100 0 6 ECU_ADDRESS 0xFFF86684 /end MEASUREMENT
/begin MEASUREMENT status_kraftfluss_egs_roh_in "" UBYTE void_int_S6_S3 1 100 0 255 ECU_ADDRESS 0xFFF86685 /end MEASUREMENT
/begin MEASUREMENT status_ll_vm_in "" UBYTE void_int_S6_S3 1 100 0 255 ECU_ADDRESS 0xFFF86686 /end MEASUREMENT
/begin MEASUREMENT status_nem_in "Status zur Drehzahl E-Motor" UBYTE E_SIGSTATUS_S6_S3 1 100 0 2 ECU_ADDRESS 0xFFF86687 /end MEASUREMENT
/begin MEASUREMENT status_nreg_em_hst_in "Status E-Motor Drehzahlregelung der HST" UBYTE void_int_S6_S3 1 100 0 255 ECU_ADDRESS 0xFFF8669D /end MEASUREMENT
/begin MEASUREMENT status_nvm_in "Status zur Drehzahl VM-Motor" UBYTE E_SIGSTATUS_S6_S3 1 100 0 2 ECU_ADDRESS 0xFFF86688 /end MEASUREMENT
/begin MEASUREMENT status_posvueb_in "Erkennung PosV Diagnose" UBYTE void_int_S6_S3 1 100 0 255 ECU_ADDRESS 0xFFF86689 /end MEASUREMENT
/begin MEASUREMENT status_psys_has_sbe "" UBYTE E_STATUSPSY_S6_S3 1 100 0 4 ECU_ADDRESS 0xFFF86654 /end MEASUREMENT
/begin MEASUREMENT status_sa_vm_in "00 Keine Beeinflussung; 01 Schubabschaltung aktiv; 10 Nicht stellbarer Bereich; 11 Signal ungültig" UBYTE void_int_S6_S3 1 100 0 3 ECU_ADDRESS 0xFFF8669E /end MEASUREMENT
/begin MEASUREMENT status_sa_vm_lau_abk "Status VM Schubabschaltung im Zustand 'Last-Übernahme' beim Abkoppeln" UBYTE void_int_S6_S3 1 100 0 1 ECU_ADDRESS 0xFFF8629D /end MEASUREMENT
/begin MEASUREMENT status_sa_vm_lau_abst "Status VM Schubabschaltung im Zustand \"Last-Übernahme\" beim VM Abstellen" UBYTE void_int_S6_S3 1 100 0 10 ECU_ADDRESS 0xFFF8632E /end MEASUREMENT
/begin MEASUREMENT status_schaltart_svh_has_sbe "Schaltart der angeforderten Schaltung der Schaltverhinderung der HAS (0 = keine Schaltung angefordert) - Bit-Codierung (m/oL=mit/ohne Lanstanh.)=: bit0=ZRSmL,1=ZHSmL,2=SRSmL,3=SHSmL,4=ZRSoL,5=ZHSoL,6=SRSoL,7=SHSoL" UBYTE void_int_S6_S3 1 100 0 255 ECU_ADDRESS 0xFFF8665B /end MEASUREMENT
/begin MEASUREMENT status_schaltung_egs_in "" SBYTE void_int_S6_S3 1 100 -9 9 ECU_ADDRESS 0xFFF86655 /end MEASUREMENT
/begin MEASUREMENT status_sync_schaltung_sbe "Anzeige der Synchronerkennung der aktuellen Schaltung innerhalb der HAS" UBYTE void_int_S6_S3 1 100 0 1 ECU_ADDRESS 0xFFF86656 /end MEASUREMENT
/begin MEASUREMENT status_waschstr_in "" UBYTE void_int_S6_S3 1 100 0 255 ECU_ADDRESS 0xFFF8668A /end MEASUREMENT
/begin MEASUREMENT status_zug_svh_sbe "Status für Anzeige Zug/Schub" UBYTE void_int_S6_S3 1 100 0 1 ECU_ADDRESS 0xFFF8665C /end MEASUREMENT
/begin MEASUREMENT t_betrieb_pvu_has_ee_in "" ULONG t_int_S6_S3 1 100 0 10000 ECU_ADDRESS 0xFFF85E2C /end MEASUREMENT
/begin MEASUREMENT t_betrieb_pvu_has_sbe "Betriebsdauer seit dem letzten Ablauf der Diagnosefunktion \"Positionsventil-Überwachung\" der Funktion zur Unterstüt-zung der Positionsventil-Überwachung der HAS" FLOAT32_IEEE t_fl_S6_S3 1 100 0 1000000 ECU_ADDRESS 0xFFF85DB8 /end MEASUREMENT
/begin MEASUREMENT t_k0oeffnenbed_lau_abk "Timer der Verzögerungszeit als Übergangsbedingung nach 'K0-Öffnen' im Zustand 'Last-Übernahme' beim Abkoppeln" UWORD t_int_h_S6_S3 1 100 0 5 ECU_ADDRESS 0xFFF96EF4 /end MEASUREMENT
/begin MEASUREMENT t_k0oeffnenbed_lau_abst "Timer der Verzögerungszeit als Übergangsbedingung nach \"K0-Öffnen\" im Zustand \"Last-Übernahme\" beim VM Abstellen" FLOAT32_IEEE t_fl_S6_S3 1 100 0 5 ECU_ADDRESS 0xFFF854E0 /end MEASUREMENT
/begin MEASUREMENT t_k0sregaktiv_syn_ank "Timer der Verzögerungszeit zur Aktivierung der K0-Schlupfregelung nach Eintritt in den Zustand K0 Syn-chronisieren beim Ankoppeln" FLOAT32_IEEE t_fl_S6_S3 1 100 -3.40282e+038 3.40282e+038 ECU_ADDRESS 0xFFF96780 /end MEASUREMENT
/begin MEASUREMENT t_k0sregbasis_syn_ank "Timer der Maximalzeit zum Setzen der Basisbedingung zur Aktivierung der K0-Schlupfregelung im Zustand K0 Synchronisieren beim Ankoppeln" FLOAT32_IEEE t_fl_S6_S3 1 100 -3.40282e+038 3.40282e+038 ECU_ADDRESS 0xFFF96784 /end MEASUREMENT
/begin MEASUREMENT t_k0syncerk_syn_ank "Timer zur Erkennung Synchron beim K0 Synchronisieren beim Ankoppeln" FLOAT32_IEEE t_fl_S6_S3 1 100 0 5 ECU_ADDRESS 0xFFF96788 /end MEASUREMENT
/begin MEASUREMENT t_k0syncerkums_syn_ank "Timer für die Umschaltung der Differenzdrehzahlschwelle zur Erkennung Synchron beim Ankoppeln" FLOAT32_IEEE t_fl_S6_S3 1 100 0 10 ECU_ADDRESS 0xFFF9678C /end MEASUREMENT
/begin MEASUREMENT t_m_k0_mod_ziel_ank "Timer zur Berücksichtigung des K0 Istmoments als Zielmoment für das modifizierte K0 Ist-Moment beim K0-Schliessen beim Ankoppeln" FLOAT32_IEEE t_fl_S6_S3 1 100 0 10 ECU_ADDRESS 0xFFF96790 /end MEASUREMENT
/begin MEASUREMENT t_m_soll_k0_anst_ank "Timer zur Überwachung der maximalen Dauer der K0-Ansteuerung HAS beim K0-Schließen beim Ankoppeln" UBYTE void_int_S6_S3 1 100 0 10 ECU_ADDRESS 0xFFF96DA5 /end MEASUREMENT
/begin MEASUREMENT t_max_abb_nos_mess "Timer der maximalen Verweildauer im Zustand Abbruch" FLOAT32_IEEE t_fl_S6_S3 1 100 -3.40282e+038 3.40282e+038 ECU_ADDRESS 0xFFF96838 /end MEASUREMENT
/begin MEASUREMENT t_max_scl_nos_mess "Timer der maximalen Verweildauer im Zustand K0-Schliessen" FLOAT32_IEEE t_fl_S6_S3 1 100 -3.40282e+038 3.40282e+038 ECU_ADDRESS 0xFFF96840 /end MEASUREMENT
/begin MEASUREMENT t_maxbed_abb_ank "Timer zur Überwachung der maximalen Verweildauer im Zustand 'Abbruch Ankoppeln' beim Ankoppeln" FLOAT32_IEEE t_fl_S6_S3 1 100 0 10 ECU_ADDRESS 0xFFF96794 /end MEASUREMENT
/begin MEASUREMENT t_maxbed_ast_abst "Timer zur Überwachung der maximalen Verweildauer im Zustand \"VM-Abstellen\" beim VM Abstellen" FLOAT32_IEEE t_fl_S6_S3 1 100 0 10 ECU_ADDRESS 0xFFF854E4 /end MEASUREMENT
/begin MEASUREMENT t_maxbed_gab_abst "Timer zur Überwachung der maximalen Verweildau-er im Zustand 'VM geführt Abstellen' beim VM Ab-stellen" FLOAT32_IEEE t_fl_S6_S3 1 100 0 10 ECU_ADDRESS 0xFFF854E8 /end MEASUREMENT
/begin MEASUREMENT t_maxbed_koe_abk "Timer zur Überwachung der maximalen Verweildauer im Zustand 'K0-Öffnen' beim Abkoppeln" UWORD t_int_h_S6_S3 1 100 0 10 ECU_ADDRESS 0xFFF96EF6 /end MEASUREMENT
/begin MEASUREMENT t_maxbed_koe_abo_mes "Gemessen in St_SLST_Abbruch_Ans_En_St" FLOAT32_IEEE t_fl_S6_S3 1 100 -3.40282e+038 3.40282e+038 ECU_ADDRESS 0xFFF965EC /end MEASUREMENT
/begin MEASUREMENT t_maxbed_koe_abst "Timer zur Überwachung der maximalen Verweildauer im Zustand \"K0-Öffnen\" beim VM Abstellen" FLOAT32_IEEE t_fl_S6_S3 1 100 0 10 ECU_ADDRESS 0xFFF854EC /end MEASUREMENT
/begin MEASUREMENT t_maxbed_ksa_abk "Timer zur Überwachung der maximalen Verweildauer im Zustand 'K0-Schliessen Abbruch' beim Abkoppeln" UWORD t_int_h_S6_S3 1 100 0 10 ECU_ADDRESS 0xFFF96EF8 /end MEASUREMENT
/begin MEASUREMENT t_maxbed_ksa_abst "Timer zur Überwachung der maximalen Verweildauer im Zustand \"K0-Schliessen Abbruch\" beim VM Abstellen" FLOAT32_IEEE t_fl_S6_S3 1 100 0 10 ECU_ADDRESS 0xFFF854F0 /end MEASUREMENT
/begin MEASUREMENT t_maxbed_lau_abk "Timer zur Überwachung der maximalen Verweildauer im Zustand 'Last-Übernahme' beim Abkoppeln" UWORD t_int_h_S6_S3 1 100 0 10 ECU_ADDRESS 0xFFF96EFA /end MEASUREMENT
/begin MEASUREMENT t_maxbed_lau_abst "Timer zur Überwachung der maximalen Verweildauer im Zustand \"Last-Übernahme\" beim VM Abstellen" FLOAT32_IEEE t_fl_S6_S3 1 100 0 10 ECU_ADDRESS 0xFFF854F4 /end MEASUREMENT
/begin MEASUREMENT t_maxbed_sak_abst "Zeit der maximale Verweildauer im Zustand 'Schaltung Aktiv' beim VM Abstellen" FLOAT32_IEEE t_fl_S6_S3 1 100 0 10000 ECU_ADDRESS 0xFFF854F8 /end MEASUREMENT
/begin MEASUREMENT t_maxbed_sak_ank "Timer zur Überwachung der maximalen Verweildauer im Zustand 'Schaltung aktiv' beim Ankoppeln" FLOAT32_IEEE t_fl_S6_S3 1 100 0 10 ECU_ADDRESS 0xFFF96798 /end MEASUREMENT
/begin MEASUREMENT t_maxbed_scl_ank "Timer zur Überwachung der maximalen Verweildauer im Zustand 'K0 Schliessen' beim Ankoppeln" FLOAT32_IEEE t_fl_S6_S3 1 100 -3.40282e+038 3.40282e+038 ECU_ADDRESS 0xFFF9679C /end MEASUREMENT
/begin MEASUREMENT t_mdzielsollk0_syn_ank "Timer zur Initialisierung der VM-Solldrehzahlberechnung beim K0 Synchronisieren beim Ankoppeln" FLOAT32_IEEE t_fl_S6_S3 1 100 0 5 ECU_ADDRESS 0xFFF967A0 /end MEASUREMENT
/begin MEASUREMENT t_msollemaktiv_abo_mes "Timer Überwachung Ausgabe m_soll_em_has (Max.-Zeit)" FLOAT32_IEEE t_fl_S6_S3 1 100 -3.40282e+038 3.40282e+038 ECU_ADDRESS 0xFFF965F0 /end MEASUREMENT
/begin MEASUREMENT t_mstoerk0emfil_abo "Timerzeit zur Init. m_stoer_k0" FLOAT32_IEEE t_fl_S6_S3 1 100 -3.40282e+038 3.40282e+038 ECU_ADDRESS 0xFFF9662C /end MEASUREMENT
/begin MEASUREMENT t_ndgk0k0sreg_syn_ank "Timer der Mindestdauer bei der Abfrage des K0-Differenzdrehzahlgradienten zur Bestimmung des Zeit-punkt der Anforderung der Aktivierung der K0-Schlupfregelung im Zustand K0 Synchronisieren beim Ankoppeln" FLOAT32_IEEE t_fl_S6_S3 1 100 -3.40282e+038 3.40282e+038 ECU_ADDRESS 0xFFF967A4 /end MEASUREMENT
/begin MEASUREMENT t_ngsvm_ast_abst "Timer der Verzögerungszeit zur Abfrage der VM-Drehzahlgradientenschwelle zur Vorgabe \"K0 OEFFNENSW\" im Zustand \"VM-Abstellen\" beim VM Abstellen" FLOAT32_IEEE t_fl_S6_S3 1 100 0 10 ECU_ADDRESS 0xFFF854FC /end MEASUREMENT
/begin MEASUREMENT v_f_sbe "Fahrzeuggeschwindigkeit auf Basis der Getriebeabtriebsdrehzahl in der  Hybridablaufsteuerung" FLOAT32_IEEE v_fl_S6_S3 1 100 -3.40282e+038 3.40282e+038 ECU_ADDRESS 0xFFF85DBC /end MEASUREMENT
/begin MEASUREMENT vg_f_sbe "Fahrzeuggeschwindigkeitsgradient auf Basis der Getriebeabtriebsdrehzahl in der  Hybridablaufsteuerung" FLOAT32_IEEE vg_fl_S6_S3 1 100 -3.40282e+038 3.40282e+038 ECU_ADDRESS 0xFFF85DC0 /end MEASUREMENT
/begin MEASUREMENT z_ablauf_has_hst_in "" UBYTE void_int_S6_S3 1 100 0 15 ECU_ADDRESS 0xFFF8668B /end MEASUREMENT
/begin MEASUREMENT z_ablauf_has_stg "Zusaetzliche Steuergroesse zur Ablaufsteuerung" UBYTE void_int_S6_S3 1 100 0 15 ECU_ADDRESS 0xFFF86637 /end MEASUREMENT
/begin MEASUREMENT z_ablaufreinit_frk_dihi "Zeigt an, dass der aktuelle HAS-Ablauf erneut begonnen werden soll" UBYTE void_int_S6_S3 1 100 0 1 ECU_ADDRESS 0xFFF8662F /end MEASUREMENT
/begin MEASUREMENT z_ablaufvariante_has_hst_in "" UBYTE void_int_S6_S3 1 100 0 15 ECU_ADDRESS 0xFFF8668C /end MEASUREMENT
/begin MEASUREMENT z_ablaufvariante_has_stg "Ablaufvariante, die  die OML ausgibt" UBYTE void_int_S6_S3 1 100 0 99 ECU_ADDRESS 0xFFF86638 /end MEASUREMENT
/begin MEASUREMENT z_ba_has_k0_hst_in "" UBYTE void_int_S6_S3 1 100 0 1 ECU_ADDRESS 0xFFF8669F /end MEASUREMENT
/begin MEASUREMENT z_ba_has_vm_hst_in "" UBYTE void_int_S6_S3 1 100 0 1 ECU_ADDRESS 0xFFF866A0 /end MEASUREMENT
/begin MEASUREMENT z_diag_ersfkt_has_in "Funktionsschnittstelle zur Ermittlung ob irgendeine Ersatzmaßnahme in der Diagnoseverwaltung aktiv ist" ULONG b_int_S6_S3 1 100 0 4294967295 ECU_ADDRESS 0xFFF85E30 /end MEASUREMENT
/begin MEASUREMENT z_diag_ersfkt_hi_has_in "Funktionsschnittstelle zur Ermittlung ob irgendeine Ersatzmaßnahme in der Diagnoseverwaltung aktiv ist" ULONG b_int_S6_S3 1 100 0 4294967295 ECU_ADDRESS 0xFFF85E34 /end MEASUREMENT
/begin MEASUREMENT z_diag_notgang_has_in "Notganginformation" UBYTE void_int_S6_S3 1 100 0 255 ECU_ADDRESS 0xFFF8668D /end MEASUREMENT
/begin MEASUREMENT z_emfehler_frk_dihi "Zeigt an, dass eine EM Fehlfunktion erkannt wurde, die in der HAS ausgewertet werden soll" UBYTE void_int_S6_S3 1 100 0 1 ECU_ADDRESS 0xFFF86630 /end MEASUREMENT
/begin MEASUREMENT z_freigabe_pvu_has_sbe "Freigabe zur Aktivierung der Diagnosefunktion \"Positionsventil-Überwachung\" der Funktion zur Unterstützung der Positi-onsventil-Überwachung der HAS" UBYTE void_int_S6_S3 1 100 0 1 ECU_ADDRESS 0xFFF86657 /end MEASUREMENT
/begin MEASUREMENT z_fuwdeakt_frk_dihi "Zeigt an, dass die FUW-Funktion nicht aktiviert werden darf" UBYTE void_int_S6_S3 1 100 0 1 ECU_ADDRESS 0xFFF86631 /end MEASUREMENT
/begin MEASUREMENT z_gefabstbed_lau_abst "Bedingung zur Aktivierung der Ablaufvariante 'Geführtes Abstellen' im Zustand 'Last-Übernahme' beim VM Abstellen" UBYTE void_int_S6_S3 1 100 0 1 ECU_ADDRESS 0xFFF8632F /end MEASUREMENT
/begin MEASUREMENT z_hybfkt_stg "Anforderung der Aktivierung einer Hybridfunktion durch die Hyrid-Zustandssteuerung" UBYTE E_HYBFKT_S6_S3 1 100 0 15 ECU_ADDRESS 0xFFF86639 /end MEASUREMENT
/begin MEASUREMENT z_iep_in "" UBYTE E_ZIEP_S6_S3 1 100 0 4 ECU_ADDRESS 0xFFF8668E /end MEASUREMENT
/begin MEASUREMENT z_k0_fst_in "" UBYTE E_ZK0FSTIN_S6_S3 1 100 0 3 ECU_ADDRESS 0xFFF8668F /end MEASUREMENT
/begin MEASUREMENT z_k0_has_fkt "" UBYTE E_ZK0_S6_S3 1 100 0 5 ECU_ADDRESS 0xFFF86643 /end MEASUREMENT
/begin MEASUREMENT z_k0_has_sbe "" UBYTE E_ZK0_S6_S3 1 100 0 5 ECU_ADDRESS 0xFFF8665D /end MEASUREMENT
/begin MEASUREMENT z_k0syncmk0erh_frk_dihi "Zeigt an, dass eine K0-Zwangsynchronisation mittels Erhöhung des K0-Moments erfolgen soll" UBYTE void_int_S6_S3 1 100 0 1 ECU_ADDRESS 0xFFF86632 /end MEASUREMENT
/begin MEASUREMENT z_kps_stada_in "Sollvorgabe für die Trennkupplung K0 durch die Stillstandsadaption" UBYTE void_int_S6_S3 1 100 0 255 ECU_ADDRESS 0xFFF86690 /end MEASUREMENT
/begin MEASUREMENT z_modus_em_hst_in "" UBYTE void_int_S6_S3 1 100 0 255 ECU_ADDRESS 0xFFF86691 /end MEASUREMENT
/begin MEASUREMENT z_modus_iae_has_sbe "" UBYTE E_ZMODUSIAE_S6_S3 1 100 0 2 ECU_ADDRESS 0xFFF8665E /end MEASUREMENT
/begin MEASUREMENT z_modus_iep_has_sbe "Vorgabe des Betriebsmodus der IEP durch die HAS" UBYTE E_ZMODUSIEP_S6_S3 1 100 0 4 ECU_ADDRESS 0xFFF8665F /end MEASUREMENT
/begin MEASUREMENT z_msa_avh_moni_has_sbe "Anforderung einer Schaltverhinderung der HAS" UBYTE void_int_S6_S3 1 100 0 255 ECU_ADDRESS 0xFFF86660 /end MEASUREMENT
/begin MEASUREMENT z_msa_eaf_moni_has_sbe "Anforderung einer Schaltverhinderung der HAS" UBYTE void_int_S6_S3 1 100 0 255 ECU_ADDRESS 0xFFF86661 /end MEASUREMENT
/begin MEASUREMENT z_msa_fst_in "Anforderung einer Abschaltverhinderung durch die Fahrstrategie ASIS" UBYTE void_int_S6_S3 1 100 0 255 ECU_ADDRESS 0xFFF86692 /end MEASUREMENT
/begin MEASUREMENT z_msa_has_sbe "Anforderung der Beeinflussung der MSA-Funktionalität durch die Hybridablaufsteuerung - Codierung: bit0 = AVZ, bit1 = AVH, bit2 = EAF, bit3 = EVH, bit4 = Deaktivierung, bit7 = Störungsbedingt" UBYTE void_int_S6_S3 1 100 0 255 ECU_ADDRESS 0xFFF86662 /end MEASUREMENT
/begin MEASUREMENT z_msa_stada_in "" UBYTE void_int_S6_S3 1 100 0 6 ECU_ADDRESS 0xFFF866A1 /end MEASUREMENT
/begin MEASUREMENT z_n_min_em_parksp_has_in "Anforderung einer EM-Drehzahlanhebung beim Auslegen der Parksperre infolge unzureichender Ölversorgung" UBYTE void_int_S6_S3 1 100 0 1 ECU_ADDRESS 0xFFF86693 /end MEASUREMENT
/begin MEASUREMENT z_n_min_iep_in "Anforderung Ausgabe EM-Mindestdrehzahl zur Sicherstellung der Ölversorgung durch die IEP" UBYTE void_int_S6_S3 1 100 0 1 ECU_ADDRESS 0xFFF86694 /end MEASUREMENT
/begin MEASUREMENT z_ndsk0k0sreg_syn_ank "Anzeige des Aktivierungszeitpunkts im Bestimmungs-modus 'NDSK0' zur Anforderung der Aktivierung der K0-Schlupfregelung im Zustand K0 Synchronisieren beim Ankoppeln" UBYTE void_int_S6_S3 1 100 0 255 ECU_ADDRESS 0xFFF96DA6 /end MEASUREMENT
/begin MEASUREMENT z_nllsoll_iae_in "Anforderung der IAE, dass eine definierte LL-Drehzahl durch den Motor eingestellt werden soll" UBYTE E_ZNLLSOLL_S6_S3 1 100 0 2 ECU_ADDRESS 0xFFF86695 /end MEASUREMENT
/begin MEASUREMENT z_nminemnull_frk_dihi "Zeigt an, dass die Ausgabe der minimalen EM Drehzahl der HAS unterdrückt werden soll." UBYTE void_int_S6_S3 1 100 0 1 ECU_ADDRESS 0xFFF86633 /end MEASUREMENT
/begin MEASUREMENT z_nvmsollbegr_frk_dihi "Zeigt an, dass die VM-Solldrehzahl auf die EM-Istdrehzahl be-grenzt werden soll" UBYTE void_int_S6_S3 1 100 0 1 ECU_ADDRESS 0xFFF86634 /end MEASUREMENT
/begin MEASUREMENT z_pvu_has_sbe "Beeinflussung des Hybridsystems zur Unterstützung der Positionsventil- Überwachung der HAS-Codierung: 0 = keine Beeinflussung, 1 = Beeinflussung Stufe 1, 2 = Beeinflussung Stufe 2" UBYTE void_int_S6_S3 1 100 0 2 ECU_ADDRESS 0xFFF86658 /end MEASUREMENT
/begin MEASUREMENT z_sas_has_sbe "Ändert im Wahrheitsfall die KupplungsBefüllreihenfolge" UBYTE void_int_S6_S3 1 100 0 1 ECU_ADDRESS 0xFFF86663 /end MEASUREMENT
/begin MEASUREMENT z_start_modus_has_sbe "Anforderung eines Anlasserstarts" UBYTE void_int_S6_S3 1 100 0 255 ECU_ADDRESS 0xFFF86664 /end MEASUREMENT
/begin MEASUREMENT z_status_psys_mps_sbe "Flag, das eine Modifikation des Pumpendruckstatus anzeigt" UBYTE void_int_S6_S3 1 100 0 1 ECU_ADDRESS 0xFFF86659 /end MEASUREMENT
/begin MEASUREMENT z_svh_has_sbe "Anforderung einer Schaltverhinderung der HAS" UBYTE void_int_S6_S3 1 100 0 1 ECU_ADDRESS 0xFFF86665 /end MEASUREMENT
/begin MEASUREMENT z_t_maxbed_ast_abst "Timer zur Überwachung der maximalen Verweildauer im Zustand \"VM-Abstellen\" beim VM Abstellen" UBYTE void_int_S6_S3 1 100 0 1 ECU_ADDRESS 0xFFF86330 /end MEASUREMENT
/begin MEASUREMENT z_t_maxbed_gab_abst "Timer zur Überwachung der maximalen Verweildauer im Zustand 'VM geführt Abstellen' beim VM Ab-stellen" UBYTE void_int_S6_S3 1 100 0 1 ECU_ADDRESS 0xFFF86331 /end MEASUREMENT
/begin MEASUREMENT z_t_maxbed_koe_abo "Gemessen in St_SLST_Abbruch_Ans_En_St" UBYTE void_int_S6_S3 1 100 0 255 ECU_ADDRESS 0xFFF96DA1 /end MEASUREMENT
/begin MEASUREMENT z_t_maxbed_koe_abst "Timer zur Überwachung der maximalen Verweildauer im Zustand \"K0-Öffnen\" beim VM Abstellen" UBYTE void_int_S6_S3 1 100 0 1 ECU_ADDRESS 0xFFF86332 /end MEASUREMENT
/begin MEASUREMENT z_t_maxbed_ksa_abst "Timer zur Überwachung der maximalen Verweildauer im Zustand \"K0-Schliessen Abbruch\" beim VM Abstellen" UBYTE void_int_S6_S3 1 100 0 1 ECU_ADDRESS 0xFFF86333 /end MEASUREMENT
/begin MEASUREMENT z_t_maxbed_lau_abst "Timer zur Überwachung der maximalen Verweildauer im Zustand 'Last-Übernahme' " UBYTE void_int_S6_S3 1 100 0 1 ECU_ADDRESS 0xFFF86334 /end MEASUREMENT
/begin MEASUREMENT z_t_maxbed_sak_abst "Timer zur Überwachung der maximalen Verweildauer im Zustand 'Schaltung aktiv' beim VM Abstellen" UBYTE void_int_S6_S3 1 100 0 1 ECU_ADDRESS 0xFFF86335 /end MEASUREMENT
/begin MEASUREMENT z_t_msollemaktiv_abo "Timer Überwachung Ausgabe m_soll_em_has (Max.-Zeit)" UBYTE void_int_S6_S3 1 100 0 255 ECU_ADDRESS 0xFFF96DA2 /end MEASUREMENT
/begin MEASUREMENT z_ziel_kraftfluss_egs_in "" UBYTE void_int_S6_S3 1 100 0 255 ECU_ADDRESS 0xFFF86696 /end MEASUREMENT
/begin MEASUREMENT zielgang_egs_in "" SBYTE void_int_S6_S3 1 100 -128 127 ECU_ADDRESS 0xFFF86697 /end MEASUREMENT
/begin FUNCTION SFOp_ABK2_FOp_ABK ""
 /begin SUB_FUNCTION SFOp_ABK10_St_Start SFOp_ABK9_St_Ablauf SFOp_ABK6_Input SFOp_ABK20_Bitwise_AND_ui8_ SFOp_ABK19_Var_2 /end SUB_FUNCTION
 /begin DEF_CHARACTERISTIC K_SVH_RESET_LAU_ABK MO_VMK0ZUBED_KSA_ABK MS_K0VMABKBED_KOE_ABK NDS_K0VMABKBED_KOE_ABK NS_EMMINBED_KOE_ABK NS_EMMINBED_LAU_ABK NS_EMMINBED_SAK_ABK SWI_ABBRUCH_AKTIV_ABK /end DEF_CHARACTERISTIC
 /begin LOC_MEASUREMENT abstellpos_vm_in abstellpos_vm_status_in c_getriebe_egs_in c_vm_in gangwechsel_egs_in i_istgang_egs i_zielgang_egs istgang_egs_in m_em_in m_iae_in m_k0_in m_k0_mber_has_sbe m_k0_mod_has_fkt m_max_dyn_em_in m_min_dyn_em_in m_min_vm_in m_mot_in m_motmax_has m_soll_em_hst_in m_soll_k0_has_fkt m_soll_res_em_bas_sbe m_soll_res_em_has_sbe m_soll_vm_hst_in m_soll_vm_l_hst_in m_vm_in m_vm_start_in m_wunsch_fpw_hst_fil m_wunsch_fpw_hst_in m_wunsch_fpw_in mg_wunsch_fpw mg_wunsch_fpw_hst n_ab_egs_in n_em_in n_min_em_has_sbe n_min_psys_em_has_sbe n_mot_soll_iae_in n_sec_iae n_soll_em_hst_in n_soll_ll_vm_in n_t_egs_in n_vm_in nd_iae nd_k0_in ndg_k0_in ng_vm osmode_next_in p_bremse_fzg_in phi_neigung_in pos_egs_in sollgang_egs_in st_OMLID_act_stg st_ist_bz_has_stg st_soll_bz_has_hst st_ziel_bz_has_stg status_alaengs_adaoff_in status_betriebsbereit_hst_in status_efahren_has_sbe status_fehler15_eh_diagin status_fehler_iep_in status_iae_adap_in status_iae_in status_iep_in status_k0_adap_in status_k0_in status_kl15_in status_kolbenpos_k0_in status_kraftfluss_egs_in status_kraftfluss_egs_roh_in status_ll_vm_in status_nem_in status_nreg_em_hst_in status_nvm_in status_posvueb_in status_psys_has_sbe status_sa_vm_in status_schaltart_svh_has_sbe status_schaltung_egs_in status_sync_schaltung_sbe status_waschstr_in status_zug_svh_sbe t_betrieb_pvu_has_ee_in t_betrieb_pvu_has_sbe v_f_sbe vg_f_sbe z_ablauf_has_hst_in z_ablauf_has_stg z_ablaufreinit_frk_dihi z_ablaufvariante_has_hst_in z_ablaufvariante_has_stg z_ba_has_k0_hst_in z_ba_has_vm_hst_in z_diag_ersfkt_has_in z_diag_ersfkt_hi_has_in z_diag_notgang_has_in z_emfehler_frk_dihi z_freigabe_pvu_has_sbe z_fuwdeakt_frk_dihi z_hybfkt_stg z_iep_in z_k0_fst_in z_k0_has_fkt z_k0_has_sbe z_k0syncmk0erh_frk_dihi z_kps_stada_in z_modus_em_hst_in z_modus_iae_has_sbe z_modus_iep_has_sbe z_msa_avh_moni_has_sbe z_msa_eaf_moni_has_sbe z_msa_fst_in z_msa_has_sbe z_msa_stada_in z_n_min_em_parksp_has_in z_n_min_iep_in z_nllsoll_iae_in z_nminemnull_frk_dihi z_nvmsollbegr_frk_dihi z_pvu_has_sbe z_sas_has_sbe z_start_modus_has_sbe z_status_psys_mps_sbe z_svh_has_sbe z_ziel_kraftfluss_egs_in zielgang_egs_in /end LOC_MEASUREMENT
/end FUNCTION
/begin FUNCTION SFOp_ABK58_st_k0_oeffnen_abk ""
 /begin SUB_FUNCTION Run_SFOp_ABK70_cTimer_trigger_ Run_SFOp_ABK69__radient_MSollK0 SFOp_ABK64_Entry /end SUB_FUNCTION
 /begin DEF_CHARACTERISTIC K_SVH_RESET_KOE_ABK MO_K0REGELN_KOE_ABK M_K0MODHAS_ZIEL_LAU_ABK STATUS_ABL_KOE_ABK TAB_MGSOLLK0ABLVAR_KOE_ABK T_MAX_KOE_ABK /end DEF_CHARACTERISTIC
 /begin LOC_MEASUREMENT SFOp_ABK69_out_ SFOp_ABK70_isActive_ m_k0_in m_soll_vm_hst_in m_soll_vm_l_hst_in m_vm_in n_em_in n_soll_em_hst_in nd_k0_in status_k0_in status_sa_vm_in status_schaltart_svh_has_sbe status_schaltung_egs_in t_maxbed_koe_abk z_ablauf_has_hst_in z_ablauf_has_stg z_ablaufvariante_has_stg /end LOC_MEASUREMENT
/end FUNCTION
/begin FUNCTION SFOp_ABK59_st___sen_abbruch_abk "" /begin SUB_FUNCTION Run_SFOp_ABK81_cTimer_trigger_ SFOp_ABK76_Entry /end SUB_FUNCTION /begin DEF_CHARACTERISTIC K_SVH_RESET_KSA_ABK STATUS_ABL_ABBRUCH_AKTIV T_MAX_KSA_ABK /end DEF_CHARACTERISTIC /begin LOC_MEASUREMENT SFOp_ABK81_isActive_ t_maxbed_ksa_abk /end LOC_MEASUREMENT /end FUNCTION
/begin FUNCTION SFOp_ABK60_st____uebernahme_abk ""
 /begin SUB_FUNCTION Run_SFOp_ABK90_cTimer_trigger_ Run_SFOp_ABK92__vzk0oeffnen_abk Run_SFOp_ABK91__t_MK0modhas_abk SFOp_ABK84_Entry /end SUB_FUNCTION
 /begin DEF_CHARACTERISTIC KL_MOSOLLK0MVM_LAU_ABK_X KL_MOSOLLK0MVM_LAU_ABK_Y K_SVH_RESET_LAU_ABK MG_K0MODHAS_LAU_ABK MO_K0MODHASK0OEFFNEN_LAU_ABK MS_VMK0OEFFNEN_LAU_ABK M_K0MODHAS_ZIEL_LAU_ABK STATUS_ABL_LAU_ABK SWI_MSOLLK0BASIS_LAU_ABK T_MAX_LAU_ABK T_VZK0OEFFNEN_LAU_ABK /end DEF_CHARACTERISTIC
 /begin LOC_MEASUREMENT SFOp_ABK90_isActive_ SFOp_ABK91_out_ SFOp_ABK92_isActive_ m_k0_in m_soll_vm_hst_in m_soll_vm_l_hst_in m_vm_in n_em_in n_soll_em_hst_in nd_k0_in status_k0_in status_sa_vm_in status_sa_vm_lau_abk status_schaltart_svh_has_sbe status_schaltung_egs_in t_k0oeffnenbed_lau_abk t_maxbed_lau_abk z_ablauf_has_hst_in z_ablauf_has_stg z_ablaufvariante_has_stg /end LOC_MEASUREMENT
/end FUNCTION
/begin FUNCTION SFOp_ABK61_st___ltung_aktiv_abk ""
 /begin SUB_FUNCTION SFOp_ABK102_ac__aktiv_abk_en_st SFOp_ABK101_ac__ng_aktiv_abk_en /end SUB_FUNCTION
 /begin DEF_CHARACTERISTIC STATUS_ABL_SAK_ABK /end DEF_CHARACTERISTIC
 /begin LOC_MEASUREMENT SFOp_ABK105_isActive_ /end LOC_MEASUREMENT
/end FUNCTION
/begin FUNCTION SFOp_ABK62_st_uebergabe "" /begin SUB_FUNCTION SFOp_ABK108_Entry /end SUB_FUNCTION /begin DEF_CHARACTERISTIC K_SVH_RESET_UEB_ABK /end DEF_CHARACTERISTIC /end FUNCTION
/begin FUNCTION SFOp_ABK63_st___abe_abbruch_abk "" /begin SUB_FUNCTION SFOp_ABK111_Entry /end SUB_FUNCTION /begin DEF_CHARACTERISTIC K_SVH_RESET_UAB_ABK STATUS_ABL_ABBRUCH_FERTIG /end DEF_CHARACTERISTIC /end FUNCTION
/begin FUNCTION SFOp_ABK64_Entry ""
 /begin DEF_CHARACTERISTIC K_SVH_RESET_KOE_ABK M_K0MODHAS_ZIEL_LAU_ABK STATUS_ABL_KOE_ABK /end DEF_CHARACTERISTIC
/end FUNCTION
/begin FUNCTION SFOp_ABK6_Input ""
 /begin LOC_MEASUREMENT abstellpos_vm_in abstellpos_vm_status_in c_getriebe_egs_in c_vm_in gangwechsel_egs_in i_istgang_egs i_zielgang_egs istgang_egs_in m_em_in m_iae_in m_k0_in m_k0_mber_has_sbe m_k0_mod_has_fkt m_max_dyn_em_in m_min_dyn_em_in m_min_vm_in m_mot_in m_motmax_has m_soll_em_hst_in m_soll_k0_has_fkt m_soll_res_em_bas_sbe m_soll_res_em_has_sbe m_soll_vm_hst_in m_soll_vm_l_hst_in m_vm_in m_vm_start_in m_wunsch_fpw_hst_fil m_wunsch_fpw_hst_in m_wunsch_fpw_in mg_wunsch_fpw mg_wunsch_fpw_hst n_ab_egs_in n_em_in n_min_em_has_sbe n_min_psys_em_has_sbe n_mot_soll_iae_in n_sec_iae n_soll_em_hst_in n_soll_ll_vm_in n_t_egs_in n_vm_in nd_iae nd_k0_in ndg_k0_in ng_vm osmode_next_in p_bremse_fzg_in phi_neigung_in pos_egs_in sollgang_egs_in st_OMLID_act_stg st_ist_bz_has_stg st_soll_bz_has_hst st_ziel_bz_has_stg status_alaengs_adaoff_in status_betriebsbereit_hst_in status_efahren_has_sbe status_fehler15_eh_diagin status_fehler_iep_in status_iae_adap_in status_iae_in status_iep_in status_k0_adap_in status_k0_in status_kl15_in status_kolbenpos_k0_in status_kraftfluss_egs_in status_kraftfluss_egs_roh_in status_ll_vm_in status_nem_in status_nreg_em_hst_in status_nvm_in status_posvueb_in status_psys_has_sbe status_sa_vm_in status_schaltart_svh_has_sbe status_schaltung_egs_in status_sync_schaltung_sbe status_waschstr_in status_zug_svh_sbe t_betrieb_pvu_has_ee_in t_betrieb_pvu_has_sbe v_f_sbe vg_f_sbe z_ablauf_has_hst_in z_ablauf_has_stg z_ablaufreinit_frk_dihi z_ablaufvariante_has_hst_in z_ablaufvariante_has_stg z_ba_has_k0_hst_in z_ba_has_vm_hst_in z_diag_ersfkt_has_in z_diag_ersfkt_hi_has_in z_diag_notgang_has_in z_emfehler_frk_dihi z_freigabe_pvu_has_sbe z_fuwdeakt_frk_dihi z_hybfkt_stg z_iep_in z_k0_fst_in z_k0_has_fkt z_k0_has_sbe z_k0syncmk0erh_frk_dihi z_kps_stada_in z_modus_em_hst_in z_modus_iae_has_sbe z_modus_iep_has_sbe z_msa_avh_moni_has_sbe z_msa_eaf_moni_has_sbe z_msa_fst_in z_msa_has_sbe z_msa_stada_in z_n_min_em_parksp_has_in z_n_min_iep_in z_nllsoll_iae_in z_nminemnull_frk_dihi z_nvmsollbegr_frk_dihi z_pvu_has_sbe z_sas_has_sbe z_start_modus_has_sbe z_status_psys_mps_sbe z_svh_has_sbe z_ziel_kraftfluss_egs_in zielgang_egs_in /end LOC_MEASUREMENT
/end FUNCTION
/begin FUNCTION SFOp_ABK76_Entry ""
 /begin DEF_CHARACTERISTIC K_SVH_RESET_KSA_ABK STATUS_ABL_ABBRUCH_AKTIV SWI_ZPHYSK0_KSA_ABK /end DEF_CHARACTERISTIC
/end FUNCTION
/begin FUNCTION SFOp_ABK84_Entry ""
 /begin DEF_CHARACTERISTIC KL_MK0MODINIT_LAU_ABK_X KL_MK0MODINIT_LAU_ABK_Y K_SVH_RESET_LAU_ABK STATUS_ABL_LAU_ABK SWI_K0SREGAKTIV_LAU_ABK SWI_KLMK0MODINIT_LAU_ABK SWI_MK0MODINIT_LAU_ABK SWI_STATUSK0K0SREG_LAU_ABK /end DEF_CHARACTERISTIC
 /begin LOC_MEASUREMENT m_k0_in m_soll_vm_hst_in m_soll_vm_l_hst_in m_vm_in n_em_in n_soll_em_hst_in nd_k0_in status_k0_in status_k0sreg_lau_abk status_sa_vm_in status_sa_vm_lau_abk status_schaltart_svh_has_sbe status_schaltung_egs_in z_ablauf_has_hst_in z_ablauf_has_stg z_ablaufvariante_has_stg /end LOC_MEASUREMENT
/end FUNCTION
/begin FUNCTION SFOp_ABK9_St_Ablauf ""
 /begin SUB_FUNCTION SFOp_ABK63_st___abe_abbruch_abk SFOp_ABK62_st_uebergabe SFOp_ABK61_st___ltung_aktiv_abk SFOp_ABK60_st____uebernahme_abk SFOp_ABK59_st___sen_abbruch_abk SFOp_ABK58_st_k0_oeffnen_abk /end SUB_FUNCTION
/end FUNCTION
/begin FUNCTION SFOp_ABO10_St_Start "" /begin SUB_FUNCTION SFOp_ABO97_Entry /end SUB_FUNCTION /begin LOC_MEASUREMENT m_stoer_k0_em_fil_abo msollresem_stat_abo_mes /end LOC_MEASUREMENT /end FUNCTION
/begin FUNCTION SFOp_ABO52_AndrehenVM_ABO "" /begin SUB_FUNCTION SFOp_ABO56_St_K0_Oeffnen_ABO SFOp_ABO55_St_Andrehen_VM_ABO /end SUB_FUNCTION /begin LOC_MEASUREMENT m_stoer_k0_em_fil_abo msollresem_stat_abo_mes /end LOC_MEASUREMENT /end FUNCTION
/begin FUNCTION SFOp_ABO53_St_Uebergabe "" /begin SUB_FUNCTION SFOp_ABO94_Entry /end SUB_FUNCTION /begin LOC_MEASUREMENT m_stoer_k0_em_fil_abo msollresem_stat_abo_mes /end LOC_MEASUREMENT /end FUNCTION
/begin FUNCTION SFOp_ABO55_St_Andrehen_VM_ABO ""
 /begin SUB_FUNCTION SFOp_ABO69_Vorgaben_LP3 Run_SFOp_ABO65_cTimer_T1MAX_ABO SFOp_ABO57_Entry /end SUB_FUNCTION
 /begin DEF_CHARACTERISTIC K_MSTOERKPL_AND_ABO MS_RESEM_AND_ABO MS_ZMSOLLEMAKTIV_ABO STATUS_ABL_AND_ABO SWI_ZMSOLLEM_ABO T_MAX_AND_ABO /end DEF_CHARACTERISTIC
 /begin LOC_MEASUREMENT SFOp_ABO71_out_ abstellpos_vm_in abstellpos_vm_status_in c_getriebe_egs_in c_vm_in istgang_egs_in m_k0_in m_max_dyn_em_in m_soll_res_em_bas_sbe m_stoer_k0_em_fil_abo msollresem_stat_abo_mes n_em_in n_vm_in nd_k0_in ng_vm status_k0_in status_kolbenpos_k0_in status_kraftfluss_egs_in status_psys_has_sbe status_schaltung_egs_in z_ablauf_has_hst_in z_ablauf_has_stg z_ablaufvariante_has_stg z_svh_has_sbe /end LOC_MEASUREMENT
/end FUNCTION
/begin FUNCTION SFOp_ABO56_St_K0_Oeffnen_ABO ""
 /begin SUB_FUNCTION Run_SFOp_ABO85__x_k0oeffnen_abo Run_SFOp_ABO88__ent_msollk0_abo SFOp_ABO78_Entry /end SUB_FUNCTION
 /begin DEF_CHARACTERISTIC KF_MGSOLLK0CVMABST_KOE_ABO_W KF_MGSOLLK0CVMABST_KOE_ABO_X KF_MGSOLLK0CVMABST_KOE_ABO_Y K_MSTOERKPL_AND_ABO MS_ZMSOLLEMAKTIV_ABO STATUS_ABL_KOE_ABO SWI_ZMSOLLEM_ABO T_MAX_KOE_ABO /end DEF_CHARACTERISTIC
 /begin LOC_MEASUREMENT SFOp_ABO88_out_ abstellpos_vm_in abstellpos_vm_status_in c_getriebe_egs_in c_vm_in istgang_egs_in m_k0_in m_max_dyn_em_in m_soll_res_em_bas_sbe m_stoer_k0_em_fil_abo msollresem_stat_abo_mes n_em_in n_vm_in nd_k0_in ng_vm status_k0_in status_kolbenpos_k0_in status_kraftfluss_egs_in status_psys_has_sbe status_schaltung_egs_in t_maxbed_koe_abo_mes z_ablauf_has_hst_in z_ablauf_has_stg z_ablaufvariante_has_stg z_svh_has_sbe z_t_maxbed_koe_abo /end LOC_MEASUREMENT
/end FUNCTION
/begin FUNCTION SFOp_ABO57_Entry "" /begin DEF_CHARACTERISTIC STATUS_ABL_AND_ABO /end DEF_CHARACTERISTIC
 /begin LOC_MEASUREMENT abstellpos_vm_in abstellpos_vm_status_in c_getriebe_egs_in c_vm_in istgang_egs_in m_k0_in m_max_dyn_em_in m_soll_res_em_bas_sbe m_stoer_k0_em_fil_abo msollresem_stat_abo_mes n_em_in n_vm_in nd_k0_in ng_vm status_k0_in status_kolbenpos_k0_in status_kraftfluss_egs_in status_psys_has_sbe status_schaltung_egs_in z_ablauf_has_hst_in z_ablauf_has_stg z_ablaufvariante_has_stg z_svh_has_sbe /end LOC_MEASUREMENT
/end FUNCTION
/begin FUNCTION SFOp_ABO5_Input ""
 /begin SUB_FUNCTION Run_SFOp_ABO30__toerk0emfil_abo Run_SFOp_ABO29__m_stoer_em_abo1 Run_SFOp_ABO28___m_stoer_em_abo /end SUB_FUNCTION
 /begin DEF_CHARACTERISTIC KF_FFKMSTOERKPL_ABO_W KF_FFKMSTOERKPL_ABO_X KF_FFKMSTOERKPL_ABO_Y KF_FKMSTOERKPL_ABO_W KF_FKMSTOERKPL_ABO_X KF_FKMSTOERKPL_ABO_Y KF_FMOSTOERKPL_ABO_W KF_FMOSTOERKPL_ABO_X KF_FMOSTOERKPL_ABO_Y KF_FMSTOERKPL_ABO_W KF_FMSTOERKPL_ABO_X KF_FMSTOERKPL_ABO_Y KF_FMSTOERND_VMS_ABO_W KF_FMSTOERND_VMS_ABO_X KF_FMSTOERND_VMS_ABO_Y KF_KOLBPOSINITTIMER_ABO_W KF_KOLBPOSINITTIMER_ABO_X KF_KOLBPOSINITTIMER_ABO_Y KF_MOSTOERKPL_ABO_W KF_MOSTOERKPL_ABO_X KF_MOSTOERKPL_ABO_Y KF_TVMSTOERK0EMFIL_ABO_W KF_TVMSTOERK0EMFIL_ABO_X KF_TVMSTOERK0EMFIL_ABO_Y /end DEF_CHARACTERISTIC
 /begin LOC_MEASUREMENT abstellpos_vm_in abstellpos_vm_status_in c_getriebe_egs_in c_vm_in gangwechsel_egs_in i_istgang_egs i_zielgang_egs istgang_egs_in m_em_in m_iae_in m_k0_in m_k0_mber_has_sbe m_k0_mod_has_fkt m_max_dyn_em_in m_min_dyn_em_in m_min_vm_in m_mot_in m_motmax_has m_soll_em_hst_in m_soll_k0_has_fkt m_soll_res_em_bas_sbe m_soll_res_em_has_sbe m_soll_vm_hst_in m_soll_vm_l_hst_in m_stoer_k0_em_fil_abo m_vm_in m_vm_start_in m_wunsch_fpw_hst_fil m_wunsch_fpw_hst_in m_wunsch_fpw_in mg_wunsch_fpw mg_wunsch_fpw_hst msollresem_stat_abo_mes n_ab_egs_in n_em_in n_min_em_has_sbe n_min_psys_em_has_sbe n_mot_soll_iae_in n_sec_iae n_soll_em_hst_in n_soll_ll_vm_in n_t_egs_in n_vm_in nd_iae nd_k0_in ndg_k0_in ng_vm osmode_next_in p_bremse_fzg_in phi_neigung_in pos_egs_in sollgang_egs_in st_OMLID_act_stg st_ist_bz_has_stg st_soll_bz_has_hst st_ziel_bz_has_stg status_alaengs_adaoff_in status_betriebsbereit_hst_in status_efahren_has_sbe status_fehler15_eh_diagin status_fehler_iep_in status_iae_adap_in status_iae_in status_iep_in status_k0_adap_in status_k0_in status_kl15_in status_kolbenpos_k0_in status_kraftfluss_egs_in status_kraftfluss_egs_roh_in status_ll_vm_in status_nem_in status_nreg_em_hst_in status_nvm_in status_posvueb_in status_psys_has_sbe status_sa_vm_in status_schaltart_svh_has_sbe status_schaltung_egs_in status_sync_schaltung_sbe status_waschstr_in status_zug_svh_sbe t_betrieb_pvu_has_ee_in t_betrieb_pvu_has_sbe t_mstoerk0emfil_abo v_f_sbe vg_f_sbe z_ablauf_has_hst_in z_ablauf_has_stg z_ablaufreinit_frk_dihi z_ablaufvariante_has_hst_in z_ablaufvariante_has_stg z_ba_has_k0_hst_in z_ba_has_vm_hst_in z_diag_ersfkt_has_in z_diag_ersfkt_hi_has_in z_diag_notgang_has_in z_emfehler_frk_dihi z_freigabe_pvu_has_sbe z_fuwdeakt_frk_dihi z_hybfkt_stg z_iep_in z_k0_fst_in z_k0_has_fkt z_k0_has_sbe z_k0syncmk0erh_frk_dihi z_kps_stada_in z_modus_em_hst_in z_modus_iae_has_sbe z_modus_iep_has_sbe z_msa_avh_moni_has_sbe z_msa_eaf_moni_has_sbe z_msa_fst_in z_msa_has_sbe z_msa_stada_in z_n_min_em_parksp_has_in z_n_min_iep_in z_nllsoll_iae_in z_nminemnull_frk_dihi z_nvmsollbegr_frk_dihi z_pvu_has_sbe z_sas_has_sbe z_start_modus_has_sbe z_status_psys_mps_sbe z_svh_has_sbe z_ziel_kraftfluss_egs_in zielgang_egs_in /end LOC_MEASUREMENT
/end FUNCTION
/begin FUNCTION SFOp_ABO69_Vorgaben_LP3 ""
 /begin SUB_FUNCTION Run_SFOp_ABO72__0startrampe_abo Run_SFOp_ABO71__ent_msollk0_kon /end SUB_FUNCTION
 /begin DEF_CHARACTERISTIC KF_MGZIELK0RAMPCVMABST_AND_ABO_W KF_MGZIELK0RAMPCVMABST_AND_ABO_X KF_MGZIELK0RAMPCVMABST_AND_ABO_Y KF_MZIELK0RAMPCVMABST_AND_ABO_W KF_MZIELK0RAMPCVMABST_AND_ABO_X KF_MZIELK0RAMPCVMABST_AND_ABO_Y KF_MZIELK0STATCVMABST_AND_ABO_W KF_MZIELK0STATCVMABST_AND_ABO_X KF_MZIELK0STATCVMABST_AND_ABO_Y KOLBENP_MOMRAMPE_AKT_AND_ABO T_MK0STARTRAMPE_AND_ABO /end DEF_CHARACTERISTIC
 /begin LOC_MEASUREMENT SFOp_ABO71_out_ abstellpos_vm_in c_vm_in status_kolbenpos_k0_in /end LOC_MEASUREMENT
/end FUNCTION
/begin FUNCTION SFOp_ABO78_Entry "" /begin DEF_CHARACTERISTIC STATUS_ABL_KOE_ABO /end DEF_CHARACTERISTIC /end FUNCTION
/begin FUNCTION SFOp_ABO7_Output "" /begin SUB_FUNCTION Run_SFOp_ABO49__sollemaktiv_ans /end SUB_FUNCTION
 /begin DEF_CHARACTERISTIC KL_MSSOLLEMAKTIVSTKRAFTFL_ABO_X KL_MSSOLLEMAKTIVSTKRAFTFL_ABO_Y KL_MSSOLLEMAKTIV_ABO_X KL_MSSOLLEMAKTIV_ABO_Y T_MSOLLEMAKTIV_ABO /end DEF_CHARACTERISTIC
 /begin LOC_MEASUREMENT abstellpos_vm_in abstellpos_vm_status_in c_getriebe_egs_in c_vm_in istgang_egs_in m_k0_in m_max_dyn_em_in m_soll_res_em_bas_sbe m_stoer_k0_em_fil_abo msollresem_stat_abo_mes n_em_in n_vm_in nd_k0_in ng_vm status_k0_in status_kolbenpos_k0_in status_kraftfluss_egs_in status_psys_has_sbe status_schaltung_egs_in t_msollemaktiv_abo_mes z_ablauf_has_hst_in z_ablauf_has_stg z_ablaufvariante_has_stg z_svh_has_sbe z_t_msollemaktiv_abo /end LOC_MEASUREMENT
/end FUNCTION
/begin FUNCTION SFOp_ABO94_Entry ""
 /begin LOC_MEASUREMENT abstellpos_vm_in abstellpos_vm_status_in c_getriebe_egs_in c_vm_in istgang_egs_in m_k0_in m_max_dyn_em_in m_soll_res_em_bas_sbe m_stoer_k0_em_fil_abo msollresem_stat_abo_mes n_em_in n_vm_in nd_k0_in ng_vm status_k0_in status_kolbenpos_k0_in status_kraftfluss_egs_in status_psys_has_sbe status_schaltung_egs_in z_ablauf_has_hst_in z_ablauf_has_stg z_ablaufvariante_has_stg z_svh_has_sbe /end LOC_MEASUREMENT
/end FUNCTION
/begin FUNCTION SFOp_ABO97_Entry "" /begin DEF_CHARACTERISTIC MS_RESEM_SRT_ABO SWI_ZPHYSK0_SRT_ABO /end DEF_CHARACTERISTIC
 /begin LOC_MEASUREMENT abstellpos_vm_in abstellpos_vm_status_in c_getriebe_egs_in c_vm_in istgang_egs_in m_k0_in m_max_dyn_em_in m_soll_res_em_bas_sbe m_stoer_k0_em_fil_abo msollresem_stat_abo_mes n_em_in n_vm_in nd_k0_in ng_vm status_k0_in status_kolbenpos_k0_in status_kraftfluss_egs_in status_psys_has_sbe status_schaltung_egs_in z_ablauf_has_hst_in z_ablauf_has_stg z_ablaufvariante_has_stg z_svh_has_sbe /end LOC_MEASUREMENT
/end FUNCTION
/begin FUNCTION SFOp_ABO9_St_Ablauf "" /begin SUB_FUNCTION SFOp_ABO53_St_Uebergabe SFOp_ABO52_AndrehenVM_ABO /end SUB_FUNCTION /begin LOC_MEASUREMENT m_stoer_k0_em_fil_abo msollresem_stat_abo_mes /end LOC_MEASUREMENT /end FUNCTION
/begin FUNCTION SFOp_ABST104_a__stellen_abst_en "" /begin DEF_CHARACTERISTIC M_K0MODHAS_ZIEL_LAU_ABST /end DEF_CHARACTERISTIC /end FUNCTION
/begin FUNCTION SFOp_ABST10_st_start "" /begin SUB_FUNCTION SFOp_ABST168_Entry /end SUB_FUNCTION /begin DEF_CHARACTERISTIC STATUS_ABL_SRT_ABST /end DEF_CHARACTERISTIC /end FUNCTION
/begin FUNCTION SFOp_ABST116_a__oeffnen_abst_en ""
 /begin DEF_CHARACTERISTIC M_K0MODHAS_ZIEL_LAU_ABST STATUS_ABL_AST_ABST STATUS_ABL_KOE_ABST /end DEF_CHARACTERISTIC
/end FUNCTION
/begin FUNCTION SFOp_ABST128_a__abbruch_abst_en "" /begin DEF_CHARACTERISTIC STATUS_ABL_ABBRUCH_AKTIV SWI_ZPHYSK0_KSA_ABST /end DEF_CHARACTERISTIC /end FUNCTION
/begin FUNCTION SFOp_ABST136_a__ernahme_abst_en ""
 /begin DEF_CHARACTERISTIC KL_MK0MODINIT_LAU_ABST_X KL_MK0MODINIT_LAU_ABST_Y K_SVH_RESET_LAU_ABST MO_SOLLK0BEGRK0SREG_LAU_ABST STATUS_ABL_AST_ABST STATUS_ABL_LAU_ABST SWI_K0SREGAKTIV_LAU_ABST SWI_KLMK0MODINIT_LAU_ABST SWI_MK0MODINIT_LAU_ABST SWI_STATUSABL_SAVM_LAU_ABST SWI_STATUSK0K0SREG_LAU_ABST SWI_ZK0REGELN_LAU_ABST /end DEF_CHARACTERISTIC
 /begin LOC_MEASUREMENT c_getriebe_egs_in c_vm_in m_em_in m_k0_in m_max_dyn_em_in m_min_vm_in m_mot_in m_soll_em_hst_in m_soll_vm_hst_in m_soll_vm_l_hst_in m_sollk0begrk0sreg_lau_abst m_vm_in m_wunsch_fpw_in n_em_in n_min_em_has_sbe n_min_psys_em_has_sbe n_soll_em_hst_in n_vm_in nd_k0_in ng_vm status_k0_in status_k0sreg_lau_abst status_kraftfluss_egs_in status_sa_vm_in status_sa_vm_lau_abst status_schaltart_svh_has_sbe status_schaltung_egs_in z_ablauf_has_hst_in z_ablauf_has_stg z_ablaufvariante_has_stg z_modus_em_hst_in /end LOC_MEASUREMENT
/end FUNCTION
/begin FUNCTION SFOp_ABST137_a__ahme_abst_en_st ""
 /begin SUB_FUNCTION Run_SFOp_ABST1__cTimer_trigge_a SFOp_ABST141_Ansteuervariante_2 SFOp_ABST140_Ansteuervariante_1 /end SUB_FUNCTION
 /begin DEF_CHARACTERISTIC T_MAX_LAU_ABST /end DEF_CHARACTERISTIC
 /begin LOC_MEASUREMENT c_getriebe_egs_in c_vm_in m_em_in m_k0_in m_max_dyn_em_in m_min_vm_in m_mot_in m_soll_em_hst_in m_soll_vm_hst_in m_soll_vm_l_hst_in m_sollk0begrk0sreg_lau_abst m_vm_in m_wunsch_fpw_in n_em_in n_min_em_has_sbe n_min_psys_em_has_sbe n_soll_em_hst_in n_vm_in nd_k0_in ng_vm status_k0_in status_kraftfluss_egs_in status_sa_vm_in status_sa_vm_lau_abst status_schaltart_svh_has_sbe status_schaltung_egs_in t_maxbed_lau_abst z_ablauf_has_hst_in z_ablauf_has_stg z_ablaufvariante_has_stg z_modus_em_hst_in z_t_maxbed_lau_abst /end LOC_MEASUREMENT
/end FUNCTION
/begin FUNCTION SFOp_ABST140_Ansteuervariante_1 "" /begin DEF_CHARACTERISTIC SWI_ZK0REGELN_LAU_ABST /end DEF_CHARACTERISTIC /end FUNCTION
/begin FUNCTION SFOp_ABST141_Ansteuervariante_2 ""
 /begin SUB_FUNCTION Run_SFOp_ABST1__cTimer_trigger_ Run_SFOp_ABST1__dient_MK0modhas /end SUB_FUNCTION
 /begin DEF_CHARACTERISTIC KL_MOSOLLK0MVM_LAU_ABST_X KL_MOSOLLK0MVM_LAU_ABST_Y MDS_MOTBREMSREKU_LAU_ABST MG_K0MODHASSAREKU_LAU_ABST MG_K0MODHASSA_LAU_ABST MG_K0MODHAS_LAU_ABST MO_K0MODHASK0OEFFNEN_LAU_ABST MS_VMK0OEFFNEN_LAU_ABST M_K0MODHAS_ZIEL_LAU_ABST NS_MINEMGABBED_LAU_ABST NS_MINPSYSEMGABBED_LAU_ABST SWI_MSOLLK0BASIS_LAU_ABST T_VK0OEFFNEN_LAU_ABST Z_ABLAUFVARIANTE_GEFABST_ABST /end DEF_CHARACTERISTIC
 /begin LOC_MEASUREMENT t_k0oeffnenbed_lau_abst /end LOC_MEASUREMENT
/end FUNCTION
/begin FUNCTION SFOp_ABST153_a__g_aktiv_abst_en "" /begin DEF_CHARACTERISTIC STATUS_ABL_SAK_ABST /end DEF_CHARACTERISTIC /end FUNCTION
/begin FUNCTION SFOp_ABST154_a__ktiv_abst_en_st "" /begin SUB_FUNCTION Run_SFOp_ABST1__cTimer_trigge_b /end SUB_FUNCTION /begin DEF_CHARACTERISTIC K_SVH_RESET_SAK_ABST M_K0MODMIN_SAK_ABST T_MAX_SAK_ABST /end DEF_CHARACTERISTIC
 /begin LOC_MEASUREMENT m_k0_in status_schaltung_egs_in t_maxbed_sak_abst z_t_maxbed_sak_abst /end LOC_MEASUREMENT
/end FUNCTION
/begin FUNCTION SFOp_ABST164_a__abbruch_abst_en "" /begin DEF_CHARACTERISTIC STATUS_ABL_ABBRUCH_FERTIG SWI_ZPHYSK0_UAB_ABST /end DEF_CHARACTERISTIC /end FUNCTION
/begin FUNCTION SFOp_ABST168_Entry ""
 /begin DEF_CHARACTERISTIC K_SVH_RESET_SRT_ABST M_K0MODMIN_SRT_ABST STATUS_ABL_SRT_ABST /end DEF_CHARACTERISTIC
 /begin LOC_MEASUREMENT m_k0_in status_schaltung_egs_in /end LOC_MEASUREMENT
/end FUNCTION
/begin FUNCTION SFOp_ABST24_Var_2 "" /begin DEF_CHARACTERISTIC MO_K0OEFFNENBED_LAU_ABST MS_K0OEFFNENBED_LAU_ABST /end DEF_CHARACTERISTIC /end FUNCTION
/begin FUNCTION SFOp_ABST26_Var_2 "" /begin DEF_CHARACTERISTIC MO_K0OEFFNENBED_LAU_ABST MS_K0OEFFNENBED_LAU_ABST /end DEF_CHARACTERISTIC /end FUNCTION
/begin FUNCTION SFOp_ABST27_Bitwise_AND_ui8_ "" /begin DEF_CHARACTERISTIC K_SVH_RESET_LAU_ABST /end DEF_CHARACTERISTIC /end FUNCTION
/begin FUNCTION SFOp_ABST2_FOp_ABS ""
 /begin SUB_FUNCTION SFOp_ABST10_st_start SFOp_ABST9_st_ablauf SFOp_ABST6_Input SFOp_ABST27_Bitwise_AND_ui8_ SFOp_ABST26_Var_2 SFOp_ABST24_Var_2 /end SUB_FUNCTION
 /begin DEF_CHARACTERISTIC KF_NSEMBED_GAB_ABST_W KF_NSEMBED_GAB_ABST_X KF_NSEMBED_GAB_ABST_Y K_SVH_RESET_LAU_ABST MO_VMK0ZUBED_KSA_ABST MS_K0BED_AST_ABST MS_K0VMABSTBED_KOE_ABST NDS_K0VMABSTBED_KOE_ABST NS_EMMINBED_KOE_ABST NS_EMMINBED_LAU_ABST NS_EMMINBED_SAK_ABST NS_MINEMGABBED_LAU_ABST NS_MINPSYSEMGABBED_LAU_ABST NS_VMAUSBED_AST_ABST SWI_ABBRUCH_AKTIV_ABST Z_ABLAUFVARIANTE_GEFABST_ABST Z_ABLAUFVARIANTE_K0SOEF_ABST /end DEF_CHARACTERISTIC
 /begin LOC_MEASUREMENT SFOp_ABST12_KF_NSEMBED_GAB_ABST abstellpos_vm_in abstellpos_vm_status_in c_getriebe_egs_in c_vm_in gangwechsel_egs_in i_istgang_egs i_zielgang_egs istgang_egs_in m_em_in m_iae_in m_k0_in m_k0_mber_has_sbe m_k0_mod_has_fkt m_max_dyn_em_in m_min_dyn_em_in m_min_vm_in m_mot_in m_motmax_has m_soll_em_hst_in m_soll_k0_has_fkt m_soll_res_em_bas_sbe m_soll_res_em_has_sbe m_soll_vm_hst_in m_soll_vm_l_hst_in m_vm_in m_vm_start_in m_wunsch_fpw_hst_fil m_wunsch_fpw_hst_in m_wunsch_fpw_in mg_wunsch_fpw mg_wunsch_fpw_hst n_ab_egs_in n_em_in n_min_em_has_sbe n_min_psys_em_has_sbe n_mot_soll_iae_in n_sec_iae n_soll_em_hst_in n_soll_ll_vm_in n_t_egs_in n_vm_in nd_iae nd_k0_in ndg_k0_in ng_vm osmode_next_in p_bremse_fzg_in phi_neigung_in pos_egs_in sollgang_egs_in st_OMLID_act_stg st_ist_bz_has_stg st_soll_bz_has_hst st_ziel_bz_has_stg status_alaengs_adaoff_in status_betriebsbereit_hst_in status_efahren_has_sbe status_fehler15_eh_diagin status_fehler_iep_in status_iae_adap_in status_iae_in status_iep_in status_k0_adap_in status_k0_in status_kl15_in status_kolbenpos_k0_in status_kraftfluss_egs_in status_kraftfluss_egs_roh_in status_ll_vm_in status_nem_in status_nreg_em_hst_in status_nvm_in status_posvueb_in status_psys_has_sbe status_sa_vm_in status_schaltart_svh_has_sbe status_schaltung_egs_in status_sync_schaltung_sbe status_waschstr_in status_zug_svh_sbe t_betrieb_pvu_has_ee_in t_betrieb_pvu_has_sbe v_f_sbe vg_f_sbe z_ablauf_has_hst_in z_ablauf_has_stg z_ablaufreinit_frk_dihi z_ablaufvariante_has_hst_in z_ablaufvariante_has_stg z_ba_has_k0_hst_in z_ba_has_vm_hst_in z_diag_ersfkt_has_in z_diag_ersfkt_hi_has_in z_diag_notgang_has_in z_emfehler_frk_dihi z_freigabe_pvu_has_sbe z_fuwdeakt_frk_dihi z_gefabstbed_lau_abst z_hybfkt_stg z_iep_in z_k0_fst_in z_k0_has_fkt z_k0_has_sbe z_k0syncmk0erh_frk_dihi z_kps_stada_in z_modus_em_hst_in z_modus_iae_has_sbe z_modus_iep_has_sbe z_msa_avh_moni_has_sbe z_msa_eaf_moni_has_sbe z_msa_fst_in z_msa_has_sbe z_msa_stada_in z_n_min_em_parksp_has_in z_n_min_iep_in z_nllsoll_iae_in z_nminemnull_frk_dihi z_nvmsollbegr_frk_dihi z_pvu_has_sbe z_sas_has_sbe z_start_modus_has_sbe z_status_psys_mps_sbe z_svh_has_sbe z_ziel_kraftfluss_egs_in zielgang_egs_in /end LOC_MEASUREMENT
/end FUNCTION
/begin FUNCTION SFOp_ABST6_Input ""
 /begin LOC_MEASUREMENT abstellpos_vm_in abstellpos_vm_status_in c_getriebe_egs_in c_vm_in gangwechsel_egs_in i_istgang_egs i_zielgang_egs istgang_egs_in m_em_in m_iae_in m_k0_in m_k0_mber_has_sbe m_k0_mod_has_fkt m_max_dyn_em_in m_min_dyn_em_in m_min_vm_in m_mot_in m_motmax_has m_soll_em_hst_in m_soll_k0_has_fkt m_soll_res_em_bas_sbe m_soll_res_em_has_sbe m_soll_vm_hst_in m_soll_vm_l_hst_in m_vm_in m_vm_start_in m_wunsch_fpw_hst_fil m_wunsch_fpw_hst_in m_wunsch_fpw_in mg_wunsch_fpw mg_wunsch_fpw_hst n_ab_egs_in n_em_in n_min_em_has_sbe n_min_psys_em_has_sbe n_mot_soll_iae_in n_sec_iae n_soll_em_hst_in n_soll_ll_vm_in n_t_egs_in n_vm_in nd_iae nd_k0_in ndg_k0_in ng_vm osmode_next_in p_bremse_fzg_in phi_neigung_in pos_egs_in sollgang_egs_in st_OMLID_act_stg st_ist_bz_has_stg st_soll_bz_has_hst st_ziel_bz_has_stg status_alaengs_adaoff_in status_betriebsbereit_hst_in status_efahren_has_sbe status_fehler15_eh_diagin status_fehler_iep_in status_iae_adap_in status_iae_in status_iep_in status_k0_adap_in status_k0_in status_kl15_in status_kolbenpos_k0_in status_kraftfluss_egs_in status_kraftfluss_egs_roh_in status_ll_vm_in status_nem_in status_nreg_em_hst_in status_nvm_in status_posvueb_in status_psys_has_sbe status_sa_vm_in status_schaltart_svh_has_sbe status_schaltung_egs_in status_sync_schaltung_sbe status_waschstr_in status_zug_svh_sbe t_betrieb_pvu_has_ee_in t_betrieb_pvu_has_sbe v_f_sbe vg_f_sbe z_ablauf_has_hst_in z_ablauf_has_stg z_ablaufreinit_frk_dihi z_ablaufvariante_has_hst_in z_ablaufvariante_has_stg z_ba_has_k0_hst_in z_ba_has_vm_hst_in z_diag_ersfkt_has_in z_diag_ersfkt_hi_has_in z_diag_notgang_has_in z_emfehler_frk_dihi z_freigabe_pvu_has_sbe z_fuwdeakt_frk_dihi z_hybfkt_stg z_iep_in z_k0_fst_in z_k0_has_fkt z_k0_has_sbe z_k0syncmk0erh_frk_dihi z_kps_stada_in z_modus_em_hst_in z_modus_iae_has_sbe z_modus_iep_has_sbe z_msa_avh_moni_has_sbe z_msa_eaf_moni_has_sbe z_msa_fst_in z_msa_has_sbe z_msa_stada_in z_n_min_em_parksp_has_in z_n_min_iep_in z_nllsoll_iae_in z_nminemnull_frk_dihi z_nvmsollbegr_frk_dihi z_pvu_has_sbe z_sas_has_sbe z_start_modus_has_sbe z_status_psys_mps_sbe z_svh_has_sbe z_ziel_kraftfluss_egs_in zielgang_egs_in /end LOC_MEASUREMENT
/end FUNCTION
/begin FUNCTION SFOp_ABST81_st_abstellen_abst ""
 /begin SUB_FUNCTION Run_SFOp_ABST9__svmvmabst_abst_ Run_SFOp_ABST95_cTimer_VM_aus_ Run_SFOp_ABST94_CL_PT1_ SFOp_ABST90_ac__stellen_abst_en /end SUB_FUNCTION
 /begin DEF_CHARACTERISTIC FK_NGVM_AST_ABST K_SVH_RESET_AST_ABST NGS_VMK0OEFFNEN_AST_ABST NS_VMK0OEFFNEN_AST_ABST T_NGSVMK0OEFFNEN_AST_ABST /end DEF_CHARACTERISTIC
 /begin LOC_MEASUREMENT c_getriebe_egs_in c_vm_in m_em_in m_k0_in m_max_dyn_em_in m_min_vm_in m_mot_in m_soll_em_hst_in m_soll_vm_hst_in m_soll_vm_l_hst_in m_vm_in m_wunsch_fpw_in n_em_in n_min_em_has_sbe n_min_psys_em_has_sbe n_soll_em_hst_in n_vm_in nd_k0_in ng_vm ng_vm_gef_ast_abst status_k0_in status_kraftfluss_egs_in status_sa_vm_in status_schaltart_svh_has_sbe status_schaltung_egs_in t_maxbed_ast_abst t_ngsvm_ast_abst z_ablauf_has_hst_in z_ablauf_has_stg z_ablaufvariante_has_stg z_modus_em_hst_in z_t_maxbed_ast_abst /end LOC_MEASUREMENT
/end FUNCTION
/begin FUNCTION SFOp_ABST82_st___abstellen_abst ""
 /begin SUB_FUNCTION Run_SFOp_ABST1__er_VM_abstellen Run_SFOp_ABST1__radient_MSollK0 SFOp_ABST104_a__stellen_abst_en /end SUB_FUNCTION
 /begin DEF_CHARACTERISTIC KL_MSOLLK0ZIEL_GAB_ABST_X KL_MSOLLK0ZIEL_GAB_ABST_Y MG_SOLLK0NEG_GAB_ABST MG_SOLLK0POS_GAB_ABST MO_K0REGELN_GAB_ABST M_K0MODHAS_ZIEL_LAU_ABST STATUS_ABL_GAB_ABST SWI_ZK0REGELN_LAU_ABST T_MAX_GAB_ABST /end DEF_CHARACTERISTIC
 /begin LOC_MEASUREMENT SFOp_ABST108_out_ c_getriebe_egs_in c_vm_in m_em_in m_k0_in m_max_dyn_em_in m_min_vm_in m_mot_in m_soll_em_hst_in m_soll_vm_hst_in m_soll_vm_l_hst_in m_vm_in m_wunsch_fpw_in n_em_in n_min_em_has_sbe n_min_psys_em_has_sbe n_soll_em_hst_in n_vm_in nd_k0_in ng_vm status_k0_in status_kraftfluss_egs_in status_sa_vm_in status_schaltart_svh_has_sbe status_schaltung_egs_in t_maxbed_gab_abst z_ablauf_has_hst_in z_ablauf_has_stg z_ablaufvariante_has_stg z_modus_em_hst_in z_t_maxbed_gab_abst /end LOC_MEASUREMENT
/end FUNCTION
/begin FUNCTION SFOp_ABST83_st_k0_oeffnen_abst ""
 /begin SUB_FUNCTION Run_SFOp_ABST1__er_VM_abstell_a Run_SFOp_ABST1__radient_MSoll_a SFOp_ABST116_a__oeffnen_abst_en /end SUB_FUNCTION
 /begin DEF_CHARACTERISTIC MO_K0REGELN_KOE_ABST M_K0MODHAS_ZIEL_LAU_ABST SWI_ZK0REGELN_LAU_ABST TAB_MGSOLLK0ABLVAR_KOE_ABST T_MAX_KOE_ABST /end DEF_CHARACTERISTIC
 /begin LOC_MEASUREMENT SFOp_ABST120_out_ c_getriebe_egs_in c_vm_in m_em_in m_k0_in m_max_dyn_em_in m_min_vm_in m_mot_in m_soll_em_hst_in m_soll_vm_hst_in m_soll_vm_l_hst_in m_vm_in m_wunsch_fpw_in n_em_in n_min_em_has_sbe n_min_psys_em_has_sbe n_soll_em_hst_in n_vm_in nd_k0_in ng_vm status_k0_in status_kraftfluss_egs_in status_sa_vm_in status_schaltart_svh_has_sbe status_schaltung_egs_in t_maxbed_koe_abst z_ablauf_has_hst_in z_ablauf_has_stg z_ablaufvariante_has_stg z_modus_em_hst_in z_t_maxbed_koe_abst /end LOC_MEASUREMENT
/end FUNCTION
/begin FUNCTION SFOp_ABST84_st__en_abbruch_abst ""
 /begin SUB_FUNCTION Run_SFOp_ABST1__iessen_Abbruch_ SFOp_ABST128_a__abbruch_abst_en /end SUB_FUNCTION
 /begin DEF_CHARACTERISTIC STATUS_ABL_ABBRUCH_AKTIV T_MAX_KSA_ABST /end DEF_CHARACTERISTIC
 /begin LOC_MEASUREMENT t_maxbed_ksa_abst z_t_maxbed_ksa_abst /end LOC_MEASUREMENT
/end FUNCTION
/begin FUNCTION SFOp_ABST85_st__uebernahme_abst ""
 /begin SUB_FUNCTION SFOp_ABST137_a__ahme_abst_en_st SFOp_ABST136_a__ernahme_abst_en /end SUB_FUNCTION
 /begin DEF_CHARACTERISTIC K_SVH_RESET_LAU_ABST /end DEF_CHARACTERISTIC
 /begin LOC_MEASUREMENT z_t_maxbed_lau_abst /end LOC_MEASUREMENT
/end FUNCTION
/begin FUNCTION SFOp_ABST86_st__tung_aktiv_abst ""
 /begin SUB_FUNCTION SFOp_ABST154_a__ktiv_abst_en_st SFOp_ABST153_a__g_aktiv_abst_en /end SUB_FUNCTION
 /begin DEF_CHARACTERISTIC STATUS_ABL_SAK_ABST /end DEF_CHARACTERISTIC
 /begin LOC_MEASUREMENT z_t_maxbed_sak_abst /end LOC_MEASUREMENT
/end FUNCTION
/begin FUNCTION SFOp_ABST88_st__be_abbruch_abst "" /begin SUB_FUNCTION SFOp_ABST164_a__abbruch_abst_en /end SUB_FUNCTION /begin DEF_CHARACTERISTIC STATUS_ABL_ABBRUCH_FERTIG /end DEF_CHARACTERISTIC /end FUNCTION
/begin FUNCTION SFOp_ABST90_ac__stellen_abst_en ""
 /begin DEF_CHARACTERISTIC K_SVH_RESET_AST_ABST STATUS_ABL_AST_ABST STATUS_ABL_GEFABST_AST_ABST SWI_K0ANSTEUERUNG_AST_ABST T_MAX_AST_ABST T_MAX_GEFABST_AST_ABST /end DEF_CHARACTERISTIC
 /begin LOC_MEASUREMENT c_getriebe_egs_in c_vm_in m_em_in m_k0_in m_max_dyn_em_in m_min_vm_in m_mot_in m_soll_em_hst_in m_soll_vm_hst_in m_soll_vm_l_hst_in m_vm_in m_wunsch_fpw_in n_em_in n_min_em_has_sbe n_min_psys_em_has_sbe n_soll_em_hst_in n_vm_in nd_k0_in ng_vm status_k0_in status_kraftfluss_egs_in status_sa_vm_in status_schaltart_svh_has_sbe status_schaltung_egs_in z_ablauf_has_hst_in z_ablauf_has_stg z_ablaufvariante_has_stg z_modus_em_hst_in /end LOC_MEASUREMENT
/end FUNCTION
/begin FUNCTION SFOp_ABST9_st_ablauf ""
 /begin SUB_FUNCTION SFOp_ABST88_st__be_abbruch_abst SFOp_ABST86_st__tung_aktiv_abst SFOp_ABST85_st__uebernahme_abst SFOp_ABST84_st__en_abbruch_abst SFOp_ABST83_st_k0_oeffnen_abst SFOp_ABST82_st___abstellen_abst SFOp_ABST81_st_abstellen_abst /end SUB_FUNCTION
/end FUNCTION
/begin FUNCTION SFOp_ANK10_St_Start "" /begin SUB_FUNCTION SFOp_ANK208_Entry /end SUB_FUNCTION /end FUNCTION
/begin FUNCTION SFOp_ANK121_Entry "" /begin DEF_CHARACTERISTIC K_SVH_RESET_SYN_ANK STATUS_ABL_SYN_ANK /end DEF_CHARACTERISTIC /end FUNCTION
/begin FUNCTION SFOp_ANK136_Bitwise_AND_ui8_ "" /begin DEF_CHARACTERISTIC SWI_K0SREGBASIS_SYN_ANK /end DEF_CHARACTERISTIC /end FUNCTION
/begin FUNCTION SFOp_ANK138_Bitwise_AND_ui8_ "" /begin DEF_CHARACTERISTIC SWI_K0SREGBASIS_SYN_ANK /end DEF_CHARACTERISTIC /end FUNCTION
/begin FUNCTION SFOp_ANK139_Bitwise_AND_ui8_ "" /begin DEF_CHARACTERISTIC SWI_K0SREGBASIS_SYN_ANK /end DEF_CHARACTERISTIC /end FUNCTION
/begin FUNCTION SFOp_ANK140_Bitwise_AND_ui8_ "" /begin DEF_CHARACTERISTIC SWI_K0SREGBASIS_SYN_ANK /end DEF_CHARACTERISTIC /end FUNCTION
/begin FUNCTION SFOp_ANK179_Entry "" /begin DEF_CHARACTERISTIC K_SVH_RESET_KON_ANK STATUS_ABL_KON_ANK SWI_ZMODUSVMN_ANK /end DEF_CHARACTERISTIC /end FUNCTION
/begin FUNCTION SFOp_ANK190_Entry ""
 /begin DEF_CHARACTERISTIC STATUS_ABL_SAK_ANK SWI_ZMODUSVMN_ANK SWI_ZMODUSVMN_SAK_ANK SWI_ZPHYSK0_SAK_ANK /end DEF_CHARACTERISTIC
/end FUNCTION
/begin FUNCTION SFOp_ANK191_Entry_Static "" /begin SUB_FUNCTION Run_SFOp_ANK197_cTimer_trigger_ /end SUB_FUNCTION
 /begin DEF_CHARACTERISTIC KF_NOEMNSOLLVM_SAK_ANK_W KF_NOEMNSOLLVM_SAK_ANK_X KF_NOEMNSOLLVM_SAK_ANK_Y KL_MSOLLK0BEF_SAK_ANK_X KL_MSOLLK0BEF_SAK_ANK_Y K_MZIELNOEMSOLLVM_SAK_ANK K_NOEMNSOLLVMOKS_KON_ANK K_SVH_RESET_SAK_ANK N_MINEMNSOLLVM_KON_ANK SWI_MK0MODBEGR_SAK_ANK SWI_ZMODUSVMN_ANK T_MAX_SAK_ANK Z_ABLAUF_ABBRUCH_ANK /end DEF_CHARACTERISTIC
 /begin LOC_MEASUREMENT SFOp_ANK195_KF__NSOLLVM_SAK_ANK SFOp_ANK196_KL__LLK0BEF_SAK_ANK SFOp_ANK197_isActive_ gangwechsel_egs_in i_istgang_egs i_zielgang_egs m_k0_in m_k0_mod_has_fkt m_max_dyn_em_in m_soll_k0_has_fkt m_soll_vm_hst_in m_soll_vm_l_hst_in m_vm_in m_wunsch_fpw_hst_in m_wunsch_fpw_in mg_wunsch_fpw_hst n_ab_egs_in n_em_in n_sec_iae_ist_ank n_sec_iae_ziel_ank n_soll_em_hst_in n_soll_ll_vm_in n_vm_in nd_k0_in ndg_k0_in ng_em_ank ng_vm status_iae_in status_k0_in status_kraftfluss_egs_in status_nreg_em_hst_in status_psys_has_sbe status_schaltart_svh_has_sbe status_schaltung_egs_in status_sync_schaltung_sbe t_maxbed_sak_ank z_ablauf_has_hst_in z_ablauf_has_stg z_ablaufvariante_has_stg z_k0_fst_in z_k0_has_fkt z_k0syncmk0erh_frk_dihi /end LOC_MEASUREMENT
/end FUNCTION
/begin FUNCTION SFOp_ANK200_Entry "" /begin DEF_CHARACTERISTIC SWI_ZPHYSK0_UEB_ANK /end DEF_CHARACTERISTIC /end FUNCTION
/begin FUNCTION SFOp_ANK203_Entry "" /begin DEF_CHARACTERISTIC STATUS_ABL_ABBRUCH_FERTIG SWI_ZPHYSK0_SRT_ANK /end DEF_CHARACTERISTIC /end FUNCTION
/begin FUNCTION SFOp_ANK208_Entry ""
 /begin DEF_CHARACTERISTIC K_SVH_RESET_SRT_ANK STATUS_ABL_ABBRFKT_SRT_ANK SWI_ZPHYSK0_SRT_ANK Z_ABLAUF_ABBRUCH_ANK /end DEF_CHARACTERISTIC
 /begin LOC_MEASUREMENT gangwechsel_egs_in i_istgang_egs i_zielgang_egs m_k0_in m_k0_mod_has_fkt m_max_dyn_em_in m_soll_k0_has_fkt m_soll_vm_hst_in m_soll_vm_l_hst_in m_vm_in m_wunsch_fpw_hst_in m_wunsch_fpw_in mg_wunsch_fpw_hst n_ab_egs_in n_em_in n_sec_iae_ist_ank n_sec_iae_ziel_ank n_soll_em_hst_in n_soll_ll_vm_in n_vm_in nd_k0_in ndg_k0_in ng_em_ank ng_vm status_iae_in status_k0_in status_kraftfluss_egs_in status_nreg_em_hst_in status_psys_has_sbe status_schaltart_svh_has_sbe status_schaltung_egs_in status_sync_schaltung_sbe z_ablauf_has_hst_in z_ablauf_has_stg z_ablaufvariante_has_stg z_k0_fst_in z_k0_has_fkt z_k0syncmk0erh_frk_dihi /end LOC_MEASUREMENT
/end FUNCTION
/begin FUNCTION SFOp_ANK20_Bitwise_AND_ui8_ "" /begin DEF_CHARACTERISTIC K_SVH_RESET_KON_ANK /end DEF_CHARACTERISTIC /end FUNCTION
/begin FUNCTION SFOp_ANK22_InputSignale1 "" /begin LOC_MEASUREMENT m_max_dyn_em_in m_wunsch_fpw_hst_in /end LOC_MEASUREMENT /end FUNCTION
/begin FUNCTION SFOp_ANK2_FOp_ANK ""
 /begin SUB_FUNCTION SFOp_ANK10_St_Start SFOp_ANK9_St_Ablauf SFOp_ANK6_Input SFOp_ANK20_Bitwise_AND_ui8_ /end SUB_FUNCTION
 /begin DEF_CHARACTERISTIC KL_NDGSK0SYNCERK_SYN_ANK_X KL_NDGSK0SYNCERK_SYN_ANK_Y K_SVH_RESET_KON_ANK MO_SOLLVMHSTBED_SCL_ANK MO_SOLLVMLHSTBED_SCL_ANK MS_K0BED_ABB_ANK MS_K0SCHLBED_SRT_ANK NDGS_K0SYNCERK_SYN_ANK NDS_K0SCHLBED_SRT_ANK NDS_VMNEMBED_KON_ANK NGS_VMSYNCERK_SYN_ANK NS_EMMINBED_SCL_ANK NS_EMMINBED_SYN_ANK NS_VMEINBED_KON_ANK SWI_ABBRUCH_AKTIV_ANK SWI_ABLAUFVAR_SYN_ANK Z_ABLAUF_ABBRUCH_ANK /end DEF_CHARACTERISTIC
 /begin LOC_MEASUREMENT abstellpos_vm_in abstellpos_vm_status_in c_getriebe_egs_in c_vm_in gangwechsel_egs_in i_istgang_egs i_zielgang_egs istgang_egs_in m_em_in m_iae_in m_k0_in m_k0_mber_has_sbe m_k0_mod_has_fkt m_max_dyn_em_in m_min_dyn_em_in m_min_vm_in m_mot_in m_motmax_has m_soll_em_hst_in m_soll_k0_has_fkt m_soll_res_em_bas_sbe m_soll_res_em_has_sbe m_soll_vm_hst_in m_soll_vm_l_hst_in m_vm_in m_vm_start_in m_wunsch_fpw_hst_fil m_wunsch_fpw_hst_in m_wunsch_fpw_in mg_wunsch_fpw mg_wunsch_fpw_hst n_ab_egs_in n_em_in n_min_em_has_sbe n_min_psys_em_has_sbe n_mot_soll_iae_in n_sec_iae n_sec_iae_ist_ank n_sec_iae_ziel_ank n_soll_em_hst_in n_soll_ll_vm_in n_t_egs_in n_vm_in nd_iae nd_k0_in ndg_k0_in ng_em_ank ng_vm osmode_next_in p_bremse_fzg_in phi_neigung_in pos_egs_in sollgang_egs_in st_OMLID_act_stg st_ist_bz_has_stg st_soll_bz_has_hst st_ziel_bz_has_stg status_alaengs_adaoff_in status_betriebsbereit_hst_in status_efahren_has_sbe status_fehler15_eh_diagin status_fehler_iep_in status_iae_adap_in status_iae_in status_iep_in status_k0_adap_in status_k0_in status_kl15_in status_kolbenpos_k0_in status_kraftfluss_egs_in status_kraftfluss_egs_roh_in status_ll_vm_in status_nem_in status_nreg_em_hst_in status_nvm_in status_posvueb_in status_psys_has_sbe status_sa_vm_in status_schaltart_svh_has_sbe status_schaltung_egs_in status_sync_schaltung_sbe status_waschstr_in status_zug_svh_sbe t_betrieb_pvu_has_ee_in t_betrieb_pvu_has_sbe v_f_sbe vg_f_sbe z_ablauf_has_hst_in z_ablauf_has_stg z_ablaufreinit_frk_dihi z_ablaufvariante_has_hst_in z_ablaufvariante_has_stg z_ba_has_k0_hst_in z_ba_has_vm_hst_in z_diag_ersfkt_has_in z_diag_ersfkt_hi_has_in z_diag_notgang_has_in z_emfehler_frk_dihi z_freigabe_pvu_has_sbe z_fuwdeakt_frk_dihi z_hybfkt_stg z_iep_in z_k0_fst_in z_k0_has_fkt z_k0_has_sbe z_k0syncmk0erh_frk_dihi z_kps_stada_in z_modus_em_hst_in z_modus_iae_has_sbe z_modus_iep_has_sbe z_msa_avh_moni_has_sbe z_msa_eaf_moni_has_sbe z_msa_fst_in z_msa_has_sbe z_msa_stada_in z_n_min_em_parksp_has_in z_n_min_iep_in z_nllsoll_iae_in z_nminemnull_frk_dihi z_nvmsollbegr_frk_dihi z_pvu_has_sbe z_sas_has_sbe z_start_modus_has_sbe z_status_psys_mps_sbe z_svh_has_sbe z_ziel_kraftfluss_egs_in zielgang_egs_in /end LOC_MEASUREMENT
/end FUNCTION
/begin FUNCTION SFOp_ANK6_Input "" /begin SUB_FUNCTION SFOp_ANK22_InputSignale1 Run_SFOp_ANK54_cDT1_ngem /end SUB_FUNCTION /begin DEF_CHARACTERISTIC FK_NGEM_ANK /end DEF_CHARACTERISTIC
 /begin LOC_MEASUREMENT SFOp_ANK54_xp_ abstellpos_vm_in abstellpos_vm_status_in c_getriebe_egs_in c_vm_in gangwechsel_egs_in i_istgang_egs i_zielgang_egs istgang_egs_in m_em_in m_iae_in m_k0_in m_k0_mber_has_sbe m_k0_mod_has_fkt m_max_dyn_em_in m_min_dyn_em_in m_min_vm_in m_mot_in m_motmax_has m_soll_em_hst_in m_soll_k0_has_fkt m_soll_res_em_bas_sbe m_soll_res_em_has_sbe m_soll_vm_hst_in m_soll_vm_l_hst_in m_vm_in m_vm_start_in m_wunsch_fpw_hst_fil m_wunsch_fpw_hst_in m_wunsch_fpw_in mg_wunsch_fpw mg_wunsch_fpw_hst n_ab_egs_in n_em_in n_min_em_has_sbe n_min_psys_em_has_sbe n_mot_soll_iae_in n_sec_iae n_sec_iae_ist_ank n_sec_iae_ziel_ank n_soll_em_hst_in n_soll_ll_vm_in n_t_egs_in n_vm_in nd_iae nd_k0_in ndg_k0_in ng_em_ank ng_vm osmode_next_in p_bremse_fzg_in phi_neigung_in pos_egs_in sollgang_egs_in st_OMLID_act_stg st_ist_bz_has_stg st_soll_bz_has_hst st_ziel_bz_has_stg status_alaengs_adaoff_in status_betriebsbereit_hst_in status_efahren_has_sbe status_fehler15_eh_diagin status_fehler_iep_in status_iae_adap_in status_iae_in status_iep_in status_k0_adap_in status_k0_in status_kl15_in status_kolbenpos_k0_in status_kraftfluss_egs_in status_kraftfluss_egs_roh_in status_ll_vm_in status_nem_in status_nreg_em_hst_in status_nvm_in status_posvueb_in status_psys_has_sbe status_sa_vm_in status_schaltart_svh_has_sbe status_schaltung_egs_in status_sync_schaltung_sbe status_waschstr_in status_zug_svh_sbe t_betrieb_pvu_has_ee_in t_betrieb_pvu_has_sbe v_f_sbe vg_f_sbe z_ablauf_has_hst_in z_ablauf_has_stg z_ablaufreinit_frk_dihi z_ablaufvariante_has_hst_in z_ablaufvariante_has_stg z_ba_has_k0_hst_in z_ba_has_vm_hst_in z_diag_ersfkt_has_in z_diag_ersfkt_hi_has_in z_diag_notgang_has_in z_emfehler_frk_dihi z_freigabe_pvu_has_sbe z_fuwdeakt_frk_dihi z_hybfkt_stg z_iep_in z_k0_fst_in z_k0_has_fkt z_k0_has_sbe z_k0syncmk0erh_frk_dihi z_kps_stada_in z_modus_em_hst_in z_modus_iae_has_sbe z_modus_iep_has_sbe z_msa_avh_moni_has_sbe z_msa_eaf_moni_has_sbe z_msa_fst_in z_msa_has_sbe z_msa_stada_in z_n_min_em_parksp_has_in z_n_min_iep_in z_nllsoll_iae_in z_nminemnull_frk_dihi z_nvmsollbegr_frk_dihi z_pvu_has_sbe z_sas_has_sbe z_start_modus_has_sbe z_status_psys_mps_sbe z_svh_has_sbe z_ziel_kraftfluss_egs_in zielgang_egs_in /end LOC_MEASUREMENT
/end FUNCTION
/begin FUNCTION SFOp_ANK76_st___eln_abbruch_ank ""
 /begin SUB_FUNCTION Run_SFOp_ANK89_cTimer_trigger_ Run_SFOp_ANK90__radient_MSollK0 SFOp_ANK83_Entry /end SUB_FUNCTION
 /begin DEF_CHARACTERISTIC K_SVH_RESET_ABB_ANK MG_SOLLK0_ABB_ANK STATUS_ABL_ABBRUCH_AKTIV T_MAX_ABB_ANK /end DEF_CHARACTERISTIC
 /begin LOC_MEASUREMENT SFOp_ANK89_isActive_ gangwechsel_egs_in i_istgang_egs i_zielgang_egs m_k0_in m_k0_mod_has_fkt m_max_dyn_em_in m_soll_k0_has_fkt m_soll_vm_hst_in m_soll_vm_l_hst_in m_vm_in m_wunsch_fpw_hst_in m_wunsch_fpw_in mg_wunsch_fpw_hst n_ab_egs_in n_em_in n_sec_iae_ist_ank n_sec_iae_ziel_ank n_soll_em_hst_in n_soll_ll_vm_in n_vm_in nd_k0_in ndg_k0_in ng_em_ank ng_vm status_iae_in status_k0_in status_kraftfluss_egs_in status_nreg_em_hst_in status_psys_has_sbe status_schaltart_svh_has_sbe status_schaltung_egs_in status_sync_schaltung_sbe t_maxbed_abb_ank z_ablauf_has_hst_in z_ablauf_has_stg z_ablaufvariante_has_stg z_k0_fst_in z_k0_has_fkt z_k0syncmk0erh_frk_dihi /end LOC_MEASUREMENT
/end FUNCTION
/begin FUNCTION SFOp_ANK77_st_k0_schliessen_ank ""
 /begin SUB_FUNCTION Run_SFOp_ANK102_cTimer_trigger_ Run_SFOp_ANK11__Timer_trigger_1 Run_SFOp_ANK10__Timer_trigger_1 Run_SFOp_ANK10__t_m_soll_k0_has Run_SFOp_ANK10__nt_m_k0_mod_has SFOp_ANK96_Entry /end SUB_FUNCTION
 /begin DEF_CHARACTERISTIC KF_MGK0MODHASMAX_SCL_ANK_W KF_MGK0MODHASMAX_SCL_ANK_X KF_MGK0MODHASMAX_SCL_ANK_Y KF_MGSOLLK0HASMAX_SCL_ANK_W KF_MGSOLLK0HASMAX_SCL_ANK_X KF_MGSOLLK0HASMAX_SCL_ANK_Y K_SVH_RESET_SCL_ANK MG_K0MODHASMAXABBR_SCL_ANK MG_K0MODHASMAXK0SREG_SCL_ANK MG_SOLLK0HASMAXABBR_SCL_ANK MO_SOLLVMHSTMSOLLK0_SCL_ANK MO_SOLLVMLHSTMSOLLK0_SCL_ANK NDS_K0GESCHL_SCL_ANK STATUS_ABL_SCL_ANK T_MAX_SCL_ANK T_MK0MODZIEL_SCL_ANK T_MSOLLK0ANSTMAX_SCL_ANK /end DEF_CHARACTERISTIC
 /begin LOC_MEASUREMENT SFOp_ANK102_isActive_ SFOp_ANK104_out_ gangwechsel_egs_in i_istgang_egs i_zielgang_egs m_k0_in m_k0_mod_has_fkt m_max_dyn_em_in m_soll_k0_has_fkt m_soll_vm_hst_in m_soll_vm_l_hst_in m_vm_in m_wunsch_fpw_hst_in m_wunsch_fpw_in mg_k0_mod_max_ank mg_soll_k0_max_ank mg_wunsch_fpw_hst n_ab_egs_in n_em_in n_sec_iae_ist_ank n_sec_iae_ziel_ank n_soll_em_hst_in n_soll_ll_vm_in n_vm_in nd_k0_in ndg_k0_in ng_em_ank ng_vm status_iae_in status_k0_in status_kraftfluss_egs_in status_nreg_em_hst_in status_psys_has_sbe status_schaltart_svh_has_sbe status_schaltung_egs_in status_sync_schaltung_sbe t_m_k0_mod_ziel_ank t_m_soll_k0_anst_ank t_maxbed_scl_ank z_ablauf_has_hst_in z_ablauf_has_stg z_ablaufvariante_has_stg z_k0_fst_in z_k0_has_fkt z_k0syncmk0erh_frk_dihi /end LOC_MEASUREMENT
/end FUNCTION
/begin FUNCTION SFOp_ANK78_st___hronisieren_ank ""
 /begin SUB_FUNCTION Run_SFOp_ANK17__erkums_syn_ank_ Run_SFOp_ANK17__yncerk_syn_ank_ Run_SFOp_ANK16__nt_m_k0_mod_has Run_SFOp_ANK16___MSollK0_Synmin Run_SFOp_ANK15__radient_MSollK0 Run_SFOp_ANK149_cPT1_NVMSoll Run_SFOp_ANK15__mer_NSollVMInit Run_SFOp_ANK13__egaktiv_syn_ank Run_SFOp_ANK14__0k0sreg_syn_ank Run_SFOp_ANK13__egbasis_syn_ank SFOp_ANK136_Bitwise_AND_ui8_ SFOp_ANK140_Bitwise_AND_ui8_ SFOp_ANK139_Bitwise_AND_ui8_ SFOp_ANK138_Bitwise_AND_ui8_ SFOp_ANK121_Entry /end SUB_FUNCTION
 /begin DEF_CHARACTERISTIC FK_NSOLLVM_KON_ANK KF_MGK0NDK0M_SYN_ANK_W KF_MGK0NDK0M_SYN_ANK_X KF_MGK0NDK0M_SYN_ANK_Y KF_MGK0NDK0NGVM_SYN_ANK_W KF_MGK0NDK0NGVM_SYN_ANK_X KF_MGK0NDK0NGVM_SYN_ANK_Y KF_NDEMNSOLLVM_SAK_ANK_W KF_NDEMNSOLLVM_SAK_ANK_X KF_NDEMNSOLLVM_SAK_ANK_Y KF_NGEMMODRSMAX_SYN_ANK_W KF_NGEMMODRSMAX_SYN_ANK_X KF_NGEMMODRSMAX_SYN_ANK_Y KF_NOEMNSOLLVM_SAK_ANK_W KF_NOEMNSOLLVM_SAK_ANK_X KF_NOEMNSOLLVM_SAK_ANK_Y KL_MSOLLK0MIN_SYN_ANK_X KL_MSOLLK0MIN_SYN_ANK_Y KL_MVMVOLLASTSAUG_SYN_ANK_X KL_MVMVOLLASTSAUG_SYN_ANK_Y KL_MZIELK0_SYN_ANK_X KL_MZIELK0_SYN_ANK_Y KL_NDSK0SYNCERK_SYN_ANK_X KL_NDSK0SYNCERK_SYN_ANK_Y KL_TK0SYNCERKUMS_SYN_ANK_X KL_TK0SYNCERKUMS_SYN_ANK_Y K_MZIELNOEMSOLLVM_SAK_ANK K_NOEMNSOLLVMOKS_KON_ANK K_SVH_RESET_SYN_ANK MDS_ZIELK0NSOLLVMINIT_SYN_ANK MD_ZIELSOLLK0_SYN_ANK MGS_WUNSCHFPW_SYN_ANK MG_K0MODMAXMAX_SYN_ANK MG_K0SYNCMK0ERHDIAG_SYN_ANK MG_K0SYNCVMVOLLAST_SYN_ANK MG_SOLLK0MIN_SYN_ANK MO_VMMGSOLLK0_SYN_ANK MS_SOLLK0K0SREG_SYN_ANK MS_ZIELVMHASK0HYS_KON_ANK MS_ZIELVMK0SREG_SYN_ANK NDGS_K0K0SREG_SYN_ANK NDS_K0K0SREG_SYN_ANK NDS_K0SYNCERKMAX_SYN_ANK ND_ZIELK0K0SREG_SYN_ANK NG_EMMODRSMIN_SYN_ANK NOS_EMNSOLLVMK0SREG_SYN_ANK NOS_EMNSOLLVM_SYN_ANK NS_EMMINBED_SYN_ANK N_MINEMNSOLLVM_KON_ANK STATUS_ABL_SYN_ANK SWI_K0SREGBASIS_SYN_ANK SWI_KFMGK0AUSWAHL_SYN_ANK SWI_MK0MODBEGR_SYN_ANK SWI_ZMODUSVMN_ANK SWI_ZPHYSK0_SYN_ANK T_K0SREGBASISMAX_SYN_ANK T_NDGK0K0SREGMIN_SYN_ANK T_VK0SREGAKTIV_SYN_ANK T_VK0SYNCERK_SYN_ANK T_VMDZIELSOLLK0_SYN_ANK /end DEF_CHARACTERISTIC
 /begin LOC_MEASUREMENT SFOp_ANK128_KL_MZIELK0_SYN_ANK SFOp_ANK128_KL__LLK0MIN_SYN_ANK SFOp_ANK129_KL__SYNCERK_SYN_ANK SFOp_ANK132_isActive_ SFOp_ANK148_KF__NSOLLVM_SAK_ANK SFOp_ANK148_KF__NSOLLVM_SAK_A_a SFOp_ANK150_KF__ODRSMAX_SYN_ANK SFOp_ANK153_isActive_ SFOp_ANK163_KF__DK0NGVM_SYN_ANK SFOp_ANK163_KF__K0NDK0M_SYN_ANK SFOp_ANK163_KL__ASTSAUG_SYN_ANK SFOp_ANK164_out_ SFOp_ANK172_isActive_ SFOp_ANK173_KL__CERKUMS_SYN_ANK SFOp_ANK176_isActive_ gangwechsel_egs_in i_istgang_egs i_zielgang_egs m_k0_in m_k0_mod_has_fkt m_k0_mod_max_syn_ank m_max_dyn_em_in m_soll_k0_has_fkt m_soll_vm_hst_in m_soll_vm_l_hst_in m_vm_in m_wunsch_fpw_hst_in m_wunsch_fpw_in m_ziel_k0_ank mg_soll_k0_syn_ank mg_wunsch_fpw_hst n_ab_egs_in n_em_in n_em_mod_syn_ank n_em_ref_syn_ank n_sec_iae_ist_ank n_sec_iae_ziel_ank n_soll_em_hst_in n_soll_ll_vm_in n_vm_in nd_k0_in nd_sec_iae_syn_ank ndg_k0_in nds_k0syncerk_syn_ank ng_em_ank ng_emmodrsmax_syn_ank ng_vm status_iae_in status_k0_in status_kraftfluss_egs_in status_nreg_em_hst_in status_psys_has_sbe status_schaltart_svh_has_sbe status_schaltung_egs_in status_sync_schaltung_sbe t_k0sregaktiv_syn_ank t_k0sregbasis_syn_ank t_k0syncerk_syn_ank t_k0syncerkums_syn_ank t_mdzielsollk0_syn_ank t_ndgk0k0sreg_syn_ank z_ablauf_has_hst_in z_ablauf_has_stg z_ablaufvariante_has_stg z_k0_fst_in z_k0_has_fkt z_k0syncmk0erh_frk_dihi z_ndsk0k0sreg_syn_ank /end LOC_MEASUREMENT
/end FUNCTION
/begin FUNCTION SFOp_ANK79_st___ditionieren_ank "" /begin SUB_FUNCTION Run_SFOp_ANK187_cPT1_NVMSoll SFOp_ANK179_Entry /end SUB_FUNCTION
 /begin DEF_CHARACTERISTIC FK_NSOLLVM_KON_ANK KF_NOEMNSOLLVM_SAK_ANK_W KF_NOEMNSOLLVM_SAK_ANK_X KF_NOEMNSOLLVM_SAK_ANK_Y KL_MSOLLK0BEF_KON_ANK_X KL_MSOLLK0BEF_KON_ANK_Y K_MZIELNOEMSOLLVM_SAK_ANK K_NOEMNSOLLVMOKS_KON_ANK K_SVH_RESET_KON_ANK MS_ZIELVMHASK0HYS_KON_ANK NDS_VMNEMK0HYSMIN_KON_ANK NDS_VMNEMK0HYS_KON_ANK N_MINEMNSOLLVM_KON_ANK STATUS_ABL_KON_ANK SWI_MK0MODBEGR_KON_ANK SWI_ZMODUSVMN_ANK SWI_ZPHYSK0_KON_ANK /end DEF_CHARACTERISTIC
 /begin LOC_MEASUREMENT SFOp_ANK185_KL__LLK0BEF_KON_ANK SFOp_ANK186_KF__NSOLLVM_SAK_ANK gangwechsel_egs_in i_istgang_egs i_zielgang_egs m_k0_in m_k0_mod_has_fkt m_max_dyn_em_in m_soll_k0_has_fkt m_soll_vm_hst_in m_soll_vm_l_hst_in m_vm_in m_wunsch_fpw_hst_in m_wunsch_fpw_in mg_wunsch_fpw_hst n_ab_egs_in n_em_in n_sec_iae_ist_ank n_sec_iae_ziel_ank n_soll_em_hst_in n_soll_ll_vm_in n_vm_in nd_k0_in ndg_k0_in ng_em_ank ng_vm status_iae_in status_k0_in status_kraftfluss_egs_in status_nreg_em_hst_in status_psys_has_sbe status_schaltart_svh_has_sbe status_schaltung_egs_in status_sync_schaltung_sbe z_ablauf_has_hst_in z_ablauf_has_stg z_ablaufvariante_has_stg z_k0_fst_in z_k0_has_fkt z_k0syncmk0erh_frk_dihi /end LOC_MEASUREMENT
/end FUNCTION
/begin FUNCTION SFOp_ANK80_st___ltung_aktiv_ank "" /begin SUB_FUNCTION SFOp_ANK191_Entry_Static SFOp_ANK190_Entry /end SUB_FUNCTION /begin DEF_CHARACTERISTIC STATUS_ABL_SAK_ANK /end DEF_CHARACTERISTIC /begin LOC_MEASUREMENT SFOp_ANK195_KF__NSOLLVM_SAK_ANK SFOp_ANK197_isActive_ /end LOC_MEASUREMENT /end FUNCTION
/begin FUNCTION SFOp_ANK81_st_uebergabe "" /begin SUB_FUNCTION SFOp_ANK200_Entry /end SUB_FUNCTION /end FUNCTION
/begin FUNCTION SFOp_ANK82_st___eln_abbruch_ank "" /begin SUB_FUNCTION SFOp_ANK203_Entry /end SUB_FUNCTION /begin DEF_CHARACTERISTIC STATUS_ABL_ABBRUCH_FERTIG /end DEF_CHARACTERISTIC
 /begin LOC_MEASUREMENT gangwechsel_egs_in i_istgang_egs i_zielgang_egs m_k0_in m_k0_mod_has_fkt m_max_dyn_em_in m_soll_k0_has_fkt m_soll_vm_hst_in m_soll_vm_l_hst_in m_vm_in m_wunsch_fpw_hst_in m_wunsch_fpw_in mg_wunsch_fpw_hst n_ab_egs_in n_em_in n_sec_iae_ist_ank n_sec_iae_ziel_ank n_soll_em_hst_in n_soll_ll_vm_in n_vm_in nd_k0_in ndg_k0_in ng_em_ank ng_vm status_iae_in status_k0_in status_kraftfluss_egs_in status_nreg_em_hst_in status_psys_has_sbe status_schaltart_svh_has_sbe status_schaltung_egs_in status_sync_schaltung_sbe z_ablauf_has_hst_in z_ablauf_has_stg z_ablaufvariante_has_stg z_k0_fst_in z_k0_has_fkt z_k0syncmk0erh_frk_dihi /end LOC_MEASUREMENT
/end FUNCTION
/begin FUNCTION SFOp_ANK83_Entry ""
 /begin DEF_CHARACTERISTIC K_SVH_RESET_ABB_ANK STATUS_ABL_ABBRUCH_AKTIV SWI_ZPHYSK0_ABB_ANK /end DEF_CHARACTERISTIC
/end FUNCTION
/begin FUNCTION SFOp_ANK96_Entry "" /begin DEF_CHARACTERISTIC K_SVH_RESET_SCL_ANK STATUS_ABL_SCL_ANK SWI_ZPHYSK0_SCL_ANK /end DEF_CHARACTERISTIC /end FUNCTION
/begin FUNCTION SFOp_ANK9_St_Ablauf ""
 /begin SUB_FUNCTION SFOp_ANK82_st___eln_abbruch_ank SFOp_ANK81_st_uebergabe SFOp_ANK80_st___ltung_aktiv_ank SFOp_ANK79_st___ditionieren_ank SFOp_ANK78_st___hronisieren_ank SFOp_ANK77_st_k0_schliessen_ank SFOp_ANK76_st___eln_abbruch_ank /end SUB_FUNCTION
/end FUNCTION
/begin FUNCTION SFOp_DRS10_St_Ablauf "" /begin SUB_FUNCTION SFOp_DRS53_Subsystem /end SUB_FUNCTION /end FUNCTION
/begin FUNCTION SFOp_DRS12_Subsystem_Audi_DRS "" /begin SUB_FUNCTION SFOp_DRS90_Entry_Static SFOp_DRS89_Entry /end SUB_FUNCTION /begin LOC_MEASUREMENT SFOp_DRS93_Switch2 /end LOC_MEASUREMENT /end FUNCTION
/begin FUNCTION SFOp_DRS16_Cd_Uebergabe_1 "" /begin DEF_CHARACTERISTIC NDS_SOLLEM_DRS /end DEF_CHARACTERISTIC /end FUNCTION
/begin FUNCTION SFOp_DRS2_Action_FOp_DRS2 ""
 /begin SUB_FUNCTION SFOp_DRS12_Subsystem_Audi_DRS SFOp_DRS10_St_Ablauf SFOp_DRS7_Input SFOp_DRS16_Cd_Uebergabe_1 /end SUB_FUNCTION
 /begin LOC_MEASUREMENT abstellpos_vm_in abstellpos_vm_status_in c_getriebe_egs_in c_vm_in gangwechsel_egs_in i_istgang_egs i_zielgang_egs istgang_egs_in m_em_in m_iae_in m_k0_in m_k0_mber_has_sbe m_k0_mod_has_fkt m_max_dyn_em_in m_min_dyn_em_in m_min_vm_in m_mot_in m_motmax_has m_soll_em_hst_in m_soll_k0_has_fkt m_soll_res_em_bas_sbe m_soll_res_em_has_sbe m_soll_vm_hst_in m_soll_vm_l_hst_in m_vm_in m_vm_start_in m_wunsch_fpw_hst_fil m_wunsch_fpw_hst_in m_wunsch_fpw_in mg_wunsch_fpw mg_wunsch_fpw_hst n_ab_egs_in n_em_in n_min_em_has_sbe n_min_psys_em_has_sbe n_mot_soll_iae_in n_sec_iae n_soll_em_hst_in n_soll_ll_vm_in n_t_egs_in n_vm_in nd_iae nd_k0_in ndg_k0_in ng_vm osmode_next_in p_bremse_fzg_in phi_neigung_in pos_egs_in sollgang_egs_in st_OMLID_act_stg st_ist_bz_has_stg st_soll_bz_has_hst st_ziel_bz_has_stg status_alaengs_adaoff_in status_betriebsbereit_hst_in status_efahren_has_sbe status_fehler15_eh_diagin status_fehler_iep_in status_iae_adap_in status_iae_in status_iep_in status_k0_adap_in status_k0_in status_kl15_in status_kolbenpos_k0_in status_kraftfluss_egs_in status_kraftfluss_egs_roh_in status_ll_vm_in status_nem_in status_nreg_em_hst_in status_nvm_in status_posvueb_in status_psys_has_sbe status_sa_vm_in status_schaltart_svh_has_sbe status_schaltung_egs_in status_sync_schaltung_sbe status_waschstr_in status_zug_svh_sbe t_betrieb_pvu_has_ee_in t_betrieb_pvu_has_sbe v_f_sbe vg_f_sbe z_ablauf_has_hst_in z_ablauf_has_stg z_ablaufreinit_frk_dihi z_ablaufvariante_has_hst_in z_ablaufvariante_has_stg z_ba_has_k0_hst_in z_ba_has_vm_hst_in z_diag_ersfkt_has_in z_diag_ersfkt_hi_has_in z_diag_notgang_has_in z_emfehler_frk_dihi z_freigabe_pvu_has_sbe z_fuwdeakt_frk_dihi z_hybfkt_stg z_iep_in z_k0_fst_in z_k0_has_fkt z_k0_has_sbe z_k0syncmk0erh_frk_dihi z_kps_stada_in z_modus_em_hst_in z_modus_iae_has_sbe z_modus_iep_has_sbe z_msa_avh_moni_has_sbe z_msa_eaf_moni_has_sbe z_msa_fst_in z_msa_has_sbe z_msa_stada_in z_n_min_em_parksp_has_in z_n_min_iep_in z_nllsoll_iae_in z_nminemnull_frk_dihi z_nvmsollbegr_frk_dihi z_pvu_has_sbe z_sas_has_sbe z_start_modus_has_sbe z_status_psys_mps_sbe z_svh_has_sbe z_ziel_kraftfluss_egs_in zielgang_egs_in /end LOC_MEASUREMENT
/end FUNCTION
/begin FUNCTION SFOp_DRS53_Subsystem ""
 /begin SUB_FUNCTION SFOp_DRS56_St_VM_zuenden SFOp_DRS55_St_Uebergabe SFOp_DRS54_St_EM_auf_n /end SUB_FUNCTION
/end FUNCTION
/begin FUNCTION SFOp_DRS54_St_EM_auf_n "" /begin SUB_FUNCTION SFOp_DRS58_Entry_Static SFOp_DRS57_Entry /end SUB_FUNCTION /begin DEF_CHARACTERISTIC MG_1MMAXEM_DRS MG_1MMINEM_DRS /end DEF_CHARACTERISTIC /begin LOC_MEASUREMENT SFOp_DRS63_isActive_ m_soll_vm_hst_in m_soll_vm_l_hst_in /end LOC_MEASUREMENT /end FUNCTION
/begin FUNCTION SFOp_DRS55_St_Uebergabe "" /begin SUB_FUNCTION SFOp_DRS69_Entry /end SUB_FUNCTION
 /begin LOC_MEASUREMENT c_vm_in m_soll_vm_hst_in m_soll_vm_l_hst_in n_em_in n_soll_ll_vm_in status_iep_in z_ablaufvariante_has_stg /end LOC_MEASUREMENT
/end FUNCTION
/begin FUNCTION SFOp_DRS56_St_VM_zuenden ""
 /begin SUB_FUNCTION Run_SFOp_DRS80_cTimerStep_ Run_SFOp_DRS79_CL_PT1_TA_ SFOp_DRS74_Entry /end SUB_FUNCTION
 /begin DEF_CHARACTERISTIC T_2MAX_DRS T_PT1NSOLLEM_DRS /end DEF_CHARACTERISTIC
 /begin LOC_MEASUREMENT SFOp_DRS80_isActive_ c_vm_in m_soll_vm_hst_in m_soll_vm_l_hst_in n_em_in n_soll_ll_vm_in status_iep_in z_ablaufvariante_has_stg /end LOC_MEASUREMENT
/end FUNCTION
/begin FUNCTION SFOp_DRS57_Entry "" /begin DEF_CHARACTERISTIC MG_1MMAXEM_DRS MG_1MMINEM_DRS /end DEF_CHARACTERISTIC
 /begin LOC_MEASUREMENT c_vm_in m_soll_vm_hst_in m_soll_vm_l_hst_in n_em_in n_soll_ll_vm_in status_iep_in z_ablaufvariante_has_stg /end LOC_MEASUREMENT
/end FUNCTION
/begin FUNCTION SFOp_DRS58_Entry_Static "" /begin SUB_FUNCTION Run_SFOp_DRS63_cTimerStep_ Run_SFOp_DRS62__miter_Gradient_ /end SUB_FUNCTION
 /begin DEF_CHARACTERISTIC KL_1NOSOLLEM_DRS_X KL_1NOSOLLEM_DRS_Y NG_1SOLLEM_DRS T_1MAX_DRS /end DEF_CHARACTERISTIC
 /begin LOC_MEASUREMENT SFOp_DRS63_isActive_ c_vm_in m_soll_vm_hst_in m_soll_vm_l_hst_in n_em_in n_soll_ll_vm_in status_iep_in z_ablaufvariante_has_stg /end LOC_MEASUREMENT
/end FUNCTION
/begin FUNCTION SFOp_DRS69_Entry ""
 /begin LOC_MEASUREMENT c_vm_in m_soll_vm_hst_in m_soll_vm_l_hst_in n_em_in n_soll_ll_vm_in status_iep_in z_ablaufvariante_has_stg /end LOC_MEASUREMENT
/end FUNCTION
/begin FUNCTION SFOp_DRS74_Entry ""
 /begin LOC_MEASUREMENT c_vm_in m_soll_vm_hst_in m_soll_vm_l_hst_in n_em_in n_soll_ll_vm_in status_iep_in z_ablaufvariante_has_stg /end LOC_MEASUREMENT
/end FUNCTION
/begin FUNCTION SFOp_DRS7_Input ""
 /begin LOC_MEASUREMENT abstellpos_vm_in abstellpos_vm_status_in c_getriebe_egs_in c_vm_in gangwechsel_egs_in i_istgang_egs i_zielgang_egs istgang_egs_in m_em_in m_iae_in m_k0_in m_k0_mber_has_sbe m_k0_mod_has_fkt m_max_dyn_em_in m_min_dyn_em_in m_min_vm_in m_mot_in m_motmax_has m_soll_em_hst_in m_soll_k0_has_fkt m_soll_res_em_bas_sbe m_soll_res_em_has_sbe m_soll_vm_hst_in m_soll_vm_l_hst_in m_vm_in m_vm_start_in m_wunsch_fpw_hst_fil m_wunsch_fpw_hst_in m_wunsch_fpw_in mg_wunsch_fpw mg_wunsch_fpw_hst n_ab_egs_in n_em_in n_min_em_has_sbe n_min_psys_em_has_sbe n_mot_soll_iae_in n_sec_iae n_soll_em_hst_in n_soll_ll_vm_in n_t_egs_in n_vm_in nd_iae nd_k0_in ndg_k0_in ng_vm osmode_next_in p_bremse_fzg_in phi_neigung_in pos_egs_in sollgang_egs_in st_OMLID_act_stg st_ist_bz_has_stg st_soll_bz_has_hst st_ziel_bz_has_stg status_alaengs_adaoff_in status_betriebsbereit_hst_in status_efahren_has_sbe status_fehler15_eh_diagin status_fehler_iep_in status_iae_adap_in status_iae_in status_iep_in status_k0_adap_in status_k0_in status_kl15_in status_kolbenpos_k0_in status_kraftfluss_egs_in status_kraftfluss_egs_roh_in status_ll_vm_in status_nem_in status_nreg_em_hst_in status_nvm_in status_posvueb_in status_psys_has_sbe status_sa_vm_in status_schaltart_svh_has_sbe status_schaltung_egs_in status_sync_schaltung_sbe status_waschstr_in status_zug_svh_sbe t_betrieb_pvu_has_ee_in t_betrieb_pvu_has_sbe v_f_sbe vg_f_sbe z_ablauf_has_hst_in z_ablauf_has_stg z_ablaufreinit_frk_dihi z_ablaufvariante_has_hst_in z_ablaufvariante_has_stg z_ba_has_k0_hst_in z_ba_has_vm_hst_in z_diag_ersfkt_has_in z_diag_ersfkt_hi_has_in z_diag_notgang_has_in z_emfehler_frk_dihi z_freigabe_pvu_has_sbe z_fuwdeakt_frk_dihi z_hybfkt_stg z_iep_in z_k0_fst_in z_k0_has_fkt z_k0_has_sbe z_k0syncmk0erh_frk_dihi z_kps_stada_in z_modus_em_hst_in z_modus_iae_has_sbe z_modus_iep_has_sbe z_msa_avh_moni_has_sbe z_msa_eaf_moni_has_sbe z_msa_fst_in z_msa_has_sbe z_msa_stada_in z_n_min_em_parksp_has_in z_n_min_iep_in z_nllsoll_iae_in z_nminemnull_frk_dihi z_nvmsollbegr_frk_dihi z_pvu_has_sbe z_sas_has_sbe z_start_modus_has_sbe z_status_psys_mps_sbe z_svh_has_sbe z_ziel_kraftfluss_egs_in zielgang_egs_in /end LOC_MEASUREMENT
/end FUNCTION
/begin FUNCTION SFOp_DRS89_Entry ""
 /begin LOC_MEASUREMENT c_vm_in m_soll_vm_hst_in m_soll_vm_l_hst_in n_em_in n_soll_ll_vm_in status_iep_in z_ablaufvariante_has_stg /end LOC_MEASUREMENT
/end FUNCTION
/begin FUNCTION SFOp_DRS90_Entry_Static ""
 /begin LOC_MEASUREMENT SFOp_DRS93_Switch2 c_vm_in m_soll_vm_hst_in m_soll_vm_l_hst_in n_em_in n_soll_ll_vm_in status_iep_in z_ablaufvariante_has_stg /end LOC_MEASUREMENT
/end FUNCTION
/begin FUNCTION SFop_Fehl155_Subsystem "" /begin SUB_FUNCTION SFop_Fehl159_Input SFop_Fehl157_Entry /end SUB_FUNCTION
 /begin LOC_MEASUREMENT c_getriebe_egs_in gangwechsel_egs_in istgang_egs_in m_em_in m_iae_in m_k0_in m_max_dyn_em_in m_min_dyn_em_in m_mot_in m_soll_em_hst_in m_soll_vm_hst_in m_vm_in m_vm_start_in m_wunsch_fpw_in n_ab_egs_in n_em_in n_mot_soll_iae_in n_soll_ll_vm_in n_t_egs_in n_vm_in osmode_next_in p_bremse_fzg_in phi_neigung_in pos_egs_in sollgang_egs_in status_alaengs_adaoff_in status_fehler_iep_in status_iae_adap_in status_iae_in status_iep_in status_k0_adap_in status_k0_in status_kolbenpos_k0_in status_kraftfluss_egs_in status_kraftfluss_egs_roh_in status_ll_vm_in status_nem_in status_nvm_in status_posvueb_in status_waschstr_in t_betrieb_pvu_has_ee_in z_ablauf_has_hst_in z_ablaufvariante_has_hst_in z_diag_ersfkt_has_in z_diag_ersfkt_hi_has_in z_diag_notgang_has_in z_iep_in z_k0_fst_in z_kps_stada_in z_modus_em_hst_in z_msa_fst_in z_n_min_em_parksp_has_in z_n_min_iep_in z_nllsoll_iae_in z_ziel_kraftfluss_egs_in zielgang_egs_in /end LOC_MEASUREMENT
/end FUNCTION
/begin FUNCTION SFop_Fehl157_Entry "" /begin LOC_MEASUREMENT z_ablauf_has_hst_in /end LOC_MEASUREMENT /end FUNCTION
/begin FUNCTION SFop_Fehl159_Input ""
 /begin LOC_MEASUREMENT c_getriebe_egs_in gangwechsel_egs_in istgang_egs_in m_em_in m_iae_in m_k0_in m_max_dyn_em_in m_min_dyn_em_in m_mot_in m_soll_em_hst_in m_soll_vm_hst_in m_vm_in m_vm_start_in m_wunsch_fpw_in n_ab_egs_in n_em_in n_mot_soll_iae_in n_soll_ll_vm_in n_t_egs_in n_vm_in osmode_next_in p_bremse_fzg_in phi_neigung_in pos_egs_in sollgang_egs_in status_alaengs_adaoff_in status_fehler_iep_in status_iae_adap_in status_iae_in status_iep_in status_k0_adap_in status_k0_in status_kolbenpos_k0_in status_kraftfluss_egs_in status_kraftfluss_egs_roh_in status_ll_vm_in status_nem_in status_nvm_in status_posvueb_in status_waschstr_in t_betrieb_pvu_has_ee_in z_ablauf_has_hst_in z_ablaufvariante_has_hst_in z_diag_ersfkt_has_in z_diag_ersfkt_hi_has_in z_diag_notgang_has_in z_iep_in z_k0_fst_in z_kps_stada_in z_modus_em_hst_in z_msa_fst_in z_n_min_em_parksp_has_in z_n_min_iep_in z_nllsoll_iae_in z_ziel_kraftfluss_egs_in zielgang_egs_in /end LOC_MEASUREMENT
/end FUNCTION
/begin FUNCTION SFOp_GA3_Entry "" /begin SUB_FUNCTION SFOp_GA8_If_Action_Subsystem /end SUB_FUNCTION /begin LOC_MEASUREMENT n_em_in z_ablauf_has_hst_in /end LOC_MEASUREMENT /end FUNCTION
/begin FUNCTION SFOp_GA8_If_Action_Subsystem "" /begin LOC_MEASUREMENT n_em_in z_ablauf_has_hst_in /end LOC_MEASUREMENT /end FUNCTION
/begin FUNCTION SFOp_GA9_If_Action_Subsystem "" /begin LOC_MEASUREMENT n_em_in z_ablauf_has_hst_in /end LOC_MEASUREMENT /end FUNCTION
/begin FUNCTION SFOp_GE3_Entry "" /begin SUB_FUNCTION SFOp_GE8_If_Action_Subsystem /end SUB_FUNCTION /begin LOC_MEASUREMENT n_em_in z_ablauf_has_hst_in /end LOC_MEASUREMENT /end FUNCTION
/begin FUNCTION SFOp_GE8_If_Action_Subsystem "" /begin LOC_MEASUREMENT n_em_in z_ablauf_has_hst_in /end LOC_MEASUREMENT /end FUNCTION
/begin FUNCTION SFOp_GE9_If_Action_Subsystem "" /begin LOC_MEASUREMENT n_em_in z_ablauf_has_hst_in /end LOC_MEASUREMENT /end FUNCTION
/begin FUNCTION SFOp_NOS105_ac_start_en "" /begin DEF_CHARACTERISTIC STATUS_ABL_SRT_NOS SWI_ZPHYSK0_SRT_NOS /end DEF_CHARACTERISTIC /end FUNCTION
/begin FUNCTION SFOp_NOS10_St_Start "" /begin SUB_FUNCTION SFOp_NOS105_ac_start_en /end SUB_FUNCTION /begin DEF_CHARACTERISTIC STATUS_ABL_SRT_NOS /end DEF_CHARACTERISTIC /end FUNCTION
/begin FUNCTION SFOp_NOS34_st_k0schliessen_nos ""
 /begin SUB_FUNCTION SFOp_NOS42_ac___essen_nos_en_st SFOp_NOS41_ac___hliessen_nos_en /end SUB_FUNCTION
 /begin DEF_CHARACTERISTIC STATUS_ABL_SCL_NOS /end DEF_CHARACTERISTIC
 /begin LOC_MEASUREMENT SFOp_NOS46_isActive_ m_k0_in /end LOC_MEASUREMENT
/end FUNCTION
/begin FUNCTION SFOp_NOS35_st___ditionieren_nos ""
 /begin SUB_FUNCTION SFOp_NOS51_ac___ieren_nos_en_st SFOp_NOS50_ac___ionieren_nos_en /end SUB_FUNCTION
 /begin DEF_CHARACTERISTIC STATUS_ABL_KON_NOS /end DEF_CHARACTERISTIC
 /begin LOC_MEASUREMENT m_k0_in /end LOC_MEASUREMENT
/end FUNCTION
/begin FUNCTION SFOp_NOS36_st___art_abbruch_nos ""
 /begin SUB_FUNCTION Run_SFOp_NOS61__r_t_max_abb_zus Run_SFOp_NOS62__radient_MSollK0 SFOp_NOS55_Entry /end SUB_FUNCTION
 /begin DEF_CHARACTERISTIC MG_SOLLK0_ABB_NOS STATUS_ABL_ABBRUCH_AKTIV T_MAX_ABB_NOS /end DEF_CHARACTERISTIC
 /begin LOC_MEASUREMENT SFOp_NOS61_isActive_ m_k0_in n_em_in n_vm_in nd_k0_in status_k0_in status_psys_has_sbe t_max_abb_nos_mess z_ablauf_has_stg z_status_psys_mps_sbe /end LOC_MEASUREMENT
/end FUNCTION
/begin FUNCTION SFOp_NOS37_st_notstarten_nos ""
 /begin SUB_FUNCTION SFOp_NOS71_ac___arten_nos_en_st SFOp_NOS70_ac_notstarten_nos_en /end SUB_FUNCTION
 /begin DEF_CHARACTERISTIC STATUS_ABL_NST_NOS /end DEF_CHARACTERISTIC
 /begin LOC_MEASUREMENT SFOp_NOS75_isActive_ SFOp_NOS77_out_ SFOp_NOS78_isActive_ m_k0_in /end LOC_MEASUREMENT
/end FUNCTION
/begin FUNCTION SFOp_NOS38_st_uebergabe ""
 /begin SUB_FUNCTION SFOp_NOS92_ac___rgabe_nos_en_st SFOp_NOS91_ac_uebergabe_nos_en /end SUB_FUNCTION
 /begin LOC_MEASUREMENT m_k0_in /end LOC_MEASUREMENT
/end FUNCTION
/begin FUNCTION SFOp_NOS39_st___art_abbruch_nos "" /begin SUB_FUNCTION SFOp_NOS96_Entry /end SUB_FUNCTION /begin DEF_CHARACTERISTIC STATUS_ABL_ABBRUCH_FERTIG /end DEF_CHARACTERISTIC
 /begin LOC_MEASUREMENT m_k0_in n_em_in n_vm_in nd_k0_in status_k0_in status_psys_has_sbe z_ablauf_has_stg z_status_psys_mps_sbe /end LOC_MEASUREMENT
/end FUNCTION
/begin FUNCTION SFOp_NOS41_ac___hliessen_nos_en "" /begin DEF_CHARACTERISTIC STATUS_ABL_SCL_NOS SWI_ZPHYSK0_SCL_NOS /end DEF_CHARACTERISTIC /end FUNCTION
/begin FUNCTION SFOp_NOS42_ac___essen_nos_en_st "" /begin SUB_FUNCTION Run_SFOp_NOS46__mer_max_scl_nos /end SUB_FUNCTION /begin DEF_CHARACTERISTIC T_MAX_SCL_NOS /end DEF_CHARACTERISTIC
 /begin LOC_MEASUREMENT SFOp_NOS46_isActive_ m_k0_in n_em_in n_vm_in nd_k0_in status_k0_in status_psys_has_sbe t_max_scl_nos_mess z_ablauf_has_stg z_status_psys_mps_sbe /end LOC_MEASUREMENT
/end FUNCTION
/begin FUNCTION SFOp_NOS50_ac___ionieren_nos_en "" /begin DEF_CHARACTERISTIC STATUS_ABL_KON_NOS SWI_ZPHYSK0_KON_NOS /end DEF_CHARACTERISTIC
 /begin LOC_MEASUREMENT m_k0_in n_em_in n_vm_in nd_k0_in status_k0_in status_psys_has_sbe z_ablauf_has_stg z_status_psys_mps_sbe /end LOC_MEASUREMENT
/end FUNCTION
/begin RECORD_LAYOUT FLOAT32_IEEE_COL_DIRECT_S6_S3 FNC_VALUES 1 FLOAT32_IEEE COLUMN_DIR DIRECT /end RECORD_LAYOUT
/begin RECORD_LAYOUT FLOAT32_IEEE_X_INCR_DIRECT_S6_S3 AXIS_PTS_X 1 FLOAT32_IEEE INDEX_INCR DIRECT /end RECORD_LAYOUT
/begin RECORD_LAYOUT SBYTE_X_INCR_DIRECT_S6_S3 AXIS_PTS_X 1 SBYTE INDEX_INCR DIRECT /end RECORD_LAYOUT
/begin RECORD_LAYOUT UBYTE_COL_DIRECT_S6_S3 FNC_VALUES 1 UBYTE COLUMN_DIR DIRECT /end RECORD_LAYOUT
/begin RECORD_LAYOUT UBYTE_X_INCR_DIRECT_S6_S3 AXIS_PTS_X 1 UBYTE INDEX_INCR DIRECT /end RECORD_LAYOUT
/end MODULE
/end PROJECT
