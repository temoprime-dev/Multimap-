ASAP2_VERSION 1 51
/begin PROJECT ZHBC8600 "Gen2_BMW_System_Supplier_Lib"
/begin MODULE CPP ""
/begin MOD_COMMON "" BYTE_ORDER MSB_FIRST ALIGNMENT_BYTE 1 ALIGNMENT_WORD 2 ALIGNMENT_LONG 4 ALIGNMENT_FLOAT32_IEEE 4 ALIGNMENT_FLOAT64_IEEE 1 /end MOD_COMMON
/begin COMPU_TAB _CNV_P_2_A_I_32_S2 "" TAB_INTP 2 0 0 65535 65535 /end COMPU_TAB
/begin COMPU_TAB _CNV_P_2_A_I_5_S2 "" TAB_INTP 2 0 0 255 255 /end COMPU_TAB
/begin COMPU_VTAB _CNV_S_2_Enum_EBABF_41_S2 "" TAB_VERB 2 0 "BAB_KEINE_FGRKF" 1 "BAB_UND_FGRKF" DEFAULT_VALUE "" /end COMPU_VTAB
/begin COMPU_VTAB _CNV_S_2_Enum_ECOD__16_S2 "" TAB_VERB 2 0 "KEIN_SPORTSCHALTER" 1 "SPORTSCHALTER" DEFAULT_VALUE "" /end COMPU_VTAB
/begin COMPU_VTAB _CNV_S_2_Enum_EHDC__99_S2 "" TAB_VERB 2 0 "N_MOT_SCHALTEN" 1 "N_MOT_GANGHALTEN" DEFAULT_VALUE "" /end COMPU_VTAB
/begin COMPU_VTAB _CNV_S_2_Enum_EMSA__72_S2 "MSA-Anforderungs-Status" TAB_VERB 2 0 "MSA_NO_REQ" 1 "MSA_AVOID_ENG_OFF" DEFAULT_VALUE "" /end COMPU_VTAB
/begin COMPU_VTAB _CNV_S_2_Enum_ERRDS_215_S2 "" TAB_VERB 2 0 "ABS_DSC_Ok" 1 "ABS_DSC_nOk" DEFAULT_VALUE "" /end COMPU_VTAB
/begin COMPU_VTAB _CNV_S_2_Enum_ERS_S_33_S2 "" TAB_VERB 2 0 "ERS" 1 "MFRS" DEFAULT_VALUE "" /end COMPU_VTAB
/begin COMPU_VTAB _CNV_S_2_Enum_ESPOR_193_S2 "" TAB_VERB 2 0 "AUTOMATC" 1 "SPORT" DEFAULT_VALUE "" /end COMPU_VTAB
/begin COMPU_VTAB _CNV_S_2_Schalter_A_4_S2 "Schalter: 0 = AUS, 1 = EIN" TAB_VERB 2 0 "AUS" 1 "EIN" DEFAULT_VALUE "" /end COMPU_VTAB
/begin COMPU_VTAB _CNV_S_3_Enum_EB_ST_196_S2 "" TAB_VERB 3 0 "B_NOT_PUSHED" 1 "B_PUSHED" 2 "B_FAILURE" DEFAULT_VALUE "" /end COMPU_VTAB
/begin COMPU_VTAB _CNV_S_3_Enum_EQ_64_S2 "" TAB_VERB 3 0 "SIGNAL_OK" 1 "ERSATZWERT" 2 "FEHLER" DEFAULT_VALUE "" /end COMPU_VTAB
/begin COMPU_VTAB _CNV_S_3_Enum_ERRDS_70_S2 "" TAB_VERB 3 0 "ABS_DSC_Ok" 1 "ABS_DSC_ERR_RolleCAN_False" 2 "ABS_DSC_ERR_RolleCAN_True" DEFAULT_VALUE "" /end COMPU_VTAB
/begin COMPU_METHOD _CNV_P_2_A_I_32_CM_S2 "" TAB_INTP "%6.3" "" COMPU_TAB_REF _CNV_P_2_A_I_32_S2 /end COMPU_METHOD
/begin COMPU_METHOD _CNV_P_2_A_I_5_CM_S2 "" TAB_INTP "%6.3" "" COMPU_TAB_REF _CNV_P_2_A_I_5_S2 /end COMPU_METHOD
/begin COMPU_METHOD _CNV_R_R_Umr_1000_z_12_CM_S2 "" RAT_FUNC "%6.3" "s" COEFFS 0 1000 0 0 0 1 /end COMPU_METHOD
/begin COMPU_METHOD _CNV_R_R_Umr_100_zu_42_CM_S2 "" RAT_FUNC "%6.3" "" COEFFS 0 100 0 0 0 1 /end COMPU_METHOD
/begin COMPU_METHOD _CNV_R_R_Umr_100_zu_88_CM_S2 "" RAT_FUNC "%6.3" "%" COEFFS 0 100 0 0 0 1 /end COMPU_METHOD
/begin COMPU_METHOD _CNV_R_R_Umr_10_zu__10_CM_S2 "" RAT_FUNC "%6.3" "°" COEFFS 0 10 0 0 0 1 /end COMPU_METHOD
/begin COMPU_METHOD _CNV_R_R_Umr_10_zu__133_CM_S2 "" RAT_FUNC "%6.3" "U/min" COEFFS 0 10 0 0 0 1 /end COMPU_METHOD
/begin COMPU_METHOD _CNV_R_R_Umr_10_zu__241_CM_S2 "" RAT_FUNC "%6.3" "1/s³" COEFFS 0 10 0 0 0 1 /end COMPU_METHOD
/begin COMPU_METHOD _CNV_R_R_Umr_10_zu__37_CM_S2 "" RAT_FUNC "%6.3" "m/s*s" COEFFS 0 10 0 0 0 1 /end COMPU_METHOD
/begin COMPU_METHOD _CNV_R_R_Umr_10_zu__9_CM_S2 "" RAT_FUNC "%6.3" "%" COEFFS 0 10 0 0 0 1 /end COMPU_METHOD
/begin COMPU_METHOD _CNV_R_R_Umr_1_zu_1_0_CM_S2 "" RAT_FUNC "%6.3" "hPa" COEFFS 0 1 0 0 0 1 /end COMPU_METHOD
/begin COMPU_METHOD _CNV_R_R_Umr_1_zu_1_110_CM_S2 "" RAT_FUNC "%6.3" "°/s" COEFFS 0 1 0 0 0 1 /end COMPU_METHOD
/begin COMPU_METHOD _CNV_R_R_Umr_1_zu_1_111_CM_S2 "" RAT_FUNC "%6.3" "usec" COEFFS 0 1 0 0 0 1 /end COMPU_METHOD
/begin COMPU_METHOD _CNV_R_R_Umr_1_zu_1_124_CM_S2 "" RAT_FUNC "%6.3" "s" COEFFS 0 1 0 0 0 1 /end COMPU_METHOD
/begin COMPU_METHOD _CNV_R_R_Umr_1_zu_1_1_CM_S2 "" RAT_FUNC "%6.3" "°C" COEFFS 0 1 0 0 0 1 /end COMPU_METHOD
/begin COMPU_METHOD _CNV_R_R_Umr_1_zu_1_266_CM_S2 "" RAT_FUNC "%6.3" "% von %" COEFFS 0 1 0 0 0 1 /end COMPU_METHOD
/begin COMPU_METHOD _CNV_R_R_Umr_1_zu_1_2_CM_S2 "" RAT_FUNC "%6.3" "" COEFFS 0 1 0 0 0 1 /end COMPU_METHOD
/begin COMPU_METHOD _CNV_R_R_Umr_1_zu_1_38_CM_S2 "" RAT_FUNC "%6.3" "Nm" COEFFS 0 1 0 0 0 1 /end COMPU_METHOD
/begin COMPU_METHOD _CNV_R_R_Umr_1_zu_1_3_CM_S2 "" RAT_FUNC "%6.3" "U/min" COEFFS 0 1 0 0 0 1 /end COMPU_METHOD
/begin COMPU_METHOD _CNV_R_R_Umr_1_zu_1_6_CM_S2 "" RAT_FUNC "%6.3" "ms" COEFFS 0 1 0 0 0 1 /end COMPU_METHOD
/begin COMPU_METHOD _CNV_R_R_Umr_1_zu_1_8_CM_S2 "" RAT_FUNC "%6.3" "km/h" COEFFS 0 1 0 0 0 1 /end COMPU_METHOD
/begin COMPU_METHOD _CNV_R_R_Umr_2_zu_1_179_CM_S2 "" RAT_FUNC "%6.3" "Bar" COEFFS 0 2 0 0 0 1 /end COMPU_METHOD
/begin COMPU_METHOD _CNV_S_2_Enum_EBABF_41_CM_S2 "" TAB_VERB "%6.3" "" COMPU_TAB_REF _CNV_S_2_Enum_EBABF_41_S2 /end COMPU_METHOD
/begin COMPU_METHOD _CNV_S_2_Enum_ECOD__16_CM_S2 "" TAB_VERB "%6.3" "" COMPU_TAB_REF _CNV_S_2_Enum_ECOD__16_S2 /end COMPU_METHOD
/begin COMPU_METHOD _CNV_S_2_Enum_EHDC__99_CM_S2 "" TAB_VERB "%6.3" "" COMPU_TAB_REF _CNV_S_2_Enum_EHDC__99_S2 /end COMPU_METHOD
/begin COMPU_METHOD _CNV_S_2_Enum_EMSA__72_CM_S2 "MSA-Anforderungs-Status" TAB_VERB "%6.3" "" COMPU_TAB_REF _CNV_S_2_Enum_EMSA__72_S2 /end COMPU_METHOD
/begin COMPU_METHOD _CNV_S_2_Enum_ERRDS_215_CM_S2 "" TAB_VERB "%6.3" "" COMPU_TAB_REF _CNV_S_2_Enum_ERRDS_215_S2 /end COMPU_METHOD
/begin COMPU_METHOD _CNV_S_2_Enum_ERS_S_33_CM_S2 "" TAB_VERB "%6.3" "" COMPU_TAB_REF _CNV_S_2_Enum_ERS_S_33_S2 /end COMPU_METHOD
/begin COMPU_METHOD _CNV_S_2_Enum_ESPOR_193_CM_S2 "" TAB_VERB "%6.3" "" COMPU_TAB_REF _CNV_S_2_Enum_ESPOR_193_S2 /end COMPU_METHOD
/begin COMPU_METHOD _CNV_S_2_Schalter_A_4_CM_S2 "Schalter: 0 = AUS, 1 = EIN" TAB_VERB "%6.3" "" COMPU_TAB_REF _CNV_S_2_Schalter_A_4_S2 /end COMPU_METHOD
/begin COMPU_METHOD _CNV_S_3_Enum_EB_ST_196_CM_S2 "" TAB_VERB "%6.3" "" COMPU_TAB_REF _CNV_S_3_Enum_EB_ST_196_S2 /end COMPU_METHOD
/begin COMPU_METHOD _CNV_S_3_Enum_EQ_64_CM_S2 "" TAB_VERB "%6.3" "" COMPU_TAB_REF _CNV_S_3_Enum_EQ_64_S2 /end COMPU_METHOD
/begin COMPU_METHOD _CNV_S_3_Enum_ERRDS_70_CM_S2 "" TAB_VERB "%6.3" "" COMPU_TAB_REF _CNV_S_3_Enum_ERRDS_70_S2 /end COMPU_METHOD
/begin COMPU_METHOD SAB2_T_TIMER_20MS_S3_S3 "int = ((phys * 1) / 20) - (0) ms" RAT_FUNC "%4.3" "ms" COEFFS 0 0.05 0 0 0 1 /end COMPU_METHOD
/begin COMPU_METHOD SAB2_T_TIMER_50NS_S3_S3 "int = ((phys * 20000) / 1) - (0) ms" RAT_FUNC "%6.5" "ms" COEFFS 0 20000 0 0 0 1 /end COMPU_METHOD
/begin COMPU_METHOD SAB2_T_TIMER_S10_S3_S3 "int = ((phys * 10) / 1) - (0) s" RAT_FUNC "%4.3" "s" COEFFS 0 10 0 0 0 1 /end COMPU_METHOD
/begin COMPU_METHOD SAB2_U_1VOLT1000_S3_S3 "int = ((phys * 1000) / 1) - (0) Volt" RAT_FUNC "%4.3" "Volt" COEFFS 0 1000 0 0 0 1 /end COMPU_METHOD
/begin COMPU_METHOD SAB2_U_1VOLT_S3_S3 "int = ((phys * 1) / 1) - (0) Volt" RAT_FUNC "%1.0" "Volt" COEFFS 0 1 0 0 0 1 /end COMPU_METHOD
/begin COMPU_METHOD SAB2_V_10KMH_S3_S3 "int = ((phys * 1) / 10) - (0) km/h" RAT_FUNC "%4.3" "km/h" COEFFS 0 0.1 0 0 0 1 /end COMPU_METHOD
/begin COMPU_METHOD SAB2_V_KMH100_S3_S3 "int = ((phys * 100) / 1) - (0) km/h" RAT_FUNC "%4.3" "km/h" COEFFS 0 100 0 0 0 1 /end COMPU_METHOD
/begin COMPU_METHOD SAB2_V_KMH10_S3_S3 "int = ((phys * 10) / 1) - (0) km/h" RAT_FUNC "%4.3" "km/h" COEFFS 0 10 0 0 0 1 /end COMPU_METHOD
/begin COMPU_METHOD SAB2_V_KMH16_S3_S3 "int = ((phys * 16) / 1) - (0) km/h" RAT_FUNC "%4.3" "km/h" COEFFS 0 16 0 0 0 1 /end COMPU_METHOD
/begin COMPU_METHOD SAB2_V_KMH50_S3_S3 "int = ((phys * 50) / 1) - (0) km/h" RAT_FUNC "%4.3" "km/h" COEFFS 0 50 0 0 0 1 /end COMPU_METHOD
/begin COMPU_METHOD SAB2_V_KMH64_S3_S3 "int = ((phys * 64) / 1) - (0) km/h" RAT_FUNC "%4.3" "km/h" COEFFS 0 64 0 0 0 1 /end COMPU_METHOD
/begin COMPU_METHOD SAB_0125PROZENT_S2_S3 "int = ((phys * 1000) / 125) - (0) %" RAT_FUNC "%4.3" "%" COEFFS 0 8 0 0 0 1 /end COMPU_METHOD
/begin COMPU_METHOD SAB_039063PROZENT_S2_S3 "int = ((phys * 100000) / 39063) - (0) %" RAT_FUNC "%4.3" "%" COEFFS 0 2.55996723242 0 0 0 1 /end COMPU_METHOD
/begin COMPU_METHOD SAB_0400PROZENT_S2_S3 "int = ((phys * 1000) / 400) - (0) %" RAT_FUNC "%4.3" "%" COEFFS 0 2.5 0 0 0 1 /end COMPU_METHOD
/begin COMPU_METHOD SAB_04883PROZENT100000_M127_S2_S3 "int = ((phys * 100000) / 4883) - (-127) -" RAT_FUNC "%4.3" "-" COEFFS 0 20.4792135982 127 0 0 1 /end COMPU_METHOD
/begin COMPU_METHOD SAB_04PROZENT_S2_S3 "int = ((phys * 10) / 4) - (0) %" RAT_FUNC "%4.3" "%" COEFFS 0 2.5 0 0 0 1 /end COMPU_METHOD
/begin COMPU_METHOD SAB_05PROZENT_S2_S3 "int = ((phys * 10) / 5) - (0) %" RAT_FUNC "%4.3" "%" COEFFS 0 2 0 0 0 1 /end COMPU_METHOD
/begin COMPU_METHOD SAB_0781PROZENT_S2_S3 "int = ((phys * 1000) / 781) - (0) %" RAT_FUNC "%4.3" "%" COEFFS 0 1.28040973111 0 0 0 1 /end COMPU_METHOD
/begin COMPU_METHOD SAB_100PROZENT125_M127_S2_S3 "int = ((phys * 125) / 100) - (-127) %" RAT_FUNC "%4.3" "%" COEFFS 0 1.25 127 0 0 1 /end COMPU_METHOD
/begin COMPU_METHOD SAB_100PROZENT200_S2_S3 "int = ((phys * 200) / 100) - (0) %" RAT_FUNC "%4.3" "%" COEFFS 0 2 0 0 0 1 /end COMPU_METHOD
/begin COMPU_METHOD SAB_100PROZENT2048_6201M1000_S2_S3 "int = ((phys * 2048) / 100) - (-127) %" RAT_FUNC "%4.3" "%" COEFFS 0 20.48 127 0 0 1 /end COMPU_METHOD
/begin COMPU_METHOD SAB_100PROZENT255_S2_S3 "int = ((phys * 255) / 100) - (0) %" RAT_FUNC "%4.3" "%" COEFFS 0 2.55 0 0 0 1 /end COMPU_METHOD
/begin COMPU_METHOD SAB_10MA_S2_S3 "int = ((phys * 10) / 1) - (0) mA" RAT_FUNC "%4.3" "mA" COEFFS 0 10 0 0 0 1 /end COMPU_METHOD
/begin COMPU_METHOD SAB_125PROZENT1000_S2_S3 "int = ((phys * 1000) / 125) - (0) %" RAT_FUNC "%4.3" "%" COEFFS 0 8 0 0 0 1 /end COMPU_METHOD
/begin COMPU_METHOD SAB_152587890625K10000000000000000_S2_S3 "int = ((phys * 1.0E16) / 1.52587890625E11) - (0) -" RAT_FUNC "%17.16" "-" COEFFS 0 65536 0 0 0 1 /end COMPU_METHOD
/begin COMPU_METHOD SAB_15PROZENT1000_1P10_S2_S3 "int = ((phys * 1000) / 15) - (7) %" RAT_FUNC "%4.3" "%" COEFFS 0 66.6666666667 -7 0 0 1 /end COMPU_METHOD
/begin COMPU_METHOD SAB_16PROZENT10_S2_S3 "int = ((phys * 10) / 16) - (0) %" RAT_FUNC "%4.3" "%" COEFFS 0 0.625 0 0 0 1 /end COMPU_METHOD
/begin COMPU_METHOD SAB_1G100_M127_S2_S3 "int = ((phys * 100) / 1) - (-127) g" RAT_FUNC "%4.3" "g" COEFFS 0 100 127 0 0 1 /end COMPU_METHOD
/begin COMPU_METHOD SAB_1PROZENT_M125_S2_S3 "int = ((phys * 1) / 1) - (-125) %" RAT_FUNC "%1.0" "%" COEFFS 0 1 125 0 0 1 /end COMPU_METHOD
/begin COMPU_METHOD SAB_1PROZENTG_M128_S2_S3 "int = ((phys * 1) / 1) - (-128) %" RAT_FUNC "%1.0" "%" COEFFS 0 1 128 0 0 1 /end COMPU_METHOD
/begin COMPU_METHOD SAB_249PROZENT1000_M127_S2_S3 "int = ((phys * 1000) / 249) - (-127) %" RAT_FUNC "%4.3" "%" COEFFS 0 4.01606425703 127 0 0 1 /end COMPU_METHOD
/begin COMPU_METHOD SAB_255PROZENT800_S2_S3 "int = ((phys * 255) / 800) - (0) %" RAT_FUNC "%4.3" "%" COEFFS 0 0.31875 0 0 0 1 /end COMPU_METHOD
/begin COMPU_METHOD SAB_25PROZENTPS_S2_S3 "int = ((phys * 1) / 25) - (0) %/s" RAT_FUNC "%4.3" "%/s" COEFFS 0 0.04 0 0 0 1 /end COMPU_METHOD
/begin COMPU_METHOD SAB_392157PROZENT1000000_S2_S3 "int = ((phys * 1.0E6) / 392157) - (0) %" RAT_FUNC "%4.3" "%" COEFFS 0 2.5499991075 0 0 0 1 /end COMPU_METHOD
/begin COMPU_METHOD SAB_39PROZENT100_S2_S3 "int = ((phys * 100) / 39) - (0) %" RAT_FUNC "%4.3" "%" COEFFS 0 2.5641025641 0 0 0 1 /end COMPU_METHOD
/begin COMPU_METHOD SAB_49K2000_S2_S3 "int = ((phys * 2000) / 49) - (0) -" RAT_FUNC "%4.3" "-" COEFFS 0 40.8163265306 0 0 0 1 /end COMPU_METHOD
/begin COMPU_METHOD SAB_49PROZENT125_S2_S3 "int = ((phys * 125) / 49) - (0) %" RAT_FUNC "%4.3" "%" COEFFS 0 2.55102040816 0 0 0 1 /end COMPU_METHOD
/begin COMPU_METHOD SAB_4PROZENT10_S2_S3 "int = ((phys * 10) / 4) - (0) %" RAT_FUNC "%4.3" "%" COEFFS 0 2.5 0 0 0 1 /end COMPU_METHOD
/begin COMPU_METHOD SAB_4PROZENT5_S2_S3 "int = ((phys * 5) / 4) - (0) %" RAT_FUNC "%4.3" "%" COEFFS 0 1.25 0 0 0 1 /end COMPU_METHOD
/begin COMPU_METHOD SAB_7874PROZENT10000_M100_S2_S3 "int = ((phys * 10000) / 7874) - (-128) %" RAT_FUNC "%4.3" "%" COEFFS 0 1.27000254001 128 0 0 1 /end COMPU_METHOD
/begin COMPU_METHOD SAB_7874PROZENT10000_M127_S2_S3 "int = ((phys * 10000) / 7874) - (-127) %" RAT_FUNC "%4.3" "%" COEFFS 0 1.27000254001 127 0 0 1 /end COMPU_METHOD
/begin COMPU_METHOD SAB_A_0024MPSS_M124_S2_S3 "int = ((phys * 1000) / 24) - (-124) m/s^2" RAT_FUNC "%4.3" "m/s^2" COEFFS 0 41.6666666667 124 0 0 1 /end COMPU_METHOD
/begin COMPU_METHOD SAB_A_00478MPSS_M24_S2_S3 "int = ((phys * 10000) / 478) - (-512) m/s^2" RAT_FUNC "%4.3" "m/s^2" COEFFS 0 20.9205020921 512 0 0 1 /end COMPU_METHOD
/begin COMPU_METHOD SAB_A_024MPSS1000_S2_S3 "int = ((phys * 1000) / 24) - (0) m/s^2" RAT_FUNC "%4.3" "m/s^2" COEFFS 0 41.6666666667 0 0 0 1 /end COMPU_METHOD
/begin COMPU_METHOD SAB_A_10G1000_M180_S2_S3 "int = ((phys * 1000) / 10) - (-180) g" RAT_FUNC "%4.3" "g" COEFFS 0 100 180 0 0 1 /end COMPU_METHOD
/begin COMPU_METHOD SAB_A_15G1000_M120_S2_S3 "int = ((phys * 1000) / 15) - (-120) g" RAT_FUNC "%4.3" "g" COEFFS 0 66.6666666667 120 0 0 1 /end COMPU_METHOD
/begin COMPU_METHOD SAB_A_1G100_M127_S2_S3 "int = ((phys * 100) / 1) - (-127) g" RAT_FUNC "%4.3" "g" COEFFS 0 100 127 0 0 1 /end COMPU_METHOD
/begin COMPU_METHOD SAB_A_1MPSS10_M11_S2_S3 "int = ((phys * 10) / 1) - (-110) m/s^2" RAT_FUNC "%4.3" "m/s^2" COEFFS 0 10 110 0 0 1 /end COMPU_METHOD
/begin COMPU_METHOD SAB_A_1MPSS200_M722_S2_S3 "int = ((phys * 200) / 1) - (-1444) m/s^2" RAT_FUNC "%4.3" "m/s^2" COEFFS 0 200 1444 0 0 1 /end COMPU_METHOD
/begin COMPU_METHOD SAB_A_1MPSS32_M16_S2_S3 "int = ((phys * 32) / 1) - (-512) m/s^2" RAT_FUNC "%4.3" "m/s^2" COEFFS 0 32 512 0 0 1 /end COMPU_METHOD
/begin COMPU_METHOD SBW_STANDARD_S1_S3 "int = ((phys * 1) / 1) - (0) -" RAT_FUNC "%1.0" "-" COEFFS 0 1 0 0 0 1 /end COMPU_METHOD
/begin COMPU_METHOD SBW_TIMER_10MS_S1_S3 "int = ((phys * 1) / 10) - (0) ms" RAT_FUNC "%1.0" "ms" COEFFS 0 0.1 0 0 0 1 /end COMPU_METHOD
/begin COMPU_METHOD UMR___1_1_0_S5_S3 "int = ((phys * 1) / 1) - (0) [-]" RAT_FUNC "%1.0" "[-]" COEFFS 0 1 0 0 0 1 /end COMPU_METHOD
/begin COMPU_METHOD UMR_GRADC__1_1_M40_S5_S3 "int = ((phys * 1) / 1) - (-40) [°C]" RAT_FUNC "%1.0" "[°C]" COEFFS 0 1 40 0 0 1 /end COMPU_METHOD
/begin COMPU_METHOD UMR_MBAR__1_1_0_S5_S3 "int = ((phys * 1) / 1) - (0) [mbar]" RAT_FUNC "%1.0" "[mbar]" COEFFS 0 1 0 0 0 1 /end COMPU_METHOD
/begin COMPU_METHOD UMR_MSEC__1_1_0_S5_S3 "int = ((phys * 1) / 1) - (0) [ms]" RAT_FUNC "%1.0" "[ms]" COEFFS 0 1 0 0 0 1 /end COMPU_METHOD
/begin COMPU_METHOD UMR_PROZENT__1_100_0_S5_S3 "int = ((phys * 100) / 1) - (0) [%]" RAT_FUNC "%3.2" "[%]" COEFFS 0 100 0 0 0 1 /end COMPU_METHOD
/begin MEASUREMENT MvG.AnzSchleppstart.Ctr "Statistics[1999 ... 2022]: MvG Anzahl der Schleppstarts [(x=8/UMR___1_1_0)]" UBYTE UMR___1_1_0_S5_S3 1 100 0 255 ECU_ADDRESS 0xFFF99FD7 DISPLAY_IDENTIFIER Ctr.AnzSchleppstart.MvG MATRIX_DIM 24 1 1 /end MEASUREMENT
/begin MEASUREMENT MvG.Betriebspunkt.Ctr "Statistics[58 ... 1353]: MvG Betriebspunkt [(z=9/UMR___1_1_0),(x=6/UMR_U_MIN_1_1_0),(y=8/UMR_NM__1_1_0)]" UBYTE UMR___1_1_0_S5_S3 1 100 0 255 ECU_ADDRESS 0xFFF99842 DISPLAY_IDENTIFIER Ctr.Betriebspunkt.MvG MATRIX_DIM 1296 1 1 /end MEASUREMENT
/begin MEASUREMENT MvG.GetrTemp.Ctr "Statistics[1354 ... 1377]: MvG Getriebe Temperatur [(x=8/UMR_GRADC__1_1_M40)]" UBYTE UMR___1_1_0_S5_S3 1 100 0 255 ECU_ADDRESS 0xFFF99D52 DISPLAY_IDENTIFIER Ctr.GetrTemp.MvG MATRIX_DIM 24 1 1 /end MEASUREMENT
/begin MEASUREMENT MvG.HisSpeicherLoesen.Ctr "Statistics[1378 ... 1401]: MvG HIS Speicher Loesen Temperatur [(x=8/UMR_GRADC__1_1_M40)]" UBYTE UMR___1_1_0_S5_S3 1 100 0 255 ECU_ADDRESS 0xFFF99D6A DISPLAY_IDENTIFIER Ctr.HisSpeicherLoesen.MvG MATRIX_DIM 24 1 1 /end MEASUREMENT
/begin MEASUREMENT MvG.IaeBelastung.Ctr "Statistics[1483 ... 1674]: MvG IAE Belastung [(x=8/UMR_U_MIN_1_1_0),(y=8/UMR_NM__1_1_0)]" UBYTE UMR___1_1_0_S5_S3 1 100 0 255 ECU_ADDRESS 0xFFF99DD3 DISPLAY_IDENTIFIER Ctr.IaeBelastung.MvG MATRIX_DIM 192 1 1 /end MEASUREMENT
/begin MEASUREMENT MvG.IaeTemp.Ctr "Statistics[1426 ... 1449]: MvG Iae Temperatur [(x=8/UMR_GRADC__1_1_M40)]" UBYTE UMR___1_1_0_S5_S3 1 100 0 255 ECU_ADDRESS 0xFFF99D9A DISPLAY_IDENTIFIER Ctr.IaeTemp.MvG MATRIX_DIM 24 1 1 /end MEASUREMENT
/begin MEASUREMENT MvG.IaeZustand.Ctr "Statistics[1474 ... 1482]: MvG Iae Zustand [(x=3/UMR___1_1_0)]" UBYTE UMR___1_1_0_S5_S3 1 100 0 255 ECU_ADDRESS 0xFFF99DCA DISPLAY_IDENTIFIER Ctr.IaeZustand.MvG MATRIX_DIM 9 1 1 /end MEASUREMENT
/begin MEASUREMENT MvG.IepBetriebsstunden.Ctr "Statistics[2023 ... 2034]: MvG Iep Betriebsstunden [(x=4/UMR___1_1_0)]" UBYTE UMR___1_1_0_S5_S3 1 100 0 255 ECU_ADDRESS 0xFFF99FEF DISPLAY_IDENTIFIER Ctr.IepBetriebsstunden.MvG MATRIX_DIM 12 1 1 /end MEASUREMENT
/begin MEASUREMENT MvG.K0BelagTemp.Ctr "Statistics[1450 ... 1473]: MvG K0 Belag Temperatur [(x=8/UMR_GRADC__1_1_M40)]" UBYTE UMR___1_1_0_S5_S3 1 100 0 255 ECU_ADDRESS 0xFFF99DB2 DISPLAY_IDENTIFIER Ctr.K0BelagTemp.MvG MATRIX_DIM 24 1 1 /end MEASUREMENT
/begin MEASUREMENT MvG.K0Belastung.Ctr "Statistics[1687 ... 1878]: MvG K0 Belastung [(x=8/UMR_U_MIN_1_1_0),(y=8/UMR_NM__1_1_0)]" UBYTE UMR___1_1_0_S5_S3 1 100 0 255 ECU_ADDRESS 0xFFF99E9F DISPLAY_IDENTIFIER Ctr.K0Belastung.MvG MATRIX_DIM 192 1 1 /end MEASUREMENT
/begin MEASUREMENT MvG.K0Zustand.Ctr "Statistics[1675 ... 1686]: MvG K0 Zustand [(x=4/UMR___1_1_0)]" UBYTE UMR___1_1_0_S5_S3 1 100 0 255 ECU_ADDRESS 0xFFF99E93 DISPLAY_IDENTIFIER Ctr.K0Zustand.MvG MATRIX_DIM 12 1 1 /end MEASUREMENT
/begin MEASUREMENT MvG.KflWechsel.Ctr "Statistics[2128 ... 2178]: MvG Kfl Wechsel [(x=17/UMR___1_1_0)]" UBYTE UMR___1_1_0_S5_S3 1 100 0 255 ECU_ADDRESS 0xFFF9A058 DISPLAY_IDENTIFIER Ctr.KflWechsel.MvG MATRIX_DIM 51 1 1 /end MEASUREMENT
/begin MEASUREMENT MvG.KupTemp.Ctr "Statistics[1879 ... 1998]: MvG Temperatur der Kupplungen [(y=5/UMR___1_1_0),(x=8/UMR_GRADC__1_1_0)]" UBYTE UMR___1_1_0_S5_S3 1 100 0 255 ECU_ADDRESS 0xFFF99F5F DISPLAY_IDENTIFIER Ctr.KupTemp.MvG MATRIX_DIM 120 1 1 /end MEASUREMENT
/begin MEASUREMENT MvG.MotorStartTemp.Ctr "Statistics[1402 ... 1425]: MvG Motor Start Temperatur [(x=8/UMR_GRADC__1_1_M40)]" UBYTE UMR___1_1_0_S5_S3 1 100 0 255 ECU_ADDRESS 0xFFF99D82 DISPLAY_IDENTIFIER Ctr.MotorStartTemp.MvG MATRIX_DIM 24 1 1 /end MEASUREMENT
/begin MEASUREMENT MvG.Schaltungen.Ctr "Statistics[2035 ... 2127]: MvG Schaltungen [(x=31/UMR___1_1_0)]" UBYTE UMR___1_1_0_S5_S3 1 100 0 255 ECU_ADDRESS 0xFFF99FFB DISPLAY_IDENTIFIER Ctr.Schaltungen.MvG MATRIX_DIM 93 1 1 /end MEASUREMENT
/begin MEASUREMENT N_AB "" UWORD _CNV_R_R_Umr_1_zu_1_3_CM_S2 1 0 0 20000 ECU_ADDRESS 0xFFF8E6CE FORMAT "%2.0" /end MEASUREMENT
/begin MEASUREMENT N_ABRAD "" UWORD _CNV_R_R_Umr_1_zu_1_3_CM_S2 1 0 0 20000 ECU_ADDRESS 0xFFF8E48A FORMAT "%2.0" /end MEASUREMENT
/begin MEASUREMENT N_AB_ALT "" UWORD _CNV_R_R_Umr_1_zu_1_3_CM_S2 1 0 0 20000 ECU_ADDRESS 0xFFF8E3DA FORMAT "%2.0" /end MEASUREMENT
/begin MEASUREMENT N_AB_ARSSTD[0] "" SWORD _CNV_R_R_Umr_1_zu_1_3_CM_S2 1 0 -32768 32767 ECU_ADDRESS 0xFFF8E23E FORMAT "%2.0" /end MEASUREMENT
/begin MEASUREMENT N_AB_ARSSTD[1] "" SWORD _CNV_R_R_Umr_1_zu_1_3_CM_S2 1 0 -32768 32767 ECU_ADDRESS 0xFFF8E240 FORMAT "%2.0" /end MEASUREMENT
/begin MEASUREMENT N_AB_ARSSTD[2] "" SWORD _CNV_R_R_Umr_1_zu_1_3_CM_S2 1 0 -32768 32767 ECU_ADDRESS 0xFFF8E242 FORMAT "%2.0" /end MEASUREMENT
/begin MEASUREMENT N_AB_ARSSTD[3] "" SWORD _CNV_R_R_Umr_1_zu_1_3_CM_S2 1 0 -32768 32767 ECU_ADDRESS 0xFFF8E244 FORMAT "%2.0" /end MEASUREMENT
/begin MEASUREMENT N_AB_ARSSTD[4] "" SWORD _CNV_R_R_Umr_1_zu_1_3_CM_S2 1 0 -32768 32767 ECU_ADDRESS 0xFFF8E246 FORMAT "%2.0" /end MEASUREMENT
/begin MEASUREMENT N_AB_ARSSTD[5] "" SWORD _CNV_R_R_Umr_1_zu_1_3_CM_S2 1 0 -32768 32767 ECU_ADDRESS 0xFFF8E248 FORMAT "%2.0" /end MEASUREMENT
/begin MEASUREMENT N_AB_ARSSTD[6] "" SWORD _CNV_R_R_Umr_1_zu_1_3_CM_S2 1 0 -32768 32767 ECU_ADDRESS 0xFFF8E24A FORMAT "%2.0" /end MEASUREMENT
/begin MEASUREMENT N_AB_ARSSTD[7] "" SWORD _CNV_R_R_Umr_1_zu_1_3_CM_S2 1 0 -32768 32767 ECU_ADDRESS 0xFFF8E24C FORMAT "%2.0" /end MEASUREMENT
/begin MEASUREMENT N_AB_ARSSTD[8] "" SWORD _CNV_R_R_Umr_1_zu_1_3_CM_S2 1 0 -32768 32767 ECU_ADDRESS 0xFFF8E24E FORMAT "%2.0" /end MEASUREMENT
/begin MEASUREMENT N_AB_ARSSTD_DBM[0] "" SWORD _CNV_R_R_Umr_1_zu_1_3_CM_S2 1 0 -32768 32767 ECU_ADDRESS 0xFFF8E250 FORMAT "%2.0" /end MEASUREMENT
/begin MEASUREMENT N_AB_ARSSTD_DBM[1] "" SWORD _CNV_R_R_Umr_1_zu_1_3_CM_S2 1 0 -32768 32767 ECU_ADDRESS 0xFFF8E252 FORMAT "%2.0" /end MEASUREMENT
/begin MEASUREMENT N_AB_ARSSTD_DBM[2] "" SWORD _CNV_R_R_Umr_1_zu_1_3_CM_S2 1 0 -32768 32767 ECU_ADDRESS 0xFFF8E254 FORMAT "%2.0" /end MEASUREMENT
/begin MEASUREMENT N_AB_ARSSTD_DBM[3] "" SWORD _CNV_R_R_Umr_1_zu_1_3_CM_S2 1 0 -32768 32767 ECU_ADDRESS 0xFFF8E256 FORMAT "%2.0" /end MEASUREMENT
/begin MEASUREMENT N_AB_ARSSTD_DBM[4] "" SWORD _CNV_R_R_Umr_1_zu_1_3_CM_S2 1 0 -32768 32767 ECU_ADDRESS 0xFFF8E258 FORMAT "%2.0" /end MEASUREMENT
/begin MEASUREMENT N_AB_ARSSTD_DBM[5] "" SWORD _CNV_R_R_Umr_1_zu_1_3_CM_S2 1 0 -32768 32767 ECU_ADDRESS 0xFFF8E25A FORMAT "%2.0" /end MEASUREMENT
/begin MEASUREMENT N_AB_ARSSTD_DBM[6] "" SWORD _CNV_R_R_Umr_1_zu_1_3_CM_S2 1 0 -32768 32767 ECU_ADDRESS 0xFFF8E25C FORMAT "%2.0" /end MEASUREMENT
/begin MEASUREMENT N_AB_ARSSTD_DBM[7] "" SWORD _CNV_R_R_Umr_1_zu_1_3_CM_S2 1 0 -32768 32767 ECU_ADDRESS 0xFFF8E25E FORMAT "%2.0" /end MEASUREMENT
/begin MEASUREMENT N_AB_ARSSTD_DBM[8] "" SWORD _CNV_R_R_Umr_1_zu_1_3_CM_S2 1 0 -32768 32767 ECU_ADDRESS 0xFFF8E260 FORMAT "%2.0" /end MEASUREMENT
/begin MEASUREMENT N_AB_ARSSTD_EXKL[0] "" SWORD _CNV_R_R_Umr_1_zu_1_3_CM_S2 1 0 -32768 32767 ECU_ADDRESS 0xFFF8E262 FORMAT "%2.0" /end MEASUREMENT
/begin MEASUREMENT N_AB_ARSSTD_EXKL[1] "" SWORD _CNV_R_R_Umr_1_zu_1_3_CM_S2 1 0 -32768 32767 ECU_ADDRESS 0xFFF8E264 FORMAT "%2.0" /end MEASUREMENT
/begin MEASUREMENT N_AB_ARSSTD_EXKL[2] "" SWORD _CNV_R_R_Umr_1_zu_1_3_CM_S2 1 0 -32768 32767 ECU_ADDRESS 0xFFF8E266 FORMAT "%2.0" /end MEASUREMENT
/begin MEASUREMENT N_AB_ARSSTD_EXKL[3] "" SWORD _CNV_R_R_Umr_1_zu_1_3_CM_S2 1 0 -32768 32767 ECU_ADDRESS 0xFFF8E268 FORMAT "%2.0" /end MEASUREMENT
/begin MEASUREMENT N_AB_ARSSTD_EXKL[4] "" SWORD _CNV_R_R_Umr_1_zu_1_3_CM_S2 1 0 -32768 32767 ECU_ADDRESS 0xFFF8E26A FORMAT "%2.0" /end MEASUREMENT
/begin MEASUREMENT N_AB_ARSSTD_EXKL[5] "" SWORD _CNV_R_R_Umr_1_zu_1_3_CM_S2 1 0 -32768 32767 ECU_ADDRESS 0xFFF8E26C FORMAT "%2.0" /end MEASUREMENT
/begin MEASUREMENT N_AB_ARSSTD_EXKL[6] "" SWORD _CNV_R_R_Umr_1_zu_1_3_CM_S2 1 0 -32768 32767 ECU_ADDRESS 0xFFF8E26E FORMAT "%2.0" /end MEASUREMENT
/begin MEASUREMENT N_AB_ARSSTD_EXKL[7] "" SWORD _CNV_R_R_Umr_1_zu_1_3_CM_S2 1 0 -32768 32767 ECU_ADDRESS 0xFFF8E270 FORMAT "%2.0" /end MEASUREMENT
/begin MEASUREMENT N_AB_ARSSTD_EXKL[8] "" SWORD _CNV_R_R_Umr_1_zu_1_3_CM_S2 1 0 -32768 32767 ECU_ADDRESS 0xFFF8E272 FORMAT "%2.0" /end MEASUREMENT
/begin MEASUREMENT N_AB_BUFFER "" UWORD _CNV_R_R_Umr_1_zu_1_3_CM_S2 1 0 0 20000 ECU_ADDRESS 0xFFF8EF64 FORMAT "%2.0" MATRIX_DIM 10 1 1 /end MEASUREMENT
/begin MEASUREMENT N_AB_DELTANMOTHS "" UWORD _CNV_R_R_Umr_1_zu_1_3_CM_S2 1 0 0 20000 ECU_ADDRESS 0xFFF8E3FA FORMAT "%2.0" /end MEASUREMENT
/begin MEASUREMENT N_AB_FILT "" UWORD _CNV_R_R_Umr_1_zu_1_3_CM_S2 1 0 0 20000 ECU_ADDRESS 0xFFF8E5AE FORMAT "%2.0" /end MEASUREMENT
/begin MEASUREMENT N_AB_FILTREST "" UWORD _CNV_R_R_Umr_1_zu_1_3_CM_S2 1 0 0 65535 ECU_ADDRESS 0xFFF8E5B0 FORMAT "%2.0" /end MEASUREMENT
/begin MEASUREMENT N_AB_HSZIELKD_DBM "" UWORD _CNV_R_R_Umr_1_zu_1_3_CM_S2 1 0 0 20000 ECU_ADDRESS 0xFFF8E2D0 FORMAT "%2.0" /end MEASUREMENT
/begin MEASUREMENT N_AB_HSZIEL_DBM "" UWORD _CNV_R_R_Umr_1_zu_1_3_CM_S2 1 0 0 20000 ECU_ADDRESS 0xFFF8E2D2 FORMAT "%2.0" /end MEASUREMENT
/begin MEASUREMENT N_AB_REFBAB "" UWORD _CNV_R_R_Umr_1_zu_1_3_CM_S2 1 0 0 20000 ECU_ADDRESS 0xFFF8E42C FORMAT "%2.0" /end MEASUREMENT
/begin MEASUREMENT N_AB_REST "" UWORD _CNV_R_R_Umr_1_zu_1_3_CM_S2 1 0 0 65535 ECU_ADDRESS 0xFFF8E3F4 FORMAT "%2.0" /end MEASUREMENT
/begin MEASUREMENT N_AB_ROH "" UWORD _CNV_R_R_Umr_1_zu_1_3_CM_S2 1 0 0 20000 ECU_ADDRESS 0xFFF8E39E FORMAT "%2.0" /end MEASUREMENT
/begin MEASUREMENT N_AB_RSZIELKD_DBM "" UWORD _CNV_R_R_Umr_1_zu_1_3_CM_S2 1 0 0 20000 ECU_ADDRESS 0xFFF8E2D4 FORMAT "%2.0" /end MEASUREMENT
/begin MEASUREMENT N_AB_RSZIEL_DBM "" UWORD _CNV_R_R_Umr_1_zu_1_3_CM_S2 1 0 0 20000 ECU_ADDRESS 0xFFF8E2D6 FORMAT "%2.0" /end MEASUREMENT
/begin MEASUREMENT N_AB_SHIFTNMOTHS "" UWORD _CNV_R_R_Umr_1_zu_1_3_CM_S2 1 0 0 20000 ECU_ADDRESS 0xFFF8E3FC FORMAT "%2.0" /end MEASUREMENT
/begin MEASUREMENT N_AB_UNFILT "" UWORD _CNV_R_R_Umr_1_zu_1_3_CM_S2 1 0 0 20000 ECU_ADDRESS 0xFFF8E6D0 FORMAT "%2.0" /end MEASUREMENT
/begin MEASUREMENT N_AB_UNFILT_ALT "" UWORD _CNV_R_R_Umr_1_zu_1_3_CM_S2 1 0 0 20000 ECU_ADDRESS 0xFFF8E3DC FORMAT "%2.0" /end MEASUREMENT
/begin MEASUREMENT N_AB_VIRT "" UWORD _CNV_R_R_Umr_1_zu_1_3_CM_S2 1 0 0 20000 ECU_ADDRESS 0xFFF8E3FE FORMAT "%2.0" /end MEASUREMENT
/begin MEASUREMENT N_AKT_MAX_DBM "" SWORD _CNV_R_R_Umr_1_zu_1_3_CM_S2 1 0 -32768 32767 ECU_ADDRESS 0xFFF8E2D8 FORMAT "%2.0" /end MEASUREMENT
/begin MEASUREMENT N_AKT_MIN_DBM "" SWORD _CNV_R_R_Umr_1_zu_1_3_CM_S2 1 0 -32768 32767 ECU_ADDRESS 0xFFF8E2DA FORMAT "%2.0" /end MEASUREMENT
/begin MEASUREMENT N_DELTA_ZIEL_DBG "" SLONG _CNV_R_R_Umr_10_zu__133_CM_S2 1 0 -10000 10000 ECU_ADDRESS 0xFFF8F2E4 FORMAT "%3.1" /end MEASUREMENT
/begin MEASUREMENT N_DSPV_DBM "" SWORD _CNV_R_R_Umr_1_zu_1_3_CM_S2 1 0 -32768 32767 ECU_ADDRESS 0xFFF8E2DC MATRIX_DIM 9 1 1 /end MEASUREMENT
/begin MEASUREMENT N_DYNDZM "" UWORD _CNV_R_R_Umr_1_zu_1_3_CM_S2 1 0 0 10000 ECU_ADDRESS 0xFFF8E4A8 FORMAT "%2.0" /end MEASUREMENT
/begin MEASUREMENT N_DYNDZM_ANGLEICH_UMSCHALT "" ULONG _CNV_R_R_Umr_10_zu__133_CM_S2 1 0 0 10000 ECU_ADDRESS 0xFFF8EE70 FORMAT "%3.1" /end MEASUREMENT
/begin MEASUREMENT N_DYNDZM_ANGL_PHASE1 "" ULONG _CNV_R_R_Umr_10_zu__133_CM_S2 1 0 0 10000 ECU_ADDRESS 0xFFF8EE74 FORMAT "%3.1" /end MEASUREMENT
/begin MEASUREMENT N_DYNDZM_BER "" ULONG _CNV_R_R_Umr_10_zu__133_CM_S2 1 0 0 10000 ECU_ADDRESS 0xFFF8EE78 FORMAT "%3.1" /end MEASUREMENT
/begin MEASUREMENT N_DYNDZM_BER_FILT "" ULONG _CNV_R_R_Umr_10_zu__133_CM_S2 1 0 0 10000 ECU_ADDRESS 0xFFF8EE7C FORMAT "%3.1" /end MEASUREMENT
/begin MEASUREMENT N_DYNDZM_EFAHREN "" ULONG _CNV_R_R_Umr_10_zu__133_CM_S2 1 0 0 10000 ECU_ADDRESS 0xFFF8F2EC FORMAT "%3.1" /end MEASUREMENT
/begin MEASUREMENT N_DYNDZM_LASTWEFILT_BER "" ULONG _CNV_R_R_Umr_10_zu__133_CM_S2 1 0 0 40000000 ECU_ADDRESS 0xFFF8EE80 FORMAT "%3.1" /end MEASUREMENT
/begin MEASUREMENT N_DYNDZM_NAB_PHASE5 "" ULONG _CNV_R_R_Umr_10_zu__133_CM_S2 1 0 0 10000 ECU_ADDRESS 0xFFF8EE84 FORMAT "%3.1" /end MEASUREMENT
/begin MEASUREMENT N_DYNDZM_PHASE6_7 "" ULONG _CNV_R_R_Umr_10_zu__133_CM_S2 1 0 0 10000 ECU_ADDRESS 0xFFF8F2F0 FORMAT "%3.1" /end MEASUREMENT
/begin MEASUREMENT N_DYNDZM_SS "" UWORD _CNV_R_R_Umr_1_zu_1_3_CM_S2 1 0 0 10000 ECU_ADDRESS 0xFFF8E3D0 FORMAT "%2.0" /end MEASUREMENT
/begin MEASUREMENT N_DYNDZM_ZIEL_PHASE4 "" ULONG _CNV_R_R_Umr_10_zu__133_CM_S2 1 0 0 10000 ECU_ADDRESS 0xFFF8EE88 FORMAT "%3.1" /end MEASUREMENT
/begin MEASUREMENT N_EIN_IST "" UWORD _CNV_R_R_Umr_1_zu_1_3_CM_S2 1 0 0 20000 ECU_ADDRESS 0xFFF8E358 FORMAT "%2.0" /end MEASUREMENT
/begin MEASUREMENT N_EIN_START "" UWORD _CNV_R_R_Umr_1_zu_1_3_CM_S2 1 0 0 20000 ECU_ADDRESS 0xFFF8E35A FORMAT "%2.0" /end MEASUREMENT
/begin MEASUREMENT N_EIN_ZIEL "" UWORD _CNV_R_R_Umr_1_zu_1_3_CM_S2 1 0 0 20000 ECU_ADDRESS 0xFFF8E35C FORMAT "%2.0" /end MEASUREMENT
/begin MEASUREMENT N_EM "" SWORD _CNV_R_R_Umr_1_zu_1_3_CM_S2 1 0 -5000 27767 ECU_ADDRESS 0xFFF8E6A4 FORMAT "%2.0" /end MEASUREMENT
/begin MEASUREMENT N_EMBUFFER "" SWORD _CNV_R_R_Umr_1_zu_1_3_CM_S2 1 0 -20000 20000 ECU_ADDRESS 0xFFF8EF7C FORMAT "%2.0" MATRIX_DIM 2 1 1 /end MEASUREMENT
/begin MEASUREMENT N_EM_ROH "" UWORD _CNV_R_R_Umr_1_zu_1_3_CM_S2 1 0 0 32767 ECU_ADDRESS 0xFFF8E38A FORMAT "%2.0" /end MEASUREMENT
/begin MEASUREMENT N_GETR_EINGANG "" UWORD _CNV_R_R_Umr_1_zu_1_2_CM_S2 1 0 0 32767 ECU_ADDRESS 0xFFF8E48C FORMAT "%2.0" MATRIX_DIM 9 1 1 /end MEASUREMENT
/begin MEASUREMENT N_GETR_EINGANG_VIRT "" UWORD _CNV_R_R_Umr_1_zu_1_3_CM_S2 1 0 0 20000 ECU_ADDRESS 0xFFF8E3E2 FORMAT "%2.0" /end MEASUREMENT
/begin MEASUREMENT N_GETR_EINGANG_ZIEL "" UWORD _CNV_R_R_Umr_1_zu_1_3_CM_S2 1 0 0 20000 ECU_ADDRESS 0xFFF8E49E FORMAT "%2.0" /end MEASUREMENT
/begin MEASUREMENT N_GE_NAB_ZIELGANG "" UWORD _CNV_R_R_Umr_1_zu_1_3_CM_S2 1 0 0 10000 ECU_ADDRESS 0xFFF8E5FE FORMAT "%2.0" /end MEASUREMENT
/begin MEASUREMENT N_HS_MIN_STEPS "" UWORD _CNV_R_R_Umr_1_zu_1_3_CM_S2 1 0 0 20000 ECU_ADDRESS 0xFFF8E3E4 FORMAT "%2.0" /end MEASUREMENT
/begin MEASUREMENT N_MOT "" UWORD _CNV_R_R_Umr_1_zu_1_3_CM_S2 1 0 0 20000 ECU_ADDRESS 0xFFF8E6D2 FORMAT "%2.0" /end MEASUREMENT
/begin MEASUREMENT N_MOTBUFFER "" UWORD _CNV_R_R_Umr_1_zu_1_3_CM_S2 1 0 0 20000 ECU_ADDRESS 0xFFF8EF80 FORMAT "%2.0" MATRIX_DIM 2 1 1 /end MEASUREMENT
/begin MEASUREMENT N_MOTNACHHS_HSUREHS "" UWORD _CNV_R_R_Umr_1_zu_1_3_CM_S2 1 0 0 20000 ECU_ADDRESS 0xFFF8E658 FORMAT "%2.0" /end MEASUREMENT
/begin MEASUREMENT N_MOT_ABREGEL "" UWORD _CNV_R_R_Umr_1_zu_1_3_CM_S2 1 0 0 10000 ECU_ADDRESS 0xFFF8E6D4 FORMAT "%2.0" /end MEASUREMENT
/begin MEASUREMENT N_MOT_ABREGEL_ROH "" UWORD _CNV_R_R_Umr_1_zu_1_3_CM_S2 1 0 0 10000 ECU_ADDRESS 0xFFF8E3A0 FORMAT "%2.0" /end MEASUREMENT
/begin MEASUREMENT N_MOT_ALT "" UWORD _CNV_R_R_Umr_1_zu_1_3_CM_S2 1 0 0 20000 ECU_ADDRESS 0xFFF8E3DE FORMAT "%2.0" /end MEASUREMENT
/begin MEASUREMENT N_MOT_ANZEIGE "" UWORD _CNV_R_R_Umr_1_zu_1_3_CM_S2 1 0 0 20000 ECU_ADDRESS 0xFFF8E35E FORMAT "%2.0" /end MEASUREMENT
/begin MEASUREMENT N_MOT_BEGR "" UWORD _CNV_R_R_Umr_1_zu_1_3_CM_S2 1 0 0 10000 ECU_ADDRESS 0xFFF8E6D6 FORMAT "%2.0" /end MEASUREMENT
/begin MEASUREMENT N_MOT_DYNDZM "" ULONG _CNV_R_R_Umr_10_zu__133_CM_S2 1 0 0 10000 ECU_ADDRESS 0xFFF8EE8C FORMAT "%3.1" /end MEASUREMENT
/begin MEASUREMENT N_MOT_DYNHSPV "" UWORD _CNV_R_R_Umr_1_zu_1_3_CM_S2 1 0 0 65535 ECU_ADDRESS 0xFFF8E754 FORMAT "%2.0" /end MEASUREMENT
/begin MEASUREMENT N_MOT_DYNHSPV_OffSET "" UWORD _CNV_R_R_Umr_1_zu_1_3_CM_S2 1 0 0 65535 ECU_ADDRESS 0xFFF8E756 FORMAT "%2.0" /end MEASUREMENT
/begin MEASUREMENT N_MOT_EINFRS "" UWORD _CNV_R_R_Umr_1_zu_1_3_CM_S2 1 0 0 20000 ECU_ADDRESS 0xFFF8E856 FORMAT "%2.0" /end MEASUREMENT
/begin MEASUREMENT N_MOT_HSURE "" UWORD _CNV_R_R_Umr_1_zu_1_3_CM_S2 1 0 0 65535 ECU_ADDRESS 0xFFF8E634 FORMAT "%2.0" /end MEASUREMENT
/begin MEASUREMENT N_MOT_HSVIRT "" UWORD _CNV_R_R_Umr_1_zu_1_3_CM_S2 1 0 0 20000 ECU_ADDRESS 0xFFF8E758 FORMAT "%2.0" /end MEASUREMENT
/begin MEASUREMENT N_MOT_HSVIRT_DYN "" SLONG _CNV_R_R_Umr_1_zu_1_3_CM_S2 1 0 -2147483648 2147483647 ECU_ADDRESS 0xFFF8F180 FORMAT "%2.0" /end MEASUREMENT
/begin MEASUREMENT N_MOT_HSVIRT_STAT "" UWORD _CNV_R_R_Umr_1_zu_1_3_CM_S2 1 0 0 20000 ECU_ADDRESS 0xFFF8E75A FORMAT "%2.0" /end MEASUREMENT
/begin MEASUREMENT N_MOT_HSZIEL "" UWORD _CNV_R_R_Umr_1_zu_1_3_CM_S2 1 0 0 20000 ECU_ADDRESS 0xFFF8E764 FORMAT "%2.0" /end MEASUREMENT
/begin MEASUREMENT N_MOT_HSZIELKD "" UWORD _CNV_R_R_Umr_1_zu_1_3_CM_S2 1 0 0 20000 ECU_ADDRESS 0xFFF8E766 FORMAT "%2.0" /end MEASUREMENT
/begin MEASUREMENT N_MOT_HSZIELKD_DBM "" UWORD _CNV_R_R_Umr_1_zu_1_3_CM_S2 1 0 0 20000 ECU_ADDRESS 0xFFF8E2EE FORMAT "%2.0" /end MEASUREMENT
/begin MEASUREMENT N_MOT_HSZIEL_DBM "" UWORD _CNV_R_R_Umr_1_zu_1_3_CM_S2 1 0 0 20000 ECU_ADDRESS 0xFFF8E2F0 FORMAT "%2.0" /end MEASUREMENT
/begin MEASUREMENT N_MOT_MFRSZ "" UWORD _CNV_R_R_Umr_1_zu_1_3_CM_S2 1 0 0 20000 ECU_ADDRESS 0xFFF8E858 FORMAT "%2.0" /end MEASUREMENT
/begin MEASUREMENT N_MOT_NACHDMRS "" UWORD _CNV_R_R_Umr_1_zu_1_3_CM_S2 1 0 0 20000 ECU_ADDRESS 0xFFF8E480 FORMAT "%2.0" /end MEASUREMENT
/begin MEASUREMENT N_MOT_NACHHS_HDC "" UWORD _CNV_R_R_Umr_1_zu_1_3_CM_S2 1 0 0 20000 ECU_ADDRESS 0xFFF8E5F2 FORMAT "%2.0" /end MEASUREMENT
/begin MEASUREMENT N_MOT_NACHRS_HDC "" UWORD _CNV_R_R_Umr_1_zu_1_3_CM_S2 1 0 0 20000 ECU_ADDRESS 0xFFF8E5F4 FORMAT "%2.0" /end MEASUREMENT
/begin MEASUREMENT N_MOT_RSZIEL "" UWORD _CNV_R_R_Umr_1_zu_1_3_CM_S2 1 0 0 20000 ECU_ADDRESS 0xFFF8E768 FORMAT "%2.0" /end MEASUREMENT
/begin MEASUREMENT N_MOT_RSZIELKD "" UWORD _CNV_R_R_Umr_1_zu_1_3_CM_S2 1 0 0 20000 ECU_ADDRESS 0xFFF8E76A FORMAT "%2.0" /end MEASUREMENT
/begin MEASUREMENT N_MOT_RSZIELKD_DBM "" UWORD _CNV_R_R_Umr_1_zu_1_3_CM_S2 1 0 0 20000 ECU_ADDRESS 0xFFF8E2F2 FORMAT "%2.0" /end MEASUREMENT
/begin MEASUREMENT N_MOT_RSZIEL_DBM "" UWORD _CNV_R_R_Umr_1_zu_1_3_CM_S2 1 0 0 20000 ECU_ADDRESS 0xFFF8E2F4 FORMAT "%2.0" /end MEASUREMENT
/begin MEASUREMENT N_MOT_SOLLLL "" UWORD _CNV_R_R_Umr_1_zu_1_3_CM_S2 1 0 0 3000 ECU_ADDRESS 0xFFF8E6D8 FORMAT "%2.0" /end MEASUREMENT
/begin MEASUREMENT N_MOT_SOLLLL_DBM "" UWORD _CNV_R_R_Umr_1_zu_1_3_CM_S2 1 0 0 3000 ECU_ADDRESS 0xFFF8E2F6 FORMAT "%2.0" /end MEASUREMENT
/begin MEASUREMENT N_MOT_SOLLLL_ROH "" UWORD _CNV_R_R_Umr_1_zu_1_2_CM_S2 1 0 0 65535 ECU_ADDRESS 0xFFF8E3A2 /end MEASUREMENT
/begin MEASUREMENT N_MOT_SOLLLL_STEPTR "" UWORD _CNV_R_R_Umr_1_zu_1_3_CM_S2 1 0 0 3000 ECU_ADDRESS 0xFFF8E3E6 FORMAT "%2.0" /end MEASUREMENT
/begin MEASUREMENT N_MT "" UWORD _CNV_R_R_Umr_1_zu_1_3_CM_S2 1 0 0 20000 ECU_ADDRESS 0xFFF8E75C FORMAT "%2.0" /end MEASUREMENT
/begin MEASUREMENT N_MT_ALT "" UWORD _CNV_R_R_Umr_1_zu_1_3_CM_S2 1 0 0 20000 ECU_ADDRESS 0xFFF8E75E FORMAT "%2.0" /end MEASUREMENT
/begin MEASUREMENT N_RAD_HL "" UWORD _CNV_R_R_Umr_1_zu_1_3_CM_S2 1 0 0 20000 ECU_ADDRESS 0xFFF8E7B0 FORMAT "%2.0" /end MEASUREMENT
/begin MEASUREMENT N_RAD_HR "" UWORD _CNV_R_R_Umr_1_zu_1_3_CM_S2 1 0 0 20000 ECU_ADDRESS 0xFFF8E7B2 FORMAT "%2.0" /end MEASUREMENT
/begin MEASUREMENT N_RAD_VL "" UWORD _CNV_R_R_Umr_1_zu_1_3_CM_S2 1 0 0 20000 ECU_ADDRESS 0xFFF8E7B4 FORMAT "%2.0" /end MEASUREMENT
/begin MEASUREMENT N_RAD_VR "" UWORD _CNV_R_R_Umr_1_zu_1_3_CM_S2 1 0 0 20000 ECU_ADDRESS 0xFFF8E7B6 FORMAT "%2.0" /end MEASUREMENT
/begin MEASUREMENT N_RATIO_ANZEIGE "" SWORD _CNV_R_R_Umr_100_zu_42_CM_S2 1 0 -10 10 ECU_ADDRESS 0xFFF8E360 FORMAT "%4.2" /end MEASUREMENT
/begin MEASUREMENT N_RELATION_VAHA "" UWORD _CNV_R_R_Umr_100_zu_42_CM_S2 1 0 0 1 ECU_ADDRESS 0xFFF8E7B8 FORMAT "%4.2" /end MEASUREMENT
/begin MEASUREMENT N_RS_STPTR "" UWORD _CNV_R_R_Umr_1_zu_1_3_CM_S2 1 0 0 20000 ECU_ADDRESS 0xFFF8E3E8 FORMAT "%2.0" /end MEASUREMENT
/begin MEASUREMENT N_STABI_DBM "" SWORD _CNV_R_R_Umr_1_zu_1_3_CM_S2 1 0 -32768 32767 ECU_ADDRESS 0xFFF866F8 FORMAT "%2.0" MATRIX_DIM 9 1 1 /end MEASUREMENT
/begin MEASUREMENT N_T "" UWORD _CNV_R_R_Umr_1_zu_1_3_CM_S2 1 0 0 20000 ECU_ADDRESS 0xFFF8E6DA FORMAT "%2.0" /end MEASUREMENT
/begin MEASUREMENT N_TMIN_ARSDYN_DBM[0] "" SWORD _CNV_R_R_Umr_1_zu_1_3_CM_S2 1 0 -32768 32767 ECU_ADDRESS 0xFFF8E274 FORMAT "%2.0" /end MEASUREMENT
/begin MEASUREMENT N_TMIN_ARSDYN_DBM[1] "" SWORD _CNV_R_R_Umr_1_zu_1_3_CM_S2 1 0 -32768 32767 ECU_ADDRESS 0xFFF8E276 FORMAT "%2.0" /end MEASUREMENT
/begin MEASUREMENT N_TMIN_ARSDYN_DBM[2] "" SWORD _CNV_R_R_Umr_1_zu_1_3_CM_S2 1 0 -32768 32767 ECU_ADDRESS 0xFFF8E278 FORMAT "%2.0" /end MEASUREMENT
/begin MEASUREMENT N_TMIN_ARSDYN_DBM[3] "" SWORD _CNV_R_R_Umr_1_zu_1_3_CM_S2 1 0 -32768 32767 ECU_ADDRESS 0xFFF8E27A FORMAT "%2.0" /end MEASUREMENT
/begin MEASUREMENT N_TMIN_ARSDYN_DBM[4] "" SWORD _CNV_R_R_Umr_1_zu_1_3_CM_S2 1 0 -32768 32767 ECU_ADDRESS 0xFFF8E27C FORMAT "%2.0" /end MEASUREMENT
/begin MEASUREMENT N_TMIN_ARSDYN_DBM[5] "" SWORD _CNV_R_R_Umr_1_zu_1_3_CM_S2 1 0 -32768 32767 ECU_ADDRESS 0xFFF8E27E FORMAT "%2.0" /end MEASUREMENT
/begin MEASUREMENT N_TMIN_ARSDYN_DBM[6] "" SWORD _CNV_R_R_Umr_1_zu_1_3_CM_S2 1 0 -32768 32767 ECU_ADDRESS 0xFFF8E280 FORMAT "%2.0" /end MEASUREMENT
/begin MEASUREMENT N_TMIN_ARSDYN_DBM[7] "" SWORD _CNV_R_R_Umr_1_zu_1_3_CM_S2 1 0 -32768 32767 ECU_ADDRESS 0xFFF8E282 FORMAT "%2.0" /end MEASUREMENT
/begin MEASUREMENT N_TMIN_ARSDYN_DBM[8] "" SWORD _CNV_R_R_Umr_1_zu_1_3_CM_S2 1 0 -32768 32767 ECU_ADDRESS 0xFFF8E284 FORMAT "%2.0" /end MEASUREMENT
/begin MEASUREMENT N_TRAD "" UWORD _CNV_R_R_Umr_1_zu_1_3_CM_S2 1 0 0 20000 ECU_ADDRESS 0xFFF8E4A0 FORMAT "%2.0" /end MEASUREMENT
/begin MEASUREMENT N_TRAD_ALT "" UWORD _CNV_R_R_Umr_1_zu_1_3_CM_S2 1 0 0 20000 ECU_ADDRESS 0xFFF8E760 FORMAT "%2.0" /end MEASUREMENT
/begin MEASUREMENT N_T_ARSSTD[0] "" SWORD _CNV_R_R_Umr_1_zu_1_3_CM_S2 1 0 -32768 32767 ECU_ADDRESS 0xFFF8E286 FORMAT "%2.0" /end MEASUREMENT
/begin MEASUREMENT N_T_ARSSTD[1] "" SWORD _CNV_R_R_Umr_1_zu_1_3_CM_S2 1 0 -32768 32767 ECU_ADDRESS 0xFFF8E288 FORMAT "%2.0" /end MEASUREMENT
/begin MEASUREMENT N_T_ARSSTD[2] "" SWORD _CNV_R_R_Umr_1_zu_1_3_CM_S2 1 0 -32768 32767 ECU_ADDRESS 0xFFF8E28A FORMAT "%2.0" /end MEASUREMENT
/begin MEASUREMENT N_T_ARSSTD[3] "" SWORD _CNV_R_R_Umr_1_zu_1_3_CM_S2 1 0 -32768 32767 ECU_ADDRESS 0xFFF8E28C FORMAT "%2.0" /end MEASUREMENT
/begin MEASUREMENT N_T_ARSSTD[4] "" SWORD _CNV_R_R_Umr_1_zu_1_3_CM_S2 1 0 -32768 32767 ECU_ADDRESS 0xFFF8E28E FORMAT "%2.0" /end MEASUREMENT
/begin MEASUREMENT N_T_ARSSTD[5] "" SWORD _CNV_R_R_Umr_1_zu_1_3_CM_S2 1 0 -32768 32767 ECU_ADDRESS 0xFFF8E290 FORMAT "%2.0" /end MEASUREMENT
/begin MEASUREMENT N_T_ARSSTD[6] "" SWORD _CNV_R_R_Umr_1_zu_1_3_CM_S2 1 0 -32768 32767 ECU_ADDRESS 0xFFF8E292 FORMAT "%2.0" /end MEASUREMENT
/begin MEASUREMENT N_T_ARSSTD[7] "" SWORD _CNV_R_R_Umr_1_zu_1_3_CM_S2 1 0 -32768 32767 ECU_ADDRESS 0xFFF8E294 FORMAT "%2.0" /end MEASUREMENT
/begin MEASUREMENT N_T_ARSSTD[8] "" SWORD _CNV_R_R_Umr_1_zu_1_3_CM_S2 1 0 -32768 32767 ECU_ADDRESS 0xFFF8E296 FORMAT "%2.0" /end MEASUREMENT
/begin MEASUREMENT N_T_BUFFER "" UWORD _CNV_R_R_Umr_1_zu_1_3_CM_S2 1 0 0 20000 ECU_ADDRESS 0xFFF8EF84 FORMAT "%2.0" MATRIX_DIM 16 1 1 /end MEASUREMENT
/begin MEASUREMENT N_T_HSURESCHLUPF_OffSET "" UWORD _CNV_R_R_Umr_1_zu_1_3_CM_S2 1 0 0 20000 ECU_ADDRESS 0xFFF8E666 FORMAT "%2.0" /end MEASUREMENT
/begin MEASUREMENT N_T_HS_MDS "" UWORD _CNV_R_R_Umr_1_zu_1_3_CM_S2 1 0 0 65535 ECU_ADDRESS 0xFFF8E72C FORMAT "%2.0" /end MEASUREMENT
/begin MEASUREMENT N_T_MIN_NACHRS "" UWORD _CNV_R_R_Umr_1_zu_1_3_CM_S2 1 0 0 20000 ECU_ADDRESS 0xFFF8E888 FORMAT "%2.0" /end MEASUREMENT
/begin MEASUREMENT N_T_ROH "" UWORD _CNV_R_R_Umr_1_zu_1_2_CM_S2 1 0 0 65535 ECU_ADDRESS 0xFFF8E3A4 /end MEASUREMENT
/begin MEASUREMENT N_T_RS_MDS "" UWORD _CNV_R_R_Umr_1_zu_1_3_CM_S2 1 0 0 20000 ECU_ADDRESS 0xFFF8E72E FORMAT "%2.0" /end MEASUREMENT
/begin MEASUREMENT N_VM "" UWORD _CNV_R_R_Umr_1_zu_1_3_CM_S2 1 0 0 20000 ECU_ADDRESS 0xFFF8E5EA FORMAT "%2.0" /end MEASUREMENT
/begin MEASUREMENT N_VMBUFFER "" UWORD _CNV_R_R_Umr_1_zu_1_3_CM_S2 1 0 0 20000 ECU_ADDRESS 0xFFF8EFE4 FORMAT "%2.0" MATRIX_DIM 2 1 1 /end MEASUREMENT
/begin MEASUREMENT N_VM_ROH "" UWORD _CNV_R_R_Umr_1_zu_1_2_CM_S2 1 0 0 65535 ECU_ADDRESS 0xFFF8E3A6 /end MEASUREMENT
/begin MEASUREMENT NoIni.MOBEF.MESchlupfCounter "Statistics[4 ... 5]: Motor Eingriff Schlupf-Zaehler [(x=1/UMR___1_1_0)]" UWORD UMR___1_1_0_S5_S3 1 100 0 65535 ECU_ADDRESS 0xFFF9980C DISPLAY_IDENTIFIER MESchlupfCounter.MOBEF.NoIni /end MEASUREMENT
/begin MEASUREMENT NoIni.MvG.Version "Statistics[6 ... 7]: MvG Versions-Nummer [(x=1/UMR___1_1_0)]" UWORD UMR___1_1_0_S5_S3 1 100 0 65535 ECU_ADDRESS 0xFFF9980E DISPLAY_IDENTIFIER Version.MvG.NoIni /end MEASUREMENT
/begin MEASUREMENT OC_CR "" SWORD _CNV_R_R_Umr_1_zu_1_2_CM_S2 1 0 -32768 32767 ECU_ADDRESS 0xFFF8E86E FORMAT "%2.0" /end MEASUREMENT
/begin MEASUREMENT ODM_AB_FWSKORLUFT "" SWORD _CNV_R_R_Umr_1_zu_1_38_CM_S2 1 0 0 256 ECU_ADDRESS 0xFFF8E516 FORMAT "%2.0" /end MEASUREMENT
/begin MEASUREMENT ODM_AB_FWSKORTEMP "" SWORD _CNV_R_R_Umr_1_zu_1_38_CM_S2 1 0 -127 127 ECU_ADDRESS 0xFFF8E518 FORMAT "%2.0" /end MEASUREMENT
/begin MEASUREMENT OEM_EEPROM_MIRROR_PTR "" ULONG _CNV_R_R_Umr_1_zu_1_2_CM_S2 1 0 0 4294967295 ECU_ADDRESS 0xFFF8ED94 FORMAT "%2.0" /end MEASUREMENT
/begin MEASUREMENT ON_AB_HSFWS "" UWORD _CNV_R_R_Umr_1_zu_1_3_CM_S2 1 0 0 20000 ECU_ADDRESS 0xFFF8E400 FORMAT "%2.0" /end MEASUREMENT
/begin MEASUREMENT ON_AB_HSWK "" UWORD _CNV_R_R_Umr_1_zu_1_3_CM_S2 1 0 0 1023 ECU_ADDRESS 0xFFF8E402 FORMAT "%2.0" /end MEASUREMENT
/begin MEASUREMENT ON_AB_MAXWLSPV "" UWORD _CNV_R_R_Umr_1_zu_1_3_CM_S2 1 0 0 20000 ECU_ADDRESS 0xFFF8E404 FORMAT "%2.0" /end MEASUREMENT
/begin MEASUREMENT ON_AB_WLSPV "" UWORD _CNV_R_R_Umr_1_zu_1_3_CM_S2 1 0 0 20000 ECU_ADDRESS 0xFFF8E7E8 FORMAT "%2.0" /end MEASUREMENT
/begin MEASUREMENT ON_T_ARSDYNMAX_DBM[0] "" SWORD _CNV_R_R_Umr_1_zu_1_3_CM_S2 1 0 -32768 32767 ECU_ADDRESS 0xFFF8E298 FORMAT "%2.0" /end MEASUREMENT
/begin MEASUREMENT ON_T_ARSDYNMAX_DBM[1] "" SWORD _CNV_R_R_Umr_1_zu_1_3_CM_S2 1 0 -32768 32767 ECU_ADDRESS 0xFFF8E29A FORMAT "%2.0" /end MEASUREMENT
/begin MEASUREMENT ON_T_ARSDYNMAX_DBM[2] "" SWORD _CNV_R_R_Umr_1_zu_1_3_CM_S2 1 0 -32768 32767 ECU_ADDRESS 0xFFF8E29C FORMAT "%2.0" /end MEASUREMENT
/begin MEASUREMENT ON_T_ARSDYNMAX_DBM[3] "" SWORD _CNV_R_R_Umr_1_zu_1_3_CM_S2 1 0 -32768 32767 ECU_ADDRESS 0xFFF8E29E FORMAT "%2.0" /end MEASUREMENT
/begin MEASUREMENT ON_T_ARSDYNMAX_DBM[4] "" SWORD _CNV_R_R_Umr_1_zu_1_3_CM_S2 1 0 -32768 32767 ECU_ADDRESS 0xFFF8E2A0 FORMAT "%2.0" /end MEASUREMENT
/begin MEASUREMENT ON_T_ARSDYNMAX_DBM[5] "" SWORD _CNV_R_R_Umr_1_zu_1_3_CM_S2 1 0 -32768 32767 ECU_ADDRESS 0xFFF8E2A2 FORMAT "%2.0" /end MEASUREMENT
/begin MEASUREMENT ON_T_ARSDYNMAX_DBM[6] "" SWORD _CNV_R_R_Umr_1_zu_1_3_CM_S2 1 0 -32768 32767 ECU_ADDRESS 0xFFF8E2A4 FORMAT "%2.0" /end MEASUREMENT
/begin MEASUREMENT ON_T_ARSDYNMAX_DBM[7] "" SWORD _CNV_R_R_Umr_1_zu_1_3_CM_S2 1 0 -32768 32767 ECU_ADDRESS 0xFFF8E2A6 FORMAT "%2.0" /end MEASUREMENT
/begin MEASUREMENT ON_T_ARSDYNMAX_DBM[8] "" SWORD _CNV_R_R_Umr_1_zu_1_3_CM_S2 1 0 -32768 32767 ECU_ADDRESS 0xFFF8E2A8 FORMAT "%2.0" /end MEASUREMENT
/begin MEASUREMENT ON_T_ARSDYN_DBM[0] "" SWORD _CNV_R_R_Umr_1_zu_1_3_CM_S2 1 0 -32768 32767 ECU_ADDRESS 0xFFF8E2AA FORMAT "%2.0" /end MEASUREMENT
/begin MEASUREMENT ON_T_ARSDYN_DBM[1] "" SWORD _CNV_R_R_Umr_1_zu_1_3_CM_S2 1 0 -32768 32767 ECU_ADDRESS 0xFFF8E2AC FORMAT "%2.0" /end MEASUREMENT
/begin MEASUREMENT ON_T_ARSDYN_DBM[2] "" SWORD _CNV_R_R_Umr_1_zu_1_3_CM_S2 1 0 -32768 32767 ECU_ADDRESS 0xFFF8E2AE FORMAT "%2.0" /end MEASUREMENT
/begin MEASUREMENT ON_T_ARSDYN_DBM[3] "" SWORD _CNV_R_R_Umr_1_zu_1_3_CM_S2 1 0 -32768 32767 ECU_ADDRESS 0xFFF8E2B0 FORMAT "%2.0" /end MEASUREMENT
/begin MEASUREMENT ON_T_ARSDYN_DBM[4] "" SWORD _CNV_R_R_Umr_1_zu_1_3_CM_S2 1 0 -32768 32767 ECU_ADDRESS 0xFFF8E2B2 FORMAT "%2.0" /end MEASUREMENT
/begin MEASUREMENT ON_T_ARSDYN_DBM[5] "" SWORD _CNV_R_R_Umr_1_zu_1_3_CM_S2 1 0 -32768 32767 ECU_ADDRESS 0xFFF8E2B4 FORMAT "%2.0" /end MEASUREMENT
/begin MEASUREMENT ON_T_ARSDYN_DBM[6] "" SWORD _CNV_R_R_Umr_1_zu_1_3_CM_S2 1 0 -32768 32767 ECU_ADDRESS 0xFFF8E2B6 FORMAT "%2.0" /end MEASUREMENT
/begin MEASUREMENT ON_T_ARSDYN_DBM[7] "" SWORD _CNV_R_R_Umr_1_zu_1_3_CM_S2 1 0 -32768 32767 ECU_ADDRESS 0xFFF8E2B8 FORMAT "%2.0" /end MEASUREMENT
/begin MEASUREMENT ON_T_ARSDYN_DBM[8] "" SWORD _CNV_R_R_Umr_1_zu_1_3_CM_S2 1 0 -32768 32767 ECU_ADDRESS 0xFFF8E2BA FORMAT "%2.0" /end MEASUREMENT
/begin MEASUREMENT PAKConfig.PAKConfig_TEST "Only a TestValue" UBYTE SBW_STANDARD_S1_S3 1 100 1 7 ECU_ADDRESS 0xFFF893DB DISPLAY_IDENTIFIER PAKConfig_TEST.PAKConfig /end MEASUREMENT
/begin MEASUREMENT PRISQ_PRIO "" UWORD _CNV_R_R_Umr_1_zu_1_2_CM_S2 1 0 0 65535 ECU_ADDRESS 0xFFF8ECB8 FORMAT "%2.0" MATRIX_DIM 100 1 1 /end MEASUREMENT
/begin MEASUREMENT P_BR "" UWORD _CNV_R_R_Umr_2_zu_1_179_CM_S2 1 0 0 32767 ECU_ADDRESS 0xFFF8E6DC FORMAT "%3.1" /end MEASUREMENT
/begin MEASUREMENT P_LUFT "" UWORD _CNV_R_R_Umr_1_zu_1_0_CM_S2 1 0 598 1108 ECU_ADDRESS 0xFFF8E6DE FORMAT "%2.0" /end MEASUREMENT
/begin MEASUREMENT P_LUFT_ROH "" UWORD _CNV_R_R_Umr_1_zu_1_2_CM_S2 1 0 0 65535 ECU_ADDRESS 0xFFF8E3AA /end MEASUREMENT
/begin MEASUREMENT P_LUFT_ZKA "" SWORD _CNV_R_R_Umr_1_zu_1_0_CM_S2 1 0 598 1108 ECU_ADDRESS 0xFFF8E81A FORMAT "%2.0" /end MEASUREMENT
/begin MEASUREMENT PosMonitoring.L2_DrvReqPRND_Filt.Complement "Copy of L1 DrvReqPRND_Filt after monitoring of debounce" UBYTE SBW_STANDARD_S1_S3 1 100 0 8 ECU_ADDRESS 0xFFF980EF DISPLAY_IDENTIFIER Complement.L2_DrvReqPRND_Filt.PosMonitoring /end MEASUREMENT
/begin MEASUREMENT PosMonitoring.L2_DrvReqPRND_Filt.Value "Copy of L1 DrvReqPRND_Filt after monitoring of debounce" UBYTE SBW_STANDARD_S1_S3 1 100 0 8 ECU_ADDRESS 0xFFF980EE DISPLAY_IDENTIFIER Value.L2_DrvReqPRND_Filt.PosMonitoring /end MEASUREMENT
/begin MEASUREMENT PosMonitoring.L2_DrvReqPRND_Raw.Complement "raw value of L2 driver request" UBYTE SBW_STANDARD_S1_S3 1 100 0 8 ECU_ADDRESS 0xFFF980FD DISPLAY_IDENTIFIER Complement.L2_DrvReqPRND_Raw.PosMonitoring /end MEASUREMENT
/begin MEASUREMENT PosMonitoring.L2_DrvReqPRND_Raw.Value "raw value of L2 driver request" UBYTE SBW_STANDARD_S1_S3 1 100 0 8 ECU_ADDRESS 0xFFF980FC DISPLAY_IDENTIFIER Value.L2_DrvReqPRND_Raw.PosMonitoring /end MEASUREMENT
/begin MEASUREMENT PosMonitoring.L2_DrvReqP_Trig.Complement "triggerd driver request P" UBYTE SBW_STANDARD_S1_S3 1 100 0 1 BIT_MASK 0x1 ECU_ADDRESS 0xFFF980F1 DISPLAY_IDENTIFIER Complement.L2_DrvReqP_Trig.PosMonitoring /end MEASUREMENT
/begin MEASUREMENT PosMonitoring.L2_DrvReqP_Trig.Value "triggerd driver request P" UBYTE SBW_STANDARD_S1_S3 1 100 0 1 BIT_MASK 0x1 ECU_ADDRESS 0xFFF980F0 DISPLAY_IDENTIFIER Value.L2_DrvReqP_Trig.PosMonitoring /end MEASUREMENT
/begin MEASUREMENT PosMonitoring.L2_DrvReqP_old.Complement "remind old driver request P" UBYTE SBW_STANDARD_S1_S3 1 100 0 1 BIT_MASK 0x1 ECU_ADDRESS 0xFFF980F3 DISPLAY_IDENTIFIER Complement.L2_DrvReqP_old.PosMonitoring /end MEASUREMENT
/begin MEASUREMENT PosMonitoring.L2_DrvReqP_old.Value "remind old driver request P" UBYTE SBW_STANDARD_S1_S3 1 100 0 1 BIT_MASK 0x1 ECU_ADDRESS 0xFFF980F2 DISPLAY_IDENTIFIER Value.L2_DrvReqP_old.PosMonitoring /end MEASUREMENT
/begin MEASUREMENT PosMonitoring.L2_DrvReq_Old.Complement "remind Driver request by Level2" UBYTE SBW_STANDARD_S1_S3 1 100 0 8 ECU_ADDRESS 0xFFF980ED DISPLAY_IDENTIFIER Complement.L2_DrvReq_Old.PosMonitoring /end MEASUREMENT
/begin MEASUREMENT PosMonitoring.L2_DrvReq_Old.Value "remind Driver request by Level2" UBYTE SBW_STANDARD_S1_S3 1 100 0 8 ECU_ADDRESS 0xFFF980EC DISPLAY_IDENTIFIER Value.L2_DrvReq_Old.PosMonitoring /end MEASUREMENT
/begin MEASUREMENT PosMonitoring.L2_DrvReq_Trig.Complement "triggered Driver request by Level2" UBYTE SBW_STANDARD_S1_S3 1 100 0 8 ECU_ADDRESS 0xFFF980EB DISPLAY_IDENTIFIER Complement.L2_DrvReq_Trig.PosMonitoring /end MEASUREMENT
/begin MEASUREMENT PosMonitoring.L2_DrvReq_Trig.Value "triggered Driver request by Level2" UBYTE SBW_STANDARD_S1_S3 1 100 0 8 ECU_ADDRESS 0xFFF980EA DISPLAY_IDENTIFIER Value.L2_DrvReq_Trig.PosMonitoring /end MEASUREMENT
/begin MEASUREMENT PosMonitoring.L2_GatePos_Old.Complement "reminder of old Gate Position" UBYTE SBW_STANDARD_S1_S3 1 100 0 7 ECU_ADDRESS 0xFFF980F7 DISPLAY_IDENTIFIER Complement.L2_GatePos_Old.PosMonitoring /end MEASUREMENT
/begin MEASUREMENT PosMonitoring.L2_GatePos_Old.Value "reminder of old Gate Position" UBYTE SBW_STANDARD_S1_S3 1 100 0 7 ECU_ADDRESS 0xFFF980F6 DISPLAY_IDENTIFIER Value.L2_GatePos_Old.PosMonitoring /end MEASUREMENT
/begin MEASUREMENT PosMonitoring.L2_GatePos_Trig.Complement "triggerd Gate Position" UBYTE SBW_STANDARD_S1_S3 1 100 0 7 ECU_ADDRESS 0xFFF980F5 DISPLAY_IDENTIFIER Complement.L2_GatePos_Trig.PosMonitoring /end MEASUREMENT
/begin MEASUREMENT PosMonitoring.L2_GatePos_Trig.Value "triggerd Gate Position" UBYTE SBW_STANDARD_S1_S3 1 100 0 7 ECU_ADDRESS 0xFFF980F4 DISPLAY_IDENTIFIER Value.L2_GatePos_Trig.PosMonitoring /end MEASUREMENT
/begin MEASUREMENT PosMonitoring.L2_Max_D_t_StoreN.Complement "Set value of L2_tmr_N_Request depending on driver request storage" UWORD SBW_STANDARD_S1_S3 1 100 0 65535 ECU_ADDRESS 0xFFF98106 DISPLAY_IDENTIFIER Complement.L2_Max_D_t_StoreN.PosMonitoring /end MEASUREMENT
/begin MEASUREMENT PosMonitoring.L2_Max_D_t_StoreN.Value "Set value of L2_tmr_N_Request depending on driver request storage" UWORD SBW_TIMER_10MS_S1_S3 1 100 0 655350 ECU_ADDRESS 0xFFF98104 DISPLAY_IDENTIFIER Value.L2_Max_D_t_StoreN.PosMonitoring /end MEASUREMENT
/begin MEASUREMENT PosMonitoring.L2_Max_D_t_StoreRD.Complement "Set value of L2_tmr_R/D_Request depending on driver request storage" UWORD SBW_STANDARD_S1_S3 1 100 0 65535 ECU_ADDRESS 0xFFF98102 DISPLAY_IDENTIFIER Complement.L2_Max_D_t_StoreRD.PosMonitoring /end MEASUREMENT
/begin MEASUREMENT PosMonitoring.L2_Max_D_t_StoreRD.Value "Set value of L2_tmr_R/D_Request depending on driver request storage" UWORD SBW_TIMER_10MS_S1_S3 1 100 0 655350 ECU_ADDRESS 0xFFF98100 DISPLAY_IDENTIFIER Value.L2_Max_D_t_StoreRD.PosMonitoring /end MEASUREMENT
/begin MEASUREMENT PosMonitoring.L2_PosDrvAssistRaw_Old.Complement "mem. value of L2_PosDrvAssistRaw for next cycle" UBYTE SBW_STANDARD_S1_S3 1 100 0 8 ECU_ADDRESS 0xFFF9810B DISPLAY_IDENTIFIER Complement.L2_PosDrvAssistRaw_Old.PosMonitoring /end MEASUREMENT
/begin MEASUREMENT PosMonitoring.L2_PosDrvAssistRaw_Old.Value "mem. value of L2_PosDrvAssistRaw for next cycle" UBYTE SBW_STANDARD_S1_S3 1 100 0 8 ECU_ADDRESS 0xFFF9810A DISPLAY_IDENTIFIER Value.L2_PosDrvAssistRaw_Old.PosMonitoring /end MEASUREMENT
/begin MEASUREMENT PosMonitoring.L2_PosDrvAssistRaw_Trig.Complement "triggered PosDrvAssistRaw Level2" UBYTE SBW_STANDARD_S1_S3 1 100 0 8 ECU_ADDRESS 0xFFF98109 DISPLAY_IDENTIFIER Complement.L2_PosDrvAssistRaw_Trig.PosMonitoring /end MEASUREMENT
/begin MEASUREMENT PosMonitoring.L2_PosDrvAssistRaw_Trig.Value "triggered PosDrvAssistRaw Level2" UBYTE SBW_STANDARD_S1_S3 1 100 0 8 ECU_ADDRESS 0xFFF98108 DISPLAY_IDENTIFIER Value.L2_PosDrvAssistRaw_Trig.PosMonitoring /end MEASUREMENT
/begin MEASUREMENT PosMonitoring.L2_PosPRND_Init.Complement "position of selection-lever after reset [without intermediate positions]; buffered in PosPRNDBuf for level 2" UBYTE SBW_STANDARD_S1_S3 1 100 0 255 ECU_ADDRESS 0xFFF980FB DISPLAY_IDENTIFIER Complement.L2_PosPRND_Init.PosMonitoring /end MEASUREMENT
/begin MEASUREMENT PosMonitoring.L2_PosPRND_Init.Value "position of selection-lever after reset [without intermediate positions]; buffered in PosPRNDBuf for level 2" UBYTE SBW_STANDARD_S1_S3 1 100 0 255 ECU_ADDRESS 0xFFF980FA DISPLAY_IDENTIFIER Value.L2_PosPRND_Init.PosMonitoring /end MEASUREMENT
/begin MEASUREMENT PosMonitoring.L2_PosPRND_Trig.Complement "triggered Position Level2" UBYTE SBW_STANDARD_S1_S3 1 100 0 8 ECU_ADDRESS 0xFFF980E7 DISPLAY_IDENTIFIER Complement.L2_PosPRND_Trig.PosMonitoring /end MEASUREMENT
/begin MEASUREMENT PosMonitoring.L2_PosPRND_Trig.Value "triggered Position Level2" UBYTE SBW_STANDARD_S1_S3 1 100 0 8 ECU_ADDRESS 0xFFF980E6 DISPLAY_IDENTIFIER Value.L2_PosPRND_Trig.PosMonitoring /end MEASUREMENT
/begin MEASUREMENT PosMonitoring.L2_f_DiagposAutoposDetectedLastCycle.Complement "detction of diagpos or autopos during last cycle Level2" UBYTE SBW_STANDARD_S1_S3 1 100 0 1 BIT_MASK 0x1 ECU_ADDRESS 0xFFF980E9 DISPLAY_IDENTIFIER Complement.L2_f_DiagposAutoposDetectedLastCycle.PosMonitoring /end MEASUREMENT
/begin MEASUREMENT PosMonitoring.L2_f_DiagposAutoposDetectedLastCycle.Value "detction of diagpos or autopos during last cycle Level2" UBYTE SBW_STANDARD_S1_S3 1 100 0 1 BIT_MASK 0x1 ECU_ADDRESS 0xFFF980E8 DISPLAY_IDENTIFIER Value.L2_f_DiagposAutoposDetectedLastCycle.PosMonitoring /end MEASUREMENT
/begin MEASUREMENT PosMonitoring.L2_f_Shiftlock_Brake.Complement "f_Shiftlock_Brake value for level2" UBYTE SBW_STANDARD_S1_S3 1 100 0 1 BIT_MASK 0x1 ECU_ADDRESS 0xFFF980FF DISPLAY_IDENTIFIER Complement.L2_f_Shiftlock_Brake.PosMonitoring /end MEASUREMENT
/begin MEASUREMENT PosMonitoring.L2_f_Shiftlock_Brake.Value "f_Shiftlock_Brake value for level2" UBYTE SBW_STANDARD_S1_S3 1 100 0 1 BIT_MASK 0x1 ECU_ADDRESS 0xFFF980FE DISPLAY_IDENTIFIER Value.L2_f_Shiftlock_Brake.PosMonitoring /end MEASUREMENT
/begin MEASUREMENT PosMonitoring.L2_f_WaitDrvReqRD2N.Complement "indicates that timer L2_tmr_WaitForDebouncedDrvReq was preloaded / running" UBYTE SBW_STANDARD_S1_S3 1 100 0 1 BIT_MASK 0x1 ECU_ADDRESS 0xFFF980F9 DISPLAY_IDENTIFIER Complement.L2_f_WaitDrvReqRD2N.PosMonitoring /end MEASUREMENT
/begin MEASUREMENT PosMonitoring.L2_f_WaitDrvReqRD2N.Value "indicates that timer L2_tmr_WaitForDebouncedDrvReq was preloaded / running" UBYTE SBW_STANDARD_S1_S3 1 100 0 1 BIT_MASK 0x1 ECU_ADDRESS 0xFFF980F8 DISPLAY_IDENTIFIER Value.L2_f_WaitDrvReqRD2N.PosMonitoring /end MEASUREMENT
/begin MEASUREMENT PosMonitoring.L2_tmr_D_Request.f_IsExpired.Complement "test_timer" UBYTE SBW_STANDARD_S1_S3 1 100 0 255 ECU_ADDRESS 0xFFF980CB DISPLAY_IDENTIFIER Complement.f_IsExpired.L2_tmr_D_Request.PosMonitoring /end MEASUREMENT
/begin MEASUREMENT PosMonitoring.L2_tmr_D_Request.f_IsExpired.Value "test_timer" UBYTE SBW_STANDARD_S1_S3 1 100 0 255 ECU_ADDRESS 0xFFF980CA DISPLAY_IDENTIFIER Value.f_IsExpired.L2_tmr_D_Request.PosMonitoring /end MEASUREMENT
/begin MEASUREMENT PosMonitoring.L2_tmr_D_Request.time.Complement "test_timer" UWORD SBW_STANDARD_S1_S3 1 100 0 65535 ECU_ADDRESS 0xFFF980C8 DISPLAY_IDENTIFIER Complement.time.L2_tmr_D_Request.PosMonitoring /end MEASUREMENT
/begin MEASUREMENT PosMonitoring.L2_tmr_D_Request.time.Value "test_timer" UWORD SBW_TIMER_10MS_S1_S3 1 100 0 655350 ECU_ADDRESS 0xFFF980C6 DISPLAY_IDENTIFIER Value.time.L2_tmr_D_Request.PosMonitoring /end MEASUREMENT
/begin MEASUREMENT PosMonitoring.L2_tmr_D_t_StoreN.f_IsExpired.Complement "test_timer" UBYTE SBW_STANDARD_S1_S3 1 100 0 255 ECU_ADDRESS 0xFFF980DB DISPLAY_IDENTIFIER Complement.f_IsExpired.L2_tmr_D_t_StoreN.PosMonitoring /end MEASUREMENT
/begin MEASUREMENT PosMonitoring.L2_tmr_D_t_StoreN.f_IsExpired.Value "test_timer" UBYTE SBW_STANDARD_S1_S3 1 100 0 255 ECU_ADDRESS 0xFFF980DA DISPLAY_IDENTIFIER Value.f_IsExpired.L2_tmr_D_t_StoreN.PosMonitoring /end MEASUREMENT
/begin MEASUREMENT PosMonitoring.L2_tmr_D_t_StoreN.time.Complement "test_timer" UBYTE SBW_STANDARD_S1_S3 1 100 0 255 ECU_ADDRESS 0xFFF980D9 DISPLAY_IDENTIFIER Complement.time.L2_tmr_D_t_StoreN.PosMonitoring /end MEASUREMENT
/begin MEASUREMENT PosMonitoring.L2_tmr_D_t_StoreN.time.Value "test_timer" UBYTE SBW_TIMER_10MS_S1_S3 1 100 0 2550 ECU_ADDRESS 0xFFF980D8 DISPLAY_IDENTIFIER Value.time.L2_tmr_D_t_StoreN.PosMonitoring /end MEASUREMENT
/begin MEASUREMENT PosMonitoring.L2_tmr_DelayShiftlockBrake.f_IsExpired.Complement "test_timer" UBYTE SBW_STANDARD_S1_S3 1 100 0 255 ECU_ADDRESS 0xFFF980E5 DISPLAY_IDENTIFIER Complement.f_IsExpired.L2_tmr_DelayShiftlockBrake.PosMonitoring /end MEASUREMENT
/begin MEASUREMENT PosMonitoring.L2_tmr_DelayShiftlockBrake.f_IsExpired.Value "test_timer" UBYTE SBW_STANDARD_S1_S3 1 100 0 255 ECU_ADDRESS 0xFFF980E4 DISPLAY_IDENTIFIER Value.f_IsExpired.L2_tmr_DelayShiftlockBrake.PosMonitoring /end MEASUREMENT
/begin MEASUREMENT PosMonitoring.L2_tmr_DelayShiftlockBrake.time.Complement "test_timer" UBYTE SBW_STANDARD_S1_S3 1 100 0 255 ECU_ADDRESS 0xFFF980E3 DISPLAY_IDENTIFIER Complement.time.L2_tmr_DelayShiftlockBrake.PosMonitoring /end MEASUREMENT
/begin MEASUREMENT PosMonitoring.L2_tmr_DelayShiftlockBrake.time.Value "test_timer" UBYTE SBW_TIMER_10MS_S1_S3 1 100 0 2550 ECU_ADDRESS 0xFFF980E2 DISPLAY_IDENTIFIER Value.time.L2_tmr_DelayShiftlockBrake.PosMonitoring /end MEASUREMENT
/begin MEASUREMENT PosMonitoring.L2_tmr_N_Request.f_IsExpired.Complement "test_timer" UBYTE SBW_STANDARD_S1_S3 1 100 0 255 ECU_ADDRESS 0xFFF980D1 DISPLAY_IDENTIFIER Complement.f_IsExpired.L2_tmr_N_Request.PosMonitoring /end MEASUREMENT
/begin MEASUREMENT PosMonitoring.L2_tmr_N_Request.f_IsExpired.Value "test_timer" UBYTE SBW_STANDARD_S1_S3 1 100 0 255 ECU_ADDRESS 0xFFF980D0 DISPLAY_IDENTIFIER Value.f_IsExpired.L2_tmr_N_Request.PosMonitoring /end MEASUREMENT
/begin MEASUREMENT PosMonitoring.L2_tmr_N_Request.time.Complement "test_timer" UWORD SBW_STANDARD_S1_S3 1 100 0 65535 ECU_ADDRESS 0xFFF980CE DISPLAY_IDENTIFIER Complement.time.L2_tmr_N_Request.PosMonitoring /end MEASUREMENT
/begin MEASUREMENT PosMonitoring.L2_tmr_N_Request.time.Value "test_timer" UWORD SBW_TIMER_10MS_S1_S3 1 100 0 655350 ECU_ADDRESS 0xFFF980CC DISPLAY_IDENTIFIER Value.time.L2_tmr_N_Request.PosMonitoring /end MEASUREMENT
/begin MEASUREMENT PosMonitoring.L2_tmr_R_Request.f_IsExpired.Complement "test_timer" UBYTE SBW_STANDARD_S1_S3 1 100 0 255 ECU_ADDRESS 0xFFF980C5 DISPLAY_IDENTIFIER Complement.f_IsExpired.L2_tmr_R_Request.PosMonitoring /end MEASUREMENT
/begin MEASUREMENT PosMonitoring.L2_tmr_R_Request.f_IsExpired.Value "test_timer" UBYTE SBW_STANDARD_S1_S3 1 100 0 255 ECU_ADDRESS 0xFFF980C4 DISPLAY_IDENTIFIER Value.f_IsExpired.L2_tmr_R_Request.PosMonitoring /end MEASUREMENT
/begin MEASUREMENT PosMonitoring.L2_tmr_R_Request.time.Complement "test_timer" UWORD SBW_STANDARD_S1_S3 1 100 0 65535 ECU_ADDRESS 0xFFF980C2 DISPLAY_IDENTIFIER Complement.time.L2_tmr_R_Request.PosMonitoring /end MEASUREMENT
/begin MEASUREMENT PosMonitoring.L2_tmr_R_Request.time.Value "test_timer" UWORD SBW_TIMER_10MS_S1_S3 1 100 0 655350 ECU_ADDRESS 0xFFF980C0 DISPLAY_IDENTIFIER Value.time.L2_tmr_R_Request.PosMonitoring /end MEASUREMENT
/begin MEASUREMENT PosMonitoring.L2_tmr_Rocking.f_IsExpired.Complement "test_timer" UBYTE SBW_STANDARD_S1_S3 1 100 0 255 ECU_ADDRESS 0xFFF980E1 DISPLAY_IDENTIFIER Complement.f_IsExpired.L2_tmr_Rocking.PosMonitoring /end MEASUREMENT
/begin MEASUREMENT PosMonitoring.L2_tmr_Rocking.f_IsExpired.Value "test_timer" UBYTE SBW_STANDARD_S1_S3 1 100 0 255 ECU_ADDRESS 0xFFF980E0 DISPLAY_IDENTIFIER Value.f_IsExpired.L2_tmr_Rocking.PosMonitoring /end MEASUREMENT
/begin MEASUREMENT PosMonitoring.L2_tmr_Rocking.time.Complement "test_timer" UWORD SBW_STANDARD_S1_S3 1 100 0 65535 ECU_ADDRESS 0xFFF980DE DISPLAY_IDENTIFIER Complement.time.L2_tmr_Rocking.PosMonitoring /end MEASUREMENT
/begin MEASUREMENT PosMonitoring.L2_tmr_Rocking.time.Value "test_timer" UWORD SBW_TIMER_10MS_S1_S3 1 100 0 655350 ECU_ADDRESS 0xFFF980DC DISPLAY_IDENTIFIER Value.time.L2_tmr_Rocking.PosMonitoring /end MEASUREMENT
/begin MEASUREMENT PosMonitoring.L2_tmr_WaitForDebouncedDrvReq.f_IsExpired.Complement "test_timer" UBYTE SBW_STANDARD_S1_S3 1 100 0 255 ECU_ADDRESS 0xFFF980D7 DISPLAY_IDENTIFIER Complement.f_IsExpired.L2_tmr_WaitForDebouncedDrvReq.PosMonitoring /end MEASUREMENT
/begin MEASUREMENT PosMonitoring.L2_tmr_WaitForDebouncedDrvReq.f_IsExpired.Value "test_timer" UBYTE SBW_STANDARD_S1_S3 1 100 0 255 ECU_ADDRESS 0xFFF980D6 DISPLAY_IDENTIFIER Value.f_IsExpired.L2_tmr_WaitForDebouncedDrvReq.PosMonitoring /end MEASUREMENT
/begin MEASUREMENT PosMonitoring.L2_tmr_WaitForDebouncedDrvReq.time.Complement "test_timer" UWORD SBW_STANDARD_S1_S3 1 100 0 65535 ECU_ADDRESS 0xFFF980D4 DISPLAY_IDENTIFIER Complement.time.L2_tmr_WaitForDebouncedDrvReq.PosMonitoring /end MEASUREMENT
/begin MEASUREMENT PosMonitoring.L2_tmr_WaitForDebouncedDrvReq.time.Value "test_timer" UWORD SBW_TIMER_10MS_S1_S3 1 100 0 655350 ECU_ADDRESS 0xFFF980D2 DISPLAY_IDENTIFIER Value.time.L2_tmr_WaitForDebouncedDrvReq.PosMonitoring /end MEASUREMENT
/begin MEASUREMENT PowerDown.f_PowDownEnable "flag to notify RB-SW powering down is permitted in overshoot-state" UBYTE SBW_STANDARD_S1_S3 1 100 0 1 BIT_MASK 0x1 ECU_ADDRESS 0xFFF89965 DISPLAY_IDENTIFIER f_PowDownEnable.PowerDown /end MEASUREMENT
/begin MEASUREMENT PowerDown.st_PowerDownDelay "status for timer tmr_PowDownDelay counts active for P R N D" UBYTE SBW_STANDARD_S1_S3 1 100 0 1 ECU_ADDRESS 0xFFF89964 DISPLAY_IDENTIFIER st_PowerDownDelay.PowerDown /end MEASUREMENT
/begin MEASUREMENT PowerDown.tmr_PowDownDelay.f_IsExpired "test_timer" UBYTE SBW_STANDARD_S1_S3 1 100 0 255 ECU_ADDRESS 0xFFF89962 DISPLAY_IDENTIFIER f_IsExpired.tmr_PowDownDelay.PowerDown /end MEASUREMENT
/begin MEASUREMENT PowerDown.tmr_PowDownDelay.time "test_timer" UWORD SBW_TIMER_10MS_S1_S3 1 100 0 655350 ECU_ADDRESS 0xFFF89960 DISPLAY_IDENTIFIER time.tmr_PowDownDelay.PowerDown /end MEASUREMENT
/begin MEASUREMENT PulsAda.Daten.NPruefschleife "EepromStd[260 ... 265]: Pulsadaption: Zaehler Pruefschleife bei Puls 3 (laut Diagramm in PH) [(x=6/UMR___1_1_0)]" UBYTE UMR___1_1_0_S5_S3 1 100 0 255 ECU_ADDRESS 0xFFF8113C DISPLAY_IDENTIFIER NPruefschleife.Daten.PulsAda MATRIX_DIM 6 1 1 /end MEASUREMENT
/begin MEASUREMENT PulsAda.Daten.NPruefzyklen "EepromStd[248 ... 253]: Pulsadaption: Anzahl der abgeschlossenen Pruefzyklen fuer Increment Befuell-Pruefzaehler [(x=6/UMR___1_1_0)]" UBYTE UMR___1_1_0_S5_S3 1 100 0 255 ECU_ADDRESS 0xFFF81130 DISPLAY_IDENTIFIER NPruefzyklen.Daten.PulsAda MATRIX_DIM 6 1 1 /end MEASUREMENT
/begin MEASUREMENT PulsAda.Daten.NPulsgrenz "EepromStd[254 ... 259]: Pulsadaption: Anzahl der Pulse in diesem Pruefzyklus [(x=6/UMR___1_1_0)]" UBYTE UMR___1_1_0_S5_S3 1 100 0 255 ECU_ADDRESS 0xFFF81136 DISPLAY_IDENTIFIER NPulsgrenz.Daten.PulsAda MATRIX_DIM 6 1 1 /end MEASUREMENT
/begin MEASUREMENT PulsAda.Daten.Prueftyp "EepromStd[236 ... 241]: Pulsadaption: Prueftyp (TSF oder PF) [(x=6/UMR___1_1_0)]" UBYTE UMR___1_1_0_S5_S3 1 100 0 255 ECU_ADDRESS 0xFFF81124 DISPLAY_IDENTIFIER Prueftyp.Daten.PulsAda MATRIX_DIM 6 1 1 /end MEASUREMENT
/begin MEASUREMENT PulsAda.Daten.Pulsid "EepromStd[242 ... 247]: Pulsadaption: Puls ID (Nummer Pruefpuls laut Diagrammm in PH) [(x=6/UMR___1_1_0)]" UBYTE UMR___1_1_0_S5_S3 1 100 0 255 ECU_ADDRESS 0xFFF8112A DISPLAY_IDENTIFIER Pulsid.Daten.PulsAda MATRIX_DIM 6 1 1 /end MEASUREMENT
/begin MEASUREMENT PulsAda.Daten.ZwSpPf "EepromStd[212 ... 223]: Pulsadaption: Zwischenspeicher Fuelldruck [(x=6/UMR___1_1_0)]" SWORD UMR_MBAR__1_1_0_S5_S3 1 100 -32768 32767 ECU_ADDRESS 0xFFF8110C DISPLAY_IDENTIFIER ZwSpPf.Daten.PulsAda MATRIX_DIM 6 1 1 /end MEASUREMENT
/begin MEASUREMENT PulsAda.Daten.ZwSpTsf "EepromStd[224 ... 235]: Pulsadaption: Zwischenspeicher Schnellfuellzeit [(x=6/UMR___1_1_0)]" SWORD UMR_MSEC__1_1_0_S5_S3 1 100 -32768 32767 ECU_ADDRESS 0xFFF81118 DISPLAY_IDENTIFIER ZwSpTsf.Daten.PulsAda MATRIX_DIM 6 1 1 /end MEASUREMENT
/begin MEASUREMENT QA_L_REF "" UBYTE _CNV_S_3_Enum_EQ_64_CM_S2 1 0 0 2 ECU_ADDRESS 0xFFF8EAB4 /end MEASUREMENT
/begin MEASUREMENT QA_L_REF_ROH "" UBYTE _CNV_R_R_Umr_1_zu_1_2_CM_S2 1 0 0 255 ECU_ADDRESS 0xFFF8E92C /end MEASUREMENT
/begin MEASUREMENT QA_Q_REF "" UBYTE _CNV_S_3_Enum_EQ_64_CM_S2 1 0 0 2 ECU_ADDRESS 0xFFF8EAB5 /end MEASUREMENT
/begin MEASUREMENT QA_Q_REF_ROH "" UBYTE _CNV_R_R_Umr_1_zu_1_2_CM_S2 1 0 0 255 ECU_ADDRESS 0xFFF8E92D /end MEASUREMENT
/begin MEASUREMENT QGM_LDM_SOLL "" UBYTE _CNV_R_R_Umr_1_zu_1_2_CM_S2 1 0 0 1 ECU_ADDRESS 0xFFF8EB0B FORMAT "%2.0" /end MEASUREMENT
/begin MEASUREMENT QGW_GIER "" UBYTE _CNV_S_3_Enum_EQ_64_CM_S2 1 0 0 2 ECU_ADDRESS 0xFFF8EAB6 /end MEASUREMENT
/begin MEASUREMENT QGW_GIER_ROH "" UBYTE _CNV_R_R_Umr_1_zu_1_2_CM_S2 1 0 0 255 ECU_ADDRESS 0xFFF8E92E /end MEASUREMENT
/begin MEASUREMENT QMASSE_FZG_EST "" UBYTE _CNV_S_3_Enum_EQ_64_CM_S2 1 0 0 2 ECU_ADDRESS 0xFFF8EAB7 /end MEASUREMENT
/begin MEASUREMENT QMASSE_FZG_EST_ROH "" UBYTE _CNV_R_R_Umr_1_zu_1_2_CM_S2 1 0 0 255 ECU_ADDRESS 0xFFF8E92F /end MEASUREMENT
/begin MEASUREMENT QM_BR "" UBYTE _CNV_S_3_Enum_EQ_64_CM_S2 1 0 0 2 ECU_ADDRESS 0xFFF8EAB8 /end MEASUREMENT
/begin MEASUREMENT QM_BR_ROH "" UBYTE _CNV_R_R_Umr_1_zu_1_2_CM_S2 1 0 0 255 ECU_ADDRESS 0xFFF8E930 /end MEASUREMENT
/begin MEASUREMENT QM_BR_SOLL "" UBYTE _CNV_S_3_Enum_EQ_64_CM_S2 1 0 0 2 ECU_ADDRESS 0xFFF8EAB9 /end MEASUREMENT
/begin MEASUREMENT QM_LDM_STATUS "" UBYTE _CNV_S_3_Enum_EQ_64_CM_S2 1 0 0 2 ECU_ADDRESS 0xFFF8EB0C /end MEASUREMENT
/begin MEASUREMENT QM_LDM_STATUS_ROH "" UBYTE _CNV_R_R_Umr_1_zu_1_2_CM_S2 1 0 0 255 ECU_ADDRESS 0xFFF8E937 /end MEASUREMENT
/begin MEASUREMENT QM_MOT_MAXDME "" UBYTE _CNV_S_3_Enum_EQ_64_CM_S2 1 0 0 2 ECU_ADDRESS 0xFFF8EABB /end MEASUREMENT
/begin MEASUREMENT QM_MOT_MAXDME_ROH "" UBYTE _CNV_R_R_Umr_1_zu_1_2_CM_S2 1 0 0 255 ECU_ADDRESS 0xFFF8E93A /end MEASUREMENT
/begin MEASUREMENT QM_RAD_IST "" UBYTE _CNV_S_3_Enum_EQ_64_CM_S2 1 0 0 2 ECU_ADDRESS 0xFFF8EABC /end MEASUREMENT
/begin MEASUREMENT QM_RAD_IST_ROH "" UBYTE _CNV_R_R_Umr_1_zu_1_2_CM_S2 1 0 0 255 ECU_ADDRESS 0xFFF8E932 /end MEASUREMENT
/begin MEASUREMENT QN_AB_ROH "" UBYTE _CNV_S_3_Enum_EQ_64_CM_S2 1 0 0 2 ECU_ADDRESS 0xFFF8E93B /end MEASUREMENT
/begin MEASUREMENT QN_MOT_SOLLLL "" UBYTE _CNV_S_3_Enum_EQ_64_CM_S2 1 0 0 2 ECU_ADDRESS 0xFFF8EABD /end MEASUREMENT
/begin MEASUREMENT QN_MOT_SOLLLL_ROH "" UBYTE _CNV_S_3_Enum_EQ_64_CM_S2 1 0 0 2 ECU_ADDRESS 0xFFF8E93C /end MEASUREMENT
/begin MEASUREMENT QN_T "" UBYTE _CNV_S_3_Enum_EQ_64_CM_S2 1 0 0 2 ECU_ADDRESS 0xFFF8EABE /end MEASUREMENT
/begin MEASUREMENT QN_T_ROH "" UBYTE _CNV_S_3_Enum_EQ_64_CM_S2 1 0 0 2 ECU_ADDRESS 0xFFF8E93D /end MEASUREMENT
/begin MEASUREMENT QP_BR "" UBYTE _CNV_S_3_Enum_EQ_64_CM_S2 1 0 0 2 ECU_ADDRESS 0xFFF8EABF /end MEASUREMENT
/begin MEASUREMENT QV_FZG_COG "" UBYTE _CNV_S_3_Enum_EQ_64_CM_S2 1 0 0 2 ECU_ADDRESS 0xFFF8EAC0 /end MEASUREMENT
/begin MEASUREMENT QV_FZG_COG_ROH "" UBYTE _CNV_R_R_Umr_1_zu_1_2_CM_S2 1 0 0 255 ECU_ADDRESS 0xFFF8E933 /end MEASUREMENT
/begin MEASUREMENT QV_RAD_HL "" UBYTE _CNV_S_3_Enum_EQ_64_CM_S2 1 0 0 2 ECU_ADDRESS 0xFFF8EAC1 /end MEASUREMENT
/begin MEASUREMENT QV_RAD_HL_ROH "" UBYTE _CNV_R_R_Umr_1_zu_1_2_CM_S2 1 0 0 255 ECU_ADDRESS 0xFFF8E93F /end MEASUREMENT
/begin MEASUREMENT QV_RAD_HR "" UBYTE _CNV_S_3_Enum_EQ_64_CM_S2 1 0 0 2 ECU_ADDRESS 0xFFF8EAC2 /end MEASUREMENT
/begin MEASUREMENT QV_RAD_HR_ROH "" UBYTE _CNV_R_R_Umr_1_zu_1_2_CM_S2 1 0 0 255 ECU_ADDRESS 0xFFF8E940 /end MEASUREMENT
/begin MEASUREMENT QV_RAD_VL "" UBYTE _CNV_S_3_Enum_EQ_64_CM_S2 1 0 0 2 ECU_ADDRESS 0xFFF8EAC3 /end MEASUREMENT
/begin MEASUREMENT QV_RAD_VL_ROH "" UBYTE _CNV_R_R_Umr_1_zu_1_2_CM_S2 1 0 0 255 ECU_ADDRESS 0xFFF8E941 /end MEASUREMENT
/begin MEASUREMENT QV_RAD_VR "" UBYTE _CNV_S_3_Enum_EQ_64_CM_S2 1 0 0 2 ECU_ADDRESS 0xFFF8EAC4 /end MEASUREMENT
/begin MEASUREMENT QV_RAD_VR_ROH "" UBYTE _CNV_R_R_Umr_1_zu_1_2_CM_S2 1 0 0 255 ECU_ADDRESS 0xFFF8E942 /end MEASUREMENT
/begin MEASUREMENT QW_STEIGUNG "" UBYTE _CNV_S_3_Enum_EQ_64_CM_S2 1 0 0 2 ECU_ADDRESS 0xFFF8EAC5 /end MEASUREMENT
/begin MEASUREMENT QW_STEIGUNG_ROH "" UBYTE _CNV_R_R_Umr_1_zu_1_2_CM_S2 1 0 0 255 ECU_ADDRESS 0xFFF8E943 /end MEASUREMENT
/begin MEASUREMENT R_RAD_DYN "" UWORD _CNV_R_R_Umr_1_zu_1_2_CM_S2 1 0 0 65535 ECU_ADDRESS 0xFFF8E6E0 FORMAT "%2.0" /end MEASUREMENT
/begin MEASUREMENT R_RAD_DYN_ROH "" UWORD _CNV_R_R_Umr_1_zu_1_2_CM_S2 1 0 0 65535 ECU_ADDRESS 0xFFF8E3AC /end MEASUREMENT
/begin MEASUREMENT RelToAbs.DrvReq_Raw "Absolute Driver Request" UBYTE SBW_STANDARD_S1_S3 1 100 0 8 ECU_ADDRESS 0xFFF89850 DISPLAY_IDENTIFIER DrvReq_Raw.RelToAbs /end MEASUREMENT
/begin CHARACTERISTIC S12 "" CURVE 0x1E05EA _REC_A1CUR_1_u2_u2_S2 15000 _CNV_R_R_Umr_1_zu_1_3_CM_S2 0 15000
 /begin AXIS_DESCR COM_AXIS W_DKKD _CNV_R_R_Umr_10_zu__9_CM_S2 15 0 120 DEPOSIT ABSOLUTE FORMAT "%3.1" AXIS_PTS_REF SSTSKL_S /end AXIS_DESCR
 FORMAT "%2.0" /end CHARACTERISTIC
/begin CHARACTERISTIC S21 "" CURVE 0x1E0608 _REC_A1CUR_1_u2_u2_S2 15000 _CNV_R_R_Umr_1_zu_1_3_CM_S2 0 15000
 /begin AXIS_DESCR COM_AXIS W_DKKD _CNV_R_R_Umr_10_zu__9_CM_S2 15 0 120 DEPOSIT ABSOLUTE FORMAT "%3.1" AXIS_PTS_REF SSTSKL_S /end AXIS_DESCR
 FORMAT "%2.0" /end CHARACTERISTIC
/begin CHARACTERISTIC S23 "" CURVE 0x1E0626 _REC_A1CUR_1_u2_u2_S2 15000 _CNV_R_R_Umr_1_zu_1_3_CM_S2 0 15000
 /begin AXIS_DESCR COM_AXIS W_DKKD _CNV_R_R_Umr_10_zu__9_CM_S2 15 0 120 DEPOSIT ABSOLUTE FORMAT "%3.1" AXIS_PTS_REF SSTSKL_S /end AXIS_DESCR
 FORMAT "%2.0" /end CHARACTERISTIC
/begin CHARACTERISTIC S32 "" CURVE 0x1E0644 _REC_A1CUR_1_u2_u2_S2 15000 _CNV_R_R_Umr_1_zu_1_3_CM_S2 0 15000
 /begin AXIS_DESCR COM_AXIS W_DKKD _CNV_R_R_Umr_10_zu__9_CM_S2 15 0 120 DEPOSIT ABSOLUTE FORMAT "%3.1" AXIS_PTS_REF SSTSKL_S /end AXIS_DESCR
 FORMAT "%2.0" /end CHARACTERISTIC
/begin CHARACTERISTIC S34 "" CURVE 0x1E0662 _REC_A1CUR_1_u2_u2_S2 15000 _CNV_R_R_Umr_1_zu_1_3_CM_S2 0 15000
 /begin AXIS_DESCR COM_AXIS W_DKKD _CNV_R_R_Umr_10_zu__9_CM_S2 15 0 120 DEPOSIT ABSOLUTE FORMAT "%3.1" AXIS_PTS_REF SSTSKL_S /end AXIS_DESCR
 FORMAT "%2.0" /end CHARACTERISTIC
/begin CHARACTERISTIC S43 "" CURVE 0x1E0680 _REC_A1CUR_1_u2_u2_S2 15000 _CNV_R_R_Umr_1_zu_1_3_CM_S2 0 15000
 /begin AXIS_DESCR COM_AXIS W_DKKD _CNV_R_R_Umr_10_zu__9_CM_S2 15 0 120 DEPOSIT ABSOLUTE FORMAT "%3.1" AXIS_PTS_REF SSTSKL_S /end AXIS_DESCR
 FORMAT "%2.0" /end CHARACTERISTIC
/begin CHARACTERISTIC S45 "" CURVE 0x1E069E _REC_A1CUR_1_u2_u2_S2 15000 _CNV_R_R_Umr_1_zu_1_3_CM_S2 0 15000
 /begin AXIS_DESCR COM_AXIS W_DKKD _CNV_R_R_Umr_10_zu__9_CM_S2 15 0 120 DEPOSIT ABSOLUTE FORMAT "%3.1" AXIS_PTS_REF SSTSKL_S /end AXIS_DESCR
 FORMAT "%2.0" /end CHARACTERISTIC
/begin CHARACTERISTIC S54 "" CURVE 0x1E06BC _REC_A1CUR_1_u2_u2_S2 15000 _CNV_R_R_Umr_1_zu_1_3_CM_S2 0 15000
 /begin AXIS_DESCR COM_AXIS W_DKKD _CNV_R_R_Umr_10_zu__9_CM_S2 15 0 120 DEPOSIT ABSOLUTE FORMAT "%3.1" AXIS_PTS_REF SSTSKL_S /end AXIS_DESCR
 FORMAT "%2.0" /end CHARACTERISTIC
/begin CHARACTERISTIC S56 "" CURVE 0x1E06DA _REC_A1CUR_1_u2_u2_S2 15000 _CNV_R_R_Umr_1_zu_1_3_CM_S2 0 15000
 /begin AXIS_DESCR COM_AXIS W_DKKD _CNV_R_R_Umr_10_zu__9_CM_S2 15 0 120 DEPOSIT ABSOLUTE FORMAT "%3.1" AXIS_PTS_REF SSTSKL_S /end AXIS_DESCR
 FORMAT "%2.0" /end CHARACTERISTIC
/begin CHARACTERISTIC S65 "" CURVE 0x1E06F8 _REC_A1CUR_1_u2_u2_S2 15000 _CNV_R_R_Umr_1_zu_1_3_CM_S2 0 15000
 /begin AXIS_DESCR COM_AXIS W_DKKD _CNV_R_R_Umr_10_zu__9_CM_S2 15 0 120 DEPOSIT ABSOLUTE FORMAT "%3.1" AXIS_PTS_REF SSTSKL_S /end AXIS_DESCR
 FORMAT "%2.0" /end CHARACTERISTIC
/begin CHARACTERISTIC S67 "" CURVE 0x1E1526 _REC_A1CUR_1_u2_u2_S2 15000 _CNV_R_R_Umr_1_zu_1_3_CM_S2 0 15000
 /begin AXIS_DESCR COM_AXIS W_DKKD _CNV_R_R_Umr_10_zu__9_CM_S2 15 0 120 DEPOSIT ABSOLUTE FORMAT "%3.1" AXIS_PTS_REF SSTSKL_S /end AXIS_DESCR
 FORMAT "%2.0" /end CHARACTERISTIC
/begin CHARACTERISTIC S76 "" CURVE 0x1E1544 _REC_A1CUR_1_u2_u2_S2 15000 _CNV_R_R_Umr_1_zu_1_3_CM_S2 0 15000
 /begin AXIS_DESCR COM_AXIS W_DKKD _CNV_R_R_Umr_10_zu__9_CM_S2 15 0 120 DEPOSIT ABSOLUTE FORMAT "%3.1" AXIS_PTS_REF SSTSKL_S /end AXIS_DESCR
 FORMAT "%2.0" /end CHARACTERISTIC
/begin CHARACTERISTIC S78 "" CURVE 0x1E1A12 _REC_A1CUR_1_u2_u2_S2 15000 _CNV_R_R_Umr_1_zu_1_3_CM_S2 0 15000
 /begin AXIS_DESCR COM_AXIS W_DKKD _CNV_R_R_Umr_10_zu__9_CM_S2 15 0 120 DEPOSIT ABSOLUTE FORMAT "%3.1" AXIS_PTS_REF SSTSKL_S /end AXIS_DESCR
 FORMAT "%2.0" /end CHARACTERISTIC
/begin CHARACTERISTIC S87 "" CURVE 0x1E1A30 _REC_A1CUR_1_u2_u2_S2 15000 _CNV_R_R_Umr_1_zu_1_3_CM_S2 0 15000
 /begin AXIS_DESCR COM_AXIS W_DKKD _CNV_R_R_Umr_10_zu__9_CM_S2 15 0 120 DEPOSIT ABSOLUTE FORMAT "%3.1" AXIS_PTS_REF SSTSKL_S /end AXIS_DESCR
 FORMAT "%2.0" /end CHARACTERISTIC
/begin CHARACTERISTIC SA112 "" CURVE 0x1E0716 _REC_A1CUR_1_u2_u2_S2 15000 _CNV_R_R_Umr_1_zu_1_3_CM_S2 0 15000
 /begin AXIS_DESCR COM_AXIS W_DKKD _CNV_R_R_Umr_10_zu__9_CM_S2 15 0 120 DEPOSIT ABSOLUTE FORMAT "%3.1" AXIS_PTS_REF SSTSKL_SA1 /end AXIS_DESCR
 FORMAT "%2.0" /end CHARACTERISTIC
/begin CHARACTERISTIC SA121 "" CURVE 0x1E0734 _REC_A1CUR_1_u2_u2_S2 15000 _CNV_R_R_Umr_1_zu_1_3_CM_S2 0 15000
 /begin AXIS_DESCR COM_AXIS W_DKKD _CNV_R_R_Umr_10_zu__9_CM_S2 15 0 120 DEPOSIT ABSOLUTE FORMAT "%3.1" AXIS_PTS_REF SSTSKL_SA1 /end AXIS_DESCR
 FORMAT "%2.0" /end CHARACTERISTIC
/begin CHARACTERISTIC SA123 "" CURVE 0x1E0752 _REC_A1CUR_1_u2_u2_S2 15000 _CNV_R_R_Umr_1_zu_1_3_CM_S2 0 15000
 /begin AXIS_DESCR COM_AXIS W_DKKD _CNV_R_R_Umr_10_zu__9_CM_S2 15 0 120 DEPOSIT ABSOLUTE FORMAT "%3.1" AXIS_PTS_REF SSTSKL_SA1 /end AXIS_DESCR
 FORMAT "%2.0" /end CHARACTERISTIC
/begin CHARACTERISTIC SA132 "" CURVE 0x1E0770 _REC_A1CUR_1_u2_u2_S2 15000 _CNV_R_R_Umr_1_zu_1_3_CM_S2 0 15000
 /begin AXIS_DESCR COM_AXIS W_DKKD _CNV_R_R_Umr_10_zu__9_CM_S2 15 0 120 DEPOSIT ABSOLUTE FORMAT "%3.1" AXIS_PTS_REF SSTSKL_SA1 /end AXIS_DESCR
 FORMAT "%2.0" /end CHARACTERISTIC
/begin CHARACTERISTIC SA134 "" CURVE 0x1E078E _REC_A1CUR_1_u2_u2_S2 15000 _CNV_R_R_Umr_1_zu_1_3_CM_S2 0 15000
 /begin AXIS_DESCR COM_AXIS W_DKKD _CNV_R_R_Umr_10_zu__9_CM_S2 15 0 120 DEPOSIT ABSOLUTE FORMAT "%3.1" AXIS_PTS_REF SSTSKL_SA1 /end AXIS_DESCR
 FORMAT "%2.0" /end CHARACTERISTIC
/begin CHARACTERISTIC SA143 "" CURVE 0x1E07AC _REC_A1CUR_1_u2_u2_S2 15000 _CNV_R_R_Umr_1_zu_1_3_CM_S2 0 15000
 /begin AXIS_DESCR COM_AXIS W_DKKD _CNV_R_R_Umr_10_zu__9_CM_S2 15 0 120 DEPOSIT ABSOLUTE FORMAT "%3.1" AXIS_PTS_REF SSTSKL_SA1 /end AXIS_DESCR
 FORMAT "%2.0" /end CHARACTERISTIC
/begin CHARACTERISTIC SA145 "" CURVE 0x1E07CA _REC_A1CUR_1_u2_u2_S2 15000 _CNV_R_R_Umr_1_zu_1_3_CM_S2 0 15000
 /begin AXIS_DESCR COM_AXIS W_DKKD _CNV_R_R_Umr_10_zu__9_CM_S2 15 0 120 DEPOSIT ABSOLUTE FORMAT "%3.1" AXIS_PTS_REF SSTSKL_SA1 /end AXIS_DESCR
 FORMAT "%2.0" /end CHARACTERISTIC
/begin CHARACTERISTIC SA154 "" CURVE 0x1E07E8 _REC_A1CUR_1_u2_u2_S2 15000 _CNV_R_R_Umr_1_zu_1_3_CM_S2 0 15000
 /begin AXIS_DESCR COM_AXIS W_DKKD _CNV_R_R_Umr_10_zu__9_CM_S2 15 0 120 DEPOSIT ABSOLUTE FORMAT "%3.1" AXIS_PTS_REF SSTSKL_SA1 /end AXIS_DESCR
 FORMAT "%2.0" /end CHARACTERISTIC
/begin CHARACTERISTIC SA156 "" CURVE 0x1E0806 _REC_A1CUR_1_u2_u2_S2 15000 _CNV_R_R_Umr_1_zu_1_3_CM_S2 0 15000
 /begin AXIS_DESCR COM_AXIS W_DKKD _CNV_R_R_Umr_10_zu__9_CM_S2 15 0 120 DEPOSIT ABSOLUTE FORMAT "%3.1" AXIS_PTS_REF SSTSKL_SA1 /end AXIS_DESCR
 FORMAT "%2.0" /end CHARACTERISTIC
/begin CHARACTERISTIC SA165 "" CURVE 0x1E0824 _REC_A1CUR_1_u2_u2_S2 15000 _CNV_R_R_Umr_1_zu_1_3_CM_S2 0 15000
 /begin AXIS_DESCR COM_AXIS W_DKKD _CNV_R_R_Umr_10_zu__9_CM_S2 15 0 120 DEPOSIT ABSOLUTE FORMAT "%3.1" AXIS_PTS_REF SSTSKL_SA1 /end AXIS_DESCR
 FORMAT "%2.0" /end CHARACTERISTIC
/begin CHARACTERISTIC SA167 "" CURVE 0x1E1562 _REC_A1CUR_1_u2_u2_S2 15000 _CNV_R_R_Umr_1_zu_1_3_CM_S2 0 15000
 /begin AXIS_DESCR COM_AXIS W_DKKD _CNV_R_R_Umr_10_zu__9_CM_S2 15 0 120 DEPOSIT ABSOLUTE FORMAT "%3.1" AXIS_PTS_REF SSTSKL_SA1 /end AXIS_DESCR
 FORMAT "%2.0" /end CHARACTERISTIC
/begin CHARACTERISTIC SA176 "" CURVE 0x1E1580 _REC_A1CUR_1_u2_u2_S2 15000 _CNV_R_R_Umr_1_zu_1_3_CM_S2 0 15000
 /begin AXIS_DESCR COM_AXIS W_DKKD _CNV_R_R_Umr_10_zu__9_CM_S2 15 0 120 DEPOSIT ABSOLUTE FORMAT "%3.1" AXIS_PTS_REF SSTSKL_SA1 /end AXIS_DESCR
 FORMAT "%2.0" /end CHARACTERISTIC
/begin CHARACTERISTIC SA178 "" CURVE 0x1E1A4E _REC_A1CUR_1_u2_u2_S2 15000 _CNV_R_R_Umr_1_zu_1_3_CM_S2 0 15000
 /begin AXIS_DESCR COM_AXIS W_DKKD _CNV_R_R_Umr_10_zu__9_CM_S2 15 0 120 DEPOSIT ABSOLUTE FORMAT "%3.1" AXIS_PTS_REF SSTSKL_SA1 /end AXIS_DESCR
 FORMAT "%2.0" /end CHARACTERISTIC
/begin CHARACTERISTIC SA187 "" CURVE 0x1E1A6C _REC_A1CUR_1_u2_u2_S2 15000 _CNV_R_R_Umr_1_zu_1_3_CM_S2 0 15000
 /begin AXIS_DESCR COM_AXIS W_DKKD _CNV_R_R_Umr_10_zu__9_CM_S2 15 0 120 DEPOSIT ABSOLUTE FORMAT "%3.1" AXIS_PTS_REF SSTSKL_SA1 /end AXIS_DESCR
 FORMAT "%2.0" /end CHARACTERISTIC
/begin CHARACTERISTIC SA212 "" CURVE 0x1E0842 _REC_A1CUR_1_u2_u2_S2 15000 _CNV_R_R_Umr_1_zu_1_3_CM_S2 0 15000
 /begin AXIS_DESCR COM_AXIS W_DKKD _CNV_R_R_Umr_10_zu__9_CM_S2 15 0 120 DEPOSIT ABSOLUTE FORMAT "%3.1" AXIS_PTS_REF SSTSKL_SA2 /end AXIS_DESCR
 FORMAT "%2.0" /end CHARACTERISTIC
/begin CHARACTERISTIC SA221 "" CURVE 0x1E0860 _REC_A1CUR_1_u2_u2_S2 15000 _CNV_R_R_Umr_1_zu_1_3_CM_S2 0 15000
 /begin AXIS_DESCR COM_AXIS W_DKKD _CNV_R_R_Umr_10_zu__9_CM_S2 15 0 120 DEPOSIT ABSOLUTE FORMAT "%3.1" AXIS_PTS_REF SSTSKL_SA2 /end AXIS_DESCR
 FORMAT "%2.0" /end CHARACTERISTIC
/begin CHARACTERISTIC SA223 "" CURVE 0x1E087E _REC_A1CUR_1_u2_u2_S2 15000 _CNV_R_R_Umr_1_zu_1_3_CM_S2 0 15000
 /begin AXIS_DESCR COM_AXIS W_DKKD _CNV_R_R_Umr_10_zu__9_CM_S2 15 0 120 DEPOSIT ABSOLUTE FORMAT "%3.1" AXIS_PTS_REF SSTSKL_SA2 /end AXIS_DESCR
 FORMAT "%2.0" /end CHARACTERISTIC
/begin CHARACTERISTIC SA232 "" CURVE 0x1E089C _REC_A1CUR_1_u2_u2_S2 15000 _CNV_R_R_Umr_1_zu_1_3_CM_S2 0 15000
 /begin AXIS_DESCR COM_AXIS W_DKKD _CNV_R_R_Umr_10_zu__9_CM_S2 15 0 120 DEPOSIT ABSOLUTE FORMAT "%3.1" AXIS_PTS_REF SSTSKL_SA2 /end AXIS_DESCR
 FORMAT "%2.0" /end CHARACTERISTIC
/begin CHARACTERISTIC SA234 "" CURVE 0x1E08BA _REC_A1CUR_1_u2_u2_S2 15000 _CNV_R_R_Umr_1_zu_1_3_CM_S2 0 15000
 /begin AXIS_DESCR COM_AXIS W_DKKD _CNV_R_R_Umr_10_zu__9_CM_S2 15 0 120 DEPOSIT ABSOLUTE FORMAT "%3.1" AXIS_PTS_REF SSTSKL_SA2 /end AXIS_DESCR
 FORMAT "%2.0" /end CHARACTERISTIC
/begin CHARACTERISTIC SA243 "" CURVE 0x1E08D8 _REC_A1CUR_1_u2_u2_S2 15000 _CNV_R_R_Umr_1_zu_1_3_CM_S2 0 15000
 /begin AXIS_DESCR COM_AXIS W_DKKD _CNV_R_R_Umr_10_zu__9_CM_S2 15 0 120 DEPOSIT ABSOLUTE FORMAT "%3.1" AXIS_PTS_REF SSTSKL_SA2 /end AXIS_DESCR
 FORMAT "%2.0" /end CHARACTERISTIC
/begin CHARACTERISTIC SA245 "" CURVE 0x1E08F6 _REC_A1CUR_1_u2_u2_S2 15000 _CNV_R_R_Umr_1_zu_1_3_CM_S2 0 15000
 /begin AXIS_DESCR COM_AXIS W_DKKD _CNV_R_R_Umr_10_zu__9_CM_S2 15 0 120 DEPOSIT ABSOLUTE FORMAT "%3.1" AXIS_PTS_REF SSTSKL_SA2 /end AXIS_DESCR
 FORMAT "%2.0" /end CHARACTERISTIC
/begin CHARACTERISTIC SA254 "" CURVE 0x1E0914 _REC_A1CUR_1_u2_u2_S2 15000 _CNV_R_R_Umr_1_zu_1_3_CM_S2 0 15000
 /begin AXIS_DESCR COM_AXIS W_DKKD _CNV_R_R_Umr_10_zu__9_CM_S2 15 0 120 DEPOSIT ABSOLUTE FORMAT "%3.1" AXIS_PTS_REF SSTSKL_SA2 /end AXIS_DESCR
 FORMAT "%2.0" /end CHARACTERISTIC
/begin CHARACTERISTIC SA256 "" CURVE 0x1E0932 _REC_A1CUR_1_u2_u2_S2 15000 _CNV_R_R_Umr_1_zu_1_3_CM_S2 0 15000
 /begin AXIS_DESCR COM_AXIS W_DKKD _CNV_R_R_Umr_10_zu__9_CM_S2 15 0 120 DEPOSIT ABSOLUTE FORMAT "%3.1" AXIS_PTS_REF SSTSKL_SA2 /end AXIS_DESCR
 FORMAT "%2.0" /end CHARACTERISTIC
/begin CHARACTERISTIC SA265 "" CURVE 0x1E0950 _REC_A1CUR_1_u2_u2_S2 15000 _CNV_R_R_Umr_1_zu_1_3_CM_S2 0 15000
 /begin AXIS_DESCR COM_AXIS W_DKKD _CNV_R_R_Umr_10_zu__9_CM_S2 15 0 120 DEPOSIT ABSOLUTE FORMAT "%3.1" AXIS_PTS_REF SSTSKL_SA2 /end AXIS_DESCR
 FORMAT "%2.0" /end CHARACTERISTIC
/begin CHARACTERISTIC SA267 "" CURVE 0x1E159E _REC_A1CUR_1_u2_u2_S2 15000 _CNV_R_R_Umr_1_zu_1_3_CM_S2 0 15000
 /begin AXIS_DESCR COM_AXIS W_DKKD _CNV_R_R_Umr_10_zu__9_CM_S2 15 0 120 DEPOSIT ABSOLUTE FORMAT "%3.1" AXIS_PTS_REF SSTSKL_SA2 /end AXIS_DESCR
 FORMAT "%2.0" /end CHARACTERISTIC
/begin CHARACTERISTIC SA276 "" CURVE 0x1E15BC _REC_A1CUR_1_u2_u2_S2 15000 _CNV_R_R_Umr_1_zu_1_3_CM_S2 0 15000
 /begin AXIS_DESCR COM_AXIS W_DKKD _CNV_R_R_Umr_10_zu__9_CM_S2 15 0 120 DEPOSIT ABSOLUTE FORMAT "%3.1" AXIS_PTS_REF SSTSKL_SA2 /end AXIS_DESCR
 FORMAT "%2.0" /end CHARACTERISTIC
/begin CHARACTERISTIC SA278 "" CURVE 0x1E1A8A _REC_A1CUR_1_u2_u2_S2 15000 _CNV_R_R_Umr_1_zu_1_3_CM_S2 0 15000
 /begin AXIS_DESCR COM_AXIS W_DKKD _CNV_R_R_Umr_10_zu__9_CM_S2 15 0 120 DEPOSIT ABSOLUTE FORMAT "%3.1" AXIS_PTS_REF SSTSKL_SA2 /end AXIS_DESCR
 FORMAT "%2.0" /end CHARACTERISTIC
/begin CHARACTERISTIC SA287 "" CURVE 0x1E1AA8 _REC_A1CUR_1_u2_u2_S2 15000 _CNV_R_R_Umr_1_zu_1_3_CM_S2 0 15000
 /begin AXIS_DESCR COM_AXIS W_DKKD _CNV_R_R_Umr_10_zu__9_CM_S2 15 0 120 DEPOSIT ABSOLUTE FORMAT "%3.1" AXIS_PTS_REF SSTSKL_SA2 /end AXIS_DESCR
 FORMAT "%2.0" /end CHARACTERISTIC
/begin CHARACTERISTIC SA312 "" CURVE 0x1E096E _REC_A1CUR_1_u2_u2_S2 15000 _CNV_R_R_Umr_1_zu_1_3_CM_S2 0 15000
 /begin AXIS_DESCR COM_AXIS W_DKKD _CNV_R_R_Umr_10_zu__9_CM_S2 15 0 120 DEPOSIT ABSOLUTE FORMAT "%3.1" AXIS_PTS_REF SSTSKL_SA3 /end AXIS_DESCR
 FORMAT "%2.0" /end CHARACTERISTIC
/begin CHARACTERISTIC SA321 "" CURVE 0x1E098C _REC_A1CUR_1_u2_u2_S2 15000 _CNV_R_R_Umr_1_zu_1_3_CM_S2 0 15000
 /begin AXIS_DESCR COM_AXIS W_DKKD _CNV_R_R_Umr_10_zu__9_CM_S2 15 0 120 DEPOSIT ABSOLUTE FORMAT "%3.1" AXIS_PTS_REF SSTSKL_SA3 /end AXIS_DESCR
 FORMAT "%2.0" /end CHARACTERISTIC
/begin CHARACTERISTIC SA323 "" CURVE 0x1E09AA _REC_A1CUR_1_u2_u2_S2 15000 _CNV_R_R_Umr_1_zu_1_3_CM_S2 0 15000
 /begin AXIS_DESCR COM_AXIS W_DKKD _CNV_R_R_Umr_10_zu__9_CM_S2 15 0 120 DEPOSIT ABSOLUTE FORMAT "%3.1" AXIS_PTS_REF SSTSKL_SA3 /end AXIS_DESCR
 FORMAT "%2.0" /end CHARACTERISTIC
/begin CHARACTERISTIC SA332 "" CURVE 0x1E09C8 _REC_A1CUR_1_u2_u2_S2 15000 _CNV_R_R_Umr_1_zu_1_3_CM_S2 0 15000
 /begin AXIS_DESCR COM_AXIS W_DKKD _CNV_R_R_Umr_10_zu__9_CM_S2 15 0 120 DEPOSIT ABSOLUTE FORMAT "%3.1" AXIS_PTS_REF SSTSKL_SA3 /end AXIS_DESCR
 FORMAT "%2.0" /end CHARACTERISTIC
/begin CHARACTERISTIC SA334 "" CURVE 0x1E09E6 _REC_A1CUR_1_u2_u2_S2 15000 _CNV_R_R_Umr_1_zu_1_3_CM_S2 0 15000
 /begin AXIS_DESCR COM_AXIS W_DKKD _CNV_R_R_Umr_10_zu__9_CM_S2 15 0 120 DEPOSIT ABSOLUTE FORMAT "%3.1" AXIS_PTS_REF SSTSKL_SA3 /end AXIS_DESCR
 FORMAT "%2.0" /end CHARACTERISTIC
/begin CHARACTERISTIC SA343 "" CURVE 0x1E0A04 _REC_A1CUR_1_u2_u2_S2 15000 _CNV_R_R_Umr_1_zu_1_3_CM_S2 0 15000
 /begin AXIS_DESCR COM_AXIS W_DKKD _CNV_R_R_Umr_10_zu__9_CM_S2 15 0 120 DEPOSIT ABSOLUTE FORMAT "%3.1" AXIS_PTS_REF SSTSKL_SA3 /end AXIS_DESCR
 FORMAT "%2.0" /end CHARACTERISTIC
/begin CHARACTERISTIC SA345 "" CURVE 0x1E0A22 _REC_A1CUR_1_u2_u2_S2 15000 _CNV_R_R_Umr_1_zu_1_3_CM_S2 0 15000
 /begin AXIS_DESCR COM_AXIS W_DKKD _CNV_R_R_Umr_10_zu__9_CM_S2 15 0 120 DEPOSIT ABSOLUTE FORMAT "%3.1" AXIS_PTS_REF SSTSKL_SA3 /end AXIS_DESCR
 FORMAT "%2.0" /end CHARACTERISTIC
/begin CHARACTERISTIC SA354 "" CURVE 0x1E0A40 _REC_A1CUR_1_u2_u2_S2 15000 _CNV_R_R_Umr_1_zu_1_3_CM_S2 0 15000
 /begin AXIS_DESCR COM_AXIS W_DKKD _CNV_R_R_Umr_10_zu__9_CM_S2 15 0 120 DEPOSIT ABSOLUTE FORMAT "%3.1" AXIS_PTS_REF SSTSKL_SA3 /end AXIS_DESCR
 FORMAT "%2.0" /end CHARACTERISTIC
/begin CHARACTERISTIC SA356 "" CURVE 0x1E0A5E _REC_A1CUR_1_u2_u2_S2 15000 _CNV_R_R_Umr_1_zu_1_3_CM_S2 0 15000
 /begin AXIS_DESCR COM_AXIS W_DKKD _CNV_R_R_Umr_10_zu__9_CM_S2 15 0 120 DEPOSIT ABSOLUTE FORMAT "%3.1" AXIS_PTS_REF SSTSKL_SA3 /end AXIS_DESCR
 FORMAT "%2.0" /end CHARACTERISTIC
/begin CHARACTERISTIC SA365 "" CURVE 0x1E0A7C _REC_A1CUR_1_u2_u2_S2 15000 _CNV_R_R_Umr_1_zu_1_3_CM_S2 0 15000
 /begin AXIS_DESCR COM_AXIS W_DKKD _CNV_R_R_Umr_10_zu__9_CM_S2 15 0 120 DEPOSIT ABSOLUTE FORMAT "%3.1" AXIS_PTS_REF SSTSKL_SA3 /end AXIS_DESCR
 FORMAT "%2.0" /end CHARACTERISTIC
/begin CHARACTERISTIC SA367 "" CURVE 0x1E15DA _REC_A1CUR_1_u2_u2_S2 15000 _CNV_R_R_Umr_1_zu_1_3_CM_S2 0 15000
 /begin AXIS_DESCR COM_AXIS W_DKKD _CNV_R_R_Umr_10_zu__9_CM_S2 15 0 120 DEPOSIT ABSOLUTE FORMAT "%3.1" AXIS_PTS_REF SSTSKL_SA3 /end AXIS_DESCR
 FORMAT "%2.0" /end CHARACTERISTIC
/begin CHARACTERISTIC SA376 "" CURVE 0x1E15F8 _REC_A1CUR_1_u2_u2_S2 15000 _CNV_R_R_Umr_1_zu_1_3_CM_S2 0 15000
 /begin AXIS_DESCR COM_AXIS W_DKKD _CNV_R_R_Umr_10_zu__9_CM_S2 15 0 120 DEPOSIT ABSOLUTE FORMAT "%3.1" AXIS_PTS_REF SSTSKL_SA3 /end AXIS_DESCR
 FORMAT "%2.0" /end CHARACTERISTIC
/begin CHARACTERISTIC SA378 "" CURVE 0x1E1AC6 _REC_A1CUR_1_u2_u2_S2 15000 _CNV_R_R_Umr_1_zu_1_3_CM_S2 0 15000
 /begin AXIS_DESCR COM_AXIS W_DKKD _CNV_R_R_Umr_10_zu__9_CM_S2 15 0 120 DEPOSIT ABSOLUTE FORMAT "%3.1" AXIS_PTS_REF SSTSKL_SA3 /end AXIS_DESCR
 FORMAT "%2.0" /end CHARACTERISTIC
/begin CHARACTERISTIC SA387 "" CURVE 0x1E1AE4 _REC_A1CUR_1_u2_u2_S2 15000 _CNV_R_R_Umr_1_zu_1_3_CM_S2 0 15000
 /begin AXIS_DESCR COM_AXIS W_DKKD _CNV_R_R_Umr_10_zu__9_CM_S2 15 0 120 DEPOSIT ABSOLUTE FORMAT "%3.1" AXIS_PTS_REF SSTSKL_SA3 /end AXIS_DESCR
 FORMAT "%2.0" /end CHARACTERISTIC
/begin CHARACTERISTIC SA412 "" CURVE 0x1E0A9A _REC_A1CUR_1_u2_u2_S2 15000 _CNV_R_R_Umr_1_zu_1_3_CM_S2 0 15000
 /begin AXIS_DESCR COM_AXIS W_DKKD _CNV_R_R_Umr_10_zu__9_CM_S2 15 0 120 DEPOSIT ABSOLUTE FORMAT "%3.1" AXIS_PTS_REF SSTSKL_SA4 /end AXIS_DESCR
 FORMAT "%2.0" /end CHARACTERISTIC
/begin CHARACTERISTIC SA421 "" CURVE 0x1E0AB8 _REC_A1CUR_1_u2_u2_S2 15000 _CNV_R_R_Umr_1_zu_1_3_CM_S2 0 15000
 /begin AXIS_DESCR COM_AXIS W_DKKD _CNV_R_R_Umr_10_zu__9_CM_S2 15 0 120 DEPOSIT ABSOLUTE FORMAT "%3.1" AXIS_PTS_REF SSTSKL_SA4 /end AXIS_DESCR
 FORMAT "%2.0" /end CHARACTERISTIC
/begin CHARACTERISTIC SA423 "" CURVE 0x1E0AD6 _REC_A1CUR_1_u2_u2_S2 15000 _CNV_R_R_Umr_1_zu_1_3_CM_S2 0 15000
 /begin AXIS_DESCR COM_AXIS W_DKKD _CNV_R_R_Umr_10_zu__9_CM_S2 15 0 120 DEPOSIT ABSOLUTE FORMAT "%3.1" AXIS_PTS_REF SSTSKL_SA4 /end AXIS_DESCR
 FORMAT "%2.0" /end CHARACTERISTIC
/begin CHARACTERISTIC SA432 "" CURVE 0x1E0AF4 _REC_A1CUR_1_u2_u2_S2 15000 _CNV_R_R_Umr_1_zu_1_3_CM_S2 0 15000
 /begin AXIS_DESCR COM_AXIS W_DKKD _CNV_R_R_Umr_10_zu__9_CM_S2 15 0 120 DEPOSIT ABSOLUTE FORMAT "%3.1" AXIS_PTS_REF SSTSKL_SA4 /end AXIS_DESCR
 FORMAT "%2.0" /end CHARACTERISTIC
/begin CHARACTERISTIC SA434 "" CURVE 0x1E0B12 _REC_A1CUR_1_u2_u2_S2 15000 _CNV_R_R_Umr_1_zu_1_3_CM_S2 0 15000
 /begin AXIS_DESCR COM_AXIS W_DKKD _CNV_R_R_Umr_10_zu__9_CM_S2 15 0 120 DEPOSIT ABSOLUTE FORMAT "%3.1" AXIS_PTS_REF SSTSKL_SA4 /end AXIS_DESCR
 FORMAT "%2.0" /end CHARACTERISTIC
/begin CHARACTERISTIC SA443 "" CURVE 0x1E0B30 _REC_A1CUR_1_u2_u2_S2 15000 _CNV_R_R_Umr_1_zu_1_3_CM_S2 0 15000
 /begin AXIS_DESCR COM_AXIS W_DKKD _CNV_R_R_Umr_10_zu__9_CM_S2 15 0 120 DEPOSIT ABSOLUTE FORMAT "%3.1" AXIS_PTS_REF SSTSKL_SA4 /end AXIS_DESCR
 FORMAT "%2.0" /end CHARACTERISTIC
/begin CHARACTERISTIC SA445 "" CURVE 0x1E0B4E _REC_A1CUR_1_u2_u2_S2 15000 _CNV_R_R_Umr_1_zu_1_3_CM_S2 0 15000
 /begin AXIS_DESCR COM_AXIS W_DKKD _CNV_R_R_Umr_10_zu__9_CM_S2 15 0 120 DEPOSIT ABSOLUTE FORMAT "%3.1" AXIS_PTS_REF SSTSKL_SA4 /end AXIS_DESCR
 FORMAT "%2.0" /end CHARACTERISTIC
/begin CHARACTERISTIC SA454 "" CURVE 0x1E0B6C _REC_A1CUR_1_u2_u2_S2 15000 _CNV_R_R_Umr_1_zu_1_3_CM_S2 0 15000
 /begin AXIS_DESCR COM_AXIS W_DKKD _CNV_R_R_Umr_10_zu__9_CM_S2 15 0 120 DEPOSIT ABSOLUTE FORMAT "%3.1" AXIS_PTS_REF SSTSKL_SA4 /end AXIS_DESCR
 FORMAT "%2.0" /end CHARACTERISTIC
/begin CHARACTERISTIC SA456 "" CURVE 0x1E0B8A _REC_A1CUR_1_u2_u2_S2 15000 _CNV_R_R_Umr_1_zu_1_3_CM_S2 0 15000
 /begin AXIS_DESCR COM_AXIS W_DKKD _CNV_R_R_Umr_10_zu__9_CM_S2 15 0 120 DEPOSIT ABSOLUTE FORMAT "%3.1" AXIS_PTS_REF SSTSKL_SA4 /end AXIS_DESCR
 FORMAT "%2.0" /end CHARACTERISTIC
/begin CHARACTERISTIC SA465 "" CURVE 0x1E0BA8 _REC_A1CUR_1_u2_u2_S2 15000 _CNV_R_R_Umr_1_zu_1_3_CM_S2 0 15000
 /begin AXIS_DESCR COM_AXIS W_DKKD _CNV_R_R_Umr_10_zu__9_CM_S2 15 0 120 DEPOSIT ABSOLUTE FORMAT "%3.1" AXIS_PTS_REF SSTSKL_SA4 /end AXIS_DESCR
 FORMAT "%2.0" /end CHARACTERISTIC
/begin CHARACTERISTIC SA467 "" CURVE 0x1E1616 _REC_A1CUR_1_u2_u2_S2 15000 _CNV_R_R_Umr_1_zu_1_3_CM_S2 0 15000
 /begin AXIS_DESCR COM_AXIS W_DKKD _CNV_R_R_Umr_10_zu__9_CM_S2 15 0 120 DEPOSIT ABSOLUTE FORMAT "%3.1" AXIS_PTS_REF SSTSKL_SA4 /end AXIS_DESCR
 FORMAT "%2.0" /end CHARACTERISTIC
/begin CHARACTERISTIC SA476 "" CURVE 0x1E1634 _REC_A1CUR_1_u2_u2_S2 15000 _CNV_R_R_Umr_1_zu_1_3_CM_S2 0 15000
 /begin AXIS_DESCR COM_AXIS W_DKKD _CNV_R_R_Umr_10_zu__9_CM_S2 15 0 120 DEPOSIT ABSOLUTE FORMAT "%3.1" AXIS_PTS_REF SSTSKL_SA4 /end AXIS_DESCR
 FORMAT "%2.0" /end CHARACTERISTIC
/begin CHARACTERISTIC SA478 "" CURVE 0x1E1B02 _REC_A1CUR_1_u2_u2_S2 15000 _CNV_R_R_Umr_1_zu_1_3_CM_S2 0 15000
 /begin AXIS_DESCR COM_AXIS W_DKKD _CNV_R_R_Umr_10_zu__9_CM_S2 15 0 120 DEPOSIT ABSOLUTE FORMAT "%3.1" AXIS_PTS_REF SSTSKL_SA4 /end AXIS_DESCR
 FORMAT "%2.0" /end CHARACTERISTIC
/begin CHARACTERISTIC SA487 "" CURVE 0x1E1B20 _REC_A1CUR_1_u2_u2_S2 15000 _CNV_R_R_Umr_1_zu_1_3_CM_S2 0 15000
 /begin AXIS_DESCR COM_AXIS W_DKKD _CNV_R_R_Umr_10_zu__9_CM_S2 15 0 120 DEPOSIT ABSOLUTE FORMAT "%3.1" AXIS_PTS_REF SSTSKL_SA4 /end AXIS_DESCR
 FORMAT "%2.0" /end CHARACTERISTIC
/begin MEASUREMENT SCHA_Q_HSURE_KU "" SWORD _CNV_R_R_Umr_10_zu__37_CM_S2 1 0 -3276.8 3276.7 ECU_ADDRESS 0xFFF8E65C FORMAT "%3.1" /end MEASUREMENT
/begin MEASUREMENT SCHA_Q_SERP "" UWORD _CNV_R_R_Umr_10_zu__37_CM_S2 1 0 0 6553.5 ECU_ADDRESS 0xFFF8E688 FORMAT "%3.1" /end MEASUREMENT
/begin MEASUREMENT SCHDA_Q_HSURE_KUVOR "" SWORD _CNV_R_R_Umr_10_zu__37_CM_S2 1 0 -20 20 ECU_ADDRESS 0xFFF8E660 FORMAT "%3.1" /end MEASUREMENT
/begin MEASUREMENT SCHDM_AB_FWSZW_HS "" SWORD _CNV_R_R_Umr_1_zu_1_38_CM_S2 1 0 -32768 32767 ECU_ADDRESS 0xFFF8E442 FORMAT "%2.0" /end MEASUREMENT
/begin MEASUREMENT SCHDN_SCHLUPF_HA "" UWORD _CNV_R_R_Umr_1_zu_1_3_CM_S2 1 0 0 20000 ECU_ADDRESS 0xFFF8E7BA FORMAT "%2.0" /end MEASUREMENT
/begin MEASUREMENT SCHDN_SCHLUPF_VA "" UWORD _CNV_R_R_Umr_1_zu_1_3_CM_S2 1 0 0 20000 ECU_ADDRESS 0xFFF8E7BC FORMAT "%2.0" /end MEASUREMENT
/begin MEASUREMENT SCHDN_SCHLUPF_VFZG "" UWORD _CNV_R_R_Umr_1_zu_1_3_CM_S2 1 0 0 20000 ECU_ADDRESS 0xFFF8E7BE FORMAT "%2.0" /end MEASUREMENT
/begin MEASUREMENT SCHDW_DKKD_REST "" SWORD _CNV_R_R_Umr_1_zu_1_266_CM_S2 1 0 -100 100 ECU_ADDRESS 0xFFF8E482 FORMAT "%2.0" /end MEASUREMENT
/begin MEASUREMENT SCHGW_FP_DMRS "" SLONG _CNV_R_R_Umr_1_zu_1_110_CM_S2 1 0 -2147483647 2147483647 ECU_ADDRESS 0xFFF8EE58 FORMAT "%2.0" /end MEASUREMENT
/begin MEASUREMENT SCHGW_FP_DMRSKORRFAKT "" UWORD _CNV_R_R_Umr_1_zu_1_2_CM_S2 1 0 0 200 ECU_ADDRESS 0xFFF8E484 FORMAT "%2.0" /end MEASUREMENT
/begin MEASUREMENT SCHLUPF_BUF_SUM_HSURE "" UWORD _CNV_R_R_Umr_1_zu_1_2_CM_S2 1 0 0 65535 ECU_ADDRESS 0xFFF8E636 FORMAT "%2.0" /end MEASUREMENT
/begin MEASUREMENT SCHLUPF_GEW_HSURE_BUF "" UWORD _CNV_R_R_Umr_1_zu_1_2_CM_S2 1 0 0 65535 ECU_ADDRESS 0xFFF8EFF8 FORMAT "%2.0" MATRIX_DIM 16 1 1 /end MEASUREMENT
/begin MEASUREMENT SCHN_ABAKTSTRAT_MAX_DBM "" SWORD _CNV_R_R_Umr_1_zu_1_3_CM_S2 1 0 -32768 32767 ECU_ADDRESS 0xFFF8E2F8 FORMAT "%2.0" /end MEASUREMENT
/begin MEASUREMENT SCHN_ABAKTSTRAT_MIN_DBM "" SWORD _CNV_R_R_Umr_1_zu_1_3_CM_S2 1 0 -32768 32767 ECU_ADDRESS 0xFFF8E2FA FORMAT "%2.0" /end MEASUREMENT
/begin MEASUREMENT SCHN_ABHISTRAT_MAX_DBM "" SWORD _CNV_R_R_Umr_1_zu_1_3_CM_S2 1 0 -32768 32767 ECU_ADDRESS 0xFFF8E2FC FORMAT "%2.0" /end MEASUREMENT
/begin MEASUREMENT SCHN_ABLOSTRAT_MIN_DBM "" SWORD _CNV_R_R_Umr_1_zu_1_3_CM_S2 1 0 -32768 32767 ECU_ADDRESS 0xFFF8E2FE FORMAT "%2.0" /end MEASUREMENT
/begin MEASUREMENT SCHN_ABSEGELN_MAX_DBM "" SWORD _CNV_R_R_Umr_1_zu_1_3_CM_S2 1 0 0 10000 ECU_ADDRESS 0xFFF8E300 FORMAT "%2.0" /end MEASUREMENT
/begin MEASUREMENT SCHN_ABSEGELN_MIN_DBM "" SWORD _CNV_R_R_Umr_1_zu_1_3_CM_S2 1 0 0 10000 ECU_ADDRESS 0xFFF8E302 FORMAT "%2.0" /end MEASUREMENT
/begin MEASUREMENT SCHN_AB_DERS "" UWORD _CNV_R_R_Umr_1_zu_1_3_CM_S2 1 0 0 20000 ECU_ADDRESS 0xFFF8E88E FORMAT "%2.0" /end MEASUREMENT
/begin MEASUREMENT SCHN_AB_HS "" UWORD _CNV_R_R_Umr_1_zu_1_3_CM_S2 1 0 0 20000 ECU_ADDRESS 0xFFF8E406 FORMAT "%2.0" /end MEASUREMENT
/begin MEASUREMENT SCHN_AB_HSSKL "" UWORD _CNV_R_R_Umr_1_zu_1_3_CM_S2 1 0 0 20000 ECU_ADDRESS 0xFFF8E408 FORMAT "%2.0" /end MEASUREMENT
/begin MEASUREMENT SCHN_AB_HSURERS "" UWORD _CNV_R_R_Umr_1_zu_1_3_CM_S2 1 0 0 15000 ECU_ADDRESS 0xFFF8E662 FORMAT "%2.0" /end MEASUREMENT
/begin MEASUREMENT SCHN_AB_HSVOLLAST "" UWORD _CNV_R_R_Umr_1_zu_1_3_CM_S2 1 0 0 20000 ECU_ADDRESS 0xFFF8E40A FORMAT "%2.0" /end MEASUREMENT
/begin MEASUREMENT SCHN_AB_KD "" UWORD _CNV_R_R_Umr_1_zu_1_3_CM_S2 1 0 0 20000 ECU_ADDRESS 0xFFF8E40C FORMAT "%2.0" MATRIX_DIM 9 1 1 /end MEASUREMENT
/begin MEASUREMENT SCHN_AB_REG_HSURESCHLUPF "" UWORD _CNV_R_R_Umr_1_zu_1_3_CM_S2 1 0 0 15000 ECU_ADDRESS 0xFFF8E668 FORMAT "%2.0" /end MEASUREMENT
/begin MEASUREMENT SCHN_AB_RSFOLLOWHS "" UWORD _CNV_R_R_Umr_1_zu_1_3_CM_S2 1 0 0 20000 ECU_ADDRESS 0xFFF8E41E FORMAT "%2.0" /end MEASUREMENT
/begin MEASUREMENT SCHN_AB_RSFOLLOWHS_NL "" UWORD _CNV_R_R_Umr_1_zu_1_3_CM_S2 1 0 0 20000 ECU_ADDRESS 0xFFF8E420 FORMAT "%2.0" /end MEASUREMENT
/begin MEASUREMENT SCHN_AB_RSSKL "" UWORD _CNV_R_R_Umr_1_zu_1_3_CM_S2 1 0 0 30000 ECU_ADDRESS 0xFFF8E422 FORMAT "%2.0" /end MEASUREMENT
/begin MEASUREMENT SCHN_AB_STD_RSSKL "" UWORD _CNV_R_R_Umr_1_zu_1_3_CM_S2 1 0 0 20000 ECU_ADDRESS 0xFFF8E424 FORMAT "%2.0" /end MEASUREMENT
/begin MEASUREMENT SCHN_AKTABREGELDSCERR_MAX_DBM "" SWORD _CNV_R_R_Umr_1_zu_1_3_CM_S2 1 0 -32768 32767 ECU_ADDRESS 0xFFF8E304 FORMAT "%2.0" /end MEASUREMENT
/begin MEASUREMENT SCHN_AKTBAUTSCHUTZ_MAX_DBM "" SWORD _CNV_R_R_Umr_1_zu_1_3_CM_S2 1 0 -32768 32767 ECU_ADDRESS 0xFFF8E306 FORMAT "%2.0" /end MEASUREMENT
/begin MEASUREMENT SCHN_AKTBAUTSCHUTZ_MIN_DBM "" SWORD _CNV_R_R_Umr_1_zu_1_3_CM_S2 1 0 -32768 32767 ECU_ADDRESS 0xFFF8E308 FORMAT "%2.0" /end MEASUREMENT
/begin MEASUREMENT SCHN_AKTUMWELT_MAX_DBM "" SWORD _CNV_R_R_Umr_1_zu_1_3_CM_S2 1 0 -32768 32767 ECU_ADDRESS 0xFFF8E30A FORMAT "%2.0" /end MEASUREMENT
/begin MEASUREMENT SCHN_AKTUMWELT_MIN_DBM "" SWORD _CNV_R_R_Umr_1_zu_1_3_CM_S2 1 0 -32768 32767 ECU_ADDRESS 0xFFF8E30C FORMAT "%2.0" /end MEASUREMENT
/begin MEASUREMENT SCHN_HIABREGELDSCERR_MAX_DBM "" SWORD _CNV_R_R_Umr_1_zu_1_3_CM_S2 1 0 -32768 32767 ECU_ADDRESS 0xFFF8E30E FORMAT "%2.0" /end MEASUREMENT
/begin MEASUREMENT SCHN_HIBAUTSCHUTZ_MAX_DBM "" SWORD _CNV_R_R_Umr_1_zu_1_3_CM_S2 1 0 -32768 32767 ECU_ADDRESS 0xFFF8E310 FORMAT "%2.0" /end MEASUREMENT
/begin MEASUREMENT SCHN_HIUMWELT_MAX_DBM "" SWORD _CNV_R_R_Umr_1_zu_1_3_CM_S2 1 0 -32768 32767 ECU_ADDRESS 0xFFF8E312 FORMAT "%2.0" /end MEASUREMENT
/begin MEASUREMENT SCHN_LOBAUTSCHUTZ_MIN_DBM "" SWORD _CNV_R_R_Umr_1_zu_1_3_CM_S2 1 0 -32768 32767 ECU_ADDRESS 0xFFF8E314 FORMAT "%2.0" /end MEASUREMENT
/begin MEASUREMENT SCHN_LOUMWELT_MIN_DBM "" SWORD _CNV_R_R_Umr_1_zu_1_3_CM_S2 1 0 -32768 32767 ECU_ADDRESS 0xFFF8E316 FORMAT "%2.0" /end MEASUREMENT
/begin MEASUREMENT SCHN_MAX_K0 "" SWORD _CNV_R_R_Umr_1_zu_1_3_CM_S2 1 0 -32768 32767 ECU_ADDRESS 0xFFF8E318 FORMAT "%2.0" /end MEASUREMENT
/begin MEASUREMENT SCHN_MIN_K0 "" SWORD _CNV_R_R_Umr_1_zu_1_3_CM_S2 1 0 -32768 32767 ECU_ADDRESS 0xFFF8E31A FORMAT "%2.0" /end MEASUREMENT
/begin MEASUREMENT SCHN_MOTMAX_RSZ_BAB "" UWORD _CNV_R_R_Umr_1_zu_1_3_CM_S2 1 0 0 20000 ECU_ADDRESS 0xFFF8E85A FORMAT "%2.0" /end MEASUREMENT
/begin MEASUREMENT SCHN_MOT_MAX_RSUMUELOW "" UWORD _CNV_P_2_A_I_32_CM_S2 1 0 0 65535 ECU_ADDRESS 0xFFF8E8AE /end MEASUREMENT
/begin MEASUREMENT SCHN_MOT_QS_DOWNGRADE "" UWORD _CNV_R_R_Umr_1_zu_1_3_CM_S2 1 0 0 20000 ECU_ADDRESS 0xFFF8E3D4 FORMAT "%2.0" /end MEASUREMENT
/begin MEASUREMENT SCHN_TAKTBAUTSCHUTZ_MIN_DBM "" SWORD _CNV_R_R_Umr_1_zu_1_3_CM_S2 1 0 -32768 32767 ECU_ADDRESS 0xFFF8E31C FORMAT "%2.0" /end MEASUREMENT
/begin MEASUREMENT SCHN_TAKTUMWELT_MIN_DBM "" SWORD _CNV_R_R_Umr_1_zu_1_3_CM_S2 1 0 -32768 32767 ECU_ADDRESS 0xFFF8E31E FORMAT "%2.0" /end MEASUREMENT
/begin MEASUREMENT SCHN_TLOBAUTSCHUTZ_MIN_DBM "" SWORD _CNV_R_R_Umr_1_zu_1_3_CM_S2 1 0 -32768 32767 ECU_ADDRESS 0xFFF8E320 FORMAT "%2.0" /end MEASUREMENT
/begin MEASUREMENT SCHN_TLOUMWELT_MIN_DBM "" SWORD _CNV_R_R_Umr_1_zu_1_3_CM_S2 1 0 -32768 32767 ECU_ADDRESS 0xFFF8E322 FORMAT "%2.0" /end MEASUREMENT
/begin MEASUREMENT SCHN_TMAX_MODBEDEL_DBM "" SWORD _CNV_R_R_Umr_1_zu_1_3_CM_S2 1 0 -32768 32767 ECU_ADDRESS 0xFFF8E324 FORMAT "%2.0" /end MEASUREMENT
/begin MEASUREMENT SCHN_T_MAXSPEICHER_TIPP_MINUS "" UWORD _CNV_R_R_Umr_1_zu_1_3_CM_S2 1 0 0 20000 ECU_ADDRESS 0xFFF8E3EA FORMAT "%2.0" /end MEASUREMENT
/begin MEASUREMENT SCHN_T_MDSMAXRS "" UWORD _CNV_R_R_Umr_1_zu_1_3_CM_S2 1 0 0 20000 ECU_ADDRESS 0xFFF8E730 FORMAT "%2.0" /end MEASUREMENT
/begin MEASUREMENT SCHW_DKKD_HSURERS "" UWORD _CNV_R_R_Umr_10_zu__9_CM_S2 1 0 0 110 ECU_ADDRESS 0xFFF8E664 FORMAT "%3.1" /end MEASUREMENT
/begin MEASUREMENT SCHW_LWVA_EFF_KURVE "" SWORD _CNV_R_R_Umr_10_zu__10_CM_S2 1 0 -90 90 ECU_ADDRESS 0xFFF8E68A FORMAT "%3.1" /end MEASUREMENT
/begin MEASUREMENT SCHW_LWVA_EFF_SERP "" SWORD _CNV_R_R_Umr_10_zu__10_CM_S2 1 0 -90 90 ECU_ADDRESS 0xFFF8E68C FORMAT "%3.1" /end MEASUREMENT
/begin MEASUREMENT SCHW_MRADSOLL_STABKRI_HIGH_ZKA "" SLONG _CNV_R_R_Umr_1_zu_1_38_CM_S2 1 0 -2147483648 2147483647 ECU_ADDRESS 0xFFF8F250 FORMAT "%2.0" /end MEASUREMENT
/begin MEASUREMENT SCHW_MRADSOLL_STABKRI_LOW_ZKA "" SLONG _CNV_R_R_Umr_1_zu_1_38_CM_S2 1 0 -2147483648 2147483647 ECU_ADDRESS 0xFFF8F254 FORMAT "%2.0" /end MEASUREMENT
/begin MEASUREMENT SCHW_STEIGUNG_BABAUS "" SWORD _CNV_R_R_Umr_10_zu__9_CM_S2 1 0 -3276.8 3276.7 ECU_ADDRESS 0xFFF8E42E FORMAT "%3.1" /end MEASUREMENT
/begin MEASUREMENT SCHW_STEIGUNG_BABEIN "" SWORD _CNV_R_R_Umr_10_zu__9_CM_S2 1 0 -3276.8 3276.7 ECU_ADDRESS 0xFFF8E430 FORMAT "%3.1" /end MEASUREMENT
/begin MEASUREMENT SCHW_VFZG_STABKRI_HIGH_ZKA "" SLONG _CNV_R_R_Umr_1_zu_1_8_CM_S2 1 0 -2147483648 2147483647 ECU_ADDRESS 0xFFF8F258 FORMAT "%2.0" /end MEASUREMENT
/begin MEASUREMENT SCHW_VFZG_STABKRI_LOW_ZKA "" SLONG _CNV_R_R_Umr_1_zu_1_8_CM_S2 1 0 -2147483648 2147483647 ECU_ADDRESS 0xFFF8F25C FORMAT "%2.0" /end MEASUREMENT
/begin MEASUREMENT SMPL_SCHLUPF_GEW "" UWORD _CNV_R_R_Umr_1_zu_1_2_CM_S2 1 0 0 65535 ECU_ADDRESS 0xFFF8E738 FORMAT "%2.0" /end MEASUREMENT
/begin MEASUREMENT SMPL_SCHLUPF_GEWBUFFER "" UWORD _CNV_R_R_Umr_1_zu_1_2_CM_S2 1 0 0 65535 ECU_ADDRESS 0xFFF8F12C FORMAT "%2.0" MATRIX_DIM 16 1 1 /end MEASUREMENT
/begin CHARACTERISTIC SO112 "" CURVE 0x1E0BC6 _REC_A1CUR_1_u2_u2_S2 15000 _CNV_R_R_Umr_1_zu_1_3_CM_S2 0 15000
 /begin AXIS_DESCR COM_AXIS W_DKKD _CNV_R_R_Umr_10_zu__9_CM_S2 15 0 120 DEPOSIT ABSOLUTE FORMAT "%3.1" AXIS_PTS_REF SSTSKL_SO1 /end AXIS_DESCR
 FORMAT "%2.0" /end CHARACTERISTIC
/begin CHARACTERISTIC SO121 "" CURVE 0x1E0BE4 _REC_A1CUR_1_u2_u2_S2 15000 _CNV_R_R_Umr_1_zu_1_3_CM_S2 0 15000
 /begin AXIS_DESCR COM_AXIS W_DKKD _CNV_R_R_Umr_10_zu__9_CM_S2 15 0 120 DEPOSIT ABSOLUTE FORMAT "%3.1" AXIS_PTS_REF SSTSKL_SO1 /end AXIS_DESCR
 FORMAT "%2.0" /end CHARACTERISTIC
/begin CHARACTERISTIC SO123 "" CURVE 0x1E0C02 _REC_A1CUR_1_u2_u2_S2 15000 _CNV_R_R_Umr_1_zu_1_3_CM_S2 0 15000
 /begin AXIS_DESCR COM_AXIS W_DKKD _CNV_R_R_Umr_10_zu__9_CM_S2 15 0 120 DEPOSIT ABSOLUTE FORMAT "%3.1" AXIS_PTS_REF SSTSKL_SO1 /end AXIS_DESCR
 FORMAT "%2.0" /end CHARACTERISTIC
/begin CHARACTERISTIC SO132 "" CURVE 0x1E0C20 _REC_A1CUR_1_u2_u2_S2 15000 _CNV_R_R_Umr_1_zu_1_3_CM_S2 0 15000
 /begin AXIS_DESCR COM_AXIS W_DKKD _CNV_R_R_Umr_10_zu__9_CM_S2 15 0 120 DEPOSIT ABSOLUTE FORMAT "%3.1" AXIS_PTS_REF SSTSKL_SO1 /end AXIS_DESCR
 FORMAT "%2.0" /end CHARACTERISTIC
/begin CHARACTERISTIC SO134 "" CURVE 0x1E0C3E _REC_A1CUR_1_u2_u2_S2 15000 _CNV_R_R_Umr_1_zu_1_3_CM_S2 0 15000
 /begin AXIS_DESCR COM_AXIS W_DKKD _CNV_R_R_Umr_10_zu__9_CM_S2 15 0 120 DEPOSIT ABSOLUTE FORMAT "%3.1" AXIS_PTS_REF SSTSKL_SO1 /end AXIS_DESCR
 FORMAT "%2.0" /end CHARACTERISTIC
/begin CHARACTERISTIC SO143 "" CURVE 0x1E0C5C _REC_A1CUR_1_u2_u2_S2 15000 _CNV_R_R_Umr_1_zu_1_3_CM_S2 0 15000
 /begin AXIS_DESCR COM_AXIS W_DKKD _CNV_R_R_Umr_10_zu__9_CM_S2 15 0 120 DEPOSIT ABSOLUTE FORMAT "%3.1" AXIS_PTS_REF SSTSKL_SO1 /end AXIS_DESCR
 FORMAT "%2.0" /end CHARACTERISTIC
/begin CHARACTERISTIC SO145 "" CURVE 0x1E0C7A _REC_A1CUR_1_u2_u2_S2 15000 _CNV_R_R_Umr_1_zu_1_3_CM_S2 0 15000
 /begin AXIS_DESCR COM_AXIS W_DKKD _CNV_R_R_Umr_10_zu__9_CM_S2 15 0 120 DEPOSIT ABSOLUTE FORMAT "%3.1" AXIS_PTS_REF SSTSKL_SO1 /end AXIS_DESCR
 FORMAT "%2.0" /end CHARACTERISTIC
/begin CHARACTERISTIC SO154 "" CURVE 0x1E0C98 _REC_A1CUR_1_u2_u2_S2 15000 _CNV_R_R_Umr_1_zu_1_3_CM_S2 0 15000
 /begin AXIS_DESCR COM_AXIS W_DKKD _CNV_R_R_Umr_10_zu__9_CM_S2 15 0 120 DEPOSIT ABSOLUTE FORMAT "%3.1" AXIS_PTS_REF SSTSKL_SO1 /end AXIS_DESCR
 FORMAT "%2.0" /end CHARACTERISTIC
/begin CHARACTERISTIC SO156 "" CURVE 0x1E0CB6 _REC_A1CUR_1_u2_u2_S2 15000 _CNV_R_R_Umr_1_zu_1_3_CM_S2 0 15000
 /begin AXIS_DESCR COM_AXIS W_DKKD _CNV_R_R_Umr_10_zu__9_CM_S2 15 0 120 DEPOSIT ABSOLUTE FORMAT "%3.1" AXIS_PTS_REF SSTSKL_SO1 /end AXIS_DESCR
 FORMAT "%2.0" /end CHARACTERISTIC
/begin CHARACTERISTIC SO165 "" CURVE 0x1E0CD4 _REC_A1CUR_1_u2_u2_S2 15000 _CNV_R_R_Umr_1_zu_1_3_CM_S2 0 15000
 /begin AXIS_DESCR COM_AXIS W_DKKD _CNV_R_R_Umr_10_zu__9_CM_S2 15 0 120 DEPOSIT ABSOLUTE FORMAT "%3.1" AXIS_PTS_REF SSTSKL_SO1 /end AXIS_DESCR
 FORMAT "%2.0" /end CHARACTERISTIC
/begin CHARACTERISTIC SO167 "" CURVE 0x1E1652 _REC_A1CUR_1_u2_u2_S2 15000 _CNV_R_R_Umr_1_zu_1_3_CM_S2 0 15000
 /begin AXIS_DESCR COM_AXIS W_DKKD _CNV_R_R_Umr_10_zu__9_CM_S2 15 0 120 DEPOSIT ABSOLUTE FORMAT "%3.1" AXIS_PTS_REF SSTSKL_SO1 /end AXIS_DESCR
 FORMAT "%2.0" /end CHARACTERISTIC
/begin CHARACTERISTIC SO176 "" CURVE 0x1E1670 _REC_A1CUR_1_u2_u2_S2 15000 _CNV_R_R_Umr_1_zu_1_3_CM_S2 0 15000
 /begin AXIS_DESCR COM_AXIS W_DKKD _CNV_R_R_Umr_10_zu__9_CM_S2 15 0 120 DEPOSIT ABSOLUTE FORMAT "%3.1" AXIS_PTS_REF SSTSKL_SO1 /end AXIS_DESCR
 FORMAT "%2.0" /end CHARACTERISTIC
/begin CHARACTERISTIC SO178 "" CURVE 0x1E1B3E _REC_A1CUR_1_u2_u2_S2 15000 _CNV_R_R_Umr_1_zu_1_3_CM_S2 0 15000
 /begin AXIS_DESCR COM_AXIS W_DKKD _CNV_R_R_Umr_10_zu__9_CM_S2 15 0 120 DEPOSIT ABSOLUTE FORMAT "%3.1" AXIS_PTS_REF SSTSKL_SO1 /end AXIS_DESCR
 FORMAT "%2.0" /end CHARACTERISTIC
/begin CHARACTERISTIC SO187 "" CURVE 0x1E1B5C _REC_A1CUR_1_u2_u2_S2 15000 _CNV_R_R_Umr_1_zu_1_3_CM_S2 0 15000
 /begin AXIS_DESCR COM_AXIS W_DKKD _CNV_R_R_Umr_10_zu__9_CM_S2 15 0 120 DEPOSIT ABSOLUTE FORMAT "%3.1" AXIS_PTS_REF SSTSKL_SO1 /end AXIS_DESCR
 FORMAT "%2.0" /end CHARACTERISTIC
/begin CHARACTERISTIC SO212 "" CURVE 0x1E0CF2 _REC_A1CUR_1_u2_u2_S2 15000 _CNV_R_R_Umr_1_zu_1_3_CM_S2 0 15000
 /begin AXIS_DESCR COM_AXIS W_DKKD _CNV_R_R_Umr_10_zu__9_CM_S2 15 0 120 DEPOSIT ABSOLUTE FORMAT "%3.1" AXIS_PTS_REF SSTSKL_SO2 /end AXIS_DESCR
 FORMAT "%2.0" /end CHARACTERISTIC
/begin CHARACTERISTIC SO221 "" CURVE 0x1E0D10 _REC_A1CUR_1_u2_u2_S2 15000 _CNV_R_R_Umr_1_zu_1_3_CM_S2 0 15000
 /begin AXIS_DESCR COM_AXIS W_DKKD _CNV_R_R_Umr_10_zu__9_CM_S2 15 0 120 DEPOSIT ABSOLUTE FORMAT "%3.1" AXIS_PTS_REF SSTSKL_SO2 /end AXIS_DESCR
 FORMAT "%2.0" /end CHARACTERISTIC
/begin CHARACTERISTIC SO223 "" CURVE 0x1E0D2E _REC_A1CUR_1_u2_u2_S2 15000 _CNV_R_R_Umr_1_zu_1_3_CM_S2 0 15000
 /begin AXIS_DESCR COM_AXIS W_DKKD _CNV_R_R_Umr_10_zu__9_CM_S2 15 0 120 DEPOSIT ABSOLUTE FORMAT "%3.1" AXIS_PTS_REF SSTSKL_SO2 /end AXIS_DESCR
 FORMAT "%2.0" /end CHARACTERISTIC
/begin CHARACTERISTIC SO232 "" CURVE 0x1E0D4C _REC_A1CUR_1_u2_u2_S2 15000 _CNV_R_R_Umr_1_zu_1_3_CM_S2 0 15000
 /begin AXIS_DESCR COM_AXIS W_DKKD _CNV_R_R_Umr_10_zu__9_CM_S2 15 0 120 DEPOSIT ABSOLUTE FORMAT "%3.1" AXIS_PTS_REF SSTSKL_SO2 /end AXIS_DESCR
 FORMAT "%2.0" /end CHARACTERISTIC
/begin CHARACTERISTIC SO234 "" CURVE 0x1E0D6A _REC_A1CUR_1_u2_u2_S2 15000 _CNV_R_R_Umr_1_zu_1_3_CM_S2 0 15000
 /begin AXIS_DESCR COM_AXIS W_DKKD _CNV_R_R_Umr_10_zu__9_CM_S2 15 0 120 DEPOSIT ABSOLUTE FORMAT "%3.1" AXIS_PTS_REF SSTSKL_SO2 /end AXIS_DESCR
 FORMAT "%2.0" /end CHARACTERISTIC
/begin CHARACTERISTIC SO243 "" CURVE 0x1E0D88 _REC_A1CUR_1_u2_u2_S2 15000 _CNV_R_R_Umr_1_zu_1_3_CM_S2 0 15000
 /begin AXIS_DESCR COM_AXIS W_DKKD _CNV_R_R_Umr_10_zu__9_CM_S2 15 0 120 DEPOSIT ABSOLUTE FORMAT "%3.1" AXIS_PTS_REF SSTSKL_SO2 /end AXIS_DESCR
 FORMAT "%2.0" /end CHARACTERISTIC
/begin CHARACTERISTIC SO245 "" CURVE 0x1E0DA6 _REC_A1CUR_1_u2_u2_S2 15000 _CNV_R_R_Umr_1_zu_1_3_CM_S2 0 15000
 /begin AXIS_DESCR COM_AXIS W_DKKD _CNV_R_R_Umr_10_zu__9_CM_S2 15 0 120 DEPOSIT ABSOLUTE FORMAT "%3.1" AXIS_PTS_REF SSTSKL_SO2 /end AXIS_DESCR
 FORMAT "%2.0" /end CHARACTERISTIC
/begin CHARACTERISTIC SO254 "" CURVE 0x1E0DC4 _REC_A1CUR_1_u2_u2_S2 15000 _CNV_R_R_Umr_1_zu_1_3_CM_S2 0 15000
 /begin AXIS_DESCR COM_AXIS W_DKKD _CNV_R_R_Umr_10_zu__9_CM_S2 15 0 120 DEPOSIT ABSOLUTE FORMAT "%3.1" AXIS_PTS_REF SSTSKL_SO2 /end AXIS_DESCR
 FORMAT "%2.0" /end CHARACTERISTIC
/begin CHARACTERISTIC SO256 "" CURVE 0x1E0DE2 _REC_A1CUR_1_u2_u2_S2 15000 _CNV_R_R_Umr_1_zu_1_3_CM_S2 0 15000
 /begin AXIS_DESCR COM_AXIS W_DKKD _CNV_R_R_Umr_10_zu__9_CM_S2 15 0 120 DEPOSIT ABSOLUTE FORMAT "%3.1" AXIS_PTS_REF SSTSKL_SO2 /end AXIS_DESCR
 FORMAT "%2.0" /end CHARACTERISTIC
/begin CHARACTERISTIC SO265 "" CURVE 0x1E0E00 _REC_A1CUR_1_u2_u2_S2 15000 _CNV_R_R_Umr_1_zu_1_3_CM_S2 0 15000
 /begin AXIS_DESCR COM_AXIS W_DKKD _CNV_R_R_Umr_10_zu__9_CM_S2 15 0 120 DEPOSIT ABSOLUTE FORMAT "%3.1" AXIS_PTS_REF SSTSKL_SO2 /end AXIS_DESCR
 FORMAT "%2.0" /end CHARACTERISTIC
/begin CHARACTERISTIC SO267 "" CURVE 0x1E168E _REC_A1CUR_1_u2_u2_S2 15000 _CNV_R_R_Umr_1_zu_1_3_CM_S2 0 15000
 /begin AXIS_DESCR COM_AXIS W_DKKD _CNV_R_R_Umr_10_zu__9_CM_S2 15 0 120 DEPOSIT ABSOLUTE FORMAT "%3.1" AXIS_PTS_REF SSTSKL_SO2 /end AXIS_DESCR
 FORMAT "%2.0" /end CHARACTERISTIC
/begin CHARACTERISTIC SO276 "" CURVE 0x1E16AC _REC_A1CUR_1_u2_u2_S2 15000 _CNV_R_R_Umr_1_zu_1_3_CM_S2 0 15000
 /begin AXIS_DESCR COM_AXIS W_DKKD _CNV_R_R_Umr_10_zu__9_CM_S2 15 0 120 DEPOSIT ABSOLUTE FORMAT "%3.1" AXIS_PTS_REF SSTSKL_SO2 /end AXIS_DESCR
 FORMAT "%2.0" /end CHARACTERISTIC
/begin CHARACTERISTIC SO278 "" CURVE 0x1E1B7A _REC_A1CUR_1_u2_u2_S2 15000 _CNV_R_R_Umr_1_zu_1_3_CM_S2 0 15000
 /begin AXIS_DESCR COM_AXIS W_DKKD _CNV_R_R_Umr_10_zu__9_CM_S2 15 0 120 DEPOSIT ABSOLUTE FORMAT "%3.1" AXIS_PTS_REF SSTSKL_SO2 /end AXIS_DESCR
 FORMAT "%2.0" /end CHARACTERISTIC
/begin CHARACTERISTIC SO287 "" CURVE 0x1E1B98 _REC_A1CUR_1_u2_u2_S2 15000 _CNV_R_R_Umr_1_zu_1_3_CM_S2 0 15000
 /begin AXIS_DESCR COM_AXIS W_DKKD _CNV_R_R_Umr_10_zu__9_CM_S2 15 0 120 DEPOSIT ABSOLUTE FORMAT "%3.1" AXIS_PTS_REF SSTSKL_SO2 /end AXIS_DESCR
 FORMAT "%2.0" /end CHARACTERISTIC
/begin MEASUREMENT SSTERGW_DKKD_BPL.anz "" UBYTE _CNV_P_2_A_I_5_CM_S2 1 0 0 255 ECU_ADDRESS 0xFFF8F310 /end MEASUREMENT
/begin MEASUREMENT SSTERGW_DKKD_BPL.index "" UBYTE _CNV_P_2_A_I_5_CM_S2 1 0 0 255 ECU_ADDRESS 0xFFF8F311 /end MEASUREMENT
/begin MEASUREMENT SSTERGW_DKKD_BPL.ratio "" UWORD _CNV_P_2_A_I_32_CM_S2 1 0 0 65535 ECU_ADDRESS 0xFFF8F312 /end MEASUREMENT
/begin MEASUREMENT SSTERG_SKL.anz "" UBYTE _CNV_P_2_A_I_5_CM_S2 1 0 0 255 ECU_ADDRESS 0xFFF8EDFC /end MEASUREMENT
/begin MEASUREMENT SSTERG_SKL.index "" UBYTE _CNV_P_2_A_I_5_CM_S2 1 0 0 255 ECU_ADDRESS 0xFFF8EDFD /end MEASUREMENT
/begin MEASUREMENT SSTERG_SKL.ratio "" UWORD _CNV_P_2_A_I_32_CM_S2 1 0 0 65535 ECU_ADDRESS 0xFFF8EDFE /end MEASUREMENT
/begin MEASUREMENT SSTERG_SKL_KICKDOWN.anz "" UBYTE _CNV_P_2_A_I_5_CM_S2 1 0 0 255 ECU_ADDRESS 0xFFF8EE00 /end MEASUREMENT
/begin MEASUREMENT SSTERG_SKL_KICKDOWN.index "" UBYTE _CNV_P_2_A_I_5_CM_S2 1 0 0 255 ECU_ADDRESS 0xFFF8EE01 /end MEASUREMENT
/begin MEASUREMENT SSTERG_SKL_KICKDOWN.ratio "" UWORD _CNV_P_2_A_I_32_CM_S2 1 0 0 65535 ECU_ADDRESS 0xFFF8EE02 /end MEASUREMENT
/begin AXIS_PTS SSTSKL_S "" 0x1DD230 W_DKKD _REC_A2AXS_31_u2_S2 120 _CNV_R_R_Umr_10_zu__9_CM_S2 15 0 120 DEPOSIT ABSOLUTE FORMAT "%3.1" /end AXIS_PTS
/begin AXIS_PTS SSTSKL_SA1 "" 0x1DD250 W_DKKD _REC_A2AXS_31_u2_S2 120 _CNV_R_R_Umr_10_zu__9_CM_S2 15 0 120 DEPOSIT ABSOLUTE FORMAT "%3.1" /end AXIS_PTS
/begin AXIS_PTS SSTSKL_SA2 "" 0x1DD270 W_DKKD _REC_A2AXS_31_u2_S2 120 _CNV_R_R_Umr_10_zu__9_CM_S2 15 0 120 DEPOSIT ABSOLUTE FORMAT "%3.1" /end AXIS_PTS
/begin AXIS_PTS SSTSKL_SA3 "" 0x1DD290 W_DKKD _REC_A2AXS_31_u2_S2 120 _CNV_R_R_Umr_10_zu__9_CM_S2 15 0 120 DEPOSIT ABSOLUTE FORMAT "%3.1" /end AXIS_PTS
/begin AXIS_PTS SSTSKL_SA4 "" 0x1DD2B0 W_DKKD _REC_A2AXS_31_u2_S2 120 _CNV_R_R_Umr_10_zu__9_CM_S2 15 0 120 DEPOSIT ABSOLUTE FORMAT "%3.1" /end AXIS_PTS
/begin AXIS_PTS SSTSKL_SO1 "" 0x1DD2D0 W_DKKD _REC_A2AXS_31_u2_S2 120 _CNV_R_R_Umr_10_zu__9_CM_S2 15 0 120 DEPOSIT ABSOLUTE FORMAT "%3.1" /end AXIS_PTS
/begin AXIS_PTS SSTSKL_SO2 "" 0x1DD2F0 W_DKKD _REC_A2AXS_31_u2_S2 120 _CNV_R_R_Umr_10_zu__9_CM_S2 15 0 120 DEPOSIT ABSOLUTE FORMAT "%3.1" /end AXIS_PTS
/begin MEASUREMENT SUM_G3WAB_FILT "" SWORD _CNV_R_R_Umr_10_zu__241_CM_S2 1 0 -3276.8 3276.7 ECU_ADDRESS 0xFFF8E51A /end MEASUREMENT
/begin MEASUREMENT SUM_G3WAB_FWSFILTBUFFER "" SWORD _CNV_R_R_Umr_10_zu__241_CM_S2 1 0 -3276.8 3276.7 ECU_ADDRESS 0xFFF8E51C MATRIX_DIM 5 1 1 /end MEASUREMENT
/begin MEASUREMENT SWSP_DONE_FT "" UWORD _CNV_P_2_A_I_32_CM_S2 1 0 0 65535 ECU_ADDRESS 0xFFF8E870 /end MEASUREMENT
/begin MEASUREMENT SWSP_DONE_MUELOW "" UWORD _CNV_P_2_A_I_32_CM_S2 1 0 0 65535 ECU_ADDRESS 0xFFF8E732 /end MEASUREMENT
/begin MEASUREMENT S_ABREGLERHILFE "" UBYTE _CNV_S_2_Schalter_A_4_CM_S2 1 0 0 1 ECU_ADDRESS 0xFFF8EB37 /end MEASUREMENT
/begin MEASUREMENT S_ABREGLERSCHLUPF "" UBYTE _CNV_S_2_Schalter_A_4_CM_S2 1 0 0 1 ECU_ADDRESS 0xFFF8EB38 /end MEASUREMENT
/begin MEASUREMENT S_ABS_ERK "" UBYTE _CNV_P_2_A_I_5_CM_S2 1 0 0 255 ECU_ADDRESS 0xFFF8EC16 /end MEASUREMENT
/begin MEASUREMENT S_ADAPT_INIT "" UBYTE _CNV_R_R_Umr_1_zu_1_2_CM_S2 1 0 0 1 ECU_ADDRESS 0xFFF8EA72 FORMAT "%2.0" /end MEASUREMENT
/begin MEASUREMENT S_ADD_FKTENBL "" UBYTE _CNV_P_2_A_I_5_CM_S2 1 0 0 255 ECU_ADDRESS 0xFFF8E8B9 MATRIX_DIM 13 1 1 /end MEASUREMENT
/begin MEASUREMENT S_AEP_REQ "" UBYTE _CNV_S_2_Schalter_A_4_CM_S2 1 0 0 1 ECU_ADDRESS 0xFFF8EABA /end MEASUREMENT
/begin MEASUREMENT S_AEP_REQ_ROH "" UBYTE _CNV_R_R_Umr_1_zu_1_2_CM_S2 1 0 0 255 ECU_ADDRESS 0xFFF8E934 /end MEASUREMENT
/begin MEASUREMENT S_AGS_INIT "" UBYTE _CNV_R_R_Umr_1_zu_1_2_CM_S2 1 0 0 2 ECU_ADDRESS 0xFFF8EB8A FORMAT "%2.0" /end MEASUREMENT
/begin MEASUREMENT S_ALLRAD "" UBYTE _CNV_R_R_Umr_1_zu_1_2_CM_S2 1 0 0 255 ECU_ADDRESS 0xFFF8EA0F FORMAT "%2.0" /end MEASUREMENT
/begin MEASUREMENT S_ANFGANG2_ERK "" UBYTE _CNV_P_2_A_I_5_CM_S2 1 0 0 255 ECU_ADDRESS 0xFFF8E9DF /end MEASUREMENT
/begin MEASUREMENT S_ANFGANG2_FL_ERK "" UBYTE _CNV_P_2_A_I_5_CM_S2 1 0 0 255 ECU_ADDRESS 0xFFF8E9E0 /end MEASUREMENT
/begin MEASUREMENT S_AQ_ERROR "" UBYTE _CNV_S_3_Enum_ERRDS_70_CM_S2 1 0 0 2 ECU_ADDRESS 0xFFF8EAA4 /end MEASUREMENT
/begin MEASUREMENT S_ARSDYN_DBM "" UBYTE _CNV_R_R_Umr_1_zu_1_2_CM_S2 1 0 0 1 ECU_ADDRESS 0xFFF8E8F1 FORMAT "%2.0" /end MEASUREMENT
/begin MEASUREMENT S_AUS_MUELOWERK "" UBYTE _CNV_P_2_A_I_5_CM_S2 1 0 0 255 ECU_ADDRESS 0xFFF8EB47 /end MEASUREMENT
/begin MEASUREMENT S_AUS_MUELOWERK_SS "" UBYTE _CNV_P_2_A_I_5_CM_S2 1 0 0 255 ECU_ADDRESS 0xFFF8EB48 /end MEASUREMENT
/begin MEASUREMENT S_A_QREF "" UBYTE _CNV_P_2_A_I_5_CM_S2 1 0 0 255 ECU_ADDRESS 0xFFF8EA05 /end MEASUREMENT
/begin MEASUREMENT S_A_RADABSFILT "" UBYTE _CNV_R_R_Umr_1_zu_1_2_CM_S2 1 0 0 255 ECU_ADDRESS 0xFFF8EA5A FORMAT "%2.0" /end MEASUREMENT
/begin MEASUREMENT S_A_RADBRFAKT "" UBYTE _CNV_P_2_A_I_5_CM_S2 1 0 0 255 ECU_ADDRESS 0xFFF8EA06 /end MEASUREMENT
/begin MEASUREMENT S_B "" UBYTE _CNV_S_3_Enum_EB_ST_196_CM_S2 1 0 0 2 ECU_ADDRESS 0xFFF8EAC6 /end MEASUREMENT
/begin MEASUREMENT S_BAB_ERK "" UBYTE _CNV_P_2_A_I_5_CM_S2 1 0 0 255 ECU_ADDRESS 0xFFF8E9EC /end MEASUREMENT
/begin MEASUREMENT S_BAB_FGRKF "" UBYTE _CNV_S_2_Enum_EBABF_41_CM_S2 1 0 0 1 ECU_ADDRESS 0xFFF8EBE6 /end MEASUREMENT
/begin MEASUREMENT S_BAB_PRIOALT "" UBYTE _CNV_R_R_Umr_1_zu_1_2_CM_S2 1 0 0 2 ECU_ADDRESS 0xFFF8E8C6 FORMAT "%2.0" /end MEASUREMENT
/begin MEASUREMENT S_BCA_FAS "" UBYTE _CNV_P_2_A_I_5_CM_S2 1 0 0 255 ECU_ADDRESS 0xFFF8EA09 /end MEASUREMENT
/begin MEASUREMENT S_BEGRENZT_DBM "" ULONG _CNV_R_R_Umr_1_zu_1_2_CM_S2 1 0 0 4294967295 ECU_ADDRESS 0xFFF8ED84 FORMAT "%2.0" /end MEASUREMENT
/begin MEASUREMENT S_BERG_A1_ERK "" UBYTE _CNV_P_2_A_I_5_CM_S2 1 0 0 255 ECU_ADDRESS 0xFFF8E9F2 /end MEASUREMENT
/begin MEASUREMENT S_BERG_A2_ERK "" UBYTE _CNV_P_2_A_I_5_CM_S2 1 0 0 255 ECU_ADDRESS 0xFFF8E9F3 /end MEASUREMENT
/begin MEASUREMENT S_BERG_A3_ERK "" UBYTE _CNV_P_2_A_I_5_CM_S2 1 0 0 255 ECU_ADDRESS 0xFFF8E9F4 /end MEASUREMENT
/begin MEASUREMENT S_BERG_A4_ERK "" UBYTE _CNV_P_2_A_I_5_CM_S2 1 0 0 255 ECU_ADDRESS 0xFFF8E9F5 /end MEASUREMENT
/begin MEASUREMENT S_BERG_A5_ERK "" UBYTE _CNV_P_2_A_I_5_CM_S2 1 0 0 255 ECU_ADDRESS 0xFFF8E9F6 /end MEASUREMENT
/begin MEASUREMENT S_BERG_PROGNACHL "" UBYTE _CNV_P_2_A_I_5_CM_S2 1 0 0 255 ECU_ADDRESS 0xFFF8E9F7 /end MEASUREMENT
/begin MEASUREMENT S_BESCHL_MODAFB "" UBYTE _CNV_P_2_A_I_5_CM_S2 1 0 0 255 ECU_ADDRESS 0xFFF8EB26 /end MEASUREMENT
/begin MEASUREMENT S_BETRBER_MODAFB "" UBYTE _CNV_P_2_A_I_5_CM_S2 1 0 0 255 ECU_ADDRESS 0xFFF8EB27 /end MEASUREMENT
/begin MEASUREMENT S_BETRBER_STOPGO "" UBYTE _CNV_P_2_A_I_5_CM_S2 1 0 0 255 ECU_ADDRESS 0xFFF8EBA6 /end MEASUREMENT
/begin MEASUREMENT S_BMWAGS2_AKTIV "" UBYTE _CNV_S_2_Schalter_A_4_CM_S2 1 0 0 1 ECU_ADDRESS 0xFFF8E8B2 /end MEASUREMENT
/begin MEASUREMENT S_BPL_BEW "" UBYTE _CNV_R_R_Umr_1_zu_1_2_CM_S2 1 0 0 2 ECU_ADDRESS 0xFFF8EC02 FORMAT "%2.0" /end MEASUREMENT
/begin MEASUREMENT S_BRS_AKTION "" UBYTE _CNV_P_2_A_I_5_CM_S2 1 0 0 255 ECU_ADDRESS 0xFFF8EBF6 /end MEASUREMENT
/begin MEASUREMENT S_BRS_ERK "" UBYTE _CNV_P_2_A_I_5_CM_S2 1 0 0 255 ECU_ADDRESS 0xFFF8EA0E /end MEASUREMENT
/begin MEASUREMENT S_B_ALT "" UBYTE _CNV_S_3_Enum_EB_ST_196_CM_S2 1 0 0 2 ECU_ADDRESS 0xFFF8E9B8 /end MEASUREMENT
/begin MEASUREMENT S_B_BCA "" UBYTE _CNV_P_2_A_I_5_CM_S2 1 0 0 1 ECU_ADDRESS 0xFFF8EA0A /end MEASUREMENT
/begin MEASUREMENT S_B_BCAALT "" UBYTE _CNV_P_2_A_I_5_CM_S2 1 0 0 255 ECU_ADDRESS 0xFFF8E9B9 /end MEASUREMENT
/begin MEASUREMENT S_B_LDM "" UBYTE _CNV_P_2_A_I_5_CM_S2 1 0 0 255 ECU_ADDRESS 0xFFF8EB0D /end MEASUREMENT
/begin MEASUREMENT S_B_MUELOW "" UBYTE _CNV_P_2_A_I_5_CM_S2 1 0 0 255 ECU_ADDRESS 0xFFF8EB49 /end MEASUREMENT
/begin MEASUREMENT S_B_ROH "" UBYTE _CNV_R_R_Umr_1_zu_1_2_CM_S2 1 0 0 255 ECU_ADDRESS 0xFFF8E944 /end MEASUREMENT
/begin MEASUREMENT S_COD_ALLRAD "" UBYTE _CNV_S_2_Schalter_A_4_CM_S2 1 0 0 1 ECU_ADDRESS 0xFFF8EA10 /end MEASUREMENT
/begin MEASUREMENT S_COD_GETRTYP "" UBYTE _CNV_S_2_Enum_ECOD__16_CM_S2 1 0 0 1 ECU_ADDRESS 0xFFF8EA11 /end MEASUREMENT
/begin MEASUREMENT S_COD_MAB "" UBYTE _CNV_R_R_Umr_1_zu_1_2_CM_S2 1 0 0 1 ECU_ADDRESS 0xFFF8EA12 FORMAT "%2.0" /end MEASUREMENT
/begin MEASUREMENT S_COD_STOPGO "" UBYTE _CNV_S_2_Schalter_A_4_CM_S2 1 0 0 1 ECU_ADDRESS 0xFFF8EA13 /end MEASUREMENT
/begin MEASUREMENT S_D2RS_BRS_AKTION "" UBYTE _CNV_P_2_A_I_5_CM_S2 1 0 0 255 ECU_ADDRESS 0xFFF8EBF7 /end MEASUREMENT
/begin MEASUREMENT S_DDRS_NTMIN "" UBYTE _CNV_P_2_A_I_5_CM_S2 1 0 0 255 ECU_ADDRESS 0xFFF8EC06 /end MEASUREMENT
/begin MEASUREMENT S_DERS "" UBYTE _CNV_P_2_A_I_5_CM_S2 1 0 0 255 ECU_ADDRESS 0xFFF8EC08 /end MEASUREMENT
/begin MEASUREMENT S_DERS_DMRS "" UBYTE _CNV_P_2_A_I_5_CM_S2 1 0 0 255 ECU_ADDRESS 0xFFF8EC09 /end MEASUREMENT
/begin MEASUREMENT S_DERS_LWVA "" UBYTE _CNV_R_R_Umr_1_zu_1_2_CM_S2 1 0 0 1 ECU_ADDRESS 0xFFF8EC0A FORMAT "%2.0" /end MEASUREMENT
/begin MEASUREMENT S_DERS_NIC "" UBYTE _CNV_R_R_Umr_1_zu_1_2_CM_S2 1 0 0 1 ECU_ADDRESS 0xFFF8EC0B FORMAT "%2.0" /end MEASUREMENT
/begin MEASUREMENT S_DERS_NL "" UBYTE _CNV_R_R_Umr_1_zu_1_2_CM_S2 1 0 0 1 ECU_ADDRESS 0xFFF8EC0C FORMAT "%2.0" /end MEASUREMENT
/begin MEASUREMENT S_DERS_WAIT "" UBYTE _CNV_P_2_A_I_5_CM_S2 1 0 0 255 ECU_ADDRESS 0xFFF8EC0D /end MEASUREMENT
/begin MEASUREMENT S_DMRS_ARR "" UWORD _CNV_P_2_A_I_32_CM_S2 1 0 0 65535 ECU_ADDRESS 0xFFF8EE44 MATRIX_DIM 10 1 1 /end MEASUREMENT
/begin MEASUREMENT S_DMRS_DBM "" ULONG _CNV_R_R_Umr_1_zu_1_2_CM_S2 1 0 0 4294967295 ECU_ADDRESS 0xFFF8ED88 FORMAT "%2.0" /end MEASUREMENT
/begin MEASUREMENT S_DMRS_ENBL "" UBYTE _CNV_P_2_A_I_5_CM_S2 1 0 0 255 ECU_ADDRESS 0xFFF8EA1A /end MEASUREMENT
/begin MEASUREMENT S_DMRS_PRUEFT "" UBYTE _CNV_P_2_A_I_5_CM_S2 1 0 0 255 ECU_ADDRESS 0xFFF8EA1B /end MEASUREMENT
/begin MEASUREMENT S_DPF_REG_ERK "" UBYTE _CNV_S_2_Schalter_A_4_CM_S2 1 0 0 1 ECU_ADDRESS 0xFFF8EBB9 /end MEASUREMENT
/begin MEASUREMENT S_DRIVEDYN_VALID "" UBYTE _CNV_R_R_Umr_1_zu_1_2_CM_S2 1 0 0 255 ECU_ADDRESS 0xFFF8EA38 FORMAT "%2.0" /end MEASUREMENT
/begin MEASUREMENT S_DRIVELOGIK2_ERK "" UBYTE _CNV_R_R_Umr_1_zu_1_2_CM_S2 1 0 0 1 ECU_ADDRESS 0xFFF8E904 FORMAT "%2.0" /end MEASUREMENT
/begin MEASUREMENT S_DRIVELOGIK3_ERK "" UBYTE _CNV_R_R_Umr_1_zu_1_2_CM_S2 1 0 0 1 ECU_ADDRESS 0xFFF8E905 FORMAT "%2.0" /end MEASUREMENT
/begin MEASUREMENT S_DRIVELOGIK4_ERK "" UBYTE _CNV_R_R_Umr_1_zu_1_2_CM_S2 1 0 0 1 ECU_ADDRESS 0xFFF8E906 FORMAT "%2.0" /end MEASUREMENT
/begin MEASUREMENT S_DRIVELOGIK5_ERK "" UBYTE _CNV_R_R_Umr_1_zu_1_2_CM_S2 1 0 0 1 ECU_ADDRESS 0xFFF8E907 FORMAT "%2.0" /end MEASUREMENT
/begin MEASUREMENT S_DRIVELOGIK6_ERK "" UBYTE _CNV_R_R_Umr_1_zu_1_2_CM_S2 1 0 0 1 ECU_ADDRESS 0xFFF8E908 FORMAT "%2.0" /end MEASUREMENT
/begin MEASUREMENT S_DSC_EINMUELOW "" UBYTE _CNV_P_2_A_I_5_CM_S2 1 0 0 255 ECU_ADDRESS 0xFFF8EB4A /end MEASUREMENT
/begin MEASUREMENT S_DSPV_DBM "" UBYTE _CNV_R_R_Umr_1_zu_1_2_CM_S2 1 0 0 255 ECU_ADDRESS 0xFFF8E8F2 FORMAT "%2.0" /end MEASUREMENT
/begin MEASUREMENT S_DUE_ERK "" UBYTE _CNV_P_2_A_I_5_CM_S2 1 0 0 255 ECU_ADDRESS 0xFFF8E9C3 /end MEASUREMENT
/begin MEASUREMENT S_DYNAMIKZYK "" UBYTE _CNV_P_2_A_I_5_CM_S2 1 0 0 255 ECU_ADDRESS 0xFFF8E999 /end MEASUREMENT
/begin MEASUREMENT S_DYNAMIK_FFG "" UBYTE _CNV_P_2_A_I_5_CM_S2 1 0 0 255 ECU_ADDRESS 0xFFF8E99A MATRIX_DIM 15 1 1 /end MEASUREMENT
/begin MEASUREMENT S_DYNDZM "" UBYTE _CNV_P_2_A_I_5_CM_S2 1 0 0 255 ECU_ADDRESS 0xFFF8EA28 /end MEASUREMENT
/begin MEASUREMENT S_DYNDZM_ARR[0] "" UBYTE _CNV_P_2_A_I_5_CM_S2 1 0 0 1 ECU_ADDRESS 0xFFF8E4AC /end MEASUREMENT
/begin MEASUREMENT S_DYNDZM_ARR[1] "" UBYTE _CNV_P_2_A_I_5_CM_S2 1 0 0 1 ECU_ADDRESS 0xFFF8E4AD /end MEASUREMENT
/begin MEASUREMENT S_DYNDZM_ARR[2] "" UBYTE _CNV_P_2_A_I_5_CM_S2 1 0 0 1 ECU_ADDRESS 0xFFF8E4AE /end MEASUREMENT
/begin MEASUREMENT S_DYNDZM_ARR[3] "" UBYTE _CNV_P_2_A_I_5_CM_S2 1 0 0 1 ECU_ADDRESS 0xFFF8E4AF /end MEASUREMENT
/begin MEASUREMENT S_DYNDZM_ARR[4] "" UBYTE _CNV_P_2_A_I_5_CM_S2 1 0 0 1 ECU_ADDRESS 0xFFF8E4B0 /end MEASUREMENT
/begin MEASUREMENT S_DYNDZM_ARR[5] "" UBYTE _CNV_P_2_A_I_5_CM_S2 1 0 0 1 ECU_ADDRESS 0xFFF8E4B1 /end MEASUREMENT
/begin MEASUREMENT S_DYNDZM_ARR[6] "" UBYTE _CNV_P_2_A_I_5_CM_S2 1 0 0 1 ECU_ADDRESS 0xFFF8E4B2 /end MEASUREMENT
/begin MEASUREMENT S_DYNDZM_ARR[7] "" UBYTE _CNV_P_2_A_I_5_CM_S2 1 0 0 1 ECU_ADDRESS 0xFFF8E4B3 /end MEASUREMENT
/begin MEASUREMENT S_DYNDZM_ARR[8] "" UBYTE _CNV_P_2_A_I_5_CM_S2 1 0 0 1 ECU_ADDRESS 0xFFF8E4B4 /end MEASUREMENT
/begin MEASUREMENT S_DYNDZM_ARR[9] "" UBYTE _CNV_P_2_A_I_5_CM_S2 1 0 0 1 ECU_ADDRESS 0xFFF8E4B5 /end MEASUREMENT
/begin MEASUREMENT S_DYNDZM_EFAHREN "" UBYTE _CNV_R_R_Umr_1_zu_1_2_CM_S2 1 0 0 1 ECU_ADDRESS 0xFFF8EC12 FORMAT "%2.0" /end MEASUREMENT
/begin MEASUREMENT S_DYNDZM_FFG "" UBYTE _CNV_P_2_A_I_5_CM_S2 1 0 0 255 ECU_ADDRESS 0xFFF8EA29 /end MEASUREMENT
/begin MEASUREMENT S_DYNDZM_FFG_ALT "" UBYTE _CNV_P_2_A_I_5_CM_S2 1 0 0 255 ECU_ADDRESS 0xFFF8EA2A /end MEASUREMENT
/begin MEASUREMENT S_DYNDZM_SS "" UBYTE _CNV_P_2_A_I_5_CM_S2 1 0 0 255 ECU_ADDRESS 0xFFF8E982 /end MEASUREMENT
/begin MEASUREMENT S_DYN_RSAUSROLL "" UBYTE _CNV_P_2_A_I_5_CM_S2 1 0 0 255 ECU_ADDRESS 0xFFF8E9AF /end MEASUREMENT
/begin MEASUREMENT S_ECO_ERK "" UBYTE _CNV_P_2_A_I_5_CM_S2 1 0 0 255 ECU_ADDRESS 0xFFF8EA3C /end MEASUREMENT
/begin MEASUREMENT S_EFAHREN_1_ERK "" UBYTE _CNV_R_R_Umr_1_zu_1_2_CM_S2 1 0 0 255 ECU_ADDRESS 0xFFF8EA97 /end MEASUREMENT
/begin MEASUREMENT S_EFAHREN_2_ERK "" UBYTE _CNV_R_R_Umr_1_zu_1_2_CM_S2 1 0 0 255 ECU_ADDRESS 0xFFF8EA98 FORMAT "%2.0" /end MEASUREMENT
/begin MEASUREMENT S_EFAHREN_ERK "" UBYTE _CNV_P_2_A_I_5_CM_S2 1 0 0 255 ECU_ADDRESS 0xFFF8EA99 /end MEASUREMENT
/begin MEASUREMENT S_EIN_BAB "" UBYTE _CNV_P_2_A_I_5_CM_S2 1 0 0 255 ECU_ADDRESS 0xFFF8E9ED /end MEASUREMENT
/begin MEASUREMENT S_EIN_BAB_NAB "" UBYTE _CNV_P_2_A_I_5_CM_S2 1 0 0 255 ECU_ADDRESS 0xFFF8E9EE /end MEASUREMENT
/begin MEASUREMENT S_EIN_BAB_STEIGUNG "" UBYTE _CNV_P_2_A_I_5_CM_S2 1 0 0 255 ECU_ADDRESS 0xFFF8E9EF /end MEASUREMENT
/begin MEASUREMENT S_EIN_ERKBERGANH "" UBYTE _CNV_P_2_A_I_5_CM_S2 1 0 0 255 ECU_ADDRESS 0xFFF8E9F8 /end MEASUREMENT
/begin MEASUREMENT S_EIN_MUELOWERK "" UBYTE _CNV_P_2_A_I_5_CM_S2 1 0 0 255 ECU_ADDRESS 0xFFF8EB4B /end MEASUREMENT
/begin MEASUREMENT S_EIN_MUELOWERK_SS "" UBYTE _CNV_P_2_A_I_5_CM_S2 1 0 0 255 ECU_ADDRESS 0xFFF8EB4C /end MEASUREMENT
/begin MEASUREMENT S_EM1_ZKA "" UBYTE _CNV_R_R_Umr_1_zu_1_2_CM_S2 1 0 0 255 ECU_ADDRESS 0xFFF8EBBE FORMAT "%2.0" /end MEASUREMENT
/begin MEASUREMENT S_EM2_ZKA "" UBYTE _CNV_R_R_Umr_1_zu_1_2_CM_S2 1 0 0 255 ECU_ADDRESS 0xFFF8EBBF FORMAT "%2.0" /end MEASUREMENT
/begin MEASUREMENT S_EM_DAEMPFUNG "" UBYTE _CNV_S_2_Schalter_A_4_CM_S2 1 0 0 1 ECU_ADDRESS 0xFFF8EAC7 /end MEASUREMENT
/begin MEASUREMENT S_EM_DAEMPFUNG_ROH "" UBYTE _CNV_R_R_Umr_1_zu_1_2_CM_S2 1 0 0 255 ECU_ADDRESS 0xFFF8E945 FORMAT "%2.0" /end MEASUREMENT
/begin MEASUREMENT S_ERR_ASC "" UBYTE _CNV_P_2_A_I_5_CM_S2 1 0 0 255 ECU_ADDRESS 0xFFF8EACE /end MEASUREMENT
/begin MEASUREMENT S_ERR_ASC_ROH "" UBYTE _CNV_P_2_A_I_5_CM_S2 1 0 0 255 ECU_ADDRESS 0xFFF8E94E /end MEASUREMENT
/begin MEASUREMENT S_ERR_DSC "" UBYTE _CNV_S_2_Enum_ERRDS_215_CM_S2 1 0 0 1 ECU_ADDRESS 0xFFF8EACF /end MEASUREMENT
/begin MEASUREMENT S_ERR_DSC_ROH "" UBYTE _CNV_R_R_Umr_1_zu_1_2_CM_S2 1 0 0 255 ECU_ADDRESS 0xFFF8E94F /end MEASUREMENT
/begin MEASUREMENT S_ERR_DSC_ROLLECAN "" UBYTE _CNV_S_3_Enum_ERRDS_70_CM_S2 1 0 0 2 ECU_ADDRESS 0xFFF8EAD0 /end MEASUREMENT
/begin MEASUREMENT S_EXCFKT_FFG "" UBYTE _CNV_P_2_A_I_5_CM_S2 1 0 0 255 ECU_ADDRESS 0xFFF8EC28 MATRIX_DIM 32 1 1 /end MEASUREMENT
/begin MEASUREMENT S_FAS_ERK "" UBYTE _CNV_P_2_A_I_5_CM_S2 1 0 0 255 ECU_ADDRESS 0xFFF8EA40 /end MEASUREMENT
/begin MEASUREMENT S_FDC "" UBYTE _CNV_P_2_A_I_5_CM_S2 1 0 0 255 ECU_ADDRESS 0xFFF8EAD1 /end MEASUREMENT
/begin MEASUREMENT S_FDC_REAL "" UBYTE _CNV_P_2_A_I_5_CM_S2 1 0 0 255 ECU_ADDRESS 0xFFF8EAD2 /end MEASUREMENT
/begin MEASUREMENT S_FESTBREMS "" UBYTE _CNV_P_2_A_I_5_CM_S2 1 0 0 255 ECU_ADDRESS 0xFFF8EA0B /end MEASUREMENT
/begin MEASUREMENT S_FGR_FFG "" UBYTE _CNV_R_R_Umr_1_zu_1_2_CM_S2 1 0 0 255 ECU_ADDRESS 0xFFF8E8C7 FORMAT "%2.0" /end MEASUREMENT
/begin MEASUREMENT S_FKT_SPA "" UBYTE _CNV_P_2_A_I_5_CM_S2 1 0 0 255 ECU_ADDRESS 0xFFF8EB8C MATRIX_DIM 11 1 1 /end MEASUREMENT
/begin MEASUREMENT S_FLANKE_DOWN "" UBYTE _CNV_P_2_A_I_5_CM_S2 1 0 0 255 ECU_ADDRESS 0xFFF8E8C8 /end MEASUREMENT
/begin MEASUREMENT S_FLM_ERK "" UBYTE _CNV_P_2_A_I_5_CM_S2 1 0 0 255 ECU_ADDRESS 0xFFF8E9E1 /end MEASUREMENT
/begin MEASUREMENT S_FORCE_HS_MDSSCHUB "" UBYTE _CNV_S_2_Schalter_A_4_CM_S2 1 0 0 1 ECU_ADDRESS 0xFFF8EC1E /end MEASUREMENT
/begin MEASUREMENT S_FSANF_PHASE3_DYNDZM "" UBYTE _CNV_R_R_Umr_1_zu_1_2_CM_S2 1 0 0 1 ECU_ADDRESS 0xFFF8679E FORMAT "%2.0" /end MEASUREMENT
/begin MEASUREMENT S_FT_CR "" UBYTE _CNV_P_2_A_I_5_CM_S2 1 0 0 255 ECU_ADDRESS 0xFFF8EC26 /end MEASUREMENT
/begin MEASUREMENT S_FT_E_ERK "" UBYTE _CNV_P_2_A_I_5_CM_S2 1 0 0 255 ECU_ADDRESS 0xFFF8EA41 /end MEASUREMENT
/begin MEASUREMENT S_FT_S_ERK "" UBYTE _CNV_P_2_A_I_5_CM_S2 1 0 0 255 ECU_ADDRESS 0xFFF8EA42 /end MEASUREMENT
/begin MEASUREMENT S_FT_XE_ERK "" UBYTE _CNV_P_2_A_I_5_CM_S2 1 0 0 255 ECU_ADDRESS 0xFFF8EA43 /end MEASUREMENT
/begin MEASUREMENT S_FT_XS_ERK "" UBYTE _CNV_P_2_A_I_5_CM_S2 1 0 0 255 ECU_ADDRESS 0xFFF8EA44 /end MEASUREMENT
/begin MEASUREMENT S_FZGSTEHT_MODAFB "" UBYTE _CNV_P_2_A_I_5_CM_S2 1 0 0 255 ECU_ADDRESS 0xFFF8EB28 /end MEASUREMENT
/begin MEASUREMENT S_FZG_STEHT "" UBYTE _CNV_P_2_A_I_5_CM_S2 1 0 0 255 ECU_ADDRESS 0xFFF8EA07 /end MEASUREMENT
/begin MEASUREMENT S_FZG_STEHT_STEPS "" UBYTE _CNV_S_2_Schalter_A_4_CM_S2 1 0 0 1 ECU_ADDRESS 0xFFF8E9C4 /end MEASUREMENT
/begin MEASUREMENT S_GANGSPEICHER_TIPP_MINUS "" UBYTE _CNV_P_2_A_I_5_CM_S2 1 0 0 255 ECU_ADDRESS 0xFFF8E9C5 /end MEASUREMENT
/begin MEASUREMENT S_GANG_ANZEIGE_FREEZE "" UBYTE _CNV_S_2_Schalter_A_4_CM_S2 1 0 0 1 ECU_ADDRESS 0xFFF8E91D /end MEASUREMENT
/begin MEASUREMENT S_GEGEN_TIPP_STEPS "" UBYTE _CNV_S_2_Schalter_A_4_CM_S2 1 0 0 1 ECU_ADDRESS 0xFFF8E9C6 /end MEASUREMENT
/begin MEASUREMENT S_GK0_FAHRDYNAMIK "" UBYTE _CNV_R_R_Umr_1_zu_1_2_CM_S2 1 0 0 255 ECU_ADDRESS 0xFFF8E91A FORMAT "%2.0" /end MEASUREMENT
/begin MEASUREMENT S_GK0_FAHRDYNAMIK_SS "" UBYTE _CNV_R_R_Umr_1_zu_1_2_CM_S2 1 0 0 255 ECU_ADDRESS 0xFFF8E983 FORMAT "%2.0" /end MEASUREMENT
/begin MEASUREMENT S_GN_MT_FREEZE "" UBYTE _CNV_R_R_Umr_1_zu_1_2_CM_S2 1 0 0 255 ECU_ADDRESS 0xFFF8EB5C /end MEASUREMENT
/begin MEASUREMENT S_GN_TRAD_FREEZE "" UBYTE _CNV_R_R_Umr_1_zu_1_2_CM_S2 1 0 0 255 ECU_ADDRESS 0xFFF8EB5D /end MEASUREMENT
/begin MEASUREMENT S_GWFP_FILTHSURE_DOWN "" UBYTE _CNV_P_2_A_I_5_CM_S2 1 0 0 255 ECU_ADDRESS 0xFFF8EA74 /end MEASUREMENT
/begin MEASUREMENT S_GWFP_FILTHSURE_NEG "" UBYTE _CNV_P_2_A_I_5_CM_S2 1 0 0 255 ECU_ADDRESS 0xFFF8EA75 /end MEASUREMENT
/begin MEASUREMENT S_GWFP_FLANKENWECHSEL_VALID "" UBYTE _CNV_P_2_A_I_5_CM_S2 1 0 0 255 ECU_ADDRESS 0xFFF8EA76 /end MEASUREMENT
/begin MEASUREMENT S_GWFP_HSURE_BRS "" UBYTE _CNV_P_2_A_I_5_CM_S2 1 0 0 255 ECU_ADDRESS 0xFFF8EA77 /end MEASUREMENT
/begin MEASUREMENT S_GWFP_UP "" UBYTE _CNV_P_2_A_I_5_CM_S2 1 0 0 255 ECU_ADDRESS 0xFFF8EA1C /end MEASUREMENT
/begin MEASUREMENT S_HALT_KURVELDMNACHL "" UBYTE _CNV_P_2_A_I_5_CM_S2 1 0 0 255 ECU_ADDRESS 0xFFF8EAA5 /end MEASUREMENT
/begin MEASUREMENT S_HALT_KURVENACHL "" UBYTE _CNV_P_2_A_I_5_CM_S2 1 0 0 255 ECU_ADDRESS 0xFFF8EAA6 /end MEASUREMENT
/begin MEASUREMENT S_HDC_BER "" UBYTE _CNV_S_2_Enum_EHDC__99_CM_S2 1 0 0 1 ECU_ADDRESS 0xFFF8EA64 /end MEASUREMENT
/begin MEASUREMENT S_HDC_ERK "" UBYTE _CNV_P_2_A_I_5_CM_S2 1 0 0 255 ECU_ADDRESS 0xFFF8EA67 /end MEASUREMENT
/begin MEASUREMENT S_HDC_INIT "" UBYTE _CNV_P_2_A_I_5_CM_S2 1 0 0 255 ECU_ADDRESS 0xFFF8EA65 /end MEASUREMENT
/begin MEASUREMENT S_HEISSHOCH_ERK "" UBYTE _CNV_P_2_A_I_5_CM_S2 1 0 0 255 ECU_ADDRESS 0xFFF8EBA7 /end MEASUREMENT
/begin MEASUREMENT S_HKOR_AKTIV "" UBYTE _CNV_R_R_Umr_1_zu_1_2_CM_S2 1 0 0 1 ECU_ADDRESS 0xFFF8EA6C FORMAT "%2.0" /end MEASUREMENT
/begin MEASUREMENT S_HOTMODE_ERK "" UBYTE _CNV_P_2_A_I_5_CM_S2 1 0 0 255 ECU_ADDRESS 0xFFF8EA71 /end MEASUREMENT
/begin MEASUREMENT S_HS "" UBYTE _CNV_S_2_Schalter_A_4_CM_S2 1 0 0 1 ECU_ADDRESS 0xFFF8E91E /end MEASUREMENT
/begin MEASUREMENT S_HSUKS_ERK "" UBYTE _CNV_R_R_Umr_1_zu_1_2_CM_S2 1 0 0 1 ECU_ADDRESS 0xFFF8EC18 FORMAT "%2.0" /end MEASUREMENT
/begin MEASUREMENT S_HSUKS_PROG_MODE "" UBYTE _CNV_R_R_Umr_1_zu_1_2_CM_S2 1 0 0 255 ECU_ADDRESS 0xFFF8EC19 FORMAT "%2.0" /end MEASUREMENT
/begin MEASUREMENT S_HSUKS_TEMP_ERK "" UBYTE _CNV_R_R_Umr_1_zu_1_2_CM_S2 1 0 0 1 ECU_ADDRESS 0xFFF8EC1A FORMAT "%2.0" /end MEASUREMENT
/begin MEASUREMENT S_HSUREFKT_FFG[0] "" UBYTE _CNV_P_2_A_I_5_CM_S2 1 0 0 1 ECU_ADDRESS 0xFFF8E8C9 /end MEASUREMENT
/begin MEASUREMENT S_HSUREFKT_FFG[10] "" UBYTE _CNV_P_2_A_I_5_CM_S2 1 0 0 1 ECU_ADDRESS 0xFFF8E8D3 /end MEASUREMENT
/begin MEASUREMENT S_HSUREFKT_FFG[11] "" UBYTE _CNV_P_2_A_I_5_CM_S2 1 0 0 1 ECU_ADDRESS 0xFFF8E8D4 /end MEASUREMENT
/begin MEASUREMENT S_HSUREFKT_FFG[12] "" UBYTE _CNV_P_2_A_I_5_CM_S2 1 0 0 1 ECU_ADDRESS 0xFFF8E8D5 /end MEASUREMENT
/begin MEASUREMENT S_HSUREFKT_FFG[1] "" UBYTE _CNV_P_2_A_I_5_CM_S2 1 0 0 1 ECU_ADDRESS 0xFFF8E8CA /end MEASUREMENT
/begin MEASUREMENT S_HSUREFKT_FFG[2] "" UBYTE _CNV_P_2_A_I_5_CM_S2 1 0 0 1 ECU_ADDRESS 0xFFF8E8CB /end MEASUREMENT
/begin MEASUREMENT S_HSUREFKT_FFG[3] "" UBYTE _CNV_P_2_A_I_5_CM_S2 1 0 0 1 ECU_ADDRESS 0xFFF8E8CC /end MEASUREMENT
/begin MEASUREMENT S_HSUREFKT_FFG[4] "" UBYTE _CNV_P_2_A_I_5_CM_S2 1 0 0 1 ECU_ADDRESS 0xFFF8E8CD /end MEASUREMENT
/begin MEASUREMENT S_HSUREFKT_FFG[5] "" UBYTE _CNV_P_2_A_I_5_CM_S2 1 0 0 1 ECU_ADDRESS 0xFFF8E8CE /end MEASUREMENT
/begin MEASUREMENT S_HSUREFKT_FFG[6] "" UBYTE _CNV_P_2_A_I_5_CM_S2 1 0 0 1 ECU_ADDRESS 0xFFF8E8CF /end MEASUREMENT
/begin MEASUREMENT S_HSUREFKT_FFG[7] "" UBYTE _CNV_P_2_A_I_5_CM_S2 1 0 0 1 ECU_ADDRESS 0xFFF8E8D0 /end MEASUREMENT
/begin MEASUREMENT S_HSUREFKT_FFG[8] "" UBYTE _CNV_P_2_A_I_5_CM_S2 1 0 0 1 ECU_ADDRESS 0xFFF8E8D1 /end MEASUREMENT
/begin MEASUREMENT S_HSUREFKT_FFG[9] "" UBYTE _CNV_P_2_A_I_5_CM_S2 1 0 0 1 ECU_ADDRESS 0xFFF8E8D2 /end MEASUREMENT
/begin MEASUREMENT S_HSURESCHLUPF_FAST "" UBYTE _CNV_P_2_A_I_5_CM_S2 1 0 0 255 ECU_ADDRESS 0xFFF8EA8D /end MEASUREMENT
/begin MEASUREMENT S_HSURE_ADAPT_ERK "" UBYTE _CNV_R_R_Umr_1_zu_1_2_CM_S2 1 0 0 255 ECU_ADDRESS 0xFFF8EA73 /end MEASUREMENT
/begin MEASUREMENT S_HSURE_BAB_ERK "" UBYTE _CNV_P_2_A_I_5_CM_S2 1 0 0 255 ECU_ADDRESS 0xFFF8EA7B /end MEASUREMENT
/begin MEASUREMENT S_HSURE_BAB_HS "" UBYTE _CNV_P_2_A_I_5_CM_S2 1 0 0 255 ECU_ADDRESS 0xFFF8EC1D /end MEASUREMENT
/begin MEASUREMENT S_HSURE_BRSNACHL "" UBYTE _CNV_P_2_A_I_5_CM_S2 1 0 0 255 ECU_ADDRESS 0xFFF8EA78 FORMAT "%2.0" /end MEASUREMENT
/begin MEASUREMENT S_HSURE_BRS_ERK "" UBYTE _CNV_P_2_A_I_5_CM_S2 1 0 0 255 ECU_ADDRESS 0xFFF8EA79 /end MEASUREMENT
/begin MEASUREMENT S_HSURE_FFG "" UBYTE _CNV_R_R_Umr_1_zu_1_2_CM_S2 1 0 0 255 ECU_ADDRESS 0xFFF8EAA0 /end MEASUREMENT
/begin MEASUREMENT S_HSURE_FOF_ERK "" UBYTE _CNV_P_2_A_I_5_CM_S2 1 0 0 255 ECU_ADDRESS 0xFFF8EA81 /end MEASUREMENT
/begin MEASUREMENT S_HSURE_HS_ERK "" UBYTE _CNV_P_2_A_I_5_CM_S2 1 0 0 255 ECU_ADDRESS 0xFFF8EA83 /end MEASUREMENT
/begin MEASUREMENT S_HSURE_INSTAT_ERK "" UBYTE _CNV_P_2_A_I_5_CM_S2 1 0 0 255 ECU_ADDRESS 0xFFF8EA84 /end MEASUREMENT
/begin MEASUREMENT S_HSURE_KUVOR_ERK "" UBYTE _CNV_P_2_A_I_5_CM_S2 1 0 0 255 ECU_ADDRESS 0xFFF8EA87 /end MEASUREMENT
/begin MEASUREMENT S_HSURE_KU_ERK "" UBYTE _CNV_P_2_A_I_5_CM_S2 1 0 0 255 ECU_ADDRESS 0xFFF8EA86 /end MEASUREMENT
/begin MEASUREMENT S_HSURE_NABNEGATIV_ERK "" UBYTE _CNV_P_2_A_I_5_CM_S2 1 0 0 255 ECU_ADDRESS 0xFFF8EA89 /end MEASUREMENT
/begin MEASUREMENT S_HSURE_NL_ERK "" UBYTE _CNV_P_2_A_I_5_CM_S2 1 0 0 255 ECU_ADDRESS 0xFFF8EA8A /end MEASUREMENT
/begin MEASUREMENT S_HSURE_RS_ERK "" UBYTE _CNV_P_2_A_I_5_CM_S2 1 0 0 255 ECU_ADDRESS 0xFFF8EA8C /end MEASUREMENT
/begin MEASUREMENT S_HSURE_SCHLUPF_ERK "" UBYTE _CNV_P_2_A_I_5_CM_S2 1 0 0 255 ECU_ADDRESS 0xFFF8EA8E /end MEASUREMENT
/begin MEASUREMENT S_HSURE_VOR_ERK "" UBYTE _CNV_P_2_A_I_5_CM_S2 1 0 0 255 ECU_ADDRESS 0xFFF8EA91 /end MEASUREMENT
/begin MEASUREMENT S_HSZIEL_FLM "" UBYTE _CNV_R_R_Umr_1_zu_1_2_CM_S2 1 0 0 1 ECU_ADDRESS 0xFFF8EB5E FORMAT "%2.0" /end MEASUREMENT
/begin MEASUREMENT S_HYBRID_HAS_IST_ERK "" UBYTE _CNV_R_R_Umr_1_zu_1_2_CM_S2 1 0 0 255 ECU_ADDRESS 0xFFF8EA9A FORMAT "%2.0" /end MEASUREMENT
/begin MEASUREMENT S_HYBRID_HAS_ZIEL_ERK "" UBYTE _CNV_R_R_Umr_1_zu_1_2_CM_S2 1 0 0 255 ECU_ADDRESS 0xFFF8EA9B FORMAT "%2.0" /end MEASUREMENT
/begin MEASUREMENT S_HYS_EIN_TRAKTION "" UBYTE _CNV_R_R_Umr_1_zu_1_2_CM_S2 1 0 0 1 ECU_ADDRESS 0xFFF8EC15 FORMAT "%2.0" /end MEASUREMENT
/begin MEASUREMENT S_INIT_EEPROM_DATA "" UBYTE _CNV_R_R_Umr_1_zu_1_2_CM_S2 1 0 0 255 ECU_ADDRESS 0xFFF8E901 FORMAT "%2.0" /end MEASUREMENT
/begin MEASUREMENT S_KD "" UBYTE _CNV_P_2_A_I_5_CM_S2 1 0 0 255 ECU_ADDRESS 0xFFF8EAD3 /end MEASUREMENT
/begin MEASUREMENT S_KDRS_STEPS "" UBYTE _CNV_S_2_Schalter_A_4_CM_S2 1 0 0 1 ECU_ADDRESS 0xFFF8E9C7 /end MEASUREMENT
/begin MEASUREMENT S_KD_ROH "" UBYTE _CNV_R_R_Umr_1_zu_1_2_CM_S2 1 0 0 255 ECU_ADDRESS 0xFFF8E951 /end MEASUREMENT
/begin MEASUREMENT S_KD_SPERR "" UBYTE _CNV_P_2_A_I_5_CM_S2 1 0 0 255 ECU_ADDRESS 0xFFF8E9C8 /end MEASUREMENT
/begin MEASUREMENT S_KFE_BEW "" UBYTE _CNV_R_R_Umr_1_zu_1_2_CM_S2 1 0 0 2 ECU_ADDRESS 0xFFF8EC03 FORMAT "%2.0" /end MEASUREMENT
/begin MEASUREMENT S_KFINIT_MODAFB "" UBYTE _CNV_P_2_A_I_5_CM_S2 1 0 0 255 ECU_ADDRESS 0xFFF8EB29 /end MEASUREMENT
/begin MEASUREMENT S_KFINIT_MODAFB_LAEUFT "" UBYTE _CNV_P_2_A_I_5_CM_S2 1 0 0 255 ECU_ADDRESS 0xFFF8EB2A /end MEASUREMENT
/begin MEASUREMENT S_KF_LRN_MODAFB "" UBYTE _CNV_P_2_A_I_5_CM_S2 1 0 0 255 ECU_ADDRESS 0xFFF8EB2B /end MEASUREMENT
/begin MEASUREMENT S_KF_MODAFB "" UBYTE _CNV_P_2_A_I_5_CM_S2 1 0 0 255 ECU_ADDRESS 0xFFF8EB2C /end MEASUREMENT
/begin MEASUREMENT S_KF_MODAFB_LAEUFT "" UBYTE _CNV_P_2_A_I_5_CM_S2 1 0 0 255 ECU_ADDRESS 0xFFF8EB2D /end MEASUREMENT
/begin MEASUREMENT S_KF_RSU_MODAFB "" UBYTE _CNV_P_2_A_I_5_CM_S2 1 0 0 255 ECU_ADDRESS 0xFFF8EB2E /end MEASUREMENT
/begin MEASUREMENT S_KF_TINLRN_MODAFB "" UBYTE _CNV_P_2_A_I_5_CM_S2 1 0 0 255 ECU_ADDRESS 0xFFF8EB2F /end MEASUREMENT
/begin MEASUREMENT S_KOPFKT_FFG "" UBYTE _CNV_P_2_A_I_5_CM_S2 1 0 0 255 ECU_ADDRESS 0xFFF8EC48 MATRIX_DIM 12 1 1 /end MEASUREMENT
/begin MEASUREMENT S_KOPFKT_STOPGOALT "" UBYTE _CNV_P_2_A_I_5_CM_S2 1 0 0 255 ECU_ADDRESS 0xFFF8EBA8 /end MEASUREMENT
/begin MEASUREMENT S_KURVE_BEGR "" UBYTE _CNV_P_2_A_I_5_CM_S2 1 0 0 255 ECU_ADDRESS 0xFFF8EC04 /end MEASUREMENT
/begin MEASUREMENT S_LAEUFT_T_HSRS_SPA "" UBYTE _CNV_S_2_Schalter_A_4_CM_S2 1 0 0 1 ECU_ADDRESS 0xFFF8EB97 /end MEASUREMENT
/begin MEASUREMENT S_LAEUFT_T_SPERR_SPA "" UBYTE _CNV_S_2_Schalter_A_4_CM_S2 1 0 0 1 ECU_ADDRESS 0xFFF8EB98 /end MEASUREMENT
/begin MEASUREMENT S_LDMBAB_ENBL "" UBYTE _CNV_P_2_A_I_5_CM_S2 1 0 0 255 ECU_ADDRESS 0xFFF8EB0E /end MEASUREMENT
/begin MEASUREMENT S_LDMBAB_ENBL_ALT "" UBYTE _CNV_R_R_Umr_1_zu_1_2_CM_S2 1 0 0 1 ECU_ADDRESS 0xFFF8EB0F /end MEASUREMENT
/begin MEASUREMENT S_LDMBAB_ERK "" UBYTE _CNV_P_2_A_I_5_CM_S2 1 0 0 255 ECU_ADDRESS 0xFFF8EB10 /end MEASUREMENT
/begin MEASUREMENT S_LDM_ERK "" UBYTE _CNV_P_2_A_I_5_CM_S2 1 0 0 255 ECU_ADDRESS 0xFFF8EB09 /end MEASUREMENT
/begin MEASUREMENT S_LDM_ERK_ALT "" UBYTE _CNV_P_2_A_I_5_CM_S2 1 0 0 255 ECU_ADDRESS 0xFFF8EB0A /end MEASUREMENT
/begin MEASUREMENT S_LDM_STELLUNSTETIGKEIT "" UBYTE _CNV_R_R_Umr_1_zu_1_2_CM_S2 1 0 0 1 ECU_ADDRESS 0xFFF8EB11 FORMAT "%2.0" /end MEASUREMENT
/begin MEASUREMENT S_LDM_STELLUNSTETIGKEIT_ALT "" UBYTE _CNV_R_R_Umr_1_zu_1_2_CM_S2 1 0 0 1 ECU_ADDRESS 0xFFF8EB12 FORMAT "%2.0" /end MEASUREMENT
/begin MEASUREMENT S_LM "" UBYTE _CNV_P_2_A_I_5_CM_S2 1 0 0 255 ECU_ADDRESS 0xFFF8EB1C /end MEASUREMENT
/begin MEASUREMENT S_LMODE_PRIOALT "" UBYTE _CNV_R_R_Umr_1_zu_1_2_CM_S2 1 0 0 1 ECU_ADDRESS 0xFFF8E8D6 FORMAT "%2.0" /end MEASUREMENT
/begin MEASUREMENT S_LM_ERK "" UBYTE _CNV_P_2_A_I_5_CM_S2 1 0 0 255 ECU_ADDRESS 0xFFF8EB1D /end MEASUREMENT
/begin MEASUREMENT S_LPA "" UBYTE _CNV_R_R_Umr_1_zu_1_2_CM_S2 1 0 0 1 ECU_ADDRESS 0xFFF8EA18 FORMAT "%2.0" /end MEASUREMENT
/begin MEASUREMENT S_MAB_PRIOALT "" UBYTE _CNV_R_R_Umr_1_zu_1_2_CM_S2 1 0 0 1 ECU_ADDRESS 0xFFF8E8D7 FORMAT "%2.0" /end MEASUREMENT
/begin MEASUREMENT S_MARS_BR "" UBYTE _CNV_S_2_Schalter_A_4_CM_S2 1 0 0 1 ECU_ADDRESS 0xFFF8EB32 /end MEASUREMENT
/begin MEASUREMENT S_MARS_DBM "" UBYTE _CNV_R_R_Umr_1_zu_1_2_CM_S2 1 0 0 255 ECU_ADDRESS 0xFFF8EB33 FORMAT "%2.0" /end MEASUREMENT
/begin MEASUREMENT S_MARS_G2W "" UBYTE _CNV_S_2_Schalter_A_4_CM_S2 1 0 0 1 ECU_ADDRESS 0xFFF8EB34 /end MEASUREMENT
/begin MEASUREMENT S_MINUS "" UBYTE _CNV_P_2_A_I_5_CM_S2 1 0 0 255 ECU_ADDRESS 0xFFF8EBAD /end MEASUREMENT
/begin MEASUREMENT S_MINUS_ALT_LM "" UBYTE _CNV_P_2_A_I_5_CM_S2 1 0 0 255 ECU_ADDRESS 0xFFF8EB1E /end MEASUREMENT
/begin MEASUREMENT S_MINUS_ALT_STEPS "" UBYTE _CNV_P_2_A_I_5_CM_S2 1 0 0 255 ECU_ADDRESS 0xFFF8E9C9 /end MEASUREMENT
/begin MEASUREMENT S_MINUS_GWS "" UBYTE _CNV_P_2_A_I_5_CM_S2 1 0 0 255 ECU_ADDRESS 0xFFF8EAD4 /end MEASUREMENT
/begin MEASUREMENT S_MINUS_GWS_ROH "" UBYTE _CNV_S_2_Schalter_A_4_CM_S2 1 0 0 1 ECU_ADDRESS 0xFFF8E952 /end MEASUREMENT
/begin MEASUREMENT S_MINUS_HDC "" UBYTE _CNV_P_2_A_I_5_CM_S2 1 0 0 255 ECU_ADDRESS 0xFFF8EBAE /end MEASUREMENT
/begin MEASUREMENT S_MINUS_PADDLE "" UBYTE _CNV_P_2_A_I_5_CM_S2 1 0 0 255 ECU_ADDRESS 0xFFF8EBAF /end MEASUREMENT
/begin MEASUREMENT S_MINUS_PADDLE_ROH "" UBYTE _CNV_P_2_A_I_5_CM_S2 1 0 0 255 ECU_ADDRESS 0xFFF8E953 /end MEASUREMENT
/begin MEASUREMENT S_MINUS_TIPP "" UBYTE _CNV_P_2_A_I_5_CM_S2 1 0 0 255 ECU_ADDRESS 0xFFF8E9CA /end MEASUREMENT
/begin MEASUREMENT S_MODAFB_ERK "" UBYTE _CNV_P_2_A_I_5_CM_S2 1 0 0 255 ECU_ADDRESS 0xFFF8EB21 /end MEASUREMENT
/begin MEASUREMENT S_MRADWUNSCH_BEGRENZT_ZKA "" UBYTE _CNV_R_R_Umr_1_zu_1_2_CM_S2 1 0 0 255 ECU_ADDRESS 0xFFF8EBCA FORMAT "%2.0" /end MEASUREMENT
/begin MEASUREMENT S_MRSZ_BAB "" UBYTE _CNV_P_2_A_I_5_CM_S2 1 0 0 255 ECU_ADDRESS 0xFFF8EBE7 /end MEASUREMENT
/begin MEASUREMENT S_MRSZ_KURVEAUS "" UBYTE _CNV_P_2_A_I_5_CM_S2 1 0 0 255 ECU_ADDRESS 0xFFF8EBE8 /end MEASUREMENT
/begin MEASUREMENT S_MSA_ADAPT_RS "" UBYTE _CNV_S_2_Schalter_A_4_CM_S2 1 0 0 1 ECU_ADDRESS 0xFFF8EAD5 /end MEASUREMENT
/begin MEASUREMENT S_MSA_ADAPT_RS_ROH "" UBYTE _CNV_R_R_Umr_1_zu_1_2_CM_S2 1 0 0 255 ECU_ADDRESS 0xFFF8E954 /end MEASUREMENT
/begin MEASUREMENT S_MSA_REQ "" UBYTE _CNV_S_2_Enum_EMSA__72_CM_S2 1 0 0 1 ECU_ADDRESS 0xFFF8E995 /end MEASUREMENT
/begin MEASUREMENT S_MSA_REQ_ADAPT "" UBYTE _CNV_S_2_Enum_EMSA__72_CM_S2 1 0 0 1 ECU_ADDRESS 0xFFF8E996 /end MEASUREMENT
/begin MEASUREMENT S_MSA_REQ_PRISQ "" UBYTE _CNV_S_2_Enum_EMSA__72_CM_S2 1 0 0 1 ECU_ADDRESS 0xFFF8E997 /end MEASUREMENT
/begin MEASUREMENT S_MSA_REQ_SS "" UBYTE _CNV_S_2_Enum_EMSA__72_CM_S2 1 0 0 1 ECU_ADDRESS 0xFFF8E985 /end MEASUREMENT
/begin MEASUREMENT S_MSA_REQ_TEMP_WANDLER "" UBYTE _CNV_S_2_Enum_EMSA__72_CM_S2 1 0 0 1 ECU_ADDRESS 0xFFF8E998 /end MEASUREMENT
/begin MEASUREMENT S_MSA_STAT "" UBYTE _CNV_S_2_Schalter_A_4_CM_S2 1 0 0 1 ECU_ADDRESS 0xFFF8EAD6 /end MEASUREMENT
/begin MEASUREMENT S_MSA_STAT_ROH "" UBYTE _CNV_R_R_Umr_1_zu_1_2_CM_S2 1 0 0 255 ECU_ADDRESS 0xFFF8E955 /end MEASUREMENT
/begin MEASUREMENT S_MUELOW "" UBYTE _CNV_P_2_A_I_5_CM_S2 1 0 0 255 ECU_ADDRESS 0xFFF8EB4D /end MEASUREMENT
/begin MEASUREMENT S_MUELOWAUS_LAST "" UBYTE _CNV_P_2_A_I_5_CM_S2 1 0 0 255 ECU_ADDRESS 0xFFF8EB4E /end MEASUREMENT
/begin MEASUREMENT S_MUELOW_ERK "" UBYTE _CNV_P_2_A_I_5_CM_S2 1 0 0 255 ECU_ADDRESS 0xFFF8EB4F /end MEASUREMENT
/begin MEASUREMENT S_MUE_STATISCH "" UBYTE _CNV_P_2_A_I_5_CM_S2 1 0 0 255 ECU_ADDRESS 0xFFF8EA4B /end MEASUREMENT
/begin MEASUREMENT S_MUE_UEBERGANG "" UBYTE _CNV_P_2_A_I_5_CM_S2 1 0 0 255 ECU_ADDRESS 0xFFF8EA4C /end MEASUREMENT
/begin MEASUREMENT S_NAB_DELTANMOTHS_DECRSTART "" UBYTE _CNV_P_2_A_I_5_CM_S2 1 0 0 1 ECU_ADDRESS 0xFFF8E9E5 /end MEASUREMENT
/begin MEASUREMENT S_NICVERBOT_BERGANH "" UBYTE _CNV_P_2_A_I_5_CM_S2 1 0 0 255 ECU_ADDRESS 0xFFF8E9F9 /end MEASUREMENT
/begin MEASUREMENT S_NOTLAUF_AEP_ERK "" UBYTE _CNV_R_R_Umr_1_zu_1_2_CM_S2 1 0 0 255 ECU_ADDRESS 0xFFF8EA93 /end MEASUREMENT
/begin MEASUREMENT S_NOTLAUF_EM_HIGH_ERK "" UBYTE _CNV_R_R_Umr_1_zu_1_2_CM_S2 1 0 0 255 ECU_ADDRESS 0xFFF8EA94 /end MEASUREMENT
/begin MEASUREMENT S_NOTLAUF_EM_LOW_ERK "" UBYTE _CNV_R_R_Umr_1_zu_1_2_CM_S2 1 0 0 255 ECU_ADDRESS 0xFFF8EA95 /end MEASUREMENT
/begin MEASUREMENT S_N_ANGLEICH "" UBYTE _CNV_S_2_Schalter_A_4_CM_S2 1 0 0 1 ECU_ADDRESS 0xFFF8E91F /end MEASUREMENT
/begin MEASUREMENT S_ON_AB_HSFWS "" UBYTE _CNV_P_2_A_I_5_CM_S2 1 0 0 255 ECU_ADDRESS 0xFFF8E9FA /end MEASUREMENT
/begin MEASUREMENT S_OVERRIDE_GANG "" UBYTE _CNV_P_2_A_I_5_CM_S2 1 0 0 255 ECU_ADDRESS 0xFFF8EAD7 /end MEASUREMENT
/begin MEASUREMENT S_OVERRIDE_GANG_ROH "" UBYTE _CNV_R_R_Umr_1_zu_1_2_CM_S2 1 0 0 255 ECU_ADDRESS 0xFFF8E956 /end MEASUREMENT
/begin MEASUREMENT S_PADDLE_AUS "" UBYTE _CNV_S_2_Schalter_A_4_CM_S2 1 0 0 1 ECU_ADDRESS 0xFFF8EBB0 /end MEASUREMENT
/begin MEASUREMENT S_PADDLE_TIMER "" UBYTE _CNV_S_2_Schalter_A_4_CM_S2 1 0 0 1 ECU_ADDRESS 0xFFF8EBB1 /end MEASUREMENT
/begin MEASUREMENT S_PHASE4_ERREICHT_DYNDZM "" UBYTE _CNV_R_R_Umr_1_zu_1_2_CM_S2 1 0 0 1 ECU_ADDRESS 0xFFF8EA2B FORMAT "%2.0" /end MEASUREMENT
/begin MEASUREMENT S_PLUS "" UBYTE _CNV_P_2_A_I_5_CM_S2 1 0 0 255 ECU_ADDRESS 0xFFF8EBB2 /end MEASUREMENT
/begin MEASUREMENT S_PLUS_ALT_STEPS "" UBYTE _CNV_P_2_A_I_5_CM_S2 1 0 0 255 ECU_ADDRESS 0xFFF8E9CB /end MEASUREMENT
/begin MEASUREMENT S_PLUS_GWS "" UBYTE _CNV_P_2_A_I_5_CM_S2 1 0 0 255 ECU_ADDRESS 0xFFF8EAD8 /end MEASUREMENT
/begin MEASUREMENT S_PLUS_GWS_ROH "" UBYTE _CNV_S_2_Schalter_A_4_CM_S2 1 0 0 1 ECU_ADDRESS 0xFFF8E957 /end MEASUREMENT
/begin MEASUREMENT S_PLUS_HDC "" UBYTE _CNV_P_2_A_I_5_CM_S2 1 0 0 255 ECU_ADDRESS 0xFFF8EBB3 /end MEASUREMENT
/begin MEASUREMENT S_PLUS_PADDLE "" UBYTE _CNV_P_2_A_I_5_CM_S2 1 0 0 255 ECU_ADDRESS 0xFFF8EBB4 /end MEASUREMENT
/begin MEASUREMENT S_PLUS_PADDLE_ROH "" UBYTE _CNV_P_2_A_I_5_CM_S2 1 0 0 255 ECU_ADDRESS 0xFFF8E958 /end MEASUREMENT
/begin MEASUREMENT S_PLUS_TIPP "" UBYTE _CNV_P_2_A_I_5_CM_S2 1 0 0 255 ECU_ADDRESS 0xFFF8E9CC /end MEASUREMENT
/begin MEASUREMENT S_PMA "" UBYTE _CNV_R_R_Umr_1_zu_1_2_CM_S2 1 0 0 1 ECU_ADDRESS 0xFFF8EB13 /end MEASUREMENT
/begin MEASUREMENT S_PMA_ENBL "" UBYTE _CNV_R_R_Umr_1_zu_1_2_CM_S2 1 0 0 1 ECU_ADDRESS 0xFFF8EB14 /end MEASUREMENT
/begin MEASUREMENT S_PMA_ERK "" UBYTE _CNV_R_R_Umr_1_zu_1_2_CM_S2 1 0 0 1 ECU_ADDRESS 0xFFF8EB15 /end MEASUREMENT
/begin MEASUREMENT S_QS3_SOLL "" UBYTE _CNV_R_R_Umr_1_zu_1_2_CM_S2 1 0 0 1 ECU_ADDRESS 0xFFF8EB64 FORMAT "%2.0" /end MEASUREMENT
/begin MEASUREMENT S_QSHIFT_ARR "" UBYTE _CNV_P_2_A_I_5_CM_S2 1 0 0 255 ECU_ADDRESS 0xFFF8E776 MATRIX_DIM 42 1 1 /end MEASUREMENT
/begin MEASUREMENT S_QSHIFT_DSC_AUS "" UBYTE _CNV_P_2_A_I_5_CM_S2 1 0 0 255 ECU_ADDRESS 0xFFF8EB65 /end MEASUREMENT
/begin MEASUREMENT S_QSHIFT_DSC_DTC "" UBYTE _CNV_P_2_A_I_5_CM_S2 1 0 0 255 ECU_ADDRESS 0xFFF8EB66 /end MEASUREMENT
/begin MEASUREMENT S_QSHIFT_EXCFKT1 "" UBYTE _CNV_P_2_A_I_5_CM_S2 1 0 0 255 ECU_ADDRESS 0xFFF8EB67 /end MEASUREMENT
/begin MEASUREMENT S_QSHIFT_EXCFKT2 "" UBYTE _CNV_P_2_A_I_5_CM_S2 1 0 0 255 ECU_ADDRESS 0xFFF8EB68 /end MEASUREMENT
/begin MEASUREMENT S_QSHIFT_EXCFKT3 "" UBYTE _CNV_P_2_A_I_5_CM_S2 1 0 0 255 ECU_ADDRESS 0xFFF8EB69 /end MEASUREMENT
/begin MEASUREMENT S_QSHIFT_EXCFKT4 "" UBYTE _CNV_P_2_A_I_5_CM_S2 1 0 0 255 ECU_ADDRESS 0xFFF8EB6A /end MEASUREMENT
/begin MEASUREMENT S_QSHIFT_EXCFKT5 "" UBYTE _CNV_P_2_A_I_5_CM_S2 1 0 0 255 ECU_ADDRESS 0xFFF8EB6B /end MEASUREMENT
/begin MEASUREMENT S_QSHIFT_EXCFKT6 "" UBYTE _CNV_P_2_A_I_5_CM_S2 1 0 0 255 ECU_ADDRESS 0xFFF8EB6C /end MEASUREMENT
/begin MEASUREMENT S_QSHIFT_EXCFKT7 "" UBYTE _CNV_P_2_A_I_5_CM_S2 1 0 0 255 ECU_ADDRESS 0xFFF8EB6D /end MEASUREMENT
/begin MEASUREMENT S_QSHIFT_EXCFKT8 "" UBYTE _CNV_P_2_A_I_5_CM_S2 1 0 0 255 ECU_ADDRESS 0xFFF8EB6E /end MEASUREMENT
/begin MEASUREMENT S_QSHIFT_GWDKKD1 "" UBYTE _CNV_P_2_A_I_5_CM_S2 1 0 0 255 ECU_ADDRESS 0xFFF8EB6F /end MEASUREMENT
/begin MEASUREMENT S_QSHIFT_GWDKKD2 "" UBYTE _CNV_P_2_A_I_5_CM_S2 1 0 0 255 ECU_ADDRESS 0xFFF8EB70 /end MEASUREMENT
/begin MEASUREMENT S_QSHIFT_MFHS "" UBYTE _CNV_P_2_A_I_5_CM_S2 1 0 0 255 ECU_ADDRESS 0xFFF8EB71 /end MEASUREMENT
/begin MEASUREMENT S_QSHIFT_MFRS "" UBYTE _CNV_P_2_A_I_5_CM_S2 1 0 0 255 ECU_ADDRESS 0xFFF8EB72 /end MEASUREMENT
/begin MEASUREMENT S_QSHIFT_NULLAST "" UBYTE _CNV_P_2_A_I_5_CM_S2 1 0 0 255 ECU_ADDRESS 0xFFF8EB73 /end MEASUREMENT
/begin MEASUREMENT S_QSHIFT_RS "" UBYTE _CNV_S_2_Schalter_A_4_CM_S2 1 0 0 1 ECU_ADDRESS 0xFFF8EB74 /end MEASUREMENT
/begin MEASUREMENT S_QSHIFT_TEMP1 "" UBYTE _CNV_P_2_A_I_5_CM_S2 1 0 0 255 ECU_ADDRESS 0xFFF8EB75 /end MEASUREMENT
/begin MEASUREMENT S_QSHIFT_TEMP2 "" UBYTE _CNV_P_2_A_I_5_CM_S2 1 0 0 255 ECU_ADDRESS 0xFFF8EB76 /end MEASUREMENT
/begin MEASUREMENT S_QSHIFT_WDKKD1 "" UBYTE _CNV_P_2_A_I_5_CM_S2 1 0 0 255 ECU_ADDRESS 0xFFF8EB77 /end MEASUREMENT
/begin MEASUREMENT S_QSHIFT_WDKKD2 "" UBYTE _CNV_P_2_A_I_5_CM_S2 1 0 0 255 ECU_ADDRESS 0xFFF8EB78 /end MEASUREMENT
/begin MEASUREMENT S_QSHIFT_WDKKD3 "" UBYTE _CNV_P_2_A_I_5_CM_S2 1 0 0 255 ECU_ADDRESS 0xFFF8EB79 /end MEASUREMENT
/begin MEASUREMENT S_REG_ASC "" UBYTE _CNV_P_2_A_I_5_CM_S2 1 0 0 255 ECU_ADDRESS 0xFFF8EAD9 /end MEASUREMENT
/begin MEASUREMENT S_REG_ASCNACHL "" UBYTE _CNV_P_2_A_I_5_CM_S2 1 0 0 255 ECU_ADDRESS 0xFFF8E9E3 /end MEASUREMENT
/begin MEASUREMENT S_REG_ASC_ROH "" UBYTE _CNV_R_R_Umr_1_zu_1_2_CM_S2 1 0 0 255 ECU_ADDRESS 0xFFF8E959 /end MEASUREMENT
/begin MEASUREMENT S_REG_HSEARLIERLATERDSC "" UBYTE _CNV_P_2_A_I_5_CM_S2 1 0 0 255 ECU_ADDRESS 0xFFF8EA63 /end MEASUREMENT
/begin MEASUREMENT S_REKUPRS "" UBYTE _CNV_P_2_A_I_5_CM_S2 1 0 0 255 ECU_ADDRESS 0xFFF8EB84 /end MEASUREMENT
/begin MEASUREMENT S_REKUP_ERK "" UBYTE _CNV_P_2_A_I_5_CM_S2 1 0 0 255 ECU_ADDRESS 0xFFF8EA96 /end MEASUREMENT
/begin MEASUREMENT S_RENNSTART "" UBYTE _CNV_S_2_Schalter_A_4_CM_S2 1 0 0 1 ECU_ADDRESS 0xFFF8EADA /end MEASUREMENT
/begin MEASUREMENT S_RESET_SEQUENZER "" UBYTE _CNV_P_2_A_I_5_CM_S2 1 0 0 255 ECU_ADDRESS 0xFFF8EB3D /end MEASUREMENT
/begin MEASUREMENT S_RESET_TMRMUELOWAUSLAST "" UBYTE _CNV_P_2_A_I_5_CM_S2 1 0 0 255 ECU_ADDRESS 0xFFF8EB50 /end MEASUREMENT
/begin MEASUREMENT S_RESET_TMRWAITRS "" UBYTE _CNV_P_2_A_I_5_CM_S2 1 0 0 255 ECU_ADDRESS 0xFFF8EB3E /end MEASUREMENT
/begin MEASUREMENT S_RESET_VFZGPLAUSI "" UBYTE _CNV_S_2_Schalter_A_4_CM_S2 1 0 0 1 ECU_ADDRESS 0xFFF8EA08 /end MEASUREMENT
/begin MEASUREMENT S_ROLLE "" UBYTE _CNV_P_2_A_I_5_CM_S2 1 0 0 255 ECU_ADDRESS 0xFFF8EB89 /end MEASUREMENT
/begin MEASUREMENT S_ROLLE_CAN "" UBYTE _CNV_S_2_Schalter_A_4_CM_S2 1 0 0 1 ECU_ADDRESS 0xFFF8EADB /end MEASUREMENT
/begin MEASUREMENT S_ROLLE_CAN_ROH "" UBYTE _CNV_R_R_Umr_1_zu_1_2_CM_S2 1 0 0 255 ECU_ADDRESS 0xFFF8E935 /end MEASUREMENT
/begin MEASUREMENT S_RSSEQ_AKTIV_MAB "" UBYTE _CNV_P_2_A_I_5_CM_S2 1 0 0 255 ECU_ADDRESS 0xFFF8EB22 /end MEASUREMENT
/begin MEASUREMENT S_RSUBGH "" UBYTE _CNV_S_2_Schalter_A_4_CM_S2 1 0 0 1 ECU_ADDRESS 0xFFF8EC21 /end MEASUREMENT
/begin MEASUREMENT S_RSUBGH_ERK "" UBYTE _CNV_S_2_Schalter_A_4_CM_S2 1 0 0 1 ECU_ADDRESS 0xFFF8EB85 /end MEASUREMENT
/begin MEASUREMENT S_RSU_MUELOW_ERK "" UBYTE _CNV_P_2_A_I_5_CM_S2 1 0 0 255 ECU_ADDRESS 0xFFF8EB88 /end MEASUREMENT
/begin MEASUREMENT S_RSZ_BAB "" UBYTE _CNV_P_2_A_I_5_CM_S2 1 0 0 255 ECU_ADDRESS 0xFFF8EBE9 /end MEASUREMENT
/begin MEASUREMENT S_RSZ_VERBOT_DUE "" UBYTE _CNV_P_2_A_I_5_CM_S2 1 0 0 255 ECU_ADDRESS 0xFFF8E9CD /end MEASUREMENT
/begin MEASUREMENT S_RSZ_ZUL "" UBYTE _CNV_P_2_A_I_5_CM_S2 1 0 0 255 ECU_ADDRESS 0xFFF8EBEA /end MEASUREMENT
/begin MEASUREMENT S_RS_SEQ "" UBYTE _CNV_S_2_Enum_ERS_S_33_CM_S2 1 0 0 1 ECU_ADDRESS 0xFFF8EB3F /end MEASUREMENT
/begin MEASUREMENT S_SCHALTVERZUG "" UBYTE _CNV_S_2_Schalter_A_4_CM_S2 1 0 0 1 ECU_ADDRESS 0xFFF8EAC8 /end MEASUREMENT
/begin MEASUREMENT S_SCHALTVERZUG_ROH "" UBYTE _CNV_R_R_Umr_1_zu_1_2_CM_S2 1 0 0 1 ECU_ADDRESS 0xFFF8E946 FORMAT "%2.0" /end MEASUREMENT
/begin MEASUREMENT S_SCHALT_BAB "" UBYTE _CNV_P_2_A_I_5_CM_S2 1 0 0 255 ECU_ADDRESS 0xFFF8EBEB /end MEASUREMENT
/begin MEASUREMENT S_SCHALT_BABERK "" UBYTE _CNV_P_2_A_I_5_CM_S2 1 0 0 255 ECU_ADDRESS 0xFFF8EBEC /end MEASUREMENT
/begin MEASUREMENT S_SCHLUPF_NACHL "" UBYTE _CNV_P_2_A_I_5_CM_S2 1 0 0 255 ECU_ADDRESS 0xFFF8EB51 /end MEASUREMENT
/begin MEASUREMENT S_SCHLUPF_NACHLZWEI "" UBYTE _CNV_P_2_A_I_5_CM_S2 1 0 0 255 ECU_ADDRESS 0xFFF8EB52 /end MEASUREMENT
/begin MEASUREMENT S_SHIFT_NMOTHS "" UBYTE _CNV_P_2_A_I_5_CM_S2 1 0 0 255 ECU_ADDRESS 0xFFF8E9E6 /end MEASUREMENT
/begin MEASUREMENT S_SHIFT_NMOTHS_ALT "" UBYTE _CNV_P_2_A_I_5_CM_S2 1 0 0 1 ECU_ADDRESS 0xFFF8E9E7 /end MEASUREMENT
/begin MEASUREMENT S_SHIFT_UP "" UBYTE _CNV_P_2_A_I_5_CM_S2 1 0 0 255 ECU_ADDRESS 0xFFF8E9E8 /end MEASUREMENT
/begin MEASUREMENT S_SPA_AKTIV "" UBYTE _CNV_S_2_Schalter_A_4_CM_S2 1 0 0 1 ECU_ADDRESS 0xFFF8EB99 /end MEASUREMENT
/begin MEASUREMENT S_SPA_REGEN "" UBYTE _CNV_P_2_A_I_5_CM_S2 1 0 0 255 ECU_ADDRESS 0xFFF8EADC /end MEASUREMENT
/begin MEASUREMENT S_SPA_REGEN_ROH "" UBYTE _CNV_R_R_Umr_1_zu_1_2_CM_S2 1 0 0 255 ECU_ADDRESS 0xFFF8E95A /end MEASUREMENT
/begin MEASUREMENT S_SPERR_TIPP_STEPS "" UBYTE _CNV_S_2_Schalter_A_4_CM_S2 1 0 0 1 ECU_ADDRESS 0xFFF8E9CE /end MEASUREMENT
/begin MEASUREMENT S_START_CRUISE "" UBYTE _CNV_P_2_A_I_5_CM_S2 1 0 0 255 ECU_ADDRESS 0xFFF8E8B3 /end MEASUREMENT
/begin MEASUREMENT S_START_CRUISE_ALT "" UBYTE _CNV_P_2_A_I_5_CM_S2 1 0 0 255 ECU_ADDRESS 0xFFF8E9BA /end MEASUREMENT
/begin MEASUREMENT S_STAT_SPORT "" UBYTE _CNV_S_2_Enum_ESPOR_193_CM_S2 1 0 0 1 ECU_ADDRESS 0xFFF8EA15 /end MEASUREMENT
/begin MEASUREMENT S_STAT_SPORT_SS "" UBYTE _CNV_P_2_A_I_5_CM_S2 1 0 0 255 ECU_ADDRESS 0xFFF8E986 /end MEASUREMENT
/begin MEASUREMENT S_STAT_ZHS "" UBYTE _CNV_P_2_A_I_5_CM_S2 1 0 0 255 ECU_ADDRESS 0xFFF8EB39 /end MEASUREMENT
/begin MEASUREMENT S_STAT_ZHS_SS "" UBYTE _CNV_P_2_A_I_5_CM_S2 1 0 0 255 ECU_ADDRESS 0xFFF8E987 /end MEASUREMENT
/begin MEASUREMENT S_STEIGUNG_FILT_SCHNELL "" UBYTE _CNV_S_2_Schalter_A_4_CM_S2 1 0 0 1 ECU_ADDRESS 0xFFF8EBA4 /end MEASUREMENT
/begin MEASUREMENT S_STEIGUNG_STEPS "" UBYTE _CNV_S_2_Schalter_A_4_CM_S2 1 0 0 1 ECU_ADDRESS 0xFFF8E9CF /end MEASUREMENT
/begin MEASUREMENT S_STEPTR_ERK "" UBYTE _CNV_P_2_A_I_5_CM_S2 1 0 0 255 ECU_ADDRESS 0xFFF8EB30 /end MEASUREMENT
/begin MEASUREMENT S_STOPGO_ERK "" UBYTE _CNV_P_2_A_I_5_CM_S2 1 0 0 255 ECU_ADDRESS 0xFFF8EBA9 /end MEASUREMENT
/begin MEASUREMENT S_STOPGO_NIC_ERK "" UBYTE _CNV_P_2_A_I_5_CM_S2 1 0 0 255 ECU_ADDRESS 0xFFF8EBAA /end MEASUREMENT
/begin MEASUREMENT S_STOP_WL "" UBYTE _CNV_P_2_A_I_5_CM_S2 1 0 0 255 ECU_ADDRESS 0xFFF8EBBA /end MEASUREMENT
/begin MEASUREMENT S_TBUFFER "" UBYTE _CNV_P_2_A_I_5_CM_S2 1 0 0 255 ECU_ADDRESS 0xFFF8E9FB /end MEASUREMENT
/begin MEASUREMENT S_TID_ERK "" UBYTE _CNV_P_2_A_I_5_CM_S2 1 0 0 255 ECU_ADDRESS 0xFFF8EB31 /end MEASUREMENT
/begin MEASUREMENT S_TID_FFG "" UBYTE _CNV_P_2_A_I_5_CM_S2 1 0 0 255 ECU_ADDRESS 0xFFF8E8D8 /end MEASUREMENT
/begin MEASUREMENT S_TID_IM_STAND "" UBYTE _CNV_P_2_A_I_5_CM_S2 1 0 0 255 ECU_ADDRESS 0xFFF8EC25 /end MEASUREMENT
/begin MEASUREMENT S_TIMER_MINLV "" UBYTE _CNV_P_2_A_I_5_CM_S2 1 0 0 255 ECU_ADDRESS 0xFFF8EB53 /end MEASUREMENT
/begin MEASUREMENT S_TIMER_MUELOWAUS "" UBYTE _CNV_P_2_A_I_5_CM_S2 1 0 0 255 ECU_ADDRESS 0xFFF8EB54 /end MEASUREMENT
/begin MEASUREMENT S_TIPPHS_DYNDZM "" UBYTE _CNV_R_R_Umr_1_zu_1_2_CM_S2 1 0 0 1 ECU_ADDRESS 0xFFF8EA2C FORMAT "%2.0" /end MEASUREMENT
/begin MEASUREMENT S_TMR_BSCHLUPF "" UBYTE _CNV_P_2_A_I_5_CM_S2 1 0 0 255 ECU_ADDRESS 0xFFF8EB55 /end MEASUREMENT
/begin MEASUREMENT S_TMS_ERK "" UBYTE _CNV_P_2_A_I_5_CM_S2 1 0 0 255 ECU_ADDRESS 0xFFF8E909 /end MEASUREMENT
/begin MEASUREMENT S_TSET_BABFGR "" UBYTE _CNV_P_2_A_I_5_CM_S2 1 0 0 255 ECU_ADDRESS 0xFFF8EBED /end MEASUREMENT
/begin MEASUREMENT S_TSG_LAEUFT "" UBYTE _CNV_P_2_A_I_5_CM_S2 1 0 0 255 ECU_ADDRESS 0xFFF8EBAB /end MEASUREMENT
/begin MEASUREMENT S_T_DERS_HS "" UBYTE _CNV_R_R_Umr_1_zu_1_6_CM_S2 1 0 0 255 ECU_ADDRESS 0xFFF8EC0E FORMAT "%2.0" /end MEASUREMENT
/begin MEASUREMENT S_T_DERS_LAEUFT "" UBYTE _CNV_R_R_Umr_1_zu_1_6_CM_S2 1 0 0 255 ECU_ADDRESS 0xFFF8EC0F FORMAT "%2.0" /end MEASUREMENT
/begin MEASUREMENT S_T_DMRSSTART "" UBYTE _CNV_P_2_A_I_5_CM_S2 1 0 0 255 ECU_ADDRESS 0xFFF8EA1D /end MEASUREMENT
/begin MEASUREMENT S_T_MDSSCHUB_LAEUFT "" UBYTE _CNV_S_2_Schalter_A_4_CM_S2 1 0 0 1 ECU_ADDRESS 0xFFF8EC1F /end MEASUREMENT
/begin MEASUREMENT S_T_MDSSCHUB_REGEN_LAEUFT "" UBYTE _CNV_S_2_Schalter_A_4_CM_S2 1 0 0 1 ECU_ADDRESS 0xFFF8EC20 /end MEASUREMENT
/begin MEASUREMENT S_T_MFRSSTART_ZKA "" UBYTE _CNV_R_R_Umr_1_zu_1_2_CM_S2 1 0 0 255 ECU_ADDRESS 0xFFF8EBCB FORMAT "%2.0" /end MEASUREMENT
/begin MEASUREMENT S_UPDATE_GN_MTTRAD "" UBYTE _CNV_P_2_A_I_5_CM_S2 1 0 0 1 ECU_ADDRESS 0xFFF8EB5F /end MEASUREMENT
/begin MEASUREMENT S_USE_MABBREMS_FWSBER "" UBYTE _CNV_R_R_Umr_1_zu_1_2_CM_S2 1 0 0 1 ECU_ADDRESS 0xFFF8EA4D FORMAT "%2.0" /end MEASUREMENT
/begin MEASUREMENT S_VALID_BER_MMOTHKOR "" UBYTE _CNV_R_R_Umr_1_zu_1_2_CM_S2 1 0 0 1 ECU_ADDRESS 0xFFF8EA70 FORMAT "%2.0" /end MEASUREMENT
/begin MEASUREMENT S_VALID_DBM "" UBYTE _CNV_R_R_Umr_1_zu_1_2_CM_S2 1 0 0 255 ECU_ADDRESS 0xFFF8E8F0 FORMAT "%2.0" /end MEASUREMENT
/begin MEASUREMENT S_VALID_DMABFWS "" UBYTE _CNV_P_2_A_I_5_CM_S2 1 0 0 1 ECU_ADDRESS 0xFFF8EA4E /end MEASUREMENT
/begin MEASUREMENT S_VALID_DMABFWS_ACT_MSASTART "" UBYTE _CNV_R_R_Umr_1_zu_1_2_CM_S2 1 0 0 1 ECU_ADDRESS 0xFFF8EA4F /end MEASUREMENT
/begin MEASUREMENT S_VALID_DMABFWS_BREMS "" UBYTE _CNV_R_R_Umr_1_zu_1_2_CM_S2 1 0 0 1 ECU_ADDRESS 0xFFF8EA51 /end MEASUREMENT
/begin MEASUREMENT S_VALID_DMABFWS_BREMSNACHL "" UBYTE _CNV_R_R_Umr_1_zu_1_2_CM_S2 1 0 0 1 ECU_ADDRESS 0xFFF8EA52 /end MEASUREMENT
/begin MEASUREMENT S_VALID_DMABFWS_GWFP "" UBYTE _CNV_R_R_Umr_1_zu_1_2_CM_S2 1 0 0 1 ECU_ADDRESS 0xFFF8EA53 /end MEASUREMENT
/begin MEASUREMENT S_VALID_DMABFWS_MSASTART "" UBYTE _CNV_R_R_Umr_1_zu_1_2_CM_S2 1 0 0 1 ECU_ADDRESS 0xFFF8EA50 /end MEASUREMENT
/begin MEASUREMENT S_VALID_DMABFWS_SCHALT "" UBYTE _CNV_R_R_Umr_1_zu_1_2_CM_S2 1 0 0 1 ECU_ADDRESS 0xFFF8EA54 /end MEASUREMENT
/begin MEASUREMENT S_VALID_DMABFWS_SCHLUPF "" UBYTE _CNV_R_R_Umr_1_zu_1_2_CM_S2 1 0 0 1 ECU_ADDRESS 0xFFF8EA55 /end MEASUREMENT
/begin MEASUREMENT S_VALID_GNTMED "" UWORD _CNV_P_2_A_I_32_CM_S2 1 0 0 65535 ECU_ADDRESS 0xFFF8E5BA /end MEASUREMENT
/begin MEASUREMENT S_VALID_ZIELALT_DBM "" UBYTE _CNV_R_R_Umr_1_zu_1_2_CM_S2 1 0 0 255 ECU_ADDRESS 0xFFF8E8F3 FORMAT "%2.0" /end MEASUREMENT
/begin MEASUREMENT S_VFZG_COG "" UBYTE _CNV_R_R_Umr_1_zu_1_2_CM_S2 1 0 0 1 ECU_ADDRESS 0xFFF8EA5B FORMAT "%2.0" /end MEASUREMENT
/begin MEASUREMENT S_VFZG_FILT "" UBYTE _CNV_R_R_Umr_1_zu_1_2_CM_S2 1 0 0 1 ECU_ADDRESS 0xFFF8EA5C FORMAT "%2.0" /end MEASUREMENT
/begin MEASUREMENT S_VFZG_PLAUSI "" UBYTE _CNV_S_2_Schalter_A_4_CM_S2 1 0 0 1 ECU_ADDRESS 0xFFF8EADD /end MEASUREMENT
/begin MEASUREMENT S_VFZG_PLAUSI_ALT "" UBYTE _CNV_S_2_Schalter_A_4_CM_S2 1 0 0 1 ECU_ADDRESS 0xFFF8E9BB /end MEASUREMENT
/begin MEASUREMENT S_VFZG_PLAUSI_ROH "" UBYTE _CNV_R_R_Umr_1_zu_1_2_CM_S2 1 0 0 255 ECU_ADDRESS 0xFFF8E95B /end MEASUREMENT
/begin MEASUREMENT S_V_RSZBAB "" UBYTE _CNV_P_2_A_I_5_CM_S2 1 0 0 255 ECU_ADDRESS 0xFFF8EBEE /end MEASUREMENT
/begin MEASUREMENT S_WKV_MAB "" UBYTE _CNV_P_2_A_I_5_CM_S2 1 0 0 255 ECU_ADDRESS 0xFFF8EB23 /end MEASUREMENT
/begin MEASUREMENT S_WL "" UBYTE _CNV_P_2_A_I_5_CM_S2 1 0 0 255 ECU_ADDRESS 0xFFF8EBBB /end MEASUREMENT
/begin MEASUREMENT S_WL2_ERK "" UBYTE _CNV_S_2_Schalter_A_4_CM_S2 1 0 0 1 ECU_ADDRESS 0xFFF8EBB6 /end MEASUREMENT
/begin MEASUREMENT S_WLPRED "" UBYTE _CNV_S_2_Schalter_A_4_CM_S2 1 0 0 1 ECU_ADDRESS 0xFFF8EBB7 /end MEASUREMENT
/begin MEASUREMENT S_WLSPV_ERK "" UBYTE _CNV_P_2_A_I_5_CM_S2 1 0 0 255 ECU_ADDRESS 0xFFF8EBBC /end MEASUREMENT
/begin MEASUREMENT S_WL_ERK "" UBYTE _CNV_P_2_A_I_5_CM_S2 1 0 0 255 ECU_ADDRESS 0xFFF8EBBD /end MEASUREMENT
/begin MEASUREMENT S_ZHSKDRS_VERBOT_STEPS "" UBYTE _CNV_S_2_Schalter_A_4_CM_S2 1 0 0 1 ECU_ADDRESS 0xFFF8E9D0 /end MEASUREMENT
/begin MEASUREMENT S_ZHS_VERBOT_DUE "" UBYTE _CNV_S_2_Schalter_A_4_CM_S2 1 0 0 1 ECU_ADDRESS 0xFFF8EB3A /end MEASUREMENT
/begin MEASUREMENT S_ZHS_VERBOT_KOORD "" UBYTE _CNV_S_2_Schalter_A_4_CM_S2 1 0 0 1 ECU_ADDRESS 0xFFF8EB3B /end MEASUREMENT
/begin MEASUREMENT S_ZHS_VERBOT_PRISQ "" UBYTE _CNV_P_2_A_I_5_CM_S2 1 0 0 255 ECU_ADDRESS 0xFFF8E8D9 /end MEASUREMENT
/begin MEASUREMENT S_ZHS_VERBOT_STEPS "" UBYTE _CNV_P_2_A_I_5_CM_S2 1 0 0 255 ECU_ADDRESS 0xFFF8E9D1 /end MEASUREMENT
/begin MEASUREMENT S_ZRSGANG1_ERK "" UBYTE _CNV_P_2_A_I_5_CM_S2 1 0 0 255 ECU_ADDRESS 0xFFF8EBE1 /end MEASUREMENT
/begin MEASUREMENT S_ZRSGANG1_EXT_ERK "" UBYTE _CNV_R_R_Umr_1_zu_1_2_CM_S2 1 0 0 1 ECU_ADDRESS 0xFFF8EBE2 /end MEASUREMENT
/begin MEASUREMENT S_ZRS_MOD_STEPS "" UBYTE _CNV_S_2_Schalter_A_4_CM_S2 1 0 0 1 ECU_ADDRESS 0xFFF8E9D2 /end MEASUREMENT
/begin MEASUREMENT S_ZUG "" UBYTE _CNV_S_2_Schalter_A_4_CM_S2 1 0 0 1 ECU_ADDRESS 0xFFF8E920 /end MEASUREMENT
/begin MEASUREMENT S_ZUG_FZGERK "" UBYTE _CNV_R_R_Umr_1_zu_1_2_CM_S2 1 0 0 2 ECU_ADDRESS 0xFFF8EA5D FORMAT "%2.0" /end MEASUREMENT
/begin MEASUREMENT S_ZWANG_HSRS_AKTIV "" UBYTE _CNV_S_2_Schalter_A_4_CM_S2 1 0 0 1 ECU_ADDRESS 0xFFF8E9D3 /end MEASUREMENT
/begin MEASUREMENT S_ZWANG_HSRS_STPTRsport "" UBYTE _CNV_S_2_Schalter_A_4_CM_S2 1 0 0 1 ECU_ADDRESS 0xFFF8E9D4 /end MEASUREMENT
/begin MEASUREMENT ShiftLock.DrvReqPRND_SL "Shiftlock filtered PosPRND signal" UBYTE SBW_STANDARD_S1_S3 1 100 0 8 ECU_ADDRESS 0xFFF89900 DISPLAY_IDENTIFIER DrvReqPRND_SL.ShiftLock /end MEASUREMENT
/begin MEASUREMENT ShiftLock.Shiftlock_Brake.cShiftlock_SubModule._.f_Active "Shiftlock is active" UBYTE SBW_STANDARD_S1_S3 1 100 0 1 BIT_MASK 0x1 ECU_ADDRESS 0xFFF898D8 DISPLAY_IDENTIFIER f_Active._.cShiftlock_SubModule.Shiftlock_Brake.ShiftLock /end MEASUREMENT
/begin MEASUREMENT ShiftLock.Shiftlock_CAN.cShiftlock_SubModule._.f_Active "Shiftlock is active" UBYTE SBW_STANDARD_S1_S3 1 100 0 1 BIT_MASK 0x1 ECU_ADDRESS 0xFFF898F4 DISPLAY_IDENTIFIER f_Active._.cShiftlock_SubModule.Shiftlock_CAN.ShiftLock /end MEASUREMENT
/begin MEASUREMENT ShiftLock.Shiftlock_Engine.cShiftlock_SubModule._.f_Active "Shiftlock is active" UBYTE SBW_STANDARD_S1_S3 1 100 0 1 BIT_MASK 0x1 ECU_ADDRESS 0xFFF898E0 DISPLAY_IDENTIFIER f_Active._.cShiftlock_SubModule.Shiftlock_Engine.ShiftLock /end MEASUREMENT
/begin MEASUREMENT ShiftLock.Shiftlock_RemoteStart.cShiftlock_SubModule._.f_Active "Shiftlock is active" UBYTE SBW_STANDARD_S1_S3 1 100 0 1 BIT_MASK 0x1 ECU_ADDRESS 0xFFF898E8 DISPLAY_IDENTIFIER f_Active._.cShiftlock_SubModule.Shiftlock_RemoteStart.ShiftLock /end MEASUREMENT
/begin MEASUREMENT ShiftLock.Shiftlock_RemoteStart.f_RemoteStart "enable shiftlock via keyy remote start" UBYTE SBW_STANDARD_S1_S3 1 100 0 1 BIT_MASK 0x1 ECU_ADDRESS 0xFFF898EC DISPLAY_IDENTIFIER f_RemoteStart.Shiftlock_RemoteStart.ShiftLock /end MEASUREMENT
/begin MEASUREMENT ShiftLock.Shiftlock_RemoteStart.f_RemoteStart_SLDisable "permanent deactivation of shiftlock remote start for complete ignition cycle" UBYTE SBW_STANDARD_S1_S3 1 100 0 1 BIT_MASK 0x1 ECU_ADDRESS 0xFFF898ED DISPLAY_IDENTIFIER f_RemoteStart_SLDisable.Shiftlock_RemoteStart.ShiftLock /end MEASUREMENT
/begin MEASUREMENT ShiftLock.f_CC_ShiftlockActive "Flag for CC-Message: Push Break to insert Gear" UBYTE SBW_STANDARD_S1_S3 1 100 0 1 BIT_MASK 0x1 ECU_ADDRESS 0xFFF89901 DISPLAY_IDENTIFIER f_CC_ShiftlockActive.ShiftLock /end MEASUREMENT
/begin MEASUREMENT ShiftLock.f_Shiftlock_Brake "Shiftlock brake active" UBYTE SBW_STANDARD_S1_S3 1 100 0 1 BIT_MASK 0x1 ECU_ADDRESS 0xFFF898FC DISPLAY_IDENTIFIER f_Shiftlock_Brake.ShiftLock /end MEASUREMENT
/begin MEASUREMENT ShiftLock.f_Shiftlock_CAN "Shiftlock CAN active" UBYTE SBW_STANDARD_S1_S3 1 100 0 1 BIT_MASK 0x1 ECU_ADDRESS 0xFFF898FF DISPLAY_IDENTIFIER f_Shiftlock_CAN.ShiftLock /end MEASUREMENT
/begin MEASUREMENT ShiftLock.f_Shiftlock_Engine "Shiftlock engine active" UBYTE SBW_STANDARD_S1_S3 1 100 0 1 BIT_MASK 0x1 ECU_ADDRESS 0xFFF898FD DISPLAY_IDENTIFIER f_Shiftlock_Engine.ShiftLock /end MEASUREMENT
/begin MEASUREMENT ShiftLock.f_Shiftlock_RemoteStart "Shiftlock RemoteStart active" UBYTE SBW_STANDARD_S1_S3 1 100 0 1 BIT_MASK 0x1 ECU_ADDRESS 0xFFF898FE DISPLAY_IDENTIFIER f_Shiftlock_RemoteStart.ShiftLock /end MEASUREMENT
/begin MEASUREMENT SignalConditioning.f_cc_PSAbuse "flag signaling mech.parklock-abuse conditions" UBYTE SBW_STANDARD_S1_S3 1 100 0 1 BIT_MASK 0x1 ECU_ADDRESS 0xFFF897C0 DISPLAY_IDENTIFIER f_cc_PSAbuse.SignalConditioning /end MEASUREMENT
/begin MEASUREMENT SignalConditioning.tmr_DiagAfterFirstKL15.f_IsExpired "test_timer" UBYTE SBW_STANDARD_S1_S3 1 100 0 255 ECU_ADDRESS 0xFFF897BA DISPLAY_IDENTIFIER f_IsExpired.tmr_DiagAfterFirstKL15.SignalConditioning /end MEASUREMENT
/begin MEASUREMENT SignalConditioning.tmr_DiagAfterFirstKL15.time "test_timer" UWORD SBW_TIMER_10MS_S1_S3 1 100 0 655350 ECU_ADDRESS 0xFFF897B8 DISPLAY_IDENTIFIER time.tmr_DiagAfterFirstKL15.SignalConditioning /end MEASUREMENT
/begin MEASUREMENT SignalConditioning.tmr_DiagAfterKL15.f_IsExpired "test_timer" UBYTE SBW_STANDARD_S1_S3 1 100 0 255 ECU_ADDRESS 0xFFF897BE DISPLAY_IDENTIFIER f_IsExpired.tmr_DiagAfterKL15.SignalConditioning /end MEASUREMENT
/begin MEASUREMENT SignalConditioning.tmr_DiagAfterKL15.time "test_timer" UWORD SBW_TIMER_10MS_S1_S3 1 100 0 655350 ECU_ADDRESS 0xFFF897BC DISPLAY_IDENTIFIER time.tmr_DiagAfterKL15.SignalConditioning /end MEASUREMENT
/begin MEASUREMENT Sonstige.BefModell.KolbenPos "EepromStd[192 ... 201]: Befuellmodell - Kolbenposition [(x=5/UMR___1_1_0)]" UWORD UMR_PROZENT__1_100_0_S5_S3 1 100 0 100 ECU_ADDRESS 0xFFF810F8 DISPLAY_IDENTIFIER KolbenPos.BefModell.Sonstige MATRIX_DIM 5 1 1 /end MEASUREMENT
/begin MEASUREMENT Sonstige.InfoSpeicher.Eintrag "EepromStd[6 ... 185]: Atsys Infospeicher Eintraege [(x=18/UMR___1_1_0),(y=10/UMR___1_1_0)]" UBYTE UMR___1_1_0_S5_S3 1 100 0 255 ECU_ADDRESS 0xFFF8103E DISPLAY_IDENTIFIER Eintrag.InfoSpeicher.Sonstige MATRIX_DIM 180 1 1 /end MEASUREMENT
/begin MEASUREMENT Sonstige.InfoSpeicher.Init "EepromStd[188 ... 189]: Atsys Infospeicher: derzeit noch dummy-Groesse fuer Initialisierung [(x=1/UMR___1_1_0)]" UWORD UMR___1_1_0_S5_S3 1 100 0 65535 ECU_ADDRESS 0xFFF810F4 DISPLAY_IDENTIFIER Init.InfoSpeicher.Sonstige /end MEASUREMENT
/begin MEASUREMENT Sonstige.InfoSpeicher.Zaehler "EepromStd[186 ... 187]: Atsys Infospeicher: Anzahl der Eintraege [(x=1/UMR___1_1_0)]" UWORD UMR___1_1_0_S5_S3 1 100 0 65535 ECU_ADDRESS 0xFFF810F2 DISPLAY_IDENTIFIER Zaehler.InfoSpeicher.Sonstige /end MEASUREMENT
/begin MEASUREMENT Sonstige.Itf.AbstellTemperatur "EepromStd[190]: Getriebe Abstelltemperatur [(x=1/UMR___1_1_0)]" UBYTE UMR_GRADC__1_1_M40_S5_S3 1 100 -40 215 ECU_ADDRESS 0xFFF810F6 DISPLAY_IDENTIFIER AbstellTemperatur.Itf.Sonstige /end MEASUREMENT
/begin MEASUREMENT Sonstige.Itf.Dummy "EepromStd[191]: Dummy Speicher [(x=1/UMR___1_1_0)]" UBYTE UMR___1_1_0_S5_S3 1 100 0 255 ECU_ADDRESS 0xFFF810F7 DISPLAY_IDENTIFIER Dummy.Itf.Sonstige /end MEASUREMENT
/begin MEASUREMENT Sonstige.PosVUew.Zaehler "EepromStd[204 ... 207]: PosV Ueberwachung Zaehler ueber Zuendung/Motor AUS [(x=1/UMR___1_1_0)]" ULONG UMR___1_1_0_S5_S3 1 100 0 2147483647 ECU_ADDRESS 0xFFF81104 DISPLAY_IDENTIFIER Zaehler.PosVUew.Sonstige /end MEASUREMENT
/begin MEASUREMENT Sonstige.Test.StartEE "EepromStd[4 ... 5]: Markierung 12345 am Anfang des Kanals EepromStd [(x=1/UMR___1_1_0)]" UWORD UMR___1_1_0_S5_S3 1 100 0 65535 ECU_ADDRESS 0xFFF8103C DISPLAY_IDENTIFIER StartEE.Test.Sonstige /end MEASUREMENT
/begin MEASUREMENT SrvcMsgHandler.LastSemaphore "value of the semaphore of previous cycle" UBYTE SBW_STANDARD_S1_S3 1 100 0 1 BIT_MASK 0x1 ECU_ADDRESS 0xFFF8997F DISPLAY_IDENTIFIER LastSemaphore.SrvcMsgHandler /end MEASUREMENT
/begin MEASUREMENT SrvcMsgHandler.MSA_Msg_Function_Requester "saving ID_FN_RQ_MSA 8Bit" UBYTE SBW_STANDARD_S1_S3 1 100 0 255 ECU_ADDRESS 0xFFF89983 DISPLAY_IDENTIFIER MSA_Msg_Function_Requester.SrvcMsgHandler /end MEASUREMENT
/begin MEASUREMENT SrvcMsgHandler.MSA_Msg_Function_Selection "saving RQ_MSA_FN_SLCTN 6Bit" UBYTE SBW_STANDARD_S1_S3 1 100 0 255 ECU_ADDRESS 0xFFF89982 DISPLAY_IDENTIFIER MSA_Msg_Function_Selection.SrvcMsgHandler /end MEASUREMENT
/begin MEASUREMENT SrvcMsgHandler.cnt_NrOfOverdueMsgs "count number of sendings" UBYTE SBW_STANDARD_S1_S3 1 100 0 255 ECU_ADDRESS 0xFFF8997E DISPLAY_IDENTIFIER cnt_NrOfOverdueMsgs.SrvcMsgHandler /end MEASUREMENT
/begin MEASUREMENT SrvcMsgHandler.cnt_Send_Counter "Number of times same msg is resent" UBYTE SBW_STANDARD_S1_S3 1 100 0 3 ECU_ADDRESS 0xFFF89981 DISPLAY_IDENTIFIER cnt_Send_Counter.SrvcMsgHandler /end MEASUREMENT
/begin MEASUREMENT SrvcMsgHandler.st_SendMSA_MSg "state of statemachine for sending the MSA Msg" UBYTE SBW_STANDARD_S1_S3 1 100 0 3 ECU_ADDRESS 0xFFF89980 DISPLAY_IDENTIFIER st_SendMSA_MSg.SrvcMsgHandler /end MEASUREMENT
/begin MEASUREMENT SrvcMsgHandler.tmr_MSA_MsgCyclicSend.f_IsExpired "test_timer" UBYTE SBW_STANDARD_S1_S3 1 100 0 255 ECU_ADDRESS 0xFFF89979 DISPLAY_IDENTIFIER f_IsExpired.tmr_MSA_MsgCyclicSend.SrvcMsgHandler /end MEASUREMENT
/begin MEASUREMENT SrvcMsgHandler.tmr_MSA_MsgCyclicSend.time "test_timer" UBYTE SBW_TIMER_10MS_S1_S3 1 100 0 2550 ECU_ADDRESS 0xFFF89978 DISPLAY_IDENTIFIER time.tmr_MSA_MsgCyclicSend.SrvcMsgHandler /end MEASUREMENT
/begin MEASUREMENT SrvcMsgHandler.tmr_MSA_MsgDebouncing.f_IsExpired "test_timer" UBYTE SBW_STANDARD_S1_S3 1 100 0 255 ECU_ADDRESS 0xFFF8997B DISPLAY_IDENTIFIER f_IsExpired.tmr_MSA_MsgDebouncing.SrvcMsgHandler /end MEASUREMENT
/begin MEASUREMENT SrvcMsgHandler.tmr_MSA_MsgDebouncing.time "test_timer" UBYTE SBW_TIMER_10MS_S1_S3 1 100 0 2550 ECU_ADDRESS 0xFFF8997A DISPLAY_IDENTIFIER time.tmr_MSA_MsgDebouncing.SrvcMsgHandler /end MEASUREMENT
/begin MEASUREMENT SrvcMsgHandler.tmr_MSA_MsgWaitResend.f_IsExpired "test_timer" UBYTE SBW_STANDARD_S1_S3 1 100 0 255 ECU_ADDRESS 0xFFF8997D DISPLAY_IDENTIFIER f_IsExpired.tmr_MSA_MsgWaitResend.SrvcMsgHandler /end MEASUREMENT
/begin MEASUREMENT SrvcMsgHandler.tmr_MSA_MsgWaitResend.time "test_timer" UBYTE SBW_TIMER_10MS_S1_S3 1 100 0 2550 ECU_ADDRESS 0xFFF8997C DISPLAY_IDENTIFIER time.tmr_MSA_MsgWaitResend.SrvcMsgHandler /end MEASUREMENT
/begin MEASUREMENT StarterRelease.st_StarterRelease "state of starter release [0=no eng.start; 1=trnsmsn. in pos N - enable eng.start; 2=trnsmsn. in pos P - enable eng.start; 3=init-val. - signal invalid]" UBYTE SBW_STANDARD_S1_S3 1 100 0 3 ECU_ADDRESS 0xFFF89403 DISPLAY_IDENTIFIER st_StarterRelease.StarterRelease /end MEASUREMENT
/begin MEASUREMENT StarterReleaseBPRam.f_DelayCrankInMechLimpBPRam "buffered flag f_DelayCrankInMechLimpBPRam" UBYTE SBW_STANDARD_S1_S3 1 100 0 255 ECU_ADDRESS 0xFFF835D0 DISPLAY_IDENTIFIER f_DelayCrankInMechLimpBPRam.StarterReleaseBPRam /end MEASUREMENT
/begin MEASUREMENT StarterReleaseBPRam.f_DelayCrankInMechLimpBPRam_ "Complement of buffered flag f_DelayCrankInMechLimpBPRam" UBYTE SBW_STANDARD_S1_S3 1 100 0 255 ECU_ADDRESS 0xFFF835D1 DISPLAY_IDENTIFIER f_DelayCrankInMechLimpBPRam_.StarterReleaseBPRam /end MEASUREMENT
/begin MEASUREMENT StarterReleaseOEM.st_StarterRelease "state of starter release [0=no eng.start; 1=trnsmsn. in pos N - enable eng.start; 2=trnsmsn. in pos P - enable eng.start; 3=init-val. - signal invalid]" UBYTE SBW_STANDARD_S1_S3 1 100 0 3 ECU_ADDRESS 0xFFF8D69B DISPLAY_IDENTIFIER st_StarterRelease.StarterReleaseOEM /end MEASUREMENT
/begin MEASUREMENT StarterReleaseOEM.st_StarterRelease_ "Complement of state of starter release [255=no eng.start; 254=trnsmsn. in pos N - enable eng.start; 253=trnsmsn. in pos P - enable eng.start; 252=init-val. - signal invalid]" UBYTE SBW_STANDARD_S1_S3 1 100 252 255 ECU_ADDRESS 0xFFF8D69A DISPLAY_IDENTIFIER st_StarterRelease_.StarterReleaseOEM /end MEASUREMENT
/begin MEASUREMENT StatisticCounter.SportLevel "current sport level" UBYTE SBW_STANDARD_S1_S3 1 100 0 255 ECU_ADDRESS 0xFFF89CC4 DISPLAY_IDENTIFIER SportLevel.StatisticCounter /end MEASUREMENT
/begin MEASUREMENT StatisticCounter.cnt_AdaptiveMode "counter to ensure that eeprom counter for adaptive mode is icreased every second" UBYTE SBW_STANDARD_S1_S3 1 100 0 255 ECU_ADDRESS 0xFFF89CC5 DISPLAY_IDENTIFIER cnt_AdaptiveMode.StatisticCounter /end MEASUREMENT
/begin MEASUREMENT StatisticCounter.cnt_ManualMode "counter to ensure that eeprom counter for manual mode is icreased every second" UBYTE SBW_STANDARD_S1_S3 1 100 0 255 ECU_ADDRESS 0xFFF89CC7 DISPLAY_IDENTIFIER cnt_ManualMode.StatisticCounter /end MEASUREMENT
/begin MEASUREMENT StatisticCounter.cnt_SportMode "counter to ensure that eeprom counter for sport mode is icreased every second" UBYTE SBW_STANDARD_S1_S3 1 100 0 255 ECU_ADDRESS 0xFFF89CC6 DISPLAY_IDENTIFIER cnt_SportMode.StatisticCounter /end MEASUREMENT
/begin MEASUREMENT StoreDrvReq.DrvReqPRND "Driver Request after Storing Position" UBYTE SBW_STANDARD_S1_S3 1 100 0 8 ECU_ADDRESS 0xFFF89898 DISPLAY_IDENTIFIER DrvReqPRND.StoreDrvReq /end MEASUREMENT
/begin MEASUREMENT StoreDrvReq.DrvReqPRND_FiltPrev "Last Position of Driver Request after Debouncing" UBYTE SBW_STANDARD_S1_S3 1 100 0 8 ECU_ADDRESS 0xFFF8989B DISPLAY_IDENTIFIER DrvReqPRND_FiltPrev.StoreDrvReq /end MEASUREMENT
/begin MEASUREMENT StoreDrvReq.f_NoStoreN "error flag which prevents storage of N" UBYTE SBW_STANDARD_S1_S3 1 100 0 1 BIT_MASK 0x1 ECU_ADDRESS 0xFFF8989E DISPLAY_IDENTIFIER f_NoStoreN.StoreDrvReq /end MEASUREMENT
/begin MEASUREMENT StoreDrvReq.f_NoStoreP "error flag which prevents storage of P" UBYTE SBW_STANDARD_S1_S3 1 100 0 1 BIT_MASK 0x1 ECU_ADDRESS 0xFFF8989C DISPLAY_IDENTIFIER f_NoStoreP.StoreDrvReq /end MEASUREMENT
/begin MEASUREMENT StoreDrvReq.f_NoStoreRD "error flag which prevents storage of R or D" UBYTE SBW_STANDARD_S1_S3 1 100 0 1 BIT_MASK 0x1 ECU_ADDRESS 0xFFF8989D DISPLAY_IDENTIFIER f_NoStoreRD.StoreDrvReq /end MEASUREMENT
/begin MEASUREMENT StoreDrvReq.f_StartRestartOrResetOfStorageOccured "if storage started this flag prevents from being stopped in the same cycle" UBYTE SBW_STANDARD_S1_S3 1 100 0 1 BIT_MASK 0x1 ECU_ADDRESS 0xFFF8989A DISPLAY_IDENTIFIER f_StartRestartOrResetOfStorageOccured.StoreDrvReq /end MEASUREMENT
/begin MEASUREMENT StoreDrvReq.st_StorePRND "Stored position" UBYTE SBW_STANDARD_S1_S3 1 100 0 8 ECU_ADDRESS 0xFFF89899 DISPLAY_IDENTIFIER st_StorePRND.StoreDrvReq /end MEASUREMENT
/begin MEASUREMENT StoreDrvReq.tmr_StorePRND.f_IsExpired "test_timer" UBYTE SBW_STANDARD_S1_S3 1 100 0 255 ECU_ADDRESS 0xFFF89896 DISPLAY_IDENTIFIER f_IsExpired.tmr_StorePRND.StoreDrvReq /end MEASUREMENT
/begin MEASUREMENT StoreDrvReq.tmr_StorePRND.time "test_timer" UWORD SBW_TIMER_10MS_S1_S3 1 100 0 655350 ECU_ADDRESS 0xFFF89894 DISPLAY_IDENTIFIER time.tmr_StorePRND.StoreDrvReq /end MEASUREMENT
/begin MEASUREMENT TEMP_EM "" SWORD _CNV_R_R_Umr_1_zu_1_1_CM_S2 1 0 -50 220 ECU_ADDRESS 0xFFF8E6A6 FORMAT "%2.0" /end MEASUREMENT
/begin MEASUREMENT TEMP_EM_ROH "" UBYTE _CNV_R_R_Umr_1_zu_1_2_CM_S2 1 0 0 255 ECU_ADDRESS 0xFFF8E947 FORMAT "%2.0" /end MEASUREMENT
/begin MEASUREMENT TEMP_GETR "" SWORD _CNV_R_R_Umr_1_zu_1_1_CM_S2 1 0 -200 200 ECU_ADDRESS 0xFFF8E6E2 FORMAT "%2.0" /end MEASUREMENT
/begin MEASUREMENT TEMP_GETR_ROH "" UBYTE _CNV_R_R_Umr_1_zu_1_2_CM_S2 1 0 0 255 ECU_ADDRESS 0xFFF8E95C FORMAT "%2.0" /end MEASUREMENT
/begin MEASUREMENT TEMP_KUP_A "" SWORD _CNV_R_R_Umr_1_zu_1_1_CM_S2 1 0 -40 500 ECU_ADDRESS 0xFFF8E6E4 FORMAT "%2.0" /end MEASUREMENT
/begin MEASUREMENT TEMP_KUP_A_ROH "" SWORD _CNV_R_R_Umr_1_zu_1_2_CM_S2 1 0 -40 500 ECU_ADDRESS 0xFFF8E3AE FORMAT "%2.0" /end MEASUREMENT
/begin MEASUREMENT TEMP_KUP_B "" SWORD _CNV_R_R_Umr_1_zu_1_1_CM_S2 1 0 -40 500 ECU_ADDRESS 0xFFF8E6E6 FORMAT "%2.0" /end MEASUREMENT
/begin MEASUREMENT TEMP_KUP_B_ROH "" SWORD _CNV_R_R_Umr_1_zu_1_2_CM_S2 1 0 -40 500 ECU_ADDRESS 0xFFF8E3B0 FORMAT "%2.0" /end MEASUREMENT
/begin MEASUREMENT TEMP_KUP_C "" SWORD _CNV_R_R_Umr_1_zu_1_1_CM_S2 1 0 -40 500 ECU_ADDRESS 0xFFF8E6E8 FORMAT "%2.0" /end MEASUREMENT
/begin MEASUREMENT TEMP_KUP_C_ROH "" SWORD _CNV_R_R_Umr_1_zu_1_2_CM_S2 1 0 -40 500 ECU_ADDRESS 0xFFF8E3B2 FORMAT "%2.0" /end MEASUREMENT
/begin MEASUREMENT TEMP_KUP_D "" SWORD _CNV_R_R_Umr_1_zu_1_1_CM_S2 1 0 -40 500 ECU_ADDRESS 0xFFF8E6EA FORMAT "%2.0" /end MEASUREMENT
/begin MEASUREMENT TEMP_KUP_D_ROH "" SWORD _CNV_R_R_Umr_1_zu_1_2_CM_S2 1 0 -40 500 ECU_ADDRESS 0xFFF8E3B4 FORMAT "%2.0" /end MEASUREMENT
/begin MEASUREMENT TEMP_KUP_E "" SWORD _CNV_R_R_Umr_1_zu_1_1_CM_S2 1 0 -40 500 ECU_ADDRESS 0xFFF8E6EC FORMAT "%2.0" /end MEASUREMENT
/begin MEASUREMENT TEMP_KUP_E_ROH "" SWORD _CNV_R_R_Umr_1_zu_1_2_CM_S2 1 0 -40 500 ECU_ADDRESS 0xFFF8E3B6 FORMAT "%2.0" /end MEASUREMENT
/begin MEASUREMENT TEMP_MOT "" SWORD _CNV_R_R_Umr_1_zu_1_1_CM_S2 1 0 -200 200 ECU_ADDRESS 0xFFF8E6EE FORMAT "%2.0" /end MEASUREMENT
/begin MEASUREMENT TEMP_MOT_ROH "" UBYTE _CNV_R_R_Umr_1_zu_1_2_CM_S2 1 0 0 255 ECU_ADDRESS 0xFFF8E95D /end MEASUREMENT
/begin MEASUREMENT TEMP_UMG "" SWORD _CNV_R_R_Umr_1_zu_1_1_CM_S2 1 0 -50 220 ECU_ADDRESS 0xFFF8E6F0 FORMAT "%2.0" /end MEASUREMENT
/begin MEASUREMENT TEMP_UMG_ROH "" UBYTE _CNV_R_R_Umr_1_zu_1_2_CM_S2 1 0 0 255 ECU_ADDRESS 0xFFF8E95E /end MEASUREMENT
/begin MEASUREMENT T_ABREGLER_NXT_DECR "" ULONG _CNV_R_R_Umr_1_zu_1_6_CM_S2 1 0 0 4294967295 ECU_ADDRESS 0xFFF8F118 FORMAT "%2.0" /end MEASUREMENT
/begin MEASUREMENT T_ABS_EINMUELOW "" SLONG _CNV_R_R_Umr_1_zu_1_6_CM_S2 1 0 -2147483647 2147483647 ECU_ADDRESS 0xFFF8F14C FORMAT "%2.0" /end MEASUREMENT
/begin MEASUREMENT T_ANGLEICH_UMSCHALT_DYNDZM "" UWORD _CNV_R_R_Umr_1_zu_1_6_CM_S2 1 0 0 65535 ECU_ADDRESS 0xFFF8E4AA FORMAT "%2.0" /end MEASUREMENT
/begin MEASUREMENT T_AUSROLLRS_DBM "" SWORD _CNV_R_R_Umr_1_zu_1_6_CM_S2 1 0 0 12500 ECU_ADDRESS 0xFFF8670A FORMAT "%2.0" MATRIX_DIM 9 1 1 /end MEASUREMENT
/begin MEASUREMENT T_BAB_FGR "" SLONG _CNV_R_R_Umr_1_zu_1_6_CM_S2 1 0 -2147483647 2147483647 ECU_ADDRESS 0xFFF8F28C FORMAT "%2.0" /end MEASUREMENT
/begin MEASUREMENT T_BERGANH "" SLONG _CNV_R_R_Umr_1_zu_1_6_CM_S2 1 0 -2147483648 2147483647 ECU_ADDRESS 0xFFF8EE14 FORMAT "%2.0" /end MEASUREMENT
/begin MEASUREMENT T_BERG_PROGNACHL "" SLONG _CNV_R_R_Umr_1_zu_1_6_CM_S2 1 0 -50 100000 ECU_ADDRESS 0xFFF8EE18 FORMAT "%2.0" /end MEASUREMENT
/begin MEASUREMENT T_BESCHL_MODAFB "" SLONG _CNV_R_R_Umr_1_zu_1_6_CM_S2 1 0 -2147483648 2147483647 ECU_ADDRESS 0xFFF8F0F8 FORMAT "%2.0" /end MEASUREMENT
/begin MEASUREMENT T_BETRBEREINMODAFB "" SLONG _CNV_R_R_Umr_1_zu_1_6_CM_S2 1 0 -2147483648 2147483647 ECU_ADDRESS 0xFFF8F0FC FORMAT "%2.0" /end MEASUREMENT
/begin MEASUREMENT T_BGH_NACHLSTART "" ULONG _CNV_R_R_Umr_1_zu_1_6_CM_S2 1 0 0 4294967295 ECU_ADDRESS 0xFFF8EE1C FORMAT "%2.0" /end MEASUREMENT
/begin MEASUREMENT T_BGH_NACHLVERGANGEN "" ULONG _CNV_R_R_Umr_1_zu_1_6_CM_S2 1 0 0 4294967295 ECU_ADDRESS 0xFFF8EE20 FORMAT "%2.0" /end MEASUREMENT
/begin MEASUREMENT T_BPL "" SLONG _CNV_R_R_Umr_1_zu_1_6_CM_S2 1 0 -2147483647 2147483647 ECU_ADDRESS 0xFFF8F314 FORMAT "%2.0" /end MEASUREMENT
/begin MEASUREMENT T_BUFFER "" ULONG _CNV_R_R_Umr_1_zu_1_6_CM_S2 1 0 0 4294967295 ECU_ADDRESS 0xFFF8EFA4 FORMAT "%2.0" MATRIX_DIM 16 1 1 /end MEASUREMENT
/begin MEASUREMENT T_BUFFERSPEICHER_TIPP_MINUS "" ULONG _CNV_R_R_Umr_1_zu_1_2_CM_S2 1 0 0 4294967295 ECU_ADDRESS 0xFFF8EDDC FORMAT "%2.0" /end MEASUREMENT
/begin MEASUREMENT T_BUFFER_ABSEINMUELOW "" ULONG _CNV_R_R_Umr_1_zu_1_6_CM_S2 1 0 0 4294967295 ECU_ADDRESS 0xFFF8F150 FORMAT "%2.0" /end MEASUREMENT
/begin MEASUREMENT T_BUFFER_ARADABSFILT "" ULONG _CNV_R_R_Umr_1_zu_1_6_CM_S2 1 0 0 4294967295 ECU_ADDRESS 0xFFF8EF44 FORMAT "%2.0" /end MEASUREMENT
/begin MEASUREMENT T_BUFFER_BAB "" ULONG _CNV_R_R_Umr_1_zu_1_6_CM_S2 1 0 0 2147483647 ECU_ADDRESS 0xFFF8EE04 FORMAT "%2.0" /end MEASUREMENT
/begin MEASUREMENT T_BUFFER_BABFGR "" ULONG _CNV_R_R_Umr_1_zu_1_6_CM_S2 1 0 0 2147483647 ECU_ADDRESS 0xFFF8F290 FORMAT "%2.0" /end MEASUREMENT
/begin MEASUREMENT T_BUFFER_BERGANH "" ULONG _CNV_R_R_Umr_1_zu_1_6_CM_S2 1 0 0 2147483647 ECU_ADDRESS 0xFFF8EE24 FORMAT "%2.0" /end MEASUREMENT
/begin MEASUREMENT T_BUFFER_BESCHLMODAFB "" ULONG _CNV_R_R_Umr_1_zu_1_6_CM_S2 1 0 0 4294967295 ECU_ADDRESS 0xFFF8F100 FORMAT "%2.0" /end MEASUREMENT
/begin MEASUREMENT T_BUFFER_BETRBEREINMODAFB "" ULONG _CNV_R_R_Umr_1_zu_1_6_CM_S2 1 0 0 4294967295 ECU_ADDRESS 0xFFF8F104 FORMAT "%2.0" /end MEASUREMENT
/begin MEASUREMENT T_BUFFER_BPL "" ULONG _CNV_R_R_Umr_1_zu_1_6_CM_S2 1 0 0 4294967295 ECU_ADDRESS 0xFFF8F318 FORMAT "%2.0" /end MEASUREMENT
/begin MEASUREMENT T_BUFFER_BSCHLUPF "" ULONG _CNV_R_R_Umr_1_zu_1_6_CM_S2 1 0 0 4294967295 ECU_ADDRESS 0xFFF8F154 FORMAT "%2.0" /end MEASUREMENT
/begin MEASUREMENT T_BUFFER_DERS "" ULONG _CNV_R_R_Umr_1_zu_1_6_CM_S2 1 0 0 2147483647 ECU_ADDRESS 0xFFF8F2C8 FORMAT "%2.0" /end MEASUREMENT
/begin MEASUREMENT T_BUFFER_DERS_HS "" ULONG _CNV_R_R_Umr_1_zu_1_6_CM_S2 1 0 0 2147483647 ECU_ADDRESS 0xFFF8F2CC FORMAT "%2.0" /end MEASUREMENT
/begin MEASUREMENT T_BUFFER_DERS_WAIT "" ULONG _CNV_R_R_Umr_1_zu_1_6_CM_S2 1 0 0 2147483647 ECU_ADDRESS 0xFFF8F2D0 FORMAT "%2.0" /end MEASUREMENT
/begin MEASUREMENT T_BUFFER_DUEAUS "" ULONG _CNV_R_R_Umr_1_zu_1_6_CM_S2 1 0 0 4294967295 ECU_ADDRESS 0xFFF8F2D4 FORMAT "%2.0" /end MEASUREMENT
/begin MEASUREMENT T_BUFFER_DUEEIN "" ULONG _CNV_R_R_Umr_1_zu_1_6_CM_S2 1 0 0 4294967295 ECU_ADDRESS 0xFFF8F2D8 FORMAT "%2.0" /end MEASUREMENT
/begin MEASUREMENT T_BUFFER_DYNAMIKZYK "" ULONG _CNV_R_R_Umr_1_zu_1_6_CM_S2 1 0 0 2147483647 ECU_ADDRESS 0xFFF8EDA8 FORMAT "%2.0" /end MEASUREMENT
/begin MEASUREMENT T_BUFFER_EIN "" ULONG _CNV_R_R_Umr_1_zu_1_6_CM_S2 1 0 0 2147483647 ECU_ADDRESS 0xFFF8EE08 FORMAT "%2.0" /end MEASUREMENT
/begin MEASUREMENT T_BUFFER_KFINITMODAFB "" ULONG _CNV_R_R_Umr_1_zu_1_6_CM_S2 1 0 0 4294967295 ECU_ADDRESS 0xFFF8F108 FORMAT "%2.0" /end MEASUREMENT
/begin MEASUREMENT T_BUFFER_KFMODAFB "" ULONG _CNV_R_R_Umr_1_zu_1_6_CM_S2 1 0 0 4294967295 ECU_ADDRESS 0xFFF8F10C FORMAT "%2.0" /end MEASUREMENT
/begin MEASUREMENT T_BUFFER_KURVE "" ULONG _CNV_R_R_Umr_1_zu_1_6_CM_S2 1 0 0 4294967295 ECU_ADDRESS 0xFFF8F2AC FORMAT "%2.0" /end MEASUREMENT
/begin MEASUREMENT T_BUFFER_KURVELDMNACHL "" ULONG _CNV_R_R_Umr_1_zu_1_6_CM_S2 1 0 0 4294967295 ECU_ADDRESS 0xFFF8F098 FORMAT "%2.0" /end MEASUREMENT
/begin MEASUREMENT T_BUFFER_KURVENACHL "" ULONG _CNV_R_R_Umr_1_zu_1_6_CM_S2 1 0 0 4294967295 ECU_ADDRESS 0xFFF8F09C FORMAT "%2.0" /end MEASUREMENT
/begin MEASUREMENT T_BUFFER_LASTWE_DYNDZM_GWFP "" ULONG _CNV_R_R_Umr_1_zu_1_6_CM_S2 1 0 0 4294967295 ECU_ADDRESS 0xFFF8EE90 FORMAT "%2.0" /end MEASUREMENT
/begin MEASUREMENT T_BUFFER_LDMBAB_ENBL "" ULONG _CNV_R_R_Umr_1_zu_1_6_CM_S2 1 0 0 4294967295 ECU_ADDRESS 0xFFF8F0D8 FORMAT "%2.0" /end MEASUREMENT
/begin MEASUREMENT T_BUFFER_MAB "" ULONG _CNV_R_R_Umr_1_zu_1_6_CM_S2 1 0 0 4294967295 ECU_ADDRESS 0xFFF8F0F0 FORMAT "%2.0" /end MEASUREMENT
/begin MEASUREMENT T_BUFFER_MDSSCHUB "" ULONG _CNV_R_R_Umr_1_zu_1_6_CM_S2 1 0 0 4294967295 ECU_ADDRESS 0xFFF8F2F8 FORMAT "%2.0" /end MEASUREMENT
/begin MEASUREMENT T_BUFFER_MDSSCHUB_REGEN "" ULONG _CNV_R_R_Umr_1_zu_1_6_CM_S2 1 0 0 4294967295 ECU_ADDRESS 0xFFF8F2FC FORMAT "%2.0" /end MEASUREMENT
/begin MEASUREMENT T_BUFFER_MFRSZBAB "" ULONG _CNV_R_R_Umr_1_zu_1_6_CM_S2 1 0 0 2147483647 ECU_ADDRESS 0xFFF8F294 FORMAT "%2.0" /end MEASUREMENT
/begin MEASUREMENT T_BUFFER_MINLV "" ULONG _CNV_R_R_Umr_1_zu_1_6_CM_S2 1 0 0 4294967295 ECU_ADDRESS 0xFFF8F158 FORMAT "%2.0" /end MEASUREMENT
/begin MEASUREMENT T_BUFFER_MUELOWAUS "" ULONG _CNV_R_R_Umr_1_zu_1_6_CM_S2 1 0 0 2147483647 ECU_ADDRESS 0xFFF8F15C FORMAT "%2.0" /end MEASUREMENT
/begin MEASUREMENT T_BUFFER_NACHLAUF_EINLENK "" ULONG _CNV_R_R_Umr_1_zu_1_6_CM_S2 1 0 0 4294967295 ECU_ADDRESS 0xFFF8F0A0 FORMAT "%2.0" /end MEASUREMENT
/begin MEASUREMENT T_BUFFER_NACHLLDM_DYNAMIC2 "" ULONG _CNV_R_R_Umr_1_zu_1_6_CM_S2 1 0 0 2147483647 ECU_ADDRESS 0xFFF8F0DC FORMAT "%2.0" /end MEASUREMENT
/begin MEASUREMENT T_BUFFER_PADDLE_AUS "" ULONG _CNV_R_R_Umr_1_zu_1_6_CM_S2 1 0 0 4294967295 ECU_ADDRESS 0xFFF8F1C0 FORMAT "%2.0" /end MEASUREMENT
/begin MEASUREMENT T_BUFFER_QSHIFTMFRS_ACTIVE "" ULONG _CNV_R_R_Umr_1_zu_1_6_CM_S2 1 0 0 2147483647 ECU_ADDRESS 0xFFF8F18C FORMAT "%2.0" /end MEASUREMENT
/begin MEASUREMENT T_BUFFER_QSHIFTMFRS_WAIT "" ULONG _CNV_R_R_Umr_1_zu_1_6_CM_S2 1 0 0 2147483647 ECU_ADDRESS 0xFFF8F190 FORMAT "%2.0" /end MEASUREMENT
/begin MEASUREMENT T_BUFFER_RSU_DSCERR "" ULONG _CNV_R_R_Umr_1_zu_1_6_CM_S2 1 0 0 2147483647 ECU_ADDRESS 0xFFF8ED98 FORMAT "%2.0" /end MEASUREMENT
/begin MEASUREMENT T_BUFFER_SCHLEPP "" ULONG _CNV_R_R_Umr_1_zu_1_6_CM_S2 1 0 0 4294967295 ECU_ADDRESS 0xFFF8F2B4 FORMAT "%2.0" /end MEASUREMENT
/begin MEASUREMENT T_BUFFER_SERP "" ULONG _CNV_R_R_Umr_1_zu_1_6_CM_S2 1 0 0 4294967295 ECU_ADDRESS 0xFFF8F0A4 FORMAT "%2.0" /end MEASUREMENT
/begin MEASUREMENT T_BUFFER_SG "" ULONG _CNV_R_R_Umr_1_zu_1_6_CM_S2 1 0 0 4294967295 ECU_ADDRESS 0xFFF8F1B8 FORMAT "%2.0" /end MEASUREMENT
/begin MEASUREMENT T_BUFFER_SGG "" ULONG _CNV_R_R_Umr_1_zu_1_6_CM_S2 1 0 0 4294967295 ECU_ADDRESS 0xFFF8EDB0 FORMAT "%2.0" MATRIX_DIM 10 1 1 /end MEASUREMENT
/begin MEASUREMENT T_BUFFER_SPERRRSZBAB "" ULONG _CNV_R_R_Umr_1_zu_1_6_CM_S2 1 0 0 2147483647 ECU_ADDRESS 0xFFF8F298 FORMAT "%2.0" /end MEASUREMENT
/begin MEASUREMENT T_BUFFER_SPERR_FWSVALID_MSASTART "" ULONG _CNV_R_R_Umr_1_zu_1_6_CM_S2 1 0 0 4294967295 ECU_ADDRESS 0xFFF8EEBC FORMAT "%2.0" /end MEASUREMENT
/begin MEASUREMENT T_BUFFER_STARTLM "" ULONG _CNV_R_R_Umr_1_zu_1_6_CM_S2 1 0 0 4294967295 ECU_ADDRESS 0xFFF8F0E8 FORMAT "%2.0" /end MEASUREMENT
/begin MEASUREMENT T_BUFFER_STEIGUNG_FILT "" ULONG _CNV_R_R_Umr_1_zu_1_6_CM_S2 1 0 0 4294967295 ECU_ADDRESS 0xFFF8F1B0 FORMAT "%2.0" /end MEASUREMENT
/begin MEASUREMENT T_BUFFER_TID_AUSSTIEG "" ULONG _CNV_R_R_Umr_1_zu_1_6_CM_S2 1 0 0 4294967295 ECU_ADDRESS 0xFFF8F308 FORMAT "%2.0" /end MEASUREMENT
/begin MEASUREMENT T_BUFFER_VALIDFWS_BREMS "" ULONG _CNV_R_R_Umr_1_zu_1_6_CM_S2 1 0 0 4294967295 ECU_ADDRESS 0xFFF8EEC4 FORMAT "%2.0" /end MEASUREMENT
/begin MEASUREMENT T_BUFFER_VALIDFWS_BREMS_FLANKE "" ULONG _CNV_R_R_Umr_1_zu_1_6_CM_S2 1 0 0 4294967295 ECU_ADDRESS 0xFFF8EEC8 FORMAT "%2.0" /end MEASUREMENT
/begin MEASUREMENT T_BUFFER_VALIDFWS_GWFP "" ULONG _CNV_R_R_Umr_1_zu_1_6_CM_S2 1 0 0 4294967295 ECU_ADDRESS 0xFFF8EECC FORMAT "%2.0" /end MEASUREMENT
/begin MEASUREMENT T_BUFFER_VERBOTSCHLEPP "" ULONG _CNV_R_R_Umr_1_zu_1_6_CM_S2 1 0 0 4294967295 ECU_ADDRESS 0xFFF8F2B8 FORMAT "%2.0" /end MEASUREMENT
/begin MEASUREMENT T_BUFFER_VORWAHL_MINUS "" ULONG _CNV_R_R_Umr_1_zu_1_6_CM_S2 1 0 0 4294967295 ECU_ADDRESS 0xFFF8EDE0 FORMAT "%2.0" /end MEASUREMENT
/begin MEASUREMENT T_BUFFER_VORWAHL_PLUS "" ULONG _CNV_R_R_Umr_1_zu_1_6_CM_S2 1 0 0 4294967295 ECU_ADDRESS 0xFFF8EDE4 FORMAT "%2.0" /end MEASUREMENT
/begin MEASUREMENT T_BUFFER_VRSZBAB "" ULONG _CNV_R_R_Umr_1_zu_1_6_CM_S2 1 0 0 2147483647 ECU_ADDRESS 0xFFF8F29C FORMAT "%2.0" /end MEASUREMENT
/begin MEASUREMENT T_BUFFER_WL "" ULONG _CNV_R_R_Umr_1_zu_1_6_CM_S2 1 0 0 4294967295 ECU_ADDRESS 0xFFF8F1D8 FORMAT "%2.0" /end MEASUREMENT
/begin MEASUREMENT T_BUFFER_WL2 "" ULONG _CNV_R_R_Umr_1_zu_1_6_CM_S2 1 0 0 4294967295 ECU_ADDRESS 0xFFF8F1C8 FORMAT "%2.0" /end MEASUREMENT
/begin MEASUREMENT T_BUFFER_WLPRED "" ULONG _CNV_R_R_Umr_1_zu_1_6_CM_S2 1 0 0 4294967295 ECU_ADDRESS 0xFFF8F1CC FORMAT "%2.0" /end MEASUREMENT
/begin MEASUREMENT T_BUFF_GWFP_SPA "" ULONG _CNV_R_R_Umr_1_zu_1_6_CM_S2 1 0 0 4294967295 ECU_ADDRESS 0xFFF8F19C FORMAT "%2.0" /end MEASUREMENT
/begin MEASUREMENT T_BUFF_HSRS_SPA "" ULONG _CNV_R_R_Umr_1_zu_1_6_CM_S2 1 0 0 4294967295 ECU_ADDRESS 0xFFF8F1A0 FORMAT "%2.0" /end MEASUREMENT
/begin MEASUREMENT T_BUFF_SPERR_SPA "" ULONG _CNV_R_R_Umr_1_zu_1_6_CM_S2 1 0 0 4294967295 ECU_ADDRESS 0xFFF8F1A4 FORMAT "%2.0" /end MEASUREMENT
/begin MEASUREMENT T_BUFF_TIPP_SPA "" ULONG _CNV_R_R_Umr_1_zu_1_6_CM_S2 1 0 0 4294967295 ECU_ADDRESS 0xFFF8F1A8 FORMAT "%2.0" /end MEASUREMENT
/begin MEASUREMENT T_BUF_HSURESCHLUPF_AUS "" ULONG _CNV_R_R_Umr_1_zu_1_6_CM_S2 1 0 0 4294967295 ECU_ADDRESS 0xFFF8F05C FORMAT "%2.0" /end MEASUREMENT
/begin MEASUREMENT T_BUF_MUELOWAUSLAST "" ULONG _CNV_R_R_Umr_1_zu_1_6_CM_S2 1 0 0 4294967295 ECU_ADDRESS 0xFFF8F160 FORMAT "%2.0" /end MEASUREMENT
/begin MEASUREMENT T_BUF_RSSEQ "" ULONG _CNV_R_R_Umr_1_zu_1_6_CM_S2 1 0 0 4294967295 ECU_ADDRESS 0xFFF8F11C FORMAT "%2.0" /end MEASUREMENT
/begin MEASUREMENT T_BUF_WAITRS "" ULONG _CNV_R_R_Umr_1_zu_1_6_CM_S2 1 0 0 4294967295 ECU_ADDRESS 0xFFF8F120 FORMAT "%2.0" /end MEASUREMENT
/begin MEASUREMENT T_DDRS "" UWORD _CNV_R_R_Umr_1_zu_1_6_CM_S2 1 0 0 65535 ECU_ADDRESS 0xFFF8E88A FORMAT "%2.0" /end MEASUREMENT
/begin MEASUREMENT T_DERS "" UWORD _CNV_R_R_Umr_1_zu_1_6_CM_S2 1 0 0 65535 ECU_ADDRESS 0xFFF8E890 FORMAT "%2.0" /end MEASUREMENT
/begin MEASUREMENT T_DERS_HS "" UWORD _CNV_R_R_Umr_1_zu_1_6_CM_S2 1 0 0 65535 ECU_ADDRESS 0xFFF8E892 FORMAT "%2.0" /end MEASUREMENT
/begin MEASUREMENT T_DERS_WAIT "" UWORD _CNV_R_R_Umr_1_zu_1_6_CM_S2 1 0 0 65535 ECU_ADDRESS 0xFFF8E894 FORMAT "%2.0" /end MEASUREMENT
/begin MEASUREMENT T_DMRADKOMP_ALT "" ULONG _CNV_R_R_Umr_1_zu_1_6_CM_S2 1 0 0 4294967295 ECU_ADDRESS 0xFFF8F068 FORMAT "%2.0" /end MEASUREMENT
/begin MEASUREMENT T_DMRS "" ULONG _CNV_R_R_Umr_1_zu_1_6_CM_S2 1 0 0 2147483647 ECU_ADDRESS 0xFFF8EE5C FORMAT "%2.0" /end MEASUREMENT
/begin MEASUREMENT T_DSC_EINMUELOW "" SLONG _CNV_R_R_Umr_1_zu_1_6_CM_S2 1 0 -2147483647 2147483647 ECU_ADDRESS 0xFFF8F164 FORMAT "%2.0" /end MEASUREMENT
/begin MEASUREMENT T_DSC_EINMUELOWBUF "" ULONG _CNV_R_R_Umr_1_zu_1_6_CM_S2 1 0 0 4294967295 ECU_ADDRESS 0xFFF8F168 FORMAT "%2.0" /end MEASUREMENT
/begin MEASUREMENT T_DUE_AUS "" SLONG _CNV_R_R_Umr_1_zu_1_6_CM_S2 1 0 -2147483647 2147483647 ECU_ADDRESS 0xFFF8F2DC FORMAT "%2.0" /end MEASUREMENT
/begin MEASUREMENT T_DUE_EIN "" SLONG _CNV_R_R_Umr_1_zu_1_6_CM_S2 1 0 -2147483647 2147483647 ECU_ADDRESS 0xFFF8F2E0 FORMAT "%2.0" /end MEASUREMENT
/begin MEASUREMENT T_DYNAMIKZYK "" SLONG _CNV_R_R_Umr_1_zu_1_6_CM_S2 1 0 -2147483647 2147483647 ECU_ADDRESS 0xFFF8EDAC FORMAT "%2.0" /end MEASUREMENT
/begin MEASUREMENT T_DYNDZM_PHASE6_AUS "" SWORD _CNV_R_R_Umr_1_zu_1_6_CM_S2 1 0 0 1000 ECU_ADDRESS 0xFFF8E89A FORMAT "%2.0" /end MEASUREMENT
/begin MEASUREMENT T_DYNDZM_PHASE6_EIN "" SWORD _CNV_R_R_Umr_1_zu_1_6_CM_S2 1 0 0 1000 ECU_ADDRESS 0xFFF8E89C FORMAT "%2.0" /end MEASUREMENT
/begin MEASUREMENT T_EIN_BAB "" SLONG _CNV_R_R_Umr_1_zu_1_6_CM_S2 1 0 -2147483648 2147483647 ECU_ADDRESS 0xFFF8EE0C FORMAT "%2.0" /end MEASUREMENT
/begin MEASUREMENT T_GANG_ZIEL_STPTRsport "" ULONG _CNV_R_R_Umr_1_zu_1_6_CM_S2 1 0 0 2147483647 ECU_ADDRESS 0xFFF8EDE8 FORMAT "%2.0" /end MEASUREMENT
/begin MEASUREMENT T_GM_LDM_SOLLALT "" ULONG _CNV_R_R_Umr_1_zu_1_6_CM_S2 1 0 0 4294967295 ECU_ADDRESS 0xFFF8F0E0 FORMAT "%2.0" /end MEASUREMENT
/begin MEASUREMENT T_GN_MTALT "" ULONG _CNV_R_R_Umr_1_zu_1_6_CM_S2 1 0 0 4294967295 ECU_ADDRESS 0xFFF8F184 FORMAT "%2.0" /end MEASUREMENT
/begin MEASUREMENT T_GN_TRADALT "" ULONG _CNV_R_R_Umr_1_zu_1_6_CM_S2 1 0 0 4294967295 ECU_ADDRESS 0xFFF8F188 FORMAT "%2.0" /end MEASUREMENT
/begin MEASUREMENT T_GRADIENT_PHASE4_DYNDZM "" ULONG _CNV_R_R_Umr_1_zu_1_6_CM_S2 1 0 0 127 ECU_ADDRESS 0xFFF8EE94 FORMAT "%2.0" /end MEASUREMENT
/begin MEASUREMENT T_GRAD_REST_DYNDZM "" ULONG _CNV_R_R_Umr_1_zu_1_6_CM_S2 1 0 0 4294967295 ECU_ADDRESS 0xFFF8F2E8 FORMAT "%2.0" /end MEASUREMENT
/begin MEASUREMENT T_GWFP_SPA "" UWORD _CNV_R_R_Umr_1_zu_1_6_CM_S2 1 0 0 65535 ECU_ADDRESS 0xFFF8E7C8 FORMAT "%2.0" /end MEASUREMENT
/begin MEASUREMENT T_HALT_KURVELDMNACHL "" ULONG _CNV_R_R_Umr_1_zu_1_6_CM_S2 1 0 0 2147483647 ECU_ADDRESS 0xFFF8F0A8 FORMAT "%2.0" /end MEASUREMENT
/begin MEASUREMENT T_HALT_KURVELDMNACHLSUM "" ULONG _CNV_R_R_Umr_1_zu_1_6_CM_S2 1 0 0 2147483647 ECU_ADDRESS 0xFFF8F0AC FORMAT "%2.0" /end MEASUREMENT
/begin MEASUREMENT T_HALT_KURVENACHL "" ULONG _CNV_R_R_Umr_1_zu_1_6_CM_S2 1 0 0 2147483647 ECU_ADDRESS 0xFFF8F0B0 FORMAT "%2.0" /end MEASUREMENT
/begin MEASUREMENT T_HALT_KURVENACHLSUM "" ULONG _CNV_R_R_Umr_1_zu_1_6_CM_S2 1 0 0 2147483647 ECU_ADDRESS 0xFFF8F0B4 FORMAT "%2.0" /end MEASUREMENT
/begin MEASUREMENT T_HALT_LDMSTART "" ULONG _CNV_R_R_Umr_1_zu_1_6_CM_S2 1 0 0 2147483647 ECU_ADDRESS 0xFFF8F0B8 FORMAT "%2.0" /end MEASUREMENT
/begin MEASUREMENT T_HALT_START "" ULONG _CNV_R_R_Umr_1_zu_1_6_CM_S2 1 0 0 2147483647 ECU_ADDRESS 0xFFF8F0BC FORMAT "%2.0" /end MEASUREMENT
/begin MEASUREMENT T_HSRS_SPA "" UWORD _CNV_R_R_Umr_1_zu_1_6_CM_S2 1 0 0 65535 ECU_ADDRESS 0xFFF8E7CA FORMAT "%2.0" /end MEASUREMENT
/begin MEASUREMENT T_HSURE_DECPERIOD "" ULONG _CNV_R_R_Umr_1_zu_1_6_CM_S2 1 0 0 4294967295 ECU_ADDRESS 0xFFF8F018 FORMAT "%2.0" /end MEASUREMENT
/begin MEASUREMENT T_HSURE_MSCTR "" ULONG _CNV_R_R_Umr_1_zu_1_6_CM_S2 1 0 0 4294967295 ECU_ADDRESS 0xFFF8F01C FORMAT "%2.0" /end MEASUREMENT
/begin MEASUREMENT T_HSURE_NEXTDECREMENTTIME "" ULONG _CNV_R_R_Umr_1_zu_1_6_CM_S2 1 0 0 4294967295 ECU_ADDRESS 0xFFF8F020 FORMAT "%2.0" MATRIX_DIM 13 1 1 /end MEASUREMENT
/begin MEASUREMENT T_HSURE_NEXTDECREMENTTIME_KS "" ULONG _CNV_R_R_Umr_1_zu_1_6_CM_S2 1 0 0 4294967295 ECU_ADDRESS 0xFFF8F054 FORMAT "%2.0" /end MEASUREMENT
/begin MEASUREMENT T_HSURE_SCHLUPF_AUS "" SLONG _CNV_R_R_Umr_1_zu_1_6_CM_S2 1 0 -2147483648 2147483647 ECU_ADDRESS 0xFFF8F060 FORMAT "%2.0" /end MEASUREMENT
/begin MEASUREMENT T_HSZEIT "" UWORD _CNV_R_R_Umr_1_zu_1_6_CM_S2 1 0 0 5000 ECU_ADDRESS 0xFFF8E6F2 FORMAT "%2.0" /end MEASUREMENT
/begin MEASUREMENT T_HSZEIT_ROH "" UWORD _CNV_R_R_Umr_1_zu_1_6_CM_S2 1 0 0 5000 ECU_ADDRESS 0xFFF8E3B8 FORMAT "%2.0" /end MEASUREMENT
/begin MEASUREMENT T_HS_ZEITKOR "" UWORD _CNV_R_R_Umr_1_zu_1_6_CM_S2 1 0 0 65535 ECU_ADDRESS 0xFFF8E762 FORMAT "%2.0" /end MEASUREMENT
/begin MEASUREMENT T_INIT_DONE "" UWORD _CNV_P_2_A_I_32_CM_S2 1 0 0 65535 ECU_ADDRESS 0xFFF8E724 /end MEASUREMENT
/begin MEASUREMENT T_KFINIT_MODAFB "" SLONG _CNV_R_R_Umr_1_zu_1_6_CM_S2 1 0 -2147483648 2147483647 ECU_ADDRESS 0xFFF8F110 FORMAT "%2.0" /end MEASUREMENT
/begin MEASUREMENT T_KF_MODAFB "" SLONG _CNV_R_R_Umr_1_zu_1_6_CM_S2 1 0 -2147483648 2147483647 ECU_ADDRESS 0xFFF8F114 FORMAT "%2.0" /end MEASUREMENT
/begin MEASUREMENT T_KURVE_BEW "" SLONG _CNV_R_R_Umr_1_zu_1_6_CM_S2 1 0 -2147483647 2147483647 ECU_ADDRESS 0xFFF8F2B0 FORMAT "%2.0" /end MEASUREMENT
/begin MEASUREMENT T_KURVE_LDMNACHL "" SLONG _CNV_R_R_Umr_1_zu_1_6_CM_S2 1 0 -2147483647 2147483647 ECU_ADDRESS 0xFFF8F0C0 FORMAT "%2.0" /end MEASUREMENT
/begin MEASUREMENT T_KURVE_NACHL "" SLONG _CNV_R_R_Umr_1_zu_1_6_CM_S2 1 0 -2147483647 2147483647 ECU_ADDRESS 0xFFF8F0C4 FORMAT "%2.0" /end MEASUREMENT
/begin MEASUREMENT T_LASTWE_DYNDZM_GWFP "" ULONG _CNV_R_R_Umr_1_zu_1_6_CM_S2 1 0 0 4294967295 ECU_ADDRESS 0xFFF8EE98 FORMAT "%2.0" /end MEASUREMENT
/begin MEASUREMENT T_LAYERIN_MSCTR "" ULONG _CNV_R_R_Umr_1_zu_1_6_CM_S2 1 0 0 4294967295 ECU_ADDRESS 0xFFF8F0D0 FORMAT "%2.0" /end MEASUREMENT
/begin MEASUREMENT T_LAYERIN_MSCTR_ALT "" ULONG _CNV_R_R_Umr_1_zu_1_6_CM_S2 1 0 0 4294967295 ECU_ADDRESS 0xFFF8EDD8 FORMAT "%2.0" /end MEASUREMENT
/begin MEASUREMENT T_LDMBAB_ENBL "" UWORD _CNV_R_R_Umr_1_zu_1_6_CM_S2 1 0 0 65535 ECU_ADDRESS 0xFFF8E714 FORMAT "%2.0" /end MEASUREMENT
/begin MEASUREMENT T_MAB "" SLONG _CNV_R_R_Umr_1_zu_1_6_CM_S2 1 0 -2147483647 2147483647 ECU_ADDRESS 0xFFF8F0F4 FORMAT "%2.0" /end MEASUREMENT
/begin MEASUREMENT T_MDSSCHUB "" SLONG _CNV_R_R_Umr_1_zu_1_6_CM_S2 1 0 -2147483648 2147483647 ECU_ADDRESS 0xFFF8F300 FORMAT "%2.0" /end MEASUREMENT
/begin MEASUREMENT T_MDSSCHUB_REGEN "" SLONG _CNV_R_R_Umr_1_zu_1_6_CM_S2 1 0 -2147483648 2147483647 ECU_ADDRESS 0xFFF8F304 FORMAT "%2.0" /end MEASUREMENT
/begin MEASUREMENT T_MFRSZ_BAB "" SLONG _CNV_R_R_Umr_1_zu_1_6_CM_S2 1 0 -2147483647 2147483647 ECU_ADDRESS 0xFFF8F2A0 FORMAT "%2.0" /end MEASUREMENT
/begin MEASUREMENT T_MFRS_ZKA "" ULONG _CNV_R_R_Umr_1_zu_1_6_CM_S2 1 0 0 4294967295 ECU_ADDRESS 0xFFF8F260 FORMAT "%2.0" /end MEASUREMENT
/begin MEASUREMENT T_MSCTR_ALT_ZKA "" ULONG _CNV_R_R_Umr_1_zu_1_6_CM_S2 1 0 0 4294967295 ECU_ADDRESS 0xFFF8F264 FORMAT "%2.0" /end MEASUREMENT
/begin MEASUREMENT T_MSCTR_DIFF_ZKA "" ULONG _CNV_R_R_Umr_1_zu_1_6_CM_S2 1 0 0 4294967295 ECU_ADDRESS 0xFFF8F268 FORMAT "%2.0" /end MEASUREMENT
/begin MEASUREMENT T_MSCTR_DYNDZM_ALT "" ULONG _CNV_R_R_Umr_1_zu_1_6_CM_S2 1 0 0 4294967295 ECU_ADDRESS 0xFFF8EE9C FORMAT "%2.0" /end MEASUREMENT
/begin MEASUREMENT T_MSCTR_ZKA "" ULONG _CNV_R_R_Umr_1_zu_1_6_CM_S2 1 0 0 4294967295 ECU_ADDRESS 0xFFF8F26C FORMAT "%2.0" /end MEASUREMENT
/begin MEASUREMENT T_MUELOWAUS_LAST "" SLONG _CNV_R_R_Umr_1_zu_1_6_CM_S2 1 0 -2147483647 2147483647 ECU_ADDRESS 0xFFF8F16C FORMAT "%2.0" /end MEASUREMENT
/begin MEASUREMENT T_MUELOW_AUS "" SLONG _CNV_R_R_Umr_1_zu_1_6_CM_S2 1 0 -2147483647 2147483647 ECU_ADDRESS 0xFFF8F170 FORMAT "%2.0" /end MEASUREMENT
/begin MEASUREMENT T_MUE_UEBER "" SLONG _CNV_R_R_Umr_1_zu_1_6_CM_S2 1 0 -2147483647 2147483647 ECU_ADDRESS 0xFFF8EED0 FORMAT "%2.0" /end MEASUREMENT
/begin MEASUREMENT T_MUE_UEBERBUF "" ULONG _CNV_R_R_Umr_1_zu_1_6_CM_S2 1 0 0 2147483647 ECU_ADDRESS 0xFFF8EED4 FORMAT "%2.0" /end MEASUREMENT
/begin MEASUREMENT T_NACHLAUF_EINLENK "" SLONG _CNV_R_R_Umr_1_zu_1_6_CM_S2 1 0 -2147483648 2147483647 ECU_ADDRESS 0xFFF8F0C8 FORMAT "%2.0" /end MEASUREMENT
/begin MEASUREMENT T_NACHLAUF_QS3 "" ULONG _CNV_R_R_Umr_1000_z_12_CM_S2 1 0 0 1024 ECU_ADDRESS 0xFFF8EDA4 FORMAT "%2.0" /end MEASUREMENT
/begin MEASUREMENT T_NACHL_BAB "" SLONG _CNV_R_R_Umr_1_zu_1_6_CM_S2 1 0 -2147483647 2147483647 ECU_ADDRESS 0xFFF8EE10 FORMAT "%2.0" /end MEASUREMENT
/begin MEASUREMENT T_NACHL_LDM_DYNAMIC2 "" ULONG _CNV_R_R_Umr_1_zu_1_6_CM_S2 1 0 0 2147483647 ECU_ADDRESS 0xFFF8F0E4 FORMAT "%2.0" /end MEASUREMENT
/begin MEASUREMENT T_OVERRIDE_GANG "" SWORD _CNV_R_R_Umr_1_zu_1_6_CM_S2 1 0 0 3000 ECU_ADDRESS 0xFFF8E708 FORMAT "%2.0" /end MEASUREMENT
/begin MEASUREMENT T_PADDLE_AUS "" ULONG _CNV_R_R_Umr_1_zu_1_6_CM_S2 1 0 0 4294967281 ECU_ADDRESS 0xFFF8F1C4 FORMAT "%2.0" /end MEASUREMENT
/begin MEASUREMENT T_PRUEF1_VALIDFWS "" UWORD _CNV_R_R_Umr_1_zu_1_6_CM_S2 1 0 0 65535 ECU_ADDRESS 0xFFF8E526 FORMAT "%2.0" /end MEASUREMENT
/begin MEASUREMENT T_PRUEF2_VALIDFWS "" SWORD _CNV_R_R_Umr_1_zu_1_6_CM_S2 1 0 -32768 32767 ECU_ADDRESS 0xFFF8E528 FORMAT "%2.0" /end MEASUREMENT
/begin MEASUREMENT T_QSHIFTMFRS_ACTIVE "" SLONG _CNV_R_R_Umr_1_zu_1_6_CM_S2 1 0 -2147483647 2147483647 ECU_ADDRESS 0xFFF8F194 FORMAT "%2.0" /end MEASUREMENT
/begin MEASUREMENT T_QSHIFTMFRS_WAIT "" SLONG _CNV_R_R_Umr_1_zu_1_6_CM_S2 1 0 -2147483647 2147483647 ECU_ADDRESS 0xFFF8F198 FORMAT "%2.0" /end MEASUREMENT
/begin MEASUREMENT T_RAD_FZGBUFFER "" ULONG _CNV_R_R_Umr_1_zu_1_6_CM_S2 1 0 0 4294967295 ECU_ADDRESS 0xFFF8EF48 FORMAT "%2.0" MATRIX_DIM 2 1 1 /end MEASUREMENT
/begin MEASUREMENT T_REG_ASCNACHL "" SLONG _CNV_R_R_Umr_1_zu_1_6_CM_S2 1 0 -2147483647 2147483647 ECU_ADDRESS 0xFFF8EDF4 FORMAT "%2.0" /end MEASUREMENT
/begin MEASUREMENT T_REG_ASCNACHLBUF "" ULONG _CNV_R_R_Umr_1_zu_1_6_CM_S2 1 0 0 4294967295 ECU_ADDRESS 0xFFF8EDF8 FORMAT "%2.0" /end MEASUREMENT
/begin MEASUREMENT T_RSU_DSCERR "" SLONG _CNV_R_R_Umr_1_zu_1_6_CM_S2 1 0 -2147483647 2147483647 ECU_ADDRESS 0xFFF8ED9C FORMAT "%2.0" /end MEASUREMENT
/begin MEASUREMENT T_RS_SEQ "" SLONG _CNV_R_R_Umr_1_zu_1_6_CM_S2 1 0 -2147483647 2147483647 ECU_ADDRESS 0xFFF8F124 FORMAT "%2.0" /end MEASUREMENT
/begin MEASUREMENT T_RUNTIME_AGS "" UWORD _CNV_R_R_Umr_100_zu_88_CM_S2 1 0 0 655.35 ECU_ADDRESS 0xFFF8E1FA FORMAT "%4.2" /end MEASUREMENT
/begin MEASUREMENT T_RUNTIME_AUTOMAT "" UWORD _CNV_R_R_Umr_1_zu_1_111_CM_S2 1 0 0 65535 ECU_ADDRESS 0xFFF8E1FC FORMAT "%2.0" /end MEASUREMENT
/begin MEASUREMENT T_RUNTIME_BMWCRUISE10_1 "" UWORD _CNV_R_R_Umr_1_zu_1_111_CM_S2 1 0 0 65535 ECU_ADDRESS 0xFFF8E1FE FORMAT "%2.0" /end MEASUREMENT
/begin MEASUREMENT T_RUNTIME_BMWCRUISE10_2 "" UWORD _CNV_R_R_Umr_1_zu_1_111_CM_S2 1 0 0 65535 ECU_ADDRESS 0xFFF8E200 FORMAT "%2.0" /end MEASUREMENT
/begin MEASUREMENT T_RUNTIME_DBM "" UWORD _CNV_R_R_Umr_1_zu_1_111_CM_S2 1 0 0 65535 ECU_ADDRESS 0xFFF8E202 FORMAT "%2.0" /end MEASUREMENT
/begin MEASUREMENT T_RUNTIME_DMRS "" UWORD _CNV_R_R_Umr_1_zu_1_111_CM_S2 1 0 0 65535 ECU_ADDRESS 0xFFF8E426 FORMAT "%2.0" /end MEASUREMENT
/begin MEASUREMENT T_RUNTIME_DYNAMIK "" UWORD _CNV_R_R_Umr_1_zu_1_111_CM_S2 1 0 0 65535 ECU_ADDRESS 0xFFF8E204 FORMAT "%2.0" /end MEASUREMENT
/begin MEASUREMENT T_RUNTIME_ERKKOOP "" UWORD _CNV_R_R_Umr_1_zu_1_111_CM_S2 1 0 0 65535 ECU_ADDRESS 0xFFF8E206 FORMAT "%2.0" /end MEASUREMENT
/begin MEASUREMENT T_RUNTIME_ERKPRISQPRIO "" UWORD _CNV_R_R_Umr_1_zu_1_111_CM_S2 1 0 0 65535 ECU_ADDRESS 0xFFF8E208 FORMAT "%2.0" /end MEASUREMENT
/begin MEASUREMENT T_RUNTIME_FAHRERASSISTENT "" UWORD _CNV_R_R_Umr_1_zu_1_111_CM_S2 1 0 0 65535 ECU_ADDRESS 0xFFF8E20A FORMAT "%2.0" /end MEASUREMENT
/begin MEASUREMENT T_RUNTIME_FFG "" UWORD _CNV_R_R_Umr_1_zu_1_111_CM_S2 1 0 0 65535 ECU_ADDRESS 0xFFF8E20C FORMAT "%2.0" /end MEASUREMENT
/begin MEASUREMENT T_RUNTIME_GFBMW30MS "" UWORD _CNV_R_R_Umr_1_zu_1_111_CM_S2 1 0 0 65535 ECU_ADDRESS 0xFFF8E20E FORMAT "%2.0" /end MEASUREMENT
/begin MEASUREMENT T_RUNTIME_HSURE "" UWORD _CNV_R_R_Umr_1_zu_1_111_CM_S2 1 0 0 65535 ECU_ADDRESS 0xFFF8E638 FORMAT "%2.0" /end MEASUREMENT
/begin MEASUREMENT T_RUNTIME_K0 "" UWORD _CNV_R_R_Umr_1_zu_1_111_CM_S2 1 0 0 65535 ECU_ADDRESS 0xFFF8E210 FORMAT "%2.0" /end MEASUREMENT
/begin MEASUREMENT T_RUNTIME_KOMBIANZEIGE "" UWORD _CNV_R_R_Umr_1_zu_1_111_CM_S2 1 0 0 65535 ECU_ADDRESS 0xFFF8E212 FORMAT "%2.0" /end MEASUREMENT
/begin MEASUREMENT T_RUNTIME_KOORDSLOW "" UWORD _CNV_R_R_Umr_1_zu_1_111_CM_S2 1 0 0 65535 ECU_ADDRESS 0xFFF8E214 FORMAT "%2.0" /end MEASUREMENT
/begin MEASUREMENT T_RUNTIME_KRAFTSCHLUSS "" UWORD _CNV_R_R_Umr_1_zu_1_111_CM_S2 1 0 0 65535 ECU_ADDRESS 0xFFF8E216 FORMAT "%2.0" /end MEASUREMENT
/begin MEASUREMENT T_RUNTIME_LAYEROUTPUT "" UWORD _CNV_R_R_Umr_1_zu_1_111_CM_S2 1 0 0 65535 ECU_ADDRESS 0xFFF8E218 FORMAT "%2.0" /end MEASUREMENT
/begin MEASUREMENT T_RUNTIME_MSA "" UWORD _CNV_R_R_Umr_1_zu_1_111_CM_S2 1 0 0 65535 ECU_ADDRESS 0xFFF8E21A FORMAT "%2.0" /end MEASUREMENT
/begin MEASUREMENT T_RUNTIME_SIGNALPOOL "" UWORD _CNV_R_R_Umr_1_zu_1_111_CM_S2 1 0 0 65535 ECU_ADDRESS 0xFFF8E21C FORMAT "%2.0" /end MEASUREMENT
/begin MEASUREMENT T_RUNTIME_STEPTRONIC "" UWORD _CNV_R_R_Umr_1_zu_1_111_CM_S2 1 0 0 65535 ECU_ADDRESS 0xFFF8E21E FORMAT "%2.0" /end MEASUREMENT
/begin MEASUREMENT T_RUNTIME_ZKA "" UWORD _CNV_R_R_Umr_1_zu_1_111_CM_S2 1 0 0 65535 ECU_ADDRESS 0xFFF8E220 FORMAT "%2.0" /end MEASUREMENT
/begin MEASUREMENT T_SCHLEPP "" SLONG _CNV_R_R_Umr_1_zu_1_6_CM_S2 1 0 -2147483647 2147483647 ECU_ADDRESS 0xFFF8F2BC FORMAT "%2.0" /end MEASUREMENT
/begin MEASUREMENT T_SCHLUPF_NACHL "" SLONG _CNV_R_R_Umr_1_zu_1_6_CM_S2 1 0 -2147483647 2147483647 ECU_ADDRESS 0xFFF8F174 FORMAT "%2.0" /end MEASUREMENT
/begin MEASUREMENT T_SCHLUPF_NACHLBUF "" ULONG _CNV_R_R_Umr_1_zu_1_6_CM_S2 1 0 0 4294967295 ECU_ADDRESS 0xFFF8F178 FORMAT "%2.0" /end MEASUREMENT
/begin MEASUREMENT T_SCHLUPF_NACHLZWEI "" UWORD _CNV_R_R_Umr_1_zu_1_6_CM_S2 1 0 0 65535 ECU_ADDRESS 0xFFF8E73A FORMAT "%2.0" /end MEASUREMENT
/begin MEASUREMENT T_SCHLUPF_NACHLZWEI_BUF "" ULONG _CNV_R_R_Umr_1_zu_1_6_CM_S2 1 0 0 4294967295 ECU_ADDRESS 0xFFF8F17C FORMAT "%2.0" /end MEASUREMENT
/begin MEASUREMENT T_SEQ_SCHALT_ZKA "" SLONG _CNV_R_R_Umr_1_zu_1_124_CM_S2 1 0 -2147483648 2147483647 ECU_ADDRESS 0xFFF8F270 FORMAT "%2.0" /end MEASUREMENT
/begin MEASUREMENT T_SERP "" SLONG _CNV_R_R_Umr_1_zu_1_6_CM_S2 1 0 -2147483647 2147483647 ECU_ADDRESS 0xFFF8F0CC FORMAT "%2.0" /end MEASUREMENT
/begin MEASUREMENT T_SG "" SLONG _CNV_R_R_Umr_1_zu_1_6_CM_S2 1 0 -2147483647 2147483647 ECU_ADDRESS 0xFFF8F1BC FORMAT "%2.0" /end MEASUREMENT
/begin MEASUREMENT T_SPA "" UWORD _CNV_R_R_Umr_1_zu_1_6_CM_S2 1 0 0 65535 ECU_ADDRESS 0xFFF8E7CC FORMAT "%2.0" /end MEASUREMENT
/begin MEASUREMENT T_SPEICHER_TIPP_MINUS "" UWORD _CNV_R_R_Umr_1_zu_1_2_CM_S2 1 0 0 65535 ECU_ADDRESS 0xFFF8E3EC FORMAT "%2.0" /end MEASUREMENT
/begin MEASUREMENT T_SPERRHS_LDMMODEW_ZKA "" SLONG _CNV_R_R_Umr_1_zu_1_6_CM_S2 1 0 -2147483648 2147483647 ECU_ADDRESS 0xFFF8F274 FORMAT "%2.0" /end MEASUREMENT
/begin MEASUREMENT T_SPERR_FWSVALID_MSASTART "" ULONG _CNV_R_R_Umr_1_zu_1_6_CM_S2 1 0 0 4294967295 ECU_ADDRESS 0xFFF8EEC0 FORMAT "%2.0" /end MEASUREMENT
/begin MEASUREMENT T_SPERR_RSZBAB "" SLONG _CNV_R_R_Umr_1_zu_1_6_CM_S2 1 0 -2147483647 2147483647 ECU_ADDRESS 0xFFF8F2A4 FORMAT "%2.0" /end MEASUREMENT
/begin MEASUREMENT T_SPERR_SPA "" UWORD _CNV_R_R_Umr_1_zu_1_6_CM_S2 1 0 0 65535 ECU_ADDRESS 0xFFF8E7CE FORMAT "%2.0" /end MEASUREMENT
/begin MEASUREMENT T_STABKRI_ZKA "" SLONG _CNV_R_R_Umr_1_zu_1_2_CM_S2 1 0 -2147483648 2147483647 ECU_ADDRESS 0xFFF8F278 FORMAT "%2.0" /end MEASUREMENT
/begin MEASUREMENT T_STARTBUF_DDRS "" ULONG _CNV_R_R_Umr_1_zu_1_6_CM_S2 1 0 0 4294967295 ECU_ADDRESS 0xFFF8F2C4 FORMAT "%2.0" /end MEASUREMENT
/begin MEASUREMENT T_STARTBUF_DMRS "" ULONG _CNV_R_R_Umr_1_zu_1_6_CM_S2 1 0 0 2147483647 ECU_ADDRESS 0xFFF8EE60 FORMAT "%2.0" /end MEASUREMENT
/begin MEASUREMENT T_STARTLM "" SLONG _CNV_R_R_Umr_1_zu_1_6_CM_S2 1 0 -2147483647 2147483647 ECU_ADDRESS 0xFFF8F0EC FORMAT "%2.0" /end MEASUREMENT
/begin MEASUREMENT T_STEIGUNG_FILT "" SLONG _CNV_R_R_Umr_1_zu_1_6_CM_S2 1 0 -2147483648 2147483647 ECU_ADDRESS 0xFFF8F1B4 FORMAT "%2.0" /end MEASUREMENT
/begin MEASUREMENT T_TID_AUSSTIEG "" ULONG _CNV_R_R_Umr_1_zu_1_6_CM_S2 1 0 0 2147483647 ECU_ADDRESS 0xFFF8F30C FORMAT "%2.0" /end MEASUREMENT
/begin MEASUREMENT T_TIMESTAMP_FWSALT "" ULONG _CNV_R_R_Umr_1_zu_1_6_CM_S2 1 0 0 4294967295 ECU_ADDRESS 0xFFF8EED8 FORMAT "%2.0" /end MEASUREMENT
/begin MEASUREMENT T_TIMESTAMP_FWSVALIDALT "" ULONG _CNV_R_R_Umr_1_zu_1_6_CM_S2 1 0 0 4294967295 ECU_ADDRESS 0xFFF8EEDC FORMAT "%2.0" /end MEASUREMENT
/begin MEASUREMENT T_TIPP_SPA "" UWORD _CNV_R_R_Umr_1_zu_1_6_CM_S2 1 0 0 65535 ECU_ADDRESS 0xFFF8E7D0 FORMAT "%2.0" /end MEASUREMENT
/begin MEASUREMENT T_TIPP_STEPS "" ULONG _CNV_R_R_Umr_1_zu_1_6_CM_S2 1 0 0 2147483647 ECU_ADDRESS 0xFFF8EDEC FORMAT "%2.0" /end MEASUREMENT
/begin MEASUREMENT T_UEBLENDZEIT_DYNDZM_GES "" UWORD _CNV_R_R_Umr_1_zu_1_6_CM_S2 1 0 0 65535 ECU_ADDRESS 0xFFF86788 FORMAT "%2.0" /end MEASUREMENT
/begin MEASUREMENT T_UEBLENDZEIT_DYNDZM_REST "" UWORD _CNV_R_R_Umr_1_zu_1_6_CM_S2 1 0 0 65535 ECU_ADDRESS 0xFFF8678A FORMAT "%2.0" /end MEASUREMENT
/begin MEASUREMENT T_VALIDFWS_BREMS "" ULONG _CNV_R_R_Umr_1_zu_1_6_CM_S2 1 0 0 4294967295 ECU_ADDRESS 0xFFF8EEE0 FORMAT "%2.0" /end MEASUREMENT
/begin MEASUREMENT T_VALIDFWS_BREMS_FLANKE "" UWORD _CNV_R_R_Umr_1_zu_1_6_CM_S2 1 0 0 1000 ECU_ADDRESS 0xFFF8E52A FORMAT "%2.0" /end MEASUREMENT
/begin MEASUREMENT T_VALIDFWS_GWFP "" UWORD _CNV_R_R_Umr_1_zu_1_6_CM_S2 1 0 0 65535 ECU_ADDRESS 0xFFF8E52C FORMAT "%2.0" /end MEASUREMENT
/begin MEASUREMENT T_VERBOT_SCHLEPP "" SLONG _CNV_R_R_Umr_1_zu_1_6_CM_S2 1 0 -2147483647 2147483647 ECU_ADDRESS 0xFFF8F2C0 FORMAT "%2.0" /end MEASUREMENT
/begin MEASUREMENT T_VM_MOT_ISTFW "" SWORD _CNV_R_R_Umr_1_zu_1_6_CM_S2 1 0 0 2500 ECU_ADDRESS 0xFFF8E600 FORMAT "%2.0" /end MEASUREMENT
/begin MEASUREMENT T_VORWAHL "" UWORD _CNV_R_R_Umr_1_zu_1_6_CM_S2 1 0 0 65535 ECU_ADDRESS 0xFFF8E3EE FORMAT "%2.0" /end MEASUREMENT
/begin RECORD_LAYOUT _REC_A1CUR_1_u2_u2_S2 FNC_VALUES 1 UWORD COLUMN_DIR DIRECT /end RECORD_LAYOUT
/begin RECORD_LAYOUT _REC_A2AXS_31_u2_S2 AXIS_PTS_X 2 UWORD INDEX_INCR DIRECT NO_AXIS_PTS_X 1 UWORD /end RECORD_LAYOUT
/end MODULE
/end PROJECT
