ASAP2_VERSION 1 51
/begin PROJECT ZHBC8600 "Gen2_BMW_System_Supplier_Lib"
/begin MODULE CPP ""
/begin MOD_COMMON "" BYTE_ORDER MSB_FIRST ALIGNMENT_BYTE 1 ALIGNMENT_WORD 2 ALIGNMENT_LONG 4 ALIGNMENT_FLOAT32_IEEE 4 ALIGNMENT_FLOAT64_IEEE 1 /end MOD_COMMON
/begin COMPU_VTAB _CNV_S_9_Enum_EPOSL_81_S2 "" TAB_VERB 9 0 "POSL_1" 1 "POSL_2" 2 "POSL_3" 3 "POSL_4" 4 "POSL_5" 5 "POSL_6" 6 "POSL_7" 7 "POSL_8" 8 "POSL_9" DEFAULT_VALUE "" /end COMPU_VTAB
/begin COMPU_VTAB B_TRUE_M "boolean states, positive logic" TAB_VERB 2 0 "FALSE" 1 "TRUE" DEFAULT_VALUE "xxxxx" /end COMPU_VTAB
/begin COMPU_VTAB B_TRUE_S1 "boolean states, positive logic" TAB_VERB 2 0 "FALSE" 1 "TRUE" DEFAULT_VALUE "xxxxx" /end COMPU_VTAB
/begin COMPU_VTAB Conv.cBibRingSpeicher._.init_S5_S3 "Umrechnung fuer Messgroesse cBibRingSpeicher::init" TAB_VERB 2 0 "FALSE" 1 "TRUE" DEFAULT_VALUE "" /end COMPU_VTAB
/begin COMPU_METHOD _CNV_R_R_Umr_100_zu_142_CM_S2 "" RAT_FUNC "%6.3" "s" COEFFS 0 100 0 0 0 1 /end COMPU_METHOD
/begin COMPU_METHOD _CNV_R_R_Umr_128_zu_149_CM_S2 "" RAT_FUNC "%6.3" "km/h" COEFFS 0 128 0 0 0 1 /end COMPU_METHOD
/begin COMPU_METHOD _CNV_R_R_Umr_1_zu_1_144_CM_S2 "" RAT_FUNC "%6.3" "Nm/s" COEFFS 0 1 0 0 0 1 /end COMPU_METHOD
/begin COMPU_METHOD B_TRUE_M "boolean states, positive logic" TAB_VERB "%6.3" "" COMPU_TAB_REF B_TRUE_M /end COMPU_METHOD
/begin COMPU_METHOD B_TRUE_S1 "boolean states, positive logic" TAB_VERB "%6.3" "" COMPU_TAB_REF B_TRUE_S1 /end COMPU_METHOD
/begin COMPU_METHOD R0_1_P_M "[0.1%]" RAT_FUNC "%6.3" "%" COEFFS 0 10 0 0 0 1 /end COMPU_METHOD
/begin COMPU_METHOD R0_1_P_S1 "[0.1%]" RAT_FUNC "%6.3" "%" COEFFS 0 10 0 0 0 1 /end COMPU_METHOD
/begin COMPU_METHOD TI0_001_M_M "[0.001ms] time" RAT_FUNC "%6.5" "ms" COEFFS 0 1000 0 0 0 1 /end COMPU_METHOD
/begin COMPU_METHOD TI0_01_M_M "[0.01ms] time" RAT_FUNC "%6.4" "ms" COEFFS 0 100 0 0 0 1 /end COMPU_METHOD
/begin COMPU_METHOD TI1_CYCLE_S1 "[0.1s] resolution in multiples of 100ms task" RAT_FUNC "%6.3" "s" COEFFS 0 10 0 0 0 1 /end COMPU_METHOD
/begin COMPU_METHOD TI1_M_CYCLE_M "[ms] resolution in multiples of main task (time*ROS_NUM_MNTSK_100MS_SY/100.0ms)" RAT_FUNC "%6.2" "ms" COEFFS 0 0.2 0 0 0 1 /end COMPU_METHOD
/begin COMPU_METHOD TI1_M_CYCLE_S1 "[ms] resolution in multiples of main task (time*ROS_NUM_MNTSK_100MS_SY/100.0ms)" RAT_FUNC "%6.2" "ms" COEFFS 0 0.2 0 0 0 1 /end COMPU_METHOD
/begin COMPU_METHOD TI1_M_M "[1ms] time" RAT_FUNC "%6.2" "ms" COEFFS 0 1 0 0 0 1 /end COMPU_METHOD
/begin COMPU_METHOD TI1_U_S1 "[1µs] time" RAT_FUNC "%6.2" "µs" COEFFS 0 1 0 0 0 1 /end COMPU_METHOD
/begin COMPU_METHOD X1_M "[1] no unit" RAT_FUNC "%6.2" "" COEFFS 0 1 0 0 0 1 /end COMPU_METHOD
/begin COMPU_METHOD X1_S1 "[1] no unit" RAT_FUNC "%6.2" "" COEFFS 0 1 0 0 0 1 /end COMPU_METHOD
/begin MEASUREMENT CANFA_ACLNX_MASSCNTR " F2062: CANFA_ACLNX_MASSCNTR (internal only)" UBYTE X1_M 1 100 0 255 ECU_ADDRESS 0xFFF84160 FORMAT "%5.1" MATRIX_DIM 15 1 1 /end MEASUREMENT
/begin MEASUREMENT CANFA_ACLNX_MASSCNTR_DATA " F2062: CANFA_ACLNX_MASSCNTR valid buffer" UBYTE X1_M 1 100 0 255 ECU_ADDRESS 0xFFF84158 FORMAT "%5.1" MATRIX_DIM 8 1 1 /end MEASUREMENT
/begin MEASUREMENT CANFA_ACLNX_MASSCNTR_RAW " F2062: CANFA_ACLNX_MASSCNTR raw buffer" UBYTE X1_M 1 100 0 255 ECU_ADDRESS 0xFFF923FC FORMAT "%5.1" MATRIX_DIM 8 1 1 /end MEASUREMENT
/begin MEASUREMENT CANFA_ACLNY_MASSCNTR " F2062: CANFA_ACLNY_MASSCNTR (internal only)" UBYTE X1_M 1 100 0 255 ECU_ADDRESS 0xFFF84178 FORMAT "%5.1" MATRIX_DIM 15 1 1 /end MEASUREMENT
/begin MEASUREMENT CANFA_ACLNY_MASSCNTR_DATA " F2062: CANFA_ACLNY_MASSCNTR valid buffer" UBYTE X1_M 1 100 0 255 ECU_ADDRESS 0xFFF84170 FORMAT "%5.1" MATRIX_DIM 8 1 1 /end MEASUREMENT
/begin MEASUREMENT CANFA_ACLNY_MASSCNTR_RAW " F2062: CANFA_ACLNY_MASSCNTR raw buffer" UBYTE X1_M 1 100 0 255 ECU_ADDRESS 0xFFF92404 FORMAT "%5.1" MATRIX_DIM 8 1 1 /end MEASUREMENT
/begin MEASUREMENT CANFA_AVL_BRTORQ_SUM " F2062: CANFA_AVL_BRTORQ_SUM (internal only)" UBYTE X1_M 1 100 0 255 ECU_ADDRESS 0xFFF84198 FORMAT "%5.1" MATRIX_DIM 15 1 1 /end MEASUREMENT
/begin MEASUREMENT CANFA_AVL_BRTORQ_SUM_COMP " F2062: CANFA_AVL_BRTORQ_SUM complement buffer" UBYTE X1_M 1 100 0 255 ECU_ADDRESS 0xFFF92414 FORMAT "%5.1" MATRIX_DIM 8 1 1 /end MEASUREMENT
/begin MEASUREMENT CANFA_AVL_BRTORQ_SUM_COMPSTA " F2062: CANFA_AVL_BRTORQ_SUM_COMPSTA (internal only)" UBYTE X1_M 1 100 0 255 ECU_ADDRESS 0xFFF84190 FORMAT "%5.1" MATRIX_DIM 7 1 1 /end MEASUREMENT
/begin MEASUREMENT CANFA_AVL_BRTORQ_SUM_DATA " F2062: CANFA_AVL_BRTORQ_SUM valid buffer" UBYTE X1_M 1 100 0 255 ECU_ADDRESS 0xFFF84188 FORMAT "%5.1" MATRIX_DIM 8 1 1 /end MEASUREMENT
/begin MEASUREMENT CANFA_AVL_BRTORQ_SUM_RAW " F2062: CANFA_AVL_BRTORQ_SUM raw buffer" UBYTE X1_M 1 100 0 255 ECU_ADDRESS 0xFFF9240C FORMAT "%5.1" MATRIX_DIM 8 1 1 /end MEASUREMENT
/begin MEASUREMENT CANFA_AVL_RPM_WHL_UPRT " F2062: CANFA_AVL_RPM_WHL_UPRT (internal only)" UBYTE X1_M 1 100 0 255 ECU_ADDRESS 0xFFF841B0 FORMAT "%5.1" MATRIX_DIM 15 1 1 /end MEASUREMENT
/begin MEASUREMENT CANFA_AVL_RPM_WHL_UPRT_DATA " F2062: CANFA_AVL_RPM_WHL_UPRT valid buffer" UBYTE X1_M 1 100 0 255 ECU_ADDRESS 0xFFF841A8 FORMAT "%5.1" MATRIX_DIM 8 1 1 /end MEASUREMENT
/begin MEASUREMENT CANFA_AVL_RPM_WHL_UPRT_RAW " F2062: CANFA_AVL_RPM_WHL_UPRT raw buffer" UBYTE X1_M 1 100 0 255 ECU_ADDRESS 0xFFF9241C FORMAT "%5.1" MATRIX_DIM 8 1 1 /end MEASUREMENT
/begin MEASUREMENT CANFA_A_TEMP " F2062: CANFA_A_TEMP (internal only)" UBYTE X1_M 1 100 0 255 ECU_ADDRESS 0xFFF84148 FORMAT "%5.1" MATRIX_DIM 15 1 1 /end MEASUREMENT
/begin MEASUREMENT CANFA_A_TEMP_DATA " F2062: CANFA_A_TEMP valid buffer" UBYTE X1_M 1 100 0 255 ECU_ADDRESS 0xFFF84140 FORMAT "%5.1" MATRIX_DIM 8 1 1 /end MEASUREMENT
/begin MEASUREMENT CANFA_A_TEMP_RAW " F2062: CANFA_A_TEMP raw buffer" UBYTE X1_M 1 100 0 255 ECU_ADDRESS 0xFFF923F4 FORMAT "%5.1" MATRIX_DIM 8 1 1 /end MEASUREMENT
/begin MEASUREMENT CANFA_DIAG_OBD_ENG " F2062: CANFA_DIAG_OBD_ENG (internal only)" UBYTE X1_M 1 100 0 255 ECU_ADDRESS 0xFFF841C8 FORMAT "%5.1" MATRIX_DIM 15 1 1 /end MEASUREMENT
/begin MEASUREMENT CANFA_DIAG_OBD_ENG_DATA " F2062: CANFA_DIAG_OBD_ENG valid buffer" UBYTE X1_M 1 100 0 255 ECU_ADDRESS 0xFFF841C0 FORMAT "%5.1" MATRIX_DIM 8 1 1 /end MEASUREMENT
/begin MEASUREMENT CANFA_DIAG_OBD_ENG_RAW " F2062: CANFA_DIAG_OBD_ENG raw buffer" UBYTE X1_M 1 100 0 255 ECU_ADDRESS 0xFFF92424 FORMAT "%5.1" MATRIX_DIM 8 1 1 /end MEASUREMENT
/begin MEASUREMENT CANFA_DIAG_OBD_GRB " F2062: CANFA_DIAG_OBD_GRB (internal only)" UBYTE X1_M 1 100 0 255 ECU_ADDRESS 0xFFF84470 FORMAT "%5.1" MATRIX_DIM 15 1 1 /end MEASUREMENT
/begin MEASUREMENT CANFA_DIAG_OBD_GRB_DATA " F2062: CANFA_DIAG_OBD_GRB valid buffer" UBYTE X1_M 1 100 0 255 ECU_ADDRESS 0xFFF84460 FORMAT "%5.1" MATRIX_DIM 8 1 1 /end MEASUREMENT
/begin MEASUREMENT CANFA_DT_DISP_GRDT " F2062: CANFA_DT_DISP_GRDT (internal only)" UBYTE X1_M 1 100 0 255 ECU_ADDRESS 0xFFF844B0 FORMAT "%5.1" MATRIX_DIM 15 1 1 /end MEASUREMENT
/begin MEASUREMENT CANFA_DT_DISP_GRDT_COMP " F2062: CANFA_DT_DISP_GRDT complement buffer" UBYTE X1_M 1 100 0 255 ECU_ADDRESS 0xFFF9251C FORMAT "%5.1" MATRIX_DIM 8 1 1 /end MEASUREMENT
/begin MEASUREMENT CANFA_DT_DISP_GRDT_DATA " F2062: CANFA_DT_DISP_GRDT valid buffer" UBYTE X1_M 1 100 0 255 ECU_ADDRESS 0xFFF844A0 FORMAT "%5.1" MATRIX_DIM 8 1 1 /end MEASUREMENT
/begin MEASUREMENT CANFA_DT_DISP_GRDT_RX " F2062: CANFA_DT_DISP_GRDT_RX (internal only)" UBYTE X1_M 1 100 0 255 ECU_ADDRESS 0xFFF84490 FORMAT "%5.1" MATRIX_DIM 15 1 1 /end MEASUREMENT
/begin MEASUREMENT CANFA_DT_DISP_GRDT_RX_COMP " F2062: CANFA_DT_DISP_GRDT_RX complement buffer" UBYTE X1_M 1 100 0 255 ECU_ADDRESS 0xFFF92514 FORMAT "%5.1" MATRIX_DIM 8 1 1 /end MEASUREMENT
/begin MEASUREMENT CANFA_DT_DISP_GRDT_RX_DATA " F2062: CANFA_DT_DISP_GRDT_RX valid buffer" UBYTE X1_M 1 100 0 255 ECU_ADDRESS 0xFFF84480 FORMAT "%5.1" MATRIX_DIM 8 1 1 /end MEASUREMENT
/begin MEASUREMENT CANFA_DT_DISP_GRDT_RX_RAW " F2062: CANFA_DT_DISP_GRDT_RX raw buffer" UBYTE X1_M 1 100 0 255 ECU_ADDRESS 0xFFF84488 FORMAT "%5.1" MATRIX_DIM 8 1 1 /end MEASUREMENT
/begin MEASUREMENT CANFA_FAHRGESTELLNUMMER " F2062: CANFA_FAHRGESTELLNUMMER (internal only)" UBYTE X1_M 1 100 0 255 ECU_ADDRESS 0xFFF841E0 FORMAT "%5.1" MATRIX_DIM 15 1 1 /end MEASUREMENT
/begin MEASUREMENT CANFA_FAHRGESTELLNUMMER_DATA " F2062: CANFA_FAHRGESTELLNUMMER valid buffer" UBYTE X1_M 1 100 0 255 ECU_ADDRESS 0xFFF841D8 FORMAT "%5.1" MATRIX_DIM 8 1 1 /end MEASUREMENT
/begin MEASUREMENT CANFA_FAHRGESTELLNUMMER_RAW " F2062: CANFA_FAHRGESTELLNUMMER raw buffer" UBYTE X1_M 1 100 0 255 ECU_ADDRESS 0xFFF9242C FORMAT "%5.1" MATRIX_DIM 8 1 1 /end MEASUREMENT
/begin MEASUREMENT CANFA_FLLUPT_GPWSUP " F2062: CANFA_FLLUPT_GPWSUP (internal only)" UBYTE X1_M 1 100 0 255 ECU_ADDRESS 0xFFF841F8 FORMAT "%5.1" MATRIX_DIM 15 1 1 /end MEASUREMENT
/begin MEASUREMENT CANFA_FLLUPT_GPWSUP_DATA " F2062: CANFA_FLLUPT_GPWSUP valid buffer" UBYTE X1_M 1 100 0 255 ECU_ADDRESS 0xFFF841F0 FORMAT "%5.1" MATRIX_DIM 8 1 1 /end MEASUREMENT
/begin MEASUREMENT CANFA_FLLUPT_GPWSUP_RAW " F2062: CANFA_FLLUPT_GPWSUP raw buffer" UBYTE X1_M 1 100 0 255 ECU_ADDRESS 0xFFF92434 FORMAT "%5.1" MATRIX_DIM 8 1 1 /end MEASUREMENT
/begin MEASUREMENT CANFA_FZZSTD " F2062: CANFA_FZZSTD (internal only)" UBYTE X1_M 1 100 0 255 ECU_ADDRESS 0xFFF84210 FORMAT "%5.1" MATRIX_DIM 15 1 1 /end MEASUREMENT
/begin MEASUREMENT CANFA_FZZSTD_DATA " F2062: CANFA_FZZSTD valid buffer" UBYTE X1_M 1 100 0 255 ECU_ADDRESS 0xFFF84208 FORMAT "%5.1" MATRIX_DIM 8 1 1 /end MEASUREMENT
/begin MEASUREMENT CANFA_FZZSTD_RAW " F2062: CANFA_FZZSTD raw buffer" UBYTE X1_M 1 100 0 255 ECU_ADDRESS 0xFFF9243C FORMAT "%5.1" MATRIX_DIM 8 1 1 /end MEASUREMENT
/begin MEASUREMENT CANFA_KILOMETERSTAND " F2062: CANFA_KILOMETERSTAND (internal only)" UBYTE X1_M 1 100 0 255 ECU_ADDRESS 0xFFF84228 FORMAT "%5.1" MATRIX_DIM 15 1 1 /end MEASUREMENT
/begin MEASUREMENT CANFA_KILOMETERSTAND_DATA " F2062: CANFA_KILOMETERSTAND valid buffer" UBYTE X1_M 1 100 0 255 ECU_ADDRESS 0xFFF84220 FORMAT "%5.1" MATRIX_DIM 8 1 1 /end MEASUREMENT
/begin MEASUREMENT CANFA_KILOMETERSTAND_RAW " F2062: CANFA_KILOMETERSTAND raw buffer" UBYTE X1_M 1 100 0 255 ECU_ADDRESS 0xFFF92444 FORMAT "%5.1" MATRIX_DIM 8 1 1 /end MEASUREMENT
/begin MEASUREMENT CANFA_KLEMMEN " F2062: CANFA_KLEMMEN (internal only)" UBYTE X1_M 1 100 0 255 ECU_ADDRESS 0xFFF84248 FORMAT "%5.1" MATRIX_DIM 15 1 1 /end MEASUREMENT
/begin MEASUREMENT CANFA_KLEMMEN_COMP " F2062: CANFA_KLEMMEN complement buffer" UBYTE X1_M 1 100 0 255 ECU_ADDRESS 0xFFF92454 FORMAT "%5.1" MATRIX_DIM 8 1 1 /end MEASUREMENT
/begin MEASUREMENT CANFA_KLEMMEN_COMPSTA " F2062: CANFA_KLEMMEN_COMPSTA (internal only)" UBYTE X1_M 1 100 0 255 ECU_ADDRESS 0xFFF84240 FORMAT "%5.1" MATRIX_DIM 7 1 1 /end MEASUREMENT
/begin MEASUREMENT CANFA_KLEMMEN_DATA " F2062: CANFA_KLEMMEN valid buffer" UBYTE X1_M 1 100 0 255 ECU_ADDRESS 0xFFF84238 FORMAT "%5.1" MATRIX_DIM 8 1 1 /end MEASUREMENT
/begin MEASUREMENT CANFA_KLEMMEN_RAW " F2062: CANFA_KLEMMEN raw buffer" UBYTE X1_M 1 100 0 255 ECU_ADDRESS 0xFFF9244C FORMAT "%5.1" MATRIX_DIM 8 1 1 /end MEASUREMENT
/begin MEASUREMENT CANFA_MASS_VEH " F2062: CANFA_MASS_VEH (internal only)" UBYTE X1_M 1 100 0 255 ECU_ADDRESS 0xFFF84260 FORMAT "%5.1" MATRIX_DIM 15 1 1 /end MEASUREMENT
/begin MEASUREMENT CANFA_MASS_VEH_DATA " F2062: CANFA_MASS_VEH valid buffer" UBYTE X1_M 1 100 0 255 ECU_ADDRESS 0xFFF84258 FORMAT "%5.1" MATRIX_DIM 8 1 1 /end MEASUREMENT
/begin MEASUREMENT CANFA_MASS_VEH_RAW " F2062: CANFA_MASS_VEH raw buffer" UBYTE X1_M 1 100 0 255 ECU_ADDRESS 0xFFF9245C FORMAT "%5.1" MATRIX_DIM 8 1 1 /end MEASUREMENT
/begin MEASUREMENT CANFA_OP_SPD " F2062: CANFA_OP_SPD (internal only)" UBYTE X1_M 1 100 0 255 ECU_ADDRESS 0xFFF84278 FORMAT "%5.1" MATRIX_DIM 15 1 1 /end MEASUREMENT
/begin MEASUREMENT CANFA_OP_SPD_DATA " F2062: CANFA_OP_SPD valid buffer" UBYTE X1_M 1 100 0 255 ECU_ADDRESS 0xFFF84270 FORMAT "%5.1" MATRIX_DIM 8 1 1 /end MEASUREMENT
/begin MEASUREMENT CANFA_OP_SPD_RAW " F2062: CANFA_OP_SPD raw buffer" UBYTE X1_M 1 100 0 255 ECU_ADDRESS 0xFFF92464 FORMAT "%5.1" MATRIX_DIM 8 1 1 /end MEASUREMENT
/begin MEASUREMENT CANFA_RELATIVZEIT " F2062: CANFA_RELATIVZEIT (internal only)" UBYTE X1_M 1 100 0 255 ECU_ADDRESS 0xFFF84290 FORMAT "%5.1" MATRIX_DIM 15 1 1 /end MEASUREMENT
/begin MEASUREMENT CANFA_RELATIVZEIT_DATA " F2062: CANFA_RELATIVZEIT valid buffer" UBYTE X1_M 1 100 0 255 ECU_ADDRESS 0xFFF84288 FORMAT "%5.1" MATRIX_DIM 8 1 1 /end MEASUREMENT
/begin MEASUREMENT CANFA_RELATIVZEIT_RAW " F2062: CANFA_RELATIVZEIT raw buffer" UBYTE X1_M 1 100 0 255 ECU_ADDRESS 0xFFF9246C FORMAT "%5.1" MATRIX_DIM 8 1 1 /end MEASUREMENT
/begin MEASUREMENT CANFA_STAT_ANHAENGER " F2062: CANFA_STAT_ANHAENGER (internal only)" UBYTE X1_M 1 100 0 255 ECU_ADDRESS 0xFFF84360 FORMAT "%5.1" MATRIX_DIM 15 1 1 /end MEASUREMENT
/begin MEASUREMENT CANFA_STAT_ANHAENGER_DATA " F2062: CANFA_STAT_ANHAENGER valid buffer" UBYTE X1_M 1 100 0 255 ECU_ADDRESS 0xFFF84358 FORMAT "%5.1" MATRIX_DIM 8 1 1 /end MEASUREMENT
/begin MEASUREMENT CANFA_STAT_ANHAENGER_RAW " F2062: CANFA_STAT_ANHAENGER raw buffer" UBYTE X1_M 1 100 0 255 ECU_ADDRESS 0xFFF924BC FORMAT "%5.1" MATRIX_DIM 8 1 1 /end MEASUREMENT
/begin MEASUREMENT CANFA_STAT_CT_HABR " F2062: CANFA_STAT_CT_HABR (internal only)" UBYTE X1_M 1 100 0 255 ECU_ADDRESS 0xFFF84378 FORMAT "%5.1" MATRIX_DIM 15 1 1 /end MEASUREMENT
/begin MEASUREMENT CANFA_STAT_CT_HABR_DATA " F2062: CANFA_STAT_CT_HABR valid buffer" UBYTE X1_M 1 100 0 255 ECU_ADDRESS 0xFFF84370 FORMAT "%5.1" MATRIX_DIM 8 1 1 /end MEASUREMENT
/begin MEASUREMENT CANFA_STAT_CT_HABR_RAW " F2062: CANFA_STAT_CT_HABR raw buffer" UBYTE X1_M 1 100 0 255 ECU_ADDRESS 0xFFF924C4 FORMAT "%5.1" MATRIX_DIM 8 1 1 /end MEASUREMENT
/begin MEASUREMENT CANFA_STAT_DS_VRFD " F2062: CANFA_STAT_DS_VRFD (internal only)" UBYTE X1_M 1 100 0 255 ECU_ADDRESS 0xFFF84390 FORMAT "%5.1" MATRIX_DIM 15 1 1 /end MEASUREMENT
/begin MEASUREMENT CANFA_STAT_DS_VRFD_DATA " F2062: CANFA_STAT_DS_VRFD valid buffer" UBYTE X1_M 1 100 0 255 ECU_ADDRESS 0xFFF84388 FORMAT "%5.1" MATRIX_DIM 8 1 1 /end MEASUREMENT
/begin MEASUREMENT CANFA_STAT_DS_VRFD_RAW " F2062: CANFA_STAT_DS_VRFD raw buffer" UBYTE X1_M 1 100 0 255 ECU_ADDRESS 0xFFF924CC FORMAT "%5.1" MATRIX_DIM 8 1 1 /end MEASUREMENT
/begin MEASUREMENT CANFA_STAT_ZV_KLAPPEN " F2062: CANFA_STAT_ZV_KLAPPEN (internal only)" UBYTE X1_M 1 100 0 255 ECU_ADDRESS 0xFFF843A8 FORMAT "%5.1" MATRIX_DIM 15 1 1 /end MEASUREMENT
/begin MEASUREMENT CANFA_STAT_ZV_KLAPPEN_DATA " F2062: CANFA_STAT_ZV_KLAPPEN valid buffer" UBYTE X1_M 1 100 0 255 ECU_ADDRESS 0xFFF843A0 FORMAT "%5.1" MATRIX_DIM 8 1 1 /end MEASUREMENT
/begin MEASUREMENT CANFA_STAT_ZV_KLAPPEN_RAW " F2062: CANFA_STAT_ZV_KLAPPEN raw buffer" UBYTE X1_M 1 100 0 255 ECU_ADDRESS 0xFFF924D4 FORMAT "%5.1" MATRIX_DIM 8 1 1 /end MEASUREMENT
/begin MEASUREMENT CANFA_STEA_FTAX_EFFV " F2062: CANFA_STEA_FTAX_EFFV (internal only)" UBYTE X1_M 1 100 0 255 ECU_ADDRESS 0xFFF843C0 FORMAT "%5.1" MATRIX_DIM 15 1 1 /end MEASUREMENT
/begin MEASUREMENT CANFA_STEA_FTAX_EFFV_DATA " F2062: CANFA_STEA_FTAX_EFFV valid buffer" UBYTE X1_M 1 100 0 255 ECU_ADDRESS 0xFFF843B8 FORMAT "%5.1" MATRIX_DIM 8 1 1 /end MEASUREMENT
/begin MEASUREMENT CANFA_STEA_FTAX_EFFV_RAW " F2062: CANFA_STEA_FTAX_EFFV raw buffer" UBYTE X1_M 1 100 0 255 ECU_ADDRESS 0xFFF924DC FORMAT "%5.1" MATRIX_DIM 8 1 1 /end MEASUREMENT
/begin MEASUREMENT CANFA_ST_BLT_CT_SOCCU " F2062: CANFA_ST_BLT_CT_SOCCU (internal only)" UBYTE X1_M 1 100 0 255 ECU_ADDRESS 0xFFF842A8 FORMAT "%5.1" MATRIX_DIM 15 1 1 /end MEASUREMENT
/begin MEASUREMENT CANFA_ST_BLT_CT_SOCCU_DATA " F2062: CANFA_ST_BLT_CT_SOCCU valid buffer" UBYTE X1_M 1 100 0 255 ECU_ADDRESS 0xFFF842A0 FORMAT "%5.1" MATRIX_DIM 8 1 1 /end MEASUREMENT
/begin MEASUREMENT CANFA_ST_BLT_CT_SOCCU_RAW " F2062: CANFA_ST_BLT_CT_SOCCU raw buffer" UBYTE X1_M 1 100 0 255 ECU_ADDRESS 0xFFF92474 FORMAT "%5.1" MATRIX_DIM 8 1 1 /end MEASUREMENT
/begin MEASUREMENT CANFA_ST_DISP_DRDY " F2062: CANFA_ST_DISP_DRDY (internal only)" UBYTE X1_M 1 100 0 255 ECU_ADDRESS 0xFFF842C0 FORMAT "%5.1" MATRIX_DIM 15 1 1 /end MEASUREMENT
/begin MEASUREMENT CANFA_ST_DISP_DRDY_DATA " F2062: CANFA_ST_DISP_DRDY valid buffer" UBYTE X1_M 1 100 0 255 ECU_ADDRESS 0xFFF842B8 FORMAT "%5.1" MATRIX_DIM 8 1 1 /end MEASUREMENT
/begin MEASUREMENT CANFA_ST_DISP_DRDY_RAW " F2062: CANFA_ST_DISP_DRDY raw buffer" UBYTE X1_M 1 100 0 255 ECU_ADDRESS 0xFFF9247C FORMAT "%5.1" MATRIX_DIM 8 1 1 /end MEASUREMENT
/begin MEASUREMENT CANFA_ST_GRB_ECU " F2062: CANFA_ST_GRB_ECU (internal only)" UBYTE X1_M 1 100 0 255 ECU_ADDRESS 0xFFF844F0 FORMAT "%5.1" MATRIX_DIM 15 1 1 /end MEASUREMENT
/begin MEASUREMENT CANFA_ST_GRB_ECU_COMP " F2062: CANFA_ST_GRB_ECU complement buffer" UBYTE X1_M 1 100 0 255 ECU_ADDRESS 0xFFF9252C FORMAT "%5.1" MATRIX_DIM 8 1 1 /end MEASUREMENT
/begin MEASUREMENT CANFA_ST_GRB_ECU_DATA " F2062: CANFA_ST_GRB_ECU valid buffer" UBYTE X1_M 1 100 0 255 ECU_ADDRESS 0xFFF844E0 FORMAT "%5.1" MATRIX_DIM 8 1 1 /end MEASUREMENT
/begin MEASUREMENT CANFA_ST_GRB_ECU_RX " F2062: CANFA_ST_GRB_ECU_RX (internal only)" UBYTE X1_M 1 100 0 255 ECU_ADDRESS 0xFFF844D0 FORMAT "%5.1" MATRIX_DIM 15 1 1 /end MEASUREMENT
/begin MEASUREMENT CANFA_ST_GRB_ECU_RX_COMP " F2062: CANFA_ST_GRB_ECU_RX complement buffer" UBYTE X1_M 1 100 0 255 ECU_ADDRESS 0xFFF92524 FORMAT "%5.1" MATRIX_DIM 8 1 1 /end MEASUREMENT
/begin MEASUREMENT CANFA_ST_GRB_ECU_RX_DATA " F2062: CANFA_ST_GRB_ECU_RX valid buffer" UBYTE X1_M 1 100 0 255 ECU_ADDRESS 0xFFF844C0 FORMAT "%5.1" MATRIX_DIM 8 1 1 /end MEASUREMENT
/begin MEASUREMENT CANFA_ST_GRB_ECU_RX_RAW " F2062: CANFA_ST_GRB_ECU_RX raw buffer" UBYTE X1_M 1 100 0 255 ECU_ADDRESS 0xFFF844C8 FORMAT "%5.1" MATRIX_DIM 8 1 1 /end MEASUREMENT
/begin MEASUREMENT CANFA_ST_GWS " F2062: CANFA_ST_GWS (internal only)" UBYTE X1_M 1 100 0 255 ECU_ADDRESS 0xFFF842E0 FORMAT "%5.1" MATRIX_DIM 15 1 1 /end MEASUREMENT
/begin MEASUREMENT CANFA_ST_GWS_COMP " F2062: CANFA_ST_GWS complement buffer" UBYTE X1_M 1 100 0 255 ECU_ADDRESS 0xFFF9248C FORMAT "%5.1" MATRIX_DIM 8 1 1 /end MEASUREMENT
/begin MEASUREMENT CANFA_ST_GWS_COMPSTA " F2062: CANFA_ST_GWS_COMPSTA (internal only)" UBYTE X1_M 1 100 0 255 ECU_ADDRESS 0xFFF842D8 FORMAT "%5.1" MATRIX_DIM 7 1 1 /end MEASUREMENT
/begin MEASUREMENT CANFA_ST_GWS_DATA " F2062: CANFA_ST_GWS valid buffer" UBYTE X1_M 1 100 0 255 ECU_ADDRESS 0xFFF842D0 FORMAT "%5.1" MATRIX_DIM 8 1 1 /end MEASUREMENT
/begin MEASUREMENT CANFA_ST_GWS_RAW " F2062: CANFA_ST_GWS raw buffer" UBYTE X1_M 1 100 0 255 ECU_ADDRESS 0xFFF92484 FORMAT "%5.1" MATRIX_DIM 8 1 1 /end MEASUREMENT
/begin MEASUREMENT CANFA_ST_STAB_DSC " F2062: CANFA_ST_STAB_DSC (internal only)" UBYTE X1_M 1 100 0 255 ECU_ADDRESS 0xFFF84318 FORMAT "%5.1" MATRIX_DIM 15 1 1 /end MEASUREMENT
/begin MEASUREMENT CANFA_ST_STAB_DSC_COMP " F2062: CANFA_ST_STAB_DSC complement buffer" UBYTE X1_M 1 100 0 255 ECU_ADDRESS 0xFFF924A4 FORMAT "%5.1" MATRIX_DIM 8 1 1 /end MEASUREMENT
/begin MEASUREMENT CANFA_ST_STAB_DSC_COMPSTA " F2062: CANFA_ST_STAB_DSC_COMPSTA (internal only)" UBYTE X1_M 1 100 0 255 ECU_ADDRESS 0xFFF84310 FORMAT "%5.1" MATRIX_DIM 7 1 1 /end MEASUREMENT
/begin MEASUREMENT CANFA_ST_STAB_DSC_DATA " F2062: CANFA_ST_STAB_DSC valid buffer" UBYTE X1_M 1 100 0 255 ECU_ADDRESS 0xFFF84308 FORMAT "%5.1" MATRIX_DIM 8 1 1 /end MEASUREMENT
/begin MEASUREMENT CANFA_ST_STAB_DSC_RAW " F2062: CANFA_ST_STAB_DSC raw buffer" UBYTE X1_M 1 100 0 255 ECU_ADDRESS 0xFFF9249C FORMAT "%5.1" MATRIX_DIM 8 1 1 /end MEASUREMENT
/begin MEASUREMENT CANFA_ST_STA_PWR_DRV " F2062: CANFA_ST_STA_PWR_DRV (internal only)" UBYTE X1_M 1 100 0 255 ECU_ADDRESS 0xFFF842F8 FORMAT "%5.1" MATRIX_DIM 15 1 1 /end MEASUREMENT
/begin MEASUREMENT CANFA_ST_STA_PWR_DRV_DATA " F2062: CANFA_ST_STA_PWR_DRV valid buffer" UBYTE X1_M 1 100 0 255 ECU_ADDRESS 0xFFF842F0 FORMAT "%5.1" MATRIX_DIM 8 1 1 /end MEASUREMENT
/begin MEASUREMENT CANFA_ST_STA_PWR_DRV_RAW " F2062: CANFA_ST_STA_PWR_DRV raw buffer" UBYTE X1_M 1 100 0 255 ECU_ADDRESS 0xFFF92494 FORMAT "%5.1" MATRIX_DIM 8 1 1 /end MEASUREMENT
/begin MEASUREMENT CANFA_ST_VEHSS_PBRK " F2062: CANFA_ST_VEHSS_PBRK (internal only)" UBYTE X1_M 1 100 0 255 ECU_ADDRESS 0xFFF84330 FORMAT "%5.1" MATRIX_DIM 15 1 1 /end MEASUREMENT
/begin MEASUREMENT CANFA_ST_VEHSS_PBRK_DATA " F2062: CANFA_ST_VEHSS_PBRK valid buffer" UBYTE X1_M 1 100 0 255 ECU_ADDRESS 0xFFF84328 FORMAT "%5.1" MATRIX_DIM 8 1 1 /end MEASUREMENT
/begin MEASUREMENT CANFA_ST_VEHSS_PBRK_RAW " F2062: CANFA_ST_VEHSS_PBRK raw buffer" UBYTE X1_M 1 100 0 255 ECU_ADDRESS 0xFFF924AC FORMAT "%5.1" MATRIX_DIM 8 1 1 /end MEASUREMENT
/begin MEASUREMENT CANFA_ST_VHSS " F2062: CANFA_ST_VHSS (internal only)" UBYTE X1_M 1 100 0 255 ECU_ADDRESS 0xFFF84348 FORMAT "%5.1" MATRIX_DIM 15 1 1 /end MEASUREMENT
/begin MEASUREMENT CANFA_ST_VHSS_DATA " F2062: CANFA_ST_VHSS valid buffer" UBYTE X1_M 1 100 0 255 ECU_ADDRESS 0xFFF84340 FORMAT "%5.1" MATRIX_DIM 8 1 1 /end MEASUREMENT
/begin MEASUREMENT CANFA_ST_VHSS_RAW " F2062: CANFA_ST_VHSS raw buffer" UBYTE X1_M 1 100 0 255 ECU_ADDRESS 0xFFF924B4 FORMAT "%5.1" MATRIX_DIM 8 1 1 /end MEASUREMENT
/begin MEASUREMENT CANFA_SU_SW_DRDY " F2062: CANFA_SU_SW_DRDY (internal only)" UBYTE X1_M 1 100 0 255 ECU_ADDRESS 0xFFF843D8 FORMAT "%5.1" MATRIX_DIM 15 1 1 /end MEASUREMENT
/begin MEASUREMENT CANFA_SU_SW_DRDY_DATA " F2062: CANFA_SU_SW_DRDY valid buffer" UBYTE X1_M 1 100 0 255 ECU_ADDRESS 0xFFF843D0 FORMAT "%5.1" MATRIX_DIM 8 1 1 /end MEASUREMENT
/begin MEASUREMENT CANFA_SU_SW_DRDY_RAW " F2062: CANFA_SU_SW_DRDY raw buffer" UBYTE X1_M 1 100 0 255 ECU_ADDRESS 0xFFF924E4 FORMAT "%5.1" MATRIX_DIM 8 1 1 /end MEASUREMENT
/begin MEASUREMENT CANFA_TAR_DT_GRB_MOT_1 " F2062: CANFA_TAR_DT_GRB_MOT_1 (internal only)" UBYTE X1_M 1 100 0 255 ECU_ADDRESS 0xFFF84520 FORMAT "%5.1" MATRIX_DIM 15 1 1 /end MEASUREMENT
/begin MEASUREMENT CANFA_TAR_DT_GRB_MOT_1_COMP " F2062: CANFA_TAR_DT_GRB_MOT_1 complement buffer" UBYTE X1_M 1 100 0 255 ECU_ADDRESS 0xFFF92544 FORMAT "%5.1" MATRIX_DIM 8 1 1 /end MEASUREMENT
/begin MEASUREMENT CANFA_TAR_DT_GRB_MOT_1_DATA " F2062: CANFA_TAR_DT_GRB_MOT_1 valid buffer" UBYTE X1_M 1 100 0 255 ECU_ADDRESS 0xFFF84518 FORMAT "%5.1" MATRIX_DIM 8 1 1 /end MEASUREMENT
/begin MEASUREMENT CANFA_TAR_DT_GRB_MOT_1_RX " F2062: CANFA_TAR_DT_GRB_MOT_1_RX (internal only)" UBYTE X1_M 1 100 0 255 ECU_ADDRESS 0xFFF84508 FORMAT "%5.1" MATRIX_DIM 15 1 1 /end MEASUREMENT
/begin MEASUREMENT CANFA_TAR_DT_GRB_MOT_1_RX_COMP " F2062: CANFA_TAR_DT_GRB_MOT_1_RX complement buffer" UBYTE X1_M 1 100 0 255 ECU_ADDRESS 0xFFF9253C FORMAT "%5.1" MATRIX_DIM 8 1 1 /end MEASUREMENT
/begin MEASUREMENT CANFA_TAR_DT_GRB_MOT_1_RX_DATA " F2062: CANFA_TAR_DT_GRB_MOT_1_RX valid buffer" UBYTE X1_M 1 100 0 255 ECU_ADDRESS 0xFFF84500 FORMAT "%5.1" MATRIX_DIM 8 1 1 /end MEASUREMENT
/begin MEASUREMENT CANFA_TAR_DT_GRB_MOT_1_RX_RAW " F2062: CANFA_TAR_DT_GRB_MOT_1_RX raw buffer" UBYTE X1_M 1 100 0 255 ECU_ADDRESS 0xFFF92534 FORMAT "%5.1" MATRIX_DIM 8 1 1 /end MEASUREMENT
/begin MEASUREMENT CANFA_TLT_RW " F2062: CANFA_TLT_RW (internal only)" UBYTE X1_M 1 100 0 255 ECU_ADDRESS 0xFFF843F0 FORMAT "%5.1" MATRIX_DIM 15 1 1 /end MEASUREMENT
/begin MEASUREMENT CANFA_TLT_RW_DATA " F2062: CANFA_TLT_RW valid buffer" UBYTE X1_M 1 100 0 255 ECU_ADDRESS 0xFFF843E8 FORMAT "%5.1" MATRIX_DIM 8 1 1 /end MEASUREMENT
/begin MEASUREMENT CANFA_TLT_RW_RAW " F2062: CANFA_TLT_RW raw buffer" UBYTE X1_M 1 100 0 255 ECU_ADDRESS 0xFFF924EC FORMAT "%5.1" MATRIX_DIM 8 1 1 /end MEASUREMENT
/begin MEASUREMENT CANFA_TOMA_WHL " F2062: CANFA_TOMA_WHL (internal only)" UBYTE X1_M 1 100 0 255 ECU_ADDRESS 0xFFF84408 FORMAT "%5.1" MATRIX_DIM 15 1 1 /end MEASUREMENT
/begin MEASUREMENT CANFA_TOMA_WHL_DATA " F2062: CANFA_TOMA_WHL valid buffer" UBYTE X1_M 1 100 0 255 ECU_ADDRESS 0xFFF84400 FORMAT "%5.1" MATRIX_DIM 8 1 1 /end MEASUREMENT
/begin MEASUREMENT CANFA_TOMA_WHL_RAW " F2062: CANFA_TOMA_WHL raw buffer" UBYTE X1_M 1 100 0 255 ECU_ADDRESS 0xFFF924F4 FORMAT "%5.1" MATRIX_DIM 8 1 1 /end MEASUREMENT
/begin MEASUREMENT CANFA_TORQ_GRB_HYB " F2062: CANFA_TORQ_GRB_HYB (internal only)" UBYTE X1_M 1 100 0 255 ECU_ADDRESS 0xFFF84550 FORMAT "%5.1" MATRIX_DIM 15 1 1 /end MEASUREMENT
/begin MEASUREMENT CANFA_TORQ_GRB_HYB_COMP " F2062: CANFA_TORQ_GRB_HYB complement buffer" UBYTE X1_M 1 100 0 255 ECU_ADDRESS 0xFFF9255C FORMAT "%5.1" MATRIX_DIM 8 1 1 /end MEASUREMENT
/begin MEASUREMENT CANFA_TORQ_GRB_HYB_DATA " F2062: CANFA_TORQ_GRB_HYB valid buffer" UBYTE X1_M 1 100 0 255 ECU_ADDRESS 0xFFF84548 FORMAT "%5.1" MATRIX_DIM 8 1 1 /end MEASUREMENT
/begin MEASUREMENT CANFA_TORQ_GRB_HYB_RX " F2062: CANFA_TORQ_GRB_HYB_RX (internal only)" UBYTE X1_M 1 100 0 255 ECU_ADDRESS 0xFFF84538 FORMAT "%5.1" MATRIX_DIM 15 1 1 /end MEASUREMENT
/begin MEASUREMENT CANFA_TORQ_GRB_HYB_RX_COMP " F2062: CANFA_TORQ_GRB_HYB_RX complement buffer" UBYTE X1_M 1 100 0 255 ECU_ADDRESS 0xFFF92554 FORMAT "%5.1" MATRIX_DIM 8 1 1 /end MEASUREMENT
/begin MEASUREMENT CANFA_TORQ_GRB_HYB_RX_DATA " F2062: CANFA_TORQ_GRB_HYB_RX valid buffer" UBYTE X1_M 1 100 0 255 ECU_ADDRESS 0xFFF84530 FORMAT "%5.1" MATRIX_DIM 8 1 1 /end MEASUREMENT
/begin MEASUREMENT CANFA_TORQ_GRB_HYB_RX_RAW " F2062: CANFA_TORQ_GRB_HYB_RX raw buffer" UBYTE X1_M 1 100 0 255 ECU_ADDRESS 0xFFF9254C FORMAT "%5.1" MATRIX_DIM 8 1 1 /end MEASUREMENT
/begin MEASUREMENT CANFA_TORQ_PT_HYB_1 " F2062: CANFA_TORQ_PT_HYB_1 (internal only)" UBYTE X1_M 1 100 0 255 ECU_ADDRESS 0xFFF84420 FORMAT "%5.1" MATRIX_DIM 15 1 1 /end MEASUREMENT
/begin MEASUREMENT CANFA_TORQ_PT_HYB_1_DATA " F2062: CANFA_TORQ_PT_HYB_1 valid buffer" UBYTE X1_M 1 100 0 255 ECU_ADDRESS 0xFFF84418 FORMAT "%5.1" MATRIX_DIM 8 1 1 /end MEASUREMENT
/begin MEASUREMENT CANFA_TORQ_PT_HYB_1_RAW " F2062: CANFA_TORQ_PT_HYB_1 raw buffer" UBYTE X1_M 1 100 0 255 ECU_ADDRESS 0xFFF924FC FORMAT "%5.1" MATRIX_DIM 8 1 1 /end MEASUREMENT
/begin MEASUREMENT CANFA_VYAW_VEH " F2062: CANFA_VYAW_VEH (internal only)" UBYTE X1_M 1 100 0 255 ECU_ADDRESS 0xFFF84450 FORMAT "%5.1" MATRIX_DIM 15 1 1 /end MEASUREMENT
/begin MEASUREMENT CANFA_VYAW_VEH_DATA " F2062: CANFA_VYAW_VEH valid buffer" UBYTE X1_M 1 100 0 255 ECU_ADDRESS 0xFFF84448 FORMAT "%5.1" MATRIX_DIM 8 1 1 /end MEASUREMENT
/begin MEASUREMENT CANFA_VYAW_VEH_RAW " F2062: CANFA_VYAW_VEH raw buffer" UBYTE X1_M 1 100 0 255 ECU_ADDRESS 0xFFF9250C FORMAT "%5.1" MATRIX_DIM 8 1 1 /end MEASUREMENT
/begin MEASUREMENT CANFA_V_VEH " F2062: CANFA_V_VEH (internal only)" UBYTE X1_M 1 100 0 255 ECU_ADDRESS 0xFFF84438 FORMAT "%5.1" MATRIX_DIM 15 1 1 /end MEASUREMENT
/begin MEASUREMENT CANFA_V_VEH_DATA " F2062: CANFA_V_VEH valid buffer" UBYTE X1_M 1 100 0 255 ECU_ADDRESS 0xFFF84430 FORMAT "%5.1" MATRIX_DIM 8 1 1 /end MEASUREMENT
/begin MEASUREMENT CANFA_V_VEH_RAW " F2062: CANFA_V_VEH raw buffer" UBYTE X1_M 1 100 0 255 ECU_ADDRESS 0xFFF92504 FORMAT "%5.1" MATRIX_DIM 8 1 1 /end MEASUREMENT
/begin CHARACTERISTIC CANFA_ctMsgMonAlvACLNX_MASSCNTR_C "F2062: alive counter monitoring message ACLNX_MASSCNTR" VALUE 0x191929 AblGLKWub_M 255 X1_M 0 255 FORMAT "%5.1" /end CHARACTERISTIC
/begin CHARACTERISTIC CANFA_ctMsgMonAlvACLNY_MASSCNTR_C "F2062: alive counter monitoring message ACLNY_MASSCNTR" VALUE 0x19192A AblGLKWub_M 255 X1_M 0 255 FORMAT "%5.1" /end CHARACTERISTIC
/begin CHARACTERISTIC CANFA_ctMsgMonAlvAVL_BRTORQ_SUM_C "F2062: alive counter monitoring message AVL_BRTORQ_SUM" VALUE 0x19192B AblGLKWub_M 255 X1_M 0 255 FORMAT "%5.1" /end CHARACTERISTIC
/begin CHARACTERISTIC CANFA_ctMsgMonAlvKLEMMEN_C "F2062: alive counter monitoring message KLEMMEN" VALUE 0x19192C AblGLKWub_M 255 X1_M 0 255 FORMAT "%5.1" /end CHARACTERISTIC
/begin CHARACTERISTIC CANFA_ctMsgMonAlvMASS_VEH_C "F2062: alive counter monitoring message MASS_VEH" VALUE 0x19192D AblGLKWub_M 255 X1_M 0 255 FORMAT "%5.1" /end CHARACTERISTIC
/begin CHARACTERISTIC CANFA_ctMsgMonAlvOP_SPD_C "F2062: alive counter monitoring message OP_SPD" VALUE 0x19192E AblGLKWub_M 255 X1_M 0 255 FORMAT "%5.1" /end CHARACTERISTIC
/begin CHARACTERISTIC CANFA_ctMsgMonAlvSTAT_DS_VRFD_C "F2062: alive counter monitoring message STAT_DS_VRFD" VALUE 0x19192F AblGLKWub_M 255 X1_M 0 255 FORMAT "%5.1" /end CHARACTERISTIC
/begin CHARACTERISTIC CANFA_ctMsgMonAlvSTEA_FTAX_EFFV_C "F2062: alive counter monitoring message STEA_FTAX_EFFV" VALUE 0x191930 AblGLKWub_M 255 X1_M 0 255 FORMAT "%5.1" /end CHARACTERISTIC
/begin CHARACTERISTIC CANFA_ctMsgMonAlvST_BLT_CT_SOCCU_C "F2062: alive counter monitoring message ST_BLT_CT_SOCCU" VALUE 0x191931 AblGLKWub_M 255 X1_M 0 255 FORMAT "%5.1" /end CHARACTERISTIC
/begin CHARACTERISTIC CANFA_ctMsgMonAlvST_DISP_DRDY_C "F2062: alive counter monitoring message ST_DISP_DRDY" VALUE 0x191932 AblGLKWub_M 255 X1_M 0 255 FORMAT "%5.1" /end CHARACTERISTIC
/begin CHARACTERISTIC CANFA_ctMsgMonAlvST_GWS_C "F2062: alive counter monitoring message ST_GWS" VALUE 0x191933 AblGLKWub_M 255 X1_M 0 255 FORMAT "%5.1" /end CHARACTERISTIC
/begin CHARACTERISTIC CANFA_ctMsgMonAlvST_STAB_DSC_C "F2062: alive counter monitoring message ST_STAB_DSC" VALUE 0x191934 AblGLKWub_M 255 X1_M 0 255 FORMAT "%5.1" /end CHARACTERISTIC
/begin CHARACTERISTIC CANFA_ctMsgMonAlvST_VEHSS_PBRK_C "F2062: alive counter monitoring message ST_VEHSS_PBRK" VALUE 0x191935 AblGLKWub_M 255 X1_M 0 255 FORMAT "%5.1" /end CHARACTERISTIC
/begin CHARACTERISTIC CANFA_ctMsgMonAlvST_VHSS_C "F2062: alive counter monitoring message ST_VHSS" VALUE 0x191936 AblGLKWub_M 255 X1_M 0 255 FORMAT "%5.1" /end CHARACTERISTIC
/begin CHARACTERISTIC CANFA_ctMsgMonAlvSU_SW_DRDY_C "F2062: alive counter monitoring message SU_SW_DRDY" VALUE 0x191937 AblGLKWub_M 255 X1_M 0 255 FORMAT "%5.1" /end CHARACTERISTIC
/begin CHARACTERISTIC CANFA_ctMsgMonAlvTLT_RW_C "F2062: alive counter monitoring message TLT_RW" VALUE 0x191938 AblGLKWub_M 255 X1_M 0 255 FORMAT "%5.1" /end CHARACTERISTIC
/begin CHARACTERISTIC CANFA_ctMsgMonAlvTORQ_PT_HYB_1_C "F2062: alive counter monitoring message TORQ_PT_HYB_1" VALUE 0x191939 AblGLKWub_M 255 X1_M 0 255 FORMAT "%5.1" /end CHARACTERISTIC
/begin CHARACTERISTIC CANFA_ctMsgMonAlvVYAW_VEH_C "F2062: alive counter monitoring message VYAW_VEH" VALUE 0x19193A AblGLKWub_M 255 X1_M 0 255 FORMAT "%5.1" /end CHARACTERISTIC
/begin CHARACTERISTIC CANFA_ctMsgMonAlvV_VEH_C "F2062: alive counter monitoring message V_VEH" VALUE 0x19193B AblGLKWub_M 255 X1_M 0 255 FORMAT "%5.1" /end CHARACTERISTIC
/begin CHARACTERISTIC CANFA_ctMsgMonChkACLNX_MASSCNTR_C "F2062: checksum monitoring message ACLNX_MASSCNTR" VALUE 0x19193C AblGLKWub_M 255 X1_M 0 255 FORMAT "%5.1" /end CHARACTERISTIC
/begin CHARACTERISTIC CANFA_ctMsgMonChkACLNY_MASSCNTR_C "F2062: checksum monitoring message ACLNY_MASSCNTR" VALUE 0x19193D AblGLKWub_M 255 X1_M 0 255 FORMAT "%5.1" /end CHARACTERISTIC
/begin CHARACTERISTIC CANFA_ctMsgMonChkAVL_BRTORQ_SUM_C "F2062: checksum monitoring message AVL_BRTORQ_SUM" VALUE 0x19193E AblGLKWub_M 255 X1_M 0 255 FORMAT "%5.1" /end CHARACTERISTIC
/begin CHARACTERISTIC CANFA_ctMsgMonChkKLEMMEN_C "F2062: checksum monitoring message KLEMMEN" VALUE 0x19193F AblGLKWub_M 255 X1_M 0 255 FORMAT "%5.1" /end CHARACTERISTIC
/begin CHARACTERISTIC CANFA_ctMsgMonChkMASS_VEH_C "F2062: checksum monitoring message MASS_VEH" VALUE 0x191940 AblGLKWub_M 255 X1_M 0 255 FORMAT "%5.1" /end CHARACTERISTIC
/begin CHARACTERISTIC CANFA_ctMsgMonChkOP_SPD_C "F2062: checksum monitoring message OP_SPD" VALUE 0x191941 AblGLKWub_M 255 X1_M 0 255 FORMAT "%5.1" /end CHARACTERISTIC
/begin CHARACTERISTIC CANFA_ctMsgMonChkSTAT_DS_VRFD_C "F2062: checksum monitoring message STAT_DS_VRFD" VALUE 0x191942 AblGLKWub_M 255 X1_M 0 255 FORMAT "%5.1" /end CHARACTERISTIC
/begin CHARACTERISTIC CANFA_ctMsgMonChkST_BLT_CT_SOCCU_C "F2062: checksum monitoring message ST_BLT_CT_SOCCU" VALUE 0x191943 AblGLKWub_M 255 X1_M 0 255 FORMAT "%5.1" /end CHARACTERISTIC
/begin CHARACTERISTIC CANFA_ctMsgMonChkST_GWS_C "F2062: checksum monitoring message ST_GWS" VALUE 0x191944 AblGLKWub_M 255 X1_M 0 255 FORMAT "%5.1" /end CHARACTERISTIC
/begin CHARACTERISTIC CANFA_ctMsgMonChkST_STAB_DSC_C "F2062: checksum monitoring message ST_STAB_DSC" VALUE 0x191945 AblGLKWub_M 255 X1_M 0 255 FORMAT "%5.1" /end CHARACTERISTIC
/begin CHARACTERISTIC CANFA_ctMsgMonChkST_VEHSS_PBRK_C "F2062: checksum monitoring message ST_VEHSS_PBRK" VALUE 0x191946 AblGLKWub_M 255 X1_M 0 255 FORMAT "%5.1" /end CHARACTERISTIC
/begin CHARACTERISTIC CANFA_ctMsgMonChkST_VHSS_C "F2062: checksum monitoring message ST_VHSS" VALUE 0x191947 AblGLKWub_M 255 X1_M 0 255 FORMAT "%5.1" /end CHARACTERISTIC
/begin CHARACTERISTIC CANFA_ctMsgMonChkSU_SW_DRDY_C "F2062: checksum monitoring message SU_SW_DRDY" VALUE 0x191948 AblGLKWub_M 255 X1_M 0 255 FORMAT "%5.1" /end CHARACTERISTIC
/begin CHARACTERISTIC CANFA_ctMsgMonChkTLT_RW_C "F2062: checksum monitoring message TLT_RW" VALUE 0x191949 AblGLKWub_M 255 X1_M 0 255 FORMAT "%5.1" /end CHARACTERISTIC
/begin CHARACTERISTIC CANFA_ctMsgMonChkTORQ_PT_HYB_1_C "F2062: checksum monitoring message TORQ_PT_HYB_1" VALUE 0x19194A AblGLKWub_M 255 X1_M 0 255 FORMAT "%5.1" /end CHARACTERISTIC
/begin CHARACTERISTIC CANFA_ctMsgMonChkVYAW_VEH_C "F2062: checksum monitoring message VYAW_VEH" VALUE 0x19194B AblGLKWub_M 255 X1_M 0 255 FORMAT "%5.1" /end CHARACTERISTIC
/begin CHARACTERISTIC CANFA_ctMsgMonChkV_VEH_C "F2062: checksum monitoring message V_VEH" VALUE 0x19194C AblGLKWub_M 255 X1_M 0 255 FORMAT "%5.1" /end CHARACTERISTIC
/begin CHARACTERISTIC CANFA_ctMsgMonDlcACLNX_MASSCNTR_C "F2062: DLC monitoring message ACLNX_MASSCNTR" VALUE 0x19194D AblGLKWub_M 255 X1_M 0 255 FORMAT "%5.1" /end CHARACTERISTIC
/begin CHARACTERISTIC CANFA_ctMsgMonDlcACLNY_MASSCNTR_C "F2062: DLC monitoring message ACLNY_MASSCNTR" VALUE 0x19194E AblGLKWub_M 255 X1_M 0 255 FORMAT "%5.1" /end CHARACTERISTIC
/begin CHARACTERISTIC CANFA_ctMsgMonDlcAVL_BRTORQ_SUM_C "F2062: DLC monitoring message AVL_BRTORQ_SUM" VALUE 0x19194F AblGLKWub_M 255 X1_M 0 255 FORMAT "%5.1" /end CHARACTERISTIC
/begin CHARACTERISTIC CANFA_ctMsgMonDlcAVL_RPM_WHL_UPRT_C "F2062: DLC monitoring message AVL_RPM_WHL_UPRT" VALUE 0x191950 AblGLKWub_M 255 X1_M 0 255 FORMAT "%5.1" /end CHARACTERISTIC
/begin CHARACTERISTIC CANFA_ctMsgMonDlcA_TEMP_C "F2062: DLC monitoring message A_TEMP" VALUE 0x191951 AblGLKWub_M 255 X1_M 0 255 FORMAT "%5.1" /end CHARACTERISTIC
/begin CHARACTERISTIC CANFA_ctMsgMonDlcDIAG_OBD_ENG_C "F2062: DLC monitoring message DIAG_OBD_ENG" VALUE 0x191952 AblGLKWub_M 255 X1_M 0 255 FORMAT "%5.1" /end CHARACTERISTIC
/begin CHARACTERISTIC CANFA_ctMsgMonDlcFAHRGESTELLNUMMER_C "F2062: DLC monitoring message FAHRGESTELLNUMMER" VALUE 0x191953 AblGLKWub_M 255 X1_M 0 255 FORMAT "%5.1" /end CHARACTERISTIC
/begin CHARACTERISTIC CANFA_ctMsgMonDlcFLLUPT_GPWSUP_C "F2062: DLC monitoring message FLLUPT_GPWSUP" VALUE 0x191954 AblGLKWub_M 255 X1_M 0 255 FORMAT "%5.1" /end CHARACTERISTIC
/begin CHARACTERISTIC CANFA_ctMsgMonDlcFZZSTD_C "F2062: DLC monitoring message FZZSTD" VALUE 0x191955 AblGLKWub_M 255 X1_M 0 255 FORMAT "%5.1" /end CHARACTERISTIC
/begin CHARACTERISTIC CANFA_ctMsgMonDlcKILOMETERSTAND_C "F2062: DLC monitoring message KILOMETERSTAND" VALUE 0x191956 AblGLKWub_M 255 X1_M 0 255 FORMAT "%5.1" /end CHARACTERISTIC
/begin CHARACTERISTIC CANFA_ctMsgMonDlcKLEMMEN_C "F2062: DLC monitoring message KLEMMEN" VALUE 0x191957 AblGLKWub_M 255 X1_M 0 255 FORMAT "%5.1" /end CHARACTERISTIC
/begin CHARACTERISTIC CANFA_ctMsgMonDlcMASS_VEH_C "F2062: DLC monitoring message MASS_VEH" VALUE 0x191958 AblGLKWub_M 255 X1_M 0 255 FORMAT "%5.1" /end CHARACTERISTIC
/begin CHARACTERISTIC CANFA_ctMsgMonDlcOP_SPD_C "F2062: DLC monitoring message OP_SPD" VALUE 0x191959 AblGLKWub_M 255 X1_M 0 255 FORMAT "%5.1" /end CHARACTERISTIC
/begin CHARACTERISTIC CANFA_ctMsgMonDlcRELATIVZEIT_C "F2062: DLC monitoring message RELATIVZEIT" VALUE 0x19195A AblGLKWub_M 255 X1_M 0 255 FORMAT "%5.1" /end CHARACTERISTIC
/begin CHARACTERISTIC CANFA_ctMsgMonDlcSTAT_ANHAENGER_C "F2062: DLC monitoring message STAT_ANHAENGER" VALUE 0x19195B AblGLKWub_M 255 X1_M 0 255 FORMAT "%5.1" /end CHARACTERISTIC
/begin CHARACTERISTIC CANFA_ctMsgMonDlcSTAT_CT_HABR_C "F2062: DLC monitoring message STAT_CT_HABR" VALUE 0x19195C AblGLKWub_M 255 X1_M 0 255 FORMAT "%5.1" /end CHARACTERISTIC
/begin CHARACTERISTIC CANFA_ctMsgMonDlcSTAT_DS_VRFD_C "F2062: DLC monitoring message STAT_DS_VRFD" VALUE 0x19195D AblGLKWub_M 255 X1_M 0 255 FORMAT "%5.1" /end CHARACTERISTIC
/begin CHARACTERISTIC CANFA_ctMsgMonDlcSTAT_ZV_KLAPPEN_C "F2062: DLC monitoring message STAT_ZV_KLAPPEN" VALUE 0x19195E AblGLKWub_M 255 X1_M 0 255 FORMAT "%5.1" /end CHARACTERISTIC
/begin CHARACTERISTIC CANFA_ctMsgMonDlcSTEA_FTAX_EFFV_C "F2062: DLC monitoring message STEA_FTAX_EFFV" VALUE 0x19195F AblGLKWub_M 255 X1_M 0 255 FORMAT "%5.1" /end CHARACTERISTIC
/begin CHARACTERISTIC CANFA_ctMsgMonDlcST_BLT_CT_SOCCU_C "F2062: DLC monitoring message ST_BLT_CT_SOCCU" VALUE 0x191960 AblGLKWub_M 255 X1_M 0 255 FORMAT "%5.1" /end CHARACTERISTIC
/begin CHARACTERISTIC CANFA_ctMsgMonDlcST_DISP_DRDY_C "F2062: DLC monitoring message ST_DISP_DRDY" VALUE 0x191961 AblGLKWub_M 255 X1_M 0 255 FORMAT "%5.1" /end CHARACTERISTIC
/begin CHARACTERISTIC CANFA_ctMsgMonDlcST_GWS_C "F2062: DLC monitoring message ST_GWS" VALUE 0x191962 AblGLKWub_M 255 X1_M 0 255 FORMAT "%5.1" /end CHARACTERISTIC
/begin CHARACTERISTIC CANFA_ctMsgMonDlcST_STAB_DSC_C "F2062: DLC monitoring message ST_STAB_DSC" VALUE 0x191963 AblGLKWub_M 255 X1_M 0 255 FORMAT "%5.1" /end CHARACTERISTIC
/begin CHARACTERISTIC CANFA_ctMsgMonDlcST_STA_PWR_DRV_C "F2062: DLC monitoring message ST_STA_PWR_DRV" VALUE 0x191964 AblGLKWub_M 255 X1_M 0 255 FORMAT "%5.1" /end CHARACTERISTIC
/begin CHARACTERISTIC CANFA_ctMsgMonDlcST_VEHSS_PBRK_C "F2062: DLC monitoring message ST_VEHSS_PBRK" VALUE 0x191965 AblGLKWub_M 255 X1_M 0 255 FORMAT "%5.1" /end CHARACTERISTIC
/begin CHARACTERISTIC CANFA_ctMsgMonDlcST_VHSS_C "F2062: DLC monitoring message ST_VHSS" VALUE 0x191966 AblGLKWub_M 255 X1_M 0 255 FORMAT "%5.1" /end CHARACTERISTIC
/begin CHARACTERISTIC CANFA_ctMsgMonDlcSU_SW_DRDY_C "F2062: DLC monitoring message SU_SW_DRDY" VALUE 0x191967 AblGLKWub_M 255 X1_M 0 255 FORMAT "%5.1" /end CHARACTERISTIC
/begin CHARACTERISTIC CANFA_ctMsgMonDlcTLT_RW_C "F2062: DLC monitoring message TLT_RW" VALUE 0x191968 AblGLKWub_M 255 X1_M 0 255 FORMAT "%5.1" /end CHARACTERISTIC
/begin CHARACTERISTIC CANFA_ctMsgMonDlcTOMA_WHL_C "F2062: DLC monitoring message TOMA_WHL" VALUE 0x191969 AblGLKWub_M 255 X1_M 0 255 FORMAT "%5.1" /end CHARACTERISTIC
/begin CHARACTERISTIC CANFA_ctMsgMonDlcTORQ_PT_HYB_1_C "F2062: DLC monitoring message TORQ_PT_HYB_1" VALUE 0x19196A AblGLKWub_M 255 X1_M 0 255 FORMAT "%5.1" /end CHARACTERISTIC
/begin CHARACTERISTIC CANFA_ctMsgMonDlcVYAW_VEH_C "F2062: DLC monitoring message VYAW_VEH" VALUE 0x19196B AblGLKWub_M 255 X1_M 0 255 FORMAT "%5.1" /end CHARACTERISTIC
/begin CHARACTERISTIC CANFA_ctMsgMonDlcV_VEH_C "F2062: DLC monitoring message V_VEH" VALUE 0x19196C AblGLKWub_M 255 X1_M 0 255 FORMAT "%5.1" /end CHARACTERISTIC
/begin CHARACTERISTIC CANFA_swtMsgMonACLNX_MASSCNTR_C "F2062: activation monitoring message ACLNX_MASSCNTR" VALUE 0x19196D AblGLKWub_M 255 X1_M 0 255 FORMAT "%5.1" /end CHARACTERISTIC
/begin CHARACTERISTIC CANFA_swtMsgMonACLNY_MASSCNTR_C "F2062: activation monitoring message ACLNY_MASSCNTR" VALUE 0x19196E AblGLKWub_M 255 X1_M 0 255 FORMAT "%5.1" /end CHARACTERISTIC
/begin CHARACTERISTIC CANFA_swtMsgMonAVL_BRTORQ_SUM_C "F2062: activation monitoring message AVL_BRTORQ_SUM" VALUE 0x19196F AblGLKWub_M 255 X1_M 0 255 FORMAT "%5.1" /end CHARACTERISTIC
/begin CHARACTERISTIC CANFA_swtMsgMonAVL_RPM_WHL_UPRT_C "F2062: activation monitoring message AVL_RPM_WHL_UPRT" VALUE 0x191970 AblGLKWub_M 255 X1_M 0 255 FORMAT "%5.1" /end CHARACTERISTIC
/begin CHARACTERISTIC CANFA_swtMsgMonA_TEMP_C "F2062: activation monitoring message A_TEMP" VALUE 0x191971 AblGLKWub_M 255 X1_M 0 255 FORMAT "%5.1" /end CHARACTERISTIC
/begin CHARACTERISTIC CANFA_swtMsgMonDIAG_OBD_ENG_C "F2062: activation monitoring message DIAG_OBD_ENG" VALUE 0x191972 AblGLKWub_M 255 X1_M 0 255 FORMAT "%5.1" /end CHARACTERISTIC
/begin CHARACTERISTIC CANFA_swtMsgMonDT_DISP_GRDT_RX_C "F2062: activation monitoring message DT_DISP_GRDT_RX" VALUE 0x191973 AblGLKWub_M 255 X1_M 0 255 FORMAT "%5.1" /end CHARACTERISTIC
/begin CHARACTERISTIC CANFA_swtMsgMonFAHRGESTELLNUMMER_C "F2062: activation monitoring message FAHRGESTELLNUMMER" VALUE 0x191974 AblGLKWub_M 255 X1_M 0 255 FORMAT "%5.1" /end CHARACTERISTIC
/begin CHARACTERISTIC CANFA_swtMsgMonFLLUPT_GPWSUP_C "F2062: activation monitoring message FLLUPT_GPWSUP" VALUE 0x191975 AblGLKWub_M 255 X1_M 0 255 FORMAT "%5.1" /end CHARACTERISTIC
/begin CHARACTERISTIC CANFA_swtMsgMonFZZSTD_C "F2062: activation monitoring message FZZSTD" VALUE 0x191976 AblGLKWub_M 255 X1_M 0 255 FORMAT "%5.1" /end CHARACTERISTIC
/begin CHARACTERISTIC CANFA_swtMsgMonKILOMETERSTAND_C "F2062: activation monitoring message KILOMETERSTAND" VALUE 0x191977 AblGLKWub_M 255 X1_M 0 255 FORMAT "%5.1" /end CHARACTERISTIC
/begin CHARACTERISTIC CANFA_swtMsgMonKLEMMEN_C "F2062: activation monitoring message KLEMMEN" VALUE 0x191978 AblGLKWub_M 255 X1_M 0 255 FORMAT "%5.1" /end CHARACTERISTIC
/begin CHARACTERISTIC CANFA_swtMsgMonMASS_VEH_C "F2062: activation monitoring message MASS_VEH" VALUE 0x191979 AblGLKWub_M 255 X1_M 0 255 FORMAT "%5.1" /end CHARACTERISTIC
/begin CHARACTERISTIC CANFA_swtMsgMonOP_SPD_C "F2062: activation monitoring message OP_SPD" VALUE 0x19197A AblGLKWub_M 255 X1_M 0 255 FORMAT "%5.1" /end CHARACTERISTIC
/begin CHARACTERISTIC CANFA_swtMsgMonRELATIVZEIT_C "F2062: activation monitoring message RELATIVZEIT" VALUE 0x19197B AblGLKWub_M 255 X1_M 0 255 FORMAT "%5.1" /end CHARACTERISTIC
/begin CHARACTERISTIC CANFA_swtMsgMonSTAT_ANHAENGER_C "F2062: activation monitoring message STAT_ANHAENGER" VALUE 0x19197C AblGLKWub_M 255 X1_M 0 255 FORMAT "%5.1" /end CHARACTERISTIC
/begin CHARACTERISTIC CANFA_swtMsgMonSTAT_CT_HABR_C "F2062: activation monitoring message STAT_CT_HABR" VALUE 0x19197D AblGLKWub_M 255 X1_M 0 255 FORMAT "%5.1" /end CHARACTERISTIC
/begin CHARACTERISTIC CANFA_swtMsgMonSTAT_DS_VRFD_C "F2062: activation monitoring message STAT_DS_VRFD" VALUE 0x19197E AblGLKWub_M 255 X1_M 0 255 FORMAT "%5.1" /end CHARACTERISTIC
/begin CHARACTERISTIC CANFA_swtMsgMonSTAT_ZV_KLAPPEN_C "F2062: activation monitoring message STAT_ZV_KLAPPEN" VALUE 0x19197F AblGLKWub_M 255 X1_M 0 255 FORMAT "%5.1" /end CHARACTERISTIC
/begin CHARACTERISTIC CANFA_swtMsgMonSTEA_FTAX_EFFV_C "F2062: activation monitoring message STEA_FTAX_EFFV" VALUE 0x191980 AblGLKWub_M 255 X1_M 0 255 FORMAT "%5.1" /end CHARACTERISTIC
/begin CHARACTERISTIC CANFA_swtMsgMonST_BLT_CT_SOCCU_C "F2062: activation monitoring message ST_BLT_CT_SOCCU" VALUE 0x191981 AblGLKWub_M 255 X1_M 0 255 FORMAT "%5.1" /end CHARACTERISTIC
/begin CHARACTERISTIC CANFA_swtMsgMonST_DISP_DRDY_C "F2062: activation monitoring message ST_DISP_DRDY" VALUE 0x191982 AblGLKWub_M 255 X1_M 0 255 FORMAT "%5.1" /end CHARACTERISTIC
/begin CHARACTERISTIC CANFA_swtMsgMonST_GRB_ECU_RX_C "F2062: activation monitoring message ST_GRB_ECU_RX" VALUE 0x191983 AblGLKWub_M 255 X1_M 0 255 FORMAT "%5.1" /end CHARACTERISTIC
/begin CHARACTERISTIC CANFA_swtMsgMonST_GWS_C "F2062: activation monitoring message ST_GWS" VALUE 0x191984 AblGLKWub_M 255 X1_M 0 255 FORMAT "%5.1" /end CHARACTERISTIC
/begin CHARACTERISTIC CANFA_swtMsgMonST_STAB_DSC_C "F2062: activation monitoring message ST_STAB_DSC" VALUE 0x191985 AblGLKWub_M 255 X1_M 0 255 FORMAT "%5.1" /end CHARACTERISTIC
/begin CHARACTERISTIC CANFA_swtMsgMonST_STA_PWR_DRV_C "F2062: activation monitoring message ST_STA_PWR_DRV" VALUE 0x191986 AblGLKWub_M 255 X1_M 0 255 FORMAT "%5.1" /end CHARACTERISTIC
/begin CHARACTERISTIC CANFA_swtMsgMonST_VEHSS_PBRK_C "F2062: activation monitoring message ST_VEHSS_PBRK" VALUE 0x191987 AblGLKWub_M 255 X1_M 0 255 FORMAT "%5.1" /end CHARACTERISTIC
/begin CHARACTERISTIC CANFA_swtMsgMonST_VHSS_C "F2062: activation monitoring message ST_VHSS" VALUE 0x191988 AblGLKWub_M 255 X1_M 0 255 FORMAT "%5.1" /end CHARACTERISTIC
/begin CHARACTERISTIC CANFA_swtMsgMonSU_SW_DRDY_C "F2062: activation monitoring message SU_SW_DRDY" VALUE 0x191989 AblGLKWub_M 255 X1_M 0 255 FORMAT "%5.1" /end CHARACTERISTIC
/begin CHARACTERISTIC CANFA_swtMsgMonTAR_DT_GRB_MOT_1_RX_C "F2062: activation monitoring message TAR_DT_GRB_MOT_1_RX" VALUE 0x19198A AblGLKWub_M 255 X1_M 0 255 FORMAT "%5.1" /end CHARACTERISTIC
/begin CHARACTERISTIC CANFA_swtMsgMonTLT_RW_C "F2062: activation monitoring message TLT_RW" VALUE 0x19198B AblGLKWub_M 255 X1_M 0 255 FORMAT "%5.1" /end CHARACTERISTIC
/begin CHARACTERISTIC CANFA_swtMsgMonTOMA_WHL_C "F2062: activation monitoring message TOMA_WHL" VALUE 0x19198C AblGLKWub_M 255 X1_M 0 255 FORMAT "%5.1" /end CHARACTERISTIC
/begin CHARACTERISTIC CANFA_swtMsgMonTORQ_GRB_HYB_RX_C "F2062: activation monitoring message TORQ_GRB_HYB_RX" VALUE 0x19198D AblGLKWub_M 255 X1_M 0 255 FORMAT "%5.1" /end CHARACTERISTIC
/begin CHARACTERISTIC CANFA_swtMsgMonTORQ_PT_HYB_1_C "F2062: activation monitoring message TORQ_PT_HYB_1" VALUE 0x19198E AblGLKWub_M 255 X1_M 0 255 FORMAT "%5.1" /end CHARACTERISTIC
/begin CHARACTERISTIC CANFA_swtMsgMonVYAW_VEH_C "F2062: activation monitoring message VYAW_VEH" VALUE 0x19198F AblGLKWub_M 255 X1_M 0 255 FORMAT "%5.1" /end CHARACTERISTIC
/begin CHARACTERISTIC CANFA_swtMsgMonV_VEH_C "F2062: activation monitoring message V_VEH" VALUE 0x191990 AblGLKWub_M 255 X1_M 0 255 FORMAT "%5.1" /end CHARACTERISTIC
/begin CHARACTERISTIC CANFA_swtMsgSlw_ST_BLT_CT_SOCCU_C "F2070: Raster selection for message ST_BLT_CT_SOCCU. 0: 200ms, 1: 1000ms." VALUE 0x1918D3 AblGLKWub_M 255 X1_M 0 255 FORMAT "%5.1" /end CHARACTERISTIC
/begin MEASUREMENT CAN_ANG_ACPD " F2062: CAN_ANG_ACPD (internal only)" UBYTE X1_M 1 100 0 255 ECU_ADDRESS 0xFFF84570 FORMAT "%5.1" MATRIX_DIM 15 1 1 /end MEASUREMENT
/begin MEASUREMENT CAN_ANG_ACPD_COMP " F2062: CAN_ANG_ACPD complement buffer" UBYTE X1_M 1 100 0 255 ECU_ADDRESS 0xFFF9256C FORMAT "%5.1" MATRIX_DIM 8 1 1 /end MEASUREMENT
/begin MEASUREMENT CAN_ANG_ACPD_COMPSTA " F2062: CAN_ANG_ACPD_COMPSTA (internal only)" UBYTE X1_M 1 100 0 255 ECU_ADDRESS 0xFFF84568 FORMAT "%5.1" MATRIX_DIM 7 1 1 /end MEASUREMENT
/begin MEASUREMENT CAN_ANG_ACPD_DATA " F2062: CAN_ANG_ACPD valid buffer" UBYTE X1_M 1 100 0 255 ECU_ADDRESS 0xFFF84560 FORMAT "%5.1" MATRIX_DIM 8 1 1 /end MEASUREMENT
/begin MEASUREMENT CAN_ANG_ACPD_RAW " F2062: CAN_ANG_ACPD raw buffer" UBYTE X1_M 1 100 0 255 ECU_ADDRESS 0xFFF92564 FORMAT "%5.1" MATRIX_DIM 8 1 1 /end MEASUREMENT
/begin MEASUREMENT CAN_AVL_DT_MOT_1 " F2062: CAN_AVL_DT_MOT_1 (internal only)" UBYTE X1_M 1 100 0 255 ECU_ADDRESS 0xFFF84590 FORMAT "%5.1" MATRIX_DIM 15 1 1 /end MEASUREMENT
/begin MEASUREMENT CAN_AVL_DT_MOT_1_COMP " F2062: CAN_AVL_DT_MOT_1 complement buffer" UBYTE X1_M 1 100 0 255 ECU_ADDRESS 0xFFF9257C FORMAT "%5.1" MATRIX_DIM 8 1 1 /end MEASUREMENT
/begin MEASUREMENT CAN_AVL_DT_MOT_1_COMPSTA " F2062: CAN_AVL_DT_MOT_1_COMPSTA (internal only)" UBYTE X1_M 1 100 0 255 ECU_ADDRESS 0xFFF84588 FORMAT "%5.1" MATRIX_DIM 7 1 1 /end MEASUREMENT
/begin MEASUREMENT CAN_AVL_DT_MOT_1_DATA " F2062: CAN_AVL_DT_MOT_1 valid buffer" UBYTE X1_M 1 100 0 255 ECU_ADDRESS 0xFFF84580 FORMAT "%5.1" MATRIX_DIM 8 1 1 /end MEASUREMENT
/begin MEASUREMENT CAN_AVL_DT_MOT_1_LT " F2062: CAN_AVL_DT_MOT_1_LT (internal only)" UBYTE X1_M 1 100 0 255 ECU_ADDRESS 0xFFF845A8 FORMAT "%5.1" MATRIX_DIM 15 1 1 /end MEASUREMENT
/begin MEASUREMENT CAN_AVL_DT_MOT_1_LT_DATA " F2062: CAN_AVL_DT_MOT_1_LT valid buffer" UBYTE X1_M 1 100 0 255 ECU_ADDRESS 0xFFF845A0 FORMAT "%5.1" MATRIX_DIM 8 1 1 /end MEASUREMENT
/begin MEASUREMENT CAN_AVL_DT_MOT_1_LT_RAW " F2062: CAN_AVL_DT_MOT_1_LT raw buffer" UBYTE X1_M 1 100 0 255 ECU_ADDRESS 0xFFF92584 FORMAT "%5.1" MATRIX_DIM 8 1 1 /end MEASUREMENT
/begin MEASUREMENT CAN_AVL_DT_MOT_1_RAW " F2062: CAN_AVL_DT_MOT_1 raw buffer" UBYTE X1_M 1 100 0 255 ECU_ADDRESS 0xFFF92574 FORMAT "%5.1" MATRIX_DIM 8 1 1 /end MEASUREMENT
/begin MEASUREMENT CAN_DIAG_OBD_ENG " F2062: CAN_DIAG_OBD_ENG (internal only)" UBYTE X1_M 1 100 0 255 ECU_ADDRESS 0xFFF845C0 FORMAT "%5.1" MATRIX_DIM 15 1 1 /end MEASUREMENT
/begin MEASUREMENT CAN_DIAG_OBD_ENG_DATA " F2062: CAN_DIAG_OBD_ENG valid buffer" UBYTE X1_M 1 100 0 255 ECU_ADDRESS 0xFFF845B8 FORMAT "%5.1" MATRIX_DIM 8 1 1 /end MEASUREMENT
/begin MEASUREMENT CAN_DIAG_OBD_ENG_RAW " F2062: CAN_DIAG_OBD_ENG raw buffer" UBYTE X1_M 1 100 0 255 ECU_ADDRESS 0xFFF9258C FORMAT "%5.1" MATRIX_DIM 8 1 1 /end MEASUREMENT
/begin MEASUREMENT CAN_DIAG_OBD_GRB " F2062: CAN_DIAG_OBD_GRB (internal only)" UBYTE X1_M 1 100 0 255 ECU_ADDRESS 0xFFF84778 FORMAT "%5.1" MATRIX_DIM 15 1 1 /end MEASUREMENT
/begin MEASUREMENT CAN_DIAG_OBD_GRB_DATA " F2062: CAN_DIAG_OBD_GRB valid buffer" UBYTE X1_M 1 100 0 255 ECU_ADDRESS 0xFFF84768 FORMAT "%5.1" MATRIX_DIM 8 1 1 /end MEASUREMENT
/begin MEASUREMENT CAN_DISP_RPM_ENG_DYNS " F2062: CAN_DISP_RPM_ENG_DYNS (internal only)" UBYTE X1_M 1 100 0 255 ECU_ADDRESS 0xFFF84790 FORMAT "%5.1" MATRIX_DIM 15 1 1 /end MEASUREMENT
/begin MEASUREMENT CAN_DISP_RPM_ENG_DYNS_DATA " F2062: CAN_DISP_RPM_ENG_DYNS valid buffer" UBYTE X1_M 1 100 0 255 ECU_ADDRESS 0xFFF84788 FORMAT "%5.1" MATRIX_DIM 8 1 1 /end MEASUREMENT
/begin MEASUREMENT CAN_DT_DISP_GRDT " F2062: CAN_DT_DISP_GRDT (internal only)" UBYTE X1_M 1 100 0 255 ECU_ADDRESS 0xFFF847D0 FORMAT "%5.1" MATRIX_DIM 15 1 1 /end MEASUREMENT
/begin MEASUREMENT CAN_DT_DISP_GRDT_COMP " F2062: CAN_DT_DISP_GRDT complement buffer" UBYTE X1_M 1 100 0 255 ECU_ADDRESS 0xFFF92644 FORMAT "%5.1" MATRIX_DIM 8 1 1 /end MEASUREMENT
/begin MEASUREMENT CAN_DT_DISP_GRDT_DATA " F2062: CAN_DT_DISP_GRDT valid buffer" UBYTE X1_M 1 100 0 255 ECU_ADDRESS 0xFFF847C0 FORMAT "%5.1" MATRIX_DIM 8 1 1 /end MEASUREMENT
/begin MEASUREMENT CAN_DT_DISP_GRDT_RX " F2062: CAN_DT_DISP_GRDT_RX (internal only)" UBYTE X1_M 1 100 0 255 ECU_ADDRESS 0xFFF847B0 FORMAT "%5.1" MATRIX_DIM 15 1 1 /end MEASUREMENT
/begin MEASUREMENT CAN_DT_DISP_GRDT_RX_COMP " F2062: CAN_DT_DISP_GRDT_RX complement buffer" UBYTE X1_M 1 100 0 255 ECU_ADDRESS 0xFFF9263C FORMAT "%5.1" MATRIX_DIM 8 1 1 /end MEASUREMENT
/begin MEASUREMENT CAN_DT_DISP_GRDT_RX_DATA " F2062: CAN_DT_DISP_GRDT_RX valid buffer" UBYTE X1_M 1 100 0 255 ECU_ADDRESS 0xFFF847A0 FORMAT "%5.1" MATRIX_DIM 8 1 1 /end MEASUREMENT
/begin MEASUREMENT CAN_DT_DISP_GRDT_RX_RAW " F2062: CAN_DT_DISP_GRDT_RX raw buffer" UBYTE X1_M 1 100 0 255 ECU_ADDRESS 0xFFF847A8 FORMAT "%5.1" MATRIX_DIM 8 1 1 /end MEASUREMENT
/begin MEASUREMENT CAN_DT_DRV_EL " F2062: CAN_DT_DRV_EL (internal only)" UBYTE X1_M 1 100 0 255 ECU_ADDRESS 0xFFF845D8 FORMAT "%5.1" MATRIX_DIM 15 1 1 /end MEASUREMENT
/begin MEASUREMENT CAN_DT_DRV_EL_DATA " F2062: CAN_DT_DRV_EL valid buffer" UBYTE X1_M 1 100 0 255 ECU_ADDRESS 0xFFF845D0 FORMAT "%5.1" MATRIX_DIM 8 1 1 /end MEASUREMENT
/begin MEASUREMENT CAN_DT_DRV_EL_RAW " F2062: CAN_DT_DRV_EL raw buffer" UBYTE X1_M 1 100 0 255 ECU_ADDRESS 0xFFF92594 FORMAT "%5.1" MATRIX_DIM 8 1 1 /end MEASUREMENT
/begin MEASUREMENT CAN_DT_GRDT " F2062: CAN_DT_GRDT (internal only)" UBYTE X1_M 1 100 0 255 ECU_ADDRESS 0xFFF84800 FORMAT "%5.1" MATRIX_DIM 15 1 1 /end MEASUREMENT
/begin MEASUREMENT CAN_DT_GRDT_COMP " F2062: CAN_DT_GRDT complement buffer" UBYTE X1_M 1 100 0 255 ECU_ADDRESS 0xFFF9265C FORMAT "%5.1" MATRIX_DIM 8 1 1 /end MEASUREMENT
/begin MEASUREMENT CAN_DT_GRDT_DATA " F2062: CAN_DT_GRDT valid buffer" UBYTE X1_M 1 100 0 255 ECU_ADDRESS 0xFFF847F8 FORMAT "%5.1" MATRIX_DIM 8 1 1 /end MEASUREMENT
/begin MEASUREMENT CAN_DT_GRDT_RX " F2062: CAN_DT_GRDT_RX (internal only)" UBYTE X1_M 1 100 0 255 ECU_ADDRESS 0xFFF847E8 FORMAT "%5.1" MATRIX_DIM 15 1 1 /end MEASUREMENT
/begin MEASUREMENT CAN_DT_GRDT_RX_COMP " F2062: CAN_DT_GRDT_RX complement buffer" UBYTE X1_M 1 100 0 255 ECU_ADDRESS 0xFFF92654 FORMAT "%5.1" MATRIX_DIM 8 1 1 /end MEASUREMENT
/begin MEASUREMENT CAN_DT_GRDT_RX_DATA " F2062: CAN_DT_GRDT_RX valid buffer" UBYTE X1_M 1 100 0 255 ECU_ADDRESS 0xFFF847E0 FORMAT "%5.1" MATRIX_DIM 8 1 1 /end MEASUREMENT
/begin MEASUREMENT CAN_DT_GRDT_RX_RAW " F2062: CAN_DT_GRDT_RX raw buffer" UBYTE X1_M 1 100 0 255 ECU_ADDRESS 0xFFF9264C FORMAT "%5.1" MATRIX_DIM 8 1 1 /end MEASUREMENT
/begin MEASUREMENT CAN_DT_PT_1 " F2062: CAN_DT_PT_1 (internal only)" UBYTE X1_M 1 100 0 255 ECU_ADDRESS 0xFFF845F0 FORMAT "%5.1" MATRIX_DIM 15 1 1 /end MEASUREMENT
/begin MEASUREMENT CAN_DT_PT_1_DATA " F2062: CAN_DT_PT_1 valid buffer" UBYTE X1_M 1 100 0 255 ECU_ADDRESS 0xFFF845E8 FORMAT "%5.1" MATRIX_DIM 8 1 1 /end MEASUREMENT
/begin MEASUREMENT CAN_DT_PT_1_RAW " F2062: CAN_DT_PT_1 raw buffer" UBYTE X1_M 1 100 0 255 ECU_ADDRESS 0xFFF9259C FORMAT "%5.1" MATRIX_DIM 8 1 1 /end MEASUREMENT
/begin MEASUREMENT CAN_DT_PT_2 " F2062: CAN_DT_PT_2 (internal only)" UBYTE X1_M 1 100 0 255 ECU_ADDRESS 0xFFF84610 FORMAT "%5.1" MATRIX_DIM 15 1 1 /end MEASUREMENT
/begin MEASUREMENT CAN_DT_PT_2_COMP " F2062: CAN_DT_PT_2 complement buffer" UBYTE X1_M 1 100 0 255 ECU_ADDRESS 0xFFF925AC FORMAT "%5.1" MATRIX_DIM 8 1 1 /end MEASUREMENT
/begin MEASUREMENT CAN_DT_PT_2_COMPSTA " F2062: CAN_DT_PT_2_COMPSTA (internal only)" UBYTE X1_M 1 100 0 255 ECU_ADDRESS 0xFFF84608 FORMAT "%5.1" MATRIX_DIM 7 1 1 /end MEASUREMENT
/begin MEASUREMENT CAN_DT_PT_2_DATA " F2062: CAN_DT_PT_2 valid buffer" UBYTE X1_M 1 100 0 255 ECU_ADDRESS 0xFFF84600 FORMAT "%5.1" MATRIX_DIM 8 1 1 /end MEASUREMENT
/begin MEASUREMENT CAN_DT_PT_2_RAW " F2062: CAN_DT_PT_2 raw buffer" UBYTE X1_M 1 100 0 255 ECU_ADDRESS 0xFFF925A4 FORMAT "%5.1" MATRIX_DIM 8 1 1 /end MEASUREMENT
/begin MEASUREMENT CAN_FLLUPT_GPWSUP " F2062: CAN_FLLUPT_GPWSUP (internal only)" UBYTE X1_M 1 100 0 255 ECU_ADDRESS 0xFFF84628 FORMAT "%5.1" MATRIX_DIM 15 1 1 /end MEASUREMENT
/begin MEASUREMENT CAN_FLLUPT_GPWSUP_DATA " F2062: CAN_FLLUPT_GPWSUP valid buffer" UBYTE X1_M 1 100 0 255 ECU_ADDRESS 0xFFF84620 FORMAT "%5.1" MATRIX_DIM 8 1 1 /end MEASUREMENT
/begin MEASUREMENT CAN_FLLUPT_GPWSUP_RAW " F2062: CAN_FLLUPT_GPWSUP raw buffer" UBYTE X1_M 1 100 0 255 ECU_ADDRESS 0xFFF925B4 FORMAT "%5.1" MATRIX_DIM 8 1 1 /end MEASUREMENT
/begin MEASUREMENT CAN_HYB_SPEC " F2062: CAN_HYB_SPEC (internal only)" UBYTE X1_M 1 100 0 255 ECU_ADDRESS 0xFFF84648 FORMAT "%5.1" MATRIX_DIM 15 1 1 /end MEASUREMENT
/begin MEASUREMENT CAN_HYB_SPEC_COMP " F2062: CAN_HYB_SPEC complement buffer" UBYTE X1_M 1 100 0 255 ECU_ADDRESS 0xFFF925C4 FORMAT "%5.1" MATRIX_DIM 8 1 1 /end MEASUREMENT
/begin MEASUREMENT CAN_HYB_SPEC_COMPSTA " F2062: CAN_HYB_SPEC_COMPSTA (internal only)" UBYTE X1_M 1 100 0 255 ECU_ADDRESS 0xFFF84640 FORMAT "%5.1" MATRIX_DIM 7 1 1 /end MEASUREMENT
/begin MEASUREMENT CAN_HYB_SPEC_DATA " F2062: CAN_HYB_SPEC valid buffer" UBYTE X1_M 1 100 0 255 ECU_ADDRESS 0xFFF84638 FORMAT "%5.1" MATRIX_DIM 8 1 1 /end MEASUREMENT
/begin MEASUREMENT CAN_HYB_SPEC_RAW " F2062: CAN_HYB_SPEC raw buffer" UBYTE X1_M 1 100 0 255 ECU_ADDRESS 0xFFF925BC FORMAT "%5.1" MATRIX_DIM 8 1 1 /end MEASUREMENT
/begin MEASUREMENT CAN_RQ_TORQ_CRSH_GRB " F2062: CAN_RQ_TORQ_CRSH_GRB (internal only)" UBYTE X1_M 1 100 0 255 ECU_ADDRESS 0xFFF84830 FORMAT "%5.1" MATRIX_DIM 15 1 1 /end MEASUREMENT
/begin MEASUREMENT CAN_RQ_TORQ_CRSH_GRB_2 " F2062: CAN_RQ_TORQ_CRSH_GRB_2 (internal only)" UBYTE X1_M 1 100 0 255 ECU_ADDRESS 0xFFF84848 FORMAT "%5.1" MATRIX_DIM 15 1 1 /end MEASUREMENT
/begin MEASUREMENT CAN_RQ_TORQ_CRSH_GRB_2_DATA " F2062: CAN_RQ_TORQ_CRSH_GRB_2 valid buffer" UBYTE X1_M 1 100 0 255 ECU_ADDRESS 0xFFF84840 FORMAT "%5.1" MATRIX_DIM 8 1 1 /end MEASUREMENT
/begin MEASUREMENT CAN_RQ_TORQ_CRSH_GRB_COMP " F2062: CAN_RQ_TORQ_CRSH_GRB complement buffer" UBYTE X1_M 1 100 0 255 ECU_ADDRESS 0xFFF92674 FORMAT "%5.1" MATRIX_DIM 8 1 1 /end MEASUREMENT
/begin MEASUREMENT CAN_RQ_TORQ_CRSH_GRB_DATA " F2062: CAN_RQ_TORQ_CRSH_GRB valid buffer" UBYTE X1_M 1 100 0 255 ECU_ADDRESS 0xFFF84828 FORMAT "%5.1" MATRIX_DIM 8 1 1 /end MEASUREMENT
/begin MEASUREMENT CAN_RQ_TORQ_CRSH_GRB_RX " F2062: CAN_RQ_TORQ_CRSH_GRB_RX (internal only)" UBYTE X1_M 1 100 0 255 ECU_ADDRESS 0xFFF84818 FORMAT "%5.1" MATRIX_DIM 15 1 1 /end MEASUREMENT
/begin MEASUREMENT CAN_RQ_TORQ_CRSH_GRB_RX_COMP " F2062: CAN_RQ_TORQ_CRSH_GRB_RX complement buffer" UBYTE X1_M 1 100 0 255 ECU_ADDRESS 0xFFF9266C FORMAT "%5.1" MATRIX_DIM 8 1 1 /end MEASUREMENT
/begin MEASUREMENT CAN_RQ_TORQ_CRSH_GRB_RX_DATA " F2062: CAN_RQ_TORQ_CRSH_GRB_RX valid buffer" UBYTE X1_M 1 100 0 255 ECU_ADDRESS 0xFFF84810 FORMAT "%5.1" MATRIX_DIM 8 1 1 /end MEASUREMENT
/begin MEASUREMENT CAN_RQ_TORQ_CRSH_GRB_RX_RAW " F2062: CAN_RQ_TORQ_CRSH_GRB_RX raw buffer" UBYTE X1_M 1 100 0 255 ECU_ADDRESS 0xFFF92664 FORMAT "%5.1" MATRIX_DIM 8 1 1 /end MEASUREMENT
/begin MEASUREMENT CAN_SPEC_HVSTO " F2062: CAN_SPEC_HVSTO (internal only)" UBYTE X1_M 1 100 0 255 ECU_ADDRESS 0xFFF84660 FORMAT "%5.1" MATRIX_DIM 15 1 1 /end MEASUREMENT
/begin MEASUREMENT CAN_SPEC_HVSTO_DATA " F2062: CAN_SPEC_HVSTO valid buffer" UBYTE X1_M 1 100 0 255 ECU_ADDRESS 0xFFF84658 FORMAT "%5.1" MATRIX_DIM 8 1 1 /end MEASUREMENT
/begin MEASUREMENT CAN_SPEC_HVSTO_RAW " F2062: CAN_SPEC_HVSTO raw buffer" UBYTE X1_M 1 100 0 255 ECU_ADDRESS 0xFFF925CC FORMAT "%5.1" MATRIX_DIM 8 1 1 /end MEASUREMENT
/begin MEASUREMENT CAN_STAT_ENG_STA_AUTO " F2062: CAN_STAT_ENG_STA_AUTO (internal only)" UBYTE X1_M 1 100 0 255 ECU_ADDRESS 0xFFF846A0 FORMAT "%5.1" MATRIX_DIM 15 1 1 /end MEASUREMENT
/begin MEASUREMENT CAN_STAT_ENG_STA_AUTO_COMP " F2062: CAN_STAT_ENG_STA_AUTO complement buffer" UBYTE X1_M 1 100 0 255 ECU_ADDRESS 0xFFF925EC FORMAT "%5.1" MATRIX_DIM 8 1 1 /end MEASUREMENT
/begin MEASUREMENT CAN_STAT_ENG_STA_AUTO_COMPSTA " F2062: CAN_STAT_ENG_STA_AUTO_COMPSTA (internal only)" UBYTE X1_M 1 100 0 255 ECU_ADDRESS 0xFFF84698 FORMAT "%5.1" MATRIX_DIM 7 1 1 /end MEASUREMENT
/begin MEASUREMENT CAN_STAT_ENG_STA_AUTO_DATA " F2062: CAN_STAT_ENG_STA_AUTO valid buffer" UBYTE X1_M 1 100 0 255 ECU_ADDRESS 0xFFF84690 FORMAT "%5.1" MATRIX_DIM 8 1 1 /end MEASUREMENT
/begin MEASUREMENT CAN_STAT_ENG_STA_AUTO_RAW " F2062: CAN_STAT_ENG_STA_AUTO raw buffer" UBYTE X1_M 1 100 0 255 ECU_ADDRESS 0xFFF925E4 FORMAT "%5.1" MATRIX_DIM 8 1 1 /end MEASUREMENT
/begin MEASUREMENT CAN_STAT_HVSTO_2 " F2062: CAN_STAT_HVSTO_2 (internal only)" UBYTE X1_M 1 100 0 255 ECU_ADDRESS 0xFFF846B8 FORMAT "%5.1" MATRIX_DIM 15 1 1 /end MEASUREMENT
/begin MEASUREMENT CAN_STAT_HVSTO_2_DATA " F2062: CAN_STAT_HVSTO_2 valid buffer" UBYTE X1_M 1 100 0 255 ECU_ADDRESS 0xFFF846B0 FORMAT "%5.1" MATRIX_DIM 8 1 1 /end MEASUREMENT
/begin MEASUREMENT CAN_STAT_HVSTO_2_RAW " F2062: CAN_STAT_HVSTO_2 raw buffer" UBYTE X1_M 1 100 0 255 ECU_ADDRESS 0xFFF925F4 FORMAT "%5.1" MATRIX_DIM 8 1 1 /end MEASUREMENT
/begin MEASUREMENT CAN_ST_GRB_ECU " F2062: CAN_ST_GRB_ECU (internal only)" UBYTE X1_M 1 100 0 255 ECU_ADDRESS 0xFFF84888 FORMAT "%5.1" MATRIX_DIM 15 1 1 /end MEASUREMENT
/begin MEASUREMENT CAN_ST_GRB_ECU_COMP " F2062: CAN_ST_GRB_ECU complement buffer" UBYTE X1_M 1 100 0 255 ECU_ADDRESS 0xFFF92684 FORMAT "%5.1" MATRIX_DIM 8 1 1 /end MEASUREMENT
/begin MEASUREMENT CAN_ST_GRB_ECU_DATA " F2062: CAN_ST_GRB_ECU valid buffer" UBYTE X1_M 1 100 0 255 ECU_ADDRESS 0xFFF84878 FORMAT "%5.1" MATRIX_DIM 8 1 1 /end MEASUREMENT
/begin MEASUREMENT CAN_ST_GRB_ECU_RX " F2062: CAN_ST_GRB_ECU_RX (internal only)" UBYTE X1_M 1 100 0 255 ECU_ADDRESS 0xFFF84868 FORMAT "%5.1" MATRIX_DIM 15 1 1 /end MEASUREMENT
/begin MEASUREMENT CAN_ST_GRB_ECU_RX_COMP " F2062: CAN_ST_GRB_ECU_RX complement buffer" UBYTE X1_M 1 100 0 255 ECU_ADDRESS 0xFFF9267C FORMAT "%5.1" MATRIX_DIM 8 1 1 /end MEASUREMENT
/begin MEASUREMENT CAN_ST_GRB_ECU_RX_DATA " F2062: CAN_ST_GRB_ECU_RX valid buffer" UBYTE X1_M 1 100 0 255 ECU_ADDRESS 0xFFF84858 FORMAT "%5.1" MATRIX_DIM 8 1 1 /end MEASUREMENT
/begin MEASUREMENT CAN_ST_GRB_ECU_RX_RAW " F2062: CAN_ST_GRB_ECU_RX raw buffer" UBYTE X1_M 1 100 0 255 ECU_ADDRESS 0xFFF84860 FORMAT "%5.1" MATRIX_DIM 8 1 1 /end MEASUREMENT
/begin MEASUREMENT CAN_ST_GRB_HYB " F2062: CAN_ST_GRB_HYB (internal only)" UBYTE X1_M 1 100 0 255 ECU_ADDRESS 0xFFF848C8 FORMAT "%5.1" MATRIX_DIM 15 1 1 /end MEASUREMENT
/begin MEASUREMENT CAN_ST_GRB_HYB_COMP " F2062: CAN_ST_GRB_HYB complement buffer" UBYTE X1_M 1 100 0 255 ECU_ADDRESS 0xFFF92694 FORMAT "%5.1" MATRIX_DIM 8 1 1 /end MEASUREMENT
/begin MEASUREMENT CAN_ST_GRB_HYB_DATA " F2062: CAN_ST_GRB_HYB valid buffer" UBYTE X1_M 1 100 0 255 ECU_ADDRESS 0xFFF848B8 FORMAT "%5.1" MATRIX_DIM 8 1 1 /end MEASUREMENT
/begin MEASUREMENT CAN_ST_GRB_HYB_RX " F2062: CAN_ST_GRB_HYB_RX (internal only)" UBYTE X1_M 1 100 0 255 ECU_ADDRESS 0xFFF848A8 FORMAT "%5.1" MATRIX_DIM 15 1 1 /end MEASUREMENT
/begin MEASUREMENT CAN_ST_GRB_HYB_RX_COMP " F2062: CAN_ST_GRB_HYB_RX complement buffer" UBYTE X1_M 1 100 0 255 ECU_ADDRESS 0xFFF9268C FORMAT "%5.1" MATRIX_DIM 8 1 1 /end MEASUREMENT
/begin MEASUREMENT CAN_ST_GRB_HYB_RX_DATA " F2062: CAN_ST_GRB_HYB_RX valid buffer" UBYTE X1_M 1 100 0 255 ECU_ADDRESS 0xFFF84898 FORMAT "%5.1" MATRIX_DIM 8 1 1 /end MEASUREMENT
/begin MEASUREMENT CAN_ST_GRB_HYB_RX_RAW " F2062: CAN_ST_GRB_HYB_RX raw buffer" UBYTE X1_M 1 100 0 255 ECU_ADDRESS 0xFFF848A0 FORMAT "%5.1" MATRIX_DIM 8 1 1 /end MEASUREMENT
/begin MEASUREMENT CAN_ST_GWS " F2062: CAN_ST_GWS (internal only)" UBYTE X1_M 1 100 0 255 ECU_ADDRESS 0xFFF84680 FORMAT "%5.1" MATRIX_DIM 15 1 1 /end MEASUREMENT
/begin MEASUREMENT CAN_ST_GWS_COMP " F2062: CAN_ST_GWS complement buffer" UBYTE X1_M 1 100 0 255 ECU_ADDRESS 0xFFF925DC FORMAT "%5.1" MATRIX_DIM 8 1 1 /end MEASUREMENT
/begin MEASUREMENT CAN_ST_GWS_COMPSTA " F2062: CAN_ST_GWS_COMPSTA (internal only)" UBYTE X1_M 1 100 0 255 ECU_ADDRESS 0xFFF84678 FORMAT "%5.1" MATRIX_DIM 7 1 1 /end MEASUREMENT
/begin MEASUREMENT CAN_ST_GWS_DATA " F2062: CAN_ST_GWS valid buffer" UBYTE X1_M 1 100 0 255 ECU_ADDRESS 0xFFF84670 FORMAT "%5.1" MATRIX_DIM 8 1 1 /end MEASUREMENT
/begin MEASUREMENT CAN_ST_GWS_RAW " F2062: CAN_ST_GWS raw buffer" UBYTE X1_M 1 100 0 255 ECU_ADDRESS 0xFFF925D4 FORMAT "%5.1" MATRIX_DIM 8 1 1 /end MEASUREMENT
/begin CHARACTERISTIC CAN_TIDEB_DIAG_OBD_GRB_C "F2070: Debounce timer for message DIAG_OBD_GRB" VALUE 0x1918D4 AblGLKWub_M 1275 TI1_M_CYCLE_M 0 1275 FORMAT "%5.0" /end CHARACTERISTIC
/begin CHARACTERISTIC CAN_TIDEB_DT_DISP_GRDT_C "F2070: Debounce timer for message DT_DISP_GRDT" VALUE 0x1918D5 AblGLKWub_M 1275 TI1_M_CYCLE_M 0 1275 FORMAT "%5.0" /end CHARACTERISTIC
/begin CHARACTERISTIC CAN_TIDEB_ST_GRB_ECU_C "F2070: Debounce timer for message ST_GRB_ECU" VALUE 0x1918D6 AblGLKWub_M 1275 TI1_M_CYCLE_M 0 1275 FORMAT "%5.0" /end CHARACTERISTIC
/begin CHARACTERISTIC CAN_TIDEB_ST_GRB_HYB_C "F2070: Debounce timer for message ST_GRB_HYB" VALUE 0x1918D7 AblGLKWub_M 1275 TI1_M_CYCLE_M 0 1275 FORMAT "%5.0" /end CHARACTERISTIC
/begin MEASUREMENT CAN_TORQ_CRSH_1 " F2062: CAN_TORQ_CRSH_1 (internal only)" UBYTE X1_M 1 100 0 255 ECU_ADDRESS 0xFFF846D8 FORMAT "%5.1" MATRIX_DIM 15 1 1 /end MEASUREMENT
/begin MEASUREMENT CAN_TORQ_CRSH_1_COMP " F2062: CAN_TORQ_CRSH_1 complement buffer" UBYTE X1_M 1 100 0 255 ECU_ADDRESS 0xFFF92604 FORMAT "%5.1" MATRIX_DIM 8 1 1 /end MEASUREMENT
/begin MEASUREMENT CAN_TORQ_CRSH_1_COMPSTA " F2062: CAN_TORQ_CRSH_1_COMPSTA (internal only)" UBYTE X1_M 1 100 0 255 ECU_ADDRESS 0xFFF846D0 FORMAT "%5.1" MATRIX_DIM 7 1 1 /end MEASUREMENT
/begin MEASUREMENT CAN_TORQ_CRSH_1_DATA " F2062: CAN_TORQ_CRSH_1 valid buffer" UBYTE X1_M 1 100 0 255 ECU_ADDRESS 0xFFF846C8 FORMAT "%5.1" MATRIX_DIM 8 1 1 /end MEASUREMENT
/begin MEASUREMENT CAN_TORQ_CRSH_1_RAW " F2062: CAN_TORQ_CRSH_1 raw buffer" UBYTE X1_M 1 100 0 255 ECU_ADDRESS 0xFFF925FC FORMAT "%5.1" MATRIX_DIM 8 1 1 /end MEASUREMENT
/begin MEASUREMENT CAN_TORQ_CRSH_2 " F2062: CAN_TORQ_CRSH_2 (internal only)" UBYTE X1_M 1 100 0 255 ECU_ADDRESS 0xFFF846F0 FORMAT "%5.1" MATRIX_DIM 15 1 1 /end MEASUREMENT
/begin MEASUREMENT CAN_TORQ_CRSH_2_DATA " F2062: CAN_TORQ_CRSH_2 valid buffer" UBYTE X1_M 1 100 0 255 ECU_ADDRESS 0xFFF846E8 FORMAT "%5.1" MATRIX_DIM 8 1 1 /end MEASUREMENT
/begin MEASUREMENT CAN_TORQ_CRSH_2_RAW " F2062: CAN_TORQ_CRSH_2 raw buffer" UBYTE X1_M 1 100 0 255 ECU_ADDRESS 0xFFF9260C FORMAT "%5.1" MATRIX_DIM 8 1 1 /end MEASUREMENT
/begin MEASUREMENT CAN_TORQ_CRSH_3 " F2062: CAN_TORQ_CRSH_3 (internal only)" UBYTE X1_M 1 100 0 255 ECU_ADDRESS 0xFFF84710 FORMAT "%5.1" MATRIX_DIM 15 1 1 /end MEASUREMENT
/begin MEASUREMENT CAN_TORQ_CRSH_3_COMP " F2062: CAN_TORQ_CRSH_3 complement buffer" UBYTE X1_M 1 100 0 255 ECU_ADDRESS 0xFFF9261C FORMAT "%5.1" MATRIX_DIM 8 1 1 /end MEASUREMENT
/begin MEASUREMENT CAN_TORQ_CRSH_3_COMPSTA " F2062: CAN_TORQ_CRSH_3_COMPSTA (internal only)" UBYTE X1_M 1 100 0 255 ECU_ADDRESS 0xFFF84708 FORMAT "%5.1" MATRIX_DIM 7 1 1 /end MEASUREMENT
/begin MEASUREMENT CAN_TORQ_CRSH_3_DATA " F2062: CAN_TORQ_CRSH_3 valid buffer" UBYTE X1_M 1 100 0 255 ECU_ADDRESS 0xFFF84700 FORMAT "%5.1" MATRIX_DIM 8 1 1 /end MEASUREMENT
/begin MEASUREMENT CAN_TORQ_CRSH_3_RAW " F2062: CAN_TORQ_CRSH_3 raw buffer" UBYTE X1_M 1 100 0 255 ECU_ADDRESS 0xFFF92614 FORMAT "%5.1" MATRIX_DIM 8 1 1 /end MEASUREMENT
/begin MEASUREMENT CAN_WMOM_DRV_1 " F2062: CAN_WMOM_DRV_1 (internal only)" UBYTE X1_M 1 100 0 255 ECU_ADDRESS 0xFFF84728 FORMAT "%5.1" MATRIX_DIM 15 1 1 /end MEASUREMENT
/begin MEASUREMENT CAN_WMOM_DRV_1_DATA " F2062: CAN_WMOM_DRV_1 valid buffer" UBYTE X1_M 1 100 0 255 ECU_ADDRESS 0xFFF84720 FORMAT "%5.1" MATRIX_DIM 8 1 1 /end MEASUREMENT
/begin MEASUREMENT CAN_WMOM_DRV_1_RAW " F2062: CAN_WMOM_DRV_1 raw buffer" UBYTE X1_M 1 100 0 255 ECU_ADDRESS 0xFFF92624 FORMAT "%5.1" MATRIX_DIM 8 1 1 /end MEASUREMENT
/begin MEASUREMENT CAN_WMOM_DRV_3 " F2062: CAN_WMOM_DRV_3 (internal only)" UBYTE X1_M 1 100 0 255 ECU_ADDRESS 0xFFF84740 FORMAT "%5.1" MATRIX_DIM 15 1 1 /end MEASUREMENT
/begin MEASUREMENT CAN_WMOM_DRV_3_DATA " F2062: CAN_WMOM_DRV_3 valid buffer" UBYTE X1_M 1 100 0 255 ECU_ADDRESS 0xFFF84738 FORMAT "%5.1" MATRIX_DIM 8 1 1 /end MEASUREMENT
/begin MEASUREMENT CAN_WMOM_DRV_3_RAW " F2062: CAN_WMOM_DRV_3 raw buffer" UBYTE X1_M 1 100 0 255 ECU_ADDRESS 0xFFF9262C FORMAT "%5.1" MATRIX_DIM 8 1 1 /end MEASUREMENT
/begin MEASUREMENT CAN_WMOM_DRV_7 " F2062: CAN_WMOM_DRV_7 (internal only)" UBYTE X1_M 1 100 0 255 ECU_ADDRESS 0xFFF84758 FORMAT "%5.1" MATRIX_DIM 15 1 1 /end MEASUREMENT
/begin MEASUREMENT CAN_WMOM_DRV_7_DATA " F2062: CAN_WMOM_DRV_7 valid buffer" UBYTE X1_M 1 100 0 255 ECU_ADDRESS 0xFFF84750 FORMAT "%5.1" MATRIX_DIM 8 1 1 /end MEASUREMENT
/begin MEASUREMENT CAN_WMOM_DRV_7_RAW " F2062: CAN_WMOM_DRV_7 raw buffer" UBYTE X1_M 1 100 0 255 ECU_ADDRESS 0xFFF92634 FORMAT "%5.1" MATRIX_DIM 8 1 1 /end MEASUREMENT
/begin MEASUREMENT CAN_bBusOff "F2063: CAN busoff flag" UBYTE B_TRUE_M 1 100 0 1 ECU_ADDRESS 0xFFF933D2 FORMAT "%13.11" MATRIX_DIM 2 1 1 /end MEASUREMENT
/begin MEASUREMENT CAN_bErrPas "F2063: CAN error passive flag" UBYTE B_TRUE_M 1 100 0 1 ECU_ADDRESS 0xFFF933D4 FORMAT "%13.11" MATRIX_DIM 2 1 1 /end MEASUREMENT
/begin CHARACTERISTIC CAN_ctMsgMonAlvANG_ACPD_C "F2062: alive counter monitoring message ANG_ACPD" VALUE 0x191991 AblGLKWub_M 255 X1_M 0 255 FORMAT "%5.1" /end CHARACTERISTIC
/begin CHARACTERISTIC CAN_ctMsgMonAlvAVL_DT_MOT_1_C "F2062: alive counter monitoring message AVL_DT_MOT_1" VALUE 0x191992 AblGLKWub_M 255 X1_M 0 255 FORMAT "%5.1" /end CHARACTERISTIC
/begin CHARACTERISTIC CAN_ctMsgMonAlvAVL_DT_MOT_1_LT_C "F2062: alive counter monitoring message AVL_DT_MOT_1_LT" VALUE 0x191993 AblGLKWub_M 255 X1_M 0 255 FORMAT "%5.1" /end CHARACTERISTIC
/begin CHARACTERISTIC CAN_ctMsgMonAlvDT_PT_2_C "F2062: alive counter monitoring message DT_PT_2" VALUE 0x191994 AblGLKWub_M 255 X1_M 0 255 FORMAT "%5.1" /end CHARACTERISTIC
/begin CHARACTERISTIC CAN_ctMsgMonAlvHYB_SPEC_C "F2062: alive counter monitoring message HYB_SPEC" VALUE 0x191995 AblGLKWub_M 255 X1_M 0 255 FORMAT "%5.1" /end CHARACTERISTIC
/begin CHARACTERISTIC CAN_ctMsgMonAlvSTAT_ENG_STA_AUTO_C "F2062: alive counter monitoring message STAT_ENG_STA_AUTO" VALUE 0x191996 AblGLKWub_M 255 X1_M 0 255 FORMAT "%5.1" /end CHARACTERISTIC
/begin CHARACTERISTIC CAN_ctMsgMonAlvST_GWS_C "F2062: alive counter monitoring message ST_GWS" VALUE 0x191997 AblGLKWub_M 255 X1_M 0 255 FORMAT "%5.1" /end CHARACTERISTIC
/begin CHARACTERISTIC CAN_ctMsgMonAlvTORQ_CRSH_1_C "F2062: alive counter monitoring message TORQ_CRSH_1" VALUE 0x191998 AblGLKWub_M 255 X1_M 0 255 FORMAT "%5.1" /end CHARACTERISTIC
/begin CHARACTERISTIC CAN_ctMsgMonAlvTORQ_CRSH_2_C "F2062: alive counter monitoring message TORQ_CRSH_2" VALUE 0x191999 AblGLKWub_M 255 X1_M 0 255 FORMAT "%5.1" /end CHARACTERISTIC
/begin CHARACTERISTIC CAN_ctMsgMonAlvTORQ_CRSH_3_C "F2062: alive counter monitoring message TORQ_CRSH_3" VALUE 0x19199A AblGLKWub_M 255 X1_M 0 255 FORMAT "%5.1" /end CHARACTERISTIC
/begin CHARACTERISTIC CAN_ctMsgMonAlvWMOM_DRV_1_C "F2062: alive counter monitoring message WMOM_DRV_1" VALUE 0x19199B AblGLKWub_M 255 X1_M 0 255 FORMAT "%5.1" /end CHARACTERISTIC
/begin CHARACTERISTIC CAN_ctMsgMonAlvWMOM_DRV_3_C "F2062: alive counter monitoring message WMOM_DRV_3" VALUE 0x19199C AblGLKWub_M 255 X1_M 0 255 FORMAT "%5.1" /end CHARACTERISTIC
/begin CHARACTERISTIC CAN_ctMsgMonAlvWMOM_DRV_7_C "F2062: alive counter monitoring message WMOM_DRV_7" VALUE 0x19199D AblGLKWub_M 255 X1_M 0 255 FORMAT "%5.1" /end CHARACTERISTIC
/begin CHARACTERISTIC CAN_ctMsgMonChkANG_ACPD_C "F2062: checksum monitoring message ANG_ACPD" VALUE 0x19199E AblGLKWub_M 255 X1_M 0 255 FORMAT "%5.1" /end CHARACTERISTIC
/begin CHARACTERISTIC CAN_ctMsgMonChkAVL_DT_MOT_1_C "F2062: checksum monitoring message AVL_DT_MOT_1" VALUE 0x19199F AblGLKWub_M 255 X1_M 0 255 FORMAT "%5.1" /end CHARACTERISTIC
/begin CHARACTERISTIC CAN_ctMsgMonChkAVL_DT_MOT_1_LT_C "F2062: checksum monitoring message AVL_DT_MOT_1_LT" VALUE 0x1919A0 AblGLKWub_M 255 X1_M 0 255 FORMAT "%5.1" /end CHARACTERISTIC
/begin CHARACTERISTIC CAN_ctMsgMonChkDT_PT_2_C "F2062: checksum monitoring message DT_PT_2" VALUE 0x1919A1 AblGLKWub_M 255 X1_M 0 255 FORMAT "%5.1" /end CHARACTERISTIC
/begin CHARACTERISTIC CAN_ctMsgMonChkHYB_SPEC_C "F2062: checksum monitoring message HYB_SPEC" VALUE 0x1919A2 AblGLKWub_M 255 X1_M 0 255 FORMAT "%5.1" /end CHARACTERISTIC
/begin CHARACTERISTIC CAN_ctMsgMonChkSTAT_ENG_STA_AUTO_C "F2062: checksum monitoring message STAT_ENG_STA_AUTO" VALUE 0x1919A3 AblGLKWub_M 255 X1_M 0 255 FORMAT "%5.1" /end CHARACTERISTIC
/begin CHARACTERISTIC CAN_ctMsgMonChkST_GWS_C "F2062: checksum monitoring message ST_GWS" VALUE 0x1919A4 AblGLKWub_M 255 X1_M 0 255 FORMAT "%5.1" /end CHARACTERISTIC
/begin CHARACTERISTIC CAN_ctMsgMonChkTORQ_CRSH_1_C "F2062: checksum monitoring message TORQ_CRSH_1" VALUE 0x1919A5 AblGLKWub_M 255 X1_M 0 255 FORMAT "%5.1" /end CHARACTERISTIC
/begin CHARACTERISTIC CAN_ctMsgMonChkTORQ_CRSH_2_C "F2062: checksum monitoring message TORQ_CRSH_2" VALUE 0x1919A6 AblGLKWub_M 255 X1_M 0 255 FORMAT "%5.1" /end CHARACTERISTIC
/begin CHARACTERISTIC CAN_ctMsgMonChkTORQ_CRSH_3_C "F2062: checksum monitoring message TORQ_CRSH_3" VALUE 0x1919A7 AblGLKWub_M 255 X1_M 0 255 FORMAT "%5.1" /end CHARACTERISTIC
/begin CHARACTERISTIC CAN_ctMsgMonChkWMOM_DRV_1_C "F2062: checksum monitoring message WMOM_DRV_1" VALUE 0x1919A8 AblGLKWub_M 255 X1_M 0 255 FORMAT "%5.1" /end CHARACTERISTIC
/begin CHARACTERISTIC CAN_ctMsgMonChkWMOM_DRV_3_C "F2062: checksum monitoring message WMOM_DRV_3" VALUE 0x1919A9 AblGLKWub_M 255 X1_M 0 255 FORMAT "%5.1" /end CHARACTERISTIC
/begin CHARACTERISTIC CAN_ctMsgMonChkWMOM_DRV_7_C "F2062: checksum monitoring message WMOM_DRV_7" VALUE 0x1919AA AblGLKWub_M 255 X1_M 0 255 FORMAT "%5.1" /end CHARACTERISTIC
/begin CHARACTERISTIC CAN_ctMsgMonDlcANG_ACPD_C "F2062: DLC monitoring message ANG_ACPD" VALUE 0x1919AB AblGLKWub_M 255 X1_M 0 255 FORMAT "%5.1" /end CHARACTERISTIC
/begin CHARACTERISTIC CAN_ctMsgMonDlcAVL_DT_MOT_1_C "F2062: DLC monitoring message AVL_DT_MOT_1" VALUE 0x1919AC AblGLKWub_M 255 X1_M 0 255 FORMAT "%5.1" /end CHARACTERISTIC
/begin CHARACTERISTIC CAN_ctMsgMonDlcAVL_DT_MOT_1_LT_C "F2062: DLC monitoring message AVL_DT_MOT_1_LT" VALUE 0x1919AD AblGLKWub_M 255 X1_M 0 255 FORMAT "%5.1" /end CHARACTERISTIC
/begin CHARACTERISTIC CAN_ctMsgMonDlcDIAG_OBD_ENG_C "F2062: DLC monitoring message DIAG_OBD_ENG" VALUE 0x1919AE AblGLKWub_M 255 X1_M 0 255 FORMAT "%5.1" /end CHARACTERISTIC
/begin CHARACTERISTIC CAN_ctMsgMonDlcDT_DRV_EL_C "F2062: DLC monitoring message DT_DRV_EL" VALUE 0x1919AF AblGLKWub_M 255 X1_M 0 255 FORMAT "%5.1" /end CHARACTERISTIC
/begin CHARACTERISTIC CAN_ctMsgMonDlcDT_PT_1_C "F2062: DLC monitoring message DT_PT_1" VALUE 0x1919B0 AblGLKWub_M 255 X1_M 0 255 FORMAT "%5.1" /end CHARACTERISTIC
/begin CHARACTERISTIC CAN_ctMsgMonDlcDT_PT_2_C "F2062: DLC monitoring message DT_PT_2" VALUE 0x1919B1 AblGLKWub_M 255 X1_M 0 255 FORMAT "%5.1" /end CHARACTERISTIC
/begin CHARACTERISTIC CAN_ctMsgMonDlcFLLUPT_GPWSUP_C "F2062: DLC monitoring message FLLUPT_GPWSUP" VALUE 0x1919B2 AblGLKWub_M 255 X1_M 0 255 FORMAT "%5.1" /end CHARACTERISTIC
/begin CHARACTERISTIC CAN_ctMsgMonDlcHYB_SPEC_C "F2062: DLC monitoring message HYB_SPEC" VALUE 0x1919B3 AblGLKWub_M 255 X1_M 0 255 FORMAT "%5.1" /end CHARACTERISTIC
/begin CHARACTERISTIC CAN_ctMsgMonDlcSPEC_HVSTO_C "F2062: DLC monitoring message SPEC_HVSTO" VALUE 0x1919B4 AblGLKWub_M 255 X1_M 0 255 FORMAT "%5.1" /end CHARACTERISTIC
/begin CHARACTERISTIC CAN_ctMsgMonDlcSTAT_ENG_STA_AUTO_C "F2062: DLC monitoring message STAT_ENG_STA_AUTO" VALUE 0x1919B5 AblGLKWub_M 255 X1_M 0 255 FORMAT "%5.1" /end CHARACTERISTIC
/begin CHARACTERISTIC CAN_ctMsgMonDlcSTAT_HVSTO_2_C "F2062: DLC monitoring message STAT_HVSTO_2" VALUE 0x1919B6 AblGLKWub_M 255 X1_M 0 255 FORMAT "%5.1" /end CHARACTERISTIC
/begin CHARACTERISTIC CAN_ctMsgMonDlcST_GWS_C "F2062: DLC monitoring message ST_GWS" VALUE 0x1919B7 AblGLKWub_M 255 X1_M 0 255 FORMAT "%5.1" /end CHARACTERISTIC
/begin CHARACTERISTIC CAN_ctMsgMonDlcTORQ_CRSH_1_C "F2062: DLC monitoring message TORQ_CRSH_1" VALUE 0x1919B8 AblGLKWub_M 255 X1_M 0 255 FORMAT "%5.1" /end CHARACTERISTIC
/begin CHARACTERISTIC CAN_ctMsgMonDlcTORQ_CRSH_2_C "F2062: DLC monitoring message TORQ_CRSH_2" VALUE 0x1919B9 AblGLKWub_M 255 X1_M 0 255 FORMAT "%5.1" /end CHARACTERISTIC
/begin CHARACTERISTIC CAN_ctMsgMonDlcTORQ_CRSH_3_C "F2062: DLC monitoring message TORQ_CRSH_3" VALUE 0x1919BA AblGLKWub_M 255 X1_M 0 255 FORMAT "%5.1" /end CHARACTERISTIC
/begin CHARACTERISTIC CAN_ctMsgMonDlcWMOM_DRV_1_C "F2062: DLC monitoring message WMOM_DRV_1" VALUE 0x1919BB AblGLKWub_M 255 X1_M 0 255 FORMAT "%5.1" /end CHARACTERISTIC
/begin CHARACTERISTIC CAN_ctMsgMonDlcWMOM_DRV_3_C "F2062: DLC monitoring message WMOM_DRV_3" VALUE 0x1919BC AblGLKWub_M 255 X1_M 0 255 FORMAT "%5.1" /end CHARACTERISTIC
/begin CHARACTERISTIC CAN_ctMsgMonDlcWMOM_DRV_7_C "F2062: DLC monitoring message WMOM_DRV_7" VALUE 0x1919BD AblGLKWub_M 255 X1_M 0 255 FORMAT "%5.1" /end CHARACTERISTIC
/begin MEASUREMENT CAN_stBusOff "F2063: internal CAN busoff status" UBYTE X1_M 1 100 0 255 ECU_ADDRESS 0xFFF933D6 FORMAT "%5.1" MATRIX_DIM 2 1 1 /end MEASUREMENT
/begin MEASUREMENT CAN_stErrPas "F2063: internal CAN error passive status" UBYTE X1_M 1 100 0 255 ECU_ADDRESS 0xFFF933D8 FORMAT "%5.1" MATRIX_DIM 2 1 1 /end MEASUREMENT
/begin MEASUREMENT CAN_stLine "F2063: actual state of CAN lines" UWORD X1_M 1 100 0 65535 ECU_ADDRESS 0xFFF92AB8 FORMAT "%8.2" MATRIX_DIM 2 1 1 /end MEASUREMENT
/begin CHARACTERISTIC CAN_stNodePerLine_C "F2063: Bit coded information which CAN node is assigned to which line (B0=CAN_A,B1=CAN_B etc.) (no SERAP)" VAL_BLK 0x1904E0 AblGLKWBuw_M 65535 X1_M 0 65535 MATRIX_DIM 2 1 1 FORMAT "%8.2" /end CHARACTERISTIC
/begin CHARACTERISTIC CAN_swtErrPasDet_C "F2063: switch for error passive detection" VALUE 0x1918D9 AblGLKWub_M 255 X1_M 0 255 FORMAT "%5.1" /end CHARACTERISTIC
/begin CHARACTERISTIC CAN_swtMsgMonANG_ACPD_C "F2062: activation monitoring message ANG_ACPD" VALUE 0x1919BE AblGLKWub_M 255 X1_M 0 255 FORMAT "%5.1" /end CHARACTERISTIC
/begin CHARACTERISTIC CAN_swtMsgMonAVL_DT_MOT_1_C "F2062: activation monitoring message AVL_DT_MOT_1" VALUE 0x1919BF AblGLKWub_M 255 X1_M 0 255 FORMAT "%5.1" /end CHARACTERISTIC
/begin CHARACTERISTIC CAN_swtMsgMonAVL_DT_MOT_1_LT_C "F2062: activation monitoring message AVL_DT_MOT_1_LT" VALUE 0x1919C0 AblGLKWub_M 255 X1_M 0 255 FORMAT "%5.1" /end CHARACTERISTIC
/begin CHARACTERISTIC CAN_swtMsgMonDIAG_OBD_ENG_C "F2062: activation monitoring message DIAG_OBD_ENG" VALUE 0x1919C1 AblGLKWub_M 255 X1_M 0 255 FORMAT "%5.1" /end CHARACTERISTIC
/begin CHARACTERISTIC CAN_swtMsgMonDT_DISP_GRDT_RX_C "F2062: activation monitoring message DT_DISP_GRDT_RX" VALUE 0x1919C2 AblGLKWub_M 255 X1_M 0 255 FORMAT "%5.1" /end CHARACTERISTIC
/begin CHARACTERISTIC CAN_swtMsgMonDT_DRV_EL_C "F2062: activation monitoring message DT_DRV_EL" VALUE 0x1919C3 AblGLKWub_M 255 X1_M 0 255 FORMAT "%5.1" /end CHARACTERISTIC
/begin CHARACTERISTIC CAN_swtMsgMonDT_GRDT_RX_C "F2062: activation monitoring message DT_GRDT_RX" VALUE 0x1919C4 AblGLKWub_M 255 X1_M 0 255 FORMAT "%5.1" /end CHARACTERISTIC
/begin CHARACTERISTIC CAN_swtMsgMonDT_PT_1_C "F2062: activation monitoring message DT_PT_1" VALUE 0x1919C5 AblGLKWub_M 255 X1_M 0 255 FORMAT "%5.1" /end CHARACTERISTIC
/begin CHARACTERISTIC CAN_swtMsgMonDT_PT_2_C "F2062: activation monitoring message DT_PT_2" VALUE 0x1919C6 AblGLKWub_M 255 X1_M 0 255 FORMAT "%5.1" /end CHARACTERISTIC
/begin CHARACTERISTIC CAN_swtMsgMonFLLUPT_GPWSUP_C "F2062: activation monitoring message FLLUPT_GPWSUP" VALUE 0x1919C7 AblGLKWub_M 255 X1_M 0 255 FORMAT "%5.1" /end CHARACTERISTIC
/begin CHARACTERISTIC CAN_swtMsgMonHYB_SPEC_C "F2062: activation monitoring message HYB_SPEC" VALUE 0x1919C8 AblGLKWub_M 255 X1_M 0 255 FORMAT "%5.1" /end CHARACTERISTIC
/begin CHARACTERISTIC CAN_swtMsgMonRQ_TORQ_CRSH_GRB_RX_C "F2062: activation monitoring message RQ_TORQ_CRSH_GRB_RX" VALUE 0x1919C9 AblGLKWub_M 255 X1_M 0 255 FORMAT "%5.1" /end CHARACTERISTIC
/begin CHARACTERISTIC CAN_swtMsgMonSPEC_HVSTO_C "F2062: activation monitoring message SPEC_HVSTO" VALUE 0x1919CA AblGLKWub_M 255 X1_M 0 255 FORMAT "%5.1" /end CHARACTERISTIC
/begin CHARACTERISTIC CAN_swtMsgMonSTAT_ENG_STA_AUTO_C "F2062: activation monitoring message STAT_ENG_STA_AUTO" VALUE 0x1919CB AblGLKWub_M 255 X1_M 0 255 FORMAT "%5.1" /end CHARACTERISTIC
/begin CHARACTERISTIC CAN_swtMsgMonSTAT_HVSTO_2_C "F2062: activation monitoring message STAT_HVSTO_2" VALUE 0x1919CC AblGLKWub_M 255 X1_M 0 255 FORMAT "%5.1" /end CHARACTERISTIC
/begin CHARACTERISTIC CAN_swtMsgMonST_GRB_ECU_RX_C "F2062: activation monitoring message ST_GRB_ECU_RX" VALUE 0x1919CD AblGLKWub_M 255 X1_M 0 255 FORMAT "%5.1" /end CHARACTERISTIC
/begin CHARACTERISTIC CAN_swtMsgMonST_GRB_HYB_RX_C "F2062: activation monitoring message ST_GRB_HYB_RX" VALUE 0x1919CE AblGLKWub_M 255 X1_M 0 255 FORMAT "%5.1" /end CHARACTERISTIC
/begin CHARACTERISTIC CAN_swtMsgMonST_GWS_C "F2062: activation monitoring message ST_GWS" VALUE 0x1919CF AblGLKWub_M 255 X1_M 0 255 FORMAT "%5.1" /end CHARACTERISTIC
/begin CHARACTERISTIC CAN_swtMsgMonTORQ_CRSH_1_C "F2062: activation monitoring message TORQ_CRSH_1" VALUE 0x1919D0 AblGLKWub_M 255 X1_M 0 255 FORMAT "%5.1" /end CHARACTERISTIC
/begin CHARACTERISTIC CAN_swtMsgMonTORQ_CRSH_2_C "F2062: activation monitoring message TORQ_CRSH_2" VALUE 0x1919D1 AblGLKWub_M 255 X1_M 0 255 FORMAT "%5.1" /end CHARACTERISTIC
/begin CHARACTERISTIC CAN_swtMsgMonTORQ_CRSH_3_C "F2062: activation monitoring message TORQ_CRSH_3" VALUE 0x1919D2 AblGLKWub_M 255 X1_M 0 255 FORMAT "%5.1" /end CHARACTERISTIC
/begin CHARACTERISTIC CAN_swtMsgMonWMOM_DRV_1_C "F2062: activation monitoring message WMOM_DRV_1" VALUE 0x1919D3 AblGLKWub_M 255 X1_M 0 255 FORMAT "%5.1" /end CHARACTERISTIC
/begin CHARACTERISTIC CAN_swtMsgMonWMOM_DRV_3_C "F2062: activation monitoring message WMOM_DRV_3" VALUE 0x1919D4 AblGLKWub_M 255 X1_M 0 255 FORMAT "%5.1" /end CHARACTERISTIC
/begin CHARACTERISTIC CAN_swtMsgMonWMOM_DRV_7_C "F2062: activation monitoring message WMOM_DRV_7" VALUE 0x1919D5 AblGLKWub_M 255 X1_M 0 255 FORMAT "%5.1" /end CHARACTERISTIC
/begin MEASUREMENT CAN_tiBusOff "F2063: CAN busoff timer" UWORD TI1_M_CYCLE_M 1 100 0 327675 ECU_ADDRESS 0xFFF94150 FORMAT "%8.1" MATRIX_DIM 2 1 1 /end MEASUREMENT
/begin CHARACTERISTIC CAN_tiBusOffChk_C "F2063: Duration of check when trying to recover from bus off." VAL_BLK 0x1904E4 AblGLKWBuw_M 327675 TI1_M_CYCLE_M 0 327675 MATRIX_DIM 2 1 1 FORMAT "%8.1" /end CHARACTERISTIC
/begin CHARACTERISTIC CAN_tiBusOffDly1_C "F2063: Delay time after busoff detection and start of recovery (first time)" VAL_BLK 0x1904E8 AblGLKWBuw_M 327675 TI1_M_CYCLE_M 0 327675 MATRIX_DIM 2 1 1 FORMAT "%8.1" /end CHARACTERISTIC
/begin CHARACTERISTIC CAN_tiBusOffDly2_C "F2063: Delay time after busoff detection and start of recovery (second time)" VAL_BLK 0x1904EC AblGLKWBuw_M 327675 TI1_M_CYCLE_M 0 327675 MATRIX_DIM 2 1 1 FORMAT "%8.1" /end CHARACTERISTIC
/begin MEASUREMENT CAN_tiErrPas "F2063: CAN error passive timer" UWORD TI1_M_CYCLE_M 1 100 0 327675 ECU_ADDRESS 0xFFF94154 FORMAT "%8.1" MATRIX_DIM 2 1 1 /end MEASUREMENT
/begin CHARACTERISTIC CAN_tiErrPasDly_C "F2063: Delay time after error passive detection to restart" VAL_BLK 0x1904F0 AblGLKWBuw_M 327675 TI1_M_CYCLE_M 0 327675 MATRIX_DIM 2 1 1 FORMAT "%8.1" /end CHARACTERISTIC
/begin MEASUREMENT CNE_cfMsgRx "F2050: Reception acknowledege for at least one CAN message in the last 10 ms cycle" UBYTE X1_M 1 100 0 255 ECU_ADDRESS 0xFFF93AAF FORMAT "%5.1" /end MEASUREMENT
/begin CHARACTERISTIC CNE_numAlvTol_C "F2050: application value for ALV tolerance" VALUE 0x1918D8 AblGLKWub_M 14 X1_M 1 15 FORMAT "%5.2" /end CHARACTERISTIC
/begin MEASUREMENT CalHndlrHw_regAUDISR "F1505: Initial value of register AUDISR" UWORD X1_S1 1 100 0 65535 ECU_ADDRESS 0xFFF9313C FORMAT "%8.2" /end MEASUREMENT
/begin MEASUREMENT CalHndlrHw_sAudTool "F1505: Status of AUD-Tool Detection: 0xAA ETK_ACTIVE, 0x55 ETK_PREDETECT, 0xAB GSI_ACTIVE, 0x56 GSI_PREDETECT,0x00 INACTIVE,0xF0 DETECTION_FAILED, 0xF1u CALHDNLR_REGFAILED" UBYTE X1_S1 1 100 0 255 ECU_ADDRESS 0xFFF9367B FORMAT "%5.1" /end MEASUREMENT
/begin MEASUREMENT CalHndlr_xActvCalPg "F1505: Active Calibration-Page (0xX0 NONE, 0xX3 DSERAP, 0xX5 SERAP, 0xXA SERAM, 0xFX Error)" UBYTE X1_S1 1 100 0 15 ECU_ADDRESS 0xFFF948F4 FORMAT "%5.2" /end MEASUREMENT
/begin MEASUREMENT CalHndlr_xActvCalUsr "F1505: active Calibrationmethod (0x5 GSI; 0x4 XCP; 0x3 ETK; 0x2 CCP; 0x1 IC2; 0x00 none)" UBYTE X1_S1 1 100 0 5 ECU_ADDRESS 0xFFF93682 FORMAT "%5.3" /end MEASUREMENT
/begin MEASUREMENT CanFA_tiEventMsgDelayDIAG_OBD_GRB "F2070: Timer debounce time for message DIAG_OBD_GRB (FA-CAN)" UBYTE TI1_M_CYCLE_M 1 100 0 1275 ECU_ADDRESS 0xFFF94226 FORMAT "%5.0" /end MEASUREMENT
/begin MEASUREMENT CanFA_tiEventMsgDelayDT_DISP_GRDT "F2070: Timer debounce time for message DT_DISP_GRDT (FA-CAN)" UBYTE TI1_M_CYCLE_M 1 100 0 1275 ECU_ADDRESS 0xFFF94227 FORMAT "%5.0" /end MEASUREMENT
/begin MEASUREMENT CanFA_tiEventMsgDelayST_GRB_ECU "F2070: Timer debounce time for message ST_GRB_ECU (FA-CAN)" UBYTE TI1_M_CYCLE_M 1 100 0 1275 ECU_ADDRESS 0xFFF94228 FORMAT "%5.0" /end MEASUREMENT
/begin MEASUREMENT Can_tiEventMsgDelayDIAG_OBD_GRB "F2070: Timer debounce time for message DIAG_OBD_GRB (A-CAN)" UBYTE TI1_M_CYCLE_M 1 100 0 1275 ECU_ADDRESS 0xFFF94229 FORMAT "%5.0" /end MEASUREMENT
/begin MEASUREMENT Can_tiEventMsgDelayDT_DISP_GRDT "F2070: Timer debounce time for message DT_DISP_GRDT (A-CAN)" UBYTE TI1_M_CYCLE_M 1 100 0 1275 ECU_ADDRESS 0xFFF9422A FORMAT "%5.0" /end MEASUREMENT
/begin MEASUREMENT Can_tiEventMsgDelayST_GRB_ECU "F2070: Timer debounce time for message ST_GRB_ECU (A-CAN)" UBYTE TI1_M_CYCLE_M 1 100 0 1275 ECU_ADDRESS 0xFFF9422B FORMAT "%5.0" /end MEASUREMENT
/begin MEASUREMENT Can_tiEventMsgDelayST_GRB_HYB "F2070: Timer debounce time for message ST_GRB_HYB (A-CAN)" UBYTE TI1_M_CYCLE_M 1 100 0 1275 ECU_ADDRESS 0xFFF9422C FORMAT "%5.0" /end MEASUREMENT
/begin MEASUREMENT DBG_ERR_numBuf "F1590: Number of debug entries stored in the system" UBYTE X1_S1 1 100 0 5 ECU_ADDRESS 0xFFF939C5 FORMAT "%5.3" /end MEASUREMENT
/begin MEASUREMENT DBG_ERR_numErr "F1590: Number of debug entries counted in the system (limited to 255)" UBYTE X1_S1 1 100 0 255 ECU_ADDRESS 0xFFF939C6 FORMAT "%5.1" /end MEASUREMENT
/begin MEASUREMENT DBG_ERR_numErrId "F1590: Error indication number" UWORD X1_S1 1 100 0 65535 ECU_ADDRESS 0xFFF9339C FORMAT "%8.2" MATRIX_DIM 5 1 1 /end MEASUREMENT
/begin MEASUREMENT DBG_ERR_numFctId "F1590: Function identification number" UWORD X1_S1 1 100 0 65535 ECU_ADDRESS 0xFFF933A6 FORMAT "%8.2" MATRIX_DIM 5 1 1 /end MEASUREMENT
/begin MEASUREMENT DBG_ERR_regPR "F1590: Address of the error call (register PR)" ULONG X1_S1 1 100 0 4294967295 ECU_ADDRESS 0xFFF9288C FORMAT "%13.2" MATRIX_DIM 5 1 1 /end MEASUREMENT
/begin MEASUREMENT DBG_ERR_xPar "F1590: Passed parameter" ULONG X1_S1 1 100 0 4294967295 ECU_ADDRESS 0xFFF928A0 FORMAT "%13.2" MATRIX_DIM 5 1 1 /end MEASUREMENT
/begin MEASUREMENT ECE_CORE_bMisrErr "F2351: Indicates an error within the MISR calculation (FALSE=ok, not FALSE=error)" UBYTE B_TRUE_S1 1 100 0 1 ECU_ADDRESS 0xFFF9091C FORMAT "%13.11" /end MEASUREMENT
/begin MEASUREMENT ECE_CORE_ctPbusCycles "F2351: period counter for Pbus transfer measurement" UWORD X1_S1 1 100 0 65535 ECU_ADDRESS 0xFFF90848 FORMAT "%8.2" /end MEASUREMENT
/begin CHARACTERISTIC ECE_CORE_numPbusCycles_C "F2351: Number of program cycles for Pbus-DMA transfer observation (0=off) (no SERAP)" VALUE 0x19147C AblGLKWuw_S1 65535 X1_S1 0 65535 FORMAT "%8.2" /end CHARACTERISTIC
/begin MEASUREMENT ECE_CORE_numPbusTransfers "F2351: number of PBus transfers in period ECE_CORE_numPBusCycles_C" ULONG X1_S1 1 100 0 4294967295 ECU_ADDRESS 0xFFF903B0 FORMAT "%13.2" /end MEASUREMENT
/begin MEASUREMENT ECE_CORE_regMisr "F2351: MISR register content after a reference calculation" ULONG X1_S1 1 100 0 4294967295 ECU_ADDRESS 0xFFF903AC FORMAT "%13.2" /end MEASUREMENT
/begin CHARACTERISTIC ECE_CORE_regModClkMsk_C "F2351: bitmask to select MD_CLK setting which is allowed (see register MDCR1) (no SERAP)" VALUE 0x191899 AblGLKWub_S1 255 X1_S1 0 255 FORMAT "%5.1" /end CHARACTERISTIC
/begin CHARACTERISTIC ECE_CORE_regModeMsk_C "F2351: Masks for CPU mode verification. Idx0:verification mask, Idx1:expected value  (see register MDCR1) (no SERAP)" VAL_BLK 0x1903A0 AblGLKWBuw_S1 65535 X1_S1 0 65535 MATRIX_DIM 2 1 1 FORMAT "%8.2" /end CHARACTERISTIC
/begin CHARACTERISTIC ECE_CORE_stRamWS_C "F2351: RAM waitstate configuration Info: 1=Force normal RAM WS, 2=Force fast RAM WS, 3=Auto detection of RAM WS depend on CPU type" VALUE 0x19189A AblGLKWub_S1 2 X1_S1 1 3 FORMAT "%5.3" /end CHARACTERISTIC
/begin CHARACTERISTIC ECE_CORE_stRstTrg_C "F2351: reset activation via an application label - value has to change from an odd to an even value to initiate a reset (for test purpose)" VALUE 0x19189B AblGLKWub_S1 255 X1_S1 0 255 FORMAT "%5.1" /end CHARACTERISTIC
/begin CHARACTERISTIC ECE_idxAdcAtf2_C "F2352: Index to Atf2-Temperature lines (only ADC-A) (0:high, 1:low) (no SERAP)" VAL_BLK 0x191484 AblGLKWBub_S1 255 X1_S1 0 255 MATRIX_DIM 2 1 1 FORMAT "%5.1" /end CHARACTERISTIC
/begin CHARACTERISTIC ECE_idxAdcAtf_C "F2352: Index to Atf-Temperature lines (only ADC-A) (0:high, 1:low) (no SERAP)" VAL_BLK 0x191486 AblGLKWBub_S1 255 X1_S1 0 255 MATRIX_DIM 2 1 1 FORMAT "%5.1" /end CHARACTERISTIC
/begin CHARACTERISTIC ECE_idxAdcBrk_C "F2352: Index of brake switch line (ADC-A/B) (no SERAP)" VAL_BLK 0x1918A6 AblGLKWBub_S1 255 X1_S1 0 255 MATRIX_DIM 1 1 1 FORMAT "%5.1" /end CHARACTERISTIC
/begin CHARACTERISTIC ECE_idxAdcDrvPos_C "F2352: Driver position sensing (only ADC-A) (0:main-line 1:alternative-line) (no SERAP)" VAL_BLK 0x191488 AblGLKWBub_S1 255 X1_S1 0 255 MATRIX_DIM 2 1 1 FORMAT "%5.1" /end CHARACTERISTIC
/begin CHARACTERISTIC ECE_idxAdcFdbkSsply5_C "F2352: Sensor Supply 5V feedback (ADC-A/B) (no SERAP)" VALUE 0x1918A7 AblGLKWub_S1 255 X1_S1 0 255 FORMAT "%5.1" /end CHARACTERISTIC
/begin CHARACTERISTIC ECE_idxAdcFdbkStrtRly_C "F2352: Feedback channel starter relay (only ADC-A) (no SERAP)" VAL_BLK 0x1918A8 AblGLKWBub_S1 255 X1_S1 0 255 MATRIX_DIM 1 1 1 FORMAT "%5.1" /end CHARACTERISTIC
/begin CHARACTERISTIC ECE_idxAdcLx_C "F2352: Index to ADC Lx-lines (only ADC-A).0=L01_new, 1=L02_new,...n=L11_old, n+1=L12_old.. (no SERAP)" MAP 0x1903D4 AblGLFKFub_S1 255 X1_S1 0 255
 /begin AXIS_DESCR FIX_AXIS ECE_idxDmy X1_S1 6 0 5 READ_ONLY FORMAT "%5.3" FIX_AXIS_PAR_DIST 0 1 6 /end AXIS_DESCR
 /begin AXIS_DESCR FIX_AXIS ECE_idxDmy X1_S1 2 0 1 READ_ONLY FORMAT "%5.3" FIX_AXIS_PAR_DIST 0 1 2 /end AXIS_DESCR
 FORMAT "%5.1" /end CHARACTERISTIC
/begin CHARACTERISTIC ECE_idxAdcOptRef_C "F2352: Index to Optional-lines reference (ADC-A/B) (not all migt be used) (no SERAP)" VAL_BLK 0x1903E0 AblGLKWBub_S1 255 X1_S1 0 255 MATRIX_DIM 8 1 1 FORMAT "%5.1" /end CHARACTERISTIC
/begin CHARACTERISTIC ECE_idxAdcOpt_C "F2352: Index to Optional-lines (ADC-A/B) (not all migt be used) (no SERAP)" VAL_BLK 0x1903E8 AblGLKWBub_S1 255 X1_S1 0 255 MATRIX_DIM 8 1 1 FORMAT "%5.1" /end CHARACTERISTIC
/begin CHARACTERISTIC ECE_idxAdcPres_C "F2352: Index of pressure switch lines (ADC-A/B) (no SERAP)" VAL_BLK 0x1918A9 AblGLKWBub_S1 255 X1_S1 0 255 MATRIX_DIM 5 1 1 FORMAT "%5.1" /end CHARACTERISTIC
/begin CHARACTERISTIC ECE_idxAdcTap_C "F2352: Index to Tap-lines (only ADC-A) (0:TapUp, 1:TapDn, 2:Man) (no SERAP)" VAL_BLK 0x1918AE AblGLKWBub_S1 255 X1_S1 0 255 MATRIX_DIM 3 1 1 FORMAT "%5.1" /end CHARACTERISTIC
/begin CHARACTERISTIC ECE_idxAdcTim_C "F2352: Index to Timing Element (only ADC-A) (no SERAP)" VALUE 0x1918B1 AblGLKWub_S1 255 X1_S1 0 255 FORMAT "%5.1" /end CHARACTERISTIC
/begin CHARACTERISTIC ECE_idxAdcVdd3_C "F2352: Alternative Vdd3 (ADC-A/B) (no SERAP)" VALUE 0x1918B2 AblGLKWub_S1 255 X1_S1 0 255 FORMAT "%5.1" /end CHARACTERISTIC
/begin CHARACTERISTIC ECE_idxAdc_iHss_C "F2352: Current measurement channel High-Side Actuator control (only ADC-A) (no SERAP)" VAL_BLK 0x19148A AblGLKWBub_S1 255 X1_S1 0 255 MATRIX_DIM 2 1 1 FORMAT "%5.1" /end CHARACTERISTIC
/begin CHARACTERISTIC ECE_idxAdc_iPSply_C "F2352: Current measurement channel PSply channels (ADC-A/B) (no SERAP)" VAL_BLK 0x19148C AblGLKWBub_S1 255 X1_S1 0 255 MATRIX_DIM 2 1 1 FORMAT "%5.1" /end CHARACTERISTIC
/begin CHARACTERISTIC ECE_idxDigLx_C "F2352: Index to Digital Lx-lines (Bitno. to ECE_stLines).0=L01_new, 1=L02_new,...n=L11_old, n+1=L12_old.. (no SERAP)" MAP 0x1903F0 AblGLFKFub_S1 255 X1_S1 0 255
 /begin AXIS_DESCR FIX_AXIS ECE_idxDmy X1_S1 6 0 5 READ_ONLY FORMAT "%5.3" FIX_AXIS_PAR_DIST 0 1 6 /end AXIS_DESCR
 /begin AXIS_DESCR FIX_AXIS ECE_idxDmy X1_S1 2 0 1 READ_ONLY FORMAT "%5.3" FIX_AXIS_PAR_DIST 0 1 2 /end AXIS_DESCR
 FORMAT "%5.1" /end CHARACTERISTIC
/begin MEASUREMENT ECE_idxDmy "F2352: dummy index for table addressing" UBYTE X1_S1 1 100 0 255 ECU_ADDRESS 0xFFF908F4 FORMAT "%5.1" /end MEASUREMENT
/begin CHARACTERISTIC ECE_idxFrqTis2_C "F2352: Tis2 Input Speed to Input Frequency channel selection (idx=0:FRQ_N0,1:FRQ_N1,2:FRQ_N2,3:FRQ_N3) (no SERAP)" VALUE 0x1918B3 AblGLKWub_S1 3 X1_S1 0 3 FORMAT "%5.3" /end CHARACTERISTIC
/begin CHARACTERISTIC ECE_idxFrqTis_C "F2352: Tis Input Speed to Input Frequency channel selection (idx=0:FRQ_N0,1:FRQ_N1,2:FRQ_N2,3:FRQ_N3) (no SERAP)" VALUE 0x1918B4 AblGLKWub_S1 3 X1_S1 0 3 FORMAT "%5.3" /end CHARACTERISTIC
/begin CHARACTERISTIC ECE_idxFrqTos_C "F2352: Tis Output Speed to Input Frequency channel selection (idx=0:FRQ_N0,1:FRQ_N1,2:FRQ_N2,3:FRQ_N3) (no SERAP)" VALUE 0x1918B5 AblGLKWub_S1 3 X1_S1 0 3 FORMAT "%5.3" /end CHARACTERISTIC
/begin MEASUREMENT ECE_idxLx "F2352: Evaluated index for Lx variant handling 0=new config., 1=old config." UBYTE X1_S1 1 100 0 255 ECU_ADDRESS 0xFFF9094B FORMAT "%5.1" /end MEASUREMENT
/begin MEASUREMENT ECE_idxLxOff "F2352: Evaluated offser for Lx variant handling " UBYTE X1_S1 1 100 0 255 ECU_ADDRESS 0xFFF9094C FORMAT "%5.1" /end MEASUREMENT
/begin CHARACTERISTIC ECE_idxLxVarHandling_C "F2352: Lx lines configuration detection: 0 = new config; 1 = old config; 255 = auto detection (no SERAP)" VALUE 0x1918B6 AblGLKWub_S1 255 X1_S1 0 255 FORMAT "%5.1" /end CHARACTERISTIC
/begin CHARACTERISTIC ECE_idxPwdLx_C "F2352: Lx-lines PWD-channel selection (idx=0:L1,1:L2,2:L3,3:L4) (no SERAP)" VAL_BLK 0x1903FC AblGLKWBub_S1 5 X1_S1 0 5 MATRIX_DIM 4 1 1 FORMAT "%5.3" /end CHARACTERISTIC
/begin CHARACTERISTIC ECE_idxPwdOpt_C "F2352: Optional PWD-channel selection (idx=0...) (no SERAP)" VAL_BLK 0x190400 AblGLKWBub_S1 5 X1_S1 0 5 MATRIX_DIM 8 1 1 FORMAT "%5.3" /end CHARACTERISTIC
/begin CHARACTERISTIC ECE_idxPwdTapProt_C "F2352: optional Tap-Protocol channel (no SERAP)" VALUE 0x1918B7 AblGLKWub_S1 255 X1_S1 0 255 FORMAT "%5.1" /end CHARACTERISTIC
/begin CHARACTERISTIC ECE_idxPwdTapX_C "F2352: TapX PWD-channel selection (idx=0:TapUp,1:TapDn,2:Mgate) (no SERAP)" VAL_BLK 0x1918B8 AblGLKWBub_S1 5 X1_S1 0 5 MATRIX_DIM 3 1 1 FORMAT "%5.3" /end CHARACTERISTIC
/begin CHARACTERISTIC ECE_stAdcLxAvail_C "F2352: bitcoded definition for which Lx-line an analog signal is available. B0=Lx1,B1=Lx2.. (no SERAP)" VAL_BLK 0x19148E AblGLKWBub_S1 255 X1_S1 0 255 MATRIX_DIM 2 1 1 FORMAT "%5.1" /end CHARACTERISTIC
/begin CHARACTERISTIC ECE_stDigLxAvail_C "F2352: bitcoded definition for which Lx-line a digital signal is available. B0=Lx1,B1=Lx2.. (no SERAP)" VAL_BLK 0x191490 AblGLKWBub_S1 255 X1_S1 0 255 MATRIX_DIM 2 1 1 FORMAT "%5.1" /end CHARACTERISTIC
/begin MEASUREMENT EeAccs_stEmu "F1100: Emu State: Bit [15]=Res, [14]=HealChkDne, [13]=HealChkTrg, [12]=NoVldSctrGrp, [11]=DatOutdated, [10]=PrvErsTrg, [9]=RamAccs, [8]=UpdTrg, [7]=UpdFin, [6]=WrTmpDat, [5]=Wr, [4]=Prio0RdFin, [3]=Prio1RdFin, [2]=Rd, [1]=FrstInitDet, [0]=Idle" UWORD X1_S1 1 100 0 65535 ECU_ADDRESS 0xFFF9333C FORMAT "%8.2" /end MEASUREMENT
/begin MEASUREMENT EeAccs_stPrgLvlChg "F1100: Program level change: Bit [7]=First init, [6]=unused, [5]=unused, [4]=ROM data checksum, [3]=Additional OEM-ID, [2]=OEM-ID, [1]=ROM code checksum, [0]=RB-ID" UBYTE X1_S1 1 100 0 255 ECU_ADDRESS 0xFFF936BA FORMAT "%5.1" /end MEASUREMENT
/begin MEASUREMENT EeFltHdl_efFaults "F1100: Internal error bitfield (Bit 0/12/13: Reading, 1-5: Upd Main Data, 6-8: Upd Temp Data, 9: Deadlock, 10-11: FCU)" UWORD X1_S1 1 100 0 65535 ECU_ADDRESS 0xFFF9333E FORMAT "%8.2" /end MEASUREMENT
/begin MEASUREMENT EeGenSrv_ctTotUpdSctrGrp_a "F1100: EEPROM Total Update Counter of Sector-Groups" ULONG X1_S1 1 100 0 4294967295 ECU_ADDRESS 0xFFF928B4 FORMAT "%13.2" MATRIX_DIM 8 1 1 /end MEASUREMENT
/begin CHARACTERISTIC EePstId_Cfg_idAddOem_C "F1100: Application value for additional OEM-ID part of PST-ID (no SERAP)" VAL_BLK 0x1914B4 AblGLKWBub_S1 255 X1_S1 0 255 MATRIX_DIM 2 1 1 FORMAT "%5.1" /end CHARACTERISTIC
/begin CHARACTERISTIC EePstId_Cfg_idOem_C "F1100: Application value for OEM-ID part of PST-ID (no SERAP)" VAL_BLK 0x1918C6 AblGLKWBub_S1 255 X1_S1 0 255 MATRIX_DIM 1 1 1 FORMAT "%5.1" /end CHARACTERISTIC
/begin CHARACTERISTIC EeUpdSrv_bDisblPstIdDstChsUpd_C "F1100: Application value deactivation DST-CHS update in PST-ID (0=current DST-CHS written together with PST-ID, 1=DST-CHS remains unchanged in PST-ID)" VALUE 0x1918C5 AblGLKWub_S1 255 X1_S1 0 255 FORMAT "%5.1" /end CHARACTERISTIC
/begin MEASUREMENT EeUpdSrv_ctCmplUpd "F1100: EEPROM completed update counter" UWORD X1_S1 1 100 0 65535 ECU_ADDRESS 0xFFF9334C FORMAT "%8.2" /end MEASUREMENT
/begin MEASUREMENT EeUpdSrv_ctTgtUpd "F1100: EEPROM Update Target Counter" UWORD X1_S1 1 100 0 65535 ECU_ADDRESS 0xFFF9334E FORMAT "%8.2" /end MEASUREMENT
/begin MEASUREMENT EtkCal_FshbckWaitCnt "F1510: Downcounter to wait 1sec before starting flashback" UWORD TI1_CYCLE_S1 1 100 0 6553.5 ECU_ADDRESS 0xFFF94148 FORMAT "%8.3" /end MEASUREMENT
/begin MEASUREMENT EtkSrv_tiDiffNoWait "F1510: Coldstart Setup-Time which was waited till WAIT_Command receveid from ETK (max 4ms)" ULONG TI1_U_S1 1 100 0 4294967295 ECU_ADDRESS 0xFFF909FC FORMAT "%13.2" /end MEASUREMENT
/begin MEASUREMENT EtkSrv_tiDiffWait "F1510: Coldstart Setup-Time which was wait till READY_Command received from ETK (max. 8ms)" ULONG TI1_U_S1 1 100 0 4294967295 ECU_ADDRESS 0xFFF90A00 FORMAT "%13.2" /end MEASUREMENT
/begin MEASUREMENT ExchgFix_ctStrtUp "F1206: number of SB system startups since last power-down or loss of RAM content" UBYTE X1_S1 1 100 0 255 ECU_ADDRESS 0xFFF800EC FORMAT "%5.1" /end MEASUREMENT
/begin MEASUREMENT ExchgFix_s.numAreaDataVal "F1206: Fix Exchg-RAM-Area: numRamBufValid=0xAF02451D (valid buffered RAM) / " UWORD X1_S1 1 100 0 65535 ECU_ADDRESS 0xFFF800F8 FORMAT "%8.2" /end MEASUREMENT
/begin MEASUREMENT ExchgFix_s.numFlshChkReq "F1206: Fix Exchg-RAM-Area: numRamBufValid=0xAF02451D (valid buffered RAM) / " ULONG X1_S1 1 100 0 4294967295 ECU_ADDRESS 0xFFF800F4 FORMAT "%13.2" /end MEASUREMENT
/begin MEASUREMENT ExchgFix_s.numRamBufTest "F1206: Fix Exchg-RAM-Area: numRamBufValid=0xAF02451D (valid buffered RAM) / " ULONG X1_S1 1 100 0 4294967295 ECU_ADDRESS 0xFFF800F0 FORMAT "%13.2" /end MEASUREMENT
/begin MEASUREMENT ExchgFix_s.numRamBufValid "F1206: Fix Exchg-RAM-Area: numRamBufValid=0xAF02451D (valid buffered RAM) / " ULONG X1_S1 1 100 0 4294967295 ECU_ADDRESS 0xFFF800FC FORMAT "%13.2" /end MEASUREMENT
/begin MEASUREMENT ExchgFix_s.reserved "F1206: Fix Exchg-RAM-Area: numRamBufValid=0xAF02451D (valid buffered RAM) / " UWORD X1_S1 1 100 0 65535 ECU_ADDRESS 0xFFF800FA FORMAT "%8.2" /end MEASUREMENT
/begin MEASUREMENT MmmCycl_numRamEccEE "F1211: number of RAM-ECC events registered and stored in EE" ULONG X1_S1 1 100 0 4294967295 ECU_ADDRESS 0xFFF94298 FORMAT "%13.2" /end MEASUREMENT
/begin MEASUREMENT MmmCycl_numRomEccEE "F1211: number of ROM-ECC events registered and stored in EE" ULONG X1_S1 1 100 0 4294967295 ECU_ADDRESS 0xFFF9429C FORMAT "%13.2" /end MEASUREMENT
/begin CHARACTERISTIC MsrvMemByAdr_swtAllwDvlpTab_C "F1405: Switches between two permission tables (if MSRV_GEN_PRMS_NUM_TAB==2): TRUE=development/FALSE=series" VALUE 0x191917 AblGLKWub_S1 1 B_TRUE_S1 0 1 FORMAT "%13.11" /end CHARACTERISTIC
/begin MEASUREMENT OmmBc_sPrep "F1740: ECU-status for jump to BC [IDLE WAIT OK PREP]" UBYTE X1_S1 1 100 0 255 ECU_ADDRESS 0xFFF939E0 FORMAT "%5.1" /end MEASUREMENT
/begin CHARACTERISTIC OmmBc_sPrepCfg_C "F1740: Configuration word for changing to BC" VALUE 0x1918CB AblGLKWub_S1 255 X1_S1 0 255 FORMAT "%5.1" /end CHARACTERISTIC
/begin MEASUREMENT OmmInCfg_stIni "F1800: main initialization switch" UBYTE X1_S1 1 100 0 255 ECU_ADDRESS 0xFFF936D0 FORMAT "%5.1" /end MEASUREMENT
/begin MEASUREMENT OmmInCfg_stIniDSM "F1800: DSM init state" UBYTE X1_S1 1 100 0 255 ECU_ADDRESS 0xFFF936D1 FORMAT "%5.1" /end MEASUREMENT
/begin MEASUREMENT OmmInCfg_stIniEE "F1800: state of EE initialization" UBYTE X1_S1 1 100 0 255 ECU_ADDRESS 0xFFF936D2 FORMAT "%5.1" /end MEASUREMENT
/begin MEASUREMENT OmmInCfg_stIniFin "F1800: state of final init task" UBYTE X1_S1 1 100 0 255 ECU_ADDRESS 0xFFF936D3 FORMAT "%5.1" /end MEASUREMENT
/begin MEASUREMENT OmmInCfg_stIniHot "F1800: Init status of hot detection" UBYTE X1_S1 1 100 0 255 ECU_ADDRESS 0xFFF936D4 FORMAT "%5.1" /end MEASUREMENT
/begin MEASUREMENT OmmInCfg_stIniInp "F1800: Init state of input" UBYTE X1_S1 1 100 0 255 ECU_ADDRESS 0xFFF936D5 FORMAT "%5.1" /end MEASUREMENT
/begin MEASUREMENT OmmInCfg_stIniMain "F1800: state of main task in init" UBYTE X1_S1 1 100 0 255 ECU_ADDRESS 0xFFF936D6 FORMAT "%5.1" /end MEASUREMENT
/begin MEASUREMENT OmmInCfg_stIniOps "F1800: Init status of Ops Test" UBYTE X1_S1 1 100 0 255 ECU_ADDRESS 0xFFF936D7 FORMAT "%5.1" /end MEASUREMENT
/begin MEASUREMENT OmmInCfg_stIniOutp "F1800: Init state of output" UBYTE X1_S1 1 100 0 255 ECU_ADDRESS 0xFFF936D8 FORMAT "%5.1" /end MEASUREMENT
/begin MEASUREMENT OmmInCfg_stIniPer "F1800: state of periodic tasks in init" UBYTE X1_S1 1 100 0 255 ECU_ADDRESS 0xFFF936D9 FORMAT "%5.1" /end MEASUREMENT
/begin MEASUREMENT OmmInCfg_stIniRAM "F1800: Init state of NVRAM" UBYTE X1_S1 1 100 0 255 ECU_ADDRESS 0xFFF936DA FORMAT "%5.1" /end MEASUREMENT
/begin MEASUREMENT OmmInCfg_stIniSAF "F1800: Init status of SAF (=safety) system" UBYTE X1_S1 1 100 0 255 ECU_ADDRESS 0xFFF936DB FORMAT "%5.1" /end MEASUREMENT
/begin MEASUREMENT OmmInMgr_bIniOk "F1800: are all init switches processed" UBYTE B_TRUE_S1 1 100 0 1 ECU_ADDRESS 0xFFF936DC FORMAT "%13.11" /end MEASUREMENT
/begin MEASUREMENT OmmInMgr_bStrtTskFin "F1800: Flag: start Final Init Task" UBYTE B_TRUE_S1 1 100 0 1 ECU_ADDRESS 0xFFF936DD FORMAT "%13.11" /end MEASUREMENT
/begin MEASUREMENT OmmInMgr_bStrtTskPer "F1800: Flag: start periodic tasks in init" UBYTE B_TRUE_S1 1 100 0 1 ECU_ADDRESS 0xFFF936DE FORMAT "%13.11" /end MEASUREMENT
/begin MEASUREMENT OmmMdSw_sOpMCur "F1730: Current operating mode" UBYTE X1_M 1 100 0 255 ECU_ADDRESS 0xFFF936AD FORMAT "%5.1" /end MEASUREMENT
/begin MEASUREMENT OmmMdSw_sOpMDest "F1730: Destination operating mode of the OMM" UBYTE X1_M 1 100 0 255 ECU_ADDRESS 0xFFF936AE FORMAT "%5.1" /end MEASUREMENT
/begin MEASUREMENT OmmMdSw_sOpMInt "F1730: Omm internal mode request [FF = No request]" UBYTE X1_M 1 100 0 255 ECU_ADDRESS 0xFFF936AF FORMAT "%5.1" /end MEASUREMENT
/begin MEASUREMENT OmmMdSw_sOpMReq "F1730: Requested operating mode" UBYTE X1_M 1 100 0 255 ECU_ADDRESS 0xFFF936B0 FORMAT "%5.1" /end MEASUREMENT
/begin MEASUREMENT OmmRst_idxOpMode "F1740: actual mode index for reset detection" UBYTE X1_S1 1 100 0 255 ECU_ADDRESS 0xFFF80D1E FORMAT "%5.1" /end MEASUREMENT
/begin MEASUREMENT OmmRst_idxOpModeLast "F1740: Last operating mode" UBYTE X1_S1 1 100 0 255 ECU_ADDRESS 0xFFF939E1 FORMAT "%5.1" /end MEASUREMENT
/begin MEASUREMENT OmmRst_sRst "F1740: Status of running Reset Check" UBYTE X1_S1 1 100 0 255 ECU_ADDRESS 0xFFF939E2 FORMAT "%5.1" /end MEASUREMENT
/begin MEASUREMENT OmmRst_sRstID "F1740: Omme reset marker" ULONG X1_S1 1 100 0 4294967295 ECU_ADDRESS 0xFFF80CE4 FORMAT "%13.2" /end MEASUREMENT
/begin MEASUREMENT OmmSdMgr_bReqCal "F1740: Request calibration hold" UBYTE B_TRUE_S1 1 100 0 1 ECU_ADDRESS 0xFFF936DF FORMAT "%13.11" /end MEASUREMENT
/begin MEASUREMENT OmmSdMgr_bReqHot "F1740: Request for hot shutdown" UBYTE B_TRUE_S1 1 100 0 1 ECU_ADDRESS 0xFFF936E0 FORMAT "%13.11" /end MEASUREMENT
/begin MEASUREMENT OmmSdMgr_bSdnAllow "F1740: status: is switching to SDN allowed" UBYTE B_TRUE_S1 1 100 0 1 ECU_ADDRESS 0xFFF936E1 FORMAT "%13.11" /end MEASUREMENT
/begin MEASUREMENT OmmSdMgr_eReqStd "F1740: Shutdown request (0=no request; 1=standard shutdown request; 2=fast shutdown request;)" UBYTE X1_S1 1 100 0 255 ECU_ADDRESS 0xFFF936E2 FORMAT "%5.1" /end MEASUREMENT
/begin MEASUREMENT OmmSdMgr_stSdn "F1740: state variable of shutdown preparation process" UBYTE X1_S1 1 100 0 255 ECU_ADDRESS 0xFFF936E3 FORMAT "%5.1" /end MEASUREMENT
/begin MEASUREMENT OmmSdMgr_tiExtDly "F1740: Timer for external shutdown delay request" UBYTE TI1_M_CYCLE_S1 1 100 0 1275 ECU_ADDRESS 0xFFF94224 FORMAT "%5.0" /end MEASUREMENT
/begin CHARACTERISTIC OmmSdMgr_xCtl_C "F1740: Control word for shutdown Module" VALUE 0x1914BA AblGLKWuw_S1 65535 X1_S1 0 65535 FORMAT "%8.2" /end CHARACTERISTIC
/begin MEASUREMENT RCT_bIniActvCYC "F1600: Flag cyclic task INI active" UBYTE B_TRUE_M 1 100 0 1 ECU_ADDRESS 0xFFF84BD2 FORMAT "%13.11" /end MEASUREMENT
/begin MEASUREMENT RCT_sIniActvPT "F1600: State periodic tasks INI" UBYTE X1_M 1 100 0 2 ECU_ADDRESS 0xFFF93680 FORMAT "%5.3" /end MEASUREMENT
/begin MEASUREMENT RCT_sModeAct "F1600: Current operating system mode" UBYTE X1_M 1 100 0 255 ECU_ADDRESS 0xFFF84BD1 FORMAT "%5.1" /end MEASUREMENT
/begin MEASUREMENT RCT_sModeActIdx "F1600: Current operating system mode (without no mode information)" UBYTE X1_M 1 100 0 5 ECU_ADDRESS 0xFFF93671 FORMAT "%5.3" /end MEASUREMENT
/begin MEASUREMENT RCT_sModeNxt "F1600: Requested operating system mode" UBYTE X1_M 1 100 0 5 ECU_ADDRESS 0xFFF93672 FORMAT "%5.3" /end MEASUREMENT
/begin MEASUREMENT RCT_tiModeChng "F1600: Duration of operating system mode change" UWORD TI0_001_M_M 1 100 0 65.535 ECU_ADDRESS 0xFFF9099C FORMAT "%8.5" MATRIX_DIM 6 1 1 /end MEASUREMENT
/begin MEASUREMENT ROS_idxDmy "F1600: Dummy variable for use as index of DAMOS tables (value always=0)" UBYTE X1_M 1 100 0 255 ECU_ADDRESS 0xFFF93AB0 FORMAT "%5.1" /end MEASUREMENT
/begin MEASUREMENT RRT_adProcRunMax "F1620: Address of the n longest processes" ULONG X1_M 1 100 0 4294967295 ECU_ADDRESS 0xFFF90C38 FORMAT "%13.2" MATRIX_DIM 5 1 1 /end MEASUREMENT
/begin CHARACTERISTIC RRT_adProcRunSel_C "F1620: Address of the process to be measured" VALUE 0x190130 AblGLKWul_M 4294970000 X1_M 0 4294967295 FORMAT "%13.2" /end CHARACTERISTIC
/begin MEASUREMENT RRT_bCpuLd2Actv "F1620: Flag CPU utilization 2 calculation active" UBYTE B_TRUE_M 1 100 0 1 ECU_ADDRESS 0xFFF93681 FORMAT "%13.11" /end MEASUREMENT
/begin MEASUREMENT RRT_idxProcFrst10 "F1620: Index table for the 10ms task" UWORD X1_M 1 100 0 65535 ECU_ADDRESS 0xFFF91060 FORMAT "%8.2" MATRIX_DIM 8 1 1 /end MEASUREMENT
/begin MEASUREMENT RRT_idxProcFrst100 "F1620: Index table for the 100ms task" UWORD X1_M 1 100 0 65535 ECU_ADDRESS 0xFFF91070 FORMAT "%8.2" MATRIX_DIM 8 1 1 /end MEASUREMENT
/begin MEASUREMENT RRT_idxProcFrst20 "F1620: Index table for the 20ms task" UWORD X1_M 1 100 0 65535 ECU_ADDRESS 0xFFF91080 FORMAT "%8.2" MATRIX_DIM 8 1 1 /end MEASUREMENT
/begin MEASUREMENT RRT_idxProcFrst2X5 "F1620: Index table for the 2.5ms task" UWORD X1_M 1 100 0 65535 ECU_ADDRESS 0xFFF91090 FORMAT "%8.2" MATRIX_DIM 8 1 1 /end MEASUREMENT
/begin MEASUREMENT RRT_idxProcFrst30 "F1620: Index table for the 30ms task" UWORD X1_M 1 100 0 65535 ECU_ADDRESS 0xFFF910A0 FORMAT "%8.2" MATRIX_DIM 8 1 1 /end MEASUREMENT
/begin MEASUREMENT RRT_idxProcFrst5 "F1620: Index table for the 5ms task" UWORD X1_M 1 100 0 65535 ECU_ADDRESS 0xFFF910B0 FORMAT "%8.2" MATRIX_DIM 8 1 1 /end MEASUREMENT
/begin MEASUREMENT RRT_idxProcFrst50 "F1620: Index table for the 50ms task" UWORD X1_M 1 100 0 65535 ECU_ADDRESS 0xFFF910C0 FORMAT "%8.2" MATRIX_DIM 8 1 1 /end MEASUREMENT
/begin MEASUREMENT RRT_idxProcFrstBG "F1620: Index table for the background task" UWORD X1_M 1 100 0 65535 ECU_ADDRESS 0xFFF910D0 FORMAT "%8.2" MATRIX_DIM 8 1 1 /end MEASUREMENT
/begin MEASUREMENT RRT_idxProcFrstFN "F1620: Index table for the final initialization task" UWORD X1_M 1 100 0 65535 ECU_ADDRESS 0xFFF910E0 FORMAT "%8.2" MATRIX_DIM 8 1 1 /end MEASUREMENT
/begin MEASUREMENT RRT_idxProcFrstTRS "F1620: Index table for the transition functions" UWORD X1_M 1 100 0 65535 ECU_ADDRESS 0xFFF910F0 FORMAT "%8.2" MATRIX_DIM 8 1 1 /end MEASUREMENT
/begin MEASUREMENT RRT_rCpuLd "F1620: Current CPU utilization" UWORD R0_1_P_M 1 100 0 100 ECU_ADDRESS 0xFFF931BE FORMAT "%8.4" /end MEASUREMENT
/begin MEASUREMENT RRT_rCpuLd2 "F1620: Current CPU utilization 2 per measurement period" UWORD R0_1_P_M 1 100 0 100 ECU_ADDRESS 0xFFF931C0 FORMAT "%8.4" /end MEASUREMENT
/begin MEASUREMENT RRT_rCpuLd2Avrg "F1620: Current CPU utilization 2 average value per 10 measurement periods" UWORD R0_1_P_M 1 100 0 100 ECU_ADDRESS 0xFFF931C2 FORMAT "%8.4" /end MEASUREMENT
/begin MEASUREMENT RRT_rCpuLd2AvrgMax "F1620: Maximum CPU utilization 2 average value per 10 measurement periods" UWORD R0_1_P_M 1 100 0 100 ECU_ADDRESS 0xFFF931C4 FORMAT "%8.4" /end MEASUREMENT
/begin MEASUREMENT RRT_rCpuLd2Max "F1620: Maximum CPU utilization 2 per measurement period" UWORD R0_1_P_M 1 100 0 100 ECU_ADDRESS 0xFFF931C6 FORMAT "%8.4" /end MEASUREMENT
/begin MEASUREMENT RRT_rCpuLdMax "F1620: Maximum CPU utilization" UWORD R0_1_P_M 1 100 0 100 ECU_ADDRESS 0xFFF931C8 FORMAT "%8.4" /end MEASUREMENT
/begin CHARACTERISTIC RRT_swtCpuLd2_C "F1620: Control switch of the CPU load 2 calculation (0x53AC = on)" VALUE 0x191464 AblGLKWuw_M 65535 X1_M 0 65535 FORMAT "%8.2" /end CHARACTERISTIC
/begin CHARACTERISTIC RRT_swtProcCtlAll_C "F1620: Calibration switch to enable the runtime measurement of all processes" VALUE 0x191883 AblGLKWub_M 1 B_TRUE_M 0 1 FORMAT "%13.11" /end CHARACTERISTIC
/begin CHARACTERISTIC RRT_swtProcCtl_C "F1620: Calibration switch to control the process runtime measurement task/mode specific" MAP 0x190134 AblGLFKFub_M 1 X1_M 0 1
 /begin AXIS_DESCR FIX_AXIS ROS_idxDmy X1_M 6 0 5 READ_ONLY FORMAT "%5.3" FIX_AXIS_PAR_DIST 0 1 6 /end AXIS_DESCR
 /begin AXIS_DESCR FIX_AXIS ROS_idxDmy X1_M 10 0 9 READ_ONLY FORMAT "%5.3" FIX_AXIS_PAR_DIST 0 1 10 /end AXIS_DESCR
 FORMAT "%5.3" /end CHARACTERISTIC
/begin CHARACTERISTIC RRT_swtProcRst_C "F1620: Calibration switch to reset the determination of the n longest processes" VALUE 0x191884 AblGLKWub_M 1 B_TRUE_M 0 1 FORMAT "%13.11" /end CHARACTERISTIC
/begin MEASUREMENT RRT_tiLopCpuLd2 "F1620: Current execution time of loops for CPU load 2 calculation" SLONG TI0_001_M_M 1 100 0 200 ECU_ADDRESS 0xFFF90C30 FORMAT "%13.9" /end MEASUREMENT
/begin CHARACTERISTIC RRT_tiLopCpuLd2_C "F1620: Duration of one loop execution [ns]" VAL_BLK 0x190128 AblGLKWBuw_M 65535 X1_M 0 65535 MATRIX_DIM 4 1 1 FORMAT "%8.2" /end CHARACTERISTIC
/begin MEASUREMENT RRT_tiMeasCpuLd2 "F1620: Current measurement time for CPU load 2 calculation" SLONG TI0_001_M_M 1 100 0 200 ECU_ADDRESS 0xFFF90C34 FORMAT "%13.9" /end MEASUREMENT
/begin CHARACTERISTIC RRT_tiMeasCpuLd2_C "F1620: Measurement time of the CPU load 2 calculation" VALUE 0x191882 AblGLKWub_M 200 TI1_M_M 0 200 FORMAT "%5.1" /end CHARACTERISTIC
/begin MEASUREMENT RRT_tiProcRun10 "F1620: Process runtimes of the 10ms task" UWORD TI0_001_M_M 1 100 0 65.535 ECU_ADDRESS 0xFFF91100 FORMAT "%8.5" MATRIX_DIM 120 1 1 /end MEASUREMENT
/begin MEASUREMENT RRT_tiProcRun100 "F1620: Process runtimes of the 100ms task" UWORD TI0_001_M_M 1 100 0 65.535 ECU_ADDRESS 0xFFF931DE FORMAT "%8.5" MATRIX_DIM 35 1 1 /end MEASUREMENT
/begin MEASUREMENT RRT_tiProcRun20 "F1620: Process runtimes of the 20ms task" UWORD TI0_001_M_M 1 100 0 65.535 ECU_ADDRESS 0xFFF93224 FORMAT "%8.5" MATRIX_DIM 35 1 1 /end MEASUREMENT
/begin MEASUREMENT RRT_tiProcRun2X5 "F1620: Process runtimes of the 2.5ms task" UWORD TI0_001_M_M 1 100 0 65.535 ECU_ADDRESS 0xFFF911F0 FORMAT "%8.5" MATRIX_DIM 20 1 1 /end MEASUREMENT
/begin MEASUREMENT RRT_tiProcRun30 "F1620: Process runtimes of the 30ms task" UWORD TI0_001_M_M 1 100 0 65.535 ECU_ADDRESS 0xFFF91218 FORMAT "%8.5" MATRIX_DIM 50 1 1 /end MEASUREMENT
/begin MEASUREMENT RRT_tiProcRun5 "F1620: Process runtimes of the 5ms task" UWORD TI0_001_M_M 1 100 0 65.535 ECU_ADDRESS 0xFFF9127C FORMAT "%8.5" MATRIX_DIM 40 1 1 /end MEASUREMENT
/begin MEASUREMENT RRT_tiProcRun50 "F1620: Process runtimes of the 50ms task" UWORD TI0_001_M_M 1 100 0 65.535 ECU_ADDRESS 0xFFF912CC FORMAT "%8.5" MATRIX_DIM 20 1 1 /end MEASUREMENT
/begin MEASUREMENT RRT_tiProcRunBG "F1620: Process runtimes of the background task" UWORD TI0_001_M_M 1 100 0 65.535 ECU_ADDRESS 0xFFF912F4 FORMAT "%8.5" MATRIX_DIM 10 1 1 /end MEASUREMENT
/begin MEASUREMENT RRT_tiProcRunFN "F1620: Process runtimes of the final initialization task" UWORD TI0_001_M_M 1 100 0 65.535 ECU_ADDRESS 0xFFF9326A FORMAT "%8.5" MATRIX_DIM 45 1 1 /end MEASUREMENT
/begin CHARACTERISTIC RRT_tiProcRunLoLim_C "F1620: Lower runtime limit for determination of the n longest processes" VALUE 0x191466 AblGLKWuw_M 65.535 TI0_001_M_M 0 65.535 FORMAT "%8.5" /end CHARACTERISTIC
/begin MEASUREMENT RRT_tiProcRunMax "F1620: Runtime of the n longest processes" UWORD TI0_001_M_M 1 100 0 65.535 ECU_ADDRESS 0xFFF931CA FORMAT "%8.5" MATRIX_DIM 5 1 1 /end MEASUREMENT
/begin MEASUREMENT RRT_tiProcRunSel "F1620: Runtime of the selected process" UWORD TI0_001_M_M 1 100 0 65.535 ECU_ADDRESS 0xFFF931D4 FORMAT "%8.5" /end MEASUREMENT
/begin MEASUREMENT RRT_tiProcRunSelMax "F1620: Maximum runtime of the selected process" UWORD TI0_001_M_M 1 100 0 65.535 ECU_ADDRESS 0xFFF931D6 FORMAT "%8.5" /end MEASUREMENT
/begin MEASUREMENT RRT_tiProcRunTRS "F1620: Process runtimes of the transition functions" UWORD TI0_001_M_M 1 100 0 65.535 ECU_ADDRESS 0xFFF932C4 FORMAT "%8.5" MATRIX_DIM 55 1 1 /end MEASUREMENT
/begin MEASUREMENT RamBuf_numClearReq "F1220: Currently registered value of RamBuf_numClearReq_C" UBYTE X1_S1 1 100 0 255 ECU_ADDRESS 0xFFF80C54 FORMAT "%5.1" /end MEASUREMENT
/begin CHARACTERISTIC RamBuf_numClearReq_C "F1220: Buffered RAM clear request which is evaluated upon next system start (0xA5 or 0x5A is possible) (to activate this function, the value has to be changed !)" VALUE 0x191880 AblGLKWub_S1 255 X1_S1 0 255 FORMAT "%5.1" /end CHARACTERISTIC
/begin MEASUREMENT RamBuf_st "F1220: buffered RAM status for fault memory: 0xB5=RAM-valid, others=data loss (RAM cell is cleared when data is stored to permanent memory)" UBYTE X1_S1 1 100 0 255 ECU_ADDRESS 0xFFF80D05 FORMAT "%5.1" /end MEASUREMENT
/begin MEASUREMENT RamBuf_stClear "F1220: Indication that buffered RAM should be cleared after a system start (0xB5)" UBYTE X1_S1 1 100 0 255 ECU_ADDRESS 0xFFF80C55 FORMAT "%5.1" /end MEASUREMENT
/begin MEASUREMENT RamBuf_stStart "F1220: buffered RAM status init after last system start: 0x1D=no, others=yes-data loss" UBYTE X1_S1 1 100 0 255 ECU_ADDRESS 0xFFF80D06 FORMAT "%5.1" /end MEASUREMENT
/begin MEASUREMENT RamCycl_adBegTstNext "F1211: Next address for RAM testing" ULONG X1_S1 1 100 0 4294967295 ECU_ADDRESS 0xFFF928D4 FORMAT "%13.2" /end MEASUREMENT
/begin MEASUREMENT RamCycl_adTstFail "F1211: Last found fault address of RAM testing." ULONG X1_S1 1 100 0 4294967295 ECU_ADDRESS 0xFFF928D8 FORMAT "%13.2" /end MEASUREMENT
/begin MEASUREMENT RamCycl_ctTstCompl "F1211: Counter incremented each time the complete RAM was tested. Counter overflows." UWORD X1_S1 1 100 0 65535 ECU_ADDRESS 0xFFF933B2 FORMAT "%8.2" /end MEASUREMENT
/begin MEASUREMENT RamCycl_stEccForMcor "F1211: ECC Test status for MCor: BIT1=RAM-ECC-Test failed, BIT2=RAM-ECC-ISR-Test failed,  BIT4=ECC-ROM-Test failed" UBYTE X1_S1 1 100 0 255 ECU_ADDRESS 0xFFF939DF FORMAT "%5.1" /end MEASUREMENT
/begin MEASUREMENT RamCycl_stEccTestFailed "F1211: Bit array with bits set each time an EccRamTest-Failure occured (1 Bit for each 16kB segment) (special combination 0x8001=ISR test failed)" UWORD X1_S1 1 100 0 65535 ECU_ADDRESS 0xFFF933B0 FORMAT "%8.2" /end MEASUREMENT
/begin CHARACTERISTIC RamStckMon_bRstDat_C "F1270: Flag to clear stored information (if TRUE)" VALUE 0x191918 AblGLKWub_S1 1 B_TRUE_S1 0 1 FORMAT "%13.11" /end CHARACTERISTIC
/begin MEASUREMENT RamStckMon_numMaxUsd "F1270: Maximum used stack in bytes" UWORD X1_S1 1 100 0 10240 ECU_ADDRESS 0xFFF9350A FORMAT "%8.2" /end MEASUREMENT
/begin MEASUREMENT RamStckMon_numMaxUsdStrd "F1270: Maximum used stack in bytes, stored in EEPROM" UWORD X1_S1 1 100 0 10240 ECU_ADDRESS 0xFFF9439A FORMAT "%8.2" /end MEASUREMENT
/begin MEASUREMENT RamStckMon_numMinFreeStrd "F1270: Minimum free stack in bytes, stored in EEPROM" UWORD X1_S1 1 100 0 10240 ECU_ADDRESS 0xFFF9439C FORMAT "%8.2" /end MEASUREMENT
/begin MEASUREMENT RamStckMon_rMaxUsd "F1270: Maximum used stack in percent" UWORD R0_1_P_S1 1 100 0 100 ECU_ADDRESS 0xFFF9350C FORMAT "%8.4" /end MEASUREMENT
/begin MEASUREMENT RamStckMon_stFault "F1270: Bit map for detected faults, will only be written if no reset is configured (B0:underflow, B1:overflow)" UBYTE X1_S1 1 100 0 3 ECU_ADDRESS 0xFFF93B30 FORMAT "%5.3" /end MEASUREMENT
/begin MEASUREMENT RctT10.ctActv "F1600: Task counter for 10ms task / Activation counter" UWORD X1_M 1 100 0 65535 ECU_ADDRESS 0xFFF93140 FORMAT "%8.2" /end MEASUREMENT
/begin MEASUREMENT RctT10.ctExe "F1600: Task counter for 10ms task / Execution counter" UWORD X1_M 1 100 0 65535 ECU_ADDRESS 0xFFF93142 FORMAT "%8.2" /end MEASUREMENT
/begin MEASUREMENT RctT10.ctOvrFlw "F1600: Task counter for 10ms task / Overflow counter" UWORD X1_M 1 100 0 65535 ECU_ADDRESS 0xFFF93144 FORMAT "%8.2" /end MEASUREMENT
/begin MEASUREMENT RctT100.ctActv "F1600: Task counter for 100ms task / Activation counter" UWORD X1_M 1 100 0 65535 ECU_ADDRESS 0xFFF93146 FORMAT "%8.2" /end MEASUREMENT
/begin MEASUREMENT RctT100.ctExe "F1600: Task counter for 100ms task / Execution counter" UWORD X1_M 1 100 0 65535 ECU_ADDRESS 0xFFF93148 FORMAT "%8.2" /end MEASUREMENT
/begin MEASUREMENT RctT100.ctOvrFlw "F1600: Task counter for 100ms task / Overflow counter" UWORD X1_M 1 100 0 65535 ECU_ADDRESS 0xFFF9314A FORMAT "%8.2" /end MEASUREMENT
/begin MEASUREMENT RctT20.ctActv "F1600: Task counter for 20ms task / Activation counter" UWORD X1_M 1 100 0 65535 ECU_ADDRESS 0xFFF9314C FORMAT "%8.2" /end MEASUREMENT
/begin MEASUREMENT RctT20.ctExe "F1600: Task counter for 20ms task / Execution counter" UWORD X1_M 1 100 0 65535 ECU_ADDRESS 0xFFF9314E FORMAT "%8.2" /end MEASUREMENT
/begin MEASUREMENT RctT20.ctOvrFlw "F1600: Task counter for 20ms task / Overflow counter" UWORD X1_M 1 100 0 65535 ECU_ADDRESS 0xFFF93150 FORMAT "%8.2" /end MEASUREMENT
/begin MEASUREMENT RctT2x5.ctActv "F1600: Task counter for 2.5ms task / Activation counter" UWORD X1_M 1 100 0 65535 ECU_ADDRESS 0xFFF93152 FORMAT "%8.2" /end MEASUREMENT
/begin MEASUREMENT RctT2x5.ctExe "F1600: Task counter for 2.5ms task / Execution counter" UWORD X1_M 1 100 0 65535 ECU_ADDRESS 0xFFF93154 FORMAT "%8.2" /end MEASUREMENT
/begin MEASUREMENT RctT2x5.ctOvrFlw "F1600: Task counter for 2.5ms task / Overflow counter" UWORD X1_M 1 100 0 65535 ECU_ADDRESS 0xFFF93156 FORMAT "%8.2" /end MEASUREMENT
/begin MEASUREMENT RctT30.ctActv "F1600: Task counter for 30ms task / Activation counter" UWORD X1_M 1 100 0 65535 ECU_ADDRESS 0xFFF93158 FORMAT "%8.2" /end MEASUREMENT
/begin MEASUREMENT RctT30.ctExe "F1600: Task counter for 30ms task / Execution counter" UWORD X1_M 1 100 0 65535 ECU_ADDRESS 0xFFF9315A FORMAT "%8.2" /end MEASUREMENT
/begin MEASUREMENT RctT30.ctOvrFlw "F1600: Task counter for 30ms task / Overflow counter" UWORD X1_M 1 100 0 65535 ECU_ADDRESS 0xFFF9315C FORMAT "%8.2" /end MEASUREMENT
/begin MEASUREMENT RctT5.ctActv "F1600: Task counter for 5ms task / Activation counter" UWORD X1_M 1 100 0 65535 ECU_ADDRESS 0xFFF9315E FORMAT "%8.2" /end MEASUREMENT
/begin MEASUREMENT RctT5.ctExe "F1600: Task counter for 5ms task / Execution counter" UWORD X1_M 1 100 0 65535 ECU_ADDRESS 0xFFF93160 FORMAT "%8.2" /end MEASUREMENT
/begin MEASUREMENT RctT5.ctOvrFlw "F1600: Task counter for 5ms task / Overflow counter" UWORD X1_M 1 100 0 65535 ECU_ADDRESS 0xFFF93162 FORMAT "%8.2" /end MEASUREMENT
/begin MEASUREMENT RctT50.ctActv "F1600: Task counter for 50ms task / Activation counter" UWORD X1_M 1 100 0 65535 ECU_ADDRESS 0xFFF93164 FORMAT "%8.2" /end MEASUREMENT
/begin MEASUREMENT RctT50.ctExe "F1600: Task counter for 50ms task / Execution counter" UWORD X1_M 1 100 0 65535 ECU_ADDRESS 0xFFF93166 FORMAT "%8.2" /end MEASUREMENT
/begin MEASUREMENT RctT50.ctOvrFlw "F1600: Task counter for 50ms task / Overflow counter" UWORD X1_M 1 100 0 65535 ECU_ADDRESS 0xFFF93168 FORMAT "%8.2" /end MEASUREMENT
/begin MEASUREMENT RmnT10.ctStop "F1630: Task monitoring variables for 10ms task / Task stop counter" UWORD X1_M 1 100 0 65535 ECU_ADDRESS 0xFFF9316E FORMAT "%8.2" /end MEASUREMENT
/begin MEASUREMENT RmnT10.ctStrt "F1630: Task monitoring variables for 10ms task / Task start counter" UWORD X1_M 1 100 0 65535 ECU_ADDRESS 0xFFF93170 FORMAT "%8.2" /end MEASUREMENT
/begin MEASUREMENT RmnT10.sMon "F1630: Task monitoring variables for 10ms task / State of the enhanced task monitoring" UBYTE X1_M 1 100 0 2 ECU_ADDRESS 0xFFF9316A FORMAT "%5.3" /end MEASUREMENT
/begin MEASUREMENT RmnT10.tiOvrFlw "F1630: Task monitoring variables for 10ms task / Time stamp taken at task overflow" UWORD TI1_M_M 1 100 0 65535 ECU_ADDRESS 0xFFF9316C FORMAT "%8.2" /end MEASUREMENT
/begin MEASUREMENT RmnT10.tiStrt "F1630: Task monitoring variables for 10ms task / Time stamp taken at start of task" UWORD TI1_M_M 1 100 0 65535 ECU_ADDRESS 0xFFF93172 FORMAT "%8.2" /end MEASUREMENT
/begin MEASUREMENT RmnT100.ctStop "F1630: Task monitoring variables for 100ms task / Task stop counter" UWORD X1_M 1 100 0 65535 ECU_ADDRESS 0xFFF9317C FORMAT "%8.2" /end MEASUREMENT
/begin MEASUREMENT RmnT100.ctStrt "F1630: Task monitoring variables for 100ms task / Task start counter" UWORD X1_M 1 100 0 65535 ECU_ADDRESS 0xFFF9317E FORMAT "%8.2" /end MEASUREMENT
/begin MEASUREMENT RmnT100.sMon "F1630: Task monitoring variables for 100ms task / State of the enhanced task monitoring" UBYTE X1_M 1 100 0 2 ECU_ADDRESS 0xFFF93178 FORMAT "%5.3" /end MEASUREMENT
/begin MEASUREMENT RmnT100.tiOvrFlw "F1630: Task monitoring variables for 100ms task / Time stamp taken at task overflow" UWORD TI1_M_M 1 100 0 65535 ECU_ADDRESS 0xFFF9317A FORMAT "%8.2" /end MEASUREMENT
/begin MEASUREMENT RmnT100.tiStrt "F1630: Task monitoring variables for 100ms task / Time stamp taken at start of task" UWORD TI1_M_M 1 100 0 65535 ECU_ADDRESS 0xFFF93180 FORMAT "%8.2" /end MEASUREMENT
/begin CHARACTERISTIC RmnT100_tiMon_C "F1630: Monitoring time for 100ms task (no SERAP)" VALUE 0x191440 AblGLKWuw_M 65535 TI1_M_M 0 65535 FORMAT "%8.2" /end CHARACTERISTIC
/begin CHARACTERISTIC RmnT100_tiTOutSngl_C "F1630: Time out for single overflow of 100ms task (no SERAP)" VALUE 0x191442 AblGLKWuw_M 65535 TI1_M_M 0 65535 FORMAT "%8.2" /end CHARACTERISTIC
/begin CHARACTERISTIC RmnT100_tiTOut_C "F1630: Time out of 100ms task (no SERAP)" VALUE 0x191444 AblGLKWuw_M 65535 TI1_M_M 0 65535 FORMAT "%8.2" /end CHARACTERISTIC
/begin CHARACTERISTIC RmnT10_tiMon_C "F1630: Monitoring time for 10ms task (no SERAP)" VALUE 0x191446 AblGLKWuw_M 65535 TI1_M_M 0 65535 FORMAT "%8.2" /end CHARACTERISTIC
/begin CHARACTERISTIC RmnT10_tiTOutSngl_C "F1630: Time out for single overflow of 10ms task (no SERAP)" VALUE 0x191448 AblGLKWuw_M 65535 TI1_M_M 0 65535 FORMAT "%8.2" /end CHARACTERISTIC
/begin CHARACTERISTIC RmnT10_tiTOut_C "F1630: Time out of 10ms task (no SERAP)" VALUE 0x19144A AblGLKWuw_M 65535 TI1_M_M 0 65535 FORMAT "%8.2" /end CHARACTERISTIC
/begin MEASUREMENT RmnT20.ctStop "F1630: Task monitoring variables for 20ms task / Task stop counter" UWORD X1_M 1 100 0 65535 ECU_ADDRESS 0xFFF9318A FORMAT "%8.2" /end MEASUREMENT
/begin MEASUREMENT RmnT20.ctStrt "F1630: Task monitoring variables for 20ms task / Task start counter" UWORD X1_M 1 100 0 65535 ECU_ADDRESS 0xFFF9318C FORMAT "%8.2" /end MEASUREMENT
/begin MEASUREMENT RmnT20.sMon "F1630: Task monitoring variables for 20ms task / State of the enhanced task monitoring" UBYTE X1_M 1 100 0 2 ECU_ADDRESS 0xFFF93186 FORMAT "%5.3" /end MEASUREMENT
/begin MEASUREMENT RmnT20.tiOvrFlw "F1630: Task monitoring variables for 20ms task / Time stamp taken at task overflow" UWORD TI1_M_M 1 100 0 65535 ECU_ADDRESS 0xFFF93188 FORMAT "%8.2" /end MEASUREMENT
/begin MEASUREMENT RmnT20.tiStrt "F1630: Task monitoring variables for 20ms task / Time stamp taken at start of task" UWORD TI1_M_M 1 100 0 65535 ECU_ADDRESS 0xFFF9318E FORMAT "%8.2" /end MEASUREMENT
/begin CHARACTERISTIC RmnT20_tiMon_C "F1630: Monitoring time for 20ms task (no SERAP)" VALUE 0x19144C AblGLKWuw_M 65535 TI1_M_M 0 65535 FORMAT "%8.2" /end CHARACTERISTIC
/begin CHARACTERISTIC RmnT20_tiTOutSngl_C "F1630: Time out for single overflow of 20ms task (no SERAP)" VALUE 0x19144E AblGLKWuw_M 65535 TI1_M_M 0 65535 FORMAT "%8.2" /end CHARACTERISTIC
/begin CHARACTERISTIC RmnT20_tiTOut_C "F1630: Time out of 20ms task (no SERAP)" VALUE 0x191450 AblGLKWuw_M 65535 TI1_M_M 0 65535 FORMAT "%8.2" /end CHARACTERISTIC
/begin MEASUREMENT RmnT30.ctStop "F1630: Task monitoring variables for 30ms task / Task stop counter" UWORD X1_M 1 100 0 65535 ECU_ADDRESS 0xFFF93198 FORMAT "%8.2" /end MEASUREMENT
/begin MEASUREMENT RmnT30.ctStrt "F1630: Task monitoring variables for 30ms task / Task start counter" UWORD X1_M 1 100 0 65535 ECU_ADDRESS 0xFFF9319A FORMAT "%8.2" /end MEASUREMENT
/begin MEASUREMENT RmnT30.sMon "F1630: Task monitoring variables for 30ms task / State of the enhanced task monitoring" UBYTE X1_M 1 100 0 2 ECU_ADDRESS 0xFFF93194 FORMAT "%5.3" /end MEASUREMENT
/begin MEASUREMENT RmnT30.tiOvrFlw "F1630: Task monitoring variables for 30ms task / Time stamp taken at task overflow" UWORD TI1_M_M 1 100 0 65535 ECU_ADDRESS 0xFFF93196 FORMAT "%8.2" /end MEASUREMENT
/begin MEASUREMENT RmnT30.tiStrt "F1630: Task monitoring variables for 30ms task / Time stamp taken at start of task" UWORD TI1_M_M 1 100 0 65535 ECU_ADDRESS 0xFFF9319C FORMAT "%8.2" /end MEASUREMENT
/begin CHARACTERISTIC RmnT30_tiMon_C "F1630: Monitoring time for 30ms task (no SERAP)" VALUE 0x191452 AblGLKWuw_M 65535 TI1_M_M 0 65535 FORMAT "%8.2" /end CHARACTERISTIC
/begin CHARACTERISTIC RmnT30_tiTOutSngl_C "F1630: Time out for single overflow of 30ms task (no SERAP)" VALUE 0x191454 AblGLKWuw_M 65535 TI1_M_M 0 65535 FORMAT "%8.2" /end CHARACTERISTIC
/begin CHARACTERISTIC RmnT30_tiTOut_C "F1630: Time out of 30ms task (no SERAP)" VALUE 0x191456 AblGLKWuw_M 65535 TI1_M_M 0 65535 FORMAT "%8.2" /end CHARACTERISTIC
/begin MEASUREMENT RmnT5.ctStop "F1630: Task monitoring variables for 5ms task / Task stop counter" UWORD X1_M 1 100 0 65535 ECU_ADDRESS 0xFFF931A6 FORMAT "%8.2" /end MEASUREMENT
/begin MEASUREMENT RmnT5.ctStrt "F1630: Task monitoring variables for 5ms task / Task start counter" UWORD X1_M 1 100 0 65535 ECU_ADDRESS 0xFFF931A8 FORMAT "%8.2" /end MEASUREMENT
/begin MEASUREMENT RmnT5.sMon "F1630: Task monitoring variables for 5ms task / State of the enhanced task monitoring" UBYTE X1_M 1 100 0 2 ECU_ADDRESS 0xFFF931A2 FORMAT "%5.3" /end MEASUREMENT
/begin MEASUREMENT RmnT5.tiOvrFlw "F1630: Task monitoring variables for 5ms task / Time stamp taken at task overflow" UWORD TI1_M_M 1 100 0 65535 ECU_ADDRESS 0xFFF931A4 FORMAT "%8.2" /end MEASUREMENT
/begin MEASUREMENT RmnT5.tiStrt "F1630: Task monitoring variables for 5ms task / Time stamp taken at start of task" UWORD TI1_M_M 1 100 0 65535 ECU_ADDRESS 0xFFF931AA FORMAT "%8.2" /end MEASUREMENT
/begin MEASUREMENT RmnT50.ctStop "F1630: Task monitoring variables for 50ms task / Task stop counter" UWORD X1_M 1 100 0 65535 ECU_ADDRESS 0xFFF931B4 FORMAT "%8.2" /end MEASUREMENT
/begin MEASUREMENT RmnT50.ctStrt "F1630: Task monitoring variables for 50ms task / Task start counter" UWORD X1_M 1 100 0 65535 ECU_ADDRESS 0xFFF931B6 FORMAT "%8.2" /end MEASUREMENT
/begin MEASUREMENT RmnT50.sMon "F1630: Task monitoring variables for 50ms task / State of the enhanced task monitoring" UBYTE X1_M 1 100 0 2 ECU_ADDRESS 0xFFF931B0 FORMAT "%5.3" /end MEASUREMENT
/begin MEASUREMENT RmnT50.tiOvrFlw "F1630: Task monitoring variables for 50ms task / Time stamp taken at task overflow" UWORD TI1_M_M 1 100 0 65535 ECU_ADDRESS 0xFFF931B2 FORMAT "%8.2" /end MEASUREMENT
/begin MEASUREMENT RmnT50.tiStrt "F1630: Task monitoring variables for 50ms task / Time stamp taken at start of task" UWORD TI1_M_M 1 100 0 65535 ECU_ADDRESS 0xFFF931B8 FORMAT "%8.2" /end MEASUREMENT
/begin CHARACTERISTIC RmnT50_tiMon_C "F1630: Monitoring time for 50ms task (no SERAP)" VALUE 0x191458 AblGLKWuw_M 65535 TI1_M_M 0 65535 FORMAT "%8.2" /end CHARACTERISTIC
/begin CHARACTERISTIC RmnT50_tiTOutSngl_C "F1630: Time out for single overflow of 50ms task (no SERAP)" VALUE 0x19145A AblGLKWuw_M 65535 TI1_M_M 0 65535 FORMAT "%8.2" /end CHARACTERISTIC
/begin CHARACTERISTIC RmnT50_tiTOut_C "F1630: Time out of 50ms task (no SERAP)" VALUE 0x19145C AblGLKWuw_M 65535 TI1_M_M 0 65535 FORMAT "%8.2" /end CHARACTERISTIC
/begin CHARACTERISTIC RmnT5_tiMon_C "F1630: Monitoring time for 5ms task (no SERAP)" VALUE 0x19145E AblGLKWuw_M 65535 TI1_M_M 0 65535 FORMAT "%8.2" /end CHARACTERISTIC
/begin CHARACTERISTIC RmnT5_tiTOutSngl_C "F1630: Time out for single overflow of 5ms task (no SERAP)" VALUE 0x191460 AblGLKWuw_M 65535 TI1_M_M 0 65535 FORMAT "%8.2" /end CHARACTERISTIC
/begin CHARACTERISTIC RmnT5_tiTOut_C "F1630: Time out of 5ms task (no SERAP)" VALUE 0x191462 AblGLKWuw_M 65535 TI1_M_M 0 65535 FORMAT "%8.2" /end CHARACTERISTIC
/begin MEASUREMENT Rom_RomChsCycTst_adCurrEnd "F1350: store the current stop adr of the current area" ULONG X1_S1 1 100 0 4294967295 ECU_ADDRESS 0xFFF94798 FORMAT "%13.2" MATRIX_DIM 5 1 1 /end MEASUREMENT
/begin MEASUREMENT Rom_RomChsCycTst_adCurrStrt "F1350: store the current start adr of the current area, to calc next start adr" ULONG X1_S1 1 100 0 4294967295 ECU_ADDRESS 0xFFF947AC FORMAT "%13.2" MATRIX_DIM 5 1 1 /end MEASUREMENT
/begin MEASUREMENT Rom_RomChsCycTst_adTmpCurrStrt "F1350: temp end adr for the current area. To compare with the given end adr" ULONG X1_S1 1 100 0 4294967295 ECU_ADDRESS 0xFFF947C0 FORMAT "%13.2" /end MEASUREMENT
/begin MEASUREMENT Rom_RomChsCycTst_ctChsAllTst "F1350: Counter, how often a complete analysis off all checksum areas was done." UWORD X1_S1 1 100 0 65535 ECU_ADDRESS 0xFFF93350 FORMAT "%8.2" /end MEASUREMENT
/begin MEASUREMENT Rom_RomChsCycTst_ctCurrDneAr "F1350: store the running index of the checksum area which is current in work" UBYTE X1_S1 1 100 0 255 ECU_ADDRESS 0xFFF936CE FORMAT "%5.1" /end MEASUREMENT
/begin MEASUREMENT Rom_RomChsCycTst_stChsInfo "F1350: Bit coded. Bit0: Chs calc is ready, Bit1: Chs calc is not ready" UBYTE X1_S1 1 100 0 255 ECU_ADDRESS 0xFFF936CF FORMAT "%5.1" /end MEASUREMENT
/begin MEASUREMENT Rom_RomChsCycTst_stChsMonDisbl "F1350: Measurement variable to see if the monitoring is disable (Bit coded) 0=mon is active 1=mon is disable" UWORD X1_S1 1 100 0 65535 ECU_ADDRESS 0xFFF93352 FORMAT "%8.2" /end MEASUREMENT
/begin MEASUREMENT Rom_RomChsCycTst_stFault "F1350: Variable to measure the faults of the Checksum monitoring system (bit coded for further information take a look in the documentation)" UWORD X1_S1 1 100 0 65535 ECU_ADDRESS 0xFFF93354 FORMAT "%8.2" /end MEASUREMENT
/begin MEASUREMENT Rom_RomChsCycTst_stTest "F1350: Variable to measure the test conditions of the Checksum monitoring system (bit coded for further information take a look in the documentation)" UWORD X1_S1 1 100 0 65535 ECU_ADDRESS 0xFFF93356 FORMAT "%8.2" /end MEASUREMENT
/begin MEASUREMENT Rom_RomChsCycTst_tiStamp1ms "F1350: Timestamp in 1ms, after the first complete analysis off all checksum areas was done." ULONG X1_S1 1 100 0 4294967295 ECU_ADDRESS 0xFFF91F64 FORMAT "%13.2" /end MEASUREMENT
/begin MEASUREMENT Rom_RomChsCycTst_xCfgInfo "F1350: configuration information of the checksum areas" UWORD X1_S1 1 100 0 65534 ECU_ADDRESS 0xFFF94884 FORMAT "%8.2" MATRIX_DIM 5 1 1 /end MEASUREMENT
/begin MEASUREMENT Rom_RomChsCycTst_xCurrChs "F1350: store the chs of the current chs area, needed to compare the calc chs" ULONG X1_S1 1 100 0 4294967295 ECU_ADDRESS 0xFFF947C4 FORMAT "%13.2" MATRIX_DIM 5 1 1 /end MEASUREMENT
/begin MEASUREMENT Rom_RomChsCycTst_xTmpCurrChs "F1350: store the current checksum of the current area" ULONG X1_S1 1 100 0 4294967295 ECU_ADDRESS 0xFFF91F68 FORMAT "%13.2" /end MEASUREMENT
/begin MEASUREMENT Rom_RomChsTstRef "F1350: Reference checksums" ULONG X1_S1 1 100 0 4294967295 ECU_ADDRESS 0xFFF91F6C FORMAT "%13.2" MATRIX_DIM 5 1 1 /end MEASUREMENT
/begin MEASUREMENT Rom_RomChsTstRslt "F1350: Calculated checksums" ULONG X1_S1 1 100 0 4294967295 ECU_ADDRESS 0xFFF91F80 FORMAT "%13.2" MATRIX_DIM 5 1 1 /end MEASUREMENT
/begin MEASUREMENT Rom_RomChsTstRsltStrd "F1350: Calculated checksums (stored in EEPROM)" ULONG X1_S1 1 100 0 4294967295 ECU_ADDRESS 0xFFF94284 FORMAT "%13.2" MATRIX_DIM 5 1 1 /end MEASUREMENT
/begin CHARACTERISTIC Rom_stMonActvCpl_C "F1351: Complement status if the ROM checksum is active or not. Bit coded 0=active 1=not active" VALUE 0x1914B6 AblGLKWuw_S1 65535 X1_S1 0 65535 FORMAT "%8.2" /end CHARACTERISTIC
/begin CHARACTERISTIC Rom_stMonActv_C "F1351: Status if the ROM checksum is active or not. Bit coded 1=active 0=not active" VALUE 0x1914B8 AblGLKWuw_S1 65535 X1_S1 0 65535 FORMAT "%8.2" /end CHARACTERISTIC
/begin MEASUREMENT RrtFgp0.tiRun "F1620: Runtime measurement for functional group 0 / Runtime of the functional group" UWORD TI0_001_M_M 1 100 0 65.535 ECU_ADDRESS 0xFFF90FA4 FORMAT "%8.5" /end MEASUREMENT
/begin MEASUREMENT RrtFgp0.tiRunMax "F1620: Runtime measurement for functional group 0 / Maximum runtime of the functional group" UWORD TI0_001_M_M 1 100 0 65.535 ECU_ADDRESS 0xFFF90FA6 FORMAT "%8.5" /end MEASUREMENT
/begin MEASUREMENT RrtFgp1.tiRun "F1620: Runtime measurement for functional group 1 / Runtime of the functional group" UWORD TI0_001_M_M 1 100 0 65.535 ECU_ADDRESS 0xFFF90FB8 FORMAT "%8.5" /end MEASUREMENT
/begin MEASUREMENT RrtFgp1.tiRunMax "F1620: Runtime measurement for functional group 1 / Maximum runtime of the functional group" UWORD TI0_001_M_M 1 100 0 65.535 ECU_ADDRESS 0xFFF90FBA FORMAT "%8.5" /end MEASUREMENT
/begin MEASUREMENT RrtFgp2.tiRun "F1620: Runtime measurement for functional group 2 / Runtime of the functional group" UWORD TI0_001_M_M 1 100 0 65.535 ECU_ADDRESS 0xFFF90FCC FORMAT "%8.5" /end MEASUREMENT
/begin MEASUREMENT RrtFgp2.tiRunMax "F1620: Runtime measurement for functional group 2 / Maximum runtime of the functional group" UWORD TI0_001_M_M 1 100 0 65.535 ECU_ADDRESS 0xFFF90FCE FORMAT "%8.5" /end MEASUREMENT
/begin MEASUREMENT RrtFgp3.tiRun "F1620: Runtime measurement for functional group 3 / Runtime of the functional group" UWORD TI0_001_M_M 1 100 0 65.535 ECU_ADDRESS 0xFFF90FE0 FORMAT "%8.5" /end MEASUREMENT
/begin MEASUREMENT RrtFgp3.tiRunMax "F1620: Runtime measurement for functional group 3 / Maximum runtime of the functional group" UWORD TI0_001_M_M 1 100 0 65.535 ECU_ADDRESS 0xFFF90FE2 FORMAT "%8.5" /end MEASUREMENT
/begin MEASUREMENT RrtFgp4.tiRun "F1620: Runtime measurement for functional group 4 / Runtime of the functional group" UWORD TI0_001_M_M 1 100 0 65.535 ECU_ADDRESS 0xFFF90FF4 FORMAT "%8.5" /end MEASUREMENT
/begin MEASUREMENT RrtFgp4.tiRunMax "F1620: Runtime measurement for functional group 4 / Maximum runtime of the functional group" UWORD TI0_001_M_M 1 100 0 65.535 ECU_ADDRESS 0xFFF90FF6 FORMAT "%8.5" /end MEASUREMENT
/begin MEASUREMENT RrtFgp5.tiRun "F1620: Runtime measurement for functional group 5 / Runtime of the functional group" UWORD TI0_001_M_M 1 100 0 65.535 ECU_ADDRESS 0xFFF91008 FORMAT "%8.5" /end MEASUREMENT
/begin MEASUREMENT RrtFgp5.tiRunMax "F1620: Runtime measurement for functional group 5 / Maximum runtime of the functional group" UWORD TI0_001_M_M 1 100 0 65.535 ECU_ADDRESS 0xFFF9100A FORMAT "%8.5" /end MEASUREMENT
/begin MEASUREMENT RrtFgp6.tiRun "F1620: Runtime measurement for functional group 6 / Runtime of the functional group" UWORD TI0_001_M_M 1 100 0 65.535 ECU_ADDRESS 0xFFF9101C FORMAT "%8.5" /end MEASUREMENT
/begin MEASUREMENT RrtFgp6.tiRunMax "F1620: Runtime measurement for functional group 6 / Maximum runtime of the functional group" UWORD TI0_001_M_M 1 100 0 65.535 ECU_ADDRESS 0xFFF9101E FORMAT "%8.5" /end MEASUREMENT
/begin MEASUREMENT RrtFgp7.tiRun "F1620: Runtime measurement for functional group 7 / Runtime of the functional group" UWORD TI0_001_M_M 1 100 0 65.535 ECU_ADDRESS 0xFFF91030 FORMAT "%8.5" /end MEASUREMENT
/begin MEASUREMENT RrtFgp7.tiRunMax "F1620: Runtime measurement for functional group 7 / Maximum runtime of the functional group" UWORD TI0_001_M_M 1 100 0 65.535 ECU_ADDRESS 0xFFF91032 FORMAT "%8.5" /end MEASUREMENT
/begin MEASUREMENT RrtFgp8.tiRun "F1620: Runtime measurement for functional group 8 / Runtime of the functional group" UWORD TI0_001_M_M 1 100 0 65.535 ECU_ADDRESS 0xFFF91044 FORMAT "%8.5" /end MEASUREMENT
/begin MEASUREMENT RrtFgp8.tiRunMax "F1620: Runtime measurement for functional group 8 / Maximum runtime of the functional group" UWORD TI0_001_M_M 1 100 0 65.535 ECU_ADDRESS 0xFFF91046 FORMAT "%8.5" /end MEASUREMENT
/begin MEASUREMENT RrtFgp9.tiRun "F1620: Runtime measurement for functional group 9 / Runtime of the functional group" UWORD TI0_001_M_M 1 100 0 65.535 ECU_ADDRESS 0xFFF91058 FORMAT "%8.5" /end MEASUREMENT
/begin MEASUREMENT RrtFgp9.tiRunMax "F1620: Runtime measurement for functional group 9 / Maximum runtime of the functional group" UWORD TI0_001_M_M 1 100 0 65.535 ECU_ADDRESS 0xFFF9105A FORMAT "%8.5" /end MEASUREMENT
/begin MEASUREMENT RrtIsr0.ctExe "F1620: Runtime measurement for interrupt 0 / Number of interrupts per measurement period" UWORD X1_M 1 100 0 65535 ECU_ADDRESS 0xFFF90AC8 FORMAT "%8.2" /end MEASUREMENT
/begin MEASUREMENT RrtIsr0.tiRunSum "F1620: Runtime measurement for interrupt 0 / Sum of interrupt runtime per measurement period" UWORD TI0_001_M_M 1 100 0 65.535 ECU_ADDRESS 0xFFF90AC4 FORMAT "%8.5" /end MEASUREMENT
/begin MEASUREMENT RrtIsr1.ctExe "F1620: Runtime measurement for interrupt 1 / Number of interrupts per measurement period" UWORD X1_M 1 100 0 65535 ECU_ADDRESS 0xFFF90AE0 FORMAT "%8.2" /end MEASUREMENT
/begin MEASUREMENT RrtIsr1.tiRunSum "F1620: Runtime measurement for interrupt 1 / Sum of interrupt runtime per measurement period" UWORD TI0_001_M_M 1 100 0 65.535 ECU_ADDRESS 0xFFF90ADC FORMAT "%8.5" /end MEASUREMENT
/begin MEASUREMENT RrtIsr2.ctExe "F1620: Runtime measurement for interrupt 2 / Number of interrupts per measurement period" UWORD X1_M 1 100 0 65535 ECU_ADDRESS 0xFFF90AF8 FORMAT "%8.2" /end MEASUREMENT
/begin MEASUREMENT RrtIsr2.tiRunSum "F1620: Runtime measurement for interrupt 2 / Sum of interrupt runtime per measurement period" UWORD TI0_001_M_M 1 100 0 65.535 ECU_ADDRESS 0xFFF90AF4 FORMAT "%8.5" /end MEASUREMENT
/begin MEASUREMENT RrtIsr3.ctExe "F1620: Runtime measurement for interrupt 3 / Number of interrupts per measurement period" UWORD X1_M 1 100 0 65535 ECU_ADDRESS 0xFFF90B10 FORMAT "%8.2" /end MEASUREMENT
/begin MEASUREMENT RrtIsr3.tiRunSum "F1620: Runtime measurement for interrupt 3 / Sum of interrupt runtime per measurement period" UWORD TI0_001_M_M 1 100 0 65.535 ECU_ADDRESS 0xFFF90B0C FORMAT "%8.5" /end MEASUREMENT
/begin MEASUREMENT RrtIsr4.ctExe "F1620: Runtime measurement for interrupt 4 / Number of interrupts per measurement period" UWORD X1_M 1 100 0 65535 ECU_ADDRESS 0xFFF90B28 FORMAT "%8.2" /end MEASUREMENT
/begin MEASUREMENT RrtIsr4.tiRunSum "F1620: Runtime measurement for interrupt 4 / Sum of interrupt runtime per measurement period" UWORD TI0_001_M_M 1 100 0 65.535 ECU_ADDRESS 0xFFF90B24 FORMAT "%8.5" /end MEASUREMENT
/begin MEASUREMENT RrtIsr5.ctExe "F1620: Runtime measurement for interrupt 5 / Number of interrupts per measurement period" UWORD X1_M 1 100 0 65535 ECU_ADDRESS 0xFFF90B40 FORMAT "%8.2" /end MEASUREMENT
/begin MEASUREMENT RrtIsr5.tiRunSum "F1620: Runtime measurement for interrupt 5 / Sum of interrupt runtime per measurement period" UWORD TI0_001_M_M 1 100 0 65.535 ECU_ADDRESS 0xFFF90B3C FORMAT "%8.5" /end MEASUREMENT
/begin MEASUREMENT RrtIsr6.ctExe "F1620: Runtime measurement for interrupt 6 / Number of interrupts per measurement period" UWORD X1_M 1 100 0 65535 ECU_ADDRESS 0xFFF90B58 FORMAT "%8.2" /end MEASUREMENT
/begin MEASUREMENT RrtIsr6.tiRunSum "F1620: Runtime measurement for interrupt 6 / Sum of interrupt runtime per measurement period" UWORD TI0_001_M_M 1 100 0 65.535 ECU_ADDRESS 0xFFF90B54 FORMAT "%8.5" /end MEASUREMENT
/begin MEASUREMENT RrtIsr7.ctExe "F1620: Runtime measurement for interrupt 7 / Number of interrupts per measurement period" UWORD X1_M 1 100 0 65535 ECU_ADDRESS 0xFFF90B70 FORMAT "%8.2" /end MEASUREMENT
/begin MEASUREMENT RrtIsr7.tiRunSum "F1620: Runtime measurement for interrupt 7 / Sum of interrupt runtime per measurement period" UWORD TI0_001_M_M 1 100 0 65.535 ECU_ADDRESS 0xFFF90B6C FORMAT "%8.5" /end MEASUREMENT
/begin MEASUREMENT RrtIsr8.ctExe "F1620: Runtime measurement for interrupt 8 / Number of interrupts per measurement period" UWORD X1_M 1 100 0 65535 ECU_ADDRESS 0xFFF90B88 FORMAT "%8.2" /end MEASUREMENT
/begin MEASUREMENT RrtIsr8.tiRunSum "F1620: Runtime measurement for interrupt 8 / Sum of interrupt runtime per measurement period" UWORD TI0_001_M_M 1 100 0 65.535 ECU_ADDRESS 0xFFF90B84 FORMAT "%8.5" /end MEASUREMENT
/begin MEASUREMENT RrtIsrOS.ctExe "F1620: Runtime measurement for OS interrupt / Number of interrupts per measurement period" UWORD X1_M 1 100 0 65535 ECU_ADDRESS 0xFFF90BA0 FORMAT "%8.2" /end MEASUREMENT
/begin MEASUREMENT RrtIsrOS.tiRunSum "F1620: Runtime measurement for OS interrupt / Sum of interrupt runtime per measurement period" UWORD TI0_001_M_M 1 100 0 65.535 ECU_ADDRESS 0xFFF90B9C FORMAT "%8.5" /end MEASUREMENT
/begin MEASUREMENT RrtT10.tiPer "F1620: Runtime measurement for 10ms task / Task period" UWORD TI0_01_M_M 1 100 0 655.35 ECU_ADDRESS 0xFFF90BB0 FORMAT "%8.4" /end MEASUREMENT
/begin MEASUREMENT RrtT10.tiRun "F1620: Runtime measurement for 10ms task / Task runtime" UWORD TI0_01_M_M 1 100 0 655.35 ECU_ADDRESS 0xFFF90BB2 FORMAT "%8.4" /end MEASUREMENT
/begin MEASUREMENT RrtT10.tiRunMax "F1620: Runtime measurement for 10ms task / Maximum task runtime" UWORD TI0_01_M_M 1 100 0 655.35 ECU_ADDRESS 0xFFF90BB4 FORMAT "%8.4" /end MEASUREMENT
/begin MEASUREMENT RrtT100.tiPer "F1620: Runtime measurement for 100ms task / Task period" UWORD TI0_01_M_M 1 100 0 655.35 ECU_ADDRESS 0xFFF90BC4 FORMAT "%8.4" /end MEASUREMENT
/begin MEASUREMENT RrtT100.tiRun "F1620: Runtime measurement for 100ms task / Task runtime" UWORD TI0_01_M_M 1 100 0 655.35 ECU_ADDRESS 0xFFF90BC6 FORMAT "%8.4" /end MEASUREMENT
/begin MEASUREMENT RrtT100.tiRunMax "F1620: Runtime measurement for 100ms task / Maximum task runtime" UWORD TI0_01_M_M 1 100 0 655.35 ECU_ADDRESS 0xFFF90BC8 FORMAT "%8.4" /end MEASUREMENT
/begin MEASUREMENT RrtT20.tiPer "F1620: Runtime measurement for 20ms task / Task period" UWORD TI0_01_M_M 1 100 0 655.35 ECU_ADDRESS 0xFFF90BD8 FORMAT "%8.4" /end MEASUREMENT
/begin MEASUREMENT RrtT20.tiRun "F1620: Runtime measurement for 20ms task / Task runtime" UWORD TI0_01_M_M 1 100 0 655.35 ECU_ADDRESS 0xFFF90BDA FORMAT "%8.4" /end MEASUREMENT
/begin MEASUREMENT RrtT20.tiRunMax "F1620: Runtime measurement for 20ms task / Maximum task runtime" UWORD TI0_01_M_M 1 100 0 655.35 ECU_ADDRESS 0xFFF90BDC FORMAT "%8.4" /end MEASUREMENT
/begin MEASUREMENT RrtT2x5.tiPer "F1620: Runtime measurement for 2.5ms task / Task period" UWORD TI0_01_M_M 1 100 0 655.35 ECU_ADDRESS 0xFFF90BEC FORMAT "%8.4" /end MEASUREMENT
/begin MEASUREMENT RrtT2x5.tiRun "F1620: Runtime measurement for 2.5ms task / Task runtime" UWORD TI0_01_M_M 1 100 0 655.35 ECU_ADDRESS 0xFFF90BEE FORMAT "%8.4" /end MEASUREMENT
/begin MEASUREMENT RrtT2x5.tiRunMax "F1620: Runtime measurement for 2.5ms task / Maximum task runtime" UWORD TI0_01_M_M 1 100 0 655.35 ECU_ADDRESS 0xFFF90BF0 FORMAT "%8.4" /end MEASUREMENT
/begin MEASUREMENT RrtT30.tiPer "F1620: Runtime measurement for 30ms task / Task period" UWORD TI0_01_M_M 1 100 0 655.35 ECU_ADDRESS 0xFFF90C00 FORMAT "%8.4" /end MEASUREMENT
/begin MEASUREMENT RrtT30.tiRun "F1620: Runtime measurement for 30ms task / Task runtime" UWORD TI0_01_M_M 1 100 0 655.35 ECU_ADDRESS 0xFFF90C02 FORMAT "%8.4" /end MEASUREMENT
/begin MEASUREMENT RrtT30.tiRunMax "F1620: Runtime measurement for 30ms task / Maximum task runtime" UWORD TI0_01_M_M 1 100 0 655.35 ECU_ADDRESS 0xFFF90C04 FORMAT "%8.4" /end MEASUREMENT
/begin MEASUREMENT RrtT5.tiPer "F1620: Runtime measurement for 5ms task / Task period" UWORD TI0_01_M_M 1 100 0 655.35 ECU_ADDRESS 0xFFF90C14 FORMAT "%8.4" /end MEASUREMENT
/begin MEASUREMENT RrtT5.tiRun "F1620: Runtime measurement for 5ms task / Task runtime" UWORD TI0_01_M_M 1 100 0 655.35 ECU_ADDRESS 0xFFF90C16 FORMAT "%8.4" /end MEASUREMENT
/begin MEASUREMENT RrtT5.tiRunMax "F1620: Runtime measurement for 5ms task / Maximum task runtime" UWORD TI0_01_M_M 1 100 0 655.35 ECU_ADDRESS 0xFFF90C18 FORMAT "%8.4" /end MEASUREMENT
/begin MEASUREMENT RrtT50.tiPer "F1620: Runtime measurement for 50ms task / Task period" UWORD TI0_01_M_M 1 100 0 655.35 ECU_ADDRESS 0xFFF90C28 FORMAT "%8.4" /end MEASUREMENT
/begin MEASUREMENT RrtT50.tiRun "F1620: Runtime measurement for 50ms task / Task runtime" UWORD TI0_01_M_M 1 100 0 655.35 ECU_ADDRESS 0xFFF90C2A FORMAT "%8.4" /end MEASUREMENT
/begin MEASUREMENT RrtT50.tiRunMax "F1620: Runtime measurement for 50ms task / Maximum task runtime" UWORD TI0_01_M_M 1 100 0 655.35 ECU_ADDRESS 0xFFF90C2C FORMAT "%8.4" /end MEASUREMENT
/begin MEASUREMENT Serap_adOfsWrk "F1520: Address offset from pointers reference page to pointers working page" ULONG X1_S1 1 100 0 4294967295 ECU_ADDRESS 0xFFF90A04 FORMAT "%13.2" /end MEASUREMENT
/begin MEASUREMENT Serap_swtPg "F1520: Switch for page selection" UBYTE X1_S1 1 100 0 1 ECU_ADDRESS 0xFFF9367D FORMAT "%5.3" /end MEASUREMENT
/begin CHARACTERISTIC ShrEe_xSctnCfgCh0_C "F1100: Configuration for ZF EEPROM channel 00 ([0]=Nr, [1]=Attribute, [2]=Version, [3]=Add..Conf.) (no SERAP)" VAL_BLK 0x19045C AblGLKWBuw_S1 65535 X1_S1 0 65535 MATRIX_DIM 4 1 1 FORMAT "%8.2" /end CHARACTERISTIC
/begin CHARACTERISTIC ShrEe_xSctnCfgCh10_C "F1100: Configuration for ZF EEPROM channel 10 ([0]=Nr, [1]=Attribute, [2]=Version, [3]=Add..Conf.) (no SERAP)" VAL_BLK 0x190464 AblGLKWBuw_S1 65535 X1_S1 0 65535 MATRIX_DIM 4 1 1 FORMAT "%8.2" /end CHARACTERISTIC
/begin CHARACTERISTIC ShrEe_xSctnCfgCh11_C "F1100: Configuration for ZF EEPROM channel 11 ([0]=Nr, [1]=Attribute, [2]=Version, [3]=Add..Conf.) (no SERAP)" VAL_BLK 0x19046C AblGLKWBuw_S1 65535 X1_S1 0 65535 MATRIX_DIM 4 1 1 FORMAT "%8.2" /end CHARACTERISTIC
/begin CHARACTERISTIC ShrEe_xSctnCfgCh12_C "F1100: Configuration for ZF EEPROM channel 12 ([0]=Nr, [1]=Attribute, [2]=Version, [3]=Add..Conf.) (no SERAP)" VAL_BLK 0x190474 AblGLKWBuw_S1 65535 X1_S1 0 65535 MATRIX_DIM 4 1 1 FORMAT "%8.2" /end CHARACTERISTIC
/begin CHARACTERISTIC ShrEe_xSctnCfgCh13_C "F1100: Configuration for ZF EEPROM channel 13 ([0]=Nr, [1]=Attribute, [2]=Version, [3]=Add..Conf.) (no SERAP)" VAL_BLK 0x19047C AblGLKWBuw_S1 65535 X1_S1 0 65535 MATRIX_DIM 4 1 1 FORMAT "%8.2" /end CHARACTERISTIC
/begin CHARACTERISTIC ShrEe_xSctnCfgCh14_C "F1100: Configuration for ZF EEPROM channel 14 ([0]=Nr, [1]=Attribute, [2]=Version, [3]=Add..Conf.) (no SERAP)" VAL_BLK 0x190484 AblGLKWBuw_S1 65535 X1_S1 0 65535 MATRIX_DIM 4 1 1 FORMAT "%8.2" /end CHARACTERISTIC
/begin CHARACTERISTIC ShrEe_xSctnCfgCh15_C "F1100: Configuration for ZF EEPROM channel 15 ([0]=Nr, [1]=Attribute, [2]=Version, [3]=Add..Conf.) (no SERAP)" VAL_BLK 0x19048C AblGLKWBuw_S1 65535 X1_S1 0 65535 MATRIX_DIM 4 1 1 FORMAT "%8.2" /end CHARACTERISTIC
/begin CHARACTERISTIC ShrEe_xSctnCfgCh1_C "F1100: Configuration for ZF EEPROM channel 01 ([0]=Nr, [1]=Attribute, [2]=Version, [3]=Add..Conf.) (no SERAP)" VAL_BLK 0x190494 AblGLKWBuw_S1 65535 X1_S1 0 65535 MATRIX_DIM 4 1 1 FORMAT "%8.2" /end CHARACTERISTIC
/begin CHARACTERISTIC ShrEe_xSctnCfgCh2_C "F1100: Configuration for ZF EEPROM channel 02 ([0]=Nr, [1]=Attribute, [2]=Version, [3]=Add..Conf.) (no SERAP)" VAL_BLK 0x19049C AblGLKWBuw_S1 65535 X1_S1 0 65535 MATRIX_DIM 4 1 1 FORMAT "%8.2" /end CHARACTERISTIC
/begin CHARACTERISTIC ShrEe_xSctnCfgCh3_C "F1100: Configuration for ZF EEPROM channel 03 ([0]=Nr, [1]=Attribute, [2]=Version, [3]=Add..Conf.) (no SERAP)" VAL_BLK 0x1904A4 AblGLKWBuw_S1 65535 X1_S1 0 65535 MATRIX_DIM 4 1 1 FORMAT "%8.2" /end CHARACTERISTIC
/begin CHARACTERISTIC ShrEe_xSctnCfgCh4_C "F1100: Configuration for ZF EEPROM channel 04 ([0]=Nr, [1]=Attribute, [2]=Version, [3]=Add..Conf.) (no SERAP)" VAL_BLK 0x1904AC AblGLKWBuw_S1 65535 X1_S1 0 65535 MATRIX_DIM 4 1 1 FORMAT "%8.2" /end CHARACTERISTIC
/begin CHARACTERISTIC ShrEe_xSctnCfgCh5_C "F1100: Configuration for ZF EEPROM channel 05 ([0]=Nr, [1]=Attribute, [2]=Version, [3]=Add..Conf.) (no SERAP)" VAL_BLK 0x1904B4 AblGLKWBuw_S1 65535 X1_S1 0 65535 MATRIX_DIM 4 1 1 FORMAT "%8.2" /end CHARACTERISTIC
/begin CHARACTERISTIC ShrEe_xSctnCfgCh6_C "F1100: Configuration for ZF EEPROM channel 06 ([0]=Nr, [1]=Attribute, [2]=Version, [3]=Add..Conf.) (no SERAP)" VAL_BLK 0x1904BC AblGLKWBuw_S1 65535 X1_S1 0 65535 MATRIX_DIM 4 1 1 FORMAT "%8.2" /end CHARACTERISTIC
/begin CHARACTERISTIC ShrEe_xSctnCfgCh7_C "F1100: Configuration for ZF EEPROM channel 07 ([0]=Nr, [1]=Attribute, [2]=Version, [3]=Add..Conf.) (no SERAP)" VAL_BLK 0x1904C4 AblGLKWBuw_S1 65535 X1_S1 0 65535 MATRIX_DIM 4 1 1 FORMAT "%8.2" /end CHARACTERISTIC
/begin CHARACTERISTIC ShrEe_xSctnCfgCh8_C "F1100: Configuration for ZF EEPROM channel 08 ([0]=Nr, [1]=Attribute, [2]=Version, [3]=Add..Conf.) (no SERAP)" VAL_BLK 0x1904CC AblGLKWBuw_S1 65535 X1_S1 0 65535 MATRIX_DIM 4 1 1 FORMAT "%8.2" /end CHARACTERISTIC
/begin CHARACTERISTIC ShrEe_xSctnCfgCh9_C "F1100: Configuration for ZF EEPROM channel 09 ([0]=Nr, [1]=Attribute, [2]=Version, [3]=Add..Conf.) (no SERAP)" VAL_BLK 0x1904D4 AblGLKWBuw_S1 65535 X1_S1 0 65535 MATRIX_DIM 4 1 1 FORMAT "%8.2" /end CHARACTERISTIC
/begin MEASUREMENT SrvShr_stEe_Fault "F1100: bitcoded EEPROM emulation fault status (memorized information)" UWORD X1_S1 1 100 0 65535 ECU_ADDRESS 0xFFF93396 FORMAT "%8.2" /end MEASUREMENT
/begin FUNCTION dMoeSasERS_Fktn "Applikationesgroessen der Komponente dMoeSasERS"
 /begin SUB_FUNCTION jMoeSasERS21_Fktn jMoeSasERS32_Fktn jMoeSasERS43_Fktn jMoeSasERS54_Fktn jMoeSasERS65_Fktn jMoeSasERS76_Fktn jMoeSasERS87_Fktn /end SUB_FUNCTION
/end FUNCTION
/begin FUNCTION dMoeSasGeG_Fktn "Applikationesgroessen der Komponente dMoeSasGeG"
 /begin SUB_FUNCTION jMoeSasGeGR_Fktn jMoeSasGeG1_Fktn jMoeSasGeG2_Fktn jMoeSasGeG3_Fktn jMoeSasGeG4_Fktn jMoeSasGeG5_Fktn jMoeSasGeG6_Fktn jMoeSasGeG7_Fktn jMoeSasGeG8_Fktn /end SUB_FUNCTION
/end FUNCTION
/begin FUNCTION dMoeSasHSP_Fktn "Applikationesgroessen der Komponente dMoeSasHSP"
 /begin SUB_FUNCTION jMoeSasHSP112_Fktn jMoeSasHSP123_Fktn jMoeSasHSP134_Fktn jMoeSasHSP145_Fktn jMoeSasHSP156_Fktn jMoeSasHSP167_Fktn jMoeSasHSP178_Fktn jMoeSasHSP212_Fktn jMoeSasHSP223_Fktn jMoeSasHSP234_Fktn jMoeSasHSP245_Fktn jMoeSasHSP256_Fktn jMoeSasHSP267_Fktn jMoeSasHSP278_Fktn jMoeSasHSP312_Fktn jMoeSasHSP323_Fktn jMoeSasHSP334_Fktn jMoeSasHSP345_Fktn jMoeSasHSP356_Fktn jMoeSasHSP367_Fktn jMoeSasHSP378_Fktn /end SUB_FUNCTION
/end FUNCTION
/begin FUNCTION dMoeSasHSS_Fktn "Applikationesgroessen der Komponente dMoeSasHSS"
 /begin SUB_FUNCTION jMoeSasHSS12_Fktn jMoeSasHSS23_Fktn jMoeSasHSS34_Fktn jMoeSasHSS45_Fktn jMoeSasHSS56_Fktn jMoeSasHSS67_Fktn jMoeSasHSS78_Fktn /end SUB_FUNCTION
/end FUNCTION
/begin FUNCTION dMoeSasRSP_Fktn "Applikationesgroessen der Komponente dMoeSasRSP"
 /begin SUB_FUNCTION jMoeSasRSP121_Fktn jMoeSasRSP132_Fktn jMoeSasRSP143_Fktn jMoeSasRSP154_Fktn jMoeSasRSP165_Fktn jMoeSasRSP176_Fktn jMoeSasRSP187_Fktn jMoeSasRSP221_Fktn jMoeSasRSP232_Fktn jMoeSasRSP243_Fktn jMoeSasRSP254_Fktn jMoeSasRSP265_Fktn jMoeSasRSP276_Fktn jMoeSasRSP287_Fktn jMoeSasRSP231_Fktn jMoeSasRSP242_Fktn jMoeSasRSP251_Fktn jMoeSasRSP253_Fktn jMoeSasRSP263_Fktn jMoeSasRSP264_Fktn jMoeSasRSP271_Fktn jMoeSasRSP275_Fktn jMoeSasRSP282_Fktn jMoeSasRSP284_Fktn jMoeSasRSP286_Fktn jMoeSasRSP321_Fktn jMoeSasRSP332_Fktn jMoeSasRSP343_Fktn jMoeSasRSP354_Fktn jMoeSasRSP365_Fktn jMoeSasRSP376_Fktn jMoeSasRSP387_Fktn jMoeSasRSP331_Fktn jMoeSasRSP342_Fktn jMoeSasRSP351_Fktn jMoeSasRSP353_Fktn jMoeSasRSP363_Fktn jMoeSasRSP364_Fktn jMoeSasRSP371_Fktn jMoeSasRSP375_Fktn jMoeSasRSP382_Fktn jMoeSasRSP384_Fktn jMoeSasRSP386_Fktn /end SUB_FUNCTION
/end FUNCTION
/begin FUNCTION dMoeSasRSS_Fktn "Applikationesgroessen der Komponente dMoeSasRSS"
 /begin SUB_FUNCTION jMoeSasRSS21_Fktn jMoeSasRSS32_Fktn jMoeSasRSS43_Fktn jMoeSasRSS54_Fktn jMoeSasRSS65_Fktn jMoeSasRSS76_Fktn jMoeSasRSS87_Fktn jMoeSasRSS31_Fktn jMoeSasRSS42_Fktn jMoeSasRSS51_Fktn jMoeSasRSS53_Fktn jMoeSasRSS63_Fktn jMoeSasRSS64_Fktn jMoeSasRSS71_Fktn jMoeSasRSS75_Fktn jMoeSasRSS82_Fktn jMoeSasRSS84_Fktn jMoeSasRSS86_Fktn /end SUB_FUNCTION
/end FUNCTION
/begin FUNCTION dMonMvGet_Fktn "Applikationesgroessen der Komponente dMonMvGet" /begin SUB_FUNCTION jMonMvGet_Fktn /end SUB_FUNCTION /end FUNCTION
/begin FUNCTION dMvsZentr_Fktn "Applikationesgroessen der Komponente dMvsZentr" /begin SUB_FUNCTION jMvsZentr_Fktn /end SUB_FUNCTION /end FUNCTION
/begin FUNCTION dNvrContr_Fktn "Applikationesgroessen der Komponente dNvrContr" /begin SUB_FUNCTION jNvrContr_Fktn /end SUB_FUNCTION /end FUNCTION
/begin FUNCTION dSasGeaAl_Fktn "Applikationesgroessen der Komponente dSasGeaAl" /begin SUB_FUNCTION jSasGeaAl_Fktn /end SUB_FUNCTION /end FUNCTION
/begin FUNCTION dSasGloAl_Fktn "Applikationesgroessen der Komponente dSasGloAl" /begin SUB_FUNCTION jSasGloAl_Fktn /end SUB_FUNCTION /end FUNCTION
/begin FUNCTION dSasGloGeG_Fktn "Applikationesgroessen der Komponente dSasGloGeG"
 /begin SUB_FUNCTION jSasGloGeGR_Fktn jSasGloGeG1_Fktn jSasGloGeG2_Fktn jSasGloGeG3_Fktn jSasGloGeG4_Fktn jSasGloGeG5_Fktn jSasGloGeG6_Fktn jSasGloGeG7_Fktn jSasGloGeG8_Fktn /end SUB_FUNCTION
/end FUNCTION
/begin FUNCTION dSasGloHSS_Fktn "Applikationesgroessen der Komponente dSasGloHSS"
 /begin SUB_FUNCTION jSasGloHSS12_Fktn jSasGloHSS23_Fktn jSasGloHSS34_Fktn jSasGloHSS45_Fktn jSasGloHSS56_Fktn jSasGloHSS67_Fktn jSasGloHSS78_Fktn /end SUB_FUNCTION
/end FUNCTION
/begin FUNCTION dSasGloKuK_Fktn "Applikationesgroessen der Komponente dSasGloKuK"
 /begin SUB_FUNCTION jSasGloKuKA_Fktn jSasGloKuKB_Fktn jSasGloKuKC_Fktn jSasGloKuKD_Fktn jSasGloKuKE_Fktn /end SUB_FUNCTION
/end FUNCTION
/begin FUNCTION dSasGloRSP_Fktn "Applikationesgroessen der Komponente dSasGloRSP"
 /begin SUB_FUNCTION jSasGloRSP121_Fktn jSasGloRSP132_Fktn jSasGloRSP143_Fktn jSasGloRSP154_Fktn jSasGloRSP165_Fktn jSasGloRSP176_Fktn jSasGloRSP187_Fktn jSasGloRSP221_Fktn jSasGloRSP232_Fktn jSasGloRSP243_Fktn jSasGloRSP254_Fktn jSasGloRSP265_Fktn jSasGloRSP276_Fktn jSasGloRSP287_Fktn jSasGloRSP231_Fktn jSasGloRSP242_Fktn jSasGloRSP251_Fktn jSasGloRSP253_Fktn jSasGloRSP263_Fktn jSasGloRSP264_Fktn jSasGloRSP271_Fktn jSasGloRSP275_Fktn jSasGloRSP282_Fktn jSasGloRSP284_Fktn jSasGloRSP286_Fktn jSasGloRSP321_Fktn jSasGloRSP332_Fktn jSasGloRSP343_Fktn jSasGloRSP354_Fktn jSasGloRSP365_Fktn jSasGloRSP376_Fktn jSasGloRSP387_Fktn jSasGloRSP331_Fktn jSasGloRSP342_Fktn jSasGloRSP351_Fktn jSasGloRSP353_Fktn jSasGloRSP363_Fktn jSasGloRSP364_Fktn jSasGloRSP371_Fktn jSasGloRSP375_Fktn jSasGloRSP382_Fktn jSasGloRSP384_Fktn jSasGloRSP386_Fktn /end SUB_FUNCTION
/end FUNCTION
/begin FUNCTION dSasGloRSS_Fktn "Applikationesgroessen der Komponente dSasGloRSS"
 /begin SUB_FUNCTION jSasGloRSS21_Fktn jSasGloRSS32_Fktn jSasGloRSS43_Fktn jSasGloRSS54_Fktn jSasGloRSS65_Fktn jSasGloRSS76_Fktn jSasGloRSS87_Fktn jSasGloRSS31_Fktn jSasGloRSS42_Fktn jSasGloRSS51_Fktn jSasGloRSS53_Fktn jSasGloRSS63_Fktn jSasGloRSS64_Fktn jSasGloRSS71_Fktn jSasGloRSS75_Fktn jSasGloRSS82_Fktn jSasGloRSS84_Fktn jSasGloRSS86_Fktn /end SUB_FUNCTION
/end FUNCTION
/begin FUNCTION dSasGlsAl_Fktn "Applikationesgroessen der Komponente dSasGlsAl" /begin SUB_FUNCTION jSasGlsAl_Fktn /end SUB_FUNCTION /end FUNCTION
/begin FUNCTION dSasGlsGeG_Fktn "Applikationesgroessen der Komponente dSasGlsGeG"
 /begin SUB_FUNCTION jSasGlsGeGR_Fktn jSasGlsGeG1_Fktn jSasGlsGeG2_Fktn jSasGlsGeG3_Fktn jSasGlsGeG4_Fktn jSasGlsGeG5_Fktn jSasGlsGeG6_Fktn jSasGlsGeG7_Fktn jSasGlsGeG8_Fktn /end SUB_FUNCTION
/end FUNCTION
/begin FUNCTION dSasGlsHSP_Fktn "Applikationesgroessen der Komponente dSasGlsHSP"
 /begin SUB_FUNCTION jSasGlsHSP112_Fktn jSasGlsHSP123_Fktn jSasGlsHSP134_Fktn jSasGlsHSP145_Fktn jSasGlsHSP156_Fktn jSasGlsHSP167_Fktn jSasGlsHSP178_Fktn jSasGlsHSP212_Fktn jSasGlsHSP223_Fktn jSasGlsHSP234_Fktn jSasGlsHSP245_Fktn jSasGlsHSP256_Fktn jSasGlsHSP267_Fktn jSasGlsHSP278_Fktn jSasGlsHSP312_Fktn jSasGlsHSP323_Fktn jSasGlsHSP334_Fktn jSasGlsHSP345_Fktn jSasGlsHSP356_Fktn jSasGlsHSP367_Fktn jSasGlsHSP378_Fktn /end SUB_FUNCTION
/end FUNCTION
/begin FUNCTION dSasGlsHSS_Fktn "Applikationesgroessen der Komponente dSasGlsHSS"
 /begin SUB_FUNCTION jSasGlsHSS12_Fktn jSasGlsHSS23_Fktn jSasGlsHSS34_Fktn jSasGlsHSS45_Fktn jSasGlsHSS56_Fktn jSasGlsHSS67_Fktn jSasGlsHSS78_Fktn /end SUB_FUNCTION
/end FUNCTION
/begin FUNCTION dSasGlsRSP_Fktn "Applikationesgroessen der Komponente dSasGlsRSP"
 /begin SUB_FUNCTION jSasGlsRSP121_Fktn jSasGlsRSP132_Fktn jSasGlsRSP143_Fktn jSasGlsRSP154_Fktn jSasGlsRSP165_Fktn jSasGlsRSP176_Fktn jSasGlsRSP187_Fktn jSasGlsRSP221_Fktn jSasGlsRSP232_Fktn jSasGlsRSP243_Fktn jSasGlsRSP254_Fktn jSasGlsRSP265_Fktn jSasGlsRSP276_Fktn jSasGlsRSP287_Fktn jSasGlsRSP231_Fktn jSasGlsRSP242_Fktn jSasGlsRSP251_Fktn jSasGlsRSP253_Fktn jSasGlsRSP263_Fktn jSasGlsRSP264_Fktn jSasGlsRSP271_Fktn jSasGlsRSP275_Fktn jSasGlsRSP282_Fktn jSasGlsRSP284_Fktn jSasGlsRSP286_Fktn jSasGlsRSP321_Fktn jSasGlsRSP332_Fktn jSasGlsRSP343_Fktn jSasGlsRSP354_Fktn jSasGlsRSP365_Fktn jSasGlsRSP376_Fktn jSasGlsRSP387_Fktn jSasGlsRSP331_Fktn jSasGlsRSP342_Fktn jSasGlsRSP351_Fktn jSasGlsRSP353_Fktn jSasGlsRSP363_Fktn jSasGlsRSP364_Fktn jSasGlsRSP371_Fktn jSasGlsRSP375_Fktn jSasGlsRSP382_Fktn jSasGlsRSP384_Fktn jSasGlsRSP386_Fktn /end SUB_FUNCTION
/end FUNCTION
/begin FUNCTION dSasGlsRSS_Fktn "Applikationesgroessen der Komponente dSasGlsRSS"
 /begin SUB_FUNCTION jSasGlsRSS21_Fktn jSasGlsRSS32_Fktn jSasGlsRSS43_Fktn jSasGlsRSS54_Fktn jSasGlsRSS65_Fktn jSasGlsRSS76_Fktn jSasGlsRSS87_Fktn jSasGlsRSS31_Fktn jSasGlsRSS42_Fktn jSasGlsRSS51_Fktn jSasGlsRSS53_Fktn jSasGlsRSS63_Fktn jSasGlsRSS64_Fktn jSasGlsRSS71_Fktn jSasGlsRSS75_Fktn jSasGlsRSS82_Fktn jSasGlsRSS84_Fktn jSasGlsRSS86_Fktn /end SUB_FUNCTION
/end FUNCTION
/begin FUNCTION dSasKabAl_Fktn "Applikationesgroessen der Komponente dSasKabAl" /begin SUB_FUNCTION jSasKabAl_Fktn /end SUB_FUNCTION /end FUNCTION
/begin FUNCTION dSasKabEHS_Fktn "Applikationesgroessen der Komponente dSasKabEHS"
 /begin SUB_FUNCTION jSasKabEHS12_Fktn jSasKabEHS23_Fktn jSasKabEHS34_Fktn jSasKabEHS45_Fktn jSasKabEHS56_Fktn jSasKabEHS67_Fktn jSasKabEHS78_Fktn /end SUB_FUNCTION
/end FUNCTION
/begin FUNCTION dSasKabERS_Fktn "Applikationesgroessen der Komponente dSasKabERS"
 /begin SUB_FUNCTION jSasKabERS21_Fktn jSasKabERS32_Fktn jSasKabERS43_Fktn jSasKabERS54_Fktn jSasKabERS65_Fktn jSasKabERS76_Fktn jSasKabERS87_Fktn /end SUB_FUNCTION
/end FUNCTION
/begin FUNCTION dSasKabGeG_Fktn "Applikationesgroessen der Komponente dSasKabGeG"
 /begin SUB_FUNCTION jSasKabGeGR_Fktn jSasKabGeG1_Fktn jSasKabGeG2_Fktn jSasKabGeG3_Fktn jSasKabGeG4_Fktn jSasKabGeG5_Fktn jSasKabGeG6_Fktn jSasKabGeG7_Fktn jSasKabGeG8_Fktn /end SUB_FUNCTION
/end FUNCTION
/begin FUNCTION dSasKabHSP_Fktn "Applikationesgroessen der Komponente dSasKabHSP"
 /begin SUB_FUNCTION jSasKabHSP112_Fktn jSasKabHSP123_Fktn jSasKabHSP134_Fktn jSasKabHSP145_Fktn jSasKabHSP156_Fktn jSasKabHSP167_Fktn jSasKabHSP178_Fktn jSasKabHSP212_Fktn jSasKabHSP223_Fktn jSasKabHSP234_Fktn jSasKabHSP245_Fktn jSasKabHSP256_Fktn jSasKabHSP267_Fktn jSasKabHSP278_Fktn jSasKabHSP312_Fktn jSasKabHSP323_Fktn jSasKabHSP334_Fktn jSasKabHSP345_Fktn jSasKabHSP356_Fktn jSasKabHSP367_Fktn jSasKabHSP378_Fktn /end SUB_FUNCTION
/end FUNCTION
/begin FUNCTION dSasKabHSS_Fktn "Applikationesgroessen der Komponente dSasKabHSS"
 /begin SUB_FUNCTION jSasKabHSS12_Fktn jSasKabHSS23_Fktn jSasKabHSS34_Fktn jSasKabHSS45_Fktn jSasKabHSS56_Fktn jSasKabHSS67_Fktn jSasKabHSS78_Fktn /end SUB_FUNCTION
/end FUNCTION
/begin FUNCTION dSasKabRSP_Fktn "Applikationesgroessen der Komponente dSasKabRSP"
 /begin SUB_FUNCTION jSasKabRSP121_Fktn jSasKabRSP132_Fktn jSasKabRSP143_Fktn jSasKabRSP154_Fktn jSasKabRSP165_Fktn jSasKabRSP176_Fktn jSasKabRSP187_Fktn jSasKabRSP221_Fktn jSasKabRSP232_Fktn jSasKabRSP243_Fktn jSasKabRSP254_Fktn jSasKabRSP265_Fktn jSasKabRSP276_Fktn jSasKabRSP287_Fktn jSasKabRSP231_Fktn jSasKabRSP242_Fktn jSasKabRSP251_Fktn jSasKabRSP253_Fktn jSasKabRSP263_Fktn jSasKabRSP264_Fktn jSasKabRSP271_Fktn jSasKabRSP275_Fktn jSasKabRSP282_Fktn jSasKabRSP284_Fktn jSasKabRSP286_Fktn jSasKabRSP321_Fktn jSasKabRSP332_Fktn jSasKabRSP343_Fktn jSasKabRSP354_Fktn jSasKabRSP365_Fktn jSasKabRSP376_Fktn jSasKabRSP387_Fktn jSasKabRSP331_Fktn jSasKabRSP342_Fktn jSasKabRSP351_Fktn jSasKabRSP353_Fktn jSasKabRSP363_Fktn jSasKabRSP364_Fktn jSasKabRSP371_Fktn jSasKabRSP375_Fktn jSasKabRSP382_Fktn jSasKabRSP384_Fktn jSasKabRSP386_Fktn /end SUB_FUNCTION
/end FUNCTION
/begin FUNCTION dSasKabRSS_Fktn "Applikationesgroessen der Komponente dSasKabRSS"
 /begin SUB_FUNCTION jSasKabRSS21_Fktn jSasKabRSS32_Fktn jSasKabRSS43_Fktn jSasKabRSS54_Fktn jSasKabRSS65_Fktn jSasKabRSS76_Fktn jSasKabRSS87_Fktn jSasKabRSS31_Fktn jSasKabRSS42_Fktn jSasKabRSS51_Fktn jSasKabRSS53_Fktn jSasKabRSS63_Fktn jSasKabRSS64_Fktn jSasKabRSS71_Fktn jSasKabRSS75_Fktn jSasKabRSS82_Fktn jSasKabRSS86_Fktn jSasKabRSS84_Fktn /end SUB_FUNCTION
/end FUNCTION
/begin FUNCTION dSasKflwe_Fktn "Applikationesgroessen der Komponente dSasKflwe" /begin SUB_FUNCTION jSasKflwe_Fktn /end SUB_FUNCTION /end FUNCTION
/begin FUNCTION dSasKflweW_Fktn "Applikationesgroessen der Komponente dSasKflweW"
 /begin SUB_FUNCTION jSasKflweWDNR_Fktn jSasKflweWRND_Fktn jSasKflweWDNRV2_Fktn jSasKflweWRNDV2_Fktn jSasKflweWD2NR_Fktn /end SUB_FUNCTION
/end FUNCTION
/begin FUNCTION dSasKzuAl_Fktn "Applikationesgroessen der Komponente dSasKzuAl" /begin SUB_FUNCTION jSasKzuAl_Fktn /end SUB_FUNCTION /end FUNCTION
/begin FUNCTION dSasKzuEHS_Fktn "Applikationesgroessen der Komponente dSasKzuEHS"
 /begin SUB_FUNCTION jSasKzuEHS12_Fktn jSasKzuEHS23_Fktn jSasKzuEHS34_Fktn jSasKzuEHS45_Fktn jSasKzuEHS56_Fktn jSasKzuEHS67_Fktn jSasKzuEHS78_Fktn /end SUB_FUNCTION
/end FUNCTION
/begin FUNCTION dSasKzuERS_Fktn "Applikationesgroessen der Komponente dSasKzuERS"
 /begin SUB_FUNCTION jSasKzuERS21_Fktn jSasKzuERS32_Fktn jSasKzuERS43_Fktn jSasKzuERS54_Fktn jSasKzuERS65_Fktn jSasKzuERS76_Fktn jSasKzuERS87_Fktn /end SUB_FUNCTION
/end FUNCTION
/begin FUNCTION dSasKzuGeG_Fktn "Applikationesgroessen der Komponente dSasKzuGeG"
 /begin SUB_FUNCTION jSasKzuGeGR_Fktn jSasKzuGeG1_Fktn jSasKzuGeG2_Fktn jSasKzuGeG3_Fktn jSasKzuGeG4_Fktn jSasKzuGeG5_Fktn jSasKzuGeG6_Fktn jSasKzuGeG7_Fktn jSasKzuGeG8_Fktn /end SUB_FUNCTION
/end FUNCTION
/begin FUNCTION dSasKzuHSP_Fktn "Applikationesgroessen der Komponente dSasKzuHSP"
 /begin SUB_FUNCTION jSasKzuHSP112_Fktn jSasKzuHSP123_Fktn jSasKzuHSP134_Fktn jSasKzuHSP145_Fktn jSasKzuHSP156_Fktn jSasKzuHSP167_Fktn jSasKzuHSP178_Fktn jSasKzuHSP212_Fktn jSasKzuHSP223_Fktn jSasKzuHSP234_Fktn jSasKzuHSP245_Fktn jSasKzuHSP256_Fktn jSasKzuHSP267_Fktn jSasKzuHSP278_Fktn jSasKzuHSP312_Fktn jSasKzuHSP323_Fktn jSasKzuHSP334_Fktn jSasKzuHSP345_Fktn jSasKzuHSP356_Fktn jSasKzuHSP367_Fktn jSasKzuHSP378_Fktn /end SUB_FUNCTION
/end FUNCTION
/begin FUNCTION dSasKzuHSS_Fktn "Applikationesgroessen der Komponente dSasKzuHSS"
 /begin SUB_FUNCTION jSasKzuHSS12_Fktn jSasKzuHSS23_Fktn jSasKzuHSS34_Fktn jSasKzuHSS45_Fktn jSasKzuHSS56_Fktn jSasKzuHSS67_Fktn jSasKzuHSS78_Fktn /end SUB_FUNCTION
/end FUNCTION
/begin FUNCTION dSasKzuRSP_Fktn "Applikationesgroessen der Komponente dSasKzuRSP"
 /begin SUB_FUNCTION jSasKzuRSP121_Fktn jSasKzuRSP132_Fktn jSasKzuRSP143_Fktn jSasKzuRSP154_Fktn jSasKzuRSP165_Fktn jSasKzuRSP176_Fktn jSasKzuRSP187_Fktn jSasKzuRSP221_Fktn jSasKzuRSP232_Fktn jSasKzuRSP243_Fktn jSasKzuRSP254_Fktn jSasKzuRSP265_Fktn jSasKzuRSP276_Fktn jSasKzuRSP287_Fktn jSasKzuRSP231_Fktn jSasKzuRSP242_Fktn jSasKzuRSP251_Fktn jSasKzuRSP253_Fktn jSasKzuRSP263_Fktn jSasKzuRSP264_Fktn jSasKzuRSP271_Fktn jSasKzuRSP275_Fktn jSasKzuRSP282_Fktn jSasKzuRSP284_Fktn jSasKzuRSP286_Fktn jSasKzuRSP321_Fktn jSasKzuRSP332_Fktn jSasKzuRSP343_Fktn jSasKzuRSP354_Fktn jSasKzuRSP365_Fktn jSasKzuRSP376_Fktn jSasKzuRSP387_Fktn jSasKzuRSP331_Fktn jSasKzuRSP342_Fktn jSasKzuRSP351_Fktn jSasKzuRSP353_Fktn jSasKzuRSP363_Fktn jSasKzuRSP364_Fktn jSasKzuRSP371_Fktn jSasKzuRSP375_Fktn jSasKzuRSP382_Fktn jSasKzuRSP384_Fktn jSasKzuRSP386_Fktn /end SUB_FUNCTION
/end FUNCTION
/begin FUNCTION dSasKzuRSS_Fktn "Applikationesgroessen der Komponente dSasKzuRSS"
 /begin SUB_FUNCTION jSasKzuRSS21_Fktn jSasKzuRSS32_Fktn jSasKzuRSS43_Fktn jSasKzuRSS54_Fktn jSasKzuRSS65_Fktn jSasKzuRSS76_Fktn jSasKzuRSS87_Fktn jSasKzuRSS31_Fktn jSasKzuRSS42_Fktn jSasKzuRSS51_Fktn jSasKzuRSS53_Fktn jSasKzuRSS63_Fktn jSasKzuRSS64_Fktn jSasKzuRSS71_Fktn jSasKzuRSS75_Fktn jSasKzuRSS82_Fktn jSasKzuRSS84_Fktn jSasKzuRSS86_Fktn /end SUB_FUNCTION
/end FUNCTION
/begin FUNCTION dSasPsyGeG_Fktn "Applikationesgroessen der Komponente dSasPsyGeG"
 /begin SUB_FUNCTION jSasPsyGeGR_Fktn jSasPsyGeG1_Fktn jSasPsyGeG2_Fktn jSasPsyGeG3_Fktn jSasPsyGeG4_Fktn jSasPsyGeG5_Fktn jSasPsyGeG6_Fktn jSasPsyGeG7_Fktn jSasPsyGeG8_Fktn /end SUB_FUNCTION
/end FUNCTION
/begin FUNCTION dSasPsyHSS_Fktn "Applikationesgroessen der Komponente dSasPsyHSS"
 /begin SUB_FUNCTION jSasPsyHSS12_Fktn jSasPsyHSS23_Fktn jSasPsyHSS34_Fktn jSasPsyHSS45_Fktn jSasPsyHSS56_Fktn jSasPsyHSS67_Fktn jSasPsyHSS78_Fktn /end SUB_FUNCTION
/end FUNCTION
/begin FUNCTION dSasPsyRSS_Fktn "Applikationesgroessen der Komponente dSasPsyRSS"
 /begin SUB_FUNCTION jSasPsyRSS21_Fktn jSasPsyRSS32_Fktn jSasPsyRSS43_Fktn jSasPsyRSS54_Fktn jSasPsyRSS65_Fktn jSasPsyRSS76_Fktn jSasPsyRSS87_Fktn jSasPsyRSS31_Fktn jSasPsyRSS42_Fktn jSasPsyRSS53_Fktn jSasPsyRSS64_Fktn jSasPsyRSS75_Fktn jSasPsyRSS86_Fktn jSasPsyRSS51_Fktn jSasPsyRSS63_Fktn jSasPsyRSS71_Fktn jSasPsyRSS82_Fktn jSasPsyRSS84_Fktn /end SUB_FUNCTION
/end FUNCTION
/begin FUNCTION dSasPsyst_Fktn "Applikationesgroessen der Komponente dSasPsyst" /begin SUB_FUNCTION jSasPsyst_Fktn /end SUB_FUNCTION /end FUNCTION
/begin FUNCTION dSasStrat_Fktn "Applikationesgroessen der Komponente dSasStrat" /begin SUB_FUNCTION jSasStrat_Fktn /end SUB_FUNCTION /end FUNCTION
/begin FUNCTION dUewIgetr_Fktn "Applikationesgroessen der Komponente dUewIgetr" /begin SUB_FUNCTION jUewIgetr_Fktn /end SUB_FUNCTION /end FUNCTION
/begin FUNCTION dUewIgetrG_Fktn "Applikationesgroessen der Komponente dUewIgetrG"
 /begin SUB_FUNCTION jUewIgetrGR_Fktn jUewIgetrG1_Fktn jUewIgetrG2_Fktn jUewIgetrG3_Fktn jUewIgetrG4_Fktn jUewIgetrG5_Fktn jUewIgetrG6_Fktn jUewIgetrG7_Fktn jUewIgetrG8_Fktn /end SUB_FUNCTION
/end FUNCTION
/begin FUNCTION dUewIgetrK_Fktn "Applikationesgroessen der Komponente dUewIgetrK"
 /begin SUB_FUNCTION jUewIgetrKA_Fktn jUewIgetrKB_Fktn jUewIgetrKC_Fktn jUewIgetrKD_Fktn jUewIgetrKE_Fktn /end SUB_FUNCTION
/end FUNCTION
/begin FUNCTION dUewIgetrS_Fktn "Applikationesgroessen der Komponente dUewIgetrS"
 /begin SUB_FUNCTION jUewIgetrS12_Fktn jUewIgetrS23_Fktn jUewIgetrS34_Fktn jUewIgetrS45_Fktn jUewIgetrS56_Fktn jUewIgetrS67_Fktn jUewIgetrS78_Fktn jUewIgetrS21_Fktn jUewIgetrS32_Fktn jUewIgetrS43_Fktn jUewIgetrS54_Fktn jUewIgetrS65_Fktn jUewIgetrS76_Fktn jUewIgetrS87_Fktn jUewIgetrS31_Fktn jUewIgetrS42_Fktn jUewIgetrS51_Fktn jUewIgetrS53_Fktn jUewIgetrS63_Fktn jUewIgetrS64_Fktn jUewIgetrS71_Fktn jUewIgetrS75_Fktn jUewIgetrS82_Fktn jUewIgetrS84_Fktn jUewIgetrS86_Fktn /end SUB_FUNCTION
/end FUNCTION
/begin FUNCTION dUewParksperrenmagnet_Fktn "Applikationesgroessen der Komponente dUewParksperrenmagnet" /begin SUB_FUNCTION jUewParksperrenmagnet_Fktn /end SUB_FUNCTION /end FUNCTION
/begin FUNCTION dUewSgetf_Fktn "Applikationesgroessen der Komponente dUewSgetf" /begin SUB_FUNCTION jUewSgetf_Fktn /end SUB_FUNCTION /end FUNCTION
/begin FUNCTION dUl2EdsLg_Fktn "Applikationesgroessen der Komponente dUl2EdsLg" /begin SUB_FUNCTION jUl2EdsLg_Fktn /end SUB_FUNCTION /end FUNCTION
/begin FUNCTION dUl2GetrMAuf_Fktn "Applikationesgroessen der Komponente dUl2GetrMAuf" /begin SUB_FUNCTION jUl2GetrMAuf_Fktn /end SUB_FUNCTION /end FUNCTION
/begin FUNCTION dUl2Kflpl_Fktn "Applikationesgroessen der Komponente dUl2Kflpl" /begin SUB_FUNCTION jUl2Kflpl_Fktn /end SUB_FUNCTION /end FUNCTION
/begin FUNCTION dUl2KflplK_Fktn "Applikationesgroessen der Komponente dUl2KflplK"
 /begin SUB_FUNCTION jUl2KflplKA_Fktn jUl2KflplKB_Fktn jUl2KflplKC_Fktn jUl2KflplKD_Fktn jUl2KflplKE_Fktn /end SUB_FUNCTION
/end FUNCTION
/begin FUNCTION dUl2Kuppl_Fktn "Applikationesgroessen der Komponente dUl2Kuppl" /begin SUB_FUNCTION jUl2Kuppl_Fktn /end SUB_FUNCTION /end FUNCTION
/begin FUNCTION dUl2KupplK_Fktn "Applikationesgroessen der Komponente dUl2KupplK"
 /begin SUB_FUNCTION jUl2KupplKA_Fktn jUl2KupplKB_Fktn jUl2KupplKC_Fktn jUl2KupplKD_Fktn jUl2KupplKE_Fktn /end SUB_FUNCTION
/end FUNCTION
/begin FUNCTION dUl2Nmotu_Fktn "Applikationesgroessen der Komponente dUl2Nmotu" /begin SUB_FUNCTION jUl2Nmotu_Fktn /end SUB_FUNCTION /end FUNCTION
/begin FUNCTION dUl2Posme_Fktn "Applikationesgroessen der Komponente dUl2Posme" /begin SUB_FUNCTION jUl2Posme_Fktn /end SUB_FUNCTION /end FUNCTION
/begin FUNCTION F1100_EeAccs "F1100: EEPROM main module" /begin OUT_MEASUREMENT EeAccs_stEmu EeAccs_stPrgLvlChg /end OUT_MEASUREMENT /end FUNCTION
/begin FUNCTION F1100_EeFltHdl "F1100: EEPROM fault handling" /begin OUT_MEASUREMENT EeFltHdl_efFaults /end OUT_MEASUREMENT /end FUNCTION
/begin FUNCTION F1100_EeGenSrv "F1100: EEPROM general services" /begin OUT_MEASUREMENT EeGenSrv_ctTotUpdSctrGrp_a /end OUT_MEASUREMENT /end FUNCTION
/begin FUNCTION F1100_EePstId_Cfg "F1100: Application values for project specific PST-ID configuration of EEPROM emulation" /begin DEF_CHARACTERISTIC EePstId_Cfg_idAddOem_C EePstId_Cfg_idOem_C /end DEF_CHARACTERISTIC /end FUNCTION
/begin FUNCTION F1100_EeUpdSrv "F1100: EEPROM update service" /begin DEF_CHARACTERISTIC EeUpdSrv_bDisblPstIdDstChsUpd_C /end DEF_CHARACTERISTIC /begin OUT_MEASUREMENT EeUpdSrv_ctCmplUpd EeUpdSrv_ctTgtUpd /end OUT_MEASUREMENT /end FUNCTION
/begin FUNCTION F1100_ShrEe_Cfg "F1100: Application values for ZF SW EEPROM channels"
 /begin DEF_CHARACTERISTIC ShrEe_xSctnCfgCh0_C ShrEe_xSctnCfgCh10_C ShrEe_xSctnCfgCh11_C ShrEe_xSctnCfgCh12_C ShrEe_xSctnCfgCh13_C ShrEe_xSctnCfgCh14_C ShrEe_xSctnCfgCh15_C ShrEe_xSctnCfgCh1_C ShrEe_xSctnCfgCh2_C ShrEe_xSctnCfgCh3_C ShrEe_xSctnCfgCh4_C ShrEe_xSctnCfgCh5_C ShrEe_xSctnCfgCh6_C ShrEe_xSctnCfgCh7_C ShrEe_xSctnCfgCh8_C ShrEe_xSctnCfgCh9_C /end DEF_CHARACTERISTIC
/end FUNCTION
/begin FUNCTION F1100_SHREE_DSM "F1100: EEPROM emulation connection to DSM" /begin OUT_MEASUREMENT SrvShr_stEe_Fault /end OUT_MEASUREMENT /end FUNCTION
/begin FUNCTION F1206_EXCHG_FIX_M "F1206: fixed data in exchange RAM (only measurement)"
 /begin OUT_MEASUREMENT ExchgFix_ctStrtUp ExchgFix_s.numAreaDataVal ExchgFix_s.numFlshChkReq ExchgFix_s.numRamBufTest ExchgFix_s.numRamBufValid ExchgFix_s.reserved /end OUT_MEASUREMENT
/end FUNCTION
/begin FUNCTION F1211_RAMCYCL_ECC_M "F1211: cyclic RAM-ECC test and monitoring (only measurement)"
 /begin OUT_MEASUREMENT MmmCycl_numRamEccEE MmmCycl_numRomEccEE RamCycl_stEccForMcor RamCycl_stEccTestFailed /end OUT_MEASUREMENT
/end FUNCTION
/begin FUNCTION F1211_RAMCYCL_TST_M "F1211: cyclic RAM test (only measurement)" /begin OUT_MEASUREMENT RamCycl_adBegTstNext RamCycl_adTstFail RamCycl_ctTstCompl /end OUT_MEASUREMENT /end FUNCTION
/begin FUNCTION F1220_RAMBUF "F1220: Buffered RAM administration" /begin DEF_CHARACTERISTIC RamBuf_numClearReq_C /end DEF_CHARACTERISTIC /begin OUT_MEASUREMENT RamBuf_numClearReq RamBuf_st RamBuf_stClear RamBuf_stStart /end OUT_MEASUREMENT /end FUNCTION
/begin FUNCTION F1270_RAMSTCKMON "F1270: Stack monitoring" /begin DEF_CHARACTERISTIC RamStckMon_bRstDat_C /end DEF_CHARACTERISTIC
 /begin OUT_MEASUREMENT RamStckMon_numMaxUsd RamStckMon_numMaxUsdStrd RamStckMon_numMinFreeStrd RamStckMon_rMaxUsd RamStckMon_stFault /end OUT_MEASUREMENT
/end FUNCTION
/begin FUNCTION F1350_RomChsCycTst "F1350: Cyclic monitoring of the flash checksums"
 /begin OUT_MEASUREMENT Rom_RomChsCycTst_adCurrEnd Rom_RomChsCycTst_adCurrStrt Rom_RomChsCycTst_adTmpCurrStrt Rom_RomChsCycTst_ctChsAllTst Rom_RomChsCycTst_ctCurrDneAr Rom_RomChsCycTst_stChsInfo Rom_RomChsCycTst_stChsMonDisbl Rom_RomChsCycTst_stFault Rom_RomChsCycTst_stTest Rom_RomChsCycTst_tiStamp1ms Rom_RomChsCycTst_xCfgInfo Rom_RomChsCycTst_xCurrChs Rom_RomChsCycTst_xTmpCurrChs Rom_RomChsTstRef Rom_RomChsTstRslt Rom_RomChsTstRsltStrd /end OUT_MEASUREMENT
/end FUNCTION
/begin FUNCTION F1351_RomChsCycTst_Cfg "F1351: Monitoring of the flash checksums - configuration" /begin DEF_CHARACTERISTIC Rom_stMonActvCpl_C Rom_stMonActv_C /end DEF_CHARACTERISTIC /end FUNCTION
/begin FUNCTION F1405_MsrvMemByAdr "F1405: Function for the memory rights" /begin DEF_CHARACTERISTIC MsrvMemByAdr_swtAllwDvlpTab_C /end DEF_CHARACTERISTIC /end FUNCTION
/begin FUNCTION F1505_CalHndlr "F1505: Calibration Handler" /begin OUT_MEASUREMENT CalHndlr_xActvCalPg CalHndlr_xActvCalUsr /end OUT_MEASUREMENT /end FUNCTION
/begin FUNCTION F1505_CalHndlrHw "F1505: hardware dependent part of calibration handler" /begin OUT_MEASUREMENT CalHndlrHw_regAUDISR CalHndlrHw_sAudTool /end OUT_MEASUREMENT /end FUNCTION
/begin FUNCTION F1510_EtkCal "F1510: ETK calibration functions" /begin OUT_MEASUREMENT EtkCal_FshbckWaitCnt /end OUT_MEASUREMENT /end FUNCTION
/begin FUNCTION F1510_EtkSrv "F1510: General etk-services" /begin OUT_MEASUREMENT EtkSrv_tiDiffNoWait EtkSrv_tiDiffWait /end OUT_MEASUREMENT /end FUNCTION
/begin FUNCTION F1520_Serap "F1520: Calibration with InCircuit 2" /begin OUT_MEASUREMENT Serap_adOfsWrk Serap_swtPg /end OUT_MEASUREMENT /end FUNCTION
/begin FUNCTION F1590_DBG_ERR "F1590: Debug error handler"
 /begin OUT_MEASUREMENT DBG_ERR_numBuf DBG_ERR_numErr DBG_ERR_numErrId DBG_ERR_numFctId DBG_ERR_regPR DBG_ERR_xPar /end OUT_MEASUREMENT
/end FUNCTION
/begin FUNCTION F1600_RCTMODE "F1600: Services for operating system mode handling" /begin OUT_MEASUREMENT RCT_sModeAct RCT_sModeActIdx RCT_sModeNxt RCT_tiModeChng /end OUT_MEASUREMENT /end FUNCTION
/begin FUNCTION F1600_RCTTKCFG "F1600: Services for task handling"
 /begin LOC_MEASUREMENT RctT10.ctActv RctT10.ctExe RctT10.ctOvrFlw RctT100.ctActv RctT100.ctExe RctT100.ctOvrFlw RctT20.ctActv RctT20.ctExe RctT20.ctOvrFlw RctT2x5.ctActv RctT2x5.ctExe RctT2x5.ctOvrFlw RctT30.ctActv RctT30.ctExe RctT30.ctOvrFlw RctT5.ctActv RctT5.ctExe RctT5.ctOvrFlw RctT50.ctActv RctT50.ctExe RctT50.ctOvrFlw /end LOC_MEASUREMENT
/end FUNCTION
/begin FUNCTION F1600_RCTTKINI "F1600: Initialization tasks" /begin OUT_MEASUREMENT RCT_bIniActvCYC RCT_sIniActvPT /end OUT_MEASUREMENT /end FUNCTION
/begin FUNCTION F1600_ROSDUMMY "F1600: Dummy variables for use as index of DAMOS tables" /begin OUT_MEASUREMENT ROS_idxDmy /end OUT_MEASUREMENT /end FUNCTION
/begin FUNCTION F1620_RRTCPU "F1620: Calculation of the CPU utilization" /begin DEF_CHARACTERISTIC RRT_swtCpuLd2_C RRT_tiLopCpuLd2_C RRT_tiMeasCpuLd2_C /end DEF_CHARACTERISTIC
 /begin OUT_MEASUREMENT RRT_bCpuLd2Actv RRT_rCpuLd RRT_rCpuLd2 RRT_rCpuLd2Avrg RRT_rCpuLd2AvrgMax RRT_rCpuLd2Max RRT_rCpuLdMax RRT_tiLopCpuLd2 RRT_tiMeasCpuLd2 /end OUT_MEASUREMENT
/end FUNCTION
/begin FUNCTION F1620_RRTFGCFG "F1620: Functional group runtime measurement"
 /begin LOC_MEASUREMENT RrtFgp0.tiRun RrtFgp0.tiRunMax RrtFgp1.tiRun RrtFgp1.tiRunMax RrtFgp2.tiRun RrtFgp2.tiRunMax RrtFgp3.tiRun RrtFgp3.tiRunMax RrtFgp4.tiRun RrtFgp4.tiRunMax RrtFgp5.tiRun RrtFgp5.tiRunMax RrtFgp6.tiRun RrtFgp6.tiRunMax RrtFgp7.tiRun RrtFgp7.tiRunMax RrtFgp8.tiRun RrtFgp8.tiRunMax RrtFgp9.tiRun RrtFgp9.tiRunMax /end LOC_MEASUREMENT
/end FUNCTION
/begin FUNCTION F1620_RRTIRCFG "F1620: Interrupt runtime measurement"
 /begin LOC_MEASUREMENT RrtIsr0.ctExe RrtIsr0.tiRunSum RrtIsr1.ctExe RrtIsr1.tiRunSum RrtIsr2.ctExe RrtIsr2.tiRunSum RrtIsr3.ctExe RrtIsr3.tiRunSum RrtIsr4.ctExe RrtIsr4.tiRunSum RrtIsr5.ctExe RrtIsr5.tiRunSum RrtIsr6.ctExe RrtIsr6.tiRunSum RrtIsr7.ctExe RrtIsr7.tiRunSum RrtIsr8.ctExe RrtIsr8.tiRunSum RrtIsrOS.ctExe RrtIsrOS.tiRunSum /end LOC_MEASUREMENT
/end FUNCTION
/begin FUNCTION F1620_RRTPRCFG "F1620: Process runtime measurement"
 /begin OUT_MEASUREMENT RRT_idxProcFrst10 RRT_idxProcFrst100 RRT_idxProcFrst20 RRT_idxProcFrst2X5 RRT_idxProcFrst30 RRT_idxProcFrst5 RRT_idxProcFrst50 RRT_idxProcFrstBG RRT_idxProcFrstFN RRT_idxProcFrstTRS RRT_tiProcRun10 RRT_tiProcRun100 RRT_tiProcRun20 RRT_tiProcRun2X5 RRT_tiProcRun30 RRT_tiProcRun5 RRT_tiProcRun50 RRT_tiProcRunBG RRT_tiProcRunFN RRT_tiProcRunTRS /end OUT_MEASUREMENT
/end FUNCTION
/begin FUNCTION F1620_RRTPROC "F1620: Process runtime measurement"
 /begin DEF_CHARACTERISTIC RRT_adProcRunSel_C RRT_swtProcCtlAll_C RRT_swtProcCtl_C RRT_swtProcRst_C RRT_tiProcRunLoLim_C /end DEF_CHARACTERISTIC
 /begin IN_MEASUREMENT ROS_idxDmy /end IN_MEASUREMENT
 /begin OUT_MEASUREMENT RRT_adProcRunMax RRT_tiProcRunMax RRT_tiProcRunSel RRT_tiProcRunSelMax /end OUT_MEASUREMENT
/end FUNCTION
/begin FUNCTION F1620_RRTTKCFG "F1620: Task runtime measurement"
 /begin LOC_MEASUREMENT RrtT10.tiPer RrtT10.tiRun RrtT10.tiRunMax RrtT100.tiPer RrtT100.tiRun RrtT100.tiRunMax RrtT20.tiPer RrtT20.tiRun RrtT20.tiRunMax RrtT2x5.tiPer RrtT2x5.tiRun RrtT2x5.tiRunMax RrtT30.tiPer RrtT30.tiRun RrtT30.tiRunMax RrtT5.tiPer RrtT5.tiRun RrtT5.tiRunMax RrtT50.tiPer RrtT50.tiRun RrtT50.tiRunMax /end LOC_MEASUREMENT
/end FUNCTION
/begin FUNCTION F1630_RMNTKCFG "F1630: Task monitoring"
 /begin DEF_CHARACTERISTIC RmnT100_tiMon_C RmnT100_tiTOutSngl_C RmnT100_tiTOut_C RmnT10_tiMon_C RmnT10_tiTOutSngl_C RmnT10_tiTOut_C RmnT20_tiMon_C RmnT20_tiTOutSngl_C RmnT20_tiTOut_C RmnT30_tiMon_C RmnT30_tiTOutSngl_C RmnT30_tiTOut_C RmnT50_tiMon_C RmnT50_tiTOutSngl_C RmnT50_tiTOut_C RmnT5_tiMon_C RmnT5_tiTOutSngl_C RmnT5_tiTOut_C /end DEF_CHARACTERISTIC
 /begin LOC_MEASUREMENT RmnT10.ctStop RmnT10.ctStrt RmnT10.sMon RmnT10.tiOvrFlw RmnT10.tiStrt RmnT100.ctStop RmnT100.ctStrt RmnT100.sMon RmnT100.tiOvrFlw RmnT100.tiStrt RmnT20.ctStop RmnT20.ctStrt RmnT20.sMon RmnT20.tiOvrFlw RmnT20.tiStrt RmnT30.ctStop RmnT30.ctStrt RmnT30.sMon RmnT30.tiOvrFlw RmnT30.tiStrt RmnT5.ctStop RmnT5.ctStrt RmnT5.sMon RmnT5.tiOvrFlw RmnT5.tiStrt RmnT50.ctStop RmnT50.ctStrt RmnT50.sMon RmnT50.tiOvrFlw RmnT50.tiStrt /end LOC_MEASUREMENT
/end FUNCTION
/begin FUNCTION F1730_OmmMdSw "F1730: Mode Switch"
 /begin OUT_MEASUREMENT OmmMdSw_sOpMCur OmmMdSw_sOpMDest OmmMdSw_sOpMInt OmmMdSw_sOpMReq /end OUT_MEASUREMENT
/end FUNCTION
/begin FUNCTION F1740_OmmBc "F1740: Jump to BC" /begin DEF_CHARACTERISTIC OmmBc_sPrepCfg_C /end DEF_CHARACTERISTIC /begin OUT_MEASUREMENT OmmBc_sPrep /end OUT_MEASUREMENT /end FUNCTION
/begin FUNCTION F1740_OmmRst "F1740: OMM Reset Handling"
 /begin OUT_MEASUREMENT OmmRst_idxOpMode OmmRst_idxOpModeLast OmmRst_sRst OmmRst_sRstID /end OUT_MEASUREMENT
/end FUNCTION
/begin FUNCTION F1740_OmmSdMgr "F1740: Shutdown Manager" /begin DEF_CHARACTERISTIC OmmSdMgr_xCtl_C /end DEF_CHARACTERISTIC
 /begin OUT_MEASUREMENT OmmSdMgr_bReqCal OmmSdMgr_bReqHot OmmSdMgr_bSdnAllow OmmSdMgr_eReqStd OmmSdMgr_stSdn OmmSdMgr_tiExtDly /end OUT_MEASUREMENT
/end FUNCTION
/begin FUNCTION F1800_OmmInCfg "F1800: Init Configuration"
 /begin OUT_MEASUREMENT OmmInCfg_stIni OmmInCfg_stIniDSM OmmInCfg_stIniEE OmmInCfg_stIniFin OmmInCfg_stIniHot OmmInCfg_stIniInp OmmInCfg_stIniMain OmmInCfg_stIniOps OmmInCfg_stIniOutp OmmInCfg_stIniPer OmmInCfg_stIniRAM OmmInCfg_stIniSAF /end OUT_MEASUREMENT
/end FUNCTION
/begin FUNCTION F1800_OmmInMgr "F1800: initialization manager" /begin OUT_MEASUREMENT OmmInMgr_bIniOk OmmInMgr_bStrtTskFin OmmInMgr_bStrtTskPer /end OUT_MEASUREMENT /end FUNCTION
/begin FUNCTION F2050_CNE "F2050: CNE interface" /begin DEF_CHARACTERISTIC CNE_numAlvTol_C /end DEF_CHARACTERISTIC /begin OUT_MEASUREMENT CNE_cfMsgRx /end OUT_MEASUREMENT /end FUNCTION
/begin FUNCTION F2062_CAN_MSGMON_1 "F2062: CAN interface"
 /begin DEF_CHARACTERISTIC CANFA_ctMsgMonAlvACLNX_MASSCNTR_C CANFA_ctMsgMonAlvACLNY_MASSCNTR_C CANFA_ctMsgMonAlvAVL_BRTORQ_SUM_C CANFA_ctMsgMonAlvKLEMMEN_C CANFA_ctMsgMonAlvMASS_VEH_C CANFA_ctMsgMonAlvOP_SPD_C CANFA_ctMsgMonAlvSTAT_DS_VRFD_C CANFA_ctMsgMonAlvSTEA_FTAX_EFFV_C CANFA_ctMsgMonAlvST_BLT_CT_SOCCU_C CANFA_ctMsgMonAlvST_DISP_DRDY_C CANFA_ctMsgMonAlvST_GWS_C CANFA_ctMsgMonAlvST_STAB_DSC_C CANFA_ctMsgMonAlvST_VEHSS_PBRK_C CANFA_ctMsgMonAlvST_VHSS_C CANFA_ctMsgMonAlvSU_SW_DRDY_C CANFA_ctMsgMonAlvTLT_RW_C CANFA_ctMsgMonAlvTORQ_PT_HYB_1_C CANFA_ctMsgMonAlvVYAW_VEH_C CANFA_ctMsgMonAlvV_VEH_C CANFA_ctMsgMonChkACLNX_MASSCNTR_C CANFA_ctMsgMonChkACLNY_MASSCNTR_C CANFA_ctMsgMonChkAVL_BRTORQ_SUM_C CANFA_ctMsgMonChkKLEMMEN_C CANFA_ctMsgMonChkMASS_VEH_C CANFA_ctMsgMonChkOP_SPD_C CANFA_ctMsgMonChkSTAT_DS_VRFD_C CANFA_ctMsgMonChkST_BLT_CT_SOCCU_C CANFA_ctMsgMonChkST_GWS_C CANFA_ctMsgMonChkST_STAB_DSC_C CANFA_ctMsgMonChkST_VEHSS_PBRK_C CANFA_ctMsgMonChkST_VHSS_C CANFA_ctMsgMonChkSU_SW_DRDY_C CANFA_ctMsgMonChkTLT_RW_C CANFA_ctMsgMonChkTORQ_PT_HYB_1_C CANFA_ctMsgMonChkVYAW_VEH_C CANFA_ctMsgMonChkV_VEH_C CANFA_ctMsgMonDlcACLNX_MASSCNTR_C CANFA_ctMsgMonDlcACLNY_MASSCNTR_C CANFA_ctMsgMonDlcAVL_BRTORQ_SUM_C CANFA_ctMsgMonDlcAVL_RPM_WHL_UPRT_C CANFA_ctMsgMonDlcA_TEMP_C CANFA_ctMsgMonDlcDIAG_OBD_ENG_C CANFA_ctMsgMonDlcFAHRGESTELLNUMMER_C CANFA_ctMsgMonDlcFLLUPT_GPWSUP_C CANFA_ctMsgMonDlcFZZSTD_C CANFA_ctMsgMonDlcKILOMETERSTAND_C CANFA_ctMsgMonDlcKLEMMEN_C CANFA_ctMsgMonDlcMASS_VEH_C CANFA_ctMsgMonDlcOP_SPD_C CANFA_ctMsgMonDlcRELATIVZEIT_C CANFA_ctMsgMonDlcSTAT_ANHAENGER_C CANFA_ctMsgMonDlcSTAT_CT_HABR_C CANFA_ctMsgMonDlcSTAT_DS_VRFD_C CANFA_ctMsgMonDlcSTAT_ZV_KLAPPEN_C CANFA_ctMsgMonDlcSTEA_FTAX_EFFV_C CANFA_ctMsgMonDlcST_BLT_CT_SOCCU_C CANFA_ctMsgMonDlcST_DISP_DRDY_C CANFA_ctMsgMonDlcST_GWS_C CANFA_ctMsgMonDlcST_STAB_DSC_C CANFA_ctMsgMonDlcST_STA_PWR_DRV_C CANFA_ctMsgMonDlcST_VEHSS_PBRK_C CANFA_ctMsgMonDlcST_VHSS_C CANFA_ctMsgMonDlcSU_SW_DRDY_C CANFA_ctMsgMonDlcTLT_RW_C CANFA_ctMsgMonDlcTOMA_WHL_C CANFA_ctMsgMonDlcTORQ_PT_HYB_1_C CANFA_ctMsgMonDlcVYAW_VEH_C CANFA_ctMsgMonDlcV_VEH_C CANFA_swtMsgMonACLNX_MASSCNTR_C CANFA_swtMsgMonACLNY_MASSCNTR_C CANFA_swtMsgMonAVL_BRTORQ_SUM_C CANFA_swtMsgMonAVL_RPM_WHL_UPRT_C CANFA_swtMsgMonA_TEMP_C CANFA_swtMsgMonDIAG_OBD_ENG_C CANFA_swtMsgMonDT_DISP_GRDT_RX_C CANFA_swtMsgMonFAHRGESTELLNUMMER_C CANFA_swtMsgMonFLLUPT_GPWSUP_C CANFA_swtMsgMonFZZSTD_C CANFA_swtMsgMonKILOMETERSTAND_C CANFA_swtMsgMonKLEMMEN_C CANFA_swtMsgMonMASS_VEH_C CANFA_swtMsgMonOP_SPD_C CANFA_swtMsgMonRELATIVZEIT_C CANFA_swtMsgMonSTAT_ANHAENGER_C CANFA_swtMsgMonSTAT_CT_HABR_C CANFA_swtMsgMonSTAT_DS_VRFD_C CANFA_swtMsgMonSTAT_ZV_KLAPPEN_C CANFA_swtMsgMonSTEA_FTAX_EFFV_C CANFA_swtMsgMonST_BLT_CT_SOCCU_C CANFA_swtMsgMonST_DISP_DRDY_C CANFA_swtMsgMonST_GRB_ECU_RX_C CANFA_swtMsgMonST_GWS_C CANFA_swtMsgMonST_STAB_DSC_C CANFA_swtMsgMonST_STA_PWR_DRV_C CANFA_swtMsgMonST_VEHSS_PBRK_C CANFA_swtMsgMonST_VHSS_C CANFA_swtMsgMonSU_SW_DRDY_C CANFA_swtMsgMonTAR_DT_GRB_MOT_1_RX_C CANFA_swtMsgMonTLT_RW_C CANFA_swtMsgMonTOMA_WHL_C CANFA_swtMsgMonTORQ_GRB_HYB_RX_C CANFA_swtMsgMonTORQ_PT_HYB_1_C CANFA_swtMsgMonVYAW_VEH_C CANFA_swtMsgMonV_VEH_C /end DEF_CHARACTERISTIC
 /begin OUT_MEASUREMENT CANFA_ACLNX_MASSCNTR CANFA_ACLNX_MASSCNTR_DATA CANFA_ACLNX_MASSCNTR_RAW CANFA_ACLNY_MASSCNTR CANFA_ACLNY_MASSCNTR_DATA CANFA_ACLNY_MASSCNTR_RAW CANFA_AVL_BRTORQ_SUM CANFA_AVL_BRTORQ_SUM_COMP CANFA_AVL_BRTORQ_SUM_COMPSTA CANFA_AVL_BRTORQ_SUM_DATA CANFA_AVL_BRTORQ_SUM_RAW CANFA_AVL_RPM_WHL_UPRT CANFA_AVL_RPM_WHL_UPRT_DATA CANFA_AVL_RPM_WHL_UPRT_RAW CANFA_A_TEMP CANFA_A_TEMP_DATA CANFA_A_TEMP_RAW CANFA_DIAG_OBD_ENG CANFA_DIAG_OBD_ENG_DATA CANFA_DIAG_OBD_ENG_RAW CANFA_DIAG_OBD_GRB CANFA_DIAG_OBD_GRB_DATA CANFA_DT_DISP_GRDT CANFA_DT_DISP_GRDT_COMP CANFA_DT_DISP_GRDT_DATA CANFA_DT_DISP_GRDT_RX CANFA_DT_DISP_GRDT_RX_COMP CANFA_DT_DISP_GRDT_RX_DATA CANFA_DT_DISP_GRDT_RX_RAW CANFA_FAHRGESTELLNUMMER CANFA_FAHRGESTELLNUMMER_DATA CANFA_FAHRGESTELLNUMMER_RAW CANFA_FLLUPT_GPWSUP CANFA_FLLUPT_GPWSUP_DATA CANFA_FLLUPT_GPWSUP_RAW CANFA_FZZSTD CANFA_FZZSTD_DATA CANFA_FZZSTD_RAW CANFA_KILOMETERSTAND CANFA_KILOMETERSTAND_DATA CANFA_KILOMETERSTAND_RAW CANFA_KLEMMEN CANFA_KLEMMEN_COMP CANFA_KLEMMEN_COMPSTA CANFA_KLEMMEN_DATA CANFA_KLEMMEN_RAW CANFA_MASS_VEH CANFA_MASS_VEH_DATA CANFA_MASS_VEH_RAW CANFA_OP_SPD CANFA_OP_SPD_DATA CANFA_OP_SPD_RAW CANFA_RELATIVZEIT CANFA_RELATIVZEIT_DATA CANFA_RELATIVZEIT_RAW CANFA_STAT_ANHAENGER CANFA_STAT_ANHAENGER_DATA CANFA_STAT_ANHAENGER_RAW CANFA_STAT_CT_HABR CANFA_STAT_CT_HABR_DATA CANFA_STAT_CT_HABR_RAW CANFA_STAT_DS_VRFD CANFA_STAT_DS_VRFD_DATA CANFA_STAT_DS_VRFD_RAW CANFA_STAT_ZV_KLAPPEN CANFA_STAT_ZV_KLAPPEN_DATA CANFA_STAT_ZV_KLAPPEN_RAW CANFA_STEA_FTAX_EFFV CANFA_STEA_FTAX_EFFV_DATA CANFA_STEA_FTAX_EFFV_RAW CANFA_ST_BLT_CT_SOCCU CANFA_ST_BLT_CT_SOCCU_DATA CANFA_ST_BLT_CT_SOCCU_RAW CANFA_ST_DISP_DRDY CANFA_ST_DISP_DRDY_DATA CANFA_ST_DISP_DRDY_RAW CANFA_ST_GRB_ECU CANFA_ST_GRB_ECU_COMP CANFA_ST_GRB_ECU_DATA CANFA_ST_GRB_ECU_RX CANFA_ST_GRB_ECU_RX_COMP CANFA_ST_GRB_ECU_RX_DATA CANFA_ST_GRB_ECU_RX_RAW CANFA_ST_GWS CANFA_ST_GWS_COMP CANFA_ST_GWS_COMPSTA CANFA_ST_GWS_DATA CANFA_ST_GWS_RAW CANFA_ST_STAB_DSC CANFA_ST_STAB_DSC_COMP CANFA_ST_STAB_DSC_COMPSTA CANFA_ST_STAB_DSC_DATA CANFA_ST_STAB_DSC_RAW CANFA_ST_STA_PWR_DRV CANFA_ST_STA_PWR_DRV_DATA CANFA_ST_STA_PWR_DRV_RAW CANFA_ST_VEHSS_PBRK CANFA_ST_VEHSS_PBRK_DATA CANFA_ST_VEHSS_PBRK_RAW CANFA_ST_VHSS CANFA_ST_VHSS_DATA CANFA_ST_VHSS_RAW CANFA_SU_SW_DRDY CANFA_SU_SW_DRDY_DATA CANFA_SU_SW_DRDY_RAW CANFA_TAR_DT_GRB_MOT_1 CANFA_TAR_DT_GRB_MOT_1_COMP CANFA_TAR_DT_GRB_MOT_1_DATA CANFA_TAR_DT_GRB_MOT_1_RX CANFA_TAR_DT_GRB_MOT_1_RX_COMP CANFA_TAR_DT_GRB_MOT_1_RX_DATA CANFA_TAR_DT_GRB_MOT_1_RX_RAW CANFA_TLT_RW CANFA_TLT_RW_DATA CANFA_TLT_RW_RAW CANFA_TOMA_WHL CANFA_TOMA_WHL_DATA CANFA_TOMA_WHL_RAW CANFA_TORQ_GRB_HYB CANFA_TORQ_GRB_HYB_COMP CANFA_TORQ_GRB_HYB_DATA CANFA_TORQ_GRB_HYB_RX CANFA_TORQ_GRB_HYB_RX_COMP CANFA_TORQ_GRB_HYB_RX_DATA CANFA_TORQ_GRB_HYB_RX_RAW CANFA_TORQ_PT_HYB_1 CANFA_TORQ_PT_HYB_1_DATA CANFA_TORQ_PT_HYB_1_RAW CANFA_VYAW_VEH CANFA_VYAW_VEH_DATA CANFA_VYAW_VEH_RAW CANFA_V_VEH CANFA_V_VEH_DATA CANFA_V_VEH_RAW /end OUT_MEASUREMENT
/end FUNCTION
/begin FUNCTION F2062_CAN_MSGMON_2 "F2062: CAN interface"
 /begin DEF_CHARACTERISTIC CAN_ctMsgMonAlvANG_ACPD_C CAN_ctMsgMonAlvAVL_DT_MOT_1_C CAN_ctMsgMonAlvAVL_DT_MOT_1_LT_C CAN_ctMsgMonAlvDT_PT_2_C CAN_ctMsgMonAlvHYB_SPEC_C CAN_ctMsgMonAlvSTAT_ENG_STA_AUTO_C CAN_ctMsgMonAlvST_GWS_C CAN_ctMsgMonAlvTORQ_CRSH_1_C CAN_ctMsgMonAlvTORQ_CRSH_2_C CAN_ctMsgMonAlvTORQ_CRSH_3_C CAN_ctMsgMonAlvWMOM_DRV_1_C CAN_ctMsgMonAlvWMOM_DRV_3_C CAN_ctMsgMonAlvWMOM_DRV_7_C CAN_ctMsgMonChkANG_ACPD_C CAN_ctMsgMonChkAVL_DT_MOT_1_C CAN_ctMsgMonChkAVL_DT_MOT_1_LT_C CAN_ctMsgMonChkDT_PT_2_C CAN_ctMsgMonChkHYB_SPEC_C CAN_ctMsgMonChkSTAT_ENG_STA_AUTO_C CAN_ctMsgMonChkST_GWS_C CAN_ctMsgMonChkTORQ_CRSH_1_C CAN_ctMsgMonChkTORQ_CRSH_2_C CAN_ctMsgMonChkTORQ_CRSH_3_C CAN_ctMsgMonChkWMOM_DRV_1_C CAN_ctMsgMonChkWMOM_DRV_3_C CAN_ctMsgMonChkWMOM_DRV_7_C CAN_ctMsgMonDlcANG_ACPD_C CAN_ctMsgMonDlcAVL_DT_MOT_1_C CAN_ctMsgMonDlcAVL_DT_MOT_1_LT_C CAN_ctMsgMonDlcDIAG_OBD_ENG_C CAN_ctMsgMonDlcDT_DRV_EL_C CAN_ctMsgMonDlcDT_PT_1_C CAN_ctMsgMonDlcDT_PT_2_C CAN_ctMsgMonDlcFLLUPT_GPWSUP_C CAN_ctMsgMonDlcHYB_SPEC_C CAN_ctMsgMonDlcSPEC_HVSTO_C CAN_ctMsgMonDlcSTAT_ENG_STA_AUTO_C CAN_ctMsgMonDlcSTAT_HVSTO_2_C CAN_ctMsgMonDlcST_GWS_C CAN_ctMsgMonDlcTORQ_CRSH_1_C CAN_ctMsgMonDlcTORQ_CRSH_2_C CAN_ctMsgMonDlcTORQ_CRSH_3_C CAN_ctMsgMonDlcWMOM_DRV_1_C CAN_ctMsgMonDlcWMOM_DRV_3_C CAN_ctMsgMonDlcWMOM_DRV_7_C CAN_swtMsgMonANG_ACPD_C CAN_swtMsgMonAVL_DT_MOT_1_C CAN_swtMsgMonAVL_DT_MOT_1_LT_C CAN_swtMsgMonDIAG_OBD_ENG_C CAN_swtMsgMonDT_DISP_GRDT_RX_C CAN_swtMsgMonDT_DRV_EL_C CAN_swtMsgMonDT_GRDT_RX_C CAN_swtMsgMonDT_PT_1_C CAN_swtMsgMonDT_PT_2_C CAN_swtMsgMonFLLUPT_GPWSUP_C CAN_swtMsgMonHYB_SPEC_C CAN_swtMsgMonRQ_TORQ_CRSH_GRB_RX_C CAN_swtMsgMonSPEC_HVSTO_C CAN_swtMsgMonSTAT_ENG_STA_AUTO_C CAN_swtMsgMonSTAT_HVSTO_2_C CAN_swtMsgMonST_GRB_ECU_RX_C CAN_swtMsgMonST_GRB_HYB_RX_C CAN_swtMsgMonST_GWS_C CAN_swtMsgMonTORQ_CRSH_1_C CAN_swtMsgMonTORQ_CRSH_2_C CAN_swtMsgMonTORQ_CRSH_3_C CAN_swtMsgMonWMOM_DRV_1_C CAN_swtMsgMonWMOM_DRV_3_C CAN_swtMsgMonWMOM_DRV_7_C /end DEF_CHARACTERISTIC
 /begin OUT_MEASUREMENT CAN_ANG_ACPD CAN_ANG_ACPD_COMP CAN_ANG_ACPD_COMPSTA CAN_ANG_ACPD_DATA CAN_ANG_ACPD_RAW CAN_AVL_DT_MOT_1 CAN_AVL_DT_MOT_1_COMP CAN_AVL_DT_MOT_1_COMPSTA CAN_AVL_DT_MOT_1_DATA CAN_AVL_DT_MOT_1_LT CAN_AVL_DT_MOT_1_LT_DATA CAN_AVL_DT_MOT_1_LT_RAW CAN_AVL_DT_MOT_1_RAW CAN_DIAG_OBD_ENG CAN_DIAG_OBD_ENG_DATA CAN_DIAG_OBD_ENG_RAW CAN_DIAG_OBD_GRB CAN_DIAG_OBD_GRB_DATA CAN_DISP_RPM_ENG_DYNS CAN_DISP_RPM_ENG_DYNS_DATA CAN_DT_DISP_GRDT CAN_DT_DISP_GRDT_COMP CAN_DT_DISP_GRDT_DATA CAN_DT_DISP_GRDT_RX CAN_DT_DISP_GRDT_RX_COMP CAN_DT_DISP_GRDT_RX_DATA CAN_DT_DISP_GRDT_RX_RAW CAN_DT_DRV_EL CAN_DT_DRV_EL_DATA CAN_DT_DRV_EL_RAW CAN_DT_GRDT CAN_DT_GRDT_COMP CAN_DT_GRDT_DATA CAN_DT_GRDT_RX CAN_DT_GRDT_RX_COMP CAN_DT_GRDT_RX_DATA CAN_DT_GRDT_RX_RAW CAN_DT_PT_1 CAN_DT_PT_1_DATA CAN_DT_PT_1_RAW CAN_DT_PT_2 CAN_DT_PT_2_COMP CAN_DT_PT_2_COMPSTA CAN_DT_PT_2_DATA CAN_DT_PT_2_RAW CAN_FLLUPT_GPWSUP CAN_FLLUPT_GPWSUP_DATA CAN_FLLUPT_GPWSUP_RAW CAN_HYB_SPEC CAN_HYB_SPEC_COMP CAN_HYB_SPEC_COMPSTA CAN_HYB_SPEC_DATA CAN_HYB_SPEC_RAW CAN_RQ_TORQ_CRSH_GRB CAN_RQ_TORQ_CRSH_GRB_2 CAN_RQ_TORQ_CRSH_GRB_2_DATA CAN_RQ_TORQ_CRSH_GRB_COMP CAN_RQ_TORQ_CRSH_GRB_DATA CAN_RQ_TORQ_CRSH_GRB_RX CAN_RQ_TORQ_CRSH_GRB_RX_COMP CAN_RQ_TORQ_CRSH_GRB_RX_DATA CAN_RQ_TORQ_CRSH_GRB_RX_RAW CAN_SPEC_HVSTO CAN_SPEC_HVSTO_DATA CAN_SPEC_HVSTO_RAW CAN_STAT_ENG_STA_AUTO CAN_STAT_ENG_STA_AUTO_COMP CAN_STAT_ENG_STA_AUTO_COMPSTA CAN_STAT_ENG_STA_AUTO_DATA CAN_STAT_ENG_STA_AUTO_RAW CAN_STAT_HVSTO_2 CAN_STAT_HVSTO_2_DATA CAN_STAT_HVSTO_2_RAW CAN_ST_GRB_ECU CAN_ST_GRB_ECU_COMP CAN_ST_GRB_ECU_DATA CAN_ST_GRB_ECU_RX CAN_ST_GRB_ECU_RX_COMP CAN_ST_GRB_ECU_RX_DATA CAN_ST_GRB_ECU_RX_RAW CAN_ST_GRB_HYB CAN_ST_GRB_HYB_COMP CAN_ST_GRB_HYB_DATA CAN_ST_GRB_HYB_RX CAN_ST_GRB_HYB_RX_COMP CAN_ST_GRB_HYB_RX_DATA CAN_ST_GRB_HYB_RX_RAW CAN_ST_GWS CAN_ST_GWS_COMP CAN_ST_GWS_COMPSTA CAN_ST_GWS_DATA CAN_ST_GWS_RAW CAN_TORQ_CRSH_1 CAN_TORQ_CRSH_1_COMP CAN_TORQ_CRSH_1_COMPSTA CAN_TORQ_CRSH_1_DATA CAN_TORQ_CRSH_1_RAW CAN_TORQ_CRSH_2 CAN_TORQ_CRSH_2_DATA CAN_TORQ_CRSH_2_RAW CAN_TORQ_CRSH_3 CAN_TORQ_CRSH_3_COMP CAN_TORQ_CRSH_3_COMPSTA CAN_TORQ_CRSH_3_DATA CAN_TORQ_CRSH_3_RAW CAN_WMOM_DRV_1 CAN_WMOM_DRV_1_DATA CAN_WMOM_DRV_1_RAW CAN_WMOM_DRV_3 CAN_WMOM_DRV_3_DATA CAN_WMOM_DRV_3_RAW CAN_WMOM_DRV_7 CAN_WMOM_DRV_7_DATA CAN_WMOM_DRV_7_RAW /end OUT_MEASUREMENT
/end FUNCTION
/begin FUNCTION F2063_CNE_BUSOFF "F2063: CNE interface"
 /begin DEF_CHARACTERISTIC CAN_stNodePerLine_C CAN_swtErrPasDet_C CAN_tiBusOffChk_C CAN_tiBusOffDly1_C CAN_tiBusOffDly2_C CAN_tiErrPasDly_C /end DEF_CHARACTERISTIC
 /begin OUT_MEASUREMENT CAN_bBusOff CAN_bErrPas CAN_stBusOff CAN_stErrPas CAN_stLine CAN_tiBusOff CAN_tiErrPas /end OUT_MEASUREMENT
/end FUNCTION
/begin FUNCTION F2070_CAN_SEND_PREP "F2070: CAN system interface"
 /begin DEF_CHARACTERISTIC CANFA_swtMsgSlw_ST_BLT_CT_SOCCU_C CAN_TIDEB_DIAG_OBD_GRB_C CAN_TIDEB_DT_DISP_GRDT_C CAN_TIDEB_ST_GRB_ECU_C CAN_TIDEB_ST_GRB_HYB_C /end DEF_CHARACTERISTIC
 /begin OUT_MEASUREMENT CanFA_tiEventMsgDelayDIAG_OBD_GRB CanFA_tiEventMsgDelayDT_DISP_GRDT CanFA_tiEventMsgDelayST_GRB_ECU Can_tiEventMsgDelayDIAG_OBD_GRB Can_tiEventMsgDelayDT_DISP_GRDT Can_tiEventMsgDelayST_GRB_ECU Can_tiEventMsgDelayST_GRB_HYB /end OUT_MEASUREMENT
/end FUNCTION
/begin FUNCTION F2351_ECE_CORE "F2351: ECE core test/measurement"
 /begin DEF_CHARACTERISTIC ECE_CORE_numPbusCycles_C ECE_CORE_regModClkMsk_C ECE_CORE_regModeMsk_C ECE_CORE_stRamWS_C ECE_CORE_stRstTrg_C /end DEF_CHARACTERISTIC
 /begin OUT_MEASUREMENT ECE_CORE_bMisrErr ECE_CORE_ctPbusCycles ECE_CORE_numPbusTransfers ECE_CORE_regMisr /end OUT_MEASUREMENT
/end FUNCTION
/begin FUNCTION F2352_ECE_IDX "F2352: Project Specific Channel Indices of the ECU Encapsulation (ECE)"
 /begin DEF_CHARACTERISTIC ECE_idxAdcAtf2_C ECE_idxAdcAtf_C ECE_idxAdcBrk_C ECE_idxAdcDrvPos_C ECE_idxAdcFdbkSsply5_C ECE_idxAdcFdbkStrtRly_C ECE_idxAdcLx_C ECE_idxAdcOptRef_C ECE_idxAdcOpt_C ECE_idxAdcPres_C ECE_idxAdcTap_C ECE_idxAdcTim_C ECE_idxAdcVdd3_C ECE_idxAdc_iHss_C ECE_idxAdc_iPSply_C ECE_idxDigLx_C ECE_idxFrqTis2_C ECE_idxFrqTis_C ECE_idxFrqTos_C ECE_idxLxVarHandling_C ECE_idxPwdLx_C ECE_idxPwdOpt_C ECE_idxPwdTapProt_C ECE_idxPwdTapX_C ECE_stAdcLxAvail_C ECE_stDigLxAvail_C /end DEF_CHARACTERISTIC
 /begin IN_MEASUREMENT ECE_idxDmy /end IN_MEASUREMENT
 /begin OUT_MEASUREMENT ECE_idxLx ECE_idxLxOff /end OUT_MEASUREMENT
/end FUNCTION
/begin FUNCTION F2352_ECE_PSYS "F2352: Project Specific Definitions of the ECU Encapsulation (ECE)" /begin OUT_MEASUREMENT ECE_idxDmy /end OUT_MEASUREMENT /end FUNCTION
/begin RECORD_LAYOUT AblGLFKFub_M FNC_VALUES 1 UBYTE ROW_DIR DIRECT /end RECORD_LAYOUT
/begin RECORD_LAYOUT AblGLFKFub_S1 FNC_VALUES 1 UBYTE ROW_DIR DIRECT /end RECORD_LAYOUT
/begin RECORD_LAYOUT AblGLKWBub_S1 FNC_VALUES 1 UBYTE COLUMN_DIR DIRECT /end RECORD_LAYOUT
/begin RECORD_LAYOUT AblGLKWBuw_M FNC_VALUES 1 UWORD COLUMN_DIR DIRECT /end RECORD_LAYOUT
/begin RECORD_LAYOUT AblGLKWBuw_S1 FNC_VALUES 1 UWORD COLUMN_DIR DIRECT /end RECORD_LAYOUT
/begin RECORD_LAYOUT AblGLKWub_M FNC_VALUES 1 UBYTE COLUMN_DIR DIRECT /end RECORD_LAYOUT
/begin RECORD_LAYOUT AblGLKWub_S1 FNC_VALUES 1 UBYTE COLUMN_DIR DIRECT /end RECORD_LAYOUT
/begin RECORD_LAYOUT AblGLKWul_M FNC_VALUES 1 ULONG COLUMN_DIR DIRECT /end RECORD_LAYOUT
/begin RECORD_LAYOUT AblGLKWuw_M FNC_VALUES 1 UWORD COLUMN_DIR DIRECT /end RECORD_LAYOUT
/begin RECORD_LAYOUT AblGLKWuw_S1 FNC_VALUES 1 UWORD COLUMN_DIR DIRECT /end RECORD_LAYOUT
/end MODULE
/end PROJECT
