ASAP2_VERSION 1 51
/begin PROJECT ZHBC8600 "Gen2_BMW_System_Supplier_Lib"
/begin MODULE CPP ""
/begin MOD_COMMON "" BYTE_ORDER MSB_FIRST ALIGNMENT_BYTE 1 ALIGNMENT_WORD 2 ALIGNMENT_LONG 4 ALIGNMENT_FLOAT32_IEEE 4 ALIGNMENT_FLOAT64_IEEE 1 /end MOD_COMMON
/begin COMPU_METHOD SAB_0025PROZENT_S2_S3 "int = ((phys * 1000) / 25) - (0) %" RAT_FUNC "%4.3" "%" COEFFS 0 40 0 0 0 1 /end COMPU_METHOD
/begin COMPU_METHOD SAB_100PROZENT254_S2_S3 "int = ((phys * 254) / 100) - (0) %" RAT_FUNC "%4.3" "%" COEFFS 0 2.54 0 0 0 1 /end COMPU_METHOD
/begin COMPU_METHOD SAB_C_CGT_1CEL_M40_S2_S3 "int = ((phys * 1) / 1) - (-40) Grad Celsius" RAT_FUNC "%1.0" "Grad Celsius" COEFFS 0 1 40 0 0 1 /end COMPU_METHOD
/begin COMPU_METHOD SAB_C_TEMPEXTERN_CEL2_M40_S2_S3 "int = ((phys * 2) / 1) - (-80) Grad Celsius" RAT_FUNC "%4.3" "Grad Celsius" COEFFS 0 2 80 0 0 1 /end COMPU_METHOD
/begin COMPU_METHOD SAB_FRQ_1HZ_S2_S3 "int = ((phys * 1) / 1) - (0) Hz" RAT_FUNC "%1.0" "Hz" COEFFS 0 1 0 0 0 1 /end COMPU_METHOD
/begin COMPU_METHOD SAB_I_MA10_S2_S3 "int = ((phys * 10) / 1) - (0) mA" RAT_FUNC "%4.3" "mA" COEFFS 0 10 0 0 0 1 /end COMPU_METHOD
/begin COMPU_METHOD SAB_K1000_S2_S3 "int = ((phys * 1000) / 1) - (0) -" RAT_FUNC "%4.3" "-" COEFFS 0 1000 0 0 0 1 /end COMPU_METHOD
/begin COMPU_METHOD SAB_M_1NM_M32000_S2_S3 "int = ((phys * 1) / 1) - (-32000) Nm" RAT_FUNC "%1.0" "Nm" COEFFS 0 1 32000 0 0 1 /end COMPU_METHOD
/begin COMPU_METHOD SAB_M_1NM_S2_S3 "int = ((phys * 1) / 1) - (0) Nm" RAT_FUNC "%1.0" "Nm" COEFFS 0 1 0 0 0 1 /end COMPU_METHOD
/begin COMPU_METHOD SAB_M_20KG_S2_S3 "int = ((phys * 1) / 20) - (0) kg" RAT_FUNC "%4.3" "kg" COEFFS 0 0.05 0 0 0 1 /end COMPU_METHOD
/begin COMPU_METHOD SAB_M_NM2_M2047_S2_S3 "int = ((phys * 2) / 1) - (-2047) Nm" RAT_FUNC "%4.3" "Nm" COEFFS 0 2 2047 0 0 1 /end COMPU_METHOD
/begin COMPU_METHOD SAB_M_NM2_S2_S3 "int = ((phys * 2) / 1) - (0) Nm" RAT_FUNC "%4.3" "Nm" COEFFS 0 2 0 0 0 1 /end COMPU_METHOD
/begin COMPU_METHOD SAB_N_10RPM_S2_S3 "int = ((phys * 1) / 10) - (0) 1/min" RAT_FUNC "%4.3" "1/min" COEFFS 0 0.1 0 0 0 1 /end COMPU_METHOD
/begin COMPU_METHOD SAB_N_1RPM_S2_S3 "int = ((phys * 1) / 1) - (0) 1/min" RAT_FUNC "%1.0" "1/min" COEFFS 0 1 0 0 0 1 /end COMPU_METHOD
/begin COMPU_METHOD SAB_N_50RPM_S2_S3 "int = ((phys * 1) / 50) - (0) 1/min" RAT_FUNC "%4.3" "1/min" COEFFS 0 0.02 0 0 0 1 /end COMPU_METHOD
/begin COMPU_METHOD SAB_N_RPM2_M5000_S2_S3 "int = ((phys * 2) / 1) - (-10000) 1/min" RAT_FUNC "%4.3" "1/min" COEFFS 0 2 10000 0 0 1 /end COMPU_METHOD
/begin COMPU_METHOD SAB_PHI_SENS_1GRAD20_M1280_S2_S3 "int = ((phys * 20) / 1) - (-1280) grad" RAT_FUNC "%4.3" "grad" COEFFS 0 20 1280 0 0 1 /end COMPU_METHOD
/begin COMPU_METHOD SAB_PHI_SENS_1GRAD3_M128_S2_S3 "int = ((phys * 3) / 1) - (-128) grad" RAT_FUNC "%4.3" "grad" COEFFS 0 3 128 0 0 1 /end COMPU_METHOD
/begin COMPU_METHOD SAB_PROZENT10_M2000_S2_S3 "int = ((phys * 10) / 1) - (-2000) %" RAT_FUNC "%4.3" "%" COEFFS 0 10 2000 0 0 1 /end COMPU_METHOD
/begin COMPU_METHOD SAB_STANDARD_S2_S3 "int = ((phys * 1) / 1) - (0) -" RAT_FUNC "%1.0" "-" COEFFS 0 1 0 0 0 1 /end COMPU_METHOD
/begin COMPU_METHOD SAB_T_TIMER_10MS_S2_S3 "int = ((phys * 1) / 10) - (0) ms" RAT_FUNC "%4.3" "ms" COEFFS 0 0.1 0 0 0 1 /end COMPU_METHOD
/begin COMPU_METHOD SAB_T_TIMER_1MS_S2_S3 "int = ((phys * 1) / 1) - (0) ms" RAT_FUNC "%1.0" "ms" COEFFS 0 1 0 0 0 1 /end COMPU_METHOD
/begin COMPU_METHOD SAB_T_TIMER_1US_S2_S3 "int = ((phys * 1) / 1) - (0) us" RAT_FUNC "%1.0" "us" COEFFS 0 1 0 0 0 1 /end COMPU_METHOD
/begin COMPU_METHOD SAB_T_TIMER_266NS66_S2_S3 "int = ((phys * 3750) / 1) - (0) ms" RAT_FUNC "%9.8" "ms" COEFFS 0 3750 0 0 0 1 /end COMPU_METHOD
/begin COMPU_METHOD SAB_T_TIMER_2MS_S2_S3 "int = ((phys * 1) / 2) - (0) ms" RAT_FUNC "%4.3" "ms" COEFFS 0 0.5 0 0 0 1 /end COMPU_METHOD
/begin COMPU_METHOD SAB_T_TIMER_31NS25_S2_S3 "int = ((phys * 32000) / 1) - (0) ms" RAT_FUNC "%9.8" "ms" COEFFS 0 32000 0 0 0 1 /end COMPU_METHOD
/begin COMPU_METHOD SAB_T_TIMER_40MS_S2_S3 "int = ((phys * 1) / 40) - (0) ms" RAT_FUNC "%4.3" "ms" COEFFS 0 0.025 0 0 0 1 /end COMPU_METHOD
/begin COMPU_METHOD SAB_T_TIMER_50NS_S2_S3 "int = ((phys * 20000) / 1) - (0) ms" RAT_FUNC "%6.5" "ms" COEFFS 0 20000 0 0 0 1 /end COMPU_METHOD
/begin COMPU_METHOD SAB_T_TIMER_S10_S2_S3 "int = ((phys * 10) / 1) - (0) s" RAT_FUNC "%4.3" "s" COEFFS 0 10 0 0 0 1 /end COMPU_METHOD
/begin COMPU_METHOD SAB_T_TIMER_S2_S2_S3 "int = ((phys * 2) / 1) - (0) s" RAT_FUNC "%4.3" "s" COEFFS 0 2 0 0 0 1 /end COMPU_METHOD
/begin COMPU_METHOD SAB_T_US10_S2_S3 "int = ((phys * 10) / 1) - (0) us" RAT_FUNC "%4.3" "us" COEFFS 0 10 0 0 0 1 /end COMPU_METHOD
/begin COMPU_METHOD SAB_T_US_S2_S3 "int = ((phys * 1) / 1) - (0) us" RAT_FUNC "%1.0" "us" COEFFS 0 1 0 0 0 1 /end COMPU_METHOD
/begin COMPU_METHOD SAB_U_1VOLT1000_S2_S3 "int = ((phys * 1000) / 1) - (0) Volt" RAT_FUNC "%4.3" "Volt" COEFFS 0 1000 0 0 0 1 /end COMPU_METHOD
/begin COMPU_METHOD SAB_U_1VOLT8000_S2_S3 "int = ((phys * 8000) / 1) - (0) V" RAT_FUNC "%6.5" "V" COEFFS 0 8000 0 0 0 1 /end COMPU_METHOD
/begin COMPU_METHOD SAB_U_5VOLT100_S2_S3 "int = ((phys * 100) / 5) - (0) V" RAT_FUNC "%4.3" "V" COEFFS 0 20 0 0 0 1 /end COMPU_METHOD
/begin COMPU_METHOD SAB_U_8VOLT100_S2_S3 "int = ((phys * 100) / 8) - (0) V" RAT_FUNC "%4.3" "V" COEFFS 0 12.5 0 0 0 1 /end COMPU_METHOD
/begin COMPU_METHOD SAB_U_VOLT1000000_S2_S3 "int = ((phys * 1.0E6) / 1) - (0) V" RAT_FUNC "%7.6" "V" COEFFS 0 1000000 0 0 0 1 /end COMPU_METHOD
/begin COMPU_METHOD SAB_U_VOLT1000_S2_S3 "int = ((phys * 1000) / 1) - (0) V" RAT_FUNC "%4.3" "V" COEFFS 0 1000 0 0 0 1 /end COMPU_METHOD
/begin COMPU_METHOD SAB_U_VOLT10_S2_S3 "int = ((phys * 10) / 1) - (0) Volt" RAT_FUNC "%4.3" "Volt" COEFFS 0 10 0 0 0 1 /end COMPU_METHOD
/begin COMPU_METHOD SAB_U_VOLT40_S2_S3 "int = ((phys * 40) / 1) - (0) Volt" RAT_FUNC "%4.3" "Volt" COEFFS 0 40 0 0 0 1 /end COMPU_METHOD
/begin COMPU_METHOD SAB_U_VOLT4_S2_S3 "int = ((phys * 4) / 1) - (0) Volt" RAT_FUNC "%4.3" "Volt" COEFFS 0 4 0 0 0 1 /end COMPU_METHOD
/begin COMPU_METHOD SAB_V_10KMH_S2_S3 "int = ((phys * 1) / 10) - (0) km/h" RAT_FUNC "%4.3" "km/h" COEFFS 0 0.1 0 0 0 1 /end COMPU_METHOD
/begin COMPU_METHOD SAB_V_32KMH100_S2_S3 "int = ((phys * 100) / 32) - (0) km/h" RAT_FUNC "%4.3" "km/h" COEFFS 0 3.125 0 0 0 1 /end COMPU_METHOD
/begin COMPU_METHOD SAB_V_32KMH25_S2_S3 "int = ((phys * 25) / 32) - (0) km/h" RAT_FUNC "%4.3" "km/h" COEFFS 0 0.78125 0 0 0 1 /end COMPU_METHOD
/begin COMPU_METHOD SAB_V_5KMH10_S2_S3 "int = ((phys * 10) / 5) - (0) km/h" RAT_FUNC "%4.3" "km/h" COEFFS 0 2 0 0 0 1 /end COMPU_METHOD
/begin COMPU_METHOD SAB_V_KMH100_S2_S3 "int = ((phys * 100) / 1) - (0) km/h" RAT_FUNC "%4.3" "km/h" COEFFS 0 100 0 0 0 1 /end COMPU_METHOD
/begin COMPU_METHOD SAB_V_KMH128_S2_S3 "int = ((phys * 128) / 1) - (0) km/h" RAT_FUNC "%4.3" "km/h" COEFFS 0 128 0 0 0 1 /end COMPU_METHOD
/begin COMPU_METHOD SAB_V_KMH16_M125_S2_S3 "int = ((phys * 16) / 1) - (-125) km/h" RAT_FUNC "%4.3" "km/h" COEFFS 0 16 125 0 0 1 /end COMPU_METHOD
/begin COMPU_METHOD SAB_V_KMH256_S2_S3 "int = ((phys * 256) / 1) - (0) km/h" RAT_FUNC "%4.3" "km/h" COEFFS 0 256 0 0 0 1 /end COMPU_METHOD
/begin COMPU_METHOD SAB_V_KMH2_S2_S3 "int = ((phys * 2) / 1) - (0) km/h" RAT_FUNC "%4.3" "km/h" COEFFS 0 2 0 0 0 1 /end COMPU_METHOD
/begin COMPU_METHOD SAB_V_KMH50_S2_S3 "int = ((phys * 50) / 1) - (0) km/h" RAT_FUNC "%4.3" "km/h" COEFFS 0 50 0 0 0 1 /end COMPU_METHOD
/begin COMPU_METHOD SAB_V_KMH_M40_S2_S3 "int = ((phys * 1) / 1) - (-40) km/h" RAT_FUNC "%1.0" "km/h" COEFFS 0 1 40 0 0 1 /end COMPU_METHOD
/begin COMPU_METHOD SAB_V_KMH_S2_S3 "int = ((phys * 1) / 1) - (0) km/h" RAT_FUNC "%1.0" "km/h" COEFFS 0 1 0 0 0 1 /end COMPU_METHOD
/begin COMPU_METHOD SAB_VG_KMH100_S2_S3 "int = ((phys * 100) / 1) - (0) km/h/Task" RAT_FUNC "%4.3" "km/h/Task" COEFFS 0 100 0 0 0 1 /end COMPU_METHOD
/begin COMPU_METHOD SAB_VOLT20_M5_S2_S3 "int = ((phys * 20) / 1) - (100) Volt" RAT_FUNC "%4.3" "Volt" COEFFS 0 20 -100 0 0 1 /end COMPU_METHOD
/begin COMPU_METHOD SAB_Z_1DIGIT8_S2_S3 "int = ((phys * 8) / 1) - (0) Digit" RAT_FUNC "%4.3" "Digit" COEFFS 0 8 0 0 0 1 /end COMPU_METHOD
/begin COMPU_METHOD SAB_Z_1DIGIT_S2_S3 "int = ((phys * 1) / 1) - (0) Digit" RAT_FUNC "%1.0" "Digit" COEFFS 0 1 0 0 0 1 /end COMPU_METHOD
/begin COMPU_METHOD SBW_A_CAN_S1_S3 "int = ((phys * 32) / 1) - (0) m/s^2" RAT_FUNC "%3.2" "m/s^2" COEFFS 0 32 0 0 0 1 /end COMPU_METHOD
/begin MEASUREMENT ZFFSAB._.EngineSpeedRedIn.f_n_EngMaxRedErr "Error flag of reduction engine rpm" UBYTE SAB_STANDARD_S2_S3 1 100 0 1 ECU_ADDRESS 0xFFF8DD0C DISPLAY_IDENTIFIER f_n_EngMaxRedErr.EngineSpeedRedIn._.ZFFSAB /end MEASUREMENT
/begin MEASUREMENT ZFFSAB._.EngineSpeedRedIn.iv_n_EngMaxAlw "Input value of maximum allowed rpm of the engine from CAN" UBYTE SAB_N_50RPM_S2_S3 1 100 0 12750 ECU_ADDRESS 0xFFF8DD04 DISPLAY_IDENTIFIER iv_n_EngMaxAlw.EngineSpeedRedIn._.ZFFSAB /end MEASUREMENT
/begin MEASUREMENT ZFFSAB._.EngineSpeedRedIn.iv_n_EngMaxAlw_ "Complementary input value of maximum allowed rpm of the engine from CAN" UBYTE SAB_STANDARD_S2_S3 1 100 0 255 ECU_ADDRESS 0xFFF8DD05 DISPLAY_IDENTIFIER iv_n_EngMaxAlw_.EngineSpeedRedIn._.ZFFSAB /end MEASUREMENT
/begin MEASUREMENT ZFFSAB._.EngineSpeedRedIn.iv_n_EngMaxRed "Input value reduction of rpm maximum from CAN" UBYTE SAB_STANDARD_S2_S3 1 100 0 3 ECU_ADDRESS 0xFFF8DD00 DISPLAY_IDENTIFIER iv_n_EngMaxRed.EngineSpeedRedIn._.ZFFSAB /end MEASUREMENT
/begin MEASUREMENT ZFFSAB._.EngineSpeedRedIn.iv_n_EngMaxRedSts "Input value of message status of reduction of rpm maximum" UBYTE SAB_STANDARD_S2_S3 1 100 0 255 ECU_ADDRESS 0xFFF8DD02 DISPLAY_IDENTIFIER iv_n_EngMaxRedSts.EngineSpeedRedIn._.ZFFSAB /end MEASUREMENT
/begin MEASUREMENT ZFFSAB._.EngineSpeedRedIn.iv_n_EngMaxRedSts_ "Input value of message status of reduction of rpm maximum" UBYTE SAB_STANDARD_S2_S3 1 100 0 255 ECU_ADDRESS 0xFFF8DD03 DISPLAY_IDENTIFIER iv_n_EngMaxRedSts_.EngineSpeedRedIn._.ZFFSAB /end MEASUREMENT
/begin MEASUREMENT ZFFSAB._.EngineSpeedRedIn.iv_n_EngMaxRed_ "Input value of complement of reduction of rpm maximum from CAN" UBYTE SAB_STANDARD_S2_S3 1 100 0 255 ECU_ADDRESS 0xFFF8DD01 DISPLAY_IDENTIFIER iv_n_EngMaxRed_.EngineSpeedRedIn._.ZFFSAB /end MEASUREMENT
/begin MEASUREMENT ZFFSAB._.EngineSpeedRedIn.sv_n_EngMaxRed "Output value reduction rpm" UBYTE SAB_STANDARD_S2_S3 1 100 0 2 ECU_ADDRESS 0xFFF8DD06 DISPLAY_IDENTIFIER sv_n_EngMaxRed.EngineSpeedRedIn._.ZFFSAB /end MEASUREMENT
/begin MEASUREMENT ZFFSAB._.EngineSpeedRedIn.sv_n_EngMaxRedSts "Output value signal status of reduction rpm" UBYTE SAB_STANDARD_S2_S3 1 100 0 2 ECU_ADDRESS 0xFFF8DD07 DISPLAY_IDENTIFIER sv_n_EngMaxRedSts.EngineSpeedRedIn._.ZFFSAB /end MEASUREMENT
/begin MEASUREMENT ZFFSAB._.EngineSpeedRedIn.sv_n_EngRed "Output value threshold reduction engine rpm" UWORD SAB_N_1RPM_S2_S3 1 100 0 10000 ECU_ADDRESS 0xFFF8DD08 DISPLAY_IDENTIFIER sv_n_EngRed.EngineSpeedRedIn._.ZFFSAB /end MEASUREMENT
/begin MEASUREMENT ZFFSAB._.EngineSpeedRedIn.sv_n_EngRed_ "Output value threshold reduction engine rpm complement" UWORD SAB_STANDARD_S2_S3 1 100 0 65535 ECU_ADDRESS 0xFFF8DD0A DISPLAY_IDENTIFIER sv_n_EngRed_.EngineSpeedRedIn._.ZFFSAB /end MEASUREMENT
/begin MEASUREMENT ZFFSAB._.EngineTorqueIn.EngineTorqueInFl.f_m_EngErr "Error flag" FLOAT32_IEEE SAB_STANDARD_S2_S3 1 100 0 1 ECU_ADDRESS 0xFFF8DD50 FORMAT "%4.3" DISPLAY_IDENTIFIER f_m_EngErr.EngineTorqueInFl.EngineTorqueIn._.ZFFSAB /end MEASUREMENT
/begin MEASUREMENT ZFFSAB._.EngineTorqueIn.EngineTorqueInFl.iv_m_Eng "Input value for crankshaft torque" FLOAT32_IEEE SAB_M_NM2_M2047_S2_S3 1 100 -2047.5 0.5 ECU_ADDRESS 0xFFF8DD48 DISPLAY_IDENTIFIER iv_m_Eng.EngineTorqueInFl.EngineTorqueIn._.ZFFSAB /end MEASUREMENT
/begin MEASUREMENT ZFFSAB._.EngineTorqueIn.EngineTorqueInFl.iv_m_EngSts "Input value for message status" FLOAT32_IEEE SAB_STANDARD_S2_S3 1 100 0 255 ECU_ADDRESS 0xFFF8DD44 FORMAT "%4.3" DISPLAY_IDENTIFIER iv_m_EngSts.EngineTorqueInFl.EngineTorqueIn._.ZFFSAB /end MEASUREMENT
/begin MEASUREMENT ZFFSAB._.EngineTorqueIn.EngineTorqueInFl.iv_m_Eng_ "Input value for crankshaft torque" FLOAT32_IEEE SAB_STANDARD_S2_S3 1 100 -2048 2048 ECU_ADDRESS 0xFFF8DD4C FORMAT "%4.3" DISPLAY_IDENTIFIER iv_m_Eng_.EngineTorqueInFl.EngineTorqueIn._.ZFFSAB /end MEASUREMENT
/begin MEASUREMENT ZFFSAB._.EngineTorqueIn.EngineTorqueInFl.m_EngCor "Intermediate value for engine torque with quantisation 1Nm/Bit" FLOAT32_IEEE SAB_M_1NM_S2_S3 1 100 -2048 2047.875 ECU_ADDRESS 0xFFF8DD60 FORMAT "%4.3" DISPLAY_IDENTIFIER m_EngCor.EngineTorqueInFl.EngineTorqueIn._.ZFFSAB /end MEASUREMENT
/begin MEASUREMENT ZFFSAB._.EngineTorqueIn.EngineTorqueInFl.sv_m_EngLev2 "Output value for engine torque" FLOAT32_IEEE SAB_M_1NM_S2_S3 1 100 -2048 2047 ECU_ADDRESS 0xFFF8DD58 FORMAT "%4.3" DISPLAY_IDENTIFIER sv_m_EngLev2.EngineTorqueInFl.EngineTorqueIn._.ZFFSAB /end MEASUREMENT
/begin MEASUREMENT ZFFSAB._.EngineTorqueIn.EngineTorqueInFl.sv_m_EngLev2_ "Output value for engine torque" FLOAT32_IEEE SAB_STANDARD_S2_S3 1 100 -2048 2047 ECU_ADDRESS 0xFFF8DD5C FORMAT "%4.3" DISPLAY_IDENTIFIER sv_m_EngLev2_.EngineTorqueInFl.EngineTorqueIn._.ZFFSAB /end MEASUREMENT
/begin MEASUREMENT ZFFSAB._.EngineTorqueIn.EngineTorqueInFl.sv_m_EngSts "Output value signal status for GET_M_MOT_STATUS" FLOAT32_IEEE SAB_STANDARD_S2_S3 1 100 0 2 ECU_ADDRESS 0xFFF8DD54 FORMAT "%4.3" DISPLAY_IDENTIFIER sv_m_EngSts.EngineTorqueInFl.EngineTorqueIn._.ZFFSAB /end MEASUREMENT
/begin MEASUREMENT ZFFSAB._.EngineTorqueIn.f_m_EngErr "!!!NO DESCRIPTION AVAILABLE!!!" UBYTE SAB_STANDARD_S2_S3 1 100 0 1 ECU_ADDRESS 0xFFF8DD79 DISPLAY_IDENTIFIER f_m_EngErr.EngineTorqueIn._.ZFFSAB /end MEASUREMENT
/begin MEASUREMENT ZFFSAB._.EngineTorqueIn.iv_m_Eng "Input value for crankshaft torque" UWORD SAB_M_NM2_M2047_S2_S3 1 100 -1023.5 1023.5 ECU_ADDRESS 0xFFF8DD68 DISPLAY_IDENTIFIER iv_m_Eng.EngineTorqueIn._.ZFFSAB /end MEASUREMENT
/begin MEASUREMENT ZFFSAB._.EngineTorqueIn.iv_m_EngSts "Input value for message status" UBYTE SAB_STANDARD_S2_S3 1 100 0 255 ECU_ADDRESS 0xFFF8DD6A DISPLAY_IDENTIFIER iv_m_EngSts.EngineTorqueIn._.ZFFSAB /end MEASUREMENT
/begin MEASUREMENT ZFFSAB._.EngineTorqueIn.iv_m_EngSts_ "Input value for message status" UBYTE SAB_STANDARD_S2_S3 1 100 0 255 ECU_ADDRESS 0xFFF8DD6B DISPLAY_IDENTIFIER iv_m_EngSts_.EngineTorqueIn._.ZFFSAB /end MEASUREMENT
/begin MEASUREMENT ZFFSAB._.EngineTorqueIn.iv_m_Eng_ "Input value for crankshaft torque" UWORD SAB_M_NM2_M2047_S2_S3 1 100 -1023.5 1023.5 ECU_ADDRESS 0xFFF8DD6E DISPLAY_IDENTIFIER iv_m_Eng_.EngineTorqueIn._.ZFFSAB /end MEASUREMENT
/begin MEASUREMENT ZFFSAB._.EngineTorqueIn.iv_m_K0AktModified "Input value for K0 max torque" SWORD SAB_M_1NM_S2_S3 1 100 -1000 1000 ECU_ADDRESS 0xFFF8DD70 DISPLAY_IDENTIFIER iv_m_K0AktModified.EngineTorqueIn._.ZFFSAB /end MEASUREMENT
/begin MEASUREMENT ZFFSAB._.EngineTorqueIn.iv_m_PumpCensored "Input value of pump intake torque with coefficient from class PumpIntakeTorqueOut" SWORD SAB_M_1NM_S2_S3 1 100 -32768 32767 ECU_ADDRESS 0xFFF8DD6C DISPLAY_IDENTIFIER iv_m_PumpCensored.EngineTorqueIn._.ZFFSAB /end MEASUREMENT
/begin MEASUREMENT ZFFSAB._.EngineTorqueIn.m_EngCor "Intermediate value for engine torque with quantisation 1Nm/Bit" SWORD SAB_M_1NM_S2_S3 1 100 -2048 2047.875 ECU_ADDRESS 0xFFF8DD80 DISPLAY_IDENTIFIER m_EngCor.EngineTorqueIn._.ZFFSAB /end MEASUREMENT
/begin MEASUREMENT ZFFSAB._.EngineTorqueIn.m_EngCor2 "Intermediate value for engine torque with quantisation 1Nm/Bit" SWORD SAB_M_1NM_S2_S3 1 100 -2048 2047 ECU_ADDRESS 0xFFF8DD84 DISPLAY_IDENTIFIER m_EngCor2.EngineTorqueIn._.ZFFSAB /end MEASUREMENT
/begin MEASUREMENT ZFFSAB._.EngineTorqueIn.m_EngCor2Sts "Intermediate value signal status" UBYTE SAB_STANDARD_S2_S3 1 100 0 2 ECU_ADDRESS 0xFFF8DD86 DISPLAY_IDENTIFIER m_EngCor2Sts.EngineTorqueIn._.ZFFSAB /end MEASUREMENT
/begin MEASUREMENT ZFFSAB._.EngineTorqueIn.m_EngCorSts "Intermediate value signal status Level 2" UBYTE SAB_STANDARD_S2_S3 1 100 0 2 ECU_ADDRESS 0xFFF8DD82 DISPLAY_IDENTIFIER m_EngCorSts.EngineTorqueIn._.ZFFSAB /end MEASUREMENT
/begin MEASUREMENT ZFFSAB._.EngineTorqueIn.m_EngCorSts_ "Complement of Intermediate value signal status Level 2" UBYTE SAB_STANDARD_S2_S3 1 100 0 2 ECU_ADDRESS 0xFFF8DD83 DISPLAY_IDENTIFIER m_EngCorSts_.EngineTorqueIn._.ZFFSAB /end MEASUREMENT
/begin MEASUREMENT ZFFSAB._.EngineTorqueIn.sv_AGS_MMot "Output value for engine torque" SWORD SAB_M_1NM_S2_S3 1 100 -8192 8192 ECU_ADDRESS 0xFFF8DD74 DISPLAY_IDENTIFIER sv_AGS_MMot.EngineTorqueIn._.ZFFSAB /end MEASUREMENT
/begin MEASUREMENT ZFFSAB._.EngineTorqueIn.sv_m_Eng "Output value for engine torque" SWORD SAB_M_1NM_S2_S3 1 100 -2048 2047 ECU_ADDRESS 0xFFF8DD72 DISPLAY_IDENTIFIER sv_m_Eng.EngineTorqueIn._.ZFFSAB /end MEASUREMENT
/begin MEASUREMENT ZFFSAB._.EngineTorqueIn.sv_m_EngFilt "Output value for engine torque" SWORD SAB_M_1NM_S2_S3 1 100 -400 1640 ECU_ADDRESS 0xFFF8DD7A DISPLAY_IDENTIFIER sv_m_EngFilt.EngineTorqueIn._.ZFFSAB /end MEASUREMENT
/begin MEASUREMENT ZFFSAB._.EngineTorqueIn.sv_m_EngFiltSts "Output value signal status for engine torque" UBYTE SAB_STANDARD_S2_S3 1 100 0 2 ECU_ADDRESS 0xFFF8DD7C DISPLAY_IDENTIFIER sv_m_EngFiltSts.EngineTorqueIn._.ZFFSAB /end MEASUREMENT
/begin MEASUREMENT ZFFSAB._.EngineTorqueIn.sv_m_EngLev2 "Output value for engine torque" SWORD SAB_M_1NM_S2_S3 1 100 -2048 2047 ECU_ADDRESS 0xFFF8DD76 DISPLAY_IDENTIFIER sv_m_EngLev2.EngineTorqueIn._.ZFFSAB /end MEASUREMENT
/begin MEASUREMENT ZFFSAB._.EngineTorqueIn.sv_m_EngLev2_ "Output value for engine torque (complement)" SWORD SAB_STANDARD_S2_S3 1 100 -32768 32767 ECU_ADDRESS 0xFFF8DD7E DISPLAY_IDENTIFIER sv_m_EngLev2_.EngineTorqueIn._.ZFFSAB /end MEASUREMENT
/begin MEASUREMENT ZFFSAB._.EngineTorqueIn.sv_m_EngSts "Output value signal status for GET_M_MOT_STATUS" UBYTE SAB_STANDARD_S2_S3 1 100 0 2 ECU_ADDRESS 0xFFF8DD78 DISPLAY_IDENTIFIER sv_m_EngSts.EngineTorqueIn._.ZFFSAB /end MEASUREMENT
/begin MEASUREMENT ZFFSAB._.EstVehicleWeightIn.f_MassFzgEstErr "Error flag of estimated vehicle weight signal" UBYTE SAB_STANDARD_S2_S3 1 100 0 1 ECU_ADDRESS 0xFFF95F03 DISPLAY_IDENTIFIER f_MassFzgEstErr.EstVehicleWeightIn._.ZFFSAB /end MEASUREMENT
/begin MEASUREMENT ZFFSAB._.EstVehicleWeightIn.iv_MassFzgEst "Input raw signal for estimated vehicle weight" UWORD SAB_M_20KG_S2_S3 1 100 0 8180 ECU_ADDRESS 0xFFF95EFC DISPLAY_IDENTIFIER iv_MassFzgEst.EstVehicleWeightIn._.ZFFSAB /end MEASUREMENT
/begin MEASUREMENT ZFFSAB._.EstVehicleWeightIn.iv_MassFzgEstErr "Qualifier signal for estimated vehicle weight signal" UBYTE SAB_STANDARD_S2_S3 1 100 0 255 ECU_ADDRESS 0xFFF95EFE DISPLAY_IDENTIFIER iv_MassFzgEstErr.EstVehicleWeightIn._.ZFFSAB /end MEASUREMENT
/begin MEASUREMENT ZFFSAB._.EstVehicleWeightIn.iv_MassFzgEstSts "Input signal message status of estimated vehicle weight" UBYTE SAB_STANDARD_S2_S3 1 100 0 255 ECU_ADDRESS 0xFFF95EFF DISPLAY_IDENTIFIER iv_MassFzgEstSts.EstVehicleWeightIn._.ZFFSAB /end MEASUREMENT
/begin MEASUREMENT ZFFSAB._.EstVehicleWeightIn.sv_MassFzgEst "Output signal of estimated vehicle weight" UWORD SAB_M_20KG_S2_S3 1 100 0 81900 ECU_ADDRESS 0xFFF95F00 DISPLAY_IDENTIFIER sv_MassFzgEst.EstVehicleWeightIn._.ZFFSAB /end MEASUREMENT
/begin MEASUREMENT ZFFSAB._.EstVehicleWeightIn.sv_MassFzgEstSts "Output status signal of estimated vehicle weight" UBYTE SAB_STANDARD_S2_S3 1 100 0 2 ECU_ADDRESS 0xFFF95F02 DISPLAY_IDENTIFIER sv_MassFzgEstSts.EstVehicleWeightIn._.ZFFSAB /end MEASUREMENT
/begin MEASUREMENT ZFFSAB._.ExtBrakeInterventionIn.BrakeTorq "calculated value of BrakeTorq" UWORD SAB_STANDARD_S2_S3 1 100 0 1 ECU_ADDRESS 0xFFF95B36 DISPLAY_IDENTIFIER BrakeTorq.ExtBrakeInterventionIn._.ZFFSAB /end MEASUREMENT
/begin MEASUREMENT ZFFSAB._.ExtBrakeInterventionIn.BrakeTorqDvch "calculated value of BrakeTorqDvch" UWORD SAB_STANDARD_S2_S3 1 100 0 1 ECU_ADDRESS 0xFFF95B3A DISPLAY_IDENTIFIER BrakeTorqDvch.ExtBrakeInterventionIn._.ZFFSAB /end MEASUREMENT
/begin MEASUREMENT ZFFSAB._.ExtBrakeInterventionIn.BrakeTorqDvchSts "Status of BrakeDvch-signal" UBYTE SAB_STANDARD_S2_S3 1 100 0 1 ECU_ADDRESS 0xFFF95B3C DISPLAY_IDENTIFIER BrakeTorqDvchSts.ExtBrakeInterventionIn._.ZFFSAB /end MEASUREMENT
/begin MEASUREMENT ZFFSAB._.ExtBrakeInterventionIn.BrakeTorqSts "Status of Brake-signal" UBYTE SAB_STANDARD_S2_S3 1 100 0 1 ECU_ADDRESS 0xFFF95B38 DISPLAY_IDENTIFIER BrakeTorqSts.ExtBrakeInterventionIn._.ZFFSAB /end MEASUREMENT
/begin MEASUREMENT ZFFSAB._.ExtBrakeInterventionIn.StBrake "calculated value of StBrake" UBYTE SAB_STANDARD_S2_S3 1 100 0 1 ECU_ADDRESS 0xFFF95B3E DISPLAY_IDENTIFIER StBrake.ExtBrakeInterventionIn._.ZFFSAB /end MEASUREMENT
/begin MEASUREMENT ZFFSAB._.ExtBrakeInterventionIn.StBrakeSts "Status of StBrake-signal" UBYTE SAB_STANDARD_S2_S3 1 100 0 1 ECU_ADDRESS 0xFFF95B3F DISPLAY_IDENTIFIER StBrakeSts.ExtBrakeInterventionIn._.ZFFSAB /end MEASUREMENT
/begin MEASUREMENT ZFFSAB._.ExtBrakeInterventionIn.f_BrakeTorq "Error flag of Brake-signal" UBYTE SAB_STANDARD_S2_S3 1 100 0 1 ECU_ADDRESS 0xFFF95B39 DISPLAY_IDENTIFIER f_BrakeTorq.ExtBrakeInterventionIn._.ZFFSAB /end MEASUREMENT
/begin MEASUREMENT ZFFSAB._.ExtBrakeInterventionIn.f_BrakeTorqDvch "Error flag of BrakeDvch-signal" UBYTE SAB_STANDARD_S2_S3 1 100 0 1 ECU_ADDRESS 0xFFF95B3D DISPLAY_IDENTIFIER f_BrakeTorqDvch.ExtBrakeInterventionIn._.ZFFSAB /end MEASUREMENT
/begin MEASUREMENT ZFFSAB._.ExtBrakeInterventionIn.f_StBrake "Error flag of StBrake-signal" UBYTE SAB_STANDARD_S2_S3 1 100 0 1 ECU_ADDRESS 0xFFF95B40 DISPLAY_IDENTIFIER f_StBrake.ExtBrakeInterventionIn._.ZFFSAB /end MEASUREMENT
/begin MEASUREMENT ZFFSAB._.ExtBrakeInterventionIn.iv_BrakeTorq "input value iv_BrakeTorq" UWORD SAB_M_1NM_M32000_S2_S3 1 100 -32000 33535 ECU_ADDRESS 0xFFF95B28 DISPLAY_IDENTIFIER iv_BrakeTorq.ExtBrakeInterventionIn._.ZFFSAB /end MEASUREMENT
/begin MEASUREMENT ZFFSAB._.ExtBrakeInterventionIn.iv_BrakeTorqDvch "input value iv_BrakeTorqDvch" UWORD SAB_M_1NM_M32000_S2_S3 1 100 -32000 33535 ECU_ADDRESS 0xFFF95B2C DISPLAY_IDENTIFIER iv_BrakeTorqDvch.ExtBrakeInterventionIn._.ZFFSAB /end MEASUREMENT
/begin MEASUREMENT ZFFSAB._.ExtBrakeInterventionIn.iv_BrakeTorqDvchSts "input value iv_BrakeTorqDvchSts" UBYTE SAB_STANDARD_S2_S3 1 100 0 255 ECU_ADDRESS 0xFFF95B2E DISPLAY_IDENTIFIER iv_BrakeTorqDvchSts.ExtBrakeInterventionIn._.ZFFSAB /end MEASUREMENT
/begin MEASUREMENT ZFFSAB._.ExtBrakeInterventionIn.iv_BrakeTorqSts "input value iv_BrakeTorqSts" UBYTE SAB_STANDARD_S2_S3 1 100 0 255 ECU_ADDRESS 0xFFF95B2A DISPLAY_IDENTIFIER iv_BrakeTorqSts.ExtBrakeInterventionIn._.ZFFSAB /end MEASUREMENT
/begin MEASUREMENT ZFFSAB._.ExtBrakeInterventionIn.iv_StBrake "input value iv_StBrake" UBYTE SAB_STANDARD_S2_S3 1 100 0 255 ECU_ADDRESS 0xFFF95B30 DISPLAY_IDENTIFIER iv_StBrake.ExtBrakeInterventionIn._.ZFFSAB /end MEASUREMENT
/begin MEASUREMENT ZFFSAB._.ExtBrakeInterventionIn.iv_StBrakeSts "input value iv_StBrakeSts" UBYTE SAB_STANDARD_S2_S3 1 100 0 255 ECU_ADDRESS 0xFFF95B31 DISPLAY_IDENTIFIER iv_StBrakeSts.ExtBrakeInterventionIn._.ZFFSAB /end MEASUREMENT
/begin MEASUREMENT ZFFSAB._.ExtBrakeInterventionIn.iv_StBrakeTorq "input value iv_StBrake" UBYTE SAB_STANDARD_S2_S3 1 100 0 255 ECU_ADDRESS 0xFFF95B2F DISPLAY_IDENTIFIER iv_StBrakeTorq.ExtBrakeInterventionIn._.ZFFSAB /end MEASUREMENT
/begin MEASUREMENT ZFFSAB._.ExtBrakeInterventionIn.sv_AGS_MBrSoll "Output signal of Externer Bremseingriff" UWORD SAB_M_1NM_M32000_S2_S3 1 100 -32000 0 ECU_ADDRESS 0xFFF95B34 DISPLAY_IDENTIFIER sv_AGS_MBrSoll.ExtBrakeInterventionIn._.ZFFSAB /end MEASUREMENT
/begin MEASUREMENT ZFFSAB._.ExtBrakeInterventionIn.sv_ExtBrakeInterventionSts "Output value signal status of external brake interventeion" UBYTE SAB_STANDARD_S2_S3 1 100 0 2 ECU_ADDRESS 0xFFF95B32 DISPLAY_IDENTIFIER sv_ExtBrakeInterventionSts.ExtBrakeInterventionIn._.ZFFSAB /end MEASUREMENT
/begin MEASUREMENT ZFFSAB._.ExtBrakeInterventionIn.sv_f_ExtBrakeIntervention "Output variable for GET_BRAKE_INTER" UBYTE SAB_STANDARD_S2_S3 1 100 0 1 ECU_ADDRESS 0xFFF95B33 DISPLAY_IDENTIFIER sv_f_ExtBrakeIntervention.ExtBrakeInterventionIn._.ZFFSAB /end MEASUREMENT
/begin MEASUREMENT ZFFSAB._.FlagKickDownIn.f_KickdownErr "Error flag of Kickdown-signal" UBYTE SAB_STANDARD_S2_S3 1 100 0 1 ECU_ADDRESS 0xFFF96E61 DISPLAY_IDENTIFIER f_KickdownErr.FlagKickDownIn._.ZFFSAB /end MEASUREMENT
/begin MEASUREMENT ZFFSAB._.FlagKickDownIn.iv_Kickdown "Input value kickdown flag from CAN" UWORD SAB_0025PROZENT_S2_S3 1 100 0 102.375 ECU_ADDRESS 0xFFF96E5C DISPLAY_IDENTIFIER iv_Kickdown.FlagKickDownIn._.ZFFSAB /end MEASUREMENT
/begin MEASUREMENT ZFFSAB._.FlagKickDownIn.iv_KickdownSts "Input value message status of kickdown flag" UBYTE SAB_STANDARD_S2_S3 1 100 0 255 ECU_ADDRESS 0xFFF96E5E DISPLAY_IDENTIFIER iv_KickdownSts.FlagKickDownIn._.ZFFSAB /end MEASUREMENT
/begin MEASUREMENT ZFFSAB._.FlagKickDownIn.sv_KickdownSts "Output value signal status of kickdown flag" UBYTE SAB_STANDARD_S2_S3 1 100 0 2 ECU_ADDRESS 0xFFF96E60 DISPLAY_IDENTIFIER sv_KickdownSts.FlagKickDownIn._.ZFFSAB /end MEASUREMENT
/begin MEASUREMENT ZFFSAB._.FlagKickDownIn.sv_f_Kickdown "Output value kickdown flag" UBYTE SAB_STANDARD_S2_S3 1 100 0 1 ECU_ADDRESS 0xFFF96E5F DISPLAY_IDENTIFIER sv_f_Kickdown.FlagKickDownIn._.ZFFSAB /end MEASUREMENT
/begin MEASUREMENT ZFFSAB._.FlagTrailerInfoIn.iv_TrailerInfo "Input value trailer active from CAN" UBYTE SAB_STANDARD_S2_S3 1 100 0 3 ECU_ADDRESS 0xFFF95988 DISPLAY_IDENTIFIER iv_TrailerInfo.FlagTrailerInfoIn._.ZFFSAB /end MEASUREMENT
/begin MEASUREMENT ZFFSAB._.FlagTrailerInfoIn.iv_TrailerInfoSts "Input value message status of trailer active" UBYTE SAB_STANDARD_S2_S3 1 100 0 255 ECU_ADDRESS 0xFFF95989 DISPLAY_IDENTIFIER iv_TrailerInfoSts.FlagTrailerInfoIn._.ZFFSAB /end MEASUREMENT
/begin MEASUREMENT ZFFSAB._.FlagTrailerInfoIn.sv_TrailerInfoSts "Intermediate value message status of trailer active" UBYTE SAB_STANDARD_S2_S3 1 100 0 2 ECU_ADDRESS 0xFFF9598B DISPLAY_IDENTIFIER sv_TrailerInfoSts.FlagTrailerInfoIn._.ZFFSAB /end MEASUREMENT
/begin MEASUREMENT ZFFSAB._.FlagTrailerInfoIn.sv_f_TrailerInfo "Intermediate value trailer active" UBYTE SAB_STANDARD_S2_S3 1 100 0 1 ECU_ADDRESS 0xFFF9598A DISPLAY_IDENTIFIER sv_f_TrailerInfo.FlagTrailerInfoIn._.ZFFSAB /end MEASUREMENT
/begin MEASUREMENT ZFFSAB._.FpDkVpIn.f_ThrottlePositionErr "Error flag for error status" UBYTE SAB_STANDARD_S2_S3 1 100 0 1 ECU_ADDRESS 0xFFF8DB1D DISPLAY_IDENTIFIER f_ThrottlePositionErr.FpDkVpIn._.ZFFSAB /end MEASUREMENT
/begin MEASUREMENT ZFFSAB._.FpDkVpIn.f_ThrottlePositionVirtErr "Errorflag set by detecting an errorvalue of the incoming signal and a valid signal-status at the the same time" UBYTE SAB_STANDARD_S2_S3 1 100 0 2 ECU_ADDRESS 0xFFF8DB1E DISPLAY_IDENTIFIER f_ThrottlePositionVirtErr.FpDkVpIn._.ZFFSAB /end MEASUREMENT
/begin MEASUREMENT ZFFSAB._.FpDkVpIn.iv_ThrottlePosition "Input value from the CAN-Bus" UWORD SAB_0025PROZENT_S2_S3 1 100 0 102.375 ECU_ADDRESS 0xFFF8DB08 DISPLAY_IDENTIFIER iv_ThrottlePosition.FpDkVpIn._.ZFFSAB /end MEASUREMENT
/begin MEASUREMENT ZFFSAB._.FpDkVpIn.iv_ThrottlePositionErr "seperate throttle position fault flag on CAN" UBYTE SAB_STANDARD_S2_S3 1 100 0 15 ECU_ADDRESS 0xFFF8DB0C DISPLAY_IDENTIFIER iv_ThrottlePositionErr.FpDkVpIn._.ZFFSAB /end MEASUREMENT
/begin MEASUREMENT ZFFSAB._.FpDkVpIn.iv_ThrottlePositionErr_ "complement of seperate throttle position fault flag on CAN" UBYTE SAB_STANDARD_S2_S3 1 100 0 255 ECU_ADDRESS 0xFFF8DB0D DISPLAY_IDENTIFIER iv_ThrottlePositionErr_.FpDkVpIn._.ZFFSAB /end MEASUREMENT
/begin MEASUREMENT ZFFSAB._.FpDkVpIn.iv_ThrottlePositionSts "Input value from the CAN-Bus" UBYTE SAB_STANDARD_S2_S3 1 100 0 255 ECU_ADDRESS 0xFFF8DB0E DISPLAY_IDENTIFIER iv_ThrottlePositionSts.FpDkVpIn._.ZFFSAB /end MEASUREMENT
/begin MEASUREMENT ZFFSAB._.FpDkVpIn.iv_ThrottlePositionSts_ "Input value of complementary signal status from the CAN-Bus" UBYTE SAB_STANDARD_S2_S3 1 100 0 255 ECU_ADDRESS 0xFFF8DB0F DISPLAY_IDENTIFIER iv_ThrottlePositionSts_.FpDkVpIn._.ZFFSAB /end MEASUREMENT
/begin MEASUREMENT ZFFSAB._.FpDkVpIn.iv_ThrottlePositionVirt "The inputsignal which transport the calculated throttleposition based on the actual drivingspeedsettings of CAN2. Are there no FAS_interventions ThrottlePositionVirt equals ThrottlePosition" UWORD SAB_0025PROZENT_S2_S3 1 100 0 102.375 ECU_ADDRESS 0xFFF8DB10 DISPLAY_IDENTIFIER iv_ThrottlePositionVirt.FpDkVpIn._.ZFFSAB /end MEASUREMENT
/begin MEASUREMENT ZFFSAB._.FpDkVpIn.iv_ThrottlePositionVirtSts "The inputsignal status of iv_ThrottlePositionVirt" UBYTE SAB_STANDARD_S2_S3 1 100 0 2 ECU_ADDRESS 0xFFF8DB12 DISPLAY_IDENTIFIER iv_ThrottlePositionVirtSts.FpDkVpIn._.ZFFSAB /end MEASUREMENT
/begin MEASUREMENT ZFFSAB._.FpDkVpIn.iv_ThrottlePosition_ "Input value from the CAN-Bus(Complement)" UWORD SAB_STANDARD_S2_S3 1 100 0 255 ECU_ADDRESS 0xFFF8DB0A DISPLAY_IDENTIFIER iv_ThrottlePosition_.FpDkVpIn._.ZFFSAB /end MEASUREMENT
/begin MEASUREMENT ZFFSAB._.FpDkVpIn.sv_MaxThrottlePosition "The output-signal which transport the calculated throttleposition based on the values provided from sv_ThrottlePosition or sv_ThrottlePositionVirt" UBYTE SAB_100PROZENT254_S2_S3 1 100 0 100.393700787 ECU_ADDRESS 0xFFF8DB1A DISPLAY_IDENTIFIER sv_MaxThrottlePosition.FpDkVpIn._.ZFFSAB /end MEASUREMENT
/begin MEASUREMENT ZFFSAB._.FpDkVpIn.sv_MaxThrottlePositionSts "The output-signal status of sv_MaxThrottlePositionSts" UBYTE SAB_STANDARD_S2_S3 1 100 0 2 ECU_ADDRESS 0xFFF8DB1B DISPLAY_IDENTIFIER sv_MaxThrottlePositionSts.FpDkVpIn._.ZFFSAB /end MEASUREMENT
/begin MEASUREMENT ZFFSAB._.FpDkVpIn.sv_ThrottlePosition "ThrottlePositionCor2 output value for HPSYS" UBYTE SAB_100PROZENT254_S2_S3 1 100 0 100.393700787 ECU_ADDRESS 0xFFF8DB13 DISPLAY_IDENTIFIER sv_ThrottlePosition.FpDkVpIn._.ZFFSAB /end MEASUREMENT
/begin MEASUREMENT ZFFSAB._.FpDkVpIn.sv_ThrottlePositionLev2 "ThrottlePositionCor2 Level 2 output value for HPSYS" UBYTE SAB_100PROZENT254_S2_S3 1 100 0 100.393700787 ECU_ADDRESS 0xFFF8DB15 DISPLAY_IDENTIFIER sv_ThrottlePositionLev2.FpDkVpIn._.ZFFSAB /end MEASUREMENT
/begin MEASUREMENT ZFFSAB._.FpDkVpIn.sv_ThrottlePositionLev2Sts "ThrottlePositionLev2Sts as output value for HPSYS" UBYTE SAB_STANDARD_S2_S3 1 100 0 2 ECU_ADDRESS 0xFFF8DB17 DISPLAY_IDENTIFIER sv_ThrottlePositionLev2Sts.FpDkVpIn._.ZFFSAB /end MEASUREMENT
/begin MEASUREMENT ZFFSAB._.FpDkVpIn.sv_ThrottlePositionLev2Sts_ "ThrottlePositionLev2Sts as complementary output value for HPSYS" UBYTE SAB_STANDARD_S2_S3 1 100 0 2 ECU_ADDRESS 0xFFF8DB18 DISPLAY_IDENTIFIER sv_ThrottlePositionLev2Sts_.FpDkVpIn._.ZFFSAB /end MEASUREMENT
/begin MEASUREMENT ZFFSAB._.FpDkVpIn.sv_ThrottlePositionLev2_ "ThrottlePositionCor2 Level 2 output value for HPSYS(Complement)" UBYTE SAB_STANDARD_S2_S3 1 100 0 255 ECU_ADDRESS 0xFFF8DB16 DISPLAY_IDENTIFIER sv_ThrottlePositionLev2_.FpDkVpIn._.ZFFSAB /end MEASUREMENT
/begin MEASUREMENT ZFFSAB._.FpDkVpIn.sv_ThrottlePositionSts "ThrottlePositionSts as output value for HPSYS" UBYTE SAB_STANDARD_S2_S3 1 100 0 2 ECU_ADDRESS 0xFFF8DB14 DISPLAY_IDENTIFIER sv_ThrottlePositionSts.FpDkVpIn._.ZFFSAB /end MEASUREMENT
/begin MEASUREMENT ZFFSAB._.FpDkVpIn.sv_ThrottlePositionVirt "The output-signal which transport the calculated throttleposition based on the actual drivingspeedsettings" UBYTE SAB_100PROZENT254_S2_S3 1 100 0 100.393700787 ECU_ADDRESS 0xFFF8DB19 DISPLAY_IDENTIFIER sv_ThrottlePositionVirt.FpDkVpIn._.ZFFSAB /end MEASUREMENT
/begin MEASUREMENT ZFFSAB._.FpDkVpIn.sv_ThrottlePositionVirtSts "The output-signal status of sv_ThrottlePositionVirt" UBYTE SAB_STANDARD_S2_S3 1 100 0 2 ECU_ADDRESS 0xFFF8DB1C DISPLAY_IDENTIFIER sv_ThrottlePositionVirtSts.FpDkVpIn._.ZFFSAB /end MEASUREMENT
/begin MEASUREMENT ZFFSAB._.FrictionIn.f_m_FrictionErr "Error flag for engine friction moment" UBYTE SAB_STANDARD_S2_S3 1 100 0 1 ECU_ADDRESS 0xFFF8DB2A DISPLAY_IDENTIFIER f_m_FrictionErr.FrictionIn._.ZFFSAB /end MEASUREMENT
/begin MEASUREMENT ZFFSAB._.FrictionIn.iv_m_Friction "Input value engine friction moment from CAN" UWORD SAB_M_NM2_M2047_S2_S3 1 100 -1023.5 -512 ECU_ADDRESS 0xFFF8DB20 DISPLAY_IDENTIFIER iv_m_Friction.FrictionIn._.ZFFSAB /end MEASUREMENT
/begin MEASUREMENT ZFFSAB._.FrictionIn.iv_m_FrictionSts "Input value of engine friction moment message status" UBYTE SAB_STANDARD_S2_S3 1 100 0 255 ECU_ADDRESS 0xFFF8DB22 DISPLAY_IDENTIFIER iv_m_FrictionSts.FrictionIn._.ZFFSAB /end MEASUREMENT
/begin MEASUREMENT ZFFSAB._.FrictionIn.m_FrictionCor "Intermediate value converted quantisation of engine friction moment" SWORD SAB_M_1NM_S2_S3 1 100 -1024 1023 ECU_ADDRESS 0xFFF8DB28 DISPLAY_IDENTIFIER m_FrictionCor.FrictionIn._.ZFFSAB /end MEASUREMENT
/begin MEASUREMENT ZFFSAB._.FrictionIn.sv_m_Friction "Output value of engine friction moment" UWORD SAB_M_1NM_S2_S3 1 100 0 1023 ECU_ADDRESS 0xFFF8DB24 DISPLAY_IDENTIFIER sv_m_Friction.FrictionIn._.ZFFSAB /end MEASUREMENT
/begin MEASUREMENT ZFFSAB._.FrictionIn.sv_m_FrictionSts "Output value of engine friction moment signal status" UBYTE SAB_STANDARD_S2_S3 1 100 0 2 ECU_ADDRESS 0xFFF8DB26 DISPLAY_IDENTIFIER sv_m_FrictionSts.FrictionIn._.ZFFSAB /end MEASUREMENT
/begin MEASUREMENT ZFFSAB._.FuelCutoffActiveIn.iv_FuelCutoffActive "Input value for fuel cutoff active message" UBYTE SAB_STANDARD_S2_S3 1 100 0 3 ECU_ADDRESS 0xFFF96CFA DISPLAY_IDENTIFIER iv_FuelCutoffActive.FuelCutoffActiveIn._.ZFFSAB /end MEASUREMENT
/begin MEASUREMENT ZFFSAB._.FuelCutoffActiveIn.iv_FuelCutoffActiveSts "Input value for fuel cutoff active message status" UBYTE SAB_STANDARD_S2_S3 1 100 0 255 ECU_ADDRESS 0xFFF96CFB DISPLAY_IDENTIFIER iv_FuelCutoffActiveSts.FuelCutoffActiveIn._.ZFFSAB /end MEASUREMENT
/begin MEASUREMENT ZFFSAB._.FuelCutoffActiveIn.sv_AGS_StatINFS "Output value for fuel cutoff active signal for LayerAGS" UBYTE SAB_STANDARD_S2_S3 1 100 0 1 ECU_ADDRESS 0xFFF96CFE DISPLAY_IDENTIFIER sv_AGS_StatINFS.FuelCutoffActiveIn._.ZFFSAB /end MEASUREMENT
/begin MEASUREMENT ZFFSAB._.FuelCutoffActiveIn.sv_FuelCutoffActiveSts "Output value for fuel cutoff active message status" UBYTE SAB_STANDARD_S2_S3 1 100 0 2 ECU_ADDRESS 0xFFF96CFD DISPLAY_IDENTIFIER sv_FuelCutoffActiveSts.FuelCutoffActiveIn._.ZFFSAB /end MEASUREMENT
/begin MEASUREMENT ZFFSAB._.FuelCutoffActiveIn.sv_f_FuelCutoffActive "Output value for fuel cutoff active message" UBYTE SAB_STANDARD_S2_S3 1 100 0 1 ECU_ADDRESS 0xFFF96CFC DISPLAY_IDENTIFIER sv_f_FuelCutoffActive.FuelCutoffActiveIn._.ZFFSAB /end MEASUREMENT
/begin MEASUREMENT ZFFSAB._.FullThrottleTorqueIn.f_m_MKWMaxErr "Errorflag of full throttle torque" UBYTE SAB_STANDARD_S2_S3 1 100 0 1 ECU_ADDRESS 0xFFF95933 DISPLAY_IDENTIFIER f_m_MKWMaxErr.FullThrottleTorqueIn._.ZFFSAB /end MEASUREMENT
/begin MEASUREMENT ZFFSAB._.FullThrottleTorqueIn.iv_m_MKWMax "Input value of stationary full trottle torque from CAN" UWORD SAB_M_NM2_M2047_S2_S3 1 100 -1023.5 31744 ECU_ADDRESS 0xFFF9592C DISPLAY_IDENTIFIER iv_m_MKWMax.FullThrottleTorqueIn._.ZFFSAB /end MEASUREMENT
/begin MEASUREMENT ZFFSAB._.FullThrottleTorqueIn.iv_m_MKWMaxSts "Input status value of stationary full trottle torque from CAN" UBYTE SAB_STANDARD_S2_S3 1 100 0 255 ECU_ADDRESS 0xFFF9592E DISPLAY_IDENTIFIER iv_m_MKWMaxSts.FullThrottleTorqueIn._.ZFFSAB /end MEASUREMENT
/begin MEASUREMENT ZFFSAB._.FullThrottleTorqueIn.sv_m_MKWMax "Output value of stationary full trottle torque" SWORD SAB_M_1NM_S2_S3 1 100 -32768 32767 ECU_ADDRESS 0xFFF95930 DISPLAY_IDENTIFIER sv_m_MKWMax.FullThrottleTorqueIn._.ZFFSAB /end MEASUREMENT
/begin MEASUREMENT ZFFSAB._.FullThrottleTorqueIn.sv_m_MKWMaxSts "Output value signal status of stationary full trottle torque" UBYTE SAB_STANDARD_S2_S3 1 100 0 2 ECU_ADDRESS 0xFFF95932 DISPLAY_IDENTIFIER sv_m_MKWMaxSts.FullThrottleTorqueIn._.ZFFSAB /end MEASUREMENT
/begin MEASUREMENT ZFFSAB._.GearBoxState.f_ctl_HssOff "Highside Off Flag" UBYTE SAB_STANDARD_S2_S3 1 100 0 1 ECU_ADDRESS 0xFFF8DB3E DISPLAY_IDENTIFIER f_ctl_HssOff.GearBoxState._.ZFFSAB /end MEASUREMENT
/begin MEASUREMENT ZFFSAB._.GearBoxState.iv_fet0_active "Input value for state of FET0" UBYTE SAB_STANDARD_S2_S3 1 100 0 255 ECU_ADDRESS 0xFFF8DB3A DISPLAY_IDENTIFIER iv_fet0_active.GearBoxState._.ZFFSAB /end MEASUREMENT
/begin MEASUREMENT ZFFSAB._.GearBoxState.iv_fet0_active_ "Input complement value for state of FET0" UBYTE SAB_STANDARD_S2_S3 1 100 0 255 ECU_ADDRESS 0xFFF8DB3B DISPLAY_IDENTIFIER iv_fet0_active_.GearBoxState._.ZFFSAB /end MEASUREMENT
/begin MEASUREMENT ZFFSAB._.GearBoxState.iv_u_BattFilt "filtered battery voltage used for test conditions" UWORD SAB_U_1VOLT1000_S2_S3 1 100 0 65.535 ECU_ADDRESS 0xFFF8DB38 DISPLAY_IDENTIFIER iv_u_BattFilt.GearBoxState._.ZFFSAB /end MEASUREMENT
/begin MEASUREMENT ZFFSAB._.GearBoxState.sv_StatusLimphome "Output signal of Gearbox Staus" UBYTE SAB_STANDARD_S2_S3 1 100 0 2 ECU_ADDRESS 0xFFF8DB3C DISPLAY_IDENTIFIER sv_StatusLimphome.GearBoxState._.ZFFSAB /end MEASUREMENT
/begin MEASUREMENT ZFFSAB._.GearBoxState.sv_StatusLimphome_ "Output complement signal of Gearbox Staus" UBYTE SAB_STANDARD_S2_S3 1 100 0 255 ECU_ADDRESS 0xFFF8DB3D DISPLAY_IDENTIFIER sv_StatusLimphome_.GearBoxState._.ZFFSAB /end MEASUREMENT
/begin MEASUREMENT ZFFSAB._.GearBoxState.tmr_t_HssOff.time "Description for this variable only in SW documentation possible not in asap2" ULONG SAB_T_TIMER_10MS_S2_S3 1 100 0 42949672950 ECU_ADDRESS 0xFFF8DB30 DISPLAY_IDENTIFIER time.tmr_t_HssOff.GearBoxState._.ZFFSAB /end MEASUREMENT
/begin MEASUREMENT ZFFSAB._.GearBoxState.tmr_t_HssOff.time_ "Description for this variable only in SW documentation possible not in asap2" ULONG SAB_T_TIMER_10MS_S2_S3 1 100 0 42949672950 ECU_ADDRESS 0xFFF8DB34 DISPLAY_IDENTIFIER time_.tmr_t_HssOff.GearBoxState._.ZFFSAB /end MEASUREMENT
/begin MEASUREMENT ZFFSAB._.GearLeverIn.GLI_SWI_LeverType "choice of the needed LeverType" UBYTE SAB_STANDARD_S2_S3 1 100 0 255 ECU_ADDRESS 0xFFF8DB78 DISPLAY_IDENTIFIER GLI_SWI_LeverType.GearLeverIn._.ZFFSAB /end MEASUREMENT
/begin MEASUREMENT ZFFSAB._.GearLeverIn.P1Act "park-button 1" UBYTE SAB_STANDARD_S2_S3 1 100 0 7 ECU_ADDRESS 0xFFF8DB72 DISPLAY_IDENTIFIER P1Act.GearLeverIn._.ZFFSAB /end MEASUREMENT
/begin MEASUREMENT ZFFSAB._.GearLeverIn.P1Sts "park-button 1 status calculation" UBYTE SAB_STANDARD_S2_S3 1 100 0 7 ECU_ADDRESS 0xFFF8DB74 DISPLAY_IDENTIFIER P1Sts.GearLeverIn._.ZFFSAB /end MEASUREMENT
/begin MEASUREMENT ZFFSAB._.GearLeverIn.P1_Raw "Input signal of alternate P-Taster 1" UBYTE SAB_STANDARD_S2_S3 1 100 0 1 ECU_ADDRESS 0xFFF8DB70 DISPLAY_IDENTIFIER P1_Raw.GearLeverIn._.ZFFSAB /end MEASUREMENT
/begin MEASUREMENT ZFFSAB._.GearLeverIn.P2Act "park-button 2 calculation" UBYTE SAB_STANDARD_S2_S3 1 100 0 7 ECU_ADDRESS 0xFFF8DB73 DISPLAY_IDENTIFIER P2Act.GearLeverIn._.ZFFSAB /end MEASUREMENT
/begin MEASUREMENT ZFFSAB._.GearLeverIn.P2Sts "park-button 2 status calculation" UBYTE SAB_STANDARD_S2_S3 1 100 0 7 ECU_ADDRESS 0xFFF8DB75 DISPLAY_IDENTIFIER P2Sts.GearLeverIn._.ZFFSAB /end MEASUREMENT
/begin MEASUREMENT ZFFSAB._.GearLeverIn.P2_Raw "Input signal of alternate P-Taster 2" UBYTE SAB_STANDARD_S2_S3 1 100 0 1 ECU_ADDRESS 0xFFF8DB71 DISPLAY_IDENTIFIER P2_Raw.GearLeverIn._.ZFFSAB /end MEASUREMENT
/begin MEASUREMENT ZFFSAB._.GearLeverIn.P_Raw "Input signal of alternate P-Taster" UBYTE SAB_STANDARD_S2_S3 1 100 0 1 ECU_ADDRESS 0xFFF8DB76 DISPLAY_IDENTIFIER P_Raw.GearLeverIn._.ZFFSAB /end MEASUREMENT
/begin MEASUREMENT ZFFSAB._.GearLeverIn.P_Raw_ "complement of P_Raw" UBYTE SAB_STANDARD_S2_S3 1 100 0 255 ECU_ADDRESS 0xFFF8DB77 DISPLAY_IDENTIFIER P_Raw_.GearLeverIn._.ZFFSAB /end MEASUREMENT
/begin MEASUREMENT ZFFSAB._.GearLeverIn.Pos "internal position signal from S1 or S2" UBYTE SAB_STANDARD_S2_S3 1 100 0 255 ECU_ADDRESS 0xFFF8DB7D DISPLAY_IDENTIFIER Pos.GearLeverIn._.ZFFSAB /end MEASUREMENT
/begin MEASUREMENT ZFFSAB._.GearLeverIn.PosS1Raw "input of gearlevers raw signal" UBYTE SAB_STANDARD_S2_S3 1 100 0 255 ECU_ADDRESS 0xFFF8DB79 DISPLAY_IDENTIFIER PosS1Raw.GearLeverIn._.ZFFSAB /end MEASUREMENT
/begin MEASUREMENT ZFFSAB._.GearLeverIn.PosS1Raw_ "complement of iv_PosS1Raw" UBYTE SAB_STANDARD_S2_S3 1 100 0 255 ECU_ADDRESS 0xFFF8DB7A DISPLAY_IDENTIFIER PosS1Raw_.GearLeverIn._.ZFFSAB /end MEASUREMENT
/begin MEASUREMENT ZFFSAB._.GearLeverIn.PosS2Raw "input of gearlevers raw signal" UBYTE SAB_STANDARD_S2_S3 1 100 0 255 ECU_ADDRESS 0xFFF8DB7B DISPLAY_IDENTIFIER PosS2Raw.GearLeverIn._.ZFFSAB /end MEASUREMENT
/begin MEASUREMENT ZFFSAB._.GearLeverIn.PosS2Raw_ "complement of iv_PosS2Raw" UBYTE SAB_STANDARD_S2_S3 1 100 0 255 ECU_ADDRESS 0xFFF8DB7C DISPLAY_IDENTIFIER PosS2Raw_.GearLeverIn._.ZFFSAB /end MEASUREMENT
/begin MEASUREMENT ZFFSAB._.GearLeverIn.Pos_ "internal complement of PosRaw" UBYTE SAB_STANDARD_S2_S3 1 100 0 255 ECU_ADDRESS 0xFFF8DB7E DISPLAY_IDENTIFIER Pos_.GearLeverIn._.ZFFSAB /end MEASUREMENT
/begin MEASUREMENT ZFFSAB._.GearLeverIn.iv_P1S1Raw "P1-Sensor Signal Source 1" UBYTE SAB_STANDARD_S2_S3 1 100 0 255 ECU_ADDRESS 0xFFF8DB48 DISPLAY_IDENTIFIER iv_P1S1Raw.GearLeverIn._.ZFFSAB /end MEASUREMENT
/begin MEASUREMENT ZFFSAB._.GearLeverIn.iv_P1S2Raw "P1-Sensor Signal Source 2" UBYTE SAB_STANDARD_S2_S3 1 100 0 255 ECU_ADDRESS 0xFFF8DB49 DISPLAY_IDENTIFIER iv_P1S2Raw.GearLeverIn._.ZFFSAB /end MEASUREMENT
/begin MEASUREMENT ZFFSAB._.GearLeverIn.iv_P2S1Raw "P2-Sensor Signal Source 1" UBYTE SAB_STANDARD_S2_S3 1 100 0 255 ECU_ADDRESS 0xFFF8DB4A DISPLAY_IDENTIFIER iv_P2S1Raw.GearLeverIn._.ZFFSAB /end MEASUREMENT
/begin MEASUREMENT ZFFSAB._.GearLeverIn.iv_P2S2Raw "P2-Sensor Signal Source 2" UBYTE SAB_STANDARD_S2_S3 1 100 0 255 ECU_ADDRESS 0xFFF8DB4B DISPLAY_IDENTIFIER iv_P2S2Raw.GearLeverIn._.ZFFSAB /end MEASUREMENT
/begin MEASUREMENT ZFFSAB._.GearLeverIn.iv_PS1_Raw "P-Sensor Signal Source 1" UBYTE SAB_STANDARD_S2_S3 1 100 0 255 ECU_ADDRESS 0xFFF8DB44 DISPLAY_IDENTIFIER iv_PS1_Raw.GearLeverIn._.ZFFSAB /end MEASUREMENT
/begin MEASUREMENT ZFFSAB._.GearLeverIn.iv_PS1_Raw_ "complement of Parktaster" UBYTE SAB_STANDARD_S2_S3 1 100 0 255 ECU_ADDRESS 0xFFF8DB45 DISPLAY_IDENTIFIER iv_PS1_Raw_.GearLeverIn._.ZFFSAB /end MEASUREMENT
/begin MEASUREMENT ZFFSAB._.GearLeverIn.iv_PS2_Raw "P-Sensor Signal Source 2" UBYTE SAB_STANDARD_S2_S3 1 100 0 255 ECU_ADDRESS 0xFFF8DB46 DISPLAY_IDENTIFIER iv_PS2_Raw.GearLeverIn._.ZFFSAB /end MEASUREMENT
/begin MEASUREMENT ZFFSAB._.GearLeverIn.iv_PS2_Raw_ "complement of Parktaster signal from Source2" UBYTE SAB_STANDARD_S2_S3 1 100 0 255 ECU_ADDRESS 0xFFF8DB47 DISPLAY_IDENTIFIER iv_PS2_Raw_.GearLeverIn._.ZFFSAB /end MEASUREMENT
/begin MEASUREMENT ZFFSAB._.GearLeverIn.iv_PosAbsS1Raw "absolute input signal 1" UBYTE SAB_STANDARD_S2_S3 1 100 0 255 ECU_ADDRESS 0xFFF8DB50 DISPLAY_IDENTIFIER iv_PosAbsS1Raw.GearLeverIn._.ZFFSAB /end MEASUREMENT
/begin MEASUREMENT ZFFSAB._.GearLeverIn.iv_PosAbsS1Raw_ "complement of iv_PosAbsS1Raw" UBYTE SAB_STANDARD_S2_S3 1 100 0 255 ECU_ADDRESS 0xFFF8DB51 DISPLAY_IDENTIFIER iv_PosAbsS1Raw_.GearLeverIn._.ZFFSAB /end MEASUREMENT
/begin MEASUREMENT ZFFSAB._.GearLeverIn.iv_PosAbsS2Raw "absolute input raw signal" UBYTE SAB_STANDARD_S2_S3 1 100 0 255 ECU_ADDRESS 0xFFF8DB56 DISPLAY_IDENTIFIER iv_PosAbsS2Raw.GearLeverIn._.ZFFSAB /end MEASUREMENT
/begin MEASUREMENT ZFFSAB._.GearLeverIn.iv_PosAbsS2Raw_ "complement of iv_PosAbsS2Raw" UBYTE SAB_STANDARD_S2_S3 1 100 0 255 ECU_ADDRESS 0xFFF8DB57 DISPLAY_IDENTIFIER iv_PosAbsS2Raw_.GearLeverIn._.ZFFSAB /end MEASUREMENT
/begin MEASUREMENT ZFFSAB._.GearLeverIn.iv_PosRelS1Raw "relative input signal 1" UBYTE SAB_STANDARD_S2_S3 1 100 0 255 ECU_ADDRESS 0xFFF8DB4E DISPLAY_IDENTIFIER iv_PosRelS1Raw.GearLeverIn._.ZFFSAB /end MEASUREMENT
/begin MEASUREMENT ZFFSAB._.GearLeverIn.iv_PosRelS1Raw_ "complement of iv_PosRelS1Raw" UBYTE SAB_STANDARD_S2_S3 1 100 0 255 ECU_ADDRESS 0xFFF8DB4F DISPLAY_IDENTIFIER iv_PosRelS1Raw_.GearLeverIn._.ZFFSAB /end MEASUREMENT
/begin MEASUREMENT ZFFSAB._.GearLeverIn.iv_PosRelS2Raw "relative input raw signal" UBYTE SAB_STANDARD_S2_S3 1 100 0 255 ECU_ADDRESS 0xFFF8DB54 DISPLAY_IDENTIFIER iv_PosRelS2Raw.GearLeverIn._.ZFFSAB /end MEASUREMENT
/begin MEASUREMENT ZFFSAB._.GearLeverIn.iv_PosRelS2Raw_ "complement of iv_PosRelS2Raw" UBYTE SAB_STANDARD_S2_S3 1 100 0 255 ECU_ADDRESS 0xFFF8DB55 DISPLAY_IDENTIFIER iv_PosRelS2Raw_.GearLeverIn._.ZFFSAB /end MEASUREMENT
/begin MEASUREMENT ZFFSAB._.GearLeverIn.iv_PosS1RawSts "status of gearlevers raw signal" UBYTE SAB_STANDARD_S2_S3 1 100 0 255 ECU_ADDRESS 0xFFF8DB4C DISPLAY_IDENTIFIER iv_PosS1RawSts.GearLeverIn._.ZFFSAB /end MEASUREMENT
/begin MEASUREMENT ZFFSAB._.GearLeverIn.iv_PosS1RawSts_ "komplement of iv_PosS1RawSts" UBYTE SAB_STANDARD_S2_S3 1 100 0 255 ECU_ADDRESS 0xFFF8DB4D DISPLAY_IDENTIFIER iv_PosS1RawSts_.GearLeverIn._.ZFFSAB /end MEASUREMENT
/begin MEASUREMENT ZFFSAB._.GearLeverIn.iv_PosS2RawSts "status of gearlevers raw signal" UBYTE SAB_STANDARD_S2_S3 1 100 0 255 ECU_ADDRESS 0xFFF8DB52 DISPLAY_IDENTIFIER iv_PosS2RawSts.GearLeverIn._.ZFFSAB /end MEASUREMENT
/begin MEASUREMENT ZFFSAB._.GearLeverIn.iv_PosS2RawSts_ "komplement of iv_PosS2RawSts" UBYTE SAB_STANDARD_S2_S3 1 100 0 255 ECU_ADDRESS 0xFFF8DB53 DISPLAY_IDENTIFIER iv_PosS2RawSts_.GearLeverIn._.ZFFSAB /end MEASUREMENT
/begin MEASUREMENT ZFFSAB._.GearLeverIn.sv_AGS_LeverPos "Output signal of gear lever for Layer AGS" UBYTE SAB_STANDARD_S2_S3 1 100 0 3 ECU_ADDRESS 0xFFF8DB6F DISPLAY_IDENTIFIER sv_AGS_LeverPos.GearLeverIn._.ZFFSAB /end MEASUREMENT
/begin MEASUREMENT ZFFSAB._.GearLeverIn.sv_CtrlSignalSource "parameter to switch between S2 and S1" UBYTE SAB_STANDARD_S2_S3 1 100 0 2 ECU_ADDRESS 0xFFF8DB58 DISPLAY_IDENTIFIER sv_CtrlSignalSource.GearLeverIn._.ZFFSAB /end MEASUREMENT
/begin MEASUREMENT ZFFSAB._.GearLeverIn.sv_CtrlSignalSourceSts "status of CtrlSignalSource" UBYTE SAB_STANDARD_S2_S3 1 100 0 2 ECU_ADDRESS 0xFFF8DB59 DISPLAY_IDENTIFIER sv_CtrlSignalSourceSts.GearLeverIn._.ZFFSAB /end MEASUREMENT
/begin MEASUREMENT ZFFSAB._.GearLeverIn.sv_CtrlSignalSourceSts_ "complement CtrlSignalSource" UBYTE SAB_STANDARD_S2_S3 1 100 0 255 ECU_ADDRESS 0xFFF8DB5A DISPLAY_IDENTIFIER sv_CtrlSignalSourceSts_.GearLeverIn._.ZFFSAB /end MEASUREMENT
/begin MEASUREMENT ZFFSAB._.GearLeverIn.sv_GatePosition "output value gate position" UBYTE SAB_STANDARD_S2_S3 1 100 0 255 ECU_ADDRESS 0xFFF8DB6B DISPLAY_IDENTIFIER sv_GatePosition.GearLeverIn._.ZFFSAB /end MEASUREMENT
/begin MEASUREMENT ZFFSAB._.GearLeverIn.sv_GatePosition_ "output complement value gate position" UBYTE SAB_STANDARD_S2_S3 1 100 0 255 ECU_ADDRESS 0xFFF8DB6C DISPLAY_IDENTIFIER sv_GatePosition_.GearLeverIn._.ZFFSAB /end MEASUREMENT
/begin MEASUREMENT ZFFSAB._.GearLeverIn.sv_PosRaw "position signal S1 or S2" UBYTE SAB_STANDARD_S2_S3 1 100 0 255 ECU_ADDRESS 0xFFF8DB6D DISPLAY_IDENTIFIER sv_PosRaw.GearLeverIn._.ZFFSAB /end MEASUREMENT
/begin MEASUREMENT ZFFSAB._.GearLeverIn.sv_PosRaw_ "complement of PosRaw" UBYTE SAB_STANDARD_S2_S3 1 100 0 255 ECU_ADDRESS 0xFFF8DB6E DISPLAY_IDENTIFIER sv_PosRaw_.GearLeverIn._.ZFFSAB /end MEASUREMENT
/begin MEASUREMENT ZFFSAB._.GearLeverIn.sv_SWILeverType "Get method for SWI_LeverType" UBYTE SAB_STANDARD_S2_S3 1 100 0 2 ECU_ADDRESS 0xFFF8DB68 DISPLAY_IDENTIFIER sv_SWILeverType.GearLeverIn._.ZFFSAB /end MEASUREMENT
/begin MEASUREMENT ZFFSAB._.GearLeverIn.sv_SWILeverTypeKomp "Get method for SWI_LeverTypeKomp" UBYTE SAB_STANDARD_S2_S3 1 100 0 255 ECU_ADDRESS 0xFFF8DB69 DISPLAY_IDENTIFIER sv_SWILeverTypeKomp.GearLeverIn._.ZFFSAB /end MEASUREMENT
/begin MEASUREMENT ZFFSAB._.GearLeverIn.sv_SWISignalSource "Get method for SWI_SignalSource" UBYTE SAB_STANDARD_S2_S3 1 100 0 3 ECU_ADDRESS 0xFFF8DB6A DISPLAY_IDENTIFIER sv_SWISignalSource.GearLeverIn._.ZFFSAB /end MEASUREMENT
/begin MEASUREMENT ZFFSAB._.GearLeverIn.sv_f_P12BadOpRaw "flag of bad operation" UBYTE SAB_STANDARD_S2_S3 1 100 0 7 ECU_ADDRESS 0xFFF8DB5B DISPLAY_IDENTIFIER sv_f_P12BadOpRaw.GearLeverIn._.ZFFSAB /end MEASUREMENT
/begin MEASUREMENT ZFFSAB._.GearLeverIn.sv_f_P12Button "flag of park-button" UBYTE SAB_STANDARD_S2_S3 1 100 0 7 ECU_ADDRESS 0xFFF8DB5C DISPLAY_IDENTIFIER sv_f_P12Button.GearLeverIn._.ZFFSAB /end MEASUREMENT
/begin MEASUREMENT ZFFSAB._.GearLeverIn.sv_f_P12Button_ "complement of sv_f_P12Button" UBYTE SAB_STANDARD_S2_S3 1 100 0 255 ECU_ADDRESS 0xFFF8DB5D DISPLAY_IDENTIFIER sv_f_P12Button_.GearLeverIn._.ZFFSAB /end MEASUREMENT
/begin MEASUREMENT ZFFSAB._.GearLeverIn.sv_f_P12OneErr "defective park-button 1" UBYTE SAB_STANDARD_S2_S3 1 100 0 7 ECU_ADDRESS 0xFFF8DB5E DISPLAY_IDENTIFIER sv_f_P12OneErr.GearLeverIn._.ZFFSAB /end MEASUREMENT
/begin MEASUREMENT ZFFSAB._.GearLeverIn.sv_f_P12TwoErr "defective park-buttons2" UBYTE SAB_STANDARD_S2_S3 1 100 0 7 ECU_ADDRESS 0xFFF8DB5F DISPLAY_IDENTIFIER sv_f_P12TwoErr.GearLeverIn._.ZFFSAB /end MEASUREMENT
/begin MEASUREMENT ZFFSAB._.GearLeverIn.sv_f_PosS1Err "error-signal of position source 1" UBYTE SAB_STANDARD_S2_S3 1 100 0 1 ECU_ADDRESS 0xFFF8DB60 DISPLAY_IDENTIFIER sv_f_PosS1Err.GearLeverIn._.ZFFSAB /end MEASUREMENT
/begin MEASUREMENT ZFFSAB._.GearLeverIn.sv_f_PosS2Err "error-signal of position source 2" UBYTE SAB_STANDARD_S2_S3 1 100 0 1 ECU_ADDRESS 0xFFF8DB61 DISPLAY_IDENTIFIER sv_f_PosS2Err.GearLeverIn._.ZFFSAB /end MEASUREMENT
/begin MEASUREMENT ZFFSAB._.GearLeverIn.sv_f_SD_Button "flag for Sport-Drive" UBYTE SAB_STANDARD_S2_S3 1 100 0 1 ECU_ADDRESS 0xFFF8DB62 DISPLAY_IDENTIFIER sv_f_SD_Button.GearLeverIn._.ZFFSAB /end MEASUREMENT
/begin MEASUREMENT ZFFSAB._.GearLeverIn.sv_f_TipMinusSBWErr "depends on CtrlSignalSourceSts" UBYTE SAB_STANDARD_S2_S3 1 100 0 1 ECU_ADDRESS 0xFFF8DB65 DISPLAY_IDENTIFIER sv_f_TipMinusSBWErr.GearLeverIn._.ZFFSAB /end MEASUREMENT
/begin MEASUREMENT ZFFSAB._.GearLeverIn.sv_f_TipMinusSBW_Raw "output value of f_TipMinusSBW_Raw" UBYTE SAB_STANDARD_S2_S3 1 100 0 1 ECU_ADDRESS 0xFFF8DB63 DISPLAY_IDENTIFIER sv_f_TipMinusSBW_Raw.GearLeverIn._.ZFFSAB /end MEASUREMENT
/begin MEASUREMENT ZFFSAB._.GearLeverIn.sv_f_TipMinusSBW_Raw_ "output value of f_TipMinusSBW_Raw_" UBYTE SAB_STANDARD_S2_S3 1 100 0 255 ECU_ADDRESS 0xFFF8DB64 DISPLAY_IDENTIFIER sv_f_TipMinusSBW_Raw_.GearLeverIn._.ZFFSAB /end MEASUREMENT
/begin MEASUREMENT ZFFSAB._.GearLeverIn.sv_f_TipPlusSBW_Raw "output value of f_TipPlusSBW_Raw" UBYTE SAB_STANDARD_S2_S3 1 100 0 1 ECU_ADDRESS 0xFFF8DB66 DISPLAY_IDENTIFIER sv_f_TipPlusSBW_Raw.GearLeverIn._.ZFFSAB /end MEASUREMENT
/begin MEASUREMENT ZFFSAB._.GearLeverIn.sv_f_TipPlusSBW_Raw_ "output value of f_TipPlusSBW_Raw_" UBYTE SAB_STANDARD_S2_S3 1 100 0 255 ECU_ADDRESS 0xFFF8DB67 DISPLAY_IDENTIFIER sv_f_TipPlusSBW_Raw_.GearLeverIn._.ZFFSAB /end MEASUREMENT
/begin MEASUREMENT ZFFSAB._.GearLimitation.iv_f_GearLimitActive "flag which signalizes if gears must be suppressed" UBYTE SAB_STANDARD_S2_S3 1 100 0 1 ECU_ADDRESS 0xFFF95E8E DISPLAY_IDENTIFIER iv_f_GearLimitActive.GearLimitation._.ZFFSAB /end MEASUREMENT
/begin MEASUREMENT ZFFSAB._.GearLimitation.sv_GearLimit "signalizes which gears must be suppressed" UBYTE SAB_STANDARD_S2_S3 1 100 0 255 ECU_ADDRESS 0xFFF95E8C DISPLAY_IDENTIFIER sv_GearLimit.GearLimitation._.ZFFSAB /end MEASUREMENT
/begin MEASUREMENT ZFFSAB._.GearLimitation.sv_f_GearLimitActive "flag which signalizes if gears must be suppressed" UBYTE SAB_STANDARD_S2_S3 1 100 0 1 ECU_ADDRESS 0xFFF95E8D DISPLAY_IDENTIFIER sv_f_GearLimitActive.GearLimitation._.ZFFSAB /end MEASUREMENT
/begin MEASUREMENT ZFFSAB._.GearRatioByCurrents.GearRatioByCurrents_fl.IstGang "Calculated gear with different definition: 255=not defined 0=backward 1..8 forward" FLOAT32_IEEE SAB_STANDARD_S2_S3 1 100 0 255 ECU_ADDRESS 0xFFF8DE3C FORMAT "%4.3" DISPLAY_IDENTIFIER IstGang.GearRatioByCurrents_fl.GearRatioByCurrents._.ZFFSAB /end MEASUREMENT
/begin MEASUREMENT ZFFSAB._.GearRatioByCurrents.GearRatioByCurrents_fl.IstGangOld "Old value of calculated gear" FLOAT32_IEEE SAB_STANDARD_S2_S3 1 100 0 255 ECU_ADDRESS 0xFFF8DE40 FORMAT "%4.3" DISPLAY_IDENTIFIER IstGangOld.GearRatioByCurrents_fl.GearRatioByCurrents._.ZFFSAB /end MEASUREMENT
/begin MEASUREMENT ZFFSAB._.GearRatioByCurrents.GearRatioByCurrents_fl.err_flags_old "Packed error flags to be stored in EEPROM Bits: 2: f_n_AbWheelErr 1: f_n_AbTuErr 0: f_n_TuWheelErr" FLOAT32_IEEE SAB_STANDARD_S2_S3 1 100 0 255 ECU_ADDRESS 0xFFF8DECC FORMAT "%4.3" DISPLAY_IDENTIFIER err_flags_old.GearRatioByCurrents_fl.GearRatioByCurrents._.ZFFSAB /end MEASUREMENT
/begin MEASUREMENT ZFFSAB._.GearRatioByCurrents.GearRatioByCurrents_fl.err_flags_old_ "Complement of err_flags_old" FLOAT32_IEEE SAB_STANDARD_S2_S3 1 100 0 255 ECU_ADDRESS 0xFFF8DED0 FORMAT "%4.3" DISPLAY_IDENTIFIER err_flags_old_.GearRatioByCurrents_fl.GearRatioByCurrents._.ZFFSAB /end MEASUREMENT
/begin MEASUREMENT ZFFSAB._.GearRatioByCurrents.GearRatioByCurrents_fl.f_RearAxleRatioLearned "Flag indicating that rear axle ratio is learned or learn function is disabled" FLOAT32_IEEE SAB_STANDARD_S2_S3 1 100 0 1 ECU_ADDRESS 0xFFF8DE94 FORMAT "%4.3" DISPLAY_IDENTIFIER f_RearAxleRatioLearned.GearRatioByCurrents_fl.GearRatioByCurrents._.ZFFSAB /end MEASUREMENT
/begin MEASUREMENT ZFFSAB._.GearRatioByCurrents.GearRatioByCurrents_fl.f_RearAxleRatioLearned_ "Complement of f_RearAxleRatioLearned" FLOAT32_IEEE SAB_STANDARD_S2_S3 1 100 0 255 ECU_ADDRESS 0xFFF8DE98 FORMAT "%4.3" DISPLAY_IDENTIFIER f_RearAxleRatioLearned_.GearRatioByCurrents_fl.GearRatioByCurrents._.ZFFSAB /end MEASUREMENT
/begin MEASUREMENT ZFFSAB._.GearRatioByCurrents.GearRatioByCurrents_fl.f_n6PlausiErr "Flag indicating that n_Tu is not plausible to CAN n_Wheel and n_Ab" FLOAT32_IEEE SAB_STANDARD_S2_S3 1 100 0 1 ECU_ADDRESS 0xFFF8DEE4 FORMAT "%4.3" DISPLAY_IDENTIFIER f_n6PlausiErr.GearRatioByCurrents_fl.GearRatioByCurrents._.ZFFSAB /end MEASUREMENT
/begin MEASUREMENT ZFFSAB._.GearRatioByCurrents.GearRatioByCurrents_fl.f_n6WheelErr "Flag indicating that n_Tu and CAN n_Wheel are not plausible to each other" FLOAT32_IEEE SAB_STANDARD_S2_S3 1 100 0 1 ECU_ADDRESS 0xFFF8DEC4 FORMAT "%4.3" DISPLAY_IDENTIFIER f_n6WheelErr.GearRatioByCurrents_fl.GearRatioByCurrents._.ZFFSAB /end MEASUREMENT
/begin MEASUREMENT ZFFSAB._.GearRatioByCurrents.GearRatioByCurrents_fl.f_n6nEngErr "Flag indicating that n6 and nEM are not plausible to each other" FLOAT32_IEEE SAB_STANDARD_S2_S3 1 100 0 1 ECU_ADDRESS 0xFFF8DE60 FORMAT "%4.3" DISPLAY_IDENTIFIER f_n6nEngErr.GearRatioByCurrents_fl.GearRatioByCurrents._.ZFFSAB /end MEASUREMENT
/begin MEASUREMENT ZFFSAB._.GearRatioByCurrents.GearRatioByCurrents_fl.f_n_AbPlausiErr "Flag indicating that n_Ab is not plausible to CAN n_Wheel and n_Tu" FLOAT32_IEEE SAB_STANDARD_S2_S3 1 100 0 1 ECU_ADDRESS 0xFFF8DEDC FORMAT "%4.3" DISPLAY_IDENTIFIER f_n_AbPlausiErr.GearRatioByCurrents_fl.GearRatioByCurrents._.ZFFSAB /end MEASUREMENT
/begin MEASUREMENT ZFFSAB._.GearRatioByCurrents.GearRatioByCurrents_fl.f_n_AbWheelErr "Flag indicating that n_Ab and CAN n_Wheel are not plausible to each other" FLOAT32_IEEE SAB_STANDARD_S2_S3 1 100 0 1 ECU_ADDRESS 0xFFF8DEBC FORMAT "%4.3" DISPLAY_IDENTIFIER f_n_AbWheelErr.GearRatioByCurrents_fl.GearRatioByCurrents._.ZFFSAB /end MEASUREMENT
/begin MEASUREMENT ZFFSAB._.GearRatioByCurrents.GearRatioByCurrents_fl.f_n_Abn6Err "Flag indicating that n_Ab and n_Tu are not plausible to each other" FLOAT32_IEEE SAB_STANDARD_S2_S3 1 100 0 1 ECU_ADDRESS 0xFFF8DEC0 FORMAT "%4.3" DISPLAY_IDENTIFIER f_n_Abn6Err.GearRatioByCurrents_fl.GearRatioByCurrents._.ZFFSAB /end MEASUREMENT
/begin MEASUREMENT ZFFSAB._.GearRatioByCurrents.GearRatioByCurrents_fl.f_n_PlausiErr "Flag indicating that there are more than two signals of n_Ab n_Tu and n_Wheel have failed" FLOAT32_IEEE SAB_STANDARD_S2_S3 1 100 0 1 ECU_ADDRESS 0xFFF8DEE8 FORMAT "%4.3" DISPLAY_IDENTIFIER f_n_PlausiErr.GearRatioByCurrents_fl.GearRatioByCurrents._.ZFFSAB /end MEASUREMENT
/begin MEASUREMENT ZFFSAB._.GearRatioByCurrents.GearRatioByCurrents_fl.f_n_TuVirtPlausiErr "Flag indicating that iv_n_Tu = n_TuVirt Lev1 and n_TuVirtLev2 are not plausible to each other" FLOAT32_IEEE SAB_STANDARD_S2_S3 1 100 0 1 ECU_ADDRESS 0xFFF8DE6C FORMAT "%4.3" DISPLAY_IDENTIFIER f_n_TuVirtPlausiErr.GearRatioByCurrents_fl.GearRatioByCurrents._.ZFFSAB /end MEASUREMENT
/begin MEASUREMENT ZFFSAB._.GearRatioByCurrents.GearRatioByCurrents_fl.f_n_WheelPlausiErr "Flag indicating that CAN n_Wheel is not plausible to n_Ab and n_Tu" FLOAT32_IEEE SAB_STANDARD_S2_S3 1 100 0 1 ECU_ADDRESS 0xFFF8DEE0 FORMAT "%4.3" DISPLAY_IDENTIFIER f_n_WheelPlausiErr.GearRatioByCurrents_fl.GearRatioByCurrents._.ZFFSAB /end MEASUREMENT
/begin MEASUREMENT ZFFSAB._.GearRatioByCurrents.GearRatioByCurrents_fl.f_xErrChanged "Flag indicating that one of the f_n_*Err flags has changed from 0 to 1" FLOAT32_IEEE SAB_STANDARD_S2_S3 1 100 0 1 ECU_ADDRESS 0xFFF8DEC8 FORMAT "%4.3" DISPLAY_IDENTIFIER f_xErrChanged.GearRatioByCurrents_fl.GearRatioByCurrents._.ZFFSAB /end MEASUREMENT
/begin MEASUREMENT ZFFSAB._.GearRatioByCurrents.GearRatioByCurrents_fl.iGang "Calculated gear ratio" FLOAT32_IEEE SAB_K1000_S2_S3 1 100 0 65.535 ECU_ADDRESS 0xFFF8DE38 DISPLAY_IDENTIFIER iGang.GearRatioByCurrents_fl.GearRatioByCurrents._.ZFFSAB /end MEASUREMENT
/begin MEASUREMENT ZFFSAB._.GearRatioByCurrents.GearRatioByCurrents_fl.iv_ieds0 "Input value for electric current of actuator IEDS0 - connected to gearbox clutch A" FLOAT32_IEEE SAB_I_MA10_S2_S3 1 100 0 6553.5 ECU_ADDRESS 0xFFF8DE10 DISPLAY_IDENTIFIER iv_ieds0.GearRatioByCurrents_fl.GearRatioByCurrents._.ZFFSAB /end MEASUREMENT
/begin MEASUREMENT ZFFSAB._.GearRatioByCurrents.GearRatioByCurrents_fl.iv_ieds0_ "Complement of input value for electric current of actuator IEDS0 - connected to gearbox clutch A" FLOAT32_IEEE SAB_STANDARD_S2_S3 1 100 0 65535 ECU_ADDRESS 0xFFF8DE24 FORMAT "%4.3" DISPLAY_IDENTIFIER iv_ieds0_.GearRatioByCurrents_fl.GearRatioByCurrents._.ZFFSAB /end MEASUREMENT
/begin MEASUREMENT ZFFSAB._.GearRatioByCurrents.GearRatioByCurrents_fl.iv_ieds1 "Input value for electric current of actuator IEDS1 - connected to gearbox clutch D" FLOAT32_IEEE SAB_I_MA10_S2_S3 1 100 0 6553.5 ECU_ADDRESS 0xFFF8DE14 DISPLAY_IDENTIFIER iv_ieds1.GearRatioByCurrents_fl.GearRatioByCurrents._.ZFFSAB /end MEASUREMENT
/begin MEASUREMENT ZFFSAB._.GearRatioByCurrents.GearRatioByCurrents_fl.iv_ieds1_ "Complement of input value for electric current of actuator IEDS1 - connected to gearbox clutch D" FLOAT32_IEEE SAB_STANDARD_S2_S3 1 100 0 65535 ECU_ADDRESS 0xFFF8DE28 FORMAT "%4.3" DISPLAY_IDENTIFIER iv_ieds1_.GearRatioByCurrents_fl.GearRatioByCurrents._.ZFFSAB /end MEASUREMENT
/begin MEASUREMENT ZFFSAB._.GearRatioByCurrents.GearRatioByCurrents_fl.iv_ieds2 "Input value for electric current of actuator IEDS2 - connected to gearbox clutch B" FLOAT32_IEEE SAB_I_MA10_S2_S3 1 100 0 6553.5 ECU_ADDRESS 0xFFF8DE18 DISPLAY_IDENTIFIER iv_ieds2.GearRatioByCurrents_fl.GearRatioByCurrents._.ZFFSAB /end MEASUREMENT
/begin MEASUREMENT ZFFSAB._.GearRatioByCurrents.GearRatioByCurrents_fl.iv_ieds2_ "Complement of input value for electric current of actuator IEDS2 - connected to gearbox clutch B" FLOAT32_IEEE SAB_STANDARD_S2_S3 1 100 0 65535 ECU_ADDRESS 0xFFF8DE2C FORMAT "%4.3" DISPLAY_IDENTIFIER iv_ieds2_.GearRatioByCurrents_fl.GearRatioByCurrents._.ZFFSAB /end MEASUREMENT
/begin MEASUREMENT ZFFSAB._.GearRatioByCurrents.GearRatioByCurrents_fl.iv_ieds3 "Input value for electric current of actuator IEDS3 - connected to gearbox clutch E" FLOAT32_IEEE SAB_I_MA10_S2_S3 1 100 0 6553.5 ECU_ADDRESS 0xFFF8DE1C DISPLAY_IDENTIFIER iv_ieds3.GearRatioByCurrents_fl.GearRatioByCurrents._.ZFFSAB /end MEASUREMENT
/begin MEASUREMENT ZFFSAB._.GearRatioByCurrents.GearRatioByCurrents_fl.iv_ieds3_ "Complement of input value for electric current of actuator IEDS3 - connected to gearbox clutch E" FLOAT32_IEEE SAB_STANDARD_S2_S3 1 100 0 65535 ECU_ADDRESS 0xFFF8DE30 FORMAT "%4.3" DISPLAY_IDENTIFIER iv_ieds3_.GearRatioByCurrents_fl.GearRatioByCurrents._.ZFFSAB /end MEASUREMENT
/begin MEASUREMENT ZFFSAB._.GearRatioByCurrents.GearRatioByCurrents_fl.iv_ieds4 "Input value for electric current of actuator IEDS4 - connected to gearbox clutch C" FLOAT32_IEEE SAB_I_MA10_S2_S3 1 100 0 6553.5 ECU_ADDRESS 0xFFF8DE20 DISPLAY_IDENTIFIER iv_ieds4.GearRatioByCurrents_fl.GearRatioByCurrents._.ZFFSAB /end MEASUREMENT
/begin MEASUREMENT ZFFSAB._.GearRatioByCurrents.GearRatioByCurrents_fl.iv_ieds4_ "Complement of input value for electric current of actuator IEDS4 - connected to gearbox clutch C" FLOAT32_IEEE SAB_STANDARD_S2_S3 1 100 0 65535 ECU_ADDRESS 0xFFF8DE34 FORMAT "%4.3" DISPLAY_IDENTIFIER iv_ieds4_.GearRatioByCurrents_fl.GearRatioByCurrents._.ZFFSAB /end MEASUREMENT
/begin MEASUREMENT ZFFSAB._.GearRatioByCurrents.GearRatioByCurrents_fl.iv_n6 "Raw value of shaft 6 rotational speed" FLOAT32_IEEE SAB_N_1RPM_S2_S3 1 100 0 65535 ECU_ADDRESS 0xFFF8DE4C FORMAT "%4.3" DISPLAY_IDENTIFIER iv_n6.GearRatioByCurrents_fl.GearRatioByCurrents._.ZFFSAB /end MEASUREMENT
/begin MEASUREMENT ZFFSAB._.GearRatioByCurrents.GearRatioByCurrents_fl.iv_n6_ "Complement of iv_n6" FLOAT32_IEEE SAB_STANDARD_S2_S3 1 100 0 65535 ECU_ADDRESS 0xFFF8DE50 FORMAT "%4.3" DISPLAY_IDENTIFIER iv_n6_.GearRatioByCurrents_fl.GearRatioByCurrents._.ZFFSAB /end MEASUREMENT
/begin MEASUREMENT ZFFSAB._.GearRatioByCurrents.GearRatioByCurrents_fl.iv_n6_ESts "Electrical status of turbine rotational speed" FLOAT32_IEEE SAB_STANDARD_S2_S3 1 100 0 2 ECU_ADDRESS 0xFFF8DE80 FORMAT "%4.3" DISPLAY_IDENTIFIER iv_n6_ESts.GearRatioByCurrents_fl.GearRatioByCurrents._.ZFFSAB /end MEASUREMENT
/begin MEASUREMENT ZFFSAB._.GearRatioByCurrents.GearRatioByCurrents_fl.iv_n6_ESts_ "Complement of iv_n_TuESts" FLOAT32_IEEE SAB_STANDARD_S2_S3 1 100 0 255 ECU_ADDRESS 0xFFF8DEA8 FORMAT "%4.3" DISPLAY_IDENTIFIER iv_n6_ESts_.GearRatioByCurrents_fl.GearRatioByCurrents._.ZFFSAB /end MEASUREMENT
/begin MEASUREMENT ZFFSAB._.GearRatioByCurrents.GearRatioByCurrents_fl.iv_n_Ab "Raw value of Transmission output rotational speed" FLOAT32_IEEE SAB_N_1RPM_S2_S3 1 100 0 65535 ECU_ADDRESS 0xFFF8DE84 FORMAT "%4.3" DISPLAY_IDENTIFIER iv_n_Ab.GearRatioByCurrents_fl.GearRatioByCurrents._.ZFFSAB /end MEASUREMENT
/begin MEASUREMENT ZFFSAB._.GearRatioByCurrents.GearRatioByCurrents_fl.iv_n_AbESts "Electrical status of transmission output rotational speed" FLOAT32_IEEE SAB_STANDARD_S2_S3 1 100 0 2 ECU_ADDRESS 0xFFF8DE88 FORMAT "%4.3" DISPLAY_IDENTIFIER iv_n_AbESts.GearRatioByCurrents_fl.GearRatioByCurrents._.ZFFSAB /end MEASUREMENT
/begin MEASUREMENT ZFFSAB._.GearRatioByCurrents.GearRatioByCurrents_fl.iv_n_AbESts_ "Complement of iv_n_AbESts" FLOAT32_IEEE SAB_STANDARD_S2_S3 1 100 0 255 ECU_ADDRESS 0xFFF8DEB0 FORMAT "%4.3" DISPLAY_IDENTIFIER iv_n_AbESts_.GearRatioByCurrents_fl.GearRatioByCurrents._.ZFFSAB /end MEASUREMENT
/begin MEASUREMENT ZFFSAB._.GearRatioByCurrents.GearRatioByCurrents_fl.iv_n_Ab_ "Complement of iv_n_Ab" FLOAT32_IEEE SAB_STANDARD_S2_S3 1 100 0 65535 ECU_ADDRESS 0xFFF8DEAC FORMAT "%4.3" DISPLAY_IDENTIFIER iv_n_Ab_.GearRatioByCurrents_fl.GearRatioByCurrents._.ZFFSAB /end MEASUREMENT
/begin MEASUREMENT ZFFSAB._.GearRatioByCurrents.GearRatioByCurrents_fl.iv_n_Tu "Is the n_TuVirt of Lev1 calculation" FLOAT32_IEEE SAB_N_1RPM_S2_S3 1 100 0 65535 ECU_ADDRESS 0xFFF8DE44 FORMAT "%4.3" DISPLAY_IDENTIFIER iv_n_Tu.GearRatioByCurrents_fl.GearRatioByCurrents._.ZFFSAB /end MEASUREMENT
/begin MEASUREMENT ZFFSAB._.GearRatioByCurrents.GearRatioByCurrents_fl.iv_n_Tu_ "Complement of iv_n_Tu" FLOAT32_IEEE SAB_STANDARD_S2_S3 1 100 0 65535 ECU_ADDRESS 0xFFF8DE48 FORMAT "%4.3" DISPLAY_IDENTIFIER iv_n_Tu_.GearRatioByCurrents_fl.GearRatioByCurrents._.ZFFSAB /end MEASUREMENT
/begin MEASUREMENT ZFFSAB._.GearRatioByCurrents.GearRatioByCurrents_fl.iv_sts_ClutchIAE "Status signal of IAE" FLOAT32_IEEE SAB_STANDARD_S2_S3 1 100 0 255 ECU_ADDRESS 0xFFF8DE68 FORMAT "%4.3" DISPLAY_IDENTIFIER iv_sts_ClutchIAE.GearRatioByCurrents_fl.GearRatioByCurrents._.ZFFSAB /end MEASUREMENT
/begin MEASUREMENT ZFFSAB._.GearRatioByCurrents.GearRatioByCurrents_fl.iv_sts_n6_DirectionDiag "Direction flag of n6 rotation" FLOAT32_IEEE SAB_STANDARD_S2_S3 1 100 0 255 ECU_ADDRESS 0xFFF8DE54 FORMAT "%4.3" DISPLAY_IDENTIFIER iv_sts_n6_DirectionDiag.GearRatioByCurrents_fl.GearRatioByCurrents._.ZFFSAB /end MEASUREMENT
/begin MEASUREMENT ZFFSAB._.GearRatioByCurrents.GearRatioByCurrents_fl.iv_sts_n6_DirectionDiag_ "Complement of iv_sts_n6_DirectionDiag" FLOAT32_IEEE SAB_STANDARD_S2_S3 1 100 0 255 ECU_ADDRESS 0xFFF8DE58 FORMAT "%4.3" DISPLAY_IDENTIFIER iv_sts_n6_DirectionDiag_.GearRatioByCurrents_fl.GearRatioByCurrents._.ZFFSAB /end MEASUREMENT
/begin MEASUREMENT ZFFSAB._.GearRatioByCurrents.GearRatioByCurrents_fl.n_AbByWheelAvg "Calculated n_Ab using n_WheelAvg from CAN" FLOAT32_IEEE SAB_N_1RPM_S2_S3 1 100 0 65535 ECU_ADDRESS 0xFFF8DE74 FORMAT "%4.3" DISPLAY_IDENTIFIER n_AbByWheelAvg.GearRatioByCurrents_fl.GearRatioByCurrents._.ZFFSAB /end MEASUREMENT
/begin MEASUREMENT ZFFSAB._.GearRatioByCurrents.GearRatioByCurrents_fl.n_AbByWheelAvg_ "Complement of n_AbByWheelAvg" FLOAT32_IEEE SAB_STANDARD_S2_S3 1 100 0 65535 ECU_ADDRESS 0xFFF8DE9C FORMAT "%4.3" DISPLAY_IDENTIFIER n_AbByWheelAvg_.GearRatioByCurrents_fl.GearRatioByCurrents._.ZFFSAB /end MEASUREMENT
/begin MEASUREMENT ZFFSAB._.GearRatioByCurrents.GearRatioByCurrents_fl.n_TuVirtLev2 "Raw value of turbine rotational speed" FLOAT32_IEEE SAB_N_1RPM_S2_S3 1 100 0 65535 ECU_ADDRESS 0xFFF8DE7C FORMAT "%4.3" DISPLAY_IDENTIFIER n_TuVirtLev2.GearRatioByCurrents_fl.GearRatioByCurrents._.ZFFSAB /end MEASUREMENT
/begin MEASUREMENT ZFFSAB._.GearRatioByCurrents.GearRatioByCurrents_fl.n_TuVirtLev2Sts "Status of n_TuVirtLev2 0=OK 2=Calculation not possible" FLOAT32_IEEE SAB_STANDARD_S2_S3 1 100 0 2 ECU_ADDRESS 0xFFF8DE70 FORMAT "%4.3" DISPLAY_IDENTIFIER n_TuVirtLev2Sts.GearRatioByCurrents_fl.GearRatioByCurrents._.ZFFSAB /end MEASUREMENT
/begin MEASUREMENT ZFFSAB._.GearRatioByCurrents.GearRatioByCurrents_fl.n_TuVirtLev2_ "Complement of iv_n_Tu" FLOAT32_IEEE SAB_STANDARD_S2_S3 1 100 0 65535 ECU_ADDRESS 0xFFF8DEA4 FORMAT "%4.3" DISPLAY_IDENTIFIER n_TuVirtLev2_.GearRatioByCurrents_fl.GearRatioByCurrents._.ZFFSAB /end MEASUREMENT
/begin MEASUREMENT ZFFSAB._.GearRatioByCurrents.GearRatioByCurrents_fl.n_WheelAvgSts "Status of n_WheelAvg signal from CAN" FLOAT32_IEEE SAB_STANDARD_S2_S3 1 100 0 2 ECU_ADDRESS 0xFFF8DE78 FORMAT "%4.3" DISPLAY_IDENTIFIER n_WheelAvgSts.GearRatioByCurrents_fl.GearRatioByCurrents._.ZFFSAB /end MEASUREMENT
/begin MEASUREMENT ZFFSAB._.GearRatioByCurrents.GearRatioByCurrents_fl.n_WheelAvgSts_ "Complement of n_WheelAvgSts" FLOAT32_IEEE SAB_STANDARD_S2_S3 1 100 0 255 ECU_ADDRESS 0xFFF8DEA0 FORMAT "%4.3" DISPLAY_IDENTIFIER n_WheelAvgSts_.GearRatioByCurrents_fl.GearRatioByCurrents._.ZFFSAB /end MEASUREMENT
/begin MEASUREMENT ZFFSAB._.GearRatioByCurrents.GearRatioByCurrents_fl.sts_n6_Dir "Direction sign of n6 rotation 1=positive -1=negative 0=not defined" FLOAT32_IEEE SAB_STANDARD_S2_S3 1 100 0 255 ECU_ADDRESS 0xFFF8DE5C FORMAT "%4.3" DISPLAY_IDENTIFIER sts_n6_Dir.GearRatioByCurrents_fl.GearRatioByCurrents._.ZFFSAB /end MEASUREMENT
/begin MEASUREMENT ZFFSAB._.GearRatioByCurrents.GearRatioByCurrents_fl.sv_f_IAE_ReqSubst "Flag indicating a request to IAE to go to state over pressure" FLOAT32_IEEE SAB_STANDARD_S2_S3 1 100 0 1 ECU_ADDRESS 0xFFF8DE64 FORMAT "%4.3" DISPLAY_IDENTIFIER sv_f_IAE_ReqSubst.GearRatioByCurrents_fl.GearRatioByCurrents._.ZFFSAB /end MEASUREMENT
/begin MEASUREMENT ZFFSAB._.GearRatioByCurrents.GearRatioByCurrents_fl.sv_n_EngLev2 "Engine speed" FLOAT32_IEEE SAB_N_1RPM_S2_S3 1 100 0 65535 ECU_ADDRESS 0xFFF8DE8C FORMAT "%4.3" DISPLAY_IDENTIFIER sv_n_EngLev2.GearRatioByCurrents_fl.GearRatioByCurrents._.ZFFSAB /end MEASUREMENT
/begin MEASUREMENT ZFFSAB._.GearRatioByCurrents.GearRatioByCurrents_fl.sv_n_EngLev2Sts "Status of Engine speed" FLOAT32_IEEE SAB_STANDARD_S2_S3 1 100 0 2 ECU_ADDRESS 0xFFF8DE90 FORMAT "%4.3" DISPLAY_IDENTIFIER sv_n_EngLev2Sts.GearRatioByCurrents_fl.GearRatioByCurrents._.ZFFSAB /end MEASUREMENT
/begin MEASUREMENT ZFFSAB._.GearRatioByCurrents.GearRatioByCurrents_fl.sv_n_EngLev2Sts_ "Complement of sv_n_EngLev2Sts" FLOAT32_IEEE SAB_STANDARD_S2_S3 1 100 0 255 ECU_ADDRESS 0xFFF8DEB8 FORMAT "%4.3" DISPLAY_IDENTIFIER sv_n_EngLev2Sts_.GearRatioByCurrents_fl.GearRatioByCurrents._.ZFFSAB /end MEASUREMENT
/begin MEASUREMENT ZFFSAB._.GearRatioByCurrents.GearRatioByCurrents_fl.sv_n_EngLev2_ "Complement of sv_n_EngLev2" FLOAT32_IEEE SAB_STANDARD_S2_S3 1 100 0 65535 ECU_ADDRESS 0xFFF8DEB4 FORMAT "%4.3" DISPLAY_IDENTIFIER sv_n_EngLev2_.GearRatioByCurrents_fl.GearRatioByCurrents._.ZFFSAB /end MEASUREMENT
/begin MEASUREMENT ZFFSAB._.GearRatioByCurrents.GearRatioByCurrents_fl.sv_st_KL15 "Ignition state" FLOAT32_IEEE SAB_STANDARD_S2_S3 1 100 0 255 ECU_ADDRESS 0xFFF8DED4 FORMAT "%4.3" DISPLAY_IDENTIFIER sv_st_KL15.GearRatioByCurrents_fl.GearRatioByCurrents._.ZFFSAB /end MEASUREMENT
/begin MEASUREMENT ZFFSAB._.GearRatioByCurrents.GearRatioByCurrents_fl.sv_st_KL15_ "Complement of sv_st_KL15" FLOAT32_IEEE SAB_STANDARD_S2_S3 1 100 0 255 ECU_ADDRESS 0xFFF8DED8 FORMAT "%4.3" DISPLAY_IDENTIFIER sv_st_KL15_.GearRatioByCurrents_fl.GearRatioByCurrents._.ZFFSAB /end MEASUREMENT
/begin MEASUREMENT ZFFSAB._.GearRatioByCurrents.GearRatioByCurrents_fl.tmr_DiagDelayCurrentConst_LEV2.time "Description for this variable only in SW documentation possible not in asap2" ULONG SAB_T_TIMER_10MS_S2_S3 1 100 0 42949672950 ECU_ADDRESS 0xFFF8DDE0 DISPLAY_IDENTIFIER time.tmr_DiagDelayCurrentConst_LEV2.GearRatioByCurrents_fl.GearRatioByCurrents._.ZFFSAB /end MEASUREMENT
/begin MEASUREMENT ZFFSAB._.GearRatioByCurrents.GearRatioByCurrents_fl.tmr_DiagDelayCurrentConst_LEV2.time_ "Description for this variable only in SW documentation possible not in asap2" ULONG SAB_T_TIMER_10MS_S2_S3 1 100 0 42949672950 ECU_ADDRESS 0xFFF8DDE4 DISPLAY_IDENTIFIER time_.tmr_DiagDelayCurrentConst_LEV2.GearRatioByCurrents_fl.GearRatioByCurrents._.ZFFSAB /end MEASUREMENT
/begin MEASUREMENT ZFFSAB._.GearRatioByCurrents.GearRatioByCurrents_fl.tmr_IAECloseDelay_LEV2.time "Description for this variable only in SW documentation possible not in asap2" ULONG SAB_T_TIMER_10MS_S2_S3 1 100 0 42949672950 ECU_ADDRESS 0xFFF8DDF8 DISPLAY_IDENTIFIER time.tmr_IAECloseDelay_LEV2.GearRatioByCurrents_fl.GearRatioByCurrents._.ZFFSAB /end MEASUREMENT
/begin MEASUREMENT ZFFSAB._.GearRatioByCurrents.GearRatioByCurrents_fl.tmr_IAECloseDelay_LEV2.time_ "Description for this variable only in SW documentation possible not in asap2" ULONG SAB_T_TIMER_10MS_S2_S3 1 100 0 42949672950 ECU_ADDRESS 0xFFF8DDFC DISPLAY_IDENTIFIER time_.tmr_IAECloseDelay_LEV2.GearRatioByCurrents_fl.GearRatioByCurrents._.ZFFSAB /end MEASUREMENT
/begin MEASUREMENT ZFFSAB._.GearRatioByCurrents.GearRatioByCurrents_fl.tmr_IAEClose_LEV2.time "Description for this variable only in SW documentation possible not in asap2" ULONG SAB_T_TIMER_10MS_S2_S3 1 100 0 42949672950 ECU_ADDRESS 0xFFF8DDF0 DISPLAY_IDENTIFIER time.tmr_IAEClose_LEV2.GearRatioByCurrents_fl.GearRatioByCurrents._.ZFFSAB /end MEASUREMENT
/begin MEASUREMENT ZFFSAB._.GearRatioByCurrents.GearRatioByCurrents_fl.tmr_IAEClose_LEV2.time_ "Description for this variable only in SW documentation possible not in asap2" ULONG SAB_T_TIMER_10MS_S2_S3 1 100 0 42949672950 ECU_ADDRESS 0xFFF8DDF4 DISPLAY_IDENTIFIER time_.tmr_IAEClose_LEV2.GearRatioByCurrents_fl.GearRatioByCurrents._.ZFFSAB /end MEASUREMENT
/begin MEASUREMENT ZFFSAB._.GearRatioByCurrents.GearRatioByCurrents_fl.tmr_nTuVirtLev2Delay_LEV2.time "Description for this variable only in SW documentation possible not in asap2" ULONG SAB_T_TIMER_10MS_S2_S3 1 100 0 42949672950 ECU_ADDRESS 0xFFF8DE00 DISPLAY_IDENTIFIER time.tmr_nTuVirtLev2Delay_LEV2.GearRatioByCurrents_fl.GearRatioByCurrents._.ZFFSAB /end MEASUREMENT
/begin MEASUREMENT ZFFSAB._.GearRatioByCurrents.GearRatioByCurrents_fl.tmr_nTuVirtLev2Delay_LEV2.time_ "Description for this variable only in SW documentation possible not in asap2" ULONG SAB_T_TIMER_10MS_S2_S3 1 100 0 42949672950 ECU_ADDRESS 0xFFF8DE04 DISPLAY_IDENTIFIER time_.tmr_nTuVirtLev2Delay_LEV2.GearRatioByCurrents_fl.GearRatioByCurrents._.ZFFSAB /end MEASUREMENT
/begin MEASUREMENT ZFFSAB._.GearRatioByCurrents.GearRatioByCurrents_fl.tmr_nTuVirtPlausiErrDelay_LEV2.time "Description for this variable only in SW documentation possible not in asap2" ULONG SAB_T_TIMER_10MS_S2_S3 1 100 0 42949672950 ECU_ADDRESS 0xFFF8DE08 DISPLAY_IDENTIFIER time.tmr_nTuVirtPlausiErrDelay_LEV2.GearRatioByCurrents_fl.GearRatioByCurrents._.ZFFSAB /end MEASUREMENT
/begin MEASUREMENT ZFFSAB._.GearRatioByCurrents.GearRatioByCurrents_fl.tmr_nTuVirtPlausiErrDelay_LEV2.time_ "Description for this variable only in SW documentation possible not in asap2" ULONG SAB_T_TIMER_10MS_S2_S3 1 100 0 42949672950 ECU_ADDRESS 0xFFF8DE0C DISPLAY_IDENTIFIER time_.tmr_nTuVirtPlausiErrDelay_LEV2.GearRatioByCurrents_fl.GearRatioByCurrents._.ZFFSAB /end MEASUREMENT
/begin MEASUREMENT ZFFSAB._.GearRatioByCurrents.GearRatioByCurrents_fl.tmr_t_nDiagDelay_LEV2.time "Description for this variable only in SW documentation possible not in asap2" ULONG SAB_T_TIMER_10MS_S2_S3 1 100 0 42949672950 ECU_ADDRESS 0xFFF8DDE8 DISPLAY_IDENTIFIER time.tmr_t_nDiagDelay_LEV2.GearRatioByCurrents_fl.GearRatioByCurrents._.ZFFSAB /end MEASUREMENT
/begin MEASUREMENT ZFFSAB._.GearRatioByCurrents.GearRatioByCurrents_fl.tmr_t_nDiagDelay_LEV2.time_ "Description for this variable only in SW documentation possible not in asap2" ULONG SAB_T_TIMER_10MS_S2_S3 1 100 0 42949672950 ECU_ADDRESS 0xFFF8DDEC DISPLAY_IDENTIFIER time_.tmr_t_nDiagDelay_LEV2.GearRatioByCurrents_fl.GearRatioByCurrents._.ZFFSAB /end MEASUREMENT
/begin MEASUREMENT ZFFSAB._.GearRatioByCurrents.IstGang "Calculated gear with different definition: 255=not defined 0=backward 1..8 forward" UBYTE SAB_STANDARD_S2_S3 1 100 0 255 ECU_ADDRESS 0xFFF8DF00 DISPLAY_IDENTIFIER IstGang.GearRatioByCurrents._.ZFFSAB /end MEASUREMENT
/begin MEASUREMENT ZFFSAB._.GearRatioByCurrents.IstGangOld "Old value of calculated gear" UBYTE SAB_STANDARD_S2_S3 1 100 0 255 ECU_ADDRESS 0xFFF8DF01 DISPLAY_IDENTIFIER IstGangOld.GearRatioByCurrents._.ZFFSAB /end MEASUREMENT
/begin MEASUREMENT ZFFSAB._.GearRatioByCurrents.err_flags_old "Packed error flags to be stored in EEPROM Bits: 2: f_n_AbWheelErr 1: f_n_AbTuErr 0: f_n_TuWheelErr" UBYTE SAB_STANDARD_S2_S3 1 100 0 255 ECU_ADDRESS 0xFFF8DF37 DISPLAY_IDENTIFIER err_flags_old.GearRatioByCurrents._.ZFFSAB /end MEASUREMENT
/begin MEASUREMENT ZFFSAB._.GearRatioByCurrents.err_flags_old_ "Complement of err_flags_old" UBYTE SAB_STANDARD_S2_S3 1 100 0 255 ECU_ADDRESS 0xFFF8DF38 DISPLAY_IDENTIFIER err_flags_old_.GearRatioByCurrents._.ZFFSAB /end MEASUREMENT
/begin MEASUREMENT ZFFSAB._.GearRatioByCurrents.f_RearAxleRatioLearned "Flag indicating that rear axle ratio is learned or learn function is disabled" UBYTE SAB_STANDARD_S2_S3 1 100 0 1 ECU_ADDRESS 0xFFF8DF21 DISPLAY_IDENTIFIER f_RearAxleRatioLearned.GearRatioByCurrents._.ZFFSAB /end MEASUREMENT
/begin MEASUREMENT ZFFSAB._.GearRatioByCurrents.f_RearAxleRatioLearned_ "Complement of f_RearAxleRatioLearned" UBYTE SAB_STANDARD_S2_S3 1 100 0 255 ECU_ADDRESS 0xFFF8DF22 DISPLAY_IDENTIFIER f_RearAxleRatioLearned_.GearRatioByCurrents._.ZFFSAB /end MEASUREMENT
/begin MEASUREMENT ZFFSAB._.GearRatioByCurrents.f_n6PlausiErr "Flag indicating that n_Tu is not plausible to CAN n_Wheel and n_Ab" UBYTE SAB_STANDARD_S2_S3 1 100 0 1 ECU_ADDRESS 0xFFF8DF3D DISPLAY_IDENTIFIER f_n6PlausiErr.GearRatioByCurrents._.ZFFSAB /end MEASUREMENT
/begin MEASUREMENT ZFFSAB._.GearRatioByCurrents.f_n6PlausiErr_ "Complement of flag f_n_InPlausiErr" UBYTE SAB_STANDARD_S2_S3 1 100 0 255 ECU_ADDRESS 0xFFF8DF41 DISPLAY_IDENTIFIER f_n6PlausiErr_.GearRatioByCurrents._.ZFFSAB /end MEASUREMENT
/begin MEASUREMENT ZFFSAB._.GearRatioByCurrents.f_n6WheelErr "Flag indicating that n_Tu and CAN n_Wheel are not plausible to each other" UBYTE SAB_STANDARD_S2_S3 1 100 0 1 ECU_ADDRESS 0xFFF8DF35 DISPLAY_IDENTIFIER f_n6WheelErr.GearRatioByCurrents._.ZFFSAB /end MEASUREMENT
/begin MEASUREMENT ZFFSAB._.GearRatioByCurrents.f_n6WheelErr_ "Complement of flag f_n_InWheelErr" UBYTE SAB_STANDARD_S2_S3 1 100 0 255 ECU_ADDRESS 0xFFF8DF47 DISPLAY_IDENTIFIER f_n6WheelErr_.GearRatioByCurrents._.ZFFSAB /end MEASUREMENT
/begin MEASUREMENT ZFFSAB._.GearRatioByCurrents.f_n6nEngErr "Flag indicating that n6 and nEM are not plausible to each other" UBYTE SAB_STANDARD_S2_S3 1 100 0 1 ECU_ADDRESS 0xFFF8DF0D DISPLAY_IDENTIFIER f_n6nEngErr.GearRatioByCurrents._.ZFFSAB /end MEASUREMENT
/begin MEASUREMENT ZFFSAB._.GearRatioByCurrents.f_n_AbPlausiErr "Flag indicating that n_Ab is not plausible to CAN n_Wheel and n_Tu" UBYTE SAB_STANDARD_S2_S3 1 100 0 1 ECU_ADDRESS 0xFFF8DF3B DISPLAY_IDENTIFIER f_n_AbPlausiErr.GearRatioByCurrents._.ZFFSAB /end MEASUREMENT
/begin MEASUREMENT ZFFSAB._.GearRatioByCurrents.f_n_AbPlausiErr_ "Complement of flag f_n_AbPlausiErr" UBYTE SAB_STANDARD_S2_S3 1 100 0 255 ECU_ADDRESS 0xFFF8DF3F DISPLAY_IDENTIFIER f_n_AbPlausiErr_.GearRatioByCurrents._.ZFFSAB /end MEASUREMENT
/begin MEASUREMENT ZFFSAB._.GearRatioByCurrents.f_n_AbWheelErr "Flag indicating that n_Ab and CAN n_Wheel are not plausible to each other" UBYTE SAB_STANDARD_S2_S3 1 100 0 1 ECU_ADDRESS 0xFFF8DF33 DISPLAY_IDENTIFIER f_n_AbWheelErr.GearRatioByCurrents._.ZFFSAB /end MEASUREMENT
/begin MEASUREMENT ZFFSAB._.GearRatioByCurrents.f_n_AbWheelErr_ "Complement of flag f_n_AbWheelErr" UBYTE SAB_STANDARD_S2_S3 1 100 0 255 ECU_ADDRESS 0xFFF8DF48 DISPLAY_IDENTIFIER f_n_AbWheelErr_.GearRatioByCurrents._.ZFFSAB /end MEASUREMENT
/begin MEASUREMENT ZFFSAB._.GearRatioByCurrents.f_n_Abn6Err "Flag indicating that n_Ab and n_Tu are not plausible to each other" UBYTE SAB_STANDARD_S2_S3 1 100 0 1 ECU_ADDRESS 0xFFF8DF34 DISPLAY_IDENTIFIER f_n_Abn6Err.GearRatioByCurrents._.ZFFSAB /end MEASUREMENT
/begin MEASUREMENT ZFFSAB._.GearRatioByCurrents.f_n_Abn6Err_ "Complement of flag f_n_AbInErr" UBYTE SAB_STANDARD_S2_S3 1 100 0 255 ECU_ADDRESS 0xFFF8DF46 DISPLAY_IDENTIFIER f_n_Abn6Err_.GearRatioByCurrents._.ZFFSAB /end MEASUREMENT
/begin MEASUREMENT ZFFSAB._.GearRatioByCurrents.f_n_PlausiErr "Flag indicating that there are more than two signals of n_Ab n_Tu and n_Wheel have failed" UBYTE SAB_STANDARD_S2_S3 1 100 0 1 ECU_ADDRESS 0xFFF8DF3E DISPLAY_IDENTIFIER f_n_PlausiErr.GearRatioByCurrents._.ZFFSAB /end MEASUREMENT
/begin MEASUREMENT ZFFSAB._.GearRatioByCurrents.f_n_PlausiErr_ "Complement of flag f_n_PlausiErr" UBYTE SAB_STANDARD_S2_S3 1 100 0 255 ECU_ADDRESS 0xFFF8DF42 DISPLAY_IDENTIFIER f_n_PlausiErr_.GearRatioByCurrents._.ZFFSAB /end MEASUREMENT
/begin MEASUREMENT ZFFSAB._.GearRatioByCurrents.f_n_TuVirtPlausiErr "Flag indicating that iv_n_Tu = n_TuVirt Lev1 and n_TuVirtLev2 are not plausible to each other" UBYTE SAB_STANDARD_S2_S3 1 100 0 1 ECU_ADDRESS 0xFFF8DF0E DISPLAY_IDENTIFIER f_n_TuVirtPlausiErr.GearRatioByCurrents._.ZFFSAB /end MEASUREMENT
/begin MEASUREMENT ZFFSAB._.GearRatioByCurrents.f_n_TuVirtPlausiErr_ "Complement of f_n_TuVirtPlausiErr" UBYTE SAB_STANDARD_S2_S3 1 100 0 255 ECU_ADDRESS 0xFFF8DF0F DISPLAY_IDENTIFIER f_n_TuVirtPlausiErr_.GearRatioByCurrents._.ZFFSAB /end MEASUREMENT
/begin MEASUREMENT ZFFSAB._.GearRatioByCurrents.f_n_WheelPlausiErr "Flag indicating that CAN n_Wheel is not plausible to n_Ab and n_Tu" UBYTE SAB_STANDARD_S2_S3 1 100 0 1 ECU_ADDRESS 0xFFF8DF3C DISPLAY_IDENTIFIER f_n_WheelPlausiErr.GearRatioByCurrents._.ZFFSAB /end MEASUREMENT
/begin MEASUREMENT ZFFSAB._.GearRatioByCurrents.f_n_WheelPlausiErr_ "Complement of flag f_n_WheelPlausiErr" UBYTE SAB_STANDARD_S2_S3 1 100 0 255 ECU_ADDRESS 0xFFF8DF40 DISPLAY_IDENTIFIER f_n_WheelPlausiErr_.GearRatioByCurrents._.ZFFSAB /end MEASUREMENT
/begin MEASUREMENT ZFFSAB._.GearRatioByCurrents.f_xErrChanged "Flag indicating that one of the f_n_*Err flags has changed from 0 to 1" UBYTE SAB_STANDARD_S2_S3 1 100 0 1 ECU_ADDRESS 0xFFF8DF36 DISPLAY_IDENTIFIER f_xErrChanged.GearRatioByCurrents._.ZFFSAB /end MEASUREMENT
/begin MEASUREMENT ZFFSAB._.GearRatioByCurrents.iGang "Calculated gear ratio" UWORD SAB_K1000_S2_S3 1 100 0 65.535 ECU_ADDRESS 0xFFF8DEFE DISPLAY_IDENTIFIER iGang.GearRatioByCurrents._.ZFFSAB /end MEASUREMENT
/begin MEASUREMENT ZFFSAB._.GearRatioByCurrents.iGang_ "Complement of Calculated gear ratio" UWORD SAB_STANDARD_S2_S3 1 100 0 65535 ECU_ADDRESS 0xFFF8DF44 DISPLAY_IDENTIFIER iGang_.GearRatioByCurrents._.ZFFSAB /end MEASUREMENT
/begin MEASUREMENT ZFFSAB._.GearRatioByCurrents.iv_ieds0 "Input value for electric current of actuator IEDS0 - connected to gearbox clutch A" UWORD SAB_I_MA10_S2_S3 1 100 0 6553.5 ECU_ADDRESS 0xFFF8DEEC DISPLAY_IDENTIFIER iv_ieds0.GearRatioByCurrents._.ZFFSAB /end MEASUREMENT
/begin MEASUREMENT ZFFSAB._.GearRatioByCurrents.iv_ieds0_ "Complement of input value for electric current of actuator IEDS0" UWORD SAB_STANDARD_S2_S3 1 100 0 65535 ECU_ADDRESS 0xFFF8DEF4 DISPLAY_IDENTIFIER iv_ieds0_.GearRatioByCurrents._.ZFFSAB /end MEASUREMENT
/begin MEASUREMENT ZFFSAB._.GearRatioByCurrents.iv_ieds1 "Input value for electric current of actuator IEDS1 - connected to gearbox clutch D" UWORD SAB_I_MA10_S2_S3 1 100 0 6553.5 ECU_ADDRESS 0xFFF8DEEE DISPLAY_IDENTIFIER iv_ieds1.GearRatioByCurrents._.ZFFSAB /end MEASUREMENT
/begin MEASUREMENT ZFFSAB._.GearRatioByCurrents.iv_ieds1_ "Complement of input value for electric current of actuator IEDS1" UWORD SAB_STANDARD_S2_S3 1 100 0 65535 ECU_ADDRESS 0xFFF8DEF6 DISPLAY_IDENTIFIER iv_ieds1_.GearRatioByCurrents._.ZFFSAB /end MEASUREMENT
/begin MEASUREMENT ZFFSAB._.GearRatioByCurrents.iv_ieds3 "Input value for electric current of actuator IEDS3 - connected to gearbox clutch E" UWORD SAB_I_MA10_S2_S3 1 100 0 6553.5 ECU_ADDRESS 0xFFF8DEF0 DISPLAY_IDENTIFIER iv_ieds3.GearRatioByCurrents._.ZFFSAB /end MEASUREMENT
/begin MEASUREMENT ZFFSAB._.GearRatioByCurrents.iv_ieds3_ "Complement of input value for electric current of actuator IEDS3" UWORD SAB_STANDARD_S2_S3 1 100 0 65535 ECU_ADDRESS 0xFFF8DEF8 DISPLAY_IDENTIFIER iv_ieds3_.GearRatioByCurrents._.ZFFSAB /end MEASUREMENT
/begin MEASUREMENT ZFFSAB._.GearRatioByCurrents.iv_ieds4 "Input value for electric current of actuator IEDS4 - connected to gearbox clutch C" UWORD SAB_I_MA10_S2_S3 1 100 0 6553.5 ECU_ADDRESS 0xFFF8DEF2 DISPLAY_IDENTIFIER iv_ieds4.GearRatioByCurrents._.ZFFSAB /end MEASUREMENT
/begin MEASUREMENT ZFFSAB._.GearRatioByCurrents.iv_ieds4_ "Complement of input value for electric current of actuator IEDS4" UWORD SAB_STANDARD_S2_S3 1 100 0 65535 ECU_ADDRESS 0xFFF8DEFA DISPLAY_IDENTIFIER iv_ieds4_.GearRatioByCurrents._.ZFFSAB /end MEASUREMENT
/begin MEASUREMENT ZFFSAB._.GearRatioByCurrents.iv_n6 "Raw value of shaft 6 rotational speed" UWORD SAB_N_1RPM_S2_S3 1 100 0 65535 ECU_ADDRESS 0xFFF8DF06 DISPLAY_IDENTIFIER iv_n6.GearRatioByCurrents._.ZFFSAB /end MEASUREMENT
/begin MEASUREMENT ZFFSAB._.GearRatioByCurrents.iv_n6_ "Complement of iv_n6" UWORD SAB_STANDARD_S2_S3 1 100 0 65535 ECU_ADDRESS 0xFFF8DF08 DISPLAY_IDENTIFIER iv_n6_.GearRatioByCurrents._.ZFFSAB /end MEASUREMENT
/begin MEASUREMENT ZFFSAB._.GearRatioByCurrents.iv_n6_ESts "Electrical status of turbine rotational speed" UBYTE SAB_STANDARD_S2_S3 1 100 0 2 ECU_ADDRESS 0xFFF8DF18 DISPLAY_IDENTIFIER iv_n6_ESts.GearRatioByCurrents._.ZFFSAB /end MEASUREMENT
/begin MEASUREMENT ZFFSAB._.GearRatioByCurrents.iv_n6_ESts_ "Complement of iv_n_TuESts" UBYTE SAB_STANDARD_S2_S3 1 100 0 255 ECU_ADDRESS 0xFFF8DF2A DISPLAY_IDENTIFIER iv_n6_ESts_.GearRatioByCurrents._.ZFFSAB /end MEASUREMENT
/begin MEASUREMENT ZFFSAB._.GearRatioByCurrents.iv_n_Ab "Raw value of Transmission output rotational speed" UWORD SAB_N_1RPM_S2_S3 1 100 0 65535 ECU_ADDRESS 0xFFF8DF1A DISPLAY_IDENTIFIER iv_n_Ab.GearRatioByCurrents._.ZFFSAB /end MEASUREMENT
/begin MEASUREMENT ZFFSAB._.GearRatioByCurrents.iv_n_AbESts "Electrical status of transmission output rotational speed" UBYTE SAB_STANDARD_S2_S3 1 100 0 2 ECU_ADDRESS 0xFFF8DF1C DISPLAY_IDENTIFIER iv_n_AbESts.GearRatioByCurrents._.ZFFSAB /end MEASUREMENT
/begin MEASUREMENT ZFFSAB._.GearRatioByCurrents.iv_n_AbESts_ "Complement of iv_n_AbESts" UBYTE SAB_STANDARD_S2_S3 1 100 0 255 ECU_ADDRESS 0xFFF8DF2E DISPLAY_IDENTIFIER iv_n_AbESts_.GearRatioByCurrents._.ZFFSAB /end MEASUREMENT
/begin MEASUREMENT ZFFSAB._.GearRatioByCurrents.iv_n_Ab_ "Complement of iv_n_Ab" UWORD SAB_STANDARD_S2_S3 1 100 0 65535 ECU_ADDRESS 0xFFF8DF2C DISPLAY_IDENTIFIER iv_n_Ab_.GearRatioByCurrents._.ZFFSAB /end MEASUREMENT
/begin MEASUREMENT ZFFSAB._.GearRatioByCurrents.iv_n_Tu "Is the n_TuVirt of Lev1 calculation" UWORD SAB_N_1RPM_S2_S3 1 100 0 65535 ECU_ADDRESS 0xFFF8DF02 DISPLAY_IDENTIFIER iv_n_Tu.GearRatioByCurrents._.ZFFSAB /end MEASUREMENT
/begin MEASUREMENT ZFFSAB._.GearRatioByCurrents.iv_n_Tu_ "Complement of iv_n_Tu" UWORD SAB_STANDARD_S2_S3 1 100 0 65535 ECU_ADDRESS 0xFFF8DF04 DISPLAY_IDENTIFIER iv_n_Tu_.GearRatioByCurrents._.ZFFSAB /end MEASUREMENT
/begin MEASUREMENT ZFFSAB._.GearRatioByCurrents.iv_sts_ClutchIAE "State of the IAE aka clutch B" UBYTE SAB_STANDARD_S2_S3 1 100 0 255 ECU_ADDRESS 0xFFF8DEFC DISPLAY_IDENTIFIER iv_sts_ClutchIAE.GearRatioByCurrents._.ZFFSAB /end MEASUREMENT
/begin MEASUREMENT ZFFSAB._.GearRatioByCurrents.iv_sts_n6_DirectionDiag "Direction flag of n6 rotation" UBYTE SAB_STANDARD_S2_S3 1 100 0 255 ECU_ADDRESS 0xFFF8DF0A DISPLAY_IDENTIFIER iv_sts_n6_DirectionDiag.GearRatioByCurrents._.ZFFSAB /end MEASUREMENT
/begin MEASUREMENT ZFFSAB._.GearRatioByCurrents.iv_sts_n6_DirectionDiag_ "Complement of iv_sts_n6_DirectionDiag" UBYTE SAB_STANDARD_S2_S3 1 100 0 255 ECU_ADDRESS 0xFFF8DF0B DISPLAY_IDENTIFIER iv_sts_n6_DirectionDiag_.GearRatioByCurrents._.ZFFSAB /end MEASUREMENT
/begin MEASUREMENT ZFFSAB._.GearRatioByCurrents.n_AbByWheelAvg "Calculated n_Ab using n_Wheel average from CAN" UWORD SAB_N_1RPM_S2_S3 1 100 0 65535 ECU_ADDRESS 0xFFF8DF12 DISPLAY_IDENTIFIER n_AbByWheelAvg.GearRatioByCurrents._.ZFFSAB /end MEASUREMENT
/begin MEASUREMENT ZFFSAB._.GearRatioByCurrents.n_AbByWheelAvg_ "Complement of n_AbByWheelAvg" UWORD SAB_STANDARD_S2_S3 1 100 0 65535 ECU_ADDRESS 0xFFF8DF24 DISPLAY_IDENTIFIER n_AbByWheelAvg_.GearRatioByCurrents._.ZFFSAB /end MEASUREMENT
/begin MEASUREMENT ZFFSAB._.GearRatioByCurrents.n_TuVirtLev2 "Raw value of turbine rotational speed" UWORD SAB_N_1RPM_S2_S3 1 100 0 65535 ECU_ADDRESS 0xFFF8DF16 DISPLAY_IDENTIFIER n_TuVirtLev2.GearRatioByCurrents._.ZFFSAB /end MEASUREMENT
/begin MEASUREMENT ZFFSAB._.GearRatioByCurrents.n_TuVirtLev2Sts "Status of n_TuVirtLev2 0=OK 2=Calculation not possible" UBYTE SAB_STANDARD_S2_S3 1 100 0 2 ECU_ADDRESS 0xFFF8DF10 DISPLAY_IDENTIFIER n_TuVirtLev2Sts.GearRatioByCurrents._.ZFFSAB /end MEASUREMENT
/begin MEASUREMENT ZFFSAB._.GearRatioByCurrents.n_TuVirtLev2Sts_ "Complement of n_TuVirtLev2Sts" UBYTE SAB_STANDARD_S2_S3 1 100 0 255 ECU_ADDRESS 0xFFF8DF11 DISPLAY_IDENTIFIER n_TuVirtLev2Sts_.GearRatioByCurrents._.ZFFSAB /end MEASUREMENT
/begin MEASUREMENT ZFFSAB._.GearRatioByCurrents.n_TuVirtLev2_ "Complement of iv_n_Tu" UWORD SAB_STANDARD_S2_S3 1 100 0 65535 ECU_ADDRESS 0xFFF8DF28 DISPLAY_IDENTIFIER n_TuVirtLev2_.GearRatioByCurrents._.ZFFSAB /end MEASUREMENT
/begin MEASUREMENT ZFFSAB._.GearRatioByCurrents.n_WheelAvgSts "Status of n_Wheel average signal from CAN" UBYTE SAB_STANDARD_S2_S3 1 100 0 2 ECU_ADDRESS 0xFFF8DF14 DISPLAY_IDENTIFIER n_WheelAvgSts.GearRatioByCurrents._.ZFFSAB /end MEASUREMENT
/begin MEASUREMENT ZFFSAB._.GearRatioByCurrents.n_WheelAvgSts_ "Complement of n_WheelAvgSts" UBYTE SAB_STANDARD_S2_S3 1 100 0 255 ECU_ADDRESS 0xFFF8DF26 DISPLAY_IDENTIFIER n_WheelAvgSts_.GearRatioByCurrents._.ZFFSAB /end MEASUREMENT
/begin MEASUREMENT ZFFSAB._.GearRatioByCurrents.sts_n6_Dir "Direction sign of n6 rotation 1=positive -1=negative 0=not defined" SBYTE SAB_STANDARD_S2_S3 1 100 -128 127 ECU_ADDRESS 0xFFF8DF0C DISPLAY_IDENTIFIER sts_n6_Dir.GearRatioByCurrents._.ZFFSAB /end MEASUREMENT
/begin MEASUREMENT ZFFSAB._.GearRatioByCurrents.sv_f_IAE_ReqSubst "Output signal indicating an IEA over closed request 0=No request to IAE - 1=Request to IAE active" UBYTE SAB_STANDARD_S2_S3 1 100 0 1 ECU_ADDRESS 0xFFF8DEFD DISPLAY_IDENTIFIER sv_f_IAE_ReqSubst.GearRatioByCurrents._.ZFFSAB /end MEASUREMENT
/begin MEASUREMENT ZFFSAB._.GearRatioByCurrents.sv_n_EngLev2 "Engine speed" UWORD SAB_N_1RPM_S2_S3 1 100 0 65535 ECU_ADDRESS 0xFFF8DF1E DISPLAY_IDENTIFIER sv_n_EngLev2.GearRatioByCurrents._.ZFFSAB /end MEASUREMENT
/begin MEASUREMENT ZFFSAB._.GearRatioByCurrents.sv_n_EngLev2Sts "Status of Engine speed" UBYTE SAB_STANDARD_S2_S3 1 100 0 2 ECU_ADDRESS 0xFFF8DF20 DISPLAY_IDENTIFIER sv_n_EngLev2Sts.GearRatioByCurrents._.ZFFSAB /end MEASUREMENT
/begin MEASUREMENT ZFFSAB._.GearRatioByCurrents.sv_n_EngLev2Sts_ "Complement of sv_n_EngLev2Sts" UBYTE SAB_STANDARD_S2_S3 1 100 0 255 ECU_ADDRESS 0xFFF8DF32 DISPLAY_IDENTIFIER sv_n_EngLev2Sts_.GearRatioByCurrents._.ZFFSAB /end MEASUREMENT
/begin MEASUREMENT ZFFSAB._.GearRatioByCurrents.sv_n_EngLev2_ "Complement of sv_n_EngLev2" UWORD SAB_STANDARD_S2_S3 1 100 0 65535 ECU_ADDRESS 0xFFF8DF30 DISPLAY_IDENTIFIER sv_n_EngLev2_.GearRatioByCurrents._.ZFFSAB /end MEASUREMENT
/begin MEASUREMENT ZFFSAB._.GearRatioByCurrents.sv_st_KL15 "Ignition state" UBYTE SAB_STANDARD_S2_S3 1 100 0 255 ECU_ADDRESS 0xFFF8DF39 DISPLAY_IDENTIFIER sv_st_KL15.GearRatioByCurrents._.ZFFSAB /end MEASUREMENT
/begin MEASUREMENT ZFFSAB._.GearRatioByCurrents.sv_st_KL15_ "Complement of sv_st_KL15" UBYTE SAB_STANDARD_S2_S3 1 100 0 255 ECU_ADDRESS 0xFFF8DF3A DISPLAY_IDENTIFIER sv_st_KL15_.GearRatioByCurrents._.ZFFSAB /end MEASUREMENT
/begin MEASUREMENT ZFFSAB._.GearRatioByCurrents.tmr_DiagDelayCurrentConst_LEV2.time "Description for this variable only in SW documentation possible not in asap2" ULONG SAB_T_TIMER_10MS_S2_S3 1 100 0 42949672950 ECU_ADDRESS 0xFFF8DD94 DISPLAY_IDENTIFIER time.tmr_DiagDelayCurrentConst_LEV2.GearRatioByCurrents._.ZFFSAB /end MEASUREMENT
/begin MEASUREMENT ZFFSAB._.GearRatioByCurrents.tmr_DiagDelayCurrentConst_LEV2.time_ "Description for this variable only in SW documentation possible not in asap2" ULONG SAB_T_TIMER_10MS_S2_S3 1 100 0 42949672950 ECU_ADDRESS 0xFFF8DD98 DISPLAY_IDENTIFIER time_.tmr_DiagDelayCurrentConst_LEV2.GearRatioByCurrents._.ZFFSAB /end MEASUREMENT
/begin MEASUREMENT ZFFSAB._.GearRatioByCurrents.tmr_IAECloseDelay_LEV2.time "Description for this variable only in SW documentation possible not in asap2" ULONG SAB_T_TIMER_10MS_S2_S3 1 100 0 42949672950 ECU_ADDRESS 0xFFF8DDAC DISPLAY_IDENTIFIER time.tmr_IAECloseDelay_LEV2.GearRatioByCurrents._.ZFFSAB /end MEASUREMENT
/begin MEASUREMENT ZFFSAB._.GearRatioByCurrents.tmr_IAECloseDelay_LEV2.time_ "Description for this variable only in SW documentation possible not in asap2" ULONG SAB_T_TIMER_10MS_S2_S3 1 100 0 42949672950 ECU_ADDRESS 0xFFF8DDB0 DISPLAY_IDENTIFIER time_.tmr_IAECloseDelay_LEV2.GearRatioByCurrents._.ZFFSAB /end MEASUREMENT
/begin MEASUREMENT ZFFSAB._.GearRatioByCurrents.tmr_IAEClose_LEV2.time "Description for this variable only in SW documentation possible not in asap2" ULONG SAB_T_TIMER_10MS_S2_S3 1 100 0 42949672950 ECU_ADDRESS 0xFFF8DDA4 DISPLAY_IDENTIFIER time.tmr_IAEClose_LEV2.GearRatioByCurrents._.ZFFSAB /end MEASUREMENT
/begin MEASUREMENT ZFFSAB._.GearRatioByCurrents.tmr_IAEClose_LEV2.time_ "Description for this variable only in SW documentation possible not in asap2" ULONG SAB_T_TIMER_10MS_S2_S3 1 100 0 42949672950 ECU_ADDRESS 0xFFF8DDA8 DISPLAY_IDENTIFIER time_.tmr_IAEClose_LEV2.GearRatioByCurrents._.ZFFSAB /end MEASUREMENT
/begin MEASUREMENT ZFFSAB._.GearRatioByCurrents.tmr_nTuVirtLev2Delay_LEV2.time "Description for this variable only in SW documentation possible not in asap2" ULONG SAB_T_TIMER_10MS_S2_S3 1 100 0 42949672950 ECU_ADDRESS 0xFFF8DDB4 DISPLAY_IDENTIFIER time.tmr_nTuVirtLev2Delay_LEV2.GearRatioByCurrents._.ZFFSAB /end MEASUREMENT
/begin MEASUREMENT ZFFSAB._.GearRatioByCurrents.tmr_nTuVirtLev2Delay_LEV2.time_ "Description for this variable only in SW documentation possible not in asap2" ULONG SAB_T_TIMER_10MS_S2_S3 1 100 0 42949672950 ECU_ADDRESS 0xFFF8DDB8 DISPLAY_IDENTIFIER time_.tmr_nTuVirtLev2Delay_LEV2.GearRatioByCurrents._.ZFFSAB /end MEASUREMENT
/begin MEASUREMENT ZFFSAB._.GearRatioByCurrents.tmr_nTuVirtPlausiErrDelay_LEV2.time "Description for this variable only in SW documentation possible not in asap2" ULONG SAB_T_TIMER_10MS_S2_S3 1 100 0 42949672950 ECU_ADDRESS 0xFFF8DDBC DISPLAY_IDENTIFIER time.tmr_nTuVirtPlausiErrDelay_LEV2.GearRatioByCurrents._.ZFFSAB /end MEASUREMENT
/begin MEASUREMENT ZFFSAB._.GearRatioByCurrents.tmr_nTuVirtPlausiErrDelay_LEV2.time_ "Description for this variable only in SW documentation possible not in asap2" ULONG SAB_T_TIMER_10MS_S2_S3 1 100 0 42949672950 ECU_ADDRESS 0xFFF8DDC0 DISPLAY_IDENTIFIER time_.tmr_nTuVirtPlausiErrDelay_LEV2.GearRatioByCurrents._.ZFFSAB /end MEASUREMENT
/begin MEASUREMENT ZFFSAB._.GearRatioByCurrents.tmr_t_nDiagDelay_LEV2.time "Description for this variable only in SW documentation possible not in asap2" ULONG SAB_T_TIMER_10MS_S2_S3 1 100 0 42949672950 ECU_ADDRESS 0xFFF8DD9C DISPLAY_IDENTIFIER time.tmr_t_nDiagDelay_LEV2.GearRatioByCurrents._.ZFFSAB /end MEASUREMENT
/begin MEASUREMENT ZFFSAB._.GearRatioByCurrents.tmr_t_nDiagDelay_LEV2.time_ "Description for this variable only in SW documentation possible not in asap2" ULONG SAB_T_TIMER_10MS_S2_S3 1 100 0 42949672950 ECU_ADDRESS 0xFFF8DDA0 DISPLAY_IDENTIFIER time_.tmr_t_nDiagDelay_LEV2.GearRatioByCurrents._.ZFFSAB /end MEASUREMENT
/begin MEASUREMENT ZFFSAB._.GearboxTempIn.GearboxTempInFl.iv_c_Chip2Trans "Input raw signal substrate temperature Sensor 2(LM71)" FLOAT32_IEEE SAB_C_CGT_1CEL_M40_S2_S3 1 100 -40 215 ECU_ADDRESS 0xFFF8DB88 FORMAT "%4.3" DISPLAY_IDENTIFIER iv_c_Chip2Trans.GearboxTempInFl.GearboxTempIn._.ZFFSAB /end MEASUREMENT
/begin MEASUREMENT ZFFSAB._.GearboxTempIn.GearboxTempInFl.sv_c_ChipTrans "Output value substrate temperature" FLOAT32_IEEE SAB_C_CGT_1CEL_M40_S2_S3 1 100 -40 215 ECU_ADDRESS 0xFFF8DB94 FORMAT "%4.3" DISPLAY_IDENTIFIER sv_c_ChipTrans.GearboxTempInFl.GearboxTempIn._.ZFFSAB /end MEASUREMENT
/begin MEASUREMENT ZFFSAB._.GearboxTempIn.GearboxTempInFl.sv_c_ChipTransSts "signal status substrate temperature" FLOAT32_IEEE SAB_STANDARD_S2_S3 1 100 0 2 ECU_ADDRESS 0xFFF8DB98 FORMAT "%4.3" DISPLAY_IDENTIFIER sv_c_ChipTransSts.GearboxTempInFl.GearboxTempIn._.ZFFSAB /end MEASUREMENT
/begin MEASUREMENT ZFFSAB._.GearboxTempIn.GearboxTempInFl.sv_c_OilTrans "Output value of gear oil temperature" FLOAT32_IEEE SAB_C_CGT_1CEL_M40_S2_S3 1 100 -40 215 ECU_ADDRESS 0xFFF8DB90 FORMAT "%4.3" DISPLAY_IDENTIFIER sv_c_OilTrans.GearboxTempInFl.GearboxTempIn._.ZFFSAB /end MEASUREMENT
/begin MEASUREMENT ZFFSAB._.GearboxTempIn.GearboxTempInFl.sv_c_OilTransSts "Output value signal status of gear oil temperature" FLOAT32_IEEE SAB_STANDARD_S2_S3 1 100 0 2 ECU_ADDRESS 0xFFF8DB8C FORMAT "%4.3" DISPLAY_IDENTIFIER sv_c_OilTransSts.GearboxTempInFl.GearboxTempIn._.ZFFSAB /end MEASUREMENT
/begin MEASUREMENT ZFFSAB._.GearboxTempIn.GearboxTempInFl.sv_c_OilTrans_ "Output value of gear oil temperature (Complement)" FLOAT32_IEEE SAB_STANDARD_S2_S3 1 100 0 255 ECU_ADDRESS 0xFFF8DB84 FORMAT "%4.3" DISPLAY_IDENTIFIER sv_c_OilTrans_.GearboxTempInFl.GearboxTempIn._.ZFFSAB /end MEASUREMENT
/begin MEASUREMENT ZFFSAB._.GearboxTempIn.PAK_counter_end "counter Pak calls in 10 ms Task" UBYTE SAB_STANDARD_S2_S3 1 100 0 19 ECU_ADDRESS 0xFFF8DBBC DISPLAY_IDENTIFIER PAK_counter_end.GearboxTempIn._.ZFFSAB /end MEASUREMENT
/begin MEASUREMENT ZFFSAB._.GearboxTempIn.PAK_counter_end_ "complement of counter Pak calls in 10 ms Task" UBYTE SAB_STANDARD_S2_S3 1 100 0 19 ECU_ADDRESS 0xFFF8DBBD DISPLAY_IDENTIFIER PAK_counter_end_.GearboxTempIn._.ZFFSAB /end MEASUREMENT
/begin MEASUREMENT ZFFSAB._.GearboxTempIn.PAK_counter_start "counter Pak calls in 10 ms Task" UBYTE SAB_STANDARD_S2_S3 1 100 0 19 ECU_ADDRESS 0xFFF8DBBA DISPLAY_IDENTIFIER PAK_counter_start.GearboxTempIn._.ZFFSAB /end MEASUREMENT
/begin MEASUREMENT ZFFSAB._.GearboxTempIn.PAK_counter_start_ "complement of counter Pak calls in 10 ms Task" UBYTE SAB_STANDARD_S2_S3 1 100 0 19 ECU_ADDRESS 0xFFF8DBBB DISPLAY_IDENTIFIER PAK_counter_start_.GearboxTempIn._.ZFFSAB /end MEASUREMENT
/begin MEASUREMENT ZFFSAB._.GearboxTempIn.f_IgnitionOff2On "represenets an Ignition OFF to ON" UBYTE SAB_STANDARD_S2_S3 1 100 0 1 ECU_ADDRESS 0xFFF8DB9C DISPLAY_IDENTIFIER f_IgnitionOff2On.GearboxTempIn._.ZFFSAB /end MEASUREMENT
/begin MEASUREMENT ZFFSAB._.GearboxTempIn.iv_c_Chip2Trans "Input raw signal Chiptemperature Sensor 2(LM71)" UBYTE SAB_C_CGT_1CEL_M40_S2_S3 1 100 -40 215 ECU_ADDRESS 0xFFF8DBAC DISPLAY_IDENTIFIER iv_c_Chip2Trans.GearboxTempIn._.ZFFSAB /end MEASUREMENT
/begin MEASUREMENT ZFFSAB._.GearboxTempIn.iv_c_Chip2TransESts "Input raw signal EStatus Chiptemperature Sensor 1(LM71)" UBYTE SAB_STANDARD_S2_S3 1 100 0 255 ECU_ADDRESS 0xFFF8DBAE DISPLAY_IDENTIFIER iv_c_Chip2TransESts.GearboxTempIn._.ZFFSAB /end MEASUREMENT
/begin MEASUREMENT ZFFSAB._.GearboxTempIn.iv_c_OilTransESts "Input raw signal for electrical status CGT Sensor" UBYTE SAB_STANDARD_S2_S3 1 100 0 255 ECU_ADDRESS 0xFFF8DBAD DISPLAY_IDENTIFIER iv_c_OilTransESts.GearboxTempIn._.ZFFSAB /end MEASUREMENT
/begin MEASUREMENT ZFFSAB._.GearboxTempIn.iv_n_Eng "input signal engine speed" UWORD SAB_STANDARD_S2_S3 1 100 0 65535 ECU_ADDRESS 0xFFF8DBB0 DISPLAY_IDENTIFIER iv_n_Eng.GearboxTempIn._.ZFFSAB /end MEASUREMENT
/begin MEASUREMENT ZFFSAB._.GearboxTempIn.iv_n_EngSts "input signal engine speed" UBYTE SAB_STANDARD_S2_S3 1 100 0 255 ECU_ADDRESS 0xFFF8DBB2 DISPLAY_IDENTIFIER iv_n_EngSts.GearboxTempIn._.ZFFSAB /end MEASUREMENT
/begin MEASUREMENT ZFFSAB._.GearboxTempIn.sv_c_ChipTrans "Output value substrate temperature" UBYTE SAB_C_CGT_1CEL_M40_S2_S3 1 100 -40 215 ECU_ADDRESS 0xFFF8DBB7 DISPLAY_IDENTIFIER sv_c_ChipTrans.GearboxTempIn._.ZFFSAB /end MEASUREMENT
/begin MEASUREMENT ZFFSAB._.GearboxTempIn.sv_c_ChipTransSts "Output value substrate temperature Status" UBYTE SAB_STANDARD_S2_S3 1 100 0 255 ECU_ADDRESS 0xFFF8DBB8 DISPLAY_IDENTIFIER sv_c_ChipTransSts.GearboxTempIn._.ZFFSAB /end MEASUREMENT
/begin MEASUREMENT ZFFSAB._.GearboxTempIn.sv_c_OilTrans "Output value of gear oil temperature" UBYTE SAB_C_CGT_1CEL_M40_S2_S3 1 100 -40 215 ECU_ADDRESS 0xFFF8DBB3 DISPLAY_IDENTIFIER sv_c_OilTrans.GearboxTempIn._.ZFFSAB /end MEASUREMENT
/begin MEASUREMENT ZFFSAB._.GearboxTempIn.sv_c_OilTransSts "Output value signal status of gear oil temperature" UBYTE SAB_STANDARD_S2_S3 1 100 0 2 ECU_ADDRESS 0xFFF8DBB5 DISPLAY_IDENTIFIER sv_c_OilTransSts.GearboxTempIn._.ZFFSAB /end MEASUREMENT
/begin MEASUREMENT ZFFSAB._.GearboxTempIn.sv_c_OilTransSts_ "Output value signal status of gear oil temperature (Complement)" UBYTE SAB_STANDARD_S2_S3 1 100 0 255 ECU_ADDRESS 0xFFF8DBB6 DISPLAY_IDENTIFIER sv_c_OilTransSts_.GearboxTempIn._.ZFFSAB /end MEASUREMENT
/begin MEASUREMENT ZFFSAB._.GearboxTempIn.sv_c_OilTransTXCAN "Output value of gear oil temperature for CAN" UBYTE SAB_C_CGT_1CEL_M40_S2_S3 1 100 -40 215 ECU_ADDRESS 0xFFF8DBB9 DISPLAY_IDENTIFIER sv_c_OilTransTXCAN.GearboxTempIn._.ZFFSAB /end MEASUREMENT
/begin MEASUREMENT ZFFSAB._.GearboxTempIn.sv_c_OilTrans_ "Output value of gear oil temperature (Complement)" UBYTE SAB_STANDARD_S2_S3 1 100 0 255 ECU_ADDRESS 0xFFF8DBB4 DISPLAY_IDENTIFIER sv_c_OilTrans_.GearboxTempIn._.ZFFSAB /end MEASUREMENT
/begin MEASUREMENT ZFFSAB._.GearboxTempIn.tmr_CGTPausi_CGTLEV2.time "Description for this variable only in SW documentation possible not in asap2" ULONG SAB_T_TIMER_S10_S2_S3 1 100 0 429496729.5 ECU_ADDRESS 0xFFF8DBA4 DISPLAY_IDENTIFIER time.tmr_CGTPausi_CGTLEV2.GearboxTempIn._.ZFFSAB /end MEASUREMENT
/begin MEASUREMENT ZFFSAB._.GearboxTempIn.tmr_CGTPausi_CGTLEV2.time_ "Description for this variable only in SW documentation possible not in asap2" ULONG SAB_T_TIMER_S10_S2_S3 1 100 0 429496729.5 ECU_ADDRESS 0xFFF8DBA8 DISPLAY_IDENTIFIER time_.tmr_CGTPausi_CGTLEV2.GearboxTempIn._.ZFFSAB /end MEASUREMENT
/begin MEASUREMENT ZFFSAB._.HDCIn.f_HDCErr "Error flag of HDC-signal" UBYTE SAB_STANDARD_S2_S3 1 100 0 1 ECU_ADDRESS 0xFFF96E5B DISPLAY_IDENTIFIER f_HDCErr.HDCIn._.ZFFSAB /end MEASUREMENT
/begin MEASUREMENT ZFFSAB._.HDCIn.iv_HDC "Input value of HDC status from CAN" UBYTE SAB_STANDARD_S2_S3 1 100 0 15 ECU_ADDRESS 0xFFF96E56 DISPLAY_IDENTIFIER iv_HDC.HDCIn._.ZFFSAB /end MEASUREMENT
/begin MEASUREMENT ZFFSAB._.HDCIn.iv_HDCSts "Input value message status of HDC status" UBYTE SAB_STANDARD_S2_S3 1 100 0 255 ECU_ADDRESS 0xFFF96E57 DISPLAY_IDENTIFIER iv_HDCSts.HDCIn._.ZFFSAB /end MEASUREMENT
/begin MEASUREMENT ZFFSAB._.HDCIn.sv_HDC "Output value of HDC status" UBYTE SAB_STANDARD_S2_S3 1 100 0 7 ECU_ADDRESS 0xFFF96E58 DISPLAY_IDENTIFIER sv_HDC.HDCIn._.ZFFSAB /end MEASUREMENT
/begin MEASUREMENT ZFFSAB._.HDCIn.sv_HDCSbe "Output value shifting request HDC" UBYTE SAB_STANDARD_S2_S3 1 100 0 7 ECU_ADDRESS 0xFFF96E59 DISPLAY_IDENTIFIER sv_HDCSbe.HDCIn._.ZFFSAB /end MEASUREMENT
/begin MEASUREMENT ZFFSAB._.HDCIn.sv_HDCSts "Output value signal status of HDC status" UBYTE SAB_STANDARD_S2_S3 1 100 0 2 ECU_ADDRESS 0xFFF96E5A DISPLAY_IDENTIFIER sv_HDCSts.HDCIn._.ZFFSAB /end MEASUREMENT
/begin MEASUREMENT ZFFSAB._.HybridControlIn.f_ST_TAR_CENGErr "HAS error flag" UBYTE SAB_STANDARD_S2_S3 1 100 0 1 ECU_ADDRESS 0xFFF8E1F0 DISPLAY_IDENTIFIER f_ST_TAR_CENGErr.HybridControlIn._.ZFFSAB /end MEASUREMENT
/begin MEASUREMENT ZFFSAB._.HybridControlIn.f_ST_TAR_PENG_CENGErr "HAS error flag" UBYTE SAB_STANDARD_S2_S3 1 100 0 1 ECU_ADDRESS 0xFFF8E1EF DISPLAY_IDENTIFIER f_ST_TAR_PENG_CENGErr.HybridControlIn._.ZFFSAB /end MEASUREMENT
/begin MEASUREMENT ZFFSAB._.HybridControlIn.iv_Ablaufvariante_HAS "input signal SPEC_TYP_ENGSTA of message STAT_ENG_STA_AUTO" UBYTE SAB_STANDARD_S2_S3 1 100 0 15 ECU_ADDRESS 0xFFF8E1DA DISPLAY_IDENTIFIER iv_Ablaufvariante_HAS.HybridControlIn._.ZFFSAB /end MEASUREMENT
/begin MEASUREMENT ZFFSAB._.HybridControlIn.iv_Ablaufvariante_HASSts "State of the input signal Z_ABL_VAR_HAS" UBYTE SAB_STANDARD_S2_S3 1 100 0 255 ECU_ADDRESS 0xFFF8E1DC DISPLAY_IDENTIFIER iv_Ablaufvariante_HASSts.HybridControlIn._.ZFFSAB /end MEASUREMENT
/begin MEASUREMENT ZFFSAB._.HybridControlIn.iv_ST_TAR_CENG "input signal ST_TAR_PENG_CENG of message STAT_ENG_STA_AUTO" UBYTE SAB_STANDARD_S2_S3 1 100 0 3 ECU_ADDRESS 0xFFF8E1DF DISPLAY_IDENTIFIER iv_ST_TAR_CENG.HybridControlIn._.ZFFSAB /end MEASUREMENT
/begin MEASUREMENT ZFFSAB._.HybridControlIn.iv_ST_TAR_CENGSts "input value State STAT_ENG_STA_AUTO message status" UBYTE SAB_STANDARD_S2_S3 1 100 0 255 ECU_ADDRESS 0xFFF8E1E0 DISPLAY_IDENTIFIER iv_ST_TAR_CENGSts.HybridControlIn._.ZFFSAB /end MEASUREMENT
/begin MEASUREMENT ZFFSAB._.HybridControlIn.iv_ST_TAR_PENG_CENG "input signal ST_TAR_PENG_CENG of message STAT_ENG_STA_AUTO" UBYTE SAB_STANDARD_S2_S3 1 100 0 3 ECU_ADDRESS 0xFFF8E1DD DISPLAY_IDENTIFIER iv_ST_TAR_PENG_CENG.HybridControlIn._.ZFFSAB /end MEASUREMENT
/begin MEASUREMENT ZFFSAB._.HybridControlIn.iv_ST_TAR_PENG_CENGSts "input value State STAT_ENG_STA_AUTO message status" UBYTE SAB_STANDARD_S2_S3 1 100 0 255 ECU_ADDRESS 0xFFF8E1DE DISPLAY_IDENTIFIER iv_ST_TAR_PENG_CENGSts.HybridControlIn._.ZFFSAB /end MEASUREMENT
/begin MEASUREMENT ZFFSAB._.HybridControlIn.iv_Startablauf "Type of start: 0 = normal 1 = low temperature 3 = signal error" UBYTE SAB_STANDARD_S2_S3 1 100 0 3 ECU_ADDRESS 0xFFF8E1DB DISPLAY_IDENTIFIER iv_Startablauf.HybridControlIn._.ZFFSAB /end MEASUREMENT
/begin MEASUREMENT ZFFSAB._.HybridControlIn.iv_st_EngineSpeedControlEM "Input signal ST_RPM_CLCTR_MOT" UBYTE SAB_STANDARD_S2_S3 1 100 0 3 ECU_ADDRESS 0xFFF8E1E1 DISPLAY_IDENTIFIER iv_st_EngineSpeedControlEM.HybridControlIn._.ZFFSAB /end MEASUREMENT
/begin MEASUREMENT ZFFSAB._.HybridControlIn.iv_st_EngineSpeedControlEMSts "State of the input signal ST_RPM_CLCTR_MOT" UBYTE SAB_STANDARD_S2_S3 1 100 0 255 ECU_ADDRESS 0xFFF8E1E3 DISPLAY_IDENTIFIER iv_st_EngineSpeedControlEMSts.HybridControlIn._.ZFFSAB /end MEASUREMENT
/begin MEASUREMENT ZFFSAB._.HybridControlIn.iv_st_EngineSpeedControlEMSts_ "Complement for state of the input signal ST_RPM_CLCTR_MOT" UBYTE SAB_STANDARD_S2_S3 1 100 0 255 ECU_ADDRESS 0xFFF8E1E4 DISPLAY_IDENTIFIER iv_st_EngineSpeedControlEMSts_.HybridControlIn._.ZFFSAB /end MEASUREMENT
/begin MEASUREMENT ZFFSAB._.HybridControlIn.iv_st_EngineSpeedControlEM_ "Complement for input signal ST_RPM_CLCTR_MOT" UBYTE SAB_STANDARD_S2_S3 1 100 0 255 ECU_ADDRESS 0xFFF8E1E2 DISPLAY_IDENTIFIER iv_st_EngineSpeedControlEM_.HybridControlIn._.ZFFSAB /end MEASUREMENT
/begin MEASUREMENT ZFFSAB._.HybridControlIn.sv_Ablaufvariante_HAS "output value Ablaufvariante_HAS" UBYTE SAB_STANDARD_S2_S3 1 100 0 15 ECU_ADDRESS 0xFFF8E1E5 DISPLAY_IDENTIFIER sv_Ablaufvariante_HAS.HybridControlIn._.ZFFSAB /end MEASUREMENT
/begin MEASUREMENT ZFFSAB._.HybridControlIn.sv_STAT_Drv "output value STAT_Drv" UBYTE SAB_STANDARD_S2_S3 1 100 0 15 ECU_ADDRESS 0xFFF8E1E6 DISPLAY_IDENTIFIER sv_STAT_Drv.HybridControlIn._.ZFFSAB /end MEASUREMENT
/begin MEASUREMENT ZFFSAB._.HybridControlIn.sv_ST_TAR_CENG "output value ST_TAR_CENG" UBYTE SAB_STANDARD_S2_S3 1 100 0 15 ECU_ADDRESS 0xFFF8E1E9 DISPLAY_IDENTIFIER sv_ST_TAR_CENG.HybridControlIn._.ZFFSAB /end MEASUREMENT
/begin MEASUREMENT ZFFSAB._.HybridControlIn.sv_ST_TAR_CENGSts "output value ST_TAR_CENGSts" UBYTE SAB_STANDARD_S2_S3 1 100 0 2 ECU_ADDRESS 0xFFF8E1EA DISPLAY_IDENTIFIER sv_ST_TAR_CENGSts.HybridControlIn._.ZFFSAB /end MEASUREMENT
/begin MEASUREMENT ZFFSAB._.HybridControlIn.sv_ST_TAR_PENG_CENG "output value ST_TAR_PENG_CENG" UBYTE SAB_STANDARD_S2_S3 1 100 0 15 ECU_ADDRESS 0xFFF8E1E7 DISPLAY_IDENTIFIER sv_ST_TAR_PENG_CENG.HybridControlIn._.ZFFSAB /end MEASUREMENT
/begin MEASUREMENT ZFFSAB._.HybridControlIn.sv_ST_TAR_PENG_CENGSts "output value ST_TAR_PENG_CENGSts" UBYTE SAB_STANDARD_S2_S3 1 100 0 2 ECU_ADDRESS 0xFFF8E1E8 DISPLAY_IDENTIFIER sv_ST_TAR_PENG_CENGSts.HybridControlIn._.ZFFSAB /end MEASUREMENT
/begin MEASUREMENT ZFFSAB._.HybridControlIn.sv_st_EngineSpeedControlEM "output value st_EngineSpeedControlEM" UBYTE SAB_STANDARD_S2_S3 1 100 0 1 ECU_ADDRESS 0xFFF8E1EB DISPLAY_IDENTIFIER sv_st_EngineSpeedControlEM.HybridControlIn._.ZFFSAB /end MEASUREMENT
/begin MEASUREMENT ZFFSAB._.HybridControlIn.sv_st_EngineSpeedControlEMSts "state of output signal st_EngineSpeedControlEM" UBYTE SAB_STANDARD_S2_S3 1 100 0 2 ECU_ADDRESS 0xFFF8E1ED DISPLAY_IDENTIFIER sv_st_EngineSpeedControlEMSts.HybridControlIn._.ZFFSAB /end MEASUREMENT
/begin MEASUREMENT ZFFSAB._.HybridControlIn.sv_st_EngineSpeedControlEMSts_ "Complement for state of output signal st_EngineSpeedControlEM" UBYTE SAB_STANDARD_S2_S3 1 100 0 255 ECU_ADDRESS 0xFFF8E1EE DISPLAY_IDENTIFIER sv_st_EngineSpeedControlEMSts_.HybridControlIn._.ZFFSAB /end MEASUREMENT
/begin MEASUREMENT ZFFSAB._.HybridControlIn.sv_st_EngineSpeedControlEM_ "Complement for output value st_EngineSpeedControlEM" UBYTE SAB_STANDARD_S2_S3 1 100 0 255 ECU_ADDRESS 0xFFF8E1EC DISPLAY_IDENTIFIER sv_st_EngineSpeedControlEM_.HybridControlIn._.ZFFSAB /end MEASUREMENT
/begin MEASUREMENT ZFFSAB._.HybridGearboxReadyToDriveIn.f_SystemPressureFromEngineSpeed "Flag of hydraulic system pressure from engine driven pump" UBYTE SAB_STANDARD_S2_S3 1 100 0 1 ECU_ADDRESS 0xFFF95996 DISPLAY_IDENTIFIER f_SystemPressureFromEngineSpeed.HybridGearboxReadyToDriveIn._.ZFFSAB /end MEASUREMENT
/begin MEASUREMENT ZFFSAB._.HybridGearboxReadyToDriveIn.f_SystemPressureFromIEP "Flag of hydraulic system pressure from IEP" UBYTE SAB_STANDARD_S2_S3 1 100 0 1 ECU_ADDRESS 0xFFF95995 DISPLAY_IDENTIFIER f_SystemPressureFromIEP.HybridGearboxReadyToDriveIn._.ZFFSAB /end MEASUREMENT
/begin MEASUREMENT ZFFSAB._.HybridGearboxReadyToDriveIn.iv_StateIEP "Input signal from ATSYS indicating the state of the Integrierte Elektrische Pumpe" UBYTE SAB_STANDARD_S2_S3 1 100 0 4 ECU_ADDRESS 0xFFF95990 DISPLAY_IDENTIFIER iv_StateIEP.HybridGearboxReadyToDriveIn._.ZFFSAB /end MEASUREMENT
/begin MEASUREMENT ZFFSAB._.HybridGearboxReadyToDriveIn.sv_GearboxReadyToDrive "Output signal of state gearbox ready to drive: 0x00 = not ready 0x80 = ready" UBYTE SAB_STANDARD_S2_S3 1 100 0 255 ECU_ADDRESS 0xFFF95991 DISPLAY_IDENTIFIER sv_GearboxReadyToDrive.HybridGearboxReadyToDriveIn._.ZFFSAB /end MEASUREMENT
/begin MEASUREMENT ZFFSAB._.HybridGearboxReadyToDriveIn.sv_GearboxReadyToDriveSts "Output signal state of sv_GearboxReadyToDrive" UBYTE SAB_STANDARD_S2_S3 1 100 0 255 ECU_ADDRESS 0xFFF95993 DISPLAY_IDENTIFIER sv_GearboxReadyToDriveSts.HybridGearboxReadyToDriveIn._.ZFFSAB /end MEASUREMENT
/begin MEASUREMENT ZFFSAB._.HybridGearboxReadyToDriveIn.sv_GearboxReadyToDriveSts_ "Output complement of sv_GearboxReadyToDriveSts" UBYTE SAB_STANDARD_S2_S3 1 100 0 255 ECU_ADDRESS 0xFFF95994 DISPLAY_IDENTIFIER sv_GearboxReadyToDriveSts_.HybridGearboxReadyToDriveIn._.ZFFSAB /end MEASUREMENT
/begin MEASUREMENT ZFFSAB._.HybridGearboxReadyToDriveIn.sv_GearboxReadyToDrive_ "Output complement of signal sv_GearboxReadyToDrive" UBYTE SAB_STANDARD_S2_S3 1 100 0 255 ECU_ADDRESS 0xFFF95992 DISPLAY_IDENTIFIER sv_GearboxReadyToDrive_.HybridGearboxReadyToDriveIn._.ZFFSAB /end MEASUREMENT
/begin MEASUREMENT ZFFSAB._.HybridOpModeEMIn.f_DmpEMErr "Error flag of DampingEM-signal" UBYTE SAB_STANDARD_S2_S3 1 100 0 1 ECU_ADDRESS 0xFFF96E4B DISPLAY_IDENTIFIER f_DmpEMErr.HybridOpModeEMIn._.ZFFSAB /end MEASUREMENT
/begin MEASUREMENT ZFFSAB._.HybridOpModeEMIn.f_ModEMErr "Error flag of ModEM-signal" UBYTE SAB_STANDARD_S2_S3 1 100 0 1 ECU_ADDRESS 0xFFF96E4A DISPLAY_IDENTIFIER f_ModEMErr.HybridOpModeEMIn._.ZFFSAB /end MEASUREMENT
/begin MEASUREMENT ZFFSAB._.HybridOpModeEMIn.iv_DmpEM "Input value for damping of electric motor from CAN" UBYTE SAB_STANDARD_S2_S3 1 100 0 3 ECU_ADDRESS 0xFFF96E44 DISPLAY_IDENTIFIER iv_DmpEM.HybridOpModeEMIn._.ZFFSAB /end MEASUREMENT
/begin MEASUREMENT ZFFSAB._.HybridOpModeEMIn.iv_DmpEMSts "Input value for the status of damping electic motor" UBYTE SAB_STANDARD_S2_S3 1 100 0 255 ECU_ADDRESS 0xFFF96E45 DISPLAY_IDENTIFIER iv_DmpEMSts.HybridOpModeEMIn._.ZFFSAB /end MEASUREMENT
/begin MEASUREMENT ZFFSAB._.HybridOpModeEMIn.iv_ModEM "Input value for mode of operation of electric motor from CAN" UBYTE SAB_STANDARD_S2_S3 1 100 0 15 ECU_ADDRESS 0xFFF96E42 DISPLAY_IDENTIFIER iv_ModEM.HybridOpModeEMIn._.ZFFSAB /end MEASUREMENT
/begin MEASUREMENT ZFFSAB._.HybridOpModeEMIn.iv_ModEMSts "Input value for the status of electic motor" UBYTE SAB_STANDARD_S2_S3 1 100 0 255 ECU_ADDRESS 0xFFF96E43 DISPLAY_IDENTIFIER iv_ModEMSts.HybridOpModeEMIn._.ZFFSAB /end MEASUREMENT
/begin MEASUREMENT ZFFSAB._.HybridOpModeEMIn.sv_DmpEM "Output signal for damping of electric motor" UBYTE SAB_STANDARD_S2_S3 1 100 0 1 ECU_ADDRESS 0xFFF96E48 DISPLAY_IDENTIFIER sv_DmpEM.HybridOpModeEMIn._.ZFFSAB /end MEASUREMENT
/begin MEASUREMENT ZFFSAB._.HybridOpModeEMIn.sv_DmpEMSts "Output signal for the status of damping electic motor" UBYTE SAB_STANDARD_S2_S3 1 100 0 2 ECU_ADDRESS 0xFFF96E49 DISPLAY_IDENTIFIER sv_DmpEMSts.HybridOpModeEMIn._.ZFFSAB /end MEASUREMENT
/begin MEASUREMENT ZFFSAB._.HybridOpModeEMIn.sv_ModEM "Output signal for mode of operation of electric motor" UBYTE SAB_STANDARD_S2_S3 1 100 0 15 ECU_ADDRESS 0xFFF96E46 DISPLAY_IDENTIFIER sv_ModEM.HybridOpModeEMIn._.ZFFSAB /end MEASUREMENT
/begin MEASUREMENT ZFFSAB._.HybridOpModeEMIn.sv_ModEMSts "Output signal for the status of electic motor" UBYTE SAB_STANDARD_S2_S3 1 100 0 2 ECU_ADDRESS 0xFFF96E47 DISPLAY_IDENTIFIER sv_ModEMSts.HybridOpModeEMIn._.ZFFSAB /end MEASUREMENT
/begin MEASUREMENT ZFFSAB._.HybridSignalsIn.f_AepReq "Error flag for Request Gear shift in from AEP" UBYTE SAB_STANDARD_S2_S3 1 100 0 1 ECU_ADDRESS 0xFFF95B21 DISPLAY_IDENTIFIER f_AepReq.HybridSignalsIn._.ZFFSAB /end MEASUREMENT
/begin MEASUREMENT ZFFSAB._.HybridSignalsIn.f_EgsReaktNRedErr "Error flag for emergency operation to AGS" UBYTE SAB_STANDARD_S2_S3 1 100 0 1 ECU_ADDRESS 0xFFF95B22 DISPLAY_IDENTIFIER f_EgsReaktNRedErr.HybridSignalsIn._.ZFFSAB /end MEASUREMENT
/begin MEASUREMENT ZFFSAB._.HybridSignalsIn.f_m_EngStartErr "Error flag for start torque of combustion engine" UBYTE SAB_STANDARD_S2_S3 1 100 0 1 ECU_ADDRESS 0xFFF95B20 DISPLAY_IDENTIFIER f_m_EngStartErr.HybridSignalsIn._.ZFFSAB /end MEASUREMENT
/begin MEASUREMENT ZFFSAB._.HybridSignalsIn.f_n_SollEMErr "Error flag for desired RPM of electric motor" UBYTE SAB_STANDARD_S2_S3 1 100 0 1 ECU_ADDRESS 0xFFF95B1F DISPLAY_IDENTIFIER f_n_SollEMErr.HybridSignalsIn._.ZFFSAB /end MEASUREMENT
/begin MEASUREMENT ZFFSAB._.HybridSignalsIn.iv_AepReq "Input CAN message Request Gear shift in from AEP" UBYTE SAB_STANDARD_S2_S3 1 100 0 3 ECU_ADDRESS 0xFFF95AFD DISPLAY_IDENTIFIER iv_AepReq.HybridSignalsIn._.ZFFSAB /end MEASUREMENT
/begin MEASUREMENT ZFFSAB._.HybridSignalsIn.iv_AepReqSts "Input CAN message Status Request Gear shift in from AEP" UBYTE SAB_STANDARD_S2_S3 1 100 0 255 ECU_ADDRESS 0xFFF95AFE DISPLAY_IDENTIFIER iv_AepReqSts.HybridSignalsIn._.ZFFSAB /end MEASUREMENT
/begin MEASUREMENT ZFFSAB._.HybridSignalsIn.iv_EgsReaktNRed "Input CAN message signal emergency operation to AGS" UBYTE SAB_STANDARD_S2_S3 1 100 0 255 ECU_ADDRESS 0xFFF95AFF DISPLAY_IDENTIFIER iv_EgsReaktNRed.HybridSignalsIn._.ZFFSAB /end MEASUREMENT
/begin MEASUREMENT ZFFSAB._.HybridSignalsIn.iv_EgsReaktNRedSts "Input CAN message Status emergency operation to AGS" UBYTE SAB_STANDARD_S2_S3 1 100 0 255 ECU_ADDRESS 0xFFF95B00 DISPLAY_IDENTIFIER iv_EgsReaktNRedSts.HybridSignalsIn._.ZFFSAB /end MEASUREMENT
/begin MEASUREMENT ZFFSAB._.HybridSignalsIn.iv_STAT_Drv "Input raw signal Status MSA" UBYTE SAB_STANDARD_S2_S3 1 100 0 255 ECU_ADDRESS 0xFFF95AF3 DISPLAY_IDENTIFIER iv_STAT_Drv.HybridSignalsIn._.ZFFSAB /end MEASUREMENT
/begin MEASUREMENT ZFFSAB._.HybridSignalsIn.iv_STAT_DrvSts "Input CAN message status Status MSA" UBYTE SAB_STANDARD_S2_S3 1 100 0 255 ECU_ADDRESS 0xFFF95AF4 DISPLAY_IDENTIFIER iv_STAT_DrvSts.HybridSignalsIn._.ZFFSAB /end MEASUREMENT
/begin MEASUREMENT ZFFSAB._.HybridSignalsIn.iv_Vor_Kurz_m_crsh_Max "Input raw signal Voraussage_Drehmoment_Kurbelwelle_Max_EMotor_Hybrid" UWORD SAB_M_NM2_M2047_S2_S3 1 100 -1023.5 31744 ECU_ADDRESS 0xFFF95AE4 DISPLAY_IDENTIFIER iv_Vor_Kurz_m_crsh_Max.HybridSignalsIn._.ZFFSAB /end MEASUREMENT
/begin MEASUREMENT ZFFSAB._.HybridSignalsIn.iv_Vor_Kurz_m_crsh_MaxSts "Input CAN message status Voraussage_Drehmoment_Kurbelwelle_Max_EMotor_Hybrid" UBYTE SAB_STANDARD_S2_S3 1 100 0 255 ECU_ADDRESS 0xFFF95AE6 DISPLAY_IDENTIFIER iv_Vor_Kurz_m_crsh_MaxSts.HybridSignalsIn._.ZFFSAB /end MEASUREMENT
/begin MEASUREMENT ZFFSAB._.HybridSignalsIn.iv_Vor_Kurz_m_crsh_Min "Input raw signal Voraussage_Drehmoment_Kurbelwelle_Min_EMotor_Hybrid" UWORD SAB_M_NM2_M2047_S2_S3 1 100 -1023.5 31744 ECU_ADDRESS 0xFFF95AE8 DISPLAY_IDENTIFIER iv_Vor_Kurz_m_crsh_Min.HybridSignalsIn._.ZFFSAB /end MEASUREMENT
/begin MEASUREMENT ZFFSAB._.HybridSignalsIn.iv_Vor_Kurz_m_crsh_MinSts "Input CAN message status Voraussage_Drehmoment_Kurbelwelle_Min_EMotor_Hybrid" UBYTE SAB_STANDARD_S2_S3 1 100 0 255 ECU_ADDRESS 0xFFF95AEA DISPLAY_IDENTIFIER iv_Vor_Kurz_m_crsh_MinSts.HybridSignalsIn._.ZFFSAB /end MEASUREMENT
/begin MEASUREMENT ZFFSAB._.HybridSignalsIn.iv_Vor_Lang_m_crsh_Max "Input raw signal Voraussage_Langzeit_Drehmoment_Kurbelwelle_Max_EMotor_Hybrid" UWORD SAB_M_NM2_M2047_S2_S3 1 100 -1023.5 31744 ECU_ADDRESS 0xFFF95AEC DISPLAY_IDENTIFIER iv_Vor_Lang_m_crsh_Max.HybridSignalsIn._.ZFFSAB /end MEASUREMENT
/begin MEASUREMENT ZFFSAB._.HybridSignalsIn.iv_Vor_Lang_m_crsh_MaxSts "Input CAN message status Voraussage_Langzeit_Drehmoment_Kurbelwelle_Max_EMotor_Hybrid" UBYTE SAB_STANDARD_S2_S3 1 100 0 255 ECU_ADDRESS 0xFFF95AEE DISPLAY_IDENTIFIER iv_Vor_Lang_m_crsh_MaxSts.HybridSignalsIn._.ZFFSAB /end MEASUREMENT
/begin MEASUREMENT ZFFSAB._.HybridSignalsIn.iv_Vor_Lang_m_crsh_Min "Input raw signal Voraussage_Langzeit_Drehmoment_Kurbelwelle_Min_EMotor_Hybrid" UWORD SAB_M_NM2_M2047_S2_S3 1 100 -1023.5 31744 ECU_ADDRESS 0xFFF95AF0 DISPLAY_IDENTIFIER iv_Vor_Lang_m_crsh_Min.HybridSignalsIn._.ZFFSAB /end MEASUREMENT
/begin MEASUREMENT ZFFSAB._.HybridSignalsIn.iv_Vor_Lang_m_crsh_MinSts "Input CAN message status Voraussage_Langzeit_Drehmoment_Kurbelwelle_Min_EMotor_Hybrid" UBYTE SAB_STANDARD_S2_S3 1 100 0 255 ECU_ADDRESS 0xFFF95AF2 DISPLAY_IDENTIFIER iv_Vor_Lang_m_crsh_MinSts.HybridSignalsIn._.ZFFSAB /end MEASUREMENT
/begin MEASUREMENT ZFFSAB._.HybridSignalsIn.iv_Vor_m_Ant_Sum_Rekup_Max "Input raw signal VorausIstRadmomentAntriebstrangSumme_Rekuperation_Maximal_Hybrid" UWORD SAB_M_1NM_M32000_S2_S3 1 100 -32000 33535 ECU_ADDRESS 0xFFF95AE0 DISPLAY_IDENTIFIER iv_Vor_m_Ant_Sum_Rekup_Max.HybridSignalsIn._.ZFFSAB /end MEASUREMENT
/begin MEASUREMENT ZFFSAB._.HybridSignalsIn.iv_Vor_m_Ant_Sum_Rekup_MaxSts "Input CAN message status VorausIstRadmomentAntriebstrangSumme_Rekuperation_Maximal_Hybrid" UBYTE SAB_STANDARD_S2_S3 1 100 0 255 ECU_ADDRESS 0xFFF95AE2 DISPLAY_IDENTIFIER iv_Vor_m_Ant_Sum_Rekup_MaxSts.HybridSignalsIn._.ZFFSAB /end MEASUREMENT
/begin MEASUREMENT ZFFSAB._.HybridSignalsIn.iv_m_AntSumRekupGearb "Input raw signal SollRadmomentAntriebstrangSummeRek_Getr_Hybrid" UWORD SAB_M_1NM_M32000_S2_S3 1 100 -32000 33535 ECU_ADDRESS 0xFFF95AD4 DISPLAY_IDENTIFIER iv_m_AntSumRekupGearb.HybridSignalsIn._.ZFFSAB /end MEASUREMENT
/begin MEASUREMENT ZFFSAB._.HybridSignalsIn.iv_m_AntSumRekupGearbSts "Input CAN message status SollRadmomentAntriebstrangSummeRek_Getr_Hybrid" UBYTE SAB_STANDARD_S2_S3 1 100 0 255 ECU_ADDRESS 0xFFF95AD6 DISPLAY_IDENTIFIER iv_m_AntSumRekupGearbSts.HybridSignalsIn._.ZFFSAB /end MEASUREMENT
/begin MEASUREMENT ZFFSAB._.HybridSignalsIn.iv_m_AntSumRekupMax "Input raw signal IstRadmomentAntriebstrangSumme_Rekuperation_Maximal_Hybrid" UWORD SAB_M_1NM_M32000_S2_S3 1 100 -32000 33535 ECU_ADDRESS 0xFFF95ADC DISPLAY_IDENTIFIER iv_m_AntSumRekupMax.HybridSignalsIn._.ZFFSAB /end MEASUREMENT
/begin MEASUREMENT ZFFSAB._.HybridSignalsIn.iv_m_AntSumRekupMaxSts "Input CAN message status IstRadmomentAntriebstrangSumme_Rekuperation_Maximal_Hybrid" UBYTE SAB_STANDARD_S2_S3 1 100 0 255 ECU_ADDRESS 0xFFF95ADE DISPLAY_IDENTIFIER iv_m_AntSumRekupMaxSts.HybridSignalsIn._.ZFFSAB /end MEASUREMENT
/begin MEASUREMENT ZFFSAB._.HybridSignalsIn.iv_m_AntSumSchleppUnten "Input raw signal IstRadmomentAntriebstrangSummeSchleppmoment_unten_Hybrid" UWORD SAB_M_1NM_M32000_S2_S3 1 100 -32000 33535 ECU_ADDRESS 0xFFF95AD8 DISPLAY_IDENTIFIER iv_m_AntSumSchleppUnten.HybridSignalsIn._.ZFFSAB /end MEASUREMENT
/begin MEASUREMENT ZFFSAB._.HybridSignalsIn.iv_m_AntSumSchleppUntenSts "Input CAN message status IstRadmomentAntriebstrangSummeSchleppmoment_unten_Hybrid" UBYTE SAB_STANDARD_S2_S3 1 100 0 255 ECU_ADDRESS 0xFFF95ADA DISPLAY_IDENTIFIER iv_m_AntSumSchleppUntenSts.HybridSignalsIn._.ZFFSAB /end MEASUREMENT
/begin MEASUREMENT ZFFSAB._.HybridSignalsIn.iv_m_EngStart "Input raw signal of starting torque of combustion engine" UWORD SAB_M_NM2_M2047_S2_S3 1 100 -1023.5 31744 ECU_ADDRESS 0xFFF95AFA DISPLAY_IDENTIFIER iv_m_EngStart.HybridSignalsIn._.ZFFSAB /end MEASUREMENT
/begin MEASUREMENT ZFFSAB._.HybridSignalsIn.iv_m_EngStartSts "Input CAN message status starting torque of combustion engine" UBYTE SAB_STANDARD_S2_S3 1 100 0 255 ECU_ADDRESS 0xFFF95AFC DISPLAY_IDENTIFIER iv_m_EngStartSts.HybridSignalsIn._.ZFFSAB /end MEASUREMENT
/begin MEASUREMENT ZFFSAB._.HybridSignalsIn.iv_n_SollEM "Input raw signal of desired RPM electric motor" UWORD SAB_N_RPM2_M5000_S2_S3 1 100 -5000 27767.5 ECU_ADDRESS 0xFFF95AF6 DISPLAY_IDENTIFIER iv_n_SollEM.HybridSignalsIn._.ZFFSAB /end MEASUREMENT
/begin MEASUREMENT ZFFSAB._.HybridSignalsIn.iv_n_SollEMSts "Input CAN message status desired RPM electric motor" UBYTE SAB_STANDARD_S2_S3 1 100 0 255 ECU_ADDRESS 0xFFF95AF8 DISPLAY_IDENTIFIER iv_n_SollEMSts.HybridSignalsIn._.ZFFSAB /end MEASUREMENT
/begin MEASUREMENT ZFFSAB._.HybridSignalsIn.sv_AGS_AepReq "Output Request Gear shift in from AEP" UBYTE SAB_STANDARD_S2_S3 1 100 0 1 ECU_ADDRESS 0xFFF95B1B DISPLAY_IDENTIFIER sv_AGS_AepReq.HybridSignalsIn._.ZFFSAB /end MEASUREMENT
/begin MEASUREMENT ZFFSAB._.HybridSignalsIn.sv_AGS_EgsReaktNRed "Output signal emergency operation to AGS" UBYTE SAB_STANDARD_S2_S3 1 100 0 3 ECU_ADDRESS 0xFFF95B1D DISPLAY_IDENTIFIER sv_AGS_EgsReaktNRed.HybridSignalsIn._.ZFFSAB /end MEASUREMENT
/begin MEASUREMENT ZFFSAB._.HybridSignalsIn.sv_AGS_StatusAntriebFzg "Output signal of Status MSA" UBYTE SAB_STANDARD_S2_S3 1 100 0 255 ECU_ADDRESS 0xFFF95B12 DISPLAY_IDENTIFIER sv_AGS_StatusAntriebFzg.HybridSignalsIn._.ZFFSAB /end MEASUREMENT
/begin MEASUREMENT ZFFSAB._.HybridSignalsIn.sv_AepReqSts "Output status of Request Gear shift in from AEP" UBYTE SAB_STANDARD_S2_S3 1 100 0 255 ECU_ADDRESS 0xFFF95B1C DISPLAY_IDENTIFIER sv_AepReqSts.HybridSignalsIn._.ZFFSAB /end MEASUREMENT
/begin MEASUREMENT ZFFSAB._.HybridSignalsIn.sv_EgsReaktNRedSts "Output status of signal emergency operation to AGS" UBYTE SAB_STANDARD_S2_S3 1 100 0 255 ECU_ADDRESS 0xFFF95B1E DISPLAY_IDENTIFIER sv_EgsReaktNRedSts.HybridSignalsIn._.ZFFSAB /end MEASUREMENT
/begin MEASUREMENT ZFFSAB._.HybridSignalsIn.sv_Vor_Kurz_m_crsh_Max "Output signal of Voraussage_Drehmoment_Kurbelwelle_Max_EMotor_Hybrid" UWORD SAB_M_NM2_M2047_S2_S3 1 100 -1023.5 31744 ECU_ADDRESS 0xFFF95B0A DISPLAY_IDENTIFIER sv_Vor_Kurz_m_crsh_Max.HybridSignalsIn._.ZFFSAB /end MEASUREMENT
/begin MEASUREMENT ZFFSAB._.HybridSignalsIn.sv_Vor_Kurz_m_crsh_Min "Output signal of Voraussage_Drehmoment_Kurbelwelle_Max_EMotor_Hybrid" UWORD SAB_M_NM2_M2047_S2_S3 1 100 -1023.5 31744 ECU_ADDRESS 0xFFF95B0C DISPLAY_IDENTIFIER sv_Vor_Kurz_m_crsh_Min.HybridSignalsIn._.ZFFSAB /end MEASUREMENT
/begin MEASUREMENT ZFFSAB._.HybridSignalsIn.sv_Vor_Lang_m_crsh_Max "Output signal of Voraussage_Langzeit_Drehmoment_Kurbelwelle_Max_EMotor_Hybrid" UWORD SAB_M_NM2_M2047_S2_S3 1 100 -1023.5 31744 ECU_ADDRESS 0xFFF95B0E DISPLAY_IDENTIFIER sv_Vor_Lang_m_crsh_Max.HybridSignalsIn._.ZFFSAB /end MEASUREMENT
/begin MEASUREMENT ZFFSAB._.HybridSignalsIn.sv_Vor_Lang_m_crsh_Min "Output signal of Voraussage_Langzeit_Drehmoment_Kurbelwelle_Min_EMotor_Hybrid" UWORD SAB_M_NM2_M2047_S2_S3 1 100 -1023.5 31744 ECU_ADDRESS 0xFFF95B10 DISPLAY_IDENTIFIER sv_Vor_Lang_m_crsh_Min.HybridSignalsIn._.ZFFSAB /end MEASUREMENT
/begin MEASUREMENT ZFFSAB._.HybridSignalsIn.sv_Vor_m_Ant_Sum_Rekup_Max "Output signal of VorausIstRadmomentAntriebstrangSumme_Rekuperation_Maximal_Hybrid" UWORD SAB_M_1NM_M32000_S2_S3 1 100 -32000 33535 ECU_ADDRESS 0xFFF95B08 DISPLAY_IDENTIFIER sv_Vor_m_Ant_Sum_Rekup_Max.HybridSignalsIn._.ZFFSAB /end MEASUREMENT
/begin MEASUREMENT ZFFSAB._.HybridSignalsIn.sv_m_AntSumRekupGearb "Output signal of SollRadmomentAntriebstrangSummeRek_Getr_Hybrid" UWORD SAB_M_1NM_M32000_S2_S3 1 100 -32000 33535 ECU_ADDRESS 0xFFF95B02 DISPLAY_IDENTIFIER sv_m_AntSumRekupGearb.HybridSignalsIn._.ZFFSAB /end MEASUREMENT
/begin MEASUREMENT ZFFSAB._.HybridSignalsIn.sv_m_AntSumRekupMax "Output signal of IstRadmomentAntriebstrangSumme_Rekuperation_Maximal_Hybrid" UWORD SAB_M_1NM_M32000_S2_S3 1 100 -32000 33535 ECU_ADDRESS 0xFFF95B06 DISPLAY_IDENTIFIER sv_m_AntSumRekupMax.HybridSignalsIn._.ZFFSAB /end MEASUREMENT
/begin MEASUREMENT ZFFSAB._.HybridSignalsIn.sv_m_AntSumSchleppUnten "Output signal of IstRadmomentAntriebstrangSummeSchleppmoment_unten_Hybrid" UWORD SAB_M_1NM_M32000_S2_S3 1 100 -32000 33535 ECU_ADDRESS 0xFFF95B04 DISPLAY_IDENTIFIER sv_m_AntSumSchleppUnten.HybridSignalsIn._.ZFFSAB /end MEASUREMENT
/begin MEASUREMENT ZFFSAB._.HybridSignalsIn.sv_m_EngStart "Output signal of starting torque of combustion engine" SWORD SAB_M_NM2_S2_S3 1 100 -512 512 ECU_ADDRESS 0xFFF95B18 DISPLAY_IDENTIFIER sv_m_EngStart.HybridSignalsIn._.ZFFSAB /end MEASUREMENT
/begin MEASUREMENT ZFFSAB._.HybridSignalsIn.sv_m_EngStartSts "Output status of starting torque of combustion engine" UBYTE SAB_STANDARD_S2_S3 1 100 0 255 ECU_ADDRESS 0xFFF95B1A DISPLAY_IDENTIFIER sv_m_EngStartSts.HybridSignalsIn._.ZFFSAB /end MEASUREMENT
/begin MEASUREMENT ZFFSAB._.HybridSignalsIn.sv_n_SollEM "Output signal of desired RPM electric engine" UWORD SAB_N_1RPM_S2_S3 1 100 0 12000 ECU_ADDRESS 0xFFF95B14 DISPLAY_IDENTIFIER sv_n_SollEM.HybridSignalsIn._.ZFFSAB /end MEASUREMENT
/begin MEASUREMENT ZFFSAB._.HybridSignalsIn.sv_n_SollEMSts "Output status of desired RPM electric engine" UBYTE SAB_STANDARD_S2_S3 1 100 0 255 ECU_ADDRESS 0xFFF95B16 DISPLAY_IDENTIFIER sv_n_SollEMSts.HybridSignalsIn._.ZFFSAB /end MEASUREMENT
/begin MEASUREMENT ZFFSAB._.HybridVehicleReadyToDriveIn.VehicleReadyToDriveOld "Output signal of sv_VehicleReadyToDrive from previous cycle" UBYTE SAB_STANDARD_S2_S3 1 100 0 255 ECU_ADDRESS 0xFFF95F43 DISPLAY_IDENTIFIER VehicleReadyToDriveOld.HybridVehicleReadyToDriveIn._.ZFFSAB /end MEASUREMENT
/begin MEASUREMENT ZFFSAB._.HybridVehicleReadyToDriveIn.VehicleReadyToDriveOldSts "Output status signal of sv_VehicleReadyToDriveSts from previous cycle" UBYTE SAB_STANDARD_S2_S3 1 100 0 255 ECU_ADDRESS 0xFFF95F44 DISPLAY_IDENTIFIER VehicleReadyToDriveOldSts.HybridVehicleReadyToDriveIn._.ZFFSAB /end MEASUREMENT
/begin MEASUREMENT ZFFSAB._.HybridVehicleReadyToDriveIn.f_ReqVehImdtVehRdyToDrvOff "Flag set when no timer is needed to set the ready to drive bit" UBYTE SAB_STANDARD_S2_S3 1 100 0 255 ECU_ADDRESS 0xFFF95F42 DISPLAY_IDENTIFIER f_ReqVehImdtVehRdyToDrvOff.HybridVehicleReadyToDriveIn._.ZFFSAB /end MEASUREMENT
/begin MEASUREMENT ZFFSAB._.HybridVehicleReadyToDriveIn.iv_ReqVehImdtVehRdyToDrvOff "Input raw signal from hardware informing whether the vehicle is ready to drive" UBYTE SAB_STANDARD_S2_S3 1 100 0 255 ECU_ADDRESS 0xFFF95F3E DISPLAY_IDENTIFIER iv_ReqVehImdtVehRdyToDrvOff.HybridVehicleReadyToDriveIn._.ZFFSAB /end MEASUREMENT
/begin MEASUREMENT ZFFSAB._.HybridVehicleReadyToDriveIn.iv_ReqVehImdtVehRdyToDrvOffSts "Input raw signal status from hardware informing whether the vehicle is ready to drive" UBYTE SAB_STANDARD_S2_S3 1 100 0 255 ECU_ADDRESS 0xFFF95F3F DISPLAY_IDENTIFIER iv_ReqVehImdtVehRdyToDrvOffSts.HybridVehicleReadyToDriveIn._.ZFFSAB /end MEASUREMENT
/begin MEASUREMENT ZFFSAB._.HybridVehicleReadyToDriveIn.iv_STAT_Drv "Input raw signal informing whether the vehicle is ready to drive" UBYTE SAB_STANDARD_S2_S3 1 100 0 255 ECU_ADDRESS 0xFFF95F3C DISPLAY_IDENTIFIER iv_STAT_Drv.HybridVehicleReadyToDriveIn._.ZFFSAB /end MEASUREMENT
/begin MEASUREMENT ZFFSAB._.HybridVehicleReadyToDriveIn.iv_STAT_DrvSts "Input CAN message status signal informing whether the vehicle is ready to drive" UBYTE SAB_STANDARD_S2_S3 1 100 0 255 ECU_ADDRESS 0xFFF95F3D DISPLAY_IDENTIFIER iv_STAT_DrvSts.HybridVehicleReadyToDriveIn._.ZFFSAB /end MEASUREMENT
/begin MEASUREMENT ZFFSAB._.HybridVehicleReadyToDriveIn.sv_VehicleReadyToDrive "Output signal giving the information whether the vehicle is ready to drive" UBYTE SAB_STANDARD_S2_S3 1 100 0 255 ECU_ADDRESS 0xFFF95F40 DISPLAY_IDENTIFIER sv_VehicleReadyToDrive.HybridVehicleReadyToDriveIn._.ZFFSAB /end MEASUREMENT
/begin MEASUREMENT ZFFSAB._.HybridVehicleReadyToDriveIn.sv_VehicleReadyToDriveSts "Output status signal giving the information whether the vehicle is ready to drive" UBYTE SAB_STANDARD_S2_S3 1 100 0 255 ECU_ADDRESS 0xFFF95F41 DISPLAY_IDENTIFIER sv_VehicleReadyToDriveSts.HybridVehicleReadyToDriveIn._.ZFFSAB /end MEASUREMENT
/begin MEASUREMENT ZFFSAB._.HybridVehicleReadyToDriveIn.tmr_ToStartVM.time "Description for this variable only in SW documentation possible not in asap2" UBYTE SAB_T_TIMER_10MS_S2_S3 1 100 0 2550 ECU_ADDRESS 0xFFF95F36 DISPLAY_IDENTIFIER time.tmr_ToStartVM.HybridVehicleReadyToDriveIn._.ZFFSAB /end MEASUREMENT
/begin MEASUREMENT ZFFSAB._.HybridVehicleReadyToDriveIn.tmr_holdStateVehicleReadyToDrive.time "Description for this variable only in SW documentation possible not in asap2" UWORD SAB_T_TIMER_10MS_S2_S3 1 100 0 655350 ECU_ADDRESS 0xFFF95F34 DISPLAY_IDENTIFIER time.tmr_holdStateVehicleReadyToDrive.HybridVehicleReadyToDriveIn._.ZFFSAB /end MEASUREMENT
/begin MEASUREMENT ZFFSAB._.HybridVehicleReadyToDriveInBPRAM.f_VehicleReadyToDriveInitPhase "Flag set to 1 if we were still in the initialization phase" UBYTE SAB_STANDARD_S2_S3 1 100 0 1 ECU_ADDRESS 0xFFF835CA DISPLAY_IDENTIFIER f_VehicleReadyToDriveInitPhase.HybridVehicleReadyToDriveInBPRAM._.ZFFSAB /end MEASUREMENT
/begin MEASUREMENT ZFFSAB._.HybridVehicleReadyToDriveInBPRAM.f_VehicleReadyToDriveInitPhase_ "Complement of the flag set to 1 if we were still in the initialization phase" UBYTE SAB_STANDARD_S2_S3 1 100 0 255 ECU_ADDRESS 0xFFF835CB DISPLAY_IDENTIFIER f_VehicleReadyToDriveInitPhase_.HybridVehicleReadyToDriveInBPRAM._.ZFFSAB /end MEASUREMENT
/begin MEASUREMENT ZFFSAB._.HybridVehicleReadyToDriveInBPRAM.stc_VehicleReadyToDriveBPRAM "Value of the vehicle ready to drive flag in the BPRAM" UBYTE SAB_STANDARD_S2_S3 1 100 0 1 ECU_ADDRESS 0xFFF835C6 DISPLAY_IDENTIFIER stc_VehicleReadyToDriveBPRAM.HybridVehicleReadyToDriveInBPRAM._.ZFFSAB /end MEASUREMENT
/begin MEASUREMENT ZFFSAB._.HybridVehicleReadyToDriveInBPRAM.stc_VehicleReadyToDriveBPRAM_ "Complement of value of the vehicle ready to drive flag in the BPRAM" UBYTE SAB_STANDARD_S2_S3 1 100 0 255 ECU_ADDRESS 0xFFF835C7 DISPLAY_IDENTIFIER stc_VehicleReadyToDriveBPRAM_.HybridVehicleReadyToDriveInBPRAM._.ZFFSAB /end MEASUREMENT
/begin MEASUREMENT ZFFSAB._.HybridVehicleReadyToDriveInBPRAM.stc_VehicleReadyToDriveStsBPRAM "Value of the vehicle ready to drive flag status in the BPRAM" UBYTE SAB_STANDARD_S2_S3 1 100 0 1 ECU_ADDRESS 0xFFF835C8 DISPLAY_IDENTIFIER stc_VehicleReadyToDriveStsBPRAM.HybridVehicleReadyToDriveInBPRAM._.ZFFSAB /end MEASUREMENT
/begin MEASUREMENT ZFFSAB._.HybridVehicleReadyToDriveInBPRAM.stc_VehicleReadyToDriveStsBPRAM_ "Complement of value of the vehicle ready to drive flag status in the BPRAM" UBYTE SAB_STANDARD_S2_S3 1 100 0 255 ECU_ADDRESS 0xFFF835C9 DISPLAY_IDENTIFIER stc_VehicleReadyToDriveStsBPRAM_.HybridVehicleReadyToDriveInBPRAM._.ZFFSAB /end MEASUREMENT
/begin MEASUREMENT ZFFSAB._.IgnitionKeyStatusIn.f_KeyValidErr "Error flag of key valid" UBYTE SAB_STANDARD_S2_S3 1 100 0 1 ECU_ADDRESS 0xFFF8E1C5 DISPLAY_IDENTIFIER f_KeyValidErr.IgnitionKeyStatusIn._.ZFFSAB /end MEASUREMENT
/begin MEASUREMENT ZFFSAB._.IgnitionKeyStatusIn.iv_KeyValid "Input value key valid from CAN" UBYTE SAB_STANDARD_S2_S3 1 100 0 3 ECU_ADDRESS 0xFFF8E1C0 DISPLAY_IDENTIFIER iv_KeyValid.IgnitionKeyStatusIn._.ZFFSAB /end MEASUREMENT
/begin MEASUREMENT ZFFSAB._.IgnitionKeyStatusIn.iv_KeyValidSts "Input value message status of key valid" UBYTE SAB_STANDARD_S2_S3 1 100 0 255 ECU_ADDRESS 0xFFF8E1C1 DISPLAY_IDENTIFIER iv_KeyValidSts.IgnitionKeyStatusIn._.ZFFSAB /end MEASUREMENT
/begin MEASUREMENT ZFFSAB._.IgnitionKeyStatusIn.sv_KeyValidSts "Output value signal status of key valid" UBYTE SAB_STANDARD_S2_S3 1 100 0 2 ECU_ADDRESS 0xFFF8E1C3 DISPLAY_IDENTIFIER sv_KeyValidSts.IgnitionKeyStatusIn._.ZFFSAB /end MEASUREMENT
/begin MEASUREMENT ZFFSAB._.IgnitionKeyStatusIn.sv_f_KeyRemoteStart "Output value of Key Remote Start" UBYTE SAB_STANDARD_S2_S3 1 100 0 1 ECU_ADDRESS 0xFFF8E1C4 DISPLAY_IDENTIFIER sv_f_KeyRemoteStart.IgnitionKeyStatusIn._.ZFFSAB /end MEASUREMENT
/begin MEASUREMENT ZFFSAB._.IgnitionKeyStatusIn.sv_f_KeyValid "Output value of key valid" UBYTE SAB_STANDARD_S2_S3 1 100 0 1 ECU_ADDRESS 0xFFF8E1C2 DISPLAY_IDENTIFIER sv_f_KeyValid.IgnitionKeyStatusIn._.ZFFSAB /end MEASUREMENT
/begin MEASUREMENT ZFFSAB._.IgnitionStatusIn.IgnPlausiErr "state of the plausibility check result CAN signal against hardware signal KL15" UBYTE SAB_STANDARD_S2_S3 1 100 0 2 ECU_ADDRESS 0xFFF8DBE3 DISPLAY_IDENTIFIER IgnPlausiErr.IgnitionStatusIn._.ZFFSAB /end MEASUREMENT
/begin MEASUREMENT ZFFSAB._.IgnitionStatusIn.f_KL15 "internal result of can signal 1 = can terminal 15 signal is on 0 = can terminal 15 signal is off" UBYTE SAB_STANDARD_S2_S3 1 100 0 1 ECU_ADDRESS 0xFFF8DBE1 DISPLAY_IDENTIFIER f_KL15.IgnitionStatusIn._.ZFFSAB /end MEASUREMENT
/begin MEASUREMENT ZFFSAB._.IgnitionStatusIn.f_KL15Err "error flag of can signal timeout alivecounter- checksum- dlcerror or invalig can signal" UBYTE SAB_STANDARD_S2_S3 1 100 0 1 ECU_ADDRESS 0xFFF8DBE2 DISPLAY_IDENTIFIER f_KL15Err.IgnitionStatusIn._.ZFFSAB /end MEASUREMENT
/begin MEASUREMENT ZFFSAB._.IgnitionStatusIn.f_Kl15_Pin "internal result of pin signal 1 = pin signal is on 0 = pin signal is off" UBYTE SAB_STANDARD_S2_S3 1 100 0 1 ECU_ADDRESS 0xFFF8DBE0 DISPLAY_IDENTIFIER f_Kl15_Pin.IgnitionStatusIn._.ZFFSAB /end MEASUREMENT
/begin MEASUREMENT ZFFSAB._.IgnitionStatusIn.iv_KL15 "Input value of terminal 15 CAN signal" UBYTE SAB_STANDARD_S2_S3 1 100 0 15 ECU_ADDRESS 0xFFF8DBEC DISPLAY_IDENTIFIER iv_KL15.IgnitionStatusIn._.ZFFSAB /end MEASUREMENT
/begin MEASUREMENT ZFFSAB._.IgnitionStatusIn.iv_KL15Sts "Input value of the status of terminal 15 CAN signal" UBYTE SAB_STANDARD_S2_S3 1 100 0 255 ECU_ADDRESS 0xFFF8DBEE DISPLAY_IDENTIFIER iv_KL15Sts.IgnitionStatusIn._.ZFFSAB /end MEASUREMENT
/begin MEASUREMENT ZFFSAB._.IgnitionStatusIn.iv_KL15Sts_ "complement of the status of the input signal received via CAN" UBYTE SAB_STANDARD_S2_S3 1 100 0 255 ECU_ADDRESS 0xFFF8DBEF DISPLAY_IDENTIFIER iv_KL15Sts_.IgnitionStatusIn._.ZFFSAB /end MEASUREMENT
/begin MEASUREMENT ZFFSAB._.IgnitionStatusIn.iv_KL15_ "Complement of input value of terminal 15 CAN signal" UBYTE SAB_STANDARD_S2_S3 1 100 0 255 ECU_ADDRESS 0xFFF8DBED DISPLAY_IDENTIFIER iv_KL15_.IgnitionStatusIn._.ZFFSAB /end MEASUREMENT
/begin MEASUREMENT ZFFSAB._.IgnitionStatusIn.iv_KLDiv "Diversity input signal of the can signal" UBYTE SAB_STANDARD_S2_S3 1 100 0 255 ECU_ADDRESS 0xFFF8DBF0 DISPLAY_IDENTIFIER iv_KLDiv.IgnitionStatusIn._.ZFFSAB /end MEASUREMENT
/begin MEASUREMENT ZFFSAB._.IgnitionStatusIn.iv_KLDiv_ "Complement of diversity input signal of the can signal" UBYTE SAB_STANDARD_S2_S3 1 100 0 255 ECU_ADDRESS 0xFFF8DBF1 DISPLAY_IDENTIFIER iv_KLDiv_.IgnitionStatusIn._.ZFFSAB /end MEASUREMENT
/begin MEASUREMENT ZFFSAB._.IgnitionStatusIn.iv_t_System "input System 1ms Counter (overspills to 0 with 2^32-1)" ULONG SAB_T_TIMER_1MS_S2_S3 1 100 0 4294967295 ECU_ADDRESS 0xFFF8DBE8 DISPLAY_IDENTIFIER iv_t_System.IgnitionStatusIn._.ZFFSAB /end MEASUREMENT
/begin MEASUREMENT ZFFSAB._.IgnitionStatusIn.iv_u_Kl15_Pin "Input of the voltage terminal 15 value" UWORD SAB_U_1VOLT1000_S2_S3 1 100 0 25 ECU_ADDRESS 0xFFF8DBE6 DISPLAY_IDENTIFIER iv_u_Kl15_Pin.IgnitionStatusIn._.ZFFSAB /end MEASUREMENT
/begin MEASUREMENT ZFFSAB._.IgnitionStatusIn.st_IgnPlausiState "actual state of the state machine of the plausibility check CAN/hardware signal KL15" UBYTE SAB_STANDARD_S2_S3 1 100 0 4 ECU_ADDRESS 0xFFF8DBE4 DISPLAY_IDENTIFIER st_IgnPlausiState.IgnitionStatusIn._.ZFFSAB /end MEASUREMENT
/begin MEASUREMENT ZFFSAB._.IgnitionStatusIn.st_IgnPlausiState_ "complement of actual state of the state machine of the plausibility check CAN/hardware signal KL15" UBYTE SAB_STANDARD_S2_S3 1 100 0 4 ECU_ADDRESS 0xFFF8DBE5 DISPLAY_IDENTIFIER st_IgnPlausiState_.IgnitionStatusIn._.ZFFSAB /end MEASUREMENT
/begin MEASUREMENT ZFFSAB._.IgnitionStatusIn.sv_KL15 "Output value of ignition 0=init 1=switching on 2=on 3=switching off 4=off" UBYTE SAB_STANDARD_S2_S3 1 100 0 4 ECU_ADDRESS 0xFFF8DBF3 DISPLAY_IDENTIFIER sv_KL15.IgnitionStatusIn._.ZFFSAB /end MEASUREMENT
/begin MEASUREMENT ZFFSAB._.IgnitionStatusIn.sv_KL15Sts "Error state of output value 0=no error 1=substitute value 2=error" UBYTE SAB_STANDARD_S2_S3 1 100 0 2 ECU_ADDRESS 0xFFF8DBF5 DISPLAY_IDENTIFIER sv_KL15Sts.IgnitionStatusIn._.ZFFSAB /end MEASUREMENT
/begin MEASUREMENT ZFFSAB._.IgnitionStatusIn.sv_KL15Sts_ "Complement of error state of output value" UBYTE SAB_STANDARD_S2_S3 1 100 0 255 ECU_ADDRESS 0xFFF8DBF6 DISPLAY_IDENTIFIER sv_KL15Sts_.IgnitionStatusIn._.ZFFSAB /end MEASUREMENT
/begin MEASUREMENT ZFFSAB._.IgnitionStatusIn.sv_KL15_ "Complement of output value" UBYTE SAB_STANDARD_S2_S3 1 100 0 255 ECU_ADDRESS 0xFFF8DBF4 DISPLAY_IDENTIFIER sv_KL15_.IgnitionStatusIn._.ZFFSAB /end MEASUREMENT
/begin MEASUREMENT ZFFSAB._.IgnitionStatusIn.sv_f_IgnOn "Output flag 1=Ignition on 0=Ignition off" UBYTE SAB_STANDARD_S2_S3 1 100 0 1 ECU_ADDRESS 0xFFF8DBF2 DISPLAY_IDENTIFIER sv_f_IgnOn.IgnitionStatusIn._.ZFFSAB /end MEASUREMENT
/begin MEASUREMENT ZFFSAB._.IgnitionStatusIn.t_IgnTimer.time "Description for this variable only in SW documentation possible not in asap2" ULONG SAB_T_TIMER_10MS_S2_S3 1 100 0 42949672950 ECU_ADDRESS 0xFFF8DBC4 DISPLAY_IDENTIFIER time.t_IgnTimer.IgnitionStatusIn._.ZFFSAB /end MEASUREMENT
/begin MEASUREMENT ZFFSAB._.IgnitionStatusIn.t_IgnTimer.time_ "Description for this variable only in SW documentation possible not in asap2" ULONG SAB_T_TIMER_10MS_S2_S3 1 100 0 42949672950 ECU_ADDRESS 0xFFF8DBC8 DISPLAY_IDENTIFIER time_.t_IgnTimer.IgnitionStatusIn._.ZFFSAB /end MEASUREMENT
/begin MEASUREMENT ZFFSAB._.IgnitionStatusIn.tmr_IgnPlausiDelay.time "Description for this variable only in SW documentation possible not in asap2" ULONG SAB_T_TIMER_10MS_S2_S3 1 100 0 42949672950 ECU_ADDRESS 0xFFF8DBD4 DISPLAY_IDENTIFIER time.tmr_IgnPlausiDelay.IgnitionStatusIn._.ZFFSAB /end MEASUREMENT
/begin MEASUREMENT ZFFSAB._.IgnitionStatusIn.tmr_IgnPlausiDelay.time_ "Description for this variable only in SW documentation possible not in asap2" ULONG SAB_T_TIMER_10MS_S2_S3 1 100 0 42949672950 ECU_ADDRESS 0xFFF8DBD8 DISPLAY_IDENTIFIER time_.tmr_IgnPlausiDelay.IgnitionStatusIn._.ZFFSAB /end MEASUREMENT
/begin MEASUREMENT ZFFSAB._.IgnitionStatusIn.tmr_IgnPlausiTol.time "Description for this variable only in SW documentation possible not in asap2" ULONG SAB_T_TIMER_10MS_S2_S3 1 100 0 42949672950 ECU_ADDRESS 0xFFF8DBCC DISPLAY_IDENTIFIER time.tmr_IgnPlausiTol.IgnitionStatusIn._.ZFFSAB /end MEASUREMENT
/begin MEASUREMENT ZFFSAB._.IgnitionStatusIn.tmr_IgnPlausiTol.time_ "Description for this variable only in SW documentation possible not in asap2" ULONG SAB_T_TIMER_10MS_S2_S3 1 100 0 42949672950 ECU_ADDRESS 0xFFF8DBD0 DISPLAY_IDENTIFIER time_.tmr_IgnPlausiTol.IgnitionStatusIn._.ZFFSAB /end MEASUREMENT
/begin MEASUREMENT ZFFSAB._.InclinationIn.f_SensErr "Error flag of Sens-signal" UBYTE SAB_STANDARD_S2_S3 1 100 0 1 ECU_ADDRESS 0xFFF95D5E DISPLAY_IDENTIFIER f_SensErr.InclinationIn._.ZFFSAB /end MEASUREMENT
/begin MEASUREMENT ZFFSAB._.InclinationIn.iv_Sens "Input raw signal for inclination" UWORD SAB_PHI_SENS_1GRAD20_M1280_S2_S3 1 100 -64 140.75 ECU_ADDRESS 0xFFF95D56 DISPLAY_IDENTIFIER iv_Sens.InclinationIn._.ZFFSAB /end MEASUREMENT
/begin MEASUREMENT ZFFSAB._.InclinationIn.iv_SensErr "Extra error signal for inclination signal" UBYTE SAB_STANDARD_S2_S3 1 100 0 1 ECU_ADDRESS 0xFFF95D54 DISPLAY_IDENTIFIER iv_SensErr.InclinationIn._.ZFFSAB /end MEASUREMENT
/begin MEASUREMENT ZFFSAB._.InclinationIn.iv_SensSts "Input CAN message status for inclination signal" UBYTE SAB_STANDARD_S2_S3 1 100 0 255 ECU_ADDRESS 0xFFF95D58 DISPLAY_IDENTIFIER iv_SensSts.InclinationIn._.ZFFSAB /end MEASUREMENT
/begin MEASUREMENT ZFFSAB._.InclinationIn.sv_AGS_Acclivity "Output signal of inclination for AGS" UWORD SAB_PROZENT10_M2000_S2_S3 1 100 -200 200 ECU_ADDRESS 0xFFF95D5C DISPLAY_IDENTIFIER sv_AGS_Acclivity.InclinationIn._.ZFFSAB /end MEASUREMENT
/begin MEASUREMENT ZFFSAB._.InclinationIn.sv_Sens "Output signal for inclination" UBYTE SAB_PHI_SENS_1GRAD3_M128_S2_S3 1 100 -42.6666666667 42.3333333333 ECU_ADDRESS 0xFFF95D59 DISPLAY_IDENTIFIER sv_Sens.InclinationIn._.ZFFSAB /end MEASUREMENT
/begin MEASUREMENT ZFFSAB._.InclinationIn.sv_SensSts "Output status signal for inclination" UBYTE SAB_STANDARD_S2_S3 1 100 0 2 ECU_ADDRESS 0xFFF95D5A DISPLAY_IDENTIFIER sv_SensSts.InclinationIn._.ZFFSAB /end MEASUREMENT
/begin MEASUREMENT ZFFSAB._.Interfi.iv_EepromBusy "Input signal of _GET_EE_BUSY macro from Siemens" UBYTE SAB_STANDARD_S2_S3 1 100 0 1 ECU_ADDRESS 0xFFF96ECC DISPLAY_IDENTIFIER iv_EepromBusy.Interfi._.ZFFSAB /end MEASUREMENT
/begin MEASUREMENT ZFFSAB._.Interfi.iv_Kraftschluss "Input value for power transmission" UBYTE SAB_STANDARD_S2_S3 1 100 0 6 ECU_ADDRESS 0xFFF96ECF DISPLAY_IDENTIFIER iv_Kraftschluss.Interfi._.ZFFSAB /end MEASUREMENT
/begin MEASUREMENT ZFFSAB._.Interfi.iv_Pos "Input value for position of Gear Lever" UBYTE SAB_STANDARD_S2_S3 1 100 0 255 ECU_ADDRESS 0xFFF96ECD DISPLAY_IDENTIFIER iv_Pos.Interfi._.ZFFSAB /end MEASUREMENT
/begin MEASUREMENT ZFFSAB._.Interfi.iv_PosSts "Input CAN message status for position of Gear Lever signal" UBYTE SAB_STANDARD_S2_S3 1 100 0 255 ECU_ADDRESS 0xFFF96ECE DISPLAY_IDENTIFIER iv_PosSts.Interfi._.ZFFSAB /end MEASUREMENT
/begin MEASUREMENT ZFFSAB._.Interfi.iv_u_Batt_Diag "Input value for voltage of battery for local diagnostics" UWORD SAB_U_1VOLT1000_S2_S3 1 100 0 65.535 ECU_ADDRESS 0xFFF96ECA DISPLAY_IDENTIFIER iv_u_Batt_Diag.Interfi._.ZFFSAB /end MEASUREMENT
/begin MEASUREMENT ZFFSAB._.Interfo.arg_idx "0x00 means reference page and 0x01 means working page" UBYTE SAB_STANDARD_S2_S3 1 100 0 1 ECU_ADDRESS 0xFFF96D2C DISPLAY_IDENTIFIER arg_idx.Interfo._.ZFFSAB /end MEASUREMENT
/begin MEASUREMENT ZFFSAB._.Interfo.arg_idx_komp "0xFF means reference page and 0xFE means working page" UBYTE SAB_STANDARD_S2_S3 1 100 0 255 ECU_ADDRESS 0xFFF96D2D DISPLAY_IDENTIFIER arg_idx_komp.Interfo._.ZFFSAB /end MEASUREMENT
/begin MEASUREMENT ZFFSAB._.Interfo.f_erase_infomemory "if set the internal info memory will be erased" UBYTE SAB_STANDARD_S2_S3 1 100 0 1 ECU_ADDRESS 0xFFF96D2B DISPLAY_IDENTIFIER f_erase_infomemory.Interfo._.ZFFSAB /end MEASUREMENT
/begin MEASUREMENT ZFFSAB._.LDMDesiredTorqueIn.f_LDMModeErr "Error flag of ACC/DCC program mode" UBYTE SAB_STANDARD_S2_S3 1 100 0 1 ECU_ADDRESS 0xFFF96E7A DISPLAY_IDENTIFIER f_LDMModeErr.LDMDesiredTorqueIn._.ZFFSAB /end MEASUREMENT
/begin MEASUREMENT ZFFSAB._.LDMDesiredTorqueIn.f_m_LDMErr "Error flag of desired torque-LDM" UBYTE SAB_STANDARD_S2_S3 1 100 0 1 ECU_ADDRESS 0xFFF96E79 DISPLAY_IDENTIFIER f_m_LDMErr.LDMDesiredTorqueIn._.ZFFSAB /end MEASUREMENT
/begin MEASUREMENT ZFFSAB._.LDMDesiredTorqueIn.iv_FASMode "Input value controlling state of LDM system from CAN" UBYTE SAB_STANDARD_S2_S3 1 100 0 15 ECU_ADDRESS 0xFFF96E6A DISPLAY_IDENTIFIER iv_FASMode.LDMDesiredTorqueIn._.ZFFSAB /end MEASUREMENT
/begin MEASUREMENT ZFFSAB._.LDMDesiredTorqueIn.iv_FASModeSts "Input value message status of LDM CAN Message" UBYTE SAB_STANDARD_S2_S3 1 100 0 255 ECU_ADDRESS 0xFFF96E6B DISPLAY_IDENTIFIER iv_FASModeSts.LDMDesiredTorqueIn._.ZFFSAB /end MEASUREMENT
/begin MEASUREMENT ZFFSAB._.LDMDesiredTorqueIn.iv_m_LDM "Input value desired torque-LDM from CAN" UWORD SAB_M_1NM_M32000_S2_S3 1 100 -32000 0 ECU_ADDRESS 0xFFF96E6C DISPLAY_IDENTIFIER iv_m_LDM.LDMDesiredTorqueIn._.ZFFSAB /end MEASUREMENT
/begin MEASUREMENT ZFFSAB._.LDMDesiredTorqueIn.iv_m_LDMSts "Input value message status of LDM CAN Message" UBYTE SAB_STANDARD_S2_S3 1 100 0 255 ECU_ADDRESS 0xFFF96E6E DISPLAY_IDENTIFIER iv_m_LDMSts.LDMDesiredTorqueIn._.ZFFSAB /end MEASUREMENT
/begin MEASUREMENT ZFFSAB._.LDMDesiredTorqueIn.sv_LDMDynamic "Output value of dynamic request" UBYTE SAB_STANDARD_S2_S3 1 100 0 1 ECU_ADDRESS 0xFFF96E73 DISPLAY_IDENTIFIER sv_LDMDynamic.LDMDesiredTorqueIn._.ZFFSAB /end MEASUREMENT
/begin MEASUREMENT ZFFSAB._.LDMDesiredTorqueIn.sv_LDMDynamic2 "Output value of dynamic2 request" UBYTE SAB_STANDARD_S2_S3 1 100 0 255 ECU_ADDRESS 0xFFF96E75 DISPLAY_IDENTIFIER sv_LDMDynamic2.LDMDesiredTorqueIn._.ZFFSAB /end MEASUREMENT
/begin MEASUREMENT ZFFSAB._.LDMDesiredTorqueIn.sv_LDMDynamic2Sts "Output value signal status of dynamic2 request" UBYTE SAB_STANDARD_S2_S3 1 100 0 2 ECU_ADDRESS 0xFFF96E76 DISPLAY_IDENTIFIER sv_LDMDynamic2Sts.LDMDesiredTorqueIn._.ZFFSAB /end MEASUREMENT
/begin MEASUREMENT ZFFSAB._.LDMDesiredTorqueIn.sv_LDMDynamicSts "Output value signal status of dynamic request" UBYTE SAB_STANDARD_S2_S3 1 100 0 2 ECU_ADDRESS 0xFFF96E74 DISPLAY_IDENTIFIER sv_LDMDynamicSts.LDMDesiredTorqueIn._.ZFFSAB /end MEASUREMENT
/begin MEASUREMENT ZFFSAB._.LDMDesiredTorqueIn.sv_LDMMode "ACC/DCC Schaltprogram Zustand" UBYTE SAB_STANDARD_S2_S3 1 100 0 1 ECU_ADDRESS 0xFFF96E77 DISPLAY_IDENTIFIER sv_LDMMode.LDMDesiredTorqueIn._.ZFFSAB /end MEASUREMENT
/begin MEASUREMENT ZFFSAB._.LDMDesiredTorqueIn.sv_LDMModeSts "Output value signal status of controlling state of LDM system" UBYTE SAB_STANDARD_S2_S3 1 100 0 2 ECU_ADDRESS 0xFFF96E78 DISPLAY_IDENTIFIER sv_LDMModeSts.LDMDesiredTorqueIn._.ZFFSAB /end MEASUREMENT
/begin MEASUREMENT ZFFSAB._.LDMDesiredTorqueIn.sv_m_LDM "Output value of desired torque-LDM" SWORD SAB_M_1NM_S2_S3 1 100 -32000 32000 ECU_ADDRESS 0xFFF96E70 DISPLAY_IDENTIFIER sv_m_LDM.LDMDesiredTorqueIn._.ZFFSAB /end MEASUREMENT
/begin MEASUREMENT ZFFSAB._.LDMDesiredTorqueIn.sv_m_LDMSts "Output value signal status of desired torque-LDM" UBYTE SAB_STANDARD_S2_S3 1 100 0 2 ECU_ADDRESS 0xFFF96E72 DISPLAY_IDENTIFIER sv_m_LDMSts.LDMDesiredTorqueIn._.ZFFSAB /end MEASUREMENT
/begin MEASUREMENT ZFFSAB._.LayerAGS.IstGangAGS "Calculated ZF-Istgang" SBYTE SAB_STANDARD_S2_S3 1 100 -128 127 ECU_ADDRESS 0xFFF958CD DISPLAY_IDENTIFIER IstGangAGS.LayerAGS._.ZFFSAB /end MEASUREMENT
/begin MEASUREMENT ZFFSAB._.LayerAGS.SollGangMoeglich "Calculated possible Request for ZGangSoll" SBYTE SAB_STANDARD_S2_S3 1 100 -1 8 ECU_ADDRESS 0xFFF958D4 DISPLAY_IDENTIFIER SollGangMoeglich.LayerAGS._.ZFFSAB /end MEASUREMENT
/begin MEASUREMENT ZFFSAB._.LayerAGS.ZielGangAGS "Calculated ZF-Zielgang" SBYTE SAB_STANDARD_S2_S3 1 100 -128 127 ECU_ADDRESS 0xFFF958CC DISPLAY_IDENTIFIER ZielGangAGS.LayerAGS._.ZFFSAB /end MEASUREMENT
/begin MEASUREMENT ZFFSAB._.LayerAGS.iv_AGS_DispRpmEngCrsh "Input value Dynamical engine speed in LayerAGS" UWORD SAB_N_10RPM_S2_S3 1 100 0 100000 ECU_ADDRESS 0xFFF958D6 DISPLAY_IDENTIFIER iv_AGS_DispRpmEngCrsh.LayerAGS._.ZFFSAB /end MEASUREMENT
/begin MEASUREMENT ZFFSAB._.LayerAGS.iv_AGS_EFahrKL "Input CAN message. Control index to choose energetic Operationstrategie." UBYTE SAB_STANDARD_S2_S3 1 100 0 15 ECU_ADDRESS 0xFFF958E0 DISPLAY_IDENTIFIER iv_AGS_EFahrKL.LayerAGS._.ZFFSAB /end MEASUREMENT
/begin MEASUREMENT ZFFSAB._.LayerAGS.iv_AGS_EFahrKLSts "Input CAN message status. Control index to choose energetic Operationstrategie." UBYTE SAB_STANDARD_S2_S3 1 100 0 255 ECU_ADDRESS 0xFFF958E1 DISPLAY_IDENTIFIER iv_AGS_EFahrKLSts.LayerAGS._.ZFFSAB /end MEASUREMENT
/begin MEASUREMENT ZFFSAB._.LayerAGS.iv_AGS_EngStartTyp "Input CAN message. Input value engine start modein LayerAGS." UBYTE SAB_STANDARD_S2_S3 1 100 0 15 ECU_ADDRESS 0xFFF958E5 DISPLAY_IDENTIFIER iv_AGS_EngStartTyp.LayerAGS._.ZFFSAB /end MEASUREMENT
/begin MEASUREMENT ZFFSAB._.LayerAGS.iv_AGS_EngStartTypSts "Input CAN message status. Input value Status of engine start mode in LayerAGS." UBYTE SAB_STANDARD_S2_S3 1 100 0 255 ECU_ADDRESS 0xFFF958E6 DISPLAY_IDENTIFIER iv_AGS_EngStartTypSts.LayerAGS._.ZFFSAB /end MEASUREMENT
/begin MEASUREMENT ZFFSAB._.LayerAGS.iv_AGS_GWkFDyn "Input value control info for tcc dynamic-function in LayerAGS" UBYTE SAB_STANDARD_S2_S3 1 100 0 1 ECU_ADDRESS 0xFFF958D8 DISPLAY_IDENTIFIER iv_AGS_GWkFDyn.LayerAGS._.ZFFSAB /end MEASUREMENT
/begin MEASUREMENT ZFFSAB._.LayerAGS.iv_AGS_IdxGrbDyn "Input value Dynamic Gearbox Index in LayerAGS" UBYTE SAB_STANDARD_S2_S3 1 100 0 255 ECU_ADDRESS 0xFFF958D9 DISPLAY_IDENTIFIER iv_AGS_IdxGrbDyn.LayerAGS._.ZFFSAB /end MEASUREMENT
/begin MEASUREMENT ZFFSAB._.LayerAGS.iv_AGS_K0ZielZustand "Input value target state K0 clutch in LayerAGS" UBYTE SAB_STANDARD_S2_S3 1 100 0 6 ECU_ADDRESS 0xFFF958DA DISPLAY_IDENTIFIER iv_AGS_K0ZielZustand.LayerAGS._.ZFFSAB /end MEASUREMENT
/begin MEASUREMENT ZFFSAB._.LayerAGS.iv_AGS_MEm "Input CAN message. Input value Electrical machine torque in LayerAGS" UWORD SAB_M_NM2_M2047_S2_S3 1 100 -1023.5 1024 ECU_ADDRESS 0xFFF958E2 DISPLAY_IDENTIFIER iv_AGS_MEm.LayerAGS._.ZFFSAB /end MEASUREMENT
/begin MEASUREMENT ZFFSAB._.LayerAGS.iv_AGS_MEmSts "Input CAN message status. Input value Electrical machine torque in LayerAGS" UBYTE SAB_STANDARD_S2_S3 1 100 0 255 ECU_ADDRESS 0xFFF958E4 DISPLAY_IDENTIFIER iv_AGS_MEmSts.LayerAGS._.ZFFSAB /end MEASUREMENT
/begin MEASUREMENT ZFFSAB._.LayerAGS.iv_AGS_MSA "MSA-request to ATSYS in LayerAGS" UBYTE SAB_STANDARD_S2_S3 1 100 0 1 ECU_ADDRESS 0xFFF958DB DISPLAY_IDENTIFIER iv_AGS_MSA.LayerAGS._.ZFFSAB /end MEASUREMENT
/begin MEASUREMENT ZFFSAB._.LayerAGS.iv_AGS_RpmDynOut "Input value Dynamical revolution counter request in LayerAGS" UBYTE SAB_STANDARD_S2_S3 1 100 0 1 ECU_ADDRESS 0xFFF958DC DISPLAY_IDENTIFIER iv_AGS_RpmDynOut.LayerAGS._.ZFFSAB /end MEASUREMENT
/begin MEASUREMENT ZFFSAB._.LayerAGS.iv_AGS_ZGangSoll "Input value ZGangSoll in LayerAGS" UBYTE SAB_STANDARD_S2_S3 1 100 0 12 ECU_ADDRESS 0xFFF958DD DISPLAY_IDENTIFIER iv_AGS_ZGangSoll.LayerAGS._.ZFFSAB /end MEASUREMENT
/begin MEASUREMENT ZFFSAB._.LayerAGS.iv_AGS_ZK0Soll "Input value K0 state request in LayerAGS" UBYTE SAB_STANDARD_S2_S3 1 100 0 5 ECU_ADDRESS 0xFFF958DF DISPLAY_IDENTIFIER iv_AGS_ZK0Soll.LayerAGS._.ZFFSAB /end MEASUREMENT
/begin MEASUREMENT ZFFSAB._.LayerAGS.iv_AGS_ZkaIndex "Interpretation of drivers request to ATSYS in LayerAGS" UBYTE SAB_STANDARD_S2_S3 1 100 0 14 ECU_ADDRESS 0xFFF958DE DISPLAY_IDENTIFIER iv_AGS_ZkaIndex.LayerAGS._.ZFFSAB /end MEASUREMENT
/begin MEASUREMENT ZFFSAB._.LayerAGS.sv_AGS_CkbTout "Output value ambient temperature in LayerAGS" UBYTE SAB_C_TEMPEXTERN_CEL2_M40_S2_S3 1 100 -40 87.5 ECU_ADDRESS 0xFFF958B8 DISPLAY_IDENTIFIER sv_AGS_CkbTout.LayerAGS._.ZFFSAB /end MEASUREMENT
/begin MEASUREMENT ZFFSAB._.LayerAGS.sv_AGS_EFahrKL "Output value current electronic driving strategy in LayerAGS" UBYTE SAB_STANDARD_S2_S3 1 100 0 5 ECU_ADDRESS 0xFFF958E7 DISPLAY_IDENTIFIER sv_AGS_EFahrKL.LayerAGS._.ZFFSAB /end MEASUREMENT
/begin MEASUREMENT ZFFSAB._.LayerAGS.sv_AGS_EngStartTyp "Output value engine start mode in LayerAGS" UBYTE SAB_STANDARD_S2_S3 1 100 0 4 ECU_ADDRESS 0xFFF958B9 DISPLAY_IDENTIFIER sv_AGS_EngStartTyp.LayerAGS._.ZFFSAB /end MEASUREMENT
/begin MEASUREMENT ZFFSAB._.LayerAGS.sv_AGS_ForceHs "Input value current forced changing gears up in LayerAGS" UBYTE SAB_STANDARD_S2_S3 1 100 0 3 ECU_ADDRESS 0xFFF958BA DISPLAY_IDENTIFIER sv_AGS_ForceHs.LayerAGS._.ZFFSAB /end MEASUREMENT
/begin MEASUREMENT ZFFSAB._.LayerAGS.sv_AGS_GangZielAgs "Output value possible Request for ZGangSoll in LayerAGS" UBYTE SAB_STANDARD_S2_S3 1 100 0 12 ECU_ADDRESS 0xFFF958D5 DISPLAY_IDENTIFIER sv_AGS_GangZielAgs.LayerAGS._.ZFFSAB /end MEASUREMENT
/begin MEASUREMENT ZFFSAB._.LayerAGS.sv_AGS_IstGang "Output value IstGang in LayerAGS" UBYTE SAB_STANDARD_S2_S3 1 100 0 12 ECU_ADDRESS 0xFFF958CF DISPLAY_IDENTIFIER sv_AGS_IstGang.LayerAGS._.ZFFSAB /end MEASUREMENT
/begin MEASUREMENT ZFFSAB._.LayerAGS.sv_AGS_K0IstZustand "Output value actual state K0 clutch in LayerAGS" UBYTE SAB_STANDARD_S2_S3 1 100 0 5 ECU_ADDRESS 0xFFF958BB DISPLAY_IDENTIFIER sv_AGS_K0IstZustand.LayerAGS._.ZFFSAB /end MEASUREMENT
/begin MEASUREMENT ZFFSAB._.LayerAGS.sv_AGS_K0ZielZustand "Output value target state K0 clutch in LayerAGS" UBYTE SAB_STANDARD_S2_S3 1 100 0 5 ECU_ADDRESS 0xFFF958BC DISPLAY_IDENTIFIER sv_AGS_K0ZielZustand.LayerAGS._.ZFFSAB /end MEASUREMENT
/begin MEASUREMENT ZFFSAB._.LayerAGS.sv_AGS_MEm "Output value Electrical machine torque in LayerAGS" SWORD SAB_M_1NM_S2_S3 1 100 -8192 8192 ECU_ADDRESS 0xFFF958BE DISPLAY_IDENTIFIER sv_AGS_MEm.LayerAGS._.ZFFSAB /end MEASUREMENT
/begin MEASUREMENT ZFFSAB._.LayerAGS.sv_AGS_MTurbine "Output value Turbine Torque in LayerAGS" UWORD SAB_M_1NM_M32000_S2_S3 1 100 -32000 33535 ECU_ADDRESS 0xFFF958CA DISPLAY_IDENTIFIER sv_AGS_MTurbine.LayerAGS._.ZFFSAB /end MEASUREMENT
/begin MEASUREMENT ZFFSAB._.LayerAGS.sv_AGS_MsaAdaptRs "Output value Request for RS21 adaption in LayerAGS" UBYTE SAB_STANDARD_S2_S3 1 100 0 1 ECU_ADDRESS 0xFFF958C0 DISPLAY_IDENTIFIER sv_AGS_MsaAdaptRs.LayerAGS._.ZFFSAB /end MEASUREMENT
/begin MEASUREMENT ZFFSAB._.LayerAGS.sv_AGS_Pos "Output value braketorque in LayerAGS" UBYTE SAB_STANDARD_S2_S3 1 100 0 255 ECU_ADDRESS 0xFFF958C1 DISPLAY_IDENTIFIER sv_AGS_Pos.LayerAGS._.ZFFSAB /end MEASUREMENT
/begin MEASUREMENT ZFFSAB._.LayerAGS.sv_AGS_PosStat "Output value braketorque status in LayerAGS" UBYTE SAB_STANDARD_S2_S3 1 100 0 2 ECU_ADDRESS 0xFFF958C2 DISPLAY_IDENTIFIER sv_AGS_PosStat.LayerAGS._.ZFFSAB /end MEASUREMENT
/begin MEASUREMENT ZFFSAB._.LayerAGS.sv_AGS_PtDampgActive "Output value power train damping is active in LayerAGS" UBYTE SAB_STANDARD_S2_S3 1 100 0 1 ECU_ADDRESS 0xFFF958C3 DISPLAY_IDENTIFIER sv_AGS_PtDampgActive.LayerAGS._.ZFFSAB /end MEASUREMENT
/begin MEASUREMENT ZFFSAB._.LayerAGS.sv_AGS_RpmEngMax "Output value max allowed engine speed from engine unit in LayerAGS" UBYTE SAB_N_50RPM_S2_S3 1 100 0 12750 ECU_ADDRESS 0xFFF958C4 DISPLAY_IDENTIFIER sv_AGS_RpmEngMax.LayerAGS._.ZFFSAB /end MEASUREMENT
/begin MEASUREMENT ZFFSAB._.LayerAGS.sv_AGS_ShiftDelay "Output value ShiftDelay in LayerAGS" UBYTE SAB_STANDARD_S2_S3 1 100 0 1 ECU_ADDRESS 0xFFF958D1 DISPLAY_IDENTIFIER sv_AGS_ShiftDelay.LayerAGS._.ZFFSAB /end MEASUREMENT
/begin MEASUREMENT ZFFSAB._.LayerAGS.sv_AGS_SportGetriebe "Output value current forced changing gears up in LayerAGS" UBYTE SAB_STANDARD_S2_S3 1 100 0 15 ECU_ADDRESS 0xFFF958C5 DISPLAY_IDENTIFIER sv_AGS_SportGetriebe.LayerAGS._.ZFFSAB /end MEASUREMENT
/begin MEASUREMENT ZFFSAB._.LayerAGS.sv_AGS_VVehPlausi "Output value Plausibility of car speed in LayerAGS" UBYTE SAB_STANDARD_S2_S3 1 100 0 5 ECU_ADDRESS 0xFFF958C6 DISPLAY_IDENTIFIER sv_AGS_VVehPlausi.LayerAGS._.ZFFSAB /end MEASUREMENT
/begin MEASUREMENT ZFFSAB._.LayerAGS.sv_AGS_ZGangSoll "Output value Request for ZGangSoll in LayerAGS" SBYTE SAB_STANDARD_S2_S3 1 100 0 8 ECU_ADDRESS 0xFFF958CE DISPLAY_IDENTIFIER sv_AGS_ZGangSoll.LayerAGS._.ZFFSAB /end MEASUREMENT
/begin MEASUREMENT ZFFSAB._.LayerAGS.sv_AGS_ZHasIst "Output value actual State of HAS in LayerAGS" UBYTE SAB_STANDARD_S2_S3 1 100 0 15 ECU_ADDRESS 0xFFF958D2 DISPLAY_IDENTIFIER sv_AGS_ZHasIst.LayerAGS._.ZFFSAB /end MEASUREMENT
/begin MEASUREMENT ZFFSAB._.LayerAGS.sv_AGS_ZHasZiel "Output value target State of HAS in LayerAGS" UBYTE SAB_STANDARD_S2_S3 1 100 0 15 ECU_ADDRESS 0xFFF958D3 DISPLAY_IDENTIFIER sv_AGS_ZHasZiel.LayerAGS._.ZFFSAB /end MEASUREMENT
/begin MEASUREMENT ZFFSAB._.LayerAGS.sv_AGS_ZK0Soll "Output value K0 state request in LayerAGS" UBYTE SAB_STANDARD_S2_S3 1 100 0 3 ECU_ADDRESS 0xFFF958C7 DISPLAY_IDENTIFIER sv_AGS_ZK0Soll.LayerAGS._.ZFFSAB /end MEASUREMENT
/begin MEASUREMENT ZFFSAB._.LayerAGS.sv_AGS_ZielGang "Output value ZielGang in LayerAGS" UBYTE SAB_STANDARD_S2_S3 1 100 0 12 ECU_ADDRESS 0xFFF958D0 DISPLAY_IDENTIFIER sv_AGS_ZielGang.LayerAGS._.ZFFSAB /end MEASUREMENT
/begin MEASUREMENT ZFFSAB._.LayerAGS.sv_f_TrailerInfo_AGS "Output value trailer active in LayerAGS" UBYTE SAB_STANDARD_S2_S3 1 100 0 255 ECU_ADDRESS 0xFFF958C8 DISPLAY_IDENTIFIER sv_f_TrailerInfo_AGS.LayerAGS._.ZFFSAB /end MEASUREMENT
/begin MEASUREMENT ZFFSAB._.LowModeDriveIn.iv_LowMode "Input signal Low Mode" UBYTE SAB_STANDARD_S2_S3 1 100 0 255 ECU_ADDRESS 0xFFF96E3A DISPLAY_IDENTIFIER iv_LowMode.LowModeDriveIn._.ZFFSAB /end MEASUREMENT
/begin MEASUREMENT ZFFSAB._.LowModeDriveIn.iv_LowModeFA "Input signal Low Mode (FACAN)" UBYTE SAB_STANDARD_S2_S3 1 100 0 255 ECU_ADDRESS 0xFFF96E3B DISPLAY_IDENTIFIER iv_LowModeFA.LowModeDriveIn._.ZFFSAB /end MEASUREMENT
/begin MEASUREMENT ZFFSAB._.LowModeDriveIn.iv_LowModeFASts "Input message status Low Mode (FACAN)" UBYTE SAB_STANDARD_S2_S3 1 100 0 255 ECU_ADDRESS 0xFFF96E3D DISPLAY_IDENTIFIER iv_LowModeFASts.LowModeDriveIn._.ZFFSAB /end MEASUREMENT
/begin MEASUREMENT ZFFSAB._.LowModeDriveIn.iv_LowModeSts "Input message status Low Mode" UBYTE SAB_STANDARD_S2_S3 1 100 0 255 ECU_ADDRESS 0xFFF96E3C DISPLAY_IDENTIFIER iv_LowModeSts.LowModeDriveIn._.ZFFSAB /end MEASUREMENT
/begin MEASUREMENT ZFFSAB._.LowModeDriveIn.sv_LowMode "Output signal of GET_LOW_MODE" UBYTE SAB_STANDARD_S2_S3 1 100 0 255 ECU_ADDRESS 0xFFF96E3E DISPLAY_IDENTIFIER sv_LowMode.LowModeDriveIn._.ZFFSAB /end MEASUREMENT
/begin MEASUREMENT ZFFSAB._.LowModeDriveIn.sv_LowModeSts "Output status signal of GET_LOW_MODE_STATUS" UBYTE SAB_STANDARD_S2_S3 1 100 0 2 ECU_ADDRESS 0xFFF96E3F DISPLAY_IDENTIFIER sv_LowModeSts.LowModeDriveIn._.ZFFSAB /end MEASUREMENT
/begin MEASUREMENT ZFFSAB._.MSAIn.f_HIS_gelernt "Flag which informs about the HIS learned state: 0 = not learned 1 = learned" UBYTE SAB_STANDARD_S2_S3 1 100 0 1 ECU_ADDRESS 0xFFF8DC00 DISPLAY_IDENTIFIER f_HIS_gelernt.MSAIn._.ZFFSAB /end MEASUREMENT
/begin MEASUREMENT ZFFSAB._.MSAIn.iv_STAT_MSA "Input value of MSA state" UBYTE SAB_STANDARD_S2_S3 1 100 0 3 ECU_ADDRESS 0xFFF8DBFC DISPLAY_IDENTIFIER iv_STAT_MSA.MSAIn._.ZFFSAB /end MEASUREMENT
/begin MEASUREMENT ZFFSAB._.MSAIn.iv_STAT_MSASts "Input value signal status of MSA state" UBYTE SAB_STANDARD_S2_S3 1 100 0 255 ECU_ADDRESS 0xFFF8DBFD DISPLAY_IDENTIFIER iv_STAT_MSASts.MSAIn._.ZFFSAB /end MEASUREMENT
/begin MEASUREMENT ZFFSAB._.MSAIn.sv_AGS_MsaStat "Flag which informs about the HIS state: 0 = not installed 1 = installed" UBYTE SAB_STANDARD_S2_S3 1 100 0 1 ECU_ADDRESS 0xFFF8DBFF DISPLAY_IDENTIFIER sv_AGS_MsaStat.MSAIn._.ZFFSAB /end MEASUREMENT
/begin MEASUREMENT ZFFSAB._.MSAIn.sv_DiOff "Output value of DI OFF state" UBYTE SAB_STANDARD_S2_S3 1 100 0 255 ECU_ADDRESS 0xFFF8DC01 DISPLAY_IDENTIFIER sv_DiOff.MSAIn._.ZFFSAB /end MEASUREMENT
/begin MEASUREMENT ZFFSAB._.MSAIn.sv_DiOff_ "Complement value of DI OFF state" UBYTE SAB_STANDARD_S2_S3 1 100 0 255 ECU_ADDRESS 0xFFF8DC02 DISPLAY_IDENTIFIER sv_DiOff_.MSAIn._.ZFFSAB /end MEASUREMENT
/begin MEASUREMENT ZFFSAB._.MSAIn.sv_f_HIS_verbaut "Flag which informs about the HIS state: 0 = not installed 1 = installed" UBYTE SAB_STANDARD_S2_S3 1 100 0 1 ECU_ADDRESS 0xFFF8DBFE DISPLAY_IDENTIFIER sv_f_HIS_verbaut.MSAIn._.ZFFSAB /end MEASUREMENT
/begin MEASUREMENT ZFFSAB._.MSAOut.iv_StatusMSAHAS "State of MSA HAS" UBYTE SAB_STANDARD_S2_S3 1 100 0 255 ECU_ADDRESS 0xFFF96D26 DISPLAY_IDENTIFIER iv_StatusMSAHAS.MSAOut._.ZFFSAB /end MEASUREMENT
/begin MEASUREMENT ZFFSAB._.MSAOut.sv_MSA_Rq_Hyb_Grb "Signal approves the prevention for switch-on request of the combustion engine" UBYTE SAB_STANDARD_S2_S3 1 100 0 255 ECU_ADDRESS 0xFFF96D27 DISPLAY_IDENTIFIER sv_MSA_Rq_Hyb_Grb.MSAOut._.ZFFSAB /end MEASUREMENT
/begin MEASUREMENT ZFFSAB._.MSAOut.sv_RqMSA_FnSlctn "signal for the switch-off/on request or the switch-off prevention" UBYTE SAB_STANDARD_S2_S3 1 100 0 255 ECU_ADDRESS 0xFFF96D28 DISPLAY_IDENTIFIER sv_RqMSA_FnSlctn.MSAOut._.ZFFSAB /end MEASUREMENT
/begin MEASUREMENT ZFFSAB._.MaxTorquePredictionEMIn.f_m_maxPredEMErr "Error flag of predicted maximum Torque-signal" UBYTE SAB_STANDARD_S2_S3 1 100 0 1 ECU_ADDRESS 0xFFF96E8B DISPLAY_IDENTIFIER f_m_maxPredEMErr.MaxTorquePredictionEMIn._.ZFFSAB /end MEASUREMENT
/begin MEASUREMENT ZFFSAB._.MaxTorquePredictionEMIn.f_m_minPredEMErr "Error flag of predicted minimum Torque-signal" UBYTE SAB_STANDARD_S2_S3 1 100 0 1 ECU_ADDRESS 0xFFF96E8C DISPLAY_IDENTIFIER f_m_minPredEMErr.MaxTorquePredictionEMIn._.ZFFSAB /end MEASUREMENT
/begin MEASUREMENT ZFFSAB._.MaxTorquePredictionEMIn.iv_m_MaxPredEM "Input signal for maximum torque prediction of the electrical machine" UWORD SAB_M_NM2_M2047_S2_S3 1 100 -1023.5 1024 ECU_ADDRESS 0xFFF96E7C DISPLAY_IDENTIFIER iv_m_MaxPredEM.MaxTorquePredictionEMIn._.ZFFSAB /end MEASUREMENT
/begin MEASUREMENT ZFFSAB._.MaxTorquePredictionEMIn.iv_m_MaxPredEMSts "Status of the input signal for maximum torque prediction of the electrical machine" UBYTE SAB_STANDARD_S2_S3 1 100 0 255 ECU_ADDRESS 0xFFF96E7E DISPLAY_IDENTIFIER iv_m_MaxPredEMSts.MaxTorquePredictionEMIn._.ZFFSAB /end MEASUREMENT
/begin MEASUREMENT ZFFSAB._.MaxTorquePredictionEMIn.iv_m_MinPredEM "Input signal for minimum torque prediction of the electrical machine" UWORD SAB_M_NM2_M2047_S2_S3 1 100 -1023.5 1024 ECU_ADDRESS 0xFFF96E80 DISPLAY_IDENTIFIER iv_m_MinPredEM.MaxTorquePredictionEMIn._.ZFFSAB /end MEASUREMENT
/begin MEASUREMENT ZFFSAB._.MaxTorquePredictionEMIn.iv_m_MinPredEMSts "Status of the input signal for minimum torque prediction of the electrical machine" UBYTE SAB_STANDARD_S2_S3 1 100 0 255 ECU_ADDRESS 0xFFF96E82 DISPLAY_IDENTIFIER iv_m_MinPredEMSts.MaxTorquePredictionEMIn._.ZFFSAB /end MEASUREMENT
/begin MEASUREMENT ZFFSAB._.MaxTorquePredictionEMIn.sv_m_MaxPredEM "Output signal of the predicted maximum torque of the electrical machine" SWORD SAB_M_1NM_S2_S3 1 100 -400 1640 ECU_ADDRESS 0xFFF96E84 DISPLAY_IDENTIFIER sv_m_MaxPredEM.MaxTorquePredictionEMIn._.ZFFSAB /end MEASUREMENT
/begin MEASUREMENT ZFFSAB._.MaxTorquePredictionEMIn.sv_m_MaxPredEMSts "Output status signal of the predicted maximum torque of the electrical machine" UBYTE SAB_STANDARD_S2_S3 1 100 0 2 ECU_ADDRESS 0xFFF96E86 DISPLAY_IDENTIFIER sv_m_MaxPredEMSts.MaxTorquePredictionEMIn._.ZFFSAB /end MEASUREMENT
/begin MEASUREMENT ZFFSAB._.MaxTorquePredictionEMIn.sv_m_MinPredEM "Output signal of the predicted minimum torque of the electrical machine" SWORD SAB_M_1NM_S2_S3 1 100 -400 1640 ECU_ADDRESS 0xFFF96E88 DISPLAY_IDENTIFIER sv_m_MinPredEM.MaxTorquePredictionEMIn._.ZFFSAB /end MEASUREMENT
/begin MEASUREMENT ZFFSAB._.MaxTorquePredictionEMIn.sv_m_MinPredEMSts "Output status signal of the predicted minimum torque of the electrical machine" UBYTE SAB_STANDARD_S2_S3 1 100 0 2 ECU_ADDRESS 0xFFF96E8A DISPLAY_IDENTIFIER sv_m_MinPredEMSts.MaxTorquePredictionEMIn._.ZFFSAB /end MEASUREMENT
/begin MEASUREMENT ZFFSAB._.OBD_CyclesIn.f_OBD_CyclesInfoErr "Error flag of CyclesInfo-signal" UBYTE SAB_STANDARD_S2_S3 1 100 0 1 ECU_ADDRESS 0xFFF95929 DISPLAY_IDENTIFIER f_OBD_CyclesInfoErr.OBD_CyclesIn._.ZFFSAB /end MEASUREMENT
/begin MEASUREMENT ZFFSAB._.OBD_CyclesIn.iv_OBD_CyclesInfo "Input raw signal of OBD cycles information" UBYTE SAB_STANDARD_S2_S3 1 100 0 255 ECU_ADDRESS 0xFFF95920 DISPLAY_IDENTIFIER iv_OBD_CyclesInfo.OBD_CyclesIn._.ZFFSAB /end MEASUREMENT
/begin MEASUREMENT ZFFSAB._.OBD_CyclesIn.iv_OBD_CyclesInfoSts "Input signal message status of OBD cycles information" UBYTE SAB_STANDARD_S2_S3 1 100 0 255 ECU_ADDRESS 0xFFF95921 DISPLAY_IDENTIFIER iv_OBD_CyclesInfoSts.OBD_CyclesIn._.ZFFSAB /end MEASUREMENT
/begin MEASUREMENT ZFFSAB._.OBD_CyclesIn.iv_u_Batt_Diag "actual battery voltage" UWORD SAB_U_1VOLT1000_S2_S3 1 100 0 65.535 ECU_ADDRESS 0xFFF95922 DISPLAY_IDENTIFIER iv_u_Batt_Diag.OBD_CyclesIn._.ZFFSAB /end MEASUREMENT
/begin MEASUREMENT ZFFSAB._.OBD_CyclesIn.sv_OBD_CyclesInfoSts "Output status signal of OBD_CyclesIn" UBYTE SAB_STANDARD_S2_S3 1 100 0 2 ECU_ADDRESS 0xFFF95924 DISPLAY_IDENTIFIER sv_OBD_CyclesInfoSts.OBD_CyclesIn._.ZFFSAB /end MEASUREMENT
/begin MEASUREMENT ZFFSAB._.OBD_CyclesIn.sv_OBD_DrivingCycle "Output status signal of OBD_CyclesIn 0=inactive 1=active 255=signal faulty" UBYTE SAB_STANDARD_S2_S3 1 100 0 2 ECU_ADDRESS 0xFFF95925 DISPLAY_IDENTIFIER sv_OBD_DrivingCycle.OBD_CyclesIn._.ZFFSAB /end MEASUREMENT
/begin MEASUREMENT ZFFSAB._.OBD_CyclesIn.sv_OBD_NormedTrip "Output signal of OBD_CyclesIn 0=inactive 1=active 255=signal faulty" UBYTE SAB_STANDARD_S2_S3 1 100 0 255 ECU_ADDRESS 0xFFF95926 DISPLAY_IDENTIFIER sv_OBD_NormedTrip.OBD_CyclesIn._.ZFFSAB /end MEASUREMENT
/begin MEASUREMENT ZFFSAB._.OBD_CyclesIn.sv_OBD_NormedTripB "Output signal of OBD_CyclesInB 0=inactive 1=active 255=signal faulty" UBYTE SAB_STANDARD_S2_S3 1 100 0 255 ECU_ADDRESS 0xFFF95927 DISPLAY_IDENTIFIER sv_OBD_NormedTripB.OBD_CyclesIn._.ZFFSAB /end MEASUREMENT
/begin MEASUREMENT ZFFSAB._.OBD_CyclesIn.sv_OBD_WarmUpCycle "Output signal of OBD_CyclesIn 0=inactive 1=active 255=signal faulty" UBYTE SAB_STANDARD_S2_S3 1 100 0 255 ECU_ADDRESS 0xFFF95928 DISPLAY_IDENTIFIER sv_OBD_WarmUpCycle.OBD_CyclesIn._.ZFFSAB /end MEASUREMENT
/begin MEASUREMENT ZFFSAB._.OSModeSwitchingOut.OSModeActive "this value shows which mode is online" UBYTE SAB_STANDARD_S2_S3 1 100 0 3 ECU_ADDRESS 0xFFF95970 DISPLAY_IDENTIFIER OSModeActive.OSModeSwitchingOut._.ZFFSAB /end MEASUREMENT
/begin MEASUREMENT ZFFSAB._.OSModeSwitchingOut.OSModeNext "this value shows which mode is online" UBYTE SAB_STANDARD_S2_S3 1 100 0 3 ECU_ADDRESS 0xFFF9596F DISPLAY_IDENTIFIER OSModeNext.OSModeSwitchingOut._.ZFFSAB /end MEASUREMENT
/begin MEASUREMENT ZFFSAB._.OSModeSwitchingOut.iv_n_Eng "Input value for engine speed" UWORD SAB_STANDARD_S2_S3 1 100 0 8000 ECU_ADDRESS 0xFFF9596C DISPLAY_IDENTIFIER iv_n_Eng.OSModeSwitchingOut._.ZFFSAB /end MEASUREMENT
/begin MEASUREMENT ZFFSAB._.OSModeSwitchingOut.iv_n_EngSts "Input value for engine speed signal status" UBYTE SAB_STANDARD_S2_S3 1 100 0 4 ECU_ADDRESS 0xFFF9596E DISPLAY_IDENTIFIER iv_n_EngSts.OSModeSwitchingOut._.ZFFSAB /end MEASUREMENT
/begin MEASUREMENT ZFFSAB._.PMA_ErrorHandling.f_PMA_Error "Error flag for local diagnosis: 0=no error 1=error detected" UBYTE SAB_STANDARD_S2_S3 1 100 0 1 ECU_ADDRESS 0xFFF958B0 DISPLAY_IDENTIFIER f_PMA_Error.PMA_ErrorHandling._.ZFFSAB /end MEASUREMENT
/begin MEASUREMENT ZFFSAB._.PMA_ErrorHandling.f_PMA_TestCondition "Testcondition for local diagnosis: 0=not valid 1=valid" UBYTE SAB_STANDARD_S2_S3 1 100 0 1 ECU_ADDRESS 0xFFF958B1 DISPLAY_IDENTIFIER f_PMA_TestCondition.PMA_ErrorHandling._.ZFFSAB /end MEASUREMENT
/begin MEASUREMENT ZFFSAB._.PMA_ErrorHandling.iv_Brake "CAN-Rawsignal: GETCANFA_RX_ST_BRG_DV :: Statusinformation ueber den Bremseingriff durch den Fahrer oder durch Fahrerassistenzsysteme." UBYTE SAB_STANDARD_S2_S3 1 100 0 63 ECU_ADDRESS 0xFFF958AD DISPLAY_IDENTIFIER iv_Brake.PMA_ErrorHandling._.ZFFSAB /end MEASUREMENT
/begin MEASUREMENT ZFFSAB._.PMA_ErrorHandling.iv_BrakeSts "Status for the CAN-Signal: GETCANFA_RX_ST_BRG_DV :: Bit coded- 0:Signal Ok 1:Time-Out 2:Bus error 3:CAN-version error 4:Checksum error 5:Alive counter error 6:Level 2 error 7:Complement error 8:Bus deactivated or Msg not received on StartUp" UBYTE SAB_STANDARD_S2_S3 1 100 0 255 ECU_ADDRESS 0xFFF958AC DISPLAY_IDENTIFIER iv_BrakeSts.PMA_ErrorHandling._.ZFFSAB /end MEASUREMENT
/begin MEASUREMENT ZFFSAB._.PMA_ErrorHandling.iv_FASMode "CAN-Rawsignal: GETCAN_RX_RQ_OPMO_GRDT_DRS :: Mit diesem Signal uebermittelt das Motorsteuergeraet dem Getriebe die von den FAS angeforderten Betriebsarten." UBYTE SAB_STANDARD_S2_S3 1 100 0 15 ECU_ADDRESS 0xFFF958AE DISPLAY_IDENTIFIER iv_FASMode.PMA_ErrorHandling._.ZFFSAB /end MEASUREMENT
/begin MEASUREMENT ZFFSAB._.PMA_ErrorHandling.iv_FASModeSts "Status for the CAN-Signal: GETCAN_RX_RQ_OPMO_GRDT_DRS :: Bit coded- 0:Signal Ok 1:Time-Out 2:Bus error 3:CAN-version error 4:Checksum error 5:Alive counter error 6:Level 2 error 7:Complement error 8:Bus deactivated or Msg not received on StartUp" UBYTE SAB_STANDARD_S2_S3 1 100 0 255 ECU_ADDRESS 0xFFF958AA DISPLAY_IDENTIFIER iv_FASModeSts.PMA_ErrorHandling._.ZFFSAB /end MEASUREMENT
/begin MEASUREMENT ZFFSAB._.PMA_ErrorHandling.iv_FASPos "CAN-Rawsignal: GETCAN_RX_RQ_OPMO_GRDT_DRS :: Mit diesem Signal uebermittelt das Motorsteuergeraet dem Getriebe die von den FAS angeforderten Betriebsarten." UBYTE SAB_STANDARD_S2_S3 1 100 0 15 ECU_ADDRESS 0xFFF958AF DISPLAY_IDENTIFIER iv_FASPos.PMA_ErrorHandling._.ZFFSAB /end MEASUREMENT
/begin MEASUREMENT ZFFSAB._.PMA_ErrorHandling.iv_FASPosSts "Status for the CAN-Signal: GETCAN_RX_STATUS_TAR_OPMO_PT_GRB :: Bit coded- 0:Signal Ok 1:Time-Out 2:Bus error 3:CAN-version error 4:Checksum error 5:Alive counter error 6:Level 2 error 7:Complement error 8:Bus deactivated or Msg not received on StartUp" UBYTE SAB_STANDARD_S2_S3 1 100 0 255 ECU_ADDRESS 0xFFF958AB DISPLAY_IDENTIFIER iv_FASPosSts.PMA_ErrorHandling._.ZFFSAB /end MEASUREMENT
/begin MEASUREMENT ZFFSAB._.PMA_ErrorHandling.iv_u_Batt_Diag "actual battery voltage" UWORD SAB_U_VOLT1000_S2_S3 1 100 0 65.535 ECU_ADDRESS 0xFFF958A8 DISPLAY_IDENTIFIER iv_u_Batt_Diag.PMA_ErrorHandling._.ZFFSAB /end MEASUREMENT
/begin MEASUREMENT ZFFSAB._.ParkManeuverAssistant.FASModeRaw "Intermediate output signal of sv_FASMode" UBYTE SAB_STANDARD_S2_S3 1 100 0 1 ECU_ADDRESS 0xFFF8DC49 DISPLAY_IDENTIFIER FASModeRaw.ParkManeuverAssistant._.ZFFSAB /end MEASUREMENT
/begin MEASUREMENT ZFFSAB._.ParkManeuverAssistant.FASModeRaw_ "Intermediate complement of sv_FASMode" UBYTE SAB_STANDARD_S2_S3 1 100 0 255 ECU_ADDRESS 0xFFF8DC4A DISPLAY_IDENTIFIER FASModeRaw_.ParkManeuverAssistant._.ZFFSAB /end MEASUREMENT
/begin MEASUREMENT ZFFSAB._.ParkManeuverAssistant.f_FASBrakeErr "Error flag of FAS brake-signal" UBYTE SAB_STANDARD_S2_S3 1 100 0 1 ECU_ADDRESS 0xFFF8DC48 DISPLAY_IDENTIFIER f_FASBrakeErr.ParkManeuverAssistant._.ZFFSAB /end MEASUREMENT
/begin MEASUREMENT ZFFSAB._.ParkManeuverAssistant.f_FASPosErr "Error flag of FAS pos-signal" UBYTE SAB_STANDARD_S2_S3 1 100 0 1 ECU_ADDRESS 0xFFF8DC47 DISPLAY_IDENTIFIER f_FASPosErr.ParkManeuverAssistant._.ZFFSAB /end MEASUREMENT
/begin MEASUREMENT ZFFSAB._.ParkManeuverAssistant.f_PMAModeLearned "Learned flag of PMA mode" UBYTE SAB_STANDARD_S2_S3 1 100 0 1 ECU_ADDRESS 0xFFF8DC45 DISPLAY_IDENTIFIER f_PMAModeLearned.ParkManeuverAssistant._.ZFFSAB /end MEASUREMENT
/begin MEASUREMENT ZFFSAB._.ParkManeuverAssistant.f_PMAModeLearned_ "complement learned flag of PMA mode" UBYTE SAB_STANDARD_S2_S3 1 100 0 1 ECU_ADDRESS 0xFFF8DC46 DISPLAY_IDENTIFIER f_PMAModeLearned_.ParkManeuverAssistant._.ZFFSAB /end MEASUREMENT
/begin MEASUREMENT ZFFSAB._.ParkManeuverAssistant.iv_Brake "Input value brake information signal from CAN" UBYTE SAB_STANDARD_S2_S3 1 100 0 63 ECU_ADDRESS 0xFFF8DC32 DISPLAY_IDENTIFIER iv_Brake.ParkManeuverAssistant._.ZFFSAB /end MEASUREMENT
/begin MEASUREMENT ZFFSAB._.ParkManeuverAssistant.iv_BrakeSts "Input value message status of brake information from CAN" UBYTE SAB_STANDARD_S2_S3 1 100 0 255 ECU_ADDRESS 0xFFF8DC34 DISPLAY_IDENTIFIER iv_BrakeSts.ParkManeuverAssistant._.ZFFSAB /end MEASUREMENT
/begin MEASUREMENT ZFFSAB._.ParkManeuverAssistant.iv_BrakeSts_ "Input complement value message status of brake information from CAN" UBYTE SAB_STANDARD_S2_S3 1 100 0 255 ECU_ADDRESS 0xFFF8DC35 DISPLAY_IDENTIFIER iv_BrakeSts_.ParkManeuverAssistant._.ZFFSAB /end MEASUREMENT
/begin MEASUREMENT ZFFSAB._.ParkManeuverAssistant.iv_Brake_ "Input complement value brake information from CAN" UBYTE SAB_STANDARD_S2_S3 1 100 0 255 ECU_ADDRESS 0xFFF8DC33 DISPLAY_IDENTIFIER iv_Brake_.ParkManeuverAssistant._.ZFFSAB /end MEASUREMENT
/begin MEASUREMENT ZFFSAB._.ParkManeuverAssistant.iv_FASGearbox "Input value of FAS Gearbox from ABK" UBYTE SAB_STANDARD_S2_S3 1 100 0 255 ECU_ADDRESS 0xFFF8DC30 DISPLAY_IDENTIFIER iv_FASGearbox.ParkManeuverAssistant._.ZFFSAB /end MEASUREMENT
/begin MEASUREMENT ZFFSAB._.ParkManeuverAssistant.iv_FASGearbox_ "Complement input value of FAS Gearbox from ABK" UBYTE SAB_STANDARD_S2_S3 1 100 0 255 ECU_ADDRESS 0xFFF8DC31 DISPLAY_IDENTIFIER iv_FASGearbox_.ParkManeuverAssistant._.ZFFSAB /end MEASUREMENT
/begin MEASUREMENT ZFFSAB._.ParkManeuverAssistant.iv_FASMode "Input value controlling state of FAS from CAN" UBYTE SAB_STANDARD_S2_S3 1 100 0 15 ECU_ADDRESS 0xFFF8DC28 DISPLAY_IDENTIFIER iv_FASMode.ParkManeuverAssistant._.ZFFSAB /end MEASUREMENT
/begin MEASUREMENT ZFFSAB._.ParkManeuverAssistant.iv_FASModeSts "Input value message status of FAS CAN Message" UBYTE SAB_STANDARD_S2_S3 1 100 0 255 ECU_ADDRESS 0xFFF8DC2A DISPLAY_IDENTIFIER iv_FASModeSts.ParkManeuverAssistant._.ZFFSAB /end MEASUREMENT
/begin MEASUREMENT ZFFSAB._.ParkManeuverAssistant.iv_FASModeSts_ "Complement input value message status of FAS CAN Message" UBYTE SAB_STANDARD_S2_S3 1 100 0 255 ECU_ADDRESS 0xFFF8DC2B DISPLAY_IDENTIFIER iv_FASModeSts_.ParkManeuverAssistant._.ZFFSAB /end MEASUREMENT
/begin MEASUREMENT ZFFSAB._.ParkManeuverAssistant.iv_FASMode_ "Complement input value controlling state of FAS from CAN" UBYTE SAB_STANDARD_S2_S3 1 100 0 255 ECU_ADDRESS 0xFFF8DC29 DISPLAY_IDENTIFIER iv_FASMode_.ParkManeuverAssistant._.ZFFSAB /end MEASUREMENT
/begin MEASUREMENT ZFFSAB._.ParkManeuverAssistant.iv_FASPos "Input value controlling state of FAS position from CAN" UBYTE SAB_STANDARD_S2_S3 1 100 0 15 ECU_ADDRESS 0xFFF8DC2C DISPLAY_IDENTIFIER iv_FASPos.ParkManeuverAssistant._.ZFFSAB /end MEASUREMENT
/begin MEASUREMENT ZFFSAB._.ParkManeuverAssistant.iv_FASPosSts "Input value message status of FAS CAN Message" UBYTE SAB_STANDARD_S2_S3 1 100 0 255 ECU_ADDRESS 0xFFF8DC2E DISPLAY_IDENTIFIER iv_FASPosSts.ParkManeuverAssistant._.ZFFSAB /end MEASUREMENT
/begin MEASUREMENT ZFFSAB._.ParkManeuverAssistant.iv_FASPosSts_ "Complement input value message status of FAS CAN Message" UBYTE SAB_STANDARD_S2_S3 1 100 0 255 ECU_ADDRESS 0xFFF8DC2F DISPLAY_IDENTIFIER iv_FASPosSts_.ParkManeuverAssistant._.ZFFSAB /end MEASUREMENT
/begin MEASUREMENT ZFFSAB._.ParkManeuverAssistant.iv_FASPos_ "Complement input value controlling state of FAS position from CAN" UBYTE SAB_STANDARD_S2_S3 1 100 0 255 ECU_ADDRESS 0xFFF8DC2D DISPLAY_IDENTIFIER iv_FASPos_.ParkManeuverAssistant._.ZFFSAB /end MEASUREMENT
/begin MEASUREMENT ZFFSAB._.ParkManeuverAssistant.sv_FASBrake "Output signal of sv_FASBrake" UBYTE SAB_STANDARD_S2_S3 1 100 0 1 ECU_ADDRESS 0xFFF8DC40 DISPLAY_IDENTIFIER sv_FASBrake.ParkManeuverAssistant._.ZFFSAB /end MEASUREMENT
/begin MEASUREMENT ZFFSAB._.ParkManeuverAssistant.sv_FASBrakeSts "Output status signal of sv_FASBrakeSts" UBYTE SAB_STANDARD_S2_S3 1 100 0 2 ECU_ADDRESS 0xFFF8DC42 DISPLAY_IDENTIFIER sv_FASBrakeSts.ParkManeuverAssistant._.ZFFSAB /end MEASUREMENT
/begin MEASUREMENT ZFFSAB._.ParkManeuverAssistant.sv_FASBrakeSts_ "Complement of sv_FASBrakeSts" UBYTE SAB_STANDARD_S2_S3 1 100 0 255 ECU_ADDRESS 0xFFF8DC43 DISPLAY_IDENTIFIER sv_FASBrakeSts_.ParkManeuverAssistant._.ZFFSAB /end MEASUREMENT
/begin MEASUREMENT ZFFSAB._.ParkManeuverAssistant.sv_FASBrake_ "Complement of sv_FASBrake" UBYTE SAB_STANDARD_S2_S3 1 100 0 255 ECU_ADDRESS 0xFFF8DC41 DISPLAY_IDENTIFIER sv_FASBrake_.ParkManeuverAssistant._.ZFFSAB /end MEASUREMENT
/begin MEASUREMENT ZFFSAB._.ParkManeuverAssistant.sv_FASGearbox "Output signal of sv_FASGearbox provided for CAN 0: gearbox intervention not allowed by driver request 1: allowance by gearbox 2: no allowance by gearbox 3: signal invalid" UBYTE SAB_STANDARD_S2_S3 1 100 0 255 ECU_ADDRESS 0xFFF8DC36 DISPLAY_IDENTIFIER sv_FASGearbox.ParkManeuverAssistant._.ZFFSAB /end MEASUREMENT
/begin MEASUREMENT ZFFSAB._.ParkManeuverAssistant.sv_FASGearbox_ "Complement output signal of sv_FASGearbox provided for CAN" UBYTE SAB_STANDARD_S2_S3 1 100 0 255 ECU_ADDRESS 0xFFF8DC37 DISPLAY_IDENTIFIER sv_FASGearbox_.ParkManeuverAssistant._.ZFFSAB /end MEASUREMENT
/begin MEASUREMENT ZFFSAB._.ParkManeuverAssistant.sv_FASMode "Output signal of sv_FASMode" UBYTE SAB_STANDARD_S2_S3 1 100 0 1 ECU_ADDRESS 0xFFF8DC38 DISPLAY_IDENTIFIER sv_FASMode.ParkManeuverAssistant._.ZFFSAB /end MEASUREMENT
/begin MEASUREMENT ZFFSAB._.ParkManeuverAssistant.sv_FASModeSts "Output status signal of sv_FASModeSts" UBYTE SAB_STANDARD_S2_S3 1 100 0 2 ECU_ADDRESS 0xFFF8DC3A DISPLAY_IDENTIFIER sv_FASModeSts.ParkManeuverAssistant._.ZFFSAB /end MEASUREMENT
/begin MEASUREMENT ZFFSAB._.ParkManeuverAssistant.sv_FASModeSts_ "Complement of sv_FASModeSts" UBYTE SAB_STANDARD_S2_S3 1 100 0 255 ECU_ADDRESS 0xFFF8DC3B DISPLAY_IDENTIFIER sv_FASModeSts_.ParkManeuverAssistant._.ZFFSAB /end MEASUREMENT
/begin MEASUREMENT ZFFSAB._.ParkManeuverAssistant.sv_FASMode_ "Complement of sv_FASMode" UBYTE SAB_STANDARD_S2_S3 1 100 0 255 ECU_ADDRESS 0xFFF8DC39 DISPLAY_IDENTIFIER sv_FASMode_.ParkManeuverAssistant._.ZFFSAB /end MEASUREMENT
/begin MEASUREMENT ZFFSAB._.ParkManeuverAssistant.sv_FASPos "Output signal of sv_FASPos" UBYTE SAB_STANDARD_S2_S3 1 100 0 8 ECU_ADDRESS 0xFFF8DC3C DISPLAY_IDENTIFIER sv_FASPos.ParkManeuverAssistant._.ZFFSAB /end MEASUREMENT
/begin MEASUREMENT ZFFSAB._.ParkManeuverAssistant.sv_FASPosSts "Output status signal of sv_FASPosSts" UBYTE SAB_STANDARD_S2_S3 1 100 0 2 ECU_ADDRESS 0xFFF8DC3E DISPLAY_IDENTIFIER sv_FASPosSts.ParkManeuverAssistant._.ZFFSAB /end MEASUREMENT
/begin MEASUREMENT ZFFSAB._.ParkManeuverAssistant.sv_FASPosSts_ "Complement of sv_FASPosSts" UBYTE SAB_STANDARD_S2_S3 1 100 0 255 ECU_ADDRESS 0xFFF8DC3F DISPLAY_IDENTIFIER sv_FASPosSts_.ParkManeuverAssistant._.ZFFSAB /end MEASUREMENT
/begin MEASUREMENT ZFFSAB._.ParkManeuverAssistant.sv_FASPos_ "Complement of sv_FASPos" UBYTE SAB_STANDARD_S2_S3 1 100 0 255 ECU_ADDRESS 0xFFF8DC3D DISPLAY_IDENTIFIER sv_FASPos_.ParkManeuverAssistant._.ZFFSAB /end MEASUREMENT
/begin MEASUREMENT ZFFSAB._.ParkingBrakeIn.f_ParkingBrakeErr "Error flag of ParkingBrake-signal" UBYTE SAB_STANDARD_S2_S3 1 100 0 1 ECU_ADDRESS 0xFFF96D11 DISPLAY_IDENTIFIER f_ParkingBrakeErr.ParkingBrakeIn._.ZFFSAB /end MEASUREMENT
/begin MEASUREMENT ZFFSAB._.ParkingBrakeIn.iv_ParkingBrake "Input variable for current condition of the parking brake light" UBYTE SAB_STANDARD_S2_S3 1 100 0 255 ECU_ADDRESS 0xFFF96D09 DISPLAY_IDENTIFIER iv_ParkingBrake.ParkingBrakeIn._.ZFFSAB /end MEASUREMENT
/begin MEASUREMENT ZFFSAB._.ParkingBrakeIn.iv_ParkingBrake1 "Input variable for current condition of the parking brake" UBYTE SAB_STANDARD_S2_S3 1 100 0 255 ECU_ADDRESS 0xFFF96D0B DISPLAY_IDENTIFIER iv_ParkingBrake1.ParkingBrakeIn._.ZFFSAB /end MEASUREMENT
/begin MEASUREMENT ZFFSAB._.ParkingBrakeIn.iv_ParkingBrake1Sts "Input variable for the parking brake electrical status" UBYTE SAB_STANDARD_S2_S3 1 100 0 255 ECU_ADDRESS 0xFFF96D0C DISPLAY_IDENTIFIER iv_ParkingBrake1Sts.ParkingBrakeIn._.ZFFSAB /end MEASUREMENT
/begin MEASUREMENT ZFFSAB._.ParkingBrakeIn.iv_ParkingBrake2 "Input variable for filtered condition of the parking brake" UBYTE SAB_STANDARD_S2_S3 1 100 0 3 ECU_ADDRESS 0xFFF96D0D DISPLAY_IDENTIFIER iv_ParkingBrake2.ParkingBrakeIn._.ZFFSAB /end MEASUREMENT
/begin MEASUREMENT ZFFSAB._.ParkingBrakeIn.iv_ParkingBrake2Sts "Input variable for filtered condition of the parking brake electrical status" UBYTE SAB_STANDARD_S2_S3 1 100 0 255 ECU_ADDRESS 0xFFF96D0E DISPLAY_IDENTIFIER iv_ParkingBrake2Sts.ParkingBrakeIn._.ZFFSAB /end MEASUREMENT
/begin MEASUREMENT ZFFSAB._.ParkingBrakeIn.iv_ParkingBrakeSts "Input variable for the parking brake light electrical status" UBYTE SAB_STANDARD_S2_S3 1 100 0 255 ECU_ADDRESS 0xFFF96D0A DISPLAY_IDENTIFIER iv_ParkingBrakeSts.ParkingBrakeIn._.ZFFSAB /end MEASUREMENT
/begin MEASUREMENT ZFFSAB._.ParkingBrakeIn.sv_ParkingBrakeSts "Output variable for the parking brake light status" UBYTE SAB_STANDARD_S2_S3 1 100 0 2 ECU_ADDRESS 0xFFF96D10 DISPLAY_IDENTIFIER sv_ParkingBrakeSts.ParkingBrakeIn._.ZFFSAB /end MEASUREMENT
/begin MEASUREMENT ZFFSAB._.ParkingBrakeIn.sv_f_ParkingBrake "Output variable for condition of the parking brake light" UBYTE SAB_STANDARD_S2_S3 1 100 0 1 ECU_ADDRESS 0xFFF96D0F DISPLAY_IDENTIFIER sv_f_ParkingBrake.ParkingBrakeIn._.ZFFSAB /end MEASUREMENT
/begin MEASUREMENT ZFFSAB._.ParklockSensorIn.PSensFaultInfo "calculated signal" UBYTE SAB_STANDARD_S2_S3 1 100 0 31 ECU_ADDRESS 0xFFF8DC1E DISPLAY_IDENTIFIER PSensFaultInfo.ParklockSensorIn._.ZFFSAB /end MEASUREMENT
/begin MEASUREMENT ZFFSAB._.ParklockSensorIn.PSensFaultInfo_ "calculated complement signal" UBYTE SAB_STANDARD_S2_S3 1 100 0 31 ECU_ADDRESS 0xFFF8DC1F DISPLAY_IDENTIFIER PSensFaultInfo_.ParklockSensorIn._.ZFFSAB /end MEASUREMENT
/begin MEASUREMENT ZFFSAB._.ParklockSensorIn.iv_PSens1 "position 1 of P_sensor" UBYTE SAB_STANDARD_S2_S3 1 100 0 1 ECU_ADDRESS 0xFFF8DC10 DISPLAY_IDENTIFIER iv_PSens1.ParklockSensorIn._.ZFFSAB /end MEASUREMENT
/begin MEASUREMENT ZFFSAB._.ParklockSensorIn.iv_PSens1FaultInfo "state of iv_PSens2" UBYTE SAB_STANDARD_S2_S3 1 100 0 7 ECU_ADDRESS 0xFFF8DC12 DISPLAY_IDENTIFIER iv_PSens1FaultInfo.ParklockSensorIn._.ZFFSAB /end MEASUREMENT
/begin MEASUREMENT ZFFSAB._.ParklockSensorIn.iv_PSens1FaultInfo_ "complement state of sensor" UBYTE SAB_STANDARD_S2_S3 1 100 0 255 ECU_ADDRESS 0xFFF8DC13 DISPLAY_IDENTIFIER iv_PSens1FaultInfo_.ParklockSensorIn._.ZFFSAB /end MEASUREMENT
/begin MEASUREMENT ZFFSAB._.ParklockSensorIn.iv_PSens1_ "complement of iv_PSens1" UBYTE SAB_STANDARD_S2_S3 1 100 0 255 ECU_ADDRESS 0xFFF8DC11 DISPLAY_IDENTIFIER iv_PSens1_.ParklockSensorIn._.ZFFSAB /end MEASUREMENT
/begin MEASUREMENT ZFFSAB._.ParklockSensorIn.iv_PSens2 "position 2 of P_sensor" UBYTE SAB_STANDARD_S2_S3 1 100 0 1 ECU_ADDRESS 0xFFF8DC14 DISPLAY_IDENTIFIER iv_PSens2.ParklockSensorIn._.ZFFSAB /end MEASUREMENT
/begin MEASUREMENT ZFFSAB._.ParklockSensorIn.iv_PSens2FaultInfo "state of sensor" UBYTE SAB_STANDARD_S2_S3 1 100 0 7 ECU_ADDRESS 0xFFF8DC16 DISPLAY_IDENTIFIER iv_PSens2FaultInfo.ParklockSensorIn._.ZFFSAB /end MEASUREMENT
/begin MEASUREMENT ZFFSAB._.ParklockSensorIn.iv_PSens2FaultInfo_ "complement state of sensor" UBYTE SAB_STANDARD_S2_S3 1 100 0 255 ECU_ADDRESS 0xFFF8DC17 DISPLAY_IDENTIFIER iv_PSens2FaultInfo_.ParklockSensorIn._.ZFFSAB /end MEASUREMENT
/begin MEASUREMENT ZFFSAB._.ParklockSensorIn.iv_PSens2_ "complement of iv_PSens2" UBYTE SAB_STANDARD_S2_S3 1 100 0 255 ECU_ADDRESS 0xFFF8DC15 DISPLAY_IDENTIFIER iv_PSens2_.ParklockSensorIn._.ZFFSAB /end MEASUREMENT
/begin MEASUREMENT ZFFSAB._.ParklockSensorIn.iv_u_SensESts "state of iv_u_SensESts" UBYTE SAB_STANDARD_S2_S3 1 100 0 255 ECU_ADDRESS 0xFFF8DC18 DISPLAY_IDENTIFIER iv_u_SensESts.ParklockSensorIn._.ZFFSAB /end MEASUREMENT
/begin MEASUREMENT ZFFSAB._.ParklockSensorIn.iv_u_SensESts_ "state of iv_u_SensESts_" UBYTE SAB_STANDARD_S2_S3 1 100 0 255 ECU_ADDRESS 0xFFF8DC19 DISPLAY_IDENTIFIER iv_u_SensESts_.ParklockSensorIn._.ZFFSAB /end MEASUREMENT
/begin MEASUREMENT ZFFSAB._.ParklockSensorIn.sv_PSens "calculated P-Sensor-Signal" UBYTE SAB_STANDARD_S2_S3 1 100 0 3 ECU_ADDRESS 0xFFF8DC1A DISPLAY_IDENTIFIER sv_PSens.ParklockSensorIn._.ZFFSAB /end MEASUREMENT
/begin MEASUREMENT ZFFSAB._.ParklockSensorIn.sv_PSensSts "state of calculated P-Sensor-Signal" UBYTE SAB_STANDARD_S2_S3 1 100 0 2 ECU_ADDRESS 0xFFF8DC1C DISPLAY_IDENTIFIER sv_PSensSts.ParklockSensorIn._.ZFFSAB /end MEASUREMENT
/begin MEASUREMENT ZFFSAB._.ParklockSensorIn.sv_PSensSts_ "state komplement of calculated P-Sensor-Signal" UBYTE SAB_STANDARD_S2_S3 1 100 0 255 ECU_ADDRESS 0xFFF8DC1D DISPLAY_IDENTIFIER sv_PSensSts_.ParklockSensorIn._.ZFFSAB /end MEASUREMENT
/begin MEASUREMENT ZFFSAB._.ParklockSensorIn.sv_PSens_ "complement of PSens" UBYTE SAB_STANDARD_S2_S3 1 100 0 255 ECU_ADDRESS 0xFFF8DC1B DISPLAY_IDENTIFIER sv_PSens_.ParklockSensorIn._.ZFFSAB /end MEASUREMENT
/begin MEASUREMENT ZFFSAB._.ParklockSensorIn.tmr_PosZ.time "Description for this variable only in SW documentation possible not in asap2" ULONG SAB_T_TIMER_10MS_S2_S3 1 100 0 42949672950 ECU_ADDRESS 0xFFF8DC08 DISPLAY_IDENTIFIER time.tmr_PosZ.ParklockSensorIn._.ZFFSAB /end MEASUREMENT
/begin MEASUREMENT ZFFSAB._.ParklockSensorIn.tmr_PosZ.time_ "Description for this variable only in SW documentation possible not in asap2" ULONG SAB_T_TIMER_10MS_S2_S3 1 100 0 42949672950 ECU_ADDRESS 0xFFF8DC0C DISPLAY_IDENTIFIER time_.tmr_PosZ.ParklockSensorIn._.ZFFSAB /end MEASUREMENT
/begin MEASUREMENT ZFFSAB._.ParklockStatusIn.f_EmfPErr "Error flag of parklock status" UBYTE SAB_STANDARD_S2_S3 1 100 0 1 ECU_ADDRESS 0xFFF8E1F5 DISPLAY_IDENTIFIER f_EmfPErr.ParklockStatusIn._.ZFFSAB /end MEASUREMENT
/begin MEASUREMENT ZFFSAB._.ParklockStatusIn.iv_EmfP "Input value parklock status from CAN" UBYTE SAB_STANDARD_S2_S3 1 100 0 15 ECU_ADDRESS 0xFFF8E1F1 DISPLAY_IDENTIFIER iv_EmfP.ParklockStatusIn._.ZFFSAB /end MEASUREMENT
/begin MEASUREMENT ZFFSAB._.ParklockStatusIn.iv_EmfPSts "Input value message status of parklock status" UBYTE SAB_STANDARD_S2_S3 1 100 0 255 ECU_ADDRESS 0xFFF8E1F2 DISPLAY_IDENTIFIER iv_EmfPSts.ParklockStatusIn._.ZFFSAB /end MEASUREMENT
/begin MEASUREMENT ZFFSAB._.ParklockStatusIn.sv_EmfP "Output value of parklock status" UBYTE SAB_STANDARD_S2_S3 1 100 0 2 ECU_ADDRESS 0xFFF8E1F3 DISPLAY_IDENTIFIER sv_EmfP.ParklockStatusIn._.ZFFSAB /end MEASUREMENT
/begin MEASUREMENT ZFFSAB._.ParklockStatusIn.sv_EmfPSts "Output value signal status of parklock status" UBYTE SAB_STANDARD_S2_S3 1 100 0 2 ECU_ADDRESS 0xFFF8E1F4 DISPLAY_IDENTIFIER sv_EmfPSts.ParklockStatusIn._.ZFFSAB /end MEASUREMENT
/begin MEASUREMENT ZFFSAB._.PowerdownIn.f_EeStoreAllowed "1 = EEPROM data gets written during next shutdown 0 = writing of EEPROM data gets avoided during next shutdown" UBYTE SAB_STANDARD_S2_S3 1 100 0 1 ECU_ADDRESS 0xFFF95E64 DISPLAY_IDENTIFIER f_EeStoreAllowed.PowerdownIn._.ZFFSAB /end MEASUREMENT
/begin MEASUREMENT ZFFSAB._.PowerdownIn.f_Iep_Shutdown "parameter of last call to IEP for shutdown by the SAB" UBYTE SAB_STANDARD_S2_S3 1 100 0 1 ECU_ADDRESS 0xFFF95E69 DISPLAY_IDENTIFIER f_Iep_Shutdown.PowerdownIn._.ZFFSAB /end MEASUREMENT
/begin MEASUREMENT ZFFSAB._.PowerdownIn.f_IgnitionOn "this is a class specific reference to IgnitionStatusIn.sv_f_IgnOn" UBYTE SAB_STANDARD_S2_S3 1 100 0 1 ECU_ADDRESS 0xFFF95E66 DISPLAY_IDENTIFIER f_IgnitionOn.PowerdownIn._.ZFFSAB /end MEASUREMENT
/begin MEASUREMENT ZFFSAB._.PowerdownIn.f_InternalWakeUp "1 = last CAN Wake Up was invoked by SBW N-Haltephase 0 = last CAN Wake Up was not invoked by SBW N-Haltephase" UBYTE SAB_STANDARD_S2_S3 1 100 0 1 ECU_ADDRESS 0xFFF95E65 DISPLAY_IDENTIFIER f_InternalWakeUp.PowerdownIn._.ZFFSAB /end MEASUREMENT
/begin MEASUREMENT ZFFSAB._.PowerdownIn.f_RapidPowerShutdown "flag for signalling a rapid power shutdown" UBYTE SAB_STANDARD_S2_S3 1 100 0 1 ECU_ADDRESS 0xFFF95E62 DISPLAY_IDENTIFIER f_RapidPowerShutdown.PowerdownIn._.ZFFSAB /end MEASUREMENT
/begin MEASUREMENT ZFFSAB._.PowerdownIn.f_ResetByTester "flag for signalling a reset by tester" UBYTE SAB_STANDARD_S2_S3 1 100 0 1 ECU_ADDRESS 0xFFF95E63 DISPLAY_IDENTIFIER f_ResetByTester.PowerdownIn._.ZFFSAB /end MEASUREMENT
/begin MEASUREMENT ZFFSAB._.PowerdownIn.iv_f_CanActive "1=bus communication is active 0=no bus communication" UBYTE SAB_STANDARD_S2_S3 1 100 0 1 ECU_ADDRESS 0xFFF95E5E DISPLAY_IDENTIFIER iv_f_CanActive.PowerdownIn._.ZFFSAB /end MEASUREMENT
/begin MEASUREMENT ZFFSAB._.PowerdownIn.iv_f_EeStoreInProgress "1=EEPROM Storage is activ 0=EEPROM Storage is not activ" UBYTE SAB_STANDARD_S2_S3 1 100 0 1 ECU_ADDRESS 0xFFF95E5C DISPLAY_IDENTIFIER iv_f_EeStoreInProgress.PowerdownIn._.ZFFSAB /end MEASUREMENT
/begin MEASUREMENT ZFFSAB._.PowerdownIn.iv_f_PowDownEnable "1=SBW enables the powerdown 0=SBW disables the powerdown" UBYTE SAB_STANDARD_S2_S3 1 100 0 1 ECU_ADDRESS 0xFFF95E5B DISPLAY_IDENTIFIER iv_f_PowDownEnable.PowerdownIn._.ZFFSAB /end MEASUREMENT
/begin MEASUREMENT ZFFSAB._.PowerdownIn.iv_f_PowDownEnableAtsys "1=ATSYS enables the powerdown 0=ATSYS disables the powerdown" UBYTE SAB_STANDARD_S2_S3 1 100 0 1 ECU_ADDRESS 0xFFF95E5D DISPLAY_IDENTIFIER iv_f_PowDownEnableAtsys.PowerdownIn._.ZFFSAB /end MEASUREMENT
/begin MEASUREMENT ZFFSAB._.PowerdownIn.st_Powerdown "internal current state of the state machine" UBYTE SAB_STANDARD_S2_S3 1 100 0 6 ECU_ADDRESS 0xFFF95E68 DISPLAY_IDENTIFIER st_Powerdown.PowerdownIn._.ZFFSAB /end MEASUREMENT
/begin MEASUREMENT ZFFSAB._.PowerdownIn.st_PowerdownMain "internal current state of the main state machine" UBYTE SAB_STANDARD_S2_S3 1 100 0 6 ECU_ADDRESS 0xFFF95E67 DISPLAY_IDENTIFIER st_PowerdownMain.PowerdownIn._.ZFFSAB /end MEASUREMENT
/begin MEASUREMENT ZFFSAB._.PowerdownIn.sv_f_CanComActive "1 = the ECU requests the Canbus 0 = the ECU does not need the Canbus for communication --NM may go to sleep know--." UBYTE SAB_STANDARD_S2_S3 1 100 0 1 ECU_ADDRESS 0xFFF95E61 DISPLAY_IDENTIFIER sv_f_CanComActive.PowerdownIn._.ZFFSAB /end MEASUREMENT
/begin MEASUREMENT ZFFSAB._.PowerdownIn.sv_f_PowDownCondOk "1=signals the SBW to preparing powerdown" UBYTE SAB_STANDARD_S2_S3 1 100 0 1 ECU_ADDRESS 0xFFF95E5F DISPLAY_IDENTIFIER sv_f_PowDownCondOk.PowerdownIn._.ZFFSAB /end MEASUREMENT
/begin MEASUREMENT ZFFSAB._.PowerdownIn.sv_f_ShutDown "signals the hardware layer to shutdown the ecu" UBYTE SAB_STANDARD_S2_S3 1 100 0 2 ECU_ADDRESS 0xFFF95E60 DISPLAY_IDENTIFIER sv_f_ShutDown.PowerdownIn._.ZFFSAB /end MEASUREMENT
/begin MEASUREMENT ZFFSAB._.PowerdownIn.tmr_PowerDown.time "Description for this variable only in SW documentation possible not in asap2" UWORD SAB_T_TIMER_10MS_S2_S3 1 100 0 655350 ECU_ADDRESS 0xFFF95E58 DISPLAY_IDENTIFIER time.tmr_PowerDown.PowerdownIn._.ZFFSAB /end MEASUREMENT
/begin MEASUREMENT ZFFSAB._.PowerdownIn.tmr_ResetByTester.time "Description for this variable only in SW documentation possible not in asap2" UBYTE SAB_T_TIMER_10MS_S2_S3 1 100 0 2550 ECU_ADDRESS 0xFFF95E5A DISPLAY_IDENTIFIER time.tmr_ResetByTester.PowerdownIn._.ZFFSAB /end MEASUREMENT
/begin MEASUREMENT ZFFSAB._.RPM_Diagnosis.iv_u_Batt_Diag "actual battery voltage" UWORD SAB_U_1VOLT1000_S2_S3 1 100 0 65.535 ECU_ADDRESS 0xFFF8DF7A DISPLAY_IDENTIFIER iv_u_Batt_Diag.RPM_Diagnosis._.ZFFSAB /end MEASUREMENT
/begin MEASUREMENT ZFFSAB._.RPM_Diagnosis.iv_u_SensESts "state of sensor" UBYTE SAB_STANDARD_S2_S3 1 100 0 255 ECU_ADDRESS 0xFFF8DF7F DISPLAY_IDENTIFIER iv_u_SensESts.RPM_Diagnosis._.ZFFSAB /end MEASUREMENT
/begin MEASUREMENT ZFFSAB._.RPM_Diagnosis.iv_u_SensEStsRam "Ram value- used for testing complement monitoring of state of sensor" UBYTE SAB_STANDARD_S2_S3 1 100 0 255 ECU_ADDRESS 0xFFF8DF7D DISPLAY_IDENTIFIER iv_u_SensEStsRam.RPM_Diagnosis._.ZFFSAB /end MEASUREMENT
/begin MEASUREMENT ZFFSAB._.RPM_Diagnosis.iv_u_SensEStsRam_ "Ram value- used for testing complement monitoring of state of sensor" UBYTE SAB_STANDARD_S2_S3 1 100 0 255 ECU_ADDRESS 0xFFF8DF7E DISPLAY_IDENTIFIER iv_u_SensEStsRam_.RPM_Diagnosis._.ZFFSAB /end MEASUREMENT
/begin MEASUREMENT ZFFSAB._.RPM_Diagnosis.iv_u_SensEStsRaw "state of sensor raw value" UBYTE SAB_STANDARD_S2_S3 1 100 0 255 ECU_ADDRESS 0xFFF8DF78 DISPLAY_IDENTIFIER iv_u_SensEStsRaw.RPM_Diagnosis._.ZFFSAB /end MEASUREMENT
/begin MEASUREMENT ZFFSAB._.RPM_Diagnosis.iv_u_SensEStsRaw_ "state of sensor raw value complement" UBYTE SAB_STANDARD_S2_S3 1 100 0 255 ECU_ADDRESS 0xFFF8DF7C DISPLAY_IDENTIFIER iv_u_SensEStsRaw_.RPM_Diagnosis._.ZFFSAB /end MEASUREMENT
/begin MEASUREMENT ZFFSAB._.RPM_Diagnosis.iv_u_SensESts_ "state of sensor complement" UBYTE SAB_STANDARD_S2_S3 1 100 0 255 ECU_ADDRESS 0xFFF8DF80 DISPLAY_IDENTIFIER iv_u_SensESts_.RPM_Diagnosis._.ZFFSAB /end MEASUREMENT
/begin MEASUREMENT ZFFSAB._.RPM_Diagnosis.tmr_t_delay_1SENSORLEV2.time "Description for this variable only in SW documentation possible not in asap2" ULONG SAB_T_TIMER_10MS_S2_S3 1 100 0 42949672950 ECU_ADDRESS 0xFFF8DF50 DISPLAY_IDENTIFIER time.tmr_t_delay_1SENSORLEV2.RPM_Diagnosis._.ZFFSAB /end MEASUREMENT
/begin MEASUREMENT ZFFSAB._.RPM_Diagnosis.tmr_t_delay_1SENSORLEV2.time_ "Description for this variable only in SW documentation possible not in asap2" ULONG SAB_T_TIMER_10MS_S2_S3 1 100 0 42949672950 ECU_ADDRESS 0xFFF8DF54 DISPLAY_IDENTIFIER time_.tmr_t_delay_1SENSORLEV2.RPM_Diagnosis._.ZFFSAB /end MEASUREMENT
/begin MEASUREMENT ZFFSAB._.RPM_Diagnosis.tmr_t_delay_N6LEV2.time "Description for this variable only in SW documentation possible not in asap2" ULONG SAB_T_TIMER_10MS_S2_S3 1 100 0 42949672950 ECU_ADDRESS 0xFFF8DF60 DISPLAY_IDENTIFIER time.tmr_t_delay_N6LEV2.RPM_Diagnosis._.ZFFSAB /end MEASUREMENT
/begin MEASUREMENT ZFFSAB._.RPM_Diagnosis.tmr_t_delay_N6LEV2.time_ "Description for this variable only in SW documentation possible not in asap2" ULONG SAB_T_TIMER_10MS_S2_S3 1 100 0 42949672950 ECU_ADDRESS 0xFFF8DF64 DISPLAY_IDENTIFIER time_.tmr_t_delay_N6LEV2.RPM_Diagnosis._.ZFFSAB /end MEASUREMENT
/begin MEASUREMENT ZFFSAB._.RPM_Diagnosis.tmr_t_delay_N6PLAUSILEV2.time "Description for this variable only in SW documentation possible not in asap2" ULONG SAB_T_TIMER_10MS_S2_S3 1 100 0 42949672950 ECU_ADDRESS 0xFFF8DF68 DISPLAY_IDENTIFIER time.tmr_t_delay_N6PLAUSILEV2.RPM_Diagnosis._.ZFFSAB /end MEASUREMENT
/begin MEASUREMENT ZFFSAB._.RPM_Diagnosis.tmr_t_delay_N6PLAUSILEV2.time_ "Description for this variable only in SW documentation possible not in asap2" ULONG SAB_T_TIMER_10MS_S2_S3 1 100 0 42949672950 ECU_ADDRESS 0xFFF8DF6C DISPLAY_IDENTIFIER time_.tmr_t_delay_N6PLAUSILEV2.RPM_Diagnosis._.ZFFSAB /end MEASUREMENT
/begin MEASUREMENT ZFFSAB._.RPM_Diagnosis.tmr_t_delay_NTUVIRTLEV2.time "Description for this variable only in SW documentation possible not in asap2" ULONG SAB_T_TIMER_10MS_S2_S3 1 100 0 42949672950 ECU_ADDRESS 0xFFF8DF70 DISPLAY_IDENTIFIER time.tmr_t_delay_NTUVIRTLEV2.RPM_Diagnosis._.ZFFSAB /end MEASUREMENT
/begin MEASUREMENT ZFFSAB._.RPM_Diagnosis.tmr_t_delay_NTUVIRTLEV2.time_ "Description for this variable only in SW documentation possible not in asap2" ULONG SAB_T_TIMER_10MS_S2_S3 1 100 0 42949672950 ECU_ADDRESS 0xFFF8DF74 DISPLAY_IDENTIFIER time_.tmr_t_delay_NTUVIRTLEV2.RPM_Diagnosis._.ZFFSAB /end MEASUREMENT
/begin MEASUREMENT ZFFSAB._.RPM_Diagnosis.tmr_t_delay_SENSORLEV2.time "Description for this variable only in SW documentation possible not in asap2" ULONG SAB_T_TIMER_10MS_S2_S3 1 100 0 42949672950 ECU_ADDRESS 0xFFF8DF58 DISPLAY_IDENTIFIER time.tmr_t_delay_SENSORLEV2.RPM_Diagnosis._.ZFFSAB /end MEASUREMENT
/begin MEASUREMENT ZFFSAB._.RPM_Diagnosis.tmr_t_delay_SENSORLEV2.time_ "Description for this variable only in SW documentation possible not in asap2" ULONG SAB_T_TIMER_10MS_S2_S3 1 100 0 42949672950 ECU_ADDRESS 0xFFF8DF5C DISPLAY_IDENTIFIER time_.tmr_t_delay_SENSORLEV2.RPM_Diagnosis._.ZFFSAB /end MEASUREMENT
/begin MEASUREMENT ZFFSAB._.RPM_SensingIn.Ab.St_RPMSensing "current state of tooth sensing.St_RESET_OR_RUNUP = 0 St_STANDSTILL = 1 St_ONE_TOOTH_RISING_RPM = 2 St_ONE_TOOTH_FALLING_RPM = 3 St_NORMAL_DRIVE 4" UBYTE SAB_STANDARD_S2_S3 1 100 0 255 ECU_ADDRESS 0xFFF8D880 DISPLAY_IDENTIFIER St_RPMSensing.Ab.RPM_SensingIn._.ZFFSAB /end MEASUREMENT
/begin MEASUREMENT ZFFSAB._.RPM_SensingIn.Ab.cnt_total_teeth "Number of the trigger-wheels teeth" UBYTE SAB_STANDARD_S2_S3 1 100 0 255 ECU_ADDRESS 0xFFF8D881 DISPLAY_IDENTIFIER cnt_total_teeth.Ab.RPM_SensingIn._.ZFFSAB /end MEASUREMENT
/begin MEASUREMENT ZFFSAB._.RPM_SensingIn.Ab.f_FirstVirtualCalc "Internal flag to detect first virtual calculation" UBYTE SAB_STANDARD_S2_S3 1 100 0 1 ECU_ADDRESS 0xFFF8D89E DISPLAY_IDENTIFIER f_FirstVirtualCalc.Ab.RPM_SensingIn._.ZFFSAB /end MEASUREMENT
/begin MEASUREMENT ZFFSAB._.RPM_SensingIn.Ab.f_NeverOnePulse "Internal flag to detect if no pulse was detected during last task and until now" UBYTE SAB_STANDARD_S2_S3 1 100 0 1 ECU_ADDRESS 0xFFF8D89F DISPLAY_IDENTIFIER f_NeverOnePulse.Ab.RPM_SensingIn._.ZFFSAB /end MEASUREMENT
/begin MEASUREMENT ZFFSAB._.RPM_SensingIn.Ab.frq_SpeedSensor "Frequency of the speed-sensor" UWORD SAB_FRQ_1HZ_S2_S3 1 100 0 65535 ECU_ADDRESS 0xFFF8D8A4 DISPLAY_IDENTIFIER frq_SpeedSensor.Ab.RPM_SensingIn._.ZFFSAB /end MEASUREMENT
/begin MEASUREMENT ZFFSAB._.RPM_SensingIn.Ab.iv_ESts "Input variable for RPM-sensor electrical status" UBYTE SAB_STANDARD_S2_S3 1 100 0 255 ECU_ADDRESS 0xFFF8D895 DISPLAY_IDENTIFIER iv_ESts.Ab.RPM_SensingIn._.ZFFSAB /end MEASUREMENT
/begin MEASUREMENT ZFFSAB._.RPM_SensingIn.Ab.iv_PulseWidth "Input variable for direction detection pulsewidth" UBYTE SAB_T_TIMER_1US_S2_S3 1 100 0 255 ECU_ADDRESS 0xFFF8D896 DISPLAY_IDENTIFIER iv_PulseWidth.Ab.RPM_SensingIn._.ZFFSAB /end MEASUREMENT
/begin MEASUREMENT ZFFSAB._.RPM_SensingIn.Ab.iv_f_Diag "Input flag shows if a diagnosis is possible or not" UBYTE SAB_STANDARD_S2_S3 1 100 0 1 ECU_ADDRESS 0xFFF8D894 DISPLAY_IDENTIFIER iv_f_Diag.Ab.RPM_SensingIn._.ZFFSAB /end MEASUREMENT
/begin MEASUREMENT ZFFSAB._.RPM_SensingIn.Ab.iv_n_Pulses "Input variable for number of pulses detected during iv_t_Pulses" UBYTE SAB_STANDARD_S2_S3 1 100 0 255 ECU_ADDRESS 0xFFF8D88C DISPLAY_IDENTIFIER iv_n_Pulses.Ab.RPM_SensingIn._.ZFFSAB /end MEASUREMENT
/begin MEASUREMENT ZFFSAB._.RPM_SensingIn.Ab.iv_t_Pulses "Input variable for exact time needed for counting iv_n_Pulses" ULONG SAB_T_TIMER_1US_S2_S3 1 100 0 4294967295 ECU_ADDRESS 0xFFF8D888 DISPLAY_IDENTIFIER iv_t_Pulses.Ab.RPM_SensingIn._.ZFFSAB /end MEASUREMENT
/begin MEASUREMENT ZFFSAB._.RPM_SensingIn.Ab.iv_t_Pulses_old "Input variable for last valid iv_t_Pulses needed for virtual RPMs" ULONG SAB_STANDARD_S2_S3 1 100 0 4294967295 ECU_ADDRESS 0xFFF8D890 DISPLAY_IDENTIFIER iv_t_Pulses_old.Ab.RPM_SensingIn._.ZFFSAB /end MEASUREMENT
/begin MEASUREMENT ZFFSAB._.RPM_SensingIn.Ab.k_nenner "Part of potential factor e.g. for a fix transmission" UWORD SAB_STANDARD_S2_S3 1 100 0 65535 ECU_ADDRESS 0xFFF8D882 DISPLAY_IDENTIFIER k_nenner.Ab.RPM_SensingIn._.ZFFSAB /end MEASUREMENT
/begin MEASUREMENT ZFFSAB._.RPM_SensingIn.Ab.k_zaehler "Part of potential factor e.g. for a fix transmission" UWORD SAB_STANDARD_S2_S3 1 100 0 65535 ECU_ADDRESS 0xFFF8D884 DISPLAY_IDENTIFIER k_zaehler.Ab.RPM_SensingIn._.ZFFSAB /end MEASUREMENT
/begin MEASUREMENT ZFFSAB._.RPM_SensingIn.Ab.n_Offset "Fix RPM-offset (not appliable in car)" UBYTE SAB_N_1RPM_S2_S3 1 100 0 255 ECU_ADDRESS 0xFFF8D89D DISPLAY_IDENTIFIER n_Offset.Ab.RPM_SensingIn._.ZFFSAB /end MEASUREMENT
/begin MEASUREMENT ZFFSAB._.RPM_SensingIn.Ab.n_RPM "Intermediate RPM (not yet usable for reliable RPM Sensing!)" UWORD SAB_N_1RPM_S2_S3 1 100 0 65535 ECU_ADDRESS 0xFFF8D898 DISPLAY_IDENTIFIER n_RPM.Ab.RPM_SensingIn._.ZFFSAB /end MEASUREMENT
/begin MEASUREMENT ZFFSAB._.RPM_SensingIn.Ab.n_RPM_Old "Old RPM from last task" UWORD SAB_N_1RPM_S2_S3 1 100 0 65535 ECU_ADDRESS 0xFFF8D89A DISPLAY_IDENTIFIER n_RPM_Old.Ab.RPM_SensingIn._.ZFFSAB /end MEASUREMENT
/begin MEASUREMENT ZFFSAB._.RPM_SensingIn.Ab.n_RPM_min "Minimum detectable RPM (under this value a zero will be provided)" UWORD SAB_N_1RPM_S2_S3 1 100 0 65535 ECU_ADDRESS 0xFFF8D886 DISPLAY_IDENTIFIER n_RPM_min.Ab.RPM_SensingIn._.ZFFSAB /end MEASUREMENT
/begin MEASUREMENT ZFFSAB._.RPM_SensingIn.Ab.n_Sts "Electrical status of RPM sensor" UBYTE SAB_STANDARD_S2_S3 1 100 0 255 ECU_ADDRESS 0xFFF8D89C DISPLAY_IDENTIFIER n_Sts.Ab.RPM_SensingIn._.ZFFSAB /end MEASUREMENT
/begin MEASUREMENT ZFFSAB._.RPM_SensingIn.Ab.sts_Direction "Intermediate value of direction" UBYTE SAB_STANDARD_S2_S3 1 100 0 255 ECU_ADDRESS 0xFFF8D8A0 DISPLAY_IDENTIFIER sts_Direction.Ab.RPM_SensingIn._.ZFFSAB /end MEASUREMENT
/begin MEASUREMENT ZFFSAB._.RPM_SensingIn.Ab.sts_DirectionDiag "diag-information of the direction-detection" UBYTE SAB_STANDARD_S2_S3 1 100 0 5 ECU_ADDRESS 0xFFF8D8A2 DISPLAY_IDENTIFIER sts_DirectionDiag.Ab.RPM_SensingIn._.ZFFSAB /end MEASUREMENT
/begin MEASUREMENT ZFFSAB._.RPM_SensingIn.Ab.sts_DirectionSts "Intermediate value of direction status" UBYTE SAB_STANDARD_S2_S3 1 100 0 255 ECU_ADDRESS 0xFFF8D8A1 DISPLAY_IDENTIFIER sts_DirectionSts.Ab.RPM_SensingIn._.ZFFSAB /end MEASUREMENT
/begin MEASUREMENT ZFFSAB._.RPM_SensingIn.Ab.sv_n_RPM "Output RPM" UWORD SAB_N_1RPM_S2_S3 1 100 0 65535 ECU_ADDRESS 0xFFF8D8A6 DISPLAY_IDENTIFIER sv_n_RPM.Ab.RPM_SensingIn._.ZFFSAB /end MEASUREMENT
/begin MEASUREMENT ZFFSAB._.RPM_SensingIn.Ab.sv_n_Sts "Electrical status of the RPM sensor" UBYTE SAB_STANDARD_S2_S3 1 100 0 255 ECU_ADDRESS 0xFFF8D8A8 DISPLAY_IDENTIFIER sv_n_Sts.Ab.RPM_SensingIn._.ZFFSAB /end MEASUREMENT
/begin MEASUREMENT ZFFSAB._.RPM_SensingIn.Ab.sv_sts_Direction "Direction (FORWARD=forward BACKWARD=backward)" UBYTE SAB_STANDARD_S2_S3 1 100 0 255 ECU_ADDRESS 0xFFF8D8A9 DISPLAY_IDENTIFIER sv_sts_Direction.Ab.RPM_SensingIn._.ZFFSAB /end MEASUREMENT
/end MODULE
/end PROJECT
