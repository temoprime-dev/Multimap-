ASAP2_VERSION 1 51
/begin PROJECT ZHBC8600 "Gen2_BMW_System_Supplier_Lib"
/begin MODULE CPP ""
/begin MOD_COMMON "" BYTE_ORDER MSB_FIRST ALIGNMENT_BYTE 1 ALIGNMENT_WORD 2 ALIGNMENT_LONG 4 ALIGNMENT_FLOAT32_IEEE 4 ALIGNMENT_FLOAT64_IEEE 1 /end MOD_COMMON
/begin COMPU_TAB _CNV_P_2_A_I_5_S2 "" TAB_INTP 2 0 0 255 255 /end COMPU_TAB
/begin COMPU_VTAB _CNV_S_100_Enum_EPRIS_25_S2 "" TAB_VERB 100 0 "PRISQ_1" 1 "PRISQ_2" 2 "PRISQ_3" 3 "PRISQ_4" 4 "PRISQ_5" 5 "PRISQ_6" 6 "PRISQ_7" 7 "PRISQ_8" 8 "PRISQ_9" 9 "PRISQ_10" 10 "PRISQ_11" 11 "PRISQ_12" 12 "PRISQ_13" 13 "PRISQ_14" 14 "PRISQ_15" 15 "PRISQ_16" 16 "PRISQ_17" 17 "PRISQ_18" 18 "PRISQ_19" 19 "PRISQ_20" 20 "PRISQ_21" 21 "PRISQ_22" 22 "PRISQ_23" 23 "PRISQ_24" 24 "PRISQ_25" 25 "PRISQ_26" 26 "PRISQ_27" 27 "PRISQ_28" 28 "PRISQ_29" 29 "PRISQ_30" 30 "PRISQ_31" 31 "PRISQ_32" 32 "PRISQ_33" 33 "PRISQ_34" 34 "PRISQ_35" 35 "PRISQ_36" 36 "PRISQ_37" 37 "PRISQ_38" 38 "PRISQ_39" 39 "PRISQ_40" 40 "PRISQ_41" 41 "PRISQ_42" 42 "PRISQ_43" 43 "PRISQ_44" 44 "PRISQ_45" 45 "PRISQ_46" 46 "PRISQ_47" 47 "PRISQ_48" 48 "PRISQ_49" 49 "PRISQ_50" 50 "PRISQ_51" 51 "PRISQ_52" 52 "PRISQ_53" 53 "PRISQ_54" 54 "PRISQ_55" 55 "PRISQ_56" 56 "PRISQ_57" 57 "PRISQ_58" 58 "PRISQ_59" 59 "PRISQ_60" 60 "PRISQ_61" 61 "PRISQ_62" 62 "PRISQ_63" 63 "PRISQ_64" 64 "PRISQ_65" 65 "PRISQ_66" 66 "PRISQ_67" 67 "PRISQ_68" 68 "PRISQ_69" 69 "PRISQ_70" 70 "PRISQ_71" 71 "PRISQ_72" 72 "PRISQ_73" 73 "PRISQ_74" 74 "PRISQ_75" 75 "PRISQ_76" 76 "PRISQ_77" 77 "PRISQ_78" 78 "PRISQ_79" 79 "PRISQ_80" 80 "PRISQ_81" 81 "PRISQ_82" 82 "PRISQ_83" 83 "PRISQ_84" 84 "PRISQ_85" 85 "PRISQ_86" 86 "PRISQ_87" 87 "PRISQ_88" 88 "PRISQ_89" 89 "PRISQ_90" 90 "PRISQ_91" 91 "PRISQ_92" 92 "PRISQ_93" 93 "PRISQ_94" 94 "PRISQ_95" 95 "PRISQ_96" 96 "PRISQ_97" 97 "PRISQ_98" 98 "PRISQ_99" 99 "PRISQ_100" DEFAULT_VALUE "" /end COMPU_VTAB
/begin COMPU_VTAB _CNV_S_10_Enum_EDBMT_254_S2 "" TAB_VERB 10 0 "DBMZKA_IDX1" 1 "DBMZKA_IDX2" 2 "DBMZKA_IDX3" 3 "DBMZKA_IDX4" 4 "DBMZKA_IDX5" 5 "DBMZKA_IDX6" 6 "DBMZKA_IDX7" 7 "DBMZKA_IDX8" 8 "DBMZKA_IDX9" 9 "DBMZKA_IDX10" DEFAULT_VALUE "" /end COMPU_VTAB
/begin COMPU_VTAB _CNV_S_10_Enum_EDMRS_22_S2 "" TAB_VERB 10 0 "D2RS_A_AGS" 1 "D3RS_A_AGS" 2 "D4RS_A_AGS" 3 "D5RS_A_AGS" 4 "D6RS_A_AGS" 5 "D2RS_S_AGS" 6 "D3RS_S_AGS" 7 "D4RS_S_AGS" 8 "D5RS_S_AGS" 9 "D6RS_S_AGS" DEFAULT_VALUE "" /end COMPU_VTAB
/begin COMPU_VTAB _CNV_S_10_Enum_EGANG_75_S2 "" TAB_VERB 10 0 "DARK" 1 "GANG_1" 2 "GANG_2" 3 "GANG_3" 4 "GANG_4" 5 "GANG_5" 6 "GANG_6" 7 "GANG_7" 8 "GANG_8" 9 "GANG_9" DEFAULT_VALUE "" /end COMPU_VTAB
/begin COMPU_VTAB _CNV_S_10_Enum_EHASS_119_S2 "" TAB_VERB 10 0 "INIT_INAKTIV" 1 "ANGEKOPPELT" 2 "ENTKOPPELT" 3 "E_FAHREN" 4 "STOP" 5 "LADEN" 6 "ENTKOPPELT_VM_EIN" 7 "E_FAHREN_VM_EIN" 8 "HYBRIDFAHREN" 15 "FEHLER" DEFAULT_VALUE "" /end COMPU_VTAB
/begin COMPU_VTAB _CNV_S_11_Enum_EGANG_74_S2 "" TAB_VERB 11 1 "GANGSS_KEIN_GANG" 2 "GANGSS_R" 5 "GANGSS_1" 6 "GANGSS_2" 7 "GANGSS_3" 8 "GANGSS_4" 9 "GANGSS_5" 10 "GANGSS_6" 11 "GANGSS_7" 12 "GANGSS_8" 13 "GANGSS_9" DEFAULT_VALUE "" /end COMPU_VTAB
/begin COMPU_VTAB _CNV_S_12_Enum_EK0_S_76_S2 "" TAB_VERB 12 0 "OFFEN_ASDINAKT" 1 "ANGELEGT_ASDINAKT" 2 "DRUCKSTELLUNG_ASDINAKT" 3 "SCHLUPFGEREGELT_ASDINAKT" 4 "GEREGELTGESCHLOSSEN_ASDINAKT" 5 "GESCHLOSSEN_ASDINAKT" 6 "OFFEN_ASDAKT" 7 "ANGELEGT_ASDAKT" 8 "DRUCKSTELLUNG_ASDAKT" 9 "SCHLUPFGEREGELT_ASDAKT" 10 "GEREGELTGESCHLOSSEN_ASDAKT" 11 "GESCHLOSSEN_ASDAKT" DEFAULT_VALUE "" /end COMPU_VTAB
/begin COMPU_VTAB _CNV_S_14_Enum_EGANG_73_S2 "Ganganzeige" TAB_VERB 14 0 "GANG_WHL_AZG_NODISP" 1 "GANG_WHL_AZG_N" 2 "GANG_WHL_AZG_R" 3 "GANG_WHL_AZG_P" 4 "GANG_WHL_AZG_D" 5 "GANG_WHL_AZG_1" 6 "GANG_WHL_AZG_2" 7 "GANG_WHL_AZG_3" 8 "GANG_WHL_AZG_4" 9 "GANG_WHL_AZG_5" 10 "GANG_WHL_AZG_6" 11 "GANG_WHL_AZG_7" 12 "GANG_WHL_AZG_8" 13 "GANG_WHL_AZG_9" DEFAULT_VALUE "" /end COMPU_VTAB
/begin COMPU_VTAB _CNV_S_15_Enum_EPRIS_274_S2 "" TAB_VERB 15 0 "SPA_PRSIQ_1" 1 "SPA_PRSIQ_2" 2 "SPA_PRSIQ_3" 3 "SPA_PRSIQ_4" 4 "SPA_PRSIQ_5" 5 "SPA_PRSIQ_6" 6 "SPA_PRSIQ_7" 7 "SPA_PRSIQ_8" 8 "SPA_PRSIQ_9" 9 "SPA_PRSIQ_10" 10 "SPA_PRSIQ_11" 11 "SPA_PRSIQ_12" 12 "SPA_PRSIQ_13" 13 "SPA_PRSIQ_14" 14 "SPA_PRSIQ_15" DEFAULT_VALUE "" /end COMPU_VTAB
/begin COMPU_VTAB _CNV_S_16_Enum_EIDXG_169_S2 "" TAB_VERB 16 0 "Index_0" 1 "Index_1" 2 "Index_2" 3 "Index_3" 4 "Index_4" 5 "Index_5" 6 "Index_6" 7 "Index_7" 8 "Index_8" 9 "Index_9" 10 "Index_10" 11 "Index_11" 12 "Index_12" 13 "Index_13" 14 "Index_14" 15 "SIGNAL_UNGUELTIG" DEFAULT_VALUE "0" /end COMPU_VTAB
/begin COMPU_VTAB _CNV_S_16_Enum_EPROG_79_S2 "" TAB_VERB 16 0 "DS2_XE" 1 "DS2_E" 2 "DS2_S" 3 "DS2_XS" 4 "DS2_A1" 5 "DS2_A2" 6 "DS2_A3" 7 "DS2_A4" 8 "DS2_STEPTR" 9 "DS2_SO" 10 "DS2_B0" 11 "DS2_LM" 12 "DS2_WL" 13 "DS2_LD" 14 "DS2_LDM" 15 "DS2_A5" DEFAULT_VALUE "" /end COMPU_VTAB
/begin COMPU_VTAB _CNV_S_21_Enum_EPROG_27_S2 "" TAB_VERB 21 0 "EXTREME_ECONOMY_PROG" 1 "ECONOMY_PROG" 2 "SPORT_PROG" 3 "EXTREME_SPORT_PROG" 4 "A1_PROG" 5 "A2_PROG" 6 "A3_PROG" 7 "A4_PROG" 8 "A5_PROG" 9 "SA1_PROG" 10 "SA2_PROG" 11 "SA3_PROG" 12 "SA4_PROG" 13 "WL1_PROG" 14 "WL2_PROG" 15 "ECO_PROG" 16 "ECOA1_PROG" 17 "ECOA2_PROG" 18 "ECOWL2_PROG" 19 "SO1_PROG" 20 "SO2_PROG" DEFAULT_VALUE "" /end COMPU_VTAB
/begin COMPU_VTAB _CNV_S_2_Enum_EAGS_18_S2 "" TAB_VERB 2 0 "A_AGS" 1 "S_AGS" DEFAULT_VALUE "" /end COMPU_VTAB
/begin COMPU_VTAB _CNV_S_2_Enum_EDYN__176_S2 "" TAB_VERB 2 0 "DYN_WKANBIND_KOMFORT" 1 "DYN_WKANBIND_DIREKT" DEFAULT_VALUE "" /end COMPU_VTAB
/begin COMPU_VTAB _CNV_S_2_Enum_ESTAT_223_S2 "" TAB_VERB 2 0 "KEINE_BEEINFLUSSUNG" 1 "SCHUBABSCHALTUNG_AKTIV" DEFAULT_VALUE "" /end COMPU_VTAB
/begin COMPU_VTAB _CNV_S_2_Enum_EWKAN_162_S2 "" TAB_VERB 2 0 "GER_WKSOLL" 1 "ZU_WKSOLL" DEFAULT_VALUE "" /end COMPU_VTAB
/begin COMPU_VTAB _CNV_S_2_Schalter_A_4_S2 "Schalter: 0 = AUS, 1 = EIN" TAB_VERB 2 0 "AUS" 1 "EIN" DEFAULT_VALUE "" /end COMPU_VTAB
/begin COMPU_VTAB _CNV_S_3_Enum_EABSS_228_S2 "" TAB_VERB 3 0 "ABS_NOT_IN_ACTION" 1 "ABS_IN_ACTION" 2 "ABS_FAILURE" DEFAULT_VALUE "" /end COMPU_VTAB
/begin COMPU_VTAB _CNV_S_3_Enum_EAGST_248_S2 "" TAB_VERB 3 0 "A_AGS_KU" 1 "S_AGS_KU" 2 "TID_KU" DEFAULT_VALUE "" /end COMPU_VTAB
/begin COMPU_VTAB _CNV_S_3_Enum_EANH_51_S2 "" TAB_VERB 3 0 "KEIN_ANHAENGER" 1 "ANHAENGER" 2 "ANHAENGER_ODER_KEIN_ANHAENGER" DEFAULT_VALUE "" /end COMPU_VTAB
/begin COMPU_VTAB _CNV_S_3_Enum_EANTR_216_S2 "" TAB_VERB 3 0 "HECK" 1 "ALLRAD" 2 "FRONT" DEFAULT_VALUE "" /end COMPU_VTAB
/begin COMPU_VTAB _CNV_S_3_Enum_EBAB_45_S2 "" TAB_VERB 3 0 "BAB_NICHT_ERKANNT" 1 "BAB_ERKANNT" 2 "BAB_ERKANNT_NACHL" DEFAULT_VALUE "" /end COMPU_VTAB
/begin COMPU_VTAB _CNV_S_3_Enum_ECOMP_77_S2 "Status der Steigungsverlust-Kompensation" TAB_VERB 3 0 "GUELTIG" 1 "UNGUELTIG" 2 "EINGESCHRAENKT_GUELTIG" DEFAULT_VALUE "" /end COMPU_VTAB
/begin COMPU_VTAB _CNV_S_3_Enum_EDRDY_218_S2 "" TAB_VERB 3 0 "DRDY_DSC_ON" 1 "DRDY_DTC" 4 "DRDY_DSC_OFF" DEFAULT_VALUE "" /end COMPU_VTAB
/begin COMPU_VTAB _CNV_S_3_Enum_EDSCS_50_S2 "" TAB_VERB 3 0 "DSC_ACTIVE" 1 "DSC_PASSIVE" 2 "DTC_ACTIVE" DEFAULT_VALUE "" /end COMPU_VTAB
/begin COMPU_VTAB _CNV_S_3_Enum_EDYN__171_S2 "" TAB_VERB 3 0 "DYN_DMRS_PME_KOMFORT" 1 "DYN_DMRS_PME_QS1" 2 "DYN_DMRS_PME_QS2" DEFAULT_VALUE "" /end COMPU_VTAB
/begin COMPU_VTAB _CNV_S_3_Enum_EDYN__172_S2 "" TAB_VERB 3 0 "DYN_FPKF_KOMFORT" 1 "DYN_FPKF_SPORT" 2 "DYN_FPKF_ECO" DEFAULT_VALUE "" /end COMPU_VTAB
/begin COMPU_VTAB _CNV_S_3_Enum_EDYND_129_S2 "" TAB_VERB 3 -1 "KEINE_PHASE6_7_DYNDZM" 0 "SEGELN_DYNDZM" 1 "EFAHREN_DYNDZM" DEFAULT_VALUE "" /end COMPU_VTAB
/begin COMPU_VTAB _CNV_S_3_Enum_EGDM__244_S2 "Definitionen der Werte fuer Z_GDM_RAD_KOMP" TAB_VERB 3 0 "ZU_STEIL_NEG" 1 "KEINE_UEBERSCHREITUNG" 2 "ZU_STEIL_POS" DEFAULT_VALUE "" /end COMPU_VTAB
/begin COMPU_VTAB _CNV_S_3_Enum_EHOTD_137_S2 "" TAB_VERB 3 0 "DUE" 1 "DUE_RSZVERBOT" 2 "HOTMODE" DEFAULT_VALUE "" /end COMPU_VTAB
/begin COMPU_VTAB _CNV_S_3_Enum_EHSU__112_S2 "" TAB_VERB 3 0 "HSUKS_AUS" 1 "HSUKS_EIN" 2 "HSUKS_NACHL" DEFAULT_VALUE "" /end COMPU_VTAB
/begin COMPU_VTAB _CNV_S_3_Enum_EHSUA_109_S2 "" TAB_VERB 3 0 "KEEP_HSU" 1 "OUT_HSU_ONLY" 2 "OUT_HSU_PLUS_BUFF" DEFAULT_VALUE "" /end COMPU_VTAB
/begin COMPU_VTAB _CNV_S_3_Enum_EHSUR_113_S2 "" TAB_VERB 3 0 "HSURE_BRS_AUS" 1 "HSURE_BRS_EIN" 2 "HSURE_BRS_NACHL" DEFAULT_VALUE "" /end COMPU_VTAB
/begin COMPU_VTAB _CNV_S_3_Enum_EHSUR_114_S2 "" TAB_VERB 3 0 "HSURE_FOF_AUS" 1 "HSURE_FOF_SCHARF" 2 "HSURE_FOF_EIN" DEFAULT_VALUE "" /end COMPU_VTAB
/begin COMPU_VTAB _CNV_S_3_Enum_EHSUR_115_S2 "" TAB_VERB 3 0 "HSURE_NL_AUS" 1 "HSURE_NL_SCHARF" 2 "HSURE_NL_EIN" DEFAULT_VALUE "" /end COMPU_VTAB
/begin COMPU_VTAB _CNV_S_3_Enum_EKURV_249_S2 "" TAB_VERB 3 0 "KEINE_KURVE" 1 "KURVE" 2 "KURVE_UNPLAUSIBEL" DEFAULT_VALUE "" /end COMPU_VTAB
/begin COMPU_VTAB _CNV_S_3_Enum_ELDM_61_S2 "" TAB_VERB 3 0 "KEIN_LDM" 1 "LDM_AAGS" 2 "LDM_SAGS" DEFAULT_VALUE "" /end COMPU_VTAB
/begin COMPU_VTAB _CNV_S_3_Enum_ELDM__66_S2 "" TAB_VERB 3 0 "KEINE_STELLABW" 1 "STELLABW_OK" 2 "SIGNAL_UNGUELTIG" DEFAULT_VALUE "" /end COMPU_VTAB
/begin COMPU_VTAB _CNV_S_3_Enum_ELDMA_102_S2 "" TAB_VERB 3 0 "LDM_ZUG" 1 "LDM_SCHUB_BAB_INAKTIV" 2 "LDM_SCHUB_BAB_AKTIV" DEFAULT_VALUE "" /end COMPU_VTAB
/begin COMPU_VTAB _CNV_S_3_Enum_eLW_V_225_S2 "" TAB_VERB 3 0 "LWVA_GUELTIG" 1 "LWVA_UNSICHER" 2 "LWVA_UNGUELTIG" DEFAULT_VALUE "" /end COMPU_VTAB
/begin COMPU_VTAB _CNV_S_3_Enum_ENOTL_210_S2 "" TAB_VERB 3 0 "MOTOR_KEIN_NOTLAUF" 1 "MOTOR_NOTLAUF_1" 2 "MOTOR_NOTLAUF_2" DEFAULT_VALUE "" /end COMPU_VTAB
/begin COMPU_VTAB _CNV_S_3_Enum_EPOSS_211_S2 "" TAB_VERB 3 0 "POS_CORRECT" 1 "POS_INTERMEDIATE" 2 "POS_ILLEGAL" DEFAULT_VALUE "" /end COMPU_VTAB
/begin COMPU_VTAB _CNV_S_3_Enum_EQ_64_S2 "" TAB_VERB 3 0 "SIGNAL_OK" 1 "ERSATZWERT" 2 "FEHLER" DEFAULT_VALUE "" /end COMPU_VTAB
/begin COMPU_VTAB _CNV_S_3_Enum_EREQA_103_S2 "" TAB_VERB 3 0 "NO_REQUEST" 1 "REQUEST_PRIO_LOW" 2 "REQUEST_PRIO_HIGH" DEFAULT_VALUE "" /end COMPU_VTAB
/begin COMPU_VTAB _CNV_S_3_Enum_ESCHL_28_S2 "" TAB_VERB 3 0 "HAFT_REIBUNG" 1 "ZUG_SCHLUPF" 2 "SCHUB_SCHLUPF" DEFAULT_VALUE "" /end COMPU_VTAB
/begin COMPU_VTAB _CNV_S_3_Enum_ESCHL_57_S2 "" TAB_VERB 3 0 "NICHT_BEWERTET" 1 "IN_BEWERTUNG" 2 "BEWERTET" DEFAULT_VALUE "" /end COMPU_VTAB
/begin COMPU_VTAB _CNV_S_3_Enum_EST_S_275_S2 "" TAB_VERB 3 0 "KS_SPA" 1 "HS_SPA" 2 "RS_SPA" DEFAULT_VALUE "" /end COMPU_VTAB
/begin COMPU_VTAB _CNV_S_3_Enum_EV_RI_227_S2 "" TAB_VERB 3 0 "V_VOR" 1 "V_RUECK" 2 "V_UNDEF" DEFAULT_VALUE "" /end COMPU_VTAB
/begin COMPU_VTAB _CNV_S_3_Enum_EWARM_229_S2 "" TAB_VERB 3 0 "WL_IMWARMLAUF" 1 "WL_BETRIEBSWARM" 2 "WL_ZUWARM" DEFAULT_VALUE "" /end COMPU_VTAB
/begin COMPU_VTAB _CNV_S_3_Enum_EWK_128_S2 "" TAB_VERB 3 0 "OFFEN" 1 "GEREGELT" 2 "ZU" DEFAULT_VALUE "" /end COMPU_VTAB
/begin COMPU_VTAB _CNV_S_42_Enum_EQSHI_164_S2 "" TAB_VERB 42 0 "ZWANGSCH_STEP" 1 "FT_BR_E" 2 "FT_BR_S" 3 "FT_BR_XS" 4 "GWDKKD1" 5 "GWDKKD2" 6 "MFRS" 7 "MFHS" 8 "WDKKD1" 9 "WDKKD2" 10 "WDKKD3" 11 "NULLAST" 12 "DSC_DTC" 13 "DSC_AUS" 14 "S_QS3_SOLL" 15 "ANH" 16 "ASC" 17 "TEMP1" 18 "TEMP2" 19 "WL2" 20 "ECO" 21 "COD_GETRTYP" 22 "EXCFKT1" 23 "EXCFKT2" 24 "EXCFKT3" 25 "EXCFKT4" 26 "EXCFKT5" 27 "EXCFKT6" 28 "EXCFKT7" 29 "EXCFKT8" 30 "HOCHSCH" 31 "RUECKSCH" 32 "ISTGANG_1" 33 "ISTGANG_2" 34 "ISTGANG_3" 35 "ISTGANG_4" 36 "ISTGANG_5" 37 "ISTGANG_6" 38 "ISTGANG_7" 39 "ISTGANG_8" 40 "ISTGANG_9" 41 "DYNAMIK" DEFAULT_VALUE "" /end COMPU_VTAB
/begin COMPU_VTAB _CNV_S_4_Enum_EAGS__17_S2 "" TAB_VERB 4 0 "A_AGS" 1 "S_AGS" 2 "ECO" 3 "E_FAHREN" DEFAULT_VALUE "" /end COMPU_VTAB
/begin COMPU_VTAB _CNV_S_4_Enum_EB_197_S2 "" TAB_VERB 4 0 "NICHT_GETRETEN" 1 "UEB_NICHT_GETR_GETR" 2 "DAUERHAFT_GETRETEN" 3 "UEB_GETR_NICHT_GETR" DEFAULT_VALUE "" /end COMPU_VTAB
/begin COMPU_VTAB _CNV_S_4_Enum_EBSMO_198_S2 "" TAB_VERB 4 0 "BSMODE_INIT" 1 "BSMODE_STBY" 2 "BSMODE_CRUISE" 3 "BSMODE_LMPH" DEFAULT_VALUE "" /end COMPU_VTAB
/begin COMPU_VTAB _CNV_S_4_Enum_ECOD__208_S2 "" TAB_VERB 4 0 "VMAX_IDX_0" 1 "VMAX_IDX_1" 2 "VMAX_IDX_2" 3 "VMAX_IDX_3" DEFAULT_VALUE "" /end COMPU_VTAB
/begin COMPU_VTAB _CNV_S_4_Enum_EDKFI_89_S2 "" TAB_VERB 4 0 "DKFILT_OFF" 1 "DKFILT_LDM" 2 "DKFILT_FILT1" 3 "DKFILT_PLUFT" DEFAULT_VALUE "" /end COMPU_VTAB
/begin COMPU_VTAB _CNV_S_4_Enum_EDKFI_90_S2 "" TAB_VERB 4 0 "DKFILT_LEV2_OFF" 1 "DKFILT_LEV2_UP" 2 "DKFILT_LEV2_DOWN" 3 "DKFILT_LEV2_UPDOWN" DEFAULT_VALUE "" /end COMPU_VTAB
/begin COMPU_VTAB _CNV_S_4_Enum_EDYN__173_S2 "" TAB_VERB 4 0 "DYN_HS_KOMFORT" 1 "DYN_HS_QS1" 2 "DYN_HS_QS2" 3 "DYN_HS_QS3" DEFAULT_VALUE "" /end COMPU_VTAB
/begin COMPU_VTAB _CNV_S_4_Enum_EDYN__174_S2 "" TAB_VERB 4 0 "DYN_RS_PME_KOMFORT" 1 "DYN_RS_PME_QS1" 2 "DYN_RS_PME_QS2" 3 "DYN_RS_KOMFORT" DEFAULT_VALUE "" /end COMPU_VTAB
/begin COMPU_VTAB _CNV_S_4_Enum_eEGS__219_S2 "" TAB_VERB 4 0 "KEINE_RPM_RED" 1 "RPM_RED_AKS" 2 "RPM_RED_EWP_ERR" 3 "RPM_RED_3" DEFAULT_VALUE "" /end COMPU_VTAB
/begin COMPU_VTAB _CNV_S_4_Enum_EEIN__220_S2 "" TAB_VERB 4 0 "KEINE_ANFORDERUNG" 1 "HOHE_STRANGVERSTAERKUNG" 2 "KEINE_LASTWECHSEL" 3 "LASTREDUKTION" DEFAULT_VALUE "" /end COMPU_VTAB
/begin COMPU_VTAB _CNV_S_4_Enum_EEXCF_91_S2 "" TAB_VERB 4 0 "AUTOMAT" 1 "MANUELL" 2 "FAHRERASSISTENT" 3 "ZUGKRAFTALGO" DEFAULT_VALUE "" /end COMPU_VTAB
/begin COMPU_VTAB _CNV_S_4_Enum_EFT_20_S2 "" TAB_VERB 4 0 "XE_FT" 1 "E_FT" 2 "S_FT" 3 "XS_FT" DEFAULT_VALUE "" /end COMPU_VTAB
/begin COMPU_VTAB _CNV_S_4_Enum_EHDC__222_S2 "" TAB_VERB 4 0 "HDCSBE_NO_SBE" 1 "HDCSBE_RS" 2 "HDCSBE_HS" 3 "HDCSBE_NEUTRAL" DEFAULT_VALUE "" /end COMPU_VTAB
/begin COMPU_VTAB _CNV_S_4_Enum_EHSUR_105_S2 "" TAB_VERB 4 0 "HSURE_KUVOR_A_AGS" 1 "HSURE_KUVOR_S_AGS" 2 "HSURE_KUVOR_LDMAAGS" 3 "HSURE_KUVOR_LDMSAGS" DEFAULT_VALUE "" /end COMPU_VTAB
/begin COMPU_VTAB _CNV_S_4_Enum_EHSUR_116_S2 "" TAB_VERB 4 0 "HSURE_SCHLUPF_AUS" 1 "HSURE_SCHLUPF_EIN" 2 "HSURE_SCHLUPF_HALT" 3 "HSURE_SCHLUPF_NACHL" DEFAULT_VALUE "" /end COMPU_VTAB
/begin COMPU_VTAB _CNV_S_4_Enum_EKOMB_78_S2 "" TAB_VERB 4 0 "DARK_KOMBI" 1 "SPORT_KOMBI" 2 "STEPTRONIC_KOMBI" 3 "L_KOMBI" DEFAULT_VALUE "" /end COMPU_VTAB
/begin COMPU_VTAB _CNV_S_4_Enum_EKURV_247_S2 "" TAB_VERB 4 0 "KURVEVORL_A_AGS" 1 "KURVEVORL_S_AGS" 2 "KURVEVORL_LDM" 3 "KURVEVORL_TID" DEFAULT_VALUE "" /end COMPU_VTAB
/begin COMPU_VTAB _CNV_S_4_Enum_EMODU_121_S2 "" TAB_VERB 4 0 "hFahren" 1 "Uebergang_hFahren_eFahren" 2 "eFahren" 3 "Uebergang_eFahren_hFahren" DEFAULT_VALUE "" /end COMPU_VTAB
/begin COMPU_VTAB _CNV_S_4_Enum_ENABH_93_S2 "" TAB_VERB 4 0 "KEINE_HSURERS" 1 "NABHSURERS_NULLDECRVL_1" 2 "NABHSURERS_NULLDECRVL_2" 3 "NABHSURERS_NULLDECRVL_3" DEFAULT_VALUE "" /end COMPU_VTAB
/begin COMPU_VTAB _CNV_S_4_Enum_ENIC__94_S2 "" TAB_VERB 4 0 "NIC_PROHIBITED" 1 "NIC_LOWSLIP" 2 "NIC_HIGHSLIP" 3 "AFU_ACTIVE" DEFAULT_VALUE "" /end COMPU_VTAB
/begin COMPU_VTAB _CNV_S_4_Enum_EPOSA_29_S2 "" TAB_VERB 4 0 "POS_D" 1 "POS_N" 2 "POS_R" 3 "POS_P" DEFAULT_VALUE "" /end COMPU_VTAB
/begin COMPU_VTAB _CNV_S_4_Enum_EPOSB_95_S2 "" TAB_VERB 4 0 "POSENB_D" 1 "POSENB_N" 2 "POSENB_R" 3 "POSENB_P" DEFAULT_VALUE "" /end COMPU_VTAB
/begin COMPU_VTAB _CNV_S_4_Enum_EPOWE_87_S2 "" TAB_VERB 4 0 "PS_FREI" 1 "PS_KOMFORT" 2 "PS_SPORT" 3 "PS_SPORT_PLUS" DEFAULT_VALUE "" /end COMPU_VTAB
/begin COMPU_VTAB _CNV_S_4_Enum_EPROG_26_S2 "" TAB_VERB 4 0 "NORMAL_MODE" 1 "SPORT_MODE" 2 "STEPTRONIC_MODE" 3 "L_MODE" DEFAULT_VALUE "" /end COMPU_VTAB
/begin COMPU_VTAB _CNV_S_4_Enum_EPROG_55_S2 "" TAB_VERB 4 0 "EXTREME_ECONOMY_PROG" 1 "ECONOMY_PROG" 2 "SPORT_PROG" 3 "EXTREME_SPORT_PROG" DEFAULT_VALUE "" /end COMPU_VTAB
/begin COMPU_VTAB_RANGE _CNV_S_4_Enum_ESCHA_151_R_S2 "Schaltungstypen" 4 0 0 "ZH" 1 1 "SH" 2 2 "ZR" 3 4 "SR" DEFAULT_VALUE "" /end COMPU_VTAB_RANGE
/begin COMPU_VTAB _CNV_S_4_Enum_ESEQU_35_S2 "" TAB_VERB 4 0 "SCHALT_FERTIG" 1 "BEHANDLE_SCHLUPF" 2 "SCHALT_ANGFEFORDERT" 3 "SCHALT_LAEUFT" DEFAULT_VALUE "" /end COMPU_VTAB
/begin COMPU_VTAB _CNV_S_5_Enum_EFT2_53_S2 "" TAB_VERB 5 0 "XXE_FT" 1 "XE_FT" 2 "E_FT" 3 "S_FT" 4 "XS_FT" DEFAULT_VALUE "" /end COMPU_VTAB
/begin COMPU_VTAB _CNV_S_5_Enum_EKURV_246_S2 "" TAB_VERB 5 0 "KURVETYP_NORMAL" 1 "KURVETYP_NORMAL_S_AGS" 2 "KURVETYP_SERP" 3 "KURVETYP_LDM" 4 "KURVETYP_NORMAL_TID" DEFAULT_VALUE "" /end COMPU_VTAB
/begin COMPU_VTAB _CNV_S_5_Enum_EMOTS_226_S2 "" TAB_VERB 5 0 "KEIN_MOTSTART" 1 "START_SGR" 2 "START_EM" 3 "START_SGR_EM" 4 "START_RS" DEFAULT_VALUE "" /end COMPU_VTAB
/begin COMPU_VTAB _CNV_S_5_Enum_ETUPE_23_S2 "" TAB_VERB 5 0 "NMOTHS_TUPEL_0" 1 "NMOTHS_TUPEL_1" 2 "NMOTHS_TUPEL_2" 3 "NMOTHS_TUPEL_3" 4 "NMOTHS_TUPEL_4" DEFAULT_VALUE "" /end COMPU_VTAB
/begin COMPU_VTAB _CNV_S_5_Enum_EVALI_187_S2 "" TAB_VERB 5 0 "INVALID" 2 "INVALID_LDM" 5 "DREHZAHLGRENZEN" 10 "DREHZAHLEN" 30 "BEWERTUNG" DEFAULT_VALUE "" /end COMPU_VTAB
/begin COMPU_VTAB _CNV_S_5_Enum_REKUP_257_S2 "" TAB_VERB 5 0 "REKUP_IDX1" 1 "REKUP_IDX2" 2 "REKUP_IDX3" 3 "REKUP_IDX4" 4 "REKUP_IDX5" DEFAULT_VALUE "" /end COMPU_VTAB
/begin COMPU_VTAB _CNV_S_6_Enum_EANZE_152_S2 "" TAB_VERB 6 0 "MANUELLGANG_ANZ" 1 "ISTGANG_ANZ" 2 "ZIELGANG_ANZ" 3 "AUTOMATGANG_ANZ" 4 "LMODEGANG_ANZ" 5 "KEINGANG_ANZ" DEFAULT_VALUE "" /end COMPU_VTAB
/begin COMPU_VTAB _CNV_S_6_Enum_EANZG_150_S2 "" TAB_VERB 6 0 "GANGART_AUTOMAT" 1 "GANGART_MANUELL" 2 "GANGART_SPORT" 3 "GANGART_FAS" 4 "GANGART_ZKA" 5 "GANGART_LMODE" DEFAULT_VALUE "" /end COMPU_VTAB
/begin COMPU_VTAB _CNV_S_6_Enum_EBERG_47_S2 "" TAB_VERB 6 0 "BERGANH_OFF" 1 "BERGANH_A1" 2 "BERGANH_A2" 3 "BERGANH_A3" 4 "BERGANH_A4" 5 "BERGANH_A5" DEFAULT_VALUE "" /end COMPU_VTAB
/begin COMPU_VTAB _CNV_S_6_Enum_EDL_11_S2 "" TAB_VERB 6 1 "DL_1" 2 "DL_2" 3 "DL_3" 4 "DL_4" 5 "DL_5" 6 "DL_6" DEFAULT_VALUE "" /end COMPU_VTAB
/begin COMPU_VTAB _CNV_S_6_Enum_EEFAH_118_S2 "" TAB_VERB 6 0 "KEIN_E_FAHREN" 1 "MSA_KENNLINIE" 2 "HOCHEFFIZIENZ_KL" 3 "EFFIZIENZ_KL" 4 "KUNDENWERTE_KL" 5 "EDRIVE_KL" DEFAULT_VALUE "" /end COMPU_VTAB
/begin COMPU_VTAB _CNV_S_6_Enum_EK0_224_S2 "" TAB_VERB 6 0 "OFFEN" 1 "ANGELEGT" 2 "DRUCKSTELLUNG" 3 "SCHLUPFGEREGELT" 4 "GEREGELTGESCHLOSSEN" 5 "GESCHLOSSEN" DEFAULT_VALUE "" /end COMPU_VTAB
/begin COMPU_VTAB _CNV_S_6_Enum_EZKAT_189_S2 "" TAB_VERB 6 -1 "ZKA_IDX_DEAKTIVIERT" 0 "ZKA_IDX1" 1 "ZKA_IDX2" 2 "ZKA_IDX3" 3 "ZKA_IDX4" 4 "ZKA_IDX5" DEFAULT_VALUE "" /end COMPU_VTAB
/begin COMPU_VTAB _CNV_S_7_Enum_EBSMO_199_S2 "" TAB_VERB 7 0 "NO_TRANS" 1 "INIT_STBY" 2 "STBY_CRUISE" 3 "STBY_LMPH" 4 "CRUISE_STBY" 5 "CRUISE_LMPH" 6 "LMPH_STBY" DEFAULT_VALUE "" /end COMPU_VTAB
/begin COMPU_VTAB _CNV_S_7_Enum_EDMRS_188_S2 "" TAB_VERB 7 0 "KEIN_BEREICH" 1 "BEREICH_1RS" 2 "BEREICH_D2RS" 3 "BEREICH_D3RS" 4 "BEREICH_D4RS" 5 "BEREICH_D5RS" 6 "BEREICH_D6RS" DEFAULT_VALUE "" /end COMPU_VTAB
/begin COMPU_VTAB _CNV_S_7_Enum_EDRDY_217_S2 "" TAB_VERB 7 0 "DRDY_BASIS" 2 "DRDY_KOMFORT" 4 "DRDY_TRAKTION" 9 "DRDY_SPORT" 10 "DRDY_ECO" 11 "DRDY_SPORT_PLUS" 13 "DRDY_RACE" DEFAULT_VALUE "" /end COMPU_VTAB
/begin COMPU_VTAB _CNV_S_7_Enum_EDRIV_158_S2 "" TAB_VERB 7 0 "DRIVEDYN_BASIS" 1 "DRIVEDYN_KOMFORT" 2 "DRIVEDYN_TRAKTION" 3 "DRIVEDYN_SPORT" 4 "DRIVEDYN_SPORT_PLUS" 5 "DRIVEDYN_RACE" 6 "DRIVEDYN_ECO" DEFAULT_VALUE "" /end COMPU_VTAB
/begin COMPU_VTAB _CNV_S_7_Enum_EGEAR_209_S2 "" TAB_VERB 7 0 "NO_GEAR_REDUCTION" 1 "REDUCE_GEAR_1" 2 "REDUCE_GEAR_2" 3 "REDUCE_GEAR_3" 4 "REDUCE_GEAR_4" 5 "REDUCE_GEAR_5" 6 "REDUCE_GEAR_6" DEFAULT_VALUE "" /end COMPU_VTAB
/begin COMPU_VTAB _CNV_S_7_Enum_ELDMM_65_S2 "" TAB_VERB 7 0 "LDM_AUS" 1 "LDM_AN_STD" 2 "BN2020_SLD_AKTIV" 3 "BN2020_PMA_AKTIV_ODER_BN2000_LDM_AN_BREMSE" 4 "BN2000_LDM_AN_UEBERTRITT" 5 "BN2000_LDM_AUS_CASYSTEMBREMSUNG" 15 "BN2000_LDM_INIT" DEFAULT_VALUE "" /end COMPU_VTAB
/begin COMPU_VTAB _CNV_S_7_Enum_ESDYN_175_S2 "" TAB_VERB 7 0 "KOMFORT_SDYN" 1 "QS1_SDYN" 2 "QS2_SDYN" 3 "QS3_SDYN" 4 "QS4_SDYN" 5 "QS5_SDYN" 6 "QS6_SDYN" DEFAULT_VALUE "" /end COMPU_VTAB
/begin COMPU_VTAB _CNV_S_7_Enum_ESTAR_200_S2 "" TAB_VERB 7 0 "STARTLM_NICHT" 1 "STARTLM_STEP1" 2 "STARTLM_STEP2" 3 "STARTLM_STEP3" 4 "STARTLM_TIPP1" 5 "STARTLM_TIPP2" 6 "STARTLM_OK" DEFAULT_VALUE "" /end COMPU_VTAB
/begin COMPU_VTAB _CNV_S_8_Enum_EDYND_134_S2 "" TAB_VERB 8 0 "PHASE0" 1 "PHASE1" 2 "PHASE2" 3 "PHASE3" 4 "PHASE4" 5 "PHASE5" 6 "PHASE6" 7 "PHASE7" DEFAULT_VALUE "" /end COMPU_VTAB
/begin COMPU_VTAB _CNV_S_8_Enum_EHDC_221_S2 "" TAB_VERB 8 0 "HDC_OFF" 1 "HDC_DSBL_GANG" 2 "HDC_DSBL_LOW" 3 "HDC_DSBL_SPD" 4 "HDC_UNDEF" 5 "HDC_ENBL" 6 "HDC_ACTIVE" 7 "HDC_ERROR" DEFAULT_VALUE "" /end COMPU_VTAB
/begin COMPU_VTAB _CNV_S_8_Enum_EHSUB_104_S2 "" TAB_VERB 8 0 "HSUBEDAUS_D" 1 "HSUBEDAUS_D_FDC" 2 "HSUBEDAUS_S" 3 "HSUBEDAUS_S_FDC" 4 "HSUBEDAUS_STEP" 5 "HSUBEDAUS_STEP_FDC" 6 "HSUBEDAUS_TID" 7 "HSUBEDAUS_TID_FDC" DEFAULT_VALUE "" /end COMPU_VTAB
/begin COMPU_VTAB _CNV_S_8_Enum_EMUEL_34_S2 "" TAB_VERB 8 0 "KICKDOWN_HS" 1 "KICKDOWN_RS" 2 "BERG_HS" 3 "BERG_RS" 4 "VOLLAST_HS" 5 "VOLLAST_RS" 6 "TEILLAST_HS" 7 "TEILLAST_RS" DEFAULT_VALUE "" /end COMPU_VTAB
/begin COMPU_VTAB _CNV_S_8_Enum_EPOS_24_S2 "" TAB_VERB 8 0 "POS_1" 1 "POS_2" 2 "POS_3" 3 "POS_4" 4 "POS_D" 5 "POS_N" 6 "POS_R" 7 "POS_P" DEFAULT_VALUE "" /end COMPU_VTAB
/begin COMPU_VTAB _CNV_S_9_Enum_EFKTE_92_S2 "" TAB_VERB 9 0 "KEINE" 1 "WL1" 2 "WL2" 3 "MUELOW" 4 "TID" 5 "LDM" 6 "FGR" 7 "FAS_LERN" 8 "HDC" DEFAULT_VALUE "" /end COMPU_VTAB
/begin COMPU_VTAB _CNV_S_9_Enum_EGANG_21_S2 "" TAB_VERB 9 0 "GANG_1" 1 "GANG_2" 2 "GANG_3" 3 "GANG_4" 4 "GANG_5" 5 "GANG_6" 6 "GANG_7" 7 "GANG_8" 8 "GANG_9" DEFAULT_VALUE "" /end COMPU_VTAB
/begin COMPU_VTAB _CNV_S_9_Enum_EMAPD_212_S2 "" TAB_VERB 9 0 "LMODE_DL" 1 "FDC_DL" 2 "FDS_BASIS" 3 "FDS_KOMFORT" 4 "FDS_TRAKTION" 5 "FDS_SPORT" 6 "FDS_SPORT_PLUS" 7 "FDS_RACE" 8 "FDS_ECO" DEFAULT_VALUE "" /end COMPU_VTAB
/begin COMPU_METHOD _CNV_P_2_A_I_5_CM_S2 "" TAB_INTP "%6.3" "" COMPU_TAB_REF _CNV_P_2_A_I_5_S2 /end COMPU_METHOD
/begin COMPU_METHOD _CNV_R_R_Umr_1_zu_1_2_CM_S2 "" RAT_FUNC "%6.3" "" COEFFS 0 1 0 0 0 1 /end COMPU_METHOD
/begin COMPU_METHOD _CNV_R_R_Umr_1_zu_1_30_CM_S2 "" RAT_FUNC "%6.3" "%" COEFFS 0 1 0 0 0 1 /end COMPU_METHOD
/begin COMPU_METHOD _CNV_R_R_Umr_1_zu_1_8_CM_S2 "" RAT_FUNC "%6.3" "km/h" COEFFS 0 1 0 0 0 1 /end COMPU_METHOD
/begin COMPU_METHOD _CNV_S_100_Enum_EPRIS_25_CM_S2 "" TAB_VERB "%6.3" "" COMPU_TAB_REF _CNV_S_100_Enum_EPRIS_25_S2 /end COMPU_METHOD
/begin COMPU_METHOD _CNV_S_10_Enum_EDBMT_254_CM_S2 "" TAB_VERB "%6.3" "" COMPU_TAB_REF _CNV_S_10_Enum_EDBMT_254_S2 /end COMPU_METHOD
/begin COMPU_METHOD _CNV_S_10_Enum_EDMRS_22_CM_S2 "" TAB_VERB "%6.3" "" COMPU_TAB_REF _CNV_S_10_Enum_EDMRS_22_S2 /end COMPU_METHOD
/begin COMPU_METHOD _CNV_S_10_Enum_EGANG_75_CM_S2 "" TAB_VERB "%6.3" "" COMPU_TAB_REF _CNV_S_10_Enum_EGANG_75_S2 /end COMPU_METHOD
/begin COMPU_METHOD _CNV_S_10_Enum_EHASS_119_CM_S2 "" TAB_VERB "%6.3" "" COMPU_TAB_REF _CNV_S_10_Enum_EHASS_119_S2 /end COMPU_METHOD
/begin COMPU_METHOD _CNV_S_11_Enum_EGANG_74_CM_S2 "" TAB_VERB "%6.3" "" COMPU_TAB_REF _CNV_S_11_Enum_EGANG_74_S2 /end COMPU_METHOD
/begin COMPU_METHOD _CNV_S_12_Enum_EK0_S_76_CM_S2 "" TAB_VERB "%6.3" "" COMPU_TAB_REF _CNV_S_12_Enum_EK0_S_76_S2 /end COMPU_METHOD
/begin COMPU_METHOD _CNV_S_14_Enum_EGANG_73_CM_S2 "Ganganzeige" TAB_VERB "%6.3" "" COMPU_TAB_REF _CNV_S_14_Enum_EGANG_73_S2 /end COMPU_METHOD
/begin COMPU_METHOD _CNV_S_15_Enum_EPRIS_274_CM_S2 "" TAB_VERB "%6.3" "" COMPU_TAB_REF _CNV_S_15_Enum_EPRIS_274_S2 /end COMPU_METHOD
/begin COMPU_METHOD _CNV_S_16_Enum_EIDXG_169_CM_S2 "" TAB_VERB "%6.3" "" COMPU_TAB_REF _CNV_S_16_Enum_EIDXG_169_S2 /end COMPU_METHOD
/begin COMPU_METHOD _CNV_S_16_Enum_EPROG_79_CM_S2 "" TAB_VERB "%6.3" "" COMPU_TAB_REF _CNV_S_16_Enum_EPROG_79_S2 /end COMPU_METHOD
/begin COMPU_METHOD _CNV_S_21_Enum_EPROG_27_CM_S2 "" TAB_VERB "%6.3" "" COMPU_TAB_REF _CNV_S_21_Enum_EPROG_27_S2 /end COMPU_METHOD
/begin COMPU_METHOD _CNV_S_2_Enum_EAGS_18_CM_S2 "" TAB_VERB "%6.3" "" COMPU_TAB_REF _CNV_S_2_Enum_EAGS_18_S2 /end COMPU_METHOD
/begin COMPU_METHOD _CNV_S_2_Enum_EDYN__176_CM_S2 "" TAB_VERB "%6.3" "" COMPU_TAB_REF _CNV_S_2_Enum_EDYN__176_S2 /end COMPU_METHOD
/begin COMPU_METHOD _CNV_S_2_Enum_ESTAT_223_CM_S2 "" TAB_VERB "%6.3" "" COMPU_TAB_REF _CNV_S_2_Enum_ESTAT_223_S2 /end COMPU_METHOD
/begin COMPU_METHOD _CNV_S_2_Enum_EWKAN_162_CM_S2 "" TAB_VERB "%6.3" "" COMPU_TAB_REF _CNV_S_2_Enum_EWKAN_162_S2 /end COMPU_METHOD
/begin COMPU_METHOD _CNV_S_2_Schalter_A_4_CM_S2 "Schalter: 0 = AUS, 1 = EIN" TAB_VERB "%6.3" "" COMPU_TAB_REF _CNV_S_2_Schalter_A_4_S2 /end COMPU_METHOD
/begin COMPU_METHOD _CNV_S_3_Enum_EABSS_228_CM_S2 "" TAB_VERB "%6.3" "" COMPU_TAB_REF _CNV_S_3_Enum_EABSS_228_S2 /end COMPU_METHOD
/begin COMPU_METHOD _CNV_S_3_Enum_EAGST_248_CM_S2 "" TAB_VERB "%6.3" "" COMPU_TAB_REF _CNV_S_3_Enum_EAGST_248_S2 /end COMPU_METHOD
/begin COMPU_METHOD _CNV_S_3_Enum_EANH_51_CM_S2 "" TAB_VERB "%6.3" "" COMPU_TAB_REF _CNV_S_3_Enum_EANH_51_S2 /end COMPU_METHOD
/begin COMPU_METHOD _CNV_S_3_Enum_EANTR_216_CM_S2 "" TAB_VERB "%6.3" "" COMPU_TAB_REF _CNV_S_3_Enum_EANTR_216_S2 /end COMPU_METHOD
/begin COMPU_METHOD _CNV_S_3_Enum_EBAB_45_CM_S2 "" TAB_VERB "%6.3" "" COMPU_TAB_REF _CNV_S_3_Enum_EBAB_45_S2 /end COMPU_METHOD
/begin COMPU_METHOD _CNV_S_3_Enum_ECOMP_77_CM_S2 "Status der Steigungsverlust-Kompensation" TAB_VERB "%6.3" "" COMPU_TAB_REF _CNV_S_3_Enum_ECOMP_77_S2 /end COMPU_METHOD
/begin COMPU_METHOD _CNV_S_3_Enum_EDRDY_218_CM_S2 "" TAB_VERB "%6.3" "" COMPU_TAB_REF _CNV_S_3_Enum_EDRDY_218_S2 /end COMPU_METHOD
/begin COMPU_METHOD _CNV_S_3_Enum_EDSCS_50_CM_S2 "" TAB_VERB "%6.3" "" COMPU_TAB_REF _CNV_S_3_Enum_EDSCS_50_S2 /end COMPU_METHOD
/begin COMPU_METHOD _CNV_S_3_Enum_EDYN__171_CM_S2 "" TAB_VERB "%6.3" "" COMPU_TAB_REF _CNV_S_3_Enum_EDYN__171_S2 /end COMPU_METHOD
/begin COMPU_METHOD _CNV_S_3_Enum_EDYN__172_CM_S2 "" TAB_VERB "%6.3" "" COMPU_TAB_REF _CNV_S_3_Enum_EDYN__172_S2 /end COMPU_METHOD
/begin COMPU_METHOD _CNV_S_3_Enum_EDYND_129_CM_S2 "" TAB_VERB "%6.3" "" COMPU_TAB_REF _CNV_S_3_Enum_EDYND_129_S2 /end COMPU_METHOD
/begin COMPU_METHOD _CNV_S_3_Enum_EGDM__244_CM_S2 "Definitionen der Werte fuer Z_GDM_RAD_KOMP" TAB_VERB "%6.3" "" COMPU_TAB_REF _CNV_S_3_Enum_EGDM__244_S2 /end COMPU_METHOD
/begin COMPU_METHOD _CNV_S_3_Enum_EHOTD_137_CM_S2 "" TAB_VERB "%6.3" "" COMPU_TAB_REF _CNV_S_3_Enum_EHOTD_137_S2 /end COMPU_METHOD
/begin COMPU_METHOD _CNV_S_3_Enum_EHSU__112_CM_S2 "" TAB_VERB "%6.3" "" COMPU_TAB_REF _CNV_S_3_Enum_EHSU__112_S2 /end COMPU_METHOD
/begin COMPU_METHOD _CNV_S_3_Enum_EHSUA_109_CM_S2 "" TAB_VERB "%6.3" "" COMPU_TAB_REF _CNV_S_3_Enum_EHSUA_109_S2 /end COMPU_METHOD
/begin COMPU_METHOD _CNV_S_3_Enum_EHSUR_113_CM_S2 "" TAB_VERB "%6.3" "" COMPU_TAB_REF _CNV_S_3_Enum_EHSUR_113_S2 /end COMPU_METHOD
/begin COMPU_METHOD _CNV_S_3_Enum_EHSUR_114_CM_S2 "" TAB_VERB "%6.3" "" COMPU_TAB_REF _CNV_S_3_Enum_EHSUR_114_S2 /end COMPU_METHOD
/begin COMPU_METHOD _CNV_S_3_Enum_EHSUR_115_CM_S2 "" TAB_VERB "%6.3" "" COMPU_TAB_REF _CNV_S_3_Enum_EHSUR_115_S2 /end COMPU_METHOD
/begin COMPU_METHOD _CNV_S_3_Enum_EKURV_249_CM_S2 "" TAB_VERB "%6.3" "" COMPU_TAB_REF _CNV_S_3_Enum_EKURV_249_S2 /end COMPU_METHOD
/begin COMPU_METHOD _CNV_S_3_Enum_ELDM_61_CM_S2 "" TAB_VERB "%6.3" "" COMPU_TAB_REF _CNV_S_3_Enum_ELDM_61_S2 /end COMPU_METHOD
/begin COMPU_METHOD _CNV_S_3_Enum_ELDM__66_CM_S2 "" TAB_VERB "%6.3" "" COMPU_TAB_REF _CNV_S_3_Enum_ELDM__66_S2 /end COMPU_METHOD
/begin COMPU_METHOD _CNV_S_3_Enum_ELDMA_102_CM_S2 "" TAB_VERB "%6.3" "" COMPU_TAB_REF _CNV_S_3_Enum_ELDMA_102_S2 /end COMPU_METHOD
/begin COMPU_METHOD _CNV_S_3_Enum_eLW_V_225_CM_S2 "" TAB_VERB "%6.3" "" COMPU_TAB_REF _CNV_S_3_Enum_eLW_V_225_S2 /end COMPU_METHOD
/begin COMPU_METHOD _CNV_S_3_Enum_ENOTL_210_CM_S2 "" TAB_VERB "%6.3" "" COMPU_TAB_REF _CNV_S_3_Enum_ENOTL_210_S2 /end COMPU_METHOD
/begin COMPU_METHOD _CNV_S_3_Enum_EPOSS_211_CM_S2 "" TAB_VERB "%6.3" "" COMPU_TAB_REF _CNV_S_3_Enum_EPOSS_211_S2 /end COMPU_METHOD
/begin COMPU_METHOD _CNV_S_3_Enum_EQ_64_CM_S2 "" TAB_VERB "%6.3" "" COMPU_TAB_REF _CNV_S_3_Enum_EQ_64_S2 /end COMPU_METHOD
/begin COMPU_METHOD _CNV_S_3_Enum_EREQA_103_CM_S2 "" TAB_VERB "%6.3" "" COMPU_TAB_REF _CNV_S_3_Enum_EREQA_103_S2 /end COMPU_METHOD
/begin COMPU_METHOD _CNV_S_3_Enum_ESCHL_28_CM_S2 "" TAB_VERB "%6.3" "" COMPU_TAB_REF _CNV_S_3_Enum_ESCHL_28_S2 /end COMPU_METHOD
/begin COMPU_METHOD _CNV_S_3_Enum_ESCHL_57_CM_S2 "" TAB_VERB "%6.3" "" COMPU_TAB_REF _CNV_S_3_Enum_ESCHL_57_S2 /end COMPU_METHOD
/begin COMPU_METHOD _CNV_S_3_Enum_EST_S_275_CM_S2 "" TAB_VERB "%6.3" "" COMPU_TAB_REF _CNV_S_3_Enum_EST_S_275_S2 /end COMPU_METHOD
/begin COMPU_METHOD _CNV_S_3_Enum_EV_RI_227_CM_S2 "" TAB_VERB "%6.3" "" COMPU_TAB_REF _CNV_S_3_Enum_EV_RI_227_S2 /end COMPU_METHOD
/begin COMPU_METHOD _CNV_S_3_Enum_EWARM_229_CM_S2 "" TAB_VERB "%6.3" "" COMPU_TAB_REF _CNV_S_3_Enum_EWARM_229_S2 /end COMPU_METHOD
/begin COMPU_METHOD _CNV_S_3_Enum_EWK_128_CM_S2 "" TAB_VERB "%6.3" "" COMPU_TAB_REF _CNV_S_3_Enum_EWK_128_S2 /end COMPU_METHOD
/begin COMPU_METHOD _CNV_S_42_Enum_EQSHI_164_CM_S2 "" TAB_VERB "%6.3" "" COMPU_TAB_REF _CNV_S_42_Enum_EQSHI_164_S2 /end COMPU_METHOD
/begin COMPU_METHOD _CNV_S_4_Enum_EAGS__17_CM_S2 "" TAB_VERB "%6.3" "" COMPU_TAB_REF _CNV_S_4_Enum_EAGS__17_S2 /end COMPU_METHOD
/begin COMPU_METHOD _CNV_S_4_Enum_EB_197_CM_S2 "" TAB_VERB "%6.3" "" COMPU_TAB_REF _CNV_S_4_Enum_EB_197_S2 /end COMPU_METHOD
/begin COMPU_METHOD _CNV_S_4_Enum_EBSMO_198_CM_S2 "" TAB_VERB "%6.3" "" COMPU_TAB_REF _CNV_S_4_Enum_EBSMO_198_S2 /end COMPU_METHOD
/begin COMPU_METHOD _CNV_S_4_Enum_ECOD__208_CM_S2 "" TAB_VERB "%6.3" "" COMPU_TAB_REF _CNV_S_4_Enum_ECOD__208_S2 /end COMPU_METHOD
/begin COMPU_METHOD _CNV_S_4_Enum_EDKFI_89_CM_S2 "" TAB_VERB "%6.3" "" COMPU_TAB_REF _CNV_S_4_Enum_EDKFI_89_S2 /end COMPU_METHOD
/begin COMPU_METHOD _CNV_S_4_Enum_EDKFI_90_CM_S2 "" TAB_VERB "%6.3" "" COMPU_TAB_REF _CNV_S_4_Enum_EDKFI_90_S2 /end COMPU_METHOD
/begin COMPU_METHOD _CNV_S_4_Enum_EDYN__173_CM_S2 "" TAB_VERB "%6.3" "" COMPU_TAB_REF _CNV_S_4_Enum_EDYN__173_S2 /end COMPU_METHOD
/begin COMPU_METHOD _CNV_S_4_Enum_EDYN__174_CM_S2 "" TAB_VERB "%6.3" "" COMPU_TAB_REF _CNV_S_4_Enum_EDYN__174_S2 /end COMPU_METHOD
/begin COMPU_METHOD _CNV_S_4_Enum_eEGS__219_CM_S2 "" TAB_VERB "%6.3" "" COMPU_TAB_REF _CNV_S_4_Enum_eEGS__219_S2 /end COMPU_METHOD
/begin COMPU_METHOD _CNV_S_4_Enum_EEIN__220_CM_S2 "" TAB_VERB "%6.3" "" COMPU_TAB_REF _CNV_S_4_Enum_EEIN__220_S2 /end COMPU_METHOD
/begin COMPU_METHOD _CNV_S_4_Enum_EEXCF_91_CM_S2 "" TAB_VERB "%6.3" "" COMPU_TAB_REF _CNV_S_4_Enum_EEXCF_91_S2 /end COMPU_METHOD
/begin COMPU_METHOD _CNV_S_4_Enum_EFT_20_CM_S2 "" TAB_VERB "%6.3" "" COMPU_TAB_REF _CNV_S_4_Enum_EFT_20_S2 /end COMPU_METHOD
/begin COMPU_METHOD _CNV_S_4_Enum_EHDC__222_CM_S2 "" TAB_VERB "%6.3" "" COMPU_TAB_REF _CNV_S_4_Enum_EHDC__222_S2 /end COMPU_METHOD
/begin COMPU_METHOD _CNV_S_4_Enum_EHSUR_105_CM_S2 "" TAB_VERB "%6.3" "" COMPU_TAB_REF _CNV_S_4_Enum_EHSUR_105_S2 /end COMPU_METHOD
/begin COMPU_METHOD _CNV_S_4_Enum_EHSUR_116_CM_S2 "" TAB_VERB "%6.3" "" COMPU_TAB_REF _CNV_S_4_Enum_EHSUR_116_S2 /end COMPU_METHOD
/begin COMPU_METHOD _CNV_S_4_Enum_EKOMB_78_CM_S2 "" TAB_VERB "%6.3" "" COMPU_TAB_REF _CNV_S_4_Enum_EKOMB_78_S2 /end COMPU_METHOD
/begin COMPU_METHOD _CNV_S_4_Enum_EKURV_247_CM_S2 "" TAB_VERB "%6.3" "" COMPU_TAB_REF _CNV_S_4_Enum_EKURV_247_S2 /end COMPU_METHOD
/begin COMPU_METHOD _CNV_S_4_Enum_EMODU_121_CM_S2 "" TAB_VERB "%6.3" "" COMPU_TAB_REF _CNV_S_4_Enum_EMODU_121_S2 /end COMPU_METHOD
/begin COMPU_METHOD _CNV_S_4_Enum_ENABH_93_CM_S2 "" TAB_VERB "%6.3" "" COMPU_TAB_REF _CNV_S_4_Enum_ENABH_93_S2 /end COMPU_METHOD
/begin COMPU_METHOD _CNV_S_4_Enum_ENIC__94_CM_S2 "" TAB_VERB "%6.3" "" COMPU_TAB_REF _CNV_S_4_Enum_ENIC__94_S2 /end COMPU_METHOD
/begin COMPU_METHOD _CNV_S_4_Enum_EPOSA_29_CM_S2 "" TAB_VERB "%6.3" "" COMPU_TAB_REF _CNV_S_4_Enum_EPOSA_29_S2 /end COMPU_METHOD
/begin COMPU_METHOD _CNV_S_4_Enum_EPOSB_95_CM_S2 "" TAB_VERB "%6.3" "" COMPU_TAB_REF _CNV_S_4_Enum_EPOSB_95_S2 /end COMPU_METHOD
/begin COMPU_METHOD _CNV_S_4_Enum_EPOWE_87_CM_S2 "" TAB_VERB "%6.3" "" COMPU_TAB_REF _CNV_S_4_Enum_EPOWE_87_S2 /end COMPU_METHOD
/begin COMPU_METHOD _CNV_S_4_Enum_EPROG_26_CM_S2 "" TAB_VERB "%6.3" "" COMPU_TAB_REF _CNV_S_4_Enum_EPROG_26_S2 /end COMPU_METHOD
/begin COMPU_METHOD _CNV_S_4_Enum_EPROG_55_CM_S2 "" TAB_VERB "%6.3" "" COMPU_TAB_REF _CNV_S_4_Enum_EPROG_55_S2 /end COMPU_METHOD
/begin COMPU_METHOD _CNV_S_4_Enum_ESCHA_151_R_CM_S2 "Schaltungstypen" TAB_VERB "%6.3" "" COMPU_TAB_REF _CNV_S_4_Enum_ESCHA_151_R_S2 /end COMPU_METHOD
/begin COMPU_METHOD _CNV_S_4_Enum_ESEQU_35_CM_S2 "" TAB_VERB "%6.3" "" COMPU_TAB_REF _CNV_S_4_Enum_ESEQU_35_S2 /end COMPU_METHOD
/begin COMPU_METHOD _CNV_S_5_Enum_EFT2_53_CM_S2 "" TAB_VERB "%6.3" "" COMPU_TAB_REF _CNV_S_5_Enum_EFT2_53_S2 /end COMPU_METHOD
/begin COMPU_METHOD _CNV_S_5_Enum_EKURV_246_CM_S2 "" TAB_VERB "%6.3" "" COMPU_TAB_REF _CNV_S_5_Enum_EKURV_246_S2 /end COMPU_METHOD
/begin COMPU_METHOD _CNV_S_5_Enum_EMOTS_226_CM_S2 "" TAB_VERB "%6.3" "" COMPU_TAB_REF _CNV_S_5_Enum_EMOTS_226_S2 /end COMPU_METHOD
/begin COMPU_METHOD _CNV_S_5_Enum_ETUPE_23_CM_S2 "" TAB_VERB "%6.3" "" COMPU_TAB_REF _CNV_S_5_Enum_ETUPE_23_S2 /end COMPU_METHOD
/begin COMPU_METHOD _CNV_S_5_Enum_EVALI_187_CM_S2 "" TAB_VERB "%6.3" "" COMPU_TAB_REF _CNV_S_5_Enum_EVALI_187_S2 /end COMPU_METHOD
/begin COMPU_METHOD _CNV_S_5_Enum_REKUP_257_CM_S2 "" TAB_VERB "%6.3" "" COMPU_TAB_REF _CNV_S_5_Enum_REKUP_257_S2 /end COMPU_METHOD
/begin COMPU_METHOD _CNV_S_6_Enum_EANZE_152_CM_S2 "" TAB_VERB "%6.3" "" COMPU_TAB_REF _CNV_S_6_Enum_EANZE_152_S2 /end COMPU_METHOD
/begin COMPU_METHOD _CNV_S_6_Enum_EANZG_150_CM_S2 "" TAB_VERB "%6.3" "" COMPU_TAB_REF _CNV_S_6_Enum_EANZG_150_S2 /end COMPU_METHOD
/begin COMPU_METHOD _CNV_S_6_Enum_EBERG_47_CM_S2 "" TAB_VERB "%6.3" "" COMPU_TAB_REF _CNV_S_6_Enum_EBERG_47_S2 /end COMPU_METHOD
/begin COMPU_METHOD _CNV_S_6_Enum_EDL_11_CM_S2 "" TAB_VERB "%6.3" "" COMPU_TAB_REF _CNV_S_6_Enum_EDL_11_S2 /end COMPU_METHOD
/begin COMPU_METHOD _CNV_S_6_Enum_EEFAH_118_CM_S2 "" TAB_VERB "%6.3" "" COMPU_TAB_REF _CNV_S_6_Enum_EEFAH_118_S2 /end COMPU_METHOD
/begin COMPU_METHOD _CNV_S_6_Enum_EK0_224_CM_S2 "" TAB_VERB "%6.3" "" COMPU_TAB_REF _CNV_S_6_Enum_EK0_224_S2 /end COMPU_METHOD
/begin COMPU_METHOD _CNV_S_6_Enum_EZKAT_189_CM_S2 "" TAB_VERB "%6.3" "" COMPU_TAB_REF _CNV_S_6_Enum_EZKAT_189_S2 /end COMPU_METHOD
/begin COMPU_METHOD _CNV_S_7_Enum_EBSMO_199_CM_S2 "" TAB_VERB "%6.3" "" COMPU_TAB_REF _CNV_S_7_Enum_EBSMO_199_S2 /end COMPU_METHOD
/begin COMPU_METHOD _CNV_S_7_Enum_EDMRS_188_CM_S2 "" TAB_VERB "%6.3" "" COMPU_TAB_REF _CNV_S_7_Enum_EDMRS_188_S2 /end COMPU_METHOD
/begin COMPU_METHOD _CNV_S_7_Enum_EDRDY_217_CM_S2 "" TAB_VERB "%6.3" "" COMPU_TAB_REF _CNV_S_7_Enum_EDRDY_217_S2 /end COMPU_METHOD
/begin COMPU_METHOD _CNV_S_7_Enum_EDRIV_158_CM_S2 "" TAB_VERB "%6.3" "" COMPU_TAB_REF _CNV_S_7_Enum_EDRIV_158_S2 /end COMPU_METHOD
/begin COMPU_METHOD _CNV_S_7_Enum_EGEAR_209_CM_S2 "" TAB_VERB "%6.3" "" COMPU_TAB_REF _CNV_S_7_Enum_EGEAR_209_S2 /end COMPU_METHOD
/begin COMPU_METHOD _CNV_S_7_Enum_ELDMM_65_CM_S2 "" TAB_VERB "%6.3" "" COMPU_TAB_REF _CNV_S_7_Enum_ELDMM_65_S2 /end COMPU_METHOD
/begin COMPU_METHOD _CNV_S_7_Enum_ESDYN_175_CM_S2 "" TAB_VERB "%6.3" "" COMPU_TAB_REF _CNV_S_7_Enum_ESDYN_175_S2 /end COMPU_METHOD
/begin COMPU_METHOD _CNV_S_7_Enum_ESTAR_200_CM_S2 "" TAB_VERB "%6.3" "" COMPU_TAB_REF _CNV_S_7_Enum_ESTAR_200_S2 /end COMPU_METHOD
/begin COMPU_METHOD _CNV_S_8_Enum_EDYND_134_CM_S2 "" TAB_VERB "%6.3" "" COMPU_TAB_REF _CNV_S_8_Enum_EDYND_134_S2 /end COMPU_METHOD
/begin COMPU_METHOD _CNV_S_8_Enum_EHDC_221_CM_S2 "" TAB_VERB "%6.3" "" COMPU_TAB_REF _CNV_S_8_Enum_EHDC_221_S2 /end COMPU_METHOD
/begin COMPU_METHOD _CNV_S_8_Enum_EHSUB_104_CM_S2 "" TAB_VERB "%6.3" "" COMPU_TAB_REF _CNV_S_8_Enum_EHSUB_104_S2 /end COMPU_METHOD
/begin COMPU_METHOD _CNV_S_8_Enum_EMUEL_34_CM_S2 "" TAB_VERB "%6.3" "" COMPU_TAB_REF _CNV_S_8_Enum_EMUEL_34_S2 /end COMPU_METHOD
/begin COMPU_METHOD _CNV_S_8_Enum_EPOS_24_CM_S2 "" TAB_VERB "%6.3" "" COMPU_TAB_REF _CNV_S_8_Enum_EPOS_24_S2 /end COMPU_METHOD
/begin COMPU_METHOD _CNV_S_9_Enum_EFKTE_92_CM_S2 "" TAB_VERB "%6.3" "" COMPU_TAB_REF _CNV_S_9_Enum_EFKTE_92_S2 /end COMPU_METHOD
/begin COMPU_METHOD _CNV_S_9_Enum_EGANG_21_CM_S2 "" TAB_VERB "%6.3" "" COMPU_TAB_REF _CNV_S_9_Enum_EGANG_21_S2 /end COMPU_METHOD
/begin COMPU_METHOD _CNV_S_9_Enum_EMAPD_212_CM_S2 "" TAB_VERB "%6.3" "" COMPU_TAB_REF _CNV_S_9_Enum_EMAPD_212_S2 /end COMPU_METHOD
/begin COMPU_METHOD EH_STANDARD_S4_S3 "int = ((phys * 1) / 1) - (0) -" RAT_FUNC "%1.0" "-" COEFFS 0 1 0 0 0 1 /end COMPU_METHOD
/begin COMPU_METHOD SAB2_C_1CEL_M40_S3_S3 "int = ((phys * 1) / 1) - (-40) Grad Celsius" RAT_FUNC "%1.0" "Grad Celsius" COEFFS 0 1 40 0 0 1 /end COMPU_METHOD
/begin COMPU_METHOD SAB2_C_CGT_1CEL_M40_S3_S3 "int = ((phys * 1) / 1) - (-40) Grad Celsius" RAT_FUNC "%1.0" "Grad Celsius" COEFFS 0 1 40 0 0 1 /end COMPU_METHOD
/begin COMPU_METHOD SAB2_K1000_S3_S3 "int = ((phys * 1000) / 1) - (0) -" RAT_FUNC "%4.3" "-" COEFFS 0 1000 0 0 0 1 /end COMPU_METHOD
/begin COMPU_METHOD SAB2_K100_S3_S3 "int = ((phys * 100) / 1) - (0) -" RAT_FUNC "%4.3" "-" COEFFS 0 100 0 0 0 1 /end COMPU_METHOD
/begin COMPU_METHOD SAB2_K8_S3_S3 "int = ((phys * 8) / 1) - (0) -" RAT_FUNC "%4.3" "-" COEFFS 0 8 0 0 0 1 /end COMPU_METHOD
/begin COMPU_METHOD SAB2_M_1NM_S3_S3 "int = ((phys * 1) / 1) - (0) Nm" RAT_FUNC "%1.0" "Nm" COEFFS 0 1 0 0 0 1 /end COMPU_METHOD
/begin COMPU_METHOD SAB2_M_2NM_S3_S3 "int = ((phys * 1) / 2) - (0) Nm" RAT_FUNC "%4.3" "Nm" COEFFS 0 0.5 0 0 0 1 /end COMPU_METHOD
/begin COMPU_METHOD SAB2_M_NM2_M2047_S3_S3 "int = ((phys * 2) / 1) - (-2047) Nm" RAT_FUNC "%4.3" "Nm" COEFFS 0 2 2047 0 0 1 /end COMPU_METHOD
/begin COMPU_METHOD SAB2_N_10RPM4_S3_S3 "int = ((phys * 4) / 10) - (0) 1/min" RAT_FUNC "%4.3" "1/min" COEFFS 0 0.4 0 0 0 1 /end COMPU_METHOD
/begin COMPU_METHOD SAB2_N_1RPM_S3_S3 "int = ((phys * 1) / 1) - (0) 1/min" RAT_FUNC "%1.0" "1/min" COEFFS 0 1 0 0 0 1 /end COMPU_METHOD
/begin COMPU_METHOD SAB2_N_RPM2_S3_S3 "int = ((phys * 2) / 1) - (0) 1/min" RAT_FUNC "%4.3" "1/min" COEFFS 0 2 0 0 0 1 /end COMPU_METHOD
/begin COMPU_METHOD SAB2_STANDARD_S3_S3 "int = ((phys * 1) / 1) - (0) -" RAT_FUNC "%1.0" "-" COEFFS 0 1 0 0 0 1 /end COMPU_METHOD
/begin COMPU_METHOD SAB2_T_TIMER_10MS_S3_S3 "int = ((phys * 1) / 10) - (0) ms" RAT_FUNC "%4.3" "ms" COEFFS 0 0.1 0 0 0 1 /end COMPU_METHOD
/begin COMPU_METHOD SAB2_V_1KMH_S3_S3 "int = ((phys * 1) / 1) - (0) km/h" RAT_FUNC "%1.0" "km/h" COEFFS 0 1 0 0 0 1 /end COMPU_METHOD
/begin COMPU_METHOD SBW_STANDARD_S1_S3 "int = ((phys * 1) / 1) - (0) -" RAT_FUNC "%1.0" "-" COEFFS 0 1 0 0 0 1 /end COMPU_METHOD
/begin COMPU_METHOD UMR___1_1_0_S5_S3 "int = ((phys * 1) / 1) - (0) [-]" RAT_FUNC "%1.0" "[-]" COEFFS 0 1 0 0 0 1 /end COMPU_METHOD
/begin COMPU_METHOD UMR_J_MM2_1_100_0_S5_S3 "int = ((phys * 100) / 1) - (0) [J/(mm^2)]" RAT_FUNC "%3.2" "[J/(mm^2)]" COEFFS 0 100 0 0 0 1 /end COMPU_METHOD
/begin COMPU_METHOD UMR_J_MM2_1_1_0_S5_S3 "int = ((phys * 1) / 1) - (0) [J/(mm^2)]" RAT_FUNC "%1.0" "[J/(mm^2)]" COEFFS 0 1 0 0 0 1 /end COMPU_METHOD
/begin COMPU_METHOD UMR_K_NM_1_1_0_S5_S3 "int = ((phys * 1) / 1) - (0) [K/Nm]" RAT_FUNC "%1.0" "[K/Nm]" COEFFS 0 1 0 0 0 1 /end COMPU_METHOD
/begin COMPU_METHOD UMR_KG__1_1_0_S5_S3 "int = ((phys * 1) / 1) - (0) [kg]" RAT_FUNC "%1.0" "[kg]" COEFFS 0 1 0 0 0 1 /end COMPU_METHOD
/begin COMPU_METHOD UMR_KGM2__1_10000_0_S5_S3 "int = ((phys * 10000) / 1) - (0) [kg*m^2]" RAT_FUNC "%5.4" "[kg*m^2]" COEFFS 0 10000 0 0 0 1 /end COMPU_METHOD
/begin COMPU_METHOD UMR_KM__10_1_0_S5_S3 "int = ((phys * 1) / 10) - (0) [Km]" RAT_FUNC "%1.0" "[Km]" COEFFS 0 0.1 0 0 0 1 /end COMPU_METHOD
/begin COMPU_METHOD UMR_KM_H_1_10_0_S5_S3 "int = ((phys * 10) / 1) - (0) [km/h]" RAT_FUNC "%2.1" "[km/h]" COEFFS 0 10 0 0 0 1 /end COMPU_METHOD
/begin COMPU_METHOD UMR_LITER__1_10000_0_S5_S3 "int = ((phys * 10000) / 1) - (0) [Liter]" RAT_FUNC "%5.4" "[Liter]" COEFFS 0 10000 0 0 0 1 /end COMPU_METHOD
/begin COMPU_METHOD UMR_LITER_MIN_1_100_0_S5_S3 "int = ((phys * 100) / 1) - (0) [Liter/min]" RAT_FUNC "%3.2" "[Liter/min]" COEFFS 0 100 0 0 0 1 /end COMPU_METHOD
/begin COMPU_METHOD UMR_LITER_MIN_1_1_0_2_S5_S3 "int = ((phys * 1) / 1) - (0) [Liter/min]" RAT_FUNC "%1.0" "[Liter/min]" COEFFS 0 1 0 0 0 1 /end COMPU_METHOD
/begin COMPU_METHOD UMR_LITER_MIN_1_1_0_4_S5_S3 "int = ((phys * 1) / 1) - (0) [Liter/min]" RAT_FUNC "%1.0" "[Liter/min]" COEFFS 0 1 0 0 0 1 /end COMPU_METHOD
/begin COMPU_METHOD UMR_LITER_MIN_1_32_0_S5_S3 "int = ((phys * 32) / 1) - (0) [Liter/min]" RAT_FUNC "%5.4" "[Liter/min]" COEFFS 0 32 0 0 0 1 /end COMPU_METHOD
/begin COMPU_METHOD UMR_LITER_SEC_1_1_0_S5_S3 "int = ((phys * 1) / 1) - (0) [Liter/s]" RAT_FUNC "%1.0" "[Liter/s]" COEFFS 0 1 0 0 0 1 /end COMPU_METHOD
/begin COMPU_METHOD UMR_M__1_100_0_S5_S3 "int = ((phys * 100) / 1) - (0) [m]" RAT_FUNC "%3.2" "[m]" COEFFS 0 100 0 0 0 1 /end COMPU_METHOD
/begin COMPU_METHOD UMR_MA__1_100_0_S5_S3 "int = ((phys * 100) / 1) - (0) [mA]" RAT_FUNC "%3.2" "[mA]" COEFFS 0 100 0 0 0 1 /end COMPU_METHOD
/begin COMPU_METHOD UMR_MA__1_1_M128_S5_S3 "int = ((phys * 1) / 1) - (-128) [mA]" RAT_FUNC "%1.0" "[mA]" COEFFS 0 1 128 0 0 1 /end COMPU_METHOD
/begin COMPU_METHOD UMR_MBAR__100_1_0_S5_S3 "int = ((phys * 1) / 100) - (0) [mbar]" RAT_FUNC "%1.0" "[mbar]" COEFFS 0 0.01 0 0 0 1 /end COMPU_METHOD
/begin COMPU_METHOD UMR_MBAR_NM_1_100_0_S5_S3 "int = ((phys * 100) / 1) - (0) [mbar/Nm]" RAT_FUNC "%3.2" "[mbar/Nm]" COEFFS 0 100 0 0 0 1 /end COMPU_METHOD
/begin COMPU_METHOD UMR_MM2__1_1_0_S5_S3 "int = ((phys * 1) / 1) - (0) [mm^2]" RAT_FUNC "%1.0" "[mm^2]" COEFFS 0 1 0 0 0 1 /end COMPU_METHOD
/begin COMPU_METHOD UMR_MSEC_10MS_10_1_0_S5_S3 "int = ((phys * 1) / 10) - (0) [ms/10ms]" RAT_FUNC "%1.0" "[ms/10ms]" COEFFS 0 0.1 0 0 0 1 /end COMPU_METHOD
/begin COMPU_METHOD UMR_MSEC__100_1_0_S5_S3 "int = ((phys * 1) / 100) - (0) [ms]" RAT_FUNC "%1.0" "[ms]" COEFFS 0 0.01 0 0 0 1 /end COMPU_METHOD
/begin COMPU_METHOD UMR_MSEC__1_10_0_S5_S3 "int = ((phys * 10) / 1) - (0) [ms]" RAT_FUNC "%2.1" "[ms]" COEFFS 0 10 0 0 0 1 /end COMPU_METHOD
/begin COMPU_METHOD UMR_MSEC__20_1_0_S5_S3 "int = ((phys * 1) / 20) - (0) [ms]" RAT_FUNC "%1.0" "[ms]" COEFFS 0 0.05 0 0 0 1 /end COMPU_METHOD
/begin COMPU_METHOD UMR_MSEC__2_1_0_S5_S3 "int = ((phys * 1) / 2) - (0) [ms]" RAT_FUNC "%1.0" "[ms]" COEFFS 0 0.5 0 0 0 1 /end COMPU_METHOD
/begin COMPU_METHOD UMR_MSEC__50_1_0_S5_S3 "int = ((phys * 1) / 50) - (0) [ms]" RAT_FUNC "%1.0" "[ms]" COEFFS 0 0.02 0 0 0 1 /end COMPU_METHOD
/begin COMPU_METHOD UMR_NM__10_1_0_S5_S3 "int = ((phys * 1) / 10) - (0) [Nm]" RAT_FUNC "%1.0" "[Nm]" COEFFS 0 0.1 0 0 0 1 /end COMPU_METHOD
/begin COMPU_METHOD UMR_NM__1_10000_0_S5_S3 "int = ((phys * 10000) / 1) - (0) [Nm]" RAT_FUNC "%5.4" "[Nm]" COEFFS 0 10000 0 0 0 1 /end COMPU_METHOD
/begin COMPU_METHOD UMR_NM__1_1_0_1_S5_S3 "int = ((phys * 1) / 1) - (0) [Nm]" RAT_FUNC "%1.0" "[Nm]" COEFFS 0 1 0 0 0 1 /end COMPU_METHOD
/begin COMPU_METHOD UMR_NM__8_1_0_S5_S3 "int = ((phys * 1) / 8) - (0) [Nm]" RAT_FUNC "%1.0" "[Nm]" COEFFS 0 0.125 0 0 0 1 /end COMPU_METHOD
/begin COMPU_METHOD UMR_NM__8_1_M128_S5_S3 "int = ((phys * 1) / 8) - (-128) [Nm]" RAT_FUNC "%1.0" "[Nm]" COEFFS 0 0.125 128 0 0 1 /end COMPU_METHOD
/begin COMPU_METHOD UMR_NM__8_1_M34_S5_S3 "int = ((phys * 1) / 8) - (-34) [Nm]" RAT_FUNC "%1.0" "[Nm]" COEFFS 0 0.125 34 0 0 1 /end COMPU_METHOD
/begin COMPU_METHOD UMR_NM__8_1_M50_S5_S3 "int = ((phys * 1) / 8) - (-50) [Nm]" RAT_FUNC "%1.0" "[Nm]" COEFFS 0 0.125 50 0 0 1 /end COMPU_METHOD
/begin COMPU_METHOD UMR_NM_BAR_1_10_0_S5_S3 "int = ((phys * 10) / 1) - (0) [Nm/bar]" RAT_FUNC "%2.1" "[Nm/bar]" COEFFS 0 10 0 0 0 1 /end COMPU_METHOD
/begin COMPU_METHOD UMR_NM_DC_1_100_0_S5_S3 "int = ((phys * 100) / 1) - (0) [Nm/DC]" RAT_FUNC "%3.2" "[Nm/DC]" COEFFS 0 100 0 0 0 1 /end COMPU_METHOD
/begin COMPU_METHOD UMR_NM_LITERK_1_1_0_S5_S3 "int = ((phys * 1) / 1) - (0) [Nm/(Liter*K)]" RAT_FUNC "%1.0" "[Nm/(Liter*K)]" COEFFS 0 1 0 0 0 1 /end COMPU_METHOD
/begin COMPU_METHOD UMR_NM_SEC2_1_1_0_S5_S3 "int = ((phys * 1) / 1) - (0) [Nm/s^2]" RAT_FUNC "%1.0" "[Nm/s^2]" COEFFS 0 1 0 0 0 1 /end COMPU_METHOD
/begin COMPU_METHOD UMR_NM_SEC_1_10_0_S5_S3 "int = ((phys * 10) / 1) - (0) [Nm/s]" RAT_FUNC "%2.1" "[Nm/s]" COEFFS 0 10 0 0 0 1 /end COMPU_METHOD
/begin COMPU_METHOD UMR_NM_SECK_1_1_0_4_S5_S3 "int = ((phys * 1) / 1) - (0) [Nm/(s*K)]" RAT_FUNC "%1.0" "[Nm/(s*K)]" COEFFS 0 1 0 0 0 1 /end COMPU_METHOD
/begin COMPU_METHOD UMR_NM_SECK_1_1_0_S5_S3 "int = ((phys * 1) / 1) - (0) [Nm/(s*K)]" RAT_FUNC "%1.0" "[Nm/(s*K)]" COEFFS 0 1 0 0 0 1 /end COMPU_METHOD
/begin COMPU_METHOD UMR_NMMINSEC_10MSEC_1_1_0_S5_S3 "int = ((phys * 1) / 1) - (0) [0,000025Nm/(10ms/(min*s))]" RAT_FUNC "%1.0" "[0,000025Nm/(10ms/(min*s))]" COEFFS 0 1 0 0 0 1 /end COMPU_METHOD
/begin MEASUREMENT ZFFSAB2._.EngineInterventionOut.EngineInterventionOut_Fl.f_m_EngInterventionNegErr "error message for positive moment intervention - for negative engine torque" FLOAT32_IEEE SAB2_STANDARD_S3_S3 1 100 0 255 ECU_ADDRESS 0xFFF961F0 FORMAT "%4.3" DISPLAY_IDENTIFIER f_m_EngInterventionNegErr.EngineInterventionOut_Fl.EngineInterventionOut._.ZFFSAB2 /end MEASUREMENT
/begin MEASUREMENT ZFFSAB2._.EngineInterventionOut.EngineInterventionOut_Fl.f_m_EngInterventionNegErr_ "complemented error message for positive moment intervention - for negative engine torque" FLOAT32_IEEE SAB2_STANDARD_S3_S3 1 100 0 255 ECU_ADDRESS 0xFFF961F4 FORMAT "%4.3" DISPLAY_IDENTIFIER f_m_EngInterventionNegErr_.EngineInterventionOut_Fl.EngineInterventionOut._.ZFFSAB2 /end MEASUREMENT
/begin MEASUREMENT ZFFSAB2._.EngineInterventionOut.EngineInterventionOut_Fl.iv_f_m_EngInterventionNegErr "Error message for negative moment intervention" FLOAT32_IEEE SAB2_STANDARD_S3_S3 1 100 0 1 ECU_ADDRESS 0xFFF961E8 FORMAT "%4.3" DISPLAY_IDENTIFIER iv_f_m_EngInterventionNegErr.EngineInterventionOut_Fl.EngineInterventionOut._.ZFFSAB2 /end MEASUREMENT
/begin MEASUREMENT ZFFSAB2._.EngineInterventionOut.EngineInterventionOut_Fl.iv_f_m_EngInterventionNegErr_ "Complemented error message for positive moment intervention" FLOAT32_IEEE SAB2_STANDARD_S3_S3 1 100 0 255 ECU_ADDRESS 0xFFF961EC FORMAT "%4.3" DISPLAY_IDENTIFIER iv_f_m_EngInterventionNegErr_.EngineInterventionOut_Fl.EngineInterventionOut._.ZFFSAB2 /end MEASUREMENT
/begin MEASUREMENT ZFFSAB2._.EngineInterventionOut.f_m_EI_Lev2Err "Error flag of a SAB2-internal inconsitency during the intervention calculation" UBYTE SAB2_STANDARD_S3_S3 1 100 0 1 ECU_ADDRESS 0xFFF96243 DISPLAY_IDENTIFIER f_m_EI_Lev2Err.EngineInterventionOut._.ZFFSAB2 /end MEASUREMENT
/begin MEASUREMENT ZFFSAB2._.EngineInterventionOut.f_m_EI_Lev2Err_ "Error flag complement of a SAB2-internal inconsitency during the intervention calculation" UBYTE SAB2_STANDARD_S3_S3 1 100 0 255 ECU_ADDRESS 0xFFF96244 DISPLAY_IDENTIFIER f_m_EI_Lev2Err_.EngineInterventionOut._.ZFFSAB2 /end MEASUREMENT
/begin MEASUREMENT ZFFSAB2._.EngineInterventionOut.f_m_EngInterventionNegErr "error message for positive moment intervention - for negative engine torque" UBYTE SAB2_STANDARD_S3_S3 1 100 0 255 ECU_ADDRESS 0xFFF96249 DISPLAY_IDENTIFIER f_m_EngInterventionNegErr.EngineInterventionOut._.ZFFSAB2 /end MEASUREMENT
/begin MEASUREMENT ZFFSAB2._.EngineInterventionOut.f_m_EngInterventionNegErr_ "complemented error message for positive moment intervention - for negative engine torque" UBYTE SAB2_STANDARD_S3_S3 1 100 0 255 ECU_ADDRESS 0xFFF9624A DISPLAY_IDENTIFIER f_m_EngInterventionNegErr_.EngineInterventionOut._.ZFFSAB2 /end MEASUREMENT
/begin MEASUREMENT ZFFSAB2._.EngineInterventionOut.f_m_EngInterventionPosErr "error message for positive moment intervention" UBYTE SAB2_STANDARD_S3_S3 1 100 0 255 ECU_ADDRESS 0xFFF96245 DISPLAY_IDENTIFIER f_m_EngInterventionPosErr.EngineInterventionOut._.ZFFSAB2 /end MEASUREMENT
/begin MEASUREMENT ZFFSAB2._.EngineInterventionOut.f_m_EngInterventionPosErr_ "complemented error message for positive moment intervention" UBYTE SAB2_STANDARD_S3_S3 1 100 0 255 ECU_ADDRESS 0xFFF96246 DISPLAY_IDENTIFIER f_m_EngInterventionPosErr_.EngineInterventionOut._.ZFFSAB2 /end MEASUREMENT
/begin MEASUREMENT ZFFSAB2._.EngineInterventionOut.f_m_NegEI_Lev2Err "Error flag of a SAB2-internal inconsitency during the intervention calculation - for negative engine torque" UBYTE SAB2_STANDARD_S3_S3 1 100 0 1 ECU_ADDRESS 0xFFF96247 DISPLAY_IDENTIFIER f_m_NegEI_Lev2Err.EngineInterventionOut._.ZFFSAB2 /end MEASUREMENT
/begin MEASUREMENT ZFFSAB2._.EngineInterventionOut.f_m_NegEI_Lev2Err_ "Error flag complement of a SAB2-internal inconsitency during the intervention calculation - for negative engine torque" UBYTE SAB2_STANDARD_S3_S3 1 100 0 255 ECU_ADDRESS 0xFFF96248 DISPLAY_IDENTIFIER f_m_NegEI_Lev2Err_.EngineInterventionOut._.ZFFSAB2 /end MEASUREMENT
/begin MEASUREMENT ZFFSAB2._.EngineInterventionOut.iv_f_m_EngInterventionNegErr "Error message for negative moment intervention" UBYTE SAB2_STANDARD_S3_S3 1 100 0 1 ECU_ADDRESS 0xFFF96206 DISPLAY_IDENTIFIER iv_f_m_EngInterventionNegErr.EngineInterventionOut._.ZFFSAB2 /end MEASUREMENT
/begin MEASUREMENT ZFFSAB2._.EngineInterventionOut.iv_f_m_EngInterventionNegErr_ "Complemented error message for positive moment intervention" UBYTE SAB2_STANDARD_S3_S3 1 100 0 255 ECU_ADDRESS 0xFFF96207 DISPLAY_IDENTIFIER iv_f_m_EngInterventionNegErr_.EngineInterventionOut._.ZFFSAB2 /end MEASUREMENT
/begin MEASUREMENT ZFFSAB2._.EngineInterventionOut.iv_f_m_EngInterventionPosErr "error message for positive moment intervention" UBYTE SAB2_STANDARD_S3_S3 1 100 0 1 ECU_ADDRESS 0xFFF96204 DISPLAY_IDENTIFIER iv_f_m_EngInterventionPosErr.EngineInterventionOut._.ZFFSAB2 /end MEASUREMENT
/begin MEASUREMENT ZFFSAB2._.EngineInterventionOut.iv_f_m_EngInterventionPosErr_ "complemented error message for positive moment intervention" UBYTE SAB2_STANDARD_S3_S3 1 100 0 255 ECU_ADDRESS 0xFFF96205 DISPLAY_IDENTIFIER iv_f_m_EngInterventionPosErr_.EngineInterventionOut._.ZFFSAB2 /end MEASUREMENT
/begin MEASUREMENT ZFFSAB2._.EngineInterventionOut.iv_m_CrankSts "Input value signal status of current torque of crankshaft" UBYTE SAB2_STANDARD_S3_S3 1 100 0 2 ECU_ADDRESS 0xFFF96224 DISPLAY_IDENTIFIER iv_m_CrankSts.EngineInterventionOut._.ZFFSAB2 /end MEASUREMENT
/begin MEASUREMENT ZFFSAB2._.EngineInterventionOut.iv_m_Eng "Input value of engine torque" SWORD SAB2_M_1NM_S3_S3 1 100 -2048 2047 ECU_ADDRESS 0xFFF96208 DISPLAY_IDENTIFIER iv_m_Eng.EngineInterventionOut._.ZFFSAB2 /end MEASUREMENT
/begin MEASUREMENT ZFFSAB2._.EngineInterventionOut.iv_m_EngDesAdjustRange "Input value iv_m_EngDesAdjustRange" SWORD SAB2_M_1NM_S3_S3 1 100 -32768 32767 ECU_ADDRESS 0xFFF96214 DISPLAY_IDENTIFIER iv_m_EngDesAdjustRange.EngineInterventionOut._.ZFFSAB2 /end MEASUREMENT
/begin MEASUREMENT ZFFSAB2._.EngineInterventionOut.iv_m_EngIntervention "Input value for torque limitation" SWORD SAB2_M_1NM_S3_S3 1 100 -32768 32767 ECU_ADDRESS 0xFFF9620A DISPLAY_IDENTIFIER iv_m_EngIntervention.EngineInterventionOut._.ZFFSAB2 /end MEASUREMENT
/begin MEASUREMENT ZFFSAB2._.EngineInterventionOut.iv_m_EngInterventionLimit "Input value iv_m_EngInterventionLimit" SWORD SAB2_M_1NM_S3_S3 1 100 -32768 32767 ECU_ADDRESS 0xFFF96218 DISPLAY_IDENTIFIER iv_m_EngInterventionLimit.EngineInterventionOut._.ZFFSAB2 /end MEASUREMENT
/begin MEASUREMENT ZFFSAB2._.EngineInterventionOut.iv_m_EngInterventionPred "Input value for predictive pos torque intervention from ATSYS" SWORD SAB2_M_1NM_S3_S3 1 100 -32768 32767 ECU_ADDRESS 0xFFF96200 DISPLAY_IDENTIFIER iv_m_EngInterventionPred.EngineInterventionOut._.ZFFSAB2 /end MEASUREMENT
/begin MEASUREMENT ZFFSAB2._.EngineInterventionOut.iv_m_EngInterventionPredSts "Input value for predictive pos torque intervention status from ATSYS" UBYTE SAB2_STANDARD_S3_S3 1 100 0 1 ECU_ADDRESS 0xFFF96202 DISPLAY_IDENTIFIER iv_m_EngInterventionPredSts.EngineInterventionOut._.ZFFSAB2 /end MEASUREMENT
/begin MEASUREMENT ZFFSAB2._.EngineInterventionOut.iv_m_EngInterventionSts "Input value for engine intervention type from ATSYS" UBYTE SAB2_STANDARD_S3_S3 1 100 0 255 ECU_ADDRESS 0xFFF96203 DISPLAY_IDENTIFIER iv_m_EngInterventionSts.EngineInterventionOut._.ZFFSAB2 /end MEASUREMENT
/begin MEASUREMENT ZFFSAB2._.EngineInterventionOut.iv_m_EngInterventionSts_ "complemented input status value for pos torque intervention from HPSYS" UBYTE SAB2_STANDARD_S3_S3 1 100 0 255 ECU_ADDRESS 0xFFF9620E DISPLAY_IDENTIFIER iv_m_EngInterventionSts_.EngineInterventionOut._.ZFFSAB2 /end MEASUREMENT
/begin MEASUREMENT ZFFSAB2._.EngineInterventionOut.iv_m_EngIntervention_ "complemented input value for torque limitation" SWORD SAB2_M_1NM_S3_S3 1 100 0 32767 ECU_ADDRESS 0xFFF9620C DISPLAY_IDENTIFIER iv_m_EngIntervention_.EngineInterventionOut._.ZFFSAB2 /end MEASUREMENT
/begin MEASUREMENT ZFFSAB2._.EngineInterventionOut.iv_m_EngMax "Input value for max. allowed engine torque by HPSYS" SWORD SAB2_M_1NM_S3_S3 1 100 -32768 32767 ECU_ADDRESS 0xFFF96210 DISPLAY_IDENTIFIER iv_m_EngMax.EngineInterventionOut._.ZFFSAB2 /end MEASUREMENT
/begin MEASUREMENT ZFFSAB2._.EngineInterventionOut.iv_m_EngMaxHAS "Input value for max. allowed HAS engine torque by HPSYS" SWORD SAB2_M_1NM_S3_S3 1 100 -32768 32767 ECU_ADDRESS 0xFFF9621A DISPLAY_IDENTIFIER iv_m_EngMaxHAS.EngineInterventionOut._.ZFFSAB2 /end MEASUREMENT
/begin MEASUREMENT ZFFSAB2._.EngineInterventionOut.iv_m_EngMaxHAS_ "Input value for max. allowed HAS engine torque by HPSYS" SWORD SAB2_STANDARD_S3_S3 1 100 -32768 32767 ECU_ADDRESS 0xFFF9621C DISPLAY_IDENTIFIER iv_m_EngMaxHAS_.EngineInterventionOut._.ZFFSAB2 /end MEASUREMENT
/begin MEASUREMENT ZFFSAB2._.EngineInterventionOut.iv_m_EngMax_ "Complement of input value for max. allowed engine torque by HPSYS" SWORD SAB2_STANDARD_S3_S3 1 100 -32768 32767 ECU_ADDRESS 0xFFF96212 DISPLAY_IDENTIFIER iv_m_EngMax_.EngineInterventionOut._.ZFFSAB2 /end MEASUREMENT
/begin MEASUREMENT ZFFSAB2._.EngineInterventionOut.iv_m_EngRedSts "input status value for iv_m_EngRedSts" UBYTE SAB2_STANDARD_S3_S3 1 100 0 3 ECU_ADDRESS 0xFFF96216 DISPLAY_IDENTIFIER iv_m_EngRedSts.EngineInterventionOut._.ZFFSAB2 /end MEASUREMENT
/begin MEASUREMENT ZFFSAB2._.EngineInterventionOut.iv_m_PumpCensored "Pump intake torque of class PumpIntakeTorqueIn" SWORD SAB2_M_1NM_S3_S3 1 100 0 30 ECU_ADDRESS 0xFFF96236 DISPLAY_IDENTIFIER iv_m_PumpCensored.EngineInterventionOut._.ZFFSAB2 /end MEASUREMENT
/begin MEASUREMENT ZFFSAB2._.EngineInterventionOut.iv_n_EngLev2 "Level 2 output value engine rpm" UWORD SAB2_N_1RPM_S3_S3 1 100 0 65535 ECU_ADDRESS 0xFFF9621E DISPLAY_IDENTIFIER iv_n_EngLev2.EngineInterventionOut._.ZFFSAB2 /end MEASUREMENT
/begin MEASUREMENT ZFFSAB2._.EngineInterventionOut.iv_n_EngLev2Sts "Level 2 output value signal status of engine rpm" UBYTE SAB2_STANDARD_S3_S3 1 100 0 2 ECU_ADDRESS 0xFFF96222 DISPLAY_IDENTIFIER iv_n_EngLev2Sts.EngineInterventionOut._.ZFFSAB2 /end MEASUREMENT
/begin MEASUREMENT ZFFSAB2._.EngineInterventionOut.iv_n_EngLev2Sts_ "Level 2 output value signal status complement of engine rpm" UBYTE SAB2_STANDARD_S3_S3 1 100 0 255 ECU_ADDRESS 0xFFF96223 DISPLAY_IDENTIFIER iv_n_EngLev2Sts_.EngineInterventionOut._.ZFFSAB2 /end MEASUREMENT
/begin MEASUREMENT ZFFSAB2._.EngineInterventionOut.iv_n_EngLev2_ "Level 2 output value engine rpm complement" UWORD SAB2_STANDARD_S3_S3 1 100 0 65535 ECU_ADDRESS 0xFFF96220 DISPLAY_IDENTIFIER iv_n_EngLev2_.EngineInterventionOut._.ZFFSAB2 /end MEASUREMENT
/begin MEASUREMENT ZFFSAB2._.EngineInterventionOut.iv_n_TuLev2Sts "Input value signal status level2 of turbine speed" UBYTE SAB2_STANDARD_S3_S3 1 100 0 2 ECU_ADDRESS 0xFFF96225 DISPLAY_IDENTIFIER iv_n_TuLev2Sts.EngineInterventionOut._.ZFFSAB2 /end MEASUREMENT
/begin MEASUREMENT ZFFSAB2._.EngineInterventionOut.iv_n_TuLev2Sts_ "Input value signal status complement level2 of turbine speed" UBYTE SAB2_STANDARD_S3_S3 1 100 0 255 ECU_ADDRESS 0xFFF96226 DISPLAY_IDENTIFIER iv_n_TuLev2Sts_.EngineInterventionOut._.ZFFSAB2 /end MEASUREMENT
/begin MEASUREMENT ZFFSAB2._.EngineInterventionOut.m_EngDesAdjustRangeCrankshaft "Input value sv_m_EngDesAdjustRange corrected by pump intake torque" SWORD SAB2_M_1NM_S3_S3 1 100 -32768 32767 ECU_ADDRESS 0xFFF96240 DISPLAY_IDENTIFIER m_EngDesAdjustRangeCrankshaft.EngineInterventionOut._.ZFFSAB2 /end MEASUREMENT
/begin MEASUREMENT ZFFSAB2._.EngineInterventionOut.m_EngInterventionCrankshaft "Input value engine torque corrected by pump intake torque" SWORD SAB2_M_1NM_S3_S3 1 100 0 4095 ECU_ADDRESS 0xFFF96238 DISPLAY_IDENTIFIER m_EngInterventionCrankshaft.EngineInterventionOut._.ZFFSAB2 /end MEASUREMENT
/begin MEASUREMENT ZFFSAB2._.EngineInterventionOut.m_EngInterventionPredCrankshaft "Input value predicted engine torque corrected by pump intake torque" SWORD SAB2_M_1NM_S3_S3 1 100 0 4095 ECU_ADDRESS 0xFFF9623E DISPLAY_IDENTIFIER m_EngInterventionPredCrankshaft.EngineInterventionOut._.ZFFSAB2 /end MEASUREMENT
/begin MEASUREMENT ZFFSAB2._.EngineInterventionOut.m_EngMax "Intermediate value of the max. allowed engine torque" SWORD SAB2_M_1NM_S3_S3 1 100 -32768 32767 ECU_ADDRESS 0xFFF9623A DISPLAY_IDENTIFIER m_EngMax.EngineInterventionOut._.ZFFSAB2 /end MEASUREMENT
/begin MEASUREMENT ZFFSAB2._.EngineInterventionOut.m_EngMaxCensored "Intermediate value of the max. allowed engine torque limited from below by D_m_EngMaxLTh." SWORD SAB2_M_1NM_S3_S3 1 100 -32768 32767 ECU_ADDRESS 0xFFF9623C DISPLAY_IDENTIFIER m_EngMaxCensored.EngineInterventionOut._.ZFFSAB2 /end MEASUREMENT
/begin MEASUREMENT ZFFSAB2._.EngineInterventionOut.sv_f_NoNegEIActive "Output signal - SAB2_GetNoNegTrqReqActive() is active or not" UBYTE SAB2_STANDARD_S3_S3 1 100 0 1 ECU_ADDRESS 0xFFF96233 DISPLAY_IDENTIFIER sv_f_NoNegEIActive.EngineInterventionOut._.ZFFSAB2 /end MEASUREMENT
/begin MEASUREMENT ZFFSAB2._.EngineInterventionOut.sv_f_NoNegEIActive_ "Complement of signal sv_f_NoNegEIActive" UBYTE SAB2_STANDARD_S3_S3 1 100 0 255 ECU_ADDRESS 0xFFF96234 DISPLAY_IDENTIFIER sv_f_NoNegEIActive_.EngineInterventionOut._.ZFFSAB2 /end MEASUREMENT
/begin MEASUREMENT ZFFSAB2._.EngineInterventionOut.sv_f_NoPosEIActive "Output signal - (TYPE_UI8) 23) is active or not" UBYTE SAB2_STANDARD_S3_S3 1 100 0 1 ECU_ADDRESS 0xFFF96232 DISPLAY_IDENTIFIER sv_f_NoPosEIActive.EngineInterventionOut._.ZFFSAB2 /end MEASUREMENT
/begin MEASUREMENT ZFFSAB2._.EngineInterventionOut.sv_m_EngDesAdjustRange "Output value for pos desired range of EGS" UWORD SAB2_M_NM2_M2047_S3_S3 1 100 -1023.5 1024 ECU_ADDRESS 0xFFF96228 DISPLAY_IDENTIFIER sv_m_EngDesAdjustRange.EngineInterventionOut._.ZFFSAB2 /end MEASUREMENT
/begin MEASUREMENT ZFFSAB2._.EngineInterventionOut.sv_m_EngRed "Output value for desired engine torque" UWORD SAB2_M_NM2_M2047_S3_S3 1 100 -1023.5 1024 ECU_ADDRESS 0xFFF9622A DISPLAY_IDENTIFIER sv_m_EngRed.EngineInterventionOut._.ZFFSAB2 /end MEASUREMENT
/begin MEASUREMENT ZFFSAB2._.EngineInterventionOut.sv_m_EngRedSts "Output value for signal status of desired engine torque" UBYTE SAB2_STANDARD_S3_S3 1 100 0 15 ECU_ADDRESS 0xFFF9622E DISPLAY_IDENTIFIER sv_m_EngRedSts.EngineInterventionOut._.ZFFSAB2 /end MEASUREMENT
/begin MEASUREMENT ZFFSAB2._.EngineInterventionOut.sv_m_EngRedSts_ "Output value complement for signal status of desired engine torque" UBYTE SAB2_STANDARD_S3_S3 1 100 0 255 ECU_ADDRESS 0xFFF9622F DISPLAY_IDENTIFIER sv_m_EngRedSts_.EngineInterventionOut._.ZFFSAB2 /end MEASUREMENT
/begin MEASUREMENT ZFFSAB2._.EngineInterventionOut.sv_m_EngRed_ "Output value complement for desired engine torque" UWORD SAB2_STANDARD_S3_S3 1 100 0 65535 ECU_ADDRESS 0xFFF9622C DISPLAY_IDENTIFIER sv_m_EngRed_.EngineInterventionOut._.ZFFSAB2 /end MEASUREMENT
/begin MEASUREMENT ZFFSAB2._.EngineInterventionOut.sv_m_Lim "Output value for torque reducement" UWORD SAB2_M_NM2_M2047_S3_S3 1 100 -1023.5 31744 ECU_ADDRESS 0xFFF96230 DISPLAY_IDENTIFIER sv_m_Lim.EngineInterventionOut._.ZFFSAB2 /end MEASUREMENT
/begin MEASUREMENT ZFFSAB2._.ErrorEntryOut.ErrorEntryOut_Fl.f_DiagnosticFunctErr "Error flag of diagnostic function" FLOAT32_IEEE SAB2_STANDARD_S3_S3 1 100 0 1 ECU_ADDRESS 0xFFF96250 FORMAT "%4.3" DISPLAY_IDENTIFIER f_DiagnosticFunctErr.ErrorEntryOut_Fl.ErrorEntryOut._.ZFFSAB2 /end MEASUREMENT
/begin MEASUREMENT ZFFSAB2._.ErrorEntryOut.ErrorEntryOut_Fl.f_DiagnosticFunctErr_ "Complement to error flag of diagnostic function" FLOAT32_IEEE SAB2_STANDARD_S3_S3 1 100 0 255 ECU_ADDRESS 0xFFF96254 FORMAT "%4.3" DISPLAY_IDENTIFIER f_DiagnosticFunctErr_.ErrorEntryOut_Fl.ErrorEntryOut._.ZFFSAB2 /end MEASUREMENT
/begin MEASUREMENT ZFFSAB2._.ErrorEntryOut.ErrorEntryOut_Fl.iv_FET0_Active "Input value for state of FET0" FLOAT32_IEEE SAB2_STANDARD_S3_S3 1 100 0 255 ECU_ADDRESS 0xFFF96268 FORMAT "%4.3" DISPLAY_IDENTIFIER iv_FET0_Active.ErrorEntryOut_Fl.ErrorEntryOut._.ZFFSAB2 /end MEASUREMENT
/begin MEASUREMENT ZFFSAB2._.ErrorEntryOut.ErrorEntryOut_Fl.iv_FET0_Active_ "Complement to iv_FET0_Active" FLOAT32_IEEE SAB2_STANDARD_S3_S3 1 100 0 255 ECU_ADDRESS 0xFFF9626C FORMAT "%4.3" DISPLAY_IDENTIFIER iv_FET0_Active_.ErrorEntryOut_Fl.ErrorEntryOut._.ZFFSAB2 /end MEASUREMENT
/begin MEASUREMENT ZFFSAB2._.ErrorEntryOut.ErrorEntryOut_Fl.iv_v_Fzg "Input signal of vehicle speed" FLOAT32_IEEE SAB2_V_1KMH_S3_S3 1 100 0 65535 ECU_ADDRESS 0xFFF96260 FORMAT "%4.3" DISPLAY_IDENTIFIER iv_v_Fzg.ErrorEntryOut_Fl.ErrorEntryOut._.ZFFSAB2 /end MEASUREMENT
/begin MEASUREMENT ZFFSAB2._.ErrorEntryOut.ErrorEntryOut_Fl.iv_v_FzgSts "Input status signal of input signal vehicle speed" FLOAT32_IEEE SAB2_STANDARD_S3_S3 1 100 0 2 ECU_ADDRESS 0xFFF96258 FORMAT "%4.3" DISPLAY_IDENTIFIER iv_v_FzgSts.ErrorEntryOut_Fl.ErrorEntryOut._.ZFFSAB2 /end MEASUREMENT
/begin MEASUREMENT ZFFSAB2._.ErrorEntryOut.ErrorEntryOut_Fl.iv_v_FzgSts_ "Complement to iv_v_FzgSts" FLOAT32_IEEE SAB2_STANDARD_S3_S3 1 100 0 255 ECU_ADDRESS 0xFFF9625C FORMAT "%4.3" DISPLAY_IDENTIFIER iv_v_FzgSts_.ErrorEntryOut_Fl.ErrorEntryOut._.ZFFSAB2 /end MEASUREMENT
/begin MEASUREMENT ZFFSAB2._.ErrorEntryOut.ErrorEntryOut_Fl.iv_v_Fzg_ "Complement to iv_v_Fzg" FLOAT32_IEEE SAB2_STANDARD_S3_S3 1 100 0 65535 ECU_ADDRESS 0xFFF96264 FORMAT "%4.3" DISPLAY_IDENTIFIER iv_v_Fzg_.ErrorEntryOut_Fl.ErrorEntryOut._.ZFFSAB2 /end MEASUREMENT
/begin MEASUREMENT ZFFSAB2._.ErrorEntryOut.ErrorEntryOut_Fl.sv_DiagnosticFunct "Diagnostics of hybrid functions" FLOAT32_IEEE SAB2_STANDARD_S3_S3 1 100 0 15 ECU_ADDRESS 0xFFF96270 FORMAT "%4.3" DISPLAY_IDENTIFIER sv_DiagnosticFunct.ErrorEntryOut_Fl.ErrorEntryOut._.ZFFSAB2 /end MEASUREMENT
/begin MEASUREMENT ZFFSAB2._.ErrorEntryOut.ErrorEntryOut_Fl.tmr_ForwardFilter_LIMPHOMECAN.time "Description for this variable only in SW documentation possible not in asap2" ULONG SAB2_T_TIMER_10MS_S3_S3 1 100 0 42949672950 ECU_ADDRESS 0xFFF96274 DISPLAY_IDENTIFIER time.tmr_ForwardFilter_LIMPHOMECAN.ErrorEntryOut_Fl.ErrorEntryOut._.ZFFSAB2 /end MEASUREMENT
/begin MEASUREMENT ZFFSAB2._.ErrorEntryOut.ErrorEntryOut_Fl.tmr_ForwardFilter_LIMPHOMECAN.time_ "Description for this variable only in SW documentation possible not in asap2" ULONG SAB2_T_TIMER_10MS_S3_S3 1 100 0 42949672950 ECU_ADDRESS 0xFFF96278 DISPLAY_IDENTIFIER time_.tmr_ForwardFilter_LIMPHOMECAN.ErrorEntryOut_Fl.ErrorEntryOut._.ZFFSAB2 /end MEASUREMENT
/begin MEASUREMENT ZFFSAB2._.ErrorEntryOut.f_DiagnosticFunctErr "Error flag of diagnostic function" UBYTE SAB2_STANDARD_S3_S3 1 100 0 1 ECU_ADDRESS 0xFFF96291 DISPLAY_IDENTIFIER f_DiagnosticFunctErr.ErrorEntryOut._.ZFFSAB2 /end MEASUREMENT
/begin MEASUREMENT ZFFSAB2._.ErrorEntryOut.f_DiagnosticFunctErr_ "Complement to error flag of diagnostic function" UBYTE SAB2_STANDARD_S3_S3 1 100 0 255 ECU_ADDRESS 0xFFF96292 DISPLAY_IDENTIFIER f_DiagnosticFunctErr_.ErrorEntryOut._.ZFFSAB2 /end MEASUREMENT
/begin MEASUREMENT ZFFSAB2._.ErrorEntryOut.iv_EPumpErr "Output signal: descryption of PWM from E-Pump" UBYTE SAB2_STANDARD_S3_S3 1 100 0 3 ECU_ADDRESS 0xFFF9628C DISPLAY_IDENTIFIER iv_EPumpErr.ErrorEntryOut._.ZFFSAB2 /end MEASUREMENT
/begin MEASUREMENT ZFFSAB2._.ErrorEntryOut.iv_FET0_Active "Input value for state of FET0" UBYTE SAB2_STANDARD_S3_S3 1 100 0 255 ECU_ADDRESS 0xFFF9628D DISPLAY_IDENTIFIER iv_FET0_Active.ErrorEntryOut._.ZFFSAB2 /end MEASUREMENT
/begin MEASUREMENT ZFFSAB2._.ErrorEntryOut.iv_FET0_Active_ "Input complement value for state of FET0" UBYTE SAB2_STANDARD_S3_S3 1 100 0 255 ECU_ADDRESS 0xFFF9628E DISPLAY_IDENTIFIER iv_FET0_Active_.ErrorEntryOut._.ZFFSAB2 /end MEASUREMENT
/begin MEASUREMENT ZFFSAB2._.ErrorEntryOut.iv_SubstFunct "Bitcode for the currently active lower 32 error measures" ULONG SAB2_STANDARD_S3_S3 1 100 0 4294967295 ECU_ADDRESS 0xFFF96284 DISPLAY_IDENTIFIER iv_SubstFunct.ErrorEntryOut._.ZFFSAB2 /end MEASUREMENT
/begin MEASUREMENT ZFFSAB2._.ErrorEntryOut.iv_SubstFunctHi "Bitcode for the currently active higher 32 error measures" ULONG SAB2_STANDARD_S3_S3 1 100 0 4294967295 ECU_ADDRESS 0xFFF96288 DISPLAY_IDENTIFIER iv_SubstFunctHi.ErrorEntryOut._.ZFFSAB2 /end MEASUREMENT
/begin MEASUREMENT ZFFSAB2._.ErrorEntryOut.sv_DiagnosticFunct "Diagnostics of hybrid functions" UBYTE SAB2_STANDARD_S3_S3 1 100 0 15 ECU_ADDRESS 0xFFF9628F DISPLAY_IDENTIFIER sv_DiagnosticFunct.ErrorEntryOut._.ZFFSAB2 /end MEASUREMENT
/begin MEASUREMENT ZFFSAB2._.ErrorEntryOut.sv_DiagnosticFunct_ "Diagnostics of hybrid functions - complement" UBYTE SAB2_STANDARD_S3_S3 1 100 0 255 ECU_ADDRESS 0xFFF96290 DISPLAY_IDENTIFIER sv_DiagnosticFunct_.ErrorEntryOut._.ZFFSAB2 /end MEASUREMENT
/begin MEASUREMENT ZFFSAB2._.GearboxLossesOut.iv_m_GearboxLosses "Gearbox losses calculate by HPSYS" SWORD SAB2_M_1NM_S3_S3 1 100 0 100 ECU_ADDRESS 0xFFF96294 DISPLAY_IDENTIFIER iv_m_GearboxLosses.GearboxLossesOut._.ZFFSAB2 /end MEASUREMENT
/begin MEASUREMENT ZFFSAB2._.GearboxLossesOut.sv_m_GearboxLosses "CAN Output signal of gearbox losses" UBYTE SAB2_M_2NM_S3_S3 1 100 0 510 ECU_ADDRESS 0xFFF96296 DISPLAY_IDENTIFIER sv_m_GearboxLosses.GearboxLossesOut._.ZFFSAB2 /end MEASUREMENT
/begin MEASUREMENT ZFFSAB2._.GearboxReinforcementOut.ActualGearOld "Value of iv_ActualGear from last cycle." SBYTE SAB2_STANDARD_S3_S3 1 100 -1 8 ECU_ADDRESS 0xFFF962AF DISPLAY_IDENTIFIER ActualGearOld.GearboxReinforcementOut._.ZFFSAB2 /end MEASUREMENT
/begin MEASUREMENT ZFFSAB2._.GearboxReinforcementOut.GearboxReinforcementInter "Intermediate variable for sv_GearboxReinforcement." UWORD SAB2_K8_S3_S3 1 100 0 511.875 ECU_ADDRESS 0xFFF962AC DISPLAY_IDENTIFIER GearboxReinforcementInter.GearboxReinforcementOut._.ZFFSAB2 /end MEASUREMENT
/begin MEASUREMENT ZFFSAB2._.GearboxReinforcementOut.dt_IGChangeOld "Value of tmr_dt_IGChange from last cycle." UBYTE SAB2_T_TIMER_10MS_S3_S3 1 100 0 2540 ECU_ADDRESS 0xFFF962B5 DISPLAY_IDENTIFIER dt_IGChangeOld.GearboxReinforcementOut._.ZFFSAB2 /end MEASUREMENT
/begin MEASUREMENT ZFFSAB2._.GearboxReinforcementOut.f_ShiftingAborted "Flag of gear shifting interruption." UBYTE SAB2_STANDARD_S3_S3 1 100 0 1 ECU_ADDRESS 0xFFF962B6 DISPLAY_IDENTIFIER f_ShiftingAborted.GearboxReinforcementOut._.ZFFSAB2 /end MEASUREMENT
/begin MEASUREMENT ZFFSAB2._.GearboxReinforcementOut.in_Gearbox "Calculated intermediate variable of actual gear" UWORD SAB2_K1000_S3_S3 1 100 0 10 ECU_ADDRESS 0xFFF962B0 DISPLAY_IDENTIFIER in_Gearbox.GearboxReinforcementOut._.ZFFSAB2 /end MEASUREMENT
/begin MEASUREMENT ZFFSAB2._.GearboxReinforcementOut.in_GearboxOld "Value of variable in_Gearbox from last cycle." UWORD SAB2_K1000_S3_S3 1 100 0 10 ECU_ADDRESS 0xFFF962B2 DISPLAY_IDENTIFIER in_GearboxOld.GearboxReinforcementOut._.ZFFSAB2 /end MEASUREMENT
/begin MEASUREMENT ZFFSAB2._.GearboxReinforcementOut.iv_GearboxReinforcementErr "Input value of (TYPE_UI8) 12)." UBYTE SAB2_STANDARD_S3_S3 1 100 0 1 ECU_ADDRESS 0xFFF962AE DISPLAY_IDENTIFIER iv_GearboxReinforcementErr.GearboxReinforcementOut._.ZFFSAB2 /end MEASUREMENT
/begin MEASUREMENT ZFFSAB2._.GearboxReinforcementOut.iv_RearAxleRatio "Rear axle ratio - Output signal from RearAxleRatioIn" UWORD SAB2_K100_S3_S3 1 100 0 10 ECU_ADDRESS 0xFFF962A2 DISPLAY_IDENTIFIER iv_RearAxleRatio.GearboxReinforcementOut._.ZFFSAB2 /end MEASUREMENT
/begin MEASUREMENT ZFFSAB2._.GearboxReinforcementOut.iv_dt_IGChange "Input signal" UBYTE SAB2_T_TIMER_10MS_S3_S3 1 100 0 2540 ECU_ADDRESS 0xFFF962A6 DISPLAY_IDENTIFIER iv_dt_IGChange.GearboxReinforcementOut._.ZFFSAB2 /end MEASUREMENT
/begin MEASUREMENT ZFFSAB2._.GearboxReinforcementOut.iv_in_ActualGear "Input value gearbox ratio of transferred gear from HPSYS" UWORD SAB2_K1000_S3_S3 1 100 0 10 ECU_ADDRESS 0xFFF9629C DISPLAY_IDENTIFIER iv_in_ActualGear.GearboxReinforcementOut._.ZFFSAB2 /end MEASUREMENT
/begin MEASUREMENT ZFFSAB2._.GearboxReinforcementOut.iv_in_TargetGear "Input value gearbox ratio of transferred gear from HPSYS" UWORD SAB2_K1000_S3_S3 1 100 0 10 ECU_ADDRESS 0xFFF9629E DISPLAY_IDENTIFIER iv_in_TargetGear.GearboxReinforcementOut._.ZFFSAB2 /end MEASUREMENT
/begin MEASUREMENT ZFFSAB2._.GearboxReinforcementOut.iv_n_Ab "Output rpm - Output signal from WheelIn" UWORD SAB2_N_1RPM_S3_S3 1 100 0 65535 ECU_ADDRESS 0xFFF962A0 DISPLAY_IDENTIFIER iv_n_Ab.GearboxReinforcementOut._.ZFFSAB2 /end MEASUREMENT
/begin MEASUREMENT ZFFSAB2._.GearboxReinforcementOut.iv_rga_not_info "Input value rga_not_info from HPSYS" UBYTE SAB2_STANDARD_S3_S3 1 100 0 255 ECU_ADDRESS 0xFFF962A4 DISPLAY_IDENTIFIER iv_rga_not_info.GearboxReinforcementOut._.ZFFSAB2 /end MEASUREMENT
/begin MEASUREMENT ZFFSAB2._.GearboxReinforcementOut.iv_status_limphome "Output signal of Gearbox Staus from SABIN" UBYTE SAB2_STANDARD_S3_S3 1 100 0 3 ECU_ADDRESS 0xFFF962A5 DISPLAY_IDENTIFIER iv_status_limphome.GearboxReinforcementOut._.ZFFSAB2 /end MEASUREMENT
/begin MEASUREMENT ZFFSAB2._.GearboxReinforcementOut.sv_GearboxReinforcement "Output value gearbox reinforcement" UWORD SAB2_K8_S3_S3 1 100 0 511.875 ECU_ADDRESS 0xFFF962A8 DISPLAY_IDENTIFIER sv_GearboxReinforcement.GearboxReinforcementOut._.ZFFSAB2 /end MEASUREMENT
/begin MEASUREMENT ZFFSAB2._.GearboxReinforcementOut.sv_GearboxReinforcementCalcSts "Output value status of gearbox reinforcement" UBYTE SAB2_STANDARD_S3_S3 1 100 0 2 ECU_ADDRESS 0xFFF962AA DISPLAY_IDENTIFIER sv_GearboxReinforcementCalcSts.GearboxReinforcementOut._.ZFFSAB2 /end MEASUREMENT
/begin MEASUREMENT ZFFSAB2._.GearboxReinforcementOut.tmr_dt_IGChange "Value of actual timer." UBYTE SAB2_T_TIMER_10MS_S3_S3 1 100 0 2540 ECU_ADDRESS 0xFFF962B4 DISPLAY_IDENTIFIER tmr_dt_IGChange.GearboxReinforcementOut._.ZFFSAB2 /end MEASUREMENT
/begin MEASUREMENT ZFFSAB2._.GearboxTorqueOut.f_TimerStarted "Flag that timer is already running" UBYTE SAB2_STANDARD_S3_S3 1 100 0 255 ECU_ADDRESS 0xFFF962CA DISPLAY_IDENTIFIER f_TimerStarted.GearboxTorqueOut._.ZFFSAB2 /end MEASUREMENT
/begin MEASUREMENT ZFFSAB2._.GearboxTorqueOut.iv_m_Gearbox "Input value from _ZF application transmission absorbing torque" SWORD SAB2_M_1NM_S3_S3 1 100 -32768 32767 ECU_ADDRESS 0xFFF962C0 DISPLAY_IDENTIFIER iv_m_Gearbox.GearboxTorqueOut._.ZFFSAB2 /end MEASUREMENT
/begin MEASUREMENT ZFFSAB2._.GearboxTorqueOut.iv_m_Gearbox_ "Complement of input value from _ZF application transmission absorbing torque" SWORD SAB2_STANDARD_S3_S3 1 100 -32768 32767 ECU_ADDRESS 0xFFF962C2 DISPLAY_IDENTIFIER iv_m_Gearbox_.GearboxTorqueOut._.ZFFSAB2 /end MEASUREMENT
/begin MEASUREMENT ZFFSAB2._.GearboxTorqueOut.iv_n_EngIdleSts "Input value from EngineIdleSpeedIn - Signalstatus of engine idle speed" UBYTE SAB2_STANDARD_S3_S3 1 100 0 255 ECU_ADDRESS 0xFFF962C4 DISPLAY_IDENTIFIER iv_n_EngIdleSts.GearboxTorqueOut._.ZFFSAB2 /end MEASUREMENT
/begin MEASUREMENT ZFFSAB2._.GearboxTorqueOut.sv_m_Gearbox "Output value for calculated transmission absorbing torque" UWORD SAB2_M_NM2_M2047_S3_S3 1 100 -1023.5 1024 ECU_ADDRESS 0xFFF962C6 DISPLAY_IDENTIFIER sv_m_Gearbox.GearboxTorqueOut._.ZFFSAB2 /end MEASUREMENT
/begin MEASUREMENT ZFFSAB2._.GearboxTorqueOut.sv_m_Gearbox_ "Complement of output value for calculated transmission absorbing torque" UWORD SAB2_STANDARD_S3_S3 1 100 0 65535 ECU_ADDRESS 0xFFF962C8 DISPLAY_IDENTIFIER sv_m_Gearbox_.GearboxTorqueOut._.ZFFSAB2 /end MEASUREMENT
/begin MEASUREMENT ZFFSAB2._.GearboxTorqueOut.t_freeze_mgt_Aufn_CAN.time "test_timer" UWORD SAB2_T_TIMER_10MS_S3_S3 1 100 0 655350 ECU_ADDRESS 0xFFF962CC DISPLAY_IDENTIFIER time.t_freeze_mgt_Aufn_CAN.GearboxTorqueOut._.ZFFSAB2 /end MEASUREMENT
/begin MEASUREMENT ZFFSAB2._.HybridControlOut.iv_BetriebszustandIst "Input value current function state HAS IST from HAS 0 = Inactive 1 = Coupled P/N 2 = Uncoupled P/N 3 = E-run 4 = Stop 5 = Charging 6 = Uncoupled VM on P/N 7 = Uncoupled VM on D/R 8 = Hybridrun 14 = Init 15 = Error" UBYTE SAB2_STANDARD_S3_S3 1 100 0 15 ECU_ADDRESS 0xFFF962D1 DISPLAY_IDENTIFIER iv_BetriebszustandIst.HybridControlOut._.ZFFSAB2 /end MEASUREMENT
/begin MEASUREMENT ZFFSAB2._.HybridControlOut.iv_BetriebszustandZiel "Input value requested function state HAS ZIEL from HAS 0 = Inactive 1 = Coupled P/N 2 = Uncoupled P/N 3 = E-run 4 = Stop 5 = Charging 6 = Uncoupled VM on P/N 7 = Uncoupled VM on D/R 8 = Hybridrun 14 = Init 15 = Error" UBYTE SAB2_STANDARD_S3_S3 1 100 0 15 ECU_ADDRESS 0xFFF962D2 DISPLAY_IDENTIFIER iv_BetriebszustandZiel.HybridControlOut._.ZFFSAB2 /end MEASUREMENT
/begin MEASUREMENT ZFFSAB2._.HybridControlOut.iv_StatusAblauf_HAS "Input value sv_StatusAblauf_HAS from HAS" UBYTE SAB2_STANDARD_S3_S3 1 100 0 15 ECU_ADDRESS 0xFFF962D0 DISPLAY_IDENTIFIER iv_StatusAblauf_HAS.HybridControlOut._.ZFFSAB2 /end MEASUREMENT
/begin MEASUREMENT ZFFSAB2._.HybridControlOut.sv_IstzustandKraftschluss "Output value sv_IstzustandKraftschluss" UBYTE SAB2_STANDARD_S3_S3 1 100 0 3 ECU_ADDRESS 0xFFF962D6 DISPLAY_IDENTIFIER sv_IstzustandKraftschluss.HybridControlOut._.ZFFSAB2 /end MEASUREMENT
/begin MEASUREMENT ZFFSAB2._.HybridControlOut.sv_IstzustandVerbrenner "Output value sv_IstzustandVerbrenner" UBYTE SAB2_STANDARD_S3_S3 1 100 0 3 ECU_ADDRESS 0xFFF962D7 DISPLAY_IDENTIFIER sv_IstzustandVerbrenner.HybridControlOut._.ZFFSAB2 /end MEASUREMENT
/begin MEASUREMENT ZFFSAB2._.HybridControlOut.sv_SollzustandKraftschluss "Output value sv_SollzustandKraftschluss" UBYTE SAB2_STANDARD_S3_S3 1 100 0 3 ECU_ADDRESS 0xFFF962D4 DISPLAY_IDENTIFIER sv_SollzustandKraftschluss.HybridControlOut._.ZFFSAB2 /end MEASUREMENT
/begin MEASUREMENT ZFFSAB2._.HybridControlOut.sv_SollzustandVerbrenner "Output value sv_SollzustandVerbrenner" UBYTE SAB2_STANDARD_S3_S3 1 100 0 3 ECU_ADDRESS 0xFFF962D5 DISPLAY_IDENTIFIER sv_SollzustandVerbrenner.HybridControlOut._.ZFFSAB2 /end MEASUREMENT
/begin MEASUREMENT ZFFSAB2._.HybridControlOut.sv_StatusAblauf_HAS "Output value sv_StatusAblauf_HAS" UBYTE SAB2_STANDARD_S3_S3 1 100 0 15 ECU_ADDRESS 0xFFF962D3 DISPLAY_IDENTIFIER sv_StatusAblauf_HAS.HybridControlOut._.ZFFSAB2 /end MEASUREMENT
/begin MEASUREMENT ZFFSAB2._.HybridSignalsOut.iv_StatusK0 "Input value of the state of the clutch K0. 0 - open 1 - enclosed 2 - pressure seting 3 - slip regulated 4 - closed regulation 5 - closed" UBYTE SAB2_STANDARD_S3_S3 1 100 0 5 ECU_ADDRESS 0xFFF962E4 DISPLAY_IDENTIFIER iv_StatusK0.HybridSignalsOut._.ZFFSAB2 /end MEASUREMENT
/begin MEASUREMENT ZFFSAB2._.HybridSignalsOut.iv_c_BelagK0 "Input value of the current K0 temperature" UWORD SAB2_C_1CEL_M40_S3_S3 1 100 -40 500 ECU_ADDRESS 0xFFF962E6 DISPLAY_IDENTIFIER iv_c_BelagK0.HybridSignalsOut._.ZFFSAB2 /end MEASUREMENT
/begin MEASUREMENT ZFFSAB2._.HybridSignalsOut.iv_m_MaxK0Akt "Input value of the current clutch K0 torque" SWORD SAB2_M_1NM_S3_S3 1 100 0 1000 ECU_ADDRESS 0xFFF962E8 DISPLAY_IDENTIFIER iv_m_MaxK0Akt.HybridSignalsOut._.ZFFSAB2 /end MEASUREMENT
/begin MEASUREMENT ZFFSAB2._.HybridSignalsOut.iv_m_Max_EM_HAS "Input value maximum torque for electric motor" SWORD SAB2_M_1NM_S3_S3 1 100 -32768 32767 ECU_ADDRESS 0xFFF962E0 DISPLAY_IDENTIFIER iv_m_Max_EM_HAS.HybridSignalsOut._.ZFFSAB2 /end MEASUREMENT
/begin MEASUREMENT ZFFSAB2._.HybridSignalsOut.iv_m_Min_EM_HAS "Input value minimum torque for electric motor" SWORD SAB2_M_1NM_S3_S3 1 100 -32768 32767 ECU_ADDRESS 0xFFF962E2 DISPLAY_IDENTIFIER iv_m_Min_EM_HAS.HybridSignalsOut._.ZFFSAB2 /end MEASUREMENT
/begin MEASUREMENT ZFFSAB2._.HybridSignalsOut.iv_m_Mod_EMHST_HAS_Offset "Input value torqueoffset electric motor for modification HST-action" SWORD SAB2_M_1NM_S3_S3 1 100 -32768 32767 ECU_ADDRESS 0xFFF962DE DISPLAY_IDENTIFIER iv_m_Mod_EMHST_HAS_Offset.HybridSignalsOut._.ZFFSAB2 /end MEASUREMENT
/begin MEASUREMENT ZFFSAB2._.HybridSignalsOut.iv_m_MotMaxVM_K0 "Input value of the current clutch K0 torque" SWORD SAB2_M_1NM_S3_S3 1 100 -400 1640 ECU_ADDRESS 0xFFF962EC DISPLAY_IDENTIFIER iv_m_MotMaxVM_K0.HybridSignalsOut._.ZFFSAB2 /end MEASUREMENT
/begin MEASUREMENT ZFFSAB2._.HybridSignalsOut.iv_m_ResEM_HAS "Input value of the spare torque of the electric motor" SWORD SAB2_M_1NM_S3_S3 1 100 0 1000 ECU_ADDRESS 0xFFF962DC DISPLAY_IDENTIFIER iv_m_ResEM_HAS.HybridSignalsOut._.ZFFSAB2 /end MEASUREMENT
/begin MEASUREMENT ZFFSAB2._.HybridSignalsOut.iv_m_SchleppK0Akt "Input value of signal from _GET_M_SCHLEPP_K0_AKT" SWORD SAB2_M_1NM_S3_S3 1 100 0 1000 ECU_ADDRESS 0xFFF962EA DISPLAY_IDENTIFIER iv_m_SchleppK0Akt.HybridSignalsOut._.ZFFSAB2 /end MEASUREMENT
/begin MEASUREMENT ZFFSAB2._.HybridSignalsOut.iv_st_m_MotMaxVM_K0 "State of torque moment reduction. 0 - inactive 1 - active" UBYTE SAB2_STANDARD_S3_S3 1 100 0 1 ECU_ADDRESS 0xFFF962EE DISPLAY_IDENTIFIER iv_st_m_MotMaxVM_K0.HybridSignalsOut._.ZFFSAB2 /end MEASUREMENT
/begin MEASUREMENT ZFFSAB2._.HybridSignalsOut.m_MaxK0_OldValue "Old Value form the signal sv_m_MaxK0." SWORD SAB2_M_1NM_S3_S3 1 100 0 4095 ECU_ADDRESS 0xFFF962FC DISPLAY_IDENTIFIER m_MaxK0_OldValue.HybridSignalsOut._.ZFFSAB2 /end MEASUREMENT
/begin MEASUREMENT ZFFSAB2._.HybridSignalsOut.sv_StatusK0 "Output value of the state of the clutch K0. 0 - open 1 - quick filling 2 - compensatory filing phase 3 - enclosed (touch point) 4 - pressure seting 5 - closing ramp 6 - slip regulation 7 - closed regulation (micro slip 8 - close) 9 - unencumbered BIN:1x x" UBYTE SAB2_STANDARD_S3_S3 1 100 0 63 ECU_ADDRESS 0xFFF962F8 DISPLAY_IDENTIFIER sv_StatusK0.HybridSignalsOut._.ZFFSAB2 /end MEASUREMENT
/begin MEASUREMENT ZFFSAB2._.HybridSignalsOut.sv_c_BelagK0 "Output value of the current K0 temperature" UBYTE SAB2_C_1CEL_M40_S3_S3 1 100 -40 214 ECU_ADDRESS 0xFFF962F9 DISPLAY_IDENTIFIER sv_c_BelagK0.HybridSignalsOut._.ZFFSAB2 /end MEASUREMENT
/begin MEASUREMENT ZFFSAB2._.HybridSignalsOut.sv_m_MaxK0 "Output value of the current clutch K0 torque" UWORD SAB2_M_NM2_M2047_S3_S3 1 100 -1023.5 1024 ECU_ADDRESS 0xFFF962FA DISPLAY_IDENTIFIER sv_m_MaxK0.HybridSignalsOut._.ZFFSAB2 /end MEASUREMENT
/begin MEASUREMENT ZFFSAB2._.HybridSignalsOut.sv_m_Max_EM_HAS "Output value maximum torque of electric motor" UWORD SAB2_M_NM2_M2047_S3_S3 1 100 -1023.5 1024 ECU_ADDRESS 0xFFF962F4 DISPLAY_IDENTIFIER sv_m_Max_EM_HAS.HybridSignalsOut._.ZFFSAB2 /end MEASUREMENT
/begin MEASUREMENT ZFFSAB2._.HybridSignalsOut.sv_m_Min_EM_HAS "Output value minimum torque of electric motor" UWORD SAB2_M_NM2_M2047_S3_S3 1 100 -1023.5 1024 ECU_ADDRESS 0xFFF962F6 DISPLAY_IDENTIFIER sv_m_Min_EM_HAS.HybridSignalsOut._.ZFFSAB2 /end MEASUREMENT
/begin MEASUREMENT ZFFSAB2._.HybridSignalsOut.sv_m_Mod_EMHST_HAS_Offset "Output value torque offset for modification HST-action" UWORD SAB2_M_NM2_M2047_S3_S3 1 100 -1023.5 1024 ECU_ADDRESS 0xFFF962F2 DISPLAY_IDENTIFIER sv_m_Mod_EMHST_HAS_Offset.HybridSignalsOut._.ZFFSAB2 /end MEASUREMENT
/begin MEASUREMENT ZFFSAB2._.HybridSignalsOut.sv_m_ResEM_HAS "Output value of the spare torque of the electric motor" UWORD SAB2_M_NM2_M2047_S3_S3 1 100 -1023.5 1024 ECU_ADDRESS 0xFFF962F0 DISPLAY_IDENTIFIER sv_m_ResEM_HAS.HybridSignalsOut._.ZFFSAB2 /end MEASUREMENT
/begin MEASUREMENT ZFFSAB2._.Interfi2.iv_ActualGear "Value of the current gear." SBYTE SAB2_STANDARD_S3_S3 1 100 -1 8 ECU_ADDRESS 0xFFF9634F DISPLAY_IDENTIFIER iv_ActualGear.Interfi2._.ZFFSAB2 /end MEASUREMENT
/begin MEASUREMENT ZFFSAB2._.Interfi2.iv_KL15 "Input value of ignition 0=init 1=switching on 2=on 3=switching off 4=off" UBYTE SAB2_STANDARD_S3_S3 1 100 0 4 ECU_ADDRESS 0xFFF96351 DISPLAY_IDENTIFIER iv_KL15.Interfi2._.ZFFSAB2 /end MEASUREMENT
/begin MEASUREMENT ZFFSAB2._.Interfi2.iv_KL15_ "Complement of output value" UBYTE SAB2_STANDARD_S3_S3 1 100 0 255 ECU_ADDRESS 0xFFF96352 DISPLAY_IDENTIFIER iv_KL15_.Interfi2._.ZFFSAB2 /end MEASUREMENT
/begin MEASUREMENT ZFFSAB2._.Interfi2.iv_Pos "Position of Gear Lever: D=5 N=6 R=7 P=8" UBYTE SAB2_STANDARD_S3_S3 1 100 0 8 ECU_ADDRESS 0xFFF96340 DISPLAY_IDENTIFIER iv_Pos.Interfi2._.ZFFSAB2 /end MEASUREMENT
/begin MEASUREMENT ZFFSAB2._.Interfi2.iv_TargetGear "Value of the target gear." SBYTE SAB2_STANDARD_S3_S3 1 100 -1 8 ECU_ADDRESS 0xFFF9634E DISPLAY_IDENTIFIER iv_TargetGear.Interfi2._.ZFFSAB2 /end MEASUREMENT
/begin MEASUREMENT ZFFSAB2._.Interfi2.iv_c_OilTrans "Input value of gear oil temperature. From SABIn class GearboxTempIn." UBYTE SAB2_C_CGT_1CEL_M40_S3_S3 1 100 -40 215 ECU_ADDRESS 0xFFF9634C DISPLAY_IDENTIFIER iv_c_OilTrans.Interfi2._.ZFFSAB2 /end MEASUREMENT
/begin MEASUREMENT ZFFSAB2._.Interfi2.iv_c_OilTransSts "Signal status of gear oil temperature - Output signal from the class GearBoxTempIn" UBYTE SAB2_STANDARD_S3_S3 1 100 0 255 ECU_ADDRESS 0xFFF9634D DISPLAY_IDENTIFIER iv_c_OilTransSts.Interfi2._.ZFFSAB2 /end MEASUREMENT
/begin MEASUREMENT ZFFSAB2._.Interfi2.iv_f_ACANorFACAN "CAN bus used - Output signal form CAN_SwitchingIn" UBYTE SAB2_STANDARD_S3_S3 1 100 0 1 ECU_ADDRESS 0xFFF96342 DISPLAY_IDENTIFIER iv_f_ACANorFACAN.Interfi2._.ZFFSAB2 /end MEASUREMENT
/begin MEASUREMENT ZFFSAB2._.Interfi2.iv_f_IgnOn "Terminal 15 status - Output signal form IgnitionStatusIn" UBYTE SAB2_STANDARD_S3_S3 1 100 0 1 ECU_ADDRESS 0xFFF96341 DISPLAY_IDENTIFIER iv_f_IgnOn.Interfi2._.ZFFSAB2 /end MEASUREMENT
/begin MEASUREMENT ZFFSAB2._.Interfi2.iv_kraftschluss "Input value grip from HPSYS" UBYTE SAB2_STANDARD_S3_S3 1 100 0 6 ECU_ADDRESS 0xFFF96350 DISPLAY_IDENTIFIER iv_kraftschluss.Interfi2._.ZFFSAB2 /end MEASUREMENT
/begin MEASUREMENT ZFFSAB2._.Interfi2.iv_m_EngSts "Signal status of engine torque. Output variable from SABIN class EngineTorqueIn." UBYTE SAB2_STANDARD_S3_S3 1 100 0 255 ECU_ADDRESS 0xFFF9634B DISPLAY_IDENTIFIER iv_m_EngSts.Interfi2._.ZFFSAB2 /end MEASUREMENT
/begin MEASUREMENT ZFFSAB2._.Interfi2.iv_n_Eng "Reduction rpm - Output signal from EngineSpeedIn" UWORD SAB2_N_1RPM_S3_S3 1 100 0 65535 ECU_ADDRESS 0xFFF96348 DISPLAY_IDENTIFIER iv_n_Eng.Interfi2._.ZFFSAB2 /end MEASUREMENT
/begin MEASUREMENT ZFFSAB2._.Interfi2.iv_n_EngSts "Signal status of reduction rpm - Output signal from EngineSpeedIn" UBYTE SAB2_STANDARD_S3_S3 1 100 0 255 ECU_ADDRESS 0xFFF9634A DISPLAY_IDENTIFIER iv_n_EngSts.Interfi2._.ZFFSAB2 /end MEASUREMENT
/begin MEASUREMENT ZFFSAB2._.Interfi2.iv_n_Tu "Turbine speed - Output signal from the class RPM_SensingIn" UWORD SAB2_N_1RPM_S3_S3 1 100 0 65535 ECU_ADDRESS 0xFFF96344 DISPLAY_IDENTIFIER iv_n_Tu.Interfi2._.ZFFSAB2 /end MEASUREMENT
/begin MEASUREMENT ZFFSAB2._.Interfi2.iv_n_TuSts "Turbine speed status - Output signal from the class RPM_SensingIn" UBYTE SAB2_STANDARD_S3_S3 1 100 0 255 ECU_ADDRESS 0xFFF96346 DISPLAY_IDENTIFIER iv_n_TuSts.Interfi2._.ZFFSAB2 /end MEASUREMENT
/begin MEASUREMENT ZFFSAB2._.MIL_RequestOut.iv_CodingMilLamp "Input signal from OBD switch function; 0 - MIL always off; 1 - Signalization from Errorhandler cause activation of MIL." UBYTE SAB2_STANDARD_S3_S3 1 100 0 1 ECU_ADDRESS 0xFFF96D3F DISPLAY_IDENTIFIER iv_CodingMilLamp.MIL_RequestOut._.ZFFSAB2 /end MEASUREMENT
/begin MEASUREMENT ZFFSAB2._.MIL_RequestOut.iv_MilReq "Input signal MIL request" UBYTE SAB2_STANDARD_S3_S3 1 100 0 1 ECU_ADDRESS 0xFFF96D40 DISPLAY_IDENTIFIER iv_MilReq.MIL_RequestOut._.ZFFSAB2 /end MEASUREMENT
/begin MEASUREMENT ZFFSAB2._.MIL_RequestOut.sv_MilReq "Output signal of MIL request" UBYTE SAB2_STANDARD_S3_S3 1 100 0 2 ECU_ADDRESS 0xFFF96D41 DISPLAY_IDENTIFIER sv_MilReq.MIL_RequestOut._.ZFFSAB2 /end MEASUREMENT
/begin MEASUREMENT ZFFSAB2._.MStartLimitationOut.sv_f_m_StartLimitation "Output value limitation of starting torque" UBYTE SAB2_STANDARD_S3_S3 1 100 0 3 ECU_ADDRESS 0xFFF96D42 DISPLAY_IDENTIFIER sv_f_m_StartLimitation.MStartLimitationOut._.ZFFSAB2 /end MEASUREMENT
/begin MEASUREMENT ZFFSAB2._.NICActiveOut.iv_ADA_IAEActive "input value IAE-adaption active / inactive" UBYTE SAB2_STANDARD_S3_S3 1 100 0 2 ECU_ADDRESS 0xFFF96302 DISPLAY_IDENTIFIER iv_ADA_IAEActive.NICActiveOut._.ZFFSAB2 /end MEASUREMENT
/begin MEASUREMENT ZFFSAB2._.NICActiveOut.iv_SBCActive "input value SBC active / SBC inactive" UBYTE SAB2_STANDARD_S3_S3 1 100 0 1 ECU_ADDRESS 0xFFF96300 DISPLAY_IDENTIFIER iv_SBCActive.NICActiveOut._.ZFFSAB2 /end MEASUREMENT
/begin MEASUREMENT ZFFSAB2._.NICActiveOut.iv_SSCActive "input value SSC active / inactive" UBYTE SAB2_STANDARD_S3_S3 1 100 0 1 ECU_ADDRESS 0xFFF96301 DISPLAY_IDENTIFIER iv_SSCActive.NICActiveOut._.ZFFSAB2 /end MEASUREMENT
/begin MEASUREMENT ZFFSAB2._.NICActiveOut.sv_GearboxSts "output value with currrent SBC and SSC status" UBYTE SAB2_STANDARD_S3_S3 1 100 0 7 ECU_ADDRESS 0xFFF96303 DISPLAY_IDENTIFIER sv_GearboxSts.NICActiveOut._.ZFFSAB2 /end MEASUREMENT
/begin MEASUREMENT ZFFSAB2._.PumpIntakeTorqueOut.iv_m_Pump "Input value pump intake torque" SWORD SAB2_M_1NM_S3_S3 1 100 -32768 32767 ECU_ADDRESS 0xFFF96308 DISPLAY_IDENTIFIER iv_m_Pump.PumpIntakeTorqueOut._.ZFFSAB2 /end MEASUREMENT
/begin MEASUREMENT ZFFSAB2._.PumpIntakeTorqueOut.sv_m_PumpCensored "Output value pump intake torque for internal usage in SABIN." SWORD SAB2_M_1NM_S3_S3 1 100 0 30 ECU_ADDRESS 0xFFF9630A DISPLAY_IDENTIFIER sv_m_PumpCensored.PumpIntakeTorqueOut._.ZFFSAB2 /end MEASUREMENT
/begin MEASUREMENT ZFFSAB2._.ShiftingActiveOut.iv_f_ChangeOfGear "0 - gear change not aktiv; 1 - gear change aktiv" UBYTE SAB2_STANDARD_S3_S3 1 100 0 1 ECU_ADDRESS 0xFFF96310 DISPLAY_IDENTIFIER iv_f_ChangeOfGear.ShiftingActiveOut._.ZFFSAB2 /end MEASUREMENT
/begin MEASUREMENT ZFFSAB2._.ShiftingActiveOut.sv_f_ShiftingActive "Undelayed output value flag shifting active (SWP-RAM-cell)" UBYTE SAB2_STANDARD_S3_S3 1 100 0 3 ECU_ADDRESS 0xFFF96311 DISPLAY_IDENTIFIER sv_f_ShiftingActive.ShiftingActiveOut._.ZFFSAB2 /end MEASUREMENT
/begin MEASUREMENT ZFFSAB2._.SynEngineSpeedOut.f_n_mot_synSollVMSts "f_n_mot_synSollVMSts status flag" UBYTE SAB2_STANDARD_S3_S3 1 100 0 255 ECU_ADDRESS 0xFFF96332 DISPLAY_IDENTIFIER f_n_mot_synSollVMSts.SynEngineSpeedOut._.ZFFSAB2 /end MEASUREMENT
/begin MEASUREMENT ZFFSAB2._.SynEngineSpeedOut.f_n_mot_synSollVMSts_ "f_n_mot_synSollVMSts complement" UBYTE SAB2_STANDARD_S3_S3 1 100 0 255 ECU_ADDRESS 0xFFF96333 DISPLAY_IDENTIFIER f_n_mot_synSollVMSts_.SynEngineSpeedOut._.ZFFSAB2 /end MEASUREMENT
/begin MEASUREMENT ZFFSAB2._.SynEngineSpeedOut.iv_f_n_mot_synEMSts "Input value f_n_mot_synEMSts" UBYTE SAB2_STANDARD_S3_S3 1 100 0 1 ECU_ADDRESS 0xFFF9631A DISPLAY_IDENTIFIER iv_f_n_mot_synEMSts.SynEngineSpeedOut._.ZFFSAB2 /end MEASUREMENT
/begin MEASUREMENT ZFFSAB2._.SynEngineSpeedOut.iv_f_n_mot_synEMSts_ "Input value f_n_mot_synEMSts_" UBYTE SAB2_STANDARD_S3_S3 1 100 0 255 ECU_ADDRESS 0xFFF9631B DISPLAY_IDENTIFIER iv_f_n_mot_synEMSts_.SynEngineSpeedOut._.ZFFSAB2 /end MEASUREMENT
/begin MEASUREMENT ZFFSAB2._.SynEngineSpeedOut.iv_f_n_mot_synVMSts "Input value f_n_mot_synVMSts" UBYTE SAB2_STANDARD_S3_S3 1 100 0 1 ECU_ADDRESS 0xFFF96322 DISPLAY_IDENTIFIER iv_f_n_mot_synVMSts.SynEngineSpeedOut._.ZFFSAB2 /end MEASUREMENT
/begin MEASUREMENT ZFFSAB2._.SynEngineSpeedOut.iv_f_n_mot_synVMSts_ "Input value f_n_mot_synVMSts_" UBYTE SAB2_STANDARD_S3_S3 1 100 0 255 ECU_ADDRESS 0xFFF96323 DISPLAY_IDENTIFIER iv_f_n_mot_synVMSts_.SynEngineSpeedOut._.ZFFSAB2 /end MEASUREMENT
/begin MEASUREMENT ZFFSAB2._.SynEngineSpeedOut.iv_n_mot_synEM "Input value n_mot_synEM" UWORD SAB2_N_1RPM_S3_S3 1 100 0 8000 ECU_ADDRESS 0xFFF96316 DISPLAY_IDENTIFIER iv_n_mot_synEM.SynEngineSpeedOut._.ZFFSAB2 /end MEASUREMENT
/begin MEASUREMENT ZFFSAB2._.SynEngineSpeedOut.iv_n_mot_synEM_ "Input value n_mot_synEM_" UWORD SAB2_STANDARD_S3_S3 1 100 0 65535 ECU_ADDRESS 0xFFF96318 DISPLAY_IDENTIFIER iv_n_mot_synEM_.SynEngineSpeedOut._.ZFFSAB2 /end MEASUREMENT
/begin MEASUREMENT ZFFSAB2._.SynEngineSpeedOut.iv_n_mot_synVM "Input value n_mot_synVM" UWORD SAB2_N_1RPM_S3_S3 1 100 0 8000 ECU_ADDRESS 0xFFF9631E DISPLAY_IDENTIFIER iv_n_mot_synVM.SynEngineSpeedOut._.ZFFSAB2 /end MEASUREMENT
/begin MEASUREMENT ZFFSAB2._.SynEngineSpeedOut.iv_n_mot_synVM_ "Input value n_mot_synVM_" UWORD SAB2_STANDARD_S3_S3 1 100 0 65535 ECU_ADDRESS 0xFFF96320 DISPLAY_IDENTIFIER iv_n_mot_synVM_.SynEngineSpeedOut._.ZFFSAB2 /end MEASUREMENT
/begin MEASUREMENT ZFFSAB2._.SynEngineSpeedOut.iv_n_motsynEMErr "Input value n_motsynEMErr" UBYTE SAB2_STANDARD_S3_S3 1 100 0 1 ECU_ADDRESS 0xFFF9631C DISPLAY_IDENTIFIER iv_n_motsynEMErr.SynEngineSpeedOut._.ZFFSAB2 /end MEASUREMENT
/begin MEASUREMENT ZFFSAB2._.SynEngineSpeedOut.iv_n_motsynEMErr_ "Input value n_motsynEMErr_" UBYTE SAB2_STANDARD_S3_S3 1 100 0 255 ECU_ADDRESS 0xFFF9631D DISPLAY_IDENTIFIER iv_n_motsynEMErr_.SynEngineSpeedOut._.ZFFSAB2 /end MEASUREMENT
/begin MEASUREMENT ZFFSAB2._.SynEngineSpeedOut.iv_n_motsynVMErr "Input value n_motsynVMErr" UBYTE SAB2_STANDARD_S3_S3 1 100 0 1 ECU_ADDRESS 0xFFF96324 DISPLAY_IDENTIFIER iv_n_motsynVMErr.SynEngineSpeedOut._.ZFFSAB2 /end MEASUREMENT
/begin MEASUREMENT ZFFSAB2._.SynEngineSpeedOut.iv_n_motsynVMErr_ "Input value n_motsynVMErr_" UBYTE SAB2_STANDARD_S3_S3 1 100 0 255 ECU_ADDRESS 0xFFF96325 DISPLAY_IDENTIFIER iv_n_motsynVMErr_.SynEngineSpeedOut._.ZFFSAB2 /end MEASUREMENT
/begin MEASUREMENT ZFFSAB2._.SynEngineSpeedOut.sv_f_n_mot_synSollEMSts "output value sv_f_n_mot_synSollEMSts" UBYTE SAB2_STANDARD_S3_S3 1 100 0 255 ECU_ADDRESS 0xFFF96330 DISPLAY_IDENTIFIER sv_f_n_mot_synSollEMSts.SynEngineSpeedOut._.ZFFSAB2 /end MEASUREMENT
/begin MEASUREMENT ZFFSAB2._.SynEngineSpeedOut.sv_f_n_mot_synSollEMSts_ "output value sv_f_n_mot_synSollEMSts complement" UBYTE SAB2_STANDARD_S3_S3 1 100 0 255 ECU_ADDRESS 0xFFF96331 DISPLAY_IDENTIFIER sv_f_n_mot_synSollEMSts_.SynEngineSpeedOut._.ZFFSAB2 /end MEASUREMENT
/begin MEASUREMENT ZFFSAB2._.SynEngineSpeedOut.sv_n_mot_synSollEM "Output value of the target engine speed" UWORD SAB2_N_10RPM4_S3_S3 1 100 0 163837.5 ECU_ADDRESS 0xFFF96326 DISPLAY_IDENTIFIER sv_n_mot_synSollEM.SynEngineSpeedOut._.ZFFSAB2 /end MEASUREMENT
/begin MEASUREMENT ZFFSAB2._.SynEngineSpeedOut.sv_n_mot_synSollEMVMSts "output value of the combined rpm control" UBYTE SAB2_STANDARD_S3_S3 1 100 0 7 ECU_ADDRESS 0xFFF9632E DISPLAY_IDENTIFIER sv_n_mot_synSollEMVMSts.SynEngineSpeedOut._.ZFFSAB2 /end MEASUREMENT
/begin MEASUREMENT ZFFSAB2._.SynEngineSpeedOut.sv_n_mot_synSollEMVMSts_ "complement of output value of the combined rpm control" UBYTE SAB2_STANDARD_S3_S3 1 100 0 255 ECU_ADDRESS 0xFFF9632F DISPLAY_IDENTIFIER sv_n_mot_synSollEMVMSts_.SynEngineSpeedOut._.ZFFSAB2 /end MEASUREMENT
/begin MEASUREMENT ZFFSAB2._.SynEngineSpeedOut.sv_n_mot_synSollEM_ "Output value of the complement target engine speed" UWORD SAB2_STANDARD_S3_S3 1 100 0 65535 ECU_ADDRESS 0xFFF96328 DISPLAY_IDENTIFIER sv_n_mot_synSollEM_.SynEngineSpeedOut._.ZFFSAB2 /end MEASUREMENT
/begin MEASUREMENT ZFFSAB2._.SynEngineSpeedOut.sv_n_mot_synSollVM "output value n_mo_synSollVM" UWORD SAB2_N_RPM2_S3_S3 1 100 0 32767.5 ECU_ADDRESS 0xFFF9632A DISPLAY_IDENTIFIER sv_n_mot_synSollVM.SynEngineSpeedOut._.ZFFSAB2 /end MEASUREMENT
/begin MEASUREMENT ZFFSAB2._.SynEngineSpeedOut.sv_n_mot_synSollVM_ "output value n_mo_synSollVM_" UWORD SAB2_STANDARD_S3_S3 1 100 0 65535 ECU_ADDRESS 0xFFF9632C DISPLAY_IDENTIFIER sv_n_mot_synSollVM_.SynEngineSpeedOut._.ZFFSAB2 /end MEASUREMENT
/begin MEASUREMENT ZFFSAB2._.TorqueConverterOut.TorqueConverterOutDAT.TableColumnHyb "x-value of D_KplHyb" UWORD SAB2_STANDARD_S3_S3 1 100 0 65535 ECU_ADDRESS 0xFFF9633A DISPLAY_IDENTIFIER TableColumnHyb.TorqueConverterOutDAT.TorqueConverterOut._.ZFFSAB2 /end MEASUREMENT
/begin MEASUREMENT ZFFSAB2._.TorqueConverterOut.TorqueConverterOutDAT.TableRowHyb "y-value of D_KplHyb" UWORD SAB2_STANDARD_S3_S3 1 100 0 65535 ECU_ADDRESS 0xFFF96338 DISPLAY_IDENTIFIER TableRowHyb.TorqueConverterOutDAT.TorqueConverterOut._.ZFFSAB2 /end MEASUREMENT
/begin MEASUREMENT ZFFSAB2._.TorqueConverterOut.iv_PreadaptionState "Input signal of preadaption: 0 = not started yet; 1 = Init state; 2 = running; 3 = will be finished; 4 = function interrupted" UBYTE SAB2_STANDARD_S3_S3 1 100 0 4 ECU_ADDRESS 0xFFF9633C DISPLAY_IDENTIFIER iv_PreadaptionState.TorqueConverterOut._.ZFFSAB2 /end MEASUREMENT
/begin MEASUREMENT ZFFSAB2._.TorqueConverterOut.iv_st_IAE "Input signal torque converter IAE" UBYTE SAB2_STANDARD_S3_S3 1 100 0 8 ECU_ADDRESS 0xFFF9633D DISPLAY_IDENTIFIER iv_st_IAE.TorqueConverterOut._.ZFFSAB2 /end MEASUREMENT
/begin MEASUREMENT ZFFSAB2._.TorqueConverterOut.sv_wk_Ist "Output signal of torque converter" UBYTE SAB2_STANDARD_S3_S3 1 100 0 3 ECU_ADDRESS 0xFFF9633F DISPLAY_IDENTIFIER sv_wk_Ist.TorqueConverterOut._.ZFFSAB2 /end MEASUREMENT
/begin MEASUREMENT ZFFSAB2._.TorqueConverterOut.sv_wk_IstHybrid "Output signal of torque converter status" UBYTE SAB2_STANDARD_S3_S3 1 100 0 15 ECU_ADDRESS 0xFFF9633E DISPLAY_IDENTIFIER sv_wk_IstHybrid.TorqueConverterOut._.ZFFSAB2 /end MEASUREMENT
/begin MEASUREMENT ZKA_DBG17 "" UWORD _CNV_R_R_Umr_1_zu_1_2_CM_S2 1 0 0 65535 ECU_ADDRESS 0xFFF8E82E FORMAT "%2.0" /end MEASUREMENT
/begin MEASUREMENT ZKA_DBG19 "" SWORD _CNV_R_R_Umr_1_zu_1_2_CM_S2 1 0 -32768 32767 ECU_ADDRESS 0xFFF8E830 FORMAT "%2.0" /end MEASUREMENT
/begin MEASUREMENT ZKA_DBG23 "" SWORD _CNV_R_R_Umr_1_zu_1_2_CM_S2 1 0 -32768 32767 ECU_ADDRESS 0xFFF8E832 FORMAT "%2.0" /end MEASUREMENT
/begin MEASUREMENT ZKA_DBG24 "" SWORD _CNV_R_R_Umr_1_zu_1_2_CM_S2 1 0 -32768 32767 ECU_ADDRESS 0xFFF8E834 FORMAT "%2.0" /end MEASUREMENT
/begin MEASUREMENT ZKA_DBG26 "" SWORD _CNV_R_R_Umr_1_zu_1_2_CM_S2 1 0 -32768 32767 ECU_ADDRESS 0xFFF8E836 FORMAT "%2.0" /end MEASUREMENT
/begin MEASUREMENT Z_ADAPT_REQ "" UBYTE _CNV_S_3_Enum_EREQA_103_CM_S2 1 0 0 2 ECU_ADDRESS 0xFFF8EADE /end MEASUREMENT
/begin MEASUREMENT Z_ADAPT_REQ_ROH "" UBYTE _CNV_P_2_A_I_5_CM_S2 1 0 0 255 ECU_ADDRESS 0xFFF8E961 /end MEASUREMENT
/begin MEASUREMENT Z_AFU "" UBYTE _CNV_P_2_A_I_5_CM_S2 1 0 0 255 ECU_ADDRESS 0xFFF8EADF /end MEASUREMENT
/begin MEASUREMENT Z_AGSMOD_ECO_EFAHREN "" UBYTE _CNV_S_4_Enum_EAGS__17_CM_S2 1 0 0 3 ECU_ADDRESS 0xFFF8E902 /end MEASUREMENT
/begin MEASUREMENT Z_AGSMOD_ECO_EFAHREN_ALT "" UBYTE _CNV_S_4_Enum_EAGS__17_CM_S2 1 0 0 3 ECU_ADDRESS 0xFFF8E903 /end MEASUREMENT
/begin MEASUREMENT Z_AGS_MODBEDEL "" UBYTE _CNV_S_2_Enum_EAGS_18_CM_S2 1 0 0 1 ECU_ADDRESS 0xFFF8EB8B /end MEASUREMENT
/begin MEASUREMENT Z_AGS_MODBEDEL_ALT "" UBYTE _CNV_S_2_Enum_EAGS_18_CM_S2 1 0 0 1 ECU_ADDRESS 0xFFF8E9BC /end MEASUREMENT
/begin MEASUREMENT Z_AGS_MODBEDEL_ALT_RSUBGH "" UBYTE _CNV_S_2_Enum_EAGS_18_CM_S2 1 0 0 1 ECU_ADDRESS 0xFFF8EB86 /end MEASUREMENT
/begin MEASUREMENT Z_AGS_MODBEDEL_ALT_STEPS "" UBYTE _CNV_S_2_Enum_EAGS_18_CM_S2 1 0 0 1 ECU_ADDRESS 0xFFF8E9D5 /end MEASUREMENT
/begin MEASUREMENT Z_AGS_TID_MOD "" UBYTE _CNV_S_3_Enum_EAGST_248_CM_S2 1 0 0 2 ECU_ADDRESS 0xFFF8EAA7 /end MEASUREMENT
/begin MEASUREMENT Z_ANTRIEB "" UBYTE _CNV_S_3_Enum_EANTR_216_CM_S2 1 0 0 2 ECU_ADDRESS 0xFFF8EA16 /end MEASUREMENT
/begin MEASUREMENT Z_ANTRIEB_ROH "" UBYTE _CNV_R_R_Umr_1_zu_1_2_CM_S2 1 0 0 255 ECU_ADDRESS 0xFFF8E962 /end MEASUREMENT
/begin MEASUREMENT Z_ANZAHL_QS3 "" UWORD _CNV_R_R_Umr_1_zu_1_2_CM_S2 1 0 0 1024 ECU_ADDRESS 0xFFF8E3D6 FORMAT "%2.0" /end MEASUREMENT
/begin MEASUREMENT Z_ANZAHL_QS3_SS "" UBYTE _CNV_P_2_A_I_5_CM_S2 1 0 0 255 ECU_ADDRESS 0xFFF8E988 /end MEASUREMENT
/begin MEASUREMENT Z_ANZEIGEART_GANG "" UBYTE _CNV_S_6_Enum_EANZE_152_CM_S2 1 0 0 5 ECU_ADDRESS 0xFFF8E921 /end MEASUREMENT
/begin MEASUREMENT Z_ANZGANGART "" UBYTE _CNV_S_6_Enum_EANZG_150_CM_S2 1 0 0 5 ECU_ADDRESS 0xFFF8E922 /end MEASUREMENT
/begin MEASUREMENT Z_B "" UBYTE _CNV_S_4_Enum_EB_197_CM_S2 1 0 0 3 ECU_ADDRESS 0xFFF8EA0C /end MEASUREMENT
/begin MEASUREMENT Z_BEDEL_AUSHSU "" UBYTE _CNV_S_3_Enum_EHSUA_109_CM_S2 1 0 0 2 ECU_ADDRESS 0xFFF8EA7C /end MEASUREMENT
/begin MEASUREMENT Z_BEREICH_GWFP "" UBYTE _CNV_S_7_Enum_EDMRS_188_CM_S2 1 0 0 6 ECU_ADDRESS 0xFFF8EA1E /end MEASUREMENT
/begin MEASUREMENT Z_BERGANH "" UBYTE _CNV_S_6_Enum_EBERG_47_CM_S2 1 0 0 5 ECU_ADDRESS 0xFFF8E9FC /end MEASUREMENT
/begin MEASUREMENT Z_BERGANH_ALT "" UBYTE _CNV_S_6_Enum_EBERG_47_CM_S2 1 0 0 5 ECU_ADDRESS 0xFFF8E9FD /end MEASUREMENT
/begin MEASUREMENT Z_BERGANH_ALT_RSUBGH "" UBYTE _CNV_S_6_Enum_EBERG_47_CM_S2 1 0 0 5 ECU_ADDRESS 0xFFF8EB87 /end MEASUREMENT
/begin MEASUREMENT Z_BSMODE "" UBYTE _CNV_S_4_Enum_EBSMO_198_CM_S2 1 0 0 3 ECU_ADDRESS 0xFFF8EAE0 /end MEASUREMENT
/begin MEASUREMENT Z_BSMODE_ALT "" UBYTE _CNV_S_4_Enum_EBSMO_198_CM_S2 1 0 0 3 ECU_ADDRESS 0xFFF8E9BD /end MEASUREMENT
/begin MEASUREMENT Z_BSMODE_ROH "" UBYTE _CNV_R_R_Umr_1_zu_1_2_CM_S2 1 0 0 255 ECU_ADDRESS 0xFFF8E963 /end MEASUREMENT
/begin MEASUREMENT Z_BSMODE_TRANS "" UBYTE _CNV_S_7_Enum_EBSMO_199_CM_S2 1 0 0 6 ECU_ADDRESS 0xFFF8E8B4 /end MEASUREMENT
/begin MEASUREMENT Z_B_BCA "" UBYTE _CNV_S_4_Enum_EB_197_CM_S2 1 0 0 3 ECU_ADDRESS 0xFFF8EA0D /end MEASUREMENT
/begin MEASUREMENT Z_B_ERR "" UBYTE _CNV_S_3_Enum_EQ_64_CM_S2 1 0 0 2 ECU_ADDRESS 0xFFF8EAE1 /end MEASUREMENT
/begin MEASUREMENT Z_CODIERUNG "" UBYTE _CNV_R_R_Umr_1_zu_1_2_CM_S2 1 0 0 255 ECU_ADDRESS 0xFFF8EAE3 FORMAT "%2.0" /end MEASUREMENT
/begin MEASUREMENT Z_CODIERUNG_OBD "" UBYTE _CNV_R_R_Umr_1_zu_1_2_CM_S2 1 0 0 255 ECU_ADDRESS 0xFFF8EAE4 FORMAT "%2.0" /end MEASUREMENT
/begin MEASUREMENT Z_CODIERUNG_OBD_ROH "" UBYTE _CNV_R_R_Umr_1_zu_1_2_CM_S2 1 0 0 255 ECU_ADDRESS 0xFFF8E964 /end MEASUREMENT
/begin MEASUREMENT Z_CODIERUNG_ROH "" UBYTE _CNV_R_R_Umr_1_zu_1_2_CM_S2 1 0 0 255 ECU_ADDRESS 0xFFF8E965 /end MEASUREMENT
/begin MEASUREMENT Z_COD_VMAX "" UBYTE _CNV_S_4_Enum_ECOD__208_CM_S2 1 0 0 3 ECU_ADDRESS 0xFFF8EA17 /end MEASUREMENT
/begin MEASUREMENT Z_COD_VMAX_ROH "" UBYTE _CNV_S_4_Enum_ECOD__208_CM_S2 1 0 0 3 ECU_ADDRESS 0xFFF8EA14 /end MEASUREMENT
/begin MEASUREMENT Z_DERS_YIDX "" UBYTE _CNV_R_R_Umr_1_zu_1_2_CM_S2 1 0 0 1 ECU_ADDRESS 0xFFF8EC10 /end MEASUREMENT
/begin MEASUREMENT Z_DK_FFG "" UBYTE _CNV_S_4_Enum_EDKFI_89_CM_S2 1 0 0 3 ECU_ADDRESS 0xFFF8E8DA /end MEASUREMENT
/begin MEASUREMENT Z_DK_FILT "" UBYTE _CNV_S_4_Enum_EDKFI_90_CM_S2 1 0 0 3 ECU_ADDRESS 0xFFF8E8DB /end MEASUREMENT
/begin MEASUREMENT Z_DL_IDX "" UBYTE _CNV_S_9_Enum_EMAPD_212_CM_S2 1 0 0 8 ECU_ADDRESS 0xFFF8EA3D /end MEASUREMENT
/begin MEASUREMENT Z_DMRS_DYN "" UBYTE _CNV_S_3_Enum_EDYN__171_CM_S2 1 0 0 2 ECU_ADDRESS 0xFFF8E9A9 /end MEASUREMENT
/begin MEASUREMENT Z_DMRS_FINDTABIDX "" UBYTE _CNV_R_R_Umr_1_zu_1_2_CM_S2 1 0 0 19 ECU_ADDRESS 0xFFF8EA1F FORMAT "%2.0" /end MEASUREMENT
/begin MEASUREMENT Z_DRIVEDYN "" UBYTE _CNV_S_7_Enum_EDRDY_217_CM_S2 1 0 0 13 ECU_ADDRESS 0xFFF8EAE7 /end MEASUREMENT
/begin MEASUREMENT Z_DRIVEDYN_DSC "" UBYTE _CNV_S_3_Enum_EDRDY_218_CM_S2 1 0 0 4 ECU_ADDRESS 0xFFF8EA39 /end MEASUREMENT
/begin MEASUREMENT Z_DRIVEDYN_IDX "" UBYTE _CNV_S_7_Enum_EDRIV_158_CM_S2 1 0 0 6 ECU_ADDRESS 0xFFF8EA3A /end MEASUREMENT
/begin MEASUREMENT Z_DRIVEDYN_ROH "" UWORD _CNV_R_R_Umr_1_zu_1_2_CM_S2 1 0 0 65535 ECU_ADDRESS 0xFFF8E3CA /end MEASUREMENT
/begin MEASUREMENT Z_DRIVELOGIC "" UBYTE _CNV_S_6_Enum_EDL_11_CM_S2 1 0 1 6 ECU_ADDRESS 0xFFF8EA3E /end MEASUREMENT
/begin MEASUREMENT Z_DSC "" UBYTE _CNV_S_3_Enum_EDSCS_50_CM_S2 1 0 0 2 ECU_ADDRESS 0xFFF8EA3F /end MEASUREMENT
/begin MEASUREMENT Z_DSC_ALT_LM "" UBYTE _CNV_S_3_Enum_EDSCS_50_CM_S2 1 0 0 2 ECU_ADDRESS 0xFFF8EB1F /end MEASUREMENT
/begin MEASUREMENT Z_DSC_FDS "" UBYTE _CNV_S_3_Enum_EDSCS_50_CM_S2 1 0 0 2 ECU_ADDRESS 0xFFF8EA3B /end MEASUREMENT
/begin MEASUREMENT Z_DSC_IST "" UBYTE _CNV_S_3_Enum_EDSCS_50_CM_S2 1 0 0 2 ECU_ADDRESS 0xFFF8EAE8 /end MEASUREMENT
/begin MEASUREMENT Z_DSC_ROH "" UBYTE _CNV_R_R_Umr_1_zu_1_2_CM_S2 1 0 0 255 ECU_ADDRESS 0xFFF8E969 /end MEASUREMENT
/begin MEASUREMENT Z_DWDKKD_DMRS_AGS "" UBYTE _CNV_S_10_Enum_EDMRS_22_CM_S2 1 0 0 9 ECU_ADDRESS 0xFFF8EA20 /end MEASUREMENT
/begin MEASUREMENT Z_DWDKKD_KL_IDX "" UBYTE _CNV_P_2_A_I_5_CM_S2 1 0 0 255 ECU_ADDRESS 0xFFF8EA21 /end MEASUREMENT
/begin MEASUREMENT Z_DYNAMIK "" UBYTE _CNV_P_2_A_I_5_CM_S2 1 0 0 255 ECU_ADDRESS 0xFFF8E9B0 /end MEASUREMENT
/begin MEASUREMENT Z_DYNAMIK_ENBL "" UBYTE _CNV_P_2_A_I_5_CM_S2 1 0 0 255 ECU_ADDRESS 0xFFF8E9AA /end MEASUREMENT
/begin MEASUREMENT Z_DYNAMIK_SS "" UBYTE _CNV_P_2_A_I_5_CM_S2 1 0 0 255 ECU_ADDRESS 0xFFF8E989 /end MEASUREMENT
/begin MEASUREMENT Z_DYNAMIK_YIDX "" UBYTE _CNV_R_R_Umr_1_zu_1_2_CM_S2 1 0 0 24 ECU_ADDRESS 0xFFF8E9AB FORMAT "%2.0" /end MEASUREMENT
/begin MEASUREMENT Z_DYNDZM_FFG "" UBYTE _CNV_R_R_Umr_1_zu_1_2_CM_S2 1 0 0 1 ECU_ADDRESS 0xFFF8E8DD FORMAT "%2.0" /end MEASUREMENT
/begin MEASUREMENT Z_DYNDZM_INDEX "" UBYTE _CNV_R_R_Umr_1_zu_1_2_CM_S2 1 0 0 19 ECU_ADDRESS 0xFFF8EA2D /end MEASUREMENT
/begin MEASUREMENT Z_DYNDZM_PHASE6_7 "" SBYTE _CNV_S_3_Enum_EDYND_129_CM_S2 1 0 -1 1 ECU_ADDRESS 0xFFF8EC14 /end MEASUREMENT
/begin MEASUREMENT Z_DYNDZM_STATE "" UBYTE _CNV_S_8_Enum_EDYND_134_CM_S2 1 0 0 7 ECU_ADDRESS 0xFFF8EA2E /end MEASUREMENT
/begin MEASUREMENT Z_DYNDZM_STATE_ALT "" UBYTE _CNV_S_8_Enum_EDYND_134_CM_S2 1 0 0 7 ECU_ADDRESS 0xFFF8EA2F /end MEASUREMENT
/begin MEASUREMENT Z_DYNDZM_STATE_ZIEL "" UBYTE _CNV_S_8_Enum_EDYND_134_CM_S2 1 0 0 7 ECU_ADDRESS 0xFFF8EA30 /end MEASUREMENT
/begin MEASUREMENT Z_EFAHRKL "" UBYTE _CNV_S_6_Enum_EEFAH_118_CM_S2 1 0 0 5 ECU_ADDRESS 0xFFF8EAE9 /end MEASUREMENT
/begin MEASUREMENT Z_EFAHRKL_ROH "" UBYTE _CNV_R_R_Umr_1_zu_1_2_CM_S2 1 0 0 5 ECU_ADDRESS 0xFFF8E96A FORMAT "%2.0" /end MEASUREMENT
/begin MEASUREMENT Z_EGS_REAKTION_N_RED "" UBYTE _CNV_S_4_Enum_eEGS__219_CM_S2 1 0 0 3 ECU_ADDRESS 0xFFF8EAEA /end MEASUREMENT
/begin MEASUREMENT Z_EGS_REAKTION_N_RED_ROH "" UBYTE _CNV_R_R_Umr_1_zu_1_2_CM_S2 1 0 0 255 ECU_ADDRESS 0xFFF8E96B /end MEASUREMENT
/begin MEASUREMENT Z_EINLENK "" UBYTE _CNV_S_2_Schalter_A_4_CM_S2 1 0 0 1 ECU_ADDRESS 0xFFF8EAA8 /end MEASUREMENT
/begin MEASUREMENT Z_EIN_TRAKTION "" UBYTE _CNV_S_4_Enum_EEIN__220_CM_S2 1 0 0 3 ECU_ADDRESS 0xFFF8EAE5 /end MEASUREMENT
/begin MEASUREMENT Z_EIN_TRAKTION_ROH "" UBYTE _CNV_R_R_Umr_1_zu_1_2_CM_S2 1 0 0 255 ECU_ADDRESS 0xFFF8E966 /end MEASUREMENT
/begin MEASUREMENT Z_ERK_BAB "" UBYTE _CNV_S_3_Enum_EBAB_45_CM_S2 1 0 0 2 ECU_ADDRESS 0xFFF8E9F0 /end MEASUREMENT
/begin MEASUREMENT Z_EXCFKT_DBM "" UBYTE _CNV_S_4_Enum_EEXCF_91_CM_S2 1 0 0 3 ECU_ADDRESS 0xFFF8E8F4 /end MEASUREMENT
/begin MEASUREMENT Z_EXCFKT_FFG "" UBYTE _CNV_S_4_Enum_EEXCF_91_CM_S2 1 0 0 3 ECU_ADDRESS 0xFFF8E8DE /end MEASUREMENT
/begin MEASUREMENT Z_EXCFKT_FFGALT "" UBYTE _CNV_S_4_Enum_EEXCF_91_CM_S2 1 0 0 3 ECU_ADDRESS 0xFFF8E8DF /end MEASUREMENT
/begin MEASUREMENT Z_FBIT_FELD[0] "" UBYTE _CNV_P_2_A_I_5_CM_S2 1 0 0 255 ECU_ADDRESS 0xFFF8E530 /end MEASUREMENT
/begin MEASUREMENT Z_FBIT_FELD[10] "" UBYTE _CNV_P_2_A_I_5_CM_S2 1 0 0 255 ECU_ADDRESS 0xFFF8E53A /end MEASUREMENT
/begin MEASUREMENT Z_FBIT_FELD[11] "" UBYTE _CNV_P_2_A_I_5_CM_S2 1 0 0 255 ECU_ADDRESS 0xFFF8E53B /end MEASUREMENT
/begin MEASUREMENT Z_FBIT_FELD[12] "" UBYTE _CNV_P_2_A_I_5_CM_S2 1 0 0 255 ECU_ADDRESS 0xFFF8E53C /end MEASUREMENT
/begin MEASUREMENT Z_FBIT_FELD[13] "" UBYTE _CNV_P_2_A_I_5_CM_S2 1 0 0 255 ECU_ADDRESS 0xFFF8E53D /end MEASUREMENT
/begin MEASUREMENT Z_FBIT_FELD[14] "" UBYTE _CNV_P_2_A_I_5_CM_S2 1 0 0 255 ECU_ADDRESS 0xFFF8E53E /end MEASUREMENT
/begin MEASUREMENT Z_FBIT_FELD[15] "" UBYTE _CNV_P_2_A_I_5_CM_S2 1 0 0 255 ECU_ADDRESS 0xFFF8E53F /end MEASUREMENT
/begin MEASUREMENT Z_FBIT_FELD[16] "" UBYTE _CNV_P_2_A_I_5_CM_S2 1 0 0 255 ECU_ADDRESS 0xFFF8E540 /end MEASUREMENT
/begin MEASUREMENT Z_FBIT_FELD[17] "" UBYTE _CNV_P_2_A_I_5_CM_S2 1 0 0 255 ECU_ADDRESS 0xFFF8E541 /end MEASUREMENT
/begin MEASUREMENT Z_FBIT_FELD[18] "" UBYTE _CNV_P_2_A_I_5_CM_S2 1 0 0 255 ECU_ADDRESS 0xFFF8E542 /end MEASUREMENT
/begin MEASUREMENT Z_FBIT_FELD[19] "" UBYTE _CNV_P_2_A_I_5_CM_S2 1 0 0 255 ECU_ADDRESS 0xFFF8E543 /end MEASUREMENT
/begin MEASUREMENT Z_FBIT_FELD[1] "" UBYTE _CNV_P_2_A_I_5_CM_S2 1 0 0 255 ECU_ADDRESS 0xFFF8E531 /end MEASUREMENT
/begin MEASUREMENT Z_FBIT_FELD[20] "" UBYTE _CNV_P_2_A_I_5_CM_S2 1 0 0 255 ECU_ADDRESS 0xFFF8E544 /end MEASUREMENT
/begin MEASUREMENT Z_FBIT_FELD[21] "" UBYTE _CNV_P_2_A_I_5_CM_S2 1 0 0 255 ECU_ADDRESS 0xFFF8E545 /end MEASUREMENT
/begin MEASUREMENT Z_FBIT_FELD[22] "" UBYTE _CNV_P_2_A_I_5_CM_S2 1 0 0 255 ECU_ADDRESS 0xFFF8E546 /end MEASUREMENT
/begin MEASUREMENT Z_FBIT_FELD[23] "" UBYTE _CNV_P_2_A_I_5_CM_S2 1 0 0 255 ECU_ADDRESS 0xFFF8E547 /end MEASUREMENT
/begin MEASUREMENT Z_FBIT_FELD[24] "" UBYTE _CNV_P_2_A_I_5_CM_S2 1 0 0 255 ECU_ADDRESS 0xFFF8E548 /end MEASUREMENT
/begin MEASUREMENT Z_FBIT_FELD[25] "" UBYTE _CNV_P_2_A_I_5_CM_S2 1 0 0 255 ECU_ADDRESS 0xFFF8E549 /end MEASUREMENT
/begin MEASUREMENT Z_FBIT_FELD[26] "" UBYTE _CNV_P_2_A_I_5_CM_S2 1 0 0 255 ECU_ADDRESS 0xFFF8E54A /end MEASUREMENT
/begin MEASUREMENT Z_FBIT_FELD[27] "" UBYTE _CNV_P_2_A_I_5_CM_S2 1 0 0 255 ECU_ADDRESS 0xFFF8E54B /end MEASUREMENT
/begin MEASUREMENT Z_FBIT_FELD[28] "" UBYTE _CNV_P_2_A_I_5_CM_S2 1 0 0 255 ECU_ADDRESS 0xFFF8E54C /end MEASUREMENT
/begin MEASUREMENT Z_FBIT_FELD[29] "" UBYTE _CNV_P_2_A_I_5_CM_S2 1 0 0 255 ECU_ADDRESS 0xFFF8E54D /end MEASUREMENT
/begin MEASUREMENT Z_FBIT_FELD[2] "" UBYTE _CNV_P_2_A_I_5_CM_S2 1 0 0 255 ECU_ADDRESS 0xFFF8E532 /end MEASUREMENT
/begin MEASUREMENT Z_FBIT_FELD[3] "" UBYTE _CNV_P_2_A_I_5_CM_S2 1 0 0 255 ECU_ADDRESS 0xFFF8E533 /end MEASUREMENT
/begin MEASUREMENT Z_FBIT_FELD[4] "" UBYTE _CNV_P_2_A_I_5_CM_S2 1 0 0 255 ECU_ADDRESS 0xFFF8E534 /end MEASUREMENT
/begin MEASUREMENT Z_FBIT_FELD[5] "" UBYTE _CNV_P_2_A_I_5_CM_S2 1 0 0 255 ECU_ADDRESS 0xFFF8E535 /end MEASUREMENT
/begin MEASUREMENT Z_FBIT_FELD[6] "" UBYTE _CNV_P_2_A_I_5_CM_S2 1 0 0 255 ECU_ADDRESS 0xFFF8E536 /end MEASUREMENT
/begin MEASUREMENT Z_FBIT_FELD[7] "" UBYTE _CNV_P_2_A_I_5_CM_S2 1 0 0 255 ECU_ADDRESS 0xFFF8E537 /end MEASUREMENT
/begin MEASUREMENT Z_FBIT_FELD[8] "" UBYTE _CNV_P_2_A_I_5_CM_S2 1 0 0 255 ECU_ADDRESS 0xFFF8E538 /end MEASUREMENT
/begin MEASUREMENT Z_FBIT_FELD[9] "" UBYTE _CNV_P_2_A_I_5_CM_S2 1 0 0 255 ECU_ADDRESS 0xFFF8E539 /end MEASUREMENT
/begin MEASUREMENT Z_FILT_DAEMPF_DYNDZM "" UBYTE _CNV_R_R_Umr_1_zu_1_2_CM_S2 1 0 0 3 ECU_ADDRESS 0xFFF8EA31 FORMAT "%2.0" /end MEASUREMENT
/begin MEASUREMENT Z_FILT_WK_DYNDZM "" UBYTE _CNV_R_R_Umr_1_zu_1_2_CM_S2 1 0 0 3 ECU_ADDRESS 0xFFF8EA32 FORMAT "%2.0" /end MEASUREMENT
/begin MEASUREMENT Z_FKTERW_FFG "" UBYTE _CNV_S_9_Enum_EFKTE_92_CM_S2 1 0 0 8 ECU_ADDRESS 0xFFF8E8E0 /end MEASUREMENT
/begin MEASUREMENT Z_FKTERW_FFGALT "" UBYTE _CNV_S_9_Enum_EFKTE_92_CM_S2 1 0 0 8 ECU_ADDRESS 0xFFF8E8E1 /end MEASUREMENT
/begin MEASUREMENT Z_FKT_EXC_ERK "" ULONG _CNV_R_R_Umr_1_zu_1_2_CM_S2 1 0 0 4294967295 ECU_ADDRESS 0xFFF8ED80 FORMAT "%2.0" /end MEASUREMENT
/begin MEASUREMENT Z_FPKF_DYN "" UBYTE _CNV_S_3_Enum_EDYN__172_CM_S2 1 0 0 2 ECU_ADDRESS 0xFFF8E9AC /end MEASUREMENT
/begin MEASUREMENT Z_FT "" UBYTE _CNV_S_4_Enum_EFT_20_CM_S2 1 0 0 3 ECU_ADDRESS 0xFFF8EA45 /end MEASUREMENT
/begin MEASUREMENT Z_FT_BPL "" UBYTE _CNV_S_4_Enum_EFT_20_CM_S2 1 0 0 3 ECU_ADDRESS 0xFFF8EA46 /end MEASUREMENT
/begin MEASUREMENT Z_FT_BR "" UBYTE _CNV_S_4_Enum_EFT_20_CM_S2 1 0 0 3 ECU_ADDRESS 0xFFF8EBFB /end MEASUREMENT
/begin MEASUREMENT Z_FT_KICKFAST "" UBYTE _CNV_S_4_Enum_EFT_20_CM_S2 1 0 0 3 ECU_ADDRESS 0xFFF8EA47 /end MEASUREMENT
/begin MEASUREMENT Z_FT_MAX "" UBYTE _CNV_S_4_Enum_EFT_20_CM_S2 1 0 0 3 ECU_ADDRESS 0xFFF8EBFE /end MEASUREMENT
/begin MEASUREMENT Z_FT_MAXOLD "" UBYTE _CNV_S_4_Enum_EFT_20_CM_S2 1 0 0 3 ECU_ADDRESS 0xFFF8EBFF /end MEASUREMENT
/begin MEASUREMENT Z_FT_MBR "" UBYTE _CNV_S_5_Enum_EFT2_53_CM_S2 1 0 0 4 ECU_ADDRESS 0xFFF8EBFC /end MEASUREMENT
/begin MEASUREMENT Z_FZG_ANH "" UBYTE _CNV_S_3_Enum_EANH_51_CM_S2 1 0 0 2 ECU_ADDRESS 0xFFF8EAEC /end MEASUREMENT
/begin MEASUREMENT Z_FZG_ANH_ROH "" UBYTE _CNV_R_R_Umr_1_zu_1_2_CM_S2 1 0 0 255 ECU_ADDRESS 0xFFF8E96D /end MEASUREMENT
/begin MEASUREMENT Z_GANGWHL_AZG "" UBYTE _CNV_S_14_Enum_EGANG_73_CM_S2 1 0 0 13 ECU_ADDRESS 0xFFF8E923 /end MEASUREMENT
/begin MEASUREMENT Z_GANGWHL_AZG_SS "" UBYTE _CNV_S_14_Enum_EGANG_73_CM_S2 1 0 0 13 ECU_ADDRESS 0xFFF8E98B /end MEASUREMENT
/begin MEASUREMENT Z_GANG_ADD "" UBYTE _CNV_S_9_Enum_EGANG_21_CM_S2 1 0 0 8 ECU_ADDRESS 0xFFF8E911 /end MEASUREMENT
/begin MEASUREMENT Z_GANG_ALGO_ZKA "" UBYTE _CNV_S_9_Enum_EGANG_21_CM_S2 1 0 0 8 ECU_ADDRESS 0xFFF8EBCC /end MEASUREMENT
/begin MEASUREMENT Z_GANG_ANZEIGE_ANGLEICH "" UBYTE _CNV_S_9_Enum_EGANG_21_CM_S2 1 0 0 8 ECU_ADDRESS 0xFFF8E924 /end MEASUREMENT
/begin MEASUREMENT Z_GANG_ANZEIGE_AUT "" UBYTE _CNV_S_9_Enum_EGANG_21_CM_S2 1 0 0 8 ECU_ADDRESS 0xFFF8E925 /end MEASUREMENT
/begin MEASUREMENT Z_GANG_ANZEIGE_AUT_ALT "" UBYTE _CNV_S_9_Enum_EGANG_21_CM_S2 1 0 0 8 ECU_ADDRESS 0xFFF8E926 /end MEASUREMENT
/begin MEASUREMENT Z_GANG_ANZEIGE_AUT_START "" UBYTE _CNV_S_9_Enum_EGANG_21_CM_S2 1 0 0 8 ECU_ADDRESS 0xFFF8E927 /end MEASUREMENT
/begin MEASUREMENT Z_GANG_ASSISTENT "" UBYTE _CNV_S_9_Enum_EGANG_21_CM_S2 1 0 0 8 ECU_ADDRESS 0xFFF8E90A /end MEASUREMENT
/begin MEASUREMENT Z_GANG_AUTOMAT "" UBYTE _CNV_S_9_Enum_EGANG_21_CM_S2 1 0 0 8 ECU_ADDRESS 0xFFF8E8B5 /end MEASUREMENT
/begin MEASUREMENT Z_GANG_BAB "" UBYTE _CNV_S_9_Enum_EGANG_21_CM_S2 1 0 0 8 ECU_ADDRESS 0xFFF8EBEF /end MEASUREMENT
/begin MEASUREMENT Z_GANG_BABRSZ "" UBYTE _CNV_S_9_Enum_EGANG_21_CM_S2 1 0 0 8 ECU_ADDRESS 0xFFF8EBF0 /end MEASUREMENT
/begin MEASUREMENT Z_GANG_BRS "" UBYTE _CNV_S_9_Enum_EGANG_21_CM_S2 1 0 0 8 ECU_ADDRESS 0xFFF8EBF8 /end MEASUREMENT
/begin MEASUREMENT Z_GANG_BRSMBR "" UBYTE _CNV_S_9_Enum_EGANG_21_CM_S2 1 0 0 8 ECU_ADDRESS 0xFFF8EBF9 /end MEASUREMENT
/begin MEASUREMENT Z_GANG_D2BRSMBR "" UBYTE _CNV_S_9_Enum_EGANG_21_CM_S2 1 0 0 8 ECU_ADDRESS 0xFFF8EBFA /end MEASUREMENT
/begin MEASUREMENT Z_GANG_DEFAULT "" UBYTE _CNV_S_9_Enum_EGANG_21_CM_S2 1 0 0 8 ECU_ADDRESS 0xFFF8EAED /end MEASUREMENT
/begin MEASUREMENT Z_GANG_DEFAULT_ROH "" UBYTE _CNV_R_R_Umr_1_zu_1_2_CM_S2 1 0 0 255 ECU_ADDRESS 0xFFF8E96E /end MEASUREMENT
/begin MEASUREMENT Z_GANG_DERS "" UBYTE _CNV_S_9_Enum_EGANG_21_CM_S2 1 0 0 8 ECU_ADDRESS 0xFFF8EC11 /end MEASUREMENT
/begin MEASUREMENT Z_GANG_DMRS "" UBYTE _CNV_S_9_Enum_EGANG_21_CM_S2 1 0 0 8 ECU_ADDRESS 0xFFF8EA22 /end MEASUREMENT
/begin MEASUREMENT Z_GANG_DMRSKD "" UBYTE _CNV_S_9_Enum_EGANG_21_CM_S2 1 0 0 8 ECU_ADDRESS 0xFFF8EA23 /end MEASUREMENT
/begin MEASUREMENT Z_GANG_DMRSSKL "" UBYTE _CNV_S_9_Enum_EGANG_21_CM_S2 1 0 0 8 ECU_ADDRESS 0xFFF8E9E9 /end MEASUREMENT
/begin MEASUREMENT Z_GANG_EXC "" UBYTE _CNV_S_9_Enum_EGANG_21_CM_S2 1 0 0 8 ECU_ADDRESS 0xFFF8E912 /end MEASUREMENT
/begin MEASUREMENT Z_GANG_HDC "" UBYTE _CNV_S_9_Enum_EGANG_21_CM_S2 1 0 0 8 ECU_ADDRESS 0xFFF8EA66 /end MEASUREMENT
/begin MEASUREMENT Z_GANG_HSURE "" UBYTE _CNV_S_9_Enum_EGANG_21_CM_S2 1 0 0 8 ECU_ADDRESS 0xFFF8EAA1 /end MEASUREMENT
/begin MEASUREMENT Z_GANG_IST "" UBYTE _CNV_S_9_Enum_EGANG_21_CM_S2 1 0 0 8 ECU_ADDRESS 0xFFF8EAEE /end MEASUREMENT
/begin MEASUREMENT Z_GANG_ISTALTSTOPGO "" UBYTE _CNV_S_9_Enum_EGANG_21_CM_S2 1 0 0 8 ECU_ADDRESS 0xFFF8EBAC /end MEASUREMENT
/begin MEASUREMENT Z_GANG_IST_ALT "" UBYTE _CNV_S_9_Enum_EGANG_21_CM_S2 1 0 0 8 ECU_ADDRESS 0xFFF8E9BE /end MEASUREMENT
/begin MEASUREMENT Z_GANG_IST_ANZEIGE_ALT "" UBYTE _CNV_S_9_Enum_EGANG_21_CM_S2 1 0 0 8 ECU_ADDRESS 0xFFF8E928 /end MEASUREMENT
/begin MEASUREMENT Z_GANG_IST_DYNDZM_FREEZE "" UBYTE _CNV_S_9_Enum_EGANG_21_CM_S2 1 0 0 8 ECU_ADDRESS 0xFFF8EA33 /end MEASUREMENT
/begin MEASUREMENT Z_GANG_IST_ROH "" UBYTE _CNV_S_11_Enum_EGANG_74_CM_S2 1 0 1 13 ECU_ADDRESS 0xFFF8E96F /end MEASUREMENT
/begin MEASUREMENT Z_GANG_KDRS_STEPS "" UBYTE _CNV_S_9_Enum_EGANG_21_CM_S2 1 0 0 8 ECU_ADDRESS 0xFFF8E9D6 /end MEASUREMENT
/begin MEASUREMENT Z_GANG_KD_ZKA "" UBYTE _CNV_S_9_Enum_EGANG_21_CM_S2 1 0 0 8 ECU_ADDRESS 0xFFF8EBCD /end MEASUREMENT
/begin MEASUREMENT Z_GANG_KOOP "" UBYTE _CNV_S_9_Enum_EGANG_21_CM_S2 1 0 0 8 ECU_ADDRESS 0xFFF8E913 /end MEASUREMENT
/begin MEASUREMENT Z_GANG_KOOP_DBM "" UBYTE _CNV_S_9_Enum_EGANG_21_CM_S2 1 0 0 8 ECU_ADDRESS 0xFFF8E914 /end MEASUREMENT
/begin MEASUREMENT Z_GANG_MANUELL "" UBYTE _CNV_S_9_Enum_EGANG_21_CM_S2 1 0 0 8 ECU_ADDRESS 0xFFF8E9D7 /end MEASUREMENT
/begin MEASUREMENT Z_GANG_MARS "" UBYTE _CNV_S_9_Enum_EGANG_21_CM_S2 1 0 0 8 ECU_ADDRESS 0xFFF8EB35 /end MEASUREMENT
/begin MEASUREMENT Z_GANG_MAX "" UBYTE _CNV_S_9_Enum_EGANG_21_CM_S2 1 0 0 8 ECU_ADDRESS 0xFFF8E90C /end MEASUREMENT
/begin MEASUREMENT Z_GANG_MAX_DBM "" UBYTE _CNV_S_9_Enum_EGANG_21_CM_S2 1 0 0 8 ECU_ADDRESS 0xFFF8E8F5 /end MEASUREMENT
/begin MEASUREMENT Z_GANG_MFRS_ZKA "" UBYTE _CNV_S_9_Enum_EGANG_21_CM_S2 1 0 0 8 ECU_ADDRESS 0xFFF8EBCE /end MEASUREMENT
/begin MEASUREMENT Z_GANG_MIN "" UBYTE _CNV_S_9_Enum_EGANG_21_CM_S2 1 0 0 8 ECU_ADDRESS 0xFFF8E90D /end MEASUREMENT
/begin MEASUREMENT Z_GANG_MIN_DBM "" UBYTE _CNV_S_9_Enum_EGANG_21_CM_S2 1 0 0 8 ECU_ADDRESS 0xFFF8E8F6 /end MEASUREMENT
/begin MEASUREMENT Z_GANG_MUELOWSKL "" UBYTE _CNV_S_9_Enum_EGANG_21_CM_S2 1 0 0 8 ECU_ADDRESS 0xFFF8EB40 /end MEASUREMENT
/begin MEASUREMENT Z_GANG_PMA "" UBYTE _CNV_S_9_Enum_EGANG_21_CM_S2 1 0 0 8 ECU_ADDRESS 0xFFF8E915 /end MEASUREMENT
/begin MEASUREMENT Z_GANG_RSU "" UBYTE _CNV_S_9_Enum_EGANG_21_CM_S2 1 0 0 8 ECU_ADDRESS 0xFFF8EB24 /end MEASUREMENT
/begin MEASUREMENT Z_GANG_RSUBGH "" UBYTE _CNV_S_9_Enum_EGANG_21_CM_S2 1 0 0 8 ECU_ADDRESS 0xFFF8EC22 /end MEASUREMENT
/begin MEASUREMENT Z_GANG_RSUMUELOW "" UBYTE _CNV_S_9_Enum_EGANG_21_CM_S2 1 0 0 8 ECU_ADDRESS 0xFFF8EC23 /end MEASUREMENT
/begin MEASUREMENT Z_GANG_RSUMUELOW_IN "" UBYTE _CNV_S_9_Enum_EGANG_21_CM_S2 1 0 0 8 ECU_ADDRESS 0xFFF8EC24 /end MEASUREMENT
/begin MEASUREMENT Z_GANG_RSZFWS "" UBYTE _CNV_S_9_Enum_EGANG_21_CM_S2 1 0 0 8 ECU_ADDRESS 0xFFF8EBF1 /end MEASUREMENT
/begin MEASUREMENT Z_GANG_RSZMOT "" UBYTE _CNV_S_9_Enum_EGANG_21_CM_S2 1 0 0 8 ECU_ADDRESS 0xFFF8EBF2 /end MEASUREMENT
/begin MEASUREMENT Z_GANG_RSZROH "" UBYTE _CNV_S_9_Enum_EGANG_21_CM_S2 1 0 0 8 ECU_ADDRESS 0xFFF8EBF3 /end MEASUREMENT
/begin MEASUREMENT Z_GANG_RSZSEQ_BAB "" UBYTE _CNV_S_9_Enum_EGANG_21_CM_S2 1 0 0 8 ECU_ADDRESS 0xFFF8EBF4 /end MEASUREMENT
/begin MEASUREMENT Z_GANG_SEQ_DEC "" UBYTE _CNV_S_9_Enum_EGANG_21_CM_S2 1 0 0 8 ECU_ADDRESS 0xFFF8EB41 /end MEASUREMENT
/begin MEASUREMENT Z_GANG_SEQ_ZKA "" UBYTE _CNV_S_9_Enum_EGANG_21_CM_S2 1 0 0 8 ECU_ADDRESS 0xFFF8EBCF /end MEASUREMENT
/begin MEASUREMENT Z_GANG_SKL "" UBYTE _CNV_S_9_Enum_EGANG_21_CM_S2 1 0 0 8 ECU_ADDRESS 0xFFF8E90E /end MEASUREMENT
/begin MEASUREMENT Z_GANG_SKLMARS "" UBYTE _CNV_S_9_Enum_EGANG_21_CM_S2 1 0 0 8 ECU_ADDRESS 0xFFF8EB36 /end MEASUREMENT
/begin MEASUREMENT Z_GANG_SKLNULLAST "" UBYTE _CNV_S_9_Enum_EGANG_21_CM_S2 1 0 0 8 ECU_ADDRESS 0xFFF8EB42 /end MEASUREMENT
/begin MEASUREMENT Z_GANG_SOLL "" UBYTE _CNV_S_9_Enum_EGANG_21_CM_S2 1 0 0 8 ECU_ADDRESS 0xFFF8E90F /end MEASUREMENT
/begin MEASUREMENT Z_GANG_SOLLAGS "" UBYTE _CNV_S_9_Enum_EGANG_21_CM_S2 1 0 0 8 ECU_ADDRESS 0xFFF8E916 /end MEASUREMENT
/begin MEASUREMENT Z_GANG_SOLLALT_QSHIFT "" UBYTE _CNV_S_9_Enum_EGANG_21_CM_S2 1 0 0 8 ECU_ADDRESS 0xFFF8E9B1 /end MEASUREMENT
/begin MEASUREMENT Z_GANG_SOLLGF "" UBYTE _CNV_S_9_Enum_EGANG_21_CM_S2 1 0 0 8 ECU_ADDRESS 0xFFF8E90B /end MEASUREMENT
/begin MEASUREMENT Z_GANG_SOLL_SS "" UBYTE _CNV_S_11_Enum_EGANG_74_CM_S2 1 0 1 13 ECU_ADDRESS 0xFFF8E98C /end MEASUREMENT
/begin MEASUREMENT Z_GANG_SOLL_ZKA "" UBYTE _CNV_S_9_Enum_EGANG_21_CM_S2 1 0 0 8 ECU_ADDRESS 0xFFF8EBD0 /end MEASUREMENT
/begin MEASUREMENT Z_GANG_SPA "" UBYTE _CNV_S_9_Enum_EGANG_21_CM_S2 1 0 0 8 ECU_ADDRESS 0xFFF8EB9A /end MEASUREMENT
/begin MEASUREMENT Z_GANG_SPA_FILT "" UBYTE _CNV_S_9_Enum_EGANG_21_CM_S2 1 0 0 8 ECU_ADDRESS 0xFFF8EB9B /end MEASUREMENT
/begin MEASUREMENT Z_GANG_SPA_SKL "" UBYTE _CNV_S_9_Enum_EGANG_21_CM_S2 1 0 0 8 ECU_ADDRESS 0xFFF8EB9C /end MEASUREMENT
/begin MEASUREMENT Z_GANG_SPA_SKL_ALT "" UBYTE _CNV_S_9_Enum_EGANG_21_CM_S2 1 0 0 8 ECU_ADDRESS 0xFFF8EB9D /end MEASUREMENT
/begin MEASUREMENT Z_GANG_SPA_SKL_INIT "" UBYTE _CNV_S_9_Enum_EGANG_21_CM_S2 1 0 0 8 ECU_ADDRESS 0xFFF8EB9E /end MEASUREMENT
/begin MEASUREMENT Z_GANG_SPA_SS "" UBYTE _CNV_S_10_Enum_EGANG_75_CM_S2 1 0 0 9 ECU_ADDRESS 0xFFF8E98D /end MEASUREMENT
/begin MEASUREMENT Z_GANG_SPERRHS_ZKA "" UBYTE _CNV_S_9_Enum_EGANG_21_CM_S2 1 0 0 8 ECU_ADDRESS 0xFFF8EBD1 /end MEASUREMENT
/begin MEASUREMENT Z_GANG_STEPTR_SPORT "" UBYTE _CNV_S_9_Enum_EGANG_21_CM_S2 1 0 0 8 ECU_ADDRESS 0xFFF8E9D8 /end MEASUREMENT
/begin MEASUREMENT Z_GANG_STEPTR_SPORT_ROH "" UBYTE _CNV_S_9_Enum_EGANG_21_CM_S2 1 0 0 8 ECU_ADDRESS 0xFFF8E9D9 /end MEASUREMENT
/begin MEASUREMENT Z_GANG_TEMP_KUP_A "" UBYTE _CNV_S_9_Enum_EGANG_21_CM_S2 1 0 0 8 ECU_ADDRESS 0xFFF8E917 /end MEASUREMENT
/begin MEASUREMENT Z_GANG_TIPP_SPORT "" UBYTE _CNV_S_9_Enum_EGANG_21_CM_S2 1 0 0 8 ECU_ADDRESS 0xFFF8E9DA /end MEASUREMENT
/begin MEASUREMENT Z_GANG_TIPP_SPORT_ALT "" UBYTE _CNV_S_9_Enum_EGANG_21_CM_S2 1 0 0 8 ECU_ADDRESS 0xFFF8E9DB /end MEASUREMENT
/begin MEASUREMENT Z_GANG_VORWAHL "" UBYTE _CNV_S_9_Enum_EGANG_21_CM_S2 1 0 0 8 ECU_ADDRESS 0xFFF8E9DC /end MEASUREMENT
/begin MEASUREMENT Z_GANG_ZIEL "" UBYTE _CNV_S_9_Enum_EGANG_21_CM_S2 1 0 0 8 ECU_ADDRESS 0xFFF8EAEF /end MEASUREMENT
/begin MEASUREMENT Z_GANG_ZIELALT "" UBYTE _CNV_S_9_Enum_EGANG_21_CM_S2 1 0 0 8 ECU_ADDRESS 0xFFF8EB43 /end MEASUREMENT
/begin MEASUREMENT Z_GANG_ZIELALT_BAB "" UBYTE _CNV_S_9_Enum_EGANG_21_CM_S2 1 0 0 8 ECU_ADDRESS 0xFFF8EBF5 /end MEASUREMENT
/begin MEASUREMENT Z_GANG_ZIELALT_DYNHSPV "" UBYTE _CNV_S_9_Enum_EGANG_21_CM_S2 1 0 0 8 ECU_ADDRESS 0xFFF8EB60 /end MEASUREMENT
/begin MEASUREMENT Z_GANG_ZIELALT_FWS "" UBYTE _CNV_S_9_Enum_EGANG_21_CM_S2 1 0 0 8 ECU_ADDRESS 0xFFF8EA56 /end MEASUREMENT
/begin MEASUREMENT Z_GANG_ZIELALT_HSURE "" UBYTE _CNV_S_9_Enum_EGANG_21_CM_S2 1 0 0 8 ECU_ADDRESS 0xFFF8EA7D /end MEASUREMENT
/begin MEASUREMENT Z_GANG_ZIEL_AGS "" UBYTE _CNV_S_9_Enum_EGANG_21_CM_S2 1 0 0 8 ECU_ADDRESS 0xFFF8EAF0 /end MEASUREMENT
/begin MEASUREMENT Z_GANG_ZIEL_AGS_ROH "" UBYTE _CNV_S_11_Enum_EGANG_74_CM_S2 1 0 1 13 ECU_ADDRESS 0xFFF8E970 /end MEASUREMENT
/begin MEASUREMENT Z_GANG_ZIEL_ALT "" UBYTE _CNV_S_9_Enum_EGANG_21_CM_S2 1 0 0 8 ECU_ADDRESS 0xFFF8E9BF /end MEASUREMENT
/begin MEASUREMENT Z_GANG_ZIEL_ANZEIGEGANG "" UBYTE _CNV_S_9_Enum_EGANG_21_CM_S2 1 0 0 8 ECU_ADDRESS 0xFFF8EAF1 /end MEASUREMENT
/begin MEASUREMENT Z_GANG_ZIEL_ANZEIGE_ALT "" UBYTE _CNV_S_9_Enum_EGANG_21_CM_S2 1 0 0 8 ECU_ADDRESS 0xFFF8E929 /end MEASUREMENT
/begin MEASUREMENT Z_GANG_ZIEL_DBM "" UBYTE _CNV_S_9_Enum_EGANG_21_CM_S2 1 0 0 8 ECU_ADDRESS 0xFFF8EAF2 /end MEASUREMENT
/begin MEASUREMENT Z_GANG_ZIEL_DYNDZM "" UBYTE _CNV_S_9_Enum_EGANG_21_CM_S2 1 0 0 8 ECU_ADDRESS 0xFFF8EAF3 /end MEASUREMENT
/begin MEASUREMENT Z_GANG_ZIEL_DYNDZM_ALT "" UBYTE _CNV_S_9_Enum_EGANG_21_CM_S2 1 0 0 8 ECU_ADDRESS 0xFFF8EA34 /end MEASUREMENT
/begin MEASUREMENT Z_GANG_ZIEL_DYNDZM_FREEZE "" UBYTE _CNV_S_9_Enum_EGANG_21_CM_S2 1 0 0 8 ECU_ADDRESS 0xFFF8EA35 /end MEASUREMENT
/begin MEASUREMENT Z_GANG_ZIEL_HSURE "" UBYTE _CNV_S_9_Enum_EGANG_21_CM_S2 1 0 0 8 ECU_ADDRESS 0xFFF8EAF4 /end MEASUREMENT
/begin MEASUREMENT Z_GANG_ZIEL_K0ALT "" UBYTE _CNV_S_9_Enum_EGANG_21_CM_S2 1 0 0 8 ECU_ADDRESS 0xFFF8EB63 /end MEASUREMENT
/begin MEASUREMENT Z_GANG_ZIEL_ROH "" UBYTE _CNV_S_11_Enum_EGANG_74_CM_S2 1 0 1 13 ECU_ADDRESS 0xFFF8E971 /end MEASUREMENT
/begin MEASUREMENT Z_GANG_ZIEL_SKL "" UBYTE _CNV_S_9_Enum_EGANG_21_CM_S2 1 0 0 8 ECU_ADDRESS 0xFFF8EAF5 /end MEASUREMENT
/begin MEASUREMENT Z_GANG_ZIEL_SSTEP "" UBYTE _CNV_S_9_Enum_EGANG_21_CM_S2 1 0 0 8 ECU_ADDRESS 0xFFF8EAF6 /end MEASUREMENT
/begin MEASUREMENT Z_GANG_ZIEL_WK "" UBYTE _CNV_S_9_Enum_EGANG_21_CM_S2 1 0 0 8 ECU_ADDRESS 0xFFF8EAF7 /end MEASUREMENT
/begin MEASUREMENT Z_GANG_ZIEL_ZKA "" UBYTE _CNV_S_9_Enum_EGANG_21_CM_S2 1 0 0 8 ECU_ADDRESS 0xFFF8EAF8 /end MEASUREMENT
/begin MEASUREMENT Z_GANG_ZKA "" UBYTE _CNV_S_9_Enum_EGANG_21_CM_S2 1 0 0 8 ECU_ADDRESS 0xFFF8E910 /end MEASUREMENT
/begin MEASUREMENT Z_GDM_RAD_KOMP "" UBYTE _CNV_S_3_Enum_EGDM__244_CM_S2 1 0 0 2 ECU_ADDRESS 0xFFF8EA9F /end MEASUREMENT
/begin MEASUREMENT Z_GEARREDUCTION "" UBYTE _CNV_S_7_Enum_EGEAR_209_CM_S2 1 0 0 6 ECU_ADDRESS 0xFFF8EAF9 /end MEASUREMENT
/begin MEASUREMENT Z_GEARREDUCTION_ROH "" UBYTE _CNV_S_7_Enum_EGEAR_209_CM_S2 1 0 0 6 ECU_ADDRESS 0xFFF8E972 /end MEASUREMENT
/begin MEASUREMENT Z_GEARS_DBM_MASK "" UBYTE _CNV_R_R_Umr_1_zu_1_2_CM_S2 1 0 0 255 ECU_ADDRESS 0xFFF8E8F7 FORMAT "%2.0" /end MEASUREMENT
/begin MEASUREMENT Z_GEARS_ZKA_MASK "" UBYTE _CNV_R_R_Umr_1_zu_1_2_CM_S2 1 0 0 255 ECU_ADDRESS 0xFFF8EBD2 FORMAT "%2.0" /end MEASUREMENT
/begin MEASUREMENT Z_GWFP_DMRS_AGS "" UBYTE _CNV_S_10_Enum_EDMRS_22_CM_S2 1 0 0 9 ECU_ADDRESS 0xFFF8EA24 /end MEASUREMENT
/begin MEASUREMENT Z_Gang_DDRS_NTMIN "" UBYTE _CNV_S_9_Enum_EGANG_21_CM_S2 1 0 0 8 ECU_ADDRESS 0xFFF8EC07 /end MEASUREMENT
/begin MEASUREMENT Z_HAS_IST "" UBYTE _CNV_S_10_Enum_EHASS_119_CM_S2 1 0 0 15 ECU_ADDRESS 0xFFF8EAC9 /end MEASUREMENT
/begin MEASUREMENT Z_HAS_IST_ROH "" UBYTE _CNV_R_R_Umr_1_zu_1_2_CM_S2 1 0 0 255 ECU_ADDRESS 0xFFF8E948 /end MEASUREMENT
/begin MEASUREMENT Z_HAS_ZIEL "" UBYTE _CNV_S_10_Enum_EHASS_119_CM_S2 1 0 0 15 ECU_ADDRESS 0xFFF8EACA /end MEASUREMENT
/begin MEASUREMENT Z_HAS_ZIEL_ROH "" UBYTE _CNV_R_R_Umr_1_zu_1_2_CM_S2 1 0 0 255 ECU_ADDRESS 0xFFF8E949 /end MEASUREMENT
/begin MEASUREMENT Z_HDC "" UBYTE _CNV_S_8_Enum_EHDC_221_CM_S2 1 0 0 7 ECU_ADDRESS 0xFFF8EAFA /end MEASUREMENT
/begin MEASUREMENT Z_HDC_ROH "" UBYTE _CNV_R_R_Umr_1_zu_1_2_CM_S2 1 0 0 255 ECU_ADDRESS 0xFFF8E973 /end MEASUREMENT
/begin MEASUREMENT Z_HDC_SBE "" UBYTE _CNV_S_4_Enum_EHDC__222_CM_S2 1 0 0 3 ECU_ADDRESS 0xFFF8EAFB /end MEASUREMENT
/begin MEASUREMENT Z_HIENBL_DBM_MASK "" UBYTE _CNV_R_R_Umr_1_zu_1_2_CM_S2 1 0 0 255 ECU_ADDRESS 0xFFF8E8F8 FORMAT "%2.0" /end MEASUREMENT
/begin MEASUREMENT Z_HOTDUE "" UBYTE _CNV_S_3_Enum_EHOTD_137_CM_S2 1 0 0 2 ECU_ADDRESS 0xFFF8E9DD /end MEASUREMENT
/begin MEASUREMENT Z_HOTMODE "" UBYTE _CNV_R_R_Umr_1_zu_1_2_CM_S2 1 0 0 2 ECU_ADDRESS 0xFFF8EAFC FORMAT "%2.0" /end MEASUREMENT
/begin MEASUREMENT Z_HOTMODE_ROH "" UBYTE _CNV_R_R_Umr_1_zu_1_2_CM_S2 1 0 0 255 ECU_ADDRESS 0xFFF8E975 /end MEASUREMENT
/begin MEASUREMENT Z_HSUBED "" UBYTE _CNV_S_8_Enum_EHSUB_104_CM_S2 1 0 0 7 ECU_ADDRESS 0xFFF8EA7E /end MEASUREMENT
/begin MEASUREMENT Z_HSUBEDALT "" UBYTE _CNV_S_8_Enum_EHSUB_104_CM_S2 1 0 0 7 ECU_ADDRESS 0xFFF8E9C0 /end MEASUREMENT
/begin MEASUREMENT Z_HSUKS "" UBYTE _CNV_S_3_Enum_EHSU__112_CM_S2 1 0 0 2 ECU_ADDRESS 0xFFF8EC1B /end MEASUREMENT
/begin MEASUREMENT Z_HSUKS_IDX "" UBYTE _CNV_R_R_Umr_1_zu_1_2_CM_S2 1 0 0 2 ECU_ADDRESS 0xFFF8EC1C FORMAT "%2.0" /end MEASUREMENT
/begin MEASUREMENT Z_HSURESCHLUPF_DECVAL "" UWORD _CNV_R_R_Umr_1_zu_1_2_CM_S2 1 0 0 65535 ECU_ADDRESS 0xFFF8E66E /end MEASUREMENT
/begin MEASUREMENT Z_HSURE_BRS "" UBYTE _CNV_S_3_Enum_EHSUR_113_CM_S2 1 0 0 2 ECU_ADDRESS 0xFFF8EA7A /end MEASUREMENT
/begin MEASUREMENT Z_HSURE_DECVAL "" UWORD _CNV_R_R_Umr_1_zu_1_2_CM_S2 1 0 0 65535 ECU_ADDRESS 0xFFF8E63C FORMAT "%2.0" MATRIX_DIM 13 1 1 /end MEASUREMENT
/begin MEASUREMENT Z_HSURE_DECVAL_KS "" UWORD _CNV_R_R_Umr_1_zu_1_2_CM_S2 1 0 0 255 ECU_ADDRESS 0xFFF8E8AC FORMAT "%2.0" /end MEASUREMENT
/begin MEASUREMENT Z_HSURE_FOF_STAT "" UBYTE _CNV_S_3_Enum_EHSUR_114_CM_S2 1 0 0 2 ECU_ADDRESS 0xFFF8EA82 /end MEASUREMENT
/begin MEASUREMENT Z_HSURE_NL_STAT "" UBYTE _CNV_S_3_Enum_EHSUR_115_CM_S2 1 0 0 2 ECU_ADDRESS 0xFFF8EA8B /end MEASUREMENT
/begin MEASUREMENT Z_HSURE_RESET_MASK "" UWORD _CNV_R_R_Umr_1_zu_1_2_CM_S2 1 0 0 65535 ECU_ADDRESS 0xFFF8E656 FORMAT "%2.0" /end MEASUREMENT
/begin MEASUREMENT Z_HSURE_SCHLUPF "" UBYTE _CNV_S_4_Enum_EHSUR_116_CM_S2 1 0 0 3 ECU_ADDRESS 0xFFF8EA8F /end MEASUREMENT
/begin MEASUREMENT Z_HS_DYN "" UBYTE _CNV_S_4_Enum_EDYN__173_CM_S2 1 0 0 3 ECU_ADDRESS 0xFFF8E9AD /end MEASUREMENT
/begin MEASUREMENT Z_IDXGRBDYN "" UBYTE _CNV_S_16_Enum_EIDXG_169_CM_S2 1 0 0 15 ECU_ADDRESS 0xFFF8EB7A /end MEASUREMENT
/begin MEASUREMENT Z_IDXGRBDYN_SS "" UBYTE _CNV_R_R_Umr_1_zu_1_2_CM_S2 1 0 0 14 ECU_ADDRESS 0xFFF8E98E FORMAT "%2.0" /end MEASUREMENT
/begin MEASUREMENT Z_INFS "" UBYTE _CNV_S_2_Enum_ESTAT_223_CM_S2 1 0 0 1 ECU_ADDRESS 0xFFF8EAE6 /end MEASUREMENT
/begin MEASUREMENT Z_INFS_ROH "" UBYTE _CNV_P_2_A_I_5_CM_S2 1 0 0 255 ECU_ADDRESS 0xFFF8E967 /end MEASUREMENT
/begin MEASUREMENT Z_K0_IST "" UBYTE _CNV_S_6_Enum_EK0_224_CM_S2 1 0 0 5 ECU_ADDRESS 0xFFF8EACB /end MEASUREMENT
/begin MEASUREMENT Z_K0_IST_ROH "" UBYTE _CNV_R_R_Umr_1_zu_1_2_CM_S2 1 0 0 255 ECU_ADDRESS 0xFFF8E94A /end MEASUREMENT
/begin MEASUREMENT Z_K0_SOLL "" UBYTE _CNV_S_12_Enum_EK0_S_76_CM_S2 1 0 0 11 ECU_ADDRESS 0xFFF8E91B /end MEASUREMENT
/begin MEASUREMENT Z_K0_SOLL_SS "" UBYTE _CNV_S_12_Enum_EK0_S_76_CM_S2 1 0 0 11 ECU_ADDRESS 0xFFF8E984 /end MEASUREMENT
/begin MEASUREMENT Z_K0_ZIEL "" UBYTE _CNV_S_6_Enum_EK0_224_CM_S2 1 0 0 5 ECU_ADDRESS 0xFFF8EACC /end MEASUREMENT
/begin MEASUREMENT Z_K0_ZIEL_ROH "" UBYTE _CNV_R_R_Umr_1_zu_1_2_CM_S2 1 0 0 255 ECU_ADDRESS 0xFFF8E94B /end MEASUREMENT
/begin MEASUREMENT Z_KOOP_MASK "" ULONG _CNV_R_R_Umr_1_zu_1_2_CM_S2 1 0 0 4294967295 ECU_ADDRESS 0xFFF8F06C FORMAT "%2.0" /end MEASUREMENT
/begin MEASUREMENT Z_KURVE "" UBYTE _CNV_S_3_Enum_EKURV_249_CM_S2 1 0 0 2 ECU_ADDRESS 0xFFF8EAA9 /end MEASUREMENT
/begin MEASUREMENT Z_KURVETYP_NORMAL "" UBYTE _CNV_S_5_Enum_EKURV_246_CM_S2 1 0 0 4 ECU_ADDRESS 0xFFF8EAAA /end MEASUREMENT
/begin MEASUREMENT Z_KURVE_LDM "" UBYTE _CNV_S_3_Enum_EKURV_249_CM_S2 1 0 0 2 ECU_ADDRESS 0xFFF8EAAB /end MEASUREMENT
/begin MEASUREMENT Z_KURVE_LDMNACHL "" UBYTE _CNV_S_3_Enum_EKURV_249_CM_S2 1 0 0 2 ECU_ADDRESS 0xFFF8EAAC /end MEASUREMENT
/begin MEASUREMENT Z_KURVE_LDMVORL "" UBYTE _CNV_S_3_Enum_EKURV_249_CM_S2 1 0 0 2 ECU_ADDRESS 0xFFF8EAAD /end MEASUREMENT
/begin MEASUREMENT Z_KURVE_NACHL "" UBYTE _CNV_S_3_Enum_EKURV_249_CM_S2 1 0 0 2 ECU_ADDRESS 0xFFF8EAAE /end MEASUREMENT
/begin MEASUREMENT Z_KURVE_VORL "" UBYTE _CNV_S_3_Enum_EKURV_249_CM_S2 1 0 0 2 ECU_ADDRESS 0xFFF8EAAF /end MEASUREMENT
/begin MEASUREMENT Z_LDMBAB_HSURE_IDX "" UBYTE _CNV_S_3_Enum_ELDMA_102_CM_S2 1 0 0 2 ECU_ADDRESS 0xFFF8EA85 /end MEASUREMENT
/begin MEASUREMENT Z_LDMMOD "" UBYTE _CNV_S_7_Enum_ELDMM_65_CM_S2 1 0 0 15 ECU_ADDRESS 0xFFF8EB16 /end MEASUREMENT
/begin MEASUREMENT Z_LDMMOD_ALT "" UBYTE _CNV_S_7_Enum_ELDMM_65_CM_S2 1 0 0 15 ECU_ADDRESS 0xFFF8EB17 /end MEASUREMENT
/begin MEASUREMENT Z_LDMMOD_ROH "" UBYTE _CNV_S_7_Enum_ELDMM_65_CM_S2 1 0 0 15 ECU_ADDRESS 0xFFF8E938 /end MEASUREMENT
/begin MEASUREMENT Z_LDM_DYNAMIC "" UBYTE _CNV_R_R_Umr_1_zu_1_2_CM_S2 1 0 0 15 ECU_ADDRESS 0xFFF8EB18 FORMAT "%2.0" /end MEASUREMENT
/begin MEASUREMENT Z_LDM_DYNAMIC2 "" UBYTE _CNV_S_3_Enum_ELDM__66_CM_S2 1 0 0 2 ECU_ADDRESS 0xFFF8EB19 /end MEASUREMENT
/begin MEASUREMENT Z_LDM_DYNAMIC2_ROH "" UBYTE _CNV_R_R_Umr_1_zu_1_2_CM_S2 1 0 0 1 ECU_ADDRESS 0xFFF8E976 FORMAT "%2.0" /end MEASUREMENT
/begin MEASUREMENT Z_LDM_DYNAMIC_ROH "" UBYTE _CNV_R_R_Umr_1_zu_1_2_CM_S2 1 0 0 15 ECU_ADDRESS 0xFFF8E939 FORMAT "%2.0" /end MEASUREMENT
/begin MEASUREMENT Z_LDM_FFG "" UBYTE _CNV_S_3_Enum_ELDM_61_CM_S2 1 0 0 2 ECU_ADDRESS 0xFFF8E8E2 /end MEASUREMENT
/begin MEASUREMENT Z_LOENBL_DBM_MASK "" UWORD _CNV_R_R_Umr_1_zu_1_2_CM_S2 1 0 0 65535 ECU_ADDRESS 0xFFF8E338 FORMAT "%2.0" /end MEASUREMENT
/begin MEASUREMENT Z_LWVA_EFF_STAT "" UBYTE _CNV_S_3_Enum_eLW_V_225_CM_S2 1 0 0 2 ECU_ADDRESS 0xFFF8EB1B /end MEASUREMENT
/begin MEASUREMENT Z_LWVA_EFF_STAT_ROH "" UBYTE _CNV_R_R_Umr_1_zu_1_2_CM_S2 1 0 0 255 ECU_ADDRESS 0xFFF8E936 /end MEASUREMENT
/begin MEASUREMENT Z_MAXHS_ZKA "" UBYTE _CNV_R_R_Umr_1_zu_1_2_CM_S2 1 0 0 255 ECU_ADDRESS 0xFFF8EBC0 FORMAT "%2.0" /end MEASUREMENT
/begin MEASUREMENT Z_MAXRS_ZKA "" UBYTE _CNV_R_R_Umr_1_zu_1_2_CM_S2 1 0 0 255 ECU_ADDRESS 0xFFF8EBC1 FORMAT "%2.0" /end MEASUREMENT
/begin MEASUREMENT Z_MAX_KRIT_ZKA "" SWORD _CNV_S_5_Enum_EVALI_187_CM_S2 1 0 0 30 ECU_ADDRESS 0xFFF8E838 /end MEASUREMENT
/begin MEASUREMENT Z_MFRSKS_KUP_A_ERK "" UBYTE _CNV_R_R_Umr_1_zu_1_2_CM_S2 1 0 0 2 ECU_ADDRESS 0xFFF8E918 FORMAT "%2.0" /end MEASUREMENT
/begin MEASUREMENT Z_MFRS_BEREICH_ZKA "" UBYTE _CNV_S_7_Enum_EDMRS_188_CM_S2 1 0 0 6 ECU_ADDRESS 0xFFF8EBD3 /end MEASUREMENT
/begin MEASUREMENT Z_MODUS_HYBRID "" UBYTE _CNV_S_4_Enum_EMODU_121_CM_S2 1 0 0 3 ECU_ADDRESS 0xFFF8EA9C /end MEASUREMENT
/begin MEASUREMENT Z_MODUS_HYBRID_ALT "" UBYTE _CNV_S_4_Enum_EMODU_121_CM_S2 1 0 0 3 ECU_ADDRESS 0xFFF8EA9D /end MEASUREMENT
/begin MEASUREMENT Z_MOD_KURVE "" UBYTE _CNV_S_4_Enum_EKURV_247_CM_S2 1 0 0 3 ECU_ADDRESS 0xFFF8EAB0 /end MEASUREMENT
/begin MEASUREMENT Z_MOD_KURVE_HSURE "" UBYTE _CNV_S_4_Enum_EHSUR_105_CM_S2 1 0 0 3 ECU_ADDRESS 0xFFF8EA88 /end MEASUREMENT
/begin MEASUREMENT Z_MOTOR_NOTLAUF "" UBYTE _CNV_S_3_Enum_ENOTL_210_CM_S2 1 0 0 2 ECU_ADDRESS 0xFFF8EAFD /end MEASUREMENT
/begin MEASUREMENT Z_MOTOR_NOTLAUF_ROH "" UBYTE _CNV_S_3_Enum_ENOTL_210_CM_S2 1 0 0 2 ECU_ADDRESS 0xFFF8E977 /end MEASUREMENT
/begin MEASUREMENT Z_MOTSTART_TYP "" UBYTE _CNV_S_5_Enum_EMOTS_226_CM_S2 1 0 0 4 ECU_ADDRESS 0xFFF8EACD /end MEASUREMENT
/begin MEASUREMENT Z_MOTSTART_TYP_ROH "" UBYTE _CNV_R_R_Umr_1_zu_1_2_CM_S2 1 0 0 255 ECU_ADDRESS 0xFFF8E94C FORMAT "%2.0" /end MEASUREMENT
/begin MEASUREMENT Z_MRADSOLL_STABKRI_ZKA "" UBYTE _CNV_R_R_Umr_1_zu_1_2_CM_S2 1 0 0 1 ECU_ADDRESS 0xFFF8EBD4 FORMAT "%2.0" /end MEASUREMENT
/begin MEASUREMENT Z_MRAD_BEGRENZT_ZKA "" UBYTE _CNV_R_R_Umr_1_zu_1_2_CM_S2 1 0 0 255 ECU_ADDRESS 0xFFF8EBC3 FORMAT "%2.0" /end MEASUREMENT
/begin MEASUREMENT Z_MUELOW "" UBYTE _CNV_S_8_Enum_EMUEL_34_CM_S2 1 0 0 7 ECU_ADDRESS 0xFFF8EB44 /end MEASUREMENT
/begin MEASUREMENT Z_MUELOWALT "" UBYTE _CNV_S_8_Enum_EMUEL_34_CM_S2 1 0 0 7 ECU_ADDRESS 0xFFF8EB45 /end MEASUREMENT
/begin MEASUREMENT Z_M_COMPRISE_SS "" UBYTE _CNV_S_3_Enum_ECOMP_77_CM_S2 1 0 0 2 ECU_ADDRESS 0xFFF8E98F /end MEASUREMENT
/begin MEASUREMENT Z_NABHSURERS_FFG "" UBYTE _CNV_S_4_Enum_ENABH_93_CM_S2 1 0 0 3 ECU_ADDRESS 0xFFF8E8E3 /end MEASUREMENT
/begin MEASUREMENT Z_NABNEGATIV "" UBYTE _CNV_S_3_Enum_EV_RI_227_CM_S2 1 0 0 2 ECU_ADDRESS 0xFFF8EAFE /end MEASUREMENT
/begin MEASUREMENT Z_NABNEGATIV_ROH "" UBYTE _CNV_R_R_Umr_1_zu_1_2_CM_S2 1 0 0 255 ECU_ADDRESS 0xFFF8E978 /end MEASUREMENT
/begin MEASUREMENT Z_NIC_IDX "" UBYTE _CNV_S_4_Enum_ENIC__94_CM_S2 1 0 0 3 ECU_ADDRESS 0xFFF8E8E4 /end MEASUREMENT
/begin MEASUREMENT Z_NMOTHSTUPEL_FFG "" UBYTE _CNV_S_5_Enum_ETUPE_23_CM_S2 1 0 0 4 ECU_ADDRESS 0xFFF8E8E5 /end MEASUREMENT
/begin MEASUREMENT Z_POS "" UBYTE _CNV_S_8_Enum_EPOS_24_CM_S2 1 0 0 7 ECU_ADDRESS 0xFFF8EAFF /end MEASUREMENT
/begin MEASUREMENT Z_POS_AGS "" UBYTE _CNV_S_4_Enum_EPOSA_29_CM_S2 1 0 0 3 ECU_ADDRESS 0xFFF8EB00 /end MEASUREMENT
/begin MEASUREMENT Z_POS_BDLENB "" UBYTE _CNV_S_4_Enum_EPOSB_95_CM_S2 1 0 0 3 ECU_ADDRESS 0xFFF8E8E6 /end MEASUREMENT
/begin MEASUREMENT Z_POS_ROH "" UBYTE _CNV_R_R_Umr_1_zu_1_2_CM_S2 1 0 0 255 ECU_ADDRESS 0xFFF8E979 /end MEASUREMENT
/begin MEASUREMENT Z_POS_STAT_ROH "" UBYTE _CNV_S_3_Enum_EPOSS_211_CM_S2 1 0 0 2 ECU_ADDRESS 0xFFF8E97A /end MEASUREMENT
/begin MEASUREMENT Z_POWERSWITCH "" UBYTE _CNV_S_4_Enum_EPOWE_87_CM_S2 1 0 0 3 ECU_ADDRESS 0xFFF8EB01 /end MEASUREMENT
/begin MEASUREMENT Z_PRISQ_IDX "" UBYTE _CNV_S_100_Enum_EPRIS_25_CM_S2 1 0 0 99 ECU_ADDRESS 0xFFF8EC54 MATRIX_DIM 100 1 1 /end MEASUREMENT
/begin MEASUREMENT Z_PRISQ_IDX_DBM "" SBYTE _CNV_S_10_Enum_EDBMT_254_CM_S2 1 0 0 9 ECU_ADDRESS 0xFFF8E33A MATRIX_DIM 2 1 1 /end MEASUREMENT
/begin MEASUREMENT Z_PRISQ_IDX_MAXEXC_DBM "" SBYTE _CNV_S_10_Enum_EDBMT_254_CM_S2 1 0 0 9 ECU_ADDRESS 0xFFF8E8F9 /end MEASUREMENT
/begin MEASUREMENT Z_PRISQ_IDX_MINEXC_DBM "" SBYTE _CNV_S_10_Enum_EDBMT_254_CM_S2 1 0 0 9 ECU_ADDRESS 0xFFF8E8FA /end MEASUREMENT
/begin MEASUREMENT Z_PRISQ_IDX_ZKA "" SBYTE _CNV_S_6_Enum_EZKAT_189_CM_S2 1 0 -1 4 ECU_ADDRESS 0xFFF8EBD5 MATRIX_DIM 5 1 1 /end MEASUREMENT
/begin MEASUREMENT Z_PRISQ_MOTZKA "" UBYTE _CNV_R_R_Umr_1_zu_1_2_CM_S2 1 0 0 14 ECU_ADDRESS 0xFFF8E8E7 FORMAT "%2.0" /end MEASUREMENT
/begin MEASUREMENT Z_PRISQ_PRIOIDX "" UBYTE _CNV_S_100_Enum_EPRIS_25_CM_S2 1 0 0 99 ECU_ADDRESS 0xFFF8E8E8 /end MEASUREMENT
/begin MEASUREMENT Z_PRISQ_SPA_PRIOIDX "" UBYTE _CNV_S_15_Enum_EPRIS_274_CM_S2 1 0 0 14 ECU_ADDRESS 0xFFF8EB9F /end MEASUREMENT
/begin MEASUREMENT Z_PROGINF_AZG "" UBYTE _CNV_S_4_Enum_EKOMB_78_CM_S2 1 0 0 3 ECU_ADDRESS 0xFFF8E92A /end MEASUREMENT
/begin MEASUREMENT Z_PROGINF_AZG_ALT "" UBYTE _CNV_S_4_Enum_EKOMB_78_CM_S2 1 0 0 3 ECU_ADDRESS 0xFFF8E92B /end MEASUREMENT
/begin MEASUREMENT Z_PROGINF_AZG_SS "" UBYTE _CNV_S_4_Enum_EKOMB_78_CM_S2 1 0 0 3 ECU_ADDRESS 0xFFF8E992 /end MEASUREMENT
/begin MEASUREMENT Z_PROG_DS2 "" UBYTE _CNV_S_16_Enum_EPROG_79_CM_S2 1 0 0 15 ECU_ADDRESS 0xFFF8E8E9 /end MEASUREMENT
/begin MEASUREMENT Z_PROG_DS2_SS "" UBYTE _CNV_S_16_Enum_EPROG_79_CM_S2 1 0 0 15 ECU_ADDRESS 0xFFF8E993 /end MEASUREMENT
/begin MEASUREMENT Z_PROG_FFG "" UBYTE _CNV_S_21_Enum_EPROG_27_CM_S2 1 0 0 20 ECU_ADDRESS 0xFFF8E8EA /end MEASUREMENT
/begin MEASUREMENT Z_PROG_FFGALT "" UBYTE _CNV_S_21_Enum_EPROG_27_CM_S2 1 0 0 20 ECU_ADDRESS 0xFFF8E8EB /end MEASUREMENT
/begin MEASUREMENT Z_PROG_FT "" UBYTE _CNV_S_4_Enum_EPROG_55_CM_S2 1 0 0 3 ECU_ADDRESS 0xFFF8EC00 /end MEASUREMENT
/begin MEASUREMENT Z_PROG_FT_MAX "" UBYTE _CNV_S_4_Enum_EPROG_55_CM_S2 1 0 0 3 ECU_ADDRESS 0xFFF8EC01 /end MEASUREMENT
/begin MEASUREMENT Z_PROG_HDMABFWSDOWN "" UBYTE _CNV_S_6_Enum_EBERG_47_CM_S2 1 0 0 5 ECU_ADDRESS 0xFFF8E9FE /end MEASUREMENT
/begin MEASUREMENT Z_PROG_HDMABFWSDOWNOLD "" UBYTE _CNV_S_6_Enum_EBERG_47_CM_S2 1 0 0 5 ECU_ADDRESS 0xFFF8E9FF /end MEASUREMENT
/begin MEASUREMENT Z_PROG_HDMABFWSUP "" UBYTE _CNV_S_6_Enum_EBERG_47_CM_S2 1 0 0 5 ECU_ADDRESS 0xFFF8EA00 /end MEASUREMENT
/begin MEASUREMENT Z_PROG_MODE "" UBYTE _CNV_S_4_Enum_EPROG_26_CM_S2 1 0 0 3 ECU_ADDRESS 0xFFF8EB02 /end MEASUREMENT
/begin MEASUREMENT Z_PROG_MODEALT "" UBYTE _CNV_S_4_Enum_EPROG_26_CM_S2 1 0 0 3 ECU_ADDRESS 0xFFF8E9C1 /end MEASUREMENT
/begin MEASUREMENT Z_PROG_MODE_ROH "" UBYTE _CNV_S_4_Enum_EPROG_26_CM_S2 1 0 0 3 ECU_ADDRESS 0xFFF8E97B /end MEASUREMENT
/begin MEASUREMENT Z_PROG_SPA "" UBYTE _CNV_S_21_Enum_EPROG_27_CM_S2 1 0 0 20 ECU_ADDRESS 0xFFF8EBA0 /end MEASUREMENT
/begin MEASUREMENT Z_PRUEFBEREICH "" UBYTE _CNV_S_7_Enum_EDMRS_188_CM_S2 1 0 0 6 ECU_ADDRESS 0xFFF8EA25 /end MEASUREMENT
/begin MEASUREMENT Z_PRUEFBEREICH_EIN "" UBYTE _CNV_S_7_Enum_EDMRS_188_CM_S2 1 0 0 6 ECU_ADDRESS 0xFFF8EA26 /end MEASUREMENT
/begin MEASUREMENT Z_QSHIFT_XIDX "" UBYTE _CNV_S_42_Enum_EQSHI_164_CM_S2 1 0 0 41 ECU_ADDRESS 0xFFF8EB7B /end MEASUREMENT
/begin MEASUREMENT Z_QSHIFT_YIDX "" UBYTE _CNV_R_R_Umr_1_zu_1_2_CM_S2 1 0 0 19 ECU_ADDRESS 0xFFF8EB7C FORMAT "%2.0" /end MEASUREMENT
/begin MEASUREMENT Z_REG_ABS "" UBYTE _CNV_S_3_Enum_EABSS_228_CM_S2 1 0 0 2 ECU_ADDRESS 0xFFF8EB03 /end MEASUREMENT
/begin MEASUREMENT Z_REG_ABS_ROH "" UBYTE _CNV_R_R_Umr_1_zu_1_2_CM_S2 1 0 0 255 ECU_ADDRESS 0xFFF8E97C /end MEASUREMENT
/begin MEASUREMENT Z_REKUP_IDX_ALT_DBM "" UBYTE _CNV_S_5_Enum_REKUP_257_CM_S2 1 0 0 4 ECU_ADDRESS 0xFFF8E8FB /end MEASUREMENT
/begin MEASUREMENT Z_REKUP_IDX_DBM "" UBYTE _CNV_S_5_Enum_REKUP_257_CM_S2 1 0 0 4 ECU_ADDRESS 0xFFF8E8FC /end MEASUREMENT
/begin MEASUREMENT Z_RESET_GLOBAL "" UBYTE _CNV_R_R_Umr_1_zu_1_2_CM_S2 1 0 0 255 ECU_ADDRESS 0xFFF8EA7F FORMAT "%2.0" /end MEASUREMENT
/begin MEASUREMENT Z_RESET_HSURE_SCHLUPF "" UBYTE _CNV_R_R_Umr_1_zu_1_2_CM_S2 1 0 0 255 ECU_ADDRESS 0xFFF8EA80 FORMAT "%2.0" /end MEASUREMENT
/begin MEASUREMENT Z_RFWS_STATE_DBM "" UBYTE _CNV_R_R_Umr_1_zu_1_2_CM_S2 1 0 0 1 ECU_ADDRESS 0xFFF8E8FD FORMAT "%2.0" /end MEASUREMENT
/begin MEASUREMENT Z_RS_DYN "" UBYTE _CNV_S_4_Enum_EDYN__174_CM_S2 1 0 0 3 ECU_ADDRESS 0xFFF8E9AE /end MEASUREMENT
/begin MEASUREMENT Z_SCHALTDYN "" UBYTE _CNV_S_7_Enum_ESDYN_175_CM_S2 1 0 0 6 ECU_ADDRESS 0xFFF8E9B2 /end MEASUREMENT
/begin MEASUREMENT Z_SCHALTDYN_ALT "" UBYTE _CNV_S_7_Enum_ESDYN_175_CM_S2 1 0 0 6 ECU_ADDRESS 0xFFF8E9B3 /end MEASUREMENT
/begin MEASUREMENT Z_SCHALTDYN_ENBL "" UBYTE _CNV_S_7_Enum_ESDYN_175_CM_S2 1 0 0 6 ECU_ADDRESS 0xFFF8EB7D /end MEASUREMENT
/begin MEASUREMENT Z_SCHALTUNGSTYP "" UBYTE _CNV_S_4_Enum_ESCHA_151_R_CM_S2 1 0 0 4 ECU_ADDRESS 0xFFF8E91C /end MEASUREMENT
/begin MEASUREMENT Z_SCHALTUNGSTYP_SPA "" UBYTE _CNV_S_3_Enum_EST_S_275_CM_S2 1 0 0 2 ECU_ADDRESS 0xFFF8EBA1 /end MEASUREMENT
/begin MEASUREMENT Z_SCHLEPP_KURVEBEW "" UBYTE _CNV_S_3_Enum_ESCHL_57_CM_S2 1 0 0 2 ECU_ADDRESS 0xFFF8EC05 /end MEASUREMENT
/begin MEASUREMENT Z_SCHLUPF_ANTRIEB_RL "" UBYTE _CNV_S_3_Enum_ESCHL_28_CM_S2 1 0 0 2 ECU_ADDRESS 0xFFF8EB7E /end MEASUREMENT
/begin MEASUREMENT Z_SCHLUPF_ANTRIEB_RR "" UBYTE _CNV_S_3_Enum_ESCHL_28_CM_S2 1 0 0 2 ECU_ADDRESS 0xFFF8EB7F /end MEASUREMENT
/begin MEASUREMENT Z_SCHLUPF_HL "" UBYTE _CNV_S_3_Enum_ESCHL_28_CM_S2 1 0 0 2 ECU_ADDRESS 0xFFF8EB80 /end MEASUREMENT
/begin MEASUREMENT Z_SCHLUPF_HR "" UBYTE _CNV_S_3_Enum_ESCHL_28_CM_S2 1 0 0 2 ECU_ADDRESS 0xFFF8EB81 /end MEASUREMENT
/begin MEASUREMENT Z_SCHLUPF_VL "" UBYTE _CNV_S_3_Enum_ESCHL_28_CM_S2 1 0 0 2 ECU_ADDRESS 0xFFF8EB82 /end MEASUREMENT
/begin MEASUREMENT Z_SCHLUPF_VR "" UBYTE _CNV_S_3_Enum_ESCHL_28_CM_S2 1 0 0 2 ECU_ADDRESS 0xFFF8EB83 /end MEASUREMENT
/begin MEASUREMENT Z_SCHUB_ERK_DBM "" UBYTE _CNV_R_R_Umr_1_zu_1_2_CM_S2 1 0 0 1 ECU_ADDRESS 0xFFF8E8FE FORMAT "%2.0" /end MEASUREMENT
/begin MEASUREMENT Z_SCHUB_ERK_ZKA "" UBYTE _CNV_R_R_Umr_1_zu_1_2_CM_S2 1 0 0 1 ECU_ADDRESS 0xFFF8EBDA FORMAT "%2.0" /end MEASUREMENT
/begin MEASUREMENT Z_SEQUENZER "" UBYTE _CNV_S_4_Enum_ESEQU_35_CM_S2 1 0 0 3 ECU_ADDRESS 0xFFF8EB46 /end MEASUREMENT
/begin MEASUREMENT Z_SERAP_ASRS_ROH "" UBYTE _CNV_P_2_A_I_5_CM_S2 1 0 0 255 ECU_ADDRESS 0xFFF8E97D /end MEASUREMENT
/begin MEASUREMENT Z_SERP "" UBYTE _CNV_S_3_Enum_EKURV_249_CM_S2 1 0 0 2 ECU_ADDRESS 0xFFF8EAB1 /end MEASUREMENT
/begin MEASUREMENT Z_SERPALT "" UBYTE _CNV_S_3_Enum_EKURV_249_CM_S2 1 0 0 2 ECU_ADDRESS 0xFFF8EAB2 /end MEASUREMENT
/begin MEASUREMENT Z_SERP_CLEAREINSTIEG "" UBYTE _CNV_P_2_A_I_5_CM_S2 1 0 0 255 ECU_ADDRESS 0xFFF8EA01 /end MEASUREMENT
/begin MEASUREMENT Z_SERP_SETEINSTIEG "" UBYTE _CNV_P_2_A_I_5_CM_S2 1 0 0 255 ECU_ADDRESS 0xFFF8EAB3 /end MEASUREMENT
/begin MEASUREMENT Z_SOC "" UWORD _CNV_R_R_Umr_1_zu_1_30_CM_S2 1 0 0 100 ECU_ADDRESS 0xFFF8E6A8 FORMAT "%2.0" /end MEASUREMENT
/begin MEASUREMENT Z_SOC_ROH "" UBYTE _CNV_R_R_Umr_1_zu_1_2_CM_S2 1 0 0 255 ECU_ADDRESS 0xFFF8E94D /end MEASUREMENT
/begin MEASUREMENT Z_SPA_DUNKELGANG_MASK "" UBYTE _CNV_R_R_Umr_1_zu_1_2_CM_S2 1 0 0 255 ECU_ADDRESS 0xFFF8EBA2 /end MEASUREMENT
/begin MEASUREMENT Z_STARTLM_STATE "" UBYTE _CNV_S_7_Enum_ESTAR_200_CM_S2 1 0 0 6 ECU_ADDRESS 0xFFF8EB20 /end MEASUREMENT
/begin MEASUREMENT Z_STATUS_ANTRIEB_FZG "" UBYTE _CNV_R_R_Umr_1_zu_1_2_CM_S2 1 0 0 255 ECU_ADDRESS 0xFFF8EAEB /end MEASUREMENT
/begin MEASUREMENT Z_STATUS_ANTRIEB_FZG_BAB "" UBYTE _CNV_R_R_Umr_1_zu_1_2_CM_S2 1 0 0 255 ECU_ADDRESS 0xFFF8EBE4 /end MEASUREMENT
/begin MEASUREMENT Z_STATUS_ANTRIEB_FZG_ROH "" UBYTE _CNV_R_R_Umr_1_zu_1_2_CM_S2 1 0 0 255 ECU_ADDRESS 0xFFF8E96C /end MEASUREMENT
/begin MEASUREMENT Z_STEPTRONIC_INIT "" UBYTE _CNV_S_2_Schalter_A_4_CM_S2 1 0 0 1 ECU_ADDRESS 0xFFF8E9DE /end MEASUREMENT
/begin MEASUREMENT Z_T_GRADIENT_DYNDZM "" UBYTE _CNV_R_R_Umr_1_zu_1_2_CM_S2 1 0 0 3 ECU_ADDRESS 0xFFF8EA36 FORMAT "%2.0" /end MEASUREMENT
/begin MEASUREMENT Z_T_PRUEF1_VALIDFWS "" UBYTE _CNV_R_R_Umr_1_zu_1_2_CM_S2 1 0 0 1 ECU_ADDRESS 0xFFF8EA57 /end MEASUREMENT
/begin MEASUREMENT Z_T_PRUEF2_VALIDFWS "" UBYTE _CNV_R_R_Umr_1_zu_1_2_CM_S2 1 0 0 2 ECU_ADDRESS 0xFFF8EA58 /end MEASUREMENT
/begin MEASUREMENT Z_T_WARTEZEIT_DYNDZM "" UBYTE _CNV_R_R_Umr_1_zu_1_2_CM_S2 1 0 0 3 ECU_ADDRESS 0xFFF8EA37 FORMAT "%2.0" /end MEASUREMENT
/begin MEASUREMENT Z_VFZG_STABKRI_ZKA "" UBYTE _CNV_R_R_Umr_1_zu_1_8_CM_S2 1 0 0 1 ECU_ADDRESS 0xFFF8EBDB FORMAT "%2.0" /end MEASUREMENT
/begin MEASUREMENT Z_WARMLAUF "" UBYTE _CNV_S_3_Enum_EWARM_229_CM_S2 1 0 0 2 ECU_ADDRESS 0xFFF8EB05 /end MEASUREMENT
/begin MEASUREMENT Z_WARMLAUF_ROH "" UBYTE _CNV_R_R_Umr_1_zu_1_2_CM_S2 1 0 0 255 ECU_ADDRESS 0xFFF8E97E /end MEASUREMENT
/begin MEASUREMENT Z_WDK_UEBERTRETEN "" UBYTE _CNV_P_2_A_I_5_CM_S2 1 0 0 255 ECU_ADDRESS 0xFFF8EB1A /end MEASUREMENT
/begin MEASUREMENT Z_WKANBIND_DYN "" UBYTE _CNV_S_2_Enum_EDYN__176_CM_S2 1 0 0 1 ECU_ADDRESS 0xFFF8E9B4 /end MEASUREMENT
/begin MEASUREMENT Z_WKSOLL_IDX "" UBYTE _CNV_S_2_Enum_EWKAN_162_CM_S2 1 0 0 1 ECU_ADDRESS 0xFFF8E9B5 /end MEASUREMENT
/begin MEASUREMENT Z_WK_IST "" UBYTE _CNV_S_3_Enum_EWK_128_CM_S2 1 0 0 2 ECU_ADDRESS 0xFFF8EB06 /end MEASUREMENT
/begin MEASUREMENT Z_WK_SOLL "" UBYTE _CNV_S_3_Enum_EWK_128_CM_S2 1 0 0 2 ECU_ADDRESS 0xFFF8E9B6 /end MEASUREMENT
/begin MEASUREMENT Z_WK_ZIEL "" UBYTE _CNV_S_3_Enum_EWK_128_CM_S2 1 0 0 2 ECU_ADDRESS 0xFFF8EB07 /end MEASUREMENT
/begin MEASUREMENT Z_ZKAIDX_MAX_DBM "" UBYTE _CNV_R_R_Umr_1_zu_1_2_CM_S2 1 0 0 9 ECU_ADDRESS 0xFFF8E8EC FORMAT "%2.0" /end MEASUREMENT
/begin MEASUREMENT Z_ZKAIDX_MIN_DBM "" UBYTE _CNV_R_R_Umr_1_zu_1_2_CM_S2 1 0 0 9 ECU_ADDRESS 0xFFF8E8ED FORMAT "%2.0" /end MEASUREMENT
/begin MEASUREMENT Z_ZKAIDX_SCHUB_ZKA "" UBYTE _CNV_R_R_Umr_1_zu_1_2_CM_S2 1 0 0 9 ECU_ADDRESS 0xFFF8E8EE FORMAT "%2.0" /end MEASUREMENT
/begin MEASUREMENT Z_ZKAIDX_ZUG_ZKA "" UBYTE _CNV_R_R_Umr_1_zu_1_2_CM_S2 1 0 0 9 ECU_ADDRESS 0xFFF8E8EF FORMAT "%2.0" /end MEASUREMENT
/begin MEASUREMENT Z_ZKA_IDX_SS "" UBYTE _CNV_R_R_Umr_1_zu_1_2_CM_S2 1 0 0 255 ECU_ADDRESS 0xFFF8E990 /end MEASUREMENT
/begin MEASUREMENT cCC_ID._.f_CC_DrvExpectsP "Additional flag for ID_ParkLockFault_IEP_On" UBYTE SBW_STANDARD_S1_S3 1 100 0 1 BIT_MASK 0x1 ECU_ADDRESS 0xFFF85003 DISPLAY_IDENTIFIER f_CC_DrvExpectsP._.cCC_ID /end MEASUREMENT
/begin MEASUREMENT cID_ParkLockFault_IEP_On._.f_IgnOn_Old "Igniiton Old Value in 50ms Cycle" UBYTE SBW_STANDARD_S1_S3 1 100 0 1 BIT_MASK 0x1 ECU_ADDRESS 0xFFF85004 DISPLAY_IDENTIFIER f_IgnOn_Old._.cID_ParkLockFault_IEP_On /end MEASUREMENT
/begin MEASUREMENT defaultgang "Defaultgang" SBYTE UMR___1_1_0_S5_S3 1 100 -1 8 ECU_ADDRESS 0xFFF84FFA /end MEASUREMENT
/begin MEASUREMENT di_err_deb[0] "debounced errors (bitcoded) [0 .. 16-1]" UWORD EH_STANDARD_S4_S3 1 100 0 65535 ECU_ADDRESS 0xFFF8A7B4 /end MEASUREMENT
/begin MEASUREMENT di_err_deb[10] "debounced errors (bitcoded) [0 .. 16-1]" UWORD EH_STANDARD_S4_S3 1 100 0 65535 ECU_ADDRESS 0xFFF8A7C8 /end MEASUREMENT
/begin MEASUREMENT di_err_deb[11] "debounced errors (bitcoded) [0 .. 16-1]" UWORD EH_STANDARD_S4_S3 1 100 0 65535 ECU_ADDRESS 0xFFF8A7CA /end MEASUREMENT
/begin MEASUREMENT di_err_deb[12] "debounced errors (bitcoded) [0 .. 16-1]" UWORD EH_STANDARD_S4_S3 1 100 0 65535 ECU_ADDRESS 0xFFF8A7CC /end MEASUREMENT
/begin MEASUREMENT di_err_deb[13] "debounced errors (bitcoded) [0 .. 16-1]" UWORD EH_STANDARD_S4_S3 1 100 0 65535 ECU_ADDRESS 0xFFF8A7CE /end MEASUREMENT
/begin MEASUREMENT di_err_deb[14] "debounced errors (bitcoded) [0 .. 16-1]" UWORD EH_STANDARD_S4_S3 1 100 0 65535 ECU_ADDRESS 0xFFF8A7D0 /end MEASUREMENT
/begin MEASUREMENT di_err_deb[15] "debounced errors (bitcoded) [0 .. 16-1]" UWORD EH_STANDARD_S4_S3 1 100 0 65535 ECU_ADDRESS 0xFFF8A7D2 /end MEASUREMENT
/begin MEASUREMENT di_err_deb[1] "debounced errors (bitcoded) [0 .. 16-1]" UWORD EH_STANDARD_S4_S3 1 100 0 65535 ECU_ADDRESS 0xFFF8A7B6 /end MEASUREMENT
/begin MEASUREMENT di_err_deb[2] "debounced errors (bitcoded) [0 .. 16-1]" UWORD EH_STANDARD_S4_S3 1 100 0 65535 ECU_ADDRESS 0xFFF8A7B8 /end MEASUREMENT
/begin MEASUREMENT di_err_deb[3] "debounced errors (bitcoded) [0 .. 16-1]" UWORD EH_STANDARD_S4_S3 1 100 0 65535 ECU_ADDRESS 0xFFF8A7BA /end MEASUREMENT
/begin MEASUREMENT di_err_deb[4] "debounced errors (bitcoded) [0 .. 16-1]" UWORD EH_STANDARD_S4_S3 1 100 0 65535 ECU_ADDRESS 0xFFF8A7BC /end MEASUREMENT
/begin MEASUREMENT di_err_deb[5] "debounced errors (bitcoded) [0 .. 16-1]" UWORD EH_STANDARD_S4_S3 1 100 0 65535 ECU_ADDRESS 0xFFF8A7BE /end MEASUREMENT
/begin MEASUREMENT di_err_deb[6] "debounced errors (bitcoded) [0 .. 16-1]" UWORD EH_STANDARD_S4_S3 1 100 0 65535 ECU_ADDRESS 0xFFF8A7C0 /end MEASUREMENT
/begin MEASUREMENT di_err_deb[7] "debounced errors (bitcoded) [0 .. 16-1]" UWORD EH_STANDARD_S4_S3 1 100 0 65535 ECU_ADDRESS 0xFFF8A7C2 /end MEASUREMENT
/begin MEASUREMENT di_err_deb[8] "debounced errors (bitcoded) [0 .. 16-1]" UWORD EH_STANDARD_S4_S3 1 100 0 65535 ECU_ADDRESS 0xFFF8A7C4 /end MEASUREMENT
/begin MEASUREMENT di_err_deb[9] "debounced errors (bitcoded) [0 .. 16-1]" UWORD EH_STANDARD_S4_S3 1 100 0 65535 ECU_ADDRESS 0xFFF8A7C6 /end MEASUREMENT
/begin MEASUREMENT di_err_det[0] "detected active errors (bitcoded) [0 .. 16-1]" UWORD EH_STANDARD_S4_S3 1 100 0 65535 ECU_ADDRESS 0xFFF8A794 /end MEASUREMENT
/begin MEASUREMENT di_err_det[10] "detected active errors (bitcoded) [0 .. 16-1]" UWORD EH_STANDARD_S4_S3 1 100 0 65535 ECU_ADDRESS 0xFFF8A7A8 /end MEASUREMENT
/begin MEASUREMENT di_err_det[11] "detected active errors (bitcoded) [0 .. 16-1]" UWORD EH_STANDARD_S4_S3 1 100 0 65535 ECU_ADDRESS 0xFFF8A7AA /end MEASUREMENT
/begin MEASUREMENT di_err_det[12] "detected active errors (bitcoded) [0 .. 16-1]" UWORD EH_STANDARD_S4_S3 1 100 0 65535 ECU_ADDRESS 0xFFF8A7AC /end MEASUREMENT
/begin MEASUREMENT di_err_det[13] "detected active errors (bitcoded) [0 .. 16-1]" UWORD EH_STANDARD_S4_S3 1 100 0 65535 ECU_ADDRESS 0xFFF8A7AE /end MEASUREMENT
/begin MEASUREMENT di_err_det[14] "detected active errors (bitcoded) [0 .. 16-1]" UWORD EH_STANDARD_S4_S3 1 100 0 65535 ECU_ADDRESS 0xFFF8A7B0 /end MEASUREMENT
/begin MEASUREMENT di_err_det[15] "detected active errors (bitcoded) [0 .. 16-1]" UWORD EH_STANDARD_S4_S3 1 100 0 65535 ECU_ADDRESS 0xFFF8A7B2 /end MEASUREMENT
/begin MEASUREMENT di_err_det[1] "detected active errors (bitcoded) [0 .. 16-1]" UWORD EH_STANDARD_S4_S3 1 100 0 65535 ECU_ADDRESS 0xFFF8A796 /end MEASUREMENT
/begin MEASUREMENT di_err_det[2] "detected active errors (bitcoded) [0 .. 16-1]" UWORD EH_STANDARD_S4_S3 1 100 0 65535 ECU_ADDRESS 0xFFF8A798 /end MEASUREMENT
/begin MEASUREMENT di_err_det[3] "detected active errors (bitcoded) [0 .. 16-1]" UWORD EH_STANDARD_S4_S3 1 100 0 65535 ECU_ADDRESS 0xFFF8A79A /end MEASUREMENT
/begin MEASUREMENT di_err_det[4] "detected active errors (bitcoded) [0 .. 16-1]" UWORD EH_STANDARD_S4_S3 1 100 0 65535 ECU_ADDRESS 0xFFF8A79C /end MEASUREMENT
/begin MEASUREMENT di_err_det[5] "detected active errors (bitcoded) [0 .. 16-1]" UWORD EH_STANDARD_S4_S3 1 100 0 65535 ECU_ADDRESS 0xFFF8A79E /end MEASUREMENT
/begin MEASUREMENT di_err_det[6] "detected active errors (bitcoded) [0 .. 16-1]" UWORD EH_STANDARD_S4_S3 1 100 0 65535 ECU_ADDRESS 0xFFF8A7A0 /end MEASUREMENT
/begin MEASUREMENT di_err_det[7] "detected active errors (bitcoded) [0 .. 16-1]" UWORD EH_STANDARD_S4_S3 1 100 0 65535 ECU_ADDRESS 0xFFF8A7A2 /end MEASUREMENT
/begin MEASUREMENT di_err_det[8] "detected active errors (bitcoded) [0 .. 16-1]" UWORD EH_STANDARD_S4_S3 1 100 0 65535 ECU_ADDRESS 0xFFF8A7A4 /end MEASUREMENT
/begin MEASUREMENT di_err_det[9] "detected active errors (bitcoded) [0 .. 16-1]" UWORD EH_STANDARD_S4_S3 1 100 0 65535 ECU_ADDRESS 0xFFF8A7A6 /end MEASUREMENT
/begin MEASUREMENT di_err_state_info[0] "status word of error code [0 .. 254-1]" UWORD EH_STANDARD_S4_S3 1 100 0 65535 ECU_ADDRESS 0xFFF8A394 /end MEASUREMENT
/begin MEASUREMENT di_err_state_info[100] "status word of error code [0 .. 254-1]" UWORD EH_STANDARD_S4_S3 1 100 0 65535 ECU_ADDRESS 0xFFF8A45C /end MEASUREMENT
/begin MEASUREMENT di_err_state_info[101] "status word of error code [0 .. 254-1]" UWORD EH_STANDARD_S4_S3 1 100 0 65535 ECU_ADDRESS 0xFFF8A45E /end MEASUREMENT
/begin MEASUREMENT di_err_state_info[102] "status word of error code [0 .. 254-1]" UWORD EH_STANDARD_S4_S3 1 100 0 65535 ECU_ADDRESS 0xFFF8A460 /end MEASUREMENT
/begin MEASUREMENT di_err_state_info[103] "status word of error code [0 .. 254-1]" UWORD EH_STANDARD_S4_S3 1 100 0 65535 ECU_ADDRESS 0xFFF8A462 /end MEASUREMENT
/begin MEASUREMENT di_err_state_info[104] "status word of error code [0 .. 254-1]" UWORD EH_STANDARD_S4_S3 1 100 0 65535 ECU_ADDRESS 0xFFF8A464 /end MEASUREMENT
/begin MEASUREMENT di_err_state_info[105] "status word of error code [0 .. 254-1]" UWORD EH_STANDARD_S4_S3 1 100 0 65535 ECU_ADDRESS 0xFFF8A466 /end MEASUREMENT
/begin MEASUREMENT di_err_state_info[106] "status word of error code [0 .. 254-1]" UWORD EH_STANDARD_S4_S3 1 100 0 65535 ECU_ADDRESS 0xFFF8A468 /end MEASUREMENT
/begin MEASUREMENT di_err_state_info[107] "status word of error code [0 .. 254-1]" UWORD EH_STANDARD_S4_S3 1 100 0 65535 ECU_ADDRESS 0xFFF8A46A /end MEASUREMENT
/begin MEASUREMENT di_err_state_info[108] "status word of error code [0 .. 254-1]" UWORD EH_STANDARD_S4_S3 1 100 0 65535 ECU_ADDRESS 0xFFF8A46C /end MEASUREMENT
/begin MEASUREMENT di_err_state_info[109] "status word of error code [0 .. 254-1]" UWORD EH_STANDARD_S4_S3 1 100 0 65535 ECU_ADDRESS 0xFFF8A46E /end MEASUREMENT
/begin MEASUREMENT di_err_state_info[10] "status word of error code [0 .. 254-1]" UWORD EH_STANDARD_S4_S3 1 100 0 65535 ECU_ADDRESS 0xFFF8A3A8 /end MEASUREMENT
/begin MEASUREMENT di_err_state_info[110] "status word of error code [0 .. 254-1]" UWORD EH_STANDARD_S4_S3 1 100 0 65535 ECU_ADDRESS 0xFFF8A470 /end MEASUREMENT
/begin MEASUREMENT di_err_state_info[111] "status word of error code [0 .. 254-1]" UWORD EH_STANDARD_S4_S3 1 100 0 65535 ECU_ADDRESS 0xFFF8A472 /end MEASUREMENT
/begin MEASUREMENT di_err_state_info[112] "status word of error code [0 .. 254-1]" UWORD EH_STANDARD_S4_S3 1 100 0 65535 ECU_ADDRESS 0xFFF8A474 /end MEASUREMENT
/begin MEASUREMENT di_err_state_info[113] "status word of error code [0 .. 254-1]" UWORD EH_STANDARD_S4_S3 1 100 0 65535 ECU_ADDRESS 0xFFF8A476 /end MEASUREMENT
/begin MEASUREMENT di_err_state_info[114] "status word of error code [0 .. 254-1]" UWORD EH_STANDARD_S4_S3 1 100 0 65535 ECU_ADDRESS 0xFFF8A478 /end MEASUREMENT
/begin MEASUREMENT di_err_state_info[115] "status word of error code [0 .. 254-1]" UWORD EH_STANDARD_S4_S3 1 100 0 65535 ECU_ADDRESS 0xFFF8A47A /end MEASUREMENT
/begin MEASUREMENT di_err_state_info[116] "status word of error code [0 .. 254-1]" UWORD EH_STANDARD_S4_S3 1 100 0 65535 ECU_ADDRESS 0xFFF8A47C /end MEASUREMENT
/begin MEASUREMENT di_err_state_info[117] "status word of error code [0 .. 254-1]" UWORD EH_STANDARD_S4_S3 1 100 0 65535 ECU_ADDRESS 0xFFF8A47E /end MEASUREMENT
/begin MEASUREMENT di_err_state_info[118] "status word of error code [0 .. 254-1]" UWORD EH_STANDARD_S4_S3 1 100 0 65535 ECU_ADDRESS 0xFFF8A480 /end MEASUREMENT
/begin MEASUREMENT di_err_state_info[119] "status word of error code [0 .. 254-1]" UWORD EH_STANDARD_S4_S3 1 100 0 65535 ECU_ADDRESS 0xFFF8A482 /end MEASUREMENT
/begin MEASUREMENT di_err_state_info[11] "status word of error code [0 .. 254-1]" UWORD EH_STANDARD_S4_S3 1 100 0 65535 ECU_ADDRESS 0xFFF8A3AA /end MEASUREMENT
/begin MEASUREMENT di_err_state_info[120] "status word of error code [0 .. 254-1]" UWORD EH_STANDARD_S4_S3 1 100 0 65535 ECU_ADDRESS 0xFFF8A484 /end MEASUREMENT
/begin MEASUREMENT di_err_state_info[121] "status word of error code [0 .. 254-1]" UWORD EH_STANDARD_S4_S3 1 100 0 65535 ECU_ADDRESS 0xFFF8A486 /end MEASUREMENT
/begin MEASUREMENT di_err_state_info[122] "status word of error code [0 .. 254-1]" UWORD EH_STANDARD_S4_S3 1 100 0 65535 ECU_ADDRESS 0xFFF8A488 /end MEASUREMENT
/begin MEASUREMENT di_err_state_info[123] "status word of error code [0 .. 254-1]" UWORD EH_STANDARD_S4_S3 1 100 0 65535 ECU_ADDRESS 0xFFF8A48A /end MEASUREMENT
/begin MEASUREMENT di_err_state_info[124] "status word of error code [0 .. 254-1]" UWORD EH_STANDARD_S4_S3 1 100 0 65535 ECU_ADDRESS 0xFFF8A48C /end MEASUREMENT
/begin MEASUREMENT di_err_state_info[125] "status word of error code [0 .. 254-1]" UWORD EH_STANDARD_S4_S3 1 100 0 65535 ECU_ADDRESS 0xFFF8A48E /end MEASUREMENT
/begin MEASUREMENT di_err_state_info[126] "status word of error code [0 .. 254-1]" UWORD EH_STANDARD_S4_S3 1 100 0 65535 ECU_ADDRESS 0xFFF8A490 /end MEASUREMENT
/begin MEASUREMENT di_err_state_info[127] "status word of error code [0 .. 254-1]" UWORD EH_STANDARD_S4_S3 1 100 0 65535 ECU_ADDRESS 0xFFF8A492 /end MEASUREMENT
/begin MEASUREMENT di_err_state_info[128] "status word of error code [0 .. 254-1]" UWORD EH_STANDARD_S4_S3 1 100 0 65535 ECU_ADDRESS 0xFFF8A494 /end MEASUREMENT
/begin MEASUREMENT di_err_state_info[129] "status word of error code [0 .. 254-1]" UWORD EH_STANDARD_S4_S3 1 100 0 65535 ECU_ADDRESS 0xFFF8A496 /end MEASUREMENT
/begin MEASUREMENT di_err_state_info[12] "status word of error code [0 .. 254-1]" UWORD EH_STANDARD_S4_S3 1 100 0 65535 ECU_ADDRESS 0xFFF8A3AC /end MEASUREMENT
/begin MEASUREMENT di_err_state_info[130] "status word of error code [0 .. 254-1]" UWORD EH_STANDARD_S4_S3 1 100 0 65535 ECU_ADDRESS 0xFFF8A498 /end MEASUREMENT
/begin MEASUREMENT di_err_state_info[131] "status word of error code [0 .. 254-1]" UWORD EH_STANDARD_S4_S3 1 100 0 65535 ECU_ADDRESS 0xFFF8A49A /end MEASUREMENT
/begin MEASUREMENT di_err_state_info[132] "status word of error code [0 .. 254-1]" UWORD EH_STANDARD_S4_S3 1 100 0 65535 ECU_ADDRESS 0xFFF8A49C /end MEASUREMENT
/begin MEASUREMENT di_err_state_info[133] "status word of error code [0 .. 254-1]" UWORD EH_STANDARD_S4_S3 1 100 0 65535 ECU_ADDRESS 0xFFF8A49E /end MEASUREMENT
/begin MEASUREMENT di_err_state_info[134] "status word of error code [0 .. 254-1]" UWORD EH_STANDARD_S4_S3 1 100 0 65535 ECU_ADDRESS 0xFFF8A4A0 /end MEASUREMENT
/begin MEASUREMENT di_err_state_info[135] "status word of error code [0 .. 254-1]" UWORD EH_STANDARD_S4_S3 1 100 0 65535 ECU_ADDRESS 0xFFF8A4A2 /end MEASUREMENT
/begin MEASUREMENT di_err_state_info[136] "status word of error code [0 .. 254-1]" UWORD EH_STANDARD_S4_S3 1 100 0 65535 ECU_ADDRESS 0xFFF8A4A4 /end MEASUREMENT
/begin MEASUREMENT di_err_state_info[137] "status word of error code [0 .. 254-1]" UWORD EH_STANDARD_S4_S3 1 100 0 65535 ECU_ADDRESS 0xFFF8A4A6 /end MEASUREMENT
/begin MEASUREMENT di_err_state_info[138] "status word of error code [0 .. 254-1]" UWORD EH_STANDARD_S4_S3 1 100 0 65535 ECU_ADDRESS 0xFFF8A4A8 /end MEASUREMENT
/begin MEASUREMENT di_err_state_info[139] "status word of error code [0 .. 254-1]" UWORD EH_STANDARD_S4_S3 1 100 0 65535 ECU_ADDRESS 0xFFF8A4AA /end MEASUREMENT
/begin MEASUREMENT di_err_state_info[13] "status word of error code [0 .. 254-1]" UWORD EH_STANDARD_S4_S3 1 100 0 65535 ECU_ADDRESS 0xFFF8A3AE /end MEASUREMENT
/begin MEASUREMENT di_err_state_info[140] "status word of error code [0 .. 254-1]" UWORD EH_STANDARD_S4_S3 1 100 0 65535 ECU_ADDRESS 0xFFF8A4AC /end MEASUREMENT
/begin MEASUREMENT di_err_state_info[141] "status word of error code [0 .. 254-1]" UWORD EH_STANDARD_S4_S3 1 100 0 65535 ECU_ADDRESS 0xFFF8A4AE /end MEASUREMENT
/begin MEASUREMENT di_err_state_info[142] "status word of error code [0 .. 254-1]" UWORD EH_STANDARD_S4_S3 1 100 0 65535 ECU_ADDRESS 0xFFF8A4B0 /end MEASUREMENT
/begin MEASUREMENT di_err_state_info[143] "status word of error code [0 .. 254-1]" UWORD EH_STANDARD_S4_S3 1 100 0 65535 ECU_ADDRESS 0xFFF8A4B2 /end MEASUREMENT
/begin MEASUREMENT di_err_state_info[144] "status word of error code [0 .. 254-1]" UWORD EH_STANDARD_S4_S3 1 100 0 65535 ECU_ADDRESS 0xFFF8A4B4 /end MEASUREMENT
/begin MEASUREMENT di_err_state_info[145] "status word of error code [0 .. 254-1]" UWORD EH_STANDARD_S4_S3 1 100 0 65535 ECU_ADDRESS 0xFFF8A4B6 /end MEASUREMENT
/begin MEASUREMENT di_err_state_info[146] "status word of error code [0 .. 254-1]" UWORD EH_STANDARD_S4_S3 1 100 0 65535 ECU_ADDRESS 0xFFF8A4B8 /end MEASUREMENT
/begin MEASUREMENT di_err_state_info[147] "status word of error code [0 .. 254-1]" UWORD EH_STANDARD_S4_S3 1 100 0 65535 ECU_ADDRESS 0xFFF8A4BA /end MEASUREMENT
/begin MEASUREMENT di_err_state_info[148] "status word of error code [0 .. 254-1]" UWORD EH_STANDARD_S4_S3 1 100 0 65535 ECU_ADDRESS 0xFFF8A4BC /end MEASUREMENT
/begin MEASUREMENT di_err_state_info[149] "status word of error code [0 .. 254-1]" UWORD EH_STANDARD_S4_S3 1 100 0 65535 ECU_ADDRESS 0xFFF8A4BE /end MEASUREMENT
/begin MEASUREMENT di_err_state_info[14] "status word of error code [0 .. 254-1]" UWORD EH_STANDARD_S4_S3 1 100 0 65535 ECU_ADDRESS 0xFFF8A3B0 /end MEASUREMENT
/begin MEASUREMENT di_err_state_info[150] "status word of error code [0 .. 254-1]" UWORD EH_STANDARD_S4_S3 1 100 0 65535 ECU_ADDRESS 0xFFF8A4C0 /end MEASUREMENT
/begin MEASUREMENT di_err_state_info[151] "status word of error code [0 .. 254-1]" UWORD EH_STANDARD_S4_S3 1 100 0 65535 ECU_ADDRESS 0xFFF8A4C2 /end MEASUREMENT
/begin MEASUREMENT di_err_state_info[152] "status word of error code [0 .. 254-1]" UWORD EH_STANDARD_S4_S3 1 100 0 65535 ECU_ADDRESS 0xFFF8A4C4 /end MEASUREMENT
/begin MEASUREMENT di_err_state_info[153] "status word of error code [0 .. 254-1]" UWORD EH_STANDARD_S4_S3 1 100 0 65535 ECU_ADDRESS 0xFFF8A4C6 /end MEASUREMENT
/begin MEASUREMENT di_err_state_info[154] "status word of error code [0 .. 254-1]" UWORD EH_STANDARD_S4_S3 1 100 0 65535 ECU_ADDRESS 0xFFF8A4C8 /end MEASUREMENT
/begin MEASUREMENT di_err_state_info[155] "status word of error code [0 .. 254-1]" UWORD EH_STANDARD_S4_S3 1 100 0 65535 ECU_ADDRESS 0xFFF8A4CA /end MEASUREMENT
/begin MEASUREMENT di_err_state_info[156] "status word of error code [0 .. 254-1]" UWORD EH_STANDARD_S4_S3 1 100 0 65535 ECU_ADDRESS 0xFFF8A4CC /end MEASUREMENT
/begin MEASUREMENT di_err_state_info[157] "status word of error code [0 .. 254-1]" UWORD EH_STANDARD_S4_S3 1 100 0 65535 ECU_ADDRESS 0xFFF8A4CE /end MEASUREMENT
/begin MEASUREMENT di_err_state_info[158] "status word of error code [0 .. 254-1]" UWORD EH_STANDARD_S4_S3 1 100 0 65535 ECU_ADDRESS 0xFFF8A4D0 /end MEASUREMENT
/begin MEASUREMENT di_err_state_info[159] "status word of error code [0 .. 254-1]" UWORD EH_STANDARD_S4_S3 1 100 0 65535 ECU_ADDRESS 0xFFF8A4D2 /end MEASUREMENT
/begin MEASUREMENT di_err_state_info[15] "status word of error code [0 .. 254-1]" UWORD EH_STANDARD_S4_S3 1 100 0 65535 ECU_ADDRESS 0xFFF8A3B2 /end MEASUREMENT
/begin MEASUREMENT di_err_state_info[160] "status word of error code [0 .. 254-1]" UWORD EH_STANDARD_S4_S3 1 100 0 65535 ECU_ADDRESS 0xFFF8A4D4 /end MEASUREMENT
/begin MEASUREMENT di_err_state_info[161] "status word of error code [0 .. 254-1]" UWORD EH_STANDARD_S4_S3 1 100 0 65535 ECU_ADDRESS 0xFFF8A4D6 /end MEASUREMENT
/begin MEASUREMENT di_err_state_info[162] "status word of error code [0 .. 254-1]" UWORD EH_STANDARD_S4_S3 1 100 0 65535 ECU_ADDRESS 0xFFF8A4D8 /end MEASUREMENT
/begin MEASUREMENT di_err_state_info[163] "status word of error code [0 .. 254-1]" UWORD EH_STANDARD_S4_S3 1 100 0 65535 ECU_ADDRESS 0xFFF8A4DA /end MEASUREMENT
/begin MEASUREMENT di_err_state_info[164] "status word of error code [0 .. 254-1]" UWORD EH_STANDARD_S4_S3 1 100 0 65535 ECU_ADDRESS 0xFFF8A4DC /end MEASUREMENT
/begin MEASUREMENT di_err_state_info[165] "status word of error code [0 .. 254-1]" UWORD EH_STANDARD_S4_S3 1 100 0 65535 ECU_ADDRESS 0xFFF8A4DE /end MEASUREMENT
/begin MEASUREMENT di_err_state_info[166] "status word of error code [0 .. 254-1]" UWORD EH_STANDARD_S4_S3 1 100 0 65535 ECU_ADDRESS 0xFFF8A4E0 /end MEASUREMENT
/begin MEASUREMENT di_err_state_info[167] "status word of error code [0 .. 254-1]" UWORD EH_STANDARD_S4_S3 1 100 0 65535 ECU_ADDRESS 0xFFF8A4E2 /end MEASUREMENT
/begin MEASUREMENT di_err_state_info[168] "status word of error code [0 .. 254-1]" UWORD EH_STANDARD_S4_S3 1 100 0 65535 ECU_ADDRESS 0xFFF8A4E4 /end MEASUREMENT
/begin MEASUREMENT di_err_state_info[169] "status word of error code [0 .. 254-1]" UWORD EH_STANDARD_S4_S3 1 100 0 65535 ECU_ADDRESS 0xFFF8A4E6 /end MEASUREMENT
/begin MEASUREMENT di_err_state_info[16] "status word of error code [0 .. 254-1]" UWORD EH_STANDARD_S4_S3 1 100 0 65535 ECU_ADDRESS 0xFFF8A3B4 /end MEASUREMENT
/begin MEASUREMENT di_err_state_info[170] "status word of error code [0 .. 254-1]" UWORD EH_STANDARD_S4_S3 1 100 0 65535 ECU_ADDRESS 0xFFF8A4E8 /end MEASUREMENT
/begin MEASUREMENT di_err_state_info[171] "status word of error code [0 .. 254-1]" UWORD EH_STANDARD_S4_S3 1 100 0 65535 ECU_ADDRESS 0xFFF8A4EA /end MEASUREMENT
/begin MEASUREMENT di_err_state_info[172] "status word of error code [0 .. 254-1]" UWORD EH_STANDARD_S4_S3 1 100 0 65535 ECU_ADDRESS 0xFFF8A4EC /end MEASUREMENT
/begin MEASUREMENT di_err_state_info[173] "status word of error code [0 .. 254-1]" UWORD EH_STANDARD_S4_S3 1 100 0 65535 ECU_ADDRESS 0xFFF8A4EE /end MEASUREMENT
/begin MEASUREMENT di_err_state_info[174] "status word of error code [0 .. 254-1]" UWORD EH_STANDARD_S4_S3 1 100 0 65535 ECU_ADDRESS 0xFFF8A4F0 /end MEASUREMENT
/begin MEASUREMENT di_err_state_info[175] "status word of error code [0 .. 254-1]" UWORD EH_STANDARD_S4_S3 1 100 0 65535 ECU_ADDRESS 0xFFF8A4F2 /end MEASUREMENT
/begin MEASUREMENT di_err_state_info[176] "status word of error code [0 .. 254-1]" UWORD EH_STANDARD_S4_S3 1 100 0 65535 ECU_ADDRESS 0xFFF8A4F4 /end MEASUREMENT
/begin MEASUREMENT di_err_state_info[177] "status word of error code [0 .. 254-1]" UWORD EH_STANDARD_S4_S3 1 100 0 65535 ECU_ADDRESS 0xFFF8A4F6 /end MEASUREMENT
/begin MEASUREMENT di_err_state_info[178] "status word of error code [0 .. 254-1]" UWORD EH_STANDARD_S4_S3 1 100 0 65535 ECU_ADDRESS 0xFFF8A4F8 /end MEASUREMENT
/begin MEASUREMENT di_err_state_info[179] "status word of error code [0 .. 254-1]" UWORD EH_STANDARD_S4_S3 1 100 0 65535 ECU_ADDRESS 0xFFF8A4FA /end MEASUREMENT
/begin MEASUREMENT di_err_state_info[17] "status word of error code [0 .. 254-1]" UWORD EH_STANDARD_S4_S3 1 100 0 65535 ECU_ADDRESS 0xFFF8A3B6 /end MEASUREMENT
/begin MEASUREMENT di_err_state_info[180] "status word of error code [0 .. 254-1]" UWORD EH_STANDARD_S4_S3 1 100 0 65535 ECU_ADDRESS 0xFFF8A4FC /end MEASUREMENT
/begin MEASUREMENT di_err_state_info[181] "status word of error code [0 .. 254-1]" UWORD EH_STANDARD_S4_S3 1 100 0 65535 ECU_ADDRESS 0xFFF8A4FE /end MEASUREMENT
/begin MEASUREMENT di_err_state_info[182] "status word of error code [0 .. 254-1]" UWORD EH_STANDARD_S4_S3 1 100 0 65535 ECU_ADDRESS 0xFFF8A500 /end MEASUREMENT
/begin MEASUREMENT di_err_state_info[183] "status word of error code [0 .. 254-1]" UWORD EH_STANDARD_S4_S3 1 100 0 65535 ECU_ADDRESS 0xFFF8A502 /end MEASUREMENT
/begin MEASUREMENT di_err_state_info[184] "status word of error code [0 .. 254-1]" UWORD EH_STANDARD_S4_S3 1 100 0 65535 ECU_ADDRESS 0xFFF8A504 /end MEASUREMENT
/begin MEASUREMENT di_err_state_info[185] "status word of error code [0 .. 254-1]" UWORD EH_STANDARD_S4_S3 1 100 0 65535 ECU_ADDRESS 0xFFF8A506 /end MEASUREMENT
/begin MEASUREMENT di_err_state_info[186] "status word of error code [0 .. 254-1]" UWORD EH_STANDARD_S4_S3 1 100 0 65535 ECU_ADDRESS 0xFFF8A508 /end MEASUREMENT
/begin MEASUREMENT di_err_state_info[187] "status word of error code [0 .. 254-1]" UWORD EH_STANDARD_S4_S3 1 100 0 65535 ECU_ADDRESS 0xFFF8A50A /end MEASUREMENT
/begin MEASUREMENT di_err_state_info[188] "status word of error code [0 .. 254-1]" UWORD EH_STANDARD_S4_S3 1 100 0 65535 ECU_ADDRESS 0xFFF8A50C /end MEASUREMENT
/begin MEASUREMENT di_err_state_info[189] "status word of error code [0 .. 254-1]" UWORD EH_STANDARD_S4_S3 1 100 0 65535 ECU_ADDRESS 0xFFF8A50E /end MEASUREMENT
/begin MEASUREMENT di_err_state_info[18] "status word of error code [0 .. 254-1]" UWORD EH_STANDARD_S4_S3 1 100 0 65535 ECU_ADDRESS 0xFFF8A3B8 /end MEASUREMENT
/begin MEASUREMENT di_err_state_info[190] "status word of error code [0 .. 254-1]" UWORD EH_STANDARD_S4_S3 1 100 0 65535 ECU_ADDRESS 0xFFF8A510 /end MEASUREMENT
/begin MEASUREMENT di_err_state_info[191] "status word of error code [0 .. 254-1]" UWORD EH_STANDARD_S4_S3 1 100 0 65535 ECU_ADDRESS 0xFFF8A512 /end MEASUREMENT
/begin MEASUREMENT di_err_state_info[192] "status word of error code [0 .. 254-1]" UWORD EH_STANDARD_S4_S3 1 100 0 65535 ECU_ADDRESS 0xFFF8A514 /end MEASUREMENT
/begin MEASUREMENT di_err_state_info[193] "status word of error code [0 .. 254-1]" UWORD EH_STANDARD_S4_S3 1 100 0 65535 ECU_ADDRESS 0xFFF8A516 /end MEASUREMENT
/begin MEASUREMENT di_err_state_info[194] "status word of error code [0 .. 254-1]" UWORD EH_STANDARD_S4_S3 1 100 0 65535 ECU_ADDRESS 0xFFF8A518 /end MEASUREMENT
/begin MEASUREMENT di_err_state_info[195] "status word of error code [0 .. 254-1]" UWORD EH_STANDARD_S4_S3 1 100 0 65535 ECU_ADDRESS 0xFFF8A51A /end MEASUREMENT
/begin MEASUREMENT di_err_state_info[196] "status word of error code [0 .. 254-1]" UWORD EH_STANDARD_S4_S3 1 100 0 65535 ECU_ADDRESS 0xFFF8A51C /end MEASUREMENT
/begin MEASUREMENT di_err_state_info[197] "status word of error code [0 .. 254-1]" UWORD EH_STANDARD_S4_S3 1 100 0 65535 ECU_ADDRESS 0xFFF8A51E /end MEASUREMENT
/begin MEASUREMENT di_err_state_info[198] "status word of error code [0 .. 254-1]" UWORD EH_STANDARD_S4_S3 1 100 0 65535 ECU_ADDRESS 0xFFF8A520 /end MEASUREMENT
/begin MEASUREMENT di_err_state_info[199] "status word of error code [0 .. 254-1]" UWORD EH_STANDARD_S4_S3 1 100 0 65535 ECU_ADDRESS 0xFFF8A522 /end MEASUREMENT
/begin MEASUREMENT di_err_state_info[19] "status word of error code [0 .. 254-1]" UWORD EH_STANDARD_S4_S3 1 100 0 65535 ECU_ADDRESS 0xFFF8A3BA /end MEASUREMENT
/begin MEASUREMENT di_err_state_info[1] "status word of error code [0 .. 254-1]" UWORD EH_STANDARD_S4_S3 1 100 0 65535 ECU_ADDRESS 0xFFF8A396 /end MEASUREMENT
/begin MEASUREMENT di_err_state_info[200] "status word of error code [0 .. 254-1]" UWORD EH_STANDARD_S4_S3 1 100 0 65535 ECU_ADDRESS 0xFFF8A524 /end MEASUREMENT
/begin MEASUREMENT di_err_state_info[201] "status word of error code [0 .. 254-1]" UWORD EH_STANDARD_S4_S3 1 100 0 65535 ECU_ADDRESS 0xFFF8A526 /end MEASUREMENT
/begin MEASUREMENT di_err_state_info[202] "status word of error code [0 .. 254-1]" UWORD EH_STANDARD_S4_S3 1 100 0 65535 ECU_ADDRESS 0xFFF8A528 /end MEASUREMENT
/begin MEASUREMENT di_err_state_info[203] "status word of error code [0 .. 254-1]" UWORD EH_STANDARD_S4_S3 1 100 0 65535 ECU_ADDRESS 0xFFF8A52A /end MEASUREMENT
/begin MEASUREMENT di_err_state_info[204] "status word of error code [0 .. 254-1]" UWORD EH_STANDARD_S4_S3 1 100 0 65535 ECU_ADDRESS 0xFFF8A52C /end MEASUREMENT
/begin MEASUREMENT di_err_state_info[205] "status word of error code [0 .. 254-1]" UWORD EH_STANDARD_S4_S3 1 100 0 65535 ECU_ADDRESS 0xFFF8A52E /end MEASUREMENT
/begin MEASUREMENT di_err_state_info[206] "status word of error code [0 .. 254-1]" UWORD EH_STANDARD_S4_S3 1 100 0 65535 ECU_ADDRESS 0xFFF8A530 /end MEASUREMENT
/begin MEASUREMENT di_err_state_info[207] "status word of error code [0 .. 254-1]" UWORD EH_STANDARD_S4_S3 1 100 0 65535 ECU_ADDRESS 0xFFF8A532 /end MEASUREMENT
/begin MEASUREMENT di_err_state_info[208] "status word of error code [0 .. 254-1]" UWORD EH_STANDARD_S4_S3 1 100 0 65535 ECU_ADDRESS 0xFFF8A534 /end MEASUREMENT
/begin MEASUREMENT di_err_state_info[209] "status word of error code [0 .. 254-1]" UWORD EH_STANDARD_S4_S3 1 100 0 65535 ECU_ADDRESS 0xFFF8A536 /end MEASUREMENT
/begin MEASUREMENT di_err_state_info[20] "status word of error code [0 .. 254-1]" UWORD EH_STANDARD_S4_S3 1 100 0 65535 ECU_ADDRESS 0xFFF8A3BC /end MEASUREMENT
/begin MEASUREMENT di_err_state_info[210] "status word of error code [0 .. 254-1]" UWORD EH_STANDARD_S4_S3 1 100 0 65535 ECU_ADDRESS 0xFFF8A538 /end MEASUREMENT
/begin MEASUREMENT di_err_state_info[211] "status word of error code [0 .. 254-1]" UWORD EH_STANDARD_S4_S3 1 100 0 65535 ECU_ADDRESS 0xFFF8A53A /end MEASUREMENT
/begin MEASUREMENT di_err_state_info[212] "status word of error code [0 .. 254-1]" UWORD EH_STANDARD_S4_S3 1 100 0 65535 ECU_ADDRESS 0xFFF8A53C /end MEASUREMENT
/begin MEASUREMENT di_err_state_info[213] "status word of error code [0 .. 254-1]" UWORD EH_STANDARD_S4_S3 1 100 0 65535 ECU_ADDRESS 0xFFF8A53E /end MEASUREMENT
/begin MEASUREMENT di_err_state_info[214] "status word of error code [0 .. 254-1]" UWORD EH_STANDARD_S4_S3 1 100 0 65535 ECU_ADDRESS 0xFFF8A540 /end MEASUREMENT
/begin MEASUREMENT di_err_state_info[215] "status word of error code [0 .. 254-1]" UWORD EH_STANDARD_S4_S3 1 100 0 65535 ECU_ADDRESS 0xFFF8A542 /end MEASUREMENT
/begin MEASUREMENT di_err_state_info[216] "status word of error code [0 .. 254-1]" UWORD EH_STANDARD_S4_S3 1 100 0 65535 ECU_ADDRESS 0xFFF8A544 /end MEASUREMENT
/begin MEASUREMENT di_err_state_info[217] "status word of error code [0 .. 254-1]" UWORD EH_STANDARD_S4_S3 1 100 0 65535 ECU_ADDRESS 0xFFF8A546 /end MEASUREMENT
/begin MEASUREMENT di_err_state_info[218] "status word of error code [0 .. 254-1]" UWORD EH_STANDARD_S4_S3 1 100 0 65535 ECU_ADDRESS 0xFFF8A548 /end MEASUREMENT
/begin MEASUREMENT di_err_state_info[219] "status word of error code [0 .. 254-1]" UWORD EH_STANDARD_S4_S3 1 100 0 65535 ECU_ADDRESS 0xFFF8A54A /end MEASUREMENT
/begin MEASUREMENT di_err_state_info[21] "status word of error code [0 .. 254-1]" UWORD EH_STANDARD_S4_S3 1 100 0 65535 ECU_ADDRESS 0xFFF8A3BE /end MEASUREMENT
/begin MEASUREMENT di_err_state_info[220] "status word of error code [0 .. 254-1]" UWORD EH_STANDARD_S4_S3 1 100 0 65535 ECU_ADDRESS 0xFFF8A54C /end MEASUREMENT
/begin MEASUREMENT di_err_state_info[221] "status word of error code [0 .. 254-1]" UWORD EH_STANDARD_S4_S3 1 100 0 65535 ECU_ADDRESS 0xFFF8A54E /end MEASUREMENT
/begin MEASUREMENT di_err_state_info[222] "status word of error code [0 .. 254-1]" UWORD EH_STANDARD_S4_S3 1 100 0 65535 ECU_ADDRESS 0xFFF8A550 /end MEASUREMENT
/begin MEASUREMENT di_err_state_info[223] "status word of error code [0 .. 254-1]" UWORD EH_STANDARD_S4_S3 1 100 0 65535 ECU_ADDRESS 0xFFF8A552 /end MEASUREMENT
/begin MEASUREMENT di_err_state_info[224] "status word of error code [0 .. 254-1]" UWORD EH_STANDARD_S4_S3 1 100 0 65535 ECU_ADDRESS 0xFFF8A554 /end MEASUREMENT
/begin MEASUREMENT di_err_state_info[225] "status word of error code [0 .. 254-1]" UWORD EH_STANDARD_S4_S3 1 100 0 65535 ECU_ADDRESS 0xFFF8A556 /end MEASUREMENT
/begin MEASUREMENT di_err_state_info[226] "status word of error code [0 .. 254-1]" UWORD EH_STANDARD_S4_S3 1 100 0 65535 ECU_ADDRESS 0xFFF8A558 /end MEASUREMENT
/begin MEASUREMENT di_err_state_info[227] "status word of error code [0 .. 254-1]" UWORD EH_STANDARD_S4_S3 1 100 0 65535 ECU_ADDRESS 0xFFF8A55A /end MEASUREMENT
/begin MEASUREMENT di_err_state_info[228] "status word of error code [0 .. 254-1]" UWORD EH_STANDARD_S4_S3 1 100 0 65535 ECU_ADDRESS 0xFFF8A55C /end MEASUREMENT
/begin MEASUREMENT di_err_state_info[229] "status word of error code [0 .. 254-1]" UWORD EH_STANDARD_S4_S3 1 100 0 65535 ECU_ADDRESS 0xFFF8A55E /end MEASUREMENT
/begin MEASUREMENT di_err_state_info[22] "status word of error code [0 .. 254-1]" UWORD EH_STANDARD_S4_S3 1 100 0 65535 ECU_ADDRESS 0xFFF8A3C0 /end MEASUREMENT
/begin MEASUREMENT di_err_state_info[230] "status word of error code [0 .. 254-1]" UWORD EH_STANDARD_S4_S3 1 100 0 65535 ECU_ADDRESS 0xFFF8A560 /end MEASUREMENT
/begin MEASUREMENT di_err_state_info[231] "status word of error code [0 .. 254-1]" UWORD EH_STANDARD_S4_S3 1 100 0 65535 ECU_ADDRESS 0xFFF8A562 /end MEASUREMENT
/begin MEASUREMENT di_err_state_info[232] "status word of error code [0 .. 254-1]" UWORD EH_STANDARD_S4_S3 1 100 0 65535 ECU_ADDRESS 0xFFF8A564 /end MEASUREMENT
/begin MEASUREMENT di_err_state_info[233] "status word of error code [0 .. 254-1]" UWORD EH_STANDARD_S4_S3 1 100 0 65535 ECU_ADDRESS 0xFFF8A566 /end MEASUREMENT
/begin MEASUREMENT di_err_state_info[234] "status word of error code [0 .. 254-1]" UWORD EH_STANDARD_S4_S3 1 100 0 65535 ECU_ADDRESS 0xFFF8A568 /end MEASUREMENT
/begin MEASUREMENT di_err_state_info[235] "status word of error code [0 .. 254-1]" UWORD EH_STANDARD_S4_S3 1 100 0 65535 ECU_ADDRESS 0xFFF8A56A /end MEASUREMENT
/begin MEASUREMENT di_err_state_info[236] "status word of error code [0 .. 254-1]" UWORD EH_STANDARD_S4_S3 1 100 0 65535 ECU_ADDRESS 0xFFF8A56C /end MEASUREMENT
/begin MEASUREMENT di_err_state_info[237] "status word of error code [0 .. 254-1]" UWORD EH_STANDARD_S4_S3 1 100 0 65535 ECU_ADDRESS 0xFFF8A56E /end MEASUREMENT
/begin MEASUREMENT di_err_state_info[238] "status word of error code [0 .. 254-1]" UWORD EH_STANDARD_S4_S3 1 100 0 65535 ECU_ADDRESS 0xFFF8A570 /end MEASUREMENT
/begin MEASUREMENT di_err_state_info[239] "status word of error code [0 .. 254-1]" UWORD EH_STANDARD_S4_S3 1 100 0 65535 ECU_ADDRESS 0xFFF8A572 /end MEASUREMENT
/begin MEASUREMENT di_err_state_info[23] "status word of error code [0 .. 254-1]" UWORD EH_STANDARD_S4_S3 1 100 0 65535 ECU_ADDRESS 0xFFF8A3C2 /end MEASUREMENT
/begin MEASUREMENT di_err_state_info[240] "status word of error code [0 .. 254-1]" UWORD EH_STANDARD_S4_S3 1 100 0 65535 ECU_ADDRESS 0xFFF8A574 /end MEASUREMENT
/begin MEASUREMENT di_err_state_info[241] "status word of error code [0 .. 254-1]" UWORD EH_STANDARD_S4_S3 1 100 0 65535 ECU_ADDRESS 0xFFF8A576 /end MEASUREMENT
/begin MEASUREMENT di_err_state_info[242] "status word of error code [0 .. 254-1]" UWORD EH_STANDARD_S4_S3 1 100 0 65535 ECU_ADDRESS 0xFFF8A578 /end MEASUREMENT
/begin MEASUREMENT di_err_state_info[243] "status word of error code [0 .. 254-1]" UWORD EH_STANDARD_S4_S3 1 100 0 65535 ECU_ADDRESS 0xFFF8A57A /end MEASUREMENT
/begin MEASUREMENT di_err_state_info[244] "status word of error code [0 .. 254-1]" UWORD EH_STANDARD_S4_S3 1 100 0 65535 ECU_ADDRESS 0xFFF8A57C /end MEASUREMENT
/begin MEASUREMENT di_err_state_info[245] "status word of error code [0 .. 254-1]" UWORD EH_STANDARD_S4_S3 1 100 0 65535 ECU_ADDRESS 0xFFF8A57E /end MEASUREMENT
/begin MEASUREMENT di_err_state_info[246] "status word of error code [0 .. 254-1]" UWORD EH_STANDARD_S4_S3 1 100 0 65535 ECU_ADDRESS 0xFFF8A580 /end MEASUREMENT
/begin MEASUREMENT di_err_state_info[247] "status word of error code [0 .. 254-1]" UWORD EH_STANDARD_S4_S3 1 100 0 65535 ECU_ADDRESS 0xFFF8A582 /end MEASUREMENT
/begin MEASUREMENT di_err_state_info[248] "status word of error code [0 .. 254-1]" UWORD EH_STANDARD_S4_S3 1 100 0 65535 ECU_ADDRESS 0xFFF8A584 /end MEASUREMENT
/begin MEASUREMENT di_err_state_info[249] "status word of error code [0 .. 254-1]" UWORD EH_STANDARD_S4_S3 1 100 0 65535 ECU_ADDRESS 0xFFF8A586 /end MEASUREMENT
/begin MEASUREMENT di_err_state_info[24] "status word of error code [0 .. 254-1]" UWORD EH_STANDARD_S4_S3 1 100 0 65535 ECU_ADDRESS 0xFFF8A3C4 /end MEASUREMENT
/begin MEASUREMENT di_err_state_info[250] "status word of error code [0 .. 254-1]" UWORD EH_STANDARD_S4_S3 1 100 0 65535 ECU_ADDRESS 0xFFF8A588 /end MEASUREMENT
/begin MEASUREMENT di_err_state_info[251] "status word of error code [0 .. 254-1]" UWORD EH_STANDARD_S4_S3 1 100 0 65535 ECU_ADDRESS 0xFFF8A58A /end MEASUREMENT
/begin MEASUREMENT di_err_state_info[252] "status word of error code [0 .. 254-1]" UWORD EH_STANDARD_S4_S3 1 100 0 65535 ECU_ADDRESS 0xFFF8A58C /end MEASUREMENT
/begin MEASUREMENT di_err_state_info[253] "status word of error code [0 .. 254-1]" UWORD EH_STANDARD_S4_S3 1 100 0 65535 ECU_ADDRESS 0xFFF8A58E /end MEASUREMENT
/begin MEASUREMENT di_err_state_info[25] "status word of error code [0 .. 254-1]" UWORD EH_STANDARD_S4_S3 1 100 0 65535 ECU_ADDRESS 0xFFF8A3C6 /end MEASUREMENT
/begin MEASUREMENT di_err_state_info[26] "status word of error code [0 .. 254-1]" UWORD EH_STANDARD_S4_S3 1 100 0 65535 ECU_ADDRESS 0xFFF8A3C8 /end MEASUREMENT
/begin MEASUREMENT di_err_state_info[27] "status word of error code [0 .. 254-1]" UWORD EH_STANDARD_S4_S3 1 100 0 65535 ECU_ADDRESS 0xFFF8A3CA /end MEASUREMENT
/begin MEASUREMENT di_err_state_info[28] "status word of error code [0 .. 254-1]" UWORD EH_STANDARD_S4_S3 1 100 0 65535 ECU_ADDRESS 0xFFF8A3CC /end MEASUREMENT
/begin MEASUREMENT di_err_state_info[29] "status word of error code [0 .. 254-1]" UWORD EH_STANDARD_S4_S3 1 100 0 65535 ECU_ADDRESS 0xFFF8A3CE /end MEASUREMENT
/begin MEASUREMENT di_err_state_info[2] "status word of error code [0 .. 254-1]" UWORD EH_STANDARD_S4_S3 1 100 0 65535 ECU_ADDRESS 0xFFF8A398 /end MEASUREMENT
/begin MEASUREMENT di_err_state_info[30] "status word of error code [0 .. 254-1]" UWORD EH_STANDARD_S4_S3 1 100 0 65535 ECU_ADDRESS 0xFFF8A3D0 /end MEASUREMENT
/begin MEASUREMENT di_err_state_info[31] "status word of error code [0 .. 254-1]" UWORD EH_STANDARD_S4_S3 1 100 0 65535 ECU_ADDRESS 0xFFF8A3D2 /end MEASUREMENT
/begin MEASUREMENT di_err_state_info[32] "status word of error code [0 .. 254-1]" UWORD EH_STANDARD_S4_S3 1 100 0 65535 ECU_ADDRESS 0xFFF8A3D4 /end MEASUREMENT
/begin MEASUREMENT di_err_state_info[33] "status word of error code [0 .. 254-1]" UWORD EH_STANDARD_S4_S3 1 100 0 65535 ECU_ADDRESS 0xFFF8A3D6 /end MEASUREMENT
/begin MEASUREMENT di_err_state_info[34] "status word of error code [0 .. 254-1]" UWORD EH_STANDARD_S4_S3 1 100 0 65535 ECU_ADDRESS 0xFFF8A3D8 /end MEASUREMENT
/begin MEASUREMENT di_err_state_info[35] "status word of error code [0 .. 254-1]" UWORD EH_STANDARD_S4_S3 1 100 0 65535 ECU_ADDRESS 0xFFF8A3DA /end MEASUREMENT
/begin MEASUREMENT di_err_state_info[36] "status word of error code [0 .. 254-1]" UWORD EH_STANDARD_S4_S3 1 100 0 65535 ECU_ADDRESS 0xFFF8A3DC /end MEASUREMENT
/begin MEASUREMENT di_err_state_info[37] "status word of error code [0 .. 254-1]" UWORD EH_STANDARD_S4_S3 1 100 0 65535 ECU_ADDRESS 0xFFF8A3DE /end MEASUREMENT
/begin MEASUREMENT di_err_state_info[38] "status word of error code [0 .. 254-1]" UWORD EH_STANDARD_S4_S3 1 100 0 65535 ECU_ADDRESS 0xFFF8A3E0 /end MEASUREMENT
/begin MEASUREMENT di_err_state_info[39] "status word of error code [0 .. 254-1]" UWORD EH_STANDARD_S4_S3 1 100 0 65535 ECU_ADDRESS 0xFFF8A3E2 /end MEASUREMENT
/begin MEASUREMENT di_err_state_info[3] "status word of error code [0 .. 254-1]" UWORD EH_STANDARD_S4_S3 1 100 0 65535 ECU_ADDRESS 0xFFF8A39A /end MEASUREMENT
/begin MEASUREMENT di_err_state_info[40] "status word of error code [0 .. 254-1]" UWORD EH_STANDARD_S4_S3 1 100 0 65535 ECU_ADDRESS 0xFFF8A3E4 /end MEASUREMENT
/begin MEASUREMENT di_err_state_info[41] "status word of error code [0 .. 254-1]" UWORD EH_STANDARD_S4_S3 1 100 0 65535 ECU_ADDRESS 0xFFF8A3E6 /end MEASUREMENT
/begin MEASUREMENT di_err_state_info[42] "status word of error code [0 .. 254-1]" UWORD EH_STANDARD_S4_S3 1 100 0 65535 ECU_ADDRESS 0xFFF8A3E8 /end MEASUREMENT
/begin MEASUREMENT di_err_state_info[43] "status word of error code [0 .. 254-1]" UWORD EH_STANDARD_S4_S3 1 100 0 65535 ECU_ADDRESS 0xFFF8A3EA /end MEASUREMENT
/begin MEASUREMENT di_err_state_info[44] "status word of error code [0 .. 254-1]" UWORD EH_STANDARD_S4_S3 1 100 0 65535 ECU_ADDRESS 0xFFF8A3EC /end MEASUREMENT
/begin MEASUREMENT di_err_state_info[45] "status word of error code [0 .. 254-1]" UWORD EH_STANDARD_S4_S3 1 100 0 65535 ECU_ADDRESS 0xFFF8A3EE /end MEASUREMENT
/begin MEASUREMENT di_err_state_info[46] "status word of error code [0 .. 254-1]" UWORD EH_STANDARD_S4_S3 1 100 0 65535 ECU_ADDRESS 0xFFF8A3F0 /end MEASUREMENT
/begin MEASUREMENT di_err_state_info[47] "status word of error code [0 .. 254-1]" UWORD EH_STANDARD_S4_S3 1 100 0 65535 ECU_ADDRESS 0xFFF8A3F2 /end MEASUREMENT
/begin MEASUREMENT di_err_state_info[48] "status word of error code [0 .. 254-1]" UWORD EH_STANDARD_S4_S3 1 100 0 65535 ECU_ADDRESS 0xFFF8A3F4 /end MEASUREMENT
/begin MEASUREMENT di_err_state_info[49] "status word of error code [0 .. 254-1]" UWORD EH_STANDARD_S4_S3 1 100 0 65535 ECU_ADDRESS 0xFFF8A3F6 /end MEASUREMENT
/begin MEASUREMENT di_err_state_info[4] "status word of error code [0 .. 254-1]" UWORD EH_STANDARD_S4_S3 1 100 0 65535 ECU_ADDRESS 0xFFF8A39C /end MEASUREMENT
/begin MEASUREMENT di_err_state_info[50] "status word of error code [0 .. 254-1]" UWORD EH_STANDARD_S4_S3 1 100 0 65535 ECU_ADDRESS 0xFFF8A3F8 /end MEASUREMENT
/begin MEASUREMENT di_err_state_info[51] "status word of error code [0 .. 254-1]" UWORD EH_STANDARD_S4_S3 1 100 0 65535 ECU_ADDRESS 0xFFF8A3FA /end MEASUREMENT
/begin MEASUREMENT di_err_state_info[52] "status word of error code [0 .. 254-1]" UWORD EH_STANDARD_S4_S3 1 100 0 65535 ECU_ADDRESS 0xFFF8A3FC /end MEASUREMENT
/begin MEASUREMENT di_err_state_info[53] "status word of error code [0 .. 254-1]" UWORD EH_STANDARD_S4_S3 1 100 0 65535 ECU_ADDRESS 0xFFF8A3FE /end MEASUREMENT
/begin MEASUREMENT di_err_state_info[54] "status word of error code [0 .. 254-1]" UWORD EH_STANDARD_S4_S3 1 100 0 65535 ECU_ADDRESS 0xFFF8A400 /end MEASUREMENT
/begin MEASUREMENT di_err_state_info[55] "status word of error code [0 .. 254-1]" UWORD EH_STANDARD_S4_S3 1 100 0 65535 ECU_ADDRESS 0xFFF8A402 /end MEASUREMENT
/begin MEASUREMENT di_err_state_info[56] "status word of error code [0 .. 254-1]" UWORD EH_STANDARD_S4_S3 1 100 0 65535 ECU_ADDRESS 0xFFF8A404 /end MEASUREMENT
/begin MEASUREMENT di_err_state_info[57] "status word of error code [0 .. 254-1]" UWORD EH_STANDARD_S4_S3 1 100 0 65535 ECU_ADDRESS 0xFFF8A406 /end MEASUREMENT
/begin MEASUREMENT di_err_state_info[58] "status word of error code [0 .. 254-1]" UWORD EH_STANDARD_S4_S3 1 100 0 65535 ECU_ADDRESS 0xFFF8A408 /end MEASUREMENT
/begin MEASUREMENT di_err_state_info[59] "status word of error code [0 .. 254-1]" UWORD EH_STANDARD_S4_S3 1 100 0 65535 ECU_ADDRESS 0xFFF8A40A /end MEASUREMENT
/begin MEASUREMENT di_err_state_info[5] "status word of error code [0 .. 254-1]" UWORD EH_STANDARD_S4_S3 1 100 0 65535 ECU_ADDRESS 0xFFF8A39E /end MEASUREMENT
/begin MEASUREMENT di_err_state_info[60] "status word of error code [0 .. 254-1]" UWORD EH_STANDARD_S4_S3 1 100 0 65535 ECU_ADDRESS 0xFFF8A40C /end MEASUREMENT
/begin MEASUREMENT di_err_state_info[61] "status word of error code [0 .. 254-1]" UWORD EH_STANDARD_S4_S3 1 100 0 65535 ECU_ADDRESS 0xFFF8A40E /end MEASUREMENT
/begin MEASUREMENT di_err_state_info[62] "status word of error code [0 .. 254-1]" UWORD EH_STANDARD_S4_S3 1 100 0 65535 ECU_ADDRESS 0xFFF8A410 /end MEASUREMENT
/begin MEASUREMENT di_err_state_info[63] "status word of error code [0 .. 254-1]" UWORD EH_STANDARD_S4_S3 1 100 0 65535 ECU_ADDRESS 0xFFF8A412 /end MEASUREMENT
/begin MEASUREMENT di_err_state_info[64] "status word of error code [0 .. 254-1]" UWORD EH_STANDARD_S4_S3 1 100 0 65535 ECU_ADDRESS 0xFFF8A414 /end MEASUREMENT
/begin MEASUREMENT di_err_state_info[65] "status word of error code [0 .. 254-1]" UWORD EH_STANDARD_S4_S3 1 100 0 65535 ECU_ADDRESS 0xFFF8A416 /end MEASUREMENT
/begin MEASUREMENT di_err_state_info[66] "status word of error code [0 .. 254-1]" UWORD EH_STANDARD_S4_S3 1 100 0 65535 ECU_ADDRESS 0xFFF8A418 /end MEASUREMENT
/begin MEASUREMENT di_err_state_info[67] "status word of error code [0 .. 254-1]" UWORD EH_STANDARD_S4_S3 1 100 0 65535 ECU_ADDRESS 0xFFF8A41A /end MEASUREMENT
/begin MEASUREMENT di_err_state_info[68] "status word of error code [0 .. 254-1]" UWORD EH_STANDARD_S4_S3 1 100 0 65535 ECU_ADDRESS 0xFFF8A41C /end MEASUREMENT
/begin MEASUREMENT di_err_state_info[69] "status word of error code [0 .. 254-1]" UWORD EH_STANDARD_S4_S3 1 100 0 65535 ECU_ADDRESS 0xFFF8A41E /end MEASUREMENT
/begin MEASUREMENT di_err_state_info[6] "status word of error code [0 .. 254-1]" UWORD EH_STANDARD_S4_S3 1 100 0 65535 ECU_ADDRESS 0xFFF8A3A0 /end MEASUREMENT
/begin MEASUREMENT di_err_state_info[70] "status word of error code [0 .. 254-1]" UWORD EH_STANDARD_S4_S3 1 100 0 65535 ECU_ADDRESS 0xFFF8A420 /end MEASUREMENT
/begin MEASUREMENT di_err_state_info[71] "status word of error code [0 .. 254-1]" UWORD EH_STANDARD_S4_S3 1 100 0 65535 ECU_ADDRESS 0xFFF8A422 /end MEASUREMENT
/begin MEASUREMENT di_err_state_info[72] "status word of error code [0 .. 254-1]" UWORD EH_STANDARD_S4_S3 1 100 0 65535 ECU_ADDRESS 0xFFF8A424 /end MEASUREMENT
/begin MEASUREMENT di_err_state_info[73] "status word of error code [0 .. 254-1]" UWORD EH_STANDARD_S4_S3 1 100 0 65535 ECU_ADDRESS 0xFFF8A426 /end MEASUREMENT
/begin MEASUREMENT di_err_state_info[74] "status word of error code [0 .. 254-1]" UWORD EH_STANDARD_S4_S3 1 100 0 65535 ECU_ADDRESS 0xFFF8A428 /end MEASUREMENT
/begin MEASUREMENT di_err_state_info[75] "status word of error code [0 .. 254-1]" UWORD EH_STANDARD_S4_S3 1 100 0 65535 ECU_ADDRESS 0xFFF8A42A /end MEASUREMENT
/begin MEASUREMENT di_err_state_info[76] "status word of error code [0 .. 254-1]" UWORD EH_STANDARD_S4_S3 1 100 0 65535 ECU_ADDRESS 0xFFF8A42C /end MEASUREMENT
/begin MEASUREMENT di_err_state_info[77] "status word of error code [0 .. 254-1]" UWORD EH_STANDARD_S4_S3 1 100 0 65535 ECU_ADDRESS 0xFFF8A42E /end MEASUREMENT
/begin MEASUREMENT di_err_state_info[78] "status word of error code [0 .. 254-1]" UWORD EH_STANDARD_S4_S3 1 100 0 65535 ECU_ADDRESS 0xFFF8A430 /end MEASUREMENT
/begin MEASUREMENT di_err_state_info[79] "status word of error code [0 .. 254-1]" UWORD EH_STANDARD_S4_S3 1 100 0 65535 ECU_ADDRESS 0xFFF8A432 /end MEASUREMENT
/begin MEASUREMENT di_err_state_info[7] "status word of error code [0 .. 254-1]" UWORD EH_STANDARD_S4_S3 1 100 0 65535 ECU_ADDRESS 0xFFF8A3A2 /end MEASUREMENT
/begin MEASUREMENT di_err_state_info[80] "status word of error code [0 .. 254-1]" UWORD EH_STANDARD_S4_S3 1 100 0 65535 ECU_ADDRESS 0xFFF8A434 /end MEASUREMENT
/begin MEASUREMENT di_err_state_info[81] "status word of error code [0 .. 254-1]" UWORD EH_STANDARD_S4_S3 1 100 0 65535 ECU_ADDRESS 0xFFF8A436 /end MEASUREMENT
/begin MEASUREMENT di_err_state_info[82] "status word of error code [0 .. 254-1]" UWORD EH_STANDARD_S4_S3 1 100 0 65535 ECU_ADDRESS 0xFFF8A438 /end MEASUREMENT
/begin MEASUREMENT di_err_state_info[83] "status word of error code [0 .. 254-1]" UWORD EH_STANDARD_S4_S3 1 100 0 65535 ECU_ADDRESS 0xFFF8A43A /end MEASUREMENT
/begin MEASUREMENT di_err_state_info[84] "status word of error code [0 .. 254-1]" UWORD EH_STANDARD_S4_S3 1 100 0 65535 ECU_ADDRESS 0xFFF8A43C /end MEASUREMENT
/begin MEASUREMENT di_err_state_info[85] "status word of error code [0 .. 254-1]" UWORD EH_STANDARD_S4_S3 1 100 0 65535 ECU_ADDRESS 0xFFF8A43E /end MEASUREMENT
/begin MEASUREMENT di_err_state_info[86] "status word of error code [0 .. 254-1]" UWORD EH_STANDARD_S4_S3 1 100 0 65535 ECU_ADDRESS 0xFFF8A440 /end MEASUREMENT
/begin MEASUREMENT di_err_state_info[87] "status word of error code [0 .. 254-1]" UWORD EH_STANDARD_S4_S3 1 100 0 65535 ECU_ADDRESS 0xFFF8A442 /end MEASUREMENT
/begin MEASUREMENT di_err_state_info[88] "status word of error code [0 .. 254-1]" UWORD EH_STANDARD_S4_S3 1 100 0 65535 ECU_ADDRESS 0xFFF8A444 /end MEASUREMENT
/begin MEASUREMENT di_err_state_info[89] "status word of error code [0 .. 254-1]" UWORD EH_STANDARD_S4_S3 1 100 0 65535 ECU_ADDRESS 0xFFF8A446 /end MEASUREMENT
/begin MEASUREMENT di_err_state_info[8] "status word of error code [0 .. 254-1]" UWORD EH_STANDARD_S4_S3 1 100 0 65535 ECU_ADDRESS 0xFFF8A3A4 /end MEASUREMENT
/begin MEASUREMENT di_err_state_info[90] "status word of error code [0 .. 254-1]" UWORD EH_STANDARD_S4_S3 1 100 0 65535 ECU_ADDRESS 0xFFF8A448 /end MEASUREMENT
/begin MEASUREMENT di_err_state_info[91] "status word of error code [0 .. 254-1]" UWORD EH_STANDARD_S4_S3 1 100 0 65535 ECU_ADDRESS 0xFFF8A44A /end MEASUREMENT
/begin MEASUREMENT di_err_state_info[92] "status word of error code [0 .. 254-1]" UWORD EH_STANDARD_S4_S3 1 100 0 65535 ECU_ADDRESS 0xFFF8A44C /end MEASUREMENT
/begin MEASUREMENT di_err_state_info[93] "status word of error code [0 .. 254-1]" UWORD EH_STANDARD_S4_S3 1 100 0 65535 ECU_ADDRESS 0xFFF8A44E /end MEASUREMENT
/begin MEASUREMENT di_err_state_info[94] "status word of error code [0 .. 254-1]" UWORD EH_STANDARD_S4_S3 1 100 0 65535 ECU_ADDRESS 0xFFF8A450 /end MEASUREMENT
/begin MEASUREMENT di_err_state_info[95] "status word of error code [0 .. 254-1]" UWORD EH_STANDARD_S4_S3 1 100 0 65535 ECU_ADDRESS 0xFFF8A452 /end MEASUREMENT
/begin MEASUREMENT di_err_state_info[96] "status word of error code [0 .. 254-1]" UWORD EH_STANDARD_S4_S3 1 100 0 65535 ECU_ADDRESS 0xFFF8A454 /end MEASUREMENT
/begin MEASUREMENT di_err_state_info[97] "status word of error code [0 .. 254-1]" UWORD EH_STANDARD_S4_S3 1 100 0 65535 ECU_ADDRESS 0xFFF8A456 /end MEASUREMENT
/begin MEASUREMENT di_err_state_info[98] "status word of error code [0 .. 254-1]" UWORD EH_STANDARD_S4_S3 1 100 0 65535 ECU_ADDRESS 0xFFF8A458 /end MEASUREMENT
/begin MEASUREMENT di_err_state_info[99] "status word of error code [0 .. 254-1]" UWORD EH_STANDARD_S4_S3 1 100 0 65535 ECU_ADDRESS 0xFFF8A45A /end MEASUREMENT
/begin MEASUREMENT di_err_state_info[9] "status word of error code [0 .. 254-1]" UWORD EH_STANDARD_S4_S3 1 100 0 65535 ECU_ADDRESS 0xFFF8A3A6 /end MEASUREMENT
/begin MEASUREMENT di_filter_max_val[0] "maximum reached filter value of error code [0 .. 254-1]" UWORD EH_STANDARD_S4_S3 1 100 0 65535 ECU_ADDRESS 0xFFF8A598 /end MEASUREMENT
/begin MEASUREMENT di_filter_max_val[100] "maximum reached filter value of error code [0 .. 254-1]" UWORD EH_STANDARD_S4_S3 1 100 0 65535 ECU_ADDRESS 0xFFF8A660 /end MEASUREMENT
/begin MEASUREMENT di_filter_max_val[101] "maximum reached filter value of error code [0 .. 254-1]" UWORD EH_STANDARD_S4_S3 1 100 0 65535 ECU_ADDRESS 0xFFF8A662 /end MEASUREMENT
/begin MEASUREMENT di_filter_max_val[102] "maximum reached filter value of error code [0 .. 254-1]" UWORD EH_STANDARD_S4_S3 1 100 0 65535 ECU_ADDRESS 0xFFF8A664 /end MEASUREMENT
/begin MEASUREMENT di_filter_max_val[103] "maximum reached filter value of error code [0 .. 254-1]" UWORD EH_STANDARD_S4_S3 1 100 0 65535 ECU_ADDRESS 0xFFF8A666 /end MEASUREMENT
/begin MEASUREMENT di_filter_max_val[104] "maximum reached filter value of error code [0 .. 254-1]" UWORD EH_STANDARD_S4_S3 1 100 0 65535 ECU_ADDRESS 0xFFF8A668 /end MEASUREMENT
/begin MEASUREMENT di_filter_max_val[105] "maximum reached filter value of error code [0 .. 254-1]" UWORD EH_STANDARD_S4_S3 1 100 0 65535 ECU_ADDRESS 0xFFF8A66A /end MEASUREMENT
/begin MEASUREMENT di_filter_max_val[106] "maximum reached filter value of error code [0 .. 254-1]" UWORD EH_STANDARD_S4_S3 1 100 0 65535 ECU_ADDRESS 0xFFF8A66C /end MEASUREMENT
/begin MEASUREMENT di_filter_max_val[107] "maximum reached filter value of error code [0 .. 254-1]" UWORD EH_STANDARD_S4_S3 1 100 0 65535 ECU_ADDRESS 0xFFF8A66E /end MEASUREMENT
/begin MEASUREMENT di_filter_max_val[108] "maximum reached filter value of error code [0 .. 254-1]" UWORD EH_STANDARD_S4_S3 1 100 0 65535 ECU_ADDRESS 0xFFF8A670 /end MEASUREMENT
/begin MEASUREMENT di_filter_max_val[109] "maximum reached filter value of error code [0 .. 254-1]" UWORD EH_STANDARD_S4_S3 1 100 0 65535 ECU_ADDRESS 0xFFF8A672 /end MEASUREMENT
/begin MEASUREMENT di_filter_max_val[10] "maximum reached filter value of error code [0 .. 254-1]" UWORD EH_STANDARD_S4_S3 1 100 0 65535 ECU_ADDRESS 0xFFF8A5AC /end MEASUREMENT
/begin MEASUREMENT di_filter_max_val[110] "maximum reached filter value of error code [0 .. 254-1]" UWORD EH_STANDARD_S4_S3 1 100 0 65535 ECU_ADDRESS 0xFFF8A674 /end MEASUREMENT
/begin MEASUREMENT di_filter_max_val[111] "maximum reached filter value of error code [0 .. 254-1]" UWORD EH_STANDARD_S4_S3 1 100 0 65535 ECU_ADDRESS 0xFFF8A676 /end MEASUREMENT
/begin MEASUREMENT di_filter_max_val[112] "maximum reached filter value of error code [0 .. 254-1]" UWORD EH_STANDARD_S4_S3 1 100 0 65535 ECU_ADDRESS 0xFFF8A678 /end MEASUREMENT
/begin MEASUREMENT di_filter_max_val[113] "maximum reached filter value of error code [0 .. 254-1]" UWORD EH_STANDARD_S4_S3 1 100 0 65535 ECU_ADDRESS 0xFFF8A67A /end MEASUREMENT
/begin MEASUREMENT di_filter_max_val[114] "maximum reached filter value of error code [0 .. 254-1]" UWORD EH_STANDARD_S4_S3 1 100 0 65535 ECU_ADDRESS 0xFFF8A67C /end MEASUREMENT
/begin MEASUREMENT di_filter_max_val[115] "maximum reached filter value of error code [0 .. 254-1]" UWORD EH_STANDARD_S4_S3 1 100 0 65535 ECU_ADDRESS 0xFFF8A67E /end MEASUREMENT
/begin MEASUREMENT di_filter_max_val[116] "maximum reached filter value of error code [0 .. 254-1]" UWORD EH_STANDARD_S4_S3 1 100 0 65535 ECU_ADDRESS 0xFFF8A680 /end MEASUREMENT
/begin MEASUREMENT di_filter_max_val[117] "maximum reached filter value of error code [0 .. 254-1]" UWORD EH_STANDARD_S4_S3 1 100 0 65535 ECU_ADDRESS 0xFFF8A682 /end MEASUREMENT
/begin MEASUREMENT di_filter_max_val[118] "maximum reached filter value of error code [0 .. 254-1]" UWORD EH_STANDARD_S4_S3 1 100 0 65535 ECU_ADDRESS 0xFFF8A684 /end MEASUREMENT
/begin MEASUREMENT di_filter_max_val[119] "maximum reached filter value of error code [0 .. 254-1]" UWORD EH_STANDARD_S4_S3 1 100 0 65535 ECU_ADDRESS 0xFFF8A686 /end MEASUREMENT
/begin MEASUREMENT di_filter_max_val[11] "maximum reached filter value of error code [0 .. 254-1]" UWORD EH_STANDARD_S4_S3 1 100 0 65535 ECU_ADDRESS 0xFFF8A5AE /end MEASUREMENT
/begin MEASUREMENT di_filter_max_val[120] "maximum reached filter value of error code [0 .. 254-1]" UWORD EH_STANDARD_S4_S3 1 100 0 65535 ECU_ADDRESS 0xFFF8A688 /end MEASUREMENT
/begin MEASUREMENT di_filter_max_val[121] "maximum reached filter value of error code [0 .. 254-1]" UWORD EH_STANDARD_S4_S3 1 100 0 65535 ECU_ADDRESS 0xFFF8A68A /end MEASUREMENT
/begin MEASUREMENT di_filter_max_val[122] "maximum reached filter value of error code [0 .. 254-1]" UWORD EH_STANDARD_S4_S3 1 100 0 65535 ECU_ADDRESS 0xFFF8A68C /end MEASUREMENT
/begin MEASUREMENT di_filter_max_val[123] "maximum reached filter value of error code [0 .. 254-1]" UWORD EH_STANDARD_S4_S3 1 100 0 65535 ECU_ADDRESS 0xFFF8A68E /end MEASUREMENT
/begin MEASUREMENT di_filter_max_val[124] "maximum reached filter value of error code [0 .. 254-1]" UWORD EH_STANDARD_S4_S3 1 100 0 65535 ECU_ADDRESS 0xFFF8A690 /end MEASUREMENT
/begin MEASUREMENT di_filter_max_val[125] "maximum reached filter value of error code [0 .. 254-1]" UWORD EH_STANDARD_S4_S3 1 100 0 65535 ECU_ADDRESS 0xFFF8A692 /end MEASUREMENT
/begin MEASUREMENT di_filter_max_val[126] "maximum reached filter value of error code [0 .. 254-1]" UWORD EH_STANDARD_S4_S3 1 100 0 65535 ECU_ADDRESS 0xFFF8A694 /end MEASUREMENT
/begin MEASUREMENT di_filter_max_val[127] "maximum reached filter value of error code [0 .. 254-1]" UWORD EH_STANDARD_S4_S3 1 100 0 65535 ECU_ADDRESS 0xFFF8A696 /end MEASUREMENT
/begin MEASUREMENT di_filter_max_val[128] "maximum reached filter value of error code [0 .. 254-1]" UWORD EH_STANDARD_S4_S3 1 100 0 65535 ECU_ADDRESS 0xFFF8A698 /end MEASUREMENT
/begin MEASUREMENT di_filter_max_val[129] "maximum reached filter value of error code [0 .. 254-1]" UWORD EH_STANDARD_S4_S3 1 100 0 65535 ECU_ADDRESS 0xFFF8A69A /end MEASUREMENT
/begin MEASUREMENT di_filter_max_val[12] "maximum reached filter value of error code [0 .. 254-1]" UWORD EH_STANDARD_S4_S3 1 100 0 65535 ECU_ADDRESS 0xFFF8A5B0 /end MEASUREMENT
/begin MEASUREMENT di_filter_max_val[130] "maximum reached filter value of error code [0 .. 254-1]" UWORD EH_STANDARD_S4_S3 1 100 0 65535 ECU_ADDRESS 0xFFF8A69C /end MEASUREMENT
/begin MEASUREMENT di_filter_max_val[131] "maximum reached filter value of error code [0 .. 254-1]" UWORD EH_STANDARD_S4_S3 1 100 0 65535 ECU_ADDRESS 0xFFF8A69E /end MEASUREMENT
/begin MEASUREMENT di_filter_max_val[132] "maximum reached filter value of error code [0 .. 254-1]" UWORD EH_STANDARD_S4_S3 1 100 0 65535 ECU_ADDRESS 0xFFF8A6A0 /end MEASUREMENT
/begin MEASUREMENT di_filter_max_val[133] "maximum reached filter value of error code [0 .. 254-1]" UWORD EH_STANDARD_S4_S3 1 100 0 65535 ECU_ADDRESS 0xFFF8A6A2 /end MEASUREMENT
/begin MEASUREMENT di_filter_max_val[134] "maximum reached filter value of error code [0 .. 254-1]" UWORD EH_STANDARD_S4_S3 1 100 0 65535 ECU_ADDRESS 0xFFF8A6A4 /end MEASUREMENT
/begin MEASUREMENT di_filter_max_val[135] "maximum reached filter value of error code [0 .. 254-1]" UWORD EH_STANDARD_S4_S3 1 100 0 65535 ECU_ADDRESS 0xFFF8A6A6 /end MEASUREMENT
/begin MEASUREMENT di_filter_max_val[136] "maximum reached filter value of error code [0 .. 254-1]" UWORD EH_STANDARD_S4_S3 1 100 0 65535 ECU_ADDRESS 0xFFF8A6A8 /end MEASUREMENT
/begin MEASUREMENT di_filter_max_val[137] "maximum reached filter value of error code [0 .. 254-1]" UWORD EH_STANDARD_S4_S3 1 100 0 65535 ECU_ADDRESS 0xFFF8A6AA /end MEASUREMENT
/begin MEASUREMENT di_filter_max_val[138] "maximum reached filter value of error code [0 .. 254-1]" UWORD EH_STANDARD_S4_S3 1 100 0 65535 ECU_ADDRESS 0xFFF8A6AC /end MEASUREMENT
/begin MEASUREMENT di_filter_max_val[139] "maximum reached filter value of error code [0 .. 254-1]" UWORD EH_STANDARD_S4_S3 1 100 0 65535 ECU_ADDRESS 0xFFF8A6AE /end MEASUREMENT
/begin MEASUREMENT di_filter_max_val[13] "maximum reached filter value of error code [0 .. 254-1]" UWORD EH_STANDARD_S4_S3 1 100 0 65535 ECU_ADDRESS 0xFFF8A5B2 /end MEASUREMENT
/begin MEASUREMENT di_filter_max_val[140] "maximum reached filter value of error code [0 .. 254-1]" UWORD EH_STANDARD_S4_S3 1 100 0 65535 ECU_ADDRESS 0xFFF8A6B0 /end MEASUREMENT
/begin MEASUREMENT di_filter_max_val[141] "maximum reached filter value of error code [0 .. 254-1]" UWORD EH_STANDARD_S4_S3 1 100 0 65535 ECU_ADDRESS 0xFFF8A6B2 /end MEASUREMENT
/begin MEASUREMENT di_filter_max_val[142] "maximum reached filter value of error code [0 .. 254-1]" UWORD EH_STANDARD_S4_S3 1 100 0 65535 ECU_ADDRESS 0xFFF8A6B4 /end MEASUREMENT
/begin MEASUREMENT di_filter_max_val[143] "maximum reached filter value of error code [0 .. 254-1]" UWORD EH_STANDARD_S4_S3 1 100 0 65535 ECU_ADDRESS 0xFFF8A6B6 /end MEASUREMENT
/begin MEASUREMENT di_filter_max_val[144] "maximum reached filter value of error code [0 .. 254-1]" UWORD EH_STANDARD_S4_S3 1 100 0 65535 ECU_ADDRESS 0xFFF8A6B8 /end MEASUREMENT
/begin MEASUREMENT di_filter_max_val[145] "maximum reached filter value of error code [0 .. 254-1]" UWORD EH_STANDARD_S4_S3 1 100 0 65535 ECU_ADDRESS 0xFFF8A6BA /end MEASUREMENT
/begin MEASUREMENT di_filter_max_val[146] "maximum reached filter value of error code [0 .. 254-1]" UWORD EH_STANDARD_S4_S3 1 100 0 65535 ECU_ADDRESS 0xFFF8A6BC /end MEASUREMENT
/begin MEASUREMENT di_filter_max_val[147] "maximum reached filter value of error code [0 .. 254-1]" UWORD EH_STANDARD_S4_S3 1 100 0 65535 ECU_ADDRESS 0xFFF8A6BE /end MEASUREMENT
/begin MEASUREMENT di_filter_max_val[148] "maximum reached filter value of error code [0 .. 254-1]" UWORD EH_STANDARD_S4_S3 1 100 0 65535 ECU_ADDRESS 0xFFF8A6C0 /end MEASUREMENT
/begin MEASUREMENT di_filter_max_val[149] "maximum reached filter value of error code [0 .. 254-1]" UWORD EH_STANDARD_S4_S3 1 100 0 65535 ECU_ADDRESS 0xFFF8A6C2 /end MEASUREMENT
/begin MEASUREMENT di_filter_max_val[14] "maximum reached filter value of error code [0 .. 254-1]" UWORD EH_STANDARD_S4_S3 1 100 0 65535 ECU_ADDRESS 0xFFF8A5B4 /end MEASUREMENT
/begin MEASUREMENT di_filter_max_val[150] "maximum reached filter value of error code [0 .. 254-1]" UWORD EH_STANDARD_S4_S3 1 100 0 65535 ECU_ADDRESS 0xFFF8A6C4 /end MEASUREMENT
/begin MEASUREMENT di_filter_max_val[151] "maximum reached filter value of error code [0 .. 254-1]" UWORD EH_STANDARD_S4_S3 1 100 0 65535 ECU_ADDRESS 0xFFF8A6C6 /end MEASUREMENT
/begin MEASUREMENT di_filter_max_val[152] "maximum reached filter value of error code [0 .. 254-1]" UWORD EH_STANDARD_S4_S3 1 100 0 65535 ECU_ADDRESS 0xFFF8A6C8 /end MEASUREMENT
/begin MEASUREMENT di_filter_max_val[153] "maximum reached filter value of error code [0 .. 254-1]" UWORD EH_STANDARD_S4_S3 1 100 0 65535 ECU_ADDRESS 0xFFF8A6CA /end MEASUREMENT
/begin MEASUREMENT di_filter_max_val[154] "maximum reached filter value of error code [0 .. 254-1]" UWORD EH_STANDARD_S4_S3 1 100 0 65535 ECU_ADDRESS 0xFFF8A6CC /end MEASUREMENT
/begin MEASUREMENT di_filter_max_val[155] "maximum reached filter value of error code [0 .. 254-1]" UWORD EH_STANDARD_S4_S3 1 100 0 65535 ECU_ADDRESS 0xFFF8A6CE /end MEASUREMENT
/end MODULE
/end PROJECT
