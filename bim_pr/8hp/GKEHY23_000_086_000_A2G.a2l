ASAP2_VERSION 1 51
/begin PROJECT ZHBC8600 "Gen2_BMW_System_Supplier_Lib"
/begin MODULE CPP ""
/begin MOD_COMMON "" BYTE_ORDER MSB_FIRST ALIGNMENT_BYTE 1 ALIGNMENT_WORD 2 ALIGNMENT_LONG 4 ALIGNMENT_FLOAT32_IEEE 4 ALIGNMENT_FLOAT64_IEEE 1 /end MOD_COMMON
/begin COMPU_METHOD EH_P_5MBAR_S4_S3 "int = ((phys * 1) / 5) - (0) mbar" RAT_FUNC "%1.0" "mbar" COEFFS 0 0.2 0 0 0 1 /end COMPU_METHOD
/begin COMPU_METHOD EH_T_100MS_S4_S3 "int = ((phys * 1) / 100) - (0) ms" RAT_FUNC "%1.0" "ms" COEFFS 0 0.01 0 0 0 1 /end COMPU_METHOD
/begin COMPU_METHOD EH_T_10MS_S4_S3 "int = ((phys * 1) / 10) - (0) ms" RAT_FUNC "%1.0" "ms" COEFFS 0 0.1 0 0 0 1 /end COMPU_METHOD
/begin COMPU_METHOD EH_T_S100_S4_S3 "int = ((phys * 100) / 1) - (0) s" RAT_FUNC "%3.2" "s" COEFFS 0 100 0 0 0 1 /end COMPU_METHOD
/begin COMPU_METHOD EH_V_KMH50_S4_S3 "int = ((phys * 50) / 1) - (0) km/h" RAT_FUNC "%3.2" "km/h" COEFFS 0 50 0 0 0 1 /end COMPU_METHOD
/begin COMPU_METHOD UMR___1_100_0_S5_S3 "int = ((phys * 100) / 1) - (0) [-]" RAT_FUNC "%3.2" "[-]" COEFFS 0 100 0 0 0 1 /end COMPU_METHOD
/begin COMPU_METHOD UMR___1_1_0_S5_S3 "int = ((phys * 1) / 1) - (0) [-]" RAT_FUNC "%1.0" "[-]" COEFFS 0 1 0 0 0 1 /end COMPU_METHOD
/begin COMPU_METHOD UMR_BAR__1_1000_0_S5_S3 "int = ((phys * 1000) / 1) - (0) [bar]" RAT_FUNC "%4.3" "[bar]" COEFFS 0 1000 0 0 0 1 /end COMPU_METHOD
/begin COMPU_METHOD UMR_GRADC__1_1_M40_S5_S3 "int = ((phys * 1) / 1) - (-40) [°C]" RAT_FUNC "%1.0" "[°C]" COEFFS 0 1 40 0 0 1 /end COMPU_METHOD
/begin COMPU_METHOD UMR_MBARMINSEC_10MSEC_1_1_0_S5_S3 "int = ((phys * 1) / 1) - (0) [0,00031mbar/(10ms/(min*s))]" RAT_FUNC "%1.0" "[0,00031mbar/(10ms/(min*s))]" COEFFS 0 1 0 0 0 1 /end COMPU_METHOD
/begin COMPU_METHOD UMR_MBARMINSEC__1_1_0_S5_S3 "int = ((phys * 1) / 1) - (0) [0,02mbar/(1/(min*s))]" RAT_FUNC "%1.0" "[0,02mbar/(1/(min*s))]" COEFFS 0 1 0 0 0 1 /end COMPU_METHOD
/begin COMPU_METHOD UMR_MSEC__10_1_0_S5_S3 "int = ((phys * 1) / 10) - (0) [ms]" RAT_FUNC "%1.0" "[ms]" COEFFS 0 0.1 0 0 0 1 /end COMPU_METHOD
/begin COMPU_METHOD UMR_MSEC__10_1_M255_S5_S3 "int = ((phys * 1) / 10) - (-255) [ms]" RAT_FUNC "%1.0" "[ms]" COEFFS 0 0.1 255 0 0 1 /end COMPU_METHOD
/begin COMPU_METHOD UMR_MSEC__1_1_0_S5_S3 "int = ((phys * 1) / 1) - (0) [ms]" RAT_FUNC "%1.0" "[ms]" COEFFS 0 1 0 0 0 1 /end COMPU_METHOD
/begin COMPU_METHOD UMR_NM__6_1_M34_S5_S3 "int = ((phys * 1) / 6) - (-34) [Nm]" RAT_FUNC "%1.0" "[Nm]" COEFFS 0 0.166666666667 34 0 0 1 /end COMPU_METHOD
/begin COMPU_METHOD UMR_U_MIN_1_1_0_S5_S3 "int = ((phys * 1) / 1) - (0) [U/min]" RAT_FUNC "%1.0" "[U/min]" COEFFS 0 1 0 0 0 1 /end COMPU_METHOD
/begin COMPU_METHOD UMR_U_MIN_32_1_0_S5_S3 "int = ((phys * 1) / 32) - (0) [U/min]" RAT_FUNC "%1.0" "[U/min]" COEFFS 0 0.03125 0 0 0 1 /end COMPU_METHOD
/begin COMPU_METHOD UMR_U_MINSEC2_1_1_0_S5_S3 "int = ((phys * 1) / 1) - (0) [U/(min*s^2)]" RAT_FUNC "%1.0" "[U/(min*s^2)]" COEFFS 0 1 0 0 0 1 /end COMPU_METHOD
/begin COMPU_METHOD UMR_U_MINSEC_1_1_0_S5_S3 "int = ((phys * 1) / 1) - (0) [U/(min*s)]" RAT_FUNC "%1.0" "[U/(min*s)]" COEFFS 0 1 0 0 0 1 /end COMPU_METHOD
/begin CHARACTERISTIC CS_GLSGE "Getriebetemp.schwelle Einstieg Regelung Gangeinlegen" VALUE 0x1D7939 ZF_kw_ui8_S5_S3 190 UMR_GRADC__1_1_M40_S5_S3 -40 150 /end CHARACTERISTIC
/begin CHARACTERISTIC HYS_NGS_VERIAE21 "Hysterese für Gradientenschwelle bei IAE" VALUE 0x1D8714 ZF_kw_si16_S5_S3 20000 UMR_U_MINSEC_1_1_0_S5_S3 -10000 10000 /end CHARACTERISTIC
/begin CHARACTERISTIC HYS_NGS_VERIAE32 "Hysterese für Gradientenschwelle bei IAE" VALUE 0x1D871C ZF_kw_si16_S5_S3 20000 UMR_U_MINSEC_1_1_0_S5_S3 -10000 10000 /end CHARACTERISTIC
/begin CHARACTERISTIC HYS_NGS_VERIAE43 "Hysterese für Gradientenschwelle bei IAE" VALUE 0x1D8724 ZF_kw_si16_S5_S3 20000 UMR_U_MINSEC_1_1_0_S5_S3 -10000 10000 /end CHARACTERISTIC
/begin CHARACTERISTIC HYS_NGS_VERIAE54 "Hysterese für Gradientenschwelle bei IAE" VALUE 0x1D872C ZF_kw_si16_S5_S3 20000 UMR_U_MINSEC_1_1_0_S5_S3 -10000 10000 /end CHARACTERISTIC
/begin CHARACTERISTIC HYS_NGS_VERIAE65 "Hysterese für Gradientenschwelle bei IAE" VALUE 0x1D8734 ZF_kw_si16_S5_S3 20000 UMR_U_MINSEC_1_1_0_S5_S3 -10000 10000 /end CHARACTERISTIC
/begin CHARACTERISTIC HYS_NGS_VERIAE76 "Hysterese für Gradientenschwelle bei IAE" VALUE 0x1D873C ZF_kw_si16_S5_S3 20000 UMR_U_MINSEC_1_1_0_S5_S3 -10000 10000 /end CHARACTERISTIC
/begin CHARACTERISTIC HYS_NGS_VERIAE87 "Hysterese für Gradientenschwelle bei IAE" VALUE 0x1D8744 ZF_kw_si16_S5_S3 20000 UMR_U_MINSEC_1_1_0_S5_S3 -10000 10000 /end CHARACTERISTIC
/begin CHARACTERISTIC HYS_NGS_VERIAESP31 "Hysterese für Gradientenschwelle bei IAE" VALUE 0x1D874C ZF_kw_si16_S5_S3 20000 UMR_U_MINSEC_1_1_0_S5_S3 -10000 10000 /end CHARACTERISTIC
/begin CHARACTERISTIC HYS_NGS_VERIAESP42 "Hysterese für Gradientenschwelle bei IAE" VALUE 0x1D8754 ZF_kw_si16_S5_S3 20000 UMR_U_MINSEC_1_1_0_S5_S3 -10000 10000 /end CHARACTERISTIC
/begin CHARACTERISTIC HYS_NGS_VERIAESP51 "Hysterese für Gradientenschwelle bei IAE" VALUE 0x1D875C ZF_kw_si16_S5_S3 20000 UMR_U_MINSEC_1_1_0_S5_S3 -10000 10000 /end CHARACTERISTIC
/begin CHARACTERISTIC HYS_NGS_VERIAESP53 "Hysterese für Gradientenschwelle bei IAE" VALUE 0x1D8764 ZF_kw_si16_S5_S3 20000 UMR_U_MINSEC_1_1_0_S5_S3 -10000 10000 /end CHARACTERISTIC
/begin CHARACTERISTIC HYS_NGS_VERIAESP63 "Hysterese für Gradientenschwelle bei IAE" VALUE 0x1D876C ZF_kw_si16_S5_S3 20000 UMR_U_MINSEC_1_1_0_S5_S3 -10000 10000 /end CHARACTERISTIC
/begin CHARACTERISTIC HYS_NGS_VERIAESP64 "Hysterese für Gradientenschwelle bei IAE" VALUE 0x1D8774 ZF_kw_si16_S5_S3 20000 UMR_U_MINSEC_1_1_0_S5_S3 -10000 10000 /end CHARACTERISTIC
/begin CHARACTERISTIC HYS_NGS_VERIAESP71 "Hysterese für Gradientenschwelle bei IAE" VALUE 0x1D877C ZF_kw_si16_S5_S3 20000 UMR_U_MINSEC_1_1_0_S5_S3 -10000 10000 /end CHARACTERISTIC
/begin CHARACTERISTIC HYS_NGS_VERIAESP75 "Hysterese für Gradientenschwelle bei IAE" VALUE 0x1D8784 ZF_kw_si16_S5_S3 20000 UMR_U_MINSEC_1_1_0_S5_S3 -10000 10000 /end CHARACTERISTIC
/begin CHARACTERISTIC HYS_NGS_VERIAESP82 "Hysterese für Gradientenschwelle bei IAE" VALUE 0x1D878C ZF_kw_si16_S5_S3 20000 UMR_U_MINSEC_1_1_0_S5_S3 -10000 10000 /end CHARACTERISTIC
/begin CHARACTERISTIC HYS_NGS_VERIAESP84 "Hysterese für Gradientenschwelle bei IAE" VALUE 0x1D8794 ZF_kw_si16_S5_S3 20000 UMR_U_MINSEC_1_1_0_S5_S3 -10000 10000 /end CHARACTERISTIC
/begin CHARACTERISTIC HYS_NGS_VERIAESP86 "Hysterese für Gradientenschwelle bei IAE" VALUE 0x1D879C ZF_kw_si16_S5_S3 20000 UMR_U_MINSEC_1_1_0_S5_S3 -10000 10000 /end CHARACTERISTIC
/begin CHARACTERISTIC KF_TSYNCGMTHINSYNRASP75 "Zeit vor sync. fur Rampenende Haltephase in Synchron" MAP 0x1B099C ZF_kf_ui8_S5_S3 2550 UMR_MSEC__10_1_M255_S5_S3 -2550 0
 /begin AXIS_DESCR STD_AXIS zff_atsys._.iSignale._.obj.sig_c_getr UMR_GRADC__1_1_M40_S5_S3 4 -40 215 DEPOSIT ABSOLUTE /end AXIS_DESCR
 /begin AXIS_DESCR STD_AXIS zff_atsys._.iSignale._.obj.sig_m_t8 UMR_NM__6_1_M34_S5_S3 4 -204 1326 DEPOSIT ABSOLUTE /end AXIS_DESCR
/end CHARACTERISTIC
/begin CHARACTERISTIC KF_TSYNCGMTHINSYNRASP76 "Zeit vor sync. fur Rampenende Haltephase in Synchron" MAP 0x1B075C ZF_kf_ui8_S5_S3 2550 UMR_MSEC__10_1_M255_S5_S3 -2550 0
 /begin AXIS_DESCR STD_AXIS zff_atsys._.iSignale._.obj.sig_c_getr UMR_GRADC__1_1_M40_S5_S3 4 -40 215 DEPOSIT ABSOLUTE /end AXIS_DESCR
 /begin AXIS_DESCR STD_AXIS zff_atsys._.iSignale._.obj.sig_m_t8 UMR_NM__6_1_M34_S5_S3 4 -204 1326 DEPOSIT ABSOLUTE /end AXIS_DESCR
/end CHARACTERISTIC
/begin CHARACTERISTIC KF_TSYNCGMTHINSYNRASP82 "Zeit vor sync. fur Rampenende Haltephase in Synchron" MAP 0x1B09DC ZF_kf_ui8_S5_S3 2550 UMR_MSEC__10_1_M255_S5_S3 -2550 0
 /begin AXIS_DESCR STD_AXIS zff_atsys._.iSignale._.obj.sig_c_getr UMR_GRADC__1_1_M40_S5_S3 4 -40 215 DEPOSIT ABSOLUTE /end AXIS_DESCR
 /begin AXIS_DESCR STD_AXIS zff_atsys._.iSignale._.obj.sig_m_t8 UMR_NM__6_1_M34_S5_S3 4 -204 1326 DEPOSIT ABSOLUTE /end AXIS_DESCR
/end CHARACTERISTIC
/begin CHARACTERISTIC KF_TSYNCGMTHINSYNRASP84 "Zeit vor sync. fur Rampenende Haltephase in Synchron" MAP 0x1B0A1C ZF_kf_ui8_S5_S3 2550 UMR_MSEC__10_1_M255_S5_S3 -2550 0
 /begin AXIS_DESCR STD_AXIS zff_atsys._.iSignale._.obj.sig_c_getr UMR_GRADC__1_1_M40_S5_S3 4 -40 215 DEPOSIT ABSOLUTE /end AXIS_DESCR
 /begin AXIS_DESCR STD_AXIS zff_atsys._.iSignale._.obj.sig_m_t8 UMR_NM__6_1_M34_S5_S3 4 -204 1326 DEPOSIT ABSOLUTE /end AXIS_DESCR
/end CHARACTERISTIC
/begin CHARACTERISTIC KF_TSYNCGMTHINSYNRASP86 "Zeit vor sync. fur Rampenende Haltephase in Synchron" MAP 0x1B0A5C ZF_kf_ui8_S5_S3 2550 UMR_MSEC__10_1_M255_S5_S3 -2550 0
 /begin AXIS_DESCR STD_AXIS zff_atsys._.iSignale._.obj.sig_c_getr UMR_GRADC__1_1_M40_S5_S3 4 -40 215 DEPOSIT ABSOLUTE /end AXIS_DESCR
 /begin AXIS_DESCR STD_AXIS zff_atsys._.iSignale._.obj.sig_m_t8 UMR_NM__6_1_M34_S5_S3 4 -204 1326 DEPOSIT ABSOLUTE /end AXIS_DESCR
/end CHARACTERISTIC
/begin CHARACTERISTIC KF_TSYNCGMTHINSYNRASP87 "Zeit vor sync. fur Rampenende Haltephase in Synchron" MAP 0x1B079C ZF_kf_ui8_S5_S3 2550 UMR_MSEC__10_1_M255_S5_S3 -2550 0
 /begin AXIS_DESCR STD_AXIS zff_atsys._.iSignale._.obj.sig_c_getr UMR_GRADC__1_1_M40_S5_S3 4 -40 215 DEPOSIT ABSOLUTE /end AXIS_DESCR
 /begin AXIS_DESCR STD_AXIS zff_atsys._.iSignale._.obj.sig_m_t8 UMR_NM__6_1_M34_S5_S3 4 -204 1326 DEPOSIT ABSOLUTE /end AXIS_DESCR
/end CHARACTERISTIC
/begin CHARACTERISTIC KF_TSYNCGMTHINSYNRASPORT21 "Zeit vor sync. fur Rampenende Haltephase in Synchron" MAP 0x1B0A9C ZF_kf_ui8_S5_S3 2550 UMR_MSEC__10_1_M255_S5_S3 -2550 0
 /begin AXIS_DESCR STD_AXIS zff_atsys._.iSignale._.obj.sig_c_getr UMR_GRADC__1_1_M40_S5_S3 4 -40 215 DEPOSIT ABSOLUTE /end AXIS_DESCR
 /begin AXIS_DESCR STD_AXIS zff_atsys._.iSignale._.obj.sig_m_t8 UMR_NM__6_1_M34_S5_S3 4 -204 1326 DEPOSIT ABSOLUTE /end AXIS_DESCR
/end CHARACTERISTIC
/begin CHARACTERISTIC KF_TSYNCGMTHINSYNRASPORT31 "Zeit vor sync. fur Rampenende Haltephase in Synchron" MAP 0x1B0C5C ZF_kf_ui8_S5_S3 2550 UMR_MSEC__10_1_M255_S5_S3 -2550 0
 /begin AXIS_DESCR STD_AXIS zff_atsys._.iSignale._.obj.sig_c_getr UMR_GRADC__1_1_M40_S5_S3 4 -40 215 DEPOSIT ABSOLUTE /end AXIS_DESCR
 /begin AXIS_DESCR STD_AXIS zff_atsys._.iSignale._.obj.sig_m_t8 UMR_NM__6_1_M34_S5_S3 4 -204 1326 DEPOSIT ABSOLUTE /end AXIS_DESCR
/end CHARACTERISTIC
/begin CHARACTERISTIC KF_TSYNCGMTHINSYNRASPORT32 "Zeit vor sync. fur Rampenende Haltephase in Synchron" MAP 0x1B0ADC ZF_kf_ui8_S5_S3 2550 UMR_MSEC__10_1_M255_S5_S3 -2550 0
 /begin AXIS_DESCR STD_AXIS zff_atsys._.iSignale._.obj.sig_c_getr UMR_GRADC__1_1_M40_S5_S3 4 -40 215 DEPOSIT ABSOLUTE /end AXIS_DESCR
 /begin AXIS_DESCR STD_AXIS zff_atsys._.iSignale._.obj.sig_m_t8 UMR_NM__6_1_M34_S5_S3 4 -204 1326 DEPOSIT ABSOLUTE /end AXIS_DESCR
/end CHARACTERISTIC
/begin CHARACTERISTIC KF_TSYNCGMTHINSYNRASPORT42 "Zeit vor sync. fur Rampenende Haltephase in Synchron" MAP 0x1B0C9C ZF_kf_ui8_S5_S3 2550 UMR_MSEC__10_1_M255_S5_S3 -2550 0
 /begin AXIS_DESCR STD_AXIS zff_atsys._.iSignale._.obj.sig_c_getr UMR_GRADC__1_1_M40_S5_S3 4 -40 215 DEPOSIT ABSOLUTE /end AXIS_DESCR
 /begin AXIS_DESCR STD_AXIS zff_atsys._.iSignale._.obj.sig_m_t8 UMR_NM__6_1_M34_S5_S3 4 -204 1326 DEPOSIT ABSOLUTE /end AXIS_DESCR
/end CHARACTERISTIC
/begin CHARACTERISTIC KF_TSYNCGMTHINSYNRASPORT43 "Zeit vor sync. fur Rampenende Haltephase in Synchron" MAP 0x1B0B1C ZF_kf_ui8_S5_S3 2550 UMR_MSEC__10_1_M255_S5_S3 -2550 0
 /begin AXIS_DESCR STD_AXIS zff_atsys._.iSignale._.obj.sig_c_getr UMR_GRADC__1_1_M40_S5_S3 4 -40 215 DEPOSIT ABSOLUTE /end AXIS_DESCR
 /begin AXIS_DESCR STD_AXIS zff_atsys._.iSignale._.obj.sig_m_t8 UMR_NM__6_1_M34_S5_S3 4 -204 1326 DEPOSIT ABSOLUTE /end AXIS_DESCR
/end CHARACTERISTIC
/begin CHARACTERISTIC KF_TSYNCGMTHINSYNRASPORT51 "Zeit vor sync. fur Rampenende Haltephase in Synchron" MAP 0x1B0CDC ZF_kf_ui8_S5_S3 2550 UMR_MSEC__10_1_M255_S5_S3 -2550 0
 /begin AXIS_DESCR STD_AXIS zff_atsys._.iSignale._.obj.sig_c_getr UMR_GRADC__1_1_M40_S5_S3 4 -40 215 DEPOSIT ABSOLUTE /end AXIS_DESCR
 /begin AXIS_DESCR STD_AXIS zff_atsys._.iSignale._.obj.sig_m_t8 UMR_NM__6_1_M34_S5_S3 4 -204 1326 DEPOSIT ABSOLUTE /end AXIS_DESCR
/end CHARACTERISTIC
/begin CHARACTERISTIC KF_TSYNCGMTHINSYNRASPORT53 "Zeit vor sync. fur Rampenende Haltephase in Synchron" MAP 0x1B0D1C ZF_kf_ui8_S5_S3 2550 UMR_MSEC__10_1_M255_S5_S3 -2550 0
 /begin AXIS_DESCR STD_AXIS zff_atsys._.iSignale._.obj.sig_c_getr UMR_GRADC__1_1_M40_S5_S3 4 -40 215 DEPOSIT ABSOLUTE /end AXIS_DESCR
 /begin AXIS_DESCR STD_AXIS zff_atsys._.iSignale._.obj.sig_m_t8 UMR_NM__6_1_M34_S5_S3 4 -204 1326 DEPOSIT ABSOLUTE /end AXIS_DESCR
/end CHARACTERISTIC
/begin CHARACTERISTIC KF_TSYNCGMTHINSYNRASPORT54 "Zeit vor sync. fur Rampenende Haltephase in Synchron" MAP 0x1B0B5C ZF_kf_ui8_S5_S3 2550 UMR_MSEC__10_1_M255_S5_S3 -2550 0
 /begin AXIS_DESCR STD_AXIS zff_atsys._.iSignale._.obj.sig_c_getr UMR_GRADC__1_1_M40_S5_S3 4 -40 215 DEPOSIT ABSOLUTE /end AXIS_DESCR
 /begin AXIS_DESCR STD_AXIS zff_atsys._.iSignale._.obj.sig_m_t8 UMR_NM__6_1_M34_S5_S3 4 -204 1326 DEPOSIT ABSOLUTE /end AXIS_DESCR
/end CHARACTERISTIC
/begin CHARACTERISTIC KF_TSYNCGMTHINSYNRASPORT63 "Zeit vor sync. fur Rampenende Haltephase in Synchron" MAP 0x1B0D5C ZF_kf_ui8_S5_S3 2550 UMR_MSEC__10_1_M255_S5_S3 -2550 0
 /begin AXIS_DESCR STD_AXIS zff_atsys._.iSignale._.obj.sig_c_getr UMR_GRADC__1_1_M40_S5_S3 4 -40 215 DEPOSIT ABSOLUTE /end AXIS_DESCR
 /begin AXIS_DESCR STD_AXIS zff_atsys._.iSignale._.obj.sig_m_t8 UMR_NM__6_1_M34_S5_S3 4 -204 1326 DEPOSIT ABSOLUTE /end AXIS_DESCR
/end CHARACTERISTIC
/begin CHARACTERISTIC KF_TSYNCGMTHINSYNRASPORT64 "Zeit vor sync. fur Rampenende Haltephase in Synchron" MAP 0x1B0D9C ZF_kf_ui8_S5_S3 2550 UMR_MSEC__10_1_M255_S5_S3 -2550 0
 /begin AXIS_DESCR STD_AXIS zff_atsys._.iSignale._.obj.sig_c_getr UMR_GRADC__1_1_M40_S5_S3 4 -40 215 DEPOSIT ABSOLUTE /end AXIS_DESCR
 /begin AXIS_DESCR STD_AXIS zff_atsys._.iSignale._.obj.sig_m_t8 UMR_NM__6_1_M34_S5_S3 4 -204 1326 DEPOSIT ABSOLUTE /end AXIS_DESCR
/end CHARACTERISTIC
/begin CHARACTERISTIC KF_TSYNCGMTHINSYNRASPORT65 "Zeit vor sync. fur Rampenende Haltephase in Synchron" MAP 0x1B0B9C ZF_kf_ui8_S5_S3 2550 UMR_MSEC__10_1_M255_S5_S3 -2550 0
 /begin AXIS_DESCR STD_AXIS zff_atsys._.iSignale._.obj.sig_c_getr UMR_GRADC__1_1_M40_S5_S3 4 -40 215 DEPOSIT ABSOLUTE /end AXIS_DESCR
 /begin AXIS_DESCR STD_AXIS zff_atsys._.iSignale._.obj.sig_m_t8 UMR_NM__6_1_M34_S5_S3 4 -204 1326 DEPOSIT ABSOLUTE /end AXIS_DESCR
/end CHARACTERISTIC
/begin CHARACTERISTIC KF_TSYNCGMTHINSYNRASPORT71 "Zeit vor sync. fur Rampenende Haltephase in Synchron" MAP 0x1B0DDC ZF_kf_ui8_S5_S3 2550 UMR_MSEC__10_1_M255_S5_S3 -2550 0
 /begin AXIS_DESCR STD_AXIS zff_atsys._.iSignale._.obj.sig_c_getr UMR_GRADC__1_1_M40_S5_S3 4 -40 215 DEPOSIT ABSOLUTE /end AXIS_DESCR
 /begin AXIS_DESCR STD_AXIS zff_atsys._.iSignale._.obj.sig_m_t8 UMR_NM__6_1_M34_S5_S3 4 -204 1326 DEPOSIT ABSOLUTE /end AXIS_DESCR
/end CHARACTERISTIC
/begin CHARACTERISTIC KF_TSYNCGMTHINSYNRASPORT75 "Zeit vor sync. fur Rampenende Haltephase in Synchron" MAP 0x1B0E1C ZF_kf_ui8_S5_S3 2550 UMR_MSEC__10_1_M255_S5_S3 -2550 0
 /begin AXIS_DESCR STD_AXIS zff_atsys._.iSignale._.obj.sig_c_getr UMR_GRADC__1_1_M40_S5_S3 4 -40 215 DEPOSIT ABSOLUTE /end AXIS_DESCR
 /begin AXIS_DESCR STD_AXIS zff_atsys._.iSignale._.obj.sig_m_t8 UMR_NM__6_1_M34_S5_S3 4 -204 1326 DEPOSIT ABSOLUTE /end AXIS_DESCR
/end CHARACTERISTIC
/begin CHARACTERISTIC KF_TSYNCGMTHINSYNRASPORT76 "Zeit vor sync. fur Rampenende Haltephase in Synchron" MAP 0x1B0BDC ZF_kf_ui8_S5_S3 2550 UMR_MSEC__10_1_M255_S5_S3 -2550 0
 /begin AXIS_DESCR STD_AXIS zff_atsys._.iSignale._.obj.sig_c_getr UMR_GRADC__1_1_M40_S5_S3 4 -40 215 DEPOSIT ABSOLUTE /end AXIS_DESCR
 /begin AXIS_DESCR STD_AXIS zff_atsys._.iSignale._.obj.sig_m_t8 UMR_NM__6_1_M34_S5_S3 4 -204 1326 DEPOSIT ABSOLUTE /end AXIS_DESCR
/end CHARACTERISTIC
/begin CHARACTERISTIC KF_TSYNCGMTHINSYNRASPORT82 "Zeit vor sync. fur Rampenende Haltephase in Synchron" MAP 0x1B0E5C ZF_kf_ui8_S5_S3 2550 UMR_MSEC__10_1_M255_S5_S3 -2550 0
 /begin AXIS_DESCR STD_AXIS zff_atsys._.iSignale._.obj.sig_c_getr UMR_GRADC__1_1_M40_S5_S3 4 -40 215 DEPOSIT ABSOLUTE /end AXIS_DESCR
 /begin AXIS_DESCR STD_AXIS zff_atsys._.iSignale._.obj.sig_m_t8 UMR_NM__6_1_M34_S5_S3 4 -204 1326 DEPOSIT ABSOLUTE /end AXIS_DESCR
/end CHARACTERISTIC
/begin CHARACTERISTIC KF_TSYNCGMTHINSYNRASPORT84 "Zeit vor sync. fur Rampenende Haltephase in Synchron" MAP 0x1B0E9C ZF_kf_ui8_S5_S3 2550 UMR_MSEC__10_1_M255_S5_S3 -2550 0
 /begin AXIS_DESCR STD_AXIS zff_atsys._.iSignale._.obj.sig_c_getr UMR_GRADC__1_1_M40_S5_S3 4 -40 215 DEPOSIT ABSOLUTE /end AXIS_DESCR
 /begin AXIS_DESCR STD_AXIS zff_atsys._.iSignale._.obj.sig_m_t8 UMR_NM__6_1_M34_S5_S3 4 -204 1326 DEPOSIT ABSOLUTE /end AXIS_DESCR
/end CHARACTERISTIC
/begin CHARACTERISTIC KF_TSYNCGMTHINSYNRASPORT86 "Zeit vor sync. fur Rampenende Haltephase in Synchron" MAP 0x1B0EDC ZF_kf_ui8_S5_S3 2550 UMR_MSEC__10_1_M255_S5_S3 -2550 0
 /begin AXIS_DESCR STD_AXIS zff_atsys._.iSignale._.obj.sig_c_getr UMR_GRADC__1_1_M40_S5_S3 4 -40 215 DEPOSIT ABSOLUTE /end AXIS_DESCR
 /begin AXIS_DESCR STD_AXIS zff_atsys._.iSignale._.obj.sig_m_t8 UMR_NM__6_1_M34_S5_S3 4 -204 1326 DEPOSIT ABSOLUTE /end AXIS_DESCR
/end CHARACTERISTIC
/begin CHARACTERISTIC KF_TSYNCGMTHINSYNRASPORT87 "Zeit vor sync. fur Rampenende Haltephase in Synchron" MAP 0x1B0C1C ZF_kf_ui8_S5_S3 2550 UMR_MSEC__10_1_M255_S5_S3 -2550 0
 /begin AXIS_DESCR STD_AXIS zff_atsys._.iSignale._.obj.sig_c_getr UMR_GRADC__1_1_M40_S5_S3 4 -40 215 DEPOSIT ABSOLUTE /end AXIS_DESCR
 /begin AXIS_DESCR STD_AXIS zff_atsys._.iSignale._.obj.sig_m_t8 UMR_NM__6_1_M34_S5_S3 4 -204 1326 DEPOSIT ABSOLUTE /end AXIS_DESCR
/end CHARACTERISTIC
/begin CHARACTERISTIC KF_TSYNCGMTHINSYNSP75 "Zeit vor sync. fur Rampenstart Haltephase in Synchron" MAP 0x1B097C ZF_kf_ui8_S5_S3 2550 UMR_MSEC__10_1_M255_S5_S3 -2550 0
 /begin AXIS_DESCR STD_AXIS zff_atsys._.iSignale._.obj.sig_c_getr UMR_GRADC__1_1_M40_S5_S3 4 -40 215 DEPOSIT ABSOLUTE /end AXIS_DESCR
 /begin AXIS_DESCR STD_AXIS zff_atsys._.iSignale._.obj.sig_m_t8 UMR_NM__6_1_M34_S5_S3 4 -204 1326 DEPOSIT ABSOLUTE /end AXIS_DESCR
/end CHARACTERISTIC
/begin CHARACTERISTIC KF_TSYNCGMTHINSYNSP76 "Zeit vor sync. fur Rampenstart Haltephase in Synchron" MAP 0x1B073C ZF_kf_ui8_S5_S3 2550 UMR_MSEC__10_1_M255_S5_S3 -2550 0
 /begin AXIS_DESCR STD_AXIS zff_atsys._.iSignale._.obj.sig_c_getr UMR_GRADC__1_1_M40_S5_S3 4 -40 215 DEPOSIT ABSOLUTE /end AXIS_DESCR
 /begin AXIS_DESCR STD_AXIS zff_atsys._.iSignale._.obj.sig_m_t8 UMR_NM__6_1_M34_S5_S3 4 -204 1326 DEPOSIT ABSOLUTE /end AXIS_DESCR
/end CHARACTERISTIC
/begin CHARACTERISTIC KF_TSYNCGMTHINSYNSP82 "Zeit vor sync. fur Rampenstart Haltephase in Synchron" MAP 0x1B09BC ZF_kf_ui8_S5_S3 2550 UMR_MSEC__10_1_M255_S5_S3 -2550 0
 /begin AXIS_DESCR STD_AXIS zff_atsys._.iSignale._.obj.sig_c_getr UMR_GRADC__1_1_M40_S5_S3 4 -40 215 DEPOSIT ABSOLUTE /end AXIS_DESCR
 /begin AXIS_DESCR STD_AXIS zff_atsys._.iSignale._.obj.sig_m_t8 UMR_NM__6_1_M34_S5_S3 4 -204 1326 DEPOSIT ABSOLUTE /end AXIS_DESCR
/end CHARACTERISTIC
/begin CHARACTERISTIC KF_TSYNCGMTHINSYNSP84 "Zeit vor sync. fur Rampenstart Haltephase in Synchron" MAP 0x1B09FC ZF_kf_ui8_S5_S3 2550 UMR_MSEC__10_1_M255_S5_S3 -2550 0
 /begin AXIS_DESCR STD_AXIS zff_atsys._.iSignale._.obj.sig_c_getr UMR_GRADC__1_1_M40_S5_S3 4 -40 215 DEPOSIT ABSOLUTE /end AXIS_DESCR
 /begin AXIS_DESCR STD_AXIS zff_atsys._.iSignale._.obj.sig_m_t8 UMR_NM__6_1_M34_S5_S3 4 -204 1326 DEPOSIT ABSOLUTE /end AXIS_DESCR
/end CHARACTERISTIC
/begin CHARACTERISTIC KF_TSYNCGMTHINSYNSP86 "Zeit vor sync. fur Rampenstart Haltephase in Synchron" MAP 0x1B0A3C ZF_kf_ui8_S5_S3 2550 UMR_MSEC__10_1_M255_S5_S3 -2550 0
 /begin AXIS_DESCR STD_AXIS zff_atsys._.iSignale._.obj.sig_c_getr UMR_GRADC__1_1_M40_S5_S3 4 -40 215 DEPOSIT ABSOLUTE /end AXIS_DESCR
 /begin AXIS_DESCR STD_AXIS zff_atsys._.iSignale._.obj.sig_m_t8 UMR_NM__6_1_M34_S5_S3 4 -204 1326 DEPOSIT ABSOLUTE /end AXIS_DESCR
/end CHARACTERISTIC
/begin CHARACTERISTIC KF_TSYNCGMTHINSYNSP87 "Zeit vor sync. fur Rampenstart Haltephase in Synchron" MAP 0x1B077C ZF_kf_ui8_S5_S3 2550 UMR_MSEC__10_1_M255_S5_S3 -2550 0
 /begin AXIS_DESCR STD_AXIS zff_atsys._.iSignale._.obj.sig_c_getr UMR_GRADC__1_1_M40_S5_S3 4 -40 215 DEPOSIT ABSOLUTE /end AXIS_DESCR
 /begin AXIS_DESCR STD_AXIS zff_atsys._.iSignale._.obj.sig_m_t8 UMR_NM__6_1_M34_S5_S3 4 -204 1326 DEPOSIT ABSOLUTE /end AXIS_DESCR
/end CHARACTERISTIC
/begin CHARACTERISTIC KF_TSYNCGMTHINSYNSPORT21 "Zeit vor sync. fur Rampenstart Haltephase in Synchron" MAP 0x1B0A7C ZF_kf_ui8_S5_S3 2550 UMR_MSEC__10_1_M255_S5_S3 -2550 0
 /begin AXIS_DESCR STD_AXIS zff_atsys._.iSignale._.obj.sig_c_getr UMR_GRADC__1_1_M40_S5_S3 4 -40 215 DEPOSIT ABSOLUTE /end AXIS_DESCR
 /begin AXIS_DESCR STD_AXIS zff_atsys._.iSignale._.obj.sig_m_t8 UMR_NM__6_1_M34_S5_S3 4 -204 1326 DEPOSIT ABSOLUTE /end AXIS_DESCR
/end CHARACTERISTIC
/begin CHARACTERISTIC KF_TSYNCGMTHINSYNSPORT31 "Zeit vor sync. fur Rampenstart Haltephase in Synchron" MAP 0x1B0C3C ZF_kf_ui8_S5_S3 2550 UMR_MSEC__10_1_M255_S5_S3 -2550 0
 /begin AXIS_DESCR STD_AXIS zff_atsys._.iSignale._.obj.sig_c_getr UMR_GRADC__1_1_M40_S5_S3 4 -40 215 DEPOSIT ABSOLUTE /end AXIS_DESCR
 /begin AXIS_DESCR STD_AXIS zff_atsys._.iSignale._.obj.sig_m_t8 UMR_NM__6_1_M34_S5_S3 4 -204 1326 DEPOSIT ABSOLUTE /end AXIS_DESCR
/end CHARACTERISTIC
/begin CHARACTERISTIC KF_TSYNCGMTHINSYNSPORT32 "Zeit vor sync. fur Rampenstart Haltephase in Synchron" MAP 0x1B0ABC ZF_kf_ui8_S5_S3 2550 UMR_MSEC__10_1_M255_S5_S3 -2550 0
 /begin AXIS_DESCR STD_AXIS zff_atsys._.iSignale._.obj.sig_c_getr UMR_GRADC__1_1_M40_S5_S3 4 -40 215 DEPOSIT ABSOLUTE /end AXIS_DESCR
 /begin AXIS_DESCR STD_AXIS zff_atsys._.iSignale._.obj.sig_m_t8 UMR_NM__6_1_M34_S5_S3 4 -204 1326 DEPOSIT ABSOLUTE /end AXIS_DESCR
/end CHARACTERISTIC
/begin CHARACTERISTIC KF_TSYNCGMTHINSYNSPORT42 "Zeit vor sync. fur Rampenstart Haltephase in Synchron" MAP 0x1B0C7C ZF_kf_ui8_S5_S3 2550 UMR_MSEC__10_1_M255_S5_S3 -2550 0
 /begin AXIS_DESCR STD_AXIS zff_atsys._.iSignale._.obj.sig_c_getr UMR_GRADC__1_1_M40_S5_S3 4 -40 215 DEPOSIT ABSOLUTE /end AXIS_DESCR
 /begin AXIS_DESCR STD_AXIS zff_atsys._.iSignale._.obj.sig_m_t8 UMR_NM__6_1_M34_S5_S3 4 -204 1326 DEPOSIT ABSOLUTE /end AXIS_DESCR
/end CHARACTERISTIC
/begin CHARACTERISTIC KF_TSYNCGMTHINSYNSPORT43 "Zeit vor sync. fur Rampenstart Haltephase in Synchron" MAP 0x1B0AFC ZF_kf_ui8_S5_S3 2550 UMR_MSEC__10_1_M255_S5_S3 -2550 0
 /begin AXIS_DESCR STD_AXIS zff_atsys._.iSignale._.obj.sig_c_getr UMR_GRADC__1_1_M40_S5_S3 4 -40 215 DEPOSIT ABSOLUTE /end AXIS_DESCR
 /begin AXIS_DESCR STD_AXIS zff_atsys._.iSignale._.obj.sig_m_t8 UMR_NM__6_1_M34_S5_S3 4 -204 1326 DEPOSIT ABSOLUTE /end AXIS_DESCR
/end CHARACTERISTIC
/begin CHARACTERISTIC KF_TSYNCGMTHINSYNSPORT51 "Zeit vor sync. fur Rampenstart Haltephase in Synchron" MAP 0x1B0CBC ZF_kf_ui8_S5_S3 2550 UMR_MSEC__10_1_M255_S5_S3 -2550 0
 /begin AXIS_DESCR STD_AXIS zff_atsys._.iSignale._.obj.sig_c_getr UMR_GRADC__1_1_M40_S5_S3 4 -40 215 DEPOSIT ABSOLUTE /end AXIS_DESCR
 /begin AXIS_DESCR STD_AXIS zff_atsys._.iSignale._.obj.sig_m_t8 UMR_NM__6_1_M34_S5_S3 4 -204 1326 DEPOSIT ABSOLUTE /end AXIS_DESCR
/end CHARACTERISTIC
/begin CHARACTERISTIC KF_TSYNCGMTHINSYNSPORT53 "Zeit vor sync. fur Rampenstart Haltephase in Synchron" MAP 0x1B0CFC ZF_kf_ui8_S5_S3 2550 UMR_MSEC__10_1_M255_S5_S3 -2550 0
 /begin AXIS_DESCR STD_AXIS zff_atsys._.iSignale._.obj.sig_c_getr UMR_GRADC__1_1_M40_S5_S3 4 -40 215 DEPOSIT ABSOLUTE /end AXIS_DESCR
 /begin AXIS_DESCR STD_AXIS zff_atsys._.iSignale._.obj.sig_m_t8 UMR_NM__6_1_M34_S5_S3 4 -204 1326 DEPOSIT ABSOLUTE /end AXIS_DESCR
/end CHARACTERISTIC
/begin CHARACTERISTIC KF_TSYNCGMTHINSYNSPORT54 "Zeit vor sync. fur Rampenstart Haltephase in Synchron" MAP 0x1B0B3C ZF_kf_ui8_S5_S3 2550 UMR_MSEC__10_1_M255_S5_S3 -2550 0
 /begin AXIS_DESCR STD_AXIS zff_atsys._.iSignale._.obj.sig_c_getr UMR_GRADC__1_1_M40_S5_S3 4 -40 215 DEPOSIT ABSOLUTE /end AXIS_DESCR
 /begin AXIS_DESCR STD_AXIS zff_atsys._.iSignale._.obj.sig_m_t8 UMR_NM__6_1_M34_S5_S3 4 -204 1326 DEPOSIT ABSOLUTE /end AXIS_DESCR
/end CHARACTERISTIC
/begin CHARACTERISTIC KF_TSYNCGMTHINSYNSPORT63 "Zeit vor sync. fur Rampenstart Haltephase in Synchron" MAP 0x1B0D3C ZF_kf_ui8_S5_S3 2550 UMR_MSEC__10_1_M255_S5_S3 -2550 0
 /begin AXIS_DESCR STD_AXIS zff_atsys._.iSignale._.obj.sig_c_getr UMR_GRADC__1_1_M40_S5_S3 4 -40 215 DEPOSIT ABSOLUTE /end AXIS_DESCR
 /begin AXIS_DESCR STD_AXIS zff_atsys._.iSignale._.obj.sig_m_t8 UMR_NM__6_1_M34_S5_S3 4 -204 1326 DEPOSIT ABSOLUTE /end AXIS_DESCR
/end CHARACTERISTIC
/begin CHARACTERISTIC KF_TSYNCGMTHINSYNSPORT64 "Zeit vor sync. fur Rampenstart Haltephase in Synchron" MAP 0x1B0D7C ZF_kf_ui8_S5_S3 2550 UMR_MSEC__10_1_M255_S5_S3 -2550 0
 /begin AXIS_DESCR STD_AXIS zff_atsys._.iSignale._.obj.sig_c_getr UMR_GRADC__1_1_M40_S5_S3 4 -40 215 DEPOSIT ABSOLUTE /end AXIS_DESCR
 /begin AXIS_DESCR STD_AXIS zff_atsys._.iSignale._.obj.sig_m_t8 UMR_NM__6_1_M34_S5_S3 4 -204 1326 DEPOSIT ABSOLUTE /end AXIS_DESCR
/end CHARACTERISTIC
/begin CHARACTERISTIC KF_TSYNCGMTHINSYNSPORT65 "Zeit vor sync. fur Rampenstart Haltephase in Synchron" MAP 0x1B0B7C ZF_kf_ui8_S5_S3 2550 UMR_MSEC__10_1_M255_S5_S3 -2550 0
 /begin AXIS_DESCR STD_AXIS zff_atsys._.iSignale._.obj.sig_c_getr UMR_GRADC__1_1_M40_S5_S3 4 -40 215 DEPOSIT ABSOLUTE /end AXIS_DESCR
 /begin AXIS_DESCR STD_AXIS zff_atsys._.iSignale._.obj.sig_m_t8 UMR_NM__6_1_M34_S5_S3 4 -204 1326 DEPOSIT ABSOLUTE /end AXIS_DESCR
/end CHARACTERISTIC
/begin CHARACTERISTIC KF_TSYNCGMTHINSYNSPORT71 "Zeit vor sync. fur Rampenstart Haltephase in Synchron" MAP 0x1B0DBC ZF_kf_ui8_S5_S3 2550 UMR_MSEC__10_1_M255_S5_S3 -2550 0
 /begin AXIS_DESCR STD_AXIS zff_atsys._.iSignale._.obj.sig_c_getr UMR_GRADC__1_1_M40_S5_S3 4 -40 215 DEPOSIT ABSOLUTE /end AXIS_DESCR
 /begin AXIS_DESCR STD_AXIS zff_atsys._.iSignale._.obj.sig_m_t8 UMR_NM__6_1_M34_S5_S3 4 -204 1326 DEPOSIT ABSOLUTE /end AXIS_DESCR
/end CHARACTERISTIC
/begin CHARACTERISTIC KF_TSYNCGMTHINSYNSPORT75 "Zeit vor sync. fur Rampenstart Haltephase in Synchron" MAP 0x1B0DFC ZF_kf_ui8_S5_S3 2550 UMR_MSEC__10_1_M255_S5_S3 -2550 0
 /begin AXIS_DESCR STD_AXIS zff_atsys._.iSignale._.obj.sig_c_getr UMR_GRADC__1_1_M40_S5_S3 4 -40 215 DEPOSIT ABSOLUTE /end AXIS_DESCR
 /begin AXIS_DESCR STD_AXIS zff_atsys._.iSignale._.obj.sig_m_t8 UMR_NM__6_1_M34_S5_S3 4 -204 1326 DEPOSIT ABSOLUTE /end AXIS_DESCR
/end CHARACTERISTIC
/begin CHARACTERISTIC KF_TSYNCGMTHINSYNSPORT76 "Zeit vor sync. fur Rampenstart Haltephase in Synchron" MAP 0x1B0BBC ZF_kf_ui8_S5_S3 2550 UMR_MSEC__10_1_M255_S5_S3 -2550 0
 /begin AXIS_DESCR STD_AXIS zff_atsys._.iSignale._.obj.sig_c_getr UMR_GRADC__1_1_M40_S5_S3 4 -40 215 DEPOSIT ABSOLUTE /end AXIS_DESCR
 /begin AXIS_DESCR STD_AXIS zff_atsys._.iSignale._.obj.sig_m_t8 UMR_NM__6_1_M34_S5_S3 4 -204 1326 DEPOSIT ABSOLUTE /end AXIS_DESCR
/end CHARACTERISTIC
/begin CHARACTERISTIC KF_TSYNCGMTHINSYNSPORT82 "Zeit vor sync. fur Rampenstart Haltephase in Synchron" MAP 0x1B0E3C ZF_kf_ui8_S5_S3 2550 UMR_MSEC__10_1_M255_S5_S3 -2550 0
 /begin AXIS_DESCR STD_AXIS zff_atsys._.iSignale._.obj.sig_c_getr UMR_GRADC__1_1_M40_S5_S3 4 -40 215 DEPOSIT ABSOLUTE /end AXIS_DESCR
 /begin AXIS_DESCR STD_AXIS zff_atsys._.iSignale._.obj.sig_m_t8 UMR_NM__6_1_M34_S5_S3 4 -204 1326 DEPOSIT ABSOLUTE /end AXIS_DESCR
/end CHARACTERISTIC
/begin CHARACTERISTIC KF_TSYNCGMTHINSYNSPORT84 "Zeit vor sync. fur Rampenstart Haltephase in Synchron" MAP 0x1B0E7C ZF_kf_ui8_S5_S3 2550 UMR_MSEC__10_1_M255_S5_S3 -2550 0
 /begin AXIS_DESCR STD_AXIS zff_atsys._.iSignale._.obj.sig_c_getr UMR_GRADC__1_1_M40_S5_S3 4 -40 215 DEPOSIT ABSOLUTE /end AXIS_DESCR
 /begin AXIS_DESCR STD_AXIS zff_atsys._.iSignale._.obj.sig_m_t8 UMR_NM__6_1_M34_S5_S3 4 -204 1326 DEPOSIT ABSOLUTE /end AXIS_DESCR
/end CHARACTERISTIC
/begin CHARACTERISTIC KF_TSYNCGMTHINSYNSPORT86 "Zeit vor sync. fur Rampenstart Haltephase in Synchron" MAP 0x1B0EBC ZF_kf_ui8_S5_S3 2550 UMR_MSEC__10_1_M255_S5_S3 -2550 0
 /begin AXIS_DESCR STD_AXIS zff_atsys._.iSignale._.obj.sig_c_getr UMR_GRADC__1_1_M40_S5_S3 4 -40 215 DEPOSIT ABSOLUTE /end AXIS_DESCR
 /begin AXIS_DESCR STD_AXIS zff_atsys._.iSignale._.obj.sig_m_t8 UMR_NM__6_1_M34_S5_S3 4 -204 1326 DEPOSIT ABSOLUTE /end AXIS_DESCR
/end CHARACTERISTIC
/begin CHARACTERISTIC KF_TSYNCGMTHINSYNSPORT87 "Zeit vor sync. fur Rampenstart Haltephase in Synchron" MAP 0x1B0BFC ZF_kf_ui8_S5_S3 2550 UMR_MSEC__10_1_M255_S5_S3 -2550 0
 /begin AXIS_DESCR STD_AXIS zff_atsys._.iSignale._.obj.sig_c_getr UMR_GRADC__1_1_M40_S5_S3 4 -40 215 DEPOSIT ABSOLUTE /end AXIS_DESCR
 /begin AXIS_DESCR STD_AXIS zff_atsys._.iSignale._.obj.sig_m_t8 UMR_NM__6_1_M34_S5_S3 4 -204 1326 DEPOSIT ABSOLUTE /end AXIS_DESCR
/end CHARACTERISTIC
/begin CHARACTERISTIC KF_WNGTNDSYNCGGE_1 "Sollturbinengradient geregeltes Gangeinlegen" MAP 0x1B1070 ZF_kf_si16_S5_S3 20000 UMR_U_MINSEC_1_1_0_S5_S3 -10000 10000
 /begin AXIS_DESCR STD_AXIS NO_INPUT_QUANTITY UMR_U_MIN_1_1_0_S5_S3 6 -8160 8160 DEPOSIT ABSOLUTE /end AXIS_DESCR
 /begin AXIS_DESCR STD_AXIS iSasZentr.c_getr_sas UMR_GRADC__1_1_M40_S5_S3 4 -40 150 DEPOSIT ABSOLUTE /end AXIS_DESCR
/end CHARACTERISTIC
/begin CHARACTERISTIC KF_WNGTNDSYNCGGE_2 "Sollturbinengradient geregeltes Gangeinlegen" MAP 0x1B10E4 ZF_kf_si16_S5_S3 20000 UMR_U_MINSEC_1_1_0_S5_S3 -10000 10000
 /begin AXIS_DESCR STD_AXIS NO_INPUT_QUANTITY UMR_U_MIN_1_1_0_S5_S3 6 -8160 8160 DEPOSIT ABSOLUTE /end AXIS_DESCR
 /begin AXIS_DESCR STD_AXIS iSasZentr.c_getr_sas UMR_GRADC__1_1_M40_S5_S3 4 -40 150 DEPOSIT ABSOLUTE /end AXIS_DESCR
/end CHARACTERISTIC
/begin CHARACTERISTIC KF_WNGTNDSYNCGGE_3 "Sollturbinengradient geregeltes Gangeinlegen" MAP 0x1B1158 ZF_kf_si16_S5_S3 20000 UMR_U_MINSEC_1_1_0_S5_S3 -10000 10000
 /begin AXIS_DESCR STD_AXIS NO_INPUT_QUANTITY UMR_U_MIN_1_1_0_S5_S3 6 -8160 8160 DEPOSIT ABSOLUTE /end AXIS_DESCR
 /begin AXIS_DESCR STD_AXIS iSasZentr.c_getr_sas UMR_GRADC__1_1_M40_S5_S3 4 -40 150 DEPOSIT ABSOLUTE /end AXIS_DESCR
/end CHARACTERISTIC
/begin CHARACTERISTIC KF_WNGTNDSYNCGGE_4 "Sollturbinengradient geregeltes Gangeinlegen" MAP 0x1B11CC ZF_kf_si16_S5_S3 20000 UMR_U_MINSEC_1_1_0_S5_S3 -10000 10000
 /begin AXIS_DESCR STD_AXIS NO_INPUT_QUANTITY UMR_U_MIN_1_1_0_S5_S3 6 -8160 8160 DEPOSIT ABSOLUTE /end AXIS_DESCR
 /begin AXIS_DESCR STD_AXIS iSasZentr.c_getr_sas UMR_GRADC__1_1_M40_S5_S3 4 -40 150 DEPOSIT ABSOLUTE /end AXIS_DESCR
/end CHARACTERISTIC
/begin CHARACTERISTIC KF_WNGTNDSYNCGGE_5 "Sollturbinengradient geregeltes Gangeinlegen" MAP 0x1B1240 ZF_kf_si16_S5_S3 20000 UMR_U_MINSEC_1_1_0_S5_S3 -10000 10000
 /begin AXIS_DESCR STD_AXIS NO_INPUT_QUANTITY UMR_U_MIN_1_1_0_S5_S3 6 -8160 8160 DEPOSIT ABSOLUTE /end AXIS_DESCR
 /begin AXIS_DESCR STD_AXIS iSasZentr.c_getr_sas UMR_GRADC__1_1_M40_S5_S3 4 -40 150 DEPOSIT ABSOLUTE /end AXIS_DESCR
/end CHARACTERISTIC
/begin CHARACTERISTIC KF_WNGTNDSYNCGGE_6 "Sollturbinengradient geregeltes Gangeinlegen" MAP 0x1B12B4 ZF_kf_si16_S5_S3 20000 UMR_U_MINSEC_1_1_0_S5_S3 -10000 10000
 /begin AXIS_DESCR STD_AXIS NO_INPUT_QUANTITY UMR_U_MIN_1_1_0_S5_S3 6 -8160 8160 DEPOSIT ABSOLUTE /end AXIS_DESCR
 /begin AXIS_DESCR STD_AXIS iSasZentr.c_getr_sas UMR_GRADC__1_1_M40_S5_S3 4 -40 150 DEPOSIT ABSOLUTE /end AXIS_DESCR
/end CHARACTERISTIC
/begin CHARACTERISTIC KF_WNGTNDSYNCGGE_7 "Sollturbinengradient geregeltes Gangeinlegen" MAP 0x1B1328 ZF_kf_si16_S5_S3 20000 UMR_U_MINSEC_1_1_0_S5_S3 -10000 10000
 /begin AXIS_DESCR STD_AXIS NO_INPUT_QUANTITY UMR_U_MIN_1_1_0_S5_S3 6 -8160 8160 DEPOSIT ABSOLUTE /end AXIS_DESCR
 /begin AXIS_DESCR STD_AXIS iSasZentr.c_getr_sas UMR_GRADC__1_1_M40_S5_S3 4 -40 150 DEPOSIT ABSOLUTE /end AXIS_DESCR
/end CHARACTERISTIC
/begin CHARACTERISTIC KF_WNGTNDSYNCGGE_8 "Sollturbinengradient geregeltes Gangeinlegen" MAP 0x1B139C ZF_kf_si16_S5_S3 20000 UMR_U_MINSEC_1_1_0_S5_S3 -10000 10000
 /begin AXIS_DESCR STD_AXIS NO_INPUT_QUANTITY UMR_U_MIN_1_1_0_S5_S3 6 -8160 8160 DEPOSIT ABSOLUTE /end AXIS_DESCR
 /begin AXIS_DESCR STD_AXIS iSasZentr.c_getr_sas UMR_GRADC__1_1_M40_S5_S3 4 -40 150 DEPOSIT ABSOLUTE /end AXIS_DESCR
/end CHARACTERISTIC
/begin CHARACTERISTIC KF_WNGTNDSYNCGGE_R "Sollturbinengradient geregeltes Gangeinlegen" MAP 0x1B0FFC ZF_kf_si16_S5_S3 20000 UMR_U_MINSEC_1_1_0_S5_S3 -10000 10000
 /begin AXIS_DESCR STD_AXIS NO_INPUT_QUANTITY UMR_U_MIN_1_1_0_S5_S3 6 -8160 8160 DEPOSIT ABSOLUTE /end AXIS_DESCR
 /begin AXIS_DESCR STD_AXIS iSasZentr.c_getr_sas UMR_GRADC__1_1_M40_S5_S3 4 -40 150 DEPOSIT ABSOLUTE /end AXIS_DESCR
/end CHARACTERISTIC
/begin CHARACTERISTIC KF_WTSGLS12 "Sollschleifzeit GLS" MAP 0x1B1400 ZF_kf_ui8_S5_S3 2550 UMR_MSEC__10_1_0_S5_S3 0 2550
 /begin AXIS_DESCR STD_AXIS zff_atsys._.iSignale._.obj.sig_n_t8 UMR_U_MIN_32_1_0_S5_S3 4 0 8160 DEPOSIT ABSOLUTE /end AXIS_DESCR
 /begin AXIS_DESCR STD_AXIS zff_atsys._.iSignale._.obj.sig_m_t8 UMR_NM__6_1_M34_S5_S3 6 -204 1326 DEPOSIT ABSOLUTE /end AXIS_DESCR
/end CHARACTERISTIC
/begin CHARACTERISTIC KF_WTSGLS12_EL "Sollschleifzeit GLS" MAP 0x1B142C ZF_kf_ui8_S5_S3 2550 UMR_MSEC__10_1_0_S5_S3 0 2550
 /begin AXIS_DESCR STD_AXIS zff_atsys._.iSignale._.obj.sig_n_t8 UMR_U_MIN_32_1_0_S5_S3 4 0 8160 DEPOSIT ABSOLUTE /end AXIS_DESCR
 /begin AXIS_DESCR STD_AXIS zff_atsys._.iSignale._.obj.sig_m_t8 UMR_NM__6_1_M34_S5_S3 6 -204 1326 DEPOSIT ABSOLUTE /end AXIS_DESCR
/end CHARACTERISTIC
/begin CHARACTERISTIC KF_WTSGLS21 "Sollschleifzeit GLS" MAP 0x1B1B04 ZF_kf_ui8_S5_S3 2550 UMR_MSEC__10_1_0_S5_S3 0 2550
 /begin AXIS_DESCR STD_AXIS zff_atsys._.iSignale._.obj.sig_n_t8 UMR_U_MIN_32_1_0_S5_S3 4 0 8160 DEPOSIT ABSOLUTE /end AXIS_DESCR
 /begin AXIS_DESCR STD_AXIS zff_atsys._.iSignale._.obj.sig_m_t8 UMR_NM__6_1_M34_S5_S3 6 -204 1326 DEPOSIT ABSOLUTE /end AXIS_DESCR
/end CHARACTERISTIC
/begin CHARACTERISTIC KF_WTSGLS21_EL "Sollschleifzeit GLS" MAP 0x1B1B30 ZF_kf_ui8_S5_S3 2550 UMR_MSEC__10_1_0_S5_S3 0 2550
 /begin AXIS_DESCR STD_AXIS zff_atsys._.iSignale._.obj.sig_n_t8 UMR_U_MIN_32_1_0_S5_S3 4 0 8160 DEPOSIT ABSOLUTE /end AXIS_DESCR
 /begin AXIS_DESCR STD_AXIS zff_atsys._.iSignale._.obj.sig_m_t8 UMR_NM__6_1_M34_S5_S3 6 -204 1326 DEPOSIT ABSOLUTE /end AXIS_DESCR
/end CHARACTERISTIC
/begin CHARACTERISTIC KF_WTSGLS23 "Sollschleifzeit GLS" MAP 0x1B147C ZF_kf_ui8_S5_S3 2550 UMR_MSEC__10_1_0_S5_S3 0 2550
 /begin AXIS_DESCR STD_AXIS zff_atsys._.iSignale._.obj.sig_n_t8 UMR_U_MIN_32_1_0_S5_S3 4 0 8160 DEPOSIT ABSOLUTE /end AXIS_DESCR
 /begin AXIS_DESCR STD_AXIS zff_atsys._.iSignale._.obj.sig_m_t8 UMR_NM__6_1_M34_S5_S3 6 -204 1326 DEPOSIT ABSOLUTE /end AXIS_DESCR
/end CHARACTERISTIC
/begin CHARACTERISTIC KF_WTSGLS23_EL "Sollschleifzeit GLS" MAP 0x1B14A8 ZF_kf_ui8_S5_S3 2550 UMR_MSEC__10_1_0_S5_S3 0 2550
 /begin AXIS_DESCR STD_AXIS zff_atsys._.iSignale._.obj.sig_n_t8 UMR_U_MIN_32_1_0_S5_S3 4 0 8160 DEPOSIT ABSOLUTE /end AXIS_DESCR
 /begin AXIS_DESCR STD_AXIS zff_atsys._.iSignale._.obj.sig_m_t8 UMR_NM__6_1_M34_S5_S3 6 -204 1326 DEPOSIT ABSOLUTE /end AXIS_DESCR
/end CHARACTERISTIC
/begin CHARACTERISTIC KF_WTSGLS32 "Sollschleifzeit GLS" MAP 0x1B1B74 ZF_kf_ui8_S5_S3 2550 UMR_MSEC__10_1_0_S5_S3 0 2550
 /begin AXIS_DESCR STD_AXIS zff_atsys._.iSignale._.obj.sig_n_t8 UMR_U_MIN_32_1_0_S5_S3 4 0 8160 DEPOSIT ABSOLUTE /end AXIS_DESCR
 /begin AXIS_DESCR STD_AXIS zff_atsys._.iSignale._.obj.sig_m_t8 UMR_NM__6_1_M34_S5_S3 6 -204 1326 DEPOSIT ABSOLUTE /end AXIS_DESCR
/end CHARACTERISTIC
/begin CHARACTERISTIC KF_WTSGLS32_EL "Sollschleifzeit GLS" MAP 0x1B1BA0 ZF_kf_ui8_S5_S3 2550 UMR_MSEC__10_1_0_S5_S3 0 2550
 /begin AXIS_DESCR STD_AXIS zff_atsys._.iSignale._.obj.sig_n_t8 UMR_U_MIN_32_1_0_S5_S3 4 0 8160 DEPOSIT ABSOLUTE /end AXIS_DESCR
 /begin AXIS_DESCR STD_AXIS zff_atsys._.iSignale._.obj.sig_m_t8 UMR_NM__6_1_M34_S5_S3 6 -204 1326 DEPOSIT ABSOLUTE /end AXIS_DESCR
/end CHARACTERISTIC
/begin CHARACTERISTIC KF_WTSGLS34 "Sollschleifzeit GLS" MAP 0x1B14F8 ZF_kf_ui8_S5_S3 2550 UMR_MSEC__10_1_0_S5_S3 0 2550
 /begin AXIS_DESCR STD_AXIS zff_atsys._.iSignale._.obj.sig_n_t8 UMR_U_MIN_32_1_0_S5_S3 4 0 8160 DEPOSIT ABSOLUTE /end AXIS_DESCR
 /begin AXIS_DESCR STD_AXIS zff_atsys._.iSignale._.obj.sig_m_t8 UMR_NM__6_1_M34_S5_S3 6 -204 1326 DEPOSIT ABSOLUTE /end AXIS_DESCR
/end CHARACTERISTIC
/begin CHARACTERISTIC KF_WTSGLS34_EL "Sollschleifzeit GLS" MAP 0x1B1524 ZF_kf_ui8_S5_S3 2550 UMR_MSEC__10_1_0_S5_S3 0 2550
 /begin AXIS_DESCR STD_AXIS zff_atsys._.iSignale._.obj.sig_n_t8 UMR_U_MIN_32_1_0_S5_S3 4 0 8160 DEPOSIT ABSOLUTE /end AXIS_DESCR
 /begin AXIS_DESCR STD_AXIS zff_atsys._.iSignale._.obj.sig_m_t8 UMR_NM__6_1_M34_S5_S3 6 -204 1326 DEPOSIT ABSOLUTE /end AXIS_DESCR
/end CHARACTERISTIC
/begin CHARACTERISTIC KF_WTSGLS43 "Sollschleifzeit GLS" MAP 0x1B1BE4 ZF_kf_ui8_S5_S3 2550 UMR_MSEC__10_1_0_S5_S3 0 2550
 /begin AXIS_DESCR STD_AXIS zff_atsys._.iSignale._.obj.sig_n_t8 UMR_U_MIN_32_1_0_S5_S3 4 0 8160 DEPOSIT ABSOLUTE /end AXIS_DESCR
 /begin AXIS_DESCR STD_AXIS zff_atsys._.iSignale._.obj.sig_m_t8 UMR_NM__6_1_M34_S5_S3 6 -204 1326 DEPOSIT ABSOLUTE /end AXIS_DESCR
/end CHARACTERISTIC
/begin CHARACTERISTIC KF_WTSGLS43_EL "Sollschleifzeit GLS" MAP 0x1B1C10 ZF_kf_ui8_S5_S3 2550 UMR_MSEC__10_1_0_S5_S3 0 2550
 /begin AXIS_DESCR STD_AXIS zff_atsys._.iSignale._.obj.sig_n_t8 UMR_U_MIN_32_1_0_S5_S3 4 0 8160 DEPOSIT ABSOLUTE /end AXIS_DESCR
 /begin AXIS_DESCR STD_AXIS zff_atsys._.iSignale._.obj.sig_m_t8 UMR_NM__6_1_M34_S5_S3 6 -204 1326 DEPOSIT ABSOLUTE /end AXIS_DESCR
/end CHARACTERISTIC
/begin CHARACTERISTIC KF_WTSGLS45 "Sollschleifzeit GLS" MAP 0x1B1574 ZF_kf_ui8_S5_S3 2550 UMR_MSEC__10_1_0_S5_S3 0 2550
 /begin AXIS_DESCR STD_AXIS zff_atsys._.iSignale._.obj.sig_n_t8 UMR_U_MIN_32_1_0_S5_S3 4 0 8160 DEPOSIT ABSOLUTE /end AXIS_DESCR
 /begin AXIS_DESCR STD_AXIS zff_atsys._.iSignale._.obj.sig_m_t8 UMR_NM__6_1_M34_S5_S3 6 -204 1326 DEPOSIT ABSOLUTE /end AXIS_DESCR
/end CHARACTERISTIC
/begin CHARACTERISTIC KF_WTSGLS45_EL "Sollschleifzeit GLS" MAP 0x1B15A0 ZF_kf_ui8_S5_S3 2550 UMR_MSEC__10_1_0_S5_S3 0 2550
 /begin AXIS_DESCR STD_AXIS zff_atsys._.iSignale._.obj.sig_n_t8 UMR_U_MIN_32_1_0_S5_S3 4 0 8160 DEPOSIT ABSOLUTE /end AXIS_DESCR
 /begin AXIS_DESCR STD_AXIS zff_atsys._.iSignale._.obj.sig_m_t8 UMR_NM__6_1_M34_S5_S3 6 -204 1326 DEPOSIT ABSOLUTE /end AXIS_DESCR
/end CHARACTERISTIC
/begin CHARACTERISTIC KF_WTSGLS54 "Sollschleifzeit GLS" MAP 0x1B1C54 ZF_kf_ui8_S5_S3 2550 UMR_MSEC__10_1_0_S5_S3 0 2550
 /begin AXIS_DESCR STD_AXIS zff_atsys._.iSignale._.obj.sig_n_t8 UMR_U_MIN_32_1_0_S5_S3 4 0 8160 DEPOSIT ABSOLUTE /end AXIS_DESCR
 /begin AXIS_DESCR STD_AXIS zff_atsys._.iSignale._.obj.sig_m_t8 UMR_NM__6_1_M34_S5_S3 6 -204 1326 DEPOSIT ABSOLUTE /end AXIS_DESCR
/end CHARACTERISTIC
/begin CHARACTERISTIC KF_WTSGLS54_EL "Sollschleifzeit GLS" MAP 0x1B1C80 ZF_kf_ui8_S5_S3 2550 UMR_MSEC__10_1_0_S5_S3 0 2550
 /begin AXIS_DESCR STD_AXIS zff_atsys._.iSignale._.obj.sig_n_t8 UMR_U_MIN_32_1_0_S5_S3 4 0 8160 DEPOSIT ABSOLUTE /end AXIS_DESCR
 /begin AXIS_DESCR STD_AXIS zff_atsys._.iSignale._.obj.sig_m_t8 UMR_NM__6_1_M34_S5_S3 6 -204 1326 DEPOSIT ABSOLUTE /end AXIS_DESCR
/end CHARACTERISTIC
/begin CHARACTERISTIC KF_WTSGLS56 "Sollschleifzeit GLS" MAP 0x1B15F0 ZF_kf_ui8_S5_S3 2550 UMR_MSEC__10_1_0_S5_S3 0 2550
 /begin AXIS_DESCR STD_AXIS zff_atsys._.iSignale._.obj.sig_n_t8 UMR_U_MIN_32_1_0_S5_S3 4 0 8160 DEPOSIT ABSOLUTE /end AXIS_DESCR
 /begin AXIS_DESCR STD_AXIS zff_atsys._.iSignale._.obj.sig_m_t8 UMR_NM__6_1_M34_S5_S3 6 -204 1326 DEPOSIT ABSOLUTE /end AXIS_DESCR
/end CHARACTERISTIC
/begin CHARACTERISTIC KF_WTSGLS56_EL "Sollschleifzeit GLS" MAP 0x1B161C ZF_kf_ui8_S5_S3 2550 UMR_MSEC__10_1_0_S5_S3 0 2550
 /begin AXIS_DESCR STD_AXIS zff_atsys._.iSignale._.obj.sig_n_t8 UMR_U_MIN_32_1_0_S5_S3 4 0 8160 DEPOSIT ABSOLUTE /end AXIS_DESCR
 /begin AXIS_DESCR STD_AXIS zff_atsys._.iSignale._.obj.sig_m_t8 UMR_NM__6_1_M34_S5_S3 6 -204 1326 DEPOSIT ABSOLUTE /end AXIS_DESCR
/end CHARACTERISTIC
/begin CHARACTERISTIC KF_WTSGLS65 "Sollschleifzeit GLS" MAP 0x1B1CC4 ZF_kf_ui8_S5_S3 2550 UMR_MSEC__10_1_0_S5_S3 0 2550
 /begin AXIS_DESCR STD_AXIS zff_atsys._.iSignale._.obj.sig_n_t8 UMR_U_MIN_32_1_0_S5_S3 4 0 8160 DEPOSIT ABSOLUTE /end AXIS_DESCR
 /begin AXIS_DESCR STD_AXIS zff_atsys._.iSignale._.obj.sig_m_t8 UMR_NM__6_1_M34_S5_S3 6 -204 1326 DEPOSIT ABSOLUTE /end AXIS_DESCR
/end CHARACTERISTIC
/begin CHARACTERISTIC KF_WTSGLS65_EL "Sollschleifzeit GLS" MAP 0x1B1CF0 ZF_kf_ui8_S5_S3 2550 UMR_MSEC__10_1_0_S5_S3 0 2550
 /begin AXIS_DESCR STD_AXIS zff_atsys._.iSignale._.obj.sig_n_t8 UMR_U_MIN_32_1_0_S5_S3 4 0 8160 DEPOSIT ABSOLUTE /end AXIS_DESCR
 /begin AXIS_DESCR STD_AXIS zff_atsys._.iSignale._.obj.sig_m_t8 UMR_NM__6_1_M34_S5_S3 6 -204 1326 DEPOSIT ABSOLUTE /end AXIS_DESCR
/end CHARACTERISTIC
/begin CHARACTERISTIC KF_WTSGLS67 "Sollschleifzeit GLS" MAP 0x1B166C ZF_kf_ui8_S5_S3 2550 UMR_MSEC__10_1_0_S5_S3 0 2550
 /begin AXIS_DESCR STD_AXIS zff_atsys._.iSignale._.obj.sig_n_t8 UMR_U_MIN_32_1_0_S5_S3 4 0 8160 DEPOSIT ABSOLUTE /end AXIS_DESCR
 /begin AXIS_DESCR STD_AXIS zff_atsys._.iSignale._.obj.sig_m_t8 UMR_NM__6_1_M34_S5_S3 6 -204 1326 DEPOSIT ABSOLUTE /end AXIS_DESCR
/end CHARACTERISTIC
/begin CHARACTERISTIC KF_WTSGLS67_EL "Sollschleifzeit GLS" MAP 0x1B1698 ZF_kf_ui8_S5_S3 2550 UMR_MSEC__10_1_0_S5_S3 0 2550
 /begin AXIS_DESCR STD_AXIS zff_atsys._.iSignale._.obj.sig_n_t8 UMR_U_MIN_32_1_0_S5_S3 4 0 8160 DEPOSIT ABSOLUTE /end AXIS_DESCR
 /begin AXIS_DESCR STD_AXIS zff_atsys._.iSignale._.obj.sig_m_t8 UMR_NM__6_1_M34_S5_S3 6 -204 1326 DEPOSIT ABSOLUTE /end AXIS_DESCR
/end CHARACTERISTIC
/begin CHARACTERISTIC KF_WTSGLS76 "Sollschleifzeit GLS" MAP 0x1B1D34 ZF_kf_ui8_S5_S3 2550 UMR_MSEC__10_1_0_S5_S3 0 2550
 /begin AXIS_DESCR STD_AXIS zff_atsys._.iSignale._.obj.sig_n_t8 UMR_U_MIN_32_1_0_S5_S3 4 0 8160 DEPOSIT ABSOLUTE /end AXIS_DESCR
 /begin AXIS_DESCR STD_AXIS zff_atsys._.iSignale._.obj.sig_m_t8 UMR_NM__6_1_M34_S5_S3 6 -204 1326 DEPOSIT ABSOLUTE /end AXIS_DESCR
/end CHARACTERISTIC
/begin CHARACTERISTIC KF_WTSGLS76_EL "Sollschleifzeit GLS" MAP 0x1B1D60 ZF_kf_ui8_S5_S3 2550 UMR_MSEC__10_1_0_S5_S3 0 2550
 /begin AXIS_DESCR STD_AXIS zff_atsys._.iSignale._.obj.sig_n_t8 UMR_U_MIN_32_1_0_S5_S3 4 0 8160 DEPOSIT ABSOLUTE /end AXIS_DESCR
 /begin AXIS_DESCR STD_AXIS zff_atsys._.iSignale._.obj.sig_m_t8 UMR_NM__6_1_M34_S5_S3 6 -204 1326 DEPOSIT ABSOLUTE /end AXIS_DESCR
/end CHARACTERISTIC
/begin CHARACTERISTIC KF_WTSGLS78 "Sollschleifzeit GLS" MAP 0x1B16E8 ZF_kf_ui8_S5_S3 2550 UMR_MSEC__10_1_0_S5_S3 0 2550
 /begin AXIS_DESCR STD_AXIS zff_atsys._.iSignale._.obj.sig_n_t8 UMR_U_MIN_32_1_0_S5_S3 4 0 8160 DEPOSIT ABSOLUTE /end AXIS_DESCR
 /begin AXIS_DESCR STD_AXIS zff_atsys._.iSignale._.obj.sig_m_t8 UMR_NM__6_1_M34_S5_S3 6 -204 1326 DEPOSIT ABSOLUTE /end AXIS_DESCR
/end CHARACTERISTIC
/begin CHARACTERISTIC KF_WTSGLS78_EL "Sollschleifzeit GLS" MAP 0x1B1714 ZF_kf_ui8_S5_S3 2550 UMR_MSEC__10_1_0_S5_S3 0 2550
 /begin AXIS_DESCR STD_AXIS zff_atsys._.iSignale._.obj.sig_n_t8 UMR_U_MIN_32_1_0_S5_S3 4 0 8160 DEPOSIT ABSOLUTE /end AXIS_DESCR
 /begin AXIS_DESCR STD_AXIS zff_atsys._.iSignale._.obj.sig_m_t8 UMR_NM__6_1_M34_S5_S3 6 -204 1326 DEPOSIT ABSOLUTE /end AXIS_DESCR
/end CHARACTERISTIC
/begin CHARACTERISTIC KF_WTSGLS87 "Sollschleifzeit GLS" MAP 0x1B1DA4 ZF_kf_ui8_S5_S3 2550 UMR_MSEC__10_1_0_S5_S3 0 2550
 /begin AXIS_DESCR STD_AXIS zff_atsys._.iSignale._.obj.sig_n_t8 UMR_U_MIN_32_1_0_S5_S3 4 0 8160 DEPOSIT ABSOLUTE /end AXIS_DESCR
 /begin AXIS_DESCR STD_AXIS zff_atsys._.iSignale._.obj.sig_m_t8 UMR_NM__6_1_M34_S5_S3 6 -204 1326 DEPOSIT ABSOLUTE /end AXIS_DESCR
/end CHARACTERISTIC
/begin CHARACTERISTIC KF_WTSGLS87_EL "Sollschleifzeit GLS" MAP 0x1B1DD0 ZF_kf_ui8_S5_S3 2550 UMR_MSEC__10_1_0_S5_S3 0 2550
 /begin AXIS_DESCR STD_AXIS zff_atsys._.iSignale._.obj.sig_n_t8 UMR_U_MIN_32_1_0_S5_S3 4 0 8160 DEPOSIT ABSOLUTE /end AXIS_DESCR
 /begin AXIS_DESCR STD_AXIS zff_atsys._.iSignale._.obj.sig_m_t8 UMR_NM__6_1_M34_S5_S3 6 -204 1326 DEPOSIT ABSOLUTE /end AXIS_DESCR
/end CHARACTERISTIC
/begin CHARACTERISTIC KF_WTSGLSSP12 "Sollschleifzeit GLS" MAP 0x1B1758 ZF_kf_ui8_S5_S3 2550 UMR_MSEC__10_1_0_S5_S3 0 2550
 /begin AXIS_DESCR STD_AXIS zff_atsys._.iSignale._.obj.sig_n_t8 UMR_U_MIN_32_1_0_S5_S3 4 0 8160 DEPOSIT ABSOLUTE /end AXIS_DESCR
 /begin AXIS_DESCR STD_AXIS zff_atsys._.iSignale._.obj.sig_m_t8 UMR_NM__6_1_M34_S5_S3 6 -204 1326 DEPOSIT ABSOLUTE /end AXIS_DESCR
/end CHARACTERISTIC
/begin CHARACTERISTIC KF_WTSGLSSP21 "Sollschleifzeit GLS" MAP 0x1B1E14 ZF_kf_ui8_S5_S3 2550 UMR_MSEC__10_1_0_S5_S3 0 2550
 /begin AXIS_DESCR STD_AXIS zff_atsys._.iSignale._.obj.sig_n_t8 UMR_U_MIN_32_1_0_S5_S3 4 0 8160 DEPOSIT ABSOLUTE /end AXIS_DESCR
 /begin AXIS_DESCR STD_AXIS zff_atsys._.iSignale._.obj.sig_m_t8 UMR_NM__6_1_M34_S5_S3 6 -204 1326 DEPOSIT ABSOLUTE /end AXIS_DESCR
/end CHARACTERISTIC
/begin CHARACTERISTIC KF_WTSGLSSP23 "Sollschleifzeit GLS" MAP 0x1B179C ZF_kf_ui8_S5_S3 2550 UMR_MSEC__10_1_0_S5_S3 0 2550
 /begin AXIS_DESCR STD_AXIS zff_atsys._.iSignale._.obj.sig_n_t8 UMR_U_MIN_32_1_0_S5_S3 4 0 8160 DEPOSIT ABSOLUTE /end AXIS_DESCR
 /begin AXIS_DESCR STD_AXIS zff_atsys._.iSignale._.obj.sig_m_t8 UMR_NM__6_1_M34_S5_S3 6 -204 1326 DEPOSIT ABSOLUTE /end AXIS_DESCR
/end CHARACTERISTIC
/begin CHARACTERISTIC KF_WTSGLSSP31 "Sollschleifzeit GLS" MAP 0x1B1F9C ZF_kf_ui8_S5_S3 2550 UMR_MSEC__10_1_0_S5_S3 0 2550
 /begin AXIS_DESCR STD_AXIS zff_atsys._.iSignale._.obj.sig_n_t8 UMR_U_MIN_32_1_0_S5_S3 4 0 8160 DEPOSIT ABSOLUTE /end AXIS_DESCR
 /begin AXIS_DESCR STD_AXIS zff_atsys._.iSignale._.obj.sig_m_t8 UMR_NM__6_1_M34_S5_S3 6 -204 1326 DEPOSIT ABSOLUTE /end AXIS_DESCR
/end CHARACTERISTIC
/begin CHARACTERISTIC KF_WTSGLSSP32 "Sollschleifzeit GLS" MAP 0x1B1E4C ZF_kf_ui8_S5_S3 2550 UMR_MSEC__10_1_0_S5_S3 0 2550
 /begin AXIS_DESCR STD_AXIS zff_atsys._.iSignale._.obj.sig_n_t8 UMR_U_MIN_32_1_0_S5_S3 4 0 8160 DEPOSIT ABSOLUTE /end AXIS_DESCR
 /begin AXIS_DESCR STD_AXIS zff_atsys._.iSignale._.obj.sig_m_t8 UMR_NM__6_1_M34_S5_S3 6 -204 1326 DEPOSIT ABSOLUTE /end AXIS_DESCR
/end CHARACTERISTIC
/begin CHARACTERISTIC KF_WTSGLSSP34 "Sollschleifzeit GLS" MAP 0x1B17E0 ZF_kf_ui8_S5_S3 2550 UMR_MSEC__10_1_0_S5_S3 0 2550
 /begin AXIS_DESCR STD_AXIS zff_atsys._.iSignale._.obj.sig_n_t8 UMR_U_MIN_32_1_0_S5_S3 4 0 8160 DEPOSIT ABSOLUTE /end AXIS_DESCR
 /begin AXIS_DESCR STD_AXIS zff_atsys._.iSignale._.obj.sig_m_t8 UMR_NM__6_1_M34_S5_S3 6 -204 1326 DEPOSIT ABSOLUTE /end AXIS_DESCR
/end CHARACTERISTIC
/begin CHARACTERISTIC KF_WTSGLSSP42 "Sollschleifzeit GLS" MAP 0x1B1FD4 ZF_kf_ui8_S5_S3 2550 UMR_MSEC__10_1_0_S5_S3 0 2550
 /begin AXIS_DESCR STD_AXIS zff_atsys._.iSignale._.obj.sig_n_t8 UMR_U_MIN_32_1_0_S5_S3 4 0 8160 DEPOSIT ABSOLUTE /end AXIS_DESCR
 /begin AXIS_DESCR STD_AXIS zff_atsys._.iSignale._.obj.sig_m_t8 UMR_NM__6_1_M34_S5_S3 6 -204 1326 DEPOSIT ABSOLUTE /end AXIS_DESCR
/end CHARACTERISTIC
/begin CHARACTERISTIC KF_WTSGLSSP43 "Sollschleifzeit GLS" MAP 0x1B1E84 ZF_kf_ui8_S5_S3 2550 UMR_MSEC__10_1_0_S5_S3 0 2550
 /begin AXIS_DESCR STD_AXIS zff_atsys._.iSignale._.obj.sig_n_t8 UMR_U_MIN_32_1_0_S5_S3 4 0 8160 DEPOSIT ABSOLUTE /end AXIS_DESCR
 /begin AXIS_DESCR STD_AXIS zff_atsys._.iSignale._.obj.sig_m_t8 UMR_NM__6_1_M34_S5_S3 6 -204 1326 DEPOSIT ABSOLUTE /end AXIS_DESCR
/end CHARACTERISTIC
/begin CHARACTERISTIC KF_WTSGLSSP45 "Sollschleifzeit GLS" MAP 0x1B1824 ZF_kf_ui8_S5_S3 2550 UMR_MSEC__10_1_0_S5_S3 0 2550
 /begin AXIS_DESCR STD_AXIS zff_atsys._.iSignale._.obj.sig_n_t8 UMR_U_MIN_32_1_0_S5_S3 4 0 8160 DEPOSIT ABSOLUTE /end AXIS_DESCR
 /begin AXIS_DESCR STD_AXIS zff_atsys._.iSignale._.obj.sig_m_t8 UMR_NM__6_1_M34_S5_S3 6 -204 1326 DEPOSIT ABSOLUTE /end AXIS_DESCR
/end CHARACTERISTIC
/begin CHARACTERISTIC KF_WTSGLSSP51 "Sollschleifzeit GLS" MAP 0x1B200C ZF_kf_ui8_S5_S3 2550 UMR_MSEC__10_1_0_S5_S3 0 2550
 /begin AXIS_DESCR STD_AXIS zff_atsys._.iSignale._.obj.sig_n_t8 UMR_U_MIN_32_1_0_S5_S3 4 0 8160 DEPOSIT ABSOLUTE /end AXIS_DESCR
 /begin AXIS_DESCR STD_AXIS zff_atsys._.iSignale._.obj.sig_m_t8 UMR_NM__6_1_M34_S5_S3 6 -204 1326 DEPOSIT ABSOLUTE /end AXIS_DESCR
/end CHARACTERISTIC
/begin CHARACTERISTIC KF_WTSGLSSP53 "Sollschleifzeit GLS" MAP 0x1B2044 ZF_kf_ui8_S5_S3 2550 UMR_MSEC__10_1_0_S5_S3 0 2550
 /begin AXIS_DESCR STD_AXIS zff_atsys._.iSignale._.obj.sig_n_t8 UMR_U_MIN_32_1_0_S5_S3 4 0 8160 DEPOSIT ABSOLUTE /end AXIS_DESCR
 /begin AXIS_DESCR STD_AXIS zff_atsys._.iSignale._.obj.sig_m_t8 UMR_NM__6_1_M34_S5_S3 6 -204 1326 DEPOSIT ABSOLUTE /end AXIS_DESCR
/end CHARACTERISTIC
/begin CHARACTERISTIC KF_WTSGLSSP54 "Sollschleifzeit GLS" MAP 0x1B1EBC ZF_kf_ui8_S5_S3 2550 UMR_MSEC__10_1_0_S5_S3 0 2550
 /begin AXIS_DESCR STD_AXIS zff_atsys._.iSignale._.obj.sig_n_t8 UMR_U_MIN_32_1_0_S5_S3 4 0 8160 DEPOSIT ABSOLUTE /end AXIS_DESCR
 /begin AXIS_DESCR STD_AXIS zff_atsys._.iSignale._.obj.sig_m_t8 UMR_NM__6_1_M34_S5_S3 6 -204 1326 DEPOSIT ABSOLUTE /end AXIS_DESCR
/end CHARACTERISTIC
/begin CHARACTERISTIC KF_WTSGLSSP56 "Sollschleifzeit GLS" MAP 0x1B1868 ZF_kf_ui8_S5_S3 2550 UMR_MSEC__10_1_0_S5_S3 0 2550
 /begin AXIS_DESCR STD_AXIS zff_atsys._.iSignale._.obj.sig_n_t8 UMR_U_MIN_32_1_0_S5_S3 4 0 8160 DEPOSIT ABSOLUTE /end AXIS_DESCR
 /begin AXIS_DESCR STD_AXIS zff_atsys._.iSignale._.obj.sig_m_t8 UMR_NM__6_1_M34_S5_S3 6 -204 1326 DEPOSIT ABSOLUTE /end AXIS_DESCR
/end CHARACTERISTIC
/begin CHARACTERISTIC KF_WTSGLSSP63 "Sollschleifzeit GLS" MAP 0x1B207C ZF_kf_ui8_S5_S3 2550 UMR_MSEC__10_1_0_S5_S3 0 2550
 /begin AXIS_DESCR STD_AXIS zff_atsys._.iSignale._.obj.sig_n_t8 UMR_U_MIN_32_1_0_S5_S3 4 0 8160 DEPOSIT ABSOLUTE /end AXIS_DESCR
 /begin AXIS_DESCR STD_AXIS zff_atsys._.iSignale._.obj.sig_m_t8 UMR_NM__6_1_M34_S5_S3 6 -204 1326 DEPOSIT ABSOLUTE /end AXIS_DESCR
/end CHARACTERISTIC
/begin CHARACTERISTIC KF_WTSGLSSP64 "Sollschleifzeit GLS" MAP 0x1B20B4 ZF_kf_ui8_S5_S3 2550 UMR_MSEC__10_1_0_S5_S3 0 2550
 /begin AXIS_DESCR STD_AXIS zff_atsys._.iSignale._.obj.sig_n_t8 UMR_U_MIN_32_1_0_S5_S3 4 0 8160 DEPOSIT ABSOLUTE /end AXIS_DESCR
 /begin AXIS_DESCR STD_AXIS zff_atsys._.iSignale._.obj.sig_m_t8 UMR_NM__6_1_M34_S5_S3 6 -204 1326 DEPOSIT ABSOLUTE /end AXIS_DESCR
/end CHARACTERISTIC
/begin CHARACTERISTIC KF_WTSGLSSP65 "Sollschleifzeit GLS" MAP 0x1B1EF4 ZF_kf_ui8_S5_S3 2550 UMR_MSEC__10_1_0_S5_S3 0 2550
 /begin AXIS_DESCR STD_AXIS zff_atsys._.iSignale._.obj.sig_n_t8 UMR_U_MIN_32_1_0_S5_S3 4 0 8160 DEPOSIT ABSOLUTE /end AXIS_DESCR
 /begin AXIS_DESCR STD_AXIS zff_atsys._.iSignale._.obj.sig_m_t8 UMR_NM__6_1_M34_S5_S3 6 -204 1326 DEPOSIT ABSOLUTE /end AXIS_DESCR
/end CHARACTERISTIC
/begin CHARACTERISTIC KF_WTSGLSSP67 "Sollschleifzeit GLS" MAP 0x1B18AC ZF_kf_ui8_S5_S3 2550 UMR_MSEC__10_1_0_S5_S3 0 2550
 /begin AXIS_DESCR STD_AXIS zff_atsys._.iSignale._.obj.sig_n_t8 UMR_U_MIN_32_1_0_S5_S3 4 0 8160 DEPOSIT ABSOLUTE /end AXIS_DESCR
 /begin AXIS_DESCR STD_AXIS zff_atsys._.iSignale._.obj.sig_m_t8 UMR_NM__6_1_M34_S5_S3 6 -204 1326 DEPOSIT ABSOLUTE /end AXIS_DESCR
/end CHARACTERISTIC
/begin CHARACTERISTIC KF_WTSGLSSP71 "Sollschleifzeit GLS" MAP 0x1B20EC ZF_kf_ui8_S5_S3 2550 UMR_MSEC__10_1_0_S5_S3 0 2550
 /begin AXIS_DESCR STD_AXIS zff_atsys._.iSignale._.obj.sig_n_t8 UMR_U_MIN_32_1_0_S5_S3 4 0 8160 DEPOSIT ABSOLUTE /end AXIS_DESCR
 /begin AXIS_DESCR STD_AXIS zff_atsys._.iSignale._.obj.sig_m_t8 UMR_NM__6_1_M34_S5_S3 6 -204 1326 DEPOSIT ABSOLUTE /end AXIS_DESCR
/end CHARACTERISTIC
/begin CHARACTERISTIC KF_WTSGLSSP75 "Sollschleifzeit GLS" MAP 0x1B2124 ZF_kf_ui8_S5_S3 2550 UMR_MSEC__10_1_0_S5_S3 0 2550
 /begin AXIS_DESCR STD_AXIS zff_atsys._.iSignale._.obj.sig_n_t8 UMR_U_MIN_32_1_0_S5_S3 4 0 8160 DEPOSIT ABSOLUTE /end AXIS_DESCR
 /begin AXIS_DESCR STD_AXIS zff_atsys._.iSignale._.obj.sig_m_t8 UMR_NM__6_1_M34_S5_S3 6 -204 1326 DEPOSIT ABSOLUTE /end AXIS_DESCR
/end CHARACTERISTIC
/begin CHARACTERISTIC KF_WTSGLSSP76 "Sollschleifzeit GLS" MAP 0x1B1F2C ZF_kf_ui8_S5_S3 2550 UMR_MSEC__10_1_0_S5_S3 0 2550
 /begin AXIS_DESCR STD_AXIS zff_atsys._.iSignale._.obj.sig_n_t8 UMR_U_MIN_32_1_0_S5_S3 4 0 8160 DEPOSIT ABSOLUTE /end AXIS_DESCR
 /begin AXIS_DESCR STD_AXIS zff_atsys._.iSignale._.obj.sig_m_t8 UMR_NM__6_1_M34_S5_S3 6 -204 1326 DEPOSIT ABSOLUTE /end AXIS_DESCR
/end CHARACTERISTIC
/begin CHARACTERISTIC KF_WTSGLSSP78 "Sollschleifzeit GLS" MAP 0x1B18F0 ZF_kf_ui8_S5_S3 2550 UMR_MSEC__10_1_0_S5_S3 0 2550
 /begin AXIS_DESCR STD_AXIS zff_atsys._.iSignale._.obj.sig_n_t8 UMR_U_MIN_32_1_0_S5_S3 4 0 8160 DEPOSIT ABSOLUTE /end AXIS_DESCR
 /begin AXIS_DESCR STD_AXIS zff_atsys._.iSignale._.obj.sig_m_t8 UMR_NM__6_1_M34_S5_S3 6 -204 1326 DEPOSIT ABSOLUTE /end AXIS_DESCR
/end CHARACTERISTIC
/begin CHARACTERISTIC KF_WTSGLSSP82 "Sollschleifzeit GLS" MAP 0x1B215C ZF_kf_ui8_S5_S3 2550 UMR_MSEC__10_1_0_S5_S3 0 2550
 /begin AXIS_DESCR STD_AXIS zff_atsys._.iSignale._.obj.sig_n_t8 UMR_U_MIN_32_1_0_S5_S3 4 0 8160 DEPOSIT ABSOLUTE /end AXIS_DESCR
 /begin AXIS_DESCR STD_AXIS zff_atsys._.iSignale._.obj.sig_m_t8 UMR_NM__6_1_M34_S5_S3 6 -204 1326 DEPOSIT ABSOLUTE /end AXIS_DESCR
/end CHARACTERISTIC
/begin CHARACTERISTIC KF_WTSGLSSP84 "Sollschleifzeit GLS" MAP 0x1B2194 ZF_kf_ui8_S5_S3 2550 UMR_MSEC__10_1_0_S5_S3 0 2550
 /begin AXIS_DESCR STD_AXIS zff_atsys._.iSignale._.obj.sig_n_t8 UMR_U_MIN_32_1_0_S5_S3 4 0 8160 DEPOSIT ABSOLUTE /end AXIS_DESCR
 /begin AXIS_DESCR STD_AXIS zff_atsys._.iSignale._.obj.sig_m_t8 UMR_NM__6_1_M34_S5_S3 6 -204 1326 DEPOSIT ABSOLUTE /end AXIS_DESCR
/end CHARACTERISTIC
/begin CHARACTERISTIC KF_WTSGLSSP86 "Sollschleifzeit GLS" MAP 0x1B21CC ZF_kf_ui8_S5_S3 2550 UMR_MSEC__10_1_0_S5_S3 0 2550
 /begin AXIS_DESCR STD_AXIS zff_atsys._.iSignale._.obj.sig_n_t8 UMR_U_MIN_32_1_0_S5_S3 4 0 8160 DEPOSIT ABSOLUTE /end AXIS_DESCR
 /begin AXIS_DESCR STD_AXIS zff_atsys._.iSignale._.obj.sig_m_t8 UMR_NM__6_1_M34_S5_S3 6 -204 1326 DEPOSIT ABSOLUTE /end AXIS_DESCR
/end CHARACTERISTIC
/begin CHARACTERISTIC KF_WTSGLSSP87 "Sollschleifzeit GLS" MAP 0x1B1F64 ZF_kf_ui8_S5_S3 2550 UMR_MSEC__10_1_0_S5_S3 0 2550
 /begin AXIS_DESCR STD_AXIS zff_atsys._.iSignale._.obj.sig_n_t8 UMR_U_MIN_32_1_0_S5_S3 4 0 8160 DEPOSIT ABSOLUTE /end AXIS_DESCR
 /begin AXIS_DESCR STD_AXIS zff_atsys._.iSignale._.obj.sig_m_t8 UMR_NM__6_1_M34_S5_S3 6 -204 1326 DEPOSIT ABSOLUTE /end AXIS_DESCR
/end CHARACTERISTIC
/begin CHARACTERISTIC KF_WTSGLSSPORT12 "Sollschleifzeit GLS" MAP 0x1B1934 ZF_kf_ui8_S5_S3 2550 UMR_MSEC__10_1_0_S5_S3 0 2550
 /begin AXIS_DESCR STD_AXIS zff_atsys._.iSignale._.obj.sig_n_t8 UMR_U_MIN_32_1_0_S5_S3 4 0 8160 DEPOSIT ABSOLUTE /end AXIS_DESCR
 /begin AXIS_DESCR STD_AXIS zff_atsys._.iSignale._.obj.sig_m_t8 UMR_NM__6_1_M34_S5_S3 6 -204 1326 DEPOSIT ABSOLUTE /end AXIS_DESCR
/end CHARACTERISTIC
/begin CHARACTERISTIC KF_WTSGLSSPORT21 "Sollschleifzeit GLS" MAP 0x1B2204 ZF_kf_ui8_S5_S3 2550 UMR_MSEC__10_1_0_S5_S3 0 2550
 /begin AXIS_DESCR STD_AXIS zff_atsys._.iSignale._.obj.sig_n_t8 UMR_U_MIN_32_1_0_S5_S3 4 0 8160 DEPOSIT ABSOLUTE /end AXIS_DESCR
 /begin AXIS_DESCR STD_AXIS zff_atsys._.iSignale._.obj.sig_m_t8 UMR_NM__6_1_M34_S5_S3 6 -204 1326 DEPOSIT ABSOLUTE /end AXIS_DESCR
/end CHARACTERISTIC
/begin CHARACTERISTIC KF_WTSGLSSPORT23 "Sollschleifzeit GLS" MAP 0x1B1978 ZF_kf_ui8_S5_S3 2550 UMR_MSEC__10_1_0_S5_S3 0 2550
 /begin AXIS_DESCR STD_AXIS zff_atsys._.iSignale._.obj.sig_n_t8 UMR_U_MIN_32_1_0_S5_S3 4 0 8160 DEPOSIT ABSOLUTE /end AXIS_DESCR
 /begin AXIS_DESCR STD_AXIS zff_atsys._.iSignale._.obj.sig_m_t8 UMR_NM__6_1_M34_S5_S3 6 -204 1326 DEPOSIT ABSOLUTE /end AXIS_DESCR
/end CHARACTERISTIC
/begin CHARACTERISTIC KF_WTSGLSSPORT31 "Sollschleifzeit GLS" MAP 0x1B238C ZF_kf_ui8_S5_S3 2550 UMR_MSEC__10_1_0_S5_S3 0 2550
 /begin AXIS_DESCR STD_AXIS zff_atsys._.iSignale._.obj.sig_n_t8 UMR_U_MIN_32_1_0_S5_S3 4 0 8160 DEPOSIT ABSOLUTE /end AXIS_DESCR
 /begin AXIS_DESCR STD_AXIS zff_atsys._.iSignale._.obj.sig_m_t8 UMR_NM__6_1_M34_S5_S3 6 -204 1326 DEPOSIT ABSOLUTE /end AXIS_DESCR
/end CHARACTERISTIC
/begin CHARACTERISTIC KF_WTSGLSSPORT32 "Sollschleifzeit GLS" MAP 0x1B223C ZF_kf_ui8_S5_S3 2550 UMR_MSEC__10_1_0_S5_S3 0 2550
 /begin AXIS_DESCR STD_AXIS zff_atsys._.iSignale._.obj.sig_n_t8 UMR_U_MIN_32_1_0_S5_S3 4 0 8160 DEPOSIT ABSOLUTE /end AXIS_DESCR
 /begin AXIS_DESCR STD_AXIS zff_atsys._.iSignale._.obj.sig_m_t8 UMR_NM__6_1_M34_S5_S3 6 -204 1326 DEPOSIT ABSOLUTE /end AXIS_DESCR
/end CHARACTERISTIC
/begin CHARACTERISTIC KF_WTSGLSSPORT34 "Sollschleifzeit GLS" MAP 0x1B19BC ZF_kf_ui8_S5_S3 2550 UMR_MSEC__10_1_0_S5_S3 0 2550
 /begin AXIS_DESCR STD_AXIS zff_atsys._.iSignale._.obj.sig_n_t8 UMR_U_MIN_32_1_0_S5_S3 4 0 8160 DEPOSIT ABSOLUTE /end AXIS_DESCR
 /begin AXIS_DESCR STD_AXIS zff_atsys._.iSignale._.obj.sig_m_t8 UMR_NM__6_1_M34_S5_S3 6 -204 1326 DEPOSIT ABSOLUTE /end AXIS_DESCR
/end CHARACTERISTIC
/begin CHARACTERISTIC KF_WTSGLSSPORT42 "Sollschleifzeit GLS" MAP 0x1B23C4 ZF_kf_ui8_S5_S3 2550 UMR_MSEC__10_1_0_S5_S3 0 2550
 /begin AXIS_DESCR STD_AXIS zff_atsys._.iSignale._.obj.sig_n_t8 UMR_U_MIN_32_1_0_S5_S3 4 0 8160 DEPOSIT ABSOLUTE /end AXIS_DESCR
 /begin AXIS_DESCR STD_AXIS zff_atsys._.iSignale._.obj.sig_m_t8 UMR_NM__6_1_M34_S5_S3 6 -204 1326 DEPOSIT ABSOLUTE /end AXIS_DESCR
/end CHARACTERISTIC
/begin CHARACTERISTIC KF_WTSGLSSPORT43 "Sollschleifzeit GLS" MAP 0x1B2274 ZF_kf_ui8_S5_S3 2550 UMR_MSEC__10_1_0_S5_S3 0 2550
 /begin AXIS_DESCR STD_AXIS zff_atsys._.iSignale._.obj.sig_n_t8 UMR_U_MIN_32_1_0_S5_S3 4 0 8160 DEPOSIT ABSOLUTE /end AXIS_DESCR
 /begin AXIS_DESCR STD_AXIS zff_atsys._.iSignale._.obj.sig_m_t8 UMR_NM__6_1_M34_S5_S3 6 -204 1326 DEPOSIT ABSOLUTE /end AXIS_DESCR
/end CHARACTERISTIC
/begin CHARACTERISTIC KF_WTSGLSSPORT45 "Sollschleifzeit GLS" MAP 0x1B1A00 ZF_kf_ui8_S5_S3 2550 UMR_MSEC__10_1_0_S5_S3 0 2550
 /begin AXIS_DESCR STD_AXIS zff_atsys._.iSignale._.obj.sig_n_t8 UMR_U_MIN_32_1_0_S5_S3 4 0 8160 DEPOSIT ABSOLUTE /end AXIS_DESCR
 /begin AXIS_DESCR STD_AXIS zff_atsys._.iSignale._.obj.sig_m_t8 UMR_NM__6_1_M34_S5_S3 6 -204 1326 DEPOSIT ABSOLUTE /end AXIS_DESCR
/end CHARACTERISTIC
/begin CHARACTERISTIC KF_WTSGLSSPORT51 "Sollschleifzeit GLS" MAP 0x1B23FC ZF_kf_ui8_S5_S3 2550 UMR_MSEC__10_1_0_S5_S3 0 2550
 /begin AXIS_DESCR STD_AXIS zff_atsys._.iSignale._.obj.sig_n_t8 UMR_U_MIN_32_1_0_S5_S3 4 0 8160 DEPOSIT ABSOLUTE /end AXIS_DESCR
 /begin AXIS_DESCR STD_AXIS zff_atsys._.iSignale._.obj.sig_m_t8 UMR_NM__6_1_M34_S5_S3 6 -204 1326 DEPOSIT ABSOLUTE /end AXIS_DESCR
/end CHARACTERISTIC
/begin CHARACTERISTIC KF_WTSGLSSPORT53 "Sollschleifzeit GLS" MAP 0x1B2434 ZF_kf_ui8_S5_S3 2550 UMR_MSEC__10_1_0_S5_S3 0 2550
 /begin AXIS_DESCR STD_AXIS zff_atsys._.iSignale._.obj.sig_n_t8 UMR_U_MIN_32_1_0_S5_S3 4 0 8160 DEPOSIT ABSOLUTE /end AXIS_DESCR
 /begin AXIS_DESCR STD_AXIS zff_atsys._.iSignale._.obj.sig_m_t8 UMR_NM__6_1_M34_S5_S3 6 -204 1326 DEPOSIT ABSOLUTE /end AXIS_DESCR
/end CHARACTERISTIC
/begin CHARACTERISTIC KF_WTSGLSSPORT54 "Sollschleifzeit GLS" MAP 0x1B22AC ZF_kf_ui8_S5_S3 2550 UMR_MSEC__10_1_0_S5_S3 0 2550
 /begin AXIS_DESCR STD_AXIS zff_atsys._.iSignale._.obj.sig_n_t8 UMR_U_MIN_32_1_0_S5_S3 4 0 8160 DEPOSIT ABSOLUTE /end AXIS_DESCR
 /begin AXIS_DESCR STD_AXIS zff_atsys._.iSignale._.obj.sig_m_t8 UMR_NM__6_1_M34_S5_S3 6 -204 1326 DEPOSIT ABSOLUTE /end AXIS_DESCR
/end CHARACTERISTIC
/begin CHARACTERISTIC KF_WTSGLSSPORT56 "Sollschleifzeit GLS" MAP 0x1B1A44 ZF_kf_ui8_S5_S3 2550 UMR_MSEC__10_1_0_S5_S3 0 2550
 /begin AXIS_DESCR STD_AXIS zff_atsys._.iSignale._.obj.sig_n_t8 UMR_U_MIN_32_1_0_S5_S3 4 0 8160 DEPOSIT ABSOLUTE /end AXIS_DESCR
 /begin AXIS_DESCR STD_AXIS zff_atsys._.iSignale._.obj.sig_m_t8 UMR_NM__6_1_M34_S5_S3 6 -204 1326 DEPOSIT ABSOLUTE /end AXIS_DESCR
/end CHARACTERISTIC
/begin CHARACTERISTIC KF_WTSGLSSPORT63 "Sollschleifzeit GLS" MAP 0x1B246C ZF_kf_ui8_S5_S3 2550 UMR_MSEC__10_1_0_S5_S3 0 2550
 /begin AXIS_DESCR STD_AXIS zff_atsys._.iSignale._.obj.sig_n_t8 UMR_U_MIN_32_1_0_S5_S3 4 0 8160 DEPOSIT ABSOLUTE /end AXIS_DESCR
 /begin AXIS_DESCR STD_AXIS zff_atsys._.iSignale._.obj.sig_m_t8 UMR_NM__6_1_M34_S5_S3 6 -204 1326 DEPOSIT ABSOLUTE /end AXIS_DESCR
/end CHARACTERISTIC
/begin CHARACTERISTIC KF_WTSGLSSPORT64 "Sollschleifzeit GLS" MAP 0x1B24A4 ZF_kf_ui8_S5_S3 2550 UMR_MSEC__10_1_0_S5_S3 0 2550
 /begin AXIS_DESCR STD_AXIS zff_atsys._.iSignale._.obj.sig_n_t8 UMR_U_MIN_32_1_0_S5_S3 4 0 8160 DEPOSIT ABSOLUTE /end AXIS_DESCR
 /begin AXIS_DESCR STD_AXIS zff_atsys._.iSignale._.obj.sig_m_t8 UMR_NM__6_1_M34_S5_S3 6 -204 1326 DEPOSIT ABSOLUTE /end AXIS_DESCR
/end CHARACTERISTIC
/begin CHARACTERISTIC KF_WTSGLSSPORT65 "Sollschleifzeit GLS" MAP 0x1B22E4 ZF_kf_ui8_S5_S3 2550 UMR_MSEC__10_1_0_S5_S3 0 2550
 /begin AXIS_DESCR STD_AXIS zff_atsys._.iSignale._.obj.sig_n_t8 UMR_U_MIN_32_1_0_S5_S3 4 0 8160 DEPOSIT ABSOLUTE /end AXIS_DESCR
 /begin AXIS_DESCR STD_AXIS zff_atsys._.iSignale._.obj.sig_m_t8 UMR_NM__6_1_M34_S5_S3 6 -204 1326 DEPOSIT ABSOLUTE /end AXIS_DESCR
/end CHARACTERISTIC
/begin CHARACTERISTIC KF_WTSGLSSPORT67 "Sollschleifzeit GLS" MAP 0x1B1A88 ZF_kf_ui8_S5_S3 2550 UMR_MSEC__10_1_0_S5_S3 0 2550
 /begin AXIS_DESCR STD_AXIS zff_atsys._.iSignale._.obj.sig_n_t8 UMR_U_MIN_32_1_0_S5_S3 4 0 8160 DEPOSIT ABSOLUTE /end AXIS_DESCR
 /begin AXIS_DESCR STD_AXIS zff_atsys._.iSignale._.obj.sig_m_t8 UMR_NM__6_1_M34_S5_S3 6 -204 1326 DEPOSIT ABSOLUTE /end AXIS_DESCR
/end CHARACTERISTIC
/begin CHARACTERISTIC KF_WTSGLSSPORT71 "Sollschleifzeit GLS" MAP 0x1B24DC ZF_kf_ui8_S5_S3 2550 UMR_MSEC__10_1_0_S5_S3 0 2550
 /begin AXIS_DESCR STD_AXIS zff_atsys._.iSignale._.obj.sig_n_t8 UMR_U_MIN_32_1_0_S5_S3 4 0 8160 DEPOSIT ABSOLUTE /end AXIS_DESCR
 /begin AXIS_DESCR STD_AXIS zff_atsys._.iSignale._.obj.sig_m_t8 UMR_NM__6_1_M34_S5_S3 6 -204 1326 DEPOSIT ABSOLUTE /end AXIS_DESCR
/end CHARACTERISTIC
/begin CHARACTERISTIC KF_WTSGLSSPORT75 "Sollschleifzeit GLS" MAP 0x1B2514 ZF_kf_ui8_S5_S3 2550 UMR_MSEC__10_1_0_S5_S3 0 2550
 /begin AXIS_DESCR STD_AXIS zff_atsys._.iSignale._.obj.sig_n_t8 UMR_U_MIN_32_1_0_S5_S3 4 0 8160 DEPOSIT ABSOLUTE /end AXIS_DESCR
 /begin AXIS_DESCR STD_AXIS zff_atsys._.iSignale._.obj.sig_m_t8 UMR_NM__6_1_M34_S5_S3 6 -204 1326 DEPOSIT ABSOLUTE /end AXIS_DESCR
/end CHARACTERISTIC
/begin CHARACTERISTIC KF_WTSGLSSPORT76 "Sollschleifzeit GLS" MAP 0x1B231C ZF_kf_ui8_S5_S3 2550 UMR_MSEC__10_1_0_S5_S3 0 2550
 /begin AXIS_DESCR STD_AXIS zff_atsys._.iSignale._.obj.sig_n_t8 UMR_U_MIN_32_1_0_S5_S3 4 0 8160 DEPOSIT ABSOLUTE /end AXIS_DESCR
 /begin AXIS_DESCR STD_AXIS zff_atsys._.iSignale._.obj.sig_m_t8 UMR_NM__6_1_M34_S5_S3 6 -204 1326 DEPOSIT ABSOLUTE /end AXIS_DESCR
/end CHARACTERISTIC
/begin CHARACTERISTIC KF_WTSGLSSPORT78 "Sollschleifzeit GLS" MAP 0x1B1ACC ZF_kf_ui8_S5_S3 2550 UMR_MSEC__10_1_0_S5_S3 0 2550
 /begin AXIS_DESCR STD_AXIS zff_atsys._.iSignale._.obj.sig_n_t8 UMR_U_MIN_32_1_0_S5_S3 4 0 8160 DEPOSIT ABSOLUTE /end AXIS_DESCR
 /begin AXIS_DESCR STD_AXIS zff_atsys._.iSignale._.obj.sig_m_t8 UMR_NM__6_1_M34_S5_S3 6 -204 1326 DEPOSIT ABSOLUTE /end AXIS_DESCR
/end CHARACTERISTIC
/begin CHARACTERISTIC KF_WTSGLSSPORT82 "Sollschleifzeit GLS" MAP 0x1B254C ZF_kf_ui8_S5_S3 2550 UMR_MSEC__10_1_0_S5_S3 0 2550
 /begin AXIS_DESCR STD_AXIS zff_atsys._.iSignale._.obj.sig_n_t8 UMR_U_MIN_32_1_0_S5_S3 4 0 8160 DEPOSIT ABSOLUTE /end AXIS_DESCR
 /begin AXIS_DESCR STD_AXIS zff_atsys._.iSignale._.obj.sig_m_t8 UMR_NM__6_1_M34_S5_S3 6 -204 1326 DEPOSIT ABSOLUTE /end AXIS_DESCR
/end CHARACTERISTIC
/begin CHARACTERISTIC KF_WTSGLSSPORT84 "Sollschleifzeit GLS" MAP 0x1B2584 ZF_kf_ui8_S5_S3 2550 UMR_MSEC__10_1_0_S5_S3 0 2550
 /begin AXIS_DESCR STD_AXIS zff_atsys._.iSignale._.obj.sig_n_t8 UMR_U_MIN_32_1_0_S5_S3 4 0 8160 DEPOSIT ABSOLUTE /end AXIS_DESCR
 /begin AXIS_DESCR STD_AXIS zff_atsys._.iSignale._.obj.sig_m_t8 UMR_NM__6_1_M34_S5_S3 6 -204 1326 DEPOSIT ABSOLUTE /end AXIS_DESCR
/end CHARACTERISTIC
/begin CHARACTERISTIC KF_WTSGLSSPORT86 "Sollschleifzeit GLS" MAP 0x1B25BC ZF_kf_ui8_S5_S3 2550 UMR_MSEC__10_1_0_S5_S3 0 2550
 /begin AXIS_DESCR STD_AXIS zff_atsys._.iSignale._.obj.sig_n_t8 UMR_U_MIN_32_1_0_S5_S3 4 0 8160 DEPOSIT ABSOLUTE /end AXIS_DESCR
 /begin AXIS_DESCR STD_AXIS zff_atsys._.iSignale._.obj.sig_m_t8 UMR_NM__6_1_M34_S5_S3 6 -204 1326 DEPOSIT ABSOLUTE /end AXIS_DESCR
/end CHARACTERISTIC
/begin CHARACTERISTIC KF_WTSGLSSPORT87 "Sollschleifzeit GLS" MAP 0x1B2354 ZF_kf_ui8_S5_S3 2550 UMR_MSEC__10_1_0_S5_S3 0 2550
 /begin AXIS_DESCR STD_AXIS zff_atsys._.iSignale._.obj.sig_n_t8 UMR_U_MIN_32_1_0_S5_S3 4 0 8160 DEPOSIT ABSOLUTE /end AXIS_DESCR
 /begin AXIS_DESCR STD_AXIS zff_atsys._.iSignale._.obj.sig_m_t8 UMR_NM__6_1_M34_S5_S3 6 -204 1326 DEPOSIT ABSOLUTE /end AXIS_DESCR
/end CHARACTERISTIC
/begin CHARACTERISTIC KI_GLSKAB12 "Integralfaktor PID-Regler GLS" VALUE 0x1D8592 ZF_kw_ui16_S5_S3 10000 UMR_MBARMINSEC_10MSEC_1_1_0_S5_S3 0 10000 /end CHARACTERISTIC
/begin CHARACTERISTIC KI_GLSKAB12_EL "Integralfaktor PID-Regler GLS" VALUE 0x1D8594 ZF_kw_ui16_S5_S3 10000 UMR_MBARMINSEC_10MSEC_1_1_0_S5_S3 0 10000 /end CHARACTERISTIC
/begin CHARACTERISTIC KI_GLSKAB21 "Integralfaktor PID-Regler GLS" VALUE 0x1D87D4 ZF_kw_ui16_S5_S3 10000 UMR_MBARMINSEC_10MSEC_1_1_0_S5_S3 0 10000 /end CHARACTERISTIC
/begin CHARACTERISTIC KI_GLSKAB21_EL "Integralfaktor PID-Regler GLS" VALUE 0x1D87D6 ZF_kw_ui16_S5_S3 10000 UMR_MBARMINSEC_10MSEC_1_1_0_S5_S3 0 10000 /end CHARACTERISTIC
/begin CHARACTERISTIC KI_GLSKAB23 "Integralfaktor PID-Regler GLS" VALUE 0x1D85B8 ZF_kw_ui16_S5_S3 10000 UMR_MBARMINSEC_10MSEC_1_1_0_S5_S3 0 10000 /end CHARACTERISTIC
/begin CHARACTERISTIC KI_GLSKAB23_EL "Integralfaktor PID-Regler GLS" VALUE 0x1D85BA ZF_kw_ui16_S5_S3 10000 UMR_MBARMINSEC_10MSEC_1_1_0_S5_S3 0 10000 /end CHARACTERISTIC
/begin CHARACTERISTIC KI_GLSKAB34 "Integralfaktor PID-Regler GLS" VALUE 0x1D85DE ZF_kw_ui16_S5_S3 10000 UMR_MBARMINSEC_10MSEC_1_1_0_S5_S3 0 10000 /end CHARACTERISTIC
/begin CHARACTERISTIC KI_GLSKAB34_EL "Integralfaktor PID-Regler GLS" VALUE 0x1D85E0 ZF_kw_ui16_S5_S3 10000 UMR_MBARMINSEC_10MSEC_1_1_0_S5_S3 0 10000 /end CHARACTERISTIC
/begin CHARACTERISTIC KI_GLSKAB45 "Integralfaktor PID-Regler GLS" VALUE 0x1D8604 ZF_kw_ui16_S5_S3 10000 UMR_MBARMINSEC_10MSEC_1_1_0_S5_S3 0 10000 /end CHARACTERISTIC
/begin CHARACTERISTIC KI_GLSKAB45_EL "Integralfaktor PID-Regler GLS" VALUE 0x1D8606 ZF_kw_ui16_S5_S3 10000 UMR_MBARMINSEC_10MSEC_1_1_0_S5_S3 0 10000 /end CHARACTERISTIC
/begin CHARACTERISTIC KI_GLSKAB56 "Integralfaktor PID-Regler GLS" VALUE 0x1D862A ZF_kw_ui16_S5_S3 10000 UMR_MBARMINSEC_10MSEC_1_1_0_S5_S3 0 10000 /end CHARACTERISTIC
/begin CHARACTERISTIC KI_GLSKAB56_EL "Integralfaktor PID-Regler GLS" VALUE 0x1D862C ZF_kw_ui16_S5_S3 10000 UMR_MBARMINSEC_10MSEC_1_1_0_S5_S3 0 10000 /end CHARACTERISTIC
/begin CHARACTERISTIC KI_GLSKAB67 "Integralfaktor PID-Regler GLS" VALUE 0x1D8650 ZF_kw_ui16_S5_S3 10000 UMR_MBARMINSEC_10MSEC_1_1_0_S5_S3 0 10000 /end CHARACTERISTIC
/begin CHARACTERISTIC KI_GLSKAB67_EL "Integralfaktor PID-Regler GLS" VALUE 0x1D8652 ZF_kw_ui16_S5_S3 10000 UMR_MBARMINSEC_10MSEC_1_1_0_S5_S3 0 10000 /end CHARACTERISTIC
/begin CHARACTERISTIC KI_GLSKAB78 "Integralfaktor PID-Regler GLS" VALUE 0x1D8676 ZF_kw_ui16_S5_S3 10000 UMR_MBARMINSEC_10MSEC_1_1_0_S5_S3 0 10000 /end CHARACTERISTIC
/begin CHARACTERISTIC KI_GLSKAB78_EL "Integralfaktor PID-Regler GLS" VALUE 0x1D8678 ZF_kw_ui16_S5_S3 10000 UMR_MBARMINSEC_10MSEC_1_1_0_S5_S3 0 10000 /end CHARACTERISTIC
/begin CHARACTERISTIC KI_GLSKABSP31 "Integralfaktor PID-Regler GLS" VALUE 0x1D88D0 ZF_kw_ui16_S5_S3 10000 UMR_MBARMINSEC_10MSEC_1_1_0_S5_S3 0 10000 /end CHARACTERISTIC
/begin CHARACTERISTIC KI_GLSKABSP31_EL "Integralfaktor PID-Regler GLS" VALUE 0x1D88D2 ZF_kw_ui16_S5_S3 10000 UMR_MBARMINSEC_10MSEC_1_1_0_S5_S3 0 10000 /end CHARACTERISTIC
/begin CHARACTERISTIC KI_GLSKZU12 "Integralfaktor PID-Regler GLS" VALUE 0x1D857E ZF_kw_ui16_S5_S3 10000 UMR_MBARMINSEC_10MSEC_1_1_0_S5_S3 0 10000 /end CHARACTERISTIC
/begin CHARACTERISTIC KI_GLSKZU12_EL "Integralfaktor PID-Regler GLS" VALUE 0x1D8580 ZF_kw_ui16_S5_S3 10000 UMR_MBARMINSEC_10MSEC_1_1_0_S5_S3 0 10000 /end CHARACTERISTIC
/begin CHARACTERISTIC KI_GLSKZU21 "I-Faktor PID-Regler GLS" VALUE 0x1D87BC ZF_kw_ui16_S5_S3 10000 UMR_MBARMINSEC_10MSEC_1_1_0_S5_S3 0 10000 /end CHARACTERISTIC
/begin CHARACTERISTIC KI_GLSKZU21_EL "I-Faktor PID-Regler GLS" VALUE 0x1D87BE ZF_kw_ui16_S5_S3 10000 UMR_MBARMINSEC_10MSEC_1_1_0_S5_S3 0 10000 /end CHARACTERISTIC
/begin CHARACTERISTIC KI_GLSKZU23 "Integralfaktor PID-Regler GLS" VALUE 0x1D85A4 ZF_kw_ui16_S5_S3 10000 UMR_MBARMINSEC_10MSEC_1_1_0_S5_S3 0 10000 /end CHARACTERISTIC
/begin CHARACTERISTIC KI_GLSKZU23_EL "Integralfaktor PID-Regler GLS" VALUE 0x1D85A6 ZF_kw_ui16_S5_S3 10000 UMR_MBARMINSEC_10MSEC_1_1_0_S5_S3 0 10000 /end CHARACTERISTIC
/begin CHARACTERISTIC KI_GLSKZU34 "Integralfaktor PID-Regler GLS" VALUE 0x1D85CA ZF_kw_ui16_S5_S3 10000 UMR_MBARMINSEC_10MSEC_1_1_0_S5_S3 0 10000 /end CHARACTERISTIC
/begin CHARACTERISTIC KI_GLSKZU34_EL "Integralfaktor PID-Regler GLS" VALUE 0x1D85CC ZF_kw_ui16_S5_S3 10000 UMR_MBARMINSEC_10MSEC_1_1_0_S5_S3 0 10000 /end CHARACTERISTIC
/begin CHARACTERISTIC KI_GLSKZU45 "Integralfaktor PID-Regler GLS" VALUE 0x1D85F0 ZF_kw_ui16_S5_S3 10000 UMR_MBARMINSEC_10MSEC_1_1_0_S5_S3 0 10000 /end CHARACTERISTIC
/begin CHARACTERISTIC KI_GLSKZU45_EL "Integralfaktor PID-Regler GLS" VALUE 0x1D85F2 ZF_kw_ui16_S5_S3 10000 UMR_MBARMINSEC_10MSEC_1_1_0_S5_S3 0 10000 /end CHARACTERISTIC
/begin CHARACTERISTIC KI_GLSKZU56 "Integralfaktor PID-Regler GLS" VALUE 0x1D8616 ZF_kw_ui16_S5_S3 10000 UMR_MBARMINSEC_10MSEC_1_1_0_S5_S3 0 10000 /end CHARACTERISTIC
/begin CHARACTERISTIC KI_GLSKZU56_EL "Integralfaktor PID-Regler GLS" VALUE 0x1D8618 ZF_kw_ui16_S5_S3 10000 UMR_MBARMINSEC_10MSEC_1_1_0_S5_S3 0 10000 /end CHARACTERISTIC
/begin CHARACTERISTIC KI_GLSKZU67 "Integralfaktor PID-Regler GLS" VALUE 0x1D863C ZF_kw_ui16_S5_S3 10000 UMR_MBARMINSEC_10MSEC_1_1_0_S5_S3 0 10000 /end CHARACTERISTIC
/begin CHARACTERISTIC KI_GLSKZU67_EL "Integralfaktor PID-Regler GLS" VALUE 0x1D863E ZF_kw_ui16_S5_S3 10000 UMR_MBARMINSEC_10MSEC_1_1_0_S5_S3 0 10000 /end CHARACTERISTIC
/begin CHARACTERISTIC KI_GLSKZU78 "Integralfaktor PID-Regler GLS" VALUE 0x1D8662 ZF_kw_ui16_S5_S3 10000 UMR_MBARMINSEC_10MSEC_1_1_0_S5_S3 0 10000 /end CHARACTERISTIC
/begin CHARACTERISTIC KI_GLSKZU78_EL "Integralfaktor PID-Regler GLS" VALUE 0x1D8664 ZF_kw_ui16_S5_S3 10000 UMR_MBARMINSEC_10MSEC_1_1_0_S5_S3 0 10000 /end CHARACTERISTIC
/begin CHARACTERISTIC KI_GLSKZUSP31 "I-Faktor PID-Regler GLS" VALUE 0x1D88B8 ZF_kw_ui16_S5_S3 10000 UMR_MBARMINSEC_10MSEC_1_1_0_S5_S3 0 10000 /end CHARACTERISTIC
/begin CHARACTERISTIC KI_GLSKZUSP31_EL "I-Faktor PID-Regler GLS" VALUE 0x1D88BA ZF_kw_ui16_S5_S3 10000 UMR_MBARMINSEC_10MSEC_1_1_0_S5_S3 0 10000 /end CHARACTERISTIC
/begin CHARACTERISTIC KL_FMENACHGLSENDE12 "Faktor der Nach-ME-Rampe HS fuer Start Filterung GLS" CURVE 0x1B1458 ZF_kl_ui8_S5_S3 1 UMR___1_100_0_S5_S3 0 1
 /begin AXIS_DESCR STD_AXIS zff_atsys._.iSignale._.obj.sig_m_t8 UMR_NM__6_1_M34_S5_S3 4 -204 1326 DEPOSIT ABSOLUTE /end AXIS_DESCR
/end CHARACTERISTIC
/begin CHARACTERISTIC KL_FMENACHGLSENDE23 "Faktor der Nach-ME-Rampe HS fuer Start Filterung GLS" CURVE 0x1B14D4 ZF_kl_ui8_S5_S3 1 UMR___1_100_0_S5_S3 0 1
 /begin AXIS_DESCR STD_AXIS zff_atsys._.iSignale._.obj.sig_m_t8 UMR_NM__6_1_M34_S5_S3 4 -204 1326 DEPOSIT ABSOLUTE /end AXIS_DESCR
/end CHARACTERISTIC
/begin CHARACTERISTIC KL_FMENACHGLSENDE34 "Faktor der Nach-ME-Rampe HS fuer Start Filterung GLS" CURVE 0x1B1550 ZF_kl_ui8_S5_S3 1 UMR___1_100_0_S5_S3 0 1
 /begin AXIS_DESCR STD_AXIS zff_atsys._.iSignale._.obj.sig_m_t8 UMR_NM__6_1_M34_S5_S3 4 -204 1326 DEPOSIT ABSOLUTE /end AXIS_DESCR
/end CHARACTERISTIC
/begin CHARACTERISTIC KL_FMENACHGLSENDE45 "Faktor der Nach-ME-Rampe HS fuer Start Filterung GLS" CURVE 0x1B15CC ZF_kl_ui8_S5_S3 1 UMR___1_100_0_S5_S3 0 1
 /begin AXIS_DESCR STD_AXIS zff_atsys._.iSignale._.obj.sig_m_t8 UMR_NM__6_1_M34_S5_S3 4 -204 1326 DEPOSIT ABSOLUTE /end AXIS_DESCR
/end CHARACTERISTIC
/begin CHARACTERISTIC KL_FMENACHGLSENDE56 "Faktor der Nach-ME-Rampe HS fuer Start Filterung GLS" CURVE 0x1B1648 ZF_kl_ui8_S5_S3 1 UMR___1_100_0_S5_S3 0 1
 /begin AXIS_DESCR STD_AXIS zff_atsys._.iSignale._.obj.sig_m_t8 UMR_NM__6_1_M34_S5_S3 4 -204 1326 DEPOSIT ABSOLUTE /end AXIS_DESCR
/end CHARACTERISTIC
/begin CHARACTERISTIC KL_FMENACHGLSENDE67 "Faktor der Nach-ME-Rampe HS fuer Start Filterung GLS" CURVE 0x1B16C4 ZF_kl_ui8_S5_S3 1 UMR___1_100_0_S5_S3 0 1
 /begin AXIS_DESCR STD_AXIS zff_atsys._.iSignale._.obj.sig_m_t8 UMR_NM__6_1_M34_S5_S3 4 -204 1326 DEPOSIT ABSOLUTE /end AXIS_DESCR
/end CHARACTERISTIC
/begin CHARACTERISTIC KL_FMENACHGLSENDE78 "Faktor der Nach-ME-Rampe HS fuer Start Filterung GLS" CURVE 0x1B1740 ZF_kl_ui8_S5_S3 1 UMR___1_100_0_S5_S3 0 1
 /begin AXIS_DESCR STD_AXIS zff_atsys._.iSignale._.obj.sig_m_t8 UMR_NM__6_1_M34_S5_S3 4 -204 1326 DEPOSIT ABSOLUTE /end AXIS_DESCR
/end CHARACTERISTIC
/begin CHARACTERISTIC KL_FMENACHGLSENDESP12 "Faktor der Nach-ME-Rampe HS fuer Start Filterung GLS" CURVE 0x1B1784 ZF_kl_ui8_S5_S3 1 UMR___1_100_0_S5_S3 0 1
 /begin AXIS_DESCR STD_AXIS zff_atsys._.iSignale._.obj.sig_m_t8 UMR_NM__6_1_M34_S5_S3 4 -204 1326 DEPOSIT ABSOLUTE /end AXIS_DESCR
/end CHARACTERISTIC
/begin CHARACTERISTIC KL_FMENACHGLSENDESP23 "Faktor der Nach-ME-Rampe HS fuer Start Filterung GLS" CURVE 0x1B17C8 ZF_kl_ui8_S5_S3 1 UMR___1_100_0_S5_S3 0 1
 /begin AXIS_DESCR STD_AXIS zff_atsys._.iSignale._.obj.sig_m_t8 UMR_NM__6_1_M34_S5_S3 4 -204 1326 DEPOSIT ABSOLUTE /end AXIS_DESCR
/end CHARACTERISTIC
/begin CHARACTERISTIC KL_FMENACHGLSENDESP34 "Faktor der Nach-ME-Rampe HS fuer Start Filterung GLS" CURVE 0x1B180C ZF_kl_ui8_S5_S3 1 UMR___1_100_0_S5_S3 0 1
 /begin AXIS_DESCR STD_AXIS zff_atsys._.iSignale._.obj.sig_m_t8 UMR_NM__6_1_M34_S5_S3 4 -204 1326 DEPOSIT ABSOLUTE /end AXIS_DESCR
/end CHARACTERISTIC
/begin CHARACTERISTIC KL_FMENACHGLSENDESP45 "Faktor der Nach-ME-Rampe HS fuer Start Filterung GLS" CURVE 0x1B1850 ZF_kl_ui8_S5_S3 1 UMR___1_100_0_S5_S3 0 1
 /begin AXIS_DESCR STD_AXIS zff_atsys._.iSignale._.obj.sig_m_t8 UMR_NM__6_1_M34_S5_S3 4 -204 1326 DEPOSIT ABSOLUTE /end AXIS_DESCR
/end CHARACTERISTIC
/begin CHARACTERISTIC KL_FMENACHGLSENDESP56 "Faktor der Nach-ME-Rampe HS fuer Start Filterung GLS" CURVE 0x1B1894 ZF_kl_ui8_S5_S3 1 UMR___1_100_0_S5_S3 0 1
 /begin AXIS_DESCR STD_AXIS zff_atsys._.iSignale._.obj.sig_m_t8 UMR_NM__6_1_M34_S5_S3 4 -204 1326 DEPOSIT ABSOLUTE /end AXIS_DESCR
/end CHARACTERISTIC
/begin CHARACTERISTIC KL_FMENACHGLSENDESP67 "Faktor der Nach-ME-Rampe HS fuer Start Filterung GLS" CURVE 0x1B18D8 ZF_kl_ui8_S5_S3 1 UMR___1_100_0_S5_S3 0 1
 /begin AXIS_DESCR STD_AXIS zff_atsys._.iSignale._.obj.sig_m_t8 UMR_NM__6_1_M34_S5_S3 4 -204 1326 DEPOSIT ABSOLUTE /end AXIS_DESCR
/end CHARACTERISTIC
/begin CHARACTERISTIC KL_FMENACHGLSENDESP78 "Faktor der Nach-ME-Rampe HS fuer Start Filterung GLS" CURVE 0x1B191C ZF_kl_ui8_S5_S3 1 UMR___1_100_0_S5_S3 0 1
 /begin AXIS_DESCR STD_AXIS zff_atsys._.iSignale._.obj.sig_m_t8 UMR_NM__6_1_M34_S5_S3 4 -204 1326 DEPOSIT ABSOLUTE /end AXIS_DESCR
/end CHARACTERISTIC
/begin CHARACTERISTIC KL_FMENACHGLSENDESPORT12 "Faktor der Nach-ME-Rampe HS fuer Start Filterung GLS" CURVE 0x1B1960 ZF_kl_ui8_S5_S3 1 UMR___1_100_0_S5_S3 0 1
 /begin AXIS_DESCR STD_AXIS zff_atsys._.iSignale._.obj.sig_m_t8 UMR_NM__6_1_M34_S5_S3 4 -204 1326 DEPOSIT ABSOLUTE /end AXIS_DESCR
/end CHARACTERISTIC
/begin CHARACTERISTIC KL_FMENACHGLSENDESPORT23 "Faktor der Nach-ME-Rampe HS fuer Start Filterung GLS" CURVE 0x1B19A4 ZF_kl_ui8_S5_S3 1 UMR___1_100_0_S5_S3 0 1
 /begin AXIS_DESCR STD_AXIS zff_atsys._.iSignale._.obj.sig_m_t8 UMR_NM__6_1_M34_S5_S3 4 -204 1326 DEPOSIT ABSOLUTE /end AXIS_DESCR
/end CHARACTERISTIC
/begin CHARACTERISTIC KL_FMENACHGLSENDESPORT34 "Faktor der Nach-ME-Rampe HS fuer Start Filterung GLS" CURVE 0x1B19E8 ZF_kl_ui8_S5_S3 1 UMR___1_100_0_S5_S3 0 1
 /begin AXIS_DESCR STD_AXIS zff_atsys._.iSignale._.obj.sig_m_t8 UMR_NM__6_1_M34_S5_S3 4 -204 1326 DEPOSIT ABSOLUTE /end AXIS_DESCR
/end CHARACTERISTIC
/begin CHARACTERISTIC KL_FMENACHGLSENDESPORT45 "Faktor der Nach-ME-Rampe HS fuer Start Filterung GLS" CURVE 0x1B1A2C ZF_kl_ui8_S5_S3 1 UMR___1_100_0_S5_S3 0 1
 /begin AXIS_DESCR STD_AXIS zff_atsys._.iSignale._.obj.sig_m_t8 UMR_NM__6_1_M34_S5_S3 4 -204 1326 DEPOSIT ABSOLUTE /end AXIS_DESCR
/end CHARACTERISTIC
/begin CHARACTERISTIC KL_FMENACHGLSENDESPORT56 "Faktor der Nach-ME-Rampe HS fuer Start Filterung GLS" CURVE 0x1B1A70 ZF_kl_ui8_S5_S3 1 UMR___1_100_0_S5_S3 0 1
 /begin AXIS_DESCR STD_AXIS zff_atsys._.iSignale._.obj.sig_m_t8 UMR_NM__6_1_M34_S5_S3 4 -204 1326 DEPOSIT ABSOLUTE /end AXIS_DESCR
/end CHARACTERISTIC
/begin CHARACTERISTIC KL_FMENACHGLSENDESPORT67 "Faktor der Nach-ME-Rampe HS fuer Start Filterung GLS" CURVE 0x1B1AB4 ZF_kl_ui8_S5_S3 1 UMR___1_100_0_S5_S3 0 1
 /begin AXIS_DESCR STD_AXIS zff_atsys._.iSignale._.obj.sig_m_t8 UMR_NM__6_1_M34_S5_S3 4 -204 1326 DEPOSIT ABSOLUTE /end AXIS_DESCR
/end CHARACTERISTIC
/begin CHARACTERISTIC KL_FMENACHGLSENDESPORT78 "Faktor der Nach-ME-Rampe HS fuer Start Filterung GLS" CURVE 0x1B1AF8 ZF_kl_ui8_S5_S3 1 UMR___1_100_0_S5_S3 0 1
 /begin AXIS_DESCR STD_AXIS zff_atsys._.iSignale._.obj.sig_m_t8 UMR_NM__6_1_M34_S5_S3 4 -204 1326 DEPOSIT ABSOLUTE /end AXIS_DESCR
/end CHARACTERISTIC
/begin CHARACTERISTIC KL_KIGLSKZUCG_1 "Integralfaktor PID-Regler GLS Gangeinlegen" CURVE 0x1B105C ZF_kl_ui16_S5_S3 10000 UMR_MBARMINSEC__1_1_0_S5_S3 0 10000
 /begin AXIS_DESCR STD_AXIS iSasZentr.c_getr_sas UMR_GRADC__1_1_M40_S5_S3 4 -40 150 DEPOSIT ABSOLUTE /end AXIS_DESCR
/end CHARACTERISTIC
/begin CHARACTERISTIC KL_KIGLSKZUCG_2 "Integralfaktor PID-Regler GLS Gangeinlegen" CURVE 0x1B10D0 ZF_kl_ui16_S5_S3 10000 UMR_MBARMINSEC__1_1_0_S5_S3 0 10000
 /begin AXIS_DESCR STD_AXIS iSasZentr.c_getr_sas UMR_GRADC__1_1_M40_S5_S3 4 -40 150 DEPOSIT ABSOLUTE /end AXIS_DESCR
/end CHARACTERISTIC
/begin CHARACTERISTIC KL_KIGLSKZUCG_3 "Integralfaktor PID-Regler GLS Gangeinlegen" CURVE 0x1B1144 ZF_kl_ui16_S5_S3 10000 UMR_MBARMINSEC__1_1_0_S5_S3 0 10000
 /begin AXIS_DESCR STD_AXIS iSasZentr.c_getr_sas UMR_GRADC__1_1_M40_S5_S3 4 -40 150 DEPOSIT ABSOLUTE /end AXIS_DESCR
/end CHARACTERISTIC
/begin CHARACTERISTIC KL_KIGLSKZUCG_4 "Integralfaktor PID-Regler GLS Gangeinlegen" CURVE 0x1B11B8 ZF_kl_ui16_S5_S3 10000 UMR_MBARMINSEC__1_1_0_S5_S3 0 10000
 /begin AXIS_DESCR STD_AXIS iSasZentr.c_getr_sas UMR_GRADC__1_1_M40_S5_S3 4 -40 150 DEPOSIT ABSOLUTE /end AXIS_DESCR
/end CHARACTERISTIC
/begin CHARACTERISTIC KL_KIGLSKZUCG_5 "Integralfaktor PID-Regler GLS Gangeinlegen" CURVE 0x1B122C ZF_kl_ui16_S5_S3 10000 UMR_MBARMINSEC__1_1_0_S5_S3 0 10000
 /begin AXIS_DESCR STD_AXIS iSasZentr.c_getr_sas UMR_GRADC__1_1_M40_S5_S3 4 -40 150 DEPOSIT ABSOLUTE /end AXIS_DESCR
/end CHARACTERISTIC
/begin CHARACTERISTIC KL_KIGLSKZUCG_6 "Integralfaktor PID-Regler GLS Gangeinlegen" CURVE 0x1B12A0 ZF_kl_ui16_S5_S3 10000 UMR_MBARMINSEC__1_1_0_S5_S3 0 10000
 /begin AXIS_DESCR STD_AXIS iSasZentr.c_getr_sas UMR_GRADC__1_1_M40_S5_S3 4 -40 150 DEPOSIT ABSOLUTE /end AXIS_DESCR
/end CHARACTERISTIC
/begin CHARACTERISTIC KL_KIGLSKZUCG_7 "Integralfaktor PID-Regler GLS Gangeinlegen" CURVE 0x1B1314 ZF_kl_ui16_S5_S3 10000 UMR_MBARMINSEC__1_1_0_S5_S3 0 10000
 /begin AXIS_DESCR STD_AXIS iSasZentr.c_getr_sas UMR_GRADC__1_1_M40_S5_S3 4 -40 150 DEPOSIT ABSOLUTE /end AXIS_DESCR
/end CHARACTERISTIC
/begin CHARACTERISTIC KL_KIGLSKZUCG_8 "Integralfaktor PID-Regler GLS Gangeinlegen" CURVE 0x1B1388 ZF_kl_ui16_S5_S3 10000 UMR_MBARMINSEC__1_1_0_S5_S3 0 10000
 /begin AXIS_DESCR STD_AXIS iSasZentr.c_getr_sas UMR_GRADC__1_1_M40_S5_S3 4 -40 150 DEPOSIT ABSOLUTE /end AXIS_DESCR
/end CHARACTERISTIC
/begin CHARACTERISTIC KL_KIGLSKZUCG_R "Integralfaktor PID-Regler GLS Gangeinlegen" CURVE 0x1B0FE8 ZF_kl_ui16_S5_S3 10000 UMR_MBARMINSEC__1_1_0_S5_S3 0 10000
 /begin AXIS_DESCR STD_AXIS iSasZentr.c_getr_sas UMR_GRADC__1_1_M40_S5_S3 4 -40 150 DEPOSIT ABSOLUTE /end AXIS_DESCR
/end CHARACTERISTIC
/begin CHARACTERISTIC KL_KPGLSKZUCG_1 "Proportionalfaktor PID-Regler GLS Gangeinlegen" CURVE 0x1B1048 ZF_kl_ui16_S5_S3 10000 UMR_MBARMINSEC__1_1_0_S5_S3 0 10000
 /begin AXIS_DESCR STD_AXIS iSasZentr.c_getr_sas UMR_GRADC__1_1_M40_S5_S3 4 -40 150 DEPOSIT ABSOLUTE /end AXIS_DESCR
/end CHARACTERISTIC
/begin CHARACTERISTIC KL_KPGLSKZUCG_2 "Proportionalfaktor PID-Regler GLS Gangeinlegen" CURVE 0x1B10BC ZF_kl_ui16_S5_S3 10000 UMR_MBARMINSEC__1_1_0_S5_S3 0 10000
 /begin AXIS_DESCR STD_AXIS iSasZentr.c_getr_sas UMR_GRADC__1_1_M40_S5_S3 4 -40 150 DEPOSIT ABSOLUTE /end AXIS_DESCR
/end CHARACTERISTIC
/begin CHARACTERISTIC KL_KPGLSKZUCG_3 "Proportionalfaktor PID-Regler GLS Gangeinlegen" CURVE 0x1B1130 ZF_kl_ui16_S5_S3 10000 UMR_MBARMINSEC__1_1_0_S5_S3 0 10000
 /begin AXIS_DESCR STD_AXIS iSasZentr.c_getr_sas UMR_GRADC__1_1_M40_S5_S3 4 -40 150 DEPOSIT ABSOLUTE /end AXIS_DESCR
/end CHARACTERISTIC
/begin CHARACTERISTIC KL_KPGLSKZUCG_4 "Proportionalfaktor PID-Regler GLS Gangeinlegen" CURVE 0x1B11A4 ZF_kl_ui16_S5_S3 10000 UMR_MBARMINSEC__1_1_0_S5_S3 0 10000
 /begin AXIS_DESCR STD_AXIS iSasZentr.c_getr_sas UMR_GRADC__1_1_M40_S5_S3 4 -40 150 DEPOSIT ABSOLUTE /end AXIS_DESCR
/end CHARACTERISTIC
/begin CHARACTERISTIC KL_KPGLSKZUCG_5 "Proportionalfaktor PID-Regler GLS Gangeinlegen" CURVE 0x1B1218 ZF_kl_ui16_S5_S3 10000 UMR_MBARMINSEC__1_1_0_S5_S3 0 10000
 /begin AXIS_DESCR STD_AXIS iSasZentr.c_getr_sas UMR_GRADC__1_1_M40_S5_S3 4 -40 150 DEPOSIT ABSOLUTE /end AXIS_DESCR
/end CHARACTERISTIC
/begin CHARACTERISTIC KL_KPGLSKZUCG_6 "Proportionalfaktor PID-Regler GLS Gangeinlegen" CURVE 0x1B128C ZF_kl_ui16_S5_S3 10000 UMR_MBARMINSEC__1_1_0_S5_S3 0 10000
 /begin AXIS_DESCR STD_AXIS iSasZentr.c_getr_sas UMR_GRADC__1_1_M40_S5_S3 4 -40 150 DEPOSIT ABSOLUTE /end AXIS_DESCR
/end CHARACTERISTIC
/begin CHARACTERISTIC KL_KPGLSKZUCG_7 "Proportionalfaktor PID-Regler GLS Gangeinlegen" CURVE 0x1B1300 ZF_kl_ui16_S5_S3 10000 UMR_MBARMINSEC__1_1_0_S5_S3 0 10000
 /begin AXIS_DESCR STD_AXIS iSasZentr.c_getr_sas UMR_GRADC__1_1_M40_S5_S3 4 -40 150 DEPOSIT ABSOLUTE /end AXIS_DESCR
/end CHARACTERISTIC
/begin CHARACTERISTIC KL_KPGLSKZUCG_8 "Proportionalfaktor PID-Regler GLS Gangeinlegen" CURVE 0x1B1374 ZF_kl_ui16_S5_S3 10000 UMR_MBARMINSEC__1_1_0_S5_S3 0 10000
 /begin AXIS_DESCR STD_AXIS iSasZentr.c_getr_sas UMR_GRADC__1_1_M40_S5_S3 4 -40 150 DEPOSIT ABSOLUTE /end AXIS_DESCR
/end CHARACTERISTIC
/begin CHARACTERISTIC KL_KPGLSKZUCG_R "Proportionalfaktor PID-Regler GLS Gangeinlegen" CURVE 0x1B0FD4 ZF_kl_ui16_S5_S3 10000 UMR_MBARMINSEC__1_1_0_S5_S3 0 10000
 /begin AXIS_DESCR STD_AXIS iSasZentr.c_getr_sas UMR_GRADC__1_1_M40_S5_S3 4 -40 150 DEPOSIT ABSOLUTE /end AXIS_DESCR
/end CHARACTERISTIC
/begin CHARACTERISTIC KL_TMAXCG21 "Maximaldauer Schaltung" CURVE 0x1B0EFC ZF_kl_ui16_S5_S3 10000 UMR_MSEC__10_1_0_S5_S3 0 10000
 /begin AXIS_DESCR STD_AXIS zff_atsys._.iSignale._.obj.sig_c_getr UMR_GRADC__1_1_M40_S5_S3 2 -40 150 DEPOSIT ABSOLUTE /end AXIS_DESCR
/end CHARACTERISTIC
/begin CHARACTERISTIC KL_TMAXCG32 "Maximaldauer Schaltung" CURVE 0x1B0F08 ZF_kl_ui16_S5_S3 10000 UMR_MSEC__10_1_0_S5_S3 0 10000
 /begin AXIS_DESCR STD_AXIS zff_atsys._.iSignale._.obj.sig_c_getr UMR_GRADC__1_1_M40_S5_S3 2 -40 150 DEPOSIT ABSOLUTE /end AXIS_DESCR
/end CHARACTERISTIC
/begin CHARACTERISTIC KL_TMAXCG43 "Maximaldauer Schaltung" CURVE 0x1B0F14 ZF_kl_ui16_S5_S3 10000 UMR_MSEC__10_1_0_S5_S3 0 10000
 /begin AXIS_DESCR STD_AXIS zff_atsys._.iSignale._.obj.sig_c_getr UMR_GRADC__1_1_M40_S5_S3 2 -40 150 DEPOSIT ABSOLUTE /end AXIS_DESCR
/end CHARACTERISTIC
/begin CHARACTERISTIC KL_TMAXCG54 "Maximaldauer Schaltung" CURVE 0x1B0F20 ZF_kl_ui16_S5_S3 10000 UMR_MSEC__10_1_0_S5_S3 0 10000
 /begin AXIS_DESCR STD_AXIS zff_atsys._.iSignale._.obj.sig_c_getr UMR_GRADC__1_1_M40_S5_S3 2 -40 150 DEPOSIT ABSOLUTE /end AXIS_DESCR
/end CHARACTERISTIC
/begin CHARACTERISTIC KL_TMAXCG65 "Maximaldauer Schaltung" CURVE 0x1B0F2C ZF_kl_ui16_S5_S3 10000 UMR_MSEC__10_1_0_S5_S3 0 10000
 /begin AXIS_DESCR STD_AXIS zff_atsys._.iSignale._.obj.sig_c_getr UMR_GRADC__1_1_M40_S5_S3 2 -40 150 DEPOSIT ABSOLUTE /end AXIS_DESCR
/end CHARACTERISTIC
/begin CHARACTERISTIC KL_TMAXCG76 "Maximaldauer Schaltung" CURVE 0x1B0F38 ZF_kl_ui16_S5_S3 10000 UMR_MSEC__10_1_0_S5_S3 0 10000
 /begin AXIS_DESCR STD_AXIS zff_atsys._.iSignale._.obj.sig_c_getr UMR_GRADC__1_1_M40_S5_S3 2 -40 150 DEPOSIT ABSOLUTE /end AXIS_DESCR
/end CHARACTERISTIC
/begin CHARACTERISTIC KL_TMAXCG87 "Maximaldauer Schaltung" CURVE 0x1B0F44 ZF_kl_ui16_S5_S3 10000 UMR_MSEC__10_1_0_S5_S3 0 10000
 /begin AXIS_DESCR STD_AXIS zff_atsys._.iSignale._.obj.sig_c_getr UMR_GRADC__1_1_M40_S5_S3 2 -40 150 DEPOSIT ABSOLUTE /end AXIS_DESCR
/end CHARACTERISTIC
/begin CHARACTERISTIC KL_TMAXCGSP31 "Maximaldauer Schaltung" CURVE 0x1B0F50 ZF_kl_ui16_S5_S3 10000 UMR_MSEC__10_1_0_S5_S3 0 10000
 /begin AXIS_DESCR STD_AXIS zff_atsys._.iSignale._.obj.sig_c_getr UMR_GRADC__1_1_M40_S5_S3 2 -40 150 DEPOSIT ABSOLUTE /end AXIS_DESCR
/end CHARACTERISTIC
/begin CHARACTERISTIC KL_TMAXCGSP42 "Maximaldauer Schaltung" CURVE 0x1B0F5C ZF_kl_ui16_S5_S3 10000 UMR_MSEC__10_1_0_S5_S3 0 10000
 /begin AXIS_DESCR STD_AXIS zff_atsys._.iSignale._.obj.sig_c_getr UMR_GRADC__1_1_M40_S5_S3 2 -40 150 DEPOSIT ABSOLUTE /end AXIS_DESCR
/end CHARACTERISTIC
/begin CHARACTERISTIC KL_TMAXCGSP51 "Maximaldauer Schaltung" CURVE 0x1B0F68 ZF_kl_ui16_S5_S3 10000 UMR_MSEC__10_1_0_S5_S3 0 10000
 /begin AXIS_DESCR STD_AXIS zff_atsys._.iSignale._.obj.sig_c_getr UMR_GRADC__1_1_M40_S5_S3 2 -40 150 DEPOSIT ABSOLUTE /end AXIS_DESCR
/end CHARACTERISTIC
/begin CHARACTERISTIC KL_TMAXCGSP53 "Maximaldauer Schaltung" CURVE 0x1B0F74 ZF_kl_ui16_S5_S3 10000 UMR_MSEC__10_1_0_S5_S3 0 10000
 /begin AXIS_DESCR STD_AXIS zff_atsys._.iSignale._.obj.sig_c_getr UMR_GRADC__1_1_M40_S5_S3 2 -40 150 DEPOSIT ABSOLUTE /end AXIS_DESCR
/end CHARACTERISTIC
/begin CHARACTERISTIC KL_TMAXCGSP63 "Maximaldauer Schaltung" CURVE 0x1B0F80 ZF_kl_ui16_S5_S3 10000 UMR_MSEC__10_1_0_S5_S3 0 10000
 /begin AXIS_DESCR STD_AXIS zff_atsys._.iSignale._.obj.sig_c_getr UMR_GRADC__1_1_M40_S5_S3 2 -40 150 DEPOSIT ABSOLUTE /end AXIS_DESCR
/end CHARACTERISTIC
/begin CHARACTERISTIC KL_TMAXCGSP64 "Maximaldauer Schaltung" CURVE 0x1B0F8C ZF_kl_ui16_S5_S3 10000 UMR_MSEC__10_1_0_S5_S3 0 10000
 /begin AXIS_DESCR STD_AXIS zff_atsys._.iSignale._.obj.sig_c_getr UMR_GRADC__1_1_M40_S5_S3 2 -40 150 DEPOSIT ABSOLUTE /end AXIS_DESCR
/end CHARACTERISTIC
/begin CHARACTERISTIC KL_TMAXCGSP71 "Maximaldauer Schaltung" CURVE 0x1B0F98 ZF_kl_ui16_S5_S3 10000 UMR_MSEC__10_1_0_S5_S3 0 10000
 /begin AXIS_DESCR STD_AXIS zff_atsys._.iSignale._.obj.sig_c_getr UMR_GRADC__1_1_M40_S5_S3 2 -40 150 DEPOSIT ABSOLUTE /end AXIS_DESCR
/end CHARACTERISTIC
/begin CHARACTERISTIC KL_TMAXCGSP75 "Maximaldauer Schaltung" CURVE 0x1B0FA4 ZF_kl_ui16_S5_S3 10000 UMR_MSEC__10_1_0_S5_S3 0 10000
 /begin AXIS_DESCR STD_AXIS zff_atsys._.iSignale._.obj.sig_c_getr UMR_GRADC__1_1_M40_S5_S3 2 -40 150 DEPOSIT ABSOLUTE /end AXIS_DESCR
/end CHARACTERISTIC
/begin CHARACTERISTIC KL_TMAXCGSP82 "Maximaldauer Schaltung" CURVE 0x1B0FB0 ZF_kl_ui16_S5_S3 10000 UMR_MSEC__10_1_0_S5_S3 0 10000
 /begin AXIS_DESCR STD_AXIS zff_atsys._.iSignale._.obj.sig_c_getr UMR_GRADC__1_1_M40_S5_S3 2 -40 150 DEPOSIT ABSOLUTE /end AXIS_DESCR
/end CHARACTERISTIC
/begin CHARACTERISTIC KL_TMAXCGSP84 "Maximaldauer Schaltung" CURVE 0x1B0FBC ZF_kl_ui16_S5_S3 10000 UMR_MSEC__10_1_0_S5_S3 0 10000
 /begin AXIS_DESCR STD_AXIS zff_atsys._.iSignale._.obj.sig_c_getr UMR_GRADC__1_1_M40_S5_S3 2 -40 150 DEPOSIT ABSOLUTE /end AXIS_DESCR
/end CHARACTERISTIC
/begin CHARACTERISTIC KL_TMAXCGSP86 "Maximaldauer Schaltung" CURVE 0x1B0FC8 ZF_kl_ui16_S5_S3 10000 UMR_MSEC__10_1_0_S5_S3 0 10000
 /begin AXIS_DESCR STD_AXIS zff_atsys._.iSignale._.obj.sig_c_getr UMR_GRADC__1_1_M40_S5_S3 2 -40 150 DEPOSIT ABSOLUTE /end AXIS_DESCR
/end CHARACTERISTIC
/begin CHARACTERISTIC KL_TVGLSKABCG12 "Verzoegerungszeit GLS-Beginn" CURVE 0x1AEDC0 ZF_kl_ui8_S5_S3 2540 UMR_MSEC__10_1_0_S5_S3 0 2540
 /begin AXIS_DESCR STD_AXIS zff_atsys._.iSignale._.obj.sig_c_getr UMR_GRADC__1_1_M40_S5_S3 3 -40 150 DEPOSIT ABSOLUTE /end AXIS_DESCR
/end CHARACTERISTIC
/begin CHARACTERISTIC KL_TVGLSKABCG21 "Verzoegerungszeit GLS-Beginn" CURVE 0x1B1B5C ZF_kl_ui8_S5_S3 2540 UMR_MSEC__10_1_0_S5_S3 0 2540
 /begin AXIS_DESCR STD_AXIS zff_atsys._.iSignale._.obj.sig_c_getr UMR_GRADC__1_1_M40_S5_S3 3 -40 150 DEPOSIT ABSOLUTE /end AXIS_DESCR
/end CHARACTERISTIC
/begin CHARACTERISTIC KL_TVGLSKABCG21_EL "Verzoegerungszeit GLS-Beginn" CURVE 0x1B1B68 ZF_kl_ui8_S5_S3 2540 UMR_MSEC__10_1_0_S5_S3 0 2540
 /begin AXIS_DESCR STD_AXIS zff_atsys._.iSignale._.obj.sig_c_getr UMR_GRADC__1_1_M40_S5_S3 3 -40 150 DEPOSIT ABSOLUTE /end AXIS_DESCR
/end CHARACTERISTIC
/begin CHARACTERISTIC KL_TVGLSKABCG23 "Verzoegerungszeit GLS-Beginn" CURVE 0x1AEDCC ZF_kl_ui8_S5_S3 2540 UMR_MSEC__10_1_0_S5_S3 0 2540
 /begin AXIS_DESCR STD_AXIS zff_atsys._.iSignale._.obj.sig_c_getr UMR_GRADC__1_1_M40_S5_S3 3 -40 150 DEPOSIT ABSOLUTE /end AXIS_DESCR
/end CHARACTERISTIC
/begin CHARACTERISTIC KL_TVGLSKABCG32 "Verzoegerungszeit GLS-Beginn" CURVE 0x1B1BCC ZF_kl_ui8_S5_S3 2540 UMR_MSEC__10_1_0_S5_S3 0 2540
 /begin AXIS_DESCR STD_AXIS zff_atsys._.iSignale._.obj.sig_c_getr UMR_GRADC__1_1_M40_S5_S3 3 -40 150 DEPOSIT ABSOLUTE /end AXIS_DESCR
/end CHARACTERISTIC
/begin CHARACTERISTIC KL_TVGLSKABCG32_EL "Verzoegerungszeit GLS-Beginn" CURVE 0x1B1BD8 ZF_kl_ui8_S5_S3 2540 UMR_MSEC__10_1_0_S5_S3 0 2540
 /begin AXIS_DESCR STD_AXIS zff_atsys._.iSignale._.obj.sig_c_getr UMR_GRADC__1_1_M40_S5_S3 3 -40 150 DEPOSIT ABSOLUTE /end AXIS_DESCR
/end CHARACTERISTIC
/begin CHARACTERISTIC KL_TVGLSKABCG34 "Verzoegerungszeit GLS-Beginn" CURVE 0x1AEDD8 ZF_kl_ui8_S5_S3 2540 UMR_MSEC__10_1_0_S5_S3 0 2540
 /begin AXIS_DESCR STD_AXIS zff_atsys._.iSignale._.obj.sig_c_getr UMR_GRADC__1_1_M40_S5_S3 3 -40 150 DEPOSIT ABSOLUTE /end AXIS_DESCR
/end CHARACTERISTIC
/begin CHARACTERISTIC KL_TVGLSKABCG43 "Verzoegerungszeit GLS-Beginn" CURVE 0x1B1C3C ZF_kl_ui8_S5_S3 2540 UMR_MSEC__10_1_0_S5_S3 0 2540
 /begin AXIS_DESCR STD_AXIS zff_atsys._.iSignale._.obj.sig_c_getr UMR_GRADC__1_1_M40_S5_S3 3 -40 150 DEPOSIT ABSOLUTE /end AXIS_DESCR
/end CHARACTERISTIC
/begin CHARACTERISTIC KL_TVGLSKABCG43_EL "Verzoegerungszeit GLS-Beginn" CURVE 0x1B1C48 ZF_kl_ui8_S5_S3 2540 UMR_MSEC__10_1_0_S5_S3 0 2540
 /begin AXIS_DESCR STD_AXIS zff_atsys._.iSignale._.obj.sig_c_getr UMR_GRADC__1_1_M40_S5_S3 3 -40 150 DEPOSIT ABSOLUTE /end AXIS_DESCR
/end CHARACTERISTIC
/begin CHARACTERISTIC KL_TVGLSKABCG45 "Verzoegerungszeit GLS-Beginn" CURVE 0x1AEDE4 ZF_kl_ui8_S5_S3 2540 UMR_MSEC__10_1_0_S5_S3 0 2540
 /begin AXIS_DESCR STD_AXIS zff_atsys._.iSignale._.obj.sig_c_getr UMR_GRADC__1_1_M40_S5_S3 3 -40 150 DEPOSIT ABSOLUTE /end AXIS_DESCR
/end CHARACTERISTIC
/begin CHARACTERISTIC KL_TVGLSKABCG54 "Verzoegerungszeit GLS-Beginn" CURVE 0x1B1CAC ZF_kl_ui8_S5_S3 2540 UMR_MSEC__10_1_0_S5_S3 0 2540
 /begin AXIS_DESCR STD_AXIS zff_atsys._.iSignale._.obj.sig_c_getr UMR_GRADC__1_1_M40_S5_S3 3 -40 150 DEPOSIT ABSOLUTE /end AXIS_DESCR
/end CHARACTERISTIC
/begin CHARACTERISTIC KL_TVGLSKABCG54_EL "Verzoegerungszeit GLS-Beginn" CURVE 0x1B1CB8 ZF_kl_ui8_S5_S3 2540 UMR_MSEC__10_1_0_S5_S3 0 2540
 /begin AXIS_DESCR STD_AXIS zff_atsys._.iSignale._.obj.sig_c_getr UMR_GRADC__1_1_M40_S5_S3 3 -40 150 DEPOSIT ABSOLUTE /end AXIS_DESCR
/end CHARACTERISTIC
/begin CHARACTERISTIC KL_TVGLSKABCG56 "Verzoegerungszeit GLS-Beginn" CURVE 0x1AEDF0 ZF_kl_ui8_S5_S3 2540 UMR_MSEC__10_1_0_S5_S3 0 2540
 /begin AXIS_DESCR STD_AXIS zff_atsys._.iSignale._.obj.sig_c_getr UMR_GRADC__1_1_M40_S5_S3 3 -40 150 DEPOSIT ABSOLUTE /end AXIS_DESCR
/end CHARACTERISTIC
/begin CHARACTERISTIC KL_TVGLSKABCG65 "Verzoegerungszeit GLS-Beginn" CURVE 0x1B1D1C ZF_kl_ui8_S5_S3 2540 UMR_MSEC__10_1_0_S5_S3 0 2540
 /begin AXIS_DESCR STD_AXIS zff_atsys._.iSignale._.obj.sig_c_getr UMR_GRADC__1_1_M40_S5_S3 3 -40 150 DEPOSIT ABSOLUTE /end AXIS_DESCR
/end CHARACTERISTIC
/begin CHARACTERISTIC KL_TVGLSKABCG65_EL "Verzoegerungszeit GLS-Beginn" CURVE 0x1B1D28 ZF_kl_ui8_S5_S3 2540 UMR_MSEC__10_1_0_S5_S3 0 2540
 /begin AXIS_DESCR STD_AXIS zff_atsys._.iSignale._.obj.sig_c_getr UMR_GRADC__1_1_M40_S5_S3 3 -40 150 DEPOSIT ABSOLUTE /end AXIS_DESCR
/end CHARACTERISTIC
/begin CHARACTERISTIC KL_TVGLSKABCG67 "Verzoegerungszeit GLS-Beginn" CURVE 0x1AEDFC ZF_kl_ui8_S5_S3 2540 UMR_MSEC__10_1_0_S5_S3 0 2540
 /begin AXIS_DESCR STD_AXIS zff_atsys._.iSignale._.obj.sig_c_getr UMR_GRADC__1_1_M40_S5_S3 3 -40 150 DEPOSIT ABSOLUTE /end AXIS_DESCR
/end CHARACTERISTIC
/begin CHARACTERISTIC KL_TVGLSKABCG76 "Verzoegerungszeit GLS-Beginn" CURVE 0x1B1D8C ZF_kl_ui8_S5_S3 2540 UMR_MSEC__10_1_0_S5_S3 0 2540
 /begin AXIS_DESCR STD_AXIS zff_atsys._.iSignale._.obj.sig_c_getr UMR_GRADC__1_1_M40_S5_S3 3 -40 150 DEPOSIT ABSOLUTE /end AXIS_DESCR
/end CHARACTERISTIC
/begin CHARACTERISTIC KL_TVGLSKABCG76_EL "Verzoegerungszeit GLS-Beginn" CURVE 0x1B1D98 ZF_kl_ui8_S5_S3 2540 UMR_MSEC__10_1_0_S5_S3 0 2540
 /begin AXIS_DESCR STD_AXIS zff_atsys._.iSignale._.obj.sig_c_getr UMR_GRADC__1_1_M40_S5_S3 3 -40 150 DEPOSIT ABSOLUTE /end AXIS_DESCR
/end CHARACTERISTIC
/begin CHARACTERISTIC KL_TVGLSKABCG78 "Verzoegerungszeit GLS-Beginn" CURVE 0x1AEE08 ZF_kl_ui8_S5_S3 2540 UMR_MSEC__10_1_0_S5_S3 0 2540
 /begin AXIS_DESCR STD_AXIS zff_atsys._.iSignale._.obj.sig_c_getr UMR_GRADC__1_1_M40_S5_S3 3 -40 150 DEPOSIT ABSOLUTE /end AXIS_DESCR
/end CHARACTERISTIC
/begin CHARACTERISTIC KL_TVGLSKABCG87 "Verzoegerungszeit GLS-Beginn" CURVE 0x1B1DFC ZF_kl_ui8_S5_S3 2540 UMR_MSEC__10_1_0_S5_S3 0 2540
 /begin AXIS_DESCR STD_AXIS zff_atsys._.iSignale._.obj.sig_c_getr UMR_GRADC__1_1_M40_S5_S3 3 -40 150 DEPOSIT ABSOLUTE /end AXIS_DESCR
/end CHARACTERISTIC
/begin CHARACTERISTIC KL_TVGLSKABCG87_EL "Verzoegerungszeit GLS-Beginn" CURVE 0x1B1E08 ZF_kl_ui8_S5_S3 2540 UMR_MSEC__10_1_0_S5_S3 0 2540
 /begin AXIS_DESCR STD_AXIS zff_atsys._.iSignale._.obj.sig_c_getr UMR_GRADC__1_1_M40_S5_S3 3 -40 150 DEPOSIT ABSOLUTE /end AXIS_DESCR
/end CHARACTERISTIC
/begin CHARACTERISTIC KL_TVGLSKABCGSP21 "Verzoegerungszeit GLS-Beginn" CURVE 0x1B1E40 ZF_kl_ui8_S5_S3 2540 UMR_MSEC__10_1_0_S5_S3 0 2540
 /begin AXIS_DESCR STD_AXIS zff_atsys._.iSignale._.obj.sig_c_getr UMR_GRADC__1_1_M40_S5_S3 3 -40 150 DEPOSIT ABSOLUTE /end AXIS_DESCR
/end CHARACTERISTIC
/begin CHARACTERISTIC KL_TVGLSKABCGSP31 "Verzoegerungszeit GLS-Beginn" CURVE 0x1B1FC8 ZF_kl_ui8_S5_S3 2540 UMR_MSEC__10_1_0_S5_S3 0 2540
 /begin AXIS_DESCR STD_AXIS zff_atsys._.iSignale._.obj.sig_c_getr UMR_GRADC__1_1_M40_S5_S3 3 -40 150 DEPOSIT ABSOLUTE /end AXIS_DESCR
/end CHARACTERISTIC
/begin CHARACTERISTIC KL_TVGLSKABCGSP32 "Verzoegerungszeit GLS-Beginn" CURVE 0x1B1E78 ZF_kl_ui8_S5_S3 2540 UMR_MSEC__10_1_0_S5_S3 0 2540
 /begin AXIS_DESCR STD_AXIS zff_atsys._.iSignale._.obj.sig_c_getr UMR_GRADC__1_1_M40_S5_S3 3 -40 150 DEPOSIT ABSOLUTE /end AXIS_DESCR
/end CHARACTERISTIC
/begin CHARACTERISTIC KL_TVGLSKABCGSP42 "Verzoegerungszeit GLS-Beginn" CURVE 0x1B2000 ZF_kl_ui8_S5_S3 2540 UMR_MSEC__10_1_0_S5_S3 0 2540
 /begin AXIS_DESCR STD_AXIS zff_atsys._.iSignale._.obj.sig_c_getr UMR_GRADC__1_1_M40_S5_S3 3 -40 150 DEPOSIT ABSOLUTE /end AXIS_DESCR
/end CHARACTERISTIC
/begin CHARACTERISTIC KL_TVGLSKABCGSP43 "Verzoegerungszeit GLS-Beginn" CURVE 0x1B1EB0 ZF_kl_ui8_S5_S3 2540 UMR_MSEC__10_1_0_S5_S3 0 2540
 /begin AXIS_DESCR STD_AXIS zff_atsys._.iSignale._.obj.sig_c_getr UMR_GRADC__1_1_M40_S5_S3 3 -40 150 DEPOSIT ABSOLUTE /end AXIS_DESCR
/end CHARACTERISTIC
/begin CHARACTERISTIC KL_TVGLSKABCGSP51 "Verzoegerungszeit GLS-Beginn" CURVE 0x1B2038 ZF_kl_ui8_S5_S3 2540 UMR_MSEC__10_1_0_S5_S3 0 2540
 /begin AXIS_DESCR STD_AXIS zff_atsys._.iSignale._.obj.sig_c_getr UMR_GRADC__1_1_M40_S5_S3 3 -40 150 DEPOSIT ABSOLUTE /end AXIS_DESCR
/end CHARACTERISTIC
/begin CHARACTERISTIC KL_TVGLSKABCGSP53 "Verzoegerungszeit GLS-Beginn" CURVE 0x1B2070 ZF_kl_ui8_S5_S3 2540 UMR_MSEC__10_1_0_S5_S3 0 2540
 /begin AXIS_DESCR STD_AXIS zff_atsys._.iSignale._.obj.sig_c_getr UMR_GRADC__1_1_M40_S5_S3 3 -40 150 DEPOSIT ABSOLUTE /end AXIS_DESCR
/end CHARACTERISTIC
/begin CHARACTERISTIC KL_TVGLSKABCGSP54 "Verzoegerungszeit GLS-Beginn" CURVE 0x1B1EE8 ZF_kl_ui8_S5_S3 2540 UMR_MSEC__10_1_0_S5_S3 0 2540
 /begin AXIS_DESCR STD_AXIS zff_atsys._.iSignale._.obj.sig_c_getr UMR_GRADC__1_1_M40_S5_S3 3 -40 150 DEPOSIT ABSOLUTE /end AXIS_DESCR
/end CHARACTERISTIC
/begin CHARACTERISTIC KL_TVGLSKABCGSP63 "Verzoegerungszeit GLS-Beginn" CURVE 0x1B20A8 ZF_kl_ui8_S5_S3 2540 UMR_MSEC__10_1_0_S5_S3 0 2540
 /begin AXIS_DESCR STD_AXIS zff_atsys._.iSignale._.obj.sig_c_getr UMR_GRADC__1_1_M40_S5_S3 3 -40 150 DEPOSIT ABSOLUTE /end AXIS_DESCR
/end CHARACTERISTIC
/begin CHARACTERISTIC KL_TVGLSKABCGSP64 "Verzoegerungszeit GLS-Beginn" CURVE 0x1B20E0 ZF_kl_ui8_S5_S3 2540 UMR_MSEC__10_1_0_S5_S3 0 2540
 /begin AXIS_DESCR STD_AXIS zff_atsys._.iSignale._.obj.sig_c_getr UMR_GRADC__1_1_M40_S5_S3 3 -40 150 DEPOSIT ABSOLUTE /end AXIS_DESCR
/end CHARACTERISTIC
/begin CHARACTERISTIC KL_TVGLSKABCGSP65 "Verzoegerungszeit GLS-Beginn" CURVE 0x1B1F20 ZF_kl_ui8_S5_S3 2540 UMR_MSEC__10_1_0_S5_S3 0 2540
 /begin AXIS_DESCR STD_AXIS zff_atsys._.iSignale._.obj.sig_c_getr UMR_GRADC__1_1_M40_S5_S3 3 -40 150 DEPOSIT ABSOLUTE /end AXIS_DESCR
/end CHARACTERISTIC
/begin CHARACTERISTIC KL_TVGLSKABCGSP71 "Verzoegerungszeit GLS-Beginn" CURVE 0x1B2118 ZF_kl_ui8_S5_S3 2540 UMR_MSEC__10_1_0_S5_S3 0 2540
 /begin AXIS_DESCR STD_AXIS zff_atsys._.iSignale._.obj.sig_c_getr UMR_GRADC__1_1_M40_S5_S3 3 -40 150 DEPOSIT ABSOLUTE /end AXIS_DESCR
/end CHARACTERISTIC
/begin CHARACTERISTIC KL_TVGLSKABCGSP75 "Verzoegerungszeit GLS-Beginn" CURVE 0x1B2150 ZF_kl_ui8_S5_S3 2540 UMR_MSEC__10_1_0_S5_S3 0 2540
 /begin AXIS_DESCR STD_AXIS zff_atsys._.iSignale._.obj.sig_c_getr UMR_GRADC__1_1_M40_S5_S3 3 -40 150 DEPOSIT ABSOLUTE /end AXIS_DESCR
/end CHARACTERISTIC
/begin CHARACTERISTIC KL_TVGLSKABCGSP76 "Verzoegerungszeit GLS-Beginn" CURVE 0x1B1F58 ZF_kl_ui8_S5_S3 2540 UMR_MSEC__10_1_0_S5_S3 0 2540
 /begin AXIS_DESCR STD_AXIS zff_atsys._.iSignale._.obj.sig_c_getr UMR_GRADC__1_1_M40_S5_S3 3 -40 150 DEPOSIT ABSOLUTE /end AXIS_DESCR
/end CHARACTERISTIC
/begin CHARACTERISTIC KL_TVGLSKABCGSP82 "Verzoegerungszeit GLS-Beginn" CURVE 0x1B2188 ZF_kl_ui8_S5_S3 2540 UMR_MSEC__10_1_0_S5_S3 0 2540
 /begin AXIS_DESCR STD_AXIS zff_atsys._.iSignale._.obj.sig_c_getr UMR_GRADC__1_1_M40_S5_S3 3 -40 150 DEPOSIT ABSOLUTE /end AXIS_DESCR
/end CHARACTERISTIC
/begin CHARACTERISTIC KL_TVGLSKABCGSP84 "Verzoegerungszeit GLS-Beginn" CURVE 0x1B21C0 ZF_kl_ui8_S5_S3 2540 UMR_MSEC__10_1_0_S5_S3 0 2540
 /begin AXIS_DESCR STD_AXIS zff_atsys._.iSignale._.obj.sig_c_getr UMR_GRADC__1_1_M40_S5_S3 3 -40 150 DEPOSIT ABSOLUTE /end AXIS_DESCR
/end CHARACTERISTIC
/begin CHARACTERISTIC KL_TVGLSKABCGSP86 "Verzoegerungszeit GLS-Beginn" CURVE 0x1B21F8 ZF_kl_ui8_S5_S3 2540 UMR_MSEC__10_1_0_S5_S3 0 2540
 /begin AXIS_DESCR STD_AXIS zff_atsys._.iSignale._.obj.sig_c_getr UMR_GRADC__1_1_M40_S5_S3 3 -40 150 DEPOSIT ABSOLUTE /end AXIS_DESCR
/end CHARACTERISTIC
/begin CHARACTERISTIC KL_TVGLSKABCGSP87 "Verzoegerungszeit GLS-Beginn" CURVE 0x1B1F90 ZF_kl_ui8_S5_S3 2540 UMR_MSEC__10_1_0_S5_S3 0 2540
 /begin AXIS_DESCR STD_AXIS zff_atsys._.iSignale._.obj.sig_c_getr UMR_GRADC__1_1_M40_S5_S3 3 -40 150 DEPOSIT ABSOLUTE /end AXIS_DESCR
/end CHARACTERISTIC
/begin CHARACTERISTIC KL_TVGLSKABCGSPORT21 "Verzoegerungszeit GLS-Beginn" CURVE 0x1B2230 ZF_kl_ui8_S5_S3 2540 UMR_MSEC__10_1_0_S5_S3 0 2540
 /begin AXIS_DESCR STD_AXIS zff_atsys._.iSignale._.obj.sig_c_getr UMR_GRADC__1_1_M40_S5_S3 3 -40 150 DEPOSIT ABSOLUTE /end AXIS_DESCR
/end CHARACTERISTIC
/begin CHARACTERISTIC KL_TVGLSKABCGSPORT31 "Verzoegerungszeit GLS-Beginn" CURVE 0x1B23B8 ZF_kl_ui8_S5_S3 2540 UMR_MSEC__10_1_0_S5_S3 0 2540
 /begin AXIS_DESCR STD_AXIS zff_atsys._.iSignale._.obj.sig_c_getr UMR_GRADC__1_1_M40_S5_S3 3 -40 150 DEPOSIT ABSOLUTE /end AXIS_DESCR
/end CHARACTERISTIC
/begin CHARACTERISTIC KL_TVGLSKABCGSPORT32 "Verzoegerungszeit GLS-Beginn" CURVE 0x1B2268 ZF_kl_ui8_S5_S3 2540 UMR_MSEC__10_1_0_S5_S3 0 2540
 /begin AXIS_DESCR STD_AXIS zff_atsys._.iSignale._.obj.sig_c_getr UMR_GRADC__1_1_M40_S5_S3 3 -40 150 DEPOSIT ABSOLUTE /end AXIS_DESCR
/end CHARACTERISTIC
/begin CHARACTERISTIC KL_TVGLSKABCGSPORT42 "Verzoegerungszeit GLS-Beginn" CURVE 0x1B23F0 ZF_kl_ui8_S5_S3 2540 UMR_MSEC__10_1_0_S5_S3 0 2540
 /begin AXIS_DESCR STD_AXIS zff_atsys._.iSignale._.obj.sig_c_getr UMR_GRADC__1_1_M40_S5_S3 3 -40 150 DEPOSIT ABSOLUTE /end AXIS_DESCR
/end CHARACTERISTIC
/begin CHARACTERISTIC KL_TVGLSKABCGSPORT43 "Verzoegerungszeit GLS-Beginn" CURVE 0x1B22A0 ZF_kl_ui8_S5_S3 2540 UMR_MSEC__10_1_0_S5_S3 0 2540
 /begin AXIS_DESCR STD_AXIS zff_atsys._.iSignale._.obj.sig_c_getr UMR_GRADC__1_1_M40_S5_S3 3 -40 150 DEPOSIT ABSOLUTE /end AXIS_DESCR
/end CHARACTERISTIC
/begin CHARACTERISTIC KL_TVGLSKABCGSPORT51 "Verzoegerungszeit GLS-Beginn" CURVE 0x1B2428 ZF_kl_ui8_S5_S3 2540 UMR_MSEC__10_1_0_S5_S3 0 2540
 /begin AXIS_DESCR STD_AXIS zff_atsys._.iSignale._.obj.sig_c_getr UMR_GRADC__1_1_M40_S5_S3 3 -40 150 DEPOSIT ABSOLUTE /end AXIS_DESCR
/end CHARACTERISTIC
/begin CHARACTERISTIC KL_TVGLSKABCGSPORT53 "Verzoegerungszeit GLS-Beginn" CURVE 0x1B2460 ZF_kl_ui8_S5_S3 2540 UMR_MSEC__10_1_0_S5_S3 0 2540
 /begin AXIS_DESCR STD_AXIS zff_atsys._.iSignale._.obj.sig_c_getr UMR_GRADC__1_1_M40_S5_S3 3 -40 150 DEPOSIT ABSOLUTE /end AXIS_DESCR
/end CHARACTERISTIC
/begin CHARACTERISTIC KL_TVGLSKABCGSPORT54 "Verzoegerungszeit GLS-Beginn" CURVE 0x1B22D8 ZF_kl_ui8_S5_S3 2540 UMR_MSEC__10_1_0_S5_S3 0 2540
 /begin AXIS_DESCR STD_AXIS zff_atsys._.iSignale._.obj.sig_c_getr UMR_GRADC__1_1_M40_S5_S3 3 -40 150 DEPOSIT ABSOLUTE /end AXIS_DESCR
/end CHARACTERISTIC
/begin CHARACTERISTIC KL_TVGLSKABCGSPORT63 "Verzoegerungszeit GLS-Beginn" CURVE 0x1B2498 ZF_kl_ui8_S5_S3 2540 UMR_MSEC__10_1_0_S5_S3 0 2540
 /begin AXIS_DESCR STD_AXIS zff_atsys._.iSignale._.obj.sig_c_getr UMR_GRADC__1_1_M40_S5_S3 3 -40 150 DEPOSIT ABSOLUTE /end AXIS_DESCR
/end CHARACTERISTIC
/begin CHARACTERISTIC KL_TVGLSKABCGSPORT64 "Verzoegerungszeit GLS-Beginn" CURVE 0x1B24D0 ZF_kl_ui8_S5_S3 2540 UMR_MSEC__10_1_0_S5_S3 0 2540
 /begin AXIS_DESCR STD_AXIS zff_atsys._.iSignale._.obj.sig_c_getr UMR_GRADC__1_1_M40_S5_S3 3 -40 150 DEPOSIT ABSOLUTE /end AXIS_DESCR
/end CHARACTERISTIC
/begin CHARACTERISTIC KL_TVGLSKABCGSPORT65 "Verzoegerungszeit GLS-Beginn" CURVE 0x1B2310 ZF_kl_ui8_S5_S3 2540 UMR_MSEC__10_1_0_S5_S3 0 2540
 /begin AXIS_DESCR STD_AXIS zff_atsys._.iSignale._.obj.sig_c_getr UMR_GRADC__1_1_M40_S5_S3 3 -40 150 DEPOSIT ABSOLUTE /end AXIS_DESCR
/end CHARACTERISTIC
/begin CHARACTERISTIC KL_TVGLSKABCGSPORT71 "Verzoegerungszeit GLS-Beginn" CURVE 0x1B2508 ZF_kl_ui8_S5_S3 2540 UMR_MSEC__10_1_0_S5_S3 0 2540
 /begin AXIS_DESCR STD_AXIS zff_atsys._.iSignale._.obj.sig_c_getr UMR_GRADC__1_1_M40_S5_S3 3 -40 150 DEPOSIT ABSOLUTE /end AXIS_DESCR
/end CHARACTERISTIC
/begin CHARACTERISTIC KL_TVGLSKABCGSPORT75 "Verzoegerungszeit GLS-Beginn" CURVE 0x1B2540 ZF_kl_ui8_S5_S3 2540 UMR_MSEC__10_1_0_S5_S3 0 2540
 /begin AXIS_DESCR STD_AXIS zff_atsys._.iSignale._.obj.sig_c_getr UMR_GRADC__1_1_M40_S5_S3 3 -40 150 DEPOSIT ABSOLUTE /end AXIS_DESCR
/end CHARACTERISTIC
/begin CHARACTERISTIC KL_TVGLSKABCGSPORT76 "Verzoegerungszeit GLS-Beginn" CURVE 0x1B2348 ZF_kl_ui8_S5_S3 2540 UMR_MSEC__10_1_0_S5_S3 0 2540
 /begin AXIS_DESCR STD_AXIS zff_atsys._.iSignale._.obj.sig_c_getr UMR_GRADC__1_1_M40_S5_S3 3 -40 150 DEPOSIT ABSOLUTE /end AXIS_DESCR
/end CHARACTERISTIC
/begin CHARACTERISTIC KL_TVGLSKABCGSPORT82 "Verzoegerungszeit GLS-Beginn" CURVE 0x1B2578 ZF_kl_ui8_S5_S3 2540 UMR_MSEC__10_1_0_S5_S3 0 2540
 /begin AXIS_DESCR STD_AXIS zff_atsys._.iSignale._.obj.sig_c_getr UMR_GRADC__1_1_M40_S5_S3 3 -40 150 DEPOSIT ABSOLUTE /end AXIS_DESCR
/end CHARACTERISTIC
/begin CHARACTERISTIC KL_TVGLSKABCGSPORT84 "Verzoegerungszeit GLS-Beginn" CURVE 0x1B25B0 ZF_kl_ui8_S5_S3 2540 UMR_MSEC__10_1_0_S5_S3 0 2540
 /begin AXIS_DESCR STD_AXIS zff_atsys._.iSignale._.obj.sig_c_getr UMR_GRADC__1_1_M40_S5_S3 3 -40 150 DEPOSIT ABSOLUTE /end AXIS_DESCR
/end CHARACTERISTIC
/begin CHARACTERISTIC KL_TVGLSKABCGSPORT86 "Verzoegerungszeit GLS-Beginn" CURVE 0x1B25E8 ZF_kl_ui8_S5_S3 2540 UMR_MSEC__10_1_0_S5_S3 0 2540
 /begin AXIS_DESCR STD_AXIS zff_atsys._.iSignale._.obj.sig_c_getr UMR_GRADC__1_1_M40_S5_S3 3 -40 150 DEPOSIT ABSOLUTE /end AXIS_DESCR
/end CHARACTERISTIC
/begin CHARACTERISTIC KL_TVGLSKABCGSPORT87 "Verzoegerungszeit GLS-Beginn" CURVE 0x1B2380 ZF_kl_ui8_S5_S3 2540 UMR_MSEC__10_1_0_S5_S3 0 2540
 /begin AXIS_DESCR STD_AXIS zff_atsys._.iSignale._.obj.sig_c_getr UMR_GRADC__1_1_M40_S5_S3 3 -40 150 DEPOSIT ABSOLUTE /end AXIS_DESCR
/end CHARACTERISTIC
/begin CHARACTERISTIC KL_TVGLSKZUCG12 "Verzoegerungszeit GLS-Beginn" CURVE 0x1B13E8 ZF_kl_ui8_S5_S3 2540 UMR_MSEC__10_1_0_S5_S3 0 2540
 /begin AXIS_DESCR STD_AXIS zff_atsys._.iSignale._.obj.sig_c_getr UMR_GRADC__1_1_M40_S5_S3 3 -40 150 DEPOSIT ABSOLUTE /end AXIS_DESCR
/end CHARACTERISTIC
/begin CHARACTERISTIC KL_TVGLSKZUCG12_EL "Verzoegerungszeit GLS-Beginn" CURVE 0x1B13F4 ZF_kl_ui8_S5_S3 2540 UMR_MSEC__10_1_0_S5_S3 0 2540
 /begin AXIS_DESCR STD_AXIS zff_atsys._.iSignale._.obj.sig_c_getr UMR_GRADC__1_1_M40_S5_S3 3 -40 150 DEPOSIT ABSOLUTE /end AXIS_DESCR
/end CHARACTERISTIC
/begin CHARACTERISTIC KL_TVGLSKZUCG21 "Verzoegerungszeit GLS-Beginn" CURVE 0x1B25F4 ZF_kl_ui8_S5_S3 2540 UMR_MSEC__10_1_0_S5_S3 0 2540
 /begin AXIS_DESCR STD_AXIS zff_atsys._.iSignale._.obj.sig_c_getr UMR_GRADC__1_1_M40_S5_S3 3 -40 150 DEPOSIT ABSOLUTE /end AXIS_DESCR
/end CHARACTERISTIC
/begin CHARACTERISTIC KL_TVGLSKZUCG23 "Verzoegerungszeit GLS-Beginn" CURVE 0x1B1464 ZF_kl_ui8_S5_S3 2540 UMR_MSEC__10_1_0_S5_S3 0 2540
 /begin AXIS_DESCR STD_AXIS zff_atsys._.iSignale._.obj.sig_c_getr UMR_GRADC__1_1_M40_S5_S3 3 -40 150 DEPOSIT ABSOLUTE /end AXIS_DESCR
/end CHARACTERISTIC
/begin CHARACTERISTIC KL_TVGLSKZUCG23_EL "Verzoegerungszeit GLS-Beginn" CURVE 0x1B1470 ZF_kl_ui8_S5_S3 2540 UMR_MSEC__10_1_0_S5_S3 0 2540
 /begin AXIS_DESCR STD_AXIS zff_atsys._.iSignale._.obj.sig_c_getr UMR_GRADC__1_1_M40_S5_S3 3 -40 150 DEPOSIT ABSOLUTE /end AXIS_DESCR
/end CHARACTERISTIC
/begin CHARACTERISTIC KL_TVGLSKZUCG34 "Verzoegerungszeit GLS-Beginn" CURVE 0x1B14E0 ZF_kl_ui8_S5_S3 2540 UMR_MSEC__10_1_0_S5_S3 0 2540
 /begin AXIS_DESCR STD_AXIS zff_atsys._.iSignale._.obj.sig_c_getr UMR_GRADC__1_1_M40_S5_S3 3 -40 150 DEPOSIT ABSOLUTE /end AXIS_DESCR
/end CHARACTERISTIC
/begin CHARACTERISTIC KL_TVGLSKZUCG34_EL "Verzoegerungszeit GLS-Beginn" CURVE 0x1B14EC ZF_kl_ui8_S5_S3 2540 UMR_MSEC__10_1_0_S5_S3 0 2540
 /begin AXIS_DESCR STD_AXIS zff_atsys._.iSignale._.obj.sig_c_getr UMR_GRADC__1_1_M40_S5_S3 3 -40 150 DEPOSIT ABSOLUTE /end AXIS_DESCR
/end CHARACTERISTIC
/begin CHARACTERISTIC KL_TVGLSKZUCG45 "Verzoegerungszeit GLS-Beginn" CURVE 0x1B155C ZF_kl_ui8_S5_S3 2540 UMR_MSEC__10_1_0_S5_S3 0 2540
 /begin AXIS_DESCR STD_AXIS zff_atsys._.iSignale._.obj.sig_c_getr UMR_GRADC__1_1_M40_S5_S3 3 -40 150 DEPOSIT ABSOLUTE /end AXIS_DESCR
/end CHARACTERISTIC
/begin CHARACTERISTIC KL_TVGLSKZUCG45_EL "Verzoegerungszeit GLS-Beginn" CURVE 0x1B1568 ZF_kl_ui8_S5_S3 2540 UMR_MSEC__10_1_0_S5_S3 0 2540
 /begin AXIS_DESCR STD_AXIS zff_atsys._.iSignale._.obj.sig_c_getr UMR_GRADC__1_1_M40_S5_S3 3 -40 150 DEPOSIT ABSOLUTE /end AXIS_DESCR
/end CHARACTERISTIC
/begin CHARACTERISTIC KL_TVGLSKZUCG56 "Verzoegerungszeit GLS-Beginn" CURVE 0x1B15D8 ZF_kl_ui8_S5_S3 2540 UMR_MSEC__10_1_0_S5_S3 0 2540
 /begin AXIS_DESCR STD_AXIS zff_atsys._.iSignale._.obj.sig_c_getr UMR_GRADC__1_1_M40_S5_S3 3 -40 150 DEPOSIT ABSOLUTE /end AXIS_DESCR
/end CHARACTERISTIC
/begin CHARACTERISTIC KL_TVGLSKZUCG56_EL "Verzoegerungszeit GLS-Beginn" CURVE 0x1B15E4 ZF_kl_ui8_S5_S3 2540 UMR_MSEC__10_1_0_S5_S3 0 2540
 /begin AXIS_DESCR STD_AXIS zff_atsys._.iSignale._.obj.sig_c_getr UMR_GRADC__1_1_M40_S5_S3 3 -40 150 DEPOSIT ABSOLUTE /end AXIS_DESCR
/end CHARACTERISTIC
/begin CHARACTERISTIC KL_TVGLSKZUCG67 "Verzoegerungszeit GLS-Beginn" CURVE 0x1B1654 ZF_kl_ui8_S5_S3 2540 UMR_MSEC__10_1_0_S5_S3 0 2540
 /begin AXIS_DESCR STD_AXIS zff_atsys._.iSignale._.obj.sig_c_getr UMR_GRADC__1_1_M40_S5_S3 3 -40 150 DEPOSIT ABSOLUTE /end AXIS_DESCR
/end CHARACTERISTIC
/begin CHARACTERISTIC KL_TVGLSKZUCG67_EL "Verzoegerungszeit GLS-Beginn" CURVE 0x1B1660 ZF_kl_ui8_S5_S3 2540 UMR_MSEC__10_1_0_S5_S3 0 2540
 /begin AXIS_DESCR STD_AXIS zff_atsys._.iSignale._.obj.sig_c_getr UMR_GRADC__1_1_M40_S5_S3 3 -40 150 DEPOSIT ABSOLUTE /end AXIS_DESCR
/end CHARACTERISTIC
/begin CHARACTERISTIC KL_TVGLSKZUCG78 "Verzoegerungszeit GLS-Beginn" CURVE 0x1B16D0 ZF_kl_ui8_S5_S3 2540 UMR_MSEC__10_1_0_S5_S3 0 2540
 /begin AXIS_DESCR STD_AXIS zff_atsys._.iSignale._.obj.sig_c_getr UMR_GRADC__1_1_M40_S5_S3 3 -40 150 DEPOSIT ABSOLUTE /end AXIS_DESCR
/end CHARACTERISTIC
/begin CHARACTERISTIC KL_TVGLSKZUCG78_EL "Verzoegerungszeit GLS-Beginn" CURVE 0x1B16DC ZF_kl_ui8_S5_S3 2540 UMR_MSEC__10_1_0_S5_S3 0 2540
 /begin AXIS_DESCR STD_AXIS zff_atsys._.iSignale._.obj.sig_c_getr UMR_GRADC__1_1_M40_S5_S3 3 -40 150 DEPOSIT ABSOLUTE /end AXIS_DESCR
/end CHARACTERISTIC
/begin CHARACTERISTIC KL_TVGLSKZUCGSP12 "Verzoegerungszeit GLS-Beginn" CURVE 0x1B174C ZF_kl_ui8_S5_S3 2540 UMR_MSEC__10_1_0_S5_S3 0 2540
 /begin AXIS_DESCR STD_AXIS zff_atsys._.iSignale._.obj.sig_c_getr UMR_GRADC__1_1_M40_S5_S3 3 -40 150 DEPOSIT ABSOLUTE /end AXIS_DESCR
/end CHARACTERISTIC
/begin CHARACTERISTIC KL_TVGLSKZUCGSP23 "Verzoegerungszeit GLS-Beginn" CURVE 0x1B1790 ZF_kl_ui8_S5_S3 2540 UMR_MSEC__10_1_0_S5_S3 0 2540
 /begin AXIS_DESCR STD_AXIS zff_atsys._.iSignale._.obj.sig_c_getr UMR_GRADC__1_1_M40_S5_S3 3 -40 150 DEPOSIT ABSOLUTE /end AXIS_DESCR
/end CHARACTERISTIC
/begin CHARACTERISTIC KL_TVGLSKZUCGSP31 "Verzoegerungszeit GLS-Beginn" CURVE 0x1B2648 ZF_kl_ui8_S5_S3 2540 UMR_MSEC__10_1_0_S5_S3 0 2540
 /begin AXIS_DESCR STD_AXIS zff_atsys._.iSignale._.obj.sig_c_getr UMR_GRADC__1_1_M40_S5_S3 3 -40 150 DEPOSIT ABSOLUTE /end AXIS_DESCR
/end CHARACTERISTIC
/begin CHARACTERISTIC KL_TVGLSKZUCGSP34 "Verzoegerungszeit GLS-Beginn" CURVE 0x1B17D4 ZF_kl_ui8_S5_S3 2540 UMR_MSEC__10_1_0_S5_S3 0 2540
 /begin AXIS_DESCR STD_AXIS zff_atsys._.iSignale._.obj.sig_c_getr UMR_GRADC__1_1_M40_S5_S3 3 -40 150 DEPOSIT ABSOLUTE /end AXIS_DESCR
/end CHARACTERISTIC
/begin CHARACTERISTIC KL_TVGLSKZUCGSP45 "Verzoegerungszeit GLS-Beginn" CURVE 0x1B1818 ZF_kl_ui8_S5_S3 2540 UMR_MSEC__10_1_0_S5_S3 0 2540
 /begin AXIS_DESCR STD_AXIS zff_atsys._.iSignale._.obj.sig_c_getr UMR_GRADC__1_1_M40_S5_S3 3 -40 150 DEPOSIT ABSOLUTE /end AXIS_DESCR
/end CHARACTERISTIC
/begin CHARACTERISTIC KL_TVGLSKZUCGSP56 "Verzoegerungszeit GLS-Beginn" CURVE 0x1B185C ZF_kl_ui8_S5_S3 2540 UMR_MSEC__10_1_0_S5_S3 0 2540
 /begin AXIS_DESCR STD_AXIS zff_atsys._.iSignale._.obj.sig_c_getr UMR_GRADC__1_1_M40_S5_S3 3 -40 150 DEPOSIT ABSOLUTE /end AXIS_DESCR
/end CHARACTERISTIC
/begin CHARACTERISTIC KL_TVGLSKZUCGSP67 "Verzoegerungszeit GLS-Beginn" CURVE 0x1B18A0 ZF_kl_ui8_S5_S3 2540 UMR_MSEC__10_1_0_S5_S3 0 2540
 /begin AXIS_DESCR STD_AXIS zff_atsys._.iSignale._.obj.sig_c_getr UMR_GRADC__1_1_M40_S5_S3 3 -40 150 DEPOSIT ABSOLUTE /end AXIS_DESCR
/end CHARACTERISTIC
/begin CHARACTERISTIC KL_TVGLSKZUCGSP78 "Verzoegerungszeit GLS-Beginn" CURVE 0x1B18E4 ZF_kl_ui8_S5_S3 2540 UMR_MSEC__10_1_0_S5_S3 0 2540
 /begin AXIS_DESCR STD_AXIS zff_atsys._.iSignale._.obj.sig_c_getr UMR_GRADC__1_1_M40_S5_S3 3 -40 150 DEPOSIT ABSOLUTE /end AXIS_DESCR
/end CHARACTERISTIC
/begin CHARACTERISTIC KL_TVGLSKZUCGSPORT12 "Verzoegerungszeit GLS-Beginn" CURVE 0x1B1928 ZF_kl_ui8_S5_S3 2540 UMR_MSEC__10_1_0_S5_S3 0 2540
 /begin AXIS_DESCR STD_AXIS zff_atsys._.iSignale._.obj.sig_c_getr UMR_GRADC__1_1_M40_S5_S3 3 -40 150 DEPOSIT ABSOLUTE /end AXIS_DESCR
/end CHARACTERISTIC
/begin CHARACTERISTIC KL_TVGLSKZUCGSPORT23 "Verzoegerungszeit GLS-Beginn" CURVE 0x1B196C ZF_kl_ui8_S5_S3 2540 UMR_MSEC__10_1_0_S5_S3 0 2540
 /begin AXIS_DESCR STD_AXIS zff_atsys._.iSignale._.obj.sig_c_getr UMR_GRADC__1_1_M40_S5_S3 3 -40 150 DEPOSIT ABSOLUTE /end AXIS_DESCR
/end CHARACTERISTIC
/begin CHARACTERISTIC KL_TVGLSKZUCGSPORT34 "Verzoegerungszeit GLS-Beginn" CURVE 0x1B19B0 ZF_kl_ui8_S5_S3 2540 UMR_MSEC__10_1_0_S5_S3 0 2540
 /begin AXIS_DESCR STD_AXIS zff_atsys._.iSignale._.obj.sig_c_getr UMR_GRADC__1_1_M40_S5_S3 3 -40 150 DEPOSIT ABSOLUTE /end AXIS_DESCR
/end CHARACTERISTIC
/begin CHARACTERISTIC KL_TVGLSKZUCGSPORT45 "Verzoegerungszeit GLS-Beginn" CURVE 0x1B19F4 ZF_kl_ui8_S5_S3 2540 UMR_MSEC__10_1_0_S5_S3 0 2540
 /begin AXIS_DESCR STD_AXIS zff_atsys._.iSignale._.obj.sig_c_getr UMR_GRADC__1_1_M40_S5_S3 3 -40 150 DEPOSIT ABSOLUTE /end AXIS_DESCR
/end CHARACTERISTIC
/begin CHARACTERISTIC KL_TVGLSKZUCGSPORT56 "Verzoegerungszeit GLS-Beginn" CURVE 0x1B1A38 ZF_kl_ui8_S5_S3 2540 UMR_MSEC__10_1_0_S5_S3 0 2540
 /begin AXIS_DESCR STD_AXIS zff_atsys._.iSignale._.obj.sig_c_getr UMR_GRADC__1_1_M40_S5_S3 3 -40 150 DEPOSIT ABSOLUTE /end AXIS_DESCR
/end CHARACTERISTIC
/begin CHARACTERISTIC KL_TVGLSKZUCGSPORT67 "Verzoegerungszeit GLS-Beginn" CURVE 0x1B1A7C ZF_kl_ui8_S5_S3 2540 UMR_MSEC__10_1_0_S5_S3 0 2540
 /begin AXIS_DESCR STD_AXIS zff_atsys._.iSignale._.obj.sig_c_getr UMR_GRADC__1_1_M40_S5_S3 3 -40 150 DEPOSIT ABSOLUTE /end AXIS_DESCR
/end CHARACTERISTIC
/begin CHARACTERISTIC KL_TVGLSKZUCGSPORT78 "Verzoegerungszeit GLS-Beginn" CURVE 0x1B1AC0 ZF_kl_ui8_S5_S3 2540 UMR_MSEC__10_1_0_S5_S3 0 2540
 /begin AXIS_DESCR STD_AXIS zff_atsys._.iSignale._.obj.sig_c_getr UMR_GRADC__1_1_M40_S5_S3 3 -40 150 DEPOSIT ABSOLUTE /end AXIS_DESCR
/end CHARACTERISTIC
/begin CHARACTERISTIC KP_GLSKAB12 "Proportionalfaktor PID-Regler GLS" VALUE 0x1D8596 ZF_kw_ui16_S5_S3 10000 UMR_MBARMINSEC__1_1_0_S5_S3 0 10000 /end CHARACTERISTIC
/begin CHARACTERISTIC KP_GLSKAB12_EL "Proportionalfaktor PID-Regler GLS" VALUE 0x1D8598 ZF_kw_ui16_S5_S3 10000 UMR_MBARMINSEC__1_1_0_S5_S3 0 10000 /end CHARACTERISTIC
/begin CHARACTERISTIC KP_GLSKAB21 "Proportionalfaktor PID-Regler GLS" VALUE 0x1D87D8 ZF_kw_ui16_S5_S3 10000 UMR_MBARMINSEC__1_1_0_S5_S3 0 10000 /end CHARACTERISTIC
/begin CHARACTERISTIC KP_GLSKAB21_EL "Proportionalfaktor PID-Regler GLS" VALUE 0x1D87DA ZF_kw_ui16_S5_S3 10000 UMR_MBARMINSEC__1_1_0_S5_S3 0 10000 /end CHARACTERISTIC
/begin CHARACTERISTIC KP_GLSKAB23 "Proportionalfaktor PID-Regler GLS" VALUE 0x1D85BC ZF_kw_ui16_S5_S3 10000 UMR_MBARMINSEC__1_1_0_S5_S3 0 10000 /end CHARACTERISTIC
/begin CHARACTERISTIC KP_GLSKAB23_EL "Proportionalfaktor PID-Regler GLS" VALUE 0x1D85BE ZF_kw_ui16_S5_S3 10000 UMR_MBARMINSEC__1_1_0_S5_S3 0 10000 /end CHARACTERISTIC
/begin CHARACTERISTIC KP_GLSKAB34 "Proportionalfaktor PID-Regler GLS" VALUE 0x1D85E2 ZF_kw_ui16_S5_S3 10000 UMR_MBARMINSEC__1_1_0_S5_S3 0 10000 /end CHARACTERISTIC
/begin CHARACTERISTIC KP_GLSKAB34_EL "Proportionalfaktor PID-Regler GLS" VALUE 0x1D85E4 ZF_kw_ui16_S5_S3 10000 UMR_MBARMINSEC__1_1_0_S5_S3 0 10000 /end CHARACTERISTIC
/begin CHARACTERISTIC KP_GLSKAB45 "Proportionalfaktor PID-Regler GLS" VALUE 0x1D8608 ZF_kw_ui16_S5_S3 10000 UMR_MBARMINSEC__1_1_0_S5_S3 0 10000 /end CHARACTERISTIC
/begin CHARACTERISTIC KP_GLSKAB45_EL "Proportionalfaktor PID-Regler GLS" VALUE 0x1D860A ZF_kw_ui16_S5_S3 10000 UMR_MBARMINSEC__1_1_0_S5_S3 0 10000 /end CHARACTERISTIC
/begin CHARACTERISTIC KP_GLSKAB56 "Proportionalfaktor PID-Regler GLS" VALUE 0x1D862E ZF_kw_ui16_S5_S3 10000 UMR_MBARMINSEC__1_1_0_S5_S3 0 10000 /end CHARACTERISTIC
/begin CHARACTERISTIC KP_GLSKAB56_EL "Proportionalfaktor PID-Regler GLS" VALUE 0x1D8630 ZF_kw_ui16_S5_S3 10000 UMR_MBARMINSEC__1_1_0_S5_S3 0 10000 /end CHARACTERISTIC
/begin CHARACTERISTIC KP_GLSKAB67 "Proportionalfaktor PID-Regler GLS" VALUE 0x1D8654 ZF_kw_ui16_S5_S3 10000 UMR_MBARMINSEC__1_1_0_S5_S3 0 10000 /end CHARACTERISTIC
/begin CHARACTERISTIC KP_GLSKAB67_EL "Proportionalfaktor PID-Regler GLS" VALUE 0x1D8656 ZF_kw_ui16_S5_S3 10000 UMR_MBARMINSEC__1_1_0_S5_S3 0 10000 /end CHARACTERISTIC
/begin CHARACTERISTIC KP_GLSKAB78 "Proportionalfaktor PID-Regler GLS" VALUE 0x1D867A ZF_kw_ui16_S5_S3 10000 UMR_MBARMINSEC__1_1_0_S5_S3 0 10000 /end CHARACTERISTIC
/begin CHARACTERISTIC KP_GLSKAB78_EL "Proportionalfaktor PID-Regler GLS" VALUE 0x1D867C ZF_kw_ui16_S5_S3 10000 UMR_MBARMINSEC__1_1_0_S5_S3 0 10000 /end CHARACTERISTIC
/begin CHARACTERISTIC KP_GLSKABSP31 "Proportionalfaktor PID-Regler GLS" VALUE 0x1D88D4 ZF_kw_ui16_S5_S3 10000 UMR_MBARMINSEC__1_1_0_S5_S3 0 10000 /end CHARACTERISTIC
/begin CHARACTERISTIC KP_GLSKABSP31_EL "Proportionalfaktor PID-Regler GLS" VALUE 0x1D88D6 ZF_kw_ui16_S5_S3 10000 UMR_MBARMINSEC__1_1_0_S5_S3 0 10000 /end CHARACTERISTIC
/begin CHARACTERISTIC KP_GLSKZU12 "Proportionalfaktor PID-Regler GLS" VALUE 0x1D857A ZF_kw_ui16_S5_S3 10000 UMR_MBARMINSEC__1_1_0_S5_S3 0 10000 /end CHARACTERISTIC
/begin CHARACTERISTIC KP_GLSKZU12_EL "Proportionalfaktor PID-Regler GLS" VALUE 0x1D857C ZF_kw_ui16_S5_S3 10000 UMR_MBARMINSEC__1_1_0_S5_S3 0 10000 /end CHARACTERISTIC
/begin CHARACTERISTIC KP_GLSKZU21 "P-Faktor PID-Regler GLS" VALUE 0x1D87C0 ZF_kw_ui16_S5_S3 10000 UMR_MBARMINSEC__1_1_0_S5_S3 0 10000 /end CHARACTERISTIC
/begin CHARACTERISTIC KP_GLSKZU21_EL "P-Faktor PID-Regler GLS" VALUE 0x1D87C2 ZF_kw_ui16_S5_S3 10000 UMR_MBARMINSEC__1_1_0_S5_S3 0 10000 /end CHARACTERISTIC
/begin CHARACTERISTIC KP_GLSKZU23 "Proportionalfaktor PID-Regler GLS" VALUE 0x1D85A0 ZF_kw_ui16_S5_S3 10000 UMR_MBARMINSEC__1_1_0_S5_S3 0 10000 /end CHARACTERISTIC
/begin CHARACTERISTIC KP_GLSKZU23_EL "Proportionalfaktor PID-Regler GLS" VALUE 0x1D85A2 ZF_kw_ui16_S5_S3 10000 UMR_MBARMINSEC__1_1_0_S5_S3 0 10000 /end CHARACTERISTIC
/begin CHARACTERISTIC KP_GLSKZU34 "Proportionalfaktor PID-Regler GLS" VALUE 0x1D85C6 ZF_kw_ui16_S5_S3 10000 UMR_MBARMINSEC__1_1_0_S5_S3 0 10000 /end CHARACTERISTIC
/begin CHARACTERISTIC KP_GLSKZU34_EL "Proportionalfaktor PID-Regler GLS" VALUE 0x1D85C8 ZF_kw_ui16_S5_S3 10000 UMR_MBARMINSEC__1_1_0_S5_S3 0 10000 /end CHARACTERISTIC
/begin CHARACTERISTIC KP_GLSKZU45 "Proportionalfaktor PID-Regler GLS" VALUE 0x1D85EC ZF_kw_ui16_S5_S3 10000 UMR_MBARMINSEC__1_1_0_S5_S3 0 10000 /end CHARACTERISTIC
/begin CHARACTERISTIC KP_GLSKZU45_EL "Proportionalfaktor PID-Regler GLS" VALUE 0x1D85EE ZF_kw_ui16_S5_S3 10000 UMR_MBARMINSEC__1_1_0_S5_S3 0 10000 /end CHARACTERISTIC
/begin CHARACTERISTIC KP_GLSKZU56 "Proportionalfaktor PID-Regler GLS" VALUE 0x1D8612 ZF_kw_ui16_S5_S3 10000 UMR_MBARMINSEC__1_1_0_S5_S3 0 10000 /end CHARACTERISTIC
/begin CHARACTERISTIC KP_GLSKZU56_EL "Proportionalfaktor PID-Regler GLS" VALUE 0x1D8614 ZF_kw_ui16_S5_S3 10000 UMR_MBARMINSEC__1_1_0_S5_S3 0 10000 /end CHARACTERISTIC
/begin CHARACTERISTIC KP_GLSKZU67 "Proportionalfaktor PID-Regler GLS" VALUE 0x1D8638 ZF_kw_ui16_S5_S3 10000 UMR_MBARMINSEC__1_1_0_S5_S3 0 10000 /end CHARACTERISTIC
/begin CHARACTERISTIC KP_GLSKZU67_EL "Proportionalfaktor PID-Regler GLS" VALUE 0x1D863A ZF_kw_ui16_S5_S3 10000 UMR_MBARMINSEC__1_1_0_S5_S3 0 10000 /end CHARACTERISTIC
/begin CHARACTERISTIC KP_GLSKZU78 "Proportionalfaktor PID-Regler GLS" VALUE 0x1D865E ZF_kw_ui16_S5_S3 10000 UMR_MBARMINSEC__1_1_0_S5_S3 0 10000 /end CHARACTERISTIC
/begin CHARACTERISTIC KP_GLSKZU78_EL "Proportionalfaktor PID-Regler GLS" VALUE 0x1D8660 ZF_kw_ui16_S5_S3 10000 UMR_MBARMINSEC__1_1_0_S5_S3 0 10000 /end CHARACTERISTIC
/begin CHARACTERISTIC KP_GLSKZUSP31 "P-Faktor PID-Regler GLS" VALUE 0x1D88BC ZF_kw_ui16_S5_S3 10000 UMR_MBARMINSEC__1_1_0_S5_S3 0 10000 /end CHARACTERISTIC
/begin CHARACTERISTIC KP_GLSKZUSP31_EL "P-Faktor PID-Regler GLS" VALUE 0x1D88BE ZF_kw_ui16_S5_S3 10000 UMR_MBARMINSEC__1_1_0_S5_S3 0 10000 /end CHARACTERISTIC
/begin CHARACTERISTIC K_WNGGRGLSPKAB12 "Korrekturfaktor, wenn gemessene Schleifzeit zu gross (oberhalb der Toleranz) bei Regelung KAB" VALUE 0x1D8586 ZF_kw_ui16_S5_S3 65530 UMR_U_MINSEC2_1_1_0_S5_S3 0 65530 /end CHARACTERISTIC
/begin CHARACTERISTIC K_WNGGRGLSPKAB12_EL "Korrekturfaktor, wenn gemessene Schleifzeit zu gross (oberhalb der Toleranz) bei Regelung KAB" VALUE 0x1D8588 ZF_kw_ui16_S5_S3 65530 UMR_U_MINSEC2_1_1_0_S5_S3 0 65530 /end CHARACTERISTIC
/begin CHARACTERISTIC K_WNGGRGLSPKAB21 "Korrekturfaktor, wenn gemessene Schleifzeit zu gross (oberhalb der Toleranz) bei Regelung KAB" VALUE 0x1D87C8 ZF_kw_ui16_S5_S3 65530 UMR_U_MINSEC2_1_1_0_S5_S3 0 65530 /end CHARACTERISTIC
/begin CHARACTERISTIC K_WNGGRGLSPKAB21_EL "Korrekturfaktor, wenn gemessene Schleifzeit zu gross (oberhalb der Toleranz) bei Regelung KAB" VALUE 0x1D87CA ZF_kw_ui16_S5_S3 65530 UMR_U_MINSEC2_1_1_0_S5_S3 0 65530 /end CHARACTERISTIC
/begin CHARACTERISTIC K_WNGGRGLSPKAB23 "Korrekturfaktor, wenn gemessene Schleifzeit zu gross (oberhalb der Toleranz) bei Regelung KAB" VALUE 0x1D85AC ZF_kw_ui16_S5_S3 65530 UMR_U_MINSEC2_1_1_0_S5_S3 0 65530 /end CHARACTERISTIC
/begin CHARACTERISTIC K_WNGGRGLSPKAB23_EL "Korrekturfaktor, wenn gemessene Schleifzeit zu gross (oberhalb der Toleranz) bei Regelung KAB" VALUE 0x1D85AE ZF_kw_ui16_S5_S3 65530 UMR_U_MINSEC2_1_1_0_S5_S3 0 65530 /end CHARACTERISTIC
/begin CHARACTERISTIC K_WNGGRGLSPKAB34 "Korrekturfaktor, wenn gemessene Schleifzeit zu gross (oberhalb der Toleranz) bei Regelung KAB" VALUE 0x1D85D2 ZF_kw_ui16_S5_S3 65530 UMR_U_MINSEC2_1_1_0_S5_S3 0 65530 /end CHARACTERISTIC
/begin CHARACTERISTIC K_WNGGRGLSPKAB34_EL "Korrekturfaktor, wenn gemessene Schleifzeit zu gross (oberhalb der Toleranz) bei Regelung KAB" VALUE 0x1D85D4 ZF_kw_ui16_S5_S3 65530 UMR_U_MINSEC2_1_1_0_S5_S3 0 65530 /end CHARACTERISTIC
/begin CHARACTERISTIC K_WNGGRGLSPKAB45 "Korrekturfaktor, wenn gemessene Schleifzeit zu gross (oberhalb der Toleranz) bei Regelung KAB" VALUE 0x1D85F8 ZF_kw_ui16_S5_S3 65530 UMR_U_MINSEC2_1_1_0_S5_S3 0 65530 /end CHARACTERISTIC
/begin CHARACTERISTIC K_WNGGRGLSPKAB45_EL "Korrekturfaktor, wenn gemessene Schleifzeit zu gross (oberhalb der Toleranz) bei Regelung KAB" VALUE 0x1D85FA ZF_kw_ui16_S5_S3 65530 UMR_U_MINSEC2_1_1_0_S5_S3 0 65530 /end CHARACTERISTIC
/begin CHARACTERISTIC K_WNGGRGLSPKAB56 "Korrekturfaktor, wenn gemessene Schleifzeit zu gross (oberhalb der Toleranz) bei Regelung KAB" VALUE 0x1D861E ZF_kw_ui16_S5_S3 65530 UMR_U_MINSEC2_1_1_0_S5_S3 0 65530 /end CHARACTERISTIC
/begin CHARACTERISTIC K_WNGGRGLSPKAB56_EL "Korrekturfaktor, wenn gemessene Schleifzeit zu gross (oberhalb der Toleranz) bei Regelung KAB" VALUE 0x1D8620 ZF_kw_ui16_S5_S3 65530 UMR_U_MINSEC2_1_1_0_S5_S3 0 65530 /end CHARACTERISTIC
/begin CHARACTERISTIC K_WNGGRGLSPKAB67 "Korrekturfaktor, wenn gemessene Schleifzeit zu gross (oberhalb der Toleranz) bei Regelung KAB" VALUE 0x1D8644 ZF_kw_ui16_S5_S3 65530 UMR_U_MINSEC2_1_1_0_S5_S3 0 65530 /end CHARACTERISTIC
/begin CHARACTERISTIC K_WNGGRGLSPKAB67_EL "Korrekturfaktor, wenn gemessene Schleifzeit zu gross (oberhalb der Toleranz) bei Regelung KAB" VALUE 0x1D8646 ZF_kw_ui16_S5_S3 65530 UMR_U_MINSEC2_1_1_0_S5_S3 0 65530 /end CHARACTERISTIC
/begin CHARACTERISTIC K_WNGGRGLSPKAB78 "Korrekturfaktor, wenn gemessene Schleifzeit zu gross (oberhalb der Toleranz) bei Regelung KAB" VALUE 0x1D866A ZF_kw_ui16_S5_S3 65530 UMR_U_MINSEC2_1_1_0_S5_S3 0 65530 /end CHARACTERISTIC
/begin CHARACTERISTIC K_WNGGRGLSPKAB78_EL "Korrekturfaktor, wenn gemessene Schleifzeit zu gross (oberhalb der Toleranz) bei Regelung KAB" VALUE 0x1D866C ZF_kw_ui16_S5_S3 65530 UMR_U_MINSEC2_1_1_0_S5_S3 0 65530 /end CHARACTERISTIC
/begin CHARACTERISTIC K_WNGGRGLSPKABSP31 "Korrekturfaktor, wenn gemessene Schleifzeit zu gross (oberhalb der Toleranz) bei Regelung KAB" VALUE 0x1D88C4 ZF_kw_ui16_S5_S3 65530 UMR_U_MINSEC2_1_1_0_S5_S3 0 65530 /end CHARACTERISTIC
/begin CHARACTERISTIC K_WNGGRGLSPKABSP31_EL "Korrekturfaktor, wenn gemessene Schleifzeit zu gross (oberhalb der Toleranz) bei Regelung KAB" VALUE 0x1D88C6 ZF_kw_ui16_S5_S3 65530 UMR_U_MINSEC2_1_1_0_S5_S3 0 65530 /end CHARACTERISTIC
/begin CHARACTERISTIC K_WNGGRGLSPKZU12 "Korrekturfaktor, wenn gemessene Schleifzeit zu gross (oberhalb der Toleranz) bei Regelung KZU" VALUE 0x1D8582 ZF_kw_ui16_S5_S3 65530 UMR_U_MINSEC2_1_1_0_S5_S3 0 65530 /end CHARACTERISTIC
/begin CHARACTERISTIC K_WNGGRGLSPKZU12_EL "Korrekturfaktor, wenn gemessene Schleifzeit zu gross (oberhalb der Toleranz) bei Regelung KZU" VALUE 0x1D8584 ZF_kw_ui16_S5_S3 65530 UMR_U_MINSEC2_1_1_0_S5_S3 0 65530 /end CHARACTERISTIC
/begin CHARACTERISTIC K_WNGGRGLSPKZU21 "Korrekturfaktor, wenn gemessene Schleifzeit zu gross (oberhalb der Toleranz) bei Regelung KZU" VALUE 0x1D87C4 ZF_kw_ui16_S5_S3 65530 UMR_U_MINSEC2_1_1_0_S5_S3 0 65530 /end CHARACTERISTIC
/begin CHARACTERISTIC K_WNGGRGLSPKZU21_EL "Korrekturfaktor, wenn gemessene Schleifzeit zu gross (oberhalb der Toleranz) bei Regelung KZU" VALUE 0x1D87C6 ZF_kw_ui16_S5_S3 65530 UMR_U_MINSEC2_1_1_0_S5_S3 0 65530 /end CHARACTERISTIC
/begin CHARACTERISTIC K_WNGGRGLSPKZU23 "Korrekturfaktor, wenn gemessene Schleifzeit zu gross (oberhalb der Toleranz) bei Regelung KZU" VALUE 0x1D85A8 ZF_kw_ui16_S5_S3 65530 UMR_U_MINSEC2_1_1_0_S5_S3 0 65530 /end CHARACTERISTIC
/begin CHARACTERISTIC K_WNGGRGLSPKZU23_EL "Korrekturfaktor, wenn gemessene Schleifzeit zu gross (oberhalb der Toleranz) bei Regelung KZU" VALUE 0x1D85AA ZF_kw_ui16_S5_S3 65530 UMR_U_MINSEC2_1_1_0_S5_S3 0 65530 /end CHARACTERISTIC
/begin CHARACTERISTIC K_WNGGRGLSPKZU34 "Korrekturfaktor, wenn gemessene Schleifzeit zu gross (oberhalb der Toleranz) bei Regelung KZU" VALUE 0x1D85CE ZF_kw_ui16_S5_S3 65530 UMR_U_MINSEC2_1_1_0_S5_S3 0 65530 /end CHARACTERISTIC
/begin CHARACTERISTIC K_WNGGRGLSPKZU34_EL "Korrekturfaktor, wenn gemessene Schleifzeit zu gross (oberhalb der Toleranz) bei Regelung KZU" VALUE 0x1D85D0 ZF_kw_ui16_S5_S3 65530 UMR_U_MINSEC2_1_1_0_S5_S3 0 65530 /end CHARACTERISTIC
/begin CHARACTERISTIC K_WNGGRGLSPKZU45 "Korrekturfaktor, wenn gemessene Schleifzeit zu gross (oberhalb der Toleranz) bei Regelung KZU" VALUE 0x1D85F4 ZF_kw_ui16_S5_S3 65530 UMR_U_MINSEC2_1_1_0_S5_S3 0 65530 /end CHARACTERISTIC
/begin CHARACTERISTIC K_WNGGRGLSPKZU45_EL "Korrekturfaktor, wenn gemessene Schleifzeit zu gross (oberhalb der Toleranz) bei Regelung KZU" VALUE 0x1D85F6 ZF_kw_ui16_S5_S3 65530 UMR_U_MINSEC2_1_1_0_S5_S3 0 65530 /end CHARACTERISTIC
/begin CHARACTERISTIC K_WNGGRGLSPKZU56 "Korrekturfaktor, wenn gemessene Schleifzeit zu gross (oberhalb der Toleranz) bei Regelung KZU" VALUE 0x1D861A ZF_kw_ui16_S5_S3 65530 UMR_U_MINSEC2_1_1_0_S5_S3 0 65530 /end CHARACTERISTIC
/begin CHARACTERISTIC K_WNGGRGLSPKZU56_EL "Korrekturfaktor, wenn gemessene Schleifzeit zu gross (oberhalb der Toleranz) bei Regelung KZU" VALUE 0x1D861C ZF_kw_ui16_S5_S3 65530 UMR_U_MINSEC2_1_1_0_S5_S3 0 65530 /end CHARACTERISTIC
/begin CHARACTERISTIC K_WNGGRGLSPKZU67 "Korrekturfaktor, wenn gemessene Schleifzeit zu gross (oberhalb der Toleranz) bei Regelung KZU" VALUE 0x1D8640 ZF_kw_ui16_S5_S3 65530 UMR_U_MINSEC2_1_1_0_S5_S3 0 65530 /end CHARACTERISTIC
/begin CHARACTERISTIC K_WNGGRGLSPKZU67_EL "Korrekturfaktor, wenn gemessene Schleifzeit zu gross (oberhalb der Toleranz) bei Regelung KZU" VALUE 0x1D8642 ZF_kw_ui16_S5_S3 65530 UMR_U_MINSEC2_1_1_0_S5_S3 0 65530 /end CHARACTERISTIC
/begin CHARACTERISTIC K_WNGGRGLSPKZU78 "Korrekturfaktor, wenn gemessene Schleifzeit zu gross (oberhalb der Toleranz) bei Regelung KZU" VALUE 0x1D8666 ZF_kw_ui16_S5_S3 65530 UMR_U_MINSEC2_1_1_0_S5_S3 0 65530 /end CHARACTERISTIC
/begin CHARACTERISTIC K_WNGGRGLSPKZU78_EL "Korrekturfaktor, wenn gemessene Schleifzeit zu gross (oberhalb der Toleranz) bei Regelung KZU" VALUE 0x1D8668 ZF_kw_ui16_S5_S3 65530 UMR_U_MINSEC2_1_1_0_S5_S3 0 65530 /end CHARACTERISTIC
/begin CHARACTERISTIC K_WNGGRGLSPKZUSP31 "Korrekturfaktor, wenn gemessene Schleifzeit zu gross (oberhalb der Toleranz) bei Regelung KZU" VALUE 0x1D88C0 ZF_kw_ui16_S5_S3 65530 UMR_U_MINSEC2_1_1_0_S5_S3 0 65530 /end CHARACTERISTIC
/begin CHARACTERISTIC K_WNGGRGLSPKZUSP31_EL "Korrekturfaktor, wenn gemessene Schleifzeit zu gross (oberhalb der Toleranz) bei Regelung KZU" VALUE 0x1D88C2 ZF_kw_ui16_S5_S3 65530 UMR_U_MINSEC2_1_1_0_S5_S3 0 65530 /end CHARACTERISTIC
/begin CHARACTERISTIC K_WNGKLGLSPKAB12 "Korrekturfaktor, wenn gemessene Schleifzeit zu klein (unterhalb der Toleranz) bei Regelung KAB" VALUE 0x1D858E ZF_kw_ui16_S5_S3 65530 UMR_U_MINSEC2_1_1_0_S5_S3 0 65530 /end CHARACTERISTIC
/begin CHARACTERISTIC K_WNGKLGLSPKAB12_EL "Korrekturfaktor, wenn gemessene Schleifzeit zu klein (unterhalb der Toleranz) bei Regelung KAB" VALUE 0x1D8590 ZF_kw_ui16_S5_S3 65530 UMR_U_MINSEC2_1_1_0_S5_S3 0 65530 /end CHARACTERISTIC
/begin CHARACTERISTIC K_WNGKLGLSPKAB21 "Korrekturfaktor, wenn gemessene Schleifzeit zu klein (unterhalb der Toleranz) bei Regelung KAB" VALUE 0x1D87D0 ZF_kw_ui16_S5_S3 65530 UMR_U_MINSEC2_1_1_0_S5_S3 0 65530 /end CHARACTERISTIC
/begin CHARACTERISTIC K_WNGKLGLSPKAB21_EL "Korrekturfaktor, wenn gemessene Schleifzeit zu klein (unterhalb der Toleranz) bei Regelung KAB" VALUE 0x1D87D2 ZF_kw_ui16_S5_S3 65530 UMR_U_MINSEC2_1_1_0_S5_S3 0 65530 /end CHARACTERISTIC
/begin CHARACTERISTIC K_WNGKLGLSPKAB23 "Korrekturfaktor, wenn gemessene Schleifzeit zu klein (unterhalb der Toleranz) bei Regelung KAB" VALUE 0x1D85B4 ZF_kw_ui16_S5_S3 65530 UMR_U_MINSEC2_1_1_0_S5_S3 0 65530 /end CHARACTERISTIC
/begin CHARACTERISTIC K_WNGKLGLSPKAB23_EL "Korrekturfaktor, wenn gemessene Schleifzeit zu klein (unterhalb der Toleranz) bei Regelung KAB" VALUE 0x1D85B6 ZF_kw_ui16_S5_S3 65530 UMR_U_MINSEC2_1_1_0_S5_S3 0 65530 /end CHARACTERISTIC
/begin CHARACTERISTIC K_WNGKLGLSPKAB34 "Korrekturfaktor, wenn gemessene Schleifzeit zu klein (unterhalb der Toleranz) bei Regelung KAB" VALUE 0x1D85DA ZF_kw_ui16_S5_S3 65530 UMR_U_MINSEC2_1_1_0_S5_S3 0 65530 /end CHARACTERISTIC
/begin CHARACTERISTIC K_WNGKLGLSPKAB34_EL "Korrekturfaktor, wenn gemessene Schleifzeit zu klein (unterhalb der Toleranz) bei Regelung KAB" VALUE 0x1D85DC ZF_kw_ui16_S5_S3 65530 UMR_U_MINSEC2_1_1_0_S5_S3 0 65530 /end CHARACTERISTIC
/begin CHARACTERISTIC K_WNGKLGLSPKAB45 "Korrekturfaktor, wenn gemessene Schleifzeit zu klein (unterhalb der Toleranz) bei Regelung KAB" VALUE 0x1D8600 ZF_kw_ui16_S5_S3 65530 UMR_U_MINSEC2_1_1_0_S5_S3 0 65530 /end CHARACTERISTIC
/begin CHARACTERISTIC K_WNGKLGLSPKAB45_EL "Korrekturfaktor, wenn gemessene Schleifzeit zu klein (unterhalb der Toleranz) bei Regelung KAB" VALUE 0x1D8602 ZF_kw_ui16_S5_S3 65530 UMR_U_MINSEC2_1_1_0_S5_S3 0 65530 /end CHARACTERISTIC
/begin CHARACTERISTIC K_WNGKLGLSPKAB56 "Korrekturfaktor, wenn gemessene Schleifzeit zu klein (unterhalb der Toleranz) bei Regelung KAB" VALUE 0x1D8626 ZF_kw_ui16_S5_S3 65530 UMR_U_MINSEC2_1_1_0_S5_S3 0 65530 /end CHARACTERISTIC
/begin CHARACTERISTIC K_WNGKLGLSPKAB56_EL "Korrekturfaktor, wenn gemessene Schleifzeit zu klein (unterhalb der Toleranz) bei Regelung KAB" VALUE 0x1D8628 ZF_kw_ui16_S5_S3 65530 UMR_U_MINSEC2_1_1_0_S5_S3 0 65530 /end CHARACTERISTIC
/begin CHARACTERISTIC K_WNGKLGLSPKAB67 "Korrekturfaktor, wenn gemessene Schleifzeit zu klein (unterhalb der Toleranz) bei Regelung KAB" VALUE 0x1D864C ZF_kw_ui16_S5_S3 65530 UMR_U_MINSEC2_1_1_0_S5_S3 0 65530 /end CHARACTERISTIC
/begin CHARACTERISTIC K_WNGKLGLSPKAB67_EL "Korrekturfaktor, wenn gemessene Schleifzeit zu klein (unterhalb der Toleranz) bei Regelung KAB" VALUE 0x1D864E ZF_kw_ui16_S5_S3 65530 UMR_U_MINSEC2_1_1_0_S5_S3 0 65530 /end CHARACTERISTIC
/begin CHARACTERISTIC K_WNGKLGLSPKAB78 "Korrekturfaktor, wenn gemessene Schleifzeit zu klein (unterhalb der Toleranz) bei Regelung KAB" VALUE 0x1D8672 ZF_kw_ui16_S5_S3 65530 UMR_U_MINSEC2_1_1_0_S5_S3 0 65530 /end CHARACTERISTIC
/begin CHARACTERISTIC K_WNGKLGLSPKAB78_EL "Korrekturfaktor, wenn gemessene Schleifzeit zu klein (unterhalb der Toleranz) bei Regelung KAB" VALUE 0x1D8674 ZF_kw_ui16_S5_S3 65530 UMR_U_MINSEC2_1_1_0_S5_S3 0 65530 /end CHARACTERISTIC
/begin CHARACTERISTIC K_WNGKLGLSPKABSP31 "Korrekturfaktor, wenn gemessene Schleifzeit zu klein (unterhalb der Toleranz) bei Regelung KAB" VALUE 0x1D88CC ZF_kw_ui16_S5_S3 65530 UMR_U_MINSEC2_1_1_0_S5_S3 0 65530 /end CHARACTERISTIC
/begin CHARACTERISTIC K_WNGKLGLSPKABSP31_EL "Korrekturfaktor, wenn gemessene Schleifzeit zu klein (unterhalb der Toleranz) bei Regelung KAB" VALUE 0x1D88CE ZF_kw_ui16_S5_S3 65530 UMR_U_MINSEC2_1_1_0_S5_S3 0 65530 /end CHARACTERISTIC
/begin CHARACTERISTIC K_WNGKLGLSPKZU12 "Korrekturfaktor, wenn gemessene Schleifzeit zu klein (unterhalb der Toleranz) bei Regelung KZU" VALUE 0x1D858A ZF_kw_ui16_S5_S3 65530 UMR_U_MINSEC2_1_1_0_S5_S3 0 65530 /end CHARACTERISTIC
/begin CHARACTERISTIC K_WNGKLGLSPKZU12_EL "Korrekturfaktor, wenn gemessene Schleifzeit zu klein (unterhalb der Toleranz) bei Regelung KZU" VALUE 0x1D858C ZF_kw_ui16_S5_S3 65530 UMR_U_MINSEC2_1_1_0_S5_S3 0 65530 /end CHARACTERISTIC
/begin CHARACTERISTIC K_WNGKLGLSPKZU21 "Korrekturfaktor, wenn gemessene Schleifzeit zu klein (unterhalb der Toleranz) bei Regelung KZU" VALUE 0x1D87CC ZF_kw_ui16_S5_S3 65530 UMR_U_MINSEC2_1_1_0_S5_S3 0 65530 /end CHARACTERISTIC
/begin CHARACTERISTIC K_WNGKLGLSPKZU21_EL "Korrekturfaktor, wenn gemessene Schleifzeit zu klein (unterhalb der Toleranz) bei Regelung KZU" VALUE 0x1D87CE ZF_kw_ui16_S5_S3 65530 UMR_U_MINSEC2_1_1_0_S5_S3 0 65530 /end CHARACTERISTIC
/begin CHARACTERISTIC K_WNGKLGLSPKZU23 "Korrekturfaktor, wenn gemessene Schleifzeit zu klein (unterhalb der Toleranz) bei Regelung KZU" VALUE 0x1D85B0 ZF_kw_ui16_S5_S3 65530 UMR_U_MINSEC2_1_1_0_S5_S3 0 65530 /end CHARACTERISTIC
/begin CHARACTERISTIC K_WNGKLGLSPKZU23_EL "Korrekturfaktor, wenn gemessene Schleifzeit zu klein (unterhalb der Toleranz) bei Regelung KZU" VALUE 0x1D85B2 ZF_kw_ui16_S5_S3 65530 UMR_U_MINSEC2_1_1_0_S5_S3 0 65530 /end CHARACTERISTIC
/begin CHARACTERISTIC K_WNGKLGLSPKZU34 "Korrekturfaktor, wenn gemessene Schleifzeit zu klein (unterhalb der Toleranz) bei Regelung KZU" VALUE 0x1D85D6 ZF_kw_ui16_S5_S3 65530 UMR_U_MINSEC2_1_1_0_S5_S3 0 65530 /end CHARACTERISTIC
/begin CHARACTERISTIC K_WNGKLGLSPKZU34_EL "Korrekturfaktor, wenn gemessene Schleifzeit zu klein (unterhalb der Toleranz) bei Regelung KZU" VALUE 0x1D85D8 ZF_kw_ui16_S5_S3 65530 UMR_U_MINSEC2_1_1_0_S5_S3 0 65530 /end CHARACTERISTIC
/begin CHARACTERISTIC K_WNGKLGLSPKZU45 "Korrekturfaktor, wenn gemessene Schleifzeit zu klein (unterhalb der Toleranz) bei Regelung KZU" VALUE 0x1D85FC ZF_kw_ui16_S5_S3 65530 UMR_U_MINSEC2_1_1_0_S5_S3 0 65530 /end CHARACTERISTIC
/begin CHARACTERISTIC K_WNGKLGLSPKZU45_EL "Korrekturfaktor, wenn gemessene Schleifzeit zu klein (unterhalb der Toleranz) bei Regelung KZU" VALUE 0x1D85FE ZF_kw_ui16_S5_S3 65530 UMR_U_MINSEC2_1_1_0_S5_S3 0 65530 /end CHARACTERISTIC
/begin CHARACTERISTIC K_WNGKLGLSPKZU56 "Korrekturfaktor, wenn gemessene Schleifzeit zu klein (unterhalb der Toleranz) bei Regelung KZU" VALUE 0x1D8622 ZF_kw_ui16_S5_S3 65530 UMR_U_MINSEC2_1_1_0_S5_S3 0 65530 /end CHARACTERISTIC
/begin CHARACTERISTIC K_WNGKLGLSPKZU56_EL "Korrekturfaktor, wenn gemessene Schleifzeit zu klein (unterhalb der Toleranz) bei Regelung KZU" VALUE 0x1D8624 ZF_kw_ui16_S5_S3 65530 UMR_U_MINSEC2_1_1_0_S5_S3 0 65530 /end CHARACTERISTIC
/begin CHARACTERISTIC K_WNGKLGLSPKZU67 "Korrekturfaktor, wenn gemessene Schleifzeit zu klein (unterhalb der Toleranz) bei Regelung KZU" VALUE 0x1D8648 ZF_kw_ui16_S5_S3 65530 UMR_U_MINSEC2_1_1_0_S5_S3 0 65530 /end CHARACTERISTIC
/begin CHARACTERISTIC K_WNGKLGLSPKZU67_EL "Korrekturfaktor, wenn gemessene Schleifzeit zu klein (unterhalb der Toleranz) bei Regelung KZU" VALUE 0x1D864A ZF_kw_ui16_S5_S3 65530 UMR_U_MINSEC2_1_1_0_S5_S3 0 65530 /end CHARACTERISTIC
/begin CHARACTERISTIC K_WNGKLGLSPKZU78 "Korrekturfaktor, wenn gemessene Schleifzeit zu klein (unterhalb der Toleranz) bei Regelung KZU" VALUE 0x1D866E ZF_kw_ui16_S5_S3 65530 UMR_U_MINSEC2_1_1_0_S5_S3 0 65530 /end CHARACTERISTIC
/begin CHARACTERISTIC K_WNGKLGLSPKZU78_EL "Korrekturfaktor, wenn gemessene Schleifzeit zu klein (unterhalb der Toleranz) bei Regelung KZU" VALUE 0x1D8670 ZF_kw_ui16_S5_S3 65530 UMR_U_MINSEC2_1_1_0_S5_S3 0 65530 /end CHARACTERISTIC
/begin CHARACTERISTIC K_WNGKLGLSPKZUSP31 "Korrekturfaktor, wenn gemessene Schleifzeit zu klein (unterhalb der Toleranz) bei Regelung KZU" VALUE 0x1D88C8 ZF_kw_ui16_S5_S3 65530 UMR_U_MINSEC2_1_1_0_S5_S3 0 65530 /end CHARACTERISTIC
/begin CHARACTERISTIC K_WNGKLGLSPKZUSP31_EL "Korrekturfaktor, wenn gemessene Schleifzeit zu klein (unterhalb der Toleranz) bei Regelung KZU" VALUE 0x1D88CA ZF_kw_ui16_S5_S3 65530 UMR_U_MINSEC2_1_1_0_S5_S3 0 65530 /end CHARACTERISTIC
/begin CHARACTERISTIC ND_GLSGE_1 "Drehzahlkriterium Start Regelung Gangeinlegen" VALUE 0x1D87AA ZF_kw_ui16_S5_S3 8000 UMR_U_MIN_1_1_0_S5_S3 0 8000 /end CHARACTERISTIC
/begin CHARACTERISTIC ND_GLSGE_2 "Drehzahlkriterium Start Regelung Gangeinlegen" VALUE 0x1D87AC ZF_kw_ui16_S5_S3 8000 UMR_U_MIN_1_1_0_S5_S3 0 8000 /end CHARACTERISTIC
/begin CHARACTERISTIC ND_GLSGE_3 "Drehzahlkriterium Start Regelung Gangeinlegen" VALUE 0x1D87AE ZF_kw_ui16_S5_S3 8000 UMR_U_MIN_1_1_0_S5_S3 0 8000 /end CHARACTERISTIC
/begin CHARACTERISTIC ND_GLSGE_4 "Drehzahlkriterium Start Regelung Gangeinlegen" VALUE 0x1D87B0 ZF_kw_ui16_S5_S3 8000 UMR_U_MIN_1_1_0_S5_S3 0 8000 /end CHARACTERISTIC
/begin CHARACTERISTIC ND_GLSGE_5 "Drehzahlkriterium Start Regelung Gangeinlegen" VALUE 0x1D87B2 ZF_kw_ui16_S5_S3 8000 UMR_U_MIN_1_1_0_S5_S3 0 8000 /end CHARACTERISTIC
/begin CHARACTERISTIC ND_GLSGE_6 "Drehzahlkriterium Start Regelung Gangeinlegen" VALUE 0x1D87B4 ZF_kw_ui16_S5_S3 8000 UMR_U_MIN_1_1_0_S5_S3 0 8000 /end CHARACTERISTIC
/begin CHARACTERISTIC ND_GLSGE_7 "Drehzahlkriterium Start Regelung Gangeinlegen" VALUE 0x1D87B6 ZF_kw_ui16_S5_S3 8000 UMR_U_MIN_1_1_0_S5_S3 0 8000 /end CHARACTERISTIC
/begin CHARACTERISTIC ND_GLSGE_8 "Drehzahlkriterium Start Regelung Gangeinlegen" VALUE 0x1D87B8 ZF_kw_ui16_S5_S3 8000 UMR_U_MIN_1_1_0_S5_S3 0 8000 /end CHARACTERISTIC
/begin CHARACTERISTIC ND_GLSGE_R "Drehzahlkriterium Start Regelung Gangeinlegen" VALUE 0x1D87A8 ZF_kw_ui16_S5_S3 8000 UMR_U_MIN_1_1_0_S5_S3 0 8000 /end CHARACTERISTIC
/begin CHARACTERISTIC ND_GLSNEGHS12 "Drehzahlschwelle negativ für den Start der GLS bei HS" VALUE 0x1D8578 ZF_kw_si16_S5_S3 8000 UMR_U_MIN_1_1_0_S5_S3 -8000 0 /end CHARACTERISTIC
/begin CHARACTERISTIC ND_GLSNEGHS23 "Drehzahlschwelle negativ für den Start der GLS bei HS" VALUE 0x1D859E ZF_kw_si16_S5_S3 8000 UMR_U_MIN_1_1_0_S5_S3 -8000 0 /end CHARACTERISTIC
/begin CHARACTERISTIC ND_GLSNEGHS34 "Drehzahlschwelle negativ für den Start der GLS bei HS" VALUE 0x1D85C4 ZF_kw_si16_S5_S3 8000 UMR_U_MIN_1_1_0_S5_S3 -8000 0 /end CHARACTERISTIC
/begin CHARACTERISTIC ND_GLSNEGHS45 "Drehzahlschwelle negativ für den Start der GLS bei HS" VALUE 0x1D85EA ZF_kw_si16_S5_S3 8000 UMR_U_MIN_1_1_0_S5_S3 -8000 0 /end CHARACTERISTIC
/begin CHARACTERISTIC ND_GLSNEGHS56 "Drehzahlschwelle negativ für den Start der GLS bei HS" VALUE 0x1D8610 ZF_kw_si16_S5_S3 8000 UMR_U_MIN_1_1_0_S5_S3 -8000 0 /end CHARACTERISTIC
/begin CHARACTERISTIC ND_GLSNEGHS67 "Drehzahlschwelle negativ für den Start der GLS bei HS" VALUE 0x1D8636 ZF_kw_si16_S5_S3 8000 UMR_U_MIN_1_1_0_S5_S3 -8000 0 /end CHARACTERISTIC
/begin CHARACTERISTIC ND_GLSNEGHS78 "Drehzahlschwelle negativ für den Start der GLS bei HS" VALUE 0x1D865C ZF_kw_si16_S5_S3 8000 UMR_U_MIN_1_1_0_S5_S3 -8000 0 /end CHARACTERISTIC
/begin CHARACTERISTIC ND_GLSPOSHS12 "Drehzahlschwelle positiv für den Start der GLS bei HS" VALUE 0x1D8576 ZF_kw_si16_S5_S3 8000 UMR_U_MIN_1_1_0_S5_S3 0 8000 /end CHARACTERISTIC
/begin CHARACTERISTIC ND_GLSPOSHS23 "Drehzahlschwelle positiv für den Start der GLS bei HS" VALUE 0x1D859C ZF_kw_si16_S5_S3 8000 UMR_U_MIN_1_1_0_S5_S3 0 8000 /end CHARACTERISTIC
/begin CHARACTERISTIC ND_GLSPOSHS34 "Drehzahlschwelle positiv für den Start der GLS bei HS" VALUE 0x1D85C2 ZF_kw_si16_S5_S3 8000 UMR_U_MIN_1_1_0_S5_S3 0 8000 /end CHARACTERISTIC
/begin CHARACTERISTIC ND_GLSPOSHS45 "Drehzahlschwelle positiv für den Start der GLS bei HS" VALUE 0x1D85E8 ZF_kw_si16_S5_S3 8000 UMR_U_MIN_1_1_0_S5_S3 0 8000 /end CHARACTERISTIC
/begin CHARACTERISTIC ND_GLSPOSHS56 "Drehzahlschwelle positiv für den Start der GLS bei HS" VALUE 0x1D860E ZF_kw_si16_S5_S3 8000 UMR_U_MIN_1_1_0_S5_S3 0 8000 /end CHARACTERISTIC
/begin CHARACTERISTIC ND_GLSPOSHS67 "Drehzahlschwelle positiv für den Start der GLS bei HS" VALUE 0x1D8634 ZF_kw_si16_S5_S3 8000 UMR_U_MIN_1_1_0_S5_S3 0 8000 /end CHARACTERISTIC
/begin CHARACTERISTIC ND_GLSPOSHS78 "Drehzahlschwelle positiv für den Start der GLS bei HS" VALUE 0x1D865A ZF_kw_si16_S5_S3 8000 UMR_U_MIN_1_1_0_S5_S3 0 8000 /end CHARACTERISTIC
/begin CHARACTERISTIC ND_GLSRS21 "Drehzahlkriterium Start Regelung bei RS" VALUE 0x1D87BA ZF_kw_ui16_S5_S3 8000 UMR_U_MIN_1_1_0_S5_S3 0 8000 /end CHARACTERISTIC
/begin CHARACTERISTIC ND_GLSRSSP31 "Drehzahlkriterium Start Regelung bei RS" VALUE 0x1D88B6 ZF_kw_ui16_S5_S3 8000 UMR_U_MIN_1_1_0_S5_S3 0 8000 /end CHARACTERISTIC
/begin CHARACTERISTIC NGS_VERIAE21 "Abtriebsdrehzahlgradientenschwelle für ausführen der verschachtelten Schaltung mit IAE" VALUE 0x1D8712 ZF_kw_si16_S5_S3 20000 UMR_U_MINSEC_1_1_0_S5_S3 -10000 10000 /end CHARACTERISTIC
/begin CHARACTERISTIC NGS_VERIAE32 "Abtriebsdrehzahlgradientenschwelle für ausführen der verschachtelten Schaltung mit IAE" VALUE 0x1D871A ZF_kw_si16_S5_S3 20000 UMR_U_MINSEC_1_1_0_S5_S3 -10000 10000 /end CHARACTERISTIC
/begin CHARACTERISTIC NGS_VERIAE43 "Abtriebsdrehzahlgradientenschwelle für ausführen der verschachtelten Schaltung mit IAE" VALUE 0x1D8722 ZF_kw_si16_S5_S3 20000 UMR_U_MINSEC_1_1_0_S5_S3 -10000 10000 /end CHARACTERISTIC
/begin CHARACTERISTIC NGS_VERIAE54 "Abtriebsdrehzahlgradientenschwelle für ausführen der verschachtelten Schaltung mit IAE" VALUE 0x1D872A ZF_kw_si16_S5_S3 20000 UMR_U_MINSEC_1_1_0_S5_S3 -10000 10000 /end CHARACTERISTIC
/begin CHARACTERISTIC NGS_VERIAE65 "Abtriebsdrehzahlgradientenschwelle für ausführen der verschachtelten Schaltung mit IAE" VALUE 0x1D8732 ZF_kw_si16_S5_S3 20000 UMR_U_MINSEC_1_1_0_S5_S3 -10000 10000 /end CHARACTERISTIC
/begin CHARACTERISTIC NGS_VERIAE76 "Abtriebsdrehzahlgradientenschwelle für ausführen der verschachtelten Schaltung mit IAE" VALUE 0x1D873A ZF_kw_si16_S5_S3 20000 UMR_U_MINSEC_1_1_0_S5_S3 -10000 10000 /end CHARACTERISTIC
/begin CHARACTERISTIC NGS_VERIAE87 "Abtriebsdrehzahlgradientenschwelle für ausführen der verschachtelten Schaltung mit IAE" VALUE 0x1D8742 ZF_kw_si16_S5_S3 20000 UMR_U_MINSEC_1_1_0_S5_S3 -10000 10000 /end CHARACTERISTIC
/begin CHARACTERISTIC NGS_VERIAESP31 "Abtriebsdrehzahlgradientenschwelle für ausführen der verschachtelten Schaltung mit IAE" VALUE 0x1D874A ZF_kw_si16_S5_S3 20000 UMR_U_MINSEC_1_1_0_S5_S3 -10000 10000 /end CHARACTERISTIC
/begin CHARACTERISTIC NGS_VERIAESP42 "Abtriebsdrehzahlgradientenschwelle für ausführen der verschachtelten Schaltung mit IAE" VALUE 0x1D8752 ZF_kw_si16_S5_S3 20000 UMR_U_MINSEC_1_1_0_S5_S3 -10000 10000 /end CHARACTERISTIC
/begin CHARACTERISTIC NGS_VERIAESP51 "Abtriebsdrehzahlgradientenschwelle für ausführen der verschachtelten Schaltung mit IAE" VALUE 0x1D875A ZF_kw_si16_S5_S3 20000 UMR_U_MINSEC_1_1_0_S5_S3 -10000 10000 /end CHARACTERISTIC
/begin CHARACTERISTIC NGS_VERIAESP53 "Abtriebsdrehzahlgradientenschwelle für ausführen der verschachtelten Schaltung mit IAE" VALUE 0x1D8762 ZF_kw_si16_S5_S3 20000 UMR_U_MINSEC_1_1_0_S5_S3 -10000 10000 /end CHARACTERISTIC
/begin CHARACTERISTIC NGS_VERIAESP63 "Abtriebsdrehzahlgradientenschwelle für ausführen der verschachtelten Schaltung mit IAE" VALUE 0x1D876A ZF_kw_si16_S5_S3 20000 UMR_U_MINSEC_1_1_0_S5_S3 -10000 10000 /end CHARACTERISTIC
/begin CHARACTERISTIC NGS_VERIAESP64 "Abtriebsdrehzahlgradientenschwelle für ausführen der verschachtelten Schaltung mit IAE" VALUE 0x1D8772 ZF_kw_si16_S5_S3 20000 UMR_U_MINSEC_1_1_0_S5_S3 -10000 10000 /end CHARACTERISTIC
/begin CHARACTERISTIC NGS_VERIAESP71 "Abtriebsdrehzahlgradientenschwelle für ausführen der verschachtelten Schaltung mit IAE" VALUE 0x1D877A ZF_kw_si16_S5_S3 20000 UMR_U_MINSEC_1_1_0_S5_S3 -10000 10000 /end CHARACTERISTIC
/begin CHARACTERISTIC NGS_VERIAESP75 "Abtriebsdrehzahlgradientenschwelle für ausführen der verschachtelten Schaltung mit IAE" VALUE 0x1D8782 ZF_kw_si16_S5_S3 20000 UMR_U_MINSEC_1_1_0_S5_S3 -10000 10000 /end CHARACTERISTIC
/begin CHARACTERISTIC NGS_VERIAESP82 "Abtriebsdrehzahlgradientenschwelle für ausführen der verschachtelten Schaltung mit IAE" VALUE 0x1D878A ZF_kw_si16_S5_S3 20000 UMR_U_MINSEC_1_1_0_S5_S3 -10000 10000 /end CHARACTERISTIC
/begin CHARACTERISTIC NGS_VERIAESP84 "Abtriebsdrehzahlgradientenschwelle für ausführen der verschachtelten Schaltung mit IAE" VALUE 0x1D8792 ZF_kw_si16_S5_S3 20000 UMR_U_MINSEC_1_1_0_S5_S3 -10000 10000 /end CHARACTERISTIC
/begin CHARACTERISTIC NGS_VERIAESP86 "Abtriebsdrehzahlgradientenschwelle für ausführen der verschachtelten Schaltung mit IAE" VALUE 0x1D879A ZF_kw_si16_S5_S3 20000 UMR_U_MINSEC_1_1_0_S5_S3 -10000 10000 /end CHARACTERISTIC
/begin CHARACTERISTIC NS_SYNISTE21 "Turbinendifferenzdrehzahlschwelle zur Erkennung Synchron istgang verlassen" VALUE 0x1D870E ZF_kw_si16_S5_S3 1000 UMR_U_MIN_1_1_0_S5_S3 0 1000 /end CHARACTERISTIC
/begin CHARACTERISTIC NS_SYNISTE32 "Turbinendifferenzdrehzahlschwelle zur Erkennung Synchron istgang verlassen" VALUE 0x1D8716 ZF_kw_si16_S5_S3 1000 UMR_U_MIN_1_1_0_S5_S3 0 1000 /end CHARACTERISTIC
/begin CHARACTERISTIC NS_SYNISTE43 "Turbinendifferenzdrehzahlschwelle zur Erkennung Synchron istgang verlassen" VALUE 0x1D871E ZF_kw_si16_S5_S3 1000 UMR_U_MIN_1_1_0_S5_S3 0 1000 /end CHARACTERISTIC
/begin CHARACTERISTIC NS_SYNISTE54 "Turbinendifferenzdrehzahlschwelle zur Erkennung Synchron istgang verlassen" VALUE 0x1D8726 ZF_kw_si16_S5_S3 1000 UMR_U_MIN_1_1_0_S5_S3 0 1000 /end CHARACTERISTIC
/begin CHARACTERISTIC NS_SYNISTE65 "Turbinendifferenzdrehzahlschwelle zur Erkennung Synchron istgang verlassen" VALUE 0x1D872E ZF_kw_si16_S5_S3 1000 UMR_U_MIN_1_1_0_S5_S3 0 1000 /end CHARACTERISTIC
/begin CHARACTERISTIC NS_SYNISTE76 "Turbinendifferenzdrehzahlschwelle zur Erkennung Synchron istgang verlassen" VALUE 0x1D8736 ZF_kw_si16_S5_S3 1000 UMR_U_MIN_1_1_0_S5_S3 0 1000 /end CHARACTERISTIC
/begin CHARACTERISTIC NS_SYNISTE87 "Turbinendifferenzdrehzahlschwelle zur Erkennung Synchron istgang verlassen" VALUE 0x1D873E ZF_kw_si16_S5_S3 1000 UMR_U_MIN_1_1_0_S5_S3 0 1000 /end CHARACTERISTIC
/begin CHARACTERISTIC NS_SYNISTESP31 "Turbinendifferenzdrehzahlschwelle zur Erkennung Synchron istgang verlassen" VALUE 0x1D8746 ZF_kw_si16_S5_S3 1000 UMR_U_MIN_1_1_0_S5_S3 0 1000 /end CHARACTERISTIC
/begin CHARACTERISTIC NS_SYNISTESP42 "Turbinendifferenzdrehzahlschwelle zur Erkennung Synchron istgang verlassen" VALUE 0x1D874E ZF_kw_si16_S5_S3 1000 UMR_U_MIN_1_1_0_S5_S3 0 1000 /end CHARACTERISTIC
/begin CHARACTERISTIC NS_SYNISTESP51 "Turbinendifferenzdrehzahlschwelle zur Erkennung Synchron istgang verlassen" VALUE 0x1D8756 ZF_kw_si16_S5_S3 1000 UMR_U_MIN_1_1_0_S5_S3 0 1000 /end CHARACTERISTIC
/begin CHARACTERISTIC NS_SYNISTESP53 "Turbinendifferenzdrehzahlschwelle zur Erkennung Synchron istgang verlassen" VALUE 0x1D875E ZF_kw_si16_S5_S3 1000 UMR_U_MIN_1_1_0_S5_S3 0 1000 /end CHARACTERISTIC
/begin CHARACTERISTIC NS_SYNISTESP63 "Turbinendifferenzdrehzahlschwelle zur Erkennung Synchron istgang verlassen" VALUE 0x1D8766 ZF_kw_si16_S5_S3 1000 UMR_U_MIN_1_1_0_S5_S3 0 1000 /end CHARACTERISTIC
/begin CHARACTERISTIC NS_SYNISTESP64 "Turbinendifferenzdrehzahlschwelle zur Erkennung Synchron istgang verlassen" VALUE 0x1D876E ZF_kw_si16_S5_S3 1000 UMR_U_MIN_1_1_0_S5_S3 0 1000 /end CHARACTERISTIC
/begin CHARACTERISTIC NS_SYNISTESP71 "Turbinendifferenzdrehzahlschwelle zur Erkennung Synchron istgang verlassen" VALUE 0x1D8776 ZF_kw_si16_S5_S3 1000 UMR_U_MIN_1_1_0_S5_S3 0 1000 /end CHARACTERISTIC
/begin CHARACTERISTIC NS_SYNISTESP75 "Turbinendifferenzdrehzahlschwelle zur Erkennung Synchron istgang verlassen" VALUE 0x1D877E ZF_kw_si16_S5_S3 1000 UMR_U_MIN_1_1_0_S5_S3 0 1000 /end CHARACTERISTIC
/begin CHARACTERISTIC NS_SYNISTESP82 "Turbinendifferenzdrehzahlschwelle zur Erkennung Synchron istgang verlassen" VALUE 0x1D8786 ZF_kw_si16_S5_S3 1000 UMR_U_MIN_1_1_0_S5_S3 0 1000 /end CHARACTERISTIC
/begin CHARACTERISTIC NS_SYNISTESP84 "Turbinendifferenzdrehzahlschwelle zur Erkennung Synchron istgang verlassen" VALUE 0x1D878E ZF_kw_si16_S5_S3 1000 UMR_U_MIN_1_1_0_S5_S3 0 1000 /end CHARACTERISTIC
/begin CHARACTERISTIC NS_SYNISTESP86 "Turbinendifferenzdrehzahlschwelle zur Erkennung Synchron istgang verlassen" VALUE 0x1D8796 ZF_kw_si16_S5_S3 1000 UMR_U_MIN_1_1_0_S5_S3 0 1000 /end CHARACTERISTIC
/begin CHARACTERISTIC NS_VERSIAE21 "Drehzahlschwelle auf Leerlaufdrehzahl zur Verhinderung der Verschachtelung bei IAE" VALUE 0x1D8710 ZF_kw_si16_S5_S3 8200 UMR_U_MIN_1_1_0_S5_S3 0 8200 /end CHARACTERISTIC
/begin CHARACTERISTIC NS_VERSIAE32 "Drehzahlschwelle auf Leerlaufdrehzahl zur Verhinderung der Verschachtelung bei IAE" VALUE 0x1D8718 ZF_kw_si16_S5_S3 8200 UMR_U_MIN_1_1_0_S5_S3 0 8200 /end CHARACTERISTIC
/begin CHARACTERISTIC NS_VERSIAE43 "Drehzahlschwelle auf Leerlaufdrehzahl zur Verhinderung der Verschachtelung bei IAE" VALUE 0x1D8720 ZF_kw_si16_S5_S3 8200 UMR_U_MIN_1_1_0_S5_S3 0 8200 /end CHARACTERISTIC
/begin CHARACTERISTIC NS_VERSIAE54 "Drehzahlschwelle auf Leerlaufdrehzahl zur Verhinderung der Verschachtelung bei IAE" VALUE 0x1D8728 ZF_kw_si16_S5_S3 8200 UMR_U_MIN_1_1_0_S5_S3 0 8200 /end CHARACTERISTIC
/begin CHARACTERISTIC NS_VERSIAE65 "Drehzahlschwelle auf Leerlaufdrehzahl zur Verhinderung der Verschachtelung bei IAE" VALUE 0x1D8730 ZF_kw_si16_S5_S3 8200 UMR_U_MIN_1_1_0_S5_S3 0 8200 /end CHARACTERISTIC
/begin CHARACTERISTIC NS_VERSIAE76 "Drehzahlschwelle auf Leerlaufdrehzahl zur Verhinderung der Verschachtelung bei IAE" VALUE 0x1D8738 ZF_kw_si16_S5_S3 8200 UMR_U_MIN_1_1_0_S5_S3 0 8200 /end CHARACTERISTIC
/begin CHARACTERISTIC NS_VERSIAE87 "Drehzahlschwelle auf Leerlaufdrehzahl zur Verhinderung der Verschachtelung bei IAE" VALUE 0x1D8740 ZF_kw_si16_S5_S3 8200 UMR_U_MIN_1_1_0_S5_S3 0 8200 /end CHARACTERISTIC
/begin CHARACTERISTIC NS_VERSIAESP31 "Drehzahlschwelle auf Leerlaufdrehzahl zur Verhinderung der Verschachtelung bei IAE" VALUE 0x1D8748 ZF_kw_si16_S5_S3 8200 UMR_U_MIN_1_1_0_S5_S3 0 8200 /end CHARACTERISTIC
/begin CHARACTERISTIC NS_VERSIAESP42 "Drehzahlschwelle auf Leerlaufdrehzahl zur Verhinderung der Verschachtelung bei IAE" VALUE 0x1D8750 ZF_kw_si16_S5_S3 8200 UMR_U_MIN_1_1_0_S5_S3 0 8200 /end CHARACTERISTIC
/begin CHARACTERISTIC NS_VERSIAESP51 "Drehzahlschwelle auf Leerlaufdrehzahl zur Verhinderung der Verschachtelung bei IAE" VALUE 0x1D8758 ZF_kw_si16_S5_S3 8200 UMR_U_MIN_1_1_0_S5_S3 0 8200 /end CHARACTERISTIC
/begin CHARACTERISTIC NS_VERSIAESP53 "Drehzahlschwelle auf Leerlaufdrehzahl zur Verhinderung der Verschachtelung bei IAE" VALUE 0x1D8760 ZF_kw_si16_S5_S3 8200 UMR_U_MIN_1_1_0_S5_S3 0 8200 /end CHARACTERISTIC
/begin CHARACTERISTIC NS_VERSIAESP63 "Drehzahlschwelle auf Leerlaufdrehzahl zur Verhinderung der Verschachtelung bei IAE" VALUE 0x1D8768 ZF_kw_si16_S5_S3 8200 UMR_U_MIN_1_1_0_S5_S3 0 8200 /end CHARACTERISTIC
/begin CHARACTERISTIC NS_VERSIAESP64 "Drehzahlschwelle auf Leerlaufdrehzahl zur Verhinderung der Verschachtelung bei IAE" VALUE 0x1D8770 ZF_kw_si16_S5_S3 8200 UMR_U_MIN_1_1_0_S5_S3 0 8200 /end CHARACTERISTIC
/begin CHARACTERISTIC NS_VERSIAESP71 "Drehzahlschwelle auf Leerlaufdrehzahl zur Verhinderung der Verschachtelung bei IAE" VALUE 0x1D8778 ZF_kw_si16_S5_S3 8200 UMR_U_MIN_1_1_0_S5_S3 0 8200 /end CHARACTERISTIC
/begin CHARACTERISTIC NS_VERSIAESP75 "Drehzahlschwelle auf Leerlaufdrehzahl zur Verhinderung der Verschachtelung bei IAE" VALUE 0x1D8780 ZF_kw_si16_S5_S3 8200 UMR_U_MIN_1_1_0_S5_S3 0 8200 /end CHARACTERISTIC
/begin CHARACTERISTIC NS_VERSIAESP82 "Drehzahlschwelle auf Leerlaufdrehzahl zur Verhinderung der Verschachtelung bei IAE" VALUE 0x1D8788 ZF_kw_si16_S5_S3 8200 UMR_U_MIN_1_1_0_S5_S3 0 8200 /end CHARACTERISTIC
/begin CHARACTERISTIC NS_VERSIAESP84 "Drehzahlschwelle auf Leerlaufdrehzahl zur Verhinderung der Verschachtelung bei IAE" VALUE 0x1D8790 ZF_kw_si16_S5_S3 8200 UMR_U_MIN_1_1_0_S5_S3 0 8200 /end CHARACTERISTIC
/begin CHARACTERISTIC NS_VERSIAESP86 "Drehzahlschwelle auf Leerlaufdrehzahl zur Verhinderung der Verschachtelung bei IAE" VALUE 0x1D8798 ZF_kw_si16_S5_S3 8200 UMR_U_MIN_1_1_0_S5_S3 0 8200 /end CHARACTERISTIC
/begin CHARACTERISTIC PO_ABBGLSHSZ21 "Schaltdruckoffset nach Umstellung einer HSZ in eine RSZ waehrend der GLS-Phase" VALUE 0x1D87DC ZF_kw_si16_S5_S3 12 UMR_BAR__1_1000_0_S5_S3 -6 6 /end CHARACTERISTIC
/begin CHARACTERISTIC PO_ABBGLSHSZSP31 "Schaltdruckoffset nach Umstellung einer HSZ in eine RSZ waehrend der GLS-Phase" VALUE 0x1D88D8 ZF_kw_si16_S5_S3 12 UMR_BAR__1_1000_0_S5_S3 -6 6 /end CHARACTERISTIC
/begin CHARACTERISTIC P_MAXOBGLS "Max. Reglerdruck nach oben bei GLS" VALUE 0x1D87A0 ZF_kw_si16_S5_S3 12.75 UMR_BAR__1_1000_0_S5_S3 0 12.75 /end CHARACTERISTIC
/begin CHARACTERISTIC P_MAXOBGLSGE "Max. Regeldruck nach oben bei GLS Gangeinlegen" VALUE 0x1D87A4 ZF_kw_si16_S5_S3 12.75 UMR_BAR__1_1000_0_S5_S3 0 12.75 /end CHARACTERISTIC
/begin CHARACTERISTIC P_MAXUNGLS "Max. Reglerdruck nach unten bei GLS" VALUE 0x1D87A2 ZF_kw_si16_S5_S3 12.75 UMR_BAR__1_1000_0_S5_S3 0 12.75 /end CHARACTERISTIC
/begin CHARACTERISTIC P_MAXUNGLSGE "Max. Reglerdruck nach unten bei GLS Gangeinlegen" VALUE 0x1D87A6 ZF_kw_si16_S5_S3 12.75 UMR_BAR__1_1000_0_S5_S3 0 12.75 /end CHARACTERISTIC
/begin CHARACTERISTIC SWI_GLS "Schalter GLS" VALUE 0x1D7937 ZF_kw_ui8_S5_S3 1 UMR___1_1_0_S5_S3 0 1 /end CHARACTERISTIC
/begin CHARACTERISTIC SWI_GLSGE "Schalter GLS-Regelung Gangeinlegen" VALUE 0x1D793A ZF_kw_bool8_S5_S3 1 UMR___1_1_0_S5_S3 0 1 /end CHARACTERISTIC
/begin CHARACTERISTIC SWI_NGABGLS "Schalter Beruecksichtigung Gradient(n_ab) bei GLS" VALUE 0x1D7938 ZF_kw_ui8_S5_S3 2 UMR___1_1_0_S5_S3 0 2 /end CHARACTERISTIC
/begin CHARACTERISTIC TD_STOLGLS12 "max. tol. Schleifzeitdifferenz GLS" VALUE 0x1D78E6 ZF_kw_ui8_S5_S3 2540 UMR_MSEC__10_1_0_S5_S3 0 2540 /end CHARACTERISTIC
/begin CHARACTERISTIC TD_STOLGLS12_EL "max. tol. Schleifzeitdifferenz GLS" VALUE 0x1D78E7 ZF_kw_ui8_S5_S3 2540 UMR_MSEC__10_1_0_S5_S3 0 2540 /end CHARACTERISTIC
/begin CHARACTERISTIC TD_STOLGLS21 "max. tol. Schleifzeitdifferenz GLS" VALUE 0x1D7944 ZF_kw_ui8_S5_S3 2540 UMR_MSEC__10_1_0_S5_S3 0 2540 /end CHARACTERISTIC
/begin CHARACTERISTIC TD_STOLGLS21_EL "max. tol. Schleifzeitdifferenz GLS" VALUE 0x1D7945 ZF_kw_ui8_S5_S3 2540 UMR_MSEC__10_1_0_S5_S3 0 2540 /end CHARACTERISTIC
/begin CHARACTERISTIC TD_STOLGLS23 "max. tol. Schleifzeitdifferenz GLS" VALUE 0x1D78E9 ZF_kw_ui8_S5_S3 2540 UMR_MSEC__10_1_0_S5_S3 0 2540 /end CHARACTERISTIC
/begin CHARACTERISTIC TD_STOLGLS23_EL "max. tol. Schleifzeitdifferenz GLS" VALUE 0x1D78EA ZF_kw_ui8_S5_S3 2540 UMR_MSEC__10_1_0_S5_S3 0 2540 /end CHARACTERISTIC
/begin CHARACTERISTIC TD_STOLGLS34 "max. tol. Schleifzeitdifferenz GLS" VALUE 0x1D78EC ZF_kw_ui8_S5_S3 2540 UMR_MSEC__10_1_0_S5_S3 0 2540 /end CHARACTERISTIC
/begin CHARACTERISTIC TD_STOLGLS34_EL "max. tol. Schleifzeitdifferenz GLS" VALUE 0x1D78ED ZF_kw_ui8_S5_S3 2540 UMR_MSEC__10_1_0_S5_S3 0 2540 /end CHARACTERISTIC
/begin CHARACTERISTIC TD_STOLGLS45 "max. tol. Schleifzeitdifferenz GLS" VALUE 0x1D78EF ZF_kw_ui8_S5_S3 2540 UMR_MSEC__10_1_0_S5_S3 0 2540 /end CHARACTERISTIC
/begin CHARACTERISTIC TD_STOLGLS45_EL "max. tol. Schleifzeitdifferenz GLS" VALUE 0x1D78F0 ZF_kw_ui8_S5_S3 2540 UMR_MSEC__10_1_0_S5_S3 0 2540 /end CHARACTERISTIC
/begin CHARACTERISTIC TD_STOLGLS56 "max. tol. Schleifzeitdifferenz GLS" VALUE 0x1D78F2 ZF_kw_ui8_S5_S3 2540 UMR_MSEC__10_1_0_S5_S3 0 2540 /end CHARACTERISTIC
/begin CHARACTERISTIC TD_STOLGLS56_EL "max. tol. Schleifzeitdifferenz GLS" VALUE 0x1D78F3 ZF_kw_ui8_S5_S3 2540 UMR_MSEC__10_1_0_S5_S3 0 2540 /end CHARACTERISTIC
/begin CHARACTERISTIC TD_STOLGLS67 "max. tol. Schleifzeitdifferenz GLS" VALUE 0x1D78F5 ZF_kw_ui8_S5_S3 2540 UMR_MSEC__10_1_0_S5_S3 0 2540 /end CHARACTERISTIC
/begin CHARACTERISTIC TD_STOLGLS67_EL "max. tol. Schleifzeitdifferenz GLS" VALUE 0x1D78F6 ZF_kw_ui8_S5_S3 2540 UMR_MSEC__10_1_0_S5_S3 0 2540 /end CHARACTERISTIC
/begin CHARACTERISTIC TD_STOLGLS78 "max. tol. Schleifzeitdifferenz GLS" VALUE 0x1D78F8 ZF_kw_ui8_S5_S3 2540 UMR_MSEC__10_1_0_S5_S3 0 2540 /end CHARACTERISTIC
/begin CHARACTERISTIC TD_STOLGLS78_EL "max. tol. Schleifzeitdifferenz GLS" VALUE 0x1D78F9 ZF_kw_ui8_S5_S3 2540 UMR_MSEC__10_1_0_S5_S3 0 2540 /end CHARACTERISTIC
/begin CHARACTERISTIC TD_STOLGLSSP31 "max. tol. Schleifzeitdifferenz GLS" VALUE 0x1D7952 ZF_kw_ui8_S5_S3 2540 UMR_MSEC__10_1_0_S5_S3 0 2540 /end CHARACTERISTIC
/begin CHARACTERISTIC TD_STOLGLSSP31_EL "max. tol. Schleifzeitdifferenz GLS" VALUE 0x1D7953 ZF_kw_ui8_S5_S3 2540 UMR_MSEC__10_1_0_S5_S3 0 2540 /end CHARACTERISTIC
/begin CHARACTERISTIC T_FNGTGLS "Filterzeit fuer Turbinendrehzahlgradient bei GLS" VALUE 0x1D879E ZF_kw_ui16_S5_S3 999 UMR_MSEC__1_1_0_S5_S3 1 1000 /end CHARACTERISTIC
/begin CHARACTERISTIC T_FNGTGLSENDE12 "Filterwert für Filterung Sollgradient bei HS" VALUE 0x1D78E8 ZF_kw_ui8_S5_S3 254 UMR_MSEC__1_1_0_S5_S3 0 254 /end CHARACTERISTIC
/begin CHARACTERISTIC T_FNGTGLSENDE23 "Filterwert für Filterung Sollgradient bei HS" VALUE 0x1D78EB ZF_kw_ui8_S5_S3 254 UMR_MSEC__1_1_0_S5_S3 0 254 /end CHARACTERISTIC
/begin CHARACTERISTIC T_FNGTGLSENDE34 "Filterwert für Filterung Sollgradient bei HS" VALUE 0x1D78EE ZF_kw_ui8_S5_S3 254 UMR_MSEC__1_1_0_S5_S3 0 254 /end CHARACTERISTIC
/begin CHARACTERISTIC T_FNGTGLSENDE45 "Filterwert für Filterung Sollgradient bei HS" VALUE 0x1D78F1 ZF_kw_ui8_S5_S3 254 UMR_MSEC__1_1_0_S5_S3 0 254 /end CHARACTERISTIC
/begin CHARACTERISTIC T_FNGTGLSENDE56 "Filterwert für Filterung Sollgradient bei HS" VALUE 0x1D78F4 ZF_kw_ui8_S5_S3 254 UMR_MSEC__1_1_0_S5_S3 0 254 /end CHARACTERISTIC
/begin CHARACTERISTIC T_FNGTGLSENDE67 "Filterwert für Filterung Sollgradient bei HS" VALUE 0x1D78F7 ZF_kw_ui8_S5_S3 254 UMR_MSEC__1_1_0_S5_S3 0 254 /end CHARACTERISTIC
/begin CHARACTERISTIC T_FNGTGLSENDE78 "Filterwert für Filterung Sollgradient bei HS" VALUE 0x1D78FA ZF_kw_ui8_S5_S3 254 UMR_MSEC__1_1_0_S5_S3 0 254 /end CHARACTERISTIC
/begin CHARACTERISTIC T_RAMAX21 "Rampe bei Timeout" VALUE 0x1D7925 ZF_kw_ui8_S5_S3 2540 UMR_MSEC__10_1_0_S5_S3 0 2540 /end CHARACTERISTIC
/begin CHARACTERISTIC T_RAMAX32 "Rampe bei Timeout" VALUE 0x1D7926 ZF_kw_ui8_S5_S3 2540 UMR_MSEC__10_1_0_S5_S3 0 2540 /end CHARACTERISTIC
/begin CHARACTERISTIC T_RAMAX43 "Rampe bei Timeout" VALUE 0x1D7927 ZF_kw_ui8_S5_S3 2540 UMR_MSEC__10_1_0_S5_S3 0 2540 /end CHARACTERISTIC
/begin CHARACTERISTIC T_RAMAX54 "Rampe bei Timeout" VALUE 0x1D7928 ZF_kw_ui8_S5_S3 2540 UMR_MSEC__10_1_0_S5_S3 0 2540 /end CHARACTERISTIC
/begin CHARACTERISTIC T_RAMAX65 "Rampe bei Timeout" VALUE 0x1D7929 ZF_kw_ui8_S5_S3 2540 UMR_MSEC__10_1_0_S5_S3 0 2540 /end CHARACTERISTIC
/begin CHARACTERISTIC T_RAMAX76 "Rampe bei Timeout" VALUE 0x1D792A ZF_kw_ui8_S5_S3 2540 UMR_MSEC__10_1_0_S5_S3 0 2540 /end CHARACTERISTIC
/begin CHARACTERISTIC T_RAMAX87 "Rampe bei Timeout" VALUE 0x1D792B ZF_kw_ui8_S5_S3 2540 UMR_MSEC__10_1_0_S5_S3 0 2540 /end CHARACTERISTIC
/begin CHARACTERISTIC T_RAMAXSP31 "Rampe bei Timeout" VALUE 0x1D792C ZF_kw_ui8_S5_S3 2540 UMR_MSEC__10_1_0_S5_S3 0 2540 /end CHARACTERISTIC
/begin CHARACTERISTIC T_RAMAXSP42 "Rampe bei Timeout" VALUE 0x1D792D ZF_kw_ui8_S5_S3 2540 UMR_MSEC__10_1_0_S5_S3 0 2540 /end CHARACTERISTIC
/begin CHARACTERISTIC T_RAMAXSP51 "Rampe bei Timeout" VALUE 0x1D792E ZF_kw_ui8_S5_S3 2540 UMR_MSEC__10_1_0_S5_S3 0 2540 /end CHARACTERISTIC
/begin CHARACTERISTIC T_RAMAXSP53 "Rampe bei Timeout" VALUE 0x1D792F ZF_kw_ui8_S5_S3 2540 UMR_MSEC__10_1_0_S5_S3 0 2540 /end CHARACTERISTIC
/begin CHARACTERISTIC T_RAMAXSP63 "Rampe bei Timeout" VALUE 0x1D7930 ZF_kw_ui8_S5_S3 2540 UMR_MSEC__10_1_0_S5_S3 0 2540 /end CHARACTERISTIC
/begin CHARACTERISTIC T_RAMAXSP64 "Rampe bei Timeout" VALUE 0x1D7931 ZF_kw_ui8_S5_S3 2540 UMR_MSEC__10_1_0_S5_S3 0 2540 /end CHARACTERISTIC
/begin CHARACTERISTIC T_RAMAXSP71 "Rampe bei Timeout" VALUE 0x1D7932 ZF_kw_ui8_S5_S3 2540 UMR_MSEC__10_1_0_S5_S3 0 2540 /end CHARACTERISTIC
/begin CHARACTERISTIC T_RAMAXSP75 "Rampe bei Timeout" VALUE 0x1D7933 ZF_kw_ui8_S5_S3 2540 UMR_MSEC__10_1_0_S5_S3 0 2540 /end CHARACTERISTIC
/begin CHARACTERISTIC T_RAMAXSP82 "Rampe bei Timeout" VALUE 0x1D7934 ZF_kw_ui8_S5_S3 2540 UMR_MSEC__10_1_0_S5_S3 0 2540 /end CHARACTERISTIC
/begin CHARACTERISTIC T_RAMAXSP84 "Rampe bei Timeout" VALUE 0x1D7935 ZF_kw_ui8_S5_S3 2540 UMR_MSEC__10_1_0_S5_S3 0 2540 /end CHARACTERISTIC
/begin CHARACTERISTIC T_RAMAXSP86 "Rampe bei Timeout" VALUE 0x1D7936 ZF_kw_ui8_S5_S3 2540 UMR_MSEC__10_1_0_S5_S3 0 2540 /end CHARACTERISTIC
/begin CHARACTERISTIC T_VGLSKZU_1 "Verzoegerungszeit GLS-Beginn Gangeinlegen" VALUE 0x1D793C ZF_kw_ui8_S5_S3 2540 UMR_MSEC__10_1_0_S5_S3 0 2540 /end CHARACTERISTIC
/begin CHARACTERISTIC T_VGLSKZU_2 "Verzoegerungszeit GLS-Beginn Gangeinlegen" VALUE 0x1D793D ZF_kw_ui8_S5_S3 2540 UMR_MSEC__10_1_0_S5_S3 0 2540 /end CHARACTERISTIC
/begin CHARACTERISTIC T_VGLSKZU_3 "Verzoegerungszeit GLS-Beginn Gangeinlegen" VALUE 0x1D793E ZF_kw_ui8_S5_S3 2540 UMR_MSEC__10_1_0_S5_S3 0 2540 /end CHARACTERISTIC
/begin CHARACTERISTIC T_VGLSKZU_4 "Verzoegerungszeit GLS-Beginn Gangeinlegen" VALUE 0x1D793F ZF_kw_ui8_S5_S3 2540 UMR_MSEC__10_1_0_S5_S3 0 2540 /end CHARACTERISTIC
/begin CHARACTERISTIC T_VGLSKZU_5 "Verzoegerungszeit GLS-Beginn Gangeinlegen" VALUE 0x1D7940 ZF_kw_ui8_S5_S3 2540 UMR_MSEC__10_1_0_S5_S3 0 2540 /end CHARACTERISTIC
/begin CHARACTERISTIC T_VGLSKZU_6 "Verzoegerungszeit GLS-Beginn Gangeinlegen" VALUE 0x1D7941 ZF_kw_ui8_S5_S3 2540 UMR_MSEC__10_1_0_S5_S3 0 2540 /end CHARACTERISTIC
/begin CHARACTERISTIC T_VGLSKZU_7 "Verzoegerungszeit GLS-Beginn Gangeinlegen" VALUE 0x1D7942 ZF_kw_ui8_S5_S3 2540 UMR_MSEC__10_1_0_S5_S3 0 2540 /end CHARACTERISTIC
/begin CHARACTERISTIC T_VGLSKZU_8 "Verzoegerungszeit GLS-Beginn Gangeinlegen" VALUE 0x1D7943 ZF_kw_ui8_S5_S3 2540 UMR_MSEC__10_1_0_S5_S3 0 2540 /end CHARACTERISTIC
/begin CHARACTERISTIC T_VGLSKZU_R "Verzoegerungszeit GLS-Beginn Gangeinlegen" VALUE 0x1D793B ZF_kw_ui8_S5_S3 2540 UMR_MSEC__10_1_0_S5_S3 0 2540 /end CHARACTERISTIC
/begin CHARACTERISTIC W_NGTGLSENDE12 "Endwert für Filterung Sollgradient bei HS" VALUE 0x1D859A ZF_kw_si16_S5_S3 5000 UMR_U_MINSEC_1_1_0_S5_S3 -5000 0 /end CHARACTERISTIC
/begin CHARACTERISTIC W_NGTGLSENDE23 "Endwert für Filterung Sollgradient bei HS" VALUE 0x1D85C0 ZF_kw_si16_S5_S3 5000 UMR_U_MINSEC_1_1_0_S5_S3 -5000 0 /end CHARACTERISTIC
/begin CHARACTERISTIC W_NGTGLSENDE34 "Endwert für Filterung Sollgradient bei HS" VALUE 0x1D85E6 ZF_kw_si16_S5_S3 5000 UMR_U_MINSEC_1_1_0_S5_S3 -5000 0 /end CHARACTERISTIC
/begin CHARACTERISTIC W_NGTGLSENDE45 "Endwert für Filterung Sollgradient bei HS" VALUE 0x1D860C ZF_kw_si16_S5_S3 5000 UMR_U_MINSEC_1_1_0_S5_S3 -5000 0 /end CHARACTERISTIC
/begin CHARACTERISTIC W_NGTGLSENDE56 "Endwert für Filterung Sollgradient bei HS" VALUE 0x1D8632 ZF_kw_si16_S5_S3 5000 UMR_U_MINSEC_1_1_0_S5_S3 -5000 0 /end CHARACTERISTIC
/begin CHARACTERISTIC W_NGTGLSENDE67 "Endwert für Filterung Sollgradient bei HS" VALUE 0x1D8658 ZF_kw_si16_S5_S3 5000 UMR_U_MINSEC_1_1_0_S5_S3 -5000 0 /end CHARACTERISTIC
/begin CHARACTERISTIC W_NGTGLSENDE78 "Endwert für Filterung Sollgradient bei HS" VALUE 0x1D867E ZF_kw_si16_S5_S3 5000 UMR_U_MINSEC_1_1_0_S5_S3 -5000 0 /end CHARACTERISTIC
/begin FUNCTION jSasGloRSP275_Fktn "Applikationesgroessen Instanz jSasGloRSP275" /begin DEF_CHARACTERISTIC KF_TSYNCGMTHINSYNRASP75 KF_TSYNCGMTHINSYNSP75 /end DEF_CHARACTERISTIC /end FUNCTION
/begin FUNCTION jSasGloRSP276_Fktn "Applikationesgroessen Instanz jSasGloRSP276" /begin DEF_CHARACTERISTIC KF_TSYNCGMTHINSYNRASP76 KF_TSYNCGMTHINSYNSP76 /end DEF_CHARACTERISTIC /end FUNCTION
/begin FUNCTION jSasGloRSP282_Fktn "Applikationesgroessen Instanz jSasGloRSP282" /begin DEF_CHARACTERISTIC KF_TSYNCGMTHINSYNRASP82 KF_TSYNCGMTHINSYNSP82 /end DEF_CHARACTERISTIC /end FUNCTION
/begin FUNCTION jSasGloRSP284_Fktn "Applikationesgroessen Instanz jSasGloRSP284" /begin DEF_CHARACTERISTIC KF_TSYNCGMTHINSYNRASP84 KF_TSYNCGMTHINSYNSP84 /end DEF_CHARACTERISTIC /end FUNCTION
/begin FUNCTION jSasGloRSP286_Fktn "Applikationesgroessen Instanz jSasGloRSP286" /begin DEF_CHARACTERISTIC KF_TSYNCGMTHINSYNRASP86 KF_TSYNCGMTHINSYNSP86 /end DEF_CHARACTERISTIC /end FUNCTION
/begin FUNCTION jSasGloRSP287_Fktn "Applikationesgroessen Instanz jSasGloRSP287" /begin DEF_CHARACTERISTIC KF_TSYNCGMTHINSYNRASP87 KF_TSYNCGMTHINSYNSP87 /end DEF_CHARACTERISTIC /end FUNCTION
/begin FUNCTION jSasGloRSP321_Fktn "Applikationesgroessen Instanz jSasGloRSP321" /begin DEF_CHARACTERISTIC KF_TSYNCGMTHINSYNRASPORT21 KF_TSYNCGMTHINSYNSPORT21 /end DEF_CHARACTERISTIC /end FUNCTION
/begin FUNCTION jSasGloRSP331_Fktn "Applikationesgroessen Instanz jSasGloRSP331" /begin DEF_CHARACTERISTIC KF_TSYNCGMTHINSYNRASPORT31 KF_TSYNCGMTHINSYNSPORT31 /end DEF_CHARACTERISTIC /end FUNCTION
/begin FUNCTION jSasGloRSP332_Fktn "Applikationesgroessen Instanz jSasGloRSP332" /begin DEF_CHARACTERISTIC KF_TSYNCGMTHINSYNRASPORT32 KF_TSYNCGMTHINSYNSPORT32 /end DEF_CHARACTERISTIC /end FUNCTION
/begin FUNCTION jSasGloRSP342_Fktn "Applikationesgroessen Instanz jSasGloRSP342" /begin DEF_CHARACTERISTIC KF_TSYNCGMTHINSYNRASPORT42 KF_TSYNCGMTHINSYNSPORT42 /end DEF_CHARACTERISTIC /end FUNCTION
/begin FUNCTION jSasGloRSP343_Fktn "Applikationesgroessen Instanz jSasGloRSP343" /begin DEF_CHARACTERISTIC KF_TSYNCGMTHINSYNRASPORT43 KF_TSYNCGMTHINSYNSPORT43 /end DEF_CHARACTERISTIC /end FUNCTION
/begin FUNCTION jSasGloRSP351_Fktn "Applikationesgroessen Instanz jSasGloRSP351" /begin DEF_CHARACTERISTIC KF_TSYNCGMTHINSYNRASPORT51 KF_TSYNCGMTHINSYNSPORT51 /end DEF_CHARACTERISTIC /end FUNCTION
/begin FUNCTION jSasGloRSP353_Fktn "Applikationesgroessen Instanz jSasGloRSP353" /begin DEF_CHARACTERISTIC KF_TSYNCGMTHINSYNRASPORT53 KF_TSYNCGMTHINSYNSPORT53 /end DEF_CHARACTERISTIC /end FUNCTION
/begin FUNCTION jSasGloRSP354_Fktn "Applikationesgroessen Instanz jSasGloRSP354" /begin DEF_CHARACTERISTIC KF_TSYNCGMTHINSYNRASPORT54 KF_TSYNCGMTHINSYNSPORT54 /end DEF_CHARACTERISTIC /end FUNCTION
/begin FUNCTION jSasGloRSP363_Fktn "Applikationesgroessen Instanz jSasGloRSP363" /begin DEF_CHARACTERISTIC KF_TSYNCGMTHINSYNRASPORT63 KF_TSYNCGMTHINSYNSPORT63 /end DEF_CHARACTERISTIC /end FUNCTION
/begin FUNCTION jSasGloRSP364_Fktn "Applikationesgroessen Instanz jSasGloRSP364" /begin DEF_CHARACTERISTIC KF_TSYNCGMTHINSYNRASPORT64 KF_TSYNCGMTHINSYNSPORT64 /end DEF_CHARACTERISTIC /end FUNCTION
/begin FUNCTION jSasGloRSP365_Fktn "Applikationesgroessen Instanz jSasGloRSP365" /begin DEF_CHARACTERISTIC KF_TSYNCGMTHINSYNRASPORT65 KF_TSYNCGMTHINSYNSPORT65 /end DEF_CHARACTERISTIC /end FUNCTION
/begin FUNCTION jSasGloRSP371_Fktn "Applikationesgroessen Instanz jSasGloRSP371" /begin DEF_CHARACTERISTIC KF_TSYNCGMTHINSYNRASPORT71 KF_TSYNCGMTHINSYNSPORT71 /end DEF_CHARACTERISTIC /end FUNCTION
/begin FUNCTION jSasGloRSP375_Fktn "Applikationesgroessen Instanz jSasGloRSP375" /begin DEF_CHARACTERISTIC KF_TSYNCGMTHINSYNRASPORT75 KF_TSYNCGMTHINSYNSPORT75 /end DEF_CHARACTERISTIC /end FUNCTION
/begin FUNCTION jSasGloRSP376_Fktn "Applikationesgroessen Instanz jSasGloRSP376" /begin DEF_CHARACTERISTIC KF_TSYNCGMTHINSYNRASPORT76 KF_TSYNCGMTHINSYNSPORT76 /end DEF_CHARACTERISTIC /end FUNCTION
/begin FUNCTION jSasGloRSP382_Fktn "Applikationesgroessen Instanz jSasGloRSP382" /begin DEF_CHARACTERISTIC KF_TSYNCGMTHINSYNRASPORT82 KF_TSYNCGMTHINSYNSPORT82 /end DEF_CHARACTERISTIC /end FUNCTION
/begin FUNCTION jSasGloRSP384_Fktn "Applikationesgroessen Instanz jSasGloRSP384" /begin DEF_CHARACTERISTIC KF_TSYNCGMTHINSYNRASPORT84 KF_TSYNCGMTHINSYNSPORT84 /end DEF_CHARACTERISTIC /end FUNCTION
/begin FUNCTION jSasGloRSP386_Fktn "Applikationesgroessen Instanz jSasGloRSP386" /begin DEF_CHARACTERISTIC KF_TSYNCGMTHINSYNRASPORT86 KF_TSYNCGMTHINSYNSPORT86 /end DEF_CHARACTERISTIC /end FUNCTION
/begin FUNCTION jSasGloRSP387_Fktn "Applikationesgroessen Instanz jSasGloRSP387" /begin DEF_CHARACTERISTIC KF_TSYNCGMTHINSYNRASPORT87 KF_TSYNCGMTHINSYNSPORT87 /end DEF_CHARACTERISTIC /end FUNCTION
/begin FUNCTION jSasGloRSS21_Fktn "Applikationesgroessen Instanz jSasGloRSS21"
 /begin DEF_CHARACTERISTIC HYS_NGS_VERIAE21 KL_TMAXCG21 NGS_VERIAE21 NS_SYNISTE21 NS_VERSIAE21 T_RAMAX21 /end DEF_CHARACTERISTIC
/end FUNCTION
/begin FUNCTION jSasGloRSS31_Fktn "Applikationesgroessen Instanz jSasGloRSS31"
 /begin DEF_CHARACTERISTIC HYS_NGS_VERIAESP31 KL_TMAXCGSP31 NGS_VERIAESP31 NS_SYNISTESP31 NS_VERSIAESP31 T_RAMAXSP31 /end DEF_CHARACTERISTIC
/end FUNCTION
/begin FUNCTION jSasGloRSS32_Fktn "Applikationesgroessen Instanz jSasGloRSS32"
 /begin DEF_CHARACTERISTIC HYS_NGS_VERIAE32 KL_TMAXCG32 NGS_VERIAE32 NS_SYNISTE32 NS_VERSIAE32 T_RAMAX32 /end DEF_CHARACTERISTIC
/end FUNCTION
/begin FUNCTION jSasGloRSS42_Fktn "Applikationesgroessen Instanz jSasGloRSS42"
 /begin DEF_CHARACTERISTIC HYS_NGS_VERIAESP42 KL_TMAXCGSP42 NGS_VERIAESP42 NS_SYNISTESP42 NS_VERSIAESP42 T_RAMAXSP42 /end DEF_CHARACTERISTIC
/end FUNCTION
/begin FUNCTION jSasGloRSS43_Fktn "Applikationesgroessen Instanz jSasGloRSS43"
 /begin DEF_CHARACTERISTIC HYS_NGS_VERIAE43 KL_TMAXCG43 NGS_VERIAE43 NS_SYNISTE43 NS_VERSIAE43 T_RAMAX43 /end DEF_CHARACTERISTIC
/end FUNCTION
/begin FUNCTION jSasGloRSS51_Fktn "Applikationesgroessen Instanz jSasGloRSS51"
 /begin DEF_CHARACTERISTIC HYS_NGS_VERIAESP51 KL_TMAXCGSP51 NGS_VERIAESP51 NS_SYNISTESP51 NS_VERSIAESP51 T_RAMAXSP51 /end DEF_CHARACTERISTIC
/end FUNCTION
/begin FUNCTION jSasGloRSS53_Fktn "Applikationesgroessen Instanz jSasGloRSS53"
 /begin DEF_CHARACTERISTIC HYS_NGS_VERIAESP53 KL_TMAXCGSP53 NGS_VERIAESP53 NS_SYNISTESP53 NS_VERSIAESP53 T_RAMAXSP53 /end DEF_CHARACTERISTIC
/end FUNCTION
/begin FUNCTION jSasGloRSS54_Fktn "Applikationesgroessen Instanz jSasGloRSS54"
 /begin DEF_CHARACTERISTIC HYS_NGS_VERIAE54 KL_TMAXCG54 NGS_VERIAE54 NS_SYNISTE54 NS_VERSIAE54 T_RAMAX54 /end DEF_CHARACTERISTIC
/end FUNCTION
/begin FUNCTION jSasGloRSS63_Fktn "Applikationesgroessen Instanz jSasGloRSS63"
 /begin DEF_CHARACTERISTIC HYS_NGS_VERIAESP63 KL_TMAXCGSP63 NGS_VERIAESP63 NS_SYNISTESP63 NS_VERSIAESP63 T_RAMAXSP63 /end DEF_CHARACTERISTIC
/end FUNCTION
/begin FUNCTION jSasGloRSS64_Fktn "Applikationesgroessen Instanz jSasGloRSS64"
 /begin DEF_CHARACTERISTIC HYS_NGS_VERIAESP64 KL_TMAXCGSP64 NGS_VERIAESP64 NS_SYNISTESP64 NS_VERSIAESP64 T_RAMAXSP64 /end DEF_CHARACTERISTIC
/end FUNCTION
/begin FUNCTION jSasGloRSS65_Fktn "Applikationesgroessen Instanz jSasGloRSS65"
 /begin DEF_CHARACTERISTIC HYS_NGS_VERIAE65 KL_TMAXCG65 NGS_VERIAE65 NS_SYNISTE65 NS_VERSIAE65 T_RAMAX65 /end DEF_CHARACTERISTIC
/end FUNCTION
/begin FUNCTION jSasGloRSS71_Fktn "Applikationesgroessen Instanz jSasGloRSS71"
 /begin DEF_CHARACTERISTIC HYS_NGS_VERIAESP71 KL_TMAXCGSP71 NGS_VERIAESP71 NS_SYNISTESP71 NS_VERSIAESP71 T_RAMAXSP71 /end DEF_CHARACTERISTIC
/end FUNCTION
/begin FUNCTION jSasGloRSS75_Fktn "Applikationesgroessen Instanz jSasGloRSS75"
 /begin DEF_CHARACTERISTIC HYS_NGS_VERIAESP75 KL_TMAXCGSP75 NGS_VERIAESP75 NS_SYNISTESP75 NS_VERSIAESP75 T_RAMAXSP75 /end DEF_CHARACTERISTIC
/end FUNCTION
/begin FUNCTION jSasGloRSS76_Fktn "Applikationesgroessen Instanz jSasGloRSS76"
 /begin DEF_CHARACTERISTIC HYS_NGS_VERIAE76 KL_TMAXCG76 NGS_VERIAE76 NS_SYNISTE76 NS_VERSIAE76 T_RAMAX76 /end DEF_CHARACTERISTIC
/end FUNCTION
/begin FUNCTION jSasGloRSS82_Fktn "Applikationesgroessen Instanz jSasGloRSS82"
 /begin DEF_CHARACTERISTIC HYS_NGS_VERIAESP82 KL_TMAXCGSP82 NGS_VERIAESP82 NS_SYNISTESP82 NS_VERSIAESP82 T_RAMAXSP82 /end DEF_CHARACTERISTIC
/end FUNCTION
/begin FUNCTION jSasGloRSS84_Fktn "Applikationesgroessen Instanz jSasGloRSS84"
 /begin DEF_CHARACTERISTIC HYS_NGS_VERIAESP84 KL_TMAXCGSP84 NGS_VERIAESP84 NS_SYNISTESP84 NS_VERSIAESP84 T_RAMAXSP84 /end DEF_CHARACTERISTIC
/end FUNCTION
/begin FUNCTION jSasGloRSS86_Fktn "Applikationesgroessen Instanz jSasGloRSS86"
 /begin DEF_CHARACTERISTIC HYS_NGS_VERIAESP86 KL_TMAXCGSP86 NGS_VERIAESP86 NS_SYNISTESP86 NS_VERSIAESP86 T_RAMAXSP86 /end DEF_CHARACTERISTIC
/end FUNCTION
/begin FUNCTION jSasGloRSS87_Fktn "Applikationesgroessen Instanz jSasGloRSS87"
 /begin DEF_CHARACTERISTIC HYS_NGS_VERIAE87 KL_TMAXCG87 NGS_VERIAE87 NS_SYNISTE87 NS_VERSIAE87 T_RAMAX87 /end DEF_CHARACTERISTIC
/end FUNCTION
/begin FUNCTION jSasGlsAl_Fktn "Applikationesgroessen Instanz jSasGlsAl"
 /begin DEF_CHARACTERISTIC CS_GLSGE P_MAXOBGLS P_MAXOBGLSGE P_MAXUNGLS P_MAXUNGLSGE SWI_GLS SWI_GLSGE SWI_NGABGLS T_FNGTGLS /end DEF_CHARACTERISTIC
/end FUNCTION
/begin FUNCTION jSasGlsGeG1_Fktn "Applikationesgroessen Instanz jSasGlsGeG1"
 /begin DEF_CHARACTERISTIC KF_WNGTNDSYNCGGE_1 KL_KIGLSKZUCG_1 KL_KPGLSKZUCG_1 ND_GLSGE_1 T_VGLSKZU_1 /end DEF_CHARACTERISTIC
/end FUNCTION
/begin FUNCTION jSasGlsGeG2_Fktn "Applikationesgroessen Instanz jSasGlsGeG2"
 /begin DEF_CHARACTERISTIC KF_WNGTNDSYNCGGE_2 KL_KIGLSKZUCG_2 KL_KPGLSKZUCG_2 ND_GLSGE_2 T_VGLSKZU_2 /end DEF_CHARACTERISTIC
/end FUNCTION
/begin FUNCTION jSasGlsGeG3_Fktn "Applikationesgroessen Instanz jSasGlsGeG3"
 /begin DEF_CHARACTERISTIC KF_WNGTNDSYNCGGE_3 KL_KIGLSKZUCG_3 KL_KPGLSKZUCG_3 ND_GLSGE_3 T_VGLSKZU_3 /end DEF_CHARACTERISTIC
/end FUNCTION
/begin FUNCTION jSasGlsGeG4_Fktn "Applikationesgroessen Instanz jSasGlsGeG4"
 /begin DEF_CHARACTERISTIC KF_WNGTNDSYNCGGE_4 KL_KIGLSKZUCG_4 KL_KPGLSKZUCG_4 ND_GLSGE_4 T_VGLSKZU_4 /end DEF_CHARACTERISTIC
/end FUNCTION
/begin FUNCTION jSasGlsGeG5_Fktn "Applikationesgroessen Instanz jSasGlsGeG5"
 /begin DEF_CHARACTERISTIC KF_WNGTNDSYNCGGE_5 KL_KIGLSKZUCG_5 KL_KPGLSKZUCG_5 ND_GLSGE_5 T_VGLSKZU_5 /end DEF_CHARACTERISTIC
/end FUNCTION
/begin FUNCTION jSasGlsGeG6_Fktn "Applikationesgroessen Instanz jSasGlsGeG6"
 /begin DEF_CHARACTERISTIC KF_WNGTNDSYNCGGE_6 KL_KIGLSKZUCG_6 KL_KPGLSKZUCG_6 ND_GLSGE_6 T_VGLSKZU_6 /end DEF_CHARACTERISTIC
/end FUNCTION
/begin FUNCTION jSasGlsGeG7_Fktn "Applikationesgroessen Instanz jSasGlsGeG7"
 /begin DEF_CHARACTERISTIC KF_WNGTNDSYNCGGE_7 KL_KIGLSKZUCG_7 KL_KPGLSKZUCG_7 ND_GLSGE_7 T_VGLSKZU_7 /end DEF_CHARACTERISTIC
/end FUNCTION
/begin FUNCTION jSasGlsGeG8_Fktn "Applikationesgroessen Instanz jSasGlsGeG8"
 /begin DEF_CHARACTERISTIC KF_WNGTNDSYNCGGE_8 KL_KIGLSKZUCG_8 KL_KPGLSKZUCG_8 ND_GLSGE_8 T_VGLSKZU_8 /end DEF_CHARACTERISTIC
/end FUNCTION
/begin FUNCTION jSasGlsGeGR_Fktn "Applikationesgroessen Instanz jSasGlsGeGR"
 /begin DEF_CHARACTERISTIC KF_WNGTNDSYNCGGE_R KL_KIGLSKZUCG_R KL_KPGLSKZUCG_R ND_GLSGE_R T_VGLSKZU_R /end DEF_CHARACTERISTIC
/end FUNCTION
/begin FUNCTION jSasGlsHSP112_Fktn "Applikationesgroessen Instanz jSasGlsHSP112"
 /begin DEF_CHARACTERISTIC KF_WTSGLS12 KF_WTSGLS12_EL KL_FMENACHGLSENDE12 KL_TVGLSKZUCG12 KL_TVGLSKZUCG12_EL /end DEF_CHARACTERISTIC
/end FUNCTION
/begin FUNCTION jSasGlsHSP123_Fktn "Applikationesgroessen Instanz jSasGlsHSP123"
 /begin DEF_CHARACTERISTIC KF_WTSGLS23 KF_WTSGLS23_EL KL_FMENACHGLSENDE23 KL_TVGLSKZUCG23 KL_TVGLSKZUCG23_EL /end DEF_CHARACTERISTIC
/end FUNCTION
/begin FUNCTION jSasGlsHSP134_Fktn "Applikationesgroessen Instanz jSasGlsHSP134"
 /begin DEF_CHARACTERISTIC KF_WTSGLS34 KF_WTSGLS34_EL KL_FMENACHGLSENDE34 KL_TVGLSKZUCG34 KL_TVGLSKZUCG34_EL /end DEF_CHARACTERISTIC
/end FUNCTION
/begin FUNCTION jSasGlsHSP145_Fktn "Applikationesgroessen Instanz jSasGlsHSP145"
 /begin DEF_CHARACTERISTIC KF_WTSGLS45 KF_WTSGLS45_EL KL_FMENACHGLSENDE45 KL_TVGLSKZUCG45 KL_TVGLSKZUCG45_EL /end DEF_CHARACTERISTIC
/end FUNCTION
/begin FUNCTION jSasGlsHSP156_Fktn "Applikationesgroessen Instanz jSasGlsHSP156"
 /begin DEF_CHARACTERISTIC KF_WTSGLS56 KF_WTSGLS56_EL KL_FMENACHGLSENDE56 KL_TVGLSKZUCG56 KL_TVGLSKZUCG56_EL /end DEF_CHARACTERISTIC
/end FUNCTION
/begin FUNCTION jSasGlsHSP167_Fktn "Applikationesgroessen Instanz jSasGlsHSP167"
 /begin DEF_CHARACTERISTIC KF_WTSGLS67 KF_WTSGLS67_EL KL_FMENACHGLSENDE67 KL_TVGLSKZUCG67 KL_TVGLSKZUCG67_EL /end DEF_CHARACTERISTIC
/end FUNCTION
/begin FUNCTION jSasGlsHSP178_Fktn "Applikationesgroessen Instanz jSasGlsHSP178"
 /begin DEF_CHARACTERISTIC KF_WTSGLS78 KF_WTSGLS78_EL KL_FMENACHGLSENDE78 KL_TVGLSKZUCG78 KL_TVGLSKZUCG78_EL /end DEF_CHARACTERISTIC
/end FUNCTION
/begin FUNCTION jSasGlsHSP212_Fktn "Applikationesgroessen Instanz jSasGlsHSP212" /begin DEF_CHARACTERISTIC KF_WTSGLSSP12 KL_FMENACHGLSENDESP12 KL_TVGLSKZUCGSP12 /end DEF_CHARACTERISTIC /end FUNCTION
/begin FUNCTION jSasGlsHSP223_Fktn "Applikationesgroessen Instanz jSasGlsHSP223" /begin DEF_CHARACTERISTIC KF_WTSGLSSP23 KL_FMENACHGLSENDESP23 KL_TVGLSKZUCGSP23 /end DEF_CHARACTERISTIC /end FUNCTION
/begin FUNCTION jSasGlsHSP234_Fktn "Applikationesgroessen Instanz jSasGlsHSP234" /begin DEF_CHARACTERISTIC KF_WTSGLSSP34 KL_FMENACHGLSENDESP34 KL_TVGLSKZUCGSP34 /end DEF_CHARACTERISTIC /end FUNCTION
/begin FUNCTION jSasGlsHSP245_Fktn "Applikationesgroessen Instanz jSasGlsHSP245" /begin DEF_CHARACTERISTIC KF_WTSGLSSP45 KL_FMENACHGLSENDESP45 KL_TVGLSKZUCGSP45 /end DEF_CHARACTERISTIC /end FUNCTION
/begin FUNCTION jSasGlsHSP256_Fktn "Applikationesgroessen Instanz jSasGlsHSP256" /begin DEF_CHARACTERISTIC KF_WTSGLSSP56 KL_FMENACHGLSENDESP56 KL_TVGLSKZUCGSP56 /end DEF_CHARACTERISTIC /end FUNCTION
/begin FUNCTION jSasGlsHSP267_Fktn "Applikationesgroessen Instanz jSasGlsHSP267" /begin DEF_CHARACTERISTIC KF_WTSGLSSP67 KL_FMENACHGLSENDESP67 KL_TVGLSKZUCGSP67 /end DEF_CHARACTERISTIC /end FUNCTION
/begin FUNCTION jSasGlsHSP278_Fktn "Applikationesgroessen Instanz jSasGlsHSP278" /begin DEF_CHARACTERISTIC KF_WTSGLSSP78 KL_FMENACHGLSENDESP78 KL_TVGLSKZUCGSP78 /end DEF_CHARACTERISTIC /end FUNCTION
/begin FUNCTION jSasGlsHSP312_Fktn "Applikationesgroessen Instanz jSasGlsHSP312"
 /begin DEF_CHARACTERISTIC KF_WTSGLSSPORT12 KL_FMENACHGLSENDESPORT12 KL_TVGLSKZUCGSPORT12 /end DEF_CHARACTERISTIC
/end FUNCTION
/begin FUNCTION jSasGlsHSP323_Fktn "Applikationesgroessen Instanz jSasGlsHSP323"
 /begin DEF_CHARACTERISTIC KF_WTSGLSSPORT23 KL_FMENACHGLSENDESPORT23 KL_TVGLSKZUCGSPORT23 /end DEF_CHARACTERISTIC
/end FUNCTION
/begin FUNCTION jSasGlsHSP334_Fktn "Applikationesgroessen Instanz jSasGlsHSP334"
 /begin DEF_CHARACTERISTIC KF_WTSGLSSPORT34 KL_FMENACHGLSENDESPORT34 KL_TVGLSKZUCGSPORT34 /end DEF_CHARACTERISTIC
/end FUNCTION
/begin FUNCTION jSasGlsHSP345_Fktn "Applikationesgroessen Instanz jSasGlsHSP345"
 /begin DEF_CHARACTERISTIC KF_WTSGLSSPORT45 KL_FMENACHGLSENDESPORT45 KL_TVGLSKZUCGSPORT45 /end DEF_CHARACTERISTIC
/end FUNCTION
/begin FUNCTION jSasGlsHSP356_Fktn "Applikationesgroessen Instanz jSasGlsHSP356"
 /begin DEF_CHARACTERISTIC KF_WTSGLSSPORT56 KL_FMENACHGLSENDESPORT56 KL_TVGLSKZUCGSPORT56 /end DEF_CHARACTERISTIC
/end FUNCTION
/begin FUNCTION jSasGlsHSP367_Fktn "Applikationesgroessen Instanz jSasGlsHSP367"
 /begin DEF_CHARACTERISTIC KF_WTSGLSSPORT67 KL_FMENACHGLSENDESPORT67 KL_TVGLSKZUCGSPORT67 /end DEF_CHARACTERISTIC
/end FUNCTION
/begin FUNCTION jSasGlsHSP378_Fktn "Applikationesgroessen Instanz jSasGlsHSP378"
 /begin DEF_CHARACTERISTIC KF_WTSGLSSPORT78 KL_FMENACHGLSENDESPORT78 KL_TVGLSKZUCGSPORT78 /end DEF_CHARACTERISTIC
/end FUNCTION
/begin FUNCTION jSasGlsHSS12_Fktn "Applikationesgroessen Instanz jSasGlsHSS12"
 /begin DEF_CHARACTERISTIC KI_GLSKAB12 KI_GLSKAB12_EL KI_GLSKZU12 KI_GLSKZU12_EL KL_TVGLSKABCG12 KP_GLSKAB12 KP_GLSKAB12_EL KP_GLSKZU12 KP_GLSKZU12_EL K_WNGGRGLSPKAB12 K_WNGGRGLSPKAB12_EL K_WNGGRGLSPKZU12 K_WNGGRGLSPKZU12_EL K_WNGKLGLSPKAB12 K_WNGKLGLSPKAB12_EL K_WNGKLGLSPKZU12 K_WNGKLGLSPKZU12_EL ND_GLSNEGHS12 ND_GLSPOSHS12 TD_STOLGLS12 TD_STOLGLS12_EL T_FNGTGLSENDE12 W_NGTGLSENDE12 /end DEF_CHARACTERISTIC
/end FUNCTION
/begin FUNCTION jSasGlsHSS23_Fktn "Applikationesgroessen Instanz jSasGlsHSS23"
 /begin DEF_CHARACTERISTIC KI_GLSKAB23 KI_GLSKAB23_EL KI_GLSKZU23 KI_GLSKZU23_EL KL_TVGLSKABCG23 KP_GLSKAB23 KP_GLSKAB23_EL KP_GLSKZU23 KP_GLSKZU23_EL K_WNGGRGLSPKAB23 K_WNGGRGLSPKAB23_EL K_WNGGRGLSPKZU23 K_WNGGRGLSPKZU23_EL K_WNGKLGLSPKAB23 K_WNGKLGLSPKAB23_EL K_WNGKLGLSPKZU23 K_WNGKLGLSPKZU23_EL ND_GLSNEGHS23 ND_GLSPOSHS23 TD_STOLGLS23 TD_STOLGLS23_EL T_FNGTGLSENDE23 W_NGTGLSENDE23 /end DEF_CHARACTERISTIC
/end FUNCTION
/begin FUNCTION jSasGlsHSS34_Fktn "Applikationesgroessen Instanz jSasGlsHSS34"
 /begin DEF_CHARACTERISTIC KI_GLSKAB34 KI_GLSKAB34_EL KI_GLSKZU34 KI_GLSKZU34_EL KL_TVGLSKABCG34 KP_GLSKAB34 KP_GLSKAB34_EL KP_GLSKZU34 KP_GLSKZU34_EL K_WNGGRGLSPKAB34 K_WNGGRGLSPKAB34_EL K_WNGGRGLSPKZU34 K_WNGGRGLSPKZU34_EL K_WNGKLGLSPKAB34 K_WNGKLGLSPKAB34_EL K_WNGKLGLSPKZU34 K_WNGKLGLSPKZU34_EL ND_GLSNEGHS34 ND_GLSPOSHS34 TD_STOLGLS34 TD_STOLGLS34_EL T_FNGTGLSENDE34 W_NGTGLSENDE34 /end DEF_CHARACTERISTIC
/end FUNCTION
/begin FUNCTION jSasGlsHSS45_Fktn "Applikationesgroessen Instanz jSasGlsHSS45"
 /begin DEF_CHARACTERISTIC KI_GLSKAB45 KI_GLSKAB45_EL KI_GLSKZU45 KI_GLSKZU45_EL KL_TVGLSKABCG45 KP_GLSKAB45 KP_GLSKAB45_EL KP_GLSKZU45 KP_GLSKZU45_EL K_WNGGRGLSPKAB45 K_WNGGRGLSPKAB45_EL K_WNGGRGLSPKZU45 K_WNGGRGLSPKZU45_EL K_WNGKLGLSPKAB45 K_WNGKLGLSPKAB45_EL K_WNGKLGLSPKZU45 K_WNGKLGLSPKZU45_EL ND_GLSNEGHS45 ND_GLSPOSHS45 TD_STOLGLS45 TD_STOLGLS45_EL T_FNGTGLSENDE45 W_NGTGLSENDE45 /end DEF_CHARACTERISTIC
/end FUNCTION
/begin FUNCTION jSasGlsHSS56_Fktn "Applikationesgroessen Instanz jSasGlsHSS56"
 /begin DEF_CHARACTERISTIC KI_GLSKAB56 KI_GLSKAB56_EL KI_GLSKZU56 KI_GLSKZU56_EL KL_TVGLSKABCG56 KP_GLSKAB56 KP_GLSKAB56_EL KP_GLSKZU56 KP_GLSKZU56_EL K_WNGGRGLSPKAB56 K_WNGGRGLSPKAB56_EL K_WNGGRGLSPKZU56 K_WNGGRGLSPKZU56_EL K_WNGKLGLSPKAB56 K_WNGKLGLSPKAB56_EL K_WNGKLGLSPKZU56 K_WNGKLGLSPKZU56_EL ND_GLSNEGHS56 ND_GLSPOSHS56 TD_STOLGLS56 TD_STOLGLS56_EL T_FNGTGLSENDE56 W_NGTGLSENDE56 /end DEF_CHARACTERISTIC
/end FUNCTION
/begin FUNCTION jSasGlsHSS67_Fktn "Applikationesgroessen Instanz jSasGlsHSS67"
 /begin DEF_CHARACTERISTIC KI_GLSKAB67 KI_GLSKAB67_EL KI_GLSKZU67 KI_GLSKZU67_EL KL_TVGLSKABCG67 KP_GLSKAB67 KP_GLSKAB67_EL KP_GLSKZU67 KP_GLSKZU67_EL K_WNGGRGLSPKAB67 K_WNGGRGLSPKAB67_EL K_WNGGRGLSPKZU67 K_WNGGRGLSPKZU67_EL K_WNGKLGLSPKAB67 K_WNGKLGLSPKAB67_EL K_WNGKLGLSPKZU67 K_WNGKLGLSPKZU67_EL ND_GLSNEGHS67 ND_GLSPOSHS67 TD_STOLGLS67 TD_STOLGLS67_EL T_FNGTGLSENDE67 W_NGTGLSENDE67 /end DEF_CHARACTERISTIC
/end FUNCTION
/begin FUNCTION jSasGlsHSS78_Fktn "Applikationesgroessen Instanz jSasGlsHSS78"
 /begin DEF_CHARACTERISTIC KI_GLSKAB78 KI_GLSKAB78_EL KI_GLSKZU78 KI_GLSKZU78_EL KL_TVGLSKABCG78 KP_GLSKAB78 KP_GLSKAB78_EL KP_GLSKZU78 KP_GLSKZU78_EL K_WNGGRGLSPKAB78 K_WNGGRGLSPKAB78_EL K_WNGGRGLSPKZU78 K_WNGGRGLSPKZU78_EL K_WNGKLGLSPKAB78 K_WNGKLGLSPKAB78_EL K_WNGKLGLSPKZU78 K_WNGKLGLSPKZU78_EL ND_GLSNEGHS78 ND_GLSPOSHS78 TD_STOLGLS78 TD_STOLGLS78_EL T_FNGTGLSENDE78 W_NGTGLSENDE78 /end DEF_CHARACTERISTIC
/end FUNCTION
/begin FUNCTION jSasGlsRSP121_Fktn "Applikationesgroessen Instanz jSasGlsRSP121"
 /begin DEF_CHARACTERISTIC KF_WTSGLS21 KF_WTSGLS21_EL KL_TVGLSKABCG21 KL_TVGLSKABCG21_EL /end DEF_CHARACTERISTIC
/end FUNCTION
/begin FUNCTION jSasGlsRSP132_Fktn "Applikationesgroessen Instanz jSasGlsRSP132"
 /begin DEF_CHARACTERISTIC KF_WTSGLS32 KF_WTSGLS32_EL KL_TVGLSKABCG32 KL_TVGLSKABCG32_EL /end DEF_CHARACTERISTIC
/end FUNCTION
/begin FUNCTION jSasGlsRSP143_Fktn "Applikationesgroessen Instanz jSasGlsRSP143"
 /begin DEF_CHARACTERISTIC KF_WTSGLS43 KF_WTSGLS43_EL KL_TVGLSKABCG43 KL_TVGLSKABCG43_EL /end DEF_CHARACTERISTIC
/end FUNCTION
/begin FUNCTION jSasGlsRSP154_Fktn "Applikationesgroessen Instanz jSasGlsRSP154"
 /begin DEF_CHARACTERISTIC KF_WTSGLS54 KF_WTSGLS54_EL KL_TVGLSKABCG54 KL_TVGLSKABCG54_EL /end DEF_CHARACTERISTIC
/end FUNCTION
/begin FUNCTION jSasGlsRSP165_Fktn "Applikationesgroessen Instanz jSasGlsRSP165"
 /begin DEF_CHARACTERISTIC KF_WTSGLS65 KF_WTSGLS65_EL KL_TVGLSKABCG65 KL_TVGLSKABCG65_EL /end DEF_CHARACTERISTIC
/end FUNCTION
/begin FUNCTION jSasGlsRSP176_Fktn "Applikationesgroessen Instanz jSasGlsRSP176"
 /begin DEF_CHARACTERISTIC KF_WTSGLS76 KF_WTSGLS76_EL KL_TVGLSKABCG76 KL_TVGLSKABCG76_EL /end DEF_CHARACTERISTIC
/end FUNCTION
/begin FUNCTION jSasGlsRSP187_Fktn "Applikationesgroessen Instanz jSasGlsRSP187"
 /begin DEF_CHARACTERISTIC KF_WTSGLS87 KF_WTSGLS87_EL KL_TVGLSKABCG87 KL_TVGLSKABCG87_EL /end DEF_CHARACTERISTIC
/end FUNCTION
/begin FUNCTION jSasGlsRSP221_Fktn "Applikationesgroessen Instanz jSasGlsRSP221" /begin DEF_CHARACTERISTIC KF_WTSGLSSP21 KL_TVGLSKABCGSP21 /end DEF_CHARACTERISTIC /end FUNCTION
/begin FUNCTION jSasGlsRSP231_Fktn "Applikationesgroessen Instanz jSasGlsRSP231" /begin DEF_CHARACTERISTIC KF_WTSGLSSP31 KL_TVGLSKABCGSP31 /end DEF_CHARACTERISTIC /end FUNCTION
/begin FUNCTION jSasGlsRSP232_Fktn "Applikationesgroessen Instanz jSasGlsRSP232" /begin DEF_CHARACTERISTIC KF_WTSGLSSP32 KL_TVGLSKABCGSP32 /end DEF_CHARACTERISTIC /end FUNCTION
/begin FUNCTION jSasGlsRSP242_Fktn "Applikationesgroessen Instanz jSasGlsRSP242" /begin DEF_CHARACTERISTIC KF_WTSGLSSP42 KL_TVGLSKABCGSP42 /end DEF_CHARACTERISTIC /end FUNCTION
/begin FUNCTION jSasGlsRSP243_Fktn "Applikationesgroessen Instanz jSasGlsRSP243" /begin DEF_CHARACTERISTIC KF_WTSGLSSP43 KL_TVGLSKABCGSP43 /end DEF_CHARACTERISTIC /end FUNCTION
/begin FUNCTION jSasGlsRSP251_Fktn "Applikationesgroessen Instanz jSasGlsRSP251" /begin DEF_CHARACTERISTIC KF_WTSGLSSP51 KL_TVGLSKABCGSP51 /end DEF_CHARACTERISTIC /end FUNCTION
/begin FUNCTION jSasGlsRSP253_Fktn "Applikationesgroessen Instanz jSasGlsRSP253" /begin DEF_CHARACTERISTIC KF_WTSGLSSP53 KL_TVGLSKABCGSP53 /end DEF_CHARACTERISTIC /end FUNCTION
/begin FUNCTION jSasGlsRSP254_Fktn "Applikationesgroessen Instanz jSasGlsRSP254" /begin DEF_CHARACTERISTIC KF_WTSGLSSP54 KL_TVGLSKABCGSP54 /end DEF_CHARACTERISTIC /end FUNCTION
/begin FUNCTION jSasGlsRSP263_Fktn "Applikationesgroessen Instanz jSasGlsRSP263" /begin DEF_CHARACTERISTIC KF_WTSGLSSP63 KL_TVGLSKABCGSP63 /end DEF_CHARACTERISTIC /end FUNCTION
/begin FUNCTION jSasGlsRSP264_Fktn "Applikationesgroessen Instanz jSasGlsRSP264" /begin DEF_CHARACTERISTIC KF_WTSGLSSP64 KL_TVGLSKABCGSP64 /end DEF_CHARACTERISTIC /end FUNCTION
/begin FUNCTION jSasGlsRSP265_Fktn "Applikationesgroessen Instanz jSasGlsRSP265" /begin DEF_CHARACTERISTIC KF_WTSGLSSP65 KL_TVGLSKABCGSP65 /end DEF_CHARACTERISTIC /end FUNCTION
/begin FUNCTION jSasGlsRSP271_Fktn "Applikationesgroessen Instanz jSasGlsRSP271" /begin DEF_CHARACTERISTIC KF_WTSGLSSP71 KL_TVGLSKABCGSP71 /end DEF_CHARACTERISTIC /end FUNCTION
/begin FUNCTION jSasGlsRSP275_Fktn "Applikationesgroessen Instanz jSasGlsRSP275" /begin DEF_CHARACTERISTIC KF_WTSGLSSP75 KL_TVGLSKABCGSP75 /end DEF_CHARACTERISTIC /end FUNCTION
/begin FUNCTION jSasGlsRSP276_Fktn "Applikationesgroessen Instanz jSasGlsRSP276" /begin DEF_CHARACTERISTIC KF_WTSGLSSP76 KL_TVGLSKABCGSP76 /end DEF_CHARACTERISTIC /end FUNCTION
/begin FUNCTION jSasGlsRSP282_Fktn "Applikationesgroessen Instanz jSasGlsRSP282" /begin DEF_CHARACTERISTIC KF_WTSGLSSP82 KL_TVGLSKABCGSP82 /end DEF_CHARACTERISTIC /end FUNCTION
/begin FUNCTION jSasGlsRSP284_Fktn "Applikationesgroessen Instanz jSasGlsRSP284" /begin DEF_CHARACTERISTIC KF_WTSGLSSP84 KL_TVGLSKABCGSP84 /end DEF_CHARACTERISTIC /end FUNCTION
/begin FUNCTION jSasGlsRSP286_Fktn "Applikationesgroessen Instanz jSasGlsRSP286" /begin DEF_CHARACTERISTIC KF_WTSGLSSP86 KL_TVGLSKABCGSP86 /end DEF_CHARACTERISTIC /end FUNCTION
/begin FUNCTION jSasGlsRSP287_Fktn "Applikationesgroessen Instanz jSasGlsRSP287" /begin DEF_CHARACTERISTIC KF_WTSGLSSP87 KL_TVGLSKABCGSP87 /end DEF_CHARACTERISTIC /end FUNCTION
/begin FUNCTION jSasGlsRSP321_Fktn "Applikationesgroessen Instanz jSasGlsRSP321" /begin DEF_CHARACTERISTIC KF_WTSGLSSPORT21 KL_TVGLSKABCGSPORT21 /end DEF_CHARACTERISTIC /end FUNCTION
/begin FUNCTION jSasGlsRSP331_Fktn "Applikationesgroessen Instanz jSasGlsRSP331" /begin DEF_CHARACTERISTIC KF_WTSGLSSPORT31 KL_TVGLSKABCGSPORT31 /end DEF_CHARACTERISTIC /end FUNCTION
/begin FUNCTION jSasGlsRSP332_Fktn "Applikationesgroessen Instanz jSasGlsRSP332" /begin DEF_CHARACTERISTIC KF_WTSGLSSPORT32 KL_TVGLSKABCGSPORT32 /end DEF_CHARACTERISTIC /end FUNCTION
/begin FUNCTION jSasGlsRSP342_Fktn "Applikationesgroessen Instanz jSasGlsRSP342" /begin DEF_CHARACTERISTIC KF_WTSGLSSPORT42 KL_TVGLSKABCGSPORT42 /end DEF_CHARACTERISTIC /end FUNCTION
/begin FUNCTION jSasGlsRSP343_Fktn "Applikationesgroessen Instanz jSasGlsRSP343" /begin DEF_CHARACTERISTIC KF_WTSGLSSPORT43 KL_TVGLSKABCGSPORT43 /end DEF_CHARACTERISTIC /end FUNCTION
/begin FUNCTION jSasGlsRSP351_Fktn "Applikationesgroessen Instanz jSasGlsRSP351" /begin DEF_CHARACTERISTIC KF_WTSGLSSPORT51 KL_TVGLSKABCGSPORT51 /end DEF_CHARACTERISTIC /end FUNCTION
/begin FUNCTION jSasGlsRSP353_Fktn "Applikationesgroessen Instanz jSasGlsRSP353" /begin DEF_CHARACTERISTIC KF_WTSGLSSPORT53 KL_TVGLSKABCGSPORT53 /end DEF_CHARACTERISTIC /end FUNCTION
/begin FUNCTION jSasGlsRSP354_Fktn "Applikationesgroessen Instanz jSasGlsRSP354" /begin DEF_CHARACTERISTIC KF_WTSGLSSPORT54 KL_TVGLSKABCGSPORT54 /end DEF_CHARACTERISTIC /end FUNCTION
/begin FUNCTION jSasGlsRSP363_Fktn "Applikationesgroessen Instanz jSasGlsRSP363" /begin DEF_CHARACTERISTIC KF_WTSGLSSPORT63 KL_TVGLSKABCGSPORT63 /end DEF_CHARACTERISTIC /end FUNCTION
/begin FUNCTION jSasGlsRSP364_Fktn "Applikationesgroessen Instanz jSasGlsRSP364" /begin DEF_CHARACTERISTIC KF_WTSGLSSPORT64 KL_TVGLSKABCGSPORT64 /end DEF_CHARACTERISTIC /end FUNCTION
/begin FUNCTION jSasGlsRSP365_Fktn "Applikationesgroessen Instanz jSasGlsRSP365" /begin DEF_CHARACTERISTIC KF_WTSGLSSPORT65 KL_TVGLSKABCGSPORT65 /end DEF_CHARACTERISTIC /end FUNCTION
/begin FUNCTION jSasGlsRSP371_Fktn "Applikationesgroessen Instanz jSasGlsRSP371" /begin DEF_CHARACTERISTIC KF_WTSGLSSPORT71 KL_TVGLSKABCGSPORT71 /end DEF_CHARACTERISTIC /end FUNCTION
/begin FUNCTION jSasGlsRSP375_Fktn "Applikationesgroessen Instanz jSasGlsRSP375" /begin DEF_CHARACTERISTIC KF_WTSGLSSPORT75 KL_TVGLSKABCGSPORT75 /end DEF_CHARACTERISTIC /end FUNCTION
/begin FUNCTION jSasGlsRSP376_Fktn "Applikationesgroessen Instanz jSasGlsRSP376" /begin DEF_CHARACTERISTIC KF_WTSGLSSPORT76 KL_TVGLSKABCGSPORT76 /end DEF_CHARACTERISTIC /end FUNCTION
/begin FUNCTION jSasGlsRSP382_Fktn "Applikationesgroessen Instanz jSasGlsRSP382" /begin DEF_CHARACTERISTIC KF_WTSGLSSPORT82 KL_TVGLSKABCGSPORT82 /end DEF_CHARACTERISTIC /end FUNCTION
/begin FUNCTION jSasGlsRSP384_Fktn "Applikationesgroessen Instanz jSasGlsRSP384" /begin DEF_CHARACTERISTIC KF_WTSGLSSPORT84 KL_TVGLSKABCGSPORT84 /end DEF_CHARACTERISTIC /end FUNCTION
/begin FUNCTION jSasGlsRSP386_Fktn "Applikationesgroessen Instanz jSasGlsRSP386" /begin DEF_CHARACTERISTIC KF_WTSGLSSPORT86 KL_TVGLSKABCGSPORT86 /end DEF_CHARACTERISTIC /end FUNCTION
/begin FUNCTION jSasGlsRSP387_Fktn "Applikationesgroessen Instanz jSasGlsRSP387" /begin DEF_CHARACTERISTIC KF_WTSGLSSPORT87 KL_TVGLSKABCGSPORT87 /end DEF_CHARACTERISTIC /end FUNCTION
/begin FUNCTION jSasGlsRSS21_Fktn "Applikationesgroessen Instanz jSasGlsRSS21"
 /begin DEF_CHARACTERISTIC KI_GLSKAB21 KI_GLSKAB21_EL KI_GLSKZU21 KI_GLSKZU21_EL KL_TVGLSKZUCG21 KP_GLSKAB21 KP_GLSKAB21_EL KP_GLSKZU21 KP_GLSKZU21_EL K_WNGGRGLSPKAB21 K_WNGGRGLSPKAB21_EL K_WNGGRGLSPKZU21 K_WNGGRGLSPKZU21_EL K_WNGKLGLSPKAB21 K_WNGKLGLSPKAB21_EL K_WNGKLGLSPKZU21 K_WNGKLGLSPKZU21_EL ND_GLSRS21 PO_ABBGLSHSZ21 TD_STOLGLS21 TD_STOLGLS21_EL /end DEF_CHARACTERISTIC
/end FUNCTION
/begin FUNCTION jSasGlsRSS31_Fktn "Applikationesgroessen Instanz jSasGlsRSS31"
 /begin DEF_CHARACTERISTIC KI_GLSKABSP31 KI_GLSKABSP31_EL KI_GLSKZUSP31 KI_GLSKZUSP31_EL KL_TVGLSKZUCGSP31 KP_GLSKABSP31 KP_GLSKABSP31_EL KP_GLSKZUSP31 KP_GLSKZUSP31_EL K_WNGGRGLSPKABSP31 K_WNGGRGLSPKABSP31_EL K_WNGGRGLSPKZUSP31 K_WNGGRGLSPKZUSP31_EL K_WNGKLGLSPKABSP31 K_WNGKLGLSPKABSP31_EL K_WNGKLGLSPKZUSP31 K_WNGKLGLSPKZUSP31_EL ND_GLSRSSP31 PO_ABBGLSHSZSP31 TD_STOLGLSSP31 TD_STOLGLSSP31_EL /end DEF_CHARACTERISTIC
/end FUNCTION
/begin RECORD_LAYOUT ZF_kf_si16_S5_S3 FNC_VALUES 5 SWORD ROW_DIR DIRECT AXIS_PTS_X 3 SWORD INDEX_INCR DIRECT AXIS_PTS_Y 4 SWORD INDEX_INCR DIRECT NO_AXIS_PTS_X 1 ULONG NO_AXIS_PTS_Y 2 ULONG /end RECORD_LAYOUT
/begin RECORD_LAYOUT ZF_kf_ui8_S5_S3 FNC_VALUES 5 UBYTE ROW_DIR DIRECT AXIS_PTS_X 3 UBYTE INDEX_INCR DIRECT AXIS_PTS_Y 4 UBYTE INDEX_INCR DIRECT NO_AXIS_PTS_X 1 ULONG NO_AXIS_PTS_Y 2 ULONG /end RECORD_LAYOUT
/begin RECORD_LAYOUT ZF_kl_ui16_S5_S3 FNC_VALUES 3 UWORD COLUMN_DIR DIRECT AXIS_PTS_X 2 UWORD INDEX_INCR DIRECT NO_AXIS_PTS_X 1 ULONG /end RECORD_LAYOUT
/begin RECORD_LAYOUT ZF_kl_ui8_S5_S3 FNC_VALUES 3 UBYTE COLUMN_DIR DIRECT AXIS_PTS_X 2 UBYTE INDEX_INCR DIRECT NO_AXIS_PTS_X 1 ULONG /end RECORD_LAYOUT
/begin RECORD_LAYOUT ZF_kw_bool8_S5_S3 FNC_VALUES 1 UBYTE COLUMN_DIR DIRECT /end RECORD_LAYOUT
/begin RECORD_LAYOUT ZF_kw_si16_S5_S3 FNC_VALUES 1 SWORD COLUMN_DIR DIRECT /end RECORD_LAYOUT
/begin RECORD_LAYOUT ZF_kw_ui16_S5_S3 FNC_VALUES 1 UWORD COLUMN_DIR DIRECT /end RECORD_LAYOUT
/begin RECORD_LAYOUT ZF_kw_ui8_S5_S3 FNC_VALUES 1 UBYTE COLUMN_DIR DIRECT /end RECORD_LAYOUT
/end MODULE
/end PROJECT
