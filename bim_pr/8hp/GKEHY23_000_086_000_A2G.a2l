ASAP2_VERSION 1 51
/begin PROJECT ZHBC8600 "Gen2_BMW_System_Supplier_Lib"
/begin MODULE CPP ""
/begin MOD_COMMON "" BYTE_ORDER MSB_FIRST ALIGNMENT_BYTE 1 ALIGNMENT_WORD 2 ALIGNMENT_LONG 4 ALIGNMENT_FLOAT32_IEEE 4 ALIGNMENT_FLOAT64_IEEE 1 /end MOD_COMMON
/begin COMPU_VTAB Conv.cIepSchuz._.f_cgetr_aus_iep_S5_S3 "Umrechnung fuer Messgroesse cIepSchuz::f_cgetr_aus_iep" TAB_VERB 2 0 "FALSE" 1 "TRUE" DEFAULT_VALUE "" /end COMPU_VTAB
/begin COMPU_VTAB Conv.cIepSchuz._.f_cgetr_fehler_iep_S5_S3 "Umrechnung fuer Messgroesse cIepSchuz::f_cgetr_fehler_iep" TAB_VERB 2 0 "FALSE" 1 "TRUE" DEFAULT_VALUE "" /end COMPU_VTAB
/begin COMPU_VTAB Conv.cIepSchuz._.f_psys_max_iep_S5_S3 "Umrechnung fuer Messgroesse cIepSchuz::f_psys_max_iep" TAB_VERB 2 0 "FALSE" 1 "TRUE" DEFAULT_VALUE "" /end COMPU_VTAB
/begin COMPU_VTAB Conv.cIepSchuz._.f_tmax_aus_iep_S5_S3 "Umrechnung fuer Messgroesse cIepSchuz::f_tmax_aus_iep" TAB_VERB 2 0 "FALSE" 1 "TRUE" DEFAULT_VALUE "" /end COMPU_VTAB
/begin COMPU_VTAB Conv.cIepSchuz._.f_ts_LP_iep_S5_S3 "Umrechnung fuer Messgroesse cIepSchuz::f_ts_LP_iep" TAB_VERB 2 0 "FALSE" 1 "TRUE" DEFAULT_VALUE "" /end COMPU_VTAB
/begin COMPU_VTAB Conv.cIepSigna._.f_an_aus_iep_S5_S3 "Umrechnung fuer Messgroesse cIepSigna::f_an_aus_iep" TAB_VERB 2 0 "FALSE" 1 "TRUE" DEFAULT_VALUE "" /end COMPU_VTAB
/begin COMPU_VTAB Conv.cIepSigna._.f_ansteuerung_iep_S5_S3 "Umrechnung fuer Messgroesse cIepSigna::f_ansteuerung_iep" TAB_VERB 2 0 "FALSE" 1 "TRUE" DEFAULT_VALUE "" /end COMPU_VTAB
/begin COMPU_VTAB Conv.cIepSigna._.f_einmal_aus_S5_S3 "Umrechnung fuer Messgroesse cIepSigna::f_einmal_aus" TAB_VERB 2 0 "FALSE" 1 "TRUE" DEFAULT_VALUE "" /end COMPU_VTAB
/begin COMPU_VTAB Conv.cIepSigna._.f_gefaelle_erfuellt_iep_S5_S3 "Umrechnung fuer Messgroesse cIepSigna::f_gefaelle_erfuellt_iep" TAB_VERB 2 0 "FALSE" 1 "TRUE" DEFAULT_VALUE "" /end COMPU_VTAB
/begin COMPU_VTAB Conv.cIepSigna._.f_luft_erfuellt_iep_S5_S3 "Umrechnung fuer Messgroesse cIepSigna::f_luft_erfuellt_iep" TAB_VERB 2 0 "FALSE" 1 "TRUE" DEFAULT_VALUE "" /end COMPU_VTAB
/begin COMPU_VTAB Conv.cIepSigna._.f_nab_erfuellt_iep_S5_S3 "Umrechnung fuer Messgroesse cIepSigna::f_nab_erfuellt_iep" TAB_VERB 2 0 "FALSE" 1 "TRUE" DEFAULT_VALUE "" /end COMPU_VTAB
/begin COMPU_VTAB Conv.cIepSigna._.f_nab_gegeben_iep_S5_S3 "Umrechnung fuer Messgroesse cIepSigna::f_nab_gegeben_iep" TAB_VERB 2 0 "FALSE" 1 "TRUE" DEFAULT_VALUE "" /end COMPU_VTAB
/begin COMPU_VTAB Conv.cIepSigna._.f_ns_iep_S5_S3 "Umrechnung fuer Messgroesse cIepSigna::f_ns_iep" TAB_VERB 2 0 "FALSE" 1 "TRUE" DEFAULT_VALUE "" /end COMPU_VTAB
/begin COMPU_VTAB Conv.cIepSigna._.f_pow_down_enable_atsys_iep_S5_S3 "Umrechnung fuer Messgroesse cIepSigna::f_pow_down_enable_atsys_iep" TAB_VERB 2 0 "FALSE" 1 "TRUE" DEFAULT_VALUE "" /end COMPU_VTAB
/begin COMPU_VTAB Conv.cIepSigna._.f_psys_stuetzen_iep_S5_S3 "Umrechnung fuer Messgroesse cIepSigna::f_psys_stuetzen_iep" TAB_VERB 2 0 "FALSE" 1 "TRUE" DEFAULT_VALUE "" /end COMPU_VTAB
/begin COMPU_VTAB Conv.cIepSigna._.f_sleep_iep_S5_S3 "Umrechnung fuer Messgroesse cIepSigna::f_sleep_iep" TAB_VERB 2 0 "FALSE" 1 "TRUE" DEFAULT_VALUE "" /end COMPU_VTAB
/begin COMPU_VTAB Conv.cIepSigna._.f_wash_fkt_aktiv_iep_S5_S3 "Umrechnung fuer Messgroesse cIepSigna::f_wash_fkt_aktiv_iep" TAB_VERB 2 0 "Waschstrassenfunktion inaktiv" 1 "Wasch-Str fkt. ist aktiv und Timer zum Ausschalten der Iep abgelaufen" DEFAULT_VALUE "" /end COMPU_VTAB
/begin COMPU_VTAB Conv.cIepSigna._.z_f_stuetzen_iep_S5_S3 "Umrechnung fuer Messgroesse cIepSigna::z_f_stuetzen_iep" TAB_VERB 3 0 "Pumpe noch nicht gelaufen und f_psys_stuetzen_iep = FALSE" 1 "f_psys_stuetzen_iep = FALSE" 2 "f_psys_stuetzen_iep = TRUE" DEFAULT_VALUE "" /end COMPU_VTAB
/begin COMPU_VTAB Conv.cIepSigna._.z_fehler_reset_iep_S5_S3 "Umrechnung fuer Messgroesse cIepSigna::z_fehler_reset_iep" TAB_VERB 3 0 "Passiv" 1 "Aktiv" 2 "Warten" DEFAULT_VALUE "" /end COMPU_VTAB
/begin COMPU_VTAB Conv.cIepSigna._.z_gefaelle_iep_S5_S3 "Umrechnung fuer Messgroesse cIepSigna::z_gefaelle_iep" TAB_VERB 3 0 "Detektion der Neigungsschwelle bei iep_ist =AUS lauft" 1 "Neigungsschwelle erreicht" 2 "f_gefaelle_erfuellt_iep =TRUE" DEFAULT_VALUE "" /end COMPU_VTAB
/begin COMPU_VTAB Conv.cIepSigna._.z_luft_iep_S5_S3 "Umrechnung fuer Messgroesse cIepSigna::z_luft_iep" TAB_VERB 3 0 "Detektion der Drehzahlschwelle bei iep_ist =AUS lauft" 1 "f_luft_erfuellt_iep =TRUE" 2 "Sperrzeit für das erneute Aktivieren der Funktion" DEFAULT_VALUE "" /end COMPU_VTAB
/begin COMPU_VTAB Conv.cIepSigna._.z_nab_iep_S5_S3 "Umrechnung fuer Messgroesse cIepSigna::z_nab_iep" TAB_VERB 4 0 "Detektion der Drehzahlschwelle bei iep_ist =AUS lauft" 1 "Drehzahlschwelle erreicht" 2 "Drehzahlschwelle erreicht T_NAB_IEP abgelaufen" 3 "f_nab_erfuellt_iep =TRUE" DEFAULT_VALUE "" /end COMPU_VTAB
/begin COMPU_VTAB Conv.cIepSigna._.z_wstr_iep_S5_S3 "Umrechnung fuer Messgroesse cIepSigna::z_wstr_iep" TAB_VERB 3 0 "Funktion inaktiv" 1 "Waschstrassenfunktion nicht aktiv Vz-Timer läuft" 2 "Waschstrassenfunktion ist aktiv" DEFAULT_VALUE "" /end COMPU_VTAB
/begin COMPU_VTAB Conv.cIepStSig._.f_erststart_iep_S5_S3 "Umrechnung fuer Messgroesse cIepStSig::f_erststart_iep" TAB_VERB 2 0 "FALSE" 1 "TRUE" DEFAULT_VALUE "" /end COMPU_VTAB
/begin COMPU_VTAB Conv.cIepStSig._.status_iep_S5_S3 "Umrechnung fuer Messgroesse cIepStSig::status_iep" TAB_VERB 5 0 "Pumpe ausgeschaltet" 1 "Sleep Modus" 2 "Leistungspunkt 1" 3 "Leistungspunkt 2" 4 "Leistungspunkt 3" DEFAULT_VALUE "" /end COMPU_VTAB
/begin COMPU_VTAB Conv.cIepStSig._.zustand_status_iep_S5_S3 "Umrechnung fuer Messgroesse cIepStSig::zustand_status_iep" TAB_VERB 22 0 "Pumpe ausgeschaltet" 1 "ZP: AUS->LP1" 2 "ZP: AUS->LP1->LP2" 3 "ZP: AUS->LP1->LP2->LP3" 4 "ZP: AUS->LP2" 5 "ZP: AUS->LP2->LP3" 6 "ZP: AUS->LP3" 7 "ZP: AUS->LP1->LP3" 8 "Leistungspunkt 1" 9 "ZP: LP1->AUS" 10 "ZP: LP1->LP2" 11 "ZP: LP1->LP2->LP3" 12 "ZP: LP1->LP3" 13 "Leistungspunkt 2" 14 "ZP: LP2->AUS" 15 "ZP: LP2->LP3" 16 "Leistungspunkt 3" 17 "ZP: LP3->AUS" 18 "Sleep-Zustand" 19 "ZP: LP1->SLEEP" 20 "ZP: LP2->SLEEP" 21 "ZP: LP2->SLEEP" DEFAULT_VALUE "" /end COMPU_VTAB
/begin COMPU_VTAB Conv.cItfInput._.abs_reg_S5_S3 "Umrechnung fuer Messgroesse cItfInput::abs_reg" TAB_VERB 2 0 "ABS aus" 1 "ABS reglet" DEFAULT_VALUE "" /end COMPU_VTAB
/begin COMPU_VTAB Conv.cItfInput._.abs_reg_status_S5_S3 "Umrechnung fuer Messgroesse cItfInput::abs_reg_status" TAB_VERB 3 0 "Signal o.K." 1 "Ersatzwert" 2 "Signal fehlerhaft" DEFAULT_VALUE "" /end COMPU_VTAB
/begin COMPU_VTAB Conv.cItfInput._.ags_zka_index_S5_S3 "Umrechnung fuer Messgroesse cItfInput::ags_zka_index" TAB_VERB 2 0 "keinen Momentennachfuehrung" 1 "Momentennachfuehrung" DEFAULT_VALUE "" /end COMPU_VTAB
/begin COMPU_VTAB Conv.cItfInput._.anhaenger_aktiv_S5_S3 "Umrechnung fuer Messgroesse cItfInput::anhaenger_aktiv" TAB_VERB 2 0 "Kein Anhaengerbetrieb" 1 "Anhaengerbetrieb" DEFAULT_VALUE "" /end COMPU_VTAB
/begin COMPU_VTAB Conv.cItfInput._.asc_passiv_S5_S3 "Umrechnung fuer Messgroesse cItfInput::asc_passiv" TAB_VERB 2 0 "ASC funktional nicht abgeschaltet" 1 "ASC funktional abgeschaltet" DEFAULT_VALUE "" /end COMPU_VTAB
/begin COMPU_VTAB Conv.cItfInput._.asc_regelt_S5_S3 "Umrechnung fuer Messgroesse cItfInput::asc_regelt" TAB_VERB 2 0 "ASC regelt nicht" 1 "ASC regelt" DEFAULT_VALUE "" /end COMPU_VTAB
/begin COMPU_VTAB Conv.cItfInput._.autohold_aktiv_S5_S3 "Umrechnung fuer Messgroesse cItfInput::autohold_aktiv" TAB_VERB 2 0 "FALSE" 1 "TRUE" DEFAULT_VALUE "" /end COMPU_VTAB
/begin COMPU_VTAB Conv.cItfInput._.ax_ref_status_S5_S3 "Umrechnung fuer Messgroesse cItfInput::ax_ref_status" TAB_VERB 3 0 "Signal o.K." 1 "Ersatzwert" 2 "Signal fehlerhaft" DEFAULT_VALUE "" /end COMPU_VTAB
/begin COMPU_VTAB Conv.cItfInput._.bls_defakt_S5_S3 "Umrechnung fuer Messgroesse cItfInput::bls_defakt" TAB_VERB 2 0 "Bremslicht aus" 1 "Bremslicht ein" DEFAULT_VALUE "" /end COMPU_VTAB
/begin COMPU_VTAB Conv.cItfInput._.bls_defpas_S5_S3 "Umrechnung fuer Messgroesse cItfInput::bls_defpas" TAB_VERB 2 0 "Bremslicht aus" 1 "Bremslicht ein" DEFAULT_VALUE "" /end COMPU_VTAB
/begin COMPU_VTAB Conv.cItfInput._.bls_status_S5_S3 "Umrechnung fuer Messgroesse cItfInput::bls_status" TAB_VERB 3 0 "Signal o.K." 1 "Ersatzwert" 2 "Signal fehlerhaft" DEFAULT_VALUE "" /end COMPU_VTAB
/begin COMPU_VTAB Conv.cItfInput._.c_getr_status_S5_S3 "Umrechnung fuer Messgroesse cItfInput::c_getr_status" TAB_VERB 3 0 "Signal o.K." 1 "Ersatzwert" 2 "Signal fehlerhaft" DEFAULT_VALUE "" /end COMPU_VTAB
/begin COMPU_VTAB Conv.cItfInput._.druck_vorhanden_mod_S5_S3 "Umrechnung fuer Messgroesse cItfInput::druck_vorhanden_mod" TAB_VERB 2 0 "keine Modifikation" 1 "Modifikation aktiv" DEFAULT_VALUE "" /end COMPU_VTAB
/begin COMPU_VTAB Conv.cItfInput._.edsmv_ersatzinfo_S5_S3 "Umrechnung fuer Messgroesse cItfInput::edsmv_ersatzinfo" TAB_VERB 8 0 "keine edsmv_ersatzinfo" 1 "GRAUS -vorbelegt fuer MECH_NOTLAUF- nur HSS1 aus" 2 "LOWSIDE-OFF -vorbelegt fuer LOWSIDEOFF-" 3 "nicht belegt war mal EL_SIM_NL in der 53 Umsschaltphase" 4 "nicht belegt war mal EL_SIM_NL 5" 5 "nicht belegt war mal Sonderbestromung Notlauf 2" 6 "nicht relevant für ATSYS" 7 "HSS1 und HSS2 aus" DEFAULT_VALUE "" /end COMPU_VTAB
/begin COMPU_VTAB Conv.cItfInput._.ersf_k0auf_S5_S3 "Umrechnung fuer Messgroesse cItfInput::ersf_k0auf" TAB_VERB 2 0 "Ersatzfkt. nicht aktiv" 1 "Ersatzfkt. aktiv" DEFAULT_VALUE "" /end COMPU_VTAB
/begin COMPU_VTAB Conv.cItfInput._.f_iep_shutdown_S5_S3 "Umrechnung fuer Messgroesse cItfInput::f_iep_shutdown" TAB_VERB 2 0 "normaler Betrieb" 1 "Abschaltbedingungn erfuelt" DEFAULT_VALUE "" /end COMPU_VTAB
/begin COMPU_VTAB Conv.cItfInput._.f_minimaldruck_ausgabe_S5_S3 "Umrechnung fuer Messgroesse cItfInput::f_minimaldruck_ausgabe" TAB_VERB 2 0 "keine Vorgabe" 1 "Minimal-Druck Vorgabe" DEFAULT_VALUE "" /end COMPU_VTAB
/begin COMPU_VTAB Conv.cItfInput._.fahrbetrieb_S5_S3 "Umrechnung fuer Messgroesse cItfInput::fahrbetrieb" TAB_VERB 2 0 "Fahrbetiebstask nicht aktiv" 1 "Fahrbetriebstask aktiv" DEFAULT_VALUE "" /end COMPU_VTAB
/begin COMPU_VTAB Conv.cItfInput._.feststellbremse_aktiv_S5_S3 "Umrechnung fuer Messgroesse cItfInput::feststellbremse_aktiv" TAB_VERB 2 0 "Feststellbremse nicht angezogen" 1 "Feststellbremse angezogen" DEFAULT_VALUE "" /end COMPU_VTAB
/begin COMPU_VTAB Conv.cItfInput._.fet0_active_S5_S3 "Umrechnung fuer Messgroesse cItfInput::fet0_active" TAB_VERB 5 0 "FET0 in Sollzustand abgeschaltet" 1 "FET0 in Sollzustand eingeschaltet" 2 "FET0 aufgrund Fehler abgeschaltet" 3 "FET0 wird durch HW Software getestet" 4 "FET0 wegen Unterspannung abgeschaltet" DEFAULT_VALUE "" /end COMPU_VTAB
/begin COMPU_VTAB Conv.cItfInput._.fl_brake_inter_status_S5_S3 "Umrechnung fuer Messgroesse cItfInput::fl_brake_inter_status" TAB_VERB 3 0 "Signal o.K." 1 "Ersatzwert" 2 "Signal fehlerhaft" DEFAULT_VALUE "" /end COMPU_VTAB
/begin COMPU_VTAB Conv.cItfInput._.flag_m_max_has_iae_S5_S3 "Umrechnung fuer Messgroesse cItfInput::flag_m_max_has_iae" TAB_VERB 2 0 "Keine Begrenzung des IAE Moments" 1 "Begrenzung des IAE Moments" DEFAULT_VALUE "" /end COMPU_VTAB
/begin COMPU_VTAB Conv.cItfInput._.flag_p_hys_k0_has_S5_S3 "Umrechnung fuer Messgroesse cItfInput::flag_p_hys_k0_has" TAB_VERB 2 0 "Druckanteil p_hys_k0 inaktiv" 1 "Druckanteil p_hys_k0 aktiv" DEFAULT_VALUE "" /end COMPU_VTAB
/begin COMPU_VTAB Conv.cItfInput._.flag_partfilt_aktiv_S5_S3 "Umrechnung fuer Messgroesse cItfInput::flag_partfilt_aktiv" TAB_VERB 2 0 "keine Regeneration" 1 "Regenertation aktiv" DEFAULT_VALUE "" /end COMPU_VTAB
/begin COMPU_VTAB Conv.cItfInput._.freigabe_posvdiag_S5_S3 "Umrechnung fuer Messgroesse cItfInput::freigabe_posvdiag" TAB_VERB 2 0 "Posv Ueberwachung nicht freigegeben" 1 "Posv Ueberwachung freigegeben" DEFAULT_VALUE "" /end COMPU_VTAB
/begin COMPU_VTAB Conv.cItfInput._.fzg_rollverh_aktiv_stat_S5_S3 "Umrechnung fuer Messgroesse cItfInput::fzg_rollverh_aktiv_stat" TAB_VERB 3 0 "Signal o.K." 1 "Ersatzwert" 2 "Signal fehlerhaft" DEFAULT_VALUE "" /end COMPU_VTAB
/begin COMPU_VTAB Conv.cItfInput._.hdc_S5_S3 "Umrechnung fuer Messgroesse cItfInput::hdc" TAB_VERB 8 0 "HDC aus - nicht eingeschaltet" 1 "gesperrt  nicht im korrekten Gang" 2 "gesperrt nicht im unteren Gangbereich - falls vorhanden" 3 "aufgrund zu hoher Geschwindigkeit gesperrt" 4 "inaktiv vorübergehend" 5 "freigegeben aber nicht aktiv keine Gefällefahrt" 6 "aktiv - freigegeben und Gefällefahrt Kombiinstrument lässt Lampe blinken." 7 "HDC-Fehler" DEFAULT_VALUE "" /end COMPU_VTAB
/begin COMPU_VTAB Conv.cItfInput._.hillhold_aktiv_S5_S3 "Umrechnung fuer Messgroesse cItfInput::hillhold_aktiv" TAB_VERB 2 0 "FALSE" 1 "TRUE" DEFAULT_VALUE "" /end COMPU_VTAB
/begin COMPU_VTAB Conv.cItfInput._.hyd_notlauf_S5_S3 "Umrechnung fuer Messgroesse cItfInput::hyd_notlauf" TAB_VERB 2 0 "kein hyd. Notlauf" 1 "hyd. Notlauf inkl simulierter NL" DEFAULT_VALUE "" /end COMPU_VTAB
/begin COMPU_VTAB Conv.cItfInput._.i_min_ausser_parksperre_S5_S3 "Umrechnung fuer Messgroesse cItfInput::i_min_ausser_parksperre" TAB_VERB 2 0 "Keine Minimalbestromung EDS1-6 und MV1-2" 1 "Minimalbestromung EDS1-6 und MV1-2" DEFAULT_VALUE "" /end COMPU_VTAB
/begin COMPU_VTAB Conv.cItfInput._.iae_req_subst_S5_S3 "Umrechnung fuer Messgroesse cItfInput::iae_req_subst" TAB_VERB 2 0 "Keine Überanpressung für IAE angefordert" 1 "Überanpressung für IAE angefordert" DEFAULT_VALUE "" /end COMPU_VTAB
/begin COMPU_VTAB Conv.cItfInput._.iep_soll_has_S5_S3 "Umrechnung fuer Messgroesse cItfInput::iep_soll_has" TAB_VERB 5 0 "keine Vorgabe" 1 "iep Aus" 2 "Leistungs Punkt 1 angefordert" 3 "Leistungs Punkt 2 angefordert" 4 "Leistungs Punkt 3 angefordert" DEFAULT_VALUE "" /end COMPU_VTAB
/begin COMPU_VTAB Conv.cItfInput._.iep_soll_sab_S5_S3 "Umrechnung fuer Messgroesse cItfInput::iep_soll_sab" TAB_VERB 5 0 "keine Vorgabe" 1 "iep Aus" 2 "Leistungs Punkt 1 angefordert" 3 "Leistungs Punkt 2 angefordert" 4 "Leistungs Punkt 3 angefordert" DEFAULT_VALUE "" /end COMPU_VTAB
/begin COMPU_VTAB Conv.cItfInput._.iep_soll_tes_S5_S3 "Umrechnung fuer Messgroesse cItfInput::iep_soll_tes" TAB_VERB 4 0 "keine Vorgabe" 1 "Leistungspunkt 1" 2 "Leistungspunkt 2" 3 "Leistungspunkt 3" DEFAULT_VALUE "" /end COMPU_VTAB
/begin COMPU_VTAB Conv.cItfInput._.init_n_abneu_gef_S5_S3 "Umrechnung fuer Messgroesse cItfInput::init_n_abneu_gef" TAB_VERB 2 0 "FALSE" 1 "TRUE" DEFAULT_VALUE "" /end COMPU_VTAB
/begin COMPU_VTAB Conv.cItfInput._.init_n_t_S5_S3 "Umrechnung fuer Messgroesse cItfInput::init_n_t" TAB_VERB 2 0 "FALSE" 1 "TRUE" DEFAULT_VALUE "" /end COMPU_VTAB
/begin COMPU_VTAB Conv.cItfInput._.iv_abs_reg_S5_S3 "Umrechnung fuer Messgroesse cItfInput::iv_abs_reg" TAB_VERB 2 0 "ABS aus" 1 "ABS reglet" DEFAULT_VALUE "" /end COMPU_VTAB
/begin COMPU_VTAB Conv.cItfInput._.iv_abs_reg_status_S5_S3 "Umrechnung fuer Messgroesse cItfInput::iv_abs_reg_status" TAB_VERB 3 0 "Signal o.K." 1 "Ersatzwert" 2 "Signal fehlerhaft" DEFAULT_VALUE "" /end COMPU_VTAB
/begin COMPU_VTAB Conv.cItfInput._.iv_ags_zka_index_S5_S3 "Umrechnung fuer Messgroesse cItfInput::iv_ags_zka_index" TAB_VERB 2 0 "keinen Momentennachfuehrung" 1 "Momentennachfuehrung" DEFAULT_VALUE "" /end COMPU_VTAB
/begin COMPU_VTAB Conv.cItfInput._.iv_anhaengeraktiv_S5_S3 "Umrechnung fuer Messgroesse cItfInput::iv_anhaengeraktiv" TAB_VERB 2 0 "Kein Anhaengerbetrieb" 1 "Anhaengerbetrieb" DEFAULT_VALUE "" /end COMPU_VTAB
/begin COMPU_VTAB Conv.cItfInput._.iv_ascpas_S5_S3 "Umrechnung fuer Messgroesse cItfInput::iv_ascpas" TAB_VERB 2 0 "ASC funktional nicht abgeschaltet" 1 "ASC funktional abgeschaltet" DEFAULT_VALUE "" /end COMPU_VTAB
/begin COMPU_VTAB Conv.cItfInput._.iv_ascreg_S5_S3 "Umrechnung fuer Messgroesse cItfInput::iv_ascreg" TAB_VERB 2 0 "ASC regelt nicht" 1 "ASC regelt" DEFAULT_VALUE "" /end COMPU_VTAB
/begin COMPU_VTAB Conv.cItfInput._.iv_ax_ref_status_S5_S3 "Umrechnung fuer Messgroesse cItfInput::iv_ax_ref_status" TAB_VERB 3 0 "Signal o.K." 1 "Ersatzwert" 2 "Signal fehlerhaft" DEFAULT_VALUE "" /end COMPU_VTAB
/begin COMPU_VTAB Conv.cItfInput._.iv_blsdefakt_S5_S3 "Umrechnung fuer Messgroesse cItfInput::iv_blsdefakt" TAB_VERB 2 0 "Bremslicht aus" 1 "Bremslicht ein" DEFAULT_VALUE "" /end COMPU_VTAB
/begin COMPU_VTAB Conv.cItfInput._.iv_blsdefpas_S5_S3 "Umrechnung fuer Messgroesse cItfInput::iv_blsdefpas" TAB_VERB 2 0 "Bremslicht aus" 1 "Bremslicht ein" DEFAULT_VALUE "" /end COMPU_VTAB
/begin COMPU_VTAB Conv.cItfInput._.iv_blsstatus_S5_S3 "Umrechnung fuer Messgroesse cItfInput::iv_blsstatus" TAB_VERB 3 0 "Signal o.K." 1 "Ersatzwert" 2 "Signal fehlerhaft" DEFAULT_VALUE "" /end COMPU_VTAB
/begin COMPU_VTAB Conv.cItfInput._.iv_cgetrstatus_S5_S3 "Umrechnung fuer Messgroesse cItfInput::iv_cgetrstatus" TAB_VERB 3 0 "Signal o.K." 1 "Ersatzwert" 2 "Signal fehlerhaft" DEFAULT_VALUE "" /end COMPU_VTAB
/begin COMPU_VTAB Conv.cItfInput._.iv_druck_vorhanden_mod_S5_S3 "Umrechnung fuer Messgroesse cItfInput::iv_druck_vorhanden_mod" TAB_VERB 2 0 "keine Modifikation" 1 "Modifikation aktiv" DEFAULT_VALUE "" /end COMPU_VTAB
/begin COMPU_VTAB Conv.cItfInput._.iv_edsmversatzinfo_S5_S3 "Umrechnung fuer Messgroesse cItfInput::iv_edsmversatzinfo" TAB_VERB 8 0 "keine edsmv_ersatzinfo" 1 "GRAUS -vorbelegt fuer MECH_NOTLAUF- nur HSS1 aus" 2 "LOWSIDE-OFF -vorbelegt fuer LOWSIDEOFF-" 3 "nicht belegt war mal EL_SIM_NL in der 53 Umsschaltphase" 4 "nicht belegt war mal EL_SIM_NL" 5 "nicht belegt war mal Sonderbestromung Notlauf 2" 6 "nicht relevant fuer ATSYS" 7 "HSS1 und HSS2 aus" DEFAULT_VALUE "" /end COMPU_VTAB
/begin COMPU_VTAB Conv.cItfInput._.iv_f_iep_shutdown_S5_S3 "Umrechnung fuer Messgroesse cItfInput::iv_f_iep_shutdown" TAB_VERB 2 0 "normaler Betrieb" 1 "Abschaltbedingungn erfuelt" DEFAULT_VALUE "" /end COMPU_VTAB
/begin COMPU_VTAB Conv.cItfInput._.iv_fahrbet_task_S5_S3 "Umrechnung fuer Messgroesse cItfInput::iv_fahrbet_task" TAB_VERB 2 0 "Fahrbetiebstask nicht aktiv" 1 "Fahrbetriebstask aktiv" DEFAULT_VALUE "" /end COMPU_VTAB
/begin COMPU_VTAB Conv.cItfInput._.iv_feststellbremseaktiv_S5_S3 "Umrechnung fuer Messgroesse cItfInput::iv_feststellbremseaktiv" TAB_VERB 2 0 "Feststellbremse nicht angezogen" 1 "Feststellbremse angezogen" DEFAULT_VALUE "" /end COMPU_VTAB
/begin COMPU_VTAB Conv.cItfInput._.iv_fet0_active_S5_S3 "Umrechnung fuer Messgroesse cItfInput::iv_fet0_active" TAB_VERB 5 0 "FET0 in Sollzustand abgeschaltet" 1 "FET0 in Sollzustand eingeschaltet" 2 "FET0 aufgrund Fehler abgeschaltet" 3 "FET0 wird durch HW Software getestet" 4 "FET0 wegen Unterspannung abgeschaltet" DEFAULT_VALUE "" /end COMPU_VTAB
/begin COMPU_VTAB Conv.cItfInput._.iv_fl_brake_inter_status_S5_S3 "Umrechnung fuer Messgroesse cItfInput::iv_fl_brake_inter_status" TAB_VERB 3 0 "Signal o.K." 1 "Ersatzwert" 2 "Signal fehlerhaft" DEFAULT_VALUE "" /end COMPU_VTAB
/begin COMPU_VTAB Conv.cItfInput._.iv_flag_m_max_has_iae_S5_S3 "Umrechnung fuer Messgroesse cItfInput::iv_flag_m_max_has_iae" TAB_VERB 2 0 "Keine Begrenzung des IAE Moments" 1 "Begrenzung des IAE Moments" DEFAULT_VALUE "" /end COMPU_VTAB
/begin COMPU_VTAB Conv.cItfInput._.iv_flag_p_hys_k0_has_S5_S3 "Umrechnung fuer Messgroesse cItfInput::iv_flag_p_hys_k0_has" TAB_VERB 2 0 "Druckanteil p_hys_k0 inaktiv" 1 "Druckanteil p_hys_k0 inaktiv" DEFAULT_VALUE "" /end COMPU_VTAB
/begin COMPU_VTAB Conv.cItfInput._.iv_flag_partfilt_aktiv_S5_S3 "Umrechnung fuer Messgroesse cItfInput::iv_flag_partfilt_aktiv" TAB_VERB 2 0 "keine Regeneration" 1 "Regenertation aktiv" DEFAULT_VALUE "" /end COMPU_VTAB
/begin COMPU_VTAB Conv.cItfInput._.iv_freigabe_posvdiag_S5_S3 "Umrechnung fuer Messgroesse cItfInput::iv_freigabe_posvdiag" TAB_VERB 2 0 "Posv Ueberwachung nicht freigegeben" 1 "Posv Ueberwachung freigegeben" DEFAULT_VALUE "" /end COMPU_VTAB
/begin COMPU_VTAB Conv.cItfInput._.iv_fzg_rollverh_aktiv_stat_S5_S3 "Umrechnung fuer Messgroesse cItfInput::iv_fzg_rollverh_aktiv_stat" TAB_VERB 3 0 "Signal o.K." 1 "Ersatzwert" 2 "Signal fehlerhaft" DEFAULT_VALUE "" /end COMPU_VTAB
/begin COMPU_VTAB Conv.cItfInput._.iv_gnotinfo_S5_S3 "Umrechnung fuer Messgroesse cItfInput::iv_gnotinfo" TAB_VERB 41 0 "kein Notgang" 1 "modulierter UWIG-Ersatzgang" 2 "S/W UWIG-Ersatzgang" 3 "Gang halten" 4 "Gang halten mit aktivem Zwangsneutral - nur in Verbindung mit ENPGx" 5 "nicht belegt war mal G5FIX" 6 "mechanischer NOTLAUF" 7 "nur Gaenge 1 oder 2" 8 "bed. NP" 9 "ENP 5. moduliert" 10 "ENP 4. moduliert" 11 "nicht belegt war mal G3FIX" 12 "nicht belegt war mal BENP3" 13 "nicht belegt war mal BENP4" 14 "nicht belegt war mal BENP1" 15 "nicht belegt war mal BENP2" 16 "ENP 3. oder 5. Gang und Bed. nicht erfuellt vorbelegt" 17 "ENP 3. oder 5. Gang und Bed. erfuellt vorbelegt" 18 "vorbelegt" 19 "nur Gaenge 1 2 oder 3" 20 "vorbelegt" 21 "nur 1. Gang" 22 "Zwangsneutral fuer MV2 fehler" 23 "ENPG5 mit aktivem Zwangsneutral" 24 "ENPG35 3. Gang mit aktivem Zwangsneutral" 25 "ENPG35 5. Gang mit aktivem Zwangsneutral" 26 "LOW-SIDE-OFF 3/5. Gang wie mech Notlauf" 27 "ENPG2 mit aktivem Zwangsneutral" 28 "ENPG3 mit aktivem Zwangsneutral" 29 "ENPG4 mit aktivem Zwangsneutral" 30 "ENPG6 mit aktivem Zwangsneutral" 31 "ENPG2 ohne aktivem Zwangsneutral" 32 "ENPG3 ohne aktivem Zwangsneutral" 33 "ENPG4 ohne aktivem Zwangsneutral" 34 "ENPG6 ohne aktivem Zwangsneutral" 35 "ENPG1 mit aktivem Zwangsneutral" 36 "ENPG1 ohne aktivem Zwangsneutral" 37 "ENPG7 mit aktivem Zwangsneutral" 38 "ENPG7 ohne aktivem Zwangsneutral" 39 "ENPG8 mit aktivem Zwangsneutral" 40 "ENPG8 ohne aktivem Zwangsneutral" DEFAULT_VALUE "" /end COMPU_VTAB
/begin COMPU_VTAB Conv.cItfInput._.iv_gsoll_S5_S3 "Umrechnung fuer Messgroesse cItfInput::iv_gsoll" TAB_VERB 10 -1 "GR1" 0 "KEIN_GANG" 1 "G1" 2 "G2" 3 "G3" 4 "G4" 5 "G5" 6 "G6" 7 "G7" 8 "G8" DEFAULT_VALUE "" /end COMPU_VTAB
/begin COMPU_VTAB Conv.cItfInput._.iv_hdc_S5_S3 "Umrechnung fuer Messgroesse cItfInput::iv_hdc" TAB_VERB 8 0 "HDC aus - nicht eingeschaltet" 1 "gesperrt  nicht im korrekten Gang" 2 "gesperrt nicht im unteren Gangbereich - falls vorhanden" 3 "aufgrund zu hoher Geschwindigkeit gesperrt" 4 "inaktiv vorübergehend" 5 "freigegeben aber nicht aktiv keine Gefällefahrt" 6 "aktiv - freigegeben und Gefällefahrt Kombiinstrument lässt Lampe blinken." 7 "HDC-Fehler" DEFAULT_VALUE "" /end COMPU_VTAB
/begin COMPU_VTAB Conv.cItfInput._.iv_iae_req_subst_S5_S3 "Umrechnung fuer Messgroesse cItfInput::iv_iae_req_subst" TAB_VERB 2 0 "Keine Überanpressung für IAE angefordert" 1 "Überanpressung für IAE angefordert" DEFAULT_VALUE "" /end COMPU_VTAB
/begin COMPU_VTAB Conv.cItfInput._.iv_iep_soll_has_S5_S3 "Umrechnung fuer Messgroesse cItfInput::iv_iep_soll_has" TAB_VERB 5 0 "keine Vorgabe" 1 "iep Aus" 2 "Leistungs Punkt 1 angefordert" 3 "Leistungs Punkt 2 angefordert" 4 "Leistungs Punkt 3 angefordert" DEFAULT_VALUE "" /end COMPU_VTAB
/begin COMPU_VTAB Conv.cItfInput._.iv_iep_soll_sab_S5_S3 "Umrechnung fuer Messgroesse cItfInput::iv_iep_soll_sab" TAB_VERB 5 0 "keine Vorgabe" 1 "iep Aus" 2 "Leistungs Punkt 1 angefordert" 3 "Leistungs Punkt 2 angefordert" 4 "Leistungs Punkt 3 angefordert" DEFAULT_VALUE "" /end COMPU_VTAB
/begin COMPU_VTAB Conv.cItfInput._.iv_iep_soll_tes_S5_S3 "Umrechnung fuer Messgroesse cItfInput::iv_iep_soll_tes" TAB_VERB 4 0 "keine Vorgabe" 1 "Leistungspunkt 1" 2 "Leistungspunkt 2" 3 "Leistungspunkt 3" DEFAULT_VALUE "" /end COMPU_VTAB
/begin COMPU_VTAB Conv.cItfInput._.iv_k0_soll_S5_S3 "Umrechnung fuer Messgroesse cItfInput::iv_k0_soll" TAB_VERB 6 0 "K0 Oeffnen" 1 "K0 Befuellen" 2 "K0 Druckstellung" 3 "K0 Schlupfgeregelt" 4 "K0 Geregelt geschlossen" 5 "K0 Geschlossen" DEFAULT_VALUE "" /end COMPU_VTAB
/begin COMPU_VTAB Conv.cItfInput._.iv_ll_mot_aktiv_status_S5_S3 "Umrechnung fuer Messgroesse cItfInput::iv_ll_mot_aktiv_status" TAB_VERB 3 0 "Signal o.K." 1 "Ersatzwert" 2 "Signal fehlerhaft" DEFAULT_VALUE "" /end COMPU_VTAB
/begin COMPU_VTAB Conv.cItfInput._.iv_m_motsoll_mod_status_S5_S3 "Umrechnung fuer Messgroesse cItfInput::iv_m_motsoll_mod_status" TAB_VERB 3 0 "Signal o.K." 1 "Ersatzwert" 2 "Signal fehlerhaft" DEFAULT_VALUE "" /end COMPU_VTAB
/begin COMPU_VTAB Conv.cItfInput._.iv_mmotstatus_S5_S3 "Umrechnung fuer Messgroesse cItfInput::iv_mmotstatus" TAB_VERB 3 0 "Signal o.K." 1 "Ersatzwert" 2 "Signal fehlerhaft" DEFAULT_VALUE "" /end COMPU_VTAB
/begin COMPU_VTAB Conv.cItfInput._.iv_mvg_vm_start_S5_S3 "Umrechnung fuer Messgroesse cItfInput::iv_mvg_vm_start" TAB_VERB 9 0 "kein Start der VM" 1 "Startart 1 der VM" 2 "Startart 2 der VM" 3 "Startart 3 der VM" 4 "Startart 4 der VM" 5 "Startart 5 der VM" 6 "Startart 6 der VM" 7 "Startart 7 der VM" 8 "Startart 8 der VM" DEFAULT_VALUE "" /end COMPU_VTAB
/begin COMPU_VTAB Conv.cItfInput._.iv_n_ab_dir_S5_S3 "Umrechnung fuer Messgroesse cItfInput::iv_n_ab_dir" TAB_VERB 3 0 "Drehrichtung unbestimmt" 1 "Drehrichtung vorwaerts" 2 "Drehrichtung rueckwaerts" DEFAULT_VALUE "" /end COMPU_VTAB
/begin COMPU_VTAB Conv.cItfInput._.iv_n_ab_dir_status_S5_S3 "Umrechnung fuer Messgroesse cItfInput::iv_n_ab_dir_status" TAB_VERB 3 0 "Signal o.K." 1 "Ersatzwert" 2 "Signal fehlerhaft" DEFAULT_VALUE "" /end COMPU_VTAB
/begin COMPU_VTAB Conv.cItfInput._.iv_n_t_dir_S5_S3 "Umrechnung fuer Messgroesse cItfInput::iv_n_t_dir" TAB_VERB 3 0 "Drehrichtung unbestimmt" 1 "Drehrichtung Pumpe Turbine gleichsinnig" 2 "Drehrichtung Pumpe Turbine ungleichsinnig" DEFAULT_VALUE "" /end COMPU_VTAB
/begin COMPU_VTAB Conv.cItfInput._.iv_n_t_dir_status_S5_S3 "Umrechnung fuer Messgroesse cItfInput::iv_n_t_dir_status" TAB_VERB 3 0 "Signal o.K." 1 "Ersatzwert" 2 "Signal fehlerhaft" DEFAULT_VALUE "" /end COMPU_VTAB
/begin COMPU_VTAB Conv.cItfInput._.iv_n_vm_status_S5_S3 "Umrechnung fuer Messgroesse cItfInput::iv_n_vm_status" TAB_VERB 3 0 "Signal o.K." 1 "Ersatzwert" 2 "Signal fehlerhaft" DEFAULT_VALUE "" /end COMPU_VTAB
/begin COMPU_VTAB Conv.cItfInput._.iv_nabstatus_S5_S3 "Umrechnung fuer Messgroesse cItfInput::iv_nabstatus" TAB_VERB 3 0 "Signal o.K." 1 "Ersatzwert" 2 "Signal fehlerhaft" DEFAULT_VALUE "" /end COMPU_VTAB
/begin COMPU_VTAB Conv.cItfInput._.iv_neigungstatus_S5_S3 "Umrechnung fuer Messgroesse cItfInput::iv_neigungstatus" TAB_VERB 3 0 "Signal o.K." 1 "Ersatzwert" 2 "Signal fehlerhaft" DEFAULT_VALUE "" /end COMPU_VTAB
/begin COMPU_VTAB Conv.cItfInput._.iv_nmotstatus_S5_S3 "Umrechnung fuer Messgroesse cItfInput::iv_nmotstatus" TAB_VERB 3 0 "Signal o.K." 1 "Ersatzwert" 2 "Signal fehlerhaft" DEFAULT_VALUE "" /end COMPU_VTAB
/begin COMPU_VTAB Conv.cItfInput._.iv_notltask_S5_S3 "Umrechnung fuer Messgroesse cItfInput::iv_notltask" TAB_VERB 2 0 "Notlauftask nicht aktiv" 1 "Notlauftask aktiv" DEFAULT_VALUE "" /end COMPU_VTAB
/begin COMPU_VTAB Conv.cItfInput._.iv_ntstatus_S5_S3 "Umrechnung fuer Messgroesse cItfInput::iv_ntstatus" TAB_VERB 3 0 "Signal o.K." 1 "Ersatzwert" 2 "Signal fehlerhaft" DEFAULT_VALUE "" /end COMPU_VTAB
/begin COMPU_VTAB Conv.cItfInput._.iv_ntu_virt_dir_S5_S3 "Umrechnung fuer Messgroesse cItfInput::iv_ntu_virt_dir" TAB_VERB 3 0 "Drehrichtung unbestimmt" 1 "Drehrichtung Pumpe Turbine gleichsinnig" 2 "Drehrichtung Pumpe Turbine ungleichsinnig" DEFAULT_VALUE "" /end COMPU_VTAB
/begin COMPU_VTAB Conv.cItfInput._.iv_ntu_virt_dir_status_S5_S3 "Umrechnung fuer Messgroesse cItfInput::iv_ntu_virt_dir_status" TAB_VERB 3 0 "Signal o.K." 1 "Ersatzwert" 2 "Signal fehlerhaft" DEFAULT_VALUE "" /end COMPU_VTAB
/begin COMPU_VTAB Conv.cItfInput._.iv_pos_S5_S3 "Umrechnung fuer Messgroesse cItfInput::iv_pos" TAB_VERB 9 0 "Pos. 1" 1 "Pos. 2" 2 "Pos. 3" 3 "Pos. 4" 4 "Pos. 5" 5 "Pos. D" 6 "Pos. N" 7 "Pos. R" 8 "Pos. P" DEFAULT_VALUE "" /end COMPU_VTAB
/begin COMPU_VTAB Conv.cItfInput._.iv_posstatus_S5_S3 "Umrechnung fuer Messgroesse cItfInput::iv_posstatus" TAB_VERB 3 0 "Signal o.K." 1 "Ersatzwert" 2 "Signal fehlerhaft" DEFAULT_VALUE "" /end COMPU_VTAB
/begin COMPU_VTAB Conv.cItfInput._.iv_pt_damping_active_S5_S3 "Umrechnung fuer Messgroesse cItfInput::iv_pt_damping_active" TAB_VERB 2 0 "damping Power train not active" 1 "damping Power train active" DEFAULT_VALUE "" /end COMPU_VTAB
/begin COMPU_VTAB Conv.cItfInput._.iv_saf_has_aktiv_S5_S3 "Umrechnung fuer Messgroesse cItfInput::iv_saf_has_aktiv" TAB_VERB 2 0 "keine Schaltanforderungt" 1 "Schaltanforderung" DEFAULT_VALUE "" /end COMPU_VTAB
/begin COMPU_VTAB Conv.cItfInput._.iv_sbytask_S5_S3 "Umrechnung fuer Messgroesse cItfInput::iv_sbytask" TAB_VERB 2 0 "Standbytask nicht aktiv" 1 "Standbytask aktiv" DEFAULT_VALUE "" /end COMPU_VTAB
/begin COMPU_VTAB Conv.cItfInput._.iv_schluesselstart_aktiv_S5_S3 "Umrechnung fuer Messgroesse cItfInput::iv_schluesselstart_aktiv" TAB_VERB 2 0 "keine Schluesselstart" 1 "Schluesselstart" DEFAULT_VALUE "" /end COMPU_VTAB
/begin COMPU_VTAB Conv.cItfInput._.iv_status_has_S5_S3 "Umrechnung fuer Messgroesse cItfInput::iv_status_has" TAB_VERB 16 0 "kein Ablauf aktiv" 1 "normaler Ablauf" 2 "normaler Ablauf" 3 "normaler Ablauf" 4 "normaler Ablauf" 5 "normaler Ablauf" 6 "normaler Ablauf" 7 "normaler Ablauf" 8 "Ende normaler Ablauf" 9 "Abbruch aktiv" 10 "Abbruch aktiv" 11 "Abbruch aktiv" 12 "Abbruch aktiv" 13 "Abbruch aktiv" 14 "Abbruch abgeschlossen" 15 "Sprunganf. bei aufgetretenem Fehler" DEFAULT_VALUE "" /end COMPU_VTAB
/begin COMPU_VTAB Conv.cItfInput._.iv_status_n_haltephase_S5_S3 "Umrechnung fuer Messgroesse cItfInput::iv_status_n_haltephase" TAB_VERB 6 0 "HoldN Function not active" 1 "Entrance into HoldN Function" 2 "HoldN Function active" 3 "HoldN Function active (end)" 6 "HoldN Functon interrupted" 7 "Restart of HoldN Function" DEFAULT_VALUE "" /end COMPU_VTAB
/begin COMPU_VTAB Conv.cItfInput._.iv_svh_aktiv_has_S5_S3 "Umrechnung fuer Messgroesse cItfInput::iv_svh_aktiv_has" TAB_VERB 2 0 "keine Schaltverhinderung" 1 "Schaltverhinderung aktiv" DEFAULT_VALUE "" /end COMPU_VTAB
/begin COMPU_VTAB Conv.cItfInput._.iv_verbot_sas_fkt_S5_S3 "Umrechnung fuer Messgroesse cItfInput::iv_verbot_sas_fkt" TAB_VERB 2 0 "kein Verbot der GLS-Funktionen" 1 "Verbot der GLS-Funktionen" DEFAULT_VALUE "" /end COMPU_VTAB
/begin COMPU_VTAB Conv.cItfInput._.iv_z_k0_befuellopt_S5_S3 "Umrechnung fuer Messgroesse cItfInput::iv_z_k0_befuellopt" TAB_VERB 3 0 "normale Befuellung K0" 1 "optimierte Befuellung K0" 2 "reduzierte Befuellung K0" DEFAULT_VALUE "" /end COMPU_VTAB
/begin COMPU_VTAB Conv.cItfInput._.iv_z_k0_soll_subst_S5_S3 "Umrechnung fuer Messgroesse cItfInput::iv_z_k0_soll_subst" TAB_VERB 4 0 "Keine Anforderung aus der Diagnose - K0 Normalbetrieb" 1 "k0_soll_gepr = 5 (GESCHLOSSEN)" 2 "k0_soll_gepr = 0 (OEFFNENSW)" 3 "k0_soll_gepr = 6 (GESCHLOSSENALT)" DEFAULT_VALUE "" /end COMPU_VTAB
/begin COMPU_VTAB Conv.cItfInput._.iv_z_modus_iae_S5_S3 "Umrechnung fuer Messgroesse cItfInput::iv_z_modus_iae" TAB_VERB 3 0 "E-Anfahren mit Schlupf" 1 "E-Anfahren geschlossen" 2 "Hybrid-Anfahren" DEFAULT_VALUE "" /end COMPU_VTAB
/begin COMPU_VTAB Conv.cItfInput._.iv_zzuendung_S5_S3 "Umrechnung fuer Messgroesse cItfInput::iv_zzuendung" TAB_VERB 5 0 "undefiniert" 1 "Zuendung aus->ein" 2 "Zuendung ein" 3 "Zuendung ein->aus" 4 "Zuendung aus" DEFAULT_VALUE "" /end COMPU_VTAB
/begin COMPU_VTAB Conv.cItfInput._.k0_diag_moeglich_S5_S3 "Umrechnung fuer Messgroesse cItfInput::k0_diag_moeglich" TAB_VERB 2 0 "Signale fehlerhaft" 1 "Signale n_mot n_ab und m_mot ok" DEFAULT_VALUE "" /end COMPU_VTAB
/begin COMPU_VTAB Conv.cItfInput._.k0_soll_S5_S3 "Umrechnung fuer Messgroesse cItfInput::k0_soll" TAB_VERB 6 0 "K0 Oeffnen" 1 "K0 Befuellen" 2 "K0 Druckstellung" 3 "K0 Schlupfgeregelt" 4 "K0 Geregelt geschlossen" 5 "K0 Geschlossen" DEFAULT_VALUE "" /end COMPU_VTAB
/begin COMPU_VTAB Conv.cItfInput._.ll_mot_aktiv_status_S5_S3 "Umrechnung fuer Messgroesse cItfInput::ll_mot_aktiv_status" TAB_VERB 3 0 "Signal o.K." 1 "Ersatzwert" 2 "Signal fehlerhaft" DEFAULT_VALUE "" /end COMPU_VTAB
/begin COMPU_VTAB Conv.cItfInput._.m_mot_status_S5_S3 "Umrechnung fuer Messgroesse cItfInput::m_mot_status" TAB_VERB 3 0 "Signal o.K." 1 "Ersatzwert" 2 "Signal fehlerhaft" DEFAULT_VALUE "" /end COMPU_VTAB
/begin COMPU_VTAB Conv.cItfInput._.m_motsoll_mod_status_S5_S3 "Umrechnung fuer Messgroesse cItfInput::m_motsoll_mod_status" TAB_VERB 3 0 "Signal o.K." 1 "Ersatzwert" 2 "Signal fehlerhaft" DEFAULT_VALUE "" /end COMPU_VTAB
/begin COMPU_VTAB Conv.cItfInput._.manuell_S5_S3 "Umrechnung fuer Messgroesse cItfInput::manuell" TAB_VERB 2 0 "kein Steptronicbetrieb" 1 "Steptronicbetrieb" DEFAULT_VALUE "" /end COMPU_VTAB
/begin COMPU_VTAB Conv.cItfInput._.max_p_haupt_S5_S3 "Umrechnung fuer Messgroesse cItfInput::max_p_haupt" TAB_VERB 2 0 "Max. Hauptdruck nicht aktiv" 1 "Max. Hauptdruck aktiv" DEFAULT_VALUE "" /end COMPU_VTAB
/begin COMPU_VTAB Conv.cItfInput._.mvg_vm_start_S5_S3 "Umrechnung fuer Messgroesse cItfInput::mvg_vm_start" TAB_VERB 9 0 "kein Start der VM" 1 "Startart 1 der VM" 2 "Startart 2 der VM" 3 "Startart 3 der VM" 4 "Startart 4 der VM" 5 "Startart 5 der VM" 6 "Startart 6 der VM" 7 "Startart 7 der VM" 8 "Startart 8 der VM" DEFAULT_VALUE "" /end COMPU_VTAB
/begin COMPU_VTAB Conv.cItfInput._.n_ab_dir_S5_S3 "Umrechnung fuer Messgroesse cItfInput::n_ab_dir" TAB_VERB 2 -1 "Drehrichtung rueckwaerts" 1 "Drehrichtung vorwaerts" DEFAULT_VALUE "" /end COMPU_VTAB
/begin COMPU_VTAB Conv.cItfInput._.n_ab_dir_status_S5_S3 "Umrechnung fuer Messgroesse cItfInput::n_ab_dir_status" TAB_VERB 3 0 "Signal o.K." 1 "Ersatzwert" 2 "Signal fehlerhaft" DEFAULT_VALUE "" /end COMPU_VTAB
/begin COMPU_VTAB Conv.cItfInput._.n_ab_status_S5_S3 "Umrechnung fuer Messgroesse cItfInput::n_ab_status" TAB_VERB 3 0 "Signal o.K." 1 "Ersatzwert" 2 "Signal fehlerhaft" DEFAULT_VALUE "" /end COMPU_VTAB
/begin COMPU_VTAB Conv.cItfInput._.n_mot_status_S5_S3 "Umrechnung fuer Messgroesse cItfInput::n_mot_status" TAB_VERB 3 0 "Signal o.K." 1 "Ersatzwert" 2 "Signal fehlerhaft" DEFAULT_VALUE "" /end COMPU_VTAB
/begin COMPU_VTAB Conv.cItfInput._.n_t_dir_S5_S3 "Umrechnung fuer Messgroesse cItfInput::n_t_dir" TAB_VERB 2 -1 "Drehrichtung Pumpe Turbinde ungleichsinnig" 1 "Drehrichtung Pumpe Turbinde gleichsinnig" DEFAULT_VALUE "" /end COMPU_VTAB
/begin COMPU_VTAB Conv.cItfInput._.n_t_dir_status_S5_S3 "Umrechnung fuer Messgroesse cItfInput::n_t_dir_status" TAB_VERB 3 0 "Signal o.K." 1 "Ersatzwert" 2 "Signal fehlerhaft" DEFAULT_VALUE "" /end COMPU_VTAB
/begin COMPU_VTAB Conv.cItfInput._.n_t_status_S5_S3 "Umrechnung fuer Messgroesse cItfInput::n_t_status" TAB_VERB 3 0 "Signal o.K." 1 "Ersatzwert" 2 "Signal fehlerhaft" DEFAULT_VALUE "" /end COMPU_VTAB
/begin COMPU_VTAB Conv.cItfInput._.n_vm_status_S5_S3 "Umrechnung fuer Messgroesse cItfInput::n_vm_status" TAB_VERB 3 0 "Signal o.K." 1 "Ersatzwert" 2 "Signal fehlerhaft" DEFAULT_VALUE "" /end COMPU_VTAB
/begin COMPU_VTAB Conv.cItfInput._.neigung_status_S5_S3 "Umrechnung fuer Messgroesse cItfInput::neigung_status" TAB_VERB 3 0 "Signal o.K." 1 "Ersatzwert" 2 "Signal fehlerhaft" DEFAULT_VALUE "" /end COMPU_VTAB
/begin COMPU_VTAB Conv.cItfInput._.notgang_info_S5_S3 "Umrechnung fuer Messgroesse cItfInput::notgang_info" TAB_VERB 41 0 "kein Notgang" 1 "modulierter UWIG-Ersatzgang" 2 "S/W UWIG-Ersatzgang" 3 "Gang halten" 4 "Gang halten mit aktivem Zwangsneutral - nur in Verbindung mit ENPGx" 5 "nicht belegt war mal G5FIX" 6 "mechanischer NOTLAUF" 7 "nur Gaenge 1 oder 2" 8 "bed. NP" 9 "ENP 5. moduliert" 10 "ENP 4. moduliert" 11 "nicht belegt war mal G3FIX" 12 "nicht belegt war mal BENP3" 13 "nicht belegt war mal BENP4" 14 "nicht belegt war mal BENP1" 15 "nicht belegt war mal BENP2" 16 "ENP 3. oder 5. Gang und Bed. nicht erfuellt vorbelegt" 17 "ENP 3. oder 5. Gang und Bed. erfuellt vorbelegt" 18 "vorbelegt" 19 "nur Gaenge 1 2 oder 3" 20 "vorbelegt" 21 "nur 1. Gang" 22 "Zwangsneutral fuer MV2 fehler" 23 "ENPG5 mit aktivem Zwangsneutral" 24 "ENPG35 3. Gang mit aktivem Zwangsneutral" 25 "ENPG35 5. Gang mit aktivem Zwangsneutral" 26 "LOW-SIDE-OFF 3/5. Gang wie mech Notlauf" 27 "ENPG2 mit aktivem Zwangsneutral" 28 "ENPG3 mit aktivem Zwangsneutral" 29 "ENPG4 mit aktivem Zwangsneutral" 30 "ENPG6 mit aktivem Zwangsneutral" 31 "ENPG2 ohne aktivem Zwangsneutral" 32 "ENPG3 ohne aktivem Zwangsneutral" 33 "ENPG4 ohne aktivem Zwangsneutral" 34 "ENPG6 ohne aktivem Zwangsneutral" 35 "ENPG1 mit aktivem Zwangsneutral" 36 "ENPG1 ohne aktivem Zwangsneutral" 37 "ENPG7 mit aktivem Zwangsneutral" 38 "ENPG7 ohne aktivem Zwangsneutral" 39 "ENPG8 mit aktivem Zwangsneutral" 40 "ENPG8 ohne aktivem Zwangsneutral" DEFAULT_VALUE "" /end COMPU_VTAB
/begin COMPU_VTAB Conv.cItfInput._.notgang_S5_S3 "Umrechnung fuer Messgroesse cItfInput::notgang" TAB_VERB 10 -1 "GR1" 0 "KEIN_GANG" 1 "G1" 2 "G2" 3 "G3" 4 "G4" 5 "G5" 6 "G6" 7 "G7" 8 "G8" DEFAULT_VALUE "" /end COMPU_VTAB
/begin COMPU_VTAB Conv.cItfInput._.notlauf_S5_S3 "Umrechnung fuer Messgroesse cItfInput::notlauf" TAB_VERB 2 0 "Notlauftask nicht aktiv" 1 "Notlauftask aktiv" DEFAULT_VALUE "" /end COMPU_VTAB
/begin COMPU_VTAB Conv.cItfInput._.ntu_virt_dir_S5_S3 "Umrechnung fuer Messgroesse cItfInput::ntu_virt_dir" TAB_VERB 2 -1 "Drehrichtung Pumpe Turbinde ungleichsinnig" 1 "Drehrichtung Pumpe Turbinde gleichsinnig" DEFAULT_VALUE "" /end COMPU_VTAB
/begin COMPU_VTAB Conv.cItfInput._.ntu_virt_dir_status_S5_S3 "Umrechnung fuer Messgroesse cItfInput::ntu_virt_dir_status" TAB_VERB 3 0 "Signal o.K." 1 "Ersatzwert" 2 "Signal fehlerhaft" DEFAULT_VALUE "" /end COMPU_VTAB
/begin COMPU_VTAB Conv.cItfInput._.nullbestromung_aktiv_S5_S3 "Umrechnung fuer Messgroesse cItfInput::nullbestromung_aktiv" TAB_VERB 2 0 "Keine Nullbestromung (0mA) auf I_ABGESCHALTET" 1 "Nullbestromung (0mA) auf EDS1-6" DEFAULT_VALUE "" /end COMPU_VTAB
/begin COMPU_VTAB Conv.cItfInput._.pak_aktiv_S5_S3 "Umrechnung fuer Messgroesse cItfInput::pak_aktiv" TAB_VERB 2 0 "Task enthaelt keine PAK" 1 "Task benoetigt PAK" DEFAULT_VALUE "" /end COMPU_VTAB
/begin COMPU_VTAB Conv.cItfInput._.pos_S5_S3 "Umrechnung fuer Messgroesse cItfInput::pos" TAB_VERB 9 0 "Pos. 1" 1 "Pos. 2" 2 "Pos. 3" 3 "Pos. 4" 4 "Pos. 5" 5 "Pos. D" 6 "Pos. N" 7 "Pos. R" 8 "Pos. P" DEFAULT_VALUE "" /end COMPU_VTAB
/begin COMPU_VTAB Conv.cItfInput._.pos_status_S5_S3 "Umrechnung fuer Messgroesse cItfInput::pos_status" TAB_VERB 3 0 "Signal o.K." 1 "Ersatzwert" 2 "Signal fehlerhaft" DEFAULT_VALUE "" /end COMPU_VTAB
/begin COMPU_VTAB Conv.cItfInput._.pos_wunsch_S5_S3 "Umrechnung fuer Messgroesse cItfInput::pos_wunsch" TAB_VERB 9 0 "Pos. 1" 1 "Pos. 2" 2 "Pos. 3" 3 "Pos. 4" 4 "Pos. 5" 5 "Pos. D" 6 "Pos. N" 7 "Pos. R" 8 "Pos. P" DEFAULT_VALUE "" /end COMPU_VTAB
/begin COMPU_VTAB Conv.cItfInput._.pt_damping_active_S5_S3 "Umrechnung fuer Messgroesse cItfInput::pt_damping_active" TAB_VERB 2 0 "damping Power train not active" 1 "damping Power train active" DEFAULT_VALUE "" /end COMPU_VTAB
/begin COMPU_VTAB Conv.cItfInput._.pumpendruck_nicht_vorhanden_S5_S3 "Umrechnung fuer Messgroesse cItfInput::pumpendruck_nicht_vorhanden" TAB_VERB 2 0 "Pumpendruck eventuell vorhanden" 1 "Pumpendruck sicher nicht vorhanden" DEFAULT_VALUE "" /end COMPU_VTAB
/begin COMPU_VTAB Conv.cItfInput._.pumpendruck_vorhanden_S5_S3 "Umrechnung fuer Messgroesse cItfInput::pumpendruck_vorhanden" TAB_VERB 2 0 "Event. kein Pumpendruck vorhanden" 1 "Pumpendruck sicher vorhanden" DEFAULT_VALUE "" /end COMPU_VTAB
/begin COMPU_VTAB Conv.cItfInput._.saf_has_aktiv_S5_S3 "Umrechnung fuer Messgroesse cItfInput::saf_has_aktiv" TAB_VERB 2 0 "keine Schaltanforderung HAS" 1 "Schaltanforderung HAS" DEFAULT_VALUE "" /end COMPU_VTAB
/begin COMPU_VTAB Conv.cItfInput._.schluesselstart_aktiv_S5_S3 "Umrechnung fuer Messgroesse cItfInput::schluesselstart_aktiv" TAB_VERB 2 0 "keine Schluesselstart (Standard)" 1 "Schluesselstart (Prio K0)" DEFAULT_VALUE "" /end COMPU_VTAB
/begin COMPU_VTAB Conv.cItfInput._.sollgang_S5_S3 "Umrechnung fuer Messgroesse cItfInput::sollgang" TAB_VERB 10 -1 "GR1" 0 "KEIN_GANG" 1 "G1" 2 "G2" 3 "G3" 4 "G4" 5 "G5" 6 "G6" 7 "G7" 8 "G8" DEFAULT_VALUE "" /end COMPU_VTAB
/begin COMPU_VTAB Conv.cItfInput._.standby_S5_S3 "Umrechnung fuer Messgroesse cItfInput::standby" TAB_VERB 2 0 "Standbytask nicht aktiv" 1 "Standbytask aktiv" DEFAULT_VALUE "" /end COMPU_VTAB
/begin COMPU_VTAB Conv.cItfInput._.status_has_S5_S3 "Umrechnung fuer Messgroesse cItfInput::status_has" TAB_VERB 16 0 "kein Ablauf aktiv" 1 "normaler Ablauf" 2 "normaler Ablauf" 3 "normaler Ablauf" 4 "normaler Ablauf" 5 "normaler Ablauf" 6 "normaler Ablauf" 7 "normaler Ablauf" 8 "Ende normaler Ablauf" 9 "Abbruch aktiv" 10 "Abbruch aktiv" 11 "Abbruch aktiv" 12 "Abbruch aktiv" 13 "Abbruch aktiv" 14 "Abbruch abgeschlossen" 15 "Sprunganf. bei aufgetretenem Fehler" DEFAULT_VALUE "" /end COMPU_VTAB
/begin COMPU_VTAB Conv.cItfInput._.status_n_haltephase_S5_S3 "Umrechnung fuer Messgroesse cItfInput::status_n_haltephase" TAB_VERB 6 0 "HoldN Function not active" 1 "Entrance into HoldN Function" 2 "HoldN Function active" 3 "HoldN Function active (end)" 6 "HoldN Functon interrupted" 7 "Restart of HoldN Function" DEFAULT_VALUE "" /end COMPU_VTAB
/begin COMPU_VTAB Conv.cItfInput._.stromlos_ausser_ps_S5_S3 "Umrechnung fuer Messgroesse cItfInput::stromlos_ausser_ps" TAB_VERB 2 0 "Endstufe nicht stromlos" 1 "Endstufen stromlos" DEFAULT_VALUE "" /end COMPU_VTAB
/begin COMPU_VTAB Conv.cItfInput._.stromlos_ges_S5_S3 "Umrechnung fuer Messgroesse cItfInput::stromlos_ges" TAB_VERB 2 0 "Endstufe nicht stromlos" 1 "Endstufen stromlos" DEFAULT_VALUE "" /end COMPU_VTAB
/begin COMPU_VTAB Conv.cItfInput._.stromlos_ps_S5_S3 "Umrechnung fuer Messgroesse cItfInput::stromlos_ps" TAB_VERB 2 0 "Endstufe nicht stromlos" 1 "Endstufen stromlos" DEFAULT_VALUE "" /end COMPU_VTAB
/begin COMPU_VTAB Conv.cItfInput._.svh_aktiv_has_S5_S3 "Umrechnung fuer Messgroesse cItfInput::svh_aktiv_has" TAB_VERB 2 0 "keine Schaltverhinderung" 1 "Schaltverhinderung aktiv" DEFAULT_VALUE "" /end COMPU_VTAB
/begin COMPU_VTAB Conv.cItfInput._.verbot_sas_fkt_S5_S3 "Umrechnung fuer Messgroesse cItfInput::verbot_sas_fkt" TAB_VERB 2 0 "kein Verbot der SAS Funktionen" 1 "Verbot der SAS Funktionen" DEFAULT_VALUE "" /end COMPU_VTAB
/begin COMPU_VTAB Conv.cItfInput._.z_k0_befuellopt_S5_S3 "Umrechnung fuer Messgroesse cItfInput::z_k0_befuellopt" TAB_VERB 3 0 "normale Befuellung K0" 1 "optimierte Befuellung K0" 2 "reduzierte Befuellung K0" DEFAULT_VALUE "" /end COMPU_VTAB
/begin COMPU_VTAB Conv.cItfInput._.z_k0_soll_subst_S5_S3 "Umrechnung fuer Messgroesse cItfInput::z_k0_soll_subst" TAB_VERB 4 0 "Keine Anforderung aus der Diagnose - K0 Normalbetrieb" 1 "k0_soll_gepr = 5 (GESCHLOSSEN)" 2 "k0_soll_gepr = 0 (OEFFNENSW)" 3 "k0_soll_gepr = 6 (GESCHLOSSENALT)" DEFAULT_VALUE "" /end COMPU_VTAB
/begin COMPU_VTAB Conv.cItfInput._.z_modus_iae_S5_S3 "Umrechnung fuer Messgroesse cItfInput::z_modus_iae" TAB_VERB 3 0 "E-Anfahren mit Schlupf" 1 "E-Anfahren geschlossen" 2 "Hybrid-Anfahren" DEFAULT_VALUE "" /end COMPU_VTAB
/begin COMPU_VTAB Conv.cItfInput._.z_zuendung_S5_S3 "Umrechnung fuer Messgroesse cItfInput::z_zuendung" TAB_VERB 5 0 "undefiniert" 1 "Zuendung aus->ein" 2 "Zuendung ein" 3 "Zuendung ein->aus" 4 "Zuendung aus" DEFAULT_VALUE "" /end COMPU_VTAB
/begin COMPU_VTAB Conv.cItfInput._.zug_schub_S5_S3 "Umrechnung fuer Messgroesse cItfInput::zug_schub" TAB_VERB 2 0 "SCHUB" 1 "ZUG" DEFAULT_VALUE "" /end COMPU_VTAB
/begin COMPU_VTAB Conv.cItfInputParaumsch._.f_e_fahren_aktiv_S5_S3 "Umrechnung fuer Messgroesse cItfInputParaumsch::f_e_fahren_aktiv" TAB_VERB 2 0 "" 1 "" DEFAULT_VALUE "" /end COMPU_VTAB
/begin COMPU_VTAB Conv.cItfInputParaumsch._.iv_f_e_fahren_aktiv_S5_S3 "Umrechnung fuer Messgroesse cItfInputParaumsch::iv_f_e_fahren_aktiv" TAB_VERB 2 0 "" 1 "" DEFAULT_VALUE "" /end COMPU_VTAB
/begin COMPU_VTAB Conv.cK0sDiagnose._.cbelag_schutzfkt_k0_S5_S3 "Umrechnung fuer Messgroesse cK0sDiagnose::cbelag_schutzfkt_k0" TAB_VERB 2 0 "Schutzfunktion nicht aktiv" 1 "Schutzfunktion aktiv" DEFAULT_VALUE "" /end COMPU_VTAB
/begin COMPU_VTAB Conv.cK0sDiagnose._.flag_verbotregeln_k0_S5_S3 "Umrechnung fuer Messgroesse cK0sDiagnose::flag_verbotregeln_k0" TAB_VERB 2 0 "Regeln nicht verboten" 1 "Regeln verboten" DEFAULT_VALUE "" /end COMPU_VTAB
/begin COMPU_VTAB Conv.cK0sDiagnose._.k0_defekt_S5_S3 "Umrechnung fuer Messgroesse cK0sDiagnose::k0_defekt" TAB_VERB 4 0 "K0 nicht defekt" 1 "K0 Defekt Stufe 1" 2 "K0 Defekt Stufe 2" 3 "K0 Defekt Stufe 3" DEFAULT_VALUE "" /end COMPU_VTAB
/begin COMPU_VTAB Conv.cK0sDiagnose._.k0_pruefok_S5_S3 "Umrechnung fuer Messgroesse cK0sDiagnose::k0_pruefok" TAB_VERB 2 0 "K0 Prüfung nicht bestanden" 1 "K0 geprüft und WK i.O" DEFAULT_VALUE "" /end COMPU_VTAB
/begin COMPU_VTAB Conv.cK0sDiagnose._.kalt_regeln_verbot_S5_S3 "Umrechnung fuer Messgroesse cK0sDiagnose::kalt_regeln_verbot" TAB_VERB 2 0 "Regeln nicht verboten" 1 "Regeln verboten" DEFAULT_VALUE "" /end COMPU_VTAB
/begin COMPU_VTAB Conv.cK0sDiagnose._.schaltungdirekt_fkt_S5_S3 "Umrechnung fuer Messgroesse cK0sDiagnose::schaltungdirekt_fkt" TAB_VERB 2 0 "Funktion nicht aktiv" 1 "Funktion aktiv" DEFAULT_VALUE "" /end COMPU_VTAB
/begin COMPU_VTAB Conv.cK0sDiagnose._.warm_regeln_verbot_S5_S3 "Umrechnung fuer Messgroesse cK0sDiagnose::warm_regeln_verbot" TAB_VERB 2 0 "Regeln nicht verboten" 1 "Regeln verboten" DEFAULT_VALUE "" /end COMPU_VTAB
/begin COMPU_VTAB Conv.cK0sDiagnose._.z_diag_k0_S5_S3 "Umrechnung fuer Messgroesse cK0sDiagnose::z_diag_k0" TAB_VERB 5 0 "Inaktiv" 1 "Fehler Filtern" 2 "Anfiltern MEUTF" 3 "K0 Defekt Stufe 2" 4 "K0 Defekt Stufe 3" DEFAULT_VALUE "" /end COMPU_VTAB
/begin COMPU_VTAB Conv.cK0sDruck._.z_hys_k0_S5_S3 "Umrechnung fuer Messgroesse cK0sDruck::z_hys_k0" TAB_VERB 5 0 "Hysterese offset Initialisierung bei Systemstart" 1 "Hystereseoffset erreicht" 2 "Hysterese offset nicht aktiv" 3 "Hystereseoffset wird aufgebaut" 4 "Hystereseoffset wird abgebaut" DEFAULT_VALUE "" /end COMPU_VTAB
/begin COMPU_VTAB Conv.cK0sKorK0._.flag_p_sys_k0_S5_S3 "Umrechnung fuer Messgroesse cK0sKorK0::flag_p_sys_k0" TAB_VERB 2 0 "Keine Systemdruckanhebung K0 seitig angefordert" 1 "Systemdruckanhebung K0 seitig angefordert" DEFAULT_VALUE "" /end COMPU_VTAB
/begin COMPU_VTAB Conv.cK0sKorK0._.flag_verbot_mschalt_S5_S3 "Umrechnung fuer Messgroesse cK0sKorK0::flag_verbot_mschalt" TAB_VERB 2 0 "m_schalt wird berücksichtigt" 1 "m_schalt wird nicht berücksichtigt" DEFAULT_VALUE "" /end COMPU_VTAB
/begin COMPU_VTAB Conv.cK0sKorK0._.k0_bef_hysterese_S5_S3 "Umrechnung fuer Messgroesse cK0sKorK0::k0_bef_hysterese" TAB_VERB 2 0 "Druckvorgabe ohne Hysterese" 1 "Druckvorgabe mit Hysterese" DEFAULT_VALUE "" /end COMPU_VTAB
/begin COMPU_VTAB Conv.cK0sKorK0._.k0_ist_S5_S3 "Umrechnung fuer Messgroesse cK0sKorK0::k0_ist" TAB_VERB 6 0 "K0 offen" 1 "K0 Angelegt" 2 "K0 Druckstellung" 3 "K0 Schlupfgeregelt" 4 "K0 Geregelt Geschlossen" 5 "K0 Geschlossen" DEFAULT_VALUE "" /end COMPU_VTAB
/begin COMPU_VTAB Conv.cK0sKorK0._.z_k0_merk_S5_S3 "Umrechnung fuer Messgroesse cK0sKorK0::z_k0_merk" TAB_VERB 15 0 "offen" 1 "Schnellfüllung" 2 "Fuellausgleich" 3 "Anlegen" 4 "Angelegt" 5 "Druckstellung" 6 "Schliessrampe" 7 "Schlupfgeregelt" 8 "Geregelt Geschlossen" 9 "Geschlossen über Regelkreis" 10 "Zu regeln" 11 "Druckvorgabe" 12 "Uebergangszustand Geschlossen_alt nach Druckstellung" 13 "Uebergangszustan Druckstellung nach Füllausgleich" 14 "Uebergangszustand Geschlossen nach Füllausgleich" DEFAULT_VALUE "" /end COMPU_VTAB
/begin COMPU_VTAB Conv.cK0sKorK0._.z_k0_S5_S3 "Umrechnung fuer Messgroesse cK0sKorK0::z_k0" TAB_VERB 15 0 "offen" 1 "Schnellfüllung" 2 "Fuellausgleich" 3 "Anlegen" 4 "Angelegt" 5 "Druckstellung" 6 "Schliessrampe" 7 "Schlupfgeregelt" 8 "Geregelt Geschlossen" 9 "Geschlossen über Regelkreis" 10 "Zu regeln" 11 "Druckvorgabe" 12 "Uebergangszustand Geschlossen_alt nach Druckstellung" 13 "Uebergangszustan Druckstellung nach Füllausgleich" 14 "Uebergangszustand Geschlossen nach Füllausgleich" DEFAULT_VALUE "" /end COMPU_VTAB
/begin COMPU_VTAB Conv.cK0sKorSignale._.idx_sp_sps_lf_S5_S3 "Umrechnung fuer Messgroesse cK0sKorSignale::idx_sp_sps_lf" TAB_VERB 2 0 "Spontan Funktion nicht  möglich" 1 "Spontan Funktion möglich" DEFAULT_VALUE "" /end COMPU_VTAB
/begin COMPU_VTAB Conv.cK0sKorSignale._.idx_sp_sps_S5_S3 "Umrechnung fuer Messgroesse cK0sKorSignale::idx_sp_sps" TAB_VERB 2 0 "Spontan Funktion nicht  möglich" 1 "Spontan Funktion möglich" DEFAULT_VALUE "" /end COMPU_VTAB
/begin COMPU_VTAB Conv.cK0sKorSignale._.idx_sp_sps_schalt_S5_S3 "Umrechnung fuer Messgroesse cK0sKorSignale::idx_sp_sps_schalt" TAB_VERB 2 0 "Spontan Funktion nicht  möglich" 1 "Spontan Funktion möglich" DEFAULT_VALUE "" /end COMPU_VTAB
/begin COMPU_VTAB Conv.cK0sKorSignale._.idx_zs_zug_k0_S5_S3 "Umrechnung fuer Messgroesse cK0sKorSignale::idx_zs_zug_k0" TAB_VERB 2 0 "Schub" 1 "Zug" DEFAULT_VALUE "" /end COMPU_VTAB
/begin COMPU_VTAB Conv.cK0sKorSignale._.k0_soll_erw_S5_S3 "Umrechnung fuer Messgroesse cK0sKorSignale::k0_soll_erw" TAB_VERB 6 0 "K0 offen" 1 "K0 Angelegt" 2 "K0 Druckstellung" 3 "K0 Schlupfgeregelt" 4 "K0 Geregelt Geschlossen" 5 "K0 Geschlossen" DEFAULT_VALUE "" /end COMPU_VTAB
/begin COMPU_VTAB Conv.cK0sKorSignale._.k0_soll_gepr_S5_S3 "Umrechnung fuer Messgroesse cK0sKorSignale::k0_soll_gepr" TAB_VERB 7 0 "K0 offen" 1 "K0 Angelegt" 2 "K0 Druckstellung" 3 "K0 Schlupfgeregelt" 4 "K0 Geregelt Geschlossen" 5 "K0 Geschlossen" 6 "K0 Schliessrampe" DEFAULT_VALUE "" /end COMPU_VTAB
/begin COMPU_VTAB Conv.cK0sKorSollwert._.sollwert_aktiv_S5_S3 "Umrechnung fuer Messgroesse cK0sKorSollwert::sollwert_aktiv" TAB_VERB 2 0 "Sollwertgenerierung nicht aktiv" 1 "Sollwertgenerierung aktiv" DEFAULT_VALUE "" /end COMPU_VTAB
/begin COMPU_VTAB Conv.cK0sSODyn._.z_fdyn_k0_S5_S3 "Umrechnung fuer Messgroesse cK0sSODyn::z_fdyn_k0" TAB_VERB 4 0 "Fahrdynamik passiv" 1 "Vorbereitung" 2 "Wartezustand" 3 "Fahrdynamikoffset aktiv" DEFAULT_VALUE "" /end COMPU_VTAB
/begin COMPU_VTAB Conv.cK0sSOShi._.f_SchaltoffsetAktiv_S5_S3 "Umrechnung fuer Messgroesse cK0sSOShi::f_SchaltoffsetAktiv" TAB_VERB 2 0 "spontane Schaltung nicht aktiv" 1 "spontane Schaltung aktiv" DEFAULT_VALUE "" /end COMPU_VTAB
/begin COMPU_VTAB Conv.cK0sSOShi._.schaltung_aktiv_merk_S5_S3 "Umrechnung fuer Messgroesse cK0sSOShi::schaltung_aktiv_merk" TAB_VERB 4 -2 "Doppelrueckschaltung" -1 "keine Schaltung" 0 "Rueckschaltung" 1 "Hochschaltung" DEFAULT_VALUE "" /end COMPU_VTAB
/begin COMPU_METHOD Conv.cIepSchuz._.f_cgetr_aus_iep_S5_S3 "Umrechnung fuer Messgroesse cIepSchuz::f_cgetr_aus_iep" TAB_VERB "%4.0" "" COMPU_TAB_REF Conv.cIepSchuz._.f_cgetr_aus_iep_S5_S3 /end COMPU_METHOD
/begin COMPU_METHOD Conv.cIepSchuz._.f_cgetr_fehler_iep_S5_S3 "Umrechnung fuer Messgroesse cIepSchuz::f_cgetr_fehler_iep" TAB_VERB "%4.0" "" COMPU_TAB_REF Conv.cIepSchuz._.f_cgetr_fehler_iep_S5_S3 /end COMPU_METHOD
/begin COMPU_METHOD Conv.cIepSchuz._.f_psys_max_iep_S5_S3 "Umrechnung fuer Messgroesse cIepSchuz::f_psys_max_iep" TAB_VERB "%4.0" "" COMPU_TAB_REF Conv.cIepSchuz._.f_psys_max_iep_S5_S3 /end COMPU_METHOD
/begin COMPU_METHOD Conv.cIepSchuz._.f_tmax_aus_iep_S5_S3 "Umrechnung fuer Messgroesse cIepSchuz::f_tmax_aus_iep" TAB_VERB "%4.0" "" COMPU_TAB_REF Conv.cIepSchuz._.f_tmax_aus_iep_S5_S3 /end COMPU_METHOD
/begin COMPU_METHOD Conv.cIepSchuz._.f_ts_LP_iep_S5_S3 "Umrechnung fuer Messgroesse cIepSchuz::f_ts_LP_iep" TAB_VERB "%4.0" "" COMPU_TAB_REF Conv.cIepSchuz._.f_ts_LP_iep_S5_S3 /end COMPU_METHOD
/begin COMPU_METHOD Conv.cIepSigna._.f_an_aus_iep_S5_S3 "Umrechnung fuer Messgroesse cIepSigna::f_an_aus_iep" TAB_VERB "%4.0" "" COMPU_TAB_REF Conv.cIepSigna._.f_an_aus_iep_S5_S3 /end COMPU_METHOD
/begin COMPU_METHOD Conv.cIepSigna._.f_ansteuerung_iep_S5_S3 "Umrechnung fuer Messgroesse cIepSigna::f_ansteuerung_iep" TAB_VERB "%4.0" "" COMPU_TAB_REF Conv.cIepSigna._.f_ansteuerung_iep_S5_S3 /end COMPU_METHOD
/begin COMPU_METHOD Conv.cIepSigna._.f_einmal_aus_S5_S3 "Umrechnung fuer Messgroesse cIepSigna::f_einmal_aus" TAB_VERB "%4.0" "" COMPU_TAB_REF Conv.cIepSigna._.f_einmal_aus_S5_S3 /end COMPU_METHOD
/begin COMPU_METHOD Conv.cIepSigna._.f_gefaelle_erfuellt_iep_S5_S3 "Umrechnung fuer Messgroesse cIepSigna::f_gefaelle_erfuellt_iep" TAB_VERB "%4.0" "" COMPU_TAB_REF Conv.cIepSigna._.f_gefaelle_erfuellt_iep_S5_S3 /end COMPU_METHOD
/begin COMPU_METHOD Conv.cIepSigna._.f_luft_erfuellt_iep_S5_S3 "Umrechnung fuer Messgroesse cIepSigna::f_luft_erfuellt_iep" TAB_VERB "%4.0" "" COMPU_TAB_REF Conv.cIepSigna._.f_luft_erfuellt_iep_S5_S3 /end COMPU_METHOD
/begin COMPU_METHOD Conv.cIepSigna._.f_nab_erfuellt_iep_S5_S3 "Umrechnung fuer Messgroesse cIepSigna::f_nab_erfuellt_iep" TAB_VERB "%4.0" "" COMPU_TAB_REF Conv.cIepSigna._.f_nab_erfuellt_iep_S5_S3 /end COMPU_METHOD
/begin COMPU_METHOD Conv.cIepSigna._.f_nab_gegeben_iep_S5_S3 "Umrechnung fuer Messgroesse cIepSigna::f_nab_gegeben_iep" TAB_VERB "%4.0" "" COMPU_TAB_REF Conv.cIepSigna._.f_nab_gegeben_iep_S5_S3 /end COMPU_METHOD
/begin COMPU_METHOD Conv.cIepSigna._.f_ns_iep_S5_S3 "Umrechnung fuer Messgroesse cIepSigna::f_ns_iep" TAB_VERB "%4.0" "" COMPU_TAB_REF Conv.cIepSigna._.f_ns_iep_S5_S3 /end COMPU_METHOD
/begin COMPU_METHOD Conv.cIepSigna._.f_pow_down_enable_atsys_iep_S5_S3 "Umrechnung fuer Messgroesse cIepSigna::f_pow_down_enable_atsys_iep" TAB_VERB "%4.0" "" COMPU_TAB_REF Conv.cIepSigna._.f_pow_down_enable_atsys_iep_S5_S3 /end COMPU_METHOD
/begin COMPU_METHOD Conv.cIepSigna._.f_psys_stuetzen_iep_S5_S3 "Umrechnung fuer Messgroesse cIepSigna::f_psys_stuetzen_iep" TAB_VERB "%4.0" "" COMPU_TAB_REF Conv.cIepSigna._.f_psys_stuetzen_iep_S5_S3 /end COMPU_METHOD
/begin COMPU_METHOD Conv.cIepSigna._.f_sleep_iep_S5_S3 "Umrechnung fuer Messgroesse cIepSigna::f_sleep_iep" TAB_VERB "%4.0" "" COMPU_TAB_REF Conv.cIepSigna._.f_sleep_iep_S5_S3 /end COMPU_METHOD
/begin COMPU_METHOD Conv.cIepSigna._.f_wash_fkt_aktiv_iep_S5_S3 "Umrechnung fuer Messgroesse cIepSigna::f_wash_fkt_aktiv_iep" TAB_VERB "%4.0" "" COMPU_TAB_REF Conv.cIepSigna._.f_wash_fkt_aktiv_iep_S5_S3 /end COMPU_METHOD
/begin COMPU_METHOD Conv.cIepSigna._.z_f_stuetzen_iep_S5_S3 "Umrechnung fuer Messgroesse cIepSigna::z_f_stuetzen_iep" TAB_VERB "%4.0" "" COMPU_TAB_REF Conv.cIepSigna._.z_f_stuetzen_iep_S5_S3 /end COMPU_METHOD
/begin COMPU_METHOD Conv.cIepSigna._.z_fehler_reset_iep_S5_S3 "Umrechnung fuer Messgroesse cIepSigna::z_fehler_reset_iep" TAB_VERB "%4.0" "" COMPU_TAB_REF Conv.cIepSigna._.z_fehler_reset_iep_S5_S3 /end COMPU_METHOD
/begin COMPU_METHOD Conv.cIepSigna._.z_gefaelle_iep_S5_S3 "Umrechnung fuer Messgroesse cIepSigna::z_gefaelle_iep" TAB_VERB "%4.0" "" COMPU_TAB_REF Conv.cIepSigna._.z_gefaelle_iep_S5_S3 /end COMPU_METHOD
/begin COMPU_METHOD Conv.cIepSigna._.z_luft_iep_S5_S3 "Umrechnung fuer Messgroesse cIepSigna::z_luft_iep" TAB_VERB "%4.0" "" COMPU_TAB_REF Conv.cIepSigna._.z_luft_iep_S5_S3 /end COMPU_METHOD
/begin COMPU_METHOD Conv.cIepSigna._.z_nab_iep_S5_S3 "Umrechnung fuer Messgroesse cIepSigna::z_nab_iep" TAB_VERB "%4.0" "" COMPU_TAB_REF Conv.cIepSigna._.z_nab_iep_S5_S3 /end COMPU_METHOD
/begin COMPU_METHOD Conv.cIepSigna._.z_wstr_iep_S5_S3 "Umrechnung fuer Messgroesse cIepSigna::z_wstr_iep" TAB_VERB "%4.0" "" COMPU_TAB_REF Conv.cIepSigna._.z_wstr_iep_S5_S3 /end COMPU_METHOD
/begin COMPU_METHOD Conv.cIepStSig._.f_erststart_iep_S5_S3 "Umrechnung fuer Messgroesse cIepStSig::f_erststart_iep" TAB_VERB "%4.0" "" COMPU_TAB_REF Conv.cIepStSig._.f_erststart_iep_S5_S3 /end COMPU_METHOD
/begin COMPU_METHOD Conv.cIepStSig._.status_iep_S5_S3 "Umrechnung fuer Messgroesse cIepStSig::status_iep" TAB_VERB "%4.0" "" COMPU_TAB_REF Conv.cIepStSig._.status_iep_S5_S3 /end COMPU_METHOD
/begin COMPU_METHOD Conv.cIepStSig._.zustand_status_iep_S5_S3 "Umrechnung fuer Messgroesse cIepStSig::zustand_status_iep" TAB_VERB "%4.0" "" COMPU_TAB_REF Conv.cIepStSig._.zustand_status_iep_S5_S3 /end COMPU_METHOD
/begin COMPU_METHOD Conv.cItfInput._.abs_reg_S5_S3 "Umrechnung fuer Messgroesse cItfInput::abs_reg" TAB_VERB "%4.0" "" COMPU_TAB_REF Conv.cItfInput._.abs_reg_S5_S3 /end COMPU_METHOD
/begin COMPU_METHOD Conv.cItfInput._.abs_reg_status_S5_S3 "Umrechnung fuer Messgroesse cItfInput::abs_reg_status" TAB_VERB "%4.0" "" COMPU_TAB_REF Conv.cItfInput._.abs_reg_status_S5_S3 /end COMPU_METHOD
/begin COMPU_METHOD Conv.cItfInput._.ags_zka_index_S5_S3 "Umrechnung fuer Messgroesse cItfInput::ags_zka_index" TAB_VERB "%4.0" "" COMPU_TAB_REF Conv.cItfInput._.ags_zka_index_S5_S3 /end COMPU_METHOD
/begin COMPU_METHOD Conv.cItfInput._.anhaenger_aktiv_S5_S3 "Umrechnung fuer Messgroesse cItfInput::anhaenger_aktiv" TAB_VERB "%4.0" "" COMPU_TAB_REF Conv.cItfInput._.anhaenger_aktiv_S5_S3 /end COMPU_METHOD
/begin COMPU_METHOD Conv.cItfInput._.asc_passiv_S5_S3 "Umrechnung fuer Messgroesse cItfInput::asc_passiv" TAB_VERB "%4.0" "" COMPU_TAB_REF Conv.cItfInput._.asc_passiv_S5_S3 /end COMPU_METHOD
/begin COMPU_METHOD Conv.cItfInput._.asc_regelt_S5_S3 "Umrechnung fuer Messgroesse cItfInput::asc_regelt" TAB_VERB "%4.0" "" COMPU_TAB_REF Conv.cItfInput._.asc_regelt_S5_S3 /end COMPU_METHOD
/begin COMPU_METHOD Conv.cItfInput._.autohold_aktiv_S5_S3 "Umrechnung fuer Messgroesse cItfInput::autohold_aktiv" TAB_VERB "%4.0" "" COMPU_TAB_REF Conv.cItfInput._.autohold_aktiv_S5_S3 /end COMPU_METHOD
/begin COMPU_METHOD Conv.cItfInput._.ax_ref_status_S5_S3 "Umrechnung fuer Messgroesse cItfInput::ax_ref_status" TAB_VERB "%4.0" "" COMPU_TAB_REF Conv.cItfInput._.ax_ref_status_S5_S3 /end COMPU_METHOD
/begin COMPU_METHOD Conv.cItfInput._.bls_defakt_S5_S3 "Umrechnung fuer Messgroesse cItfInput::bls_defakt" TAB_VERB "%4.0" "" COMPU_TAB_REF Conv.cItfInput._.bls_defakt_S5_S3 /end COMPU_METHOD
/begin COMPU_METHOD Conv.cItfInput._.bls_defpas_S5_S3 "Umrechnung fuer Messgroesse cItfInput::bls_defpas" TAB_VERB "%4.0" "" COMPU_TAB_REF Conv.cItfInput._.bls_defpas_S5_S3 /end COMPU_METHOD
/begin COMPU_METHOD Conv.cItfInput._.bls_status_S5_S3 "Umrechnung fuer Messgroesse cItfInput::bls_status" TAB_VERB "%4.0" "" COMPU_TAB_REF Conv.cItfInput._.bls_status_S5_S3 /end COMPU_METHOD
/begin COMPU_METHOD Conv.cItfInput._.c_getr_status_S5_S3 "Umrechnung fuer Messgroesse cItfInput::c_getr_status" TAB_VERB "%4.0" "" COMPU_TAB_REF Conv.cItfInput._.c_getr_status_S5_S3 /end COMPU_METHOD
/begin COMPU_METHOD Conv.cItfInput._.druck_vorhanden_mod_S5_S3 "Umrechnung fuer Messgroesse cItfInput::druck_vorhanden_mod" TAB_VERB "%4.0" "" COMPU_TAB_REF Conv.cItfInput._.druck_vorhanden_mod_S5_S3 /end COMPU_METHOD
/begin COMPU_METHOD Conv.cItfInput._.edsmv_ersatzinfo_S5_S3 "Umrechnung fuer Messgroesse cItfInput::edsmv_ersatzinfo" TAB_VERB "%4.0" "" COMPU_TAB_REF Conv.cItfInput._.edsmv_ersatzinfo_S5_S3 /end COMPU_METHOD
/begin COMPU_METHOD Conv.cItfInput._.ersf_k0auf_S5_S3 "Umrechnung fuer Messgroesse cItfInput::ersf_k0auf" TAB_VERB "%4.0" "" COMPU_TAB_REF Conv.cItfInput._.ersf_k0auf_S5_S3 /end COMPU_METHOD
/begin COMPU_METHOD Conv.cItfInput._.f_iep_shutdown_S5_S3 "Umrechnung fuer Messgroesse cItfInput::f_iep_shutdown" TAB_VERB "%4.0" "" COMPU_TAB_REF Conv.cItfInput._.f_iep_shutdown_S5_S3 /end COMPU_METHOD
/begin COMPU_METHOD Conv.cItfInput._.f_minimaldruck_ausgabe_S5_S3 "Umrechnung fuer Messgroesse cItfInput::f_minimaldruck_ausgabe" TAB_VERB "%4.0" "" COMPU_TAB_REF Conv.cItfInput._.f_minimaldruck_ausgabe_S5_S3 /end COMPU_METHOD
/begin COMPU_METHOD Conv.cItfInput._.fahrbetrieb_S5_S3 "Umrechnung fuer Messgroesse cItfInput::fahrbetrieb" TAB_VERB "%4.0" "" COMPU_TAB_REF Conv.cItfInput._.fahrbetrieb_S5_S3 /end COMPU_METHOD
/begin COMPU_METHOD Conv.cItfInput._.feststellbremse_aktiv_S5_S3 "Umrechnung fuer Messgroesse cItfInput::feststellbremse_aktiv" TAB_VERB "%4.0" "" COMPU_TAB_REF Conv.cItfInput._.feststellbremse_aktiv_S5_S3 /end COMPU_METHOD
/begin COMPU_METHOD Conv.cItfInput._.fet0_active_S5_S3 "Umrechnung fuer Messgroesse cItfInput::fet0_active" TAB_VERB "%4.0" "" COMPU_TAB_REF Conv.cItfInput._.fet0_active_S5_S3 /end COMPU_METHOD
/begin COMPU_METHOD Conv.cItfInput._.fl_brake_inter_status_S5_S3 "Umrechnung fuer Messgroesse cItfInput::fl_brake_inter_status" TAB_VERB "%4.0" "" COMPU_TAB_REF Conv.cItfInput._.fl_brake_inter_status_S5_S3 /end COMPU_METHOD
/begin COMPU_METHOD Conv.cItfInput._.flag_m_max_has_iae_S5_S3 "Umrechnung fuer Messgroesse cItfInput::flag_m_max_has_iae" TAB_VERB "%4.0" "" COMPU_TAB_REF Conv.cItfInput._.flag_m_max_has_iae_S5_S3 /end COMPU_METHOD
/begin COMPU_METHOD Conv.cItfInput._.flag_p_hys_k0_has_S5_S3 "Umrechnung fuer Messgroesse cItfInput::flag_p_hys_k0_has" TAB_VERB "%4.0" "" COMPU_TAB_REF Conv.cItfInput._.flag_p_hys_k0_has_S5_S3 /end COMPU_METHOD
/begin COMPU_METHOD Conv.cItfInput._.flag_partfilt_aktiv_S5_S3 "Umrechnung fuer Messgroesse cItfInput::flag_partfilt_aktiv" TAB_VERB "%4.0" "" COMPU_TAB_REF Conv.cItfInput._.flag_partfilt_aktiv_S5_S3 /end COMPU_METHOD
/begin COMPU_METHOD Conv.cItfInput._.freigabe_posvdiag_S5_S3 "Umrechnung fuer Messgroesse cItfInput::freigabe_posvdiag" TAB_VERB "%4.0" "" COMPU_TAB_REF Conv.cItfInput._.freigabe_posvdiag_S5_S3 /end COMPU_METHOD
/begin COMPU_METHOD Conv.cItfInput._.fzg_rollverh_aktiv_stat_S5_S3 "Umrechnung fuer Messgroesse cItfInput::fzg_rollverh_aktiv_stat" TAB_VERB "%4.0" "" COMPU_TAB_REF Conv.cItfInput._.fzg_rollverh_aktiv_stat_S5_S3 /end COMPU_METHOD
/begin COMPU_METHOD Conv.cItfInput._.hdc_S5_S3 "Umrechnung fuer Messgroesse cItfInput::hdc" TAB_VERB "%4.0" "" COMPU_TAB_REF Conv.cItfInput._.hdc_S5_S3 /end COMPU_METHOD
/begin COMPU_METHOD Conv.cItfInput._.hillhold_aktiv_S5_S3 "Umrechnung fuer Messgroesse cItfInput::hillhold_aktiv" TAB_VERB "%4.0" "" COMPU_TAB_REF Conv.cItfInput._.hillhold_aktiv_S5_S3 /end COMPU_METHOD
/begin COMPU_METHOD Conv.cItfInput._.hyd_notlauf_S5_S3 "Umrechnung fuer Messgroesse cItfInput::hyd_notlauf" TAB_VERB "%4.0" "" COMPU_TAB_REF Conv.cItfInput._.hyd_notlauf_S5_S3 /end COMPU_METHOD
/begin COMPU_METHOD Conv.cItfInput._.i_min_ausser_parksperre_S5_S3 "Umrechnung fuer Messgroesse cItfInput::i_min_ausser_parksperre" TAB_VERB "%4.0" "" COMPU_TAB_REF Conv.cItfInput._.i_min_ausser_parksperre_S5_S3 /end COMPU_METHOD
/begin COMPU_METHOD Conv.cItfInput._.iae_req_subst_S5_S3 "Umrechnung fuer Messgroesse cItfInput::iae_req_subst" TAB_VERB "%4.0" "" COMPU_TAB_REF Conv.cItfInput._.iae_req_subst_S5_S3 /end COMPU_METHOD
/begin COMPU_METHOD Conv.cItfInput._.iep_soll_has_S5_S3 "Umrechnung fuer Messgroesse cItfInput::iep_soll_has" TAB_VERB "%4.0" "" COMPU_TAB_REF Conv.cItfInput._.iep_soll_has_S5_S3 /end COMPU_METHOD
/begin COMPU_METHOD Conv.cItfInput._.iep_soll_sab_S5_S3 "Umrechnung fuer Messgroesse cItfInput::iep_soll_sab" TAB_VERB "%4.0" "" COMPU_TAB_REF Conv.cItfInput._.iep_soll_sab_S5_S3 /end COMPU_METHOD
/begin COMPU_METHOD Conv.cItfInput._.iep_soll_tes_S5_S3 "Umrechnung fuer Messgroesse cItfInput::iep_soll_tes" TAB_VERB "%4.0" "" COMPU_TAB_REF Conv.cItfInput._.iep_soll_tes_S5_S3 /end COMPU_METHOD
/begin COMPU_METHOD Conv.cItfInput._.init_n_abneu_gef_S5_S3 "Umrechnung fuer Messgroesse cItfInput::init_n_abneu_gef" TAB_VERB "%4.0" "" COMPU_TAB_REF Conv.cItfInput._.init_n_abneu_gef_S5_S3 /end COMPU_METHOD
/begin COMPU_METHOD Conv.cItfInput._.init_n_t_S5_S3 "Umrechnung fuer Messgroesse cItfInput::init_n_t" TAB_VERB "%4.0" "" COMPU_TAB_REF Conv.cItfInput._.init_n_t_S5_S3 /end COMPU_METHOD
/begin COMPU_METHOD Conv.cItfInput._.iv_abs_reg_S5_S3 "Umrechnung fuer Messgroesse cItfInput::iv_abs_reg" TAB_VERB "%4.0" "" COMPU_TAB_REF Conv.cItfInput._.iv_abs_reg_S5_S3 /end COMPU_METHOD
/begin COMPU_METHOD Conv.cItfInput._.iv_abs_reg_status_S5_S3 "Umrechnung fuer Messgroesse cItfInput::iv_abs_reg_status" TAB_VERB "%4.0" "" COMPU_TAB_REF Conv.cItfInput._.iv_abs_reg_status_S5_S3 /end COMPU_METHOD
/begin COMPU_METHOD Conv.cItfInput._.iv_ags_zka_index_S5_S3 "Umrechnung fuer Messgroesse cItfInput::iv_ags_zka_index" TAB_VERB "%4.0" "" COMPU_TAB_REF Conv.cItfInput._.iv_ags_zka_index_S5_S3 /end COMPU_METHOD
/begin COMPU_METHOD Conv.cItfInput._.iv_anhaengeraktiv_S5_S3 "Umrechnung fuer Messgroesse cItfInput::iv_anhaengeraktiv" TAB_VERB "%4.0" "" COMPU_TAB_REF Conv.cItfInput._.iv_anhaengeraktiv_S5_S3 /end COMPU_METHOD
/begin COMPU_METHOD Conv.cItfInput._.iv_ascpas_S5_S3 "Umrechnung fuer Messgroesse cItfInput::iv_ascpas" TAB_VERB "%4.0" "" COMPU_TAB_REF Conv.cItfInput._.iv_ascpas_S5_S3 /end COMPU_METHOD
/begin COMPU_METHOD Conv.cItfInput._.iv_ascreg_S5_S3 "Umrechnung fuer Messgroesse cItfInput::iv_ascreg" TAB_VERB "%4.0" "" COMPU_TAB_REF Conv.cItfInput._.iv_ascreg_S5_S3 /end COMPU_METHOD
/begin COMPU_METHOD Conv.cItfInput._.iv_ax_ref_status_S5_S3 "Umrechnung fuer Messgroesse cItfInput::iv_ax_ref_status" TAB_VERB "%4.0" "" COMPU_TAB_REF Conv.cItfInput._.iv_ax_ref_status_S5_S3 /end COMPU_METHOD
/begin COMPU_METHOD Conv.cItfInput._.iv_blsdefakt_S5_S3 "Umrechnung fuer Messgroesse cItfInput::iv_blsdefakt" TAB_VERB "%4.0" "" COMPU_TAB_REF Conv.cItfInput._.iv_blsdefakt_S5_S3 /end COMPU_METHOD
/begin COMPU_METHOD Conv.cItfInput._.iv_blsdefpas_S5_S3 "Umrechnung fuer Messgroesse cItfInput::iv_blsdefpas" TAB_VERB "%4.0" "" COMPU_TAB_REF Conv.cItfInput._.iv_blsdefpas_S5_S3 /end COMPU_METHOD
/begin COMPU_METHOD Conv.cItfInput._.iv_blsstatus_S5_S3 "Umrechnung fuer Messgroesse cItfInput::iv_blsstatus" TAB_VERB "%4.0" "" COMPU_TAB_REF Conv.cItfInput._.iv_blsstatus_S5_S3 /end COMPU_METHOD
/begin COMPU_METHOD Conv.cItfInput._.iv_cgetrstatus_S5_S3 "Umrechnung fuer Messgroesse cItfInput::iv_cgetrstatus" TAB_VERB "%4.0" "" COMPU_TAB_REF Conv.cItfInput._.iv_cgetrstatus_S5_S3 /end COMPU_METHOD
/begin COMPU_METHOD Conv.cItfInput._.iv_druck_vorhanden_mod_S5_S3 "Umrechnung fuer Messgroesse cItfInput::iv_druck_vorhanden_mod" TAB_VERB "%4.0" "" COMPU_TAB_REF Conv.cItfInput._.iv_druck_vorhanden_mod_S5_S3 /end COMPU_METHOD
/begin COMPU_METHOD Conv.cItfInput._.iv_edsmversatzinfo_S5_S3 "Umrechnung fuer Messgroesse cItfInput::iv_edsmversatzinfo" TAB_VERB "%4.0" "" COMPU_TAB_REF Conv.cItfInput._.iv_edsmversatzinfo_S5_S3 /end COMPU_METHOD
/begin COMPU_METHOD Conv.cItfInput._.iv_f_iep_shutdown_S5_S3 "Umrechnung fuer Messgroesse cItfInput::iv_f_iep_shutdown" TAB_VERB "%4.0" "" COMPU_TAB_REF Conv.cItfInput._.iv_f_iep_shutdown_S5_S3 /end COMPU_METHOD
/begin COMPU_METHOD Conv.cItfInput._.iv_fahrbet_task_S5_S3 "Umrechnung fuer Messgroesse cItfInput::iv_fahrbet_task" TAB_VERB "%4.0" "" COMPU_TAB_REF Conv.cItfInput._.iv_fahrbet_task_S5_S3 /end COMPU_METHOD
/begin COMPU_METHOD Conv.cItfInput._.iv_feststellbremseaktiv_S5_S3 "Umrechnung fuer Messgroesse cItfInput::iv_feststellbremseaktiv" TAB_VERB "%4.0" "" COMPU_TAB_REF Conv.cItfInput._.iv_feststellbremseaktiv_S5_S3 /end COMPU_METHOD
/begin COMPU_METHOD Conv.cItfInput._.iv_fet0_active_S5_S3 "Umrechnung fuer Messgroesse cItfInput::iv_fet0_active" TAB_VERB "%4.0" "" COMPU_TAB_REF Conv.cItfInput._.iv_fet0_active_S5_S3 /end COMPU_METHOD
/begin COMPU_METHOD Conv.cItfInput._.iv_fl_brake_inter_status_S5_S3 "Umrechnung fuer Messgroesse cItfInput::iv_fl_brake_inter_status" TAB_VERB "%4.0" "" COMPU_TAB_REF Conv.cItfInput._.iv_fl_brake_inter_status_S5_S3 /end COMPU_METHOD
/begin COMPU_METHOD Conv.cItfInput._.iv_flag_m_max_has_iae_S5_S3 "Umrechnung fuer Messgroesse cItfInput::iv_flag_m_max_has_iae" TAB_VERB "%4.0" "" COMPU_TAB_REF Conv.cItfInput._.iv_flag_m_max_has_iae_S5_S3 /end COMPU_METHOD
/begin COMPU_METHOD Conv.cItfInput._.iv_flag_p_hys_k0_has_S5_S3 "Umrechnung fuer Messgroesse cItfInput::iv_flag_p_hys_k0_has" TAB_VERB "%4.0" "" COMPU_TAB_REF Conv.cItfInput._.iv_flag_p_hys_k0_has_S5_S3 /end COMPU_METHOD
/begin COMPU_METHOD Conv.cItfInput._.iv_flag_partfilt_aktiv_S5_S3 "Umrechnung fuer Messgroesse cItfInput::iv_flag_partfilt_aktiv" TAB_VERB "%4.0" "" COMPU_TAB_REF Conv.cItfInput._.iv_flag_partfilt_aktiv_S5_S3 /end COMPU_METHOD
/begin COMPU_METHOD Conv.cItfInput._.iv_freigabe_posvdiag_S5_S3 "Umrechnung fuer Messgroesse cItfInput::iv_freigabe_posvdiag" TAB_VERB "%4.0" "" COMPU_TAB_REF Conv.cItfInput._.iv_freigabe_posvdiag_S5_S3 /end COMPU_METHOD
/begin COMPU_METHOD Conv.cItfInput._.iv_fzg_rollverh_aktiv_stat_S5_S3 "Umrechnung fuer Messgroesse cItfInput::iv_fzg_rollverh_aktiv_stat" TAB_VERB "%4.0" "" COMPU_TAB_REF Conv.cItfInput._.iv_fzg_rollverh_aktiv_stat_S5_S3 /end COMPU_METHOD
/begin COMPU_METHOD Conv.cItfInput._.iv_gnotinfo_S5_S3 "Umrechnung fuer Messgroesse cItfInput::iv_gnotinfo" TAB_VERB "%4.0" "" COMPU_TAB_REF Conv.cItfInput._.iv_gnotinfo_S5_S3 /end COMPU_METHOD
/begin COMPU_METHOD Conv.cItfInput._.iv_gsoll_S5_S3 "Umrechnung fuer Messgroesse cItfInput::iv_gsoll" TAB_VERB "%4.0" "" COMPU_TAB_REF Conv.cItfInput._.iv_gsoll_S5_S3 /end COMPU_METHOD
/begin COMPU_METHOD Conv.cItfInput._.iv_hdc_S5_S3 "Umrechnung fuer Messgroesse cItfInput::iv_hdc" TAB_VERB "%4.0" "" COMPU_TAB_REF Conv.cItfInput._.iv_hdc_S5_S3 /end COMPU_METHOD
/begin COMPU_METHOD Conv.cItfInput._.iv_iae_req_subst_S5_S3 "Umrechnung fuer Messgroesse cItfInput::iv_iae_req_subst" TAB_VERB "%4.0" "" COMPU_TAB_REF Conv.cItfInput._.iv_iae_req_subst_S5_S3 /end COMPU_METHOD
/begin COMPU_METHOD Conv.cItfInput._.iv_iep_soll_has_S5_S3 "Umrechnung fuer Messgroesse cItfInput::iv_iep_soll_has" TAB_VERB "%4.0" "" COMPU_TAB_REF Conv.cItfInput._.iv_iep_soll_has_S5_S3 /end COMPU_METHOD
/begin COMPU_METHOD Conv.cItfInput._.iv_iep_soll_sab_S5_S3 "Umrechnung fuer Messgroesse cItfInput::iv_iep_soll_sab" TAB_VERB "%4.0" "" COMPU_TAB_REF Conv.cItfInput._.iv_iep_soll_sab_S5_S3 /end COMPU_METHOD
/begin COMPU_METHOD Conv.cItfInput._.iv_iep_soll_tes_S5_S3 "Umrechnung fuer Messgroesse cItfInput::iv_iep_soll_tes" TAB_VERB "%4.0" "" COMPU_TAB_REF Conv.cItfInput._.iv_iep_soll_tes_S5_S3 /end COMPU_METHOD
/begin COMPU_METHOD Conv.cItfInput._.iv_k0_soll_S5_S3 "Umrechnung fuer Messgroesse cItfInput::iv_k0_soll" TAB_VERB "%4.0" "" COMPU_TAB_REF Conv.cItfInput._.iv_k0_soll_S5_S3 /end COMPU_METHOD
/begin COMPU_METHOD Conv.cItfInput._.iv_ll_mot_aktiv_status_S5_S3 "Umrechnung fuer Messgroesse cItfInput::iv_ll_mot_aktiv_status" TAB_VERB "%4.0" "" COMPU_TAB_REF Conv.cItfInput._.iv_ll_mot_aktiv_status_S5_S3 /end COMPU_METHOD
/begin COMPU_METHOD Conv.cItfInput._.iv_m_motsoll_mod_status_S5_S3 "Umrechnung fuer Messgroesse cItfInput::iv_m_motsoll_mod_status" TAB_VERB "%4.0" "" COMPU_TAB_REF Conv.cItfInput._.iv_m_motsoll_mod_status_S5_S3 /end COMPU_METHOD
/begin COMPU_METHOD Conv.cItfInput._.iv_mmotstatus_S5_S3 "Umrechnung fuer Messgroesse cItfInput::iv_mmotstatus" TAB_VERB "%4.0" "" COMPU_TAB_REF Conv.cItfInput._.iv_mmotstatus_S5_S3 /end COMPU_METHOD
/begin COMPU_METHOD Conv.cItfInput._.iv_mvg_vm_start_S5_S3 "Umrechnung fuer Messgroesse cItfInput::iv_mvg_vm_start" TAB_VERB "%4.0" "" COMPU_TAB_REF Conv.cItfInput._.iv_mvg_vm_start_S5_S3 /end COMPU_METHOD
/begin COMPU_METHOD Conv.cItfInput._.iv_n_ab_dir_S5_S3 "Umrechnung fuer Messgroesse cItfInput::iv_n_ab_dir" TAB_VERB "%4.0" "" COMPU_TAB_REF Conv.cItfInput._.iv_n_ab_dir_S5_S3 /end COMPU_METHOD
/begin COMPU_METHOD Conv.cItfInput._.iv_n_ab_dir_status_S5_S3 "Umrechnung fuer Messgroesse cItfInput::iv_n_ab_dir_status" TAB_VERB "%4.0" "" COMPU_TAB_REF Conv.cItfInput._.iv_n_ab_dir_status_S5_S3 /end COMPU_METHOD
/begin COMPU_METHOD Conv.cItfInput._.iv_n_t_dir_S5_S3 "Umrechnung fuer Messgroesse cItfInput::iv_n_t_dir" TAB_VERB "%4.0" "" COMPU_TAB_REF Conv.cItfInput._.iv_n_t_dir_S5_S3 /end COMPU_METHOD
/begin COMPU_METHOD Conv.cItfInput._.iv_n_t_dir_status_S5_S3 "Umrechnung fuer Messgroesse cItfInput::iv_n_t_dir_status" TAB_VERB "%4.0" "" COMPU_TAB_REF Conv.cItfInput._.iv_n_t_dir_status_S5_S3 /end COMPU_METHOD
/begin COMPU_METHOD Conv.cItfInput._.iv_n_vm_status_S5_S3 "Umrechnung fuer Messgroesse cItfInput::iv_n_vm_status" TAB_VERB "%4.0" "" COMPU_TAB_REF Conv.cItfInput._.iv_n_vm_status_S5_S3 /end COMPU_METHOD
/begin COMPU_METHOD Conv.cItfInput._.iv_nabstatus_S5_S3 "Umrechnung fuer Messgroesse cItfInput::iv_nabstatus" TAB_VERB "%4.0" "" COMPU_TAB_REF Conv.cItfInput._.iv_nabstatus_S5_S3 /end COMPU_METHOD
/begin COMPU_METHOD Conv.cItfInput._.iv_neigungstatus_S5_S3 "Umrechnung fuer Messgroesse cItfInput::iv_neigungstatus" TAB_VERB "%4.0" "" COMPU_TAB_REF Conv.cItfInput._.iv_neigungstatus_S5_S3 /end COMPU_METHOD
/begin COMPU_METHOD Conv.cItfInput._.iv_nmotstatus_S5_S3 "Umrechnung fuer Messgroesse cItfInput::iv_nmotstatus" TAB_VERB "%4.0" "" COMPU_TAB_REF Conv.cItfInput._.iv_nmotstatus_S5_S3 /end COMPU_METHOD
/begin COMPU_METHOD Conv.cItfInput._.iv_notltask_S5_S3 "Umrechnung fuer Messgroesse cItfInput::iv_notltask" TAB_VERB "%4.0" "" COMPU_TAB_REF Conv.cItfInput._.iv_notltask_S5_S3 /end COMPU_METHOD
/begin COMPU_METHOD Conv.cItfInput._.iv_ntstatus_S5_S3 "Umrechnung fuer Messgroesse cItfInput::iv_ntstatus" TAB_VERB "%4.0" "" COMPU_TAB_REF Conv.cItfInput._.iv_ntstatus_S5_S3 /end COMPU_METHOD
/begin COMPU_METHOD Conv.cItfInput._.iv_ntu_virt_dir_S5_S3 "Umrechnung fuer Messgroesse cItfInput::iv_ntu_virt_dir" TAB_VERB "%4.0" "" COMPU_TAB_REF Conv.cItfInput._.iv_ntu_virt_dir_S5_S3 /end COMPU_METHOD
/begin COMPU_METHOD Conv.cItfInput._.iv_ntu_virt_dir_status_S5_S3 "Umrechnung fuer Messgroesse cItfInput::iv_ntu_virt_dir_status" TAB_VERB "%4.0" "" COMPU_TAB_REF Conv.cItfInput._.iv_ntu_virt_dir_status_S5_S3 /end COMPU_METHOD
/begin COMPU_METHOD Conv.cItfInput._.iv_pos_S5_S3 "Umrechnung fuer Messgroesse cItfInput::iv_pos" TAB_VERB "%4.0" "" COMPU_TAB_REF Conv.cItfInput._.iv_pos_S5_S3 /end COMPU_METHOD
/begin COMPU_METHOD Conv.cItfInput._.iv_posstatus_S5_S3 "Umrechnung fuer Messgroesse cItfInput::iv_posstatus" TAB_VERB "%4.0" "" COMPU_TAB_REF Conv.cItfInput._.iv_posstatus_S5_S3 /end COMPU_METHOD
/begin COMPU_METHOD Conv.cItfInput._.iv_pt_damping_active_S5_S3 "Umrechnung fuer Messgroesse cItfInput::iv_pt_damping_active" TAB_VERB "%4.0" "" COMPU_TAB_REF Conv.cItfInput._.iv_pt_damping_active_S5_S3 /end COMPU_METHOD
/begin COMPU_METHOD Conv.cItfInput._.iv_saf_has_aktiv_S5_S3 "Umrechnung fuer Messgroesse cItfInput::iv_saf_has_aktiv" TAB_VERB "%4.0" "" COMPU_TAB_REF Conv.cItfInput._.iv_saf_has_aktiv_S5_S3 /end COMPU_METHOD
/begin COMPU_METHOD Conv.cItfInput._.iv_sbytask_S5_S3 "Umrechnung fuer Messgroesse cItfInput::iv_sbytask" TAB_VERB "%4.0" "" COMPU_TAB_REF Conv.cItfInput._.iv_sbytask_S5_S3 /end COMPU_METHOD
/begin COMPU_METHOD Conv.cItfInput._.iv_schluesselstart_aktiv_S5_S3 "Umrechnung fuer Messgroesse cItfInput::iv_schluesselstart_aktiv" TAB_VERB "%4.0" "" COMPU_TAB_REF Conv.cItfInput._.iv_schluesselstart_aktiv_S5_S3 /end COMPU_METHOD
/begin COMPU_METHOD Conv.cItfInput._.iv_status_has_S5_S3 "Umrechnung fuer Messgroesse cItfInput::iv_status_has" TAB_VERB "%4.0" "" COMPU_TAB_REF Conv.cItfInput._.iv_status_has_S5_S3 /end COMPU_METHOD
/begin COMPU_METHOD Conv.cItfInput._.iv_status_n_haltephase_S5_S3 "Umrechnung fuer Messgroesse cItfInput::iv_status_n_haltephase" TAB_VERB "%4.0" "" COMPU_TAB_REF Conv.cItfInput._.iv_status_n_haltephase_S5_S3 /end COMPU_METHOD
/begin COMPU_METHOD Conv.cItfInput._.iv_svh_aktiv_has_S5_S3 "Umrechnung fuer Messgroesse cItfInput::iv_svh_aktiv_has" TAB_VERB "%4.0" "" COMPU_TAB_REF Conv.cItfInput._.iv_svh_aktiv_has_S5_S3 /end COMPU_METHOD
/begin COMPU_METHOD Conv.cItfInput._.iv_verbot_sas_fkt_S5_S3 "Umrechnung fuer Messgroesse cItfInput::iv_verbot_sas_fkt" TAB_VERB "%4.0" "" COMPU_TAB_REF Conv.cItfInput._.iv_verbot_sas_fkt_S5_S3 /end COMPU_METHOD
/begin COMPU_METHOD Conv.cItfInput._.iv_z_k0_befuellopt_S5_S3 "Umrechnung fuer Messgroesse cItfInput::iv_z_k0_befuellopt" TAB_VERB "%4.0" "" COMPU_TAB_REF Conv.cItfInput._.iv_z_k0_befuellopt_S5_S3 /end COMPU_METHOD
/begin COMPU_METHOD Conv.cItfInput._.iv_z_k0_soll_subst_S5_S3 "Umrechnung fuer Messgroesse cItfInput::iv_z_k0_soll_subst" TAB_VERB "%4.0" "" COMPU_TAB_REF Conv.cItfInput._.iv_z_k0_soll_subst_S5_S3 /end COMPU_METHOD
/begin COMPU_METHOD Conv.cItfInput._.iv_z_modus_iae_S5_S3 "Umrechnung fuer Messgroesse cItfInput::iv_z_modus_iae" TAB_VERB "%4.0" "" COMPU_TAB_REF Conv.cItfInput._.iv_z_modus_iae_S5_S3 /end COMPU_METHOD
/begin COMPU_METHOD Conv.cItfInput._.iv_zzuendung_S5_S3 "Umrechnung fuer Messgroesse cItfInput::iv_zzuendung" TAB_VERB "%4.0" "" COMPU_TAB_REF Conv.cItfInput._.iv_zzuendung_S5_S3 /end COMPU_METHOD
/begin COMPU_METHOD Conv.cItfInput._.k0_diag_moeglich_S5_S3 "Umrechnung fuer Messgroesse cItfInput::k0_diag_moeglich" TAB_VERB "%4.0" "" COMPU_TAB_REF Conv.cItfInput._.k0_diag_moeglich_S5_S3 /end COMPU_METHOD
/begin COMPU_METHOD Conv.cItfInput._.k0_soll_S5_S3 "Umrechnung fuer Messgroesse cItfInput::k0_soll" TAB_VERB "%4.0" "" COMPU_TAB_REF Conv.cItfInput._.k0_soll_S5_S3 /end COMPU_METHOD
/begin COMPU_METHOD Conv.cItfInput._.ll_mot_aktiv_status_S5_S3 "Umrechnung fuer Messgroesse cItfInput::ll_mot_aktiv_status" TAB_VERB "%4.0" "" COMPU_TAB_REF Conv.cItfInput._.ll_mot_aktiv_status_S5_S3 /end COMPU_METHOD
/begin COMPU_METHOD Conv.cItfInput._.m_mot_status_S5_S3 "Umrechnung fuer Messgroesse cItfInput::m_mot_status" TAB_VERB "%4.0" "" COMPU_TAB_REF Conv.cItfInput._.m_mot_status_S5_S3 /end COMPU_METHOD
/begin COMPU_METHOD Conv.cItfInput._.m_motsoll_mod_status_S5_S3 "Umrechnung fuer Messgroesse cItfInput::m_motsoll_mod_status" TAB_VERB "%4.0" "" COMPU_TAB_REF Conv.cItfInput._.m_motsoll_mod_status_S5_S3 /end COMPU_METHOD
/begin COMPU_METHOD Conv.cItfInput._.manuell_S5_S3 "Umrechnung fuer Messgroesse cItfInput::manuell" TAB_VERB "%4.0" "" COMPU_TAB_REF Conv.cItfInput._.manuell_S5_S3 /end COMPU_METHOD
/begin COMPU_METHOD Conv.cItfInput._.max_p_haupt_S5_S3 "Umrechnung fuer Messgroesse cItfInput::max_p_haupt" TAB_VERB "%4.0" "" COMPU_TAB_REF Conv.cItfInput._.max_p_haupt_S5_S3 /end COMPU_METHOD
/begin COMPU_METHOD Conv.cItfInput._.mvg_vm_start_S5_S3 "Umrechnung fuer Messgroesse cItfInput::mvg_vm_start" TAB_VERB "%4.0" "" COMPU_TAB_REF Conv.cItfInput._.mvg_vm_start_S5_S3 /end COMPU_METHOD
/begin COMPU_METHOD Conv.cItfInput._.n_ab_dir_S5_S3 "Umrechnung fuer Messgroesse cItfInput::n_ab_dir" TAB_VERB "%4.0" "" COMPU_TAB_REF Conv.cItfInput._.n_ab_dir_S5_S3 /end COMPU_METHOD
/begin COMPU_METHOD Conv.cItfInput._.n_ab_dir_status_S5_S3 "Umrechnung fuer Messgroesse cItfInput::n_ab_dir_status" TAB_VERB "%4.0" "" COMPU_TAB_REF Conv.cItfInput._.n_ab_dir_status_S5_S3 /end COMPU_METHOD
/begin COMPU_METHOD Conv.cItfInput._.n_ab_status_S5_S3 "Umrechnung fuer Messgroesse cItfInput::n_ab_status" TAB_VERB "%4.0" "" COMPU_TAB_REF Conv.cItfInput._.n_ab_status_S5_S3 /end COMPU_METHOD
/begin COMPU_METHOD Conv.cItfInput._.n_mot_status_S5_S3 "Umrechnung fuer Messgroesse cItfInput::n_mot_status" TAB_VERB "%4.0" "" COMPU_TAB_REF Conv.cItfInput._.n_mot_status_S5_S3 /end COMPU_METHOD
/begin COMPU_METHOD Conv.cItfInput._.n_t_dir_S5_S3 "Umrechnung fuer Messgroesse cItfInput::n_t_dir" TAB_VERB "%4.0" "" COMPU_TAB_REF Conv.cItfInput._.n_t_dir_S5_S3 /end COMPU_METHOD
/begin COMPU_METHOD Conv.cItfInput._.n_t_dir_status_S5_S3 "Umrechnung fuer Messgroesse cItfInput::n_t_dir_status" TAB_VERB "%4.0" "" COMPU_TAB_REF Conv.cItfInput._.n_t_dir_status_S5_S3 /end COMPU_METHOD
/begin COMPU_METHOD Conv.cItfInput._.n_t_status_S5_S3 "Umrechnung fuer Messgroesse cItfInput::n_t_status" TAB_VERB "%4.0" "" COMPU_TAB_REF Conv.cItfInput._.n_t_status_S5_S3 /end COMPU_METHOD
/begin COMPU_METHOD Conv.cItfInput._.n_vm_status_S5_S3 "Umrechnung fuer Messgroesse cItfInput::n_vm_status" TAB_VERB "%4.0" "" COMPU_TAB_REF Conv.cItfInput._.n_vm_status_S5_S3 /end COMPU_METHOD
/begin COMPU_METHOD Conv.cItfInput._.neigung_status_S5_S3 "Umrechnung fuer Messgroesse cItfInput::neigung_status" TAB_VERB "%4.0" "" COMPU_TAB_REF Conv.cItfInput._.neigung_status_S5_S3 /end COMPU_METHOD
/begin COMPU_METHOD Conv.cItfInput._.notgang_info_S5_S3 "Umrechnung fuer Messgroesse cItfInput::notgang_info" TAB_VERB "%4.0" "" COMPU_TAB_REF Conv.cItfInput._.notgang_info_S5_S3 /end COMPU_METHOD
/begin COMPU_METHOD Conv.cItfInput._.notgang_S5_S3 "Umrechnung fuer Messgroesse cItfInput::notgang" TAB_VERB "%4.0" "" COMPU_TAB_REF Conv.cItfInput._.notgang_S5_S3 /end COMPU_METHOD
/begin COMPU_METHOD Conv.cItfInput._.notlauf_S5_S3 "Umrechnung fuer Messgroesse cItfInput::notlauf" TAB_VERB "%4.0" "" COMPU_TAB_REF Conv.cItfInput._.notlauf_S5_S3 /end COMPU_METHOD
/begin COMPU_METHOD Conv.cItfInput._.ntu_virt_dir_S5_S3 "Umrechnung fuer Messgroesse cItfInput::ntu_virt_dir" TAB_VERB "%4.0" "" COMPU_TAB_REF Conv.cItfInput._.ntu_virt_dir_S5_S3 /end COMPU_METHOD
/begin COMPU_METHOD Conv.cItfInput._.ntu_virt_dir_status_S5_S3 "Umrechnung fuer Messgroesse cItfInput::ntu_virt_dir_status" TAB_VERB "%4.0" "" COMPU_TAB_REF Conv.cItfInput._.ntu_virt_dir_status_S5_S3 /end COMPU_METHOD
/begin COMPU_METHOD Conv.cItfInput._.nullbestromung_aktiv_S5_S3 "Umrechnung fuer Messgroesse cItfInput::nullbestromung_aktiv" TAB_VERB "%4.0" "" COMPU_TAB_REF Conv.cItfInput._.nullbestromung_aktiv_S5_S3 /end COMPU_METHOD
/begin COMPU_METHOD Conv.cItfInput._.pak_aktiv_S5_S3 "Umrechnung fuer Messgroesse cItfInput::pak_aktiv" TAB_VERB "%4.0" "" COMPU_TAB_REF Conv.cItfInput._.pak_aktiv_S5_S3 /end COMPU_METHOD
/begin COMPU_METHOD Conv.cItfInput._.pos_S5_S3 "Umrechnung fuer Messgroesse cItfInput::pos" TAB_VERB "%4.0" "" COMPU_TAB_REF Conv.cItfInput._.pos_S5_S3 /end COMPU_METHOD
/begin COMPU_METHOD Conv.cItfInput._.pos_status_S5_S3 "Umrechnung fuer Messgroesse cItfInput::pos_status" TAB_VERB "%4.0" "" COMPU_TAB_REF Conv.cItfInput._.pos_status_S5_S3 /end COMPU_METHOD
/begin COMPU_METHOD Conv.cItfInput._.pos_wunsch_S5_S3 "Umrechnung fuer Messgroesse cItfInput::pos_wunsch" TAB_VERB "%4.0" "" COMPU_TAB_REF Conv.cItfInput._.pos_wunsch_S5_S3 /end COMPU_METHOD
/begin COMPU_METHOD Conv.cItfInput._.pt_damping_active_S5_S3 "Umrechnung fuer Messgroesse cItfInput::pt_damping_active" TAB_VERB "%4.0" "" COMPU_TAB_REF Conv.cItfInput._.pt_damping_active_S5_S3 /end COMPU_METHOD
/begin COMPU_METHOD Conv.cItfInput._.pumpendruck_nicht_vorhanden_S5_S3 "Umrechnung fuer Messgroesse cItfInput::pumpendruck_nicht_vorhanden" TAB_VERB "%4.0" "" COMPU_TAB_REF Conv.cItfInput._.pumpendruck_nicht_vorhanden_S5_S3 /end COMPU_METHOD
/begin COMPU_METHOD Conv.cItfInput._.pumpendruck_vorhanden_S5_S3 "Umrechnung fuer Messgroesse cItfInput::pumpendruck_vorhanden" TAB_VERB "%4.0" "" COMPU_TAB_REF Conv.cItfInput._.pumpendruck_vorhanden_S5_S3 /end COMPU_METHOD
/begin COMPU_METHOD Conv.cItfInput._.saf_has_aktiv_S5_S3 "Umrechnung fuer Messgroesse cItfInput::saf_has_aktiv" TAB_VERB "%4.0" "" COMPU_TAB_REF Conv.cItfInput._.saf_has_aktiv_S5_S3 /end COMPU_METHOD
/begin COMPU_METHOD Conv.cItfInput._.schluesselstart_aktiv_S5_S3 "Umrechnung fuer Messgroesse cItfInput::schluesselstart_aktiv" TAB_VERB "%4.0" "" COMPU_TAB_REF Conv.cItfInput._.schluesselstart_aktiv_S5_S3 /end COMPU_METHOD
/begin COMPU_METHOD Conv.cItfInput._.sollgang_S5_S3 "Umrechnung fuer Messgroesse cItfInput::sollgang" TAB_VERB "%4.0" "" COMPU_TAB_REF Conv.cItfInput._.sollgang_S5_S3 /end COMPU_METHOD
/begin COMPU_METHOD Conv.cItfInput._.standby_S5_S3 "Umrechnung fuer Messgroesse cItfInput::standby" TAB_VERB "%4.0" "" COMPU_TAB_REF Conv.cItfInput._.standby_S5_S3 /end COMPU_METHOD
/begin COMPU_METHOD Conv.cItfInput._.status_has_S5_S3 "Umrechnung fuer Messgroesse cItfInput::status_has" TAB_VERB "%4.0" "" COMPU_TAB_REF Conv.cItfInput._.status_has_S5_S3 /end COMPU_METHOD
/begin COMPU_METHOD Conv.cItfInput._.status_n_haltephase_S5_S3 "Umrechnung fuer Messgroesse cItfInput::status_n_haltephase" TAB_VERB "%4.0" "" COMPU_TAB_REF Conv.cItfInput._.status_n_haltephase_S5_S3 /end COMPU_METHOD
/begin COMPU_METHOD Conv.cItfInput._.stromlos_ausser_ps_S5_S3 "Umrechnung fuer Messgroesse cItfInput::stromlos_ausser_ps" TAB_VERB "%4.0" "" COMPU_TAB_REF Conv.cItfInput._.stromlos_ausser_ps_S5_S3 /end COMPU_METHOD
/begin COMPU_METHOD Conv.cItfInput._.stromlos_ges_S5_S3 "Umrechnung fuer Messgroesse cItfInput::stromlos_ges" TAB_VERB "%4.0" "" COMPU_TAB_REF Conv.cItfInput._.stromlos_ges_S5_S3 /end COMPU_METHOD
/begin COMPU_METHOD Conv.cItfInput._.stromlos_ps_S5_S3 "Umrechnung fuer Messgroesse cItfInput::stromlos_ps" TAB_VERB "%4.0" "" COMPU_TAB_REF Conv.cItfInput._.stromlos_ps_S5_S3 /end COMPU_METHOD
/begin COMPU_METHOD Conv.cItfInput._.svh_aktiv_has_S5_S3 "Umrechnung fuer Messgroesse cItfInput::svh_aktiv_has" TAB_VERB "%4.0" "" COMPU_TAB_REF Conv.cItfInput._.svh_aktiv_has_S5_S3 /end COMPU_METHOD
/begin COMPU_METHOD Conv.cItfInput._.verbot_sas_fkt_S5_S3 "Umrechnung fuer Messgroesse cItfInput::verbot_sas_fkt" TAB_VERB "%4.0" "" COMPU_TAB_REF Conv.cItfInput._.verbot_sas_fkt_S5_S3 /end COMPU_METHOD
/begin COMPU_METHOD Conv.cItfInput._.z_k0_befuellopt_S5_S3 "Umrechnung fuer Messgroesse cItfInput::z_k0_befuellopt" TAB_VERB "%4.0" "" COMPU_TAB_REF Conv.cItfInput._.z_k0_befuellopt_S5_S3 /end COMPU_METHOD
/begin COMPU_METHOD Conv.cItfInput._.z_k0_soll_subst_S5_S3 "Umrechnung fuer Messgroesse cItfInput::z_k0_soll_subst" TAB_VERB "%4.0" "" COMPU_TAB_REF Conv.cItfInput._.z_k0_soll_subst_S5_S3 /end COMPU_METHOD
/begin COMPU_METHOD Conv.cItfInput._.z_modus_iae_S5_S3 "Umrechnung fuer Messgroesse cItfInput::z_modus_iae" TAB_VERB "%4.0" "" COMPU_TAB_REF Conv.cItfInput._.z_modus_iae_S5_S3 /end COMPU_METHOD
/begin COMPU_METHOD Conv.cItfInput._.z_zuendung_S5_S3 "Umrechnung fuer Messgroesse cItfInput::z_zuendung" TAB_VERB "%4.0" "" COMPU_TAB_REF Conv.cItfInput._.z_zuendung_S5_S3 /end COMPU_METHOD
/begin COMPU_METHOD Conv.cItfInput._.zug_schub_S5_S3 "Umrechnung fuer Messgroesse cItfInput::zug_schub" TAB_VERB "%4.0" "" COMPU_TAB_REF Conv.cItfInput._.zug_schub_S5_S3 /end COMPU_METHOD
/begin COMPU_METHOD Conv.cItfInputParaumsch._.f_e_fahren_aktiv_S5_S3 "Umrechnung fuer Messgroesse cItfInputParaumsch::f_e_fahren_aktiv" TAB_VERB "%4.0" "" COMPU_TAB_REF Conv.cItfInputParaumsch._.f_e_fahren_aktiv_S5_S3 /end COMPU_METHOD
/begin COMPU_METHOD Conv.cItfInputParaumsch._.iv_f_e_fahren_aktiv_S5_S3 "Umrechnung fuer Messgroesse cItfInputParaumsch::iv_f_e_fahren_aktiv" TAB_VERB "%4.0" "" COMPU_TAB_REF Conv.cItfInputParaumsch._.iv_f_e_fahren_aktiv_S5_S3 /end COMPU_METHOD
/begin COMPU_METHOD Conv.cK0sDiagnose._.cbelag_schutzfkt_k0_S5_S3 "Umrechnung fuer Messgroesse cK0sDiagnose::cbelag_schutzfkt_k0" TAB_VERB "%4.0" "" COMPU_TAB_REF Conv.cK0sDiagnose._.cbelag_schutzfkt_k0_S5_S3 /end COMPU_METHOD
/begin COMPU_METHOD Conv.cK0sDiagnose._.flag_verbotregeln_k0_S5_S3 "Umrechnung fuer Messgroesse cK0sDiagnose::flag_verbotregeln_k0" TAB_VERB "%4.0" "" COMPU_TAB_REF Conv.cK0sDiagnose._.flag_verbotregeln_k0_S5_S3 /end COMPU_METHOD
/begin COMPU_METHOD Conv.cK0sDiagnose._.k0_defekt_S5_S3 "Umrechnung fuer Messgroesse cK0sDiagnose::k0_defekt" TAB_VERB "%4.0" "" COMPU_TAB_REF Conv.cK0sDiagnose._.k0_defekt_S5_S3 /end COMPU_METHOD
/begin COMPU_METHOD Conv.cK0sDiagnose._.k0_pruefok_S5_S3 "Umrechnung fuer Messgroesse cK0sDiagnose::k0_pruefok" TAB_VERB "%4.0" "" COMPU_TAB_REF Conv.cK0sDiagnose._.k0_pruefok_S5_S3 /end COMPU_METHOD
/begin COMPU_METHOD Conv.cK0sDiagnose._.kalt_regeln_verbot_S5_S3 "Umrechnung fuer Messgroesse cK0sDiagnose::kalt_regeln_verbot" TAB_VERB "%4.0" "" COMPU_TAB_REF Conv.cK0sDiagnose._.kalt_regeln_verbot_S5_S3 /end COMPU_METHOD
/begin COMPU_METHOD Conv.cK0sDiagnose._.schaltungdirekt_fkt_S5_S3 "Umrechnung fuer Messgroesse cK0sDiagnose::schaltungdirekt_fkt" TAB_VERB "%4.0" "" COMPU_TAB_REF Conv.cK0sDiagnose._.schaltungdirekt_fkt_S5_S3 /end COMPU_METHOD
/begin COMPU_METHOD Conv.cK0sDiagnose._.warm_regeln_verbot_S5_S3 "Umrechnung fuer Messgroesse cK0sDiagnose::warm_regeln_verbot" TAB_VERB "%4.0" "" COMPU_TAB_REF Conv.cK0sDiagnose._.warm_regeln_verbot_S5_S3 /end COMPU_METHOD
/begin COMPU_METHOD Conv.cK0sDiagnose._.z_diag_k0_S5_S3 "Umrechnung fuer Messgroesse cK0sDiagnose::z_diag_k0" TAB_VERB "%4.0" "" COMPU_TAB_REF Conv.cK0sDiagnose._.z_diag_k0_S5_S3 /end COMPU_METHOD
/begin COMPU_METHOD Conv.cK0sDruck._.z_hys_k0_S5_S3 "Umrechnung fuer Messgroesse cK0sDruck::z_hys_k0" TAB_VERB "%4.0" "" COMPU_TAB_REF Conv.cK0sDruck._.z_hys_k0_S5_S3 /end COMPU_METHOD
/begin COMPU_METHOD Conv.cK0sKorK0._.flag_p_sys_k0_S5_S3 "Umrechnung fuer Messgroesse cK0sKorK0::flag_p_sys_k0" TAB_VERB "%4.0" "" COMPU_TAB_REF Conv.cK0sKorK0._.flag_p_sys_k0_S5_S3 /end COMPU_METHOD
/begin COMPU_METHOD Conv.cK0sKorK0._.flag_verbot_mschalt_S5_S3 "Umrechnung fuer Messgroesse cK0sKorK0::flag_verbot_mschalt" TAB_VERB "%4.0" "" COMPU_TAB_REF Conv.cK0sKorK0._.flag_verbot_mschalt_S5_S3 /end COMPU_METHOD
/begin COMPU_METHOD Conv.cK0sKorK0._.k0_bef_hysterese_S5_S3 "Umrechnung fuer Messgroesse cK0sKorK0::k0_bef_hysterese" TAB_VERB "%4.0" "" COMPU_TAB_REF Conv.cK0sKorK0._.k0_bef_hysterese_S5_S3 /end COMPU_METHOD
/begin COMPU_METHOD Conv.cK0sKorK0._.k0_ist_S5_S3 "Umrechnung fuer Messgroesse cK0sKorK0::k0_ist" TAB_VERB "%4.0" "" COMPU_TAB_REF Conv.cK0sKorK0._.k0_ist_S5_S3 /end COMPU_METHOD
/begin COMPU_METHOD Conv.cK0sKorK0._.z_k0_merk_S5_S3 "Umrechnung fuer Messgroesse cK0sKorK0::z_k0_merk" TAB_VERB "%4.0" "" COMPU_TAB_REF Conv.cK0sKorK0._.z_k0_merk_S5_S3 /end COMPU_METHOD
/begin COMPU_METHOD Conv.cK0sKorK0._.z_k0_S5_S3 "Umrechnung fuer Messgroesse cK0sKorK0::z_k0" TAB_VERB "%4.0" "" COMPU_TAB_REF Conv.cK0sKorK0._.z_k0_S5_S3 /end COMPU_METHOD
/begin COMPU_METHOD Conv.cK0sKorSignale._.idx_sp_sps_lf_S5_S3 "Umrechnung fuer Messgroesse cK0sKorSignale::idx_sp_sps_lf" TAB_VERB "%4.0" "" COMPU_TAB_REF Conv.cK0sKorSignale._.idx_sp_sps_lf_S5_S3 /end COMPU_METHOD
/begin COMPU_METHOD Conv.cK0sKorSignale._.idx_sp_sps_S5_S3 "Umrechnung fuer Messgroesse cK0sKorSignale::idx_sp_sps" TAB_VERB "%4.0" "" COMPU_TAB_REF Conv.cK0sKorSignale._.idx_sp_sps_S5_S3 /end COMPU_METHOD
/begin COMPU_METHOD Conv.cK0sKorSignale._.idx_sp_sps_schalt_S5_S3 "Umrechnung fuer Messgroesse cK0sKorSignale::idx_sp_sps_schalt" TAB_VERB "%4.0" "" COMPU_TAB_REF Conv.cK0sKorSignale._.idx_sp_sps_schalt_S5_S3 /end COMPU_METHOD
/begin COMPU_METHOD Conv.cK0sKorSignale._.idx_zs_zug_k0_S5_S3 "Umrechnung fuer Messgroesse cK0sKorSignale::idx_zs_zug_k0" TAB_VERB "%4.0" "" COMPU_TAB_REF Conv.cK0sKorSignale._.idx_zs_zug_k0_S5_S3 /end COMPU_METHOD
/begin COMPU_METHOD Conv.cK0sKorSignale._.k0_soll_erw_S5_S3 "Umrechnung fuer Messgroesse cK0sKorSignale::k0_soll_erw" TAB_VERB "%4.0" "" COMPU_TAB_REF Conv.cK0sKorSignale._.k0_soll_erw_S5_S3 /end COMPU_METHOD
/begin COMPU_METHOD Conv.cK0sKorSignale._.k0_soll_gepr_S5_S3 "Umrechnung fuer Messgroesse cK0sKorSignale::k0_soll_gepr" TAB_VERB "%4.0" "" COMPU_TAB_REF Conv.cK0sKorSignale._.k0_soll_gepr_S5_S3 /end COMPU_METHOD
/begin COMPU_METHOD Conv.cK0sKorSollwert._.sollwert_aktiv_S5_S3 "Umrechnung fuer Messgroesse cK0sKorSollwert::sollwert_aktiv" TAB_VERB "%4.0" "" COMPU_TAB_REF Conv.cK0sKorSollwert._.sollwert_aktiv_S5_S3 /end COMPU_METHOD
/begin COMPU_METHOD Conv.cK0sSODyn._.z_fdyn_k0_S5_S3 "Umrechnung fuer Messgroesse cK0sSODyn::z_fdyn_k0" TAB_VERB "%4.0" "" COMPU_TAB_REF Conv.cK0sSODyn._.z_fdyn_k0_S5_S3 /end COMPU_METHOD
/begin COMPU_METHOD Conv.cK0sSOShi._.f_SchaltoffsetAktiv_S5_S3 "Umrechnung fuer Messgroesse cK0sSOShi::f_SchaltoffsetAktiv" TAB_VERB "%4.0" "" COMPU_TAB_REF Conv.cK0sSOShi._.f_SchaltoffsetAktiv_S5_S3 /end COMPU_METHOD
/begin COMPU_METHOD Conv.cK0sSOShi._.schaltung_aktiv_merk_S5_S3 "Umrechnung fuer Messgroesse cK0sSOShi::schaltung_aktiv_merk" TAB_VERB "%4.0" "" COMPU_TAB_REF Conv.cK0sSOShi._.schaltung_aktiv_merk_S5_S3 /end COMPU_METHOD
/begin COMPU_METHOD UMR___1_1000_0_S5_S3 "int = ((phys * 1000) / 1) - (0) [-]" RAT_FUNC "%4.3" "[-]" COEFFS 0 1000 0 0 0 1 /end COMPU_METHOD
/begin COMPU_METHOD UMR___1_1_0_S5_S3 "int = ((phys * 1) / 1) - (0) [-]" RAT_FUNC "%1.0" "[-]" COEFFS 0 1 0 0 0 1 /end COMPU_METHOD
/begin COMPU_METHOD UMR___1_300_0_S5_S3 "int = ((phys * 300) / 1) - (0) [-]" RAT_FUNC "%6.5" "[-]" COEFFS 0 300 0 0 0 1 /end COMPU_METHOD
/begin COMPU_METHOD UMR__SEC_1_1000_0_S5_S3 "int = ((phys * 1000) / 1) - (0) [1/s]" RAT_FUNC "%4.3" "[1/s]" COEFFS 0 1000 0 0 0 1 /end COMPU_METHOD
/begin COMPU_METHOD UMR__SEC_1_1_0_S5_S3 "int = ((phys * 1) / 1) - (0) [1/s]" RAT_FUNC "%1.0" "[1/s]" COEFFS 0 1 0 0 0 1 /end COMPU_METHOD
/begin COMPU_METHOD UMR_BAR__1_1000_0_S5_S3 "int = ((phys * 1000) / 1) - (0) [bar]" RAT_FUNC "%4.3" "[bar]" COEFFS 0 1000 0 0 0 1 /end COMPU_METHOD
/begin COMPU_METHOD UMR_BAR__1_1_0_S5_S3 "int = ((phys * 1) / 1) - (0) [bar]" RAT_FUNC "%1.0" "[bar]" COEFFS 0 1 0 0 0 1 /end COMPU_METHOD
/begin COMPU_METHOD UMR_BAR__1_2_0_S5_S3 "int = ((phys * 2) / 1) - (0) [bar]" RAT_FUNC "%3.2" "[bar]" COEFFS 0 2 0 0 0 1 /end COMPU_METHOD
/begin COMPU_METHOD UMR_BAR_SEC_1_10_0_S5_S3 "int = ((phys * 10) / 1) - (0) [bar/s]" RAT_FUNC "%2.1" "[bar/s]" COEFFS 0 10 0 0 0 1 /end COMPU_METHOD
/begin COMPU_METHOD UMR_GRAD__1_3_M128_S5_S3 "int = ((phys * 3) / 1) - (-128) [Grad]" RAT_FUNC "%4.3" "[Grad]" COEFFS 0 3 128 0 0 1 /end COMPU_METHOD
/begin COMPU_METHOD UMR_GRADC__1_1_0_S5_S3 "int = ((phys * 1) / 1) - (0) [°C]" RAT_FUNC "%1.0" "[°C]" COEFFS 0 1 0 0 0 1 /end COMPU_METHOD
/begin COMPU_METHOD UMR_GRADC__1_1_M40_S5_S3 "int = ((phys * 1) / 1) - (-40) [°C]" RAT_FUNC "%1.0" "[°C]" COEFFS 0 1 40 0 0 1 /end COMPU_METHOD
/begin COMPU_METHOD UMR_GRADC__1_1_M48_S5_S3 "int = ((phys * 1) / 1) - (-48) [°C]" RAT_FUNC "%1.0" "[°C]" COEFFS 0 1 48 0 0 1 /end COMPU_METHOD
/begin COMPU_METHOD UMR_KM_H_1_16_0_S5_S3 "int = ((phys * 16) / 1) - (0) [km/h]" RAT_FUNC "%3.2" "[km/h]" COEFFS 0 16 0 0 0 1 /end COMPU_METHOD
/begin COMPU_METHOD UMR_KM_H_1_1_0_S5_S3 "int = ((phys * 1) / 1) - (0) [km/h]" RAT_FUNC "%1.0" "[km/h]" COEFFS 0 1 0 0 0 1 /end COMPU_METHOD
/begin COMPU_METHOD UMR_M_SEC2_1_32_0_S5_S3 "int = ((phys * 32) / 1) - (0) [m/s^2]" RAT_FUNC "%3.2" "[m/s^2]" COEFFS 0 32 0 0 0 1 /end COMPU_METHOD
/begin COMPU_METHOD UMR_MBAR__1_1_0_S5_S3 "int = ((phys * 1) / 1) - (0) [mbar]" RAT_FUNC "%1.0" "[mbar]" COEFFS 0 1 0 0 0 1 /end COMPU_METHOD
/begin COMPU_METHOD UMR_MIN__1_1_0_S5_S3 "int = ((phys * 1) / 1) - (0) [min]" RAT_FUNC "%1.0" "[min]" COEFFS 0 1 0 0 0 1 /end COMPU_METHOD
/begin COMPU_METHOD UMR_MSEC__10_1_0_S5_S3 "int = ((phys * 1) / 10) - (0) [ms]" RAT_FUNC "%1.0" "[ms]" COEFFS 0 0.1 0 0 0 1 /end COMPU_METHOD
/begin COMPU_METHOD UMR_MSEC__1_1_0_S5_S3 "int = ((phys * 1) / 1) - (0) [ms]" RAT_FUNC "%1.0" "[ms]" COEFFS 0 1 0 0 0 1 /end COMPU_METHOD
/begin COMPU_METHOD UMR_NM__1_10_0_S5_S3 "int = ((phys * 10) / 1) - (0) [Nm]" RAT_FUNC "%2.1" "[Nm]" COEFFS 0 10 0 0 0 1 /end COMPU_METHOD
/begin COMPU_METHOD UMR_NM__1_1_0_S5_S3 "int = ((phys * 1) / 1) - (0) [Nm]" RAT_FUNC "%1.0" "[Nm]" COEFFS 0 1 0 0 0 1 /end COMPU_METHOD
/begin COMPU_METHOD UMR_NM__6_1_M34_S5_S3 "int = ((phys * 1) / 6) - (-34) [Nm]" RAT_FUNC "%1.0" "[Nm]" COEFFS 0 0.166666666667 34 0 0 1 /end COMPU_METHOD
/begin COMPU_METHOD UMR_NM_SEC_1_1_0_S5_S3 "int = ((phys * 1) / 1) - (0) [Nm/s]" RAT_FUNC "%1.0" "[Nm/s]" COEFFS 0 1 0 0 0 1 /end COMPU_METHOD
/begin COMPU_METHOD UMR_PROZENT__1_1_0_2_S5_S3 "int = ((phys * 1) / 1) - (0) [%]" RAT_FUNC "%1.0" "[%]" COEFFS 0 1 0 0 0 1 /end COMPU_METHOD
/begin COMPU_METHOD UMR_PROZENT__20_51_0_S5_S3 "int = ((phys * 51) / 20) - (0) [%]" RAT_FUNC "%5.4" "[%]" COEFFS 0 2.55 0 0 0 1 /end COMPU_METHOD
/begin COMPU_METHOD UMR_PROZENT_SEC_20_51_0_S5_S3 "int = ((phys * 51) / 20) - (0) [%/s]" RAT_FUNC "%5.4" "[%/s]" COEFFS 0 2.55 0 0 0 1 /end COMPU_METHOD
/begin COMPU_METHOD UMR_SEC__1_100_0_S5_S3 "int = ((phys * 100) / 1) - (0) [s]" RAT_FUNC "%3.2" "[s]" COEFFS 0 100 0 0 0 1 /end COMPU_METHOD
/begin COMPU_METHOD UMR_SEC__1_1_0_S5_S3 "int = ((phys * 1) / 1) - (0) [s]" RAT_FUNC "%1.0" "[s]" COEFFS 0 1 0 0 0 1 /end COMPU_METHOD
/begin COMPU_METHOD UMR_U_MIN_10_1_0_S5_S3 "int = ((phys * 1) / 10) - (0) [U/min]" RAT_FUNC "%1.0" "[U/min]" COEFFS 0 0.1 0 0 0 1 /end COMPU_METHOD
/begin COMPU_METHOD UMR_U_MIN_1_100_0_S5_S3 "int = ((phys * 100) / 1) - (0) [U/min]" RAT_FUNC "%3.2" "[U/min]" COEFFS 0 100 0 0 0 1 /end COMPU_METHOD
/begin COMPU_METHOD UMR_U_MIN_1_1_0_S5_S3 "int = ((phys * 1) / 1) - (0) [U/min]" RAT_FUNC "%1.0" "[U/min]" COEFFS 0 1 0 0 0 1 /end COMPU_METHOD
/begin COMPU_METHOD UMR_U_MIN_32_1_0_S5_S3 "int = ((phys * 1) / 32) - (0) [U/min]" RAT_FUNC "%1.0" "[U/min]" COEFFS 0 0.03125 0 0 0 1 /end COMPU_METHOD
/begin COMPU_METHOD UMR_U_MINSEC_1_1_0_S5_S3 "int = ((phys * 1) / 1) - (0) [U/(min*s)]" RAT_FUNC "%1.0" "[U/(min*s)]" COEFFS 0 1 0 0 0 1 /end COMPU_METHOD
/begin COMPU_METHOD UMR_VOLT__1_1000_0_S5_S3 "int = ((phys * 1000) / 1) - (0) [Volt]" RAT_FUNC "%4.3" "[Volt]" COEFFS 0 1000 0 0 0 1 /end COMPU_METHOD
/begin MEASUREMENT iIepSchuz.f_cgetr_aus_iep "Flag zur Anzeige, ob die Getriebetemperatur außerhalb der Einschalttemperatur der Pumpe ist" UBYTE Conv.cIepSchuz._.f_cgetr_aus_iep_S5_S3 1 100 0 1 BIT_MASK 0x1 ECU_ADDRESS 0xFFF8B757 DISPLAY_IDENTIFIER f_cgetr_aus_iep.iIepSchuz /end MEASUREMENT
/begin MEASUREMENT iIepSchuz.f_cgetr_fehler_iep "Fehler für Ersatzmassnahme IEP" UBYTE Conv.cIepSchuz._.f_cgetr_fehler_iep_S5_S3 1 100 0 1 BIT_MASK 0x1 ECU_ADDRESS 0xFFF8B758 DISPLAY_IDENTIFIER f_cgetr_fehler_iep.iIepSchuz /end MEASUREMENT
/begin MEASUREMENT iIepSchuz.f_psys_max_iep "Systemdruck überschritten Ja/Nein" UBYTE Conv.cIepSchuz._.f_psys_max_iep_S5_S3 1 100 0 1 BIT_MASK 0x1 ECU_ADDRESS 0xFFF8B756 DISPLAY_IDENTIFIER f_psys_max_iep.iIepSchuz /end MEASUREMENT
/begin MEASUREMENT iIepSchuz.f_tmax_aus_iep "FLAG: wird gesetzt , wenn die maximale Einschaltdauer überschritten ist" UBYTE Conv.cIepSchuz._.f_tmax_aus_iep_S5_S3 1 100 0 1 BIT_MASK 0x1 ECU_ADDRESS 0xFFF8B754 DISPLAY_IDENTIFIER f_tmax_aus_iep.iIepSchuz /end MEASUREMENT
/begin MEASUREMENT iIepSchuz.f_ts_LP_iep "FLAG:zur Verhinderung eines Wechsels des Leistungspunktes nach AUS" UBYTE Conv.cIepSchuz._.f_ts_LP_iep_S5_S3 1 100 0 1 BIT_MASK 0x1 ECU_ADDRESS 0xFFF8B755 DISPLAY_IDENTIFIER f_ts_LP_iep.iIepSchuz /end MEASUREMENT
/begin MEASUREMENT iIepSchuz.iTimerGesamt.timer "Der aktuelle Timerwert" ULONG UMR_MSEC__10_1_0_S5_S3 1 100 0 42949672950 ECU_ADDRESS 0xFFF8B764 DISPLAY_IDENTIFIER iTimerGesamt.iIepSchuz /end MEASUREMENT
/begin MEASUREMENT iIepSchuz.iTimerLP.time "Zeit des Timers" UWORD UMR_SEC__1_100_0_S5_S3 1 100 0 655.35 ECU_ADDRESS 0xFFF8B760 DISPLAY_IDENTIFIER iTimerLP.iIepSchuz /end MEASUREMENT
/begin MEASUREMENT iIepSchuz.t_an_iep "Aktuelle Einschaltdauer der Pumpe" FLOAT32_IEEE UMR_SEC__1_1_0_S5_S3 1 100 0 99999 ECU_ADDRESS 0xFFF8B75C FORMAT "%4.3" DISPLAY_IDENTIFIER t_an_iep.iIepSchuz /end MEASUREMENT
/begin MEASUREMENT iIepSigna.Pt1NeigungsFilterIep.x "Filterwert" SLONG UMR___1_300_0_S5_S3 1 100 -7158278.82667 7158278.82333 ECU_ADDRESS 0xFFF8B798 DISPLAY_IDENTIFIER Pt1NeigungsFilterIep.iIepSigna /end MEASUREMENT
/begin MEASUREMENT iIepSigna.f_an_aus_iep "FLAG: Für Freigabe zur Aktivierung der el.Zusatzpumpe" UBYTE Conv.cIepSigna._.f_an_aus_iep_S5_S3 1 100 0 1 BIT_MASK 0x1 ECU_ADDRESS 0xFFF8B773 DISPLAY_IDENTIFIER f_an_aus_iep.iIepSigna /end MEASUREMENT
/begin MEASUREMENT iIepSigna.f_ansteuerung_iep "Anstsuerung der Iep ist möglich, da das Fahrzeug in Betriebsbereitschaft ist" UBYTE Conv.cIepSigna._.f_ansteuerung_iep_S5_S3 1 100 0 1 BIT_MASK 0x1 ECU_ADDRESS 0xFFF8B775 DISPLAY_IDENTIFIER f_ansteuerung_iep.iIepSigna /end MEASUREMENT
/begin MEASUREMENT iIepSigna.f_einmal_aus "FLAG: wird gesetzt, wenn f_an_aus_iep im FEHLER-Zustand ein Mal aus" UBYTE Conv.cIepSigna._.f_einmal_aus_S5_S3 1 100 0 1 BIT_MASK 0x1 ECU_ADDRESS 0xFFF8B777 DISPLAY_IDENTIFIER f_einmal_aus.iIepSigna /end MEASUREMENT
/begin MEASUREMENT iIepSigna.f_gefaelle_erfuellt_iep "Flag, dass Luft im Ansaugrüssel auf Grund des Gefälles sein könnte" UBYTE Conv.cIepSigna._.f_gefaelle_erfuellt_iep_S5_S3 1 100 0 1 BIT_MASK 0x1 ECU_ADDRESS 0xFFF8B76C DISPLAY_IDENTIFIER f_gefaelle_erfuellt_iep.iIepSigna /end MEASUREMENT
/begin MEASUREMENT iIepSigna.f_luft_erfuellt_iep "Flag, dass Luft im Ansaugrüssel auf Grund des Gefälles sein könnte" UBYTE Conv.cIepSigna._.f_luft_erfuellt_iep_S5_S3 1 100 0 1 BIT_MASK 0x1 ECU_ADDRESS 0xFFF8B76F DISPLAY_IDENTIFIER f_luft_erfuellt_iep.iIepSigna /end MEASUREMENT
/begin MEASUREMENT iIepSigna.f_nab_erfuellt_iep "Flag, dass Luft im Ansaugrüssel auf Grund der Geschwindigkeit sein könnte und die IEP angeschaltet wird" UBYTE Conv.cIepSigna._.f_nab_erfuellt_iep_S5_S3 1 100 0 1 BIT_MASK 0x1 ECU_ADDRESS 0xFFF8B76D DISPLAY_IDENTIFIER f_nab_erfuellt_iep.iIepSigna /end MEASUREMENT
/begin MEASUREMENT iIepSigna.f_nab_gegeben_iep "Flag, dass Luft im Ansaugrüssel auf Grund der Geschwindigkeit sein könnte" UBYTE Conv.cIepSigna._.f_nab_gegeben_iep_S5_S3 1 100 0 1 BIT_MASK 0x1 ECU_ADDRESS 0xFFF8B76E DISPLAY_IDENTIFIER f_nab_gegeben_iep.iIepSigna /end MEASUREMENT
/begin MEASUREMENT iIepSigna.f_ns_iep "Motordrehzahlschwelle" UBYTE Conv.cIepSigna._.f_ns_iep_S5_S3 1 100 0 1 BIT_MASK 0x1 ECU_ADDRESS 0xFFF8B774 DISPLAY_IDENTIFIER f_ns_iep.iIepSigna /end MEASUREMENT
/begin MEASUREMENT iIepSigna.f_pow_down_enable_atsys_iep "Flag zum Anzeigen ob die IEP ein Abschalten der EGS verhindert" UBYTE Conv.cIepSigna._.f_pow_down_enable_atsys_iep_S5_S3 1 100 0 1 BIT_MASK 0x1 ECU_ADDRESS 0xFFF8B77C DISPLAY_IDENTIFIER f_pow_down_enable_atsys_iep.iIepSigna /end MEASUREMENT
/begin MEASUREMENT iIepSigna.f_psys_stuetzen_iep "Flag zur Anzeige, das die IEP den Systemdruck stützt" UBYTE Conv.cIepSigna._.f_psys_stuetzen_iep_S5_S3 1 100 0 1 BIT_MASK 0x1 ECU_ADDRESS 0xFFF8B776 DISPLAY_IDENTIFIER f_psys_stuetzen_iep.iIepSigna /end MEASUREMENT
/begin MEASUREMENT iIepSigna.f_sleep_iep "FLAG: wird gesetzt für den Zustandswechsel in SLEEP-Mode" UBYTE Conv.cIepSigna._.f_sleep_iep_S5_S3 1 100 0 1 BIT_MASK 0x1 ECU_ADDRESS 0xFFF8B778 DISPLAY_IDENTIFIER f_sleep_iep.iIepSigna /end MEASUREMENT
/begin MEASUREMENT iIepSigna.f_wash_fkt_aktiv_iep "Flag für die Waschstrassenfunktion" UBYTE Conv.cIepSigna._.f_wash_fkt_aktiv_iep_S5_S3 1 100 0 1 BIT_MASK 0x1 ECU_ADDRESS 0xFFF8B77A DISPLAY_IDENTIFIER f_wash_fkt_aktiv_iep.iIepSigna /end MEASUREMENT
/begin MEASUREMENT iIepSigna.iTimerFehlerReset.time "Zeit des Timers" UWORD UMR_SEC__1_100_0_S5_S3 1 100 0 655.35 ECU_ADDRESS 0xFFF8B794 DISPLAY_IDENTIFIER iTimerFehlerReset.iIepSigna /end MEASUREMENT
/begin MEASUREMENT iIepSigna.iTimerGefaelleIep.timer "Der aktuelle Timerwert" ULONG UMR_MSEC__10_1_0_S5_S3 1 100 0 42949672950 ECU_ADDRESS 0xFFF8B788 DISPLAY_IDENTIFIER iTimerGefaelleIep.iIepSigna /end MEASUREMENT
/begin MEASUREMENT iIepSigna.iTimerLuftAktiv.timer "Der aktuelle Timerwert" ULONG UMR_MSEC__10_1_0_S5_S3 1 100 0 42949672950 ECU_ADDRESS 0xFFF8B780 DISPLAY_IDENTIFIER iTimerLuftAktiv.iIepSigna /end MEASUREMENT
/begin MEASUREMENT iIepSigna.iTimerLuftSperr.timer "Der aktuelle Timerwert" ULONG UMR_MSEC__10_1_0_S5_S3 1 100 0 42949672950 ECU_ADDRESS 0xFFF8B784 DISPLAY_IDENTIFIER iTimerLuftSperr.iIepSigna /end MEASUREMENT
/begin MEASUREMENT iIepSigna.iTimerNabIep.timer "Der aktuelle Timerwert" ULONG UMR_MSEC__10_1_0_S5_S3 1 100 0 42949672950 ECU_ADDRESS 0xFFF8B78C DISPLAY_IDENTIFIER iTimerNabIep.iIepSigna /end MEASUREMENT
/begin MEASUREMENT iIepSigna.iTimerPsysPssIep.time "Zeit des Timers" UWORD UMR_SEC__1_100_0_S5_S3 1 100 0 655.35 ECU_ADDRESS 0xFFF8B79C DISPLAY_IDENTIFIER iTimerPsysPssIep.iIepSigna /end MEASUREMENT
/begin MEASUREMENT iIepSigna.iTimerWstr.timer "Der aktuelle Timerwert" ULONG UMR_MSEC__10_1_0_S5_S3 1 100 0 42949672950 ECU_ADDRESS 0xFFF8B790 DISPLAY_IDENTIFIER iTimerWstr.iIepSigna /end MEASUREMENT
/begin MEASUREMENT iIepSigna.neigung_gef_iep "Gefiltertes Neigungssignal des Fahrzeugs" UBYTE UMR_GRAD__1_3_M128_S5_S3 1 100 -42.6666666667 42 ECU_ADDRESS 0xFFF8B77E DISPLAY_IDENTIFIER neigung_gef_iep.iIepSigna /end MEASUREMENT
/begin MEASUREMENT iIepSigna.z_f_stuetzen_iep "Zustand für Bestimmung f_psys_stuetzen_iep" UBYTE Conv.cIepSigna._.z_f_stuetzen_iep_S5_S3 1 100 0 2 ECU_ADDRESS 0xFFF8B77D DISPLAY_IDENTIFIER z_f_stuetzen_iep.iIepSigna /end MEASUREMENT
/begin MEASUREMENT iIepSigna.z_fehler_reset_iep "Zustand der Zusatzpumpe" UBYTE Conv.cIepSigna._.z_fehler_reset_iep_S5_S3 1 100 0 2 ECU_ADDRESS 0xFFF8B77B DISPLAY_IDENTIFIER z_fehler_reset_iep.iIepSigna /end MEASUREMENT
/begin MEASUREMENT iIepSigna.z_gefaelle_iep "interner Zustand fuer Verhinderung der Luftansaugung wegen Gefaelle" UBYTE Conv.cIepSigna._.z_gefaelle_iep_S5_S3 1 100 0 2 ECU_ADDRESS 0xFFF8B770 DISPLAY_IDENTIFIER z_gefaelle_iep.iIepSigna /end MEASUREMENT
/begin MEASUREMENT iIepSigna.z_luft_iep "interner Zustand fuer Verhinderung der Luftansaugung wegen Hochgeschwindigkeit" UBYTE Conv.cIepSigna._.z_luft_iep_S5_S3 1 100 0 2 ECU_ADDRESS 0xFFF8B772 DISPLAY_IDENTIFIER z_luft_iep.iIepSigna /end MEASUREMENT
/begin MEASUREMENT iIepSigna.z_nab_iep "interner Zustand fuer Verhinderung der Luftansaugung wegen Hochgeschwindigkeit" UBYTE Conv.cIepSigna._.z_nab_iep_S5_S3 1 100 0 3 ECU_ADDRESS 0xFFF8B771 DISPLAY_IDENTIFIER z_nab_iep.iIepSigna /end MEASUREMENT
/begin MEASUREMENT iIepSigna.z_wstr_iep "Zustand der Waschstrassenfunktion" UBYTE Conv.cIepSigna._.z_wstr_iep_S5_S3 1 100 0 2 ECU_ADDRESS 0xFFF8B779 DISPLAY_IDENTIFIER z_wstr_iep.iIepSigna /end MEASUREMENT
/begin MEASUREMENT iIepStSig.f_erststart_iep "Flag Erststart der Iep" UBYTE Conv.cIepStSig._.f_erststart_iep_S5_S3 1 100 0 1 BIT_MASK 0x1 ECU_ADDRESS 0xFFF8B7A8 DISPLAY_IDENTIFIER f_erststart_iep.iIepStSig /end MEASUREMENT
/begin MEASUREMENT iIepStSig.iTimerStatusIep.timer "Der aktuelle Timerwert" ULONG UMR_MSEC__10_1_0_S5_S3 1 100 0 42949672950 ECU_ADDRESS 0xFFF8B7AC DISPLAY_IDENTIFIER iTimerStatusIep.iIepStSig /end MEASUREMENT
/begin MEASUREMENT iIepStSig.status_iep "Verzögertes iep_ist - Signal" UBYTE Conv.cIepStSig._.status_iep_S5_S3 1 100 0 4 ECU_ADDRESS 0xFFF8B7A0 DISPLAY_IDENTIFIER status_iep.iIepStSig /end MEASUREMENT
/begin MEASUREMENT iIepStSig.t_vstatusiep "Zeit für den Status IEP" FLOAT32_IEEE UMR_MSEC__1_1_0_S5_S3 1 100 0 99999 ECU_ADDRESS 0xFFF8B7A4 DISPLAY_IDENTIFIER t_vstatusiep.iIepStSig /end MEASUREMENT
/begin MEASUREMENT iIepStSig.zustand_status_iep "Zustand des Statussignals in IEP" UBYTE Conv.cIepStSig._.zustand_status_iep_S5_S3 1 100 0 21 ECU_ADDRESS 0xFFF8B7A1 DISPLAY_IDENTIFIER zustand_status_iep.iIepStSig /end MEASUREMENT
/begin MEASUREMENT iItfInput.abs_reg "ABS" UBYTE Conv.cItfInput._.abs_reg_S5_S3 1 100 0 1 ECU_ADDRESS 0xFFF8AF6F DISPLAY_IDENTIFIER abs_reg.iItfInput /end MEASUREMENT
/begin MEASUREMENT iItfInput.abs_reg_status "Status des ABS" UBYTE Conv.cItfInput._.abs_reg_status_S5_S3 1 100 0 2 ECU_ADDRESS 0xFFF8AF6D DISPLAY_IDENTIFIER abs_reg_status.iItfInput /end MEASUREMENT
/begin MEASUREMENT iItfInput.ags_zka_index "Anzeige ob Moment waehrend der Schaltung ohne dki Aenderung nachgefuehrt wird." UBYTE Conv.cItfInput._.ags_zka_index_S5_S3 1 100 0 1 ECU_ADDRESS 0xFFF8B062 DISPLAY_IDENTIFIER ags_zka_index.iItfInput /end MEASUREMENT
/begin MEASUREMENT iItfInput.anhaenger_aktiv "FLAG: Anhaengerbetrieb aktiv" UBYTE Conv.cItfInput._.anhaenger_aktiv_S5_S3 1 100 0 1 BIT_MASK 0x1 ECU_ADDRESS 0xFFF8AFC8 DISPLAY_IDENTIFIER anhaenger_aktiv.iItfInput /end MEASUREMENT
/begin MEASUREMENT iItfInput.asc_passiv "FLAG: ASC funktional abgeschaltet" UBYTE Conv.cItfInput._.asc_passiv_S5_S3 1 100 0 1 BIT_MASK 0x1 ECU_ADDRESS 0xFFF8AFCA DISPLAY_IDENTIFIER asc_passiv.iItfInput /end MEASUREMENT
/begin MEASUREMENT iItfInput.asc_regelt "FLAG: ASC regelt" UBYTE Conv.cItfInput._.asc_regelt_S5_S3 1 100 0 1 BIT_MASK 0x1 ECU_ADDRESS 0xFFF8AFC9 DISPLAY_IDENTIFIER asc_regelt.iItfInput /end MEASUREMENT
/begin MEASUREMENT iItfInput.atsys_ee_busy "EEPROM Atsys Adaptionsdaten schreiben laeuft" UBYTE UMR___1_1_0_S5_S3 1 100 0 255 ECU_ADDRESS 0xFFF8AFDC DISPLAY_IDENTIFIER atsys_ee_busy.iItfInput /end MEASUREMENT
/begin MEASUREMENT iItfInput.autohold_aktiv "Autohold aktiv" UBYTE Conv.cItfInput._.autohold_aktiv_S5_S3 1 100 0 1 BIT_MASK 0x1 ECU_ADDRESS 0xFFF8B018 DISPLAY_IDENTIFIER autohold_aktiv.iItfInput /end MEASUREMENT
/begin MEASUREMENT iItfInput.ax_ref "Laengsbeschleunigung" SWORD UMR_M_SEC2_1_32_0_S5_S3 1 100 -1024 1023.96875 ECU_ADDRESS 0xFFF8B01C DISPLAY_IDENTIFIER ax_ref.iItfInput /end MEASUREMENT
/begin MEASUREMENT iItfInput.ax_ref_status "Status der Laengsbeschleunigung" UBYTE Conv.cItfInput._.ax_ref_status_S5_S3 1 100 0 2 ECU_ADDRESS 0xFFF8B020 DISPLAY_IDENTIFIER ax_ref_status.iItfInput /end MEASUREMENT
/begin MEASUREMENT iItfInput.azg_aktiv_stada "Stillstandadaption starten und stoppen über AZG" UBYTE UMR___1_1_0_S5_S3 1 100 0 255 ECU_ADDRESS 0xFFF8B070 DISPLAY_IDENTIFIER azg_aktiv_stada.iItfInput /end MEASUREMENT
/begin MEASUREMENT iItfInput.bls_defakt "FLAG: Bremslichtschalter aktiv (Default aktiv)" UBYTE Conv.cItfInput._.bls_defakt_S5_S3 1 100 0 1 BIT_MASK 0x1 ECU_ADDRESS 0xFFF8AFBD DISPLAY_IDENTIFIER bls_defakt.iItfInput /end MEASUREMENT
/begin MEASUREMENT iItfInput.bls_defpas "FLAG: Bremslichtschalter aktiv (Default passiv)" UBYTE Conv.cItfInput._.bls_defpas_S5_S3 1 100 0 1 BIT_MASK 0x1 ECU_ADDRESS 0xFFF8AFBE DISPLAY_IDENTIFIER bls_defpas.iItfInput /end MEASUREMENT
/begin MEASUREMENT iItfInput.bls_status "Statussignal Bremslichtschalter aktiv" UBYTE Conv.cItfInput._.bls_status_S5_S3 1 100 0 2 ECU_ADDRESS 0xFFF8AFD3 DISPLAY_IDENTIFIER bls_status.iItfInput /end MEASUREMENT
/begin MEASUREMENT iItfInput.bs_timer "Betriebssystemtimer im 1ms Raster" UWORD UMR___1_1_0_S5_S3 1 100 0 65535 ECU_ADDRESS 0xFFF8AFBA DISPLAY_IDENTIFIER bs_timer.iItfInput /end MEASUREMENT
/begin MEASUREMENT iItfInput.c_chip "Chiptemperatur" UBYTE UMR_GRADC__1_1_M40_S5_S3 1 100 -40 215 ECU_ADDRESS 0xFFF8AF5C DISPLAY_IDENTIFIER c_chip.iItfInput /end MEASUREMENT
/begin MEASUREMENT iItfInput.c_getr "Getriebetemperatur" UBYTE UMR_GRADC__1_1_M40_S5_S3 1 100 -40 215 ECU_ADDRESS 0xFFF8AF5A DISPLAY_IDENTIFIER c_getr.iItfInput /end MEASUREMENT
/begin MEASUREMENT iItfInput.c_getr_fl32 "Getriebetemperatur" FLOAT32_IEEE UMR_GRADC__1_1_0_S5_S3 1 100 -40 215 ECU_ADDRESS 0xFFF8AFFC DISPLAY_IDENTIFIER c_getr_fl32.iItfInput /end MEASUREMENT
/begin MEASUREMENT iItfInput.c_getr_status "Statussignal Getriebetemperatur" UBYTE Conv.cItfInput._.c_getr_status_S5_S3 1 100 0 2 ECU_ADDRESS 0xFFF8AFD2 DISPLAY_IDENTIFIER c_getr_status.iItfInput /end MEASUREMENT
/begin MEASUREMENT iItfInput.c_getrabst "Getriebeabstelltemperatur" UBYTE UMR_GRADC__1_1_M40_S5_S3 1 100 -40 150 ECU_ADDRESS 0xFFF8AFCB DISPLAY_IDENTIFIER c_getrabst.iItfInput /end MEASUREMENT
/begin MEASUREMENT iItfInput.c_mot "Motortemperatur" UBYTE UMR_GRADC__1_1_M48_S5_S3 1 100 -48 207 ECU_ADDRESS 0xFFF8AF5B DISPLAY_IDENTIFIER c_mot.iItfInput /end MEASUREMENT
/begin MEASUREMENT iItfInput.codierung_nic "NIC Codierungssignal" UBYTE UMR___1_1_0_S5_S3 1 100 0 255 ECU_ADDRESS 0xFFF8AFE8 DISPLAY_IDENTIFIER codierung_nic.iItfInput /end MEASUREMENT
/begin MEASUREMENT iItfInput.dk_pedal "Drosselklappe Pedalstellung" UBYTE UMR_PROZENT__20_51_0_S5_S3 1 100 0 100 ECU_ADDRESS 0xFFF8AF61 DISPLAY_IDENTIFIER dk_pedal.iItfInput /end MEASUREMENT
/begin MEASUREMENT iItfInput.dki "Drosselklappenistwert" UBYTE UMR_PROZENT__20_51_0_S5_S3 1 100 0 100 ECU_ADDRESS 0xFFF8AF60 DISPLAY_IDENTIFIER dki.iItfInput /end MEASUREMENT
/begin MEASUREMENT iItfInput.dki_fl32 "Drosselklappenistwert in Prozent" FLOAT32_IEEE UMR_PROZENT__1_1_0_2_S5_S3 1 100 0 100 ECU_ADDRESS 0xFFF8B00C FORMAT "%3.2" DISPLAY_IDENTIFIER dki_fl32.iItfInput /end MEASUREMENT
/begin MEASUREMENT iItfInput.dki_mmotsoll "dki oder mmotsoll_mod je nach SWI_UMSCHALTDKI" SWORD UMR___1_1_0_S5_S3 1 100 -400 1640 ECU_ADDRESS 0xFFF8B03C DISPLAY_IDENTIFIER dki_mmotsoll.iItfInput /end MEASUREMENT
/begin MEASUREMENT iItfInput.dkig "Gradient Drosselklappenistwert" SWORD UMR_PROZENT_SEC_20_51_0_S5_S3 1 100 -12849.8039216 12849.8039216 ECU_ADDRESS 0xFFF8AF62 DISPLAY_IDENTIFIER dkig.iItfInput /end MEASUREMENT
/begin MEASUREMENT iItfInput.druck_vorhanden_mod "Anforderung Kupplungsbefüllung zu starten, obwohl lt Modellierung kein Pumpendruck vorhanden ist" UBYTE Conv.cItfInput._.druck_vorhanden_mod_S5_S3 1 100 0 1 BIT_MASK 0x1 ECU_ADDRESS 0xFFF8AFC7 DISPLAY_IDENTIFIER druck_vorhanden_mod.iItfInput /end MEASUREMENT
/begin MEASUREMENT iItfInput.edsmv_ersatzinfo "Eingangsgroesse EDSMS-ErsatzInfo" UBYTE Conv.cItfInput._.edsmv_ersatzinfo_S5_S3 1 100 0 7 ECU_ADDRESS 0xFFF8AFB2 DISPLAY_IDENTIFIER edsmv_ersatzinfo.iItfInput /end MEASUREMENT
/begin MEASUREMENT iItfInput.eng_red_limit "Maximal moeglicher Me von DME auf Zuendwinkel von Moteingriffklassifizierung" SWORD UMR_NM__1_1_0_S5_S3 1 100 -32768 32767 ECU_ADDRESS 0xFFF8AF6A DISPLAY_IDENTIFIER eng_red_limit.iItfInput /end MEASUREMENT
/begin MEASUREMENT iItfInput.ersf_k0auf "FLAG: Eingangsgroesse Ersatzfkt. K0 Oeffnen" UBYTE Conv.cItfInput._.ersf_k0auf_S5_S3 1 100 0 1 BIT_MASK 0x1 ECU_ADDRESS 0xFFF8AFB9 DISPLAY_IDENTIFIER ersf_k0auf.iItfInput /end MEASUREMENT
/begin MEASUREMENT iItfInput.f_iep_shutdown "Anforderung den Zustand AUS ohne Nachlauf einzustellen" UBYTE Conv.cItfInput._.f_iep_shutdown_S5_S3 1 100 0 1 ECU_ADDRESS 0xFFF8B03E DISPLAY_IDENTIFIER f_iep_shutdown.iItfInput /end MEASUREMENT
/begin MEASUREMENT iItfInput.f_minimaldruck_ausgabe "FLAG: Minimaldruck auf zumindest allen Reibkupplungen angefordert" UBYTE Conv.cItfInput._.f_minimaldruck_ausgabe_S5_S3 1 100 0 1 BIT_MASK 0x1 ECU_ADDRESS 0xFFF8AFD9 DISPLAY_IDENTIFIER f_minimaldruck_ausgabe.iItfInput /end MEASUREMENT
/begin MEASUREMENT iItfInput.fahr_bereit "Fahrbereitschaftsinformation vom Hybridmaster" UBYTE UMR___1_1_0_S5_S3 1 100 0 128 ECU_ADDRESS 0xFFF8B047 DISPLAY_IDENTIFIER fahr_bereit.iItfInput /end MEASUREMENT
/begin MEASUREMENT iItfInput.fahrbetrieb "FLAG: Fahrbetriebstask aktiv" UBYTE Conv.cItfInput._.fahrbetrieb_S5_S3 1 100 0 1 BIT_MASK 0x1 ECU_ADDRESS 0xFFF8AED2 DISPLAY_IDENTIFIER fahrbetrieb.iItfInput /end MEASUREMENT
/begin MEASUREMENT iItfInput.feststellbremse_aktiv "FLAG: Feststellbremse aktiv (Default passiv)" UBYTE Conv.cItfInput._.feststellbremse_aktiv_S5_S3 1 100 0 1 BIT_MASK 0x1 ECU_ADDRESS 0xFFF8AFC6 DISPLAY_IDENTIFIER feststellbremse_aktiv.iItfInput /end MEASUREMENT
/begin MEASUREMENT iItfInput.fet0_active "Ist-Zustand des Highside Switches" UBYTE Conv.cItfInput._.fet0_active_S5_S3 1 100 0 4 ECU_ADDRESS 0xFFF8B060 DISPLAY_IDENTIFIER fet0_active.iItfInput /end MEASUREMENT
/begin MEASUREMENT iItfInput.fl_brake_inter "Externer Bremseingriff" UBYTE UMR___1_1_0_S5_S3 1 100 0 1 BIT_MASK 0x1 ECU_ADDRESS 0xFFF8AFF6 DISPLAY_IDENTIFIER fl_brake_inter.iItfInput /end MEASUREMENT
/begin MEASUREMENT iItfInput.fl_brake_inter_status "Status Externer Bremseingriff" UBYTE Conv.cItfInput._.fl_brake_inter_status_S5_S3 1 100 0 2 ECU_ADDRESS 0xFFF8AFF8 DISPLAY_IDENTIFIER fl_brake_inter_status.iItfInput /end MEASUREMENT
/begin MEASUREMENT iItfInput.fl_schubabschaltung_aktiv "Zustand Schubabschaltung" UBYTE UMR___1_1_0_S5_S3 1 100 0 1 BIT_MASK 0x1 ECU_ADDRESS 0xFFF8B015 DISPLAY_IDENTIFIER fl_schubabschaltung_aktiv.iItfInput /end MEASUREMENT
/begin MEASUREMENT iItfInput.flag_m_max_has_iae "Flag zur Aktivierung des max. zul. IAE_Moments aus der HAS-Funktion" UBYTE Conv.cItfInput._.flag_m_max_has_iae_S5_S3 1 100 0 1 BIT_MASK 0x1 ECU_ADDRESS 0xFFF8B04D DISPLAY_IDENTIFIER flag_m_max_has_iae.iItfInput /end MEASUREMENT
/begin MEASUREMENT iItfInput.flag_p_hys_k0_has "Flag zur Aktivierung/Deaktivierung des Druckanteils p_hys_k0 zur Hysteresekompensation" UBYTE Conv.cItfInput._.flag_p_hys_k0_has_S5_S3 1 100 0 1 BIT_MASK 0x1 ECU_ADDRESS 0xFFF8AF8C DISPLAY_IDENTIFIER flag_p_hys_k0_has.iItfInput /end MEASUREMENT
/begin MEASUREMENT iItfInput.flag_partfilt_aktiv "Zustand Dieselpartikelfilterregeneration" UBYTE Conv.cItfInput._.flag_partfilt_aktiv_S5_S3 1 100 0 1 BIT_MASK 0x1 ECU_ADDRESS 0xFFF8B05C DISPLAY_IDENTIFIER flag_partfilt_aktiv.iItfInput /end MEASUREMENT
/begin MEASUREMENT iItfInput.freigabe_posvdiag "Flag fuer die Freigabe von der position ventil Ueberwachung" UBYTE Conv.cItfInput._.freigabe_posvdiag_S5_S3 1 100 0 1 BIT_MASK 0x1 ECU_ADDRESS 0xFFF8AF1E DISPLAY_IDENTIFIER freigabe_posvdiag.iItfInput /end MEASUREMENT
/begin MEASUREMENT iItfInput.fzg_anfahrassistent_aktiv "Anfahrassistenzfunktion meldet Zustand der fahrzeugseitigen Rollverhinderung" UBYTE UMR___1_1_0_S5_S3 1 100 0 3 ECU_ADDRESS 0xFFF8B017 DISPLAY_IDENTIFIER fzg_anfahrassistent_aktiv.iItfInput /end MEASUREMENT
/begin MEASUREMENT iItfInput.fzg_geschwindigkeit "Eingangssignal Fahrzeuggeschwindigkeit (aus Abtrieb berechnet)" UWORD UMR_KM_H_1_1_0_S5_S3 1 100 0 400 ECU_ADDRESS 0xFFF8AFEA DISPLAY_IDENTIFIER fzg_geschwindigkeit.iItfInput /end MEASUREMENT
/begin MEASUREMENT iItfInput.fzg_rollverh_aktiv_stat "Status von fzg_anfahrassistent_aktiv" UBYTE Conv.cItfInput._.fzg_rollverh_aktiv_stat_S5_S3 1 100 0 2 ECU_ADDRESS 0xFFF8B01B DISPLAY_IDENTIFIER fzg_rollverh_aktiv_stat.iItfInput /end MEASUREMENT
/begin MEASUREMENT iItfInput.getr_betriebszeit "Betriebsstundenzaehler Getriebebetriebszeit (Cruisetask) in 1 min" ULONG UMR_MIN__1_1_0_S5_S3 1 100 0 65535 ECU_ADDRESS 0xFFF8AFE4 DISPLAY_IDENTIFIER getr_betriebszeit.iItfInput /end MEASUREMENT
/begin MEASUREMENT iItfInput.hdc "HDC" UBYTE Conv.cItfInput._.hdc_S5_S3 1 100 0 7 ECU_ADDRESS 0xFFF8AFF4 DISPLAY_IDENTIFIER hdc.iItfInput /end MEASUREMENT
/begin MEASUREMENT iItfInput.hillhold_aktiv "Hillhold aktiv" UBYTE Conv.cItfInput._.hillhold_aktiv_S5_S3 1 100 0 1 BIT_MASK 0x1 ECU_ADDRESS 0xFFF8B019 DISPLAY_IDENTIFIER hillhold_aktiv.iItfInput /end MEASUREMENT
/begin MEASUREMENT iItfInput.hyd_notlauf "Zustand dhydraulischer Notlauf" UBYTE Conv.cItfInput._.hyd_notlauf_S5_S3 1 100 0 1 BIT_MASK 0x1 ECU_ADDRESS 0xFFF8AFB5 DISPLAY_IDENTIFIER hyd_notlauf.iItfInput /end MEASUREMENT
/begin MEASUREMENT iItfInput.i_min_ausser_parksperre "FLAG: Minimalbestromung (N-Haltefkt)" UBYTE Conv.cItfInput._.i_min_ausser_parksperre_S5_S3 1 100 0 1 BIT_MASK 0x1 ECU_ADDRESS 0xFFF8AFD8 DISPLAY_IDENTIFIER i_min_ausser_parksperre.iItfInput /end MEASUREMENT
/begin MEASUREMENT iItfInput.iae_req_subst "Eingang: Überanpressung für IAE angefordert" UBYTE Conv.cItfInput._.iae_req_subst_S5_S3 1 100 0 1 BIT_MASK 0x1 ECU_ADDRESS 0xFFF8B04F DISPLAY_IDENTIFIER iae_req_subst.iItfInput /end MEASUREMENT
/begin MEASUREMENT iItfInput.iep_soll_has "Vorgabe Istzustand der IEP durch die HAS" UBYTE Conv.cItfInput._.iep_soll_has_S5_S3 1 100 0 4 ECU_ADDRESS 0xFFF8B041 DISPLAY_IDENTIFIER iep_soll_has.iItfInput /end MEASUREMENT
/begin MEASUREMENT iItfInput.iep_soll_sab "Vorgabe Istzustand der IEP durch SAB" UBYTE Conv.cItfInput._.iep_soll_sab_S5_S3 1 100 0 4 ECU_ADDRESS 0xFFF8B043 DISPLAY_IDENTIFIER iep_soll_sab.iItfInput /end MEASUREMENT
/begin MEASUREMENT iItfInput.iep_soll_tes "Vorgabe Istzustand der IEP durch die SAB" UBYTE Conv.cItfInput._.iep_soll_tes_S5_S3 1 100 0 3 ECU_ADDRESS 0xFFF8B045 DISPLAY_IDENTIFIER iep_soll_tes.iItfInput /end MEASUREMENT
/begin MEASUREMENT iItfInput.index_sp_sps "Index Spontanitaet Schaltpunktsteuerung aktiv" UBYTE UMR___1_1_0_S5_S3 1 100 0 99 ECU_ADDRESS 0xFFF8AFB7 DISPLAY_IDENTIFIER index_sp_sps.iItfInput /end MEASUREMENT
/begin MEASUREMENT iItfInput.init_n_abneu_gef "Init Merker von Abtriebsdrehzahl gefiltert" UBYTE Conv.cItfInput._.init_n_abneu_gef_S5_S3 1 100 0 1 BIT_MASK 0x1 ECU_ADDRESS 0xFFF8AF3F DISPLAY_IDENTIFIER init_n_abneu_gef.iItfInput /end MEASUREMENT
/begin MEASUREMENT iItfInput.init_n_t "Init Merker von Turbinendrehzahl gefiltert" UBYTE Conv.cItfInput._.init_n_t_S5_S3 1 100 0 1 BIT_MASK 0x1 ECU_ADDRESS 0xFFF8AF3E DISPLAY_IDENTIFIER init_n_t.iItfInput /end MEASUREMENT
/begin MEASUREMENT iItfInput.iv_abs_reg "ABS" UBYTE Conv.cItfInput._.iv_abs_reg_S5_S3 1 100 0 1 ECU_ADDRESS 0xFFF8AF6E DISPLAY_IDENTIFIER iv_abs_reg.iItfInput /end MEASUREMENT
/begin MEASUREMENT iItfInput.iv_abs_reg_status "Status des ABS" UBYTE Conv.cItfInput._.iv_abs_reg_status_S5_S3 1 100 0 2 ECU_ADDRESS 0xFFF8AF6C DISPLAY_IDENTIFIER iv_abs_reg_status.iItfInput /end MEASUREMENT
/begin MEASUREMENT iItfInput.iv_ags_zka_index "Eingangsgroese: Anzeige ob Moment waehrend der Schaltung ohne dki Aenderung nachgefuehrt wird." UBYTE Conv.cItfInput._.iv_ags_zka_index_S5_S3 1 100 0 1 ECU_ADDRESS 0xFFF8B063 DISPLAY_IDENTIFIER iv_ags_zka_index.iItfInput /end MEASUREMENT
/begin MEASUREMENT iItfInput.iv_anhaengeraktiv "FLAG: Anhaengerbetrieb aktiv" UBYTE Conv.cItfInput._.iv_anhaengeraktiv_S5_S3 1 100 0 1 BIT_MASK 0x1 ECU_ADDRESS 0xFFF8AEFE DISPLAY_IDENTIFIER iv_anhaengeraktiv.iItfInput /end MEASUREMENT
/begin MEASUREMENT iItfInput.iv_ascpas "FLAG: Eingangsgroesse ASC funktional abgeschaltet" UBYTE Conv.cItfInput._.iv_ascpas_S5_S3 1 100 0 1 BIT_MASK 0x1 ECU_ADDRESS 0xFFF8AF07 DISPLAY_IDENTIFIER iv_ascpas.iItfInput /end MEASUREMENT
/begin MEASUREMENT iItfInput.iv_ascreg "FLAG: ASC regelt" UBYTE Conv.cItfInput._.iv_ascreg_S5_S3 1 100 0 1 BIT_MASK 0x1 ECU_ADDRESS 0xFFF8AF06 DISPLAY_IDENTIFIER iv_ascreg.iItfInput /end MEASUREMENT
/begin MEASUREMENT iItfInput.iv_atsys_ee_busy "EEPROM Atsys Adaptionsdaten schreiben laeuft" UBYTE UMR___1_1_0_S5_S3 1 100 0 255 ECU_ADDRESS 0xFFF8AF09 DISPLAY_IDENTIFIER iv_atsys_ee_busy.iItfInput /end MEASUREMENT
/begin MEASUREMENT iItfInput.iv_ax_ref "Laengsbeschleunigung" SWORD UMR_M_SEC2_1_32_0_S5_S3 1 100 -1024 1023.96875 ECU_ADDRESS 0xFFF8B01E DISPLAY_IDENTIFIER iv_ax_ref.iItfInput /end MEASUREMENT
/begin MEASUREMENT iItfInput.iv_ax_ref_status "Status der Laengsbeschleunigung" UBYTE Conv.cItfInput._.iv_ax_ref_status_S5_S3 1 100 0 2 ECU_ADDRESS 0xFFF8B021 DISPLAY_IDENTIFIER iv_ax_ref_status.iItfInput /end MEASUREMENT
/begin MEASUREMENT iItfInput.iv_blsdefakt "FLAG: Bremslichtschalter aktiv (Default aktiv)" UBYTE Conv.cItfInput._.iv_blsdefakt_S5_S3 1 100 0 1 BIT_MASK 0x1 ECU_ADDRESS 0xFFF8AEF8 DISPLAY_IDENTIFIER iv_blsdefakt.iItfInput /end MEASUREMENT
/begin MEASUREMENT iItfInput.iv_blsdefpas "FLAG: Bremslichtschalter aktiv (Default passiv)" UBYTE Conv.cItfInput._.iv_blsdefpas_S5_S3 1 100 0 1 BIT_MASK 0x1 ECU_ADDRESS 0xFFF8AEF9 DISPLAY_IDENTIFIER iv_blsdefpas.iItfInput /end MEASUREMENT
/begin MEASUREMENT iItfInput.iv_blsstatus "Eingangsgroesse Statussignal Bremslichtschalter aktiv" UBYTE Conv.cItfInput._.iv_blsstatus_S5_S3 1 100 0 2 ECU_ADDRESS 0xFFF8AFCC DISPLAY_IDENTIFIER iv_blsstatus.iItfInput /end MEASUREMENT
/begin MEASUREMENT iItfInput.iv_bstimer "Betriebssystemtimer im 1ms Raster" UWORD UMR___1_1_0_S5_S3 1 100 0 65535 ECU_ADDRESS 0xFFF8AF28 DISPLAY_IDENTIFIER iv_bstimer.iItfInput /end MEASUREMENT
/begin MEASUREMENT iItfInput.iv_cchip "Chiptemperatur" UBYTE UMR_GRADC__1_1_M40_S5_S3 1 100 -40 215 ECU_ADDRESS 0xFFF8AEDC DISPLAY_IDENTIFIER iv_cchip.iItfInput /end MEASUREMENT
/begin MEASUREMENT iItfInput.iv_cgetr "Getriebetemperatur" UBYTE UMR_GRADC__1_1_M40_S5_S3 1 100 -40 215 ECU_ADDRESS 0xFFF8AEDA DISPLAY_IDENTIFIER iv_cgetr.iItfInput /end MEASUREMENT
/begin MEASUREMENT iItfInput.iv_cgetrstatus "Eingangsgroesse Statussignal Getriebetemperatur" UBYTE Conv.cItfInput._.iv_cgetrstatus_S5_S3 1 100 0 2 ECU_ADDRESS 0xFFF8AF26 DISPLAY_IDENTIFIER iv_cgetrstatus.iItfInput /end MEASUREMENT
/begin MEASUREMENT iItfInput.iv_cmot "Motortemperatur" UBYTE UMR_GRADC__1_1_M48_S5_S3 1 100 -48 207 ECU_ADDRESS 0xFFF8AEDB DISPLAY_IDENTIFIER iv_cmot.iItfInput /end MEASUREMENT
/begin MEASUREMENT iItfInput.iv_codierungnic "NIC Codierungssignal" UBYTE UMR___1_1_0_S5_S3 1 100 0 255 ECU_ADDRESS 0xFFF8AF20 DISPLAY_IDENTIFIER iv_codierungnic.iItfInput /end MEASUREMENT
/begin MEASUREMENT iItfInput.iv_dki "Eingangsgroesse fuer dki, wenn dki Ersatzgroesse" UBYTE UMR_PROZENT__20_51_0_S5_S3 1 100 0 100 ECU_ADDRESS 0xFFF8AEE6 DISPLAY_IDENTIFIER iv_dki.iItfInput /end MEASUREMENT
/begin MEASUREMENT iItfInput.iv_dkpedal "Drosselklappe Pedalstellung" UBYTE UMR_PROZENT__20_51_0_S5_S3 1 100 0 100 ECU_ADDRESS 0xFFF8AEFF DISPLAY_IDENTIFIER iv_dkpedal.iItfInput /end MEASUREMENT
/begin MEASUREMENT iItfInput.iv_druck_vorhanden_mod "Anforderung Kupplungsbefüllung zu starten, obwohl lt. Modellierung kein Pumpendruck vorhanden ist" UBYTE Conv.cItfInput._.iv_druck_vorhanden_mod_S5_S3 1 100 0 1 BIT_MASK 0x1 ECU_ADDRESS 0xFFF8AEFD DISPLAY_IDENTIFIER iv_druck_vorhanden_mod.iItfInput /end MEASUREMENT
/begin MEASUREMENT iItfInput.iv_edsmversatzinfo "Eingangsgroesse EDSMS-ErsatzInfo" UBYTE Conv.cItfInput._.iv_edsmversatzinfo_S5_S3 1 100 0 7 ECU_ADDRESS 0xFFF8AED6 DISPLAY_IDENTIFIER iv_edsmversatzinfo.iItfInput /end MEASUREMENT
/begin MEASUREMENT iItfInput.iv_eng_red_limit "Eingang: Maximal moeglicher Me von DME auf Zuendwinkel von Moteingriffklassifizierung" SWORD UMR_NM__1_1_0_S5_S3 1 100 -32768 32767 ECU_ADDRESS 0xFFF8AF68 DISPLAY_IDENTIFIER iv_eng_red_limit.iItfInput /end MEASUREMENT
/begin MEASUREMENT iItfInput.iv_f_iep_shutdown "Anforderung den Zustand AUS ohne Nachlauf einzustellen" UBYTE Conv.cItfInput._.iv_f_iep_shutdown_S5_S3 1 100 0 1 ECU_ADDRESS 0xFFF8B03F DISPLAY_IDENTIFIER iv_f_iep_shutdown.iItfInput /end MEASUREMENT
/begin MEASUREMENT iItfInput.iv_fahr_bereit "Fahrbereitschaftsinformation vom Hybridmaster" UBYTE UMR___1_1_0_S5_S3 1 100 0 128 ECU_ADDRESS 0xFFF8B046 DISPLAY_IDENTIFIER iv_fahr_bereit.iItfInput /end MEASUREMENT
/begin MEASUREMENT iItfInput.iv_fahrbet_task "FLAG: Eingangsgroesse Fahrbetriebstask aktiv" UBYTE Conv.cItfInput._.iv_fahrbet_task_S5_S3 1 100 0 1 BIT_MASK 0x1 ECU_ADDRESS 0xFFF8AED7 DISPLAY_IDENTIFIER iv_fahrbet_task.iItfInput /end MEASUREMENT
/begin MEASUREMENT iItfInput.iv_feststellbremseaktiv "FLAG: Feststellbremse aktiv (Default passiv)" UBYTE Conv.cItfInput._.iv_feststellbremseaktiv_S5_S3 1 100 0 1 BIT_MASK 0x1 ECU_ADDRESS 0xFFF8AEFC DISPLAY_IDENTIFIER iv_feststellbremseaktiv.iItfInput /end MEASUREMENT
/begin MEASUREMENT iItfInput.iv_fet0_active "Ist-Zustand des Highside Switches" UBYTE Conv.cItfInput._.iv_fet0_active_S5_S3 1 100 0 4 ECU_ADDRESS 0xFFF8B061 DISPLAY_IDENTIFIER iv_fet0_active.iItfInput /end MEASUREMENT
/begin MEASUREMENT iItfInput.iv_fl_brake_inter "Externer Bremseingriff" UBYTE UMR___1_1_0_S5_S3 1 100 0 1 ECU_ADDRESS 0xFFF8AFF7 DISPLAY_IDENTIFIER iv_fl_brake_inter.iItfInput /end MEASUREMENT
/begin MEASUREMENT iItfInput.iv_fl_brake_inter_status "Status Externer Bremseingriff" UBYTE Conv.cItfInput._.iv_fl_brake_inter_status_S5_S3 1 100 0 2 ECU_ADDRESS 0xFFF8AFF9 DISPLAY_IDENTIFIER iv_fl_brake_inter_status.iItfInput /end MEASUREMENT
/begin MEASUREMENT iItfInput.iv_fl_schubabschaltung_aktiv "Zustand Schubabschaltung" UBYTE UMR___1_1_0_S5_S3 1 100 0 1 ECU_ADDRESS 0xFFF8B014 DISPLAY_IDENTIFIER iv_fl_schubabschaltung_aktiv.iItfInput /end MEASUREMENT
/begin MEASUREMENT iItfInput.iv_flag_m_max_has_iae "Eingang: Flag zur Aktivierung des max. zul. IAE_Moments aus der HAS-Funktion" UBYTE Conv.cItfInput._.iv_flag_m_max_has_iae_S5_S3 1 100 0 1 BIT_MASK 0x1 ECU_ADDRESS 0xFFF8B04C DISPLAY_IDENTIFIER iv_flag_m_max_has_iae.iItfInput /end MEASUREMENT
/begin MEASUREMENT iItfInput.iv_flag_p_hys_k0_has "Flag zur Aktivierung/Deaktivierung des Druckanteils p_hys_k0 zur Hysteresekompensation" UBYTE Conv.cItfInput._.iv_flag_p_hys_k0_has_S5_S3 1 100 0 1 ECU_ADDRESS 0xFFF8AFAC DISPLAY_IDENTIFIER iv_flag_p_hys_k0_has.iItfInput /end MEASUREMENT
/begin MEASUREMENT iItfInput.iv_flag_partfilt_aktiv "Zustand Dieselpartikelfilterregeneration" UBYTE Conv.cItfInput._.iv_flag_partfilt_aktiv_S5_S3 1 100 0 1 BIT_MASK 0x1 ECU_ADDRESS 0xFFF8B05D DISPLAY_IDENTIFIER iv_flag_partfilt_aktiv.iItfInput /end MEASUREMENT
/begin MEASUREMENT iItfInput.iv_freigabe_posvdiag "Flag fuer die Freigabe von der position ventil Ueberwachung" UBYTE Conv.cItfInput._.iv_freigabe_posvdiag_S5_S3 1 100 0 1 BIT_MASK 0x1 ECU_ADDRESS 0xFFF8AF1F DISPLAY_IDENTIFIER iv_freigabe_posvdiag.iItfInput /end MEASUREMENT
/begin MEASUREMENT iItfInput.iv_fzg_anfahrassistent_aktiv "Anfahrassistenzfunktion meldet Zustand der fahrzeugseitigen Rollverhinderung" UBYTE UMR___1_1_0_S5_S3 1 100 0 3 ECU_ADDRESS 0xFFF8B016 DISPLAY_IDENTIFIER iv_fzg_anfahrassistent_aktiv.iItfInput /end MEASUREMENT
/begin MEASUREMENT iItfInput.iv_fzg_rollverh_aktiv_stat "Status von fzg_anfahrassistent_aktiv" UBYTE Conv.cItfInput._.iv_fzg_rollverh_aktiv_stat_S5_S3 1 100 0 2 ECU_ADDRESS 0xFFF8B01A DISPLAY_IDENTIFIER iv_fzg_rollverh_aktiv_stat.iItfInput /end MEASUREMENT
/begin MEASUREMENT iItfInput.iv_fzggeschwindigkeit "Eingangssignal Fahrzeuggeschwindigkeit (aus Abtrieb berechnet)" UWORD UMR_KM_H_1_1_0_S5_S3 1 100 0 400 ECU_ADDRESS 0xFFF8AF14 DISPLAY_IDENTIFIER iv_fzggeschwindigkeit.iItfInput /end MEASUREMENT
/begin MEASUREMENT iItfInput.iv_getrbetriebszeit "Betriebsstundenzaehler Getriebebetriebszeit (Cruisetask) in 1 min" ULONG UMR_MIN__1_1_0_S5_S3 1 100 0 65535 ECU_ADDRESS 0xFFF8AF10 DISPLAY_IDENTIFIER iv_getrbetriebszeit.iItfInput /end MEASUREMENT
/begin MEASUREMENT iItfInput.iv_gnotinfo "Eingangsgroesse Notgang Info" UBYTE Conv.cItfInput._.iv_gnotinfo_S5_S3 1 100 0 40 ECU_ADDRESS 0xFFF8AED3 DISPLAY_IDENTIFIER iv_gnotinfo.iItfInput /end MEASUREMENT
/begin MEASUREMENT iItfInput.iv_gsoll "Sollgang" SBYTE Conv.cItfInput._.iv_gsoll_S5_S3 1 100 -1 8 ECU_ADDRESS 0xFFF8AEF7 DISPLAY_IDENTIFIER iv_gsoll.iItfInput /end MEASUREMENT
/begin MEASUREMENT iItfInput.iv_hdc "Iv-Grösse Hdc" UBYTE Conv.cItfInput._.iv_hdc_S5_S3 1 100 0 7 ECU_ADDRESS 0xFFF8AFF5 DISPLAY_IDENTIFIER iv_hdc.iItfInput /end MEASUREMENT
/begin MEASUREMENT iItfInput.iv_iae_req_subst "iv-Größe: Überanpressung für IAE angefordert" UBYTE Conv.cItfInput._.iv_iae_req_subst_S5_S3 1 100 0 1 BIT_MASK 0x1 ECU_ADDRESS 0xFFF8B04E DISPLAY_IDENTIFIER iv_iae_req_subst.iItfInput /end MEASUREMENT
/begin MEASUREMENT iItfInput.iv_iep_soll_has "Vorgabe Istzustand der IEP durch die HAS" UBYTE Conv.cItfInput._.iv_iep_soll_has_S5_S3 1 100 0 4 ECU_ADDRESS 0xFFF8B040 DISPLAY_IDENTIFIER iv_iep_soll_has.iItfInput /end MEASUREMENT
/begin MEASUREMENT iItfInput.iv_iep_soll_sab "Vorgabe Istzustand der IEP durch SAB" UBYTE Conv.cItfInput._.iv_iep_soll_sab_S5_S3 1 100 0 4 ECU_ADDRESS 0xFFF8B042 DISPLAY_IDENTIFIER iv_iep_soll_sab.iItfInput /end MEASUREMENT
/begin MEASUREMENT iItfInput.iv_iep_soll_tes "Vorgabe Istzustand der IEP durch die SAB" UBYTE Conv.cItfInput._.iv_iep_soll_tes_S5_S3 1 100 0 3 ECU_ADDRESS 0xFFF8B044 DISPLAY_IDENTIFIER iv_iep_soll_tes.iItfInput /end MEASUREMENT
/begin MEASUREMENT iItfInput.iv_indexspsps "Index Spontanitaet Schaltpunktsteuerung aktiv" UBYTE UMR___1_1_0_S5_S3 1 100 0 255 ECU_ADDRESS 0xFFF8AF00 DISPLAY_IDENTIFIER iv_indexspsps.iItfInput /end MEASUREMENT
/begin MEASUREMENT iItfInput.iv_k0_soll "K0- Sollzustand aus der Hybrid-Ablauf-Steuerung" UBYTE Conv.cItfInput._.iv_k0_soll_S5_S3 1 100 0 5 ECU_ADDRESS 0xFFF8AFA2 DISPLAY_IDENTIFIER iv_k0_soll.iItfInput /end MEASUREMENT
/begin MEASUREMENT iItfInput.iv_ll_mot_aktiv "iv-Groesse Leerlaufregler aktiv" UBYTE UMR___1_1_0_S5_S3 1 100 0 255 ECU_ADDRESS 0xFFF8B058 DISPLAY_IDENTIFIER iv_ll_mot_aktiv.iItfInput /end MEASUREMENT
/begin MEASUREMENT iItfInput.iv_ll_mot_aktiv_status "iv-Groesse Status zu GET_LL_MOT_AKTIV" UBYTE Conv.cItfInput._.iv_ll_mot_aktiv_status_S5_S3 1 100 0 2 ECU_ADDRESS 0xFFF8B05A DISPLAY_IDENTIFIER iv_ll_mot_aktiv_status.iItfInput /end MEASUREMENT
/begin MEASUREMENT iItfInput.iv_m_emist "E-Maschinen Istmoment" SWORD UMR_NM__1_1_0_S5_S3 1 100 -1024 1024 ECU_ADDRESS 0xFFF8AF92 DISPLAY_IDENTIFIER iv_m_emist.iItfInput /end MEASUREMENT
/begin MEASUREMENT iItfInput.iv_m_emsoll "E-Maschinensollmoment mit Getriebeeingriff" SWORD UMR_NM__1_1_0_S5_S3 1 100 -1024 1024 ECU_ADDRESS 0xFFF8AF94 DISPLAY_IDENTIFIER iv_m_emsoll.iItfInput /end MEASUREMENT
/begin MEASUREMENT iItfInput.iv_m_max_dyn_em "Maximales kurzzeitig mögliches EM Moment" SWORD UMR_NM__1_1_0_S5_S3 1 100 -1024 1024 ECU_ADDRESS 0xFFF8AF96 DISPLAY_IDENTIFIER iv_m_max_dyn_em.iItfInput /end MEASUREMENT
/begin MEASUREMENT iItfInput.iv_m_max_has_iae "Eingang: maximal zulässiges IAE-Moment aus der HAS-Funktion" SWORD UMR_NM__1_1_0_S5_S3 1 100 -200 1300 ECU_ADDRESS 0xFFF8B052 DISPLAY_IDENTIFIER iv_m_max_has_iae.iItfInput /end MEASUREMENT
/begin MEASUREMENT iItfInput.iv_m_min_dyn_em "Minimal kurzzeitig mögliches EM Moment" SWORD UMR_NM__1_1_0_S5_S3 1 100 -1024 1024 ECU_ADDRESS 0xFFF8AF98 DISPLAY_IDENTIFIER iv_m_min_dyn_em.iItfInput /end MEASUREMENT
/begin MEASUREMENT iItfInput.iv_m_motsoll_mod "iv-Wert m_motsoll ohne Begrenzung auf das Reservemoment" SWORD UMR_NM__1_1_0_S5_S3 1 100 -400 1640 ECU_ADDRESS 0xFFF8B038 DISPLAY_IDENTIFIER iv_m_motsoll_mod.iItfInput /end MEASUREMENT
/begin MEASUREMENT iItfInput.iv_m_motsoll_mod_status "iv-Messgröße Statussignal zu m_motsoll_mod" UBYTE Conv.cItfInput._.iv_m_motsoll_mod_status_S5_S3 1 100 0 2 ECU_ADDRESS 0xFFF8B03A DISPLAY_IDENTIFIER iv_m_motsoll_mod_status.iItfInput /end MEASUREMENT
/begin MEASUREMENT iItfInput.iv_m_soll_k0_has "HAS Momentenvorgabe" SWORD UMR_NM__1_1_0_S5_S3 1 100 0 800 ECU_ADDRESS 0xFFF8AFA6 DISPLAY_IDENTIFIER iv_m_soll_k0_has.iItfInput /end MEASUREMENT
/begin MEASUREMENT iItfInput.iv_m_vmist "Verbrennungsmotoristmoment mit Getriebeeingriff" SWORD UMR_NM__1_1_0_S5_S3 1 100 -1500 1500 ECU_ADDRESS 0xFFF8AF9A DISPLAY_IDENTIFIER iv_m_vmist.iItfInput /end MEASUREMENT
/begin MEASUREMENT iItfInput.iv_m_vmsoll "Verbrennungsmotorsollmoment mit Getriebeeingriff" SWORD UMR_NM__1_1_0_S5_S3 1 100 -1500 1500 ECU_ADDRESS 0xFFF8AF9C DISPLAY_IDENTIFIER iv_m_vmsoll.iItfInput /end MEASUREMENT
/begin MEASUREMENT iItfInput.iv_mg_soll_k0_neg_has "Negative Drehmomentänderung K0" SWORD UMR_NM_SEC_1_1_0_S5_S3 1 100 -10000 0 ECU_ADDRESS 0xFFF8AFA8 DISPLAY_IDENTIFIER iv_mg_soll_k0_neg_has.iItfInput /end MEASUREMENT
/begin MEASUREMENT iItfInput.iv_mg_soll_k0_pos_has "Positive Drehmomentänderungen" SWORD UMR_NM_SEC_1_1_0_S5_S3 1 100 0 10000 ECU_ADDRESS 0xFFF8AFAA DISPLAY_IDENTIFIER iv_mg_soll_k0_pos_has.iItfInput /end MEASUREMENT
/begin MEASUREMENT iItfInput.iv_mmot "Motormoment das von der DME gesendet wird" SWORD UMR_NM__1_1_0_S5_S3 1 100 -200 1300 ECU_ADDRESS 0xFFF8AEE0 DISPLAY_IDENTIFIER iv_mmot.iItfInput /end MEASUREMENT
/begin MEASUREMENT iItfInput.iv_mmotist "Eingangsgroesse Kurbelwellenistmoment" SWORD UMR_NM__1_1_0_S5_S3 1 100 -200 1300 ECU_ADDRESS 0xFFF8AEE2 DISPLAY_IDENTIFIER iv_mmotist.iItfInput /end MEASUREMENT
/begin MEASUREMENT iItfInput.iv_mmotsoll_in "Eingangsgroesse Motorsollmoment" SWORD UMR_NM__1_1_0_S5_S3 1 100 -200 1300 ECU_ADDRESS 0xFFF8AEE4 DISPLAY_IDENTIFIER iv_mmotsoll_in.iItfInput /end MEASUREMENT
/begin MEASUREMENT iItfInput.iv_mmotstatus "Eingangsgroesse Statussignal Motormoment" UBYTE Conv.cItfInput._.iv_mmotstatus_S5_S3 1 100 0 2 ECU_ADDRESS 0xFFF8AF25 DISPLAY_IDENTIFIER iv_mmotstatus.iItfInput /end MEASUREMENT
/begin MEASUREMENT iItfInput.iv_mvg_vm_start "Startart der VM" UBYTE Conv.cItfInput._.iv_mvg_vm_start_S5_S3 1 100 0 8 ECU_ADDRESS 0xFFF8AF8E DISPLAY_IDENTIFIER iv_mvg_vm_start.iItfInput /end MEASUREMENT
/begin MEASUREMENT iItfInput.iv_n6 "Drehzahl an der Baugruppe 6" UWORD UMR_U_MIN_1_1_0_S5_S3 1 100 0 65535 ECU_ADDRESS 0xFFF8AEE8 DISPLAY_IDENTIFIER iv_n6.iItfInput /end MEASUREMENT
/begin MEASUREMENT iItfInput.iv_n_ab_dir "Drehrichtung Abtrieb Schnittstelle" UBYTE Conv.cItfInput._.iv_n_ab_dir_S5_S3 1 100 0 2 ECU_ADDRESS 0xFFF8B023 DISPLAY_IDENTIFIER iv_n_ab_dir.iItfInput /end MEASUREMENT
/begin MEASUREMENT iItfInput.iv_n_ab_dir_status "Drehrichtung Abtieb Status" UBYTE Conv.cItfInput._.iv_n_ab_dir_status_S5_S3 1 100 0 2 ECU_ADDRESS 0xFFF8B026 DISPLAY_IDENTIFIER iv_n_ab_dir_status.iItfInput /end MEASUREMENT
/begin MEASUREMENT iItfInput.iv_n_dif_iae_virt "reeller Bauteilschlupf von Kupplung B (auf Getriebeeingang bezogen)" SWORD UMR_U_MIN_1_1_0_S5_S3 1 100 -32768 32767 ECU_ADDRESS 0xFFF8B032 DISPLAY_IDENTIFIER iv_n_dif_iae_virt.iItfInput /end MEASUREMENT
/begin MEASUREMENT iItfInput.iv_n_mot_llsoll_has "Eingang: Minimale Drehzahl E-Motor (Betrieb ohne externe Ölpumpe)" UBYTE UMR_U_MIN_10_1_0_S5_S3 1 100 0 2550 ECU_ADDRESS 0xFFF8B056 DISPLAY_IDENTIFIER iv_n_mot_llsoll_has.iItfInput /end MEASUREMENT
/begin MEASUREMENT iItfInput.iv_n_t_dir "Drehrichtung Turbine Schnittstelle" UBYTE Conv.cItfInput._.iv_n_t_dir_S5_S3 1 100 0 2 ECU_ADDRESS 0xFFF8B025 DISPLAY_IDENTIFIER iv_n_t_dir.iItfInput /end MEASUREMENT
/begin MEASUREMENT iItfInput.iv_n_t_dir_status "Drehrichtung Turbine Status" UBYTE Conv.cItfInput._.iv_n_t_dir_status_S5_S3 1 100 0 2 ECU_ADDRESS 0xFFF8B028 DISPLAY_IDENTIFIER iv_n_t_dir_status.iItfInput /end MEASUREMENT
/begin MEASUREMENT iItfInput.iv_n_vm "Verbrennungsmotoristdrehzahl" UWORD UMR_U_MIN_1_1_0_S5_S3 1 100 0 8000 ECU_ADDRESS 0xFFF8AF9E DISPLAY_IDENTIFIER iv_n_vm.iItfInput /end MEASUREMENT
/begin MEASUREMENT iItfInput.iv_n_vm_status "Status Drehzahl VM" UBYTE Conv.cItfInput._.iv_n_vm_status_S5_S3 1 100 0 2 ECU_ADDRESS 0xFFF8AFA1 DISPLAY_IDENTIFIER iv_n_vm_status.iItfInput /end MEASUREMENT
/begin MEASUREMENT iItfInput.iv_nabneu "Abtriebsdrehzahl ungefiltert" UWORD UMR_U_MIN_1_1_0_S5_S3 1 100 0 8160 ECU_ADDRESS 0xFFF8AEEA DISPLAY_IDENTIFIER iv_nabneu.iItfInput /end MEASUREMENT
/begin MEASUREMENT iItfInput.iv_nabstatus "Eingangsgroesse Statussignal Abtriebdrehzahl" UBYTE Conv.cItfInput._.iv_nabstatus_S5_S3 1 100 0 2 ECU_ADDRESS 0xFFF8AF22 DISPLAY_IDENTIFIER iv_nabstatus.iItfInput /end MEASUREMENT
/begin MEASUREMENT iItfInput.iv_ndiaeneu "Differenzdrehzahl Anfahrelement" SWORD UMR_U_MIN_1_1_0_S5_S3 1 100 -32767 32767 ECU_ADDRESS 0xFFF8AEF0 DISPLAY_IDENTIFIER iv_ndiaeneu.iItfInput /end MEASUREMENT
/begin MEASUREMENT iItfInput.iv_neigung "Eingangsgroesse Neigungssensor-Signal" UBYTE UMR_GRAD__1_3_M128_S5_S3 1 100 -42.6666666667 42 ECU_ADDRESS 0xFFF8AF0F DISPLAY_IDENTIFIER iv_neigung.iItfInput /end MEASUREMENT
/begin MEASUREMENT iItfInput.iv_neigungstatus "Eingangsgroesse Statussignal zu Neigungssensorsignal" UBYTE Conv.cItfInput._.iv_neigungstatus_S5_S3 1 100 0 2 ECU_ADDRESS 0xFFF8AF27 DISPLAY_IDENTIFIER iv_neigungstatus.iItfInput /end MEASUREMENT
/begin MEASUREMENT iItfInput.iv_nmot "Motordrehzahl" UWORD UMR_U_MIN_1_1_0_S5_S3 1 100 0 8160 ECU_ADDRESS 0xFFF8AEEC DISPLAY_IDENTIFIER iv_nmot.iItfInput /end MEASUREMENT
/begin MEASUREMENT iItfInput.iv_nmotabregel "Eingangsgroesse Motorabregeldrehzahl" UWORD UMR_U_MIN_1_1_0_S5_S3 1 100 0 10000 ECU_ADDRESS 0xFFF8AF04 DISPLAY_IDENTIFIER iv_nmotabregel.iItfInput /end MEASUREMENT
/begin MEASUREMENT iItfInput.iv_nmotsolleer "Motorleerlaufsolldrehzahl" UWORD UMR_U_MIN_1_1_0_S5_S3 1 100 0 8160 ECU_ADDRESS 0xFFF8AF02 DISPLAY_IDENTIFIER iv_nmotsolleer.iItfInput /end MEASUREMENT
/begin MEASUREMENT iItfInput.iv_nmotstatus "Eingangsgroesse Statussignal Motordrehzahl" UBYTE Conv.cItfInput._.iv_nmotstatus_S5_S3 1 100 0 2 ECU_ADDRESS 0xFFF8AF24 DISPLAY_IDENTIFIER iv_nmotstatus.iItfInput /end MEASUREMENT
/begin MEASUREMENT iItfInput.iv_notltask "FLAG: Eingangsgroesse Notlauftask aktiv" UBYTE Conv.cItfInput._.iv_notltask_S5_S3 1 100 0 1 BIT_MASK 0x1 ECU_ADDRESS 0xFFF8AED8 DISPLAY_IDENTIFIER iv_notltask.iItfInput /end MEASUREMENT
/begin MEASUREMENT iItfInput.iv_ntneu "Turbinendrehzahl ungefiltert" UWORD UMR_U_MIN_1_1_0_S5_S3 1 100 0 8160 ECU_ADDRESS 0xFFF8AEEE DISPLAY_IDENTIFIER iv_ntneu.iItfInput /end MEASUREMENT
/begin MEASUREMENT iItfInput.iv_ntstatus "Eingangsgroesse Statussignal Turbinendrehzahl" UBYTE Conv.cItfInput._.iv_ntstatus_S5_S3 1 100 0 2 ECU_ADDRESS 0xFFF8AF23 DISPLAY_IDENTIFIER iv_ntstatus.iItfInput /end MEASUREMENT
/begin MEASUREMENT iItfInput.iv_ntu_virt "virtuelle Turbinendrehzahl ungefiltert" UWORD UMR_U_MIN_1_1_0_S5_S3 1 100 0 8160 ECU_ADDRESS 0xFFF8B02E DISPLAY_IDENTIFIER iv_ntu_virt.iItfInput /end MEASUREMENT
/begin MEASUREMENT iItfInput.iv_ntu_virt_dir "virtuelle Drehrichtung Turbine Schnittstelle" UBYTE Conv.cItfInput._.iv_ntu_virt_dir_S5_S3 1 100 0 2 ECU_ADDRESS 0xFFF8B02A DISPLAY_IDENTIFIER iv_ntu_virt_dir.iItfInput /end MEASUREMENT
/begin MEASUREMENT iItfInput.iv_ntu_virt_dir_status "virtuelle Drehrichtung Turbine Status" UBYTE Conv.cItfInput._.iv_ntu_virt_dir_status_S5_S3 1 100 0 2 ECU_ADDRESS 0xFFF8B02C DISPLAY_IDENTIFIER iv_ntu_virt_dir_status.iItfInput /end MEASUREMENT
/begin MEASUREMENT iItfInput.iv_p_air "iv-Größe Luftdruck" UWORD UMR_MBAR__1_1_0_S5_S3 1 100 0 2026 ECU_ADDRESS 0xFFF8B048 DISPLAY_IDENTIFIER iv_p_air.iItfInput /end MEASUREMENT
/begin MEASUREMENT iItfInput.iv_p_bremse_halbe "iv-Größe für Bremsdruck des Fahrzeugs, quant: 0,5 bar" SWORD UMR_BAR__1_2_0_S5_S3 1 100 -100 1000 ECU_ADDRESS 0xFFF8AFC4 DISPLAY_IDENTIFIER iv_p_bremse_halbe.iItfInput /end MEASUREMENT
/begin MEASUREMENT iItfInput.iv_pbremse "Eingangsgroesse Bremsdruckinformation" SWORD UMR_BAR__1_1_0_S5_S3 1 100 -100 1000 ECU_ADDRESS 0xFFF8AEFA DISPLAY_IDENTIFIER iv_pbremse.iItfInput /end MEASUREMENT
/begin MEASUREMENT iItfInput.iv_pos "Waehlhebelposition" UBYTE Conv.cItfInput._.iv_pos_S5_S3 1 100 0 8 ECU_ADDRESS 0xFFF8AEF6 DISPLAY_IDENTIFIER iv_pos.iItfInput /end MEASUREMENT
/begin MEASUREMENT iItfInput.iv_posstatus "Eingangsgroesse Statussignal zum Positionshebel pos" UBYTE Conv.cItfInput._.iv_posstatus_S5_S3 1 100 0 2 ECU_ADDRESS 0xFFF8AF21 DISPLAY_IDENTIFIER iv_posstatus.iItfInput /end MEASUREMENT
/begin MEASUREMENT iItfInput.iv_preadaption_start "Testersignal zur aktivierung der Preadaption nur ein Spezieller aktiviert die Funktion" UBYTE UMR___1_1_0_S5_S3 1 100 0 255 ECU_ADDRESS 0xFFF8B06E DISPLAY_IDENTIFIER iv_preadaption_start.iItfInput /end MEASUREMENT
/begin MEASUREMENT iItfInput.iv_progauswahl "Programmauswahl Sport/Manuell/Tipp/L-Programm" UBYTE UMR___1_1_0_S5_S3 1 100 0 8 ECU_ADDRESS 0xFFF8AF0B DISPLAY_IDENTIFIER iv_progauswahl.iItfInput /end MEASUREMENT
/begin MEASUREMENT iItfInput.iv_pssensorsignal "Erfasstes Sensorsignal der Parksperre" UBYTE UMR___1_1_0_S5_S3 1 100 0 3 ECU_ADDRESS 0xFFF8AF08 DISPLAY_IDENTIFIER iv_pssensorsignal.iItfInput /end MEASUREMENT
/begin MEASUREMENT iItfInput.iv_pt_damping_active "Information, if the power train damping is active or not active" UBYTE Conv.cItfInput._.iv_pt_damping_active_S5_S3 1 100 0 1 ECU_ADDRESS 0xFFF8AF90 DISPLAY_IDENTIFIER iv_pt_damping_active.iItfInput /end MEASUREMENT
/begin MEASUREMENT iItfInput.iv_rad_geschw_hinten_links "Eingangssignal Radgeschwindigkeit links hinten" UWORD UMR_KM_H_1_16_0_S5_S3 1 100 0 4095.9375 ECU_ADDRESS 0xFFF8AF1A DISPLAY_IDENTIFIER iv_rad_geschw_hinten_links.iItfInput /end MEASUREMENT
/begin MEASUREMENT iItfInput.iv_rad_geschw_hinten_rechts "Eingangssignal Radgeschwindigkeit rechts hinten" UWORD UMR_KM_H_1_16_0_S5_S3 1 100 0 4095.9375 ECU_ADDRESS 0xFFF8AF1C DISPLAY_IDENTIFIER iv_rad_geschw_hinten_rechts.iItfInput /end MEASUREMENT
/begin MEASUREMENT iItfInput.iv_rad_geschw_vorne_links "Eingangssignal Radgeschwindigkeit links vorne" UWORD UMR_KM_H_1_16_0_S5_S3 1 100 0 4095.9375 ECU_ADDRESS 0xFFF8AF16 DISPLAY_IDENTIFIER iv_rad_geschw_vorne_links.iItfInput /end MEASUREMENT
/begin MEASUREMENT iItfInput.iv_rad_geschw_vorne_rechts "Eingangssignal Radgeschwindigkeit rechts vorne" UWORD UMR_KM_H_1_16_0_S5_S3 1 100 0 4095.9375 ECU_ADDRESS 0xFFF8AF18 DISPLAY_IDENTIFIER iv_rad_geschw_vorne_rechts.iItfInput /end MEASUREMENT
/begin MEASUREMENT iItfInput.iv_saf_has_aktiv "Schaltanforderung saf_aktiv_has zur Schaltanforderung" UBYTE Conv.cItfInput._.iv_saf_has_aktiv_S5_S3 1 100 0 1 ECU_ADDRESS 0xFFF8AFAD DISPLAY_IDENTIFIER iv_saf_has_aktiv.iItfInput /end MEASUREMENT
/begin MEASUREMENT iItfInput.iv_sbytask "FLAG: Eingangsgroesse Standbytask aktiv" UBYTE Conv.cItfInput._.iv_sbytask_S5_S3 1 100 0 1 BIT_MASK 0x1 ECU_ADDRESS 0xFFF8AED9 DISPLAY_IDENTIFIER iv_sbytask.iItfInput /end MEASUREMENT
/begin MEASUREMENT iItfInput.iv_schluesselstart_aktiv "Beeinflussung Befüllreihenfolge der Kupplungen schluesselstart_aktiv" UBYTE Conv.cItfInput._.iv_schluesselstart_aktiv_S5_S3 1 100 0 1 ECU_ADDRESS 0xFFF8AFAF DISPLAY_IDENTIFIER iv_schluesselstart_aktiv.iItfInput /end MEASUREMENT
/begin MEASUREMENT iItfInput.iv_statistics_ee_busy "EEPROM Atsys Getriebemonitoringdaten schreiben laeuft" UBYTE UMR___1_1_0_S5_S3 1 100 0 255 ECU_ADDRESS 0xFFF8AF0A DISPLAY_IDENTIFIER iv_statistics_ee_busy.iItfInput /end MEASUREMENT
/begin MEASUREMENT iItfInput.iv_status_has "Aktueller Status des HAS Ablaufs" UBYTE Conv.cItfInput._.iv_status_has_S5_S3 1 100 0 15 ECU_ADDRESS 0xFFF8AFB0 DISPLAY_IDENTIFIER iv_status_has.iItfInput /end MEASUREMENT
/begin MEASUREMENT iItfInput.iv_status_n_haltephase "Zustand der N-Halte-Phase" UBYTE Conv.cItfInput._.iv_status_n_haltephase_S5_S3 1 100 0 7 ECU_ADDRESS 0xFFF8B05F DISPLAY_IDENTIFIER iv_status_n_haltephase.iItfInput /end MEASUREMENT
/begin MEASUREMENT iItfInput.iv_svh_aktiv_has "Schaltverhinderung bei Schleppstart durch Hybridablaufsteuerung saf_aktiv_has zur Schaltverhinderung durch HAS" UBYTE Conv.cItfInput._.iv_svh_aktiv_has_S5_S3 1 100 0 1 ECU_ADDRESS 0xFFF8AFA0 DISPLAY_IDENTIFIER iv_svh_aktiv_has.iItfInput /end MEASUREMENT
/begin MEASUREMENT iItfInput.iv_timeegsoff "Zeit die die EGS aus war" ULONG UMR_SEC__1_1_0_S5_S3 1 100 0 4294967295 ECU_ADDRESS 0xFFF8B064 DISPLAY_IDENTIFIER iv_timeegsoff.iItfInput /end MEASUREMENT
/begin MEASUREMENT iItfInput.iv_timeegsoff_status "Status der Zeit die die EGS aus war" UBYTE UMR___1_1_0_S5_S3 1 100 0 2 ECU_ADDRESS 0xFFF8B06C DISPLAY_IDENTIFIER iv_timeegsoff_status.iItfInput /end MEASUREMENT
/begin MEASUREMENT iItfInput.iv_udrmv "Eingangsgroesse ungefilterte EDS/MV Versorgungsspannung" UWORD UMR_VOLT__1_1000_0_S5_S3 1 100 0 25 ECU_ADDRESS 0xFFF8AEDE DISPLAY_IDENTIFIER iv_udrmv.iItfInput /end MEASUREMENT
/begin MEASUREMENT iItfInput.iv_verbot_sas_fkt "Verbot GLS verbot_sas_fkt zum Verbot GLS" UBYTE Conv.cItfInput._.iv_verbot_sas_fkt_S5_S3 1 100 0 1 ECU_ADDRESS 0xFFF8AFAE DISPLAY_IDENTIFIER iv_verbot_sas_fkt.iItfInput /end MEASUREMENT
/begin MEASUREMENT iItfInput.iv_z_k0_befuellopt "Anforderung an die Art der Kupplungsbefüllung der K0" UBYTE Conv.cItfInput._.iv_z_k0_befuellopt_S5_S3 1 100 0 2 ECU_ADDRESS 0xFFF8AFA4 DISPLAY_IDENTIFIER iv_z_k0_befuellopt.iItfInput /end MEASUREMENT
/begin MEASUREMENT iItfInput.iv_z_k0_soll_subst "K0- Sollzustand für Notprogramm aus der Hybrid-Ablauf-Steuerung" UBYTE Conv.cItfInput._.iv_z_k0_soll_subst_S5_S3 1 100 0 3 ECU_ADDRESS 0xFFF8AFA3 DISPLAY_IDENTIFIER iv_z_k0_soll_subst.iItfInput /end MEASUREMENT
/begin MEASUREMENT iItfInput.iv_z_modus_iae "iv-Größe Betriebsmodus für IAE" UBYTE Conv.cItfInput._.iv_z_modus_iae_S5_S3 1 100 0 2 ECU_ADDRESS 0xFFF8B051 DISPLAY_IDENTIFIER iv_z_modus_iae.iItfInput /end MEASUREMENT
/begin MEASUREMENT iItfInput.iv_zzuendung "Zustand der Zuendung (KL15!)" UBYTE Conv.cItfInput._.iv_zzuendung_S5_S3 1 100 0 4 ECU_ADDRESS 0xFFF8AF0D DISPLAY_IDENTIFIER iv_zzuendung.iItfInput /end MEASUREMENT
/begin MEASUREMENT iItfInput.k0_diag_moeglich "Status n_em + m_vm Signale i.O." UBYTE Conv.cItfInput._.k0_diag_moeglich_S5_S3 1 100 0 1 BIT_MASK 0x1 ECU_ADDRESS 0xFFF8AFD5 DISPLAY_IDENTIFIER k0_diag_moeglich.iItfInput /end MEASUREMENT
/begin MEASUREMENT iItfInput.k0_soll "K0 Sollzustand von der Hybrid-Ablauf-Steuerung" UBYTE Conv.cItfInput._.k0_soll_S5_S3 1 100 0 5 ECU_ADDRESS 0xFFF8AF82 DISPLAY_IDENTIFIER k0_soll.iItfInput /end MEASUREMENT
/begin MEASUREMENT iItfInput.ll_mot_aktiv "Leerlaufregler aktiv" UBYTE UMR___1_1_0_S5_S3 1 100 0 255 ECU_ADDRESS 0xFFF8B059 DISPLAY_IDENTIFIER ll_mot_aktiv.iItfInput /end MEASUREMENT
/begin MEASUREMENT iItfInput.ll_mot_aktiv_status "Status zu GET_LL_MOT_AKTIV" UBYTE Conv.cItfInput._.ll_mot_aktiv_status_S5_S3 1 100 0 2 ECU_ADDRESS 0xFFF8B05B DISPLAY_IDENTIFIER ll_mot_aktiv_status.iItfInput /end MEASUREMENT
/begin MEASUREMENT iItfInput.m_emist "E-Maschinenistmoment mit Getriebeeingriff" SWORD UMR_NM__1_1_0_S5_S3 1 100 -1024 1024 ECU_ADDRESS 0xFFF8AF78 DISPLAY_IDENTIFIER m_emist.iItfInput /end MEASUREMENT
/begin MEASUREMENT iItfInput.m_emsoll "E-Maschinensollmoment mit Getriebeeingriff" SWORD UMR_NM__1_1_0_S5_S3 1 100 -1024 1024 ECU_ADDRESS 0xFFF8AF7A DISPLAY_IDENTIFIER m_emsoll.iItfInput /end MEASUREMENT
/begin MEASUREMENT iItfInput.m_max_dyn_em "Maximales kurzzeitig mögliches EM Moment" SWORD UMR_NM__1_1_0_S5_S3 1 100 -1024 1024 ECU_ADDRESS 0xFFF8AF74 DISPLAY_IDENTIFIER m_max_dyn_em.iItfInput /end MEASUREMENT
/begin MEASUREMENT iItfInput.m_max_has_iae "maximal zulässiges IAE-Moment aus der HAS-Funktion" SWORD UMR_NM__1_1_0_S5_S3 1 100 -200 1300 ECU_ADDRESS 0xFFF8B054 DISPLAY_IDENTIFIER m_max_has_iae.iItfInput /end MEASUREMENT
/begin MEASUREMENT iItfInput.m_min_dyn_em "Minimal kurzzeitig mögliches EM Moment" SWORD UMR_NM__1_1_0_S5_S3 1 100 -1024 1024 ECU_ADDRESS 0xFFF8AF76 DISPLAY_IDENTIFIER m_min_dyn_em.iItfInput /end MEASUREMENT
/begin MEASUREMENT iItfInput.m_mot "Motormoment entweder aus von DME oder Sensor" SWORD UMR_NM__1_1_0_S5_S3 1 100 -200 1300 ECU_ADDRESS 0xFFF8AF2C DISPLAY_IDENTIFIER m_mot.iItfInput /end MEASUREMENT
/begin MEASUREMENT iItfInput.m_mot_faktor10 "Motormoment mahl 10" SWORD UMR_NM__1_10_0_S5_S3 1 100 -200 1300 ECU_ADDRESS 0xFFF8B00A DISPLAY_IDENTIFIER m_mot_faktor10.iItfInput /end MEASUREMENT
/begin MEASUREMENT iItfInput.m_mot_fl32 "Motormoment" FLOAT32_IEEE UMR_NM__1_1_0_S5_S3 1 100 -200 1300 ECU_ADDRESS 0xFFF8B000 DISPLAY_IDENTIFIER m_mot_fl32.iItfInput /end MEASUREMENT
/begin MEASUREMENT iItfInput.m_mot_status "Statussignal Motormoment" UBYTE Conv.cItfInput._.m_mot_status_S5_S3 1 100 0 2 ECU_ADDRESS 0xFFF8AFD1 DISPLAY_IDENTIFIER m_mot_status.iItfInput /end MEASUREMENT
/begin MEASUREMENT iItfInput.m_motist "Kurbelwellenistmoment" SWORD UMR_NM__1_1_0_S5_S3 1 100 -200 1300 ECU_ADDRESS 0xFFF8AF2E DISPLAY_IDENTIFIER m_motist.iItfInput /end MEASUREMENT
/begin MEASUREMENT iItfInput.m_motist_faktor10 "Kurbelwellenistmoment mahl 10" SWORD UMR_NM__1_10_0_S5_S3 1 100 -200 1300 ECU_ADDRESS 0xFFF8B010 DISPLAY_IDENTIFIER m_motist_faktor10.iItfInput /end MEASUREMENT
/begin MEASUREMENT iItfInput.m_motkor "korrigiertes Motormoment" SWORD UMR_NM__1_1_0_S5_S3 1 100 -200 1300 ECU_ADDRESS 0xFFF8AF34 DISPLAY_IDENTIFIER m_motkor.iItfInput /end MEASUREMENT
/begin MEASUREMENT iItfInput.m_motkor_in "korrigiertes Motormoment Zwischengroesse" SWORD UMR_NM__1_1_0_S5_S3 1 100 -200 1300 ECU_ADDRESS 0xFFF8AF36 DISPLAY_IDENTIFIER m_motkor_in.iItfInput /end MEASUREMENT
/begin MEASUREMENT iItfInput.m_motsoll "Motor Sollmoment" SWORD UMR_NM__1_1_0_S5_S3 1 100 -200 1300 ECU_ADDRESS 0xFFF8AF30 DISPLAY_IDENTIFIER m_motsoll.iItfInput /end MEASUREMENT
/begin MEASUREMENT iItfInput.m_motsoll_faktor10 "Motor Sollmoment mahl 10" SWORD UMR_NM__1_10_0_S5_S3 1 100 -200 1300 ECU_ADDRESS 0xFFF8B012 DISPLAY_IDENTIFIER m_motsoll_faktor10.iItfInput /end MEASUREMENT
/begin MEASUREMENT iItfInput.m_motsoll_in "Motor Sollmoment Eingangsgroesse" SWORD UMR_NM__1_1_0_S5_S3 1 100 -200 1300 ECU_ADDRESS 0xFFF8AF38 DISPLAY_IDENTIFIER m_motsoll_in.iItfInput /end MEASUREMENT
/begin MEASUREMENT iItfInput.m_motsoll_mod "Wert m_motsoll ohne Begrenzung auf das Reservemoment" SWORD UMR_NM__1_1_0_S5_S3 1 100 -400 1640 ECU_ADDRESS 0xFFF8B036 DISPLAY_IDENTIFIER m_motsoll_mod.iItfInput /end MEASUREMENT
/begin MEASUREMENT iItfInput.m_motsoll_mod_status "Statussignal zu m_motsoll_mod" UBYTE Conv.cItfInput._.m_motsoll_mod_status_S5_S3 1 100 0 2 ECU_ADDRESS 0xFFF8B03B DISPLAY_IDENTIFIER m_motsoll_mod_status.iItfInput /end MEASUREMENT
/begin MEASUREMENT iItfInput.m_soll_k0_has "HAS Momentenvorgabe" SWORD UMR_NM__1_1_0_S5_S3 1 100 0 800 ECU_ADDRESS 0xFFF8AF86 DISPLAY_IDENTIFIER m_soll_k0_has.iItfInput /end MEASUREMENT
/begin MEASUREMENT iItfInput.m_t "Turbinenmoment" SWORD UMR_NM__1_1_0_S5_S3 1 100 -200 1300 ECU_ADDRESS 0xFFF8AF2A DISPLAY_IDENTIFIER m_t.iItfInput /end MEASUREMENT
/begin MEASUREMENT iItfInput.m_t8 "Turbinenmoment (8-Bit)" UBYTE UMR_NM__6_1_M34_S5_S3 1 100 -204 1326 ECU_ADDRESS 0xFFF8AF32 DISPLAY_IDENTIFIER m_t8.iItfInput /end MEASUREMENT
/begin MEASUREMENT iItfInput.m_vmist "Verbrennungsmotoristmoment mit Getriebeeingriff" SWORD UMR_NM__1_1_0_S5_S3 1 100 -1500 1500 ECU_ADDRESS 0xFFF8AF7C DISPLAY_IDENTIFIER m_vmist.iItfInput /end MEASUREMENT
/begin MEASUREMENT iItfInput.m_vmsoll "Verbrennungsmotorsollmoment mit Getriebeeingriff" SWORD UMR_NM__1_1_0_S5_S3 1 100 -1500 1500 ECU_ADDRESS 0xFFF8AF7E DISPLAY_IDENTIFIER m_vmsoll.iItfInput /end MEASUREMENT
/begin MEASUREMENT iItfInput.manuell "FLAG: Steptronicbetrieb" UBYTE Conv.cItfInput._.manuell_S5_S3 1 100 0 1 BIT_MASK 0x1 ECU_ADDRESS 0xFFF8AF0C DISPLAY_IDENTIFIER manuell.iItfInput /end MEASUREMENT
/begin MEASUREMENT iItfInput.max_p_haupt "FLAG: Max. Hauptdruck aktiv" UBYTE Conv.cItfInput._.max_p_haupt_S5_S3 1 100 0 1 BIT_MASK 0x1 ECU_ADDRESS 0xFFF8AFB8 DISPLAY_IDENTIFIER max_p_haupt.iItfInput /end MEASUREMENT
/begin MEASUREMENT iItfInput.mg_soll_k0_neg_has "Negative Drehmomentänderungen K0" SWORD UMR_NM_SEC_1_1_0_S5_S3 1 100 -10000 0 ECU_ADDRESS 0xFFF8AF88 DISPLAY_IDENTIFIER mg_soll_k0_neg_has.iItfInput /end MEASUREMENT
/begin MEASUREMENT iItfInput.mg_soll_k0_pos_has "Positive Drehmomentänderungen" SWORD UMR_NM_SEC_1_1_0_S5_S3 1 100 0 10000 ECU_ADDRESS 0xFFF8AF8A DISPLAY_IDENTIFIER mg_soll_k0_pos_has.iItfInput /end MEASUREMENT
/begin MEASUREMENT iItfInput.mvg_vm_start "Startart der VM" UBYTE Conv.cItfInput._.mvg_vm_start_S5_S3 1 100 0 8 ECU_ADDRESS 0xFFF8AF8D DISPLAY_IDENTIFIER mvg_vm_start.iItfInput /end MEASUREMENT
/begin MEASUREMENT iItfInput.n6 "Drehzahl an der Baugruppe 6" UWORD UMR_U_MIN_1_1_0_S5_S3 1 100 0 65535 ECU_ADDRESS 0xFFF8AF50 DISPLAY_IDENTIFIER n6.iItfInput /end MEASUREMENT
/begin MEASUREMENT iItfInput.n_ab "Abtriebsdrehzahl gefiltert" UWORD UMR_U_MIN_1_1_0_S5_S3 1 100 0 8160 ECU_ADDRESS 0xFFF8AF3A DISPLAY_IDENTIFIER n_ab.iItfInput /end MEASUREMENT
/begin MEASUREMENT iItfInput.n_ab8 "Abtriebsdrehzahl (8-Bit)" UBYTE UMR_U_MIN_32_1_0_S5_S3 1 100 0 8160 ECU_ADDRESS 0xFFF8AF42 DISPLAY_IDENTIFIER n_ab8.iItfInput /end MEASUREMENT
/begin MEASUREMENT iItfInput.n_ab_dir "Drehrichtung Abtrieb intern" SBYTE Conv.cItfInput._.n_ab_dir_S5_S3 1 100 -1 1 ECU_ADDRESS 0xFFF8B022 DISPLAY_IDENTIFIER n_ab_dir.iItfInput /end MEASUREMENT
/begin MEASUREMENT iItfInput.n_ab_dir_status "Drehrichtung Abtieb Status" UBYTE Conv.cItfInput._.n_ab_dir_status_S5_S3 1 100 0 2 ECU_ADDRESS 0xFFF8B027 DISPLAY_IDENTIFIER n_ab_dir_status.iItfInput /end MEASUREMENT
/begin MEASUREMENT iItfInput.n_ab_status "Statussignal Abtriebdrehzahl" UBYTE Conv.cItfInput._.n_ab_status_S5_S3 1 100 0 2 ECU_ADDRESS 0xFFF8AFCF DISPLAY_IDENTIFIER n_ab_status.iItfInput /end MEASUREMENT
/begin MEASUREMENT iItfInput.n_abneu "Abtriebsdrehzahl ungefiltert" UWORD UMR_U_MIN_1_1_0_S5_S3 1 100 0 8160 ECU_ADDRESS 0xFFF8AF52 DISPLAY_IDENTIFIER n_abneu.iItfInput /end MEASUREMENT
/begin MEASUREMENT iItfInput.n_abneu_int16 "Abtriebsdrehzahl ungefiltert" SWORD UMR_U_MIN_1_1_0_S5_S3 1 100 0 8160 ECU_ADDRESS 0xFFF8B004 DISPLAY_IDENTIFIER n_abneu_int16.iItfInput /end MEASUREMENT
/begin MEASUREMENT iItfInput.n_dif_iae_virt "reeller Bauteilschlupf von Kupplung B (auf Getriebeeingang bezogen)" SWORD UMR_U_MIN_1_1_0_S5_S3 1 100 -32768 32767 ECU_ADDRESS 0xFFF8B034 DISPLAY_IDENTIFIER n_dif_iae_virt.iItfInput /end MEASUREMENT
/begin MEASUREMENT iItfInput.n_mot "Motordrehzahl" UWORD UMR_U_MIN_1_1_0_S5_S3 1 100 0 8160 ECU_ADDRESS 0xFFF8AF56 DISPLAY_IDENTIFIER n_mot.iItfInput /end MEASUREMENT
/begin MEASUREMENT iItfInput.n_mot8 "Motordrehzahl (8-Bit)" UBYTE UMR_U_MIN_32_1_0_S5_S3 1 100 0 8160 ECU_ADDRESS 0xFFF8AF41 DISPLAY_IDENTIFIER n_mot8.iItfInput /end MEASUREMENT
/begin MEASUREMENT iItfInput.n_mot_int16 "Motordrehzahl" SWORD UMR_U_MIN_1_1_0_S5_S3 1 100 0 8160 ECU_ADDRESS 0xFFF8B008 DISPLAY_IDENTIFIER n_mot_int16.iItfInput /end MEASUREMENT
/begin MEASUREMENT iItfInput.n_mot_llsoll_has "Minimale Drehzahl E-Motor (Betrieb ohne externe Ölpumpe)" UBYTE UMR_U_MIN_10_1_0_S5_S3 1 100 0 2550 ECU_ADDRESS 0xFFF8B057 DISPLAY_IDENTIFIER n_mot_llsoll_has.iItfInput /end MEASUREMENT
/begin MEASUREMENT iItfInput.n_mot_solleer "Motorleerlaufsolldrehzahl" UWORD UMR_U_MIN_1_1_0_S5_S3 1 100 0 8160 ECU_ADDRESS 0xFFF8AF72 DISPLAY_IDENTIFIER n_mot_solleer.iItfInput /end MEASUREMENT
/begin MEASUREMENT iItfInput.n_mot_status "Statussignal Motordrehzahl" UBYTE Conv.cItfInput._.n_mot_status_S5_S3 1 100 0 2 ECU_ADDRESS 0xFFF8AFCD DISPLAY_IDENTIFIER n_mot_status.iItfInput /end MEASUREMENT
/begin MEASUREMENT iItfInput.n_motabregel "Motorabregeldrehzahl" UWORD UMR_U_MIN_1_1_0_S5_S3 1 100 0 10000 ECU_ADDRESS 0xFFF8AF58 DISPLAY_IDENTIFIER n_motabregel.iItfInput /end MEASUREMENT
/begin MEASUREMENT iItfInput.n_t "Turbinendrehzahl gefiltert" UWORD UMR_U_MIN_1_1_0_S5_S3 1 100 0 8160 ECU_ADDRESS 0xFFF8AF3C DISPLAY_IDENTIFIER n_t.iItfInput /end MEASUREMENT
/begin MEASUREMENT iItfInput.n_t8 "Turbinendrehzahl (8-Bit)" UBYTE UMR_U_MIN_32_1_0_S5_S3 1 100 0 8160 ECU_ADDRESS 0xFFF8AF40 DISPLAY_IDENTIFIER n_t8.iItfInput /end MEASUREMENT
/begin MEASUREMENT iItfInput.n_t_dir "Drehrichtung Turbine intern" SBYTE Conv.cItfInput._.n_t_dir_S5_S3 1 100 -1 1 ECU_ADDRESS 0xFFF8B024 DISPLAY_IDENTIFIER n_t_dir.iItfInput /end MEASUREMENT
/begin MEASUREMENT iItfInput.n_t_dir_status "Drehrichtung Turbine Status" UBYTE Conv.cItfInput._.n_t_dir_status_S5_S3 1 100 0 2 ECU_ADDRESS 0xFFF8B029 DISPLAY_IDENTIFIER n_t_dir_status.iItfInput /end MEASUREMENT
/begin MEASUREMENT iItfInput.n_t_status "Statussignal Turbinendrehzahl" UBYTE Conv.cItfInput._.n_t_status_S5_S3 1 100 0 2 ECU_ADDRESS 0xFFF8AFD0 DISPLAY_IDENTIFIER n_t_status.iItfInput /end MEASUREMENT
/begin MEASUREMENT iItfInput.n_tneu "Turbinendrehzahl ungefiltert" UWORD UMR_U_MIN_1_1_0_S5_S3 1 100 0 8160 ECU_ADDRESS 0xFFF8AF54 DISPLAY_IDENTIFIER n_tneu.iItfInput /end MEASUREMENT
/begin MEASUREMENT iItfInput.n_tneu_int16 "Turbinendrehzahl ungefiltert" SWORD UMR_U_MIN_1_1_0_S5_S3 1 100 0 8160 ECU_ADDRESS 0xFFF8B006 DISPLAY_IDENTIFIER n_tneu_int16.iItfInput /end MEASUREMENT
/begin MEASUREMENT iItfInput.n_vm "Verbrennungsmotoristdrehzahl" UWORD UMR_U_MIN_1_1_0_S5_S3 1 100 0 8000 ECU_ADDRESS 0xFFF8AF80 DISPLAY_IDENTIFIER n_vm.iItfInput /end MEASUREMENT
/begin MEASUREMENT iItfInput.n_vm_status "Status Drehzahl VM" UBYTE Conv.cItfInput._.n_vm_status_S5_S3 1 100 0 2 ECU_ADDRESS 0xFFF8AF83 DISPLAY_IDENTIFIER n_vm_status.iItfInput /end MEASUREMENT
/begin MEASUREMENT iItfInput.nd_iaeneu "Differenzdrehzahl Anfahrelement" SWORD UMR_U_MIN_1_1_0_S5_S3 1 100 -32767 32767 ECU_ADDRESS 0xFFF8AF44 DISPLAY_IDENTIFIER nd_iaeneu.iItfInput /end MEASUREMENT
/begin MEASUREMENT iItfInput.neigung "Neigungssensor-Signal" UBYTE UMR_GRAD__1_3_M128_S5_S3 1 100 -42.6666666667 42 ECU_ADDRESS 0xFFF8AFDF DISPLAY_IDENTIFIER neigung.iItfInput /end MEASUREMENT
/begin MEASUREMENT iItfInput.neigung_gef "gefiltertes Neigungssensor-Signal" UBYTE UMR_GRAD__1_3_M128_S5_S3 1 100 -42.6666666667 42 ECU_ADDRESS 0xFFF8AFE0 DISPLAY_IDENTIFIER neigung_gef.iItfInput /end MEASUREMENT
/begin MEASUREMENT iItfInput.neigung_status "Statussignal zu Neigungssensorsignal" UBYTE Conv.cItfInput._.neigung_status_S5_S3 1 100 0 2 ECU_ADDRESS 0xFFF8AFD4 DISPLAY_IDENTIFIER neigung_status.iItfInput /end MEASUREMENT
/begin MEASUREMENT iItfInput.ng_ab "Gradient Abtriebsdrehzahl" SWORD UMR_U_MINSEC_1_1_0_S5_S3 1 100 -1000 1000 ECU_ADDRESS 0xFFF8AF46 DISPLAY_IDENTIFIER ng_ab.iItfInput /end MEASUREMENT
/begin MEASUREMENT iItfInput.ng_mot "Gradient Motordrehzahl" SWORD UMR_U_MINSEC_1_1_0_S5_S3 1 100 -10000 10000 ECU_ADDRESS 0xFFF8AF4A DISPLAY_IDENTIFIER ng_mot.iItfInput /end MEASUREMENT
/begin MEASUREMENT iItfInput.ng_t "Gradient Turbinendrehzahl" SWORD UMR_U_MINSEC_1_1_0_S5_S3 1 100 -1000 1000 ECU_ADDRESS 0xFFF8AF48 DISPLAY_IDENTIFIER ng_t.iItfInput /end MEASUREMENT
/begin MEASUREMENT iItfInput.notgang "Notgang" SBYTE Conv.cItfInput._.notgang_S5_S3 1 100 -1 8 ECU_ADDRESS 0xFFF8AED5 DISPLAY_IDENTIFIER notgang.iItfInput /end MEASUREMENT
/begin MEASUREMENT iItfInput.notgang_info "Notgang Info" UBYTE Conv.cItfInput._.notgang_info_S5_S3 1 100 0 40 ECU_ADDRESS 0xFFF8AED4 DISPLAY_IDENTIFIER notgang_info.iItfInput /end MEASUREMENT
/begin MEASUREMENT iItfInput.notlauf "FLAG: Notlauftask aktiv" UBYTE Conv.cItfInput._.notlauf_S5_S3 1 100 0 1 BIT_MASK 0x1 ECU_ADDRESS 0xFFF8AED0 DISPLAY_IDENTIFIER notlauf.iItfInput /end MEASUREMENT
/begin MEASUREMENT iItfInput.ntu_virt "virtuelle Turbinendrehzahl ungefiltert" UWORD UMR_U_MIN_1_1_0_S5_S3 1 100 0 8160 ECU_ADDRESS 0xFFF8B030 DISPLAY_IDENTIFIER ntu_virt.iItfInput /end MEASUREMENT
/begin MEASUREMENT iItfInput.ntu_virt_dir "virtuelle Drehrichtung Turbine Schnittstelle" SBYTE Conv.cItfInput._.ntu_virt_dir_S5_S3 1 100 -1 1 ECU_ADDRESS 0xFFF8B02B DISPLAY_IDENTIFIER ntu_virt_dir.iItfInput /end MEASUREMENT
/begin MEASUREMENT iItfInput.ntu_virt_dir_status "virtuelle Drehrichtung Turbine Status" UBYTE Conv.cItfInput._.ntu_virt_dir_status_S5_S3 1 100 0 2 ECU_ADDRESS 0xFFF8B02D DISPLAY_IDENTIFIER ntu_virt_dir_status.iItfInput /end MEASUREMENT
/begin MEASUREMENT iItfInput.nue "Drehzahlverhaeltins n_t zu n_mot" SWORD UMR___1_1000_0_S5_S3 1 100 0 10 ECU_ADDRESS 0xFFF8AF4C DISPLAY_IDENTIFIER nue.iItfInput /end MEASUREMENT
/begin MEASUREMENT iItfInput.nueg "Gradient von nue" SWORD UMR__SEC_1_1000_0_S5_S3 1 100 -1 1 ECU_ADDRESS 0xFFF8AF4E DISPLAY_IDENTIFIER nueg.iItfInput /end MEASUREMENT
/begin MEASUREMENT iItfInput.nullbestromung_aktiv "FLAG: Nullbestromung aktiv" UBYTE Conv.cItfInput._.nullbestromung_aktiv_S5_S3 1 100 0 1 BIT_MASK 0x1 ECU_ADDRESS 0xFFF8AFDA DISPLAY_IDENTIFIER nullbestromung_aktiv.iItfInput /end MEASUREMENT
/begin MEASUREMENT iItfInput.p_air "Luftdruck" UWORD UMR_MBAR__1_1_0_S5_S3 1 100 0 2026 ECU_ADDRESS 0xFFF8B04A DISPLAY_IDENTIFIER p_air.iItfInput /end MEASUREMENT
/begin MEASUREMENT iItfInput.p_bremse "Bremsdruck des Fahrzeugs" SWORD UMR_BAR__1_1_0_S5_S3 1 100 -100 1000 ECU_ADDRESS 0xFFF8AFC0 DISPLAY_IDENTIFIER p_bremse.iItfInput /end MEASUREMENT
/begin MEASUREMENT iItfInput.p_bremse_halbe "Bremsdruck des Fahrzeugs, quant: 0,5 bar" SWORD UMR_BAR__1_2_0_S5_S3 1 100 -100 1000 ECU_ADDRESS 0xFFF8AFC2 DISPLAY_IDENTIFIER p_bremse_halbe.iItfInput /end MEASUREMENT
/begin MEASUREMENT iItfInput.pak_aktiv "Anzeige einer PAK relevanten TASK" UBYTE Conv.cItfInput._.pak_aktiv_S5_S3 1 100 0 1 BIT_MASK 0x1 ECU_ADDRESS 0xFFF8AFDB DISPLAY_IDENTIFIER pak_aktiv.iItfInput /end MEASUREMENT
/begin MEASUREMENT iItfInput.pos "Waehlhebelposition" UBYTE Conv.cItfInput._.pos_S5_S3 1 100 0 8 ECU_ADDRESS 0xFFF8AF64 DISPLAY_IDENTIFIER pos.iItfInput /end MEASUREMENT
/begin MEASUREMENT iItfInput.pos_status "Statussignal zum Positionshebel pos" UBYTE Conv.cItfInput._.pos_status_S5_S3 1 100 0 2 ECU_ADDRESS 0xFFF8AFCE DISPLAY_IDENTIFIER pos_status.iItfInput /end MEASUREMENT
/begin MEASUREMENT iItfInput.pos_wunsch "Waehlhebelposition Fahrerwunsch (ohne Manipulation)" UBYTE Conv.cItfInput._.pos_wunsch_S5_S3 1 100 0 8 ECU_ADDRESS 0xFFF8AF65 DISPLAY_IDENTIFIER pos_wunsch.iItfInput /end MEASUREMENT
/begin MEASUREMENT iItfInput.preadaption_start "Stillstandadaption starten/stoppen über Kundentester" UBYTE UMR___1_1_0_S5_S3 1 100 0 255 ECU_ADDRESS 0xFFF8B06F DISPLAY_IDENTIFIER preadaption_start.iItfInput /end MEASUREMENT
/begin MEASUREMENT iItfInput.prog_auswahl "Programmauswahl Sport/Manuell/Tipp/L-Programm" UBYTE UMR___1_1_0_S5_S3 1 100 0 8 ECU_ADDRESS 0xFFF8AFDE DISPLAY_IDENTIFIER prog_auswahl.iItfInput /end MEASUREMENT
/begin MEASUREMENT iItfInput.ps_sensor_signal "Erfasstes Sensorsignal der Parksperre" UBYTE UMR___1_1_0_S5_S3 1 100 0 3 ECU_ADDRESS 0xFFF8AF66 DISPLAY_IDENTIFIER ps_sensor_signal.iItfInput /end MEASUREMENT
/begin MEASUREMENT iItfInput.pt_damping_active "Information, if the power train damping is active or not active" UBYTE Conv.cItfInput._.pt_damping_active_S5_S3 1 100 0 1 ECU_ADDRESS 0xFFF8AF8F DISPLAY_IDENTIFIER pt_damping_active.iItfInput /end MEASUREMENT
/begin MEASUREMENT iItfInput.pumpendruck_nicht_vorhanden "FLAG: Pumpendruck sicher nicht vorhanden" UBYTE Conv.cItfInput._.pumpendruck_nicht_vorhanden_S5_S3 1 100 0 1 BIT_MASK 0x1 ECU_ADDRESS 0xFFF8AFD7 DISPLAY_IDENTIFIER pumpendruck_nicht_vorhanden.iItfInput /end MEASUREMENT
/begin MEASUREMENT iItfInput.pumpendruck_vorhanden "FLAG: Pumpendruck sicher vorhanden" UBYTE Conv.cItfInput._.pumpendruck_vorhanden_S5_S3 1 100 0 1 BIT_MASK 0x1 ECU_ADDRESS 0xFFF8AFD6 DISPLAY_IDENTIFIER pumpendruck_vorhanden.iItfInput /end MEASUREMENT
/begin MEASUREMENT iItfInput.rad_geschw_hinten_links "Eingangssignal Radgeschwindigkeit links hinten" UWORD UMR_KM_H_1_16_0_S5_S3 1 100 0 4095.9375 ECU_ADDRESS 0xFFF8AFF0 DISPLAY_IDENTIFIER rad_geschw_hinten_links.iItfInput /end MEASUREMENT
/begin MEASUREMENT iItfInput.rad_geschw_hinten_rechts "Eingangssignal Radgeschwindigkeit rechts hinten" UWORD UMR_KM_H_1_16_0_S5_S3 1 100 0 4095.9375 ECU_ADDRESS 0xFFF8AFF2 DISPLAY_IDENTIFIER rad_geschw_hinten_rechts.iItfInput /end MEASUREMENT
/begin MEASUREMENT iItfInput.rad_geschw_vorne_links "Eingangssignal Radgeschwindigkeit links vorne" UWORD UMR_KM_H_1_16_0_S5_S3 1 100 0 4095.9375 ECU_ADDRESS 0xFFF8AFEC DISPLAY_IDENTIFIER rad_geschw_vorne_links.iItfInput /end MEASUREMENT
/begin MEASUREMENT iItfInput.rad_geschw_vorne_rechts "Eingangssignal Radgeschwindigkeit rechts vorne" UWORD UMR_KM_H_1_16_0_S5_S3 1 100 0 4095.9375 ECU_ADDRESS 0xFFF8AFEE DISPLAY_IDENTIFIER rad_geschw_vorne_rechts.iItfInput /end MEASUREMENT
/begin MEASUREMENT iItfInput.saf_has_aktiv "Schaltanforderung HAS" UBYTE Conv.cItfInput._.saf_has_aktiv_S5_S3 1 100 0 1 ECU_ADDRESS 0xFFF8AEF2 DISPLAY_IDENTIFIER saf_has_aktiv.iItfInput /end MEASUREMENT
/begin MEASUREMENT iItfInput.schluesselstart_aktiv "Beeinflussung Befüllreihenfolge der Kupplungen" UBYTE Conv.cItfInput._.schluesselstart_aktiv_S5_S3 1 100 0 1 ECU_ADDRESS 0xFFF8AEF4 DISPLAY_IDENTIFIER schluesselstart_aktiv.iItfInput /end MEASUREMENT
/begin MEASUREMENT iItfInput.sfkt_starten_azg "Sonderfunktionen ueber AZG starten" UBYTE UMR___1_1_0_S5_S3 1 100 0 255 ECU_ADDRESS 0xFFF8B071 DISPLAY_IDENTIFIER sfkt_starten_azg.iItfInput /end MEASUREMENT
/begin MEASUREMENT iItfInput.sollgang "Sollgang" SBYTE Conv.cItfInput._.sollgang_S5_S3 1 100 -1 8 ECU_ADDRESS 0xFFF8AF70 DISPLAY_IDENTIFIER sollgang.iItfInput /end MEASUREMENT
/begin MEASUREMENT iItfInput.standby "FLAG: Standbytask aktiv" UBYTE Conv.cItfInput._.standby_S5_S3 1 100 0 1 BIT_MASK 0x1 ECU_ADDRESS 0xFFF8AED1 DISPLAY_IDENTIFIER standby.iItfInput /end MEASUREMENT
/begin MEASUREMENT iItfInput.statistics_ee_busy "EEPROM Atsys Getriebmonitoringdaten schreiben laeuft" UBYTE UMR___1_1_0_S5_S3 1 100 0 255 ECU_ADDRESS 0xFFF8AFDD DISPLAY_IDENTIFIER statistics_ee_busy.iItfInput /end MEASUREMENT
/begin MEASUREMENT iItfInput.status_has "Aktueller Status des HAS Ablaufs" UBYTE Conv.cItfInput._.status_has_S5_S3 1 100 0 15 ECU_ADDRESS 0xFFF8AFB1 DISPLAY_IDENTIFIER status_has.iItfInput /end MEASUREMENT
/begin MEASUREMENT iItfInput.status_n_haltephase "Zustand der N-Halte-Phase" UBYTE Conv.cItfInput._.status_n_haltephase_S5_S3 1 100 0 7 ECU_ADDRESS 0xFFF8B05E DISPLAY_IDENTIFIER status_n_haltephase.iItfInput /end MEASUREMENT
/begin MEASUREMENT iItfInput.stromlos_ausser_ps "Zustand der Endstufen Stromlos (ausser ps)" UBYTE Conv.cItfInput._.stromlos_ausser_ps_S5_S3 1 100 0 1 BIT_MASK 0x1 ECU_ADDRESS 0xFFF8AFB3 DISPLAY_IDENTIFIER stromlos_ausser_ps.iItfInput /end MEASUREMENT
/begin MEASUREMENT iItfInput.stromlos_ges "Zustand der Endstufen Stromlos gesamt" UBYTE Conv.cItfInput._.stromlos_ges_S5_S3 1 100 0 1 BIT_MASK 0x1 ECU_ADDRESS 0xFFF8AFB4 DISPLAY_IDENTIFIER stromlos_ges.iItfInput /end MEASUREMENT
/begin MEASUREMENT iItfInput.stromlos_ps "Zustand der Parksperrenendstufen Stromlos" UBYTE Conv.cItfInput._.stromlos_ps_S5_S3 1 100 0 1 BIT_MASK 0x1 ECU_ADDRESS 0xFFF8AFB6 DISPLAY_IDENTIFIER stromlos_ps.iItfInput /end MEASUREMENT
/begin MEASUREMENT iItfInput.svh_aktiv_has "Schaltverhinderung bei Schleppstart durch Hybridablaufsteuerung" UBYTE Conv.cItfInput._.svh_aktiv_has_S5_S3 1 100 0 1 ECU_ADDRESS 0xFFF8AEF5 DISPLAY_IDENTIFIER svh_aktiv_has.iItfInput /end MEASUREMENT
/begin MEASUREMENT iItfInput.timeegsoff "Zeit die die EGS aus war" ULONG UMR_SEC__1_1_0_S5_S3 1 100 0 4294967295 ECU_ADDRESS 0xFFF8B068 DISPLAY_IDENTIFIER timeegsoff.iItfInput /end MEASUREMENT
/begin MEASUREMENT iItfInput.timeegsoff_status "Status der Zeit die die EGS aus war" UBYTE UMR___1_1_0_S5_S3 1 100 0 2 ECU_ADDRESS 0xFFF8B06D DISPLAY_IDENTIFIER timeegsoff_status.iItfInput /end MEASUREMENT
/begin MEASUREMENT iItfInput.u_drmv "ungefilterte EDS/MV Versorgungsspannung" UWORD UMR_VOLT__1_1000_0_S5_S3 1 100 0 25 ECU_ADDRESS 0xFFF8AF5E DISPLAY_IDENTIFIER u_drmv.iItfInput /end MEASUREMENT
/begin MEASUREMENT iItfInput.verbot_sas_fkt "Verbot SAS Funktionen" UBYTE Conv.cItfInput._.verbot_sas_fkt_S5_S3 1 100 0 1 ECU_ADDRESS 0xFFF8AEF3 DISPLAY_IDENTIFIER verbot_sas_fkt.iItfInput /end MEASUREMENT
/begin MEASUREMENT iItfInput.z_k0_befuellopt "Anforderung an die Art der Kupplungsbefüllung der K0" UBYTE Conv.cItfInput._.z_k0_befuellopt_S5_S3 1 100 0 2 ECU_ADDRESS 0xFFF8AF85 DISPLAY_IDENTIFIER z_k0_befuellopt.iItfInput /end MEASUREMENT
/begin MEASUREMENT iItfInput.z_k0_soll_subst "K0- Sollzustand für Notprogramm aus der Hybrid-Ablauf-Steuerung" UBYTE Conv.cItfInput._.z_k0_soll_subst_S5_S3 1 100 0 3 ECU_ADDRESS 0xFFF8AF84 DISPLAY_IDENTIFIER z_k0_soll_subst.iItfInput /end MEASUREMENT
/begin MEASUREMENT iItfInput.z_modus_iae "Betriebsmodus für IAE" UBYTE Conv.cItfInput._.z_modus_iae_S5_S3 1 100 0 2 ECU_ADDRESS 0xFFF8B050 DISPLAY_IDENTIFIER z_modus_iae.iItfInput /end MEASUREMENT
/begin MEASUREMENT iItfInput.z_zuendung "Zustand der Zuendung (KL15!)" UBYTE Conv.cItfInput._.z_zuendung_S5_S3 1 100 0 4 ECU_ADDRESS 0xFFF8AF0E DISPLAY_IDENTIFIER z_zuendung.iItfInput /end MEASUREMENT
/begin MEASUREMENT iItfInput.zug_schub "FLAG: Zug oder Schub" UBYTE Conv.cItfInput._.zug_schub_S5_S3 1 100 0 1 ECU_ADDRESS 0xFFF8AFBC DISPLAY_IDENTIFIER zug_schub.iItfInput /end MEASUREMENT
/begin MEASUREMENT iItfInputParaumsch.f_e_fahren_aktiv "Elektomotorisches Fahren aktiv" UBYTE Conv.cItfInputParaumsch._.f_e_fahren_aktiv_S5_S3 1 100 0 1 ECU_ADDRESS 0xFFF8D747 DISPLAY_IDENTIFIER f_e_fahren_aktiv.iItfInputParaumsch /end MEASUREMENT
/begin MEASUREMENT iItfInputParaumsch.iv_f_e_fahren_aktiv "Elektomotorisches Fahren aktiv" UBYTE Conv.cItfInputParaumsch._.iv_f_e_fahren_aktiv_S5_S3 1 100 0 1 ECU_ADDRESS 0xFFF8D746 DISPLAY_IDENTIFIER iv_f_e_fahren_aktiv.iItfInputParaumsch /end MEASUREMENT
/begin MEASUREMENT iItfInputParaumsch.iv_seraprsas "Eingangsgroesse Nr. Serap-Umschaltung Ref. Arb. Seite" UBYTE UMR___1_1_0_S5_S3 1 100 0 1 ECU_ADDRESS 0xFFF8D742 DISPLAY_IDENTIFIER iv_seraprsas.iItfInputParaumsch /end MEASUREMENT
/begin MEASUREMENT iItfInputParaumsch.iv_seraprsas_komp "Komplement Eingangsgroesse Nr. Serap-Umschaltung Ref. Arb. Seite" UBYTE UMR___1_1_0_S5_S3 1 100 254 255 ECU_ADDRESS 0xFFF8D743 DISPLAY_IDENTIFIER iv_seraprsas_komp.iItfInputParaumsch /end MEASUREMENT
/begin MEASUREMENT iItfInputParaumsch.serap_rsas "Eingangsgroesse Nr. Serap-Umschaltung Ref. Arb. Seite" UBYTE UMR___1_1_0_S5_S3 1 100 0 1 ECU_ADDRESS 0xFFF8D744 DISPLAY_IDENTIFIER serap_rsas.iItfInputParaumsch /end MEASUREMENT
/begin MEASUREMENT iItfInputParaumsch.serap_rsas_komp "Komplement Eingangsgroesse Nr. Serap-Umschaltung Ref. Arb. Seite" UBYTE UMR___1_1_0_S5_S3 1 100 254 255 ECU_ADDRESS 0xFFF8D745 DISPLAY_IDENTIFIER serap_rsas_komp.iItfInputParaumsch /end MEASUREMENT
/begin MEASUREMENT iK0sDiagnose.TimerK0IO.time "Zeit des Timers" UWORD UMR_SEC__1_100_0_S5_S3 1 100 0 655.35 ECU_ADDRESS 0xFFF8B96E DISPLAY_IDENTIFIER TimerK0IO.iK0sDiagnose /end MEASUREMENT
/begin MEASUREMENT iK0sDiagnose.TimerK0defekt.time "Zeit des Timers" UWORD UMR_SEC__1_100_0_S5_S3 1 100 0 655.35 ECU_ADDRESS 0xFFF8B96C DISPLAY_IDENTIFIER TimerK0defekt.iK0sDiagnose /end MEASUREMENT
/begin MEASUREMENT iK0sDiagnose.cbelag_schutzfkt_k0 "Schutzfunktion zum Schließen der K0" UBYTE Conv.cK0sDiagnose._.cbelag_schutzfkt_k0_S5_S3 1 100 0 1 BIT_MASK 0x1 ECU_ADDRESS 0xFFF8B964 DISPLAY_IDENTIFIER cbelag_schutzfkt_k0.iK0sDiagnose /end MEASUREMENT
/begin MEASUREMENT iK0sDiagnose.flag_verbotregeln_k0 "Schutzfunktion zum Schließen der K0" UBYTE Conv.cK0sDiagnose._.flag_verbotregeln_k0_S5_S3 1 100 0 1 BIT_MASK 0x1 ECU_ADDRESS 0xFFF8B965 DISPLAY_IDENTIFIER flag_verbotregeln_k0.iK0sDiagnose /end MEASUREMENT
/begin MEASUREMENT iK0sDiagnose.k0_defekt "Anzeigegröße für K0 defekt" UBYTE Conv.cK0sDiagnose._.k0_defekt_S5_S3 1 100 0 3 ECU_ADDRESS 0xFFF8B96B DISPLAY_IDENTIFIER k0_defekt.iK0sDiagnose /end MEASUREMENT
/begin MEASUREMENT iK0sDiagnose.k0_pruefok "K0-Prüfung erfolgreich" UBYTE Conv.cK0sDiagnose._.k0_pruefok_S5_S3 1 100 0 1 BIT_MASK 0x1 ECU_ADDRESS 0xFFF8B96A DISPLAY_IDENTIFIER k0_pruefok.iK0sDiagnose /end MEASUREMENT
/begin MEASUREMENT iK0sDiagnose.kalt_regeln_verbot "Schutzfunktion verbot Regeln K0 bei Kälte" UBYTE Conv.cK0sDiagnose._.kalt_regeln_verbot_S5_S3 1 100 0 1 BIT_MASK 0x1 ECU_ADDRESS 0xFFF8B966 DISPLAY_IDENTIFIER kalt_regeln_verbot.iK0sDiagnose /end MEASUREMENT
/begin MEASUREMENT iK0sDiagnose.schaltungdirekt_fkt "Flag für Verhinderung des Schaltoffsets bei angefordertem K0-Schließen auf gesteuert ZU" UBYTE Conv.cK0sDiagnose._.schaltungdirekt_fkt_S5_S3 1 100 0 1 BIT_MASK 0x1 ECU_ADDRESS 0xFFF8B968 DISPLAY_IDENTIFIER schaltungdirekt_fkt.iK0sDiagnose /end MEASUREMENT
/begin MEASUREMENT iK0sDiagnose.warm_regeln_verbot "Schutzfunktion verbot Regeln K0 bei hohen Getriebetemperaturen" UBYTE Conv.cK0sDiagnose._.warm_regeln_verbot_S5_S3 1 100 0 1 BIT_MASK 0x1 ECU_ADDRESS 0xFFF8B967 DISPLAY_IDENTIFIER warm_regeln_verbot.iK0sDiagnose /end MEASUREMENT
/begin MEASUREMENT iK0sDiagnose.z_diag_k0 "Zustand der Trennkupplung k0 Diagnose" UBYTE Conv.cK0sDiagnose._.z_diag_k0_S5_S3 1 100 0 4 ECU_ADDRESS 0xFFF8B969 DISPLAY_IDENTIFIER z_diag_k0.iK0sDiagnose /end MEASUREMENT
/begin MEASUREMENT iK0sDruck.DruckFilter.x "Filterwert" SLONG UMR___1_300_0_S5_S3 1 100 -7158278.82667 7158278.82333 ECU_ADDRESS 0xFFF8B9BC DISPLAY_IDENTIFIER DruckFilter.iK0sDruck /end MEASUREMENT
/begin MEASUREMENT iK0sDruck.DruckFilterHys.x "Filterwert" SLONG UMR___1_300_0_S5_S3 1 100 -7158278.82667 7158278.82333 ECU_ADDRESS 0xFFF8B9C0 DISPLAY_IDENTIFIER DruckFilterHys.iK0sDruck /end MEASUREMENT
/begin MEASUREMENT iK0sDruck.Dt1PkorrK0.Pt1Fl32.x "Filterwert" FLOAT32_IEEE UMR___1_1_0_S5_S3 1 100 -1000000000 1000000000 ECU_ADDRESS 0xFFF8B9DC FORMAT "%3.2" DISPLAY_IDENTIFIER Pt1Fl32.Dt1PkorrK0.iK0sDruck /end MEASUREMENT
/begin MEASUREMENT iK0sDruck.Dt1PkorrK0.xp "Ableitung vom Eingangswert" FLOAT32_IEEE UMR___1_1_0_S5_S3 1 100 -32768 32767 ECU_ADDRESS 0xFFF8B9D8 FORMAT "%3.2" DISPLAY_IDENTIFIER Dt1PkorrK0.iK0sDruck /end MEASUREMENT
/begin MEASUREMENT iK0sDruck.FilterPoTorus.x "Filterwert" SLONG UMR___1_300_0_S5_S3 1 100 -7158278.82667 7158278.82333 ECU_ADDRESS 0xFFF8B9C8 DISPLAY_IDENTIFIER FilterPoTorus.iK0sDruck /end MEASUREMENT
/begin MEASUREMENT iK0sDruck.FilterPoTorusDyn.x "Filterwert" SLONG UMR___1_300_0_S5_S3 1 100 -7158278.82667 7158278.82333 ECU_ADDRESS 0xFFF8B9CC DISPLAY_IDENTIFIER FilterPoTorusDyn.iK0sDruck /end MEASUREMENT
/begin MEASUREMENT iK0sDruck.FuellrampeK0.letzter_timer "Speichert den letzten BS-Timer" UWORD UMR_SEC__1_1_0_S5_S3 1 100 0 255 ECU_ADDRESS 0xFFF8B9E4 DISPLAY_IDENTIFIER letzter_timer.FuellrampeK0.iK0sDruck /end MEASUREMENT
/begin MEASUREMENT iK0sDruck.FuellrampeK0.letzter_wert "Speichert den letzten Eingangswert" SLONG UMR___1_1_0_S5_S3 1 100 -2147483648 2147483647 ECU_ADDRESS 0xFFF8B9E0 DISPLAY_IDENTIFIER letzter_wert.FuellrampeK0.iK0sDruck /end MEASUREMENT
/begin MEASUREMENT iK0sDruck.LFOffsetFilter.x "Filterwert" SLONG UMR___1_300_0_S5_S3 1 100 -7158278.82667 7158278.82333 ECU_ADDRESS 0xFFF8B9C4 DISPLAY_IDENTIFIER LFOffsetFilter.iK0sDruck /end MEASUREMENT
/begin MEASUREMENT iK0sDruck.filter_wert_hilf "Filterwert" SWORD UMR___1_1_0_S5_S3 1 100 -32768 32767 ECU_ADDRESS 0xFFF8B9B8 DISPLAY_IDENTIFIER filter_wert_hilf.iK0sDruck /end MEASUREMENT
/begin MEASUREMENT iK0sDruck.help_p0 "Merker für Druckrampe" FLOAT32_IEEE UMR_BAR__1_1_0_S5_S3 1 100 0 30 ECU_ADDRESS 0xFFF8B984 FORMAT "%4.3" DISPLAY_IDENTIFIER help_p0.iK0sDruck /end MEASUREMENT
/begin MEASUREMENT iK0sDruck.k0_ansteuern "Anforderung zum Ansteuern der K0" UBYTE UMR___1_1_0_S5_S3 1 100 0 1 BIT_MASK 0x1 ECU_ADDRESS 0xFFF8B998 DISPLAY_IDENTIFIER k0_ansteuern.iK0sDruck /end MEASUREMENT
/begin MEASUREMENT iK0sDruck.p0_ist_filter.x "Filterwert" FLOAT32_IEEE UMR___1_1_0_S5_S3 1 100 -2147483648 2147483647 ECU_ADDRESS 0xFFF8B9D0 FORMAT "%3.2" DISPLAY_IDENTIFIER x.p0_ist_filter.iK0sDruck /end MEASUREMENT
/begin MEASUREMENT iK0sDruck.p0_ist_filter.xp "Ableitung vom Eingangswert" FLOAT32_IEEE UMR__SEC_1_1_0_S5_S3 1 100 -2147483648 2147483647 ECU_ADDRESS 0xFFF8B9D4 FORMAT "%3.2" DISPLAY_IDENTIFIER xp.p0_ist_filter.iK0sDruck /end MEASUREMENT
/begin MEASUREMENT iK0sDruck.p_hys_k0 "Hysteresedruck" SWORD UMR_BAR__1_1000_0_S5_S3 1 100 0 30 ECU_ADDRESS 0xFFF8B988 DISPLAY_IDENTIFIER p_hys_k0.iK0sDruck /end MEASUREMENT
/begin MEASUREMENT iK0sDruck.p_hys_k0_hilf "Hysteresedruck" SWORD UMR_BAR__1_1000_0_S5_S3 1 100 0 30 ECU_ADDRESS 0xFFF8B9B6 DISPLAY_IDENTIFIER p_hys_k0_hilf.iK0sDruck /end MEASUREMENT
/begin MEASUREMENT iK0sDruck.p_rampe_hys "Hysteresedruck" SWORD UMR_BAR__1_1000_0_S5_S3 1 100 0 30 ECU_ADDRESS 0xFFF8B98C DISPLAY_IDENTIFIER p_rampe_hys.iK0sDruck /end MEASUREMENT
/begin MEASUREMENT iK0sDruck.p_regler_k0 "K0 Regler" FLOAT32_IEEE UMR_BAR__1_1_0_S5_S3 1 100 0 30 ECU_ADDRESS 0xFFF8B9A4 FORMAT "%4.3" DISPLAY_IDENTIFIER p_regler_k0.iK0sDruck /end MEASUREMENT
/begin MEASUREMENT iK0sDruck.p_vorsteuer_k0 "K0 Vorsteuerdruck" FLOAT32_IEEE UMR_BAR__1_1_0_S5_S3 1 100 0 30 ECU_ADDRESS 0xFFF8B9A0 FORMAT "%4.3" DISPLAY_IDENTIFIER p_vorsteuer_k0.iK0sDruck /end MEASUREMENT
/begin MEASUREMENT iK0sDruck.pg_hys_hilf "Rampengradient für Abbau p_hys_k0" SWORD UMR_BAR_SEC_1_10_0_S5_S3 1 100 0.1 30 ECU_ADDRESS 0xFFF8B9B4 DISPLAY_IDENTIFIER pg_hys_hilf.iK0sDruck /end MEASUREMENT
/begin MEASUREMENT iK0sDruck.po_gestzu_k0 "Aus mo_kozu resultierender Druckanteil" FLOAT32_IEEE UMR_BAR__1_1_0_S5_S3 1 100 0 30 ECU_ADDRESS 0xFFF8B9A8 FORMAT "%4.3" DISPLAY_IDENTIFIER po_gestzu_k0.iK0sDruck /end MEASUREMENT
/begin MEASUREMENT iK0sDruck.po_ist_k0 "Isteffektivdruck" FLOAT32_IEEE UMR_BAR__1_1_0_S5_S3 1 100 0 30 ECU_ADDRESS 0xFFF8B980 FORMAT "%4.3" DISPLAY_IDENTIFIER po_ist_k0.iK0sDruck /end MEASUREMENT
/begin MEASUREMENT iK0sDruck.po_msoll_k0 "Momentenabhängiger Offsetdruck" FLOAT32_IEEE UMR_BAR__1_1_0_S5_S3 1 100 0 30 ECU_ADDRESS 0xFFF8B990 FORMAT "%4.3" DISPLAY_IDENTIFIER po_msoll_k0.iK0sDruck /end MEASUREMENT
/begin MEASUREMENT iK0sDruck.po_msoll_zu_k0 "Kupplungsdruck im Zustand Geschlossen" FLOAT32_IEEE UMR_BAR__1_1_0_S5_S3 1 100 0 30 ECU_ADDRESS 0xFFF8B994 FORMAT "%4.3" DISPLAY_IDENTIFIER po_msoll_zu_k0.iK0sDruck /end MEASUREMENT
/begin MEASUREMENT iK0sDruck.po_pgschliess_k0 "Druckgradient Offsetanteil" FLOAT32_IEEE UMR_BAR__1_1_0_S5_S3 1 100 0 30 ECU_ADDRESS 0xFFF8B99C FORMAT "%4.3" DISPLAY_IDENTIFIER po_pgschliess_k0.iK0sDruck /end MEASUREMENT
/begin MEASUREMENT iK0sDruck.po_reg_k0 "Temperatur- und motordrehzahlabhängiger Schlupfregeloffsetdruck auf den minimalen Fülldruck" SWORD UMR_BAR__1_1000_0_S5_S3 1 100 0 10 ECU_ADDRESS 0xFFF8B98A DISPLAY_IDENTIFIER po_reg_k0.iK0sDruck /end MEASUREMENT
/begin MEASUREMENT iK0sDruck.po_soll_k0 "Druckoffset für Befüllmodell" SWORD UMR_BAR__1_1000_0_S5_S3 1 100 0 30 ECU_ADDRESS 0xFFF8B978 DISPLAY_IDENTIFIER po_soll_k0.iK0sDruck /end MEASUREMENT
/begin MEASUREMENT iK0sDruck.po_soll_k0_fl32 "Druckoffsetfür Befüllmodell in Float" FLOAT32_IEEE UMR_BAR__1_1_0_S5_S3 1 100 0 30 ECU_ADDRESS 0xFFF8B97C FORMAT "%4.3" DISPLAY_IDENTIFIER po_soll_k0_fl32.iK0sDruck /end MEASUREMENT
/begin MEASUREMENT iK0sDruck.po_soll_k0_roh_fl32 "Druckoffset ungefiltert für Befüllmodell in Float" FLOAT32_IEEE UMR_BAR__1_1_0_S5_S3 1 100 0 30 ECU_ADDRESS 0xFFF8B974 FORMAT "%4.3" DISPLAY_IDENTIFIER po_soll_k0_roh_fl32.iK0sDruck /end MEASUREMENT
/begin MEASUREMENT iK0sDruck.po_soll_roh_k0 "Druckoffset ungefiltert für Befüllmodell" SWORD UMR_BAR__1_1000_0_S5_S3 1 100 0 30 ECU_ADDRESS 0xFFF8B970 DISPLAY_IDENTIFIER po_soll_roh_k0.iK0sDruck /end MEASUREMENT
/begin MEASUREMENT iK0sDruck.po_soll_stell_k0 "Druckoffset für Befüllmodell inklusive Hysterese" SWORD UMR_BAR__1_1000_0_S5_S3 1 100 0 30 ECU_ADDRESS 0xFFF8B97A DISPLAY_IDENTIFIER po_soll_stell_k0.iK0sDruck /end MEASUREMENT
/begin MEASUREMENT iK0sDruck.po_torus_k0 "Druckoffset für Korrektur des Torusdruck" SWORD UMR_BAR__1_1000_0_S5_S3 1 100 0 30 ECU_ADDRESS 0xFFF8B9AE DISPLAY_IDENTIFIER po_torus_k0.iK0sDruck /end MEASUREMENT
/begin MEASUREMENT iK0sDruck.po_torusdyn_k0 "Dynamischer Druckoffset für Korrektur des Torusdruck" SWORD UMR_BAR__1_1000_0_S5_S3 1 100 0 30 ECU_ADDRESS 0xFFF8B9B0 DISPLAY_IDENTIFIER po_torusdyn_k0.iK0sDruck /end MEASUREMENT
/begin MEASUREMENT iK0sDruck.z_hys_k0 "Zustand der Druck-Hysteresekompensation" UBYTE Conv.cK0sDruck._.z_hys_k0_S5_S3 1 100 0 4 ECU_ADDRESS 0xFFF8B9AC DISPLAY_IDENTIFIER z_hys_k0.iK0sDruck /end MEASUREMENT
/begin MEASUREMENT iK0sDruck.z_k0_hilf "Zustand der Druck-Hysteresekompensation" UBYTE UMR___1_1_0_S5_S3 1 100 0 4 ECU_ADDRESS 0xFFF8B9B2 DISPLAY_IDENTIFIER z_k0_hilf.iK0sDruck /end MEASUREMENT
/begin MEASUREMENT iK0sKorK0.flag_p_sys_k0 "Flag zur K0 seitigen Anforderung einer Systemdruckerhöhung" UBYTE Conv.cK0sKorK0._.flag_p_sys_k0_S5_S3 1 100 0 1 BIT_MASK 0x1 ECU_ADDRESS 0xFFF89487 DISPLAY_IDENTIFIER flag_p_sys_k0.iK0sKorK0 /end MEASUREMENT
/begin MEASUREMENT iK0sKorK0.flag_verbot_mschalt "Flag zum Sperren der m_schalt aufschaltung" UBYTE Conv.cK0sKorK0._.flag_verbot_mschalt_S5_S3 1 100 0 1 BIT_MASK 0x1 ECU_ADDRESS 0xFFF89486 DISPLAY_IDENTIFIER flag_verbot_mschalt.iK0sKorK0 /end MEASUREMENT
/begin MEASUREMENT iK0sKorK0.k0_bef_hysterese "K0 - Druckvorgabe mit oder ohne Hysterese" UBYTE Conv.cK0sKorK0._.k0_bef_hysterese_S5_S3 1 100 0 1 BIT_MASK 0x1 ECU_ADDRESS 0xFFF89485 DISPLAY_IDENTIFIER k0_bef_hysterese.iK0sKorK0 /end MEASUREMENT
/begin MEASUREMENT iK0sKorK0.k0_ist "Istzustand der k0, der an die Hybrid-Ablauf-Steuerung zurückgegeben wird" UBYTE Conv.cK0sKorK0._.k0_ist_S5_S3 1 100 0 5 ECU_ADDRESS 0xFFF89483 DISPLAY_IDENTIFIER k0_ist.iK0sKorK0 /end MEASUREMENT
/begin MEASUREMENT iK0sKorK0.k0_ist_komp "Komplement: Istzustand der k0, der an die Hybrid-Ablauf-Steuerung zurückgegeben wird" UBYTE UMR___1_1_0_S5_S3 1 100 250 255 ECU_ADDRESS 0xFFF89484 DISPLAY_IDENTIFIER k0_ist_komp.iK0sKorK0 /end MEASUREMENT
/begin MEASUREMENT iK0sKorK0.z_k0 "Zustand der Trennkupplung k0" UBYTE Conv.cK0sKorK0._.z_k0_S5_S3 1 100 0 14 ECU_ADDRESS 0xFFF89482 DISPLAY_IDENTIFIER z_k0.iK0sKorK0 /end MEASUREMENT
/begin MEASUREMENT iK0sKorK0.z_k0_merk "letzter Zustand der Trennkupplung k0" UBYTE Conv.cK0sKorK0._.z_k0_merk_S5_S3 1 100 0 14 ECU_ADDRESS 0xFFF89488 DISPLAY_IDENTIFIER z_k0_merk.iK0sKorK0 /end MEASUREMENT
/begin MEASUREMENT iK0sKorSW.iSODyn.delta_dkpedal_k0 "Fahrpedaldifferenz zum Auslesen des wndo_fdyn_k0" SWORD UMR_PROZENT__20_51_0_S5_S3 1 100 0 100 ECU_ADDRESS 0xFFF8BA4C DISPLAY_IDENTIFIER delta_dkpedal_k0.iSODyn.iK0sKorSW /end MEASUREMENT
/begin MEASUREMENT iK0sKorSW.iSODyn.dk_pedal0_k0 "gespeicherter Wert von dk_pedal" UBYTE UMR_PROZENT__20_51_0_S5_S3 1 100 0 100 ECU_ADDRESS 0xFFF8BA48 DISPLAY_IDENTIFIER dk_pedal0_k0.iSODyn.iK0sKorSW /end MEASUREMENT
/begin MEASUREMENT iK0sKorSW.iSODyn.fdyn_timer.time "Zeit des Timers" UWORD UMR_SEC__1_100_0_S5_S3 1 100 0 655.35 ECU_ADDRESS 0xFFF8BA58 DISPLAY_IDENTIFIER fdyn_timer.iSODyn.iK0sKorSW /end MEASUREMENT
/begin MEASUREMENT iK0sKorSW.iSODyn.wndo_fdyn_alt_k0 "gespeicherter Sollwertoffset Fahrdynamik" SWORD UMR_U_MIN_1_1_0_S5_S3 1 100 -8128 8128 ECU_ADDRESS 0xFFF8BA4A DISPLAY_IDENTIFIER wndo_fdyn_alt_k0.iSODyn.iK0sKorSW /end MEASUREMENT
/begin MEASUREMENT iK0sKorSW.iSODyn.wndo_fdyn_filter.x "Filterwert" FLOAT32_IEEE UMR___1_1_0_S5_S3 1 100 -2147483648 2147483647 ECU_ADDRESS 0xFFF8BA50 FORMAT "%3.2" DISPLAY_IDENTIFIER x.wndo_fdyn_filter.iSODyn.iK0sKorSW /end MEASUREMENT
/begin MEASUREMENT iK0sKorSW.iSODyn.wndo_fdyn_filter.xp "Ableitung vom Eingangswert" FLOAT32_IEEE UMR__SEC_1_1_0_S5_S3 1 100 -2147483648 2147483647 ECU_ADDRESS 0xFFF8BA54 FORMAT "%3.2" DISPLAY_IDENTIFIER xp.wndo_fdyn_filter.iSODyn.iK0sKorSW /end MEASUREMENT
/begin MEASUREMENT iK0sKorSW.iSODyn.wndo_fdyn_k0 "gefilterter Sollwertoffset Fahrdynamik" SWORD UMR_U_MIN_1_1_0_S5_S3 1 100 -8128 8128 ECU_ADDRESS 0xFFF8BA40 DISPLAY_IDENTIFIER wndo_fdyn_k0.iSODyn.iK0sKorSW /end MEASUREMENT
/begin MEASUREMENT iK0sKorSW.iSODyn.wndo_fdyn_roh_begrenzt_k0 "Filtereingang Sollwertoffset Fahrdynamik" SWORD UMR_U_MIN_1_1_0_S5_S3 1 100 -8128 8128 ECU_ADDRESS 0xFFF8BA42 DISPLAY_IDENTIFIER wndo_fdyn_roh_begrenzt_k0.iSODyn.iK0sKorSW /end MEASUREMENT
/begin MEASUREMENT iK0sKorSW.iSODyn.wndo_fdyn_roh_k0 "Rohwert Sollwertoffset Fahrdynamik" SWORD UMR_U_MIN_1_1_0_S5_S3 1 100 -8128 8128 ECU_ADDRESS 0xFFF8BA46 DISPLAY_IDENTIFIER wndo_fdyn_roh_k0.iSODyn.iK0sKorSW /end MEASUREMENT
/begin MEASUREMENT iK0sKorSW.iSODyn.z_fdyn_k0 "Zustandszeiger Fahrdynamik" UBYTE Conv.cK0sSODyn._.z_fdyn_k0_S5_S3 1 100 0 3 ECU_ADDRESS 0xFFF8BA44 DISPLAY_IDENTIFIER z_fdyn_k0.iSODyn.iK0sKorSW /end MEASUREMENT
/begin MEASUREMENT iK0sKorSW.iSOShi.f_SchaltoffsetAktiv "Flag für spontane Schaltung aktiv" UBYTE Conv.cK0sSOShi._.f_SchaltoffsetAktiv_S5_S3 1 100 0 1 BIT_MASK 0x1 ECU_ADDRESS 0xFFF8BA30 DISPLAY_IDENTIFIER f_SchaltoffsetAktiv.iSOShi.iK0sKorSW /end MEASUREMENT
/begin MEASUREMENT iK0sKorSW.iSOShi.n_sec_merk "Turbinendrehzahl zu Schaltbeginn" SWORD UMR_U_MIN_1_1_0_S5_S3 1 100 0 8128 ECU_ADDRESS 0xFFF8BA2C DISPLAY_IDENTIFIER n_sec_merk.iSOShi.iK0sKorSW /end MEASUREMENT
/begin MEASUREMENT iK0sKorSW.iSOShi.ngt_delta "Gradientenänderung Turbinendrehzahl" SWORD UMR_U_MINSEC_1_1_0_S5_S3 1 100 -32768 32767 ECU_ADDRESS 0xFFF8BA2A DISPLAY_IDENTIFIER ngt_delta.iSOShi.iK0sKorSW /end MEASUREMENT
/begin MEASUREMENT iK0sKorSW.iSOShi.schaltung_aktiv_merk "Merker für schaltung_aktiv" SBYTE Conv.cK0sSOShi._.schaltung_aktiv_merk_S5_S3 1 100 -2 1 ECU_ADDRESS 0xFFF8BA28 DISPLAY_IDENTIFIER schaltung_aktiv_merk.iSOShi.iK0sKorSW /end MEASUREMENT
/begin MEASUREMENT iK0sKorSW.iSOShi.t_schleif_k0 "Schleifzeit" UWORD UMR_MSEC__1_1_0_S5_S3 1 100 1 2000 ECU_ADDRESS 0xFFF8BA2E DISPLAY_IDENTIFIER t_schleif_k0.iSOShi.iK0sKorSW /end MEASUREMENT
/begin MEASUREMENT iK0sKorSW.iSOShi.wndo_schalt_k0 "gefilterter Schaltoffset" SWORD UMR_U_MIN_1_1_0_S5_S3 1 100 0 8128 ECU_ADDRESS 0xFFF8BA24 DISPLAY_IDENTIFIER wndo_schalt_k0.iSOShi.iK0sKorSW /end MEASUREMENT
/begin MEASUREMENT iK0sKorSW.iSOShi.wndo_schalt_k0_roh "Filtereingang Schaltoffset" SWORD UMR_U_MIN_1_1_0_S5_S3 1 100 0 8128 ECU_ADDRESS 0xFFF8BA26 DISPLAY_IDENTIFIER wndo_schalt_k0_roh.iSOShi.iK0sKorSW /end MEASUREMENT
/begin MEASUREMENT iK0sKorSW.iSOShi.wndo_schalt_pt1_filter.x "Filterwert" SLONG UMR___1_300_0_S5_S3 1 100 -7158278.82667 7158278.82333 ECU_ADDRESS 0xFFF8BA34 DISPLAY_IDENTIFIER wndo_schalt_pt1_filter.iSOShi.iK0sKorSW /end MEASUREMENT
/begin MEASUREMENT iK0sKorSW.iSOShi.wndo_schalt_pt2_filter.x "Filterwert" FLOAT32_IEEE UMR___1_1_0_S5_S3 1 100 -2147483648 2147483647 ECU_ADDRESS 0xFFF8BA38 FORMAT "%3.2" DISPLAY_IDENTIFIER x.wndo_schalt_pt2_filter.iSOShi.iK0sKorSW /end MEASUREMENT
/begin MEASUREMENT iK0sKorSW.iSOShi.wndo_schalt_pt2_filter.xp "Ableitung vom Eingangswert" FLOAT32_IEEE UMR__SEC_1_1_0_S5_S3 1 100 -2147483648 2147483647 ECU_ADDRESS 0xFFF8BA3C FORMAT "%3.2" DISPLAY_IDENTIFIER xp.wndo_schalt_pt2_filter.iSOShi.iK0sKorSW /end MEASUREMENT
/begin MEASUREMENT iK0sKorSW.iStdSW.ada_timer.time "Zeit des Timers" UWORD UMR_SEC__1_100_0_S5_S3 1 100 0 655.35 ECU_ADDRESS 0xFFF8BA10 DISPLAY_IDENTIFIER ada_timer.iStdSW.iK0sKorSW /end MEASUREMENT
/begin MEASUREMENT iK0sKorSW.iStdSW.einreg_timer.time "Zeit des Timers" UWORD UMR_SEC__1_100_0_S5_S3 1 100 0 655.35 ECU_ADDRESS 0xFFF8BA12 DISPLAY_IDENTIFIER einreg_timer.iStdSW.iK0sKorSW /end MEASUREMENT
/begin MEASUREMENT iK0sKorSW.iStdSW.f_einreg "prozentualer Faktor Einregelrampe" UBYTE UMR_PROZENT__20_51_0_S5_S3 1 100 0 100 ECU_ADDRESS 0xFFF8BA08 DISPLAY_IDENTIFIER f_einreg.iStdSW.iK0sKorSW /end MEASUREMENT
/begin MEASUREMENT iK0sKorSW.iStdSW.f_minit_rest_k0 "prozentualer Faktor Faktorkennlinie m_init_rest_k0" UBYTE UMR_PROZENT__20_51_0_S5_S3 1 100 0 100 ECU_ADDRESS 0xFFF8B9FE DISPLAY_IDENTIFIER f_minit_rest_k0.iStdSW.iK0sKorSW /end MEASUREMENT
/begin MEASUREMENT iK0sKorSW.iStdSW.wnd_einreg_abs "Sollwert Einregeln" SLONG UMR_U_MIN_1_100_0_S5_S3 1 100 -8128 8128 ECU_ADDRESS 0xFFF8BA04 DISPLAY_IDENTIFIER wnd_einreg_abs.iStdSW.iK0sKorSW /end MEASUREMENT
/begin MEASUREMENT iK0sKorSW.iStdSW.wnd_einreg_abs_merk "Drehzahldifferenz für Einregeln" SLONG UMR_U_MIN_1_100_0_S5_S3 1 100 -8128 8128 ECU_ADDRESS 0xFFF8BA0C DISPLAY_IDENTIFIER wnd_einreg_abs_merk.iStdSW.iK0sKorSW /end MEASUREMENT
/begin MEASUREMENT iK0sKorSW.iStdSW.wnd_init_filter.x "Filterwert" FLOAT32_IEEE UMR___1_1_0_S5_S3 1 100 -2147483648 2147483647 ECU_ADDRESS 0xFFF8BA1C FORMAT "%3.2" DISPLAY_IDENTIFIER x.wnd_init_filter.iStdSW.iK0sKorSW /end MEASUREMENT
/begin MEASUREMENT iK0sKorSW.iStdSW.wnd_init_filter.xp "Ableitung vom Eingangswert" FLOAT32_IEEE UMR__SEC_1_1_0_S5_S3 1 100 -2147483648 2147483647 ECU_ADDRESS 0xFFF8BA20 FORMAT "%3.2" DISPLAY_IDENTIFIER xp.wnd_init_filter.iStdSW.iK0sKorSW /end MEASUREMENT
/begin MEASUREMENT iK0sKorSW.iStdSW.wnd_std_filter.x "Filterwert" FLOAT32_IEEE UMR___1_1_0_S5_S3 1 100 -2147483648 2147483647 ECU_ADDRESS 0xFFF8BA14 FORMAT "%3.2" DISPLAY_IDENTIFIER x.wnd_std_filter.iStdSW.iK0sKorSW /end MEASUREMENT
/begin MEASUREMENT iK0sKorSW.iStdSW.wnd_std_filter.xp "Ableitung vom Eingangswert" FLOAT32_IEEE UMR__SEC_1_1_0_S5_S3 1 100 -2147483648 2147483647 ECU_ADDRESS 0xFFF8BA18 FORMAT "%3.2" DISPLAY_IDENTIFIER xp.wnd_std_filter.iStdSW.iK0sKorSW /end MEASUREMENT
/begin MEASUREMENT iK0sKorSW.iStdSW.wnd_std_k0 "gefilterter Wert wnd_std_k0" SWORD UMR_U_MIN_1_1_0_S5_S3 1 100 -8128 8128 ECU_ADDRESS 0xFFF8B9F8 DISPLAY_IDENTIFIER wnd_std_k0.iStdSW.iK0sKorSW /end MEASUREMENT
/begin MEASUREMENT iK0sKorSW.iStdSW.wnd_std_roh_abs_k0 "ungefilterter Wert wnd_std_k0" SWORD UMR_U_MIN_1_1_0_S5_S3 1 100 -8128 8128 ECU_ADDRESS 0xFFF8B9FA DISPLAY_IDENTIFIER wnd_std_roh_abs_k0.iStdSW.iK0sKorSW /end MEASUREMENT
/begin MEASUREMENT iK0sKorSW.iStdSW.wnd_std_roh_abs_k0_begrenzt "ungefilterter, begrenzter Wert wnd_std_k0" SWORD UMR_U_MIN_1_1_0_S5_S3 1 100 -8128 8128 ECU_ADDRESS 0xFFF8B9FC DISPLAY_IDENTIFIER wnd_std_roh_abs_k0_begrenzt.iStdSW.iK0sKorSW /end MEASUREMENT
/begin MEASUREMENT iK0sKorSW.iStdSW.wnd_std_roh_k0_begrenzt "Filtereingang Standardsollwert" SWORD UMR_U_MIN_1_1_0_S5_S3 1 100 -8128 8128 ECU_ADDRESS 0xFFF8BA00 DISPLAY_IDENTIFIER wnd_std_roh_k0_begrenzt.iStdSW.iK0sKorSW /end MEASUREMENT
/begin MEASUREMENT iK0sKorSW.sollwert_aktiv "Flag, ob Sollwertgenerierung aktiv ist" UBYTE Conv.cK0sKorSollwert._.sollwert_aktiv_S5_S3 1 100 0 1 BIT_MASK 0x1 ECU_ADDRESS 0xFFF8B9F4 DISPLAY_IDENTIFIER sollwert_aktiv.iK0sKorSW /end MEASUREMENT
/begin MEASUREMENT iK0sKorSW.wn_mot "Soll-Motordrehzahl" SWORD UMR_U_MIN_1_1_0_S5_S3 1 100 0 8128 ECU_ADDRESS 0xFFF8B9F6 DISPLAY_IDENTIFIER wn_mot.iK0sKorSW /end MEASUREMENT
/begin MEASUREMENT iK0sKorSW.wnd_k0 "Differenzdrehzahlsollwert K0" SWORD UMR_U_MIN_1_1_0_S5_S3 1 100 -8128 8128 ECU_ADDRESS 0xFFF8B9E8 DISPLAY_IDENTIFIER wnd_k0.iK0sKorSW /end MEASUREMENT
/begin MEASUREMENT iK0sKorSW.wnd_k0_fl "Differenzdrehzahlsollwert K0 in Float" FLOAT32_IEEE UMR_U_MIN_1_1_0_S5_S3 1 100 -8128 8128 ECU_ADDRESS 0xFFF8B9EC DISPLAY_IDENTIFIER wnd_k0_fl.iK0sKorSW /end MEASUREMENT
/begin MEASUREMENT iK0sKorSW.wnd_p_k0_fl "Ableitung Differenzdrehzahlsollwert K0" FLOAT32_IEEE UMR_U_MINSEC_1_1_0_S5_S3 1 100 -8128 8128 ECU_ADDRESS 0xFFF8B9F0 DISPLAY_IDENTIFIER wnd_p_k0_fl.iK0sKorSW /end MEASUREMENT
/begin MEASUREMENT iK0sKorSignale.delay_m_em_max_dyn_sync_k0.write_index "Index der aktuellen Bufferposition" SBYTE UMR___1_1_0_S5_S3 1 100 0 10 ECU_ADDRESS 0xFFF8B874 DISPLAY_IDENTIFIER delay_m_em_max_dyn_sync_k0.iK0sKorSignale /end MEASUREMENT
/begin MEASUREMENT iK0sKorSignale.delay_m_em_min_dyn_sync_k0.write_index "Index der aktuellen Bufferposition" SBYTE UMR___1_1_0_S5_S3 1 100 0 10 ECU_ADDRESS 0xFFF8B890 DISPLAY_IDENTIFIER delay_m_em_min_dyn_sync_k0.iK0sKorSignale /end MEASUREMENT
/begin MEASUREMENT iK0sKorSignale.delay_m_emist_k0.write_index "Index der aktuellen Bufferposition" SBYTE UMR___1_1_0_S5_S3 1 100 0 10 ECU_ADDRESS 0xFFF8B8C8 DISPLAY_IDENTIFIER delay_m_emist_k0.iK0sKorSignale /end MEASUREMENT
/begin MEASUREMENT iK0sKorSignale.delay_m_motist_k0.write_index "Index der aktuellen Bufferposition" SBYTE UMR___1_1_0_S5_S3 1 100 0 10 ECU_ADDRESS 0xFFF8B858 DISPLAY_IDENTIFIER delay_m_motist_k0.iK0sKorSignale /end MEASUREMENT
/begin MEASUREMENT iK0sKorSignale.delay_m_vmist_k0.write_index "Index der aktuellen Bufferposition" SBYTE UMR___1_1_0_S5_S3 1 100 0 10 ECU_ADDRESS 0xFFF8B8AC DISPLAY_IDENTIFIER delay_m_vmist_k0.iK0sKorSignale /end MEASUREMENT
/begin MEASUREMENT iK0sKorSignale.delay_m_vmsollgemvor_k0.write_index "Index der aktuellen Bufferposition" SBYTE UMR___1_1_0_S5_S3 1 100 0 10 ECU_ADDRESS 0xFFF8B834 DISPLAY_IDENTIFIER delay_m_vmsollgemvor_k0.iK0sKorSignale /end MEASUREMENT
/begin MEASUREMENT iK0sKorSignale.delay_n_mot_k0.write_index "Index der aktuellen Bufferposition" SBYTE UMR___1_1_0_S5_S3 1 100 0 10 ECU_ADDRESS 0xFFF8B8E4 DISPLAY_IDENTIFIER delay_n_mot_k0.iK0sKorSignale /end MEASUREMENT
/begin MEASUREMENT iK0sKorSignale.delay_n_tneu_k0.write_index "Index der aktuellen Bufferposition" SBYTE UMR___1_1_0_S5_S3 1 100 0 10 ECU_ADDRESS 0xFFF8B938 DISPLAY_IDENTIFIER delay_n_tneu_k0.iK0sKorSignale /end MEASUREMENT
/begin MEASUREMENT iK0sKorSignale.delay_n_vm_k0.write_index "Index der aktuellen Bufferposition" SBYTE UMR___1_1_0_S5_S3 1 100 0 10 ECU_ADDRESS 0xFFF8B900 DISPLAY_IDENTIFIER delay_n_vm_k0.iK0sKorSignale /end MEASUREMENT
/begin MEASUREMENT iK0sKorSignale.delay_nabneu_k0.write_index "Index der aktuellen Bufferposition" SBYTE UMR___1_1_0_S5_S3 1 100 0 10 ECU_ADDRESS 0xFFF8B91C DISPLAY_IDENTIFIER delay_nabneu_k0.iK0sKorSignale /end MEASUREMENT
/begin MEASUREMENT iK0sKorSignale.dk_pedal_k0_dt1.Pt1Si16.x "Filterwert" SLONG UMR___1_300_0_S5_S3 1 100 -7158278.82667 7158278.82333 ECU_ADDRESS 0xFFF8B82C DISPLAY_IDENTIFIER Pt1Si16.dk_pedal_k0_dt1.iK0sKorSignale /end MEASUREMENT
/begin MEASUREMENT iK0sKorSignale.dk_pedal_k0_dt1.xp "Ableitung vom Eingangswert" SWORD UMR___1_1_0_S5_S3 1 100 -32768 32767 ECU_ADDRESS 0xFFF8B828 DISPLAY_IDENTIFIER dk_pedal_k0_dt1.iK0sKorSignale /end MEASUREMENT
/begin MEASUREMENT iK0sKorSignale.dkg_pedal_k0 "Gradient vom Fahrpedalistwert" SWORD UMR_PROZENT_SEC_20_51_0_S5_S3 1 100 -3187.45098039 3187.45098039 ECU_ADDRESS 0xFFF8B7B6 DISPLAY_IDENTIFIER dkg_pedal_k0.iK0sKorSignale /end MEASUREMENT
/begin MEASUREMENT iK0sKorSignale.dt1_m_vmsollgemvor_k0.Pt1Si16.x "Filterwert" SLONG UMR___1_300_0_S5_S3 1 100 -7158278.82667 7158278.82333 ECU_ADDRESS 0xFFF8B850 DISPLAY_IDENTIFIER Pt1Si16.dt1_m_vmsollgemvor_k0.iK0sKorSignale /end MEASUREMENT
/begin MEASUREMENT iK0sKorSignale.dt1_m_vmsollgemvor_k0.xp "Ableitung vom Eingangswert" SWORD UMR___1_1_0_S5_S3 1 100 -32768 32767 ECU_ADDRESS 0xFFF8B84C DISPLAY_IDENTIFIER dt1_m_vmsollgemvor_k0.iK0sKorSignale /end MEASUREMENT
/begin MEASUREMENT iK0sKorSignale.dt1_ngab_k0.Pt1Si16.x "Filterwert" SLONG UMR___1_300_0_S5_S3 1 100 -7158278.82667 7158278.82333 ECU_ADDRESS 0xFFF8B954 DISPLAY_IDENTIFIER Pt1Si16.dt1_ngab_k0.iK0sKorSignale /end MEASUREMENT
/begin MEASUREMENT iK0sKorSignale.dt1_ngab_k0.xp "Ableitung vom Eingangswert" SWORD UMR___1_1_0_S5_S3 1 100 -32768 32767 ECU_ADDRESS 0xFFF8B950 DISPLAY_IDENTIFIER dt1_ngab_k0.iK0sKorSignale /end MEASUREMENT
/begin MEASUREMENT iK0sKorSignale.dt1_ngem_sync_k0.Pt1Si16.x "Filterwert" SLONG UMR___1_300_0_S5_S3 1 100 -7158278.82667 7158278.82333 ECU_ADDRESS 0xFFF8B95C DISPLAY_IDENTIFIER Pt1Si16.dt1_ngem_sync_k0.iK0sKorSignale /end MEASUREMENT
/begin MEASUREMENT iK0sKorSignale.dt1_ngem_sync_k0.xp "Ableitung vom Eingangswert" SWORD UMR___1_1_0_S5_S3 1 100 -32768 32767 ECU_ADDRESS 0xFFF8B958 DISPLAY_IDENTIFIER dt1_ngem_sync_k0.iK0sKorSignale /end MEASUREMENT
/begin MEASUREMENT iK0sKorSignale.idx_sp_sps "Sportindex für Spontanität" UBYTE Conv.cK0sKorSignale._.idx_sp_sps_S5_S3 1 100 0 1 ECU_ADDRESS 0xFFF8B7C0 DISPLAY_IDENTIFIER idx_sp_sps.iK0sKorSignale /end MEASUREMENT
/begin MEASUREMENT iK0sKorSignale.idx_sp_sps_lf "Sportindex für Spontanität während Lastwechsel" UBYTE Conv.cK0sKorSignale._.idx_sp_sps_lf_S5_S3 1 100 0 1 ECU_ADDRESS 0xFFF8B7BE DISPLAY_IDENTIFIER idx_sp_sps_lf.iK0sKorSignale /end MEASUREMENT
/begin MEASUREMENT iK0sKorSignale.idx_sp_sps_schalt "Sportindex für Spontanität während Schaltung" UBYTE Conv.cK0sKorSignale._.idx_sp_sps_schalt_S5_S3 1 100 0 1 ECU_ADDRESS 0xFFF8B7BF DISPLAY_IDENTIFIER idx_sp_sps_schalt.iK0sKorSignale /end MEASUREMENT
/begin MEASUREMENT iK0sKorSignale.idx_zs_zug_k0 "Zug/Schub-Bestimmung wie zs_zug_k0 (0 oder 1)" UBYTE Conv.cK0sKorSignale._.idx_zs_zug_k0_S5_S3 1 100 0 1 ECU_ADDRESS 0xFFF8B7B5 DISPLAY_IDENTIFIER idx_zs_zug_k0.iK0sKorSignale /end MEASUREMENT
/begin MEASUREMENT iK0sKorSignale.k0_soll_erw "K0-Sollzustand erweitert mit dem intern gearbeitet wird vor Diagnose und sonderfunktionen" UBYTE Conv.cK0sKorSignale._.k0_soll_erw_S5_S3 1 100 0 5 ECU_ADDRESS 0xFFF8B7B1 DISPLAY_IDENTIFIER k0_soll_erw.iK0sKorSignale /end MEASUREMENT
/begin MEASUREMENT iK0sKorSignale.k0_soll_gepr "K0-Sollzustand mit dem intern gearbeitet wird nach allen Priorisierungen" UBYTE Conv.cK0sKorSignale._.k0_soll_gepr_S5_S3 1 100 0 6 ECU_ADDRESS 0xFFF8B7B0 DISPLAY_IDENTIFIER k0_soll_gepr.iK0sKorSignale /end MEASUREMENT
/begin MEASUREMENT iK0sKorSignale.m_diff_k0 "Differenzmoment an der Kupplung K0" FLOAT32_IEEE UMR_NM__1_1_0_S5_S3 1 100 -1500 1500 ECU_ADDRESS 0xFFF8B7F0 DISPLAY_IDENTIFIER m_diff_k0.iK0sKorSignale /end MEASUREMENT
/begin RECORD_LAYOUT ZF_KL_INT32_S3_S3 FNC_VALUES 3 SLONG COLUMN_DIR DIRECT AXIS_PTS_X 2 SLONG INDEX_INCR DIRECT NO_AXIS_PTS_X 1 ULONG /end RECORD_LAYOUT
/begin RECORD_LAYOUT ZF_KL_INT32_S4_S3 FNC_VALUES 3 SLONG COLUMN_DIR DIRECT AXIS_PTS_X 2 SLONG INDEX_INCR DIRECT NO_AXIS_PTS_X 1 ULONG /end RECORD_LAYOUT
/begin RECORD_LAYOUT ZF_KL_INT8_S1_S3 FNC_VALUES 3 SBYTE COLUMN_DIR DIRECT AXIS_PTS_X 2 SBYTE INDEX_INCR DIRECT NO_AXIS_PTS_X 1 ULONG /end RECORD_LAYOUT
/begin RECORD_LAYOUT ZF_KL_INT8_S2_S3 FNC_VALUES 3 SBYTE COLUMN_DIR DIRECT AXIS_PTS_X 2 SBYTE INDEX_INCR DIRECT NO_AXIS_PTS_X 1 ULONG /end RECORD_LAYOUT
/begin RECORD_LAYOUT ZF_KL_INT8_S3_S3 FNC_VALUES 3 SBYTE COLUMN_DIR DIRECT AXIS_PTS_X 2 SBYTE INDEX_INCR DIRECT NO_AXIS_PTS_X 1 ULONG /end RECORD_LAYOUT
/begin RECORD_LAYOUT ZF_KL_INT8_S4_S3 FNC_VALUES 3 SBYTE COLUMN_DIR DIRECT AXIS_PTS_X 2 SBYTE INDEX_INCR DIRECT NO_AXIS_PTS_X 1 ULONG /end RECORD_LAYOUT
/begin RECORD_LAYOUT ZF_KL_NAT16_S3_S3 FNC_VALUES 3 UWORD COLUMN_DIR DIRECT AXIS_PTS_X 2 UWORD INDEX_INCR DIRECT NO_AXIS_PTS_X 1 ULONG /end RECORD_LAYOUT
/begin RECORD_LAYOUT ZF_KL_NAT16_S4_S3 FNC_VALUES 3 UWORD COLUMN_DIR DIRECT AXIS_PTS_X 2 UWORD INDEX_INCR DIRECT NO_AXIS_PTS_X 1 ULONG /end RECORD_LAYOUT
/begin RECORD_LAYOUT ZF_KL_NAT32_S1_S3 FNC_VALUES 3 ULONG COLUMN_DIR DIRECT AXIS_PTS_X 2 ULONG INDEX_INCR DIRECT NO_AXIS_PTS_X 1 ULONG /end RECORD_LAYOUT
/begin RECORD_LAYOUT ZF_KL_NAT32_S2_S3 FNC_VALUES 3 ULONG COLUMN_DIR DIRECT AXIS_PTS_X 2 ULONG INDEX_INCR DIRECT NO_AXIS_PTS_X 1 ULONG /end RECORD_LAYOUT
/begin RECORD_LAYOUT ZF_KL_NAT32_S3_S3 FNC_VALUES 3 ULONG COLUMN_DIR DIRECT AXIS_PTS_X 2 ULONG INDEX_INCR DIRECT NO_AXIS_PTS_X 1 ULONG /end RECORD_LAYOUT
/begin RECORD_LAYOUT ZF_KL_NAT32_S4_S3 FNC_VALUES 3 ULONG COLUMN_DIR DIRECT AXIS_PTS_X 2 ULONG INDEX_INCR DIRECT NO_AXIS_PTS_X 1 ULONG /end RECORD_LAYOUT
/begin RECORD_LAYOUT ZF_KL_NAT8_S1_S3 FNC_VALUES 3 UBYTE COLUMN_DIR DIRECT AXIS_PTS_X 2 UBYTE INDEX_INCR DIRECT NO_AXIS_PTS_X 1 ULONG /end RECORD_LAYOUT
/begin RECORD_LAYOUT ZF_KL_NAT8_S3_S3 FNC_VALUES 3 UBYTE COLUMN_DIR DIRECT AXIS_PTS_X 2 UBYTE INDEX_INCR DIRECT NO_AXIS_PTS_X 1 ULONG /end RECORD_LAYOUT
/begin RECORD_LAYOUT ZF_KL_NAT8_S4_S3 FNC_VALUES 3 UBYTE COLUMN_DIR DIRECT AXIS_PTS_X 2 UBYTE INDEX_INCR DIRECT NO_AXIS_PTS_X 1 ULONG /end RECORD_LAYOUT
/begin RECORD_LAYOUT ZF_KW_INT16_S1_S3 FNC_VALUES 1 SWORD COLUMN_DIR DIRECT /end RECORD_LAYOUT
/begin RECORD_LAYOUT ZF_KW_INT16_S4_S3 FNC_VALUES 1 SWORD COLUMN_DIR DIRECT /end RECORD_LAYOUT
/begin RECORD_LAYOUT ZF_KW_INT32_S1_S3 FNC_VALUES 1 SLONG COLUMN_DIR DIRECT /end RECORD_LAYOUT
/begin RECORD_LAYOUT ZF_KW_INT32_S2_S3 FNC_VALUES 1 SLONG COLUMN_DIR DIRECT /end RECORD_LAYOUT
/end MODULE
/end PROJECT
