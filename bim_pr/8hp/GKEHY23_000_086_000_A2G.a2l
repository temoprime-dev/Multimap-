ASAP2_VERSION 1 51
/begin PROJECT ZHBC8600 "Gen2_BMW_System_Supplier_Lib"
/begin MODULE CPP ""
/begin MOD_COMMON "" BYTE_ORDER MSB_FIRST ALIGNMENT_BYTE 1 ALIGNMENT_WORD 2 ALIGNMENT_LONG 4 ALIGNMENT_FLOAT32_IEEE 4 ALIGNMENT_FLOAT64_IEEE 1 /end MOD_COMMON
/begin COMPU_VTAB B_TRUE_S1 "boolean states, positive logic" TAB_VERB 2 0 "FALSE" 1 "TRUE" DEFAULT_VALUE "xxxxx" /end COMPU_VTAB
/begin COMPU_VTAB Q_SIG_S1 "signal quality information" TAB_VERB 9 0 "init" 1 "not_available" 2 "no_source" 3 "fix" 4 "fix_source" 5 "model_based" 6 "diff_source" 7 "ok_disturbed" 8 "ok" DEFAULT_VALUE "xxxxx" /end COMPU_VTAB
/begin COMPU_METHOD _CNV_R_R_Umr_20_zu__146_CM_S2 "" RAT_FUNC "%6.3" "°" COEFFS 0 20 0 0 0 1 /end COMPU_METHOD
/begin COMPU_METHOD _CNV_R_R_Umr_800_zu_271_CM_S2 "" RAT_FUNC "%6.3" "" COEFFS 0 800 0 0 0 1 /end COMPU_METHOD
/begin COMPU_METHOD B_TRUE_S1 "boolean states, positive logic" TAB_VERB "%6.3" "" COMPU_TAB_REF B_TRUE_S1 /end COMPU_METHOD
/begin COMPU_METHOD DN1_S1 "[1rpm/s] revolutions gradient" RAT_FUNC "%6.2" "rpm/s" COEFFS 0 1 0 0 0 1 /end COMPU_METHOD
/begin COMPU_METHOD F1_S1 "[1Hz] frequency" RAT_FUNC "%6.2" "Hz" COEFFS 0 1 0 0 0 1 /end COMPU_METHOD
/begin COMPU_METHOD I0_0001_S1 "[0.0001A] current" RAT_FUNC "%7.6" "A" COEFFS 0 10000 0 0 0 1 /end COMPU_METHOD
/begin COMPU_METHOD N0_25_S1 "[0.25rpm] revolutions" RAT_FUNC "%6.3" "rpm" COEFFS 0 4 0 0 0 1 /end COMPU_METHOD
/begin COMPU_METHOD Q_SIG_S1 "signal quality information" TAB_VERB "%6.3" "" COMPU_TAB_REF Q_SIG_S1 /end COMPU_METHOD
/begin COMPU_METHOD R0_0001_S1 "[0.0001]" RAT_FUNC "%7.6" "" COEFFS 0 10000 0 0 0 1 /end COMPU_METHOD
/begin COMPU_METHOD R0_001_S1 "[0.001]" RAT_FUNC "%6.5" "" COEFFS 0 1000 0 0 0 1 /end COMPU_METHOD
/begin COMPU_METHOD R0_0625_S1 "[1/16]" RAT_FUNC "%6.4" "" COEFFS 0 16 0 0 0 1 /end COMPU_METHOD
/begin COMPU_METHOD R0_1_P_S1 "[0.1%]" RAT_FUNC "%6.3" "%" COEFFS 0 10 0 0 0 1 /end COMPU_METHOD
/begin COMPU_METHOD T0_0078125_S1 "[0.0078125°C] temperature" RAT_FUNC "%6.4" "°C" COEFFS 0 128 0 0 0 1 /end COMPU_METHOD
/begin COMPU_METHOD T0_0625_OFFS_0x8000_S1 "[0.0625°C -2048°C (0x8000=0°C)] temperature" RAT_FUNC "%6.0" "°C" COEFFS 0 16 32768 0 0 1 /end COMPU_METHOD
/begin COMPU_METHOD T0_0625_S1 "[0.0625°C] temperature" RAT_FUNC "%6.4" "°C" COEFFS 0 16 0 0 0 1 /end COMPU_METHOD
/begin COMPU_METHOD T1_OFFS_40_S1 "[1°C -40°C] temperature" RAT_FUNC "%6.2" "°C" COEFFS 0 1 40 0 0 1 /end COMPU_METHOD
/begin COMPU_METHOD TI0_00005_M_S1 "[0.00005ms] time" RAT_FUNC "%7.6" "ms" COEFFS 0 20000 0 0 0 1 /end COMPU_METHOD
/begin COMPU_METHOD TI0_00025_M_S1 "[0.00025ms] time" RAT_FUNC "%6.5" "ms" COEFFS 0 4000 0 0 0 1 /end COMPU_METHOD
/begin COMPU_METHOD TI0_0005_M_S1 "[0.0005ms] time" RAT_FUNC "%6.5" "ms" COEFFS 0 2000 0 0 0 1 /end COMPU_METHOD
/begin COMPU_METHOD TI0_001_M_S1 "[0.001ms] time" RAT_FUNC "%6.5" "ms" COEFFS 0 1000 0 0 0 1 /end COMPU_METHOD
/begin COMPU_METHOD TI1_CYCLE_S1 "[0.1s] resolution in multiples of 100ms task" RAT_FUNC "%6.3" "s" COEFFS 0 10 0 0 0 1 /end COMPU_METHOD
/begin COMPU_METHOD TI1_M_CYCLE_S1 "[ms] resolution in multiples of main task (time*ROS_NUM_MNTSK_100MS_SY/100.0ms)" RAT_FUNC "%6.2" "ms" COEFFS 0 0.2 0 0 0 1 /end COMPU_METHOD
/begin COMPU_METHOD TI1_M_S1 "[1ms] time" RAT_FUNC "%6.2" "ms" COEFFS 0 1 0 0 0 1 /end COMPU_METHOD
/begin COMPU_METHOD TI1_U_S1 "[1µs] time" RAT_FUNC "%6.2" "µs" COEFFS 0 1 0 0 0 1 /end COMPU_METHOD
/begin COMPU_METHOD U0_001_S1 "[0.001V] voltage" RAT_FUNC "%6.5" "V" COEFFS 0 1000 0 0 0 1 /end COMPU_METHOD
/begin COMPU_METHOD U0_1_S1 "[0.1V] voltage" RAT_FUNC "%6.3" "V" COEFFS 0 10 0 0 0 1 /end COMPU_METHOD
/begin COMPU_METHOD X1_S1 "[1] no unit" RAT_FUNC "%6.2" "" COEFFS 0 1 0 0 0 1 /end COMPU_METHOD
/begin MEASUREMENT CPU_TimerFastTicks_u32 "F2360: Measured system timer in 0.05us (optional)" ULONG TI0_00005_M_S1 1 100 0 214748.36475 ECU_ADDRESS 0xFFFFF310 FORMAT "%13.6" /end MEASUREMENT
/begin MEASUREMENT CPU_TimerTicks_u32 "F2360: Measured system timer in 1us" ULONG TI0_001_M_S1 1 100 0 4294967.295 ECU_ADDRESS 0xFFFFF220 FORMAT "%13.5" /end MEASUREMENT
/begin CHARACTERISTIC ECE_CAN_stWakUpCheck_C "F2357: Bitmask defining the possibility of the CAN transceiver to detect a CAN-wakeup in current HW configuration (B0:CAN-Transceiver1, B1:CAN-Transc2) (only if supported by HW configuration) (no SERAP)" VALUE 0x191887 AblGLKWub_S1 255 X1_S1 0 255 FORMAT "%5.1" /end CHARACTERISTIC
/begin MEASUREMENT ECE_CC08_bDiaDly "F2366: Delay of the DIA return value compared to output value expected" UBYTE B_TRUE_S1 1 100 0 1 ECU_ADDRESS 0xFFF9090E FORMAT "%13.11" /end MEASUREMENT
/begin CHARACTERISTIC ECE_CC08_bUseDither_C "F2366: Use the dither function even in old ASIC steps (consider that the freq. is deviating because of the slower PCLK) (no SERAP)" VALUE 0x191888 AblGLKWub_S1 1 B_TRUE_S1 0 1 FORMAT "%13.11" /end CHARACTERISTIC
/begin MEASUREMENT ECE_CC08_ctMissDithIsr "F2366: missing dither ISR counter (free-running)" UBYTE X1_S1 1 100 0 255 ECU_ADDRESS 0xFFF9091A FORMAT "%5.1" /end MEASUREMENT
/begin MEASUREMENT ECE_CC08_iAct "F2366: Actual output current of the CG208 current control channel" UWORD I0_0001_S1 1 100 0 1.2 ECU_ADDRESS 0xFFF90244 FORMAT "%8.6" MATRIX_DIM 10 1 1 /end MEASUREMENT
/begin MEASUREMENT ECE_CC08_iActDelta "F2366: Delta current measured by CG208" SWORD I0_0001_S1 1 100 -1.2 1.2 ECU_ADDRESS 0xFFF90258 FORMAT "%8.6" MATRIX_DIM 10 1 1 /end MEASUREMENT
/begin MEASUREMENT ECE_CC08_iCmd "F2366: Commanded current of the CG208 current control channel" UWORD I0_0001_S1 1 100 0 1.2 ECU_ADDRESS 0xFFF90230 FORMAT "%8.6" MATRIX_DIM 10 1 1 /end MEASUREMENT
/begin MEASUREMENT ECE_CC08_iDam "F2366: CG208 dither current amplitude" UWORD I0_0001_S1 1 100 0 0.4 ECU_ADDRESS 0xFFF90320 FORMAT "%9.7" MATRIX_DIM 10 1 1 /end MEASUREMENT
/begin MEASUREMENT ECE_CC08_idxDithGrpAssign "F2366: CG208 index to which dither group the channel is assigned info: 0:DthGrp_0, 1:DthGrp_1, 2:DthGrp_2, 3:DthGrp_3" UBYTE X1_S1 1 100 0 255 ECU_ADDRESS 0xFFF90826 FORMAT "%5.1" MATRIX_DIM 10 1 1 /end MEASUREMENT
/begin MEASUREMENT ECE_CC08_idxSyncGrpAssign "F2366: CG208 index to which sync group the ASIC-device is assigned info: 0:SyncGrp_0, 1:SyncGrp_1, 2:SyncGrp_2" UBYTE X1_S1 1 100 0 255 ECU_ADDRESS 0xFFF9090F FORMAT "%5.1" MATRIX_DIM 5 1 1 /end MEASUREMENT
/begin MEASUREMENT ECE_CC08_regDfr "F2366: CG208 dither-freq-register settings (if B5=0: B0-4: 781.25Hz/n or 1.28ms*n)   (if B5=1: B0-4: 3125Hz/n or 0.32ms*n)" UBYTE X1_S1 1 100 0 255 ECU_ADDRESS 0xFFF9090B FORMAT "%5.1" MATRIX_DIM 3 1 1 /end MEASUREMENT
/begin MEASUREMENT ECE_CC08_regInt "F2366: CG208 integrator register settings (B7+B6:P-Reg, B5-B0:n) (note: Ax-step uses slightly different structure)" UBYTE X1_S1 1 100 0 255 ECU_ADDRESS 0xFFF908FB FORMAT "%5.1" MATRIX_DIM 5 1 1 /end MEASUREMENT
/begin CHARACTERISTIC ECE_CC08_regInt_C "F2366: CG208 integrator register settings (B7+B6:P-Reg, B5-B0:n) (note: Ax-step uses slightly different structure) (no SERAP)" VAL_BLK 0x191889 AblGLKWBub_S1 255 X1_S1 0 255 MATRIX_DIM 5 1 1 FORMAT "%5.1" /end CHARACTERISTIC
/begin CHARACTERISTIC ECE_CC08_regMode_C "F2366: CG208 set-register settings (only B4:slow-driver mode) (no SERAP)" VALUE 0x19188E AblGLKWub_S1 255 X1_S1 0 255 FORMAT "%5.1" /end CHARACTERISTIC
/begin MEASUREMENT ECE_CC08_regOsc "F2366: CG208 oscillator register settings: B0-6: n*31.25Hz  B7:undervoltage behavior (note: Ax-step uses slightly different structure)" UBYTE X1_S1 1 100 0 255 ECU_ADDRESS 0xFFF90900 FORMAT "%5.1" MATRIX_DIM 5 1 1 /end MEASUREMENT
/begin CHARACTERISTIC ECE_CC08_regOsc_C "F2366: B7:undervoltage behavior (note: Ax-step uses slightly different structure) (no SERAP)" VALUE 0x19188F AblGLKWub_S1 255 X1_S1 0 255 FORMAT "%5.1" /end CHARACTERISTIC
/begin MEASUREMENT ECE_CC08_regRound "F2366: rounding information current: standard=3, special=1 or 4" UBYTE X1_S1 1 100 0 5 ECU_ADDRESS 0xFFF9090A FORMAT "%5.3" /end MEASUREMENT
/begin CHARACTERISTIC ECE_CC08_regRound_C "F2366: rounding mode selection (3=no rounding, others=rounding) (evaluated once only) (no SERAP)" VALUE 0x191890 AblGLKWub_S1 255 X1_S1 0 255 FORMAT "%5.1" /end CHARACTERISTIC
/begin MEASUREMENT ECE_CC08_regSet "F2366: CG208 set-register settings (B0-5: n*0.31ms, B7+B6:P-reg) (note: Ax-step uses slightly different structure)" UBYTE X1_S1 1 100 0 255 ECU_ADDRESS 0xFFF90905 FORMAT "%5.1" MATRIX_DIM 5 1 1 /end MEASUREMENT
/begin CHARACTERISTIC ECE_CC08_regSet_C "F2366: CG208 set-register settings (B0-5: n*0.31ms, B7+B6:P-reg) (note: Ax-step uses slightly different structure) (no SERAP)" VAL_BLK 0x191891 AblGLKWBub_S1 255 X1_S1 0 255 MATRIX_DIM 5 1 1 FORMAT "%5.1" /end CHARACTERISTIC
/begin CHARACTERISTIC ECE_CC08_stAvail_C "F2366: bit-array to select whether ASIC (not channel) is mounted (B0:CG208-0, B1:Cg208-1 ...) (no SERAP)" VALUE 0x191896 AblGLKWub_S1 255 X1_S1 0 255 FORMAT "%5.1" /end CHARACTERISTIC
/begin MEASUREMENT ECE_CC08_stModeAct "F2366: Actual output mode (0x00:CURR_OFF, 0x21:CURR, 0x32:SW_OFF, 0x43:SW_ON)" UBYTE X1_S1 1 100 0 255 ECU_ADDRESS 0xFFF9081C FORMAT "%5.1" MATRIX_DIM 10 1 1 /end MEASUREMENT
/begin MEASUREMENT ECE_CC08_stModeCmd "F2366: Commanded output mode (0x00:CURR_OFF, 0x21:CURR, 0x32:SW_OFF, 0x43:SW_ON)" UBYTE X1_S1 1 100 0 255 ECU_ADDRESS 0xFFF90812 FORMAT "%5.1" MATRIX_DIM 10 1 1 /end MEASUREMENT
/begin CHARACTERISTIC ECE_CC08_stOnOffMode_C "F2366: Activation of a special on/off mode for each CC channel (B0:Ch0,B1:Ch1, ...) (no SERAP)" VALUE 0x19146C AblGLKWuw_S1 65535 X1_S1 0 65535 FORMAT "%8.2" /end CHARACTERISTIC
/begin CHARACTERISTIC ECE_CC08_stSpiDiaDynMsk_C "F2366: Global mask to deactivate certain SPI-Diagnosis-Bits (see ECE_CC08_stSpiDiag) (no SERAP)" VALUE 0x191897 AblGLKWub_S1 255 X1_S1 0 255 FORMAT "%5.1" /end CHARACTERISTIC
/begin MEASUREMENT ECE_CC08_stSpiDiag "F2366: SPI diagnosis info: B15:ident correct,B14:DN,B13:CLKERR,B12:SEL,B10:SPI-Data-Err,B9:SPI-Err,B8:SPI-ok;B7:NOC,B6:RCHG,B5:OT,B4:OC,B3:OC,B2:NS,B1+0:ERR" UWORD X1_S1 1 100 0 65535 ECU_ADDRESS 0xFFF9030C FORMAT "%8.2" MATRIX_DIM 10 1 1 /end MEASUREMENT
/begin MEASUREMENT ECE_CC08_stVersion "F2366: Version status: 0=newest, 1=Ax-step" UBYTE X1_S1 1 100 0 255 ECU_ADDRESS 0xFFF9091B FORMAT "%5.1" /end MEASUREMENT
/begin CHARACTERISTIC ECE_CC08_tiDfrInit_C "F2366: CG208 dither period [ms] range form 0ms - 0,32ms:3125Hz. Up to three dither periodes available  (no SERAP)" VAL_BLK 0x19146E AblGLKWBuw_S1 45 TI0_001_M_S1 0 45 MATRIX_DIM 3 1 1 FORMAT "%8.5" /end CHARACTERISTIC
/begin MEASUREMENT ECE_CC08_tiDithIsr "F2366: CG208 dither interrupt timing parameters (idx0:dly sample-high, idx1:dly sample-low, idx2:dly period)" UWORD TI0_001_M_S1 1 100 0 65.535 ECU_ADDRESS 0xFFF9020C FORMAT "%8.5" MATRIX_DIM 3 1 1 /end MEASUREMENT
/begin CHARACTERISTIC ECE_CC08_tiDithIsrFast_C "F2366: CG208 dither interrupt timing parameters (idx0:dly sample-high, idx1:dly sample-low, idx2:dly period)  (table used if ECE_CC08_regDfr_C Bit5 is set (0.32ms)) (no SERAP)" MAP 0x19020C AblGLFKFuw_S1 64.835 TI0_001_M_S1 0.7 65.535
 /begin AXIS_DESCR FIX_AXIS ECE_idxDmy X1_S1 3 0 2 READ_ONLY FORMAT "%5.3" FIX_AXIS_PAR_DIST 0 1 3 /end AXIS_DESCR
 /begin AXIS_DESCR FIX_AXIS ECE_idxDmy X1_S1 32 0 31 READ_ONLY FORMAT "%5.2" FIX_AXIS_PAR_DIST 0 1 32 /end AXIS_DESCR
 FORMAT "%8.5" /end CHARACTERISTIC
/begin CHARACTERISTIC ECE_CC08_tiDithIsrSlow_C "F2366: CG208 dither interrupt timing parameters (idx0:dly sample-high, idx1:dly sample-low, idx2:dly period)  (table used if ECE_CC08_regDfr_C Bit5 is cleared (1.28ms)) (no SERAP)" MAP 0x1902CC AblGLFKFuw_S1 64.835 TI0_001_M_S1 0.7 65.535
 /begin AXIS_DESCR FIX_AXIS ECE_idxDmy X1_S1 3 0 2 READ_ONLY FORMAT "%5.3" FIX_AXIS_PAR_DIST 0 1 3 /end AXIS_DESCR
 /begin AXIS_DESCR FIX_AXIS ECE_idxDmy X1_S1 32 0 31 READ_ONLY FORMAT "%5.2" FIX_AXIS_PAR_DIST 0 1 32 /end AXIS_DESCR
 FORMAT "%8.5" /end CHARACTERISTIC
/begin MEASUREMENT ECE_CC08_tiFdbkDuty "F2366: Duty of the feedback PWM related to a CG208 output channel (high/low sequence)" UWORD TI0_001_M_S1 1 100 0 2 ECU_ADDRESS 0xFFF90294 FORMAT "%8.6" MATRIX_DIM 20 1 1 /end MEASUREMENT
/begin MEASUREMENT ECE_CC08_tiFdbkPer "F2366: Period of the feedback PWM related to a CG208 output channel (high/low sequence)" UWORD TI0_001_M_S1 1 100 0 2 ECU_ADDRESS 0xFFF9026C FORMAT "%8.6" MATRIX_DIM 20 1 1 /end MEASUREMENT
/begin MEASUREMENT ECE_CC08_tiSync "F2366: current CG208 sync group output period" UWORD TI0_001_M_S1 1 100 0 2 ECU_ADDRESS 0xFFF9083C FORMAT "%8.6" /end MEASUREMENT
/begin MEASUREMENT ECE_CC08_tiSyncChn "F2366: current CG208 ASIC sync output period" UWORD TI0_001_M_S1 1 100 0 2 ECU_ADDRESS 0xFFF9083E FORMAT "%8.6" MATRIX_DIM 5 1 1 /end MEASUREMENT
/begin CHARACTERISTIC ECE_CC08_tiSyncInit_C "F2366: initial CG208 synchronization period (this has to fit to ECE_CC08_tiSyncPhaseDlyInit_C and other parameter registers) (no SERAP)" VAL_BLK 0x191474 AblGLKWBuw_S1 1.22 TI0_001_M_S1 0.28 1.5 MATRIX_DIM 1 1 1 FORMAT "%8.6" /end CHARACTERISTIC
/begin CHARACTERISTIC ECE_CC08_tiSyncPhaseDlyInit_C "F2366: initial CG208 phase delay between ASICs - the last channel has to have the highest delay sync period if sync changes are used - these values have to fit to ECE_CC08_tiSyncInit_C (here: TimerE resolution!) (no SERAP)" MAP 0x19038C AblGLFKFuw_S1 1.5 TI0_0005_M_S1 0 1.5
 /begin AXIS_DESCR FIX_AXIS ECE_idxDmy X1_S1 5 0 4 READ_ONLY FORMAT "%5.3" FIX_AXIS_PAR_DIST 0 1 5 /end AXIS_DESCR
 /begin AXIS_DESCR FIX_AXIS ECE_idxDmy X1_S1 2 0 1 READ_ONLY FORMAT "%5.3" FIX_AXIS_PAR_DIST 0 1 2 /end AXIS_DESCR
 FORMAT "%8.6" /end CHARACTERISTIC
/begin CHARACTERISTIC ECE_CC08_xDithGrpAssign_C "F2386: bit-array to select whether Cg208 channel is in dithergroup B0:Cg208_0 ch0; B1:Cg208_0 ch1..; B15:Cg208_7 ch1 (no SERAP)" VAL_BLK 0x191476 AblGLKWBuw_S1 65535 X1_S1 0 65535 MATRIX_DIM 3 1 1 FORMAT "%8.2" /end CHARACTERISTIC
/begin CHARACTERISTIC ECE_CC08_xSyncGrpAssign_C "F2386: bit-array to select whether Cg208 ASIC is in sync group B0:Cg208_0; B1:Cg208_1;.. B7:Cg208_7 (no SERAP)" VAL_BLK 0x191898 AblGLKWBub_S1 255 X1_S1 0 255 MATRIX_DIM 1 1 1 FORMAT "%5.1" /end CHARACTERISTIC
/begin MEASUREMENT ECE_Cg124_regInit "F2385: Cg124-Init-Register (B0-3:OTA,B4:0,B5:ISO,B6:VS-VOLT,B7:AG1_OFF)" UBYTE X1_S1 1 100 0 255 ECU_ADDRESS 0xFFF90962 FORMAT "%5.1" /end MEASUREMENT
/begin CHARACTERISTIC ECE_Cg124_regInit_C "F2385: Cg124-Init-Register (B0-3:OTA,B4:0,B5:ISO,B6:VS-VOLT) (no SERAP)" VALUE 0x1918C3 AblGLKWub_S1 255 X1_S1 0 255 FORMAT "%5.1" /end CHARACTERISTIC
/begin MEASUREMENT ECE_Cg130_regInit2 "F2385: Cg130-Init2-Register (B0:TMPSEL,B2:VD1SEL,B3,TREC,B4:OTN_HSD, B5:HSD1, B6:HSD2, B7:HSD3)" UBYTE X1_S1 1 100 0 255 ECU_ADDRESS 0xFFF90963 FORMAT "%5.1" /end MEASUREMENT
/begin CHARACTERISTIC ECE_Cg130_regInit2_C "F2385: Cg130-Init2-Register (B0:TMPSEL,B2:VD1SEL,B3:TREC,B4:OTN_HSD) (no SERAP)" VALUE 0x1918C4 AblGLKWub_S1 255 X1_S1 0 255 FORMAT "%5.1" /end CHARACTERISTIC
/begin MEASUREMENT ECE_FRQ_ctPls "F2364: number of pulses/edges registered (free-running counter)" UWORD X1_S1 1 100 0 65535 ECU_ADDRESS 0xFFF90850 FORMAT "%8.2" MATRIX_DIM 3 1 1 /end MEASUREMENT
/begin MEASUREMENT ECE_FRQ_dn "F2364: speed gradient (related to ECE_FRQ_n)" SWORD DN1_S1 1 100 -32768 32767 ECU_ADDRESS 0xFFF9085C FORMAT "%8.2" MATRIX_DIM 3 1 1 /end MEASUREMENT
/begin CHARACTERISTIC ECE_FRQ_fac_C "F2364: N0I-N3I measurement factor (scaling from detected to relevant physical speed) (default: 1.00)" VAL_BLK 0x1903C8 AblGLKWBr32_S1 10 X1_S1 0 10 MATRIX_DIM 3 1 1 FORMAT "%10.7" /end CHARACTERISTIC
/begin MEASUREMENT ECE_FRQ_n "F2364: raw transmission input/output speed value (status: ECE_FRQ_qn)" UWORD N0_25_S1 1 100 0 16383.75 ECU_ADDRESS 0xFFF90856 FORMAT "%8.2" MATRIX_DIM 3 1 1 /end MEASUREMENT
/begin CHARACTERISTIC ECE_FRQ_nMin_C "F2364: N0I-N3I minimum speed (ECE_FRQ_n) below which a timeout is detected and the speed is set to 0 (no SERAP)" VAL_BLK 0x19147E AblGLKWBuw_S1 200 N0_25_S1 0 200 MATRIX_DIM 3 1 1 FORMAT "%8.4" /end CHARACTERISTIC
/begin CHARACTERISTIC ECE_FRQ_numFifo_C "F2364: N0I-N3I signal detection over number of measurement tasks  (no SERAP)" VAL_BLK 0x19189C AblGLKWBub_S1 3 X1_S1 1 4 MATRIX_DIM 3 1 1 FORMAT "%5.3" /end CHARACTERISTIC
/begin CHARACTERISTIC ECE_FRQ_numGradFifo_C "F2364: N0I-N3I signal detection over number of measurement tasks  (no SERAP)" VAL_BLK 0x19189F AblGLKWBub_S1 3 X1_S1 1 4 MATRIX_DIM 3 1 1 FORMAT "%5.3" /end CHARACTERISTIC
/begin CHARACTERISTIC ECE_FRQ_numPlsPerRev_C "F2364: N0I-N3I Number of pulses per revolution  (no SERAP)" VAL_BLK 0x1918A2 AblGLKWBub_S1 190 X1_S1 10 200 MATRIX_DIM 3 1 1 FORMAT "%5.1" /end CHARACTERISTIC
/begin MEASUREMENT ECE_FRQ_qdn "F2364: quality info of ECE_FRQ_dn (0:INIT, 5:TO,6:TOW,7:weak-filter,8:VALID)" UBYTE Q_SIG_S1 1 100 0 8 ECU_ADDRESS 0xFFF90927 FORMAT "%13.11" MATRIX_DIM 3 1 1 /end MEASUREMENT
/begin MEASUREMENT ECE_FRQ_qn "F2364: quality info of ECE_FRQ_n (0:INIT, 5:TO,6:TOW,8:VALID)" UBYTE Q_SIG_S1 1 100 0 8 ECU_ADDRESS 0xFFF90924 FORMAT "%13.11" MATRIX_DIM 3 1 1 /end MEASUREMENT
/begin CHARACTERISTIC ECE_FRQ_stAvail_C "F2364: bit-array to select which N0I-N3I channel is activated (no SERAP)" VALUE 0x1918A5 AblGLKWub_S1 255 X1_S1 0 255 FORMAT "%5.1" /end CHARACTERISTIC
/begin MEASUREMENT ECE_FRQ_stHwDiag "F2364: Reported HW diagnosis information (B0:SB,B1:OP or SG,B2:NA, B7:OK)" UBYTE X1_S1 1 100 0 255 ECU_ADDRESS 0xFFF90921 FORMAT "%5.1" MATRIX_DIM 3 1 1 /end MEASUREMENT
/begin CHARACTERISTIC ECE_FRQ_tiCfg_C "F2364: N0I-N3I timeout+channel configuration (0:timeout [0.25us], 1:timeout-weak [0.25us], 2:(pol<<8) duty-low=0 or duty-high=256) (no SERAP)" MAP 0x1903A4 AblGLFKFul_S1 4294970000 X1_S1 0 4294967295
 /begin AXIS_DESCR FIX_AXIS ECE_idxDmy X1_S1 3 0 2 READ_ONLY FORMAT "%5.3" FIX_AXIS_PAR_DIST 0 1 3 /end AXIS_DESCR
 /begin AXIS_DESCR FIX_AXIS ECE_idxDmy X1_S1 3 0 2 READ_ONLY FORMAT "%5.3" FIX_AXIS_PAR_DIST 0 1 3 /end AXIS_DESCR
 FORMAT "%13.2" /end CHARACTERISTIC
/begin MEASUREMENT ECE_FRQ_tiPls "F2364: Pulse length of speed signal (last measured signal period)" UWORD TI1_U_S1 1 100 0 65535 ECU_ADDRESS 0xFFF9084A FORMAT "%8.2" MATRIX_DIM 3 1 1 /end MEASUREMENT
/begin MEASUREMENT ECE_IWD_RESP_regRx "F2392: IWD response data message (RX)" UWORD X1_S1 1 100 0 65535 ECU_ADDRESS 0xFFF889FC FORMAT "%8.2" MATRIX_DIM 7 1 1 /end MEASUREMENT
/begin MEASUREMENT ECE_IWD_RESP_regTx "F2392: IWD response data message (TX)" UWORD X1_S1 1 100 0 65535 ECU_ADDRESS 0xFFF889EE FORMAT "%8.2" MATRIX_DIM 7 1 1 /end MEASUREMENT
/begin MEASUREMENT ECE_IWD_TIME_regRx "F2392: IWD response time message (RX)" UWORD X1_S1 1 100 0 65535 ECU_ADDRESS 0xFFF88128 FORMAT "%8.2" MATRIX_DIM 4 1 1 /end MEASUREMENT
/begin MEASUREMENT ECE_IWD_TIME_regTx "F2392: IWD response time message (TX)" UWORD X1_S1 1 100 0 65535 ECU_ADDRESS 0xFFF88120 FORMAT "%8.2" MATRIX_DIM 4 1 1 /end MEASUREMENT
/begin MEASUREMENT ECE_IWD_bActive "F2392: IWD active: TRUE=IWD timeout counter can cause interrupt" UBYTE B_TRUE_S1 1 100 0 1 ECU_ADDRESS 0xFFF9092A FORMAT "%13.11" /end MEASUREMENT
/begin MEASUREMENT ECE_IWD_reg.ctRESP "F2392: IWD register structure / " UBYTE X1_S1 1 100 0 255 ECU_ADDRESS 0xFFF9054D FORMAT "%5.1" /end MEASUREMENT
/begin MEASUREMENT ECE_IWD_reg.ctTIME "F2392: IWD register structure / " UBYTE X1_S1 1 100 0 255 ECU_ADDRESS 0xFFF9054C FORMAT "%5.1" /end MEASUREMENT
/begin MEASUREMENT ECE_IWD_reg.regREQUHI "F2392: IWD register structure / " UBYTE X1_S1 1 100 0 255 ECU_ADDRESS 0xFFF90551 FORMAT "%5.1" /end MEASUREMENT
/begin MEASUREMENT ECE_IWD_reg.regREQULO "F2392: IWD register structure / " UBYTE X1_S1 1 100 0 255 ECU_ADDRESS 0xFFF90550 FORMAT "%5.1" /end MEASUREMENT
/begin MEASUREMENT ECE_IWD_reg.regRESP "F2392: IWD register structure / " ULONG X1_S1 1 100 0 4294967295 ECU_ADDRESS 0xFFF90548 FORMAT "%13.2" /end MEASUREMENT
/begin MEASUREMENT ECE_IWD_reg.regRESP_TIME_RX "F2392: IWD register structure / " UBYTE X1_S1 1 100 0 255 ECU_ADDRESS 0xFFF9054F FORMAT "%5.1" /end MEASUREMENT
/begin MEASUREMENT ECE_IWD_reg.regRESP_TIME_TX "F2392: IWD register structure / " UBYTE X1_S1 1 100 0 255 ECU_ADDRESS 0xFFF9054E FORMAT "%5.1" /end MEASUREMENT
/begin MEASUREMENT ECE_IWD_reg.stEmpty "F2392: IWD register structure / " UBYTE X1_S1 1 100 0 255 ECU_ADDRESS 0xFFF90543 FORMAT "%5.1" /end MEASUREMENT
/begin MEASUREMENT ECE_IWD_reg.stErrDatMsk "F2392: IWD register structure / " UBYTE X1_S1 1 100 0 255 ECU_ADDRESS 0xFFF90542 FORMAT "%5.1" /end MEASUREMENT
/begin MEASUREMENT ECE_IWD_reg.stErrMsk "F2392: IWD register structure / " UBYTE X1_S1 1 100 0 255 ECU_ADDRESS 0xFFF90541 FORMAT "%5.1" /end MEASUREMENT
/begin MEASUREMENT ECE_IWD_reg.stOkMsk "F2392: IWD register structure / " UBYTE X1_S1 1 100 0 255 ECU_ADDRESS 0xFFF90540 FORMAT "%5.1" /end MEASUREMENT
/begin MEASUREMENT ECE_IWD_reg.tiSpiTransfer "F2392: IWD register structure / " ULONG X1_S1 1 100 0 4294967295 ECU_ADDRESS 0xFFF90544 FORMAT "%13.2" /end MEASUREMENT
/begin MEASUREMENT ECE_IWD_tiAct "F2392: actual IWD timing set upon timeout counter activation (for monitoring purpose)" UWORD TI1_U_S1 1 100 0 65535 ECU_ADDRESS 0xFFF90864 FORMAT "%8.2" /end MEASUREMENT
/begin MEASUREMENT ECE_IWD_tiDly "F2392: memorized delay of last IWD ISR activation (ideally close to 0) (for monitoring purpose)" UWORD TI1_U_S1 1 100 0 65535 ECU_ADDRESS 0xFFF90862 FORMAT "%8.2" /end MEASUREMENT
/begin MEASUREMENT ECE_LSS_numDuty "F2369: number of ADC measurements in duty-phase per period" UBYTE X1_S1 1 100 0 255 ECU_ADDRESS 0xFFF9093F FORMAT "%5.1" MATRIX_DIM 5 1 1 /end MEASUREMENT
/begin MEASUREMENT ECE_LSS_numNoDuty "F2369: number of ADC measurements in noduty-phase per period" UBYTE X1_S1 1 100 0 255 ECU_ADDRESS 0xFFF9093A FORMAT "%5.1" MATRIX_DIM 5 1 1 /end MEASUREMENT
/begin MEASUREMENT ECE_LSS_rAct "F2369: Actual duty of Lss output channel for diagnosis purpose" UWORD R0_1_P_S1 1 100 0 100 ECU_ADDRESS 0xFFF90874 FORMAT "%8.4" MATRIX_DIM 5 1 1 /end MEASUREMENT
/begin MEASUREMENT ECE_LSS_rCmd "F2369: Commanded duty of Lss output channel" UWORD R0_1_P_S1 1 100 0 100 ECU_ADDRESS 0xFFF9086A FORMAT "%8.4" MATRIX_DIM 5 1 1 /end MEASUREMENT
/begin MEASUREMENT ECE_LSS_rCmdAct "F2369: accepted duty command of Lss output channel" UWORD R0_1_P_S1 1 100 0 100 ECU_ADDRESS 0xFFF9087E FORMAT "%8.4" MATRIX_DIM 5 1 1 /end MEASUREMENT
/begin CHARACTERISTIC ECE_LSS_rMax_C "F2369: Maximum Duty for which the analog diagnosis is reliable (value shall be set to 100%-100%*50us/tiPer) (no SERAP)" VAL_BLK 0x191492 AblGLKWBuw_S1 100 R0_1_P_S1 0 100 MATRIX_DIM 5 1 1 FORMAT "%8.4" /end CHARACTERISTIC
/begin CHARACTERISTIC ECE_LSS_rMin_C "F2369: Minimum Duty for which the analog diagnosis is reliable (value shall be set to 100%*50us/tiPer) (no SERAP)" VAL_BLK 0x19149C AblGLKWBuw_S1 100 R0_1_P_S1 0 100 MATRIX_DIM 5 1 1 FORMAT "%8.4" /end CHARACTERISTIC
/begin CHARACTERISTIC ECE_LSS_stAvail_C "F2369: bit-array to select which output channel is activated (no SERAP)" VALUE 0x1918BB AblGLKWub_S1 255 X1_S1 0 255 FORMAT "%5.1" /end CHARACTERISTIC
/begin CHARACTERISTIC ECE_LSS_stProt_C "F2369: bit-array to select that a channel is used as protocol channel (has to be prepared in project) (in that case ECE_LSS_rCmd is ignored) (no SERAP)" VALUE 0x1918BC AblGLKWub_S1 255 X1_S1 0 255 FORMAT "%5.1" /end CHARACTERISTIC
/begin MEASUREMENT ECE_LSS_stStatHw "F2369: Status of Lss-Feedback signal: 0=off, 1=on, 2=not available" UBYTE X1_S1 1 100 0 5 ECU_ADDRESS 0xFFF90935 FORMAT "%5.3" MATRIX_DIM 5 1 1 /end MEASUREMENT
/begin MEASUREMENT ECE_LSS_tiPerAct "F2369: Actual signal output period" UWORD TI0_0005_M_S1 1 100 0 32.7675 ECU_ADDRESS 0xFFF90892 FORMAT "%8.5" MATRIX_DIM 5 1 1 /end MEASUREMENT
/begin MEASUREMENT ECE_LSS_tiPerCmd "F2369: Commanded signal output period" UWORD TI0_0005_M_S1 1 100 0 32.7675 ECU_ADDRESS 0xFFF90888 FORMAT "%8.5" MATRIX_DIM 5 1 1 /end MEASUREMENT
/begin CHARACTERISTIC ECE_LSS_tiPerCmdInit_C "F2369: initialization value of the commanded output period (this value is only valid if activated per channel) (default=1.0) (no SERAP)" VAL_BLK 0x1914A6 AblGLKWBuw_S1 31.9 TI0_0005_M_S1 0.1 32 MATRIX_DIM 5 1 1 FORMAT "%8.5" /end CHARACTERISTIC
/begin MEASUREMENT ECE_LSS_uDuty "F2369: Lss monitoring voltage in duty phase (special case: 0=no measurement available)" UWORD U0_001_S1 1 100 0 25 ECU_ADDRESS 0xFFF908A6 FORMAT "%8.5" MATRIX_DIM 5 1 1 /end MEASUREMENT
/begin MEASUREMENT ECE_LSS_uNoDuty "F2369: Lss monitoring voltage in non-duty phase (special case: 0=no measurement available)" UWORD U0_001_S1 1 100 0 25 ECU_ADDRESS 0xFFF9089C FORMAT "%8.5" MATRIX_DIM 5 1 1 /end MEASUREMENT
/begin CHARACTERISTIC ECE_PSPLY_idxSpi_C "F2397: Assignment of a CG130-HSDx channel to PSply channel defined by this label (idx=0:CG130-HSD1,idx=1:HSD2, idx=2:HSD3) (no SERAP)" VAL_BLK 0x1918BD AblGLKWBub_S1 2 X1_S1 0 2 MATRIX_DIM 3 1 1 FORMAT "%5.3" /end CHARACTERISTIC
/begin CHARACTERISTIC ECE_PSPLY_stHssForceOn_C "F2397: Force the specified bitcoded Hss channel output to on permanently (B0:HSD1,B1:HSD2,B2:HSD3,B3:HSD4,B4:HSD5,B5:HSD6) (no SERAP)" VALUE 0x1918C0 AblGLKWub_S1 255 X1_S1 0 255 FORMAT "%5.1" /end CHARACTERISTIC
/begin CHARACTERISTIC ECE_PSPLY_stHssSafOff_C "F2397: Selection which Hss channel output is switched off (B0:HSD1,B1:HSD2,B2:HSD3,B3:HSD4,B4:HSD5,B5:HSD6) (no SERAP)" VALUE 0x1918C1 AblGLKWub_S1 255 X1_S1 0 255 FORMAT "%5.1" /end CHARACTERISTIC
/begin CHARACTERISTIC ECE_PWD_tiDscr_C "F2359: Pulse-width demodulation descriptor (0:timeout [0.25us], 1:timeout-weak [0.25us], 2:(num-period<<16 + pol<<8) duty-low=65536 or duty-high=65792) (no SERAP)" MAP 0x190408 AblGLFKFul_S1 4294970000 X1_S1 0 4294967295
 /begin AXIS_DESCR FIX_AXIS ECE_idxDmy X1_S1 3 0 2 READ_ONLY FORMAT "%5.3" FIX_AXIS_PAR_DIST 0 1 3 /end AXIS_DESCR
 /begin AXIS_DESCR FIX_AXIS ECE_idxDmy X1_S1 6 0 5 READ_ONLY FORMAT "%5.3" FIX_AXIS_PAR_DIST 0 1 6 /end AXIS_DESCR
 FORMAT "%13.2" /end CHARACTERISTIC
/begin CHARACTERISTIC ECE_PWM_stPolOut_C "F2371: Polarity of the output signal: 0=low-active, 1=high-active (CPU output polarity) (no SERAP)" VAL_BLK 0x1918C2 AblGLKWBub_S1 255 X1_S1 0 255 MATRIX_DIM 1 1 1 FORMAT "%5.1" /end CHARACTERISTIC
/begin MEASUREMENT ECE_PWM_tiDutyCmd "F2371: Commanded output period (must be <=ECE_PWM_tiPerCmd)" UWORD TI0_0005_M_S1 1 100 0 32.7675 ECU_ADDRESS 0xFFF908C8 FORMAT "%8.5" /end MEASUREMENT
/begin MEASUREMENT ECE_PWM_tiPerCmd "F2371: Commanded output period (must be >=ECE_PWM_tiDtyCmd)" UWORD TI0_0005_M_S1 1 100 0 32.7675 ECU_ADDRESS 0xFFF908C6 FORMAT "%8.5" /end MEASUREMENT
/begin CHARACTERISTIC ECE_PWM_tiPerInit_C "F2371: PWM output period initialization value (no SERAP)" VAL_BLK 0x1914B0 AblGLKWBuw_S1 32.7675 TI0_0005_M_S1 0 32.7675 MATRIX_DIM 1 1 1 FORMAT "%8.5" /end CHARACTERISTIC
/begin MEASUREMENT ECE_SPI_bCg124_stSpiOk "F2385: Common Cg124 Spi state. TRUE: All Spi sequences to cg124 transmitted without an error " UBYTE B_TRUE_S1 1 100 0 1 ECU_ADDRESS 0xFFF9094F FORMAT "%13.11" /end MEASUREMENT
/begin MEASUREMENT ECE_SPI_bCg130_stSpiOk "F2385: Common Cg130 Spi state. TRUE: All Spi sequences to cg124 transmitted without an error " UBYTE B_TRUE_S1 1 100 0 1 ECU_ADDRESS 0xFFF90950 FORMAT "%13.11" /end MEASUREMENT
/begin MEASUREMENT ECE_SPI_regHsdPort "F2385: HSD control via CPU-Ports (B0-B4:undef, B5:HSD1, B6:HSD2, B7:HSD3)" UBYTE X1_S1 1 100 0 255 ECU_ADDRESS 0xFFF90965 FORMAT "%5.1" /end MEASUREMENT
/begin MEASUREMENT ECE_SPI_stSpiCore "F2385: Common Core Spi status 0=no status avail., 0x11= Core Spi error, 0x2d Core Spi status ok" UBYTE X1_S1 1 100 0 255 ECU_ADDRESS 0xFFF9094E FORMAT "%5.1" /end MEASUREMENT
/begin MEASUREMENT ECE_Stlk_bSpiOff "F2385: Prevent the starter output independent of current ECE_stLines configuration" UBYTE B_TRUE_S1 1 100 0 1 ECU_ADDRESS 0xFFF9095A FORMAT "%13.11" /end MEASUREMENT
/begin MEASUREMENT ECE_WDT_bHsdOff "F2391: Current high-side deactivation via CPU (only safety-relevant Hsds) (0:Hsd pos.,1:Hsd-Off)" UBYTE B_TRUE_S1 1 100 0 1 ECU_ADDRESS 0xFFF90969 FORMAT "%13.11" /end MEASUREMENT
/begin MEASUREMENT ECE_WDT_bWdtMode "F2391: WDT-operation mode (0=reset/overrun, 1=interrupt)" UBYTE B_TRUE_S1 1 100 0 1 ECU_ADDRESS 0xFFF9096A FORMAT "%13.11" /end MEASUREMENT
/begin MEASUREMENT ECE_WDT_tiMrgnMinEe "F2391: Minimum WDT margin, observed within the project (0=no value available; internal timer resultion)" UBYTE X1_S1 1 100 0 255 ECU_ADDRESS 0xFFF943B6 FORMAT "%5.1" /end MEASUREMENT
/begin MEASUREMENT ECE_bAdcStopA "F2355: Indicates if ADC-A DMA transfer is stopped (normal=FALSE)" UBYTE B_TRUE_S1 1 100 0 1 ECU_ADDRESS 0xFFF908F7 FORMAT "%13.11" /end MEASUREMENT
/begin MEASUREMENT ECE_bAdcStopB "F2355: Indicates if ADC-B DMA transfer is stopped (normal=FALSE)" UBYTE B_TRUE_S1 1 100 0 1 ECU_ADDRESS 0xFFF908F8 FORMAT "%13.11" /end MEASUREMENT
/begin MEASUREMENT ECE_bCpuClockActive "F2360: Verification whether the Clock is running with min. frequency (0=no, 1=yes/ok)" UBYTE B_TRUE_S1 1 100 0 1 ECU_ADDRESS 0xFFF90968 FORMAT "%13.11" /end MEASUREMENT
/begin MEASUREMENT ECE_bDN "F2385: DN-line info (1=ok, 0=error)" UBYTE B_TRUE_S1 1 100 0 1 ECU_ADDRESS 0xFFF90959 FORMAT "%13.11" /end MEASUREMENT
/begin MEASUREMENT ECE_bOvrTmpRstrt "F2385: activation of overtemperature restart function - only relevant if BIT3 in ECE_Cg130_regInit2 is set" UBYTE B_TRUE_S1 1 100 0 1 ECU_ADDRESS 0xFFF90952 FORMAT "%13.11" /end MEASUREMENT
/begin MEASUREMENT ECE_bPSplyOvrCurr "F2397: Actuator supply overcurrent info" UBYTE B_TRUE_S1 1 100 0 1 ECU_ADDRESS 0xFFF90947 FORMAT "%13.11" MATRIX_DIM 3 1 1 /end MEASUREMENT
/begin MEASUREMENT ECE_bPSplyReq "F2397: Actuator supply output request (0=off,99=63h=on)" UBYTE X1_S1 1 100 0 255 ECU_ADDRESS 0xFFF90944 FORMAT "%5.1" MATRIX_DIM 3 1 1 /end MEASUREMENT
/begin MEASUREMENT ECE_bPclk "F2360: PCLK activation status (0=off, 1=on)" UBYTE B_TRUE_S1 1 100 0 1 ECU_ADDRESS 0xFFF90967 FORMAT "%13.11" /end MEASUREMENT
/begin MEASUREMENT ECE_bSSplyReq "F2396: Sensor supply output request (FALSE=off,TRUE=on)" UBYTE B_TRUE_S1 1 100 0 1 ECU_ADDRESS 0xFFF9094D FORMAT "%13.11" /end MEASUREMENT
/begin MEASUREMENT ECE_bWak1 "F2385: Wak1 pin information (FALSE=off, TRUE=on) Cg124" UBYTE B_TRUE_S1 1 100 0 1 ECU_ADDRESS 0xFFF84C30 FORMAT "%13.11" /end MEASUREMENT
/begin MEASUREMENT ECE_bWak2 "F2385: Wak2 pin information (FALSE=off, TRUE=on) Cg124" UBYTE B_TRUE_S1 1 100 0 1 ECU_ADDRESS 0xFFF84C31 FORMAT "%13.11" /end MEASUREMENT
/begin MEASUREMENT ECE_bWakIntern "F2385: Cg130 Wak-Info information (FALSE=off, TRUE=on)" UBYTE B_TRUE_S1 1 100 0 1 ECU_ADDRESS 0xFFF84C32 FORMAT "%13.11" /end MEASUREMENT
/begin MEASUREMENT ECE_bWdRst "F2385: IWD availability to issue an ECU-reset (FALSE/TRUE)" UBYTE B_TRUE_S1 1 100 0 1 ECU_ADDRESS 0xFFF90954 FORMAT "%13.11" /end MEASUREMENT
/begin MEASUREMENT ECE_bWdRstFirst "F2385: IWD might have caused an ECU-reset in the previous software cycle (this information is latched once after system startup)" UBYTE B_TRUE_S1 1 100 0 1 ECU_ADDRESS 0xFFF90955 FORMAT "%13.11" /end MEASUREMENT
/begin MEASUREMENT ECE_bWdRstReq "F2385: IWD might cause an ECU-reset (FALSE=no/TRUE=yes)" UBYTE B_TRUE_S1 1 100 0 1 ECU_ADDRESS 0xFFF90953 FORMAT "%13.11" /end MEASUREMENT
/begin MEASUREMENT ECE_bWdRstReqCmpl "F2385: complement of ECE_bWdRstReq, IWD-reset activation (FALSE=yes/TRUE=no)" UBYTE B_TRUE_S1 1 100 0 1 ECU_ADDRESS 0xFFF9094A FORMAT "%13.11" /end MEASUREMENT
/begin MEASUREMENT ECE_ctAdcDmaOvrFlw "F2355: Counter for ADC-DMA result overflow" UWORD X1_S1 1 100 0 65535 ECU_ADDRESS 0xFFF907FE FORMAT "%8.2" /end MEASUREMENT
/begin CHARACTERISTIC ECE_facAdcA_C "F2355: Multiplication Factor to determine the measureable voltage (channel specific) (default: 1.00) (no SERAP)" VAL_BLK 0x190180 AblGLKWBr32_S1 10 X1_S1 0 10 MATRIX_DIM 28 1 1 FORMAT "%10.7" /end CHARACTERISTIC
/begin CHARACTERISTIC ECE_facAdcAmux_C "F2355: Multiplication Factor to determine the measureable voltage (channel specific) (default: 5.00) (no SERAP)" VAL_BLK 0x190170 AblGLKWBr32_S1 10 X1_S1 0 10 MATRIX_DIM 4 1 1 FORMAT "%10.7" /end CHARACTERISTIC
/begin CHARACTERISTIC ECE_facAdcB_C "F2355: Multiplication Factor to determine the measureable voltage (channel specific) (default: 1.00) (no SERAP)" VAL_BLK 0x1901F0 AblGLKWBr32_S1 10 X1_S1 0 10 MATRIX_DIM 7 1 1 FORMAT "%10.7" /end CHARACTERISTIC
/begin CHARACTERISTIC ECE_numAdcFir_C "F2361: Filter constant for voltage detection (multiples of 1ms) (no SERAP)" VALUE 0x191885 AblGLKWub_S1 9 X1_S1 1 10 FORMAT "%5.2" /end CHARACTERISTIC
/begin CHARACTERISTIC ECE_numAdcNoiFir_C "F2361: Filter constant for voltage noise detection (multiples of 1ms) (no SERAP)" VALUE 0x191886 AblGLKWub_S1 9 X1_S1 1 10 FORMAT "%5.2" /end CHARACTERISTIC
/begin MEASUREMENT ECE_qtiPwd "F2359: quality info of PWD-measurement (per channel) : 0 (init), 4 (fix)=Timeout, 8 (ok)" UBYTE Q_SIG_S1 1 100 0 8 ECU_ADDRESS 0xFFF908C0 FORMAT "%13.11" MATRIX_DIM 6 1 1 /end MEASUREMENT
/begin MEASUREMENT ECE_regAdcDiagDiffA "F2355: Difference to current diagnosis value ADC-A (idx=0:ZERO,idx=1:HALF,idx=2:FULL)" SWORD X1_S1 1 100 -1000 1000 ECU_ADDRESS 0xFFF90800 FORMAT "%8.3" MATRIX_DIM 3 1 1 /end MEASUREMENT
/begin MEASUREMENT ECE_regAdcDiagDiffB "F2355: Difference to current diagnosis value ADC-B (idx=0:ZERO,idx=1:HALF,idx=2:FULL)" SWORD X1_S1 1 100 -1000 1000 ECU_ADDRESS 0xFFF90806 FORMAT "%8.3" MATRIX_DIM 3 1 1 /end MEASUREMENT
/begin MEASUREMENT ECE_regSysChpTemp "F2385: system-temperature raw value (0xFFFF=error) (linearisation required)" UWORD X1_S1 1 100 0 65535 ECU_ADDRESS 0xFFF908CA FORMAT "%8.2" /end MEASUREMENT
/begin MEASUREMENT ECE_sCanStartup "F2357: Startup state determined by the CAN transceiver (0:undef, 1:power-on-start, 2:local wakeup, 3:CAN-wakeup)" UBYTE X1_S1 1 100 0 3 ECU_ADDRESS 0xFFF800EF FORMAT "%5.3" /end MEASUREMENT
/begin MEASUREMENT ECE_sModeCfgReq "F2385: ECU mode request (Line=0x00,Off=0x06,On=0x19,Edge=0x31,OnSdn=0x5B,EdgSdn=0x73)" UBYTE X1_S1 1 100 0 255 ECU_ADDRESS 0xFFF90951 FORMAT "%5.1" /end MEASUREMENT
/begin MEASUREMENT ECE_sSpiRead "F2385: Spi transfer status (0:not yet started, 1:started-not yet ready, 15:ready)" UBYTE X1_S1 1 100 0 15 ECU_ADDRESS 0xFFF9095B FORMAT "%5.2" /end MEASUREMENT
/begin MEASUREMENT ECE_stCg130Version "F2385: HW version number of the CG130 (0=BA HW step or newer,1=AX HW step)" UBYTE X1_S1 1 100 0 255 ECU_ADDRESS 0xFFF90966 FORMAT "%5.1" MATRIX_DIM 3 1 1 /end MEASUREMENT
/begin MEASUREMENT ECE_stLines "F2385: Cg124 bit-coded line-information" UBYTE X1_S1 1 100 0 255 ECU_ADDRESS 0xFFF90958 FORMAT "%5.1" /end MEASUREMENT
/begin MEASUREMENT ECE_stOTA "F2396: OTA output request (FALSE=off,TRUE=on)" UBYTE X1_S1 1 100 0 255 ECU_ADDRESS 0xFFF90957 FORMAT "%5.1" /end MEASUREMENT
/begin MEASUREMENT ECE_stPclk "F2385: Pclk status information BIT0: too high, BIT1: too low" UBYTE X1_S1 1 100 0 255 ECU_ADDRESS 0xFFF90956 FORMAT "%5.1" /end MEASUREMENT
/begin MEASUREMENT ECE_stSysChpTemp "F2385: system-temperature status: 0=not updated, 1=ok, 2=error" UBYTE X1_S1 1 100 0 255 ECU_ADDRESS 0xFFF9095D FORMAT "%5.1" /end MEASUREMENT
/begin MEASUREMENT ECE_stSysChpTempOT "F2385: overtemperature status of internal sensor (0:no OT, 1:low-threshold exceeded, 3:high-threshold exceeded)" UBYTE X1_S1 1 100 0 255 ECU_ADDRESS 0xFFF9095E FORMAT "%5.1" /end MEASUREMENT
/begin MEASUREMENT ECE_tChpExt "F2385: external chip-temp-sensor raw-value in 1/128°C" SWORD T0_0078125_S1 1 100 -256 255.9922 ECU_ADDRESS 0xFFF908CC FORMAT "%8.4" /end MEASUREMENT
/begin MEASUREMENT ECE_tiAdcA.ctDiff "F2355: Time measurement of interrupt activation (tiDiff=time-diff or 20 activations) / " UWORD X1_S1 1 100 0 65535 ECU_ADDRESS 0xFFF90C54 FORMAT "%8.2" /end MEASUREMENT
/begin MEASUREMENT ECE_tiAdcA.tiDiff "F2355: Time measurement of interrupt activation (tiDiff=time-diff or 20 activations) / " ULONG TI1_U_S1 1 100 0 4294967295 ECU_ADDRESS 0xFFF90C4C FORMAT "%13.2" /end MEASUREMENT
/begin MEASUREMENT ECE_tiAdcA.tiStamp "F2355: Time measurement of interrupt activation (tiDiff=time-diff or 20 activations) / " ULONG TI1_U_S1 1 100 0 4294967295 ECU_ADDRESS 0xFFF90C50 FORMAT "%13.2" /end MEASUREMENT
/begin MEASUREMENT ECE_tiPwdDuty "F2359: Measured duty in 0.25us res. (per channel)" ULONG TI0_00025_M_S1 1 100 0 1073741.82375 ECU_ADDRESS 0xFFF905C0 FORMAT "%13.5" MATRIX_DIM 6 1 1 /end MEASUREMENT
/begin MEASUREMENT ECE_tiPwdPer "F2359: Measured period in 0.25us res. (per channel)" ULONG TI0_00025_M_S1 1 100 0 1073741.82375 ECU_ADDRESS 0xFFF905A8 FORMAT "%13.5" MATRIX_DIM 6 1 1 /end MEASUREMENT
/begin MEASUREMENT ECE_uAdcA "F2355: Detected pin voltage (ADC-A channels)" UWORD U0_001_S1 1 100 0 25 ECU_ADDRESS 0xFFF9018C FORMAT "%8.5" MATRIX_DIM 28 1 1 /end MEASUREMENT
/begin MEASUREMENT ECE_uAdcAmux "F2355: Detected pin voltage (ADC-Amux MA,MB,MC,MD channels)" UWORD U0_001_S1 1 100 0 25 ECU_ADDRESS 0xFFF901D4 FORMAT "%8.5" MATRIX_DIM 4 1 1 /end MEASUREMENT
/begin MEASUREMENT ECE_uAdcB "F2355: Detected pin voltage (ADC-B channels)" UWORD U0_001_S1 1 100 0 25 ECU_ADDRESS 0xFFF901C4 FORMAT "%8.5" MATRIX_DIM 7 1 1 /end MEASUREMENT
/begin CHARACTERISTIC ECE_uAdcNoiDecrLim_C "F2361: Noise decrease limit (voltage difference per main-task) (no SERAP)" VALUE 0x191468 AblGLKWuw_S1 9.99 U0_001_S1 0.01 10 FORMAT "%8.5" /end CHARACTERISTIC
/begin CHARACTERISTIC ECE_uAdcNoiJumpLim_C "F2361: Voltage jump evaluation limitation (no SERAP)" VALUE 0x19146A AblGLKWuw_S1 5 U0_001_S1 0 5 FORMAT "%8.6" /end CHARACTERISTIC
/begin MEASUREMENT ECE_uBatt "F2355: Battery voltage (filter:ECE_numAdcFir)" UWORD U0_001_S1 1 100 0 25 ECU_ADDRESS 0xFFF907E2 FORMAT "%8.5" /end MEASUREMENT
/begin MEASUREMENT ECE_uBattMin "F2355: min. battery voltage (detected over main-task period)" UWORD U0_001_S1 1 100 0 25 ECU_ADDRESS 0xFFF907FC FORMAT "%8.5" /end MEASUREMENT
/begin MEASUREMENT ECE_uBattNoi "F2355: Noise level based on uBattSwt (filter ECE_numAdcNoiFir) (derived from uBattNoiInt+gradient limitation)" UWORD U0_001_S1 1 100 0 10 ECU_ADDRESS 0xFFF907F6 FORMAT "%8.5" /end MEASUREMENT
/begin MEASUREMENT ECE_uBattNoiInt "F2355: Noise level based on uBattSwt (filter ECE_numAdcNoiFir)" UWORD U0_001_S1 1 100 0 10 ECU_ADDRESS 0xFFF907F8 FORMAT "%8.5" /end MEASUREMENT
/begin MEASUREMENT ECE_uBattSwt "F2355: switched Battery voltage (filter:ECE_numAdcFir)" UWORD U0_001_S1 1 100 0 35 ECU_ADDRESS 0xFFF907E4 FORMAT "%8.5" /end MEASUREMENT
/begin MEASUREMENT ECE_uM2 "F2355: Pre-regulator voltage (2nd stage)" UWORD U0_001_S1 1 100 0 25 ECU_ADDRESS 0xFFF907EA FORMAT "%8.5" /end MEASUREMENT
/begin MEASUREMENT ECE_uM3 "F2355: Pre-regulator voltage (3rd stage)" UWORD U0_001_S1 1 100 0 25 ECU_ADDRESS 0xFFF907EC FORMAT "%8.5" /end MEASUREMENT
/begin MEASUREMENT ECE_uPSply "F2355: Power supply voltage (filter:ECE_numAdcFir for the first three PSply's)" UWORD U0_001_S1 1 100 0 25 ECU_ADDRESS 0xFFF90188 FORMAT "%8.5" MATRIX_DIM 2 1 1 /end MEASUREMENT
/begin MEASUREMENT ECE_uSSply "F2355: Sensor supply voltage" UWORD U0_001_S1 1 100 0 25 ECU_ADDRESS 0xFFF907E8 FORMAT "%8.5" /end MEASUREMENT
/begin MEASUREMENT ECE_uVASIC "F2355: VASIC monitoring voltage" UWORD U0_001_S1 1 100 0 10 ECU_ADDRESS 0xFFF907F4 FORMAT "%8.5" /end MEASUREMENT
/begin MEASUREMENT ECE_uVDD3 "F2355: VDD3 monitoring voltage" UWORD U0_001_S1 1 100 0 10 ECU_ADDRESS 0xFFF907F2 FORMAT "%8.5" /end MEASUREMENT
/begin MEASUREMENT ECE_uWAK1 "F2355: Wake-Up Signal (WAK1) line voltage" UWORD U0_001_S1 1 100 0 25 ECU_ADDRESS 0xFFF907EE FORMAT "%8.5" /end MEASUREMENT
/begin MEASUREMENT ECE_uWAK2 "F2355: Wake-Up Signal (WAK2) line voltage" UWORD U0_001_S1 1 100 0 25 ECU_ADDRESS 0xFFF907F0 FORMAT "%8.5" /end MEASUREMENT
/begin MEASUREMENT InpPAtfL2_efAtfVarEEP "F2440: Error flag for not supported ATF sensor variant" UBYTE B_TRUE_S1 1 100 0 1 ECU_ADDRESS 0xFFF93B6F FORMAT "%13.11" /end MEASUREMENT
/begin MEASUREMENT InpPAtfL2_facAtf "F2440: Voltage factor for resistance deviation recognition of the sensor" UWORD R0_001_S1 1 100 0 20 ECU_ADDRESS 0xFFF935DA FORMAT "%8.5" /end MEASUREMENT
/begin CHARACTERISTIC InpPAtfL2_facAtfMax_C "F2440: Maximum threshold for voltage factor facAtf" VAL_BLK 0x1912CC AblGLKWBuw_S1 40 R0_001_S1 0 40 MATRIX_DIM 2 1 1 FORMAT "%8.5" /end CHARACTERISTIC
/begin CHARACTERISTIC InpPAtfL2_facAtfMin_C "F2440: Minimum threshold for voltage factor facAtf" VAL_BLK 0x1912D0 AblGLKWBuw_S1 20 R0_001_S1 0 20 MATRIX_DIM 2 1 1 FORMAT "%8.5" /end CHARACTERISTIC
/begin MEASUREMENT InpPAtfL2_idxAtfVar "F2440: ATF sensor variant from reference table (limited)" UBYTE X1_S1 1 100 0 5 ECU_ADDRESS 0xFFF93B70 FORMAT "%5.3" /end MEASUREMENT
/begin CHARACTERISTIC InpPAtfL2_idxAtfVarCnv_C "F2440: Reference table for limited ATF sensor variant read from EEProm (Col 1: EEP value; Col 2: assigned sensor variant)" MAP 0x1916BC AblGLFKFub_S1 255 X1_S1 0 255
 /begin AXIS_DESCR FIX_AXIS InpPAtfL2_yDmy X1_S1 2 0 1 READ_ONLY FORMAT "%5.3" FIX_AXIS_PAR_DIST 0 1 2 /end AXIS_DESCR
 /begin AXIS_DESCR FIX_AXIS InpPAtfL2_yDmy X1_S1 5 0 4 READ_ONLY FORMAT "%5.3" FIX_AXIS_PAR_DIST 0 1 5 /end AXIS_DESCR
 FORMAT "%5.1" /end CHARACTERISTIC
/begin CHARACTERISTIC InpPAtfL2_idxAtfVarDfl_C "F2440: Default Sensorvariant used if not found in InpPAtfL2_idxAtfVarCnv_C" VALUE 0x1919E0 AblGLKWub_S1 1 X1_S1 0 1 FORMAT "%5.3" /end CHARACTERISTIC
/begin MEASUREMENT InpPAtfL2_idxAtfVarEEP "F2440: Index of ATF sensor variant read from EEprom" UBYTE X1_S1 1 100 0 5 ECU_ADDRESS 0xFFF93B71 FORMAT "%5.3" /end MEASUREMENT
/begin MEASUREMENT InpPAtfL2_idxAtfVarTab "F2440: Index of ATF sensor variant read from reference table" UBYTE X1_S1 1 100 0 1 ECU_ADDRESS 0xFFF93B72 FORMAT "%5.3" /end MEASUREMENT
/begin MEASUREMENT InpPAtfL2_qtAtf "F2440: Quality signal of the ATF temperature 1" UBYTE Q_SIG_S1 1 100 0 8 ECU_ADDRESS 0xFFF93B73 FORMAT "%13.11" /end MEASUREMENT
/begin MEASUREMENT InpPAtfL2_stAtf "F2440: Internal status bits: 15-12:no use, 11: init passed; 10:data variant; 9:timeout; 8:hi grad; 7:el.ok; 6:res.factor; 5:usens hi; 4:usens lo; 3:hi pin hi; 2:hi pin lo; 1:lo pin hi; 0:lo pin lo" UWORD X1_S1 1 100 0 2048 ECU_ADDRESS 0xFFF935DC FORMAT "%8.3" /end MEASUREMENT
/begin CHARACTERISTIC InpPAtfL2_swtAtfVarErr_C "F2440: Selection of sensor variant fault situation: 0=no fault; 1=fault if EEP value not supported;" VALUE 0x1919E1 AblGLKWub_S1 2 X1_S1 0 2 FORMAT "%5.3" /end CHARACTERISTIC
/begin MEASUREMENT InpPAtfL2_tAtf "F2440: ATF temperature 1" SWORD T0_0625_S1 1 100 -40 215 ECU_ADDRESS 0xFFF935DE FORMAT "%8.4" /end MEASUREMENT
/begin CHARACTERISTIC InpPAtfL2_tAtfCnvAbs_C[0] "F2440: Characteristic line for convertion sensor voltage to temperature (only sensor Hi line used)" CURVE 0x1912D4 AblGLKLuw_S1 255 T0_0625_OFFS_0x8000_S1 -40 215
 /begin AXIS_DESCR STD_AXIS InpPAtfL2_uAtfHi U0_001_S1 16 0 5 DEPOSIT ABSOLUTE FORMAT "%8.6" /end AXIS_DESCR
 FORMAT "%8.4" /end CHARACTERISTIC
/begin CHARACTERISTIC InpPAtfL2_tAtfCnvAbs_C[1] "F2440: Characteristic line for convertion sensor voltage to temperature (only sensor Hi line used)" CURVE 0x191316 AblGLKLuw_S1 255 T0_0625_OFFS_0x8000_S1 -40 215
 /begin AXIS_DESCR STD_AXIS InpPAtfL2_uAtfHi U0_001_S1 16 0 5 DEPOSIT ABSOLUTE FORMAT "%8.6" /end AXIS_DESCR
 FORMAT "%8.4" /end CHARACTERISTIC
/begin CHARACTERISTIC InpPAtfL2_tAtfRepl_C "F2440: Replacement for tAtf during electrical error and timeout" VALUE 0x1916C6 AblGLKWsw_S1 255 T0_0625_S1 -40 215 FORMAT "%8.4" /end CHARACTERISTIC
/begin MEASUREMENT InpPAtfL2_tiAtfErr "F2440: Timer for fix replacement of tAtf during error situation" UWORD TI1_M_CYCLE_S1 1 100 0 10000 ECU_ADDRESS 0xFFF9418E FORMAT "%8.2" /end MEASUREMENT
/begin CHARACTERISTIC InpPAtfL2_tiAtfErr_C "F2440: Error timeout timer reload value for fix replacement of tAtf" VALUE 0x1916C8 AblGLKWuw_S1 10000 TI1_M_CYCLE_S1 0 10000 FORMAT "%8.2" /end CHARACTERISTIC
/begin MEASUREMENT InpPAtfL2_tiAtfIniDel "F2440: Delay timer after initialization for fault prevention caused by unvalid signals" UBYTE TI1_M_CYCLE_S1 1 100 0 50 ECU_ADDRESS 0xFFF94245 FORMAT "%5.2" /end MEASUREMENT
/begin CHARACTERISTIC InpPAtfL2_tiAtfIniDel_C "F2440: Delay time after initialization for fault prevention caused by unvalid signals" VALUE 0x1919E2 AblGLKWub_S1 50 TI1_M_CYCLE_S1 0 50 FORMAT "%5.2" /end CHARACTERISTIC
/begin MEASUREMENT InpPAtfL2_uAtfGrad "F2440: Voltage differenz against old value of ATF sensor" SWORD U0_001_S1 1 100 -0.5 0.5 ECU_ADDRESS 0xFFF935E0 FORMAT "%9.7" /end MEASUREMENT
/begin CHARACTERISTIC InpPAtfL2_uAtfGradMax_C "F2440: Maximum voltage differenz against old value (absolute) of ATF sensor" VAL_BLK 0x191358 AblGLKWBuw_S1 0.5 U0_001_S1 0 0.5 MATRIX_DIM 2 1 1 FORMAT "%9.7" /end CHARACTERISTIC
/begin MEASUREMENT InpPAtfL2_uAtfHi "F2440: Voltage on the high line of the ATF sensor" UWORD U0_001_S1 1 100 0 5 ECU_ADDRESS 0xFFF935E2 FORMAT "%8.6" /end MEASUREMENT
/begin CHARACTERISTIC InpPAtfL2_uAtfHiMax_C "F2440: Maximum voltage on the high line of the ATF sensor" VAL_BLK 0x19135C AblGLKWBuw_S1 5 U0_001_S1 0 5 MATRIX_DIM 2 1 1 FORMAT "%8.6" /end CHARACTERISTIC
/begin CHARACTERISTIC InpPAtfL2_uAtfHiMin_C "F2440: Minimum voltage on the high line of the ATF sensor" VAL_BLK 0x191360 AblGLKWBuw_S1 5 U0_001_S1 0 5 MATRIX_DIM 2 1 1 FORMAT "%8.6" /end CHARACTERISTIC
/begin MEASUREMENT InpPAtfL2_uAtfLo "F2440: Voltage on the low line of the ATF sensor" UWORD U0_001_S1 1 100 0 5 ECU_ADDRESS 0xFFF935E4 FORMAT "%8.6" /end MEASUREMENT
/begin CHARACTERISTIC InpPAtfL2_uAtfLoMax_C "F2440: Maximum Voltage on the low line of the ATF sensor" VAL_BLK 0x191364 AblGLKWBuw_S1 5 U0_001_S1 0 5 MATRIX_DIM 2 1 1 FORMAT "%8.6" /end CHARACTERISTIC
/begin CHARACTERISTIC InpPAtfL2_uAtfLoMin_C "F2440: Minimum voltage on the low line of the ATF sensor" VAL_BLK 0x191368 AblGLKWBuw_S1 5 U0_001_S1 0 5 MATRIX_DIM 2 1 1 FORMAT "%8.6" /end CHARACTERISTIC
/begin MEASUREMENT InpPAtfL2_uAtfSens "F2440: Raw value of voltage difference ATF sensor" SWORD U0_001_S1 1 100 0 5 ECU_ADDRESS 0xFFF935E6 FORMAT "%8.6" /end MEASUREMENT
/begin CHARACTERISTIC InpPAtfL2_uAtfSensMax_C "F2440: Maximum raw value of voltage difference ATF sensor" VAL_BLK 0x19136C AblGLKWBuw_S1 5 U0_001_S1 0 5 MATRIX_DIM 2 1 1 FORMAT "%8.6" /end CHARACTERISTIC
/begin CHARACTERISTIC InpPAtfL2_uAtfSensMin_C "F2440: Minimum raw value of voltage difference ATF sensor" VAL_BLK 0x191370 AblGLKWBuw_S1 5 U0_001_S1 0 5 MATRIX_DIM 2 1 1 FORMAT "%8.6" /end CHARACTERISTIC
/begin MEASUREMENT InpPAtfL2_uAtfSensOld "F2440: Raw value of voltage difference of ATF sensor old value" SWORD U0_001_S1 1 100 0 5 ECU_ADDRESS 0xFFF935E8 FORMAT "%8.6" /end MEASUREMENT
/begin MEASUREMENT InpPAtfL2_yDmy "F2440: Dummy ram for ATF variant conversion table (idxAtfVarCnv_C)" UBYTE X1_S1 1 100 0 255 ECU_ADDRESS 0xFFF93B74 FORMAT "%5.1" /end MEASUREMENT
/begin MEASUREMENT InpPAtfL3_stAtfFault "F2440: Bit word with fault conditions of fault types for DSM" UWORD X1_S1 1 100 0 65535 ECU_ADDRESS 0xFFF93626 FORMAT "%8.2" /end MEASUREMENT
/begin MEASUREMENT InpPAtfL3_stAtfTstCon "F2440: Bit word with test conditions of fault types for DSM" UWORD X1_S1 1 100 0 65535 ECU_ADDRESS 0xFFF93628 FORMAT "%8.2" /end MEASUREMENT
/begin CHARACTERISTIC InpPAtfL3_stSubsPtd_C "F2440: Allowed sources for ATF substitution (bit 0: -, bit 1: ATF2, bit 2: CHP)" VALUE 0x1919E5 AblGLKWub_S1 7 X1_S1 0 7 FORMAT "%5.3" /end CHARACTERISTIC
/begin MEASUREMENT InpPAtfL3_stSubsQualOk "F2440: Status bit word shows the availability of substitution signals: Bit 0: ATF, Bit 1:ATF2, Bit 2: CHP" UBYTE X1_S1 1 100 0 7 ECU_ADDRESS 0xFFF93B88 FORMAT "%5.3" /end MEASUREMENT
/begin MEASUREMENT InpPAtfL3_stSubsUsd "F2440: Current used signal source for ATF (bit 0: ATF, bit 1: ATF2, bit 2: CHP)" UBYTE X1_S1 1 100 0 7 ECU_ADDRESS 0xFFF93B89 FORMAT "%5.3" /end MEASUREMENT
/begin CHARACTERISTIC InpPAtfL3_tSubsAtf2Ofs_C "F2440: Temperature offset for the ATF substitution by ATF2" VALUE 0x19170C AblGLKWsw_S1 100 T0_0625_S1 -50 50 FORMAT "%8.5" /end CHARACTERISTIC
/begin CHARACTERISTIC InpPAtfL3_tSubsChpOfs_C "F2440: Temperature offset for the ATF substitution by CHP" VALUE 0x19170E AblGLKWsw_S1 100 T0_0625_S1 -50 50 FORMAT "%8.5" /end CHARACTERISTIC
/begin MEASUREMENT InpPBatL2_bBattNoiVBS "F2410: Flag for noise voltage higher limit and elongation timer for VBS monitoring not zero." UBYTE B_TRUE_S1 1 100 0 1 ECU_ADDRESS 0xFFF93B75 FORMAT "%13.11" /end MEASUREMENT
/begin MEASUREMENT InpPBatL2_stBatt "F2410: Bit word for fault situations: 7:noise hi timeout, 6: noise hi, 5: vb lo timeout, 4: vb lo, 3: vb hi, 2: -, 1: vbs tol. timeout, 0: vbs tol." UWORD X1_S1 1 100 0 65535 ECU_ADDRESS 0xFFF935EA FORMAT "%8.2" /end MEASUREMENT
/begin MEASUREMENT InpPBatL2_tiBattDiff "F2410: Timer for voltage difference of VB and VBS is over threshold" UWORD TI1_M_CYCLE_S1 1 100 0 327675 ECU_ADDRESS 0xFFF94190 FORMAT "%8.1" /end MEASUREMENT
/begin CHARACTERISTIC InpPBatL2_tiBattDiff_C "F2410: If voltage difference between VB and VBS is higher limit after this time a fault indication bit is set." VALUE 0x1916CA AblGLKWuw_S1 1000 TI1_M_CYCLE_S1 0 1000 FORMAT "%8.3" /end CHARACTERISTIC
/begin MEASUREMENT InpPBatL2_tiBattLoVltg "F2410: Timer is running down if battery voltage is under threshold. On reaching zero a status bit is set." UWORD TI1_M_CYCLE_S1 1 100 0 327675 ECU_ADDRESS 0xFFF94192 FORMAT "%8.1" /end MEASUREMENT
/begin CHARACTERISTIC InpPBatL2_tiBattLoVltg_C "F2410: If battery voltage is under threshold after this time a fault indication bit is set" VALUE 0x1916CC AblGLKWuw_S1 1000 TI1_M_CYCLE_S1 0 1000 FORMAT "%8.3" /end CHARACTERISTIC
/begin MEASUREMENT InpPBatL2_tiBattNoi "F2410: Timer for holding noise recognition flag" UWORD TI1_M_CYCLE_S1 1 100 0 327675 ECU_ADDRESS 0xFFF94194 FORMAT "%8.1" /end MEASUREMENT
/begin MEASUREMENT InpPBatL2_tiBattNoiVBS "F2410: Timer for holding noise recognition flag concerning VBS monitoring prevention" UWORD TI1_M_CYCLE_S1 1 100 0 327675 ECU_ADDRESS 0xFFF94196 FORMAT "%8.1" /end MEASUREMENT
/begin CHARACTERISTIC InpPBatL2_tiBattNoiVBS_C "F2410: Time const for holding the noise indication flag for prevention VBS monitoring" VALUE 0x1916CE AblGLKWuw_S1 1000 TI1_M_CYCLE_S1 0 1000 FORMAT "%8.3" /end CHARACTERISTIC
/begin CHARACTERISTIC InpPBatL2_tiBattNoi_C "F2410: Time const for holding the noise indication flag" VALUE 0x1916D0 AblGLKWuw_S1 1000 TI1_M_CYCLE_S1 0 1000 FORMAT "%8.3" /end CHARACTERISTIC
/begin MEASUREMENT InpPBatL2_uBattDrop "F2410: Deviation of voltage drop at UBS-FET against normal value (UDROP:=ABS(UB-UBS-UDROPC))" UWORD U0_001_S1 1 100 0 2 ECU_ADDRESS 0xFFF935EC FORMAT "%8.6" /end MEASUREMENT
/begin CHARACTERISTIC InpPBatL2_uBattLoLim_C "F2410: Lower threshold of normal battery voltage range" VALUE 0x1916D2 AblGLKWuw_S1 9.5 U0_001_S1 0 9.5 FORMAT "%8.6" /end CHARACTERISTIC
/begin CHARACTERISTIC InpPBatL2_uBattNoiLi_C "F2410: Threshold of maximum allowed noise voltage of the battery" VALUE 0x1916D4 AblGLKWuw_S1 16 U0_001_S1 0 16 FORMAT "%8.5" /end CHARACTERISTIC
/begin MEASUREMENT InpPBatL2_uBattSwt "F2410: Switched battery voltage (VBS)" UWORD U0_001_S1 1 100 0 32.767 ECU_ADDRESS 0xFFF935EE FORMAT "%8.5" /end MEASUREMENT
/begin CHARACTERISTIC InpPBatL2_uBattSwtCal_C "F2410: Average voltage drop between VB and VBS" VALUE 0x1916D6 AblGLKWuw_S1 5 U0_001_S1 0 5 FORMAT "%8.6" /end CHARACTERISTIC
/begin CHARACTERISTIC InpPBatL2_uBattTolc_C "F2410: Allowed absolut tolerance of voltage difference between VB and VBS" VALUE 0x1916D8 AblGLKWuw_S1 16 U0_001_S1 0 16 FORMAT "%8.5" /end CHARACTERISTIC
/begin CHARACTERISTIC InpPBatL2_uBattUpLim_C "F2410: Upper threshold of normal battery voltage range" VALUE 0x1916DA AblGLKWuw_S1 16.767 U0_001_S1 16 32.767 FORMAT "%8.5" /end CHARACTERISTIC
/begin MEASUREMENT InpPBatL3_stBattFault "F2410: Active fault situations bit coded of battery monitoring for DSM" UWORD X1_S1 1 100 0 65535 ECU_ADDRESS 0xFFF9362A FORMAT "%8.2" /end MEASUREMENT
/begin MEASUREMENT InpPBatL3_stBattTstCon "F2410: Active test condition bit coded of battery monitoring for DSM" UWORD X1_S1 1 100 0 65535 ECU_ADDRESS 0xFFF9362C FORMAT "%8.2" /end MEASUREMENT
/begin MEASUREMENT InpPChipL2_bChpHw "F2442: komparator output of CG130 internal chip temperature HW evaluation (Bit0:TEMPL Bit1:TEMPH)" UBYTE X1_S1 1 100 0 255 ECU_ADDRESS 0xFFF93B76 FORMAT "%5.1" /end MEASUREMENT
/begin MEASUREMENT InpPChipL2_idxChpHwVers "F2442: application data index for CG130 Chip temperature" UBYTE X1_S1 1 100 0 255 ECU_ADDRESS 0xFFF93B77 FORMAT "%5.1" /end MEASUREMENT
/begin MEASUREMENT InpPChipL2_qtChp "F2442: Quality signal of the internal chip temperatur (Chp1 = CG130)" UBYTE Q_SIG_S1 1 100 0 8 ECU_ADDRESS 0xFFF93B78 FORMAT "%13.11" /end MEASUREMENT
/begin MEASUREMENT InpPChipL2_rChp "F2442: CG130 chip temperature signal without quantisation (raw value)" UWORD X1_S1 1 100 0 1023 ECU_ADDRESS 0xFFF935F0 FORMAT "%8.3" /end MEASUREMENT
/begin MEASUREMENT InpPChipL2_rChpOld "F2442: Old value rChpNew for change recognition" UWORD X1_S1 1 100 0 1023 ECU_ADDRESS 0xFFF935F2 FORMAT "%8.3" /end MEASUREMENT
/begin MEASUREMENT InpPChipL2_stChp "F2442: status bit field of CG130 chip temperature (format see documentation)" UWORD X1_S1 1 100 0 65535 ECU_ADDRESS 0xFFF935F4 FORMAT "%8.2" /end MEASUREMENT
/begin MEASUREMENT InpPChipL2_stChpOld "F2442: Status bit word of the chip temperature evaluation from last cycle (same bit meaning as stChp)" UWORD X1_S1 1 100 0 65535 ECU_ADDRESS 0xFFF935F6 FORMAT "%8.2" /end MEASUREMENT
/begin MEASUREMENT InpPChipL2_tChp "F2442: Chip temperature (interner Sensor = CG130 = Chp1)" SWORD T0_0625_S1 1 100 -40 215 ECU_ADDRESS 0xFFF935F8 FORMAT "%8.4" /end MEASUREMENT
/begin CHARACTERISTIC InpPChipL2_tChpAdjOfsCal_C "F2442: Application offset for CG130 chip temp. adjustment" VAL_BLK 0x191378 AblGLKWBsw_S1 40 T0_0625_S1 -65 -25 MATRIX_DIM 2 1 1 FORMAT "%8.5" /end CHARACTERISTIC
/begin CHARACTERISTIC InpPChipL2_tChpDigThresHiLoLim_C "F2442: CG130 comparator TEMPH, lower limit" VAL_BLK 0x19137C AblGLKWBsw_S1 240 T0_0625_S1 -50 190 MATRIX_DIM 2 1 1 FORMAT "%8.4" /end CHARACTERISTIC
/begin CHARACTERISTIC InpPChipL2_tChpDigThresHiUpLim_C "F2442: CG130 comparator TEMPH, upper limit" VAL_BLK 0x191380 AblGLKWBsw_S1 240 T0_0625_S1 -50 190 MATRIX_DIM 2 1 1 FORMAT "%8.4" /end CHARACTERISTIC
/begin CHARACTERISTIC InpPChipL2_tChpDigThresLoLoLim_C "F2442: CG130 comparator TEMPL, lower limit" VAL_BLK 0x191384 AblGLKWBsw_S1 240 T0_0625_S1 -50 190 MATRIX_DIM 2 1 1 FORMAT "%8.4" /end CHARACTERISTIC
/begin CHARACTERISTIC InpPChipL2_tChpDigThresLoUpLim_C "F2442: CG130 comparator TEMPL, upper limit" VAL_BLK 0x191388 AblGLKWBsw_S1 240 T0_0625_S1 -50 190 MATRIX_DIM 2 1 1 FORMAT "%8.4" /end CHARACTERISTIC
/begin CHARACTERISTIC InpPChipL2_tChpIni_C "F2442: Init value of CG130 chip temperature" VALUE 0x1916DC AblGLKWsw_S1 250 T0_0625_S1 -50 200 FORMAT "%8.4" /end CHARACTERISTIC
/begin MEASUREMENT InpPChipL2_tiChpFault "F2442: Timeout timer for CG130 chip temperatur signal fault" UWORD TI1_M_CYCLE_S1 1 100 0 327675 ECU_ADDRESS 0xFFF94198 FORMAT "%8.1" /end MEASUREMENT
/begin CHARACTERISTIC InpPChipL2_tiChpFault_C "F2442: Reload value of timeout timer on CG130 chip temperatur signal fault" VALUE 0x1916DE AblGLKWuw_S1 5000 TI1_M_CYCLE_S1 0 5000 FORMAT "%8.3" /end CHARACTERISTIC
/begin MEASUREMENT InpPChipL2_tiChpIniDel "F2442: Delay timer after initialization for fault prevention caused by unvalid signals" UBYTE TI1_M_CYCLE_S1 1 100 0 50 ECU_ADDRESS 0xFFF94246 FORMAT "%5.2" /end MEASUREMENT
/begin CHARACTERISTIC InpPChipL2_tiChpIniDel_C "F2442: Delay time after initialization for fault prevention caused by unvalid signals" VALUE 0x1919E3 AblGLKWub_S1 50 TI1_M_CYCLE_S1 0 50 FORMAT "%5.2" /end CHARACTERISTIC
/begin CHARACTERISTIC InpPChipL2_xChpAdjMulCal_C "F2442: Application factor for CG130 chip temp. adjustment (°C/Bit x 10 000) (no SERAP)" VAL_BLK 0x191374 AblGLKWBuw_S1 500 R0_0625_S1 2000 2500 MATRIX_DIM 2 1 1 FORMAT "%8.3" /end CHARACTERISTIC
/begin CHARACTERISTIC InpPChipL2_xChpRawMax_C "F2442: Maximum allowed raw value of the CG130 chip temperature signal" VALUE 0x1916E0 AblGLKWuw_S1 65534 X1_S1 0 65534 FORMAT "%8.2" /end CHARACTERISTIC
/begin CHARACTERISTIC InpPChipL2_xChpRawMin_C "F2442: Minimum allowed raw value of the CG130 chip temperature signal" VALUE 0x1916E2 AblGLKWuw_S1 65534 X1_S1 1 65535 FORMAT "%8.2" /end CHARACTERISTIC
/begin MEASUREMENT InpPChipL3_stChpFault "F2442: Bit word with active fault status of internal chip temperatur monitoring (Chp1)" UWORD X1_S1 1 100 0 65535 ECU_ADDRESS 0xFFF9362E FORMAT "%8.2" /end MEASUREMENT
/begin MEASUREMENT InpPChipL3_stChpTstCon "F2442: Bit word with active test conditions of internal chip temperature monitoring (Chp1)" UWORD X1_S1 1 100 0 65535 ECU_ADDRESS 0xFFF93630 FORMAT "%8.2" /end MEASUREMENT
/begin CHARACTERISTIC InpPChipL3_stSubsPtd_C "F2442: Allowed sources for CHP substitution: Bit 2: CHP2, Bit 1:CHP1, Bit 0: ATF" VALUE 0x1919E6 AblGLKWub_S1 6 X1_S1 1 7 FORMAT "%5.3" /end CHARACTERISTIC
/begin MEASUREMENT InpPChipL3_stSubsUsd "F2442: Current used signal source for CHP: Bit 2: CHP2, Bit 1:CHP1, Bit 0: ATF" UBYTE X1_S1 1 100 0 7 ECU_ADDRESS 0xFFF93B8A FORMAT "%5.3" /end MEASUREMENT
/begin CHARACTERISTIC InpPChipL3_tSubsAtfOfs_C "F2442: Temperature offset added to ATF as substitution for CHP1" VALUE 0x191710 AblGLKWsw_S1 100 T0_0625_S1 -50 50 FORMAT "%8.5" /end CHARACTERISTIC
/begin CHARACTERISTIC InpPChipL3_tSubsChp2Ofs_C "F2442: Temperature offset added to the CHP2 as substitution for CHP1" VALUE 0x191712 AblGLKWsw_S1 100 T0_0625_S1 -50 50 FORMAT "%8.5" /end CHARACTERISTIC
/begin MEASUREMENT InpPChp2L2_rChp2 "F2443: External chip temperature 2 signal from ECE with 128 LSB/bit" SWORD T0_0078125_S1 1 100 -256 255.9922 ECU_ADDRESS 0xFFF935FA FORMAT "%8.4" /end MEASUREMENT
/begin MEASUREMENT InpPChp2L2_rChp2Old "F2443: Old value rChp2 for change recognition" SWORD T0_0078125_S1 1 100 -255.9922 255.9922 ECU_ADDRESS 0xFFF935FC FORMAT "%8.4" /end MEASUREMENT
/begin MEASUREMENT InpPChp2L2_stChp2 "F2443: Status error bits: 15-13:- 12:flt.timeout, 11:-, 10:timeout, 9:sig.chg., 8:FFFF error, 7:mid rng., 6:sig hi 5:sig lo 4:bit01 not set, 3:init.sig.rec., 2:FFFF sig.rec., 1:init.timeout, 0:init done" UWORD X1_S1 1 100 0 2048 ECU_ADDRESS 0xFFF935FE FORMAT "%8.3" /end MEASUREMENT
/begin MEASUREMENT InpPChp2L2_stChp2Old "F2443: Status bit word of the chip 2 temperature evaluation from last cycle" UWORD X1_S1 1 100 0 2024 ECU_ADDRESS 0xFFF93600 FORMAT "%8.3" /end MEASUREMENT
/begin CHARACTERISTIC InpPChp2L2_stPtt_C "F2443: Bit mask for checking the bit pattern of the received sensor value" VALUE 0x1916E4 AblGLKWuw_S1 65535 X1_S1 0 65535 FORMAT "%8.2" /end CHARACTERISTIC
/begin CHARACTERISTIC InpPChp2L2_tChp2Ini_C "F2443: Init value of chip 2 temperature" VALUE 0x1916E6 AblGLKWsw_S1 255 T0_0625_S1 -40 215 FORMAT "%8.4" /end CHARACTERISTIC
/begin CHARACTERISTIC InpPChp2L2_tChp2MidDwn_C "F2443: Lower threshold of the middle signal range (for 0xffff error recognition)" VALUE 0x1916E8 AblGLKWsw_S1 511.992 T0_0078125_S1 -256 255.9922 FORMAT "%8.4" /end CHARACTERISTIC
/begin CHARACTERISTIC InpPChp2L2_tChp2MidUp_C "F2443:  Upper threshold of the middle signal range (for 0xffff error recognition)" VALUE 0x1916EA AblGLKWsw_S1 511.992 T0_0078125_S1 -256 255.9922 FORMAT "%8.4" /end CHARACTERISTIC
/begin CHARACTERISTIC InpPChp2L2_tChp2RawMax_C "F2443: Maximum allowed temperature value of the external chip temperature sensor" VALUE 0x1916EC AblGLKWsw_S1 511.992 T0_0078125_S1 -256 255.9922 FORMAT "%8.4" /end CHARACTERISTIC
/begin CHARACTERISTIC InpPChp2L2_tChp2RawMin_C "F2443: Minimum allowed temperature value of the external chip temperature sensor" VALUE 0x1916EE AblGLKWsw_S1 511.992 T0_0078125_S1 -256 255.9922 FORMAT "%8.4" /end CHARACTERISTIC
/begin MEASUREMENT InpPChp2L2_tiChp2Fault "F2443: Timeout timer on signal fault" UWORD TI1_M_CYCLE_S1 1 100 0 327675 ECU_ADDRESS 0xFFF9419A FORMAT "%8.1" /end MEASUREMENT
/begin CHARACTERISTIC InpPChp2L2_tiChp2Fault_C "F2443: Reload value of the timeout timer on signal fault" VALUE 0x1916F0 AblGLKWuw_S1 5000 TI1_M_CYCLE_S1 0 5000 FORMAT "%8.3" /end CHARACTERISTIC
/begin MEASUREMENT InpPChp2L2_tiChp2IniTo "F2443:  Time out timer of the init phase for externel chip temperature" UWORD TI1_CYCLE_S1 1 100 0 6553.5 ECU_ADDRESS 0xFFF9414E FORMAT "%8.3" /end MEASUREMENT
/begin CHARACTERISTIC InpPChp2L2_tiChp2IniTo_C "F2443:  Time out value of the init phase for externel chip temperature" VALUE 0x1916F2 AblGLKWuw_S1 10 TI1_CYCLE_S1 0 10 FORMAT "%8.5" /end CHARACTERISTIC
/begin CHARACTERISTIC InpPChp2L2_xChp2RawIni_C "F2443: Init value of the external chip temperature sensor to be ignored (without quantisation)" VALUE 0x1916F4 AblGLKWuw_S1 65535 X1_S1 0 65535 FORMAT "%8.2" /end CHARACTERISTIC
/begin MEASUREMENT InpPChp2L3_stChp2Fault "F2443: Bit word with active fault status of chip 2 temperatur monitoring" UWORD X1_S1 1 100 0 65535 ECU_ADDRESS 0xFFF93632 FORMAT "%8.2" /end MEASUREMENT
/begin MEASUREMENT InpPChp2L3_stChp2TstCon "F2443: Bit word with active test conditions of chip 2 temperature monitoring" UWORD X1_S1 1 100 0 65535 ECU_ADDRESS 0xFFF93634 FORMAT "%8.2" /end MEASUREMENT
/begin MEASUREMENT InpPIfcBatt_efBattNoi "F2410: Error flag is set if noise voltage is over limit" UBYTE B_TRUE_S1 1 100 0 1 ECU_ADDRESS 0xFFF93B06 FORMAT "%13.11" /end MEASUREMENT
/begin MEASUREMENT InpPIfcBatt_quBatt "F2410: Quality information (status) of the battery voltage" UBYTE Q_SIG_S1 1 100 0 8 ECU_ADDRESS 0xFFF948FC FORMAT "%13.11" /end MEASUREMENT
/begin MEASUREMENT InpPIfcBatt_uBatt "F2410: Battery voltage" UWORD U0_001_S1 1 100 0 32.767 ECU_ADDRESS 0xFFF94896 FORMAT "%8.5" /end MEASUREMENT
/begin MEASUREMENT InpPIfcBatt_uBatt8 "F2410: Battery voltage with 8 bit resolution" UBYTE U0_1_S1 1 100 0 25.5 ECU_ADDRESS 0xFFF93B07 FORMAT "%5.2" /end MEASUREMENT
/begin MEASUREMENT InpPIfcBatt_uBattMin "F2410: Minimum battery voltage" UWORD U0_001_S1 1 100 0 32.767 ECU_ADDRESS 0xFFF93476 FORMAT "%8.5" /end MEASUREMENT
/begin MEASUREMENT InpPIfcBatt_uBattNoi "F2410: Noise voltage of battery signal" UWORD U0_001_S1 1 100 0 16 ECU_ADDRESS 0xFFF93478 FORMAT "%8.5" /end MEASUREMENT
/begin MEASUREMENT InpPIfcChip_qtChp "F2442: Quality signal of the chip temperatur (selection of tChp2, tChp, tAtf)" UBYTE Q_SIG_S1 1 100 0 8 ECU_ADDRESS 0xFFF93B08 FORMAT "%13.11" /end MEASUREMENT
/begin MEASUREMENT InpPIfcChip_qtChp1 "F2442: Quality of the internal chip temperature signal (Chp1)" UBYTE Q_SIG_S1 1 100 0 8 ECU_ADDRESS 0xFFF93B09 FORMAT "%13.11" /end MEASUREMENT
/begin MEASUREMENT InpPIfcChip_tChp "F2442: Chip temperature (selection of tChp2, tChp, tAtf)" SWORD T0_0625_S1 1 100 -40 215 ECU_ADDRESS 0xFFF9347A FORMAT "%8.4" /end MEASUREMENT
/begin MEASUREMENT InpPIfcChip_tChp1 "F2442: Temperature of the internal chip sensor" SWORD T0_0625_S1 1 100 -40 215 ECU_ADDRESS 0xFFF9347C FORMAT "%8.4" /end MEASUREMENT
/begin MEASUREMENT InpPIfcChip_tChp18 "F2442: Temperature of the internal sensor with 8 bit resolution" UBYTE T1_OFFS_40_S1 1 100 -40 215 ECU_ADDRESS 0xFFF93B0A FORMAT "%5.1" /end MEASUREMENT
/begin MEASUREMENT InpPIfcChip_tChp8 "F2442: Chip temperature with 8 bit resolution (selection of tChp2, tChp, tAtf)" UBYTE T1_OFFS_40_S1 1 100 -40 215 ECU_ADDRESS 0xFFF93B0B FORMAT "%5.1" /end MEASUREMENT
/begin MEASUREMENT InpPIfcChp2_qtChp2 "F2443: Quality signal of the chip temperatur 2" UBYTE Q_SIG_S1 1 100 0 8 ECU_ADDRESS 0xFFF93B0C FORMAT "%13.11" /end MEASUREMENT
/begin MEASUREMENT InpPIfcChp2_tChp2 "F2443: Chip temperature 2" SWORD T0_0625_S1 1 100 -40 215 ECU_ADDRESS 0xFFF9347E FORMAT "%8.4" /end MEASUREMENT
/begin MEASUREMENT InpPIfcChp2_tChp28 "F2443: Chip 2 temperature with 8 bit resolution" UBYTE T1_OFFS_40_S1 1 100 -40 215 ECU_ADDRESS 0xFFF93B0D FORMAT "%5.1" /end MEASUREMENT
/begin MEASUREMENT InpPIfcM2M3_quM2 "F2415: Quality signal of the Voltage Signal M2" UBYTE Q_SIG_S1 1 100 0 8 ECU_ADDRESS 0xFFF93B57 FORMAT "%13.11" /end MEASUREMENT
/begin MEASUREMENT InpPIfcM2M3_quM3 "F2415: Quality signal of the Voltage Signal M3" UBYTE Q_SIG_S1 1 100 0 8 ECU_ADDRESS 0xFFF93B58 FORMAT "%13.11" /end MEASUREMENT
/begin MEASUREMENT InpPIfcM2M3_uM2 "F2415: Voltage signal M2" UWORD U0_001_S1 1 100 0 16 ECU_ADDRESS 0xFFF93530 FORMAT "%8.5" /end MEASUREMENT
/begin MEASUREMENT InpPIfcM2M3_uM3 "F2415: Voltage Signal M3" UWORD U0_001_S1 1 100 0 16 ECU_ADDRESS 0xFFF93532 FORMAT "%8.5" /end MEASUREMENT
/begin MEASUREMENT InpPIfcPSupp_quBattSply "F2411: Current quality of the power supply source voltage" UBYTE Q_SIG_S1 1 100 0 8 ECU_ADDRESS 0xFFF948FD FORMAT "%13.11" /end MEASUREMENT
/begin MEASUREMENT InpPIfcPSupp_quPSply "F2411: Quality information of actuator supply (channel no)" UBYTE Q_SIG_S1 1 100 0 8 ECU_ADDRESS 0xFFF948A4 FORMAT "%13.11" MATRIX_DIM 2 1 1 /end MEASUREMENT
/begin MEASUREMENT InpPIfcPSupp_uBattSply "F2411: Current voltage of the power supply source" UWORD U0_001_S1 1 100 0 32.767 ECU_ADDRESS 0xFFF948A6 FORMAT "%8.5" /end MEASUREMENT
/begin MEASUREMENT InpPIfcPSupp_uPSply "F2411: Power supply voltage of the available channels in L2" UWORD U0_001_S1 1 100 0 32.767 ECU_ADDRESS 0xFFF947DC FORMAT "%8.5" MATRIX_DIM 2 1 1 /end MEASUREMENT
/begin MEASUREMENT InpPIfcPSupp_uPSply8 "F2411: Actuator voltage with 8 bit resolution,(para. channel no.)" UBYTE U0_1_S1 1 100 0 25.5 ECU_ADDRESS 0xFFF93480 FORMAT "%5.2" MATRIX_DIM 2 1 1 /end MEASUREMENT
/begin MEASUREMENT InpPIfcPsns_bPsns "F2450: Array with the states of digital position lines as bool: TRUE=ON" UBYTE B_TRUE_S1 1 100 0 1 ECU_ADDRESS 0xFFF94898 FORMAT "%13.11" MATRIX_DIM 6 1 1 /end MEASUREMENT
/begin MEASUREMENT InpPIfcPsns_qbPsns "F2450: Quality info for bPsns[]" UBYTE Q_SIG_S1 1 100 0 8 ECU_ADDRESS 0xFFF9489E FORMAT "%13.11" MATRIX_DIM 6 1 1 /end MEASUREMENT
/begin MEASUREMENT InpPIfcSens_uSSply "F2413: Sensor supply voltage" UWORD U0_001_S1 1 100 0 10 ECU_ADDRESS 0xFFF93482 FORMAT "%8.5" /end MEASUREMENT
/begin MEASUREMENT InpPIfcTemp_qtAtf "F2440: Quality of tAtf (transmission oil temperature with substitution signals)" UBYTE Q_SIG_S1 1 100 0 8 ECU_ADDRESS 0xFFF948FE FORMAT "%13.11" /end MEASUREMENT
/begin MEASUREMENT InpPIfcTemp_qtAtfHw "F2440: Quality of tAtfHw (oil temperature without substitution signals)" UBYTE Q_SIG_S1 1 100 0 8 ECU_ADDRESS 0xFFF948FF FORMAT "%13.11" /end MEASUREMENT
/begin MEASUREMENT InpPIfcTemp_qtAtfPhys "F2440: Quality of tAtfPhys (oil temperature with substitution and may be project specific modell correction)" UBYTE Q_SIG_S1 1 100 0 8 ECU_ADDRESS 0xFFF94900 FORMAT "%13.11" /end MEASUREMENT
/begin MEASUREMENT InpPIfcTemp_tAtf "F2440: ATF temperature with substitution values)" SWORD T0_0625_S1 1 100 -40 215 ECU_ADDRESS 0xFFF948A8 FORMAT "%8.4" /end MEASUREMENT
/begin MEASUREMENT InpPIfcTemp_tAtf8 "F2440: 8 bit value of tAtf (oil temperature with substitution signals)" UBYTE T1_OFFS_40_S1 1 100 -40 215 ECU_ADDRESS 0xFFF93B0E FORMAT "%5.1" /end MEASUREMENT
/begin MEASUREMENT InpPIfcTemp_tAtf8Phys "F2440: ATF temperature with 8 bit resolution (signal with substitution and may be project specific modell correction)" UBYTE T1_OFFS_40_S1 1 100 -40 215 ECU_ADDRESS 0xFFF93B0F FORMAT "%5.1" /end MEASUREMENT
/begin MEASUREMENT InpPIfcTemp_tAtfHw "F2440: ATF temperature (oil temperature) without substitution values" SWORD T0_0625_S1 1 100 -40 215 ECU_ADDRESS 0xFFF948AA FORMAT "%8.4" /end MEASUREMENT
/begin MEASUREMENT InpPIfcTemp_tAtfPhys "F2440: ATF (oil) temperature with substitution and may be project specific modell correction" SWORD T0_0625_S1 1 100 -40 215 ECU_ADDRESS 0xFFF948AC FORMAT "%8.4" /end MEASUREMENT
/begin MEASUREMENT InpPIfcWake_bWak1 "F2420: Logical level on wakeup input line 1" UBYTE B_TRUE_S1 1 100 0 1 ECU_ADDRESS 0xFFF94901 FORMAT "%13.11" /end MEASUREMENT
/begin MEASUREMENT InpPIfcWake_bWak2 "F2420: Logical level on wakeup input line 2" UBYTE B_TRUE_S1 1 100 0 1 ECU_ADDRESS 0xFFF93B10 FORMAT "%13.11" /end MEASUREMENT
/begin MEASUREMENT InpPIfcWake_bWakInt "F2420: Logical level of the internal wakeup signal" UBYTE B_TRUE_S1 1 100 0 1 ECU_ADDRESS 0xFFF93B11 FORMAT "%13.11" /end MEASUREMENT
/begin MEASUREMENT InpPIfcWake_bWakPhys "F2420: physical level on wakeup" UBYTE B_TRUE_S1 1 100 0 1 ECU_ADDRESS 0xFFF94902 FORMAT "%13.11" /end MEASUREMENT
/begin MEASUREMENT InpPIfcWake_qbWak1 "F2420: Quality information for the digital Wak1 signal" UBYTE Q_SIG_S1 1 100 0 8 ECU_ADDRESS 0xFFF94903 FORMAT "%13.11" /end MEASUREMENT
/begin MEASUREMENT InpPIfcWake_qbWak2 "F2420: Quality information for the digital Wak2 signal" UBYTE Q_SIG_S1 1 100 0 8 ECU_ADDRESS 0xFFF93B12 FORMAT "%13.11" /end MEASUREMENT
/begin MEASUREMENT InpPIfcWake_qbWakInt "F2420: Quality info of the internal wakeup line (WAKST from CG130)" UBYTE Q_SIG_S1 1 100 0 8 ECU_ADDRESS 0xFFF93B13 FORMAT "%13.11" /end MEASUREMENT
/begin MEASUREMENT InpPIfcWake_qbWakPhys "F2420: quality information for the physical wake signal" UBYTE Q_SIG_S1 1 100 0 8 ECU_ADDRESS 0xFFF94904 FORMAT "%13.11" /end MEASUREMENT
/begin MEASUREMENT InpPIfcWake_quWak1 "F2420: Quality information of Wakeup 1" UBYTE Q_SIG_S1 1 100 0 8 ECU_ADDRESS 0xFFF94905 FORMAT "%13.11" /end MEASUREMENT
/begin MEASUREMENT InpPIfcWake_quWak2 "F2420: Quality information of Wakeup 2" UBYTE Q_SIG_S1 1 100 0 8 ECU_ADDRESS 0xFFF93B14 FORMAT "%13.11" /end MEASUREMENT
/begin MEASUREMENT InpPIfcWake_uWak1 "F2420: Voltage level on wakeup input line 1" UWORD U0_001_S1 1 100 0 25 ECU_ADDRESS 0xFFF948AE FORMAT "%8.5" /end MEASUREMENT
/begin MEASUREMENT InpPIfcWake_uWak2 "F2420: Voltage level on wakeup input line 2" UWORD U0_001_S1 1 100 0 25 ECU_ADDRESS 0xFFF93484 FORMAT "%8.5" /end MEASUREMENT
/begin CHARACTERISTIC InpPPSplyL3_bPrs_C "F2411: Availability of power supply lines bidcoded (bit x=1/0: Channel x available/not available)" VALUE 0x191714 AblGLKWuw_S1 3 X1_S1 0 3 FORMAT "%8.6" /end CHARACTERISTIC
/begin CHARACTERISTIC InpPPSplyL3_swtBattSply_C "F2411: Source selection switch of the power stage supply (<>1: uBatt, =1: uWak1)" VALUE 0x1919E9 AblGLKWub_S1 1 X1_S1 0 1 FORMAT "%5.3" /end CHARACTERISTIC
/begin CHARACTERISTIC InpPPSplyL3_uThres_C "F2411: Threshold of Power Supply Voltage for ADC saturation" VALUE 0x191716 AblGLKWuw_S1 32.767 U0_001_S1 0 32.767 FORMAT "%8.5" /end CHARACTERISTIC
/begin MEASUREMENT InpPPsnsL2_bAna "F2450: Array with on/off status of the analog lines: TRUE=ON" UBYTE B_TRUE_S1 1 100 0 1 ECU_ADDRESS 0xFFF93602 FORMAT "%13.11" MATRIX_DIM 6 1 1 /end MEASUREMENT
/begin MEASUREMENT InpPPsnsL2_bAnaCpl "F2450: Array with complements of the on/off stati of the analog lines: 254=ON, 255=OFF" UBYTE X1_S1 1 100 0 255 ECU_ADDRESS 0xFFF93608 FORMAT "%5.1" MATRIX_DIM 6 1 1 /end MEASUREMENT
/begin MEASUREMENT InpPPsnsL2_bDig "F2450: Digital line state of the digital Psns inputs as array" UBYTE B_TRUE_S1 1 100 0 1 ECU_ADDRESS 0xFFF9360E FORMAT "%13.11" MATRIX_DIM 6 1 1 /end MEASUREMENT
/begin MEASUREMENT InpPPsnsL2_ctChnIdx "F2450: Psns input line index for Festkennfeld  InpPPsnsL2_rPsnsAnaZon_C" UBYTE X1_S1 1 100 0 5 ECU_ADDRESS 0xFFF93B79 FORMAT "%5.3" /end MEASUREMENT
/begin MEASUREMENT InpPPsnsL2_ctPsnsIni "F2450: Down counter of program cycles calls after reset." UBYTE X1_S1 1 100 0 20 ECU_ADDRESS 0xFFF93B7A FORMAT "%5.2" /end MEASUREMENT
/begin CHARACTERISTIC InpPPsnsL2_ctPsnsIni_C "F2450: Reload value of the program cycle down counter after reset." VALUE 0x1919E4 AblGLKWub_S1 20 X1_S1 0 20 FORMAT "%5.2" /end CHARACTERISTIC
/begin MEASUREMENT InpPPsnsL2_ctRngIdx "F2450: Analog range index for Festkennfeld  InpPPsnsL2_rPsnsAnaZon_C" UBYTE X1_S1 1 100 0 4 ECU_ADDRESS 0xFFF93B7B FORMAT "%5.3" /end MEASUREMENT
/begin MEASUREMENT InpPPsnsL2_qbPsns "F2450: internal quality info concerning sensor supply" UBYTE Q_SIG_S1 1 100 0 8 ECU_ADDRESS 0xFFF93B7C FORMAT "%13.11" /end MEASUREMENT
/begin MEASUREMENT InpPPsnsL2_rPsnsAna "F2450: Array with voltage ratio of the analog Psns lines related to the sensor voltage" UWORD R0_0001_S1 1 100 0 1.2 ECU_ADDRESS 0xFFF930C8 FORMAT "%8.6" MATRIX_DIM 6 1 1 /end MEASUREMENT
/begin CHARACTERISTIC InpPPsnsL2_rPsnsAnaZon_C "F2450: Ratio thresholds of analog positions ranges:  <[0]: SG; <[1]: ON; <[2]: UNDEF; <[3]: OFF; <[4]: OP; >[5]: SB" MAP 0x19138C AblGLFKFuw_S1 1 R0_0001_S1 0 1
 /begin AXIS_DESCR FIX_AXIS InpPPsnsL2_ctRngIdx X1_S1 5 0 4 READ_ONLY FORMAT "%5.3" FIX_AXIS_PAR_DIST 0 1 5 /end AXIS_DESCR
 /begin AXIS_DESCR FIX_AXIS InpPPsnsL2_ctChnIdx X1_S1 6 0 5 READ_ONLY FORMAT "%5.3" FIX_AXIS_PAR_DIST 0 1 6 /end AXIS_DESCR
 FORMAT "%8.6" /end CHARACTERISTIC
/begin CHARACTERISTIC InpPPsnsL2_rPsnsOnOffThres_C "F2450: threshold for nominal value" VALUE 0x1916F6 AblGLKWuw_S1 6.5535 R0_0001_S1 0 6.5535 FORMAT "%8.6" /end CHARACTERISTIC
/begin MEASUREMENT InpPPsnsL2_stPsnsAna "F2450: Analog line states digitized as bit word" UBYTE X1_S1 1 100 0 63 ECU_ADDRESS 0xFFF93B7D FORMAT "%5.2" /end MEASUREMENT
/begin MEASUREMENT InpPPsnsL2_stPsnsAnaErr "F2450: Bit word with fault bits of the available analog lines" UBYTE X1_S1 1 100 0 63 ECU_ADDRESS 0xFFF93B7E FORMAT "%5.2" /end MEASUREMENT
/begin MEASUREMENT InpPPsnsL2_stPsnsDFC "F2450: Array over position lines with diagnosis state of the analog Psns inputs: 0=SG; 1=ON; 2=UNDEF; 3=OFF; 4=OP; 5=SB" UBYTE X1_S1 1 100 0 5 ECU_ADDRESS 0xFFF93614 FORMAT "%5.3" MATRIX_DIM 6 1 1 /end MEASUREMENT
/begin MEASUREMENT InpPPsnsL2_stPsnsDig "F2450: Digital Psns line states as bit word" UBYTE X1_S1 1 100 0 63 ECU_ADDRESS 0xFFF93B7F FORMAT "%5.2" /end MEASUREMENT
/begin MEASUREMENT InpPPsnsL2_stPsnsDigChng "F2450: Bit word with line change information since last cycle only of the digital position inputs." UBYTE X1_S1 1 100 0 63 ECU_ADDRESS 0xFFF93B80 FORMAT "%5.2" /end MEASUREMENT
/begin MEASUREMENT InpPPsnsL2_stPsnsDigOld "F2450: Old value of digital Psns line states" UBYTE X1_S1 1 100 0 63 ECU_ADDRESS 0xFFF93B81 FORMAT "%5.2" /end MEASUREMENT
/begin MEASUREMENT InpPPsnsL2_stPsnsPlausErr "F2450: Bit word with plausibility errors for every line which is analog and digital available" UBYTE X1_S1 1 100 0 63 ECU_ADDRESS 0xFFF93B82 FORMAT "%5.2" /end MEASUREMENT
/begin MEASUREMENT InpPPsnsL2_stPsnsSt "F2450: Status bit word f Psns signal evaluation. (bit0: 1=ctPsnsIni zero; bit1: 1=supply below limit; bit2: 1=sply switched off; bit3: 1=supply switched off and timer zero)" UBYTE X1_S1 1 100 0 63 ECU_ADDRESS 0xFFF93B83 FORMAT "%5.2" /end MEASUREMENT
/begin MEASUREMENT InpPPsnsL2_tiFault "F2450: Timeout timer for freezing the position signals on sensor supply fault" UWORD TI1_M_CYCLE_S1 1 100 0 1000 ECU_ADDRESS 0xFFF9419C FORMAT "%8.3" /end MEASUREMENT
/begin CHARACTERISTIC InpPPsnsL2_tiFault_C "F2450: Start value for tiFault. Timeout timer for sensor supply fault." VALUE 0x1916F8 AblGLKWuw_S1 1000 TI1_M_CYCLE_S1 0 1000 FORMAT "%8.3" /end CHARACTERISTIC
/begin CHARACTERISTIC InpPPsnsL2_uSSplyThres_C "F2450: Threshold for sufficient sensor supply voltage" VALUE 0x1916FA AblGLKWuw_S1 15 U0_001_S1 0 15 FORMAT "%8.5" /end CHARACTERISTIC
/begin MEASUREMENT InpPPsnsL3_bMonCondGen "F2450: General condition for monitoring release" UBYTE B_TRUE_S1 1 100 0 1 ECU_ADDRESS 0xFFF93B8B FORMAT "%13.11" /end MEASUREMENT
/begin MEASUREMENT InpPPsnsL3_bPsnsDsmErr "F2450: current electrical error state" UBYTE B_TRUE_S1 1 100 0 1 ECU_ADDRESS 0xFFF93636 FORMAT "%13.11" MATRIX_DIM 6 1 1 /end MEASUREMENT
/begin MEASUREMENT InpPPsnsL3_stPsnsAnaOld "F2450: Old value of bit word with on/off status of the analog lines" UBYTE X1_S1 1 100 0 63 ECU_ADDRESS 0xFFF93B8C FORMAT "%5.2" /end MEASUREMENT
/begin MEASUREMENT InpPPsnsL3_stPsnsChngErr "F2450: Bit word with lines which have toggled for activation the test condition" UBYTE X1_S1 1 100 0 63 ECU_ADDRESS 0xFFF93B8D FORMAT "%5.2" /end MEASUREMENT
/begin CHARACTERISTIC InpPPsnsL3_stPsnsChng_C "F2450: Bit word for activation of the toggle condition for every position line (1= on, 0= off)" VALUE 0x1919E7 AblGLKWub_S1 63 X1_S1 0 63 FORMAT "%5.2" /end CHARACTERISTIC
/begin MEASUREMENT InpPPsnsL3_stPsnsDFCOld "F2450: Array with diagnosis state of the Psns lines from last cycle" UBYTE X1_S1 1 100 0 5 ECU_ADDRESS 0xFFF9363C FORMAT "%5.3" MATRIX_DIM 6 1 1 /end MEASUREMENT
/begin MEASUREMENT InpPPsnsL3_stPsnsFault "F2450: Bit field with active fault conditions of Psns monitoring" UWORD X1_S1 1 100 0 65535 ECU_ADDRESS 0xFFF930D4 FORMAT "%8.2" MATRIX_DIM 6 1 1 /end MEASUREMENT
/begin CHARACTERISTIC InpPPsnsL3_stPsnsMon_C "F2450: Bit word for activation the fault message to the DSM interface for every position line (1= on, 0= off)" VALUE 0x1919E8 AblGLKWub_S1 63 X1_S1 0 63 FORMAT "%5.2" /end CHARACTERISTIC
/begin MEASUREMENT InpPPsnsL3_stPsnsOld "F2450: Old value of the digital Psns line states" UBYTE X1_S1 1 100 0 63 ECU_ADDRESS 0xFFF93B8E FORMAT "%5.2" /end MEASUREMENT
/begin MEASUREMENT InpPPsnsL3_stPsnsTstCon "F2450: Bit word with active test conditions of Psns monitoring" UWORD X1_S1 1 100 0 65535 ECU_ADDRESS 0xFFF930E0 FORMAT "%8.2" MATRIX_DIM 6 1 1 /end MEASUREMENT
/begin MEASUREMENT InpPTisL2_fEce "F2431: Signal frequency received from ECE layer." UWORD F1_S1 1 100 0 15000 ECU_ADDRESS 0xFFF9361A FORMAT "%8.2" /end MEASUREMENT
/begin CHARACTERISTIC InpPTisL2_fHwDiaMax_C "F2431: Frequency threshold of using the HW diagnostic info from the sensor" VALUE 0x1916FC AblGLKWuw_S1 15000 F1_S1 0 15000 FORMAT "%8.2" /end CHARACTERISTIC
/begin CHARACTERISTIC InpPTisL2_fThresHwProt_C "F2431: For SB fault active and frequency lower threshold the protection circuit is activated (if available)" VALUE 0x1916FE AblGLKWuw_S1 15000 F1_S1 0 15000 FORMAT "%8.2" /end CHARACTERISTIC
/begin MEASUREMENT InpPTisL2_nErrCyclCnt "F2431: Counter of cycles during sensor supply not ok" UBYTE X1_S1 1 100 0 255 ECU_ADDRESS 0xFFF93B84 FORMAT "%5.1" /end MEASUREMENT
/begin MEASUREMENT InpPTisL2_stTis "F2431: Status error bits: 15-11:-/-; 10: protection active; 9:SGOP fault; 8:SB fault; 7:over speed; 6:timeout; 5:second fault cycle; 4:ECE init; 3:-/-; 2:sply off; 1:sply low; 0:init passed;" UWORD X1_S1 1 100 0 65535 ECU_ADDRESS 0xFFF9361C FORMAT "%8.2" /end MEASUREMENT
/begin MEASUREMENT InpPTisL2_stTisHwDia "F2431: HW diagnosis info bits: 7:ok, 2:not available, 1:SG/OP, 0:SB" UBYTE X1_S1 1 100 0 255 ECU_ADDRESS 0xFFF93B85 FORMAT "%5.1" /end MEASUREMENT
/begin MEASUREMENT InpPTisL2_stTisOld "F2431: Value of stTis from last cycle" UWORD X1_S1 1 100 0 65535 ECU_ADDRESS 0xFFF9361E FORMAT "%8.2" /end MEASUREMENT
/begin MEASUREMENT InpPTisL2_tiFault "F2431: TIS signal timeout timer" UWORD TI1_M_CYCLE_S1 1 100 0 327675 ECU_ADDRESS 0xFFF9419E FORMAT "%8.1" /end MEASUREMENT
/begin CHARACTERISTIC InpPTisL2_tiFault_C "F2431: Time until TIS timeout recognition" VALUE 0x191700 AblGLKWuw_S1 1000 TI1_M_CYCLE_S1 0 1000 FORMAT "%8.3" /end CHARACTERISTIC
/begin CHARACTERISTIC InpPTisL2_uSplyMin_C "F2431: Lower limit of an allowed sensor supply voltage for TIS detection" VALUE 0x191702 AblGLKWuw_S1 12 U0_001_S1 0 12 FORMAT "%8.5" /end CHARACTERISTIC
/begin MEASUREMENT InpPTisL3_stTisFault "F2431: Bit field with active fault conditions of Tis monitoring" UWORD X1_S1 1 100 0 65535 ECU_ADDRESS 0xFFF93642 FORMAT "%8.2" /end MEASUREMENT
/begin MEASUREMENT InpPTisL3_stTisTstCon "F2431: Bit word with active test conditions of Tis monitoring" UWORD X1_S1 1 100 0 65535 ECU_ADDRESS 0xFFF93644 FORMAT "%8.2" /end MEASUREMENT
/begin MEASUREMENT InpPTisL3_tiSSplyDel "F2431: Delay timer of HW diagnosis prevention after sensor supply was switched off or insufficient" UBYTE TI1_M_CYCLE_S1 1 100 0 1275 ECU_ADDRESS 0xFFF94247 FORMAT "%5.0" /end MEASUREMENT
/begin CHARACTERISTIC InpPTisL3_tiSSplyDel_C "F2431: Delay time const. for HW diagnosis fault prevention after missing or switched off sensor supply" VALUE 0x1919EA AblGLKWub_S1 1275 TI1_M_CYCLE_S1 0 1275 FORMAT "%5.0" /end CHARACTERISTIC
/begin MEASUREMENT InpPTosL2_fEce "F2430: Signal frequency received from ECE layer." UWORD F1_S1 1 100 0 15000 ECU_ADDRESS 0xFFF93620 FORMAT "%8.2" /end MEASUREMENT
/begin CHARACTERISTIC InpPTosL2_fHwDiaMax_C "F2430: Frequency threshold of using the HW diagnostic info from the sensor" VALUE 0x191704 AblGLKWuw_S1 15000 F1_S1 0 15000 FORMAT "%8.2" /end CHARACTERISTIC
/begin CHARACTERISTIC InpPTosL2_fThresHwProt_C "F2430: For SB fault active and frequency lower threshold the protection circuit is activated (if available)" VALUE 0x191706 AblGLKWuw_S1 15000 F1_S1 0 15000 FORMAT "%8.2" /end CHARACTERISTIC
/begin MEASUREMENT InpPTosL2_nErrCyclCnt "F2430: Counter of cycles during sensor supply not ok" UBYTE X1_S1 1 100 0 255 ECU_ADDRESS 0xFFF93B86 FORMAT "%5.1" /end MEASUREMENT
/begin MEASUREMENT InpPTosL2_stTos "F2430: Status error bits: 15-11:-/-; 10: protection active; 9:SGOP fault; 8:SB fault; 7:over speed; 6:timeout; 5:second fault cycle; 4:ECE init; 3:-/-; 2:sply off; 1:sply low; 0:init passed;" UWORD X1_S1 1 100 0 65535 ECU_ADDRESS 0xFFF93622 FORMAT "%8.2" /end MEASUREMENT
/begin MEASUREMENT InpPTosL2_stTosHwDia "F2430: HW diagnosis info from TOS sensor" UBYTE X1_S1 1 100 0 255 ECU_ADDRESS 0xFFF93B87 FORMAT "%5.1" /end MEASUREMENT
/begin MEASUREMENT InpPTosL2_stTosOld "F2430: Value of stTos from last cycle" UWORD X1_S1 1 100 0 65535 ECU_ADDRESS 0xFFF93624 FORMAT "%8.2" /end MEASUREMENT
/begin MEASUREMENT InpPTosL2_tiFault "F2430: TOS signal timeout timer" UWORD TI1_M_CYCLE_S1 1 100 0 327675 ECU_ADDRESS 0xFFF941A0 FORMAT "%8.1" /end MEASUREMENT
/begin CHARACTERISTIC InpPTosL2_tiFault_C "F2430: Time until TOS timeout recognition" VALUE 0x191708 AblGLKWuw_S1 1000 TI1_M_CYCLE_S1 0 1000 FORMAT "%8.3" /end CHARACTERISTIC
/begin CHARACTERISTIC InpPTosL2_uSplyMin_C "F2430: Lower limit of an allowed sensor supply voltage for TOS detection" VALUE 0x19170A AblGLKWuw_S1 12 U0_001_S1 0 12 FORMAT "%8.5" /end CHARACTERISTIC
/begin MEASUREMENT InpPTosL3_stTosFault "F2430: Bit field with active fault conditions of Tos monitoring" UWORD X1_S1 1 100 0 65535 ECU_ADDRESS 0xFFF93646 FORMAT "%8.2" /end MEASUREMENT
/begin MEASUREMENT InpPTosL3_stTosTstCon "F2430: Bit word with active test conditions of Tos monitoring" UWORD X1_S1 1 100 0 65535 ECU_ADDRESS 0xFFF93648 FORMAT "%8.2" /end MEASUREMENT
/begin MEASUREMENT InpPTosL3_tiSSplyDel "F2430: Delay timer of HW diagnosis prevention after sensor supply was switched off or insufficient" UBYTE TI1_M_CYCLE_S1 1 100 0 1275 ECU_ADDRESS 0xFFF94248 FORMAT "%5.0" /end MEASUREMENT
/begin CHARACTERISTIC InpPTosL3_tiSSplyDel_C "F2430: Delay time const. for HW diagnosis fault prevention after missing or switched off sensor supply" VALUE 0x1919EB AblGLKWub_S1 1275 TI1_M_CYCLE_S1 0 1275 FORMAT "%5.0" /end CHARACTERISTIC
/begin CHARACTERISTIC InpPWakL2_bWak1SrcSel_C "F2420: Switch for selection of bWak1 source: FALSE=bWak1, TRUE=uWak1>=uWakThresOn_C" VALUE 0x191A01 AblGLKWub_S1 1 B_TRUE_S1 0 1 FORMAT "%13.11" /end CHARACTERISTIC
/begin CHARACTERISTIC InpPWakL2_swtPrsWak2_C "F2420: Switch for availability of WAKE2 (1: available, 0: not available) (no SERAP)" VALUE 0x191A00 AblGLKWub_S1 1 X1_S1 0 1 FORMAT "%5.3" /end CHARACTERISTIC
/begin CHARACTERISTIC InpPWakL2_uThresWak_C "F2420: Threshold of Wake up Voltage for ADC saturation" VALUE 0x19187C AblGLKWuw_S1 25 U0_001_S1 0 25 FORMAT "%8.5" /end CHARACTERISTIC
/begin CHARACTERISTIC InpPWakL2_uWak1ThresOn_C "F2420: Threshold for uWak1 if uWak1 is used as source for bWak1." VALUE 0x19187E AblGLKWuw_S1 20 U0_001_S1 0 20 FORMAT "%8.5" /end CHARACTERISTIC
/begin MEASUREMENT OutPCc08Cfg_iCc08EeChn "F2531: Current compensation value of EE for a selected channel (only internal)" SWORD I0_0001_S1 1 100 -0.026 0.026 ECU_ADDRESS 0xFFF93550 FORMAT "%10.8" /end MEASUREMENT
/begin MEASUREMENT OutPCc08Cfg_iCc08Out "F2531: Current output value for current control of VFS" UWORD I0_0001_S1 1 100 0 1.2282 ECU_ADDRESS 0xFFF94864 FORMAT "%8.6" MATRIX_DIM 10 1 1 /end MEASUREMENT
/begin MEASUREMENT OutPCc08Cfg_stCc08Actv "F2531: Current mode at VFS [0=switch mode off, 1=Curr mode off, 2=Curr mode 0mA, 3=Curr mode, 4=switch mode on]" UBYTE X1_S1 1 100 0 3 ECU_ADDRESS 0xFFF948E8 FORMAT "%5.3" MATRIX_DIM 10 1 1 /end MEASUREMENT
/begin CHARACTERISTIC OutPCc08Cfg_stCc08Mode_C "F2531: Status of current control mode [0=VFS not available, 1=Regulator Mode, 2=Switch Mode, 3=Mode is set by IFC]" VAL_BLK 0x191690 AblGLKWBub_S1 2 X1_S1 0 2 MATRIX_DIM 10 1 1 FORMAT "%5.3" /end CHARACTERISTIC
/begin CHARACTERISTIC OutPCc08Crnt_iCc08CrntHys_C "F2531: Current tolerance value for current control changes" VALUE 0x191718 AblGLKWuw_S1 1 I0_0001_S1 0 1 FORMAT "%8.6" /end CHARACTERISTIC
/begin CHARACTERISTIC OutPCc08Crnt_stCc08CrntEval_C "F2531: Relevance of VFS for current monitoring evaluation [B0=VFS0, B1=VFS1,... ; 0=not relevant, 1=relevant]" VALUE 0x19171A AblGLKWuw_S1 1023 X1_S1 0 1023 FORMAT "%8.3" /end CHARACTERISTIC
/begin MEASUREMENT OutPCc08Crnt_stCc08CrntNom "F2531: Status of current control transitions [0=undef, 0x10=AllOff, 0x11=Off, 0x20=Trans, 0x30=AllConst, 0x31=Const, 0x32=Chng, 0x35=Dth, 0x36=AllSync, 0x40=DIFFSGOP_OFF; 0x41=DIFFSGOP_PWM, 0x50=SWM_OFF, 0x51=SWM_ON, 0x60=MINCRNT, 0x61=MAXCRNT]" UBYTE X1_S1 1 100 0 97 ECU_ADDRESS 0xFFF9364A FORMAT "%5.2" MATRIX_DIM 10 1 1 /end MEASUREMENT
/begin MEASUREMENT OutPCc08Crnt_tiCc08CrntChng "F2531: Lag counter for current evaluation of this VFS while current control changes" UBYTE TI1_M_CYCLE_S1 1 100 0 100 ECU_ADDRESS 0xFFF94206 FORMAT "%5.1" MATRIX_DIM 10 1 1 /end MEASUREMENT
/begin CHARACTERISTIC OutPCc08Crnt_tiCc08CrntChng_C "F2531: Start value lag counter for current evaluation while current control changes" VAL_BLK 0x19171C AblGLKWBub_S1 100 TI1_M_CYCLE_S1 0 100 MATRIX_DIM 10 1 1 FORMAT "%5.1" /end CHARACTERISTIC
/begin MEASUREMENT OutPCc08Crnt_tiCc08CrntGen "F2531: Lag counter for current tolerance expansion if other VFS change their current control" UBYTE TI1_M_CYCLE_S1 1 100 0 100 ECU_ADDRESS 0xFFF94249 FORMAT "%5.1" /end MEASUREMENT
/begin CHARACTERISTIC OutPCc08Crnt_tiCc08CrntGen_C "F2531: Start value of lag counter for current tolerance expansion if other VFS change their current control" VAL_BLK 0x191726 AblGLKWBub_S1 100 TI1_M_CYCLE_S1 0 100 MATRIX_DIM 10 1 1 FORMAT "%5.1" /end CHARACTERISTIC
/begin CHARACTERISTIC OutPCc08Ctl_facCc08PSplyFlt_C "F2531: Filter constant for filtered power supply voltage" VAL_BLK 0x190500 AblGLKWBsw_S1 1 R0_0001_S1 0 1 MATRIX_DIM 2 1 1 FORMAT "%8.6" /end CHARACTERISTIC
/begin MEASUREMENT OutPCc08Ctl_iCc08Crnt "F2531: Current output value from layer 3 to layer 2" UWORD I0_0001_S1 1 100 0 1.2282 ECU_ADDRESS 0xFFF947E0 FORMAT "%8.6" MATRIX_DIM 10 1 1 /end MEASUREMENT
/begin MEASUREMENT OutPCc08Ctl_iCc08In "F2531: Nominal current value" UWORD I0_0001_S1 1 100 0 1.2282 ECU_ADDRESS 0xFFF947F4 FORMAT "%8.6" MATRIX_DIM 10 1 1 /end MEASUREMENT
/begin CHARACTERISTIC OutPCc08Ctl_iCc08LoBatt_C "F2531: Current threshold for differentiation to switch On/Off in case of under voltage" VALUE 0x191514 AblGLKWuw_S1 0.4 I0_0001_S1 0 0.4 FORMAT "%9.7" /end CHARACTERISTIC
/begin CHARACTERISTIC OutPCc08Ctl_iCc08LoCrnt_C "F2531: Threshold for under current deactivation" VALUE 0x191516 AblGLKWuw_S1 0.05 I0_0001_S1 0 0.05 FORMAT "%10.8" /end CHARACTERISTIC
/begin CHARACTERISTIC OutPCc08Ctl_stCc08Avl_C "F2531: Current regulator available [B0=CG208 channel 0, B1=CG208 channel 1,...; 0=not available, 1=available]" VALUE 0x191518 AblGLKWuw_S1 1023 X1_S1 0 1023 FORMAT "%8.3" /end CHARACTERISTIC
/begin CHARACTERISTIC OutPCc08Ctl_stCc08DnConn_C "F2531: Connection between VFS and DN [B0: CG208 channel 0, ..; 0=Not connected, 1=Connected]" VALUE 0x19151A AblGLKWuw_S1 1023 X1_S1 0 1023 FORMAT "%8.3" /end CHARACTERISTIC
/begin CHARACTERISTIC OutPCc08Ctl_stCc08LoBatt_C "F2531: Status for switch on/off in case of under voltage [bit0=switch off, bit1=switch on; 0=deaktivate, 1=active]" VAL_BLK 0x190504 AblGLKWBuw_S1 3 X1_S1 0 3 MATRIX_DIM 10 1 1 FORMAT "%8.6" /end CHARACTERISTIC
/begin MEASUREMENT OutPCc08Ctl_stCc08Out "F2531: Output value for SFRM, if current control is active" UBYTE X1_S1 1 100 0 255 ECU_ADDRESS 0xFFF948B0 FORMAT "%5.1" MATRIX_DIM 10 1 1 /end MEASUREMENT
/begin MEASUREMENT OutPCc08Ctl_stCc08ReqOff "F2531: Request to switch VFS off [B0=CG208 channel 0, B1=CG208 channel 1, ...; 0=Off, 1=On]" UWORD X1_S1 1 100 0 1023 ECU_ADDRESS 0xFFF934BA FORMAT "%8.3" /end MEASUREMENT
/begin MEASUREMENT OutPCc08Ctl_stCc08ReqOn "F2531: Status of request to switch current control on [B0:CG208 channel 0, ..; value 0=Off, 1=On]" UWORD X1_S1 1 100 0 1023 ECU_ADDRESS 0xFFF934BC FORMAT "%8.3" /end MEASUREMENT
/begin CHARACTERISTIC OutPCc08Ctl_stCc08ReqPSply_C "F2531: Active channel for request ON demand from PSply [B0=VFS0, B1=VFS1,...]" VALUE 0x19151C AblGLKWuw_S1 1023 X1_S1 0 1023 FORMAT "%8.3" /end CHARACTERISTIC
/begin MEASUREMENT OutPCc08Ctl_tiCc08HwFault "F2531: Timer for hardware fault detection of current comparing" UBYTE TI1_M_CYCLE_S1 1 100 0 1275 ECU_ADDRESS 0xFFF941AA FORMAT "%5.0" MATRIX_DIM 10 1 1 /end MEASUREMENT
/begin CHARACTERISTIC OutPCc08Ctl_tiCc08HwFault_C "F2531: Start value of timer for hardware fault detection of current comparing" VALUE 0x1918E7 AblGLKWub_S1 1275 TI1_M_CYCLE_S1 0 1275 FORMAT "%5.0" /end CHARACTERISTIC
/begin CHARACTERISTIC OutPCc08Ctl_tiCc08ModeChng_C "F2531: Start value of timer for fault detection after PSply mode changes" VALUE 0x1918E8 AblGLKWub_S1 1275 TI1_M_CYCLE_S1 0 1275 FORMAT "%5.0" /end CHARACTERISTIC
/begin CHARACTERISTIC OutPCc08Ctl_uCc08LoBattHys_C "F2531: Hysteresisvoltage for LoadOnOff function" VALUE 0x19151E AblGLKWuw_S1 5 U0_001_S1 0 5 FORMAT "%8.6" /end CHARACTERISTIC
/begin CHARACTERISTIC OutPCc08Ctl_uCc08LoBatt_C "F2531: Actuator voltage below which LoadOnOff function is activated" VALUE 0x191520 AblGLKWuw_S1 9 U0_001_S1 0 9 FORMAT "%8.6" /end CHARACTERISTIC
/begin MEASUREMENT OutPCc08Ctl_uCc08PSplyFlt "F2531: Filtered power supply voltage" UWORD U0_001_S1 1 100 0 32 ECU_ADDRESS 0xFFF92C28 FORMAT "%8.5" MATRIX_DIM 2 1 1 /end MEASUREMENT
/begin MEASUREMENT OutPCc08Fdbk_ctCc08FdbkErr "F2531: Errorcounter for feedback signal" UBYTE X1_S1 1 100 0 10 ECU_ADDRESS 0xFFF93562 FORMAT "%5.2" MATRIX_DIM 10 1 1 /end MEASUREMENT
/begin CHARACTERISTIC OutPCc08Fdbk_ctCc08FdbkErr_C "F2531: Limit for errorcounter for feedback signal" VALUE 0x1919D7 AblGLKWub_S1 100 X1_S1 0 100 FORMAT "%5.1" /end CHARACTERISTIC
/begin CHARACTERISTIC OutPCc08Fdbk_facCc08FdbkFlt_C "F2531: Filter constant for filtered ratio of feedback signal" VAL_BLK 0x191288 AblGLKWBsw_S1 1 R0_0001_S1 0 1 MATRIX_DIM 10 1 1 FORMAT "%8.6" /end CHARACTERISTIC
/begin MEASUREMENT OutPCc08Fdbk_rCc08FdbkAvrg "F2531: Ratio of feedback signal (average of high and low value)" UWORD R0_1_P_S1 1 100 0 100 ECU_ADDRESS 0xFFF92FC0 FORMAT "%8.4" MATRIX_DIM 10 1 1 /end MEASUREMENT
/begin MEASUREMENT OutPCc08Fdbk_rCc08FdbkFlt "F2531: Filtered ratio of feedback signal" UWORD R0_1_P_S1 1 100 0 100 ECU_ADDRESS 0xFFF92FD4 FORMAT "%8.4" MATRIX_DIM 10 1 1 /end MEASUREMENT
/begin MEASUREMENT OutPCc08Fdbk_rCc08FdbkFlt32 "F2531: Internal filter value for feedback signal" SLONG R0_0001_S1 1 100 0 100 ECU_ADDRESS 0xFFF92FE8 FORMAT "%13.9" MATRIX_DIM 10 1 1 /end MEASUREMENT
/begin MEASUREMENT OutPCc08Fdbk_rCc08FdbkHi "F2531: Ratio of feedback signal (high sample value)" UWORD R0_1_P_S1 1 100 0 100 ECU_ADDRESS 0xFFF93010 FORMAT "%8.4" MATRIX_DIM 10 1 1 /end MEASUREMENT
/begin CHARACTERISTIC OutPCc08Fdbk_rCc08FdbkLim_C "F2531: Ratio limit to recognize short circuits" VALUE 0x19169A AblGLKWuw_S1 100 R0_1_P_S1 0 100 FORMAT "%8.4" /end CHARACTERISTIC
/begin MEASUREMENT OutPCc08Fdbk_rCc08FdbkLo "F2531: Ratio of feedback signal (low sample value)" UWORD R0_1_P_S1 1 100 0 100 ECU_ADDRESS 0xFFF93024 FORMAT "%8.4" MATRIX_DIM 10 1 1 /end MEASUREMENT
/begin MEASUREMENT OutPCc08Fdbk_stCc08Fdbk "F2531: Status of feedback signal [0=undef, 1=0%, 2=100%, 3=PWM, 4=PWMLo, 5=PWMHi, 6=NoInfo, 7=Err]" UBYTE X1_S1 1 100 0 7 ECU_ADDRESS 0xFFF9356C FORMAT "%5.3" MATRIX_DIM 10 1 1 /end MEASUREMENT
/begin MEASUREMENT OutPCc08Mon_iCc08Meas "F2531: Measured current value, which is calculated from feedback switch on and period time" UWORD I0_0001_S1 1 100 0 2 ECU_ADDRESS 0xFFF92C2C FORMAT "%8.6" MATRIX_DIM 10 1 1 /end MEASUREMENT
/begin MEASUREMENT OutPCc08Mon_stCc08Fault "F2531: Status of fault for diagnosis purpose [B0=Gen, B1=Plaus, B2=SB, B3=SG, B4=SGOP, B5=SBDFE, B6=SGDFE, B7=OPDFE, B8=Low, B9=High, B10=NSSTA, B11=NSDYN, B12=PRESGOP, B13=TEMPINCOR]" UWORD X1_S1 1 100 0 65535 ECU_ADDRESS 0xFFF94350 FORMAT "%8.2" MATRIX_DIM 10 1 1 /end MEASUREMENT
/begin MEASUREMENT OutPCc08Mon_stCc08Sfrm "F2531: Fault status for Sfrm [0=no fault, 1= switch off lowsides, 2=switch off lowsides and PSply,  Bit7 = DFE fault]" UBYTE X1_S1 1 100 0 2 ECU_ADDRESS 0xFFF934D4 FORMAT "%5.3" MATRIX_DIM 10 1 1 /end MEASUREMENT
/begin CHARACTERISTIC OutPCc08Mon_stCc08SfrmLss_C "F2531: Fault bit mask for SFRM check: only VFS should switch off [B0=Gen, B1=Plaus, B2=SB, B3=SG, B4=SGOP, B5=SBDFE, B6=SGDFE, B7=OPDFE, B8=Low, B9=High, B0=NSSTA, B11=NSDYN, B12=PRESGOP, B13=TEMPINCOR]" VAL_BLK 0x190518 AblGLKWBuw_S1 65535 X1_S1 0 65535 MATRIX_DIM 10 1 1 FORMAT "%8.2" /end CHARACTERISTIC
/begin CHARACTERISTIC OutPCc08Mon_stCc08SfrmPSply_C "F2531: Fault bit mask for SFRM check: PSply and VFS should switch off [B0=Gen, B1=Plaus, B2=SB, B3=SG, B4=SGOP, B5=SBDFE, B6=SGDFE, B7=OPDFE, B8=Low, B9=High, B10=NSSTA, B11=NSDYN, B12=PRESGOP, B13=TEMPINCOR]" VAL_BLK 0x19052C AblGLKWBuw_S1 65535 X1_S1 0 65535 MATRIX_DIM 10 1 1 FORMAT "%8.2" /end CHARACTERISTIC
/begin MEASUREMENT OutPCc08Mon_stCc08TstCond "F2531: Status of test condition for diagnosis purpose [B0=Gen, B1=Plaus, B2=SB, B3=SG, B4=SGOP, B5=SBDFE, B6=SGDFE, B7=OPDFE, B8=Low, B9=High, B10=NSSTA, B11=NSDYN, B12=PRESGOP, B13=TEMPINCOR]" UWORD X1_S1 1 100 0 65535 ECU_ADDRESS 0xFFF94364 FORMAT "%8.2" MATRIX_DIM 10 1 1 /end MEASUREMENT
/begin CHARACTERISTIC OutPCc08Mon_stCc08TstCond_C "F2531: Enable test condition [0=off, 1=on; B0=Gen, B1=Plaus, B2=SB, B3=SG, B4=SGOP, B5=SBDFE, B6=SGDFE, B7=OPDFE, B8=Low, B9=High, B10=NSSTA, B11=NSDYN, B12=PRESGOP, B13=TEMPINCOR]" VAL_BLK 0x190540 AblGLKWBuw_S1 65535 X1_S1 0 65535 MATRIX_DIM 10 1 1 FORMAT "%8.2" /end CHARACTERISTIC
/begin MEASUREMENT OutPCc08Mon_stCc08TstGen "F2531: Status of general test condition [0=undef, 1=Off, 2=Wait, 3=Sc, 4=ScCrnt]" UBYTE X1_S1 1 100 0 4 ECU_ADDRESS 0xFFF934DE FORMAT "%5.3" MATRIX_DIM 10 1 1 /end MEASUREMENT
/begin MEASUREMENT OutPCc08Mon_stHealSfrmFault "F2531: Status: SFRM report, no fault is present[0=Off, 1=On]" UWORD X1_S1 1 100 0 65535 ECU_ADDRESS 0xFFF934E8 FORMAT "%8.2" /end MEASUREMENT
/begin CHARACTERISTIC OutPCc08Mon_stPSplyErrOP_C "F2531: Relevance of VFS for PSply OP monitoring [B0=VFS0, B1=VFS1,.. ; 0=not relevant, 1=relevant]" VALUE 0x191522 AblGLKWuw_S1 1023 X1_S1 0 1023 FORMAT "%8.3" /end CHARACTERISTIC
/begin MEASUREMENT OutPCc08Mon_tiCc08NsDynErr "F2531: Fault filter timer for dynamical current flow" UBYTE TI1_M_CYCLE_S1 1 100 0 1275 ECU_ADDRESS 0xFFF941B4 FORMAT "%5.0" MATRIX_DIM 10 1 1 /end MEASUREMENT
/begin CHARACTERISTIC OutPCc08Mon_tiCc08NsDynErr_C "F2531: Start value of fault filter timer for dynamical current flow" VALUE 0x1918E9 AblGLKWub_S1 1275 TI1_M_CYCLE_S1 0 1275 FORMAT "%5.0" /end CHARACTERISTIC
/begin MEASUREMENT OutPCc08Mon_tiCc08TstFdbk "F2531: Filter for test condition if feedback signal is changing from 100%" UBYTE TI1_M_CYCLE_S1 1 100 0 1275 ECU_ADDRESS 0xFFF941BE FORMAT "%5.0" MATRIX_DIM 10 1 1 /end MEASUREMENT
/begin CHARACTERISTIC OutPCc08Mon_tiCc08TstFdbk_C "F2531: Start value of Filter for test condition if feedback signal is changing from 100%" VALUE 0x1918EA AblGLKWub_S1 1275 TI1_M_CYCLE_S1 0 1275 FORMAT "%5.0" /end CHARACTERISTIC
/begin CHARACTERISTIC OutPCc08Mon_uCc08TstCrntHi_C "F2531: Voltage threshold for test condition of current monitoring at high battery voltage" VALUE 0x191524 AblGLKWuw_S1 40 U0_001_S1 0 40 FORMAT "%8.5" /end CHARACTERISTIC
/begin CHARACTERISTIC OutPCc08Mon_uCc08TstCrntLo_C "F2531: Voltage threshold for test condition of current monitoring at low battery voltage" VALUE 0x191526 AblGLKWuw_S1 9 U0_001_S1 0 9 FORMAT "%8.6" /end CHARACTERISTIC
/begin CHARACTERISTIC OutPCc08Mon_uCc08TstSCHi_C "F2531: Voltage threshold for test condition to detect short circuit at high battery voltage" VALUE 0x191528 AblGLKWuw_S1 40 U0_001_S1 0 40 FORMAT "%8.5" /end CHARACTERISTIC
/begin CHARACTERISTIC OutPCc08Mon_uCc08TstSCLo_C "F2531: Voltage threshold for test condition to detect short circuit at low battery voltage" VALUE 0x19152A AblGLKWuw_S1 9 U0_001_S1 0 9 FORMAT "%8.6" /end CHARACTERISTIC
/begin MEASUREMENT OutPCc08Rat_rCc08Rat "F2531: Ratio RI/U at VFS to recognize 100% or 0% current mode" UWORD R0_0001_S1 1 100 0 2 ECU_ADDRESS 0xFFF930EC FORMAT "%8.6" MATRIX_DIM 10 1 1 /end MEASUREMENT
/begin CHARACTERISTIC OutPCc08Rat_rCc08RatFdbk_C "F2531: Ratio limit of feedback signal to recognize 100% current mode" VALUE 0x191730 AblGLKWuw_S1 100 R0_1_P_S1 0 100 FORMAT "%8.4" /end CHARACTERISTIC
/begin CHARACTERISTIC OutPCc08Rat_rCc08RatHys_C "F2531: Hysteresis for Ratio RI/U at VFS to recognize 100% or 0% current mode" VALUE 0x191732 AblGLKWuw_S1 1 R0_0001_S1 0 1 FORMAT "%8.6" /end CHARACTERISTIC
/begin CHARACTERISTIC OutPCc08Rat_rCc08Rat_C "F2531: Ratio RI/U at VFS to recognize 100% current mode (Limit) [0=deactive]" VAL_BLK 0x1913C8 AblGLKWBuw_S1 2 R0_0001_S1 0 2 MATRIX_DIM 10 1 1 FORMAT "%8.6" /end CHARACTERISTIC
/begin MEASUREMENT OutPCc08Rat_stCc08RatMode "F2531: Status RI/U at VFS to recognize 100% current mode [0=off, 1=PSply high, 2=constant, 3=change, 4=high ratio]" UBYTE X1_S1 1 100 0 4 ECU_ADDRESS 0xFFF93654 FORMAT "%5.3" MATRIX_DIM 10 1 1 /end MEASUREMENT
/begin CHARACTERISTIC OutPCc08Rat_uCc08RatActv_C "F2531: Voltage threshold to recognize 100% current mode" VAL_BLK 0x1913DC AblGLKWBuw_S1 32 U0_001_S1 0 32 MATRIX_DIM 10 1 1 FORMAT "%8.5" /end CHARACTERISTIC
/begin CHARACTERISTIC OutPCc08Rat_uCc08RatSplyHys_C "F2531: Hysteresis to recognize constant power supply voltage" VALUE 0x191734 AblGLKWuw_S1 5 U0_001_S1 0 5 FORMAT "%8.6" /end CHARACTERISTIC
/begin MEASUREMENT OutPCc08SGOP_sCc08DiffSGOP "F2531: Statemachine counter for short to ground and open load detection" UBYTE X1_S1 1 100 0 10 ECU_ADDRESS 0xFFF93576 FORMAT "%5.2" MATRIX_DIM 10 1 1 /end MEASUREMENT
/begin MEASUREMENT OutPCc08SGOP_stCc08DiffReq "F2531: Mode request for current control [0 = normal, 1 = filtering, 2 = Curr mode 0mA, 3 = switch mode off, 4 = fault entry]" UBYTE X1_S1 1 100 0 4 ECU_ADDRESS 0xFFF93580 FORMAT "%5.3" MATRIX_DIM 10 1 1 /end MEASUREMENT
/begin CHARACTERISTIC OutPCc08SGOP_stCc08DiffSC_C "F2531: Selection switch for short circuit detection [0=without NsDyn, 1=with NsDyn, 2=distinguishing between SG or OP]" VAL_BLK 0x19169C AblGLKWBub_S1 2 X1_S1 0 2 MATRIX_DIM 10 1 1 FORMAT "%5.3" /end CHARACTERISTIC
/begin MEASUREMENT OutPCc08SGOP_stCc08DiffSGOP "F2531: Result of short to ground and open pin differentiation [see documentation]" UBYTE X1_S1 1 100 0 48 ECU_ADDRESS 0xFFF9358A FORMAT "%5.2" MATRIX_DIM 10 1 1 /end MEASUREMENT
/begin MEASUREMENT OutPCc08SGOP_stCc08HldFault "F2531: Status for keeping faults [0= no fault, 32=SB, 36= SG,OP,NsDyn]" UBYTE X1_S1 1 100 0 255 ECU_ADDRESS 0xFFF93594 FORMAT "%5.1" MATRIX_DIM 10 1 1 /end MEASUREMENT
/begin MEASUREMENT OutPCc08SGOP_tiCc08DiffDly "F2531: Internal delay timer of short to ground and open load detection" UBYTE TI1_M_CYCLE_S1 1 100 0 1275 ECU_ADDRESS 0xFFF941E8 FORMAT "%5.0" MATRIX_DIM 10 1 1 /end MEASUREMENT
/begin CHARACTERISTIC OutPCc08SGOP_tiCc08DiffDly_C[0] "F2531: Start value for internal delay timer of short to ground and open load detection" CURVE 0x19129C AblGLKLuw_S1 50 TI1_M_CYCLE_S1 0 50
 /begin AXIS_DESCR STD_AXIS OutPCc08SGOP_uCc08DiffPSply U0_001_S1 3 0 32 DEPOSIT ABSOLUTE FORMAT "%8.5" /end AXIS_DESCR
 FORMAT "%8.5" /end CHARACTERISTIC
/begin CHARACTERISTIC OutPCc08SGOP_tiCc08DiffDly_C[1] "F2531: Start value for internal delay timer of short to ground and open load detection" CURVE 0x1912AA AblGLKLuw_S1 50 TI1_M_CYCLE_S1 0 50
 /begin AXIS_DESCR STD_AXIS OutPCc08SGOP_uCc08DiffPSply U0_001_S1 3 0 32 DEPOSIT ABSOLUTE FORMAT "%8.5" /end AXIS_DESCR
 FORMAT "%8.5" /end CHARACTERISTIC
/begin MEASUREMENT OutPCc08SGOP_tiCc08DiffSGOP "F2531: Fault filter timer of short to ground and open load detection" UBYTE TI1_M_CYCLE_S1 1 100 0 250 ECU_ADDRESS 0xFFF941F2 FORMAT "%5.1" MATRIX_DIM 10 1 1 /end MEASUREMENT
/begin CHARACTERISTIC OutPCc08SGOP_tiCc08DiffSGOP_C "F2531: Start value for fault filter timer of short to ground and open load detection" VAL_BLK 0x1916A6 AblGLKWBub_S1 250 TI1_M_CYCLE_S1 0 250 MATRIX_DIM 10 1 1 FORMAT "%5.1" /end CHARACTERISTIC
/begin MEASUREMENT OutPCc08SGOP_tiCc08HldFault "F2531: Timer for keeping faults" UBYTE TI1_M_CYCLE_S1 1 100 0 1275 ECU_ADDRESS 0xFFF941FC FORMAT "%5.0" MATRIX_DIM 10 1 1 /end MEASUREMENT
/begin CHARACTERISTIC OutPCc08SGOP_tiCc08HldFault_C "F2531: Start value for timer for keeping faults" VALUE 0x1919D8 AblGLKWub_S1 1275 TI1_M_CYCLE_S1 0 1275 FORMAT "%5.0" /end CHARACTERISTIC
/begin MEASUREMENT OutPCc08SGOP_uCc08DiffPSply "F2531: PSply voltage for a selected channel (only internal)" UWORD U0_001_S1 1 100 0 32 ECU_ADDRESS 0xFFF9359E FORMAT "%8.5" /end MEASUREMENT
/begin CHARACTERISTIC OutPCc08SGOP_uCc08DiffSGOP_C "F2531: Voltage threshold to activate short to ground and open load detection" VALUE 0x1916B0 AblGLKWuw_S1 25 U0_001_S1 0 25 FORMAT "%8.5" /end CHARACTERISTIC
/begin MEASUREMENT OutPLssCtl_iLssIn "F2525: Current input value for low side control" UWORD I0_0001_S1 1 100 0 3.2 ECU_ADDRESS 0xFFF934EA FORMAT "%8.6" MATRIX_DIM 5 1 1 /end MEASUREMENT
/begin MEASUREMENT OutPLssCtl_rLssIn "F2525: PWM or binary input value for low side control [0=Off, >1=On]" UWORD R0_1_P_S1 1 100 0 100 ECU_ADDRESS 0xFFF948BA FORMAT "%8.4" MATRIX_DIM 5 1 1 /end MEASUREMENT
/begin CHARACTERISTIC OutPLssCtl_stLssAvl_C "F2525: Solenoid active [B0: Lss channel 0, B1: ...; 0=Deactivate, 1=Active]" VALUE 0x1918EB AblGLKWub_S1 31 X1_S1 0 31 FORMAT "%5.2" /end CHARACTERISTIC
/begin CHARACTERISTIC OutPLssCtl_stLssDnConn_C "F2525: Connection between Lss and DN [B0: Lss channel 0, B1: ...; 0=Not connected, 1=Connected]" VALUE 0x1918EC AblGLKWub_S1 31 X1_S1 0 31 FORMAT "%5.2" /end CHARACTERISTIC
/begin MEASUREMENT OutPLssCtl_stLssOut "F2525: Output status of low side control for SFRM [0=Off, 1=On/PWM, 2=On with 100%]" UBYTE X1_S1 1 100 0 2 ECU_ADDRESS 0xFFF94906 FORMAT "%5.3" MATRIX_DIM 5 1 1 /end MEASUREMENT
/begin MEASUREMENT OutPLssCtl_stLssOutL3 "F2525: Output status of low side control [0=Off, 1=On/PWM, 2=On with 100%]" UBYTE X1_S1 1 100 0 2 ECU_ADDRESS 0xFFF9490B FORMAT "%5.3" MATRIX_DIM 5 1 1 /end MEASUREMENT
/begin MEASUREMENT OutPLssCtl_stLssReqOff "F2525: Request to switch Lss off [B0: Lss channel 0, B1: ...; 0=Off, 1=On]" UBYTE X1_S1 1 100 0 31 ECU_ADDRESS 0xFFF93B1E FORMAT "%5.2" /end MEASUREMENT
/begin MEASUREMENT OutPLssCtl_stLssReqOn "F2525: Request to switch Lss on [B0: Lss channel 0, B1: ...; 0=Off, 1=On]" UBYTE X1_S1 1 100 0 31 ECU_ADDRESS 0xFFF93B1F FORMAT "%5.2" /end MEASUREMENT
/begin CHARACTERISTIC OutPLssCtl_stLssReqPSply_C "F2525: Active channels for request on demand from PSply [B0: Lss channel 0, B1: ...; 0=Off, 1=On]" VALUE 0x1918ED AblGLKWub_S1 31 X1_S1 0 31 FORMAT "%5.2" /end CHARACTERISTIC
/begin CHARACTERISTIC OutPLssCtl_uLssThresT15Hys_C "F2525: Hysteresisvoltage for Terminal 15 supply" VALUE 0x19152C AblGLKWuw_S1 10 U0_001_S1 0 10 FORMAT "%8.5" /end CHARACTERISTIC
/begin CHARACTERISTIC OutPLssCtl_uLssThresT15_C "F2525: Voltage threshold for Terminal 15 supply" VALUE 0x19152E AblGLKWuw_S1 32 U0_001_S1 0 32 FORMAT "%8.5" /end CHARACTERISTIC
/begin CHARACTERISTIC OutPLssCtl_uLssThresT30Hys_C "F2525: Hysteresisvoltage for Terminal 30 supply" VALUE 0x191530 AblGLKWuw_S1 10 U0_001_S1 0 10 FORMAT "%8.5" /end CHARACTERISTIC
/begin CHARACTERISTIC OutPLssCtl_uLssThresT30_C "F2525: Voltage threshold for Terminal 30 supply" VALUE 0x191532 AblGLKWuw_S1 32 U0_001_S1 0 32 FORMAT "%8.5" /end CHARACTERISTIC
/begin CHARACTERISTIC OutPLssDuty_facLssCrnt_C "F2525: Correction factor of PWM calculation from current value" VAL_BLK 0x191534 AblGLKWBuw_S1 40 R0_1_P_S1 80 120 MATRIX_DIM 5 1 1 FORMAT "%8.4" /end CHARACTERISTIC
/begin MEASUREMENT OutPLssDuty_rLssDuty "F2525: Duty cycle of solenoid" UWORD R0_1_P_S1 1 100 0 100 ECU_ADDRESS 0xFFF948C4 FORMAT "%8.4" MATRIX_DIM 5 1 1 /end MEASUREMENT
/begin MEASUREMENT OutPLssDuty_stLssActv "F2525: Solenoid active [0=Off, 1=On/PWM, 2=On with 100%]" UBYTE X1_S1 1 100 0 2 ECU_ADDRESS 0xFFF94910 FORMAT "%5.3" MATRIX_DIM 5 1 1 /end MEASUREMENT
/begin CHARACTERISTIC OutPLssDuty_stLssDutyLtdMax_C "F2525: Increase solenoid control above max. duty [B0: Lss channel 0, B1: ...; 0=No change, 1=Jump to 100%]" VALUE 0x1918EE AblGLKWub_S1 31 X1_S1 0 31 FORMAT "%5.2" /end CHARACTERISTIC
/begin CHARACTERISTIC OutPLssDuty_stLssDutyLtdMin_C "F2525: Increase solenoid control below min. duty [B0: Lss channel 0, B1: ...; 0=No change, 1=Jump to min. duty]" VALUE 0x1918EF AblGLKWub_S1 31 X1_S1 0 31 FORMAT "%5.2" /end CHARACTERISTIC
/begin CHARACTERISTIC OutPLssDuty_stLssMode_C "F2525:Operation mode solenoid [0=Switch on/off, 1=PWM dependent on voltage, 2=PWM, 3=By current]" VAL_BLK 0x1918F0 AblGLKWBub_S1 3 X1_S1 0 3 MATRIX_DIM 5 1 1 FORMAT "%5.3" /end CHARACTERISTIC
/begin CHARACTERISTIC OutPLssDuty_stLssSelSply_C "F2525: Selection for solenoid supply [-2=T30, -1=T15, 0=PSply channel 0, 1=PSply channel 1, ...]" VAL_BLK 0x1918F5 AblGLKWBsb_S1 3 X1_S1 -2 1 MATRIX_DIM 5 1 1 FORMAT "%5.3" /end CHARACTERISTIC
/begin MEASUREMENT OutPLssDuty_tAtf "F2525: Oil temperature" SWORD T0_0625_S1 1 100 -40 215 ECU_ADDRESS 0xFFF948CE FORMAT "%8.4" /end MEASUREMENT
/begin MEASUREMENT OutPLssDuty_tiLssPk "F2525: Time of switch on peak" UBYTE TI1_M_CYCLE_S1 1 100 0 1275 ECU_ADDRESS 0xFFF9422E FORMAT "%5.0" MATRIX_DIM 5 1 1 /end MEASUREMENT
/begin MEASUREMENT OutPLssDuty_tiLssPkCpl "F2525: Time of switch on peak (2nd timer)" UBYTE TI1_M_CYCLE_S1 1 100 0 1275 ECU_ADDRESS 0xFFF94233 FORMAT "%5.0" MATRIX_DIM 5 1 1 /end MEASUREMENT
/begin CHARACTERISTIC OutPLssDuty_tiLssPk_C "F2525: Solenoid duration of peak [0=No peak function active]" VAL_BLK 0x1918FA AblGLKWBub_S1 1275 TI1_M_CYCLE_S1 0 1275 MATRIX_DIM 5 1 1 FORMAT "%5.0" /end CHARACTERISTIC
/begin CHARACTERISTIC OutPLssDuty_uLssDutyRef_C[0] "F2525: Reference voltage for solenoids (characteristic curve is dependent on oil temperature)" CURVE 0x19153E AblGLKLsw_S1 31.5 U0_001_S1 0.5 32
 /begin AXIS_DESCR STD_AXIS OutPLssDuty_tAtf T0_0625_S1 2 -40 215 DEPOSIT ABSOLUTE FORMAT "%8.4" /end AXIS_DESCR
 FORMAT "%8.5" /end CHARACTERISTIC
/begin CHARACTERISTIC OutPLssDuty_uLssDutyRef_C[1] "F2525: Reference voltage for solenoids (characteristic curve is dependent on oil temperature)" CURVE 0x191548 AblGLKLsw_S1 31.5 U0_001_S1 0.5 32
 /begin AXIS_DESCR STD_AXIS OutPLssDuty_tAtf T0_0625_S1 2 -40 215 DEPOSIT ABSOLUTE FORMAT "%8.4" /end AXIS_DESCR
 FORMAT "%8.5" /end CHARACTERISTIC
/begin CHARACTERISTIC OutPLssDuty_uLssDutyRef_C[2] "F2525: Reference voltage for solenoids (characteristic curve is dependent on oil temperature)" CURVE 0x191552 AblGLKLsw_S1 31.5 U0_001_S1 0.5 32
 /begin AXIS_DESCR STD_AXIS OutPLssDuty_tAtf T0_0625_S1 2 -40 215 DEPOSIT ABSOLUTE FORMAT "%8.4" /end AXIS_DESCR
 FORMAT "%8.5" /end CHARACTERISTIC
/begin CHARACTERISTIC OutPLssDuty_uLssDutyRef_C[3] "F2525: Reference voltage for solenoids (characteristic curve is dependent on oil temperature)" CURVE 0x19155C AblGLKLsw_S1 31.5 U0_001_S1 0.5 32
 /begin AXIS_DESCR STD_AXIS OutPLssDuty_tAtf T0_0625_S1 2 -40 215 DEPOSIT ABSOLUTE FORMAT "%8.4" /end AXIS_DESCR
 FORMAT "%8.5" /end CHARACTERISTIC
/begin CHARACTERISTIC OutPLssDuty_uLssDutyRef_C[4] "F2525: Reference voltage for solenoids (characteristic curve is dependent on oil temperature)" CURVE 0x191566 AblGLKLsw_S1 31.5 U0_001_S1 0.5 32
 /begin AXIS_DESCR STD_AXIS OutPLssDuty_tAtf T0_0625_S1 2 -40 215 DEPOSIT ABSOLUTE FORMAT "%8.4" /end AXIS_DESCR
 FORMAT "%8.5" /end CHARACTERISTIC
/begin MEASUREMENT OutPLssDuty_xLssIn "F2525: Duty cycle or current signal of solenoid" UWORD X1_S1 1 100 0 32000 ECU_ADDRESS 0xFFF948D0 FORMAT "%8.2" MATRIX_DIM 5 1 1 /end MEASUREMENT
/begin CHARACTERISTIC OutPLssMon_stLssChkHw_C "F2525: Hardware status evaluation at 100% PWM active [B0: Lss channel 0, B1: ...; 0=Deactivate, 1=Active]" VALUE 0x1919ED AblGLKWub_S1 31 X1_S1 0 31 FORMAT "%5.2" /end CHARACTERISTIC
/begin CHARACTERISTIC OutPLssMon_stLssDetSGOP_C "F2525: Detection of SGOP if a SG or OP fault cannot be distinguished [B0: Lss channel 0, ...]" VALUE 0x1919EE AblGLKWub_S1 31 X1_S1 0 31 FORMAT "%5.2" /end CHARACTERISTIC
/begin MEASUREMENT OutPLssMon_stLssFault "F2525: Status of fault [B2: SB, B3: SG, B4: OP, B5: SGOP, B6: SGDFE, B7: SBDFE]" UWORD X1_S1 1 100 0 65535 ECU_ADDRESS 0xFFF9439E FORMAT "%8.2" MATRIX_DIM 5 1 1 /end MEASUREMENT
/begin MEASUREMENT OutPLssMon_stLssSfrm "F2525: Fault status for SFRM [0=No fault, 1=Switch off low sides, 2=Switch off low sides and PSply]" UBYTE X1_S1 1 100 0 2 ECU_ADDRESS 0xFFF93B8F FORMAT "%5.3" MATRIX_DIM 5 1 1 /end MEASUREMENT
/begin CHARACTERISTIC OutPLssMon_stLssSfrmLss_C "F2525: Fault bit mask for SFRM check: only Lss should switch off [B2: SB, B3: SG, B4: OP, B5: SGOP, B6: SGDFE, B7: SBDFE]" VAL_BLK 0x191802 AblGLKWBuw_S1 65535 X1_S1 0 65535 MATRIX_DIM 5 1 1 FORMAT "%8.2" /end CHARACTERISTIC
/begin CHARACTERISTIC OutPLssMon_stLssSfrmPSply_C "F2525: Fault bit mask for SFRM check: PSply and Lss should switch off [B2: SB, B3: SG, B4: OP, B5: SGOP, B6: SGDFE, B7: SBDFE]" VAL_BLK 0x19180C AblGLKWBuw_S1 65535 X1_S1 0 65535 MATRIX_DIM 5 1 1 FORMAT "%8.2" /end CHARACTERISTIC
/begin MEASUREMENT OutPLssMon_stLssTstCond "F2525: Status of test condition [B2: SB, B3: SG, B4: OP, B5: SGOP, B6: SGDFE, B7: SBDFE]" UWORD X1_S1 1 100 0 65535 ECU_ADDRESS 0xFFF943A8 FORMAT "%8.2" MATRIX_DIM 5 1 1 /end MEASUREMENT
/begin CHARACTERISTIC OutPLssMon_stLssTstCond_C "F2525: Enable test condition [B2: SB, B3: SG, B4: OP, B5: SGOP, B6: SGDFE, B7: SBDFE; 0=Off, 1=On]" VAL_BLK 0x191816 AblGLKWBuw_S1 65535 X1_S1 0 65535 MATRIX_DIM 5 1 1 FORMAT "%8.2" /end CHARACTERISTIC
/begin CHARACTERISTIC OutPLssMon_stPSplyErrOP_C "F2525: Relevance of LSS for PSply OP monitoring [B0=LSS0, B1=LSS1,.. ; 0=not relevant, 1=relevant]" VALUE 0x1919EF AblGLKWub_S1 31 X1_S1 0 31 FORMAT "%5.2" /end CHARACTERISTIC
/begin MEASUREMENT OutPLssMon_tiLssChng "F2525: Time since input signal has changed" UBYTE TI1_M_CYCLE_S1 1 100 0 1275 ECU_ADDRESS 0xFFF9424B FORMAT "%5.0" MATRIX_DIM 5 1 1 /end MEASUREMENT
/begin CHARACTERISTIC OutPLssMon_tiLssChng_C "F2525: Start value for monitoring delay at control value change" VAL_BLK 0x1919F0 AblGLKWBub_S1 1275 TI1_M_CYCLE_S1 0 1275 MATRIX_DIM 5 1 1 FORMAT "%5.0" /end CHARACTERISTIC
/begin MEASUREMENT OutPLssMon_tiLssSplyOn "F2525: Lag counter at T15 or T30 on" UBYTE TI1_M_CYCLE_S1 1 100 0 1275 ECU_ADDRESS 0xFFF94250 FORMAT "%5.0" MATRIX_DIM 5 1 1 /end MEASUREMENT
/begin CHARACTERISTIC OutPLssMon_tiLssSplyOn_C "F2525: Start value for monitoring delay, if T15 or T30 is used" VAL_BLK 0x1919F5 AblGLKWBub_S1 1275 TI1_M_CYCLE_S1 0 1275 MATRIX_DIM 5 1 1 FORMAT "%5.0" /end CHARACTERISTIC
/begin CHARACTERISTIC OutPLssMon_uLssTstHi_C "F2525: Upper voltage threshold of test condition" VAL_BLK 0x191820 AblGLKWBuw_S1 40 U0_001_S1 0 40 MATRIX_DIM 5 1 1 FORMAT "%8.5" /end CHARACTERISTIC
/begin CHARACTERISTIC OutPLssMon_uLssTstLo_C "F2525: Lower voltage threshold of test condition" VAL_BLK 0x19182A AblGLKWBuw_S1 32 U0_001_S1 0 32 MATRIX_DIM 5 1 1 FORMAT "%8.5" /end CHARACTERISTIC
/begin CHARACTERISTIC OutPLssMon_uLssTstOP_C "F2525: Voltage threshold for open pin detection" VAL_BLK 0x191834 AblGLKWBuw_S1 10 U0_001_S1 0 10 MATRIX_DIM 5 1 1 FORMAT "%8.5" /end CHARACTERISTIC
/begin CHARACTERISTIC OutPLssMon_uLssTstSB_C "F2525: Voltage threshold for short to battery detection" VAL_BLK 0x19183E AblGLKWBuw_S1 31 U0_001_S1 1 32 MATRIX_DIM 5 1 1 FORMAT "%8.5" /end CHARACTERISTIC
/begin CHARACTERISTIC OutPLssMon_uLssTstSG_C "F2525: Voltage threshold for short to ground detection" VAL_BLK 0x191848 AblGLKWBuw_S1 3 U0_001_S1 0 3 MATRIX_DIM 5 1 1 FORMAT "%8.6" /end CHARACTERISTIC
/begin MEASUREMENT OutPOpsCtl_cntRepIpt "F2520: left number of possible IPT repetitions" UBYTE X1_S1 1 100 0 255 ECU_ADDRESS 0xFFF93B67 FORMAT "%5.1" /end MEASUREMENT
/begin CHARACTERISTIC OutPOpsCtl_numRepIpt_C "F2520: number of IPT repetitions if IPT fails" VALUE 0x1919D9 AblGLKWub_S1 255 X1_S1 0 255 FORMAT "%5.1" /end CHARACTERISTIC
/begin MEASUREMENT OutPOpsCtl_sOpsMode "F2520: Mode of the OPS: 0x00: OPS_INIT; 0x1F:OPS_NONOP;  0x2E:OPS_OP; 0x3D:OPS_ACTIVE_OFF;0x4C: OPS_ACTIVE_ON" UBYTE X1_S1 1 100 0 76 ECU_ADDRESS 0xFFF9491C FORMAT "%5.2" /end MEASUREMENT
/begin MEASUREMENT OutPOpsCtl_stOpsFault "F2520: DSM fault condition; B9: unexpected DN-Reset, B8: IPT Final Evaluation,B7:Hss IWD deact-test, B6:Hss actv-test, B5:PClk-test, B4:Lss actv. prev.-test, B3:Hss actv. prev.-test, B2:Hss short-test, B1:DN-test, B0:Tst-prep" UWORD X1_S1 1 100 0 65535 ECU_ADDRESS 0xFFF935C2 FORMAT "%8.2" /end MEASUREMENT
/begin MEASUREMENT OutPOpsCtl_stOpsTstCond "F2520: DSM test condition; B9: unexpected DN-Reset, B8: IPT Final Evaluation,B7:Hss IWD deact-test, B6:Hss actv-test, B5:PClk-test, B4:Lss actv. prev.-test, B3:Hss actv. prev.-test, B2:Hss short-test, B1:DN-test, B0:Tst-prep" UWORD X1_S1 1 100 0 65535 ECU_ADDRESS 0xFFF935C4 FORMAT "%8.2" /end MEASUREMENT
/begin CHARACTERISTIC OutPOpsCtl_swtBypIpt_C "F2520: Disable / Bypass Inhibit Path Test (Key 0xC3)" VALUE 0x1919DA AblGLKWub_S1 195 X1_S1 0 195 FORMAT "%5.1" /end CHARACTERISTIC
/begin CHARACTERISTIC OutPOpsCtl_uUndrBatt_C "F2520: Voltage threshold to enable DN Reset faultreport" VALUE 0x1916B2 AblGLKWuw_S1 32.767 U0_001_S1 0 32.767 FORMAT "%8.5" /end CHARACTERISTIC
/begin MEASUREMENT OutPOpsCtl_xPSplySafRlvnt "F2520: safety relevance of PSply channels, array over safety relevance; bitcoded channels" UWORD X1_S1 1 100 0 65535 ECU_ADDRESS 0xFFF94878 FORMAT "%8.2" MATRIX_DIM 4 1 1 /end MEASUREMENT
/begin MEASUREMENT OutPOpsTst_sIpt "F2520: Status of IPT: B09:hold (low uBatt), B8:final eval., B7:Hss IWD deact-test, B6:Hss actv-test, B5:PClk-test, B4:Lss actv. prev.-test, B3:Hss actv. prev.-test, B2:Hss short-test, B1:DN-test, B0:Tst-prep" UWORD X1_S1 1 100 0 65535 ECU_ADDRESS 0xFFF948F2 FORMAT "%8.2" /end MEASUREMENT
/begin MEASUREMENT OutPOpsTst_sIptPreHld "F2520: Ipt test state" UWORD X1_S1 1 100 0 65535 ECU_ADDRESS 0xFFF935C6 FORMAT "%8.2" /end MEASUREMENT
/begin MEASUREMENT OutPOpsTst_stPSplyRngFault "F2520: PSply fault range; array over ECE_PSPLY_PUB_NUM_SY; 0x11=SG, 0x22=OP, 0x33=SB, 0x44=Undef_Lo, 0x55=Undef_Hi" UBYTE X1_S1 1 100 0 255 ECU_ADDRESS 0xFFF935C8 FORMAT "%5.1" MATRIX_DIM 2 1 1 /end MEASUREMENT
/begin MEASUREMENT OutPOpsTst_stSucTstMsk "F2520: Bitwise marking of successfully passed tests B8: Final Evaluation, B7: Hss IWD deact-test, B6: Hss actv-test, B5: PClk-test, B4: Lss actv. prevent.-test, B3: Hss actv. prevent.-test, B2: Hss pinline-test, B1: DN-test, B0: preparation" UWORD X1_S1 1 100 0 16 ECU_ADDRESS 0xFFF935CA FORMAT "%8.5" /end MEASUREMENT
/begin MEASUREMENT OutPOpsTst_stTst "F2520: IPT-Status 00 Idle;40 Hold; 55 NEXT_STEP; AA SUCCESS; F0 ERR_GEN;F1 ERR_IWD;F2 ERR_PSPLY;F3 ERR_LSS;F4 ERR_DN;F5 ERR UBAT;F6 ERR_TOUT;30 WAIT_PCLK;31 WAIT_IWD;32 WAIT_PCLK;33 WAIT_DN;34 WAIT_PSPLY" UBYTE X1_S1 1 100 0 255 ECU_ADDRESS 0xFFF9491D FORMAT "%5.1" /end MEASUREMENT
/begin MEASUREMENT OutPOpsTst_stTstPreHld "F2520: Ipt test state" UBYTE X1_S1 1 100 0 255 ECU_ADDRESS 0xFFF93B68 FORMAT "%5.1" /end MEASUREMENT
/begin CHARACTERISTIC OutPOpsTst_swtDbgEnbl_C "F2520: Enable debug-mode of Inhibit-Path-Test" VALUE 0x1916B4 AblGLKWuw_S1 165 X1_S1 0 165 FORMAT "%8.4" /end CHARACTERISTIC
/begin MEASUREMENT OutPOpsTst_tiDnTOut "F2520: Timeout for DN-Reset-Line" UBYTE TI1_M_CYCLE_S1 1 100 0 1275 ECU_ADDRESS 0xFFF94242 FORMAT "%5.0" /end MEASUREMENT
/begin CHARACTERISTIC OutPOpsTst_tiDnTOut_C "F2520: Timeout-value for DN-Reset-Line" VALUE 0x1919DB AblGLKWub_S1 1275 TI1_M_CYCLE_S1 0 1275 FORMAT "%5.0" /end CHARACTERISTIC
/begin MEASUREMENT OutPOpsTst_tiIptTOut "F2520: DwnCnt for Test-Timeout" UBYTE TI1_M_CYCLE_S1 1 100 0 1275 ECU_ADDRESS 0xFFF94243 FORMAT "%5.0" /end MEASUREMENT
/begin MEASUREMENT OutPOpsTst_tiIptTOutPreHld "F2520: Internal value down counter for ipt test timeout" UBYTE X1_S1 1 100 0 255 ECU_ADDRESS 0xFFF93B69 FORMAT "%5.1" /end MEASUREMENT
/begin CHARACTERISTIC OutPOpsTst_tiIptTOut_C "F2520: Time for Test-Timeout" VALUE 0x1919DC AblGLKWub_S1 1275 TI1_M_CYCLE_S1 0 1275 FORMAT "%5.0" /end CHARACTERISTIC
/begin MEASUREMENT OutPOpsTst_tiPSplyTOut "F2520: DwnCnt for Hss-Timeout" UBYTE TI1_M_CYCLE_S1 1 100 0 150 ECU_ADDRESS 0xFFF94244 FORMAT "%5.1" /end MEASUREMENT
/begin MEASUREMENT OutPOpsTst_tiPSplyTOutPreHld "F2520: Internal value down counter for psply test timeout" UBYTE X1_S1 1 100 0 255 ECU_ADDRESS 0xFFF93B6A FORMAT "%5.1" /end MEASUREMENT
/begin CHARACTERISTIC OutPOpsTst_tiPSplyTOut_C "F2520: Hss Timeout" VALUE 0x1919DD AblGLKWub_S1 500 TI1_M_CYCLE_S1 0 500 FORMAT "%5.1" /end CHARACTERISTIC
/begin CHARACTERISTIC OutPOpsTst_uBattIptMax_C "F2520: maximal battery voltage limit for inhibit-path-test (IPT)" VALUE 0x1916B6 AblGLKWuw_S1 65.535 U0_001_S1 0 65.535 FORMAT "%8.5" /end CHARACTERISTIC
/begin CHARACTERISTIC OutPOpsTst_uBattIptMin_C "F2520: minimal battery voltage limit for inhibit-path-test (IPT)" VALUE 0x1916B8 AblGLKWuw_S1 10 U0_001_S1 0 10 FORMAT "%8.5" /end CHARACTERISTIC
/begin MEASUREMENT OutPPSplyCtl_bOpsDn "F2523: Information from the OPS about the  DN-Status (0= no reset; 1= reset)" UBYTE B_TRUE_S1 1 100 0 1 ECU_ADDRESS 0xFFF94915 FORMAT "%13.11" /end MEASUREMENT
/begin MEASUREMENT OutPPSplyCtl_bPSplyIn "F2523: Request to activate PSply [0=off, 1=on]" UBYTE B_TRUE_S1 1 100 0 1 ECU_ADDRESS 0xFFF948DA FORMAT "%13.11" MATRIX_DIM 2 1 1 /end MEASUREMENT
/begin MEASUREMENT OutPPSplyCtl_bPSplyOut "F2523: Control value of PSply for SFRM [0=off, 1=on]" UBYTE B_TRUE_S1 1 100 0 1 ECU_ADDRESS 0xFFF948DC FORMAT "%13.11" MATRIX_DIM 2 1 1 /end MEASUREMENT
/begin MEASUREMENT OutPPSplyCtl_bPSplyOutL3 "F2523: Control value of PSply [0=off, 1=on]" UBYTE B_TRUE_S1 1 100 0 1 ECU_ADDRESS 0xFFF948DE FORMAT "%13.11" MATRIX_DIM 2 1 1 /end MEASUREMENT
/begin MEASUREMENT OutPPSplyCtl_sPSplyMode "F2523: Status of PSply [11h=INIT,16h=INIT_END,22h=NONOP,33h=OP,34h=ERROR_OFF,38h=UBATT_OFF,3Fh=DSM_OFF,44h=ACTIVE_ON,55h=ACTIVE_OFF]" UBYTE X1_S1 1 100 0 85 ECU_ADDRESS 0xFFF948E0 FORMAT "%5.2" MATRIX_DIM 2 1 1 /end MEASUREMENT
/begin MEASUREMENT OutPPSplyCtl_stLdOpsOn "F2523: Request from OPS to activate all load of a PSply (ini test) [B0=Loads of PSply0, B1=Loads of PSply1,...]" UBYTE X1_S1 1 100 0 3 ECU_ADDRESS 0xFFF93B20 FORMAT "%5.3" /end MEASUREMENT
/begin MEASUREMENT OutPPSplyCtl_stLdPSplyOn "F2523: Request to activate all loads of a PSply (ini test) [B0=Loads of PSply0, B1=Loads of PSply1,...]" UBYTE X1_S1 1 100 0 3 ECU_ADDRESS 0xFFF93B21 FORMAT "%5.3" /end MEASUREMENT
/begin MEASUREMENT OutPPSplyCtl_stOpsFault "F2523: OPS delivers wrong detected PSPLY_RNG" UBYTE X1_S1 1 100 0 3 ECU_ADDRESS 0xFFF934F4 FORMAT "%5.3" MATRIX_DIM 2 1 1 /end MEASUREMENT
/begin CHARACTERISTIC OutPPSplyCtl_stPSplyAvl_C "F2523: Power supply available [[B0=PSply0, B1=PSply1,...; 0=not available, 1=available]" VALUE 0x1918FF AblGLKWub_S1 3 X1_S1 0 3 FORMAT "%5.3" /end CHARACTERISTIC
/begin MEASUREMENT OutPPSplyCtl_stPSplyBattLo "F2523: Status switch off of PSply at low battery voltage [B0=PSply0, B1=PSply1...]" UBYTE X1_S1 1 100 0 3 ECU_ADDRESS 0xFFF93B22 FORMAT "%5.3" /end MEASUREMENT
/begin MEASUREMENT OutPPSplyCtl_stPSplyBattLoCpl "F2523: Status (for complement) switch off of PSply at low battery voltage [B0=PSply0, B1=PSply1...]" UBYTE X1_S1 1 100 0 3 ECU_ADDRESS 0xFFF93B23 FORMAT "%5.3" /end MEASUREMENT
/begin MEASUREMENT OutPPSplyCtl_stPSplyIni "F2523: Ini-state of PSply (bit coded)" UBYTE X1_S1 1 100 0 255 ECU_ADDRESS 0xFFF93B24 FORMAT "%5.1" /end MEASUREMENT
/begin MEASUREMENT OutPPSplyCtl_stPSplyOpsOn "F2523: Request to activate PSply during ini test [0=off, 1=on]" UBYTE X1_S1 1 100 0 1 ECU_ADDRESS 0xFFF934F6 FORMAT "%5.3" MATRIX_DIM 2 1 1 /end MEASUREMENT
/begin CHARACTERISTIC OutPPSplyCtl_stPSplySaf_C "F2523: PSply safety status: 0=not connected, 1=connected, 2=connected and relevant" VAL_BLK 0x191570 AblGLKWBub_S1 2 X1_S1 0 2 MATRIX_DIM 2 1 1 FORMAT "%5.3" /end CHARACTERISTIC
/begin MEASUREMENT OutPPSplyCtl_stPSplySt "F2523: Status of PSply mode secure on/off [1=off, 2=InitOn, 3=DrvChg, 4=DrvOn]" UBYTE X1_S1 1 100 0 4 ECU_ADDRESS 0xFFF934F8 FORMAT "%5.3" MATRIX_DIM 2 1 1 /end MEASUREMENT
/begin MEASUREMENT OutPPSplyCtl_tiPSplyBattLo "F2523: Timer for PSply switch off during low battery voltage" UBYTE TI1_M_CYCLE_S1 1 100 0 1275 ECU_ADDRESS 0xFFF941C8 FORMAT "%5.0" MATRIX_DIM 2 1 1 /end MEASUREMENT
/begin MEASUREMENT OutPPSplyCtl_tiPSplyBattLoCpl "F2523: Timer (for complement) for PSply switch off during low battery voltage" UBYTE TI1_M_CYCLE_S1 1 100 0 1275 ECU_ADDRESS 0xFFF941CA FORMAT "%5.0" MATRIX_DIM 2 1 1 /end MEASUREMENT
/begin CHARACTERISTIC OutPPSplyCtl_tiPSplyBattLoStrt_C "F2523: Start value for timer for PSply switch off during low battery voltage after system start" VAL_BLK 0x191572 AblGLKWBub_S1 1275 TI1_M_CYCLE_S1 0 1275 MATRIX_DIM 2 1 1 FORMAT "%5.0" /end CHARACTERISTIC
/begin CHARACTERISTIC OutPPSplyCtl_tiPSplyBattLo_C "F2523: Start value for PSply switch off timer during low battery voltage" VAL_BLK 0x191574 AblGLKWBub_S1 1275 TI1_M_CYCLE_S1 0 1275 MATRIX_DIM 2 1 1 FORMAT "%5.0" /end CHARACTERISTIC
/begin MEASUREMENT OutPPSplyCtl_tiPSplyChng "F2523: Counter for control value changing" UBYTE TI1_M_CYCLE_S1 1 100 0 1275 ECU_ADDRESS 0xFFF941CC FORMAT "%5.0" MATRIX_DIM 2 1 1 /end MEASUREMENT
/begin CHARACTERISTIC OutPPSplyCtl_tiPSplyChngOff_C "F2523: Power supply switch off stabilization time" VAL_BLK 0x191576 AblGLKWBub_S1 100 TI1_M_CYCLE_S1 0 100 MATRIX_DIM 2 1 1 FORMAT "%5.1" /end CHARACTERISTIC
/begin CHARACTERISTIC OutPPSplyCtl_tiPSplyChngOn_C "F2523: Power supply switch on stabilization time" VAL_BLK 0x191578 AblGLKWBub_S1 100 TI1_M_CYCLE_S1 0 100 MATRIX_DIM 2 1 1 FORMAT "%5.1" /end CHARACTERISTIC
/begin MEASUREMENT OutPPSplyCtl_tiPSplyPrtSG "F2523: Timer for HW protection in case of SG" UBYTE TI1_M_CYCLE_S1 1 100 0 255 ECU_ADDRESS 0xFFF941CE FORMAT "%5.1" MATRIX_DIM 2 1 1 /end MEASUREMENT
/begin CHARACTERISTIC OutPPSplyCtl_tiPSplyPrtSG_C "F2523: Timer start value for HW protection in case of SG" VAL_BLK 0x19157A AblGLKWBub_S1 1250 TI1_M_CYCLE_S1 0 1250 MATRIX_DIM 2 1 1 FORMAT "%5.0" /end CHARACTERISTIC
/begin CHARACTERISTIC OutPPSplyCtl_uPSplyBattLoHys_C "F2523: Hysteresis for PSply switch off during low battery voltage" VALUE 0x19157C AblGLKWuw_S1 5 U0_001_S1 0 5 FORMAT "%8.6" /end CHARACTERISTIC
/begin CHARACTERISTIC OutPPSplyCtl_uPSplyBattLo_C "F2523: Voltage threshold for PSply switch off during low battery voltage" VALUE 0x19157E AblGLKWuw_S1 25 U0_001_S1 0 25 FORMAT "%8.5" /end CHARACTERISTIC
/begin MEASUREMENT OutPPSplyMon_ctPSplyErrOP "F2523: Faultcounter of OP diagnosis for different low sides" UBYTE X1_S1 1 100 0 255 ECU_ADDRESS 0xFFF934FA FORMAT "%5.1" MATRIX_DIM 2 1 1 /end MEASUREMENT
/begin CHARACTERISTIC OutPPSplyMon_ctPSplyErrOP_C "F2523: threshold for number of low sides with detected error" VAL_BLK 0x191580 AblGLKWBub_S1 255 X1_S1 0 255 MATRIX_DIM 2 1 1 FORMAT "%5.1" /end CHARACTERISTIC
/begin MEASUREMENT OutPPSplyMon_ctPSplyOPEvt "F2523: Counter of consecutive PSply OP faults" UBYTE X1_S1 1 100 0 255 ECU_ADDRESS 0xFFF934FC FORMAT "%5.1" MATRIX_DIM 2 1 1 /end MEASUREMENT
/begin CHARACTERISTIC OutPPSplyMon_ctPSplyOPEvt_C "F2523: Counter threshold of consecutive PSply OP faults" VAL_BLK 0x191582 AblGLKWBub_S1 255 X1_S1 0 255 MATRIX_DIM 2 1 1 FORMAT "%5.1" /end CHARACTERISTIC
/begin MEASUREMENT OutPPSplyMon_sPSplyOpM "F2523: State machine for the short circuit test during mode OP" UBYTE X1_S1 1 100 0 255 ECU_ADDRESS 0xFFF934FE FORMAT "%5.1" MATRIX_DIM 2 1 1 /end MEASUREMENT
/begin CHARACTERISTIC OutPPSplyMon_stPSplyErrOP_C "F2523: activation of OP monitoring (B0=OP in mode OP, B1=OP in mode ACTIVE_ON)" VAL_BLK 0x191584 AblGLKWBub_S1 255 X1_S1 0 255 MATRIX_DIM 2 1 1 FORMAT "%5.1" /end CHARACTERISTIC
/begin MEASUREMENT OutPPSplyMon_stPSplyFault "F2523: Fault status [B0=GEN, B1=PLAUS, B2=SB, B3=SG, B4=OP, B5=SBDFE, B6=SGDFE, B7=OPDFE, B8=SCDFE, B9=SC]" UWORD X1_S1 1 100 0 65535 ECU_ADDRESS 0xFFF94378 FORMAT "%8.2" MATRIX_DIM 2 1 1 /end MEASUREMENT
/begin MEASUREMENT OutPPSplyMon_stPSplyFaultOP "F2523: PSply Open Pin fault condition [B0=PSply0, B1=PSply1,...; 0=no OP fault, 1= OP fault]" UBYTE X1_S1 1 100 0 255 ECU_ADDRESS 0xFFF93B25 FORMAT "%5.1" /end MEASUREMENT
/begin MEASUREMENT OutPPSplyMon_stPSplyHldDfe "F2523: Status for holding of direct fault entry" UWORD X1_S1 1 100 0 65535 ECU_ADDRESS 0xFFF92C48 FORMAT "%8.2" MATRIX_DIM 2 1 1 /end MEASUREMENT
/begin CHARACTERISTIC OutPPSplyMon_stPSplyHldDfe_C "F2523: Mask for holding of direct fault entry  [B5=SBDFE, B6=SGDFE, B7=OPDFE, B8=SCDFE]" VALUE 0x191586 AblGLKWuw_S1 65535 X1_S1 0 65535 FORMAT "%8.2" /end CHARACTERISTIC
/begin MEASUREMENT OutPPSplyMon_stPSplyOffSGErr "F2523: SG error in case of reinit PSply" UBYTE B_TRUE_S1 1 100 0 1 ECU_ADDRESS 0xFFF93500 FORMAT "%13.11" MATRIX_DIM 2 1 1 /end MEASUREMENT
/begin CHARACTERISTIC OutPPSplyMon_stPSplyOffSG_C "F2523: Monitoring of SG in mode ACTIVE_OFF active (TRUE: active)" VAL_BLK 0x191588 AblGLKWBub_S1 1 B_TRUE_S1 0 1 MATRIX_DIM 2 1 1 FORMAT "%13.11" /end CHARACTERISTIC
/begin MEASUREMENT OutPPSplyMon_stPSplyOpMRng "F2523: Status of delay timer for fault detection during mode operation" UBYTE X1_S1 1 100 0 255 ECU_ADDRESS 0xFFF93502 FORMAT "%5.1" MATRIX_DIM 2 1 1 /end MEASUREMENT
/begin CHARACTERISTIC OutPPSplyMon_stPSplyOpMSC_C "F2523: Monitoring of short circuits between PSply [0=off, 1=on]" VALUE 0x191900 AblGLKWub_S1 1 X1_S1 0 1 FORMAT "%5.3" /end CHARACTERISTIC
/begin MEASUREMENT OutPPSplyMon_stPSplySfrm "F2523: Fault status for Sfrm [0=no fault, 2=switch off PSply, Bit7=DFE fault]" UBYTE X1_S1 1 100 0 255 ECU_ADDRESS 0xFFF93504 FORMAT "%5.1" MATRIX_DIM 2 1 1 /end MEASUREMENT
/begin CHARACTERISTIC OutPPSplyMon_stPSplySfrmPSply_C "F2523: Fault bit mask for SFRM check: PSply should switch off [B0=GEN, B1=PLAUS, B2=SB, B3=SG, B4=OP, B5=SBDFE, B6=SGDFE, B7=OPDFE, B8=SCDFE, B9=SC]" VAL_BLK 0x190554 AblGLKWBuw_S1 65535 X1_S1 0 65535 MATRIX_DIM 2 1 1 FORMAT "%8.2" /end CHARACTERISTIC
/begin MEASUREMENT OutPPSplyMon_stPSplyTstCond "F2523: Test condition status [B0=GEN, B1=PLAUS, B2=SB, B3=SG, B4=OP, B5=SBDFE, B6=SGDFE, B7=OPDFE, B8=SCDFE, B9=SC]" UWORD X1_S1 1 100 0 65535 ECU_ADDRESS 0xFFF9437C FORMAT "%8.2" MATRIX_DIM 2 1 1 /end MEASUREMENT
/begin MEASUREMENT OutPPSplyMon_stPSplyTstCondOP "F2523: PSply OP test condition [B0=PSply0, B1=PSply1,...; 0= no test cond, 1= OP test cond. fullfilled]" UBYTE X1_S1 1 100 0 255 ECU_ADDRESS 0xFFF93B26 FORMAT "%5.1" /end MEASUREMENT
/begin CHARACTERISTIC OutPPSplyMon_stPSplyTstCond_C "F2523: Enable test condition [0=off, 1=on; B0=GEN, B1=PLAUS, B2=SB, B3=SG, B4=OP, B5=SBDFE, B6=SGDFE, B7=OPDFE, B8=SCDFE, B9=SC]" VAL_BLK 0x190558 AblGLKWBuw_S1 65535 X1_S1 0 65535 MATRIX_DIM 2 1 1 FORMAT "%8.2" /end CHARACTERISTIC
/begin MEASUREMENT OutPPSplyMon_tiPSplyOpMRng "F2523: Delay timer for fault detection during mode operation" UBYTE TI1_M_CYCLE_S1 1 100 0 1275 ECU_ADDRESS 0xFFF941D0 FORMAT "%5.0" MATRIX_DIM 2 1 1 /end MEASUREMENT
/begin CHARACTERISTIC OutPPSplyMon_tiPSplyRngDly_C "F2523: Delay timer for fault detection during mode operation" MAP 0x191901 AblGLFKFub_S1 100 TI1_M_CYCLE_S1 0 100
 /begin AXIS_DESCR FIX_AXIS OutPPSplyMon_xPSplyDmy X1_S1 3 0 2 READ_ONLY FORMAT "%5.3" FIX_AXIS_PAR_DIST 0 1 3 /end AXIS_DESCR
 /begin AXIS_DESCR FIX_AXIS OutPPSplyMon_yPSplyDmy X1_S1 3 0 2 READ_ONLY FORMAT "%5.3" FIX_AXIS_PAR_DIST 0 1 3 /end AXIS_DESCR
 FORMAT "%5.1" /end CHARACTERISTIC
/begin CHARACTERISTIC OutPPSplyMon_tiPSplyRngWait_C "F2523: Wait timer for fault detection during mode operation" MAP 0x19190A AblGLFKFub_S1 100 TI1_M_CYCLE_S1 0 100
 /begin AXIS_DESCR FIX_AXIS OutPPSplyMon_xPSplyDmy X1_S1 3 0 2 READ_ONLY FORMAT "%5.3" FIX_AXIS_PAR_DIST 0 1 3 /end AXIS_DESCR
 /begin AXIS_DESCR FIX_AXIS OutPPSplyMon_yPSplyDmy X1_S1 3 0 2 READ_ONLY FORMAT "%5.3" FIX_AXIS_PAR_DIST 0 1 3 /end AXIS_DESCR
 FORMAT "%5.1" /end CHARACTERISTIC
/begin CHARACTERISTIC OutPPSplyMon_uPSplyDiff_C "F2523: Difference voltage for fault detection" VAL_BLK 0x19055C AblGLKWBuw_S1 5 U0_001_S1 0 5 MATRIX_DIM 2 1 1 FORMAT "%8.6" /end CHARACTERISTIC
/begin CHARACTERISTIC OutPPSplyMon_uPSplyLimSG_C "F2523: Threshold for SG detection in case of incorrect uBatt" VAL_BLK 0x190560 AblGLKWBuw_S1 5 U0_001_S1 0 5 MATRIX_DIM 2 1 1 FORMAT "%8.6" /end CHARACTERISTIC
/begin CHARACTERISTIC OutPPSplyMon_uPSplyTstHi_C "F2523: Higher voltage threshold of test condition" VAL_BLK 0x190564 AblGLKWBuw_S1 40 U0_001_S1 0 40 MATRIX_DIM 2 1 1 FORMAT "%8.5" /end CHARACTERISTIC
/begin CHARACTERISTIC OutPPSplyMon_uPSplyTstLo_C "F2523: Lower voltage threshold of test condition" VAL_BLK 0x190568 AblGLKWBuw_S1 25 U0_001_S1 0 25 MATRIX_DIM 2 1 1 FORMAT "%8.5" /end CHARACTERISTIC
/begin MEASUREMENT OutPPSplyMon_xPSplyDmy "F2523: X Dummy for characteristic field" UBYTE X1_S1 1 100 0 2 ECU_ADDRESS 0xFFF93B27 FORMAT "%5.3" /end MEASUREMENT
/begin MEASUREMENT OutPPSplyMon_yPSplyDmy "F2523: Y Dummy for characteristic field" UBYTE X1_S1 1 100 0 3 ECU_ADDRESS 0xFFF93B28 FORMAT "%5.3" /end MEASUREMENT
/begin MEASUREMENT OutPPSplyOn_bPSplyActv "F2523: Power supply active [0=off, 1=on]" UBYTE X1_S1 1 100 0 1 ECU_ADDRESS 0xFFF935CE FORMAT "%5.3" MATRIX_DIM 2 1 1 /end MEASUREMENT
/begin CHARACTERISTIC OutPPSplyOn_rPSplySB_C "F2523: Threshold for short to battery detection" VAL_BLK 0x1912B8 AblGLKWBuw_S1 100 R0_1_P_S1 0 100 MATRIX_DIM 2 1 1 FORMAT "%8.4" /end CHARACTERISTIC
/begin MEASUREMENT OutPPSplyOn_stPSplyRng "F2523: Power supply voltage range [0=INIT,0x11=SG,0x22=OP,0x33=SB,0x44=UNDEF_LO,0x55=UNDEF_HI,0x66=CLSD]" UBYTE X1_S1 1 100 0 102 ECU_ADDRESS 0xFFF935D0 FORMAT "%5.1" MATRIX_DIM 2 1 1 /end MEASUREMENT
/begin CHARACTERISTIC OutPPSplyOn_uPSplyClsdThres_C "F2523: Difference threshold between uBatt and uPSply" VALUE 0x1916BA AblGLKWuw_S1 65.535 U0_001_S1 0 65.535 FORMAT "%8.5" /end CHARACTERISTIC
/begin CHARACTERISTIC OutPPSplyOn_uPSplyOPHi_C "F2523: Voltage threshold for open load detection (High)" VAL_BLK 0x1912BC AblGLKWBuw_S1 10 U0_001_S1 0 10 MATRIX_DIM 2 1 1 FORMAT "%8.5" /end CHARACTERISTIC
/begin CHARACTERISTIC OutPPSplyOn_uPSplyOPLo_C "F2523: Voltage threshold for open load detection (low)" VAL_BLK 0x1912C0 AblGLKWBuw_S1 10 U0_001_S1 0 10 MATRIX_DIM 2 1 1 FORMAT "%8.5" /end CHARACTERISTIC
/begin CHARACTERISTIC OutPPSplyOn_uPSplySG_C "F2523: Voltage threshold for short to ground detection" VAL_BLK 0x1912C4 AblGLKWBuw_S1 3 U0_001_S1 0 3 MATRIX_DIM 2 1 1 FORMAT "%8.6" /end CHARACTERISTIC
/begin MEASUREMENT OutPRstL3_bRst "F2510: Sensor voltage will be switched off (10-20ms) (1--> in reset mode 0--> not in reset mode)" UBYTE B_TRUE_S1 1 100 0 1 ECU_ADDRESS 0xFFF93B29 FORMAT "%13.11" /end MEASUREMENT
/begin MEASUREMENT OutPRstL3_sRst "F2510: Contains the current state of the sensor supply voltage" UBYTE X1_S1 1 100 0 5 ECU_ADDRESS 0xFFF93B2A FORMAT "%5.3" /end MEASUREMENT
/begin MEASUREMENT OutPRstL3_tiHwDly "F2510: After that time the application will be informed that the sensor supply is on" UBYTE TI1_M_CYCLE_S1 1 100 0 1275 ECU_ADDRESS 0xFFF94238 FORMAT "%5.0" /end MEASUREMENT
/begin CHARACTERISTIC OutPRstL3_tiHwDly_C "F2510: After that time the application will be informed that the sensor supply is on" VALUE 0x191913 AblGLKWub_S1 20 TI1_M_CYCLE_S1 0 20 FORMAT "%5.2" /end CHARACTERISTIC
/begin MEASUREMENT OutPRstL3_tiSSplyMinOn "F2510: Min time that the sensor voltage will be on before the next reset request is possible" UBYTE TI1_M_CYCLE_S1 1 100 0 255 ECU_ADDRESS 0xFFF94239 FORMAT "%5.1" /end MEASUREMENT
/begin CHARACTERISTIC OutPRstL3_tiSSplyMinOn_C "F2510: Represents the time which the sensor voltage must be on before the next reset request is possible" VALUE 0x191914 AblGLKWub_S1 255 TI1_M_CYCLE_S1 0 255 FORMAT "%5.1" /end CHARACTERISTIC
/begin MEASUREMENT OutPRstL3_tiSSplyOff "F2510: Min time that the sensor voltage will be off" UBYTE TI1_M_CYCLE_S1 1 100 0 255 ECU_ADDRESS 0xFFF9423A FORMAT "%5.1" /end MEASUREMENT
/begin CHARACTERISTIC OutPRstL3_tiSSplyOff_C "F2510: Represents the time which the sensor voltage will be switched off during a reset" VALUE 0x191915 AblGLKWub_S1 255 TI1_M_CYCLE_S1 0 255 FORMAT "%5.1" /end CHARACTERISTIC
/begin MEASUREMENT OutPSSply5Mon_stSSply5Fault "F2511: Status of fault [B2: SB, B3: SG]" UWORD X1_S1 1 100 0 65535 ECU_ADDRESS 0xFFF93664 FORMAT "%8.2" /end MEASUREMENT
/begin MEASUREMENT OutPSSply5Mon_stSSply5TstCond "F2511: Status of test condition [B2: SB, B3: SG]" UWORD X1_S1 1 100 0 65535 ECU_ADDRESS 0xFFF93666 FORMAT "%8.2" /end MEASUREMENT
/begin CHARACTERISTIC OutPSSply5Mon_stSSply5TstCond_C "F2511: Enable test condition [B2: SB, B3: SG; 0=Off, 1=On]" VALUE 0x191864 AblGLKWuw_S1 65535 X1_S1 0 65535 FORMAT "%8.2" /end CHARACTERISTIC
/begin CHARACTERISTIC OutPSSply5Mon_uSSply5TstHi_C "F2511: Upper voltage threshold of test condition" VALUE 0x191866 AblGLKWuw_S1 32 U0_001_S1 0 32 FORMAT "%8.5" /end CHARACTERISTIC
/begin CHARACTERISTIC OutPSSply5Mon_uSSply5TstLo_C "F2511: Lower voltage threshold of test condition" VALUE 0x191868 AblGLKWuw_S1 32 U0_001_S1 0 32 FORMAT "%8.5" /end CHARACTERISTIC
/begin CHARACTERISTIC OutPSSply5Mon_uSSply5TstSB_C "F2511: Voltage threshold for short to battery detection" VALUE 0x19186A AblGLKWuw_S1 10 U0_001_S1 5 15 FORMAT "%8.5" /end CHARACTERISTIC
/begin CHARACTERISTIC OutPSSply5Mon_uSSply5TstSG_C "F2511: Voltage threshold for short to ground detection" VALUE 0x19186C AblGLKWuw_S1 5 U0_001_S1 0 5 FORMAT "%8.6" /end CHARACTERISTIC
/begin MEASUREMENT OutPShCirL3_sSSplyShCir "F2510: Represents the short circuit of the sensor supply voltage" UBYTE X1_S1 1 100 0 4 ECU_ADDRESS 0xFFF93B94 FORMAT "%5.3" /end MEASUREMENT
/begin MEASUREMENT OutPShCirL3_stSSplyFault "F2510: Variable to measure the faults of the SSply monitoring system. " UWORD X1_S1 1 100 0 65535 ECU_ADDRESS 0xFFF943B2 FORMAT "%8.2" /end MEASUREMENT
/begin MEASUREMENT OutPShCirL3_stSSplyTstCond "F2510: Variable to measure the test conditions of the SSply monitoring system." UWORD X1_S1 1 100 0 65535 ECU_ADDRESS 0xFFF943B4 FORMAT "%8.2" /end MEASUREMENT
/begin CHARACTERISTIC OutPShCirL3_stSSplyTstCond_C "F2510: Enable test condition [Bit2: SB, Bit3: SG, Bit4: SBRst; 0=Off, 1=On] " VALUE 0x191852 AblGLKWuw_S1 65535 X1_S1 0 65535 FORMAT "%8.2" /end CHARACTERISTIC
/begin MEASUREMENT OutPShCirL3_tiLoBatt "F2523: Lag counter while battery voltage is too low (used at SSply supplied by low uM2 only)" UBYTE TI1_M_CYCLE_S1 1 100 0 1275 ECU_ADDRESS 0xFFF94255 FORMAT "%5.0" /end MEASUREMENT
/begin CHARACTERISTIC OutPShCirL3_tiLoBatt_C "F2523: Start value of lag counter while battery voltage is too low (used at SSply supplied by low uM2 only)" VALUE 0x1919FA AblGLKWub_S1 300 TI1_M_CYCLE_S1 0 300 FORMAT "%5.1" /end CHARACTERISTIC
/begin MEASUREMENT OutPShCirL3_tiMonDly "F2510: Remaining time for the monitoring delay" UBYTE TI1_M_CYCLE_S1 1 100 0 1275 ECU_ADDRESS 0xFFF94256 FORMAT "%5.0" /end MEASUREMENT
/begin CHARACTERISTIC OutPShCirL3_tiMonDly_C "F2510: Adjustable time for the monitoring delay" VALUE 0x1919FB AblGLKWub_S1 100 TI1_M_CYCLE_S1 0 100 FORMAT "%5.1" /end CHARACTERISTIC
/begin CHARACTERISTIC OutPShCirL3_uSSplyAsicLos_C "F2510: Represents the loss of the ASIC which controlled the sensor supply voltage" VALUE 0x191854 AblGLKWuw_S1 0.5 U0_001_S1 0 0.5 FORMAT "%9.7" /end CHARACTERISTIC
/begin CHARACTERISTIC OutPShCirL3_uSSplyDiffSply_C "F2510: Describes how much higher the uSSply needs to detected a short to battery. The data relates to the supply voltage of this voltage." VALUE 0x191856 AblGLKWuw_S1 1 U0_001_S1 0 1 FORMAT "%8.6" /end CHARACTERISTIC
/begin CHARACTERISTIC OutPShCirL3_uSSplySBLoLim_C "F2510: Represents the limit to delete the short circuit plus" VALUE 0x191858 AblGLKWuw_S1 2 U0_001_S1 9.5 11.5 FORMAT "%8.5" /end CHARACTERISTIC
/begin CHARACTERISTIC OutPShCirL3_uSSplySBUpLim_C "F2510: Represents the limit to set the short circuit plus" VALUE 0x19185A AblGLKWuw_S1 6.5 U0_001_S1 9.5 16 FORMAT "%8.5" /end CHARACTERISTIC
/begin CHARACTERISTIC OutPShCirL3_uSSplySGLoLim_C "F2510: Represents the limit to set the short circuit flag" VALUE 0x19185C AblGLKWuw_S1 8.5 U0_001_S1 0 8.5 FORMAT "%8.6" /end CHARACTERISTIC
/begin CHARACTERISTIC OutPShCirL3_uSSplySGUpLim_C "F2510: Represents the limit to delete the short circuit flag" VALUE 0x19185E AblGLKWuw_S1 2 U0_001_S1 7.5 9.5 FORMAT "%8.6" /end CHARACTERISTIC
/begin CHARACTERISTIC OutPShCirL3_uSSplySwtOffLim_C "F2510: If the SSply is off and the voltage is above that limit an error will be detected" VALUE 0x191860 AblGLKWuw_S1 2 U0_001_S1 0 2 FORMAT "%8.6" /end CHARACTERISTIC
/begin CHARACTERISTIC OutPShCirL3_uTstLoBatt_C "F2510: Low battery voltage threshold for general monitoring condition (used at SSply supplied by low uM2 only)" VALUE 0x191862 AblGLKWuw_S1 32 U0_001_S1 0 32 FORMAT "%8.5" /end CHARACTERISTIC
/begin MEASUREMENT SpiCc08_DIA_regRx "F2386: CG208 DIA sequence (RX)" UWORD X1_S1 1 100 0 65535 ECU_ADDRESS 0xFFF88A4A FORMAT "%8.2" MATRIX_DIM 15 1 1 /end MEASUREMENT
/begin MEASUREMENT SpiCc08_DIA_regTx "F2386: CG208 DIA sequence (TX)" UWORD X1_S1 1 100 0 65535 ECU_ADDRESS 0xFFF88A2C FORMAT "%8.2" MATRIX_DIM 15 1 1 /end MEASUREMENT
/begin MEASUREMENT SpiCc08_ID_regRx "F2386: CG208 ID sequence (RX)" UWORD X1_S1 1 100 0 65535 ECU_ADDRESS 0xFFF88180 FORMAT "%8.2" MATRIX_DIM 10 1 1 /end MEASUREMENT
/begin MEASUREMENT SpiCc08_ID_regTx "F2386: CG208 ID sequence (TX)" UWORD X1_S1 1 100 0 65535 ECU_ADDRESS 0xFFF8816C FORMAT "%8.2" MATRIX_DIM 10 1 1 /end MEASUREMENT
/begin MEASUREMENT SpiCc08_OUTFX_regRx "F2386: CG208 OUTF sequence (RX)" UWORD X1_S1 1 100 0 65535 ECU_ADDRESS 0xFFF88324 FORMAT "%8.2" MATRIX_DIM 40 1 1 /end MEASUREMENT
/begin MEASUREMENT SpiCc08_OUTFX_regTx "F2386: CG208 OUTF sequence (TX)" UWORD X1_S1 1 100 0 65535 ECU_ADDRESS 0xFFF88234 FORMAT "%8.2" MATRIX_DIM 40 1 1 /end MEASUREMENT
/begin MEASUREMENT SpiCc08_OUTI_regRx "F2386: CG208 OUTI sequence (RX)" UWORD X1_S1 1 100 0 65535 ECU_ADDRESS 0xFFF88AC2 FORMAT "%8.2" MATRIX_DIM 45 1 1 /end MEASUREMENT
/begin MEASUREMENT SpiCc08_OUTI_regTx "F2386: CG208 OUTI sequence (TX)" UWORD X1_S1 1 100 0 65535 ECU_ADDRESS 0xFFF88A68 FORMAT "%8.2" MATRIX_DIM 45 1 1 /end MEASUREMENT
/begin MEASUREMENT SpiCc08_OUTP_regRx "F2386: CG208 OUTP sequence (RX)" UWORD X1_S1 1 100 0 65535 ECU_ADDRESS 0xFFF881E4 FORMAT "%8.2" MATRIX_DIM 40 1 1 /end MEASUREMENT
/begin MEASUREMENT SpiCc08_OUTP_regTx "F2386: CG208 OUTP sequence (TX)" UWORD X1_S1 1 100 0 65535 ECU_ADDRESS 0xFFF88194 FORMAT "%8.2" MATRIX_DIM 40 1 1 /end MEASUREMENT
/begin MEASUREMENT SpiCc08_st "F2386: CG208 condensed SPI Status Information (B0:Ok, B1:Err, B2:ErrDat, B7:Ident)" UBYTE X1_S1 1 100 0 255 ECU_ADDRESS 0xFFF9096C FORMAT "%5.1" MATRIX_DIM 5 1 1 /end MEASUREMENT
/begin MEASUREMENT SpiCore_DIA_regRx "F2386: CG124/CG130 DIA sequence (RX)" UWORD X1_S1 1 100 0 65535 ECU_ADDRESS 0xFFF88B26 FORMAT "%8.2" MATRIX_DIM 5 1 1 /end MEASUREMENT
/begin MEASUREMENT SpiCore_DIA_regTx "F2386: CG124/CG130 DIA sequence (TX)" UWORD X1_S1 1 100 0 65535 ECU_ADDRESS 0xFFF88B1C FORMAT "%8.2" MATRIX_DIM 5 1 1 /end MEASUREMENT
/begin MEASUREMENT SpiCore_ID_regRx "F2386: CG124/CG130 ID sequence (RX)" UWORD X1_S1 1 100 0 65535 ECU_ADDRESS 0xFFF8841C FORMAT "%8.2" MATRIX_DIM 4 1 1 /end MEASUREMENT
/begin MEASUREMENT SpiCore_ID_regTx "F2386: CG124/CG130 ID sequence (TX)" UWORD X1_S1 1 100 0 65535 ECU_ADDRESS 0xFFF88414 FORMAT "%8.2" MATRIX_DIM 4 1 1 /end MEASUREMENT
/begin MEASUREMENT SpiCore_OUT_regRx "F2386: CG124/CG130 OUT sequence (RX)" UWORD X1_S1 1 100 0 65535 ECU_ADDRESS 0xFFF8842C FORMAT "%8.2" MATRIX_DIM 7 1 1 /end MEASUREMENT
/begin MEASUREMENT SpiCore_OUT_regTx "F2386: CG124/CG130 OUT sequence (TX)" UWORD X1_S1 1 100 0 65535 ECU_ADDRESS 0xFFF88424 FORMAT "%8.2" MATRIX_DIM 7 1 1 /end MEASUREMENT
/begin MEASUREMENT SpiCore_TEMP_regRx "F2386: CG130-TEMP sequence (RX)" UWORD X1_S1 1 100 0 65535 ECU_ADDRESS 0xFFF88448 FORMAT "%8.2" MATRIX_DIM 2 1 1 /end MEASUREMENT
/begin MEASUREMENT SpiCore_TEMP_regTx "F2386: CG130-TEMP sequence (TX)" UWORD X1_S1 1 100 0 65535 ECU_ADDRESS 0xFFF88444 FORMAT "%8.2" MATRIX_DIM 2 1 1 /end MEASUREMENT
/begin MEASUREMENT SpiCore_stCg124 "F2386: CG124 condensed SPI Status Information (B0:Ok, B1:Err, B2:ErrDat, B7:Ident)" UBYTE X1_S1 1 100 0 255 ECU_ADDRESS 0xFFF90971 FORMAT "%5.1" /end MEASUREMENT
/begin MEASUREMENT SpiCore_stCg130 "F2386: CG130 condensed SPI Status Information (B0:Ok, B1:Err, B2:ErrDat, B7:Ident)" UBYTE X1_S1 1 100 0 255 ECU_ADDRESS 0xFFF90972 FORMAT "%5.1" /end MEASUREMENT
/begin MEASUREMENT Spi_Cg124.regDInit "F2386: Cg124 register structure / " UBYTE X1_S1 1 100 0 255 ECU_ADDRESS 0xFFF9097B FORMAT "%5.1" /end MEASUREMENT
/begin MEASUREMENT Spi_Cg124.regDia "F2386: Cg124 register structure / " UBYTE X1_S1 1 100 0 255 ECU_ADDRESS 0xFFF9097A FORMAT "%5.1" /end MEASUREMENT
/begin MEASUREMENT Spi_Cg124.regIdent "F2386: Cg124 register structure / " UBYTE X1_S1 1 100 0 255 ECU_ADDRESS 0xFFF90977 FORMAT "%5.1" /end MEASUREMENT
/begin MEASUREMENT Spi_Cg124.regRev "F2386: Cg124 register structure / " UBYTE X1_S1 1 100 0 255 ECU_ADDRESS 0xFFF90978 FORMAT "%5.1" /end MEASUREMENT
/begin MEASUREMENT Spi_Cg124.regStat "F2386: Cg124 register structure / " UBYTE X1_S1 1 100 0 255 ECU_ADDRESS 0xFFF90979 FORMAT "%5.1" /end MEASUREMENT
/begin MEASUREMENT Spi_Cg124.stEmpty "F2386: Cg124 register structure / " UBYTE X1_S1 1 100 0 255 ECU_ADDRESS 0xFFF90976 FORMAT "%5.1" /end MEASUREMENT
/begin MEASUREMENT Spi_Cg124.stErrDatMsk "F2386: Cg124 register structure / " UBYTE X1_S1 1 100 0 255 ECU_ADDRESS 0xFFF90975 FORMAT "%5.1" /end MEASUREMENT
/begin MEASUREMENT Spi_Cg124.stErrMsk "F2386: Cg124 register structure / " UBYTE X1_S1 1 100 0 255 ECU_ADDRESS 0xFFF90974 FORMAT "%5.1" /end MEASUREMENT
/begin MEASUREMENT Spi_Cg124.stOkMsk "F2386: Cg124 register structure / " UBYTE X1_S1 1 100 0 255 ECU_ADDRESS 0xFFF90973 FORMAT "%5.1" /end MEASUREMENT
/begin MEASUREMENT Spi_Cg124_regDiaFirst "F2385: first Cg124 Dia-reg reading after system startup (B7:not RST_U3, B6:not RST_U5)" UBYTE X1_S1 1 100 0 255 ECU_ADDRESS 0xFFF9095F FORMAT "%5.1" /end MEASUREMENT
/begin MEASUREMENT Spi_Cg130.regDia1 "F2386: Cg130 register structure / " UBYTE X1_S1 1 100 0 255 ECU_ADDRESS 0xFFF907D1 FORMAT "%5.1" /end MEASUREMENT
/begin MEASUREMENT Spi_Cg130.regDia2 "F2386: Cg130 register structure / " UBYTE X1_S1 1 100 0 255 ECU_ADDRESS 0xFFF907D2 FORMAT "%5.1" /end MEASUREMENT
/begin MEASUREMENT Spi_Cg130.regDia3 "F2386: Cg130 register structure / " UBYTE X1_S1 1 100 0 255 ECU_ADDRESS 0xFFF907D3 FORMAT "%5.1" /end MEASUREMENT
/begin MEASUREMENT Spi_Cg130.regIdent "F2386: Cg130 register structure / " UBYTE X1_S1 1 100 0 255 ECU_ADDRESS 0xFFF907CF FORMAT "%5.1" /end MEASUREMENT
/begin MEASUREMENT Spi_Cg130.regInit1 "F2386: Cg130 register structure / " UBYTE X1_S1 1 100 0 255 ECU_ADDRESS 0xFFF907D4 FORMAT "%5.1" /end MEASUREMENT
/begin MEASUREMENT Spi_Cg130.regInit1r "F2386: Cg130 register structure / " UBYTE X1_S1 1 100 0 255 ECU_ADDRESS 0xFFF907D5 FORMAT "%5.1" /end MEASUREMENT
/begin MEASUREMENT Spi_Cg130.regInit2 "F2386: Cg130 register structure / " UBYTE X1_S1 1 100 0 255 ECU_ADDRESS 0xFFF907D6 FORMAT "%5.1" /end MEASUREMENT
/begin MEASUREMENT Spi_Cg130.regInit2r "F2386: Cg130 register structure / " UBYTE X1_S1 1 100 0 255 ECU_ADDRESS 0xFFF907D7 FORMAT "%5.1" /end MEASUREMENT
/begin MEASUREMENT Spi_Cg130.regRev "F2386: Cg130 register structure / " UBYTE X1_S1 1 100 0 255 ECU_ADDRESS 0xFFF907D0 FORMAT "%5.1" /end MEASUREMENT
/begin MEASUREMENT Spi_Cg130.regTemp "F2386: Cg130 register structure / " UWORD X1_S1 1 100 0 65535 ECU_ADDRESS 0xFFF907CC FORMAT "%8.2" /end MEASUREMENT
/begin MEASUREMENT Spi_Cg130.stEmpty "F2386: Cg130 register structure / " UBYTE X1_S1 1 100 0 255 ECU_ADDRESS 0xFFF907CB FORMAT "%5.1" /end MEASUREMENT
/begin MEASUREMENT Spi_Cg130.stErrDatMsk "F2386: Cg130 register structure / " UBYTE X1_S1 1 100 0 255 ECU_ADDRESS 0xFFF907CA FORMAT "%5.1" /end MEASUREMENT
/begin MEASUREMENT Spi_Cg130.stErrMsk "F2386: Cg130 register structure / " UBYTE X1_S1 1 100 0 255 ECU_ADDRESS 0xFFF907C9 FORMAT "%5.1" /end MEASUREMENT
/begin MEASUREMENT Spi_Cg130.stOkMsk "F2386: Cg130 register structure / " UBYTE X1_S1 1 100 0 255 ECU_ADDRESS 0xFFF907C8 FORMAT "%5.1" /end MEASUREMENT
/begin MEASUREMENT Spi_Cg130.stTemp "F2386: Cg130 register structure / " UBYTE X1_S1 1 100 0 255 ECU_ADDRESS 0xFFF907CE FORMAT "%5.1" /end MEASUREMENT
/begin MEASUREMENT Spi_Cg130_regDia1First "F2385: first Cg130 Dia-reg reading after system startup (B4:PCLKHIGH, B3:PCLKLOW, B1:not DN)" UBYTE X1_S1 1 100 0 255 ECU_ADDRESS 0xFFF90960 FORMAT "%5.1" /end MEASUREMENT
/begin MEASUREMENT Spi_Cg130_regDia2First "F2385: first Cg130 Dia-reg reading after system startup (B7:RST_WD, B6:OT_ON)" UBYTE X1_S1 1 100 0 255 ECU_ADDRESS 0xFFF800ED FORMAT "%5.1" /end MEASUREMENT
/begin MEASUREMENT Spi_Cg130_regDia3First "F2385: first Cg130 Dia-reg reading after system startup (B1,0:VEN)" UBYTE X1_S1 1 100 0 255 ECU_ADDRESS 0xFFF90961 FORMAT "%5.1" /end MEASUREMENT
/begin MEASUREMENT Spi_Cg208a.C00_empty "F2386: Cg208 register structure / " UBYTE X1_S1 1 100 0 255 ECU_ADDRESS 0xFFF90C6B FORMAT "%5.1" /end MEASUREMENT
/begin MEASUREMENT Spi_Cg208a.C00_regCur "F2386: Cg208 register structure / " UWORD X1_S1 1 100 0 65535 ECU_ADDRESS 0xFFF90C64 FORMAT "%8.2" /end MEASUREMENT
/begin MEASUREMENT Spi_Cg208a.C00_regCurDelta "F2386: Cg208 register structure / " UWORD X1_S1 1 100 0 65535 ECU_ADDRESS 0xFFF90C66 FORMAT "%8.2" /end MEASUREMENT
/begin MEASUREMENT Spi_Cg208a.C00_regDam "F2386: Cg208 register structure / " UBYTE X1_S1 1 100 0 255 ECU_ADDRESS 0xFFF90C68 FORMAT "%5.1" /end MEASUREMENT
/begin MEASUREMENT Spi_Cg208a.C00_regDfr "F2386: Cg208 register structure / " UBYTE X1_S1 1 100 0 255 ECU_ADDRESS 0xFFF90C69 FORMAT "%5.1" /end MEASUREMENT
/begin MEASUREMENT Spi_Cg208a.C00_regDia "F2386: Cg208 register structure / " UBYTE X1_S1 1 100 0 255 ECU_ADDRESS 0xFFF90C6A FORMAT "%5.1" /end MEASUREMENT
/begin MEASUREMENT Spi_Cg208a.C01_empty "F2386: Cg208 register structure / " UBYTE X1_S1 1 100 0 255 ECU_ADDRESS 0xFFF90C73 FORMAT "%5.1" /end MEASUREMENT
/begin MEASUREMENT Spi_Cg208a.C01_regCur "F2386: Cg208 register structure / " UWORD X1_S1 1 100 0 65535 ECU_ADDRESS 0xFFF90C6C FORMAT "%8.2" /end MEASUREMENT
/begin MEASUREMENT Spi_Cg208a.C01_regCurDelta "F2386: Cg208 register structure / " UWORD X1_S1 1 100 0 65535 ECU_ADDRESS 0xFFF90C6E FORMAT "%8.2" /end MEASUREMENT
/begin MEASUREMENT Spi_Cg208a.C01_regDam "F2386: Cg208 register structure / " UBYTE X1_S1 1 100 0 255 ECU_ADDRESS 0xFFF90C70 FORMAT "%5.1" /end MEASUREMENT
/begin MEASUREMENT Spi_Cg208a.C01_regDfr "F2386: Cg208 register structure / " UBYTE X1_S1 1 100 0 255 ECU_ADDRESS 0xFFF90C71 FORMAT "%5.1" /end MEASUREMENT
/begin MEASUREMENT Spi_Cg208a.C01_regDia "F2386: Cg208 register structure / " UBYTE X1_S1 1 100 0 255 ECU_ADDRESS 0xFFF90C72 FORMAT "%5.1" /end MEASUREMENT
/begin MEASUREMENT Spi_Cg208a.C0_regCurDia "F2386: Cg208 register structure / " UBYTE X1_S1 1 100 0 255 ECU_ADDRESS 0xFFF90C5E FORMAT "%5.1" /end MEASUREMENT
/begin MEASUREMENT Spi_Cg208a.C0_regIdent "F2386: Cg208 register structure / " UBYTE X1_S1 1 100 0 255 ECU_ADDRESS 0xFFF90C5C FORMAT "%5.1" /end MEASUREMENT
/begin MEASUREMENT Spi_Cg208a.C0_regInt "F2386: Cg208 register structure / " UBYTE X1_S1 1 100 0 255 ECU_ADDRESS 0xFFF90C63 FORMAT "%5.1" /end MEASUREMENT
/begin MEASUREMENT Spi_Cg208a.C0_regModeIn "F2386: Cg208 register structure / " UBYTE X1_S1 1 100 0 255 ECU_ADDRESS 0xFFF90C60 FORMAT "%5.1" /end MEASUREMENT
/begin MEASUREMENT Spi_Cg208a.C0_regModeOut "F2386: Cg208 register structure / " UBYTE X1_S1 1 100 0 255 ECU_ADDRESS 0xFFF90C5F FORMAT "%5.1" /end MEASUREMENT
/begin MEASUREMENT Spi_Cg208a.C0_regOsz "F2386: Cg208 register structure / " UBYTE X1_S1 1 100 0 255 ECU_ADDRESS 0xFFF90C61 FORMAT "%5.1" /end MEASUREMENT
/begin MEASUREMENT Spi_Cg208a.C0_regRev "F2386: Cg208 register structure / " UBYTE X1_S1 1 100 0 255 ECU_ADDRESS 0xFFF90C5D FORMAT "%5.1" /end MEASUREMENT
/begin MEASUREMENT Spi_Cg208a.C0_regSet "F2386: Cg208 register structure / " UBYTE X1_S1 1 100 0 255 ECU_ADDRESS 0xFFF90C62 FORMAT "%5.1" /end MEASUREMENT
/begin MEASUREMENT Spi_Cg208a.C0_stEmpty "F2386: Cg208 register structure / " UBYTE X1_S1 1 100 0 255 ECU_ADDRESS 0xFFF90C5B FORMAT "%5.1" /end MEASUREMENT
/begin MEASUREMENT Spi_Cg208a.C0_stErrDatMsk "F2386: Cg208 register structure / " UBYTE X1_S1 1 100 0 255 ECU_ADDRESS 0xFFF90C5A FORMAT "%5.1" /end MEASUREMENT
/begin MEASUREMENT Spi_Cg208a.C0_stErrMsk "F2386: Cg208 register structure / " UBYTE X1_S1 1 100 0 255 ECU_ADDRESS 0xFFF90C59 FORMAT "%5.1" /end MEASUREMENT
/begin MEASUREMENT Spi_Cg208a.C0_stOkMsk "F2386: Cg208 register structure / " UBYTE X1_S1 1 100 0 255 ECU_ADDRESS 0xFFF90C58 FORMAT "%5.1" /end MEASUREMENT
/begin MEASUREMENT Spi_Cg208a.C10_empty "F2386: Cg208 register structure / " UBYTE X1_S1 1 100 0 255 ECU_ADDRESS 0xFFF90C87 FORMAT "%5.1" /end MEASUREMENT
/begin MEASUREMENT Spi_Cg208a.C10_regCur "F2386: Cg208 register structure / " UWORD X1_S1 1 100 0 65535 ECU_ADDRESS 0xFFF90C80 FORMAT "%8.2" /end MEASUREMENT
/begin MEASUREMENT Spi_Cg208a.C10_regCurDelta "F2386: Cg208 register structure / " UWORD X1_S1 1 100 0 65535 ECU_ADDRESS 0xFFF90C82 FORMAT "%8.2" /end MEASUREMENT
/begin MEASUREMENT Spi_Cg208a.C10_regDam "F2386: Cg208 register structure / " UBYTE X1_S1 1 100 0 255 ECU_ADDRESS 0xFFF90C84 FORMAT "%5.1" /end MEASUREMENT
/begin MEASUREMENT Spi_Cg208a.C10_regDfr "F2386: Cg208 register structure / " UBYTE X1_S1 1 100 0 255 ECU_ADDRESS 0xFFF90C85 FORMAT "%5.1" /end MEASUREMENT
/begin MEASUREMENT Spi_Cg208a.C10_regDia "F2386: Cg208 register structure / " UBYTE X1_S1 1 100 0 255 ECU_ADDRESS 0xFFF90C86 FORMAT "%5.1" /end MEASUREMENT
/begin MEASUREMENT Spi_Cg208a.C11_empty "F2386: Cg208 register structure / " UBYTE X1_S1 1 100 0 255 ECU_ADDRESS 0xFFF90C8F FORMAT "%5.1" /end MEASUREMENT
/begin MEASUREMENT Spi_Cg208a.C11_regCur "F2386: Cg208 register structure / " UWORD X1_S1 1 100 0 65535 ECU_ADDRESS 0xFFF90C88 FORMAT "%8.2" /end MEASUREMENT
/begin MEASUREMENT Spi_Cg208a.C11_regCurDelta "F2386: Cg208 register structure / " UWORD X1_S1 1 100 0 65535 ECU_ADDRESS 0xFFF90C8A FORMAT "%8.2" /end MEASUREMENT
/begin MEASUREMENT Spi_Cg208a.C11_regDam "F2386: Cg208 register structure / " UBYTE X1_S1 1 100 0 255 ECU_ADDRESS 0xFFF90C8C FORMAT "%5.1" /end MEASUREMENT
/begin MEASUREMENT Spi_Cg208a.C11_regDfr "F2386: Cg208 register structure / " UBYTE X1_S1 1 100 0 255 ECU_ADDRESS 0xFFF90C8D FORMAT "%5.1" /end MEASUREMENT
/begin MEASUREMENT Spi_Cg208a.C11_regDia "F2386: Cg208 register structure / " UBYTE X1_S1 1 100 0 255 ECU_ADDRESS 0xFFF90C8E FORMAT "%5.1" /end MEASUREMENT
/begin MEASUREMENT Spi_Cg208a.C1_regCurDia "F2386: Cg208 register structure / " UBYTE X1_S1 1 100 0 255 ECU_ADDRESS 0xFFF90C7A FORMAT "%5.1" /end MEASUREMENT
/begin MEASUREMENT Spi_Cg208a.C1_regIdent "F2386: Cg208 register structure / " UBYTE X1_S1 1 100 0 255 ECU_ADDRESS 0xFFF90C78 FORMAT "%5.1" /end MEASUREMENT
/begin MEASUREMENT Spi_Cg208a.C1_regInt "F2386: Cg208 register structure / " UBYTE X1_S1 1 100 0 255 ECU_ADDRESS 0xFFF90C7F FORMAT "%5.1" /end MEASUREMENT
/begin MEASUREMENT Spi_Cg208a.C1_regModeIn "F2386: Cg208 register structure / " UBYTE X1_S1 1 100 0 255 ECU_ADDRESS 0xFFF90C7C FORMAT "%5.1" /end MEASUREMENT
/begin MEASUREMENT Spi_Cg208a.C1_regModeOut "F2386: Cg208 register structure / " UBYTE X1_S1 1 100 0 255 ECU_ADDRESS 0xFFF90C7B FORMAT "%5.1" /end MEASUREMENT
/begin MEASUREMENT Spi_Cg208a.C1_regOsz "F2386: Cg208 register structure / " UBYTE X1_S1 1 100 0 255 ECU_ADDRESS 0xFFF90C7D FORMAT "%5.1" /end MEASUREMENT
/begin MEASUREMENT Spi_Cg208a.C1_regRev "F2386: Cg208 register structure / " UBYTE X1_S1 1 100 0 255 ECU_ADDRESS 0xFFF90C79 FORMAT "%5.1" /end MEASUREMENT
/begin MEASUREMENT Spi_Cg208a.C1_regSet "F2386: Cg208 register structure / " UBYTE X1_S1 1 100 0 255 ECU_ADDRESS 0xFFF90C7E FORMAT "%5.1" /end MEASUREMENT
/begin MEASUREMENT Spi_Cg208a.C1_stEmpty "F2386: Cg208 register structure / " UBYTE X1_S1 1 100 0 255 ECU_ADDRESS 0xFFF90C77 FORMAT "%5.1" /end MEASUREMENT
/begin MEASUREMENT Spi_Cg208a.C1_stErrDatMsk "F2386: Cg208 register structure / " UBYTE X1_S1 1 100 0 255 ECU_ADDRESS 0xFFF90C76 FORMAT "%5.1" /end MEASUREMENT
/begin MEASUREMENT Spi_Cg208a.C1_stErrMsk "F2386: Cg208 register structure / " UBYTE X1_S1 1 100 0 255 ECU_ADDRESS 0xFFF90C75 FORMAT "%5.1" /end MEASUREMENT
/begin MEASUREMENT Spi_Cg208a.C1_stOkMsk "F2386: Cg208 register structure / " UBYTE X1_S1 1 100 0 255 ECU_ADDRESS 0xFFF90C74 FORMAT "%5.1" /end MEASUREMENT
/begin MEASUREMENT Spi_Cg208a.C20_empty "F2386: Cg208 register structure / " UBYTE X1_S1 1 100 0 255 ECU_ADDRESS 0xFFF90CA3 FORMAT "%5.1" /end MEASUREMENT
/begin MEASUREMENT Spi_Cg208a.C20_regCur "F2386: Cg208 register structure / " UWORD X1_S1 1 100 0 65535 ECU_ADDRESS 0xFFF90C9C FORMAT "%8.2" /end MEASUREMENT
/begin MEASUREMENT Spi_Cg208a.C20_regCurDelta "F2386: Cg208 register structure / " UWORD X1_S1 1 100 0 65535 ECU_ADDRESS 0xFFF90C9E FORMAT "%8.2" /end MEASUREMENT
/begin MEASUREMENT Spi_Cg208a.C20_regDam "F2386: Cg208 register structure / " UBYTE X1_S1 1 100 0 255 ECU_ADDRESS 0xFFF90CA0 FORMAT "%5.1" /end MEASUREMENT
/begin MEASUREMENT Spi_Cg208a.C20_regDfr "F2386: Cg208 register structure / " UBYTE X1_S1 1 100 0 255 ECU_ADDRESS 0xFFF90CA1 FORMAT "%5.1" /end MEASUREMENT
/begin MEASUREMENT Spi_Cg208a.C20_regDia "F2386: Cg208 register structure / " UBYTE X1_S1 1 100 0 255 ECU_ADDRESS 0xFFF90CA2 FORMAT "%5.1" /end MEASUREMENT
/begin MEASUREMENT Spi_Cg208a.C21_empty "F2386: Cg208 register structure / " UBYTE X1_S1 1 100 0 255 ECU_ADDRESS 0xFFF90CAB FORMAT "%5.1" /end MEASUREMENT
/begin MEASUREMENT Spi_Cg208a.C21_regCur "F2386: Cg208 register structure / " UWORD X1_S1 1 100 0 65535 ECU_ADDRESS 0xFFF90CA4 FORMAT "%8.2" /end MEASUREMENT
/begin MEASUREMENT Spi_Cg208a.C21_regCurDelta "F2386: Cg208 register structure / " UWORD X1_S1 1 100 0 65535 ECU_ADDRESS 0xFFF90CA6 FORMAT "%8.2" /end MEASUREMENT
/begin MEASUREMENT Spi_Cg208a.C21_regDam "F2386: Cg208 register structure / " UBYTE X1_S1 1 100 0 255 ECU_ADDRESS 0xFFF90CA8 FORMAT "%5.1" /end MEASUREMENT
/begin MEASUREMENT Spi_Cg208a.C21_regDfr "F2386: Cg208 register structure / " UBYTE X1_S1 1 100 0 255 ECU_ADDRESS 0xFFF90CA9 FORMAT "%5.1" /end MEASUREMENT
/begin MEASUREMENT Spi_Cg208a.C21_regDia "F2386: Cg208 register structure / " UBYTE X1_S1 1 100 0 255 ECU_ADDRESS 0xFFF90CAA FORMAT "%5.1" /end MEASUREMENT
/begin MEASUREMENT Spi_Cg208a.C2_regCurDia "F2386: Cg208 register structure / " UBYTE X1_S1 1 100 0 255 ECU_ADDRESS 0xFFF90C96 FORMAT "%5.1" /end MEASUREMENT
/begin MEASUREMENT Spi_Cg208a.C2_regIdent "F2386: Cg208 register structure / " UBYTE X1_S1 1 100 0 255 ECU_ADDRESS 0xFFF90C94 FORMAT "%5.1" /end MEASUREMENT
/begin MEASUREMENT Spi_Cg208a.C2_regInt "F2386: Cg208 register structure / " UBYTE X1_S1 1 100 0 255 ECU_ADDRESS 0xFFF90C9B FORMAT "%5.1" /end MEASUREMENT
/begin MEASUREMENT Spi_Cg208a.C2_regModeIn "F2386: Cg208 register structure / " UBYTE X1_S1 1 100 0 255 ECU_ADDRESS 0xFFF90C98 FORMAT "%5.1" /end MEASUREMENT
/begin MEASUREMENT Spi_Cg208a.C2_regModeOut "F2386: Cg208 register structure / " UBYTE X1_S1 1 100 0 255 ECU_ADDRESS 0xFFF90C97 FORMAT "%5.1" /end MEASUREMENT
/begin MEASUREMENT Spi_Cg208a.C2_regOsz "F2386: Cg208 register structure / " UBYTE X1_S1 1 100 0 255 ECU_ADDRESS 0xFFF90C99 FORMAT "%5.1" /end MEASUREMENT
/begin MEASUREMENT Spi_Cg208a.C2_regRev "F2386: Cg208 register structure / " UBYTE X1_S1 1 100 0 255 ECU_ADDRESS 0xFFF90C95 FORMAT "%5.1" /end MEASUREMENT
/begin MEASUREMENT Spi_Cg208a.C2_regSet "F2386: Cg208 register structure / " UBYTE X1_S1 1 100 0 255 ECU_ADDRESS 0xFFF90C9A FORMAT "%5.1" /end MEASUREMENT
/begin MEASUREMENT Spi_Cg208a.C2_stEmpty "F2386: Cg208 register structure / " UBYTE X1_S1 1 100 0 255 ECU_ADDRESS 0xFFF90C93 FORMAT "%5.1" /end MEASUREMENT
/begin MEASUREMENT Spi_Cg208a.C2_stErrDatMsk "F2386: Cg208 register structure / " UBYTE X1_S1 1 100 0 255 ECU_ADDRESS 0xFFF90C92 FORMAT "%5.1" /end MEASUREMENT
/begin MEASUREMENT Spi_Cg208a.C2_stErrMsk "F2386: Cg208 register structure / " UBYTE X1_S1 1 100 0 255 ECU_ADDRESS 0xFFF90C91 FORMAT "%5.1" /end MEASUREMENT
/begin MEASUREMENT Spi_Cg208a.C2_stOkMsk "F2386: Cg208 register structure / " UBYTE X1_S1 1 100 0 255 ECU_ADDRESS 0xFFF90C90 FORMAT "%5.1" /end MEASUREMENT
/begin MEASUREMENT Spi_Cg208a.C30_empty "F2386: Cg208 register structure / " UBYTE X1_S1 1 100 0 255 ECU_ADDRESS 0xFFF90CBF FORMAT "%5.1" /end MEASUREMENT
/begin MEASUREMENT Spi_Cg208a.C30_regCur "F2386: Cg208 register structure / " UWORD X1_S1 1 100 0 65535 ECU_ADDRESS 0xFFF90CB8 FORMAT "%8.2" /end MEASUREMENT
/begin MEASUREMENT Spi_Cg208a.C30_regCurDelta "F2386: Cg208 register structure / " UWORD X1_S1 1 100 0 65535 ECU_ADDRESS 0xFFF90CBA FORMAT "%8.2" /end MEASUREMENT
/begin MEASUREMENT Spi_Cg208a.C30_regDam "F2386: Cg208 register structure / " UBYTE X1_S1 1 100 0 255 ECU_ADDRESS 0xFFF90CBC FORMAT "%5.1" /end MEASUREMENT
/begin MEASUREMENT Spi_Cg208a.C30_regDfr "F2386: Cg208 register structure / " UBYTE X1_S1 1 100 0 255 ECU_ADDRESS 0xFFF90CBD FORMAT "%5.1" /end MEASUREMENT
/begin MEASUREMENT Spi_Cg208a.C30_regDia "F2386: Cg208 register structure / " UBYTE X1_S1 1 100 0 255 ECU_ADDRESS 0xFFF90CBE FORMAT "%5.1" /end MEASUREMENT
/begin MEASUREMENT Spi_Cg208a.C31_empty "F2386: Cg208 register structure / " UBYTE X1_S1 1 100 0 255 ECU_ADDRESS 0xFFF90CC7 FORMAT "%5.1" /end MEASUREMENT
/begin MEASUREMENT Spi_Cg208a.C31_regCur "F2386: Cg208 register structure / " UWORD X1_S1 1 100 0 65535 ECU_ADDRESS 0xFFF90CC0 FORMAT "%8.2" /end MEASUREMENT
/begin MEASUREMENT Spi_Cg208a.C31_regCurDelta "F2386: Cg208 register structure / " UWORD X1_S1 1 100 0 65535 ECU_ADDRESS 0xFFF90CC2 FORMAT "%8.2" /end MEASUREMENT
/begin MEASUREMENT Spi_Cg208a.C31_regDam "F2386: Cg208 register structure / " UBYTE X1_S1 1 100 0 255 ECU_ADDRESS 0xFFF90CC4 FORMAT "%5.1" /end MEASUREMENT
/begin MEASUREMENT Spi_Cg208a.C31_regDfr "F2386: Cg208 register structure / " UBYTE X1_S1 1 100 0 255 ECU_ADDRESS 0xFFF90CC5 FORMAT "%5.1" /end MEASUREMENT
/begin MEASUREMENT Spi_Cg208a.C31_regDia "F2386: Cg208 register structure / " UBYTE X1_S1 1 100 0 255 ECU_ADDRESS 0xFFF90CC6 FORMAT "%5.1" /end MEASUREMENT
/begin MEASUREMENT Spi_Cg208a.C3_regCurDia "F2386: Cg208 register structure / " UBYTE X1_S1 1 100 0 255 ECU_ADDRESS 0xFFF90CB2 FORMAT "%5.1" /end MEASUREMENT
/begin MEASUREMENT Spi_Cg208a.C3_regIdent "F2386: Cg208 register structure / " UBYTE X1_S1 1 100 0 255 ECU_ADDRESS 0xFFF90CB0 FORMAT "%5.1" /end MEASUREMENT
/begin MEASUREMENT Spi_Cg208a.C3_regInt "F2386: Cg208 register structure / " UBYTE X1_S1 1 100 0 255 ECU_ADDRESS 0xFFF90CB7 FORMAT "%5.1" /end MEASUREMENT
/begin MEASUREMENT Spi_Cg208a.C3_regModeIn "F2386: Cg208 register structure / " UBYTE X1_S1 1 100 0 255 ECU_ADDRESS 0xFFF90CB4 FORMAT "%5.1" /end MEASUREMENT
/begin MEASUREMENT Spi_Cg208a.C3_regModeOut "F2386: Cg208 register structure / " UBYTE X1_S1 1 100 0 255 ECU_ADDRESS 0xFFF90CB3 FORMAT "%5.1" /end MEASUREMENT
/begin MEASUREMENT Spi_Cg208a.C3_regOsz "F2386: Cg208 register structure / " UBYTE X1_S1 1 100 0 255 ECU_ADDRESS 0xFFF90CB5 FORMAT "%5.1" /end MEASUREMENT
/begin MEASUREMENT Spi_Cg208a.C3_regRev "F2386: Cg208 register structure / " UBYTE X1_S1 1 100 0 255 ECU_ADDRESS 0xFFF90CB1 FORMAT "%5.1" /end MEASUREMENT
/begin MEASUREMENT Spi_Cg208a.C3_regSet "F2386: Cg208 register structure / " UBYTE X1_S1 1 100 0 255 ECU_ADDRESS 0xFFF90CB6 FORMAT "%5.1" /end MEASUREMENT
/begin MEASUREMENT Spi_Cg208a.C3_stEmpty "F2386: Cg208 register structure / " UBYTE X1_S1 1 100 0 255 ECU_ADDRESS 0xFFF90CAF FORMAT "%5.1" /end MEASUREMENT
/begin MEASUREMENT Spi_Cg208a.C3_stErrDatMsk "F2386: Cg208 register structure / " UBYTE X1_S1 1 100 0 255 ECU_ADDRESS 0xFFF90CAE FORMAT "%5.1" /end MEASUREMENT
/begin MEASUREMENT Spi_Cg208a.C3_stErrMsk "F2386: Cg208 register structure / " UBYTE X1_S1 1 100 0 255 ECU_ADDRESS 0xFFF90CAD FORMAT "%5.1" /end MEASUREMENT
/begin MEASUREMENT Spi_Cg208a.C3_stOkMsk "F2386: Cg208 register structure / " UBYTE X1_S1 1 100 0 255 ECU_ADDRESS 0xFFF90CAC FORMAT "%5.1" /end MEASUREMENT
/begin MEASUREMENT Spi_Cg208a.C40_empty "F2386: Cg208 register structure / " UBYTE X1_S1 1 100 0 255 ECU_ADDRESS 0xFFF90CDB FORMAT "%5.1" /end MEASUREMENT
/begin MEASUREMENT Spi_Cg208a.C40_regCur "F2386: Cg208 register structure / " UWORD X1_S1 1 100 0 65535 ECU_ADDRESS 0xFFF90CD4 FORMAT "%8.2" /end MEASUREMENT
/begin MEASUREMENT Spi_Cg208a.C40_regCurDelta "F2386: Cg208 register structure / " UWORD X1_S1 1 100 0 65535 ECU_ADDRESS 0xFFF90CD6 FORMAT "%8.2" /end MEASUREMENT
/begin MEASUREMENT Spi_Cg208a.C40_regDam "F2386: Cg208 register structure / " UBYTE X1_S1 1 100 0 255 ECU_ADDRESS 0xFFF90CD8 FORMAT "%5.1" /end MEASUREMENT
/begin MEASUREMENT Spi_Cg208a.C40_regDfr "F2386: Cg208 register structure / " UBYTE X1_S1 1 100 0 255 ECU_ADDRESS 0xFFF90CD9 FORMAT "%5.1" /end MEASUREMENT
/begin MEASUREMENT Spi_Cg208a.C40_regDia "F2386: Cg208 register structure / " UBYTE X1_S1 1 100 0 255 ECU_ADDRESS 0xFFF90CDA FORMAT "%5.1" /end MEASUREMENT
/begin MEASUREMENT Spi_Cg208a.C41_empty "F2386: Cg208 register structure / " UBYTE X1_S1 1 100 0 255 ECU_ADDRESS 0xFFF90CE3 FORMAT "%5.1" /end MEASUREMENT
/begin MEASUREMENT Spi_Cg208a.C41_regCur "F2386: Cg208 register structure / " UWORD X1_S1 1 100 0 65535 ECU_ADDRESS 0xFFF90CDC FORMAT "%8.2" /end MEASUREMENT
/begin MEASUREMENT Spi_Cg208a.C41_regCurDelta "F2386: Cg208 register structure / " UWORD X1_S1 1 100 0 65535 ECU_ADDRESS 0xFFF90CDE FORMAT "%8.2" /end MEASUREMENT
/begin MEASUREMENT Spi_Cg208a.C41_regDam "F2386: Cg208 register structure / " UBYTE X1_S1 1 100 0 255 ECU_ADDRESS 0xFFF90CE0 FORMAT "%5.1" /end MEASUREMENT
/begin MEASUREMENT Spi_Cg208a.C41_regDfr "F2386: Cg208 register structure / " UBYTE X1_S1 1 100 0 255 ECU_ADDRESS 0xFFF90CE1 FORMAT "%5.1" /end MEASUREMENT
/begin MEASUREMENT Spi_Cg208a.C41_regDia "F2386: Cg208 register structure / " UBYTE X1_S1 1 100 0 255 ECU_ADDRESS 0xFFF90CE2 FORMAT "%5.1" /end MEASUREMENT
/begin MEASUREMENT Spi_Cg208a.C4_regCurDia "F2386: Cg208 register structure / " UBYTE X1_S1 1 100 0 255 ECU_ADDRESS 0xFFF90CCE FORMAT "%5.1" /end MEASUREMENT
/begin MEASUREMENT Spi_Cg208a.C4_regIdent "F2386: Cg208 register structure / " UBYTE X1_S1 1 100 0 255 ECU_ADDRESS 0xFFF90CCC FORMAT "%5.1" /end MEASUREMENT
/begin MEASUREMENT Spi_Cg208a.C4_regInt "F2386: Cg208 register structure / " UBYTE X1_S1 1 100 0 255 ECU_ADDRESS 0xFFF90CD3 FORMAT "%5.1" /end MEASUREMENT
/begin MEASUREMENT Spi_Cg208a.C4_regModeIn "F2386: Cg208 register structure / " UBYTE X1_S1 1 100 0 255 ECU_ADDRESS 0xFFF90CD0 FORMAT "%5.1" /end MEASUREMENT
/begin MEASUREMENT Spi_Cg208a.C4_regModeOut "F2386: Cg208 register structure / " UBYTE X1_S1 1 100 0 255 ECU_ADDRESS 0xFFF90CCF FORMAT "%5.1" /end MEASUREMENT
/begin MEASUREMENT Spi_Cg208a.C4_regOsz "F2386: Cg208 register structure / " UBYTE X1_S1 1 100 0 255 ECU_ADDRESS 0xFFF90CD1 FORMAT "%5.1" /end MEASUREMENT
/begin MEASUREMENT Spi_Cg208a.C4_regRev "F2386: Cg208 register structure / " UBYTE X1_S1 1 100 0 255 ECU_ADDRESS 0xFFF90CCD FORMAT "%5.1" /end MEASUREMENT
/begin MEASUREMENT Spi_Cg208a.C4_regSet "F2386: Cg208 register structure / " UBYTE X1_S1 1 100 0 255 ECU_ADDRESS 0xFFF90CD2 FORMAT "%5.1" /end MEASUREMENT
/begin MEASUREMENT Spi_Cg208a.C4_stEmpty "F2386: Cg208 register structure / " UBYTE X1_S1 1 100 0 255 ECU_ADDRESS 0xFFF90CCB FORMAT "%5.1" /end MEASUREMENT
/begin MEASUREMENT Spi_Cg208a.C4_stErrDatMsk "F2386: Cg208 register structure / " UBYTE X1_S1 1 100 0 255 ECU_ADDRESS 0xFFF90CCA FORMAT "%5.1" /end MEASUREMENT
/begin MEASUREMENT Spi_Cg208a.C4_stErrMsk "F2386: Cg208 register structure / " UBYTE X1_S1 1 100 0 255 ECU_ADDRESS 0xFFF90CC9 FORMAT "%5.1" /end MEASUREMENT
/begin MEASUREMENT Spi_Cg208a.C4_stOkMsk "F2386: Cg208 register structure / " UBYTE X1_S1 1 100 0 255 ECU_ADDRESS 0xFFF90CC8 FORMAT "%5.1" /end MEASUREMENT
/begin MEASUREMENT T1ms_ti "F2360: Measured 1ms system time" ULONG TI1_M_S1 1 100 0 4294967295 ECU_ADDRESS 0xFFF90628 FORMAT "%13.2" /end MEASUREMENT
/begin FUNCTION F2355_ECE_ADC "F2355: Analog channels of the ECU encapsulation"
 /begin DEF_CHARACTERISTIC ECE_facAdcA_C ECE_facAdcAmux_C ECE_facAdcB_C ECE_numAdcFir_C ECE_numAdcNoiFir_C ECE_uAdcNoiDecrLim_C ECE_uAdcNoiJumpLim_C /end DEF_CHARACTERISTIC
 /begin OUT_MEASUREMENT ECE_bAdcStopA ECE_bAdcStopB ECE_ctAdcDmaOvrFlw ECE_regAdcDiagDiffA ECE_regAdcDiagDiffB ECE_tiAdcA.ctDiff ECE_tiAdcA.tiDiff ECE_tiAdcA.tiStamp ECE_uAdcA ECE_uAdcAmux ECE_uAdcB ECE_uBatt ECE_uBattMin ECE_uBattNoi ECE_uBattNoiInt ECE_uBattSwt ECE_uM2 ECE_uM3 ECE_uPSply ECE_uSSply ECE_uVASIC ECE_uVDD3 ECE_uWAK1 ECE_uWAK2 /end OUT_MEASUREMENT
/end FUNCTION
/begin FUNCTION F2357_ECE_CAN "F2357: ECE-CAN wake-up handling" /begin DEF_CHARACTERISTIC ECE_CAN_stWakUpCheck_C /end DEF_CHARACTERISTIC /begin OUT_MEASUREMENT ECE_sCanStartup /end OUT_MEASUREMENT /end FUNCTION
/begin FUNCTION F2359_ECE_PWD "F2359: pulse-width-demodulation" /begin DEF_CHARACTERISTIC ECE_PWD_tiDscr_C /end DEF_CHARACTERISTIC /begin IN_MEASUREMENT ECE_idxDmy /end IN_MEASUREMENT /begin OUT_MEASUREMENT ECE_qtiPwd ECE_tiPwdDuty ECE_tiPwdPer /end OUT_MEASUREMENT /end FUNCTION
/begin FUNCTION F2360_ECE_TIMER_M "F2360: Timer Channels (only measurement)"
 /begin OUT_MEASUREMENT CPU_TimerFastTicks_u32 CPU_TimerTicks_u32 ECE_bCpuClockActive ECE_bPclk T1ms_ti /end OUT_MEASUREMENT
/end FUNCTION
/begin FUNCTION F2364_ECE_FRQ "F2364: Frequency input speed ECE driver"
 /begin DEF_CHARACTERISTIC ECE_FRQ_fac_C ECE_FRQ_nMin_C ECE_FRQ_numFifo_C ECE_FRQ_numGradFifo_C ECE_FRQ_numPlsPerRev_C ECE_FRQ_stAvail_C ECE_FRQ_tiCfg_C /end DEF_CHARACTERISTIC
 /begin IN_MEASUREMENT ECE_idxDmy /end IN_MEASUREMENT
 /begin OUT_MEASUREMENT ECE_FRQ_ctPls ECE_FRQ_dn ECE_FRQ_n ECE_FRQ_qdn ECE_FRQ_qn ECE_FRQ_stHwDiag ECE_FRQ_tiPls /end OUT_MEASUREMENT
/end FUNCTION
/begin FUNCTION F2366_ECE_CC08 "F2366: CG208 driver support (CC=current control)"
 /begin DEF_CHARACTERISTIC ECE_CC08_bUseDither_C ECE_CC08_regInt_C ECE_CC08_regMode_C ECE_CC08_regOsc_C ECE_CC08_regRound_C ECE_CC08_regSet_C ECE_CC08_stAvail_C ECE_CC08_stOnOffMode_C ECE_CC08_stSpiDiaDynMsk_C ECE_CC08_tiDfrInit_C ECE_CC08_tiDithIsrFast_C ECE_CC08_tiDithIsrSlow_C ECE_CC08_tiSyncInit_C ECE_CC08_tiSyncPhaseDlyInit_C ECE_CC08_xDithGrpAssign_C ECE_CC08_xSyncGrpAssign_C /end DEF_CHARACTERISTIC
 /begin IN_MEASUREMENT ECE_idxDmy /end IN_MEASUREMENT
 /begin OUT_MEASUREMENT ECE_CC08_bDiaDly ECE_CC08_ctMissDithIsr ECE_CC08_iAct ECE_CC08_iActDelta ECE_CC08_iCmd ECE_CC08_iDam ECE_CC08_idxDithGrpAssign ECE_CC08_idxSyncGrpAssign ECE_CC08_regDfr ECE_CC08_regInt ECE_CC08_regOsc ECE_CC08_regRound ECE_CC08_regSet ECE_CC08_stModeAct ECE_CC08_stModeCmd ECE_CC08_stSpiDiag ECE_CC08_stVersion ECE_CC08_tiDithIsr ECE_CC08_tiFdbkDuty ECE_CC08_tiFdbkPer ECE_CC08_tiSync ECE_CC08_tiSyncChn /end OUT_MEASUREMENT
/end FUNCTION
/begin FUNCTION F2369_ECE_LSS "F2369: Low-Side Outputs with Cg124-AMux feedback"
 /begin DEF_CHARACTERISTIC ECE_LSS_rMax_C ECE_LSS_rMin_C ECE_LSS_stAvail_C ECE_LSS_stProt_C ECE_LSS_tiPerCmdInit_C /end DEF_CHARACTERISTIC
 /begin OUT_MEASUREMENT ECE_LSS_numDuty ECE_LSS_numNoDuty ECE_LSS_rAct ECE_LSS_rCmd ECE_LSS_rCmdAct ECE_LSS_stStatHw ECE_LSS_tiPerAct ECE_LSS_tiPerCmd ECE_LSS_uDuty ECE_LSS_uNoDuty /end OUT_MEASUREMENT
/end FUNCTION
/begin FUNCTION F2371_ECE_PWM "F2371: general PWM Outputs with non-synchronized feedback" /begin DEF_CHARACTERISTIC ECE_PWM_stPolOut_C ECE_PWM_tiPerInit_C /end DEF_CHARACTERISTIC /begin OUT_MEASUREMENT ECE_PWM_tiDutyCmd ECE_PWM_tiPerCmd /end OUT_MEASUREMENT /end FUNCTION
/begin FUNCTION F2385_ECE_SPI "F2385: ECE_SPI signal driver" /begin DEF_CHARACTERISTIC ECE_Cg124_regInit_C ECE_Cg130_regInit2_C /end DEF_CHARACTERISTIC
 /begin OUT_MEASUREMENT ECE_Cg124_regInit ECE_Cg130_regInit2 ECE_SPI_bCg124_stSpiOk ECE_SPI_bCg130_stSpiOk ECE_SPI_regHsdPort ECE_SPI_stSpiCore ECE_Stlk_bSpiOff ECE_bDN ECE_bOvrTmpRstrt ECE_bSSplyReq ECE_bWak1 ECE_bWak2 ECE_bWakIntern ECE_bWdRst ECE_bWdRstFirst ECE_bWdRstReq ECE_bWdRstReqCmpl ECE_regSysChpTemp ECE_sModeCfgReq ECE_sSpiRead ECE_stCg130Version ECE_stLines ECE_stOTA ECE_stPclk ECE_stSysChpTemp ECE_stSysChpTempOT ECE_tChpExt Spi_Cg124_regDiaFirst Spi_Cg130_regDia1First Spi_Cg130_regDia2First Spi_Cg130_regDia3First /end OUT_MEASUREMENT
/end FUNCTION
/begin FUNCTION F2386_SPICC08 "F2386: CG208 SPI sequence handling"
 /begin OUT_MEASUREMENT SpiCc08_DIA_regRx SpiCc08_DIA_regTx SpiCc08_ID_regRx SpiCc08_ID_regTx SpiCc08_OUTFX_regRx SpiCc08_OUTFX_regTx SpiCc08_OUTI_regRx SpiCc08_OUTI_regTx SpiCc08_OUTP_regRx SpiCc08_OUTP_regTx SpiCc08_st Spi_Cg208a.C00_empty Spi_Cg208a.C00_regCur Spi_Cg208a.C00_regCurDelta Spi_Cg208a.C00_regDam Spi_Cg208a.C00_regDfr Spi_Cg208a.C00_regDia Spi_Cg208a.C01_empty Spi_Cg208a.C01_regCur Spi_Cg208a.C01_regCurDelta Spi_Cg208a.C01_regDam Spi_Cg208a.C01_regDfr Spi_Cg208a.C01_regDia Spi_Cg208a.C0_regCurDia Spi_Cg208a.C0_regIdent Spi_Cg208a.C0_regInt Spi_Cg208a.C0_regModeIn Spi_Cg208a.C0_regModeOut Spi_Cg208a.C0_regOsz Spi_Cg208a.C0_regRev Spi_Cg208a.C0_regSet Spi_Cg208a.C0_stEmpty Spi_Cg208a.C0_stErrDatMsk Spi_Cg208a.C0_stErrMsk Spi_Cg208a.C0_stOkMsk Spi_Cg208a.C10_empty Spi_Cg208a.C10_regCur Spi_Cg208a.C10_regCurDelta Spi_Cg208a.C10_regDam Spi_Cg208a.C10_regDfr Spi_Cg208a.C10_regDia Spi_Cg208a.C11_empty Spi_Cg208a.C11_regCur Spi_Cg208a.C11_regCurDelta Spi_Cg208a.C11_regDam Spi_Cg208a.C11_regDfr Spi_Cg208a.C11_regDia Spi_Cg208a.C1_regCurDia Spi_Cg208a.C1_regIdent Spi_Cg208a.C1_regInt Spi_Cg208a.C1_regModeIn Spi_Cg208a.C1_regModeOut Spi_Cg208a.C1_regOsz Spi_Cg208a.C1_regRev Spi_Cg208a.C1_regSet Spi_Cg208a.C1_stEmpty Spi_Cg208a.C1_stErrDatMsk Spi_Cg208a.C1_stErrMsk Spi_Cg208a.C1_stOkMsk Spi_Cg208a.C20_empty Spi_Cg208a.C20_regCur Spi_Cg208a.C20_regCurDelta Spi_Cg208a.C20_regDam Spi_Cg208a.C20_regDfr Spi_Cg208a.C20_regDia Spi_Cg208a.C21_empty Spi_Cg208a.C21_regCur Spi_Cg208a.C21_regCurDelta Spi_Cg208a.C21_regDam Spi_Cg208a.C21_regDfr Spi_Cg208a.C21_regDia Spi_Cg208a.C2_regCurDia Spi_Cg208a.C2_regIdent Spi_Cg208a.C2_regInt Spi_Cg208a.C2_regModeIn Spi_Cg208a.C2_regModeOut Spi_Cg208a.C2_regOsz Spi_Cg208a.C2_regRev Spi_Cg208a.C2_regSet Spi_Cg208a.C2_stEmpty Spi_Cg208a.C2_stErrDatMsk Spi_Cg208a.C2_stErrMsk Spi_Cg208a.C2_stOkMsk Spi_Cg208a.C30_empty Spi_Cg208a.C30_regCur Spi_Cg208a.C30_regCurDelta Spi_Cg208a.C30_regDam Spi_Cg208a.C30_regDfr Spi_Cg208a.C30_regDia Spi_Cg208a.C31_empty Spi_Cg208a.C31_regCur Spi_Cg208a.C31_regCurDelta Spi_Cg208a.C31_regDam Spi_Cg208a.C31_regDfr Spi_Cg208a.C31_regDia Spi_Cg208a.C3_regCurDia Spi_Cg208a.C3_regIdent Spi_Cg208a.C3_regInt Spi_Cg208a.C3_regModeIn Spi_Cg208a.C3_regModeOut Spi_Cg208a.C3_regOsz Spi_Cg208a.C3_regRev Spi_Cg208a.C3_regSet Spi_Cg208a.C3_stEmpty Spi_Cg208a.C3_stErrDatMsk Spi_Cg208a.C3_stErrMsk Spi_Cg208a.C3_stOkMsk Spi_Cg208a.C40_empty Spi_Cg208a.C40_regCur Spi_Cg208a.C40_regCurDelta Spi_Cg208a.C40_regDam Spi_Cg208a.C40_regDfr Spi_Cg208a.C40_regDia Spi_Cg208a.C41_empty Spi_Cg208a.C41_regCur Spi_Cg208a.C41_regCurDelta Spi_Cg208a.C41_regDam Spi_Cg208a.C41_regDfr Spi_Cg208a.C41_regDia Spi_Cg208a.C4_regCurDia Spi_Cg208a.C4_regIdent Spi_Cg208a.C4_regInt Spi_Cg208a.C4_regModeIn Spi_Cg208a.C4_regModeOut Spi_Cg208a.C4_regOsz Spi_Cg208a.C4_regRev Spi_Cg208a.C4_regSet Spi_Cg208a.C4_stEmpty Spi_Cg208a.C4_stErrDatMsk Spi_Cg208a.C4_stErrMsk Spi_Cg208a.C4_stOkMsk /end OUT_MEASUREMENT
/end FUNCTION
/begin FUNCTION F2386_SPICORE_M "F2386: CG124/CG130 SPI sequence handling"
 /begin OUT_MEASUREMENT SpiCore_DIA_regRx SpiCore_DIA_regTx SpiCore_ID_regRx SpiCore_ID_regTx SpiCore_OUT_regRx SpiCore_OUT_regTx SpiCore_TEMP_regRx SpiCore_TEMP_regTx SpiCore_stCg124 SpiCore_stCg130 Spi_Cg124.regDInit Spi_Cg124.regDia Spi_Cg124.regIdent Spi_Cg124.regRev Spi_Cg124.regStat Spi_Cg124.stEmpty Spi_Cg124.stErrDatMsk Spi_Cg124.stErrMsk Spi_Cg124.stOkMsk Spi_Cg130.regDia1 Spi_Cg130.regDia2 Spi_Cg130.regDia3 Spi_Cg130.regIdent Spi_Cg130.regInit1 Spi_Cg130.regInit1r Spi_Cg130.regInit2 Spi_Cg130.regInit2r Spi_Cg130.regRev Spi_Cg130.regTemp Spi_Cg130.stEmpty Spi_Cg130.stErrDatMsk Spi_Cg130.stErrMsk Spi_Cg130.stOkMsk Spi_Cg130.stTemp /end OUT_MEASUREMENT
/end FUNCTION
/begin FUNCTION F2391_ECE_WDT_M "F2391: watchdog-timer (WDT) and protection (only measurement)" /begin OUT_MEASUREMENT ECE_WDT_bHsdOff ECE_WDT_bWdtMode ECE_WDT_tiMrgnMinEe /end OUT_MEASUREMENT /end FUNCTION
/begin FUNCTION F2392_ECE_IWD_M "F2392: CG130 watchdog handling (measurement only)"
 /begin OUT_MEASUREMENT ECE_IWD_RESP_regRx ECE_IWD_RESP_regTx ECE_IWD_TIME_regRx ECE_IWD_TIME_regTx ECE_IWD_bActive ECE_IWD_reg.ctRESP ECE_IWD_reg.ctTIME ECE_IWD_reg.regREQUHI ECE_IWD_reg.regREQULO ECE_IWD_reg.regRESP ECE_IWD_reg.regRESP_TIME_RX ECE_IWD_reg.regRESP_TIME_TX ECE_IWD_reg.stEmpty ECE_IWD_reg.stErrDatMsk ECE_IWD_reg.stErrMsk ECE_IWD_reg.stOkMsk ECE_IWD_reg.tiSpiTransfer ECE_IWD_tiAct ECE_IWD_tiDly /end OUT_MEASUREMENT
/end FUNCTION
/begin FUNCTION F2397_ECE_PSPLY "F2397: ECE_PSPLY power supply driver"
 /begin DEF_CHARACTERISTIC ECE_PSPLY_idxSpi_C ECE_PSPLY_stHssForceOn_C ECE_PSPLY_stHssSafOff_C /end DEF_CHARACTERISTIC
 /begin OUT_MEASUREMENT ECE_bPSplyOvrCurr ECE_bPSplyReq /end OUT_MEASUREMENT
/end FUNCTION
/begin FUNCTION F2410_InpPBatL2 "F2410: Battery voltage detection"
 /begin DEF_CHARACTERISTIC InpPBatL2_tiBattDiff_C InpPBatL2_tiBattLoVltg_C InpPBatL2_tiBattNoiVBS_C InpPBatL2_tiBattNoi_C InpPBatL2_uBattLoLim_C InpPBatL2_uBattNoiLi_C InpPBatL2_uBattSwtCal_C InpPBatL2_uBattTolc_C InpPBatL2_uBattUpLim_C /end DEF_CHARACTERISTIC
 /begin OUT_MEASUREMENT InpPBatL2_bBattNoiVBS InpPBatL2_stBatt InpPBatL2_tiBattDiff InpPBatL2_tiBattLoVltg InpPBatL2_tiBattNoi InpPBatL2_tiBattNoiVBS InpPBatL2_uBattDrop InpPBatL2_uBattSwt /end OUT_MEASUREMENT
/end FUNCTION
/begin FUNCTION F2410_InpPBatL3 "F2410: Battery voltage recognition" /begin OUT_MEASUREMENT InpPBatL3_stBattFault InpPBatL3_stBattTstCon /end OUT_MEASUREMENT /end FUNCTION
/begin FUNCTION F2410_InpPIfcBatt "F2410: Battery voltage detection"
 /begin OUT_MEASUREMENT InpPIfcBatt_efBattNoi InpPIfcBatt_quBatt InpPIfcBatt_uBatt InpPIfcBatt_uBatt8 InpPIfcBatt_uBattMin InpPIfcBatt_uBattNoi /end OUT_MEASUREMENT
/end FUNCTION
/begin FUNCTION F2411_InpPIfcPSupp "F2411: Power Supply Actuators (HSx)"
 /begin OUT_MEASUREMENT InpPIfcPSupp_quBattSply InpPIfcPSupp_quPSply InpPIfcPSupp_uBattSply InpPIfcPSupp_uPSply InpPIfcPSupp_uPSply8 /end OUT_MEASUREMENT
/end FUNCTION
/begin FUNCTION F2411_InpPPSplyL3 "F2411: Power Supply Actuators (HSx)"
 /begin DEF_CHARACTERISTIC InpPPSplyL3_bPrs_C InpPPSplyL3_swtBattSply_C InpPPSplyL3_uThres_C /end DEF_CHARACTERISTIC
/end FUNCTION
/begin FUNCTION F2413_InpPIfcSens "F2413: Sensor Supply Voltage" /begin OUT_MEASUREMENT InpPIfcSens_uSSply /end OUT_MEASUREMENT /end FUNCTION
/begin FUNCTION F2415_InpPIfcM2M3 "F2415: Internal voltage detection M2/M3"
 /begin OUT_MEASUREMENT InpPIfcM2M3_quM2 InpPIfcM2M3_quM3 InpPIfcM2M3_uM2 InpPIfcM2M3_uM3 /end OUT_MEASUREMENT
/end FUNCTION
/begin FUNCTION F2420_InpPIfcWake "F2420: Wake up signal recognition"
 /begin OUT_MEASUREMENT InpPIfcWake_bWak1 InpPIfcWake_bWak2 InpPIfcWake_bWakInt InpPIfcWake_bWakPhys InpPIfcWake_qbWak1 InpPIfcWake_qbWak2 InpPIfcWake_qbWakInt InpPIfcWake_qbWakPhys InpPIfcWake_quWak1 InpPIfcWake_quWak2 InpPIfcWake_uWak1 InpPIfcWake_uWak2 /end OUT_MEASUREMENT
/end FUNCTION
/begin FUNCTION F2420_InpPWakL2 "F2420: Wake up signal recognition"
 /begin DEF_CHARACTERISTIC InpPWakL2_bWak1SrcSel_C InpPWakL2_swtPrsWak2_C InpPWakL2_uThresWak_C InpPWakL2_uWak1ThresOn_C /end DEF_CHARACTERISTIC
/end FUNCTION
/begin FUNCTION F2430_InpPTosL2 "F2430: Transmission output speed (Layer2)"
 /begin DEF_CHARACTERISTIC InpPTosL2_fHwDiaMax_C InpPTosL2_fThresHwProt_C InpPTosL2_tiFault_C InpPTosL2_uSplyMin_C /end DEF_CHARACTERISTIC
 /begin OUT_MEASUREMENT InpPTosL2_fEce InpPTosL2_nErrCyclCnt InpPTosL2_stTos InpPTosL2_stTosHwDia InpPTosL2_stTosOld InpPTosL2_tiFault /end OUT_MEASUREMENT
/end FUNCTION
/begin FUNCTION F2430_InpPTosL3 "F2430: Transmission output speed (Layer3)" /begin DEF_CHARACTERISTIC InpPTosL3_tiSSplyDel_C /end DEF_CHARACTERISTIC
 /begin OUT_MEASUREMENT InpPTosL3_stTosFault InpPTosL3_stTosTstCon InpPTosL3_tiSSplyDel /end OUT_MEASUREMENT
/end FUNCTION
/begin FUNCTION F2431_InpPTisL2 "F2431: Transmission input speed (Layer2)"
 /begin DEF_CHARACTERISTIC InpPTisL2_fHwDiaMax_C InpPTisL2_fThresHwProt_C InpPTisL2_tiFault_C InpPTisL2_uSplyMin_C /end DEF_CHARACTERISTIC
 /begin OUT_MEASUREMENT InpPTisL2_fEce InpPTisL2_nErrCyclCnt InpPTisL2_stTis InpPTisL2_stTisHwDia InpPTisL2_stTisOld InpPTisL2_tiFault /end OUT_MEASUREMENT
/end FUNCTION
/begin FUNCTION F2431_InpPTisL3 "F2431: Transmission input speed (Layer3)" /begin DEF_CHARACTERISTIC InpPTisL3_tiSSplyDel_C /end DEF_CHARACTERISTIC
 /begin OUT_MEASUREMENT InpPTisL3_stTisFault InpPTisL3_stTisTstCon InpPTisL3_tiSSplyDel /end OUT_MEASUREMENT
/end FUNCTION
/begin FUNCTION F2440_InpPAtfL2 "F2440: ATF (transmission oil) temperature recognition"
 /begin DEF_CHARACTERISTIC InpPAtfL2_facAtfMax_C InpPAtfL2_facAtfMin_C InpPAtfL2_idxAtfVarCnv_C InpPAtfL2_idxAtfVarDfl_C InpPAtfL2_swtAtfVarErr_C InpPAtfL2_tAtfCnvAbs_C[0] InpPAtfL2_tAtfCnvAbs_C[1] InpPAtfL2_tAtfRepl_C InpPAtfL2_tiAtfErr_C InpPAtfL2_tiAtfIniDel_C InpPAtfL2_uAtfGradMax_C InpPAtfL2_uAtfHiMax_C InpPAtfL2_uAtfHiMin_C InpPAtfL2_uAtfLoMax_C InpPAtfL2_uAtfLoMin_C InpPAtfL2_uAtfSensMax_C InpPAtfL2_uAtfSensMin_C /end DEF_CHARACTERISTIC
 /begin OUT_MEASUREMENT InpPAtfL2_efAtfVarEEP InpPAtfL2_facAtf InpPAtfL2_idxAtfVar InpPAtfL2_idxAtfVarEEP InpPAtfL2_idxAtfVarTab InpPAtfL2_qtAtf InpPAtfL2_stAtf InpPAtfL2_tAtf InpPAtfL2_tiAtfErr InpPAtfL2_tiAtfIniDel InpPAtfL2_uAtfGrad InpPAtfL2_uAtfHi InpPAtfL2_uAtfLo InpPAtfL2_uAtfSens InpPAtfL2_uAtfSensOld InpPAtfL2_yDmy /end OUT_MEASUREMENT
/end FUNCTION
/begin FUNCTION F2440_InpPAtfL3 "F2440: ATF (transmission oil) temperature recognition"
 /begin DEF_CHARACTERISTIC InpPAtfL3_stSubsPtd_C InpPAtfL3_tSubsAtf2Ofs_C InpPAtfL3_tSubsChpOfs_C /end DEF_CHARACTERISTIC
 /begin OUT_MEASUREMENT InpPAtfL3_stAtfFault InpPAtfL3_stAtfTstCon InpPAtfL3_stSubsQualOk InpPAtfL3_stSubsUsd /end OUT_MEASUREMENT
/end FUNCTION
/begin FUNCTION F2440_InpPIfcTemp "F2440: ATF (transmission oil) temperature recognition"
 /begin OUT_MEASUREMENT InpPIfcTemp_qtAtf InpPIfcTemp_qtAtfHw InpPIfcTemp_qtAtfPhys InpPIfcTemp_tAtf InpPIfcTemp_tAtf8 InpPIfcTemp_tAtf8Phys InpPIfcTemp_tAtfHw InpPIfcTemp_tAtfPhys /end OUT_MEASUREMENT
/end FUNCTION
/begin FUNCTION F2442_InpPChipL2 "F2442: Calculation of the CG130 chip temperature (Chp1 = internal sensor)"
 /begin DEF_CHARACTERISTIC InpPChipL2_tChpAdjOfsCal_C InpPChipL2_tChpDigThresHiLoLim_C InpPChipL2_tChpDigThresHiUpLim_C InpPChipL2_tChpDigThresLoLoLim_C InpPChipL2_tChpDigThresLoUpLim_C InpPChipL2_tChpIni_C InpPChipL2_tiChpFault_C InpPChipL2_tiChpIniDel_C InpPChipL2_xChpAdjMulCal_C InpPChipL2_xChpRawMax_C InpPChipL2_xChpRawMin_C /end DEF_CHARACTERISTIC
 /begin OUT_MEASUREMENT InpPChipL2_bChpHw InpPChipL2_idxChpHwVers InpPChipL2_qtChp InpPChipL2_rChp InpPChipL2_rChpOld InpPChipL2_stChp InpPChipL2_stChpOld InpPChipL2_tChp InpPChipL2_tiChpFault InpPChipL2_tiChpIniDel /end OUT_MEASUREMENT
/end FUNCTION
/begin FUNCTION F2442_InpPChipL3 "F2442: Calculation of the CG130 chip temperature (Chp1 = internal sensor)"
 /begin DEF_CHARACTERISTIC InpPChipL3_stSubsPtd_C InpPChipL3_tSubsAtfOfs_C InpPChipL3_tSubsChp2Ofs_C /end DEF_CHARACTERISTIC
 /begin OUT_MEASUREMENT InpPChipL3_stChpFault InpPChipL3_stChpTstCon InpPChipL3_stSubsUsd /end OUT_MEASUREMENT
/end FUNCTION
/begin FUNCTION F2442_InpPIfcChip "F2442: Calculation of the chip temperature"
 /begin OUT_MEASUREMENT InpPIfcChip_qtChp InpPIfcChip_qtChp1 InpPIfcChip_tChp InpPIfcChip_tChp1 InpPIfcChip_tChp18 InpPIfcChip_tChp8 /end OUT_MEASUREMENT
/end FUNCTION
/begin FUNCTION F2443_InpPChp2L2 "F2443: Calculation of the chip temperature 2"
 /begin DEF_CHARACTERISTIC InpPChp2L2_stPtt_C InpPChp2L2_tChp2Ini_C InpPChp2L2_tChp2MidDwn_C InpPChp2L2_tChp2MidUp_C InpPChp2L2_tChp2RawMax_C InpPChp2L2_tChp2RawMin_C InpPChp2L2_tiChp2Fault_C InpPChp2L2_tiChp2IniTo_C InpPChp2L2_xChp2RawIni_C /end DEF_CHARACTERISTIC
 /begin OUT_MEASUREMENT InpPChp2L2_rChp2 InpPChp2L2_rChp2Old InpPChp2L2_stChp2 InpPChp2L2_stChp2Old InpPChp2L2_tiChp2Fault InpPChp2L2_tiChp2IniTo /end OUT_MEASUREMENT
/end FUNCTION
/begin FUNCTION F2443_InpPChp2L3 "F2443: Calculation of the chip temperature 2" /begin OUT_MEASUREMENT InpPChp2L3_stChp2Fault InpPChp2L3_stChp2TstCon /end OUT_MEASUREMENT /end FUNCTION
/begin FUNCTION F2443_InpPIfcChp2 "F2443: Calculation of the chip temperature 2" /begin OUT_MEASUREMENT InpPIfcChp2_qtChp2 InpPIfcChp2_tChp2 InpPIfcChp2_tChp28 /end OUT_MEASUREMENT /end FUNCTION
/begin FUNCTION F2450_InpPIfcPsns "F2450: Position recognition of the position lever (L-Lines)" /begin OUT_MEASUREMENT InpPIfcPsns_bPsns InpPIfcPsns_qbPsns /end OUT_MEASUREMENT /end FUNCTION
/begin FUNCTION F2450_InpPPsnsL2 "F2450: Position recognition of the position lever (L-Lines)"
 /begin DEF_CHARACTERISTIC InpPPsnsL2_ctPsnsIni_C InpPPsnsL2_rPsnsAnaZon_C InpPPsnsL2_rPsnsOnOffThres_C InpPPsnsL2_tiFault_C InpPPsnsL2_uSSplyThres_C /end DEF_CHARACTERISTIC
 /begin OUT_MEASUREMENT InpPPsnsL2_bAna InpPPsnsL2_bAnaCpl InpPPsnsL2_bDig InpPPsnsL2_ctChnIdx InpPPsnsL2_ctPsnsIni InpPPsnsL2_ctRngIdx InpPPsnsL2_qbPsns InpPPsnsL2_rPsnsAna InpPPsnsL2_stPsnsAna InpPPsnsL2_stPsnsAnaErr InpPPsnsL2_stPsnsDFC InpPPsnsL2_stPsnsDig InpPPsnsL2_stPsnsDigChng InpPPsnsL2_stPsnsDigOld InpPPsnsL2_stPsnsPlausErr InpPPsnsL2_stPsnsSt InpPPsnsL2_tiFault /end OUT_MEASUREMENT
/end FUNCTION
/begin FUNCTION F2450_InpPPsnsL3 "F2450: Position recognition of the position lever (L-Lines)" /begin DEF_CHARACTERISTIC InpPPsnsL3_stPsnsChng_C InpPPsnsL3_stPsnsMon_C /end DEF_CHARACTERISTIC
 /begin OUT_MEASUREMENT InpPPsnsL3_bMonCondGen InpPPsnsL3_bPsnsDsmErr InpPPsnsL3_stPsnsAnaOld InpPPsnsL3_stPsnsChngErr InpPPsnsL3_stPsnsDFCOld InpPPsnsL3_stPsnsFault InpPPsnsL3_stPsnsOld InpPPsnsL3_stPsnsTstCon /end OUT_MEASUREMENT
/end FUNCTION
/begin FUNCTION F2510_OutPRstL3 "F2510: This will be called if a sensor reset is necessary"
 /begin DEF_CHARACTERISTIC OutPRstL3_tiHwDly_C OutPRstL3_tiSSplyMinOn_C OutPRstL3_tiSSplyOff_C /end DEF_CHARACTERISTIC
 /begin OUT_MEASUREMENT OutPRstL3_bRst OutPRstL3_sRst OutPRstL3_tiHwDly OutPRstL3_tiSSplyMinOn OutPRstL3_tiSSplyOff /end OUT_MEASUREMENT
/end FUNCTION
/begin FUNCTION F2510_OutPShCirL3 "F2510: This will detect a short circuit in the sensor supply voltage "
 /begin DEF_CHARACTERISTIC OutPShCirL3_stSSplyTstCond_C OutPShCirL3_tiLoBatt_C OutPShCirL3_tiMonDly_C OutPShCirL3_uSSplyAsicLos_C OutPShCirL3_uSSplyDiffSply_C OutPShCirL3_uSSplySBLoLim_C OutPShCirL3_uSSplySBUpLim_C OutPShCirL3_uSSplySGLoLim_C OutPShCirL3_uSSplySGUpLim_C OutPShCirL3_uSSplySwtOffLim_C OutPShCirL3_uTstLoBatt_C /end DEF_CHARACTERISTIC
 /begin OUT_MEASUREMENT OutPShCirL3_sSSplyShCir OutPShCirL3_stSSplyFault OutPShCirL3_stSSplyTstCond OutPShCirL3_tiLoBatt OutPShCirL3_tiMonDly /end OUT_MEASUREMENT
/end FUNCTION
/begin FUNCTION F2511_OutPSSply5Mon "F2511: Sensor supply 5V monitoring"
 /begin DEF_CHARACTERISTIC OutPSSply5Mon_stSSply5TstCond_C OutPSSply5Mon_uSSply5TstHi_C OutPSSply5Mon_uSSply5TstLo_C OutPSSply5Mon_uSSply5TstSB_C OutPSSply5Mon_uSSply5TstSG_C /end DEF_CHARACTERISTIC
 /begin OUT_MEASUREMENT OutPSSply5Mon_stSSply5Fault OutPSSply5Mon_stSSply5TstCond /end OUT_MEASUREMENT
/end FUNCTION
/begin FUNCTION F2520_OutPOpsCtl "F2520: Output Safety System Control"
 /begin DEF_CHARACTERISTIC OutPOpsCtl_numRepIpt_C OutPOpsCtl_swtBypIpt_C OutPOpsCtl_uUndrBatt_C /end DEF_CHARACTERISTIC
 /begin OUT_MEASUREMENT OutPOpsCtl_cntRepIpt OutPOpsCtl_sOpsMode OutPOpsCtl_stOpsFault OutPOpsCtl_stOpsTstCond OutPOpsCtl_xPSplySafRlvnt /end OUT_MEASUREMENT
/end FUNCTION
/begin FUNCTION F2520_OutPOpsTst "F2520: Inhibit-Path-Test"
 /begin DEF_CHARACTERISTIC OutPOpsTst_swtDbgEnbl_C OutPOpsTst_tiDnTOut_C OutPOpsTst_tiIptTOut_C OutPOpsTst_tiPSplyTOut_C OutPOpsTst_uBattIptMax_C OutPOpsTst_uBattIptMin_C /end DEF_CHARACTERISTIC
 /begin OUT_MEASUREMENT OutPOpsTst_sIpt OutPOpsTst_sIptPreHld OutPOpsTst_stPSplyRngFault OutPOpsTst_stSucTstMsk OutPOpsTst_stTst OutPOpsTst_stTstPreHld OutPOpsTst_tiDnTOut OutPOpsTst_tiIptTOut OutPOpsTst_tiIptTOutPreHld OutPOpsTst_tiPSplyTOut OutPOpsTst_tiPSplyTOutPreHld /end OUT_MEASUREMENT
/end FUNCTION
/begin FUNCTION F2523_OutPPSplyCtl "F2523: Power supply control"
 /begin DEF_CHARACTERISTIC OutPPSplyCtl_stPSplyAvl_C OutPPSplyCtl_stPSplySaf_C OutPPSplyCtl_tiPSplyBattLoStrt_C OutPPSplyCtl_tiPSplyBattLo_C OutPPSplyCtl_tiPSplyChngOff_C OutPPSplyCtl_tiPSplyChngOn_C OutPPSplyCtl_tiPSplyPrtSG_C OutPPSplyCtl_uPSplyBattLoHys_C OutPPSplyCtl_uPSplyBattLo_C /end DEF_CHARACTERISTIC
 /begin OUT_MEASUREMENT OutPPSplyCtl_bOpsDn OutPPSplyCtl_bPSplyIn OutPPSplyCtl_bPSplyOut OutPPSplyCtl_bPSplyOutL3 OutPPSplyCtl_sPSplyMode OutPPSplyCtl_stLdOpsOn OutPPSplyCtl_stLdPSplyOn OutPPSplyCtl_stOpsFault OutPPSplyCtl_stPSplyBattLo OutPPSplyCtl_stPSplyBattLoCpl OutPPSplyCtl_stPSplyIni OutPPSplyCtl_stPSplyOpsOn OutPPSplyCtl_stPSplySt OutPPSplyCtl_tiPSplyBattLo OutPPSplyCtl_tiPSplyBattLoCpl OutPPSplyCtl_tiPSplyChng OutPPSplyCtl_tiPSplyPrtSG /end OUT_MEASUREMENT
/end FUNCTION
/begin FUNCTION F2523_OutPPSplyMon "F2523: Power supply monitoring"
 /begin DEF_CHARACTERISTIC OutPPSplyMon_ctPSplyErrOP_C OutPPSplyMon_ctPSplyOPEvt_C OutPPSplyMon_stPSplyErrOP_C OutPPSplyMon_stPSplyHldDfe_C OutPPSplyMon_stPSplyOffSG_C OutPPSplyMon_stPSplyOpMSC_C OutPPSplyMon_stPSplySfrmPSply_C OutPPSplyMon_stPSplyTstCond_C OutPPSplyMon_tiPSplyRngDly_C OutPPSplyMon_tiPSplyRngWait_C OutPPSplyMon_uPSplyDiff_C OutPPSplyMon_uPSplyLimSG_C OutPPSplyMon_uPSplyTstHi_C OutPPSplyMon_uPSplyTstLo_C /end DEF_CHARACTERISTIC
 /begin OUT_MEASUREMENT OutPPSplyMon_ctPSplyErrOP OutPPSplyMon_ctPSplyOPEvt OutPPSplyMon_sPSplyOpM OutPPSplyMon_stPSplyFault OutPPSplyMon_stPSplyFaultOP OutPPSplyMon_stPSplyHldDfe OutPPSplyMon_stPSplyOffSGErr OutPPSplyMon_stPSplyOpMRng OutPPSplyMon_stPSplySfrm OutPPSplyMon_stPSplyTstCond OutPPSplyMon_stPSplyTstCondOP OutPPSplyMon_tiPSplyOpMRng OutPPSplyMon_xPSplyDmy OutPPSplyMon_yPSplyDmy /end OUT_MEASUREMENT
/end FUNCTION
/begin FUNCTION F2523_OutPPSplyOn "F2523: Power supply activation"
 /begin DEF_CHARACTERISTIC OutPPSplyOn_rPSplySB_C OutPPSplyOn_uPSplyClsdThres_C OutPPSplyOn_uPSplyOPHi_C OutPPSplyOn_uPSplyOPLo_C OutPPSplyOn_uPSplySG_C /end DEF_CHARACTERISTIC
 /begin OUT_MEASUREMENT OutPPSplyOn_bPSplyActv OutPPSplyOn_stPSplyRng /end OUT_MEASUREMENT
/end FUNCTION
/begin FUNCTION F2525_OutPLssCtl "F2525: Low side control (complement calculation)"
 /begin DEF_CHARACTERISTIC OutPLssCtl_stLssAvl_C OutPLssCtl_stLssDnConn_C OutPLssCtl_stLssReqPSply_C OutPLssCtl_uLssThresT15Hys_C OutPLssCtl_uLssThresT15_C OutPLssCtl_uLssThresT30Hys_C OutPLssCtl_uLssThresT30_C /end DEF_CHARACTERISTIC
 /begin OUT_MEASUREMENT OutPLssCtl_iLssIn OutPLssCtl_rLssIn OutPLssCtl_stLssOut OutPLssCtl_stLssOutL3 OutPLssCtl_stLssReqOff OutPLssCtl_stLssReqOn /end OUT_MEASUREMENT
/end FUNCTION
/begin FUNCTION F2525_OutPLssDuty "F2525: Low side duty output"
 /begin DEF_CHARACTERISTIC OutPLssDuty_facLssCrnt_C OutPLssDuty_stLssDutyLtdMax_C OutPLssDuty_stLssDutyLtdMin_C OutPLssDuty_stLssMode_C OutPLssDuty_stLssSelSply_C OutPLssDuty_tiLssPk_C OutPLssDuty_uLssDutyRef_C[0] OutPLssDuty_uLssDutyRef_C[1] OutPLssDuty_uLssDutyRef_C[2] OutPLssDuty_uLssDutyRef_C[3] OutPLssDuty_uLssDutyRef_C[4] /end DEF_CHARACTERISTIC
 /begin OUT_MEASUREMENT OutPLssDuty_rLssDuty OutPLssDuty_stLssActv OutPLssDuty_tAtf OutPLssDuty_tiLssPk OutPLssDuty_tiLssPkCpl OutPLssDuty_xLssIn /end OUT_MEASUREMENT
/end FUNCTION
/begin FUNCTION F2525_OutPLssMon "F2525: Low Side monitoring"
 /begin DEF_CHARACTERISTIC OutPLssMon_stLssChkHw_C OutPLssMon_stLssDetSGOP_C OutPLssMon_stLssSfrmLss_C OutPLssMon_stLssSfrmPSply_C OutPLssMon_stLssTstCond_C OutPLssMon_stPSplyErrOP_C OutPLssMon_tiLssChng_C OutPLssMon_tiLssSplyOn_C OutPLssMon_uLssTstHi_C OutPLssMon_uLssTstLo_C OutPLssMon_uLssTstOP_C OutPLssMon_uLssTstSB_C OutPLssMon_uLssTstSG_C /end DEF_CHARACTERISTIC
 /begin OUT_MEASUREMENT OutPLssMon_stLssFault OutPLssMon_stLssSfrm OutPLssMon_stLssTstCond OutPLssMon_tiLssChng OutPLssMon_tiLssSplyOn /end OUT_MEASUREMENT
/end FUNCTION
/begin FUNCTION F2531_OutPCc08Cfg "F2531: Current control configuration (Complement)" /begin DEF_CHARACTERISTIC OutPCc08Cfg_stCc08Mode_C /end DEF_CHARACTERISTIC
 /begin OUT_MEASUREMENT OutPCc08Cfg_iCc08EeChn OutPCc08Cfg_iCc08Out OutPCc08Cfg_stCc08Actv /end OUT_MEASUREMENT
/end FUNCTION
/begin FUNCTION F2531_OutPCc08Crnt "F2531: Evaluation of incoming current"
 /begin DEF_CHARACTERISTIC OutPCc08Crnt_iCc08CrntHys_C OutPCc08Crnt_stCc08CrntEval_C OutPCc08Crnt_tiCc08CrntChng_C OutPCc08Crnt_tiCc08CrntGen_C /end DEF_CHARACTERISTIC
 /begin OUT_MEASUREMENT OutPCc08Crnt_stCc08CrntNom OutPCc08Crnt_tiCc08CrntChng OutPCc08Crnt_tiCc08CrntGen /end OUT_MEASUREMENT
/end FUNCTION
/begin FUNCTION F2531_OutPCc08Ctl "F2531: Current control (Complement)"
 /begin DEF_CHARACTERISTIC OutPCc08Ctl_facCc08PSplyFlt_C OutPCc08Ctl_iCc08LoBatt_C OutPCc08Ctl_iCc08LoCrnt_C OutPCc08Ctl_stCc08Avl_C OutPCc08Ctl_stCc08DnConn_C OutPCc08Ctl_stCc08LoBatt_C OutPCc08Ctl_stCc08ReqPSply_C OutPCc08Ctl_tiCc08HwFault_C OutPCc08Ctl_tiCc08ModeChng_C OutPCc08Ctl_uCc08LoBattHys_C OutPCc08Ctl_uCc08LoBatt_C /end DEF_CHARACTERISTIC
 /begin OUT_MEASUREMENT OutPCc08Ctl_iCc08Crnt OutPCc08Ctl_iCc08In OutPCc08Ctl_stCc08Out OutPCc08Ctl_stCc08ReqOff OutPCc08Ctl_stCc08ReqOn OutPCc08Ctl_tiCc08HwFault OutPCc08Ctl_uCc08PSplyFlt /end OUT_MEASUREMENT
/end FUNCTION
/begin FUNCTION F2531_OutPCc08Fdbk "F2531: Calculation duty cycle of feedback signal"
 /begin DEF_CHARACTERISTIC OutPCc08Fdbk_ctCc08FdbkErr_C OutPCc08Fdbk_facCc08FdbkFlt_C OutPCc08Fdbk_rCc08FdbkLim_C /end DEF_CHARACTERISTIC
 /begin OUT_MEASUREMENT OutPCc08Fdbk_ctCc08FdbkErr OutPCc08Fdbk_rCc08FdbkAvrg OutPCc08Fdbk_rCc08FdbkFlt OutPCc08Fdbk_rCc08FdbkFlt32 OutPCc08Fdbk_rCc08FdbkHi OutPCc08Fdbk_rCc08FdbkLo OutPCc08Fdbk_stCc08Fdbk /end OUT_MEASUREMENT
/end FUNCTION
/begin FUNCTION F2531_OutPCc08Mon "F2531: Current control monitoring"
 /begin DEF_CHARACTERISTIC OutPCc08Mon_stCc08SfrmLss_C OutPCc08Mon_stCc08SfrmPSply_C OutPCc08Mon_stCc08TstCond_C OutPCc08Mon_stPSplyErrOP_C OutPCc08Mon_tiCc08NsDynErr_C OutPCc08Mon_tiCc08TstFdbk_C OutPCc08Mon_uCc08TstCrntHi_C OutPCc08Mon_uCc08TstCrntLo_C OutPCc08Mon_uCc08TstSCHi_C OutPCc08Mon_uCc08TstSCLo_C /end DEF_CHARACTERISTIC
 /begin OUT_MEASUREMENT OutPCc08Mon_iCc08Meas OutPCc08Mon_stCc08Fault OutPCc08Mon_stCc08Sfrm OutPCc08Mon_stCc08TstCond OutPCc08Mon_stCc08TstGen OutPCc08Mon_stHealSfrmFault OutPCc08Mon_tiCc08NsDynErr OutPCc08Mon_tiCc08TstFdbk /end OUT_MEASUREMENT
/end FUNCTION
/begin FUNCTION F2531_OutPCc08Rat "F2531: Calculation of ratio R*I/U"
 /begin DEF_CHARACTERISTIC OutPCc08Rat_rCc08RatFdbk_C OutPCc08Rat_rCc08RatHys_C OutPCc08Rat_rCc08Rat_C OutPCc08Rat_uCc08RatActv_C OutPCc08Rat_uCc08RatSplyHys_C /end DEF_CHARACTERISTIC
 /begin OUT_MEASUREMENT OutPCc08Rat_rCc08Rat OutPCc08Rat_stCc08RatMode /end OUT_MEASUREMENT
/end FUNCTION
/begin FUNCTION F2531_OutPCc08SGOP "F2531: Differentiation between SG or OP"
 /begin DEF_CHARACTERISTIC OutPCc08SGOP_stCc08DiffSC_C OutPCc08SGOP_tiCc08DiffDly_C[0] OutPCc08SGOP_tiCc08DiffDly_C[1] OutPCc08SGOP_tiCc08DiffSGOP_C OutPCc08SGOP_tiCc08HldFault_C OutPCc08SGOP_uCc08DiffSGOP_C /end DEF_CHARACTERISTIC
 /begin OUT_MEASUREMENT OutPCc08SGOP_sCc08DiffSGOP OutPCc08SGOP_stCc08DiffReq OutPCc08SGOP_stCc08DiffSGOP OutPCc08SGOP_stCc08HldFault OutPCc08SGOP_tiCc08DiffDly OutPCc08SGOP_tiCc08DiffSGOP OutPCc08SGOP_tiCc08HldFault OutPCc08SGOP_uCc08DiffPSply /end OUT_MEASUREMENT
/end FUNCTION
/begin RECORD_LAYOUT AblGLFKFub_S1 FNC_VALUES 1 UBYTE ROW_DIR DIRECT /end RECORD_LAYOUT
/begin RECORD_LAYOUT AblGLFKFul_S1 FNC_VALUES 1 ULONG ROW_DIR DIRECT /end RECORD_LAYOUT
/begin RECORD_LAYOUT AblGLFKFuw_S1 FNC_VALUES 1 UWORD ROW_DIR DIRECT /end RECORD_LAYOUT
/begin RECORD_LAYOUT AblGLKLsw_S1 FNC_VALUES 3 SWORD COLUMN_DIR DIRECT AXIS_PTS_X 2 SWORD INDEX_INCR DIRECT NO_AXIS_PTS_X 1 SWORD /end RECORD_LAYOUT
/begin RECORD_LAYOUT AblGLKLuw_S1 FNC_VALUES 3 UWORD COLUMN_DIR DIRECT AXIS_PTS_X 2 UWORD INDEX_INCR DIRECT NO_AXIS_PTS_X 1 UWORD /end RECORD_LAYOUT
/begin RECORD_LAYOUT AblGLKWBr32_S1 FNC_VALUES 1 FLOAT32_IEEE COLUMN_DIR DIRECT /end RECORD_LAYOUT
/begin RECORD_LAYOUT AblGLKWBsb_S1 FNC_VALUES 1 SBYTE COLUMN_DIR DIRECT /end RECORD_LAYOUT
/begin RECORD_LAYOUT AblGLKWBsw_S1 FNC_VALUES 1 SWORD COLUMN_DIR DIRECT /end RECORD_LAYOUT
/begin RECORD_LAYOUT AblGLKWBub_S1 FNC_VALUES 1 UBYTE COLUMN_DIR DIRECT /end RECORD_LAYOUT
/begin RECORD_LAYOUT AblGLKWBuw_S1 FNC_VALUES 1 UWORD COLUMN_DIR DIRECT /end RECORD_LAYOUT
/begin RECORD_LAYOUT AblGLKWsw_S1 FNC_VALUES 1 SWORD COLUMN_DIR DIRECT /end RECORD_LAYOUT
/begin RECORD_LAYOUT AblGLKWub_S1 FNC_VALUES 1 UBYTE COLUMN_DIR DIRECT /end RECORD_LAYOUT
/begin RECORD_LAYOUT AblGLKWuw_S1 FNC_VALUES 1 UWORD COLUMN_DIR DIRECT /end RECORD_LAYOUT
/end MODULE
/end PROJECT
