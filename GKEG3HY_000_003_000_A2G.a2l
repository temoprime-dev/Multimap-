ASAP2_VERSION 1 51
/begin PROJECT _929_929 "Gen2_BMW_System_Supplier_Lib"
/begin HEADER "" VERSION "C_03_03" PROJECT_NO _929_929 /end HEADER
/begin MODULE DIM ""
/begin MOD_COMMON "" BYTE_ORDER MSB_FIRST ALIGNMENT_BYTE 1 ALIGNMENT_WORD 2 ALIGNMENT_LONG 4 ALIGNMENT_FLOAT32_IEEE 4 /end MOD_COMMON
/begin CHARACTERISTIC SWI_DiGlobalCtrl "ASIL: Global diagnosis switch (165=diagnosis deactivated and errmem cleared every power up, 170=diagnosis deactivated and errmem not cleared, 90=diagnosis activated and errmem cleared every power up, 0=diagnosis activated and errmem not cleared)" VALUE 0x21802B ZF_kw_ui8_S5_S3 170 EH_STANDARD_S5_S3 0 170 /end CHARACTERISTIC
/begin CHARACTERISTIC SWI_DiClearErrMem "Switch for clearing error memory. A change between 0x55 and 0xAA (85 and 170 dec) clears the error memory content." VALUE 0x21802C ZF_kw_ui8_S5_S3 255 EH_STANDARD_S5_S3 0 255 /end CHARACTERISTIC
/begin CHARACTERISTIC SWI_DiClearBkpErrMem "Switch for clearing backup error memory. A change between 0x55 and 0xAA (85 and 170 dec) clears the backup error memory content." VALUE 0x21802D ZF_kw_ui8_S5_S3 255 EH_STANDARD_S5_S3 0 255 /end CHARACTERISTIC
/begin CHARACTERISTIC D_DiActivateSubstFunct "error reactions to be enabled (bitcoded, 0..31)" VALUE 0x202314 ZF_kw_ui32_S5_S3 4.29497E+009 EH_STANDARD_S5_S3 0 4294967295 /end CHARACTERISTIC
/begin CHARACTERISTIC D_DiActivateSubstFunctHi "error reactions to be enabled (bitcoded, 32..63)" VALUE 0x202318 ZF_kw_ui32_S5_S3 4.29497E+009 EH_STANDARD_S5_S3 0 4294967295 /end CHARACTERISTIC
/begin CHARACTERISTIC SWI_DiActivateExtSubstFunct "ASIL: switch for selecting active substitute functions (0x5A=internal and external, 0xA5=external only, others=internal only)" VALUE 0x21802E ZF_kw_ui8_S5_S3 255 EH_STANDARD_S5_S3 0 255 /end CHARACTERISTIC
/begin CHARACTERISTIC D_nAbFiltUThForQSF "threshold for project specific RNF condition (output shaft speed below threshold)" VALUE 0x2182B0 ZF_kw_ui16_S5_S3 11000 EH_N_1RPM_S5_S3 0 11000 /end CHARACTERISTIC
/begin CHARACTERISTIC D_ThrottlePosUThForQSF "threshold for project specific RNF condition (throttle position below threshold)" VALUE 0x21802F ZF_kw_ui8_S5_S3 100 EH_100PROZENT255_S5_S3 0 100 /end CHARACTERISTIC
/begin CHARACTERISTIC D_DiRetryRNFInInit "number of retries for RNF at power-up (only if RNF failed because of missing project specific conditions)" VALUE 0x218030 ZF_kw_ui8_S5_S3 255 EH_STANDARD_S5_S3 0 255 /end CHARACTERISTIC
/begin CHARACTERISTIC D_DiErrorCodeConvTabForAZG "Calibration field for conversion of project-specific ZF-Errorcodes to standardized AZG-Errorcodes (and thus standardized AZG-Errortexts)" CURVE 0x20231C ZF_tab_ui16_S5_S3 512 EH_STANDARD_S5_S3 0 512
 /begin AXIS_DESCR FIX_AXIS NO_INPUT_QUANTITY EH_STANDARD_S5_S3 320 0 319 FIX_AXIS_PAR_DIST 0 1 320 /end AXIS_DESCR
/end CHARACTERISTIC
/begin CHARACTERISTIC D_DiErrorEntryUpdateType "Time when the error type in the error memory is updated (0=at the end of the forward filtering, 1=at the end of the forward filtering if the error has been inactive before, 2=as long as the error is active)" VALUE 0x218031 ZF_kw_ui8_S5_S3 255 EH_STANDARD_S5_S3 0 255 /end CHARACTERISTIC
/begin CHARACTERISTIC D_uBattFiltUThForCalTC "filtered battery voltage upper threshold for calibratable test conditions" VALUE 0x2182B2 ZF_kw_ui16_S5_S3 25 EH_U_1VOLT1000_S5_S3 0 25 /end CHARACTERISTIC
/begin CHARACTERISTIC D_uBattFiltLTh1ForCalTC "filtered battery voltage lower threshold 1 for calibratable test conditions" VALUE 0x2182B4 ZF_kw_ui16_S5_S3 25 EH_U_1VOLT1000_S5_S3 0 25 /end CHARACTERISTIC
/begin CHARACTERISTIC D_uBattFiltLTh2ForCalTC "filtered battery voltage lower threshold 2 for calibratable test conditions" VALUE 0x2182B6 ZF_kw_ui16_S5_S3 25 EH_U_1VOLT1000_S5_S3 0 25 /end CHARACTERISTIC
/begin CHARACTERISTIC D_nEngLThForCalTC "engine speed lower threshold for calibratable test conditions" VALUE 0x2182B8 ZF_kw_ui16_S5_S3 11000 EH_N_1RPM_S5_S3 0 11000 /end CHARACTERISTIC
/begin CHARACTERISTIC D_DiErrorCode_1 "Calibration Field for error code 1" CURVE 0x2025A0 ZF_tab_nx_ui16_S5_S3 65535 EH_STANDARD_S5_S3 0 65535
 /begin AXIS_DESCR FIX_AXIS NO_INPUT_QUANTITY EH_STANDARD_S5_S3 18 0 17 FIX_AXIS_PAR_DIST 0 1 18 /end AXIS_DESCR
/end CHARACTERISTIC
/begin CHARACTERISTIC D_DiErrorCode_2 "Calibration Field for error code 2" CURVE 0x2025C4 ZF_tab_nx_ui16_S5_S3 65535 EH_STANDARD_S5_S3 0 65535
 /begin AXIS_DESCR FIX_AXIS NO_INPUT_QUANTITY EH_STANDARD_S5_S3 18 0 17 FIX_AXIS_PAR_DIST 0 1 18 /end AXIS_DESCR
/end CHARACTERISTIC
/begin CHARACTERISTIC D_DiErrorCode_3 "Calibration Field for error code 3" CURVE 0x2025E8 ZF_tab_nx_ui16_S5_S3 65535 EH_STANDARD_S5_S3 0 65535
 /begin AXIS_DESCR FIX_AXIS NO_INPUT_QUANTITY EH_STANDARD_S5_S3 18 0 17 FIX_AXIS_PAR_DIST 0 1 18 /end AXIS_DESCR
/end CHARACTERISTIC
/begin CHARACTERISTIC D_DiErrorCode_4 "Calibration Field for error code 4" CURVE 0x20260C ZF_tab_nx_ui16_S5_S3 65535 EH_STANDARD_S5_S3 0 65535
 /begin AXIS_DESCR FIX_AXIS NO_INPUT_QUANTITY EH_STANDARD_S5_S3 18 0 17 FIX_AXIS_PAR_DIST 0 1 18 /end AXIS_DESCR
/end CHARACTERISTIC
/begin CHARACTERISTIC D_DiErrorCode_5 "Calibration Field for error code 5" CURVE 0x202630 ZF_tab_nx_ui16_S5_S3 65535 EH_STANDARD_S5_S3 0 65535
 /begin AXIS_DESCR FIX_AXIS NO_INPUT_QUANTITY EH_STANDARD_S5_S3 18 0 17 FIX_AXIS_PAR_DIST 0 1 18 /end AXIS_DESCR
/end CHARACTERISTIC
/begin CHARACTERISTIC D_DiErrorCode_6 "Calibration Field for error code 6" CURVE 0x202654 ZF_tab_nx_ui16_S5_S3 65535 EH_STANDARD_S5_S3 0 65535
 /begin AXIS_DESCR FIX_AXIS NO_INPUT_QUANTITY EH_STANDARD_S5_S3 18 0 17 FIX_AXIS_PAR_DIST 0 1 18 /end AXIS_DESCR
/end CHARACTERISTIC
/begin CHARACTERISTIC D_DiErrorCode_7 "Calibration Field for error code 7" CURVE 0x202678 ZF_tab_nx_ui16_S5_S3 65535 EH_STANDARD_S5_S3 0 65535
 /begin AXIS_DESCR FIX_AXIS NO_INPUT_QUANTITY EH_STANDARD_S5_S3 18 0 17 FIX_AXIS_PAR_DIST 0 1 18 /end AXIS_DESCR
/end CHARACTERISTIC
/begin CHARACTERISTIC D_DiErrorCode_8 "Calibration Field for error code 8" CURVE 0x20269C ZF_tab_nx_ui16_S5_S3 65535 EH_STANDARD_S5_S3 0 65535
 /begin AXIS_DESCR FIX_AXIS NO_INPUT_QUANTITY EH_STANDARD_S5_S3 18 0 17 FIX_AXIS_PAR_DIST 0 1 18 /end AXIS_DESCR
/end CHARACTERISTIC
/begin CHARACTERISTIC D_DiErrorCode_9 "Calibration Field for error code 9" CURVE 0x2026C0 ZF_tab_nx_ui16_S5_S3 65535 EH_STANDARD_S5_S3 0 65535
 /begin AXIS_DESCR FIX_AXIS NO_INPUT_QUANTITY EH_STANDARD_S5_S3 18 0 17 FIX_AXIS_PAR_DIST 0 1 18 /end AXIS_DESCR
/end CHARACTERISTIC
/begin CHARACTERISTIC D_DiErrorCode_10 "Calibration Field for error code 10" CURVE 0x2026E4 ZF_tab_nx_ui16_S5_S3 65535 EH_STANDARD_S5_S3 0 65535
 /begin AXIS_DESCR FIX_AXIS NO_INPUT_QUANTITY EH_STANDARD_S5_S3 18 0 17 FIX_AXIS_PAR_DIST 0 1 18 /end AXIS_DESCR
/end CHARACTERISTIC
/begin CHARACTERISTIC D_DiErrorCode_11 "Calibration Field for error code 11" CURVE 0x202708 ZF_tab_nx_ui16_S5_S3 65535 EH_STANDARD_S5_S3 0 65535
 /begin AXIS_DESCR FIX_AXIS NO_INPUT_QUANTITY EH_STANDARD_S5_S3 18 0 17 FIX_AXIS_PAR_DIST 0 1 18 /end AXIS_DESCR
/end CHARACTERISTIC
/begin CHARACTERISTIC D_DiErrorCode_12 "Calibration Field for error code 12" CURVE 0x20272C ZF_tab_nx_ui16_S5_S3 65535 EH_STANDARD_S5_S3 0 65535
 /begin AXIS_DESCR FIX_AXIS NO_INPUT_QUANTITY EH_STANDARD_S5_S3 18 0 17 FIX_AXIS_PAR_DIST 0 1 18 /end AXIS_DESCR
/end CHARACTERISTIC
/begin CHARACTERISTIC D_DiErrorCode_13 "Calibration Field for error code 13" CURVE 0x202750 ZF_tab_nx_ui16_S5_S3 65535 EH_STANDARD_S5_S3 0 65535
 /begin AXIS_DESCR FIX_AXIS NO_INPUT_QUANTITY EH_STANDARD_S5_S3 18 0 17 FIX_AXIS_PAR_DIST 0 1 18 /end AXIS_DESCR
/end CHARACTERISTIC
/begin CHARACTERISTIC D_DiErrorCode_14 "Calibration Field for error code 14" CURVE 0x202774 ZF_tab_nx_ui16_S5_S3 65535 EH_STANDARD_S5_S3 0 65535
 /begin AXIS_DESCR FIX_AXIS NO_INPUT_QUANTITY EH_STANDARD_S5_S3 18 0 17 FIX_AXIS_PAR_DIST 0 1 18 /end AXIS_DESCR
/end CHARACTERISTIC
/begin CHARACTERISTIC D_DiErrorCode_15 "Calibration Field for error code 15" CURVE 0x202798 ZF_tab_nx_ui16_S5_S3 65535 EH_STANDARD_S5_S3 0 65535
 /begin AXIS_DESCR FIX_AXIS NO_INPUT_QUANTITY EH_STANDARD_S5_S3 18 0 17 FIX_AXIS_PAR_DIST 0 1 18 /end AXIS_DESCR
/end CHARACTERISTIC
/begin CHARACTERISTIC D_DiErrorCode_16 "Calibration Field for error code 16" CURVE 0x2027BC ZF_tab_nx_ui16_S5_S3 65535 EH_STANDARD_S5_S3 0 65535
 /begin AXIS_DESCR FIX_AXIS NO_INPUT_QUANTITY EH_STANDARD_S5_S3 18 0 17 FIX_AXIS_PAR_DIST 0 1 18 /end AXIS_DESCR
/end CHARACTERISTIC
/begin CHARACTERISTIC D_DiErrorCode_17 "Calibration Field for error code 17" CURVE 0x2027E0 ZF_tab_nx_ui16_S5_S3 65535 EH_STANDARD_S5_S3 0 65535
 /begin AXIS_DESCR FIX_AXIS NO_INPUT_QUANTITY EH_STANDARD_S5_S3 18 0 17 FIX_AXIS_PAR_DIST 0 1 18 /end AXIS_DESCR
/end CHARACTERISTIC
/begin CHARACTERISTIC D_DiErrorCode_18 "Calibration Field for error code 18" CURVE 0x202804 ZF_tab_nx_ui16_S5_S3 65535 EH_STANDARD_S5_S3 0 65535
 /begin AXIS_DESCR FIX_AXIS NO_INPUT_QUANTITY EH_STANDARD_S5_S3 18 0 17 FIX_AXIS_PAR_DIST 0 1 18 /end AXIS_DESCR
/end CHARACTERISTIC
/begin CHARACTERISTIC D_DiErrorCode_19 "Calibration Field for error code 19" CURVE 0x202828 ZF_tab_nx_ui16_S5_S3 65535 EH_STANDARD_S5_S3 0 65535
 /begin AXIS_DESCR FIX_AXIS NO_INPUT_QUANTITY EH_STANDARD_S5_S3 18 0 17 FIX_AXIS_PAR_DIST 0 1 18 /end AXIS_DESCR
/end CHARACTERISTIC
/begin CHARACTERISTIC D_DiErrorCode_20 "Calibration Field for error code 20" CURVE 0x20284C ZF_tab_nx_ui16_S5_S3 65535 EH_STANDARD_S5_S3 0 65535
 /begin AXIS_DESCR FIX_AXIS NO_INPUT_QUANTITY EH_STANDARD_S5_S3 18 0 17 FIX_AXIS_PAR_DIST 0 1 18 /end AXIS_DESCR
/end CHARACTERISTIC
/begin CHARACTERISTIC D_DiErrorCode_21 "Calibration Field for error code 21" CURVE 0x202870 ZF_tab_nx_ui16_S5_S3 65535 EH_STANDARD_S5_S3 0 65535
 /begin AXIS_DESCR FIX_AXIS NO_INPUT_QUANTITY EH_STANDARD_S5_S3 18 0 17 FIX_AXIS_PAR_DIST 0 1 18 /end AXIS_DESCR
/end CHARACTERISTIC
/begin CHARACTERISTIC D_DiErrorCode_22 "Calibration Field for error code 22" CURVE 0x202894 ZF_tab_nx_ui16_S5_S3 65535 EH_STANDARD_S5_S3 0 65535
 /begin AXIS_DESCR FIX_AXIS NO_INPUT_QUANTITY EH_STANDARD_S5_S3 18 0 17 FIX_AXIS_PAR_DIST 0 1 18 /end AXIS_DESCR
/end CHARACTERISTIC
/begin CHARACTERISTIC D_DiErrorCode_23 "Calibration Field for error code 23" CURVE 0x2028B8 ZF_tab_nx_ui16_S5_S3 65535 EH_STANDARD_S5_S3 0 65535
 /begin AXIS_DESCR FIX_AXIS NO_INPUT_QUANTITY EH_STANDARD_S5_S3 18 0 17 FIX_AXIS_PAR_DIST 0 1 18 /end AXIS_DESCR
/end CHARACTERISTIC
/begin CHARACTERISTIC D_DiErrorCode_24 "Calibration Field for error code 24" CURVE 0x2028DC ZF_tab_nx_ui16_S5_S3 65535 EH_STANDARD_S5_S3 0 65535
 /begin AXIS_DESCR FIX_AXIS NO_INPUT_QUANTITY EH_STANDARD_S5_S3 18 0 17 FIX_AXIS_PAR_DIST 0 1 18 /end AXIS_DESCR
/end CHARACTERISTIC
/begin CHARACTERISTIC D_DiErrorCode_25 "Calibration Field for error code 25" CURVE 0x202900 ZF_tab_nx_ui16_S5_S3 65535 EH_STANDARD_S5_S3 0 65535
 /begin AXIS_DESCR FIX_AXIS NO_INPUT_QUANTITY EH_STANDARD_S5_S3 18 0 17 FIX_AXIS_PAR_DIST 0 1 18 /end AXIS_DESCR
/end CHARACTERISTIC
/begin CHARACTERISTIC D_DiErrorCode_26 "Calibration Field for error code 26" CURVE 0x202924 ZF_tab_nx_ui16_S5_S3 65535 EH_STANDARD_S5_S3 0 65535
 /begin AXIS_DESCR FIX_AXIS NO_INPUT_QUANTITY EH_STANDARD_S5_S3 18 0 17 FIX_AXIS_PAR_DIST 0 1 18 /end AXIS_DESCR
/end CHARACTERISTIC
/begin CHARACTERISTIC D_DiErrorCode_27 "Calibration Field for error code 27" CURVE 0x202948 ZF_tab_nx_ui16_S5_S3 65535 EH_STANDARD_S5_S3 0 65535
 /begin AXIS_DESCR FIX_AXIS NO_INPUT_QUANTITY EH_STANDARD_S5_S3 18 0 17 FIX_AXIS_PAR_DIST 0 1 18 /end AXIS_DESCR
/end CHARACTERISTIC
/begin CHARACTERISTIC D_DiErrorCode_28 "Calibration Field for error code 28" CURVE 0x20296C ZF_tab_nx_ui16_S5_S3 65535 EH_STANDARD_S5_S3 0 65535
 /begin AXIS_DESCR FIX_AXIS NO_INPUT_QUANTITY EH_STANDARD_S5_S3 18 0 17 FIX_AXIS_PAR_DIST 0 1 18 /end AXIS_DESCR
/end CHARACTERISTIC
/begin CHARACTERISTIC D_DiErrorCode_29 "Calibration Field for error code 29" CURVE 0x202990 ZF_tab_nx_ui16_S5_S3 65535 EH_STANDARD_S5_S3 0 65535
 /begin AXIS_DESCR FIX_AXIS NO_INPUT_QUANTITY EH_STANDARD_S5_S3 18 0 17 FIX_AXIS_PAR_DIST 0 1 18 /end AXIS_DESCR
/end CHARACTERISTIC
/begin CHARACTERISTIC D_DiErrorCode_30 "Calibration Field for error code 30" CURVE 0x2029B4 ZF_tab_nx_ui16_S5_S3 65535 EH_STANDARD_S5_S3 0 65535
 /begin AXIS_DESCR FIX_AXIS NO_INPUT_QUANTITY EH_STANDARD_S5_S3 18 0 17 FIX_AXIS_PAR_DIST 0 1 18 /end AXIS_DESCR
/end CHARACTERISTIC
/begin CHARACTERISTIC D_DiErrorCode_31 "Calibration Field for error code 31" CURVE 0x2029D8 ZF_tab_nx_ui16_S5_S3 65535 EH_STANDARD_S5_S3 0 65535
 /begin AXIS_DESCR FIX_AXIS NO_INPUT_QUANTITY EH_STANDARD_S5_S3 18 0 17 FIX_AXIS_PAR_DIST 0 1 18 /end AXIS_DESCR
/end CHARACTERISTIC
/begin CHARACTERISTIC D_DiErrorCode_32 "Calibration Field for error code 32" CURVE 0x2029FC ZF_tab_nx_ui16_S5_S3 65535 EH_STANDARD_S5_S3 0 65535
 /begin AXIS_DESCR FIX_AXIS NO_INPUT_QUANTITY EH_STANDARD_S5_S3 18 0 17 FIX_AXIS_PAR_DIST 0 1 18 /end AXIS_DESCR
/end CHARACTERISTIC
/begin CHARACTERISTIC D_DiErrorCode_33 "Calibration Field for error code 33" CURVE 0x202A20 ZF_tab_nx_ui16_S5_S3 65535 EH_STANDARD_S5_S3 0 65535
 /begin AXIS_DESCR FIX_AXIS NO_INPUT_QUANTITY EH_STANDARD_S5_S3 18 0 17 FIX_AXIS_PAR_DIST 0 1 18 /end AXIS_DESCR
/end CHARACTERISTIC
/begin CHARACTERISTIC D_DiErrorCode_34 "Calibration Field for error code 34" CURVE 0x202A44 ZF_tab_nx_ui16_S5_S3 65535 EH_STANDARD_S5_S3 0 65535
 /begin AXIS_DESCR FIX_AXIS NO_INPUT_QUANTITY EH_STANDARD_S5_S3 18 0 17 FIX_AXIS_PAR_DIST 0 1 18 /end AXIS_DESCR
/end CHARACTERISTIC
/begin CHARACTERISTIC D_DiErrorCode_35 "Calibration Field for error code 35" CURVE 0x202A68 ZF_tab_nx_ui16_S5_S3 65535 EH_STANDARD_S5_S3 0 65535
 /begin AXIS_DESCR FIX_AXIS NO_INPUT_QUANTITY EH_STANDARD_S5_S3 18 0 17 FIX_AXIS_PAR_DIST 0 1 18 /end AXIS_DESCR
/end CHARACTERISTIC
/begin CHARACTERISTIC D_DiErrorCode_36 "Calibration Field for error code 36" CURVE 0x202A8C ZF_tab_nx_ui16_S5_S3 65535 EH_STANDARD_S5_S3 0 65535
 /begin AXIS_DESCR FIX_AXIS NO_INPUT_QUANTITY EH_STANDARD_S5_S3 18 0 17 FIX_AXIS_PAR_DIST 0 1 18 /end AXIS_DESCR
/end CHARACTERISTIC
/begin CHARACTERISTIC D_DiErrorCode_37 "Calibration Field for error code 37" CURVE 0x202AB0 ZF_tab_nx_ui16_S5_S3 65535 EH_STANDARD_S5_S3 0 65535
 /begin AXIS_DESCR FIX_AXIS NO_INPUT_QUANTITY EH_STANDARD_S5_S3 18 0 17 FIX_AXIS_PAR_DIST 0 1 18 /end AXIS_DESCR
/end CHARACTERISTIC
/begin CHARACTERISTIC D_DiErrorCode_38 "Calibration Field for error code 38" CURVE 0x202AD4 ZF_tab_nx_ui16_S5_S3 65535 EH_STANDARD_S5_S3 0 65535
 /begin AXIS_DESCR FIX_AXIS NO_INPUT_QUANTITY EH_STANDARD_S5_S3 18 0 17 FIX_AXIS_PAR_DIST 0 1 18 /end AXIS_DESCR
/end CHARACTERISTIC
/begin CHARACTERISTIC D_DiErrorCode_39 "Calibration Field for error code 39" CURVE 0x202AF8 ZF_tab_nx_ui16_S5_S3 65535 EH_STANDARD_S5_S3 0 65535
 /begin AXIS_DESCR FIX_AXIS NO_INPUT_QUANTITY EH_STANDARD_S5_S3 18 0 17 FIX_AXIS_PAR_DIST 0 1 18 /end AXIS_DESCR
/end CHARACTERISTIC
/begin CHARACTERISTIC D_DiErrorCode_40 "Calibration Field for error code 40" CURVE 0x202B1C ZF_tab_nx_ui16_S5_S3 65535 EH_STANDARD_S5_S3 0 65535
 /begin AXIS_DESCR FIX_AXIS NO_INPUT_QUANTITY EH_STANDARD_S5_S3 18 0 17 FIX_AXIS_PAR_DIST 0 1 18 /end AXIS_DESCR
/end CHARACTERISTIC
/begin CHARACTERISTIC D_DiErrorCode_41 "Calibration Field for error code 41" CURVE 0x202B40 ZF_tab_nx_ui16_S5_S3 65535 EH_STANDARD_S5_S3 0 65535
 /begin AXIS_DESCR FIX_AXIS NO_INPUT_QUANTITY EH_STANDARD_S5_S3 18 0 17 FIX_AXIS_PAR_DIST 0 1 18 /end AXIS_DESCR
/end CHARACTERISTIC
/begin CHARACTERISTIC D_DiErrorCode_42 "Calibration Field for error code 42" CURVE 0x202B64 ZF_tab_nx_ui16_S5_S3 65535 EH_STANDARD_S5_S3 0 65535
 /begin AXIS_DESCR FIX_AXIS NO_INPUT_QUANTITY EH_STANDARD_S5_S3 18 0 17 FIX_AXIS_PAR_DIST 0 1 18 /end AXIS_DESCR
/end CHARACTERISTIC
/begin CHARACTERISTIC D_DiErrorCode_43 "Calibration Field for error code 43" CURVE 0x202B88 ZF_tab_nx_ui16_S5_S3 65535 EH_STANDARD_S5_S3 0 65535
 /begin AXIS_DESCR FIX_AXIS NO_INPUT_QUANTITY EH_STANDARD_S5_S3 18 0 17 FIX_AXIS_PAR_DIST 0 1 18 /end AXIS_DESCR
/end CHARACTERISTIC
/begin CHARACTERISTIC D_DiErrorCode_44 "Calibration Field for error code 44" CURVE 0x202BAC ZF_tab_nx_ui16_S5_S3 65535 EH_STANDARD_S5_S3 0 65535
 /begin AXIS_DESCR FIX_AXIS NO_INPUT_QUANTITY EH_STANDARD_S5_S3 18 0 17 FIX_AXIS_PAR_DIST 0 1 18 /end AXIS_DESCR
/end CHARACTERISTIC
/begin CHARACTERISTIC D_DiErrorCode_45 "Calibration Field for error code 45" CURVE 0x202BD0 ZF_tab_nx_ui16_S5_S3 65535 EH_STANDARD_S5_S3 0 65535
 /begin AXIS_DESCR FIX_AXIS NO_INPUT_QUANTITY EH_STANDARD_S5_S3 18 0 17 FIX_AXIS_PAR_DIST 0 1 18 /end AXIS_DESCR
/end CHARACTERISTIC
/begin CHARACTERISTIC D_DiErrorCode_46 "Calibration Field for error code 46" CURVE 0x202BF4 ZF_tab_nx_ui16_S5_S3 65535 EH_STANDARD_S5_S3 0 65535
 /begin AXIS_DESCR FIX_AXIS NO_INPUT_QUANTITY EH_STANDARD_S5_S3 18 0 17 FIX_AXIS_PAR_DIST 0 1 18 /end AXIS_DESCR
/end CHARACTERISTIC
/begin CHARACTERISTIC D_DiErrorCode_47 "Calibration Field for error code 47" CURVE 0x202C18 ZF_tab_nx_ui16_S5_S3 65535 EH_STANDARD_S5_S3 0 65535
 /begin AXIS_DESCR FIX_AXIS NO_INPUT_QUANTITY EH_STANDARD_S5_S3 18 0 17 FIX_AXIS_PAR_DIST 0 1 18 /end AXIS_DESCR
/end CHARACTERISTIC
/begin CHARACTERISTIC D_DiErrorCode_48 "Calibration Field for error code 48" CURVE 0x202C3C ZF_tab_nx_ui16_S5_S3 65535 EH_STANDARD_S5_S3 0 65535
 /begin AXIS_DESCR FIX_AXIS NO_INPUT_QUANTITY EH_STANDARD_S5_S3 18 0 17 FIX_AXIS_PAR_DIST 0 1 18 /end AXIS_DESCR
/end CHARACTERISTIC
/begin CHARACTERISTIC D_DiErrorCode_49 "Calibration Field for error code 49" CURVE 0x202C60 ZF_tab_nx_ui16_S5_S3 65535 EH_STANDARD_S5_S3 0 65535
 /begin AXIS_DESCR FIX_AXIS NO_INPUT_QUANTITY EH_STANDARD_S5_S3 18 0 17 FIX_AXIS_PAR_DIST 0 1 18 /end AXIS_DESCR
/end CHARACTERISTIC
/begin CHARACTERISTIC D_DiErrorCode_50 "Calibration Field for error code 50" CURVE 0x202C84 ZF_tab_nx_ui16_S5_S3 65535 EH_STANDARD_S5_S3 0 65535
 /begin AXIS_DESCR FIX_AXIS NO_INPUT_QUANTITY EH_STANDARD_S5_S3 18 0 17 FIX_AXIS_PAR_DIST 0 1 18 /end AXIS_DESCR
/end CHARACTERISTIC
/begin CHARACTERISTIC D_DiErrorCode_51 "Calibration Field for error code 51" CURVE 0x202CA8 ZF_tab_nx_ui16_S5_S3 65535 EH_STANDARD_S5_S3 0 65535
 /begin AXIS_DESCR FIX_AXIS NO_INPUT_QUANTITY EH_STANDARD_S5_S3 18 0 17 FIX_AXIS_PAR_DIST 0 1 18 /end AXIS_DESCR
/end CHARACTERISTIC
/begin CHARACTERISTIC D_DiErrorCode_52 "Calibration Field for error code 52" CURVE 0x202CCC ZF_tab_nx_ui16_S5_S3 65535 EH_STANDARD_S5_S3 0 65535
 /begin AXIS_DESCR FIX_AXIS NO_INPUT_QUANTITY EH_STANDARD_S5_S3 18 0 17 FIX_AXIS_PAR_DIST 0 1 18 /end AXIS_DESCR
/end CHARACTERISTIC
/begin CHARACTERISTIC D_DiErrorCode_53 "Calibration Field for error code 53" CURVE 0x202CF0 ZF_tab_nx_ui16_S5_S3 65535 EH_STANDARD_S5_S3 0 65535
 /begin AXIS_DESCR FIX_AXIS NO_INPUT_QUANTITY EH_STANDARD_S5_S3 18 0 17 FIX_AXIS_PAR_DIST 0 1 18 /end AXIS_DESCR
/end CHARACTERISTIC
/begin CHARACTERISTIC D_DiErrorCode_54 "Calibration Field for error code 54" CURVE 0x202D14 ZF_tab_nx_ui16_S5_S3 65535 EH_STANDARD_S5_S3 0 65535
 /begin AXIS_DESCR FIX_AXIS NO_INPUT_QUANTITY EH_STANDARD_S5_S3 18 0 17 FIX_AXIS_PAR_DIST 0 1 18 /end AXIS_DESCR
/end CHARACTERISTIC
/begin CHARACTERISTIC D_DiErrorCode_55 "Calibration Field for error code 55" CURVE 0x202D38 ZF_tab_nx_ui16_S5_S3 65535 EH_STANDARD_S5_S3 0 65535
 /begin AXIS_DESCR FIX_AXIS NO_INPUT_QUANTITY EH_STANDARD_S5_S3 18 0 17 FIX_AXIS_PAR_DIST 0 1 18 /end AXIS_DESCR
/end CHARACTERISTIC
/begin CHARACTERISTIC D_DiErrorCode_56 "Calibration Field for error code 56" CURVE 0x202D5C ZF_tab_nx_ui16_S5_S3 65535 EH_STANDARD_S5_S3 0 65535
 /begin AXIS_DESCR FIX_AXIS NO_INPUT_QUANTITY EH_STANDARD_S5_S3 18 0 17 FIX_AXIS_PAR_DIST 0 1 18 /end AXIS_DESCR
/end CHARACTERISTIC
/begin CHARACTERISTIC D_DiErrorCode_57 "Calibration Field for error code 57" CURVE 0x202D80 ZF_tab_nx_ui16_S5_S3 65535 EH_STANDARD_S5_S3 0 65535
 /begin AXIS_DESCR FIX_AXIS NO_INPUT_QUANTITY EH_STANDARD_S5_S3 18 0 17 FIX_AXIS_PAR_DIST 0 1 18 /end AXIS_DESCR
/end CHARACTERISTIC
/begin CHARACTERISTIC D_DiErrorCode_58 "Calibration Field for error code 58" CURVE 0x202DA4 ZF_tab_nx_ui16_S5_S3 65535 EH_STANDARD_S5_S3 0 65535
 /begin AXIS_DESCR FIX_AXIS NO_INPUT_QUANTITY EH_STANDARD_S5_S3 18 0 17 FIX_AXIS_PAR_DIST 0 1 18 /end AXIS_DESCR
/end CHARACTERISTIC
/begin CHARACTERISTIC D_DiErrorCode_59 "Calibration Field for error code 59" CURVE 0x202DC8 ZF_tab_nx_ui16_S5_S3 65535 EH_STANDARD_S5_S3 0 65535
 /begin AXIS_DESCR FIX_AXIS NO_INPUT_QUANTITY EH_STANDARD_S5_S3 18 0 17 FIX_AXIS_PAR_DIST 0 1 18 /end AXIS_DESCR
/end CHARACTERISTIC
/begin CHARACTERISTIC D_DiErrorCode_60 "Calibration Field for error code 60" CURVE 0x202DEC ZF_tab_nx_ui16_S5_S3 65535 EH_STANDARD_S5_S3 0 65535
 /begin AXIS_DESCR FIX_AXIS NO_INPUT_QUANTITY EH_STANDARD_S5_S3 18 0 17 FIX_AXIS_PAR_DIST 0 1 18 /end AXIS_DESCR
/end CHARACTERISTIC
/begin CHARACTERISTIC D_DiErrorCode_61 "Calibration Field for error code 61" CURVE 0x202E10 ZF_tab_nx_ui16_S5_S3 65535 EH_STANDARD_S5_S3 0 65535
 /begin AXIS_DESCR FIX_AXIS NO_INPUT_QUANTITY EH_STANDARD_S5_S3 18 0 17 FIX_AXIS_PAR_DIST 0 1 18 /end AXIS_DESCR
/end CHARACTERISTIC
/begin CHARACTERISTIC D_DiErrorCode_62 "Calibration Field for error code 62" CURVE 0x202E34 ZF_tab_nx_ui16_S5_S3 65535 EH_STANDARD_S5_S3 0 65535
 /begin AXIS_DESCR FIX_AXIS NO_INPUT_QUANTITY EH_STANDARD_S5_S3 18 0 17 FIX_AXIS_PAR_DIST 0 1 18 /end AXIS_DESCR
/end CHARACTERISTIC
/begin CHARACTERISTIC D_DiErrorCode_63 "Calibration Field for error code 63" CURVE 0x202E58 ZF_tab_nx_ui16_S5_S3 65535 EH_STANDARD_S5_S3 0 65535
 /begin AXIS_DESCR FIX_AXIS NO_INPUT_QUANTITY EH_STANDARD_S5_S3 18 0 17 FIX_AXIS_PAR_DIST 0 1 18 /end AXIS_DESCR
/end CHARACTERISTIC
/begin CHARACTERISTIC D_DiErrorCode_64 "Calibration Field for error code 64" CURVE 0x202E7C ZF_tab_nx_ui16_S5_S3 65535 EH_STANDARD_S5_S3 0 65535
 /begin AXIS_DESCR FIX_AXIS NO_INPUT_QUANTITY EH_STANDARD_S5_S3 18 0 17 FIX_AXIS_PAR_DIST 0 1 18 /end AXIS_DESCR
/end CHARACTERISTIC
/begin CHARACTERISTIC D_DiErrorCode_65 "Calibration Field for error code 65" CURVE 0x202EA0 ZF_tab_nx_ui16_S5_S3 65535 EH_STANDARD_S5_S3 0 65535
 /begin AXIS_DESCR FIX_AXIS NO_INPUT_QUANTITY EH_STANDARD_S5_S3 18 0 17 FIX_AXIS_PAR_DIST 0 1 18 /end AXIS_DESCR
/end CHARACTERISTIC
/begin CHARACTERISTIC D_DiErrorCode_66 "Calibration Field for error code 66" CURVE 0x202EC4 ZF_tab_nx_ui16_S5_S3 65535 EH_STANDARD_S5_S3 0 65535
 /begin AXIS_DESCR FIX_AXIS NO_INPUT_QUANTITY EH_STANDARD_S5_S3 18 0 17 FIX_AXIS_PAR_DIST 0 1 18 /end AXIS_DESCR
/end CHARACTERISTIC
/begin CHARACTERISTIC D_DiErrorCode_67 "Calibration Field for error code 67" CURVE 0x202EE8 ZF_tab_nx_ui16_S5_S3 65535 EH_STANDARD_S5_S3 0 65535
 /begin AXIS_DESCR FIX_AXIS NO_INPUT_QUANTITY EH_STANDARD_S5_S3 18 0 17 FIX_AXIS_PAR_DIST 0 1 18 /end AXIS_DESCR
/end CHARACTERISTIC
/begin CHARACTERISTIC D_DiErrorCode_68 "Calibration Field for error code 68" CURVE 0x202F0C ZF_tab_nx_ui16_S5_S3 65535 EH_STANDARD_S5_S3 0 65535
 /begin AXIS_DESCR FIX_AXIS NO_INPUT_QUANTITY EH_STANDARD_S5_S3 18 0 17 FIX_AXIS_PAR_DIST 0 1 18 /end AXIS_DESCR
/end CHARACTERISTIC
/begin CHARACTERISTIC D_DiErrorCode_69 "Calibration Field for error code 69" CURVE 0x202F30 ZF_tab_nx_ui16_S5_S3 65535 EH_STANDARD_S5_S3 0 65535
 /begin AXIS_DESCR FIX_AXIS NO_INPUT_QUANTITY EH_STANDARD_S5_S3 18 0 17 FIX_AXIS_PAR_DIST 0 1 18 /end AXIS_DESCR
/end CHARACTERISTIC
/begin CHARACTERISTIC D_DiErrorCode_70 "Calibration Field for error code 70" CURVE 0x202F54 ZF_tab_nx_ui16_S5_S3 65535 EH_STANDARD_S5_S3 0 65535
 /begin AXIS_DESCR FIX_AXIS NO_INPUT_QUANTITY EH_STANDARD_S5_S3 18 0 17 FIX_AXIS_PAR_DIST 0 1 18 /end AXIS_DESCR
/end CHARACTERISTIC
/begin CHARACTERISTIC D_DiErrorCode_71 "Calibration Field for error code 71" CURVE 0x202F78 ZF_tab_nx_ui16_S5_S3 65535 EH_STANDARD_S5_S3 0 65535
 /begin AXIS_DESCR FIX_AXIS NO_INPUT_QUANTITY EH_STANDARD_S5_S3 18 0 17 FIX_AXIS_PAR_DIST 0 1 18 /end AXIS_DESCR
/end CHARACTERISTIC
/begin CHARACTERISTIC D_DiErrorCode_72 "Calibration Field for error code 72" CURVE 0x202F9C ZF_tab_nx_ui16_S5_S3 65535 EH_STANDARD_S5_S3 0 65535
 /begin AXIS_DESCR FIX_AXIS NO_INPUT_QUANTITY EH_STANDARD_S5_S3 18 0 17 FIX_AXIS_PAR_DIST 0 1 18 /end AXIS_DESCR
/end CHARACTERISTIC
/begin CHARACTERISTIC D_DiErrorCode_73 "Calibration Field for error code 73" CURVE 0x202FC0 ZF_tab_nx_ui16_S5_S3 65535 EH_STANDARD_S5_S3 0 65535
 /begin AXIS_DESCR FIX_AXIS NO_INPUT_QUANTITY EH_STANDARD_S5_S3 18 0 17 FIX_AXIS_PAR_DIST 0 1 18 /end AXIS_DESCR
/end CHARACTERISTIC
/begin CHARACTERISTIC D_DiErrorCode_74 "Calibration Field for error code 74" CURVE 0x202FE4 ZF_tab_nx_ui16_S5_S3 65535 EH_STANDARD_S5_S3 0 65535
 /begin AXIS_DESCR FIX_AXIS NO_INPUT_QUANTITY EH_STANDARD_S5_S3 18 0 17 FIX_AXIS_PAR_DIST 0 1 18 /end AXIS_DESCR
/end CHARACTERISTIC
/begin CHARACTERISTIC D_DiErrorCode_75 "Calibration Field for error code 75" CURVE 0x203008 ZF_tab_nx_ui16_S5_S3 65535 EH_STANDARD_S5_S3 0 65535
 /begin AXIS_DESCR FIX_AXIS NO_INPUT_QUANTITY EH_STANDARD_S5_S3 18 0 17 FIX_AXIS_PAR_DIST 0 1 18 /end AXIS_DESCR
/end CHARACTERISTIC
/begin CHARACTERISTIC D_DiErrorCode_76 "Calibration Field for error code 76" CURVE 0x20302C ZF_tab_nx_ui16_S5_S3 65535 EH_STANDARD_S5_S3 0 65535
 /begin AXIS_DESCR FIX_AXIS NO_INPUT_QUANTITY EH_STANDARD_S5_S3 18 0 17 FIX_AXIS_PAR_DIST 0 1 18 /end AXIS_DESCR
/end CHARACTERISTIC
/begin CHARACTERISTIC D_DiErrorCode_77 "Calibration Field for error code 77" CURVE 0x203050 ZF_tab_nx_ui16_S5_S3 65535 EH_STANDARD_S5_S3 0 65535
 /begin AXIS_DESCR FIX_AXIS NO_INPUT_QUANTITY EH_STANDARD_S5_S3 18 0 17 FIX_AXIS_PAR_DIST 0 1 18 /end AXIS_DESCR
/end CHARACTERISTIC
/begin CHARACTERISTIC D_DiErrorCode_78 "Calibration Field for error code 78" CURVE 0x203074 ZF_tab_nx_ui16_S5_S3 65535 EH_STANDARD_S5_S3 0 65535
 /begin AXIS_DESCR FIX_AXIS NO_INPUT_QUANTITY EH_STANDARD_S5_S3 18 0 17 FIX_AXIS_PAR_DIST 0 1 18 /end AXIS_DESCR
/end CHARACTERISTIC
/begin CHARACTERISTIC D_DiErrorCode_79 "Calibration Field for error code 79" CURVE 0x203098 ZF_tab_nx_ui16_S5_S3 65535 EH_STANDARD_S5_S3 0 65535
 /begin AXIS_DESCR FIX_AXIS NO_INPUT_QUANTITY EH_STANDARD_S5_S3 18 0 17 FIX_AXIS_PAR_DIST 0 1 18 /end AXIS_DESCR
/end CHARACTERISTIC
/begin CHARACTERISTIC D_DiErrorCode_80 "Calibration Field for error code 80" CURVE 0x2030BC ZF_tab_nx_ui16_S5_S3 65535 EH_STANDARD_S5_S3 0 65535
 /begin AXIS_DESCR FIX_AXIS NO_INPUT_QUANTITY EH_STANDARD_S5_S3 18 0 17 FIX_AXIS_PAR_DIST 0 1 18 /end AXIS_DESCR
/end CHARACTERISTIC
/begin CHARACTERISTIC D_DiErrorCode_81 "Calibration Field for error code 81" CURVE 0x2030E0 ZF_tab_nx_ui16_S5_S3 65535 EH_STANDARD_S5_S3 0 65535
 /begin AXIS_DESCR FIX_AXIS NO_INPUT_QUANTITY EH_STANDARD_S5_S3 18 0 17 FIX_AXIS_PAR_DIST 0 1 18 /end AXIS_DESCR
/end CHARACTERISTIC
/begin CHARACTERISTIC D_DiErrorCode_82 "Calibration Field for error code 82" CURVE 0x203104 ZF_tab_nx_ui16_S5_S3 65535 EH_STANDARD_S5_S3 0 65535
 /begin AXIS_DESCR FIX_AXIS NO_INPUT_QUANTITY EH_STANDARD_S5_S3 18 0 17 FIX_AXIS_PAR_DIST 0 1 18 /end AXIS_DESCR
/end CHARACTERISTIC
/begin CHARACTERISTIC D_DiErrorCode_83 "Calibration Field for error code 83" CURVE 0x203128 ZF_tab_nx_ui16_S5_S3 65535 EH_STANDARD_S5_S3 0 65535
 /begin AXIS_DESCR FIX_AXIS NO_INPUT_QUANTITY EH_STANDARD_S5_S3 18 0 17 FIX_AXIS_PAR_DIST 0 1 18 /end AXIS_DESCR
/end CHARACTERISTIC
/begin CHARACTERISTIC D_DiErrorCode_84 "Calibration Field for error code 84" CURVE 0x20314C ZF_tab_nx_ui16_S5_S3 65535 EH_STANDARD_S5_S3 0 65535
 /begin AXIS_DESCR FIX_AXIS NO_INPUT_QUANTITY EH_STANDARD_S5_S3 18 0 17 FIX_AXIS_PAR_DIST 0 1 18 /end AXIS_DESCR
/end CHARACTERISTIC
/begin CHARACTERISTIC D_DiErrorCode_85 "Calibration Field for error code 85" CURVE 0x203170 ZF_tab_nx_ui16_S5_S3 65535 EH_STANDARD_S5_S3 0 65535
 /begin AXIS_DESCR FIX_AXIS NO_INPUT_QUANTITY EH_STANDARD_S5_S3 18 0 17 FIX_AXIS_PAR_DIST 0 1 18 /end AXIS_DESCR
/end CHARACTERISTIC
/begin CHARACTERISTIC D_DiErrorCode_86 "Calibration Field for error code 86" CURVE 0x203194 ZF_tab_nx_ui16_S5_S3 65535 EH_STANDARD_S5_S3 0 65535
 /begin AXIS_DESCR FIX_AXIS NO_INPUT_QUANTITY EH_STANDARD_S5_S3 18 0 17 FIX_AXIS_PAR_DIST 0 1 18 /end AXIS_DESCR
/end CHARACTERISTIC
/begin CHARACTERISTIC D_DiErrorCode_87 "Calibration Field for error code 87" CURVE 0x2031B8 ZF_tab_nx_ui16_S5_S3 65535 EH_STANDARD_S5_S3 0 65535
 /begin AXIS_DESCR FIX_AXIS NO_INPUT_QUANTITY EH_STANDARD_S5_S3 18 0 17 FIX_AXIS_PAR_DIST 0 1 18 /end AXIS_DESCR
/end CHARACTERISTIC
/begin CHARACTERISTIC D_DiErrorCode_88 "Calibration Field for error code 88" CURVE 0x2031DC ZF_tab_nx_ui16_S5_S3 65535 EH_STANDARD_S5_S3 0 65535
 /begin AXIS_DESCR FIX_AXIS NO_INPUT_QUANTITY EH_STANDARD_S5_S3 18 0 17 FIX_AXIS_PAR_DIST 0 1 18 /end AXIS_DESCR
/end CHARACTERISTIC
/begin CHARACTERISTIC D_DiErrorCode_89 "Calibration Field for error code 89" CURVE 0x203200 ZF_tab_nx_ui16_S5_S3 65535 EH_STANDARD_S5_S3 0 65535
 /begin AXIS_DESCR FIX_AXIS NO_INPUT_QUANTITY EH_STANDARD_S5_S3 18 0 17 FIX_AXIS_PAR_DIST 0 1 18 /end AXIS_DESCR
/end CHARACTERISTIC
/begin CHARACTERISTIC D_DiErrorCode_90 "Calibration Field for error code 90" CURVE 0x203224 ZF_tab_nx_ui16_S5_S3 65535 EH_STANDARD_S5_S3 0 65535
 /begin AXIS_DESCR FIX_AXIS NO_INPUT_QUANTITY EH_STANDARD_S5_S3 18 0 17 FIX_AXIS_PAR_DIST 0 1 18 /end AXIS_DESCR
/end CHARACTERISTIC
/begin CHARACTERISTIC D_DiErrorCode_91 "Calibration Field for error code 91" CURVE 0x203248 ZF_tab_nx_ui16_S5_S3 65535 EH_STANDARD_S5_S3 0 65535
 /begin AXIS_DESCR FIX_AXIS NO_INPUT_QUANTITY EH_STANDARD_S5_S3 18 0 17 FIX_AXIS_PAR_DIST 0 1 18 /end AXIS_DESCR
/end CHARACTERISTIC
/begin CHARACTERISTIC D_DiErrorCode_92 "Calibration Field for error code 92" CURVE 0x20326C ZF_tab_nx_ui16_S5_S3 65535 EH_STANDARD_S5_S3 0 65535
 /begin AXIS_DESCR FIX_AXIS NO_INPUT_QUANTITY EH_STANDARD_S5_S3 18 0 17 FIX_AXIS_PAR_DIST 0 1 18 /end AXIS_DESCR
/end CHARACTERISTIC
/begin CHARACTERISTIC D_DiErrorCode_93 "Calibration Field for error code 93" CURVE 0x203290 ZF_tab_nx_ui16_S5_S3 65535 EH_STANDARD_S5_S3 0 65535
 /begin AXIS_DESCR FIX_AXIS NO_INPUT_QUANTITY EH_STANDARD_S5_S3 18 0 17 FIX_AXIS_PAR_DIST 0 1 18 /end AXIS_DESCR
/end CHARACTERISTIC
/begin CHARACTERISTIC D_DiErrorCode_94 "Calibration Field for error code 94" CURVE 0x2032B4 ZF_tab_nx_ui16_S5_S3 65535 EH_STANDARD_S5_S3 0 65535
 /begin AXIS_DESCR FIX_AXIS NO_INPUT_QUANTITY EH_STANDARD_S5_S3 18 0 17 FIX_AXIS_PAR_DIST 0 1 18 /end AXIS_DESCR
/end CHARACTERISTIC
/begin CHARACTERISTIC D_DiErrorCode_95 "Calibration Field for error code 95" CURVE 0x2032D8 ZF_tab_nx_ui16_S5_S3 65535 EH_STANDARD_S5_S3 0 65535
 /begin AXIS_DESCR FIX_AXIS NO_INPUT_QUANTITY EH_STANDARD_S5_S3 18 0 17 FIX_AXIS_PAR_DIST 0 1 18 /end AXIS_DESCR
/end CHARACTERISTIC
/begin CHARACTERISTIC D_DiErrorCode_96 "Calibration Field for error code 96" CURVE 0x2032FC ZF_tab_nx_ui16_S5_S3 65535 EH_STANDARD_S5_S3 0 65535
 /begin AXIS_DESCR FIX_AXIS NO_INPUT_QUANTITY EH_STANDARD_S5_S3 18 0 17 FIX_AXIS_PAR_DIST 0 1 18 /end AXIS_DESCR
/end CHARACTERISTIC
/begin CHARACTERISTIC D_DiErrorCode_97 "Calibration Field for error code 97" CURVE 0x203320 ZF_tab_nx_ui16_S5_S3 65535 EH_STANDARD_S5_S3 0 65535
 /begin AXIS_DESCR FIX_AXIS NO_INPUT_QUANTITY EH_STANDARD_S5_S3 18 0 17 FIX_AXIS_PAR_DIST 0 1 18 /end AXIS_DESCR
/end CHARACTERISTIC
/begin CHARACTERISTIC D_DiErrorCode_98 "Calibration Field for error code 98" CURVE 0x203344 ZF_tab_nx_ui16_S5_S3 65535 EH_STANDARD_S5_S3 0 65535
 /begin AXIS_DESCR FIX_AXIS NO_INPUT_QUANTITY EH_STANDARD_S5_S3 18 0 17 FIX_AXIS_PAR_DIST 0 1 18 /end AXIS_DESCR
/end CHARACTERISTIC
/begin CHARACTERISTIC D_DiErrorCode_99 "Calibration Field for error code 99" CURVE 0x203368 ZF_tab_nx_ui16_S5_S3 65535 EH_STANDARD_S5_S3 0 65535
 /begin AXIS_DESCR FIX_AXIS NO_INPUT_QUANTITY EH_STANDARD_S5_S3 18 0 17 FIX_AXIS_PAR_DIST 0 1 18 /end AXIS_DESCR
/end CHARACTERISTIC
/begin CHARACTERISTIC D_DiErrorCode_100 "Calibration Field for error code 100" CURVE 0x20338C ZF_tab_nx_ui16_S5_S3 65535 EH_STANDARD_S5_S3 0 65535
 /begin AXIS_DESCR FIX_AXIS NO_INPUT_QUANTITY EH_STANDARD_S5_S3 18 0 17 FIX_AXIS_PAR_DIST 0 1 18 /end AXIS_DESCR
/end CHARACTERISTIC
/begin CHARACTERISTIC D_DiErrorCode_101 "Calibration Field for error code 101" CURVE 0x2033B0 ZF_tab_nx_ui16_S5_S3 65535 EH_STANDARD_S5_S3 0 65535
 /begin AXIS_DESCR FIX_AXIS NO_INPUT_QUANTITY EH_STANDARD_S5_S3 18 0 17 FIX_AXIS_PAR_DIST 0 1 18 /end AXIS_DESCR
/end CHARACTERISTIC
/begin CHARACTERISTIC D_DiErrorCode_102 "Calibration Field for error code 102" CURVE 0x2033D4 ZF_tab_nx_ui16_S5_S3 65535 EH_STANDARD_S5_S3 0 65535
 /begin AXIS_DESCR FIX_AXIS NO_INPUT_QUANTITY EH_STANDARD_S5_S3 18 0 17 FIX_AXIS_PAR_DIST 0 1 18 /end AXIS_DESCR
/end CHARACTERISTIC
/begin CHARACTERISTIC D_DiErrorCode_103 "Calibration Field for error code 103" CURVE 0x2033F8 ZF_tab_nx_ui16_S5_S3 65535 EH_STANDARD_S5_S3 0 65535
 /begin AXIS_DESCR FIX_AXIS NO_INPUT_QUANTITY EH_STANDARD_S5_S3 18 0 17 FIX_AXIS_PAR_DIST 0 1 18 /end AXIS_DESCR
/end CHARACTERISTIC
/begin CHARACTERISTIC D_DiErrorCode_104 "Calibration Field for error code 104" CURVE 0x20341C ZF_tab_nx_ui16_S5_S3 65535 EH_STANDARD_S5_S3 0 65535
 /begin AXIS_DESCR FIX_AXIS NO_INPUT_QUANTITY EH_STANDARD_S5_S3 18 0 17 FIX_AXIS_PAR_DIST 0 1 18 /end AXIS_DESCR
/end CHARACTERISTIC
/begin CHARACTERISTIC D_DiErrorCode_105 "Calibration Field for error code 105" CURVE 0x203440 ZF_tab_nx_ui16_S5_S3 65535 EH_STANDARD_S5_S3 0 65535
 /begin AXIS_DESCR FIX_AXIS NO_INPUT_QUANTITY EH_STANDARD_S5_S3 18 0 17 FIX_AXIS_PAR_DIST 0 1 18 /end AXIS_DESCR
/end CHARACTERISTIC
/begin CHARACTERISTIC D_DiErrorCode_106 "Calibration Field for error code 106" CURVE 0x203464 ZF_tab_nx_ui16_S5_S3 65535 EH_STANDARD_S5_S3 0 65535
 /begin AXIS_DESCR FIX_AXIS NO_INPUT_QUANTITY EH_STANDARD_S5_S3 18 0 17 FIX_AXIS_PAR_DIST 0 1 18 /end AXIS_DESCR
/end CHARACTERISTIC
/begin CHARACTERISTIC D_DiErrorCode_107 "Calibration Field for error code 107" CURVE 0x203488 ZF_tab_nx_ui16_S5_S3 65535 EH_STANDARD_S5_S3 0 65535
 /begin AXIS_DESCR FIX_AXIS NO_INPUT_QUANTITY EH_STANDARD_S5_S3 18 0 17 FIX_AXIS_PAR_DIST 0 1 18 /end AXIS_DESCR
/end CHARACTERISTIC
/begin CHARACTERISTIC D_DiErrorCode_108 "Calibration Field for error code 108" CURVE 0x2034AC ZF_tab_nx_ui16_S5_S3 65535 EH_STANDARD_S5_S3 0 65535
 /begin AXIS_DESCR FIX_AXIS NO_INPUT_QUANTITY EH_STANDARD_S5_S3 18 0 17 FIX_AXIS_PAR_DIST 0 1 18 /end AXIS_DESCR
/end CHARACTERISTIC
/begin CHARACTERISTIC D_DiErrorCode_109 "Calibration Field for error code 109" CURVE 0x2034D0 ZF_tab_nx_ui16_S5_S3 65535 EH_STANDARD_S5_S3 0 65535
 /begin AXIS_DESCR FIX_AXIS NO_INPUT_QUANTITY EH_STANDARD_S5_S3 18 0 17 FIX_AXIS_PAR_DIST 0 1 18 /end AXIS_DESCR
/end CHARACTERISTIC
/begin CHARACTERISTIC D_DiErrorCode_110 "Calibration Field for error code 110" CURVE 0x2034F4 ZF_tab_nx_ui16_S5_S3 65535 EH_STANDARD_S5_S3 0 65535
 /begin AXIS_DESCR FIX_AXIS NO_INPUT_QUANTITY EH_STANDARD_S5_S3 18 0 17 FIX_AXIS_PAR_DIST 0 1 18 /end AXIS_DESCR
/end CHARACTERISTIC
/begin CHARACTERISTIC D_DiErrorCode_111 "Calibration Field for error code 111" CURVE 0x203518 ZF_tab_nx_ui16_S5_S3 65535 EH_STANDARD_S5_S3 0 65535
 /begin AXIS_DESCR FIX_AXIS NO_INPUT_QUANTITY EH_STANDARD_S5_S3 18 0 17 FIX_AXIS_PAR_DIST 0 1 18 /end AXIS_DESCR
/end CHARACTERISTIC
/begin CHARACTERISTIC D_DiErrorCode_112 "Calibration Field for error code 112" CURVE 0x20353C ZF_tab_nx_ui16_S5_S3 65535 EH_STANDARD_S5_S3 0 65535
 /begin AXIS_DESCR FIX_AXIS NO_INPUT_QUANTITY EH_STANDARD_S5_S3 18 0 17 FIX_AXIS_PAR_DIST 0 1 18 /end AXIS_DESCR
/end CHARACTERISTIC
/begin CHARACTERISTIC D_DiErrorCode_113 "Calibration Field for error code 113" CURVE 0x203560 ZF_tab_nx_ui16_S5_S3 65535 EH_STANDARD_S5_S3 0 65535
 /begin AXIS_DESCR FIX_AXIS NO_INPUT_QUANTITY EH_STANDARD_S5_S3 18 0 17 FIX_AXIS_PAR_DIST 0 1 18 /end AXIS_DESCR
/end CHARACTERISTIC
/begin CHARACTERISTIC D_DiErrorCode_114 "Calibration Field for error code 114" CURVE 0x203584 ZF_tab_nx_ui16_S5_S3 65535 EH_STANDARD_S5_S3 0 65535
 /begin AXIS_DESCR FIX_AXIS NO_INPUT_QUANTITY EH_STANDARD_S5_S3 18 0 17 FIX_AXIS_PAR_DIST 0 1 18 /end AXIS_DESCR
/end CHARACTERISTIC
/begin CHARACTERISTIC D_DiErrorCode_115 "Calibration Field for error code 115" CURVE 0x2035A8 ZF_tab_nx_ui16_S5_S3 65535 EH_STANDARD_S5_S3 0 65535
 /begin AXIS_DESCR FIX_AXIS NO_INPUT_QUANTITY EH_STANDARD_S5_S3 18 0 17 FIX_AXIS_PAR_DIST 0 1 18 /end AXIS_DESCR
/end CHARACTERISTIC
/begin CHARACTERISTIC D_DiErrorCode_116 "Calibration Field for error code 116" CURVE 0x2035CC ZF_tab_nx_ui16_S5_S3 65535 EH_STANDARD_S5_S3 0 65535
 /begin AXIS_DESCR FIX_AXIS NO_INPUT_QUANTITY EH_STANDARD_S5_S3 18 0 17 FIX_AXIS_PAR_DIST 0 1 18 /end AXIS_DESCR
/end CHARACTERISTIC
/begin CHARACTERISTIC D_DiErrorCode_117 "Calibration Field for error code 117" CURVE 0x2035F0 ZF_tab_nx_ui16_S5_S3 65535 EH_STANDARD_S5_S3 0 65535
 /begin AXIS_DESCR FIX_AXIS NO_INPUT_QUANTITY EH_STANDARD_S5_S3 18 0 17 FIX_AXIS_PAR_DIST 0 1 18 /end AXIS_DESCR
/end CHARACTERISTIC
/begin CHARACTERISTIC D_DiErrorCode_118 "Calibration Field for error code 118" CURVE 0x203614 ZF_tab_nx_ui16_S5_S3 65535 EH_STANDARD_S5_S3 0 65535
 /begin AXIS_DESCR FIX_AXIS NO_INPUT_QUANTITY EH_STANDARD_S5_S3 18 0 17 FIX_AXIS_PAR_DIST 0 1 18 /end AXIS_DESCR
/end CHARACTERISTIC
/begin CHARACTERISTIC D_DiErrorCode_119 "Calibration Field for error code 119" CURVE 0x203638 ZF_tab_nx_ui16_S5_S3 65535 EH_STANDARD_S5_S3 0 65535
 /begin AXIS_DESCR FIX_AXIS NO_INPUT_QUANTITY EH_STANDARD_S5_S3 18 0 17 FIX_AXIS_PAR_DIST 0 1 18 /end AXIS_DESCR
/end CHARACTERISTIC
/begin CHARACTERISTIC D_DiErrorCode_120 "Calibration Field for error code 120" CURVE 0x20365C ZF_tab_nx_ui16_S5_S3 65535 EH_STANDARD_S5_S3 0 65535
 /begin AXIS_DESCR FIX_AXIS NO_INPUT_QUANTITY EH_STANDARD_S5_S3 18 0 17 FIX_AXIS_PAR_DIST 0 1 18 /end AXIS_DESCR
/end CHARACTERISTIC
/begin CHARACTERISTIC D_DiErrorCode_121 "Calibration Field for error code 121" CURVE 0x203680 ZF_tab_nx_ui16_S5_S3 65535 EH_STANDARD_S5_S3 0 65535
 /begin AXIS_DESCR FIX_AXIS NO_INPUT_QUANTITY EH_STANDARD_S5_S3 18 0 17 FIX_AXIS_PAR_DIST 0 1 18 /end AXIS_DESCR
/end CHARACTERISTIC
/begin CHARACTERISTIC D_DiErrorCode_122 "Calibration Field for error code 122" CURVE 0x2036A4 ZF_tab_nx_ui16_S5_S3 65535 EH_STANDARD_S5_S3 0 65535
 /begin AXIS_DESCR FIX_AXIS NO_INPUT_QUANTITY EH_STANDARD_S5_S3 18 0 17 FIX_AXIS_PAR_DIST 0 1 18 /end AXIS_DESCR
/end CHARACTERISTIC
/begin CHARACTERISTIC D_DiErrorCode_123 "Calibration Field for error code 123" CURVE 0x2036C8 ZF_tab_nx_ui16_S5_S3 65535 EH_STANDARD_S5_S3 0 65535
 /begin AXIS_DESCR FIX_AXIS NO_INPUT_QUANTITY EH_STANDARD_S5_S3 18 0 17 FIX_AXIS_PAR_DIST 0 1 18 /end AXIS_DESCR
/end CHARACTERISTIC
/begin CHARACTERISTIC D_DiErrorCode_124 "Calibration Field for error code 124" CURVE 0x2036EC ZF_tab_nx_ui16_S5_S3 65535 EH_STANDARD_S5_S3 0 65535
 /begin AXIS_DESCR FIX_AXIS NO_INPUT_QUANTITY EH_STANDARD_S5_S3 18 0 17 FIX_AXIS_PAR_DIST 0 1 18 /end AXIS_DESCR
/end CHARACTERISTIC
/begin CHARACTERISTIC D_DiErrorCode_125 "Calibration Field for error code 125" CURVE 0x203710 ZF_tab_nx_ui16_S5_S3 65535 EH_STANDARD_S5_S3 0 65535
 /begin AXIS_DESCR FIX_AXIS NO_INPUT_QUANTITY EH_STANDARD_S5_S3 18 0 17 FIX_AXIS_PAR_DIST 0 1 18 /end AXIS_DESCR
/end CHARACTERISTIC
/begin CHARACTERISTIC D_DiErrorCode_126 "Calibration Field for error code 126" CURVE 0x203734 ZF_tab_nx_ui16_S5_S3 65535 EH_STANDARD_S5_S3 0 65535
 /begin AXIS_DESCR FIX_AXIS NO_INPUT_QUANTITY EH_STANDARD_S5_S3 18 0 17 FIX_AXIS_PAR_DIST 0 1 18 /end AXIS_DESCR
/end CHARACTERISTIC
/begin CHARACTERISTIC D_DiErrorCode_127 "Calibration Field for error code 127" CURVE 0x203758 ZF_tab_nx_ui16_S5_S3 65535 EH_STANDARD_S5_S3 0 65535
 /begin AXIS_DESCR FIX_AXIS NO_INPUT_QUANTITY EH_STANDARD_S5_S3 18 0 17 FIX_AXIS_PAR_DIST 0 1 18 /end AXIS_DESCR
/end CHARACTERISTIC
/begin CHARACTERISTIC D_DiErrorCode_128 "Calibration Field for error code 128" CURVE 0x20377C ZF_tab_nx_ui16_S5_S3 65535 EH_STANDARD_S5_S3 0 65535
 /begin AXIS_DESCR FIX_AXIS NO_INPUT_QUANTITY EH_STANDARD_S5_S3 18 0 17 FIX_AXIS_PAR_DIST 0 1 18 /end AXIS_DESCR
/end CHARACTERISTIC
/begin CHARACTERISTIC D_DiErrorCode_129 "Calibration Field for error code 129" CURVE 0x2037A0 ZF_tab_nx_ui16_S5_S3 65535 EH_STANDARD_S5_S3 0 65535
 /begin AXIS_DESCR FIX_AXIS NO_INPUT_QUANTITY EH_STANDARD_S5_S3 18 0 17 FIX_AXIS_PAR_DIST 0 1 18 /end AXIS_DESCR
/end CHARACTERISTIC
/begin CHARACTERISTIC D_DiErrorCode_130 "Calibration Field for error code 130" CURVE 0x2037C4 ZF_tab_nx_ui16_S5_S3 65535 EH_STANDARD_S5_S3 0 65535
 /begin AXIS_DESCR FIX_AXIS NO_INPUT_QUANTITY EH_STANDARD_S5_S3 18 0 17 FIX_AXIS_PAR_DIST 0 1 18 /end AXIS_DESCR
/end CHARACTERISTIC
/begin CHARACTERISTIC D_DiErrorCode_131 "Calibration Field for error code 131" CURVE 0x2037E8 ZF_tab_nx_ui16_S5_S3 65535 EH_STANDARD_S5_S3 0 65535
 /begin AXIS_DESCR FIX_AXIS NO_INPUT_QUANTITY EH_STANDARD_S5_S3 18 0 17 FIX_AXIS_PAR_DIST 0 1 18 /end AXIS_DESCR
/end CHARACTERISTIC
/begin CHARACTERISTIC D_DiErrorCode_132 "Calibration Field for error code 132" CURVE 0x20380C ZF_tab_nx_ui16_S5_S3 65535 EH_STANDARD_S5_S3 0 65535
 /begin AXIS_DESCR FIX_AXIS NO_INPUT_QUANTITY EH_STANDARD_S5_S3 18 0 17 FIX_AXIS_PAR_DIST 0 1 18 /end AXIS_DESCR
/end CHARACTERISTIC
/begin CHARACTERISTIC D_DiErrorCode_133 "Calibration Field for error code 133" CURVE 0x203830 ZF_tab_nx_ui16_S5_S3 65535 EH_STANDARD_S5_S3 0 65535
 /begin AXIS_DESCR FIX_AXIS NO_INPUT_QUANTITY EH_STANDARD_S5_S3 18 0 17 FIX_AXIS_PAR_DIST 0 1 18 /end AXIS_DESCR
/end CHARACTERISTIC
/begin CHARACTERISTIC D_DiErrorCode_134 "Calibration Field for error code 134" CURVE 0x203854 ZF_tab_nx_ui16_S5_S3 65535 EH_STANDARD_S5_S3 0 65535
 /begin AXIS_DESCR FIX_AXIS NO_INPUT_QUANTITY EH_STANDARD_S5_S3 18 0 17 FIX_AXIS_PAR_DIST 0 1 18 /end AXIS_DESCR
/end CHARACTERISTIC
/begin CHARACTERISTIC D_DiErrorCode_135 "Calibration Field for error code 135" CURVE 0x203878 ZF_tab_nx_ui16_S5_S3 65535 EH_STANDARD_S5_S3 0 65535
 /begin AXIS_DESCR FIX_AXIS NO_INPUT_QUANTITY EH_STANDARD_S5_S3 18 0 17 FIX_AXIS_PAR_DIST 0 1 18 /end AXIS_DESCR
/end CHARACTERISTIC
/begin CHARACTERISTIC D_DiErrorCode_136 "Calibration Field for error code 136" CURVE 0x20389C ZF_tab_nx_ui16_S5_S3 65535 EH_STANDARD_S5_S3 0 65535
 /begin AXIS_DESCR FIX_AXIS NO_INPUT_QUANTITY EH_STANDARD_S5_S3 18 0 17 FIX_AXIS_PAR_DIST 0 1 18 /end AXIS_DESCR
/end CHARACTERISTIC
/begin CHARACTERISTIC D_DiErrorCode_137 "Calibration Field for error code 137" CURVE 0x2038C0 ZF_tab_nx_ui16_S5_S3 65535 EH_STANDARD_S5_S3 0 65535
 /begin AXIS_DESCR FIX_AXIS NO_INPUT_QUANTITY EH_STANDARD_S5_S3 18 0 17 FIX_AXIS_PAR_DIST 0 1 18 /end AXIS_DESCR
/end CHARACTERISTIC
/begin CHARACTERISTIC D_DiErrorCode_138 "Calibration Field for error code 138" CURVE 0x2038E4 ZF_tab_nx_ui16_S5_S3 65535 EH_STANDARD_S5_S3 0 65535
 /begin AXIS_DESCR FIX_AXIS NO_INPUT_QUANTITY EH_STANDARD_S5_S3 18 0 17 FIX_AXIS_PAR_DIST 0 1 18 /end AXIS_DESCR
/end CHARACTERISTIC
/begin CHARACTERISTIC D_DiErrorCode_139 "Calibration Field for error code 139" CURVE 0x203908 ZF_tab_nx_ui16_S5_S3 65535 EH_STANDARD_S5_S3 0 65535
 /begin AXIS_DESCR FIX_AXIS NO_INPUT_QUANTITY EH_STANDARD_S5_S3 18 0 17 FIX_AXIS_PAR_DIST 0 1 18 /end AXIS_DESCR
/end CHARACTERISTIC
/begin CHARACTERISTIC D_DiErrorCode_140 "Calibration Field for error code 140" CURVE 0x20392C ZF_tab_nx_ui16_S5_S3 65535 EH_STANDARD_S5_S3 0 65535
 /begin AXIS_DESCR FIX_AXIS NO_INPUT_QUANTITY EH_STANDARD_S5_S3 18 0 17 FIX_AXIS_PAR_DIST 0 1 18 /end AXIS_DESCR
/end CHARACTERISTIC
/begin CHARACTERISTIC D_DiErrorCode_141 "Calibration Field for error code 141" CURVE 0x203950 ZF_tab_nx_ui16_S5_S3 65535 EH_STANDARD_S5_S3 0 65535
 /begin AXIS_DESCR FIX_AXIS NO_INPUT_QUANTITY EH_STANDARD_S5_S3 18 0 17 FIX_AXIS_PAR_DIST 0 1 18 /end AXIS_DESCR
/end CHARACTERISTIC
/begin CHARACTERISTIC D_DiErrorCode_142 "Calibration Field for error code 142" CURVE 0x203974 ZF_tab_nx_ui16_S5_S3 65535 EH_STANDARD_S5_S3 0 65535
 /begin AXIS_DESCR FIX_AXIS NO_INPUT_QUANTITY EH_STANDARD_S5_S3 18 0 17 FIX_AXIS_PAR_DIST 0 1 18 /end AXIS_DESCR
/end CHARACTERISTIC
/begin CHARACTERISTIC D_DiErrorCode_143 "Calibration Field for error code 143" CURVE 0x203998 ZF_tab_nx_ui16_S5_S3 65535 EH_STANDARD_S5_S3 0 65535
 /begin AXIS_DESCR FIX_AXIS NO_INPUT_QUANTITY EH_STANDARD_S5_S3 18 0 17 FIX_AXIS_PAR_DIST 0 1 18 /end AXIS_DESCR
/end CHARACTERISTIC
/begin CHARACTERISTIC D_DiErrorCode_144 "Calibration Field for error code 144" CURVE 0x2039BC ZF_tab_nx_ui16_S5_S3 65535 EH_STANDARD_S5_S3 0 65535
 /begin AXIS_DESCR FIX_AXIS NO_INPUT_QUANTITY EH_STANDARD_S5_S3 18 0 17 FIX_AXIS_PAR_DIST 0 1 18 /end AXIS_DESCR
/end CHARACTERISTIC
/begin CHARACTERISTIC D_DiErrorCode_145 "Calibration Field for error code 145" CURVE 0x2039E0 ZF_tab_nx_ui16_S5_S3 65535 EH_STANDARD_S5_S3 0 65535
 /begin AXIS_DESCR FIX_AXIS NO_INPUT_QUANTITY EH_STANDARD_S5_S3 18 0 17 FIX_AXIS_PAR_DIST 0 1 18 /end AXIS_DESCR
/end CHARACTERISTIC
/begin CHARACTERISTIC D_DiErrorCode_146 "Calibration Field for error code 146" CURVE 0x203A04 ZF_tab_nx_ui16_S5_S3 65535 EH_STANDARD_S5_S3 0 65535
 /begin AXIS_DESCR FIX_AXIS NO_INPUT_QUANTITY EH_STANDARD_S5_S3 18 0 17 FIX_AXIS_PAR_DIST 0 1 18 /end AXIS_DESCR
/end CHARACTERISTIC
/begin CHARACTERISTIC D_DiErrorCode_147 "Calibration Field for error code 147" CURVE 0x203A28 ZF_tab_nx_ui16_S5_S3 65535 EH_STANDARD_S5_S3 0 65535
 /begin AXIS_DESCR FIX_AXIS NO_INPUT_QUANTITY EH_STANDARD_S5_S3 18 0 17 FIX_AXIS_PAR_DIST 0 1 18 /end AXIS_DESCR
/end CHARACTERISTIC
/begin CHARACTERISTIC D_DiErrorCode_148 "Calibration Field for error code 148" CURVE 0x203A4C ZF_tab_nx_ui16_S5_S3 65535 EH_STANDARD_S5_S3 0 65535
 /begin AXIS_DESCR FIX_AXIS NO_INPUT_QUANTITY EH_STANDARD_S5_S3 18 0 17 FIX_AXIS_PAR_DIST 0 1 18 /end AXIS_DESCR
/end CHARACTERISTIC
/begin CHARACTERISTIC D_DiErrorCode_149 "Calibration Field for error code 149" CURVE 0x203A70 ZF_tab_nx_ui16_S5_S3 65535 EH_STANDARD_S5_S3 0 65535
 /begin AXIS_DESCR FIX_AXIS NO_INPUT_QUANTITY EH_STANDARD_S5_S3 18 0 17 FIX_AXIS_PAR_DIST 0 1 18 /end AXIS_DESCR
/end CHARACTERISTIC
/begin CHARACTERISTIC D_DiErrorCode_150 "Calibration Field for error code 150" CURVE 0x203A94 ZF_tab_nx_ui16_S5_S3 65535 EH_STANDARD_S5_S3 0 65535
 /begin AXIS_DESCR FIX_AXIS NO_INPUT_QUANTITY EH_STANDARD_S5_S3 18 0 17 FIX_AXIS_PAR_DIST 0 1 18 /end AXIS_DESCR
/end CHARACTERISTIC
/begin CHARACTERISTIC D_DiErrorCode_151 "Calibration Field for error code 151" CURVE 0x203AB8 ZF_tab_nx_ui16_S5_S3 65535 EH_STANDARD_S5_S3 0 65535
 /begin AXIS_DESCR FIX_AXIS NO_INPUT_QUANTITY EH_STANDARD_S5_S3 18 0 17 FIX_AXIS_PAR_DIST 0 1 18 /end AXIS_DESCR
/end CHARACTERISTIC
/begin CHARACTERISTIC D_DiErrorCode_152 "Calibration Field for error code 152" CURVE 0x203ADC ZF_tab_nx_ui16_S5_S3 65535 EH_STANDARD_S5_S3 0 65535
 /begin AXIS_DESCR FIX_AXIS NO_INPUT_QUANTITY EH_STANDARD_S5_S3 18 0 17 FIX_AXIS_PAR_DIST 0 1 18 /end AXIS_DESCR
/end CHARACTERISTIC
/begin CHARACTERISTIC D_DiErrorCode_153 "Calibration Field for error code 153" CURVE 0x203B00 ZF_tab_nx_ui16_S5_S3 65535 EH_STANDARD_S5_S3 0 65535
 /begin AXIS_DESCR FIX_AXIS NO_INPUT_QUANTITY EH_STANDARD_S5_S3 18 0 17 FIX_AXIS_PAR_DIST 0 1 18 /end AXIS_DESCR
/end CHARACTERISTIC
/begin CHARACTERISTIC D_DiErrorCode_154 "Calibration Field for error code 154" CURVE 0x203B24 ZF_tab_nx_ui16_S5_S3 65535 EH_STANDARD_S5_S3 0 65535
 /begin AXIS_DESCR FIX_AXIS NO_INPUT_QUANTITY EH_STANDARD_S5_S3 18 0 17 FIX_AXIS_PAR_DIST 0 1 18 /end AXIS_DESCR
/end CHARACTERISTIC
/begin CHARACTERISTIC D_DiErrorCode_155 "Calibration Field for error code 155" CURVE 0x203B48 ZF_tab_nx_ui16_S5_S3 65535 EH_STANDARD_S5_S3 0 65535
 /begin AXIS_DESCR FIX_AXIS NO_INPUT_QUANTITY EH_STANDARD_S5_S3 18 0 17 FIX_AXIS_PAR_DIST 0 1 18 /end AXIS_DESCR
/end CHARACTERISTIC
/begin CHARACTERISTIC D_DiErrorCode_156 "Calibration Field for error code 156" CURVE 0x203B6C ZF_tab_nx_ui16_S5_S3 65535 EH_STANDARD_S5_S3 0 65535
 /begin AXIS_DESCR FIX_AXIS NO_INPUT_QUANTITY EH_STANDARD_S5_S3 18 0 17 FIX_AXIS_PAR_DIST 0 1 18 /end AXIS_DESCR
/end CHARACTERISTIC
/begin CHARACTERISTIC D_DiErrorCode_157 "Calibration Field for error code 157" CURVE 0x203B90 ZF_tab_nx_ui16_S5_S3 65535 EH_STANDARD_S5_S3 0 65535
 /begin AXIS_DESCR FIX_AXIS NO_INPUT_QUANTITY EH_STANDARD_S5_S3 18 0 17 FIX_AXIS_PAR_DIST 0 1 18 /end AXIS_DESCR
/end CHARACTERISTIC
/begin CHARACTERISTIC D_DiErrorCode_158 "Calibration Field for error code 158" CURVE 0x203BB4 ZF_tab_nx_ui16_S5_S3 65535 EH_STANDARD_S5_S3 0 65535
 /begin AXIS_DESCR FIX_AXIS NO_INPUT_QUANTITY EH_STANDARD_S5_S3 18 0 17 FIX_AXIS_PAR_DIST 0 1 18 /end AXIS_DESCR
/end CHARACTERISTIC
/begin CHARACTERISTIC D_DiErrorCode_159 "Calibration Field for error code 159" CURVE 0x203BD8 ZF_tab_nx_ui16_S5_S3 65535 EH_STANDARD_S5_S3 0 65535
 /begin AXIS_DESCR FIX_AXIS NO_INPUT_QUANTITY EH_STANDARD_S5_S3 18 0 17 FIX_AXIS_PAR_DIST 0 1 18 /end AXIS_DESCR
/end CHARACTERISTIC
/begin CHARACTERISTIC D_DiErrorCode_160 "Calibration Field for error code 160" CURVE 0x203BFC ZF_tab_nx_ui16_S5_S3 65535 EH_STANDARD_S5_S3 0 65535
 /begin AXIS_DESCR FIX_AXIS NO_INPUT_QUANTITY EH_STANDARD_S5_S3 18 0 17 FIX_AXIS_PAR_DIST 0 1 18 /end AXIS_DESCR
/end CHARACTERISTIC
/begin CHARACTERISTIC D_DiErrorCode_161 "Calibration Field for error code 161" CURVE 0x203C20 ZF_tab_nx_ui16_S5_S3 65535 EH_STANDARD_S5_S3 0 65535
 /begin AXIS_DESCR FIX_AXIS NO_INPUT_QUANTITY EH_STANDARD_S5_S3 18 0 17 FIX_AXIS_PAR_DIST 0 1 18 /end AXIS_DESCR
/end CHARACTERISTIC
/begin CHARACTERISTIC D_DiErrorCode_162 "Calibration Field for error code 162" CURVE 0x203C44 ZF_tab_nx_ui16_S5_S3 65535 EH_STANDARD_S5_S3 0 65535
 /begin AXIS_DESCR FIX_AXIS NO_INPUT_QUANTITY EH_STANDARD_S5_S3 18 0 17 FIX_AXIS_PAR_DIST 0 1 18 /end AXIS_DESCR
/end CHARACTERISTIC
/begin CHARACTERISTIC D_DiErrorCode_163 "Calibration Field for error code 163" CURVE 0x203C68 ZF_tab_nx_ui16_S5_S3 65535 EH_STANDARD_S5_S3 0 65535
 /begin AXIS_DESCR FIX_AXIS NO_INPUT_QUANTITY EH_STANDARD_S5_S3 18 0 17 FIX_AXIS_PAR_DIST 0 1 18 /end AXIS_DESCR
/end CHARACTERISTIC
/begin CHARACTERISTIC D_DiErrorCode_164 "Calibration Field for error code 164" CURVE 0x203C8C ZF_tab_nx_ui16_S5_S3 65535 EH_STANDARD_S5_S3 0 65535
 /begin AXIS_DESCR FIX_AXIS NO_INPUT_QUANTITY EH_STANDARD_S5_S3 18 0 17 FIX_AXIS_PAR_DIST 0 1 18 /end AXIS_DESCR
/end CHARACTERISTIC
/begin CHARACTERISTIC D_DiErrorCode_165 "Calibration Field for error code 165" CURVE 0x203CB0 ZF_tab_nx_ui16_S5_S3 65535 EH_STANDARD_S5_S3 0 65535
 /begin AXIS_DESCR FIX_AXIS NO_INPUT_QUANTITY EH_STANDARD_S5_S3 18 0 17 FIX_AXIS_PAR_DIST 0 1 18 /end AXIS_DESCR
/end CHARACTERISTIC
/begin CHARACTERISTIC D_DiErrorCode_166 "Calibration Field for error code 166" CURVE 0x203CD4 ZF_tab_nx_ui16_S5_S3 65535 EH_STANDARD_S5_S3 0 65535
 /begin AXIS_DESCR FIX_AXIS NO_INPUT_QUANTITY EH_STANDARD_S5_S3 18 0 17 FIX_AXIS_PAR_DIST 0 1 18 /end AXIS_DESCR
/end CHARACTERISTIC
/begin CHARACTERISTIC D_DiErrorCode_167 "Calibration Field for error code 167" CURVE 0x203CF8 ZF_tab_nx_ui16_S5_S3 65535 EH_STANDARD_S5_S3 0 65535
 /begin AXIS_DESCR FIX_AXIS NO_INPUT_QUANTITY EH_STANDARD_S5_S3 18 0 17 FIX_AXIS_PAR_DIST 0 1 18 /end AXIS_DESCR
/end CHARACTERISTIC
/begin CHARACTERISTIC D_DiErrorCode_168 "Calibration Field for error code 168" CURVE 0x203D1C ZF_tab_nx_ui16_S5_S3 65535 EH_STANDARD_S5_S3 0 65535
 /begin AXIS_DESCR FIX_AXIS NO_INPUT_QUANTITY EH_STANDARD_S5_S3 18 0 17 FIX_AXIS_PAR_DIST 0 1 18 /end AXIS_DESCR
/end CHARACTERISTIC
/begin CHARACTERISTIC D_DiErrorCode_169 "Calibration Field for error code 169" CURVE 0x203D40 ZF_tab_nx_ui16_S5_S3 65535 EH_STANDARD_S5_S3 0 65535
 /begin AXIS_DESCR FIX_AXIS NO_INPUT_QUANTITY EH_STANDARD_S5_S3 18 0 17 FIX_AXIS_PAR_DIST 0 1 18 /end AXIS_DESCR
/end CHARACTERISTIC
/begin CHARACTERISTIC D_DiErrorCode_170 "Calibration Field for error code 170" CURVE 0x203D64 ZF_tab_nx_ui16_S5_S3 65535 EH_STANDARD_S5_S3 0 65535
 /begin AXIS_DESCR FIX_AXIS NO_INPUT_QUANTITY EH_STANDARD_S5_S3 18 0 17 FIX_AXIS_PAR_DIST 0 1 18 /end AXIS_DESCR
/end CHARACTERISTIC
/begin CHARACTERISTIC D_DiErrorCode_171 "Calibration Field for error code 171" CURVE 0x203D88 ZF_tab_nx_ui16_S5_S3 65535 EH_STANDARD_S5_S3 0 65535
 /begin AXIS_DESCR FIX_AXIS NO_INPUT_QUANTITY EH_STANDARD_S5_S3 18 0 17 FIX_AXIS_PAR_DIST 0 1 18 /end AXIS_DESCR
/end CHARACTERISTIC
/begin CHARACTERISTIC D_DiErrorCode_172 "Calibration Field for error code 172" CURVE 0x203DAC ZF_tab_nx_ui16_S5_S3 65535 EH_STANDARD_S5_S3 0 65535
 /begin AXIS_DESCR FIX_AXIS NO_INPUT_QUANTITY EH_STANDARD_S5_S3 18 0 17 FIX_AXIS_PAR_DIST 0 1 18 /end AXIS_DESCR
/end CHARACTERISTIC
/begin CHARACTERISTIC D_DiErrorCode_173 "Calibration Field for error code 173" CURVE 0x203DD0 ZF_tab_nx_ui16_S5_S3 65535 EH_STANDARD_S5_S3 0 65535
 /begin AXIS_DESCR FIX_AXIS NO_INPUT_QUANTITY EH_STANDARD_S5_S3 18 0 17 FIX_AXIS_PAR_DIST 0 1 18 /end AXIS_DESCR
/end CHARACTERISTIC
/begin CHARACTERISTIC D_DiErrorCode_174 "Calibration Field for error code 174" CURVE 0x203DF4 ZF_tab_nx_ui16_S5_S3 65535 EH_STANDARD_S5_S3 0 65535
 /begin AXIS_DESCR FIX_AXIS NO_INPUT_QUANTITY EH_STANDARD_S5_S3 18 0 17 FIX_AXIS_PAR_DIST 0 1 18 /end AXIS_DESCR
/end CHARACTERISTIC
/begin CHARACTERISTIC D_DiErrorCode_175 "Calibration Field for error code 175" CURVE 0x203E18 ZF_tab_nx_ui16_S5_S3 65535 EH_STANDARD_S5_S3 0 65535
 /begin AXIS_DESCR FIX_AXIS NO_INPUT_QUANTITY EH_STANDARD_S5_S3 18 0 17 FIX_AXIS_PAR_DIST 0 1 18 /end AXIS_DESCR
/end CHARACTERISTIC
/begin CHARACTERISTIC D_DiErrorCode_176 "Calibration Field for error code 176" CURVE 0x203E3C ZF_tab_nx_ui16_S5_S3 65535 EH_STANDARD_S5_S3 0 65535
 /begin AXIS_DESCR FIX_AXIS NO_INPUT_QUANTITY EH_STANDARD_S5_S3 18 0 17 FIX_AXIS_PAR_DIST 0 1 18 /end AXIS_DESCR
/end CHARACTERISTIC
/begin CHARACTERISTIC D_DiErrorCode_177 "Calibration Field for error code 177" CURVE 0x203E60 ZF_tab_nx_ui16_S5_S3 65535 EH_STANDARD_S5_S3 0 65535
 /begin AXIS_DESCR FIX_AXIS NO_INPUT_QUANTITY EH_STANDARD_S5_S3 18 0 17 FIX_AXIS_PAR_DIST 0 1 18 /end AXIS_DESCR
/end CHARACTERISTIC
/begin CHARACTERISTIC D_DiErrorCode_178 "Calibration Field for error code 178" CURVE 0x203E84 ZF_tab_nx_ui16_S5_S3 65535 EH_STANDARD_S5_S3 0 65535
 /begin AXIS_DESCR FIX_AXIS NO_INPUT_QUANTITY EH_STANDARD_S5_S3 18 0 17 FIX_AXIS_PAR_DIST 0 1 18 /end AXIS_DESCR
/end CHARACTERISTIC
/begin CHARACTERISTIC D_DiErrorCode_179 "Calibration Field for error code 179" CURVE 0x203EA8 ZF_tab_nx_ui16_S5_S3 65535 EH_STANDARD_S5_S3 0 65535
 /begin AXIS_DESCR FIX_AXIS NO_INPUT_QUANTITY EH_STANDARD_S5_S3 18 0 17 FIX_AXIS_PAR_DIST 0 1 18 /end AXIS_DESCR
/end CHARACTERISTIC
/begin CHARACTERISTIC D_DiErrorCode_180 "Calibration Field for error code 180" CURVE 0x203ECC ZF_tab_nx_ui16_S5_S3 65535 EH_STANDARD_S5_S3 0 65535
 /begin AXIS_DESCR FIX_AXIS NO_INPUT_QUANTITY EH_STANDARD_S5_S3 18 0 17 FIX_AXIS_PAR_DIST 0 1 18 /end AXIS_DESCR
/end CHARACTERISTIC
/begin CHARACTERISTIC D_DiErrorCode_181 "Calibration Field for error code 181" CURVE 0x203EF0 ZF_tab_nx_ui16_S5_S3 65535 EH_STANDARD_S5_S3 0 65535
 /begin AXIS_DESCR FIX_AXIS NO_INPUT_QUANTITY EH_STANDARD_S5_S3 18 0 17 FIX_AXIS_PAR_DIST 0 1 18 /end AXIS_DESCR
/end CHARACTERISTIC
/begin CHARACTERISTIC D_DiErrorCode_182 "Calibration Field for error code 182" CURVE 0x203F14 ZF_tab_nx_ui16_S5_S3 65535 EH_STANDARD_S5_S3 0 65535
 /begin AXIS_DESCR FIX_AXIS NO_INPUT_QUANTITY EH_STANDARD_S5_S3 18 0 17 FIX_AXIS_PAR_DIST 0 1 18 /end AXIS_DESCR
/end CHARACTERISTIC
/begin CHARACTERISTIC D_DiErrorCode_183 "Calibration Field for error code 183" CURVE 0x203F38 ZF_tab_nx_ui16_S5_S3 65535 EH_STANDARD_S5_S3 0 65535
 /begin AXIS_DESCR FIX_AXIS NO_INPUT_QUANTITY EH_STANDARD_S5_S3 18 0 17 FIX_AXIS_PAR_DIST 0 1 18 /end AXIS_DESCR
/end CHARACTERISTIC
/begin CHARACTERISTIC D_DiErrorCode_184 "Calibration Field for error code 184" CURVE 0x203F5C ZF_tab_nx_ui16_S5_S3 65535 EH_STANDARD_S5_S3 0 65535
 /begin AXIS_DESCR FIX_AXIS NO_INPUT_QUANTITY EH_STANDARD_S5_S3 18 0 17 FIX_AXIS_PAR_DIST 0 1 18 /end AXIS_DESCR
/end CHARACTERISTIC
/begin CHARACTERISTIC D_DiErrorCode_185 "Calibration Field for error code 185" CURVE 0x203F80 ZF_tab_nx_ui16_S5_S3 65535 EH_STANDARD_S5_S3 0 65535
 /begin AXIS_DESCR FIX_AXIS NO_INPUT_QUANTITY EH_STANDARD_S5_S3 18 0 17 FIX_AXIS_PAR_DIST 0 1 18 /end AXIS_DESCR
/end CHARACTERISTIC
/begin CHARACTERISTIC D_DiErrorCode_186 "Calibration Field for error code 186" CURVE 0x203FA4 ZF_tab_nx_ui16_S5_S3 65535 EH_STANDARD_S5_S3 0 65535
 /begin AXIS_DESCR FIX_AXIS NO_INPUT_QUANTITY EH_STANDARD_S5_S3 18 0 17 FIX_AXIS_PAR_DIST 0 1 18 /end AXIS_DESCR
/end CHARACTERISTIC
/begin CHARACTERISTIC D_DiErrorCode_187 "Calibration Field for error code 187" CURVE 0x203FC8 ZF_tab_nx_ui16_S5_S3 65535 EH_STANDARD_S5_S3 0 65535
 /begin AXIS_DESCR FIX_AXIS NO_INPUT_QUANTITY EH_STANDARD_S5_S3 18 0 17 FIX_AXIS_PAR_DIST 0 1 18 /end AXIS_DESCR
/end CHARACTERISTIC
/begin CHARACTERISTIC D_DiErrorCode_188 "Calibration Field for error code 188" CURVE 0x203FEC ZF_tab_nx_ui16_S5_S3 65535 EH_STANDARD_S5_S3 0 65535
 /begin AXIS_DESCR FIX_AXIS NO_INPUT_QUANTITY EH_STANDARD_S5_S3 18 0 17 FIX_AXIS_PAR_DIST 0 1 18 /end AXIS_DESCR
/end CHARACTERISTIC
/begin CHARACTERISTIC D_DiErrorCode_189 "Calibration Field for error code 189" CURVE 0x204010 ZF_tab_nx_ui16_S5_S3 65535 EH_STANDARD_S5_S3 0 65535
 /begin AXIS_DESCR FIX_AXIS NO_INPUT_QUANTITY EH_STANDARD_S5_S3 18 0 17 FIX_AXIS_PAR_DIST 0 1 18 /end AXIS_DESCR
/end CHARACTERISTIC
/begin CHARACTERISTIC D_DiErrorCode_190 "Calibration Field for error code 190" CURVE 0x204034 ZF_tab_nx_ui16_S5_S3 65535 EH_STANDARD_S5_S3 0 65535
 /begin AXIS_DESCR FIX_AXIS NO_INPUT_QUANTITY EH_STANDARD_S5_S3 18 0 17 FIX_AXIS_PAR_DIST 0 1 18 /end AXIS_DESCR
/end CHARACTERISTIC
/begin CHARACTERISTIC D_DiErrorCode_191 "Calibration Field for error code 191" CURVE 0x204058 ZF_tab_nx_ui16_S5_S3 65535 EH_STANDARD_S5_S3 0 65535
 /begin AXIS_DESCR FIX_AXIS NO_INPUT_QUANTITY EH_STANDARD_S5_S3 18 0 17 FIX_AXIS_PAR_DIST 0 1 18 /end AXIS_DESCR
/end CHARACTERISTIC
/begin CHARACTERISTIC D_DiErrorCode_192 "Calibration Field for error code 192" CURVE 0x20407C ZF_tab_nx_ui16_S5_S3 65535 EH_STANDARD_S5_S3 0 65535
 /begin AXIS_DESCR FIX_AXIS NO_INPUT_QUANTITY EH_STANDARD_S5_S3 18 0 17 FIX_AXIS_PAR_DIST 0 1 18 /end AXIS_DESCR
/end CHARACTERISTIC
/begin CHARACTERISTIC D_DiErrorCode_193 "Calibration Field for error code 193" CURVE 0x2040A0 ZF_tab_nx_ui16_S5_S3 65535 EH_STANDARD_S5_S3 0 65535
 /begin AXIS_DESCR FIX_AXIS NO_INPUT_QUANTITY EH_STANDARD_S5_S3 18 0 17 FIX_AXIS_PAR_DIST 0 1 18 /end AXIS_DESCR
/end CHARACTERISTIC
/begin CHARACTERISTIC D_DiErrorCode_194 "Calibration Field for error code 194" CURVE 0x2040C4 ZF_tab_nx_ui16_S5_S3 65535 EH_STANDARD_S5_S3 0 65535
 /begin AXIS_DESCR FIX_AXIS NO_INPUT_QUANTITY EH_STANDARD_S5_S3 18 0 17 FIX_AXIS_PAR_DIST 0 1 18 /end AXIS_DESCR
/end CHARACTERISTIC
/begin CHARACTERISTIC D_DiErrorCode_195 "Calibration Field for error code 195" CURVE 0x2040E8 ZF_tab_nx_ui16_S5_S3 65535 EH_STANDARD_S5_S3 0 65535
 /begin AXIS_DESCR FIX_AXIS NO_INPUT_QUANTITY EH_STANDARD_S5_S3 18 0 17 FIX_AXIS_PAR_DIST 0 1 18 /end AXIS_DESCR
/end CHARACTERISTIC
/begin CHARACTERISTIC D_DiErrorCode_196 "Calibration Field for error code 196" CURVE 0x20410C ZF_tab_nx_ui16_S5_S3 65535 EH_STANDARD_S5_S3 0 65535
 /begin AXIS_DESCR FIX_AXIS NO_INPUT_QUANTITY EH_STANDARD_S5_S3 18 0 17 FIX_AXIS_PAR_DIST 0 1 18 /end AXIS_DESCR
/end CHARACTERISTIC
/begin CHARACTERISTIC D_DiErrorCode_197 "Calibration Field for error code 197" CURVE 0x204130 ZF_tab_nx_ui16_S5_S3 65535 EH_STANDARD_S5_S3 0 65535
 /begin AXIS_DESCR FIX_AXIS NO_INPUT_QUANTITY EH_STANDARD_S5_S3 18 0 17 FIX_AXIS_PAR_DIST 0 1 18 /end AXIS_DESCR
/end CHARACTERISTIC
/begin CHARACTERISTIC D_DiErrorCode_198 "Calibration Field for error code 198" CURVE 0x204154 ZF_tab_nx_ui16_S5_S3 65535 EH_STANDARD_S5_S3 0 65535
 /begin AXIS_DESCR FIX_AXIS NO_INPUT_QUANTITY EH_STANDARD_S5_S3 18 0 17 FIX_AXIS_PAR_DIST 0 1 18 /end AXIS_DESCR
/end CHARACTERISTIC
/begin CHARACTERISTIC D_DiErrorCode_199 "Calibration Field for error code 199" CURVE 0x204178 ZF_tab_nx_ui16_S5_S3 65535 EH_STANDARD_S5_S3 0 65535
 /begin AXIS_DESCR FIX_AXIS NO_INPUT_QUANTITY EH_STANDARD_S5_S3 18 0 17 FIX_AXIS_PAR_DIST 0 1 18 /end AXIS_DESCR
/end CHARACTERISTIC
/begin CHARACTERISTIC D_DiErrorCode_200 "Calibration Field for error code 200" CURVE 0x20419C ZF_tab_nx_ui16_S5_S3 65535 EH_STANDARD_S5_S3 0 65535
 /begin AXIS_DESCR FIX_AXIS NO_INPUT_QUANTITY EH_STANDARD_S5_S3 18 0 17 FIX_AXIS_PAR_DIST 0 1 18 /end AXIS_DESCR
/end CHARACTERISTIC
/begin CHARACTERISTIC D_DiErrorCode_201 "Calibration Field for error code 201" CURVE 0x2041C0 ZF_tab_nx_ui16_S5_S3 65535 EH_STANDARD_S5_S3 0 65535
 /begin AXIS_DESCR FIX_AXIS NO_INPUT_QUANTITY EH_STANDARD_S5_S3 18 0 17 FIX_AXIS_PAR_DIST 0 1 18 /end AXIS_DESCR
/end CHARACTERISTIC
/begin CHARACTERISTIC D_DiErrorCode_202 "Calibration Field for error code 202" CURVE 0x2041E4 ZF_tab_nx_ui16_S5_S3 65535 EH_STANDARD_S5_S3 0 65535
 /begin AXIS_DESCR FIX_AXIS NO_INPUT_QUANTITY EH_STANDARD_S5_S3 18 0 17 FIX_AXIS_PAR_DIST 0 1 18 /end AXIS_DESCR
/end CHARACTERISTIC
/begin CHARACTERISTIC D_DiErrorCode_203 "Calibration Field for error code 203" CURVE 0x204208 ZF_tab_nx_ui16_S5_S3 65535 EH_STANDARD_S5_S3 0 65535
 /begin AXIS_DESCR FIX_AXIS NO_INPUT_QUANTITY EH_STANDARD_S5_S3 18 0 17 FIX_AXIS_PAR_DIST 0 1 18 /end AXIS_DESCR
/end CHARACTERISTIC
/begin CHARACTERISTIC D_DiErrorCode_204 "Calibration Field for error code 204" CURVE 0x20422C ZF_tab_nx_ui16_S5_S3 65535 EH_STANDARD_S5_S3 0 65535
 /begin AXIS_DESCR FIX_AXIS NO_INPUT_QUANTITY EH_STANDARD_S5_S3 18 0 17 FIX_AXIS_PAR_DIST 0 1 18 /end AXIS_DESCR
/end CHARACTERISTIC
/begin CHARACTERISTIC D_DiErrorCode_205 "Calibration Field for error code 205" CURVE 0x204250 ZF_tab_nx_ui16_S5_S3 65535 EH_STANDARD_S5_S3 0 65535
 /begin AXIS_DESCR FIX_AXIS NO_INPUT_QUANTITY EH_STANDARD_S5_S3 18 0 17 FIX_AXIS_PAR_DIST 0 1 18 /end AXIS_DESCR
/end CHARACTERISTIC
/begin CHARACTERISTIC D_DiErrorCode_206 "Calibration Field for error code 206" CURVE 0x204274 ZF_tab_nx_ui16_S5_S3 65535 EH_STANDARD_S5_S3 0 65535
 /begin AXIS_DESCR FIX_AXIS NO_INPUT_QUANTITY EH_STANDARD_S5_S3 18 0 17 FIX_AXIS_PAR_DIST 0 1 18 /end AXIS_DESCR
/end CHARACTERISTIC
/begin CHARACTERISTIC D_DiErrorCode_207 "Calibration Field for error code 207" CURVE 0x204298 ZF_tab_nx_ui16_S5_S3 65535 EH_STANDARD_S5_S3 0 65535
 /begin AXIS_DESCR FIX_AXIS NO_INPUT_QUANTITY EH_STANDARD_S5_S3 18 0 17 FIX_AXIS_PAR_DIST 0 1 18 /end AXIS_DESCR
/end CHARACTERISTIC
/begin CHARACTERISTIC D_DiErrorCode_208 "Calibration Field for error code 208" CURVE 0x2042BC ZF_tab_nx_ui16_S5_S3 65535 EH_STANDARD_S5_S3 0 65535
 /begin AXIS_DESCR FIX_AXIS NO_INPUT_QUANTITY EH_STANDARD_S5_S3 18 0 17 FIX_AXIS_PAR_DIST 0 1 18 /end AXIS_DESCR
/end CHARACTERISTIC
/begin CHARACTERISTIC D_DiErrorCode_209 "Calibration Field for error code 209" CURVE 0x2042E0 ZF_tab_nx_ui16_S5_S3 65535 EH_STANDARD_S5_S3 0 65535
 /begin AXIS_DESCR FIX_AXIS NO_INPUT_QUANTITY EH_STANDARD_S5_S3 18 0 17 FIX_AXIS_PAR_DIST 0 1 18 /end AXIS_DESCR
/end CHARACTERISTIC
/begin CHARACTERISTIC D_DiErrorCode_210 "Calibration Field for error code 210" CURVE 0x204304 ZF_tab_nx_ui16_S5_S3 65535 EH_STANDARD_S5_S3 0 65535
 /begin AXIS_DESCR FIX_AXIS NO_INPUT_QUANTITY EH_STANDARD_S5_S3 18 0 17 FIX_AXIS_PAR_DIST 0 1 18 /end AXIS_DESCR
/end CHARACTERISTIC
/begin CHARACTERISTIC D_DiErrorCode_211 "Calibration Field for error code 211" CURVE 0x204328 ZF_tab_nx_ui16_S5_S3 65535 EH_STANDARD_S5_S3 0 65535
 /begin AXIS_DESCR FIX_AXIS NO_INPUT_QUANTITY EH_STANDARD_S5_S3 18 0 17 FIX_AXIS_PAR_DIST 0 1 18 /end AXIS_DESCR
/end CHARACTERISTIC
/begin CHARACTERISTIC D_DiErrorCode_212 "Calibration Field for error code 212" CURVE 0x20434C ZF_tab_nx_ui16_S5_S3 65535 EH_STANDARD_S5_S3 0 65535
 /begin AXIS_DESCR FIX_AXIS NO_INPUT_QUANTITY EH_STANDARD_S5_S3 18 0 17 FIX_AXIS_PAR_DIST 0 1 18 /end AXIS_DESCR
/end CHARACTERISTIC
/begin CHARACTERISTIC D_DiErrorCode_213 "Calibration Field for error code 213" CURVE 0x204370 ZF_tab_nx_ui16_S5_S3 65535 EH_STANDARD_S5_S3 0 65535
 /begin AXIS_DESCR FIX_AXIS NO_INPUT_QUANTITY EH_STANDARD_S5_S3 18 0 17 FIX_AXIS_PAR_DIST 0 1 18 /end AXIS_DESCR
/end CHARACTERISTIC
/begin CHARACTERISTIC D_DiErrorCode_214 "Calibration Field for error code 214" CURVE 0x204394 ZF_tab_nx_ui16_S5_S3 65535 EH_STANDARD_S5_S3 0 65535
 /begin AXIS_DESCR FIX_AXIS NO_INPUT_QUANTITY EH_STANDARD_S5_S3 18 0 17 FIX_AXIS_PAR_DIST 0 1 18 /end AXIS_DESCR
/end CHARACTERISTIC
/begin CHARACTERISTIC D_DiErrorCode_215 "Calibration Field for error code 215" CURVE 0x2043B8 ZF_tab_nx_ui16_S5_S3 65535 EH_STANDARD_S5_S3 0 65535
 /begin AXIS_DESCR FIX_AXIS NO_INPUT_QUANTITY EH_STANDARD_S5_S3 18 0 17 FIX_AXIS_PAR_DIST 0 1 18 /end AXIS_DESCR
/end CHARACTERISTIC
/begin CHARACTERISTIC D_DiErrorCode_216 "Calibration Field for error code 216" CURVE 0x2043DC ZF_tab_nx_ui16_S5_S3 65535 EH_STANDARD_S5_S3 0 65535
 /begin AXIS_DESCR FIX_AXIS NO_INPUT_QUANTITY EH_STANDARD_S5_S3 18 0 17 FIX_AXIS_PAR_DIST 0 1 18 /end AXIS_DESCR
/end CHARACTERISTIC
/begin CHARACTERISTIC D_DiErrorCode_217 "Calibration Field for error code 217" CURVE 0x204400 ZF_tab_nx_ui16_S5_S3 65535 EH_STANDARD_S5_S3 0 65535
 /begin AXIS_DESCR FIX_AXIS NO_INPUT_QUANTITY EH_STANDARD_S5_S3 18 0 17 FIX_AXIS_PAR_DIST 0 1 18 /end AXIS_DESCR
/end CHARACTERISTIC
/begin CHARACTERISTIC D_DiErrorCode_218 "Calibration Field for error code 218" CURVE 0x204424 ZF_tab_nx_ui16_S5_S3 65535 EH_STANDARD_S5_S3 0 65535
 /begin AXIS_DESCR FIX_AXIS NO_INPUT_QUANTITY EH_STANDARD_S5_S3 18 0 17 FIX_AXIS_PAR_DIST 0 1 18 /end AXIS_DESCR
/end CHARACTERISTIC
/begin CHARACTERISTIC D_DiErrorCode_219 "Calibration Field for error code 219" CURVE 0x204448 ZF_tab_nx_ui16_S5_S3 65535 EH_STANDARD_S5_S3 0 65535
 /begin AXIS_DESCR FIX_AXIS NO_INPUT_QUANTITY EH_STANDARD_S5_S3 18 0 17 FIX_AXIS_PAR_DIST 0 1 18 /end AXIS_DESCR
/end CHARACTERISTIC
/begin CHARACTERISTIC D_DiErrorCode_220 "Calibration Field for error code 220" CURVE 0x20446C ZF_tab_nx_ui16_S5_S3 65535 EH_STANDARD_S5_S3 0 65535
 /begin AXIS_DESCR FIX_AXIS NO_INPUT_QUANTITY EH_STANDARD_S5_S3 18 0 17 FIX_AXIS_PAR_DIST 0 1 18 /end AXIS_DESCR
/end CHARACTERISTIC
/begin CHARACTERISTIC D_DiErrorCode_221 "Calibration Field for error code 221" CURVE 0x204490 ZF_tab_nx_ui16_S5_S3 65535 EH_STANDARD_S5_S3 0 65535
 /begin AXIS_DESCR FIX_AXIS NO_INPUT_QUANTITY EH_STANDARD_S5_S3 18 0 17 FIX_AXIS_PAR_DIST 0 1 18 /end AXIS_DESCR
/end CHARACTERISTIC
/begin CHARACTERISTIC D_DiErrorCode_222 "Calibration Field for error code 222" CURVE 0x2044B4 ZF_tab_nx_ui16_S5_S3 65535 EH_STANDARD_S5_S3 0 65535
 /begin AXIS_DESCR FIX_AXIS NO_INPUT_QUANTITY EH_STANDARD_S5_S3 18 0 17 FIX_AXIS_PAR_DIST 0 1 18 /end AXIS_DESCR
/end CHARACTERISTIC
/begin CHARACTERISTIC D_DiErrorCode_223 "Calibration Field for error code 223" CURVE 0x2044D8 ZF_tab_nx_ui16_S5_S3 65535 EH_STANDARD_S5_S3 0 65535
 /begin AXIS_DESCR FIX_AXIS NO_INPUT_QUANTITY EH_STANDARD_S5_S3 18 0 17 FIX_AXIS_PAR_DIST 0 1 18 /end AXIS_DESCR
/end CHARACTERISTIC
/begin CHARACTERISTIC D_DiErrorCode_224 "Calibration Field for error code 224" CURVE 0x2044FC ZF_tab_nx_ui16_S5_S3 65535 EH_STANDARD_S5_S3 0 65535
 /begin AXIS_DESCR FIX_AXIS NO_INPUT_QUANTITY EH_STANDARD_S5_S3 18 0 17 FIX_AXIS_PAR_DIST 0 1 18 /end AXIS_DESCR
/end CHARACTERISTIC
/begin CHARACTERISTIC D_DiErrorCode_225 "Calibration Field for error code 225" CURVE 0x204520 ZF_tab_nx_ui16_S5_S3 65535 EH_STANDARD_S5_S3 0 65535
 /begin AXIS_DESCR FIX_AXIS NO_INPUT_QUANTITY EH_STANDARD_S5_S3 18 0 17 FIX_AXIS_PAR_DIST 0 1 18 /end AXIS_DESCR
/end CHARACTERISTIC
/begin CHARACTERISTIC D_DiErrorCode_226 "Calibration Field for error code 226" CURVE 0x204544 ZF_tab_nx_ui16_S5_S3 65535 EH_STANDARD_S5_S3 0 65535
 /begin AXIS_DESCR FIX_AXIS NO_INPUT_QUANTITY EH_STANDARD_S5_S3 18 0 17 FIX_AXIS_PAR_DIST 0 1 18 /end AXIS_DESCR
/end CHARACTERISTIC
/begin CHARACTERISTIC D_DiErrorCode_227 "Calibration Field for error code 227" CURVE 0x204568 ZF_tab_nx_ui16_S5_S3 65535 EH_STANDARD_S5_S3 0 65535
 /begin AXIS_DESCR FIX_AXIS NO_INPUT_QUANTITY EH_STANDARD_S5_S3 18 0 17 FIX_AXIS_PAR_DIST 0 1 18 /end AXIS_DESCR
/end CHARACTERISTIC
/begin CHARACTERISTIC D_DiErrorCode_228 "Calibration Field for error code 228" CURVE 0x20458C ZF_tab_nx_ui16_S5_S3 65535 EH_STANDARD_S5_S3 0 65535
 /begin AXIS_DESCR FIX_AXIS NO_INPUT_QUANTITY EH_STANDARD_S5_S3 18 0 17 FIX_AXIS_PAR_DIST 0 1 18 /end AXIS_DESCR
/end CHARACTERISTIC
/begin CHARACTERISTIC D_DiErrorCode_229 "Calibration Field for error code 229" CURVE 0x2045B0 ZF_tab_nx_ui16_S5_S3 65535 EH_STANDARD_S5_S3 0 65535
 /begin AXIS_DESCR FIX_AXIS NO_INPUT_QUANTITY EH_STANDARD_S5_S3 18 0 17 FIX_AXIS_PAR_DIST 0 1 18 /end AXIS_DESCR
/end CHARACTERISTIC
/begin CHARACTERISTIC D_DiErrorCode_230 "Calibration Field for error code 230" CURVE 0x2045D4 ZF_tab_nx_ui16_S5_S3 65535 EH_STANDARD_S5_S3 0 65535
 /begin AXIS_DESCR FIX_AXIS NO_INPUT_QUANTITY EH_STANDARD_S5_S3 18 0 17 FIX_AXIS_PAR_DIST 0 1 18 /end AXIS_DESCR
/end CHARACTERISTIC
/begin CHARACTERISTIC D_DiErrorCode_231 "Calibration Field for error code 231" CURVE 0x2045F8 ZF_tab_nx_ui16_S5_S3 65535 EH_STANDARD_S5_S3 0 65535
 /begin AXIS_DESCR FIX_AXIS NO_INPUT_QUANTITY EH_STANDARD_S5_S3 18 0 17 FIX_AXIS_PAR_DIST 0 1 18 /end AXIS_DESCR
/end CHARACTERISTIC
/begin CHARACTERISTIC D_DiErrorCode_232 "Calibration Field for error code 232" CURVE 0x20461C ZF_tab_nx_ui16_S5_S3 65535 EH_STANDARD_S5_S3 0 65535
 /begin AXIS_DESCR FIX_AXIS NO_INPUT_QUANTITY EH_STANDARD_S5_S3 18 0 17 FIX_AXIS_PAR_DIST 0 1 18 /end AXIS_DESCR
/end CHARACTERISTIC
/begin CHARACTERISTIC D_DiErrorCode_233 "Calibration Field for error code 233" CURVE 0x204640 ZF_tab_nx_ui16_S5_S3 65535 EH_STANDARD_S5_S3 0 65535
 /begin AXIS_DESCR FIX_AXIS NO_INPUT_QUANTITY EH_STANDARD_S5_S3 18 0 17 FIX_AXIS_PAR_DIST 0 1 18 /end AXIS_DESCR
/end CHARACTERISTIC
/begin CHARACTERISTIC D_DiErrorCode_234 "Calibration Field for error code 234" CURVE 0x204664 ZF_tab_nx_ui16_S5_S3 65535 EH_STANDARD_S5_S3 0 65535
 /begin AXIS_DESCR FIX_AXIS NO_INPUT_QUANTITY EH_STANDARD_S5_S3 18 0 17 FIX_AXIS_PAR_DIST 0 1 18 /end AXIS_DESCR
/end CHARACTERISTIC
/begin CHARACTERISTIC D_DiErrorCode_235 "Calibration Field for error code 235" CURVE 0x204688 ZF_tab_nx_ui16_S5_S3 65535 EH_STANDARD_S5_S3 0 65535
 /begin AXIS_DESCR FIX_AXIS NO_INPUT_QUANTITY EH_STANDARD_S5_S3 18 0 17 FIX_AXIS_PAR_DIST 0 1 18 /end AXIS_DESCR
/end CHARACTERISTIC
/begin CHARACTERISTIC D_DiErrorCode_236 "Calibration Field for error code 236" CURVE 0x2046AC ZF_tab_nx_ui16_S5_S3 65535 EH_STANDARD_S5_S3 0 65535
 /begin AXIS_DESCR FIX_AXIS NO_INPUT_QUANTITY EH_STANDARD_S5_S3 18 0 17 FIX_AXIS_PAR_DIST 0 1 18 /end AXIS_DESCR
/end CHARACTERISTIC
/begin CHARACTERISTIC D_DiErrorCode_237 "Calibration Field for error code 237" CURVE 0x2046D0 ZF_tab_nx_ui16_S5_S3 65535 EH_STANDARD_S5_S3 0 65535
 /begin AXIS_DESCR FIX_AXIS NO_INPUT_QUANTITY EH_STANDARD_S5_S3 18 0 17 FIX_AXIS_PAR_DIST 0 1 18 /end AXIS_DESCR
/end CHARACTERISTIC
/begin CHARACTERISTIC D_DiErrorCode_238 "Calibration Field for error code 238" CURVE 0x2046F4 ZF_tab_nx_ui16_S5_S3 65535 EH_STANDARD_S5_S3 0 65535
 /begin AXIS_DESCR FIX_AXIS NO_INPUT_QUANTITY EH_STANDARD_S5_S3 18 0 17 FIX_AXIS_PAR_DIST 0 1 18 /end AXIS_DESCR
/end CHARACTERISTIC
/begin CHARACTERISTIC D_DiErrorCode_239 "Calibration Field for error code 239" CURVE 0x204718 ZF_tab_nx_ui16_S5_S3 65535 EH_STANDARD_S5_S3 0 65535
 /begin AXIS_DESCR FIX_AXIS NO_INPUT_QUANTITY EH_STANDARD_S5_S3 18 0 17 FIX_AXIS_PAR_DIST 0 1 18 /end AXIS_DESCR
/end CHARACTERISTIC
/begin CHARACTERISTIC D_DiErrorCode_240 "Calibration Field for error code 240" CURVE 0x20473C ZF_tab_nx_ui16_S5_S3 65535 EH_STANDARD_S5_S3 0 65535
 /begin AXIS_DESCR FIX_AXIS NO_INPUT_QUANTITY EH_STANDARD_S5_S3 18 0 17 FIX_AXIS_PAR_DIST 0 1 18 /end AXIS_DESCR
/end CHARACTERISTIC
/begin CHARACTERISTIC D_DiErrorCode_241 "Calibration Field for error code 241" CURVE 0x204760 ZF_tab_nx_ui16_S5_S3 65535 EH_STANDARD_S5_S3 0 65535
 /begin AXIS_DESCR FIX_AXIS NO_INPUT_QUANTITY EH_STANDARD_S5_S3 18 0 17 FIX_AXIS_PAR_DIST 0 1 18 /end AXIS_DESCR
/end CHARACTERISTIC
/begin CHARACTERISTIC D_DiErrorCode_242 "Calibration Field for error code 242" CURVE 0x204784 ZF_tab_nx_ui16_S5_S3 65535 EH_STANDARD_S5_S3 0 65535
 /begin AXIS_DESCR FIX_AXIS NO_INPUT_QUANTITY EH_STANDARD_S5_S3 18 0 17 FIX_AXIS_PAR_DIST 0 1 18 /end AXIS_DESCR
/end CHARACTERISTIC
/begin CHARACTERISTIC D_DiErrorCode_243 "Calibration Field for error code 243" CURVE 0x2047A8 ZF_tab_nx_ui16_S5_S3 65535 EH_STANDARD_S5_S3 0 65535
 /begin AXIS_DESCR FIX_AXIS NO_INPUT_QUANTITY EH_STANDARD_S5_S3 18 0 17 FIX_AXIS_PAR_DIST 0 1 18 /end AXIS_DESCR
/end CHARACTERISTIC
/begin CHARACTERISTIC D_DiErrorCode_244 "Calibration Field for error code 244" CURVE 0x2047CC ZF_tab_nx_ui16_S5_S3 65535 EH_STANDARD_S5_S3 0 65535
 /begin AXIS_DESCR FIX_AXIS NO_INPUT_QUANTITY EH_STANDARD_S5_S3 18 0 17 FIX_AXIS_PAR_DIST 0 1 18 /end AXIS_DESCR
/end CHARACTERISTIC
/begin CHARACTERISTIC D_DiErrorCode_245 "Calibration Field for error code 245" CURVE 0x2047F0 ZF_tab_nx_ui16_S5_S3 65535 EH_STANDARD_S5_S3 0 65535
 /begin AXIS_DESCR FIX_AXIS NO_INPUT_QUANTITY EH_STANDARD_S5_S3 18 0 17 FIX_AXIS_PAR_DIST 0 1 18 /end AXIS_DESCR
/end CHARACTERISTIC
/begin CHARACTERISTIC D_DiErrorCode_246 "Calibration Field for error code 246" CURVE 0x204814 ZF_tab_nx_ui16_S5_S3 65535 EH_STANDARD_S5_S3 0 65535
 /begin AXIS_DESCR FIX_AXIS NO_INPUT_QUANTITY EH_STANDARD_S5_S3 18 0 17 FIX_AXIS_PAR_DIST 0 1 18 /end AXIS_DESCR
/end CHARACTERISTIC
/begin CHARACTERISTIC D_DiErrorCode_247 "Calibration Field for error code 247" CURVE 0x204838 ZF_tab_nx_ui16_S5_S3 65535 EH_STANDARD_S5_S3 0 65535
 /begin AXIS_DESCR FIX_AXIS NO_INPUT_QUANTITY EH_STANDARD_S5_S3 18 0 17 FIX_AXIS_PAR_DIST 0 1 18 /end AXIS_DESCR
/end CHARACTERISTIC
/begin CHARACTERISTIC D_DiErrorCode_248 "Calibration Field for error code 248" CURVE 0x20485C ZF_tab_nx_ui16_S5_S3 65535 EH_STANDARD_S5_S3 0 65535
 /begin AXIS_DESCR FIX_AXIS NO_INPUT_QUANTITY EH_STANDARD_S5_S3 18 0 17 FIX_AXIS_PAR_DIST 0 1 18 /end AXIS_DESCR
/end CHARACTERISTIC
/begin CHARACTERISTIC D_DiErrorCode_249 "Calibration Field for error code 249" CURVE 0x204880 ZF_tab_nx_ui16_S5_S3 65535 EH_STANDARD_S5_S3 0 65535
 /begin AXIS_DESCR FIX_AXIS NO_INPUT_QUANTITY EH_STANDARD_S5_S3 18 0 17 FIX_AXIS_PAR_DIST 0 1 18 /end AXIS_DESCR
/end CHARACTERISTIC
/begin CHARACTERISTIC D_DiErrorCode_250 "Calibration Field for error code 250" CURVE 0x2048A4 ZF_tab_nx_ui16_S5_S3 65535 EH_STANDARD_S5_S3 0 65535
 /begin AXIS_DESCR FIX_AXIS NO_INPUT_QUANTITY EH_STANDARD_S5_S3 18 0 17 FIX_AXIS_PAR_DIST 0 1 18 /end AXIS_DESCR
/end CHARACTERISTIC
/begin CHARACTERISTIC D_DiErrorCode_251 "Calibration Field for error code 251" CURVE 0x2048C8 ZF_tab_nx_ui16_S5_S3 65535 EH_STANDARD_S5_S3 0 65535
 /begin AXIS_DESCR FIX_AXIS NO_INPUT_QUANTITY EH_STANDARD_S5_S3 18 0 17 FIX_AXIS_PAR_DIST 0 1 18 /end AXIS_DESCR
/end CHARACTERISTIC
/begin CHARACTERISTIC D_DiErrorCode_252 "Calibration Field for error code 252" CURVE 0x2048EC ZF_tab_nx_ui16_S5_S3 65535 EH_STANDARD_S5_S3 0 65535
 /begin AXIS_DESCR FIX_AXIS NO_INPUT_QUANTITY EH_STANDARD_S5_S3 18 0 17 FIX_AXIS_PAR_DIST 0 1 18 /end AXIS_DESCR
/end CHARACTERISTIC
/begin CHARACTERISTIC D_DiErrorCode_253 "Calibration Field for error code 253" CURVE 0x204910 ZF_tab_nx_ui16_S5_S3 65535 EH_STANDARD_S5_S3 0 65535
 /begin AXIS_DESCR FIX_AXIS NO_INPUT_QUANTITY EH_STANDARD_S5_S3 18 0 17 FIX_AXIS_PAR_DIST 0 1 18 /end AXIS_DESCR
/end CHARACTERISTIC
/begin CHARACTERISTIC D_DiErrorCode_254 "Calibration Field for error code 254" CURVE 0x204934 ZF_tab_nx_ui16_S5_S3 65535 EH_STANDARD_S5_S3 0 65535
 /begin AXIS_DESCR FIX_AXIS NO_INPUT_QUANTITY EH_STANDARD_S5_S3 18 0 17 FIX_AXIS_PAR_DIST 0 1 18 /end AXIS_DESCR
/end CHARACTERISTIC
/begin CHARACTERISTIC D_DiAmbCond "Ambient Condition Matrix" MAP 0x204958 ZF_tab2d_nx_ny_ui16_S5_S3 65535 EH_STANDARD_S5_S3 0 65535
 /begin AXIS_DESCR FIX_AXIS NO_INPUT_QUANTITY EH_STANDARD_S5_S3 25 0 24 FIX_AXIS_PAR_DIST 0 1 25 /end AXIS_DESCR
 /begin AXIS_DESCR FIX_AXIS NO_INPUT_QUANTITY EH_STANDARD_S5_S3 24 0 23 FIX_AXIS_PAR_DIST 0 1 24 /end AXIS_DESCR
/end CHARACTERISTIC
/begin CHARACTERISTIC D_DiErrorCodeConvTab "Calibration field between ZF error codes and customer error codes and pCodes" MAP 0x204E08 ZF_tab2d_nx_ny_ui16_S5_S3 65535 EH_STANDARD_S5_S3 0 65535
 /begin AXIS_DESCR FIX_AXIS NO_INPUT_QUANTITY EH_STANDARD_S5_S3 5 0 4 FIX_AXIS_PAR_DIST 0 1 5 /end AXIS_DESCR
 /begin AXIS_DESCR FIX_AXIS NO_INPUT_QUANTITY EH_STANDARD_S5_S3 500 1 500 FIX_AXIS_PAR_DIST 1 1 500 /end AXIS_DESCR
/end CHARACTERISTIC
/begin CHARACTERISTIC D_DiErrorInhibitionTab "ASIL: Calibration field for inhibiting errors dependent on other errors" MAP 0x206190 ZF_tab2d_nx_ny_ui16_S5_S3 65535 EH_STANDARD_S5_S3 0 65535
 /begin AXIS_DESCR FIX_AXIS NO_INPUT_QUANTITY EH_STANDARD_S5_S3 3 0 2 FIX_AXIS_PAR_DIST 0 1 3 /end AXIS_DESCR
 /begin AXIS_DESCR FIX_AXIS NO_INPUT_QUANTITY EH_STANDARD_S5_S3 260 1 260 FIX_AXIS_PAR_DIST 1 1 260 /end AXIS_DESCR
/end CHARACTERISTIC
/begin CHARACTERISTIC D_DiGroupTester1Switch "ASIL: switch to activate the GroupTesterOne operation mode (change from 0x00 to 0x5A for activation, others for deactivation)" VALUE 0x218032 ZF_kw_ui8_S5_S3 255 EH_STANDARD_S5_S3 0 255 /end CHARACTERISTIC
/begin CHARACTERISTIC D_DiGroupTester1ErrorCode "definition of GroupTesterOne error code" VALUE 0x2182BA ZF_kw_ui16_S5_S3 65535 EH_STANDARD_S5_S3 0 65535 /end CHARACTERISTIC
/begin CHARACTERISTIC D_DiGroupTester1ErrorType "definition of GroupTesterOne error type" VALUE 0x2182BC ZF_kw_ui16_S5_S3 65535 EH_STANDARD_S5_S3 0 65535 /end CHARACTERISTIC
/begin CHARACTERISTIC D_DiGroupTester1Status "definition of GroupTesterOne status" VALUE 0x218033 ZF_kw_ui8_S5_S3 255 EH_STANDARD_S5_S3 0 255 /end CHARACTERISTIC
/begin CHARACTERISTIC D_DiGroupTester1Counter "definition of GroupTesterOne frequency counter" VALUE 0x218034 ZF_kw_ui8_S5_S3 255 EH_STANDARD_S5_S3 0 255 /end CHARACTERISTIC
/begin CHARACTERISTIC D_DiGroupTester1Reaction "definition of GroupTesterOne error reaction state" VALUE 0x218035 ZF_kw_ui8_S5_S3 255 EH_STANDARD_S5_S3 0 255 /end CHARACTERISTIC
/begin CHARACTERISTIC SWI_DiObdWarmUpCycle "detection of WarmUp-cycles (0=internal, 1=external)" VALUE 0x218037 ZF_kw_ui8_S5_S3 1 EH_STANDARD_S5_S3 0 1 /end CHARACTERISTIC
/begin CHARACTERISTIC D_DiObdCWarmUpCycleTh "temperature threshold for warm-up cycle detection" VALUE 0x218038 ZF_kw_ui8_S5_S3 255 EH_C_1CEL_M40_S5_S3 -40 215 /end CHARACTERISTIC
/begin CHARACTERISTIC D_DiObdCWarmUpCycleDiff "difference temperature for warm-up cycle detection" VALUE 0x218039 ZF_kw_ui8_S5_S3 255 EH_C_1K_S5_S3 0 255 /end CHARACTERISTIC
/begin CHARACTERISTIC SWI_DiObdNormTripB "selection of norm trip B calculation (0=internal, 1=external)" VALUE 0x21803A ZF_kw_ui8_S5_S3 1 EH_STANDARD_S5_S3 0 1 /end CHARACTERISTIC
/begin CHARACTERISTIC SWI_DiObdPermanentFault_1 "switch for activating permanent fault code handling and Mode 0A for variant 1 (0=disabled, 1=enabled)" VALUE 0x21803B ZF_kw_ui8_S5_S3 1 EH_STANDARD_S5_S3 0 1 /end CHARACTERISTIC
/begin CHARACTERISTIC SWI_DiObdPermanentFault_0 "switch for activating permanent fault code handling and Mode 0A for variant 0 (0=disabled, 1=enabled)" VALUE 0x21803C ZF_kw_ui8_S5_S3 1 EH_STANDARD_S5_S3 0 1 /end CHARACTERISTIC
/begin CHARACTERISTIC SWI_DiObdPermanentModeA "displaying permanent fault codes in Mode 0A (0=immediately, 1=next ignition cycle)" VALUE 0x21803D ZF_kw_ui8_S5_S3 1 EH_STANDARD_S5_S3 0 1 /end CHARACTERISTIC
/begin CHARACTERISTIC SWI_DiObdDrivingCycle "detection of driving-cycles 0=internal (by calculation), 1=external (by 'driving cycle' signal via CAN)" VALUE 0x21803E ZF_kw_ui8_S5_S3 1 EH_STANDARD_S5_S3 0 1 /end CHARACTERISTIC
/begin CHARACTERISTIC D_DiObdNEngTh "engine speed threshold for engine start detection" VALUE 0x2182BE ZF_kw_ui16_S5_S3 4096 EH_N_RPM4_S5_S3 0 4096 /end CHARACTERISTIC
/begin CHARACTERISTIC D_DiObdTEngTh "time threshold for engine start detection" VALUE 0x2182C0 ZF_kw_ui16_S5_S3 65535 EH_T_1MS_S5_S3 0 65535 /end CHARACTERISTIC
/begin CHARACTERISTIC D_DiObdNrWarmUpCycles "number of necessary warmup-cycles for clearing obd-errors from error memory" VALUE 0x21803F ZF_kw_ui8_S5_S3 255 EH_STANDARD_S5_S3 0 255 /end CHARACTERISTIC
/begin CHARACTERISTIC D_DiObdAutoDeleteVariant "kind of error healing for non-OBD-errors: 0=power-up cycles (using the error code specific start value), 1=OBD warm-up cycles (see D_DiObdNrWarmUpCycles)" VALUE 0x218040 ZF_kw_ui8_S5_S3 1 EH_STANDARD_S5_S3 0 1 /end CHARACTERISTIC
/begin CHARACTERISTIC D_DiObdFFIntern "storage of OBD-FreezeFrames 0=external 1=internal in TCU" VALUE 0x218041 ZF_kw_ui8_S5_S3 1 EH_STANDARD_S5_S3 0 1 /end CHARACTERISTIC
/begin CHARACTERISTIC D_DiObdFFMoment "moment to store and delete OBD-FreezeFrame (1=confirmed and not confirmed, 2=pending and not pending not confirmed, 3=pending and displacement)" VALUE 0x218042 ZF_kw_ui8_S5_S3 2 EH_STANDARD_S5_S3 1 3 /end CHARACTERISTIC
/begin CHARACTERISTIC D_DiObdTab_0 "OBD calibration datafield for variant 0" MAP 0x20695C ZF_tab2d_nx_ny_ui8_S5_S3 255 EH_STANDARD_S5_S3 0 255
 /begin AXIS_DESCR FIX_AXIS NO_INPUT_QUANTITY EH_STANDARD_S5_S3 2 0 1 FIX_AXIS_PAR_DIST 0 1 2 /end AXIS_DESCR
 /begin AXIS_DESCR FIX_AXIS NO_INPUT_QUANTITY EH_STANDARD_S5_S3 254 1 254 FIX_AXIS_PAR_DIST 1 1 254 /end AXIS_DESCR
/end CHARACTERISTIC
/begin CHARACTERISTIC D_DiObdTab_1 "OBD calibration datafield for variant 1" MAP 0x206B58 ZF_tab2d_nx_ny_ui8_S5_S3 255 EH_STANDARD_S5_S3 0 255
 /begin AXIS_DESCR FIX_AXIS NO_INPUT_QUANTITY EH_STANDARD_S5_S3 2 0 1 FIX_AXIS_PAR_DIST 0 1 2 /end AXIS_DESCR
 /begin AXIS_DESCR FIX_AXIS NO_INPUT_QUANTITY EH_STANDARD_S5_S3 254 1 254 FIX_AXIS_PAR_DIST 1 1 254 /end AXIS_DESCR
/end CHARACTERISTIC
/begin CHARACTERISTIC D_DiObdIumprDenominatorTimeTh "time threshold for denominator incrementation" VALUE 0x218043 ZF_kw_ui8_S5_S3 255 EH_T_1S_S5_S3 0 255 /end CHARACTERISTIC
/begin CHARACTERISTIC D_DiObdIumprDenominatorCounterTh "counter threshold for denominator incrementation" VALUE 0x218044 ZF_kw_ui8_S5_S3 255 EH_STANDARD_S5_S3 0 255 /end CHARACTERISTIC
/begin CHARACTERISTIC SWI_DiObdIumprReset "reset the IUMPR data with every change between 0x55 and 0xAA" VALUE 0x218045 ZF_kw_ui8_S5_S3 255 EH_STANDARD_S5_S3 0 255 /end CHARACTERISTIC
/begin CHARACTERISTIC D_StringObdEcuName "OBD ECU-Name for Mode 09 Infotype 0x0A" CURVE 0x206D54 ZF_tab_ui8_S5_S3 255 EH_STANDARD_S5_S3 0 255
 /begin AXIS_DESCR FIX_AXIS NO_INPUT_QUANTITY EH_STANDARD_S5_S3 20 0 19 FIX_AXIS_PAR_DIST 0 1 20 /end AXIS_DESCR
/end CHARACTERISTIC
/begin CHARACTERISTIC SWI_DiObdCommunicationAfterIgnitionOff "switch for handling OBD-Communication after Ignition Off (1=ECU responds requests not depending on ignition state, 0=ECU responds requests only with ignition on)" VALUE 0x218046 ZF_kw_ui8_S5_S3 1 EH_STANDARD_S5_S3 0 1 /end CHARACTERISTIC
/begin CHARACTERISTIC D_EepromStoreImmediate_KFC "calibration field to select error codes that require immediate Eeprom storage" CURVE 0x2067A8 ZF_tab_ui16_S5_S3 65535 EH_STANDARD_S5_S3 0 65535
 /begin AXIS_DESCR FIX_AXIS NO_INPUT_QUANTITY EH_STANDARD_S5_S3 10 0 9 FIX_AXIS_PAR_DIST 0 1 10 /end AXIS_DESCR
/end CHARACTERISTIC
/begin CHARACTERISTIC D_DemFilteredMaxSearch "max. search count for Dem_GetNextFilteredDTC()" VALUE 0x2182AE ZF_kw_ui16_S5_S3 65534 EH_STANDARD_S5_S3 1 65535 /end CHARACTERISTIC
/begin CHARACTERISTIC SWI_DiObdResponseMode "response mode for mode 09 pid 06 data not available (0=response pending for timeout time, 1=send single NRC22 immediately)" VALUE 0x21802A ZF_kw_ui8_S5_S3 1 EH_STANDARD_S5_S3 0 1 /end CHARACTERISTIC
/begin CHARACTERISTIC SWI_DiErmDeactivate "switch for ERM functionality 0xA5=deactivated other=activated" VALUE 0x218036 ZF_kw_ui8_S5_S3 255 EH_STANDARD_S5_S3 0 255 /end CHARACTERISTIC
/begin CHARACTERISTIC D_DiErmMonitoring_KFC "calibration field to select ERM relevant error codes" CURVE 0x2067C0 ZF_tab_ui16_S5_S3 65535 EH_STANDARD_S5_S3 0 65535
 /begin AXIS_DESCR FIX_AXIS NO_INPUT_QUANTITY EH_STANDARD_S5_S3 40 0 39 FIX_AXIS_PAR_DIST 0 1 40 /end AXIS_DESCR
/end CHARACTERISTIC
/begin CHARACTERISTIC D_DiErmMonitoring_KMN "Calibration field to select monitoring of ERM relevant error reactions" MAP 0x206814 ZF_tab2d_ui32_S5_S3 4.29497E+009 EH_STANDARD_S5_S3 0 4294967295
 /begin AXIS_DESCR FIX_AXIS NO_INPUT_QUANTITY EH_STANDARD_S5_S3 40 0 39 FIX_AXIS_PAR_DIST 0 1 40 /end AXIS_DESCR
 /begin AXIS_DESCR FIX_AXIS NO_INPUT_QUANTITY EH_STANDARD_S5_S3 2 0 1 FIX_AXIS_PAR_DIST 0 1 2 /end AXIS_DESCR
/end CHARACTERISTIC
/begin MEASUREMENT di_obd_norm_trip_B "OBD norm trip B for erasing permanent faults (0=norm trip B does not exist 1=norm trip B exists)" UBYTE EH_STANDARD_S5_S3 1 100 0 255 ECU_ADDRESS 0xFFF8A310 /end MEASUREMENT
/begin MEASUREMENT di_obd_vehicleIdleTime "vehicle idle time for erasing permanent faults" UWORD EH_T_1S_S5_S3 1 100 0 65535 ECU_ADDRESS 0xFFF8A042 /end MEASUREMENT
/begin MEASUREMENT di_obd_vehicleOperationTime "vehicle operation time for erasing permanent faults" UWORD EH_T_1S_S5_S3 1 100 0 65535 ECU_ADDRESS 0xFFF8A03E /end MEASUREMENT
/begin MEASUREMENT ZFEH_Interfo.di_nr_of_entries "number of entries all errors" UBYTE EH_STANDARD_S5_S3 1 100 0 255 DISPLAY_IDENTIFIER di_nr_of_entries.ZFEH_Interfo ECU_ADDRESS 0xFFF8A04C /end MEASUREMENT
/begin MEASUREMENT ZFEH_Interfo.di_nr_of_active_entries "number of entries active errors" UBYTE EH_STANDARD_S5_S3 1 100 0 255 DISPLAY_IDENTIFIER di_nr_of_active_entries.ZFEH_Interfo ECU_ADDRESS 0xFFF8A04D /end MEASUREMENT
/begin MEASUREMENT ZFEH_Interfo.di_nr_of_inactive_entries "number of entries inactive errors" UBYTE EH_STANDARD_S5_S3 1 100 0 255 DISPLAY_IDENTIFIER di_nr_of_inactive_entries.ZFEH_Interfo ECU_ADDRESS 0xFFF8A04E /end MEASUREMENT
/begin MEASUREMENT ZFEH_Interfo.di_nr_of_shadow_entries "number of entries shadow errors" UBYTE EH_STANDARD_S5_S3 1 100 0 255 DISPLAY_IDENTIFIER di_nr_of_shadow_entries.ZFEH_Interfo ECU_ADDRESS 0xFFF8A04F /end MEASUREMENT
/begin MEASUREMENT ZFEH_Interfo.di_nr_of_nonshadow_entries "number of entries nonshadow errors" UBYTE EH_STANDARD_S5_S3 1 100 0 255 DISPLAY_IDENTIFIER di_nr_of_nonshadow_entries.ZFEH_Interfo ECU_ADDRESS 0xFFF8A050 /end MEASUREMENT
/begin MEASUREMENT ZFEH_Interfo.di_nr_of_obd_entries "number of entries obd errors" UBYTE EH_STANDARD_S5_S3 1 100 0 255 DISPLAY_IDENTIFIER di_nr_of_obd_entries.ZFEH_Interfo ECU_ADDRESS 0xFFF8A051 /end MEASUREMENT
/begin MEASUREMENT ZFEH_Interfi.iv_t_msCtr "input value millisecond counter" ULONG EH_T_1MS_S5_S3 1 100 0 4294967295 DISPLAY_IDENTIFIER iv_t_msCtr.ZFEH_Interfi ECU_ADDRESS 0xFFF8BB4C /end MEASUREMENT
/begin MEASUREMENT ZFEH_Interfi.iv_CodingMilCycles "input value for coded OBD variant 0=OBD-VAR0 1=OBD-VAR1" UBYTE EH_STANDARD_S5_S3 1 100 0 1 DISPLAY_IDENTIFIER iv_CodingMilCycles.ZFEH_Interfi ECU_ADDRESS 0xFFF8BB50 /end MEASUREMENT
/begin MEASUREMENT ZFEH_Interfi.iv_f_Ignition "ignition signal from SAB 0=ignition off 1=ignition on" UBYTE EH_STANDARD_S5_S3 1 100 0 1 DISPLAY_IDENTIFIER iv_f_Ignition.ZFEH_Interfi ECU_ADDRESS 0xFFF8BB51 /end MEASUREMENT
/begin MEASUREMENT ZFEH_Interfi.iv_u_BattFilt "filtered control module voltage" UWORD EH_U_1VOLT1000_S5_S3 1 100 0 65.535 DISPLAY_IDENTIFIER iv_u_BattFilt.ZFEH_Interfi ECU_ADDRESS 0xFFF8BB52 /end MEASUREMENT
/begin MEASUREMENT ZFEH_Interfi.iv_n_Eng "engine speed" UWORD EH_N_1RPM_S5_S3 1 100 0 65535 DISPLAY_IDENTIFIER iv_n_Eng.ZFEH_Interfi ECU_ADDRESS 0xFFF8BB54 /end MEASUREMENT
/begin MEASUREMENT ZFEH_Interfi.iv_n_AbFilt "n_Ab filtered speed" UWORD EH_N_1RPM_S5_S3 1 100 0 65535 DISPLAY_IDENTIFIER iv_n_AbFilt.ZFEH_Interfi ECU_ADDRESS 0xFFF8BB56 /end MEASUREMENT
/begin MEASUREMENT ZFEH_Interfi.iv_ThrottlePosition "throttle position" UBYTE EH_100PROZENT255_S5_S3 1 100 0 100 DISPLAY_IDENTIFIER iv_ThrottlePosition.ZFEH_Interfi ECU_ADDRESS 0xFFF8BB58 /end MEASUREMENT
/begin MEASUREMENT ZFEH_Interfi.arg_idx "0x00 means reference page and 0x01 means working page" UBYTE EH_STANDARD_S5_S3 1 100 0 1 DISPLAY_IDENTIFIER arg_idx.ZFEH_Interfi ECU_ADDRESS 0xFFF8BB59 /end MEASUREMENT
/begin MEASUREMENT ZFEH_Interfi.arg_idx_komp "0xFF means reference page and 0xFE means working page" UBYTE EH_STANDARD_S5_S3 1 100 254 255 DISPLAY_IDENTIFIER arg_idx_komp.ZFEH_Interfi ECU_ADDRESS 0xFFF8BB5A /end MEASUREMENT
/begin MEASUREMENT ZFEH_Diagnosis.disabled_errorgroups "statusinfo for locked error groups (bitcoded, 1 = group disabled)" UBYTE EH_STANDARD_S5_S3 1 100 0 255 DISPLAY_IDENTIFIER disabled_errorgroups.ZFEH_Diagnosis ECU_ADDRESS 0xFFF8BB6C /end MEASUREMENT
/begin MEASUREMENT ZFEH_Diagnosis.ctl_QuitSubstFunct "conditions for quitting subst functions fulfilled" UWORD EH_STANDARD_S5_S3 1 100 0 65535 DISPLAY_IDENTIFIER ctl_QuitSubstFunct.ZFEH_Diagnosis ECU_ADDRESS 0xFFF8BB8E /end MEASUREMENT
/begin MEASUREMENT ZFEH_Statemachine.st_errorhandler "state of the errorhandler 0=initialization 1=running(without ignition on) 2=running(with ignition on) 3=running(ignition change)" UBYTE EH_STANDARD_S5_S3 1 100 0 3 DISPLAY_IDENTIFIER st_errorhandler.ZFEH_Statemachine ECU_ADDRESS 0xFFF8A052 /end MEASUREMENT
/begin MEASUREMENT ZFEH_Statemachine.typeOfStartUp "type of ECU startup 0=SW reset 1=power up" UBYTE EH_STANDARD_S5_S3 1 100 0 1 DISPLAY_IDENTIFIER typeOfStartUp.ZFEH_Statemachine ECU_ADDRESS 0xFFF8A053 /end MEASUREMENT
/begin MEASUREMENT ZFEH_Eeprom.cnt_EEvalid "Counts the calls of the Macro _GET_ZFEH_EEPROM_VALID" UWORD EH_STANDARD_S5_S3 1 100 0 65535 DISPLAY_IDENTIFIER cnt_EEvalid.ZFEH_Eeprom ECU_ADDRESS 0xFFF8BB9E /end MEASUREMENT
/begin MEASUREMENT ZFEH_Eeprom.st_EEvalid "Return value of the Macro _GET_ZFEH_EEPROM_VALID (VALID=1, INVALID=0)" UWORD EH_STANDARD_S5_S3 1 100 0 65535 DISPLAY_IDENTIFIER st_EEvalid.ZFEH_Eeprom ECU_ADDRESS 0xFFF8BBA0 /end MEASUREMENT
/begin MEASUREMENT ZFEH_Eeprom.cnt_EEinit "Counts the calls of the Macro _SET_ZFEH_EEPROM_INIT_ZYKLISCH" UWORD EH_STANDARD_S5_S3 1 100 0 65535 DISPLAY_IDENTIFIER cnt_EEinit.ZFEH_Eeprom ECU_ADDRESS 0xFFF8BBA2 /end MEASUREMENT
/begin MEASUREMENT ZFEH_Eeprom.cnt_CheckEeData "Counts the calls of the function CheckEeData" UWORD EH_STANDARD_S5_S3 1 100 0 65535 DISPLAY_IDENTIFIER cnt_CheckEeData.ZFEH_Eeprom ECU_ADDRESS 0xFFF8BBA4 /end MEASUREMENT
/begin MEASUREMENT ZFEH_Eeprom.st_CheckEeData "last state of the function CheckEeData" UBYTE EH_STANDARD_S5_S3 1 100 0 255 DISPLAY_IDENTIFIER st_CheckEeData.ZFEH_Eeprom ECU_ADDRESS 0xFFF8BBA6 /end MEASUREMENT
/begin MEASUREMENT ZFEH_Eeprom.cnt_SetDefaultData "Counts the calls of the function SetDefaultData" UWORD EH_STANDARD_S5_S3 1 100 0 65535 DISPLAY_IDENTIFIER cnt_SetDefaultData.ZFEH_Eeprom ECU_ADDRESS 0xFFF8BBA8 /end MEASUREMENT
/begin MEASUREMENT ZFEH_Erm.st_limphome_check "to avoid failure depending on task sequence the first two detections of wrong behaviour of limphome reaction will be ignored" UWORD EH_STANDARD_S5_S3 1 100 0 65535 DISPLAY_IDENTIFIER st_limphome_check.ZFEH_Erm ECU_ADDRESS 0xFFF8BBB8 /end MEASUREMENT
/begin MEASUREMENT ZFEH_Erm.st_lh_complementcheck "used for complement check only" UWORD EH_STANDARD_S5_S3 1 100 0 65535 DISPLAY_IDENTIFIER st_lh_complementcheck.ZFEH_Erm ECU_ADDRESS 0xFFF8BBBA /end MEASUREMENT
/begin MEASUREMENT ZFEH_Erm.st_nopostrqreq_check "to avoid failure depending on task sequence the first two detections of wrong behaviour of no_positive_torquerequest reaction will be ignored" UWORD EH_STANDARD_S5_S3 1 100 0 65535 DISPLAY_IDENTIFIER st_nopostrqreq_check.ZFEH_Erm ECU_ADDRESS 0xFFF8BBBC /end MEASUREMENT
/begin MEASUREMENT ZFEH_Erm.st_position_check "to avoid failure depending on task sequence the first two detections of wrong behaviour of forced position neutral reaction will be ignored" UWORD EH_STANDARD_S5_S3 1 100 0 65535 DISPLAY_IDENTIFIER st_position_check.ZFEH_Erm ECU_ADDRESS 0xFFF8BBBE /end MEASUREMENT
/begin MEASUREMENT ZFEH_Erm.st_gearboxposition_check "to avoid failure depending on task sequence the first two detections of wrong behaviour of display off reaction will be ignored" UWORD EH_STANDARD_S5_S3 1 100 0 65535 DISPLAY_IDENTIFIER st_gearboxposition_check.ZFEH_Erm ECU_ADDRESS 0xFFF8BBC0 /end MEASUREMENT
/begin MEASUREMENT ZFEH_Erm.st_limphome_check_ "complementary value of st_limphome_check" UWORD EH_STANDARD_S5_S3 1 100 0 65535 DISPLAY_IDENTIFIER st_limphome_check_.ZFEH_Erm ECU_ADDRESS 0xFFF8BBC2 /end MEASUREMENT
/begin MEASUREMENT ZFEH_Erm.st_lh_complementcheck_ "complementary value of st_lh_complementcheck" UWORD EH_STANDARD_S5_S3 1 100 0 65535 DISPLAY_IDENTIFIER st_lh_complementcheck_.ZFEH_Erm ECU_ADDRESS 0xFFF8BBC4 /end MEASUREMENT
/begin MEASUREMENT ZFEH_Erm.st_nopostrqreq_check_ "complementary value of st_nopostrqreq_check" UWORD EH_STANDARD_S5_S3 1 100 0 65535 DISPLAY_IDENTIFIER st_nopostrqreq_check_.ZFEH_Erm ECU_ADDRESS 0xFFF8BBC6 /end MEASUREMENT
/begin MEASUREMENT ZFEH_Erm.st_nonegtrqreq_check "to avoid failure depending on task sequence the first two detections of wrong behaviour of no_negative_torquerequest reaction will be ignored" UWORD EH_STANDARD_S5_S3 1 100 0 65535 DISPLAY_IDENTIFIER st_nonegtrqreq_check.ZFEH_Erm ECU_ADDRESS 0xFFF8BBC8 /end MEASUREMENT
/begin MEASUREMENT ZFEH_Erm.st_nonegtrqreq_check_ "complementary value of st_nonegtrqreq_check" UWORD EH_STANDARD_S5_S3 1 100 0 65535 DISPLAY_IDENTIFIER st_nonegtrqreq_check_.ZFEH_Erm ECU_ADDRESS 0xFFF8BBCA /end MEASUREMENT
/begin MEASUREMENT ZFEH_Erm.st_position_check_ "complementary value of st_position_check" UWORD EH_STANDARD_S5_S3 1 100 0 65535 DISPLAY_IDENTIFIER st_position_check_.ZFEH_Erm ECU_ADDRESS 0xFFF8BBCC /end MEASUREMENT
/begin MEASUREMENT ZFEH_Erm.st_gearboxposition_check_ "complementary value of st_gearboxposition_check" UWORD EH_STANDARD_S5_S3 1 100 0 65535 DISPLAY_IDENTIFIER st_gearboxposition_check_.ZFEH_Erm ECU_ADDRESS 0xFFF8BBCE /end MEASUREMENT
/begin MEASUREMENT ZFEH_Erm.st_alivecounter[0] "state of alivecounter monitoring for alivecounter x (0=inactive 1=active)" UBYTE EH_STANDARD_S5_S3 1 100 0 1 DISPLAY_IDENTIFIER st_alivecounter[0].ZFEH_Erm ECU_ADDRESS 0xFFF8BBD0 /end MEASUREMENT
/begin MEASUREMENT ZFEH_Erm.st_alivecounter[1] "state of alivecounter monitoring for alivecounter x (0=inactive 1=active)" UBYTE EH_STANDARD_S5_S3 1 100 0 1 DISPLAY_IDENTIFIER st_alivecounter[1].ZFEH_Erm ECU_ADDRESS 0xFFF8BBD1 /end MEASUREMENT
/begin MEASUREMENT ZFEH_Erm.st_alivecounter[2] "state of alivecounter monitoring for alivecounter x (0=inactive 1=active)" UBYTE EH_STANDARD_S5_S3 1 100 0 1 DISPLAY_IDENTIFIER st_alivecounter[2].ZFEH_Erm ECU_ADDRESS 0xFFF8BBD2 /end MEASUREMENT
/begin MEASUREMENT ZFEH_Erm.st_alivecounter[3] "state of alivecounter monitoring for alivecounter x (0=inactive 1=active)" UBYTE EH_STANDARD_S5_S3 1 100 0 1 DISPLAY_IDENTIFIER st_alivecounter[3].ZFEH_Erm ECU_ADDRESS 0xFFF8BBD3 /end MEASUREMENT
/begin MEASUREMENT ZFEH_Erm.alivecounter_old[0] "last stored value of alivecounter x if monitoring for this alivecounter is active" UBYTE EH_STANDARD_S5_S3 1 100 0 255 DISPLAY_IDENTIFIER alivecounter_old[0].ZFEH_Erm ECU_ADDRESS 0xFFF8BBD4 /end MEASUREMENT
/begin MEASUREMENT ZFEH_Erm.alivecounter_old[1] "last stored value of alivecounter x if monitoring for this alivecounter is active" UBYTE EH_STANDARD_S5_S3 1 100 0 255 DISPLAY_IDENTIFIER alivecounter_old[1].ZFEH_Erm ECU_ADDRESS 0xFFF8BBD5 /end MEASUREMENT
/begin MEASUREMENT ZFEH_Erm.alivecounter_old[2] "last stored value of alivecounter x if monitoring for this alivecounter is active" UBYTE EH_STANDARD_S5_S3 1 100 0 255 DISPLAY_IDENTIFIER alivecounter_old[2].ZFEH_Erm ECU_ADDRESS 0xFFF8BBD6 /end MEASUREMENT
/begin MEASUREMENT ZFEH_Erm.alivecounter_old[3] "last stored value of alivecounter x if monitoring for this alivecounter is active" UBYTE EH_STANDARD_S5_S3 1 100 0 255 DISPLAY_IDENTIFIER alivecounter_old[3].ZFEH_Erm ECU_ADDRESS 0xFFF8BBD7 /end MEASUREMENT
/begin MEASUREMENT ZFEH_Erm.st_alivecounter_check[0] "state of alivecounter monitoring check for alivecounter x (0=init 1=monitoring_entered ac_value stored 2=monitoring_active ac_value stopped or changed 3=ac_value changed again - reset)" UBYTE EH_STANDARD_S5_S3 1 100 0 2 DISPLAY_IDENTIFIER st_alivecounter_check[0].ZFEH_Erm ECU_ADDRESS 0xFFF8BBD8 /end MEASUREMENT
/begin MEASUREMENT ZFEH_Erm.st_alivecounter_check[1] "state of alivecounter monitoring check for alivecounter x (0=init 1=monitoring_entered ac_value stored 2=monitoring_active ac_value stopped or changed 3=ac_value changed again - reset)" UBYTE EH_STANDARD_S5_S3 1 100 0 2 DISPLAY_IDENTIFIER st_alivecounter_check[1].ZFEH_Erm ECU_ADDRESS 0xFFF8BBD9 /end MEASUREMENT
/begin MEASUREMENT ZFEH_Erm.st_alivecounter_check[2] "state of alivecounter monitoring check for alivecounter x (0=init 1=monitoring_entered ac_value stored 2=monitoring_active ac_value stopped or changed 3=ac_value changed again - reset)" UBYTE EH_STANDARD_S5_S3 1 100 0 2 DISPLAY_IDENTIFIER st_alivecounter_check[2].ZFEH_Erm ECU_ADDRESS 0xFFF8BBDA /end MEASUREMENT
/begin MEASUREMENT ZFEH_Erm.st_alivecounter_check[3] "state of alivecounter monitoring check for alivecounter x (0=init 1=monitoring_entered ac_value stored 2=monitoring_active ac_value stopped or changed 3=ac_value changed again - reset)" UBYTE EH_STANDARD_S5_S3 1 100 0 2 DISPLAY_IDENTIFIER st_alivecounter_check[3].ZFEH_Erm ECU_ADDRESS 0xFFF8BBDB /end MEASUREMENT
/begin MEASUREMENT ZFEH_CarbHandler.st_f_ResponsePending "state of the OBD response handler 0=response sent without delay 1=response pending" UBYTE EH_STANDARD_S5_S3 1 100 0 1 DISPLAY_IDENTIFIER st_f_ResponsePending.ZFEH_CarbHandler ECU_ADDRESS 0xFFF8BBE8 /end MEASUREMENT
/begin MEASUREMENT ZFEH_CvnCalculation.Cvn "last calculated CVN" ULONG EH_STANDARD_S5_S3 1 100 0 4294967295 DISPLAY_IDENTIFIER Cvn.ZFEH_CvnCalculation ECU_ADDRESS 0xFFF8BC04 /end MEASUREMENT
/begin MEASUREMENT ZFEH_CvnCalculation.CrcCompLength "max. length of data block" ULONG EH_STANDARD_S5_S3 1 100 0 4294967295 DISPLAY_IDENTIFIER CrcCompLength.ZFEH_CvnCalculation ECU_ADDRESS 0xFFF8BC08 /end MEASUREMENT
/begin MEASUREMENT ZFEH_CvnCalculation.Length "Length data block to be computed" ULONG EH_STANDARD_S5_S3 1 100 0 4294967295 DISPLAY_IDENTIFIER Length.ZFEH_CvnCalculation ECU_ADDRESS 0xFFF8BC0C /end MEASUREMENT
/begin MEASUREMENT ZFEH_CvnCalculation.CompLength "already calculated length of CVN" ULONG EH_STANDARD_S5_S3 1 100 0 4294967295 DISPLAY_IDENTIFIER CompLength.ZFEH_CvnCalculation ECU_ADDRESS 0xFFF8BC10 /end MEASUREMENT
/begin MEASUREMENT ZFEH_CvnCalculation.Crc32 "CRC value of CRC calculation" ULONG EH_STANDARD_S5_S3 1 100 0 4294967295 DISPLAY_IDENTIFIER Crc32.ZFEH_CvnCalculation ECU_ADDRESS 0xFFF8BC14 /end MEASUREMENT
/begin MEASUREMENT ZFEH_CvnCalculation.CvnState "State of CVN State machine 0=Init 1=Start CVN1 calc 2=Continue CVN1 calc 3=Start CVN2 calc 4=Continue CVN2 calc 5=Calculation finished" UBYTE EH_STANDARD_S5_S3 1 100 0 255 DISPLAY_IDENTIFIER CvnState.ZFEH_CvnCalculation ECU_ADDRESS 0xFFF8BC18 /end MEASUREMENT
/begin MEASUREMENT ZFEH_Obd.di_obd_new_dc "in this ignition cycle a new driving cycle has begun" UBYTE EH_STANDARD_S5_S3 1 100 0 1 DISPLAY_IDENTIFIER di_obd_new_dc.ZFEH_Obd ECU_ADDRESS 0xFFF8BC20 /end MEASUREMENT
/begin MEASUREMENT ZFEH_Obd.iv_di_obd_ext_dc "input value for obd signal external driving cycle" UBYTE EH_STANDARD_S5_S3 1 100 0 255 DISPLAY_IDENTIFIER iv_di_obd_ext_dc.ZFEH_Obd ECU_ADDRESS 0xFFF8BC21 /end MEASUREMENT
/begin MEASUREMENT ZFEH_Obd.di_obd_ext_dc "driving cycle triggered from extern" UBYTE EH_STANDARD_S5_S3 1 100 0 1 DISPLAY_IDENTIFIER di_obd_ext_dc.ZFEH_Obd ECU_ADDRESS 0xFFF8BC22 /end MEASUREMENT
/begin MEASUREMENT ZFEH_Obd.di_obd_new_dc_next_ign_on "new driving cycle starting with ignition on" UBYTE EH_STANDARD_S5_S3 1 100 0 1 DISPLAY_IDENTIFIER di_obd_new_dc_next_ign_on.ZFEH_Obd ECU_ADDRESS 0xFFF8BC23 /end MEASUREMENT
/begin MEASUREMENT ZFEH_Obd.di_obd_new_wuc "in this ignition cycle a new warmup cycle has begun" UBYTE EH_STANDARD_S5_S3 1 100 0 1 DISPLAY_IDENTIFIER di_obd_new_wuc.ZFEH_Obd ECU_ADDRESS 0xFFF8BC24 /end MEASUREMENT
/begin MEASUREMENT ZFEH_Obd.iv_di_obd_ext_wuc "input value for obd signal external warmup cycle" UBYTE EH_STANDARD_S5_S3 1 100 0 255 DISPLAY_IDENTIFIER iv_di_obd_ext_wuc.ZFEH_Obd ECU_ADDRESS 0xFFF8BC25 /end MEASUREMENT
/begin MEASUREMENT ZFEH_Obd.di_obd_ext_wuc "warmup cycle triggered from extern" UBYTE EH_STANDARD_S5_S3 1 100 0 1 DISPLAY_IDENTIFIER di_obd_ext_wuc.ZFEH_Obd ECU_ADDRESS 0xFFF8BC26 /end MEASUREMENT
/begin MEASUREMENT ZFEH_Obd.di_obd_wuc_start_temp "engine coolant temperature at engine start (for WUC calculation)" UBYTE EH_C_1CEL_M40_S5_S3 1 100 -40 215 DISPLAY_IDENTIFIER di_obd_wuc_start_temp.ZFEH_Obd ECU_ADDRESS 0xFFF8BC27 /end MEASUREMENT
/begin MEASUREMENT ZFEH_Obd.iv_di_obd_calc_load "input value for obd signal calculated load (PID 04)" UBYTE EH_100PROZENT255_S5_S3 1 100 0 100 DISPLAY_IDENTIFIER iv_di_obd_calc_load.ZFEH_Obd ECU_ADDRESS 0xFFF8BC28 /end MEASUREMENT
/begin MEASUREMENT ZFEH_Obd.iv_di_obd_calc_load_status "status of input value for obd signal calculated load" UBYTE EH_STANDARD_S5_S3 1 100 0 255 DISPLAY_IDENTIFIER iv_di_obd_calc_load_status.ZFEH_Obd ECU_ADDRESS 0xFFF8BC29 /end MEASUREMENT
/begin MEASUREMENT ZFEH_Obd.di_obd_calc_load "obd signal calculated load (converted to PID 04 scaling)" UBYTE EH_100PROZENT255_S5_S3 1 100 0 100 DISPLAY_IDENTIFIER di_obd_calc_load.ZFEH_Obd ECU_ADDRESS 0xFFF8BC2A /end MEASUREMENT
/begin MEASUREMENT ZFEH_Obd.iv_di_obd_backup_calc_load "input value for obd backup signal calculated load (PID 04)" UBYTE EH_100PROZENT255_S5_S3 1 100 0 100 DISPLAY_IDENTIFIER iv_di_obd_backup_calc_load.ZFEH_Obd ECU_ADDRESS 0xFFF8BC2B /end MEASUREMENT
/begin MEASUREMENT ZFEH_Obd.iv_di_obd_backup_calc_load_status "status of input value for obd backup signal calculated load" UBYTE EH_STANDARD_S5_S3 1 100 0 255 DISPLAY_IDENTIFIER iv_di_obd_backup_calc_load_status.ZFEH_Obd ECU_ADDRESS 0xFFF8BC2C /end MEASUREMENT
/begin MEASUREMENT ZFEH_Obd.iv_di_obd_eng_cool_temp "input value for obd signal engine coolant temperature (PID 05)" UBYTE EH_C_1CEL_M48_S5_S3 1 100 -48 207 DISPLAY_IDENTIFIER iv_di_obd_eng_cool_temp.ZFEH_Obd ECU_ADDRESS 0xFFF8BC2D /end MEASUREMENT
/begin MEASUREMENT ZFEH_Obd.iv_di_obd_eng_cool_temp_status "status of input value for obd signal engine coolant temperature" UBYTE EH_STANDARD_S5_S3 1 100 0 255 DISPLAY_IDENTIFIER iv_di_obd_eng_cool_temp_status.ZFEH_Obd ECU_ADDRESS 0xFFF8BC2E /end MEASUREMENT
/begin MEASUREMENT ZFEH_Obd.di_obd_eng_cool_temp "obd signal engine coolant temperature (converted to PID 05 scaling)" UBYTE EH_C_1CEL_M40_S5_S3 1 100 -40 215 DISPLAY_IDENTIFIER di_obd_eng_cool_temp.ZFEH_Obd ECU_ADDRESS 0xFFF8BC2F /end MEASUREMENT
/begin MEASUREMENT ZFEH_Obd.iv_di_obd_eng_speed "input value for obd signal engine speed (PID 0C)" UWORD EH_N_RPM4_S5_S3 1 100 0 16383.75 DISPLAY_IDENTIFIER iv_di_obd_eng_speed.ZFEH_Obd ECU_ADDRESS 0xFFF8BC30 /end MEASUREMENT
/begin MEASUREMENT ZFEH_Obd.iv_di_obd_eng_speed_status "status of input value for obd signal engine speed" UBYTE EH_STANDARD_S5_S3 1 100 0 255 DISPLAY_IDENTIFIER iv_di_obd_eng_speed_status.ZFEH_Obd ECU_ADDRESS 0xFFF8BC32 /end MEASUREMENT
/begin MEASUREMENT ZFEH_Obd.di_obd_eng_speed "obd signal engine speed (converted to PID 0C scaling)" UWORD EH_N_RPM4_S5_S3 1 100 0 16383.5 DISPLAY_IDENTIFIER di_obd_eng_speed.ZFEH_Obd ECU_ADDRESS 0xFFF8BC34 /end MEASUREMENT
/begin MEASUREMENT ZFEH_Obd.iv_di_obd_vehicle_speed "input value for obd signal vehicle speed (PID 0D)" UWORD EH_V_KMH16_S5_S3 1 100 0 4095.9375 DISPLAY_IDENTIFIER iv_di_obd_vehicle_speed.ZFEH_Obd ECU_ADDRESS 0xFFF8BC36 /end MEASUREMENT
/begin MEASUREMENT ZFEH_Obd.iv_di_obd_vehicle_speed_status "status of input value for obd signal vehicle speed" UBYTE EH_STANDARD_S5_S3 1 100 0 255 DISPLAY_IDENTIFIER iv_di_obd_vehicle_speed_status.ZFEH_Obd ECU_ADDRESS 0xFFF8BC38 /end MEASUREMENT
/begin MEASUREMENT ZFEH_Obd.di_obd_vehicle_speed "obd signal vehicle speed (converted to PID 0D scaling)" UBYTE EH_V_KMH_S5_S3 1 100 0 255 DISPLAY_IDENTIFIER di_obd_vehicle_speed.ZFEH_Obd ECU_ADDRESS 0xFFF8BC39 /end MEASUREMENT
/begin MEASUREMENT ZFEH_Obd.iv_di_obd_abs_throttle_pos "input value for obd signal absolute throttle position (PID 11)" UBYTE EH_STANDARD_S5_S3 1 100 0 255 DISPLAY_IDENTIFIER iv_di_obd_abs_throttle_pos.ZFEH_Obd ECU_ADDRESS 0xFFF8BC3A /end MEASUREMENT
/begin MEASUREMENT ZFEH_Obd.iv_di_obd_abs_throttle_pos_status "status of input value for obd signal absolute throttle position" UBYTE EH_STANDARD_S5_S3 1 100 0 255 DISPLAY_IDENTIFIER iv_di_obd_abs_throttle_pos_status.ZFEH_Obd ECU_ADDRESS 0xFFF8BC3B /end MEASUREMENT
/begin MEASUREMENT ZFEH_Obd.di_obd_abs_throttle_pos "obd signal absolute throttle position (converted to PID 11 scaling)" UBYTE EH_100PROZENT255_S5_S3 1 100 0 100 DISPLAY_IDENTIFIER di_obd_abs_throttle_pos.ZFEH_Obd ECU_ADDRESS 0xFFF8BC3C /end MEASUREMENT
/begin MEASUREMENT ZFEH_Obd.iv_di_obd_backup_abs_throttle_pos "input value for obd backup signal absolute throttle position (PID 11)" UBYTE EH_STANDARD_S5_S3 1 100 0 255 DISPLAY_IDENTIFIER iv_di_obd_backup_abs_throttle_pos.ZFEH_Obd ECU_ADDRESS 0xFFF8BC3D /end MEASUREMENT
/begin MEASUREMENT ZFEH_Obd.iv_di_obd_backup_abs_throttle_pos_status "status of input value for obd backup signal absolute throttle position" UBYTE EH_STANDARD_S5_S3 1 100 0 255 DISPLAY_IDENTIFIER iv_di_obd_backup_abs_throttle_pos_status.ZFEH_Obd ECU_ADDRESS 0xFFF8BC3E /end MEASUREMENT
/begin MEASUREMENT ZFEH_Obd.di_obd_time_since_eng_start "obd signal time since engine start (converted to PID 1F scaling)" UWORD EH_T_1S_S5_S3 1 100 0 65535 DISPLAY_IDENTIFIER di_obd_time_since_eng_start.ZFEH_Obd ECU_ADDRESS 0xFFF8BC40 /end MEASUREMENT
/begin MEASUREMENT ZFEH_Obd.di_obd_dist_travel_MIL_active "obd signal distance travelled with MIL active (converted to PID 21 scaling)" UWORD EH_L_1KM_S5_S3 1 100 0 65535 DISPLAY_IDENTIFIER di_obd_dist_travel_MIL_active.ZFEH_Obd ECU_ADDRESS 0xFFF8BC42 /end MEASUREMENT
/begin MEASUREMENT ZFEH_Obd.di_obd_wuc_since_DTC_clr "obd signal number of warmup cycles since DTCs cleared (converted to PID 30 scaling)" UBYTE EH_STANDARD_S5_S3 1 100 0 255 DISPLAY_IDENTIFIER di_obd_wuc_since_DTC_clr.ZFEH_Obd ECU_ADDRESS 0xFFF8BC44 /end MEASUREMENT
/begin MEASUREMENT ZFEH_Obd.di_obd_dist_travel_since_DTC_clr "obd signal distance travelled since DTCs cleared (converted to PID 31 scaling)" UWORD EH_L_1KM_S5_S3 1 100 0 65535 DISPLAY_IDENTIFIER di_obd_dist_travel_since_DTC_clr.ZFEH_Obd ECU_ADDRESS 0xFFF8BC46 /end MEASUREMENT
/begin MEASUREMENT ZFEH_Obd.iv_di_obd_voltage "input value for obd signal battery voltage (PID 42)" UWORD EH_U_1VOLT1000_S5_S3 1 100 0 65.535 DISPLAY_IDENTIFIER iv_di_obd_voltage.ZFEH_Obd ECU_ADDRESS 0xFFF8BC48 /end MEASUREMENT
/begin MEASUREMENT ZFEH_Obd.di_obd_voltage "obd signal battery voltage (converted to PID 42 scaling)" UWORD EH_U_1VOLT1000_S5_S3 1 100 0 65.535 DISPLAY_IDENTIFIER di_obd_voltage.ZFEH_Obd ECU_ADDRESS 0xFFF8BC4A /end MEASUREMENT
/begin MEASUREMENT ZFEH_Obd.di_obd_time_eng_run_MIL_active "obd signal time run by the engine while MIL is activated (converted to PID 4D scaling)" UWORD EH_T_1MIN_S5_S3 1 100 0 65535 DISPLAY_IDENTIFIER di_obd_time_eng_run_MIL_active.ZFEH_Obd ECU_ADDRESS 0xFFF8BC4C /end MEASUREMENT
/begin MEASUREMENT ZFEH_Obd.di_obd_time_since_DTC_clr "obd signal time since DTCs cleared (converted to PID 4E scaling)" UWORD EH_T_1MIN_S5_S3 1 100 0 65535 DISPLAY_IDENTIFIER di_obd_time_since_DTC_clr.ZFEH_Obd ECU_ADDRESS 0xFFF8BC4E /end MEASUREMENT
/begin MEASUREMENT ZFEH_Obd.di_obd_ready_total "total obd readiness" UBYTE EH_STANDARD_S5_S3 1 100 0 1 DISPLAY_IDENTIFIER di_obd_ready_total.ZFEH_Obd ECU_ADDRESS 0xFFF8BC50 /end MEASUREMENT
/begin MEASUREMENT ZFEH_Obd.di_obd_ready_dc_specific_total "total driving cycle specific readiness" UBYTE EH_STANDARD_S5_S3 1 100 0 1 DISPLAY_IDENTIFIER di_obd_ready_dc_specific_total.ZFEH_Obd ECU_ADDRESS 0xFFF8BC51 /end MEASUREMENT
/begin MEASUREMENT ZFEH_Obd.iv_di_obd_pedalpos "input value for pedal position signal for internal norm trip B detection" UBYTE EH_100PROZENT255_S5_S3 1 100 0 100 DISPLAY_IDENTIFIER iv_di_obd_pedalpos.ZFEH_Obd ECU_ADDRESS 0xFFF8BC52 /end MEASUREMENT
/begin MEASUREMENT ZFEH_Obd.iv_di_obd_pedalpos_status "status of input value for input signal pedal position" UBYTE EH_STANDARD_S5_S3 1 100 0 255 DISPLAY_IDENTIFIER iv_di_obd_pedalpos_status.ZFEH_Obd ECU_ADDRESS 0xFFF8BC53 /end MEASUREMENT
/begin MEASUREMENT ZFEH_Obd.di_obd_pedalpos "signal for pedal position for internal norm trip B detection" UBYTE EH_100PROZENT255_S5_S3 1 100 0 100 DISPLAY_IDENTIFIER di_obd_pedalpos.ZFEH_Obd ECU_ADDRESS 0xFFF8BC54 /end MEASUREMENT
/begin MEASUREMENT ZFEH_Obd.di_obd_ff_available "obd freeze frame datas actually available (0=no freeze frame datas available, 1=freeze frame datas available)" UBYTE EH_STANDARD_S5_S3 1 100 0 255 DISPLAY_IDENTIFIER di_obd_ff_available.ZFEH_Obd ECU_ADDRESS 0xFFF8BC55 /end MEASUREMENT
/begin MEASUREMENT ZFEH_Obd.iv_di_obd_time_ms "time information used for the calculation of some obd signals (PID 1F, 4D and 4E)" ULONG EH_T_1MS_S5_S3 1 100 0 4294967295 DISPLAY_IDENTIFIER iv_di_obd_time_ms.ZFEH_Obd ECU_ADDRESS 0xFFF8BC58 /end MEASUREMENT
/begin MEASUREMENT ZFEH_Obd.iv_di_obd_distance "input value for distance information" ULONG EH_L_1KM_S5_S3 1 100 0 4294967295 DISPLAY_IDENTIFIER iv_di_obd_distance.ZFEH_Obd ECU_ADDRESS 0xFFF8BC5C /end MEASUREMENT
/begin MEASUREMENT ZFEH_Obd.di_obd_distance "distance information used for the calculation of some obd signals (PID 21 and 31)" ULONG EH_L_1KM_S5_S3 1 100 0 4294967295 DISPLAY_IDENTIFIER di_obd_distance.ZFEH_Obd ECU_ADDRESS 0xFFF8BC60 /end MEASUREMENT
/begin MEASUREMENT ZFEH_Obd.di_obd_mil_req "MIL request (0=MIL not requested, 1=MIL requested)" UBYTE EH_STANDARD_S5_S3 1 100 0 1 DISPLAY_IDENTIFIER di_obd_mil_req.ZFEH_Obd ECU_ADDRESS 0xFFF8BC64 /end MEASUREMENT
/begin MEASUREMENT ZFEH_Obd.di_obd_wuc_without_MIL "number of WarmUpCycles without MIL active" UBYTE EH_STANDARD_S5_S3 1 100 0 255 DISPLAY_IDENTIFIER di_obd_wuc_without_MIL.ZFEH_Obd ECU_ADDRESS 0xFFF8BC65 /end MEASUREMENT
/begin MEASUREMENT ZFEH_Obd.iv_di_obd_ext_normtrip_b "input value for external norm trip B signal" UBYTE EH_STANDARD_S5_S3 1 100 0 255 DISPLAY_IDENTIFIER iv_di_obd_ext_normtrip_b.ZFEH_Obd ECU_ADDRESS 0xFFF8BC66 /end MEASUREMENT
/begin MEASUREMENT ZFEH_EepromData.di_obd_iumpr_numerator[6] "error code related numerator [index = KFC-1]" UWORD EH_STANDARD_S5_S3 1 100 0 65535 DISPLAY_IDENTIFIER di_obd_iumpr_numerator[6].ZFEH_EepromData ECU_ADDRESS 0xFFF832BE /end MEASUREMENT
/begin MEASUREMENT ZFEH_EepromData.di_obd_iumpr_numerator[7] "error code related numerator [index = KFC-1]" UWORD EH_STANDARD_S5_S3 1 100 0 65535 DISPLAY_IDENTIFIER di_obd_iumpr_numerator[7].ZFEH_EepromData ECU_ADDRESS 0xFFF832C0 /end MEASUREMENT
/begin MEASUREMENT ZFEH_EepromData.di_obd_iumpr_numerator[8] "error code related numerator [index = KFC-1]" UWORD EH_STANDARD_S5_S3 1 100 0 65535 DISPLAY_IDENTIFIER di_obd_iumpr_numerator[8].ZFEH_EepromData ECU_ADDRESS 0xFFF832C2 /end MEASUREMENT
/begin MEASUREMENT ZFEH_EepromData.di_obd_iumpr_numerator[9] "error code related numerator [index = KFC-1]" UWORD EH_STANDARD_S5_S3 1 100 0 65535 DISPLAY_IDENTIFIER di_obd_iumpr_numerator[9].ZFEH_EepromData ECU_ADDRESS 0xFFF832C4 /end MEASUREMENT
/begin MEASUREMENT ZFEH_EepromData.di_obd_iumpr_numerator[69] "error code related numerator [index = KFC-1]" UWORD EH_STANDARD_S5_S3 1 100 0 65535 DISPLAY_IDENTIFIER di_obd_iumpr_numerator[69].ZFEH_EepromData ECU_ADDRESS 0xFFF8333C /end MEASUREMENT
/begin MEASUREMENT ZFEH_EepromData.di_obd_iumpr_numerator[70] "error code related numerator [index = KFC-1]" UWORD EH_STANDARD_S5_S3 1 100 0 65535 DISPLAY_IDENTIFIER di_obd_iumpr_numerator[70].ZFEH_EepromData ECU_ADDRESS 0xFFF8333E /end MEASUREMENT
/begin MEASUREMENT ZFEH_EepromData.di_obd_iumpr_numerator[71] "error code related numerator [index = KFC-1]" UWORD EH_STANDARD_S5_S3 1 100 0 65535 DISPLAY_IDENTIFIER di_obd_iumpr_numerator[71].ZFEH_EepromData ECU_ADDRESS 0xFFF83340 /end MEASUREMENT
/begin MEASUREMENT ZFEH_EepromData.di_obd_iumpr_numerator[72] "error code related numerator [index = KFC-1]" UWORD EH_STANDARD_S5_S3 1 100 0 65535 DISPLAY_IDENTIFIER di_obd_iumpr_numerator[72].ZFEH_EepromData ECU_ADDRESS 0xFFF83342 /end MEASUREMENT
/begin MEASUREMENT ZFEH_EepromData.di_obd_iumpr_numerator[73] "error code related numerator [index = KFC-1]" UWORD EH_STANDARD_S5_S3 1 100 0 65535 DISPLAY_IDENTIFIER di_obd_iumpr_numerator[73].ZFEH_EepromData ECU_ADDRESS 0xFFF83344 /end MEASUREMENT
/begin MEASUREMENT ZFEH_EepromData.di_obd_iumpr_numerator[74] "error code related numerator [index = KFC-1]" UWORD EH_STANDARD_S5_S3 1 100 0 65535 DISPLAY_IDENTIFIER di_obd_iumpr_numerator[74].ZFEH_EepromData ECU_ADDRESS 0xFFF83346 /end MEASUREMENT
/begin MEASUREMENT ZFEH_EepromData.di_obd_iumpr_numerator[75] "error code related numerator [index = KFC-1]" UWORD EH_STANDARD_S5_S3 1 100 0 65535 DISPLAY_IDENTIFIER di_obd_iumpr_numerator[75].ZFEH_EepromData ECU_ADDRESS 0xFFF83348 /end MEASUREMENT
/begin MEASUREMENT ZFEH_EepromData.di_obd_iumpr_numerator[76] "error code related numerator [index = KFC-1]" UWORD EH_STANDARD_S5_S3 1 100 0 65535 DISPLAY_IDENTIFIER di_obd_iumpr_numerator[76].ZFEH_EepromData ECU_ADDRESS 0xFFF8334A /end MEASUREMENT
/begin MEASUREMENT ZFEH_EepromData.di_obd_iumpr_numerator[77] "error code related numerator [index = KFC-1]" UWORD EH_STANDARD_S5_S3 1 100 0 65535 DISPLAY_IDENTIFIER di_obd_iumpr_numerator[77].ZFEH_EepromData ECU_ADDRESS 0xFFF8334C /end MEASUREMENT
/begin MEASUREMENT ZFEH_EepromData.di_obd_iumpr_numerator[78] "error code related numerator [index = KFC-1]" UWORD EH_STANDARD_S5_S3 1 100 0 65535 DISPLAY_IDENTIFIER di_obd_iumpr_numerator[78].ZFEH_EepromData ECU_ADDRESS 0xFFF8334E /end MEASUREMENT
/begin MEASUREMENT ZFEH_EepromData.di_obd_iumpr_numerator[79] "error code related numerator [index = KFC-1]" UWORD EH_STANDARD_S5_S3 1 100 0 65535 DISPLAY_IDENTIFIER di_obd_iumpr_numerator[79].ZFEH_EepromData ECU_ADDRESS 0xFFF83350 /end MEASUREMENT
/begin MEASUREMENT ZFEH_EepromData.di_obd_iumpr_numerator[80] "error code related numerator [index = KFC-1]" UWORD EH_STANDARD_S5_S3 1 100 0 65535 DISPLAY_IDENTIFIER di_obd_iumpr_numerator[80].ZFEH_EepromData ECU_ADDRESS 0xFFF83352 /end MEASUREMENT
/begin MEASUREMENT ZFEH_EepromData.di_obd_iumpr_numerator[81] "error code related numerator [index = KFC-1]" UWORD EH_STANDARD_S5_S3 1 100 0 65535 DISPLAY_IDENTIFIER di_obd_iumpr_numerator[81].ZFEH_EepromData ECU_ADDRESS 0xFFF83354 /end MEASUREMENT
/begin MEASUREMENT ZFEH_EepromData.di_obd_iumpr_numerator[82] "error code related numerator [index = KFC-1]" UWORD EH_STANDARD_S5_S3 1 100 0 65535 DISPLAY_IDENTIFIER di_obd_iumpr_numerator[82].ZFEH_EepromData ECU_ADDRESS 0xFFF83356 /end MEASUREMENT
/begin MEASUREMENT ZFEH_EepromData.di_obd_iumpr_numerator[83] "error code related numerator [index = KFC-1]" UWORD EH_STANDARD_S5_S3 1 100 0 65535 DISPLAY_IDENTIFIER di_obd_iumpr_numerator[83].ZFEH_EepromData ECU_ADDRESS 0xFFF83358 /end MEASUREMENT
/begin MEASUREMENT ZFEH_EepromData.di_obd_iumpr_numerator[84] "error code related numerator [index = KFC-1]" UWORD EH_STANDARD_S5_S3 1 100 0 65535 DISPLAY_IDENTIFIER di_obd_iumpr_numerator[84].ZFEH_EepromData ECU_ADDRESS 0xFFF8335A /end MEASUREMENT
/begin MEASUREMENT ZFEH_EepromData.di_obd_iumpr_numerator[85] "error code related numerator [index = KFC-1]" UWORD EH_STANDARD_S5_S3 1 100 0 65535 DISPLAY_IDENTIFIER di_obd_iumpr_numerator[85].ZFEH_EepromData ECU_ADDRESS 0xFFF8335C /end MEASUREMENT
/begin MEASUREMENT ZFEH_EepromData.di_obd_iumpr_numerator[86] "error code related numerator [index = KFC-1]" UWORD EH_STANDARD_S5_S3 1 100 0 65535 DISPLAY_IDENTIFIER di_obd_iumpr_numerator[86].ZFEH_EepromData ECU_ADDRESS 0xFFF8335E /end MEASUREMENT
/begin MEASUREMENT ZFEH_EepromData.di_obd_iumpr_numerator[87] "error code related numerator [index = KFC-1]" UWORD EH_STANDARD_S5_S3 1 100 0 65535 DISPLAY_IDENTIFIER di_obd_iumpr_numerator[87].ZFEH_EepromData ECU_ADDRESS 0xFFF83360 /end MEASUREMENT
/begin MEASUREMENT ZFEH_EepromData.di_obd_iumpr_numerator[88] "error code related numerator [index = KFC-1]" UWORD EH_STANDARD_S5_S3 1 100 0 65535 DISPLAY_IDENTIFIER di_obd_iumpr_numerator[88].ZFEH_EepromData ECU_ADDRESS 0xFFF83362 /end MEASUREMENT
/begin MEASUREMENT ZFEH_EepromData.di_obd_iumpr_numerator[89] "error code related numerator [index = KFC-1]" UWORD EH_STANDARD_S5_S3 1 100 0 65535 DISPLAY_IDENTIFIER di_obd_iumpr_numerator[89].ZFEH_EepromData ECU_ADDRESS 0xFFF83364 /end MEASUREMENT
/begin MEASUREMENT ZFEH_EepromData.di_obd_iumpr_numerator[90] "error code related numerator [index = KFC-1]" UWORD EH_STANDARD_S5_S3 1 100 0 65535 DISPLAY_IDENTIFIER di_obd_iumpr_numerator[90].ZFEH_EepromData ECU_ADDRESS 0xFFF83366 /end MEASUREMENT
/begin MEASUREMENT ZFEH_EepromData.di_obd_iumpr_numerator[91] "error code related numerator [index = KFC-1]" UWORD EH_STANDARD_S5_S3 1 100 0 65535 DISPLAY_IDENTIFIER di_obd_iumpr_numerator[91].ZFEH_EepromData ECU_ADDRESS 0xFFF83368 /end MEASUREMENT
/begin MEASUREMENT ZFEH_EepromData.di_obd_iumpr_numerator[92] "error code related numerator [index = KFC-1]" UWORD EH_STANDARD_S5_S3 1 100 0 65535 DISPLAY_IDENTIFIER di_obd_iumpr_numerator[92].ZFEH_EepromData ECU_ADDRESS 0xFFF8336A /end MEASUREMENT
/begin MEASUREMENT ZFEH_EepromData.di_obd_iumpr_numerator[93] "error code related numerator [index = KFC-1]" UWORD EH_STANDARD_S5_S3 1 100 0 65535 DISPLAY_IDENTIFIER di_obd_iumpr_numerator[93].ZFEH_EepromData ECU_ADDRESS 0xFFF8336C /end MEASUREMENT
/begin MEASUREMENT ZFEH_EepromData.di_obd_iumpr_numerator[94] "error code related numerator [index = KFC-1]" UWORD EH_STANDARD_S5_S3 1 100 0 65535 DISPLAY_IDENTIFIER di_obd_iumpr_numerator[94].ZFEH_EepromData ECU_ADDRESS 0xFFF8336E /end MEASUREMENT
/begin MEASUREMENT ZFEH_EepromData.di_obd_iumpr_numerator[95] "error code related numerator [index = KFC-1]" UWORD EH_STANDARD_S5_S3 1 100 0 65535 DISPLAY_IDENTIFIER di_obd_iumpr_numerator[95].ZFEH_EepromData ECU_ADDRESS 0xFFF83370 /end MEASUREMENT
/begin MEASUREMENT ZFEH_EepromData.di_obd_iumpr_numerator[96] "error code related numerator [index = KFC-1]" UWORD EH_STANDARD_S5_S3 1 100 0 65535 DISPLAY_IDENTIFIER di_obd_iumpr_numerator[96].ZFEH_EepromData ECU_ADDRESS 0xFFF83372 /end MEASUREMENT
/begin MEASUREMENT ZFEH_EepromData.di_obd_iumpr_numerator[97] "error code related numerator [index = KFC-1]" UWORD EH_STANDARD_S5_S3 1 100 0 65535 DISPLAY_IDENTIFIER di_obd_iumpr_numerator[97].ZFEH_EepromData ECU_ADDRESS 0xFFF83374 /end MEASUREMENT
/begin MEASUREMENT ZFEH_EepromData.di_obd_iumpr_numerator[98] "error code related numerator [index = KFC-1]" UWORD EH_STANDARD_S5_S3 1 100 0 65535 DISPLAY_IDENTIFIER di_obd_iumpr_numerator[98].ZFEH_EepromData ECU_ADDRESS 0xFFF83376 /end MEASUREMENT
/begin MEASUREMENT ZFEH_EepromData.di_obd_iumpr_numerator[99] "error code related numerator [index = KFC-1]" UWORD EH_STANDARD_S5_S3 1 100 0 65535 DISPLAY_IDENTIFIER di_obd_iumpr_numerator[99].ZFEH_EepromData ECU_ADDRESS 0xFFF83378 /end MEASUREMENT
/begin MEASUREMENT iPakSchnittstelle.pak_aktiv "Anzeige einer PAK relevanten TASK" UBYTE Conv.cPakSchnittstelle._.pak_aktiv_S6_S3 1 100 0 1 BIT_MASK 0x1 DISPLAY_IDENTIFIER pak_aktiv.iPakSchnittstelle ECU_ADDRESS 0xFFF8A353 /end MEASUREMENT
/begin MEASUREMENT iBihZfinf.timer32_betrieb "-" ULONG UMR___1_1_0_S6_S3 1 100 0 4294967295 DISPLAY_IDENTIFIER timer32_betrieb.iBihZfinf ECU_ADDRESS 0xFFF8C28C /end MEASUREMENT
/begin COMPU_METHOD SBW_WL_M_S1_S3 "int = ((phys * 160) / 7) - (0) Grad" RAT_FUNC "%5.3" "Grad" COEFFS 0 160 -0 0 0 7 /end COMPU_METHOD
/begin COMPU_METHOD SBW_VWL_20_S1_S3 "int = ((phys * 20) / 1) - (0) Grad/s" RAT_FUNC "%4.2" "Grad/s" COEFFS 0 20 -0 0 0 1 /end COMPU_METHOD
/begin COMPU_METHOD SBW_VWL_M_S1_S3 "int = ((phys * 1) / 1) - (0) Grad/s" RAT_FUNC "%2.0" "Grad/s" COEFFS 0 1 -0 0 0 1 /end COMPU_METHOD
/begin COMPU_METHOD EH_STANDARD_S5_S3 "int = ((phys * 1) / 1) - (0) -" RAT_FUNC "%2.0" "-" COEFFS 0 1 -0 0 0 1 /end COMPU_METHOD
/begin COMPU_METHOD EH_C_1CEL_M40_S5_S3 "int = ((phys * 1) / 1) - (-40) Grad Celsius" RAT_FUNC "%2.0" "Grad Celsius" COEFFS 0 1 40 0 0 1 /end COMPU_METHOD
/begin COMPU_METHOD EH_C_1CEL_M48_S5_S3 "int = ((phys * 1) / 1) - (-48) Grad Celsius" RAT_FUNC "%2.0" "Grad Celsius" COEFFS 0 1 48 0 0 1 /end COMPU_METHOD
/begin COMPU_METHOD EH_C_1K_S5_S3 "int = ((phys * 1) / 1) - (0) Kelvin" RAT_FUNC "%2.0" "Kelvin" COEFFS 0 1 -0 0 0 1 /end COMPU_METHOD
/begin COMPU_METHOD EH_N_1RPM_S5_S3 "int = ((phys * 1) / 1) - (0) 1/min" RAT_FUNC "%2.0" "1/min" COEFFS 0 1 -0 0 0 1 /end COMPU_METHOD
/begin COMPU_METHOD EH_N_RPM4_S5_S3 "int = ((phys * 4) / 1) - (0) 1/min" RAT_FUNC "%4.2" "1/min" COEFFS 0 4 -0 0 0 1 /end COMPU_METHOD
/begin COMPU_METHOD EH_V_KMH_S5_S3 "int = ((phys * 1) / 1) - (0) km/h" RAT_FUNC "%2.0" "km/h" COEFFS 0 1 -0 0 0 1 /end COMPU_METHOD
/begin COMPU_METHOD EH_V_KMH16_S5_S3 "int = ((phys * 16) / 1) - (0) km/h" RAT_FUNC "%6.4" "km/h" COEFFS 0 16 -0 0 0 1 /end COMPU_METHOD
/begin COMPU_METHOD EH_T_1MS_S5_S3 "int = ((phys * 1) / 1) - (0) ms" RAT_FUNC "%2.0" "ms" COEFFS 0 1 -0 0 0 1 /end COMPU_METHOD
/begin COMPU_METHOD EH_T_1S_S5_S3 "int = ((phys * 1) / 1) - (0) s" RAT_FUNC "%2.0" "s" COEFFS 0 1 -0 0 0 1 /end COMPU_METHOD
/begin COMPU_METHOD EH_T_1MIN_S5_S3 "int = ((phys * 1) / 1) - (0) min" RAT_FUNC "%2.0" "min" COEFFS 0 1 -0 0 0 1 /end COMPU_METHOD
/begin COMPU_METHOD EH_U_1VOLT1000_S5_S3 "int = ((phys * 1000) / 1) - (0) V" RAT_FUNC "%5.3" "V" COEFFS 0 1000 -0 0 0 1 /end COMPU_METHOD
/begin COMPU_METHOD EH_L_1KM_S5_S3 "int = ((phys * 1) / 1) - (0) km" RAT_FUNC "%2.0" "km" COEFFS 0 1 -0 0 0 1 /end COMPU_METHOD
/begin COMPU_METHOD EH_100PROZENT255_S5_S3 "int = ((phys * 255) / 100) - (0) %" RAT_FUNC "%6.4" "%" COEFFS 0 255 -0 0 0 100 /end COMPU_METHOD
/begin COMPU_METHOD UMR___1_1_0_S6_S3 "int = ((phys * 1) / 1) - (0) [-]" RAT_FUNC "%2.0" "[-]" COEFFS 0 1 -0 0 0 1 /end COMPU_METHOD
/begin COMPU_METHOD Conv.cPakSchnittstelle._.pak_aktiv_S6_S3 "Umrechnung fuer Messgroesse cPakSchnittstelle::pak_aktiv" TAB_VERB "%4.0" "" COMPU_TAB_REF Conv.cPakSchnittstelle._.pak_aktiv_S6_S3 /end COMPU_METHOD
/begin COMPU_VTAB Conv.cPakSchnittstelle._.pak_aktiv_S6_S3 "Umrechnung fuer Messgroesse cPakSchnittstelle::pak_aktiv" TAB_VERB 2 0 "Task enthaelt keine PAK" 1 "Task benoetigt PAK" /end COMPU_VTAB
/begin FUNCTION zff_EH_Obd "desc_en"
 /begin LOC_MEASUREMENT ZFEH_EepromData.di_obd_iumpr_numerator[69] ZFEH_EepromData.di_obd_iumpr_numerator[6] ZFEH_EepromData.di_obd_iumpr_numerator[70] ZFEH_EepromData.di_obd_iumpr_numerator[71] ZFEH_EepromData.di_obd_iumpr_numerator[72] ZFEH_EepromData.di_obd_iumpr_numerator[73] ZFEH_EepromData.di_obd_iumpr_numerator[74] ZFEH_EepromData.di_obd_iumpr_numerator[75] ZFEH_EepromData.di_obd_iumpr_numerator[76] ZFEH_EepromData.di_obd_iumpr_numerator[77] ZFEH_EepromData.di_obd_iumpr_numerator[78] ZFEH_EepromData.di_obd_iumpr_numerator[79] ZFEH_EepromData.di_obd_iumpr_numerator[7] ZFEH_EepromData.di_obd_iumpr_numerator[80] ZFEH_EepromData.di_obd_iumpr_numerator[81] ZFEH_EepromData.di_obd_iumpr_numerator[82] ZFEH_EepromData.di_obd_iumpr_numerator[83] ZFEH_EepromData.di_obd_iumpr_numerator[84] ZFEH_EepromData.di_obd_iumpr_numerator[85] ZFEH_EepromData.di_obd_iumpr_numerator[86] ZFEH_EepromData.di_obd_iumpr_numerator[87] ZFEH_EepromData.di_obd_iumpr_numerator[88] ZFEH_EepromData.di_obd_iumpr_numerator[89] ZFEH_EepromData.di_obd_iumpr_numerator[8] ZFEH_EepromData.di_obd_iumpr_numerator[90] ZFEH_EepromData.di_obd_iumpr_numerator[91] ZFEH_EepromData.di_obd_iumpr_numerator[92] ZFEH_EepromData.di_obd_iumpr_numerator[93] ZFEH_EepromData.di_obd_iumpr_numerator[94] ZFEH_EepromData.di_obd_iumpr_numerator[95] ZFEH_EepromData.di_obd_iumpr_numerator[96] ZFEH_EepromData.di_obd_iumpr_numerator[97] ZFEH_EepromData.di_obd_iumpr_numerator[98] ZFEH_EepromData.di_obd_iumpr_numerator[99] ZFEH_EepromData.di_obd_iumpr_numerator[9] ZFEH_Obd.di_obd_abs_throttle_pos ZFEH_Obd.di_obd_calc_load ZFEH_Obd.di_obd_dist_travel_MIL_active ZFEH_Obd.di_obd_dist_travel_since_DTC_clr ZFEH_Obd.di_obd_distance ZFEH_Obd.di_obd_eng_cool_temp ZFEH_Obd.di_obd_eng_speed ZFEH_Obd.di_obd_ext_dc ZFEH_Obd.di_obd_ext_wuc ZFEH_Obd.di_obd_ff_available ZFEH_Obd.di_obd_mil_req ZFEH_Obd.di_obd_new_dc ZFEH_Obd.di_obd_new_dc_next_ign_on ZFEH_Obd.di_obd_new_wuc ZFEH_Obd.di_obd_pedalpos ZFEH_Obd.di_obd_ready_dc_specific_total ZFEH_Obd.di_obd_ready_total ZFEH_Obd.di_obd_time_eng_run_MIL_active ZFEH_Obd.di_obd_time_since_DTC_clr ZFEH_Obd.di_obd_time_since_eng_start ZFEH_Obd.di_obd_vehicle_speed ZFEH_Obd.di_obd_voltage ZFEH_Obd.di_obd_wuc_since_DTC_clr ZFEH_Obd.di_obd_wuc_start_temp ZFEH_Obd.di_obd_wuc_without_MIL ZFEH_Obd.iv_di_obd_abs_throttle_pos ZFEH_Obd.iv_di_obd_abs_throttle_pos_status ZFEH_Obd.iv_di_obd_backup_abs_throttle_pos ZFEH_Obd.iv_di_obd_backup_abs_throttle_pos_status ZFEH_Obd.iv_di_obd_backup_calc_load ZFEH_Obd.iv_di_obd_backup_calc_load_status ZFEH_Obd.iv_di_obd_calc_load ZFEH_Obd.iv_di_obd_calc_load_status ZFEH_Obd.iv_di_obd_distance ZFEH_Obd.iv_di_obd_eng_cool_temp ZFEH_Obd.iv_di_obd_eng_cool_temp_status ZFEH_Obd.iv_di_obd_eng_speed ZFEH_Obd.iv_di_obd_eng_speed_status ZFEH_Obd.iv_di_obd_ext_dc ZFEH_Obd.iv_di_obd_ext_normtrip_b ZFEH_Obd.iv_di_obd_ext_wuc ZFEH_Obd.iv_di_obd_pedalpos ZFEH_Obd.iv_di_obd_pedalpos_status ZFEH_Obd.iv_di_obd_time_ms ZFEH_Obd.iv_di_obd_vehicle_speed ZFEH_Obd.iv_di_obd_vehicle_speed_status ZFEH_Obd.iv_di_obd_voltage di_obd_norm_trip_B di_obd_vehicleIdleTime di_obd_vehicleOperationTime /end LOC_MEASUREMENT
/end FUNCTION
/begin FUNCTION zff_EH_Interfo "desc_en"
 /begin LOC_MEASUREMENT ZFEH_Interfo.di_nr_of_active_entries ZFEH_Interfo.di_nr_of_entries ZFEH_Interfo.di_nr_of_inactive_entries ZFEH_Interfo.di_nr_of_nonshadow_entries ZFEH_Interfo.di_nr_of_obd_entries ZFEH_Interfo.di_nr_of_shadow_entries /end LOC_MEASUREMENT
/end FUNCTION
/begin FUNCTION zff_EH_Interfi "desc_en"
 /begin LOC_MEASUREMENT ZFEH_Interfi.arg_idx ZFEH_Interfi.arg_idx_komp ZFEH_Interfi.iv_CodingMilCycles ZFEH_Interfi.iv_ThrottlePosition ZFEH_Interfi.iv_f_Ignition ZFEH_Interfi.iv_n_AbFilt ZFEH_Interfi.iv_n_Eng ZFEH_Interfi.iv_t_msCtr ZFEH_Interfi.iv_u_BattFilt /end LOC_MEASUREMENT
/end FUNCTION
/begin FUNCTION zff_EH_CommonInformation "desc_en"
 /begin LOC_MEASUREMENT ZFEH_Diagnosis.ctl_QuitSubstFunct ZFEH_Diagnosis.disabled_errorgroups /end LOC_MEASUREMENT
/end FUNCTION
/begin FUNCTION zff_EH_Statemachine "desc_en"
 /begin LOC_MEASUREMENT ZFEH_Statemachine.st_errorhandler ZFEH_Statemachine.typeOfStartUp /end LOC_MEASUREMENT
/end FUNCTION
/begin FUNCTION zff_EH_Eeprom "desc_en"
 /begin LOC_MEASUREMENT ZFEH_Eeprom.cnt_CheckEeData ZFEH_Eeprom.cnt_EEinit ZFEH_Eeprom.cnt_EEvalid ZFEH_Eeprom.cnt_SetDefaultData ZFEH_Eeprom.st_CheckEeData ZFEH_Eeprom.st_EEvalid /end LOC_MEASUREMENT
/end FUNCTION
/begin FUNCTION zff_EH_Erm "desc_en"
 /begin LOC_MEASUREMENT ZFEH_Erm.alivecounter_old[0] ZFEH_Erm.alivecounter_old[1] ZFEH_Erm.alivecounter_old[2] ZFEH_Erm.alivecounter_old[3] ZFEH_Erm.st_alivecounter[0] ZFEH_Erm.st_alivecounter[1] ZFEH_Erm.st_alivecounter[2] ZFEH_Erm.st_alivecounter[3] ZFEH_Erm.st_alivecounter_check[0] ZFEH_Erm.st_alivecounter_check[1] ZFEH_Erm.st_alivecounter_check[2] ZFEH_Erm.st_alivecounter_check[3] ZFEH_Erm.st_gearboxposition_check ZFEH_Erm.st_gearboxposition_check_ ZFEH_Erm.st_lh_complementcheck ZFEH_Erm.st_lh_complementcheck_ ZFEH_Erm.st_limphome_check ZFEH_Erm.st_limphome_check_ ZFEH_Erm.st_nonegtrqreq_check ZFEH_Erm.st_nonegtrqreq_check_ ZFEH_Erm.st_nopostrqreq_check ZFEH_Erm.st_nopostrqreq_check_ ZFEH_Erm.st_position_check ZFEH_Erm.st_position_check_ /end LOC_MEASUREMENT
/end FUNCTION
/begin FUNCTION zff_EH_CarbHandler "desc_en" /begin LOC_MEASUREMENT ZFEH_CarbHandler.st_f_ResponsePending /end LOC_MEASUREMENT /end FUNCTION
/begin FUNCTION zff_EH_CvnCalculation "desc_en"
 /begin LOC_MEASUREMENT ZFEH_CvnCalculation.CompLength ZFEH_CvnCalculation.Crc32 ZFEH_CvnCalculation.CrcCompLength ZFEH_CvnCalculation.Cvn ZFEH_CvnCalculation.CvnState ZFEH_CvnCalculation.Length /end LOC_MEASUREMENT
/end FUNCTION
/begin FUNCTION zff_EH_Applikationsgroessen "all calibration values of Errorhandler"
 /begin SUB_FUNCTION dData_DiagnosisControl_Fktn dData_Obd_Fktn dData_Eeprom_Fktn dData_DemWrapper_Fktn dData_CarbHandler_Fktn dData_Erm_Fktn /end SUB_FUNCTION
/end FUNCTION
/begin FUNCTION dData_DiagnosisControl_Fktn "Calibration values of the Component dData_DiagnosisControl" /begin SUB_FUNCTION jData_DiagnosisControl_Fktn /end SUB_FUNCTION /end FUNCTION
/begin FUNCTION jData_DiagnosisControl_Fktn "Calibration values of the Instance jData_DiagnosisControl"
 /begin DEF_CHARACTERISTIC D_DiActivateSubstFunct D_DiActivateSubstFunctHi D_DiAmbCond D_DiErrorCodeConvTab D_DiErrorCodeConvTabForAZG D_DiErrorCode_1 D_DiErrorCode_10 D_DiErrorCode_100 D_DiErrorCode_101 D_DiErrorCode_102 D_DiErrorCode_103 D_DiErrorCode_104 D_DiErrorCode_105 D_DiErrorCode_106 D_DiErrorCode_107 D_DiErrorCode_108 D_DiErrorCode_109 D_DiErrorCode_11 D_DiErrorCode_110 D_DiErrorCode_111 D_DiErrorCode_112 D_DiErrorCode_113 D_DiErrorCode_114 D_DiErrorCode_115 D_DiErrorCode_116 D_DiErrorCode_117 D_DiErrorCode_118 D_DiErrorCode_119 D_DiErrorCode_12 D_DiErrorCode_120 D_DiErrorCode_121 D_DiErrorCode_122 D_DiErrorCode_123 D_DiErrorCode_124 D_DiErrorCode_125 D_DiErrorCode_126 D_DiErrorCode_127 D_DiErrorCode_128 D_DiErrorCode_129 D_DiErrorCode_13 D_DiErrorCode_130 D_DiErrorCode_131 D_DiErrorCode_132 D_DiErrorCode_133 D_DiErrorCode_134 D_DiErrorCode_135 D_DiErrorCode_136 D_DiErrorCode_137 D_DiErrorCode_138 D_DiErrorCode_139 D_DiErrorCode_14 D_DiErrorCode_140 D_DiErrorCode_141 D_DiErrorCode_142 D_DiErrorCode_143 D_DiErrorCode_144 D_DiErrorCode_145 D_DiErrorCode_146 D_DiErrorCode_147 D_DiErrorCode_148 D_DiErrorCode_149 D_DiErrorCode_15 D_DiErrorCode_150 D_DiErrorCode_151 D_DiErrorCode_152 D_DiErrorCode_153 D_DiErrorCode_154 D_DiErrorCode_155 D_DiErrorCode_156 D_DiErrorCode_157 D_DiErrorCode_158 D_DiErrorCode_159 D_DiErrorCode_16 D_DiErrorCode_160 D_DiErrorCode_161 D_DiErrorCode_162 D_DiErrorCode_163 D_DiErrorCode_164 D_DiErrorCode_165 D_DiErrorCode_166 D_DiErrorCode_167 D_DiErrorCode_168 D_DiErrorCode_169 D_DiErrorCode_17 D_DiErrorCode_170 D_DiErrorCode_171 D_DiErrorCode_172 D_DiErrorCode_173 D_DiErrorCode_174 D_DiErrorCode_175 D_DiErrorCode_176 D_DiErrorCode_177 D_DiErrorCode_178 D_DiErrorCode_179 D_DiErrorCode_18 D_DiErrorCode_180 D_DiErrorCode_181 D_DiErrorCode_182 D_DiErrorCode_183 D_DiErrorCode_184 D_DiErrorCode_185 D_DiErrorCode_186 D_DiErrorCode_187 D_DiErrorCode_188 D_DiErrorCode_189 D_DiErrorCode_19 D_DiErrorCode_190 D_DiErrorCode_191 D_DiErrorCode_192 D_DiErrorCode_193 D_DiErrorCode_194 D_DiErrorCode_195 D_DiErrorCode_196 D_DiErrorCode_197 D_DiErrorCode_198 D_DiErrorCode_199 D_DiErrorCode_2 D_DiErrorCode_20 D_DiErrorCode_200 D_DiErrorCode_201 D_DiErrorCode_202 D_DiErrorCode_203 D_DiErrorCode_204 D_DiErrorCode_205 D_DiErrorCode_206 D_DiErrorCode_207 D_DiErrorCode_208 D_DiErrorCode_209 D_DiErrorCode_21 D_DiErrorCode_210 D_DiErrorCode_211 D_DiErrorCode_212 D_DiErrorCode_213 D_DiErrorCode_214 D_DiErrorCode_215 D_DiErrorCode_216 D_DiErrorCode_217 D_DiErrorCode_218 D_DiErrorCode_219 D_DiErrorCode_22 D_DiErrorCode_220 D_DiErrorCode_221 D_DiErrorCode_222 D_DiErrorCode_223 D_DiErrorCode_224 D_DiErrorCode_225 D_DiErrorCode_226 D_DiErrorCode_227 D_DiErrorCode_228 D_DiErrorCode_229 D_DiErrorCode_23 D_DiErrorCode_230 D_DiErrorCode_231 D_DiErrorCode_232 D_DiErrorCode_233 D_DiErrorCode_234 D_DiErrorCode_235 D_DiErrorCode_236 D_DiErrorCode_237 D_DiErrorCode_238 D_DiErrorCode_239 D_DiErrorCode_24 D_DiErrorCode_240 D_DiErrorCode_241 D_DiErrorCode_242 D_DiErrorCode_243 D_DiErrorCode_244 D_DiErrorCode_245 D_DiErrorCode_246 D_DiErrorCode_247 D_DiErrorCode_248 D_DiErrorCode_249 D_DiErrorCode_25 D_DiErrorCode_250 D_DiErrorCode_251 D_DiErrorCode_252 D_DiErrorCode_253 D_DiErrorCode_254 D_DiErrorCode_26 D_DiErrorCode_27 D_DiErrorCode_28 D_DiErrorCode_29 D_DiErrorCode_3 D_DiErrorCode_30 D_DiErrorCode_31 D_DiErrorCode_32 D_DiErrorCode_33 D_DiErrorCode_34 D_DiErrorCode_35 D_DiErrorCode_36 D_DiErrorCode_37 D_DiErrorCode_38 D_DiErrorCode_39 D_DiErrorCode_4 D_DiErrorCode_40 D_DiErrorCode_41 D_DiErrorCode_42 D_DiErrorCode_43 D_DiErrorCode_44 D_DiErrorCode_45 D_DiErrorCode_46 D_DiErrorCode_47 D_DiErrorCode_48 D_DiErrorCode_49 D_DiErrorCode_5 D_DiErrorCode_50 D_DiErrorCode_51 D_DiErrorCode_52 D_DiErrorCode_53 D_DiErrorCode_54 D_DiErrorCode_55 D_DiErrorCode_56 D_DiErrorCode_57 D_DiErrorCode_58 D_DiErrorCode_59 D_DiErrorCode_6 D_DiErrorCode_60 D_DiErrorCode_61 D_DiErrorCode_62 D_DiErrorCode_63 D_DiErrorCode_64 D_DiErrorCode_65 D_DiErrorCode_66 D_DiErrorCode_67 D_DiErrorCode_68 D_DiErrorCode_69 D_DiErrorCode_7 D_DiErrorCode_70 D_DiErrorCode_71 D_DiErrorCode_72 D_DiErrorCode_73 D_DiErrorCode_74 D_DiErrorCode_75 D_DiErrorCode_76 D_DiErrorCode_77 D_DiErrorCode_78 D_DiErrorCode_79 D_DiErrorCode_8 D_DiErrorCode_80 D_DiErrorCode_81 D_DiErrorCode_82 D_DiErrorCode_83 D_DiErrorCode_84 D_DiErrorCode_85 D_DiErrorCode_86 D_DiErrorCode_87 D_DiErrorCode_88 D_DiErrorCode_89 D_DiErrorCode_9 D_DiErrorCode_90 D_DiErrorCode_91 D_DiErrorCode_92 D_DiErrorCode_93 D_DiErrorCode_94 D_DiErrorCode_95 D_DiErrorCode_96 D_DiErrorCode_97 D_DiErrorCode_98 D_DiErrorCode_99 D_DiErrorEntryUpdateType D_DiErrorInhibitionTab D_DiGroupTester1Counter D_DiGroupTester1ErrorCode D_DiGroupTester1ErrorType D_DiGroupTester1Reaction D_DiGroupTester1Status D_DiGroupTester1Switch D_DiRetryRNFInInit D_ThrottlePosUThForQSF D_nAbFiltUThForQSF D_nEngLThForCalTC D_uBattFiltLTh1ForCalTC D_uBattFiltLTh2ForCalTC D_uBattFiltUThForCalTC SWI_DiActivateExtSubstFunct SWI_DiClearBkpErrMem SWI_DiClearErrMem SWI_DiGlobalCtrl /end DEF_CHARACTERISTIC
/end FUNCTION
/begin FUNCTION dData_Obd_Fktn "Calibration values of the Component dData_Obd" /begin SUB_FUNCTION jData_Obd_Fktn /end SUB_FUNCTION /end FUNCTION
/begin FUNCTION jData_Obd_Fktn "Calibration values of the Instance jData_Obd"
 /begin DEF_CHARACTERISTIC D_DiObdAutoDeleteVariant D_DiObdCWarmUpCycleDiff D_DiObdCWarmUpCycleTh D_DiObdFFIntern D_DiObdFFMoment D_DiObdIumprDenominatorCounterTh D_DiObdIumprDenominatorTimeTh D_DiObdNEngTh D_DiObdNrWarmUpCycles D_DiObdTEngTh D_DiObdTab_0 D_DiObdTab_1 D_StringObdEcuName SWI_DiObdCommunicationAfterIgnitionOff SWI_DiObdDrivingCycle SWI_DiObdIumprReset SWI_DiObdNormTripB SWI_DiObdPermanentFault_0 SWI_DiObdPermanentFault_1 SWI_DiObdPermanentModeA SWI_DiObdWarmUpCycle /end DEF_CHARACTERISTIC
/end FUNCTION
/begin FUNCTION dData_Eeprom_Fktn "Calibration values of the Component dData_Eeprom" /begin SUB_FUNCTION jData_Eeprom_Fktn /end SUB_FUNCTION /end FUNCTION
/begin FUNCTION jData_Eeprom_Fktn "Calibration values of the Instance jData_Eeprom" /begin DEF_CHARACTERISTIC D_EepromStoreImmediate_KFC /end DEF_CHARACTERISTIC /end FUNCTION
/begin FUNCTION dData_DemWrapper_Fktn "Calibration values of the Component dData_DemWrapper" /begin SUB_FUNCTION jData_DemWrapper_Fktn /end SUB_FUNCTION /end FUNCTION
/begin FUNCTION jData_DemWrapper_Fktn "Calibration values of the Instance jData_DemWrapper" /begin DEF_CHARACTERISTIC D_DemFilteredMaxSearch /end DEF_CHARACTERISTIC /end FUNCTION
/begin FUNCTION dData_CarbHandler_Fktn "Calibration values of the Component dData_CarbHandler" /begin SUB_FUNCTION jData_CarbHandler_Fktn /end SUB_FUNCTION /end FUNCTION
/begin FUNCTION jData_CarbHandler_Fktn "Calibration values of the Instance jData_CarbHandler" /begin DEF_CHARACTERISTIC SWI_DiObdResponseMode /end DEF_CHARACTERISTIC /end FUNCTION
/begin FUNCTION dData_Erm_Fktn "Calibration values of the Component dData_Erm" /begin SUB_FUNCTION jData_Erm_Fktn /end SUB_FUNCTION /end FUNCTION
/begin FUNCTION jData_Erm_Fktn "Calibration values of the Instance jData_Erm"
 /begin DEF_CHARACTERISTIC D_DiErmMonitoring_KFC D_DiErmMonitoring_KMN SWI_DiErmDeactivate /end DEF_CHARACTERISTIC
/end FUNCTION
/begin FUNCTION zff_EH_Applikationsgroessen.Asil.C "Asil relevant characteristic values (C)"
 /begin REF_CHARACTERISTIC D_DiErrorInhibitionTab D_DiGroupTester1Switch SWI_DiActivateExtSubstFunct SWI_DiGlobalCtrl /end REF_CHARACTERISTIC
/end FUNCTION
/begin FUNCTION zf_ATSYS "Größen der ATSYS"
 /begin SUB_FUNCTION zf_ATSYS_Messgroessen zf_ATSYS_Applikationsgroessen zf_ATSYS_Applikationsgroessen.Asil zf_ATSYS_Anforderungen /end SUB_FUNCTION
/end FUNCTION
/begin FUNCTION zf_ATSYS_Messgroessen "Alle Messgrößen der ATSYS"
 /begin SUB_FUNCTION PAK BIBLIO ITF AZS BIH HYD ADA NVR KAS SAS MON UEW UL2 PSA Funktionskomponenten /end SUB_FUNCTION
/end FUNCTION
/begin FUNCTION PAK "Programmablaufkontrolle" /begin LOC_MEASUREMENT iPakSchnittstelle.pak_aktiv /end LOC_MEASUREMENT /end FUNCTION
/begin FUNCTION BIBLIO "Die Unterstruktur BIBLIO enthält alle Klassen, die Standardfunktionalitäten enthalten. Bei BIBLIO handelt es sich nicht um ein Paket, da jeder auf diese Funktionalitäten ohne eine weitere Schnittstellenklasse zugreifen darf." /begin SUB_FUNCTION BIB_ENTW_DIAG BIB_FUNKTION /end SUB_FUNCTION /end FUNCTION
/begin FUNCTION BIB_ENTW_DIAG "In BIB_ENTW_DIAG sind die Klassen zur Entwicklungsdiagnose enthalten" /begin LOC_MEASUREMENT iBihZfinf.timer32_betrieb /end LOC_MEASUREMENT /end FUNCTION
/begin RECORD_LAYOUT ZF_kw_ui8_S5_S3 FNC_VALUES 1 UBYTE COLUMN_DIR DIRECT /end RECORD_LAYOUT
/begin RECORD_LAYOUT ZF_kw_ui16_S5_S3 FNC_VALUES 1 UWORD COLUMN_DIR DIRECT /end RECORD_LAYOUT
/begin RECORD_LAYOUT ZF_kw_ui32_S5_S3 FNC_VALUES 1 ULONG COLUMN_DIR DIRECT /end RECORD_LAYOUT
/begin RECORD_LAYOUT ZF_tab_ui8_S5_S3 FNC_VALUES 2 UBYTE COLUMN_DIR DIRECT NO_AXIS_PTS_X 1 ULONG /end RECORD_LAYOUT
/begin RECORD_LAYOUT ZF_tab_ui16_S5_S3 FNC_VALUES 2 UWORD COLUMN_DIR DIRECT NO_AXIS_PTS_X 1 ULONG /end RECORD_LAYOUT
/begin RECORD_LAYOUT ZF_tab_nx_ui16_S5_S3 FNC_VALUES 1 UWORD COLUMN_DIR DIRECT /end RECORD_LAYOUT
/begin RECORD_LAYOUT ZF_tab2d_ui32_S5_S3 FNC_VALUES 3 ULONG ROW_DIR DIRECT NO_AXIS_PTS_X 1 ULONG NO_AXIS_PTS_Y 2 ULONG /end RECORD_LAYOUT
/begin RECORD_LAYOUT ZF_tab2d_nx_ny_ui8_S5_S3 FNC_VALUES 1 UBYTE ROW_DIR DIRECT /end RECORD_LAYOUT
/begin RECORD_LAYOUT ZF_tab2d_nx_ny_ui16_S5_S3 FNC_VALUES 1 UWORD ROW_DIR DIRECT /end RECORD_LAYOUT
/end MODULE
/end PROJECT
