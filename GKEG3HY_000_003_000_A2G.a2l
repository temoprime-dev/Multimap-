ASAP2_VERSION 1 51
/begin PROJECT _929_929 "Gen2_BMW_System_Supplier_Lib"
/begin HEADER "" VERSION "C_03_03" PROJECT_NO _929_929 /end HEADER
/begin MODULE DIM ""
/begin MOD_COMMON "" BYTE_ORDER MSB_FIRST ALIGNMENT_BYTE 1 ALIGNMENT_WORD 2 ALIGNMENT_LONG 4 ALIGNMENT_FLOAT32_IEEE 4 /end MOD_COMMON
/begin MEASUREMENT ZFEH_EepromData.ydiMemory_xau16[1].amb_cond.ambient_condition[1][1] "ambient condition shot [0 .. 2-1] with 25 data bytes [0 .. 25-1] for the error code stored in this error memory slot" UBYTE EH_STANDARD_S5_S3 1 100 0 255 DISPLAY_IDENTIFIER ambient_condition[1][1].amb_cond.ydiMemory_xau16[1].ZFEH_EepromData ECU_ADDRESS 0xFFF82882 /end MEASUREMENT
/begin MEASUREMENT ZFEH_EepromData.ydiMemory_xau16[1].amb_cond.ambient_condition[1][2] "ambient condition shot [0 .. 2-1] with 25 data bytes [0 .. 25-1] for the error code stored in this error memory slot" UBYTE EH_STANDARD_S5_S3 1 100 0 255 DISPLAY_IDENTIFIER ambient_condition[1][2].amb_cond.ydiMemory_xau16[1].ZFEH_EepromData ECU_ADDRESS 0xFFF82883 /end MEASUREMENT
/begin MEASUREMENT ZFEH_EepromData.ydiMemory_xau16[1].amb_cond.ambient_condition[1][3] "ambient condition shot [0 .. 2-1] with 25 data bytes [0 .. 25-1] for the error code stored in this error memory slot" UBYTE EH_STANDARD_S5_S3 1 100 0 255 DISPLAY_IDENTIFIER ambient_condition[1][3].amb_cond.ydiMemory_xau16[1].ZFEH_EepromData ECU_ADDRESS 0xFFF82884 /end MEASUREMENT
/begin MEASUREMENT ZFEH_EepromData.ydiMemory_xau16[1].amb_cond.ambient_condition[1][4] "ambient condition shot [0 .. 2-1] with 25 data bytes [0 .. 25-1] for the error code stored in this error memory slot" UBYTE EH_STANDARD_S5_S3 1 100 0 255 DISPLAY_IDENTIFIER ambient_condition[1][4].amb_cond.ydiMemory_xau16[1].ZFEH_EepromData ECU_ADDRESS 0xFFF82885 /end MEASUREMENT
/begin MEASUREMENT ZFEH_EepromData.ydiMemory_xau16[1].amb_cond.ambient_condition[1][5] "ambient condition shot [0 .. 2-1] with 25 data bytes [0 .. 25-1] for the error code stored in this error memory slot" UBYTE EH_STANDARD_S5_S3 1 100 0 255 DISPLAY_IDENTIFIER ambient_condition[1][5].amb_cond.ydiMemory_xau16[1].ZFEH_EepromData ECU_ADDRESS 0xFFF82886 /end MEASUREMENT
/begin MEASUREMENT ZFEH_EepromData.ydiMemory_xau16[1].amb_cond.ambient_condition[1][6] "ambient condition shot [0 .. 2-1] with 25 data bytes [0 .. 25-1] for the error code stored in this error memory slot" UBYTE EH_STANDARD_S5_S3 1 100 0 255 DISPLAY_IDENTIFIER ambient_condition[1][6].amb_cond.ydiMemory_xau16[1].ZFEH_EepromData ECU_ADDRESS 0xFFF82887 /end MEASUREMENT
/begin MEASUREMENT ZFEH_EepromData.ydiMemory_xau16[1].amb_cond.ambient_condition[1][7] "ambient condition shot [0 .. 2-1] with 25 data bytes [0 .. 25-1] for the error code stored in this error memory slot" UBYTE EH_STANDARD_S5_S3 1 100 0 255 DISPLAY_IDENTIFIER ambient_condition[1][7].amb_cond.ydiMemory_xau16[1].ZFEH_EepromData ECU_ADDRESS 0xFFF82888 /end MEASUREMENT
/begin MEASUREMENT ZFEH_EepromData.ydiMemory_xau16[1].amb_cond.ambient_condition[1][8] "ambient condition shot [0 .. 2-1] with 25 data bytes [0 .. 25-1] for the error code stored in this error memory slot" UBYTE EH_STANDARD_S5_S3 1 100 0 255 DISPLAY_IDENTIFIER ambient_condition[1][8].amb_cond.ydiMemory_xau16[1].ZFEH_EepromData ECU_ADDRESS 0xFFF82889 /end MEASUREMENT
/begin MEASUREMENT ZFEH_EepromData.ydiMemory_xau16[1].amb_cond.ambient_condition[1][9] "ambient condition shot [0 .. 2-1] with 25 data bytes [0 .. 25-1] for the error code stored in this error memory slot" UBYTE EH_STANDARD_S5_S3 1 100 0 255 DISPLAY_IDENTIFIER ambient_condition[1][9].amb_cond.ydiMemory_xau16[1].ZFEH_EepromData ECU_ADDRESS 0xFFF8288A /end MEASUREMENT
/begin MEASUREMENT ZFEH_EepromData.ydiMemory_xau16[1].amb_cond.ambient_condition[1][14] "ambient condition shot [0 .. 2-1] with 25 data bytes [0 .. 25-1] for the error code stored in this error memory slot" UBYTE EH_STANDARD_S5_S3 1 100 0 255 DISPLAY_IDENTIFIER ambient_condition[1][14].amb_cond.ydiMemory_xau16[1].ZFEH_EepromData ECU_ADDRESS 0xFFF8288F /end MEASUREMENT
/begin MEASUREMENT ZFEH_EepromData.ydiMemory_xau16[1].amb_cond.ambient_condition[1][15] "ambient condition shot [0 .. 2-1] with 25 data bytes [0 .. 25-1] for the error code stored in this error memory slot" UBYTE EH_STANDARD_S5_S3 1 100 0 255 DISPLAY_IDENTIFIER ambient_condition[1][15].amb_cond.ydiMemory_xau16[1].ZFEH_EepromData ECU_ADDRESS 0xFFF82890 /end MEASUREMENT
/begin MEASUREMENT ZFEH_EepromData.ydiMemory_xau16[1].amb_cond.ambient_condition[1][16] "ambient condition shot [0 .. 2-1] with 25 data bytes [0 .. 25-1] for the error code stored in this error memory slot" UBYTE EH_STANDARD_S5_S3 1 100 0 255 DISPLAY_IDENTIFIER ambient_condition[1][16].amb_cond.ydiMemory_xau16[1].ZFEH_EepromData ECU_ADDRESS 0xFFF82891 /end MEASUREMENT
/begin MEASUREMENT ZFEH_EepromData.ydiMemory_xau16[1].amb_cond.ambient_condition[1][17] "ambient condition shot [0 .. 2-1] with 25 data bytes [0 .. 25-1] for the error code stored in this error memory slot" UBYTE EH_STANDARD_S5_S3 1 100 0 255 DISPLAY_IDENTIFIER ambient_condition[1][17].amb_cond.ydiMemory_xau16[1].ZFEH_EepromData ECU_ADDRESS 0xFFF82892 /end MEASUREMENT
/begin MEASUREMENT ZFEH_EepromData.ydiMemory_xau16[1].amb_cond.ambient_condition[1][18] "ambient condition shot [0 .. 2-1] with 25 data bytes [0 .. 25-1] for the error code stored in this error memory slot" UBYTE EH_STANDARD_S5_S3 1 100 0 255 DISPLAY_IDENTIFIER ambient_condition[1][18].amb_cond.ydiMemory_xau16[1].ZFEH_EepromData ECU_ADDRESS 0xFFF82893 /end MEASUREMENT
/begin MEASUREMENT ZFEH_EepromData.ydiMemory_xau16[1].amb_cond.ambient_condition[1][19] "ambient condition shot [0 .. 2-1] with 25 data bytes [0 .. 25-1] for the error code stored in this error memory slot" UBYTE EH_STANDARD_S5_S3 1 100 0 255 DISPLAY_IDENTIFIER ambient_condition[1][19].amb_cond.ydiMemory_xau16[1].ZFEH_EepromData ECU_ADDRESS 0xFFF82894 /end MEASUREMENT
/begin MEASUREMENT ZFEH_EepromData.ydiMemory_xau16[1].amb_cond.ambient_condition[1][20] "ambient condition shot [0 .. 2-1] with 25 data bytes [0 .. 25-1] for the error code stored in this error memory slot" UBYTE EH_STANDARD_S5_S3 1 100 0 255 DISPLAY_IDENTIFIER ambient_condition[1][20].amb_cond.ydiMemory_xau16[1].ZFEH_EepromData ECU_ADDRESS 0xFFF82895 /end MEASUREMENT
/begin MEASUREMENT ZFEH_EepromData.ydiMemory_xau16[1].amb_cond.ambient_condition[1][21] "ambient condition shot [0 .. 2-1] with 25 data bytes [0 .. 25-1] for the error code stored in this error memory slot" UBYTE EH_STANDARD_S5_S3 1 100 0 255 DISPLAY_IDENTIFIER ambient_condition[1][21].amb_cond.ydiMemory_xau16[1].ZFEH_EepromData ECU_ADDRESS 0xFFF82896 /end MEASUREMENT
/begin MEASUREMENT ZFEH_EepromData.ydiMemory_xau16[1].amb_cond.ambient_condition[1][22] "ambient condition shot [0 .. 2-1] with 25 data bytes [0 .. 25-1] for the error code stored in this error memory slot" UBYTE EH_STANDARD_S5_S3 1 100 0 255 DISPLAY_IDENTIFIER ambient_condition[1][22].amb_cond.ydiMemory_xau16[1].ZFEH_EepromData ECU_ADDRESS 0xFFF82897 /end MEASUREMENT
/begin MEASUREMENT ZFEH_EepromData.ydiMemory_xau16[1].amb_cond.ambient_condition[1][23] "ambient condition shot [0 .. 2-1] with 25 data bytes [0 .. 25-1] for the error code stored in this error memory slot" UBYTE EH_STANDARD_S5_S3 1 100 0 255 DISPLAY_IDENTIFIER ambient_condition[1][23].amb_cond.ydiMemory_xau16[1].ZFEH_EepromData ECU_ADDRESS 0xFFF82898 /end MEASUREMENT
/begin MEASUREMENT ZFEH_EepromData.ydiMemory_xau16[1].amb_cond.ambient_condition[1][24] "ambient condition shot [0 .. 2-1] with 25 data bytes [0 .. 25-1] for the error code stored in this error memory slot" UBYTE EH_STANDARD_S5_S3 1 100 0 255 DISPLAY_IDENTIFIER ambient_condition[1][24].amb_cond.ydiMemory_xau16[1].ZFEH_EepromData ECU_ADDRESS 0xFFF82899 /end MEASUREMENT
/begin MEASUREMENT ZFEH_EepromData.ydiMemory_xau16[1].amb_cond.status_of_ambient_conditions[0] "status of ambient condition shot x: 0=invalid 1=valid" UBYTE EH_STANDARD_S5_S3 1 100 0 1 DISPLAY_IDENTIFIER status_of_ambient_conditions[0].amb_cond.ydiMemory_xau16[1].ZFEH_EepromData ECU_ADDRESS 0xFFF8289A /end MEASUREMENT
/begin MEASUREMENT ZFEH_EepromData.ydiMemory_xau16[1].amb_cond.status_of_ambient_conditions[1] "status of ambient condition shot x: 0=invalid 1=valid" UBYTE EH_STANDARD_S5_S3 1 100 0 1 DISPLAY_IDENTIFIER status_of_ambient_conditions[1].amb_cond.ydiMemory_xau16[1].ZFEH_EepromData ECU_ADDRESS 0xFFF8289B /end MEASUREMENT
/begin MEASUREMENT ZFEH_EepromData.ydiMemory_xau16[1].error_code "error code stored in error memory slot" UWORD CONV_KFC_NAME 0 255 0 65535 DISPLAY_IDENTIFIER error_code.ydiMemory_xau16[1].ZFEH_EepromData ECU_ADDRESS 0xFFF82854 /end MEASUREMENT
/begin MEASUREMENT ZFEH_EepromData.ydiMemory_xau16[1].error_type "error type of error code stored in error memory slot" UWORD EH_STANDARD_S5_S3 1 100 0 65535 DISPLAY_IDENTIFIER error_type.ydiMemory_xau16[1].ZFEH_EepromData ECU_ADDRESS 0xFFF82856 /end MEASUREMENT
/begin MEASUREMENT ZFEH_EepromData.ydiMemory_xau16[1].status_word "status word of error code stored in error memory slot" UWORD EH_STANDARD_S5_S3 1 100 0 65535 DISPLAY_IDENTIFIER status_word.ydiMemory_xau16[1].ZFEH_EepromData ECU_ADDRESS 0xFFF82858 /end MEASUREMENT
/begin MEASUREMENT ZFEH_EepromData.ydiMemory_xau16[1].frequency_counter "frequency counter of error code stored in error memory slot" UBYTE EH_STANDARD_S5_S3 1 100 0 255 DISPLAY_IDENTIFIER frequency_counter.ydiMemory_xau16[1].ZFEH_EepromData ECU_ADDRESS 0xFFF8285A /end MEASUREMENT
/begin MEASUREMENT ZFEH_EepromData.ydiMemory_xau16[1].backwards_counter "backwards counter of error code stored in error memory slot" UBYTE EH_STANDARD_S5_S3 1 100 0 255 DISPLAY_IDENTIFIER backwards_counter.ydiMemory_xau16[1].ZFEH_EepromData ECU_ADDRESS 0xFFF8285B /end MEASUREMENT
/begin MEASUREMENT ZFEH_EepromData.ydiMemory_xau16[1].permanent_counter "counter of permanent error codes stored in error memory slot" UBYTE EH_STANDARD_S5_S3 1 100 0 255 DISPLAY_IDENTIFIER permanent_counter.ydiMemory_xau16[1].ZFEH_EepromData ECU_ADDRESS 0xFFF8285C /end MEASUREMENT
/begin MEASUREMENT ZFEH_EepromData.ydiMemory_xau16[1].sequence_counter "sequence counter of error code stored in error memory slot" UBYTE EH_STANDARD_S5_S3 1 100 0 255 DISPLAY_IDENTIFIER sequence_counter.ydiMemory_xau16[1].ZFEH_EepromData ECU_ADDRESS 0xFFF8285D /end MEASUREMENT
/begin MEASUREMENT ZFEH_EepromData.ydiMemory_xau16[1].master_time "master time of error code stored in error memory slot" ULONG EH_STANDARD_S5_S3 1 100 0 4294967295 DISPLAY_IDENTIFIER master_time.ydiMemory_xau16[1].ZFEH_EepromData ECU_ADDRESS 0xFFF82860 /end MEASUREMENT
/begin MEASUREMENT ZFEH_EepromData.ydiMemory_xau16[1].condition_byte "condition byte of error code stored in error memory slot" UBYTE EH_STANDARD_S5_S3 1 100 0 255 DISPLAY_IDENTIFIER condition_byte.ydiMemory_xau16[1].ZFEH_EepromData ECU_ADDRESS 0xFFF82865 /end MEASUREMENT
/begin MEASUREMENT ZFEH_EepromData.ydiMemory_xau16[1].obd_driving_cycle_counter "obd driving cycle counter of error code stored in error memory slot" UWORD EH_STANDARD_S5_S3 1 100 0 65535 DISPLAY_IDENTIFIER obd_driving_cycle_counter.ydiMemory_xau16[1].ZFEH_EepromData ECU_ADDRESS 0xFFF82866 /end MEASUREMENT
/begin MEASUREMENT ZFEH_EepromData.ydiMemory_xau16[2].amb_cond.ambient_condition[0][0] "ambient condition shot [0 .. 2-1] with 25 data bytes [0 .. 25-1] for the error code stored in this error memory slot" UBYTE EH_STANDARD_S5_S3 1 100 0 255 DISPLAY_IDENTIFIER ambient_condition[0][0].amb_cond.ydiMemory_xau16[2].ZFEH_EepromData ECU_ADDRESS 0xFFF828B0 /end MEASUREMENT
/begin MEASUREMENT ZFEH_EepromData.ydiMemory_xau16[2].amb_cond.ambient_condition[0][1] "ambient condition shot [0 .. 2-1] with 25 data bytes [0 .. 25-1] for the error code stored in this error memory slot" UBYTE EH_STANDARD_S5_S3 1 100 0 255 DISPLAY_IDENTIFIER ambient_condition[0][1].amb_cond.ydiMemory_xau16[2].ZFEH_EepromData ECU_ADDRESS 0xFFF828B1 /end MEASUREMENT
/begin MEASUREMENT ZFEH_EepromData.ydiMemory_xau16[2].amb_cond.ambient_condition[0][2] "ambient condition shot [0 .. 2-1] with 25 data bytes [0 .. 25-1] for the error code stored in this error memory slot" UBYTE EH_STANDARD_S5_S3 1 100 0 255 DISPLAY_IDENTIFIER ambient_condition[0][2].amb_cond.ydiMemory_xau16[2].ZFEH_EepromData ECU_ADDRESS 0xFFF828B2 /end MEASUREMENT
/begin MEASUREMENT ZFEH_EepromData.ydiMemory_xau16[2].amb_cond.ambient_condition[0][3] "ambient condition shot [0 .. 2-1] with 25 data bytes [0 .. 25-1] for the error code stored in this error memory slot" UBYTE EH_STANDARD_S5_S3 1 100 0 255 DISPLAY_IDENTIFIER ambient_condition[0][3].amb_cond.ydiMemory_xau16[2].ZFEH_EepromData ECU_ADDRESS 0xFFF828B3 /end MEASUREMENT
/begin MEASUREMENT ZFEH_EepromData.ydiMemory_xau16[2].amb_cond.ambient_condition[0][4] "ambient condition shot [0 .. 2-1] with 25 data bytes [0 .. 25-1] for the error code stored in this error memory slot" UBYTE EH_STANDARD_S5_S3 1 100 0 255 DISPLAY_IDENTIFIER ambient_condition[0][4].amb_cond.ydiMemory_xau16[2].ZFEH_EepromData ECU_ADDRESS 0xFFF828B4 /end MEASUREMENT
/begin MEASUREMENT ZFEH_EepromData.ydiMemory_xau16[2].amb_cond.ambient_condition[0][5] "ambient condition shot [0 .. 2-1] with 25 data bytes [0 .. 25-1] for the error code stored in this error memory slot" UBYTE EH_STANDARD_S5_S3 1 100 0 255 DISPLAY_IDENTIFIER ambient_condition[0][5].amb_cond.ydiMemory_xau16[2].ZFEH_EepromData ECU_ADDRESS 0xFFF828B5 /end MEASUREMENT
/begin MEASUREMENT ZFEH_EepromData.ydiMemory_xau16[2].amb_cond.ambient_condition[0][6] "ambient condition shot [0 .. 2-1] with 25 data bytes [0 .. 25-1] for the error code stored in this error memory slot" UBYTE EH_STANDARD_S5_S3 1 100 0 255 DISPLAY_IDENTIFIER ambient_condition[0][6].amb_cond.ydiMemory_xau16[2].ZFEH_EepromData ECU_ADDRESS 0xFFF828B6 /end MEASUREMENT
/begin MEASUREMENT ZFEH_EepromData.ydiMemory_xau16[2].amb_cond.ambient_condition[0][7] "ambient condition shot [0 .. 2-1] with 25 data bytes [0 .. 25-1] for the error code stored in this error memory slot" UBYTE EH_STANDARD_S5_S3 1 100 0 255 DISPLAY_IDENTIFIER ambient_condition[0][7].amb_cond.ydiMemory_xau16[2].ZFEH_EepromData ECU_ADDRESS 0xFFF828B7 /end MEASUREMENT
/begin MEASUREMENT ZFEH_EepromData.ydiMemory_xau16[2].amb_cond.ambient_condition[0][8] "ambient condition shot [0 .. 2-1] with 25 data bytes [0 .. 25-1] for the error code stored in this error memory slot" UBYTE EH_STANDARD_S5_S3 1 100 0 255 DISPLAY_IDENTIFIER ambient_condition[0][8].amb_cond.ydiMemory_xau16[2].ZFEH_EepromData ECU_ADDRESS 0xFFF828B8 /end MEASUREMENT
/begin MEASUREMENT ZFEH_EepromData.ydiMemory_xau16[2].amb_cond.ambient_condition[0][9] "ambient condition shot [0 .. 2-1] with 25 data bytes [0 .. 25-1] for the error code stored in this error memory slot" UBYTE EH_STANDARD_S5_S3 1 100 0 255 DISPLAY_IDENTIFIER ambient_condition[0][9].amb_cond.ydiMemory_xau16[2].ZFEH_EepromData ECU_ADDRESS 0xFFF828B9 /end MEASUREMENT
/begin MEASUREMENT ZFEH_EepromData.ydiMemory_xau16[2].amb_cond.ambient_condition[0][10] "ambient condition shot [0 .. 2-1] with 25 data bytes [0 .. 25-1] for the error code stored in this error memory slot" UBYTE EH_STANDARD_S5_S3 1 100 0 255 DISPLAY_IDENTIFIER ambient_condition[0][10].amb_cond.ydiMemory_xau16[2].ZFEH_EepromData ECU_ADDRESS 0xFFF828BA /end MEASUREMENT
/begin MEASUREMENT ZFEH_EepromData.ydiMemory_xau16[2].amb_cond.ambient_condition[0][11] "ambient condition shot [0 .. 2-1] with 25 data bytes [0 .. 25-1] for the error code stored in this error memory slot" UBYTE EH_STANDARD_S5_S3 1 100 0 255 DISPLAY_IDENTIFIER ambient_condition[0][11].amb_cond.ydiMemory_xau16[2].ZFEH_EepromData ECU_ADDRESS 0xFFF828BB /end MEASUREMENT
/begin MEASUREMENT ZFEH_EepromData.ydiMemory_xau16[2].amb_cond.ambient_condition[0][12] "ambient condition shot [0 .. 2-1] with 25 data bytes [0 .. 25-1] for the error code stored in this error memory slot" UBYTE EH_STANDARD_S5_S3 1 100 0 255 DISPLAY_IDENTIFIER ambient_condition[0][12].amb_cond.ydiMemory_xau16[2].ZFEH_EepromData ECU_ADDRESS 0xFFF828BC /end MEASUREMENT
/begin MEASUREMENT ZFEH_EepromData.ydiMemory_xau16[2].amb_cond.ambient_condition[0][13] "ambient condition shot [0 .. 2-1] with 25 data bytes [0 .. 25-1] for the error code stored in this error memory slot" UBYTE EH_STANDARD_S5_S3 1 100 0 255 DISPLAY_IDENTIFIER ambient_condition[0][13].amb_cond.ydiMemory_xau16[2].ZFEH_EepromData ECU_ADDRESS 0xFFF828BD /end MEASUREMENT
/begin MEASUREMENT ZFEH_EepromData.ydiMemory_xau16[2].amb_cond.ambient_condition[0][14] "ambient condition shot [0 .. 2-1] with 25 data bytes [0 .. 25-1] for the error code stored in this error memory slot" UBYTE EH_STANDARD_S5_S3 1 100 0 255 DISPLAY_IDENTIFIER ambient_condition[0][14].amb_cond.ydiMemory_xau16[2].ZFEH_EepromData ECU_ADDRESS 0xFFF828BE /end MEASUREMENT
/begin MEASUREMENT ZFEH_EepromData.ydiMemory_xau16[2].amb_cond.ambient_condition[0][15] "ambient condition shot [0 .. 2-1] with 25 data bytes [0 .. 25-1] for the error code stored in this error memory slot" UBYTE EH_STANDARD_S5_S3 1 100 0 255 DISPLAY_IDENTIFIER ambient_condition[0][15].amb_cond.ydiMemory_xau16[2].ZFEH_EepromData ECU_ADDRESS 0xFFF828BF /end MEASUREMENT
/begin MEASUREMENT ZFEH_EepromData.ydiMemory_xau16[2].amb_cond.ambient_condition[0][16] "ambient condition shot [0 .. 2-1] with 25 data bytes [0 .. 25-1] for the error code stored in this error memory slot" UBYTE EH_STANDARD_S5_S3 1 100 0 255 DISPLAY_IDENTIFIER ambient_condition[0][16].amb_cond.ydiMemory_xau16[2].ZFEH_EepromData ECU_ADDRESS 0xFFF828C0 /end MEASUREMENT
/begin MEASUREMENT ZFEH_EepromData.ydiMemory_xau16[2].amb_cond.ambient_condition[0][17] "ambient condition shot [0 .. 2-1] with 25 data bytes [0 .. 25-1] for the error code stored in this error memory slot" UBYTE EH_STANDARD_S5_S3 1 100 0 255 DISPLAY_IDENTIFIER ambient_condition[0][17].amb_cond.ydiMemory_xau16[2].ZFEH_EepromData ECU_ADDRESS 0xFFF828C1 /end MEASUREMENT
/begin MEASUREMENT ZFEH_EepromData.ydiMemory_xau16[2].amb_cond.ambient_condition[0][18] "ambient condition shot [0 .. 2-1] with 25 data bytes [0 .. 25-1] for the error code stored in this error memory slot" UBYTE EH_STANDARD_S5_S3 1 100 0 255 DISPLAY_IDENTIFIER ambient_condition[0][18].amb_cond.ydiMemory_xau16[2].ZFEH_EepromData ECU_ADDRESS 0xFFF828C2 /end MEASUREMENT
/begin MEASUREMENT ZFEH_EepromData.ydiMemory_xau16[2].amb_cond.ambient_condition[0][19] "ambient condition shot [0 .. 2-1] with 25 data bytes [0 .. 25-1] for the error code stored in this error memory slot" UBYTE EH_STANDARD_S5_S3 1 100 0 255 DISPLAY_IDENTIFIER ambient_condition[0][19].amb_cond.ydiMemory_xau16[2].ZFEH_EepromData ECU_ADDRESS 0xFFF828C3 /end MEASUREMENT
/begin MEASUREMENT ZFEH_EepromData.ydiMemory_xau16[2].amb_cond.ambient_condition[0][20] "ambient condition shot [0 .. 2-1] with 25 data bytes [0 .. 25-1] for the error code stored in this error memory slot" UBYTE EH_STANDARD_S5_S3 1 100 0 255 DISPLAY_IDENTIFIER ambient_condition[0][20].amb_cond.ydiMemory_xau16[2].ZFEH_EepromData ECU_ADDRESS 0xFFF828C4 /end MEASUREMENT
/begin MEASUREMENT ZFEH_EepromData.ydiMemory_xau16[2].amb_cond.ambient_condition[0][21] "ambient condition shot [0 .. 2-1] with 25 data bytes [0 .. 25-1] for the error code stored in this error memory slot" UBYTE EH_STANDARD_S5_S3 1 100 0 255 DISPLAY_IDENTIFIER ambient_condition[0][21].amb_cond.ydiMemory_xau16[2].ZFEH_EepromData ECU_ADDRESS 0xFFF828C5 /end MEASUREMENT
/begin MEASUREMENT ZFEH_EepromData.ydiMemory_xau16[2].amb_cond.ambient_condition[0][22] "ambient condition shot [0 .. 2-1] with 25 data bytes [0 .. 25-1] for the error code stored in this error memory slot" UBYTE EH_STANDARD_S5_S3 1 100 0 255 DISPLAY_IDENTIFIER ambient_condition[0][22].amb_cond.ydiMemory_xau16[2].ZFEH_EepromData ECU_ADDRESS 0xFFF828C6 /end MEASUREMENT
/begin MEASUREMENT ZFEH_EepromData.ydiMemory_xau16[2].amb_cond.ambient_condition[0][23] "ambient condition shot [0 .. 2-1] with 25 data bytes [0 .. 25-1] for the error code stored in this error memory slot" UBYTE EH_STANDARD_S5_S3 1 100 0 255 DISPLAY_IDENTIFIER ambient_condition[0][23].amb_cond.ydiMemory_xau16[2].ZFEH_EepromData ECU_ADDRESS 0xFFF828C7 /end MEASUREMENT
/begin MEASUREMENT ZFEH_EepromData.ydiMemory_xau16[2].amb_cond.ambient_condition[0][24] "ambient condition shot [0 .. 2-1] with 25 data bytes [0 .. 25-1] for the error code stored in this error memory slot" UBYTE EH_STANDARD_S5_S3 1 100 0 255 DISPLAY_IDENTIFIER ambient_condition[0][24].amb_cond.ydiMemory_xau16[2].ZFEH_EepromData ECU_ADDRESS 0xFFF828C8 /end MEASUREMENT
/begin MEASUREMENT ZFEH_EepromData.ydiMemory_xau16[2].amb_cond.ambient_condition[1][0] "ambient condition shot [0 .. 2-1] with 25 data bytes [0 .. 25-1] for the error code stored in this error memory slot" UBYTE EH_STANDARD_S5_S3 1 100 0 255 DISPLAY_IDENTIFIER ambient_condition[1][0].amb_cond.ydiMemory_xau16[2].ZFEH_EepromData ECU_ADDRESS 0xFFF828C9 /end MEASUREMENT
/begin MEASUREMENT ZFEH_EepromData.ydiMemory_xau16[2].amb_cond.ambient_condition[1][1] "ambient condition shot [0 .. 2-1] with 25 data bytes [0 .. 25-1] for the error code stored in this error memory slot" UBYTE EH_STANDARD_S5_S3 1 100 0 255 DISPLAY_IDENTIFIER ambient_condition[1][1].amb_cond.ydiMemory_xau16[2].ZFEH_EepromData ECU_ADDRESS 0xFFF828CA /end MEASUREMENT
/begin MEASUREMENT ZFEH_EepromData.ydiMemory_xau16[2].amb_cond.ambient_condition[1][2] "ambient condition shot [0 .. 2-1] with 25 data bytes [0 .. 25-1] for the error code stored in this error memory slot" UBYTE EH_STANDARD_S5_S3 1 100 0 255 DISPLAY_IDENTIFIER ambient_condition[1][2].amb_cond.ydiMemory_xau16[2].ZFEH_EepromData ECU_ADDRESS 0xFFF828CB /end MEASUREMENT
/begin MEASUREMENT ZFEH_EepromData.ydiMemory_xau16[2].amb_cond.ambient_condition[1][3] "ambient condition shot [0 .. 2-1] with 25 data bytes [0 .. 25-1] for the error code stored in this error memory slot" UBYTE EH_STANDARD_S5_S3 1 100 0 255 DISPLAY_IDENTIFIER ambient_condition[1][3].amb_cond.ydiMemory_xau16[2].ZFEH_EepromData ECU_ADDRESS 0xFFF828CC /end MEASUREMENT
/begin MEASUREMENT ZFEH_EepromData.ydiMemory_xau16[2].amb_cond.ambient_condition[1][4] "ambient condition shot [0 .. 2-1] with 25 data bytes [0 .. 25-1] for the error code stored in this error memory slot" UBYTE EH_STANDARD_S5_S3 1 100 0 255 DISPLAY_IDENTIFIER ambient_condition[1][4].amb_cond.ydiMemory_xau16[2].ZFEH_EepromData ECU_ADDRESS 0xFFF828CD /end MEASUREMENT
/begin MEASUREMENT ZFEH_EepromData.ydiMemory_xau16[2].amb_cond.ambient_condition[1][5] "ambient condition shot [0 .. 2-1] with 25 data bytes [0 .. 25-1] for the error code stored in this error memory slot" UBYTE EH_STANDARD_S5_S3 1 100 0 255 DISPLAY_IDENTIFIER ambient_condition[1][5].amb_cond.ydiMemory_xau16[2].ZFEH_EepromData ECU_ADDRESS 0xFFF828CE /end MEASUREMENT
/begin MEASUREMENT ZFEH_EepromData.ydiMemory_xau16[2].amb_cond.ambient_condition[1][6] "ambient condition shot [0 .. 2-1] with 25 data bytes [0 .. 25-1] for the error code stored in this error memory slot" UBYTE EH_STANDARD_S5_S3 1 100 0 255 DISPLAY_IDENTIFIER ambient_condition[1][6].amb_cond.ydiMemory_xau16[2].ZFEH_EepromData ECU_ADDRESS 0xFFF828CF /end MEASUREMENT
/begin MEASUREMENT ZFEH_EepromData.ydiMemory_xau16[2].amb_cond.ambient_condition[1][7] "ambient condition shot [0 .. 2-1] with 25 data bytes [0 .. 25-1] for the error code stored in this error memory slot" UBYTE EH_STANDARD_S5_S3 1 100 0 255 DISPLAY_IDENTIFIER ambient_condition[1][7].amb_cond.ydiMemory_xau16[2].ZFEH_EepromData ECU_ADDRESS 0xFFF828D0 /end MEASUREMENT
/begin MEASUREMENT ZFEH_EepromData.ydiMemory_xau16[2].amb_cond.ambient_condition[1][8] "ambient condition shot [0 .. 2-1] with 25 data bytes [0 .. 25-1] for the error code stored in this error memory slot" UBYTE EH_STANDARD_S5_S3 1 100 0 255 DISPLAY_IDENTIFIER ambient_condition[1][8].amb_cond.ydiMemory_xau16[2].ZFEH_EepromData ECU_ADDRESS 0xFFF828D1 /end MEASUREMENT
/begin MEASUREMENT ZFEH_EepromData.ydiMemory_xau16[2].amb_cond.ambient_condition[1][9] "ambient condition shot [0 .. 2-1] with 25 data bytes [0 .. 25-1] for the error code stored in this error memory slot" UBYTE EH_STANDARD_S5_S3 1 100 0 255 DISPLAY_IDENTIFIER ambient_condition[1][9].amb_cond.ydiMemory_xau16[2].ZFEH_EepromData ECU_ADDRESS 0xFFF828D2 /end MEASUREMENT
/begin MEASUREMENT ZFEH_EepromData.ydiMemory_xau16[2].amb_cond.ambient_condition[1][10] "ambient condition shot [0 .. 2-1] with 25 data bytes [0 .. 25-1] for the error code stored in this error memory slot" UBYTE EH_STANDARD_S5_S3 1 100 0 255 DISPLAY_IDENTIFIER ambient_condition[1][10].amb_cond.ydiMemory_xau16[2].ZFEH_EepromData ECU_ADDRESS 0xFFF828D3 /end MEASUREMENT
/begin MEASUREMENT ZFEH_EepromData.ydiMemory_xau16[2].amb_cond.ambient_condition[1][11] "ambient condition shot [0 .. 2-1] with 25 data bytes [0 .. 25-1] for the error code stored in this error memory slot" UBYTE EH_STANDARD_S5_S3 1 100 0 255 DISPLAY_IDENTIFIER ambient_condition[1][11].amb_cond.ydiMemory_xau16[2].ZFEH_EepromData ECU_ADDRESS 0xFFF828D4 /end MEASUREMENT
/begin MEASUREMENT ZFEH_EepromData.ydiMemory_xau16[2].amb_cond.ambient_condition[1][12] "ambient condition shot [0 .. 2-1] with 25 data bytes [0 .. 25-1] for the error code stored in this error memory slot" UBYTE EH_STANDARD_S5_S3 1 100 0 255 DISPLAY_IDENTIFIER ambient_condition[1][12].amb_cond.ydiMemory_xau16[2].ZFEH_EepromData ECU_ADDRESS 0xFFF828D5 /end MEASUREMENT
/begin MEASUREMENT ZFEH_EepromData.ydiMemory_xau16[2].amb_cond.ambient_condition[1][13] "ambient condition shot [0 .. 2-1] with 25 data bytes [0 .. 25-1] for the error code stored in this error memory slot" UBYTE EH_STANDARD_S5_S3 1 100 0 255 DISPLAY_IDENTIFIER ambient_condition[1][13].amb_cond.ydiMemory_xau16[2].ZFEH_EepromData ECU_ADDRESS 0xFFF828D6 /end MEASUREMENT
/begin MEASUREMENT ZFEH_EepromData.ydiMemory_xau16[2].amb_cond.ambient_condition[1][14] "ambient condition shot [0 .. 2-1] with 25 data bytes [0 .. 25-1] for the error code stored in this error memory slot" UBYTE EH_STANDARD_S5_S3 1 100 0 255 DISPLAY_IDENTIFIER ambient_condition[1][14].amb_cond.ydiMemory_xau16[2].ZFEH_EepromData ECU_ADDRESS 0xFFF828D7 /end MEASUREMENT
/begin MEASUREMENT ZFEH_EepromData.ydiMemory_xau16[2].amb_cond.ambient_condition[1][15] "ambient condition shot [0 .. 2-1] with 25 data bytes [0 .. 25-1] for the error code stored in this error memory slot" UBYTE EH_STANDARD_S5_S3 1 100 0 255 DISPLAY_IDENTIFIER ambient_condition[1][15].amb_cond.ydiMemory_xau16[2].ZFEH_EepromData ECU_ADDRESS 0xFFF828D8 /end MEASUREMENT
/begin MEASUREMENT ZFEH_EepromData.ydiMemory_xau16[2].amb_cond.ambient_condition[1][16] "ambient condition shot [0 .. 2-1] with 25 data bytes [0 .. 25-1] for the error code stored in this error memory slot" UBYTE EH_STANDARD_S5_S3 1 100 0 255 DISPLAY_IDENTIFIER ambient_condition[1][16].amb_cond.ydiMemory_xau16[2].ZFEH_EepromData ECU_ADDRESS 0xFFF828D9 /end MEASUREMENT
/begin MEASUREMENT ZFEH_EepromData.ydiMemory_xau16[2].amb_cond.ambient_condition[1][17] "ambient condition shot [0 .. 2-1] with 25 data bytes [0 .. 25-1] for the error code stored in this error memory slot" UBYTE EH_STANDARD_S5_S3 1 100 0 255 DISPLAY_IDENTIFIER ambient_condition[1][17].amb_cond.ydiMemory_xau16[2].ZFEH_EepromData ECU_ADDRESS 0xFFF828DA /end MEASUREMENT
/begin MEASUREMENT ZFEH_EepromData.ydiMemory_xau16[2].amb_cond.ambient_condition[1][18] "ambient condition shot [0 .. 2-1] with 25 data bytes [0 .. 25-1] for the error code stored in this error memory slot" UBYTE EH_STANDARD_S5_S3 1 100 0 255 DISPLAY_IDENTIFIER ambient_condition[1][18].amb_cond.ydiMemory_xau16[2].ZFEH_EepromData ECU_ADDRESS 0xFFF828DB /end MEASUREMENT
/begin MEASUREMENT ZFEH_EepromData.ydiMemory_xau16[2].amb_cond.ambient_condition[1][19] "ambient condition shot [0 .. 2-1] with 25 data bytes [0 .. 25-1] for the error code stored in this error memory slot" UBYTE EH_STANDARD_S5_S3 1 100 0 255 DISPLAY_IDENTIFIER ambient_condition[1][19].amb_cond.ydiMemory_xau16[2].ZFEH_EepromData ECU_ADDRESS 0xFFF828DC /end MEASUREMENT
/begin MEASUREMENT ZFEH_EepromData.ydiMemory_xau16[2].amb_cond.ambient_condition[1][20] "ambient condition shot [0 .. 2-1] with 25 data bytes [0 .. 25-1] for the error code stored in this error memory slot" UBYTE EH_STANDARD_S5_S3 1 100 0 255 DISPLAY_IDENTIFIER ambient_condition[1][20].amb_cond.ydiMemory_xau16[2].ZFEH_EepromData ECU_ADDRESS 0xFFF828DD /end MEASUREMENT
/begin MEASUREMENT ZFEH_EepromData.ydiMemory_xau16[2].amb_cond.ambient_condition[1][21] "ambient condition shot [0 .. 2-1] with 25 data bytes [0 .. 25-1] for the error code stored in this error memory slot" UBYTE EH_STANDARD_S5_S3 1 100 0 255 DISPLAY_IDENTIFIER ambient_condition[1][21].amb_cond.ydiMemory_xau16[2].ZFEH_EepromData ECU_ADDRESS 0xFFF828DE /end MEASUREMENT
/begin MEASUREMENT ZFEH_EepromData.ydiMemory_xau16[2].amb_cond.ambient_condition[1][22] "ambient condition shot [0 .. 2-1] with 25 data bytes [0 .. 25-1] for the error code stored in this error memory slot" UBYTE EH_STANDARD_S5_S3 1 100 0 255 DISPLAY_IDENTIFIER ambient_condition[1][22].amb_cond.ydiMemory_xau16[2].ZFEH_EepromData ECU_ADDRESS 0xFFF828DF /end MEASUREMENT
/begin MEASUREMENT ZFEH_EepromData.ydiMemory_xau16[2].amb_cond.ambient_condition[1][23] "ambient condition shot [0 .. 2-1] with 25 data bytes [0 .. 25-1] for the error code stored in this error memory slot" UBYTE EH_STANDARD_S5_S3 1 100 0 255 DISPLAY_IDENTIFIER ambient_condition[1][23].amb_cond.ydiMemory_xau16[2].ZFEH_EepromData ECU_ADDRESS 0xFFF828E0 /end MEASUREMENT
/begin MEASUREMENT ZFEH_EepromData.ydiMemory_xau16[2].amb_cond.ambient_condition[1][24] "ambient condition shot [0 .. 2-1] with 25 data bytes [0 .. 25-1] for the error code stored in this error memory slot" UBYTE EH_STANDARD_S5_S3 1 100 0 255 DISPLAY_IDENTIFIER ambient_condition[1][24].amb_cond.ydiMemory_xau16[2].ZFEH_EepromData ECU_ADDRESS 0xFFF828E1 /end MEASUREMENT
/begin MEASUREMENT ZFEH_EepromData.ydiMemory_xau16[2].amb_cond.status_of_ambient_conditions[0] "status of ambient condition shot x: 0=invalid 1=valid" UBYTE EH_STANDARD_S5_S3 1 100 0 1 DISPLAY_IDENTIFIER status_of_ambient_conditions[0].amb_cond.ydiMemory_xau16[2].ZFEH_EepromData ECU_ADDRESS 0xFFF828E2 /end MEASUREMENT
/begin MEASUREMENT ZFEH_EepromData.ydiMemory_xau16[2].amb_cond.status_of_ambient_conditions[1] "status of ambient condition shot x: 0=invalid 1=valid" UBYTE EH_STANDARD_S5_S3 1 100 0 1 DISPLAY_IDENTIFIER status_of_ambient_conditions[1].amb_cond.ydiMemory_xau16[2].ZFEH_EepromData ECU_ADDRESS 0xFFF828E3 /end MEASUREMENT
/begin MEASUREMENT ZFEH_EepromData.ydiMemory_xau16[2].error_code "error code stored in error memory slot" UWORD CONV_KFC_NAME 0 255 0 65535 DISPLAY_IDENTIFIER error_code.ydiMemory_xau16[2].ZFEH_EepromData ECU_ADDRESS 0xFFF8289C /end MEASUREMENT
/begin MEASUREMENT ZFEH_EepromData.ydiMemory_xau16[2].error_type "error type of error code stored in error memory slot" UWORD EH_STANDARD_S5_S3 1 100 0 65535 DISPLAY_IDENTIFIER error_type.ydiMemory_xau16[2].ZFEH_EepromData ECU_ADDRESS 0xFFF8289E /end MEASUREMENT
/begin MEASUREMENT ZFEH_EepromData.ydiMemory_xau16[2].status_word "status word of error code stored in error memory slot" UWORD EH_STANDARD_S5_S3 1 100 0 65535 DISPLAY_IDENTIFIER status_word.ydiMemory_xau16[2].ZFEH_EepromData ECU_ADDRESS 0xFFF828A0 /end MEASUREMENT
/begin MEASUREMENT ZFEH_EepromData.ydiMemory_xau16[2].frequency_counter "frequency counter of error code stored in error memory slot" UBYTE EH_STANDARD_S5_S3 1 100 0 255 DISPLAY_IDENTIFIER frequency_counter.ydiMemory_xau16[2].ZFEH_EepromData ECU_ADDRESS 0xFFF828A2 /end MEASUREMENT
/begin MEASUREMENT ZFEH_EepromData.ydiMemory_xau16[2].backwards_counter "backwards counter of error code stored in error memory slot" UBYTE EH_STANDARD_S5_S3 1 100 0 255 DISPLAY_IDENTIFIER backwards_counter.ydiMemory_xau16[2].ZFEH_EepromData ECU_ADDRESS 0xFFF828A3 /end MEASUREMENT
/begin MEASUREMENT ZFEH_EepromData.ydiMemory_xau16[2].permanent_counter "counter of permanent error codes stored in error memory slot" UBYTE EH_STANDARD_S5_S3 1 100 0 255 DISPLAY_IDENTIFIER permanent_counter.ydiMemory_xau16[2].ZFEH_EepromData ECU_ADDRESS 0xFFF828A4 /end MEASUREMENT
/begin MEASUREMENT ZFEH_EepromData.ydiMemory_xau16[2].sequence_counter "sequence counter of error code stored in error memory slot" UBYTE EH_STANDARD_S5_S3 1 100 0 255 DISPLAY_IDENTIFIER sequence_counter.ydiMemory_xau16[2].ZFEH_EepromData ECU_ADDRESS 0xFFF828A5 /end MEASUREMENT
/begin MEASUREMENT ZFEH_EepromData.ydiMemory_xau16[2].master_time "master time of error code stored in error memory slot" ULONG EH_STANDARD_S5_S3 1 100 0 4294967295 DISPLAY_IDENTIFIER master_time.ydiMemory_xau16[2].ZFEH_EepromData ECU_ADDRESS 0xFFF828A8 /end MEASUREMENT
/begin MEASUREMENT ZFEH_EepromData.ydiMemory_xau16[2].condition_byte "condition byte of error code stored in error memory slot" UBYTE EH_STANDARD_S5_S3 1 100 0 255 DISPLAY_IDENTIFIER condition_byte.ydiMemory_xau16[2].ZFEH_EepromData ECU_ADDRESS 0xFFF828AD /end MEASUREMENT
/begin MEASUREMENT ZFEH_EepromData.ydiMemory_xau16[2].obd_driving_cycle_counter "obd driving cycle counter of error code stored in error memory slot" UWORD EH_STANDARD_S5_S3 1 100 0 65535 DISPLAY_IDENTIFIER obd_driving_cycle_counter.ydiMemory_xau16[2].ZFEH_EepromData ECU_ADDRESS 0xFFF828AE /end MEASUREMENT
/begin MEASUREMENT ZFEH_EepromData.ydiMemory_xau16[3].amb_cond.ambient_condition[0][0] "ambient condition shot [0 .. 2-1] with 25 data bytes [0 .. 25-1] for the error code stored in this error memory slot" UBYTE EH_STANDARD_S5_S3 1 100 0 255 DISPLAY_IDENTIFIER ambient_condition[0][0].amb_cond.ydiMemory_xau16[3].ZFEH_EepromData ECU_ADDRESS 0xFFF828F8 /end MEASUREMENT
/begin MEASUREMENT ZFEH_EepromData.ydiMemory_xau16[3].amb_cond.ambient_condition[0][1] "ambient condition shot [0 .. 2-1] with 25 data bytes [0 .. 25-1] for the error code stored in this error memory slot" UBYTE EH_STANDARD_S5_S3 1 100 0 255 DISPLAY_IDENTIFIER ambient_condition[0][1].amb_cond.ydiMemory_xau16[3].ZFEH_EepromData ECU_ADDRESS 0xFFF828F9 /end MEASUREMENT
/begin MEASUREMENT ZFEH_EepromData.ydiMemory_xau16[3].amb_cond.ambient_condition[0][2] "ambient condition shot [0 .. 2-1] with 25 data bytes [0 .. 25-1] for the error code stored in this error memory slot" UBYTE EH_STANDARD_S5_S3 1 100 0 255 DISPLAY_IDENTIFIER ambient_condition[0][2].amb_cond.ydiMemory_xau16[3].ZFEH_EepromData ECU_ADDRESS 0xFFF828FA /end MEASUREMENT
/begin MEASUREMENT ZFEH_EepromData.ydiMemory_xau16[3].amb_cond.ambient_condition[0][3] "ambient condition shot [0 .. 2-1] with 25 data bytes [0 .. 25-1] for the error code stored in this error memory slot" UBYTE EH_STANDARD_S5_S3 1 100 0 255 DISPLAY_IDENTIFIER ambient_condition[0][3].amb_cond.ydiMemory_xau16[3].ZFEH_EepromData ECU_ADDRESS 0xFFF828FB /end MEASUREMENT
/begin MEASUREMENT ZFEH_EepromData.ydiMemory_xau16[3].amb_cond.ambient_condition[0][4] "ambient condition shot [0 .. 2-1] with 25 data bytes [0 .. 25-1] for the error code stored in this error memory slot" UBYTE EH_STANDARD_S5_S3 1 100 0 255 DISPLAY_IDENTIFIER ambient_condition[0][4].amb_cond.ydiMemory_xau16[3].ZFEH_EepromData ECU_ADDRESS 0xFFF828FC /end MEASUREMENT
/begin MEASUREMENT ZFEH_EepromData.ydiMemory_xau16[3].amb_cond.ambient_condition[0][5] "ambient condition shot [0 .. 2-1] with 25 data bytes [0 .. 25-1] for the error code stored in this error memory slot" UBYTE EH_STANDARD_S5_S3 1 100 0 255 DISPLAY_IDENTIFIER ambient_condition[0][5].amb_cond.ydiMemory_xau16[3].ZFEH_EepromData ECU_ADDRESS 0xFFF828FD /end MEASUREMENT
/begin MEASUREMENT ZFEH_EepromData.ydiMemory_xau16[3].amb_cond.ambient_condition[0][6] "ambient condition shot [0 .. 2-1] with 25 data bytes [0 .. 25-1] for the error code stored in this error memory slot" UBYTE EH_STANDARD_S5_S3 1 100 0 255 DISPLAY_IDENTIFIER ambient_condition[0][6].amb_cond.ydiMemory_xau16[3].ZFEH_EepromData ECU_ADDRESS 0xFFF828FE /end MEASUREMENT
/begin MEASUREMENT ZFEH_EepromData.ydiMemory_xau16[3].amb_cond.ambient_condition[0][7] "ambient condition shot [0 .. 2-1] with 25 data bytes [0 .. 25-1] for the error code stored in this error memory slot" UBYTE EH_STANDARD_S5_S3 1 100 0 255 DISPLAY_IDENTIFIER ambient_condition[0][7].amb_cond.ydiMemory_xau16[3].ZFEH_EepromData ECU_ADDRESS 0xFFF828FF /end MEASUREMENT
/begin MEASUREMENT ZFEH_EepromData.ydiMemory_xau16[3].amb_cond.ambient_condition[0][8] "ambient condition shot [0 .. 2-1] with 25 data bytes [0 .. 25-1] for the error code stored in this error memory slot" UBYTE EH_STANDARD_S5_S3 1 100 0 255 DISPLAY_IDENTIFIER ambient_condition[0][8].amb_cond.ydiMemory_xau16[3].ZFEH_EepromData ECU_ADDRESS 0xFFF82900 /end MEASUREMENT
/begin MEASUREMENT ZFEH_EepromData.ydiMemory_xau16[3].amb_cond.ambient_condition[0][9] "ambient condition shot [0 .. 2-1] with 25 data bytes [0 .. 25-1] for the error code stored in this error memory slot" UBYTE EH_STANDARD_S5_S3 1 100 0 255 DISPLAY_IDENTIFIER ambient_condition[0][9].amb_cond.ydiMemory_xau16[3].ZFEH_EepromData ECU_ADDRESS 0xFFF82901 /end MEASUREMENT
/begin MEASUREMENT ZFEH_EepromData.ydiMemory_xau16[3].amb_cond.ambient_condition[0][10] "ambient condition shot [0 .. 2-1] with 25 data bytes [0 .. 25-1] for the error code stored in this error memory slot" UBYTE EH_STANDARD_S5_S3 1 100 0 255 DISPLAY_IDENTIFIER ambient_condition[0][10].amb_cond.ydiMemory_xau16[3].ZFEH_EepromData ECU_ADDRESS 0xFFF82902 /end MEASUREMENT
/begin MEASUREMENT ZFEH_EepromData.ydiMemory_xau16[3].amb_cond.ambient_condition[0][11] "ambient condition shot [0 .. 2-1] with 25 data bytes [0 .. 25-1] for the error code stored in this error memory slot" UBYTE EH_STANDARD_S5_S3 1 100 0 255 DISPLAY_IDENTIFIER ambient_condition[0][11].amb_cond.ydiMemory_xau16[3].ZFEH_EepromData ECU_ADDRESS 0xFFF82903 /end MEASUREMENT
/begin MEASUREMENT ZFEH_EepromData.ydiMemory_xau16[3].amb_cond.ambient_condition[0][12] "ambient condition shot [0 .. 2-1] with 25 data bytes [0 .. 25-1] for the error code stored in this error memory slot" UBYTE EH_STANDARD_S5_S3 1 100 0 255 DISPLAY_IDENTIFIER ambient_condition[0][12].amb_cond.ydiMemory_xau16[3].ZFEH_EepromData ECU_ADDRESS 0xFFF82904 /end MEASUREMENT
/begin MEASUREMENT ZFEH_EepromData.ydiMemory_xau16[3].amb_cond.ambient_condition[0][13] "ambient condition shot [0 .. 2-1] with 25 data bytes [0 .. 25-1] for the error code stored in this error memory slot" UBYTE EH_STANDARD_S5_S3 1 100 0 255 DISPLAY_IDENTIFIER ambient_condition[0][13].amb_cond.ydiMemory_xau16[3].ZFEH_EepromData ECU_ADDRESS 0xFFF82905 /end MEASUREMENT
/begin MEASUREMENT ZFEH_EepromData.ydiMemory_xau16[3].amb_cond.ambient_condition[0][14] "ambient condition shot [0 .. 2-1] with 25 data bytes [0 .. 25-1] for the error code stored in this error memory slot" UBYTE EH_STANDARD_S5_S3 1 100 0 255 DISPLAY_IDENTIFIER ambient_condition[0][14].amb_cond.ydiMemory_xau16[3].ZFEH_EepromData ECU_ADDRESS 0xFFF82906 /end MEASUREMENT
/begin MEASUREMENT ZFEH_EepromData.ydiMemory_xau16[3].amb_cond.ambient_condition[0][15] "ambient condition shot [0 .. 2-1] with 25 data bytes [0 .. 25-1] for the error code stored in this error memory slot" UBYTE EH_STANDARD_S5_S3 1 100 0 255 DISPLAY_IDENTIFIER ambient_condition[0][15].amb_cond.ydiMemory_xau16[3].ZFEH_EepromData ECU_ADDRESS 0xFFF82907 /end MEASUREMENT
/begin MEASUREMENT ZFEH_EepromData.ydiMemory_xau16[3].amb_cond.ambient_condition[0][16] "ambient condition shot [0 .. 2-1] with 25 data bytes [0 .. 25-1] for the error code stored in this error memory slot" UBYTE EH_STANDARD_S5_S3 1 100 0 255 DISPLAY_IDENTIFIER ambient_condition[0][16].amb_cond.ydiMemory_xau16[3].ZFEH_EepromData ECU_ADDRESS 0xFFF82908 /end MEASUREMENT
/begin MEASUREMENT ZFEH_EepromData.ydiMemory_xau16[3].amb_cond.ambient_condition[0][17] "ambient condition shot [0 .. 2-1] with 25 data bytes [0 .. 25-1] for the error code stored in this error memory slot" UBYTE EH_STANDARD_S5_S3 1 100 0 255 DISPLAY_IDENTIFIER ambient_condition[0][17].amb_cond.ydiMemory_xau16[3].ZFEH_EepromData ECU_ADDRESS 0xFFF82909 /end MEASUREMENT
/begin MEASUREMENT ZFEH_EepromData.ydiMemory_xau16[3].amb_cond.ambient_condition[0][18] "ambient condition shot [0 .. 2-1] with 25 data bytes [0 .. 25-1] for the error code stored in this error memory slot" UBYTE EH_STANDARD_S5_S3 1 100 0 255 DISPLAY_IDENTIFIER ambient_condition[0][18].amb_cond.ydiMemory_xau16[3].ZFEH_EepromData ECU_ADDRESS 0xFFF8290A /end MEASUREMENT
/begin MEASUREMENT ZFEH_EepromData.ydiMemory_xau16[3].amb_cond.ambient_condition[0][19] "ambient condition shot [0 .. 2-1] with 25 data bytes [0 .. 25-1] for the error code stored in this error memory slot" UBYTE EH_STANDARD_S5_S3 1 100 0 255 DISPLAY_IDENTIFIER ambient_condition[0][19].amb_cond.ydiMemory_xau16[3].ZFEH_EepromData ECU_ADDRESS 0xFFF8290B /end MEASUREMENT
/begin MEASUREMENT ZFEH_EepromData.ydiMemory_xau16[3].amb_cond.ambient_condition[0][20] "ambient condition shot [0 .. 2-1] with 25 data bytes [0 .. 25-1] for the error code stored in this error memory slot" UBYTE EH_STANDARD_S5_S3 1 100 0 255 DISPLAY_IDENTIFIER ambient_condition[0][20].amb_cond.ydiMemory_xau16[3].ZFEH_EepromData ECU_ADDRESS 0xFFF8290C /end MEASUREMENT
/begin MEASUREMENT ZFEH_EepromData.ydiMemory_xau16[3].amb_cond.ambient_condition[0][21] "ambient condition shot [0 .. 2-1] with 25 data bytes [0 .. 25-1] for the error code stored in this error memory slot" UBYTE EH_STANDARD_S5_S3 1 100 0 255 DISPLAY_IDENTIFIER ambient_condition[0][21].amb_cond.ydiMemory_xau16[3].ZFEH_EepromData ECU_ADDRESS 0xFFF8290D /end MEASUREMENT
/begin MEASUREMENT ZFEH_EepromData.ydiMemory_xau16[3].amb_cond.ambient_condition[0][22] "ambient condition shot [0 .. 2-1] with 25 data bytes [0 .. 25-1] for the error code stored in this error memory slot" UBYTE EH_STANDARD_S5_S3 1 100 0 255 DISPLAY_IDENTIFIER ambient_condition[0][22].amb_cond.ydiMemory_xau16[3].ZFEH_EepromData ECU_ADDRESS 0xFFF8290E /end MEASUREMENT
/begin MEASUREMENT ZFEH_EepromData.ydiMemory_xau16[3].amb_cond.ambient_condition[0][23] "ambient condition shot [0 .. 2-1] with 25 data bytes [0 .. 25-1] for the error code stored in this error memory slot" UBYTE EH_STANDARD_S5_S3 1 100 0 255 DISPLAY_IDENTIFIER ambient_condition[0][23].amb_cond.ydiMemory_xau16[3].ZFEH_EepromData ECU_ADDRESS 0xFFF8290F /end MEASUREMENT
/begin MEASUREMENT ZFEH_EepromData.ydiMemory_xau16[3].amb_cond.ambient_condition[0][24] "ambient condition shot [0 .. 2-1] with 25 data bytes [0 .. 25-1] for the error code stored in this error memory slot" UBYTE EH_STANDARD_S5_S3 1 100 0 255 DISPLAY_IDENTIFIER ambient_condition[0][24].amb_cond.ydiMemory_xau16[3].ZFEH_EepromData ECU_ADDRESS 0xFFF82910 /end MEASUREMENT
/begin MEASUREMENT ZFEH_EepromData.ydiMemory_xau16[3].amb_cond.ambient_condition[1][0] "ambient condition shot [0 .. 2-1] with 25 data bytes [0 .. 25-1] for the error code stored in this error memory slot" UBYTE EH_STANDARD_S5_S3 1 100 0 255 DISPLAY_IDENTIFIER ambient_condition[1][0].amb_cond.ydiMemory_xau16[3].ZFEH_EepromData ECU_ADDRESS 0xFFF82911 /end MEASUREMENT
/begin MEASUREMENT ZFEH_EepromData.ydiMemory_xau16[3].amb_cond.ambient_condition[1][1] "ambient condition shot [0 .. 2-1] with 25 data bytes [0 .. 25-1] for the error code stored in this error memory slot" UBYTE EH_STANDARD_S5_S3 1 100 0 255 DISPLAY_IDENTIFIER ambient_condition[1][1].amb_cond.ydiMemory_xau16[3].ZFEH_EepromData ECU_ADDRESS 0xFFF82912 /end MEASUREMENT
/begin MEASUREMENT ZFEH_EepromData.ydiMemory_xau16[3].amb_cond.ambient_condition[1][2] "ambient condition shot [0 .. 2-1] with 25 data bytes [0 .. 25-1] for the error code stored in this error memory slot" UBYTE EH_STANDARD_S5_S3 1 100 0 255 DISPLAY_IDENTIFIER ambient_condition[1][2].amb_cond.ydiMemory_xau16[3].ZFEH_EepromData ECU_ADDRESS 0xFFF82913 /end MEASUREMENT
/begin MEASUREMENT ZFEH_EepromData.ydiMemory_xau16[3].amb_cond.ambient_condition[1][3] "ambient condition shot [0 .. 2-1] with 25 data bytes [0 .. 25-1] for the error code stored in this error memory slot" UBYTE EH_STANDARD_S5_S3 1 100 0 255 DISPLAY_IDENTIFIER ambient_condition[1][3].amb_cond.ydiMemory_xau16[3].ZFEH_EepromData ECU_ADDRESS 0xFFF82914 /end MEASUREMENT
/begin MEASUREMENT ZFEH_EepromData.ydiMemory_xau16[3].amb_cond.ambient_condition[1][4] "ambient condition shot [0 .. 2-1] with 25 data bytes [0 .. 25-1] for the error code stored in this error memory slot" UBYTE EH_STANDARD_S5_S3 1 100 0 255 DISPLAY_IDENTIFIER ambient_condition[1][4].amb_cond.ydiMemory_xau16[3].ZFEH_EepromData ECU_ADDRESS 0xFFF82915 /end MEASUREMENT
/begin MEASUREMENT ZFEH_EepromData.ydiMemory_xau16[3].amb_cond.ambient_condition[1][5] "ambient condition shot [0 .. 2-1] with 25 data bytes [0 .. 25-1] for the error code stored in this error memory slot" UBYTE EH_STANDARD_S5_S3 1 100 0 255 DISPLAY_IDENTIFIER ambient_condition[1][5].amb_cond.ydiMemory_xau16[3].ZFEH_EepromData ECU_ADDRESS 0xFFF82916 /end MEASUREMENT
/begin MEASUREMENT ZFEH_EepromData.ydiMemory_xau16[3].amb_cond.ambient_condition[1][6] "ambient condition shot [0 .. 2-1] with 25 data bytes [0 .. 25-1] for the error code stored in this error memory slot" UBYTE EH_STANDARD_S5_S3 1 100 0 255 DISPLAY_IDENTIFIER ambient_condition[1][6].amb_cond.ydiMemory_xau16[3].ZFEH_EepromData ECU_ADDRESS 0xFFF82917 /end MEASUREMENT
/begin MEASUREMENT ZFEH_EepromData.ydiMemory_xau16[3].amb_cond.ambient_condition[1][7] "ambient condition shot [0 .. 2-1] with 25 data bytes [0 .. 25-1] for the error code stored in this error memory slot" UBYTE EH_STANDARD_S5_S3 1 100 0 255 DISPLAY_IDENTIFIER ambient_condition[1][7].amb_cond.ydiMemory_xau16[3].ZFEH_EepromData ECU_ADDRESS 0xFFF82918 /end MEASUREMENT
/begin MEASUREMENT ZFEH_EepromData.ydiMemory_xau16[3].amb_cond.ambient_condition[1][8] "ambient condition shot [0 .. 2-1] with 25 data bytes [0 .. 25-1] for the error code stored in this error memory slot" UBYTE EH_STANDARD_S5_S3 1 100 0 255 DISPLAY_IDENTIFIER ambient_condition[1][8].amb_cond.ydiMemory_xau16[3].ZFEH_EepromData ECU_ADDRESS 0xFFF82919 /end MEASUREMENT
/begin MEASUREMENT ZFEH_EepromData.ydiMemory_xau16[3].amb_cond.ambient_condition[1][9] "ambient condition shot [0 .. 2-1] with 25 data bytes [0 .. 25-1] for the error code stored in this error memory slot" UBYTE EH_STANDARD_S5_S3 1 100 0 255 DISPLAY_IDENTIFIER ambient_condition[1][9].amb_cond.ydiMemory_xau16[3].ZFEH_EepromData ECU_ADDRESS 0xFFF8291A /end MEASUREMENT
/begin MEASUREMENT ZFEH_EepromData.ydiMemory_xau16[3].amb_cond.ambient_condition[1][10] "ambient condition shot [0 .. 2-1] with 25 data bytes [0 .. 25-1] for the error code stored in this error memory slot" UBYTE EH_STANDARD_S5_S3 1 100 0 255 DISPLAY_IDENTIFIER ambient_condition[1][10].amb_cond.ydiMemory_xau16[3].ZFEH_EepromData ECU_ADDRESS 0xFFF8291B /end MEASUREMENT
/begin MEASUREMENT ZFEH_EepromData.ydiMemory_xau16[3].amb_cond.ambient_condition[1][11] "ambient condition shot [0 .. 2-1] with 25 data bytes [0 .. 25-1] for the error code stored in this error memory slot" UBYTE EH_STANDARD_S5_S3 1 100 0 255 DISPLAY_IDENTIFIER ambient_condition[1][11].amb_cond.ydiMemory_xau16[3].ZFEH_EepromData ECU_ADDRESS 0xFFF8291C /end MEASUREMENT
/begin MEASUREMENT ZFEH_EepromData.ydiMemory_xau16[3].amb_cond.ambient_condition[1][12] "ambient condition shot [0 .. 2-1] with 25 data bytes [0 .. 25-1] for the error code stored in this error memory slot" UBYTE EH_STANDARD_S5_S3 1 100 0 255 DISPLAY_IDENTIFIER ambient_condition[1][12].amb_cond.ydiMemory_xau16[3].ZFEH_EepromData ECU_ADDRESS 0xFFF8291D /end MEASUREMENT
/begin MEASUREMENT ZFEH_EepromData.ydiMemory_xau16[3].amb_cond.ambient_condition[1][13] "ambient condition shot [0 .. 2-1] with 25 data bytes [0 .. 25-1] for the error code stored in this error memory slot" UBYTE EH_STANDARD_S5_S3 1 100 0 255 DISPLAY_IDENTIFIER ambient_condition[1][13].amb_cond.ydiMemory_xau16[3].ZFEH_EepromData ECU_ADDRESS 0xFFF8291E /end MEASUREMENT
/begin MEASUREMENT ZFEH_EepromData.ydiMemory_xau16[3].amb_cond.ambient_condition[1][14] "ambient condition shot [0 .. 2-1] with 25 data bytes [0 .. 25-1] for the error code stored in this error memory slot" UBYTE EH_STANDARD_S5_S3 1 100 0 255 DISPLAY_IDENTIFIER ambient_condition[1][14].amb_cond.ydiMemory_xau16[3].ZFEH_EepromData ECU_ADDRESS 0xFFF8291F /end MEASUREMENT
/begin MEASUREMENT ZFEH_EepromData.ydiMemory_xau16[3].amb_cond.ambient_condition[1][15] "ambient condition shot [0 .. 2-1] with 25 data bytes [0 .. 25-1] for the error code stored in this error memory slot" UBYTE EH_STANDARD_S5_S3 1 100 0 255 DISPLAY_IDENTIFIER ambient_condition[1][15].amb_cond.ydiMemory_xau16[3].ZFEH_EepromData ECU_ADDRESS 0xFFF82920 /end MEASUREMENT
/begin MEASUREMENT ZFEH_EepromData.ydiMemory_xau16[3].amb_cond.ambient_condition[1][16] "ambient condition shot [0 .. 2-1] with 25 data bytes [0 .. 25-1] for the error code stored in this error memory slot" UBYTE EH_STANDARD_S5_S3 1 100 0 255 DISPLAY_IDENTIFIER ambient_condition[1][16].amb_cond.ydiMemory_xau16[3].ZFEH_EepromData ECU_ADDRESS 0xFFF82921 /end MEASUREMENT
/begin MEASUREMENT ZFEH_EepromData.ydiMemory_xau16[3].amb_cond.ambient_condition[1][17] "ambient condition shot [0 .. 2-1] with 25 data bytes [0 .. 25-1] for the error code stored in this error memory slot" UBYTE EH_STANDARD_S5_S3 1 100 0 255 DISPLAY_IDENTIFIER ambient_condition[1][17].amb_cond.ydiMemory_xau16[3].ZFEH_EepromData ECU_ADDRESS 0xFFF82922 /end MEASUREMENT
/begin MEASUREMENT ZFEH_EepromData.ydiMemory_xau16[3].amb_cond.ambient_condition[1][18] "ambient condition shot [0 .. 2-1] with 25 data bytes [0 .. 25-1] for the error code stored in this error memory slot" UBYTE EH_STANDARD_S5_S3 1 100 0 255 DISPLAY_IDENTIFIER ambient_condition[1][18].amb_cond.ydiMemory_xau16[3].ZFEH_EepromData ECU_ADDRESS 0xFFF82923 /end MEASUREMENT
/begin MEASUREMENT ZFEH_EepromData.ydiMemory_xau16[3].amb_cond.ambient_condition[1][19] "ambient condition shot [0 .. 2-1] with 25 data bytes [0 .. 25-1] for the error code stored in this error memory slot" UBYTE EH_STANDARD_S5_S3 1 100 0 255 DISPLAY_IDENTIFIER ambient_condition[1][19].amb_cond.ydiMemory_xau16[3].ZFEH_EepromData ECU_ADDRESS 0xFFF82924 /end MEASUREMENT
/begin MEASUREMENT ZFEH_EepromData.ydiMemory_xau16[3].amb_cond.ambient_condition[1][20] "ambient condition shot [0 .. 2-1] with 25 data bytes [0 .. 25-1] for the error code stored in this error memory slot" UBYTE EH_STANDARD_S5_S3 1 100 0 255 DISPLAY_IDENTIFIER ambient_condition[1][20].amb_cond.ydiMemory_xau16[3].ZFEH_EepromData ECU_ADDRESS 0xFFF82925 /end MEASUREMENT
/begin MEASUREMENT ZFEH_EepromData.ydiMemory_xau16[3].amb_cond.ambient_condition[1][21] "ambient condition shot [0 .. 2-1] with 25 data bytes [0 .. 25-1] for the error code stored in this error memory slot" UBYTE EH_STANDARD_S5_S3 1 100 0 255 DISPLAY_IDENTIFIER ambient_condition[1][21].amb_cond.ydiMemory_xau16[3].ZFEH_EepromData ECU_ADDRESS 0xFFF82926 /end MEASUREMENT
/begin MEASUREMENT ZFEH_EepromData.ydiMemory_xau16[3].amb_cond.ambient_condition[1][22] "ambient condition shot [0 .. 2-1] with 25 data bytes [0 .. 25-1] for the error code stored in this error memory slot" UBYTE EH_STANDARD_S5_S3 1 100 0 255 DISPLAY_IDENTIFIER ambient_condition[1][22].amb_cond.ydiMemory_xau16[3].ZFEH_EepromData ECU_ADDRESS 0xFFF82927 /end MEASUREMENT
/begin MEASUREMENT ZFEH_EepromData.ydiMemory_xau16[3].amb_cond.ambient_condition[1][23] "ambient condition shot [0 .. 2-1] with 25 data bytes [0 .. 25-1] for the error code stored in this error memory slot" UBYTE EH_STANDARD_S5_S3 1 100 0 255 DISPLAY_IDENTIFIER ambient_condition[1][23].amb_cond.ydiMemory_xau16[3].ZFEH_EepromData ECU_ADDRESS 0xFFF82928 /end MEASUREMENT
/begin MEASUREMENT ZFEH_EepromData.ydiMemory_xau16[3].amb_cond.ambient_condition[1][24] "ambient condition shot [0 .. 2-1] with 25 data bytes [0 .. 25-1] for the error code stored in this error memory slot" UBYTE EH_STANDARD_S5_S3 1 100 0 255 DISPLAY_IDENTIFIER ambient_condition[1][24].amb_cond.ydiMemory_xau16[3].ZFEH_EepromData ECU_ADDRESS 0xFFF82929 /end MEASUREMENT
/begin MEASUREMENT ZFEH_EepromData.ydiMemory_xau16[3].amb_cond.status_of_ambient_conditions[0] "status of ambient condition shot x: 0=invalid 1=valid" UBYTE EH_STANDARD_S5_S3 1 100 0 1 DISPLAY_IDENTIFIER status_of_ambient_conditions[0].amb_cond.ydiMemory_xau16[3].ZFEH_EepromData ECU_ADDRESS 0xFFF8292A /end MEASUREMENT
/begin MEASUREMENT ZFEH_EepromData.ydiMemory_xau16[3].amb_cond.status_of_ambient_conditions[1] "status of ambient condition shot x: 0=invalid 1=valid" UBYTE EH_STANDARD_S5_S3 1 100 0 1 DISPLAY_IDENTIFIER status_of_ambient_conditions[1].amb_cond.ydiMemory_xau16[3].ZFEH_EepromData ECU_ADDRESS 0xFFF8292B /end MEASUREMENT
/begin MEASUREMENT ZFEH_EepromData.ydiMemory_xau16[3].error_code "error code stored in error memory slot" UWORD CONV_KFC_NAME 0 255 0 65535 DISPLAY_IDENTIFIER error_code.ydiMemory_xau16[3].ZFEH_EepromData ECU_ADDRESS 0xFFF828E4 /end MEASUREMENT
/begin MEASUREMENT ZFEH_EepromData.ydiMemory_xau16[3].error_type "error type of error code stored in error memory slot" UWORD EH_STANDARD_S5_S3 1 100 0 65535 DISPLAY_IDENTIFIER error_type.ydiMemory_xau16[3].ZFEH_EepromData ECU_ADDRESS 0xFFF828E6 /end MEASUREMENT
/begin MEASUREMENT ZFEH_EepromData.ydiMemory_xau16[3].status_word "status word of error code stored in error memory slot" UWORD EH_STANDARD_S5_S3 1 100 0 65535 DISPLAY_IDENTIFIER status_word.ydiMemory_xau16[3].ZFEH_EepromData ECU_ADDRESS 0xFFF828E8 /end MEASUREMENT
/begin MEASUREMENT ZFEH_EepromData.ydiMemory_xau16[3].frequency_counter "frequency counter of error code stored in error memory slot" UBYTE EH_STANDARD_S5_S3 1 100 0 255 DISPLAY_IDENTIFIER frequency_counter.ydiMemory_xau16[3].ZFEH_EepromData ECU_ADDRESS 0xFFF828EA /end MEASUREMENT
/begin MEASUREMENT ZFEH_EepromData.ydiMemory_xau16[3].backwards_counter "backwards counter of error code stored in error memory slot" UBYTE EH_STANDARD_S5_S3 1 100 0 255 DISPLAY_IDENTIFIER backwards_counter.ydiMemory_xau16[3].ZFEH_EepromData ECU_ADDRESS 0xFFF828EB /end MEASUREMENT
/begin MEASUREMENT ZFEH_EepromData.ydiMemory_xau16[3].permanent_counter "counter of permanent error codes stored in error memory slot" UBYTE EH_STANDARD_S5_S3 1 100 0 255 DISPLAY_IDENTIFIER permanent_counter.ydiMemory_xau16[3].ZFEH_EepromData ECU_ADDRESS 0xFFF828EC /end MEASUREMENT
/begin MEASUREMENT ZFEH_EepromData.ydiMemory_xau16[3].sequence_counter "sequence counter of error code stored in error memory slot" UBYTE EH_STANDARD_S5_S3 1 100 0 255 DISPLAY_IDENTIFIER sequence_counter.ydiMemory_xau16[3].ZFEH_EepromData ECU_ADDRESS 0xFFF828ED /end MEASUREMENT
/begin MEASUREMENT ZFEH_EepromData.ydiMemory_xau16[3].master_time "master time of error code stored in error memory slot" ULONG EH_STANDARD_S5_S3 1 100 0 4294967295 DISPLAY_IDENTIFIER master_time.ydiMemory_xau16[3].ZFEH_EepromData ECU_ADDRESS 0xFFF828F0 /end MEASUREMENT
/begin MEASUREMENT ZFEH_EepromData.ydiMemory_xau16[3].condition_byte "condition byte of error code stored in error memory slot" UBYTE EH_STANDARD_S5_S3 1 100 0 255 DISPLAY_IDENTIFIER condition_byte.ydiMemory_xau16[3].ZFEH_EepromData ECU_ADDRESS 0xFFF828F5 /end MEASUREMENT
/begin MEASUREMENT ZFEH_EepromData.ydiMemory_xau16[3].obd_driving_cycle_counter "obd driving cycle counter of error code stored in error memory slot" UWORD EH_STANDARD_S5_S3 1 100 0 65535 DISPLAY_IDENTIFIER obd_driving_cycle_counter.ydiMemory_xau16[3].ZFEH_EepromData ECU_ADDRESS 0xFFF828F6 /end MEASUREMENT
/begin MEASUREMENT ZFEH_EepromData.ydiMemory_xau16[4].amb_cond.ambient_condition[0][0] "ambient condition shot [0 .. 2-1] with 25 data bytes [0 .. 25-1] for the error code stored in this error memory slot" UBYTE EH_STANDARD_S5_S3 1 100 0 255 DISPLAY_IDENTIFIER ambient_condition[0][0].amb_cond.ydiMemory_xau16[4].ZFEH_EepromData ECU_ADDRESS 0xFFF82940 /end MEASUREMENT
/begin MEASUREMENT ZFEH_EepromData.ydiMemory_xau16[4].amb_cond.ambient_condition[0][1] "ambient condition shot [0 .. 2-1] with 25 data bytes [0 .. 25-1] for the error code stored in this error memory slot" UBYTE EH_STANDARD_S5_S3 1 100 0 255 DISPLAY_IDENTIFIER ambient_condition[0][1].amb_cond.ydiMemory_xau16[4].ZFEH_EepromData ECU_ADDRESS 0xFFF82941 /end MEASUREMENT
/begin MEASUREMENT ZFEH_EepromData.ydiMemory_xau16[4].amb_cond.ambient_condition[0][2] "ambient condition shot [0 .. 2-1] with 25 data bytes [0 .. 25-1] for the error code stored in this error memory slot" UBYTE EH_STANDARD_S5_S3 1 100 0 255 DISPLAY_IDENTIFIER ambient_condition[0][2].amb_cond.ydiMemory_xau16[4].ZFEH_EepromData ECU_ADDRESS 0xFFF82942 /end MEASUREMENT
/begin MEASUREMENT ZFEH_EepromData.ydiMemory_xau16[4].amb_cond.ambient_condition[0][3] "ambient condition shot [0 .. 2-1] with 25 data bytes [0 .. 25-1] for the error code stored in this error memory slot" UBYTE EH_STANDARD_S5_S3 1 100 0 255 DISPLAY_IDENTIFIER ambient_condition[0][3].amb_cond.ydiMemory_xau16[4].ZFEH_EepromData ECU_ADDRESS 0xFFF82943 /end MEASUREMENT
/begin MEASUREMENT ZFEH_EepromData.ydiMemory_xau16[4].amb_cond.ambient_condition[0][4] "ambient condition shot [0 .. 2-1] with 25 data bytes [0 .. 25-1] for the error code stored in this error memory slot" UBYTE EH_STANDARD_S5_S3 1 100 0 255 DISPLAY_IDENTIFIER ambient_condition[0][4].amb_cond.ydiMemory_xau16[4].ZFEH_EepromData ECU_ADDRESS 0xFFF82944 /end MEASUREMENT
/begin MEASUREMENT ZFEH_EepromData.ydiMemory_xau16[4].amb_cond.ambient_condition[0][5] "ambient condition shot [0 .. 2-1] with 25 data bytes [0 .. 25-1] for the error code stored in this error memory slot" UBYTE EH_STANDARD_S5_S3 1 100 0 255 DISPLAY_IDENTIFIER ambient_condition[0][5].amb_cond.ydiMemory_xau16[4].ZFEH_EepromData ECU_ADDRESS 0xFFF82945 /end MEASUREMENT
/begin MEASUREMENT ZFEH_EepromData.ydiMemory_xau16[4].amb_cond.ambient_condition[0][6] "ambient condition shot [0 .. 2-1] with 25 data bytes [0 .. 25-1] for the error code stored in this error memory slot" UBYTE EH_STANDARD_S5_S3 1 100 0 255 DISPLAY_IDENTIFIER ambient_condition[0][6].amb_cond.ydiMemory_xau16[4].ZFEH_EepromData ECU_ADDRESS 0xFFF82946 /end MEASUREMENT
/begin MEASUREMENT ZFEH_EepromData.ydiMemory_xau16[4].amb_cond.ambient_condition[0][7] "ambient condition shot [0 .. 2-1] with 25 data bytes [0 .. 25-1] for the error code stored in this error memory slot" UBYTE EH_STANDARD_S5_S3 1 100 0 255 DISPLAY_IDENTIFIER ambient_condition[0][7].amb_cond.ydiMemory_xau16[4].ZFEH_EepromData ECU_ADDRESS 0xFFF82947 /end MEASUREMENT
/begin MEASUREMENT ZFEH_EepromData.ydiMemory_xau16[4].amb_cond.ambient_condition[0][8] "ambient condition shot [0 .. 2-1] with 25 data bytes [0 .. 25-1] for the error code stored in this error memory slot" UBYTE EH_STANDARD_S5_S3 1 100 0 255 DISPLAY_IDENTIFIER ambient_condition[0][8].amb_cond.ydiMemory_xau16[4].ZFEH_EepromData ECU_ADDRESS 0xFFF82948 /end MEASUREMENT
/begin MEASUREMENT ZFEH_EepromData.ydiMemory_xau16[4].amb_cond.ambient_condition[0][9] "ambient condition shot [0 .. 2-1] with 25 data bytes [0 .. 25-1] for the error code stored in this error memory slot" UBYTE EH_STANDARD_S5_S3 1 100 0 255 DISPLAY_IDENTIFIER ambient_condition[0][9].amb_cond.ydiMemory_xau16[4].ZFEH_EepromData ECU_ADDRESS 0xFFF82949 /end MEASUREMENT
/begin MEASUREMENT ZFEH_EepromData.ydiMemory_xau16[4].amb_cond.ambient_condition[0][10] "ambient condition shot [0 .. 2-1] with 25 data bytes [0 .. 25-1] for the error code stored in this error memory slot" UBYTE EH_STANDARD_S5_S3 1 100 0 255 DISPLAY_IDENTIFIER ambient_condition[0][10].amb_cond.ydiMemory_xau16[4].ZFEH_EepromData ECU_ADDRESS 0xFFF8294A /end MEASUREMENT
/begin MEASUREMENT ZFEH_EepromData.ydiMemory_xau16[4].amb_cond.ambient_condition[0][11] "ambient condition shot [0 .. 2-1] with 25 data bytes [0 .. 25-1] for the error code stored in this error memory slot" UBYTE EH_STANDARD_S5_S3 1 100 0 255 DISPLAY_IDENTIFIER ambient_condition[0][11].amb_cond.ydiMemory_xau16[4].ZFEH_EepromData ECU_ADDRESS 0xFFF8294B /end MEASUREMENT
/begin MEASUREMENT ZFEH_EepromData.ydiMemory_xau16[4].amb_cond.ambient_condition[0][12] "ambient condition shot [0 .. 2-1] with 25 data bytes [0 .. 25-1] for the error code stored in this error memory slot" UBYTE EH_STANDARD_S5_S3 1 100 0 255 DISPLAY_IDENTIFIER ambient_condition[0][12].amb_cond.ydiMemory_xau16[4].ZFEH_EepromData ECU_ADDRESS 0xFFF8294C /end MEASUREMENT
/begin MEASUREMENT ZFEH_EepromData.ydiMemory_xau16[4].amb_cond.ambient_condition[0][13] "ambient condition shot [0 .. 2-1] with 25 data bytes [0 .. 25-1] for the error code stored in this error memory slot" UBYTE EH_STANDARD_S5_S3 1 100 0 255 DISPLAY_IDENTIFIER ambient_condition[0][13].amb_cond.ydiMemory_xau16[4].ZFEH_EepromData ECU_ADDRESS 0xFFF8294D /end MEASUREMENT
/begin MEASUREMENT ZFEH_EepromData.ydiMemory_xau16[4].amb_cond.ambient_condition[0][14] "ambient condition shot [0 .. 2-1] with 25 data bytes [0 .. 25-1] for the error code stored in this error memory slot" UBYTE EH_STANDARD_S5_S3 1 100 0 255 DISPLAY_IDENTIFIER ambient_condition[0][14].amb_cond.ydiMemory_xau16[4].ZFEH_EepromData ECU_ADDRESS 0xFFF8294E /end MEASUREMENT
/begin MEASUREMENT ZFEH_EepromData.ydiMemory_xau16[4].amb_cond.ambient_condition[0][15] "ambient condition shot [0 .. 2-1] with 25 data bytes [0 .. 25-1] for the error code stored in this error memory slot" UBYTE EH_STANDARD_S5_S3 1 100 0 255 DISPLAY_IDENTIFIER ambient_condition[0][15].amb_cond.ydiMemory_xau16[4].ZFEH_EepromData ECU_ADDRESS 0xFFF8294F /end MEASUREMENT
/begin MEASUREMENT ZFEH_EepromData.ydiMemory_xau16[4].amb_cond.ambient_condition[0][16] "ambient condition shot [0 .. 2-1] with 25 data bytes [0 .. 25-1] for the error code stored in this error memory slot" UBYTE EH_STANDARD_S5_S3 1 100 0 255 DISPLAY_IDENTIFIER ambient_condition[0][16].amb_cond.ydiMemory_xau16[4].ZFEH_EepromData ECU_ADDRESS 0xFFF82950 /end MEASUREMENT
/begin MEASUREMENT ZFEH_EepromData.ydiMemory_xau16[4].amb_cond.ambient_condition[0][17] "ambient condition shot [0 .. 2-1] with 25 data bytes [0 .. 25-1] for the error code stored in this error memory slot" UBYTE EH_STANDARD_S5_S3 1 100 0 255 DISPLAY_IDENTIFIER ambient_condition[0][17].amb_cond.ydiMemory_xau16[4].ZFEH_EepromData ECU_ADDRESS 0xFFF82951 /end MEASUREMENT
/begin MEASUREMENT ZFEH_EepromData.ydiMemory_xau16[4].amb_cond.ambient_condition[0][18] "ambient condition shot [0 .. 2-1] with 25 data bytes [0 .. 25-1] for the error code stored in this error memory slot" UBYTE EH_STANDARD_S5_S3 1 100 0 255 DISPLAY_IDENTIFIER ambient_condition[0][18].amb_cond.ydiMemory_xau16[4].ZFEH_EepromData ECU_ADDRESS 0xFFF82952 /end MEASUREMENT
/begin MEASUREMENT ZFEH_EepromData.ydiMemory_xau16[4].amb_cond.ambient_condition[0][19] "ambient condition shot [0 .. 2-1] with 25 data bytes [0 .. 25-1] for the error code stored in this error memory slot" UBYTE EH_STANDARD_S5_S3 1 100 0 255 DISPLAY_IDENTIFIER ambient_condition[0][19].amb_cond.ydiMemory_xau16[4].ZFEH_EepromData ECU_ADDRESS 0xFFF82953 /end MEASUREMENT
/begin MEASUREMENT ZFEH_EepromData.ydiMemory_xau16[4].amb_cond.ambient_condition[0][20] "ambient condition shot [0 .. 2-1] with 25 data bytes [0 .. 25-1] for the error code stored in this error memory slot" UBYTE EH_STANDARD_S5_S3 1 100 0 255 DISPLAY_IDENTIFIER ambient_condition[0][20].amb_cond.ydiMemory_xau16[4].ZFEH_EepromData ECU_ADDRESS 0xFFF82954 /end MEASUREMENT
/begin MEASUREMENT ZFEH_EepromData.ydiMemory_xau16[4].amb_cond.ambient_condition[0][21] "ambient condition shot [0 .. 2-1] with 25 data bytes [0 .. 25-1] for the error code stored in this error memory slot" UBYTE EH_STANDARD_S5_S3 1 100 0 255 DISPLAY_IDENTIFIER ambient_condition[0][21].amb_cond.ydiMemory_xau16[4].ZFEH_EepromData ECU_ADDRESS 0xFFF82955 /end MEASUREMENT
/begin MEASUREMENT ZFEH_EepromData.ydiMemory_xau16[4].amb_cond.ambient_condition[0][22] "ambient condition shot [0 .. 2-1] with 25 data bytes [0 .. 25-1] for the error code stored in this error memory slot" UBYTE EH_STANDARD_S5_S3 1 100 0 255 DISPLAY_IDENTIFIER ambient_condition[0][22].amb_cond.ydiMemory_xau16[4].ZFEH_EepromData ECU_ADDRESS 0xFFF82956 /end MEASUREMENT
/begin MEASUREMENT ZFEH_EepromData.ydiMemory_xau16[4].amb_cond.ambient_condition[0][23] "ambient condition shot [0 .. 2-1] with 25 data bytes [0 .. 25-1] for the error code stored in this error memory slot" UBYTE EH_STANDARD_S5_S3 1 100 0 255 DISPLAY_IDENTIFIER ambient_condition[0][23].amb_cond.ydiMemory_xau16[4].ZFEH_EepromData ECU_ADDRESS 0xFFF82957 /end MEASUREMENT
/begin MEASUREMENT ZFEH_EepromData.ydiMemory_xau16[4].amb_cond.ambient_condition[0][24] "ambient condition shot [0 .. 2-1] with 25 data bytes [0 .. 25-1] for the error code stored in this error memory slot" UBYTE EH_STANDARD_S5_S3 1 100 0 255 DISPLAY_IDENTIFIER ambient_condition[0][24].amb_cond.ydiMemory_xau16[4].ZFEH_EepromData ECU_ADDRESS 0xFFF82958 /end MEASUREMENT
/begin MEASUREMENT ZFEH_EepromData.ydiMemory_xau16[4].amb_cond.ambient_condition[1][0] "ambient condition shot [0 .. 2-1] with 25 data bytes [0 .. 25-1] for the error code stored in this error memory slot" UBYTE EH_STANDARD_S5_S3 1 100 0 255 DISPLAY_IDENTIFIER ambient_condition[1][0].amb_cond.ydiMemory_xau16[4].ZFEH_EepromData ECU_ADDRESS 0xFFF82959 /end MEASUREMENT
/begin MEASUREMENT ZFEH_EepromData.ydiMemory_xau16[4].amb_cond.ambient_condition[1][1] "ambient condition shot [0 .. 2-1] with 25 data bytes [0 .. 25-1] for the error code stored in this error memory slot" UBYTE EH_STANDARD_S5_S3 1 100 0 255 DISPLAY_IDENTIFIER ambient_condition[1][1].amb_cond.ydiMemory_xau16[4].ZFEH_EepromData ECU_ADDRESS 0xFFF8295A /end MEASUREMENT
/begin MEASUREMENT ZFEH_EepromData.ydiMemory_xau16[4].amb_cond.ambient_condition[1][2] "ambient condition shot [0 .. 2-1] with 25 data bytes [0 .. 25-1] for the error code stored in this error memory slot" UBYTE EH_STANDARD_S5_S3 1 100 0 255 DISPLAY_IDENTIFIER ambient_condition[1][2].amb_cond.ydiMemory_xau16[4].ZFEH_EepromData ECU_ADDRESS 0xFFF8295B /end MEASUREMENT
/begin MEASUREMENT ZFEH_EepromData.ydiMemory_xau16[4].amb_cond.ambient_condition[1][3] "ambient condition shot [0 .. 2-1] with 25 data bytes [0 .. 25-1] for the error code stored in this error memory slot" UBYTE EH_STANDARD_S5_S3 1 100 0 255 DISPLAY_IDENTIFIER ambient_condition[1][3].amb_cond.ydiMemory_xau16[4].ZFEH_EepromData ECU_ADDRESS 0xFFF8295C /end MEASUREMENT
/begin MEASUREMENT ZFEH_EepromData.ydiMemory_xau16[4].amb_cond.ambient_condition[1][4] "ambient condition shot [0 .. 2-1] with 25 data bytes [0 .. 25-1] for the error code stored in this error memory slot" UBYTE EH_STANDARD_S5_S3 1 100 0 255 DISPLAY_IDENTIFIER ambient_condition[1][4].amb_cond.ydiMemory_xau16[4].ZFEH_EepromData ECU_ADDRESS 0xFFF8295D /end MEASUREMENT
/begin MEASUREMENT ZFEH_EepromData.ydiMemory_xau16[4].amb_cond.ambient_condition[1][5] "ambient condition shot [0 .. 2-1] with 25 data bytes [0 .. 25-1] for the error code stored in this error memory slot" UBYTE EH_STANDARD_S5_S3 1 100 0 255 DISPLAY_IDENTIFIER ambient_condition[1][5].amb_cond.ydiMemory_xau16[4].ZFEH_EepromData ECU_ADDRESS 0xFFF8295E /end MEASUREMENT
/begin MEASUREMENT ZFEH_EepromData.ydiMemory_xau16[4].amb_cond.ambient_condition[1][6] "ambient condition shot [0 .. 2-1] with 25 data bytes [0 .. 25-1] for the error code stored in this error memory slot" UBYTE EH_STANDARD_S5_S3 1 100 0 255 DISPLAY_IDENTIFIER ambient_condition[1][6].amb_cond.ydiMemory_xau16[4].ZFEH_EepromData ECU_ADDRESS 0xFFF8295F /end MEASUREMENT
/begin MEASUREMENT ZFEH_EepromData.ydiMemory_xau16[4].amb_cond.ambient_condition[1][7] "ambient condition shot [0 .. 2-1] with 25 data bytes [0 .. 25-1] for the error code stored in this error memory slot" UBYTE EH_STANDARD_S5_S3 1 100 0 255 DISPLAY_IDENTIFIER ambient_condition[1][7].amb_cond.ydiMemory_xau16[4].ZFEH_EepromData ECU_ADDRESS 0xFFF82960 /end MEASUREMENT
/begin MEASUREMENT ZFEH_EepromData.ydiMemory_xau16[4].amb_cond.ambient_condition[1][8] "ambient condition shot [0 .. 2-1] with 25 data bytes [0 .. 25-1] for the error code stored in this error memory slot" UBYTE EH_STANDARD_S5_S3 1 100 0 255 DISPLAY_IDENTIFIER ambient_condition[1][8].amb_cond.ydiMemory_xau16[4].ZFEH_EepromData ECU_ADDRESS 0xFFF82961 /end MEASUREMENT
/begin MEASUREMENT ZFEH_EepromData.ydiMemory_xau16[4].amb_cond.ambient_condition[1][9] "ambient condition shot [0 .. 2-1] with 25 data bytes [0 .. 25-1] for the error code stored in this error memory slot" UBYTE EH_STANDARD_S5_S3 1 100 0 255 DISPLAY_IDENTIFIER ambient_condition[1][9].amb_cond.ydiMemory_xau16[4].ZFEH_EepromData ECU_ADDRESS 0xFFF82962 /end MEASUREMENT
/begin MEASUREMENT ZFEH_EepromData.ydiMemory_xau16[4].amb_cond.ambient_condition[1][10] "ambient condition shot [0 .. 2-1] with 25 data bytes [0 .. 25-1] for the error code stored in this error memory slot" UBYTE EH_STANDARD_S5_S3 1 100 0 255 DISPLAY_IDENTIFIER ambient_condition[1][10].amb_cond.ydiMemory_xau16[4].ZFEH_EepromData ECU_ADDRESS 0xFFF82963 /end MEASUREMENT
/begin MEASUREMENT ZFEH_EepromData.ydiMemory_xau16[4].amb_cond.ambient_condition[1][11] "ambient condition shot [0 .. 2-1] with 25 data bytes [0 .. 25-1] for the error code stored in this error memory slot" UBYTE EH_STANDARD_S5_S3 1 100 0 255 DISPLAY_IDENTIFIER ambient_condition[1][11].amb_cond.ydiMemory_xau16[4].ZFEH_EepromData ECU_ADDRESS 0xFFF82964 /end MEASUREMENT
/begin MEASUREMENT ZFEH_EepromData.ydiMemory_xau16[4].amb_cond.ambient_condition[1][12] "ambient condition shot [0 .. 2-1] with 25 data bytes [0 .. 25-1] for the error code stored in this error memory slot" UBYTE EH_STANDARD_S5_S3 1 100 0 255 DISPLAY_IDENTIFIER ambient_condition[1][12].amb_cond.ydiMemory_xau16[4].ZFEH_EepromData ECU_ADDRESS 0xFFF82965 /end MEASUREMENT
/begin MEASUREMENT ZFEH_EepromData.ydiMemory_xau16[4].amb_cond.ambient_condition[1][13] "ambient condition shot [0 .. 2-1] with 25 data bytes [0 .. 25-1] for the error code stored in this error memory slot" UBYTE EH_STANDARD_S5_S3 1 100 0 255 DISPLAY_IDENTIFIER ambient_condition[1][13].amb_cond.ydiMemory_xau16[4].ZFEH_EepromData ECU_ADDRESS 0xFFF82966 /end MEASUREMENT
/begin MEASUREMENT ZFEH_EepromData.ydiMemory_xau16[4].amb_cond.ambient_condition[1][14] "ambient condition shot [0 .. 2-1] with 25 data bytes [0 .. 25-1] for the error code stored in this error memory slot" UBYTE EH_STANDARD_S5_S3 1 100 0 255 DISPLAY_IDENTIFIER ambient_condition[1][14].amb_cond.ydiMemory_xau16[4].ZFEH_EepromData ECU_ADDRESS 0xFFF82967 /end MEASUREMENT
/begin MEASUREMENT ZFEH_EepromData.ydiMemory_xau16[4].amb_cond.ambient_condition[1][15] "ambient condition shot [0 .. 2-1] with 25 data bytes [0 .. 25-1] for the error code stored in this error memory slot" UBYTE EH_STANDARD_S5_S3 1 100 0 255 DISPLAY_IDENTIFIER ambient_condition[1][15].amb_cond.ydiMemory_xau16[4].ZFEH_EepromData ECU_ADDRESS 0xFFF82968 /end MEASUREMENT
/begin MEASUREMENT ZFEH_EepromData.ydiMemory_xau16[4].amb_cond.ambient_condition[1][16] "ambient condition shot [0 .. 2-1] with 25 data bytes [0 .. 25-1] for the error code stored in this error memory slot" UBYTE EH_STANDARD_S5_S3 1 100 0 255 DISPLAY_IDENTIFIER ambient_condition[1][16].amb_cond.ydiMemory_xau16[4].ZFEH_EepromData ECU_ADDRESS 0xFFF82969 /end MEASUREMENT
/begin MEASUREMENT ZFEH_EepromData.ydiMemory_xau16[4].amb_cond.ambient_condition[1][17] "ambient condition shot [0 .. 2-1] with 25 data bytes [0 .. 25-1] for the error code stored in this error memory slot" UBYTE EH_STANDARD_S5_S3 1 100 0 255 DISPLAY_IDENTIFIER ambient_condition[1][17].amb_cond.ydiMemory_xau16[4].ZFEH_EepromData ECU_ADDRESS 0xFFF8296A /end MEASUREMENT
/begin MEASUREMENT ZFEH_EepromData.ydiMemory_xau16[4].amb_cond.ambient_condition[1][18] "ambient condition shot [0 .. 2-1] with 25 data bytes [0 .. 25-1] for the error code stored in this error memory slot" UBYTE EH_STANDARD_S5_S3 1 100 0 255 DISPLAY_IDENTIFIER ambient_condition[1][18].amb_cond.ydiMemory_xau16[4].ZFEH_EepromData ECU_ADDRESS 0xFFF8296B /end MEASUREMENT
/begin MEASUREMENT ZFEH_EepromData.ydiMemory_xau16[4].amb_cond.ambient_condition[1][19] "ambient condition shot [0 .. 2-1] with 25 data bytes [0 .. 25-1] for the error code stored in this error memory slot" UBYTE EH_STANDARD_S5_S3 1 100 0 255 DISPLAY_IDENTIFIER ambient_condition[1][19].amb_cond.ydiMemory_xau16[4].ZFEH_EepromData ECU_ADDRESS 0xFFF8296C /end MEASUREMENT
/begin MEASUREMENT ZFEH_EepromData.ydiMemory_xau16[4].amb_cond.ambient_condition[1][20] "ambient condition shot [0 .. 2-1] with 25 data bytes [0 .. 25-1] for the error code stored in this error memory slot" UBYTE EH_STANDARD_S5_S3 1 100 0 255 DISPLAY_IDENTIFIER ambient_condition[1][20].amb_cond.ydiMemory_xau16[4].ZFEH_EepromData ECU_ADDRESS 0xFFF8296D /end MEASUREMENT
/begin MEASUREMENT ZFEH_EepromData.ydiMemory_xau16[4].amb_cond.ambient_condition[1][21] "ambient condition shot [0 .. 2-1] with 25 data bytes [0 .. 25-1] for the error code stored in this error memory slot" UBYTE EH_STANDARD_S5_S3 1 100 0 255 DISPLAY_IDENTIFIER ambient_condition[1][21].amb_cond.ydiMemory_xau16[4].ZFEH_EepromData ECU_ADDRESS 0xFFF8296E /end MEASUREMENT
/begin MEASUREMENT ZFEH_EepromData.ydiMemory_xau16[4].amb_cond.ambient_condition[1][22] "ambient condition shot [0 .. 2-1] with 25 data bytes [0 .. 25-1] for the error code stored in this error memory slot" UBYTE EH_STANDARD_S5_S3 1 100 0 255 DISPLAY_IDENTIFIER ambient_condition[1][22].amb_cond.ydiMemory_xau16[4].ZFEH_EepromData ECU_ADDRESS 0xFFF8296F /end MEASUREMENT
/begin MEASUREMENT ZFEH_EepromData.ydiMemory_xau16[4].amb_cond.ambient_condition[1][23] "ambient condition shot [0 .. 2-1] with 25 data bytes [0 .. 25-1] for the error code stored in this error memory slot" UBYTE EH_STANDARD_S5_S3 1 100 0 255 DISPLAY_IDENTIFIER ambient_condition[1][23].amb_cond.ydiMemory_xau16[4].ZFEH_EepromData ECU_ADDRESS 0xFFF82970 /end MEASUREMENT
/begin MEASUREMENT ZFEH_EepromData.ydiMemory_xau16[4].amb_cond.ambient_condition[1][24] "ambient condition shot [0 .. 2-1] with 25 data bytes [0 .. 25-1] for the error code stored in this error memory slot" UBYTE EH_STANDARD_S5_S3 1 100 0 255 DISPLAY_IDENTIFIER ambient_condition[1][24].amb_cond.ydiMemory_xau16[4].ZFEH_EepromData ECU_ADDRESS 0xFFF82971 /end MEASUREMENT
/begin MEASUREMENT ZFEH_EepromData.ydiMemory_xau16[4].amb_cond.status_of_ambient_conditions[0] "status of ambient condition shot x: 0=invalid 1=valid" UBYTE EH_STANDARD_S5_S3 1 100 0 1 DISPLAY_IDENTIFIER status_of_ambient_conditions[0].amb_cond.ydiMemory_xau16[4].ZFEH_EepromData ECU_ADDRESS 0xFFF82972 /end MEASUREMENT
/begin MEASUREMENT ZFEH_EepromData.ydiMemory_xau16[4].amb_cond.status_of_ambient_conditions[1] "status of ambient condition shot x: 0=invalid 1=valid" UBYTE EH_STANDARD_S5_S3 1 100 0 1 DISPLAY_IDENTIFIER status_of_ambient_conditions[1].amb_cond.ydiMemory_xau16[4].ZFEH_EepromData ECU_ADDRESS 0xFFF82973 /end MEASUREMENT
/begin MEASUREMENT ZFEH_EepromData.ydiMemory_xau16[4].error_code "error code stored in error memory slot" UWORD CONV_KFC_NAME 0 255 0 65535 DISPLAY_IDENTIFIER error_code.ydiMemory_xau16[4].ZFEH_EepromData ECU_ADDRESS 0xFFF8292C /end MEASUREMENT
/begin MEASUREMENT ZFEH_EepromData.ydiMemory_xau16[4].error_type "error type of error code stored in error memory slot" UWORD EH_STANDARD_S5_S3 1 100 0 65535 DISPLAY_IDENTIFIER error_type.ydiMemory_xau16[4].ZFEH_EepromData ECU_ADDRESS 0xFFF8292E /end MEASUREMENT
/begin MEASUREMENT ZFEH_EepromData.ydiMemory_xau16[4].status_word "status word of error code stored in error memory slot" UWORD EH_STANDARD_S5_S3 1 100 0 65535 DISPLAY_IDENTIFIER status_word.ydiMemory_xau16[4].ZFEH_EepromData ECU_ADDRESS 0xFFF82930 /end MEASUREMENT
/begin MEASUREMENT ZFEH_EepromData.ydiMemory_xau16[4].frequency_counter "frequency counter of error code stored in error memory slot" UBYTE EH_STANDARD_S5_S3 1 100 0 255 DISPLAY_IDENTIFIER frequency_counter.ydiMemory_xau16[4].ZFEH_EepromData ECU_ADDRESS 0xFFF82932 /end MEASUREMENT
/begin MEASUREMENT ZFEH_EepromData.ydiMemory_xau16[4].backwards_counter "backwards counter of error code stored in error memory slot" UBYTE EH_STANDARD_S5_S3 1 100 0 255 DISPLAY_IDENTIFIER backwards_counter.ydiMemory_xau16[4].ZFEH_EepromData ECU_ADDRESS 0xFFF82933 /end MEASUREMENT
/begin MEASUREMENT ZFEH_EepromData.ydiMemory_xau16[4].permanent_counter "counter of permanent error codes stored in error memory slot" UBYTE EH_STANDARD_S5_S3 1 100 0 255 DISPLAY_IDENTIFIER permanent_counter.ydiMemory_xau16[4].ZFEH_EepromData ECU_ADDRESS 0xFFF82934 /end MEASUREMENT
/begin MEASUREMENT ZFEH_EepromData.ydiMemory_xau16[4].sequence_counter "sequence counter of error code stored in error memory slot" UBYTE EH_STANDARD_S5_S3 1 100 0 255 DISPLAY_IDENTIFIER sequence_counter.ydiMemory_xau16[4].ZFEH_EepromData ECU_ADDRESS 0xFFF82935 /end MEASUREMENT
/begin MEASUREMENT ZFEH_EepromData.ydiMemory_xau16[4].master_time "master time of error code stored in error memory slot" ULONG EH_STANDARD_S5_S3 1 100 0 4294967295 DISPLAY_IDENTIFIER master_time.ydiMemory_xau16[4].ZFEH_EepromData ECU_ADDRESS 0xFFF82938 /end MEASUREMENT
/begin MEASUREMENT ZFEH_EepromData.ydiMemory_xau16[4].condition_byte "condition byte of error code stored in error memory slot" UBYTE EH_STANDARD_S5_S3 1 100 0 255 DISPLAY_IDENTIFIER condition_byte.ydiMemory_xau16[4].ZFEH_EepromData ECU_ADDRESS 0xFFF8293D /end MEASUREMENT
/begin MEASUREMENT ZFEH_EepromData.ydiMemory_xau16[4].obd_driving_cycle_counter "obd driving cycle counter of error code stored in error memory slot" UWORD EH_STANDARD_S5_S3 1 100 0 65535 DISPLAY_IDENTIFIER obd_driving_cycle_counter.ydiMemory_xau16[4].ZFEH_EepromData ECU_ADDRESS 0xFFF8293E /end MEASUREMENT
/begin MEASUREMENT ZFEH_EepromData.ydiMemory_xau16[5].amb_cond.ambient_condition[0][0] "ambient condition shot [0 .. 2-1] with 25 data bytes [0 .. 25-1] for the error code stored in this error memory slot" UBYTE EH_STANDARD_S5_S3 1 100 0 255 DISPLAY_IDENTIFIER ambient_condition[0][0].amb_cond.ydiMemory_xau16[5].ZFEH_EepromData ECU_ADDRESS 0xFFF82988 /end MEASUREMENT
/begin MEASUREMENT ZFEH_EepromData.ydiMemory_xau16[5].amb_cond.ambient_condition[0][1] "ambient condition shot [0 .. 2-1] with 25 data bytes [0 .. 25-1] for the error code stored in this error memory slot" UBYTE EH_STANDARD_S5_S3 1 100 0 255 DISPLAY_IDENTIFIER ambient_condition[0][1].amb_cond.ydiMemory_xau16[5].ZFEH_EepromData ECU_ADDRESS 0xFFF82989 /end MEASUREMENT
/begin MEASUREMENT ZFEH_EepromData.ydiMemory_xau16[5].amb_cond.ambient_condition[0][2] "ambient condition shot [0 .. 2-1] with 25 data bytes [0 .. 25-1] for the error code stored in this error memory slot" UBYTE EH_STANDARD_S5_S3 1 100 0 255 DISPLAY_IDENTIFIER ambient_condition[0][2].amb_cond.ydiMemory_xau16[5].ZFEH_EepromData ECU_ADDRESS 0xFFF8298A /end MEASUREMENT
/begin MEASUREMENT ZFEH_EepromData.ydiMemory_xau16[5].amb_cond.ambient_condition[0][3] "ambient condition shot [0 .. 2-1] with 25 data bytes [0 .. 25-1] for the error code stored in this error memory slot" UBYTE EH_STANDARD_S5_S3 1 100 0 255 DISPLAY_IDENTIFIER ambient_condition[0][3].amb_cond.ydiMemory_xau16[5].ZFEH_EepromData ECU_ADDRESS 0xFFF8298B /end MEASUREMENT
/begin MEASUREMENT ZFEH_EepromData.ydiMemory_xau16[5].amb_cond.ambient_condition[0][4] "ambient condition shot [0 .. 2-1] with 25 data bytes [0 .. 25-1] for the error code stored in this error memory slot" UBYTE EH_STANDARD_S5_S3 1 100 0 255 DISPLAY_IDENTIFIER ambient_condition[0][4].amb_cond.ydiMemory_xau16[5].ZFEH_EepromData ECU_ADDRESS 0xFFF8298C /end MEASUREMENT
/begin MEASUREMENT ZFEH_EepromData.ydiMemory_xau16[5].amb_cond.ambient_condition[0][5] "ambient condition shot [0 .. 2-1] with 25 data bytes [0 .. 25-1] for the error code stored in this error memory slot" UBYTE EH_STANDARD_S5_S3 1 100 0 255 DISPLAY_IDENTIFIER ambient_condition[0][5].amb_cond.ydiMemory_xau16[5].ZFEH_EepromData ECU_ADDRESS 0xFFF8298D /end MEASUREMENT
/begin MEASUREMENT ZFEH_EepromData.ydiMemory_xau16[5].amb_cond.ambient_condition[0][6] "ambient condition shot [0 .. 2-1] with 25 data bytes [0 .. 25-1] for the error code stored in this error memory slot" UBYTE EH_STANDARD_S5_S3 1 100 0 255 DISPLAY_IDENTIFIER ambient_condition[0][6].amb_cond.ydiMemory_xau16[5].ZFEH_EepromData ECU_ADDRESS 0xFFF8298E /end MEASUREMENT
/begin MEASUREMENT ZFEH_EepromData.ydiMemory_xau16[5].amb_cond.ambient_condition[0][7] "ambient condition shot [0 .. 2-1] with 25 data bytes [0 .. 25-1] for the error code stored in this error memory slot" UBYTE EH_STANDARD_S5_S3 1 100 0 255 DISPLAY_IDENTIFIER ambient_condition[0][7].amb_cond.ydiMemory_xau16[5].ZFEH_EepromData ECU_ADDRESS 0xFFF8298F /end MEASUREMENT
/begin MEASUREMENT ZFEH_EepromData.ydiMemory_xau16[5].amb_cond.ambient_condition[0][8] "ambient condition shot [0 .. 2-1] with 25 data bytes [0 .. 25-1] for the error code stored in this error memory slot" UBYTE EH_STANDARD_S5_S3 1 100 0 255 DISPLAY_IDENTIFIER ambient_condition[0][8].amb_cond.ydiMemory_xau16[5].ZFEH_EepromData ECU_ADDRESS 0xFFF82990 /end MEASUREMENT
/begin MEASUREMENT ZFEH_EepromData.ydiMemory_xau16[5].amb_cond.ambient_condition[0][9] "ambient condition shot [0 .. 2-1] with 25 data bytes [0 .. 25-1] for the error code stored in this error memory slot" UBYTE EH_STANDARD_S5_S3 1 100 0 255 DISPLAY_IDENTIFIER ambient_condition[0][9].amb_cond.ydiMemory_xau16[5].ZFEH_EepromData ECU_ADDRESS 0xFFF82991 /end MEASUREMENT
/begin MEASUREMENT ZFEH_EepromData.ydiMemory_xau16[5].amb_cond.ambient_condition[0][10] "ambient condition shot [0 .. 2-1] with 25 data bytes [0 .. 25-1] for the error code stored in this error memory slot" UBYTE EH_STANDARD_S5_S3 1 100 0 255 DISPLAY_IDENTIFIER ambient_condition[0][10].amb_cond.ydiMemory_xau16[5].ZFEH_EepromData ECU_ADDRESS 0xFFF82992 /end MEASUREMENT
/begin MEASUREMENT ZFEH_EepromData.ydiMemory_xau16[5].amb_cond.ambient_condition[0][11] "ambient condition shot [0 .. 2-1] with 25 data bytes [0 .. 25-1] for the error code stored in this error memory slot" UBYTE EH_STANDARD_S5_S3 1 100 0 255 DISPLAY_IDENTIFIER ambient_condition[0][11].amb_cond.ydiMemory_xau16[5].ZFEH_EepromData ECU_ADDRESS 0xFFF82993 /end MEASUREMENT
/begin MEASUREMENT ZFEH_EepromData.ydiMemory_xau16[5].amb_cond.ambient_condition[0][12] "ambient condition shot [0 .. 2-1] with 25 data bytes [0 .. 25-1] for the error code stored in this error memory slot" UBYTE EH_STANDARD_S5_S3 1 100 0 255 DISPLAY_IDENTIFIER ambient_condition[0][12].amb_cond.ydiMemory_xau16[5].ZFEH_EepromData ECU_ADDRESS 0xFFF82994 /end MEASUREMENT
/begin MEASUREMENT ZFEH_EepromData.ydiMemory_xau16[5].amb_cond.ambient_condition[0][13] "ambient condition shot [0 .. 2-1] with 25 data bytes [0 .. 25-1] for the error code stored in this error memory slot" UBYTE EH_STANDARD_S5_S3 1 100 0 255 DISPLAY_IDENTIFIER ambient_condition[0][13].amb_cond.ydiMemory_xau16[5].ZFEH_EepromData ECU_ADDRESS 0xFFF82995 /end MEASUREMENT
/begin MEASUREMENT ZFEH_EepromData.ydiMemory_xau16[5].amb_cond.ambient_condition[0][14] "ambient condition shot [0 .. 2-1] with 25 data bytes [0 .. 25-1] for the error code stored in this error memory slot" UBYTE EH_STANDARD_S5_S3 1 100 0 255 DISPLAY_IDENTIFIER ambient_condition[0][14].amb_cond.ydiMemory_xau16[5].ZFEH_EepromData ECU_ADDRESS 0xFFF82996 /end MEASUREMENT
/begin MEASUREMENT ZFEH_EepromData.ydiMemory_xau16[5].amb_cond.ambient_condition[0][15] "ambient condition shot [0 .. 2-1] with 25 data bytes [0 .. 25-1] for the error code stored in this error memory slot" UBYTE EH_STANDARD_S5_S3 1 100 0 255 DISPLAY_IDENTIFIER ambient_condition[0][15].amb_cond.ydiMemory_xau16[5].ZFEH_EepromData ECU_ADDRESS 0xFFF82997 /end MEASUREMENT
/begin MEASUREMENT ZFEH_EepromData.ydiMemory_xau16[5].amb_cond.ambient_condition[0][16] "ambient condition shot [0 .. 2-1] with 25 data bytes [0 .. 25-1] for the error code stored in this error memory slot" UBYTE EH_STANDARD_S5_S3 1 100 0 255 DISPLAY_IDENTIFIER ambient_condition[0][16].amb_cond.ydiMemory_xau16[5].ZFEH_EepromData ECU_ADDRESS 0xFFF82998 /end MEASUREMENT
/begin MEASUREMENT ZFEH_EepromData.ydiMemory_xau16[5].amb_cond.ambient_condition[0][17] "ambient condition shot [0 .. 2-1] with 25 data bytes [0 .. 25-1] for the error code stored in this error memory slot" UBYTE EH_STANDARD_S5_S3 1 100 0 255 DISPLAY_IDENTIFIER ambient_condition[0][17].amb_cond.ydiMemory_xau16[5].ZFEH_EepromData ECU_ADDRESS 0xFFF82999 /end MEASUREMENT
/begin MEASUREMENT ZFEH_EepromData.ydiMemory_xau16[5].amb_cond.ambient_condition[0][18] "ambient condition shot [0 .. 2-1] with 25 data bytes [0 .. 25-1] for the error code stored in this error memory slot" UBYTE EH_STANDARD_S5_S3 1 100 0 255 DISPLAY_IDENTIFIER ambient_condition[0][18].amb_cond.ydiMemory_xau16[5].ZFEH_EepromData ECU_ADDRESS 0xFFF8299A /end MEASUREMENT
/begin MEASUREMENT ZFEH_EepromData.ydiMemory_xau16[5].amb_cond.ambient_condition[0][19] "ambient condition shot [0 .. 2-1] with 25 data bytes [0 .. 25-1] for the error code stored in this error memory slot" UBYTE EH_STANDARD_S5_S3 1 100 0 255 DISPLAY_IDENTIFIER ambient_condition[0][19].amb_cond.ydiMemory_xau16[5].ZFEH_EepromData ECU_ADDRESS 0xFFF8299B /end MEASUREMENT
/begin MEASUREMENT ZFEH_EepromData.ydiMemory_xau16[5].amb_cond.ambient_condition[0][20] "ambient condition shot [0 .. 2-1] with 25 data bytes [0 .. 25-1] for the error code stored in this error memory slot" UBYTE EH_STANDARD_S5_S3 1 100 0 255 DISPLAY_IDENTIFIER ambient_condition[0][20].amb_cond.ydiMemory_xau16[5].ZFEH_EepromData ECU_ADDRESS 0xFFF8299C /end MEASUREMENT
/begin MEASUREMENT ZFEH_EepromData.ydiMemory_xau16[5].amb_cond.ambient_condition[0][21] "ambient condition shot [0 .. 2-1] with 25 data bytes [0 .. 25-1] for the error code stored in this error memory slot" UBYTE EH_STANDARD_S5_S3 1 100 0 255 DISPLAY_IDENTIFIER ambient_condition[0][21].amb_cond.ydiMemory_xau16[5].ZFEH_EepromData ECU_ADDRESS 0xFFF8299D /end MEASUREMENT
/begin MEASUREMENT ZFEH_EepromData.ydiMemory_xau16[5].amb_cond.ambient_condition[0][22] "ambient condition shot [0 .. 2-1] with 25 data bytes [0 .. 25-1] for the error code stored in this error memory slot" UBYTE EH_STANDARD_S5_S3 1 100 0 255 DISPLAY_IDENTIFIER ambient_condition[0][22].amb_cond.ydiMemory_xau16[5].ZFEH_EepromData ECU_ADDRESS 0xFFF8299E /end MEASUREMENT
/begin MEASUREMENT ZFEH_EepromData.ydiMemory_xau16[5].amb_cond.ambient_condition[0][23] "ambient condition shot [0 .. 2-1] with 25 data bytes [0 .. 25-1] for the error code stored in this error memory slot" UBYTE EH_STANDARD_S5_S3 1 100 0 255 DISPLAY_IDENTIFIER ambient_condition[0][23].amb_cond.ydiMemory_xau16[5].ZFEH_EepromData ECU_ADDRESS 0xFFF8299F /end MEASUREMENT
/begin MEASUREMENT ZFEH_EepromData.ydiMemory_xau16[5].amb_cond.ambient_condition[0][24] "ambient condition shot [0 .. 2-1] with 25 data bytes [0 .. 25-1] for the error code stored in this error memory slot" UBYTE EH_STANDARD_S5_S3 1 100 0 255 DISPLAY_IDENTIFIER ambient_condition[0][24].amb_cond.ydiMemory_xau16[5].ZFEH_EepromData ECU_ADDRESS 0xFFF829A0 /end MEASUREMENT
/begin MEASUREMENT ZFEH_EepromData.ydiMemory_xau16[5].amb_cond.ambient_condition[1][0] "ambient condition shot [0 .. 2-1] with 25 data bytes [0 .. 25-1] for the error code stored in this error memory slot" UBYTE EH_STANDARD_S5_S3 1 100 0 255 DISPLAY_IDENTIFIER ambient_condition[1][0].amb_cond.ydiMemory_xau16[5].ZFEH_EepromData ECU_ADDRESS 0xFFF829A1 /end MEASUREMENT
/begin MEASUREMENT ZFEH_EepromData.ydiMemory_xau16[5].amb_cond.ambient_condition[1][1] "ambient condition shot [0 .. 2-1] with 25 data bytes [0 .. 25-1] for the error code stored in this error memory slot" UBYTE EH_STANDARD_S5_S3 1 100 0 255 DISPLAY_IDENTIFIER ambient_condition[1][1].amb_cond.ydiMemory_xau16[5].ZFEH_EepromData ECU_ADDRESS 0xFFF829A2 /end MEASUREMENT
/begin MEASUREMENT ZFEH_EepromData.ydiMemory_xau16[5].amb_cond.ambient_condition[1][2] "ambient condition shot [0 .. 2-1] with 25 data bytes [0 .. 25-1] for the error code stored in this error memory slot" UBYTE EH_STANDARD_S5_S3 1 100 0 255 DISPLAY_IDENTIFIER ambient_condition[1][2].amb_cond.ydiMemory_xau16[5].ZFEH_EepromData ECU_ADDRESS 0xFFF829A3 /end MEASUREMENT
/begin MEASUREMENT ZFEH_EepromData.ydiMemory_xau16[5].amb_cond.ambient_condition[1][3] "ambient condition shot [0 .. 2-1] with 25 data bytes [0 .. 25-1] for the error code stored in this error memory slot" UBYTE EH_STANDARD_S5_S3 1 100 0 255 DISPLAY_IDENTIFIER ambient_condition[1][3].amb_cond.ydiMemory_xau16[5].ZFEH_EepromData ECU_ADDRESS 0xFFF829A4 /end MEASUREMENT
/begin MEASUREMENT ZFEH_EepromData.ydiMemory_xau16[5].amb_cond.ambient_condition[1][4] "ambient condition shot [0 .. 2-1] with 25 data bytes [0 .. 25-1] for the error code stored in this error memory slot" UBYTE EH_STANDARD_S5_S3 1 100 0 255 DISPLAY_IDENTIFIER ambient_condition[1][4].amb_cond.ydiMemory_xau16[5].ZFEH_EepromData ECU_ADDRESS 0xFFF829A5 /end MEASUREMENT
/begin MEASUREMENT ZFEH_EepromData.ydiMemory_xau16[5].amb_cond.ambient_condition[1][5] "ambient condition shot [0 .. 2-1] with 25 data bytes [0 .. 25-1] for the error code stored in this error memory slot" UBYTE EH_STANDARD_S5_S3 1 100 0 255 DISPLAY_IDENTIFIER ambient_condition[1][5].amb_cond.ydiMemory_xau16[5].ZFEH_EepromData ECU_ADDRESS 0xFFF829A6 /end MEASUREMENT
/begin MEASUREMENT ZFEH_EepromData.ydiMemory_xau16[5].amb_cond.ambient_condition[1][6] "ambient condition shot [0 .. 2-1] with 25 data bytes [0 .. 25-1] for the error code stored in this error memory slot" UBYTE EH_STANDARD_S5_S3 1 100 0 255 DISPLAY_IDENTIFIER ambient_condition[1][6].amb_cond.ydiMemory_xau16[5].ZFEH_EepromData ECU_ADDRESS 0xFFF829A7 /end MEASUREMENT
/begin MEASUREMENT ZFEH_EepromData.ydiMemory_xau16[5].amb_cond.ambient_condition[1][7] "ambient condition shot [0 .. 2-1] with 25 data bytes [0 .. 25-1] for the error code stored in this error memory slot" UBYTE EH_STANDARD_S5_S3 1 100 0 255 DISPLAY_IDENTIFIER ambient_condition[1][7].amb_cond.ydiMemory_xau16[5].ZFEH_EepromData ECU_ADDRESS 0xFFF829A8 /end MEASUREMENT
/begin MEASUREMENT ZFEH_EepromData.ydiMemory_xau16[5].amb_cond.ambient_condition[1][8] "ambient condition shot [0 .. 2-1] with 25 data bytes [0 .. 25-1] for the error code stored in this error memory slot" UBYTE EH_STANDARD_S5_S3 1 100 0 255 DISPLAY_IDENTIFIER ambient_condition[1][8].amb_cond.ydiMemory_xau16[5].ZFEH_EepromData ECU_ADDRESS 0xFFF829A9 /end MEASUREMENT
/begin MEASUREMENT ZFEH_EepromData.ydiMemory_xau16[5].amb_cond.ambient_condition[1][9] "ambient condition shot [0 .. 2-1] with 25 data bytes [0 .. 25-1] for the error code stored in this error memory slot" UBYTE EH_STANDARD_S5_S3 1 100 0 255 DISPLAY_IDENTIFIER ambient_condition[1][9].amb_cond.ydiMemory_xau16[5].ZFEH_EepromData ECU_ADDRESS 0xFFF829AA /end MEASUREMENT
/begin MEASUREMENT ZFEH_EepromData.ydiMemory_xau16[5].amb_cond.ambient_condition[1][10] "ambient condition shot [0 .. 2-1] with 25 data bytes [0 .. 25-1] for the error code stored in this error memory slot" UBYTE EH_STANDARD_S5_S3 1 100 0 255 DISPLAY_IDENTIFIER ambient_condition[1][10].amb_cond.ydiMemory_xau16[5].ZFEH_EepromData ECU_ADDRESS 0xFFF829AB /end MEASUREMENT
/begin MEASUREMENT ZFEH_EepromData.ydiMemory_xau16[5].amb_cond.ambient_condition[1][11] "ambient condition shot [0 .. 2-1] with 25 data bytes [0 .. 25-1] for the error code stored in this error memory slot" UBYTE EH_STANDARD_S5_S3 1 100 0 255 DISPLAY_IDENTIFIER ambient_condition[1][11].amb_cond.ydiMemory_xau16[5].ZFEH_EepromData ECU_ADDRESS 0xFFF829AC /end MEASUREMENT
/begin MEASUREMENT ZFEH_EepromData.ydiMemory_xau16[5].amb_cond.ambient_condition[1][12] "ambient condition shot [0 .. 2-1] with 25 data bytes [0 .. 25-1] for the error code stored in this error memory slot" UBYTE EH_STANDARD_S5_S3 1 100 0 255 DISPLAY_IDENTIFIER ambient_condition[1][12].amb_cond.ydiMemory_xau16[5].ZFEH_EepromData ECU_ADDRESS 0xFFF829AD /end MEASUREMENT
/begin MEASUREMENT ZFEH_EepromData.ydiMemory_xau16[5].amb_cond.ambient_condition[1][13] "ambient condition shot [0 .. 2-1] with 25 data bytes [0 .. 25-1] for the error code stored in this error memory slot" UBYTE EH_STANDARD_S5_S3 1 100 0 255 DISPLAY_IDENTIFIER ambient_condition[1][13].amb_cond.ydiMemory_xau16[5].ZFEH_EepromData ECU_ADDRESS 0xFFF829AE /end MEASUREMENT
/begin MEASUREMENT ZFEH_EepromData.ydiMemory_xau16[5].amb_cond.ambient_condition[1][14] "ambient condition shot [0 .. 2-1] with 25 data bytes [0 .. 25-1] for the error code stored in this error memory slot" UBYTE EH_STANDARD_S5_S3 1 100 0 255 DISPLAY_IDENTIFIER ambient_condition[1][14].amb_cond.ydiMemory_xau16[5].ZFEH_EepromData ECU_ADDRESS 0xFFF829AF /end MEASUREMENT
/begin MEASUREMENT ZFEH_EepromData.ydiMemory_xau16[5].amb_cond.ambient_condition[1][15] "ambient condition shot [0 .. 2-1] with 25 data bytes [0 .. 25-1] for the error code stored in this error memory slot" UBYTE EH_STANDARD_S5_S3 1 100 0 255 DISPLAY_IDENTIFIER ambient_condition[1][15].amb_cond.ydiMemory_xau16[5].ZFEH_EepromData ECU_ADDRESS 0xFFF829B0 /end MEASUREMENT
/begin MEASUREMENT ZFEH_EepromData.ydiMemory_xau16[5].amb_cond.ambient_condition[1][16] "ambient condition shot [0 .. 2-1] with 25 data bytes [0 .. 25-1] for the error code stored in this error memory slot" UBYTE EH_STANDARD_S5_S3 1 100 0 255 DISPLAY_IDENTIFIER ambient_condition[1][16].amb_cond.ydiMemory_xau16[5].ZFEH_EepromData ECU_ADDRESS 0xFFF829B1 /end MEASUREMENT
/begin MEASUREMENT ZFEH_EepromData.ydiMemory_xau16[5].amb_cond.ambient_condition[1][17] "ambient condition shot [0 .. 2-1] with 25 data bytes [0 .. 25-1] for the error code stored in this error memory slot" UBYTE EH_STANDARD_S5_S3 1 100 0 255 DISPLAY_IDENTIFIER ambient_condition[1][17].amb_cond.ydiMemory_xau16[5].ZFEH_EepromData ECU_ADDRESS 0xFFF829B2 /end MEASUREMENT
/begin MEASUREMENT ZFEH_EepromData.ydiMemory_xau16[5].amb_cond.ambient_condition[1][18] "ambient condition shot [0 .. 2-1] with 25 data bytes [0 .. 25-1] for the error code stored in this error memory slot" UBYTE EH_STANDARD_S5_S3 1 100 0 255 DISPLAY_IDENTIFIER ambient_condition[1][18].amb_cond.ydiMemory_xau16[5].ZFEH_EepromData ECU_ADDRESS 0xFFF829B3 /end MEASUREMENT
/begin MEASUREMENT ZFEH_EepromData.ydiMemory_xau16[5].amb_cond.ambient_condition[1][19] "ambient condition shot [0 .. 2-1] with 25 data bytes [0 .. 25-1] for the error code stored in this error memory slot" UBYTE EH_STANDARD_S5_S3 1 100 0 255 DISPLAY_IDENTIFIER ambient_condition[1][19].amb_cond.ydiMemory_xau16[5].ZFEH_EepromData ECU_ADDRESS 0xFFF829B4 /end MEASUREMENT
/begin MEASUREMENT ZFEH_EepromData.ydiMemory_xau16[5].amb_cond.ambient_condition[1][20] "ambient condition shot [0 .. 2-1] with 25 data bytes [0 .. 25-1] for the error code stored in this error memory slot" UBYTE EH_STANDARD_S5_S3 1 100 0 255 DISPLAY_IDENTIFIER ambient_condition[1][20].amb_cond.ydiMemory_xau16[5].ZFEH_EepromData ECU_ADDRESS 0xFFF829B5 /end MEASUREMENT
/begin MEASUREMENT ZFEH_EepromData.ydiMemory_xau16[5].amb_cond.ambient_condition[1][21] "ambient condition shot [0 .. 2-1] with 25 data bytes [0 .. 25-1] for the error code stored in this error memory slot" UBYTE EH_STANDARD_S5_S3 1 100 0 255 DISPLAY_IDENTIFIER ambient_condition[1][21].amb_cond.ydiMemory_xau16[5].ZFEH_EepromData ECU_ADDRESS 0xFFF829B6 /end MEASUREMENT
/begin MEASUREMENT ZFEH_EepromData.ydiMemory_xau16[5].amb_cond.ambient_condition[1][22] "ambient condition shot [0 .. 2-1] with 25 data bytes [0 .. 25-1] for the error code stored in this error memory slot" UBYTE EH_STANDARD_S5_S3 1 100 0 255 DISPLAY_IDENTIFIER ambient_condition[1][22].amb_cond.ydiMemory_xau16[5].ZFEH_EepromData ECU_ADDRESS 0xFFF829B7 /end MEASUREMENT
/begin MEASUREMENT ZFEH_EepromData.ydiMemory_xau16[5].amb_cond.ambient_condition[1][23] "ambient condition shot [0 .. 2-1] with 25 data bytes [0 .. 25-1] for the error code stored in this error memory slot" UBYTE EH_STANDARD_S5_S3 1 100 0 255 DISPLAY_IDENTIFIER ambient_condition[1][23].amb_cond.ydiMemory_xau16[5].ZFEH_EepromData ECU_ADDRESS 0xFFF829B8 /end MEASUREMENT
/begin MEASUREMENT ZFEH_EepromData.ydiMemory_xau16[5].amb_cond.ambient_condition[1][24] "ambient condition shot [0 .. 2-1] with 25 data bytes [0 .. 25-1] for the error code stored in this error memory slot" UBYTE EH_STANDARD_S5_S3 1 100 0 255 DISPLAY_IDENTIFIER ambient_condition[1][24].amb_cond.ydiMemory_xau16[5].ZFEH_EepromData ECU_ADDRESS 0xFFF829B9 /end MEASUREMENT
/begin MEASUREMENT ZFEH_EepromData.ydiMemory_xau16[5].amb_cond.status_of_ambient_conditions[0] "status of ambient condition shot x: 0=invalid 1=valid" UBYTE EH_STANDARD_S5_S3 1 100 0 1 DISPLAY_IDENTIFIER status_of_ambient_conditions[0].amb_cond.ydiMemory_xau16[5].ZFEH_EepromData ECU_ADDRESS 0xFFF829BA /end MEASUREMENT
/begin MEASUREMENT ZFEH_EepromData.ydiMemory_xau16[5].amb_cond.status_of_ambient_conditions[1] "status of ambient condition shot x: 0=invalid 1=valid" UBYTE EH_STANDARD_S5_S3 1 100 0 1 DISPLAY_IDENTIFIER status_of_ambient_conditions[1].amb_cond.ydiMemory_xau16[5].ZFEH_EepromData ECU_ADDRESS 0xFFF829BB /end MEASUREMENT
/begin MEASUREMENT ZFEH_EepromData.ydiMemory_xau16[5].error_code "error code stored in error memory slot" UWORD CONV_KFC_NAME 0 255 0 65535 DISPLAY_IDENTIFIER error_code.ydiMemory_xau16[5].ZFEH_EepromData ECU_ADDRESS 0xFFF82974 /end MEASUREMENT
/begin MEASUREMENT ZFEH_EepromData.ydiMemory_xau16[5].error_type "error type of error code stored in error memory slot" UWORD EH_STANDARD_S5_S3 1 100 0 65535 DISPLAY_IDENTIFIER error_type.ydiMemory_xau16[5].ZFEH_EepromData ECU_ADDRESS 0xFFF82976 /end MEASUREMENT
/begin MEASUREMENT ZFEH_EepromData.ydiMemory_xau16[5].status_word "status word of error code stored in error memory slot" UWORD EH_STANDARD_S5_S3 1 100 0 65535 DISPLAY_IDENTIFIER status_word.ydiMemory_xau16[5].ZFEH_EepromData ECU_ADDRESS 0xFFF82978 /end MEASUREMENT
/begin MEASUREMENT ZFEH_EepromData.ydiMemory_xau16[5].frequency_counter "frequency counter of error code stored in error memory slot" UBYTE EH_STANDARD_S5_S3 1 100 0 255 DISPLAY_IDENTIFIER frequency_counter.ydiMemory_xau16[5].ZFEH_EepromData ECU_ADDRESS 0xFFF8297A /end MEASUREMENT
/begin MEASUREMENT ZFEH_EepromData.ydiMemory_xau16[5].backwards_counter "backwards counter of error code stored in error memory slot" UBYTE EH_STANDARD_S5_S3 1 100 0 255 DISPLAY_IDENTIFIER backwards_counter.ydiMemory_xau16[5].ZFEH_EepromData ECU_ADDRESS 0xFFF8297B /end MEASUREMENT
/begin MEASUREMENT ZFEH_EepromData.ydiMemory_xau16[5].permanent_counter "counter of permanent error codes stored in error memory slot" UBYTE EH_STANDARD_S5_S3 1 100 0 255 DISPLAY_IDENTIFIER permanent_counter.ydiMemory_xau16[5].ZFEH_EepromData ECU_ADDRESS 0xFFF8297C /end MEASUREMENT
/begin MEASUREMENT ZFEH_EepromData.ydiMemory_xau16[5].sequence_counter "sequence counter of error code stored in error memory slot" UBYTE EH_STANDARD_S5_S3 1 100 0 255 DISPLAY_IDENTIFIER sequence_counter.ydiMemory_xau16[5].ZFEH_EepromData ECU_ADDRESS 0xFFF8297D /end MEASUREMENT
/begin MEASUREMENT ZFEH_EepromData.ydiMemory_xau16[5].master_time "master time of error code stored in error memory slot" ULONG EH_STANDARD_S5_S3 1 100 0 4294967295 DISPLAY_IDENTIFIER master_time.ydiMemory_xau16[5].ZFEH_EepromData ECU_ADDRESS 0xFFF82980 /end MEASUREMENT
/begin MEASUREMENT ZFEH_EepromData.ydiMemory_xau16[5].condition_byte "condition byte of error code stored in error memory slot" UBYTE EH_STANDARD_S5_S3 1 100 0 255 DISPLAY_IDENTIFIER condition_byte.ydiMemory_xau16[5].ZFEH_EepromData ECU_ADDRESS 0xFFF82985 /end MEASUREMENT
/begin MEASUREMENT ZFEH_EepromData.ydiMemory_xau16[5].obd_driving_cycle_counter "obd driving cycle counter of error code stored in error memory slot" UWORD EH_STANDARD_S5_S3 1 100 0 65535 DISPLAY_IDENTIFIER obd_driving_cycle_counter.ydiMemory_xau16[5].ZFEH_EepromData ECU_ADDRESS 0xFFF82986 /end MEASUREMENT
/begin MEASUREMENT ZFEH_EepromData.ydiMemory_xau16[6].amb_cond.ambient_condition[0][0] "ambient condition shot [0 .. 2-1] with 25 data bytes [0 .. 25-1] for the error code stored in this error memory slot" UBYTE EH_STANDARD_S5_S3 1 100 0 255 DISPLAY_IDENTIFIER ambient_condition[0][0].amb_cond.ydiMemory_xau16[6].ZFEH_EepromData ECU_ADDRESS 0xFFF829D0 /end MEASUREMENT
/begin MEASUREMENT ZFEH_EepromData.ydiMemory_xau16[6].amb_cond.ambient_condition[0][1] "ambient condition shot [0 .. 2-1] with 25 data bytes [0 .. 25-1] for the error code stored in this error memory slot" UBYTE EH_STANDARD_S5_S3 1 100 0 255 DISPLAY_IDENTIFIER ambient_condition[0][1].amb_cond.ydiMemory_xau16[6].ZFEH_EepromData ECU_ADDRESS 0xFFF829D1 /end MEASUREMENT
/begin MEASUREMENT ZFEH_EepromData.ydiMemory_xau16[6].amb_cond.ambient_condition[0][2] "ambient condition shot [0 .. 2-1] with 25 data bytes [0 .. 25-1] for the error code stored in this error memory slot" UBYTE EH_STANDARD_S5_S3 1 100 0 255 DISPLAY_IDENTIFIER ambient_condition[0][2].amb_cond.ydiMemory_xau16[6].ZFEH_EepromData ECU_ADDRESS 0xFFF829D2 /end MEASUREMENT
/begin MEASUREMENT ZFEH_EepromData.ydiMemory_xau16[6].amb_cond.ambient_condition[0][3] "ambient condition shot [0 .. 2-1] with 25 data bytes [0 .. 25-1] for the error code stored in this error memory slot" UBYTE EH_STANDARD_S5_S3 1 100 0 255 DISPLAY_IDENTIFIER ambient_condition[0][3].amb_cond.ydiMemory_xau16[6].ZFEH_EepromData ECU_ADDRESS 0xFFF829D3 /end MEASUREMENT
/begin MEASUREMENT ZFEH_EepromData.ydiMemory_xau16[6].amb_cond.ambient_condition[0][4] "ambient condition shot [0 .. 2-1] with 25 data bytes [0 .. 25-1] for the error code stored in this error memory slot" UBYTE EH_STANDARD_S5_S3 1 100 0 255 DISPLAY_IDENTIFIER ambient_condition[0][4].amb_cond.ydiMemory_xau16[6].ZFEH_EepromData ECU_ADDRESS 0xFFF829D4 /end MEASUREMENT
/begin MEASUREMENT ZFEH_EepromData.ydiMemory_xau16[6].amb_cond.ambient_condition[0][5] "ambient condition shot [0 .. 2-1] with 25 data bytes [0 .. 25-1] for the error code stored in this error memory slot" UBYTE EH_STANDARD_S5_S3 1 100 0 255 DISPLAY_IDENTIFIER ambient_condition[0][5].amb_cond.ydiMemory_xau16[6].ZFEH_EepromData ECU_ADDRESS 0xFFF829D5 /end MEASUREMENT
/begin MEASUREMENT ZFEH_EepromData.ydiMemory_xau16[6].amb_cond.ambient_condition[0][6] "ambient condition shot [0 .. 2-1] with 25 data bytes [0 .. 25-1] for the error code stored in this error memory slot" UBYTE EH_STANDARD_S5_S3 1 100 0 255 DISPLAY_IDENTIFIER ambient_condition[0][6].amb_cond.ydiMemory_xau16[6].ZFEH_EepromData ECU_ADDRESS 0xFFF829D6 /end MEASUREMENT
/begin MEASUREMENT ZFEH_EepromData.ydiMemory_xau16[6].amb_cond.ambient_condition[0][7] "ambient condition shot [0 .. 2-1] with 25 data bytes [0 .. 25-1] for the error code stored in this error memory slot" UBYTE EH_STANDARD_S5_S3 1 100 0 255 DISPLAY_IDENTIFIER ambient_condition[0][7].amb_cond.ydiMemory_xau16[6].ZFEH_EepromData ECU_ADDRESS 0xFFF829D7 /end MEASUREMENT
/begin MEASUREMENT ZFEH_EepromData.ydiMemory_xau16[6].amb_cond.ambient_condition[0][8] "ambient condition shot [0 .. 2-1] with 25 data bytes [0 .. 25-1] for the error code stored in this error memory slot" UBYTE EH_STANDARD_S5_S3 1 100 0 255 DISPLAY_IDENTIFIER ambient_condition[0][8].amb_cond.ydiMemory_xau16[6].ZFEH_EepromData ECU_ADDRESS 0xFFF829D8 /end MEASUREMENT
/begin MEASUREMENT ZFEH_EepromData.ydiMemory_xau16[6].amb_cond.ambient_condition[0][9] "ambient condition shot [0 .. 2-1] with 25 data bytes [0 .. 25-1] for the error code stored in this error memory slot" UBYTE EH_STANDARD_S5_S3 1 100 0 255 DISPLAY_IDENTIFIER ambient_condition[0][9].amb_cond.ydiMemory_xau16[6].ZFEH_EepromData ECU_ADDRESS 0xFFF829D9 /end MEASUREMENT
/begin MEASUREMENT ZFEH_EepromData.ydiMemory_xau16[6].amb_cond.ambient_condition[0][10] "ambient condition shot [0 .. 2-1] with 25 data bytes [0 .. 25-1] for the error code stored in this error memory slot" UBYTE EH_STANDARD_S5_S3 1 100 0 255 DISPLAY_IDENTIFIER ambient_condition[0][10].amb_cond.ydiMemory_xau16[6].ZFEH_EepromData ECU_ADDRESS 0xFFF829DA /end MEASUREMENT
/begin MEASUREMENT ZFEH_EepromData.ydiMemory_xau16[6].amb_cond.ambient_condition[0][11] "ambient condition shot [0 .. 2-1] with 25 data bytes [0 .. 25-1] for the error code stored in this error memory slot" UBYTE EH_STANDARD_S5_S3 1 100 0 255 DISPLAY_IDENTIFIER ambient_condition[0][11].amb_cond.ydiMemory_xau16[6].ZFEH_EepromData ECU_ADDRESS 0xFFF829DB /end MEASUREMENT
/begin MEASUREMENT ZFEH_EepromData.ydiMemory_xau16[6].amb_cond.ambient_condition[0][12] "ambient condition shot [0 .. 2-1] with 25 data bytes [0 .. 25-1] for the error code stored in this error memory slot" UBYTE EH_STANDARD_S5_S3 1 100 0 255 DISPLAY_IDENTIFIER ambient_condition[0][12].amb_cond.ydiMemory_xau16[6].ZFEH_EepromData ECU_ADDRESS 0xFFF829DC /end MEASUREMENT
/begin MEASUREMENT ZFEH_EepromData.ydiMemory_xau16[6].amb_cond.ambient_condition[0][13] "ambient condition shot [0 .. 2-1] with 25 data bytes [0 .. 25-1] for the error code stored in this error memory slot" UBYTE EH_STANDARD_S5_S3 1 100 0 255 DISPLAY_IDENTIFIER ambient_condition[0][13].amb_cond.ydiMemory_xau16[6].ZFEH_EepromData ECU_ADDRESS 0xFFF829DD /end MEASUREMENT
/begin MEASUREMENT ZFEH_EepromData.ydiMemory_xau16[6].amb_cond.ambient_condition[0][14] "ambient condition shot [0 .. 2-1] with 25 data bytes [0 .. 25-1] for the error code stored in this error memory slot" UBYTE EH_STANDARD_S5_S3 1 100 0 255 DISPLAY_IDENTIFIER ambient_condition[0][14].amb_cond.ydiMemory_xau16[6].ZFEH_EepromData ECU_ADDRESS 0xFFF829DE /end MEASUREMENT
/begin MEASUREMENT ZFEH_EepromData.ydiMemory_xau16[6].amb_cond.ambient_condition[0][15] "ambient condition shot [0 .. 2-1] with 25 data bytes [0 .. 25-1] for the error code stored in this error memory slot" UBYTE EH_STANDARD_S5_S3 1 100 0 255 DISPLAY_IDENTIFIER ambient_condition[0][15].amb_cond.ydiMemory_xau16[6].ZFEH_EepromData ECU_ADDRESS 0xFFF829DF /end MEASUREMENT
/begin MEASUREMENT ZFEH_EepromData.ydiMemory_xau16[6].amb_cond.ambient_condition[0][16] "ambient condition shot [0 .. 2-1] with 25 data bytes [0 .. 25-1] for the error code stored in this error memory slot" UBYTE EH_STANDARD_S5_S3 1 100 0 255 DISPLAY_IDENTIFIER ambient_condition[0][16].amb_cond.ydiMemory_xau16[6].ZFEH_EepromData ECU_ADDRESS 0xFFF829E0 /end MEASUREMENT
/begin MEASUREMENT ZFEH_EepromData.ydiMemory_xau16[6].amb_cond.ambient_condition[0][17] "ambient condition shot [0 .. 2-1] with 25 data bytes [0 .. 25-1] for the error code stored in this error memory slot" UBYTE EH_STANDARD_S5_S3 1 100 0 255 DISPLAY_IDENTIFIER ambient_condition[0][17].amb_cond.ydiMemory_xau16[6].ZFEH_EepromData ECU_ADDRESS 0xFFF829E1 /end MEASUREMENT
/begin MEASUREMENT ZFEH_EepromData.ydiMemory_xau16[6].amb_cond.ambient_condition[0][18] "ambient condition shot [0 .. 2-1] with 25 data bytes [0 .. 25-1] for the error code stored in this error memory slot" UBYTE EH_STANDARD_S5_S3 1 100 0 255 DISPLAY_IDENTIFIER ambient_condition[0][18].amb_cond.ydiMemory_xau16[6].ZFEH_EepromData ECU_ADDRESS 0xFFF829E2 /end MEASUREMENT
/begin MEASUREMENT ZFEH_EepromData.ydiMemory_xau16[6].amb_cond.ambient_condition[0][19] "ambient condition shot [0 .. 2-1] with 25 data bytes [0 .. 25-1] for the error code stored in this error memory slot" UBYTE EH_STANDARD_S5_S3 1 100 0 255 DISPLAY_IDENTIFIER ambient_condition[0][19].amb_cond.ydiMemory_xau16[6].ZFEH_EepromData ECU_ADDRESS 0xFFF829E3 /end MEASUREMENT
/begin MEASUREMENT ZFEH_EepromData.ydiMemory_xau16[6].amb_cond.ambient_condition[0][20] "ambient condition shot [0 .. 2-1] with 25 data bytes [0 .. 25-1] for the error code stored in this error memory slot" UBYTE EH_STANDARD_S5_S3 1 100 0 255 DISPLAY_IDENTIFIER ambient_condition[0][20].amb_cond.ydiMemory_xau16[6].ZFEH_EepromData ECU_ADDRESS 0xFFF829E4 /end MEASUREMENT
/begin MEASUREMENT ZFEH_EepromData.ydiMemory_xau16[6].amb_cond.ambient_condition[0][21] "ambient condition shot [0 .. 2-1] with 25 data bytes [0 .. 25-1] for the error code stored in this error memory slot" UBYTE EH_STANDARD_S5_S3 1 100 0 255 DISPLAY_IDENTIFIER ambient_condition[0][21].amb_cond.ydiMemory_xau16[6].ZFEH_EepromData ECU_ADDRESS 0xFFF829E5 /end MEASUREMENT
/begin MEASUREMENT ZFEH_EepromData.ydiMemory_xau16[6].amb_cond.ambient_condition[0][22] "ambient condition shot [0 .. 2-1] with 25 data bytes [0 .. 25-1] for the error code stored in this error memory slot" UBYTE EH_STANDARD_S5_S3 1 100 0 255 DISPLAY_IDENTIFIER ambient_condition[0][22].amb_cond.ydiMemory_xau16[6].ZFEH_EepromData ECU_ADDRESS 0xFFF829E6 /end MEASUREMENT
/begin MEASUREMENT ZFEH_EepromData.ydiMemory_xau16[6].amb_cond.ambient_condition[0][23] "ambient condition shot [0 .. 2-1] with 25 data bytes [0 .. 25-1] for the error code stored in this error memory slot" UBYTE EH_STANDARD_S5_S3 1 100 0 255 DISPLAY_IDENTIFIER ambient_condition[0][23].amb_cond.ydiMemory_xau16[6].ZFEH_EepromData ECU_ADDRESS 0xFFF829E7 /end MEASUREMENT
/begin MEASUREMENT ZFEH_EepromData.ydiMemory_xau16[6].amb_cond.ambient_condition[0][24] "ambient condition shot [0 .. 2-1] with 25 data bytes [0 .. 25-1] for the error code stored in this error memory slot" UBYTE EH_STANDARD_S5_S3 1 100 0 255 DISPLAY_IDENTIFIER ambient_condition[0][24].amb_cond.ydiMemory_xau16[6].ZFEH_EepromData ECU_ADDRESS 0xFFF829E8 /end MEASUREMENT
/begin MEASUREMENT ZFEH_EepromData.ydiMemory_xau16[6].amb_cond.ambient_condition[1][0] "ambient condition shot [0 .. 2-1] with 25 data bytes [0 .. 25-1] for the error code stored in this error memory slot" UBYTE EH_STANDARD_S5_S3 1 100 0 255 DISPLAY_IDENTIFIER ambient_condition[1][0].amb_cond.ydiMemory_xau16[6].ZFEH_EepromData ECU_ADDRESS 0xFFF829E9 /end MEASUREMENT
/begin MEASUREMENT ZFEH_EepromData.ydiMemory_xau16[6].amb_cond.ambient_condition[1][1] "ambient condition shot [0 .. 2-1] with 25 data bytes [0 .. 25-1] for the error code stored in this error memory slot" UBYTE EH_STANDARD_S5_S3 1 100 0 255 DISPLAY_IDENTIFIER ambient_condition[1][1].amb_cond.ydiMemory_xau16[6].ZFEH_EepromData ECU_ADDRESS 0xFFF829EA /end MEASUREMENT
/begin MEASUREMENT ZFEH_EepromData.ydiMemory_xau16[6].amb_cond.ambient_condition[1][2] "ambient condition shot [0 .. 2-1] with 25 data bytes [0 .. 25-1] for the error code stored in this error memory slot" UBYTE EH_STANDARD_S5_S3 1 100 0 255 DISPLAY_IDENTIFIER ambient_condition[1][2].amb_cond.ydiMemory_xau16[6].ZFEH_EepromData ECU_ADDRESS 0xFFF829EB /end MEASUREMENT
/begin MEASUREMENT ZFEH_EepromData.ydiMemory_xau16[6].amb_cond.ambient_condition[1][3] "ambient condition shot [0 .. 2-1] with 25 data bytes [0 .. 25-1] for the error code stored in this error memory slot" UBYTE EH_STANDARD_S5_S3 1 100 0 255 DISPLAY_IDENTIFIER ambient_condition[1][3].amb_cond.ydiMemory_xau16[6].ZFEH_EepromData ECU_ADDRESS 0xFFF829EC /end MEASUREMENT
/begin MEASUREMENT ZFEH_EepromData.ydiMemory_xau16[6].amb_cond.ambient_condition[1][4] "ambient condition shot [0 .. 2-1] with 25 data bytes [0 .. 25-1] for the error code stored in this error memory slot" UBYTE EH_STANDARD_S5_S3 1 100 0 255 DISPLAY_IDENTIFIER ambient_condition[1][4].amb_cond.ydiMemory_xau16[6].ZFEH_EepromData ECU_ADDRESS 0xFFF829ED /end MEASUREMENT
/begin MEASUREMENT ZFEH_EepromData.ydiMemory_xau16[6].amb_cond.ambient_condition[1][5] "ambient condition shot [0 .. 2-1] with 25 data bytes [0 .. 25-1] for the error code stored in this error memory slot" UBYTE EH_STANDARD_S5_S3 1 100 0 255 DISPLAY_IDENTIFIER ambient_condition[1][5].amb_cond.ydiMemory_xau16[6].ZFEH_EepromData ECU_ADDRESS 0xFFF829EE /end MEASUREMENT
/begin MEASUREMENT ZFEH_EepromData.ydiMemory_xau16[6].amb_cond.ambient_condition[1][6] "ambient condition shot [0 .. 2-1] with 25 data bytes [0 .. 25-1] for the error code stored in this error memory slot" UBYTE EH_STANDARD_S5_S3 1 100 0 255 DISPLAY_IDENTIFIER ambient_condition[1][6].amb_cond.ydiMemory_xau16[6].ZFEH_EepromData ECU_ADDRESS 0xFFF829EF /end MEASUREMENT
/begin MEASUREMENT ZFEH_EepromData.ydiMemory_xau16[6].amb_cond.ambient_condition[1][7] "ambient condition shot [0 .. 2-1] with 25 data bytes [0 .. 25-1] for the error code stored in this error memory slot" UBYTE EH_STANDARD_S5_S3 1 100 0 255 DISPLAY_IDENTIFIER ambient_condition[1][7].amb_cond.ydiMemory_xau16[6].ZFEH_EepromData ECU_ADDRESS 0xFFF829F0 /end MEASUREMENT
/begin MEASUREMENT ZFEH_EepromData.ydiMemory_xau16[6].amb_cond.ambient_condition[1][8] "ambient condition shot [0 .. 2-1] with 25 data bytes [0 .. 25-1] for the error code stored in this error memory slot" UBYTE EH_STANDARD_S5_S3 1 100 0 255 DISPLAY_IDENTIFIER ambient_condition[1][8].amb_cond.ydiMemory_xau16[6].ZFEH_EepromData ECU_ADDRESS 0xFFF829F1 /end MEASUREMENT
/begin MEASUREMENT ZFEH_EepromData.ydiMemory_xau16[6].amb_cond.ambient_condition[1][9] "ambient condition shot [0 .. 2-1] with 25 data bytes [0 .. 25-1] for the error code stored in this error memory slot" UBYTE EH_STANDARD_S5_S3 1 100 0 255 DISPLAY_IDENTIFIER ambient_condition[1][9].amb_cond.ydiMemory_xau16[6].ZFEH_EepromData ECU_ADDRESS 0xFFF829F2 /end MEASUREMENT
/begin MEASUREMENT ZFEH_EepromData.ydiMemory_xau16[6].amb_cond.ambient_condition[1][10] "ambient condition shot [0 .. 2-1] with 25 data bytes [0 .. 25-1] for the error code stored in this error memory slot" UBYTE EH_STANDARD_S5_S3 1 100 0 255 DISPLAY_IDENTIFIER ambient_condition[1][10].amb_cond.ydiMemory_xau16[6].ZFEH_EepromData ECU_ADDRESS 0xFFF829F3 /end MEASUREMENT
/begin MEASUREMENT ZFEH_EepromData.ydiMemory_xau16[6].amb_cond.ambient_condition[1][11] "ambient condition shot [0 .. 2-1] with 25 data bytes [0 .. 25-1] for the error code stored in this error memory slot" UBYTE EH_STANDARD_S5_S3 1 100 0 255 DISPLAY_IDENTIFIER ambient_condition[1][11].amb_cond.ydiMemory_xau16[6].ZFEH_EepromData ECU_ADDRESS 0xFFF829F4 /end MEASUREMENT
/begin MEASUREMENT ZFEH_EepromData.ydiMemory_xau16[6].amb_cond.ambient_condition[1][12] "ambient condition shot [0 .. 2-1] with 25 data bytes [0 .. 25-1] for the error code stored in this error memory slot" UBYTE EH_STANDARD_S5_S3 1 100 0 255 DISPLAY_IDENTIFIER ambient_condition[1][12].amb_cond.ydiMemory_xau16[6].ZFEH_EepromData ECU_ADDRESS 0xFFF829F5 /end MEASUREMENT
/begin MEASUREMENT ZFEH_EepromData.ydiMemory_xau16[6].amb_cond.ambient_condition[1][13] "ambient condition shot [0 .. 2-1] with 25 data bytes [0 .. 25-1] for the error code stored in this error memory slot" UBYTE EH_STANDARD_S5_S3 1 100 0 255 DISPLAY_IDENTIFIER ambient_condition[1][13].amb_cond.ydiMemory_xau16[6].ZFEH_EepromData ECU_ADDRESS 0xFFF829F6 /end MEASUREMENT
/begin MEASUREMENT ZFEH_EepromData.ydiMemory_xau16[6].amb_cond.ambient_condition[1][14] "ambient condition shot [0 .. 2-1] with 25 data bytes [0 .. 25-1] for the error code stored in this error memory slot" UBYTE EH_STANDARD_S5_S3 1 100 0 255 DISPLAY_IDENTIFIER ambient_condition[1][14].amb_cond.ydiMemory_xau16[6].ZFEH_EepromData ECU_ADDRESS 0xFFF829F7 /end MEASUREMENT
/begin MEASUREMENT ZFEH_EepromData.ydiMemory_xau16[6].amb_cond.ambient_condition[1][15] "ambient condition shot [0 .. 2-1] with 25 data bytes [0 .. 25-1] for the error code stored in this error memory slot" UBYTE EH_STANDARD_S5_S3 1 100 0 255 DISPLAY_IDENTIFIER ambient_condition[1][15].amb_cond.ydiMemory_xau16[6].ZFEH_EepromData ECU_ADDRESS 0xFFF829F8 /end MEASUREMENT
/begin MEASUREMENT ZFEH_EepromData.ydiMemory_xau16[6].amb_cond.ambient_condition[1][16] "ambient condition shot [0 .. 2-1] with 25 data bytes [0 .. 25-1] for the error code stored in this error memory slot" UBYTE EH_STANDARD_S5_S3 1 100 0 255 DISPLAY_IDENTIFIER ambient_condition[1][16].amb_cond.ydiMemory_xau16[6].ZFEH_EepromData ECU_ADDRESS 0xFFF829F9 /end MEASUREMENT
/begin MEASUREMENT ZFEH_EepromData.ydiMemory_xau16[6].amb_cond.ambient_condition[1][17] "ambient condition shot [0 .. 2-1] with 25 data bytes [0 .. 25-1] for the error code stored in this error memory slot" UBYTE EH_STANDARD_S5_S3 1 100 0 255 DISPLAY_IDENTIFIER ambient_condition[1][17].amb_cond.ydiMemory_xau16[6].ZFEH_EepromData ECU_ADDRESS 0xFFF829FA /end MEASUREMENT
/begin MEASUREMENT ZFEH_EepromData.ydiMemory_xau16[6].amb_cond.ambient_condition[1][18] "ambient condition shot [0 .. 2-1] with 25 data bytes [0 .. 25-1] for the error code stored in this error memory slot" UBYTE EH_STANDARD_S5_S3 1 100 0 255 DISPLAY_IDENTIFIER ambient_condition[1][18].amb_cond.ydiMemory_xau16[6].ZFEH_EepromData ECU_ADDRESS 0xFFF829FB /end MEASUREMENT
/begin MEASUREMENT ZFEH_EepromData.ydiMemory_xau16[6].amb_cond.ambient_condition[1][19] "ambient condition shot [0 .. 2-1] with 25 data bytes [0 .. 25-1] for the error code stored in this error memory slot" UBYTE EH_STANDARD_S5_S3 1 100 0 255 DISPLAY_IDENTIFIER ambient_condition[1][19].amb_cond.ydiMemory_xau16[6].ZFEH_EepromData ECU_ADDRESS 0xFFF829FC /end MEASUREMENT
/begin MEASUREMENT ZFEH_EepromData.ydiMemory_xau16[6].amb_cond.ambient_condition[1][20] "ambient condition shot [0 .. 2-1] with 25 data bytes [0 .. 25-1] for the error code stored in this error memory slot" UBYTE EH_STANDARD_S5_S3 1 100 0 255 DISPLAY_IDENTIFIER ambient_condition[1][20].amb_cond.ydiMemory_xau16[6].ZFEH_EepromData ECU_ADDRESS 0xFFF829FD /end MEASUREMENT
/begin MEASUREMENT ZFEH_EepromData.ydiMemory_xau16[6].amb_cond.ambient_condition[1][21] "ambient condition shot [0 .. 2-1] with 25 data bytes [0 .. 25-1] for the error code stored in this error memory slot" UBYTE EH_STANDARD_S5_S3 1 100 0 255 DISPLAY_IDENTIFIER ambient_condition[1][21].amb_cond.ydiMemory_xau16[6].ZFEH_EepromData ECU_ADDRESS 0xFFF829FE /end MEASUREMENT
/begin MEASUREMENT ZFEH_EepromData.ydiMemory_xau16[6].amb_cond.ambient_condition[1][22] "ambient condition shot [0 .. 2-1] with 25 data bytes [0 .. 25-1] for the error code stored in this error memory slot" UBYTE EH_STANDARD_S5_S3 1 100 0 255 DISPLAY_IDENTIFIER ambient_condition[1][22].amb_cond.ydiMemory_xau16[6].ZFEH_EepromData ECU_ADDRESS 0xFFF829FF /end MEASUREMENT
/begin MEASUREMENT ZFEH_EepromData.ydiMemory_xau16[6].amb_cond.ambient_condition[1][23] "ambient condition shot [0 .. 2-1] with 25 data bytes [0 .. 25-1] for the error code stored in this error memory slot" UBYTE EH_STANDARD_S5_S3 1 100 0 255 DISPLAY_IDENTIFIER ambient_condition[1][23].amb_cond.ydiMemory_xau16[6].ZFEH_EepromData ECU_ADDRESS 0xFFF82A00 /end MEASUREMENT
/begin MEASUREMENT ZFEH_EepromData.ydiMemory_xau16[6].amb_cond.ambient_condition[1][24] "ambient condition shot [0 .. 2-1] with 25 data bytes [0 .. 25-1] for the error code stored in this error memory slot" UBYTE EH_STANDARD_S5_S3 1 100 0 255 DISPLAY_IDENTIFIER ambient_condition[1][24].amb_cond.ydiMemory_xau16[6].ZFEH_EepromData ECU_ADDRESS 0xFFF82A01 /end MEASUREMENT
/begin MEASUREMENT ZFEH_EepromData.ydiMemory_xau16[6].amb_cond.status_of_ambient_conditions[0] "status of ambient condition shot x: 0=invalid 1=valid" UBYTE EH_STANDARD_S5_S3 1 100 0 1 DISPLAY_IDENTIFIER status_of_ambient_conditions[0].amb_cond.ydiMemory_xau16[6].ZFEH_EepromData ECU_ADDRESS 0xFFF82A02 /end MEASUREMENT
/begin MEASUREMENT ZFEH_EepromData.ydiMemory_xau16[6].amb_cond.status_of_ambient_conditions[1] "status of ambient condition shot x: 0=invalid 1=valid" UBYTE EH_STANDARD_S5_S3 1 100 0 1 DISPLAY_IDENTIFIER status_of_ambient_conditions[1].amb_cond.ydiMemory_xau16[6].ZFEH_EepromData ECU_ADDRESS 0xFFF82A03 /end MEASUREMENT
/begin MEASUREMENT ZFEH_EepromData.ydiMemory_xau16[6].error_code "error code stored in error memory slot" UWORD CONV_KFC_NAME 0 255 0 65535 DISPLAY_IDENTIFIER error_code.ydiMemory_xau16[6].ZFEH_EepromData ECU_ADDRESS 0xFFF829BC /end MEASUREMENT
/begin MEASUREMENT ZFEH_EepromData.ydiMemory_xau16[6].error_type "error type of error code stored in error memory slot" UWORD EH_STANDARD_S5_S3 1 100 0 65535 DISPLAY_IDENTIFIER error_type.ydiMemory_xau16[6].ZFEH_EepromData ECU_ADDRESS 0xFFF829BE /end MEASUREMENT
/begin MEASUREMENT ZFEH_EepromData.ydiMemory_xau16[6].status_word "status word of error code stored in error memory slot" UWORD EH_STANDARD_S5_S3 1 100 0 65535 DISPLAY_IDENTIFIER status_word.ydiMemory_xau16[6].ZFEH_EepromData ECU_ADDRESS 0xFFF829C0 /end MEASUREMENT
/begin MEASUREMENT ZFEH_EepromData.ydiMemory_xau16[6].frequency_counter "frequency counter of error code stored in error memory slot" UBYTE EH_STANDARD_S5_S3 1 100 0 255 DISPLAY_IDENTIFIER frequency_counter.ydiMemory_xau16[6].ZFEH_EepromData ECU_ADDRESS 0xFFF829C2 /end MEASUREMENT
/begin MEASUREMENT ZFEH_EepromData.ydiMemory_xau16[6].backwards_counter "backwards counter of error code stored in error memory slot" UBYTE EH_STANDARD_S5_S3 1 100 0 255 DISPLAY_IDENTIFIER backwards_counter.ydiMemory_xau16[6].ZFEH_EepromData ECU_ADDRESS 0xFFF829C3 /end MEASUREMENT
/begin MEASUREMENT ZFEH_EepromData.ydiMemory_xau16[6].permanent_counter "counter of permanent error codes stored in error memory slot" UBYTE EH_STANDARD_S5_S3 1 100 0 255 DISPLAY_IDENTIFIER permanent_counter.ydiMemory_xau16[6].ZFEH_EepromData ECU_ADDRESS 0xFFF829C4 /end MEASUREMENT
/begin MEASUREMENT ZFEH_EepromData.ydiMemory_xau16[6].sequence_counter "sequence counter of error code stored in error memory slot" UBYTE EH_STANDARD_S5_S3 1 100 0 255 DISPLAY_IDENTIFIER sequence_counter.ydiMemory_xau16[6].ZFEH_EepromData ECU_ADDRESS 0xFFF829C5 /end MEASUREMENT
/begin MEASUREMENT ZFEH_EepromData.ydiMemory_xau16[6].master_time "master time of error code stored in error memory slot" ULONG EH_STANDARD_S5_S3 1 100 0 4294967295 DISPLAY_IDENTIFIER master_time.ydiMemory_xau16[6].ZFEH_EepromData ECU_ADDRESS 0xFFF829C8 /end MEASUREMENT
/begin MEASUREMENT ZFEH_EepromData.ydiMemory_xau16[6].condition_byte "condition byte of error code stored in error memory slot" UBYTE EH_STANDARD_S5_S3 1 100 0 255 DISPLAY_IDENTIFIER condition_byte.ydiMemory_xau16[6].ZFEH_EepromData ECU_ADDRESS 0xFFF829CD /end MEASUREMENT
/begin MEASUREMENT ZFEH_EepromData.ydiMemory_xau16[6].obd_driving_cycle_counter "obd driving cycle counter of error code stored in error memory slot" UWORD EH_STANDARD_S5_S3 1 100 0 65535 DISPLAY_IDENTIFIER obd_driving_cycle_counter.ydiMemory_xau16[6].ZFEH_EepromData ECU_ADDRESS 0xFFF829CE /end MEASUREMENT
/begin MEASUREMENT ZFEH_EepromData.ydiMemory_xau16[7].amb_cond.ambient_condition[0][0] "ambient condition shot [0 .. 2-1] with 25 data bytes [0 .. 25-1] for the error code stored in this error memory slot" UBYTE EH_STANDARD_S5_S3 1 100 0 255 DISPLAY_IDENTIFIER ambient_condition[0][0].amb_cond.ydiMemory_xau16[7].ZFEH_EepromData ECU_ADDRESS 0xFFF82A18 /end MEASUREMENT
/begin MEASUREMENT ZFEH_EepromData.ydiMemory_xau16[7].amb_cond.ambient_condition[0][1] "ambient condition shot [0 .. 2-1] with 25 data bytes [0 .. 25-1] for the error code stored in this error memory slot" UBYTE EH_STANDARD_S5_S3 1 100 0 255 DISPLAY_IDENTIFIER ambient_condition[0][1].amb_cond.ydiMemory_xau16[7].ZFEH_EepromData ECU_ADDRESS 0xFFF82A19 /end MEASUREMENT
/begin MEASUREMENT ZFEH_EepromData.ydiMemory_xau16[7].amb_cond.ambient_condition[0][2] "ambient condition shot [0 .. 2-1] with 25 data bytes [0 .. 25-1] for the error code stored in this error memory slot" UBYTE EH_STANDARD_S5_S3 1 100 0 255 DISPLAY_IDENTIFIER ambient_condition[0][2].amb_cond.ydiMemory_xau16[7].ZFEH_EepromData ECU_ADDRESS 0xFFF82A1A /end MEASUREMENT
/begin MEASUREMENT ZFEH_EepromData.ydiMemory_xau16[7].amb_cond.ambient_condition[0][3] "ambient condition shot [0 .. 2-1] with 25 data bytes [0 .. 25-1] for the error code stored in this error memory slot" UBYTE EH_STANDARD_S5_S3 1 100 0 255 DISPLAY_IDENTIFIER ambient_condition[0][3].amb_cond.ydiMemory_xau16[7].ZFEH_EepromData ECU_ADDRESS 0xFFF82A1B /end MEASUREMENT
/begin MEASUREMENT ZFEH_EepromData.ydiMemory_xau16[7].amb_cond.ambient_condition[0][4] "ambient condition shot [0 .. 2-1] with 25 data bytes [0 .. 25-1] for the error code stored in this error memory slot" UBYTE EH_STANDARD_S5_S3 1 100 0 255 DISPLAY_IDENTIFIER ambient_condition[0][4].amb_cond.ydiMemory_xau16[7].ZFEH_EepromData ECU_ADDRESS 0xFFF82A1C /end MEASUREMENT
/begin MEASUREMENT ZFEH_EepromData.ydiMemory_xau16[7].amb_cond.ambient_condition[0][5] "ambient condition shot [0 .. 2-1] with 25 data bytes [0 .. 25-1] for the error code stored in this error memory slot" UBYTE EH_STANDARD_S5_S3 1 100 0 255 DISPLAY_IDENTIFIER ambient_condition[0][5].amb_cond.ydiMemory_xau16[7].ZFEH_EepromData ECU_ADDRESS 0xFFF82A1D /end MEASUREMENT
/begin MEASUREMENT ZFEH_EepromData.ydiMemory_xau16[7].amb_cond.ambient_condition[0][6] "ambient condition shot [0 .. 2-1] with 25 data bytes [0 .. 25-1] for the error code stored in this error memory slot" UBYTE EH_STANDARD_S5_S3 1 100 0 255 DISPLAY_IDENTIFIER ambient_condition[0][6].amb_cond.ydiMemory_xau16[7].ZFEH_EepromData ECU_ADDRESS 0xFFF82A1E /end MEASUREMENT
/begin MEASUREMENT ZFEH_EepromData.ydiMemory_xau16[7].amb_cond.ambient_condition[0][7] "ambient condition shot [0 .. 2-1] with 25 data bytes [0 .. 25-1] for the error code stored in this error memory slot" UBYTE EH_STANDARD_S5_S3 1 100 0 255 DISPLAY_IDENTIFIER ambient_condition[0][7].amb_cond.ydiMemory_xau16[7].ZFEH_EepromData ECU_ADDRESS 0xFFF82A1F /end MEASUREMENT
/begin MEASUREMENT ZFEH_EepromData.ydiMemory_xau16[7].amb_cond.ambient_condition[0][8] "ambient condition shot [0 .. 2-1] with 25 data bytes [0 .. 25-1] for the error code stored in this error memory slot" UBYTE EH_STANDARD_S5_S3 1 100 0 255 DISPLAY_IDENTIFIER ambient_condition[0][8].amb_cond.ydiMemory_xau16[7].ZFEH_EepromData ECU_ADDRESS 0xFFF82A20 /end MEASUREMENT
/begin MEASUREMENT ZFEH_EepromData.ydiMemory_xau16[7].amb_cond.ambient_condition[0][9] "ambient condition shot [0 .. 2-1] with 25 data bytes [0 .. 25-1] for the error code stored in this error memory slot" UBYTE EH_STANDARD_S5_S3 1 100 0 255 DISPLAY_IDENTIFIER ambient_condition[0][9].amb_cond.ydiMemory_xau16[7].ZFEH_EepromData ECU_ADDRESS 0xFFF82A21 /end MEASUREMENT
/begin MEASUREMENT ZFEH_EepromData.ydiMemory_xau16[7].amb_cond.ambient_condition[0][10] "ambient condition shot [0 .. 2-1] with 25 data bytes [0 .. 25-1] for the error code stored in this error memory slot" UBYTE EH_STANDARD_S5_S3 1 100 0 255 DISPLAY_IDENTIFIER ambient_condition[0][10].amb_cond.ydiMemory_xau16[7].ZFEH_EepromData ECU_ADDRESS 0xFFF82A22 /end MEASUREMENT
/begin MEASUREMENT ZFEH_EepromData.ydiMemory_xau16[7].amb_cond.ambient_condition[0][11] "ambient condition shot [0 .. 2-1] with 25 data bytes [0 .. 25-1] for the error code stored in this error memory slot" UBYTE EH_STANDARD_S5_S3 1 100 0 255 DISPLAY_IDENTIFIER ambient_condition[0][11].amb_cond.ydiMemory_xau16[7].ZFEH_EepromData ECU_ADDRESS 0xFFF82A23 /end MEASUREMENT
/begin MEASUREMENT ZFEH_EepromData.ydiMemory_xau16[7].amb_cond.ambient_condition[0][12] "ambient condition shot [0 .. 2-1] with 25 data bytes [0 .. 25-1] for the error code stored in this error memory slot" UBYTE EH_STANDARD_S5_S3 1 100 0 255 DISPLAY_IDENTIFIER ambient_condition[0][12].amb_cond.ydiMemory_xau16[7].ZFEH_EepromData ECU_ADDRESS 0xFFF82A24 /end MEASUREMENT
/begin MEASUREMENT ZFEH_EepromData.ydiMemory_xau16[7].amb_cond.ambient_condition[0][13] "ambient condition shot [0 .. 2-1] with 25 data bytes [0 .. 25-1] for the error code stored in this error memory slot" UBYTE EH_STANDARD_S5_S3 1 100 0 255 DISPLAY_IDENTIFIER ambient_condition[0][13].amb_cond.ydiMemory_xau16[7].ZFEH_EepromData ECU_ADDRESS 0xFFF82A25 /end MEASUREMENT
/begin MEASUREMENT ZFEH_EepromData.ydiMemory_xau16[7].amb_cond.ambient_condition[0][14] "ambient condition shot [0 .. 2-1] with 25 data bytes [0 .. 25-1] for the error code stored in this error memory slot" UBYTE EH_STANDARD_S5_S3 1 100 0 255 DISPLAY_IDENTIFIER ambient_condition[0][14].amb_cond.ydiMemory_xau16[7].ZFEH_EepromData ECU_ADDRESS 0xFFF82A26 /end MEASUREMENT
/begin MEASUREMENT ZFEH_EepromData.ydiMemory_xau16[7].amb_cond.ambient_condition[0][15] "ambient condition shot [0 .. 2-1] with 25 data bytes [0 .. 25-1] for the error code stored in this error memory slot" UBYTE EH_STANDARD_S5_S3 1 100 0 255 DISPLAY_IDENTIFIER ambient_condition[0][15].amb_cond.ydiMemory_xau16[7].ZFEH_EepromData ECU_ADDRESS 0xFFF82A27 /end MEASUREMENT
/begin MEASUREMENT ZFEH_EepromData.ydiMemory_xau16[7].amb_cond.ambient_condition[0][16] "ambient condition shot [0 .. 2-1] with 25 data bytes [0 .. 25-1] for the error code stored in this error memory slot" UBYTE EH_STANDARD_S5_S3 1 100 0 255 DISPLAY_IDENTIFIER ambient_condition[0][16].amb_cond.ydiMemory_xau16[7].ZFEH_EepromData ECU_ADDRESS 0xFFF82A28 /end MEASUREMENT
/begin MEASUREMENT ZFEH_EepromData.ydiMemory_xau16[7].amb_cond.ambient_condition[0][17] "ambient condition shot [0 .. 2-1] with 25 data bytes [0 .. 25-1] for the error code stored in this error memory slot" UBYTE EH_STANDARD_S5_S3 1 100 0 255 DISPLAY_IDENTIFIER ambient_condition[0][17].amb_cond.ydiMemory_xau16[7].ZFEH_EepromData ECU_ADDRESS 0xFFF82A29 /end MEASUREMENT
/begin MEASUREMENT ZFEH_EepromData.ydiMemory_xau16[7].amb_cond.ambient_condition[0][18] "ambient condition shot [0 .. 2-1] with 25 data bytes [0 .. 25-1] for the error code stored in this error memory slot" UBYTE EH_STANDARD_S5_S3 1 100 0 255 DISPLAY_IDENTIFIER ambient_condition[0][18].amb_cond.ydiMemory_xau16[7].ZFEH_EepromData ECU_ADDRESS 0xFFF82A2A /end MEASUREMENT
/begin MEASUREMENT ZFEH_EepromData.ydiMemory_xau16[7].amb_cond.ambient_condition[0][19] "ambient condition shot [0 .. 2-1] with 25 data bytes [0 .. 25-1] for the error code stored in this error memory slot" UBYTE EH_STANDARD_S5_S3 1 100 0 255 DISPLAY_IDENTIFIER ambient_condition[0][19].amb_cond.ydiMemory_xau16[7].ZFEH_EepromData ECU_ADDRESS 0xFFF82A2B /end MEASUREMENT
/begin MEASUREMENT ZFEH_EepromData.ydiMemory_xau16[7].amb_cond.ambient_condition[0][20] "ambient condition shot [0 .. 2-1] with 25 data bytes [0 .. 25-1] for the error code stored in this error memory slot" UBYTE EH_STANDARD_S5_S3 1 100 0 255 DISPLAY_IDENTIFIER ambient_condition[0][20].amb_cond.ydiMemory_xau16[7].ZFEH_EepromData ECU_ADDRESS 0xFFF82A2C /end MEASUREMENT
/begin MEASUREMENT ZFEH_EepromData.ydiMemory_xau16[7].amb_cond.ambient_condition[0][21] "ambient condition shot [0 .. 2-1] with 25 data bytes [0 .. 25-1] for the error code stored in this error memory slot" UBYTE EH_STANDARD_S5_S3 1 100 0 255 DISPLAY_IDENTIFIER ambient_condition[0][21].amb_cond.ydiMemory_xau16[7].ZFEH_EepromData ECU_ADDRESS 0xFFF82A2D /end MEASUREMENT
/begin MEASUREMENT ZFEH_EepromData.ydiMemory_xau16[7].amb_cond.ambient_condition[0][22] "ambient condition shot [0 .. 2-1] with 25 data bytes [0 .. 25-1] for the error code stored in this error memory slot" UBYTE EH_STANDARD_S5_S3 1 100 0 255 DISPLAY_IDENTIFIER ambient_condition[0][22].amb_cond.ydiMemory_xau16[7].ZFEH_EepromData ECU_ADDRESS 0xFFF82A2E /end MEASUREMENT
/begin MEASUREMENT ZFEH_EepromData.ydiMemory_xau16[7].amb_cond.ambient_condition[0][23] "ambient condition shot [0 .. 2-1] with 25 data bytes [0 .. 25-1] for the error code stored in this error memory slot" UBYTE EH_STANDARD_S5_S3 1 100 0 255 DISPLAY_IDENTIFIER ambient_condition[0][23].amb_cond.ydiMemory_xau16[7].ZFEH_EepromData ECU_ADDRESS 0xFFF82A2F /end MEASUREMENT
/begin MEASUREMENT ZFEH_EepromData.ydiMemory_xau16[7].amb_cond.ambient_condition[0][24] "ambient condition shot [0 .. 2-1] with 25 data bytes [0 .. 25-1] for the error code stored in this error memory slot" UBYTE EH_STANDARD_S5_S3 1 100 0 255 DISPLAY_IDENTIFIER ambient_condition[0][24].amb_cond.ydiMemory_xau16[7].ZFEH_EepromData ECU_ADDRESS 0xFFF82A30 /end MEASUREMENT
/begin MEASUREMENT ZFEH_EepromData.ydiMemory_xau16[7].amb_cond.ambient_condition[1][0] "ambient condition shot [0 .. 2-1] with 25 data bytes [0 .. 25-1] for the error code stored in this error memory slot" UBYTE EH_STANDARD_S5_S3 1 100 0 255 DISPLAY_IDENTIFIER ambient_condition[1][0].amb_cond.ydiMemory_xau16[7].ZFEH_EepromData ECU_ADDRESS 0xFFF82A31 /end MEASUREMENT
/begin MEASUREMENT ZFEH_EepromData.ydiMemory_xau16[7].amb_cond.ambient_condition[1][1] "ambient condition shot [0 .. 2-1] with 25 data bytes [0 .. 25-1] for the error code stored in this error memory slot" UBYTE EH_STANDARD_S5_S3 1 100 0 255 DISPLAY_IDENTIFIER ambient_condition[1][1].amb_cond.ydiMemory_xau16[7].ZFEH_EepromData ECU_ADDRESS 0xFFF82A32 /end MEASUREMENT
/begin MEASUREMENT ZFEH_EepromData.ydiMemory_xau16[7].amb_cond.ambient_condition[1][2] "ambient condition shot [0 .. 2-1] with 25 data bytes [0 .. 25-1] for the error code stored in this error memory slot" UBYTE EH_STANDARD_S5_S3 1 100 0 255 DISPLAY_IDENTIFIER ambient_condition[1][2].amb_cond.ydiMemory_xau16[7].ZFEH_EepromData ECU_ADDRESS 0xFFF82A33 /end MEASUREMENT
/begin MEASUREMENT ZFEH_EepromData.ydiMemory_xau16[7].amb_cond.ambient_condition[1][3] "ambient condition shot [0 .. 2-1] with 25 data bytes [0 .. 25-1] for the error code stored in this error memory slot" UBYTE EH_STANDARD_S5_S3 1 100 0 255 DISPLAY_IDENTIFIER ambient_condition[1][3].amb_cond.ydiMemory_xau16[7].ZFEH_EepromData ECU_ADDRESS 0xFFF82A34 /end MEASUREMENT
/begin MEASUREMENT ZFEH_EepromData.ydiMemory_xau16[7].amb_cond.ambient_condition[1][4] "ambient condition shot [0 .. 2-1] with 25 data bytes [0 .. 25-1] for the error code stored in this error memory slot" UBYTE EH_STANDARD_S5_S3 1 100 0 255 DISPLAY_IDENTIFIER ambient_condition[1][4].amb_cond.ydiMemory_xau16[7].ZFEH_EepromData ECU_ADDRESS 0xFFF82A35 /end MEASUREMENT
/begin MEASUREMENT ZFEH_EepromData.ydiMemory_xau16[7].amb_cond.ambient_condition[1][5] "ambient condition shot [0 .. 2-1] with 25 data bytes [0 .. 25-1] for the error code stored in this error memory slot" UBYTE EH_STANDARD_S5_S3 1 100 0 255 DISPLAY_IDENTIFIER ambient_condition[1][5].amb_cond.ydiMemory_xau16[7].ZFEH_EepromData ECU_ADDRESS 0xFFF82A36 /end MEASUREMENT
/begin MEASUREMENT ZFEH_EepromData.ydiMemory_xau16[7].amb_cond.ambient_condition[1][6] "ambient condition shot [0 .. 2-1] with 25 data bytes [0 .. 25-1] for the error code stored in this error memory slot" UBYTE EH_STANDARD_S5_S3 1 100 0 255 DISPLAY_IDENTIFIER ambient_condition[1][6].amb_cond.ydiMemory_xau16[7].ZFEH_EepromData ECU_ADDRESS 0xFFF82A37 /end MEASUREMENT
/begin MEASUREMENT ZFEH_EepromData.ydiMemory_xau16[7].amb_cond.ambient_condition[1][7] "ambient condition shot [0 .. 2-1] with 25 data bytes [0 .. 25-1] for the error code stored in this error memory slot" UBYTE EH_STANDARD_S5_S3 1 100 0 255 DISPLAY_IDENTIFIER ambient_condition[1][7].amb_cond.ydiMemory_xau16[7].ZFEH_EepromData ECU_ADDRESS 0xFFF82A38 /end MEASUREMENT
/begin MEASUREMENT ZFEH_EepromData.ydiMemory_xau16[7].amb_cond.ambient_condition[1][8] "ambient condition shot [0 .. 2-1] with 25 data bytes [0 .. 25-1] for the error code stored in this error memory slot" UBYTE EH_STANDARD_S5_S3 1 100 0 255 DISPLAY_IDENTIFIER ambient_condition[1][8].amb_cond.ydiMemory_xau16[7].ZFEH_EepromData ECU_ADDRESS 0xFFF82A39 /end MEASUREMENT
/begin MEASUREMENT ZFEH_EepromData.ydiMemory_xau16[7].amb_cond.ambient_condition[1][9] "ambient condition shot [0 .. 2-1] with 25 data bytes [0 .. 25-1] for the error code stored in this error memory slot" UBYTE EH_STANDARD_S5_S3 1 100 0 255 DISPLAY_IDENTIFIER ambient_condition[1][9].amb_cond.ydiMemory_xau16[7].ZFEH_EepromData ECU_ADDRESS 0xFFF82A3A /end MEASUREMENT
/begin MEASUREMENT ZFEH_EepromData.ydiMemory_xau16[7].amb_cond.ambient_condition[1][10] "ambient condition shot [0 .. 2-1] with 25 data bytes [0 .. 25-1] for the error code stored in this error memory slot" UBYTE EH_STANDARD_S5_S3 1 100 0 255 DISPLAY_IDENTIFIER ambient_condition[1][10].amb_cond.ydiMemory_xau16[7].ZFEH_EepromData ECU_ADDRESS 0xFFF82A3B /end MEASUREMENT
/begin MEASUREMENT ZFEH_EepromData.ydiMemory_xau16[7].amb_cond.ambient_condition[1][11] "ambient condition shot [0 .. 2-1] with 25 data bytes [0 .. 25-1] for the error code stored in this error memory slot" UBYTE EH_STANDARD_S5_S3 1 100 0 255 DISPLAY_IDENTIFIER ambient_condition[1][11].amb_cond.ydiMemory_xau16[7].ZFEH_EepromData ECU_ADDRESS 0xFFF82A3C /end MEASUREMENT
/begin MEASUREMENT ZFEH_EepromData.ydiMemory_xau16[7].amb_cond.ambient_condition[1][12] "ambient condition shot [0 .. 2-1] with 25 data bytes [0 .. 25-1] for the error code stored in this error memory slot" UBYTE EH_STANDARD_S5_S3 1 100 0 255 DISPLAY_IDENTIFIER ambient_condition[1][12].amb_cond.ydiMemory_xau16[7].ZFEH_EepromData ECU_ADDRESS 0xFFF82A3D /end MEASUREMENT
/begin MEASUREMENT ZFEH_EepromData.ydiMemory_xau16[7].amb_cond.ambient_condition[1][13] "ambient condition shot [0 .. 2-1] with 25 data bytes [0 .. 25-1] for the error code stored in this error memory slot" UBYTE EH_STANDARD_S5_S3 1 100 0 255 DISPLAY_IDENTIFIER ambient_condition[1][13].amb_cond.ydiMemory_xau16[7].ZFEH_EepromData ECU_ADDRESS 0xFFF82A3E /end MEASUREMENT
/begin MEASUREMENT ZFEH_EepromData.ydiMemory_xau16[7].amb_cond.ambient_condition[1][14] "ambient condition shot [0 .. 2-1] with 25 data bytes [0 .. 25-1] for the error code stored in this error memory slot" UBYTE EH_STANDARD_S5_S3 1 100 0 255 DISPLAY_IDENTIFIER ambient_condition[1][14].amb_cond.ydiMemory_xau16[7].ZFEH_EepromData ECU_ADDRESS 0xFFF82A3F /end MEASUREMENT
/begin MEASUREMENT ZFEH_EepromData.ydiMemory_xau16[7].amb_cond.ambient_condition[1][15] "ambient condition shot [0 .. 2-1] with 25 data bytes [0 .. 25-1] for the error code stored in this error memory slot" UBYTE EH_STANDARD_S5_S3 1 100 0 255 DISPLAY_IDENTIFIER ambient_condition[1][15].amb_cond.ydiMemory_xau16[7].ZFEH_EepromData ECU_ADDRESS 0xFFF82A40 /end MEASUREMENT
/begin MEASUREMENT ZFEH_EepromData.ydiMemory_xau16[7].amb_cond.ambient_condition[1][16] "ambient condition shot [0 .. 2-1] with 25 data bytes [0 .. 25-1] for the error code stored in this error memory slot" UBYTE EH_STANDARD_S5_S3 1 100 0 255 DISPLAY_IDENTIFIER ambient_condition[1][16].amb_cond.ydiMemory_xau16[7].ZFEH_EepromData ECU_ADDRESS 0xFFF82A41 /end MEASUREMENT
/begin MEASUREMENT ZFEH_EepromData.ydiMemory_xau16[7].amb_cond.ambient_condition[1][17] "ambient condition shot [0 .. 2-1] with 25 data bytes [0 .. 25-1] for the error code stored in this error memory slot" UBYTE EH_STANDARD_S5_S3 1 100 0 255 DISPLAY_IDENTIFIER ambient_condition[1][17].amb_cond.ydiMemory_xau16[7].ZFEH_EepromData ECU_ADDRESS 0xFFF82A42 /end MEASUREMENT
/begin MEASUREMENT ZFEH_EepromData.ydiMemory_xau16[7].amb_cond.ambient_condition[1][18] "ambient condition shot [0 .. 2-1] with 25 data bytes [0 .. 25-1] for the error code stored in this error memory slot" UBYTE EH_STANDARD_S5_S3 1 100 0 255 DISPLAY_IDENTIFIER ambient_condition[1][18].amb_cond.ydiMemory_xau16[7].ZFEH_EepromData ECU_ADDRESS 0xFFF82A43 /end MEASUREMENT
/begin MEASUREMENT ZFEH_EepromData.ydiMemory_xau16[7].amb_cond.ambient_condition[1][19] "ambient condition shot [0 .. 2-1] with 25 data bytes [0 .. 25-1] for the error code stored in this error memory slot" UBYTE EH_STANDARD_S5_S3 1 100 0 255 DISPLAY_IDENTIFIER ambient_condition[1][19].amb_cond.ydiMemory_xau16[7].ZFEH_EepromData ECU_ADDRESS 0xFFF82A44 /end MEASUREMENT
/begin MEASUREMENT ZFEH_EepromData.ydiMemory_xau16[7].amb_cond.ambient_condition[1][20] "ambient condition shot [0 .. 2-1] with 25 data bytes [0 .. 25-1] for the error code stored in this error memory slot" UBYTE EH_STANDARD_S5_S3 1 100 0 255 DISPLAY_IDENTIFIER ambient_condition[1][20].amb_cond.ydiMemory_xau16[7].ZFEH_EepromData ECU_ADDRESS 0xFFF82A45 /end MEASUREMENT
/begin MEASUREMENT ZFEH_EepromData.ydiMemory_xau16[7].amb_cond.ambient_condition[1][21] "ambient condition shot [0 .. 2-1] with 25 data bytes [0 .. 25-1] for the error code stored in this error memory slot" UBYTE EH_STANDARD_S5_S3 1 100 0 255 DISPLAY_IDENTIFIER ambient_condition[1][21].amb_cond.ydiMemory_xau16[7].ZFEH_EepromData ECU_ADDRESS 0xFFF82A46 /end MEASUREMENT
/begin MEASUREMENT ZFEH_EepromData.ydiMemory_xau16[7].amb_cond.ambient_condition[1][22] "ambient condition shot [0 .. 2-1] with 25 data bytes [0 .. 25-1] for the error code stored in this error memory slot" UBYTE EH_STANDARD_S5_S3 1 100 0 255 DISPLAY_IDENTIFIER ambient_condition[1][22].amb_cond.ydiMemory_xau16[7].ZFEH_EepromData ECU_ADDRESS 0xFFF82A47 /end MEASUREMENT
/begin MEASUREMENT ZFEH_EepromData.ydiMemory_xau16[7].amb_cond.ambient_condition[1][23] "ambient condition shot [0 .. 2-1] with 25 data bytes [0 .. 25-1] for the error code stored in this error memory slot" UBYTE EH_STANDARD_S5_S3 1 100 0 255 DISPLAY_IDENTIFIER ambient_condition[1][23].amb_cond.ydiMemory_xau16[7].ZFEH_EepromData ECU_ADDRESS 0xFFF82A48 /end MEASUREMENT
/begin MEASUREMENT ZFEH_EepromData.ydiMemory_xau16[7].amb_cond.ambient_condition[1][24] "ambient condition shot [0 .. 2-1] with 25 data bytes [0 .. 25-1] for the error code stored in this error memory slot" UBYTE EH_STANDARD_S5_S3 1 100 0 255 DISPLAY_IDENTIFIER ambient_condition[1][24].amb_cond.ydiMemory_xau16[7].ZFEH_EepromData ECU_ADDRESS 0xFFF82A49 /end MEASUREMENT
/begin MEASUREMENT ZFEH_EepromData.ydiMemory_xau16[7].amb_cond.status_of_ambient_conditions[0] "status of ambient condition shot x: 0=invalid 1=valid" UBYTE EH_STANDARD_S5_S3 1 100 0 1 DISPLAY_IDENTIFIER status_of_ambient_conditions[0].amb_cond.ydiMemory_xau16[7].ZFEH_EepromData ECU_ADDRESS 0xFFF82A4A /end MEASUREMENT
/begin MEASUREMENT ZFEH_EepromData.ydiMemory_xau16[7].amb_cond.status_of_ambient_conditions[1] "status of ambient condition shot x: 0=invalid 1=valid" UBYTE EH_STANDARD_S5_S3 1 100 0 1 DISPLAY_IDENTIFIER status_of_ambient_conditions[1].amb_cond.ydiMemory_xau16[7].ZFEH_EepromData ECU_ADDRESS 0xFFF82A4B /end MEASUREMENT
/begin MEASUREMENT ZFEH_EepromData.ydiMemory_xau16[7].error_code "error code stored in error memory slot" UWORD CONV_KFC_NAME 0 255 0 65535 DISPLAY_IDENTIFIER error_code.ydiMemory_xau16[7].ZFEH_EepromData ECU_ADDRESS 0xFFF82A04 /end MEASUREMENT
/begin MEASUREMENT ZFEH_EepromData.ydiMemory_xau16[7].error_type "error type of error code stored in error memory slot" UWORD EH_STANDARD_S5_S3 1 100 0 65535 DISPLAY_IDENTIFIER error_type.ydiMemory_xau16[7].ZFEH_EepromData ECU_ADDRESS 0xFFF82A06 /end MEASUREMENT
/begin MEASUREMENT ZFEH_EepromData.ydiMemory_xau16[7].status_word "status word of error code stored in error memory slot" UWORD EH_STANDARD_S5_S3 1 100 0 65535 DISPLAY_IDENTIFIER status_word.ydiMemory_xau16[7].ZFEH_EepromData ECU_ADDRESS 0xFFF82A08 /end MEASUREMENT
/begin MEASUREMENT ZFEH_EepromData.ydiMemory_xau16[7].frequency_counter "frequency counter of error code stored in error memory slot" UBYTE EH_STANDARD_S5_S3 1 100 0 255 DISPLAY_IDENTIFIER frequency_counter.ydiMemory_xau16[7].ZFEH_EepromData ECU_ADDRESS 0xFFF82A0A /end MEASUREMENT
/begin MEASUREMENT ZFEH_EepromData.ydiMemory_xau16[7].backwards_counter "backwards counter of error code stored in error memory slot" UBYTE EH_STANDARD_S5_S3 1 100 0 255 DISPLAY_IDENTIFIER backwards_counter.ydiMemory_xau16[7].ZFEH_EepromData ECU_ADDRESS 0xFFF82A0B /end MEASUREMENT
/begin MEASUREMENT ZFEH_EepromData.ydiMemory_xau16[7].permanent_counter "counter of permanent error codes stored in error memory slot" UBYTE EH_STANDARD_S5_S3 1 100 0 255 DISPLAY_IDENTIFIER permanent_counter.ydiMemory_xau16[7].ZFEH_EepromData ECU_ADDRESS 0xFFF82A0C /end MEASUREMENT
/begin MEASUREMENT ZFEH_EepromData.ydiMemory_xau16[7].sequence_counter "sequence counter of error code stored in error memory slot" UBYTE EH_STANDARD_S5_S3 1 100 0 255 DISPLAY_IDENTIFIER sequence_counter.ydiMemory_xau16[7].ZFEH_EepromData ECU_ADDRESS 0xFFF82A0D /end MEASUREMENT
/begin MEASUREMENT ZFEH_EepromData.ydiMemory_xau16[7].master_time "master time of error code stored in error memory slot" ULONG EH_STANDARD_S5_S3 1 100 0 4294967295 DISPLAY_IDENTIFIER master_time.ydiMemory_xau16[7].ZFEH_EepromData ECU_ADDRESS 0xFFF82A10 /end MEASUREMENT
/begin MEASUREMENT ZFEH_EepromData.ydiMemory_xau16[7].condition_byte "condition byte of error code stored in error memory slot" UBYTE EH_STANDARD_S5_S3 1 100 0 255 DISPLAY_IDENTIFIER condition_byte.ydiMemory_xau16[7].ZFEH_EepromData ECU_ADDRESS 0xFFF82A15 /end MEASUREMENT
/begin MEASUREMENT ZFEH_EepromData.ydiMemory_xau16[7].obd_driving_cycle_counter "obd driving cycle counter of error code stored in error memory slot" UWORD EH_STANDARD_S5_S3 1 100 0 65535 DISPLAY_IDENTIFIER obd_driving_cycle_counter.ydiMemory_xau16[7].ZFEH_EepromData ECU_ADDRESS 0xFFF82A16 /end MEASUREMENT
/begin MEASUREMENT ZFEH_EepromData.ydiMemory_xau16[8].amb_cond.ambient_condition[0][0] "ambient condition shot [0 .. 2-1] with 25 data bytes [0 .. 25-1] for the error code stored in this error memory slot" UBYTE EH_STANDARD_S5_S3 1 100 0 255 DISPLAY_IDENTIFIER ambient_condition[0][0].amb_cond.ydiMemory_xau16[8].ZFEH_EepromData ECU_ADDRESS 0xFFF82A60 /end MEASUREMENT
/begin MEASUREMENT ZFEH_EepromData.ydiMemory_xau16[8].amb_cond.ambient_condition[0][1] "ambient condition shot [0 .. 2-1] with 25 data bytes [0 .. 25-1] for the error code stored in this error memory slot" UBYTE EH_STANDARD_S5_S3 1 100 0 255 DISPLAY_IDENTIFIER ambient_condition[0][1].amb_cond.ydiMemory_xau16[8].ZFEH_EepromData ECU_ADDRESS 0xFFF82A61 /end MEASUREMENT
/begin MEASUREMENT ZFEH_EepromData.ydiMemory_xau16[8].amb_cond.ambient_condition[0][2] "ambient condition shot [0 .. 2-1] with 25 data bytes [0 .. 25-1] for the error code stored in this error memory slot" UBYTE EH_STANDARD_S5_S3 1 100 0 255 DISPLAY_IDENTIFIER ambient_condition[0][2].amb_cond.ydiMemory_xau16[8].ZFEH_EepromData ECU_ADDRESS 0xFFF82A62 /end MEASUREMENT
/begin MEASUREMENT ZFEH_EepromData.ydiMemory_xau16[8].amb_cond.ambient_condition[0][3] "ambient condition shot [0 .. 2-1] with 25 data bytes [0 .. 25-1] for the error code stored in this error memory slot" UBYTE EH_STANDARD_S5_S3 1 100 0 255 DISPLAY_IDENTIFIER ambient_condition[0][3].amb_cond.ydiMemory_xau16[8].ZFEH_EepromData ECU_ADDRESS 0xFFF82A63 /end MEASUREMENT
/begin MEASUREMENT ZFEH_EepromData.ydiMemory_xau16[8].amb_cond.ambient_condition[0][4] "ambient condition shot [0 .. 2-1] with 25 data bytes [0 .. 25-1] for the error code stored in this error memory slot" UBYTE EH_STANDARD_S5_S3 1 100 0 255 DISPLAY_IDENTIFIER ambient_condition[0][4].amb_cond.ydiMemory_xau16[8].ZFEH_EepromData ECU_ADDRESS 0xFFF82A64 /end MEASUREMENT
/begin MEASUREMENT ZFEH_EepromData.ydiMemory_xau16[8].amb_cond.ambient_condition[0][5] "ambient condition shot [0 .. 2-1] with 25 data bytes [0 .. 25-1] for the error code stored in this error memory slot" UBYTE EH_STANDARD_S5_S3 1 100 0 255 DISPLAY_IDENTIFIER ambient_condition[0][5].amb_cond.ydiMemory_xau16[8].ZFEH_EepromData ECU_ADDRESS 0xFFF82A65 /end MEASUREMENT
/begin MEASUREMENT ZFEH_EepromData.ydiMemory_xau16[8].amb_cond.ambient_condition[0][6] "ambient condition shot [0 .. 2-1] with 25 data bytes [0 .. 25-1] for the error code stored in this error memory slot" UBYTE EH_STANDARD_S5_S3 1 100 0 255 DISPLAY_IDENTIFIER ambient_condition[0][6].amb_cond.ydiMemory_xau16[8].ZFEH_EepromData ECU_ADDRESS 0xFFF82A66 /end MEASUREMENT
/begin MEASUREMENT ZFEH_EepromData.ydiMemory_xau16[8].amb_cond.ambient_condition[0][7] "ambient condition shot [0 .. 2-1] with 25 data bytes [0 .. 25-1] for the error code stored in this error memory slot" UBYTE EH_STANDARD_S5_S3 1 100 0 255 DISPLAY_IDENTIFIER ambient_condition[0][7].amb_cond.ydiMemory_xau16[8].ZFEH_EepromData ECU_ADDRESS 0xFFF82A67 /end MEASUREMENT
/begin MEASUREMENT ZFEH_EepromData.ydiMemory_xau16[8].amb_cond.ambient_condition[0][8] "ambient condition shot [0 .. 2-1] with 25 data bytes [0 .. 25-1] for the error code stored in this error memory slot" UBYTE EH_STANDARD_S5_S3 1 100 0 255 DISPLAY_IDENTIFIER ambient_condition[0][8].amb_cond.ydiMemory_xau16[8].ZFEH_EepromData ECU_ADDRESS 0xFFF82A68 /end MEASUREMENT
/begin MEASUREMENT ZFEH_EepromData.ydiMemory_xau16[8].amb_cond.ambient_condition[0][9] "ambient condition shot [0 .. 2-1] with 25 data bytes [0 .. 25-1] for the error code stored in this error memory slot" UBYTE EH_STANDARD_S5_S3 1 100 0 255 DISPLAY_IDENTIFIER ambient_condition[0][9].amb_cond.ydiMemory_xau16[8].ZFEH_EepromData ECU_ADDRESS 0xFFF82A69 /end MEASUREMENT
/begin MEASUREMENT ZFEH_EepromData.ydiMemory_xau16[8].amb_cond.ambient_condition[0][10] "ambient condition shot [0 .. 2-1] with 25 data bytes [0 .. 25-1] for the error code stored in this error memory slot" UBYTE EH_STANDARD_S5_S3 1 100 0 255 DISPLAY_IDENTIFIER ambient_condition[0][10].amb_cond.ydiMemory_xau16[8].ZFEH_EepromData ECU_ADDRESS 0xFFF82A6A /end MEASUREMENT
/begin MEASUREMENT ZFEH_EepromData.ydiMemory_xau16[8].amb_cond.ambient_condition[0][11] "ambient condition shot [0 .. 2-1] with 25 data bytes [0 .. 25-1] for the error code stored in this error memory slot" UBYTE EH_STANDARD_S5_S3 1 100 0 255 DISPLAY_IDENTIFIER ambient_condition[0][11].amb_cond.ydiMemory_xau16[8].ZFEH_EepromData ECU_ADDRESS 0xFFF82A6B /end MEASUREMENT
/begin MEASUREMENT ZFEH_EepromData.ydiMemory_xau16[8].amb_cond.ambient_condition[0][12] "ambient condition shot [0 .. 2-1] with 25 data bytes [0 .. 25-1] for the error code stored in this error memory slot" UBYTE EH_STANDARD_S5_S3 1 100 0 255 DISPLAY_IDENTIFIER ambient_condition[0][12].amb_cond.ydiMemory_xau16[8].ZFEH_EepromData ECU_ADDRESS 0xFFF82A6C /end MEASUREMENT
/begin MEASUREMENT ZFEH_EepromData.ydiMemory_xau16[8].amb_cond.ambient_condition[0][13] "ambient condition shot [0 .. 2-1] with 25 data bytes [0 .. 25-1] for the error code stored in this error memory slot" UBYTE EH_STANDARD_S5_S3 1 100 0 255 DISPLAY_IDENTIFIER ambient_condition[0][13].amb_cond.ydiMemory_xau16[8].ZFEH_EepromData ECU_ADDRESS 0xFFF82A6D /end MEASUREMENT
/begin MEASUREMENT ZFEH_EepromData.ydiMemory_xau16[8].amb_cond.ambient_condition[0][14] "ambient condition shot [0 .. 2-1] with 25 data bytes [0 .. 25-1] for the error code stored in this error memory slot" UBYTE EH_STANDARD_S5_S3 1 100 0 255 DISPLAY_IDENTIFIER ambient_condition[0][14].amb_cond.ydiMemory_xau16[8].ZFEH_EepromData ECU_ADDRESS 0xFFF82A6E /end MEASUREMENT
/begin MEASUREMENT ZFEH_EepromData.ydiMemory_xau16[8].amb_cond.ambient_condition[0][15] "ambient condition shot [0 .. 2-1] with 25 data bytes [0 .. 25-1] for the error code stored in this error memory slot" UBYTE EH_STANDARD_S5_S3 1 100 0 255 DISPLAY_IDENTIFIER ambient_condition[0][15].amb_cond.ydiMemory_xau16[8].ZFEH_EepromData ECU_ADDRESS 0xFFF82A6F /end MEASUREMENT
/begin MEASUREMENT ZFEH_EepromData.ydiMemory_xau16[8].amb_cond.ambient_condition[0][16] "ambient condition shot [0 .. 2-1] with 25 data bytes [0 .. 25-1] for the error code stored in this error memory slot" UBYTE EH_STANDARD_S5_S3 1 100 0 255 DISPLAY_IDENTIFIER ambient_condition[0][16].amb_cond.ydiMemory_xau16[8].ZFEH_EepromData ECU_ADDRESS 0xFFF82A70 /end MEASUREMENT
/begin MEASUREMENT ZFEH_EepromData.ydiMemory_xau16[8].amb_cond.ambient_condition[0][17] "ambient condition shot [0 .. 2-1] with 25 data bytes [0 .. 25-1] for the error code stored in this error memory slot" UBYTE EH_STANDARD_S5_S3 1 100 0 255 DISPLAY_IDENTIFIER ambient_condition[0][17].amb_cond.ydiMemory_xau16[8].ZFEH_EepromData ECU_ADDRESS 0xFFF82A71 /end MEASUREMENT
/begin MEASUREMENT ZFEH_EepromData.ydiMemory_xau16[8].amb_cond.ambient_condition[0][18] "ambient condition shot [0 .. 2-1] with 25 data bytes [0 .. 25-1] for the error code stored in this error memory slot" UBYTE EH_STANDARD_S5_S3 1 100 0 255 DISPLAY_IDENTIFIER ambient_condition[0][18].amb_cond.ydiMemory_xau16[8].ZFEH_EepromData ECU_ADDRESS 0xFFF82A72 /end MEASUREMENT
/begin MEASUREMENT ZFEH_EepromData.ydiMemory_xau16[8].amb_cond.ambient_condition[0][19] "ambient condition shot [0 .. 2-1] with 25 data bytes [0 .. 25-1] for the error code stored in this error memory slot" UBYTE EH_STANDARD_S5_S3 1 100 0 255 DISPLAY_IDENTIFIER ambient_condition[0][19].amb_cond.ydiMemory_xau16[8].ZFEH_EepromData ECU_ADDRESS 0xFFF82A73 /end MEASUREMENT
/begin MEASUREMENT ZFEH_EepromData.ydiMemory_xau16[8].amb_cond.ambient_condition[0][20] "ambient condition shot [0 .. 2-1] with 25 data bytes [0 .. 25-1] for the error code stored in this error memory slot" UBYTE EH_STANDARD_S5_S3 1 100 0 255 DISPLAY_IDENTIFIER ambient_condition[0][20].amb_cond.ydiMemory_xau16[8].ZFEH_EepromData ECU_ADDRESS 0xFFF82A74 /end MEASUREMENT
/begin MEASUREMENT ZFEH_EepromData.ydiMemory_xau16[8].amb_cond.ambient_condition[0][21] "ambient condition shot [0 .. 2-1] with 25 data bytes [0 .. 25-1] for the error code stored in this error memory slot" UBYTE EH_STANDARD_S5_S3 1 100 0 255 DISPLAY_IDENTIFIER ambient_condition[0][21].amb_cond.ydiMemory_xau16[8].ZFEH_EepromData ECU_ADDRESS 0xFFF82A75 /end MEASUREMENT
/begin MEASUREMENT ZFEH_EepromData.ydiMemory_xau16[8].amb_cond.ambient_condition[0][22] "ambient condition shot [0 .. 2-1] with 25 data bytes [0 .. 25-1] for the error code stored in this error memory slot" UBYTE EH_STANDARD_S5_S3 1 100 0 255 DISPLAY_IDENTIFIER ambient_condition[0][22].amb_cond.ydiMemory_xau16[8].ZFEH_EepromData ECU_ADDRESS 0xFFF82A76 /end MEASUREMENT
/begin MEASUREMENT ZFEH_EepromData.ydiMemory_xau16[8].amb_cond.ambient_condition[0][23] "ambient condition shot [0 .. 2-1] with 25 data bytes [0 .. 25-1] for the error code stored in this error memory slot" UBYTE EH_STANDARD_S5_S3 1 100 0 255 DISPLAY_IDENTIFIER ambient_condition[0][23].amb_cond.ydiMemory_xau16[8].ZFEH_EepromData ECU_ADDRESS 0xFFF82A77 /end MEASUREMENT
/begin MEASUREMENT ZFEH_EepromData.ydiMemory_xau16[8].amb_cond.ambient_condition[0][24] "ambient condition shot [0 .. 2-1] with 25 data bytes [0 .. 25-1] for the error code stored in this error memory slot" UBYTE EH_STANDARD_S5_S3 1 100 0 255 DISPLAY_IDENTIFIER ambient_condition[0][24].amb_cond.ydiMemory_xau16[8].ZFEH_EepromData ECU_ADDRESS 0xFFF82A78 /end MEASUREMENT
/begin MEASUREMENT ZFEH_EepromData.ydiMemory_xau16[8].amb_cond.ambient_condition[1][0] "ambient condition shot [0 .. 2-1] with 25 data bytes [0 .. 25-1] for the error code stored in this error memory slot" UBYTE EH_STANDARD_S5_S3 1 100 0 255 DISPLAY_IDENTIFIER ambient_condition[1][0].amb_cond.ydiMemory_xau16[8].ZFEH_EepromData ECU_ADDRESS 0xFFF82A79 /end MEASUREMENT
/begin MEASUREMENT ZFEH_EepromData.ydiMemory_xau16[8].amb_cond.ambient_condition[1][1] "ambient condition shot [0 .. 2-1] with 25 data bytes [0 .. 25-1] for the error code stored in this error memory slot" UBYTE EH_STANDARD_S5_S3 1 100 0 255 DISPLAY_IDENTIFIER ambient_condition[1][1].amb_cond.ydiMemory_xau16[8].ZFEH_EepromData ECU_ADDRESS 0xFFF82A7A /end MEASUREMENT
/begin MEASUREMENT ZFEH_EepromData.ydiMemory_xau16[8].amb_cond.ambient_condition[1][2] "ambient condition shot [0 .. 2-1] with 25 data bytes [0 .. 25-1] for the error code stored in this error memory slot" UBYTE EH_STANDARD_S5_S3 1 100 0 255 DISPLAY_IDENTIFIER ambient_condition[1][2].amb_cond.ydiMemory_xau16[8].ZFEH_EepromData ECU_ADDRESS 0xFFF82A7B /end MEASUREMENT
/begin MEASUREMENT ZFEH_EepromData.ydiMemory_xau16[8].amb_cond.ambient_condition[1][3] "ambient condition shot [0 .. 2-1] with 25 data bytes [0 .. 25-1] for the error code stored in this error memory slot" UBYTE EH_STANDARD_S5_S3 1 100 0 255 DISPLAY_IDENTIFIER ambient_condition[1][3].amb_cond.ydiMemory_xau16[8].ZFEH_EepromData ECU_ADDRESS 0xFFF82A7C /end MEASUREMENT
/begin MEASUREMENT ZFEH_EepromData.ydiMemory_xau16[8].amb_cond.ambient_condition[1][4] "ambient condition shot [0 .. 2-1] with 25 data bytes [0 .. 25-1] for the error code stored in this error memory slot" UBYTE EH_STANDARD_S5_S3 1 100 0 255 DISPLAY_IDENTIFIER ambient_condition[1][4].amb_cond.ydiMemory_xau16[8].ZFEH_EepromData ECU_ADDRESS 0xFFF82A7D /end MEASUREMENT
/begin MEASUREMENT ZFEH_EepromData.ydiMemory_xau16[8].amb_cond.ambient_condition[1][5] "ambient condition shot [0 .. 2-1] with 25 data bytes [0 .. 25-1] for the error code stored in this error memory slot" UBYTE EH_STANDARD_S5_S3 1 100 0 255 DISPLAY_IDENTIFIER ambient_condition[1][5].amb_cond.ydiMemory_xau16[8].ZFEH_EepromData ECU_ADDRESS 0xFFF82A7E /end MEASUREMENT
/begin MEASUREMENT ZFEH_EepromData.ydiMemory_xau16[8].amb_cond.ambient_condition[1][6] "ambient condition shot [0 .. 2-1] with 25 data bytes [0 .. 25-1] for the error code stored in this error memory slot" UBYTE EH_STANDARD_S5_S3 1 100 0 255 DISPLAY_IDENTIFIER ambient_condition[1][6].amb_cond.ydiMemory_xau16[8].ZFEH_EepromData ECU_ADDRESS 0xFFF82A7F /end MEASUREMENT
/begin MEASUREMENT ZFEH_EepromData.ydiMemory_xau16[8].amb_cond.ambient_condition[1][7] "ambient condition shot [0 .. 2-1] with 25 data bytes [0 .. 25-1] for the error code stored in this error memory slot" UBYTE EH_STANDARD_S5_S3 1 100 0 255 DISPLAY_IDENTIFIER ambient_condition[1][7].amb_cond.ydiMemory_xau16[8].ZFEH_EepromData ECU_ADDRESS 0xFFF82A80 /end MEASUREMENT
/begin MEASUREMENT ZFEH_EepromData.ydiMemory_xau16[8].amb_cond.ambient_condition[1][8] "ambient condition shot [0 .. 2-1] with 25 data bytes [0 .. 25-1] for the error code stored in this error memory slot" UBYTE EH_STANDARD_S5_S3 1 100 0 255 DISPLAY_IDENTIFIER ambient_condition[1][8].amb_cond.ydiMemory_xau16[8].ZFEH_EepromData ECU_ADDRESS 0xFFF82A81 /end MEASUREMENT
/begin MEASUREMENT ZFEH_EepromData.ydiMemory_xau16[8].amb_cond.ambient_condition[1][9] "ambient condition shot [0 .. 2-1] with 25 data bytes [0 .. 25-1] for the error code stored in this error memory slot" UBYTE EH_STANDARD_S5_S3 1 100 0 255 DISPLAY_IDENTIFIER ambient_condition[1][9].amb_cond.ydiMemory_xau16[8].ZFEH_EepromData ECU_ADDRESS 0xFFF82A82 /end MEASUREMENT
/begin MEASUREMENT ZFEH_EepromData.ydiMemory_xau16[8].amb_cond.ambient_condition[1][10] "ambient condition shot [0 .. 2-1] with 25 data bytes [0 .. 25-1] for the error code stored in this error memory slot" UBYTE EH_STANDARD_S5_S3 1 100 0 255 DISPLAY_IDENTIFIER ambient_condition[1][10].amb_cond.ydiMemory_xau16[8].ZFEH_EepromData ECU_ADDRESS 0xFFF82A83 /end MEASUREMENT
/begin MEASUREMENT ZFEH_EepromData.ydiMemory_xau16[8].amb_cond.ambient_condition[1][11] "ambient condition shot [0 .. 2-1] with 25 data bytes [0 .. 25-1] for the error code stored in this error memory slot" UBYTE EH_STANDARD_S5_S3 1 100 0 255 DISPLAY_IDENTIFIER ambient_condition[1][11].amb_cond.ydiMemory_xau16[8].ZFEH_EepromData ECU_ADDRESS 0xFFF82A84 /end MEASUREMENT
/begin MEASUREMENT ZFEH_EepromData.ydiMemory_xau16[8].amb_cond.ambient_condition[1][12] "ambient condition shot [0 .. 2-1] with 25 data bytes [0 .. 25-1] for the error code stored in this error memory slot" UBYTE EH_STANDARD_S5_S3 1 100 0 255 DISPLAY_IDENTIFIER ambient_condition[1][12].amb_cond.ydiMemory_xau16[8].ZFEH_EepromData ECU_ADDRESS 0xFFF82A85 /end MEASUREMENT
/begin MEASUREMENT ZFEH_EepromData.ydiMemory_xau16[8].amb_cond.ambient_condition[1][13] "ambient condition shot [0 .. 2-1] with 25 data bytes [0 .. 25-1] for the error code stored in this error memory slot" UBYTE EH_STANDARD_S5_S3 1 100 0 255 DISPLAY_IDENTIFIER ambient_condition[1][13].amb_cond.ydiMemory_xau16[8].ZFEH_EepromData ECU_ADDRESS 0xFFF82A86 /end MEASUREMENT
/begin MEASUREMENT ZFEH_EepromData.ydiMemory_xau16[8].amb_cond.ambient_condition[1][14] "ambient condition shot [0 .. 2-1] with 25 data bytes [0 .. 25-1] for the error code stored in this error memory slot" UBYTE EH_STANDARD_S5_S3 1 100 0 255 DISPLAY_IDENTIFIER ambient_condition[1][14].amb_cond.ydiMemory_xau16[8].ZFEH_EepromData ECU_ADDRESS 0xFFF82A87 /end MEASUREMENT
/begin MEASUREMENT ZFEH_EepromData.ydiMemory_xau16[8].amb_cond.ambient_condition[1][15] "ambient condition shot [0 .. 2-1] with 25 data bytes [0 .. 25-1] for the error code stored in this error memory slot" UBYTE EH_STANDARD_S5_S3 1 100 0 255 DISPLAY_IDENTIFIER ambient_condition[1][15].amb_cond.ydiMemory_xau16[8].ZFEH_EepromData ECU_ADDRESS 0xFFF82A88 /end MEASUREMENT
/begin MEASUREMENT ZFEH_EepromData.ydiMemory_xau16[8].amb_cond.ambient_condition[1][16] "ambient condition shot [0 .. 2-1] with 25 data bytes [0 .. 25-1] for the error code stored in this error memory slot" UBYTE EH_STANDARD_S5_S3 1 100 0 255 DISPLAY_IDENTIFIER ambient_condition[1][16].amb_cond.ydiMemory_xau16[8].ZFEH_EepromData ECU_ADDRESS 0xFFF82A89 /end MEASUREMENT
/begin MEASUREMENT ZFEH_EepromData.ydiMemory_xau16[8].amb_cond.ambient_condition[1][17] "ambient condition shot [0 .. 2-1] with 25 data bytes [0 .. 25-1] for the error code stored in this error memory slot" UBYTE EH_STANDARD_S5_S3 1 100 0 255 DISPLAY_IDENTIFIER ambient_condition[1][17].amb_cond.ydiMemory_xau16[8].ZFEH_EepromData ECU_ADDRESS 0xFFF82A8A /end MEASUREMENT
/begin MEASUREMENT ZFEH_EepromData.ydiMemory_xau16[8].amb_cond.ambient_condition[1][18] "ambient condition shot [0 .. 2-1] with 25 data bytes [0 .. 25-1] for the error code stored in this error memory slot" UBYTE EH_STANDARD_S5_S3 1 100 0 255 DISPLAY_IDENTIFIER ambient_condition[1][18].amb_cond.ydiMemory_xau16[8].ZFEH_EepromData ECU_ADDRESS 0xFFF82A8B /end MEASUREMENT
/begin MEASUREMENT ZFEH_EepromData.ydiMemory_xau16[8].amb_cond.ambient_condition[1][19] "ambient condition shot [0 .. 2-1] with 25 data bytes [0 .. 25-1] for the error code stored in this error memory slot" UBYTE EH_STANDARD_S5_S3 1 100 0 255 DISPLAY_IDENTIFIER ambient_condition[1][19].amb_cond.ydiMemory_xau16[8].ZFEH_EepromData ECU_ADDRESS 0xFFF82A8C /end MEASUREMENT
/begin MEASUREMENT ZFEH_EepromData.ydiMemory_xau16[8].amb_cond.ambient_condition[1][20] "ambient condition shot [0 .. 2-1] with 25 data bytes [0 .. 25-1] for the error code stored in this error memory slot" UBYTE EH_STANDARD_S5_S3 1 100 0 255 DISPLAY_IDENTIFIER ambient_condition[1][20].amb_cond.ydiMemory_xau16[8].ZFEH_EepromData ECU_ADDRESS 0xFFF82A8D /end MEASUREMENT
/begin MEASUREMENT ZFEH_EepromData.ydiMemory_xau16[8].amb_cond.ambient_condition[1][21] "ambient condition shot [0 .. 2-1] with 25 data bytes [0 .. 25-1] for the error code stored in this error memory slot" UBYTE EH_STANDARD_S5_S3 1 100 0 255 DISPLAY_IDENTIFIER ambient_condition[1][21].amb_cond.ydiMemory_xau16[8].ZFEH_EepromData ECU_ADDRESS 0xFFF82A8E /end MEASUREMENT
/begin MEASUREMENT ZFEH_EepromData.ydiMemory_xau16[8].amb_cond.ambient_condition[1][22] "ambient condition shot [0 .. 2-1] with 25 data bytes [0 .. 25-1] for the error code stored in this error memory slot" UBYTE EH_STANDARD_S5_S3 1 100 0 255 DISPLAY_IDENTIFIER ambient_condition[1][22].amb_cond.ydiMemory_xau16[8].ZFEH_EepromData ECU_ADDRESS 0xFFF82A8F /end MEASUREMENT
/begin MEASUREMENT ZFEH_EepromData.ydiMemory_xau16[8].amb_cond.ambient_condition[1][23] "ambient condition shot [0 .. 2-1] with 25 data bytes [0 .. 25-1] for the error code stored in this error memory slot" UBYTE EH_STANDARD_S5_S3 1 100 0 255 DISPLAY_IDENTIFIER ambient_condition[1][23].amb_cond.ydiMemory_xau16[8].ZFEH_EepromData ECU_ADDRESS 0xFFF82A90 /end MEASUREMENT
/begin MEASUREMENT ZFEH_EepromData.ydiMemory_xau16[8].amb_cond.ambient_condition[1][24] "ambient condition shot [0 .. 2-1] with 25 data bytes [0 .. 25-1] for the error code stored in this error memory slot" UBYTE EH_STANDARD_S5_S3 1 100 0 255 DISPLAY_IDENTIFIER ambient_condition[1][24].amb_cond.ydiMemory_xau16[8].ZFEH_EepromData ECU_ADDRESS 0xFFF82A91 /end MEASUREMENT
/begin MEASUREMENT ZFEH_EepromData.ydiMemory_xau16[8].amb_cond.status_of_ambient_conditions[0] "status of ambient condition shot x: 0=invalid 1=valid" UBYTE EH_STANDARD_S5_S3 1 100 0 1 DISPLAY_IDENTIFIER status_of_ambient_conditions[0].amb_cond.ydiMemory_xau16[8].ZFEH_EepromData ECU_ADDRESS 0xFFF82A92 /end MEASUREMENT
/begin MEASUREMENT ZFEH_EepromData.ydiMemory_xau16[8].amb_cond.status_of_ambient_conditions[1] "status of ambient condition shot x: 0=invalid 1=valid" UBYTE EH_STANDARD_S5_S3 1 100 0 1 DISPLAY_IDENTIFIER status_of_ambient_conditions[1].amb_cond.ydiMemory_xau16[8].ZFEH_EepromData ECU_ADDRESS 0xFFF82A93 /end MEASUREMENT
/begin MEASUREMENT ZFEH_EepromData.ydiMemory_xau16[8].error_code "error code stored in error memory slot" UWORD CONV_KFC_NAME 0 255 0 65535 DISPLAY_IDENTIFIER error_code.ydiMemory_xau16[8].ZFEH_EepromData ECU_ADDRESS 0xFFF82A4C /end MEASUREMENT
/begin MEASUREMENT ZFEH_EepromData.ydiMemory_xau16[8].error_type "error type of error code stored in error memory slot" UWORD EH_STANDARD_S5_S3 1 100 0 65535 DISPLAY_IDENTIFIER error_type.ydiMemory_xau16[8].ZFEH_EepromData ECU_ADDRESS 0xFFF82A4E /end MEASUREMENT
/begin MEASUREMENT ZFEH_EepromData.ydiMemory_xau16[8].frequency_counter "frequency counter of error code stored in error memory slot" UBYTE EH_STANDARD_S5_S3 1 100 0 255 DISPLAY_IDENTIFIER frequency_counter.ydiMemory_xau16[8].ZFEH_EepromData ECU_ADDRESS 0xFFF82A52 /end MEASUREMENT
/begin MEASUREMENT ZFEH_EepromData.ydiMemory_xau16[8].backwards_counter "backwards counter of error code stored in error memory slot" UBYTE EH_STANDARD_S5_S3 1 100 0 255 DISPLAY_IDENTIFIER backwards_counter.ydiMemory_xau16[8].ZFEH_EepromData ECU_ADDRESS 0xFFF82A53 /end MEASUREMENT
/begin MEASUREMENT ZFEH_EepromData.ydiMemory_xau16[8].master_time "master time of error code stored in error memory slot" ULONG EH_STANDARD_S5_S3 1 100 0 4294967295 DISPLAY_IDENTIFIER master_time.ydiMemory_xau16[8].ZFEH_EepromData ECU_ADDRESS 0xFFF82A58 /end MEASUREMENT
/begin MEASUREMENT ZFEH_EepromData.ydiMemory_xau16[8].condition_byte "condition byte of error code stored in error memory slot" UBYTE EH_STANDARD_S5_S3 1 100 0 255 DISPLAY_IDENTIFIER condition_byte.ydiMemory_xau16[8].ZFEH_EepromData ECU_ADDRESS 0xFFF82A5D /end MEASUREMENT
/begin MEASUREMENT ZFEH_EepromData.ydiMemory_xau16[8].obd_driving_cycle_counter "obd driving cycle counter of error code stored in error memory slot" UWORD EH_STANDARD_S5_S3 1 100 0 65535 DISPLAY_IDENTIFIER obd_driving_cycle_counter.ydiMemory_xau16[8].ZFEH_EepromData ECU_ADDRESS 0xFFF82A5E /end MEASUREMENT
/begin COMPU_METHOD CONV_KFC_NAME "" TAB_VERB "%6.3" "" COMPU_TAB_REF CONV_TAB_KFC_NAME /end COMPU_METHOD
/begin COMPU_METHOD EH_STANDARD_S5_S3 "int = ((phys * 1) / 1) - (0) -" RAT_FUNC "%2.0" "-" COEFFS 0 1 -0 0 0 1 /end COMPU_METHOD
/begin COMPU_VTAB CONV_TAB_KFC_NAME "Conversion table" TAB_VERB 256 0 "empty" 1 "KFC1_OUT0" 2 "KFC2_OUT0" 3 "KFC1_OUT1" 4 "KFC2_OUT1" 5 "KFC1_OUT2" 6 "KFC2_OUT2" 7 "KFC1_OUT3" 8 "KFC2_OUT3" 9 "KFC1_OUT4" 10 "KFC2_OUT4" 11 "KFC1_OUT5" 12 "KFC2_OUT5" 13 "KFC1_OUT6" 14 "KFC2_OUT6" 15 "KFC1_OUT7" 16 "KFC2_OUT7" 17 "KFC1_OUT8" 18 "KFC2_OUT8" 19 "KFC1_OUT9" 20 "KFC2_OUT9" 21 "KFC1_OUT10" 22 "KFC2_OUT10" 23 "KFC1_OUT11" 24 "KFC2_OUT11" 25 "KFC1_OUT12" 26 "KFC2_OUT12" 27 "KFC1_OUT13" 28 "KFC2_OUT13" 29 "KFC1_OUT14" 30 "KFC2_OUT14" 31 "KFC_UDRMV1" 32 "KFC_UDRMV2" 33 "KFC_USENS1" 34 "KFC_RESUNDERVOLTAGE" 35 "KFC_RESSUP" 36 "KFC_RESZF" 37 "KFC_EEPROM" 38 "KFC_DISABLEERM" 39 "KFC_EPROM" 40 "KFC_N6PLAUSILEV2" 41 "KFC_TCUHOT" 42 "KFC_SFRM" 43 "KFC1_POSLEV2" 44 "KFC2_POSLEV2" 45 "KFC3_POSLEV2" 46 "KFC4_POSLEV2" 47 "KFC_NTUVIRTLEV2" 48 "KFC_SENSORLEV2" 49 "KFC_WDOG" 50 "KFC_MCCOMP" 51 "KFC_LEV2" 52 "KFC1_LEV2" 53 "KFC_VUNPLAUSILEV2" 54 "KFC3_LEV2" 55 "KFC_RATIOGEAR" 56 "KFC_RATIOA" 57 "KFC_RATIOB" 58 "KFC_RATIOC" 59 "KFC_RATIOD" 60 "KFC_RATIOE" 61 "KFC_RATIOAB" 62 "KFC_RATIOAD" 63 "KFC_RATIOBD" 64 "KFC_RATIOBE" 65 "KFC_RATIOCD" 66 "KFC_RATIOAE" 67 "KFC_RATIOAC" 68 "KFC_RATIOBC" 69 "KFC_RATIOCE" 70 "KFC_RATIODE" 71 "KFC_RATIOABC" 72 "KFC_RATIOABE" 73 "KFC_RATIOBCE" 74 "KFC_RATIOBDE" 75 "KFC_RATIOBCD" 76 "KFC_RATIOCDE" 77 "KFC_RATIOACD" 78 "KFC_RATIOADE" 79 "KFC_RATIOABD" 80 "KFC_RATIOSHIFT" 81 "KFC_RATIOSHIFT1" 82 "KFC_RATIOSHIFT2" 83 "KFC_RATIOSHIFT3" 84 "KFC_RATIOSHIFT4" 85 "KFC_RATIOSHIFT5" 86 "KFC_RATIOSHIFT6" 87 "KFC_RATIOSHIFT7" 88 "KFC_RATIOSHIFT8" 89 "KFC_UBATTU" 90 "KFC_UBATTL" 91 "KFC_UBATTO" 92 "KFC_N6LEV2" 93 "KFC5_CLUTCHOVERHEAT" 94 "KFC_NABLEV2" 95 "KFC_USENS" 96 "KFC_NABPLAUSILEV2" 97 "KFC_NWHEELPLAUSILEV2" 98 "KFC_PARK" 99 "KFC_STADARDY" 100 "KFC_CCHIP1LEV2" 101 "KFC_CGTLEV2" 102 "KFC_NMOUEB" 103 "KFC1_CLUTCHOVERHEAT" 104 "KFC_POSV" 105 "KFC_PEDALF" 106 "KFC_NWHEELLEV2" 107 "KFC_POSINFO1" 108 "KFC_POSINFO2" 109 "KFC_POSSBW" 110 "KFC_TARGETSPEED" 111 "KFC_CANB1" 112 "KFC_CANB2" 113 "KFC_PSIN" 114 "KFC_PSOUT" 115 "KFC_PSABUSE" 116 "KFC2_ENGSIGTRQ" 117 "KFC_ENGSIGEM" 118 "KFC2_CLUTCHOVERHEAT" 119 "KFC3_CLUTCHOVERHEAT" 120 "KFC_NMOE" 121 "KFC4_CLUTCHOVERHEAT" 122 "KFC_ERSATZ" 123 "KFC_TIPP" 124 "KFC_RESUB" 125 "KFC_RATIOGLOBAL" 126 "KFC2_PSOUT" 127 "KFC_TRANSM" 128 "KFC1_POSDISP" 129 "KFC_NMOFLL" 130 "KFC_PRLOGIC" 131 "KFC_CCHIP2LEV2" 132 "KFC_ENGSIG" 133 "KFC_BRAKEF" 134 "KFC_BRAKETRQ" 135 "KFC_DOOR" 136 "KFC_SEAT" 137 "KFC_OBDCYCLES" 138 "KFC_PINFO" 139 "KFC_INFOHOT1" 140 "KFC_INFOHOT2" 141 "KFC_INFO4" 142 "KFC_INFO5" 143 "KFC_CGTELECTRICERRLEV2" 144 "KFC_FEHLBAU" 145 "KFC_ACCELY" 146 "KFC_BRAKETRQDRV" 147 "KFC1_ENGSIGEM" 148 "KFC_FLASHNOTPOS" 149 "KFC_PSHOLDERR" 150 "KFC_PSABSERR" 151 "KFC_TMS" 152 "KFC_KL15" 153 "KFC1_KL15" 154 "KFC_C0SYNCHOT" 155 "KFC1_TRSMTRQ" 156 "KFC_OBD" 157 "KFC_INTME" 158 "KFC1_INTME" 159 "KFC_DMEG1" 160 "KFC_DMEG2" 161 "KFC_DMEG3" 162 "KFC_GWSACAN" 163 "KFC_GWSFACAN" 164 "KFC_INFOHOTWARNING2" 165 "KFC_INFOHOTWARNING3" 166 "KFC_INFO6" 167 "KFC3_ENGSIGTRQ" 168 "KFC_DSCG1" 169 "KFC_DSCG2" 170 "KFC_DSCG3" 171 "KFC_C0DEFECTHOT" 172 "KFC_INFO9" 173 "KFC_INFO10" 174 "KFC_MAXDECELERATION" 175 "KFC_FEMG1" 176 "KFC_FEMG2" 177 "KFC_FEMG3" 178 "KFC1_SENSORLEV2" 179 "KFC2_ENGSIGEM" 180 "KFC_NEMNEGDIR" 181 "KFC_EGNERENABLED" 182 "KFC_EGNERFAILED" 183 "KFC_EGNERMISUSE" 184 "KFC_CIC" 185 "KFC_ICMG1" 186 "KFC_ICMG2" 187 "KFC_ICMG3" 188 "KFC_C0CLOSEASYNC" 189 "KFC_PARKASSIST" 190 "KFC_HASCYCERR" 191 "KFC_HASCYCNEMERR" 192 "KFC_INSTG1" 193 "KFC_INSTG2" 194 "KFC_INSTG3" 195 "KFC_SZL1" 196 "KFC_ACSM1" 197 "KFC1_UBATTU" 198 "KFC_AHM1" 199 "KFC_ENGWATCOOL" 200 "KFC_EWSSCAN" 201 "KFC_EWSDRVRQ" 202 "KFC_NEMPSYS" 203 "KFC_NEGTRQREQHAS" 204 "KFC_TARGETTRQEM" 205 "KFC_HASERROR" 206 "KFC_VEHDYNREG" 207 "KFC_SME" 208 "KFC_TRQ" 209 "KFC_EMEG1" 210 "KFC_EMEG2" 211 "KFC_EMEG3" 212 "KFC_ENGSIGINFO" 213 "KFC_INFON" 214 "KFC_INFOHOTWARNING" 215 "KFC_DMEOBD" 216 "KFC_POSNPLAUSI" 217 "KFC1_ENGSIGTRQ" 218 "KFC_IAENOOPEN" 219 "KFC_IAENOCLOSE" 220 "KFC_IAECLOSE" 221 "KFC_IAEHOT" 222 "KFC_HASCYCNEMERR2" 223 "KFC_C0DEFECT" 224 "KFC_SAFETYPARMISM" 225 "KFC_IEP" 226 "KFC_ZGW" 227 "KFC1_IEPERROR" 228 "KFC_C0NOCLOSE" 229 "KFC_TARGETSPEEDVM" 230 "KFC_TARGETSPEEDEM" 231 "KFC_MINSPEEDEM" 232 "KFC_IEPLEV2" 233 "KFC_HASCYCNVMERR" 234 "KFC_NABGRAD" 235 "KFC_C0HOT" 236 "KFC_C0CLOSELEV2" 237 "KFC_CGTJUMPLEV2" 238 "KFC_CGTPLAUSILEV2" 239 "KFC_CCHIP2PLAUSILEV2" 240 "KFC_CCHIP1PLAUSILEV2" 241 "KFC1_NEGTRQREQ" 242 "KFC_IEPCOM" 243 "KFC_RATIOIEPSYM" 244 "KFC_RATIOIEP" 245 "KFC_C0NOOPEN" 246 "CODING_EVENT_NOT_CODED" 247 "CODING_EVENT_TRANSACTION_FAILED" 248 "CODING_EVENT_SIGNATURE_ERROR" 249 "CODING_EVENT_WRONG_VEHICLE" 250 "CODING_EVENT_INVALID_DATA" 251 "DM_EVENT_ZEITBOTSCHAFTTIMEOUT" 252 "DM_TEST_APPL" 253 "DM_TEST_COM" 254 "VSM_EVENT_OPMODE" 255 "DI_EC_NUMBER_ENTRIES" DEFAULT_VALUE "unknown" /end COMPU_VTAB
/begin FUNCTION zff_EH_ErrorMemoryInformation "desc_en"
 /begin LOC_MEASUREMENT ZFEH_EepromData.ydiMemory_xau16[1].amb_cond.ambient_condition[1][14] ZFEH_EepromData.ydiMemory_xau16[1].amb_cond.ambient_condition[1][15] ZFEH_EepromData.ydiMemory_xau16[1].amb_cond.ambient_condition[1][16] ZFEH_EepromData.ydiMemory_xau16[1].amb_cond.ambient_condition[1][17] ZFEH_EepromData.ydiMemory_xau16[1].amb_cond.ambient_condition[1][18] ZFEH_EepromData.ydiMemory_xau16[1].amb_cond.ambient_condition[1][19] ZFEH_EepromData.ydiMemory_xau16[1].amb_cond.ambient_condition[1][1] ZFEH_EepromData.ydiMemory_xau16[1].amb_cond.ambient_condition[1][20] ZFEH_EepromData.ydiMemory_xau16[1].amb_cond.ambient_condition[1][21] ZFEH_EepromData.ydiMemory_xau16[1].amb_cond.ambient_condition[1][22] ZFEH_EepromData.ydiMemory_xau16[1].amb_cond.ambient_condition[1][23] ZFEH_EepromData.ydiMemory_xau16[1].amb_cond.ambient_condition[1][24] ZFEH_EepromData.ydiMemory_xau16[1].amb_cond.ambient_condition[1][2] ZFEH_EepromData.ydiMemory_xau16[1].amb_cond.ambient_condition[1][3] ZFEH_EepromData.ydiMemory_xau16[1].amb_cond.ambient_condition[1][4] ZFEH_EepromData.ydiMemory_xau16[1].amb_cond.ambient_condition[1][5] ZFEH_EepromData.ydiMemory_xau16[1].amb_cond.ambient_condition[1][6] ZFEH_EepromData.ydiMemory_xau16[1].amb_cond.ambient_condition[1][7] ZFEH_EepromData.ydiMemory_xau16[1].amb_cond.ambient_condition[1][8] ZFEH_EepromData.ydiMemory_xau16[1].amb_cond.ambient_condition[1][9] ZFEH_EepromData.ydiMemory_xau16[1].amb_cond.status_of_ambient_conditions[0] ZFEH_EepromData.ydiMemory_xau16[1].amb_cond.status_of_ambient_conditions[1] ZFEH_EepromData.ydiMemory_xau16[1].backwards_counter ZFEH_EepromData.ydiMemory_xau16[1].condition_byte ZFEH_EepromData.ydiMemory_xau16[1].error_code ZFEH_EepromData.ydiMemory_xau16[1].error_type ZFEH_EepromData.ydiMemory_xau16[1].frequency_counter ZFEH_EepromData.ydiMemory_xau16[1].master_time ZFEH_EepromData.ydiMemory_xau16[1].obd_driving_cycle_counter ZFEH_EepromData.ydiMemory_xau16[1].permanent_counter ZFEH_EepromData.ydiMemory_xau16[1].sequence_counter ZFEH_EepromData.ydiMemory_xau16[1].status_word ZFEH_EepromData.ydiMemory_xau16[2].amb_cond.ambient_condition[0][0] ZFEH_EepromData.ydiMemory_xau16[2].amb_cond.ambient_condition[0][10] ZFEH_EepromData.ydiMemory_xau16[2].amb_cond.ambient_condition[0][11] ZFEH_EepromData.ydiMemory_xau16[2].amb_cond.ambient_condition[0][12] ZFEH_EepromData.ydiMemory_xau16[2].amb_cond.ambient_condition[0][13] ZFEH_EepromData.ydiMemory_xau16[2].amb_cond.ambient_condition[0][14] ZFEH_EepromData.ydiMemory_xau16[2].amb_cond.ambient_condition[0][15] ZFEH_EepromData.ydiMemory_xau16[2].amb_cond.ambient_condition[0][16] ZFEH_EepromData.ydiMemory_xau16[2].amb_cond.ambient_condition[0][17] ZFEH_EepromData.ydiMemory_xau16[2].amb_cond.ambient_condition[0][18] ZFEH_EepromData.ydiMemory_xau16[2].amb_cond.ambient_condition[0][19] ZFEH_EepromData.ydiMemory_xau16[2].amb_cond.ambient_condition[0][1] ZFEH_EepromData.ydiMemory_xau16[2].amb_cond.ambient_condition[0][20] ZFEH_EepromData.ydiMemory_xau16[2].amb_cond.ambient_condition[0][21] ZFEH_EepromData.ydiMemory_xau16[2].amb_cond.ambient_condition[0][22] ZFEH_EepromData.ydiMemory_xau16[2].amb_cond.ambient_condition[0][23] ZFEH_EepromData.ydiMemory_xau16[2].amb_cond.ambient_condition[0][24] ZFEH_EepromData.ydiMemory_xau16[2].amb_cond.ambient_condition[0][2] ZFEH_EepromData.ydiMemory_xau16[2].amb_cond.ambient_condition[0][3] ZFEH_EepromData.ydiMemory_xau16[2].amb_cond.ambient_condition[0][4] ZFEH_EepromData.ydiMemory_xau16[2].amb_cond.ambient_condition[0][5] ZFEH_EepromData.ydiMemory_xau16[2].amb_cond.ambient_condition[0][6] ZFEH_EepromData.ydiMemory_xau16[2].amb_cond.ambient_condition[0][7] ZFEH_EepromData.ydiMemory_xau16[2].amb_cond.ambient_condition[0][8] ZFEH_EepromData.ydiMemory_xau16[2].amb_cond.ambient_condition[0][9] ZFEH_EepromData.ydiMemory_xau16[2].amb_cond.ambient_condition[1][0] ZFEH_EepromData.ydiMemory_xau16[2].amb_cond.ambient_condition[1][10] ZFEH_EepromData.ydiMemory_xau16[2].amb_cond.ambient_condition[1][11] ZFEH_EepromData.ydiMemory_xau16[2].amb_cond.ambient_condition[1][12] ZFEH_EepromData.ydiMemory_xau16[2].amb_cond.ambient_condition[1][13] ZFEH_EepromData.ydiMemory_xau16[2].amb_cond.ambient_condition[1][14] ZFEH_EepromData.ydiMemory_xau16[2].amb_cond.ambient_condition[1][15] ZFEH_EepromData.ydiMemory_xau16[2].amb_cond.ambient_condition[1][16] ZFEH_EepromData.ydiMemory_xau16[2].amb_cond.ambient_condition[1][17] ZFEH_EepromData.ydiMemory_xau16[2].amb_cond.ambient_condition[1][18] ZFEH_EepromData.ydiMemory_xau16[2].amb_cond.ambient_condition[1][19] ZFEH_EepromData.ydiMemory_xau16[2].amb_cond.ambient_condition[1][1] ZFEH_EepromData.ydiMemory_xau16[2].amb_cond.ambient_condition[1][20] ZFEH_EepromData.ydiMemory_xau16[2].amb_cond.ambient_condition[1][21] ZFEH_EepromData.ydiMemory_xau16[2].amb_cond.ambient_condition[1][22] ZFEH_EepromData.ydiMemory_xau16[2].amb_cond.ambient_condition[1][23] ZFEH_EepromData.ydiMemory_xau16[2].amb_cond.ambient_condition[1][24] ZFEH_EepromData.ydiMemory_xau16[2].amb_cond.ambient_condition[1][2] ZFEH_EepromData.ydiMemory_xau16[2].amb_cond.ambient_condition[1][3] ZFEH_EepromData.ydiMemory_xau16[2].amb_cond.ambient_condition[1][4] ZFEH_EepromData.ydiMemory_xau16[2].amb_cond.ambient_condition[1][5] ZFEH_EepromData.ydiMemory_xau16[2].amb_cond.ambient_condition[1][6] ZFEH_EepromData.ydiMemory_xau16[2].amb_cond.ambient_condition[1][7] ZFEH_EepromData.ydiMemory_xau16[2].amb_cond.ambient_condition[1][8] ZFEH_EepromData.ydiMemory_xau16[2].amb_cond.ambient_condition[1][9] ZFEH_EepromData.ydiMemory_xau16[2].amb_cond.status_of_ambient_conditions[0] ZFEH_EepromData.ydiMemory_xau16[2].amb_cond.status_of_ambient_conditions[1] ZFEH_EepromData.ydiMemory_xau16[2].backwards_counter ZFEH_EepromData.ydiMemory_xau16[2].condition_byte ZFEH_EepromData.ydiMemory_xau16[2].error_code ZFEH_EepromData.ydiMemory_xau16[2].error_type ZFEH_EepromData.ydiMemory_xau16[2].frequency_counter ZFEH_EepromData.ydiMemory_xau16[2].master_time ZFEH_EepromData.ydiMemory_xau16[2].obd_driving_cycle_counter ZFEH_EepromData.ydiMemory_xau16[2].permanent_counter ZFEH_EepromData.ydiMemory_xau16[2].sequence_counter ZFEH_EepromData.ydiMemory_xau16[2].status_word ZFEH_EepromData.ydiMemory_xau16[3].amb_cond.ambient_condition[0][0] ZFEH_EepromData.ydiMemory_xau16[3].amb_cond.ambient_condition[0][10] ZFEH_EepromData.ydiMemory_xau16[3].amb_cond.ambient_condition[0][11] ZFEH_EepromData.ydiMemory_xau16[3].amb_cond.ambient_condition[0][12] ZFEH_EepromData.ydiMemory_xau16[3].amb_cond.ambient_condition[0][13] ZFEH_EepromData.ydiMemory_xau16[3].amb_cond.ambient_condition[0][14] ZFEH_EepromData.ydiMemory_xau16[3].amb_cond.ambient_condition[0][15] ZFEH_EepromData.ydiMemory_xau16[3].amb_cond.ambient_condition[0][16] ZFEH_EepromData.ydiMemory_xau16[3].amb_cond.ambient_condition[0][17] ZFEH_EepromData.ydiMemory_xau16[3].amb_cond.ambient_condition[0][18] ZFEH_EepromData.ydiMemory_xau16[3].amb_cond.ambient_condition[0][19] ZFEH_EepromData.ydiMemory_xau16[3].amb_cond.ambient_condition[0][1] ZFEH_EepromData.ydiMemory_xau16[3].amb_cond.ambient_condition[0][20] ZFEH_EepromData.ydiMemory_xau16[3].amb_cond.ambient_condition[0][21] ZFEH_EepromData.ydiMemory_xau16[3].amb_cond.ambient_condition[0][22] ZFEH_EepromData.ydiMemory_xau16[3].amb_cond.ambient_condition[0][23] ZFEH_EepromData.ydiMemory_xau16[3].amb_cond.ambient_condition[0][24] ZFEH_EepromData.ydiMemory_xau16[3].amb_cond.ambient_condition[0][2] ZFEH_EepromData.ydiMemory_xau16[3].amb_cond.ambient_condition[0][3] ZFEH_EepromData.ydiMemory_xau16[3].amb_cond.ambient_condition[0][4] ZFEH_EepromData.ydiMemory_xau16[3].amb_cond.ambient_condition[0][5] ZFEH_EepromData.ydiMemory_xau16[3].amb_cond.ambient_condition[0][6] ZFEH_EepromData.ydiMemory_xau16[3].amb_cond.ambient_condition[0][7] ZFEH_EepromData.ydiMemory_xau16[3].amb_cond.ambient_condition[0][8] ZFEH_EepromData.ydiMemory_xau16[3].amb_cond.ambient_condition[0][9] ZFEH_EepromData.ydiMemory_xau16[3].amb_cond.ambient_condition[1][0] ZFEH_EepromData.ydiMemory_xau16[3].amb_cond.ambient_condition[1][10] ZFEH_EepromData.ydiMemory_xau16[3].amb_cond.ambient_condition[1][11] ZFEH_EepromData.ydiMemory_xau16[3].amb_cond.ambient_condition[1][12] ZFEH_EepromData.ydiMemory_xau16[3].amb_cond.ambient_condition[1][13] ZFEH_EepromData.ydiMemory_xau16[3].amb_cond.ambient_condition[1][14] ZFEH_EepromData.ydiMemory_xau16[3].amb_cond.ambient_condition[1][15] ZFEH_EepromData.ydiMemory_xau16[3].amb_cond.ambient_condition[1][16] ZFEH_EepromData.ydiMemory_xau16[3].amb_cond.ambient_condition[1][17] ZFEH_EepromData.ydiMemory_xau16[3].amb_cond.ambient_condition[1][18] ZFEH_EepromData.ydiMemory_xau16[3].amb_cond.ambient_condition[1][19] ZFEH_EepromData.ydiMemory_xau16[3].amb_cond.ambient_condition[1][1] ZFEH_EepromData.ydiMemory_xau16[3].amb_cond.ambient_condition[1][20] ZFEH_EepromData.ydiMemory_xau16[3].amb_cond.ambient_condition[1][21] ZFEH_EepromData.ydiMemory_xau16[3].amb_cond.ambient_condition[1][22] ZFEH_EepromData.ydiMemory_xau16[3].amb_cond.ambient_condition[1][23] ZFEH_EepromData.ydiMemory_xau16[3].amb_cond.ambient_condition[1][24] ZFEH_EepromData.ydiMemory_xau16[3].amb_cond.ambient_condition[1][2] ZFEH_EepromData.ydiMemory_xau16[3].amb_cond.ambient_condition[1][3] ZFEH_EepromData.ydiMemory_xau16[3].amb_cond.ambient_condition[1][4] ZFEH_EepromData.ydiMemory_xau16[3].amb_cond.ambient_condition[1][5] ZFEH_EepromData.ydiMemory_xau16[3].amb_cond.ambient_condition[1][6] ZFEH_EepromData.ydiMemory_xau16[3].amb_cond.ambient_condition[1][7] ZFEH_EepromData.ydiMemory_xau16[3].amb_cond.ambient_condition[1][8] ZFEH_EepromData.ydiMemory_xau16[3].amb_cond.ambient_condition[1][9] ZFEH_EepromData.ydiMemory_xau16[3].amb_cond.status_of_ambient_conditions[0] ZFEH_EepromData.ydiMemory_xau16[3].amb_cond.status_of_ambient_conditions[1] ZFEH_EepromData.ydiMemory_xau16[3].backwards_counter ZFEH_EepromData.ydiMemory_xau16[3].condition_byte ZFEH_EepromData.ydiMemory_xau16[3].error_code ZFEH_EepromData.ydiMemory_xau16[3].error_type ZFEH_EepromData.ydiMemory_xau16[3].frequency_counter ZFEH_EepromData.ydiMemory_xau16[3].master_time ZFEH_EepromData.ydiMemory_xau16[3].obd_driving_cycle_counter ZFEH_EepromData.ydiMemory_xau16[3].permanent_counter ZFEH_EepromData.ydiMemory_xau16[3].sequence_counter ZFEH_EepromData.ydiMemory_xau16[3].status_word ZFEH_EepromData.ydiMemory_xau16[4].amb_cond.ambient_condition[0][0] ZFEH_EepromData.ydiMemory_xau16[4].amb_cond.ambient_condition[0][10] ZFEH_EepromData.ydiMemory_xau16[4].amb_cond.ambient_condition[0][11] ZFEH_EepromData.ydiMemory_xau16[4].amb_cond.ambient_condition[0][12] ZFEH_EepromData.ydiMemory_xau16[4].amb_cond.ambient_condition[0][13] ZFEH_EepromData.ydiMemory_xau16[4].amb_cond.ambient_condition[0][14] ZFEH_EepromData.ydiMemory_xau16[4].amb_cond.ambient_condition[0][15] ZFEH_EepromData.ydiMemory_xau16[4].amb_cond.ambient_condition[0][16] ZFEH_EepromData.ydiMemory_xau16[4].amb_cond.ambient_condition[0][17] ZFEH_EepromData.ydiMemory_xau16[4].amb_cond.ambient_condition[0][18] ZFEH_EepromData.ydiMemory_xau16[4].amb_cond.ambient_condition[0][19] ZFEH_EepromData.ydiMemory_xau16[4].amb_cond.ambient_condition[0][1] ZFEH_EepromData.ydiMemory_xau16[4].amb_cond.ambient_condition[0][20] ZFEH_EepromData.ydiMemory_xau16[4].amb_cond.ambient_condition[0][21] ZFEH_EepromData.ydiMemory_xau16[4].amb_cond.ambient_condition[0][22] ZFEH_EepromData.ydiMemory_xau16[4].amb_cond.ambient_condition[0][23] ZFEH_EepromData.ydiMemory_xau16[4].amb_cond.ambient_condition[0][24] ZFEH_EepromData.ydiMemory_xau16[4].amb_cond.ambient_condition[0][2] ZFEH_EepromData.ydiMemory_xau16[4].amb_cond.ambient_condition[0][3] ZFEH_EepromData.ydiMemory_xau16[4].amb_cond.ambient_condition[0][4] ZFEH_EepromData.ydiMemory_xau16[4].amb_cond.ambient_condition[0][5] ZFEH_EepromData.ydiMemory_xau16[4].amb_cond.ambient_condition[0][6] ZFEH_EepromData.ydiMemory_xau16[4].amb_cond.ambient_condition[0][7] ZFEH_EepromData.ydiMemory_xau16[4].amb_cond.ambient_condition[0][8] ZFEH_EepromData.ydiMemory_xau16[4].amb_cond.ambient_condition[0][9] ZFEH_EepromData.ydiMemory_xau16[4].amb_cond.ambient_condition[1][0] ZFEH_EepromData.ydiMemory_xau16[4].amb_cond.ambient_condition[1][10] ZFEH_EepromData.ydiMemory_xau16[4].amb_cond.ambient_condition[1][11] ZFEH_EepromData.ydiMemory_xau16[4].amb_cond.ambient_condition[1][12] ZFEH_EepromData.ydiMemory_xau16[4].amb_cond.ambient_condition[1][13] ZFEH_EepromData.ydiMemory_xau16[4].amb_cond.ambient_condition[1][14] ZFEH_EepromData.ydiMemory_xau16[4].amb_cond.ambient_condition[1][15] ZFEH_EepromData.ydiMemory_xau16[4].amb_cond.ambient_condition[1][16] ZFEH_EepromData.ydiMemory_xau16[4].amb_cond.ambient_condition[1][17] ZFEH_EepromData.ydiMemory_xau16[4].amb_cond.ambient_condition[1][18] ZFEH_EepromData.ydiMemory_xau16[4].amb_cond.ambient_condition[1][19] ZFEH_EepromData.ydiMemory_xau16[4].amb_cond.ambient_condition[1][1] ZFEH_EepromData.ydiMemory_xau16[4].amb_cond.ambient_condition[1][20] ZFEH_EepromData.ydiMemory_xau16[4].amb_cond.ambient_condition[1][21] ZFEH_EepromData.ydiMemory_xau16[4].amb_cond.ambient_condition[1][22] ZFEH_EepromData.ydiMemory_xau16[4].amb_cond.ambient_condition[1][23] ZFEH_EepromData.ydiMemory_xau16[4].amb_cond.ambient_condition[1][24] ZFEH_EepromData.ydiMemory_xau16[4].amb_cond.ambient_condition[1][2] ZFEH_EepromData.ydiMemory_xau16[4].amb_cond.ambient_condition[1][3] ZFEH_EepromData.ydiMemory_xau16[4].amb_cond.ambient_condition[1][4] ZFEH_EepromData.ydiMemory_xau16[4].amb_cond.ambient_condition[1][5] ZFEH_EepromData.ydiMemory_xau16[4].amb_cond.ambient_condition[1][6] ZFEH_EepromData.ydiMemory_xau16[4].amb_cond.ambient_condition[1][7] ZFEH_EepromData.ydiMemory_xau16[4].amb_cond.ambient_condition[1][8] ZFEH_EepromData.ydiMemory_xau16[4].amb_cond.ambient_condition[1][9] ZFEH_EepromData.ydiMemory_xau16[4].amb_cond.status_of_ambient_conditions[0] ZFEH_EepromData.ydiMemory_xau16[4].amb_cond.status_of_ambient_conditions[1] ZFEH_EepromData.ydiMemory_xau16[4].backwards_counter ZFEH_EepromData.ydiMemory_xau16[4].condition_byte ZFEH_EepromData.ydiMemory_xau16[4].error_code ZFEH_EepromData.ydiMemory_xau16[4].error_type ZFEH_EepromData.ydiMemory_xau16[4].frequency_counter ZFEH_EepromData.ydiMemory_xau16[4].master_time ZFEH_EepromData.ydiMemory_xau16[4].obd_driving_cycle_counter ZFEH_EepromData.ydiMemory_xau16[4].permanent_counter ZFEH_EepromData.ydiMemory_xau16[4].sequence_counter ZFEH_EepromData.ydiMemory_xau16[4].status_word ZFEH_EepromData.ydiMemory_xau16[5].amb_cond.ambient_condition[0][0] ZFEH_EepromData.ydiMemory_xau16[5].amb_cond.ambient_condition[0][10] ZFEH_EepromData.ydiMemory_xau16[5].amb_cond.ambient_condition[0][11] ZFEH_EepromData.ydiMemory_xau16[5].amb_cond.ambient_condition[0][12] ZFEH_EepromData.ydiMemory_xau16[5].amb_cond.ambient_condition[0][13] ZFEH_EepromData.ydiMemory_xau16[5].amb_cond.ambient_condition[0][14] ZFEH_EepromData.ydiMemory_xau16[5].amb_cond.ambient_condition[0][15] ZFEH_EepromData.ydiMemory_xau16[5].amb_cond.ambient_condition[0][16] ZFEH_EepromData.ydiMemory_xau16[5].amb_cond.ambient_condition[0][17] ZFEH_EepromData.ydiMemory_xau16[5].amb_cond.ambient_condition[0][18] ZFEH_EepromData.ydiMemory_xau16[5].amb_cond.ambient_condition[0][19] ZFEH_EepromData.ydiMemory_xau16[5].amb_cond.ambient_condition[0][1] ZFEH_EepromData.ydiMemory_xau16[5].amb_cond.ambient_condition[0][20] ZFEH_EepromData.ydiMemory_xau16[5].amb_cond.ambient_condition[0][21] ZFEH_EepromData.ydiMemory_xau16[5].amb_cond.ambient_condition[0][22] ZFEH_EepromData.ydiMemory_xau16[5].amb_cond.ambient_condition[0][23] ZFEH_EepromData.ydiMemory_xau16[5].amb_cond.ambient_condition[0][24] ZFEH_EepromData.ydiMemory_xau16[5].amb_cond.ambient_condition[0][2] ZFEH_EepromData.ydiMemory_xau16[5].amb_cond.ambient_condition[0][3] ZFEH_EepromData.ydiMemory_xau16[5].amb_cond.ambient_condition[0][4] ZFEH_EepromData.ydiMemory_xau16[5].amb_cond.ambient_condition[0][5] ZFEH_EepromData.ydiMemory_xau16[5].amb_cond.ambient_condition[0][6] ZFEH_EepromData.ydiMemory_xau16[5].amb_cond.ambient_condition[0][7] ZFEH_EepromData.ydiMemory_xau16[5].amb_cond.ambient_condition[0][8] ZFEH_EepromData.ydiMemory_xau16[5].amb_cond.ambient_condition[0][9] ZFEH_EepromData.ydiMemory_xau16[5].amb_cond.ambient_condition[1][0] ZFEH_EepromData.ydiMemory_xau16[5].amb_cond.ambient_condition[1][10] ZFEH_EepromData.ydiMemory_xau16[5].amb_cond.ambient_condition[1][11] ZFEH_EepromData.ydiMemory_xau16[5].amb_cond.ambient_condition[1][12] ZFEH_EepromData.ydiMemory_xau16[5].amb_cond.ambient_condition[1][13] ZFEH_EepromData.ydiMemory_xau16[5].amb_cond.ambient_condition[1][14] ZFEH_EepromData.ydiMemory_xau16[5].amb_cond.ambient_condition[1][15] ZFEH_EepromData.ydiMemory_xau16[5].amb_cond.ambient_condition[1][16] ZFEH_EepromData.ydiMemory_xau16[5].amb_cond.ambient_condition[1][17] ZFEH_EepromData.ydiMemory_xau16[5].amb_cond.ambient_condition[1][18] ZFEH_EepromData.ydiMemory_xau16[5].amb_cond.ambient_condition[1][19] ZFEH_EepromData.ydiMemory_xau16[5].amb_cond.ambient_condition[1][1] ZFEH_EepromData.ydiMemory_xau16[5].amb_cond.ambient_condition[1][20] ZFEH_EepromData.ydiMemory_xau16[5].amb_cond.ambient_condition[1][21] ZFEH_EepromData.ydiMemory_xau16[5].amb_cond.ambient_condition[1][22] ZFEH_EepromData.ydiMemory_xau16[5].amb_cond.ambient_condition[1][23] ZFEH_EepromData.ydiMemory_xau16[5].amb_cond.ambient_condition[1][24] ZFEH_EepromData.ydiMemory_xau16[5].amb_cond.ambient_condition[1][2] ZFEH_EepromData.ydiMemory_xau16[5].amb_cond.ambient_condition[1][3] ZFEH_EepromData.ydiMemory_xau16[5].amb_cond.ambient_condition[1][4] ZFEH_EepromData.ydiMemory_xau16[5].amb_cond.ambient_condition[1][5] ZFEH_EepromData.ydiMemory_xau16[5].amb_cond.ambient_condition[1][6] ZFEH_EepromData.ydiMemory_xau16[5].amb_cond.ambient_condition[1][7] ZFEH_EepromData.ydiMemory_xau16[5].amb_cond.ambient_condition[1][8] ZFEH_EepromData.ydiMemory_xau16[5].amb_cond.ambient_condition[1][9] ZFEH_EepromData.ydiMemory_xau16[5].amb_cond.status_of_ambient_conditions[0] ZFEH_EepromData.ydiMemory_xau16[5].amb_cond.status_of_ambient_conditions[1] ZFEH_EepromData.ydiMemory_xau16[5].backwards_counter ZFEH_EepromData.ydiMemory_xau16[5].condition_byte ZFEH_EepromData.ydiMemory_xau16[5].error_code ZFEH_EepromData.ydiMemory_xau16[5].error_type ZFEH_EepromData.ydiMemory_xau16[5].frequency_counter ZFEH_EepromData.ydiMemory_xau16[5].master_time ZFEH_EepromData.ydiMemory_xau16[5].obd_driving_cycle_counter ZFEH_EepromData.ydiMemory_xau16[5].permanent_counter ZFEH_EepromData.ydiMemory_xau16[5].sequence_counter ZFEH_EepromData.ydiMemory_xau16[5].status_word ZFEH_EepromData.ydiMemory_xau16[6].amb_cond.ambient_condition[0][0] ZFEH_EepromData.ydiMemory_xau16[6].amb_cond.ambient_condition[0][10] ZFEH_EepromData.ydiMemory_xau16[6].amb_cond.ambient_condition[0][11] ZFEH_EepromData.ydiMemory_xau16[6].amb_cond.ambient_condition[0][12] ZFEH_EepromData.ydiMemory_xau16[6].amb_cond.ambient_condition[0][13] ZFEH_EepromData.ydiMemory_xau16[6].amb_cond.ambient_condition[0][14] ZFEH_EepromData.ydiMemory_xau16[6].amb_cond.ambient_condition[0][15] ZFEH_EepromData.ydiMemory_xau16[6].amb_cond.ambient_condition[0][16] ZFEH_EepromData.ydiMemory_xau16[6].amb_cond.ambient_condition[0][17] ZFEH_EepromData.ydiMemory_xau16[6].amb_cond.ambient_condition[0][18] ZFEH_EepromData.ydiMemory_xau16[6].amb_cond.ambient_condition[0][19] ZFEH_EepromData.ydiMemory_xau16[6].amb_cond.ambient_condition[0][1] ZFEH_EepromData.ydiMemory_xau16[6].amb_cond.ambient_condition[0][20] ZFEH_EepromData.ydiMemory_xau16[6].amb_cond.ambient_condition[0][21] ZFEH_EepromData.ydiMemory_xau16[6].amb_cond.ambient_condition[0][22] ZFEH_EepromData.ydiMemory_xau16[6].amb_cond.ambient_condition[0][23] ZFEH_EepromData.ydiMemory_xau16[6].amb_cond.ambient_condition[0][24] ZFEH_EepromData.ydiMemory_xau16[6].amb_cond.ambient_condition[0][2] ZFEH_EepromData.ydiMemory_xau16[6].amb_cond.ambient_condition[0][3] ZFEH_EepromData.ydiMemory_xau16[6].amb_cond.ambient_condition[0][4] ZFEH_EepromData.ydiMemory_xau16[6].amb_cond.ambient_condition[0][5] ZFEH_EepromData.ydiMemory_xau16[6].amb_cond.ambient_condition[0][6] ZFEH_EepromData.ydiMemory_xau16[6].amb_cond.ambient_condition[0][7] ZFEH_EepromData.ydiMemory_xau16[6].amb_cond.ambient_condition[0][8] ZFEH_EepromData.ydiMemory_xau16[6].amb_cond.ambient_condition[0][9] ZFEH_EepromData.ydiMemory_xau16[6].amb_cond.ambient_condition[1][0] ZFEH_EepromData.ydiMemory_xau16[6].amb_cond.ambient_condition[1][10] ZFEH_EepromData.ydiMemory_xau16[6].amb_cond.ambient_condition[1][11] ZFEH_EepromData.ydiMemory_xau16[6].amb_cond.ambient_condition[1][12] ZFEH_EepromData.ydiMemory_xau16[6].amb_cond.ambient_condition[1][13] ZFEH_EepromData.ydiMemory_xau16[6].amb_cond.ambient_condition[1][14] ZFEH_EepromData.ydiMemory_xau16[6].amb_cond.ambient_condition[1][15] ZFEH_EepromData.ydiMemory_xau16[6].amb_cond.ambient_condition[1][16] ZFEH_EepromData.ydiMemory_xau16[6].amb_cond.ambient_condition[1][17] ZFEH_EepromData.ydiMemory_xau16[6].amb_cond.ambient_condition[1][18] ZFEH_EepromData.ydiMemory_xau16[6].amb_cond.ambient_condition[1][19] ZFEH_EepromData.ydiMemory_xau16[6].amb_cond.ambient_condition[1][1] ZFEH_EepromData.ydiMemory_xau16[6].amb_cond.ambient_condition[1][20] ZFEH_EepromData.ydiMemory_xau16[6].amb_cond.ambient_condition[1][21] ZFEH_EepromData.ydiMemory_xau16[6].amb_cond.ambient_condition[1][22] ZFEH_EepromData.ydiMemory_xau16[6].amb_cond.ambient_condition[1][23] ZFEH_EepromData.ydiMemory_xau16[6].amb_cond.ambient_condition[1][24] ZFEH_EepromData.ydiMemory_xau16[6].amb_cond.ambient_condition[1][2] ZFEH_EepromData.ydiMemory_xau16[6].amb_cond.ambient_condition[1][3] ZFEH_EepromData.ydiMemory_xau16[6].amb_cond.ambient_condition[1][4] ZFEH_EepromData.ydiMemory_xau16[6].amb_cond.ambient_condition[1][5] ZFEH_EepromData.ydiMemory_xau16[6].amb_cond.ambient_condition[1][6] ZFEH_EepromData.ydiMemory_xau16[6].amb_cond.ambient_condition[1][7] ZFEH_EepromData.ydiMemory_xau16[6].amb_cond.ambient_condition[1][8] ZFEH_EepromData.ydiMemory_xau16[6].amb_cond.ambient_condition[1][9] ZFEH_EepromData.ydiMemory_xau16[6].amb_cond.status_of_ambient_conditions[0] ZFEH_EepromData.ydiMemory_xau16[6].amb_cond.status_of_ambient_conditions[1] ZFEH_EepromData.ydiMemory_xau16[6].backwards_counter ZFEH_EepromData.ydiMemory_xau16[6].condition_byte ZFEH_EepromData.ydiMemory_xau16[6].error_code ZFEH_EepromData.ydiMemory_xau16[6].error_type ZFEH_EepromData.ydiMemory_xau16[6].frequency_counter ZFEH_EepromData.ydiMemory_xau16[6].master_time ZFEH_EepromData.ydiMemory_xau16[6].obd_driving_cycle_counter ZFEH_EepromData.ydiMemory_xau16[6].permanent_counter ZFEH_EepromData.ydiMemory_xau16[6].sequence_counter ZFEH_EepromData.ydiMemory_xau16[6].status_word ZFEH_EepromData.ydiMemory_xau16[7].amb_cond.ambient_condition[0][0] ZFEH_EepromData.ydiMemory_xau16[7].amb_cond.ambient_condition[0][10] ZFEH_EepromData.ydiMemory_xau16[7].amb_cond.ambient_condition[0][11] ZFEH_EepromData.ydiMemory_xau16[7].amb_cond.ambient_condition[0][12] ZFEH_EepromData.ydiMemory_xau16[7].amb_cond.ambient_condition[0][13] ZFEH_EepromData.ydiMemory_xau16[7].amb_cond.ambient_condition[0][14] ZFEH_EepromData.ydiMemory_xau16[7].amb_cond.ambient_condition[0][15] ZFEH_EepromData.ydiMemory_xau16[7].amb_cond.ambient_condition[0][16] ZFEH_EepromData.ydiMemory_xau16[7].amb_cond.ambient_condition[0][17] ZFEH_EepromData.ydiMemory_xau16[7].amb_cond.ambient_condition[0][18] ZFEH_EepromData.ydiMemory_xau16[7].amb_cond.ambient_condition[0][19] ZFEH_EepromData.ydiMemory_xau16[7].amb_cond.ambient_condition[0][1] ZFEH_EepromData.ydiMemory_xau16[7].amb_cond.ambient_condition[0][20] ZFEH_EepromData.ydiMemory_xau16[7].amb_cond.ambient_condition[0][21] ZFEH_EepromData.ydiMemory_xau16[7].amb_cond.ambient_condition[0][22] ZFEH_EepromData.ydiMemory_xau16[7].amb_cond.ambient_condition[0][23] ZFEH_EepromData.ydiMemory_xau16[7].amb_cond.ambient_condition[0][24] ZFEH_EepromData.ydiMemory_xau16[7].amb_cond.ambient_condition[0][2] ZFEH_EepromData.ydiMemory_xau16[7].amb_cond.ambient_condition[0][3] ZFEH_EepromData.ydiMemory_xau16[7].amb_cond.ambient_condition[0][4] ZFEH_EepromData.ydiMemory_xau16[7].amb_cond.ambient_condition[0][5] ZFEH_EepromData.ydiMemory_xau16[7].amb_cond.ambient_condition[0][6] ZFEH_EepromData.ydiMemory_xau16[7].amb_cond.ambient_condition[0][7] ZFEH_EepromData.ydiMemory_xau16[7].amb_cond.ambient_condition[0][8] ZFEH_EepromData.ydiMemory_xau16[7].amb_cond.ambient_condition[0][9] ZFEH_EepromData.ydiMemory_xau16[7].amb_cond.ambient_condition[1][0] ZFEH_EepromData.ydiMemory_xau16[7].amb_cond.ambient_condition[1][10] ZFEH_EepromData.ydiMemory_xau16[7].amb_cond.ambient_condition[1][11] ZFEH_EepromData.ydiMemory_xau16[7].amb_cond.ambient_condition[1][12] ZFEH_EepromData.ydiMemory_xau16[7].amb_cond.ambient_condition[1][13] ZFEH_EepromData.ydiMemory_xau16[7].amb_cond.ambient_condition[1][14] ZFEH_EepromData.ydiMemory_xau16[7].amb_cond.ambient_condition[1][15] ZFEH_EepromData.ydiMemory_xau16[7].amb_cond.ambient_condition[1][16] ZFEH_EepromData.ydiMemory_xau16[7].amb_cond.ambient_condition[1][17] ZFEH_EepromData.ydiMemory_xau16[7].amb_cond.ambient_condition[1][18] ZFEH_EepromData.ydiMemory_xau16[7].amb_cond.ambient_condition[1][19] ZFEH_EepromData.ydiMemory_xau16[7].amb_cond.ambient_condition[1][1] ZFEH_EepromData.ydiMemory_xau16[7].amb_cond.ambient_condition[1][20] ZFEH_EepromData.ydiMemory_xau16[7].amb_cond.ambient_condition[1][21] ZFEH_EepromData.ydiMemory_xau16[7].amb_cond.ambient_condition[1][22] ZFEH_EepromData.ydiMemory_xau16[7].amb_cond.ambient_condition[1][23] ZFEH_EepromData.ydiMemory_xau16[7].amb_cond.ambient_condition[1][24] ZFEH_EepromData.ydiMemory_xau16[7].amb_cond.ambient_condition[1][2] ZFEH_EepromData.ydiMemory_xau16[7].amb_cond.ambient_condition[1][3] ZFEH_EepromData.ydiMemory_xau16[7].amb_cond.ambient_condition[1][4] ZFEH_EepromData.ydiMemory_xau16[7].amb_cond.ambient_condition[1][5] ZFEH_EepromData.ydiMemory_xau16[7].amb_cond.ambient_condition[1][6] ZFEH_EepromData.ydiMemory_xau16[7].amb_cond.ambient_condition[1][7] ZFEH_EepromData.ydiMemory_xau16[7].amb_cond.ambient_condition[1][8] ZFEH_EepromData.ydiMemory_xau16[7].amb_cond.ambient_condition[1][9] ZFEH_EepromData.ydiMemory_xau16[7].amb_cond.status_of_ambient_conditions[0] ZFEH_EepromData.ydiMemory_xau16[7].amb_cond.status_of_ambient_conditions[1] ZFEH_EepromData.ydiMemory_xau16[7].backwards_counter ZFEH_EepromData.ydiMemory_xau16[7].condition_byte ZFEH_EepromData.ydiMemory_xau16[7].error_code ZFEH_EepromData.ydiMemory_xau16[7].error_type ZFEH_EepromData.ydiMemory_xau16[7].frequency_counter ZFEH_EepromData.ydiMemory_xau16[7].master_time ZFEH_EepromData.ydiMemory_xau16[7].obd_driving_cycle_counter ZFEH_EepromData.ydiMemory_xau16[7].permanent_counter ZFEH_EepromData.ydiMemory_xau16[7].sequence_counter ZFEH_EepromData.ydiMemory_xau16[7].status_word ZFEH_EepromData.ydiMemory_xau16[8].amb_cond.ambient_condition[0][0] ZFEH_EepromData.ydiMemory_xau16[8].amb_cond.ambient_condition[0][10] ZFEH_EepromData.ydiMemory_xau16[8].amb_cond.ambient_condition[0][11] ZFEH_EepromData.ydiMemory_xau16[8].amb_cond.ambient_condition[0][12] ZFEH_EepromData.ydiMemory_xau16[8].amb_cond.ambient_condition[0][13] ZFEH_EepromData.ydiMemory_xau16[8].amb_cond.ambient_condition[0][14] ZFEH_EepromData.ydiMemory_xau16[8].amb_cond.ambient_condition[0][15] ZFEH_EepromData.ydiMemory_xau16[8].amb_cond.ambient_condition[0][16] ZFEH_EepromData.ydiMemory_xau16[8].amb_cond.ambient_condition[0][17] ZFEH_EepromData.ydiMemory_xau16[8].amb_cond.ambient_condition[0][18] ZFEH_EepromData.ydiMemory_xau16[8].amb_cond.ambient_condition[0][19] ZFEH_EepromData.ydiMemory_xau16[8].amb_cond.ambient_condition[0][1] ZFEH_EepromData.ydiMemory_xau16[8].amb_cond.ambient_condition[0][20] ZFEH_EepromData.ydiMemory_xau16[8].amb_cond.ambient_condition[0][21] ZFEH_EepromData.ydiMemory_xau16[8].amb_cond.ambient_condition[0][22] ZFEH_EepromData.ydiMemory_xau16[8].amb_cond.ambient_condition[0][23] ZFEH_EepromData.ydiMemory_xau16[8].amb_cond.ambient_condition[0][24] ZFEH_EepromData.ydiMemory_xau16[8].amb_cond.ambient_condition[0][2] ZFEH_EepromData.ydiMemory_xau16[8].amb_cond.ambient_condition[0][3] ZFEH_EepromData.ydiMemory_xau16[8].amb_cond.ambient_condition[0][4] ZFEH_EepromData.ydiMemory_xau16[8].amb_cond.ambient_condition[0][5] ZFEH_EepromData.ydiMemory_xau16[8].amb_cond.ambient_condition[0][6] ZFEH_EepromData.ydiMemory_xau16[8].amb_cond.ambient_condition[0][7] ZFEH_EepromData.ydiMemory_xau16[8].amb_cond.ambient_condition[0][8] ZFEH_EepromData.ydiMemory_xau16[8].amb_cond.ambient_condition[0][9] ZFEH_EepromData.ydiMemory_xau16[8].amb_cond.ambient_condition[1][0] ZFEH_EepromData.ydiMemory_xau16[8].amb_cond.ambient_condition[1][10] ZFEH_EepromData.ydiMemory_xau16[8].amb_cond.ambient_condition[1][11] ZFEH_EepromData.ydiMemory_xau16[8].amb_cond.ambient_condition[1][12] ZFEH_EepromData.ydiMemory_xau16[8].amb_cond.ambient_condition[1][13] ZFEH_EepromData.ydiMemory_xau16[8].amb_cond.ambient_condition[1][14] ZFEH_EepromData.ydiMemory_xau16[8].amb_cond.ambient_condition[1][15] ZFEH_EepromData.ydiMemory_xau16[8].amb_cond.ambient_condition[1][16] ZFEH_EepromData.ydiMemory_xau16[8].amb_cond.ambient_condition[1][17] ZFEH_EepromData.ydiMemory_xau16[8].amb_cond.ambient_condition[1][18] ZFEH_EepromData.ydiMemory_xau16[8].amb_cond.ambient_condition[1][19] ZFEH_EepromData.ydiMemory_xau16[8].amb_cond.ambient_condition[1][1] ZFEH_EepromData.ydiMemory_xau16[8].amb_cond.ambient_condition[1][20] ZFEH_EepromData.ydiMemory_xau16[8].amb_cond.ambient_condition[1][21] ZFEH_EepromData.ydiMemory_xau16[8].amb_cond.ambient_condition[1][22] ZFEH_EepromData.ydiMemory_xau16[8].amb_cond.ambient_condition[1][23] ZFEH_EepromData.ydiMemory_xau16[8].amb_cond.ambient_condition[1][24] ZFEH_EepromData.ydiMemory_xau16[8].amb_cond.ambient_condition[1][2] ZFEH_EepromData.ydiMemory_xau16[8].amb_cond.ambient_condition[1][3] ZFEH_EepromData.ydiMemory_xau16[8].amb_cond.ambient_condition[1][4] ZFEH_EepromData.ydiMemory_xau16[8].amb_cond.ambient_condition[1][5] ZFEH_EepromData.ydiMemory_xau16[8].amb_cond.ambient_condition[1][6] ZFEH_EepromData.ydiMemory_xau16[8].amb_cond.ambient_condition[1][7] ZFEH_EepromData.ydiMemory_xau16[8].amb_cond.ambient_condition[1][8] ZFEH_EepromData.ydiMemory_xau16[8].amb_cond.ambient_condition[1][9] ZFEH_EepromData.ydiMemory_xau16[8].amb_cond.status_of_ambient_conditions[0] ZFEH_EepromData.ydiMemory_xau16[8].amb_cond.status_of_ambient_conditions[1] ZFEH_EepromData.ydiMemory_xau16[8].backwards_counter ZFEH_EepromData.ydiMemory_xau16[8].condition_byte ZFEH_EepromData.ydiMemory_xau16[8].error_code ZFEH_EepromData.ydiMemory_xau16[8].error_type ZFEH_EepromData.ydiMemory_xau16[8].frequency_counter ZFEH_EepromData.ydiMemory_xau16[8].master_time ZFEH_EepromData.ydiMemory_xau16[8].obd_driving_cycle_counter /end LOC_MEASUREMENT
/end FUNCTION
/end MODULE
/end PROJECT
