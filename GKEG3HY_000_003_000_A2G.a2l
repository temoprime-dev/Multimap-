/* generated by ASAP2 Updater Version 5.1.01 */
ASAP2_VERSION 1 51
/begin PROJECT _929_929 "Gen2_BMW_System_Supplier_Lib"
/begin HEADER "" VERSION "C_03_03" PROJECT_NO _929_929 /end HEADER
/begin MODULE DIM ""
/begin MOD_PAR "Gen2_BMW_System_Supplier_Lib" VERSION "none" ADDR_EPK 0x200100 EPK "0929C03_ZHQB0300_8PXYPH00_Q030B " CUSTOMER_NO "0" USER "Boehm" PHONE_NO "+49-711-811-33828" ECU "TCU_2_3_13" CPU_TYPE "SH2A"
 /begin MEMORY_SEGMENT Pst0 "" RESERVED FLASH INTERN 0x0 0x40000 -1 -1 -1 -1 -1
  /begin IF_DATA XCP
   /begin SEGMENT 0x0 0x2 0x0 0x0 0x0 /begin CHECKSUM XCP_ADD_14 MAX_BLOCK_SIZE 0xFFFFFFFF /end CHECKSUM
    /begin PAGE 0x0 ECU_ACCESS_DONT_CARE XCP_READ_ACCESS_WITH_ECU_ONLY XCP_WRITE_ACCESS_NOT_ALLOWED /end PAGE
    /begin PAGE 0x1 ECU_ACCESS_DONT_CARE XCP_READ_ACCESS_DONT_CARE XCP_WRITE_ACCESS_WITH_ECU_ONLY /end PAGE
   /end SEGMENT
  /end IF_DATA
  /begin IF_DATA ASAP1B_DIAGNOSTIC_SERVICES ADDRESS_MAPPING 0x0 0x0 0x40000 /end IF_DATA
  /begin IF_DATA ETK ADDRESS_MAPPING 0x0 0x0 0x40000 /end IF_DATA
 /end MEMORY_SEGMENT
 /begin MEMORY_SEGMENT Pst40000 "" RESERVED FLASH INTERN 0x40000 0x80 -1 -1 -1 -1 -1
  /begin IF_DATA XCP
   /begin SEGMENT 0x1 0x2 0x0 0x0 0x0 /begin CHECKSUM XCP_ADD_14 MAX_BLOCK_SIZE 0xFFFFFFFF /end CHECKSUM
    /begin PAGE 0x0 ECU_ACCESS_DONT_CARE XCP_READ_ACCESS_WITH_ECU_ONLY XCP_WRITE_ACCESS_NOT_ALLOWED /end PAGE
    /begin PAGE 0x1 ECU_ACCESS_DONT_CARE XCP_READ_ACCESS_DONT_CARE XCP_WRITE_ACCESS_WITH_ECU_ONLY /end PAGE
   /end SEGMENT
  /end IF_DATA
  /begin IF_DATA ASAP1B_DIAGNOSTIC_SERVICES ADDRESS_MAPPING 0x40000 0x40000 0x80 /end IF_DATA
  /begin IF_DATA ETK ADDRESS_MAPPING 0x40000 0x40000 0x80 /end IF_DATA
 /end MEMORY_SEGMENT
 /begin MEMORY_SEGMENT Pst40080 "" CODE FLASH INTERN 0x40080 0x19FAF0 -1 -1 -1 -1 -1
  /begin IF_DATA XCP
   /begin SEGMENT 0x2 0x2 0x0 0x0 0x0 /begin CHECKSUM XCP_ADD_14 MAX_BLOCK_SIZE 0xFFFFFFFF /end CHECKSUM
    /begin PAGE 0x0 ECU_ACCESS_DONT_CARE XCP_READ_ACCESS_WITH_ECU_ONLY XCP_WRITE_ACCESS_NOT_ALLOWED /end PAGE
    /begin PAGE 0x1 ECU_ACCESS_DONT_CARE XCP_READ_ACCESS_DONT_CARE XCP_WRITE_ACCESS_WITH_ECU_ONLY /end PAGE
   /end SEGMENT
  /end IF_DATA
  /begin IF_DATA ASAP1B_DIAGNOSTIC_SERVICES ADDRESS_MAPPING 0x40080 0x40080 0x19FAF0 /end IF_DATA
  /begin IF_DATA ETK ADDRESS_MAPPING 0x40080 0x40080 0x19FAF0 /end IF_DATA
 /end MEMORY_SEGMENT
 /begin MEMORY_SEGMENT Pst1DFB70 "" RESERVED FLASH INTERN 0x1DFB70 0x490 -1 -1 -1 -1 -1
  /begin IF_DATA XCP
   /begin SEGMENT 0x3 0x2 0x0 0x0 0x0 /begin CHECKSUM XCP_ADD_14 MAX_BLOCK_SIZE 0xFFFFFFFF /end CHECKSUM
    /begin PAGE 0x0 ECU_ACCESS_DONT_CARE XCP_READ_ACCESS_WITH_ECU_ONLY XCP_WRITE_ACCESS_NOT_ALLOWED /end PAGE
    /begin PAGE 0x1 ECU_ACCESS_DONT_CARE XCP_READ_ACCESS_DONT_CARE XCP_WRITE_ACCESS_WITH_ECU_ONLY /end PAGE
   /end SEGMENT
  /end IF_DATA
  /begin IF_DATA ASAP1B_DIAGNOSTIC_SERVICES ADDRESS_MAPPING 0x1DFB70 0x1DFB70 0x490 /end IF_DATA
  /begin IF_DATA ETK ADDRESS_MAPPING 0x1DFB70 0x1DFB70 0x490 /end IF_DATA
 /end MEMORY_SEGMENT
 /begin MEMORY_SEGMENT Dst1E0000 "" RESERVED FLASH INTERN 0x1E0000 0x280 -1 -1 -1 -1 -1
  /begin IF_DATA XCP
   /begin SEGMENT 0x4 0x2 0x0 0x0 0x0 /begin CHECKSUM XCP_ADD_14 MAX_BLOCK_SIZE 0xFFFFFFFF /end CHECKSUM
    /begin PAGE 0x0 ECU_ACCESS_DONT_CARE XCP_READ_ACCESS_WITH_ECU_ONLY XCP_WRITE_ACCESS_NOT_ALLOWED /end PAGE
    /begin PAGE 0x1 ECU_ACCESS_DONT_CARE XCP_READ_ACCESS_DONT_CARE XCP_WRITE_ACCESS_WITH_ECU_ONLY /end PAGE
   /end SEGMENT
  /end IF_DATA
  /begin IF_DATA ASAP1B_DIAGNOSTIC_SERVICES ADDRESS_MAPPING 0x1E0000 0x1E0000 0x280 /end IF_DATA
  /begin IF_DATA ETK ADDRESS_MAPPING 0x1E0000 0x1E0000 0x280 /end IF_DATA
 /end MEMORY_SEGMENT
 /begin MEMORY_SEGMENT Dst1E0280 "" CODE FLASH INTERN 0x1E0280 0x1FD80 -1 -1 -1 -1 -1
  /begin IF_DATA XCP
   /begin SEGMENT 0x5 0x2 0x0 0x0 0x0 /begin CHECKSUM XCP_ADD_14 MAX_BLOCK_SIZE 0xFFFFFFFF /end CHECKSUM
    /begin PAGE 0x0 ECU_ACCESS_DONT_CARE XCP_READ_ACCESS_WITH_ECU_ONLY XCP_WRITE_ACCESS_NOT_ALLOWED /end PAGE
    /begin PAGE 0x1 ECU_ACCESS_DONT_CARE XCP_READ_ACCESS_DONT_CARE XCP_WRITE_ACCESS_WITH_ECU_ONLY /end PAGE
   /end SEGMENT
  /end IF_DATA
  /begin IF_DATA ASAP1B_DIAGNOSTIC_SERVICES ADDRESS_MAPPING 0x1E0280 0x1E0280 0x1FD80 /end IF_DATA
  /begin IF_DATA ETK ADDRESS_MAPPING 0x1E0280 0x1E0280 0x1FD80 /end IF_DATA
 /end MEMORY_SEGMENT
 /begin MEMORY_SEGMENT Dst200000 "" DATA FLASH INTERN 0x200000 0x7FD60 -1 -1 -1 -1 -1
  /begin IF_DATA XCP
   /begin SEGMENT 0x6 0x2 0x0 0x0 0x0 /begin CHECKSUM XCP_ADD_14 MAX_BLOCK_SIZE 0xFFFFFFFF /end CHECKSUM
    /begin PAGE 0x0 ECU_ACCESS_DONT_CARE XCP_READ_ACCESS_WITH_ECU_ONLY XCP_WRITE_ACCESS_NOT_ALLOWED /end PAGE
    /begin PAGE 0x1 ECU_ACCESS_DONT_CARE XCP_READ_ACCESS_DONT_CARE XCP_WRITE_ACCESS_WITH_ECU_ONLY /end PAGE
   /end SEGMENT
  /end IF_DATA
  /begin IF_DATA ASAP1B_DIAGNOSTIC_SERVICES ADDRESS_MAPPING 0x200000 0x200000 0x7FD60 /end IF_DATA
  /begin IF_DATA ETK ADDRESS_MAPPING 0x200000 0x200000 0x7FD60 /end IF_DATA
 /end MEMORY_SEGMENT
 /begin MEMORY_SEGMENT Dst27FD60 "" RESERVED FLASH INTERN 0x27FD60 0x2A0 -1 -1 -1 -1 -1
  /begin IF_DATA XCP
   /begin SEGMENT 0x7 0x2 0x0 0x0 0x0 /begin CHECKSUM XCP_ADD_14 MAX_BLOCK_SIZE 0xFFFFFFFF /end CHECKSUM
    /begin PAGE 0x0 ECU_ACCESS_DONT_CARE XCP_READ_ACCESS_WITH_ECU_ONLY XCP_WRITE_ACCESS_NOT_ALLOWED /end PAGE
    /begin PAGE 0x1 ECU_ACCESS_DONT_CARE XCP_READ_ACCESS_DONT_CARE XCP_WRITE_ACCESS_WITH_ECU_ONLY /end PAGE
   /end SEGMENT
  /end IF_DATA
  /begin IF_DATA ASAP1B_DIAGNOSTIC_SERVICES ADDRESS_MAPPING 0x27FD60 0x27FD60 0x2A0 /end IF_DATA
  /begin IF_DATA ETK ADDRESS_MAPPING 0x27FD60 0x27FD60 0x2A0 /end IF_DATA
 /end MEMORY_SEGMENT
 /begin MEMORY_SEGMENT RamFFF80000 "" VARIABLES RAM INTERN 0xFFF80000 0x1C000 -1 -1 -1 -1 -1
  /begin IF_DATA XCP
   /begin SEGMENT 0x8 0x2 0x0 0x0 0x0 /begin CHECKSUM XCP_ADD_14 MAX_BLOCK_SIZE 0xFFFFFFFF /end CHECKSUM
    /begin PAGE 0x0 ECU_ACCESS_DONT_CARE XCP_READ_ACCESS_WITH_ECU_ONLY XCP_WRITE_ACCESS_NOT_ALLOWED /end PAGE
    /begin PAGE 0x1 ECU_ACCESS_DONT_CARE XCP_READ_ACCESS_DONT_CARE XCP_WRITE_ACCESS_WITH_ECU_ONLY /end PAGE
   /end SEGMENT
  /end IF_DATA
 /end MEMORY_SEGMENT
 /begin MEMORY_SEGMENT RamFFF9C000 "" SERAM RAM INTERN 0xFFF9C000 0x3000 -1 -1 -1 -1 -1
  /begin IF_DATA XCP
   /begin SEGMENT 0x9 0x2 0x0 0x0 0x0 /begin CHECKSUM XCP_ADD_14 MAX_BLOCK_SIZE 0xFFFFFFFF /end CHECKSUM
    /begin PAGE 0x0 ECU_ACCESS_DONT_CARE XCP_READ_ACCESS_WITH_ECU_ONLY XCP_WRITE_ACCESS_NOT_ALLOWED /end PAGE
    /begin PAGE 0x1 ECU_ACCESS_DONT_CARE XCP_READ_ACCESS_DONT_CARE XCP_WRITE_ACCESS_WITH_ECU_ONLY /end PAGE
   /end SEGMENT
  /end IF_DATA
 /end MEMORY_SEGMENT
 /begin MEMORY_SEGMENT RamFFF9F000 "" VARIABLES RAM INTERN 0xFFF9F000 0x1000 -1 -1 -1 -1 -1
  /begin IF_DATA XCP
   /begin SEGMENT 0xA 0x2 0x0 0x0 0x0 /begin CHECKSUM XCP_ADD_14 MAX_BLOCK_SIZE 0xFFFFFFFF /end CHECKSUM
    /begin PAGE 0x0 ECU_ACCESS_DONT_CARE XCP_READ_ACCESS_WITH_ECU_ONLY XCP_WRITE_ACCESS_NOT_ALLOWED /end PAGE
    /begin PAGE 0x1 ECU_ACCESS_DONT_CARE XCP_READ_ACCESS_DONT_CARE XCP_WRITE_ACCESS_WITH_ECU_ONLY /end PAGE
   /end SEGMENT
  /end IF_DATA
 /end MEMORY_SEGMENT
 /begin MEMORY_SEGMENT RamFFFC0000 "" VARIABLES RAM INTERN 0xFFFC0000 0x40000 -1 -1 -1 -1 -1
  /begin IF_DATA XCP
   /begin SEGMENT 0xB 0x2 0x0 0x0 0x0 /begin CHECKSUM XCP_ADD_14 MAX_BLOCK_SIZE 0xFFFFFFFF /end CHECKSUM
    /begin PAGE 0x0 ECU_ACCESS_DONT_CARE XCP_READ_ACCESS_WITH_ECU_ONLY XCP_WRITE_ACCESS_NOT_ALLOWED /end PAGE
    /begin PAGE 0x1 ECU_ACCESS_DONT_CARE XCP_READ_ACCESS_DONT_CARE XCP_WRITE_ACCESS_WITH_ECU_ONLY /end PAGE
   /end SEGMENT
  /end IF_DATA
 /end MEMORY_SEGMENT
 SYSTEM_CONSTANT "CAN_NUM_CLASSES_SY" "8"
 SYSTEM_CONSTANT "CAN_Num_CnBus_SY" "2"
 SYSTEM_CONSTANT "CAN_NUM_FIFOR_SY" "16"
 SYSTEM_CONSTANT "CAN_NUM_NODES_SY" "3"
 SYSTEM_CONSTANT "CAN_PROJ_CFG_SY" "351"
 SYSTEM_CONSTANT "CAN_RxMode2act_SY" "1"
 SYSTEM_CONSTANT "CAN_RxMode2_SY" "10"
 SYSTEM_CONSTANT "CNE_SWTNETMNMT_SY" "1"
 SYSTEM_CONSTANT "LINAPPL_IFC_NUMFRAMESCAL" "8"
 SYSTEM_CONSTANT "LINAPPL_IFC_NUMFRAMESMON" "11"
 SYSTEM_CONSTANT "LINAPPL_MLXHNDLR_SLVPG" "128"
 SYSTEM_CONSTANT "LINAPPL_MLXSHNDLR_EXP_NUMFLSHRNG" "6"
 SYSTEM_CONSTANT "LINAPPL_MLXSHNDLR_SERNUM_MAXSIZE" "8"
 SYSTEM_CONSTANT "LINAPPL_MLXSHNDRL_NUM_LDST" "4"
 SYSTEM_CONSTANT "LINAPPL_TRAHNDLR_BUFELESIZE" "8"
 SYSTEM_CONSTANT "LINAPPL_TRAHNDLR_BUFSIZE" "1"
 SYSTEM_CONSTANT "OmmCfg_CFG_USESDNSLP" "0"
 SYSTEM_CONSTANT "OmmIfSys_CFG_USE10MSTSKINI_SY" "1"
 SYSTEM_CONSTANT "OmmIfSys_CFG_USE30MSTSK_SY" "1"
 SYSTEM_CONSTANT "OmmIfSys_CFG_USEDSMCLRTSK_SY" "0"
 SYSTEM_CONSTANT "RCT_CFG_SCHEDPREEMPBG_SY" "1"
 SYSTEM_CONSTANT "RCT_CFG_USE10MSTSKINI_SY" "1"
 SYSTEM_CONSTANT "RCT_CFG_USE30MSTSK_SY" "1"
 SYSTEM_CONSTANT "RCT_CFG_USE5MSINITSK_SY" "1"
 SYSTEM_CONSTANT "RCT_CFG_USEDSMCLRTSK_SY" "0"
 SYSTEM_CONSTANT "RCT_MODE_NUM_SY" "6"
 SYSTEM_CONSTANT "RCT_TSK_NUM_SY" "9"
 SYSTEM_CONSTANT "RMN_CFG_TSKENH_SY" "1"
 SYSTEM_CONSTANT "RMN_CFG_TSK_SY" "1"
 SYSTEM_CONSTANT "ROS_IN_LIB_SY" "1"
 SYSTEM_CONSTANT "ROS_NUM_MNTSK_100MS_SY" "20"
 SYSTEM_CONSTANT "RRT_CFG_CPULD2_SY" "1"
 SYSTEM_CONSTANT "RRT_CFG_FGP_SY" "1"
 SYSTEM_CONSTANT "RRT_CFG_ISR_SY" "1"
 SYSTEM_CONSTANT "RRT_CFG_PROC_ALL_SY" "1"
 SYSTEM_CONSTANT "RRT_CFG_PROC_SY" "1"
 SYSTEM_CONSTANT "RRT_CFG_SWT_SY" "63"
 SYSTEM_CONSTANT "RRT_CFG_TSK_SY" "1"
 SYSTEM_CONSTANT "RRT_NUMPROCRUN_100_SY" "35"
 SYSTEM_CONSTANT "RRT_NUMPROCRUN_10_SY" "120"
 SYSTEM_CONSTANT "RRT_NUMPROCRUN_20_SY" "35"
 SYSTEM_CONSTANT "RRT_NUMPROCRUN_2X5_SY" "20"
 SYSTEM_CONSTANT "RRT_NUMPROCRUN_30_SY" "50"
 SYSTEM_CONSTANT "RRT_NUMPROCRUN_50_SY" "20"
 SYSTEM_CONSTANT "RRT_NUMPROCRUN_5_SY" "40"
 SYSTEM_CONSTANT "RRT_NUMPROCRUN_BG_SY" "10"
 SYSTEM_CONSTANT "RRT_NUMPROCRUN_FN_SY" "45"
 SYSTEM_CONSTANT "RRT_NUMPROCRUN_TRS_SY" "55"
 SYSTEM_CONSTANT "RRT_NUMPROCTAB_SY" "7"
 SYSTEM_CONSTANT "RRT_PROC_NUM_SY" "5"
 SYSTEM_CONSTANT "RRT_SWTPROCCTL_X_SY" "6"
 SYSTEM_CONSTANT "SHRVAR_CAFID_LNGTH_SY" "8"
 SYSTEM_CONSTANT "SHRVAR_CPS_LNGTH_SY" "7"
 SYSTEM_CONSTANT "SHRVAR_SGNTR_LNGTH_SY" "132"
 SYSTEM_CONSTANT "SHRVAR_VARCOD_LNGTH_SY_1" "2"
 SYSTEM_CONSTANT "SHRVAR_VARCOD_LNGTH_SY_2" "2"
 SYSTEM_CONSTANT "TPRT_CFG_DIA_MIN_DSM_CLR_SY" "0"
 SYSTEM_CONSTANT "TPRT_CFG_DIA_MIN_DSM_SY" "0"
 SYSTEM_CONSTANT "TPRT_CFG_DIA_MNG_SY" "2"
 SYSTEM_CONSTANT "TPRT_CFG_MEM_DP_NUM_BYTE_SY" "100"
 SYSTEM_CONSTANT "TPRT_CFG_OUCD_TAB_SY" "1"
 SYSTEM_CONSTANT "TPRT_CFG_SEED_KEY_SY" "1"
 SYSTEM_CONSTANT "TPRT_CFG_SIG_OUT_TAB_SY" "1"
 SYSTEM_CONSTANT "TPRT_CFG_TOUT_SY" "1"
 SYSTEM_CONSTANT "TPRT_MSG_BUF_NUM_ELM_SY" "8"
 /begin CALIBRATION_METHOD "InCircuit" 0x2 /begin CALIBRATION_HANDLE 0x1E0280 0x113BC 0x4 0x1E0280 0x113BC /end CALIBRATION_HANDLE /end CALIBRATION_METHOD
/end MOD_PAR
/begin MOD_COMMON "" BYTE_ORDER MSB_FIRST ALIGNMENT_BYTE 1 ALIGNMENT_WORD 2 ALIGNMENT_LONG 4 ALIGNMENT_FLOAT32_IEEE 4 /end MOD_COMMON
/begin IF_DATA XCP
 /begin XCP_ON_CAN 0x100 CAN_ID_MASTER 0x7AD CAN_ID_SLAVE 0x784 BAUDRATE 0x7A120 SAMPLE_POINT 0x42 SAMPLE_RATE SINGLE BTL_CYCLES 0x10 SJW 0x2 SYNC_EDGE SINGLE /begin DAQ_LIST_CAN_ID 0x0 FIXED 0x784 /end DAQ_LIST_CAN_ID /begin DAQ_LIST_CAN_ID 0x1 FIXED 0x784 /end DAQ_LIST_CAN_ID /begin DAQ_LIST_CAN_ID 0x2 FIXED 0x784 /end DAQ_LIST_CAN_ID
  /begin PROTOCOL_LAYER 0x100 0x514 0x3E8 0x0 0x0 0x0 0x0 0x0 0x8 0x8 BYTE_ORDER_MSB_FIRST ADDRESS_GRANULARITY_BYTE OPTIONAL_CMD GET_ID OPTIONAL_CMD SET_REQUEST OPTIONAL_CMD SET_MTA OPTIONAL_CMD UPLOAD OPTIONAL_CMD SHORT_UPLOAD OPTIONAL_CMD BUILD_CHECKSUM OPTIONAL_CMD DOWNLOAD_NEXT OPTIONAL_CMD GET_PAG_PROCESSOR_INFO OPTIONAL_CMD SET_SEGMENT_MODE OPTIONAL_CMD GET_SEGMENT_MODE OPTIONAL_CMD COPY_CAL_PAGE OPTIONAL_CMD GET_DAQ_CLOCK OPTIONAL_CMD GET_DAQ_PROCESSOR_INFO OPTIONAL_CMD FREE_DAQ OPTIONAL_CMD ALLOC_DAQ OPTIONAL_CMD ALLOC_ODT OPTIONAL_CMD ALLOC_ODT_ENTRY COMMUNICATION_MODE_SUPPORTED BLOCK SLAVE MASTER 0x4 0x0 /end PROTOCOL_LAYER
  /begin DAQ STATIC 0x3 0x3 0x0 OPTIMISATION_TYPE_DEFAULT ADDRESS_EXTENSION_FREE IDENTIFICATION_FIELD_TYPE_ABSOLUTE GRANULARITY_ODT_ENTRY_SIZE_DAQ_BYTE 0x4 NO_OVERLOAD_INDICATION
   /begin DAQ_LIST 0x0 DAQ_LIST_TYPE DAQ MAX_ODT 0x8 MAX_ODT_ENTRIES 0x7 FIRST_PID 0x0 EVENT_FIXED 0x0 /end DAQ_LIST
   /begin DAQ_LIST 0x1 DAQ_LIST_TYPE DAQ MAX_ODT 0x4 MAX_ODT_ENTRIES 0x7 FIRST_PID 0x8 EVENT_FIXED 0x1 /end DAQ_LIST
   /begin DAQ_LIST 0x2 DAQ_LIST_TYPE DAQ MAX_ODT 0x8 MAX_ODT_ENTRIES 0x7 FIRST_PID 0xC EVENT_FIXED 0x2 /end DAQ_LIST
   /begin EVENT "10ms time synchronous" "10ms" 0x0 DAQ 0x1 0xA 0x6 0x7 /end EVENT
   /begin EVENT "20ms time synchronous" "20ms" 0x1 DAQ 0x1 0x14 0x6 0x6 /end EVENT
   /begin EVENT "100ms time synchronous" "100ms" 0x2 DAQ 0x1 0x64 0x6 0x5 /end EVENT
  /end DAQ
 /end XCP_ON_CAN
/end IF_DATA
/begin IF_DATA ASAP1B_DIAGNOSTIC_SERVICES
 /begin SOURCE "diagnostic 10ms" 0x4 0x1 QP_BLOB QP_BLOB_VERSION 0x300 BLOCKMODE LOCAL_ID 0xF301 MAX_NO_OF_SIGNALS 0x14 MAX_NO_OF_BYTES 0x50 AVAILABLE_ON CAN /end SOURCE
 /begin TP_BLOB 0x300 ISO14229_1_2003 BYTEORDER_MSB_FIRST /begin SESSION "InCircuit_CAL" 0x66 SessionOpeningOrder StartDiagSession /end SESSION /begin DATA_ACCESS 0x0 0x0 0x1 0x1 0x1 0x1 /end DATA_ACCESS /begin CHECKSUM 0x10201 0x1 0xFE81 CHECKSUM_RESULT StartRoutine /end CHECKSUM /begin COPY RAM_InitByEcu /end COPY
  /begin FLASH TOOLFLASHBACK 0x3 COPY_FRAME 0x1 RequestRoutineResults RNC_RESULT 0x23 0xFB 0xFC /end FLASH
  /begin PAGE_SWITCH PAGE_CODE 0x0 0x1 LOCAL_ROUTINE ROUTINE_NUMBER_SET 0xFE80 ROUTINE_NUMBER_READ 0xFE82 ROUTINE_PARAM_READ 0xA0 ROUTINE_RESULTS StartRoutine /end PAGE_SWITCH
  /begin ADDRESS_AND_LENGTH_FORMAT_IDENTIFIER 0x14 AALFI_FOR_CHECKSUM_CALCULATION 0x44 AALFI_FOR_ERASE_MEMORY 0x14 AALFI_FOR_WRITE_MEMORY_BY_ADDR 0x14 AALFI_FOR_READ_MEMORY_BY_ADDR 0x14 AALFI_FOR_DYNAMICALLY_DEFINE_DATA_ID 0x14 AALFI_FOR_REQUEST_DOWNLOAD 0x34 /end ADDRESS_AND_LENGTH_FORMAT_IDENTIFIER
  /begin CAN 0x7A120 SamplePoint 0x46 SamplesPerBit 0x1 BTL_CYCLES 0x10 SJW 0x2 SYNC_EDGE 0x0 /begin ADDRESS 0x7E9 0x7E1 /end ADDRESS /begin TransportProtocolVersion ISO15765_2_2003 /end TransportProtocolVersion NETWORK_LIMITS 0xA 0x500 USDTP_TIMING_DEFAULTS 0x3E8 0x3E8 0x3E8 0x0 0x32 0x0 0x1388 USDTP_TIMING 0x3E8 0x3E8 0x3E8 0x0 0x32 0x0 0x1388 /end CAN
 /end TP_BLOB
/end IF_DATA
/begin IF_DATA ASAP1B_Bypass
 /begin TP_BLOB 0x100 0x100 /end TP_BLOB
/end IF_DATA
/begin IF_DATA ETK
 /begin SOURCE "2.5ms time synchronous" 0x2 0x19 QP_BLOB 0x102 0x1 DIRECT 0x20 MEASUREMENT 0xFFFC0D04 0x60 0xFFF80134 0xFFF89C18 0x0 0x0 0x0 0x4E2 0x60 0x0 0x1 /end SOURCE
 /begin SOURCE "5ms time synchronous" 0x3 0x5 QP_BLOB 0x102 0x2 DIRECT 0x1F MEASUREMENT 0xFFFC0D04 0x60 0xFFF802BC 0xFFF89C78 0x0 0x0 0x0 0x9C4 0x60 0x0 0x2 /end SOURCE
 /begin SOURCE "10ms time synchronous" 0x4 0x1 QP_BLOB 0x102 0x3 DIRECT 0x1E MEASUREMENT 0xFFFC0D04 0x60 0xFFF80444 0xFFF89CD8 0x0 0x0 0x0 0x1388 0x60 0x0 0x3 /end SOURCE
 /begin SOURCE "20ms time synchronous" 0x4 0x2 QP_BLOB 0x102 0x4 DIRECT 0x1C MEASUREMENT 0xFFFC0D04 0x60 0xFFF805CC 0xFFF89D38 0x0 0x0 0x0 0x2710 0x60 0x0 0x4 /end SOURCE
 /begin SOURCE "50ms time synchronous" 0x4 0x5 QP_BLOB 0x102 0x5 DIRECT 0x1B MEASUREMENT 0xFFFC0D04 0x60 0xFFF80754 0xFFF89D98 0x0 0x0 0x0 0x61A8 0x60 0x0 0x5 /end SOURCE
 /begin SOURCE "100ms time synchronous" 0x4 0xA QP_BLOB 0x102 0x6 DIRECT 0x1A MEASUREMENT 0xFFFC0D04 0x60 0xFFF808DC 0xFFF89DF8 0x0 0x0 0x0 0xC350 0x60 0x0 0x6 /end SOURCE
 /begin SOURCE "Bypass 10ms time synchronous" 0x4 0x1 QP_BLOB 0x102 0x7 DIRECT 0x1D BYPASS 0xFFFC0D04 0x78 0xFFF80A64 0xFFF89E58 0x78 0x0 0xFFF89ED0 0x1388 0x78 0x78 0x3 /end SOURCE
 /begin TP_BLOB 0x1000104 INTERFACE_SPEED_100MBIT 0x7FFFFF07 DISTAB_CFG 0xD 0x122 0x1 0xFFFC0D04 0x1010100 TRG_MOD 0x0 0xFF 0x0 0x0 0x0 ETK_CFG 0x10 0x17 0x69 0x0 0x0 0xFF 0xFF 0x6F 0xD0 0x71 0x9D 0x70 0x78 0x64 0xB 0x74 0xC8 0x72 0xC7 0x73 0xBA 0x75 0xC5 ETK_MAILBOX 0x46425251 EXRAM 0xFFF89C00 0x18 EXRAM 0xFFF89C00 0x18 0x3 0x100
  /begin COLDSTART_HANDSHAKE 0xFFF921FC WAIT 0x57 0x41 0x49 0x54 READY 0x51 0x45 0x41 0x44 /end COLDSTART_HANDSHAKE
  PAGE_SWITCH_METHOD 0x1 MAILBOX 0x1 0x14 0xFFF80C4C AUTOSTART_BEHAVIOR LAST_ACTIVE_PAGE OCT_WORKINGPAGE 0x21 0xFFF80100 0x34 /end TP_BLOB
/end IF_DATA
/begin CHARACTERISTIC CANFA_ctMsgMonAlvACLNX_MASSCNTR_C "F2062: alive counter monitoring message ACLNX_MASSCNTR" VALUE 0x201A44 AblGLKWub_M 255 X1_M 0 255 FORMAT "%5.1" /end CHARACTERISTIC
/begin CHARACTERISTIC CANFA_ctMsgMonAlvACLNY_MASSCNTR_C "F2062: alive counter monitoring message ACLNY_MASSCNTR" VALUE 0x201A45 AblGLKWub_M 255 X1_M 0 255 FORMAT "%5.1" /end CHARACTERISTIC
/begin CHARACTERISTIC CANFA_ctMsgMonAlvANG_ACPD_C "F2062: alive counter monitoring message ANG_ACPD" VALUE 0x201A46 AblGLKWub_M 255 X1_M 0 255 FORMAT "%5.1" /end CHARACTERISTIC
/begin CHARACTERISTIC CANFA_ctMsgMonAlvAVL_BRTORQ_SUM_C "F2062: alive counter monitoring message AVL_BRTORQ_SUM" VALUE 0x201A47 AblGLKWub_M 255 X1_M 0 255 FORMAT "%5.1" /end CHARACTERISTIC
/begin CHARACTERISTIC CANFA_ctMsgMonAlvKLEMMEN_C "F2062: alive counter monitoring message KLEMMEN" VALUE 0x201A48 AblGLKWub_M 255 X1_M 0 255 FORMAT "%5.1" /end CHARACTERISTIC
/begin CHARACTERISTIC CANFA_ctMsgMonAlvMASS_VEH_C "F2062: alive counter monitoring message MASS_VEH" VALUE 0x201A49 AblGLKWub_M 255 X1_M 0 255 FORMAT "%5.1" /end CHARACTERISTIC
/begin CHARACTERISTIC CANFA_ctMsgMonAlvOP_SPD_C "F2062: alive counter monitoring message OP_SPD" VALUE 0x201A4A AblGLKWub_M 255 X1_M 0 255 FORMAT "%5.1" /end CHARACTERISTIC
/begin CHARACTERISTIC CANFA_ctMsgMonAlvSTAT_DS_VRFD_C "F2062: alive counter monitoring message STAT_DS_VRFD" VALUE 0x201A4B AblGLKWub_M 255 X1_M 0 255 FORMAT "%5.1" /end CHARACTERISTIC
/begin CHARACTERISTIC CANFA_ctMsgMonAlvST_BLT_CT_SOCCU_C "F2062: alive counter monitoring message ST_BLT_CT_SOCCU" VALUE 0x201A4C AblGLKWub_M 255 X1_M 0 255 FORMAT "%5.1" /end CHARACTERISTIC
/begin CHARACTERISTIC CANFA_ctMsgMonAlvST_GWS_C "F2062: alive counter monitoring message ST_GWS" VALUE 0x201A4D AblGLKWub_M 255 X1_M 0 255 FORMAT "%5.1" /end CHARACTERISTIC
/begin CHARACTERISTIC CANFA_ctMsgMonAlvST_STAB_DSC_C "F2062: alive counter monitoring message ST_STAB_DSC" VALUE 0x201A4E AblGLKWub_M 255 X1_M 0 255 FORMAT "%5.1" /end CHARACTERISTIC
/begin CHARACTERISTIC CANFA_ctMsgMonAlvST_VEHSS_PBRK_C "F2062: alive counter monitoring message ST_VEHSS_PBRK" VALUE 0x201A4F AblGLKWub_M 255 X1_M 0 255 FORMAT "%5.1" /end CHARACTERISTIC
/begin CHARACTERISTIC CANFA_ctMsgMonAlvST_VHSS_C "F2062: alive counter monitoring message ST_VHSS" VALUE 0x201A50 AblGLKWub_M 255 X1_M 0 255 FORMAT "%5.1" /end CHARACTERISTIC
/begin CHARACTERISTIC CANFA_ctMsgMonAlvSU_SW_DRDY_C "F2062: alive counter monitoring message SU_SW_DRDY" VALUE 0x201A51 AblGLKWub_M 255 X1_M 0 255 FORMAT "%5.1" /end CHARACTERISTIC
/begin CHARACTERISTIC CANFA_ctMsgMonAlvTLT_RW_C "F2062: alive counter monitoring message TLT_RW" VALUE 0x201A52 AblGLKWub_M 255 X1_M 0 255 FORMAT "%5.1" /end CHARACTERISTIC
/begin CHARACTERISTIC CANFA_ctMsgMonAlvTORQ_CRSH_1_C "F2062: alive counter monitoring message TORQ_CRSH_1" VALUE 0x201A53 AblGLKWub_M 255 X1_M 0 255 FORMAT "%5.1" /end CHARACTERISTIC
/begin CHARACTERISTIC CANFA_ctMsgMonAlvTORQ_PT_HYB_1_C "F2062: alive counter monitoring message TORQ_PT_HYB_1" VALUE 0x201A54 AblGLKWub_M 255 X1_M 0 255 FORMAT "%5.1" /end CHARACTERISTIC
/begin CHARACTERISTIC CANFA_ctMsgMonAlvVYAW_VEH_C "F2062: alive counter monitoring message VYAW_VEH" VALUE 0x201A55 AblGLKWub_M 255 X1_M 0 255 FORMAT "%5.1" /end CHARACTERISTIC
/begin CHARACTERISTIC CANFA_ctMsgMonAlvV_VEH_C "F2062: alive counter monitoring message V_VEH" VALUE 0x201A56 AblGLKWub_M 255 X1_M 0 255 FORMAT "%5.1" /end CHARACTERISTIC
/begin CHARACTERISTIC CANFA_ctMsgMonAlvWMOM_DRV_1_C "F2062: alive counter monitoring message WMOM_DRV_1" VALUE 0x201A57 AblGLKWub_M 255 X1_M 0 255 FORMAT "%5.1" /end CHARACTERISTIC
/begin CHARACTERISTIC CANFA_ctMsgMonChkACLNX_MASSCNTR_C "F2062: checksum monitoring message ACLNX_MASSCNTR" VALUE 0x201A58 AblGLKWub_M 255 X1_M 0 255 FORMAT "%5.1" /end CHARACTERISTIC
/begin CHARACTERISTIC CANFA_ctMsgMonChkACLNY_MASSCNTR_C "F2062: checksum monitoring message ACLNY_MASSCNTR" VALUE 0x201A59 AblGLKWub_M 255 X1_M 0 255 FORMAT "%5.1" /end CHARACTERISTIC
/begin CHARACTERISTIC CANFA_ctMsgMonChkANG_ACPD_C "F2062: checksum monitoring message ANG_ACPD" VALUE 0x201A5A AblGLKWub_M 255 X1_M 0 255 FORMAT "%5.1" /end CHARACTERISTIC
/begin CHARACTERISTIC CANFA_ctMsgMonChkAVL_BRTORQ_SUM_C "F2062: checksum monitoring message AVL_BRTORQ_SUM" VALUE 0x201A5B AblGLKWub_M 255 X1_M 0 255 FORMAT "%5.1" /end CHARACTERISTIC
/begin CHARACTERISTIC CANFA_ctMsgMonChkKLEMMEN_C "F2062: checksum monitoring message KLEMMEN" VALUE 0x201A5C AblGLKWub_M 255 X1_M 0 255 FORMAT "%5.1" /end CHARACTERISTIC
/begin CHARACTERISTIC CANFA_ctMsgMonChkMASS_VEH_C "F2062: checksum monitoring message MASS_VEH" VALUE 0x201A5D AblGLKWub_M 255 X1_M 0 255 FORMAT "%5.1" /end CHARACTERISTIC
/begin CHARACTERISTIC CANFA_ctMsgMonChkOP_SPD_C "F2062: checksum monitoring message OP_SPD" VALUE 0x201A5E AblGLKWub_M 255 X1_M 0 255 FORMAT "%5.1" /end CHARACTERISTIC
/begin CHARACTERISTIC CANFA_ctMsgMonChkSTAT_DS_VRFD_C "F2062: checksum monitoring message STAT_DS_VRFD" VALUE 0x201A5F AblGLKWub_M 255 X1_M 0 255 FORMAT "%5.1" /end CHARACTERISTIC
/begin CHARACTERISTIC CANFA_ctMsgMonChkST_BLT_CT_SOCCU_C "F2062: checksum monitoring message ST_BLT_CT_SOCCU" VALUE 0x201A60 AblGLKWub_M 255 X1_M 0 255 FORMAT "%5.1" /end CHARACTERISTIC
/begin CHARACTERISTIC CANFA_ctMsgMonChkST_GWS_C "F2062: checksum monitoring message ST_GWS" VALUE 0x201A61 AblGLKWub_M 255 X1_M 0 255 FORMAT "%5.1" /end CHARACTERISTIC
/begin CHARACTERISTIC CANFA_ctMsgMonChkST_STAB_DSC_C "F2062: checksum monitoring message ST_STAB_DSC" VALUE 0x201A62 AblGLKWub_M 255 X1_M 0 255 FORMAT "%5.1" /end CHARACTERISTIC
/begin CHARACTERISTIC CANFA_ctMsgMonChkST_VEHSS_PBRK_C "F2062: checksum monitoring message ST_VEHSS_PBRK" VALUE 0x201A63 AblGLKWub_M 255 X1_M 0 255 FORMAT "%5.1" /end CHARACTERISTIC
/begin CHARACTERISTIC CANFA_ctMsgMonChkST_VHSS_C "F2062: checksum monitoring message ST_VHSS" VALUE 0x201A64 AblGLKWub_M 255 X1_M 0 255 FORMAT "%5.1" /end CHARACTERISTIC
/begin CHARACTERISTIC CANFA_ctMsgMonChkSU_SW_DRDY_C "F2062: checksum monitoring message SU_SW_DRDY" VALUE 0x201A65 AblGLKWub_M 255 X1_M 0 255 FORMAT "%5.1" /end CHARACTERISTIC
/begin CHARACTERISTIC CANFA_ctMsgMonChkTLT_RW_C "F2062: checksum monitoring message TLT_RW" VALUE 0x201A66 AblGLKWub_M 255 X1_M 0 255 FORMAT "%5.1" /end CHARACTERISTIC
/begin CHARACTERISTIC CANFA_ctMsgMonChkTORQ_CRSH_1_C "F2062: checksum monitoring message TORQ_CRSH_1" VALUE 0x201A67 AblGLKWub_M 255 X1_M 0 255 FORMAT "%5.1" /end CHARACTERISTIC
/begin CHARACTERISTIC CANFA_ctMsgMonChkTORQ_PT_HYB_1_C "F2062: checksum monitoring message TORQ_PT_HYB_1" VALUE 0x201A68 AblGLKWub_M 255 X1_M 0 255 FORMAT "%5.1" /end CHARACTERISTIC
/begin CHARACTERISTIC CANFA_ctMsgMonChkVYAW_VEH_C "F2062: checksum monitoring message VYAW_VEH" VALUE 0x201A69 AblGLKWub_M 255 X1_M 0 255 FORMAT "%5.1" /end CHARACTERISTIC
/begin CHARACTERISTIC CANFA_ctMsgMonChkV_VEH_C "F2062: checksum monitoring message V_VEH" VALUE 0x201A6A AblGLKWub_M 255 X1_M 0 255 FORMAT "%5.1" /end CHARACTERISTIC
/begin CHARACTERISTIC CANFA_ctMsgMonChkWMOM_DRV_1_C "F2062: checksum monitoring message WMOM_DRV_1" VALUE 0x201A6B AblGLKWub_M 255 X1_M 0 255 FORMAT "%5.1" /end CHARACTERISTIC
/begin CHARACTERISTIC CANFA_ctMsgMonDlcACLNX_MASSCNTR_C "F2062: DLC monitoring message ACLNX_MASSCNTR" VALUE 0x201A6C AblGLKWub_M 255 X1_M 0 255 FORMAT "%5.1" /end CHARACTERISTIC
/begin CHARACTERISTIC CANFA_ctMsgMonDlcACLNY_MASSCNTR_C "F2062: DLC monitoring message ACLNY_MASSCNTR" VALUE 0x201A6D AblGLKWub_M 255 X1_M 0 255 FORMAT "%5.1" /end CHARACTERISTIC
/begin CHARACTERISTIC CANFA_ctMsgMonDlcANG_ACPD_C "F2062: DLC monitoring message ANG_ACPD" VALUE 0x201A6E AblGLKWub_M 255 X1_M 0 255 FORMAT "%5.1" /end CHARACTERISTIC
/begin CHARACTERISTIC CANFA_ctMsgMonDlcAVL_BRTORQ_SUM_C "F2062: DLC monitoring message AVL_BRTORQ_SUM" VALUE 0x201A6F AblGLKWub_M 255 X1_M 0 255 FORMAT "%5.1" /end CHARACTERISTIC
/begin CHARACTERISTIC CANFA_ctMsgMonDlcAVL_RPM_WHL_UPRT_C "F2062: DLC monitoring message AVL_RPM_WHL_UPRT" VALUE 0x201A70 AblGLKWub_M 255 X1_M 0 255 FORMAT "%5.1" /end CHARACTERISTIC
/begin CHARACTERISTIC CANFA_ctMsgMonDlcA_TEMP_C "F2062: DLC monitoring message A_TEMP" VALUE 0x201A71 AblGLKWub_M 255 X1_M 0 255 FORMAT "%5.1" /end CHARACTERISTIC
/begin CHARACTERISTIC CANFA_ctMsgMonDlcBLINKEN_C "F2062: DLC monitoring message BLINKEN" VALUE 0x201A72 AblGLKWub_M 255 X1_M 0 255 FORMAT "%5.1" /end CHARACTERISTIC
/begin CHARACTERISTIC CANFA_ctMsgMonDlcDIAG_OBD_ENG_C "F2062: DLC monitoring message DIAG_OBD_ENG" VALUE 0x201A73 AblGLKWub_M 255 X1_M 0 255 FORMAT "%5.1" /end CHARACTERISTIC
/begin CHARACTERISTIC CANFA_ctMsgMonDlcDT_PT_1_C "F2062: DLC monitoring message DT_PT_1" VALUE 0x201A74 AblGLKWub_M 255 X1_M 0 255 FORMAT "%5.1" /end CHARACTERISTIC
/begin CHARACTERISTIC CANFA_ctMsgMonDlcFAHRGESTELLNUMMER_C "F2062: DLC monitoring message FAHRGESTELLNUMMER" VALUE 0x201A75 AblGLKWub_M 255 X1_M 0 255 FORMAT "%5.1" /end CHARACTERISTIC
/begin CHARACTERISTIC CANFA_ctMsgMonDlcFLLUPT_GPWSUP_C "F2062: DLC monitoring message FLLUPT_GPWSUP" VALUE 0x201A76 AblGLKWub_M 255 X1_M 0 255 FORMAT "%5.1" /end CHARACTERISTIC
/begin CHARACTERISTIC CANFA_ctMsgMonDlcFZZSTD_C "F2062: DLC monitoring message FZZSTD" VALUE 0x201A77 AblGLKWub_M 255 X1_M 0 255 FORMAT "%5.1" /end CHARACTERISTIC
/begin CHARACTERISTIC CANFA_ctMsgMonDlcKILOMETERSTAND_C "F2062: DLC monitoring message KILOMETERSTAND" VALUE 0x201A78 AblGLKWub_M 255 X1_M 0 255 FORMAT "%5.1" /end CHARACTERISTIC
/begin CHARACTERISTIC CANFA_ctMsgMonDlcKLEMMEN_C "F2062: DLC monitoring message KLEMMEN" VALUE 0x201A79 AblGLKWub_M 255 X1_M 0 255 FORMAT "%5.1" /end CHARACTERISTIC
/begin CHARACTERISTIC CANFA_ctMsgMonDlcMASS_VEH_C "F2062: DLC monitoring message MASS_VEH" VALUE 0x201A7A AblGLKWub_M 255 X1_M 0 255 FORMAT "%5.1" /end CHARACTERISTIC
/begin CHARACTERISTIC CANFA_ctMsgMonDlcNAV_GRAPH_C "F2062: DLC monitoring message NAV_GRAPH" VALUE 0x201A7B AblGLKWub_M 255 X1_M 0 255 FORMAT "%5.1" /end CHARACTERISTIC
/begin CHARACTERISTIC CANFA_ctMsgMonDlcNAV_GRAPH_LNE_C "F2062: DLC monitoring message NAV_GRAPH_LNE" VALUE 0x201A7C AblGLKWub_M 255 X1_M 0 255 FORMAT "%5.1" /end CHARACTERISTIC
/begin CHARACTERISTIC CANFA_ctMsgMonDlcNAV_GRAPH_MAPDATA_C "F2062: DLC monitoring message NAV_GRAPH_MAPDATA" VALUE 0x201A7D AblGLKWub_M 255 X1_M 0 255 FORMAT "%5.1" /end CHARACTERISTIC
/begin CHARACTERISTIC CANFA_ctMsgMonDlcNAV_GRAPH_MATCH_C "F2062: DLC monitoring message NAV_GRAPH_MATCH" VALUE 0x201A7E AblGLKWub_M 255 X1_M 0 255 FORMAT "%5.1" /end CHARACTERISTIC
/begin CHARACTERISTIC CANFA_ctMsgMonDlcNAV_GRAPH_SYNC_C "F2062: DLC monitoring message NAV_GRAPH_SYNC" VALUE 0x201A7F AblGLKWub_M 255 X1_M 0 255 FORMAT "%5.1" /end CHARACTERISTIC
/begin CHARACTERISTIC CANFA_ctMsgMonDlcNAV_GRAPH_V_C "F2062: DLC monitoring message NAV_GRAPH_V" VALUE 0x201A80 AblGLKWub_M 255 X1_M 0 255 FORMAT "%5.1" /end CHARACTERISTIC
/begin CHARACTERISTIC CANFA_ctMsgMonDlcNAV_SYS_INF_C "F2062: DLC monitoring message NAV_SYS_INF" VALUE 0x201A81 AblGLKWub_M 255 X1_M 0 255 FORMAT "%5.1" /end CHARACTERISTIC
/begin CHARACTERISTIC CANFA_ctMsgMonDlcOP_SPD_C "F2062: DLC monitoring message OP_SPD" VALUE 0x201A82 AblGLKWub_M 255 X1_M 0 255 FORMAT "%5.1" /end CHARACTERISTIC
/begin CHARACTERISTIC CANFA_ctMsgMonDlcRELATIVZEIT_C "F2062: DLC monitoring message RELATIVZEIT" VALUE 0x201A83 AblGLKWub_M 255 X1_M 0 255 FORMAT "%5.1" /end CHARACTERISTIC
/begin CHARACTERISTIC CANFA_ctMsgMonDlcRQ_CLT_C "F2062: DLC monitoring message RQ_CLT" VALUE 0x201A84 AblGLKWub_M 255 X1_M 0 255 FORMAT "%5.1" /end CHARACTERISTIC
/begin CHARACTERISTIC CANFA_ctMsgMonDlcSTAT_ANHAENGER_C "F2062: DLC monitoring message STAT_ANHAENGER" VALUE 0x201A85 AblGLKWub_M 255 X1_M 0 255 FORMAT "%5.1" /end CHARACTERISTIC
/begin CHARACTERISTIC CANFA_ctMsgMonDlcSTAT_CT_HABR_C "F2062: DLC monitoring message STAT_CT_HABR" VALUE 0x201A86 AblGLKWub_M 255 X1_M 0 255 FORMAT "%5.1" /end CHARACTERISTIC
/begin CHARACTERISTIC CANFA_ctMsgMonDlcSTAT_DS_VRFD_C "F2062: DLC monitoring message STAT_DS_VRFD" VALUE 0x201A87 AblGLKWub_M 255 X1_M 0 255 FORMAT "%5.1" /end CHARACTERISTIC
/begin CHARACTERISTIC CANFA_ctMsgMonDlcSTAT_ZV_KLAPPEN_C "F2062: DLC monitoring message STAT_ZV_KLAPPEN" VALUE 0x201A88 AblGLKWub_M 255 X1_M 0 255 FORMAT "%5.1" /end CHARACTERISTIC
/begin CHARACTERISTIC CANFA_ctMsgMonDlcSTEA_FTAX_EFFV_C "F2062: DLC monitoring message STEA_FTAX_EFFV" VALUE 0x201A89 AblGLKWub_M 255 X1_M 0 255 FORMAT "%5.1" /end CHARACTERISTIC
/begin CHARACTERISTIC CANFA_ctMsgMonDlcST_BLT_CT_SOCCU_C "F2062: DLC monitoring message ST_BLT_CT_SOCCU" VALUE 0x201A8A AblGLKWub_M 255 X1_M 0 255 FORMAT "%5.1" /end CHARACTERISTIC
/begin CHARACTERISTIC CANFA_ctMsgMonDlcST_DISP_DRDY_C "F2062: DLC monitoring message ST_DISP_DRDY" VALUE 0x201A8B AblGLKWub_M 255 X1_M 0 255 FORMAT "%5.1" /end CHARACTERISTIC
/begin CHARACTERISTIC CANFA_ctMsgMonDlcST_GWS_C "F2062: DLC monitoring message ST_GWS" VALUE 0x201A8C AblGLKWub_M 255 X1_M 0 255 FORMAT "%5.1" /end CHARACTERISTIC
/begin CHARACTERISTIC CANFA_ctMsgMonDlcST_STAB_DSC_C "F2062: DLC monitoring message ST_STAB_DSC" VALUE 0x201A8D AblGLKWub_M 255 X1_M 0 255 FORMAT "%5.1" /end CHARACTERISTIC
/begin CHARACTERISTIC CANFA_ctMsgMonDlcST_STA_PWR_DRV_C "F2062: DLC monitoring message ST_STA_PWR_DRV" VALUE 0x201A8E AblGLKWub_M 255 X1_M 0 255 FORMAT "%5.1" /end CHARACTERISTIC
/begin CHARACTERISTIC CANFA_ctMsgMonDlcST_VEHSS_PBRK_C "F2062: DLC monitoring message ST_VEHSS_PBRK" VALUE 0x201A8F AblGLKWub_M 255 X1_M 0 255 FORMAT "%5.1" /end CHARACTERISTIC
/begin CHARACTERISTIC CANFA_ctMsgMonDlcST_VHSS_C "F2062: DLC monitoring message ST_VHSS" VALUE 0x201A90 AblGLKWub_M 255 X1_M 0 255 FORMAT "%5.1" /end CHARACTERISTIC
/begin CHARACTERISTIC CANFA_ctMsgMonDlcSU_SW_DRDY_C "F2062: DLC monitoring message SU_SW_DRDY" VALUE 0x201A91 AblGLKWub_M 255 X1_M 0 255 FORMAT "%5.1" /end CHARACTERISTIC
/begin CHARACTERISTIC CANFA_ctMsgMonDlcTLT_RW_C "F2062: DLC monitoring message TLT_RW" VALUE 0x201A92 AblGLKWub_M 255 X1_M 0 255 FORMAT "%5.1" /end CHARACTERISTIC
/begin CHARACTERISTIC CANFA_ctMsgMonDlcTOMA_WHL_C "F2062: DLC monitoring message TOMA_WHL" VALUE 0x201A93 AblGLKWub_M 255 X1_M 0 255 FORMAT "%5.1" /end CHARACTERISTIC
/begin CHARACTERISTIC CANFA_ctMsgMonDlcTORQ_CRSH_1_C "F2062: DLC monitoring message TORQ_CRSH_1" VALUE 0x201A94 AblGLKWub_M 255 X1_M 0 255 FORMAT "%5.1" /end CHARACTERISTIC
/begin CHARACTERISTIC CANFA_ctMsgMonDlcTORQ_PT_HYB_1_C "F2062: DLC monitoring message TORQ_PT_HYB_1" VALUE 0x201A95 AblGLKWub_M 255 X1_M 0 255 FORMAT "%5.1" /end CHARACTERISTIC
/begin CHARACTERISTIC CANFA_ctMsgMonDlcVYAW_VEH_C "F2062: DLC monitoring message VYAW_VEH" VALUE 0x201A96 AblGLKWub_M 255 X1_M 0 255 FORMAT "%5.1" /end CHARACTERISTIC
/begin CHARACTERISTIC CANFA_ctMsgMonDlcV_VEH_C "F2062: DLC monitoring message V_VEH" VALUE 0x201A97 AblGLKWub_M 255 X1_M 0 255 FORMAT "%5.1" /end CHARACTERISTIC
/begin CHARACTERISTIC CANFA_ctMsgMonDlcWMOM_DRV_1_C "F2062: DLC monitoring message WMOM_DRV_1" VALUE 0x201A98 AblGLKWub_M 255 X1_M 0 255 FORMAT "%5.1" /end CHARACTERISTIC
/begin CHARACTERISTIC CANFA_swtMsgMonACLNX_MASSCNTR_C "F2062: activation monitoring message ACLNX_MASSCNTR" VALUE 0x201A99 AblGLKWub_M 255 X1_M 0 255 FORMAT "%5.1" /end CHARACTERISTIC
/begin CHARACTERISTIC CANFA_swtMsgMonACLNY_MASSCNTR_C "F2062: activation monitoring message ACLNY_MASSCNTR" VALUE 0x201A9A AblGLKWub_M 255 X1_M 0 255 FORMAT "%5.1" /end CHARACTERISTIC
/begin CHARACTERISTIC CANFA_swtMsgMonANG_ACPD_C "F2062: activation monitoring message ANG_ACPD" VALUE 0x201A9B AblGLKWub_M 255 X1_M 0 255 FORMAT "%5.1" /end CHARACTERISTIC
/begin CHARACTERISTIC CANFA_swtMsgMonAVL_BRTORQ_SUM_C "F2062: activation monitoring message AVL_BRTORQ_SUM" VALUE 0x201A9C AblGLKWub_M 255 X1_M 0 255 FORMAT "%5.1" /end CHARACTERISTIC
/begin CHARACTERISTIC CANFA_swtMsgMonAVL_RPM_WHL_UPRT_C "F2062: activation monitoring message AVL_RPM_WHL_UPRT" VALUE 0x201A9D AblGLKWub_M 255 X1_M 0 255 FORMAT "%5.1" /end CHARACTERISTIC
/begin CHARACTERISTIC CANFA_swtMsgMonA_TEMP_C "F2062: activation monitoring message A_TEMP" VALUE 0x201A9E AblGLKWub_M 255 X1_M 0 255 FORMAT "%5.1" /end CHARACTERISTIC
/begin CHARACTERISTIC CANFA_swtMsgMonBLINKEN_C "F2062: activation monitoring message BLINKEN" VALUE 0x201A9F AblGLKWub_M 255 X1_M 0 255 FORMAT "%5.1" /end CHARACTERISTIC
/begin CHARACTERISTIC CANFA_swtMsgMonDIAG_OBD_ENG_C "F2062: activation monitoring message DIAG_OBD_ENG" VALUE 0x201AA0 AblGLKWub_M 255 X1_M 0 255 FORMAT "%5.1" /end CHARACTERISTIC
/begin CHARACTERISTIC CANFA_swtMsgMonDT_PT_1_C "F2062: activation monitoring message DT_PT_1" VALUE 0x201AA1 AblGLKWub_M 255 X1_M 0 255 FORMAT "%5.1" /end CHARACTERISTIC
/begin CHARACTERISTIC CANFA_swtMsgMonFAHRGESTELLNUMMER_C "F2062: activation monitoring message FAHRGESTELLNUMMER" VALUE 0x201AA2 AblGLKWub_M 255 X1_M 0 255 FORMAT "%5.1" /end CHARACTERISTIC
/begin CHARACTERISTIC CANFA_swtMsgMonFLLUPT_GPWSUP_C "F2062: activation monitoring message FLLUPT_GPWSUP" VALUE 0x201AA3 AblGLKWub_M 255 X1_M 0 255 FORMAT "%5.1" /end CHARACTERISTIC
/begin CHARACTERISTIC CANFA_swtMsgMonFZZSTD_C "F2062: activation monitoring message FZZSTD" VALUE 0x201AA4 AblGLKWub_M 255 X1_M 0 255 FORMAT "%5.1" /end CHARACTERISTIC
/begin CHARACTERISTIC CANFA_swtMsgMonKILOMETERSTAND_C "F2062: activation monitoring message KILOMETERSTAND" VALUE 0x201AA5 AblGLKWub_M 255 X1_M 0 255 FORMAT "%5.1" /end CHARACTERISTIC
/begin CHARACTERISTIC CANFA_swtMsgMonKLEMMEN_C "F2062: activation monitoring message KLEMMEN" VALUE 0x201AA6 AblGLKWub_M 255 X1_M 0 255 FORMAT "%5.1" /end CHARACTERISTIC
/begin CHARACTERISTIC CANFA_swtMsgMonMASS_VEH_C "F2062: activation monitoring message MASS_VEH" VALUE 0x201AA7 AblGLKWub_M 255 X1_M 0 255 FORMAT "%5.1" /end CHARACTERISTIC
/begin CHARACTERISTIC CANFA_swtMsgMonNAV_GRAPH_C "F2062: activation monitoring message NAV_GRAPH" VALUE 0x201AA8 AblGLKWub_M 255 X1_M 0 255 FORMAT "%5.1" /end CHARACTERISTIC
/begin CHARACTERISTIC CANFA_swtMsgMonNAV_GRAPH_LNE_C "F2062: activation monitoring message NAV_GRAPH_LNE" VALUE 0x201AA9 AblGLKWub_M 255 X1_M 0 255 FORMAT "%5.1" /end CHARACTERISTIC
/begin CHARACTERISTIC CANFA_swtMsgMonNAV_GRAPH_MAPDATA_C "F2062: activation monitoring message NAV_GRAPH_MAPDATA" VALUE 0x201AAA AblGLKWub_M 255 X1_M 0 255 FORMAT "%5.1" /end CHARACTERISTIC
/begin CHARACTERISTIC CANFA_swtMsgMonNAV_GRAPH_MATCH_C "F2062: activation monitoring message NAV_GRAPH_MATCH" VALUE 0x201AAB AblGLKWub_M 255 X1_M 0 255 FORMAT "%5.1" /end CHARACTERISTIC
/begin CHARACTERISTIC CANFA_swtMsgMonNAV_GRAPH_SYNC_C "F2062: activation monitoring message NAV_GRAPH_SYNC" VALUE 0x201AAC AblGLKWub_M 255 X1_M 0 255 FORMAT "%5.1" /end CHARACTERISTIC
/begin CHARACTERISTIC CANFA_swtMsgMonNAV_GRAPH_V_C "F2062: activation monitoring message NAV_GRAPH_V" VALUE 0x201AAD AblGLKWub_M 255 X1_M 0 255 FORMAT "%5.1" /end CHARACTERISTIC
/begin CHARACTERISTIC CANFA_swtMsgMonNAV_SYS_INF_C "F2062: activation monitoring message NAV_SYS_INF" VALUE 0x201AAE AblGLKWub_M 255 X1_M 0 255 FORMAT "%5.1" /end CHARACTERISTIC
/begin CHARACTERISTIC CANFA_swtMsgMonOP_SPD_C "F2062: activation monitoring message OP_SPD" VALUE 0x201AAF AblGLKWub_M 255 X1_M 0 255 FORMAT "%5.1" /end CHARACTERISTIC
/begin CHARACTERISTIC CANFA_swtMsgMonRELATIVZEIT_C "F2062: activation monitoring message RELATIVZEIT" VALUE 0x201AB0 AblGLKWub_M 255 X1_M 0 255 FORMAT "%5.1" /end CHARACTERISTIC
/begin CHARACTERISTIC CANFA_swtMsgMonRQ_CLT_C "F2062: activation monitoring message RQ_CLT" VALUE 0x201AB1 AblGLKWub_M 255 X1_M 0 255 FORMAT "%5.1" /end CHARACTERISTIC
/begin CHARACTERISTIC CANFA_swtMsgMonSTAT_ANHAENGER_C "F2062: activation monitoring message STAT_ANHAENGER" VALUE 0x201AB2 AblGLKWub_M 255 X1_M 0 255 FORMAT "%5.1" /end CHARACTERISTIC
/begin CHARACTERISTIC CANFA_swtMsgMonSTAT_CT_HABR_C "F2062: activation monitoring message STAT_CT_HABR" VALUE 0x201AB3 AblGLKWub_M 255 X1_M 0 255 FORMAT "%5.1" /end CHARACTERISTIC
/begin CHARACTERISTIC CANFA_swtMsgMonSTAT_DS_VRFD_C "F2062: activation monitoring message STAT_DS_VRFD" VALUE 0x201AB4 AblGLKWub_M 255 X1_M 0 255 FORMAT "%5.1" /end CHARACTERISTIC
/begin CHARACTERISTIC CANFA_swtMsgMonSTAT_ZV_KLAPPEN_C "F2062: activation monitoring message STAT_ZV_KLAPPEN" VALUE 0x201AB5 AblGLKWub_M 255 X1_M 0 255 FORMAT "%5.1" /end CHARACTERISTIC
/begin CHARACTERISTIC CANFA_swtMsgMonSTEA_FTAX_EFFV_C "F2062: activation monitoring message STEA_FTAX_EFFV" VALUE 0x201AB6 AblGLKWub_M 255 X1_M 0 255 FORMAT "%5.1" /end CHARACTERISTIC
/begin CHARACTERISTIC CANFA_swtMsgMonST_BLT_CT_SOCCU_C "F2062: activation monitoring message ST_BLT_CT_SOCCU" VALUE 0x201AB7 AblGLKWub_M 255 X1_M 0 255 FORMAT "%5.1" /end CHARACTERISTIC
/begin CHARACTERISTIC CANFA_swtMsgMonST_DISP_DRDY_C "F2062: activation monitoring message ST_DISP_DRDY" VALUE 0x201AB8 AblGLKWub_M 255 X1_M 0 255 FORMAT "%5.1" /end CHARACTERISTIC
/begin CHARACTERISTIC CANFA_swtMsgMonST_GWS_C "F2062: activation monitoring message ST_GWS" VALUE 0x201AB9 AblGLKWub_M 255 X1_M 0 255 FORMAT "%5.1" /end CHARACTERISTIC
/begin CHARACTERISTIC CANFA_swtMsgMonST_STAB_DSC_C "F2062: activation monitoring message ST_STAB_DSC" VALUE 0x201ABA AblGLKWub_M 255 X1_M 0 255 FORMAT "%5.1" /end CHARACTERISTIC
/begin CHARACTERISTIC CANFA_swtMsgMonST_STA_PWR_DRV_C "F2062: activation monitoring message ST_STA_PWR_DRV" VALUE 0x201ABB AblGLKWub_M 255 X1_M 0 255 FORMAT "%5.1" /end CHARACTERISTIC
/begin CHARACTERISTIC CANFA_swtMsgMonST_VEHSS_PBRK_C "F2062: activation monitoring message ST_VEHSS_PBRK" VALUE 0x201ABC AblGLKWub_M 255 X1_M 0 255 FORMAT "%5.1" /end CHARACTERISTIC
/begin CHARACTERISTIC CANFA_swtMsgMonST_VHSS_C "F2062: activation monitoring message ST_VHSS" VALUE 0x201ABD AblGLKWub_M 255 X1_M 0 255 FORMAT "%5.1" /end CHARACTERISTIC
/begin CHARACTERISTIC CANFA_swtMsgMonSU_SW_DRDY_C "F2062: activation monitoring message SU_SW_DRDY" VALUE 0x201ABE AblGLKWub_M 255 X1_M 0 255 FORMAT "%5.1" /end CHARACTERISTIC
/begin CHARACTERISTIC CANFA_swtMsgMonTLT_RW_C "F2062: activation monitoring message TLT_RW" VALUE 0x201ABF AblGLKWub_M 255 X1_M 0 255 FORMAT "%5.1" /end CHARACTERISTIC
/begin CHARACTERISTIC CANFA_swtMsgMonTOMA_WHL_C "F2062: activation monitoring message TOMA_WHL" VALUE 0x201AC0 AblGLKWub_M 255 X1_M 0 255 FORMAT "%5.1" /end CHARACTERISTIC
/begin CHARACTERISTIC CANFA_swtMsgMonTORQ_CRSH_1_C "F2062: activation monitoring message TORQ_CRSH_1" VALUE 0x201AC1 AblGLKWub_M 255 X1_M 0 255 FORMAT "%5.1" /end CHARACTERISTIC
/begin CHARACTERISTIC CANFA_swtMsgMonTORQ_PT_HYB_1_C "F2062: activation monitoring message TORQ_PT_HYB_1" VALUE 0x201AC2 AblGLKWub_M 255 X1_M 0 255 FORMAT "%5.1" /end CHARACTERISTIC
/begin CHARACTERISTIC CANFA_swtMsgMonVYAW_VEH_C "F2062: activation monitoring message VYAW_VEH" VALUE 0x201AC3 AblGLKWub_M 255 X1_M 0 255 FORMAT "%5.1" /end CHARACTERISTIC
/begin CHARACTERISTIC CANFA_swtMsgMonV_VEH_C "F2062: activation monitoring message V_VEH" VALUE 0x201AC4 AblGLKWub_M 255 X1_M 0 255 FORMAT "%5.1" /end CHARACTERISTIC
/begin CHARACTERISTIC CANFA_swtMsgMonWMOM_DRV_1_C "F2062: activation monitoring message WMOM_DRV_1" VALUE 0x201AC5 AblGLKWub_M 255 X1_M 0 255 FORMAT "%5.1" /end CHARACTERISTIC
/begin CHARACTERISTIC CANFA_swtMsgSlw_ST_BLT_CT_SOCCU_C "F2070: Raster selection for message ST_BLT_CT_SOCCU. 0: 200ms, 1: 1000ms." VALUE 0x2019D3 AblGLKWub_M 255 X1_M 0 255 FORMAT "%5.1" /end CHARACTERISTIC
/begin CHARACTERISTIC CAN_ctMsgMonAlvAVL_DT_MOT_1_C "F2062: alive counter monitoring message AVL_DT_MOT_1" VALUE 0x201AC6 AblGLKWub_M 255 X1_M 0 255 FORMAT "%5.1" /end CHARACTERISTIC
/begin CHARACTERISTIC CAN_ctMsgMonAlvDT_PT_2_C "F2062: alive counter monitoring message DT_PT_2" VALUE 0x201AC7 AblGLKWub_M 255 X1_M 0 255 FORMAT "%5.1" /end CHARACTERISTIC
/begin CHARACTERISTIC CAN_ctMsgMonAlvHYB_SPEC_C "F2062: alive counter monitoring message HYB_SPEC" VALUE 0x201AC8 AblGLKWub_M 255 X1_M 0 255 FORMAT "%5.1" /end CHARACTERISTIC
/begin CHARACTERISTIC CAN_ctMsgMonAlvSTAT_ENG_STA_AUTO_C "F2062: alive counter monitoring message STAT_ENG_STA_AUTO" VALUE 0x201AC9 AblGLKWub_M 255 X1_M 0 255 FORMAT "%5.1" /end CHARACTERISTIC
/begin CHARACTERISTIC CAN_ctMsgMonAlvST_GWS_C "F2062: alive counter monitoring message ST_GWS" VALUE 0x201ACA AblGLKWub_M 255 X1_M 0 255 FORMAT "%5.1" /end CHARACTERISTIC
/begin CHARACTERISTIC CAN_ctMsgMonAlvTORQ_CRSH_2_C "F2062: alive counter monitoring message TORQ_CRSH_2" VALUE 0x201ACB AblGLKWub_M 255 X1_M 0 255 FORMAT "%5.1" /end CHARACTERISTIC
/begin CHARACTERISTIC CAN_ctMsgMonAlvTORQ_CRSH_3_C "F2062: alive counter monitoring message TORQ_CRSH_3" VALUE 0x201ACC AblGLKWub_M 255 X1_M 0 255 FORMAT "%5.1" /end CHARACTERISTIC
/begin CHARACTERISTIC CAN_ctMsgMonAlvWMOM_DRV_3_C "F2062: alive counter monitoring message WMOM_DRV_3" VALUE 0x201ACD AblGLKWub_M 255 X1_M 0 255 FORMAT "%5.1" /end CHARACTERISTIC
/begin CHARACTERISTIC CAN_ctMsgMonAlvWMOM_DRV_7_C "F2062: alive counter monitoring message WMOM_DRV_7" VALUE 0x201ACE AblGLKWub_M 255 X1_M 0 255 FORMAT "%5.1" /end CHARACTERISTIC
/begin CHARACTERISTIC CAN_ctMsgMonChkAVL_DT_MOT_1_C "F2062: checksum monitoring message AVL_DT_MOT_1" VALUE 0x201ACF AblGLKWub_M 255 X1_M 0 255 FORMAT "%5.1" /end CHARACTERISTIC
/begin CHARACTERISTIC CAN_ctMsgMonChkDT_PT_2_C "F2062: checksum monitoring message DT_PT_2" VALUE 0x201AD0 AblGLKWub_M 255 X1_M 0 255 FORMAT "%5.1" /end CHARACTERISTIC
/begin CHARACTERISTIC CAN_ctMsgMonChkHYB_SPEC_C "F2062: checksum monitoring message HYB_SPEC" VALUE 0x201AD1 AblGLKWub_M 255 X1_M 0 255 FORMAT "%5.1" /end CHARACTERISTIC
/begin CHARACTERISTIC CAN_ctMsgMonChkSTAT_ENG_STA_AUTO_C "F2062: checksum monitoring message STAT_ENG_STA_AUTO" VALUE 0x201AD2 AblGLKWub_M 255 X1_M 0 255 FORMAT "%5.1" /end CHARACTERISTIC
/begin CHARACTERISTIC CAN_ctMsgMonChkST_GWS_C "F2062: checksum monitoring message ST_GWS" VALUE 0x201AD3 AblGLKWub_M 255 X1_M 0 255 FORMAT "%5.1" /end CHARACTERISTIC
/begin CHARACTERISTIC CAN_ctMsgMonChkTORQ_CRSH_2_C "F2062: checksum monitoring message TORQ_CRSH_2" VALUE 0x201AD4 AblGLKWub_M 255 X1_M 0 255 FORMAT "%5.1" /end CHARACTERISTIC
/begin CHARACTERISTIC CAN_ctMsgMonChkTORQ_CRSH_3_C "F2062: checksum monitoring message TORQ_CRSH_3" VALUE 0x201AD5 AblGLKWub_M 255 X1_M 0 255 FORMAT "%5.1" /end CHARACTERISTIC
/begin CHARACTERISTIC CAN_ctMsgMonChkWMOM_DRV_3_C "F2062: checksum monitoring message WMOM_DRV_3" VALUE 0x201AD6 AblGLKWub_M 255 X1_M 0 255 FORMAT "%5.1" /end CHARACTERISTIC
/begin CHARACTERISTIC CAN_ctMsgMonChkWMOM_DRV_7_C "F2062: checksum monitoring message WMOM_DRV_7" VALUE 0x201AD7 AblGLKWub_M 255 X1_M 0 255 FORMAT "%5.1" /end CHARACTERISTIC
/begin CHARACTERISTIC CAN_ctMsgMonDlcAVL_DT_MOT_1_C "F2062: DLC monitoring message AVL_DT_MOT_1" VALUE 0x201AD8 AblGLKWub_M 255 X1_M 0 255 FORMAT "%5.1" /end CHARACTERISTIC
/begin CHARACTERISTIC CAN_ctMsgMonDlcDIAG_OBD_ENG_C "F2062: DLC monitoring message DIAG_OBD_ENG" VALUE 0x201AD9 AblGLKWub_M 255 X1_M 0 255 FORMAT "%5.1" /end CHARACTERISTIC
/begin CHARACTERISTIC CAN_ctMsgMonDlcDT_DRV_EL_C "F2062: DLC monitoring message DT_DRV_EL" VALUE 0x201ADA AblGLKWub_M 255 X1_M 0 255 FORMAT "%5.1" /end CHARACTERISTIC
/begin CHARACTERISTIC CAN_ctMsgMonDlcDT_PT_2_C "F2062: DLC monitoring message DT_PT_2" VALUE 0x201ADB AblGLKWub_M 255 X1_M 0 255 FORMAT "%5.1" /end CHARACTERISTIC
/begin CHARACTERISTIC CAN_ctMsgMonDlcFLLUPT_GPWSUP_C "F2062: DLC monitoring message FLLUPT_GPWSUP" VALUE 0x201ADC AblGLKWub_M 255 X1_M 0 255 FORMAT "%5.1" /end CHARACTERISTIC
/begin CHARACTERISTIC CAN_ctMsgMonDlcHYB_SPEC_C "F2062: DLC monitoring message HYB_SPEC" VALUE 0x201ADD AblGLKWub_M 255 X1_M 0 255 FORMAT "%5.1" /end CHARACTERISTIC
/begin CHARACTERISTIC CAN_ctMsgMonDlcPSBTY_ENGSTA_ENSTP_C "F2062: DLC monitoring message PSBTY_ENGSTA_ENSTP" VALUE 0x201ADE AblGLKWub_M 255 X1_M 0 255 FORMAT "%5.1" /end CHARACTERISTIC
/begin CHARACTERISTIC CAN_ctMsgMonDlcSPEC_HVSTO_C "F2062: DLC monitoring message SPEC_HVSTO" VALUE 0x201ADF AblGLKWub_M 255 X1_M 0 255 FORMAT "%5.1" /end CHARACTERISTIC
/begin CHARACTERISTIC CAN_ctMsgMonDlcSPEC_TORQ_TRCT_LT_C "F2062: DLC monitoring message SPEC_TORQ_TRCT_LT" VALUE 0x201AE0 AblGLKWub_M 255 X1_M 0 255 FORMAT "%5.1" /end CHARACTERISTIC
/begin CHARACTERISTIC CAN_ctMsgMonDlcSTAT_ENG_STA_AUTO_C "F2062: DLC monitoring message STAT_ENG_STA_AUTO" VALUE 0x201AE1 AblGLKWub_M 255 X1_M 0 255 FORMAT "%5.1" /end CHARACTERISTIC
/begin CHARACTERISTIC CAN_ctMsgMonDlcSTAT_HVSTO_2_C "F2062: DLC monitoring message STAT_HVSTO_2" VALUE 0x201AE2 AblGLKWub_M 255 X1_M 0 255 FORMAT "%5.1" /end CHARACTERISTIC
/begin CHARACTERISTIC CAN_ctMsgMonDlcST_GWS_C "F2062: DLC monitoring message ST_GWS" VALUE 0x201AE3 AblGLKWub_M 255 X1_M 0 255 FORMAT "%5.1" /end CHARACTERISTIC
/begin CHARACTERISTIC CAN_ctMsgMonDlcST_HYB_2_C "F2062: DLC monitoring message ST_HYB_2" VALUE 0x201AE4 AblGLKWub_M 255 X1_M 0 255 FORMAT "%5.1" /end CHARACTERISTIC
/begin CHARACTERISTIC CAN_ctMsgMonDlcTORQ_CRSH_2_C "F2062: DLC monitoring message TORQ_CRSH_2" VALUE 0x201AE5 AblGLKWub_M 255 X1_M 0 255 FORMAT "%5.1" /end CHARACTERISTIC
/begin CHARACTERISTIC CAN_ctMsgMonDlcTORQ_CRSH_3_C "F2062: DLC monitoring message TORQ_CRSH_3" VALUE 0x201AE6 AblGLKWub_M 255 X1_M 0 255 FORMAT "%5.1" /end CHARACTERISTIC
/begin CHARACTERISTIC CAN_ctMsgMonDlcWMOM_DRV_3_C "F2062: DLC monitoring message WMOM_DRV_3" VALUE 0x201AE7 AblGLKWub_M 255 X1_M 0 255 FORMAT "%5.1" /end CHARACTERISTIC
/begin CHARACTERISTIC CAN_ctMsgMonDlcWMOM_DRV_7_C "F2062: DLC monitoring message WMOM_DRV_7" VALUE 0x201AE8 AblGLKWub_M 255 X1_M 0 255 FORMAT "%5.1" /end CHARACTERISTIC
/begin CHARACTERISTIC CAN_stNodePerLine_C "F2063: Bit coded information which CAN node is assigned to which line (B0=CAN_A,B1=CAN_B etc.) (no SERAP)" VAL_BLK 0x20058C AblGLKWBuw_M 65535 X1_M 0 65535 NUMBER 2 FORMAT "%8.2" /end CHARACTERISTIC
/begin CHARACTERISTIC CAN_swtErrPasDet_C "F2063: switch for error passive detection" VALUE 0x2019D9 AblGLKWub_M 255 X1_M 0 255 FORMAT "%5.1" /end CHARACTERISTIC
/begin CHARACTERISTIC CAN_swtMsgMonAVL_DT_MOT_1_C "F2062: activation monitoring message AVL_DT_MOT_1" VALUE 0x201AE9 AblGLKWub_M 255 X1_M 0 255 FORMAT "%5.1" /end CHARACTERISTIC
/begin CHARACTERISTIC CAN_swtMsgMonDIAG_OBD_ENG_C "F2062: activation monitoring message DIAG_OBD_ENG" VALUE 0x201AEA AblGLKWub_M 255 X1_M 0 255 FORMAT "%5.1" /end CHARACTERISTIC
/begin CHARACTERISTIC CAN_swtMsgMonDT_DRV_EL_C "F2062: activation monitoring message DT_DRV_EL" VALUE 0x201AEB AblGLKWub_M 255 X1_M 0 255 FORMAT "%5.1" /end CHARACTERISTIC
/begin CHARACTERISTIC CAN_swtMsgMonDT_PT_2_C "F2062: activation monitoring message DT_PT_2" VALUE 0x201AEC AblGLKWub_M 255 X1_M 0 255 FORMAT "%5.1" /end CHARACTERISTIC
/begin CHARACTERISTIC CAN_swtMsgMonFLLUPT_GPWSUP_C "F2062: activation monitoring message FLLUPT_GPWSUP" VALUE 0x201AED AblGLKWub_M 255 X1_M 0 255 FORMAT "%5.1" /end CHARACTERISTIC
/begin CHARACTERISTIC CAN_swtMsgMonHYB_SPEC_C "F2062: activation monitoring message HYB_SPEC" VALUE 0x201AEE AblGLKWub_M 255 X1_M 0 255 FORMAT "%5.1" /end CHARACTERISTIC
/begin CHARACTERISTIC CAN_swtMsgMonPSBTY_ENGSTA_ENSTP_C "F2062: activation monitoring message PSBTY_ENGSTA_ENSTP" VALUE 0x201AEF AblGLKWub_M 255 X1_M 0 255 FORMAT "%5.1" /end CHARACTERISTIC
/begin CHARACTERISTIC CAN_swtMsgMonSPEC_HVSTO_C "F2062: activation monitoring message SPEC_HVSTO" VALUE 0x201AF0 AblGLKWub_M 255 X1_M 0 255 FORMAT "%5.1" /end CHARACTERISTIC
/begin CHARACTERISTIC CAN_swtMsgMonSPEC_TORQ_TRCT_LT_C "F2062: activation monitoring message SPEC_TORQ_TRCT_LT" VALUE 0x201AF1 AblGLKWub_M 255 X1_M 0 255 FORMAT "%5.1" /end CHARACTERISTIC
/begin CHARACTERISTIC CAN_swtMsgMonSTAT_ENG_STA_AUTO_C "F2062: activation monitoring message STAT_ENG_STA_AUTO" VALUE 0x201AF2 AblGLKWub_M 255 X1_M 0 255 FORMAT "%5.1" /end CHARACTERISTIC
/begin CHARACTERISTIC CAN_swtMsgMonSTAT_HVSTO_2_C "F2062: activation monitoring message STAT_HVSTO_2" VALUE 0x201AF3 AblGLKWub_M 255 X1_M 0 255 FORMAT "%5.1" /end CHARACTERISTIC
/begin CHARACTERISTIC CAN_swtMsgMonST_GWS_C "F2062: activation monitoring message ST_GWS" VALUE 0x201AF4 AblGLKWub_M 255 X1_M 0 255 FORMAT "%5.1" /end CHARACTERISTIC
/begin CHARACTERISTIC CAN_swtMsgMonST_HYB_2_C "F2062: activation monitoring message ST_HYB_2" VALUE 0x201AF5 AblGLKWub_M 255 X1_M 0 255 FORMAT "%5.1" /end CHARACTERISTIC
/begin CHARACTERISTIC CAN_swtMsgMonTORQ_CRSH_2_C "F2062: activation monitoring message TORQ_CRSH_2" VALUE 0x201AF6 AblGLKWub_M 255 X1_M 0 255 FORMAT "%5.1" /end CHARACTERISTIC
/begin CHARACTERISTIC CAN_swtMsgMonTORQ_CRSH_3_C "F2062: activation monitoring message TORQ_CRSH_3" VALUE 0x201AF7 AblGLKWub_M 255 X1_M 0 255 FORMAT "%5.1" /end CHARACTERISTIC
/begin CHARACTERISTIC CAN_swtMsgMonWMOM_DRV_3_C "F2062: activation monitoring message WMOM_DRV_3" VALUE 0x201AF8 AblGLKWub_M 255 X1_M 0 255 FORMAT "%5.1" /end CHARACTERISTIC
/begin CHARACTERISTIC CAN_swtMsgMonWMOM_DRV_7_C "F2062: activation monitoring message WMOM_DRV_7" VALUE 0x201AF9 AblGLKWub_M 255 X1_M 0 255 FORMAT "%5.1" /end CHARACTERISTIC
/begin CHARACTERISTIC CAN_tiBusOffChk_C "F2063: Duration of check when trying to recover from bus off." VAL_BLK 0x200590 AblGLKWBuw_M 327675 TI1_M_CYCLE_M 0 327675 NUMBER 2 FORMAT "%8.1" /end CHARACTERISTIC
/begin CHARACTERISTIC CAN_tiBusOffDly1_C "F2063: Delay time after busoff detection and start of recovery (first time)" VAL_BLK 0x200594 AblGLKWBuw_M 327675 TI1_M_CYCLE_M 0 327675 NUMBER 2 FORMAT "%8.1" /end CHARACTERISTIC
/begin CHARACTERISTIC CAN_tiBusOffDly2_C "F2063: Delay time after busoff detection and start of recovery (second time)" VAL_BLK 0x200598 AblGLKWBuw_M 327675 TI1_M_CYCLE_M 0 327675 NUMBER 2 FORMAT "%8.1" /end CHARACTERISTIC
/begin CHARACTERISTIC CAN_TIDEB_DIAG_OBD_GRB_C "F2055: Debounce time for message DIAG_OBD_GRB" VALUE 0x2019D4 AblGLKWub_M 1275 TI1_M_CYCLE_M 0 1275 FORMAT "%5.0" /end CHARACTERISTIC
/begin CHARACTERISTIC CAN_TIDEB_DT_DISP_GRDT_C "F2055: Debounce time for message DT_DISP_GRDT" VALUE 0x2019D5 AblGLKWub_M 1275 TI1_M_CYCLE_M 0 1275 FORMAT "%5.0" /end CHARACTERISTIC
/begin CHARACTERISTIC CAN_TIDEB_ST_GRB_ECU_C "F2055: Debounce time for message ST_GRB_ECU" VALUE 0x2019D6 AblGLKWub_M 1275 TI1_M_CYCLE_M 0 1275 FORMAT "%5.0" /end CHARACTERISTIC
/begin CHARACTERISTIC CAN_TIDEB_ST_GRB_HYB_C "F2055: Debounce time for message ST_GRB_HYB" VALUE 0x2019D7 AblGLKWub_M 1275 TI1_M_CYCLE_M 0 1275 FORMAT "%5.0" /end CHARACTERISTIC
/begin CHARACTERISTIC CAN_tiErrPasDly_C "F2063: Delay time after error passive detection to restart" VAL_BLK 0x20059C AblGLKWBuw_M 327675 TI1_M_CYCLE_M 0 327675 NUMBER 2 FORMAT "%8.1" /end CHARACTERISTIC
/begin CHARACTERISTIC CNE_numAlvTol_C "F2050: application value for ALV tolerance" VALUE 0x2019D8 AblGLKWub_M 14 X1_M 1 15 FORMAT "%5.2" /end CHARACTERISTIC
/begin CHARACTERISTIC ComCtl_swtLoLimUsd_C "F4480: Switch for activation of battery voltage threshold" VALUE 0x2019B7 AblGLKWub_M 255 X1_M 0 255 FORMAT "%5.1" /end CHARACTERISTIC
/begin CHARACTERISTIC ComCtl_uLoLim_C "F4480: lower limit of battery voltage for communication" VALUE 0x201590 AblGLKWuw_M 65.535 U0_001_M 0 65.535 FORMAT "%8.5" /end CHARACTERISTIC
/begin CHARACTERISTIC COM_swtICFshPrg_C "F4100: calibration switch to enable the InCircuit flash programming in MP devices" VALUE 0x2019A0 AblGLKWub_M 255 X1_M 0 255 FORMAT "%5.1" /end CHARACTERISTIC
/begin CHARACTERISTIC I15031APPL_TimeoutLimit "F4205: Time for OBD communication timeout" VALUE 0x201A43 AblGLKWub_M 119 TI1_M 1 120 FORMAT "%5.1" /end CHARACTERISTIC
/begin CHARACTERISTIC LinAppl_Exp_RlvntBus_C "F4611: Bitmask in order to select bus relevant faults according to application layer fault types. " VALUE 0x2019CE AblGLKWub_M 255 X1_M 0 255 FORMAT "%5.1" /end CHARACTERISTIC
/begin CHARACTERISTIC LinAppl_Ifc_Frm_ComDir_C "F4612: Bitmask, If the bit is set to 1 the equivalent frame is used as a Tx frame, else as Rx" VALUE 0x2019A1 AblGLKWub_M 255 X1_M 0 255 FORMAT "%5.1" /end CHARACTERISTIC
/begin CHARACTERISTIC LinAppl_Ifc_Frm_ID_C "F4612: Calibratable IDs for frame the frames. 1st element for the 1st frame, 2nd for the 2nd fram and so on. " VAL_BLK 0x200460 AblGLKWBub_M 63 X1_M 0 63 NUMBER 8 FORMAT "%5.2" /end CHARACTERISTIC
/begin CHARACTERISTIC LinAppl_Ifc_SchedTabCfg_C "F4612: 0: Use schedule table with 6 Frames, 1: Use schedule table with 8 Frames " VALUE 0x2019A2 AblGLKWub_M 1 X1_M 0 1 FORMAT "%5.3" /end CHARACTERISTIC
/begin CHARACTERISTIC LinAppl_Ifc_swtMsgMonFRAME_C "F4612: activation monitoring of LIN message of the X-th FRAME " VAL_BLK 0x2019A3 AblGLKWBub_M 255 X1_M 0 255 NUMBER 11 FORMAT "%5.1" /end CHARACTERISTIC
/begin CHARACTERISTIC LinAppl_MlxsHndlr_adSerNum_C "F4615: EEPROM address in the melexis controller where the IEP serial number is stored" VALUE 0x20158A AblGLKWuw_M 65535 X1_M 0 65535 FORMAT "%8.2" /end CHARACTERISTIC
/begin CHARACTERISTIC LinAppl_MlxsHndlr_adWrEep_C "F4615: EEPROM address at which a write request starts writing" VALUE 0x20158C AblGLKWuw_M 65535 X1_M 0 65535 FORMAT "%8.2" /end CHARACTERISTIC
/begin CHARACTERISTIC LinAppl_MlxsHndlr_Cmd_Mst_NAD_C "F4615: The node address  send out by the master for melexis requests." VALUE 0x2019CF AblGLKWub_M 255 X1_M 0 255 FORMAT "%5.1" /end CHARACTERISTIC
/begin CHARACTERISTIC LinAppl_MlxsHndlr_Cmd_RstrtWaitCntr_C "F4615: Number of tasks to wait for a responsive melexis lin slave after a restart command." VALUE 0x2019D0 AblGLKWub_M 255 X1_M 0 255 FORMAT "%5.1" /end CHARACTERISTIC
/begin CHARACTERISTIC LinAppl_MlxsHndlr_EepUpd_numUpdTryMax_C "F4615: Maximum number of attempts for updating the EEPROM" VALUE 0x2019D1 AblGLKWub_M 254 X1_M 1 255 FORMAT "%5.1" /end CHARACTERISTIC
/begin CHARACTERISTIC LinAppl_MlxsHndlr_EntrPrgModCntrMax_C "F4615: Maximum number of reinitialization allowed for flash routine during enter programming mode command" VALUE 0x2019AE AblGLKWub_M 255 X1_M 0 255 FORMAT "%5.1" /end CHARACTERISTIC
/begin CHARACTERISTIC LinAppl_Mlxshndlr_Exp_FlshAddrRngLd1_C "F4615: Provides range information to be flashed in loader state 1. A 0xFFFF - 0xFFFF entry indicates that no more ranges have to be flashed" MAP 0x200470 AblGLFKFuw_M 65535 X1_M 0 65535 FORMAT "%8.2"
 /begin AXIS_DESCR FIX_AXIS LinAppl_MlxsHndlr_Exp_DmyIdx X1_M 2 0 1 FIX_AXIS_PAR 0 0 2 FORMAT "%5.3" /end AXIS_DESCR
 /begin AXIS_DESCR FIX_AXIS LinAppl_MlxsHndlr_Exp_DmyIdx X1_M 6 0 5 FIX_AXIS_PAR 0 0 6 FORMAT "%5.3" /end AXIS_DESCR
/end CHARACTERISTIC
/begin CHARACTERISTIC LinAppl_Mlxshndlr_Exp_FlshAddrRngLd2_C "F4615: Provides range information to be flashed in loader state 2. A 0xFFFF - 0xFFFF entry indicates that no more ranges have to be flashed" MAP 0x200488 AblGLFKFuw_M 65535 X1_M 0 65535 FORMAT "%8.2"
 /begin AXIS_DESCR FIX_AXIS LinAppl_MlxsHndlr_Exp_DmyIdx X1_M 2 0 1 FIX_AXIS_PAR 0 0 2 FORMAT "%5.3" /end AXIS_DESCR
 /begin AXIS_DESCR FIX_AXIS LinAppl_MlxsHndlr_Exp_DmyIdx X1_M 6 0 5 FIX_AXIS_PAR 0 0 6 FORMAT "%5.3" /end AXIS_DESCR
/end CHARACTERISTIC
/begin CHARACTERISTIC LinAppl_Mlxshndlr_Exp_FlshAddrRngLd3_C "F4615: Provides range information to be flashed in loader state 3.  A 0xFFFF - 0xFFFF entry indicates that no more ranges have to be flashed" MAP 0x2004A0 AblGLFKFuw_M 65535 X1_M 0 65535 FORMAT "%8.2"
 /begin AXIS_DESCR FIX_AXIS LinAppl_MlxsHndlr_Exp_DmyIdx X1_M 2 0 1 FIX_AXIS_PAR 0 0 2 FORMAT "%5.3" /end AXIS_DESCR
 /begin AXIS_DESCR FIX_AXIS LinAppl_MlxsHndlr_Exp_DmyIdx X1_M 6 0 5 FIX_AXIS_PAR 0 0 6 FORMAT "%5.3" /end AXIS_DESCR
/end CHARACTERISTIC
/begin CHARACTERISTIC LinAppl_MlxsHndlr_Exp_swtAllwRstrt_C "F4615: Allow restart of flash programming after programming has been completed" VALUE 0x2019B3 AblGLKWub_M 1 B_TRUE_M 0 1 FORMAT "%13.11" /end CHARACTERISTIC
/begin CHARACTERISTIC LinAppl_MlxsHndlr_numPgPrgTryMax_C "F4615: Maximum number of attempts for programming a page" VALUE 0x2019AF AblGLKWub_M 254 X1_M 1 255 FORMAT "%5.1" /end CHARACTERISTIC
/begin CHARACTERISTIC LinAppl_MlxsHndlr_numSerNum_C "F4615: Size of the IEP serial number stored in the EEPROM of the melexis controller" VALUE 0x2019B0 AblGLKWub_M 8 X1_M 0 8 FORMAT "%5.3" /end CHARACTERISTIC
/begin CHARACTERISTIC LinAppl_MlxsHndlr_Read_MaxTrCntr_C "F4615: Maximum number of allowed trials in order to obtain a response from the slave during read request." VALUE 0x2019B4 AblGLKWub_M 255 X1_M 0 255 FORMAT "%5.1" /end CHARACTERISTIC
/begin CHARACTERISTIC LinAppl_MlxsHndlr_stLoadRdSerNumMax_C "F4615: Maximum loader state for reading IEP serial number from melexis controller" VALUE 0x2019B1 AblGLKWub_M 3 X1_M 0 3 FORMAT "%5.3" /end CHARACTERISTIC
/begin CHARACTERISTIC LinAppl_MlxsHndlr_swtSerNumCtl_C "F4615: Control switch for handling of IEP serial number status. B0: Reset status on programming start. B1: Read number also if status valid." VALUE 0x2019B2 AblGLKWub_M 255 X1_M 0 255 FORMAT "%5.1" /end CHARACTERISTIC
/begin CHARACTERISTIC LinAppl_MlxsHndlr_TOut_C "F4615: Timeout counter. Sets the maximum allowed time until flashing is finished." VALUE 0x20158E AblGLKWuw_M 6553.5 TI1_CYCLE_M 0 6553.5 FORMAT "%8.3" /end CHARACTERISTIC
/begin CHARACTERISTIC LinAppl_MlxsHndlr_WrMem_DatWaitCntr_C "F4615: Number of tasks to wait for a responsive melexis lin slave after a data write command." VALUE 0x2019D2 AblGLKWub_M 255 X1_M 0 255 FORMAT "%5.1" /end CHARACTERISTIC
/begin CHARACTERISTIC LinAppl_MlxsHndlr_xSerNum_C "F4615: Replacement value for IEP serial number stored in the melexis controller" VAL_BLK 0x200468 AblGLKWBub_M 255 X1_M 0 255 NUMBER 8 FORMAT "%5.1" /end CHARACTERISTIC
/begin CHARACTERISTIC LinAppl_MlxsHndrl_Exp_FlshFileOffsLd1_C "F4615: File offset for loader state 1 and corresponding flash index " VAL_BLK 0x2004B8 AblGLKWBul_M 4.29497E+009 X1_M 0 4294967295 NUMBER 6 FORMAT "%13.2" /end CHARACTERISTIC
/begin CHARACTERISTIC LinAppl_MlxsHndrl_Exp_FlshFileOffsLd2_C "F4615: File offset for loader state 2 and corresponding flash index " VAL_BLK 0x2004D0 AblGLKWBul_M 4.29497E+009 X1_M 0 4294967295 NUMBER 6 FORMAT "%13.2" /end CHARACTERISTIC
/begin CHARACTERISTIC LinAppl_MlxsHndrl_Exp_FlshFileOffsLd3_C "F4615: File offset for loader state 3 and corresponding flash index " VAL_BLK 0x2004E8 AblGLKWBul_M 4.29497E+009 X1_M 0 4294967295 NUMBER 6 FORMAT "%13.2" /end CHARACTERISTIC
/begin CHARACTERISTIC LinAppl_TraHndlr_IdlModeAct_C "F4614: Allow transmission handler to be silent during idle mode 0: deactivated, 1: activated " VALUE 0x2019B6 AblGLKWub_M 255 X1_M 0 255 FORMAT "%5.1" /end CHARACTERISTIC
/begin CHARACTERISTIC LIN_ctRestartDelay_C "F4612: Communication restart delay (after communication stop)" VALUE 0x2019B5 AblGLKWub_M 251 X1_M 4 255 FORMAT "%5.1" /end CHARACTERISTIC
/begin CHARACTERISTIC LIN_swtMsgMon_C "F4611: Customer bitmask vector to disable corresponding message specific fault types. " VAL_BLK 0x200584 AblGLKWBub_M 255 X1_M 0 255 NUMBER 8 FORMAT "%5.1" /end CHARACTERISTIC
/begin CHARACTERISTIC RmnT100_tiMon_C "F1630: Monitoring time for 100ms task (no SERAP)" VALUE 0x201500 AblGLKWuw_M 65535 TI1_M_M 0 65535 FORMAT "%8.2" /end CHARACTERISTIC
/begin CHARACTERISTIC RmnT100_tiTOutSngl_C "F1630: Time out for single overflow of 100ms task (no SERAP)" VALUE 0x201502 AblGLKWuw_M 65535 TI1_M_M 0 65535 FORMAT "%8.2" /end CHARACTERISTIC
/begin CHARACTERISTIC RmnT100_tiTOut_C "F1630: Time out of 100ms task (no SERAP)" VALUE 0x201504 AblGLKWuw_M 65535 TI1_M_M 0 65535 FORMAT "%8.2" /end CHARACTERISTIC
/begin CHARACTERISTIC RmnT10_tiMon_C "F1630: Monitoring time for 10ms task (no SERAP)" VALUE 0x201506 AblGLKWuw_M 65535 TI1_M_M 0 65535 FORMAT "%8.2" /end CHARACTERISTIC
/begin CHARACTERISTIC RmnT10_tiTOutSngl_C "F1630: Time out for single overflow of 10ms task (no SERAP)" VALUE 0x201508 AblGLKWuw_M 65535 TI1_M_M 0 65535 FORMAT "%8.2" /end CHARACTERISTIC
/begin CHARACTERISTIC RmnT10_tiTOut_C "F1630: Time out of 10ms task (no SERAP)" VALUE 0x20150A AblGLKWuw_M 65535 TI1_M_M 0 65535 FORMAT "%8.2" /end CHARACTERISTIC
/begin CHARACTERISTIC RmnT20_tiMon_C "F1630: Monitoring time for 20ms task (no SERAP)" VALUE 0x20150C AblGLKWuw_M 65535 TI1_M_M 0 65535 FORMAT "%8.2" /end CHARACTERISTIC
/begin CHARACTERISTIC RmnT20_tiTOutSngl_C "F1630: Time out for single overflow of 20ms task (no SERAP)" VALUE 0x20150E AblGLKWuw_M 65535 TI1_M_M 0 65535 FORMAT "%8.2" /end CHARACTERISTIC
/begin CHARACTERISTIC RmnT20_tiTOut_C "F1630: Time out of 20ms task (no SERAP)" VALUE 0x201510 AblGLKWuw_M 65535 TI1_M_M 0 65535 FORMAT "%8.2" /end CHARACTERISTIC
/begin CHARACTERISTIC RmnT30_tiMon_C "F1630: Monitoring time for 30ms task (no SERAP)" VALUE 0x201512 AblGLKWuw_M 65535 TI1_M_M 0 65535 FORMAT "%8.2" /end CHARACTERISTIC
/begin CHARACTERISTIC RmnT30_tiTOutSngl_C "F1630: Time out for single overflow of 30ms task (no SERAP)" VALUE 0x201514 AblGLKWuw_M 65535 TI1_M_M 0 65535 FORMAT "%8.2" /end CHARACTERISTIC
/begin CHARACTERISTIC RmnT30_tiTOut_C "F1630: Time out of 30ms task (no SERAP)" VALUE 0x201516 AblGLKWuw_M 65535 TI1_M_M 0 65535 FORMAT "%8.2" /end CHARACTERISTIC
/begin CHARACTERISTIC RmnT50_tiMon_C "F1630: Monitoring time for 50ms task (no SERAP)" VALUE 0x201518 AblGLKWuw_M 65535 TI1_M_M 0 65535 FORMAT "%8.2" /end CHARACTERISTIC
/begin CHARACTERISTIC RmnT50_tiTOutSngl_C "F1630: Time out for single overflow of 50ms task (no SERAP)" VALUE 0x20151A AblGLKWuw_M 65535 TI1_M_M 0 65535 FORMAT "%8.2" /end CHARACTERISTIC
/begin CHARACTERISTIC RmnT50_tiTOut_C "F1630: Time out of 50ms task (no SERAP)" VALUE 0x20151C AblGLKWuw_M 65535 TI1_M_M 0 65535 FORMAT "%8.2" /end CHARACTERISTIC
/begin CHARACTERISTIC RmnT5_tiMon_C "F1630: Monitoring time for 5ms task (no SERAP)" VALUE 0x20151E AblGLKWuw_M 65535 TI1_M_M 0 65535 FORMAT "%8.2" /end CHARACTERISTIC
/begin CHARACTERISTIC RmnT5_tiTOutSngl_C "F1630: Time out for single overflow of 5ms task (no SERAP)" VALUE 0x201520 AblGLKWuw_M 65535 TI1_M_M 0 65535 FORMAT "%8.2" /end CHARACTERISTIC
/begin CHARACTERISTIC RmnT5_tiTOut_C "F1630: Time out of 5ms task (no SERAP)" VALUE 0x201522 AblGLKWuw_M 65535 TI1_M_M 0 65535 FORMAT "%8.2" /end CHARACTERISTIC
/begin CHARACTERISTIC RRT_adProcRunSel_C "F1620: Address of the process to be measured" VALUE 0x200130 AblGLKWul_M 4.29497E+009 X1_M 0 4294967295 FORMAT "%13.2" /end CHARACTERISTIC
/begin CHARACTERISTIC RRT_swtCpuLd2_C "F1620: Control switch of the CPU load 2 calculation (0x53AC = on)" VALUE 0x201524 AblGLKWuw_M 65535 X1_M 0 65535 FORMAT "%8.2" /end CHARACTERISTIC
/begin CHARACTERISTIC RRT_swtProcCtlAll_C "F1620: Calibration switch to enable the runtime measurement of all processes" VALUE 0x201956 AblGLKWub_M 1 B_TRUE_M 0 1 FORMAT "%13.11" /end CHARACTERISTIC
/begin CHARACTERISTIC RRT_swtProcCtl_C "F1620: Calibration switch to control the process runtime measurement task/mode specific" MAP 0x200134 AblGLFKFub_M 1 X1_M 0 1 FORMAT "%5.3"
 /begin AXIS_DESCR FIX_AXIS ROS_idxDmy X1_M 6 0 5 FIX_AXIS_PAR 0 0 6 FORMAT "%5.3" /end AXIS_DESCR
 /begin AXIS_DESCR FIX_AXIS ROS_idxDmy X1_M 10 0 9 FIX_AXIS_PAR 0 0 10 FORMAT "%5.3" /end AXIS_DESCR
/end CHARACTERISTIC
/begin CHARACTERISTIC RRT_swtProcRst_C "F1620: Calibration switch to reset the determination of the n longest processes" VALUE 0x201957 AblGLKWub_M 1 B_TRUE_M 0 1 FORMAT "%13.11" /end CHARACTERISTIC
/begin CHARACTERISTIC RRT_tiLopCpuLd2_C "F1620: Duration of one loop execution [ns]" VAL_BLK 0x200128 AblGLKWBuw_M 65535 X1_M 0 65535 NUMBER 4 FORMAT "%8.2" /end CHARACTERISTIC
/begin CHARACTERISTIC RRT_tiMeasCpuLd2_C "F1620: Measurement time of the CPU load 2 calculation" VALUE 0x201955 AblGLKWub_M 200 TI1_M_M 0 200 FORMAT "%5.1" /end CHARACTERISTIC
/begin CHARACTERISTIC RRT_tiProcRunLoLim_C "F1620: Lower runtime limit for determination of the n longest processes" VALUE 0x201526 AblGLKWuw_M 65.535 TI0_001_M_M 0 65.535 FORMAT "%8.5" /end CHARACTERISTIC
/begin CHARACTERISTIC SrvShr_TSysErrorTimeOut_C "F9120: System time client: Threshold to store a fault" VALUE 0x201592 AblGLKWuw_M 655.35 TI0_01_M 0 655.35 FORMAT "%8.4" /end CHARACTERISTIC
/begin CHARACTERISTIC SrvShr_TSysMsgTimeOut_C "F9120: System time client: Threshold to start internal inc of system time" VALUE 0x201594 AblGLKWuw_M 655.35 TI0_01_M 0 655.35 FORMAT "%8.4" /end CHARACTERISTIC
/begin CHARACTERISTIC SrvShr_TSysTimeInc_C "F9120: System time client: Threshold to control internal of system time" VALUE 0x201596 AblGLKWuw_M 655.35 TI0_01_M 0 655.35 FORMAT "%8.4" /end CHARACTERISTIC
/begin CHARACTERISTIC SWI_ComPreCond_EnrgModeFlash "F4100: Calibration mask for the precondition check for the UDS SetEnergyMode-Flash" VALUE 0x201582 AblGLKWuw_M 65535 X1_M 0 65535 FORMAT "%8.2" /end CHARACTERISTIC
/begin CHARACTERISTIC SWI_ComPreCond_EnrgModeNormal "F4100: Calibration mask for the precondition check for the UDS SetEnergyMode-Normal" VALUE 0x201584 AblGLKWuw_M 65535 X1_M 0 65535 FORMAT "%8.2" /end CHARACTERISTIC
/begin CHARACTERISTIC SWI_ComPreCond_EnrgModeProd "F4100: Calibration mask for the precondition check for the UDS SetEnergyMode-Production" VALUE 0x201586 AblGLKWuw_M 65535 X1_M 0 65535 FORMAT "%8.2" /end CHARACTERISTIC
/begin CHARACTERISTIC SWI_ComPreCond_EnrgModeTrans "F4100: Calibration mask for the precondition check for the UDS SetEnergyMode-Transport" VALUE 0x201588 AblGLKWuw_M 65535 X1_M 0 65535 FORMAT "%8.2" /end CHARACTERISTIC
/begin CHARACTERISTIC TPRT_tiComTOutStrt "F4410: Time for TPRT communication timeout" VALUE 0x20159C AblGLKWuw_M 9 TI0_1_M 1 10 FORMAT "%8.5" /end CHARACTERISTIC
/begin MEASUREMENT CANFA_ACLNX_MASSCNTR " F2062: CANFA_ACLNX_MASSCNTR (internal only)" UBYTE X1_M 1 100 0 255 FORMAT "%5.1" ARRAY_SIZE 15 ECU_ADDRESS 0xFFF84180 /end MEASUREMENT
/begin MEASUREMENT CANFA_ACLNX_MASSCNTR_DATA " F2062: CANFA_ACLNX_MASSCNTR valid buffer" UBYTE X1_M 1 100 0 255 FORMAT "%5.1" ARRAY_SIZE 8 ECU_ADDRESS 0xFFF84178 /end MEASUREMENT
/begin MEASUREMENT CANFA_ACLNX_MASSCNTR_RAW " F2062: CANFA_ACLNX_MASSCNTR raw buffer" UBYTE X1_M 1 100 0 255 FORMAT "%5.1" ARRAY_SIZE 8 ECU_ADDRESS 0xFFF941FC /end MEASUREMENT
/begin MEASUREMENT CANFA_ACLNY_MASSCNTR " F2062: CANFA_ACLNY_MASSCNTR (internal only)" UBYTE X1_M 1 100 0 255 FORMAT "%5.1" ARRAY_SIZE 15 ECU_ADDRESS 0xFFF84198 /end MEASUREMENT
/begin MEASUREMENT CANFA_ACLNY_MASSCNTR_DATA " F2062: CANFA_ACLNY_MASSCNTR valid buffer" UBYTE X1_M 1 100 0 255 FORMAT "%5.1" ARRAY_SIZE 8 ECU_ADDRESS 0xFFF84190 /end MEASUREMENT
/begin MEASUREMENT CANFA_ACLNY_MASSCNTR_RAW " F2062: CANFA_ACLNY_MASSCNTR raw buffer" UBYTE X1_M 1 100 0 255 FORMAT "%5.1" ARRAY_SIZE 8 ECU_ADDRESS 0xFFF94204 /end MEASUREMENT
/begin MEASUREMENT CANFA_ANG_ACPD " F2062: CANFA_ANG_ACPD (internal only)" UBYTE X1_M 1 100 0 255 FORMAT "%5.1" ARRAY_SIZE 15 ECU_ADDRESS 0xFFF841B0 /end MEASUREMENT
/begin MEASUREMENT CANFA_ANG_ACPD_DATA " F2062: CANFA_ANG_ACPD valid buffer" UBYTE X1_M 1 100 0 255 FORMAT "%5.1" ARRAY_SIZE 8 ECU_ADDRESS 0xFFF841A8 /end MEASUREMENT
/begin MEASUREMENT CANFA_ANG_ACPD_RAW " F2062: CANFA_ANG_ACPD raw buffer" UBYTE X1_M 1 100 0 255 FORMAT "%5.1" ARRAY_SIZE 8 ECU_ADDRESS 0xFFF9420C /end MEASUREMENT
/begin MEASUREMENT CANFA_AVL_BRTORQ_SUM " F2062: CANFA_AVL_BRTORQ_SUM (internal only)" UBYTE X1_M 1 100 0 255 FORMAT "%5.1" ARRAY_SIZE 15 ECU_ADDRESS 0xFFF841D0 /end MEASUREMENT
/begin MEASUREMENT CANFA_AVL_BRTORQ_SUM_COMP " F2062: CANFA_AVL_BRTORQ_SUM complement buffer" UBYTE X1_M 1 100 0 255 FORMAT "%5.1" ARRAY_SIZE 8 ECU_ADDRESS 0xFFF9421C /end MEASUREMENT
/begin MEASUREMENT CANFA_AVL_BRTORQ_SUM_COMPSTA " F2062: CANFA_AVL_BRTORQ_SUM_COMPSTA (internal only)" UBYTE X1_M 1 100 0 255 FORMAT "%5.1" ARRAY_SIZE 7 ECU_ADDRESS 0xFFF841C8 /end MEASUREMENT
/begin MEASUREMENT CANFA_AVL_BRTORQ_SUM_DATA " F2062: CANFA_AVL_BRTORQ_SUM valid buffer" UBYTE X1_M 1 100 0 255 FORMAT "%5.1" ARRAY_SIZE 8 ECU_ADDRESS 0xFFF841C0 /end MEASUREMENT
/begin MEASUREMENT CANFA_AVL_BRTORQ_SUM_RAW " F2062: CANFA_AVL_BRTORQ_SUM raw buffer" UBYTE X1_M 1 100 0 255 FORMAT "%5.1" ARRAY_SIZE 8 ECU_ADDRESS 0xFFF94214 /end MEASUREMENT
/begin MEASUREMENT CANFA_AVL_RPM_WHL_UPRT " F2062: CANFA_AVL_RPM_WHL_UPRT (internal only)" UBYTE X1_M 1 100 0 255 FORMAT "%5.1" ARRAY_SIZE 15 ECU_ADDRESS 0xFFF841E8 /end MEASUREMENT
/begin MEASUREMENT CANFA_AVL_RPM_WHL_UPRT_DATA " F2062: CANFA_AVL_RPM_WHL_UPRT valid buffer" UBYTE X1_M 1 100 0 255 FORMAT "%5.1" ARRAY_SIZE 8 ECU_ADDRESS 0xFFF841E0 /end MEASUREMENT
/begin MEASUREMENT CANFA_AVL_RPM_WHL_UPRT_RAW " F2062: CANFA_AVL_RPM_WHL_UPRT raw buffer" UBYTE X1_M 1 100 0 255 FORMAT "%5.1" ARRAY_SIZE 8 ECU_ADDRESS 0xFFF94224 /end MEASUREMENT
/begin MEASUREMENT CANFA_A_TEMP " F2062: CANFA_A_TEMP (internal only)" UBYTE X1_M 1 100 0 255 FORMAT "%5.1" ARRAY_SIZE 15 ECU_ADDRESS 0xFFF84168 /end MEASUREMENT
/begin MEASUREMENT CANFA_A_TEMP_DATA " F2062: CANFA_A_TEMP valid buffer" UBYTE X1_M 1 100 0 255 FORMAT "%5.1" ARRAY_SIZE 8 ECU_ADDRESS 0xFFF84160 /end MEASUREMENT
/begin MEASUREMENT CANFA_A_TEMP_RAW " F2062: CANFA_A_TEMP raw buffer" UBYTE X1_M 1 100 0 255 FORMAT "%5.1" ARRAY_SIZE 8 ECU_ADDRESS 0xFFF941F4 /end MEASUREMENT
/begin MEASUREMENT CANFA_BLINKEN " F2062: CANFA_BLINKEN (internal only)" UBYTE X1_M 1 100 0 255 FORMAT "%5.1" ARRAY_SIZE 15 ECU_ADDRESS 0xFFF84200 /end MEASUREMENT
/begin MEASUREMENT CANFA_BLINKEN_DATA " F2062: CANFA_BLINKEN valid buffer" UBYTE X1_M 1 100 0 255 FORMAT "%5.1" ARRAY_SIZE 8 ECU_ADDRESS 0xFFF841F8 /end MEASUREMENT
/begin MEASUREMENT CANFA_BLINKEN_RAW " F2062: CANFA_BLINKEN raw buffer" UBYTE X1_M 1 100 0 255 FORMAT "%5.1" ARRAY_SIZE 8 ECU_ADDRESS 0xFFF9422C /end MEASUREMENT
/begin MEASUREMENT CANFA_DIAG_OBD_ENG " F2062: CANFA_DIAG_OBD_ENG (internal only)" UBYTE X1_M 1 100 0 255 FORMAT "%5.1" ARRAY_SIZE 15 ECU_ADDRESS 0xFFF84218 /end MEASUREMENT
/begin MEASUREMENT CANFA_DIAG_OBD_ENG_DATA " F2062: CANFA_DIAG_OBD_ENG valid buffer" UBYTE X1_M 1 100 0 255 FORMAT "%5.1" ARRAY_SIZE 8 ECU_ADDRESS 0xFFF84210 /end MEASUREMENT
/begin MEASUREMENT CANFA_DIAG_OBD_ENG_RAW " F2062: CANFA_DIAG_OBD_ENG raw buffer" UBYTE X1_M 1 100 0 255 FORMAT "%5.1" ARRAY_SIZE 8 ECU_ADDRESS 0xFFF94234 /end MEASUREMENT
/begin MEASUREMENT CANFA_DT_DISP_GRDT " F2062: CANFA_DT_DISP_GRDT (internal only)" UBYTE X1_M 1 100 0 255 FORMAT "%5.1" ARRAY_SIZE 15 ECU_ADDRESS 0xFFF845D0 /end MEASUREMENT
/begin MEASUREMENT CANFA_DT_DISP_GRDT_DATA " F2062: CANFA_DT_DISP_GRDT valid buffer" UBYTE X1_M 1 100 0 255 FORMAT "%5.1" ARRAY_SIZE 8 ECU_ADDRESS 0xFFF845C0 /end MEASUREMENT
/begin MEASUREMENT CANFA_DT_DISP_GRDT_RAW " F2062: CANFA_DT_DISP_GRDT raw buffer" UBYTE X1_M 1 100 0 255 FORMAT "%5.1" ARRAY_SIZE 8 ECU_ADDRESS 0xFFF845C8 /end MEASUREMENT
/begin MEASUREMENT CANFA_DT_PT_1 " F2062: CANFA_DT_PT_1 (internal only)" UBYTE X1_M 1 100 0 255 FORMAT "%5.1" ARRAY_SIZE 15 ECU_ADDRESS 0xFFF84230 /end MEASUREMENT
/begin MEASUREMENT CANFA_DT_PT_1_DATA " F2062: CANFA_DT_PT_1 valid buffer" UBYTE X1_M 1 100 0 255 FORMAT "%5.1" ARRAY_SIZE 8 ECU_ADDRESS 0xFFF84228 /end MEASUREMENT
/begin MEASUREMENT CANFA_DT_PT_1_RAW " F2062: CANFA_DT_PT_1 raw buffer" UBYTE X1_M 1 100 0 255 FORMAT "%5.1" ARRAY_SIZE 8 ECU_ADDRESS 0xFFF9423C /end MEASUREMENT
/begin MEASUREMENT CANFA_FAHRGESTELLNUMMER " F2062: CANFA_FAHRGESTELLNUMMER (internal only)" UBYTE X1_M 1 100 0 255 FORMAT "%5.1" ARRAY_SIZE 15 ECU_ADDRESS 0xFFF84248 /end MEASUREMENT
/begin MEASUREMENT CANFA_FAHRGESTELLNUMMER_DATA " F2062: CANFA_FAHRGESTELLNUMMER valid buffer" UBYTE X1_M 1 100 0 255 FORMAT "%5.1" ARRAY_SIZE 8 ECU_ADDRESS 0xFFF84240 /end MEASUREMENT
/begin MEASUREMENT CANFA_FAHRGESTELLNUMMER_RAW " F2062: CANFA_FAHRGESTELLNUMMER raw buffer" UBYTE X1_M 1 100 0 255 FORMAT "%5.1" ARRAY_SIZE 8 ECU_ADDRESS 0xFFF94244 /end MEASUREMENT
/begin MEASUREMENT CANFA_FLLUPT_GPWSUP " F2062: CANFA_FLLUPT_GPWSUP (internal only)" UBYTE X1_M 1 100 0 255 FORMAT "%5.1" ARRAY_SIZE 15 ECU_ADDRESS 0xFFF84260 /end MEASUREMENT
/begin MEASUREMENT CANFA_FLLUPT_GPWSUP_DATA " F2062: CANFA_FLLUPT_GPWSUP valid buffer" UBYTE X1_M 1 100 0 255 FORMAT "%5.1" ARRAY_SIZE 8 ECU_ADDRESS 0xFFF84258 /end MEASUREMENT
/begin MEASUREMENT CANFA_FLLUPT_GPWSUP_RAW " F2062: CANFA_FLLUPT_GPWSUP raw buffer" UBYTE X1_M 1 100 0 255 FORMAT "%5.1" ARRAY_SIZE 8 ECU_ADDRESS 0xFFF9424C /end MEASUREMENT
/begin MEASUREMENT CANFA_FZZSTD " F2062: CANFA_FZZSTD (internal only)" UBYTE X1_M 1 100 0 255 FORMAT "%5.1" ARRAY_SIZE 15 ECU_ADDRESS 0xFFF84278 /end MEASUREMENT
/begin MEASUREMENT CANFA_FZZSTD_DATA " F2062: CANFA_FZZSTD valid buffer" UBYTE X1_M 1 100 0 255 FORMAT "%5.1" ARRAY_SIZE 8 ECU_ADDRESS 0xFFF84270 /end MEASUREMENT
/begin MEASUREMENT CANFA_FZZSTD_RAW " F2062: CANFA_FZZSTD raw buffer" UBYTE X1_M 1 100 0 255 FORMAT "%5.1" ARRAY_SIZE 8 ECU_ADDRESS 0xFFF94254 /end MEASUREMENT
/begin MEASUREMENT CANFA_KILOMETERSTAND " F2062: CANFA_KILOMETERSTAND (internal only)" UBYTE X1_M 1 100 0 255 FORMAT "%5.1" ARRAY_SIZE 15 ECU_ADDRESS 0xFFF84290 /end MEASUREMENT
/begin MEASUREMENT CANFA_KILOMETERSTAND_DATA " F2062: CANFA_KILOMETERSTAND valid buffer" UBYTE X1_M 1 100 0 255 FORMAT "%5.1" ARRAY_SIZE 8 ECU_ADDRESS 0xFFF84288 /end MEASUREMENT
/begin MEASUREMENT CANFA_KILOMETERSTAND_RAW " F2062: CANFA_KILOMETERSTAND raw buffer" UBYTE X1_M 1 100 0 255 FORMAT "%5.1" ARRAY_SIZE 8 ECU_ADDRESS 0xFFF9425C /end MEASUREMENT
/begin MEASUREMENT CANFA_KLEMMEN " F2062: CANFA_KLEMMEN (internal only)" UBYTE X1_M 1 100 0 255 FORMAT "%5.1" ARRAY_SIZE 15 ECU_ADDRESS 0xFFF842B0 /end MEASUREMENT
/begin MEASUREMENT CANFA_KLEMMEN_COMP " F2062: CANFA_KLEMMEN complement buffer" UBYTE X1_M 1 100 0 255 FORMAT "%5.1" ARRAY_SIZE 8 ECU_ADDRESS 0xFFF9426C /end MEASUREMENT
/begin MEASUREMENT CANFA_KLEMMEN_COMPSTA " F2062: CANFA_KLEMMEN_COMPSTA (internal only)" UBYTE X1_M 1 100 0 255 FORMAT "%5.1" ARRAY_SIZE 7 ECU_ADDRESS 0xFFF842A8 /end MEASUREMENT
/begin MEASUREMENT CANFA_KLEMMEN_DATA " F2062: CANFA_KLEMMEN valid buffer" UBYTE X1_M 1 100 0 255 FORMAT "%5.1" ARRAY_SIZE 8 ECU_ADDRESS 0xFFF842A0 /end MEASUREMENT
/begin MEASUREMENT CANFA_KLEMMEN_RAW " F2062: CANFA_KLEMMEN raw buffer" UBYTE X1_M 1 100 0 255 FORMAT "%5.1" ARRAY_SIZE 8 ECU_ADDRESS 0xFFF94264 /end MEASUREMENT
/begin MEASUREMENT CANFA_MASS_VEH " F2062: CANFA_MASS_VEH (internal only)" UBYTE X1_M 1 100 0 255 FORMAT "%5.1" ARRAY_SIZE 15 ECU_ADDRESS 0xFFF842C8 /end MEASUREMENT
/begin MEASUREMENT CANFA_MASS_VEH_DATA " F2062: CANFA_MASS_VEH valid buffer" UBYTE X1_M 1 100 0 255 FORMAT "%5.1" ARRAY_SIZE 8 ECU_ADDRESS 0xFFF842C0 /end MEASUREMENT
/begin MEASUREMENT CANFA_MASS_VEH_RAW " F2062: CANFA_MASS_VEH raw buffer" UBYTE X1_M 1 100 0 255 FORMAT "%5.1" ARRAY_SIZE 8 ECU_ADDRESS 0xFFF94274 /end MEASUREMENT
/begin MEASUREMENT CANFA_NAV_GRAPH " F2062: CANFA_NAV_GRAPH (internal only)" UBYTE X1_M 1 100 0 255 FORMAT "%5.1" ARRAY_SIZE 15 ECU_ADDRESS 0xFFF842E0 /end MEASUREMENT
/begin MEASUREMENT CANFA_NAV_GRAPH_DATA " F2062: CANFA_NAV_GRAPH valid buffer" UBYTE X1_M 1 100 0 255 FORMAT "%5.1" ARRAY_SIZE 8 ECU_ADDRESS 0xFFF842D8 /end MEASUREMENT
/begin MEASUREMENT CANFA_NAV_GRAPH_LNE " F2062: CANFA_NAV_GRAPH_LNE (internal only)" UBYTE X1_M 1 100 0 255 FORMAT "%5.1" ARRAY_SIZE 15 ECU_ADDRESS 0xFFF842F8 /end MEASUREMENT
/begin MEASUREMENT CANFA_NAV_GRAPH_LNE_DATA " F2062: CANFA_NAV_GRAPH_LNE valid buffer" UBYTE X1_M 1 100 0 255 FORMAT "%5.1" ARRAY_SIZE 8 ECU_ADDRESS 0xFFF842F0 /end MEASUREMENT
/begin MEASUREMENT CANFA_NAV_GRAPH_LNE_RAW " F2062: CANFA_NAV_GRAPH_LNE raw buffer" UBYTE X1_M 1 100 0 255 FORMAT "%5.1" ARRAY_SIZE 8 ECU_ADDRESS 0xFFF94284 /end MEASUREMENT
/begin MEASUREMENT CANFA_NAV_GRAPH_MAPDATA " F2062: CANFA_NAV_GRAPH_MAPDATA (internal only)" UBYTE X1_M 1 100 0 255 FORMAT "%5.1" ARRAY_SIZE 15 ECU_ADDRESS 0xFFF84310 /end MEASUREMENT
/begin MEASUREMENT CANFA_NAV_GRAPH_MAPDATA_DATA " F2062: CANFA_NAV_GRAPH_MAPDATA valid buffer" UBYTE X1_M 1 100 0 255 FORMAT "%5.1" ARRAY_SIZE 8 ECU_ADDRESS 0xFFF84308 /end MEASUREMENT
/begin MEASUREMENT CANFA_NAV_GRAPH_MAPDATA_RAW " F2062: CANFA_NAV_GRAPH_MAPDATA raw buffer" UBYTE X1_M 1 100 0 255 FORMAT "%5.1" ARRAY_SIZE 8 ECU_ADDRESS 0xFFF9428C /end MEASUREMENT
/begin MEASUREMENT CANFA_NAV_GRAPH_MATCH " F2062: CANFA_NAV_GRAPH_MATCH (internal only)" UBYTE X1_M 1 100 0 255 FORMAT "%5.1" ARRAY_SIZE 15 ECU_ADDRESS 0xFFF84328 /end MEASUREMENT
/begin MEASUREMENT CANFA_NAV_GRAPH_MATCH_DATA " F2062: CANFA_NAV_GRAPH_MATCH valid buffer" UBYTE X1_M 1 100 0 255 FORMAT "%5.1" ARRAY_SIZE 8 ECU_ADDRESS 0xFFF84320 /end MEASUREMENT
/begin MEASUREMENT CANFA_NAV_GRAPH_MATCH_RAW " F2062: CANFA_NAV_GRAPH_MATCH raw buffer" UBYTE X1_M 1 100 0 255 FORMAT "%5.1" ARRAY_SIZE 8 ECU_ADDRESS 0xFFF94294 /end MEASUREMENT
/begin MEASUREMENT CANFA_NAV_GRAPH_RAW " F2062: CANFA_NAV_GRAPH raw buffer" UBYTE X1_M 1 100 0 255 FORMAT "%5.1" ARRAY_SIZE 8 ECU_ADDRESS 0xFFF9427C /end MEASUREMENT
/begin MEASUREMENT CANFA_NAV_GRAPH_SYNC " F2062: CANFA_NAV_GRAPH_SYNC (internal only)" UBYTE X1_M 1 100 0 255 FORMAT "%5.1" ARRAY_SIZE 15 ECU_ADDRESS 0xFFF84340 /end MEASUREMENT
/begin MEASUREMENT CANFA_NAV_GRAPH_SYNC_DATA " F2062: CANFA_NAV_GRAPH_SYNC valid buffer" UBYTE X1_M 1 100 0 255 FORMAT "%5.1" ARRAY_SIZE 8 ECU_ADDRESS 0xFFF84338 /end MEASUREMENT
/begin MEASUREMENT CANFA_NAV_GRAPH_SYNC_RAW " F2062: CANFA_NAV_GRAPH_SYNC raw buffer" UBYTE X1_M 1 100 0 255 FORMAT "%5.1" ARRAY_SIZE 8 ECU_ADDRESS 0xFFF9429C /end MEASUREMENT
/begin MEASUREMENT CANFA_NAV_GRAPH_V " F2062: CANFA_NAV_GRAPH_V (internal only)" UBYTE X1_M 1 100 0 255 FORMAT "%5.1" ARRAY_SIZE 15 ECU_ADDRESS 0xFFF84358 /end MEASUREMENT
/begin MEASUREMENT CANFA_NAV_GRAPH_V_DATA " F2062: CANFA_NAV_GRAPH_V valid buffer" UBYTE X1_M 1 100 0 255 FORMAT "%5.1" ARRAY_SIZE 8 ECU_ADDRESS 0xFFF84350 /end MEASUREMENT
/begin MEASUREMENT CANFA_NAV_GRAPH_V_RAW " F2062: CANFA_NAV_GRAPH_V raw buffer" UBYTE X1_M 1 100 0 255 FORMAT "%5.1" ARRAY_SIZE 8 ECU_ADDRESS 0xFFF942A4 /end MEASUREMENT
/begin MEASUREMENT CANFA_NAV_SYS_INF " F2062: CANFA_NAV_SYS_INF (internal only)" UBYTE X1_M 1 100 0 255 FORMAT "%5.1" ARRAY_SIZE 15 ECU_ADDRESS 0xFFF84370 /end MEASUREMENT
/begin MEASUREMENT CANFA_NAV_SYS_INF_DATA " F2062: CANFA_NAV_SYS_INF valid buffer" UBYTE X1_M 1 100 0 255 FORMAT "%5.1" ARRAY_SIZE 8 ECU_ADDRESS 0xFFF84368 /end MEASUREMENT
/begin MEASUREMENT CANFA_NAV_SYS_INF_RAW " F2062: CANFA_NAV_SYS_INF raw buffer" UBYTE X1_M 1 100 0 255 FORMAT "%5.1" ARRAY_SIZE 8 ECU_ADDRESS 0xFFF942AC /end MEASUREMENT
/begin MEASUREMENT CANFA_OP_SPD " F2062: CANFA_OP_SPD (internal only)" UBYTE X1_M 1 100 0 255 FORMAT "%5.1" ARRAY_SIZE 15 ECU_ADDRESS 0xFFF84388 /end MEASUREMENT
/begin MEASUREMENT CANFA_OP_SPD_DATA " F2062: CANFA_OP_SPD valid buffer" UBYTE X1_M 1 100 0 255 FORMAT "%5.1" ARRAY_SIZE 8 ECU_ADDRESS 0xFFF84380 /end MEASUREMENT
/begin MEASUREMENT CANFA_OP_SPD_RAW " F2062: CANFA_OP_SPD raw buffer" UBYTE X1_M 1 100 0 255 FORMAT "%5.1" ARRAY_SIZE 8 ECU_ADDRESS 0xFFF942B4 /end MEASUREMENT
/begin MEASUREMENT CANFA_RELATIVZEIT " F2062: CANFA_RELATIVZEIT (internal only)" UBYTE X1_M 1 100 0 255 FORMAT "%5.1" ARRAY_SIZE 15 ECU_ADDRESS 0xFFF843A0 /end MEASUREMENT
/begin MEASUREMENT CANFA_RELATIVZEIT_DATA " F2062: CANFA_RELATIVZEIT valid buffer" UBYTE X1_M 1 100 0 255 FORMAT "%5.1" ARRAY_SIZE 8 ECU_ADDRESS 0xFFF84398 /end MEASUREMENT
/begin MEASUREMENT CANFA_RELATIVZEIT_RAW " F2062: CANFA_RELATIVZEIT raw buffer" UBYTE X1_M 1 100 0 255 FORMAT "%5.1" ARRAY_SIZE 8 ECU_ADDRESS 0xFFF942BC /end MEASUREMENT
/begin MEASUREMENT CANFA_RQ_CLT " F2062: CANFA_RQ_CLT (internal only)" UBYTE X1_M 1 100 0 255 FORMAT "%5.1" ARRAY_SIZE 15 ECU_ADDRESS 0xFFF843B8 /end MEASUREMENT
/begin MEASUREMENT CANFA_RQ_CLT_DATA " F2062: CANFA_RQ_CLT valid buffer" UBYTE X1_M 1 100 0 255 FORMAT "%5.1" ARRAY_SIZE 8 ECU_ADDRESS 0xFFF843B0 /end MEASUREMENT
/begin MEASUREMENT CANFA_RQ_CLT_RAW " F2062: CANFA_RQ_CLT raw buffer" UBYTE X1_M 1 100 0 255 FORMAT "%5.1" ARRAY_SIZE 8 ECU_ADDRESS 0xFFF942C4 /end MEASUREMENT
/begin MEASUREMENT CANFA_STAT_ANHAENGER " F2062: CANFA_STAT_ANHAENGER (internal only)" UBYTE X1_M 1 100 0 255 FORMAT "%5.1" ARRAY_SIZE 15 ECU_ADDRESS 0xFFF84488 /end MEASUREMENT
/begin MEASUREMENT CANFA_STAT_ANHAENGER_DATA " F2062: CANFA_STAT_ANHAENGER valid buffer" UBYTE X1_M 1 100 0 255 FORMAT "%5.1" ARRAY_SIZE 8 ECU_ADDRESS 0xFFF84480 /end MEASUREMENT
/begin MEASUREMENT CANFA_STAT_ANHAENGER_RAW " F2062: CANFA_STAT_ANHAENGER raw buffer" UBYTE X1_M 1 100 0 255 FORMAT "%5.1" ARRAY_SIZE 8 ECU_ADDRESS 0xFFF94314 /end MEASUREMENT
/begin MEASUREMENT CANFA_STAT_CT_HABR " F2062: CANFA_STAT_CT_HABR (internal only)" UBYTE X1_M 1 100 0 255 FORMAT "%5.1" ARRAY_SIZE 15 ECU_ADDRESS 0xFFF844A0 /end MEASUREMENT
/begin MEASUREMENT CANFA_STAT_CT_HABR_DATA " F2062: CANFA_STAT_CT_HABR valid buffer" UBYTE X1_M 1 100 0 255 FORMAT "%5.1" ARRAY_SIZE 8 ECU_ADDRESS 0xFFF84498 /end MEASUREMENT
/begin MEASUREMENT CANFA_STAT_CT_HABR_RAW " F2062: CANFA_STAT_CT_HABR raw buffer" UBYTE X1_M 1 100 0 255 FORMAT "%5.1" ARRAY_SIZE 8 ECU_ADDRESS 0xFFF9431C /end MEASUREMENT
/begin MEASUREMENT CANFA_STAT_DS_VRFD " F2062: CANFA_STAT_DS_VRFD (internal only)" UBYTE X1_M 1 100 0 255 FORMAT "%5.1" ARRAY_SIZE 15 ECU_ADDRESS 0xFFF844B8 /end MEASUREMENT
/begin MEASUREMENT CANFA_STAT_DS_VRFD_DATA " F2062: CANFA_STAT_DS_VRFD valid buffer" UBYTE X1_M 1 100 0 255 FORMAT "%5.1" ARRAY_SIZE 8 ECU_ADDRESS 0xFFF844B0 /end MEASUREMENT
/begin MEASUREMENT CANFA_STAT_DS_VRFD_RAW " F2062: CANFA_STAT_DS_VRFD raw buffer" UBYTE X1_M 1 100 0 255 FORMAT "%5.1" ARRAY_SIZE 8 ECU_ADDRESS 0xFFF94324 /end MEASUREMENT
/begin MEASUREMENT CANFA_STAT_ZV_KLAPPEN " F2062: CANFA_STAT_ZV_KLAPPEN (internal only)" UBYTE X1_M 1 100 0 255 FORMAT "%5.1" ARRAY_SIZE 15 ECU_ADDRESS 0xFFF844D0 /end MEASUREMENT
/begin MEASUREMENT CANFA_STAT_ZV_KLAPPEN_DATA " F2062: CANFA_STAT_ZV_KLAPPEN valid buffer" UBYTE X1_M 1 100 0 255 FORMAT "%5.1" ARRAY_SIZE 8 ECU_ADDRESS 0xFFF844C8 /end MEASUREMENT
/begin MEASUREMENT CANFA_STAT_ZV_KLAPPEN_RAW " F2062: CANFA_STAT_ZV_KLAPPEN raw buffer" UBYTE X1_M 1 100 0 255 FORMAT "%5.1" ARRAY_SIZE 8 ECU_ADDRESS 0xFFF9432C /end MEASUREMENT
/begin MEASUREMENT CANFA_STEA_FTAX_EFFV " F2062: CANFA_STEA_FTAX_EFFV (internal only)" UBYTE X1_M 1 100 0 255 FORMAT "%5.1" ARRAY_SIZE 15 ECU_ADDRESS 0xFFF844E8 /end MEASUREMENT
/begin MEASUREMENT CANFA_STEA_FTAX_EFFV_DATA " F2062: CANFA_STEA_FTAX_EFFV valid buffer" UBYTE X1_M 1 100 0 255 FORMAT "%5.1" ARRAY_SIZE 8 ECU_ADDRESS 0xFFF844E0 /end MEASUREMENT
/begin MEASUREMENT CANFA_STEA_FTAX_EFFV_RAW " F2062: CANFA_STEA_FTAX_EFFV raw buffer" UBYTE X1_M 1 100 0 255 FORMAT "%5.1" ARRAY_SIZE 8 ECU_ADDRESS 0xFFF94334 /end MEASUREMENT
/begin MEASUREMENT CANFA_ST_BLT_CT_SOCCU " F2062: CANFA_ST_BLT_CT_SOCCU (internal only)" UBYTE X1_M 1 100 0 255 FORMAT "%5.1" ARRAY_SIZE 15 ECU_ADDRESS 0xFFF843D0 /end MEASUREMENT
/begin MEASUREMENT CANFA_ST_BLT_CT_SOCCU_DATA " F2062: CANFA_ST_BLT_CT_SOCCU valid buffer" UBYTE X1_M 1 100 0 255 FORMAT "%5.1" ARRAY_SIZE 8 ECU_ADDRESS 0xFFF843C8 /end MEASUREMENT
/begin MEASUREMENT CANFA_ST_BLT_CT_SOCCU_RAW " F2062: CANFA_ST_BLT_CT_SOCCU raw buffer" UBYTE X1_M 1 100 0 255 FORMAT "%5.1" ARRAY_SIZE 8 ECU_ADDRESS 0xFFF942CC /end MEASUREMENT
/begin MEASUREMENT CANFA_ST_DISP_DRDY " F2062: CANFA_ST_DISP_DRDY (internal only)" UBYTE X1_M 1 100 0 255 FORMAT "%5.1" ARRAY_SIZE 15 ECU_ADDRESS 0xFFF843E8 /end MEASUREMENT
/begin MEASUREMENT CANFA_ST_DISP_DRDY_DATA " F2062: CANFA_ST_DISP_DRDY valid buffer" UBYTE X1_M 1 100 0 255 FORMAT "%5.1" ARRAY_SIZE 8 ECU_ADDRESS 0xFFF843E0 /end MEASUREMENT
/begin MEASUREMENT CANFA_ST_DISP_DRDY_RAW " F2062: CANFA_ST_DISP_DRDY raw buffer" UBYTE X1_M 1 100 0 255 FORMAT "%5.1" ARRAY_SIZE 8 ECU_ADDRESS 0xFFF942D4 /end MEASUREMENT
/begin MEASUREMENT CANFA_ST_GRB_ECU " F2062: CANFA_ST_GRB_ECU (internal only)" UBYTE X1_M 1 100 0 255 FORMAT "%5.1" ARRAY_SIZE 15 ECU_ADDRESS 0xFFF845F0 /end MEASUREMENT
/begin MEASUREMENT CANFA_ST_GRB_ECU_DATA " F2062: CANFA_ST_GRB_ECU valid buffer" UBYTE X1_M 1 100 0 255 FORMAT "%5.1" ARRAY_SIZE 8 ECU_ADDRESS 0xFFF845E0 /end MEASUREMENT
/begin MEASUREMENT CANFA_ST_GRB_ECU_RAW " F2062: CANFA_ST_GRB_ECU raw buffer" UBYTE X1_M 1 100 0 255 FORMAT "%5.1" ARRAY_SIZE 8 ECU_ADDRESS 0xFFF845E8 /end MEASUREMENT
/begin MEASUREMENT CANFA_ST_GWS " F2062: CANFA_ST_GWS (internal only)" UBYTE X1_M 1 100 0 255 FORMAT "%5.1" ARRAY_SIZE 15 ECU_ADDRESS 0xFFF84408 /end MEASUREMENT
/begin MEASUREMENT CANFA_ST_GWS_COMP " F2062: CANFA_ST_GWS complement buffer" UBYTE X1_M 1 100 0 255 FORMAT "%5.1" ARRAY_SIZE 8 ECU_ADDRESS 0xFFF942E4 /end MEASUREMENT
/begin MEASUREMENT CANFA_ST_GWS_COMPSTA " F2062: CANFA_ST_GWS_COMPSTA (internal only)" UBYTE X1_M 1 100 0 255 FORMAT "%5.1" ARRAY_SIZE 7 ECU_ADDRESS 0xFFF84400 /end MEASUREMENT
/begin MEASUREMENT CANFA_ST_GWS_DATA " F2062: CANFA_ST_GWS valid buffer" UBYTE X1_M 1 100 0 255 FORMAT "%5.1" ARRAY_SIZE 8 ECU_ADDRESS 0xFFF843F8 /end MEASUREMENT
/begin MEASUREMENT CANFA_ST_GWS_RAW " F2062: CANFA_ST_GWS raw buffer" UBYTE X1_M 1 100 0 255 FORMAT "%5.1" ARRAY_SIZE 8 ECU_ADDRESS 0xFFF942DC /end MEASUREMENT
/begin MEASUREMENT CANFA_ST_STAB_DSC " F2062: CANFA_ST_STAB_DSC (internal only)" UBYTE X1_M 1 100 0 255 FORMAT "%5.1" ARRAY_SIZE 15 ECU_ADDRESS 0xFFF84440 /end MEASUREMENT
/begin MEASUREMENT CANFA_ST_STAB_DSC_COMP " F2062: CANFA_ST_STAB_DSC complement buffer" UBYTE X1_M 1 100 0 255 FORMAT "%5.1" ARRAY_SIZE 8 ECU_ADDRESS 0xFFF942FC /end MEASUREMENT
/begin MEASUREMENT CANFA_ST_STAB_DSC_COMPSTA " F2062: CANFA_ST_STAB_DSC_COMPSTA (internal only)" UBYTE X1_M 1 100 0 255 FORMAT "%5.1" ARRAY_SIZE 7 ECU_ADDRESS 0xFFF84438 /end MEASUREMENT
/begin MEASUREMENT CANFA_ST_STAB_DSC_DATA " F2062: CANFA_ST_STAB_DSC valid buffer" UBYTE X1_M 1 100 0 255 FORMAT "%5.1" ARRAY_SIZE 8 ECU_ADDRESS 0xFFF84430 /end MEASUREMENT
/begin MEASUREMENT CANFA_ST_STAB_DSC_RAW " F2062: CANFA_ST_STAB_DSC raw buffer" UBYTE X1_M 1 100 0 255 FORMAT "%5.1" ARRAY_SIZE 8 ECU_ADDRESS 0xFFF942F4 /end MEASUREMENT
/begin MEASUREMENT CANFA_ST_STA_PWR_DRV " F2062: CANFA_ST_STA_PWR_DRV (internal only)" UBYTE X1_M 1 100 0 255 FORMAT "%5.1" ARRAY_SIZE 15 ECU_ADDRESS 0xFFF84420 /end MEASUREMENT
/begin MEASUREMENT CANFA_ST_STA_PWR_DRV_DATA " F2062: CANFA_ST_STA_PWR_DRV valid buffer" UBYTE X1_M 1 100 0 255 FORMAT "%5.1" ARRAY_SIZE 8 ECU_ADDRESS 0xFFF84418 /end MEASUREMENT
/begin MEASUREMENT CANFA_ST_STA_PWR_DRV_RAW " F2062: CANFA_ST_STA_PWR_DRV raw buffer" UBYTE X1_M 1 100 0 255 FORMAT "%5.1" ARRAY_SIZE 8 ECU_ADDRESS 0xFFF942EC /end MEASUREMENT
/begin MEASUREMENT CANFA_ST_VEHSS_PBRK " F2062: CANFA_ST_VEHSS_PBRK (internal only)" UBYTE X1_M 1 100 0 255 FORMAT "%5.1" ARRAY_SIZE 15 ECU_ADDRESS 0xFFF84458 /end MEASUREMENT
/begin MEASUREMENT CANFA_ST_VEHSS_PBRK_DATA " F2062: CANFA_ST_VEHSS_PBRK valid buffer" UBYTE X1_M 1 100 0 255 FORMAT "%5.1" ARRAY_SIZE 8 ECU_ADDRESS 0xFFF84450 /end MEASUREMENT
/begin MEASUREMENT CANFA_ST_VEHSS_PBRK_RAW " F2062: CANFA_ST_VEHSS_PBRK raw buffer" UBYTE X1_M 1 100 0 255 FORMAT "%5.1" ARRAY_SIZE 8 ECU_ADDRESS 0xFFF94304 /end MEASUREMENT
/begin MEASUREMENT CANFA_ST_VHSS " F2062: CANFA_ST_VHSS (internal only)" UBYTE X1_M 1 100 0 255 FORMAT "%5.1" ARRAY_SIZE 15 ECU_ADDRESS 0xFFF84470 /end MEASUREMENT
/begin MEASUREMENT CANFA_ST_VHSS_DATA " F2062: CANFA_ST_VHSS valid buffer" UBYTE X1_M 1 100 0 255 FORMAT "%5.1" ARRAY_SIZE 8 ECU_ADDRESS 0xFFF84468 /end MEASUREMENT
/begin MEASUREMENT CANFA_ST_VHSS_RAW " F2062: CANFA_ST_VHSS raw buffer" UBYTE X1_M 1 100 0 255 FORMAT "%5.1" ARRAY_SIZE 8 ECU_ADDRESS 0xFFF9430C /end MEASUREMENT
/begin MEASUREMENT CANFA_SU_SW_DRDY " F2062: CANFA_SU_SW_DRDY (internal only)" UBYTE X1_M 1 100 0 255 FORMAT "%5.1" ARRAY_SIZE 15 ECU_ADDRESS 0xFFF84500 /end MEASUREMENT
/begin MEASUREMENT CANFA_SU_SW_DRDY_DATA " F2062: CANFA_SU_SW_DRDY valid buffer" UBYTE X1_M 1 100 0 255 FORMAT "%5.1" ARRAY_SIZE 8 ECU_ADDRESS 0xFFF844F8 /end MEASUREMENT
/begin MEASUREMENT CANFA_SU_SW_DRDY_RAW " F2062: CANFA_SU_SW_DRDY raw buffer" UBYTE X1_M 1 100 0 255 FORMAT "%5.1" ARRAY_SIZE 8 ECU_ADDRESS 0xFFF9433C /end MEASUREMENT
/begin MEASUREMENT CanFA_tiEventMsgDelayDT_DISP_GRDT "F2055: Timer debounce time for message DT_DISP_GRDT (FA-CAN)" UBYTE TI1_M_CYCLE_M 1 100 0 1275 FORMAT "%5.0" ECU_ADDRESS 0xFFF95D30 /end MEASUREMENT
/begin MEASUREMENT CanFA_tiEventMsgDelayST_GRB_ECU "F2055: Timer debounce time for message ST_GRB_ECU (FA-CAN)" UBYTE TI1_M_CYCLE_M 1 100 0 1275 FORMAT "%5.0" ECU_ADDRESS 0xFFF95D31 /end MEASUREMENT
/begin MEASUREMENT CANFA_TLT_RW " F2062: CANFA_TLT_RW (internal only)" UBYTE X1_M 1 100 0 255 FORMAT "%5.1" ARRAY_SIZE 15 ECU_ADDRESS 0xFFF84518 /end MEASUREMENT
/begin MEASUREMENT CANFA_TLT_RW_DATA " F2062: CANFA_TLT_RW valid buffer" UBYTE X1_M 1 100 0 255 FORMAT "%5.1" ARRAY_SIZE 8 ECU_ADDRESS 0xFFF84510 /end MEASUREMENT
/begin MEASUREMENT CANFA_TLT_RW_RAW " F2062: CANFA_TLT_RW raw buffer" UBYTE X1_M 1 100 0 255 FORMAT "%5.1" ARRAY_SIZE 8 ECU_ADDRESS 0xFFF94344 /end MEASUREMENT
/begin MEASUREMENT CANFA_TOMA_WHL " F2062: CANFA_TOMA_WHL (internal only)" UBYTE X1_M 1 100 0 255 FORMAT "%5.1" ARRAY_SIZE 15 ECU_ADDRESS 0xFFF84530 /end MEASUREMENT
/begin MEASUREMENT CANFA_TOMA_WHL_DATA " F2062: CANFA_TOMA_WHL valid buffer" UBYTE X1_M 1 100 0 255 FORMAT "%5.1" ARRAY_SIZE 8 ECU_ADDRESS 0xFFF84528 /end MEASUREMENT
/begin MEASUREMENT CANFA_TOMA_WHL_RAW " F2062: CANFA_TOMA_WHL raw buffer" UBYTE X1_M 1 100 0 255 FORMAT "%5.1" ARRAY_SIZE 8 ECU_ADDRESS 0xFFF9434C /end MEASUREMENT
/begin MEASUREMENT CANFA_TORQ_CRSH_1 " F2062: CANFA_TORQ_CRSH_1 (internal only)" UBYTE X1_M 1 100 0 255 FORMAT "%5.1" ARRAY_SIZE 15 ECU_ADDRESS 0xFFF84550 /end MEASUREMENT
/begin MEASUREMENT CANFA_TORQ_CRSH_1_COMP " F2062: CANFA_TORQ_CRSH_1 complement buffer" UBYTE X1_M 1 100 0 255 FORMAT "%5.1" ARRAY_SIZE 8 ECU_ADDRESS 0xFFF9435C /end MEASUREMENT
/begin MEASUREMENT CANFA_TORQ_CRSH_1_COMPSTA " F2062: CANFA_TORQ_CRSH_1_COMPSTA (internal only)" UBYTE X1_M 1 100 0 255 FORMAT "%5.1" ARRAY_SIZE 7 ECU_ADDRESS 0xFFF84548 /end MEASUREMENT
/begin MEASUREMENT CANFA_TORQ_CRSH_1_DATA " F2062: CANFA_TORQ_CRSH_1 valid buffer" UBYTE X1_M 1 100 0 255 FORMAT "%5.1" ARRAY_SIZE 8 ECU_ADDRESS 0xFFF84540 /end MEASUREMENT
/begin MEASUREMENT CANFA_TORQ_CRSH_1_RAW " F2062: CANFA_TORQ_CRSH_1 raw buffer" UBYTE X1_M 1 100 0 255 FORMAT "%5.1" ARRAY_SIZE 8 ECU_ADDRESS 0xFFF94354 /end MEASUREMENT
/begin MEASUREMENT CANFA_TORQ_GRB_HYB " F2062: CANFA_TORQ_GRB_HYB (internal only)" UBYTE X1_M 1 100 0 255 FORMAT "%5.1" ARRAY_SIZE 15 ECU_ADDRESS 0xFFF84608 /end MEASUREMENT
/begin MEASUREMENT CANFA_TORQ_GRB_HYB_DATA " F2062: CANFA_TORQ_GRB_HYB valid buffer" UBYTE X1_M 1 100 0 255 FORMAT "%5.1" ARRAY_SIZE 8 ECU_ADDRESS 0xFFF84600 /end MEASUREMENT
/begin MEASUREMENT CANFA_TORQ_PT_HYB_1 " F2062: CANFA_TORQ_PT_HYB_1 (internal only)" UBYTE X1_M 1 100 0 255 FORMAT "%5.1" ARRAY_SIZE 15 ECU_ADDRESS 0xFFF84568 /end MEASUREMENT
/begin MEASUREMENT CANFA_TORQ_PT_HYB_1_DATA " F2062: CANFA_TORQ_PT_HYB_1 valid buffer" UBYTE X1_M 1 100 0 255 FORMAT "%5.1" ARRAY_SIZE 8 ECU_ADDRESS 0xFFF84560 /end MEASUREMENT
/begin MEASUREMENT CANFA_TORQ_PT_HYB_1_RAW " F2062: CANFA_TORQ_PT_HYB_1 raw buffer" UBYTE X1_M 1 100 0 255 FORMAT "%5.1" ARRAY_SIZE 8 ECU_ADDRESS 0xFFF94364 /end MEASUREMENT
/begin MEASUREMENT CANFA_VYAW_VEH " F2062: CANFA_VYAW_VEH (internal only)" UBYTE X1_M 1 100 0 255 FORMAT "%5.1" ARRAY_SIZE 15 ECU_ADDRESS 0xFFF84598 /end MEASUREMENT
/begin MEASUREMENT CANFA_VYAW_VEH_DATA " F2062: CANFA_VYAW_VEH valid buffer" UBYTE X1_M 1 100 0 255 FORMAT "%5.1" ARRAY_SIZE 8 ECU_ADDRESS 0xFFF84590 /end MEASUREMENT
/begin MEASUREMENT CANFA_VYAW_VEH_RAW " F2062: CANFA_VYAW_VEH raw buffer" UBYTE X1_M 1 100 0 255 FORMAT "%5.1" ARRAY_SIZE 8 ECU_ADDRESS 0xFFF94374 /end MEASUREMENT
/begin MEASUREMENT CANFA_V_VEH " F2062: CANFA_V_VEH (internal only)" UBYTE X1_M 1 100 0 255 FORMAT "%5.1" ARRAY_SIZE 15 ECU_ADDRESS 0xFFF84580 /end MEASUREMENT
/begin MEASUREMENT CANFA_V_VEH_DATA " F2062: CANFA_V_VEH valid buffer" UBYTE X1_M 1 100 0 255 FORMAT "%5.1" ARRAY_SIZE 8 ECU_ADDRESS 0xFFF84578 /end MEASUREMENT
/begin MEASUREMENT CANFA_V_VEH_RAW " F2062: CANFA_V_VEH raw buffer" UBYTE X1_M 1 100 0 255 FORMAT "%5.1" ARRAY_SIZE 8 ECU_ADDRESS 0xFFF9436C /end MEASUREMENT
/begin MEASUREMENT CANFA_WMOM_DRV_1 " F2062: CANFA_WMOM_DRV_1 (internal only)" UBYTE X1_M 1 100 0 255 FORMAT "%5.1" ARRAY_SIZE 15 ECU_ADDRESS 0xFFF845B0 /end MEASUREMENT
/begin MEASUREMENT CANFA_WMOM_DRV_1_DATA " F2062: CANFA_WMOM_DRV_1 valid buffer" UBYTE X1_M 1 100 0 255 FORMAT "%5.1" ARRAY_SIZE 8 ECU_ADDRESS 0xFFF845A8 /end MEASUREMENT
/begin MEASUREMENT CANFA_WMOM_DRV_1_RAW " F2062: CANFA_WMOM_DRV_1 raw buffer" UBYTE X1_M 1 100 0 255 FORMAT "%5.1" ARRAY_SIZE 8 ECU_ADDRESS 0xFFF9437C /end MEASUREMENT
/begin MEASUREMENT CanNmAppl_var_s[0].stBcTxA "CanNmAppl_var_s / Confirmation of Bus Communication state (Tx of Appl messages enabled/disabled)" UBYTE CanNmAppl_stBcTxA_t_M 1 100 0 1 FORMAT "%13.11" ECU_ADDRESS 0xFFF93E44 /end MEASUREMENT
/begin MEASUREMENT CanNmAppl_var_s[0].msgCnt_TxConfirmation_u16 "CanNmAppl_var_s / msg counter for confirmed transmission of own CanNm PDUs" UWORD X1_M 1 100 0 65535 FORMAT "%8.2" ECU_ADDRESS 0xFFF93E46 /end MEASUREMENT
/begin MEASUREMENT CanNmAppl_var_s[0].msgCnt_RxIndication_u16 "CanNmAppl_var_s / msg counter for Rx Indication of CanNm PDUs" UWORD X1_M 1 100 0 65535 FORMAT "%8.2" ECU_ADDRESS 0xFFF93E48 /end MEASUREMENT
/begin MEASUREMENT CanNmAppl_var_s[1].stBcTxA "CanNmAppl_var_s / Confirmation of Bus Communication state (Tx of Appl messages enabled/disabled)" UBYTE CanNmAppl_stBcTxA_t_M 1 100 0 1 FORMAT "%13.11" ECU_ADDRESS 0xFFF93E4A /end MEASUREMENT
/begin MEASUREMENT CanNmAppl_var_s[1].msgCnt_TxConfirmation_u16 "CanNmAppl_var_s / msg counter for confirmed transmission of own CanNm PDUs" UWORD X1_M 1 100 0 65535 FORMAT "%8.2" ECU_ADDRESS 0xFFF93E4C /end MEASUREMENT
/begin MEASUREMENT CanNmAppl_var_s[1].msgCnt_RxIndication_u16 "CanNmAppl_var_s / msg counter for Rx Indication of CanNm PDUs" UWORD X1_M 1 100 0 65535 FORMAT "%8.2" ECU_ADDRESS 0xFFF93E4E /end MEASUREMENT
/begin MEASUREMENT CanNm_var_s[0].tiMsg_Cycle_Time_u32 "CanNm_var_s (implementation in generated c-source in cannm_auto_conf.c) / ticks for monitoring Msg Cycle Time" ULONG X1_M 1 100 0 4294967295 FORMAT "%13.2" ECU_ADDRESS 0xFFF9456C /end MEASUREMENT
/begin MEASUREMENT CanNm_var_s[0].tiMsg_Timeout_Time_u32 "CanNm_var_s (implementation in generated c-source in cannm_auto_conf.c) / ticks for monitoring Msg Timeout Time" ULONG X1_M 1 100 0 4294967295 FORMAT "%13.2" ECU_ADDRESS 0xFFF94570 /end MEASUREMENT
/begin MEASUREMENT CanNm_var_s[0].tiMsgCycleTime_Offset_u32 "CanNm_var_s (implementation in generated c-source in cannm_auto_conf.c) / ticks with MsgCycleTime+CycleOffset" ULONG X1_M 1 100 0 4294967295 FORMAT "%13.2" ECU_ADDRESS 0xFFF94574 /end MEASUREMENT
/begin MEASUREMENT CanNm_var_s[0].stCanNmFlags_b32 "CanNm_var_s (implementation in generated c-source in cannm_auto_conf.c) / status flags for CanNm" ULONG X1_M 1 100 0 4294967295 FORMAT "%13.2" ECU_ADDRESS 0xFFF94578 /end MEASUREMENT
/begin MEASUREMENT CanNm_var_s[0].dRxUserData_u8 "CanNm_var_s (implementation in generated c-source in cannm_auto_conf.c) / copy of received user data" UBYTE X1_M 1 100 0 255 FORMAT "%5.1" ARRAY_SIZE 4 ECU_ADDRESS 0xFFF9457C /end MEASUREMENT
/begin MEASUREMENT CanNm_var_s[0].dSendBuffer_s "CanNm_var_s (implementation in generated c-source in cannm_auto_conf.c) / buffer for transmission data" UBYTE X1_M 1 100 0 255 FORMAT "%5.1" ARRAY_SIZE 7 ECU_ADDRESS 0xFFF94580 /end MEASUREMENT
/begin MEASUREMENT CanNm_var_s[0].numNodeIdOfLastMsg "CanNm_var_s (implementation in generated c-source in cannm_auto_conf.c) / node id of last received NM-message" UBYTE X1_M 1 100 0 255 FORMAT "%5.1" ECU_ADDRESS 0xFFF94587 /end MEASUREMENT
/begin MEASUREMENT CAN_AVL_DT_MOT_1 " F2062: CAN_AVL_DT_MOT_1 (internal only)" UBYTE X1_M 1 100 0 255 FORMAT "%5.1" ARRAY_SIZE 15 ECU_ADDRESS 0xFFF84628 /end MEASUREMENT
/begin MEASUREMENT CAN_AVL_DT_MOT_1_COMP " F2062: CAN_AVL_DT_MOT_1 complement buffer" UBYTE X1_M 1 100 0 255 FORMAT "%5.1" ARRAY_SIZE 8 ECU_ADDRESS 0xFFF9438C /end MEASUREMENT
/begin MEASUREMENT CAN_AVL_DT_MOT_1_COMPSTA " F2062: CAN_AVL_DT_MOT_1_COMPSTA (internal only)" UBYTE X1_M 1 100 0 255 FORMAT "%5.1" ARRAY_SIZE 7 ECU_ADDRESS 0xFFF84620 /end MEASUREMENT
/begin MEASUREMENT CAN_AVL_DT_MOT_1_DATA " F2062: CAN_AVL_DT_MOT_1 valid buffer" UBYTE X1_M 1 100 0 255 FORMAT "%5.1" ARRAY_SIZE 8 ECU_ADDRESS 0xFFF84618 /end MEASUREMENT
/begin MEASUREMENT CAN_AVL_DT_MOT_1_RAW " F2062: CAN_AVL_DT_MOT_1 raw buffer" UBYTE X1_M 1 100 0 255 FORMAT "%5.1" ARRAY_SIZE 8 ECU_ADDRESS 0xFFF94384 /end MEASUREMENT
/begin MEASUREMENT CAN_bBusOff "F2063: CAN busoff flag" UBYTE B_TRUE_M 1 100 0 1 FORMAT "%13.11" ARRAY_SIZE 2 ECU_ADDRESS 0xFFF94E8C /end MEASUREMENT
/begin MEASUREMENT CAN_bErrPas "F2063: CAN error passive flag" UBYTE B_TRUE_M 1 100 0 1 FORMAT "%13.11" ARRAY_SIZE 2 ECU_ADDRESS 0xFFF94E8E /end MEASUREMENT
/begin MEASUREMENT CAN_DIAG_OBD_ENG " F2062: CAN_DIAG_OBD_ENG (internal only)" UBYTE X1_M 1 100 0 255 FORMAT "%5.1" ARRAY_SIZE 15 ECU_ADDRESS 0xFFF84640 /end MEASUREMENT
/begin MEASUREMENT CAN_DIAG_OBD_ENG_DATA " F2062: CAN_DIAG_OBD_ENG valid buffer" UBYTE X1_M 1 100 0 255 FORMAT "%5.1" ARRAY_SIZE 8 ECU_ADDRESS 0xFFF84638 /end MEASUREMENT
/begin MEASUREMENT CAN_DIAG_OBD_ENG_RAW " F2062: CAN_DIAG_OBD_ENG raw buffer" UBYTE X1_M 1 100 0 255 FORMAT "%5.1" ARRAY_SIZE 8 ECU_ADDRESS 0xFFF94394 /end MEASUREMENT
/begin MEASUREMENT CAN_DIAG_OBD_GRB " F2062: CAN_DIAG_OBD_GRB (internal only)" UBYTE X1_M 1 100 0 255 FORMAT "%5.1" ARRAY_SIZE 15 ECU_ADDRESS 0xFFF847F0 /end MEASUREMENT
/begin MEASUREMENT CAN_DIAG_OBD_GRB_DATA " F2062: CAN_DIAG_OBD_GRB valid buffer" UBYTE X1_M 1 100 0 255 FORMAT "%5.1" ARRAY_SIZE 8 ECU_ADDRESS 0xFFF847E0 /end MEASUREMENT
/begin MEASUREMENT CAN_DIAG_OBD_GRB_RAW " F2062: CAN_DIAG_OBD_GRB raw buffer" UBYTE X1_M 1 100 0 255 FORMAT "%5.1" ARRAY_SIZE 8 ECU_ADDRESS 0xFFF847E8 /end MEASUREMENT
/begin MEASUREMENT CAN_DISP_RPM_ENG_DYNS " F2062: CAN_DISP_RPM_ENG_DYNS (internal only)" UBYTE X1_M 1 100 0 255 FORMAT "%5.1" ARRAY_SIZE 15 ECU_ADDRESS 0xFFF84808 /end MEASUREMENT
/begin MEASUREMENT CAN_DISP_RPM_ENG_DYNS_DATA " F2062: CAN_DISP_RPM_ENG_DYNS valid buffer" UBYTE X1_M 1 100 0 255 FORMAT "%5.1" ARRAY_SIZE 8 ECU_ADDRESS 0xFFF84800 /end MEASUREMENT
/begin MEASUREMENT CAN_DT_DISP_GRDT " F2062: CAN_DT_DISP_GRDT (internal only)" UBYTE X1_M 1 100 0 255 FORMAT "%5.1" ARRAY_SIZE 15 ECU_ADDRESS 0xFFF84828 /end MEASUREMENT
/begin MEASUREMENT CAN_DT_DISP_GRDT_DATA " F2062: CAN_DT_DISP_GRDT valid buffer" UBYTE X1_M 1 100 0 255 FORMAT "%5.1" ARRAY_SIZE 8 ECU_ADDRESS 0xFFF84818 /end MEASUREMENT
/begin MEASUREMENT CAN_DT_DISP_GRDT_RAW " F2062: CAN_DT_DISP_GRDT raw buffer" UBYTE X1_M 1 100 0 255 FORMAT "%5.1" ARRAY_SIZE 8 ECU_ADDRESS 0xFFF84820 /end MEASUREMENT
/begin MEASUREMENT CAN_DT_DRV_EL " F2062: CAN_DT_DRV_EL (internal only)" UBYTE X1_M 1 100 0 255 FORMAT "%5.1" ARRAY_SIZE 15 ECU_ADDRESS 0xFFF84658 /end MEASUREMENT
/begin MEASUREMENT CAN_DT_DRV_EL_DATA " F2062: CAN_DT_DRV_EL valid buffer" UBYTE X1_M 1 100 0 255 FORMAT "%5.1" ARRAY_SIZE 8 ECU_ADDRESS 0xFFF84650 /end MEASUREMENT
/begin MEASUREMENT CAN_DT_DRV_EL_RAW " F2062: CAN_DT_DRV_EL raw buffer" UBYTE X1_M 1 100 0 255 FORMAT "%5.1" ARRAY_SIZE 8 ECU_ADDRESS 0xFFF9439C /end MEASUREMENT
/begin MEASUREMENT CAN_DT_GRDT " F2062: CAN_DT_GRDT (internal only)" UBYTE X1_M 1 100 0 255 FORMAT "%5.1" ARRAY_SIZE 15 ECU_ADDRESS 0xFFF84840 /end MEASUREMENT
/begin MEASUREMENT CAN_DT_GRDT_DATA " F2062: CAN_DT_GRDT valid buffer" UBYTE X1_M 1 100 0 255 FORMAT "%5.1" ARRAY_SIZE 8 ECU_ADDRESS 0xFFF84838 /end MEASUREMENT
/begin MEASUREMENT CAN_DT_PT_2 " F2062: CAN_DT_PT_2 (internal only)" UBYTE X1_M 1 100 0 255 FORMAT "%5.1" ARRAY_SIZE 15 ECU_ADDRESS 0xFFF84678 /end MEASUREMENT
/begin MEASUREMENT CAN_DT_PT_2_COMP " F2062: CAN_DT_PT_2 complement buffer" UBYTE X1_M 1 100 0 255 FORMAT "%5.1" ARRAY_SIZE 8 ECU_ADDRESS 0xFFF943AC /end MEASUREMENT
/begin MEASUREMENT CAN_DT_PT_2_COMPSTA " F2062: CAN_DT_PT_2_COMPSTA (internal only)" UBYTE X1_M 1 100 0 255 FORMAT "%5.1" ARRAY_SIZE 7 ECU_ADDRESS 0xFFF84670 /end MEASUREMENT
/begin MEASUREMENT CAN_DT_PT_2_DATA " F2062: CAN_DT_PT_2 valid buffer" UBYTE X1_M 1 100 0 255 FORMAT "%5.1" ARRAY_SIZE 8 ECU_ADDRESS 0xFFF84668 /end MEASUREMENT
/begin MEASUREMENT CAN_DT_PT_2_RAW " F2062: CAN_DT_PT_2 raw buffer" UBYTE X1_M 1 100 0 255 FORMAT "%5.1" ARRAY_SIZE 8 ECU_ADDRESS 0xFFF943A4 /end MEASUREMENT
/begin MEASUREMENT can_flags "F2671: CAN driver internal flags (B0:node disabled, B3:ACK-error, B4:Bus-disconnect-detect) (internal only)" UBYTE X1_M 1 100 0 255 FORMAT "%5.1" ARRAY_SIZE 3 ECU_ADDRESS 0xFFF95C2D /end MEASUREMENT
/begin MEASUREMENT CAN_FLLUPT_GPWSUP " F2062: CAN_FLLUPT_GPWSUP (internal only)" UBYTE X1_M 1 100 0 255 FORMAT "%5.1" ARRAY_SIZE 15 ECU_ADDRESS 0xFFF84690 /end MEASUREMENT
/begin MEASUREMENT CAN_FLLUPT_GPWSUP_DATA " F2062: CAN_FLLUPT_GPWSUP valid buffer" UBYTE X1_M 1 100 0 255 FORMAT "%5.1" ARRAY_SIZE 8 ECU_ADDRESS 0xFFF84688 /end MEASUREMENT
/begin MEASUREMENT CAN_FLLUPT_GPWSUP_RAW " F2062: CAN_FLLUPT_GPWSUP raw buffer" UBYTE X1_M 1 100 0 255 FORMAT "%5.1" ARRAY_SIZE 8 ECU_ADDRESS 0xFFF943B4 /end MEASUREMENT
/begin MEASUREMENT CAN_HYB_SPEC " F2062: CAN_HYB_SPEC (internal only)" UBYTE X1_M 1 100 0 255 FORMAT "%5.1" ARRAY_SIZE 15 ECU_ADDRESS 0xFFF846B0 /end MEASUREMENT
/begin MEASUREMENT CAN_HYB_SPEC_COMP " F2062: CAN_HYB_SPEC complement buffer" UBYTE X1_M 1 100 0 255 FORMAT "%5.1" ARRAY_SIZE 8 ECU_ADDRESS 0xFFF943C4 /end MEASUREMENT
/begin MEASUREMENT CAN_HYB_SPEC_COMPSTA " F2062: CAN_HYB_SPEC_COMPSTA (internal only)" UBYTE X1_M 1 100 0 255 FORMAT "%5.1" ARRAY_SIZE 7 ECU_ADDRESS 0xFFF846A8 /end MEASUREMENT
/begin MEASUREMENT CAN_HYB_SPEC_DATA " F2062: CAN_HYB_SPEC valid buffer" UBYTE X1_M 1 100 0 255 FORMAT "%5.1" ARRAY_SIZE 8 ECU_ADDRESS 0xFFF846A0 /end MEASUREMENT
/begin MEASUREMENT CAN_HYB_SPEC_RAW " F2062: CAN_HYB_SPEC raw buffer" UBYTE X1_M 1 100 0 255 FORMAT "%5.1" ARRAY_SIZE 8 ECU_ADDRESS 0xFFF943BC /end MEASUREMENT
/begin MEASUREMENT can_msgbuffers_enabled "F2671: bitmask of CAN message buffers enabled (0=disabled, 1=enabled) (internal)" ULONG X1_M 1 100 0 4294967295 FORMAT "%13.2" ARRAY_SIZE 3 ECU_ADDRESS 0xFFF95A68 /end MEASUREMENT
/begin MEASUREMENT can_msgbuffers_extid "F2671: CAN bitmask extended ID (0=STD, 1=EXT)" ULONG X1_M 1 100 0 4294967295 FORMAT "%13.2" ARRAY_SIZE 3 ECU_ADDRESS 0xFFF95A80 /end MEASUREMENT
/begin MEASUREMENT can_msgbuffers_rxtx "F2671: CAN bitmask RX/TX direction (0=RX, 1=TX)" ULONG X1_M 1 100 0 4294967295 FORMAT "%13.2" ARRAY_SIZE 3 ECU_ADDRESS 0xFFF95A74 /end MEASUREMENT
/begin MEASUREMENT Can_MsgBuffer_u8 "F2675: CAN buffer assigned to a message object (BIT765:CAN-node, Bit0-4:message buffer no.) (the number of actually available objects might be less) (internal only)" UBYTE X1_M 1 100 0 255 FORMAT "%5.1" ARRAY_SIZE 256 ECU_ADDRESS 0xFFF958FA /end MEASUREMENT
/begin MEASUREMENT Can_MsgInBuffer_u16 "F2675: Message object number assigned to a physical CAN buffer (CANA:idx=0-31,CANB:idx=32-63,CANC:idx=64-95) (internal only)" UWORD X1_M 1 100 0 65535 FORMAT "%8.2" ARRAY_SIZE 96 ECU_ADDRESS 0xFFF956DC /end MEASUREMENT
/begin MEASUREMENT can_msginterrupts "F2671: CAN Buffer interrupt enabled bitmask (0=disabled, 1=enabled)" ULONG X1_M 1 100 0 4294967295 FORMAT "%13.2" ARRAY_SIZE 3 ECU_ADDRESS 0xFFF95A8C /end MEASUREMENT
/begin MEASUREMENT Can_MsgStatus_u8 "F2675: status of a CAN message object (B2:disabled, B3:node-TX-stop) (internal only)" UBYTE X1_M 1 100 0 255 FORMAT "%5.1" ARRAY_SIZE 256 ECU_ADDRESS 0xFFF95967 /end MEASUREMENT
/begin MEASUREMENT Can_NodeBaudrate_u32 "F2675: Current node baudrate (in Baud) (internal only)" ULONG X1_M 1 100 0 4294967295 FORMAT "%13.2" ARRAY_SIZE 3 ECU_ADDRESS 0xFFF957BC /end MEASUREMENT
/begin MEASUREMENT can_nodeinterruptmask "F2671: CAN node interrupt mask (low-active!) (corresponds to IMR register)" UWORD X1_M 1 100 0 65535 FORMAT "%8.2" ARRAY_SIZE 3 ECU_ADDRESS 0xFFF95C1E /end MEASUREMENT
/begin MEASUREMENT can_nodestate_cur "F2671: current CAN node state (0=HALT, 2=LISTEN, 3=NORMAL, +16=NOTX  +128=transition)" UBYTE X1_M 1 100 0 255 FORMAT "%5.1" ARRAY_SIZE 3 ECU_ADDRESS 0xFFF95C33 /end MEASUREMENT
/begin MEASUREMENT can_nodestate_req "F2671: requested CAN node state (0=HALT, 2=LISTEN, 3=NORMAL)" UBYTE X1_M 1 100 0 255 FORMAT "%5.1" ARRAY_SIZE 3 ECU_ADDRESS 0xFFF95C36 /end MEASUREMENT
/begin MEASUREMENT Can_NodeStatus_u16 "F2675: Current node status B0:Busoff,B1:Error-Warn,B8:Node disable,B9:TX-off (internal only)" UWORD X1_M 1 100 0 65535 FORMAT "%8.2" ARRAY_SIZE 3 ECU_ADDRESS 0xFFF958F2 /end MEASUREMENT
/begin MEASUREMENT can_node_operationmode "F2671: CAN node operation mode (0=HALT, 2=LISTEN, 3=NORMAL)" UBYTE X1_M 1 100 0 255 FORMAT "%5.1" ARRAY_SIZE 3 ECU_ADDRESS 0xFFF95C30 /end MEASUREMENT
/begin MEASUREMENT CAN_PSBTY_ENGSTA_ENSTP " F2062: CAN_PSBTY_ENGSTA_ENSTP (internal only)" UBYTE X1_M 1 100 0 255 FORMAT "%5.1" ARRAY_SIZE 15 ECU_ADDRESS 0xFFF846C8 /end MEASUREMENT
/begin MEASUREMENT CAN_PSBTY_ENGSTA_ENSTP_DATA " F2062: CAN_PSBTY_ENGSTA_ENSTP valid buffer" UBYTE X1_M 1 100 0 255 FORMAT "%5.1" ARRAY_SIZE 8 ECU_ADDRESS 0xFFF846C0 /end MEASUREMENT
/begin MEASUREMENT CAN_PSBTY_ENGSTA_ENSTP_RAW " F2062: CAN_PSBTY_ENGSTA_ENSTP raw buffer" UBYTE X1_M 1 100 0 255 FORMAT "%5.1" ARRAY_SIZE 8 ECU_ADDRESS 0xFFF943CC /end MEASUREMENT
/begin MEASUREMENT CAN_RQ_TORQ_CRSH_GRB " F2062: CAN_RQ_TORQ_CRSH_GRB (internal only)" UBYTE X1_M 1 100 0 255 FORMAT "%5.1" ARRAY_SIZE 15 ECU_ADDRESS 0xFFF84858 /end MEASUREMENT
/begin MEASUREMENT CAN_RQ_TORQ_CRSH_GRB_2 " F2062: CAN_RQ_TORQ_CRSH_GRB_2 (internal only)" UBYTE X1_M 1 100 0 255 FORMAT "%5.1" ARRAY_SIZE 15 ECU_ADDRESS 0xFFF84870 /end MEASUREMENT
/begin MEASUREMENT CAN_RQ_TORQ_CRSH_GRB_2_DATA " F2062: CAN_RQ_TORQ_CRSH_GRB_2 valid buffer" UBYTE X1_M 1 100 0 255 FORMAT "%5.1" ARRAY_SIZE 8 ECU_ADDRESS 0xFFF84868 /end MEASUREMENT
/begin MEASUREMENT CAN_RQ_TORQ_CRSH_GRB_DATA " F2062: CAN_RQ_TORQ_CRSH_GRB valid buffer" UBYTE X1_M 1 100 0 255 FORMAT "%5.1" ARRAY_SIZE 8 ECU_ADDRESS 0xFFF84850 /end MEASUREMENT
/begin MEASUREMENT CAN_SPEC_HVSTO " F2062: CAN_SPEC_HVSTO (internal only)" UBYTE X1_M 1 100 0 255 FORMAT "%5.1" ARRAY_SIZE 15 ECU_ADDRESS 0xFFF846E0 /end MEASUREMENT
/begin MEASUREMENT CAN_SPEC_HVSTO_DATA " F2062: CAN_SPEC_HVSTO valid buffer" UBYTE X1_M 1 100 0 255 FORMAT "%5.1" ARRAY_SIZE 8 ECU_ADDRESS 0xFFF846D8 /end MEASUREMENT
/begin MEASUREMENT CAN_SPEC_HVSTO_RAW " F2062: CAN_SPEC_HVSTO raw buffer" UBYTE X1_M 1 100 0 255 FORMAT "%5.1" ARRAY_SIZE 8 ECU_ADDRESS 0xFFF943D4 /end MEASUREMENT
/begin MEASUREMENT CAN_SPEC_TORQ_TRCT_LT " F2062: CAN_SPEC_TORQ_TRCT_LT (internal only)" UBYTE X1_M 1 100 0 255 FORMAT "%5.1" ARRAY_SIZE 15 ECU_ADDRESS 0xFFF846F8 /end MEASUREMENT
/begin MEASUREMENT CAN_SPEC_TORQ_TRCT_LT_DATA " F2062: CAN_SPEC_TORQ_TRCT_LT valid buffer" UBYTE X1_M 1 100 0 255 FORMAT "%5.1" ARRAY_SIZE 8 ECU_ADDRESS 0xFFF846F0 /end MEASUREMENT
/begin MEASUREMENT CAN_SPEC_TORQ_TRCT_LT_RAW " F2062: CAN_SPEC_TORQ_TRCT_LT raw buffer" UBYTE X1_M 1 100 0 255 FORMAT "%5.1" ARRAY_SIZE 8 ECU_ADDRESS 0xFFF943DC /end MEASUREMENT
/begin MEASUREMENT CAN_STAT_ENG_STA_AUTO " F2062: CAN_STAT_ENG_STA_AUTO (internal only)" UBYTE X1_M 1 100 0 255 FORMAT "%5.1" ARRAY_SIZE 15 ECU_ADDRESS 0xFFF84750 /end MEASUREMENT
/begin MEASUREMENT CAN_STAT_ENG_STA_AUTO_COMP " F2062: CAN_STAT_ENG_STA_AUTO complement buffer" UBYTE X1_M 1 100 0 255 FORMAT "%5.1" ARRAY_SIZE 8 ECU_ADDRESS 0xFFF94404 /end MEASUREMENT
/begin MEASUREMENT CAN_STAT_ENG_STA_AUTO_COMPSTA " F2062: CAN_STAT_ENG_STA_AUTO_COMPSTA (internal only)" UBYTE X1_M 1 100 0 255 FORMAT "%5.1" ARRAY_SIZE 7 ECU_ADDRESS 0xFFF84748 /end MEASUREMENT
/begin MEASUREMENT CAN_STAT_ENG_STA_AUTO_DATA " F2062: CAN_STAT_ENG_STA_AUTO valid buffer" UBYTE X1_M 1 100 0 255 FORMAT "%5.1" ARRAY_SIZE 8 ECU_ADDRESS 0xFFF84740 /end MEASUREMENT
/begin MEASUREMENT CAN_STAT_ENG_STA_AUTO_RAW " F2062: CAN_STAT_ENG_STA_AUTO raw buffer" UBYTE X1_M 1 100 0 255 FORMAT "%5.1" ARRAY_SIZE 8 ECU_ADDRESS 0xFFF943FC /end MEASUREMENT
/begin MEASUREMENT CAN_STAT_HVSTO_2 " F2062: CAN_STAT_HVSTO_2 (internal only)" UBYTE X1_M 1 100 0 255 FORMAT "%5.1" ARRAY_SIZE 15 ECU_ADDRESS 0xFFF84768 /end MEASUREMENT
/begin MEASUREMENT CAN_STAT_HVSTO_2_DATA " F2062: CAN_STAT_HVSTO_2 valid buffer" UBYTE X1_M 1 100 0 255 FORMAT "%5.1" ARRAY_SIZE 8 ECU_ADDRESS 0xFFF84760 /end MEASUREMENT
/begin MEASUREMENT CAN_STAT_HVSTO_2_RAW " F2062: CAN_STAT_HVSTO_2 raw buffer" UBYTE X1_M 1 100 0 255 FORMAT "%5.1" ARRAY_SIZE 8 ECU_ADDRESS 0xFFF9440C /end MEASUREMENT
/begin MEASUREMENT CAN_stBusOff "F2063: internal CAN busoff status" UBYTE X1_M 1 100 0 255 FORMAT "%5.1" ARRAY_SIZE 2 ECU_ADDRESS 0xFFF94E90 /end MEASUREMENT
/begin MEASUREMENT CAN_stErrPas "F2063: internal CAN error passive status" UBYTE X1_M 1 100 0 255 FORMAT "%5.1" ARRAY_SIZE 2 ECU_ADDRESS 0xFFF94E92 /end MEASUREMENT
/begin MEASUREMENT CAN_stLine "F2063: actual state of CAN lines" UWORD X1_M 1 100 0 65535 FORMAT "%8.2" ARRAY_SIZE 2 ECU_ADDRESS 0xFFF9474C /end MEASUREMENT
/begin MEASUREMENT CAN_ST_GRB_ECU " F2062: CAN_ST_GRB_ECU (internal only)" UBYTE X1_M 1 100 0 255 FORMAT "%5.1" ARRAY_SIZE 15 ECU_ADDRESS 0xFFF84890 /end MEASUREMENT
/begin MEASUREMENT CAN_ST_GRB_ECU_DATA " F2062: CAN_ST_GRB_ECU valid buffer" UBYTE X1_M 1 100 0 255 FORMAT "%5.1" ARRAY_SIZE 8 ECU_ADDRESS 0xFFF84880 /end MEASUREMENT
/begin MEASUREMENT CAN_ST_GRB_ECU_RAW " F2062: CAN_ST_GRB_ECU raw buffer" UBYTE X1_M 1 100 0 255 FORMAT "%5.1" ARRAY_SIZE 8 ECU_ADDRESS 0xFFF84888 /end MEASUREMENT
/begin MEASUREMENT CAN_ST_GRB_HYB " F2062: CAN_ST_GRB_HYB (internal only)" UBYTE X1_M 1 100 0 255 FORMAT "%5.1" ARRAY_SIZE 15 ECU_ADDRESS 0xFFF848B0 /end MEASUREMENT
/begin MEASUREMENT CAN_ST_GRB_HYB_DATA " F2062: CAN_ST_GRB_HYB valid buffer" UBYTE X1_M 1 100 0 255 FORMAT "%5.1" ARRAY_SIZE 8 ECU_ADDRESS 0xFFF848A0 /end MEASUREMENT
/begin MEASUREMENT CAN_ST_GRB_HYB_RAW " F2062: CAN_ST_GRB_HYB raw buffer" UBYTE X1_M 1 100 0 255 FORMAT "%5.1" ARRAY_SIZE 8 ECU_ADDRESS 0xFFF848A8 /end MEASUREMENT
/begin MEASUREMENT CAN_ST_GWS " F2062: CAN_ST_GWS (internal only)" UBYTE X1_M 1 100 0 255 FORMAT "%5.1" ARRAY_SIZE 15 ECU_ADDRESS 0xFFF84718 /end MEASUREMENT
/begin MEASUREMENT CAN_ST_GWS_COMP " F2062: CAN_ST_GWS complement buffer" UBYTE X1_M 1 100 0 255 FORMAT "%5.1" ARRAY_SIZE 8 ECU_ADDRESS 0xFFF943EC /end MEASUREMENT
/begin MEASUREMENT CAN_ST_GWS_COMPSTA " F2062: CAN_ST_GWS_COMPSTA (internal only)" UBYTE X1_M 1 100 0 255 FORMAT "%5.1" ARRAY_SIZE 7 ECU_ADDRESS 0xFFF84710 /end MEASUREMENT
/begin MEASUREMENT CAN_ST_GWS_DATA " F2062: CAN_ST_GWS valid buffer" UBYTE X1_M 1 100 0 255 FORMAT "%5.1" ARRAY_SIZE 8 ECU_ADDRESS 0xFFF84708 /end MEASUREMENT
/begin MEASUREMENT CAN_ST_GWS_RAW " F2062: CAN_ST_GWS raw buffer" UBYTE X1_M 1 100 0 255 FORMAT "%5.1" ARRAY_SIZE 8 ECU_ADDRESS 0xFFF943E4 /end MEASUREMENT
/begin MEASUREMENT CAN_ST_HYB_2 " F2062: CAN_ST_HYB_2 (internal only)" UBYTE X1_M 1 100 0 255 FORMAT "%5.1" ARRAY_SIZE 15 ECU_ADDRESS 0xFFF84730 /end MEASUREMENT
/begin MEASUREMENT CAN_ST_HYB_2_DATA " F2062: CAN_ST_HYB_2 valid buffer" UBYTE X1_M 1 100 0 255 FORMAT "%5.1" ARRAY_SIZE 8 ECU_ADDRESS 0xFFF84728 /end MEASUREMENT
/begin MEASUREMENT CAN_ST_HYB_2_RAW " F2062: CAN_ST_HYB_2 raw buffer" UBYTE X1_M 1 100 0 255 FORMAT "%5.1" ARRAY_SIZE 8 ECU_ADDRESS 0xFFF943F4 /end MEASUREMENT
/begin MEASUREMENT CAN_TAR_DT_GRB_MOT_1 " F2062: CAN_TAR_DT_GRB_MOT_1 (internal only)" UBYTE X1_M 1 100 0 255 FORMAT "%5.1" ARRAY_SIZE 15 ECU_ADDRESS 0xFFF848C8 /end MEASUREMENT
/begin MEASUREMENT CAN_TAR_DT_GRB_MOT_1_DATA " F2062: CAN_TAR_DT_GRB_MOT_1 valid buffer" UBYTE X1_M 1 100 0 255 FORMAT "%5.1" ARRAY_SIZE 8 ECU_ADDRESS 0xFFF848C0 /end MEASUREMENT
/begin MEASUREMENT CAN_tiBusOff "F2063: CAN busoff timer" UWORD TI1_M_CYCLE_M 1 100 0 327675 FORMAT "%8.1" ARRAY_SIZE 2 ECU_ADDRESS 0xFFF95C50 /end MEASUREMENT
/begin MEASUREMENT CAN_tiErrPas "F2063: CAN error passive timer" UWORD TI1_M_CYCLE_M 1 100 0 327675 FORMAT "%8.1" ARRAY_SIZE 2 ECU_ADDRESS 0xFFF95C54 /end MEASUREMENT
/begin MEASUREMENT Can_tiEventMsgDelayDIAG_OBD_GRB "F2055: Timer debounce time for message DIAG_OBD_GRB (A-CAN)" UBYTE TI1_M_CYCLE_M 1 100 0 1275 FORMAT "%5.0" ECU_ADDRESS 0xFFF95D32 /end MEASUREMENT
/begin MEASUREMENT Can_tiEventMsgDelayDT_DISP_GRDT "F2055: Timer debounce time for message DT_DISP_GRDT (A-CAN)" UBYTE TI1_M_CYCLE_M 1 100 0 1275 FORMAT "%5.0" ECU_ADDRESS 0xFFF95D33 /end MEASUREMENT
/begin MEASUREMENT Can_tiEventMsgDelayST_GRB_ECU "F2055: Timer debounce time for message ST_GRB_ECU (A-CAN)" UBYTE TI1_M_CYCLE_M 1 100 0 1275 FORMAT "%5.0" ECU_ADDRESS 0xFFF95D34 /end MEASUREMENT
/begin MEASUREMENT Can_tiEventMsgDelayST_GRB_HYB "F2055: Timer debounce time for message ST_GRB_HYB (A-CAN)" UBYTE TI1_M_CYCLE_M 1 100 0 1275 FORMAT "%5.0" ECU_ADDRESS 0xFFF95D35 /end MEASUREMENT
/begin MEASUREMENT CAN_TORQ_CRSH_2 " F2062: CAN_TORQ_CRSH_2 (internal only)" UBYTE X1_M 1 100 0 255 FORMAT "%5.1" ARRAY_SIZE 15 ECU_ADDRESS 0xFFF84780 /end MEASUREMENT
/begin MEASUREMENT CAN_TORQ_CRSH_2_DATA " F2062: CAN_TORQ_CRSH_2 valid buffer" UBYTE X1_M 1 100 0 255 FORMAT "%5.1" ARRAY_SIZE 8 ECU_ADDRESS 0xFFF84778 /end MEASUREMENT
/begin MEASUREMENT CAN_TORQ_CRSH_2_RAW " F2062: CAN_TORQ_CRSH_2 raw buffer" UBYTE X1_M 1 100 0 255 FORMAT "%5.1" ARRAY_SIZE 8 ECU_ADDRESS 0xFFF94414 /end MEASUREMENT
/begin MEASUREMENT CAN_TORQ_CRSH_3 " F2062: CAN_TORQ_CRSH_3 (internal only)" UBYTE X1_M 1 100 0 255 FORMAT "%5.1" ARRAY_SIZE 15 ECU_ADDRESS 0xFFF847A0 /end MEASUREMENT
/begin MEASUREMENT CAN_TORQ_CRSH_3_COMP " F2062: CAN_TORQ_CRSH_3 complement buffer" UBYTE X1_M 1 100 0 255 FORMAT "%5.1" ARRAY_SIZE 8 ECU_ADDRESS 0xFFF94424 /end MEASUREMENT
/begin MEASUREMENT CAN_TORQ_CRSH_3_COMPSTA " F2062: CAN_TORQ_CRSH_3_COMPSTA (internal only)" UBYTE X1_M 1 100 0 255 FORMAT "%5.1" ARRAY_SIZE 7 ECU_ADDRESS 0xFFF84798 /end MEASUREMENT
/begin MEASUREMENT CAN_TORQ_CRSH_3_DATA " F2062: CAN_TORQ_CRSH_3 valid buffer" UBYTE X1_M 1 100 0 255 FORMAT "%5.1" ARRAY_SIZE 8 ECU_ADDRESS 0xFFF84790 /end MEASUREMENT
/begin MEASUREMENT CAN_TORQ_CRSH_3_RAW " F2062: CAN_TORQ_CRSH_3 raw buffer" UBYTE X1_M 1 100 0 255 FORMAT "%5.1" ARRAY_SIZE 8 ECU_ADDRESS 0xFFF9441C /end MEASUREMENT
/begin MEASUREMENT CAN_WMOM_DRV_3 " F2062: CAN_WMOM_DRV_3 (internal only)" UBYTE X1_M 1 100 0 255 FORMAT "%5.1" ARRAY_SIZE 15 ECU_ADDRESS 0xFFF847B8 /end MEASUREMENT
/begin MEASUREMENT CAN_WMOM_DRV_3_DATA " F2062: CAN_WMOM_DRV_3 valid buffer" UBYTE X1_M 1 100 0 255 FORMAT "%5.1" ARRAY_SIZE 8 ECU_ADDRESS 0xFFF847B0 /end MEASUREMENT
/begin MEASUREMENT CAN_WMOM_DRV_3_RAW " F2062: CAN_WMOM_DRV_3 raw buffer" UBYTE X1_M 1 100 0 255 FORMAT "%5.1" ARRAY_SIZE 8 ECU_ADDRESS 0xFFF9442C /end MEASUREMENT
/begin MEASUREMENT CAN_WMOM_DRV_7 " F2062: CAN_WMOM_DRV_7 (internal only)" UBYTE X1_M 1 100 0 255 FORMAT "%5.1" ARRAY_SIZE 15 ECU_ADDRESS 0xFFF847D0 /end MEASUREMENT
/begin MEASUREMENT CAN_WMOM_DRV_7_DATA " F2062: CAN_WMOM_DRV_7 valid buffer" UBYTE X1_M 1 100 0 255 FORMAT "%5.1" ARRAY_SIZE 8 ECU_ADDRESS 0xFFF847C8 /end MEASUREMENT
/begin MEASUREMENT CAN_WMOM_DRV_7_RAW " F2062: CAN_WMOM_DRV_7 raw buffer" UBYTE X1_M 1 100 0 255 FORMAT "%5.1" ARRAY_SIZE 8 ECU_ADDRESS 0xFFF94434 /end MEASUREMENT
/begin MEASUREMENT CNE_cfMsgRx "F2050: Reception acknowledege for at least one CAN message in the last 10 ms cycle" UBYTE X1_M 1 100 0 255 FORMAT "%5.1" ECU_ADDRESS 0xFFF9556C /end MEASUREMENT
/begin MEASUREMENT ComCtl_stIfcTxCom "F4480: interface for Tx control handled by COM" UBYTE X1_M 1 100 0 255 FORMAT "%5.1" ECU_ADDRESS 0xFFF951CA /end MEASUREMENT
/begin MEASUREMENT ComCtl_stLstRun "F4480: state of last run" UBYTE X1_M 1 100 0 255 FORMAT "%5.1" ECU_ADDRESS 0xFFF951CB /end MEASUREMENT
/begin MEASUREMENT ComCtl_stRxTxCom "F4480: array for communication control handled by COM" UBYTE X1_M 1 100 0 255 FORMAT "%5.1" ARRAY_SIZE 24 ECU_ADDRESS 0xFFF93E5C /end MEASUREMENT
/begin MEASUREMENT ComCtl_stRxTxNm "F4480: array for communication control handled by NM" UBYTE X1_M 1 100 0 255 FORMAT "%5.1" ARRAY_SIZE 24 ECU_ADDRESS 0xFFF93E74 /end MEASUREMENT
/begin MEASUREMENT ComCtl_stRxTxUsd "F4480: used array for communication control" UBYTE X1_M 1 100 0 255 FORMAT "%5.1" ARRAY_SIZE 24 ECU_ADDRESS 0xFFF93E8C /end MEASUREMENT
/begin MEASUREMENT I14229_stOrigInit "F4100: state of original initialisation MISC channel" UBYTE X1_M 1 100 0 255 FORMAT "%5.1" ECU_ADDRESS 0xFFF9518C /end MEASUREMENT
/begin MEASUREMENT I14229_xInitDne "F4100: MISC channel initialisation done" UBYTE X1_M 1 100 0 255 FORMAT "%5.1" ECU_ADDRESS 0xFFF9518D /end MEASUREMENT
/begin MEASUREMENT IO_ctmsgNM_ACAN "F4450: counter for NM message" UBYTE X1_M 1 100 0 255 FORMAT "%5.1" ECU_ADDRESS 0xFFF9556A /end MEASUREMENT
/begin MEASUREMENT IO_ctmsgNM_FACAN "F4450: counter for NM message" UBYTE X1_M 1 100 0 255 FORMAT "%5.1" ECU_ADDRESS 0xFFF9556B /end MEASUREMENT
/begin MEASUREMENT LinAppl_Ifc_CusRx2MsgID "F4612: Array holds the Rx IDs for the corresponding customer Rx indices.0xFF means that there is no association. " UBYTE X1_M 1 100 0 255 FORMAT "%5.1" ARRAY_SIZE 8 ECU_ADDRESS 0xFFF93D38 /end MEASUREMENT
/begin MEASUREMENT LinAppl_Ifc_CusRx2MsgID_Size "F4612: Holds the number of customer Rx message indices " UBYTE X1_M 1 100 0 255 FORMAT "%5.1" ECU_ADDRESS 0xFFF95190 /end MEASUREMENT
/begin MEASUREMENT LinAppl_Ifc_CustRx2RbIdx "F4612: Array holds the Rb Frame indices for the customer reception index which is associated to the index of the Rb internal view.0xFF means that there is no association. " UBYTE X1_M 1 100 0 255 FORMAT "%5.1" ARRAY_SIZE 8 ECU_ADDRESS 0xFFF93D40 /end MEASUREMENT
/begin MEASUREMENT LinAppl_Ifc_CustTx2RbIdx "F4612: Array holds the Rb Frame indices for the customer transmission index which is associated to the Rb index.0xFF means that there is no association. " UBYTE X1_M 1 100 0 255 FORMAT "%5.1" ARRAY_SIZE 8 ECU_ADDRESS 0xFFF93D48 /end MEASUREMENT
/begin MEASUREMENT LinAppl_Ifc_CusTx2MsgID "F4612: Array holds the Send IDs for the corresponding customer Tx indices.0xFF means that there is no association. " UBYTE X1_M 1 100 0 255 FORMAT "%5.1" ARRAY_SIZE 8 ECU_ADDRESS 0xFFF93D50 /end MEASUREMENT
/begin MEASUREMENT LinAppl_Ifc_CusTx2MsgID_Size "F4612: Holds the number of customer send message indices " UBYTE X1_M 1 100 0 255 FORMAT "%5.1" ECU_ADDRESS 0xFFF95191 /end MEASUREMENT
/begin MEASUREMENT LinAppl_Ifc_LstFrmIdx "F4612: Index of the last finished frame ." UBYTE X1_M 1 100 0 255 FORMAT "%5.1" ECU_ADDRESS 0xFFF95192 /end MEASUREMENT
/begin MEASUREMENT LinAppl_Ifc_Rb2CustRx "F4612: Array holds the associated customer Rx indices for the corresponding Rb frame indices. 0xFF means that there is no association" UBYTE X1_M 1 100 0 255 FORMAT "%5.1" ARRAY_SIZE 8 ECU_ADDRESS 0xFFF93D58 /end MEASUREMENT
/begin MEASUREMENT LinAppl_Ifc_Rb2CustTx "F4612: Array holds the associated customer Tx indices for the corresponding Rb frame indices. 0xFF means that there is no association" UBYTE X1_M 1 100 0 255 FORMAT "%5.1" ARRAY_SIZE 8 ECU_ADDRESS 0xFFF93D60 /end MEASUREMENT
/begin MEASUREMENT LinAppl_Ifc_RxByteArrayBuf_au8 "F4612: Buffer for Rx Frames " UBYTE X1_M 1 100 0 255 FORMAT "%5.1" ARRAY_SIZE 9 ECU_ADDRESS 0xFFF95193 /end MEASUREMENT
/begin MEASUREMENT LinAppl_Ifc_stFRAME_LIN "F4612: State of LIN Xth - FRAME " UBYTE X1_M 1 100 0 255 FORMAT "%5.1" ARRAY_SIZE 11 ECU_ADDRESS 0xFFF84C62 /end MEASUREMENT
/begin MEASUREMENT LinAppl_Ifc_stFRAME_LIN_KOMP "F4612: Complement state of LIN Xth - FRAME " UBYTE X1_M 1 100 0 255 FORMAT "%5.1" ARRAY_SIZE 11 ECU_ADDRESS 0xFFF84C6D /end MEASUREMENT
/begin MEASUREMENT LinAppl_Ifc_stLstFrm "F4612: Provides the state of the last fully processed frame " UBYTE X1_M 1 100 0 255 FORMAT "%5.1" ECU_ADDRESS 0xFFF9519C /end MEASUREMENT
/begin MEASUREMENT LinAppl_Ifc_stRxMsg "F4612: State of Xth LIN Rx Message " UBYTE X1_M 1 100 0 255 FORMAT "%5.1" ARRAY_SIZE 8 ECU_ADDRESS 0xFFF84144 /end MEASUREMENT
/begin MEASUREMENT LinAppl_Ifc_TxByteArrayBuf_au8 "F4612: Buffer for Tx Frames " UBYTE X1_M 1 100 0 255 FORMAT "%5.1" ARRAY_SIZE 8 ECU_ADDRESS 0xFFF93D68 /end MEASUREMENT
/begin MEASUREMENT LinAppl_MlxsHndlr_bFaultMon "F4615: Result of fault monitoring of time out and low level faults. TRUE: Fault occured, FALSE: No fault." UBYTE B_TRUE_M 1 100 0 1 FORMAT "%13.11" ECU_ADDRESS 0xFFF9519D /end MEASUREMENT
/begin MEASUREMENT LinAppl_MlxsHndlr_Cmd_stCmdSt "F4615: Status of melexis command process" UBYTE X1_M 1 100 0 255 FORMAT "%5.1" ECU_ADDRESS 0xFFF84C7B /end MEASUREMENT
/begin MEASUREMENT LinAppl_MlxsHndlr_Cmd_stCom "F4615: Provides information if melexis communication process idle (0), send (1) or receive (2) is used" UBYTE X1_M 1 100 0 255 FORMAT "%5.1" ECU_ADDRESS 0xFFF951BC /end MEASUREMENT
/begin MEASUREMENT LinAppl_MlxsHndlr_Cmd_TempComDatBuf "F4615: Temporary communication buffer for Rx information needed for WrMem" UBYTE X1_M 1 100 0 255 FORMAT "%5.1" ARRAY_SIZE 4 ECU_ADDRESS 0xFFF94694 /end MEASUREMENT
/begin MEASUREMENT LinAppl_MlxsHndlr_ctPgPrgTry "F4615: Counter for attempts of programming a page" UBYTE X1_M 1 100 0 255 FORMAT "%5.1" ECU_ADDRESS 0xFFF84C78 /end MEASUREMENT
/begin MEASUREMENT LinAppl_MlxsHndlr_EepUpd_ctUpdTry "F4615: Counter for attempts of EEPROM updates" UBYTE X1_M 1 100 0 255 FORMAT "%5.1" ECU_ADDRESS 0xFFF954C6 /end MEASUREMENT
/begin MEASUREMENT LinAppl_MlxsHndlr_Exp_DmyIdx "F4615: Dummy index for definition of FKF, not used in C code" UBYTE X1_M 1 100 0 255 FORMAT "%5.1" ECU_ADDRESS 0xFFF951A0 /end MEASUREMENT
/begin MEASUREMENT LinAppl_MlxsHndlr_Exp_FlshLngth "F4615: Holds the length of the melexis flash section " UWORD X1_M 1 100 0 65535 FORMAT "%8.2" ECU_ADDRESS 0xFFF94DD2 /end MEASUREMENT
/begin MEASUREMENT LinAppl_MlxsHndlr_Exp_FlshPrgSt "F4615: Provides information about the status of the flash procedure. 0: Flash never started, 1: flashing active, 2: flash finished, verify running, 3: Verify success, 4: Verify Failed, 5: Flash failed" UBYTE X1_M 1 100 0 255 FORMAT "%5.1" ECU_ADDRESS 0xFFF951A1 /end MEASUREMENT
/begin MEASUREMENT LinAppl_MlxsHndlr_Exp_FlshPtr "F4615: Holds the pointer adress of the flash information for the melexis controller" ULONG X1_M 1 100 0 4294967295 FORMAT "%13.2" ECU_ADDRESS 0xFFF93E1C /end MEASUREMENT
/begin MEASUREMENT LinAppl_MlxsHndlr_Exp_RxDatBuf "F4615: Rx data buffer of melexis handler." UBYTE X1_M 1 100 0 255 FORMAT "%5.1" ARRAY_SIZE 128 ECU_ADDRESS 0xFFF93D74 /end MEASUREMENT
/begin MEASUREMENT LinAppl_MlxsHndlr_Exp_StrtFlshRqst "F4615: Provides information if start flash procedure was called " UBYTE X1_M 1 100 0 255 FORMAT "%5.1" ECU_ADDRESS 0xFFF951A2 /end MEASUREMENT
/begin MEASUREMENT LinAppl_MlxsHndlr_FaultMsk "F4615: Fault mask to inhibit expected low level driver faults" UBYTE X1_M 1 100 0 255 FORMAT "%5.1" ECU_ADDRESS 0xFFF9519E /end MEASUREMENT
/begin MEASUREMENT LinAppl_MlxsHndlr_FlshPgChsBak "F4615: Backup of the calculated CRC32 checksum for the current loader state" ULONG X1_M 1 100 0 4294967295 FORMAT "%13.2" ECU_ADDRESS 0xFFF93D70 /end MEASUREMENT
/begin MEASUREMENT LinAppl_MlxsHndlr_FlshPgRdChs "F4615: Array providing the calculated CRC32 checksum for the loader states 1,2,3 during readback" ULONG X1_M 1 100 0 4294967295 FORMAT "%13.2" ARRAY_SIZE 3 ECU_ADDRESS 0xFFF93DF4 /end MEASUREMENT
/begin MEASUREMENT LinAppl_MlxsHndlr_FlshPgWrtChs "F4615: Array providing the calculated CRC32 checksum for the loader states 1,2,3" ULONG X1_M 1 100 0 4294967295 FORMAT "%13.2" ARRAY_SIZE 3 ECU_ADDRESS 0xFFF93E00 /end MEASUREMENT
/begin MEASUREMENT LinAppl_MlxsHndlr_Read_FlshVer "F4615: Provides information about the flash loader version of the melexis controller" UBYTE X1_M 1 100 0 255 FORMAT "%5.1" ECU_ADDRESS 0xFFF951A3 /end MEASUREMENT
/begin MEASUREMENT LinAppl_MlxsHndlr_Read_LinVer "F4615: Provides information about the LIN software version of the melexis controller" UBYTE X1_M 1 100 0 255 FORMAT "%5.1" ECU_ADDRESS 0xFFF951A4 /end MEASUREMENT
/begin MEASUREMENT LinAppl_MlxsHndlr_Read_NAD "F4615:  NAD of received data  " UBYTE X1_M 1 100 0 255 FORMAT "%5.1" ECU_ADDRESS 0xFFF954CA /end MEASUREMENT
/begin MEASUREMENT LinAppl_MlxsHndlr_Read_numRxByt "F4615: Number of bytes received " UWORD X1_M 1 100 0 65535 FORMAT "%8.2" ECU_ADDRESS 0xFFF94E7A /end MEASUREMENT
/begin MEASUREMENT LinAppl_MlxsHndlr_Read_RxDatAsrt "F4615: Assertion flag comparing received data with expected data (FALSE: Assertion wrong TRUE:Assertion OK) " UBYTE B_TRUE_M 1 100 0 1 FORMAT "%13.11" ECU_ADDRESS 0xFFF954C8 /end MEASUREMENT
/begin MEASUREMENT LinAppl_MlxsHndlr_Read_RxFrmCntr "F4615: Number of frames received" UBYTE X1_M 1 100 0 255 FORMAT "%5.1" ECU_ADDRESS 0xFFF954C7 /end MEASUREMENT
/begin MEASUREMENT LinAppl_MlxsHndlr_Read_stErr "F4615: Provides information about the error state of the melexis device." UBYTE X1_M 1 100 0 255 FORMAT "%5.1" ECU_ADDRESS 0xFFF951A5 /end MEASUREMENT
/begin MEASUREMENT LinAppl_MlxsHndlr_Read_stErrCode "F4615: Provides information about the error code of the melexis device in case of an error response." UBYTE X1_M 1 100 0 255 FORMAT "%5.1" ECU_ADDRESS 0xFFF951A6 /end MEASUREMENT
/begin MEASUREMENT LinAppl_MlxsHndlr_Read_stLoad "F4615: Provides information about the loader state of the melexis device (0-3) crosscheck with LinAppl_MlxsHndlr_stSt." UBYTE X1_M 1 100 0 255 FORMAT "%5.1" ECU_ADDRESS 0xFFF951A7 /end MEASUREMENT
/begin MEASUREMENT LinAppl_MlxsHndlr_Read_stPrgMod "F4615: Provides information if melexis controller is in programming mode, 1: Device in programming mode" UBYTE X1_M 1 100 0 255 FORMAT "%5.1" ECU_ADDRESS 0xFFF951A8 /end MEASUREMENT
/begin MEASUREMENT LinAppl_MlxsHndlr_Read_stRead "F4615: Status of melexis read procedure " UBYTE X1_M 1 100 0 255 FORMAT "%5.1" ECU_ADDRESS 0xFFF954C9 /end MEASUREMENT
/begin MEASUREMENT LinAppl_MlxsHndlr_Read_stSt "F4615: Provides information about programming software status byte of the melexis controller, BIT0 +BIT1: Loader State (0-3), BIT7: (1: Error, 0: No error)." UBYTE X1_M 1 100 0 255 FORMAT "%5.1" ECU_ADDRESS 0xFFF951A9 /end MEASUREMENT
/begin MEASUREMENT LinAppl_MlxsHndlr_Send_numTxByt "F4615: Number of bytes transmitted " UWORD X1_M 1 100 0 65535 FORMAT "%8.2" ECU_ADDRESS 0xFFF94E7E /end MEASUREMENT
/begin MEASUREMENT LinAppl_MlxsHndlr_Send_stSend "F4615: Status of melexis send procedure " UBYTE X1_M 1 100 0 255 FORMAT "%5.1" ECU_ADDRESS 0xFFF954D2 /end MEASUREMENT
/begin MEASUREMENT LinAppl_MlxsHndlr_Send_TxFrmCntr "F4615: Frame transmission counter " UBYTE X1_M 1 100 0 255 FORMAT "%5.1" ECU_ADDRESS 0xFFF954CE /end MEASUREMENT
/begin MEASUREMENT LinAppl_MlxsHndlr_stLoadInit "F4615: Provides information about the loader state of the melexis device (0-3) during initiation of flash procedure.If no value was obtained 0xFF is reported (no init). " UBYTE X1_M 1 100 0 255 FORMAT "%5.1" ECU_ADDRESS 0xFFF84C79 /end MEASUREMENT
/begin MEASUREMENT LinAppl_MlxsHndlr_stLoadPre "F4615: Provides information about the loader state of the melexis device (0-3) as it is tracked by the tcu." UBYTE X1_M 1 100 0 255 FORMAT "%5.1" ECU_ADDRESS 0xFFF9519F /end MEASUREMENT
/begin MEASUREMENT LinAppl_MlxsHndlr_stProc "F4615: State melexis handler process" UBYTE X1_M 1 100 0 255 FORMAT "%5.1" ECU_ADDRESS 0xFFF9510A /end MEASUREMENT
/begin MEASUREMENT LinAppl_MlxsHndlr_stSerNum "F4615: Valid marker for IEP serial number (0xC5 = valid)" UBYTE X1_M 1 100 0 255 FORMAT "%5.1" ECU_ADDRESS 0xFFF80D23 /end MEASUREMENT
/begin MEASUREMENT LinAppl_MlxsHndlr_TOut "F4615: Time Out Counter to track maximum time for flashing " UWORD TI1_CYCLE_M 1 100 0 6553.5 FORMAT "%8.3" ECU_ADDRESS 0xFFF95C48 /end MEASUREMENT
/begin MEASUREMENT LinAppl_MlxsHndlr_WrMem_Adr "F4615: Adress used by melexis write memory process " ULONG X1_M 1 100 0 4294967295 FORMAT "%13.2" ECU_ADDRESS 0xFFF93E40 /end MEASUREMENT
/begin MEASUREMENT LinAppl_MlxsHndlr_WrMem_BlkSize "F4615: Provides information about the next block size that is allowed to be sent.0xFFFF means that nothing is expected" UWORD X1_M 1 100 0 65535 FORMAT "%8.2" ECU_ADDRESS 0xFFF94E76 /end MEASUREMENT
/begin MEASUREMENT LinAppl_MlxsHndlr_WrMem_Cmd "F4615: Melexis command issued to write memory (Eeprom 0x47, Flash 0x2X, RAM 0x0D)" UBYTE X1_M 1 100 0 255 FORMAT "%5.1" ECU_ADDRESS 0xFFF951C5 /end MEASUREMENT
/begin MEASUREMENT LinAppl_MlxsHndlr_WrMem_Length "F4615: Length of message to be written into melexis memory by WrMem procedure " UWORD X1_M 1 100 0 65535 FORMAT "%8.2" ECU_ADDRESS 0xFFF94DD8 /end MEASUREMENT
/begin MEASUREMENT LinAppl_MlxsHndlr_WrMem_LengthRmn "F4615: Bytes Remaining to be written to the melexis slave by WrMem procedure" UWORD X1_M 1 100 0 65535 FORMAT "%8.2" ECU_ADDRESS 0xFFF94DDA /end MEASUREMENT
/begin MEASUREMENT LinAppl_MlxsHndlr_WrMem_RmnDat "F4615: Provides information about the remaining data that is expected by the slave. 0xFFFF means that nothing is expected" UWORD X1_M 1 100 0 65535 FORMAT "%8.2" ECU_ADDRESS 0xFFF94E78 /end MEASUREMENT
/begin MEASUREMENT LinAppl_MlxsHndlr_WrMem_st "F4615: Status of WrMem Procedure " UBYTE X1_M 1 100 0 255 FORMAT "%5.1" ECU_ADDRESS 0xFFF84C81 /end MEASUREMENT
/begin MEASUREMENT LinAppl_MlxsHndlr_xSerNum "F4615: IEP serial number stored in the EEPROM of the melexis controller" UBYTE X1_M 1 100 0 255 FORMAT "%5.1" ARRAY_SIZE 8 ECU_ADDRESS 0xFFF80CF4 /end MEASUREMENT
/begin MEASUREMENT LinAppl_TraHndlr_FrmCntr "F4614: Counter provided by CF" UBYTE X1_M 1 100 0 255 FORMAT "%5.1" ECU_ADDRESS 0xFFF951AA /end MEASUREMENT
/begin MEASUREMENT LinAppl_TraHndlr_FrmCntrChk "F4614: Counter for CF monitoring of correct receiption" UBYTE X1_M 1 100 0 255 FORMAT "%5.1" ECU_ADDRESS 0xFFF951AB /end MEASUREMENT
/begin MEASUREMENT LinAppl_TraHndlr_FrmDir "F4614: Information about the currently processed frame communication direction. 0:Idle 1: Rx, 2: Tx" UBYTE X1_M 1 100 0 255 FORMAT "%5.1" ECU_ADDRESS 0xFFF951AC /end MEASUREMENT
/begin MEASUREMENT LinAppl_TraHndlr_FrmTyp "F4614: Information about the currently processed frame type. 0: SF, 1: FF, 2: CF, 3: EF, 4: IF, 5: LF" UBYTE X1_M 1 100 0 255 FORMAT "%5.1" ECU_ADDRESS 0xFFF951AD /end MEASUREMENT
/begin MEASUREMENT LinAppl_TraHndlr_FrmTypPre "F4614: Information about the previously processed frame type. 0: SF, 1: FF, 2: CF, 3: EF, 4: IF, 5: LF" UBYTE X1_M 1 100 0 255 FORMAT "%5.1" ECU_ADDRESS 0xFFF951AE /end MEASUREMENT
/begin MEASUREMENT LinAppl_TraHndlr_Mod "F4614: Mode of the transmission handler. 0: Off (Only normal schedule table processed), 1: Diagnostic Only, 2: Interleaved " UBYTE X1_M 1 100 0 255 FORMAT "%5.1" ECU_ADDRESS 0xFFF951AF /end MEASUREMENT
/begin MEASUREMENT LinAppl_TraHndlr_MstBuf "F4614: Buffer for diagnostic master request frames" UBYTE X1_M 1 100 0 255 FORMAT "%5.1" ARRAY_SIZE 8 ECU_ADDRESS 0xFFF93E0C /end MEASUREMENT
/begin MEASUREMENT LinAppl_TraHndlr_MstBufSt "F4614: Status of the LIN diagnostic master requests queue: 0: Empty 1:Available 2: Full 3:Error" UBYTE X1_M 1 100 0 3 FORMAT "%5.3" ECU_ADDRESS 0xFFF951B0 /end MEASUREMENT
/begin MEASUREMENT LinAppl_TraHndlr_MstQueSize "F4614: Size of the LIN diagnostic master requests queue" UBYTE X1_M 1 100 0 1 FORMAT "%5.3" ECU_ADDRESS 0xFFF951B1 /end MEASUREMENT
/begin MEASUREMENT LinAppl_TraHndlr_MstRdNxtQueIdx "F4614: Index for next Bufferelement for diagnostic master request to be written" UBYTE X1_M 1 100 0 255 FORMAT "%5.1" ECU_ADDRESS 0xFFF951B2 /end MEASUREMENT
/begin MEASUREMENT LinAppl_TraHndlr_MstWrNxtQueIdx "F4614: Index for next Bufferelement for diagnostic master request to be read" UBYTE X1_M 1 100 0 255 FORMAT "%5.1" ECU_ADDRESS 0xFFF951B3 /end MEASUREMENT
/begin MEASUREMENT LinAppl_TraHndlr_NumDatByt "F4614: Provides the number of databytes that have to be Tx/Rx for the whole message to be processed" UWORD X1_M 1 100 0 65535 FORMAT "%8.2" ECU_ADDRESS 0xFFF94DD4 /end MEASUREMENT
/begin MEASUREMENT LinAppl_TraHndlr_NumDatBytRmn "F4614: Provides the number of databytes that remain to be processed until the Tx/Rx message is fully processed" UWORD X1_M 1 100 0 65535 FORMAT "%8.2" ECU_ADDRESS 0xFFF94DD6 /end MEASUREMENT
/begin MEASUREMENT LinAppl_TraHndlr_PCIByt "F4614: Holds the last processed PCI Byte. May be either Rx or Tx Frame" UBYTE X1_M 1 100 0 255 FORMAT "%5.1" ECU_ADDRESS 0xFFF951B4 /end MEASUREMENT
/begin MEASUREMENT LinAppl_TraHndlr_ProtErr "F4614: Provides information about an error in diagnostic communication protocol" UBYTE X1_M 1 100 0 255 FORMAT "%5.1" ECU_ADDRESS 0xFFF951B5 /end MEASUREMENT
/begin MEASUREMENT LinAppl_TraHndlr_SIDByt "F4614: Holds the last processed LEN/SID/RSID Byte. May be either Rx or Tx Frame" UBYTE X1_M 1 100 0 255 FORMAT "%5.1" ECU_ADDRESS 0xFFF951B6 /end MEASUREMENT
/begin MEASUREMENT LinAppl_TraHndlr_SlvBuf "F4614: Buffer for diagnostic slave response frames" UBYTE X1_M 1 100 0 255 FORMAT "%5.1" ARRAY_SIZE 8 ECU_ADDRESS 0xFFF93E14 /end MEASUREMENT
/begin MEASUREMENT LinAppl_TraHndlr_SlvBufSt "F4614: Status of the LIN diagnostic slave response queue: 0: Empty 1:Available 2: Error" UBYTE X1_M 1 100 0 2 FORMAT "%5.3" ECU_ADDRESS 0xFFF951B7 /end MEASUREMENT
/begin MEASUREMENT LinAppl_TraHndlr_SlvQueSize "F4614: Size of the LIN diagnostic slave response queue" UBYTE X1_M 1 100 0 1 FORMAT "%5.3" ECU_ADDRESS 0xFFF951B8 /end MEASUREMENT
/begin MEASUREMENT LinAppl_TraHndlr_SlvRdNxtQueIdx "F4614: Index for next Bufferelement for diagnostic slave response to be read" UBYTE X1_M 1 100 0 255 FORMAT "%5.1" ECU_ADDRESS 0xFFF951B9 /end MEASUREMENT
/begin MEASUREMENT LinAppl_TraHndlr_SlvWrNxtQueIdx "F4614: Index for next Bufferelement for diagnostic slave response to be read" UBYTE X1_M 1 100 0 255 FORMAT "%5.1" ECU_ADDRESS 0xFFF951BA /end MEASUREMENT
/begin MEASUREMENT LinAppl_TraHndlr_St "F4614: State of the transmission handler. 0: Idle, 1: Tx Physical Active, 2: Rx Physical Active, 3: Interleaved functional during Tx, 4: Interleaved functional during Rx, 5: Tx functional active" UBYTE X1_M 1 100 0 255 FORMAT "%5.1" ECU_ADDRESS 0xFFF951BB /end MEASUREMENT
/begin MEASUREMENT Nm_var_s[0].stNmFlags_b32 "Nm_var_s (implementation in generated c-source in nm_auto_conf.c) / status flags for NM" ULONG X1_M 1 100 0 4294967295 FORMAT "%13.2" ECU_ADDRESS 0xFFF94500 /end MEASUREMENT
/begin MEASUREMENT Nm_var_s[0].tiNmNodeDetectionLockTime_u32 "Nm_var_s (implementation in generated c-source in nm_auto_conf.c) / timer for monitoring node detection lock time" ULONG X1_M 1 100 0 4294967295 FORMAT "%13.2" ECU_ADDRESS 0xFFF94504 /end MEASUREMENT
/begin MEASUREMENT Nm_var_s[0].tiRemoteSleepIndTime_u32 "Nm_var_s (implementation in generated c-source in nm_auto_conf.c) / timer for monitoring remote sleep inidcation" ULONG X1_M 1 100 0 4294967295 FORMAT "%13.2" ECU_ADDRESS 0xFFF94508 /end MEASUREMENT
/begin MEASUREMENT Nm_var_s[0].tiNmTimeoutTime_u32 "Nm_var_s (implementation in generated c-source in nm_auto_conf.c) / timer for monitoring NM timeout" ULONG X1_M 1 100 0 4294967295 FORMAT "%13.2" ECU_ADDRESS 0xFFF9450C /end MEASUREMENT
/begin MEASUREMENT Nm_var_s[0].tiNmWaitBusSleepTime_u32 "Nm_var_s (implementation in generated c-source in nm_auto_conf.c) / timer for monitoring wait sleep timeout" ULONG X1_M 1 100 0 4294967295 FORMAT "%13.2" ECU_ADDRESS 0xFFF94510 /end MEASUREMENT
/begin MEASUREMENT Nm_var_s[0].tiNmRepeatMessageTime_u32 "Nm_var_s (implementation in generated c-source in nm_auto_conf.c) / timer for monitoring repeat message time" ULONG X1_M 1 100 0 4294967295 FORMAT "%13.2" ECU_ADDRESS 0xFFF94514 /end MEASUREMENT
/begin MEASUREMENT Nm_var_s[0].numSizeOfNodeIdList_u8 "Nm_var_s (implementation in generated c-source in nm_auto_conf.c) / size of Node Id list" UBYTE X1_M 1 100 0 255 FORMAT "%5.1" ECU_ADDRESS 0xFFF94518 /end MEASUREMENT
/begin MEASUREMENT Nm_var_s[0].nmRemoteSleepInd_b "Nm_var_s (implementation in generated c-source in nm_auto_conf.c) / status of remote sleep indication" ULONG X1_M 1 100 0 4294967295 FORMAT "%13.2" ECU_ADDRESS 0xFFF9451C /end MEASUREMENT
/begin MEASUREMENT Nm_var_s[0].nmNodeIdListStatus_b "Nm_var_s (implementation in generated c-source in nm_auto_conf.c) / status of Node Identifier list" ULONG X1_M 1 100 0 4294967295 FORMAT "%13.2" ECU_ADDRESS 0xFFF94520 /end MEASUREMENT
/begin MEASUREMENT Nm_var_s[0].stNmState_e "Nm_var_s (implementation in generated c-source in nm_auto_conf.c) / state machine of the generic NM" ULONG Nm_StateType_t_M 1 100 0 4 FORMAT "%13.11" ECU_ADDRESS 0xFFF94524 /end MEASUREMENT
/begin MEASUREMENT OmmMdSw_sOpMCur "F1730: Current operating mode" UBYTE X1_M 1 100 0 255 FORMAT "%5.1" ECU_ADDRESS 0xFFF95119 /end MEASUREMENT
/begin MEASUREMENT OmmMdSw_sOpMDest "F1730: Destination operating mode of the OMM" UBYTE X1_M 1 100 0 255 FORMAT "%5.1" ECU_ADDRESS 0xFFF9511A /end MEASUREMENT
/begin MEASUREMENT OmmMdSw_sOpMInt "F1730: Omm internal mode request [FF = No request]" UBYTE X1_M 1 100 0 255 FORMAT "%5.1" ECU_ADDRESS 0xFFF9511B /end MEASUREMENT
/begin MEASUREMENT OmmMdSw_sOpMReq "F1730: Requested operating mode" UBYTE X1_M 1 100 0 255 FORMAT "%5.1" ECU_ADDRESS 0xFFF9511C /end MEASUREMENT
/begin MEASUREMENT RctT10.ctActv "F1600: Task counter for 10ms task / Activation counter" UWORD X1_M 1 100 0 65535 FORMAT "%8.2" ECU_ADDRESS 0xFFF94B68 /end MEASUREMENT
/begin MEASUREMENT RctT10.ctExe "F1600: Task counter for 10ms task / Execution counter" UWORD X1_M 1 100 0 65535 FORMAT "%8.2" ECU_ADDRESS 0xFFF94B6A /end MEASUREMENT
/begin MEASUREMENT RctT10.ctOvrFlw "F1600: Task counter for 10ms task / Overflow counter" UWORD X1_M 1 100 0 65535 FORMAT "%8.2" ECU_ADDRESS 0xFFF94B6C /end MEASUREMENT
/begin MEASUREMENT RctT100.ctActv "F1600: Task counter for 100ms task / Activation counter" UWORD X1_M 1 100 0 65535 FORMAT "%8.2" ECU_ADDRESS 0xFFF94B6E /end MEASUREMENT
/begin MEASUREMENT RctT100.ctExe "F1600: Task counter for 100ms task / Execution counter" UWORD X1_M 1 100 0 65535 FORMAT "%8.2" ECU_ADDRESS 0xFFF94B70 /end MEASUREMENT
/begin MEASUREMENT RctT100.ctOvrFlw "F1600: Task counter for 100ms task / Overflow counter" UWORD X1_M 1 100 0 65535 FORMAT "%8.2" ECU_ADDRESS 0xFFF94B72 /end MEASUREMENT
/begin MEASUREMENT RctT20.ctActv "F1600: Task counter for 20ms task / Activation counter" UWORD X1_M 1 100 0 65535 FORMAT "%8.2" ECU_ADDRESS 0xFFF94B74 /end MEASUREMENT
/begin MEASUREMENT RctT20.ctExe "F1600: Task counter for 20ms task / Execution counter" UWORD X1_M 1 100 0 65535 FORMAT "%8.2" ECU_ADDRESS 0xFFF94B76 /end MEASUREMENT
/begin MEASUREMENT RctT20.ctOvrFlw "F1600: Task counter for 20ms task / Overflow counter" UWORD X1_M 1 100 0 65535 FORMAT "%8.2" ECU_ADDRESS 0xFFF94B78 /end MEASUREMENT
/begin MEASUREMENT RctT2x5.ctActv "F1600: Task counter for 2.5ms task / Activation counter" UWORD X1_M 1 100 0 65535 FORMAT "%8.2" ECU_ADDRESS 0xFFF94B7A /end MEASUREMENT
/begin MEASUREMENT RctT2x5.ctExe "F1600: Task counter for 2.5ms task / Execution counter" UWORD X1_M 1 100 0 65535 FORMAT "%8.2" ECU_ADDRESS 0xFFF94B7C /end MEASUREMENT
/begin MEASUREMENT RctT2x5.ctOvrFlw "F1600: Task counter for 2.5ms task / Overflow counter" UWORD X1_M 1 100 0 65535 FORMAT "%8.2" ECU_ADDRESS 0xFFF94B7E /end MEASUREMENT
/begin MEASUREMENT RctT30.ctActv "F1600: Task counter for 30ms task / Activation counter" UWORD X1_M 1 100 0 65535 FORMAT "%8.2" ECU_ADDRESS 0xFFF94B80 /end MEASUREMENT
/begin MEASUREMENT RctT30.ctExe "F1600: Task counter for 30ms task / Execution counter" UWORD X1_M 1 100 0 65535 FORMAT "%8.2" ECU_ADDRESS 0xFFF94B82 /end MEASUREMENT
/begin MEASUREMENT RctT30.ctOvrFlw "F1600: Task counter for 30ms task / Overflow counter" UWORD X1_M 1 100 0 65535 FORMAT "%8.2" ECU_ADDRESS 0xFFF94B84 /end MEASUREMENT
/begin MEASUREMENT RctT5.ctActv "F1600: Task counter for 5ms task / Activation counter" UWORD X1_M 1 100 0 65535 FORMAT "%8.2" ECU_ADDRESS 0xFFF94B86 /end MEASUREMENT
/begin MEASUREMENT RctT5.ctExe "F1600: Task counter for 5ms task / Execution counter" UWORD X1_M 1 100 0 65535 FORMAT "%8.2" ECU_ADDRESS 0xFFF94B88 /end MEASUREMENT
/begin MEASUREMENT RctT5.ctOvrFlw "F1600: Task counter for 5ms task / Overflow counter" UWORD X1_M 1 100 0 65535 FORMAT "%8.2" ECU_ADDRESS 0xFFF94B8A /end MEASUREMENT
/begin MEASUREMENT RctT50.ctActv "F1600: Task counter for 50ms task / Activation counter" UWORD X1_M 1 100 0 65535 FORMAT "%8.2" ECU_ADDRESS 0xFFF94B8C /end MEASUREMENT
/begin MEASUREMENT RctT50.ctExe "F1600: Task counter for 50ms task / Execution counter" UWORD X1_M 1 100 0 65535 FORMAT "%8.2" ECU_ADDRESS 0xFFF94B8E /end MEASUREMENT
/begin MEASUREMENT RctT50.ctOvrFlw "F1600: Task counter for 50ms task / Overflow counter" UWORD X1_M 1 100 0 65535 FORMAT "%8.2" ECU_ADDRESS 0xFFF94B90 /end MEASUREMENT
/begin MEASUREMENT RCT_bIniActvCYC "F1600: Flag cyclic task INI active" UBYTE B_TRUE_M 1 100 0 1 FORMAT "%13.11" ECU_ADDRESS 0xFFF84C4A /end MEASUREMENT
/begin MEASUREMENT RCT_sIniActvPT "F1600: State periodic tasks INI" UBYTE X1_M 1 100 0 2 FORMAT "%5.3" ECU_ADDRESS 0xFFF950D3 /end MEASUREMENT
/begin MEASUREMENT RCT_sModeAct "F1600: Current operating system mode" UBYTE X1_M 1 100 0 255 FORMAT "%5.1" ECU_ADDRESS 0xFFF84C49 /end MEASUREMENT
/begin MEASUREMENT RCT_sModeActIdx "F1600: Current operating system mode (without no mode information)" UBYTE X1_M 1 100 0 5 FORMAT "%5.3" ECU_ADDRESS 0xFFF950C4 /end MEASUREMENT
/begin MEASUREMENT RCT_sModeNxt "F1600: Requested operating system mode" UBYTE X1_M 1 100 0 5 FORMAT "%5.3" ECU_ADDRESS 0xFFF950C5 /end MEASUREMENT
/begin MEASUREMENT RCT_tiModeChng "F1600: Duration of operating system mode change" UWORD TI0_001_M_M 1 100 0 65.535 FORMAT "%8.5" ARRAY_SIZE 6 ECU_ADDRESS 0xFFF921A4 /end MEASUREMENT
/begin MEASUREMENT RmnT10.sMon "F1630: Task monitoring variables for 10ms task / State of the enhanced task monitoring" UBYTE X1_M 1 100 0 2 FORMAT "%5.3" ECU_ADDRESS 0xFFF94B92 /end MEASUREMENT
/begin MEASUREMENT RmnT10.tiOvrFlw "F1630: Task monitoring variables for 10ms task / Time stamp taken at task overflow" UWORD TI1_M_M 1 100 0 65535 FORMAT "%8.2" ECU_ADDRESS 0xFFF94B94 /end MEASUREMENT
/begin MEASUREMENT RmnT10.ctStop "F1630: Task monitoring variables for 10ms task / Task stop counter" UWORD X1_M 1 100 0 65535 FORMAT "%8.2" ECU_ADDRESS 0xFFF94B96 /end MEASUREMENT
/begin MEASUREMENT RmnT10.ctStrt "F1630: Task monitoring variables for 10ms task / Task start counter" UWORD X1_M 1 100 0 65535 FORMAT "%8.2" ECU_ADDRESS 0xFFF94B98 /end MEASUREMENT
/begin MEASUREMENT RmnT10.tiStrt "F1630: Task monitoring variables for 10ms task / Time stamp taken at start of task" UWORD TI1_M_M 1 100 0 65535 FORMAT "%8.2" ECU_ADDRESS 0xFFF94B9A /end MEASUREMENT
/begin MEASUREMENT RmnT100.sMon "F1630: Task monitoring variables for 100ms task / State of the enhanced task monitoring" UBYTE X1_M 1 100 0 2 FORMAT "%5.3" ECU_ADDRESS 0xFFF94BA0 /end MEASUREMENT
/begin MEASUREMENT RmnT100.tiOvrFlw "F1630: Task monitoring variables for 100ms task / Time stamp taken at task overflow" UWORD TI1_M_M 1 100 0 65535 FORMAT "%8.2" ECU_ADDRESS 0xFFF94BA2 /end MEASUREMENT
/begin MEASUREMENT RmnT100.ctStop "F1630: Task monitoring variables for 100ms task / Task stop counter" UWORD X1_M 1 100 0 65535 FORMAT "%8.2" ECU_ADDRESS 0xFFF94BA4 /end MEASUREMENT
/begin MEASUREMENT RmnT100.ctStrt "F1630: Task monitoring variables for 100ms task / Task start counter" UWORD X1_M 1 100 0 65535 FORMAT "%8.2" ECU_ADDRESS 0xFFF94BA6 /end MEASUREMENT
/begin MEASUREMENT RmnT100.tiStrt "F1630: Task monitoring variables for 100ms task / Time stamp taken at start of task" UWORD TI1_M_M 1 100 0 65535 FORMAT "%8.2" ECU_ADDRESS 0xFFF94BA8 /end MEASUREMENT
/begin MEASUREMENT RmnT20.sMon "F1630: Task monitoring variables for 20ms task / State of the enhanced task monitoring" UBYTE X1_M 1 100 0 2 FORMAT "%5.3" ECU_ADDRESS 0xFFF94BAE /end MEASUREMENT
/begin MEASUREMENT RmnT20.tiOvrFlw "F1630: Task monitoring variables for 20ms task / Time stamp taken at task overflow" UWORD TI1_M_M 1 100 0 65535 FORMAT "%8.2" ECU_ADDRESS 0xFFF94BB0 /end MEASUREMENT
/begin MEASUREMENT RmnT20.ctStop "F1630: Task monitoring variables for 20ms task / Task stop counter" UWORD X1_M 1 100 0 65535 FORMAT "%8.2" ECU_ADDRESS 0xFFF94BB2 /end MEASUREMENT
/begin MEASUREMENT RmnT20.ctStrt "F1630: Task monitoring variables for 20ms task / Task start counter" UWORD X1_M 1 100 0 65535 FORMAT "%8.2" ECU_ADDRESS 0xFFF94BB4 /end MEASUREMENT
/begin MEASUREMENT RmnT20.tiStrt "F1630: Task monitoring variables for 20ms task / Time stamp taken at start of task" UWORD TI1_M_M 1 100 0 65535 FORMAT "%8.2" ECU_ADDRESS 0xFFF94BB6 /end MEASUREMENT
/begin MEASUREMENT RmnT30.sMon "F1630: Task monitoring variables for 30ms task / State of the enhanced task monitoring" UBYTE X1_M 1 100 0 2 FORMAT "%5.3" ECU_ADDRESS 0xFFF94BBC /end MEASUREMENT
/begin MEASUREMENT RmnT30.tiOvrFlw "F1630: Task monitoring variables for 30ms task / Time stamp taken at task overflow" UWORD TI1_M_M 1 100 0 65535 FORMAT "%8.2" ECU_ADDRESS 0xFFF94BBE /end MEASUREMENT
/begin MEASUREMENT RmnT30.ctStop "F1630: Task monitoring variables for 30ms task / Task stop counter" UWORD X1_M 1 100 0 65535 FORMAT "%8.2" ECU_ADDRESS 0xFFF94BC0 /end MEASUREMENT
/begin MEASUREMENT RmnT30.ctStrt "F1630: Task monitoring variables for 30ms task / Task start counter" UWORD X1_M 1 100 0 65535 FORMAT "%8.2" ECU_ADDRESS 0xFFF94BC2 /end MEASUREMENT
/begin MEASUREMENT RmnT30.tiStrt "F1630: Task monitoring variables for 30ms task / Time stamp taken at start of task" UWORD TI1_M_M 1 100 0 65535 FORMAT "%8.2" ECU_ADDRESS 0xFFF94BC4 /end MEASUREMENT
/begin MEASUREMENT RmnT5.sMon "F1630: Task monitoring variables for 5ms task / State of the enhanced task monitoring" UBYTE X1_M 1 100 0 2 FORMAT "%5.3" ECU_ADDRESS 0xFFF94BCA /end MEASUREMENT
/begin MEASUREMENT RmnT5.tiOvrFlw "F1630: Task monitoring variables for 5ms task / Time stamp taken at task overflow" UWORD TI1_M_M 1 100 0 65535 FORMAT "%8.2" ECU_ADDRESS 0xFFF94BCC /end MEASUREMENT
/begin MEASUREMENT RmnT5.ctStop "F1630: Task monitoring variables for 5ms task / Task stop counter" UWORD X1_M 1 100 0 65535 FORMAT "%8.2" ECU_ADDRESS 0xFFF94BCE /end MEASUREMENT
/begin MEASUREMENT RmnT5.ctStrt "F1630: Task monitoring variables for 5ms task / Task start counter" UWORD X1_M 1 100 0 65535 FORMAT "%8.2" ECU_ADDRESS 0xFFF94BD0 /end MEASUREMENT
/begin MEASUREMENT RmnT5.tiStrt "F1630: Task monitoring variables for 5ms task / Time stamp taken at start of task" UWORD TI1_M_M 1 100 0 65535 FORMAT "%8.2" ECU_ADDRESS 0xFFF94BD2 /end MEASUREMENT
/begin MEASUREMENT RmnT50.sMon "F1630: Task monitoring variables for 50ms task / State of the enhanced task monitoring" UBYTE X1_M 1 100 0 2 FORMAT "%5.3" ECU_ADDRESS 0xFFF94BD8 /end MEASUREMENT
/begin MEASUREMENT RmnT50.tiOvrFlw "F1630: Task monitoring variables for 50ms task / Time stamp taken at task overflow" UWORD TI1_M_M 1 100 0 65535 FORMAT "%8.2" ECU_ADDRESS 0xFFF94BDA /end MEASUREMENT
/begin MEASUREMENT RmnT50.ctStop "F1630: Task monitoring variables for 50ms task / Task stop counter" UWORD X1_M 1 100 0 65535 FORMAT "%8.2" ECU_ADDRESS 0xFFF94BDC /end MEASUREMENT
/begin MEASUREMENT RmnT50.ctStrt "F1630: Task monitoring variables for 50ms task / Task start counter" UWORD X1_M 1 100 0 65535 FORMAT "%8.2" ECU_ADDRESS 0xFFF94BDE /end MEASUREMENT
/begin MEASUREMENT RmnT50.tiStrt "F1630: Task monitoring variables for 50ms task / Time stamp taken at start of task" UWORD TI1_M_M 1 100 0 65535 FORMAT "%8.2" ECU_ADDRESS 0xFFF94BE0 /end MEASUREMENT
/begin MEASUREMENT ROS_idxDmy "F1600: Dummy variable for use as index of DAMOS tables (value always=0)" UBYTE X1_M 1 100 0 255 FORMAT "%5.1" ECU_ADDRESS 0xFFF9556D /end MEASUREMENT
/begin MEASUREMENT RrtFgp0.tiRun "F1620: Runtime measurement for functional group 0 / Runtime of the functional group" UWORD TI0_001_M_M 1 100 0 65.535 FORMAT "%8.5" ECU_ADDRESS 0xFFF92900 /end MEASUREMENT
/begin MEASUREMENT RrtFgp0.tiRunMax "F1620: Runtime measurement for functional group 0 / Maximum runtime of the functional group" UWORD TI0_001_M_M 1 100 0 65.535 FORMAT "%8.5" ECU_ADDRESS 0xFFF92902 /end MEASUREMENT
/begin MEASUREMENT RrtFgp1.tiRun "F1620: Runtime measurement for functional group 1 / Runtime of the functional group" UWORD TI0_001_M_M 1 100 0 65.535 FORMAT "%8.5" ECU_ADDRESS 0xFFF92914 /end MEASUREMENT
/begin MEASUREMENT RrtFgp1.tiRunMax "F1620: Runtime measurement for functional group 1 / Maximum runtime of the functional group" UWORD TI0_001_M_M 1 100 0 65.535 FORMAT "%8.5" ECU_ADDRESS 0xFFF92916 /end MEASUREMENT
/begin MEASUREMENT RrtFgp2.tiRun "F1620: Runtime measurement for functional group 2 / Runtime of the functional group" UWORD TI0_001_M_M 1 100 0 65.535 FORMAT "%8.5" ECU_ADDRESS 0xFFF92928 /end MEASUREMENT
/begin MEASUREMENT RrtFgp2.tiRunMax "F1620: Runtime measurement for functional group 2 / Maximum runtime of the functional group" UWORD TI0_001_M_M 1 100 0 65.535 FORMAT "%8.5" ECU_ADDRESS 0xFFF9292A /end MEASUREMENT
/begin MEASUREMENT RrtFgp3.tiRun "F1620: Runtime measurement for functional group 3 / Runtime of the functional group" UWORD TI0_001_M_M 1 100 0 65.535 FORMAT "%8.5" ECU_ADDRESS 0xFFF9293C /end MEASUREMENT
/begin MEASUREMENT RrtFgp3.tiRunMax "F1620: Runtime measurement for functional group 3 / Maximum runtime of the functional group" UWORD TI0_001_M_M 1 100 0 65.535 FORMAT "%8.5" ECU_ADDRESS 0xFFF9293E /end MEASUREMENT
/begin MEASUREMENT RrtFgp4.tiRun "F1620: Runtime measurement for functional group 4 / Runtime of the functional group" UWORD TI0_001_M_M 1 100 0 65.535 FORMAT "%8.5" ECU_ADDRESS 0xFFF92950 /end MEASUREMENT
/begin MEASUREMENT RrtFgp4.tiRunMax "F1620: Runtime measurement for functional group 4 / Maximum runtime of the functional group" UWORD TI0_001_M_M 1 100 0 65.535 FORMAT "%8.5" ECU_ADDRESS 0xFFF92952 /end MEASUREMENT
/begin MEASUREMENT RrtFgp5.tiRun "F1620: Runtime measurement for functional group 5 / Runtime of the functional group" UWORD TI0_001_M_M 1 100 0 65.535 FORMAT "%8.5" ECU_ADDRESS 0xFFF92964 /end MEASUREMENT
/begin MEASUREMENT RrtFgp5.tiRunMax "F1620: Runtime measurement for functional group 5 / Maximum runtime of the functional group" UWORD TI0_001_M_M 1 100 0 65.535 FORMAT "%8.5" ECU_ADDRESS 0xFFF92966 /end MEASUREMENT
/begin MEASUREMENT RrtFgp6.tiRun "F1620: Runtime measurement for functional group 6 / Runtime of the functional group" UWORD TI0_001_M_M 1 100 0 65.535 FORMAT "%8.5" ECU_ADDRESS 0xFFF92978 /end MEASUREMENT
/begin MEASUREMENT RrtFgp6.tiRunMax "F1620: Runtime measurement for functional group 6 / Maximum runtime of the functional group" UWORD TI0_001_M_M 1 100 0 65.535 FORMAT "%8.5" ECU_ADDRESS 0xFFF9297A /end MEASUREMENT
/begin MEASUREMENT RrtFgp7.tiRun "F1620: Runtime measurement for functional group 7 / Runtime of the functional group" UWORD TI0_001_M_M 1 100 0 65.535 FORMAT "%8.5" ECU_ADDRESS 0xFFF9298C /end MEASUREMENT
/begin MEASUREMENT RrtFgp7.tiRunMax "F1620: Runtime measurement for functional group 7 / Maximum runtime of the functional group" UWORD TI0_001_M_M 1 100 0 65.535 FORMAT "%8.5" ECU_ADDRESS 0xFFF9298E /end MEASUREMENT
/begin MEASUREMENT RrtFgp8.tiRun "F1620: Runtime measurement for functional group 8 / Runtime of the functional group" UWORD TI0_001_M_M 1 100 0 65.535 FORMAT "%8.5" ECU_ADDRESS 0xFFF929A0 /end MEASUREMENT
/begin MEASUREMENT RrtFgp8.tiRunMax "F1620: Runtime measurement for functional group 8 / Maximum runtime of the functional group" UWORD TI0_001_M_M 1 100 0 65.535 FORMAT "%8.5" ECU_ADDRESS 0xFFF929A2 /end MEASUREMENT
/begin MEASUREMENT RrtFgp9.tiRun "F1620: Runtime measurement for functional group 9 / Runtime of the functional group" UWORD TI0_001_M_M 1 100 0 65.535 FORMAT "%8.5" ECU_ADDRESS 0xFFF929B4 /end MEASUREMENT
/begin MEASUREMENT RrtFgp9.tiRunMax "F1620: Runtime measurement for functional group 9 / Maximum runtime of the functional group" UWORD TI0_001_M_M 1 100 0 65.535 FORMAT "%8.5" ECU_ADDRESS 0xFFF929B6 /end MEASUREMENT
/begin MEASUREMENT RrtIsr0.tiRunSum "F1620: Runtime measurement for interrupt 0 / Sum of interrupt runtime per measurement period" UWORD TI0_001_M_M 1 100 0 65.535 FORMAT "%8.5" ECU_ADDRESS 0xFFF922CC /end MEASUREMENT
/begin MEASUREMENT RrtIsr0.ctExe "F1620: Runtime measurement for interrupt 0 / Number of interrupts per measurement period" UWORD X1_M 1 100 0 65535 FORMAT "%8.2" ECU_ADDRESS 0xFFF922D0 /end MEASUREMENT
/begin MEASUREMENT RrtIsr1.tiRunSum "F1620: Runtime measurement for interrupt 1 / Sum of interrupt runtime per measurement period" UWORD TI0_001_M_M 1 100 0 65.535 FORMAT "%8.5" ECU_ADDRESS 0xFFF922E4 /end MEASUREMENT
/begin MEASUREMENT RrtIsr1.ctExe "F1620: Runtime measurement for interrupt 1 / Number of interrupts per measurement period" UWORD X1_M 1 100 0 65535 FORMAT "%8.2" ECU_ADDRESS 0xFFF922E8 /end MEASUREMENT
/begin MEASUREMENT RrtIsr2.tiRunSum "F1620: Runtime measurement for interrupt 2 / Sum of interrupt runtime per measurement period" UWORD TI0_001_M_M 1 100 0 65.535 FORMAT "%8.5" ECU_ADDRESS 0xFFF922FC /end MEASUREMENT
/begin MEASUREMENT RrtIsr2.ctExe "F1620: Runtime measurement for interrupt 2 / Number of interrupts per measurement period" UWORD X1_M 1 100 0 65535 FORMAT "%8.2" ECU_ADDRESS 0xFFF92300 /end MEASUREMENT
/begin MEASUREMENT RrtIsr3.tiRunSum "F1620: Runtime measurement for interrupt 3 / Sum of interrupt runtime per measurement period" UWORD TI0_001_M_M 1 100 0 65.535 FORMAT "%8.5" ECU_ADDRESS 0xFFF92314 /end MEASUREMENT
/begin MEASUREMENT RrtIsr3.ctExe "F1620: Runtime measurement for interrupt 3 / Number of interrupts per measurement period" UWORD X1_M 1 100 0 65535 FORMAT "%8.2" ECU_ADDRESS 0xFFF92318 /end MEASUREMENT
/begin MEASUREMENT RrtIsr4.tiRunSum "F1620: Runtime measurement for interrupt 4 / Sum of interrupt runtime per measurement period" UWORD TI0_001_M_M 1 100 0 65.535 FORMAT "%8.5" ECU_ADDRESS 0xFFF9232C /end MEASUREMENT
/begin MEASUREMENT RrtIsr4.ctExe "F1620: Runtime measurement for interrupt 4 / Number of interrupts per measurement period" UWORD X1_M 1 100 0 65535 FORMAT "%8.2" ECU_ADDRESS 0xFFF92330 /end MEASUREMENT
/begin MEASUREMENT RrtIsr5.tiRunSum "F1620: Runtime measurement for interrupt 5 / Sum of interrupt runtime per measurement period" UWORD TI0_001_M_M 1 100 0 65.535 FORMAT "%8.5" ECU_ADDRESS 0xFFF92344 /end MEASUREMENT
/begin MEASUREMENT RrtIsr5.ctExe "F1620: Runtime measurement for interrupt 5 / Number of interrupts per measurement period" UWORD X1_M 1 100 0 65535 FORMAT "%8.2" ECU_ADDRESS 0xFFF92348 /end MEASUREMENT
/begin MEASUREMENT RrtIsr6.tiRunSum "F1620: Runtime measurement for interrupt 6 / Sum of interrupt runtime per measurement period" UWORD TI0_001_M_M 1 100 0 65.535 FORMAT "%8.5" ECU_ADDRESS 0xFFF9235C /end MEASUREMENT
/begin MEASUREMENT RrtIsr6.ctExe "F1620: Runtime measurement for interrupt 6 / Number of interrupts per measurement period" UWORD X1_M 1 100 0 65535 FORMAT "%8.2" ECU_ADDRESS 0xFFF92360 /end MEASUREMENT
/begin MEASUREMENT RrtIsr7.tiRunSum "F1620: Runtime measurement for interrupt 7 / Sum of interrupt runtime per measurement period" UWORD TI0_001_M_M 1 100 0 65.535 FORMAT "%8.5" ECU_ADDRESS 0xFFF92374 /end MEASUREMENT
/begin MEASUREMENT RrtIsr7.ctExe "F1620: Runtime measurement for interrupt 7 / Number of interrupts per measurement period" UWORD X1_M 1 100 0 65535 FORMAT "%8.2" ECU_ADDRESS 0xFFF92378 /end MEASUREMENT
/begin MEASUREMENT RrtIsr8.tiRunSum "F1620: Runtime measurement for interrupt 8 / Sum of interrupt runtime per measurement period" UWORD TI0_001_M_M 1 100 0 65.535 FORMAT "%8.5" ECU_ADDRESS 0xFFF9238C /end MEASUREMENT
/begin MEASUREMENT RrtIsr8.ctExe "F1620: Runtime measurement for interrupt 8 / Number of interrupts per measurement period" UWORD X1_M 1 100 0 65535 FORMAT "%8.2" ECU_ADDRESS 0xFFF92390 /end MEASUREMENT
/begin MEASUREMENT RrtIsrOS.tiRunSum "F1620: Runtime measurement for OS interrupt / Sum of interrupt runtime per measurement period" UWORD TI0_001_M_M 1 100 0 65.535 FORMAT "%8.5" ECU_ADDRESS 0xFFF923A4 /end MEASUREMENT
/begin MEASUREMENT RrtIsrOS.ctExe "F1620: Runtime measurement for OS interrupt / Number of interrupts per measurement period" UWORD X1_M 1 100 0 65535 FORMAT "%8.2" ECU_ADDRESS 0xFFF923A8 /end MEASUREMENT
/begin MEASUREMENT RrtT10.tiPer "F1620: Runtime measurement for 10ms task / Task period" UWORD TI0_01_M_M 1 100 0 655.35 FORMAT "%8.4" ECU_ADDRESS 0xFFF923B8 /end MEASUREMENT
/begin MEASUREMENT RrtT10.tiRun "F1620: Runtime measurement for 10ms task / Task runtime" UWORD TI0_01_M_M 1 100 0 655.35 FORMAT "%8.4" ECU_ADDRESS 0xFFF923BA /end MEASUREMENT
/begin MEASUREMENT RrtT10.tiRunMax "F1620: Runtime measurement for 10ms task / Maximum task runtime" UWORD TI0_01_M_M 1 100 0 655.35 FORMAT "%8.4" ECU_ADDRESS 0xFFF923BC /end MEASUREMENT
/begin MEASUREMENT RrtT100.tiPer "F1620: Runtime measurement for 100ms task / Task period" UWORD TI0_01_M_M 1 100 0 655.35 FORMAT "%8.4" ECU_ADDRESS 0xFFF923CC /end MEASUREMENT
/begin MEASUREMENT RrtT100.tiRun "F1620: Runtime measurement for 100ms task / Task runtime" UWORD TI0_01_M_M 1 100 0 655.35 FORMAT "%8.4" ECU_ADDRESS 0xFFF923CE /end MEASUREMENT
/begin MEASUREMENT RrtT100.tiRunMax "F1620: Runtime measurement for 100ms task / Maximum task runtime" UWORD TI0_01_M_M 1 100 0 655.35 FORMAT "%8.4" ECU_ADDRESS 0xFFF923D0 /end MEASUREMENT
/begin MEASUREMENT RrtT20.tiPer "F1620: Runtime measurement for 20ms task / Task period" UWORD TI0_01_M_M 1 100 0 655.35 FORMAT "%8.4" ECU_ADDRESS 0xFFF923E0 /end MEASUREMENT
/begin MEASUREMENT RrtT20.tiRun "F1620: Runtime measurement for 20ms task / Task runtime" UWORD TI0_01_M_M 1 100 0 655.35 FORMAT "%8.4" ECU_ADDRESS 0xFFF923E2 /end MEASUREMENT
/begin MEASUREMENT RrtT20.tiRunMax "F1620: Runtime measurement for 20ms task / Maximum task runtime" UWORD TI0_01_M_M 1 100 0 655.35 FORMAT "%8.4" ECU_ADDRESS 0xFFF923E4 /end MEASUREMENT
/begin MEASUREMENT RrtT2x5.tiPer "F1620: Runtime measurement for 2.5ms task / Task period" UWORD TI0_01_M_M 1 100 0 655.35 FORMAT "%8.4" ECU_ADDRESS 0xFFF923F4 /end MEASUREMENT
/begin MEASUREMENT RrtT2x5.tiRun "F1620: Runtime measurement for 2.5ms task / Task runtime" UWORD TI0_01_M_M 1 100 0 655.35 FORMAT "%8.4" ECU_ADDRESS 0xFFF923F6 /end MEASUREMENT
/begin MEASUREMENT RrtT2x5.tiRunMax "F1620: Runtime measurement for 2.5ms task / Maximum task runtime" UWORD TI0_01_M_M 1 100 0 655.35 FORMAT "%8.4" ECU_ADDRESS 0xFFF923F8 /end MEASUREMENT
/begin MEASUREMENT RrtT30.tiPer "F1620: Runtime measurement for 30ms task / Task period" UWORD TI0_01_M_M 1 100 0 655.35 FORMAT "%8.4" ECU_ADDRESS 0xFFF92408 /end MEASUREMENT
/begin MEASUREMENT RrtT30.tiRun "F1620: Runtime measurement for 30ms task / Task runtime" UWORD TI0_01_M_M 1 100 0 655.35 FORMAT "%8.4" ECU_ADDRESS 0xFFF9240A /end MEASUREMENT
/begin MEASUREMENT RrtT30.tiRunMax "F1620: Runtime measurement for 30ms task / Maximum task runtime" UWORD TI0_01_M_M 1 100 0 655.35 FORMAT "%8.4" ECU_ADDRESS 0xFFF9240C /end MEASUREMENT
/begin MEASUREMENT RrtT5.tiPer "F1620: Runtime measurement for 5ms task / Task period" UWORD TI0_01_M_M 1 100 0 655.35 FORMAT "%8.4" ECU_ADDRESS 0xFFF9241C /end MEASUREMENT
/begin MEASUREMENT RrtT5.tiRun "F1620: Runtime measurement for 5ms task / Task runtime" UWORD TI0_01_M_M 1 100 0 655.35 FORMAT "%8.4" ECU_ADDRESS 0xFFF9241E /end MEASUREMENT
/begin MEASUREMENT RrtT5.tiRunMax "F1620: Runtime measurement for 5ms task / Maximum task runtime" UWORD TI0_01_M_M 1 100 0 655.35 FORMAT "%8.4" ECU_ADDRESS 0xFFF92420 /end MEASUREMENT
/begin MEASUREMENT RrtT50.tiPer "F1620: Runtime measurement for 50ms task / Task period" UWORD TI0_01_M_M 1 100 0 655.35 FORMAT "%8.4" ECU_ADDRESS 0xFFF92430 /end MEASUREMENT
/begin MEASUREMENT RrtT50.tiRun "F1620: Runtime measurement for 50ms task / Task runtime" UWORD TI0_01_M_M 1 100 0 655.35 FORMAT "%8.4" ECU_ADDRESS 0xFFF92432 /end MEASUREMENT
/begin MEASUREMENT RrtT50.tiRunMax "F1620: Runtime measurement for 50ms task / Maximum task runtime" UWORD TI0_01_M_M 1 100 0 655.35 FORMAT "%8.4" ECU_ADDRESS 0xFFF92434 /end MEASUREMENT
/begin MEASUREMENT RRT_adProcRunMax "F1620: Address of the n longest processes" ULONG X1_M 1 100 0 4294967295 FORMAT "%13.2" ARRAY_SIZE 5 ECU_ADDRESS 0xFFF92440 /end MEASUREMENT
/begin MEASUREMENT RRT_bCpuLd2Actv "F1620: Flag CPU utilization 2 calculation active" UBYTE B_TRUE_M 1 100 0 1 FORMAT "%13.11" ECU_ADDRESS 0xFFF950D4 /end MEASUREMENT
/begin MEASUREMENT RRT_idxProcFrst10 "F1620: Index table for the 10ms task" UWORD X1_M 1 100 0 65535 FORMAT "%8.2" ARRAY_SIZE 8 ECU_ADDRESS 0xFFF929BC /end MEASUREMENT
/begin MEASUREMENT RRT_idxProcFrst100 "F1620: Index table for the 100ms task" UWORD X1_M 1 100 0 65535 FORMAT "%8.2" ARRAY_SIZE 8 ECU_ADDRESS 0xFFF929CC /end MEASUREMENT
/begin MEASUREMENT RRT_idxProcFrst20 "F1620: Index table for the 20ms task" UWORD X1_M 1 100 0 65535 FORMAT "%8.2" ARRAY_SIZE 8 ECU_ADDRESS 0xFFF929DC /end MEASUREMENT
/begin MEASUREMENT RRT_idxProcFrst2X5 "F1620: Index table for the 2.5ms task" UWORD X1_M 1 100 0 65535 FORMAT "%8.2" ARRAY_SIZE 8 ECU_ADDRESS 0xFFF929EC /end MEASUREMENT
/begin MEASUREMENT RRT_idxProcFrst30 "F1620: Index table for the 30ms task" UWORD X1_M 1 100 0 65535 FORMAT "%8.2" ARRAY_SIZE 8 ECU_ADDRESS 0xFFF929FC /end MEASUREMENT
/begin MEASUREMENT RRT_idxProcFrst5 "F1620: Index table for the 5ms task" UWORD X1_M 1 100 0 65535 FORMAT "%8.2" ARRAY_SIZE 8 ECU_ADDRESS 0xFFF92A0C /end MEASUREMENT
/begin MEASUREMENT RRT_idxProcFrst50 "F1620: Index table for the 50ms task" UWORD X1_M 1 100 0 65535 FORMAT "%8.2" ARRAY_SIZE 8 ECU_ADDRESS 0xFFF92A1C /end MEASUREMENT
/begin MEASUREMENT RRT_idxProcFrstBG "F1620: Index table for the background task" UWORD X1_M 1 100 0 65535 FORMAT "%8.2" ARRAY_SIZE 8 ECU_ADDRESS 0xFFF92A2C /end MEASUREMENT
/begin MEASUREMENT RRT_idxProcFrstFN "F1620: Index table for the final initialization task" UWORD X1_M 1 100 0 65535 FORMAT "%8.2" ARRAY_SIZE 8 ECU_ADDRESS 0xFFF92A3C /end MEASUREMENT
/begin MEASUREMENT RRT_idxProcFrstTRS "F1620: Index table for the transition functions" UWORD X1_M 1 100 0 65535 FORMAT "%8.2" ARRAY_SIZE 8 ECU_ADDRESS 0xFFF92A4C /end MEASUREMENT
/begin MEASUREMENT RRT_rCpuLd "F1620: Current CPU utilization" UWORD R0_1_P_M 1 100 0 100 FORMAT "%8.4" ECU_ADDRESS 0xFFF94BE6 /end MEASUREMENT
/begin MEASUREMENT RRT_rCpuLd2 "F1620: Current CPU utilization 2 per measurement period" UWORD R0_1_P_M 1 100 0 100 FORMAT "%8.4" ECU_ADDRESS 0xFFF94BE8 /end MEASUREMENT
/begin MEASUREMENT RRT_rCpuLd2Avrg "F1620: Current CPU utilization 2 average value per 10 measurement periods" UWORD R0_1_P_M 1 100 0 100 FORMAT "%8.4" ECU_ADDRESS 0xFFF94BEA /end MEASUREMENT
/begin MEASUREMENT RRT_rCpuLd2AvrgMax "F1620: Maximum CPU utilization 2 average value per 10 measurement periods" UWORD R0_1_P_M 1 100 0 100 FORMAT "%8.4" ECU_ADDRESS 0xFFF94BEC /end MEASUREMENT
/begin MEASUREMENT RRT_rCpuLd2Max "F1620: Maximum CPU utilization 2 per measurement period" UWORD R0_1_P_M 1 100 0 100 FORMAT "%8.4" ECU_ADDRESS 0xFFF94BEE /end MEASUREMENT
/begin MEASUREMENT RRT_rCpuLdMax "F1620: Maximum CPU utilization" UWORD R0_1_P_M 1 100 0 100 FORMAT "%8.4" ECU_ADDRESS 0xFFF94BF0 /end MEASUREMENT
/begin MEASUREMENT RRT_tiLopCpuLd2 "F1620: Current execution time of loops for CPU load 2 calculation" SLONG TI0_001_M_M 1 100 0 200 FORMAT "%13.9" ECU_ADDRESS 0xFFF92438 /end MEASUREMENT
/begin MEASUREMENT RRT_tiMeasCpuLd2 "F1620: Current measurement time for CPU load 2 calculation" SLONG TI0_001_M_M 1 100 0 200 FORMAT "%13.9" ECU_ADDRESS 0xFFF9243C /end MEASUREMENT
/begin MEASUREMENT RRT_tiProcRun10 "F1620: Process runtimes of the 10ms task" UWORD TI0_001_M_M 1 100 0 65.535 FORMAT "%8.5" ARRAY_SIZE 120 ECU_ADDRESS 0xFFF92A5C /end MEASUREMENT
/begin MEASUREMENT RRT_tiProcRun100 "F1620: Process runtimes of the 100ms task" UWORD TI0_001_M_M 1 100 0 65.535 FORMAT "%8.5" ARRAY_SIZE 35 ECU_ADDRESS 0xFFF94C1E /end MEASUREMENT
/begin MEASUREMENT RRT_tiProcRun20 "F1620: Process runtimes of the 20ms task" UWORD TI0_001_M_M 1 100 0 65.535 FORMAT "%8.5" ARRAY_SIZE 35 ECU_ADDRESS 0xFFF94C64 /end MEASUREMENT
/begin MEASUREMENT RRT_tiProcRun2X5 "F1620: Process runtimes of the 2.5ms task" UWORD TI0_001_M_M 1 100 0 65.535 FORMAT "%8.5" ARRAY_SIZE 20 ECU_ADDRESS 0xFFF92B4C /end MEASUREMENT
/begin MEASUREMENT RRT_tiProcRun30 "F1620: Process runtimes of the 30ms task" UWORD TI0_001_M_M 1 100 0 65.535 FORMAT "%8.5" ARRAY_SIZE 50 ECU_ADDRESS 0xFFF92B74 /end MEASUREMENT
/begin MEASUREMENT RRT_tiProcRun5 "F1620: Process runtimes of the 5ms task" UWORD TI0_001_M_M 1 100 0 65.535 FORMAT "%8.5" ARRAY_SIZE 40 ECU_ADDRESS 0xFFF92BD8 /end MEASUREMENT
/begin MEASUREMENT RRT_tiProcRun50 "F1620: Process runtimes of the 50ms task" UWORD TI0_001_M_M 1 100 0 65.535 FORMAT "%8.5" ARRAY_SIZE 20 ECU_ADDRESS 0xFFF92C28 /end MEASUREMENT
/begin MEASUREMENT RRT_tiProcRunBG "F1620: Process runtimes of the background task" UWORD TI0_001_M_M 1 100 0 65.535 FORMAT "%8.5" ARRAY_SIZE 10 ECU_ADDRESS 0xFFF92C50 /end MEASUREMENT
/begin MEASUREMENT RRT_tiProcRunFN "F1620: Process runtimes of the final initialization task" UWORD TI0_001_M_M 1 100 0 65.535 FORMAT "%8.5" ARRAY_SIZE 45 ECU_ADDRESS 0xFFF94CAA /end MEASUREMENT
/begin MEASUREMENT RRT_tiProcRunMax "F1620: Runtime of the n longest processes" UWORD TI0_001_M_M 1 100 0 65.535 FORMAT "%8.5" ARRAY_SIZE 5 ECU_ADDRESS 0xFFF94BF2 /end MEASUREMENT
/begin MEASUREMENT RRT_tiProcRunSel "F1620: Runtime of the selected process" UWORD TI0_001_M_M 1 100 0 65.535 FORMAT "%8.5" ECU_ADDRESS 0xFFF94BFC /end MEASUREMENT
/begin MEASUREMENT RRT_tiProcRunSelMax "F1620: Maximum runtime of the selected process" UWORD TI0_001_M_M 1 100 0 65.535 FORMAT "%8.5" ECU_ADDRESS 0xFFF94BFE /end MEASUREMENT
/begin MEASUREMENT RRT_tiProcRunTRS "F1620: Process runtimes of the transition functions" UWORD TI0_001_M_M 1 100 0 65.535 FORMAT "%8.5" ARRAY_SIZE 55 ECU_ADDRESS 0xFFF94D04 /end MEASUREMENT
/begin MEASUREMENT SrvShr_ST_ILK_ERRM_FZM_CanSigRec "F9120: Vehicle State Manager: CAN signal received" UBYTE X1_M 1 100 0 255 FORMAT "%5.1" ECU_ADDRESS 0xFFF9540E /end MEASUREMENT
/begin MEASUREMENT SrvShr_SystemTime "F9120: System time client: System time" ULONG TI1_M 1 100 0 4294967295 FORMAT "%13.2" ECU_ADDRESS 0xFFF93F0C /end MEASUREMENT
/begin MEASUREMENT SrvShr_SysTimeInc_Counter "F9120: System time client: Timer to count til next increment of system time" UWORD TI0_01_M 1 100 0 655.35 FORMAT "%8.4" ECU_ADDRESS 0xFFF94DE0 /end MEASUREMENT
/begin MEASUREMENT SrvShr_SysTimeOut_Counter "F9120: System time client: Timeout counter" UWORD TI0_01_M 1 100 0 655.35 FORMAT "%8.4" ECU_ADDRESS 0xFFF94DE2 /end MEASUREMENT
/begin MEASUREMENT SrvShr_SysTime_BusOff "F9120: System time client: CAN bus not active" UBYTE X1_M 1 100 0 255 FORMAT "%5.1" ECU_ADDRESS 0xFFF95409 /end MEASUREMENT
/begin MEASUREMENT SrvShr_SysTime_CANSig "F9120: System time client: raw signal value from CAN" ULONG TI1_M 1 100 0 4294967295 FORMAT "%13.2" ECU_ADDRESS 0xFFF93F10 /end MEASUREMENT
/begin MEASUREMENT SrvShr_SysTime_CanSigRec "F9120: System time client: CAN signal received" UBYTE X1_M 1 100 0 255 FORMAT "%5.1" ECU_ADDRESS 0xFFF9540A /end MEASUREMENT
/begin MEASUREMENT SrvShr_SysTime_NextState "F9120: System time client: State pointer" UBYTE X1_M 1 100 0 255 FORMAT "%5.1" ECU_ADDRESS 0xFFF9540B /end MEASUREMENT
/begin MEASUREMENT SrvShr_SysTime_SigRec "F9120: System time client: Signal got from CAN IO" UBYTE X1_M 1 100 0 255 FORMAT "%5.1" ECU_ADDRESS 0xFFF9540C /end MEASUREMENT
/begin MEASUREMENT SrvShr_SysTime_SigValid "F9120: System time client: CAN signal valid - no error value" UBYTE X1_M 1 100 0 255 FORMAT "%5.1" ECU_ADDRESS 0xFFF9540D /end MEASUREMENT
/begin MEASUREMENT SrvShr_VSMC_EvalCANFltStoreState "F9120: Vehicle State Manager: State Pointer CAN evaluation" UBYTE X1_M 1 100 0 255 FORMAT "%5.1" ECU_ADDRESS 0xFFF9540F /end MEASUREMENT
/begin MEASUREMENT SrvShr_VSMC_EvalCANFltStoreTimer "F9120: Vehicle State Manager: Timer CAN evaluation" UWORD TI0_01_M 1 100 0 655.35 FORMAT "%8.4" ECU_ADDRESS 0xFFF94DEE /end MEASUREMENT
/begin MEASUREMENT SrvShr_VSMC_InhibitFltStore "F9120: Vehicle State Manager: Stored Status Fault inhibit" UBYTE X1_M 1 100 0 255 FORMAT "%5.1" ECU_ADDRESS 0xFFF95410 /end MEASUREMENT
/begin MEASUREMENT SrvShr_VSMC_StatusBusruhe "F9120: Vehicle State Manager: Stored Status Busruhe" UBYTE X1_M 1 100 0 255 FORMAT "%5.1" ECU_ADDRESS 0xFFF95411 /end MEASUREMENT
/begin MEASUREMENT TPRT_bTOutCtlActv "F4410: Flag, timeout control is active / not active (<>0 =active)" UBYTE X1_M 1 100 0 1 FORMAT "%5.3" ECU_ADDRESS 0xFFF954E1 /end MEASUREMENT
/begin MEASUREMENT TPRT_sCanMsgNew "F4410: State machine, shows the request of a new CAN message for TPRT (or overflow)" UBYTE X1_M 1 100 0 2 FORMAT "%5.3" ECU_ADDRESS 0xFFF954E2 /end MEASUREMENT
/begin MEASUREMENT TPRT_sOuCtrl "F4410: State machine for output control via OuCd" UBYTE X1_M 1 100 0 2 FORMAT "%5.3" ECU_ADDRESS 0xFFF954E3 /end MEASUREMENT
/begin MEASUREMENT TPRT_sScyLvl "F4410: Test protocol security level, state machine" UBYTE X1_M 1 100 0 3 FORMAT "%5.3" ECU_ADDRESS 0xFFF954E4 /end MEASUREMENT
/begin MEASUREMENT TPRT_tiComTOut "F4410: Timeout counter for TPRT communication timeout" UWORD TI1_CYCLE_M 1 100 0 6553.5 FORMAT "%8.3" ECU_ADDRESS 0xFFF95C4A /end MEASUREMENT
/begin MEASUREMENT TPRT_xCanMsgBufIn "F4410: Buffer for TPRT input message CAN" UBYTE X1_M 1 100 0 255 FORMAT "%5.1" ARRAY_SIZE 8 ECU_ADDRESS 0xFFF946D0 /end MEASUREMENT
/begin MEASUREMENT TPRT_xCanMsgBufOut "F4410: Buffer for TPRT output message CAN" UBYTE X1_M 1 100 0 255 FORMAT "%5.1" ARRAY_SIZE 8 ECU_ADDRESS 0xFFF946D8 /end MEASUREMENT
/begin MEASUREMENT TPRT_xMemDpBuf "F4410: Buffer for test protocol memory dump" UBYTE X1_M 1 100 0 255 FORMAT "%5.1" ARRAY_SIZE 100 ECU_ADDRESS 0xFFF946E0 /end MEASUREMENT
/begin MEASUREMENT TPRT_xSigValOff "F4410: Special output, signal value for signal OFF (e.g. current)" UWORD X1_M 1 100 0 65535 FORMAT "%8.2" ECU_ADDRESS 0xFFF94E88 /end MEASUREMENT
/begin MEASUREMENT TPRT_xSigValOn "F4410: Special output, signal value for signal ON (e.g. current)" UWORD X1_M 1 100 0 65535 FORMAT "%8.2" ECU_ADDRESS 0xFFF94E8A /end MEASUREMENT
/begin MEASUREMENT TPRT_xSrv_Seed "F4410: Data array to save the seed for later key calculation" UBYTE X1_M 1 100 0 255 FORMAT "%5.1" ARRAY_SIZE 8 ECU_ADDRESS 0xFFF94744 /end MEASUREMENT
/begin COMPU_METHOD B_TRUE_M "boolean states, positive logic" TAB_VERB "%6.3" "" COMPU_TAB_REF B_TRUE_M /end COMPU_METHOD
/begin COMPU_METHOD CanNmAppl_stBcTxA_t_M "" TAB_VERB "%6.3" "" COMPU_TAB_REF CanNmAppl_stBcTxA_t_M /end COMPU_METHOD
/begin COMPU_METHOD Nm_StateType_t_M "" TAB_VERB "%6.3" "" COMPU_TAB_REF Nm_StateType_t_M /end COMPU_METHOD
/begin COMPU_METHOD R0_1_P_M "[0.1%]" RAT_FUNC "%6.3" "%" COEFFS 0 10 0 0 0 1 /end COMPU_METHOD
/begin COMPU_METHOD TI0_001_M_M "[0.001ms] time" RAT_FUNC "%6.5" "ms" COEFFS 0 1000 0 0 0 1 /end COMPU_METHOD
/begin COMPU_METHOD TI0_01_M "[0.01s] time" RAT_FUNC "%6.4" "s" COEFFS 0 100 0 0 0 1 /end COMPU_METHOD
/begin COMPU_METHOD TI0_01_M_M "[0.01ms] time" RAT_FUNC "%6.4" "ms" COEFFS 0 100 0 0 0 1 /end COMPU_METHOD
/begin COMPU_METHOD TI0_1_M "[0.1s] time" RAT_FUNC "%6.3" "s" COEFFS 0 10 0 0 0 1 /end COMPU_METHOD
/begin COMPU_METHOD TI1_M "[1s] time" RAT_FUNC "%6.2" "s" COEFFS 0 1 0 0 0 1 /end COMPU_METHOD
/begin COMPU_METHOD TI1_CYCLE_M "[0.1s] resolution in multiples of 100ms task" RAT_FUNC "%6.3" "s" COEFFS 0 10 0 0 0 1 /end COMPU_METHOD
/begin COMPU_METHOD TI1_M_M "[1ms] time" RAT_FUNC "%6.2" "ms" COEFFS 0 1 0 0 0 1 /end COMPU_METHOD
/begin COMPU_METHOD TI1_M_CYCLE_M "[ms] resolution in multiples of main task (time*ROS_NUM_MNTSK_100MS_SY/100.0ms)" RAT_FUNC "%6.2" "ms" COEFFS 0 0.2 0 0 0 1 /end COMPU_METHOD
/begin COMPU_METHOD U0_001_M "[0.001V] voltage" RAT_FUNC "%6.5" "V" COEFFS 0 1000 0 0 0 1 /end COMPU_METHOD
/begin COMPU_METHOD X1_M "[1] no unit" RAT_FUNC "%6.2" "" COEFFS 0 1 0 0 0 1 /end COMPU_METHOD
/begin COMPU_METHOD default_M "" RAT_FUNC "%6.2" "" COEFFS 0 1 0 0 0 1 /end COMPU_METHOD
/begin COMPU_METHOD defaultAscii_M "" RAT_FUNC "%6.2" "" COEFFS 0 1 0 0 0 1 /end COMPU_METHOD
/begin COMPU_METHOD default_S1 "" RAT_FUNC "%6.2" "" COEFFS 0 1 0 0 0 1 /end COMPU_METHOD
/begin COMPU_METHOD defaultAscii_S1 "" RAT_FUNC "%6.2" "" COEFFS 0 1 0 0 0 1 /end COMPU_METHOD
/begin COMPU_METHOD _CNV_S_2_Enum_ENICA_19_CM_S2 "" TAB_VERB "%6.3" "" COMPU_TAB_REF _CNV_S_2_Enum_ENICA_19_S2 /end COMPU_METHOD
/begin COMPU_VTAB B_TRUE_M "boolean states, positive logic" TAB_VERB 2 0 "FALSE" 1 "TRUE" DEFAULT_VALUE "xxxxx" /end COMPU_VTAB
/begin COMPU_VTAB CanNmAppl_stBcTxA_t_M "" TAB_VERB 2 0 "CANNM_BCTXA_DISABLED" 1 "CANNM_BCTXA_ENABLED" DEFAULT_VALUE "xxxxx" /end COMPU_VTAB
/begin COMPU_VTAB Nm_StateType_t_M "" TAB_VERB 5 0 "NM_STATE_BUS_SLEEP" 1 "NM_STATE_PREPARE_BUS_SLEEP" 2 "NM_STATE_READY_SLEEP" 3 "NM_STATE_NORMAL_OPERATION" 4 "NM_STATE_REPEAT_MESSAGE" DEFAULT_VALUE "xxxxx" /end COMPU_VTAB
/begin COMPU_VTAB _CNV_S_2_Enum_ENICA_19_S2 "" TAB_VERB 2 0 "MOTOR_LAEUFT" 1 "VM_STARTET" /end COMPU_VTAB
/begin FUNCTION F1600_RCTMODE "F1600: Services for operating system mode handling" /begin OUT_MEASUREMENT RCT_sModeAct RCT_sModeActIdx RCT_sModeNxt RCT_tiModeChng /end OUT_MEASUREMENT /end FUNCTION
/begin FUNCTION F1600_RCTTKCFG "F1600: Services for task handling"
 /begin LOC_MEASUREMENT RctT10.ctActv RctT10.ctExe RctT10.ctOvrFlw RctT100.ctActv RctT100.ctExe RctT100.ctOvrFlw RctT20.ctActv RctT20.ctExe RctT20.ctOvrFlw RctT2x5.ctActv RctT2x5.ctExe RctT2x5.ctOvrFlw RctT30.ctActv RctT30.ctExe RctT30.ctOvrFlw RctT5.ctActv RctT5.ctExe RctT5.ctOvrFlw RctT50.ctActv RctT50.ctExe RctT50.ctOvrFlw /end LOC_MEASUREMENT
/end FUNCTION
/begin FUNCTION F1600_RCTTKINI "F1600: Initialization tasks" /begin OUT_MEASUREMENT RCT_bIniActvCYC RCT_sIniActvPT /end OUT_MEASUREMENT /end FUNCTION
/begin FUNCTION F1600_ROSDUMMY "F1600: Dummy variables for use as index of DAMOS tables" /begin OUT_MEASUREMENT ROS_idxDmy /end OUT_MEASUREMENT /end FUNCTION
/begin FUNCTION F1620_RRTCPU "F1620: Calculation of the CPU utilization" /begin DEF_CHARACTERISTIC RRT_swtCpuLd2_C RRT_tiLopCpuLd2_C RRT_tiMeasCpuLd2_C /end DEF_CHARACTERISTIC
 /begin OUT_MEASUREMENT RRT_bCpuLd2Actv RRT_rCpuLd RRT_rCpuLd2 RRT_rCpuLd2Avrg RRT_rCpuLd2AvrgMax RRT_rCpuLd2Max RRT_rCpuLdMax RRT_tiLopCpuLd2 RRT_tiMeasCpuLd2 /end OUT_MEASUREMENT
/end FUNCTION
/begin FUNCTION F1620_RRTFGCFG "F1620: Functional group runtime measurement"
 /begin LOC_MEASUREMENT RrtFgp0.tiRun RrtFgp0.tiRunMax RrtFgp1.tiRun RrtFgp1.tiRunMax RrtFgp2.tiRun RrtFgp2.tiRunMax RrtFgp3.tiRun RrtFgp3.tiRunMax RrtFgp4.tiRun RrtFgp4.tiRunMax RrtFgp5.tiRun RrtFgp5.tiRunMax RrtFgp6.tiRun RrtFgp6.tiRunMax RrtFgp7.tiRun RrtFgp7.tiRunMax RrtFgp8.tiRun RrtFgp8.tiRunMax RrtFgp9.tiRun RrtFgp9.tiRunMax /end LOC_MEASUREMENT
/end FUNCTION
/begin FUNCTION F1620_RRTIRCFG "F1620: Interrupt runtime measurement"
 /begin LOC_MEASUREMENT RrtIsr0.tiRunSum RrtIsr0.ctExe RrtIsr1.tiRunSum RrtIsr1.ctExe RrtIsr2.tiRunSum RrtIsr2.ctExe RrtIsr3.tiRunSum RrtIsr3.ctExe RrtIsr4.tiRunSum RrtIsr4.ctExe RrtIsr5.tiRunSum RrtIsr5.ctExe RrtIsr6.tiRunSum RrtIsr6.ctExe RrtIsr7.tiRunSum RrtIsr7.ctExe RrtIsr8.tiRunSum RrtIsr8.ctExe RrtIsrOS.tiRunSum RrtIsrOS.ctExe /end LOC_MEASUREMENT
/end FUNCTION
/begin FUNCTION F1620_RRTPRCFG "F1620: Process runtime measurement"
 /begin OUT_MEASUREMENT RRT_idxProcFrst10 RRT_idxProcFrst100 RRT_idxProcFrst20 RRT_idxProcFrst2X5 RRT_idxProcFrst30 RRT_idxProcFrst5 RRT_idxProcFrst50 RRT_idxProcFrstBG RRT_idxProcFrstFN RRT_idxProcFrstTRS RRT_tiProcRun10 RRT_tiProcRun100 RRT_tiProcRun20 RRT_tiProcRun2X5 RRT_tiProcRun30 RRT_tiProcRun5 RRT_tiProcRun50 RRT_tiProcRunBG RRT_tiProcRunFN RRT_tiProcRunTRS /end OUT_MEASUREMENT
/end FUNCTION
/begin FUNCTION F1620_RRTPROC "F1620: Process runtime measurement"
 /begin DEF_CHARACTERISTIC RRT_adProcRunSel_C RRT_swtProcCtlAll_C RRT_swtProcCtl_C RRT_swtProcRst_C RRT_tiProcRunLoLim_C /end DEF_CHARACTERISTIC
 /begin IN_MEASUREMENT ROS_idxDmy /end IN_MEASUREMENT
 /begin OUT_MEASUREMENT RRT_adProcRunMax RRT_tiProcRunMax RRT_tiProcRunSel RRT_tiProcRunSelMax /end OUT_MEASUREMENT
/end FUNCTION
/begin FUNCTION F1620_RRTTKCFG "F1620: Task runtime measurement"
 /begin LOC_MEASUREMENT RrtT10.tiPer RrtT10.tiRun RrtT10.tiRunMax RrtT100.tiPer RrtT100.tiRun RrtT100.tiRunMax RrtT20.tiPer RrtT20.tiRun RrtT20.tiRunMax RrtT2x5.tiPer RrtT2x5.tiRun RrtT2x5.tiRunMax RrtT30.tiPer RrtT30.tiRun RrtT30.tiRunMax RrtT5.tiPer RrtT5.tiRun RrtT5.tiRunMax RrtT50.tiPer RrtT50.tiRun RrtT50.tiRunMax /end LOC_MEASUREMENT
/end FUNCTION
/begin FUNCTION F1630_RMNTKCFG "F1630: Task monitoring"
 /begin DEF_CHARACTERISTIC RmnT100_tiMon_C RmnT100_tiTOutSngl_C RmnT100_tiTOut_C RmnT10_tiMon_C RmnT10_tiTOutSngl_C RmnT10_tiTOut_C RmnT20_tiMon_C RmnT20_tiTOutSngl_C RmnT20_tiTOut_C RmnT30_tiMon_C RmnT30_tiTOutSngl_C RmnT30_tiTOut_C RmnT50_tiMon_C RmnT50_tiTOutSngl_C RmnT50_tiTOut_C RmnT5_tiMon_C RmnT5_tiTOutSngl_C RmnT5_tiTOut_C /end DEF_CHARACTERISTIC
 /begin LOC_MEASUREMENT RmnT10.sMon RmnT10.tiOvrFlw RmnT10.ctStop RmnT10.ctStrt RmnT10.tiStrt RmnT100.sMon RmnT100.tiOvrFlw RmnT100.ctStop RmnT100.ctStrt RmnT100.tiStrt RmnT20.sMon RmnT20.tiOvrFlw RmnT20.ctStop RmnT20.ctStrt RmnT20.tiStrt RmnT30.sMon RmnT30.tiOvrFlw RmnT30.ctStop RmnT30.ctStrt RmnT30.tiStrt RmnT5.sMon RmnT5.tiOvrFlw RmnT5.ctStop RmnT5.ctStrt RmnT5.tiStrt RmnT50.sMon RmnT50.tiOvrFlw RmnT50.ctStop RmnT50.ctStrt RmnT50.tiStrt /end LOC_MEASUREMENT
/end FUNCTION
/begin FUNCTION F1730_OmmMdSw "F1730: Mode Switch"
 /begin OUT_MEASUREMENT OmmMdSw_sOpMCur OmmMdSw_sOpMDest OmmMdSw_sOpMInt OmmMdSw_sOpMReq /end OUT_MEASUREMENT
/end FUNCTION
/begin FUNCTION F2050_CNE "F2050: CNE interface" /begin DEF_CHARACTERISTIC CNE_numAlvTol_C /end DEF_CHARACTERISTIC /begin OUT_MEASUREMENT CNE_cfMsgRx /end OUT_MEASUREMENT /end FUNCTION
/begin FUNCTION F2062_CAN_MSGMON_1 "F2062: CAN interface"
 /begin DEF_CHARACTERISTIC CANFA_ctMsgMonAlvACLNX_MASSCNTR_C CANFA_ctMsgMonAlvACLNY_MASSCNTR_C CANFA_ctMsgMonAlvANG_ACPD_C CANFA_ctMsgMonAlvAVL_BRTORQ_SUM_C CANFA_ctMsgMonAlvKLEMMEN_C CANFA_ctMsgMonAlvMASS_VEH_C CANFA_ctMsgMonAlvOP_SPD_C CANFA_ctMsgMonAlvSTAT_DS_VRFD_C CANFA_ctMsgMonAlvST_BLT_CT_SOCCU_C CANFA_ctMsgMonAlvST_GWS_C CANFA_ctMsgMonAlvST_STAB_DSC_C CANFA_ctMsgMonAlvST_VEHSS_PBRK_C CANFA_ctMsgMonAlvST_VHSS_C CANFA_ctMsgMonAlvSU_SW_DRDY_C CANFA_ctMsgMonAlvTLT_RW_C CANFA_ctMsgMonAlvTORQ_CRSH_1_C CANFA_ctMsgMonAlvTORQ_PT_HYB_1_C CANFA_ctMsgMonAlvVYAW_VEH_C CANFA_ctMsgMonAlvV_VEH_C CANFA_ctMsgMonAlvWMOM_DRV_1_C CANFA_ctMsgMonChkACLNX_MASSCNTR_C CANFA_ctMsgMonChkACLNY_MASSCNTR_C CANFA_ctMsgMonChkANG_ACPD_C CANFA_ctMsgMonChkAVL_BRTORQ_SUM_C CANFA_ctMsgMonChkKLEMMEN_C CANFA_ctMsgMonChkMASS_VEH_C CANFA_ctMsgMonChkOP_SPD_C CANFA_ctMsgMonChkSTAT_DS_VRFD_C CANFA_ctMsgMonChkST_BLT_CT_SOCCU_C CANFA_ctMsgMonChkST_GWS_C CANFA_ctMsgMonChkST_STAB_DSC_C CANFA_ctMsgMonChkST_VEHSS_PBRK_C CANFA_ctMsgMonChkST_VHSS_C CANFA_ctMsgMonChkSU_SW_DRDY_C CANFA_ctMsgMonChkTLT_RW_C CANFA_ctMsgMonChkTORQ_CRSH_1_C CANFA_ctMsgMonChkTORQ_PT_HYB_1_C CANFA_ctMsgMonChkVYAW_VEH_C CANFA_ctMsgMonChkV_VEH_C CANFA_ctMsgMonChkWMOM_DRV_1_C CANFA_ctMsgMonDlcACLNX_MASSCNTR_C CANFA_ctMsgMonDlcACLNY_MASSCNTR_C CANFA_ctMsgMonDlcANG_ACPD_C CANFA_ctMsgMonDlcAVL_BRTORQ_SUM_C CANFA_ctMsgMonDlcAVL_RPM_WHL_UPRT_C CANFA_ctMsgMonDlcA_TEMP_C CANFA_ctMsgMonDlcBLINKEN_C CANFA_ctMsgMonDlcDIAG_OBD_ENG_C CANFA_ctMsgMonDlcDT_PT_1_C CANFA_ctMsgMonDlcFAHRGESTELLNUMMER_C CANFA_ctMsgMonDlcFLLUPT_GPWSUP_C CANFA_ctMsgMonDlcFZZSTD_C CANFA_ctMsgMonDlcKILOMETERSTAND_C CANFA_ctMsgMonDlcKLEMMEN_C CANFA_ctMsgMonDlcMASS_VEH_C CANFA_ctMsgMonDlcNAV_GRAPH_C CANFA_ctMsgMonDlcNAV_GRAPH_LNE_C CANFA_ctMsgMonDlcNAV_GRAPH_MAPDATA_C CANFA_ctMsgMonDlcNAV_GRAPH_MATCH_C CANFA_ctMsgMonDlcNAV_GRAPH_SYNC_C CANFA_ctMsgMonDlcNAV_GRAPH_V_C CANFA_ctMsgMonDlcNAV_SYS_INF_C CANFA_ctMsgMonDlcOP_SPD_C CANFA_ctMsgMonDlcRELATIVZEIT_C CANFA_ctMsgMonDlcRQ_CLT_C CANFA_ctMsgMonDlcSTAT_ANHAENGER_C CANFA_ctMsgMonDlcSTAT_CT_HABR_C CANFA_ctMsgMonDlcSTAT_DS_VRFD_C CANFA_ctMsgMonDlcSTAT_ZV_KLAPPEN_C CANFA_ctMsgMonDlcSTEA_FTAX_EFFV_C CANFA_ctMsgMonDlcST_BLT_CT_SOCCU_C CANFA_ctMsgMonDlcST_DISP_DRDY_C CANFA_ctMsgMonDlcST_GWS_C CANFA_ctMsgMonDlcST_STAB_DSC_C CANFA_ctMsgMonDlcST_STA_PWR_DRV_C CANFA_ctMsgMonDlcST_VEHSS_PBRK_C CANFA_ctMsgMonDlcST_VHSS_C CANFA_ctMsgMonDlcSU_SW_DRDY_C CANFA_ctMsgMonDlcTLT_RW_C CANFA_ctMsgMonDlcTOMA_WHL_C CANFA_ctMsgMonDlcTORQ_CRSH_1_C CANFA_ctMsgMonDlcTORQ_PT_HYB_1_C CANFA_ctMsgMonDlcVYAW_VEH_C CANFA_ctMsgMonDlcV_VEH_C CANFA_ctMsgMonDlcWMOM_DRV_1_C CANFA_swtMsgMonACLNX_MASSCNTR_C CANFA_swtMsgMonACLNY_MASSCNTR_C CANFA_swtMsgMonANG_ACPD_C CANFA_swtMsgMonAVL_BRTORQ_SUM_C CANFA_swtMsgMonAVL_RPM_WHL_UPRT_C CANFA_swtMsgMonA_TEMP_C CANFA_swtMsgMonBLINKEN_C CANFA_swtMsgMonDIAG_OBD_ENG_C CANFA_swtMsgMonDT_PT_1_C CANFA_swtMsgMonFAHRGESTELLNUMMER_C CANFA_swtMsgMonFLLUPT_GPWSUP_C CANFA_swtMsgMonFZZSTD_C CANFA_swtMsgMonKILOMETERSTAND_C CANFA_swtMsgMonKLEMMEN_C CANFA_swtMsgMonMASS_VEH_C CANFA_swtMsgMonNAV_GRAPH_C CANFA_swtMsgMonNAV_GRAPH_LNE_C CANFA_swtMsgMonNAV_GRAPH_MAPDATA_C CANFA_swtMsgMonNAV_GRAPH_MATCH_C CANFA_swtMsgMonNAV_GRAPH_SYNC_C CANFA_swtMsgMonNAV_GRAPH_V_C CANFA_swtMsgMonNAV_SYS_INF_C CANFA_swtMsgMonOP_SPD_C CANFA_swtMsgMonRELATIVZEIT_C CANFA_swtMsgMonRQ_CLT_C CANFA_swtMsgMonSTAT_ANHAENGER_C CANFA_swtMsgMonSTAT_CT_HABR_C CANFA_swtMsgMonSTAT_DS_VRFD_C CANFA_swtMsgMonSTAT_ZV_KLAPPEN_C CANFA_swtMsgMonSTEA_FTAX_EFFV_C CANFA_swtMsgMonST_BLT_CT_SOCCU_C CANFA_swtMsgMonST_DISP_DRDY_C CANFA_swtMsgMonST_GWS_C CANFA_swtMsgMonST_STAB_DSC_C CANFA_swtMsgMonST_STA_PWR_DRV_C CANFA_swtMsgMonST_VEHSS_PBRK_C CANFA_swtMsgMonST_VHSS_C CANFA_swtMsgMonSU_SW_DRDY_C CANFA_swtMsgMonTLT_RW_C CANFA_swtMsgMonTOMA_WHL_C CANFA_swtMsgMonTORQ_CRSH_1_C CANFA_swtMsgMonTORQ_PT_HYB_1_C CANFA_swtMsgMonVYAW_VEH_C CANFA_swtMsgMonV_VEH_C CANFA_swtMsgMonWMOM_DRV_1_C /end DEF_CHARACTERISTIC
 /begin OUT_MEASUREMENT CANFA_ACLNX_MASSCNTR CANFA_ACLNX_MASSCNTR_DATA CANFA_ACLNX_MASSCNTR_RAW CANFA_ACLNY_MASSCNTR CANFA_ACLNY_MASSCNTR_DATA CANFA_ACLNY_MASSCNTR_RAW CANFA_ANG_ACPD CANFA_ANG_ACPD_DATA CANFA_ANG_ACPD_RAW CANFA_AVL_BRTORQ_SUM CANFA_AVL_BRTORQ_SUM_COMP CANFA_AVL_BRTORQ_SUM_COMPSTA CANFA_AVL_BRTORQ_SUM_DATA CANFA_AVL_BRTORQ_SUM_RAW CANFA_AVL_RPM_WHL_UPRT CANFA_AVL_RPM_WHL_UPRT_DATA CANFA_AVL_RPM_WHL_UPRT_RAW CANFA_A_TEMP CANFA_A_TEMP_DATA CANFA_A_TEMP_RAW CANFA_BLINKEN CANFA_BLINKEN_DATA CANFA_BLINKEN_RAW CANFA_DIAG_OBD_ENG CANFA_DIAG_OBD_ENG_DATA CANFA_DIAG_OBD_ENG_RAW CANFA_DT_DISP_GRDT CANFA_DT_DISP_GRDT_DATA CANFA_DT_DISP_GRDT_RAW CANFA_DT_PT_1 CANFA_DT_PT_1_DATA CANFA_DT_PT_1_RAW CANFA_FAHRGESTELLNUMMER CANFA_FAHRGESTELLNUMMER_DATA CANFA_FAHRGESTELLNUMMER_RAW CANFA_FLLUPT_GPWSUP CANFA_FLLUPT_GPWSUP_DATA CANFA_FLLUPT_GPWSUP_RAW CANFA_FZZSTD CANFA_FZZSTD_DATA CANFA_FZZSTD_RAW CANFA_KILOMETERSTAND CANFA_KILOMETERSTAND_DATA CANFA_KILOMETERSTAND_RAW CANFA_KLEMMEN CANFA_KLEMMEN_COMP CANFA_KLEMMEN_COMPSTA CANFA_KLEMMEN_DATA CANFA_KLEMMEN_RAW CANFA_MASS_VEH CANFA_MASS_VEH_DATA CANFA_MASS_VEH_RAW CANFA_NAV_GRAPH CANFA_NAV_GRAPH_DATA CANFA_NAV_GRAPH_LNE CANFA_NAV_GRAPH_LNE_DATA CANFA_NAV_GRAPH_LNE_RAW CANFA_NAV_GRAPH_MAPDATA CANFA_NAV_GRAPH_MAPDATA_DATA CANFA_NAV_GRAPH_MAPDATA_RAW CANFA_NAV_GRAPH_MATCH CANFA_NAV_GRAPH_MATCH_DATA CANFA_NAV_GRAPH_MATCH_RAW CANFA_NAV_GRAPH_RAW CANFA_NAV_GRAPH_SYNC CANFA_NAV_GRAPH_SYNC_DATA CANFA_NAV_GRAPH_SYNC_RAW CANFA_NAV_GRAPH_V CANFA_NAV_GRAPH_V_DATA CANFA_NAV_GRAPH_V_RAW CANFA_NAV_SYS_INF CANFA_NAV_SYS_INF_DATA CANFA_NAV_SYS_INF_RAW CANFA_OP_SPD CANFA_OP_SPD_DATA CANFA_OP_SPD_RAW CANFA_RELATIVZEIT CANFA_RELATIVZEIT_DATA CANFA_RELATIVZEIT_RAW CANFA_RQ_CLT CANFA_RQ_CLT_DATA CANFA_RQ_CLT_RAW CANFA_STAT_ANHAENGER CANFA_STAT_ANHAENGER_DATA CANFA_STAT_ANHAENGER_RAW CANFA_STAT_CT_HABR CANFA_STAT_CT_HABR_DATA CANFA_STAT_CT_HABR_RAW CANFA_STAT_DS_VRFD CANFA_STAT_DS_VRFD_DATA CANFA_STAT_DS_VRFD_RAW CANFA_STAT_ZV_KLAPPEN CANFA_STAT_ZV_KLAPPEN_DATA CANFA_STAT_ZV_KLAPPEN_RAW CANFA_STEA_FTAX_EFFV CANFA_STEA_FTAX_EFFV_DATA CANFA_STEA_FTAX_EFFV_RAW CANFA_ST_BLT_CT_SOCCU CANFA_ST_BLT_CT_SOCCU_DATA CANFA_ST_BLT_CT_SOCCU_RAW CANFA_ST_DISP_DRDY CANFA_ST_DISP_DRDY_DATA CANFA_ST_DISP_DRDY_RAW CANFA_ST_GRB_ECU CANFA_ST_GRB_ECU_DATA CANFA_ST_GRB_ECU_RAW CANFA_ST_GWS CANFA_ST_GWS_COMP CANFA_ST_GWS_COMPSTA CANFA_ST_GWS_DATA CANFA_ST_GWS_RAW CANFA_ST_STAB_DSC CANFA_ST_STAB_DSC_COMP CANFA_ST_STAB_DSC_COMPSTA CANFA_ST_STAB_DSC_DATA CANFA_ST_STAB_DSC_RAW CANFA_ST_STA_PWR_DRV CANFA_ST_STA_PWR_DRV_DATA CANFA_ST_STA_PWR_DRV_RAW CANFA_ST_VEHSS_PBRK CANFA_ST_VEHSS_PBRK_DATA CANFA_ST_VEHSS_PBRK_RAW CANFA_ST_VHSS CANFA_ST_VHSS_DATA CANFA_ST_VHSS_RAW CANFA_SU_SW_DRDY CANFA_SU_SW_DRDY_DATA CANFA_SU_SW_DRDY_RAW CANFA_TLT_RW CANFA_TLT_RW_DATA CANFA_TLT_RW_RAW CANFA_TOMA_WHL CANFA_TOMA_WHL_DATA CANFA_TOMA_WHL_RAW CANFA_TORQ_CRSH_1 CANFA_TORQ_CRSH_1_COMP CANFA_TORQ_CRSH_1_COMPSTA CANFA_TORQ_CRSH_1_DATA CANFA_TORQ_CRSH_1_RAW CANFA_TORQ_GRB_HYB CANFA_TORQ_GRB_HYB_DATA CANFA_TORQ_PT_HYB_1 CANFA_TORQ_PT_HYB_1_DATA CANFA_TORQ_PT_HYB_1_RAW CANFA_VYAW_VEH CANFA_VYAW_VEH_DATA CANFA_VYAW_VEH_RAW CANFA_V_VEH CANFA_V_VEH_DATA CANFA_V_VEH_RAW CANFA_WMOM_DRV_1 CANFA_WMOM_DRV_1_DATA CANFA_WMOM_DRV_1_RAW /end OUT_MEASUREMENT
/end FUNCTION
/begin FUNCTION F2062_CAN_MSGMON_2 "F2062: CAN interface"
 /begin DEF_CHARACTERISTIC CAN_ctMsgMonAlvAVL_DT_MOT_1_C CAN_ctMsgMonAlvDT_PT_2_C CAN_ctMsgMonAlvHYB_SPEC_C CAN_ctMsgMonAlvSTAT_ENG_STA_AUTO_C CAN_ctMsgMonAlvST_GWS_C CAN_ctMsgMonAlvTORQ_CRSH_2_C CAN_ctMsgMonAlvTORQ_CRSH_3_C CAN_ctMsgMonAlvWMOM_DRV_3_C CAN_ctMsgMonAlvWMOM_DRV_7_C CAN_ctMsgMonChkAVL_DT_MOT_1_C CAN_ctMsgMonChkDT_PT_2_C CAN_ctMsgMonChkHYB_SPEC_C CAN_ctMsgMonChkSTAT_ENG_STA_AUTO_C CAN_ctMsgMonChkST_GWS_C CAN_ctMsgMonChkTORQ_CRSH_2_C CAN_ctMsgMonChkTORQ_CRSH_3_C CAN_ctMsgMonChkWMOM_DRV_3_C CAN_ctMsgMonChkWMOM_DRV_7_C CAN_ctMsgMonDlcAVL_DT_MOT_1_C CAN_ctMsgMonDlcDIAG_OBD_ENG_C CAN_ctMsgMonDlcDT_DRV_EL_C CAN_ctMsgMonDlcDT_PT_2_C CAN_ctMsgMonDlcFLLUPT_GPWSUP_C CAN_ctMsgMonDlcHYB_SPEC_C CAN_ctMsgMonDlcPSBTY_ENGSTA_ENSTP_C CAN_ctMsgMonDlcSPEC_HVSTO_C CAN_ctMsgMonDlcSPEC_TORQ_TRCT_LT_C CAN_ctMsgMonDlcSTAT_ENG_STA_AUTO_C CAN_ctMsgMonDlcSTAT_HVSTO_2_C CAN_ctMsgMonDlcST_GWS_C CAN_ctMsgMonDlcST_HYB_2_C CAN_ctMsgMonDlcTORQ_CRSH_2_C CAN_ctMsgMonDlcTORQ_CRSH_3_C CAN_ctMsgMonDlcWMOM_DRV_3_C CAN_ctMsgMonDlcWMOM_DRV_7_C CAN_swtMsgMonAVL_DT_MOT_1_C CAN_swtMsgMonDIAG_OBD_ENG_C CAN_swtMsgMonDT_DRV_EL_C CAN_swtMsgMonDT_PT_2_C CAN_swtMsgMonFLLUPT_GPWSUP_C CAN_swtMsgMonHYB_SPEC_C CAN_swtMsgMonPSBTY_ENGSTA_ENSTP_C CAN_swtMsgMonSPEC_HVSTO_C CAN_swtMsgMonSPEC_TORQ_TRCT_LT_C CAN_swtMsgMonSTAT_ENG_STA_AUTO_C CAN_swtMsgMonSTAT_HVSTO_2_C CAN_swtMsgMonST_GWS_C CAN_swtMsgMonST_HYB_2_C CAN_swtMsgMonTORQ_CRSH_2_C CAN_swtMsgMonTORQ_CRSH_3_C CAN_swtMsgMonWMOM_DRV_3_C CAN_swtMsgMonWMOM_DRV_7_C /end DEF_CHARACTERISTIC
 /begin OUT_MEASUREMENT CAN_AVL_DT_MOT_1 CAN_AVL_DT_MOT_1_COMP CAN_AVL_DT_MOT_1_COMPSTA CAN_AVL_DT_MOT_1_DATA CAN_AVL_DT_MOT_1_RAW CAN_DIAG_OBD_ENG CAN_DIAG_OBD_ENG_DATA CAN_DIAG_OBD_ENG_RAW CAN_DIAG_OBD_GRB CAN_DIAG_OBD_GRB_DATA CAN_DIAG_OBD_GRB_RAW CAN_DISP_RPM_ENG_DYNS CAN_DISP_RPM_ENG_DYNS_DATA CAN_DT_DISP_GRDT CAN_DT_DISP_GRDT_DATA CAN_DT_DISP_GRDT_RAW CAN_DT_DRV_EL CAN_DT_DRV_EL_DATA CAN_DT_DRV_EL_RAW CAN_DT_GRDT CAN_DT_GRDT_DATA CAN_DT_PT_2 CAN_DT_PT_2_COMP CAN_DT_PT_2_COMPSTA CAN_DT_PT_2_DATA CAN_DT_PT_2_RAW CAN_FLLUPT_GPWSUP CAN_FLLUPT_GPWSUP_DATA CAN_FLLUPT_GPWSUP_RAW CAN_HYB_SPEC CAN_HYB_SPEC_COMP CAN_HYB_SPEC_COMPSTA CAN_HYB_SPEC_DATA CAN_HYB_SPEC_RAW CAN_PSBTY_ENGSTA_ENSTP CAN_PSBTY_ENGSTA_ENSTP_DATA CAN_PSBTY_ENGSTA_ENSTP_RAW CAN_RQ_TORQ_CRSH_GRB CAN_RQ_TORQ_CRSH_GRB_2 CAN_RQ_TORQ_CRSH_GRB_2_DATA CAN_RQ_TORQ_CRSH_GRB_DATA CAN_SPEC_HVSTO CAN_SPEC_HVSTO_DATA CAN_SPEC_HVSTO_RAW CAN_SPEC_TORQ_TRCT_LT CAN_SPEC_TORQ_TRCT_LT_DATA CAN_SPEC_TORQ_TRCT_LT_RAW CAN_STAT_ENG_STA_AUTO CAN_STAT_ENG_STA_AUTO_COMP CAN_STAT_ENG_STA_AUTO_COMPSTA CAN_STAT_ENG_STA_AUTO_DATA CAN_STAT_ENG_STA_AUTO_RAW CAN_STAT_HVSTO_2 CAN_STAT_HVSTO_2_DATA CAN_STAT_HVSTO_2_RAW CAN_ST_GRB_ECU CAN_ST_GRB_ECU_DATA CAN_ST_GRB_ECU_RAW CAN_ST_GRB_HYB CAN_ST_GRB_HYB_DATA CAN_ST_GRB_HYB_RAW CAN_ST_GWS CAN_ST_GWS_COMP CAN_ST_GWS_COMPSTA CAN_ST_GWS_DATA CAN_ST_GWS_RAW CAN_ST_HYB_2 CAN_ST_HYB_2_DATA CAN_ST_HYB_2_RAW CAN_TAR_DT_GRB_MOT_1 CAN_TAR_DT_GRB_MOT_1_DATA CAN_TORQ_CRSH_2 CAN_TORQ_CRSH_2_DATA CAN_TORQ_CRSH_2_RAW CAN_TORQ_CRSH_3 CAN_TORQ_CRSH_3_COMP CAN_TORQ_CRSH_3_COMPSTA CAN_TORQ_CRSH_3_DATA CAN_TORQ_CRSH_3_RAW CAN_WMOM_DRV_3 CAN_WMOM_DRV_3_DATA CAN_WMOM_DRV_3_RAW CAN_WMOM_DRV_7 CAN_WMOM_DRV_7_DATA CAN_WMOM_DRV_7_RAW /end OUT_MEASUREMENT
/end FUNCTION
/begin FUNCTION F2063_CNE_BUSOFF "F2063: CNE interface"
 /begin DEF_CHARACTERISTIC CAN_stNodePerLine_C CAN_swtErrPasDet_C CAN_tiBusOffChk_C CAN_tiBusOffDly1_C CAN_tiBusOffDly2_C CAN_tiErrPasDly_C /end DEF_CHARACTERISTIC
 /begin OUT_MEASUREMENT CAN_bBusOff CAN_bErrPas CAN_stBusOff CAN_stErrPas CAN_stLine CAN_tiBusOff CAN_tiErrPas /end OUT_MEASUREMENT
/end FUNCTION
/begin FUNCTION F2070_CAN_SEND_PREP "F2070: CAN system interface"
 /begin DEF_CHARACTERISTIC CANFA_swtMsgSlw_ST_BLT_CT_SOCCU_C CAN_TIDEB_DIAG_OBD_GRB_C CAN_TIDEB_DT_DISP_GRDT_C CAN_TIDEB_ST_GRB_ECU_C CAN_TIDEB_ST_GRB_HYB_C /end DEF_CHARACTERISTIC
 /begin OUT_MEASUREMENT CanFA_tiEventMsgDelayDT_DISP_GRDT CanFA_tiEventMsgDelayST_GRB_ECU Can_tiEventMsgDelayDIAG_OBD_GRB Can_tiEventMsgDelayDT_DISP_GRDT Can_tiEventMsgDelayST_GRB_ECU Can_tiEventMsgDelayST_GRB_HYB /end OUT_MEASUREMENT
/end FUNCTION
/begin FUNCTION F2671_CANDRV "F2671: CAN Driver measurement variables"
 /begin OUT_MEASUREMENT can_flags can_msgbuffers_enabled can_msgbuffers_extid can_msgbuffers_rxtx can_msginterrupts can_nodeinterruptmask can_nodestate_cur can_nodestate_req can_node_operationmode /end OUT_MEASUREMENT
/end FUNCTION
/begin FUNCTION F2675_CAN_M "F2675: CAN Handler measurement variables"
 /begin OUT_MEASUREMENT Can_MsgBuffer_u8 Can_MsgInBuffer_u16 Can_MsgStatus_u8 Can_NodeBaudrate_u32 Can_NodeStatus_u16 /end OUT_MEASUREMENT
/end FUNCTION
/begin FUNCTION F4100_I14229_APPL "F4100: Calibration data for UDS"
 /begin DEF_CHARACTERISTIC COM_swtICFshPrg_C SWI_ComPreCond_EnrgModeFlash SWI_ComPreCond_EnrgModeNormal SWI_ComPreCond_EnrgModeProd SWI_ComPreCond_EnrgModeTrans /end DEF_CHARACTERISTIC
 /begin OUT_MEASUREMENT I14229_stOrigInit I14229_xInitDne /end OUT_MEASUREMENT
/end FUNCTION
/begin FUNCTION F4205_I15031APPL "F4205: OBD-configuration" /begin DEF_CHARACTERISTIC I15031APPL_TimeoutLimit /end DEF_CHARACTERISTIC /end FUNCTION
/begin FUNCTION F4410_TPRTData "F4410: Test Protocol Data Structures" /begin DEF_CHARACTERISTIC TPRT_tiComTOutStrt /end DEF_CHARACTERISTIC
 /begin OUT_MEASUREMENT TPRT_bTOutCtlActv TPRT_sCanMsgNew TPRT_sOuCtrl TPRT_sScyLvl TPRT_tiComTOut TPRT_xCanMsgBufIn TPRT_xCanMsgBufOut TPRT_xMemDpBuf TPRT_xSigValOff TPRT_xSigValOn TPRT_xSrv_Seed /end OUT_MEASUREMENT
/end FUNCTION
/begin FUNCTION F4450_CAN_NM "F2050: CAN interface" /begin OUT_MEASUREMENT IO_ctmsgNM_ACAN IO_ctmsgNM_FACAN /end OUT_MEASUREMENT /end FUNCTION
/begin FUNCTION F4450_Nm "F4450: Nm"
 /begin LOC_MEASUREMENT Nm_var_s[0].stNmFlags_b32 Nm_var_s[0].tiNmNodeDetectionLockTime_u32 Nm_var_s[0].tiRemoteSleepIndTime_u32 Nm_var_s[0].tiNmTimeoutTime_u32 Nm_var_s[0].tiNmWaitBusSleepTime_u32 Nm_var_s[0].tiNmRepeatMessageTime_u32 Nm_var_s[0].numSizeOfNodeIdList_u8 Nm_var_s[0].nmRemoteSleepInd_b Nm_var_s[0].nmNodeIdListStatus_b Nm_var_s[0].stNmState_e /end LOC_MEASUREMENT
/end FUNCTION
/begin FUNCTION F4451_CanNm "F4451: CanNm"
 /begin LOC_MEASUREMENT CanNm_var_s[0].tiMsg_Cycle_Time_u32 CanNm_var_s[0].tiMsg_Timeout_Time_u32 CanNm_var_s[0].tiMsgCycleTime_Offset_u32 CanNm_var_s[0].stCanNmFlags_b32 CanNm_var_s[0].dRxUserData_u8 CanNm_var_s[0].dSendBuffer_s CanNm_var_s[0].numNodeIdOfLastMsg /end LOC_MEASUREMENT
/end FUNCTION
/begin FUNCTION F4451_CanNmAppl "F4451: CanNmAppl"
 /begin LOC_MEASUREMENT CanNmAppl_var_s[0].stBcTxA CanNmAppl_var_s[0].msgCnt_TxConfirmation_u16 CanNmAppl_var_s[0].msgCnt_RxIndication_u16 CanNmAppl_var_s[1].stBcTxA CanNmAppl_var_s[1].msgCnt_TxConfirmation_u16 CanNmAppl_var_s[1].msgCnt_RxIndication_u16 /end LOC_MEASUREMENT
/end FUNCTION
/begin FUNCTION F4480_COMCTL "F4480: Communication Control" /begin DEF_CHARACTERISTIC ComCtl_swtLoLimUsd_C ComCtl_uLoLim_C /end DEF_CHARACTERISTIC
 /begin OUT_MEASUREMENT ComCtl_stIfcTxCom ComCtl_stLstRun ComCtl_stRxTxCom ComCtl_stRxTxNm ComCtl_stRxTxUsd /end OUT_MEASUREMENT
/end FUNCTION
/begin FUNCTION F4611_LINAPPL_EXP "F4611: LIN exported signals" /begin DEF_CHARACTERISTIC LinAppl_Exp_RlvntBus_C LIN_swtMsgMon_C /end DEF_CHARACTERISTIC /end FUNCTION
/begin FUNCTION F4612_LINAPPL_IFC "Interface between application layer and low level driver"
 /begin DEF_CHARACTERISTIC LinAppl_Ifc_Frm_ComDir_C LinAppl_Ifc_Frm_ID_C LinAppl_Ifc_SchedTabCfg_C LinAppl_Ifc_swtMsgMonFRAME_C /end DEF_CHARACTERISTIC
 /begin OUT_MEASUREMENT LinAppl_Ifc_CusRx2MsgID LinAppl_Ifc_CusRx2MsgID_Size LinAppl_Ifc_CustRx2RbIdx LinAppl_Ifc_CustTx2RbIdx LinAppl_Ifc_CusTx2MsgID LinAppl_Ifc_CusTx2MsgID_Size LinAppl_Ifc_LstFrmIdx LinAppl_Ifc_Rb2CustRx LinAppl_Ifc_Rb2CustTx LinAppl_Ifc_RxByteArrayBuf_au8 LinAppl_Ifc_stFRAME_LIN LinAppl_Ifc_stFRAME_LIN_KOMP LinAppl_Ifc_stLstFrm LinAppl_Ifc_stRxMsg LinAppl_Ifc_TxByteArrayBuf_au8 /end OUT_MEASUREMENT
/end FUNCTION
/begin FUNCTION F4612_LINAPPL_SIG "F4612: LIN monitoring variables and application switches" /begin DEF_CHARACTERISTIC LIN_ctRestartDelay_C /end DEF_CHARACTERISTIC /end FUNCTION
/begin FUNCTION F4614_LINAPPL_TRAHNDLR "F4614: LIN transmission handler" /begin DEF_CHARACTERISTIC LinAppl_TraHndlr_IdlModeAct_C /end DEF_CHARACTERISTIC
 /begin OUT_MEASUREMENT LinAppl_TraHndlr_FrmCntr LinAppl_TraHndlr_FrmCntrChk LinAppl_TraHndlr_FrmDir LinAppl_TraHndlr_FrmTyp LinAppl_TraHndlr_FrmTypPre LinAppl_TraHndlr_Mod LinAppl_TraHndlr_MstBuf LinAppl_TraHndlr_MstBufSt LinAppl_TraHndlr_MstQueSize LinAppl_TraHndlr_MstRdNxtQueIdx LinAppl_TraHndlr_MstWrNxtQueIdx LinAppl_TraHndlr_NumDatByt LinAppl_TraHndlr_NumDatBytRmn LinAppl_TraHndlr_PCIByt LinAppl_TraHndlr_ProtErr LinAppl_TraHndlr_SIDByt LinAppl_TraHndlr_SlvBuf LinAppl_TraHndlr_SlvBufSt LinAppl_TraHndlr_SlvQueSize LinAppl_TraHndlr_SlvRdNxtQueIdx LinAppl_TraHndlr_SlvWrNxtQueIdx LinAppl_TraHndlr_St /end OUT_MEASUREMENT
/end FUNCTION
/begin FUNCTION F4615_LINAPPL_MLXSHNDLR "F4615: Melexis flash handler"
 /begin DEF_CHARACTERISTIC LinAppl_MlxsHndlr_adSerNum_C LinAppl_MlxsHndlr_adWrEep_C LinAppl_MlxsHndlr_EntrPrgModCntrMax_C LinAppl_MlxsHndlr_numPgPrgTryMax_C LinAppl_MlxsHndlr_numSerNum_C LinAppl_MlxsHndlr_stLoadRdSerNumMax_C LinAppl_MlxsHndlr_swtSerNumCtl_C LinAppl_MlxsHndlr_TOut_C LinAppl_MlxsHndlr_xSerNum_C /end DEF_CHARACTERISTIC
 /begin OUT_MEASUREMENT LinAppl_MlxsHndlr_bFaultMon LinAppl_MlxsHndlr_ctPgPrgTry LinAppl_MlxsHndlr_FaultMsk LinAppl_MlxsHndlr_FlshPgChsBak LinAppl_MlxsHndlr_stLoadInit LinAppl_MlxsHndlr_stLoadPre LinAppl_MlxsHndlr_stProc LinAppl_MlxsHndlr_stSerNum LinAppl_MlxsHndlr_TOut LinAppl_MlxsHndlr_xSerNum /end OUT_MEASUREMENT
/end FUNCTION
/begin FUNCTION F4615_LINAPPL_MLXSHNDLR_CMD "F4615: Melexis flash handler"
 /begin DEF_CHARACTERISTIC LinAppl_MlxsHndlr_Cmd_Mst_NAD_C LinAppl_MlxsHndlr_Cmd_RstrtWaitCntr_C /end DEF_CHARACTERISTIC
 /begin OUT_MEASUREMENT LinAppl_MlxsHndlr_Cmd_stCmdSt LinAppl_MlxsHndlr_Cmd_stCom LinAppl_MlxsHndlr_Cmd_TempComDatBuf /end OUT_MEASUREMENT
/end FUNCTION
/begin FUNCTION F4615_LINAPPL_MLXSHNDLR_EEPUPD "F4615: EEPROM update state machine module" /begin DEF_CHARACTERISTIC LinAppl_MlxsHndlr_EepUpd_numUpdTryMax_C /end DEF_CHARACTERISTIC /begin OUT_MEASUREMENT LinAppl_MlxsHndlr_EepUpd_ctUpdTry /end OUT_MEASUREMENT /end FUNCTION
/begin FUNCTION F4615_LINAPPL_MLXSHNDLR_EXP "F4615: export variables of melexis flash handler"
 /begin DEF_CHARACTERISTIC LinAppl_Mlxshndlr_Exp_FlshAddrRngLd1_C LinAppl_Mlxshndlr_Exp_FlshAddrRngLd2_C LinAppl_Mlxshndlr_Exp_FlshAddrRngLd3_C LinAppl_MlxsHndlr_Exp_swtAllwRstrt_C LinAppl_MlxsHndrl_Exp_FlshFileOffsLd1_C LinAppl_MlxsHndrl_Exp_FlshFileOffsLd2_C LinAppl_MlxsHndrl_Exp_FlshFileOffsLd3_C /end DEF_CHARACTERISTIC
 /begin OUT_MEASUREMENT LinAppl_MlxsHndlr_Exp_DmyIdx LinAppl_MlxsHndlr_Exp_FlshLngth LinAppl_MlxsHndlr_Exp_FlshPrgSt LinAppl_MlxsHndlr_Exp_FlshPtr LinAppl_MlxsHndlr_Exp_RxDatBuf LinAppl_MlxsHndlr_Exp_StrtFlshRqst /end OUT_MEASUREMENT
/end FUNCTION
/begin FUNCTION F4615_LINAPPL_MLXSHNDLR_FLSHPGRD "F4615: Flash page reader state machine module" /begin OUT_MEASUREMENT LinAppl_MlxsHndlr_FlshPgRdChs /end OUT_MEASUREMENT /end FUNCTION
/begin FUNCTION F4615_LINAPPL_MLXSHNDLR_FLSHPGWRT "F4615: Flash page writer state machine module" /begin OUT_MEASUREMENT LinAppl_MlxsHndlr_FlshPgWrtChs /end OUT_MEASUREMENT /end FUNCTION
/begin FUNCTION F4615_LINAPPL_MLXSHNDLR_READ "F4615: Melexis flash handler read procedure" /begin DEF_CHARACTERISTIC LinAppl_MlxsHndlr_Read_MaxTrCntr_C /end DEF_CHARACTERISTIC
 /begin OUT_MEASUREMENT LinAppl_MlxsHndlr_Read_FlshVer LinAppl_MlxsHndlr_Read_LinVer LinAppl_MlxsHndlr_Read_NAD LinAppl_MlxsHndlr_Read_numRxByt LinAppl_MlxsHndlr_Read_RxDatAsrt LinAppl_MlxsHndlr_Read_RxFrmCntr LinAppl_MlxsHndlr_Read_stErr LinAppl_MlxsHndlr_Read_stErrCode LinAppl_MlxsHndlr_Read_stLoad LinAppl_MlxsHndlr_Read_stPrgMod LinAppl_MlxsHndlr_Read_stRead LinAppl_MlxsHndlr_Read_stSt /end OUT_MEASUREMENT
/end FUNCTION
/begin FUNCTION F4615_LINAPPL_MLXSHNDLR_SEND "F4615: Melexis flash handler send procedure"
 /begin OUT_MEASUREMENT LinAppl_MlxsHndlr_Send_numTxByt LinAppl_MlxsHndlr_Send_stSend LinAppl_MlxsHndlr_Send_TxFrmCntr /end OUT_MEASUREMENT
/end FUNCTION
/begin FUNCTION F4615_LINAPPL_MLXSHNDLR_WRMEM "F4615:Melexis flash handler write memory procedure" /begin DEF_CHARACTERISTIC LinAppl_MlxsHndlr_WrMem_DatWaitCntr_C /end DEF_CHARACTERISTIC
 /begin OUT_MEASUREMENT LinAppl_MlxsHndlr_WrMem_Adr LinAppl_MlxsHndlr_WrMem_BlkSize LinAppl_MlxsHndlr_WrMem_Cmd LinAppl_MlxsHndlr_WrMem_Length LinAppl_MlxsHndlr_WrMem_LengthRmn LinAppl_MlxsHndlr_WrMem_RmnDat LinAppl_MlxsHndlr_WrMem_st /end OUT_MEASUREMENT
/end FUNCTION
/begin FUNCTION F9120_SHRBMW "F9120: BMW specific misc. functions"
 /begin DEF_CHARACTERISTIC SrvShr_TSysErrorTimeOut_C SrvShr_TSysMsgTimeOut_C SrvShr_TSysTimeInc_C /end DEF_CHARACTERISTIC
 /begin OUT_MEASUREMENT SrvShr_SystemTime SrvShr_SysTimeInc_Counter SrvShr_SysTimeOut_Counter SrvShr_SysTime_BusOff SrvShr_SysTime_CANSig SrvShr_SysTime_CanSigRec SrvShr_SysTime_NextState SrvShr_SysTime_SigRec SrvShr_SysTime_SigValid /end OUT_MEASUREMENT
/end FUNCTION
/begin FUNCTION F9120_SHRVSMBMW "F9120: BMW specific Vehicle State Manager"
 /begin OUT_MEASUREMENT SrvShr_ST_ILK_ERRM_FZM_CanSigRec SrvShr_VSMC_EvalCANFltStoreState SrvShr_VSMC_EvalCANFltStoreTimer SrvShr_VSMC_InhibitFltStore SrvShr_VSMC_StatusBusruhe /end OUT_MEASUREMENT
/end FUNCTION
/begin RECORD_LAYOUT AblGLFKFub_M FNC_VALUES 1 UBYTE ROW_DIR DIRECT /end RECORD_LAYOUT
/begin RECORD_LAYOUT AblGLFKFuw_M FNC_VALUES 1 UWORD ROW_DIR DIRECT /end RECORD_LAYOUT
/begin RECORD_LAYOUT AblGLKWBub_M FNC_VALUES 1 UBYTE COLUMN_DIR DIRECT /end RECORD_LAYOUT
/begin RECORD_LAYOUT AblGLKWBul_M FNC_VALUES 1 ULONG COLUMN_DIR DIRECT /end RECORD_LAYOUT
/begin RECORD_LAYOUT AblGLKWBuw_M FNC_VALUES 1 UWORD COLUMN_DIR DIRECT /end RECORD_LAYOUT
/begin RECORD_LAYOUT AblGLKWub_M FNC_VALUES 1 UBYTE COLUMN_DIR DIRECT /end RECORD_LAYOUT
/begin RECORD_LAYOUT AblGLKWul_M FNC_VALUES 1 ULONG COLUMN_DIR DIRECT /end RECORD_LAYOUT
/begin RECORD_LAYOUT AblGLKWuw_M FNC_VALUES 1 UWORD COLUMN_DIR DIRECT /end RECORD_LAYOUT
/end MODULE
/end PROJECT
