ASAP2_VERSION 1 51
/begin PROJECT _929_929 "Gen2_BMW_System_Supplier_Lib"
/begin HEADER "" VERSION "C_03_03" PROJECT_NO _929_929 /end HEADER
/begin MODULE DIM ""
/begin MOD_COMMON "" BYTE_ORDER MSB_FIRST ALIGNMENT_BYTE 1 ALIGNMENT_WORD 2 ALIGNMENT_LONG 4 ALIGNMENT_FLOAT32_IEEE 4 /end MOD_COMMON
/begin CHARACTERISTIC ABSTELLPOS_VM_ERSATZ_HAS "Ersatzwert fuer abstellpos_vm_in (wenn SWI_ = 1)" VALUE 0x26E0AA UWORD_COL_DIRECT_M_S7_S3 0 void_int_c_M_S7_S3 0 360 /end CHARACTERISTIC
/begin CHARACTERISTIC ABSTELLPOS_VM_STS_ERS_HAS "Ersatzwert fuer abstellpos_vm_status_in (wenn SWI_ = 1)" VALUE 0x26EBD7 UBYTE_COL_DIRECT_M_S7_S3 0 sts_int_M_S7_S3 0 2 /end CHARACTERISTIC
/begin CHARACTERISTIC ANALYSE_HAS_ERSATZ_HAS "Ersatzwert fuer analyse_has_portout (bei SWI_ = 1)" VALUE 0x26EC6C UBYTE_COL_DIRECT_M_S7_S3 0 sts_int_M_S7_S3 0 8 /end CHARACTERISTIC
/begin CHARACTERISTIC BREMSPEDAL_ERSATZ_HAS "Ersatzwert fuer bremspedal_in (wenn SWI_ = 1)" VALUE 0x26EBD8 UBYTE_COL_DIRECT_M_S7_S3 0 void_int_M_S7_S3 0 1 /end CHARACTERISTIC
/begin CHARACTERISTIC C_GETRIEBE_OFFSET "Offset fuer c_getriebe_egs_in (wenn SWI_ = 1)" VALUE 0x26E0AE SWORD_COL_DIRECT_M_S7_S3 0 c_int_v_M_S7_S3 -32768 32767 /end CHARACTERISTIC
/begin CHARACTERISTIC C_GETRIEBEEGS_ERSATZ_HAS "Ersatzwert fuer c_getriebe_egs_in (wenn SWI_ = 1)" VALUE 0x263790 FLOAT32_IEEE_COL_DIRECT_M_S7_S3 0 c_fl_M_S7_S3 -3.40282E+038 3.40282E+038 /end CHARACTERISTIC
/begin CHARACTERISTIC C_UMGEBUNG_ERSATZ_HAS "Ersatzwert fuer c_umgebung_in (wenn SWI_ = 1)" VALUE 0x263794 FLOAT32_IEEE_COL_DIRECT_M_S7_S3 0 c_fl_M_S7_S3 -40 85 /end CHARACTERISTIC
/begin CHARACTERISTIC C_VM_ERSATZ_HAS "Ersatzwert fuer c_vm_in (wenn SWI_ = 1)" VALUE 0x263798 FLOAT32_IEEE_COL_DIRECT_M_S7_S3 0 c_fl_M_S7_S3 -3.40282E+038 3.40282E+038 /end CHARACTERISTIC
/begin CHARACTERISTIC CO_VM_HAS "Offset fuer negative Werte von c_vm_in" VALUE 0x26E0AC SWORD_COL_DIRECT_M_S7_S3 0 c_int_v_M_S7_S3 -32768 32767 /end CHARACTERISTIC
/begin CHARACTERISTIC DREHRICHTUNG_NAB_ERSATZ_HAS "Ersatzwert fuer drehrichtung_nab_in (wenn SWI_ = 1)" VALUE 0x26EBD9 UBYTE_COL_DIRECT_M_S7_S3 0 E_DREHRICH_M_S7_S3 0 2 /end CHARACTERISTIC
/begin CHARACTERISTIC DREHRICHTUNG_NEM_ERSATZ_HAS "Ersatzwert fuer drehrichtung_nem_in (wenn SWI_ = 1)" VALUE 0x26EBDA UBYTE_COL_DIRECT_M_S7_S3 0 E_DREHRICH_M_S7_S3 0 2 /end CHARACTERISTIC
/begin CHARACTERISTIC ERR_N_SOLL_EM_NULL "Ersatzwert fuer das Signal err_n_soll_em_has_portout" VALUE 0x26EC6D UBYTE_COL_DIRECT_M_S7_S3 0 void_int_M_S7_S3 0 1 /end CHARACTERISTIC
/begin CHARACTERISTIC ERR_N_SOLL_VM_NULL "Ersatzwert fuer das Signal err_n_soll_vm_has_portout" VALUE 0x26EC6E UBYTE_COL_DIRECT_M_S7_S3 0 void_int_M_S7_S3 0 1 /end CHARACTERISTIC
/begin CHARACTERISTIC FPW_ERSATZ_HAS "Ersatzwert fuer fpw_in: Prozent Fahrpedalstellung" VALUE 0x26EBDB UBYTE_COL_DIRECT_M_S7_S3 0 void_int_M_S7_S3 0 255 /end CHARACTERISTIC
/begin CHARACTERISTIC GANGWECHSEL_EGS_ERSATZ_HAS "Ersatzwert fuer gangwechsel_egs_in (wenn SWI_ = 1)" VALUE 0x26EBDC UBYTE_COL_DIRECT_M_S7_S3 0 void_int_M_S7_S3 0 1 /end CHARACTERISTIC
/begin CHARACTERISTIC I_GANG_LEV2_EGS_ERSATZ_HAS "Ersatzwert fuer i_gang_lev2_egs_in (wenn SWI_ = 1)" VALUE 0x26379C FLOAT32_IEEE_COL_DIRECT_M_S7_S3 0 void_fl_M_S7_S3 -3.40282E+038 3.40282E+038 /end CHARACTERISTIC
/begin CHARACTERISTIC ISTGANG_EGS_ERSATZ_HAS "Ersatzwert fuer istgang_egs_in (wenn SWI_ = 1)" VALUE 0x26EBDD SBYTE_COL_DIRECT_M_S7_S3 0 void_int_M_S7_S3 -128 127 /end CHARACTERISTIC
/begin CHARACTERISTIC KF_STSOLLBZHASHST_ZUL_HAS_W "" MAP 0x26EB25 UBYTE_COL_DIRECT_M_S7_S3 0 void_int_M_S7_S3 0 1
 /begin AXIS_DESCR COM_AXIS st_ist_bz_has_stg void_int_M_S7_S3 11 0 15 AXIS_PTS_REF KF_STSOLLBZHASHST_ZUL_HAS_X /end AXIS_DESCR
 /begin AXIS_DESCR COM_AXIS NO_INPUT_QUANTITY void_int_M_S7_S3 11 0 15 AXIS_PTS_REF KF_STSOLLBZHASHST_ZUL_HAS_Y /end AXIS_DESCR
/end CHARACTERISTIC
/begin CHARACTERISTIC KL_ABLAUFVARIANTE_HAS_HST_IN_Y "Anpassung der Codierung der Ablaufvariante an Hybridstrategie" CURVE 0x26EBC6 UBYTE_COL_DIRECT_M_S7_S3 0 sts_int_M_S7_S3 0 99
 /begin AXIS_DESCR COM_AXIS z_ablaufvariante_has_hst_portin sts_int_M_S7_S3 17 0 99 AXIS_PTS_REF KL_ABLAUFVARIANTE_HAS_HST_IN_X /end AXIS_DESCR
/end CHARACTERISTIC
/begin CHARACTERISTIC KL_MSMOT_KPS_HAS_Y "Momentschwelle, Tab = f(istgang_egs_in) zur Best. z_k0schlupf_mmotiae_kps" CURVE 0x263EF4 FLOAT32_IEEE_COL_DIRECT_M_S7_S3 0 trq_fl_a_M_S7_S3 -50 1000
 /begin AXIS_DESCR COM_AXIS NO_INPUT_QUANTITY sts_fl_M_S7_S3 10 -1 8 AXIS_PTS_REF KL_MSMOT_KPS_HAS_X /end AXIS_DESCR
/end CHARACTERISTIC
/begin CHARACTERISTIC KOLBENPOS_FAKTOR "Faktor fuer Umrechnung HEX-PHYS" VALUE 0x2637A0 FLOAT32_IEEE_COL_DIRECT_M_S7_S3 0 void_fl_M_S7_S3 -3.40282E+038 3.40282E+038 /end CHARACTERISTIC
/begin CHARACTERISTIC KOLBENPOS_K0_ERS_HAS "Ersatzwert fuer kolbenpos_k0_in (wenn SWI_ = 1)" VALUE 0x2637A4 FLOAT32_IEEE_COL_DIRECT_M_S7_S3 0 sts_fl_M_S7_S3 0 100 /end CHARACTERISTIC
/begin CHARACTERISTIC M_EM_ERSATZ_HAS "Ersatzwert fuer m_em_in (wenn SWI_ = 1)" VALUE 0x26E0B0 SWORD_COL_DIRECT_M_S7_S3 0 trq_int_M_S7_S3 -32768 32767 /end CHARACTERISTIC
/begin CHARACTERISTIC M_IAE_ERSATZ_HAS "Ersatzwert fuer m_iae_in (wenn SWI_ = 1)" VALUE 0x26E0B2 SWORD_COL_DIRECT_M_S7_S3 0 trq_int_M_S7_S3 -32768 32767 /end CHARACTERISTIC
/begin CHARACTERISTIC M_K0_ERSATZ_HAS "Ersatzwert fuer m_k0_in (wenn SWI_ = 1)" VALUE 0x26E0B4 SWORD_COL_DIRECT_M_S7_S3 0 trq_int_M_S7_S3 -32768 32767 /end CHARACTERISTIC
/begin CHARACTERISTIC M_K0_HAS_ERSATZ_HAS "Ersatzwert fuer m_k0_has_portout (bei SWI_ = 1)" VALUE 0x26E0E8 SWORD_COL_DIRECT_M_S7_S3 0 trq_int_M_S7_S3 0 1000 /end CHARACTERISTIC
/begin CHARACTERISTIC M_K0_MBER_HAS_ERSATZ_HAS "Ersatzwert fuer m_k0_mber_has_portout (wenn SWI_ = 1)" VALUE 0x26E0EA SWORD_COL_DIRECT_M_S7_S3 0 trq_int_M_S7_S3 -32768 32767 /end CHARACTERISTIC
/begin CHARACTERISTIC M_MAXDYNEM_ERSATZ_HAS "Ersatzwert fuer m_max_dyn_em_in (wenn SWI_ = 1)" VALUE 0x26E0B6 SWORD_COL_DIRECT_M_S7_S3 0 trq_int_M_S7_S3 -400 1640 /end CHARACTERISTIC
/begin CHARACTERISTIC M_MAXEM_HAS_ERSATZ_HAS "Ersatzwert fuer m_max_em_has_portout (wenn SWI_ = 1)" VALUE 0x26E0EC SWORD_COL_DIRECT_M_S7_S3 0 trq_int_M_S7_S3 -32768 32767 /end CHARACTERISTIC
/begin CHARACTERISTIC M_MAXIAE_HAS_ERSATZ_HAS "Ersatzwert fuer m_max_iae_has_portout (bei SWI_ = 1)" VALUE 0x26E0EE SWORD_COL_DIRECT_M_S7_S3 0 trq_int_M_S7_S3 -200 1300 /end CHARACTERISTIC
/begin CHARACTERISTIC M_MINDYNEM_ERSATZ_HAS "Ersatzwert fuer m_min_dyn_em_in (wenn SWI_ = 1)" VALUE 0x26E0B8 SWORD_COL_DIRECT_M_S7_S3 0 trq_int_M_S7_S3 -400 1640 /end CHARACTERISTIC
/begin CHARACTERISTIC M_MINEM_HAS_ERSATZ_HAS "Ersatzwert fuer m_min_em_has_portout (wenn SWI_ = 1)" VALUE 0x26E0F0 SWORD_COL_DIRECT_M_S7_S3 0 trq_int_M_S7_S3 -32768 32767 /end CHARACTERISTIC
/begin CHARACTERISTIC M_MINVM_ERSATZ_HAS "Ersatzwert fuer m_min_vm_in (wenn SWI_ = 1)" VALUE 0x26E0BA SWORD_COL_DIRECT_M_S7_S3 0 trq_int_M_S7_S3 -32768 32767 /end CHARACTERISTIC
/begin CHARACTERISTIC M_MOT_ERSATZ_HAS "Ersatzwert fuer m_mot_in (wenn SWI_ = 1)" VALUE 0x26E0BC SWORD_COL_DIRECT_M_S7_S3 0 trq_int_M_S7_S3 -1024 1024 /end CHARACTERISTIC
/begin CHARACTERISTIC M_MOTMAX_HAS_ERSATZ_HAS "Ersatzwert fuer m_motmax_has_portout (bei SWI_ = 1)" VALUE 0x26E0F2 SWORD_COL_DIRECT_M_S7_S3 0 trq_int_M_S7_S3 -32768 32767 /end CHARACTERISTIC
/begin CHARACTERISTIC M_RESEM_HAS_ERSATZ_HAS "Ersatzwert fuer m_soll_res_em_has_portout (bei SWI_ = 1)" VALUE 0x26E0F4 SWORD_COL_DIRECT_M_S7_S3 0 trq_int_M_S7_S3 0 1000 /end CHARACTERISTIC
/begin CHARACTERISTIC M_SOLLEM_HAS_ERSATZ_HAS "Ersatzwert fuer m_soll_em_has_portout (bei SWI_ = 1)" VALUE 0x26E0F6 SWORD_COL_DIRECT_M_S7_S3 0 trq_int_M_S7_S3 -32768 32767 /end CHARACTERISTIC
/begin CHARACTERISTIC M_SOLLEMHST_ERSATZ_HAS "Ersatzwert fuer m_soll_em_hst_in (wenn SWI_ = 1)" VALUE 0x26E0BE SWORD_COL_DIRECT_M_S7_S3 0 trq_int_M_S7_S3 -32768 32767 /end CHARACTERISTIC
/begin CHARACTERISTIC M_SOLLK0_HAS_ERSATZ_HAS "Ersatzwert fuer m_soll_k0_has_portout (bei SWI_ = 1)" VALUE 0x26E0F8 SWORD_COL_DIRECT_M_S7_S3 0 trq_int_M_S7_S3 -32768 32767 /end CHARACTERISTIC
/begin CHARACTERISTIC M_SOLLVMHST_ERSATZ_HAS "Ersatzwert fuer m_soll_vm_hst_in (wenn SWI_ = 1)" VALUE 0x26E0C0 SWORD_COL_DIRECT_M_S7_S3 0 trq_int_M_S7_S3 -32768 32767 /end CHARACTERISTIC
/begin CHARACTERISTIC M_SOLLVMLHST_ERSATZ_HAS "Ersatzwert fuer m_soll_vm_l_hst_in (wenn SWI_ = 1)" VALUE 0x26E0C2 SWORD_COL_DIRECT_M_S7_S3 0 trq_int_M_S7_S3 -32768 32767 /end CHARACTERISTIC
/begin CHARACTERISTIC M_VM_ERSATZ_HAS "Ersatzwert fuer m_vm_in (wenn SWI_ = 1)" VALUE 0x26E0C6 SWORD_COL_DIRECT_M_S7_S3 0 trq_int_M_S7_S3 -32768 32767 /end CHARACTERISTIC
/begin CHARACTERISTIC M_VMSTART_ERSATZ_HAS "Ersatzwert fuer m_vm_start_in (wenn SWI_ = 1)" VALUE 0x26E0C4 SWORD_COL_DIRECT_M_S7_S3 0 trq_int_M_S7_S3 -32768 32767 /end CHARACTERISTIC
/begin CHARACTERISTIC M_WUNSCHFPW_ERSATZ_HAS "Ersatzwert fuer m_wunsch_fpw_in (wenn SWI_ = 1)" VALUE 0x26E0C8 SWORD_COL_DIRECT_M_S7_S3 0 trq_int_M_S7_S3 -32768 32767 /end CHARACTERISTIC
/begin CHARACTERISTIC M_WUNSCHFPWHST_ERSATZ_HAS "Ersatzwert fuer m_wunsch_fpw_hst_in (wenn SWI_ = 1)" VALUE 0x2637A8 FLOAT32_IEEE_COL_DIRECT_M_S7_S3 0 trq_fl_a_M_S7_S3 -3.40282E+038 3.40282E+038 /end CHARACTERISTIC
/begin CHARACTERISTIC M_ZIELK0HST_ERSATZ_HAS "Ersatzwert fuer m_ziel_k0_hst_in (wenn SWI_ = 1)" VALUE 0x26E0CA SWORD_COL_DIRECT_M_S7_S3 0 trq_int_M_S7_S3 -1000 2000 /end CHARACTERISTIC
/begin CHARACTERISTIC MG_SOLLK0NEG_HAS_ERSATZ_HAS "Ersatzwert fuer mg_soll_k0_neg_has_portout (bei SWI_ = 1)" VALUE 0x26E0E2 SWORD_COL_DIRECT_M_S7_S3 0 trqg_int_M_S7_S3 -10000 0 /end CHARACTERISTIC
/begin CHARACTERISTIC MG_SOLLK0POS_HAS_ERSATZ_HAS "Ersatzwert fuer mg_soll_k0_pos_has_portout (bei SWI_ = 1)" VALUE 0x26E0E4 SWORD_COL_DIRECT_M_S7_S3 0 trqg_int_M_S7_S3 0 10000 /end CHARACTERISTIC
/begin CHARACTERISTIC MO_MODEMHST_HAS_ERSATZ_HAS "Ersatzwert fuer mo_mod_em_hst_has_portout (wenn SWI_ = 1)" VALUE 0x26E0E6 SWORD_COL_DIRECT_M_S7_S3 0 trq_int_M_S7_S3 -32768 32767 /end CHARACTERISTIC
/begin CHARACTERISTIC MO_MOT_KPS_HAS "Momentoffset zur Realisierung einer Hystereseschwelle fuer z_k0schlupfbed_mmotiae" VALUE 0x2645C4 FLOAT32_IEEE_COL_DIRECT_M_S7_S3 0 trq_fl_a_M_S7_S3 0 100 /end CHARACTERISTIC
/begin CHARACTERISTIC MODUS_EFAHRENHST_ERSATZ_HAS "Ersatzwert fuer modus_e_fahren_hst_in (wenn SWI_ = 1)" VALUE 0x26EBDE UBYTE_COL_DIRECT_M_S7_S3 0 sts_int_M_S7_S3 0 1 /end CHARACTERISTIC
/begin CHARACTERISTIC MS_WUNSCHK0SBEDNGEM1_KPS_HAS "Schwellwert des Fahrerwunschmoment aus Fahrpedalinterpretation zur Ruecknahme der EM Drehzahlgradientenbedingung der Priorisierung der K0-Ansteuerung der HAS" VALUE 0x2645D4 FLOAT32_IEEE_COL_DIRECT_M_S7_S3 0 trq_fl_a_M_S7_S3 -1000 1000 /end CHARACTERISTIC
/begin CHARACTERISTIC MS_WUNSCHK0SBEDNGEM2_KPS_HAS "Schwellwert des Fahrerwunschmoment aus Fahrpedalinterpretation zum Setzen der EM Drehzahlgradientenbedingung der Priorisierung der K0-Ansteuerung der HAS" VALUE 0x2645D8 FLOAT32_IEEE_COL_DIRECT_M_S7_S3 0 trq_fl_a_M_S7_S3 -1000 1000 /end CHARACTERISTIC
/begin CHARACTERISTIC N_ABEGS_ERSATZ_HAS "Ersatzwert fuer n_ab_egs_in (wenn SWI_ = 1)" VALUE 0x26E0CC UWORD_COL_DIRECT_M_S7_S3 0 n_int_M_S7_S3 0 65535 /end CHARACTERISTIC
/begin CHARACTERISTIC N_EM_ERSATZ_HAS "Ersatzwert fuer n_em_in (wenn SWI_ = 1)" VALUE 0x26E0CE UWORD_COL_DIRECT_M_S7_S3 0 n_int_M_S7_S3 0 65535 /end CHARACTERISTIC
/begin CHARACTERISTIC N_MINEM_HAS_ERSATZ_HAS "Ersatzwert fuer n_mot_llsoll_has_portout (bei SWI_ = 1)" VALUE 0x26E0FC UWORD_COL_DIRECT_M_S7_S3 0 n_int_M_S7_S3 0 2550 /end CHARACTERISTIC
/begin CHARACTERISTIC N_MOT_SOLL_IAE_ERSATZ_HAS "Ersatzwert fuer n_mot_soll_iae_portin" VALUE 0x26E0D0 UWORD_COL_DIRECT_M_S7_S3 0 n_int_M_S7_S3 0 10000 /end CHARACTERISTIC
/begin CHARACTERISTIC N_SOLLEM_HAS_ERSATZ_HAS "Ersatzwert fuer n_soll_em_has_portout (bei SWI_ = 1)" VALUE 0x26E0FE UWORD_COL_DIRECT_M_S7_S3 0 n_int_M_S7_S3 0 8000 /end CHARACTERISTIC
/begin CHARACTERISTIC N_SOLLEMHST_ERSATZ_HAS "Ersatzwert fuer n_soll_em_hst_in (wenn SWI_ = 1)" VALUE 0x26E0D2 UWORD_COL_DIRECT_M_S7_S3 0 n_int_M_S7_S3 0 65535 /end CHARACTERISTIC
/begin CHARACTERISTIC N_SOLLLLVM_ERSATZ_HAS "Ersatzwert fuer n_soll_ll_vm_in (wenn SWI_ = 1)" VALUE 0x26E0D4 UWORD_COL_DIRECT_M_S7_S3 0 n_int_M_S7_S3 0 65535 /end CHARACTERISTIC
/begin CHARACTERISTIC N_SOLLVM_HAS_ERSATZ_HAS "Ersatzwert fuer n_soll_vm_has_portout (bei SWI_ = 1)" VALUE 0x26E100 UWORD_COL_DIRECT_M_S7_S3 0 n_int_M_S7_S3 0 8000 /end CHARACTERISTIC
/begin CHARACTERISTIC N_TEGS_ERSATZ_HAS "Ersatzwert fuer n_t_egs_in (wenn SWI_ = 1)" VALUE 0x26E0D6 UWORD_COL_DIRECT_M_S7_S3 0 n_int_M_S7_S3 0 65535 /end CHARACTERISTIC
/begin CHARACTERISTIC N_VM_ERSATZ_HAS "Ersatzwert fuer n_vm_in (wenn SWI_ = 1)" VALUE 0x26E0D8 UWORD_COL_DIRECT_M_S7_S3 0 n_int_M_S7_S3 0 65535 /end CHARACTERISTIC
/begin CHARACTERISTIC ND_MIN_SAF_HAS_ERSATZ_HAS "Ersatzwert fuer nd_min_saf_has_portout (bei SWI_ = 1)" VALUE 0x26E0FA UWORD_COL_DIRECT_M_S7_S3 0 n_int_M_S7_S3 0 1000 /end CHARACTERISTIC
/begin CHARACTERISTIC NOS_EMK0SBEDNGEM1_KPS_HAS "Drehzahloffset zur VM-Leerlauf-Solldrehzahl als EM-Drehzahlschwelle zur Ruecknahme der EM Drehzahlgradientenbedingung der Priorisierung der K0-Ansteuerung der HAS" VALUE 0x26461C FLOAT32_IEEE_COL_DIRECT_M_S7_S3 0 n_fl_M_S7_S3 0 10000 /end CHARACTERISTIC
/begin CHARACTERISTIC NOS_EMK0SBEDNGEM2_KPS_HAS "Drehzahloffset zur VM-Leerlauf-Solldrehzahl als EM-Drehzahlschwelle zum Setzen der EM Drehzahlgradientenbedingung der Priorisierung der K0-Ansteuerung der HAS" VALUE 0x264620 FLOAT32_IEEE_COL_DIRECT_M_S7_S3 0 n_fl_M_S7_S3 0 10000 /end CHARACTERISTIC
/begin CHARACTERISTIC OSMODE_NEXT_ERSATZ_HAS "Ersatzwert osmode_next_in (Ersatzwert bei 1)" VALUE 0x26EBDF UBYTE_COL_DIRECT_M_S7_S3 0 swi_int_o_M_S7_S3 0 255 /end CHARACTERISTIC
/begin CHARACTERISTIC P_BREMSEFZG_ERSATZ_HAS "Ersatzwert fuer p_bremse_fzg_in (wenn SWI_ = 1)" VALUE 0x2637B0 FLOAT32_IEEE_COL_DIRECT_M_S7_S3 0 p_fl_M_S7_S3 -3.40282E+038 3.40282E+038 /end CHARACTERISTIC
/begin CHARACTERISTIC PHI_NEIGUNG_ERSATZ_HAS "Ersatzwert fuer phi_neigung_in (wenn SWI_ = 1)" VALUE 0x2637AC FLOAT32_IEEE_COL_DIRECT_M_S7_S3 0 phi_fl_M_S7_S3 -42 42 /end CHARACTERISTIC
/begin CHARACTERISTIC POS_EGS_ERSATZ_HAS "Ersatzwert fuer pos_egs_in (wenn SWI_ = 1)" VALUE 0x26EBE0 UBYTE_COL_DIRECT_M_S7_S3 0 void_int_M_S7_S3 0 8 /end CHARACTERISTIC
/begin CHARACTERISTIC SCHALT_MODE_EGS_ERSATZ_HAS "Ersatzwert fuer schalt_mode_egs_in: Programminformation ueber Schaltprogramm" VALUE 0x26E0DA UWORD_COL_DIRECT_M_S7_S3 0 void_int_c_M_S7_S3 0 65535 /end CHARACTERISTIC
/begin CHARACTERISTIC SOC_ERSATZ_HAS "Ersatzwert fuer soc_in (wenn SWI_ = 1)" VALUE 0x26EBE1 UBYTE_COL_DIRECT_M_S7_S3 0 sts_int_M_S7_S3 0 100 /end CHARACTERISTIC
/begin CHARACTERISTIC SOLLGANG_EGS_ERSATZ_HAS "Ersatzwert fuer sollgang_egs_in (wenn SWI_ = 1)" VALUE 0x26EBE2 SBYTE_COL_DIRECT_M_S7_S3 0 void_int_M_S7_S3 -128 127 /end CHARACTERISTIC
/begin CHARACTERISTIC ST_IST_BZ_HAS_ERSATZ_HAS "Ersatzwert fuer st_ist_bz_has_portout (wenn SWI_ = 1)" VALUE 0x26EC72 UBYTE_COL_DIRECT_M_S7_S3 0 sts_int_M_S7_S3 0 255 /end CHARACTERISTIC
/begin CHARACTERISTIC ST_ZIEL_BZ_HAS_ERSATZ_HAS "Ersatzwert fuer st_ist_bz_has_portout (wenn SWI_ = 1)" VALUE 0x26EC73 UBYTE_COL_DIRECT_M_S7_S3 0 sts_int_M_S7_S3 0 15 /end CHARACTERISTIC
/begin CHARACTERISTIC STATUS_ABLAUF_HAS_ERS_HAS "Ersatzwert fuer status_ablauf_has_portout (bei SWI_ = 1)" VALUE 0x26EC70 UBYTE_COL_DIRECT_M_S7_S3 0 sts_int_M_S7_S3 0 15 /end CHARACTERISTIC
/begin CHARACTERISTIC STATUS_ABLAUFAKTIV_ERS_HAS "Ersatzwert fuer status_ablaufaktiv_has_portout (bei SWI_ = 1)" VALUE 0x26EC6F UBYTE_COL_DIRECT_M_S7_S3 0 sts_int_M_S7_S3 0 1 /end CHARACTERISTIC
/begin CHARACTERISTIC STATUS_ABS_ERSATZ_HAS "Ersatzwert fuer status_abs_in (wenn SWI_ = 1)" VALUE 0x26EBE3 UBYTE_COL_DIRECT_M_S7_S3 0 sts_int_M_S7_S3 0 2 /end CHARACTERISTIC
/begin CHARACTERISTIC STATUS_ALAENGS_ADAO_ERS_HAS "Ersatzwert fuer status_alaengs_adaoff_in (wenn SWI_ = 1)" VALUE 0x26EBE4 UBYTE_COL_DIRECT_M_S7_S3 0 st_int_M_S7_S3 0 1 /end CHARACTERISTIC
/begin CHARACTERISTIC STATUS_ASR_ERSATZ_HAS "Ersatzwert fuer status_asr_in (wenn SWI_ = 1)" VALUE 0x26EBE5 UBYTE_COL_DIRECT_M_S7_S3 0 sts_int_M_S7_S3 0 1 /end CHARACTERISTIC
/begin CHARACTERISTIC STATUS_AUTOHOLD_ERSATZ_HAS "Ersatzwert fuer status_autohold_in (wenn SWI_ = 1)" VALUE 0x26EBE6 UBYTE_COL_DIRECT_M_S7_S3 0 E_STATUSNAA_M_S7_S3 0 1 /end CHARACTERISTIC
/begin CHARACTERISTIC STATUS_BETRBER_AUS_HAS "Abschaltschwellwert der Portin-Groesse (GET_FAHR_BEREIT) zur Ruecknahme der Betriebsbereitschaft  des Hybridsystems in der HAS - status_betriebsbereit_hst_in" VALUE 0x26EBE7 UBYTE_COL_DIRECT_M_S7_S3 0 sts_int_M_S7_S3 0 255 /end CHARACTERISTIC
/begin CHARACTERISTIC STATUS_BETRBER_EIN_HAS "Einschaltschwellwert der Portin-Groesse (GET_FAHR_BEREIT) zur Erkennung der Betriebsbereitschaft  des Hybridsystems in der HAS - status_betriebsbereit_hst_in" VALUE 0x26EBE8 UBYTE_COL_DIRECT_M_S7_S3 0 sts_int_M_S7_S3 0 255 /end CHARACTERISTIC
/begin CHARACTERISTIC STATUS_BETRIEBSBER_ERS_HAS "Ersatzwert fuer status_betriebsbereit_hst_in (wenn SWI_ = 1)" VALUE 0x26EBE9 UBYTE_COL_DIRECT_M_S7_S3 0 sts_int_M_S7_S3 0 255 /end CHARACTERISTIC
/begin CHARACTERISTIC STATUS_C_K0_ERSATZ_HAS "Ersatzwert fuer status_c_k0_in (wenn SWI_ = 1)" VALUE 0x26EBEB UBYTE_COL_DIRECT_M_S7_S3 0 E_STATUSCK0_M_S7_S3 0 2 /end CHARACTERISTIC
/begin CHARACTERISTIC STATUS_CUMGEBUNG_ERSATZ_HAS "Ersatzwert fuer status_cumgebung_in (wenn SWI_ = 1)" VALUE 0x26EBEA UBYTE_COL_DIRECT_M_S7_S3 0 sts_int_M_S7_S3 0 2 /end CHARACTERISTIC
/begin CHARACTERISTIC STATUS_EFAHREN_HAS_ERS_HAS "Ersatzwert fuer status_efahren_has_portout (bei SWI_ = 1)" VALUE 0x26EC71 UBYTE_COL_DIRECT_M_S7_S3 0 sts_int_M_S7_S3 0 1 /end CHARACTERISTIC
/begin CHARACTERISTIC STATUS_FEHLER_IEP_ERSATZ_HAS "Ersatzwert fuer z_iep_has_fkt (wenn SWI_ = 1)" VALUE 0x26EBEC UBYTE_COL_DIRECT_M_S7_S3 0 sts_int_M_S7_S3 0 255 /end CHARACTERISTIC
/begin CHARACTERISTIC STATUS_GETRBEREIT_ERS_HAS "Ersatzwert fuer status_getrbereit_in (wenn SWI_ = 1)" VALUE 0x26EBED UBYTE_COL_DIRECT_M_S7_S3 0 sts_int_M_S7_S3 0 255 /end CHARACTERISTIC
/begin CHARACTERISTIC STATUS_HILLHOLD_ERSATZ_HAS "Ersatzwert fuer status_hillhold_in (wenn SWI_ = 1)" VALUE 0x26EBEE UBYTE_COL_DIRECT_M_S7_S3 0 E_STATUSNAA_M_S7_S3 0 1 /end CHARACTERISTIC
/begin CHARACTERISTIC STATUS_IAE_ADAP_ERSATZ_HAS "Ersatzwert fuer status_iae_adap_in (wenn SWI_ = 1)" VALUE 0x26EBEF UBYTE_COL_DIRECT_M_S7_S3 0 sts_int_M_S7_S3 0 255 /end CHARACTERISTIC
/begin CHARACTERISTIC STATUS_IAE_ERSATZ_HAS "Ersatzwert fuer status_iae_in (wenn SWI_ = 1)" VALUE 0x26EBF0 UBYTE_COL_DIRECT_M_S7_S3 0 sts_int_M_S7_S3 0 255 /end CHARACTERISTIC
/begin CHARACTERISTIC STATUS_IEP_ERSATZ_HAS "Ersatzwert status_iep_in (Ersatzwert bei 1)" VALUE 0x26EBF1 UBYTE_COL_DIRECT_M_S7_S3 0 sts_int_M_S7_S3 0 255 /end CHARACTERISTIC
/begin CHARACTERISTIC STATUS_K0_ADAP_ERSATZ_HAS "Ersatzwert fuer status_k0_adap_has_in (wenn SWI_ = 1)" VALUE 0x26EBF4 UBYTE_COL_DIRECT_M_S7_S3 0 st_int_M_S7_S3 0 255 /end CHARACTERISTIC
/begin CHARACTERISTIC STATUS_K0_ERSATZ_HAS "Ersatzwert fuer status_k0_in (wenn SWI_ = 1)" VALUE 0x26EBF5 UBYTE_COL_DIRECT_M_S7_S3 0 sts_int_M_S7_S3 0 255 /end CHARACTERISTIC
/begin CHARACTERISTIC STATUS_K0ADAPZAEHLER_ERSATZ_HAS "Ersatzwert fuer status_k0_adap_zaehler_in (wenn SWI_ = 1)" VALUE 0x26EBF2 UBYTE_COL_DIRECT_M_S7_S3 0 sts_int_M_S7_S3 0 255 /end CHARACTERISTIC
/begin CHARACTERISTIC STATUS_K0BEFUELLUNG_ERSATZ_HAS "Ersatzwert fuer status_k0_befuellung_in (wenn SWI_ = 1)" VALUE 0x26EBF3 UBYTE_COL_DIRECT_M_S7_S3 0 st_int_M_S7_S3 0 3 /end CHARACTERISTIC
/begin CHARACTERISTIC STATUS_KRAFTFLUSS_ERS_HAS "Ersatzwert fuer status_kraftfluss_egs_in egs_in (wenn SWI_ = 1)" VALUE 0x26EBF6 UBYTE_COL_DIRECT_M_S7_S3 0 sts_int_M_S7_S3 0 255 /end CHARACTERISTIC
/begin CHARACTERISTIC STATUS_KRAFTFLUSS_LEV2_ERS_HAS "Ersatzwert fuer status_kraftfluss_lev2_egs_in (wenn SWI_ = 1)" VALUE 0x26EBF7 UBYTE_COL_DIRECT_M_S7_S3 0 sts_int_M_S7_S3 0 2 /end CHARACTERISTIC
/begin CHARACTERISTIC STATUS_LLVM_ERSATZ_HAS "Ersatzwert fuer status_ll_vm_in (wenn SWI_ = 1)" VALUE 0x26EBF8 UBYTE_COL_DIRECT_M_S7_S3 0 sts_int_M_S7_S3 0 255 /end CHARACTERISTIC
/begin CHARACTERISTIC STATUS_NEM_ERSATZ_HAS "Ersatzwert fuer status_nem_in (wenn SWI_ = 1)" VALUE 0x26EBF9 UBYTE_COL_DIRECT_M_S7_S3 0 sts_int_M_S7_S3 0 2 /end CHARACTERISTIC
/begin CHARACTERISTIC STATUS_NREGEMHST_ERSATZ_HAS "Ersatzwert fuer status_nreg_em_hst_in (wenn SWI_ = 1)" VALUE 0x26EBFA UBYTE_COL_DIRECT_M_S7_S3 0 st_int_M_S7_S3 0 255 /end CHARACTERISTIC
/begin CHARACTERISTIC STATUS_NVM_ERSATZ_HAS "Ersatzwert fuer status_nvm_in (wenn SWI_ = 1)" VALUE 0x26EBFB UBYTE_COL_DIRECT_M_S7_S3 0 sts_int_M_S7_S3 0 2 /end CHARACTERISTIC
/begin CHARACTERISTIC STATUS_POSVUEB_ERSATZ_HAS "Ersatzwert fuer posv_timer_portin (Ersatzwert bei 1)" VALUE 0x26EBFC UBYTE_COL_DIRECT_M_S7_S3 0 sts_int_M_S7_S3 0 2 /end CHARACTERISTIC
/begin CHARACTERISTIC STATUS_SAVM_ERSATZ_HAS "Ersatzwert fuer status_sa_vm_in (wenn SWI_ = 1)" VALUE 0x26EBFD UBYTE_COL_DIRECT_M_S7_S3 0 sts_int_M_S7_S3 0 3 /end CHARACTERISTIC
/begin CHARACTERISTIC STATUS_SOC_ERSATZ_HAS "Ersatzwert fuer status_soc_in (wenn SWI_ = 1)" VALUE 0x26EBFE UBYTE_COL_DIRECT_M_S7_S3 0 sts_int_M_S7_S3 0 2 /end CHARACTERISTIC
/begin CHARACTERISTIC STATUS_VF_ERSATZ_HAS "Ersatzwert fuer status_vf_in (wenn SWI_ = 1)" VALUE 0x26EC00 UBYTE_COL_DIRECT_M_S7_S3 0 E_SIGSTATUS_M_S7_S3 0 2 /end CHARACTERISTIC
/begin CHARACTERISTIC STATUS_VFREF_ERSATZ_HAS "Ersatzwert fuer status_vfref_in (wenn SWI_ = 1)" VALUE 0x26EBFF UBYTE_COL_DIRECT_M_S7_S3 0 E_SIGSTATUS_M_S7_S3 0 2 /end CHARACTERISTIC
/begin CHARACTERISTIC STATUS_WASCHSTR_ERSATZ_HAS "Ersatzwert fuer status_waschstr_has_in (wenn SWI_ = 1)" VALUE 0x26EC01 UBYTE_COL_DIRECT_M_S7_S3 0 st_int_M_S7_S3 0 255 /end CHARACTERISTIC
/begin CHARACTERISTIC SWI_ABSTELLPOS_VM_ERSATZ_HAS "Schalter fuer Ersatzwert abstellpos_vm_in (Ersatzwert bei 1)" VALUE 0x26EC02 UBYTE_COL_DIRECT_M_S7_S3 0 swi_int_M_S7_S3 0 1 /end CHARACTERISTIC
/begin CHARACTERISTIC SWI_ABSTELLPOS_VM_STS_ERS_HAS "Schalter fuer Ersatzwert abstellpos_vm_status_in (Ersatzwert bei 1)" VALUE 0x26EC03 UBYTE_COL_DIRECT_M_S7_S3 0 swi_int_M_S7_S3 0 1 /end CHARACTERISTIC
/begin CHARACTERISTIC SWI_ANALYSE_HAS_ERSATZ_HAS "Schalter fuer Ersatzwert fuer analyse_has_portout (bei SWI_ = 1)  " VALUE 0x26EC74 UBYTE_COL_DIRECT_M_S7_S3 0 swi_int_M_S7_S3 0 1 /end CHARACTERISTIC
/begin CHARACTERISTIC SWI_BREMSPEDAL_ERSATZ_HAS "Schalter fuer Ersatzwert bremspedal_in (Ersatzwert bei 1)" VALUE 0x26EC04 UBYTE_COL_DIRECT_M_S7_S3 0 swi_int_M_S7_S3 0 1 /end CHARACTERISTIC
/begin CHARACTERISTIC SWI_C_GETRIEBEEGS_ERSATZ_HAS "Schalter fuer Ersatzwert c_getriebe_egs_in (Ersatzwert bei 1)" VALUE 0x26EC05 UBYTE_COL_DIRECT_M_S7_S3 0 swi_int_M_S7_S3 0 1 /end CHARACTERISTIC
/begin CHARACTERISTIC SWI_C_UMGEBUNG_ERSATZ_HAS "Schalter fuer Ersatzwert fuer c_umgebung_in (wenn SWI_ = 1)" VALUE 0x26EC06 UBYTE_COL_DIRECT_M_S7_S3 0 swi_int_M_S7_S3 0 1 /end CHARACTERISTIC
/begin CHARACTERISTIC SWI_C_VM_ERSATZ_HAS "Schalter fuer Ersatzwert c_vm_in (Ersatzwert bei 1)" VALUE 0x26EC07 UBYTE_COL_DIRECT_M_S7_S3 0 swi_int_M_S7_S3 0 1 /end CHARACTERISTIC
/begin CHARACTERISTIC SWI_DREHRICHTUNG_NAB_ERSATZ_HAS "Schalter fuer Ersatzwert drehrichtung_nab_in (Ersatzwert bei 1)" VALUE 0x26EC08 UBYTE_COL_DIRECT_M_S7_S3 0 swi_int_M_S7_S3 0 1 /end CHARACTERISTIC
/begin CHARACTERISTIC SWI_DREHRICHTUNG_NEM_ERSATZ_HAS "Schalter fuer Ersatzwert drehrichtung_nem_in (Ersatzwert bei 1)" VALUE 0x26EC09 UBYTE_COL_DIRECT_M_S7_S3 0 swi_int_M_S7_S3 0 1 /end CHARACTERISTIC
/begin CHARACTERISTIC SWI_FPW_ERSATZ_HAS "Schalter fuer Ersatzwert fpw_in (Ersatzwert bei 1)" VALUE 0x26EC0A UBYTE_COL_DIRECT_M_S7_S3 0 swi_int_M_S7_S3 0 1 /end CHARACTERISTIC
/begin CHARACTERISTIC SWI_GANGWECHSEL_EGS_ERSATZ_HAS "Schalter fuer Ersatzwert gangwechsel_egs_in (Ersatzwert bei 1)" VALUE 0x26EC0B UBYTE_COL_DIRECT_M_S7_S3 0 swi_int_M_S7_S3 0 1 /end CHARACTERISTIC
/begin CHARACTERISTIC SWI_I_GANG_LEV2_EGS_ERSATZ_HAS "Schalter fuer Ersatzwert i_gang_lev2_egs_in (Ersatzwert bei 1)" VALUE 0x26EC0D UBYTE_COL_DIRECT_M_S7_S3 0 swi_int_M_S7_S3 0 1 /end CHARACTERISTIC
/begin CHARACTERISTIC SWI_ISTGANG_EGS_ERSATZ_HAS "Schalter fuer Ersatzwert istgang_egs_in (Ersatzwert bei 1)" VALUE 0x26EC0C UBYTE_COL_DIRECT_M_S7_S3 0 swi_int_M_S7_S3 0 1 /end CHARACTERISTIC
/begin CHARACTERISTIC SWI_K0SBEDABS_KPS_HAS "Schalter zur Aktivierung der Beruecksichtigung der ABS-Regelung bei der Freigabe der K0-Schlupfregelung der Priorisierung der K0-Ansteuerung der HAS" VALUE 0x26ED6D UBYTE_COL_DIRECT_M_S7_S3 0 swi_int_M_S7_S3 0 1 /end CHARACTERISTIC
/begin CHARACTERISTIC SWI_K0SBEDASR_KPS_HAS "Schalter zur Aktivierung der Beruecksichtigung der ASR-Regelung bei der Freigabe der K0-Schlupfregelung der Priorisierung der K0-Ansteuerung der HAS" VALUE 0x26ED6E UBYTE_COL_DIRECT_M_S7_S3 0 swi_int_M_S7_S3 0 1 /end CHARACTERISTIC
/begin CHARACTERISTIC SWI_K0SCHLUPFBED_PN_HAS "Schalter um die Schlupfentkopplung der K0 in PN zu erlauben in de HAS" VALUE 0x26ED6F UBYTE_COL_DIRECT_M_S7_S3 0 swi_int_M_S7_S3 0 1 /end CHARACTERISTIC
/begin CHARACTERISTIC SWI_KOLBENPOS_K0_ERS_HAS "Schalter fuer Ersatzwert kolbenpos_k0_in (Ersatzwert bei 1)" VALUE 0x26EC0E UBYTE_COL_DIRECT_M_S7_S3 0 swi_int_M_S7_S3 0 1 /end CHARACTERISTIC
/begin CHARACTERISTIC SWI_M_EM_ERSATZ_HAS "Schalter fuer Ersatzwert m_em_in (Ersatzwert bei 1)" VALUE 0x26EC10 UBYTE_COL_DIRECT_M_S7_S3 0 swi_int_M_S7_S3 0 1 /end CHARACTERISTIC
/begin CHARACTERISTIC SWI_M_IAE_ERSATZ_HAS "Schalter fuer Ersatzwert m_iae_in (Ersatzwert bei 1)" VALUE 0x26EC11 UBYTE_COL_DIRECT_M_S7_S3 0 swi_int_M_S7_S3 0 1 /end CHARACTERISTIC
/begin CHARACTERISTIC SWI_M_K0_ERSATZ_HAS "Schalter fuer Ersatzwert m_k0_in (Ersatzwert bei 1)" VALUE 0x26EC12 UBYTE_COL_DIRECT_M_S7_S3 0 swi_int_M_S7_S3 0 1 /end CHARACTERISTIC
/begin CHARACTERISTIC SWI_M_K0_HAS_ERSATZ_HAS "Schalter fuer Ersatzwert m_k0_has_portout (Ersatzwert bei 1)" VALUE 0x26EC76 UBYTE_COL_DIRECT_M_S7_S3 0 swi_int_M_S7_S3 0 1 /end CHARACTERISTIC
/begin CHARACTERISTIC SWI_M_K0_MBER_HAS_ERSATZ_HAS "Schalter fuer Ersatzwert m_k0_mber_has_portout (Ersatzwert bei 1)" VALUE 0x26EC77 UBYTE_COL_DIRECT_M_S7_S3 0 swi_int_M_S7_S3 0 1 /end CHARACTERISTIC
/begin CHARACTERISTIC SWI_M_MAXDYNEM_ERSATZ_HAS "Schalter fuer Ersatzwert m_max_dyn_em_in (Ersatzwert bei 1)" VALUE 0x26EC13 UBYTE_COL_DIRECT_M_S7_S3 0 swi_int_M_S7_S3 0 1 /end CHARACTERISTIC
/begin CHARACTERISTIC SWI_M_MAXEM_HAS_ERSATZ_HAS "Schalter fuer Ersatzwert m_max_em_has_portout (Ersatzwert bei 1)" VALUE 0x26EC78 UBYTE_COL_DIRECT_M_S7_S3 0 swi_int_M_S7_S3 0 1 /end CHARACTERISTIC
/begin CHARACTERISTIC SWI_M_MAXIAE_HAS_ERSATZ_HAS "Schalter fuer Ersatzwert m_max_iae_has_portout (Ersatzwert bei 1)" VALUE 0x26EC79 UBYTE_COL_DIRECT_M_S7_S3 0 swi_int_M_S7_S3 0 1 /end CHARACTERISTIC
/begin CHARACTERISTIC SWI_M_MINDYNEM_ERSATZ_HAS "Schalter fuer Ersatzwert m_min_dyn_em_in (Ersatzwert bei 1)" VALUE 0x26EC14 UBYTE_COL_DIRECT_M_S7_S3 0 swi_int_M_S7_S3 0 1 /end CHARACTERISTIC
/begin CHARACTERISTIC SWI_M_MINEM_HAS_ERSATZ_HAS "Schalter fuer Ersatzwert m_min_em_has_portout (Ersatzwert bei 1)" VALUE 0x26EC7A UBYTE_COL_DIRECT_M_S7_S3 0 swi_int_M_S7_S3 0 1 /end CHARACTERISTIC
/begin CHARACTERISTIC SWI_M_MINVM_ERSATZ_HAS "Schalter fuer Ersatzwert m_min_vm_in (Ersatzwert bei 1)" VALUE 0x26EC15 UBYTE_COL_DIRECT_M_S7_S3 0 swi_int_M_S7_S3 0 1 /end CHARACTERISTIC
/begin CHARACTERISTIC SWI_M_MOT_ERSATZ_HAS "Schalter fuer Ersatzwert m_mot_in (Ersatzwert bei 1)" VALUE 0x26EC16 UBYTE_COL_DIRECT_M_S7_S3 0 swi_int_M_S7_S3 0 1 /end CHARACTERISTIC
/begin CHARACTERISTIC SWI_M_MOTMAX_HAS_ERSATZ_HAS "Schalter fuer Ersatzwert m_motmax_has_portout (Ersatzwert bei 1)" VALUE 0x26EC7B UBYTE_COL_DIRECT_M_S7_S3 0 swi_int_M_S7_S3 0 1 /end CHARACTERISTIC
/begin CHARACTERISTIC SWI_M_RESEM_HAS_ERSATZ_HAS "Schalter fuer Ersatzwert m_soll_res_em_has_portout (Ersatzwert bei 1)" VALUE 0x26EC7C UBYTE_COL_DIRECT_M_S7_S3 0 swi_int_M_S7_S3 0 1 /end CHARACTERISTIC
/begin CHARACTERISTIC SWI_M_SOLLEM_HAS_ERSATZ_HAS "Schalter fuer Ersatzwert m_soll_em_has_portout (Ersatzwert bei 1)" VALUE 0x26EC7D UBYTE_COL_DIRECT_M_S7_S3 0 swi_int_M_S7_S3 0 1 /end CHARACTERISTIC
/begin CHARACTERISTIC SWI_M_SOLLEMHST_ERSATZ_HAS "Schalter fuer Ersatzwert m_soll_em_hst_in (Ersatzwert bei 1)" VALUE 0x26EC17 UBYTE_COL_DIRECT_M_S7_S3 0 swi_int_M_S7_S3 0 1 /end CHARACTERISTIC
/begin CHARACTERISTIC SWI_M_SOLLK0_HAS_ERSATZ_HAS "Schalter fuer Ersatzwert m_soll_k0_has_portout (Ersatzwert bei 1)" VALUE 0x26EC7E UBYTE_COL_DIRECT_M_S7_S3 0 swi_int_M_S7_S3 0 1 /end CHARACTERISTIC
/begin CHARACTERISTIC SWI_M_SOLLVMHST_ERSATZ_HAS "Schalter fuer Ersatzwert m_soll_vm_hst_in (Ersatzwert bei 1)" VALUE 0x26EC18 UBYTE_COL_DIRECT_M_S7_S3 0 swi_int_M_S7_S3 0 1 /end CHARACTERISTIC
/begin CHARACTERISTIC SWI_M_SOLLVMLHST_ERSATZ_HAS "Schalter fuer Ersatzwert m_soll_vm_l_hst_in (Ersatzwert bei 1)" VALUE 0x26EC19 UBYTE_COL_DIRECT_M_S7_S3 0 swi_int_M_S7_S3 0 1 /end CHARACTERISTIC
/begin CHARACTERISTIC SWI_M_VM_ERSATZ_HAS "Schalter fuer Ersatzwert m_vm_in (Ersatzwert bei 1)" VALUE 0x26EC1B UBYTE_COL_DIRECT_M_S7_S3 0 swi_int_M_S7_S3 0 1 /end CHARACTERISTIC
/begin CHARACTERISTIC SWI_M_VMSTART_ERSATZ_HAS "Schalter fuer Ersatzwert m_vm_start_in (Ersatzwert bei 1)" VALUE 0x26EC1A UBYTE_COL_DIRECT_M_S7_S3 0 swi_int_M_S7_S3 0 1 /end CHARACTERISTIC
/begin CHARACTERISTIC SWI_M_WUNSCHFPW_ERSATZ_HAS "Schalter fuer Ersatzwert m_wunsch_fpw_in (Ersatzwert bei 1)" VALUE 0x26EC1E UBYTE_COL_DIRECT_M_S7_S3 0 swi_int_M_S7_S3 0 1 /end CHARACTERISTIC
/begin CHARACTERISTIC SWI_M_WUNSCHFPWHST_ERSATZ_HAS "Schalter fuer Ersatzwert m_wunsch_fpw_hst_in (Ersatzwert bei 1)" VALUE 0x26EC1C UBYTE_COL_DIRECT_M_S7_S3 0 swi_int_M_S7_S3 0 1 /end CHARACTERISTIC
/begin CHARACTERISTIC SWI_M_WUNSCHFPWHST_IN_HAS "Auswahl der Eingangsgroesse fuer das Fahrerwunschmoment der HST - 0 = SUMME(m_soll_vm_hst_in,m_soll_em_hst_in); 1= m_wunsch_fpw_in; 2 = m_mot_in; 3 = m_wunsch_fpw_hst_in" VALUE 0x26EC1D UBYTE_COL_DIRECT_M_S7_S3 0 swi_int_o_M_S7_S3 0 3 /end CHARACTERISTIC
/begin CHARACTERISTIC SWI_M_ZIELK0HST_ERSATZ_HAS "Schalter fuer Ersatzwert m_ziel_k0_hst_in (Ersatzwert bei 1)" VALUE 0x26EC1F UBYTE_COL_DIRECT_M_S7_S3 0 swi_int_M_S7_S3 0 1 /end CHARACTERISTIC
/begin CHARACTERISTIC SWI_MO_MODEMHST_HAS_ERSATZ_HAS "Schalter fuer Ersatzwert mo_mod_em_hst_has_portout (Ersatzwert bei 1)" VALUE 0x26EC75 UBYTE_COL_DIRECT_M_S7_S3 0 swi_int_M_S7_S3 0 1 /end CHARACTERISTIC
/begin CHARACTERISTIC SWI_MODUS_EFAHRENHST_ERSATZ_HAS "Schalter fuer Ersatzwert modus_e_fahren_hst_in (Ersatzwert bei 1)" VALUE 0x26EC0F UBYTE_COL_DIRECT_M_S7_S3 0 swi_int_M_S7_S3 0 1 /end CHARACTERISTIC
/begin CHARACTERISTIC SWI_N_ABEGS_ERSATZ_HAS "Schalter fuer Ersatzwert n_ab_egs_in (Ersatzwert bei 1)" VALUE 0x26EC21 UBYTE_COL_DIRECT_M_S7_S3 0 swi_int_M_S7_S3 0 1 /end CHARACTERISTIC
/begin CHARACTERISTIC SWI_N_EM_ERSATZ_HAS "Schalter fuer Ersatzwert n_em_in (Ersatzwert bei 1)" VALUE 0x26EC22 UBYTE_COL_DIRECT_M_S7_S3 0 swi_int_M_S7_S3 0 1 /end CHARACTERISTIC
/begin CHARACTERISTIC SWI_N_MINEM_HAS_ERSATZ_HAS "Schalter fuer Ersatzwert n_mot_llsoll_has_portout (Ersatzwert bei 1)" VALUE 0x26EC80 UBYTE_COL_DIRECT_M_S7_S3 0 swi_int_M_S7_S3 0 1 /end CHARACTERISTIC
/begin CHARACTERISTIC SWI_N_MOT_SOLL_IAE_ERSATZ_HAS "Schalter fuer n_mot_soll_iae_portin" VALUE 0x26EC23 UBYTE_COL_DIRECT_M_S7_S3 0 swi_int_M_S7_S3 0 1 /end CHARACTERISTIC
/begin CHARACTERISTIC SWI_N_SOLLEM_HAS_ERSATZ_HAS "Schalter fuer Ersatzwert n_soll_em_has_portout (Ersatzwert bei 1)" VALUE 0x26EC81 UBYTE_COL_DIRECT_M_S7_S3 0 sts_int_e_M_S7_S3 0 1 /end CHARACTERISTIC
/begin CHARACTERISTIC SWI_N_SOLLEMHST_ERSATZ_HAS "Schalter fuer Ersatzwert n_soll_em_hst_in (Ersatzwert bei 1)" VALUE 0x26EC24 UBYTE_COL_DIRECT_M_S7_S3 0 swi_int_M_S7_S3 0 1 /end CHARACTERISTIC
/begin CHARACTERISTIC SWI_N_SOLLLLVM_ERSATZ_HAS "Schalter fuer Ersatzwert n_soll_ll_vm_in (Ersatzwert bei 1)" VALUE 0x26EC25 UBYTE_COL_DIRECT_M_S7_S3 0 swi_int_M_S7_S3 0 1 /end CHARACTERISTIC
/begin CHARACTERISTIC SWI_N_SOLLVM_HAS_ERSATZ_HAS "Schalter fuer Ersatzwert n_soll_vm_has_portout (Ersatzwert bei 1)" VALUE 0x26EC82 UBYTE_COL_DIRECT_M_S7_S3 0 sts_int_e_M_S7_S3 0 1 /end CHARACTERISTIC
/begin CHARACTERISTIC SWI_N_TEGS_ERSATZ_HAS "Schalter fuer Ersatzwert n_t_egs_in (Ersatzwert bei 1)" VALUE 0x26EC26 UBYTE_COL_DIRECT_M_S7_S3 0 swi_int_M_S7_S3 0 1 /end CHARACTERISTIC
/begin CHARACTERISTIC SWI_N_VM_ERSATZ_HAS "Schalter fuer Ersatzwert n_vm_in (Ersatzwert bei 1)" VALUE 0x26EC27 UBYTE_COL_DIRECT_M_S7_S3 0 swi_int_M_S7_S3 0 1 /end CHARACTERISTIC
/begin CHARACTERISTIC SWI_ND_MIN_SAF_HAS_ERSATZ_HAS "Schalter fuer Ersatzwert fuer nd_min_saf_has_portout (bei SWI_ = 1)  " VALUE 0x26EC7F UBYTE_COL_DIRECT_M_S7_S3 0 swi_int_M_S7_S3 0 1 /end CHARACTERISTIC
/begin CHARACTERISTIC SWI_NEM_FEHLERWERTNULL_HAS "Aktivierung des Ersatzwerts Null fuer die EM-Drehzahl bei Signalstatus Signal fehlerhaft" VALUE 0x26EC20 UBYTE_COL_DIRECT_M_S7_S3 0 swi_int_M_S7_S3 0 1 /end CHARACTERISTIC
/begin CHARACTERISTIC SWI_OSMODE_NEXT_ERSATZ_HAS "Schalter fuer Ersatzwert osmode_next_in (Ersatzwert bei 1)" VALUE 0x26EC28 UBYTE_COL_DIRECT_M_S7_S3 0 swi_int_M_S7_S3 0 1 /end CHARACTERISTIC
/begin CHARACTERISTIC SWI_P_BREMSEFZG_ERSATZ_HAS "Schalter fuer Ersatzwert p_bremse_fzg_in (Ersatzwert bei 1)" VALUE 0x26EC2B UBYTE_COL_DIRECT_M_S7_S3 0 swi_int_M_S7_S3 0 1 /end CHARACTERISTIC
/begin CHARACTERISTIC SWI_PHI_NEIGUNG_ERSATZ_HAS "Schalter fuer Ersatzwert phi_neigung_in (Ersatzwert bei 1)" VALUE 0x26EC29 UBYTE_COL_DIRECT_M_S7_S3 0 swi_int_M_S7_S3 0 1 /end CHARACTERISTIC
/begin CHARACTERISTIC SWI_POS_EGS_ERSATZ_HAS "Schalter fuer Ersatzwert pos_egs_portin (Ersatzwert bei 1)" VALUE 0x26EC2A UBYTE_COL_DIRECT_M_S7_S3 0 swi_int_M_S7_S3 0 1 /end CHARACTERISTIC
/begin CHARACTERISTIC SWI_SCHALT_MODE_EGS_ERSATZ_HAS "Schalter fuer Ersatzwert schalt_mode_egs_in (Ersatzwert bei 1)" VALUE 0x26EC2C UBYTE_COL_DIRECT_M_S7_S3 0 swi_int_M_S7_S3 0 1 /end CHARACTERISTIC
/begin CHARACTERISTIC SWI_SOC_ERSATZ_HAS "Schalter fuer Ersatzwert fuer soc_in (wenn SWI_ = 1)" VALUE 0x26EC2D UBYTE_COL_DIRECT_M_S7_S3 0 swi_int_M_S7_S3 0 1 /end CHARACTERISTIC
/begin CHARACTERISTIC SWI_SOLLGANG_EGS_ERSATZ_HAS "Schalter fuer Ersatzwert sollgang_egs_in (Ersatzwert bei 1)" VALUE 0x26EC2E UBYTE_COL_DIRECT_M_S7_S3 0 swi_int_M_S7_S3 0 1 /end CHARACTERISTIC
/begin CHARACTERISTIC SWI_ST_IST_BZ_HAS_ERSATZ_HAS "Schalter fuer Ersatzwert st_ist_bz_has_portout (Ersatzwert bei 1)" VALUE 0x26EC86 UBYTE_COL_DIRECT_M_S7_S3 0 swi_int_M_S7_S3 0 1 /end CHARACTERISTIC
/begin CHARACTERISTIC SWI_ST_ZIEL_BZ_HAS_ERSATZ_HAS "Schalter fuer Ersatzwert st_ziel_bz_has_portout (Ersatzwert bei 1)" VALUE 0x26EC87 UBYTE_COL_DIRECT_M_S7_S3 0 swi_int_M_S7_S3 0 1 /end CHARACTERISTIC
/begin CHARACTERISTIC SWI_STATUS_ABLAUF_HAS_ERS_HAS "Schalter fuer Ersatzwert status_ablauf_has_portout (Ersatzwert bei 1)" VALUE 0x26EC84 UBYTE_COL_DIRECT_M_S7_S3 0 swi_int_M_S7_S3 0 1 /end CHARACTERISTIC
/begin CHARACTERISTIC SWI_STATUS_ABLAUFAKTIV_ERS_HAS "Schalter fuer Ersatzwert status_ablaufaktiv_has_portout (Ersatzwert bei 1)" VALUE 0x26EC83 UBYTE_COL_DIRECT_M_S7_S3 0 swi_int_M_S7_S3 0 1 /end CHARACTERISTIC
/begin CHARACTERISTIC SWI_STATUS_ABS_ERSATZ_HAS "Schalter fuer Ersatzwert status_abs_in (Ersatzwert bei 1)" VALUE 0x26EC2F UBYTE_COL_DIRECT_M_S7_S3 0 swi_int_M_S7_S3 0 1 /end CHARACTERISTIC
/begin CHARACTERISTIC SWI_STATUS_ALAENGS_ADAO_ERS_HAS "Schalter fuer Ersatzwert status_alaengs_adaoff_in (Ersatzwert bei 1)" VALUE 0x26EC30 UBYTE_COL_DIRECT_M_S7_S3 0 swi_int_M_S7_S3 0 1 /end CHARACTERISTIC
/begin CHARACTERISTIC SWI_STATUS_ASR_ERSATZ_HAS "Schalter fuer Ersatzwert status_asr_in (Ersatzwert bei 1)" VALUE 0x26EC31 UBYTE_COL_DIRECT_M_S7_S3 0 swi_int_M_S7_S3 0 1 /end CHARACTERISTIC
/begin CHARACTERISTIC SWI_STATUS_AUTOHOLD_ERSATZ_HAS "Schalter fuer Ersatzwert status_autohold_in (Ersatzwert bei 1)" VALUE 0x26EC32 UBYTE_COL_DIRECT_M_S7_S3 0 swi_int_M_S7_S3 0 1 /end CHARACTERISTIC
/begin CHARACTERISTIC SWI_STATUS_BETRIEBSBER_ERS_HAS "Schalter fuer Ersatzwert status_betriebsbereit_hst_in (Ersatzwert bei 1)" VALUE 0x26EC33 UBYTE_COL_DIRECT_M_S7_S3 0 sts_int_e_M_S7_S3 0 1 /end CHARACTERISTIC
/begin CHARACTERISTIC SWI_STATUS_C_K0_ERSATZ_HAS "Schalter fuer Ersatzwert status_c_k0_in (Ersatzwert bei 1)" VALUE 0x26EC35 UBYTE_COL_DIRECT_M_S7_S3 0 swi_int_M_S7_S3 0 1 /end CHARACTERISTIC
/begin CHARACTERISTIC SWI_STATUS_CUMGEBUNG_ERSATZ_HAS "Schalter fuer Ersatzwert fuer status_cumgebung_in (wenn SWI_ = 1)" VALUE 0x26EC34 UBYTE_COL_DIRECT_M_S7_S3 0 swi_int_M_S7_S3 0 1 /end CHARACTERISTIC
/begin CHARACTERISTIC SWI_STATUS_EFAHREN_HAS_ERS_HAS "Schalter fuer Ersatzwert status_efahren_has_portout (Ersatzwert bei 1)" VALUE 0x26EC85 UBYTE_COL_DIRECT_M_S7_S3 0 swi_int_M_S7_S3 0 1 /end CHARACTERISTIC
/begin CHARACTERISTIC SWI_STATUS_FEHLER_IEP_ERS_HAS "Schalter fuer Ersatzwert z_iep_has_fkt (Ersatzwert bei 1)" VALUE 0x26EC36 UBYTE_COL_DIRECT_M_S7_S3 0 swi_int_M_S7_S3 0 1 /end CHARACTERISTIC
/begin CHARACTERISTIC SWI_STATUS_GETRBEREIT_ERS_HAS "Schalter fuer Ersatzwert status_getrbereit_in (Ersatzwert bei 1)" VALUE 0x26EC37 UBYTE_COL_DIRECT_M_S7_S3 0 swi_int_M_S7_S3 0 1 /end CHARACTERISTIC
/begin CHARACTERISTIC SWI_STATUS_HILLHOLD_ERSATZ_HAS "Schalter fuer Ersatzwert status_hillhold_in (Ersatzwert bei 1)" VALUE 0x26EC38 UBYTE_COL_DIRECT_M_S7_S3 0 swi_int_M_S7_S3 0 1 /end CHARACTERISTIC
/begin CHARACTERISTIC SWI_STATUS_IAE_ADAP_ERSATZ_HAS "Schalter fuer Ersatzwert status_iae_adap_in (Ersatzwert bei 1)" VALUE 0x26EC39 UBYTE_COL_DIRECT_M_S7_S3 0 swi_int_M_S7_S3 0 1 /end CHARACTERISTIC
/begin CHARACTERISTIC SWI_STATUS_IAE_ERSATZ_HAS "Schalter fuer Ersatzwert status_iae_in (Ersatzwert bei 1)" VALUE 0x26EC3A UBYTE_COL_DIRECT_M_S7_S3 0 swi_int_M_S7_S3 0 1 /end CHARACTERISTIC
/begin CHARACTERISTIC SWI_STATUS_IEP_ERSATZ_HAS "Ersatzwert status_iep_in (Ersatzwert bei 1)" VALUE 0x26EC3B UBYTE_COL_DIRECT_M_S7_S3 0 swi_int_M_S7_S3 0 1 /end CHARACTERISTIC
/begin CHARACTERISTIC SWI_STATUS_K0_ADAP_ERSATZ_HAS "Schalter fuer Ersatzwert status_k0_adap_has_in (Ersatzwert bei 1)" VALUE 0x26EC3E UBYTE_COL_DIRECT_M_S7_S3 0 swi_int_M_S7_S3 0 1 /end CHARACTERISTIC
/begin CHARACTERISTIC SWI_STATUS_K0_ERSATZ_HAS "Schalter fuer Ersatzwert status_k0_in (Ersatzwert bei 1)" VALUE 0x26EC3F UBYTE_COL_DIRECT_M_S7_S3 0 swi_int_M_S7_S3 0 1 /end CHARACTERISTIC
/begin CHARACTERISTIC SWI_STATUS_K0ADAPZAEHLER_ERSATZ_HAS "Schalter fuer Ersatzwert status_k0_adap_zaehler_in (Ersatzwert bei 1)" VALUE 0x26EC3C UBYTE_COL_DIRECT_M_S7_S3 0 swi_int_M_S7_S3 0 1 /end CHARACTERISTIC
/begin CHARACTERISTIC SWI_STATUS_K0BEFUELLUNG_ERSATZ_HAS "Schalter fuer Ersatzwert status_k0_befuellung_in (Ersatzwert bei 1)" VALUE 0x26EC3D UBYTE_COL_DIRECT_M_S7_S3 0 swi_int_M_S7_S3 0 1 /end CHARACTERISTIC
/begin CHARACTERISTIC SWI_STATUS_KRAFTFLUSS_ERS_HAS "Schalter fuer Ersatzwert status_kraftfluss_egs_in (Ersatzwert bei 1)" VALUE 0x26EC40 UBYTE_COL_DIRECT_M_S7_S3 0 swi_int_M_S7_S3 0 1 /end CHARACTERISTIC
/begin CHARACTERISTIC SWI_STATUS_KRAFTFLUSS_LEV2_ERS_HAS "Schalter fuer Ersatzwert status_kraftfluss_lev2_egs_in (Ersatzwert bei 1)" VALUE 0x26EC41 UBYTE_COL_DIRECT_M_S7_S3 0 swi_int_M_S7_S3 0 1 /end CHARACTERISTIC
/begin CHARACTERISTIC SWI_STATUS_NEM_ERSATZ_HAS "Schalter fuer Ersatzwert status_nem_in (Ersatzwert bei 1)" VALUE 0x26EC42 UBYTE_COL_DIRECT_M_S7_S3 0 swi_int_M_S7_S3 0 1 /end CHARACTERISTIC
/begin CHARACTERISTIC SWI_STATUS_NREGEMHST_ERSATZ_HAS "Schalter fuer Ersatzwert status_nreg_em_hst_in (Ersatzwert bei 1)" VALUE 0x26EC43 UBYTE_COL_DIRECT_M_S7_S3 0 swi_int_M_S7_S3 0 1 /end CHARACTERISTIC
/begin CHARACTERISTIC SWI_STATUS_NVM_ERSATZ_HAS "Schalter fuer Ersatzwert status_nvm_in (Ersatzwert bei 1)" VALUE 0x26EC44 UBYTE_COL_DIRECT_M_S7_S3 0 swi_int_M_S7_S3 0 1 /end CHARACTERISTIC
/begin CHARACTERISTIC SWI_STATUS_POSVUEB_ERSATZ_HAS "Schalter fuer Ersatzwert pos_egs_in (Ersatzwert bei 1)" VALUE 0x26EC45 UBYTE_COL_DIRECT_M_S7_S3 0 swi_int_M_S7_S3 0 1 /end CHARACTERISTIC
/begin CHARACTERISTIC SWI_STATUS_SAVM_ERSATZ_HAS "Schalter fuer Ersatzwert status_sa_vm_in (Ersatzwert bei 1)" VALUE 0x26EC46 UBYTE_COL_DIRECT_M_S7_S3 0 sts_int_e_M_S7_S3 0 1 /end CHARACTERISTIC
/begin CHARACTERISTIC SWI_STATUS_SOC_ERSATZ_HAS "Schalter fuer Ersatzwert fuer status_soc_in (wenn SWI_ = 1)" VALUE 0x26EC47 UBYTE_COL_DIRECT_M_S7_S3 0 swi_int_M_S7_S3 0 1 /end CHARACTERISTIC
/begin CHARACTERISTIC SWI_STATUS_VF_ERSATZ_HAS "Schalter fuer Ersatzwert status_vf_in (Ersatzwert bei 1)" VALUE 0x26EC49 UBYTE_COL_DIRECT_M_S7_S3 0 swi_int_M_S7_S3 0 1 /end CHARACTERISTIC
/begin CHARACTERISTIC SWI_STATUS_VFREF_ERSATZ_HAS "Schalter fuer Ersatzwert status_vfref_in (Ersatzwert bei 1)" VALUE 0x26EC48 UBYTE_COL_DIRECT_M_S7_S3 0 swi_int_M_S7_S3 0 1 /end CHARACTERISTIC
/begin CHARACTERISTIC SWI_STATUS_WASCHSTR_ERSATZ_HAS "Schalter fuer Ersatzwert status_waschstr_has_in (Ersatzwert bei 1)" VALUE 0x26EC4A UBYTE_COL_DIRECT_M_S7_S3 0 swi_int_M_S7_S3 0 1 /end CHARACTERISTIC
/begin CHARACTERISTIC SWI_T_BETRIEB_PVU_EE_ERSATZ_HAS "Schalter fuer Ersatzwert t_betrieb_pvu_has_ee_in (Ersatzwert bei 1)" VALUE 0x26EC4B UBYTE_COL_DIRECT_M_S7_S3 0 swi_int_M_S7_S3 0 1 /end CHARACTERISTIC
/begin CHARACTERISTIC SWI_T_BETRIEB_PVU_ERSATZ_HAS "Schalter fuer Ersatzwert fuer t_betrieb_pvu_has_portout" VALUE 0x26EC88 UBYTE_COL_DIRECT_M_S7_S3 0 swi_int_M_S7_S3 0 1 /end CHARACTERISTIC
/begin CHARACTERISTIC SWI_V_F_ERSATZ_HAS "Schalter fuer Ersatzwert v_f_in (Ersatzwert bei 1)" VALUE 0x26EC4D UBYTE_COL_DIRECT_M_S7_S3 0 swi_int_M_S7_S3 0 1 /end CHARACTERISTIC
/begin CHARACTERISTIC SWI_V_FREF_ERSATZ_HAS "Schalter fuer Ersatzwert v_f_ref_in (Ersatzwert bei 1)" VALUE 0x26EC4C UBYTE_COL_DIRECT_M_S7_S3 0 swi_int_M_S7_S3 0 1 /end CHARACTERISTIC
/begin CHARACTERISTIC SWI_Z_ABLAUFHASHST_ERSATZ_HAS "Schalter fuer Ersatzwert z_ablauf_has_hst_in (Ersatzwert bei 1)" VALUE 0x26EC4F UBYTE_COL_DIRECT_M_S7_S3 0 swi_int_M_S7_S3 0 1 /end CHARACTERISTIC
/begin CHARACTERISTIC SWI_Z_ABLAUFVARIANTE_ERS_HAS "Schalter fuer Ersatzwert z_ablaufvariante_has_hst_in (Ersatzwert bei 1)" VALUE 0x26EC50 UBYTE_COL_DIRECT_M_S7_S3 0 swi_int_M_S7_S3 0 1 /end CHARACTERISTIC
/begin CHARACTERISTIC SWI_Z_BAHASK0HST_ERSATZ_HAS "Schalter fuer Ersatzwert z_ba_has_k0_hst_in (Ersatzwert bei 1)" VALUE 0x26EC51 UBYTE_COL_DIRECT_M_S7_S3 0 sts_int_e_M_S7_S3 0 1 /end CHARACTERISTIC
/begin CHARACTERISTIC SWI_Z_BAHASVMHST_ERSATZ_HAS "Schalter fuer Ersatzwert z_ba_has_vm_hst_in (Ersatzwert bei 1)" VALUE 0x26EC52 UBYTE_COL_DIRECT_M_S7_S3 0 sts_int_e_M_S7_S3 0 1 /end CHARACTERISTIC
/begin CHARACTERISTIC SWI_Z_DIAG_ERSFKT_ERS_HAS "Schalter fuer Ersatzwert z_diag_ersfkt_has_in (Ersatzwert bei 1)" VALUE 0x26EC53 UBYTE_COL_DIRECT_M_S7_S3 0 swi_int_M_S7_S3 0 1 /end CHARACTERISTIC
/begin CHARACTERISTIC SWI_Z_DIAG_ERSFKT_HI_96_ERS_HAS "Schalter fuer Ersatzwert z_diag_ersfkt_hi_96_has_in (Ersatzwert bei 1)" VALUE 0x26EC54 UBYTE_COL_DIRECT_M_S7_S3 0 swi_int_M_S7_S3 0 1 /end CHARACTERISTIC
/begin CHARACTERISTIC SWI_Z_DIAG_ERSFKT_HI_ERS_HAS "Schalter fuer Ersatzwert z_diag_ersfkt_hi_has_in (Ersatzwert bei 1)" VALUE 0x26EC55 UBYTE_COL_DIRECT_M_S7_S3 0 swi_int_M_S7_S3 0 1 /end CHARACTERISTIC
/begin CHARACTERISTIC SWI_Z_DIAG_NOTGANG_HAS_ERS_HAS "Schalter fuer Ersatzwert z_diag_notgang_has_in (Ersatzwert bei 1)" VALUE 0x26EC56 UBYTE_COL_DIRECT_M_S7_S3 0 swi_int_M_S7_S3 0 1 /end CHARACTERISTIC
/begin CHARACTERISTIC SWI_Z_FREIGABE_PVU_ERSATZ_HAS "Schalter fuer Ersatzwert fuer z_freigabe_pvu_has_portout" VALUE 0x26EC89 UBYTE_COL_DIRECT_M_S7_S3 0 swi_int_M_S7_S3 0 1 /end CHARACTERISTIC
/begin CHARACTERISTIC SWI_Z_GLSBE_HAS_ERS_HAS "Schalter fuer Ersatzwert z_glsbe_has_portout (Ersatzwert bei 1)" VALUE 0x26EC8A UBYTE_COL_DIRECT_M_S7_S3 0 swi_int_M_S7_S3 0 1 /end CHARACTERISTIC
/begin CHARACTERISTIC SWI_Z_IEP_ERSATZ_HAS "Schalter fuer Ersatzwert z_iep_in (Ersatzwert bei 1)" VALUE 0x26EC57 UBYTE_COL_DIRECT_M_S7_S3 0 swi_int_M_S7_S3 0 1 /end CHARACTERISTIC
/begin CHARACTERISTIC SWI_Z_K0_FST_ERSATZ_HAS "Schalter fuer Ersatzwert z_k0_fst_in (Ersatzwert bei 1)" VALUE 0x26EC58 UBYTE_COL_DIRECT_M_S7_S3 0 swi_int_M_S7_S3 0 1 /end CHARACTERISTIC
/begin CHARACTERISTIC SWI_Z_K0_HAS_ERSATZ_HAS "Schalter fuer Ersatzwert z_k0_has_portout (Ersatzwert bei 1)" VALUE 0x26EC8C UBYTE_COL_DIRECT_M_S7_S3 0 swi_int_M_S7_S3 0 1 /end CHARACTERISTIC
/begin CHARACTERISTIC SWI_Z_K0BEFUELLOPT_HAS_ERS_HAS "Schalter fuer Ersatzwert fuer z_k0_befuellopt_has_portout (bei SWI_ = 1)  " VALUE 0x26EC8B UBYTE_COL_DIRECT_M_S7_S3 0 swi_int_M_S7_S3 0 1 /end CHARACTERISTIC
/begin CHARACTERISTIC SWI_Z_KPS_STADA_ERSATZ_HAS "Schalter fuer Ersatzwert z_kps_stada_in (Ersatzwert bei 1)" VALUE 0x26EC59 UBYTE_COL_DIRECT_M_S7_S3 0 swi_int_M_S7_S3 0 1 /end CHARACTERISTIC
/begin CHARACTERISTIC SWI_Z_MMAXIAE_HAS_ERSATZ_HAS "Schalter fuer Ersatzwert z_m_max_iae_has_portout (Ersatzwert bei 1)" VALUE 0x26EC8D UBYTE_COL_DIRECT_M_S7_S3 0 swi_int_M_S7_S3 0 1 /end CHARACTERISTIC
/begin CHARACTERISTIC SWI_Z_MODUS_IAE_HAS_ERSATZ_HAS "Schalter fuer Ersatzwert z_modus_iae_has_portout (Ersatzwert bei 1)" VALUE 0x26EC8E UBYTE_COL_DIRECT_M_S7_S3 0 swi_int_M_S7_S3 0 1 /end CHARACTERISTIC
/begin CHARACTERISTIC SWI_Z_MODUS_IEP_HAS_ERSATZ_HAS "Schalter fuer Ersatzwert iep_soll_has_portout (bei SWI_ = 1)" VALUE 0x26EC8F UBYTE_COL_DIRECT_M_S7_S3 0 swi_int_M_S7_S3 0 1 /end CHARACTERISTIC
/begin CHARACTERISTIC SWI_Z_MSA_FST_ERSATZ_HAS "Schalter fuer Ersatzwert z_msa_fst_has_in (Ersatzwert bei 1)" VALUE 0x26EC5A UBYTE_COL_DIRECT_M_S7_S3 0 swi_int_M_S7_S3 0 1 /end CHARACTERISTIC
/begin CHARACTERISTIC SWI_Z_MSA_HAS_ERSATZ_HAS "Schalter fuer Ersatzwert z_msa_has_portout (Ersatzwert bei 1)" VALUE 0x26EC90 UBYTE_COL_DIRECT_M_S7_S3 0 swi_int_M_S7_S3 0 1 /end CHARACTERISTIC
/begin CHARACTERISTIC SWI_Z_MSA_STADA_ERSATZ_HAS "Schalter fuer Ersatzwert z_msa_stada_in (Ersatzwert bei 1)" VALUE 0x26EC5B UBYTE_COL_DIRECT_M_S7_S3 0 swi_int_M_S7_S3 0 1 /end CHARACTERISTIC
/begin CHARACTERISTIC SWI_Z_MSOLLEM_HAS_ERSATZ_HAS "Schalter fuer Ersatzwert z_m_soll_em_has_portout (Ersatzwert bei 1)" VALUE 0x26EC91 UBYTE_COL_DIRECT_M_S7_S3 0 swi_int_M_S7_S3 0 1 /end CHARACTERISTIC
/begin CHARACTERISTIC SWI_Z_NLLSOLL_IAE_ERS_HAS "Schalter fuer Ersatzwert z_nllsoll_iae_in (Ersatzwert bei 1)" VALUE 0x26EC5C UBYTE_COL_DIRECT_M_S7_S3 0 swi_int_M_S7_S3 0 1 /end CHARACTERISTIC
/begin CHARACTERISTIC SWI_Z_NLLSOLLMOD_HAS_ERSATZ_HAS "Schalter fuer Ersatzwert z_nllsoll_modus_has_portout" VALUE 0x26EC92 UBYTE_COL_DIRECT_M_S7_S3 0 swi_int_M_S7_S3 0 1 /end CHARACTERISTIC
/begin CHARACTERISTIC SWI_Z_NMINEMPARKSP_ERS_HAS "Schalter fuer z_n_min_em_parksp_has_in: Anforderung einer EM-Drehzahlanhebung beim Auslegen der Parksperre infolge unzureichender Oelversorgung" VALUE 0x26EC5D UBYTE_COL_DIRECT_M_S7_S3 0 st_int_l_M_S7_S3 0 1 /end CHARACTERISTIC
/begin CHARACTERISTIC SWI_Z_NSOLLEM_HAS_ERSATZ_HAS "Schalter fuer Ersatzwert z_n_soll_em_has_portout (Ersatzwert bei 1)" VALUE 0x26EC93 UBYTE_COL_DIRECT_M_S7_S3 0 swi_int_M_S7_S3 0 1 /end CHARACTERISTIC
/begin CHARACTERISTIC SWI_Z_NSOLLVM_HAS_ERSATZ_HAS "Schalter fuer Ersatzwert z_n_soll_vm_has_portout (Ersatzwert bei 1)" VALUE 0x26EC94 UBYTE_COL_DIRECT_M_S7_S3 0 swi_int_M_S7_S3 0 1 /end CHARACTERISTIC
/begin CHARACTERISTIC SWI_Z_OEA_HST_ERSATZ_HAS "Schalter fuer Ersatzwert z_oea_hst_in (Ersatzwert bei 1)" VALUE 0x26EC5E UBYTE_COL_DIRECT_M_S7_S3 0 swi_int_M_S7_S3 0 1 /end CHARACTERISTIC
/begin CHARACTERISTIC SWI_Z_P_HYS_K0_HAS_ERSATZ_HAS "Schalter fuer Ersatzwert z_p_hys_k0_has_portout" VALUE 0x26EC95 UBYTE_COL_DIRECT_M_S7_S3 0 swi_int_M_S7_S3 0 1 /end CHARACTERISTIC
/begin CHARACTERISTIC SWI_Z_SAF_HAS_ERSATZ_HAS "Schalter fuer Ersatzwert z_saf_has_portout (Ersatzwert bei 1)" VALUE 0x26EC96 UBYTE_COL_DIRECT_M_S7_S3 0 swi_int_M_S7_S3 0 1 /end CHARACTERISTIC
/begin CHARACTERISTIC SWI_Z_SAS_HAS_ERSATZ_HAS "Schalter fuer z_sas_has_portout (bei SWI_ = 1)" VALUE 0x26EC97 UBYTE_COL_DIRECT_M_S7_S3 0 sts_int_e_M_S7_S3 0 1 /end CHARACTERISTIC
/begin CHARACTERISTIC SWI_Z_START_MODUS_HAS_ERS_HAS "Schalter fuer Ersatzwert z_start_modus_has_portout" VALUE 0x26EC98 UBYTE_COL_DIRECT_M_S7_S3 0 swi_int_M_S7_S3 0 1 /end CHARACTERISTIC
/begin CHARACTERISTIC SWI_Z_STSPSYSMPS_ERSATZ_HAS "Schalter fuer Ersatzwert z_status_psys_mps_portout" VALUE 0x26EC99 UBYTE_COL_DIRECT_M_S7_S3 0 swi_int_M_S7_S3 0 1 /end CHARACTERISTIC
/begin CHARACTERISTIC SWI_Z_SVH_HAS_ERSATZ_HAS "Schalter fuer Ersatzwert z_svh_has_portout" VALUE 0x26EC9A UBYTE_COL_DIRECT_M_S7_S3 0 swi_int_M_S7_S3 0 1 /end CHARACTERISTIC
/begin CHARACTERISTIC SWI_ZIELGANG_EGS_ERSATZ_HAS "Schalter fuer Ersatzwert zielgang_egs_in (Ersatzwert bei 1)" VALUE 0x26EC4E UBYTE_COL_DIRECT_M_S7_S3 0 swi_int_M_S7_S3 0 1 /end CHARACTERISTIC
/begin CHARACTERISTIC T_BETRIEB_PVU_EE_ERSATZ_HAS "Ersatzwert fuer t_betrieb_pvu_has_ee_in (wenn SWI_ = 1)" VALUE 0x2637B4 ULONG_COL_DIRECT_M_S7_S3 0 t_int_M_S7_S3 0 42949672.95 /end CHARACTERISTIC
/begin CHARACTERISTIC T_BETRIEB_PVU_ERSATZ_HAS "Ersatzwert fuer t_betrieb_pvu_has_portout (bei SWI_ = 1)" VALUE 0x2637CC ULONG_COL_DIRECT_M_S7_S3 0 t_int_M_S7_S3 0 42949672.95 /end CHARACTERISTIC
/begin CHARACTERISTIC T_MSOLLEMHST_HAS "Verzoegerungszeit des EM Sollmoment der HST fuer die Berechnung des Fahrerwunschmoments der HST" VALUE 0x2637B8 FLOAT32_IEEE_COL_DIRECT_M_S7_S3 0 t_fl_M_S7_S3 0 0.1 /end CHARACTERISTIC
/begin CHARACTERISTIC T_MSOLLVMHST_HAS "Verzoegerungszeit des VM Sollmoment der HST fuer die Berechnung des Fahrerwunschmoments der HST" VALUE 0x2637BC FLOAT32_IEEE_COL_DIRECT_M_S7_S3 0 t_fl_M_S7_S3 0 0.1 /end CHARACTERISTIC
/begin CHARACTERISTIC T_VK0SREGABS_KPS_HAS "Verzoegerungszeit zur Freigabe der K0-Schlupfregelung nach einer aktiven ABS-Regelung der Priorisierung der K0-Ansteuerung der HAS" VALUE 0x26E112 UWORD_COL_DIRECT_M_S7_S3 0 t_int_n_M_S7_S3 0 5 /end CHARACTERISTIC
/begin CHARACTERISTIC T_VK0SREGASR_KPS_HAS "Verzoegerungszeit zur Freigabe der K0-Schlupfregelung nach einer aktiven ASR-Regelung der Priorisierung der K0-Ansteuerung der HAS" VALUE 0x26E114 UWORD_COL_DIRECT_M_S7_S3 0 t_int_n_M_S7_S3 0 5 /end CHARACTERISTIC
/begin CHARACTERISTIC T_VZABLAUFREINIT_HAS "Verzoegerungszeit zur Bestimmung des Soll-Betriebszustands der Hybrid-Zustandssteuerung bei Anforderung eines Neustarts durch die HAS Diagnose" VALUE 0x26E0A8 UWORD_COL_DIRECT_M_S7_S3 0 t_int_n_M_S7_S3 0 1 /end CHARACTERISTIC
/begin CHARACTERISTIC TAB_K0SCHLUPFBED_IAE_HAS "Tabelle um die Schlupfentkopplung der K0 in Abhaengigkeit des IAE-Status zu erlauben in der HAS" VAL_BLK 0x26ED34 UBYTE_COL_DIRECT_M_S7_S3 0 sts_int_M_S7_S3 0 1 NUMBER 9 /end CHARACTERISTIC
/begin CHARACTERISTIC TAB_ZDIAGNOTGANG_BMI_HAS "Tabelle zur Festlegung der Zahlenwerte der Notgang-Information der Diagnose die zu einer Ueberfuehrung des IAE Hybrid Betriebsmodus in den Zustand E-Fahren Kraftschluss fuehren - Wert 0: keine Beeinflussung BMI" VAL_BLK 0x26E102 UBYTE_COL_DIRECT_M_S7_S3 0 sts_int_M_S7_S3 0 255 NUMBER 6 /end CHARACTERISTIC
/begin CHARACTERISTIC TAB_ZK0FSTSBE_HAS "Tabelle zur Umcodierung der Werte, die von der Fahrstrategie kommen" VAL_BLK 0x264520 UBYTE_COL_DIRECT_M_S7_S3 0 sts_int_M_S7_S3 3 5 NUMBER 4 /end CHARACTERISTIC
/begin CHARACTERISTIC V_F_ERSATZ_HAS "Ersatzwert fuer v_f_in (wenn SWI_ = 1)" VALUE 0x26E0DE UWORD_COL_DIRECT_M_S7_S3 0 v_int_M_S7_S3 0 500 /end CHARACTERISTIC
/begin CHARACTERISTIC V_FREF_ERSATZ_HAS "Ersatzwert fuer v_f_ref_in (wenn SWI_ = 1)" VALUE 0x26E0DC UWORD_COL_DIRECT_M_S7_S3 0 v_int_M_S7_S3 0 511 /end CHARACTERISTIC
/begin CHARACTERISTIC Z_ABLAUFHASHST_ERSATZ_HAS "Ersatzwert fuer z_ablauf_has_hst_in (wenn SWI_ = 1)" VALUE 0x26EC60 UBYTE_COL_DIRECT_M_S7_S3 0 st_int_M_S7_S3 0 255 /end CHARACTERISTIC
/begin CHARACTERISTIC Z_ABLAUFVARIANTE_ERS_HAS "Ersatzwert fuer z_ablaufvariante_has_hst_in (wenn SWI_ = 1)" VALUE 0x26EC61 UBYTE_COL_DIRECT_M_S7_S3 0 st_int_M_S7_S3 0 255 /end CHARACTERISTIC
/begin CHARACTERISTIC Z_BAHASK0HST_ERSATZ_HAS "Ersatzwert fuer z_ba_has_k0_hst_in (wenn SWI_ = 1)" VALUE 0x26EC62 UBYTE_COL_DIRECT_M_S7_S3 0 sts_int_M_S7_S3 0 1 /end CHARACTERISTIC
/begin CHARACTERISTIC Z_BAHASVMHST_ERSATZ_HAS "Ersatzwert fuer z_ba_has_vm_hst_in (wenn SWI_ = 1)" VALUE 0x26EC63 UBYTE_COL_DIRECT_M_S7_S3 0 sts_int_M_S7_S3 0 1 /end CHARACTERISTIC
/begin CHARACTERISTIC Z_DIAG_ERSFKT_ERS_HAS "Ersatzwert fuer z_diag_ersfkt_has_in (wenn SWI_ = 1)" VALUE 0x2637C0 ULONG_COL_DIRECT_M_S7_S3 0 st_int_25_M_S7_S3 0 4294967295 /end CHARACTERISTIC
/begin CHARACTERISTIC Z_DIAG_ERSFKT_HI_96_ERS_HAS "Ersatzwert fuer z_diag_ersfkt_hi_96_has_in (wenn SWI_ = 1)" VALUE 0x2637C4 ULONG_COL_DIRECT_M_S7_S3 0 st_int_25_M_S7_S3 0 4294967295 /end CHARACTERISTIC
/begin CHARACTERISTIC Z_DIAG_ERSFKT_HI_ERS_HAS "Ersatzwert fuer z_diag_ersfkt_hi_has_in (wenn SWI_ = 1)" VALUE 0x2637C8 ULONG_COL_DIRECT_M_S7_S3 0 st_int_25_M_S7_S3 0 4294967295 /end CHARACTERISTIC
/begin CHARACTERISTIC Z_DIAG_NOTGANG_HAS_ERS_HAS "Ersatzwert fuer z_diag_notgang_has_in (wenn SWI_ = 1)" VALUE 0x26EC64 UBYTE_COL_DIRECT_M_S7_S3 0 st_int_M_S7_S3 0 255 /end CHARACTERISTIC
/begin CHARACTERISTIC Z_FREIGABE_PVU_ERSATZ_HAS "Ersatzwert fuer z_freigabe_pvu_has_portout (bei SWI_ = 1)" VALUE 0x26EC9B UBYTE_COL_DIRECT_M_S7_S3 0 st_int_M_S7_S3 0 1 /end CHARACTERISTIC
/begin CHARACTERISTIC Z_GLSBE_HAS_ERS_HAS "Ersatzwert fuer z_glsbe_has_portout (bei SWI_ = 1)" VALUE 0x26EC9C UBYTE_COL_DIRECT_M_S7_S3 0 sts_int_M_S7_S3 0 255 /end CHARACTERISTIC
/begin CHARACTERISTIC Z_IEP_ERSATZ_HAS "Ersatzwert fuer status_iep_in (wenn SWI_ = 1)" VALUE 0x26E0E0 UWORD_COL_DIRECT_M_S7_S3 0 st_int_g_M_S7_S3 0 65535 /end CHARACTERISTIC
/begin CHARACTERISTIC Z_K0_FST_ERSATZ_HAS "Ersatzwert z_k0_fst_in (Ersatzwert bei 1)" VALUE 0x26EC65 UBYTE_COL_DIRECT_M_S7_S3 0 st_int_M_S7_S3 0 255 /end CHARACTERISTIC
/begin CHARACTERISTIC Z_K0_HAS_ERSATZ_HAS "Ersatzwert fuer z_k0_has_portout (bei SWI_ = 1)" VALUE 0x26EC9E UBYTE_COL_DIRECT_M_S7_S3 0 sts_int_M_S7_S3 0 7 /end CHARACTERISTIC
/begin CHARACTERISTIC Z_K0BEFUELLOPT_HAS_ERS_HAS "Ersatzwert fuer z_k0_befuellopt_has_portout (bei SWI_ = 1)" VALUE 0x26EC9D UBYTE_COL_DIRECT_M_S7_S3 0 sts_int_M_S7_S3 0 2 /end CHARACTERISTIC
/begin CHARACTERISTIC Z_KPS_STADA_ERSATZ_HAS "Ersatzwert fuer z_kps_stada_in (wenn SWI_ = 1)" VALUE 0x26EC66 UBYTE_COL_DIRECT_M_S7_S3 0 sts_int_M_S7_S3 0 1 /end CHARACTERISTIC
/begin CHARACTERISTIC Z_MMAXIAE_HAS_ERSATZ_HAS "Ersatzwert fuer z_m_max_iae_has_portout (bei SWI_ = 1)" VALUE 0x26EC9F UBYTE_COL_DIRECT_M_S7_S3 0 sts_int_M_S7_S3 0 1 /end CHARACTERISTIC
/begin CHARACTERISTIC Z_MODUS_IAE_HAS_ERSATZ_HAS "Ersatzwert fuer z_modus_iae_has_portout (bei SWI_ = 1)" VALUE 0x26ECA0 UBYTE_COL_DIRECT_M_S7_S3 0 sts_int_M_S7_S3 0 2 /end CHARACTERISTIC
/begin CHARACTERISTIC Z_MODUS_IEP_HAS_ERSATZ_HAS "Ersatzwert fuer iep_soll_has_portout (bei SWI_ = 1)" VALUE 0x26ECA1 UBYTE_COL_DIRECT_M_S7_S3 0 sts_int_M_S7_S3 0 255 /end CHARACTERISTIC
/begin CHARACTERISTIC Z_MSA_FST_ERSATZ_HAS "Ersatzwert fuer z_msa_fst_has_in (wenn SWI_ = 1)" VALUE 0x26EC67 UBYTE_COL_DIRECT_M_S7_S3 0 st_int_M_S7_S3 0 255 /end CHARACTERISTIC
/begin CHARACTERISTIC Z_MSA_HAS_ERSATZ_HAS "Ersatzwert fuer z_msa_has_portout (bei SWI_ = 1)" VALUE 0x26ECA2 UBYTE_COL_DIRECT_M_S7_S3 0 sts_int_M_S7_S3 0 255 /end CHARACTERISTIC
/begin CHARACTERISTIC Z_MSA_STADA_ERSATZ_HAS "Ersatzwert fuer z_msa_stada_in (wenn SWI_ = 1)" VALUE 0x26EC68 UBYTE_COL_DIRECT_M_S7_S3 0 sts_int_M_S7_S3 0 6 /end CHARACTERISTIC
/begin CHARACTERISTIC Z_MSOLLEM_HAS_ERSATZ_HAS "Ersatzwert fuer z_m_soll_em_has_portout (bei SWI_ = 1)" VALUE 0x26ECA3 UBYTE_COL_DIRECT_M_S7_S3 0 sts_int_M_S7_S3 0 3 /end CHARACTERISTIC
/begin CHARACTERISTIC Z_NLLSOLL_IAE_ERS_HAS "Ersatzwert fuer z_nllsoll_iae_in (wenn SWI_ = 1)" VALUE 0x26EC69 UBYTE_COL_DIRECT_M_S7_S3 0 void_int_M_S7_S3 0 3 /end CHARACTERISTIC
/begin CHARACTERISTIC Z_NLLSOLLMOD_HAS_ERSATZ_HAS "Ersatzwert fuer z_nllsoll_modus_has_portout" VALUE 0x26ECA4 UBYTE_COL_DIRECT_M_S7_S3 0 E_ZNMODUS_M_S7_S3 0 4 /end CHARACTERISTIC
/begin CHARACTERISTIC Z_NMINEMPARKSP_ERS_HAS "Ersatzwert fuer z_n_min_em_parksp_has_in: Anforderung einer EM-Drehzahlanhebung beim Auslegen der Parksperre infolge unzureichender Oelversorgung" VALUE 0x26EC6A UBYTE_COL_DIRECT_M_S7_S3 0 st_int_M_S7_S3 0 1 /end CHARACTERISTIC
/begin CHARACTERISTIC Z_NSOLLEM_HAS_ERSATZ_HAS "Ersatzwert fuer z_n_soll_em_has_portout (bei SWI_ = 1)" VALUE 0x26ECA5 UBYTE_COL_DIRECT_M_S7_S3 0 sts_int_M_S7_S3 0 1 /end CHARACTERISTIC
/begin CHARACTERISTIC Z_NSOLLVM_HAS_ERSATZ_HAS "Ersatzwert fuer z_n_soll_vm_has_portout (bei SWI_ = 1)" VALUE 0x26ECA6 UBYTE_COL_DIRECT_M_S7_S3 0 sts_int_M_S7_S3 0 1 /end CHARACTERISTIC
/begin CHARACTERISTIC Z_OEA_HST_ERSATZ_HAS "Ersatzwert fuer z_oea_hst_in (wenn SWI_ = 1)" VALUE 0x26EC6B UBYTE_COL_DIRECT_M_S7_S3 0 sts_int_M_S7_S3 0 1 /end CHARACTERISTIC
/begin CHARACTERISTIC Z_P_HYS_K0_HAS_ERSATZ_HAS "Ersatzwert fuer z_p_hys_k0_has_portout (bei SWI_ = 1)" VALUE 0x26ECA7 UBYTE_COL_DIRECT_M_S7_S3 0 sts_int_M_S7_S3 0 1 /end CHARACTERISTIC
/begin CHARACTERISTIC Z_SAF_HAS_ERSATZ_HAS "Ersatzwert fuer z_saf_has (bei SWI_ = 1)" VALUE 0x26ECA8 UBYTE_COL_DIRECT_M_S7_S3 0 sts_int_M_S7_S3 0 1 /end CHARACTERISTIC
/begin CHARACTERISTIC Z_SAS_HAS_ERSATZ_HAS "Ersatzwert fuer z_sas_has_portout (bei SWI_ = 1)" VALUE 0x26ECA9 UBYTE_COL_DIRECT_M_S7_S3 0 sts_int_M_S7_S3 0 255 /end CHARACTERISTIC
/begin CHARACTERISTIC Z_SBE_HAS_ERS_HAS "Ersatzwert fuer flag_verbot_schalt_aktiv_has (bei SWI_ = 1)" VALUE 0x26ECAA UBYTE_COL_DIRECT_M_S7_S3 0 sts_int_M_S7_S3 0 1 /end CHARACTERISTIC
/begin CHARACTERISTIC Z_START_MODUS_HAS_ERS_HAS "Ersatzwert fuer z_start_modus_has_portout (bei SWI_ = 1)" VALUE 0x26ECAB UBYTE_COL_DIRECT_M_S7_S3 0 sts_int_M_S7_S3 0 3 /end CHARACTERISTIC
/begin CHARACTERISTIC Z_STSOLLBZHSTMIN_HAS "Minimale Anzahl der Programmdurchlaeufe zur Uebernahme des Soll-Betriebszustands der Hybridstrategie nach einer Aenderung innerhalb der Betriebszustaende 1 bis 8 bei der Einbindung der HST-Einbindung Variante 2" VALUE 0x26EBB4 UBYTE_COL_DIRECT_M_S7_S3 0 sts_int_M_S7_S3 0 100 /end CHARACTERISTIC
/begin CHARACTERISTIC Z_STSPSYSMPS_ERSATZ_HAS "Ersatzwert fuer z_status_psys_mps_portout (bei SWI_ = 1)" VALUE 0x26ECAC UBYTE_COL_DIRECT_M_S7_S3 0 sts_int_M_S7_S3 0 255 /end CHARACTERISTIC
/begin CHARACTERISTIC Z_SVH_HAS_ERSATZ_HAS "Ersatzwert fuer z_svh_has_portout (bei SWI_ = 1)" VALUE 0x26ECAD UBYTE_COL_DIRECT_M_S7_S3 0 sts_int_M_S7_S3 0 255 /end CHARACTERISTIC
/begin CHARACTERISTIC ZIELGANG_EGS_ERSATZ_HAS "Ersatzwert fuer zielgang_egs_in (wenn SWI_ = 1)" VALUE 0x26EC5F SBYTE_COL_DIRECT_M_S7_S3 0 st_int_M_S7_S3 -128 127 /end CHARACTERISTIC
/begin CHARACTERISTIC I_FIX_ERSATZ_NEMMIN_HAS_L2 "(Ueberwachung EM-Stoermoment)" VALUE 0x26E34E UWORD_COL_DIRECT_S1_S7_S3 0 ratio_int_S1_S7_S3 0 5 /end CHARACTERISTIC
/begin CHARACTERISTIC I_FIX_ERSATZ_NEMSOLL_HAS_L2 "Uebersetzungsverhaeltnis zur Verwendung als Ersatzwert bei sehr niedrigen Abtriebsdrehzahlen" VALUE 0x26E38E UWORD_COL_DIRECT_S1_S7_S3 0 ratio_int_S1_S7_S3 0 5 /end CHARACTERISTIC
/begin CHARACTERISTIC KL_MO_NEMSOLL_HAS_L2_Y "Y-Achse: gangabhaengiger Toleranzmomentenoffset, um welches das EM-Istmoment das Fahrerwunschmoment uebersteigen darf" CURVE 0x26E36A SWORD_COL_DIRECT_S1_S7_S3 0 trq_int_S1_S7_S3 -200 500
 /begin AXIS_DESCR COM_AXIS NO_INPUT_QUANTITY ratio_int_S1_S7_S3 9 0 5 AXIS_PTS_REF KL_MO_NEMSOLL_HAS_L2_X /end AXIS_DESCR
/end CHARACTERISTIC
/begin CHARACTERISTIC KL_MS_NEMMIN_HAS_L2_Y "Y: Toleranzmomentenschwelle" CURVE 0x26D22C UWORD_COL_DIRECT_S1_S7_S3 0 trq_int_S1_S7_S3 0 500
 /begin AXIS_DESCR COM_AXIS NO_INPUT_QUANTITY ratio_int_S1_S7_S3 10 0 5 AXIS_PTS_REF KL_MS_NEMMIN_HAS_L2_X /end AXIS_DESCR
/end CHARACTERISTIC
/begin CHARACTERISTIC M_MOTSOLL_ERSATZ_HAS_L2 "(Ueberwachung EM-Solldrehzahl Variante 2)" VALUE 0x26E390 SWORD_COL_DIRECT_S1_S7_S3 0 trq_int_S1_S7_S3 -200 500 /end CHARACTERISTIC
/begin CHARACTERISTIC MS_MIN_NEMMIN_HAS_L2 "Mindestmomentenschwelle, ab der eine Ueberwachung der Momente erfolgt" VALUE 0x26E350 SWORD_COL_DIRECT_S1_S7_S3 0 trq_int_S1_S7_S3 -100 100 /end CHARACTERISTIC
/begin CHARACTERISTIC MS_MOTMAX_HAS_L2 "maximale Momentenschwelle, unterhalb der ein Fehler erkannt wird" VALUE 0x26E34A SWORD_COL_DIRECT_S1_S7_S3 0 trq_int_S1_S7_S3 -200 200 /end CHARACTERISTIC
/begin CHARACTERISTIC NDS_GETR_NEMSOLL_HAS_L2 "Differenzdrehzahlschwelle, ab der das Getriebe als schlupfend angesehen wird" VALUE 0x26E392 SWORD_COL_DIRECT_S1_S7_S3 0 n_int_S1_S7_S3 0 32767 /end CHARACTERISTIC
/begin CHARACTERISTIC NS_AB_MIN_NEMSOLL_HAS_L2 "Drehzahlschwelle, unterhalb welcher die Abtriebsdrehzahl zu Null angenommen wird" VALUE 0x26E394 UWORD_COL_DIRECT_S1_S7_S3 0 n_int_S1_S7_S3 0 65535 /end CHARACTERISTIC
/begin CHARACTERISTIC NS_LIM_NEMMIN_HAS_L2 "Begrenzungsdrehzahl" VALUE 0x26E352 UWORD_COL_DIRECT_S1_S7_S3 0 n_int_S1_S7_S3 0 2500 /end CHARACTERISTIC
/begin CHARACTERISTIC NS_LIM_NEMSOLL_HAS_L2 "Drehzahlbegrenzung" VALUE 0x26E396 UWORD_COL_DIRECT_S1_S7_S3 0 n_int_S1_S7_S3 0 10000 /end CHARACTERISTIC
/begin CHARACTERISTIC NS_NEMMIN_HAS_L2 "Toleranzdrehzahlschwelle" VALUE 0x26E354 UWORD_COL_DIRECT_S1_S7_S3 0 n_int_S1_S7_S3 0 1000 /end CHARACTERISTIC
/begin CHARACTERISTIC SWI_EXTDEAK_NEMMIN_HAS_L2 "Schalter, ob eine externe (OEM) Deaktivierung der Momentenplausibilisierung erlaubt ist" VALUE 0x26F1E7 UBYTE_COL_DIRECT_S1_S7_S3 0 swi_int_b_S1_S7_S3 0 1 /end CHARACTERISTIC
/begin CHARACTERISTIC SWI_MOTMAX_HAS_L2 "Schalter zur De-/Aktivierung der Funktion" VALUE 0x26F1E6 UBYTE_COL_DIRECT_S1_S7_S3 0 swi_int_b_S1_S7_S3 0 1 /end CHARACTERISTIC
/begin CHARACTERISTIC SWI_MOTVERLUST_NEMMIN_HAS_L2 "Schalter zur Beruecksichtigung des Motorverlustmoments" VALUE 0x26F1E8 UBYTE_COL_DIRECT_S1_S7_S3 0 swi_int_b_S1_S7_S3 0 1 /end CHARACTERISTIC
/begin CHARACTERISTIC SWI_NEMMIN_HAS_L2 "Schalterzu De-/Aktivierung der Funktion" VALUE 0x26F1E9 UBYTE_COL_DIRECT_S1_S7_S3 0 swi_int_b_S1_S7_S3 0 1 /end CHARACTERISTIC
/begin CHARACTERISTIC SWI_NEMSOLL_HAS_L2 "Schalter zur De-/Aktivierung der Funktion" VALUE 0x26F1EA UBYTE_COL_DIRECT_S1_S7_S3 0 swi_int_b_S1_S7_S3 0 1 /end CHARACTERISTIC
/begin CHARACTERISTIC SWI_POS_NEMSOLL_HAS_L2 "Schalter, ob Positionsabfrage != {N,P}" VALUE 0x26F1EB UBYTE_COL_DIRECT_S1_S7_S3 0 swi_int_b_S1_S7_S3 0 1 /end CHARACTERISTIC
/begin CHARACTERISTIC SWI_ST_MSOLL_Z_ERR_NEMSOLL_HAS_L2 "(Ueberwachung EM-Solldrehzahl Variante 2)Schalter zur Aktivierung des Fehlerereignisses" VALUE 0x26F1EC UBYTE_COL_DIRECT_S1_S7_S3 0 swi_int_b_S1_S7_S3 0 1 /end CHARACTERISTIC
/begin CHARACTERISTIC SWI_VAR_NEMSOLL_HAS_L2 "Schalter zur Auswahl der Ueberwachungsvariante" VALUE 0x26F1ED UBYTE_COL_DIRECT_S1_S7_S3 0 swi_int_b_S1_S7_S3 1 2 /end CHARACTERISTIC
/begin CHARACTERISTIC T_MOTMAX_HAS_L2 "max. Wert des Fehlerfilterungstimer" VALUE 0x26E34C UWORD_COL_DIRECT_S1_S7_S3 0 t_int_S1_S7_S3 0 2.5 /end CHARACTERISTIC
/begin CHARACTERISTIC T_NEMMIN_HAS_L2 "Fehlerfilterungstimer" VALUE 0x26E356 UWORD_COL_DIRECT_S1_S7_S3 0 t_int_S1_S7_S3 0 2.5 /end CHARACTERISTIC
/begin CHARACTERISTIC T_NEMSOLL_HAS_L2 "max. Wert des Fehlerfilterungstimer" VALUE 0x26E398 UWORD_COL_DIRECT_S1_S7_S3 0 t_int_S1_S7_S3 0 2.5 /end CHARACTERISTIC
/begin CHARACTERISTIC TAB_IG_NEMSOLL_HAS_L2 "vorzeichenlose Uebersetzungsverhaeltnisse der einzelnen Gangstufen in aufsteigender Reihenfolge" VAL_BLK 0x26E37C UWORD_COL_DIRECT_S1_S7_S3 0 ratio_int_S1_S7_S3 0 5 NUMBER 9 /end CHARACTERISTIC
/begin AXIS_PTS KF_STSOLLBZHASHST_ZUL_HAS_X "X-Achse: st_ist_bz_has_hst_stg" 0x26EB9E st_ist_bz_has_stg UBYTE_X_INCR_DIRECT_M_S7_S3 0 void_int_M_S7_S3 11 0 15 /end AXIS_PTS
/begin AXIS_PTS KF_STSOLLBZHASHST_ZUL_HAS_Y "Y-Achse: st_soll_bz_has_hst_bas" 0x26EBA9 NO_INPUT_QUANTITY UBYTE_X_INCR_DIRECT_M_S7_S3 0 void_int_M_S7_S3 11 0 15 /end AXIS_PTS
/begin AXIS_PTS KL_ABLAUFVARIANTE_HAS_HST_IN_X "Anpassung der Codierung der Ablaufvariante an Hybridstrategie" 0x26EBB5 z_ablaufvariante_has_hst_portin UBYTE_X_INCR_DIRECT_M_S7_S3 0 sts_int_M_S7_S3 17 0 99 /end AXIS_PTS
/begin AXIS_PTS KL_MSMOT_KPS_HAS_X "Momentschwelle, Tab = f(istgang_egs_in) zur Best. z_k0schlupf_mmotiae_kps" 0x263ECC NO_INPUT_QUANTITY FLOAT32_IEEE_X_INCR_DIRECT_M_S7_S3 0 sts_fl_M_S7_S3 10 -1 8 /end AXIS_PTS
/begin AXIS_PTS KL_MO_NEMSOLL_HAS_L2_X "X-Achse: gangabhaengiger Toleranzmomentenoffset, um welches das EM-Istmoment das Fahrerwunschmoment uebersteigen darf" 0x26E358 NO_INPUT_QUANTITY UWORD_X_INCR_DIRECT_S1_S7_S3 0 ratio_int_S1_S7_S3 9 0 5 /end AXIS_PTS
/begin AXIS_PTS KL_MS_NEMMIN_HAS_L2_X "X: i_dyn_nemmin_has_l2" 0x26D218 NO_INPUT_QUANTITY UWORD_X_INCR_DIRECT_S1_S7_S3 0 ratio_int_S1_S7_S3 10 0 5 /end AXIS_PTS
/begin MEASUREMENT abstellpos_vm_in "Abstellposition VM vor naechstem ZOT" UWORD void_int_c_M_S7_S3 1 100 0 360 ECU_ADDRESS 0xFFF86784 /end MEASUREMENT
/begin MEASUREMENT abstellpos_vm_portin "Abstellposition VM vor naechstem ZOT" UBYTE void_int_M_S7_S3 1 100 0 180 ECU_ADDRESS 0xFFF86C86 /end MEASUREMENT
/begin MEASUREMENT abstellpos_vm_status_in "Status Abstellposition VM" UBYTE void_int_M_S7_S3 1 100 0 2 ECU_ADDRESS 0xFFF86CC5 /end MEASUREMENT
/begin MEASUREMENT abstellpos_vm_status_portin "Status Abstellposition VM" UBYTE void_int_M_S7_S3 1 100 0 2 ECU_ADDRESS 0xFFF86C87 /end MEASUREMENT
/begin MEASUREMENT analyse_has_byp "" UBYTE void_int_M_S7_S3 1 100 0 255 ECU_ADDRESS 0xFFF86C12 /end MEASUREMENT
/begin MEASUREMENT analyse_has_sbe "Bestimmung der Monitoring-Variante fuer die MVG VM-Start " UBYTE void_int_M_S7_S3 1 100 0 8 ECU_ADDRESS 0xFFF86C73 /end MEASUREMENT
/begin MEASUREMENT bErrorHybrid "Anforderung der Strategieanpassung, die Zustandssteuerung (OML) im Error-Modus zu betreiben" UBYTE sts_int_M_S7_S3 1 100 0 1 ECU_ADDRESS 0xFFF86C80 /end MEASUREMENT
/begin MEASUREMENT bExceptionHybrid "Anforderung der Strategieanpassung, die Zustandssteuerung (OML) im Exception-Modus zu betreiben" UBYTE sts_int_M_S7_S3 1 100 0 1 ECU_ADDRESS 0xFFF86C81 /end MEASUREMENT
/begin MEASUREMENT bremspedal_in "Signal Bremsschalter" UBYTE E_BREMSPED_M_S7_S3 1 100 0 1 ECU_ADDRESS 0xFFF86C9B /end MEASUREMENT
/begin MEASUREMENT bremspedal_portin "Signal Bremsschalter" UBYTE E_BREMSPED_M_S7_S3 1 100 0 1 ECU_ADDRESS 0xFFF8691B /end MEASUREMENT
/begin MEASUREMENT byp_vnr_has_byp "" UBYTE void_int_M_S7_S3 1 100 0 255 ECU_ADDRESS 0xFFF86C13 /end MEASUREMENT
/begin MEASUREMENT bypass_has_aktiv "" UBYTE void_int_M_S7_S3 1 100 0 255 ECU_ADDRESS 0xFFF86C14 /end MEASUREMENT
/begin MEASUREMENT c_getriebe_egs_in "" FLOAT32_IEEE c_int_M_S7_S3 1 100 -40 215 ECU_ADDRESS 0xFFF86214 /end MEASUREMENT
/begin MEASUREMENT c_getriebe_egs_portin "" UBYTE void_int_M_S7_S3 1 100 0 255 ECU_ADDRESS 0xFFF8691C /end MEASUREMENT
/begin MEASUREMENT c_umgebung_in "Aussentemperatur gefiltert" FLOAT32_IEEE c_fl_M_S7_S3 1 100 -40 85 ECU_ADDRESS 0xFFF86284 /end MEASUREMENT
/begin MEASUREMENT c_umgebung_portin "Aussentemperatur gefiltert" UBYTE void_int_M_S7_S3 1 100 0 250 ECU_ADDRESS 0xFFF86C88 /end MEASUREMENT
/begin MEASUREMENT c_vm_in "" FLOAT32_IEEE c_fl_M_S7_S3 1 100 -3.40282E+038 3.40282E+038 ECU_ADDRESS 0xFFF86288 /end MEASUREMENT
/begin MEASUREMENT c_vm_portin "" UBYTE void_int_M_S7_S3 1 100 0 255 ECU_ADDRESS 0xFFF86C89 /end MEASUREMENT
/begin MEASUREMENT drehrichtung_nab_in "Drehrichtung Abtriebsdrehzahl" UBYTE E_DREHRICH_M_S7_S3 1 100 0 2 ECU_ADDRESS 0xFFF86C9C /end MEASUREMENT
/begin MEASUREMENT drehrichtung_nab_portin "Drehrichtung Abtriebsdrehzahl" UBYTE E_DREHRICH_M_S7_S3 1 100 0 2 ECU_ADDRESS 0xFFF8691D /end MEASUREMENT
/begin MEASUREMENT drehrichtung_nem_in "Drehrichtung der E-Maschine" UBYTE E_DREHRICH_M_S7_S3 1 100 0 2 ECU_ADDRESS 0xFFF86C9D /end MEASUREMENT
/begin MEASUREMENT drehrichtung_nem_portin "Drehrichtung der E-Maschine" UBYTE E_DREHRICH_M_S7_S3 1 100 0 2 ECU_ADDRESS 0xFFF8691E /end MEASUREMENT
/begin MEASUREMENT err_n_soll_em_has_komp_portout "" UBYTE void_int_M_S7_S3 1 100 0 255 ECU_ADDRESS 0xFFF8694B /end MEASUREMENT
/begin MEASUREMENT err_n_soll_vm_has_komp_portout "" UBYTE void_int_M_S7_S3 1 100 0 255 ECU_ADDRESS 0xFFF8694D /end MEASUREMENT
/begin MEASUREMENT fpw_in "Prozent Fahrpedalstellung" UBYTE rel_int_M_S7_S3 1 100 0 255 ECU_ADDRESS 0xFFF86C9E /end MEASUREMENT
/begin MEASUREMENT fpw_portin "Prozent Fahrpedalstellung" UBYTE void_int_M_S7_S3 1 100 0 100 ECU_ADDRESS 0xFFF8691F /end MEASUREMENT
/begin MEASUREMENT gangwechsel_egs_in "Flag waehrend laufender Schaltung, bei synchron verlassen bis synchron erreicht" UBYTE void_int_M_S7_S3 1 100 0 1 ECU_ADDRESS 0xFFF86C9F /end MEASUREMENT
/begin MEASUREMENT gangwechsel_egs_portin "Flag waehrend laufender Schaltung, bei synchron verlassen bis synchron erreicht" UBYTE void_int_M_S7_S3 1 100 0 1 ECU_ADDRESS 0xFFF86920 /end MEASUREMENT
/begin MEASUREMENT i_gang_lev2_egs_in "Uebergabe der aktuellen Ganguebersetzung i_gang nach ASILB ermittelt aus den Kupplungsstroemen" FLOAT32_IEEE void_fl_M_S7_S3 1 100 -3.40282E+038 3.40282E+038 ECU_ADDRESS 0xFFF86218 /end MEASUREMENT
/begin MEASUREMENT i_gang_lev2_egs_portin "Uebergabe der aktuellen Ganguebersetzung i_gang nach ASILB ermittelt aus den Kupplungsstroemen" SWORD void_int_c_M_S7_S3 1 100 -32768 32767 ECU_ADDRESS 0xFFF86566 /end MEASUREMENT
/begin MEASUREMENT i_istgang_egs "Uebersetzung des aktuellen Gangs" FLOAT32_IEEE ratio_fl_M_S7_S3 1 100 0 8 ECU_ADDRESS 0xFFF861B4 /end MEASUREMENT
/begin MEASUREMENT i_zielgang_egs "Uebersetzung des Zielgangs" FLOAT32_IEEE ratio_fl_M_S7_S3 1 100 0 8 ECU_ADDRESS 0xFFF861B8 /end MEASUREMENT
/begin MEASUREMENT iep_soll_has_byp "" UBYTE st_int_M_S7_S3 1 100 0 255 ECU_ADDRESS 0xFFF86C15 /end MEASUREMENT
/begin MEASUREMENT istgang_egs_in "" SBYTE void_int_M_S7_S3 1 100 -128 127 ECU_ADDRESS 0xFFF86CA0 /end MEASUREMENT
/begin MEASUREMENT istgang_egs_portin "" SBYTE void_int_M_S7_S3 1 100 -128 127 ECU_ADDRESS 0xFFF86921 /end MEASUREMENT
/begin MEASUREMENT kolbenpos_k0_in "" FLOAT32_IEEE sts_fl_M_S7_S3 1 100 -3.40282E+038 3.40282E+038 ECU_ADDRESS 0xFFF8621C /end MEASUREMENT
/begin MEASUREMENT kolbenpos_k0_portin "" UWORD void_int_c_M_S7_S3 1 100 0 65535 ECU_ADDRESS 0xFFF86568 /end MEASUREMENT
/begin MEASUREMENT m_em_in "" FLOAT32_IEEE trq_fl_a_M_S7_S3 1 100 -1024 1024 ECU_ADDRESS 0xFFF86220 /end MEASUREMENT
/begin MEASUREMENT m_em_in_azg "AZG-Signal fuer m_em_in" SWORD trq_int_M_S7_S3 1 100 -32767 32767 ECU_ADDRESS 0xFFF984B8 /end MEASUREMENT
/begin MEASUREMENT m_em_portin "" SWORD trq_int_M_S7_S3 1 100 -32768 32767 ECU_ADDRESS 0xFFF8656A /end MEASUREMENT
/begin MEASUREMENT m_iae_in "" FLOAT32_IEEE trq_fl_a_M_S7_S3 1 100 -32768 32767 ECU_ADDRESS 0xFFF86224 /end MEASUREMENT
/begin MEASUREMENT m_iae_portin "" SWORD trq_int_M_S7_S3 1 100 -32768 32767 ECU_ADDRESS 0xFFF8656C /end MEASUREMENT
/begin MEASUREMENT m_k0_has_byp "" SWORD trq_fl_M_S7_S3 1 100 -32768 32767 ECU_ADDRESS 0xFFF86752 /end MEASUREMENT
/begin MEASUREMENT m_k0_has_sbe "K0 Istmoment der Funktion Bestimmung des K0 Istmoments der HAS" FLOAT32_IEEE trq_fl_a_M_S7_S3 1 100 -1000 1000 ECU_ADDRESS 0xFFF861EC /end MEASUREMENT
/begin MEASUREMENT m_k0_in "" FLOAT32_IEEE trq_fl_a_M_S7_S3 1 100 -32768 32767 ECU_ADDRESS 0xFFF86228 /end MEASUREMENT
/begin MEASUREMENT m_k0_in_azg "AZG-Signal fuer m_k0_in" SWORD trq_int_M_S7_S3 1 100 -32767 32767 ECU_ADDRESS 0xFFF984BA /end MEASUREMENT
/begin MEASUREMENT m_k0_mber_has_byp "" SWORD trq_fl_M_S7_S3 1 100 -32768 32767 ECU_ADDRESS 0xFFF86754 /end MEASUREMENT
/begin MEASUREMENT m_k0_mber_has_sbe "K0-Moment der HAS zur Motormomentbegrenzung in der SAB" FLOAT32_IEEE trq_fl_a_M_S7_S3 1 100 -3.40282E+038 3.40282E+038 ECU_ADDRESS 0xFFF861F0 /end MEASUREMENT
/begin MEASUREMENT m_k0_mod_has_fkt "" FLOAT32_IEEE trq_fl_a_M_S7_S3 1 100 -1200 1200 ECU_ADDRESS 0xFFF86184 /end MEASUREMENT
/begin MEASUREMENT m_k0_portin "" SWORD trq_int_M_S7_S3 1 100 -32768 32767 ECU_ADDRESS 0xFFF8656E /end MEASUREMENT
/begin MEASUREMENT m_max_dyn_em_in "" FLOAT32_IEEE trq_fl_a_M_S7_S3 1 100 -3.40282E+038 3.40282E+038 ECU_ADDRESS 0xFFF8622C /end MEASUREMENT
/begin MEASUREMENT m_max_dyn_em_in_azg "AZG-Signal fuer m_max_dyn_em_in" SWORD trq_int_M_S7_S3 1 100 -32767 32767 ECU_ADDRESS 0xFFF984BC /end MEASUREMENT
/begin MEASUREMENT m_max_dyn_em_portin "" SWORD trq_int_M_S7_S3 1 100 -32768 32767 ECU_ADDRESS 0xFFF86570 /end MEASUREMENT
/begin MEASUREMENT m_max_em_has_byp "" SWORD trq_fl_M_S7_S3 1 100 -32768 32767 ECU_ADDRESS 0xFFF86756 /end MEASUREMENT
/begin MEASUREMENT m_max_em_has_fkt "" FLOAT32_IEEE trq_fl_a_M_S7_S3 1 100 -1200 1200 ECU_ADDRESS 0xFFF86188 /end MEASUREMENT
/begin MEASUREMENT m_max_iae_has_byp "" SWORD trq_fl_M_S7_S3 1 100 -32768 32767 ECU_ADDRESS 0xFFF86758 /end MEASUREMENT
/begin MEASUREMENT m_max_iae_has_fkt "" FLOAT32_IEEE trq_fl_a_M_S7_S3 1 100 -1200 1200 ECU_ADDRESS 0xFFF8618C /end MEASUREMENT
/begin MEASUREMENT m_min_dyn_em_in "" FLOAT32_IEEE trq_fl_a_M_S7_S3 1 100 -3.40282E+038 3.40282E+038 ECU_ADDRESS 0xFFF86230 /end MEASUREMENT
/begin MEASUREMENT m_min_dyn_em_portin "" SWORD trq_int_M_S7_S3 1 100 -32768 32767 ECU_ADDRESS 0xFFF86572 /end MEASUREMENT
/begin MEASUREMENT m_min_em_has_byp "" SWORD trq_fl_M_S7_S3 1 100 -32768 32767 ECU_ADDRESS 0xFFF8675A /end MEASUREMENT
/begin MEASUREMENT m_min_em_has_fkt "" FLOAT32_IEEE trq_fl_a_M_S7_S3 1 100 -1200 1200 ECU_ADDRESS 0xFFF86190 /end MEASUREMENT
/begin MEASUREMENT m_min_vm_in "" FLOAT32_IEEE trq_fl_a_M_S7_S3 1 100 -3.40282E+038 3.40282E+038 ECU_ADDRESS 0xFFF8628C /end MEASUREMENT
/begin MEASUREMENT m_min_vm_portin "" UWORD trq_int_M_S7_S3 1 100 0 65535 ECU_ADDRESS 0xFFF86776 /end MEASUREMENT
/begin MEASUREMENT m_mot_in "" FLOAT32_IEEE trq_fl_a_M_S7_S3 1 100 -1024 1024 ECU_ADDRESS 0xFFF86234 /end MEASUREMENT
/begin MEASUREMENT m_mot_portin "" SWORD trq_int_M_S7_S3 1 100 -1024 1024 ECU_ADDRESS 0xFFF86574 /end MEASUREMENT
/begin MEASUREMENT m_motmax_has_byp "" SWORD trq_fl_M_S7_S3 1 100 -32768 32767 ECU_ADDRESS 0xFFF8675C /end MEASUREMENT
/begin MEASUREMENT m_motmax_has_komp_portout "Komplement zu gefuehrtem Getriebeschutz " SWORD trq_int_M_S7_S3 1 100 -32768 32767 ECU_ADDRESS 0xFFF8659A /end MEASUREMENT
/begin MEASUREMENT m_motmax_has_sbe "Maximal zulaessiges Motormoment des Gefuehrten Getriebeschutz der HAS" FLOAT32_IEEE trq_fl_a_M_S7_S3 1 100 -5000 5000 ECU_ADDRESS 0xFFF861F4 /end MEASUREMENT
/begin MEASUREMENT m_soll_em_has_byp "" SWORD trq_fl_M_S7_S3 1 100 -32768 32767 ECU_ADDRESS 0xFFF8675E /end MEASUREMENT
/begin MEASUREMENT m_soll_em_has_fkt "" FLOAT32_IEEE trq_fl_a_M_S7_S3 1 100 -1200 1200 ECU_ADDRESS 0xFFF86194 /end MEASUREMENT
/begin MEASUREMENT m_soll_em_has_komp_portout "" SWORD trq_int_M_S7_S3 1 100 -32768 32767 ECU_ADDRESS 0xFFF8659E /end MEASUREMENT
/begin MEASUREMENT m_soll_em_hst_in "" FLOAT32_IEEE trq_fl_a_M_S7_S3 1 100 -32768 32767 ECU_ADDRESS 0xFFF86238 /end MEASUREMENT
/begin MEASUREMENT m_soll_em_hst_portin "" SWORD trq_int_M_S7_S3 1 100 -32768 32767 ECU_ADDRESS 0xFFF86576 /end MEASUREMENT
/begin MEASUREMENT m_soll_em_hst_verz "Verzoegertes EM Sollmoment der HST fuer die Berechnung des Fahrerwunschmoments der HST" FLOAT32_IEEE trq_fl_a_M_S7_S3 1 100 -3.40282E+038 3.40282E+038 ECU_ADDRESS 0xFFF982E8 /end MEASUREMENT
/begin MEASUREMENT m_soll_k0_has_byp "" SWORD trq_fl_M_S7_S3 1 100 -32768 32767 ECU_ADDRESS 0xFFF86760 /end MEASUREMENT
/begin MEASUREMENT m_soll_k0_has_fkt "" FLOAT32_IEEE trq_fl_a_M_S7_S3 1 100 -1200 1200 ECU_ADDRESS 0xFFF86198 /end MEASUREMENT
/begin MEASUREMENT m_soll_k0_has_sbe "K0 Sollmoment der Bestimmung des K0 Sollmoments der HAS" FLOAT32_IEEE trq_fl_a_M_S7_S3 1 100 -1000 1000 ECU_ADDRESS 0xFFF861F8 /end MEASUREMENT
/begin MEASUREMENT m_soll_res_em_bas_sbe "Basis-Reservemoment fuer den VM-Start" FLOAT32_IEEE trq_fl_a_M_S7_S3 1 100 -3.40282E+038 3.40282E+038 ECU_ADDRESS 0xFFF861FC /end MEASUREMENT
/begin MEASUREMENT m_soll_res_em_has_azg "AZG-Signal fuer m_soll_res_em_has" SWORD trq_int_M_S7_S3 1 100 -32767 32767 ECU_ADDRESS 0xFFF984C4 /end MEASUREMENT
/begin MEASUREMENT m_soll_res_em_has_byp "" SWORD trq_fl_M_S7_S3 1 100 -32768 32767 ECU_ADDRESS 0xFFF86762 /end MEASUREMENT
/begin MEASUREMENT m_soll_res_em_has_fkt "" FLOAT32_IEEE trq_fl_a_M_S7_S3 1 100 -1200 1200 ECU_ADDRESS 0xFFF8619C /end MEASUREMENT
/begin MEASUREMENT m_soll_res_em_has_sbe "Reservemoment fuer den VM-Start" FLOAT32_IEEE trq_fl_a_M_S7_S3 1 100 -3.40282E+038 3.40282E+038 ECU_ADDRESS 0xFFF86200 /end MEASUREMENT
/begin MEASUREMENT m_soll_vm_hst_in "" FLOAT32_IEEE trq_fl_a_M_S7_S3 1 100 -32768 32767 ECU_ADDRESS 0xFFF8623C /end MEASUREMENT
/begin MEASUREMENT m_soll_vm_hst_portin "" SWORD trq_int_M_S7_S3 1 100 -32768 32767 ECU_ADDRESS 0xFFF86578 /end MEASUREMENT
/begin MEASUREMENT m_soll_vm_hst_verz "Verzoegertes VM Sollmoment der HST fuer die Berechnung des Fahrerwunschmoments der HST" FLOAT32_IEEE trq_fl_a_M_S7_S3 1 100 -3.40282E+038 3.40282E+038 ECU_ADDRESS 0xFFF982EC /end MEASUREMENT
/begin MEASUREMENT m_soll_vm_l_hst_in "" FLOAT32_IEEE trq_fl_a_M_S7_S3 1 100 -3.40282E+038 3.40282E+038 ECU_ADDRESS 0xFFF86290 /end MEASUREMENT
/begin MEASUREMENT m_soll_vm_l_hst_portin "Sollfuellungsmoment V-Motor (Luftpfad) der Hybridstrategie" SWORD trq_int_M_S7_S3 1 100 -32767 32767 ECU_ADDRESS 0xFFF86778 /end MEASUREMENT
/begin MEASUREMENT m_vm_in "" FLOAT32_IEEE trq_fl_a_M_S7_S3 1 100 -1024 1023.5 ECU_ADDRESS 0xFFF86240 /end MEASUREMENT
/begin MEASUREMENT m_vm_in_azg "AZG-Signal fuer m_vm_in" SWORD trq_int_M_S7_S3 1 100 -32767 32767 ECU_ADDRESS 0xFFF984BE /end MEASUREMENT
/begin MEASUREMENT m_vm_portin "" SWORD trq_int_M_S7_S3 1 100 -32768 32767 ECU_ADDRESS 0xFFF8657A /end MEASUREMENT
/begin MEASUREMENT m_vm_start_in "" FLOAT32_IEEE trq_fl_a_M_S7_S3 1 100 -1024 1023.5 ECU_ADDRESS 0xFFF86244 /end MEASUREMENT
/begin MEASUREMENT m_vm_start_portin "" SWORD trq_int_M_S7_S3 1 100 -32768 32767 ECU_ADDRESS 0xFFF8657C /end MEASUREMENT
/begin MEASUREMENT m_wunsch_fpw_hst_fil "Gefiltertes Wunschmoment" FLOAT32_IEEE trqg_fl_k_M_S7_S3 1 100 -2000 2000 ECU_ADDRESS 0xFFF861BC /end MEASUREMENT
/begin MEASUREMENT m_wunsch_fpw_hst_in "" FLOAT32_IEEE trq_fl_a_M_S7_S3 1 100 -3.40282E+038 3.40282E+038 ECU_ADDRESS 0xFFF86294 /end MEASUREMENT
/begin MEASUREMENT m_wunsch_fpw_hst_portin "gefiltertes Motorsollmoment inklusive aller Momenteneingriffe exkl. Getriebe-Me" SWORD trq_int_M_S7_S3 1 100 -32768 32767 ECU_ADDRESS 0xFFF8677A /end MEASUREMENT
/begin MEASUREMENT m_wunsch_fpw_in "" FLOAT32_IEEE trq_fl_a_M_S7_S3 1 100 -32768 32767 ECU_ADDRESS 0xFFF86248 /end MEASUREMENT
/begin MEASUREMENT m_wunsch_fpw_portin "" SWORD trq_int_M_S7_S3 1 100 -32768 32767 ECU_ADDRESS 0xFFF8657E /end MEASUREMENT
/begin MEASUREMENT m_ziel_k0_hst_in "Target torque of K0 sent by ECU" FLOAT32_IEEE trq_fl_a_M_S7_S3 1 100 -1000 2000 ECU_ADDRESS 0xFFF8624C /end MEASUREMENT
/begin MEASUREMENT m_ziel_k0_hst_portin "Target torque of K0 sent by ECU" SWORD trq_int_M_S7_S3 1 100 -1000 2000 ECU_ADDRESS 0xFFF8677C /end MEASUREMENT
/begin MEASUREMENT mg_mot_in "Gradient des Getriebeeingangsmoment" FLOAT32_IEEE trqg_fl_k_M_S7_S3 1 100 -2000 2000 ECU_ADDRESS 0xFFF861C0 /end MEASUREMENT
/begin MEASUREMENT mg_soll_k0_has_fkt "" FLOAT32_IEEE trqg_fl_k_M_S7_S3 1 100 -3000 3000 ECU_ADDRESS 0xFFF861A0 /end MEASUREMENT
/begin MEASUREMENT mg_soll_k0_neg_has_byp "" SWORD trqg_fl_M_S7_S3 1 100 -32768 32767 ECU_ADDRESS 0xFFF86764 /end MEASUREMENT
/begin MEASUREMENT mg_soll_k0_pos_has_byp "" SWORD trqg_fl_M_S7_S3 1 100 -32768 32767 ECU_ADDRESS 0xFFF86766 /end MEASUREMENT
/begin MEASUREMENT mg_wunsch_fpw_hst_in "Gradient des gefilterten oder koordinierten Fahrerwunschmoments aus Fahrpedalinterpretation" FLOAT32_IEEE trqg_fl_k_M_S7_S3 1 100 -2000 2000 ECU_ADDRESS 0xFFF861C4 /end MEASUREMENT
/begin MEASUREMENT mg_wunsch_fpw_in "Gradient des Fahrerwunschmoments aus Fahrpedalinterpretation" FLOAT32_IEEE trqg_fl_k_M_S7_S3 1 100 -2000 2000 ECU_ADDRESS 0xFFF861C8 /end MEASUREMENT
/begin MEASUREMENT mo_mod_em_hst_has_byp "" SWORD trq_fl_M_S7_S3 1 100 -32768 32767 ECU_ADDRESS 0xFFF86768 /end MEASUREMENT
/begin MEASUREMENT modus_e_fahren_hst_in "Electric driving mode concerning state of charging mode of high voltage battery" UBYTE E_MODUSEFAH_M_S7_S3 1 100 0 1 ECU_ADDRESS 0xFFF86CC6 /end MEASUREMENT
/begin MEASUREMENT modus_e_fahren_hst_portin "Electric driving mode concerning state of charging mode of high voltage battery" UBYTE E_MODUSEFAH_M_S7_S3 1 100 0 1 ECU_ADDRESS 0xFFF86C8A /end MEASUREMENT
/begin MEASUREMENT n_ab_egs_in "" FLOAT32_IEEE n_fl_M_S7_S3 1 100 0 65535 ECU_ADDRESS 0xFFF86250 /end MEASUREMENT
/begin MEASUREMENT n_ab_egs_portin "" UWORD n_int_M_S7_S3 1 100 0 65535 ECU_ADDRESS 0xFFF86580 /end MEASUREMENT
/begin MEASUREMENT n_em_in "" FLOAT32_IEEE n_fl_M_S7_S3 1 100 -3.40282E+038 3.40282E+038 ECU_ADDRESS 0xFFF86254 /end MEASUREMENT
/begin MEASUREMENT n_em_in_azg "AZG-Signal fuer n_em_in" UWORD n_int_M_S7_S3 1 100 0 65535 ECU_ADDRESS 0xFFF984C0 /end MEASUREMENT
/begin MEASUREMENT n_em_portin "" UWORD n_int_M_S7_S3 1 100 0 65535 ECU_ADDRESS 0xFFF86582 /end MEASUREMENT
/begin MEASUREMENT n_min_em_has_sbe "Minimale EM Drehzahl der Leerlaufsimulation der HAS (LLS)" FLOAT32_IEEE n_fl_M_S7_S3 1 100 -32767 32767 ECU_ADDRESS 0xFFF86204 /end MEASUREMENT
/begin MEASUREMENT n_min_em_has_sbe_has_byp "" SWORD n_int_M_S7_S3 1 100 -32768 32767 ECU_ADDRESS 0xFFF8676A /end MEASUREMENT
/begin MEASUREMENT n_min_em_psys_lp3_has_sbe "Mindestdrehzahl der EM zur Sicherstellung des Leistungspunkt 3 der Bestimmung des Status Systemdruck der HAS" FLOAT32_IEEE n_fl_M_S7_S3 1 100 0 10000 ECU_ADDRESS 0xFFF861CC /end MEASUREMENT
/begin MEASUREMENT n_mot_idle_tar_has_komp_portout "" UWORD n_int_M_S7_S3 1 100 0 65535 ECU_ADDRESS 0xFFF865AA /end MEASUREMENT
/begin MEASUREMENT n_mot_llsoll_has_komp_portout "" UBYTE n_int_26_M_S7_S3 1 100 0 255 ECU_ADDRESS 0xFFF86950 /end MEASUREMENT
/begin MEASUREMENT n_mot_soll_iae_in "" FLOAT32_IEEE n_fl_M_S7_S3 1 100 -3.40282E+038 3.40282E+038 ECU_ADDRESS 0xFFF86258 /end MEASUREMENT
/begin MEASUREMENT n_mot_soll_iae_portin "Soll-Anfahrdrehzahl der IAE" UWORD n_int_M_S7_S3 1 100 0 65535 ECU_ADDRESS 0xFFF86584 /end MEASUREMENT
/begin MEASUREMENT n_sec_iae "Sekundaere IAE-Drehzahl" FLOAT32_IEEE n_fl_M_S7_S3 1 100 -10000 10000 ECU_ADDRESS 0xFFF861D0 /end MEASUREMENT
/begin MEASUREMENT n_soll_em_has_byp "" SWORD n_int_M_S7_S3 1 100 -32768 32767 ECU_ADDRESS 0xFFF8676C /end MEASUREMENT
/begin MEASUREMENT n_soll_em_has_fkt "" FLOAT32_IEEE n_fl_M_S7_S3 1 100 0 8000 ECU_ADDRESS 0xFFF861A4 /end MEASUREMENT
/begin MEASUREMENT n_soll_em_has_komp_portout "" UWORD n_int_M_S7_S3 1 100 0 65535 ECU_ADDRESS 0xFFF865AE /end MEASUREMENT
/begin MEASUREMENT n_soll_em_hst_in "" FLOAT32_IEEE n_fl_M_S7_S3 1 100 -3.40282E+038 3.40282E+038 ECU_ADDRESS 0xFFF86298 /end MEASUREMENT
/begin MEASUREMENT n_soll_em_hst_portin "" UWORD n_int_M_S7_S3 1 100 0 65535 ECU_ADDRESS 0xFFF8677E /end MEASUREMENT
/begin MEASUREMENT n_soll_ll_vm_in "" FLOAT32_IEEE n_fl_M_S7_S3 1 100 0 2540 ECU_ADDRESS 0xFFF8625C /end MEASUREMENT
/begin MEASUREMENT n_soll_ll_vm_portin "" UWORD n_int_M_S7_S3 1 100 0 65535 ECU_ADDRESS 0xFFF86586 /end MEASUREMENT
/begin MEASUREMENT n_soll_vm_has_byp "" SWORD n_int_M_S7_S3 1 100 -32768 32767 ECU_ADDRESS 0xFFF8676E /end MEASUREMENT
/begin MEASUREMENT n_soll_vm_has_fkt "" FLOAT32_IEEE n_fl_M_S7_S3 1 100 0 8000 ECU_ADDRESS 0xFFF861A8 /end MEASUREMENT
/begin MEASUREMENT n_soll_vm_has_komp_portout "" UWORD n_int_M_S7_S3 1 100 0 65535 ECU_ADDRESS 0xFFF865B2 /end MEASUREMENT
/begin MEASUREMENT n_t_egs_in "" FLOAT32_IEEE n_fl_M_S7_S3 1 100 0 65535 ECU_ADDRESS 0xFFF86260 /end MEASUREMENT
/begin MEASUREMENT n_t_egs_portin "" UWORD n_int_M_S7_S3 1 100 0 65535 ECU_ADDRESS 0xFFF86588 /end MEASUREMENT
/begin MEASUREMENT n_vm_in "" FLOAT32_IEEE n_fl_M_S7_S3 1 100 0 65535 ECU_ADDRESS 0xFFF86264 /end MEASUREMENT
/begin MEASUREMENT n_vm_in_azg "AZG-Signal fuer n_vm_in" UWORD n_int_M_S7_S3 1 100 0 65535 ECU_ADDRESS 0xFFF984C2 /end MEASUREMENT
/begin MEASUREMENT n_vm_portin "" UWORD n_int_M_S7_S3 1 100 0 65535 ECU_ADDRESS 0xFFF8658A /end MEASUREMENT
/begin MEASUREMENT nd_k0_in "Differenzdrehzahl der Trennkupplung" FLOAT32_IEEE n_fl_M_S7_S3 1 100 -10000 10000 ECU_ADDRESS 0xFFF861D4 /end MEASUREMENT
/begin MEASUREMENT nd_min_saf_has_byp "" UWORD n_int_M_S7_S3 1 100 0 65535 ECU_ADDRESS 0xFFF86770 /end MEASUREMENT
/begin MEASUREMENT nd_min_saf_has_fkt "Anforderung min. Drehzahlsprung an ASIS" FLOAT32_IEEE n_fl_M_S7_S3 1 100 0 8000 ECU_ADDRESS 0xFFF861AC /end MEASUREMENT
/begin MEASUREMENT nd_soll_iae_fkt "Differenzdrehzahl der Anfahrkupplung" FLOAT32_IEEE ng_fl_M_S7_S3 1 100 -8000 8000 ECU_ADDRESS 0xFFF861B0 /end MEASUREMENT
/begin MEASUREMENT ndg_k0_in "Gradienten der Differenzdrehzahl der Trennkupplung" FLOAT32_IEEE ng_fl_M_S7_S3 1 100 -10000 10000 ECU_ADDRESS 0xFFF861D8 /end MEASUREMENT
/begin MEASUREMENT ng_vm_in "Gradient der VM Drehzahl" FLOAT32_IEEE ng_fl_M_S7_S3 1 100 -10000 10000 ECU_ADDRESS 0xFFF861DC /end MEASUREMENT
/begin MEASUREMENT osmode_next_in "" UBYTE sts_int_M_S7_S3 1 100 0 255 ECU_ADDRESS 0xFFF86CA1 /end MEASUREMENT
/begin MEASUREMENT osmode_next_portin "" UBYTE sts_int_M_S7_S3 1 100 0 255 ECU_ADDRESS 0xFFF86922 /end MEASUREMENT
/begin MEASUREMENT p_bremse_fzg_in "" FLOAT32_IEEE p_fl_M_S7_S3 1 100 0 127 ECU_ADDRESS 0xFFF86268 /end MEASUREMENT
/begin MEASUREMENT p_bremse_fzg_portin "" UWORD void_int_c_M_S7_S3 1 100 0 65535 ECU_ADDRESS 0xFFF8658C /end MEASUREMENT
/begin MEASUREMENT pc_ok_has_byp "" UBYTE void_int_M_S7_S3 1 100 0 255 ECU_ADDRESS 0xFFF86C16 /end MEASUREMENT
/begin MEASUREMENT phi_neigung_in "" FLOAT32_IEEE phigrad_fl_M_S7_S3 1 100 -3.40282E+038 3.40282E+038 ECU_ADDRESS 0xFFF8626C /end MEASUREMENT
/begin MEASUREMENT phi_neigung_portin "" UBYTE void_int_M_S7_S3 1 100 0 255 ECU_ADDRESS 0xFFF86923 /end MEASUREMENT
/begin MEASUREMENT pos_egs_in "Waehlhebelposition" UBYTE E_POS_M_S7_S3 1 100 0 8 ECU_ADDRESS 0xFFF86CA2 /end MEASUREMENT
/begin MEASUREMENT pos_egs_portin "Waehlhebelposition" UBYTE E_POS_M_S7_S3 1 100 0 8 ECU_ADDRESS 0xFFF86924 /end MEASUREMENT
/begin MEASUREMENT posv_timer_portin "Flag ob Timerbedingungen fuer PosV Diagnose erfuellt sind" UBYTE sts_int_M_S7_S3 1 100 0 255 ECU_ADDRESS 0xFFF86C8B /end MEASUREMENT
/begin MEASUREMENT posvueb_aktiv_portin "Anforderung der  PosV Diagnose einer Drehzahlanhebung und der Deaktivierung der IEP " UBYTE sts_int_M_S7_S3 1 100 0 255 ECU_ADDRESS 0xFFF86C8C /end MEASUREMENT
/begin MEASUREMENT schalt_mode_egs_in "" UWORD void_int_c_M_S7_S3 1 100 0 65535 ECU_ADDRESS 0xFFF86780 /end MEASUREMENT
/begin MEASUREMENT schalt_mode_egs_portin "" UWORD void_int_c_M_S7_S3 1 100 0 65535 ECU_ADDRESS 0xFFF8658E /end MEASUREMENT
/begin MEASUREMENT soc_in "Interface provides state of charge of high-voltage battery" UBYTE rel_int_M_S7_S3 1 100 0 100 ECU_ADDRESS 0xFFF86CC7 /end MEASUREMENT
/begin MEASUREMENT soc_portin "Interface provides state of charge of high-voltage battery" UBYTE void_int_M_S7_S3 1 100 0 100 ECU_ADDRESS 0xFFF86C8D /end MEASUREMENT
/begin MEASUREMENT sollgang_egs_in "" SBYTE void_int_M_S7_S3 1 100 -128 127 ECU_ADDRESS 0xFFF86CA3 /end MEASUREMENT
/begin MEASUREMENT sollgang_egs_portin "" SBYTE void_int_M_S7_S3 1 100 -128 127 ECU_ADDRESS 0xFFF86925 /end MEASUREMENT
/begin MEASUREMENT st_ablauf_fkt "Phase des Ablauf" UWORD st_int_g_M_S7_S3 1 100 0 65535 ECU_ADDRESS 0xFFF86774 /end MEASUREMENT
/begin MEASUREMENT st_ist_bz_has_byp "" UBYTE st_int_M_S7_S3 1 100 0 255 ECU_ADDRESS 0xFFF86C17 /end MEASUREMENT
/begin MEASUREMENT st_ist_bz_has_stg "Istzustand OML" UBYTE E_STBZHAS_M_S7_S3 1 100 0 15 ECU_ADDRESS 0xFFF86C55 /end MEASUREMENT
/begin MEASUREMENT st_ist_bz_hst_sta "Ist-Betriebszustand aus der Startegieanpassung als Eingangsgroesse der Hybridzustandssteuerung (OML)" UBYTE E_STBZHAS_M_S7_S3 1 100 0 15 ECU_ADDRESS 0xFFF86C82 /end MEASUREMENT
/begin MEASUREMENT st_ist_hcomd_has_stg "Innere Zustaende der OML" UWORD st_int_g_M_S7_S3 1 100 0 4999 ECU_ADDRESS 0xFFF86772 /end MEASUREMENT
/begin MEASUREMENT st_soll_bz_has_hst "interner HST Soll-Betriebszustand der Strategieanpassung (variantenunabhaengig)" UBYTE sts_int_M_S7_S3 1 100 0 15 ECU_ADDRESS 0xFFF86C83 /end MEASUREMENT
/begin MEASUREMENT st_soll_bz_hst_sta "Soll-Betriebszustand aus der Strategieanpassung als Eingangsgroesse der Hybrid-Zustandssteuerung (OML)" UBYTE E_STBZHAS_M_S7_S3 1 100 0 15 ECU_ADDRESS 0xFFF86C84 /end MEASUREMENT
/begin MEASUREMENT st_ziel_bz_has_byp "" UBYTE st_int_M_S7_S3 1 100 0 255 ECU_ADDRESS 0xFFF86C18 /end MEASUREMENT
/begin MEASUREMENT st_ziel_bz_has_stg "Zielzustand OML" UBYTE E_STBZHAS_M_S7_S3 1 100 0 15 ECU_ADDRESS 0xFFF86C56 /end MEASUREMENT
/begin MEASUREMENT status_ablauf_has_byp "" UBYTE sts_int_M_S7_S3 1 100 0 255 ECU_ADDRESS 0xFFF86C19 /end MEASUREMENT
/begin MEASUREMENT status_ablauf_has_fkt "" UBYTE sts_int_M_S7_S3 1 100 0 50 ECU_ADDRESS 0xFFF86C5A /end MEASUREMENT
/begin MEASUREMENT status_ablaufaktiv_has_byp "" UBYTE sts_int_M_S7_S3 1 100 0 255 ECU_ADDRESS 0xFFF86C1A /end MEASUREMENT
/begin MEASUREMENT status_abs_in "Information, ob aktuell ein Eingriff durch das ABS System vorgenommen wird" UBYTE E_STATUSABS_M_S7_S3 1 100 0 2 ECU_ADDRESS 0xFFF86CC8 /end MEASUREMENT
/begin MEASUREMENT status_abs_portin "Information ob aktuell ein Eingriff durch das ABS System vorgenommen wird" UBYTE E_STATUSABS_M_S7_S3 1 100 0 2 ECU_ADDRESS 0xFFF86C8E /end MEASUREMENT
/begin MEASUREMENT status_alaengs_adaoff_in "Information, ob die Adaptionen aufgrund erkannter Laengsbeschleunigung deaktiviert wird. 0 = Adaption aktiv aufgrund erkannter Laengsbeschleunigung
1 = Adaption inaktiv aufgrund nicht erkannter Laengsbeschleunigung" UBYTE sts_int_M_S7_S3 1 100 0 1 ECU_ADDRESS 0xFFF86CA4 /end MEASUREMENT
/begin MEASUREMENT status_alaengs_adaoff_portin "Information, ob die Adaptionen aufgrund erkannter Laengsbeschleunigung deaktiviert wird. 0 = Adaption aktiv aufgrund erkannter Laengsbeschleunigung
1 = Adaption inaktiv aufgrund nicht erkannter Laengsbeschleunigung" UBYTE sts_int_M_S7_S3 1 100 0 1 ECU_ADDRESS 0xFFF86926 /end MEASUREMENT
/begin MEASUREMENT status_asr_in "Information, ob ein Regeleingriff durch ein Assistenzsystem (ESP, ASR) vorliegt" UBYTE E_STATUSASR_M_S7_S3 1 100 0 1 ECU_ADDRESS 0xFFF86CC9 /end MEASUREMENT
/begin MEASUREMENT status_asr_portin "Information ob aktuell ein Eingriff durch das ABS System vorgenommen wird" UBYTE E_STATUSASR_M_S7_S3 1 100 0 1 ECU_ADDRESS 0xFFF86C8F /end MEASUREMENT
/begin MEASUREMENT status_autohold_in "Status der Systeme zur Fahrzeug- Rollverhinderung" UBYTE E_STATUSNAA_M_S7_S3 1 100 0 1 ECU_ADDRESS 0xFFF86CA5 /end MEASUREMENT
/begin MEASUREMENT status_betriebsber_hst_portin "Status Fahrbereitschaft (Hybridsystem)" UBYTE sts_int_M_S7_S3 1 100 0 15 ECU_ADDRESS 0xFFF86C90 /end MEASUREMENT
/begin MEASUREMENT status_betriebsbereit_hst_in "" UBYTE sts_int_M_S7_S3 1 100 0 1 ECU_ADDRESS 0xFFF86CCA /end MEASUREMENT
/begin MEASUREMENT status_c_k0_in "Interface returns information concerning energy balance of clutch 0" UBYTE E_STATUSCK0_M_S7_S3 1 100 0 2 ECU_ADDRESS 0xFFF86CA6 /end MEASUREMENT
/begin MEASUREMENT status_c_k0_portin "Interface returns information concerning energy balance of clutch 0" UBYTE sts_int_M_S7_S3 1 100 0 3 ECU_ADDRESS 0xFFF86927 /end MEASUREMENT
/begin MEASUREMENT status_cumgebung_in "Statusinformation in GET_CKB_TOUT" UBYTE E_SIGSTATUS_M_S7_S3 1 100 0 2 ECU_ADDRESS 0xFFF86CCB /end MEASUREMENT
/begin MEASUREMENT status_cumgebung_portin "Statusinformation in GET_CKB_TOUT" UBYTE E_SIGSTATUS_M_S7_S3 1 100 0 2 ECU_ADDRESS 0xFFF86C91 /end MEASUREMENT
/begin MEASUREMENT status_ee_busy_portin "" UBYTE sts_int_M_S7_S3 1 100 0 1 ECU_ADDRESS 0xFFF86928 /end MEASUREMENT
/begin MEASUREMENT status_efahren_has_byp "" UBYTE sts_int_M_S7_S3 1 100 0 255 ECU_ADDRESS 0xFFF86C1B /end MEASUREMENT
/begin MEASUREMENT status_efahren_has_sbe "Status E-Fahren der HAS zur Festlegung der entsprechenden Portout-Groesse in der HAS Signalaufbereitung_Out" UBYTE sts_int_M_S7_S3 1 100 0 1 ECU_ADDRESS 0xFFF86C74 /end MEASUREMENT
/begin MEASUREMENT status_fahranf_hst_portin "Interface returns request to drive detailed of transmission environment" ULONG sts_int_m_M_S7_S3 1 100 0 4294967295 ECU_ADDRESS 0xFFF8620C /end MEASUREMENT
/begin MEASUREMENT status_fehler_iep_in "" UBYTE E_FEHLERIEP_M_S7_S3 1 100 0 1 ECU_ADDRESS 0xFFF86CA7 /end MEASUREMENT
/begin MEASUREMENT status_fehler_iep_portin "" UBYTE E_FEHLERIEP_M_S7_S3 1 100 0 1 ECU_ADDRESS 0xFFF86929 /end MEASUREMENT
/begin MEASUREMENT status_fzg_rollverhinderung_portin "Status der Systeme zur Fahrzeug- Rollverhinderung" UBYTE sts_int_M_S7_S3 1 100 0 3 ECU_ADDRESS 0xFFF8692A /end MEASUREMENT
/begin MEASUREMENT status_getrbereit_in "Status des hydraulischen Drucks des Getriebes" UBYTE sts_int_M_S7_S3 1 100 0 255 ECU_ADDRESS 0xFFF86CCC /end MEASUREMENT
/begin MEASUREMENT status_getrbereit_portin "Status des hydraulischen Drucks des Getriebes" UBYTE sts_int_M_S7_S3 1 100 0 255 ECU_ADDRESS 0xFFF86C92 /end MEASUREMENT
/begin MEASUREMENT status_hillhold_in "Status der Systeme zur Fahrzeug- Rollverhinderung" UBYTE E_STATUSNAA_M_S7_S3 1 100 0 1 ECU_ADDRESS 0xFFF86CA8 /end MEASUREMENT
/begin MEASUREMENT status_iae_adap_in "Status der Adaption des Integrierten Anfahrelements IAE" UBYTE E_STATUSADA_M_S7_S3 1 100 0 2 ECU_ADDRESS 0xFFF86CA9 /end MEASUREMENT
/begin MEASUREMENT status_iae_adap_portin "Status der Adaption des Integrierten Anfahrelements IAE" UBYTE E_STATUSADA_M_S7_S3 1 100 0 2 ECU_ADDRESS 0xFFF8692B /end MEASUREMENT
/begin MEASUREMENT status_iae_in "" UBYTE E_STATUSIAE_M_S7_S3 1 100 0 8 ECU_ADDRESS 0xFFF86CAA /end MEASUREMENT
/begin MEASUREMENT status_iae_portin "" UBYTE E_STATUSIAE_M_S7_S3 1 100 0 8 ECU_ADDRESS 0xFFF8692C /end MEASUREMENT
/begin MEASUREMENT status_iep_in "" UBYTE E_STATUSIEP_M_S7_S3 1 100 0 4 ECU_ADDRESS 0xFFF86CAB /end MEASUREMENT
/begin MEASUREMENT status_iep_portin "" UBYTE E_STATUSIEP_M_S7_S3 1 100 0 4 ECU_ADDRESS 0xFFF8692D /end MEASUREMENT
/begin MEASUREMENT status_k0_adap_in "" UBYTE E_STATUSADA_M_S7_S3 1 100 0 2 ECU_ADDRESS 0xFFF86CAC /end MEASUREMENT
/begin MEASUREMENT status_k0_adap_portin "Status der Adaption der Trennkupplung K0" UBYTE E_STATUSADA_M_S7_S3 1 100 0 2 ECU_ADDRESS 0xFFF8692E /end MEASUREMENT
/begin MEASUREMENT status_k0_adap_zaehler_in "Zaehler k0 adaption" UBYTE void_int_M_S7_S3 1 100 0 255 ECU_ADDRESS 0xFFF86CAD /end MEASUREMENT
/begin MEASUREMENT status_k0_adapf_zaehler_portin "Zaehlerstand der Fuelldruckadaption der uebergebenen Kupplung" UBYTE void_int_M_S7_S3 1 100 0 255 ECU_ADDRESS 0xFFF8692F /end MEASUREMENT
/begin MEASUREMENT status_k0_adatsf_zaehler_portin "Zaehlerstand der Schnellfuellzeitadaption der uebergebenen Kupplung" UBYTE void_int_M_S7_S3 1 100 0 255 ECU_ADDRESS 0xFFF86930 /end MEASUREMENT
/begin MEASUREMENT status_k0_befuellung_in "Interface provides the current filling mode of clutch 0" UBYTE E_STAK0BEF_M_S7_S3 1 100 0 3 ECU_ADDRESS 0xFFF86CAE /end MEASUREMENT
/begin MEASUREMENT status_k0_befuellung_portin "Interface provides the current filling mode of clutch 0" UBYTE E_STAK0BEF_M_S7_S3 1 100 0 3 ECU_ADDRESS 0xFFF86931 /end MEASUREMENT
/begin MEASUREMENT status_k0_in "" UBYTE E_STATUSK0_M_S7_S3 1 100 0 5 ECU_ADDRESS 0xFFF86CAF /end MEASUREMENT
/begin MEASUREMENT status_k0_portin "" UBYTE E_STATUSK0_M_S7_S3 1 100 0 5 ECU_ADDRESS 0xFFF86932 /end MEASUREMENT
/begin MEASUREMENT status_kl15_in "" UBYTE sts_int_M_S7_S3 1 100 0 1 ECU_ADDRESS 0xFFF86CCD /end MEASUREMENT
/begin MEASUREMENT status_kraftfluss_egs_in "" UBYTE E_STATUSKSL_M_S7_S3 1 100 0 6 ECU_ADDRESS 0xFFF86CB0 /end MEASUREMENT
/begin MEASUREMENT status_kraftfluss_lev2_egs_in "Power flow (controled) information concerning ASIL B" UBYTE sts_int_M_S7_S3 1 100 0 2 ECU_ADDRESS 0xFFF86CB1 /end MEASUREMENT
/begin MEASUREMENT status_kraftfluss_lev2_egs_portin "Power flow (controled) information concerning ASIL B." UBYTE void_int_M_S7_S3 1 100 0 2 ECU_ADDRESS 0xFFF86933 /end MEASUREMENT
/begin MEASUREMENT status_kraftschl_atsys_portin "" UBYTE E_STATUSKSL_M_S7_S3 1 100 0 6 ECU_ADDRESS 0xFFF86934 /end MEASUREMENT
/begin MEASUREMENT status_ll_vm_in "" UBYTE sts_int_M_S7_S3 1 100 0 255 ECU_ADDRESS 0xFFF86CB2 /end MEASUREMENT
/begin MEASUREMENT status_nem_in "Status zur Drehzahl E-Motor" UBYTE E_SIGSTATUS_M_S7_S3 1 100 0 2 ECU_ADDRESS 0xFFF86CB3 /end MEASUREMENT
/begin MEASUREMENT status_nem_portin "Status zur Drehzahl E-Motor" UBYTE E_SIGSTATUS_M_S7_S3 1 100 0 2 ECU_ADDRESS 0xFFF86935 /end MEASUREMENT
/begin MEASUREMENT status_nreg_em_hst_in "" UBYTE sts_int_M_S7_S3 1 100 0 255 ECU_ADDRESS 0xFFF86CCE /end MEASUREMENT
/begin MEASUREMENT status_nreg_em_hst_portin "Status E-Motor Drehzahlregelung der HST" UBYTE sts_int_M_S7_S3 1 100 0 255 ECU_ADDRESS 0xFFF86C93 /end MEASUREMENT
/begin MEASUREMENT status_nvm_in "Status zur Drehzahl VM-Motor" UBYTE E_SIGSTATUS_M_S7_S3 1 100 0 2 ECU_ADDRESS 0xFFF86CB4 /end MEASUREMENT
/begin MEASUREMENT status_nvm_portin "Status zur Drehzahl VM-Motor" UBYTE E_SIGSTATUS_M_S7_S3 1 100 0 2 ECU_ADDRESS 0xFFF86936 /end MEASUREMENT
/begin MEASUREMENT status_phineigung_portin "" UBYTE sts_int_M_S7_S3 1 100 0 255 ECU_ADDRESS 0xFFF86937 /end MEASUREMENT
/begin MEASUREMENT status_posvueb_in "Erkennung PosV Diagnose" UBYTE sts_int_M_S7_S3 1 100 0 255 ECU_ADDRESS 0xFFF86CCF /end MEASUREMENT
/begin MEASUREMENT status_psys_has_sbe "Anzeige des Status Pumpendruck der HAS" UBYTE E_STATUSPSY_M_S7_S3 1 100 0 4 ECU_ADDRESS 0xFFF86C6C /end MEASUREMENT
/begin MEASUREMENT status_radschlupf_rse_has_sbe "Anzeige des Status der Radschlupferkennung (RSE) der HAS" UBYTE E_STATUSRSE_M_S7_S3 1 100 0 1 ECU_ADDRESS 0xFFF86C6D /end MEASUREMENT
/begin MEASUREMENT status_sa_vm_in "00 Keine Beeinflussung; 01 Schubabschaltung aktiv; 10 Nicht stellbarer Bereich; 11 Signal ungueltig" UBYTE sts_int_e_M_S7_S3 1 100 0 1 ECU_ADDRESS 0xFFF86CD0 /end MEASUREMENT
/begin MEASUREMENT status_sa_vm_portin "00 Keine Beeinflussung; 01 Schubabschaltung aktiv; 10 Nicht stellbarer Bereich; 11 Signal ungueltig" UBYTE sts_int_M_S7_S3 1 100 0 3 ECU_ADDRESS 0xFFF86C94 /end MEASUREMENT
/begin MEASUREMENT status_schaltart_svh_has_sbe "Schaltart der angeforderten Schaltung der Schaltverhinderung der HAS (0 = keine Schaltung angefordert) - Bit-Codierung (m/oL = mit/ohne Lastanh.) =  bit0=ZRSmL, 1=ZHSmL, 2=SRSmL, 3=SHSmL, 4=ZRSoL, 5=ZHSoL, 6=SRSoL, 7=SHSoL" UBYTE sts_int_M_S7_S3 1 100 0 255 ECU_ADDRESS 0xFFF86C6E /end MEASUREMENT
/begin MEASUREMENT status_schaltung_egs_in "Anzeige ob Schaltung des Getriebes aktiv ist" SBYTE sts_int_M_S7_S3 1 100 -9 9 ECU_ADDRESS 0xFFF86C6F /end MEASUREMENT
/begin MEASUREMENT status_soc_in "Interface provides status information of soc_in" UBYTE E_SIGSTATUS_M_S7_S3 1 100 0 2 ECU_ADDRESS 0xFFF86CD1 /end MEASUREMENT
/begin MEASUREMENT status_soc_portin "Interface provides status information of soc_portin" UBYTE E_SIGSTATUS_M_S7_S3 1 100 0 2 ECU_ADDRESS 0xFFF86C95 /end MEASUREMENT
/begin MEASUREMENT status_sync_schaltung_sbe "Anzeige der Synchronerkennung der aktuellen Schaltung innerhalb der HAS" UBYTE sts_int_M_S7_S3 1 100 0 1 ECU_ADDRESS 0xFFF86C70 /end MEASUREMENT
/begin MEASUREMENT status_vf_in "Signalstatus fuer die Fahrzeugistgeschwindigkeit  gebildet aus der Getriebe-Abtriebsdrehzahl" UBYTE E_SIGSTATUS_M_S7_S3 1 100 0 2 ECU_ADDRESS 0xFFF86CB5 /end MEASUREMENT
/begin MEASUREMENT status_vf_portin "Signalstatus fuer die Fahrzeugistgeschwindigkeit  gebildet aus der Getriebe-Abtriebsdrehzahl" UBYTE E_SIGSTATUS_M_S7_S3 1 100 0 2 ECU_ADDRESS 0xFFF86938 /end MEASUREMENT
/begin MEASUREMENT status_vfref_in "Signalstatus fuer die Fahrzeuggeschwindigkeit ueber Grund" UBYTE E_SIGSTATUS_M_S7_S3 1 100 0 2 ECU_ADDRESS 0xFFF86CB6 /end MEASUREMENT
/begin MEASUREMENT status_vfref_portin "Signalstatus fuer die Fahrzeuggeschwindigkeit ueber Grund" UBYTE E_SIGSTATUS_M_S7_S3 1 100 0 2 ECU_ADDRESS 0xFFF86939 /end MEASUREMENT
/begin MEASUREMENT status_waschstr_in "" UBYTE sts_int_M_S7_S3 1 100 0 255 ECU_ADDRESS 0xFFF86CB7 /end MEASUREMENT
/begin MEASUREMENT status_waschstr_portin "Zustand der N-Halte-Phase" UBYTE sts_int_M_S7_S3 1 100 0 255 ECU_ADDRESS 0xFFF8693A /end MEASUREMENT
/begin MEASUREMENT t_betrieb_pvu_has_byp "" ULONG t_int_M_S7_S3 1 100 0 42949672.95 ECU_ADDRESS 0xFFF86180 /end MEASUREMENT
/begin MEASUREMENT t_betrieb_pvu_has_ee_in "" ULONG t_int_M_S7_S3 1 100 0 10000 ECU_ADDRESS 0xFFF86270 /end MEASUREMENT
/begin MEASUREMENT t_betrieb_pvu_has_ee_portin "" ULONG t_int_M_S7_S3 1 100 0 42949672.95 ECU_ADDRESS 0xFFF85B90 /end MEASUREMENT
/begin MEASUREMENT t_betrieb_pvu_has_sbe "Betriebsdauer seit dem letzten Ablauf der Diagnosefunktion \"Positionsventil-Ueberwachung\" der Funktion zur Unterstuet-zung der Positionsventil-Ueberwachung der HAS" ULONG t_int_M_S7_S3 1 100 0 1000000 ECU_ADDRESS 0xFFF861E0 /end MEASUREMENT
/begin MEASUREMENT v_f_in "" FLOAT32_IEEE v_fl_M_S7_S3 1 100 0 500 ECU_ADDRESS 0xFFF86274 /end MEASUREMENT
/begin MEASUREMENT v_f_portin "" UWORD v_int_M_S7_S3 1 100 0 65535 ECU_ADDRESS 0xFFF86590 /end MEASUREMENT
/begin MEASUREMENT v_f_ref_in "Fahrzeuggeschwindigkeit ueber Grund" UWORD v_int_M_S7_S3 1 100 0 511 ECU_ADDRESS 0xFFF86782 /end MEASUREMENT
/begin MEASUREMENT v_f_ref_portin "Fahrzeuggeschwindigkeit ueber Grund" UWORD void_int_c_M_S7_S3 1 100 0 51100 ECU_ADDRESS 0xFFF86592 /end MEASUREMENT
/begin MEASUREMENT v_f_sbe "Fahrzeuggeschwindigkeit auf Basis der Getriebeabtriebsdrehzahl in der  Hybridablaufsteuerung" FLOAT32_IEEE v_fl_M_S7_S3 1 100 0 500 ECU_ADDRESS 0xFFF861E4 /end MEASUREMENT
/begin MEASUREMENT vg_f_sbe "Fahrzeuggeschwindigkeitsgradient auf Basis der Getriebeabtriebsdrehzahl in der  Hybridablaufsteuerung" FLOAT32_IEEE vg_fl_M_S7_S3 1 100 -100 100 ECU_ADDRESS 0xFFF861E8 /end MEASUREMENT
/begin MEASUREMENT z_ablauf_has_hst_in "" UBYTE sts_int_M_S7_S3 1 100 0 15 ECU_ADDRESS 0xFFF86CB8 /end MEASUREMENT
/begin MEASUREMENT z_ablauf_has_hst_portin "" UBYTE sts_int_M_S7_S3 1 100 0 255 ECU_ADDRESS 0xFFF8693B /end MEASUREMENT
/begin MEASUREMENT z_ablauf_has_stg "Zusaetzliche Steuergroesse zur Ablaufsteuerung" UBYTE ctrl_int_M_S7_S3 1 100 0 15 ECU_ADDRESS 0xFFF86C57 /end MEASUREMENT
/begin MEASUREMENT z_ablauf_svh_reset_has_fkt "" UBYTE sts_int_M_S7_S3 1 100 0 255 ECU_ADDRESS 0xFFF86C5B /end MEASUREMENT
/begin MEASUREMENT z_ablaufreinit_frk_dihi "Zeigt an, dass der aktuelle HAS-Ablauf erneut begonnen werden soll" UBYTE sts_int_e_M_S7_S3 1 100 0 1 ECU_ADDRESS 0xFFF86C40 /end MEASUREMENT
/begin MEASUREMENT z_ablaufvariante_has_hst_in "" UBYTE sts_int_M_S7_S3 1 100 0 99 ECU_ADDRESS 0xFFF86CB9 /end MEASUREMENT
/begin MEASUREMENT z_ablaufvariante_has_hst_portin "" UBYTE sts_int_M_S7_S3 1 100 0 255 ECU_ADDRESS 0xFFF8693C /end MEASUREMENT
/begin MEASUREMENT z_ablaufvariante_has_stg "Ablaufvariante, die  die OML ausgibt" UBYTE sts_int_M_S7_S3 1 100 0 99 ECU_ADDRESS 0xFFF86C58 /end MEASUREMENT
/begin MEASUREMENT z_ablaufvariante_kalt_zus "Anzeige der aktiven Ablaufvariante Kaltstart beim Zustart - 0 = kein Kaltstart, 1 = Kaltstart mit abgesenkter EM-Drehzahl" UBYTE st_int_M_S7_S3 1 100 0 255 ECU_ADDRESS 0xFFF86C5C /end MEASUREMENT
/begin MEASUREMENT z_ala_frk_dihi "Zeigt an, dass die Anlasserstartanforderung der HAS aktiviert werden soll" UBYTE sts_int_e_M_S7_S3 1 100 0 1 ECU_ADDRESS 0xFFF86C41 /end MEASUREMENT
/begin MEASUREMENT z_ba_has_k0_hst_in "" UBYTE st_int_M_S7_S3 1 100 0 1 ECU_ADDRESS 0xFFF86CD2 /end MEASUREMENT
/begin MEASUREMENT z_ba_has_k0_hst_portin "Anforderung K0 Betriebsart der HAS durch die HST" UBYTE sts_int_M_S7_S3 1 100 0 15 ECU_ADDRESS 0xFFF86C96 /end MEASUREMENT
/begin MEASUREMENT z_ba_has_vm_hst_in "" UBYTE st_int_M_S7_S3 1 100 0 1 ECU_ADDRESS 0xFFF86CD3 /end MEASUREMENT
/begin MEASUREMENT z_ba_has_vm_hst_portin "Anforderung VM Betriebsart der HAS durch die HST" UBYTE sts_int_M_S7_S3 1 100 0 15 ECU_ADDRESS 0xFFF86C97 /end MEASUREMENT
/begin MEASUREMENT z_deaktiv_abo_frk_dihi "Zeigt an, dass die ABO Funktion verlassen werden soll." UBYTE sts_int_e_M_S7_S3 1 100 0 1 ECU_ADDRESS 0xFFF86C42 /end MEASUREMENT
/begin MEASUREMENT z_diag_ersfkt_has_in "Funktionsschnittstelle zur Ermittlung ob irgendeine Ersatzmassnahme in der Diagnoseverwaltung aktiv ist" ULONG b_int_M_S7_S3 1 100 0 4294967295 ECU_ADDRESS 0xFFF86278 /end MEASUREMENT
/begin MEASUREMENT z_diag_ersfkt_has_portin "Funktionsschnittstelle zur Ermittlung ob irgendeine Ersatzmassnahme in der Diagnoseverwaltung aktiv ist" ULONG b_int_M_S7_S3 1 100 0 4294967295 ECU_ADDRESS 0xFFF85B94 /end MEASUREMENT
/begin MEASUREMENT z_diag_ersfkt_hi_96_has_in "Anzeige ob Ersatzmassnahme in der Diagnoseverwaltung aktiv ist bit 64...95" ULONG b_int_M_S7_S3 1 100 0 4294967295 ECU_ADDRESS 0xFFF8627C /end MEASUREMENT
/begin MEASUREMENT z_diag_ersfkt_hi_96_has_portin "Anzeige ob Ersatzmassnahme in der Diagnoseverwaltung aktiv ist bit 64...95" ULONG b_int_M_S7_S3 1 100 0 4294967295 ECU_ADDRESS 0xFFF85B98 /end MEASUREMENT
/begin MEASUREMENT z_diag_ersfkt_hi_has_in "Funktionsschnittstelle zur Ermittlung ob irgendeine Ersatzmassnahme in der Diagnoseverwaltung aktiv ist" ULONG b_int_M_S7_S3 1 100 0 4294967295 ECU_ADDRESS 0xFFF86280 /end MEASUREMENT
/begin MEASUREMENT z_diag_ersfkt_hi_has_portin "Funktionsschnittstelle zur Ermittlung ob irgendeine Ersatzmassnahme in der Diagnoseverwaltung aktiv ist" ULONG b_int_M_S7_S3 1 100 0 4294967295 ECU_ADDRESS 0xFFF85B9C /end MEASUREMENT
/begin MEASUREMENT z_diag_notgang_has_in "Notganginformation" UBYTE b_int_b_M_S7_S3 1 100 0 255 ECU_ADDRESS 0xFFF86CBA /end MEASUREMENT
/begin MEASUREMENT z_diag_notgang_has_portin "Notganginformation" UBYTE b_int_b_M_S7_S3 1 100 0 255 ECU_ADDRESS 0xFFF8693D /end MEASUREMENT
/begin MEASUREMENT z_emaktiv_fuw_zus_fkt "Anzeige der EM Fehlfuntion der Funktionsueberwachung der EM beim Zustart" UBYTE b_int_h_M_S7_S3 1 100 0 1 ECU_ADDRESS 0xFFF86C5D /end MEASUREMENT
/begin MEASUREMENT z_emfehler_frk_dihi "Zeigt an, dass eine EM Fehlfunktion erkannt wurde, die in der HAS ausgewertet werden soll" UBYTE sts_int_e_M_S7_S3 1 100 0 1 ECU_ADDRESS 0xFFF86C43 /end MEASUREMENT
/begin MEASUREMENT z_fehler15_diho_has_byp "" UBYTE st_int_M_S7_S3 1 100 0 255 ECU_ADDRESS 0xFFF86C1C /end MEASUREMENT
/begin MEASUREMENT z_fehler15_eh_fkt "" UBYTE st_int_M_S7_S3 1 100 0 1 ECU_ADDRESS 0xFFF86C5E /end MEASUREMENT
/begin MEASUREMENT z_freigabe_pvu_has_byp "" UBYTE st_int_M_S7_S3 1 100 0 255 ECU_ADDRESS 0xFFF86C1D /end MEASUREMENT
/begin MEASUREMENT z_freigabe_pvu_has_sbe "Freigabe zur Aktivierung der Diagnosefunktion \"Positionsventil-Ueberwachung\" der Funktion zur Unterstuetzung der Positi-onsventil-Ueberwachung der HAS" UBYTE st_int_M_S7_S3 1 100 0 1 ECU_ADDRESS 0xFFF86C71 /end MEASUREMENT
/begin MEASUREMENT z_fuwdeakt_frk_dihi "Zeigt an, dass die FUW-Funktion nicht aktiviert werden darf" UBYTE sts_int_e_M_S7_S3 1 100 0 1 ECU_ADDRESS 0xFFF86C44 /end MEASUREMENT
/begin MEASUREMENT z_gebruefahrenaus_frk_dihi "Erkennung Aufheben gebruecktes E Fahren" UBYTE sts_int_e_M_S7_S3 1 100 0 1 ECU_ADDRESS 0xFFF86C45 /end MEASUREMENT
/begin MEASUREMENT z_glsbe_has_byp "" UBYTE st_int_M_S7_S3 1 100 0 255 ECU_ADDRESS 0xFFF86C1E /end MEASUREMENT
/begin MEASUREMENT z_hybfkt_stg "Anforderung der Aktivierung einer Hybridfunktion durch die Hyrid-Zustandssteuerung" UBYTE E_HYBFKT_M_S7_S3 1 100 0 15 ECU_ADDRESS 0xFFF86C59 /end MEASUREMENT
/begin MEASUREMENT z_iep_anf_portin "" UWORD void_int_c_M_S7_S3 1 100 0 65535 ECU_ADDRESS 0xFFF86594 /end MEASUREMENT
/begin MEASUREMENT z_iep_in "" UBYTE E_ZIEP_M_S7_S3 1 100 0 4 ECU_ADDRESS 0xFFF86CBB /end MEASUREMENT
/begin MEASUREMENT z_iepein_frk_dihi "Zeigt an, dass die IEP aktiviert werden soll, wenn ein EM-Drehzahl Signalfehler vorliegt, um die Oelversorgung weiterhin sicher zu stellen." UBYTE sts_int_e_M_S7_S3 1 100 0 1 ECU_ADDRESS 0xFFF86C46 /end MEASUREMENT
/begin MEASUREMENT z_init_sta "Anforderung der Initialisierung der Zustandssteuerung (OML) durch die Strategieanpassung" UBYTE sts_int_M_S7_S3 1 100 0 1 ECU_ADDRESS 0xFFF86C85 /end MEASUREMENT
/begin MEASUREMENT z_k0_befuellopt_has_byp "" UBYTE st_int_M_S7_S3 1 100 0 255 ECU_ADDRESS 0xFFF86C1F /end MEASUREMENT
/begin MEASUREMENT z_k0_befuellopt_has_fkt "" UBYTE st_int_M_S7_S3 1 100 0 1 ECU_ADDRESS 0xFFF86C5F /end MEASUREMENT
/begin MEASUREMENT z_k0_fst_in "" UBYTE E_ZK0FSTIN_M_S7_S3 1 100 0 3 ECU_ADDRESS 0xFFF86CBC /end MEASUREMENT
/begin MEASUREMENT z_k0_fst_portin "" UBYTE E_ZK0FSTIN_M_S7_S3 1 100 0 3 ECU_ADDRESS 0xFFF8693E /end MEASUREMENT
/begin MEASUREMENT z_k0_has_byp "" UBYTE st_int_M_S7_S3 1 100 0 255 ECU_ADDRESS 0xFFF86C20 /end MEASUREMENT
/begin MEASUREMENT z_k0_has_fkt "" UBYTE E_ZK0_M_S7_S3 1 100 0 5 ECU_ADDRESS 0xFFF86C60 /end MEASUREMENT
/begin MEASUREMENT z_k0_has_sbe "K0 Sollzustand der Priorisierung der K0-Ansteuerung der HAS" UBYTE E_ZK0_M_S7_S3 1 100 0 5 ECU_ADDRESS 0xFFF86C75 /end MEASUREMENT
/begin MEASUREMENT z_k0oeffnicht_diho_has_byp "" UBYTE st_int_M_S7_S3 1 100 0 255 ECU_ADDRESS 0xFFF86C21 /end MEASUREMENT
/begin MEASUREMENT z_k0schlupfbed_abs_kps "Anzeige ob die K0-Schlupfregelung in Abhaengigkeit des Regelungszustands des ABS-Steuergeraets erlaubt ist bei der Priorisierung der K0-Ansteuerung der HAS" UBYTE st_int_l_M_S7_S3 1 100 0 1 ECU_ADDRESS 0xFFF86972 /end MEASUREMENT
/begin MEASUREMENT z_k0schlupfbed_iae_has "Anzeige, ob Schlupfentkopplung der K0 in Abhaengigkeit des IAE-Status erlaubt ist in der HAS" UBYTE st_int_l_M_S7_S3 1 100 0 1 ECU_ADDRESS 0xFFF98411 /end MEASUREMENT
/begin MEASUREMENT z_k0schlupfbed_mmotiae_kps "Schlupfbedingung zur Bestimmung z_k0_has_sbe" UBYTE st_int_l_M_S7_S3 1 100 0 1 ECU_ADDRESS 0xFFF98412 /end MEASUREMENT
/begin MEASUREMENT z_k0schlupfbed_ngem_kps "Anzeige ob Schlupfentkopplung der K0 in Abhaengigkeit der EM-Drehzahlgradientenbedingung erlaubt ist bei der Priorisierung der K0-Ansteuerung der HAS" UBYTE st_int_l_M_S7_S3 1 100 0 1 ECU_ADDRESS 0xFFF86973 /end MEASUREMENT
/begin MEASUREMENT z_k0syncmk0erh_frk_dihi "Zeigt an, dass eine K0-Zwangsynchronisation mittels Erhoehung des K0-Moments erfolgen soll" UBYTE sts_int_e_M_S7_S3 1 100 0 1 ECU_ADDRESS 0xFFF86C47 /end MEASUREMENT
/begin MEASUREMENT z_kfc_c0noclose_eho_diho_has_byp "" UBYTE st_int_M_S7_S3 1 100 0 255 ECU_ADDRESS 0xFFF86C22 /end MEASUREMENT
/begin MEASUREMENT z_kfc_c0noclose_has_byp "" UBYTE st_int_M_S7_S3 1 100 0 255 ECU_ADDRESS 0xFFF86C23 /end MEASUREMENT
/begin MEASUREMENT z_kfc_c0noclosepb_has_byp "" UBYTE st_int_M_S7_S3 1 100 0 255 ECU_ADDRESS 0xFFF86C24 /end MEASUREMENT
/begin MEASUREMENT z_kfc_c0noopen_eho_diho_has_byp "" UBYTE st_int_M_S7_S3 1 100 0 255 ECU_ADDRESS 0xFFF86C25 /end MEASUREMENT
/begin MEASUREMENT z_kfc_c0noopenpb_has_byp "" UBYTE st_int_M_S7_S3 1 100 0 255 ECU_ADDRESS 0xFFF86C26 /end MEASUREMENT
/begin MEASUREMENT z_kps_stada_in "Sollvorgabe fuer die Trennkupplung K0 durch die Stillstandsadaption" UBYTE sts_int_M_S7_S3 1 100 0 255 ECU_ADDRESS 0xFFF86CBD /end MEASUREMENT
/begin MEASUREMENT z_kps_stada_portin "Sollvorgabe fuer die Trennkupplung K0 durch die Stillstandsadaption" UBYTE sts_int_M_S7_S3 1 100 0 255 ECU_ADDRESS 0xFFF8693F /end MEASUREMENT
/begin MEASUREMENT z_lls_fktaktiv_has_sbe "Aktive LLS-Funktion - Codierung bit0=STAT,1=IEP,2=CGETR,3=BEFFZP,4=GE,5=KFL,6=PAUS,7=PARKSP,8=RANG,9=MANH,10=IAE,11=SAS,12=KRI,13=DAT,14=IAEADA,15=K0ADA,16=STADA,17-18=frei,19=FKT,20=BZ,21-22=frei,23=VGF,24=ALAE,25-26=frei,27=PVU,28-30=frei,31=DIAG" ULONG sts_int_m_M_S7_S3 1 100 0 4294967295 ECU_ADDRESS 0xFFF86208 /end MEASUREMENT
/begin MEASUREMENT z_m_max_iae_has_byp "" UBYTE st_int_M_S7_S3 1 100 0 255 ECU_ADDRESS 0xFFF86C27 /end MEASUREMENT
/begin MEASUREMENT z_m_max_iae_has_fkt "" UBYTE st_int_M_S7_S3 1 100 0 50 ECU_ADDRESS 0xFFF86C61 /end MEASUREMENT
/begin MEASUREMENT z_m_soll_em_has_byp "" UBYTE st_int_M_S7_S3 1 100 0 255 ECU_ADDRESS 0xFFF86C28 /end MEASUREMENT
/begin MEASUREMENT z_m_soll_em_has_fkt "" UBYTE st_int_l_M_S7_S3 1 100 0 1 ECU_ADDRESS 0xFFF86C62 /end MEASUREMENT
/begin MEASUREMENT z_m_soll_em_has_komp_portout "" UBYTE sts_int_M_S7_S3 1 100 0 255 ECU_ADDRESS 0xFFF8695C /end MEASUREMENT
/begin MEASUREMENT z_modus_em_hst_in "" UBYTE sts_int_M_S7_S3 1 100 0 255 ECU_ADDRESS 0xFFF86CBE /end MEASUREMENT
/begin MEASUREMENT z_modus_iae_has_byp "" UBYTE st_int_M_S7_S3 1 100 0 255 ECU_ADDRESS 0xFFF86C29 /end MEASUREMENT
/begin MEASUREMENT z_modus_iae_has_sbe "" UBYTE E_ZMODUSIAE_M_S7_S3 1 100 0 2 ECU_ADDRESS 0xFFF86C76 /end MEASUREMENT
/begin MEASUREMENT z_modus_iep_has_sbe "Vorgabe des Betriebsmodus der IEP durch die HAS" UBYTE E_ZMODUSIEP_M_S7_S3 1 100 0 4 ECU_ADDRESS 0xFFF86C77 /end MEASUREMENT
/begin MEASUREMENT z_msa_avh_moni_has_sbe "Anforderung einer Schaltverhinderung der HAS" UBYTE st_int_M_S7_S3 1 100 0 255 ECU_ADDRESS 0xFFF86C78 /end MEASUREMENT
/begin MEASUREMENT z_msa_eaf_moni_has_sbe "Anforderung einer Schaltverhinderung der HAS" UBYTE st_int_M_S7_S3 1 100 0 255 ECU_ADDRESS 0xFFF86C79 /end MEASUREMENT
/begin MEASUREMENT z_msa_fst_avh_portin "Anforderung einer Abschaltverhinderung durch die Fahrstrategie" UBYTE sts_int_M_S7_S3 1 100 0 255 ECU_ADDRESS 0xFFF86940 /end MEASUREMENT
/begin MEASUREMENT z_msa_fst_eaf_portin "Anforderung einer Einschaltaufforderung durch die Fahrstrategie" UBYTE sts_int_M_S7_S3 1 100 0 255 ECU_ADDRESS 0xFFF86941 /end MEASUREMENT
/begin MEASUREMENT z_msa_fst_in "Anforderung einer Abschaltverhinderung durch die Fahrstrategie ASIS" UBYTE sts_int_M_S7_S3 1 100 0 255 ECU_ADDRESS 0xFFF86CBF /end MEASUREMENT
/begin MEASUREMENT z_msa_has_byp "" UBYTE st_int_M_S7_S3 1 100 0 255 ECU_ADDRESS 0xFFF86C2A /end MEASUREMENT
/begin MEASUREMENT z_msa_has_sbe "Anforderung der Beeinflussung der MSA-Funktionalitaet durch die Hybridablaufsteuerung - Codierung: bit0 = AVZ, bit1 = AVH, bit2 = EAF, bit3 = EVH, bit4 = Deaktivierung, bit7 = Stoerungsbedingt" UBYTE sts_int_M_S7_S3 1 100 0 255 ECU_ADDRESS 0xFFF86C7A /end MEASUREMENT
/begin MEASUREMENT z_msa_stada_avh_portin "Anforderung einer Abschaltverhinderung durch die Stillstandadaption" UBYTE sts_int_M_S7_S3 1 100 0 1 ECU_ADDRESS 0xFFF86C98 /end MEASUREMENT
/begin MEASUREMENT z_msa_stada_eaf_portin "Anforderung einer Einschaltaufforderung durch die Stillstandadaption" UBYTE sts_int_M_S7_S3 1 100 0 1 ECU_ADDRESS 0xFFF86C99 /end MEASUREMENT
/begin MEASUREMENT z_msa_stada_in "Anforderung einer Abschaltverhinderung durch die Stillstandadaption" UBYTE sts_int_M_S7_S3 1 100 0 6 ECU_ADDRESS 0xFFF86CD4 /end MEASUREMENT
/begin MEASUREMENT z_n_min_em_parksp_has_in "Anforderung einer EM-Drehzahlanhebung beim Auslegen der Parksperre infolge unzureichender Oelversorgung" UBYTE b_int_b_M_S7_S3 1 100 0 1 ECU_ADDRESS 0xFFF86CC0 /end MEASUREMENT
/begin MEASUREMENT z_n_min_em_parksp_has_portin "Anforderung einer EM-Drehzahlanhebung beim Auslegen der Parksperre infolge unzureichender Oelversorgung" UBYTE b_int_b_M_S7_S3 1 100 0 1 ECU_ADDRESS 0xFFF86942 /end MEASUREMENT
/begin MEASUREMENT z_n_soll_em_has_byp "" UBYTE st_int_M_S7_S3 1 100 0 255 ECU_ADDRESS 0xFFF86C2B /end MEASUREMENT
/begin MEASUREMENT z_n_soll_em_has_fkt "" UBYTE st_int_M_S7_S3 1 100 0 50 ECU_ADDRESS 0xFFF86C63 /end MEASUREMENT
/begin MEASUREMENT z_n_soll_em_has_komp_portout "" UBYTE sts_int_M_S7_S3 1 100 0 255 ECU_ADDRESS 0xFFF86960 /end MEASUREMENT
/begin MEASUREMENT z_n_soll_vm_has_byp "" UBYTE st_int_M_S7_S3 1 100 0 255 ECU_ADDRESS 0xFFF86C2C /end MEASUREMENT
/begin MEASUREMENT z_n_soll_vm_has_fkt "" UBYTE st_int_M_S7_S3 1 100 0 50 ECU_ADDRESS 0xFFF86C64 /end MEASUREMENT
/begin MEASUREMENT z_n_soll_vm_has_komp_portout "" UBYTE sts_int_M_S7_S3 1 100 0 255 ECU_ADDRESS 0xFFF86962 /end MEASUREMENT
/begin MEASUREMENT z_ndk0zugross_auw_diho_has_byp "" UBYTE st_int_M_S7_S3 1 100 0 255 ECU_ADDRESS 0xFFF86C2D /end MEASUREMENT
/begin MEASUREMENT z_nemablwe_auw_diho_has_byp "" UBYTE st_int_M_S7_S3 1 100 0 255 ECU_ADDRESS 0xFFF86C2E /end MEASUREMENT
/begin MEASUREMENT z_nemasynscl_auw_diho_has_byp "" UBYTE st_int_M_S7_S3 1 100 0 255 ECU_ADDRESS 0xFFF86C2F /end MEASUREMENT
/begin MEASUREMENT z_nemmin_frk_dihi "Zeigt an, dass die EM Leerlauf angehoben werden soll." UBYTE sts_int_e_M_S7_S3 1 100 0 1 ECU_ADDRESS 0xFFF86C48 /end MEASUREMENT
/begin MEASUREMENT z_nemrde_diho_has_byp "" UBYTE st_int_M_S7_S3 1 100 0 255 ECU_ADDRESS 0xFFF86C30 /end MEASUREMENT
/begin MEASUREMENT z_nemzuklein_auw_diho_has_byp "" UBYTE st_int_M_S7_S3 1 100 0 255 ECU_ADDRESS 0xFFF86C31 /end MEASUREMENT
/begin MEASUREMENT z_nllsoll_iae_in "Anforderung der IAE, dass eine definierte LL-Drehzahl durch den Motor eingestellt werden soll" UBYTE E_ZNLLSOLL_M_S7_S3 1 100 0 3 ECU_ADDRESS 0xFFF86CC1 /end MEASUREMENT
/begin MEASUREMENT z_nllsoll_iae_portin "Anforderung der IAE, dass eine definierte LL-Drehzahl durch den Motor eingestellt werden soll" UBYTE E_ZNLLSOLL_M_S7_S3 1 100 0 3 ECU_ADDRESS 0xFFF86943 /end MEASUREMENT
/begin MEASUREMENT z_nllsoll_iep_in "" UBYTE void_int_d_M_S7_S3 1 100 0 1 ECU_ADDRESS 0xFFF86CC2 /end MEASUREMENT
/begin MEASUREMENT z_nllsoll_modus_has_byp "" UBYTE st_int_M_S7_S3 1 100 0 255 ECU_ADDRESS 0xFFF86C32 /end MEASUREMENT
/begin MEASUREMENT z_nminemmodus_has_sbe "Modus der Vorgabe der minimalen EM-Drehzahl der HAS" UBYTE E_ZNMODUS_M_S7_S3 1 100 0 4 ECU_ADDRESS 0xFFF86C7B /end MEASUREMENT
/begin MEASUREMENT z_nminemnull_frk_dihi "Zeigt an, dass die Ausgabe der minimalen EM Drehzahl der HAS unterdrueckt werden soll." UBYTE sts_int_e_M_S7_S3 1 100 0 1 ECU_ADDRESS 0xFFF86C49 /end MEASUREMENT
/begin MEASUREMENT z_nsollvmanh_frk_dihi "Zeigt an, dass die VM-Solldrehzahl waehrend eines Start-Ablaufs angehoben werden soll" UBYTE sts_int_e_M_S7_S3 1 100 0 1 ECU_ADDRESS 0xFFF86C4A /end MEASUREMENT
/begin MEASUREMENT z_nsollvmnull_frk_dihi "Zeigt an, dass die VM-Solldrehzahl Vorgabe unterbunden werden soll" UBYTE sts_int_e_M_S7_S3 1 100 0 1 ECU_ADDRESS 0xFFF86C4B /end MEASUREMENT
/begin MEASUREMENT z_nvmsollbegr_frk_dihi "Zeigt an, dass die VM-Solldrehzahl auf die EM-Istdrehzahl be-grenzt werden soll" UBYTE sts_int_e_M_S7_S3 1 100 0 1 ECU_ADDRESS 0xFFF86C4C /end MEASUREMENT
/begin MEASUREMENT z_nvmzuklein_auw_diho_has_byp "" UBYTE st_int_M_S7_S3 1 100 0 255 ECU_ADDRESS 0xFFF86C33 /end MEASUREMENT
/begin MEASUREMENT z_oea_hst_in "Anforderung fuer das gebrueckte E-Anfahren der HST" UBYTE sts_int_M_S7_S3 1 100 0 1 ECU_ADDRESS 0xFFF86CC3 /end MEASUREMENT
/begin MEASUREMENT z_oea_hst_portin "Anforderung fuer das gebrueckte E-Anfahren der HST" UBYTE sts_int_M_S7_S3 1 100 0 1 ECU_ADDRESS 0xFFF86944 /end MEASUREMENT
/begin MEASUREMENT z_oelversfehler_diho_has_byp "" UBYTE st_int_M_S7_S3 1 100 0 255 ECU_ADDRESS 0xFFF86C34 /end MEASUREMENT
/begin MEASUREMENT z_p_hys_k0_has_byp "" UBYTE st_int_M_S7_S3 1 100 0 255 ECU_ADDRESS 0xFFF86C35 /end MEASUREMENT
/begin MEASUREMENT z_p_hys_k0_has_fkt "Hysteresekompensation" UBYTE st_int_M_S7_S3 1 100 0 1 ECU_ADDRESS 0xFFF86C65 /end MEASUREMENT
/begin MEASUREMENT z_ponr_fkt "point of no return" UBYTE st_int_M_S7_S3 1 100 0 1 ECU_ADDRESS 0xFFF86C66 /end MEASUREMENT
/begin MEASUREMENT z_pvu_has_sbe "Beeinflussung des Hybridsystems zur Unterstuetzung der Positionsventil- Ueberwachung der HAS-Codierung: 0 = keine Beeinflussung, 1 = Beeinflussung Stufe 1, 2 = Beeinflussung Stufe 2" UBYTE st_int_M_S7_S3 1 100 0 2 ECU_ADDRESS 0xFFF86C72 /end MEASUREMENT
/begin MEASUREMENT z_respschlepp_sas_fkt "" UBYTE st_int_M_S7_S3 1 100 0 1 ECU_ADDRESS 0xFFF86C67 /end MEASUREMENT
/begin MEASUREMENT z_saf_has_byp "" UBYTE st_int_M_S7_S3 1 100 0 255 ECU_ADDRESS 0xFFF86C36 /end MEASUREMENT
/begin MEASUREMENT z_saf_has_fkt "Schaltanforderung 1...aktiv" UBYTE st_int_M_S7_S3 1 100 0 1 ECU_ADDRESS 0xFFF86C68 /end MEASUREMENT
/begin MEASUREMENT z_sas_has_byp "" UBYTE st_int_M_S7_S3 1 100 0 255 ECU_ADDRESS 0xFFF86C37 /end MEASUREMENT
/begin MEASUREMENT z_sas_has_sbe "Aendert im Wahrheitsfall die KupplungsBefuellreihenfolge" UBYTE st_int_M_S7_S3 1 100 0 1 ECU_ADDRESS 0xFFF86C7C /end MEASUREMENT
/begin MEASUREMENT z_sbe_has_byp "" UBYTE st_int_M_S7_S3 1 100 0 255 ECU_ADDRESS 0xFFF86C38 /end MEASUREMENT
/begin MEASUREMENT z_sbe_has_fkt "Schaltbeeinflussung  1...aktiv" UBYTE st_int_M_S7_S3 1 100 0 1 ECU_ADDRESS 0xFFF86C69 /end MEASUREMENT
/begin MEASUREMENT z_schaltprioverh_frk_dihi "Zeigt an, dass die Schaltungspriorisierung bei einem Zustart-Ablauf  uterbunden werden soll" UBYTE sts_int_e_M_S7_S3 1 100 0 1 ECU_ADDRESS 0xFFF86C4D /end MEASUREMENT
/begin MEASUREMENT z_start_modus_has_byp "" UBYTE st_int_M_S7_S3 1 100 0 255 ECU_ADDRESS 0xFFF86C39 /end MEASUREMENT
/begin MEASUREMENT z_start_modus_has_sbe "Anforderung eines Anlasserstarts" UBYTE st_int_M_S7_S3 1 100 0 3 ECU_ADDRESS 0xFFF86C7D /end MEASUREMENT
/begin MEASUREMENT z_status_psys_mps_has_byp "" UBYTE st_int_M_S7_S3 1 100 0 255 ECU_ADDRESS 0xFFF86C3A /end MEASUREMENT
/begin MEASUREMENT z_status_psys_mps_sbe "Anforderung der Modifikation des Pumpendruckstatus durch die Hybrid Ablaufsteuerung (MPS)" UBYTE sts_int_M_S7_S3 1 100 0 1 ECU_ADDRESS 0xFFF86C7E /end MEASUREMENT
/begin MEASUREMENT z_statusnem_auw_diho_has_byp "" UBYTE st_int_M_S7_S3 1 100 0 255 ECU_ADDRESS 0xFFF86C3B /end MEASUREMENT
/begin MEASUREMENT z_statusnemablwe_auw_diho_has_byp "" UBYTE st_int_M_S7_S3 1 100 0 255 ECU_ADDRESS 0xFFF86C3C /end MEASUREMENT
/begin MEASUREMENT z_statusnemasynscl_auw_diho_has_byp "" UBYTE st_int_M_S7_S3 1 100 0 255 ECU_ADDRESS 0xFFF86C3D /end MEASUREMENT
/begin MEASUREMENT z_statuspsysmps_frk_dihi "Zeigt an, dass der Pumpendruck-Status der ATSYS modifiziert werden soll" UBYTE sts_int_e_M_S7_S3 1 100 0 1 ECU_ADDRESS 0xFFF86C4E /end MEASUREMENT
/begin MEASUREMENT z_svh_frk_dihi "Zeigt an, dass die Schaltverhinderung (SVH) aktiviert werden soll" UBYTE sts_int_e_M_S7_S3 1 100 0 1 ECU_ADDRESS 0xFFF86C4F /end MEASUREMENT
/begin MEASUREMENT z_svh_has_byp "" UBYTE st_int_M_S7_S3 1 100 0 255 ECU_ADDRESS 0xFFF86C3E /end MEASUREMENT
/begin MEASUREMENT z_svh_has_sbe "Anforderung einer Schaltverhinderung der HAS" UBYTE st_int_M_S7_S3 1 100 0 1 ECU_ADDRESS 0xFFF86C7F /end MEASUREMENT
/begin MEASUREMENT z_vmaus_auw_diho_has_byp "" UBYTE st_int_M_S7_S3 1 100 0 255 ECU_ADDRESS 0xFFF86C3F /end MEASUREMENT
/begin MEASUREMENT z_vmstartanf_frk_dihi "Zeigt an, dass der VM gestartet werden soll." UBYTE sts_int_e_M_S7_S3 1 100 0 1 ECU_ADDRESS 0xFFF86C50 /end MEASUREMENT
/begin MEASUREMENT z_vmstartverbot_frk_dihi "Zeigt an, dass der VM nicht gestartet werden darf." UBYTE sts_int_e_M_S7_S3 1 100 0 1 ECU_ADDRESS 0xFFF86C51 /end MEASUREMENT
/begin MEASUREMENT z_vmstopverbot_frk_dihi "Zeigt an, dass der VM nicht gestoppt werden darf." UBYTE sts_int_e_M_S7_S3 1 100 0 1 ECU_ADDRESS 0xFFF86C52 /end MEASUREMENT
/begin MEASUREMENT z_zuendfreigabe_vm_fkt "" UBYTE st_int_M_S7_S3 1 100 0 1 ECU_ADDRESS 0xFFF86C6A /end MEASUREMENT
/begin MEASUREMENT z_zuendfreigabe_vm_has_fkt "" UBYTE st_int_M_S7_S3 1 100 0 1 ECU_ADDRESS 0xFFF86C6B /end MEASUREMENT
/begin MEASUREMENT z_zust_halten_frk_dihi "Zeigt an, ob der Betriebszustand \"HAS Zustand halten\" aktiv sein soll." UBYTE sts_int_e_M_S7_S3 1 100 0 1 ECU_ADDRESS 0xFFF86C53 /end MEASUREMENT
/begin MEASUREMENT z_zust_init_frk_dihi "Zeigt an, ob der Betriebszustand \"HAS Zustand Init\" aktiv sein soll." UBYTE sts_int_e_M_S7_S3 1 100 0 1 ECU_ADDRESS 0xFFF86C54 /end MEASUREMENT
/begin MEASUREMENT zielgang_egs_in "" SBYTE sts_int_M_S7_S3 1 100 -128 127 ECU_ADDRESS 0xFFF86CC4 /end MEASUREMENT
/begin MEASUREMENT zielgang_egs_portin "" SBYTE void_int_M_S7_S3 1 100 -128 127 ECU_ADDRESS 0xFFF86945 /end MEASUREMENT
/begin MEASUREMENT f_akt_err_motmax_fl_has_l2 "Flag, ob ein Fehler aktiv ist (FPU-Pfad) (Ueberwachung max. Summenmoment)" FLOAT32_IEEE sts_fl_S1_S7_S3 1 100 -3.40282E+038 3.40282E+038 ECU_ADDRESS 0xFFF862A4 /end MEASUREMENT
/begin MEASUREMENT f_akt_err_motmax_has_l2 "Flag, ob ein Fehler aktiv ist (Ueberwachung max. Summenmoment)" UBYTE sts_int_S1_S7_S3 1 100 0 255 ECU_ADDRESS 0xFFF86CD5 /end MEASUREMENT
/begin MEASUREMENT f_akt_err_nemmin_fl_has_l2 "Flag, fuer aktiven Fehler (FPU-Pfad)" FLOAT32_IEEE sts_fl_S1_S7_S3 1 100 -3.40282E+038 3.40282E+038 ECU_ADDRESS 0xFFF862B4 /end MEASUREMENT
/begin MEASUREMENT f_akt_err_nemmin_has_l2 "Flag, fuer aktiven Fehler" UBYTE sts_int_S1_S7_S3 1 100 0 255 ECU_ADDRESS 0xFFF86CD8 /end MEASUREMENT
/begin MEASUREMENT f_akt_err_nemsoll_fl_has_l2 "Flag, ob Fehler aktiv ist (FPU-Pfad)" FLOAT32_IEEE sts_fl_S1_S7_S3 1 100 -3.40282E+038 3.40282E+038 ECU_ADDRESS 0xFFF862EC /end MEASUREMENT
/begin MEASUREMENT f_akt_err_nemsoll_has_l2 "Flag, ob Fehler aktiv ist" UBYTE sts_int_S1_S7_S3 1 100 0 255 ECU_ADDRESS 0xFFF86CE0 /end MEASUREMENT
/begin MEASUREMENT f_m_akt_err_motmax_fl_has_l2 "Flag, ob Momentenfehler aktiv ist (FPU-Pfad)" FLOAT32_IEEE sts_fl_S1_S7_S3 1 100 -3.40282E+038 3.40282E+038 ECU_ADDRESS 0xFFF862A8 /end MEASUREMENT
/begin MEASUREMENT f_m_akt_err_motmax_has_l2 "Flag, ob Momentenfehler aktiv ist" UBYTE sts_int_S1_S7_S3 1 100 0 255 ECU_ADDRESS 0xFFF86CD6 /end MEASUREMENT
/begin MEASUREMENT f_m_akt_err_nemmin_fl_has_l2 "Flag, ob Momentenfehler aktiv ist (FPU-Pfad)" FLOAT32_IEEE sts_fl_S1_S7_S3 1 100 -3.40282E+038 3.40282E+038 ECU_ADDRESS 0xFFF862B8 /end MEASUREMENT
/begin MEASUREMENT f_m_akt_err_nemmin_has_l2 "Flag, ob Momentenfehler aktiv ist" UBYTE sts_int_S1_S7_S3 1 100 0 255 ECU_ADDRESS 0xFFF86CD9 /end MEASUREMENT
/begin MEASUREMENT f_m_err_motmax_fl_has_l2 "Flag, ob Fehlerereignis aufgrund Momentenunterschreitung vorliegt (FPU-Pfad)" FLOAT32_IEEE sts_fl_S1_S7_S3 1 100 -3.40282E+038 3.40282E+038 ECU_ADDRESS 0xFFF862AC /end MEASUREMENT
/begin MEASUREMENT f_m_err_motmax_has_l2 "Flag, ob Fehlerereignis aufgrund Momentenunterschreitung vorliegt" UBYTE sts_int_S1_S7_S3 1 100 0 255 ECU_ADDRESS 0xFFF86CD7 /end MEASUREMENT
/begin MEASUREMENT f_m_err_nemmin_fl_has_l2 "Flag, ob Fehlerereignis aufgrund Momentenueberschreitung vorliegt (FPU-Pfad)" FLOAT32_IEEE sts_fl_S1_S7_S3 1 100 -3.40282E+038 3.40282E+038 ECU_ADDRESS 0xFFF862BC /end MEASUREMENT
/begin MEASUREMENT f_m_err_nemmin_has_l2 "Flag, ob Fehlerereignis aufgrund Momentenueberschreitung vorliegt" UBYTE sts_int_S1_S7_S3 1 100 0 255 ECU_ADDRESS 0xFFF86CDA /end MEASUREMENT
/begin MEASUREMENT f_n_akt_err_nemmin_fl_has_l2 "Flag, ob Drehzahlfehler aktiv ist (FPU-Pfad)" FLOAT32_IEEE sts_fl_S1_S7_S3 1 100 -3.40282E+038 3.40282E+038 ECU_ADDRESS 0xFFF862C0 /end MEASUREMENT
/begin MEASUREMENT f_n_akt_err_nemmin_has_l2 "Flag, ob Drehzahlfehler aktiv ist" UBYTE sts_int_S1_S7_S3 1 100 0 255 ECU_ADDRESS 0xFFF86CDB /end MEASUREMENT
/begin MEASUREMENT f_n_akt_err_nemsoll_fl_has_l2 "Flag, ob Drehzahlfehler aktiv ist (FPU-Pfad)" FLOAT32_IEEE sts_fl_S1_S7_S3 1 100 -3.40282E+038 3.40282E+038 ECU_ADDRESS 0xFFF862F0 /end MEASUREMENT
/begin MEASUREMENT f_n_akt_err_nemsoll_has_l2 "Flag, ob Drehzahlfehler aktiv ist" UBYTE sts_int_S1_S7_S3 1 100 0 255 ECU_ADDRESS 0xFFF86CE1 /end MEASUREMENT
/begin MEASUREMENT f_n_err_nemmin_fl_has_l2 "Flag, ob Fehlerereignis aufgrund Drehzahlueberschreitung vorliegt (FPU-Pfad)" FLOAT32_IEEE sts_fl_S1_S7_S3 1 100 -3.40282E+038 3.40282E+038 ECU_ADDRESS 0xFFF862C4 /end MEASUREMENT
/begin MEASUREMENT f_n_err_nemmin_has_l2 "Flag, ob Fehlerereignis aufgrund Drehzahlueberschreitung vorliegt" UBYTE sts_int_S1_S7_S3 1 100 0 255 ECU_ADDRESS 0xFFF86CDC /end MEASUREMENT
/begin MEASUREMENT f_n_err_nemsoll_fl_has_l2 "Flag, ob Fehlerereignis aufgrund Drehzahlueberschreitung vorliegt (FPU-Pfad)" FLOAT32_IEEE sts_fl_S1_S7_S3 1 100 -3.40282E+038 3.40282E+038 ECU_ADDRESS 0xFFF862F4 /end MEASUREMENT
/begin MEASUREMENT f_n_err_nemsoll_has_l2 "Flag, ob Fehlerereignis aufgrund Drehzahlueberschreitung vorliegt" UBYTE sts_int_S1_S7_S3 1 100 0 255 ECU_ADDRESS 0xFFF86CE2 /end MEASUREMENT
/begin MEASUREMENT f_next_check_allowed_nemmin_fl_has_l2 "Flag, ob naechste Stufe der Ueberwachung durchlaufen werden darf. Bei einem Fehlereintritt, wird die Ueberwachungabgebrochen und entsprechend der Fehler angefiltert. (FPU-Pfad)" FLOAT32_IEEE sts_fl_S1_S7_S3 1 100 0 1 ECU_ADDRESS 0xFFF862C8 /end MEASUREMENT
/begin MEASUREMENT f_next_check_allowed_nemmin_has_l2 "Flag, ob naechste Stufe der Ueberwachung durchlaufen werden darf. Bei einem Fehlereintritt, wird die Ueberwachung abgebrochen und entsprechend der Fehler angefiltert." UBYTE sts_int_S1_S7_S3 1 100 0 1 ECU_ADDRESS 0xFFF86CDD /end MEASUREMENT
/begin MEASUREMENT f_pos_akt_err_nemsoll_fl_has_l2 "Flag, ob Positionsfehler aktiv ist (FPU-Pfad)" FLOAT32_IEEE sts_fl_S1_S7_S3 1 100 -3.40282E+038 3.40282E+038 ECU_ADDRESS 0xFFF862F8 /end MEASUREMENT
/begin MEASUREMENT f_pos_akt_err_nemsoll_has_l2 "Flag, ob Positionsfehler aktiv ist" UBYTE sts_int_S1_S7_S3 1 100 0 255 ECU_ADDRESS 0xFFF86CE3 /end MEASUREMENT
/begin MEASUREMENT f_pos_err_nemsoll_fl_has_l2 "Flag, ob Fehlerereignis aufgrund falscher Positionshebelstellung vorliegt (FPU-Pfad)" FLOAT32_IEEE sts_fl_S1_S7_S3 1 100 -3.40282E+038 3.40282E+038 ECU_ADDRESS 0xFFF862FC /end MEASUREMENT
/begin MEASUREMENT f_pos_err_nemsoll_has_l2 "Flag, ob Fehlerereignis aufgrund falscher Positionshebelstellung vorliegt" UBYTE sts_int_S1_S7_S3 1 100 0 255 ECU_ADDRESS 0xFFF86CE4 /end MEASUREMENT
/begin MEASUREMENT f_s_akt_err_nemsoll_fl_has_l2 "Flag, ob Schlupffehler vorliegt (FPU-Pfad)" FLOAT32_IEEE sts_fl_S1_S7_S3 1 100 -3.40282E+038 3.40282E+038 ECU_ADDRESS 0xFFF86300 /end MEASUREMENT
/begin MEASUREMENT f_s_akt_err_nemsoll_has_l2 "Flag, ob Schlupffehler vorliegt" UBYTE sts_int_S1_S7_S3 1 100 0 255 ECU_ADDRESS 0xFFF86CE5 /end MEASUREMENT
/begin MEASUREMENT f_s_err_nemsoll_fl_has_l2 "Flag, ob Fehlerereignis aufgrund eines nicht schlupfenden Getriebes vorliegt (FPU-Pfad)" FLOAT32_IEEE sts_fl_S1_S7_S3 1 100 -3.40282E+038 3.40282E+038 ECU_ADDRESS 0xFFF86304 /end MEASUREMENT
/begin MEASUREMENT f_s_err_nemsoll_has_l2 "Flag, ob Fehlerereignis aufgrund eines nicht schlupfenden Getriebes vorliegt " UBYTE sts_int_S1_S7_S3 1 100 0 255 ECU_ADDRESS 0xFFF86CE6 /end MEASUREMENT
/begin MEASUREMENT f_sig_akt_err_nemmin_fl_has_l2 "Flag, ob Signalfehler aktiv ist (FPU-Pfad)" FLOAT32_IEEE sts_fl_S1_S7_S3 1 100 -3.40282E+038 3.40282E+038 ECU_ADDRESS 0xFFF862CC /end MEASUREMENT
/begin MEASUREMENT f_sig_akt_err_nemmin_has_l2 "Flag, ob Signalfehler aktiv ist" UBYTE sts_int_S1_S7_S3 1 100 0 255 ECU_ADDRESS 0xFFF86CDE /end MEASUREMENT
/begin MEASUREMENT f_sig_err_nemmin_fl_has_l2 "Flag, ob Fehlerereignis aufgrund Signalstoerung aktiv (FPU-Pfad)" FLOAT32_IEEE sts_fl_S1_S7_S3 1 100 -3.40282E+038 3.40282E+038 ECU_ADDRESS 0xFFF862D0 /end MEASUREMENT
/begin MEASUREMENT f_sig_err_nemmin_has_l2 "Flag, ob Fehlerereignis aufgrund Signalstoerung aktiv" UBYTE sts_int_S1_S7_S3 1 100 0 255 ECU_ADDRESS 0xFFF86CDF /end MEASUREMENT
/begin MEASUREMENT f_z_akt_err_nemsoll_fl_has_l2 "Flag, ob Vorgabefehler vorliegt (FPU-Pfad)" FLOAT32_IEEE sts_fl_S1_S7_S3 1 100 -3.40282E+038 3.40282E+038 ECU_ADDRESS 0xFFF86308 /end MEASUREMENT
/begin MEASUREMENT f_z_akt_err_nemsoll_has_l2 "Flag, ob Vorgabefehler vorliegt" UBYTE sts_int_S1_S7_S3 1 100 0 255 ECU_ADDRESS 0xFFF86CE7 /end MEASUREMENT
/begin MEASUREMENT f_z_err_nemsoll_fl_has_l2 "Flag, ob Fehlerereignis aufgrund Drehzahlvorgabe ohne Anforderung vorliegt (FPU-Pfad)" FLOAT32_IEEE sts_fl_S1_S7_S3 1 100 -3.40282E+038 3.40282E+038 ECU_ADDRESS 0xFFF8630C /end MEASUREMENT
/begin MEASUREMENT f_z_err_nemsoll_has_l2 "Flag, ob Fehlerereignis aufgrund Drehzahlvorgabe ohne Anforderung vorliegt" UBYTE sts_int_S1_S7_S3 1 100 0 255 ECU_ADDRESS 0xFFF86CE8 /end MEASUREMENT
/begin MEASUREMENT i_dyn_nemmin_fl_has_l2 "dynamisches Uebersetzungsverhaeltnis (FPU-Pfad)" FLOAT32_IEEE void_fl_S1_S7_S3 1 100 -3.40282E+038 3.40282E+038 ECU_ADDRESS 0xFFF862D4 /end MEASUREMENT
/begin MEASUREMENT i_dyn_nemmin_has_l2 "dynamisches Uebersetzungsverhaeltnis" UWORD ratio_int_S1_S7_S3 1 100 0 65.535 ECU_ADDRESS 0xFFF86788 /end MEASUREMENT
/begin MEASUREMENT i_dyn_nemsoll_fl_has_l2 "dynamisches Uebersetzungsverhaeltnis (FPU-Pfad)" FLOAT32_IEEE void_fl_S1_S7_S3 1 100 -3.40282E+038 3.40282E+038 ECU_ADDRESS 0xFFF86310 /end MEASUREMENT
/begin MEASUREMENT i_dyn_nemsoll_has_l2 "dynamisches Uebersetzungsverhaeltnis" UWORD ratio_int_S1_S7_S3 1 100 0 65.535 ECU_ADDRESS 0xFFF86794 /end MEASUREMENT
/begin MEASUREMENT i_fix_nemsoll_fl_has_l2 "ermitteltes Uebersetzungsverhaeltnis (Istganguebersetzung) (FPU-Pfad)" FLOAT32_IEEE void_fl_S1_S7_S3 1 100 -3.40282E+038 3.40282E+038 ECU_ADDRESS 0xFFF86314 /end MEASUREMENT
/begin MEASUREMENT i_fix_nemsoll_has_l2 "ermitteltes Uebersetzungsverhaeltnis (Istganguebersetzung)" UWORD ratio_int_S1_S7_S3 1 100 0 65.535 ECU_ADDRESS 0xFFF86796 /end MEASUREMENT
/begin MEASUREMENT m_motsoll_nemsoll_fl_has_l2 "Verbrennersollmoment  (FPU-Pfad)" FLOAT32_IEEE trq_fl_S1_S7_S3 1 100 -3.40282E+038 3.40282E+038 ECU_ADDRESS 0xFFF86318 /end MEASUREMENT
/begin MEASUREMENT m_motsoll_nemsoll_has_l2 "Verbrennersollmoment (Integer-Pfad)" SWORD trq_int_S1_S7_S3 1 100 -32768 32767 ECU_ADDRESS 0xFFF86798 /end MEASUREMENT
/begin MEASUREMENT m_soll_nemsoll_fl_has_l2 "EM-Sollmoment  (FPU-Pfad)" FLOAT32_IEEE trq_fl_S1_S7_S3 1 100 -3.40282E+038 3.40282E+038 ECU_ADDRESS 0xFFF8631C /end MEASUREMENT
/begin MEASUREMENT m_soll_nemsoll_has_l2 "EM-Sollmoment (Integer-Pfad)" SWORD trq_int_S1_S7_S3 1 100 -32768 32767 ECU_ADDRESS 0xFFF8679A /end MEASUREMENT
/begin MEASUREMENT m_verlust_nemmin_fl_has_l2 "Motorverlustmoment  (FPU-Pfad)" FLOAT32_IEEE trq_fl_S1_S7_S3 1 100 0 1023 ECU_ADDRESS 0xFFF862D8 /end MEASUREMENT
/begin MEASUREMENT m_verlust_nemmin_has_l2 "Motorverlustmoment" UWORD trq_int_S1_S7_S3 1 100 0 1023 ECU_ADDRESS 0xFFF8678A /end MEASUREMENT
/begin MEASUREMENT m_verlust_nemsoll_fl_has_l2 "Motorverlustmoment  (FPU-Pfad)" FLOAT32_IEEE trq_fl_S1_S7_S3 1 100 0 1023 ECU_ADDRESS 0xFFF86320 /end MEASUREMENT
/begin MEASUREMENT m_verlust_nemsoll_has_l2 "Motorverlustmoment" UWORD trq_int_S1_S7_S3 1 100 0 1023 ECU_ADDRESS 0xFFF8679C /end MEASUREMENT
/begin MEASUREMENT mo_mered_nemmin_fl_has_l2 "Drehmoment des Motoreingriffs  (FPU-Pfad)" FLOAT32_IEEE trq_fl_S1_S7_S3 1 100 -32767 32768 ECU_ADDRESS 0xFFF862DC /end MEASUREMENT
/begin MEASUREMENT mo_mered_nemmin_has_l2 "Drehmoment des Motoreingriffs" SWORD trq_int_S1_S7_S3 1 100 -32768 32767 ECU_ADDRESS 0xFFF8678C /end MEASUREMENT
/begin MEASUREMENT nd_getr_nemsoll_fl_has_l2 "berechneter Getriebeschlupf (FPU-Pfad)" FLOAT32_IEEE n_fl_S1_S7_S3 1 100 -3.40282E+038 3.40282E+038 ECU_ADDRESS 0xFFF86324 /end MEASUREMENT
/begin MEASUREMENT nd_getr_nemsoll_has_l2 "berechneter Getriebeschlupf" SWORD n_int_S1_S7_S3 1 100 -32768 32767 ECU_ADDRESS 0xFFF8679E /end MEASUREMENT
/begin MEASUREMENT no_ndgetr_nemsoll_fl_has_l2 "Drehzahloffset zur Berechnung des Getriebeschlupfes, dass von der EM-Istdrehzahl subtrahiert wird" FLOAT32_IEEE n_fl_S1_S7_S3 1 100 0 65535 ECU_ADDRESS 0xFFF86328 /end MEASUREMENT
/begin MEASUREMENT no_ndgetr_nemsoll_has_l2 "Drehzahloffset zur Berechnung des Getriebeschlupfes, dass von der EM-Istdrehzahl subtrahiert wird" UWORD n_int_S1_S7_S3 1 100 0 65535 ECU_ADDRESS 0xFFF867A0 /end MEASUREMENT
/begin MEASUREMENT t_m_err_motmax_fl_has_l2 "Fehlerfilterungstimer fuer Momentenfehlerereignis (FPU-Pfad) [10 ms]" FLOAT32_IEEE void_fl_S1_S7_S3 1 100 -3.40282E+038 3.40282E+038 ECU_ADDRESS 0xFFF862B0 /end MEASUREMENT
/begin MEASUREMENT t_m_err_motmax_has_l2 "Fehlerfilterungstimer fuer Momentenfehlerereignis" UWORD t_int_S1_S7_S3 1 100 0 655.35 ECU_ADDRESS 0xFFF86786 /end MEASUREMENT
/begin MEASUREMENT t_m_err_nemmin_fl_has_l2 "Fehlerfilterungstimer fuer Momentenfehlerereignis (FPU-Pfad) [10ms]" FLOAT32_IEEE void_fl_S1_S7_S3 1 100 -3.40282E+038 3.40282E+038 ECU_ADDRESS 0xFFF862E0 /end MEASUREMENT
/begin MEASUREMENT t_m_err_nemmin_has_l2 "Fehlerfilterungstimer fuer Momentenfehlerereignis" UWORD t_int_S1_S7_S3 1 100 0 655.35 ECU_ADDRESS 0xFFF8678E /end MEASUREMENT
/begin MEASUREMENT t_n_err_nemmin_fl_has_l2 "Fehlerfilterungstimer fuer Drehzahlfehlerereignis (FPU-Pfad) [10ms]" FLOAT32_IEEE void_fl_S1_S7_S3 1 100 -3.40282E+038 3.40282E+038 ECU_ADDRESS 0xFFF862E4 /end MEASUREMENT
/begin MEASUREMENT t_n_err_nemmin_has_l2 "Fehlerfilterungstimer fuer Drehzahlfehlerereignis" UWORD t_int_S1_S7_S3 1 100 0 655.35 ECU_ADDRESS 0xFFF86790 /end MEASUREMENT
/begin MEASUREMENT t_n_err_nemsoll_fl_has_l2 "Fehlerfilterungstimer fuer Drehzahlfehlerereignis (FPU-Pfad) [10 ms]" FLOAT32_IEEE void_fl_S1_S7_S3 1 100 -3.40282E+038 3.40282E+038 ECU_ADDRESS 0xFFF8632C /end MEASUREMENT
/begin MEASUREMENT t_n_err_nemsoll_has_l2 "Fehlerfilterungstimer fuer Drehzahlfehlerereignis" UWORD t_int_S1_S7_S3 1 100 0 655.35 ECU_ADDRESS 0xFFF867A2 /end MEASUREMENT
/begin MEASUREMENT t_pos_err_nemsoll_fl_has_l2 "Fehlerfilterungstimer fuer Positionsfehlerereignis (FPU-Pfad) [10 ms]" FLOAT32_IEEE void_fl_S1_S7_S3 1 100 -3.40282E+038 3.40282E+038 ECU_ADDRESS 0xFFF86330 /end MEASUREMENT
/begin MEASUREMENT t_pos_err_nemsoll_has_l2 "Fehlerfilterungstimer fuer Positionsfehlerereignis" UWORD t_int_S1_S7_S3 1 100 0 655.35 ECU_ADDRESS 0xFFF867A4 /end MEASUREMENT
/begin MEASUREMENT t_s_err_nemsoll_fl_has_l2 "Fehlerfilterungstimer fuer Schluffehlerereignis (FPU-Pfad) [10 ms]" FLOAT32_IEEE void_fl_S1_S7_S3 1 100 -3.40282E+038 3.40282E+038 ECU_ADDRESS 0xFFF86334 /end MEASUREMENT
/begin MEASUREMENT t_s_err_nemsoll_has_l2 "Fehlerfilterungstimer fuer Schlupffehlerereignis" UWORD t_int_S1_S7_S3 1 100 0 655.35 ECU_ADDRESS 0xFFF867A6 /end MEASUREMENT
/begin MEASUREMENT t_sig_err_nemmin_fl_has_l2 "Fehlerfilterungstimer fuer Signalfehlerereignis (FPU-Pfad)" FLOAT32_IEEE void_fl_S1_S7_S3 1 100 -3.40282E+038 3.40282E+038 ECU_ADDRESS 0xFFF862E8 /end MEASUREMENT
/begin MEASUREMENT t_sig_err_nemmin_has_l2 "Fehlerfilterungstimer fuer Signalfehlerereignis" UWORD t_int_S1_S7_S3 1 100 0 655.35 ECU_ADDRESS 0xFFF86792 /end MEASUREMENT
/begin MEASUREMENT t_z_err_nemsoll_fl_has_l2 "Fehlerfilterungstimer fuer Vorgabefehlerereignis (FPU-Pfad) [10 ms]" FLOAT32_IEEE void_fl_S1_S7_S3 1 100 -3.40282E+038 3.40282E+038 ECU_ADDRESS 0xFFF86338 /end MEASUREMENT
/begin MEASUREMENT t_z_err_nemsoll_has_l2 "Fehlerfilterungstimer fuer Vorgabefehlerereignis" UWORD t_int_S1_S7_S3 1 100 0 655.35 ECU_ADDRESS 0xFFF867A8 /end MEASUREMENT
/begin COMPU_METHOD SAB_V_10KMH_S2_S3 "int = ((phys * 1) / 10) - (0) km/h" RAT_FUNC "%5.3" "km/h" COEFFS 0 1 -0 0 0 10 /end COMPU_METHOD
/begin COMPU_METHOD SAB_V_2KMH_S2_S3 "int = ((phys * 1) / 2) - (0) km/h" RAT_FUNC "%5.3" "km/h" COEFFS 0 1 -0 0 0 2 /end COMPU_METHOD
/begin COMPU_METHOD SAB_V_KMH_S2_S3 "int = ((phys * 1) / 1) - (0) km/h" RAT_FUNC "%2.0" "km/h" COEFFS 0 1 -0 0 0 1 /end COMPU_METHOD
/begin COMPU_METHOD SAB_V_KMH_M40_S2_S3 "int = ((phys * 1) / 1) - (-40) km/h" RAT_FUNC "%2.0" "km/h" COEFFS 0 1 40 0 0 1 /end COMPU_METHOD
/begin COMPU_METHOD SAB_V_KMH8_S2_S3 "int = ((phys * 8) / 1) - (0) km/h" RAT_FUNC "%5.3" "km/h" COEFFS 0 8 -0 0 0 1 /end COMPU_METHOD
/begin COMPU_METHOD b_int_M_S7_S3 "Bit Feld" RAT_FUNC "%10.0" "-" COEFFS 0 1 0 0 0 1 /end COMPU_METHOD
/begin COMPU_METHOD b_int_b_M_S7_S3 "Bit Feld" RAT_FUNC "%3.0" "-" COEFFS 0 1 0 0 0 1 /end COMPU_METHOD
/begin COMPU_METHOD b_int_h_M_S7_S3 "Bit Feld" RAT_FUNC "%1.0" "-" COEFFS 0 1 0 0 0 1 /end COMPU_METHOD
/begin COMPU_METHOD c_fl_M_S7_S3 "Temperatur" RAT_FUNC "%12.6" "°C" COEFFS 0 1 0 0 0 1 /end COMPU_METHOD
/begin COMPU_METHOD c_int_M_S7_S3 "Temperatur" RAT_FUNC "%12.6" "°C" COEFFS 0 1 0 0 0 1 /end COMPU_METHOD
/begin COMPU_METHOD c_int_v_M_S7_S3 "Temperatur" RAT_FUNC "%5.0" "°C" COEFFS 0 1 0 0 0 1 /end COMPU_METHOD
/begin COMPU_METHOD ctrl_int_M_S7_S3 "Steuerwort" RAT_FUNC "%3.0" "-" COEFFS 0 1 0 0 0 1 /end COMPU_METHOD
/begin COMPU_METHOD E_BREMSPED_M_S7_S3 "" TAB_VERB "%12.6" "" COMPU_TAB_REF CONV_TAB_E_BREMSPED_M_S7_S3 /end COMPU_METHOD
/begin COMPU_METHOD E_DREHRICH_M_S7_S3 "" TAB_VERB "%12.6" "" COMPU_TAB_REF CONV_TAB_E_DREHRICH_M_S7_S3 /end COMPU_METHOD
/begin COMPU_METHOD E_FEHLERIEP_M_S7_S3 "" TAB_VERB "%12.6" "" COMPU_TAB_REF CONV_TAB_E_FEHLERIEP_M_S7_S3 /end COMPU_METHOD
/begin COMPU_METHOD E_HYBFKT_M_S7_S3 "" TAB_VERB "%12.6" "" COMPU_TAB_REF CONV_TAB_E_HYBFKT_M_S7_S3 /end COMPU_METHOD
/begin COMPU_METHOD E_MODUSEFAH_M_S7_S3 "" TAB_VERB "%12.6" "" COMPU_TAB_REF CONV_TAB_E_MODUSEFAH_M_S7_S3 /end COMPU_METHOD
/begin COMPU_METHOD E_POS_M_S7_S3 "" TAB_VERB "%12.6" "" COMPU_TAB_REF CONV_TAB_E_POS_M_S7_S3 /end COMPU_METHOD
/begin COMPU_METHOD E_SIGSTATUS_M_S7_S3 "" TAB_VERB "%12.6" "" COMPU_TAB_REF CONV_TAB_E_SIGSTATUS_M_S7_S3 /end COMPU_METHOD
/begin COMPU_METHOD E_STAK0BEF_M_S7_S3 "" TAB_VERB "%12.6" "" COMPU_TAB_REF CONV_TAB_E_STAK0BEF_M_S7_S3 /end COMPU_METHOD
/begin COMPU_METHOD E_STATUSABS_M_S7_S3 "" TAB_VERB "%12.6" "" COMPU_TAB_REF CONV_TAB_E_STATUSABS_M_S7_S3 /end COMPU_METHOD
/begin COMPU_METHOD E_STATUSADA_M_S7_S3 "" TAB_VERB "%12.6" "" COMPU_TAB_REF CONV_TAB_E_STATUSADA_M_S7_S3 /end COMPU_METHOD
/begin COMPU_METHOD E_STATUSASR_M_S7_S3 "" TAB_VERB "%12.6" "" COMPU_TAB_REF CONV_TAB_E_STATUSASR_M_S7_S3 /end COMPU_METHOD
/begin COMPU_METHOD E_STATUSCK0_M_S7_S3 "" TAB_VERB "%12.6" "" COMPU_TAB_REF CONV_TAB_E_STATUSCK0_M_S7_S3 /end COMPU_METHOD
/begin COMPU_METHOD E_STATUSIAE_M_S7_S3 "" TAB_VERB "%12.6" "" COMPU_TAB_REF CONV_TAB_E_STATUSIAE_M_S7_S3 /end COMPU_METHOD
/begin COMPU_METHOD E_STATUSIEP_M_S7_S3 "" TAB_VERB "%12.6" "" COMPU_TAB_REF CONV_TAB_E_STATUSIEP_M_S7_S3 /end COMPU_METHOD
/begin COMPU_METHOD E_STATUSK0_M_S7_S3 "" TAB_VERB "%12.6" "" COMPU_TAB_REF CONV_TAB_E_STATUSK0_M_S7_S3 /end COMPU_METHOD
/begin COMPU_METHOD E_STATUSKSL_M_S7_S3 "" TAB_VERB "%12.6" "" COMPU_TAB_REF CONV_TAB_E_STATUSKSL_M_S7_S3 /end COMPU_METHOD
/begin COMPU_METHOD E_STATUSNAA_M_S7_S3 "" TAB_VERB "%12.6" "" COMPU_TAB_REF CONV_TAB_E_STATUSNAA_M_S7_S3 /end COMPU_METHOD
/begin COMPU_METHOD E_STATUSPSY_M_S7_S3 "" TAB_VERB "%12.6" "" COMPU_TAB_REF CONV_TAB_E_STATUSPSY_M_S7_S3 /end COMPU_METHOD
/begin COMPU_METHOD E_STATUSRSE_M_S7_S3 "" TAB_VERB "%12.6" "" COMPU_TAB_REF CONV_TAB_E_STATUSRSE_M_S7_S3 /end COMPU_METHOD
/begin COMPU_METHOD E_STBZHAS_M_S7_S3 "" TAB_VERB "%12.6" "" COMPU_TAB_REF CONV_TAB_E_STBZHAS_M_S7_S3 /end COMPU_METHOD
/begin COMPU_METHOD E_ZIEP_M_S7_S3 "" TAB_VERB "%12.6" "" COMPU_TAB_REF CONV_TAB_E_ZIEP_M_S7_S3 /end COMPU_METHOD
/begin COMPU_METHOD E_ZK0_M_S7_S3 "" TAB_VERB "%12.6" "" COMPU_TAB_REF CONV_TAB_E_ZK0_M_S7_S3 /end COMPU_METHOD
/begin COMPU_METHOD E_ZK0FSTIN_M_S7_S3 "" TAB_VERB "%12.6" "" COMPU_TAB_REF CONV_TAB_E_ZK0FSTIN_M_S7_S3 /end COMPU_METHOD
/begin COMPU_METHOD E_ZMODUSIAE_M_S7_S3 "" TAB_VERB "%12.6" "" COMPU_TAB_REF CONV_TAB_E_ZMODUSIAE_M_S7_S3 /end COMPU_METHOD
/begin COMPU_METHOD E_ZMODUSIEP_M_S7_S3 "" TAB_VERB "%12.6" "" COMPU_TAB_REF CONV_TAB_E_ZMODUSIEP_M_S7_S3 /end COMPU_METHOD
/begin COMPU_METHOD E_ZNLLSOLL_M_S7_S3 "" TAB_VERB "%12.6" "" COMPU_TAB_REF CONV_TAB_E_ZNLLSOLL_M_S7_S3 /end COMPU_METHOD
/begin COMPU_METHOD E_ZNMODUS_M_S7_S3 "" TAB_VERB "%12.6" "" COMPU_TAB_REF CONV_TAB_E_ZNMODUS_M_S7_S3 /end COMPU_METHOD
/begin COMPU_METHOD n_fl_M_S7_S3 "Drehzahl" RAT_FUNC "%12.6" "1/min" COEFFS 0 1 0 0 0 1 /end COMPU_METHOD
/begin COMPU_METHOD n_int_M_S7_S3 "Drehzahl" RAT_FUNC "%5.0" "1/min" COEFFS 0 1 0 0 0 1 /end COMPU_METHOD
/begin COMPU_METHOD n_int_26_M_S7_S3 "Drehzahl" RAT_FUNC "%3.0" "1/min" COEFFS 0 1 0 0 0 1 /end COMPU_METHOD
/begin COMPU_METHOD ng_fl_M_S7_S3 "Drehzahlgradient" RAT_FUNC "%12.6" "1/min/s" COEFFS 0 1 0 0 0 1 /end COMPU_METHOD
/begin COMPU_METHOD p_fl_M_S7_S3 "Druck" RAT_FUNC "%12.6" "bar" COEFFS 0 1 0 0 0 1 /end COMPU_METHOD
/begin COMPU_METHOD phi_fl_M_S7_S3 "Winkel in rad" RAT_FUNC "%12.6" "rad" COEFFS 0 1 0 0 0 1 /end COMPU_METHOD
/begin COMPU_METHOD phigrad_fl_M_S7_S3 "Winkel in grad" RAT_FUNC "%12.6" "grad" COEFFS 0 1 0 0 0 1 /end COMPU_METHOD
/begin COMPU_METHOD ratio_fl_M_S7_S3 "Uebersetzungsverhaeltnis" RAT_FUNC "%12.6" "-" COEFFS 0 1 0 0 0 1 /end COMPU_METHOD
/begin COMPU_METHOD rel_int_M_S7_S3 "Relative Groesse" RAT_FUNC "%3.0" "%" COEFFS 0 1 0 0 0 1 /end COMPU_METHOD
/begin COMPU_METHOD st_int_M_S7_S3 "Zustandsgroesse" RAT_FUNC "%3.0" "-" COEFFS 0 1 0 0 0 1 /end COMPU_METHOD
/begin COMPU_METHOD st_int_25_M_S7_S3 "Zustandsgroesse" RAT_FUNC "%10.0" "-" COEFFS 0 1 0 0 0 1 /end COMPU_METHOD
/begin COMPU_METHOD st_int_g_M_S7_S3 "Zustandsgroesse" RAT_FUNC "%5.0" "-" COEFFS 0 1 0 0 0 1 /end COMPU_METHOD
/begin COMPU_METHOD st_int_l_M_S7_S3 "Zustandsgroesse" RAT_FUNC "%1.0" "-" COEFFS 0 1 0 0 0 1 /end COMPU_METHOD
/begin COMPU_METHOD sts_fl_M_S7_S3 "Status" RAT_FUNC "%12.6" "-" COEFFS 0 1 0 0 0 1 /end COMPU_METHOD
/begin COMPU_METHOD sts_int_M_S7_S3 "Status" RAT_FUNC "%3.0" "-" COEFFS 0 1 0 0 0 1 /end COMPU_METHOD
/begin COMPU_METHOD sts_int_e_M_S7_S3 "Status" RAT_FUNC "%1.0" "-" COEFFS 0 1 0 0 0 1 /end COMPU_METHOD
/begin COMPU_METHOD sts_int_m_M_S7_S3 "Status" RAT_FUNC "%10.0" "-" COEFFS 0 1 0 0 0 1 /end COMPU_METHOD
/begin COMPU_METHOD swi_int_M_S7_S3 "Schalter" RAT_FUNC "%1.0" "-" COEFFS 0 1 0 0 0 1 /end COMPU_METHOD
/begin COMPU_METHOD swi_int_o_M_S7_S3 "Schalter" RAT_FUNC "%3.0" "-" COEFFS 0 1 0 0 0 1 /end COMPU_METHOD
/begin COMPU_METHOD t_fl_M_S7_S3 "Zeit" RAT_FUNC "%12.6" "s" COEFFS 0 1 0 0 0 1 /end COMPU_METHOD
/begin COMPU_METHOD t_int_M_S7_S3 "Zeit" RAT_FUNC "%11.2" "s" COEFFS 0 1 0 0 0 0.01 /end COMPU_METHOD
/begin COMPU_METHOD t_int_n_M_S7_S3 "Zeit" RAT_FUNC "%6.2" "s" COEFFS 0 1 0 0 0 0.01 /end COMPU_METHOD
/begin COMPU_METHOD trq_fl_M_S7_S3 "Moment" RAT_FUNC "%5.0" "Nm" COEFFS 0 1 0 0 0 1 /end COMPU_METHOD
/begin COMPU_METHOD trq_fl_a_M_S7_S3 "Moment" RAT_FUNC "%12.6" "Nm" COEFFS 0 1 0 0 0 1 /end COMPU_METHOD
/begin COMPU_METHOD trq_int_M_S7_S3 "Moment" RAT_FUNC "%5.0" "Nm" COEFFS 0 1 0 0 0 1 /end COMPU_METHOD
/begin COMPU_METHOD trqg_fl_M_S7_S3 "Momentengradient" RAT_FUNC "%5.0" "Nm/s" COEFFS 0 1 0 0 0 1 /end COMPU_METHOD
/begin COMPU_METHOD trqg_fl_k_M_S7_S3 "Momentengradient" RAT_FUNC "%12.6" "Nm/s" COEFFS 0 1 0 0 0 1 /end COMPU_METHOD
/begin COMPU_METHOD trqg_int_M_S7_S3 "Momentengradient" RAT_FUNC "%5.0" "Nm/s" COEFFS 0 1 0 0 0 1 /end COMPU_METHOD
/begin COMPU_METHOD v_fl_M_S7_S3 "Geschwindigkeit" RAT_FUNC "%12.6" "km/h" COEFFS 0 1 0 0 0 1 /end COMPU_METHOD
/begin COMPU_METHOD v_int_M_S7_S3 "Geschwindigkeit" RAT_FUNC "%5.0" "km/h" COEFFS 0 1 0 0 0 1 /end COMPU_METHOD
/begin COMPU_METHOD vg_fl_M_S7_S3 "Geschwindigkeitsgradient" RAT_FUNC "%12.6" "km/h/s" COEFFS 0 1 0 0 0 1 /end COMPU_METHOD
/begin COMPU_METHOD void_fl_M_S7_S3 "ohne Umrechnung" RAT_FUNC "%12.6" "-" COEFFS 0 1 0 0 0 1 /end COMPU_METHOD
/begin COMPU_METHOD void_int_M_S7_S3 "ohne Umrechnung" RAT_FUNC "%3.0" "-" COEFFS 0 1 0 0 0 1 /end COMPU_METHOD
/begin COMPU_METHOD void_int_c_M_S7_S3 "ohne Umrechnung" RAT_FUNC "%5.0" "-" COEFFS 0 1 0 0 0 1 /end COMPU_METHOD
/begin COMPU_METHOD void_int_d_M_S7_S3 "ohne Umrechnung" RAT_FUNC "%1.0" "-" COEFFS 0 1 0 0 0 1 /end COMPU_METHOD
/begin COMPU_METHOD n_fl_S1_S7_S3 "Drehzahl" RAT_FUNC "%12.6" "1/min" COEFFS 0 1 0 0 0 1 /end COMPU_METHOD
/begin COMPU_METHOD n_int_S1_S7_S3 "Drehzahl" RAT_FUNC "%5.0" "1/min" COEFFS 0 1 0 0 0 1 /end COMPU_METHOD
/begin COMPU_METHOD ratio_int_S1_S7_S3 "Uebersetzungsverhaeltnis" RAT_FUNC "%6.3" "-" COEFFS 0 1 0 0 0 0.001 /end COMPU_METHOD
/begin COMPU_METHOD sts_fl_S1_S7_S3 "Status" RAT_FUNC "%12.6" "-" COEFFS 0 1 0 0 0 1 /end COMPU_METHOD
/begin COMPU_METHOD sts_int_S1_S7_S3 "Status" RAT_FUNC "%3.0" "-" COEFFS 0 1 0 0 0 1 /end COMPU_METHOD
/begin COMPU_METHOD swi_int_b_S1_S7_S3 "Schalter" RAT_FUNC "%3.0" "-" COEFFS 0 1 0 0 0 1 /end COMPU_METHOD
/begin COMPU_METHOD t_int_S1_S7_S3 "Zeit" RAT_FUNC "%6.2" "s" COEFFS 0 1 0 0 0 0.01 /end COMPU_METHOD
/begin COMPU_METHOD trq_fl_S1_S7_S3 "Moment" RAT_FUNC "%12.6" "Nm" COEFFS 0 1 0 0 0 1 /end COMPU_METHOD
/begin COMPU_METHOD trq_int_S1_S7_S3 "Moment" RAT_FUNC "%5.0" "Nm" COEFFS 0 1 0 0 0 1 /end COMPU_METHOD
/begin COMPU_METHOD void_fl_S1_S7_S3 "ohne Umrechnung" RAT_FUNC "%12.6" "-" COEFFS 0 1 0 0 0 1 /end COMPU_METHOD
/begin COMPU_VTAB CONV_TAB_E_BREMSPED_M_S7_S3 "Conversion table" TAB_VERB 2 0 "NICHT_GETRETEN" 1 "GETRETEN" /end COMPU_VTAB
/begin COMPU_VTAB CONV_TAB_E_DREHRICH_M_S7_S3 "Conversion table" TAB_VERB 3 0 "UNBESTIMMT" 1 "VORWAERTS" 2 "RUECKWAERTS" /end COMPU_VTAB
/begin COMPU_VTAB CONV_TAB_E_FEHLERIEP_M_S7_S3 "Conversion table" TAB_VERB 2 0 "NORMALBETRIEB" 1 "FEHLER" /end COMPU_VTAB
/begin COMPU_VTAB CONV_TAB_E_HYBFKT_M_S7_S3 "Conversion table" TAB_VERB 14 0 "PASSIV" 1 "ANKOPPELN_VM" 3 "GANGEINLEGEN" 4 "GANGAUSLEGEN" 5 "OHNABLAUFFKT" 7 "VM_ZUSTART" 8 "ABSTELLEN_VM" 9 "NICHTDEFINIERT_4" 10 "VM_SCHLEPPSTART" 11 "VM_NOTSTART" 12 "VM_EIN" 13 "VM_AUS" 14 "ABSTELLPOSOPT_VM" 15 "FEHLER" /end COMPU_VTAB
/begin COMPU_VTAB CONV_TAB_E_MODUSEFAH_M_S7_S3 "Conversion table" TAB_VERB 2 0 "LADUNG_ABBAUEN" 1 "LADUNG_ERHALTEN" /end COMPU_VTAB
/begin COMPU_VTAB CONV_TAB_E_POS_M_S7_S3 "Conversion table" TAB_VERB 9 0 "D1" 1 "D2" 2 "D3" 3 "D4" 4 "D5" 5 "D" 6 "N" 7 "R" 8 "P" /end COMPU_VTAB
/begin COMPU_VTAB CONV_TAB_E_SIGSTATUS_M_S7_S3 "Conversion table" TAB_VERB 3 0 "SIGNAL_OK" 1 "ERSATZWERT" 2 "SIGNAL_FEHLER" /end COMPU_VTAB
/begin COMPU_VTAB CONV_TAB_E_STAK0BEF_M_S7_S3 "Conversion table" TAB_VERB 4 0 "NICHT_AKTIV" 1 "STANDARD_BEF" 2 "OPTIMIERTBEF" 3 "REDUZIERTBEF" /end COMPU_VTAB
/begin COMPU_VTAB CONV_TAB_E_STATUSABS_M_S7_S3 "Conversion table" TAB_VERB 3 1 "AKTIV" 0 "NICHT_AKTIV" 2 "FEHLER" /end COMPU_VTAB
/begin COMPU_VTAB CONV_TAB_E_STATUSADA_M_S7_S3 "Conversion table" TAB_VERB 3 0 "KEINADAPTION" 1 "TOUCHPOINT_ADAPTION" 2 "REIBWERT_ADAPTION" /end COMPU_VTAB
/begin COMPU_VTAB CONV_TAB_E_STATUSASR_M_S7_S3 "Conversion table" TAB_VERB 2 0 "NICHT_AKTIV" 1 "AKTIV" /end COMPU_VTAB
/begin COMPU_VTAB CONV_TAB_E_STATUSCK0_M_S7_S3 "Conversion table" TAB_VERB 3 0 "NORMAL" 1 "ZU_HEISS" 2 "UEBERHITZT" /end COMPU_VTAB
/begin COMPU_VTAB CONV_TAB_E_STATUSIAE_M_S7_S3 "Conversion table" TAB_VERB 9 0 "NICHTDEFINIERT" 1 "OFFEN" 2 "ANGELEGT" 3 "ANFAHREN" 4 "ENTKOPPELT" 5 "ENTKOPPELT_ANFAHREN" 6 "SYNCHRONISIEREN" 7 "GESCHLOSSEN" 8 "OEFFNEN" /end COMPU_VTAB
/begin COMPU_VTAB CONV_TAB_E_STATUSIEP_M_S7_S3 "Conversion table" TAB_VERB 5 0 "AUS" 1 "SLEEP" 2 "LP1" 3 "LP2" 4 "LP3" /end COMPU_VTAB
/begin COMPU_VTAB CONV_TAB_E_STATUSK0_M_S7_S3 "Conversion table" TAB_VERB 6 0 "OFFEN" 1 "ANGELEGT" 2 "DRUCKSTELLUNG" 3 "SCHLUPFGEREGELT" 4 "GEREGELTGESCHL" 5 "GESCHLOSSEN" /end COMPU_VTAB
/begin COMPU_VTAB CONV_TAB_E_STATUSKSL_M_S7_S3 "Conversion table" TAB_VERB 7 0 "KEIN_KRAFTSCHLUSS" 1 "VORW_AUF_ABBAUEND" 2 "VORWAERTS" 3 "RUECKW_AUF_ABBAUEND" 4 "RUECKWAERTS" 5 "VORWAERTS_SCHLUPF" 6 "RUECKWAERTS_SCHLUPF" /end COMPU_VTAB
/begin COMPU_VTAB CONV_TAB_E_STATUSNAA_M_S7_S3 "Conversion table" TAB_VERB 2 0 "NICHT_AKTIV" 1 "AKTIV" /end COMPU_VTAB
/begin COMPU_VTAB CONV_TAB_E_STATUSPSY_M_S7_S3 "Conversion table" TAB_VERB 5 0 "AUS" 1 "NICHTDEFINIERT" 2 "LP1" 3 "LP2" 4 "LP3" /end COMPU_VTAB
/begin COMPU_VTAB CONV_TAB_E_STATUSRSE_M_S7_S3 "Conversion table" TAB_VERB 2 0 "KEIN_RADSCHLUPF" 1 "DURCHDREHEN_ERKANNT" /end COMPU_VTAB
/begin COMPU_VTAB CONV_TAB_E_STBZHAS_M_S7_S3 "Conversion table" TAB_VERB 16 0 "INIT_INAKTIV" 1 "ANGEKOPPELT" 2 "ENTKOPPELT" 3 "EFAHREN" 4 "STOP" 5 "LADEN" 6 "ENTK_VMEIN" 7 "EFAHREN_VMEIN" 8 "HYBRID" 9 "NICHTDEFINIERT_1" 10 "NICHTDEFINIERT_2" 11 "NICHTDEFINIERT_3" 12 "NICHTDEFINIERT_4" 13 "NICHTDEFINIERT_5" 14 "INIT_KL15" 15 "FEHLER" /end COMPU_VTAB
/begin COMPU_VTAB CONV_TAB_E_ZIEP_M_S7_S3 "Conversion table" TAB_VERB 5 0 "AUS" 1 "SLEEP" 2 "LP1" 3 "LP2" 4 "LP3" /end COMPU_VTAB
/begin COMPU_VTAB CONV_TAB_E_ZK0_M_S7_S3 "Conversion table" TAB_VERB 6 0 "OEFFNENSW" 1 "BEFUELLEN" 2 "DRUCKSTELLUNG" 3 "SCHLUPFREGELUNG" 4 "GEREGELTGESCHL" 5 "GESCHLOSSEN" /end COMPU_VTAB
/begin COMPU_VTAB CONV_TAB_E_ZK0FSTIN_M_S7_S3 "Conversion table" TAB_VERB 4 0 "OFFEN" 1 "SCHLUPFGEREGELT" 2 "GEREGELTGESCHL" 3 "GESCHLOSSEN" /end COMPU_VTAB
/begin COMPU_VTAB CONV_TAB_E_ZMODUSIAE_M_S7_S3 "Conversion table" TAB_VERB 3 0 "EFAHREN_SCHLUPF" 1 "EFAHREN_KRAFTSCHL" 2 "HYBRIDFAHREN" /end COMPU_VTAB
/begin COMPU_VTAB CONV_TAB_E_ZMODUSIEP_M_S7_S3 "Conversion table" TAB_VERB 5 0 "KEINVORGABE" 1 "AUS" 2 "LP1" 3 "LP2" 4 "LP3" /end COMPU_VTAB
/begin COMPU_VTAB CONV_TAB_E_ZNLLSOLL_M_S7_S3 "Conversion table" TAB_VERB 4 0 "KEINANF" 1 "ANF_ADAP" 2 "ANF_ALLG" 3 "ANF_ADAP_IEP" /end COMPU_VTAB
/begin COMPU_VTAB CONV_TAB_E_ZNMODUS_M_S7_S3 "Conversion table" TAB_VERB 5 0 "KEIN_AUFBAU" 1 "SCHNELL" 2 "ZUEGIG" 3 "KOMFORTABEL" 4 "UNTERDRUECKT" /end COMPU_VTAB
/begin FUNCTION SFSBo9_SBEo_K0 ""
 /begin DEF_CHARACTERISTIC KL_MSMOT_KPS_HAS_Y KL_MSMOT_KPS_HAS_X SWI_K0SBEDABS_KPS_HAS SWI_K0SBEDASR_KPS_HAS T_VK0SREGABS_KPS_HAS T_VK0SREGASR_KPS_HAS MS_WUNSCHK0SBEDNGEM1_KPS_HAS MS_WUNSCHK0SBEDNGEM2_KPS_HAS NOS_EMK0SBEDNGEM1_KPS_HAS NOS_EMK0SBEDNGEM2_KPS_HAS MO_MOT_KPS_HAS SWI_K0SCHLUPFBED_PN_HAS TAB_K0SCHLUPFBED_IAE_HAS TAB_ZK0FSTSBE_HAS /end DEF_CHARACTERISTIC
 /begin LOC_MEASUREMENT z_k0schlupfbed_mmotiae_kps z_k0schlupfbed_abs_kps z_k0schlupfbed_iae_has z_k0schlupfbed_ngem_kps m_k0_mod_has_fkt m_max_em_has_fkt m_max_iae_has_fkt m_min_em_has_fkt m_soll_em_has_fkt m_soll_k0_has_fkt m_soll_res_em_has_fkt mg_soll_k0_has_fkt n_soll_em_has_fkt n_soll_vm_has_fkt nd_min_saf_has_fkt nd_soll_iae_fkt st_ablauf_fkt status_ablauf_has_fkt z_ablauf_svh_reset_has_fkt z_ablaufvariante_kalt_zus z_emaktiv_fuw_zus_fkt z_fehler15_eh_fkt z_k0_befuellopt_has_fkt z_k0_has_fkt z_m_max_iae_has_fkt z_m_soll_em_has_fkt z_n_soll_em_has_fkt z_n_soll_vm_has_fkt z_p_hys_k0_has_fkt z_ponr_fkt z_respschlepp_sas_fkt z_saf_has_fkt z_sbe_has_fkt z_zuendfreigabe_vm_fkt z_zuendfreigabe_vm_has_fkt z_modus_em_hst_in c_getriebe_egs_in istgang_egs_in m_em_in m_iae_in m_k0_in m_max_dyn_em_in m_soll_em_hst_in m_soll_vm_hst_in m_vm_in m_vm_start_in m_wunsch_fpw_in n_ab_egs_in n_em_in n_soll_ll_vm_in n_t_egs_in n_vm_in osmode_next_in p_bremse_fzg_in sollgang_egs_in status_fehler_iep_in status_iae_in status_iep_in status_k0_in pos_egs_in z_ablauf_has_hst_in z_ablaufvariante_has_hst_in zielgang_egs_in z_k0_fst_in m_mot_in status_iae_adap_in z_diag_ersfkt_has_in z_diag_ersfkt_hi_has_in z_diag_notgang_has_in status_k0_adap_in status_waschstr_in status_kraftfluss_egs_in z_n_min_em_parksp_has_in n_mot_soll_iae_in status_alaengs_adaoff_in gangwechsel_egs_in z_nllsoll_iae_in status_nem_in status_nvm_in kolbenpos_k0_in z_kps_stada_in t_betrieb_pvu_has_ee_in status_ll_vm_in z_msa_fst_in m_min_dyn_em_in phi_neigung_in v_f_in drehrichtung_nem_in fpw_in drehrichtung_nab_in schalt_mode_egs_in m_ziel_k0_hst_in status_kraftfluss_lev2_egs_in i_gang_lev2_egs_in status_c_k0_in bremspedal_in status_autohold_in status_hillhold_in status_vf_in v_f_ref_in status_vfref_in z_diag_ersfkt_hi_96_has_in status_k0_adap_zaehler_in status_k0_befuellung_in z_oea_hst_in z_iep_in z_nllsoll_iep_in c_vm_in n_soll_em_hst_in abstellpos_vm_in abstellpos_vm_status_in status_nreg_em_hst_in m_min_vm_in m_soll_vm_l_hst_in z_msa_stada_in m_wunsch_fpw_hst_in status_getrbereit_in status_betriebsbereit_hst_in status_sa_vm_in z_ba_has_vm_hst_in z_ba_has_k0_hst_in status_abs_in status_asr_in modus_e_fahren_hst_in status_kl15_in status_posvueb_in soc_in status_soc_in c_umgebung_in status_cumgebung_in /end LOC_MEASUREMENT
 /begin SUB_FUNCTION SFSBo124_K0_Sollmoment /end SUB_FUNCTION
/end FUNCTION
/begin FUNCTION SFSBo93_Erkennung_Notgang "" /begin DEF_CHARACTERISTIC TAB_ZDIAGNOTGANG_BMI_HAS /end DEF_CHARACTERISTIC /begin LOC_MEASUREMENT z_diag_notgang_has_in /end LOC_MEASUREMENT /end FUNCTION
/begin FUNCTION SFSTA12_Driveline_act_Generator ""
 /begin LOC_MEASUREMENT st_ziel_bz_has_stg st_ist_bz_has_stg status_ablauf_has_fkt status_betriebsbereit_hst_in /end LOC_MEASUREMENT
/end FUNCTION
/begin FUNCTION SFSTA13_Driveline_req_Generator ""
 /begin DEF_CHARACTERISTIC KF_STSOLLBZHASHST_ZUL_HAS_W KF_STSOLLBZHASHST_ZUL_HAS_X KF_STSOLLBZHASHST_ZUL_HAS_Y Z_STSOLLBZHSTMIN_HAS /end DEF_CHARACTERISTIC
 /begin LOC_MEASUREMENT st_ist_bz_has_stg istgang_egs_in n_ab_egs_in z_ablaufvariante_has_hst_in status_kraftfluss_egs_in status_betriebsbereit_hst_in z_ba_has_vm_hst_in z_ba_has_k0_hst_in /end LOC_MEASUREMENT
 /begin SUB_FUNCTION SFSTA18_Subsystem /end SUB_FUNCTION
/end FUNCTION
/begin FUNCTION SFSTA15_Init_Detection "" /begin LOC_MEASUREMENT status_betriebsbereit_hst_in /end LOC_MEASUREMENT /end FUNCTION
/begin FUNCTION SFSTA18_Subsystem ""
 /begin LOC_MEASUREMENT st_ist_bz_has_stg istgang_egs_in n_ab_egs_in z_ablaufvariante_has_hst_in /end LOC_MEASUREMENT
/end FUNCTION
/begin FUNCTION SFSTA2_FSTAPA_ProjektAllgemein "" /begin DEF_CHARACTERISTIC T_VZABLAUFREINIT_HAS /end DEF_CHARACTERISTIC
 /begin LOC_MEASUREMENT z_nvmsollbegr_frk_dihi z_statuspsysmps_frk_dihi z_nminemnull_frk_dihi z_emfehler_frk_dihi z_ablaufreinit_frk_dihi z_k0syncmk0erh_frk_dihi z_fuwdeakt_frk_dihi z_nemmin_frk_dihi z_vmstopverbot_frk_dihi z_vmstartverbot_frk_dihi z_zust_halten_frk_dihi z_zust_init_frk_dihi z_deaktiv_abo_frk_dihi z_vmstartanf_frk_dihi z_svh_frk_dihi z_iepein_frk_dihi z_nsollvmnull_frk_dihi z_ala_frk_dihi z_schaltprioverh_frk_dihi z_nsollvmanh_frk_dihi z_gebruefahrenaus_frk_dihi z_hybfkt_stg st_ziel_bz_has_stg st_ist_bz_has_stg st_ist_hcomd_has_stg z_ablauf_has_stg z_ablaufvariante_has_stg z_modus_em_hst_in c_getriebe_egs_in istgang_egs_in m_em_in m_iae_in m_k0_in m_max_dyn_em_in m_soll_em_hst_in m_soll_vm_hst_in m_vm_in m_vm_start_in m_wunsch_fpw_in n_ab_egs_in n_em_in n_soll_ll_vm_in n_t_egs_in n_vm_in osmode_next_in p_bremse_fzg_in sollgang_egs_in status_fehler_iep_in status_iae_in status_iep_in status_k0_in pos_egs_in z_ablauf_has_hst_in z_ablaufvariante_has_hst_in zielgang_egs_in z_k0_fst_in m_mot_in status_iae_adap_in z_diag_ersfkt_has_in z_diag_ersfkt_hi_has_in z_diag_notgang_has_in status_k0_adap_in status_waschstr_in status_kraftfluss_egs_in z_n_min_em_parksp_has_in n_mot_soll_iae_in status_alaengs_adaoff_in gangwechsel_egs_in z_nllsoll_iae_in status_nem_in status_nvm_in kolbenpos_k0_in z_kps_stada_in t_betrieb_pvu_has_ee_in status_ll_vm_in z_msa_fst_in m_min_dyn_em_in phi_neigung_in v_f_in drehrichtung_nem_in fpw_in drehrichtung_nab_in schalt_mode_egs_in m_ziel_k0_hst_in status_kraftfluss_lev2_egs_in i_gang_lev2_egs_in status_c_k0_in bremspedal_in status_autohold_in status_hillhold_in status_vf_in v_f_ref_in status_vfref_in z_diag_ersfkt_hi_96_has_in status_k0_adap_zaehler_in status_k0_befuellung_in z_oea_hst_in z_iep_in z_nllsoll_iep_in c_vm_in n_soll_em_hst_in abstellpos_vm_in abstellpos_vm_status_in status_nreg_em_hst_in m_min_vm_in m_soll_vm_l_hst_in z_msa_stada_in m_wunsch_fpw_hst_in status_getrbereit_in status_betriebsbereit_hst_in status_sa_vm_in z_ba_has_vm_hst_in z_ba_has_k0_hst_in status_abs_in status_asr_in modus_e_fahren_hst_in status_kl15_in status_posvueb_in soc_in status_soc_in c_umgebung_in status_cumgebung_in /end LOC_MEASUREMENT
/end FUNCTION
/begin FUNCTION SSAi100_Bitwise_AND_ui8_1 "" /begin LOC_MEASUREMENT status_fzg_rollverhinderung_portin /end LOC_MEASUREMENT /end FUNCTION
/begin FUNCTION SSAi107_z_msa_fst "" /begin DEF_CHARACTERISTIC SWI_Z_MSA_FST_ERSATZ_HAS Z_MSA_FST_ERSATZ_HAS /end DEF_CHARACTERISTIC /begin LOC_MEASUREMENT z_msa_fst_avh_portin z_msa_fst_eaf_portin /end LOC_MEASUREMENT /end FUNCTION
/begin FUNCTION SSAi108_z_msa_fst1 "" /begin DEF_CHARACTERISTIC SWI_Z_MSA_FST_ERSATZ_HAS Z_MSA_FST_ERSATZ_HAS /end DEF_CHARACTERISTIC /begin LOC_MEASUREMENT z_msa_fst_avh_portin /end LOC_MEASUREMENT /end FUNCTION
/begin FUNCTION SSAi114_Bitwise_OR_ui8_ "" /begin LOC_MEASUREMENT z_msa_stada_in /end LOC_MEASUREMENT /end FUNCTION
/begin FUNCTION SSAi121_status_betriebsbereitschaft_hst "" /begin DEF_CHARACTERISTIC STATUS_BETRIEBSBER_ERS_HAS SWI_STATUS_BETRIEBSBER_ERS_HAS /end DEF_CHARACTERISTIC /begin LOC_MEASUREMENT status_betriebsber_hst_portin status_fahranf_hst_portin /end LOC_MEASUREMENT /begin SUB_FUNCTION SSAi130_If_Action SSAi129_Else_Action /end SUB_FUNCTION /end FUNCTION
/begin FUNCTION SSAi129_Else_Action "" /begin LOC_MEASUREMENT status_fahranf_hst_portin /end LOC_MEASUREMENT /begin SUB_FUNCTION SSAi131_Bitwise_AND_ui32_ /end SUB_FUNCTION /end FUNCTION
/begin FUNCTION SSAi130_If_Action "" /begin DEF_CHARACTERISTIC STATUS_BETRBER_AUS_HAS STATUS_BETRBER_EIN_HAS /end DEF_CHARACTERISTIC /begin LOC_MEASUREMENT status_betriebsber_hst_portin /end LOC_MEASUREMENT /end FUNCTION
/begin FUNCTION SSAi131_Bitwise_AND_ui32_ "" /begin LOC_MEASUREMENT status_fahranf_hst_portin /end LOC_MEASUREMENT /end FUNCTION
/begin FUNCTION SSAi2_SAiEEP_EEProm ""
 /begin LOC_MEASUREMENT c_getriebe_egs_portin istgang_egs_portin m_em_portin m_iae_portin m_k0_portin m_max_dyn_em_portin m_soll_em_hst_portin m_soll_vm_hst_portin m_vm_portin m_vm_start_portin m_wunsch_fpw_portin n_ab_egs_portin n_em_portin n_soll_ll_vm_portin n_t_egs_portin n_vm_portin osmode_next_portin p_bremse_fzg_portin sollgang_egs_portin status_fehler_iep_portin status_iae_portin status_iep_portin status_k0_portin status_kraftschl_atsys_portin z_ablauf_has_hst_portin z_ablaufvariante_has_hst_portin zielgang_egs_portin z_k0_fst_portin z_iep_anf_portin m_mot_portin status_iae_adap_portin z_diag_ersfkt_has_portin z_diag_ersfkt_hi_has_portin z_diag_notgang_has_portin status_k0_adap_portin status_waschstr_portin z_n_min_em_parksp_has_portin n_mot_soll_iae_portin status_alaengs_adaoff_portin gangwechsel_egs_portin z_nllsoll_iae_portin status_nem_portin pos_egs_portin status_nvm_portin kolbenpos_k0_portin z_kps_stada_portin t_betrieb_pvu_has_ee_portin status_ee_busy_portin z_msa_fst_avh_portin z_msa_fst_eaf_portin m_min_dyn_em_portin status_phineigung_portin phi_neigung_portin v_f_portin drehrichtung_nem_portin fpw_portin drehrichtung_nab_portin schalt_mode_egs_portin status_kraftfluss_lev2_egs_portin i_gang_lev2_egs_portin status_c_k0_portin bremspedal_portin status_fzg_rollverhinderung_portin status_vf_portin v_f_ref_portin status_vfref_portin z_diag_ersfkt_hi_96_has_portin status_k0_adapf_zaehler_portin status_k0_adatsf_zaehler_portin status_k0_befuellung_portin z_oea_hst_portin m_soll_vm_l_hst_portin m_wunsch_fpw_hst_portin status_nreg_em_hst_portin c_vm_portin m_min_vm_portin n_soll_em_hst_portin abstellpos_vm_portin abstellpos_vm_status_portin z_msa_stada_avh_portin z_msa_stada_eaf_portin status_getrbereit_portin m_ziel_k0_hst_portin /end LOC_MEASUREMENT
/end FUNCTION
/begin FUNCTION SSAi3_SAiPA_ProjektAllgemein ""
 /begin DEF_CHARACTERISTIC KL_ABLAUFVARIANTE_HAS_HST_IN_Y KL_ABLAUFVARIANTE_HAS_HST_IN_X STATUS_LLVM_ERSATZ_HAS ABSTELLPOS_VM_ERSATZ_HAS SWI_ABSTELLPOS_VM_ERSATZ_HAS ABSTELLPOS_VM_STS_ERS_HAS SWI_ABSTELLPOS_VM_STS_ERS_HAS BREMSPEDAL_ERSATZ_HAS SWI_BREMSPEDAL_ERSATZ_HAS C_GETRIEBEEGS_ERSATZ_HAS C_GETRIEBE_OFFSET SWI_C_GETRIEBEEGS_ERSATZ_HAS CO_VM_HAS C_VM_ERSATZ_HAS SWI_C_VM_ERSATZ_HAS DREHRICHTUNG_NAB_ERSATZ_HAS SWI_DREHRICHTUNG_NAB_ERSATZ_HAS DREHRICHTUNG_NEM_ERSATZ_HAS SWI_DREHRICHTUNG_NEM_ERSATZ_HAS FPW_ERSATZ_HAS SWI_FPW_ERSATZ_HAS GANGWECHSEL_EGS_ERSATZ_HAS SWI_GANGWECHSEL_EGS_ERSATZ_HAS I_GANG_LEV2_EGS_ERSATZ_HAS SWI_I_GANG_LEV2_EGS_ERSATZ_HAS ISTGANG_EGS_ERSATZ_HAS SWI_ISTGANG_EGS_ERSATZ_HAS KOLBENPOS_FAKTOR KOLBENPOS_K0_ERS_HAS SWI_KOLBENPOS_K0_ERS_HAS M_EM_ERSATZ_HAS SWI_M_EM_ERSATZ_HAS M_IAE_ERSATZ_HAS SWI_M_IAE_ERSATZ_HAS M_K0_ERSATZ_HAS SWI_M_K0_ERSATZ_HAS M_MAXDYNEM_ERSATZ_HAS SWI_M_MAXDYNEM_ERSATZ_HAS M_MINDYNEM_ERSATZ_HAS SWI_M_MINDYNEM_ERSATZ_HAS M_MINVM_ERSATZ_HAS SWI_M_MINVM_ERSATZ_HAS M_MOT_ERSATZ_HAS SWI_M_MOT_ERSATZ_HAS M_SOLLEMHST_ERSATZ_HAS SWI_M_SOLLEMHST_ERSATZ_HAS M_SOLLVMHST_ERSATZ_HAS SWI_M_SOLLVMHST_ERSATZ_HAS M_SOLLVMLHST_ERSATZ_HAS SWI_M_SOLLVMLHST_ERSATZ_HAS M_VM_ERSATZ_HAS SWI_M_VM_ERSATZ_HAS M_VMSTART_ERSATZ_HAS SWI_M_VMSTART_ERSATZ_HAS M_WUNSCHFPW_ERSATZ_HAS SWI_M_WUNSCHFPW_ERSATZ_HAS M_WUNSCHFPWHST_ERSATZ_HAS SWI_M_WUNSCHFPWHST_ERSATZ_HAS SWI_M_WUNSCHFPWHST_IN_HAS T_MSOLLEMHST_HAS T_MSOLLVMHST_HAS M_ZIELK0HST_ERSATZ_HAS SWI_M_ZIELK0HST_ERSATZ_HAS N_ABEGS_ERSATZ_HAS SWI_N_ABEGS_ERSATZ_HAS N_EM_ERSATZ_HAS SWI_NEM_FEHLERWERTNULL_HAS SWI_N_EM_ERSATZ_HAS N_MOT_SOLL_IAE_ERSATZ_HAS SWI_N_MOT_SOLL_IAE_ERSATZ_HAS N_SOLLEMHST_ERSATZ_HAS SWI_N_SOLLEMHST_ERSATZ_HAS N_SOLLLLVM_ERSATZ_HAS SWI_N_SOLLLLVM_ERSATZ_HAS N_TEGS_ERSATZ_HAS SWI_N_TEGS_ERSATZ_HAS N_VM_ERSATZ_HAS SWI_N_VM_ERSATZ_HAS OSMODE_NEXT_ERSATZ_HAS SWI_OSMODE_NEXT_ERSATZ_HAS P_BREMSEFZG_ERSATZ_HAS SWI_P_BREMSEFZG_ERSATZ_HAS PHI_NEIGUNG_ERSATZ_HAS SWI_PHI_NEIGUNG_ERSATZ_HAS POS_EGS_ERSATZ_HAS SWI_POS_EGS_ERSATZ_HAS SCHALT_MODE_EGS_ERSATZ_HAS SWI_SCHALT_MODE_EGS_ERSATZ_HAS SOLLGANG_EGS_ERSATZ_HAS SWI_SOLLGANG_EGS_ERSATZ_HAS STATUS_ALAENGS_ADAO_ERS_HAS SWI_STATUS_ALAENGS_ADAO_ERS_HAS STATUS_C_K0_ERSATZ_HAS SWI_STATUS_C_K0_ERSATZ_HAS STATUS_FEHLER_IEP_ERSATZ_HAS SWI_STATUS_FEHLER_IEP_ERS_HAS STATUS_AUTOHOLD_ERSATZ_HAS STATUS_HILLHOLD_ERSATZ_HAS SWI_STATUS_AUTOHOLD_ERSATZ_HAS SWI_STATUS_HILLHOLD_ERSATZ_HAS STATUS_GETRBEREIT_ERS_HAS SWI_STATUS_GETRBEREIT_ERS_HAS STATUS_IAE_ERSATZ_HAS SWI_STATUS_IAE_ERSATZ_HAS STATUS_IAE_ADAP_ERSATZ_HAS SWI_STATUS_IAE_ADAP_ERSATZ_HAS STATUS_IEP_ERSATZ_HAS SWI_STATUS_IEP_ERSATZ_HAS STATUS_K0_ERSATZ_HAS SWI_STATUS_K0_ERSATZ_HAS STATUS_K0_ADAP_ERSATZ_HAS SWI_STATUS_K0_ADAP_ERSATZ_HAS STATUS_K0ADAPZAEHLER_ERSATZ_HAS SWI_STATUS_K0ADAPZAEHLER_ERSATZ_HAS STATUS_K0BEFUELLUNG_ERSATZ_HAS SWI_STATUS_K0BEFUELLUNG_ERSATZ_HAS STATUS_KRAFTFLUSS_LEV2_ERS_HAS SWI_STATUS_KRAFTFLUSS_LEV2_ERS_HAS STATUS_KRAFTFLUSS_ERS_HAS SWI_STATUS_KRAFTFLUSS_ERS_HAS STATUS_NEM_ERSATZ_HAS SWI_STATUS_NEM_ERSATZ_HAS STATUS_NREGEMHST_ERSATZ_HAS SWI_STATUS_NREGEMHST_ERSATZ_HAS STATUS_NVM_ERSATZ_HAS SWI_STATUS_NVM_ERSATZ_HAS STATUS_VF_ERSATZ_HAS SWI_STATUS_VF_ERSATZ_HAS STATUS_VFREF_ERSATZ_HAS SWI_STATUS_VFREF_ERSATZ_HAS STATUS_WASCHSTR_ERSATZ_HAS SWI_STATUS_WASCHSTR_ERSATZ_HAS SWI_T_BETRIEB_PVU_EE_ERSATZ_HAS T_BETRIEB_PVU_EE_ERSATZ_HAS SWI_V_F_ERSATZ_HAS V_F_ERSATZ_HAS SWI_V_FREF_ERSATZ_HAS V_FREF_ERSATZ_HAS SWI_Z_ABLAUFHASHST_ERSATZ_HAS Z_ABLAUFHASHST_ERSATZ_HAS SWI_Z_ABLAUFVARIANTE_ERS_HAS Z_ABLAUFVARIANTE_ERS_HAS SWI_Z_DIAG_ERSFKT_ERS_HAS Z_DIAG_ERSFKT_ERS_HAS SWI_Z_DIAG_ERSFKT_HI_96_ERS_HAS Z_DIAG_ERSFKT_HI_96_ERS_HAS SWI_Z_DIAG_ERSFKT_HI_ERS_HAS Z_DIAG_ERSFKT_HI_ERS_HAS SWI_Z_DIAG_NOTGANG_HAS_ERS_HAS Z_DIAG_NOTGANG_HAS_ERS_HAS SWI_Z_IEP_ERSATZ_HAS Z_IEP_ERSATZ_HAS SWI_Z_K0_FST_ERSATZ_HAS Z_K0_FST_ERSATZ_HAS SWI_Z_KPS_STADA_ERSATZ_HAS Z_KPS_STADA_ERSATZ_HAS SWI_Z_MSA_STADA_ERSATZ_HAS Z_MSA_STADA_ERSATZ_HAS SWI_Z_NMINEMPARKSP_ERS_HAS Z_NMINEMPARKSP_ERS_HAS SWI_Z_NLLSOLL_IAE_ERS_HAS Z_NLLSOLL_IAE_ERS_HAS SWI_Z_OEA_HST_ERSATZ_HAS Z_OEA_HST_ERSATZ_HAS SWI_ZIELGANG_EGS_ERSATZ_HAS ZIELGANG_EGS_ERSATZ_HAS /end DEF_CHARACTERISTIC
 /begin LOC_MEASUREMENT m_em_in_azg m_k0_in_azg m_max_dyn_em_in_azg m_vm_in_azg m_soll_em_hst_verz m_soll_vm_hst_verz n_em_in_azg n_vm_in_azg c_getriebe_egs_portin istgang_egs_portin m_em_portin m_iae_portin m_k0_portin m_max_dyn_em_portin m_soll_em_hst_portin m_soll_vm_hst_portin m_vm_portin m_vm_start_portin m_wunsch_fpw_portin n_ab_egs_portin n_em_portin n_soll_ll_vm_portin n_t_egs_portin n_vm_portin osmode_next_portin p_bremse_fzg_portin sollgang_egs_portin status_fehler_iep_portin status_iae_portin status_iep_portin status_k0_portin status_kraftschl_atsys_portin z_ablauf_has_hst_portin z_ablaufvariante_has_hst_portin zielgang_egs_portin z_k0_fst_portin z_iep_anf_portin m_mot_portin status_iae_adap_portin z_diag_ersfkt_has_portin z_diag_ersfkt_hi_has_portin z_diag_notgang_has_portin status_k0_adap_portin status_waschstr_portin z_n_min_em_parksp_has_portin n_mot_soll_iae_portin status_alaengs_adaoff_portin gangwechsel_egs_portin z_nllsoll_iae_portin status_nem_portin pos_egs_portin status_nvm_portin kolbenpos_k0_portin z_kps_stada_portin t_betrieb_pvu_has_ee_portin status_ee_busy_portin z_msa_fst_avh_portin z_msa_fst_eaf_portin m_min_dyn_em_portin status_phineigung_portin phi_neigung_portin v_f_portin drehrichtung_nem_portin fpw_portin drehrichtung_nab_portin schalt_mode_egs_portin status_kraftfluss_lev2_egs_portin i_gang_lev2_egs_portin status_c_k0_portin bremspedal_portin status_fzg_rollverhinderung_portin status_vf_portin v_f_ref_portin status_vfref_portin z_diag_ersfkt_hi_96_has_portin status_k0_adapf_zaehler_portin status_k0_adatsf_zaehler_portin status_k0_befuellung_portin z_oea_hst_portin m_soll_vm_l_hst_portin m_wunsch_fpw_hst_portin status_nreg_em_hst_portin c_vm_portin m_min_vm_portin n_soll_em_hst_portin abstellpos_vm_portin abstellpos_vm_status_portin z_msa_stada_avh_portin z_msa_stada_eaf_portin status_getrbereit_portin m_ziel_k0_hst_portin m_soll_em_hst_in m_soll_vm_hst_in /end LOC_MEASUREMENT
 /begin SUB_FUNCTION Run_SSAi89_cDelay_m_soll_em Run_SSAi90_cDelay_m_soll_vm SSAi107_z_msa_fst SSAi108_z_msa_fst1 SSAi99_Bitwise_AND_ui8_ SSAi100_Bitwise_AND_ui8_1 SSAi114_Bitwise_OR_ui8_ /end SUB_FUNCTION
/end FUNCTION
/begin FUNCTION SSAi4_SAiPS_ProjektSpezifisch ""
 /begin DEF_CHARACTERISTIC C_UMGEBUNG_ERSATZ_HAS SWI_C_UMGEBUNG_ERSATZ_HAS MODUS_EFAHRENHST_ERSATZ_HAS SWI_MODUS_EFAHRENHST_ERSATZ_HAS SOC_ERSATZ_HAS SWI_SOC_ERSATZ_HAS STATUS_ABS_ERSATZ_HAS SWI_STATUS_ABS_ERSATZ_HAS STATUS_ASR_ERSATZ_HAS SWI_STATUS_ASR_ERSATZ_HAS STATUS_CUMGEBUNG_ERSATZ_HAS SWI_STATUS_CUMGEBUNG_ERSATZ_HAS STATUS_POSVUEB_ERSATZ_HAS SWI_STATUS_POSVUEB_ERSATZ_HAS STATUS_SAVM_ERSATZ_HAS SWI_STATUS_SAVM_ERSATZ_HAS STATUS_SOC_ERSATZ_HAS SWI_STATUS_SOC_ERSATZ_HAS SWI_Z_BAHASK0HST_ERSATZ_HAS Z_BAHASK0HST_ERSATZ_HAS SWI_Z_BAHASVMHST_ERSATZ_HAS Z_BAHASVMHST_ERSATZ_HAS /end DEF_CHARACTERISTIC
 /begin LOC_MEASUREMENT status_sa_vm_portin z_ba_has_k0_hst_portin z_ba_has_vm_hst_portin status_betriebsber_hst_portin status_abs_portin status_asr_portin modus_e_fahren_hst_portin status_fahranf_hst_portin posv_timer_portin posvueb_aktiv_portin soc_portin status_soc_portin c_umgebung_portin status_cumgebung_portin /end LOC_MEASUREMENT
 /begin SUB_FUNCTION SSAi121_status_betriebsbereitschaft_hst /end SUB_FUNCTION
/end FUNCTION
/begin FUNCTION SSAi99_Bitwise_AND_ui8_ "" /begin LOC_MEASUREMENT status_fzg_rollverhinderung_portin /end LOC_MEASUREMENT /end FUNCTION
/begin FUNCTION SSAo2_SAoEEP_EEProm ""
 /begin LOC_MEASUREMENT z_modus_em_hst_in c_getriebe_egs_in istgang_egs_in m_em_in m_iae_in m_k0_in m_max_dyn_em_in m_soll_em_hst_in m_soll_vm_hst_in m_vm_in m_vm_start_in m_wunsch_fpw_in n_ab_egs_in n_em_in n_soll_ll_vm_in n_t_egs_in n_vm_in osmode_next_in p_bremse_fzg_in sollgang_egs_in status_fehler_iep_in status_iae_in status_iep_in status_k0_in pos_egs_in z_ablauf_has_hst_in z_ablaufvariante_has_hst_in zielgang_egs_in z_k0_fst_in m_mot_in status_iae_adap_in z_diag_ersfkt_has_in z_diag_ersfkt_hi_has_in z_diag_notgang_has_in status_k0_adap_in status_waschstr_in status_kraftfluss_egs_in z_n_min_em_parksp_has_in n_mot_soll_iae_in status_alaengs_adaoff_in gangwechsel_egs_in z_nllsoll_iae_in status_nem_in status_nvm_in kolbenpos_k0_in z_kps_stada_in t_betrieb_pvu_has_ee_in status_ll_vm_in z_msa_fst_in m_min_dyn_em_in phi_neigung_in v_f_in drehrichtung_nem_in fpw_in drehrichtung_nab_in schalt_mode_egs_in m_ziel_k0_hst_in status_kraftfluss_lev2_egs_in i_gang_lev2_egs_in status_c_k0_in bremspedal_in status_autohold_in status_hillhold_in status_vf_in v_f_ref_in status_vfref_in z_diag_ersfkt_hi_96_has_in status_k0_adap_zaehler_in status_k0_befuellung_in z_oea_hst_in z_iep_in z_nllsoll_iep_in c_vm_in n_soll_em_hst_in abstellpos_vm_in abstellpos_vm_status_in status_nreg_em_hst_in m_min_vm_in m_soll_vm_l_hst_in z_msa_stada_in m_wunsch_fpw_hst_in status_getrbereit_in /end LOC_MEASUREMENT
/end FUNCTION
/begin FUNCTION SSAo3_SAoPA_ProjektAllgemein ""
 /begin DEF_CHARACTERISTIC ANALYSE_HAS_ERSATZ_HAS SWI_ANALYSE_HAS_ERSATZ_HAS ERR_N_SOLL_EM_NULL ERR_N_SOLL_VM_NULL SWI_Z_MODUS_IEP_HAS_ERSATZ_HAS Z_MODUS_IEP_HAS_ERSATZ_HAS M_K0_HAS_ERSATZ_HAS SWI_M_K0_HAS_ERSATZ_HAS M_MAXIAE_HAS_ERSATZ_HAS SWI_M_MAXIAE_HAS_ERSATZ_HAS M_MOTMAX_HAS_ERSATZ_HAS SWI_M_MOTMAX_HAS_ERSATZ_HAS M_SOLLEM_HAS_ERSATZ_HAS SWI_M_SOLLEM_HAS_ERSATZ_HAS M_SOLLK0_HAS_ERSATZ_HAS SWI_M_SOLLK0_HAS_ERSATZ_HAS M_RESEM_HAS_ERSATZ_HAS SWI_M_RESEM_HAS_ERSATZ_HAS MG_SOLLK0NEG_HAS_ERSATZ_HAS MG_SOLLK0POS_HAS_ERSATZ_HAS N_MINEM_HAS_ERSATZ_HAS SWI_N_MINEM_HAS_ERSATZ_HAS N_SOLLEM_HAS_ERSATZ_HAS SWI_N_SOLLEM_HAS_ERSATZ_HAS N_SOLLVM_HAS_ERSATZ_HAS SWI_N_SOLLVM_HAS_ERSATZ_HAS ND_MIN_SAF_HAS_ERSATZ_HAS SWI_ND_MIN_SAF_HAS_ERSATZ_HAS ST_IST_BZ_HAS_ERSATZ_HAS SWI_ST_IST_BZ_HAS_ERSATZ_HAS ST_ZIEL_BZ_HAS_ERSATZ_HAS SWI_ST_ZIEL_BZ_HAS_ERSATZ_HAS STATUS_ABLAUF_HAS_ERS_HAS SWI_STATUS_ABLAUF_HAS_ERS_HAS STATUS_ABLAUFAKTIV_ERS_HAS SWI_STATUS_ABLAUFAKTIV_ERS_HAS STATUS_EFAHREN_HAS_ERS_HAS SWI_STATUS_EFAHREN_HAS_ERS_HAS SWI_T_BETRIEB_PVU_ERSATZ_HAS T_BETRIEB_PVU_ERSATZ_HAS SWI_Z_FREIGABE_PVU_ERSATZ_HAS Z_FREIGABE_PVU_ERSATZ_HAS SWI_Z_GLSBE_HAS_ERS_HAS Z_GLSBE_HAS_ERS_HAS SWI_Z_K0BEFUELLOPT_HAS_ERS_HAS Z_K0BEFUELLOPT_HAS_ERS_HAS SWI_Z_K0_HAS_ERSATZ_HAS Z_K0_HAS_ERSATZ_HAS SWI_Z_MMAXIAE_HAS_ERSATZ_HAS Z_MMAXIAE_HAS_ERSATZ_HAS SWI_Z_MSOLLEM_HAS_ERSATZ_HAS Z_MSOLLEM_HAS_ERSATZ_HAS SWI_Z_MODUS_IAE_HAS_ERSATZ_HAS Z_MODUS_IAE_HAS_ERSATZ_HAS SWI_Z_MSA_HAS_ERSATZ_HAS Z_MSA_HAS_ERSATZ_HAS SWI_Z_NSOLLEM_HAS_ERSATZ_HAS Z_NSOLLEM_HAS_ERSATZ_HAS SWI_Z_NSOLLVM_HAS_ERSATZ_HAS Z_NSOLLVM_HAS_ERSATZ_HAS SWI_Z_NLLSOLLMOD_HAS_ERSATZ_HAS Z_NLLSOLLMOD_HAS_ERSATZ_HAS SWI_Z_P_HYS_K0_HAS_ERSATZ_HAS Z_P_HYS_K0_HAS_ERSATZ_HAS SWI_Z_SAF_HAS_ERSATZ_HAS Z_SAF_HAS_ERSATZ_HAS SWI_Z_SAS_HAS_ERSATZ_HAS Z_SAS_HAS_ERSATZ_HAS Z_SBE_HAS_ERS_HAS SWI_Z_START_MODUS_HAS_ERS_HAS Z_START_MODUS_HAS_ERS_HAS SWI_Z_STSPSYSMPS_ERSATZ_HAS Z_STSPSYSMPS_ERSATZ_HAS SWI_Z_SVH_HAS_ERSATZ_HAS Z_SVH_HAS_ERSATZ_HAS /end DEF_CHARACTERISTIC
 /begin LOC_MEASUREMENT m_soll_res_em_has_azg byp_vnr_has_byp pc_ok_has_byp status_ablauf_has_byp m_k0_has_byp n_soll_em_has_byp n_soll_vm_has_byp z_k0_has_byp m_soll_k0_has_byp z_n_soll_vm_has_byp z_n_soll_em_has_byp status_efahren_has_byp m_soll_res_em_has_byp m_soll_em_has_byp m_max_iae_has_byp z_sbe_has_byp z_modus_iae_has_byp z_m_max_iae_has_byp m_max_em_has_byp m_min_em_has_byp mo_mod_em_hst_has_byp n_min_em_has_sbe_has_byp z_m_soll_em_has_byp iep_soll_has_byp mg_soll_k0_neg_has_byp mg_soll_k0_pos_has_byp z_msa_has_byp bypass_has_aktiv z_p_hys_k0_has_byp z_saf_has_byp z_sas_has_byp nd_min_saf_has_byp z_glsbe_has_byp z_svh_has_byp m_motmax_has_byp status_ablaufaktiv_has_byp st_ist_bz_has_byp st_ziel_bz_has_byp analyse_has_byp z_k0_befuellopt_has_byp z_status_psys_mps_has_byp z_start_modus_has_byp m_k0_mber_has_byp z_fehler15_diho_has_byp z_k0oeffnicht_diho_has_byp z_kfc_c0noclose_has_byp z_oelversfehler_diho_has_byp z_vmaus_auw_diho_has_byp z_nemzuklein_auw_diho_has_byp z_ndk0zugross_auw_diho_has_byp z_kfc_c0noclosepb_has_byp z_kfc_c0noopenpb_has_byp z_nemrde_diho_has_byp z_nemablwe_auw_diho_has_byp z_statusnem_auw_diho_has_byp z_nemasynscl_auw_diho_has_byp z_statusnemasynscl_auw_diho_has_byp z_statusnemablwe_auw_diho_has_byp z_freigabe_pvu_has_byp t_betrieb_pvu_has_byp z_nllsoll_modus_has_byp z_kfc_c0noopen_eho_diho_has_byp z_kfc_c0noclose_eho_diho_has_byp z_nvmzuklein_auw_diho_has_byp z_nvmsollbegr_frk_dihi z_statuspsysmps_frk_dihi z_nminemnull_frk_dihi z_emfehler_frk_dihi z_ablaufreinit_frk_dihi z_k0syncmk0erh_frk_dihi z_fuwdeakt_frk_dihi z_nemmin_frk_dihi z_vmstopverbot_frk_dihi z_vmstartverbot_frk_dihi z_zust_halten_frk_dihi z_zust_init_frk_dihi z_deaktiv_abo_frk_dihi z_vmstartanf_frk_dihi z_svh_frk_dihi z_iepein_frk_dihi z_nsollvmnull_frk_dihi z_ala_frk_dihi z_schaltprioverh_frk_dihi z_nsollvmanh_frk_dihi z_gebruefahrenaus_frk_dihi z_hybfkt_stg st_ziel_bz_has_stg st_ist_bz_has_stg st_ist_hcomd_has_stg z_ablauf_has_stg z_ablaufvariante_has_stg m_k0_mod_has_fkt m_max_em_has_fkt m_max_iae_has_fkt m_min_em_has_fkt m_soll_em_has_fkt m_soll_k0_has_fkt m_soll_res_em_has_fkt mg_soll_k0_has_fkt n_soll_em_has_fkt n_soll_vm_has_fkt nd_min_saf_has_fkt nd_soll_iae_fkt st_ablauf_fkt status_ablauf_has_fkt z_ablauf_svh_reset_has_fkt z_ablaufvariante_kalt_zus z_emaktiv_fuw_zus_fkt z_fehler15_eh_fkt z_k0_befuellopt_has_fkt z_k0_has_fkt z_m_max_iae_has_fkt z_m_soll_em_has_fkt z_n_soll_em_has_fkt z_n_soll_vm_has_fkt z_p_hys_k0_has_fkt z_ponr_fkt z_respschlepp_sas_fkt z_saf_has_fkt z_sbe_has_fkt z_zuendfreigabe_vm_fkt z_zuendfreigabe_vm_has_fkt i_istgang_egs i_zielgang_egs m_wunsch_fpw_hst_fil mg_wunsch_fpw_in mg_wunsch_fpw_hst_in n_sec_iae nd_k0_in ndg_k0_in ng_vm_in status_schaltung_egs_in n_min_em_psys_lp3_has_sbe status_psys_has_sbe vg_f_sbe v_f_sbe status_sync_schaltung_sbe z_pvu_has_sbe z_freigabe_pvu_has_sbe t_betrieb_pvu_has_sbe mg_mot_in status_radschlupf_rse_has_sbe status_schaltart_svh_has_sbe m_motmax_has_sbe z_k0_has_sbe z_svh_has_sbe m_soll_res_em_has_sbe m_soll_res_em_bas_sbe z_modus_iae_has_sbe z_sas_has_sbe z_modus_iep_has_sbe z_msa_has_sbe status_efahren_has_sbe n_min_em_has_sbe z_msa_avh_moni_has_sbe z_msa_eaf_moni_has_sbe z_start_modus_has_sbe m_k0_mber_has_sbe z_lls_fktaktiv_has_sbe z_status_psys_mps_sbe m_k0_has_sbe m_soll_k0_has_sbe analyse_has_sbe z_nminemmodus_has_sbe z_modus_em_hst_in c_getriebe_egs_in istgang_egs_in m_em_in m_iae_in m_k0_in m_max_dyn_em_in m_soll_em_hst_in m_soll_vm_hst_in m_vm_in m_vm_start_in m_wunsch_fpw_in n_ab_egs_in n_em_in n_soll_ll_vm_in n_t_egs_in n_vm_in osmode_next_in p_bremse_fzg_in sollgang_egs_in status_fehler_iep_in status_iae_in status_iep_in status_k0_in pos_egs_in z_ablauf_has_hst_in z_ablaufvariante_has_hst_in zielgang_egs_in z_k0_fst_in m_mot_in status_iae_adap_in z_diag_ersfkt_has_in z_diag_ersfkt_hi_has_in z_diag_notgang_has_in status_k0_adap_in status_waschstr_in status_kraftfluss_egs_in z_n_min_em_parksp_has_in n_mot_soll_iae_in status_alaengs_adaoff_in gangwechsel_egs_in z_nllsoll_iae_in status_nem_in status_nvm_in kolbenpos_k0_in z_kps_stada_in t_betrieb_pvu_has_ee_in status_ll_vm_in z_msa_fst_in m_min_dyn_em_in phi_neigung_in v_f_in drehrichtung_nem_in fpw_in drehrichtung_nab_in schalt_mode_egs_in m_ziel_k0_hst_in status_kraftfluss_lev2_egs_in i_gang_lev2_egs_in status_c_k0_in bremspedal_in status_autohold_in status_hillhold_in status_vf_in v_f_ref_in status_vfref_in z_diag_ersfkt_hi_96_has_in status_k0_adap_zaehler_in status_k0_befuellung_in z_oea_hst_in z_iep_in z_nllsoll_iep_in c_vm_in n_soll_em_hst_in abstellpos_vm_in abstellpos_vm_status_in status_nreg_em_hst_in m_min_vm_in m_soll_vm_l_hst_in z_msa_stada_in m_wunsch_fpw_hst_in status_getrbereit_in m_soll_em_has_komp_portout n_mot_llsoll_has_komp_portout n_mot_idle_tar_has_komp_portout n_soll_em_has_komp_portout n_soll_vm_has_komp_portout z_m_soll_em_has_komp_portout z_n_soll_vm_has_komp_portout z_n_soll_em_has_komp_portout err_n_soll_em_has_komp_portout err_n_soll_vm_has_komp_portout m_motmax_has_komp_portout /end LOC_MEASUREMENT
 /begin SUB_FUNCTION SSAo54_Complement_si16_ SSAo56_Complement_ui8_ SSAo55_Complement_ui16_ SSAo57_Complement_ui16_ SSAo58_Complement_ui16_ SSAo61_Complement_ui8_ SSAo63_Complement_ui8_ SSAo62_Complement_ui8_ SSAo51_Complement_ui8_ SSAo52_Complement_ui8_ SSAo53_Complement_si16_ /end SUB_FUNCTION
/end FUNCTION
/begin FUNCTION SSAo4_SAoPS_ProjektSpezifisch ""
 /begin DEF_CHARACTERISTIC ERR_N_SOLL_EM_NULL ERR_N_SOLL_VM_NULL M_K0_MBER_HAS_ERSATZ_HAS SWI_M_K0_MBER_HAS_ERSATZ_HAS M_MAXEM_HAS_ERSATZ_HAS SWI_M_MAXEM_HAS_ERSATZ_HAS M_MINEM_HAS_ERSATZ_HAS SWI_M_MINEM_HAS_ERSATZ_HAS MO_MODEMHST_HAS_ERSATZ_HAS SWI_MO_MODEMHST_HAS_ERSATZ_HAS /end DEF_CHARACTERISTIC
 /begin LOC_MEASUREMENT byp_vnr_has_byp pc_ok_has_byp status_ablauf_has_byp m_k0_has_byp n_soll_em_has_byp n_soll_vm_has_byp z_k0_has_byp m_soll_k0_has_byp z_n_soll_vm_has_byp z_n_soll_em_has_byp status_efahren_has_byp m_soll_res_em_has_byp m_soll_em_has_byp m_max_iae_has_byp z_sbe_has_byp z_modus_iae_has_byp z_m_max_iae_has_byp m_max_em_has_byp m_min_em_has_byp mo_mod_em_hst_has_byp n_min_em_has_sbe_has_byp z_m_soll_em_has_byp iep_soll_has_byp mg_soll_k0_neg_has_byp mg_soll_k0_pos_has_byp z_msa_has_byp bypass_has_aktiv z_p_hys_k0_has_byp z_saf_has_byp z_sas_has_byp nd_min_saf_has_byp z_glsbe_has_byp z_svh_has_byp m_motmax_has_byp status_ablaufaktiv_has_byp st_ist_bz_has_byp st_ziel_bz_has_byp analyse_has_byp z_k0_befuellopt_has_byp z_status_psys_mps_has_byp z_start_modus_has_byp m_k0_mber_has_byp z_fehler15_diho_has_byp z_k0oeffnicht_diho_has_byp z_kfc_c0noclose_has_byp z_oelversfehler_diho_has_byp z_vmaus_auw_diho_has_byp z_nemzuklein_auw_diho_has_byp z_ndk0zugross_auw_diho_has_byp z_kfc_c0noclosepb_has_byp z_kfc_c0noopenpb_has_byp z_nemrde_diho_has_byp z_nemablwe_auw_diho_has_byp z_statusnem_auw_diho_has_byp z_nemasynscl_auw_diho_has_byp z_statusnemasynscl_auw_diho_has_byp z_statusnemablwe_auw_diho_has_byp z_freigabe_pvu_has_byp t_betrieb_pvu_has_byp z_nllsoll_modus_has_byp z_kfc_c0noopen_eho_diho_has_byp z_kfc_c0noclose_eho_diho_has_byp z_nvmzuklein_auw_diho_has_byp z_hybfkt_stg st_ziel_bz_has_stg st_ist_bz_has_stg st_ist_hcomd_has_stg z_ablauf_has_stg z_ablaufvariante_has_stg m_k0_mod_has_fkt m_max_em_has_fkt m_max_iae_has_fkt m_min_em_has_fkt m_soll_em_has_fkt m_soll_k0_has_fkt m_soll_res_em_has_fkt mg_soll_k0_has_fkt n_soll_em_has_fkt n_soll_vm_has_fkt nd_min_saf_has_fkt nd_soll_iae_fkt st_ablauf_fkt status_ablauf_has_fkt z_ablauf_svh_reset_has_fkt z_ablaufvariante_kalt_zus z_emaktiv_fuw_zus_fkt z_fehler15_eh_fkt z_k0_befuellopt_has_fkt z_k0_has_fkt z_m_max_iae_has_fkt z_m_soll_em_has_fkt z_n_soll_em_has_fkt z_n_soll_vm_has_fkt z_p_hys_k0_has_fkt z_ponr_fkt z_respschlepp_sas_fkt z_saf_has_fkt z_sbe_has_fkt z_zuendfreigabe_vm_fkt z_zuendfreigabe_vm_has_fkt m_motmax_has_sbe z_k0_has_sbe z_svh_has_sbe m_soll_res_em_has_sbe m_soll_res_em_bas_sbe z_modus_iae_has_sbe z_sas_has_sbe z_modus_iep_has_sbe z_msa_has_sbe status_efahren_has_sbe n_min_em_has_sbe z_msa_avh_moni_has_sbe z_msa_eaf_moni_has_sbe z_start_modus_has_sbe m_k0_mber_has_sbe z_lls_fktaktiv_has_sbe z_status_psys_mps_sbe m_k0_has_sbe m_soll_k0_has_sbe analyse_has_sbe z_nminemmodus_has_sbe st_soll_bz_has_hst z_init_sta st_soll_bz_hst_sta st_ist_bz_hst_sta bExceptionHybrid bErrorHybrid z_modus_em_hst_in c_getriebe_egs_in istgang_egs_in m_em_in m_iae_in m_k0_in m_max_dyn_em_in m_soll_em_hst_in m_soll_vm_hst_in m_vm_in m_vm_start_in m_wunsch_fpw_in n_ab_egs_in n_em_in n_soll_ll_vm_in n_t_egs_in n_vm_in osmode_next_in p_bremse_fzg_in sollgang_egs_in status_fehler_iep_in status_iae_in status_iep_in status_k0_in pos_egs_in z_ablauf_has_hst_in z_ablaufvariante_has_hst_in zielgang_egs_in z_k0_fst_in m_mot_in status_iae_adap_in z_diag_ersfkt_has_in z_diag_ersfkt_hi_has_in z_diag_notgang_has_in status_k0_adap_in status_waschstr_in status_kraftfluss_egs_in z_n_min_em_parksp_has_in n_mot_soll_iae_in status_alaengs_adaoff_in gangwechsel_egs_in z_nllsoll_iae_in status_nem_in status_nvm_in kolbenpos_k0_in z_kps_stada_in t_betrieb_pvu_has_ee_in status_ll_vm_in z_msa_fst_in m_min_dyn_em_in phi_neigung_in v_f_in drehrichtung_nem_in fpw_in drehrichtung_nab_in schalt_mode_egs_in m_ziel_k0_hst_in status_kraftfluss_lev2_egs_in i_gang_lev2_egs_in status_c_k0_in bremspedal_in status_autohold_in status_hillhold_in status_vf_in v_f_ref_in status_vfref_in z_diag_ersfkt_hi_96_has_in status_k0_adap_zaehler_in status_k0_befuellung_in z_oea_hst_in z_iep_in z_nllsoll_iep_in c_vm_in n_soll_em_hst_in abstellpos_vm_in abstellpos_vm_status_in status_nreg_em_hst_in m_min_vm_in m_soll_vm_l_hst_in z_msa_stada_in m_wunsch_fpw_hst_in status_getrbereit_in m_soll_em_has_komp_portout n_mot_llsoll_has_komp_portout n_mot_idle_tar_has_komp_portout n_soll_em_has_komp_portout n_soll_vm_has_komp_portout z_m_soll_em_has_komp_portout z_n_soll_vm_has_komp_portout z_n_soll_em_has_komp_portout err_n_soll_em_has_komp_portout err_n_soll_vm_has_komp_portout m_motmax_has_komp_portout /end LOC_MEASUREMENT
/end FUNCTION
/begin FUNCTION SSAo51_Complement_ui8_ "" /begin DEF_CHARACTERISTIC ERR_N_SOLL_EM_NULL /end DEF_CHARACTERISTIC /begin LOC_MEASUREMENT err_n_soll_em_has_komp_portout /end LOC_MEASUREMENT /end FUNCTION
/begin FUNCTION SSAo52_Complement_ui8_ "" /begin DEF_CHARACTERISTIC ERR_N_SOLL_VM_NULL /end DEF_CHARACTERISTIC /begin LOC_MEASUREMENT err_n_soll_vm_has_komp_portout /end LOC_MEASUREMENT /end FUNCTION
/begin FUNCTION SSAo53_Complement_si16_ "" /begin LOC_MEASUREMENT m_motmax_has_komp_portout /end LOC_MEASUREMENT /end FUNCTION
/begin FUNCTION SSAo54_Complement_si16_ "" /begin LOC_MEASUREMENT m_soll_em_has_komp_portout /end LOC_MEASUREMENT /end FUNCTION
/begin FUNCTION SSAo55_Complement_ui16_ "" /begin LOC_MEASUREMENT n_mot_idle_tar_has_komp_portout /end LOC_MEASUREMENT /end FUNCTION
/begin FUNCTION SSAo56_Complement_ui8_ "" /begin LOC_MEASUREMENT n_mot_llsoll_has_komp_portout /end LOC_MEASUREMENT /end FUNCTION
/begin FUNCTION SSAo57_Complement_ui16_ "" /begin LOC_MEASUREMENT n_soll_em_has_komp_portout /end LOC_MEASUREMENT /end FUNCTION
/begin FUNCTION SSAo58_Complement_ui16_ "" /begin LOC_MEASUREMENT n_soll_vm_has_komp_portout /end LOC_MEASUREMENT /end FUNCTION
/begin FUNCTION SSAo61_Complement_ui8_ "" /begin LOC_MEASUREMENT z_m_soll_em_has_komp_portout /end LOC_MEASUREMENT /end FUNCTION
/begin FUNCTION SSAo62_Complement_ui8_ "" /begin LOC_MEASUREMENT z_n_soll_em_has_komp_portout /end LOC_MEASUREMENT /end FUNCTION
/begin FUNCTION SSAo63_Complement_ui8_ "" /begin LOC_MEASUREMENT z_n_soll_vm_has_komp_portout /end LOC_MEASUREMENT /end FUNCTION
/begin FUNCTION Run_UL2_MOTMAX "" /begin DEF_CHARACTERISTIC MS_MOTMAX_HAS_L2 SWI_MOTMAX_HAS_L2 T_MOTMAX_HAS_L2 /end DEF_CHARACTERISTIC
 /begin LOC_MEASUREMENT f_akt_err_motmax_fl_has_l2 f_akt_err_motmax_has_l2 f_m_akt_err_motmax_fl_has_l2 f_m_akt_err_motmax_has_l2 f_m_err_motmax_fl_has_l2 f_m_err_motmax_has_l2 t_m_err_motmax_fl_has_l2 t_m_err_motmax_has_l2 /end LOC_MEASUREMENT
/end FUNCTION
/begin FUNCTION Run_UL2_NEMMIN ""
 /begin DEF_CHARACTERISTIC KL_MS_NEMMIN_HAS_L2_Y KL_MS_NEMMIN_HAS_L2_X I_FIX_ERSATZ_NEMMIN_HAS_L2 MS_MIN_NEMMIN_HAS_L2 NS_LIM_NEMMIN_HAS_L2 NS_NEMMIN_HAS_L2 SWI_EXTDEAK_NEMMIN_HAS_L2 SWI_MOTVERLUST_NEMMIN_HAS_L2 SWI_NEMMIN_HAS_L2 T_NEMMIN_HAS_L2 /end DEF_CHARACTERISTIC
 /begin LOC_MEASUREMENT f_akt_err_nemmin_fl_has_l2 f_akt_err_nemmin_has_l2 f_m_akt_err_nemmin_fl_has_l2 f_m_akt_err_nemmin_has_l2 f_m_err_nemmin_fl_has_l2 f_m_err_nemmin_has_l2 f_n_akt_err_nemmin_fl_has_l2 f_n_akt_err_nemmin_has_l2 f_n_err_nemmin_fl_has_l2 f_n_err_nemmin_has_l2 f_sig_err_nemmin_fl_has_l2 f_sig_err_nemmin_has_l2 f_sig_akt_err_nemmin_fl_has_l2 f_sig_akt_err_nemmin_has_l2 i_dyn_nemmin_fl_has_l2 i_dyn_nemmin_has_l2 m_verlust_nemmin_has_l2 m_verlust_nemmin_fl_has_l2 mo_mered_nemmin_has_l2 mo_mered_nemmin_fl_has_l2 t_m_err_nemmin_fl_has_l2 t_m_err_nemmin_has_l2 t_n_err_nemmin_fl_has_l2 t_n_err_nemmin_has_l2 t_sig_err_nemmin_fl_has_l2 t_sig_err_nemmin_has_l2 f_next_check_allowed_nemmin_fl_has_l2 f_next_check_allowed_nemmin_has_l2 /end LOC_MEASUREMENT
/end FUNCTION
/begin FUNCTION Run_UL2_NEMSOLL ""
 /begin DEF_CHARACTERISTIC KL_MO_NEMSOLL_HAS_L2_Y KL_MO_NEMSOLL_HAS_L2_X TAB_IG_NEMSOLL_HAS_L2 I_FIX_ERSATZ_NEMSOLL_HAS_L2 M_MOTSOLL_ERSATZ_HAS_L2 NDS_GETR_NEMSOLL_HAS_L2 NS_AB_MIN_NEMSOLL_HAS_L2 NS_LIM_NEMSOLL_HAS_L2 SWI_NEMSOLL_HAS_L2 SWI_POS_NEMSOLL_HAS_L2 SWI_ST_MSOLL_Z_ERR_NEMSOLL_HAS_L2 SWI_VAR_NEMSOLL_HAS_L2 T_NEMSOLL_HAS_L2 /end DEF_CHARACTERISTIC
 /begin LOC_MEASUREMENT f_akt_err_nemsoll_fl_has_l2 f_akt_err_nemsoll_has_l2 f_n_akt_err_nemsoll_fl_has_l2 f_n_akt_err_nemsoll_has_l2 f_n_err_nemsoll_fl_has_l2 f_n_err_nemsoll_has_l2 f_pos_akt_err_nemsoll_fl_has_l2 f_pos_akt_err_nemsoll_has_l2 f_pos_err_nemsoll_fl_has_l2 f_pos_err_nemsoll_has_l2 f_s_akt_err_nemsoll_fl_has_l2 f_s_akt_err_nemsoll_has_l2 f_s_err_nemsoll_fl_has_l2 f_s_err_nemsoll_has_l2 f_z_akt_err_nemsoll_fl_has_l2 f_z_akt_err_nemsoll_has_l2 f_z_err_nemsoll_fl_has_l2 f_z_err_nemsoll_has_l2 i_dyn_nemsoll_fl_has_l2 i_dyn_nemsoll_has_l2 i_fix_nemsoll_fl_has_l2 i_fix_nemsoll_has_l2 nd_getr_nemsoll_fl_has_l2 nd_getr_nemsoll_has_l2 t_n_err_nemsoll_fl_has_l2 t_n_err_nemsoll_has_l2 t_pos_err_nemsoll_fl_has_l2 t_pos_err_nemsoll_has_l2 t_s_err_nemsoll_fl_has_l2 t_s_err_nemsoll_has_l2 t_z_err_nemsoll_fl_has_l2 t_z_err_nemsoll_has_l2 m_verlust_nemsoll_fl_has_l2 m_motsoll_nemsoll_has_l2 m_motsoll_nemsoll_fl_has_l2 m_soll_nemsoll_has_l2 m_soll_nemsoll_fl_has_l2 m_verlust_nemsoll_has_l2 no_ndgetr_nemsoll_has_l2 no_ndgetr_nemsoll_fl_has_l2 /end LOC_MEASUREMENT
/end FUNCTION
/begin RECORD_LAYOUT FLOAT32_IEEE_COL_DIRECT_M_S7_S3 FNC_VALUES 1 FLOAT32_IEEE COLUMN_DIR DIRECT /end RECORD_LAYOUT
/begin RECORD_LAYOUT FLOAT32_IEEE_X_INCR_DIRECT_M_S7_S3 AXIS_PTS_X 1 FLOAT32_IEEE INDEX_INCR DIRECT /end RECORD_LAYOUT
/begin RECORD_LAYOUT SBYTE_COL_DIRECT_M_S7_S3 FNC_VALUES 1 SBYTE COLUMN_DIR DIRECT /end RECORD_LAYOUT
/begin RECORD_LAYOUT SWORD_COL_DIRECT_M_S7_S3 FNC_VALUES 1 SWORD COLUMN_DIR DIRECT /end RECORD_LAYOUT
/begin RECORD_LAYOUT UBYTE_COL_DIRECT_M_S7_S3 FNC_VALUES 1 UBYTE COLUMN_DIR DIRECT /end RECORD_LAYOUT
/begin RECORD_LAYOUT UBYTE_X_INCR_DIRECT_M_S7_S3 AXIS_PTS_X 1 UBYTE INDEX_INCR DIRECT /end RECORD_LAYOUT
/begin RECORD_LAYOUT ULONG_COL_DIRECT_M_S7_S3 FNC_VALUES 1 ULONG COLUMN_DIR DIRECT /end RECORD_LAYOUT
/begin RECORD_LAYOUT UWORD_COL_DIRECT_M_S7_S3 FNC_VALUES 1 UWORD COLUMN_DIR DIRECT /end RECORD_LAYOUT
/begin RECORD_LAYOUT SWORD_COL_DIRECT_S1_S7_S3 FNC_VALUES 1 SWORD COLUMN_DIR DIRECT /end RECORD_LAYOUT
/begin RECORD_LAYOUT UBYTE_COL_DIRECT_S1_S7_S3 FNC_VALUES 1 UBYTE COLUMN_DIR DIRECT /end RECORD_LAYOUT
/begin RECORD_LAYOUT UWORD_COL_DIRECT_S1_S7_S3 FNC_VALUES 1 UWORD COLUMN_DIR DIRECT /end RECORD_LAYOUT
/begin RECORD_LAYOUT UWORD_X_INCR_DIRECT_S1_S7_S3 AXIS_PTS_X 1 UWORD INDEX_INCR DIRECT /end RECORD_LAYOUT
/end MODULE
/end PROJECT
