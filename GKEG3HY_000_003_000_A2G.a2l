ASAP2_VERSION 1 51
/begin PROJECT _929_929 "Gen2_BMW_System_Supplier_Lib"
/begin HEADER "" VERSION "C_03_03" PROJECT_NO _929_929 /end HEADER
/begin MODULE DIM ""
/begin MOD_COMMON "" BYTE_ORDER MSB_FIRST ALIGNMENT_BYTE 1 ALIGNMENT_WORD 2 ALIGNMENT_LONG 4 ALIGNMENT_FLOAT32_IEEE 4 /end MOD_COMMON
/begin CHARACTERISTIC CAN_tiPowerup_C "F9175: Maximal delay between SW initialization and GET_IGNITION returning ON after powerup." VALUE 0x2019B8 AblGLKWub_M 1275 TI1_M_CYCLE_M 0 1275 FORMAT "%5.0" /end CHARACTERISTIC
/begin CHARACTERISTIC RRT_swtRstMax_C "F1620: Calibration switch to reset max. values of runtime measurement" VALUE 0x201954 AblGLKWub_M 2 X1_M 0 2 FORMAT "%5.3" /end CHARACTERISTIC
/begin CHARACTERISTIC ShrVar_tiWaitErrHndlr_C "F9150: waiting time for error handler" VALUE 0x201598 AblGLKWuw_M 327675 TI1_M_CYCLE_M 0 327675 FORMAT "%8.1" /end CHARACTERISTIC
/begin CHARACTERISTIC ShrVar_tiWaitVIN_C "F9150: waiting time for VIN" VALUE 0x20159A AblGLKWuw_M 327675 TI1_M_CYCLE_M 0 327675 FORMAT "%8.1" /end CHARACTERISTIC
/begin CHARACTERISTIC ECE_CAN_stWakUpCheck_C "F2357: Bitmask defining the possibility of the CAN transceiver to detect a CAN-wakeup in current HW configuration (B0:CAN-Transceiver1, B1:CAN-Transc2) (only if supported by HW configuration) (no SERAP)" VALUE 0x20195A AblGLKWub_S1 255 X1_S1 0 255 FORMAT "%5.1" /end CHARACTERISTIC
/begin CHARACTERISTIC ECE_CC08_bUseDither_C "F2366: Use the dither function even in old ASIC steps (consider that the freq. is deviating because of the slower PCLK) (no SERAP)" VALUE 0x20195B AblGLKWub_S1 1 B_TRUE_S1 0 1 FORMAT "%13.11" /end CHARACTERISTIC
/begin CHARACTERISTIC ECE_CC08_regInt_C "F2366: CG208 integrator register settings (B7+B6:P-Reg, B5-B0:n) (note: Ax-step uses slightly different structure) (no SERAP)" VAL_BLK 0x20195C AblGLKWBub_S1 255 X1_S1 0 255 NUMBER 5 FORMAT "%5.1" /end CHARACTERISTIC
/begin CHARACTERISTIC ECE_CC08_regMode_C "F2366: CG208 set-register settings (only B4:slow-driver mode) (no SERAP)" VALUE 0x201961 AblGLKWub_S1 255 X1_S1 0 255 FORMAT "%5.1" /end CHARACTERISTIC
/begin CHARACTERISTIC ECE_CC08_regOsc_C "F2366: B7:undervoltage behavior (note: Ax-step uses slightly different structure) (no SERAP)" VALUE 0x201962 AblGLKWub_S1 255 X1_S1 0 255 FORMAT "%5.1" /end CHARACTERISTIC
/begin CHARACTERISTIC ECE_CC08_regRound_C "F2366: rounding mode selection (3=no rounding, others=rounding) (evaluated once only) (no SERAP)" VALUE 0x201963 AblGLKWub_S1 255 X1_S1 0 255 FORMAT "%5.1" /end CHARACTERISTIC
/begin CHARACTERISTIC ECE_CC08_regSet_C "F2366: CG208 set-register settings (B0-5: n*0.31ms, B7+B6:P-reg) (note: Ax-step uses slightly different structure) (no SERAP)" VAL_BLK 0x201964 AblGLKWBub_S1 255 X1_S1 0 255 NUMBER 5 FORMAT "%5.1" /end CHARACTERISTIC
/begin CHARACTERISTIC ECE_CC08_stAvail_C "F2366: bit-array to select whether ASIC (not channel) is mounted (B0:CG208-0, B1:Cg208-1 ...) (no SERAP)" VALUE 0x201969 AblGLKWub_S1 255 X1_S1 0 255 FORMAT "%5.1" /end CHARACTERISTIC
/begin CHARACTERISTIC ECE_CC08_stOnOffMode_C "F2366: Activation of a special on/off mode for each CC channel (B0:Ch0,B1:Ch1, ...) (no SERAP)" VALUE 0x20152C AblGLKWuw_S1 65535 X1_S1 0 65535 FORMAT "%8.2" /end CHARACTERISTIC
/begin CHARACTERISTIC ECE_CC08_stSpiDiaDynMsk_C "F2366: Global mask to deactivate certain SPI-Diagnosis-Bits (see ECE_CC08_stSpiDiag) (no SERAP)" VALUE 0x20196A AblGLKWub_S1 255 X1_S1 0 255 FORMAT "%5.1" /end CHARACTERISTIC
/begin CHARACTERISTIC ECE_CC08_tiDfrInit_C "F2366: CG208 dither period [ms] range form 0ms - 0,32ms:3125Hz. Up to three dither periodes available  (no SERAP)" VAL_BLK 0x20152E AblGLKWBuw_S1 45 TI0_001_M_S1 0 45 NUMBER 3 FORMAT "%8.5" /end CHARACTERISTIC
/begin CHARACTERISTIC ECE_CC08_tiDithIsrFast_C "F2366: CG208 dither interrupt timing parameters (idx0:dly sample-high, idx1:dly sample-low, idx2:dly period)  (table used if ECE_CC08_regDfr_C Bit5 is set (0.32ms)) (no SERAP)" MAP 0x20020C AblGLFKFuw_S1 64.835 TI0_001_M_S1 0.7 65.535 FORMAT "%8.5"
 /begin AXIS_DESCR FIX_AXIS ECE_idxDmy X1_S1 3 0 2 FIX_AXIS_PAR 0 0 3 FORMAT "%5.3" /end AXIS_DESCR
 /begin AXIS_DESCR FIX_AXIS ECE_idxDmy X1_S1 32 0 31 FIX_AXIS_PAR 0 0 32 FORMAT "%5.2" /end AXIS_DESCR
/end CHARACTERISTIC
/begin CHARACTERISTIC ECE_CC08_tiDithIsrSlow_C "F2366: CG208 dither interrupt timing parameters (idx0:dly sample-high, idx1:dly sample-low, idx2:dly period)  (table used if ECE_CC08_regDfr_C Bit5 is cleared (1.28ms)) (no SERAP)" MAP 0x2002CC AblGLFKFuw_S1 64.835 TI0_001_M_S1 0.7 65.535 FORMAT "%8.5"
 /begin AXIS_DESCR FIX_AXIS ECE_idxDmy X1_S1 3 0 2 FIX_AXIS_PAR 0 0 3 FORMAT "%5.3" /end AXIS_DESCR
 /begin AXIS_DESCR FIX_AXIS ECE_idxDmy X1_S1 32 0 31 FIX_AXIS_PAR 0 0 32 FORMAT "%5.2" /end AXIS_DESCR
/end CHARACTERISTIC
/begin CHARACTERISTIC ECE_CC08_tiSyncInit_C "F2366: initial CG208 synchronization period (this has to fit to ECE_CC08_tiSyncPhaseDlyInit_C and other parameter registers) (no SERAP)" VAL_BLK 0x201534 AblGLKWBuw_S1 1.22 TI0_001_M_S1 0.28 1.5 NUMBER 1 FORMAT "%8.6" /end CHARACTERISTIC
/begin CHARACTERISTIC ECE_CC08_tiSyncPhaseDlyInit_C "F2366: initial CG208 phase delay between ASICs - the last channel has to have the highest delay sync period if sync changes are used - these values have to fit to ECE_CC08_tiSyncInit_C (here: TimerE resolution!) (no SERAP)" MAP 0x20038C AblGLFKFuw_S1 1.5 TI0_0005_M_S1 0 1.5 FORMAT "%8.6"
 /begin AXIS_DESCR FIX_AXIS ECE_idxDmy X1_S1 5 0 4 FIX_AXIS_PAR 0 0 5 FORMAT "%5.3" /end AXIS_DESCR
 /begin AXIS_DESCR FIX_AXIS ECE_idxDmy X1_S1 2 0 1 FIX_AXIS_PAR 0 0 2 FORMAT "%5.3" /end AXIS_DESCR
/end CHARACTERISTIC
/begin CHARACTERISTIC ECE_CC08_xDithGrpAssign_C "F2386: bit-array to select whether Cg208 channel is in dithergroup B0:Cg208_0 ch0; B1:Cg208_0 ch1..; B15:Cg208_7 ch1 (no SERAP)" VAL_BLK 0x201536 AblGLKWBuw_S1 65535 X1_S1 0 65535 NUMBER 3 FORMAT "%8.2" /end CHARACTERISTIC
/begin CHARACTERISTIC ECE_CC08_xSyncGrpAssign_C "F2386: bit-array to select whether Cg208 ASIC is in sync group B0:Cg208_0; B1:Cg208_1;.. B7:Cg208_7 (no SERAP)" VAL_BLK 0x20196B AblGLKWBub_S1 255 X1_S1 0 255 NUMBER 1 FORMAT "%5.1" /end CHARACTERISTIC
/begin CHARACTERISTIC ECE_Cg124_regInit_C "F2385: Cg124-Init-Register (B0-3:OTA,B4:0,B5:ISO,B6:VS-VOLT) (no SERAP)" VALUE 0x201996 AblGLKWub_S1 255 X1_S1 0 255 FORMAT "%5.1" /end CHARACTERISTIC
/begin CHARACTERISTIC ECE_Cg130_regInit2_C "F2385: Cg130-Init2-Register (B0:TMPSEL,B2:VD1SEL,B3:TREC,B4:OTN_HSD) (no SERAP)" VALUE 0x201997 AblGLKWub_S1 255 X1_S1 0 255 FORMAT "%5.1" /end CHARACTERISTIC
/begin CHARACTERISTIC ECE_CORE_numPbusCycles_C "F2351: Number of program cycles for Pbus-DMA transfer observation (0=off) (no SERAP)" VALUE 0x20153C AblGLKWuw_S1 65535 X1_S1 0 65535 FORMAT "%8.2" /end CHARACTERISTIC
/begin CHARACTERISTIC ECE_CORE_regModClkMsk_C "F2351: bitmask to select MD_CLK setting which is allowed (see register MDCR1) (no SERAP)" VALUE 0x20196C AblGLKWub_S1 255 X1_S1 0 255 FORMAT "%5.1" /end CHARACTERISTIC
/begin CHARACTERISTIC ECE_CORE_regModeMsk_C "F2351: Masks for CPU mode verification. Idx0:verification mask, Idx1:expected value  (see register MDCR1) (no SERAP)" VAL_BLK 0x2003A0 AblGLKWBuw_S1 65535 X1_S1 0 65535 NUMBER 2 FORMAT "%8.2" /end CHARACTERISTIC
/begin CHARACTERISTIC ECE_CORE_stRamWS_C "F2351: RAM waitstate configuration Info: 1=Force normal RAM WS, 2=Force fast RAM WS, 3=Auto detection of RAM WS depend on CPU type" VALUE 0x20196D AblGLKWub_S1 2 X1_S1 1 3 FORMAT "%5.3" /end CHARACTERISTIC
/begin CHARACTERISTIC ECE_CORE_stRstTrg_C "F2351: reset activation via an application label - value has to change from an odd to an even value to initiate a reset (for test purpose)" VALUE 0x20196E AblGLKWub_S1 255 X1_S1 0 255 FORMAT "%5.1" /end CHARACTERISTIC
/begin CHARACTERISTIC ECE_facAdcAmux_C "F2355: Multiplication Factor to determine the measureable voltage (channel specific) (default: 5.00) (no SERAP)" VAL_BLK 0x200170 AblGLKWBr32_S1 10 X1_S1 0 10 NUMBER 4 FORMAT "%10.7" /end CHARACTERISTIC
/begin CHARACTERISTIC ECE_facAdcA_C "F2355: Multiplication Factor to determine the measureable voltage (channel specific) (default: 1.00) (no SERAP)" VAL_BLK 0x200180 AblGLKWBr32_S1 10 X1_S1 0 10 NUMBER 28 FORMAT "%10.7" /end CHARACTERISTIC
/begin CHARACTERISTIC ECE_facAdcB_C "F2355: Multiplication Factor to determine the measureable voltage (channel specific) (default: 1.00) (no SERAP)" VAL_BLK 0x2001F0 AblGLKWBr32_S1 10 X1_S1 0 10 NUMBER 7 FORMAT "%10.7" /end CHARACTERISTIC
/begin CHARACTERISTIC ECE_FRQ_fac_C "F2364: N0I-N3I measurement factor (scaling from detected to relevant physical speed) (default: 1.00)" VAL_BLK 0x2003C8 AblGLKWBr32_S1 10 X1_S1 0 10 NUMBER 3 FORMAT "%10.7" /end CHARACTERISTIC
/begin CHARACTERISTIC ECE_FRQ_nMin_C "F2364: N0I-N3I minimum speed (ECE_FRQ_n) below which a timeout is detected and the speed is set to 0 (no SERAP)" VAL_BLK 0x20153E AblGLKWBuw_S1 200 N0_25_S1 0 200 NUMBER 3 FORMAT "%8.4" /end CHARACTERISTIC
/begin CHARACTERISTIC ECE_FRQ_numFifo_C "F2364: N0I-N3I signal detection over number of measurement tasks  (no SERAP)" VAL_BLK 0x20196F AblGLKWBub_S1 3 X1_S1 1 4 NUMBER 3 FORMAT "%5.3" /end CHARACTERISTIC
/begin CHARACTERISTIC ECE_FRQ_numGradFifo_C "F2364: N0I-N3I signal detection over number of measurement tasks  (no SERAP)" VAL_BLK 0x201972 AblGLKWBub_S1 3 X1_S1 1 4 NUMBER 3 FORMAT "%5.3" /end CHARACTERISTIC
/begin CHARACTERISTIC ECE_FRQ_numPlsPerRev_C "F2364: N0I-N3I Number of pulses per revolution  (no SERAP)" VAL_BLK 0x201975 AblGLKWBub_S1 190 X1_S1 10 200 NUMBER 3 FORMAT "%5.1" /end CHARACTERISTIC
/begin CHARACTERISTIC ECE_FRQ_stAvail_C "F2364: bit-array to select which N0I-N3I channel is activated (no SERAP)" VALUE 0x201978 AblGLKWub_S1 255 X1_S1 0 255 FORMAT "%5.1" /end CHARACTERISTIC
/begin CHARACTERISTIC ECE_FRQ_tiCfg_C "F2364: N0I-N3I timeout+channel configuration (0:timeout [0.25us], 1:timeout-weak [0.25us], 2:(pol<<8) duty-low=0 or duty-high=256) (no SERAP)" MAP 0x2003A4 AblGLFKFul_S1 4.29497E+009 X1_S1 0 4294967295 FORMAT "%13.2"
 /begin AXIS_DESCR FIX_AXIS ECE_idxDmy X1_S1 3 0 2 FIX_AXIS_PAR 0 0 3 FORMAT "%5.3" /end AXIS_DESCR
 /begin AXIS_DESCR FIX_AXIS ECE_idxDmy X1_S1 3 0 2 FIX_AXIS_PAR 0 0 3 FORMAT "%5.3" /end AXIS_DESCR
/end CHARACTERISTIC
/begin CHARACTERISTIC ECE_idxAdcAtf2_C "F2352: Index to Atf2-Temperature lines (only ADC-A) (0:high, 1:low) (no SERAP)" VAL_BLK 0x201544 AblGLKWBub_S1 255 X1_S1 0 255 NUMBER 2 FORMAT "%5.1" /end CHARACTERISTIC
/begin CHARACTERISTIC ECE_idxAdcAtf_C "F2352: Index to Atf-Temperature lines (only ADC-A) (0:high, 1:low) (no SERAP)" VAL_BLK 0x201546 AblGLKWBub_S1 255 X1_S1 0 255 NUMBER 2 FORMAT "%5.1" /end CHARACTERISTIC
/begin CHARACTERISTIC ECE_idxAdcBrk_C "F2352: Index of brake switch line (ADC-A/B) (no SERAP)" VAL_BLK 0x201979 AblGLKWBub_S1 255 X1_S1 0 255 NUMBER 1 FORMAT "%5.1" /end CHARACTERISTIC
/begin CHARACTERISTIC ECE_idxAdcDrvPos_C "F2352: Driver position sensing (only ADC-A) (0:main-line 1:alternative-line) (no SERAP)" VAL_BLK 0x201548 AblGLKWBub_S1 255 X1_S1 0 255 NUMBER 2 FORMAT "%5.1" /end CHARACTERISTIC
/begin CHARACTERISTIC ECE_idxAdcFdbkSsply5_C "F2352: Sensor Supply 5V feedback (ADC-A/B) (no SERAP)" VALUE 0x20197A AblGLKWub_S1 255 X1_S1 0 255 FORMAT "%5.1" /end CHARACTERISTIC
/begin CHARACTERISTIC ECE_idxAdcFdbkStrtRly_C "F2352: Feedback channel starter relay (only ADC-A) (no SERAP)" VAL_BLK 0x20197B AblGLKWBub_S1 255 X1_S1 0 255 NUMBER 1 FORMAT "%5.1" /end CHARACTERISTIC
/begin CHARACTERISTIC ECE_idxAdcLx_C "F2352: Index to ADC Lx-lines (only ADC-A).0=L01_new, 1=L02_new,...n=L11_old, n+1=L12_old.. (no SERAP)" MAP 0x2003D4 AblGLFKFub_S1 255 X1_S1 0 255 FORMAT "%5.1"
 /begin AXIS_DESCR FIX_AXIS ECE_idxDmy X1_S1 6 0 5 FIX_AXIS_PAR 0 0 6 FORMAT "%5.3" /end AXIS_DESCR
 /begin AXIS_DESCR FIX_AXIS ECE_idxDmy X1_S1 2 0 1 FIX_AXIS_PAR 0 0 2 FORMAT "%5.3" /end AXIS_DESCR
/end CHARACTERISTIC
/begin CHARACTERISTIC ECE_idxAdcOptRef_C "F2352: Index to Optional-lines reference (ADC-A/B) (not all migt be used) (no SERAP)" VAL_BLK 0x2003E0 AblGLKWBub_S1 255 X1_S1 0 255 NUMBER 8 FORMAT "%5.1" /end CHARACTERISTIC
/begin CHARACTERISTIC ECE_idxAdcOpt_C "F2352: Index to Optional-lines (ADC-A/B) (not all migt be used) (no SERAP)" VAL_BLK 0x2003E8 AblGLKWBub_S1 255 X1_S1 0 255 NUMBER 8 FORMAT "%5.1" /end CHARACTERISTIC
/begin CHARACTERISTIC ECE_idxAdcPres_C "F2352: Index of pressure switch lines (ADC-A/B) (no SERAP)" VAL_BLK 0x20197C AblGLKWBub_S1 255 X1_S1 0 255 NUMBER 5 FORMAT "%5.1" /end CHARACTERISTIC
/begin CHARACTERISTIC ECE_idxAdcTap_C "F2352: Index to Tap-lines (only ADC-A) (0:TapUp, 1:TapDn, 2:Man) (no SERAP)" VAL_BLK 0x201981 AblGLKWBub_S1 255 X1_S1 0 255 NUMBER 3 FORMAT "%5.1" /end CHARACTERISTIC
/begin CHARACTERISTIC ECE_idxAdcTim_C "F2352: Index to Timing Element (only ADC-A) (no SERAP)" VALUE 0x201984 AblGLKWub_S1 255 X1_S1 0 255 FORMAT "%5.1" /end CHARACTERISTIC
/begin CHARACTERISTIC ECE_idxAdcVdd3_C "F2352: Alternative Vdd3 (ADC-A/B) (no SERAP)" VALUE 0x201985 AblGLKWub_S1 255 X1_S1 0 255 FORMAT "%5.1" /end CHARACTERISTIC
/begin CHARACTERISTIC ECE_idxAdc_iHss_C "F2352: Current measurement channel High-Side Actuator control (only ADC-A) (no SERAP)" VAL_BLK 0x20154A AblGLKWBub_S1 255 X1_S1 0 255 NUMBER 2 FORMAT "%5.1" /end CHARACTERISTIC
/begin CHARACTERISTIC ECE_idxAdc_iPSply_C "F2352: Current measurement channel PSply channels (ADC-A/B) (no SERAP)" VAL_BLK 0x20154C AblGLKWBub_S1 255 X1_S1 0 255 NUMBER 2 FORMAT "%5.1" /end CHARACTERISTIC
/begin CHARACTERISTIC ECE_idxDigLx_C "F2352: Index to Digital Lx-lines (Bitno. to ECE_stLines).0=L01_new, 1=L02_new,...n=L11_old, n+1=L12_old.. (no SERAP)" MAP 0x2003F0 AblGLFKFub_S1 255 X1_S1 0 255 FORMAT "%5.1"
 /begin AXIS_DESCR FIX_AXIS ECE_idxDmy X1_S1 6 0 5 FIX_AXIS_PAR 0 0 6 FORMAT "%5.3" /end AXIS_DESCR
 /begin AXIS_DESCR FIX_AXIS ECE_idxDmy X1_S1 2 0 1 FIX_AXIS_PAR 0 0 2 FORMAT "%5.3" /end AXIS_DESCR
/end CHARACTERISTIC
/begin CHARACTERISTIC ECE_idxFrqTis2_C "F2352: Tis2 Input Speed to Input Frequency channel selection (idx=0:FRQ_N0,1:FRQ_N1,2:FRQ_N2,3:FRQ_N3) (no SERAP)" VALUE 0x201986 AblGLKWub_S1 3 X1_S1 0 3 FORMAT "%5.3" /end CHARACTERISTIC
/begin CHARACTERISTIC ECE_idxFrqTis_C "F2352: Tis Input Speed to Input Frequency channel selection (idx=0:FRQ_N0,1:FRQ_N1,2:FRQ_N2,3:FRQ_N3) (no SERAP)" VALUE 0x201987 AblGLKWub_S1 3 X1_S1 0 3 FORMAT "%5.3" /end CHARACTERISTIC
/begin CHARACTERISTIC ECE_idxFrqTos_C "F2352: Tis Output Speed to Input Frequency channel selection (idx=0:FRQ_N0,1:FRQ_N1,2:FRQ_N2,3:FRQ_N3) (no SERAP)" VALUE 0x201988 AblGLKWub_S1 3 X1_S1 0 3 FORMAT "%5.3" /end CHARACTERISTIC
/begin CHARACTERISTIC ECE_idxLxVarHandling_C "F2352: Lx lines configuration detection: 0 = new config; 1 = old config; 255 = auto detection (no SERAP)" VALUE 0x201989 AblGLKWub_S1 255 X1_S1 0 255 FORMAT "%5.1" /end CHARACTERISTIC
/begin CHARACTERISTIC ECE_idxPwdLx_C "F2352: Lx-lines PWD-channel selection (idx=0:L1,1:L2,2:L3,3:L4) (no SERAP)" VAL_BLK 0x2003FC AblGLKWBub_S1 5 X1_S1 0 5 NUMBER 4 FORMAT "%5.3" /end CHARACTERISTIC
/begin CHARACTERISTIC ECE_idxPwdOpt_C "F2352: Optional PWD-channel selection (idx=0...) (no SERAP)" VAL_BLK 0x200400 AblGLKWBub_S1 5 X1_S1 0 5 NUMBER 8 FORMAT "%5.3" /end CHARACTERISTIC
/begin CHARACTERISTIC ECE_idxPwdTapProt_C "F2352: optional Tap-Protocol channel (no SERAP)" VALUE 0x20198A AblGLKWub_S1 255 X1_S1 0 255 FORMAT "%5.1" /end CHARACTERISTIC
/begin CHARACTERISTIC ECE_idxPwdTapX_C "F2352: TapX PWD-channel selection (idx=0:TapUp,1:TapDn,2:Mgate) (no SERAP)" VAL_BLK 0x20198B AblGLKWBub_S1 5 X1_S1 0 5 NUMBER 3 FORMAT "%5.3" /end CHARACTERISTIC
/begin CHARACTERISTIC ECE_LSS_rMax_C "F2369: Maximum Duty for which the analog diagnosis is reliable (value shall be set to 100%-100%*50us/tiPer) (no SERAP)" VAL_BLK 0x201552 AblGLKWBuw_S1 100 R0_1_P_S1 0 100 NUMBER 5 FORMAT "%8.4" /end CHARACTERISTIC
/begin CHARACTERISTIC ECE_LSS_rMin_C "F2369: Minimum Duty for which the analog diagnosis is reliable (value shall be set to 100%*50us/tiPer) (no SERAP)" VAL_BLK 0x20155C AblGLKWBuw_S1 100 R0_1_P_S1 0 100 NUMBER 5 FORMAT "%8.4" /end CHARACTERISTIC
/begin CHARACTERISTIC ECE_LSS_stAvail_C "F2369: bit-array to select which output channel is activated (no SERAP)" VALUE 0x20198E AblGLKWub_S1 255 X1_S1 0 255 FORMAT "%5.1" /end CHARACTERISTIC
/begin CHARACTERISTIC ECE_LSS_stProt_C "F2369: bit-array to select that a channel is used as protocol channel (has to be prepared in project) (in that case ECE_LSS_rCmd is ignored) (no SERAP)" VALUE 0x20198F AblGLKWub_S1 255 X1_S1 0 255 FORMAT "%5.1" /end CHARACTERISTIC
/begin CHARACTERISTIC ECE_LSS_tiPerCmdInit_C "F2369: initialization value of the commanded output period (this value is only valid if activated per channel) (default=1.0) (no SERAP)" VAL_BLK 0x201566 AblGLKWBuw_S1 31.9 TI0_0005_M_S1 0.1 32 NUMBER 5 FORMAT "%8.5" /end CHARACTERISTIC
/begin CHARACTERISTIC ECE_numAdcFir_C "F2361: Filter constant for voltage detection (multiples of 1ms) (no SERAP)" VALUE 0x201958 AblGLKWub_S1 9 X1_S1 1 10 FORMAT "%5.2" /end CHARACTERISTIC
/begin CHARACTERISTIC ECE_numAdcNoiFir_C "F2361: Filter constant for voltage noise detection (multiples of 1ms) (no SERAP)" VALUE 0x201959 AblGLKWub_S1 9 X1_S1 1 10 FORMAT "%5.2" /end CHARACTERISTIC
/begin CHARACTERISTIC ECE_PSPLY_idxSpi_C "F2397: Assignment of a CG130-HSDx channel to PSply channel defined by this label (idx=0:CG130-HSD1,idx=1:HSD2, idx=2:HSD3) (no SERAP)" VAL_BLK 0x201990 AblGLKWBub_S1 2 X1_S1 0 2 NUMBER 3 FORMAT "%5.3" /end CHARACTERISTIC
/begin CHARACTERISTIC ECE_PSPLY_stHssForceOn_C "F2397: Force the specified bitcoded Hss channel output to on permanently (B0:HSD1,B1:HSD2,B2:HSD3,B3:HSD4,B4:HSD5,B5:HSD6) (no SERAP)" VALUE 0x201993 AblGLKWub_S1 255 X1_S1 0 255 FORMAT "%5.1" /end CHARACTERISTIC
/begin CHARACTERISTIC ECE_PSPLY_stHssSafOff_C "F2397: Selection which Hss channel output is switched off (B0:HSD1,B1:HSD2,B2:HSD3,B3:HSD4,B4:HSD5,B5:HSD6) (no SERAP)" VALUE 0x201994 AblGLKWub_S1 255 X1_S1 0 255 FORMAT "%5.1" /end CHARACTERISTIC
/begin CHARACTERISTIC ECE_PWD_tiDscr_C "F2359: Pulse-width demodulation descriptor (0:timeout [0.25us], 1:timeout-weak [0.25us], 2:(num-period<<16 + pol<<8) duty-low=65536 or duty-high=65792) (no SERAP)" MAP 0x200408 AblGLFKFul_S1 4.29497E+009 X1_S1 0 4294967295 FORMAT "%13.2"
 /begin AXIS_DESCR FIX_AXIS ECE_idxDmy X1_S1 3 0 2 FIX_AXIS_PAR 0 0 3 FORMAT "%5.3" /end AXIS_DESCR
 /begin AXIS_DESCR FIX_AXIS ECE_idxDmy X1_S1 6 0 5 FIX_AXIS_PAR 0 0 6 FORMAT "%5.3" /end AXIS_DESCR
/end CHARACTERISTIC
/begin CHARACTERISTIC ECE_PWM_stPolOut_C "F2371: Polarity of the output signal: 0=low-active, 1=high-active (CPU output polarity) (no SERAP)" VAL_BLK 0x201995 AblGLKWBub_S1 255 X1_S1 0 255 NUMBER 1 FORMAT "%5.1" /end CHARACTERISTIC
/begin CHARACTERISTIC ECE_PWM_tiPerInit_C "F2371: PWM output period initialization value (no SERAP)" VAL_BLK 0x201570 AblGLKWBuw_S1 32.7675 TI0_0005_M_S1 0 32.7675 NUMBER 1 FORMAT "%8.5" /end CHARACTERISTIC
/begin CHARACTERISTIC ECE_stAdcLxAvail_C "F2352: bitcoded definition for which Lx-line an analog signal is available. B0=Lx1,B1=Lx2.. (no SERAP)" VAL_BLK 0x20154E AblGLKWBub_S1 255 X1_S1 0 255 NUMBER 2 FORMAT "%5.1" /end CHARACTERISTIC
/begin CHARACTERISTIC ECE_stDigLxAvail_C "F2352: bitcoded definition for which Lx-line a digital signal is available. B0=Lx1,B1=Lx2.. (no SERAP)" VAL_BLK 0x201550 AblGLKWBub_S1 255 X1_S1 0 255 NUMBER 2 FORMAT "%5.1" /end CHARACTERISTIC
/begin CHARACTERISTIC ECE_uAdcNoiDecrLim_C "F2361: Noise decrease limit (voltage difference per main-task) (no SERAP)" VALUE 0x201528 AblGLKWuw_S1 9.99 U0_001_S1 0.01 10 FORMAT "%8.5" /end CHARACTERISTIC
/begin CHARACTERISTIC ECE_uAdcNoiJumpLim_C "F2361: Voltage jump evaluation limitation (no SERAP)" VALUE 0x20152A AblGLKWuw_S1 5 U0_001_S1 0 5 FORMAT "%8.6" /end CHARACTERISTIC
/begin CHARACTERISTIC EePstId_Cfg_idAddOem_C "F1100: Application value for additional OEM-ID part of PST-ID (no SERAP)" VAL_BLK 0x20157A AblGLKWBub_S1 255 X1_S1 0 255 NUMBER 2 FORMAT "%5.1" /end CHARACTERISTIC
/begin CHARACTERISTIC EePstId_Cfg_idOem_C "F1100: Application value for OEM-ID part of PST-ID (no SERAP)" VAL_BLK 0x20199F AblGLKWBub_S1 255 X1_S1 0 255 NUMBER 1 FORMAT "%5.1" /end CHARACTERISTIC
/begin CHARACTERISTIC EeUpdSrv_bDisblPstIdDstChsUpd_C "F1100: Application value deactivation DST-CHS update in PST-ID (0=current DST-CHS written together with PST-ID, 1=DST-CHS remains unchanged in PST-ID)" VALUE 0x20199E AblGLKWub_S1 255 X1_S1 0 255 FORMAT "%5.1" /end CHARACTERISTIC
/begin CHARACTERISTIC InpPAtfL2_facAtfMax_C "F2440: Maximum threshold for voltage factor facAtf" VAL_BLK 0x201388 AblGLKWBuw_S1 40 R0_001_S1 0 40 NUMBER 2 FORMAT "%8.5" /end CHARACTERISTIC
/begin CHARACTERISTIC InpPAtfL2_facAtfMin_C "F2440: Minimum threshold for voltage factor facAtf" VAL_BLK 0x20138C AblGLKWBuw_S1 20 R0_001_S1 0 20 NUMBER 2 FORMAT "%8.5" /end CHARACTERISTIC
/begin CHARACTERISTIC InpPAtfL2_idxAtfVarCnv_C "F2440: Reference table for limited ATF sensor variant read from EEProm (Col 1: EEP value; Col 2: assigned sensor variant)" MAP 0x2017DE AblGLFKFub_S1 255 X1_S1 0 255 FORMAT "%5.1"
 /begin AXIS_DESCR FIX_AXIS InpPAtfL2_yDmy X1_S1 2 0 1 FIX_AXIS_PAR 0 0 2 FORMAT "%5.3" /end AXIS_DESCR
 /begin AXIS_DESCR FIX_AXIS InpPAtfL2_yDmy X1_S1 5 0 4 FIX_AXIS_PAR 0 0 5 FORMAT "%5.3" /end AXIS_DESCR
/end CHARACTERISTIC
/begin CHARACTERISTIC InpPAtfL2_idxAtfVarDfl_C "F2440: Default Sensorvariant used if not found in InpPAtfL2_idxAtfVarCnv_C" VALUE 0x201AFA AblGLKWub_S1 1 X1_S1 0 1 FORMAT "%5.3" /end CHARACTERISTIC
/begin CHARACTERISTIC InpPAtfL2_swtAtfVarErr_C "F2440: Selection of sensor variant fault situation: 0=no fault; 1=fault if EEP value not supported;" VALUE 0x201AFB AblGLKWub_S1 2 X1_S1 0 2 FORMAT "%5.3" /end CHARACTERISTIC
/begin CHARACTERISTIC InpPAtfL2_tAtfCnvAbs_C[0] "F2440: Characteristic line for convertion sensor voltage to temperature (only sensor Hi line used)" CURVE 0x201390 AblGLKLuw_S1 255 T0_0625_OFFS_0x8000_S1 -40 215 FORMAT "%8.4"
 /begin AXIS_DESCR STD_AXIS InpPAtfL2_uAtfHi U0_001_S1 16 0 5 DEPOSIT ABSOLUTE FORMAT "%8.6" /end AXIS_DESCR
/end CHARACTERISTIC
/begin CHARACTERISTIC InpPAtfL2_tAtfCnvAbs_C[1] "F2440: Characteristic line for convertion sensor voltage to temperature (only sensor Hi line used)" CURVE 0x2013D2 AblGLKLuw_S1 255 T0_0625_OFFS_0x8000_S1 -40 215 FORMAT "%8.4"
 /begin AXIS_DESCR STD_AXIS InpPAtfL2_uAtfHi U0_001_S1 16 0 5 DEPOSIT ABSOLUTE FORMAT "%8.6" /end AXIS_DESCR
/end CHARACTERISTIC
/begin CHARACTERISTIC InpPAtfL2_tAtfRepl_C "F2440: Replacement for tAtf during electrical error and timeout" VALUE 0x2017E8 AblGLKWsw_S1 255 T0_0625_S1 -40 215 FORMAT "%8.4" /end CHARACTERISTIC
/begin CHARACTERISTIC InpPAtfL2_tiAtfErr_C "F2440: Error timeout timer reload value for fix replacement of tAtf" VALUE 0x2017EA AblGLKWuw_S1 10000 TI1_M_CYCLE_S1 0 10000 FORMAT "%8.2" /end CHARACTERISTIC
/begin CHARACTERISTIC InpPAtfL2_tiAtfIniDel_C "F2440: Delay time after initialization for fault prevention caused by unvalid signals" VALUE 0x201AFC AblGLKWub_S1 50 TI1_M_CYCLE_S1 0 50 FORMAT "%5.2" /end CHARACTERISTIC
/begin CHARACTERISTIC InpPAtfL2_uAtfGradMax_C "F2440: Maximum voltage differenz against old value (absolute) of ATF sensor" VAL_BLK 0x201414 AblGLKWBuw_S1 0.5 U0_001_S1 0 0.5 NUMBER 2 FORMAT "%9.7" /end CHARACTERISTIC
/begin CHARACTERISTIC InpPAtfL2_uAtfHiMax_C "F2440: Maximum voltage on the high line of the ATF sensor" VAL_BLK 0x201418 AblGLKWBuw_S1 5 U0_001_S1 0 5 NUMBER 2 FORMAT "%8.6" /end CHARACTERISTIC
/begin CHARACTERISTIC InpPAtfL2_uAtfHiMin_C "F2440: Minimum voltage on the high line of the ATF sensor" VAL_BLK 0x20141C AblGLKWBuw_S1 5 U0_001_S1 0 5 NUMBER 2 FORMAT "%8.6" /end CHARACTERISTIC
/begin CHARACTERISTIC InpPAtfL2_uAtfLoMax_C "F2440: Maximum Voltage on the low line of the ATF sensor" VAL_BLK 0x201420 AblGLKWBuw_S1 5 U0_001_S1 0 5 NUMBER 2 FORMAT "%8.6" /end CHARACTERISTIC
/begin CHARACTERISTIC InpPAtfL2_uAtfLoMin_C "F2440: Minimum voltage on the low line of the ATF sensor" VAL_BLK 0x201424 AblGLKWBuw_S1 5 U0_001_S1 0 5 NUMBER 2 FORMAT "%8.6" /end CHARACTERISTIC
/begin CHARACTERISTIC InpPAtfL2_uAtfSensMax_C "F2440: Maximum raw value of voltage difference ATF sensor" VAL_BLK 0x201428 AblGLKWBuw_S1 5 U0_001_S1 0 5 NUMBER 2 FORMAT "%8.6" /end CHARACTERISTIC
/begin CHARACTERISTIC InpPAtfL2_uAtfSensMin_C "F2440: Minimum raw value of voltage difference ATF sensor" VAL_BLK 0x20142C AblGLKWBuw_S1 5 U0_001_S1 0 5 NUMBER 2 FORMAT "%8.6" /end CHARACTERISTIC
/begin CHARACTERISTIC InpPAtfL3_stSubsPtd_C "F2440: Allowed sources for ATF substitution (bit 0: -, bit 1: ATF2, bit 2: CHP)" VALUE 0x201AFF AblGLKWub_S1 7 X1_S1 0 7 FORMAT "%5.3" /end CHARACTERISTIC
/begin CHARACTERISTIC InpPAtfL3_tSubsAtf2Ofs_C "F2440: Temperature offset for the ATF substitution by ATF2" VALUE 0x20182E AblGLKWsw_S1 100 T0_0625_S1 -50 50 FORMAT "%8.5" /end CHARACTERISTIC
/begin CHARACTERISTIC InpPAtfL3_tSubsChpOfs_C "F2440: Temperature offset for the ATF substitution by CHP" VALUE 0x201830 AblGLKWsw_S1 100 T0_0625_S1 -50 50 FORMAT "%8.5" /end CHARACTERISTIC
/begin CHARACTERISTIC InpPBatL2_tiBattDiff_C "F2410: If voltage difference between VB and VBS is higher limit after this time a fault indication bit is set." VALUE 0x2017EC AblGLKWuw_S1 1000 TI1_M_CYCLE_S1 0 1000 FORMAT "%8.3" /end CHARACTERISTIC
/begin CHARACTERISTIC InpPBatL2_tiBattLoVltg_C "F2410: If battery voltage is under threshold after this time a fault indication bit is set" VALUE 0x2017EE AblGLKWuw_S1 1000 TI1_M_CYCLE_S1 0 1000 FORMAT "%8.3" /end CHARACTERISTIC
/begin CHARACTERISTIC InpPBatL2_tiBattNoiVBS_C "F2410: Time const for holding the noise indication flag for prevention VBS monitoring" VALUE 0x2017F0 AblGLKWuw_S1 1000 TI1_M_CYCLE_S1 0 1000 FORMAT "%8.3" /end CHARACTERISTIC
/begin CHARACTERISTIC InpPBatL2_tiBattNoi_C "F2410: Time const for holding the noise indication flag" VALUE 0x2017F2 AblGLKWuw_S1 1000 TI1_M_CYCLE_S1 0 1000 FORMAT "%8.3" /end CHARACTERISTIC
/begin CHARACTERISTIC InpPBatL2_uBattLoLim_C "F2410: Lower threshold of normal battery voltage range" VALUE 0x2017F4 AblGLKWuw_S1 9.5 U0_001_S1 0 9.5 FORMAT "%8.6" /end CHARACTERISTIC
/begin CHARACTERISTIC InpPBatL2_uBattNoiLi_C "F2410: Threshold of maximum allowed noise voltage of the battery" VALUE 0x2017F6 AblGLKWuw_S1 16 U0_001_S1 0 16 FORMAT "%8.5" /end CHARACTERISTIC
/begin CHARACTERISTIC InpPBatL2_uBattSwtCal_C "F2410: Average voltage drop between VB and VBS" VALUE 0x2017F8 AblGLKWuw_S1 5 U0_001_S1 0 5 FORMAT "%8.6" /end CHARACTERISTIC
/begin CHARACTERISTIC InpPBatL2_uBattTolc_C "F2410: Allowed absolut tolerance of voltage difference between VB and VBS" VALUE 0x2017FA AblGLKWuw_S1 16 U0_001_S1 0 16 FORMAT "%8.5" /end CHARACTERISTIC
/begin CHARACTERISTIC InpPBatL2_uBattUpLim_C "F2410: Upper threshold of normal battery voltage range" VALUE 0x2017FC AblGLKWuw_S1 16.767 U0_001_S1 16 32.767 FORMAT "%8.5" /end CHARACTERISTIC
/begin CHARACTERISTIC InpPChipL2_tChpAdjOfsCal_C "F2442: Application offset for CG130 chip temp. adjustment" VAL_BLK 0x201434 AblGLKWBsw_S1 40 T0_0625_S1 -65 -25 NUMBER 2 FORMAT "%8.5" /end CHARACTERISTIC
/begin CHARACTERISTIC InpPChipL2_tChpDigThresHiLoLim_C "F2442: CG130 comparator TEMPH, lower limit" VAL_BLK 0x201438 AblGLKWBsw_S1 240 T0_0625_S1 -50 190 NUMBER 2 FORMAT "%8.4" /end CHARACTERISTIC
/begin CHARACTERISTIC InpPChipL2_tChpDigThresHiUpLim_C "F2442: CG130 comparator TEMPH, upper limit" VAL_BLK 0x20143C AblGLKWBsw_S1 240 T0_0625_S1 -50 190 NUMBER 2 FORMAT "%8.4" /end CHARACTERISTIC
/begin CHARACTERISTIC InpPChipL2_tChpDigThresLoLoLim_C "F2442: CG130 comparator TEMPL, lower limit" VAL_BLK 0x201440 AblGLKWBsw_S1 240 T0_0625_S1 -50 190 NUMBER 2 FORMAT "%8.4" /end CHARACTERISTIC
/begin CHARACTERISTIC InpPChipL2_tChpDigThresLoUpLim_C "F2442: CG130 comparator TEMPL, upper limit" VAL_BLK 0x201444 AblGLKWBsw_S1 240 T0_0625_S1 -50 190 NUMBER 2 FORMAT "%8.4" /end CHARACTERISTIC
/begin CHARACTERISTIC InpPChipL2_tChpIni_C "F2442: Init value of CG130 chip temperature" VALUE 0x2017FE AblGLKWsw_S1 250 T0_0625_S1 -50 200 FORMAT "%8.4" /end CHARACTERISTIC
/begin CHARACTERISTIC InpPChipL2_tiChpFault_C "F2442: Reload value of timeout timer on CG130 chip temperatur signal fault" VALUE 0x201800 AblGLKWuw_S1 5000 TI1_M_CYCLE_S1 0 5000 FORMAT "%8.3" /end CHARACTERISTIC
/begin CHARACTERISTIC InpPChipL2_tiChpIniDel_C "F2442: Delay time after initialization for fault prevention caused by unvalid signals" VALUE 0x201AFD AblGLKWub_S1 50 TI1_M_CYCLE_S1 0 50 FORMAT "%5.2" /end CHARACTERISTIC
/begin CHARACTERISTIC InpPChipL2_xChpAdjMulCal_C "F2442: Application factor for CG130 chip temp. adjustment (°C/Bit x 10 000) (no SERAP)" VAL_BLK 0x201430 AblGLKWBuw_S1 500 R0_0625_S1 2000 2500 NUMBER 2 FORMAT "%8.3" /end CHARACTERISTIC
/begin CHARACTERISTIC InpPChipL2_xChpRawMax_C "F2442: Maximum allowed raw value of the CG130 chip temperature signal" VALUE 0x201802 AblGLKWuw_S1 65534 X1_S1 0 65534 FORMAT "%8.2" /end CHARACTERISTIC
/begin CHARACTERISTIC InpPChipL2_xChpRawMin_C "F2442: Minimum allowed raw value of the CG130 chip temperature signal" VALUE 0x201804 AblGLKWuw_S1 65534 X1_S1 1 65535 FORMAT "%8.2" /end CHARACTERISTIC
/begin CHARACTERISTIC InpPChipL3_stSubsPtd_C "F2442: Allowed sources for CHP substitution: Bit 2: CHP2, Bit 1:CHP1, Bit 0: ATF" VALUE 0x201B00 AblGLKWub_S1 6 X1_S1 1 7 FORMAT "%5.3" /end CHARACTERISTIC
/begin CHARACTERISTIC InpPChipL3_tSubsAtfOfs_C "F2442: Temperature offset added to ATF as substitution for CHP1" VALUE 0x201832 AblGLKWsw_S1 100 T0_0625_S1 -50 50 FORMAT "%8.5" /end CHARACTERISTIC
/begin CHARACTERISTIC InpPChipL3_tSubsChp2Ofs_C "F2442: Temperature offset added to the CHP2 as substitution for CHP1" VALUE 0x201834 AblGLKWsw_S1 100 T0_0625_S1 -50 50 FORMAT "%8.5" /end CHARACTERISTIC
/begin CHARACTERISTIC InpPChp2L2_stPtt_C "F2443: Bit mask for checking the bit pattern of the received sensor value" VALUE 0x201806 AblGLKWuw_S1 65535 X1_S1 0 65535 FORMAT "%8.2" /end CHARACTERISTIC
/begin CHARACTERISTIC InpPChp2L2_tChp2Ini_C "F2443: Init value of chip 2 temperature" VALUE 0x201808 AblGLKWsw_S1 255 T0_0625_S1 -40 215 FORMAT "%8.4" /end CHARACTERISTIC
/begin CHARACTERISTIC InpPChp2L2_tChp2MidDwn_C "F2443: Lower threshold of the middle signal range (for 0xffff error recognition)" VALUE 0x20180A AblGLKWsw_S1 511.992 T0_0078125_S1 -256 255.9922 FORMAT "%8.4" /end CHARACTERISTIC
/begin CHARACTERISTIC InpPChp2L2_tChp2MidUp_C "F2443:  Upper threshold of the middle signal range (for 0xffff error recognition)" VALUE 0x20180C AblGLKWsw_S1 511.992 T0_0078125_S1 -256 255.9922 FORMAT "%8.4" /end CHARACTERISTIC
/begin CHARACTERISTIC InpPChp2L2_tChp2RawMax_C "F2443: Maximum allowed temperature value of the external chip temperature sensor" VALUE 0x20180E AblGLKWsw_S1 511.992 T0_0078125_S1 -256 255.9922 FORMAT "%8.4" /end CHARACTERISTIC
/begin CHARACTERISTIC InpPChp2L2_tChp2RawMin_C "F2443: Minimum allowed temperature value of the external chip temperature sensor" VALUE 0x201810 AblGLKWsw_S1 511.992 T0_0078125_S1 -256 255.9922 FORMAT "%8.4" /end CHARACTERISTIC
/begin CHARACTERISTIC InpPChp2L2_tiChp2Fault_C "F2443: Reload value of the timeout timer on signal fault" VALUE 0x201812 AblGLKWuw_S1 5000 TI1_M_CYCLE_S1 0 5000 FORMAT "%8.3" /end CHARACTERISTIC
/begin CHARACTERISTIC InpPChp2L2_tiChp2IniTo_C "F2443:  Time out value of the init phase for externel chip temperature" VALUE 0x201814 AblGLKWuw_S1 10 TI1_CYCLE_S1 0 10 FORMAT "%8.5" /end CHARACTERISTIC
/begin CHARACTERISTIC InpPChp2L2_xChp2RawIni_C "F2443: Init value of the external chip temperature sensor to be ignored (without quantisation)" VALUE 0x201816 AblGLKWuw_S1 65535 X1_S1 0 65535 FORMAT "%8.2" /end CHARACTERISTIC
/begin CHARACTERISTIC InpPPsnsL2_ctPsnsIni_C "F2450: Reload value of the program cycle down counter after reset." VALUE 0x201AFE AblGLKWub_S1 20 X1_S1 0 20 FORMAT "%5.2" /end CHARACTERISTIC
/begin CHARACTERISTIC InpPPsnsL2_rPsnsAnaZon_C "F2450: Ratio thresholds of analog positions ranges:  <[0]: SG; <[1]: ON; <[2]: UNDEF; <[3]: OFF; <[4]: OP; >[5]: SB" MAP 0x201448 AblGLFKFuw_S1 1 R0_0001_S1 0 1 FORMAT "%8.6"
 /begin AXIS_DESCR FIX_AXIS InpPPsnsL2_ctRngIdx X1_S1 5 0 4 FIX_AXIS_PAR 0 0 5 FORMAT "%5.3" /end AXIS_DESCR
 /begin AXIS_DESCR FIX_AXIS InpPPsnsL2_ctChnIdx X1_S1 6 0 5 FIX_AXIS_PAR 0 0 6 FORMAT "%5.3" /end AXIS_DESCR
/end CHARACTERISTIC
/begin CHARACTERISTIC InpPPsnsL2_rPsnsOnOffThres_C "F2450: threshold for nominal value" VALUE 0x201818 AblGLKWuw_S1 6.5535 R0_0001_S1 0 6.5535 FORMAT "%8.6" /end CHARACTERISTIC
/begin CHARACTERISTIC InpPPsnsL2_tiFault_C "F2450: Start value for tiFault. Timeout timer for sensor supply fault." VALUE 0x20181A AblGLKWuw_S1 1000 TI1_M_CYCLE_S1 0 1000 FORMAT "%8.3" /end CHARACTERISTIC
/begin CHARACTERISTIC InpPPsnsL2_uSSplyThres_C "F2450: Threshold for sufficient sensor supply voltage" VALUE 0x20181C AblGLKWuw_S1 15 U0_001_S1 0 15 FORMAT "%8.5" /end CHARACTERISTIC
/begin CHARACTERISTIC InpPPsnsL3_stPsnsChng_C "F2450: Bit word for activation of the toggle condition for every position line (1= on, 0= off)" VALUE 0x201B01 AblGLKWub_S1 63 X1_S1 0 63 FORMAT "%5.2" /end CHARACTERISTIC
/begin CHARACTERISTIC InpPPsnsL3_stPsnsMon_C "F2450: Bit word for activation the fault message to the DSM interface for every position line (1= on, 0= off)" VALUE 0x201B02 AblGLKWub_S1 63 X1_S1 0 63 FORMAT "%5.2" /end CHARACTERISTIC
/begin CHARACTERISTIC InpPPSplyL3_bPrs_C "F2411: Availability of power supply lines bidcoded (bit x=1/0: Channel x available/not available)" VALUE 0x201836 AblGLKWuw_S1 3 X1_S1 0 3 FORMAT "%8.6" /end CHARACTERISTIC
/begin CHARACTERISTIC InpPPSplyL3_swtBattSply_C "F2411: Source selection switch of the power stage supply (<>1: uBatt, =1: uWak1)" VALUE 0x201B03 AblGLKWub_S1 1 X1_S1 0 1 FORMAT "%5.3" /end CHARACTERISTIC
/begin CHARACTERISTIC InpPPSplyL3_uThres_C "F2411: Threshold of Power Supply Voltage for ADC saturation" VALUE 0x201838 AblGLKWuw_S1 32.767 U0_001_S1 0 32.767 FORMAT "%8.5" /end CHARACTERISTIC
/begin CHARACTERISTIC InpPTisL2_fHwDiaMax_C "F2431: Frequency threshold of using the HW diagnostic info from the sensor" VALUE 0x20181E AblGLKWuw_S1 15000 F1_S1 0 15000 FORMAT "%8.2" /end CHARACTERISTIC
/begin CHARACTERISTIC InpPTisL2_fThresHwProt_C "F2431: For SB fault active and frequency lower threshold the protection circuit is activated (if available)" VALUE 0x201820 AblGLKWuw_S1 15000 F1_S1 0 15000 FORMAT "%8.2" /end CHARACTERISTIC
/begin CHARACTERISTIC InpPTisL2_tiFault_C "F2431: Time until TIS timeout recognition" VALUE 0x201822 AblGLKWuw_S1 1000 TI1_M_CYCLE_S1 0 1000 FORMAT "%8.3" /end CHARACTERISTIC
/begin CHARACTERISTIC InpPTisL2_uSplyMin_C "F2431: Lower limit of an allowed sensor supply voltage for TIS detection" VALUE 0x201824 AblGLKWuw_S1 12 U0_001_S1 0 12 FORMAT "%8.5" /end CHARACTERISTIC
/begin CHARACTERISTIC InpPTisL3_tiSSplyDel_C "F2431: Delay time const. for HW diagnosis fault prevention after missing or switched off sensor supply" VALUE 0x201B04 AblGLKWub_S1 1275 TI1_M_CYCLE_S1 0 1275 FORMAT "%5.0" /end CHARACTERISTIC
/begin CHARACTERISTIC InpPTosL2_fHwDiaMax_C "F2430: Frequency threshold of using the HW diagnostic info from the sensor" VALUE 0x201826 AblGLKWuw_S1 15000 F1_S1 0 15000 FORMAT "%8.2" /end CHARACTERISTIC
/begin CHARACTERISTIC InpPTosL2_fThresHwProt_C "F2430: For SB fault active and frequency lower threshold the protection circuit is activated (if available)" VALUE 0x201828 AblGLKWuw_S1 15000 F1_S1 0 15000 FORMAT "%8.2" /end CHARACTERISTIC
/begin CHARACTERISTIC InpPTosL2_tiFault_C "F2430: Time until TOS timeout recognition" VALUE 0x20182A AblGLKWuw_S1 1000 TI1_M_CYCLE_S1 0 1000 FORMAT "%8.3" /end CHARACTERISTIC
/begin CHARACTERISTIC InpPTosL2_uSplyMin_C "F2430: Lower limit of an allowed sensor supply voltage for TOS detection" VALUE 0x20182C AblGLKWuw_S1 12 U0_001_S1 0 12 FORMAT "%8.5" /end CHARACTERISTIC
/begin CHARACTERISTIC InpPTosL3_tiSSplyDel_C "F2430: Delay time const. for HW diagnosis fault prevention after missing or switched off sensor supply" VALUE 0x201B05 AblGLKWub_S1 1275 TI1_M_CYCLE_S1 0 1275 FORMAT "%5.0" /end CHARACTERISTIC
/begin CHARACTERISTIC InpPWakL2_bWak1SrcSel_C "F2420: Switch for selection of bWak1 source: FALSE=bWak1, TRUE=uWak1>=uWakThresOn_C" VALUE 0x201B0D AblGLKWub_S1 1 B_TRUE_S1 0 1 FORMAT "%13.11" /end CHARACTERISTIC
/begin CHARACTERISTIC InpPWakL2_swtPrsWak2_C "F2420: Switch for availability of WAKE2 (1: available, 0: not available) (no SERAP)" VALUE 0x201B0C AblGLKWub_S1 1 X1_S1 0 1 FORMAT "%5.3" /end CHARACTERISTIC
/begin CHARACTERISTIC InpPWakL2_uThresWak_C "F2420: Threshold of Wake up Voltage for ADC saturation" VALUE 0x20194E AblGLKWuw_S1 25 U0_001_S1 0 25 FORMAT "%8.5" /end CHARACTERISTIC
/begin CHARACTERISTIC InpPWakL2_uWak1ThresOn_C "F2420: Threshold for uWak1 if uWak1 is used as source for bWak1." VALUE 0x201950 AblGLKWuw_S1 20 U0_001_S1 0 20 FORMAT "%8.5" /end CHARACTERISTIC
/begin CHARACTERISTIC MsrvMemByAdr_swtAllwDvlpTab_C "F1405: Switches between two permission tables (if MSRV_GEN_PRMS_NUM_TAB==2): TRUE=development/FALSE=series" VALUE 0x201A31 AblGLKWub_S1 1 B_TRUE_S1 0 1 FORMAT "%13.11" /end CHARACTERISTIC
/begin CHARACTERISTIC OmmBc_sPrepCfg_C "F1750: Configuration word for changing to BC" VALUE 0x2019CA AblGLKWub_S1 255 X1_S1 0 255 FORMAT "%5.1" /end CHARACTERISTIC
/begin CHARACTERISTIC OmmSdMgr_xCtl_C "F1740: Control word block for shutdown coordination, index selects the mode specific configuration (0: INI; 1: not INI)" VAL_BLK 0x20045C AblGLKWBuw_S1 65535 X1_S1 0 65535 NUMBER 2 FORMAT "%8.2" /end CHARACTERISTIC
/begin CHARACTERISTIC OutPRstL3_tiHwDly_C "F2510: After that time the application will be informed that the sensor supply is on" VALUE 0x20199A AblGLKWub_S1 20 TI1_M_CYCLE_S1 0 20 FORMAT "%5.2" /end CHARACTERISTIC
/begin CHARACTERISTIC OutPRstL3_tiSSplyMinOn_C "F2510: Represents the time which the sensor voltage must be on before the next reset request is possible" VALUE 0x20199B AblGLKWub_S1 255 TI1_M_CYCLE_S1 0 255 FORMAT "%5.1" /end CHARACTERISTIC
/begin CHARACTERISTIC OutPRstL3_tiSSplyOff_C "F2510: Represents the time which the sensor voltage will be switched off during a reset" VALUE 0x20199C AblGLKWub_S1 255 TI1_M_CYCLE_S1 0 255 FORMAT "%5.1" /end CHARACTERISTIC
/begin CHARACTERISTIC RamBuf_numClearReq_C "F1220: Buffered RAM clear request which is evaluated upon next system start (0xA5 or 0x5A is possible) (to activate this function, the value has to be changed !)" VALUE 0x201952 AblGLKWub_S1 255 X1_S1 0 255 FORMAT "%5.1" /end CHARACTERISTIC
/begin CHARACTERISTIC RamStckMon_bRstDat_C "F1270: Flag to clear stored information (if TRUE)" VALUE 0x201A32 AblGLKWub_S1 1 B_TRUE_S1 0 1 FORMAT "%13.11" /end CHARACTERISTIC
/begin CHARACTERISTIC Rom_stMonActvCpl_C "F1351: Complement status if the ROM checksum is active or not. Bit coded 0=active 1=not active" VALUE 0x20157C AblGLKWuw_S1 65535 X1_S1 0 65535 FORMAT "%8.2" /end CHARACTERISTIC
/begin CHARACTERISTIC Rom_stMonActv_C "F1351: Status if the ROM checksum is active or not. Bit coded 1=active 0=not active" VALUE 0x20157E AblGLKWuw_S1 65535 X1_S1 0 65535 FORMAT "%8.2" /end CHARACTERISTIC
/begin CHARACTERISTIC ShrEe_xEeInfoCfgCh0_C "F1100: Configuration for EeInfo parameter channel 00 (SET_ZF_EEPROM_INIT_ZYKLISCH)" VALUE 0x2019B9 AblGLKWub_S1 255 X1_S1 0 255 FORMAT "%5.1" /end CHARACTERISTIC
/begin CHARACTERISTIC ShrEe_xEeInfoCfgCh10_C "F1100: Configuration for EeInfo parameter channel 10 (SET_ZF_EEPROM_INIT_ZYKLISCH)" VALUE 0x2019BA AblGLKWub_S1 255 X1_S1 0 255 FORMAT "%5.1" /end CHARACTERISTIC
/begin CHARACTERISTIC ShrEe_xEeInfoCfgCh11_C "F1100: Configuration for EeInfo parameter channel 11 (SET_ZF_EEPROM_INIT_ZYKLISCH)" VALUE 0x2019BB AblGLKWub_S1 255 X1_S1 0 255 FORMAT "%5.1" /end CHARACTERISTIC
/begin CHARACTERISTIC ShrEe_xEeInfoCfgCh12_C "F1100: Configuration for EeInfo parameter channel 12 (SET_ZF_EEPROM_INIT_ZYKLISCH)" VALUE 0x2019BC AblGLKWub_S1 255 X1_S1 0 255 FORMAT "%5.1" /end CHARACTERISTIC
/begin CHARACTERISTIC ShrEe_xEeInfoCfgCh13_C "F1100: Configuration for EeInfo parameter channel 13 (SET_ZF_EEPROM_INIT_ZYKLISCH)" VALUE 0x2019BD AblGLKWub_S1 255 X1_S1 0 255 FORMAT "%5.1" /end CHARACTERISTIC
/begin CHARACTERISTIC ShrEe_xEeInfoCfgCh14_C "F1100: Configuration for EeInfo parameter channel 14 (SET_ZF_EEPROM_INIT_ZYKLISCH)" VALUE 0x2019BE AblGLKWub_S1 255 X1_S1 0 255 FORMAT "%5.1" /end CHARACTERISTIC
/begin CHARACTERISTIC ShrEe_xEeInfoCfgCh15_C "F1100: Configuration for EeInfo parameter channel 15 (SET_ZF_EEPROM_INIT_ZYKLISCH)" VALUE 0x2019BF AblGLKWub_S1 255 X1_S1 0 255 FORMAT "%5.1" /end CHARACTERISTIC
/begin CHARACTERISTIC ShrEe_xEeInfoCfgCh1_C "F1100: Configuration for EeInfo parameter channel 01 (SET_ZF_EEPROM_INIT_ZYKLISCH)" VALUE 0x2019C0 AblGLKWub_S1 255 X1_S1 0 255 FORMAT "%5.1" /end CHARACTERISTIC
/begin CHARACTERISTIC ShrEe_xEeInfoCfgCh2_C "F1100: Configuration for EeInfo parameter channel 02 (SET_ZF_EEPROM_INIT_ZYKLISCH)" VALUE 0x2019C1 AblGLKWub_S1 255 X1_S1 0 255 FORMAT "%5.1" /end CHARACTERISTIC
/begin CHARACTERISTIC ShrEe_xEeInfoCfgCh3_C "F1100: Configuration for EeInfo parameter channel 03 (SET_ZF_EEPROM_INIT_ZYKLISCH)" VALUE 0x2019C2 AblGLKWub_S1 255 X1_S1 0 255 FORMAT "%5.1" /end CHARACTERISTIC
/begin CHARACTERISTIC ShrEe_xEeInfoCfgCh4_C "F1100: Configuration for EeInfo parameter channel 04 (SET_ZF_EEPROM_INIT_ZYKLISCH)" VALUE 0x2019C3 AblGLKWub_S1 255 X1_S1 0 255 FORMAT "%5.1" /end CHARACTERISTIC
/begin CHARACTERISTIC ShrEe_xEeInfoCfgCh5_C "F1100: Configuration for EeInfo parameter channel 05 (SET_ZF_EEPROM_INIT_ZYKLISCH)" VALUE 0x2019C4 AblGLKWub_S1 255 X1_S1 0 255 FORMAT "%5.1" /end CHARACTERISTIC
/begin CHARACTERISTIC ShrEe_xEeInfoCfgCh6_C "F1100: Configuration for EeInfo parameter channel 06 (SET_ZF_EEPROM_INIT_ZYKLISCH)" VALUE 0x2019C5 AblGLKWub_S1 255 X1_S1 0 255 FORMAT "%5.1" /end CHARACTERISTIC
/begin CHARACTERISTIC ShrEe_xEeInfoCfgCh7_C "F1100: Configuration for EeInfo parameter channel 07 (SET_ZF_EEPROM_INIT_ZYKLISCH)" VALUE 0x2019C6 AblGLKWub_S1 255 X1_S1 0 255 FORMAT "%5.1" /end CHARACTERISTIC
/begin CHARACTERISTIC ShrEe_xEeInfoCfgCh8_C "F1100: Configuration for EeInfo parameter channel 08 (SET_ZF_EEPROM_INIT_ZYKLISCH)" VALUE 0x2019C7 AblGLKWub_S1 255 X1_S1 0 255 FORMAT "%5.1" /end CHARACTERISTIC
/begin CHARACTERISTIC ShrEe_xEeInfoCfgCh9_C "F1100: Configuration for EeInfo parameter channel 09 (SET_ZF_EEPROM_INIT_ZYKLISCH)" VALUE 0x2019C8 AblGLKWub_S1 255 X1_S1 0 255 FORMAT "%5.1" /end CHARACTERISTIC
/begin CHARACTERISTIC ShrEe_xSctnCfgCh0_C "F1100: Configuration for ZF EEPROM channel 00 ([0]=Nr, [1]=Attribute, [2]=Version, [3]=Add.Conf.) (no SERAP)" VAL_BLK 0x200500 AblGLKWBuw_S1 65535 X1_S1 0 65535 NUMBER 4 FORMAT "%8.2" /end CHARACTERISTIC
/begin CHARACTERISTIC ShrEe_xSctnCfgCh10_C "F1100: Configuration for ZF EEPROM channel 10 ([0]=Nr, [1]=Attribute, [2]=Version, [3]=Add.Conf.) (no SERAP)" VAL_BLK 0x200508 AblGLKWBuw_S1 65535 X1_S1 0 65535 NUMBER 4 FORMAT "%8.2" /end CHARACTERISTIC
/begin CHARACTERISTIC ShrEe_xSctnCfgCh11_C "F1100: Configuration for ZF EEPROM channel 11 ([0]=Nr, [1]=Attribute, [2]=Version, [3]=Add.Conf.) (no SERAP)" VAL_BLK 0x200510 AblGLKWBuw_S1 65535 X1_S1 0 65535 NUMBER 4 FORMAT "%8.2" /end CHARACTERISTIC
/begin CHARACTERISTIC ShrEe_xSctnCfgCh12_C "F1100: Configuration for ZF EEPROM channel 12 ([0]=Nr, [1]=Attribute, [2]=Version, [3]=Add.Conf.) (no SERAP)" VAL_BLK 0x200518 AblGLKWBuw_S1 65535 X1_S1 0 65535 NUMBER 4 FORMAT "%8.2" /end CHARACTERISTIC
/begin CHARACTERISTIC ShrEe_xSctnCfgCh13_C "F1100: Configuration for ZF EEPROM channel 13 ([0]=Nr, [1]=Attribute, [2]=Version, [3]=Add.Conf.) (no SERAP)" VAL_BLK 0x200520 AblGLKWBuw_S1 65535 X1_S1 0 65535 NUMBER 4 FORMAT "%8.2" /end CHARACTERISTIC
/begin CHARACTERISTIC ShrEe_xSctnCfgCh14_C "F1100: Configuration for ZF EEPROM channel 14 ([0]=Nr, [1]=Attribute, [2]=Version, [3]=Add.Conf.) (no SERAP)" VAL_BLK 0x200528 AblGLKWBuw_S1 65535 X1_S1 0 65535 NUMBER 4 FORMAT "%8.2" /end CHARACTERISTIC
/begin CHARACTERISTIC ShrEe_xSctnCfgCh15_C "F1100: Configuration for ZF EEPROM channel 15 ([0]=Nr, [1]=Attribute, [2]=Version, [3]=Add.Conf.) (no SERAP)" VAL_BLK 0x200530 AblGLKWBuw_S1 65535 X1_S1 0 65535 NUMBER 4 FORMAT "%8.2" /end CHARACTERISTIC
/begin CHARACTERISTIC ShrEe_xSctnCfgCh1_C "F1100: Configuration for ZF EEPROM channel 01 ([0]=Nr, [1]=Attribute, [2]=Version, [3]=Add.Conf.) (no SERAP)" VAL_BLK 0x200538 AblGLKWBuw_S1 65535 X1_S1 0 65535 NUMBER 4 FORMAT "%8.2" /end CHARACTERISTIC
/begin CHARACTERISTIC ShrEe_xSctnCfgCh2_C "F1100: Configuration for ZF EEPROM channel 02 ([0]=Nr, [1]=Attribute, [2]=Version, [3]=Add.Conf.) (no SERAP)" VAL_BLK 0x200540 AblGLKWBuw_S1 65535 X1_S1 0 65535 NUMBER 4 FORMAT "%8.2" /end CHARACTERISTIC
/begin CHARACTERISTIC ShrEe_xSctnCfgCh3_C "F1100: Configuration for ZF EEPROM channel 03 ([0]=Nr, [1]=Attribute, [2]=Version, [3]=Add.Conf.) (no SERAP)" VAL_BLK 0x200548 AblGLKWBuw_S1 65535 X1_S1 0 65535 NUMBER 4 FORMAT "%8.2" /end CHARACTERISTIC
/begin CHARACTERISTIC ShrEe_xSctnCfgCh4_C "F1100: Configuration for ZF EEPROM channel 04 ([0]=Nr, [1]=Attribute, [2]=Version, [3]=Add.Conf.) (no SERAP)" VAL_BLK 0x200550 AblGLKWBuw_S1 65535 X1_S1 0 65535 NUMBER 4 FORMAT "%8.2" /end CHARACTERISTIC
/begin CHARACTERISTIC ShrEe_xSctnCfgCh5_C "F1100: Configuration for ZF EEPROM channel 05 ([0]=Nr, [1]=Attribute, [2]=Version, [3]=Add.Conf.) (no SERAP)" VAL_BLK 0x200558 AblGLKWBuw_S1 65535 X1_S1 0 65535 NUMBER 4 FORMAT "%8.2" /end CHARACTERISTIC
/begin CHARACTERISTIC ShrEe_xSctnCfgCh6_C "F1100: Configuration for ZF EEPROM channel 06 ([0]=Nr, [1]=Attribute, [2]=Version, [3]=Add.Conf.) (no SERAP)" VAL_BLK 0x200560 AblGLKWBuw_S1 65535 X1_S1 0 65535 NUMBER 4 FORMAT "%8.2" /end CHARACTERISTIC
/begin CHARACTERISTIC ShrEe_xSctnCfgCh7_C "F1100: Configuration for ZF EEPROM channel 07 ([0]=Nr, [1]=Attribute, [2]=Version, [3]=Add.Conf.) (no SERAP)" VAL_BLK 0x200568 AblGLKWBuw_S1 65535 X1_S1 0 65535 NUMBER 4 FORMAT "%8.2" /end CHARACTERISTIC
/begin CHARACTERISTIC ShrEe_xSctnCfgCh8_C "F1100: Configuration for ZF EEPROM channel 08 ([0]=Nr, [1]=Attribute, [2]=Version, [3]=Add.Conf.) (no SERAP)" VAL_BLK 0x200570 AblGLKWBuw_S1 65535 X1_S1 0 65535 NUMBER 4 FORMAT "%8.2" /end CHARACTERISTIC
/begin CHARACTERISTIC ShrEe_xSctnCfgCh9_C "F1100: Configuration for ZF EEPROM channel 09 ([0]=Nr, [1]=Attribute, [2]=Version, [3]=Add.Conf.) (no SERAP)" VAL_BLK 0x200578 AblGLKWBuw_S1 65535 X1_S1 0 65535 NUMBER 4 FORMAT "%8.2" /end CHARACTERISTIC
/begin MEASUREMENT CanA_EwsMsgRx "Cyclic buffer for EWS CAN frames received on A CAN" UBYTE X1_M 1 100 0 255 FORMAT "%5.1" ARRAY_SIZE 179 ECU_ADDRESS 0xFFF9529E /end MEASUREMENT
/begin MEASUREMENT CanA_stEwsRx "State of EWS reception on A CAN" UBYTE X1_M 1 100 0 255 FORMAT "%5.1" ECU_ADDRESS 0xFFF954E5 /end MEASUREMENT
/begin MEASUREMENT CanFA_EwsMsgRx "Cyclic buffer for EWS CAN frames received on FA CAN" UBYTE X1_M 1 100 0 255 FORMAT "%5.1" ARRAY_SIZE 179 ECU_ADDRESS 0xFFF95351 /end MEASUREMENT
/begin MEASUREMENT CanFA_stEwsRx "State of EWS reception on FA CAN" UBYTE X1_M 1 100 0 255 FORMAT "%5.1" ECU_ADDRESS 0xFFF954E6 /end MEASUREMENT
/begin MEASUREMENT Can_EwsMsgTx "Buffer for CAN frames" UBYTE X1_M 1 100 0 255 FORMAT "%5.1" ARRAY_SIZE 179 ECU_ADDRESS 0xFFF951EB /end MEASUREMENT
/begin MEASUREMENT Can_stEwsTx "State EWS transmission" UBYTE X1_M 1 100 0 255 FORMAT "%5.1" ECU_ADDRESS 0xFFF954E7 /end MEASUREMENT
/begin MEASUREMENT CAN_tiPowerup "F9175: CAN Powerup Check timer" UBYTE TI1_M_CYCLE_M 1 100 0 1275 FORMAT "%5.0" ECU_ADDRESS 0xFFF95D2F /end MEASUREMENT
/begin MEASUREMENT COM_xBbRefId "F9260: Systemhouse identifier for test only, BB version. 8 characters ASCII" UBYTE X_ASCII_M 1 100 32 125 FORMAT "%13.9" ARRAY_SIZE 8 ECU_ADDRESS 0xFFF92190 /end MEASUREMENT
/begin MEASUREMENT COM_xBcRefId "F9260: Systemhouse identifier for test only, BC version. 8 characters ASCII" UBYTE X_ASCII_M 1 100 32 125 FORMAT "%13.9" ARRAY_SIZE 8 ECU_ADDRESS 0xFFF92198 /end MEASUREMENT
/begin MEASUREMENT COM_xPrgRefIdMeas "F9260: Systemhouse identifier for test only, name. 8 characters ASCII" UBYTE X_ASCII_M 1 100 32 125 FORMAT "%13.9" ARRAY_SIZE 8 ECU_ADDRESS 0xFFF8400C /end MEASUREMENT
/begin MEASUREMENT COM_xPrgVersMeas "F9260: Systemhouse identifier for test only, build version. 8 characters ASCII" UBYTE X_ASCII_M 1 100 32 125 FORMAT "%13.9" ARRAY_SIZE 8 ECU_ADDRESS 0xFFF84014 /end MEASUREMENT
/begin MEASUREMENT COM_xSbRefId "F9260: Systemhouse identifier for test only, SB Version. 8 characters ASCII" UBYTE X_ASCII_M 1 100 32 125 FORMAT "%13.9" ARRAY_SIZE 8 ECU_ADDRESS 0xFFF92188 /end MEASUREMENT
/begin MEASUREMENT IO_ctmsgAPP3 "F9175: counter for 3.ZF-Applikation message" UBYTE X1_M 1 100 0 255 FORMAT "%5.1" ECU_ADDRESS 0xFFF9542C /end MEASUREMENT
/begin MEASUREMENT IO_ctmsgAPP4 "F9175: counter for 4.ZF-Applikation message" UBYTE X1_M 1 100 0 255 FORMAT "%5.1" ECU_ADDRESS 0xFFF9542D /end MEASUREMENT
/begin MEASUREMENT IO_ctmsgAPP8 "F9175: counter for 8.ZF-Applikation message" UBYTE X1_M 1 100 0 255 FORMAT "%5.1" ECU_ADDRESS 0xFFF9542E /end MEASUREMENT
/begin MEASUREMENT IO_ctmsgNAV1 "F9175: counter for 1.ZF-Navigation message" UBYTE X1_M 1 100 0 255 FORMAT "%5.1" ECU_ADDRESS 0xFFF9542F /end MEASUREMENT
/begin MEASUREMENT IO_ctmsgNAV2 "F9175: counter for 2.ZF-Navigation message" UBYTE X1_M 1 100 0 255 FORMAT "%5.1" ECU_ADDRESS 0xFFF95430 /end MEASUREMENT
/begin MEASUREMENT IO_ctmsgNAV3 "F9175: counter for 3.ZF-Navigation message" UBYTE X1_M 1 100 0 255 FORMAT "%5.1" ECU_ADDRESS 0xFFF95431 /end MEASUREMENT
/begin MEASUREMENT IO_ctmsgNAV4 "F9175: counter for 4.ZF-Navigation message" UBYTE X1_M 1 100 0 255 FORMAT "%5.1" ECU_ADDRESS 0xFFF95432 /end MEASUREMENT
/begin MEASUREMENT IO_ctmsgNAV5 "F9175: counter for 5.ZF-Navigation message" UBYTE X1_M 1 100 0 255 FORMAT "%5.1" ECU_ADDRESS 0xFFF95433 /end MEASUREMENT
/begin MEASUREMENT IO_ctmsgNAV6 "F9175: counter for 6.ZF-Navigation message" UBYTE X1_M 1 100 0 255 FORMAT "%5.1" ECU_ADDRESS 0xFFF95434 /end MEASUREMENT
/begin MEASUREMENT IO_ctmsgNAV7 "F9175: counter for 7.ZF-Navigation message" UBYTE X1_M 1 100 0 255 FORMAT "%5.1" ECU_ADDRESS 0xFFF95435 /end MEASUREMENT
/begin MEASUREMENT IO_ctmsgService "F9175: counter for Service message" UBYTE X1_M 1 100 0 255 FORMAT "%5.1" ECU_ADDRESS 0xFFF95436 /end MEASUREMENT
/begin MEASUREMENT RMN_bTskErr "F1630: Flag task error detected" UBYTE B_TRUE_M 1 100 0 1 FORMAT "%13.11" ECU_ADDRESS 0xFFF9511D /end MEASUREMENT
/begin MEASUREMENT ShrVar_datCodApplFileId "F9150: Coding Application File Identifier" UBYTE X1_M 1 100 0 255 FORMAT "%5.1" ARRAY_SIZE 8 ECU_ADDRESS 0xFFF93F14 /end MEASUREMENT
/begin MEASUREMENT ShrVar_datCPS "F9150: CodierPruefStempel (last 7 Bytes of VIN)" UBYTE X1_M 1 100 0 255 FORMAT "%5.1" ARRAY_SIZE 7 ECU_ADDRESS 0xFFF95412 /end MEASUREMENT
/begin MEASUREMENT ShrVar_datVarCod_1 "F9150: variant coding data 1" UBYTE X1_M 1 100 0 255 FORMAT "%5.1" ARRAY_SIZE 2 ECU_ADDRESS 0xFFF963A6 /end MEASUREMENT
/begin MEASUREMENT ShrVar_datVarCod_2 "F9150: variant coding data 2" UBYTE X1_M 1 100 0 255 FORMAT "%5.1" ARRAY_SIZE 2 ECU_ADDRESS 0xFFF963A8 /end MEASUREMENT
/begin MEASUREMENT ShrVar_EEP_s.xStructId "ShrVar_EEP_s / structure identifier" UBYTE X1_M 1 100 0 255 FORMAT "%5.1" ECU_ADDRESS 0xFFF839B4 /end MEASUREMENT
/begin MEASUREMENT ShrVar_EEP_s.datVarCod_1 "ShrVar_EEP_s / variant coding data 1" UBYTE X1_M 1 100 0 255 FORMAT "%5.1" ARRAY_SIZE 2 ECU_ADDRESS 0xFFF839B5 /end MEASUREMENT
/begin MEASUREMENT ShrVar_EEP_s.datVarCod_2 "ShrVar_EEP_s / variant coding data 2" UBYTE X1_M 1 100 0 255 FORMAT "%5.1" ARRAY_SIZE 2 ECU_ADDRESS 0xFFF839B7 /end MEASUREMENT
/begin MEASUREMENT ShrVar_EEP_s.xCodedUS "ShrVar_EEP_s / US coded at least once" UBYTE X1_M 1 100 0 255 FORMAT "%5.1" ECU_ADDRESS 0xFFF839BD /end MEASUREMENT
/begin MEASUREMENT ShrVar_EEP_s.xChsCod "ShrVar_EEP_s / Checksum Code" ULONG X1_M 1 100 0 4294967295 FORMAT "%13.2" ECU_ADDRESS 0xFFF839C8 /end MEASUREMENT
/begin MEASUREMENT ShrVar_EEP_s.xChsDat "ShrVar_EEP_s / Checksum Data" ULONG X1_M 1 100 0 4294967295 FORMAT "%13.2" ECU_ADDRESS 0xFFF839CC /end MEASUREMENT
/begin MEASUREMENT ShrVar_EEP_s.datCafId "ShrVar_EEP_s / CAF ID" UBYTE X1_M 1 100 0 255 FORMAT "%5.1" ARRAY_SIZE 8 ECU_ADDRESS 0xFFF839D0 /end MEASUREMENT
/begin MEASUREMENT ShrVar_EEP_s.datCPS "ShrVar_EEP_s / CPS (CodierPruefStempel)" UBYTE X1_M 1 100 0 255 FORMAT "%5.1" ARRAY_SIZE 7 ECU_ADDRESS 0xFFF83A5C /end MEASUREMENT
/begin MEASUREMENT ShrVar_idWrDat "F9150: identifier written by WriteDataByIdentifier" UWORD X1_M 1 100 0 65535 FORMAT "%8.2" ECU_ADDRESS 0xFFF94DF0 /end MEASUREMENT
/begin MEASUREMENT ShrVar_stCodSesActv "F9150: state coding session active" UBYTE X1_M 1 100 0 255 FORMAT "%5.1" ECU_ADDRESS 0xFFF95419 /end MEASUREMENT
/begin MEASUREMENT ShrVar_stComDly "F9150: state of communication delay" UBYTE X1_M 1 100 0 255 FORMAT "%5.1" ECU_ADDRESS 0xFFF84C89 /end MEASUREMENT
/begin MEASUREMENT ShrVar_stInit "F9150: state variant coding initialisation" UBYTE X1_M 1 100 0 255 FORMAT "%5.1" ECU_ADDRESS 0xFFF9541A /end MEASUREMENT
/begin MEASUREMENT ShrVar_stOrigInit "F9150: state of original initialisation" UBYTE X1_M 1 100 0 255 FORMAT "%5.1" ECU_ADDRESS 0xFFF9541B /end MEASUREMENT
/begin MEASUREMENT ShrVar_stUpdEEP "F9150: state variant coding eeprom update" UBYTE X1_M 1 100 0 255 FORMAT "%5.1" ECU_ADDRESS 0xFFF9541C /end MEASUREMENT
/begin MEASUREMENT ShrVar_stWrSucCPS "F9150: state CPS written successful in coding session" UBYTE X1_M 1 100 0 255 FORMAT "%5.1" ECU_ADDRESS 0xFFF9541D /end MEASUREMENT
/begin MEASUREMENT ShrVar_tiWaitErrHndlr "F9150: timer for error handler waiting time" UWORD TI1_M_CYCLE_M 1 100 0 327675 FORMAT "%8.1" ECU_ADDRESS 0xFFF95C88 /end MEASUREMENT
/begin MEASUREMENT ShrVar_tiWaitVIN "F9150: timer for VIN waiting time" UWORD TI1_M_CYCLE_M 1 100 0 327675 FORMAT "%8.1" ECU_ADDRESS 0xFFF95C8A /end MEASUREMENT
/begin MEASUREMENT ShrVar_xBcOrigInit "F9150: customer boot info of flash programming" UBYTE X1_M 1 100 0 255 FORMAT "%5.1" ECU_ADDRESS 0xFFF9541E /end MEASUREMENT
/begin MEASUREMENT ShrVar_xCanVIN "F9150: VIN from CAN" UBYTE X1_M 1 100 0 255 FORMAT "%5.1" ARRAY_SIZE 7 ECU_ADDRESS 0xFFF9541F /end MEASUREMENT
/begin MEASUREMENT ShrVar_xCanVINRxFlg "F9150: VIN from CAN receive flags" UBYTE X1_M 1 100 0 255 FORMAT "%5.1" ECU_ADDRESS 0xFFF95426 /end MEASUREMENT
/begin MEASUREMENT ShrVar_xChsOrigInit "F9150: checksum change is causing initialisation" UBYTE X1_M 1 100 0 255 FORMAT "%5.1" ECU_ADDRESS 0xFFF95427 /end MEASUREMENT
/begin MEASUREMENT ShrVar_xCodedUS "F9150: US coded (MIL_SCAN_TOOL)" UBYTE X1_M 1 100 0 255 FORMAT "%5.1" ECU_ADDRESS 0xFFF95428 /end MEASUREMENT
/begin MEASUREMENT ShrVar_xInitDne "F9150: variant coding initialisation done" UBYTE X1_M 1 100 0 255 FORMAT "%5.1" ECU_ADDRESS 0xFFF95429 /end MEASUREMENT
/begin MEASUREMENT ShrVar_xVarCodChkDne "F9150: variant coding check done" UBYTE X1_M 1 100 0 255 FORMAT "%5.1" ECU_ADDRESS 0xFFF9542A /end MEASUREMENT
/begin MEASUREMENT SrvShr_BS_MODE "F9170: current operating system mode (0=INIT, 1=SBY/HLD, 2=CRU, 3=LPH)" UBYTE X1_M 1 100 0 255 FORMAT "%5.1" ECU_ADDRESS 0xFFF95117 /end MEASUREMENT
/begin MEASUREMENT SrvShr_CanEwsDataLength "Data bytes of EWS rx message" UBYTE X1_M 1 100 0 255 FORMAT "%5.1" ECU_ADDRESS 0xFFF954E8 /end MEASUREMENT
/begin MEASUREMENT SrvShr_CanEwsRxBuff "Data of EWS rx message" UBYTE X1_M 1 100 0 255 FORMAT "%5.1" ARRAY_SIZE 129 ECU_ADDRESS 0xFFF954E9 /end MEASUREMENT
/begin MEASUREMENT SrvShr_CAN_ACTIVE "F9170: at least one CAN-bus is active (B0:yes,B4-B7: internal)" UBYTE X1_M 1 100 0 255 FORMAT "%5.1" ECU_ADDRESS 0xFFF951E8 /end MEASUREMENT
/begin MEASUREMENT SrvShr_CAN_BusComReq "F9170: Bus Communication request from Application Layer (b0:Nm chn1; b1:Nm chn2; b2-b7:not used at the moment; " UBYTE X1_M 1 100 0 255 FORMAT "%5.1" ECU_ADDRESS 0xFFF951E9 /end MEASUREMENT
/begin MEASUREMENT SrvShr_CAN_BusComReqS "F9170: Bus Communication request state (b0:Nm chn1; b1:Nm chn2; b2-b3:not used at the moment; b4-b7: counter which inc on each req/rel Bus Communication)" UBYTE X1_M 1 100 0 255 FORMAT "%5.1" ECU_ADDRESS 0xFFF951EA /end MEASUREMENT
/begin MEASUREMENT ZF_APP1_CAN_Flag "F9175: semaphor flag for 1.ZF-Applikation message" UBYTE X1_M 1 100 0 255 FORMAT "%5.1" ECU_ADDRESS 0xFFF95437 /end MEASUREMENT
/begin MEASUREMENT ZF_APP2_CAN_Flag "F9175: semaphor flag for 2.ZF-Applikation message" UBYTE X1_M 1 100 0 255 FORMAT "%5.1" ECU_ADDRESS 0xFFF95438 /end MEASUREMENT
/begin MEASUREMENT ZF_APP3_CAN_Flag "F9175: semaphor flag for 3.ZF-Applikation message" UBYTE X1_M 1 100 0 255 FORMAT "%5.1" ECU_ADDRESS 0xFFF95439 /end MEASUREMENT
/begin MEASUREMENT ZF_APP4_CAN_Flag "F9175: semaphor flag for 4.ZF-Applikation message" UBYTE X1_M 1 100 0 255 FORMAT "%5.1" ECU_ADDRESS 0xFFF9543A /end MEASUREMENT
/begin MEASUREMENT ZF_APP5_CAN_Flag "F9175: semaphor flag for 5.ZF-Applikation message" UBYTE X1_M 1 100 0 255 FORMAT "%5.1" ECU_ADDRESS 0xFFF9543B /end MEASUREMENT
/begin MEASUREMENT ZF_APP6_CAN_Flag "F9175: semaphor flag for 6.ZF-Applikation message" UBYTE X1_M 1 100 0 255 FORMAT "%5.1" ECU_ADDRESS 0xFFF9543C /end MEASUREMENT
/begin MEASUREMENT ZF_APP7_CAN_Flag "F9175: semaphor flag for 7.ZF-Applikation message" UBYTE X1_M 1 100 0 255 FORMAT "%5.1" ECU_ADDRESS 0xFFF9543D /end MEASUREMENT
/begin MEASUREMENT ZF_APP8_CAN_Flag "F9175: semaphor flag for 8.ZF-Applikation message" UBYTE X1_M 1 100 0 255 FORMAT "%5.1" ECU_ADDRESS 0xFFF9543E /end MEASUREMENT
/begin MEASUREMENT ZF_APP9_CAN_Flag "F9175: semaphor flag for 9.ZF-Applikation message" UBYTE X1_M 1 100 0 255 FORMAT "%5.1" ECU_ADDRESS 0xFFF9543F /end MEASUREMENT
/begin MEASUREMENT ZF_APP_AZG_Selection "F9175: selected CAN line for AZG (0: not selected yet, 1: FA-CAN, 2: A-CAN)" UBYTE X1_M 1 100 0 255 FORMAT "%5.1" ECU_ADDRESS 0xFFF80D24 /end MEASUREMENT
/begin MEASUREMENT ZF_NAV1_CAN_Flag "F9175: semaphor flag for 1.ZF-Navigation message" UBYTE X1_M 1 100 0 255 FORMAT "%5.1" ECU_ADDRESS 0xFFF95440 /end MEASUREMENT
/begin MEASUREMENT ZF_NAV2_CAN_Flag "F9175: semaphor flag for 2.ZF-Navigation message" UBYTE X1_M 1 100 0 255 FORMAT "%5.1" ECU_ADDRESS 0xFFF95441 /end MEASUREMENT
/begin MEASUREMENT ZF_NAV3_CAN_Flag "F9175: semaphor flag for 3.ZF-Navigation message" UBYTE X1_M 1 100 0 255 FORMAT "%5.1" ECU_ADDRESS 0xFFF95442 /end MEASUREMENT
/begin MEASUREMENT ZF_NAV4_CAN_Flag "F9175: semaphor flag for 4.ZF-Navigation message" UBYTE X1_M 1 100 0 255 FORMAT "%5.1" ECU_ADDRESS 0xFFF95443 /end MEASUREMENT
/begin MEASUREMENT ZF_NAV5_CAN_Flag "F9175: semaphor flag for 5.ZF-Navigation message" UBYTE X1_M 1 100 0 255 FORMAT "%5.1" ECU_ADDRESS 0xFFF95444 /end MEASUREMENT
/begin MEASUREMENT ZF_NAV6_CAN_Flag "F9175: semaphor flag for 6.ZF-Navigation message" UBYTE X1_M 1 100 0 255 FORMAT "%5.1" ECU_ADDRESS 0xFFF95445 /end MEASUREMENT
/begin MEASUREMENT ZF_NAV7_CAN_Flag "F9175: semaphor flag for 7.ZF-Navigation message" UBYTE X1_M 1 100 0 255 FORMAT "%5.1" ECU_ADDRESS 0xFFF95446 /end MEASUREMENT
/begin MEASUREMENT ZF_SERVICE_CAN_Flag "F9175: semaphor flag for ZF-SERVICE-Applikation message" UBYTE X1_M 1 100 0 255 FORMAT "%5.1" ECU_ADDRESS 0xFFF95447 /end MEASUREMENT
/begin MEASUREMENT CalHndlrHw_regAUDISR "F1505: Initial value of register AUDISR" UWORD X1_S1 1 100 0 65535 FORMAT "%8.2" ECU_ADDRESS 0xFFF94B64 /end MEASUREMENT
/begin MEASUREMENT CalHndlrHw_sAudTool "F1505: Status of AUD-Tool Detection: 0xAA ETK_ACTIVE, 0x55 ETK_PREDETECT, 0xAB GSI_ACTIVE, 0x56 GSI_PREDETECT,0x00 INACTIVE,0xF0 DETECTION_FAILED, 0xF1u CALHDNLR_REGFAILED" UBYTE X1_S1 1 100 0 255 FORMAT "%5.1" ECU_ADDRESS 0xFFF950CE /end MEASUREMENT
/begin MEASUREMENT CalHndlr_xActvCalPg "F1505: Active Calibration-Page (0xX0 NONE, 0xX3 DSERAP, 0xX5 SERAP, 0xXA SERAM, 0xFX Error)" UBYTE X1_S1 1 100 0 15 FORMAT "%5.2" ECU_ADDRESS 0xFFF9640A /end MEASUREMENT
/begin MEASUREMENT CalHndlr_xActvCalUsr "F1505: active Calibrationmethod (0x5 GSI; 0x4 XCP; 0x3 ETK; 0x2 CCP; 0x1 IC2; 0x00 none)" UBYTE X1_S1 1 100 0 5 FORMAT "%5.3" ECU_ADDRESS 0xFFF950D9 /end MEASUREMENT
/begin MEASUREMENT CPU_TimerFastTicks_u32 "F2360: Measured system timer in 0.05us (optional)" ULONG TI0_00005_M_S1 1 100 0 214748.36475 FORMAT "%13.6" ECU_ADDRESS 0xFFFFF310 /end MEASUREMENT
/begin MEASUREMENT CPU_TimerTicks_u32 "F2360: Measured system timer in 1us" ULONG TI0_001_M_S1 1 100 0 4294967.295 FORMAT "%13.5" ECU_ADDRESS 0xFFFFF220 /end MEASUREMENT
/begin MEASUREMENT DBG_ERR_numBuf "F1590: Number of debug entries stored in the system" UBYTE X1_S1 1 100 0 5 FORMAT "%5.3" ECU_ADDRESS 0xFFF950DA /end MEASUREMENT
/begin MEASUREMENT DBG_ERR_numErr "F1590: Number of debug entries counted in the system (limited to 255)" UBYTE X1_S1 1 100 0 255 FORMAT "%5.1" ECU_ADDRESS 0xFFF950DB /end MEASUREMENT
/begin MEASUREMENT DBG_ERR_numErrId "F1590: Error indication number" UWORD X1_S1 1 100 0 65535 FORMAT "%8.2" ARRAY_SIZE 5 ECU_ADDRESS 0xFFF94C06 /end MEASUREMENT
/begin MEASUREMENT DBG_ERR_numFctId "F1590: Function identification number" UWORD X1_S1 1 100 0 65535 FORMAT "%8.2" ARRAY_SIZE 5 ECU_ADDRESS 0xFFF94C10 /end MEASUREMENT
/begin MEASUREMENT DBG_ERR_regPR "F1590: Address of the error call (register PR)" ULONG X1_S1 1 100 0 4294967295 FORMAT "%13.2" ARRAY_SIZE 5 ECU_ADDRESS 0xFFF92454 /end MEASUREMENT
/begin MEASUREMENT DBG_ERR_xPar "F1590: Passed parameter" ULONG X1_S1 1 100 0 4294967295 FORMAT "%13.2" ARRAY_SIZE 5 ECU_ADDRESS 0xFFF92468 /end MEASUREMENT
/begin MEASUREMENT ECE_bAdcStopA "F2355: Indicates if ADC-A DMA transfer is stopped (normal=FALSE)" UBYTE B_TRUE_S1 1 100 0 1 FORMAT "%13.11" ECU_ADDRESS 0xFFF920FF /end MEASUREMENT
/begin MEASUREMENT ECE_bAdcStopB "F2355: Indicates if ADC-B DMA transfer is stopped (normal=FALSE)" UBYTE B_TRUE_S1 1 100 0 1 FORMAT "%13.11" ECU_ADDRESS 0xFFF92100 /end MEASUREMENT
/begin MEASUREMENT ECE_bCpuClockActive "F2360: Verification whether the Clock is running with min. frequency (0=no, 1=yes/ok)" UBYTE B_TRUE_S1 1 100 0 1 FORMAT "%13.11" ECU_ADDRESS 0xFFF92170 /end MEASUREMENT
/begin MEASUREMENT ECE_bDN "F2385: DN-line info (1=ok, 0=error)" UBYTE B_TRUE_S1 1 100 0 1 FORMAT "%13.11" ECU_ADDRESS 0xFFF92161 /end MEASUREMENT
/begin MEASUREMENT ECE_bOvrTmpRstrt "F2385: activation of overtemperature restart function - only relevant if BIT3 in ECE_Cg130_regInit2 is set" UBYTE B_TRUE_S1 1 100 0 1 FORMAT "%13.11" ECU_ADDRESS 0xFFF9215A /end MEASUREMENT
/begin MEASUREMENT ECE_bPclk "F2360: PCLK activation status (0=off, 1=on)" UBYTE B_TRUE_S1 1 100 0 1 FORMAT "%13.11" ECU_ADDRESS 0xFFF9216F /end MEASUREMENT
/begin MEASUREMENT ECE_bPSplyOvrCurr "F2397: Actuator supply overcurrent info" UBYTE B_TRUE_S1 1 100 0 1 FORMAT "%13.11" ARRAY_SIZE 3 ECU_ADDRESS 0xFFF9214F /end MEASUREMENT
/begin MEASUREMENT ECE_bPSplyReq "F2397: Actuator supply output request (0=off,99=63h=on)" UBYTE X1_S1 1 100 0 255 FORMAT "%5.1" ARRAY_SIZE 3 ECU_ADDRESS 0xFFF9214C /end MEASUREMENT
/begin MEASUREMENT ECE_bSSplyReq "F2396: Sensor supply output request (FALSE=off,TRUE=on)" UBYTE B_TRUE_S1 1 100 0 1 FORMAT "%13.11" ECU_ADDRESS 0xFFF92155 /end MEASUREMENT
/begin MEASUREMENT ECE_bWak1 "F2385: Wak1 pin information (FALSE=off, TRUE=on) Cg124" UBYTE B_TRUE_S1 1 100 0 1 FORMAT "%13.11" ECU_ADDRESS 0xFFF84D38 /end MEASUREMENT
/begin MEASUREMENT ECE_bWak2 "F2385: Wak2 pin information (FALSE=off, TRUE=on) Cg124" UBYTE B_TRUE_S1 1 100 0 1 FORMAT "%13.11" ECU_ADDRESS 0xFFF84D39 /end MEASUREMENT
/begin MEASUREMENT ECE_bWakIntern "F2385: Cg130 Wak-Info information (FALSE=off, TRUE=on)" UBYTE B_TRUE_S1 1 100 0 1 FORMAT "%13.11" ECU_ADDRESS 0xFFF84D3A /end MEASUREMENT
/begin MEASUREMENT ECE_bWdRst "F2385: IWD availability to issue an ECU-reset (FALSE/TRUE)" UBYTE B_TRUE_S1 1 100 0 1 FORMAT "%13.11" ECU_ADDRESS 0xFFF9215C /end MEASUREMENT
/begin MEASUREMENT ECE_bWdRstFirst "F2385: IWD might have caused an ECU-reset in the previous software cycle (this information is latched once after system startup)" UBYTE B_TRUE_S1 1 100 0 1 FORMAT "%13.11" ECU_ADDRESS 0xFFF9215D /end MEASUREMENT
/begin MEASUREMENT ECE_bWdRstReq "F2385: IWD might cause an ECU-reset (FALSE=no/TRUE=yes)" UBYTE B_TRUE_S1 1 100 0 1 FORMAT "%13.11" ECU_ADDRESS 0xFFF9215B /end MEASUREMENT
/begin MEASUREMENT ECE_bWdRstReqCmpl "F2385: complement of ECE_bWdRstReq, IWD-reset activation (FALSE=yes/TRUE=no)" UBYTE B_TRUE_S1 1 100 0 1 FORMAT "%13.11" ECU_ADDRESS 0xFFF92152 /end MEASUREMENT
/begin MEASUREMENT ECE_CC08_bDiaDly "F2366: Delay of the DIA return value compared to output value expected" UBYTE B_TRUE_S1 1 100 0 1 FORMAT "%13.11" ECU_ADDRESS 0xFFF92116 /end MEASUREMENT
/begin MEASUREMENT ECE_CC08_ctMissDithIsr "F2366: missing dither ISR counter (free-running)" UBYTE X1_S1 1 100 0 255 FORMAT "%5.1" ECU_ADDRESS 0xFFF92122 /end MEASUREMENT
/begin MEASUREMENT ECE_CC08_iAct "F2366: Actual output current of the CG208 current control channel" UWORD I0_0001_S1 1 100 0 1.2 FORMAT "%8.6" ARRAY_SIZE 10 ECU_ADDRESS 0xFFF91A4C /end MEASUREMENT
/begin MEASUREMENT ECE_CC08_iActDelta "F2366: Delta current measured by CG208" SWORD I0_0001_S1 1 100 -1.2 1.2 FORMAT "%8.6" ARRAY_SIZE 10 ECU_ADDRESS 0xFFF91A60 /end MEASUREMENT
/begin MEASUREMENT ECE_CC08_iCmd "F2366: Commanded current of the CG208 current control channel" UWORD I0_0001_S1 1 100 0 1.2 FORMAT "%8.6" ARRAY_SIZE 10 ECU_ADDRESS 0xFFF91A38 /end MEASUREMENT
/begin MEASUREMENT ECE_CC08_iDam "F2366: CG208 dither current amplitude" UWORD I0_0001_S1 1 100 0 0.4 FORMAT "%9.7" ARRAY_SIZE 10 ECU_ADDRESS 0xFFF91B28 /end MEASUREMENT
/begin MEASUREMENT ECE_CC08_idxDithGrpAssign "F2366: CG208 index to which dither group the channel is assigned info: 0:DthGrp_0, 1:DthGrp_1, 2:DthGrp_2, 3:DthGrp_3" UBYTE X1_S1 1 100 0 255 FORMAT "%5.1" ARRAY_SIZE 10 ECU_ADDRESS 0xFFF9202E /end MEASUREMENT
/begin MEASUREMENT ECE_CC08_idxSyncGrpAssign "F2366: CG208 index to which sync group the ASIC-device is assigned info: 0:SyncGrp_0, 1:SyncGrp_1, 2:SyncGrp_2" UBYTE X1_S1 1 100 0 255 FORMAT "%5.1" ARRAY_SIZE 5 ECU_ADDRESS 0xFFF92117 /end MEASUREMENT
/begin MEASUREMENT ECE_CC08_regDfr "F2366: CG208 dither-freq-register settings (if B5=0: B0-4: 781.25Hz/n or 1.28ms*n)   (if B5=1: B0-4: 3125Hz/n or 0.32ms*n)" UBYTE X1_S1 1 100 0 255 FORMAT "%5.1" ARRAY_SIZE 3 ECU_ADDRESS 0xFFF92113 /end MEASUREMENT
/begin MEASUREMENT ECE_CC08_regInt "F2366: CG208 integrator register settings (B7+B6:P-Reg, B5-B0:n) (note: Ax-step uses slightly different structure)" UBYTE X1_S1 1 100 0 255 FORMAT "%5.1" ARRAY_SIZE 5 ECU_ADDRESS 0xFFF92103 /end MEASUREMENT
/begin MEASUREMENT ECE_CC08_regOsc "F2366: CG208 oscillator register settings: B0-6: n*31.25Hz  B7:undervoltage behavior (note: Ax-step uses slightly different structure)" UBYTE X1_S1 1 100 0 255 FORMAT "%5.1" ARRAY_SIZE 5 ECU_ADDRESS 0xFFF92108 /end MEASUREMENT
/begin MEASUREMENT ECE_CC08_regRound "F2366: rounding information current: standard=3, special=1 or 4" UBYTE X1_S1 1 100 0 5 FORMAT "%5.3" ECU_ADDRESS 0xFFF92112 /end MEASUREMENT
/begin MEASUREMENT ECE_CC08_regSet "F2366: CG208 set-register settings (B0-5: n*0.31ms, B7+B6:P-reg) (note: Ax-step uses slightly different structure)" UBYTE X1_S1 1 100 0 255 FORMAT "%5.1" ARRAY_SIZE 5 ECU_ADDRESS 0xFFF9210D /end MEASUREMENT
/begin MEASUREMENT ECE_CC08_stModeAct "F2366: Actual output mode (0x00:CURR_OFF, 0x21:CURR, 0x32:SW_OFF, 0x43:SW_ON)" UBYTE X1_S1 1 100 0 255 FORMAT "%5.1" ARRAY_SIZE 10 ECU_ADDRESS 0xFFF92024 /end MEASUREMENT
/begin MEASUREMENT ECE_CC08_stModeCmd "F2366: Commanded output mode (0x00:CURR_OFF, 0x21:CURR, 0x32:SW_OFF, 0x43:SW_ON)" UBYTE X1_S1 1 100 0 255 FORMAT "%5.1" ARRAY_SIZE 10 ECU_ADDRESS 0xFFF9201A /end MEASUREMENT
/begin MEASUREMENT ECE_CC08_stSpiDiag "F2366: SPI diagnosis info: B15:ident correct,B14:DN,B13:CLKERR,B12:SEL,B10:SPI-Data-Err,B9:SPI-Err,B8:SPI-ok;B7:NOC,B6:RCHG,B5:OT,B4:OC,B3:OC,B2:NS,B1+0:ERR" UWORD X1_S1 1 100 0 65535 FORMAT "%8.2" ARRAY_SIZE 10 ECU_ADDRESS 0xFFF91B14 /end MEASUREMENT
/begin MEASUREMENT ECE_CC08_stVersion "F2366: Version status: 0=newest, 1=Ax-step" UBYTE X1_S1 1 100 0 255 FORMAT "%5.1" ECU_ADDRESS 0xFFF92123 /end MEASUREMENT
/begin MEASUREMENT ECE_CC08_tiDithIsr "F2366: CG208 dither interrupt timing parameters (idx0:dly sample-high, idx1:dly sample-low, idx2:dly period)" UWORD TI0_001_M_S1 1 100 0 65.535 FORMAT "%8.5" ARRAY_SIZE 3 ECU_ADDRESS 0xFFF91A14 /end MEASUREMENT
/begin MEASUREMENT ECE_CC08_tiFdbkDuty "F2366: Duty of the feedback PWM related to a CG208 output channel (high/low sequence)" UWORD TI0_001_M_S1 1 100 0 2 FORMAT "%8.6" ARRAY_SIZE 20 ECU_ADDRESS 0xFFF91A9C /end MEASUREMENT
/begin MEASUREMENT ECE_CC08_tiFdbkPer "F2366: Period of the feedback PWM related to a CG208 output channel (high/low sequence)" UWORD TI0_001_M_S1 1 100 0 2 FORMAT "%8.6" ARRAY_SIZE 20 ECU_ADDRESS 0xFFF91A74 /end MEASUREMENT
/begin MEASUREMENT ECE_CC08_tiSync "F2366: current CG208 sync group output period" UWORD TI0_001_M_S1 1 100 0 2 FORMAT "%8.6" ARRAY_SIZE 1 ECU_ADDRESS 0xFFF92044 /end MEASUREMENT
/begin MEASUREMENT ECE_CC08_tiSyncChn "F2366: current CG208 ASIC sync output period" UWORD TI0_001_M_S1 1 100 0 2 FORMAT "%8.6" ARRAY_SIZE 5 ECU_ADDRESS 0xFFF92046 /end MEASUREMENT
/begin MEASUREMENT ECE_Cg124_regInit "F2385: Cg124-Init-Register (B0-3:OTA,B4:0,B5:ISO,B6:VS-VOLT,B7:AG1_OFF)" UBYTE X1_S1 1 100 0 255 FORMAT "%5.1" ECU_ADDRESS 0xFFF9216A /end MEASUREMENT
/begin MEASUREMENT ECE_Cg130_regInit2 "F2385: Cg130-Init2-Register (B0:TMPSEL,B2:VD1SEL,B3,TREC,B4:OTN_HSD, B5:HSD1, B6:HSD2, B7:HSD3)" UBYTE X1_S1 1 100 0 255 FORMAT "%5.1" ECU_ADDRESS 0xFFF9216B /end MEASUREMENT
/begin MEASUREMENT ECE_CORE_bMisrErr "F2351: Indicates an error within the MISR calculation (FALSE=ok, not FALSE=error)" UBYTE B_TRUE_S1 1 100 0 1 FORMAT "%13.11" ECU_ADDRESS 0xFFF92124 /end MEASUREMENT
/begin MEASUREMENT ECE_CORE_ctPbusCycles "F2351: period counter for Pbus transfer measurement" UWORD X1_S1 1 100 0 65535 FORMAT "%8.2" ECU_ADDRESS 0xFFF92050 /end MEASUREMENT
/begin MEASUREMENT ECE_CORE_numPbusTransfers "F2351: number of PBus transfers in period ECE_CORE_numPBusCycles_C" ULONG X1_S1 1 100 0 4294967295 FORMAT "%13.2" ECU_ADDRESS 0xFFF91BB8 /end MEASUREMENT
/begin MEASUREMENT ECE_CORE_regMisr "F2351: MISR register content after a reference calculation" ULONG X1_S1 1 100 0 4294967295 FORMAT "%13.2" ECU_ADDRESS 0xFFF91BB4 /end MEASUREMENT
/begin MEASUREMENT ECE_ctAdcDmaOvrFlw "F2355: Counter for ADC-DMA result overflow" UWORD X1_S1 1 100 0 65535 FORMAT "%8.2" ECU_ADDRESS 0xFFF92006 /end MEASUREMENT
/begin MEASUREMENT ECE_FRQ_ctPls "F2364: number of pulses/edges registered (free-running counter)" UWORD X1_S1 1 100 0 65535 FORMAT "%8.2" ARRAY_SIZE 3 ECU_ADDRESS 0xFFF92058 /end MEASUREMENT
/begin MEASUREMENT ECE_FRQ_dn "F2364: speed gradient (related to ECE_FRQ_n)" SWORD DN1_S1 1 100 -32768 32767 FORMAT "%8.2" ARRAY_SIZE 3 ECU_ADDRESS 0xFFF92064 /end MEASUREMENT
/begin MEASUREMENT ECE_FRQ_n "F2364: raw transmission input/output speed value (status: ECE_FRQ_qn)" UWORD N0_25_S1 1 100 0 16383.75 FORMAT "%8.2" ARRAY_SIZE 3 ECU_ADDRESS 0xFFF9205E /end MEASUREMENT
/begin MEASUREMENT ECE_FRQ_qdn "F2364: quality info of ECE_FRQ_dn (0:INIT, 5:TO,6:TOW,7:weak-filter,8:VALID)" UBYTE Q_SIG_S1 1 100 0 8 FORMAT "%13.11" ARRAY_SIZE 3 ECU_ADDRESS 0xFFF9212F /end MEASUREMENT
/begin MEASUREMENT ECE_FRQ_qn "F2364: quality info of ECE_FRQ_n (0:INIT, 5:TO,6:TOW,8:VALID)" UBYTE Q_SIG_S1 1 100 0 8 FORMAT "%13.11" ARRAY_SIZE 3 ECU_ADDRESS 0xFFF9212C /end MEASUREMENT
/begin MEASUREMENT ECE_FRQ_stHwDiag "F2364: Reported HW diagnosis information (B0:SB,B1:OP or SG,B2:NA, B7:OK)" UBYTE X1_S1 1 100 0 255 FORMAT "%5.1" ARRAY_SIZE 3 ECU_ADDRESS 0xFFF92129 /end MEASUREMENT
/begin MEASUREMENT ECE_FRQ_tiPls "F2364: Pulse length of speed signal (last measured signal period)" UWORD TI1_U_S1 1 100 0 65535 FORMAT "%8.2" ARRAY_SIZE 3 ECU_ADDRESS 0xFFF92052 /end MEASUREMENT
/begin MEASUREMENT ECE_idxDmy "F2352: dummy index for table addressing" UBYTE X1_S1 1 100 0 255 FORMAT "%5.1" ECU_ADDRESS 0xFFF920FC /end MEASUREMENT
/begin MEASUREMENT ECE_idxLx "F2352: Evaluated index for Lx variant handling 0=new config., 1=old config." UBYTE X1_S1 1 100 0 255 FORMAT "%5.1" ECU_ADDRESS 0xFFF92153 /end MEASUREMENT
/begin MEASUREMENT ECE_idxLxOff "F2352: Evaluated offser for Lx variant handling " UBYTE X1_S1 1 100 0 255 FORMAT "%5.1" ECU_ADDRESS 0xFFF92154 /end MEASUREMENT
/begin MEASUREMENT ECE_IWD_bActive "F2392: IWD active: TRUE=IWD timeout counter can cause interrupt" UBYTE B_TRUE_S1 1 100 0 1 FORMAT "%13.11" ECU_ADDRESS 0xFFF92132 /end MEASUREMENT
/begin MEASUREMENT ECE_IWD_reg.stOkMsk "F2392: IWD register structure / " UBYTE X1_S1 1 100 0 255 FORMAT "%5.1" ECU_ADDRESS 0xFFF91D48 /end MEASUREMENT
/begin MEASUREMENT ECE_IWD_reg.stErrMsk "F2392: IWD register structure / " UBYTE X1_S1 1 100 0 255 FORMAT "%5.1" ECU_ADDRESS 0xFFF91D49 /end MEASUREMENT
/begin MEASUREMENT ECE_IWD_reg.stErrDatMsk "F2392: IWD register structure / " UBYTE X1_S1 1 100 0 255 FORMAT "%5.1" ECU_ADDRESS 0xFFF91D4A /end MEASUREMENT
/begin MEASUREMENT ECE_IWD_reg.stEmpty "F2392: IWD register structure / " UBYTE X1_S1 1 100 0 255 FORMAT "%5.1" ECU_ADDRESS 0xFFF91D4B /end MEASUREMENT
/begin MEASUREMENT ECE_IWD_reg.tiSpiTransfer "F2392: IWD register structure / " ULONG X1_S1 1 100 0 4294967295 FORMAT "%13.2" ECU_ADDRESS 0xFFF91D4C /end MEASUREMENT
/begin MEASUREMENT ECE_IWD_reg.regRESP "F2392: IWD register structure / " ULONG X1_S1 1 100 0 4294967295 FORMAT "%13.2" ECU_ADDRESS 0xFFF91D50 /end MEASUREMENT
/begin MEASUREMENT ECE_IWD_reg.ctTIME "F2392: IWD register structure / " UBYTE X1_S1 1 100 0 255 FORMAT "%5.1" ECU_ADDRESS 0xFFF91D54 /end MEASUREMENT
/begin MEASUREMENT ECE_IWD_reg.ctRESP "F2392: IWD register structure / " UBYTE X1_S1 1 100 0 255 FORMAT "%5.1" ECU_ADDRESS 0xFFF91D55 /end MEASUREMENT
/begin MEASUREMENT ECE_IWD_reg.regRESP_TIME_TX "F2392: IWD register structure / " UBYTE X1_S1 1 100 0 255 FORMAT "%5.1" ECU_ADDRESS 0xFFF91D56 /end MEASUREMENT
/begin MEASUREMENT ECE_IWD_reg.regRESP_TIME_RX "F2392: IWD register structure / " UBYTE X1_S1 1 100 0 255 FORMAT "%5.1" ECU_ADDRESS 0xFFF91D57 /end MEASUREMENT
/begin MEASUREMENT ECE_IWD_reg.regREQULO "F2392: IWD register structure / " UBYTE X1_S1 1 100 0 255 FORMAT "%5.1" ECU_ADDRESS 0xFFF91D58 /end MEASUREMENT
/begin MEASUREMENT ECE_IWD_reg.regREQUHI "F2392: IWD register structure / " UBYTE X1_S1 1 100 0 255 FORMAT "%5.1" ECU_ADDRESS 0xFFF91D59 /end MEASUREMENT
/begin MEASUREMENT ECE_IWD_RESP_regRx "F2392: IWD response data message (RX)" UWORD X1_S1 1 100 0 65535 FORMAT "%8.2" ARRAY_SIZE 7 ECU_ADDRESS 0xFFF88A2C /end MEASUREMENT
/begin MEASUREMENT ECE_IWD_RESP_regTx "F2392: IWD response data message (TX)" UWORD X1_S1 1 100 0 65535 FORMAT "%8.2" ARRAY_SIZE 7 ECU_ADDRESS 0xFFF88A1E /end MEASUREMENT
/begin MEASUREMENT ECE_IWD_tiAct "F2392: actual IWD timing set upon timeout counter activation (for monitoring purpose)" UWORD TI1_U_S1 1 100 0 65535 FORMAT "%8.2" ECU_ADDRESS 0xFFF9206C /end MEASUREMENT
/begin MEASUREMENT ECE_IWD_tiDly "F2392: memorized delay of last IWD ISR activation (ideally close to 0) (for monitoring purpose)" UWORD TI1_U_S1 1 100 0 65535 FORMAT "%8.2" ECU_ADDRESS 0xFFF9206A /end MEASUREMENT
/begin MEASUREMENT ECE_IWD_TIME_regRx "F2392: IWD response time message (RX)" UWORD X1_S1 1 100 0 65535 FORMAT "%8.2" ARRAY_SIZE 4 ECU_ADDRESS 0xFFF88128 /end MEASUREMENT
/begin MEASUREMENT ECE_IWD_TIME_regTx "F2392: IWD response time message (TX)" UWORD X1_S1 1 100 0 65535 FORMAT "%8.2" ARRAY_SIZE 4 ECU_ADDRESS 0xFFF88120 /end MEASUREMENT
/begin MEASUREMENT ECE_LSS_numDuty "F2369: number of ADC measurements in duty-phase per period" UBYTE X1_S1 1 100 0 255 FORMAT "%5.1" ARRAY_SIZE 5 ECU_ADDRESS 0xFFF92147 /end MEASUREMENT
/begin MEASUREMENT ECE_LSS_numNoDuty "F2369: number of ADC measurements in noduty-phase per period" UBYTE X1_S1 1 100 0 255 FORMAT "%5.1" ARRAY_SIZE 5 ECU_ADDRESS 0xFFF92142 /end MEASUREMENT
/begin MEASUREMENT ECE_LSS_rAct "F2369: Actual duty of Lss output channel for diagnosis purpose" UWORD R0_1_P_S1 1 100 0 100 FORMAT "%8.4" ARRAY_SIZE 5 ECU_ADDRESS 0xFFF9207C /end MEASUREMENT
/begin MEASUREMENT ECE_LSS_rCmd "F2369: Commanded duty of Lss output channel" UWORD R0_1_P_S1 1 100 0 100 FORMAT "%8.4" ARRAY_SIZE 5 ECU_ADDRESS 0xFFF92072 /end MEASUREMENT
/begin MEASUREMENT ECE_LSS_rCmdAct "F2369: accepted duty command of Lss output channel" UWORD R0_1_P_S1 1 100 0 100 FORMAT "%8.4" ARRAY_SIZE 5 ECU_ADDRESS 0xFFF92086 /end MEASUREMENT
/begin MEASUREMENT ECE_LSS_stStatHw "F2369: Status of Lss-Feedback signal: 0=off, 1=on, 2=not available" UBYTE X1_S1 1 100 0 5 FORMAT "%5.3" ARRAY_SIZE 5 ECU_ADDRESS 0xFFF9213D /end MEASUREMENT
/begin MEASUREMENT ECE_LSS_tiPerAct "F2369: Actual signal output period" UWORD TI0_0005_M_S1 1 100 0 32.7675 FORMAT "%8.5" ARRAY_SIZE 5 ECU_ADDRESS 0xFFF9209A /end MEASUREMENT
/begin MEASUREMENT ECE_LSS_tiPerCmd "F2369: Commanded signal output period" UWORD TI0_0005_M_S1 1 100 0 32.7675 FORMAT "%8.5" ARRAY_SIZE 5 ECU_ADDRESS 0xFFF92090 /end MEASUREMENT
/begin MEASUREMENT ECE_LSS_uDuty "F2369: Lss monitoring voltage in duty phase (special case: 0=no measurement available)" UWORD U0_001_S1 1 100 0 25 FORMAT "%8.5" ARRAY_SIZE 5 ECU_ADDRESS 0xFFF920AE /end MEASUREMENT
/begin MEASUREMENT ECE_LSS_uNoDuty "F2369: Lss monitoring voltage in non-duty phase (special case: 0=no measurement available)" UWORD U0_001_S1 1 100 0 25 FORMAT "%8.5" ARRAY_SIZE 5 ECU_ADDRESS 0xFFF920A4 /end MEASUREMENT
/begin MEASUREMENT ECE_PWM_tiDutyCmd "F2371: Commanded output period (must be <=ECE_PWM_tiPerCmd)" UWORD TI0_0005_M_S1 1 100 0 32.7675 FORMAT "%8.5" ARRAY_SIZE 1 ECU_ADDRESS 0xFFF920D0 /end MEASUREMENT
/begin MEASUREMENT ECE_PWM_tiPerCmd "F2371: Commanded output period (must be >=ECE_PWM_tiDtyCmd)" UWORD TI0_0005_M_S1 1 100 0 32.7675 FORMAT "%8.5" ARRAY_SIZE 1 ECU_ADDRESS 0xFFF920CE /end MEASUREMENT
/begin MEASUREMENT ECE_qtiPwd "F2359: quality info of PWD-measurement (per channel) : 0 (init), 4 (fix)=Timeout, 8 (ok)" UBYTE Q_SIG_S1 1 100 0 8 FORMAT "%13.11" ARRAY_SIZE 6 ECU_ADDRESS 0xFFF920C8 /end MEASUREMENT
/begin MEASUREMENT ECE_regAdcDiagDiffA "F2355: Difference to current diagnosis value ADC-A (idx=0:ZERO,idx=1:HALF,idx=2:FULL)" SWORD X1_S1 1 100 -1000 1000 FORMAT "%8.3" ARRAY_SIZE 3 ECU_ADDRESS 0xFFF92008 /end MEASUREMENT
/begin MEASUREMENT ECE_regAdcDiagDiffB "F2355: Difference to current diagnosis value ADC-B (idx=0:ZERO,idx=1:HALF,idx=2:FULL)" SWORD X1_S1 1 100 -1000 1000 FORMAT "%8.3" ARRAY_SIZE 3 ECU_ADDRESS 0xFFF9200E /end MEASUREMENT
/begin MEASUREMENT ECE_regSysChpTemp "F2385: system-temperature raw value (0xFFFF=error) (linearisation required)" UWORD X1_S1 1 100 0 65535 FORMAT "%8.2" ECU_ADDRESS 0xFFF920D2 /end MEASUREMENT
/begin MEASUREMENT ECE_sCanStartup "F2357: Startup state determined by the CAN transceiver (0:undef, 1:power-on-start, 2:local wakeup, 3:CAN-wakeup)" UBYTE X1_S1 1 100 0 3 FORMAT "%5.3" ECU_ADDRESS 0xFFF800EF /end MEASUREMENT
/begin MEASUREMENT ECE_sModeCfgReq "F2385: ECU mode request (Line=0x00,Off=0x06,On=0x19,Edge=0x31,OnSdn=0x5B,EdgSdn=0x73)" UBYTE X1_S1 1 100 0 255 FORMAT "%5.1" ECU_ADDRESS 0xFFF92159 /end MEASUREMENT
/begin MEASUREMENT ECE_SPI_bCg124_stSpiOk "F2385: Common Cg124 Spi state. TRUE: All Spi sequences to cg124 transmitted without an error " UBYTE B_TRUE_S1 1 100 0 1 FORMAT "%13.11" ECU_ADDRESS 0xFFF92157 /end MEASUREMENT
/begin MEASUREMENT ECE_SPI_bCg130_stSpiOk "F2385: Common Cg130 Spi state. TRUE: All Spi sequences to cg124 transmitted without an error " UBYTE B_TRUE_S1 1 100 0 1 FORMAT "%13.11" ECU_ADDRESS 0xFFF92158 /end MEASUREMENT
/begin MEASUREMENT ECE_SPI_regHsdPort "F2385: HSD control via CPU-Ports (B0-B4:undef, B5:HSD1, B6:HSD2, B7:HSD3)" UBYTE X1_S1 1 100 0 255 FORMAT "%5.1" ECU_ADDRESS 0xFFF9216D /end MEASUREMENT
/begin MEASUREMENT ECE_SPI_stSpiCore "F2385: Common Core Spi status 0=no status avail., 0x11= Core Spi error, 0x2d Core Spi status ok" UBYTE X1_S1 1 100 0 255 FORMAT "%5.1" ECU_ADDRESS 0xFFF92156 /end MEASUREMENT
/begin MEASUREMENT ECE_sSpiRead "F2385: Spi transfer status (0:not yet started, 1:started-not yet ready, 15:ready)" UBYTE X1_S1 1 100 0 15 FORMAT "%5.2" ECU_ADDRESS 0xFFF92163 /end MEASUREMENT
/begin MEASUREMENT ECE_stCg130Version "F2385: HW version number of the CG130 (0=BA HW step or newer,1=AX HW step)" UBYTE X1_S1 1 100 0 255 FORMAT "%5.1" ARRAY_SIZE 3 ECU_ADDRESS 0xFFF9216E /end MEASUREMENT
/begin MEASUREMENT ECE_stLines "F2385: Cg124 bit-coded line-information" UBYTE X1_S1 1 100 0 255 FORMAT "%5.1" ECU_ADDRESS 0xFFF92160 /end MEASUREMENT
/begin MEASUREMENT ECE_Stlk_bSpiOff "F2385: Prevent the starter output independent of current ECE_stLines configuration" UBYTE B_TRUE_S1 1 100 0 1 FORMAT "%13.11" ECU_ADDRESS 0xFFF92162 /end MEASUREMENT
/begin MEASUREMENT ECE_stOTA "F2396: OTA output request (FALSE=off,TRUE=on)" UBYTE X1_S1 1 100 0 255 FORMAT "%5.1" ECU_ADDRESS 0xFFF9215F /end MEASUREMENT
/begin MEASUREMENT ECE_stPclk "F2385: Pclk status information BIT0: too high, BIT1: too low" UBYTE X1_S1 1 100 0 255 FORMAT "%5.1" ECU_ADDRESS 0xFFF9215E /end MEASUREMENT
/begin MEASUREMENT ECE_stSysChpTemp "F2385: system-temperature status: 0=not updated, 1=ok, 2=error" UBYTE X1_S1 1 100 0 255 FORMAT "%5.1" ECU_ADDRESS 0xFFF92165 /end MEASUREMENT
/begin MEASUREMENT ECE_stSysChpTempOT "F2385: overtemperature status of internal sensor (0:no OT, 1:low-threshold exceeded, 3:high-threshold exceeded)" UBYTE X1_S1 1 100 0 255 FORMAT "%5.1" ECU_ADDRESS 0xFFF92166 /end MEASUREMENT
/begin MEASUREMENT ECE_tChpExt "F2385: external chip-temp-sensor raw-value in 1/128°C" SWORD T0_0078125_S1 1 100 -256 255.9922 FORMAT "%8.4" ECU_ADDRESS 0xFFF920D4 /end MEASUREMENT
/begin MEASUREMENT ECE_tiAdcA.tiDiff "F2355: Time measurement of interrupt activation (tiDiff=time-diff or 20 activations) / " ULONG TI1_U_S1 1 100 0 4294967295 FORMAT "%13.2" ECU_ADDRESS 0xFFF9247C /end MEASUREMENT
/begin MEASUREMENT ECE_tiAdcA.tiStamp "F2355: Time measurement of interrupt activation (tiDiff=time-diff or 20 activations) / " ULONG TI1_U_S1 1 100 0 4294967295 FORMAT "%13.2" ECU_ADDRESS 0xFFF92480 /end MEASUREMENT
/begin MEASUREMENT ECE_tiAdcA.ctDiff "F2355: Time measurement of interrupt activation (tiDiff=time-diff or 20 activations) / " UWORD X1_S1 1 100 0 65535 FORMAT "%8.2" ECU_ADDRESS 0xFFF92484 /end MEASUREMENT
/begin MEASUREMENT ECE_tiPwdDuty "F2359: Measured duty in 0.25us res. (per channel)" ULONG TI0_00025_M_S1 1 100 0 1073741.82375 FORMAT "%13.5" ARRAY_SIZE 6 ECU_ADDRESS 0xFFF91DC8 /end MEASUREMENT
/begin MEASUREMENT ECE_tiPwdPer "F2359: Measured period in 0.25us res. (per channel)" ULONG TI0_00025_M_S1 1 100 0 1073741.82375 FORMAT "%13.5" ARRAY_SIZE 6 ECU_ADDRESS 0xFFF91DB0 /end MEASUREMENT
/begin MEASUREMENT ECE_uAdcA "F2355: Detected pin voltage (ADC-A channels)" UWORD U0_001_S1 1 100 0 25 FORMAT "%8.5" ARRAY_SIZE 28 ECU_ADDRESS 0xFFF91994 /end MEASUREMENT
/begin MEASUREMENT ECE_uAdcAmux "F2355: Detected pin voltage (ADC-Amux MA,MB,MC,MD channels)" UWORD U0_001_S1 1 100 0 25 FORMAT "%8.5" ARRAY_SIZE 4 ECU_ADDRESS 0xFFF919DC /end MEASUREMENT
/begin MEASUREMENT ECE_uAdcB "F2355: Detected pin voltage (ADC-B channels)" UWORD U0_001_S1 1 100 0 25 FORMAT "%8.5" ARRAY_SIZE 7 ECU_ADDRESS 0xFFF919CC /end MEASUREMENT
/begin MEASUREMENT ECE_uBatt "F2355: Battery voltage (filter:ECE_numAdcFir)" UWORD U0_001_S1 1 100 0 25 FORMAT "%8.5" ECU_ADDRESS 0xFFF91FEA /end MEASUREMENT
/begin MEASUREMENT ECE_uBattMin "F2355: min. battery voltage (detected over main-task period)" UWORD U0_001_S1 1 100 0 25 FORMAT "%8.5" ECU_ADDRESS 0xFFF92004 /end MEASUREMENT
/begin MEASUREMENT ECE_uBattNoi "F2355: Noise level based on uBattSwt (filter ECE_numAdcNoiFir) (derived from uBattNoiInt+gradient limitation)" UWORD U0_001_S1 1 100 0 10 FORMAT "%8.5" ECU_ADDRESS 0xFFF91FFE /end MEASUREMENT
/begin MEASUREMENT ECE_uBattNoiInt "F2355: Noise level based on uBattSwt (filter ECE_numAdcNoiFir)" UWORD U0_001_S1 1 100 0 10 FORMAT "%8.5" ECU_ADDRESS 0xFFF92000 /end MEASUREMENT
/begin MEASUREMENT ECE_uBattSwt "F2355: switched Battery voltage (filter:ECE_numAdcFir)" UWORD U0_001_S1 1 100 0 35 FORMAT "%8.5" ECU_ADDRESS 0xFFF91FEC /end MEASUREMENT
/begin MEASUREMENT ECE_uM2 "F2355: Pre-regulator voltage (2nd stage)" UWORD U0_001_S1 1 100 0 25 FORMAT "%8.5" ECU_ADDRESS 0xFFF91FF2 /end MEASUREMENT
/begin MEASUREMENT ECE_uM3 "F2355: Pre-regulator voltage (3rd stage)" UWORD U0_001_S1 1 100 0 25 FORMAT "%8.5" ECU_ADDRESS 0xFFF91FF4 /end MEASUREMENT
/begin MEASUREMENT ECE_uPSply "F2355: Power supply voltage (filter:ECE_numAdcFir for the first three PSply's)" UWORD U0_001_S1 1 100 0 25 FORMAT "%8.5" ARRAY_SIZE 2 ECU_ADDRESS 0xFFF91990 /end MEASUREMENT
/begin MEASUREMENT ECE_uSSply "F2355: Sensor supply voltage" UWORD U0_001_S1 1 100 0 25 FORMAT "%8.5" ECU_ADDRESS 0xFFF91FF0 /end MEASUREMENT
/begin MEASUREMENT ECE_uVASIC "F2355: VASIC monitoring voltage" UWORD U0_001_S1 1 100 0 10 FORMAT "%8.5" ECU_ADDRESS 0xFFF91FFC /end MEASUREMENT
/begin MEASUREMENT ECE_uVDD3 "F2355: VDD3 monitoring voltage" UWORD U0_001_S1 1 100 0 10 FORMAT "%8.5" ECU_ADDRESS 0xFFF91FFA /end MEASUREMENT
/begin MEASUREMENT ECE_uWAK1 "F2355: Wake-Up Signal (WAK1) line voltage" UWORD U0_001_S1 1 100 0 25 FORMAT "%8.5" ECU_ADDRESS 0xFFF91FF6 /end MEASUREMENT
/begin MEASUREMENT ECE_uWAK2 "F2355: Wake-Up Signal (WAK2) line voltage" UWORD U0_001_S1 1 100 0 25 FORMAT "%8.5" ECU_ADDRESS 0xFFF91FF8 /end MEASUREMENT
/begin MEASUREMENT ECE_WDT_bHsdOff "F2391: Current high-side deactivation via CPU (only safety-relevant Hsds) (0:Hsd pos.,1:Hsd-Off)" UBYTE B_TRUE_S1 1 100 0 1 FORMAT "%13.11" ECU_ADDRESS 0xFFF92171 /end MEASUREMENT
/begin MEASUREMENT ECE_WDT_bWdtMode "F2391: WDT-operation mode (0=reset/overrun, 1=interrupt)" UBYTE B_TRUE_S1 1 100 0 1 FORMAT "%13.11" ECU_ADDRESS 0xFFF92172 /end MEASUREMENT
/begin MEASUREMENT ECE_WDT_tiMrgnMinEe "F2391: Minimum WDT margin, observed within the project (0=no value available; internal timer resultion)" UBYTE X1_S1 1 100 0 255 FORMAT "%5.1" ECU_ADDRESS 0xFFF95EC6 /end MEASUREMENT
/begin MEASUREMENT EeAccs_stEmu "F1100: Emu State: Bit [15]=Res, [14]=HealChkDne, [13]=HealChkTrg, [12]=NoVldSctrGrp, [11]=DatOutdated, [10]=PrvErsTrg, [9]=RamAccs, [8]=UpdTrg, [7]=UpdFin, [6]=WrTmpDat, [5]=Wr, [4]=Prio0RdFin, [3]=Prio1RdFin, [2]=Rd, [1]=FrstInitDet, [0]=Idle" UWORD X1_S1 1 100 0 65535 FORMAT "%8.2" ECU_ADDRESS 0xFFF94D82 /end MEASUREMENT
/begin MEASUREMENT EeAccs_stPrgLvlChg "F1100: Program level change: Bit [7]=First init, [6]=unused, [5]=unused, [4]=ROM data checksum, [3]=Additional OEM-ID, [2]=OEM-ID, [1]=ROM code checksum, [0]=RB-ID" UBYTE X1_S1 1 100 0 255 FORMAT "%5.1" ECU_ADDRESS 0xFFF95138 /end MEASUREMENT
/begin MEASUREMENT EeFltHdl_efFaults "F1100: Internal error bitfield (Bit 0/12/13: Reading, 1-5: Upd Main Data, 6-8: Upd Temp Data, 9: Deadlock, 10-11: FCU)" UWORD X1_S1 1 100 0 65535 FORMAT "%8.2" ECU_ADDRESS 0xFFF94D84 /end MEASUREMENT
/begin MEASUREMENT EeGenSrv_ctTotUpdSctrGrp_a "F1100: EEPROM Total Update Counter of Sector-Groups" ULONG X1_S1 1 100 0 4294967295 FORMAT "%13.2" ARRAY_SIZE 8 ECU_ADDRESS 0xFFF94624 /end MEASUREMENT
/begin MEASUREMENT EeUpdSrv_ctCmplUpd "F1100: EEPROM completed update counter" UWORD X1_S1 1 100 0 65535 FORMAT "%8.2" ECU_ADDRESS 0xFFF94D9A /end MEASUREMENT
/begin MEASUREMENT EeUpdSrv_ctTgtUpd "F1100: EEPROM Update Target Counter" UWORD X1_S1 1 100 0 65535 FORMAT "%8.2" ECU_ADDRESS 0xFFF94D9C /end MEASUREMENT
/begin MEASUREMENT EtkCal_FshbckWaitCnt "F1510: Downcounter to wait 1sec before starting flashback" UWORD TI1_CYCLE_S1 1 100 0 6553.5 FORMAT "%8.3" ECU_ADDRESS 0xFFF95C44 /end MEASUREMENT
/begin MEASUREMENT EtkSrv_tiDiffNoWait "F1510: Coldstart Setup-Time which was waited till WAIT_Command receveid from ETK (max 4ms)" ULONG TI1_U_S1 1 100 0 4294967295 FORMAT "%13.2" ECU_ADDRESS 0xFFF92204 /end MEASUREMENT
/begin MEASUREMENT EtkSrv_tiDiffWait "F1510: Coldstart Setup-Time which was wait till READY_Command received from ETK (max. 8ms)" ULONG TI1_U_S1 1 100 0 4294967295 FORMAT "%13.2" ECU_ADDRESS 0xFFF92208 /end MEASUREMENT
/begin MEASUREMENT ExchgFix_ctStrtUp "F1206: number of SB system startups since last power-down or loss of RAM content" UBYTE X1_S1 1 100 0 255 FORMAT "%5.1" ECU_ADDRESS 0xFFF800EC /end MEASUREMENT
/begin MEASUREMENT ExchgFix_s.numRamBufTest "F1206: Fix Exchg-RAM-Area: numRamBufValid=0xAF02451D (valid buffered RAM) / " ULONG X1_S1 1 100 0 4294967295 FORMAT "%13.2" ECU_ADDRESS 0xFFF800F0 /end MEASUREMENT
/begin MEASUREMENT ExchgFix_s.numFlshChkReq "F1206: Fix Exchg-RAM-Area: numRamBufValid=0xAF02451D (valid buffered RAM) / " ULONG X1_S1 1 100 0 4294967295 FORMAT "%13.2" ECU_ADDRESS 0xFFF800F4 /end MEASUREMENT
/begin MEASUREMENT ExchgFix_s.numAreaDataVal "F1206: Fix Exchg-RAM-Area: numRamBufValid=0xAF02451D (valid buffered RAM) / " UWORD X1_S1 1 100 0 65535 FORMAT "%8.2" ECU_ADDRESS 0xFFF800F8 /end MEASUREMENT
/begin MEASUREMENT ExchgFix_s.reserved "F1206: Fix Exchg-RAM-Area: numRamBufValid=0xAF02451D (valid buffered RAM) / " UWORD X1_S1 1 100 0 65535 FORMAT "%8.2" ECU_ADDRESS 0xFFF800FA /end MEASUREMENT
/begin MEASUREMENT ExchgFix_s.numRamBufValid "F1206: Fix Exchg-RAM-Area: numRamBufValid=0xAF02451D (valid buffered RAM) / " ULONG X1_S1 1 100 0 4294967295 FORMAT "%13.2" ECU_ADDRESS 0xFFF800FC /end MEASUREMENT
/begin MEASUREMENT InpPAtfL2_efAtfVarEEP "F2440: Error flag for not supported ATF sensor variant" UBYTE B_TRUE_S1 1 100 0 1 FORMAT "%13.11" ECU_ADDRESS 0xFFF95617 /end MEASUREMENT
/begin MEASUREMENT InpPAtfL2_facAtf "F2440: Voltage factor for resistance deviation recognition of the sensor" UWORD R0_001_S1 1 100 0 20 FORMAT "%8.5" ECU_ADDRESS 0xFFF95026 /end MEASUREMENT
/begin MEASUREMENT InpPAtfL2_idxAtfVar "F2440: ATF sensor variant from reference table (limited)" UBYTE X1_S1 1 100 0 5 FORMAT "%5.3" ECU_ADDRESS 0xFFF95618 /end MEASUREMENT
/begin MEASUREMENT InpPAtfL2_idxAtfVarEEP "F2440: Index of ATF sensor variant read from EEprom" UBYTE X1_S1 1 100 0 5 FORMAT "%5.3" ECU_ADDRESS 0xFFF95619 /end MEASUREMENT
/begin MEASUREMENT InpPAtfL2_idxAtfVarTab "F2440: Index of ATF sensor variant read from reference table" UBYTE X1_S1 1 100 0 1 FORMAT "%5.3" ECU_ADDRESS 0xFFF9561A /end MEASUREMENT
/begin MEASUREMENT InpPAtfL2_qtAtf "F2440: Quality signal of the ATF temperature 1" UBYTE Q_SIG_S1 1 100 0 8 FORMAT "%13.11" ECU_ADDRESS 0xFFF9561B /end MEASUREMENT
/begin MEASUREMENT InpPAtfL2_stAtf "F2440: Internal status bits: 15-12:no use, 11: init passed; 10:data variant; 9:timeout; 8:hi grad; 7:el.ok; 6:res.factor; 5:usens hi; 4:usens lo; 3:hi pin hi; 2:hi pin lo; 1:lo pin hi; 0:lo pin lo" UWORD X1_S1 1 100 0 2048 FORMAT "%8.3" ECU_ADDRESS 0xFFF95028 /end MEASUREMENT
/begin MEASUREMENT InpPAtfL2_tAtf "F2440: ATF temperature 1" SWORD T0_0625_S1 1 100 -40 215 FORMAT "%8.4" ECU_ADDRESS 0xFFF9502A /end MEASUREMENT
/begin MEASUREMENT InpPAtfL2_tiAtfErr "F2440: Timer for fix replacement of tAtf during error situation" UWORD TI1_M_CYCLE_S1 1 100 0 10000 FORMAT "%8.2" ECU_ADDRESS 0xFFF95C92 /end MEASUREMENT
/begin MEASUREMENT InpPAtfL2_tiAtfIniDel "F2440: Delay timer after initialization for fault prevention caused by unvalid signals" UBYTE TI1_M_CYCLE_S1 1 100 0 50 FORMAT "%5.2" ECU_ADDRESS 0xFFF95D5F /end MEASUREMENT
/begin MEASUREMENT InpPAtfL2_uAtfGrad "F2440: Voltage differenz against old value of ATF sensor" SWORD U0_001_S1 1 100 -0.5 0.5 FORMAT "%9.7" ECU_ADDRESS 0xFFF9502C /end MEASUREMENT
/begin MEASUREMENT InpPAtfL2_uAtfHi "F2440: Voltage on the high line of the ATF sensor" UWORD U0_001_S1 1 100 0 5 FORMAT "%8.6" ECU_ADDRESS 0xFFF9502E /end MEASUREMENT
/begin MEASUREMENT InpPAtfL2_uAtfLo "F2440: Voltage on the low line of the ATF sensor" UWORD U0_001_S1 1 100 0 5 FORMAT "%8.6" ECU_ADDRESS 0xFFF95030 /end MEASUREMENT
/begin MEASUREMENT InpPAtfL2_uAtfSens "F2440: Raw value of voltage difference ATF sensor" SWORD U0_001_S1 1 100 0 5 FORMAT "%8.6" ECU_ADDRESS 0xFFF95032 /end MEASUREMENT
/begin MEASUREMENT InpPAtfL2_uAtfSensOld "F2440: Raw value of voltage difference of ATF sensor old value" SWORD U0_001_S1 1 100 0 5 FORMAT "%8.6" ECU_ADDRESS 0xFFF95034 /end MEASUREMENT
/begin MEASUREMENT InpPAtfL2_yDmy "F2440: Dummy ram for ATF variant conversion table (idxAtfVarCnv_C)" UBYTE X1_S1 1 100 0 255 FORMAT "%5.1" ECU_ADDRESS 0xFFF9561C /end MEASUREMENT
/begin MEASUREMENT InpPAtfL3_stAtfFault "F2440: Bit word with fault conditions of fault types for DSM" UWORD X1_S1 1 100 0 65535 FORMAT "%8.2" ECU_ADDRESS 0xFFF95072 /end MEASUREMENT
/begin MEASUREMENT InpPAtfL3_stAtfTstCon "F2440: Bit word with test conditions of fault types for DSM" UWORD X1_S1 1 100 0 65535 FORMAT "%8.2" ECU_ADDRESS 0xFFF95074 /end MEASUREMENT
/begin MEASUREMENT InpPAtfL3_stSubsQualOk "F2440: Status bit word shows the availability of substitution signals: Bit 0: ATF, Bit 1:ATF2, Bit 2: CHP" UBYTE X1_S1 1 100 0 7 FORMAT "%5.3" ECU_ADDRESS 0xFFF95630 /end MEASUREMENT
/begin MEASUREMENT InpPAtfL3_stSubsUsd "F2440: Current used signal source for ATF (bit 0: ATF, bit 1: ATF2, bit 2: CHP)" UBYTE X1_S1 1 100 0 7 FORMAT "%5.3" ECU_ADDRESS 0xFFF95631 /end MEASUREMENT
/begin MEASUREMENT InpPBatL2_bBattNoiVBS "F2410: Flag for noise voltage higher limit and elongation timer for VBS monitoring not zero." UBYTE B_TRUE_S1 1 100 0 1 FORMAT "%13.11" ECU_ADDRESS 0xFFF9561D /end MEASUREMENT
/begin MEASUREMENT InpPBatL2_stBatt "F2410: Bit word for fault situations: 7:noise hi timeout, 6: noise hi, 5: vb lo timeout, 4: vb lo, 3: vb hi, 2: -, 1: vbs tol. timeout, 0: vbs tol." UWORD X1_S1 1 100 0 65535 FORMAT "%8.2" ECU_ADDRESS 0xFFF95036 /end MEASUREMENT
/begin MEASUREMENT InpPBatL2_tiBattDiff "F2410: Timer for voltage difference of VB and VBS is over threshold" UWORD TI1_M_CYCLE_S1 1 100 0 327675 FORMAT "%8.1" ECU_ADDRESS 0xFFF95C94 /end MEASUREMENT
/begin MEASUREMENT InpPBatL2_tiBattLoVltg "F2410: Timer is running down if battery voltage is under threshold. On reaching zero a status bit is set." UWORD TI1_M_CYCLE_S1 1 100 0 327675 FORMAT "%8.1" ECU_ADDRESS 0xFFF95C96 /end MEASUREMENT
/begin MEASUREMENT InpPBatL2_tiBattNoi "F2410: Timer for holding noise recognition flag" UWORD TI1_M_CYCLE_S1 1 100 0 327675 FORMAT "%8.1" ECU_ADDRESS 0xFFF95C98 /end MEASUREMENT
/begin MEASUREMENT InpPBatL2_tiBattNoiVBS "F2410: Timer for holding noise recognition flag concerning VBS monitoring prevention" UWORD TI1_M_CYCLE_S1 1 100 0 327675 FORMAT "%8.1" ECU_ADDRESS 0xFFF95C9A /end MEASUREMENT
/begin MEASUREMENT InpPBatL2_uBattDrop "F2410: Deviation of voltage drop at UBS-FET against normal value (UDROP:=ABS(UB-UBS-UDROPC))" UWORD U0_001_S1 1 100 0 2 FORMAT "%8.6" ECU_ADDRESS 0xFFF95038 /end MEASUREMENT
/begin MEASUREMENT InpPBatL2_uBattSwt "F2410: Switched battery voltage (VBS)" UWORD U0_001_S1 1 100 0 32.767 FORMAT "%8.5" ECU_ADDRESS 0xFFF9503A /end MEASUREMENT
/begin MEASUREMENT InpPBatL3_stBattFault "F2410: Active fault situations bit coded of battery monitoring for DSM" UWORD X1_S1 1 100 0 65535 FORMAT "%8.2" ECU_ADDRESS 0xFFF95076 /end MEASUREMENT
/begin MEASUREMENT InpPBatL3_stBattTstCon "F2410: Active test condition bit coded of battery monitoring for DSM" UWORD X1_S1 1 100 0 65535 FORMAT "%8.2" ECU_ADDRESS 0xFFF95078 /end MEASUREMENT
/begin MEASUREMENT InpPChipL2_bChpHw "F2442: komparator output of CG130 internal chip temperature HW evaluation (Bit0:TEMPL Bit1:TEMPH)" UBYTE X1_S1 1 100 0 255 FORMAT "%5.1" ECU_ADDRESS 0xFFF9561E /end MEASUREMENT
/begin MEASUREMENT InpPChipL2_idxChpHwVers "F2442: application data index for CG130 Chip temperature" UBYTE X1_S1 1 100 0 255 FORMAT "%5.1" ECU_ADDRESS 0xFFF9561F /end MEASUREMENT
/begin MEASUREMENT InpPChipL2_qtChp "F2442: Quality signal of the internal chip temperatur (Chp1 = CG130)" UBYTE Q_SIG_S1 1 100 0 8 FORMAT "%13.11" ECU_ADDRESS 0xFFF95620 /end MEASUREMENT
/begin MEASUREMENT InpPChipL2_rChp "F2442: CG130 chip temperature signal without quantisation (raw value)" UWORD X1_S1 1 100 0 1023 FORMAT "%8.3" ECU_ADDRESS 0xFFF9503C /end MEASUREMENT
/begin MEASUREMENT InpPChipL2_rChpOld "F2442: Old value rChpNew for change recognition" UWORD X1_S1 1 100 0 1023 FORMAT "%8.3" ECU_ADDRESS 0xFFF9503E /end MEASUREMENT
/begin MEASUREMENT InpPChipL2_stChp "F2442: status bit field of CG130 chip temperature (format see documentation)" UWORD X1_S1 1 100 0 65535 FORMAT "%8.2" ECU_ADDRESS 0xFFF95040 /end MEASUREMENT
/begin MEASUREMENT InpPChipL2_stChpOld "F2442: Status bit word of the chip temperature evaluation from last cycle (same bit meaning as stChp)" UWORD X1_S1 1 100 0 65535 FORMAT "%8.2" ECU_ADDRESS 0xFFF95042 /end MEASUREMENT
/begin MEASUREMENT InpPChipL2_tChp "F2442: Chip temperature (interner Sensor = CG130 = Chp1)" SWORD T0_0625_S1 1 100 -40 215 FORMAT "%8.4" ECU_ADDRESS 0xFFF95044 /end MEASUREMENT
/begin MEASUREMENT InpPChipL2_tiChpFault "F2442: Timeout timer for CG130 chip temperatur signal fault" UWORD TI1_M_CYCLE_S1 1 100 0 327675 FORMAT "%8.1" ECU_ADDRESS 0xFFF95C9C /end MEASUREMENT
/begin MEASUREMENT InpPChipL2_tiChpIniDel "F2442: Delay timer after initialization for fault prevention caused by unvalid signals" UBYTE TI1_M_CYCLE_S1 1 100 0 50 FORMAT "%5.2" ECU_ADDRESS 0xFFF95D60 /end MEASUREMENT
/begin MEASUREMENT InpPChipL3_stChpFault "F2442: Bit word with active fault status of internal chip temperatur monitoring (Chp1)" UWORD X1_S1 1 100 0 65535 FORMAT "%8.2" ECU_ADDRESS 0xFFF9507A /end MEASUREMENT
/begin MEASUREMENT InpPChipL3_stChpTstCon "F2442: Bit word with active test conditions of internal chip temperature monitoring (Chp1)" UWORD X1_S1 1 100 0 65535 FORMAT "%8.2" ECU_ADDRESS 0xFFF9507C /end MEASUREMENT
/begin MEASUREMENT InpPChipL3_stSubsUsd "F2442: Current used signal source for CHP: Bit 2: CHP2, Bit 1:CHP1, Bit 0: ATF" UBYTE X1_S1 1 100 0 7 FORMAT "%5.3" ECU_ADDRESS 0xFFF95632 /end MEASUREMENT
/begin MEASUREMENT InpPChp2L2_rChp2 "F2443: External chip temperature 2 signal from ECE with 128 LSB/bit" SWORD T0_0078125_S1 1 100 -256 255.9922 FORMAT "%8.4" ECU_ADDRESS 0xFFF95046 /end MEASUREMENT
/begin MEASUREMENT InpPChp2L2_rChp2Old "F2443: Old value rChp2 for change recognition" SWORD T0_0078125_S1 1 100 -255.9922 255.9922 FORMAT "%8.4" ECU_ADDRESS 0xFFF95048 /end MEASUREMENT
/begin MEASUREMENT InpPChp2L2_stChp2 "F2443: Status error bits: 15-13:- 12:flt.timeout, 11:-, 10:timeout, 9:sig.chg., 8:FFFF error, 7:mid rng., 6:sig hi 5:sig lo 4:bit01 not set, 3:init.sig.rec., 2:FFFF sig.rec., 1:init.timeout, 0:init done" UWORD X1_S1 1 100 0 2048 FORMAT "%8.3" ECU_ADDRESS 0xFFF9504A /end MEASUREMENT
/begin MEASUREMENT InpPChp2L2_stChp2Old "F2443: Status bit word of the chip 2 temperature evaluation from last cycle" UWORD X1_S1 1 100 0 2024 FORMAT "%8.3" ECU_ADDRESS 0xFFF9504C /end MEASUREMENT
/begin MEASUREMENT InpPChp2L2_tiChp2Fault "F2443: Timeout timer on signal fault" UWORD TI1_M_CYCLE_S1 1 100 0 327675 FORMAT "%8.1" ECU_ADDRESS 0xFFF95C9E /end MEASUREMENT
/begin MEASUREMENT InpPChp2L2_tiChp2IniTo "F2443:  Time out timer of the init phase for externel chip temperature" UWORD TI1_CYCLE_S1 1 100 0 6553.5 FORMAT "%8.3" ECU_ADDRESS 0xFFF95C4C /end MEASUREMENT
/begin MEASUREMENT InpPChp2L3_stChp2Fault "F2443: Bit word with active fault status of chip 2 temperatur monitoring" UWORD X1_S1 1 100 0 65535 FORMAT "%8.2" ECU_ADDRESS 0xFFF9507E /end MEASUREMENT
/begin MEASUREMENT InpPChp2L3_stChp2TstCon "F2443: Bit word with active test conditions of chip 2 temperature monitoring" UWORD X1_S1 1 100 0 65535 FORMAT "%8.2" ECU_ADDRESS 0xFFF95080 /end MEASUREMENT
/begin MEASUREMENT InpPIfcBatt_efBattNoi "F2410: Error flag is set if noise voltage is over limit" UBYTE B_TRUE_S1 1 100 0 1 FORMAT "%13.11" ECU_ADDRESS 0xFFF955C1 /end MEASUREMENT
/begin MEASUREMENT InpPIfcBatt_quBatt "F2410: Quality information (status) of the battery voltage" UBYTE Q_SIG_S1 1 100 0 8 FORMAT "%13.11" ECU_ADDRESS 0xFFF96412 /end MEASUREMENT
/begin MEASUREMENT InpPIfcBatt_uBatt "F2410: Battery voltage" UWORD U0_001_S1 1 100 0 32.767 FORMAT "%8.5" ECU_ADDRESS 0xFFF963AA /end MEASUREMENT
/begin MEASUREMENT InpPIfcBatt_uBatt8 "F2410: Battery voltage with 8 bit resolution" UBYTE U0_1_S1 1 100 0 25.5 FORMAT "%5.2" ECU_ADDRESS 0xFFF955C2 /end MEASUREMENT
/begin MEASUREMENT InpPIfcBatt_uBattMin "F2410: Minimum battery voltage" UWORD U0_001_S1 1 100 0 32.767 FORMAT "%8.5" ECU_ADDRESS 0xFFF94F16 /end MEASUREMENT
/begin MEASUREMENT InpPIfcBatt_uBattNoi "F2410: Noise voltage of battery signal" UWORD U0_001_S1 1 100 0 16 FORMAT "%8.5" ECU_ADDRESS 0xFFF94F18 /end MEASUREMENT
/begin MEASUREMENT InpPIfcChip_qtChp "F2442: Quality signal of the chip temperatur (selection of tChp2, tChp, tAtf)" UBYTE Q_SIG_S1 1 100 0 8 FORMAT "%13.11" ECU_ADDRESS 0xFFF955C3 /end MEASUREMENT
/begin MEASUREMENT InpPIfcChip_qtChp1 "F2442: Quality of the internal chip temperature signal (Chp1)" UBYTE Q_SIG_S1 1 100 0 8 FORMAT "%13.11" ECU_ADDRESS 0xFFF955C4 /end MEASUREMENT
/begin MEASUREMENT InpPIfcChip_tChp "F2442: Chip temperature (selection of tChp2, tChp, tAtf)" SWORD T0_0625_S1 1 100 -40 215 FORMAT "%8.4" ECU_ADDRESS 0xFFF94F1A /end MEASUREMENT
/begin MEASUREMENT InpPIfcChip_tChp1 "F2442: Temperature of the internal chip sensor" SWORD T0_0625_S1 1 100 -40 215 FORMAT "%8.4" ECU_ADDRESS 0xFFF94F1C /end MEASUREMENT
/begin MEASUREMENT InpPIfcChip_tChp18 "F2442: Temperature of the internal sensor with 8 bit resolution" UBYTE T1_OFFS_40_S1 1 100 -40 215 FORMAT "%5.1" ECU_ADDRESS 0xFFF955C5 /end MEASUREMENT
/begin MEASUREMENT InpPIfcChip_tChp8 "F2442: Chip temperature with 8 bit resolution (selection of tChp2, tChp, tAtf)" UBYTE T1_OFFS_40_S1 1 100 -40 215 FORMAT "%5.1" ECU_ADDRESS 0xFFF955C6 /end MEASUREMENT
/begin MEASUREMENT InpPIfcChp2_qtChp2 "F2443: Quality signal of the chip temperatur 2" UBYTE Q_SIG_S1 1 100 0 8 FORMAT "%13.11" ECU_ADDRESS 0xFFF955C7 /end MEASUREMENT
/begin MEASUREMENT InpPIfcChp2_tChp2 "F2443: Chip temperature 2" SWORD T0_0625_S1 1 100 -40 215 FORMAT "%8.4" ECU_ADDRESS 0xFFF94F1E /end MEASUREMENT
/begin MEASUREMENT InpPIfcChp2_tChp28 "F2443: Chip 2 temperature with 8 bit resolution" UBYTE T1_OFFS_40_S1 1 100 -40 215 FORMAT "%5.1" ECU_ADDRESS 0xFFF955C8 /end MEASUREMENT
/begin MEASUREMENT InpPIfcM2M3_quM2 "F2415: Quality signal of the Voltage Signal M2" UBYTE Q_SIG_S1 1 100 0 8 FORMAT "%13.11" ECU_ADDRESS 0xFFF95615 /end MEASUREMENT
/begin MEASUREMENT InpPIfcM2M3_quM3 "F2415: Quality signal of the Voltage Signal M3" UBYTE Q_SIG_S1 1 100 0 8 FORMAT "%13.11" ECU_ADDRESS 0xFFF95616 /end MEASUREMENT
/begin MEASUREMENT InpPIfcM2M3_uM2 "F2415: Voltage signal M2" UWORD U0_001_S1 1 100 0 16 FORMAT "%8.5" ECU_ADDRESS 0xFFF95022 /end MEASUREMENT
/begin MEASUREMENT InpPIfcM2M3_uM3 "F2415: Voltage Signal M3" UWORD U0_001_S1 1 100 0 16 FORMAT "%8.5" ECU_ADDRESS 0xFFF95024 /end MEASUREMENT
/begin MEASUREMENT InpPIfcPsns_bPsns "F2450: Array with the states of digital position lines as bool: TRUE=ON" UBYTE B_TRUE_S1 1 100 0 1 FORMAT "%13.11" ARRAY_SIZE 6 ECU_ADDRESS 0xFFF963AC /end MEASUREMENT
/begin MEASUREMENT InpPIfcPsns_qbPsns "F2450: Quality info for bPsns[]" UBYTE Q_SIG_S1 1 100 0 8 FORMAT "%13.11" ARRAY_SIZE 6 ECU_ADDRESS 0xFFF963B2 /end MEASUREMENT
/begin MEASUREMENT InpPIfcPSupp_quBattSply "F2411: Current quality of the power supply source voltage" UBYTE Q_SIG_S1 1 100 0 8 FORMAT "%13.11" ECU_ADDRESS 0xFFF96413 /end MEASUREMENT
/begin MEASUREMENT InpPIfcPSupp_quPSply "F2411: Quality information of actuator supply (channel no)" UBYTE Q_SIG_S1 1 100 0 8 FORMAT "%13.11" ARRAY_SIZE 2 ECU_ADDRESS 0xFFF963B8 /end MEASUREMENT
/begin MEASUREMENT InpPIfcPSupp_uBattSply "F2411: Current voltage of the power supply source" UWORD U0_001_S1 1 100 0 32.767 FORMAT "%8.5" ECU_ADDRESS 0xFFF963BA /end MEASUREMENT
/begin MEASUREMENT InpPIfcPSupp_uPSply "F2411: Power supply voltage of the available channels in L2" UWORD U0_001_S1 1 100 0 32.767 FORMAT "%8.5" ARRAY_SIZE 2 ECU_ADDRESS 0xFFF962F0 /end MEASUREMENT
/begin MEASUREMENT InpPIfcPSupp_uPSply8 "F2411: Actuator voltage with 8 bit resolution,(para. channel no.)" UBYTE U0_1_S1 1 100 0 25.5 FORMAT "%5.2" ARRAY_SIZE 2 ECU_ADDRESS 0xFFF94F20 /end MEASUREMENT
/begin MEASUREMENT InpPIfcSens_uSSply "F2413: Sensor supply voltage" UWORD U0_001_S1 1 100 0 10 FORMAT "%8.5" ECU_ADDRESS 0xFFF94F22 /end MEASUREMENT
/begin MEASUREMENT InpPIfcTemp_qtAtf "F2440: Quality of tAtf (transmission oil temperature with substitution signals)" UBYTE Q_SIG_S1 1 100 0 8 FORMAT "%13.11" ECU_ADDRESS 0xFFF96414 /end MEASUREMENT
/begin MEASUREMENT InpPIfcTemp_qtAtfHw "F2440: Quality of tAtfHw (oil temperature without substitution signals)" UBYTE Q_SIG_S1 1 100 0 8 FORMAT "%13.11" ECU_ADDRESS 0xFFF96415 /end MEASUREMENT
/begin MEASUREMENT InpPIfcTemp_qtAtfPhys "F2440: Quality of tAtfPhys (oil temperature with substitution and may be project specific modell correction)" UBYTE Q_SIG_S1 1 100 0 8 FORMAT "%13.11" ECU_ADDRESS 0xFFF96416 /end MEASUREMENT
/begin MEASUREMENT InpPIfcTemp_tAtf "F2440: ATF temperature with substitution values)" SWORD T0_0625_S1 1 100 -40 215 FORMAT "%8.4" ECU_ADDRESS 0xFFF963BC /end MEASUREMENT
/begin MEASUREMENT InpPIfcTemp_tAtf8 "F2440: 8 bit value of tAtf (oil temperature with substitution signals)" UBYTE T1_OFFS_40_S1 1 100 -40 215 FORMAT "%5.1" ECU_ADDRESS 0xFFF955C9 /end MEASUREMENT
/begin MEASUREMENT InpPIfcTemp_tAtf8Phys "F2440: ATF temperature with 8 bit resolution (signal with substitution and may be project specific modell correction)" UBYTE T1_OFFS_40_S1 1 100 -40 215 FORMAT "%5.1" ECU_ADDRESS 0xFFF955CA /end MEASUREMENT
/begin MEASUREMENT InpPIfcTemp_tAtfHw "F2440: ATF temperature (oil temperature) without substitution values" SWORD T0_0625_S1 1 100 -40 215 FORMAT "%8.4" ECU_ADDRESS 0xFFF963BE /end MEASUREMENT
/begin MEASUREMENT InpPIfcTemp_tAtfPhys "F2440: ATF (oil) temperature with substitution and may be project specific modell correction" SWORD T0_0625_S1 1 100 -40 215 FORMAT "%8.4" ECU_ADDRESS 0xFFF963C0 /end MEASUREMENT
/begin MEASUREMENT InpPIfcWake_bWak1 "F2420: Logical level on wakeup input line 1" UBYTE B_TRUE_S1 1 100 0 1 FORMAT "%13.11" ECU_ADDRESS 0xFFF96417 /end MEASUREMENT
/begin MEASUREMENT InpPIfcWake_bWak2 "F2420: Logical level on wakeup input line 2" UBYTE B_TRUE_S1 1 100 0 1 FORMAT "%13.11" ECU_ADDRESS 0xFFF955CB /end MEASUREMENT
/begin MEASUREMENT InpPIfcWake_bWakInt "F2420: Logical level of the internal wakeup signal" UBYTE B_TRUE_S1 1 100 0 1 FORMAT "%13.11" ECU_ADDRESS 0xFFF955CC /end MEASUREMENT
/begin MEASUREMENT InpPIfcWake_bWakPhys "F2420: physical level on wakeup" UBYTE B_TRUE_S1 1 100 0 1 FORMAT "%13.11" ECU_ADDRESS 0xFFF96418 /end MEASUREMENT
/begin MEASUREMENT InpPIfcWake_qbWak1 "F2420: Quality information for the digital Wak1 signal" UBYTE Q_SIG_S1 1 100 0 8 FORMAT "%13.11" ECU_ADDRESS 0xFFF96419 /end MEASUREMENT
/begin MEASUREMENT InpPIfcWake_qbWak2 "F2420: Quality information for the digital Wak2 signal" UBYTE Q_SIG_S1 1 100 0 8 FORMAT "%13.11" ECU_ADDRESS 0xFFF955CD /end MEASUREMENT
/begin MEASUREMENT InpPIfcWake_qbWakInt "F2420: Quality info of the internal wakeup line (WAKST from CG130)" UBYTE Q_SIG_S1 1 100 0 8 FORMAT "%13.11" ECU_ADDRESS 0xFFF955CE /end MEASUREMENT
/begin MEASUREMENT InpPIfcWake_qbWakPhys "F2420: quality information for the physical wake signal" UBYTE Q_SIG_S1 1 100 0 8 FORMAT "%13.11" ECU_ADDRESS 0xFFF9641A /end MEASUREMENT
/begin MEASUREMENT InpPIfcWake_quWak1 "F2420: Quality information of Wakeup 1" UBYTE Q_SIG_S1 1 100 0 8 FORMAT "%13.11" ECU_ADDRESS 0xFFF9641B /end MEASUREMENT
/begin MEASUREMENT InpPIfcWake_quWak2 "F2420: Quality information of Wakeup 2" UBYTE Q_SIG_S1 1 100 0 8 FORMAT "%13.11" ECU_ADDRESS 0xFFF955CF /end MEASUREMENT
/begin MEASUREMENT InpPIfcWake_uWak1 "F2420: Voltage level on wakeup input line 1" UWORD U0_001_S1 1 100 0 25 FORMAT "%8.5" ECU_ADDRESS 0xFFF963C2 /end MEASUREMENT
/begin MEASUREMENT InpPIfcWake_uWak2 "F2420: Voltage level on wakeup input line 2" UWORD U0_001_S1 1 100 0 25 FORMAT "%8.5" ECU_ADDRESS 0xFFF94F24 /end MEASUREMENT
/begin MEASUREMENT InpPPsnsL2_bAna "F2450: Array with on/off status of the analog lines: TRUE=ON" UBYTE B_TRUE_S1 1 100 0 1 FORMAT "%13.11" ARRAY_SIZE 6 ECU_ADDRESS 0xFFF9504E /end MEASUREMENT
/begin MEASUREMENT InpPPsnsL2_bAnaCpl "F2450: Array with complements of the on/off stati of the analog lines: 254=ON, 255=OFF" UBYTE X1_S1 1 100 0 255 FORMAT "%5.1" ARRAY_SIZE 6 ECU_ADDRESS 0xFFF95054 /end MEASUREMENT
/begin MEASUREMENT InpPPsnsL2_bDig "F2450: Digital line state of the digital Psns inputs as array" UBYTE B_TRUE_S1 1 100 0 1 FORMAT "%13.11" ARRAY_SIZE 6 ECU_ADDRESS 0xFFF9505A /end MEASUREMENT
/begin MEASUREMENT InpPPsnsL2_ctChnIdx "F2450: Psns input line index for Festkennfeld  InpPPsnsL2_rPsnsAnaZon_C" UBYTE X1_S1 1 100 0 5 FORMAT "%5.3" ECU_ADDRESS 0xFFF95621 /end MEASUREMENT
/begin MEASUREMENT InpPPsnsL2_ctPsnsIni "F2450: Down counter of program cycles calls after reset." UBYTE X1_S1 1 100 0 20 FORMAT "%5.2" ECU_ADDRESS 0xFFF95622 /end MEASUREMENT
/begin MEASUREMENT InpPPsnsL2_ctRngIdx "F2450: Analog range index for Festkennfeld  InpPPsnsL2_rPsnsAnaZon_C" UBYTE X1_S1 1 100 0 4 FORMAT "%5.3" ECU_ADDRESS 0xFFF95623 /end MEASUREMENT
/begin MEASUREMENT InpPPsnsL2_qbPsns "F2450: internal quality info concerning sensor supply" UBYTE Q_SIG_S1 1 100 0 8 FORMAT "%13.11" ECU_ADDRESS 0xFFF95624 /end MEASUREMENT
/begin MEASUREMENT InpPPsnsL2_rPsnsAna "F2450: Array with voltage ratio of the analog Psns lines related to the sensor voltage" UWORD R0_0001_S1 1 100 0 1.2 FORMAT "%8.6" ARRAY_SIZE 6 ECU_ADDRESS 0xFFF94A9C /end MEASUREMENT
/begin MEASUREMENT InpPPsnsL2_stPsnsAna "F2450: Analog line states digitized as bit word" UBYTE X1_S1 1 100 0 63 FORMAT "%5.2" ECU_ADDRESS 0xFFF95625 /end MEASUREMENT
/begin MEASUREMENT InpPPsnsL2_stPsnsAnaErr "F2450: Bit word with fault bits of the available analog lines" UBYTE X1_S1 1 100 0 63 FORMAT "%5.2" ECU_ADDRESS 0xFFF95626 /end MEASUREMENT
/begin MEASUREMENT InpPPsnsL2_stPsnsDFC "F2450: Array over position lines with diagnosis state of the analog Psns inputs: 0=SG; 1=ON; 2=UNDEF; 3=OFF; 4=OP; 5=SB" UBYTE X1_S1 1 100 0 5 FORMAT "%5.3" ARRAY_SIZE 6 ECU_ADDRESS 0xFFF95060 /end MEASUREMENT
/begin MEASUREMENT InpPPsnsL2_stPsnsDig "F2450: Digital Psns line states as bit word" UBYTE X1_S1 1 100 0 63 FORMAT "%5.2" ECU_ADDRESS 0xFFF95627 /end MEASUREMENT
/begin MEASUREMENT InpPPsnsL2_stPsnsDigChng "F2450: Bit word with line change information since last cycle only of the digital position inputs." UBYTE X1_S1 1 100 0 63 FORMAT "%5.2" ECU_ADDRESS 0xFFF95628 /end MEASUREMENT
/begin MEASUREMENT InpPPsnsL2_stPsnsDigOld "F2450: Old value of digital Psns line states" UBYTE X1_S1 1 100 0 63 FORMAT "%5.2" ECU_ADDRESS 0xFFF95629 /end MEASUREMENT
/begin MEASUREMENT InpPPsnsL2_stPsnsPlausErr "F2450: Bit word with plausibility errors for every line which is analog and digital available" UBYTE X1_S1 1 100 0 63 FORMAT "%5.2" ECU_ADDRESS 0xFFF9562A /end MEASUREMENT
/begin MEASUREMENT InpPPsnsL2_stPsnsSt "F2450: Status bit word f Psns signal evaluation. (bit0: 1=ctPsnsIni zero; bit1: 1=supply below limit; bit2: 1=sply switched off; bit3: 1=supply switched off and timer zero)" UBYTE X1_S1 1 100 0 63 FORMAT "%5.2" ECU_ADDRESS 0xFFF9562B /end MEASUREMENT
/begin MEASUREMENT InpPPsnsL2_tiFault "F2450: Timeout timer for freezing the position signals on sensor supply fault" UWORD TI1_M_CYCLE_S1 1 100 0 1000 FORMAT "%8.3" ECU_ADDRESS 0xFFF95CA0 /end MEASUREMENT
/begin MEASUREMENT InpPPsnsL3_bMonCondGen "F2450: General condition for monitoring release" UBYTE B_TRUE_S1 1 100 0 1 FORMAT "%13.11" ECU_ADDRESS 0xFFF95633 /end MEASUREMENT
/begin MEASUREMENT InpPPsnsL3_bPsnsDsmErr "F2450: current electrical error state" UBYTE B_TRUE_S1 1 100 0 1 FORMAT "%13.11" ARRAY_SIZE 6 ECU_ADDRESS 0xFFF95082 /end MEASUREMENT
/begin MEASUREMENT InpPPsnsL3_stPsnsAnaOld "F2450: Old value of bit word with on/off status of the analog lines" UBYTE X1_S1 1 100 0 63 FORMAT "%5.2" ECU_ADDRESS 0xFFF95634 /end MEASUREMENT
/begin MEASUREMENT InpPPsnsL3_stPsnsChngErr "F2450: Bit word with lines which have toggled for activation the test condition" UBYTE X1_S1 1 100 0 63 FORMAT "%5.2" ECU_ADDRESS 0xFFF95635 /end MEASUREMENT
/begin MEASUREMENT InpPPsnsL3_stPsnsDFCOld "F2450: Array with diagnosis state of the Psns lines from last cycle" UBYTE X1_S1 1 100 0 5 FORMAT "%5.3" ARRAY_SIZE 6 ECU_ADDRESS 0xFFF95088 /end MEASUREMENT
/begin MEASUREMENT InpPPsnsL3_stPsnsFault "F2450: Bit field with active fault conditions of Psns monitoring" UWORD X1_S1 1 100 0 65535 FORMAT "%8.2" ARRAY_SIZE 6 ECU_ADDRESS 0xFFF94AA8 /end MEASUREMENT
/begin MEASUREMENT InpPPsnsL3_stPsnsOld "F2450: Old value of the digital Psns line states" UBYTE X1_S1 1 100 0 63 FORMAT "%5.2" ECU_ADDRESS 0xFFF95636 /end MEASUREMENT
/begin MEASUREMENT InpPPsnsL3_stPsnsTstCon "F2450: Bit word with active test conditions of Psns monitoring" UWORD X1_S1 1 100 0 65535 FORMAT "%8.2" ARRAY_SIZE 6 ECU_ADDRESS 0xFFF94AB4 /end MEASUREMENT
/begin MEASUREMENT InpPTisL2_fEce "F2431: Signal frequency received from ECE layer." UWORD F1_S1 1 100 0 15000 FORMAT "%8.2" ECU_ADDRESS 0xFFF95066 /end MEASUREMENT
/begin MEASUREMENT InpPTisL2_nErrCyclCnt "F2431: Counter of cycles during sensor supply not ok" UBYTE X1_S1 1 100 0 255 FORMAT "%5.1" ECU_ADDRESS 0xFFF9562C /end MEASUREMENT
/begin MEASUREMENT InpPTisL2_stTis "F2431: Status error bits: 15-11:-/-; 10: protection active; 9:SGOP fault; 8:SB fault; 7:over speed; 6:timeout; 5:second fault cycle; 4:ECE init; 3:-/-; 2:sply off; 1:sply low; 0:init passed;" UWORD X1_S1 1 100 0 65535 FORMAT "%8.2" ECU_ADDRESS 0xFFF95068 /end MEASUREMENT
/begin MEASUREMENT InpPTisL2_stTisHwDia "F2431: HW diagnosis info bits: 7:ok, 2:not available, 1:SG/OP, 0:SB" UBYTE X1_S1 1 100 0 255 FORMAT "%5.1" ECU_ADDRESS 0xFFF9562D /end MEASUREMENT
/begin MEASUREMENT InpPTisL2_stTisOld "F2431: Value of stTis from last cycle" UWORD X1_S1 1 100 0 65535 FORMAT "%8.2" ECU_ADDRESS 0xFFF9506A /end MEASUREMENT
/begin MEASUREMENT InpPTisL2_tiFault "F2431: TIS signal timeout timer" UWORD TI1_M_CYCLE_S1 1 100 0 327675 FORMAT "%8.1" ECU_ADDRESS 0xFFF95CA2 /end MEASUREMENT
/begin MEASUREMENT InpPTisL3_stTisFault "F2431: Bit field with active fault conditions of Tis monitoring" UWORD X1_S1 1 100 0 65535 FORMAT "%8.2" ECU_ADDRESS 0xFFF9508E /end MEASUREMENT
/begin MEASUREMENT InpPTisL3_stTisTstCon "F2431: Bit word with active test conditions of Tis monitoring" UWORD X1_S1 1 100 0 65535 FORMAT "%8.2" ECU_ADDRESS 0xFFF95090 /end MEASUREMENT
/begin MEASUREMENT InpPTisL3_tiSSplyDel "F2431: Delay timer of HW diagnosis prevention after sensor supply was switched off or insufficient" UBYTE TI1_M_CYCLE_S1 1 100 0 1275 FORMAT "%5.0" ECU_ADDRESS 0xFFF95D61 /end MEASUREMENT
/begin MEASUREMENT InpPTosL2_fEce "F2430: Signal frequency received from ECE layer." UWORD F1_S1 1 100 0 15000 FORMAT "%8.2" ECU_ADDRESS 0xFFF9506C /end MEASUREMENT
/begin MEASUREMENT InpPTosL2_nErrCyclCnt "F2430: Counter of cycles during sensor supply not ok" UBYTE X1_S1 1 100 0 255 FORMAT "%5.1" ECU_ADDRESS 0xFFF9562E /end MEASUREMENT
/begin MEASUREMENT InpPTosL2_stTos "F2430: Status error bits: 15-11:-/-; 10: protection active; 9:SGOP fault; 8:SB fault; 7:over speed; 6:timeout; 5:second fault cycle; 4:ECE init; 3:-/-; 2:sply off; 1:sply low; 0:init passed;" UWORD X1_S1 1 100 0 65535 FORMAT "%8.2" ECU_ADDRESS 0xFFF9506E /end MEASUREMENT
/begin MEASUREMENT InpPTosL2_stTosHwDia "F2430: HW diagnosis info from TOS sensor" UBYTE X1_S1 1 100 0 255 FORMAT "%5.1" ECU_ADDRESS 0xFFF9562F /end MEASUREMENT
/begin MEASUREMENT InpPTosL2_stTosOld "F2430: Value of stTos from last cycle" UWORD X1_S1 1 100 0 65535 FORMAT "%8.2" ECU_ADDRESS 0xFFF95070 /end MEASUREMENT
/begin MEASUREMENT InpPTosL2_tiFault "F2430: TOS signal timeout timer" UWORD TI1_M_CYCLE_S1 1 100 0 327675 FORMAT "%8.1" ECU_ADDRESS 0xFFF95CA4 /end MEASUREMENT
/begin MEASUREMENT InpPTosL3_stTosFault "F2430: Bit field with active fault conditions of Tos monitoring" UWORD X1_S1 1 100 0 65535 FORMAT "%8.2" ECU_ADDRESS 0xFFF95092 /end MEASUREMENT
/begin MEASUREMENT InpPTosL3_stTosTstCon "F2430: Bit word with active test conditions of Tos monitoring" UWORD X1_S1 1 100 0 65535 FORMAT "%8.2" ECU_ADDRESS 0xFFF95094 /end MEASUREMENT
/begin MEASUREMENT InpPTosL3_tiSSplyDel "F2430: Delay timer of HW diagnosis prevention after sensor supply was switched off or insufficient" UBYTE TI1_M_CYCLE_S1 1 100 0 1275 FORMAT "%5.0" ECU_ADDRESS 0xFFF95D62 /end MEASUREMENT
/begin MEASUREMENT MmmCycl_numRamEccEE "F1211: number of RAM-ECC events registered and stored in EE" ULONG X1_S1 1 100 0 4294967295 FORMAT "%13.2" ECU_ADDRESS 0xFFF95E58 /end MEASUREMENT
/begin MEASUREMENT MmmCycl_numRomEccEE "F1211: number of ROM-ECC events registered and stored in EE" ULONG X1_S1 1 100 0 4294967295 FORMAT "%13.2" ECU_ADDRESS 0xFFF95E5C /end MEASUREMENT
/begin MEASUREMENT OmmBc_sPrep "F1750: ECU-status for jump to BC [IDLE WAIT OK PREP]" UBYTE X1_S1 1 100 0 255 FORMAT "%5.1" ECU_ADDRESS 0xFFF954AE /end MEASUREMENT
/begin MEASUREMENT OmmInCfg_stIni "F1800: main initialization switch" UBYTE X1_S1 1 100 0 255 FORMAT "%5.1" ECU_ADDRESS 0xFFF95150 /end MEASUREMENT
/begin MEASUREMENT OmmInCfg_stIniDSM "F1800: DSM init state" UBYTE X1_S1 1 100 0 255 FORMAT "%5.1" ECU_ADDRESS 0xFFF95151 /end MEASUREMENT
/begin MEASUREMENT OmmInCfg_stIniEE "F1800: state of EE initialization" UBYTE X1_S1 1 100 0 255 FORMAT "%5.1" ECU_ADDRESS 0xFFF95152 /end MEASUREMENT
/begin MEASUREMENT OmmInCfg_stIniFin "F1800: state of final init task" UBYTE X1_S1 1 100 0 255 FORMAT "%5.1" ECU_ADDRESS 0xFFF95153 /end MEASUREMENT
/begin MEASUREMENT OmmInCfg_stIniHot "F1800: Init status of hot detection" UBYTE X1_S1 1 100 0 255 FORMAT "%5.1" ECU_ADDRESS 0xFFF95154 /end MEASUREMENT
/begin MEASUREMENT OmmInCfg_stIniInp "F1800: Init state of input" UBYTE X1_S1 1 100 0 255 FORMAT "%5.1" ECU_ADDRESS 0xFFF95155 /end MEASUREMENT
/begin MEASUREMENT OmmInCfg_stIniMain "F1800: state of main task in init" UBYTE X1_S1 1 100 0 255 FORMAT "%5.1" ECU_ADDRESS 0xFFF95156 /end MEASUREMENT
/begin MEASUREMENT OmmInCfg_stIniOps "F1800: Init status of Ops Test" UBYTE X1_S1 1 100 0 255 FORMAT "%5.1" ECU_ADDRESS 0xFFF95157 /end MEASUREMENT
/begin MEASUREMENT OmmInCfg_stIniOutp "F1800: Init state of output" UBYTE X1_S1 1 100 0 255 FORMAT "%5.1" ECU_ADDRESS 0xFFF95158 /end MEASUREMENT
/begin MEASUREMENT OmmInCfg_stIniPer "F1800: state of periodic tasks in init" UBYTE X1_S1 1 100 0 255 FORMAT "%5.1" ECU_ADDRESS 0xFFF95159 /end MEASUREMENT
/begin MEASUREMENT OmmInCfg_stIniRAM "F1800: Init state of NVRAM" UBYTE X1_S1 1 100 0 255 FORMAT "%5.1" ECU_ADDRESS 0xFFF9515A /end MEASUREMENT
/begin MEASUREMENT OmmInCfg_stIniSAF "F1800: Init status of SAF (=safety) system" UBYTE X1_S1 1 100 0 255 FORMAT "%5.1" ECU_ADDRESS 0xFFF9515B /end MEASUREMENT
/begin MEASUREMENT OmmInCfg_stIniSC "F1800: Sec Cpu init state" UBYTE X1_S1 1 100 0 255 FORMAT "%5.1" ECU_ADDRESS 0xFFF9515C /end MEASUREMENT
/begin MEASUREMENT OmmInCfg_stIniWuv "F1800: Wuv (Wake-Up-Validation) init state" UBYTE X1_S1 1 100 0 255 FORMAT "%5.1" ECU_ADDRESS 0xFFF9515D /end MEASUREMENT
/begin MEASUREMENT OmmInMgr_bIniOk "F1800: are all init switches processed" UBYTE B_TRUE_S1 1 100 0 1 FORMAT "%13.11" ECU_ADDRESS 0xFFF9515E /end MEASUREMENT
/begin MEASUREMENT OmmInMgr_bStrtTskFin "F1800: Flag: start Final Init Task" UBYTE B_TRUE_S1 1 100 0 1 FORMAT "%13.11" ECU_ADDRESS 0xFFF9515F /end MEASUREMENT
/begin MEASUREMENT OmmInMgr_bStrtTskPer "F1800: Flag: start periodic tasks in init" UBYTE B_TRUE_S1 1 100 0 1 FORMAT "%13.11" ECU_ADDRESS 0xFFF95160 /end MEASUREMENT
/begin MEASUREMENT OmmRst_idxOpMode "F1740: actual mode index for reset detection" UBYTE X1_S1 1 100 0 255 FORMAT "%5.1" ECU_ADDRESS 0xFFF80D28 /end MEASUREMENT
/begin MEASUREMENT OmmRst_idxOpModeLast "F1740: Last operating mode" UBYTE X1_S1 1 100 0 255 FORMAT "%5.1" ECU_ADDRESS 0xFFF955F8 /end MEASUREMENT
/begin MEASUREMENT OmmRst_sRst "F1740: Status of running Reset Check" UBYTE X1_S1 1 100 0 255 FORMAT "%5.1" ECU_ADDRESS 0xFFF955F9 /end MEASUREMENT
/begin MEASUREMENT OmmRst_sRstID "F1740: Omme reset marker" ULONG X1_S1 1 100 0 4294967295 FORMAT "%13.2" ECU_ADDRESS 0xFFF80CFC /end MEASUREMENT
/begin MEASUREMENT OmmSdMgr_bReqCal "F1740: Request calibration hold" UBYTE B_TRUE_S1 1 100 0 1 FORMAT "%13.11" ECU_ADDRESS 0xFFF95161 /end MEASUREMENT
/begin MEASUREMENT OmmSdMgr_bReqHot "F1740: Request for hot shutdown" UBYTE B_TRUE_S1 1 100 0 1 FORMAT "%13.11" ECU_ADDRESS 0xFFF95162 /end MEASUREMENT
/begin MEASUREMENT OmmSdMgr_bSdnAllow "F1740: status: is switching to SDN allowed" UBYTE B_TRUE_S1 1 100 0 1 FORMAT "%13.11" ECU_ADDRESS 0xFFF95163 /end MEASUREMENT
/begin MEASUREMENT OmmSdMgr_eReqStd "F1740: Shutdown request (0=no request; 1=standard shutdown request; 2=fast shutdown request;)" UBYTE X1_S1 1 100 0 255 FORMAT "%5.1" ECU_ADDRESS 0xFFF95164 /end MEASUREMENT
/begin MEASUREMENT OmmSdMgr_eSdnTgt "F1740: Shutdown Target selection (off=0, reset=1; default=off; optional feature by cfg switch OMM_USE_SDNTGTSEL)" UBYTE X1_S1 1 100 0 255 FORMAT "%5.1" ECU_ADDRESS 0xFFF95165 /end MEASUREMENT
/begin MEASUREMENT OmmSdMgr_stSdn "F1740: state variable of shutdown preparation process" UBYTE X1_S1 1 100 0 255 FORMAT "%5.1" ECU_ADDRESS 0xFFF95166 /end MEASUREMENT
/begin MEASUREMENT OmmSdMgr_tiExtDly "F1740: Timer for external shutdown delay request" UWORD TI1_M_CYCLE_S1 1 100 0 327675 FORMAT "%8.1" ECU_ADDRESS 0xFFF95C84 /end MEASUREMENT
/begin MEASUREMENT OmmSdMgr_tiExtPstDly "F1740: Timer for external shutdown post delay request" UWORD TI1_M_CYCLE_S1 1 100 0 327675 FORMAT "%8.1" ECU_ADDRESS 0xFFF95C86 /end MEASUREMENT
/begin MEASUREMENT OutPRstL3_bRst "F2510: Sensor voltage will be switched off (10-20ms) (1--> in reset mode 0--> not in reset mode)" UBYTE B_TRUE_S1 1 100 0 1 FORMAT "%13.11" ECU_ADDRESS 0xFFF95133 /end MEASUREMENT
/begin MEASUREMENT OutPRstL3_sRst "F2510: Contains the current state of the sensor supply voltage" UBYTE X1_S1 1 100 0 5 FORMAT "%5.3" ECU_ADDRESS 0xFFF95134 /end MEASUREMENT
/begin MEASUREMENT OutPRstL3_tiHwDly "F2510: After that time the application will be informed that the sensor supply is on" UBYTE TI1_M_CYCLE_S1 1 100 0 1275 FORMAT "%5.0" ECU_ADDRESS 0xFFF95D2C /end MEASUREMENT
/begin MEASUREMENT OutPRstL3_tiSSplyMinOn "F2510: Min time that the sensor voltage will be on before the next reset request is possible" UBYTE TI1_M_CYCLE_S1 1 100 0 255 FORMAT "%5.1" ECU_ADDRESS 0xFFF95D2D /end MEASUREMENT
/begin MEASUREMENT OutPRstL3_tiSSplyOff "F2510: Min time that the sensor voltage will be off" UBYTE TI1_M_CYCLE_S1 1 100 0 255 FORMAT "%5.1" ECU_ADDRESS 0xFFF95D2E /end MEASUREMENT
/begin MEASUREMENT RamBuf_numClearReq "F1220: Currently registered value of RamBuf_numClearReq_C" UBYTE X1_S1 1 100 0 255 FORMAT "%5.1" ECU_ADDRESS 0xFFF80C54 /end MEASUREMENT
/begin MEASUREMENT RamBuf_st "F1220: buffered RAM status for fault memory: 0xB5=RAM-valid, others=data loss (RAM cell is cleared when data is stored to permanent memory)" UBYTE X1_S1 1 100 0 255 FORMAT "%5.1" ECU_ADDRESS 0xFFF80D0B /end MEASUREMENT
/begin MEASUREMENT RamBuf_stClear "F1220: Indication that buffered RAM should be cleared after a system start (0xB5)" UBYTE X1_S1 1 100 0 255 FORMAT "%5.1" ECU_ADDRESS 0xFFF80C55 /end MEASUREMENT
/begin MEASUREMENT RamBuf_stStart "F1220: buffered RAM status init after last system start: 0x1D=no, others=yes-data loss" UBYTE X1_S1 1 100 0 255 FORMAT "%5.1" ECU_ADDRESS 0xFFF80D0C /end MEASUREMENT
/begin MEASUREMENT RamCycl_adBegTstNext "F1211: Next address for RAM testing" ULONG X1_S1 1 100 0 4294967295 FORMAT "%13.2" ECU_ADDRESS 0xFFF94644 /end MEASUREMENT
/begin MEASUREMENT RamCycl_adTstFail "F1211: Last found fault address of RAM testing." ULONG X1_S1 1 100 0 4294967295 FORMAT "%13.2" ECU_ADDRESS 0xFFF94648 /end MEASUREMENT
/begin MEASUREMENT RamCycl_ctTstCompl "F1211: Counter incremented each time the complete RAM was tested. Counter overflows." UWORD X1_S1 1 100 0 65535 FORMAT "%8.2" ECU_ADDRESS 0xFFF94E68 /end MEASUREMENT
/begin MEASUREMENT RamCycl_stEccForMcor "F1211: ECC Test status for MCor: BIT1=RAM-ECC-Test failed, BIT2=RAM-ECC-ISR-Test failed,  BIT4=ECC-ROM-Test failed" UBYTE X1_S1 1 100 0 255 FORMAT "%5.1" ECU_ADDRESS 0xFFF954AD /end MEASUREMENT
/begin MEASUREMENT RamCycl_stEccTestFailed "F1211: Bit array with bits set each time an EccRamTest-Failure occured (1 Bit for each 16kB segment) (special combination 0x8001=ISR test failed)" UWORD X1_S1 1 100 0 65535 FORMAT "%8.2" ECU_ADDRESS 0xFFF94E66 /end MEASUREMENT
/begin MEASUREMENT RamStckMon_numMaxUsd "F1270: Maximum used stack in bytes" UWORD X1_S1 1 100 0 10240 FORMAT "%8.2" ECU_ADDRESS 0xFFF95004 /end MEASUREMENT
/begin MEASUREMENT RamStckMon_numMaxUsdStrd "F1270: Maximum used stack in bytes, stored in EEPROM" UWORD X1_S1 1 100 0 10240 FORMAT "%8.2" ECU_ADDRESS 0xFFF95EBE /end MEASUREMENT
/begin MEASUREMENT RamStckMon_numMinFreeStrd "F1270: Minimum free stack in bytes, stored in EEPROM" UWORD X1_S1 1 100 0 10240 FORMAT "%8.2" ECU_ADDRESS 0xFFF95EC0 /end MEASUREMENT
/begin MEASUREMENT RamStckMon_rMaxUsd "F1270: Maximum used stack in percent" UWORD R0_1_P_S1 1 100 0 100 FORMAT "%8.4" ECU_ADDRESS 0xFFF95006 /end MEASUREMENT
/begin MEASUREMENT RamStckMon_stFault "F1270: Bit map for detected faults, will only be written if no reset is configured (B0:underflow, B1:overflow)" UBYTE X1_S1 1 100 0 3 FORMAT "%5.3" ECU_ADDRESS 0xFFF955F7 /end MEASUREMENT
/begin MEASUREMENT Rom_RomChsCycTst_adCurrEnd "F1350: store the current stop adr of the current area" ULONG X1_S1 1 100 0 4294967295 FORMAT "%13.2" ARRAY_SIZE 5 ECU_ADDRESS 0xFFF962B0 /end MEASUREMENT
/begin MEASUREMENT Rom_RomChsCycTst_adCurrStrt "F1350: store the current start adr of the current area, to calc next start adr" ULONG X1_S1 1 100 0 4294967295 FORMAT "%13.2" ARRAY_SIZE 5 ECU_ADDRESS 0xFFF962C4 /end MEASUREMENT
/begin MEASUREMENT Rom_RomChsCycTst_adTmpCurrStrt "F1350: temp end adr for the current area. To compare with the given end adr" ULONG X1_S1 1 100 0 4294967295 FORMAT "%13.2" ECU_ADDRESS 0xFFF962D8 /end MEASUREMENT
/begin MEASUREMENT Rom_RomChsCycTst_ctChsAllTst "F1350: Counter, how often a complete analysis off all checksum areas was done." UWORD X1_S1 1 100 0 65535 FORMAT "%8.2" ECU_ADDRESS 0xFFF94D9E /end MEASUREMENT
/begin MEASUREMENT Rom_RomChsCycTst_ctCurrDneAr "F1350: Running index of the checksum area which is currently in evaluation" UBYTE X1_S1 1 100 0 255 FORMAT "%5.1" ECU_ADDRESS 0xFFF9514E /end MEASUREMENT
/begin MEASUREMENT Rom_RomChsCycTst_stChsInfo "F1350: Calculation status of the current checksum area (TRUE:Chs calc is not ready, FALSE:Chs calc is ready/done)" UBYTE X1_S1 1 100 0 255 FORMAT "%5.1" ECU_ADDRESS 0xFFF9514F /end MEASUREMENT
/begin MEASUREMENT Rom_RomChsCycTst_stChsMonDisbl "F1350: Monitoring to DSM for the checksum area which is currently in evaluation (0: monitoring enabled, 1: monitoring disabled)" UBYTE X1_S1 1 100 0 255 FORMAT "%5.1" ECU_ADDRESS 0xFFF9640B /end MEASUREMENT
/begin MEASUREMENT Rom_RomChsCycTst_stFault "F1350: Variable to measure the faults of the Checksum monitoring system (bit coded for further information take a look in the documentation)" UWORD X1_S1 1 100 0 65535 FORMAT "%8.2" ECU_ADDRESS 0xFFF94DA0 /end MEASUREMENT
/begin MEASUREMENT Rom_RomChsCycTst_stTest "F1350: Variable to measure the test conditions of the Checksum monitoring system (bit coded for further information take a look in the documentation)" UWORD X1_S1 1 100 0 65535 FORMAT "%8.2" ECU_ADDRESS 0xFFF94DA2 /end MEASUREMENT
/begin MEASUREMENT Rom_RomChsCycTst_tiStamp1ms "F1350: Timestamp in 1ms, after the first complete analysis off all checksum areas was done." ULONG X1_S1 1 100 0 4294967295 FORMAT "%13.2" ECU_ADDRESS 0xFFF93A30 /end MEASUREMENT
/begin MEASUREMENT Rom_RomChsCycTst_xCfgInfo "F1350: configuration information of the checksum areas" UWORD X1_S1 1 100 0 65534 FORMAT "%8.2" ARRAY_SIZE 5 ECU_ADDRESS 0xFFF9639A /end MEASUREMENT
/begin MEASUREMENT Rom_RomChsCycTst_xCurrChs "F1350: store the chs of the current chs area, needed to compare the calc chs" ULONG X1_S1 1 100 0 4294967295 FORMAT "%13.2" ARRAY_SIZE 5 ECU_ADDRESS 0xFFF962DC /end MEASUREMENT
/begin MEASUREMENT Rom_RomChsCycTst_xTmpCurrChs "F1350: store the current checksum of the current area" ULONG X1_S1 1 100 0 4294967295 FORMAT "%13.2" ECU_ADDRESS 0xFFF93A34 /end MEASUREMENT
/begin MEASUREMENT Rom_RomChsTstRef "F1350: Reference checksums" ULONG X1_S1 1 100 0 4294967295 FORMAT "%13.2" ARRAY_SIZE 5 ECU_ADDRESS 0xFFF93A38 /end MEASUREMENT
/begin MEASUREMENT Rom_RomChsTstRslt "F1350: Calculated checksums" ULONG X1_S1 1 100 0 4294967295 FORMAT "%13.2" ARRAY_SIZE 5 ECU_ADDRESS 0xFFF93A4C /end MEASUREMENT
/begin MEASUREMENT Rom_RomChsTstRsltStrd "F1350: Calculated checksums (stored in EEPROM)" ULONG X1_S1 1 100 0 4294967295 FORMAT "%13.2" ARRAY_SIZE 5 ECU_ADDRESS 0xFFF95DA4 /end MEASUREMENT
/begin MEASUREMENT Serap_adOfsWrk "F1520: Address offset from pointers reference page to pointers working page" ULONG X1_S1 1 100 0 4294967295 FORMAT "%13.2" ECU_ADDRESS 0xFFF9220C /end MEASUREMENT
/begin MEASUREMENT Serap_swtPg "F1520: Switch for page selection" UBYTE X1_S1 1 100 0 1 FORMAT "%5.3" ECU_ADDRESS 0xFFF950D0 /end MEASUREMENT
/begin MEASUREMENT SpiCc08_DIA_regRx "F2386: CG208 DIA sequence (RX)" UWORD X1_S1 1 100 0 65535 FORMAT "%8.2" ARRAY_SIZE 15 ECU_ADDRESS 0xFFF88A7A /end MEASUREMENT
/begin MEASUREMENT SpiCc08_DIA_regTx "F2386: CG208 DIA sequence (TX)" UWORD X1_S1 1 100 0 65535 FORMAT "%8.2" ARRAY_SIZE 15 ECU_ADDRESS 0xFFF88A5C /end MEASUREMENT
/begin MEASUREMENT SpiCc08_ID_regRx "F2386: CG208 ID sequence (RX)" UWORD X1_S1 1 100 0 65535 FORMAT "%8.2" ARRAY_SIZE 10 ECU_ADDRESS 0xFFF88180 /end MEASUREMENT
/begin MEASUREMENT SpiCc08_ID_regTx "F2386: CG208 ID sequence (TX)" UWORD X1_S1 1 100 0 65535 FORMAT "%8.2" ARRAY_SIZE 10 ECU_ADDRESS 0xFFF8816C /end MEASUREMENT
/begin MEASUREMENT SpiCc08_OUTFX_regRx "F2386: CG208 OUTF sequence (RX)" UWORD X1_S1 1 100 0 65535 FORMAT "%8.2" ARRAY_SIZE 40 ECU_ADDRESS 0xFFF88324 /end MEASUREMENT
/begin MEASUREMENT SpiCc08_OUTFX_regTx "F2386: CG208 OUTF sequence (TX)" UWORD X1_S1 1 100 0 65535 FORMAT "%8.2" ARRAY_SIZE 40 ECU_ADDRESS 0xFFF88234 /end MEASUREMENT
/begin MEASUREMENT SpiCc08_OUTI_regRx "F2386: CG208 OUTI sequence (RX)" UWORD X1_S1 1 100 0 65535 FORMAT "%8.2" ARRAY_SIZE 45 ECU_ADDRESS 0xFFF88AF2 /end MEASUREMENT
/begin MEASUREMENT SpiCc08_OUTI_regTx "F2386: CG208 OUTI sequence (TX)" UWORD X1_S1 1 100 0 65535 FORMAT "%8.2" ARRAY_SIZE 45 ECU_ADDRESS 0xFFF88A98 /end MEASUREMENT
/begin MEASUREMENT SpiCc08_OUTP_regRx "F2386: CG208 OUTP sequence (RX)" UWORD X1_S1 1 100 0 65535 FORMAT "%8.2" ARRAY_SIZE 40 ECU_ADDRESS 0xFFF881E4 /end MEASUREMENT
/begin MEASUREMENT SpiCc08_OUTP_regTx "F2386: CG208 OUTP sequence (TX)" UWORD X1_S1 1 100 0 65535 FORMAT "%8.2" ARRAY_SIZE 40 ECU_ADDRESS 0xFFF88194 /end MEASUREMENT
/begin MEASUREMENT SpiCc08_st "F2386: CG208 condensed SPI Status Information (B0:Ok, B1:Err, B2:ErrDat, B7:Ident)" UBYTE X1_S1 1 100 0 255 FORMAT "%5.1" ARRAY_SIZE 5 ECU_ADDRESS 0xFFF92174 /end MEASUREMENT
/begin MEASUREMENT SpiCore_DIA_regRx "F2386: CG124/CG130 DIA sequence (RX)" UWORD X1_S1 1 100 0 65535 FORMAT "%8.2" ARRAY_SIZE 5 ECU_ADDRESS 0xFFF88B56 /end MEASUREMENT
/begin MEASUREMENT SpiCore_DIA_regTx "F2386: CG124/CG130 DIA sequence (TX)" UWORD X1_S1 1 100 0 65535 FORMAT "%8.2" ARRAY_SIZE 5 ECU_ADDRESS 0xFFF88B4C /end MEASUREMENT
/begin MEASUREMENT SpiCore_ID_regRx "F2386: CG124/CG130 ID sequence (RX)" UWORD X1_S1 1 100 0 65535 FORMAT "%8.2" ARRAY_SIZE 4 ECU_ADDRESS 0xFFF8841C /end MEASUREMENT
/begin MEASUREMENT SpiCore_ID_regTx "F2386: CG124/CG130 ID sequence (TX)" UWORD X1_S1 1 100 0 65535 FORMAT "%8.2" ARRAY_SIZE 4 ECU_ADDRESS 0xFFF88414 /end MEASUREMENT
/begin MEASUREMENT SpiCore_OUT_regRx "F2386: CG124/CG130 OUT sequence (RX)" UWORD X1_S1 1 100 0 65535 FORMAT "%8.2" ARRAY_SIZE 7 ECU_ADDRESS 0xFFF8842C /end MEASUREMENT
/begin MEASUREMENT SpiCore_OUT_regTx "F2386: CG124/CG130 OUT sequence (TX)" UWORD X1_S1 1 100 0 65535 FORMAT "%8.2" ARRAY_SIZE 7 ECU_ADDRESS 0xFFF88424 /end MEASUREMENT
/begin MEASUREMENT SpiCore_stCg124 "F2386: CG124 condensed SPI Status Information (B0:Ok, B1:Err, B2:ErrDat, B7:Ident)" UBYTE X1_S1 1 100 0 255 FORMAT "%5.1" ECU_ADDRESS 0xFFF92179 /end MEASUREMENT
/begin MEASUREMENT SpiCore_stCg130 "F2386: CG130 condensed SPI Status Information (B0:Ok, B1:Err, B2:ErrDat, B7:Ident)" UBYTE X1_S1 1 100 0 255 FORMAT "%5.1" ECU_ADDRESS 0xFFF9217A /end MEASUREMENT
/begin MEASUREMENT SpiCore_TEMP_regRx "F2386: CG130-TEMP sequence (RX)" UWORD X1_S1 1 100 0 65535 FORMAT "%8.2" ARRAY_SIZE 2 ECU_ADDRESS 0xFFF88448 /end MEASUREMENT
/begin MEASUREMENT SpiCore_TEMP_regTx "F2386: CG130-TEMP sequence (TX)" UWORD X1_S1 1 100 0 65535 FORMAT "%8.2" ARRAY_SIZE 2 ECU_ADDRESS 0xFFF88444 /end MEASUREMENT
/begin MEASUREMENT Spi_Cg124.stOkMsk "F2386: Cg124 register structure / " UBYTE X1_S1 1 100 0 255 FORMAT "%5.1" ECU_ADDRESS 0xFFF9217B /end MEASUREMENT
/begin MEASUREMENT Spi_Cg124.stErrMsk "F2386: Cg124 register structure / " UBYTE X1_S1 1 100 0 255 FORMAT "%5.1" ECU_ADDRESS 0xFFF9217C /end MEASUREMENT
/begin MEASUREMENT Spi_Cg124.stErrDatMsk "F2386: Cg124 register structure / " UBYTE X1_S1 1 100 0 255 FORMAT "%5.1" ECU_ADDRESS 0xFFF9217D /end MEASUREMENT
/begin MEASUREMENT Spi_Cg124.stEmpty "F2386: Cg124 register structure / " UBYTE X1_S1 1 100 0 255 FORMAT "%5.1" ECU_ADDRESS 0xFFF9217E /end MEASUREMENT
/begin MEASUREMENT Spi_Cg124.regIdent "F2386: Cg124 register structure / " UBYTE X1_S1 1 100 0 255 FORMAT "%5.1" ECU_ADDRESS 0xFFF9217F /end MEASUREMENT
/begin MEASUREMENT Spi_Cg124.regRev "F2386: Cg124 register structure / " UBYTE X1_S1 1 100 0 255 FORMAT "%5.1" ECU_ADDRESS 0xFFF92180 /end MEASUREMENT
/begin MEASUREMENT Spi_Cg124.regStat "F2386: Cg124 register structure / " UBYTE X1_S1 1 100 0 255 FORMAT "%5.1" ECU_ADDRESS 0xFFF92181 /end MEASUREMENT
/begin MEASUREMENT Spi_Cg124.regDia "F2386: Cg124 register structure / " UBYTE X1_S1 1 100 0 255 FORMAT "%5.1" ECU_ADDRESS 0xFFF92182 /end MEASUREMENT
/begin MEASUREMENT Spi_Cg124.regDInit "F2386: Cg124 register structure / " UBYTE X1_S1 1 100 0 255 FORMAT "%5.1" ECU_ADDRESS 0xFFF92183 /end MEASUREMENT
/begin MEASUREMENT Spi_Cg124_regDiaFirst "F2385: first Cg124 Dia-reg reading after system startup (B7:not RST_U3, B6:not RST_U5)" UBYTE X1_S1 1 100 0 255 FORMAT "%5.1" ECU_ADDRESS 0xFFF92167 /end MEASUREMENT
/begin MEASUREMENT Spi_Cg130.stOkMsk "F2386: Cg130 register structure / " UBYTE X1_S1 1 100 0 255 FORMAT "%5.1" ECU_ADDRESS 0xFFF91FD0 /end MEASUREMENT
/begin MEASUREMENT Spi_Cg130.stErrMsk "F2386: Cg130 register structure / " UBYTE X1_S1 1 100 0 255 FORMAT "%5.1" ECU_ADDRESS 0xFFF91FD1 /end MEASUREMENT
/begin MEASUREMENT Spi_Cg130.stErrDatMsk "F2386: Cg130 register structure / " UBYTE X1_S1 1 100 0 255 FORMAT "%5.1" ECU_ADDRESS 0xFFF91FD2 /end MEASUREMENT
/begin MEASUREMENT Spi_Cg130.stEmpty "F2386: Cg130 register structure / " UBYTE X1_S1 1 100 0 255 FORMAT "%5.1" ECU_ADDRESS 0xFFF91FD3 /end MEASUREMENT
/begin MEASUREMENT Spi_Cg130.regTemp "F2386: Cg130 register structure / " UWORD X1_S1 1 100 0 65535 FORMAT "%8.2" ECU_ADDRESS 0xFFF91FD4 /end MEASUREMENT
/begin MEASUREMENT Spi_Cg130.stTemp "F2386: Cg130 register structure / " UBYTE X1_S1 1 100 0 255 FORMAT "%5.1" ECU_ADDRESS 0xFFF91FD6 /end MEASUREMENT
/begin MEASUREMENT Spi_Cg130.regIdent "F2386: Cg130 register structure / " UBYTE X1_S1 1 100 0 255 FORMAT "%5.1" ECU_ADDRESS 0xFFF91FD7 /end MEASUREMENT
/begin MEASUREMENT Spi_Cg130.regRev "F2386: Cg130 register structure / " UBYTE X1_S1 1 100 0 255 FORMAT "%5.1" ECU_ADDRESS 0xFFF91FD8 /end MEASUREMENT
/begin MEASUREMENT Spi_Cg130.regDia1 "F2386: Cg130 register structure / " UBYTE X1_S1 1 100 0 255 FORMAT "%5.1" ECU_ADDRESS 0xFFF91FD9 /end MEASUREMENT
/begin MEASUREMENT Spi_Cg130.regDia2 "F2386: Cg130 register structure / " UBYTE X1_S1 1 100 0 255 FORMAT "%5.1" ECU_ADDRESS 0xFFF91FDA /end MEASUREMENT
/begin MEASUREMENT Spi_Cg130.regDia3 "F2386: Cg130 register structure / " UBYTE X1_S1 1 100 0 255 FORMAT "%5.1" ECU_ADDRESS 0xFFF91FDB /end MEASUREMENT
/begin MEASUREMENT Spi_Cg130.regInit1 "F2386: Cg130 register structure / " UBYTE X1_S1 1 100 0 255 FORMAT "%5.1" ECU_ADDRESS 0xFFF91FDC /end MEASUREMENT
/begin MEASUREMENT Spi_Cg130.regInit1r "F2386: Cg130 register structure / " UBYTE X1_S1 1 100 0 255 FORMAT "%5.1" ECU_ADDRESS 0xFFF91FDD /end MEASUREMENT
/begin MEASUREMENT Spi_Cg130.regInit2 "F2386: Cg130 register structure / " UBYTE X1_S1 1 100 0 255 FORMAT "%5.1" ECU_ADDRESS 0xFFF91FDE /end MEASUREMENT
/begin MEASUREMENT Spi_Cg130.regInit2r "F2386: Cg130 register structure / " UBYTE X1_S1 1 100 0 255 FORMAT "%5.1" ECU_ADDRESS 0xFFF91FDF /end MEASUREMENT
/begin MEASUREMENT Spi_Cg130_regDia1First "F2385: first Cg130 Dia-reg reading after system startup (B4:PCLKHIGH, B3:PCLKLOW, B1:not DN)" UBYTE X1_S1 1 100 0 255 FORMAT "%5.1" ECU_ADDRESS 0xFFF92168 /end MEASUREMENT
/begin MEASUREMENT Spi_Cg130_regDia2First "F2385: first Cg130 Dia-reg reading after system startup (B7:RST_WD, B6:OT_ON)" UBYTE X1_S1 1 100 0 255 FORMAT "%5.1" ECU_ADDRESS 0xFFF800ED /end MEASUREMENT
/begin MEASUREMENT Spi_Cg130_regDia3First "F2385: first Cg130 Dia-reg reading after system startup (B1,0:VEN)" UBYTE X1_S1 1 100 0 255 FORMAT "%5.1" ECU_ADDRESS 0xFFF92169 /end MEASUREMENT
/begin MEASUREMENT Spi_Cg208a.C0_stOkMsk "F2386: Cg208 register structure / " UBYTE X1_S1 1 100 0 255 FORMAT "%5.1" ECU_ADDRESS 0xFFF92488 /end MEASUREMENT
/begin MEASUREMENT Spi_Cg208a.C0_stErrMsk "F2386: Cg208 register structure / " UBYTE X1_S1 1 100 0 255 FORMAT "%5.1" ECU_ADDRESS 0xFFF92489 /end MEASUREMENT
/begin MEASUREMENT Spi_Cg208a.C0_stErrDatMsk "F2386: Cg208 register structure / " UBYTE X1_S1 1 100 0 255 FORMAT "%5.1" ECU_ADDRESS 0xFFF9248A /end MEASUREMENT
/begin MEASUREMENT Spi_Cg208a.C0_stEmpty "F2386: Cg208 register structure / " UBYTE X1_S1 1 100 0 255 FORMAT "%5.1" ECU_ADDRESS 0xFFF9248B /end MEASUREMENT
/begin MEASUREMENT Spi_Cg208a.C0_regIdent "F2386: Cg208 register structure / " UBYTE X1_S1 1 100 0 255 FORMAT "%5.1" ECU_ADDRESS 0xFFF9248C /end MEASUREMENT
/begin MEASUREMENT Spi_Cg208a.C0_regRev "F2386: Cg208 register structure / " UBYTE X1_S1 1 100 0 255 FORMAT "%5.1" ECU_ADDRESS 0xFFF9248D /end MEASUREMENT
/begin MEASUREMENT Spi_Cg208a.C0_regCurDia "F2386: Cg208 register structure / " UBYTE X1_S1 1 100 0 255 FORMAT "%5.1" ECU_ADDRESS 0xFFF9248E /end MEASUREMENT
/begin MEASUREMENT Spi_Cg208a.C0_regModeOut "F2386: Cg208 register structure / " UBYTE X1_S1 1 100 0 255 FORMAT "%5.1" ECU_ADDRESS 0xFFF9248F /end MEASUREMENT
/begin MEASUREMENT Spi_Cg208a.C0_regModeIn "F2386: Cg208 register structure / " UBYTE X1_S1 1 100 0 255 FORMAT "%5.1" ECU_ADDRESS 0xFFF92490 /end MEASUREMENT
/begin MEASUREMENT Spi_Cg208a.C0_regOsz "F2386: Cg208 register structure / " UBYTE X1_S1 1 100 0 255 FORMAT "%5.1" ECU_ADDRESS 0xFFF92491 /end MEASUREMENT
/begin MEASUREMENT Spi_Cg208a.C0_regSet "F2386: Cg208 register structure / " UBYTE X1_S1 1 100 0 255 FORMAT "%5.1" ECU_ADDRESS 0xFFF92492 /end MEASUREMENT
/begin MEASUREMENT Spi_Cg208a.C0_regInt "F2386: Cg208 register structure / " UBYTE X1_S1 1 100 0 255 FORMAT "%5.1" ECU_ADDRESS 0xFFF92493 /end MEASUREMENT
/begin MEASUREMENT Spi_Cg208a.C00_regCur "F2386: Cg208 register structure / " UWORD X1_S1 1 100 0 65535 FORMAT "%8.2" ECU_ADDRESS 0xFFF92494 /end MEASUREMENT
/begin MEASUREMENT Spi_Cg208a.C00_regCurDelta "F2386: Cg208 register structure / " UWORD X1_S1 1 100 0 65535 FORMAT "%8.2" ECU_ADDRESS 0xFFF92496 /end MEASUREMENT
/begin MEASUREMENT Spi_Cg208a.C00_regDam "F2386: Cg208 register structure / " UBYTE X1_S1 1 100 0 255 FORMAT "%5.1" ECU_ADDRESS 0xFFF92498 /end MEASUREMENT
/begin MEASUREMENT Spi_Cg208a.C00_regDfr "F2386: Cg208 register structure / " UBYTE X1_S1 1 100 0 255 FORMAT "%5.1" ECU_ADDRESS 0xFFF92499 /end MEASUREMENT
/begin MEASUREMENT Spi_Cg208a.C00_regDia "F2386: Cg208 register structure / " UBYTE X1_S1 1 100 0 255 FORMAT "%5.1" ECU_ADDRESS 0xFFF9249A /end MEASUREMENT
/begin MEASUREMENT Spi_Cg208a.C00_empty "F2386: Cg208 register structure / " UBYTE X1_S1 1 100 0 255 FORMAT "%5.1" ECU_ADDRESS 0xFFF9249B /end MEASUREMENT
/begin MEASUREMENT Spi_Cg208a.C01_regCur "F2386: Cg208 register structure / " UWORD X1_S1 1 100 0 65535 FORMAT "%8.2" ECU_ADDRESS 0xFFF9249C /end MEASUREMENT
/begin MEASUREMENT Spi_Cg208a.C01_regCurDelta "F2386: Cg208 register structure / " UWORD X1_S1 1 100 0 65535 FORMAT "%8.2" ECU_ADDRESS 0xFFF9249E /end MEASUREMENT
/begin MEASUREMENT Spi_Cg208a.C01_regDam "F2386: Cg208 register structure / " UBYTE X1_S1 1 100 0 255 FORMAT "%5.1" ECU_ADDRESS 0xFFF924A0 /end MEASUREMENT
/begin MEASUREMENT Spi_Cg208a.C01_regDfr "F2386: Cg208 register structure / " UBYTE X1_S1 1 100 0 255 FORMAT "%5.1" ECU_ADDRESS 0xFFF924A1 /end MEASUREMENT
/begin MEASUREMENT Spi_Cg208a.C01_regDia "F2386: Cg208 register structure / " UBYTE X1_S1 1 100 0 255 FORMAT "%5.1" ECU_ADDRESS 0xFFF924A2 /end MEASUREMENT
/begin MEASUREMENT Spi_Cg208a.C01_empty "F2386: Cg208 register structure / " UBYTE X1_S1 1 100 0 255 FORMAT "%5.1" ECU_ADDRESS 0xFFF924A3 /end MEASUREMENT
/begin MEASUREMENT Spi_Cg208a.C1_stOkMsk "F2386: Cg208 register structure / " UBYTE X1_S1 1 100 0 255 FORMAT "%5.1" ECU_ADDRESS 0xFFF924A4 /end MEASUREMENT
/begin MEASUREMENT Spi_Cg208a.C1_stErrMsk "F2386: Cg208 register structure / " UBYTE X1_S1 1 100 0 255 FORMAT "%5.1" ECU_ADDRESS 0xFFF924A5 /end MEASUREMENT
/begin MEASUREMENT Spi_Cg208a.C1_stErrDatMsk "F2386: Cg208 register structure / " UBYTE X1_S1 1 100 0 255 FORMAT "%5.1" ECU_ADDRESS 0xFFF924A6 /end MEASUREMENT
/begin MEASUREMENT Spi_Cg208a.C1_stEmpty "F2386: Cg208 register structure / " UBYTE X1_S1 1 100 0 255 FORMAT "%5.1" ECU_ADDRESS 0xFFF924A7 /end MEASUREMENT
/begin MEASUREMENT Spi_Cg208a.C1_regIdent "F2386: Cg208 register structure / " UBYTE X1_S1 1 100 0 255 FORMAT "%5.1" ECU_ADDRESS 0xFFF924A8 /end MEASUREMENT
/begin MEASUREMENT Spi_Cg208a.C1_regRev "F2386: Cg208 register structure / " UBYTE X1_S1 1 100 0 255 FORMAT "%5.1" ECU_ADDRESS 0xFFF924A9 /end MEASUREMENT
/begin MEASUREMENT Spi_Cg208a.C1_regCurDia "F2386: Cg208 register structure / " UBYTE X1_S1 1 100 0 255 FORMAT "%5.1" ECU_ADDRESS 0xFFF924AA /end MEASUREMENT
/begin MEASUREMENT Spi_Cg208a.C1_regModeOut "F2386: Cg208 register structure / " UBYTE X1_S1 1 100 0 255 FORMAT "%5.1" ECU_ADDRESS 0xFFF924AB /end MEASUREMENT
/begin MEASUREMENT Spi_Cg208a.C1_regModeIn "F2386: Cg208 register structure / " UBYTE X1_S1 1 100 0 255 FORMAT "%5.1" ECU_ADDRESS 0xFFF924AC /end MEASUREMENT
/begin MEASUREMENT Spi_Cg208a.C1_regOsz "F2386: Cg208 register structure / " UBYTE X1_S1 1 100 0 255 FORMAT "%5.1" ECU_ADDRESS 0xFFF924AD /end MEASUREMENT
/begin MEASUREMENT Spi_Cg208a.C1_regSet "F2386: Cg208 register structure / " UBYTE X1_S1 1 100 0 255 FORMAT "%5.1" ECU_ADDRESS 0xFFF924AE /end MEASUREMENT
/begin MEASUREMENT Spi_Cg208a.C1_regInt "F2386: Cg208 register structure / " UBYTE X1_S1 1 100 0 255 FORMAT "%5.1" ECU_ADDRESS 0xFFF924AF /end MEASUREMENT
/begin MEASUREMENT Spi_Cg208a.C10_regCur "F2386: Cg208 register structure / " UWORD X1_S1 1 100 0 65535 FORMAT "%8.2" ECU_ADDRESS 0xFFF924B0 /end MEASUREMENT
/begin MEASUREMENT Spi_Cg208a.C10_regCurDelta "F2386: Cg208 register structure / " UWORD X1_S1 1 100 0 65535 FORMAT "%8.2" ECU_ADDRESS 0xFFF924B2 /end MEASUREMENT
/begin MEASUREMENT Spi_Cg208a.C10_regDam "F2386: Cg208 register structure / " UBYTE X1_S1 1 100 0 255 FORMAT "%5.1" ECU_ADDRESS 0xFFF924B4 /end MEASUREMENT
/begin MEASUREMENT Spi_Cg208a.C10_regDfr "F2386: Cg208 register structure / " UBYTE X1_S1 1 100 0 255 FORMAT "%5.1" ECU_ADDRESS 0xFFF924B5 /end MEASUREMENT
/begin MEASUREMENT Spi_Cg208a.C10_regDia "F2386: Cg208 register structure / " UBYTE X1_S1 1 100 0 255 FORMAT "%5.1" ECU_ADDRESS 0xFFF924B6 /end MEASUREMENT
/begin MEASUREMENT Spi_Cg208a.C10_empty "F2386: Cg208 register structure / " UBYTE X1_S1 1 100 0 255 FORMAT "%5.1" ECU_ADDRESS 0xFFF924B7 /end MEASUREMENT
/begin MEASUREMENT Spi_Cg208a.C11_regCur "F2386: Cg208 register structure / " UWORD X1_S1 1 100 0 65535 FORMAT "%8.2" ECU_ADDRESS 0xFFF924B8 /end MEASUREMENT
/begin MEASUREMENT Spi_Cg208a.C11_regCurDelta "F2386: Cg208 register structure / " UWORD X1_S1 1 100 0 65535 FORMAT "%8.2" ECU_ADDRESS 0xFFF924BA /end MEASUREMENT
/begin MEASUREMENT Spi_Cg208a.C11_regDam "F2386: Cg208 register structure / " UBYTE X1_S1 1 100 0 255 FORMAT "%5.1" ECU_ADDRESS 0xFFF924BC /end MEASUREMENT
/begin MEASUREMENT Spi_Cg208a.C11_regDfr "F2386: Cg208 register structure / " UBYTE X1_S1 1 100 0 255 FORMAT "%5.1" ECU_ADDRESS 0xFFF924BD /end MEASUREMENT
/begin MEASUREMENT Spi_Cg208a.C11_regDia "F2386: Cg208 register structure / " UBYTE X1_S1 1 100 0 255 FORMAT "%5.1" ECU_ADDRESS 0xFFF924BE /end MEASUREMENT
/begin MEASUREMENT Spi_Cg208a.C11_empty "F2386: Cg208 register structure / " UBYTE X1_S1 1 100 0 255 FORMAT "%5.1" ECU_ADDRESS 0xFFF924BF /end MEASUREMENT
/begin MEASUREMENT Spi_Cg208a.C2_stOkMsk "F2386: Cg208 register structure / " UBYTE X1_S1 1 100 0 255 FORMAT "%5.1" ECU_ADDRESS 0xFFF924C0 /end MEASUREMENT
/begin MEASUREMENT Spi_Cg208a.C2_stErrMsk "F2386: Cg208 register structure / " UBYTE X1_S1 1 100 0 255 FORMAT "%5.1" ECU_ADDRESS 0xFFF924C1 /end MEASUREMENT
/begin MEASUREMENT Spi_Cg208a.C2_stErrDatMsk "F2386: Cg208 register structure / " UBYTE X1_S1 1 100 0 255 FORMAT "%5.1" ECU_ADDRESS 0xFFF924C2 /end MEASUREMENT
/begin MEASUREMENT Spi_Cg208a.C2_stEmpty "F2386: Cg208 register structure / " UBYTE X1_S1 1 100 0 255 FORMAT "%5.1" ECU_ADDRESS 0xFFF924C3 /end MEASUREMENT
/begin MEASUREMENT Spi_Cg208a.C2_regIdent "F2386: Cg208 register structure / " UBYTE X1_S1 1 100 0 255 FORMAT "%5.1" ECU_ADDRESS 0xFFF924C4 /end MEASUREMENT
/begin MEASUREMENT Spi_Cg208a.C2_regRev "F2386: Cg208 register structure / " UBYTE X1_S1 1 100 0 255 FORMAT "%5.1" ECU_ADDRESS 0xFFF924C5 /end MEASUREMENT
/begin MEASUREMENT Spi_Cg208a.C2_regCurDia "F2386: Cg208 register structure / " UBYTE X1_S1 1 100 0 255 FORMAT "%5.1" ECU_ADDRESS 0xFFF924C6 /end MEASUREMENT
/begin MEASUREMENT Spi_Cg208a.C2_regModeOut "F2386: Cg208 register structure / " UBYTE X1_S1 1 100 0 255 FORMAT "%5.1" ECU_ADDRESS 0xFFF924C7 /end MEASUREMENT
/begin MEASUREMENT Spi_Cg208a.C2_regModeIn "F2386: Cg208 register structure / " UBYTE X1_S1 1 100 0 255 FORMAT "%5.1" ECU_ADDRESS 0xFFF924C8 /end MEASUREMENT
/begin MEASUREMENT Spi_Cg208a.C2_regOsz "F2386: Cg208 register structure / " UBYTE X1_S1 1 100 0 255 FORMAT "%5.1" ECU_ADDRESS 0xFFF924C9 /end MEASUREMENT
/begin MEASUREMENT Spi_Cg208a.C2_regSet "F2386: Cg208 register structure / " UBYTE X1_S1 1 100 0 255 FORMAT "%5.1" ECU_ADDRESS 0xFFF924CA /end MEASUREMENT
/begin MEASUREMENT Spi_Cg208a.C2_regInt "F2386: Cg208 register structure / " UBYTE X1_S1 1 100 0 255 FORMAT "%5.1" ECU_ADDRESS 0xFFF924CB /end MEASUREMENT
/begin MEASUREMENT Spi_Cg208a.C20_regCur "F2386: Cg208 register structure / " UWORD X1_S1 1 100 0 65535 FORMAT "%8.2" ECU_ADDRESS 0xFFF924CC /end MEASUREMENT
/begin MEASUREMENT Spi_Cg208a.C20_regCurDelta "F2386: Cg208 register structure / " UWORD X1_S1 1 100 0 65535 FORMAT "%8.2" ECU_ADDRESS 0xFFF924CE /end MEASUREMENT
/begin MEASUREMENT Spi_Cg208a.C20_regDam "F2386: Cg208 register structure / " UBYTE X1_S1 1 100 0 255 FORMAT "%5.1" ECU_ADDRESS 0xFFF924D0 /end MEASUREMENT
/begin MEASUREMENT Spi_Cg208a.C20_regDfr "F2386: Cg208 register structure / " UBYTE X1_S1 1 100 0 255 FORMAT "%5.1" ECU_ADDRESS 0xFFF924D1 /end MEASUREMENT
/begin MEASUREMENT Spi_Cg208a.C20_regDia "F2386: Cg208 register structure / " UBYTE X1_S1 1 100 0 255 FORMAT "%5.1" ECU_ADDRESS 0xFFF924D2 /end MEASUREMENT
/begin MEASUREMENT Spi_Cg208a.C20_empty "F2386: Cg208 register structure / " UBYTE X1_S1 1 100 0 255 FORMAT "%5.1" ECU_ADDRESS 0xFFF924D3 /end MEASUREMENT
/begin MEASUREMENT Spi_Cg208a.C21_regCur "F2386: Cg208 register structure / " UWORD X1_S1 1 100 0 65535 FORMAT "%8.2" ECU_ADDRESS 0xFFF924D4 /end MEASUREMENT
/begin MEASUREMENT Spi_Cg208a.C21_regCurDelta "F2386: Cg208 register structure / " UWORD X1_S1 1 100 0 65535 FORMAT "%8.2" ECU_ADDRESS 0xFFF924D6 /end MEASUREMENT
/begin MEASUREMENT Spi_Cg208a.C21_regDam "F2386: Cg208 register structure / " UBYTE X1_S1 1 100 0 255 FORMAT "%5.1" ECU_ADDRESS 0xFFF924D8 /end MEASUREMENT
/begin MEASUREMENT Spi_Cg208a.C21_regDfr "F2386: Cg208 register structure / " UBYTE X1_S1 1 100 0 255 FORMAT "%5.1" ECU_ADDRESS 0xFFF924D9 /end MEASUREMENT
/begin MEASUREMENT Spi_Cg208a.C21_regDia "F2386: Cg208 register structure / " UBYTE X1_S1 1 100 0 255 FORMAT "%5.1" ECU_ADDRESS 0xFFF924DA /end MEASUREMENT
/begin MEASUREMENT Spi_Cg208a.C21_empty "F2386: Cg208 register structure / " UBYTE X1_S1 1 100 0 255 FORMAT "%5.1" ECU_ADDRESS 0xFFF924DB /end MEASUREMENT
/begin MEASUREMENT Spi_Cg208a.C3_stOkMsk "F2386: Cg208 register structure / " UBYTE X1_S1 1 100 0 255 FORMAT "%5.1" ECU_ADDRESS 0xFFF924DC /end MEASUREMENT
/begin MEASUREMENT Spi_Cg208a.C3_stErrMsk "F2386: Cg208 register structure / " UBYTE X1_S1 1 100 0 255 FORMAT "%5.1" ECU_ADDRESS 0xFFF924DD /end MEASUREMENT
/begin MEASUREMENT Spi_Cg208a.C3_stErrDatMsk "F2386: Cg208 register structure / " UBYTE X1_S1 1 100 0 255 FORMAT "%5.1" ECU_ADDRESS 0xFFF924DE /end MEASUREMENT
/begin MEASUREMENT Spi_Cg208a.C3_stEmpty "F2386: Cg208 register structure / " UBYTE X1_S1 1 100 0 255 FORMAT "%5.1" ECU_ADDRESS 0xFFF924DF /end MEASUREMENT
/begin MEASUREMENT Spi_Cg208a.C3_regIdent "F2386: Cg208 register structure / " UBYTE X1_S1 1 100 0 255 FORMAT "%5.1" ECU_ADDRESS 0xFFF924E0 /end MEASUREMENT
/begin MEASUREMENT Spi_Cg208a.C3_regRev "F2386: Cg208 register structure / " UBYTE X1_S1 1 100 0 255 FORMAT "%5.1" ECU_ADDRESS 0xFFF924E1 /end MEASUREMENT
/begin MEASUREMENT Spi_Cg208a.C3_regCurDia "F2386: Cg208 register structure / " UBYTE X1_S1 1 100 0 255 FORMAT "%5.1" ECU_ADDRESS 0xFFF924E2 /end MEASUREMENT
/begin MEASUREMENT Spi_Cg208a.C3_regModeOut "F2386: Cg208 register structure / " UBYTE X1_S1 1 100 0 255 FORMAT "%5.1" ECU_ADDRESS 0xFFF924E3 /end MEASUREMENT
/begin MEASUREMENT Spi_Cg208a.C3_regModeIn "F2386: Cg208 register structure / " UBYTE X1_S1 1 100 0 255 FORMAT "%5.1" ECU_ADDRESS 0xFFF924E4 /end MEASUREMENT
/begin MEASUREMENT Spi_Cg208a.C3_regOsz "F2386: Cg208 register structure / " UBYTE X1_S1 1 100 0 255 FORMAT "%5.1" ECU_ADDRESS 0xFFF924E5 /end MEASUREMENT
/begin MEASUREMENT Spi_Cg208a.C3_regSet "F2386: Cg208 register structure / " UBYTE X1_S1 1 100 0 255 FORMAT "%5.1" ECU_ADDRESS 0xFFF924E6 /end MEASUREMENT
/begin MEASUREMENT Spi_Cg208a.C3_regInt "F2386: Cg208 register structure / " UBYTE X1_S1 1 100 0 255 FORMAT "%5.1" ECU_ADDRESS 0xFFF924E7 /end MEASUREMENT
/begin MEASUREMENT Spi_Cg208a.C30_regCur "F2386: Cg208 register structure / " UWORD X1_S1 1 100 0 65535 FORMAT "%8.2" ECU_ADDRESS 0xFFF924E8 /end MEASUREMENT
/begin MEASUREMENT Spi_Cg208a.C30_regCurDelta "F2386: Cg208 register structure / " UWORD X1_S1 1 100 0 65535 FORMAT "%8.2" ECU_ADDRESS 0xFFF924EA /end MEASUREMENT
/begin MEASUREMENT Spi_Cg208a.C30_regDam "F2386: Cg208 register structure / " UBYTE X1_S1 1 100 0 255 FORMAT "%5.1" ECU_ADDRESS 0xFFF924EC /end MEASUREMENT
/begin MEASUREMENT Spi_Cg208a.C30_regDfr "F2386: Cg208 register structure / " UBYTE X1_S1 1 100 0 255 FORMAT "%5.1" ECU_ADDRESS 0xFFF924ED /end MEASUREMENT
/begin MEASUREMENT Spi_Cg208a.C30_regDia "F2386: Cg208 register structure / " UBYTE X1_S1 1 100 0 255 FORMAT "%5.1" ECU_ADDRESS 0xFFF924EE /end MEASUREMENT
/begin MEASUREMENT Spi_Cg208a.C30_empty "F2386: Cg208 register structure / " UBYTE X1_S1 1 100 0 255 FORMAT "%5.1" ECU_ADDRESS 0xFFF924EF /end MEASUREMENT
/begin MEASUREMENT Spi_Cg208a.C31_regCur "F2386: Cg208 register structure / " UWORD X1_S1 1 100 0 65535 FORMAT "%8.2" ECU_ADDRESS 0xFFF924F0 /end MEASUREMENT
/begin MEASUREMENT Spi_Cg208a.C31_regCurDelta "F2386: Cg208 register structure / " UWORD X1_S1 1 100 0 65535 FORMAT "%8.2" ECU_ADDRESS 0xFFF924F2 /end MEASUREMENT
/begin MEASUREMENT Spi_Cg208a.C31_regDam "F2386: Cg208 register structure / " UBYTE X1_S1 1 100 0 255 FORMAT "%5.1" ECU_ADDRESS 0xFFF924F4 /end MEASUREMENT
/begin MEASUREMENT Spi_Cg208a.C31_regDfr "F2386: Cg208 register structure / " UBYTE X1_S1 1 100 0 255 FORMAT "%5.1" ECU_ADDRESS 0xFFF924F5 /end MEASUREMENT
/begin MEASUREMENT Spi_Cg208a.C31_regDia "F2386: Cg208 register structure / " UBYTE X1_S1 1 100 0 255 FORMAT "%5.1" ECU_ADDRESS 0xFFF924F6 /end MEASUREMENT
/begin MEASUREMENT Spi_Cg208a.C31_empty "F2386: Cg208 register structure / " UBYTE X1_S1 1 100 0 255 FORMAT "%5.1" ECU_ADDRESS 0xFFF924F7 /end MEASUREMENT
/begin MEASUREMENT Spi_Cg208a.C4_stOkMsk "F2386: Cg208 register structure / " UBYTE X1_S1 1 100 0 255 FORMAT "%5.1" ECU_ADDRESS 0xFFF924F8 /end MEASUREMENT
/begin MEASUREMENT Spi_Cg208a.C4_stErrMsk "F2386: Cg208 register structure / " UBYTE X1_S1 1 100 0 255 FORMAT "%5.1" ECU_ADDRESS 0xFFF924F9 /end MEASUREMENT
/begin MEASUREMENT Spi_Cg208a.C4_stErrDatMsk "F2386: Cg208 register structure / " UBYTE X1_S1 1 100 0 255 FORMAT "%5.1" ECU_ADDRESS 0xFFF924FA /end MEASUREMENT
/begin MEASUREMENT Spi_Cg208a.C4_stEmpty "F2386: Cg208 register structure / " UBYTE X1_S1 1 100 0 255 FORMAT "%5.1" ECU_ADDRESS 0xFFF924FB /end MEASUREMENT
/begin MEASUREMENT Spi_Cg208a.C4_regIdent "F2386: Cg208 register structure / " UBYTE X1_S1 1 100 0 255 FORMAT "%5.1" ECU_ADDRESS 0xFFF924FC /end MEASUREMENT
/begin MEASUREMENT Spi_Cg208a.C4_regRev "F2386: Cg208 register structure / " UBYTE X1_S1 1 100 0 255 FORMAT "%5.1" ECU_ADDRESS 0xFFF924FD /end MEASUREMENT
/begin MEASUREMENT Spi_Cg208a.C4_regCurDia "F2386: Cg208 register structure / " UBYTE X1_S1 1 100 0 255 FORMAT "%5.1" ECU_ADDRESS 0xFFF924FE /end MEASUREMENT
/begin MEASUREMENT Spi_Cg208a.C4_regModeOut "F2386: Cg208 register structure / " UBYTE X1_S1 1 100 0 255 FORMAT "%5.1" ECU_ADDRESS 0xFFF924FF /end MEASUREMENT
/begin MEASUREMENT Spi_Cg208a.C4_regModeIn "F2386: Cg208 register structure / " UBYTE X1_S1 1 100 0 255 FORMAT "%5.1" ECU_ADDRESS 0xFFF92500 /end MEASUREMENT
/begin MEASUREMENT Spi_Cg208a.C4_regOsz "F2386: Cg208 register structure / " UBYTE X1_S1 1 100 0 255 FORMAT "%5.1" ECU_ADDRESS 0xFFF92501 /end MEASUREMENT
/begin MEASUREMENT Spi_Cg208a.C4_regSet "F2386: Cg208 register structure / " UBYTE X1_S1 1 100 0 255 FORMAT "%5.1" ECU_ADDRESS 0xFFF92502 /end MEASUREMENT
/begin MEASUREMENT Spi_Cg208a.C4_regInt "F2386: Cg208 register structure / " UBYTE X1_S1 1 100 0 255 FORMAT "%5.1" ECU_ADDRESS 0xFFF92503 /end MEASUREMENT
/begin MEASUREMENT Spi_Cg208a.C40_regCur "F2386: Cg208 register structure / " UWORD X1_S1 1 100 0 65535 FORMAT "%8.2" ECU_ADDRESS 0xFFF92504 /end MEASUREMENT
/begin MEASUREMENT Spi_Cg208a.C40_regCurDelta "F2386: Cg208 register structure / " UWORD X1_S1 1 100 0 65535 FORMAT "%8.2" ECU_ADDRESS 0xFFF92506 /end MEASUREMENT
/begin MEASUREMENT Spi_Cg208a.C40_regDam "F2386: Cg208 register structure / " UBYTE X1_S1 1 100 0 255 FORMAT "%5.1" ECU_ADDRESS 0xFFF92508 /end MEASUREMENT
/begin MEASUREMENT Spi_Cg208a.C40_regDfr "F2386: Cg208 register structure / " UBYTE X1_S1 1 100 0 255 FORMAT "%5.1" ECU_ADDRESS 0xFFF92509 /end MEASUREMENT
/begin MEASUREMENT Spi_Cg208a.C40_regDia "F2386: Cg208 register structure / " UBYTE X1_S1 1 100 0 255 FORMAT "%5.1" ECU_ADDRESS 0xFFF9250A /end MEASUREMENT
/begin MEASUREMENT Spi_Cg208a.C40_empty "F2386: Cg208 register structure / " UBYTE X1_S1 1 100 0 255 FORMAT "%5.1" ECU_ADDRESS 0xFFF9250B /end MEASUREMENT
/begin MEASUREMENT Spi_Cg208a.C41_regCur "F2386: Cg208 register structure / " UWORD X1_S1 1 100 0 65535 FORMAT "%8.2" ECU_ADDRESS 0xFFF9250C /end MEASUREMENT
/begin MEASUREMENT Spi_Cg208a.C41_regCurDelta "F2386: Cg208 register structure / " UWORD X1_S1 1 100 0 65535 FORMAT "%8.2" ECU_ADDRESS 0xFFF9250E /end MEASUREMENT
/begin MEASUREMENT Spi_Cg208a.C41_regDam "F2386: Cg208 register structure / " UBYTE X1_S1 1 100 0 255 FORMAT "%5.1" ECU_ADDRESS 0xFFF92510 /end MEASUREMENT
/begin MEASUREMENT Spi_Cg208a.C41_regDfr "F2386: Cg208 register structure / " UBYTE X1_S1 1 100 0 255 FORMAT "%5.1" ECU_ADDRESS 0xFFF92511 /end MEASUREMENT
/begin MEASUREMENT Spi_Cg208a.C41_regDia "F2386: Cg208 register structure / " UBYTE X1_S1 1 100 0 255 FORMAT "%5.1" ECU_ADDRESS 0xFFF92512 /end MEASUREMENT
/begin MEASUREMENT Spi_Cg208a.C41_empty "F2386: Cg208 register structure / " UBYTE X1_S1 1 100 0 255 FORMAT "%5.1" ECU_ADDRESS 0xFFF92513 /end MEASUREMENT
/begin MEASUREMENT SrvShr_stEe_Fault "F1100: bitcoded EEPROM emulation fault status (memorized information)" UWORD X1_S1 1 100 0 65535 FORMAT "%8.2" ECU_ADDRESS 0xFFF94DFE /end MEASUREMENT
/begin MEASUREMENT T1ms_ti "F2360: Measured 1ms system time" ULONG TI1_M_S1 1 100 0 4294967295 FORMAT "%13.2" ECU_ADDRESS 0xFFF91E30 /end MEASUREMENT
/begin COMPU_METHOD B_TRUE_M "boolean states, positive logic" TAB_VERB "%6.3" "" COMPU_TAB_REF B_TRUE_M /end COMPU_METHOD
/begin COMPU_METHOD TI1_M_CYCLE_M "[ms] resolution in multiples of main task (time*ROS_NUM_MNTSK_100MS_SY/100.0ms)" RAT_FUNC "%6.2" "ms" COEFFS 0 0.2 0 0 0 1 /end COMPU_METHOD
/begin COMPU_METHOD X1_M "[1] no unit" RAT_FUNC "%6.2" "" COEFFS 0 1 0 0 0 1 /end COMPU_METHOD
/begin COMPU_METHOD X_ASCII_M "BYTE to ASCII" TAB_VERB "%6.3" "" COMPU_TAB_REF X_ASCII_M /end COMPU_METHOD
/begin COMPU_METHOD B_TRUE_S1 "boolean states, positive logic" TAB_VERB "%6.3" "" COMPU_TAB_REF B_TRUE_S1 /end COMPU_METHOD
/begin COMPU_METHOD DN1_S1 "[1rpm/s] revolutions gradient" RAT_FUNC "%6.2" "rpm/s" COEFFS 0 1 0 0 0 1 /end COMPU_METHOD
/begin COMPU_METHOD F1_S1 "[1Hz] frequency" RAT_FUNC "%6.2" "Hz" COEFFS 0 1 0 0 0 1 /end COMPU_METHOD
/begin COMPU_METHOD I0_0001_S1 "[0.0001A] current" RAT_FUNC "%7.6" "A" COEFFS 0 10000 0 0 0 1 /end COMPU_METHOD
/begin COMPU_METHOD N0_25_S1 "[0.25rpm] revolutions" RAT_FUNC "%6.3" "rpm" COEFFS 0 4 0 0 0 1 /end COMPU_METHOD
/begin COMPU_METHOD Q_SIG_S1 "signal quality information" TAB_VERB "%6.3" "" COMPU_TAB_REF Q_SIG_S1 /end COMPU_METHOD
/begin COMPU_METHOD R0_0001_S1 "[0.0001]" RAT_FUNC "%7.6" "" COEFFS 0 10000 0 0 0 1 /end COMPU_METHOD
/begin COMPU_METHOD R0_001_S1 "[0.001]" RAT_FUNC "%6.5" "" COEFFS 0 1000 0 0 0 1 /end COMPU_METHOD
/begin COMPU_METHOD R0_0625_S1 "[1/16]" RAT_FUNC "%6.4" "" COEFFS 0 16 0 0 0 1 /end COMPU_METHOD
/begin COMPU_METHOD R0_1_P_S1 "[0.1%]" RAT_FUNC "%6.3" "%" COEFFS 0 10 0 0 0 1 /end COMPU_METHOD
/begin COMPU_METHOD T0_0078125_S1 "[0.0078125°C] temperature" RAT_FUNC "%6.4" "°C" COEFFS 0 128 0 0 0 1 /end COMPU_METHOD
/begin COMPU_METHOD T0_0625_S1 "[0.0625°C] temperature" RAT_FUNC "%6.4" "°C" COEFFS 0 16 0 0 0 1 /end COMPU_METHOD
/begin COMPU_METHOD T0_0625_OFFS_0x8000_S1 "[0.0625°C -2048°C (0x8000=0°C)] temperature" RAT_FUNC "%6.0" "°C" COEFFS 0 16 32768 0 0 1 /end COMPU_METHOD
/begin COMPU_METHOD T1_OFFS_40_S1 "[1°C -40°C] temperature" RAT_FUNC "%6.2" "°C" COEFFS 0 1 40 0 0 1 /end COMPU_METHOD
/begin COMPU_METHOD TI0_00005_M_S1 "[0.00005ms] time" RAT_FUNC "%7.6" "ms" COEFFS 0 20000 0 0 0 1 /end COMPU_METHOD
/begin COMPU_METHOD TI0_00025_M_S1 "[0.00025ms] time" RAT_FUNC "%6.5" "ms" COEFFS 0 4000 0 0 0 1 /end COMPU_METHOD
/begin COMPU_METHOD TI0_0005_M_S1 "[0.0005ms] time" RAT_FUNC "%6.5" "ms" COEFFS 0 2000 0 0 0 1 /end COMPU_METHOD
/begin COMPU_METHOD TI0_001_M_S1 "[0.001ms] time" RAT_FUNC "%6.5" "ms" COEFFS 0 1000 0 0 0 1 /end COMPU_METHOD
/begin COMPU_METHOD TI1_CYCLE_S1 "[0.1s] resolution in multiples of 100ms task" RAT_FUNC "%6.3" "s" COEFFS 0 10 0 0 0 1 /end COMPU_METHOD
/begin COMPU_METHOD TI1_M_S1 "[1ms] time" RAT_FUNC "%6.2" "ms" COEFFS 0 1 0 0 0 1 /end COMPU_METHOD
/begin COMPU_METHOD TI1_M_CYCLE_S1 "[ms] resolution in multiples of main task (time*ROS_NUM_MNTSK_100MS_SY/100.0ms)" RAT_FUNC "%6.2" "ms" COEFFS 0 0.2 0 0 0 1 /end COMPU_METHOD
/begin COMPU_METHOD TI1_U_S1 "[1µs] time" RAT_FUNC "%6.2" "µs" COEFFS 0 1 0 0 0 1 /end COMPU_METHOD
/begin COMPU_METHOD U0_001_S1 "[0.001V] voltage" RAT_FUNC "%6.5" "V" COEFFS 0 1000 0 0 0 1 /end COMPU_METHOD
/begin COMPU_METHOD U0_1_S1 "[0.1V] voltage" RAT_FUNC "%6.3" "V" COEFFS 0 10 0 0 0 1 /end COMPU_METHOD
/begin COMPU_METHOD X1_S1 "[1] no unit" RAT_FUNC "%6.2" "" COEFFS 0 1 0 0 0 1 /end COMPU_METHOD
/begin COMPU_METHOD _CNV_S_4_Enum_ENUEN_20_CM_S2 "" TAB_VERB "%6.3" "" COMPU_TAB_REF _CNV_S_4_Enum_ENUEN_20_S2 /end COMPU_METHOD
/begin COMPU_METHOD _CNV_S_3_Enum_ESTIL_22_CM_S2 "" TAB_VERB "%6.3" "" COMPU_TAB_REF _CNV_S_3_Enum_ESTIL_22_S2 /end COMPU_METHOD
/begin COMPU_METHOD _CNV_S_2_Enum_EPROG_36_CM_S2 "" TAB_VERB "%6.3" "" COMPU_TAB_REF _CNV_S_2_Enum_EPROG_36_S2 /end COMPU_METHOD
/begin COMPU_METHOD _CNV_S_2_EnumMINMAX_39_CM_S2 "" TAB_VERB "%6.3" "" COMPU_TAB_REF _CNV_S_2_EnumMINMAX_39_S2 /end COMPU_METHOD
/begin COMPU_METHOD _CNV_S_4_Enum_EFGRB_73_CM_S2 "" TAB_VERB "%6.3" "" COMPU_TAB_REF _CNV_S_4_Enum_EFGRB_73_S2 /end COMPU_METHOD
/begin COMPU_METHOD _CNV_S_8_Enum_EFGR_74_CM_S2 "" TAB_VERB "%6.3" "" COMPU_TAB_REF _CNV_S_8_Enum_EFGR_74_S2 /end COMPU_METHOD
/begin COMPU_METHOD _CNV_S_6_Enum_ELDMB_75_CM_S2 "" TAB_VERB "%6.3" "" COMPU_TAB_REF _CNV_S_6_Enum_ELDMB_75_S2 /end COMPU_METHOD
/begin COMPU_METHOD _CNV_S_2_Enum_EGANG_85_CM_S2 "" TAB_VERB "%6.3" "" COMPU_TAB_REF _CNV_S_2_Enum_EGANG_85_S2 /end COMPU_METHOD
/begin COMPU_METHOD _CNV_S_9_Enum_EPOSL_97_CM_S2 "" TAB_VERB "%6.3" "" COMPU_TAB_REF _CNV_S_9_Enum_EPOSL_97_S2 /end COMPU_METHOD
/begin COMPU_METHOD _CNV_S_2_Enum_EBSMO_111_CM_S2 "" TAB_VERB "%6.3" "" COMPU_TAB_REF _CNV_S_2_Enum_EBSMO_111_S2 /end COMPU_METHOD
/begin COMPU_VTAB B_TRUE_M "boolean states, positive logic" TAB_VERB 2 0 "FALSE" 1 "TRUE" DEFAULT_VALUE "xxxxx" /end COMPU_VTAB
/begin COMPU_VTAB X_ASCII_M "BYTE to ASCII" TAB_VERB 86 32 " " 33 "!" 35 "#" 36 "$" 37 "%" 38 "&" 40 "(" 41 ")" 42 "*" 43 "+" 45 "-" 46 "." 47 "/" 48 "0" 49 "1" 50 "2" 51 "3" 52 "4" 53 "5" 54 "6" 55 "7" 56 "8" 57 "9" 58 ":" 59 ";" 60 "<" 61 "=" 62 ">" 63 "?" 64 "@" 65 "A" 66 "B" 67 "C" 68 "D" 69 "E" 70 "F" 71 "G" 72 "H" 73 "I" 74 "J" 75 "K" 76 "L" 77 "M" 78 "N" 79 "O" 80 "P" 81 "Q" 82 "R" 83 "S" 84 "T" 85 "U" 86 "V" 87 "W" 88 "X" 89 "Y" 90 "Z" 91 "[" 93 "]" 97 "a" 98 "b" 99 "c" 100 "d" 101 "e" 102 "f" 103 "g" 104 "h" 105 "i" 106 "j" 107 "k" 108 "l" 109 "m" 110 "n" 111 "o" 112 "p" 113 "q" 114 "r" 115 "s" 116 "t" 117 "u" 118 "v" 119 "w" 120 "x" 121 "y" 122 "z" 123 "{" 125 "}" DEFAULT_VALUE "_" /end COMPU_VTAB
/begin COMPU_VTAB B_TRUE_S1 "boolean states, positive logic" TAB_VERB 2 0 "FALSE" 1 "TRUE" DEFAULT_VALUE "xxxxx" /end COMPU_VTAB
/begin COMPU_VTAB Q_SIG_S1 "signal quality information" TAB_VERB 9 0 "init" 1 "not_available" 2 "no_source" 3 "fix" 4 "fix_source" 5 "model_based" 6 "diff_source" 7 "ok_disturbed" 8 "ok" DEFAULT_VALUE "xxxxx" /end COMPU_VTAB
/begin COMPU_VTAB _CNV_S_4_Enum_ENUEN_20_S2 "" TAB_VERB 4 0 "KEINE" 1 "AUSSTIEG_NUEN" 2 "NUEN" 3 "EINSTIEG_NUEN" /end COMPU_VTAB
/begin COMPU_VTAB _CNV_S_3_Enum_ESTIL_22_S2 "" TAB_VERB 3 0 "KEIN_AUTOH_BR_AFU" 1 "BR_AFU" 2 "AUTO_H" /end COMPU_VTAB
/begin COMPU_VTAB _CNV_S_2_Enum_EPROG_36_S2 "" TAB_VERB 2 0 "NORMAL_MODE" 1 "SPORT_MODE" /end COMPU_VTAB
/begin COMPU_VTAB _CNV_S_2_EnumMINMAX_39_S2 "" TAB_VERB 2 0 "MIN" 1 "MAX" /end COMPU_VTAB
/begin COMPU_VTAB _CNV_S_4_Enum_EFGRB_73_S2 "" TAB_VERB 4 0 "A_AGS" 1 "S_AGS" 2 "A_AGS_BERG" 3 "S_AGS_BERG" /end COMPU_VTAB
/begin COMPU_VTAB _CNV_S_8_Enum_EFGR_74_S2 "" TAB_VERB 8 0 "FGR_PASSIV" 1 "FGR_AKTIV_KONSTANTFAHRT" 2 "FGR_ACC_REGELUNG_STANDARD" 3 "FGR_AKTIV_WIEDERAUFNAHME" 4 "FGR_ACC_REGELUNG_ERH_DYNAMIK" 5 "FGR_AKTIV_SETZEN_BESCHL" 6 "FGR_ACC_REGELUNG_ABSCHALTUNG" 7 "FGR_AKTIV_VERZOEGERN" /end COMPU_VTAB
/begin COMPU_VTAB _CNV_S_6_Enum_ELDMB_75_S2 "" TAB_VERB 6 0 "LDM_A" 1 "LDM_S" 2 "LDM_A_BERG1" 3 "LDM_S_BERG1" 4 "LDM_A_BERG2" 5 "LDM_S_BERG2" /end COMPU_VTAB
/begin COMPU_VTAB _CNV_S_2_Enum_EGANG_85_S2 "" TAB_VERB 2 0 "Kein_LimpHome" 1 "LimpHome" /end COMPU_VTAB
/begin COMPU_VTAB _CNV_S_9_Enum_EPOSL_97_S2 "" TAB_VERB 9 0 "POSL_1" 1 "POSL_2" 2 "POSL_3" 3 "POSL_4" 4 "POSL_5" 5 "POSL_6" 6 "POSL_7" 7 "POSL_8" 8 "POSL_9" /end COMPU_VTAB
/begin COMPU_VTAB _CNV_S_2_Enum_EBSMO_111_S2 "" TAB_VERB 2 0 "KEIN_LIMPHOME" 1 "LIMPHOME" /end COMPU_VTAB
/begin FUNCTION F9150_SHRVAR "F9150: variant coding" /begin DEF_CHARACTERISTIC ShrVar_tiWaitErrHndlr_C ShrVar_tiWaitVIN_C /end DEF_CHARACTERISTIC
 /begin OUT_MEASUREMENT ShrVar_datCodApplFileId ShrVar_datCPS ShrVar_datVarCod_1 ShrVar_datVarCod_2 ShrVar_idWrDat ShrVar_stCodSesActv ShrVar_stComDly ShrVar_stInit ShrVar_stOrigInit ShrVar_stUpdEEP ShrVar_stWrSucCPS ShrVar_tiWaitErrHndlr ShrVar_tiWaitVIN ShrVar_xBcOrigInit ShrVar_xCanVIN ShrVar_xCanVINRxFlg ShrVar_xChsOrigInit ShrVar_xCodedUS ShrVar_xInitDne ShrVar_xVarCodChkDne /end OUT_MEASUREMENT
/end FUNCTION
/begin FUNCTION F9150_SHRVAR_EEPIFC "F9150: variant coding channel"
 /begin LOC_MEASUREMENT ShrVar_EEP_s.xStructId ShrVar_EEP_s.datVarCod_1 ShrVar_EEP_s.datVarCod_2 ShrVar_EEP_s.xCodedUS ShrVar_EEP_s.xChsCod ShrVar_EEP_s.xChsDat ShrVar_EEP_s.datCafId ShrVar_EEP_s.datCPS /end LOC_MEASUREMENT
/end FUNCTION
/begin FUNCTION F9151_SHRCANEWS "F9151: EWS4 message service on CAN"
 /begin OUT_MEASUREMENT CanA_EwsMsgRx CanA_stEwsRx CanFA_EwsMsgRx CanFA_stEwsRx Can_EwsMsgTx Can_stEwsTx SrvShr_CanEwsDataLength SrvShr_CanEwsRxBuff /end OUT_MEASUREMENT
/end FUNCTION
/begin FUNCTION F9170_SHRCAN "F9170: CAN system interface"
 /begin OUT_MEASUREMENT SrvShr_CAN_ACTIVE SrvShr_CAN_BusComReq SrvShr_CAN_BusComReqS /end OUT_MEASUREMENT
/end FUNCTION
/begin FUNCTION F9170_SHRROS "F9170: Operating system interface" /begin OUT_MEASUREMENT SrvShr_BS_MODE /end OUT_MEASUREMENT /end FUNCTION
/begin FUNCTION F9175_CAN_SHR "F9175: CAN system interface" /begin DEF_CHARACTERISTIC CAN_tiPowerup_C /end DEF_CHARACTERISTIC
 /begin OUT_MEASUREMENT CAN_tiPowerup IO_ctmsgAPP3 IO_ctmsgAPP4 IO_ctmsgAPP8 IO_ctmsgNAV1 IO_ctmsgNAV2 IO_ctmsgNAV3 IO_ctmsgNAV4 IO_ctmsgNAV5 IO_ctmsgNAV6 IO_ctmsgNAV7 IO_ctmsgService ZF_APP1_CAN_Flag ZF_APP2_CAN_Flag ZF_APP3_CAN_Flag ZF_APP4_CAN_Flag ZF_APP5_CAN_Flag ZF_APP6_CAN_Flag ZF_APP7_CAN_Flag ZF_APP8_CAN_Flag ZF_APP9_CAN_Flag ZF_APP_AZG_Selection ZF_NAV1_CAN_Flag ZF_NAV2_CAN_Flag ZF_NAV3_CAN_Flag ZF_NAV4_CAN_Flag ZF_NAV5_CAN_Flag ZF_NAV6_CAN_Flag ZF_NAV7_CAN_Flag ZF_SERVICE_CAN_Flag /end OUT_MEASUREMENT
/end FUNCTION
/begin FUNCTION F9260_ID_DEF "F9260: Systemhouse Identification"
 /begin OUT_MEASUREMENT COM_xBbRefId COM_xBcRefId COM_xPrgRefIdMeas COM_xPrgVersMeas COM_xSbRefId /end OUT_MEASUREMENT
/end FUNCTION
/begin FUNCTION RMN_TskMon "" /begin OUT_MEASUREMENT RMN_bTskErr /end OUT_MEASUREMENT /end FUNCTION
/begin FUNCTION RRT_TskMeas "" /begin DEF_CHARACTERISTIC RRT_swtRstMax_C /end DEF_CHARACTERISTIC /end FUNCTION
/begin FUNCTION F1100_EeAccs "F1100: EEPROM main module" /begin OUT_MEASUREMENT EeAccs_stEmu EeAccs_stPrgLvlChg /end OUT_MEASUREMENT /end FUNCTION
/begin FUNCTION F1100_EeFltHdl "F1100: EEPROM fault handling" /begin OUT_MEASUREMENT EeFltHdl_efFaults /end OUT_MEASUREMENT /end FUNCTION
/begin FUNCTION F1100_EeGenSrv "F1100: EEPROM general services" /begin OUT_MEASUREMENT EeGenSrv_ctTotUpdSctrGrp_a /end OUT_MEASUREMENT /end FUNCTION
/begin FUNCTION F1100_EePstId_Cfg "F1100: Application values for project specific PST-ID configuration of EEPROM emulation" /begin DEF_CHARACTERISTIC EePstId_Cfg_idAddOem_C EePstId_Cfg_idOem_C /end DEF_CHARACTERISTIC /end FUNCTION
/begin FUNCTION F1100_EeUpdSrv "F1100: EEPROM update service" /begin DEF_CHARACTERISTIC EeUpdSrv_bDisblPstIdDstChsUpd_C /end DEF_CHARACTERISTIC /begin OUT_MEASUREMENT EeUpdSrv_ctCmplUpd EeUpdSrv_ctTgtUpd /end OUT_MEASUREMENT /end FUNCTION
/begin FUNCTION F1100_ShrEe_Cfg "F1100: Application values for ZF SW EEPROM channels"
 /begin DEF_CHARACTERISTIC ShrEe_xEeInfoCfgCh0_C ShrEe_xEeInfoCfgCh10_C ShrEe_xEeInfoCfgCh11_C ShrEe_xEeInfoCfgCh12_C ShrEe_xEeInfoCfgCh13_C ShrEe_xEeInfoCfgCh14_C ShrEe_xEeInfoCfgCh15_C ShrEe_xEeInfoCfgCh1_C ShrEe_xEeInfoCfgCh2_C ShrEe_xEeInfoCfgCh3_C ShrEe_xEeInfoCfgCh4_C ShrEe_xEeInfoCfgCh5_C ShrEe_xEeInfoCfgCh6_C ShrEe_xEeInfoCfgCh7_C ShrEe_xEeInfoCfgCh8_C ShrEe_xEeInfoCfgCh9_C ShrEe_xSctnCfgCh0_C ShrEe_xSctnCfgCh10_C ShrEe_xSctnCfgCh11_C ShrEe_xSctnCfgCh12_C ShrEe_xSctnCfgCh13_C ShrEe_xSctnCfgCh14_C ShrEe_xSctnCfgCh15_C ShrEe_xSctnCfgCh1_C ShrEe_xSctnCfgCh2_C ShrEe_xSctnCfgCh3_C ShrEe_xSctnCfgCh4_C ShrEe_xSctnCfgCh5_C ShrEe_xSctnCfgCh6_C ShrEe_xSctnCfgCh7_C ShrEe_xSctnCfgCh8_C ShrEe_xSctnCfgCh9_C /end DEF_CHARACTERISTIC
/end FUNCTION
/begin FUNCTION F1100_SHREE_DSM "F1100: EEPROM emulation connection to DSM" /begin OUT_MEASUREMENT SrvShr_stEe_Fault /end OUT_MEASUREMENT /end FUNCTION
/begin FUNCTION F1206_EXCHG_FIX_M "F1206: fixed data in exchange RAM (only measurement)"
 /begin OUT_MEASUREMENT ExchgFix_ctStrtUp ExchgFix_s.numRamBufTest ExchgFix_s.numFlshChkReq ExchgFix_s.numAreaDataVal ExchgFix_s.reserved ExchgFix_s.numRamBufValid /end OUT_MEASUREMENT
/end FUNCTION
/begin FUNCTION F1211_RAMCYCL_ECC_M "F1211: cyclic RAM-ECC test and monitoring (only measurement)"
 /begin OUT_MEASUREMENT MmmCycl_numRamEccEE MmmCycl_numRomEccEE RamCycl_stEccForMcor RamCycl_stEccTestFailed /end OUT_MEASUREMENT
/end FUNCTION
/begin FUNCTION F1211_RAMCYCL_TST_M "F1211: cyclic RAM test (only measurement)" /begin OUT_MEASUREMENT RamCycl_adBegTstNext RamCycl_adTstFail RamCycl_ctTstCompl /end OUT_MEASUREMENT /end FUNCTION
/begin FUNCTION F1220_RAMBUF "F1220: Buffered RAM administration" /begin DEF_CHARACTERISTIC RamBuf_numClearReq_C /end DEF_CHARACTERISTIC /begin OUT_MEASUREMENT RamBuf_numClearReq RamBuf_st RamBuf_stClear RamBuf_stStart /end OUT_MEASUREMENT /end FUNCTION
/begin FUNCTION F1270_RAMSTCKMON "F1270: Stack monitoring" /begin DEF_CHARACTERISTIC RamStckMon_bRstDat_C /end DEF_CHARACTERISTIC
 /begin OUT_MEASUREMENT RamStckMon_numMaxUsd RamStckMon_numMaxUsdStrd RamStckMon_numMinFreeStrd RamStckMon_rMaxUsd RamStckMon_stFault /end OUT_MEASUREMENT
/end FUNCTION
/begin FUNCTION F1350_RomChsCycTst "F1350: Cyclic monitoring of the flash checksums"
 /begin OUT_MEASUREMENT Rom_RomChsCycTst_adCurrEnd Rom_RomChsCycTst_adCurrStrt Rom_RomChsCycTst_adTmpCurrStrt Rom_RomChsCycTst_ctChsAllTst Rom_RomChsCycTst_ctCurrDneAr Rom_RomChsCycTst_stChsInfo Rom_RomChsCycTst_stChsMonDisbl Rom_RomChsCycTst_stFault Rom_RomChsCycTst_stTest Rom_RomChsCycTst_tiStamp1ms Rom_RomChsCycTst_xCfgInfo Rom_RomChsCycTst_xCurrChs Rom_RomChsCycTst_xTmpCurrChs Rom_RomChsTstRef Rom_RomChsTstRslt Rom_RomChsTstRsltStrd /end OUT_MEASUREMENT
/end FUNCTION
/begin FUNCTION F1351_RomChsCycTst_Cfg "F1351: Monitoring of the flash checksums - configuration" /begin DEF_CHARACTERISTIC Rom_stMonActvCpl_C Rom_stMonActv_C /end DEF_CHARACTERISTIC /end FUNCTION
/begin FUNCTION F1405_MsrvMemByAdr "F1405: Function for the memory rights" /begin DEF_CHARACTERISTIC MsrvMemByAdr_swtAllwDvlpTab_C /end DEF_CHARACTERISTIC /end FUNCTION
/begin FUNCTION F1505_CalHndlr "F1505: Calibration Handler" /begin OUT_MEASUREMENT CalHndlr_xActvCalPg CalHndlr_xActvCalUsr /end OUT_MEASUREMENT /end FUNCTION
/begin FUNCTION F1505_CalHndlrHw "F1505: hardware dependent part of calibration handler" /begin OUT_MEASUREMENT CalHndlrHw_regAUDISR CalHndlrHw_sAudTool /end OUT_MEASUREMENT /end FUNCTION
/begin FUNCTION F1510_EtkCal "F1510: ETK calibration functions" /begin OUT_MEASUREMENT EtkCal_FshbckWaitCnt /end OUT_MEASUREMENT /end FUNCTION
/begin FUNCTION F1510_EtkSrv "F1510: General etk-services" /begin OUT_MEASUREMENT EtkSrv_tiDiffNoWait EtkSrv_tiDiffWait /end OUT_MEASUREMENT /end FUNCTION
/begin FUNCTION F1520_Serap "F1520: Calibration with InCircuit 2" /begin OUT_MEASUREMENT Serap_adOfsWrk Serap_swtPg /end OUT_MEASUREMENT /end FUNCTION
/begin FUNCTION F1590_DBG_ERR "F1590: Debug error handler"
 /begin OUT_MEASUREMENT DBG_ERR_numBuf DBG_ERR_numErr DBG_ERR_numErrId DBG_ERR_numFctId DBG_ERR_regPR DBG_ERR_xPar /end OUT_MEASUREMENT
/end FUNCTION
/begin FUNCTION F1740_OmmRst "F1740: OMM Reset Handling"
 /begin OUT_MEASUREMENT OmmRst_idxOpMode OmmRst_idxOpModeLast OmmRst_sRst OmmRst_sRstID /end OUT_MEASUREMENT
/end FUNCTION
/begin FUNCTION F1740_OmmSdMgr "F1740: Shutdown Manager" /begin DEF_CHARACTERISTIC OmmSdMgr_xCtl_C /end DEF_CHARACTERISTIC
 /begin OUT_MEASUREMENT OmmSdMgr_bReqCal OmmSdMgr_bReqHot OmmSdMgr_bSdnAllow OmmSdMgr_eReqStd OmmSdMgr_eSdnTgt OmmSdMgr_stSdn OmmSdMgr_tiExtDly OmmSdMgr_tiExtPstDly /end OUT_MEASUREMENT
/end FUNCTION
/begin FUNCTION F1750_OmmBc "F1750: Jump to BC" /begin DEF_CHARACTERISTIC OmmBc_sPrepCfg_C /end DEF_CHARACTERISTIC /begin OUT_MEASUREMENT OmmBc_sPrep /end OUT_MEASUREMENT /end FUNCTION
/begin FUNCTION F1800_OmmInCfg "F1800: Init Configuration"
 /begin OUT_MEASUREMENT OmmInCfg_stIni OmmInCfg_stIniDSM OmmInCfg_stIniEE OmmInCfg_stIniFin OmmInCfg_stIniHot OmmInCfg_stIniInp OmmInCfg_stIniMain OmmInCfg_stIniOps OmmInCfg_stIniOutp OmmInCfg_stIniPer OmmInCfg_stIniRAM OmmInCfg_stIniSAF OmmInCfg_stIniSC OmmInCfg_stIniWuv /end OUT_MEASUREMENT
/end FUNCTION
/begin FUNCTION F1800_OmmInMgr "F1800: initialization manager" /begin OUT_MEASUREMENT OmmInMgr_bIniOk OmmInMgr_bStrtTskFin OmmInMgr_bStrtTskPer /end OUT_MEASUREMENT /end FUNCTION
/begin FUNCTION F2351_ECE_CORE "F2351: ECE core test/measurement"
 /begin DEF_CHARACTERISTIC ECE_CORE_numPbusCycles_C ECE_CORE_regModClkMsk_C ECE_CORE_regModeMsk_C ECE_CORE_stRamWS_C ECE_CORE_stRstTrg_C /end DEF_CHARACTERISTIC
 /begin OUT_MEASUREMENT ECE_CORE_bMisrErr ECE_CORE_ctPbusCycles ECE_CORE_numPbusTransfers ECE_CORE_regMisr /end OUT_MEASUREMENT
/end FUNCTION
/begin FUNCTION F2352_ECE_IDX "F2352: Project Specific Channel Indices of the ECU Encapsulation (ECE)"
 /begin DEF_CHARACTERISTIC ECE_idxAdcAtf2_C ECE_idxAdcAtf_C ECE_idxAdcBrk_C ECE_idxAdcDrvPos_C ECE_idxAdcFdbkSsply5_C ECE_idxAdcFdbkStrtRly_C ECE_idxAdcLx_C ECE_idxAdcOptRef_C ECE_idxAdcOpt_C ECE_idxAdcPres_C ECE_idxAdcTap_C ECE_idxAdcTim_C ECE_idxAdcVdd3_C ECE_idxAdc_iHss_C ECE_idxAdc_iPSply_C ECE_idxDigLx_C ECE_idxFrqTis2_C ECE_idxFrqTis_C ECE_idxFrqTos_C ECE_idxLxVarHandling_C ECE_idxPwdLx_C ECE_idxPwdOpt_C ECE_idxPwdTapProt_C ECE_idxPwdTapX_C ECE_stAdcLxAvail_C ECE_stDigLxAvail_C /end DEF_CHARACTERISTIC
 /begin IN_MEASUREMENT ECE_idxDmy /end IN_MEASUREMENT
 /begin OUT_MEASUREMENT ECE_idxLx ECE_idxLxOff /end OUT_MEASUREMENT
/end FUNCTION
/begin FUNCTION F2352_ECE_PSYS "F2352: Project Specific Definitions of the ECU Encapsulation (ECE)" /begin OUT_MEASUREMENT ECE_idxDmy /end OUT_MEASUREMENT /end FUNCTION
/begin FUNCTION F2355_ECE_ADC "F2355: Analog channels of the ECU encapsulation"
 /begin DEF_CHARACTERISTIC ECE_facAdcAmux_C ECE_facAdcA_C ECE_facAdcB_C ECE_numAdcFir_C ECE_numAdcNoiFir_C ECE_uAdcNoiDecrLim_C ECE_uAdcNoiJumpLim_C /end DEF_CHARACTERISTIC
 /begin OUT_MEASUREMENT ECE_bAdcStopA ECE_bAdcStopB ECE_ctAdcDmaOvrFlw ECE_regAdcDiagDiffA ECE_regAdcDiagDiffB ECE_tiAdcA.tiDiff ECE_tiAdcA.tiStamp ECE_tiAdcA.ctDiff ECE_uAdcA ECE_uAdcAmux ECE_uAdcB ECE_uBatt ECE_uBattMin ECE_uBattNoi ECE_uBattNoiInt ECE_uBattSwt ECE_uM2 ECE_uM3 ECE_uPSply ECE_uSSply ECE_uVASIC ECE_uVDD3 ECE_uWAK1 ECE_uWAK2 /end OUT_MEASUREMENT
/end FUNCTION
/begin FUNCTION F2357_ECE_CAN "F2357: ECE-CAN wake-up handling" /begin DEF_CHARACTERISTIC ECE_CAN_stWakUpCheck_C /end DEF_CHARACTERISTIC /begin OUT_MEASUREMENT ECE_sCanStartup /end OUT_MEASUREMENT /end FUNCTION
/begin FUNCTION F2359_ECE_PWD "F2359: pulse-width-demodulation" /begin DEF_CHARACTERISTIC ECE_PWD_tiDscr_C /end DEF_CHARACTERISTIC /begin IN_MEASUREMENT ECE_idxDmy /end IN_MEASUREMENT /begin OUT_MEASUREMENT ECE_qtiPwd ECE_tiPwdDuty ECE_tiPwdPer /end OUT_MEASUREMENT /end FUNCTION
/begin FUNCTION F2360_ECE_TIMER_M "F2360: Timer Channels (only measurement)"
 /begin OUT_MEASUREMENT CPU_TimerFastTicks_u32 CPU_TimerTicks_u32 ECE_bCpuClockActive ECE_bPclk T1ms_ti /end OUT_MEASUREMENT
/end FUNCTION
/begin FUNCTION F2364_ECE_FRQ "F2364: Frequency input speed ECE driver"
 /begin DEF_CHARACTERISTIC ECE_FRQ_fac_C ECE_FRQ_nMin_C ECE_FRQ_numFifo_C ECE_FRQ_numGradFifo_C ECE_FRQ_numPlsPerRev_C ECE_FRQ_stAvail_C ECE_FRQ_tiCfg_C /end DEF_CHARACTERISTIC
 /begin IN_MEASUREMENT ECE_idxDmy /end IN_MEASUREMENT
 /begin OUT_MEASUREMENT ECE_FRQ_ctPls ECE_FRQ_dn ECE_FRQ_n ECE_FRQ_qdn ECE_FRQ_qn ECE_FRQ_stHwDiag ECE_FRQ_tiPls /end OUT_MEASUREMENT
/end FUNCTION
/begin FUNCTION F2366_ECE_CC08 "F2366: CG208 driver support (CC=current control)"
 /begin DEF_CHARACTERISTIC ECE_CC08_bUseDither_C ECE_CC08_regInt_C ECE_CC08_regMode_C ECE_CC08_regOsc_C ECE_CC08_regRound_C ECE_CC08_regSet_C ECE_CC08_stAvail_C ECE_CC08_stOnOffMode_C ECE_CC08_stSpiDiaDynMsk_C ECE_CC08_tiDfrInit_C ECE_CC08_tiDithIsrFast_C ECE_CC08_tiDithIsrSlow_C ECE_CC08_tiSyncInit_C ECE_CC08_tiSyncPhaseDlyInit_C ECE_CC08_xDithGrpAssign_C ECE_CC08_xSyncGrpAssign_C /end DEF_CHARACTERISTIC
 /begin IN_MEASUREMENT ECE_idxDmy /end IN_MEASUREMENT
 /begin OUT_MEASUREMENT ECE_CC08_bDiaDly ECE_CC08_ctMissDithIsr ECE_CC08_iAct ECE_CC08_iActDelta ECE_CC08_iCmd ECE_CC08_iDam ECE_CC08_idxDithGrpAssign ECE_CC08_idxSyncGrpAssign ECE_CC08_regDfr ECE_CC08_regInt ECE_CC08_regOsc ECE_CC08_regRound ECE_CC08_regSet ECE_CC08_stModeAct ECE_CC08_stModeCmd ECE_CC08_stSpiDiag ECE_CC08_stVersion ECE_CC08_tiDithIsr ECE_CC08_tiFdbkDuty ECE_CC08_tiFdbkPer ECE_CC08_tiSync ECE_CC08_tiSyncChn /end OUT_MEASUREMENT
/end FUNCTION
/begin FUNCTION F2369_ECE_LSS "F2369: Low-Side Outputs with Cg124-AMux feedback"
 /begin DEF_CHARACTERISTIC ECE_LSS_rMax_C ECE_LSS_rMin_C ECE_LSS_stAvail_C ECE_LSS_stProt_C ECE_LSS_tiPerCmdInit_C /end DEF_CHARACTERISTIC
 /begin OUT_MEASUREMENT ECE_LSS_numDuty ECE_LSS_numNoDuty ECE_LSS_rAct ECE_LSS_rCmd ECE_LSS_rCmdAct ECE_LSS_stStatHw ECE_LSS_tiPerAct ECE_LSS_tiPerCmd ECE_LSS_uDuty ECE_LSS_uNoDuty /end OUT_MEASUREMENT
/end FUNCTION
/begin FUNCTION F2371_ECE_PWM "F2371: general PWM Outputs with non-synchronized feedback" /begin DEF_CHARACTERISTIC ECE_PWM_stPolOut_C ECE_PWM_tiPerInit_C /end DEF_CHARACTERISTIC /begin OUT_MEASUREMENT ECE_PWM_tiDutyCmd ECE_PWM_tiPerCmd /end OUT_MEASUREMENT /end FUNCTION
/begin FUNCTION F2385_ECE_SPI "F2385: ECE_SPI signal driver" /begin DEF_CHARACTERISTIC ECE_Cg124_regInit_C ECE_Cg130_regInit2_C /end DEF_CHARACTERISTIC
 /begin OUT_MEASUREMENT ECE_bDN ECE_bOvrTmpRstrt ECE_bSSplyReq ECE_bWak1 ECE_bWak2 ECE_bWakIntern ECE_bWdRst ECE_bWdRstFirst ECE_bWdRstReq ECE_bWdRstReqCmpl ECE_Cg124_regInit ECE_Cg130_regInit2 ECE_regSysChpTemp ECE_sModeCfgReq ECE_SPI_bCg124_stSpiOk ECE_SPI_bCg130_stSpiOk ECE_SPI_regHsdPort ECE_SPI_stSpiCore ECE_sSpiRead ECE_stCg130Version ECE_stLines ECE_Stlk_bSpiOff ECE_stOTA ECE_stPclk ECE_stSysChpTemp ECE_stSysChpTempOT ECE_tChpExt Spi_Cg124_regDiaFirst Spi_Cg130_regDia1First Spi_Cg130_regDia2First Spi_Cg130_regDia3First /end OUT_MEASUREMENT
/end FUNCTION
/begin FUNCTION F2386_SPICC08 "F2386: CG208 SPI sequence handling"
 /begin OUT_MEASUREMENT SpiCc08_DIA_regRx SpiCc08_DIA_regTx SpiCc08_ID_regRx SpiCc08_ID_regTx SpiCc08_OUTFX_regRx SpiCc08_OUTFX_regTx SpiCc08_OUTI_regRx SpiCc08_OUTI_regTx SpiCc08_OUTP_regRx SpiCc08_OUTP_regTx SpiCc08_st Spi_Cg208a.C0_stOkMsk Spi_Cg208a.C0_stErrMsk Spi_Cg208a.C0_stErrDatMsk Spi_Cg208a.C0_stEmpty Spi_Cg208a.C0_regIdent Spi_Cg208a.C0_regRev Spi_Cg208a.C0_regCurDia Spi_Cg208a.C0_regModeOut Spi_Cg208a.C0_regModeIn Spi_Cg208a.C0_regOsz Spi_Cg208a.C0_regSet Spi_Cg208a.C0_regInt Spi_Cg208a.C00_regCur Spi_Cg208a.C00_regCurDelta Spi_Cg208a.C00_regDam Spi_Cg208a.C00_regDfr Spi_Cg208a.C00_regDia Spi_Cg208a.C00_empty Spi_Cg208a.C01_regCur Spi_Cg208a.C01_regCurDelta Spi_Cg208a.C01_regDam Spi_Cg208a.C01_regDfr Spi_Cg208a.C01_regDia Spi_Cg208a.C01_empty Spi_Cg208a.C1_stOkMsk Spi_Cg208a.C1_stErrMsk Spi_Cg208a.C1_stErrDatMsk Spi_Cg208a.C1_stEmpty Spi_Cg208a.C1_regIdent Spi_Cg208a.C1_regRev Spi_Cg208a.C1_regCurDia Spi_Cg208a.C1_regModeOut Spi_Cg208a.C1_regModeIn Spi_Cg208a.C1_regOsz Spi_Cg208a.C1_regSet Spi_Cg208a.C1_regInt Spi_Cg208a.C10_regCur Spi_Cg208a.C10_regCurDelta Spi_Cg208a.C10_regDam Spi_Cg208a.C10_regDfr Spi_Cg208a.C10_regDia Spi_Cg208a.C10_empty Spi_Cg208a.C11_regCur Spi_Cg208a.C11_regCurDelta Spi_Cg208a.C11_regDam Spi_Cg208a.C11_regDfr Spi_Cg208a.C11_regDia Spi_Cg208a.C11_empty Spi_Cg208a.C2_stOkMsk Spi_Cg208a.C2_stErrMsk Spi_Cg208a.C2_stErrDatMsk Spi_Cg208a.C2_stEmpty Spi_Cg208a.C2_regIdent Spi_Cg208a.C2_regRev Spi_Cg208a.C2_regCurDia Spi_Cg208a.C2_regModeOut Spi_Cg208a.C2_regModeIn Spi_Cg208a.C2_regOsz Spi_Cg208a.C2_regSet Spi_Cg208a.C2_regInt Spi_Cg208a.C20_regCur Spi_Cg208a.C20_regCurDelta Spi_Cg208a.C20_regDam Spi_Cg208a.C20_regDfr Spi_Cg208a.C20_regDia Spi_Cg208a.C20_empty Spi_Cg208a.C21_regCur Spi_Cg208a.C21_regCurDelta Spi_Cg208a.C21_regDam Spi_Cg208a.C21_regDfr Spi_Cg208a.C21_regDia Spi_Cg208a.C21_empty Spi_Cg208a.C3_stOkMsk Spi_Cg208a.C3_stErrMsk Spi_Cg208a.C3_stErrDatMsk Spi_Cg208a.C3_stEmpty Spi_Cg208a.C3_regIdent Spi_Cg208a.C3_regRev Spi_Cg208a.C3_regCurDia Spi_Cg208a.C3_regModeOut Spi_Cg208a.C3_regModeIn Spi_Cg208a.C3_regOsz Spi_Cg208a.C3_regSet Spi_Cg208a.C3_regInt Spi_Cg208a.C30_regCur Spi_Cg208a.C30_regCurDelta Spi_Cg208a.C30_regDam Spi_Cg208a.C30_regDfr Spi_Cg208a.C30_regDia Spi_Cg208a.C30_empty Spi_Cg208a.C31_regCur Spi_Cg208a.C31_regCurDelta Spi_Cg208a.C31_regDam Spi_Cg208a.C31_regDfr Spi_Cg208a.C31_regDia Spi_Cg208a.C31_empty Spi_Cg208a.C4_stOkMsk Spi_Cg208a.C4_stErrMsk Spi_Cg208a.C4_stErrDatMsk Spi_Cg208a.C4_stEmpty Spi_Cg208a.C4_regIdent Spi_Cg208a.C4_regRev Spi_Cg208a.C4_regCurDia Spi_Cg208a.C4_regModeOut Spi_Cg208a.C4_regModeIn Spi_Cg208a.C4_regOsz Spi_Cg208a.C4_regSet Spi_Cg208a.C4_regInt Spi_Cg208a.C40_regCur Spi_Cg208a.C40_regCurDelta Spi_Cg208a.C40_regDam Spi_Cg208a.C40_regDfr Spi_Cg208a.C40_regDia Spi_Cg208a.C40_empty Spi_Cg208a.C41_regCur Spi_Cg208a.C41_regCurDelta Spi_Cg208a.C41_regDam Spi_Cg208a.C41_regDfr Spi_Cg208a.C41_regDia Spi_Cg208a.C41_empty /end OUT_MEASUREMENT
/end FUNCTION
/begin FUNCTION F2386_SPICORE_M "F2386: CG124/CG130 SPI sequence handling"
 /begin OUT_MEASUREMENT SpiCore_DIA_regRx SpiCore_DIA_regTx SpiCore_ID_regRx SpiCore_ID_regTx SpiCore_OUT_regRx SpiCore_OUT_regTx SpiCore_stCg124 SpiCore_stCg130 SpiCore_TEMP_regRx SpiCore_TEMP_regTx Spi_Cg124.stOkMsk Spi_Cg124.stErrMsk Spi_Cg124.stErrDatMsk Spi_Cg124.stEmpty Spi_Cg124.regIdent Spi_Cg124.regRev Spi_Cg124.regStat Spi_Cg124.regDia Spi_Cg124.regDInit Spi_Cg130.stOkMsk Spi_Cg130.stErrMsk Spi_Cg130.stErrDatMsk Spi_Cg130.stEmpty Spi_Cg130.regTemp Spi_Cg130.stTemp Spi_Cg130.regIdent Spi_Cg130.regRev Spi_Cg130.regDia1 Spi_Cg130.regDia2 Spi_Cg130.regDia3 Spi_Cg130.regInit1 Spi_Cg130.regInit1r Spi_Cg130.regInit2 Spi_Cg130.regInit2r /end OUT_MEASUREMENT
/end FUNCTION
/begin FUNCTION F2391_ECE_WDT_M "F2391: watchdog-timer (WDT) and protection (only measurement)" /begin OUT_MEASUREMENT ECE_WDT_bHsdOff ECE_WDT_bWdtMode ECE_WDT_tiMrgnMinEe /end OUT_MEASUREMENT /end FUNCTION
/begin FUNCTION F2392_ECE_IWD_M "F2392: CG130 watchdog handling (measurement only)"
 /begin OUT_MEASUREMENT ECE_IWD_bActive ECE_IWD_reg.stOkMsk ECE_IWD_reg.stErrMsk ECE_IWD_reg.stErrDatMsk ECE_IWD_reg.stEmpty ECE_IWD_reg.tiSpiTransfer ECE_IWD_reg.regRESP ECE_IWD_reg.ctTIME ECE_IWD_reg.ctRESP ECE_IWD_reg.regRESP_TIME_TX ECE_IWD_reg.regRESP_TIME_RX ECE_IWD_reg.regREQULO ECE_IWD_reg.regREQUHI ECE_IWD_RESP_regRx ECE_IWD_RESP_regTx ECE_IWD_tiAct ECE_IWD_tiDly ECE_IWD_TIME_regRx ECE_IWD_TIME_regTx /end OUT_MEASUREMENT
/end FUNCTION
/begin FUNCTION F2397_ECE_PSPLY "F2397: ECE_PSPLY power supply driver"
 /begin DEF_CHARACTERISTIC ECE_PSPLY_idxSpi_C ECE_PSPLY_stHssForceOn_C ECE_PSPLY_stHssSafOff_C /end DEF_CHARACTERISTIC
 /begin OUT_MEASUREMENT ECE_bPSplyOvrCurr ECE_bPSplyReq /end OUT_MEASUREMENT
/end FUNCTION
/begin FUNCTION F2410_InpPBatL2 "F2410: Battery voltage detection"
 /begin DEF_CHARACTERISTIC InpPBatL2_tiBattDiff_C InpPBatL2_tiBattLoVltg_C InpPBatL2_tiBattNoiVBS_C InpPBatL2_tiBattNoi_C InpPBatL2_uBattLoLim_C InpPBatL2_uBattNoiLi_C InpPBatL2_uBattSwtCal_C InpPBatL2_uBattTolc_C InpPBatL2_uBattUpLim_C /end DEF_CHARACTERISTIC
 /begin OUT_MEASUREMENT InpPBatL2_bBattNoiVBS InpPBatL2_stBatt InpPBatL2_tiBattDiff InpPBatL2_tiBattLoVltg InpPBatL2_tiBattNoi InpPBatL2_tiBattNoiVBS InpPBatL2_uBattDrop InpPBatL2_uBattSwt /end OUT_MEASUREMENT
/end FUNCTION
/begin FUNCTION F2410_InpPBatL3 "F2410: Battery voltage recognition" /begin OUT_MEASUREMENT InpPBatL3_stBattFault InpPBatL3_stBattTstCon /end OUT_MEASUREMENT /end FUNCTION
/begin FUNCTION F2410_InpPIfcBatt "F2410: Battery voltage detection"
 /begin OUT_MEASUREMENT InpPIfcBatt_efBattNoi InpPIfcBatt_quBatt InpPIfcBatt_uBatt InpPIfcBatt_uBatt8 InpPIfcBatt_uBattMin InpPIfcBatt_uBattNoi /end OUT_MEASUREMENT
/end FUNCTION
/begin FUNCTION F2411_InpPIfcPSupp "F2411: Power Supply Actuators (HSx)"
 /begin OUT_MEASUREMENT InpPIfcPSupp_quBattSply InpPIfcPSupp_quPSply InpPIfcPSupp_uBattSply InpPIfcPSupp_uPSply InpPIfcPSupp_uPSply8 /end OUT_MEASUREMENT
/end FUNCTION
/begin FUNCTION F2411_InpPPSplyL3 "F2411: Power Supply Actuators (HSx)"
 /begin DEF_CHARACTERISTIC InpPPSplyL3_bPrs_C InpPPSplyL3_swtBattSply_C InpPPSplyL3_uThres_C /end DEF_CHARACTERISTIC
/end FUNCTION
/begin FUNCTION F2413_InpPIfcSens "F2413: Sensor Supply Voltage" /begin OUT_MEASUREMENT InpPIfcSens_uSSply /end OUT_MEASUREMENT /end FUNCTION
/begin FUNCTION F2415_InpPIfcM2M3 "F2415: Internal voltage detection M2/M3"
 /begin OUT_MEASUREMENT InpPIfcM2M3_quM2 InpPIfcM2M3_quM3 InpPIfcM2M3_uM2 InpPIfcM2M3_uM3 /end OUT_MEASUREMENT
/end FUNCTION
/begin FUNCTION F2420_InpPIfcWake "F2420: Wake up signal recognition"
 /begin OUT_MEASUREMENT InpPIfcWake_bWak1 InpPIfcWake_bWak2 InpPIfcWake_bWakInt InpPIfcWake_bWakPhys InpPIfcWake_qbWak1 InpPIfcWake_qbWak2 InpPIfcWake_qbWakInt InpPIfcWake_qbWakPhys InpPIfcWake_quWak1 InpPIfcWake_quWak2 InpPIfcWake_uWak1 InpPIfcWake_uWak2 /end OUT_MEASUREMENT
/end FUNCTION
/begin FUNCTION F2420_InpPWakL2 "F2420: Wake up signal recognition"
 /begin DEF_CHARACTERISTIC InpPWakL2_bWak1SrcSel_C InpPWakL2_swtPrsWak2_C InpPWakL2_uThresWak_C InpPWakL2_uWak1ThresOn_C /end DEF_CHARACTERISTIC
/end FUNCTION
/begin FUNCTION F2430_InpPTosL2 "F2430: Transmission output speed (Layer2)"
 /begin DEF_CHARACTERISTIC InpPTosL2_fHwDiaMax_C InpPTosL2_fThresHwProt_C InpPTosL2_tiFault_C InpPTosL2_uSplyMin_C /end DEF_CHARACTERISTIC
 /begin OUT_MEASUREMENT InpPTosL2_fEce InpPTosL2_nErrCyclCnt InpPTosL2_stTos InpPTosL2_stTosHwDia InpPTosL2_stTosOld InpPTosL2_tiFault /end OUT_MEASUREMENT
/end FUNCTION
/begin FUNCTION F2430_InpPTosL3 "F2430: Transmission output speed (Layer3)" /begin DEF_CHARACTERISTIC InpPTosL3_tiSSplyDel_C /end DEF_CHARACTERISTIC
 /begin OUT_MEASUREMENT InpPTosL3_stTosFault InpPTosL3_stTosTstCon InpPTosL3_tiSSplyDel /end OUT_MEASUREMENT
/end FUNCTION
/begin FUNCTION F2431_InpPTisL2 "F2431: Transmission input speed (Layer2)"
 /begin DEF_CHARACTERISTIC InpPTisL2_fHwDiaMax_C InpPTisL2_fThresHwProt_C InpPTisL2_tiFault_C InpPTisL2_uSplyMin_C /end DEF_CHARACTERISTIC
 /begin OUT_MEASUREMENT InpPTisL2_fEce InpPTisL2_nErrCyclCnt InpPTisL2_stTis InpPTisL2_stTisHwDia InpPTisL2_stTisOld InpPTisL2_tiFault /end OUT_MEASUREMENT
/end FUNCTION
/begin FUNCTION F2431_InpPTisL3 "F2431: Transmission input speed (Layer3)" /begin DEF_CHARACTERISTIC InpPTisL3_tiSSplyDel_C /end DEF_CHARACTERISTIC
 /begin OUT_MEASUREMENT InpPTisL3_stTisFault InpPTisL3_stTisTstCon InpPTisL3_tiSSplyDel /end OUT_MEASUREMENT
/end FUNCTION
/begin FUNCTION F2440_InpPAtfL2 "F2440: ATF (transmission oil) temperature recognition"
 /begin DEF_CHARACTERISTIC InpPAtfL2_facAtfMax_C InpPAtfL2_facAtfMin_C InpPAtfL2_idxAtfVarCnv_C InpPAtfL2_idxAtfVarDfl_C InpPAtfL2_swtAtfVarErr_C InpPAtfL2_tAtfCnvAbs_C[0] InpPAtfL2_tAtfCnvAbs_C[1] InpPAtfL2_tAtfRepl_C InpPAtfL2_tiAtfErr_C InpPAtfL2_tiAtfIniDel_C InpPAtfL2_uAtfGradMax_C InpPAtfL2_uAtfHiMax_C InpPAtfL2_uAtfHiMin_C InpPAtfL2_uAtfLoMax_C InpPAtfL2_uAtfLoMin_C InpPAtfL2_uAtfSensMax_C InpPAtfL2_uAtfSensMin_C /end DEF_CHARACTERISTIC
 /begin OUT_MEASUREMENT InpPAtfL2_efAtfVarEEP InpPAtfL2_facAtf InpPAtfL2_idxAtfVar InpPAtfL2_idxAtfVarEEP InpPAtfL2_idxAtfVarTab InpPAtfL2_qtAtf InpPAtfL2_stAtf InpPAtfL2_tAtf InpPAtfL2_tiAtfErr InpPAtfL2_tiAtfIniDel InpPAtfL2_uAtfGrad InpPAtfL2_uAtfHi InpPAtfL2_uAtfLo InpPAtfL2_uAtfSens InpPAtfL2_uAtfSensOld InpPAtfL2_yDmy /end OUT_MEASUREMENT
/end FUNCTION
/begin FUNCTION F2440_InpPAtfL3 "F2440: ATF (transmission oil) temperature recognition"
 /begin DEF_CHARACTERISTIC InpPAtfL3_stSubsPtd_C InpPAtfL3_tSubsAtf2Ofs_C InpPAtfL3_tSubsChpOfs_C /end DEF_CHARACTERISTIC
 /begin OUT_MEASUREMENT InpPAtfL3_stAtfFault InpPAtfL3_stAtfTstCon InpPAtfL3_stSubsQualOk InpPAtfL3_stSubsUsd /end OUT_MEASUREMENT
/end FUNCTION
/begin FUNCTION F2440_InpPIfcTemp "F2440: ATF (transmission oil) temperature recognition"
 /begin OUT_MEASUREMENT InpPIfcTemp_qtAtf InpPIfcTemp_qtAtfHw InpPIfcTemp_qtAtfPhys InpPIfcTemp_tAtf InpPIfcTemp_tAtf8 InpPIfcTemp_tAtf8Phys InpPIfcTemp_tAtfHw InpPIfcTemp_tAtfPhys /end OUT_MEASUREMENT
/end FUNCTION
/begin FUNCTION F2442_InpPChipL2 "F2442: Calculation of the CG130 chip temperature (Chp1 = internal sensor)"
 /begin DEF_CHARACTERISTIC InpPChipL2_tChpAdjOfsCal_C InpPChipL2_tChpDigThresHiLoLim_C InpPChipL2_tChpDigThresHiUpLim_C InpPChipL2_tChpDigThresLoLoLim_C InpPChipL2_tChpDigThresLoUpLim_C InpPChipL2_tChpIni_C InpPChipL2_tiChpFault_C InpPChipL2_tiChpIniDel_C InpPChipL2_xChpAdjMulCal_C InpPChipL2_xChpRawMax_C InpPChipL2_xChpRawMin_C /end DEF_CHARACTERISTIC
 /begin OUT_MEASUREMENT InpPChipL2_bChpHw InpPChipL2_idxChpHwVers InpPChipL2_qtChp InpPChipL2_rChp InpPChipL2_rChpOld InpPChipL2_stChp InpPChipL2_stChpOld InpPChipL2_tChp InpPChipL2_tiChpFault InpPChipL2_tiChpIniDel /end OUT_MEASUREMENT
/end FUNCTION
/begin FUNCTION F2442_InpPChipL3 "F2442: Calculation of the CG130 chip temperature (Chp1 = internal sensor)"
 /begin DEF_CHARACTERISTIC InpPChipL3_stSubsPtd_C InpPChipL3_tSubsAtfOfs_C InpPChipL3_tSubsChp2Ofs_C /end DEF_CHARACTERISTIC
 /begin OUT_MEASUREMENT InpPChipL3_stChpFault InpPChipL3_stChpTstCon InpPChipL3_stSubsUsd /end OUT_MEASUREMENT
/end FUNCTION
/begin FUNCTION F2442_InpPIfcChip "F2442: Calculation of the chip temperature"
 /begin OUT_MEASUREMENT InpPIfcChip_qtChp InpPIfcChip_qtChp1 InpPIfcChip_tChp InpPIfcChip_tChp1 InpPIfcChip_tChp18 InpPIfcChip_tChp8 /end OUT_MEASUREMENT
/end FUNCTION
/begin FUNCTION F2443_InpPChp2L2 "F2443: Calculation of the chip temperature 2"
 /begin DEF_CHARACTERISTIC InpPChp2L2_stPtt_C InpPChp2L2_tChp2Ini_C InpPChp2L2_tChp2MidDwn_C InpPChp2L2_tChp2MidUp_C InpPChp2L2_tChp2RawMax_C InpPChp2L2_tChp2RawMin_C InpPChp2L2_tiChp2Fault_C InpPChp2L2_tiChp2IniTo_C InpPChp2L2_xChp2RawIni_C /end DEF_CHARACTERISTIC
 /begin OUT_MEASUREMENT InpPChp2L2_rChp2 InpPChp2L2_rChp2Old InpPChp2L2_stChp2 InpPChp2L2_stChp2Old InpPChp2L2_tiChp2Fault InpPChp2L2_tiChp2IniTo /end OUT_MEASUREMENT
/end FUNCTION
/begin FUNCTION F2443_InpPChp2L3 "F2443: Calculation of the chip temperature 2" /begin OUT_MEASUREMENT InpPChp2L3_stChp2Fault InpPChp2L3_stChp2TstCon /end OUT_MEASUREMENT /end FUNCTION
/begin FUNCTION F2443_InpPIfcChp2 "F2443: Calculation of the chip temperature 2" /begin OUT_MEASUREMENT InpPIfcChp2_qtChp2 InpPIfcChp2_tChp2 InpPIfcChp2_tChp28 /end OUT_MEASUREMENT /end FUNCTION
/begin FUNCTION F2450_InpPIfcPsns "F2450: Position recognition of the position lever (L-Lines)" /begin OUT_MEASUREMENT InpPIfcPsns_bPsns InpPIfcPsns_qbPsns /end OUT_MEASUREMENT /end FUNCTION
/begin FUNCTION F2450_InpPPsnsL2 "F2450: Position recognition of the position lever (L-Lines)"
 /begin DEF_CHARACTERISTIC InpPPsnsL2_ctPsnsIni_C InpPPsnsL2_rPsnsAnaZon_C InpPPsnsL2_rPsnsOnOffThres_C InpPPsnsL2_tiFault_C InpPPsnsL2_uSSplyThres_C /end DEF_CHARACTERISTIC
 /begin OUT_MEASUREMENT InpPPsnsL2_bAna InpPPsnsL2_bAnaCpl InpPPsnsL2_bDig InpPPsnsL2_ctChnIdx InpPPsnsL2_ctPsnsIni InpPPsnsL2_ctRngIdx InpPPsnsL2_qbPsns InpPPsnsL2_rPsnsAna InpPPsnsL2_stPsnsAna InpPPsnsL2_stPsnsAnaErr InpPPsnsL2_stPsnsDFC InpPPsnsL2_stPsnsDig InpPPsnsL2_stPsnsDigChng InpPPsnsL2_stPsnsDigOld InpPPsnsL2_stPsnsPlausErr InpPPsnsL2_stPsnsSt InpPPsnsL2_tiFault /end OUT_MEASUREMENT
/end FUNCTION
/begin FUNCTION F2450_InpPPsnsL3 "F2450: Position recognition of the position lever (L-Lines)" /begin DEF_CHARACTERISTIC InpPPsnsL3_stPsnsChng_C InpPPsnsL3_stPsnsMon_C /end DEF_CHARACTERISTIC
 /begin OUT_MEASUREMENT InpPPsnsL3_bMonCondGen InpPPsnsL3_bPsnsDsmErr InpPPsnsL3_stPsnsAnaOld InpPPsnsL3_stPsnsChngErr InpPPsnsL3_stPsnsDFCOld InpPPsnsL3_stPsnsFault InpPPsnsL3_stPsnsOld InpPPsnsL3_stPsnsTstCon /end OUT_MEASUREMENT
/end FUNCTION
/begin FUNCTION F2510_OutPRstL3 "F2510: This will be called if a sensor reset is necessary"
 /begin DEF_CHARACTERISTIC OutPRstL3_tiHwDly_C OutPRstL3_tiSSplyMinOn_C OutPRstL3_tiSSplyOff_C /end DEF_CHARACTERISTIC
 /begin OUT_MEASUREMENT OutPRstL3_bRst OutPRstL3_sRst OutPRstL3_tiHwDly OutPRstL3_tiSSplyMinOn OutPRstL3_tiSSplyOff /end OUT_MEASUREMENT
/end FUNCTION
/begin RECORD_LAYOUT AblGLKWub_M FNC_VALUES 1 UBYTE COLUMN_DIR DIRECT /end RECORD_LAYOUT
/begin RECORD_LAYOUT AblGLKWuw_M FNC_VALUES 1 UWORD COLUMN_DIR DIRECT /end RECORD_LAYOUT
/begin RECORD_LAYOUT AblGLFKFub_S1 FNC_VALUES 1 UBYTE ROW_DIR DIRECT /end RECORD_LAYOUT
/begin RECORD_LAYOUT AblGLFKFul_S1 FNC_VALUES 1 ULONG ROW_DIR DIRECT /end RECORD_LAYOUT
/begin RECORD_LAYOUT AblGLFKFuw_S1 FNC_VALUES 1 UWORD ROW_DIR DIRECT /end RECORD_LAYOUT
/begin RECORD_LAYOUT AblGLKLuw_S1 FNC_VALUES 3 UWORD COLUMN_DIR DIRECT AXIS_PTS_X 2 UWORD INDEX_INCR DIRECT NO_AXIS_PTS_X 1 UWORD /end RECORD_LAYOUT
/begin RECORD_LAYOUT AblGLKWBr32_S1 FNC_VALUES 1 FLOAT32_IEEE COLUMN_DIR DIRECT /end RECORD_LAYOUT
/begin RECORD_LAYOUT AblGLKWBsw_S1 FNC_VALUES 1 SWORD COLUMN_DIR DIRECT /end RECORD_LAYOUT
/begin RECORD_LAYOUT AblGLKWBub_S1 FNC_VALUES 1 UBYTE COLUMN_DIR DIRECT /end RECORD_LAYOUT
/begin RECORD_LAYOUT AblGLKWBuw_S1 FNC_VALUES 1 UWORD COLUMN_DIR DIRECT /end RECORD_LAYOUT
/begin RECORD_LAYOUT AblGLKWsw_S1 FNC_VALUES 1 SWORD COLUMN_DIR DIRECT /end RECORD_LAYOUT
/begin RECORD_LAYOUT AblGLKWub_S1 FNC_VALUES 1 UBYTE COLUMN_DIR DIRECT /end RECORD_LAYOUT
/begin RECORD_LAYOUT AblGLKWuw_S1 FNC_VALUES 1 UWORD COLUMN_DIR DIRECT /end RECORD_LAYOUT
/end MODULE
/end PROJECT
