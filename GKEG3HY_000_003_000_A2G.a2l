ASAP2_VERSION 1 51
/begin PROJECT _929_929 "Gen2_BMW_System_Supplier_Lib"
/begin HEADER "" VERSION "C_03_03" PROJECT_NO _929_929 /end HEADER
/begin MODULE DIM ""
/begin MOD_COMMON "" BYTE_ORDER MSB_FIRST ALIGNMENT_BYTE 1 ALIGNMENT_WORD 2 ALIGNMENT_LONG 4 ALIGNMENT_FLOAT32_IEEE 4 /end MOD_COMMON
/begin CHARACTERISTIC TAB_ND_PULSAMP_TSF "ND-Schwelle zur Ausgleichsgeraden im Überwachungsfenster (0=K_A, 1=K_B, ...)" CURVE 0x21CD7C tab_si16_S6_S3 1000 UMR_U_MIN_1_1_0_S6_S3 0 1000
 /begin AXIS_DESCR FIX_AXIS iAdaPulzs.kup_puls UMR___1_1_0_S6_S3 6 1 6 FIX_AXIS_PAR_DIST 1 1 6 /end AXIS_DESCR
/end CHARACTERISTIC
/begin CHARACTERISTIC TAB_ND_PULSNEG_TSF "negative ND-Schwelle zur Ausgleichsgeraden im Überwachungsfenster (0=K_A, 1=K_B, ...)" CURVE 0x21CD8C tab_si16_S6_S3 1000 UMR_U_MIN_1_1_0_S6_S3 0 1000
 /begin AXIS_DESCR FIX_AXIS iAdaPulzs.kup_puls UMR___1_1_0_S6_S3 6 1 6 FIX_AXIS_PAR_DIST 1 1 6 /end AXIS_DESCR
/end CHARACTERISTIC
/begin CHARACTERISTIC TAB_ND_PULSPOS_TSF "positive ND-Schwelle zur Ausgleichsgeraden im Überwachungsfenster (0=K_A, 1=K_B, ...)" CURVE 0x21CD9C tab_si16_S6_S3 1000 UMR_U_MIN_1_1_0_S6_S3 0 1000
 /begin AXIS_DESCR FIX_AXIS iAdaPulzs.kup_puls UMR___1_1_0_S6_S3 6 1 6 FIX_AXIS_PAR_DIST 1 1 6 /end AXIS_DESCR
/end CHARACTERISTIC
/begin CHARACTERISTIC TAB_ND_PULSZWNEG_TSF "negative ND-Schwelle fuer Zwangsrueckadaption (0=K_A, 1=K_B, ...)" CURVE 0x21CDAC tab_si16_S6_S3 1000 UMR_U_MIN_1_1_0_S6_S3 0 1000
 /begin AXIS_DESCR FIX_AXIS iAdaPulzs.kup_puls UMR___1_1_0_S6_S3 6 1 6 FIX_AXIS_PAR_DIST 1 1 6 /end AXIS_DESCR
/end CHARACTERISTIC
/begin CHARACTERISTIC TAB_ND_PULSZWPOS_TSF "positive ND-Schwelle fuer Zwangsrueckadaption (0=K_A, 1=K_B, ...)" CURVE 0x21CDBC tab_si16_S6_S3 1000 UMR_U_MIN_1_1_0_S6_S3 0 1000
 /begin AXIS_DESCR FIX_AXIS iAdaPulzs.kup_puls UMR___1_1_0_S6_S3 6 1 6 FIX_AXIS_PAR_DIST 1 1 6 /end AXIS_DESCR
/end CHARACTERISTIC
/begin CHARACTERISTIC TAB_ND_PULSAMP_SEK_TSF "ND-Schwelle zur Ausgleichsgeraden im Überwachungsfenster (0=K_A, 1=K_B, ...)" CURVE 0x21CDCC tab_si16_S6_S3 1000 UMR_U_MIN_1_1_0_S6_S3 0 1000
 /begin AXIS_DESCR FIX_AXIS iAdaPulzs.kup_puls UMR___1_1_0_S6_S3 6 1 6 FIX_AXIS_PAR_DIST 1 1 6 /end AXIS_DESCR
/end CHARACTERISTIC
/begin CHARACTERISTIC TAB_ND_PULSPOS_SEK_TSF "positive ND-Schwelle zur Ausgleichsgeraden im Überwachungsfenster (0=K_A, 1=K_B, ...)" CURVE 0x21CDDC tab_si16_S6_S3 1000 UMR_U_MIN_1_1_0_S6_S3 0 1000
 /begin AXIS_DESCR FIX_AXIS iAdaPulzs.kup_puls UMR___1_1_0_S6_S3 6 1 6 FIX_AXIS_PAR_DIST 1 1 6 /end AXIS_DESCR
/end CHARACTERISTIC
/begin CHARACTERISTIC TAB_ND_PULSNEG_SEK_TSF "negative ND-Schwelle zur Ausgleichsgeraden im Überwachungsfenster (0=K_A, 1=K_B, ...)" CURVE 0x21CDEC tab_si16_S6_S3 1000 UMR_U_MIN_1_1_0_S6_S3 0 1000
 /begin AXIS_DESCR FIX_AXIS iAdaPulzs.kup_puls UMR___1_1_0_S6_S3 6 1 6 FIX_AXIS_PAR_DIST 1 1 6 /end AXIS_DESCR
/end CHARACTERISTIC
/begin CHARACTERISTIC TAB_ND_PULSAMP_PF "ND-Schwelle zur Ausgleichsgeraden im Überwachungsfenster (0=K_A, 1=K_B, ...)" CURVE 0x21CDFC tab_si16_S6_S3 1000 UMR_U_MIN_1_1_0_S6_S3 0 1000
 /begin AXIS_DESCR FIX_AXIS iAdaPulzs.kup_puls UMR___1_1_0_S6_S3 6 1 6 FIX_AXIS_PAR_DIST 1 1 6 /end AXIS_DESCR
/end CHARACTERISTIC
/begin CHARACTERISTIC TAB_ND_PULSNEG_PF "negative ND-Schwelle zur Ausgleichsgeraden im Überwachungsfenster (0=K_A, 1=K_B, ...)" CURVE 0x21CE0C tab_si16_S6_S3 1000 UMR_U_MIN_1_1_0_S6_S3 0 1000
 /begin AXIS_DESCR FIX_AXIS iAdaPulzs.kup_puls UMR___1_1_0_S6_S3 6 1 6 FIX_AXIS_PAR_DIST 1 1 6 /end AXIS_DESCR
/end CHARACTERISTIC
/begin CHARACTERISTIC TAB_ND_PULSPOS_PF "positive ND-Schwelle zur Ausgleichsgeraden im Überwachungsfenster (0=K_A, 1=K_B, ...)" CURVE 0x21CE1C tab_si16_S6_S3 1000 UMR_U_MIN_1_1_0_S6_S3 0 1000
 /begin AXIS_DESCR FIX_AXIS iAdaPulzs.kup_puls UMR___1_1_0_S6_S3 6 1 6 FIX_AXIS_PAR_DIST 1 1 6 /end AXIS_DESCR
/end CHARACTERISTIC
/begin CHARACTERISTIC TAB_ND_PULSZWNEG_PF "negative ND-Schwelle fuer Zwangsrueckadaption (0=K_A, 1=K_B, ...)" CURVE 0x21CE2C tab_si16_S6_S3 1000 UMR_U_MIN_1_1_0_S6_S3 0 1000
 /begin AXIS_DESCR FIX_AXIS iAdaPulzs.kup_puls UMR___1_1_0_S6_S3 6 1 6 FIX_AXIS_PAR_DIST 1 1 6 /end AXIS_DESCR
/end CHARACTERISTIC
/begin CHARACTERISTIC TAB_ND_PULSZWPOS_PF "positive ND-Schwelle fuer Zwangsrueckadaption (0=K_A, 1=K_B, ...)" CURVE 0x21CE3C tab_si16_S6_S3 1000 UMR_U_MIN_1_1_0_S6_S3 0 1000
 /begin AXIS_DESCR FIX_AXIS iAdaPulzs.kup_puls UMR___1_1_0_S6_S3 6 1 6 FIX_AXIS_PAR_DIST 1 1 6 /end AXIS_DESCR
/end CHARACTERISTIC
/begin CHARACTERISTIC TAB_ND_PULSAMP_SEK_PF "ND-Schwelle zur Ausgleichsgeraden im Überwachungsfenster (0=K_A, 1=K_B, ...)" CURVE 0x21CE4C tab_si16_S6_S3 1000 UMR_U_MIN_1_1_0_S6_S3 0 1000
 /begin AXIS_DESCR FIX_AXIS iAdaPulzs.kup_puls UMR___1_1_0_S6_S3 6 1 6 FIX_AXIS_PAR_DIST 1 1 6 /end AXIS_DESCR
/end CHARACTERISTIC
/begin CHARACTERISTIC TAB_ND_PULSPOS_SEK_PF "positive ND-Schwelle zur Ausgleichsgeraden im Überwachungsfenster (0=K_A, 1=K_B, ...)" CURVE 0x21CE5C tab_si16_S6_S3 1000 UMR_U_MIN_1_1_0_S6_S3 0 1000
 /begin AXIS_DESCR FIX_AXIS iAdaPulzs.kup_puls UMR___1_1_0_S6_S3 6 1 6 FIX_AXIS_PAR_DIST 1 1 6 /end AXIS_DESCR
/end CHARACTERISTIC
/begin CHARACTERISTIC TAB_ND_PULSNEG_SEK_PF "negative ND-Schwelle zur Ausgleichsgeraden im Überwachungsfenster (0=K_A, 1=K_B, ...)" CURVE 0x21CE6C tab_si16_S6_S3 1000 UMR_U_MIN_1_1_0_S6_S3 0 1000
 /begin AXIS_DESCR FIX_AXIS iAdaPulzs.kup_puls UMR___1_1_0_S6_S3 6 1 6 FIX_AXIS_PAR_DIST 1 1 6 /end AXIS_DESCR
/end CHARACTERISTIC
/begin CHARACTERISTIC F_TVABBR "Faktor fuer Verbotszeit auf Abfrage ND_ADABBR" VALUE 0x26E461 kw_ui8_S6_S3 99.6078 UMR_PROZENT__20_51_0_S6_S3 0 99.6078431373 /end CHARACTERISTIC
/begin CHARACTERISTIC TAB_HAINCPF "Schrittweite fuer Hochadaption PF-Adaption (0=K_A, 1=K_B, ...)" CURVE 0x21CE7C tab_si16_S6_S3 6 UMR_BAR__1_1000_0_S6_S3 0 6
 /begin AXIS_DESCR FIX_AXIS iAdaPulzs.kup_puls UMR___1_1_0_S6_S3 6 1 6 FIX_AXIS_PAR_DIST 1 1 6 /end AXIS_DESCR
/end CHARACTERISTIC
/begin CHARACTERISTIC P_RAINCPF "Schrittweite fuer Rueckadaption" VALUE 0x26D400 kw_si16_S6_S3 6 UMR_BAR__1_1000_0_S6_S3 -6 0 /end CHARACTERISTIC
/begin CHARACTERISTIC P_ZWPFINC "Schrittweite fuer Zwangsrueckadaption" VALUE 0x26D402 kw_si16_S6_S3 6 UMR_BAR__1_1000_0_S6_S3 -6 0 /end CHARACTERISTIC
/begin CHARACTERISTIC P_RAUEBINCPF "Schrittweite Rueckadaption Ueberpruefgsschleife" VALUE 0x26D404 kw_si16_S6_S3 6 UMR_BAR__1_1000_0_S6_S3 -6 0 /end CHARACTERISTIC
/begin CHARACTERISTIC TAB_POPULSADAGANG "Gangabhängiges Offset auf den Fülldruck" MAP 0x21CE8C tab2d_si16_S6_S3 2 UMR_BAR__1_1000_0_S6_S3 -1 1
 /begin AXIS_DESCR FIX_AXIS iAdaPulzs.kup_puls UMR___1_1_0_S6_S3 6 1 6 FIX_AXIS_PAR_DIST 1 1 6 /end AXIS_DESCR
 /begin AXIS_DESCR FIX_AXIS zff_atsys._.iSignale._.obj.sig_istgang UMR___1_1_0_S6_S3 10 -1 8 FIX_AXIS_PAR_DIST -1 1 10 /end AXIS_DESCR
/end CHARACTERISTIC
/begin CHARACTERISTIC TO_VPFPULS_DITHEROFF "Vorhalt fuer Dither Deaktivierung" VALUE 0x26E462 kw_ui8_S6_S3 1000 UMR_MSEC__10_1_0_S6_S3 0 1000 /end CHARACTERISTIC
/begin CHARACTERISTIC TAB_SWI_DEAKT_DITHER_PULS "Schalter Dither bei Ada deaktivieren" CURVE 0x21CF0C tab_bool8_S6_S3 1 UMR___1_1_0_S6_S3 0 1
 /begin AXIS_DESCR FIX_AXIS iAdaPulzs.kup_puls UMR___1_1_0_S6_S3 6 1 6 FIX_AXIS_PAR_DIST 1 1 6 /end AXIS_DESCR
/end CHARACTERISTIC
/begin CHARACTERISTIC TAB_SWI_STILLSTANDPULS "Schalter zur Aktivierung Grundbedingungen für Stillstandadaption" CURVE 0x21CFA8 tab_bool8_S6_S3 1 UMR___1_1_0_S6_S3 0 1
 /begin AXIS_DESCR FIX_AXIS iAdaPulzs.kup_puls UMR___1_1_0_S6_S3 6 1 6 FIX_AXIS_PAR_DIST 1 1 6 /end AXIS_DESCR
/end CHARACTERISTIC
/begin CHARACTERISTIC SWI_POSPULS "Schalter zur Berücksichtigung der Wahlhebelposition in den Grundbedingungen 0=N, 1=D," VALUE 0x26E4A5 kw_ui8_S6_S3 1 UMR___1_1_0_S6_S3 0 1 /end CHARACTERISTIC
/begin CHARACTERISTIC TAB_SWI_ADPULSEFAHREN "Aktivierung Pulsadaption in Abhängigkeit vom Betriebsmode 0=H/E Faheren,1=E Fahren,2=H Fahren" MAP 0x21CFB4 tab2d_ui8_S6_S3 2 UMR___1_1_0_S6_S3 0 2
 /begin AXIS_DESCR FIX_AXIS iAdaPulzs.kup_puls UMR___1_1_0_S6_S3 6 1 6 FIX_AXIS_PAR_DIST 1 1 6 /end AXIS_DESCR
 /begin AXIS_DESCR FIX_AXIS zff_atsys._.iSignale._.obj.sig_istgang_vorw UMR___1_1_0_S6_S3 9 0 8 FIX_AXIS_PAR_DIST 0 1 9 /end AXIS_DESCR
/end CHARACTERISTIC
/begin CHARACTERISTIC NS_ABPULS "Abtriebsdrehzahlschwelle" VALUE 0x26D47A kw_ui16_S6_S3 1000 UMR_U_MIN_1_1_0_S6_S3 0 1000 /end CHARACTERISTIC
/begin CHARACTERISTIC NS_EMSOLLEERPULS "Mindestdrehzahl E- Maschine" VALUE 0x26D47C kw_ui16_S6_S3 1000 UMR_U_MIN_1_1_0_S6_S3 0 1000 /end CHARACTERISTIC
/begin CHARACTERISTIC NS_HYS_EMSOLLEERPULS "Hys.Mindestdrehzahl E- Maschine" VALUE 0x26D47E kw_ui16_S6_S3 500 UMR_U_MIN_1_1_0_S6_S3 0 500 /end CHARACTERISTIC
/begin CHARACTERISTIC NS_VMPULS "Drehzahlschwelle Verbrennungsmotor" VALUE 0x26D480 kw_ui16_S6_S3 1000 UMR_U_MIN_1_1_0_S6_S3 0 1000 /end CHARACTERISTIC
/begin CHARACTERISTIC TAB_ND_ADABBR "ND-Schwelle fuer Abbruch Befuellpruefung gangabhaengig" CURVE 0x21CFF4 tab_si16_S6_S3 2000 UMR_U_MIN_1_1_0_S6_S3 -1000 1000
 /begin AXIS_DESCR FIX_AXIS zff_atsys._.iSignale._.obj.sig_istgang UMR___1_1_0_S6_S3 10 -1 8 FIX_AXIS_PAR_DIST -1 1 10 /end AXIS_DESCR
/end CHARACTERISTIC
/begin CHARACTERISTIC DKI_ADPULS "Maximale Lastaenderung waehrend Befuellpruefung" VALUE 0x26E4A6 kw_ui8_S6_S3 100 UMR_PROZENT__20_51_0_S6_S3 0 100 /end CHARACTERISTIC
/begin CHARACTERISTIC MT_ADPULS "Maximale m_t-Aenderung waehrend Befuellpruefung" VALUE 0x26D482 kw_si16_S6_S3 2040 UMR_NM__1_1_0_S6_S3 -400 1640 /end CHARACTERISTIC
/begin CHARACTERISTIC KL_NPRUEFZYKL_KBP "Anzahl Pruefdurchlaeufe abhaengig von den Befuellpruefzaehlern" CURVE 0x21D00C kl_ui8_S6_S3 9 UMR___1_1_0_S6_S3 1 10
 /begin AXIS_DESCR STD_AXIS NO_INPUT_QUANTITY UMR___1_1_0_S6_S3 2 0 255 DEPOSIT ABSOLUTE MONOTONY MON_INCREASE /end AXIS_DESCR
/end CHARACTERISTIC
/begin CHARACTERISTIC N_PULSGRENZ "max. Anzahl Pulse pro Pruefzyklus" VALUE 0x26E4A7 kw_ui8_S6_S3 251 UMR___1_1_0_S6_S3 4 255 /end CHARACTERISTIC
/begin CHARACTERISTIC T_VHSUABBRUCH "Verzugszeit für das Beenden der Hochschaltverh. von der Pulsadaption" VALUE 0x26D484 kw_ui16_S6_S3 10000 UMR_MSEC__10_1_0_S6_S3 0 10000 /end CHARACTERISTIC
/begin CHARACTERISTIC T_SPPULS "Maximale Restsperrzeit zum aktivieren der Hochschaltverh. von der Pulsadaption" VALUE 0x26E4A8 kw_ui8_S6_S3 2550 UMR_MSEC__10_1_0_S6_S3 0 2550 /end CHARACTERISTIC
/begin CHARACTERISTIC TAB_NTHSU "Maximale Turbinendrehzahl zum aktivieren der Hochschaltverh. von der Pulsadaption" CURVE 0x21D014 tab_ui16_S6_S3 8200 UMR_U_MIN_1_1_0_S6_S3 0 8200
 /begin AXIS_DESCR FIX_AXIS iAdaPulzs.kup_puls UMR___1_1_0_S6_S3 6 1 6 FIX_AXIS_PAR_DIST 1 1 6 /end AXIS_DESCR
/end CHARACTERISTIC
/begin CHARACTERISTIC N_PULSGRENZSTART "max. Anzahl Pulse pro Pruefzyklus zu Beginn der Getriebelaufzeit" VALUE 0x26E4A9 kw_ui8_S6_S3 255 UMR___1_1_0_S6_S3 0 255 /end CHARACTERISTIC
/begin CHARACTERISTIC TAB_NSTARTWERTE_KPAD "Anzahl der Pruefdurchlaeufe mit erw. Werten" CURVE 0x21D024 tab_ui8_S6_S3 99 UMR___1_1_0_S6_S3 1 100
 /begin AXIS_DESCR FIX_AXIS iAdaPulzs.kup_puls UMR___1_1_0_S6_S3 6 1 6 FIX_AXIS_PAR_DIST 1 1 6 /end AXIS_DESCR
/end CHARACTERISTIC
/begin CHARACTERISTIC FI_ADANEU "Filteranzahl f.Gewichtung des neuen ADA-Werts" VALUE 0x26E4AA kw_ui8_S6_S3 9 UMR___1_1_0_S6_S3 1 10 /end CHARACTERISTIC
/begin CHARACTERISTIC KL_FIADAAKT_NPRUEFZYKL_POS "Filteranzahl f.Gewichtung des alten ADA-Werts bei neg. Abweichung" CURVE 0x21D030 kl_ui8_S6_S3 10 UMR___1_1_0_S6_S3 0 10
 /begin AXIS_DESCR STD_AXIS NO_INPUT_QUANTITY UMR___1_1_0_S6_S3 3 0 255 DEPOSIT ABSOLUTE MONOTONY MON_INCREASE /end AXIS_DESCR
/end CHARACTERISTIC
/begin CHARACTERISTIC KL_FIADAAKT_NPRUEFZYKL_NEG "Filteranzahl f.Gewichtung des alten ADA-Werts bei pos. Abweichung" CURVE 0x21D03C kl_ui8_S6_S3 10 UMR___1_1_0_S6_S3 0 10
 /begin AXIS_DESCR STD_AXIS NO_INPUT_QUANTITY UMR___1_1_0_S6_S3 3 0 255 DEPOSIT ABSOLUTE MONOTONY MON_INCREASE /end AXIS_DESCR
/end CHARACTERISTIC
/begin CHARACTERISTIC T_SPTSFPULS "Sperrzeit nach letzter Schaltung oder Pruefung" VALUE 0x26D486 kw_ui16_S6_S3 25000 UMR_MSEC__10_1_0_S6_S3 0 25000 /end CHARACTERISTIC
/begin CHARACTERISTIC T_SPNACHREAKTION "Sperrzeit fuer Befuellpruefung nach erkannter Reakt bei Puls 1" VALUE 0x26D488 kw_ui16_S6_S3 65000 UMR_MSEC__10_1_0_S6_S3 0 65000 /end CHARACTERISTIC
/begin CHARACTERISTIC T_VPSYSPULS "Wartezeit für Systemdruckanhebung vor Puls" VALUE 0x26E4AB kw_ui8_S6_S3 1000 UMR_MSEC__10_1_0_S6_S3 0 1000 /end CHARACTERISTIC
/begin CHARACTERISTIC TAB_CS_ADPULSOB "Obere c_getr-Schwelle fuer Pulsadapton" CURVE 0x21D048 tab_ui8_S6_S3 190 UMR_GRADC__1_1_M40_S6_S3 -40 150
 /begin AXIS_DESCR FIX_AXIS iAdaPulzs.kup_puls UMR___1_1_0_S6_S3 6 1 6 FIX_AXIS_PAR_DIST 1 1 6 /end AXIS_DESCR
/end CHARACTERISTIC
/begin CHARACTERISTIC CS_ADPULSHYS "Hysterese fuer Chiptemperatur" VALUE 0x26E4AC kw_ui8_S6_S3 50 UMR_GRADC__1_1_0_S6_S3 0 50 /end CHARACTERISTIC
/begin CHARACTERISTIC TAB_SEKKUPPULS_TSF "Tabelle zu pulsende Kupplung Sekundaere-TSF" CURVE 0x21D054 tab_ui8_S6_S3 6 UMR___1_1_0_S6_S3 0 6
 /begin AXIS_DESCR FIX_AXIS zff_atsys._.iSignale._.obj.sig_istgang UMR___1_1_0_S6_S3 10 -1 8 FIX_AXIS_PAR_DIST -1 1 10 /end AXIS_DESCR
/end CHARACTERISTIC
/begin CHARACTERISTIC TAB_SEKKUPPULS_PF "Tabelle zu pulsende Kupplung Sekundaere-PF" CURVE 0x21D064 tab_ui8_S6_S3 6 UMR___1_1_0_S6_S3 0 6
 /begin AXIS_DESCR FIX_AXIS zff_atsys._.iSignale._.obj.sig_istgang UMR___1_1_0_S6_S3 10 -1 8 FIX_AXIS_PAR_DIST -1 1 10 /end AXIS_DESCR
/end CHARACTERISTIC
/begin CHARACTERISTIC TAB_KUPPULS1 "Tabelle zu pulsende Kupplung Prio1" CURVE 0x21D074 tab_ui8_S6_S3 6 UMR___1_1_0_S6_S3 0 6
 /begin AXIS_DESCR FIX_AXIS zff_atsys._.iSignale._.obj.sig_istgang UMR___1_1_0_S6_S3 10 -1 8 FIX_AXIS_PAR_DIST -1 1 10 /end AXIS_DESCR
/end CHARACTERISTIC
/begin CHARACTERISTIC TAB_KUPPULS2 "Tabelle zu pulsende Kupplung Prio2" CURVE 0x21D084 tab_ui8_S6_S3 6 UMR___1_1_0_S6_S3 0 6
 /begin AXIS_DESCR FIX_AXIS zff_atsys._.iSignale._.obj.sig_istgang UMR___1_1_0_S6_S3 10 -1 8 FIX_AXIS_PAR_DIST -1 1 10 /end AXIS_DESCR
/end CHARACTERISTIC
/begin CHARACTERISTIC TAB_SWI_KUPPADA_AE "Kupplungsabhaengige TAB zur Aktivierung der AE Ausblendung" CURVE 0x21D094 tab_bool8_S6_S3 1 UMR___1_1_0_S6_S3 0 1
 /begin AXIS_DESCR FIX_AXIS iAdaPulzs.kup_puls UMR___1_1_0_S6_S3 6 1 6 FIX_AXIS_PAR_DIST 1 1 6 /end AXIS_DESCR
/end CHARACTERISTIC
/begin CHARACTERISTIC T_VDEAK_DAEMPFER_PULS "Vorlauf zur Deaktivierung AE Daempfung" VALUE 0x26E4AD kw_ui8_S6_S3 2540 UMR_MSEC__10_1_0_S6_S3 0 2540 /end CHARACTERISTIC
/begin CHARACTERISTIC SWI_DEAKSD "Aktivieren alternative Daempferdeaktivierung." VALUE 0x26E4AE kw_bool8_S6_S3 1 UMR___1_1_0_S6_S3 0 1 /end CHARACTERISTIC
/begin CHARACTERISTIC T_VZDEAKSD2_UEBERF "Vorlauf zur Deaktivierung AE Daempfung in der Zeit wird nicht wegen NGuete abgebrochen" VALUE 0x26E4AF kw_ui8_S6_S3 2500 UMR_MSEC__10_1_0_S6_S3 0 2500 /end CHARACTERISTIC
/begin CHARACTERISTIC T_VZDEAKSD2_RUH "Zeint in der n_guete ohne Daemper geprueft wird" VALUE 0x26E4B0 kw_ui8_S6_S3 2500 UMR_MSEC__10_1_0_S6_S3 0 2500 /end CHARACTERISTIC
/begin CHARACTERISTIC KF_NMOTMT_ADPULS_K0 "Aktivierungsschwellen Pulsadaption - Lebensdauer" MAP 0x21D0A0 kf_si16_S6_S3 1 UMR___1_1_0_S6_S3 0 1
 /begin AXIS_DESCR STD_AXIS iItfInput.n_mot UMR_U_MIN_1_1_0_S6_S3 8 0 8160 DEPOSIT ABSOLUTE MONOTONY MON_INCREASE /end AXIS_DESCR
 /begin AXIS_DESCR STD_AXIS iItfInput.m_t UMR_NM__1_1_0_S6_S3 8 -400 1640 DEPOSIT ABSOLUTE MONOTONY MON_INCREASE /end AXIS_DESCR
/end CHARACTERISTIC
/begin CHARACTERISTIC TAB_HAINCTSF "Schrittweite fuer Hochadaption TSF-Adaption (0=K_A, 1=K_B, ...)" CURVE 0x21CF18 tab_si16_S6_S3 2000 UMR_MSEC__1_1_0_S6_S3 0 2000
 /begin AXIS_DESCR FIX_AXIS iAdaPulzs.kup_puls UMR___1_1_0_S6_S3 6 1 6 FIX_AXIS_PAR_DIST 1 1 6 /end AXIS_DESCR
/end CHARACTERISTIC
/begin CHARACTERISTIC T_RAINCTSF "Schrittweite fuer Rueckadaption" VALUE 0x26D466 kw_si16_S6_S3 2000 UMR_MSEC__1_1_0_S6_S3 -2000 0 /end CHARACTERISTIC
/begin CHARACTERISTIC T_ZWTSFINC "Schrittweite fuer Zwangsrueckadaption" VALUE 0x26D468 kw_si16_S6_S3 2000 UMR_MSEC__1_1_0_S6_S3 -2000 0 /end CHARACTERISTIC
/begin CHARACTERISTIC T_RAUEBINCTSF "Schrittweite Rueckadaption Ueberpruefschleife" VALUE 0x26D46A kw_si16_S6_S3 2000 UMR_MSEC__1_1_0_S6_S3 -2000 0 /end CHARACTERISTIC
/begin CHARACTERISTIC TAB_TOPULSADAGANG "Gangabhängiges Offset auf die Schnellfüllzeit" MAP 0x21CF28 tab2d_si16_S6_S3 200 UMR_MSEC__1_1_0_S6_S3 -100 100
 /begin AXIS_DESCR FIX_AXIS iAdaPulzs.kup_puls UMR___1_1_0_S6_S3 6 1 6 FIX_AXIS_PAR_DIST 1 1 6 /end AXIS_DESCR
 /begin AXIS_DESCR FIX_AXIS zff_atsys._.iSignale._.obj.sig_istgang UMR___1_1_0_S6_S3 10 -1 8 FIX_AXIS_PAR_DIST -1 1 10 /end AXIS_DESCR
/end CHARACTERISTIC
/begin CHARACTERISTIC TO_SFRED_K0 "Offset zur TSF Reduktion während PF Prüfpuls" VALUE 0x26D46C kw_si16_S6_S3 2000 UMR_MSEC__1_1_0_S6_S3 -1000 1000 /end CHARACTERISTIC
/begin CHARACTERISTIC KL_CS_PFADPULSUN_A "minimale Temp. Grenze fuer PF- Pulsada abhaenig BPZ" CURVE 0x21D148 kl_ui16_S6_S3 190 UMR_GRADC__1_1_M40_S6_S3 -40 150
 /begin AXIS_DESCR STD_AXIS NO_INPUT_QUANTITY UMR___1_1_0_S6_S3 3 0 65535 DEPOSIT ABSOLUTE MONOTONY MON_INCREASE /end AXIS_DESCR
/end CHARACTERISTIC
/begin CHARACTERISTIC KL_CS_TSFADPULSUN_A "minimale Temp. Grenze fuer TSF- Pulsada abhaenig BPZ" CURVE 0x21D158 kl_ui16_S6_S3 190 UMR_GRADC__1_1_M40_S6_S3 -40 150
 /begin AXIS_DESCR STD_AXIS NO_INPUT_QUANTITY UMR___1_1_0_S6_S3 3 0 65535 DEPOSIT ABSOLUTE MONOTONY MON_INCREASE /end AXIS_DESCR
/end CHARACTERISTIC
/begin CHARACTERISTIC KF_NTMT_ADPULS_A "Aktivierungsschwellen Pulsadaption - Lebensdauer" MAP 0x21D168 kf_si16_S6_S3 1 UMR___1_1_0_S6_S3 0 1
 /begin AXIS_DESCR STD_AXIS iItfInput.n_t UMR_U_MIN_1_1_0_S6_S3 8 0 8160 DEPOSIT ABSOLUTE MONOTONY MON_INCREASE /end AXIS_DESCR
 /begin AXIS_DESCR STD_AXIS iItfInput.m_t UMR_NM__1_1_0_S6_S3 8 -400 1640 DEPOSIT ABSOLUTE MONOTONY MON_INCREASE /end AXIS_DESCR
/end CHARACTERISTIC
/begin CHARACTERISTIC KF_NTMT_ADPULS_A_EL "Aktivierungsschwellen Pulsadaption - Lebensdauer" MAP 0x21D210 kf_si16_S6_S3 1 UMR___1_1_0_S6_S3 0 1
 /begin AXIS_DESCR STD_AXIS iItfInput.n_t UMR_U_MIN_1_1_0_S6_S3 8 0 8160 DEPOSIT ABSOLUTE MONOTONY MON_INCREASE /end AXIS_DESCR
 /begin AXIS_DESCR STD_AXIS iItfInput.m_t UMR_NM__1_1_0_S6_S3 8 -400 1640 DEPOSIT ABSOLUTE MONOTONY MON_INCREASE /end AXIS_DESCR
/end CHARACTERISTIC
/begin CHARACTERISTIC KF_NTMT_ADPULS_SEK_A "Aktivierungsschwellen Pulsadaption - Sekundearadaption" MAP 0x21D2B8 kf_si16_S6_S3 1 UMR___1_1_0_S6_S3 0 1
 /begin AXIS_DESCR STD_AXIS iItfInput.n_t UMR_U_MIN_1_1_0_S6_S3 8 0 8160 DEPOSIT ABSOLUTE MONOTONY MON_INCREASE /end AXIS_DESCR
 /begin AXIS_DESCR STD_AXIS iItfInput.m_t UMR_NM__1_1_0_S6_S3 8 -400 1640 DEPOSIT ABSOLUTE MONOTONY MON_INCREASE /end AXIS_DESCR
/end CHARACTERISTIC
/begin CHARACTERISTIC KF_NTMT_ADPULS_SEK_A_EL "Aktivierungsschwellen Pulsadaption - Sekundearadaption" MAP 0x21D360 kf_si16_S6_S3 1 UMR___1_1_0_S6_S3 0 1
 /begin AXIS_DESCR STD_AXIS iItfInput.n_t UMR_U_MIN_1_1_0_S6_S3 8 0 8160 DEPOSIT ABSOLUTE MONOTONY MON_INCREASE /end AXIS_DESCR
 /begin AXIS_DESCR STD_AXIS iItfInput.m_t UMR_NM__1_1_0_S6_S3 8 -400 1640 DEPOSIT ABSOLUTE MONOTONY MON_INCREASE /end AXIS_DESCR
/end CHARACTERISTIC
/begin CHARACTERISTIC KL_CS_PFADPULSUN_B "minimale Temp. Grenze fuer PF- Pulsada abhaenig BPZ" CURVE 0x21D408 kl_ui16_S6_S3 190 UMR_GRADC__1_1_M40_S6_S3 -40 150
 /begin AXIS_DESCR STD_AXIS NO_INPUT_QUANTITY UMR___1_1_0_S6_S3 3 0 65535 DEPOSIT ABSOLUTE MONOTONY MON_INCREASE /end AXIS_DESCR
/end CHARACTERISTIC
/begin CHARACTERISTIC KL_CS_TSFADPULSUN_B "minimale Temp. Grenze fuer TSF- Pulsada abhaenig BPZ" CURVE 0x21D418 kl_ui16_S6_S3 190 UMR_GRADC__1_1_M40_S6_S3 -40 150
 /begin AXIS_DESCR STD_AXIS NO_INPUT_QUANTITY UMR___1_1_0_S6_S3 3 0 65535 DEPOSIT ABSOLUTE MONOTONY MON_INCREASE /end AXIS_DESCR
/end CHARACTERISTIC
/begin CHARACTERISTIC KF_NTMT_ADPULS_B "Aktivierungsschwellen Pulsadaption - Lebensdauer" MAP 0x21D428 kf_si16_S6_S3 1 UMR___1_1_0_S6_S3 0 1
 /begin AXIS_DESCR STD_AXIS iItfInput.n_t UMR_U_MIN_1_1_0_S6_S3 8 0 8160 DEPOSIT ABSOLUTE MONOTONY MON_INCREASE /end AXIS_DESCR
 /begin AXIS_DESCR STD_AXIS iItfInput.m_t UMR_NM__1_1_0_S6_S3 8 -400 1640 DEPOSIT ABSOLUTE MONOTONY MON_INCREASE /end AXIS_DESCR
/end CHARACTERISTIC
/begin CHARACTERISTIC KF_NTMT_ADPULS_B_EL "Aktivierungsschwellen Pulsadaption - Lebensdauer" MAP 0x21D4D0 kf_si16_S6_S3 1 UMR___1_1_0_S6_S3 0 1
 /begin AXIS_DESCR STD_AXIS iItfInput.n_t UMR_U_MIN_1_1_0_S6_S3 8 0 8160 DEPOSIT ABSOLUTE MONOTONY MON_INCREASE /end AXIS_DESCR
 /begin AXIS_DESCR STD_AXIS iItfInput.m_t UMR_NM__1_1_0_S6_S3 8 -400 1640 DEPOSIT ABSOLUTE MONOTONY MON_INCREASE /end AXIS_DESCR
/end CHARACTERISTIC
/begin CHARACTERISTIC KF_NTMT_ADPULS_SEK_B "Aktivierungsschwellen Pulsadaption - Sekundearadaption" MAP 0x21D578 kf_si16_S6_S3 1 UMR___1_1_0_S6_S3 0 1
 /begin AXIS_DESCR STD_AXIS iItfInput.n_t UMR_U_MIN_1_1_0_S6_S3 8 0 8160 DEPOSIT ABSOLUTE MONOTONY MON_INCREASE /end AXIS_DESCR
 /begin AXIS_DESCR STD_AXIS iItfInput.m_t UMR_NM__1_1_0_S6_S3 8 -400 1640 DEPOSIT ABSOLUTE MONOTONY MON_INCREASE /end AXIS_DESCR
/end CHARACTERISTIC
/begin CHARACTERISTIC KF_NTMT_ADPULS_SEK_B_EL "Aktivierungsschwellen Pulsadaption - Sekundearadaption" MAP 0x21D620 kf_si16_S6_S3 1 UMR___1_1_0_S6_S3 0 1
 /begin AXIS_DESCR STD_AXIS iItfInput.n_t UMR_U_MIN_1_1_0_S6_S3 8 0 8160 DEPOSIT ABSOLUTE MONOTONY MON_INCREASE /end AXIS_DESCR
 /begin AXIS_DESCR STD_AXIS iItfInput.m_t UMR_NM__1_1_0_S6_S3 8 -400 1640 DEPOSIT ABSOLUTE MONOTONY MON_INCREASE /end AXIS_DESCR
/end CHARACTERISTIC
/begin CHARACTERISTIC KL_CS_PFADPULSUN_C "minimale Temp. Grenze fuer PF- Pulsada abhaenig BPZ" CURVE 0x21D6C8 kl_ui16_S6_S3 190 UMR_GRADC__1_1_M40_S6_S3 -40 150
 /begin AXIS_DESCR STD_AXIS NO_INPUT_QUANTITY UMR___1_1_0_S6_S3 3 0 65535 DEPOSIT ABSOLUTE MONOTONY MON_INCREASE /end AXIS_DESCR
/end CHARACTERISTIC
/begin CHARACTERISTIC KL_CS_TSFADPULSUN_C "minimale Temp. Grenze fuer TSF- Pulsada abhaenig BPZ" CURVE 0x21D6D8 kl_ui16_S6_S3 190 UMR_GRADC__1_1_M40_S6_S3 -40 150
 /begin AXIS_DESCR STD_AXIS NO_INPUT_QUANTITY UMR___1_1_0_S6_S3 3 0 65535 DEPOSIT ABSOLUTE MONOTONY MON_INCREASE /end AXIS_DESCR
/end CHARACTERISTIC
/begin CHARACTERISTIC KF_NTMT_ADPULS_C "Aktivierungsschwellen Pulsadaption - Lebensdauer" MAP 0x21D6E8 kf_si16_S6_S3 1 UMR___1_1_0_S6_S3 0 1
 /begin AXIS_DESCR STD_AXIS iItfInput.n_t UMR_U_MIN_1_1_0_S6_S3 8 0 8160 DEPOSIT ABSOLUTE MONOTONY MON_INCREASE /end AXIS_DESCR
 /begin AXIS_DESCR STD_AXIS iItfInput.m_t UMR_NM__1_1_0_S6_S3 8 -400 1640 DEPOSIT ABSOLUTE MONOTONY MON_INCREASE /end AXIS_DESCR
/end CHARACTERISTIC
/begin CHARACTERISTIC KF_NTMT_ADPULS_C_EL "Aktivierungsschwellen Pulsadaption - Lebensdauer" MAP 0x21D790 kf_si16_S6_S3 1 UMR___1_1_0_S6_S3 0 1
 /begin AXIS_DESCR STD_AXIS iItfInput.n_t UMR_U_MIN_1_1_0_S6_S3 8 0 8160 DEPOSIT ABSOLUTE MONOTONY MON_INCREASE /end AXIS_DESCR
 /begin AXIS_DESCR STD_AXIS iItfInput.m_t UMR_NM__1_1_0_S6_S3 8 -400 1640 DEPOSIT ABSOLUTE MONOTONY MON_INCREASE /end AXIS_DESCR
/end CHARACTERISTIC
/begin CHARACTERISTIC KF_NTMT_ADPULS_SEK_C "Aktivierungsschwellen Pulsadaption - Sekundearadaption" MAP 0x21D838 kf_si16_S6_S3 1 UMR___1_1_0_S6_S3 0 1
 /begin AXIS_DESCR STD_AXIS iItfInput.n_t UMR_U_MIN_1_1_0_S6_S3 8 0 8160 DEPOSIT ABSOLUTE MONOTONY MON_INCREASE /end AXIS_DESCR
 /begin AXIS_DESCR STD_AXIS iItfInput.m_t UMR_NM__1_1_0_S6_S3 8 -400 1640 DEPOSIT ABSOLUTE MONOTONY MON_INCREASE /end AXIS_DESCR
/end CHARACTERISTIC
/begin CHARACTERISTIC KF_NTMT_ADPULS_SEK_C_EL "Aktivierungsschwellen Pulsadaption - Sekundearadaption" MAP 0x21D8E0 kf_si16_S6_S3 1 UMR___1_1_0_S6_S3 0 1
 /begin AXIS_DESCR STD_AXIS iItfInput.n_t UMR_U_MIN_1_1_0_S6_S3 8 0 8160 DEPOSIT ABSOLUTE MONOTONY MON_INCREASE /end AXIS_DESCR
 /begin AXIS_DESCR STD_AXIS iItfInput.m_t UMR_NM__1_1_0_S6_S3 8 -400 1640 DEPOSIT ABSOLUTE MONOTONY MON_INCREASE /end AXIS_DESCR
/end CHARACTERISTIC
/begin CHARACTERISTIC KL_CS_PFADPULSUN_D "minimale Temp. Grenze fuer PF- Pulsada abhaenig BPZ" CURVE 0x21D988 kl_ui16_S6_S3 190 UMR_GRADC__1_1_M40_S6_S3 -40 150
 /begin AXIS_DESCR STD_AXIS NO_INPUT_QUANTITY UMR___1_1_0_S6_S3 3 0 65535 DEPOSIT ABSOLUTE MONOTONY MON_INCREASE /end AXIS_DESCR
/end CHARACTERISTIC
/begin CHARACTERISTIC KL_CS_TSFADPULSUN_D "minimale Temp. Grenze fuer TSF- Pulsada abhaenig BPZ" CURVE 0x21D998 kl_ui16_S6_S3 190 UMR_GRADC__1_1_M40_S6_S3 -40 150
 /begin AXIS_DESCR STD_AXIS NO_INPUT_QUANTITY UMR___1_1_0_S6_S3 3 0 65535 DEPOSIT ABSOLUTE MONOTONY MON_INCREASE /end AXIS_DESCR
/end CHARACTERISTIC
/begin CHARACTERISTIC KF_NTMT_ADPULS_D "Aktivierungsschwellen Pulsadaption - Lebensdauer" MAP 0x21D9A8 kf_si16_S6_S3 1 UMR___1_1_0_S6_S3 0 1
 /begin AXIS_DESCR STD_AXIS iItfInput.n_t UMR_U_MIN_1_1_0_S6_S3 8 0 8160 DEPOSIT ABSOLUTE MONOTONY MON_INCREASE /end AXIS_DESCR
 /begin AXIS_DESCR STD_AXIS iItfInput.m_t UMR_NM__1_1_0_S6_S3 8 -400 1640 DEPOSIT ABSOLUTE MONOTONY MON_INCREASE /end AXIS_DESCR
/end CHARACTERISTIC
/begin CHARACTERISTIC KF_NTMT_ADPULS_D_EL "Aktivierungsschwellen Pulsadaption - Lebensdauer" MAP 0x21DA50 kf_si16_S6_S3 1 UMR___1_1_0_S6_S3 0 1
 /begin AXIS_DESCR STD_AXIS iItfInput.n_t UMR_U_MIN_1_1_0_S6_S3 8 0 8160 DEPOSIT ABSOLUTE MONOTONY MON_INCREASE /end AXIS_DESCR
 /begin AXIS_DESCR STD_AXIS iItfInput.m_t UMR_NM__1_1_0_S6_S3 8 -400 1640 DEPOSIT ABSOLUTE MONOTONY MON_INCREASE /end AXIS_DESCR
/end CHARACTERISTIC
/begin CHARACTERISTIC KF_NTMT_ADPULS_SEK_D "Aktivierungsschwellen Pulsadaption - Sekundearadaption" MAP 0x21DAF8 kf_si16_S6_S3 1 UMR___1_1_0_S6_S3 0 1
 /begin AXIS_DESCR STD_AXIS iItfInput.n_t UMR_U_MIN_1_1_0_S6_S3 8 0 8160 DEPOSIT ABSOLUTE MONOTONY MON_INCREASE /end AXIS_DESCR
 /begin AXIS_DESCR STD_AXIS iItfInput.m_t UMR_NM__1_1_0_S6_S3 8 -400 1640 DEPOSIT ABSOLUTE MONOTONY MON_INCREASE /end AXIS_DESCR
/end CHARACTERISTIC
/begin CHARACTERISTIC KF_NTMT_ADPULS_SEK_D_EL "Aktivierungsschwellen Pulsadaption - Sekundearadaption" MAP 0x21DBA0 kf_si16_S6_S3 1 UMR___1_1_0_S6_S3 0 1
 /begin AXIS_DESCR STD_AXIS iItfInput.n_t UMR_U_MIN_1_1_0_S6_S3 8 0 8160 DEPOSIT ABSOLUTE MONOTONY MON_INCREASE /end AXIS_DESCR
 /begin AXIS_DESCR STD_AXIS iItfInput.m_t UMR_NM__1_1_0_S6_S3 8 -400 1640 DEPOSIT ABSOLUTE MONOTONY MON_INCREASE /end AXIS_DESCR
/end CHARACTERISTIC
/begin CHARACTERISTIC KL_CS_PFADPULSUN_E "minimale Temp. Grenze fuer PF- Pulsada abhaenig BPZ" CURVE 0x21DC48 kl_ui16_S6_S3 190 UMR_GRADC__1_1_M40_S6_S3 -40 150
 /begin AXIS_DESCR STD_AXIS NO_INPUT_QUANTITY UMR___1_1_0_S6_S3 3 0 65535 DEPOSIT ABSOLUTE MONOTONY MON_INCREASE /end AXIS_DESCR
/end CHARACTERISTIC
/begin CHARACTERISTIC KL_CS_TSFADPULSUN_E "minimale Temp. Grenze fuer TSF- Pulsada abhaenig BPZ" CURVE 0x21DC58 kl_ui16_S6_S3 190 UMR_GRADC__1_1_M40_S6_S3 -40 150
 /begin AXIS_DESCR STD_AXIS NO_INPUT_QUANTITY UMR___1_1_0_S6_S3 3 0 65535 DEPOSIT ABSOLUTE MONOTONY MON_INCREASE /end AXIS_DESCR
/end CHARACTERISTIC
/begin CHARACTERISTIC KF_NTMT_ADPULS_E "Aktivierungsschwellen Pulsadaption - Lebensdauer" MAP 0x21DC68 kf_si16_S6_S3 1 UMR___1_1_0_S6_S3 0 1
 /begin AXIS_DESCR STD_AXIS iItfInput.n_t UMR_U_MIN_1_1_0_S6_S3 8 0 8160 DEPOSIT ABSOLUTE MONOTONY MON_INCREASE /end AXIS_DESCR
 /begin AXIS_DESCR STD_AXIS iItfInput.m_t UMR_NM__1_1_0_S6_S3 8 -400 1640 DEPOSIT ABSOLUTE MONOTONY MON_INCREASE /end AXIS_DESCR
/end CHARACTERISTIC
/begin CHARACTERISTIC KF_NTMT_ADPULS_E_EL "Aktivierungsschwellen Pulsadaption - Lebensdauer" MAP 0x21DD10 kf_si16_S6_S3 1 UMR___1_1_0_S6_S3 0 1
 /begin AXIS_DESCR STD_AXIS iItfInput.n_t UMR_U_MIN_1_1_0_S6_S3 8 0 8160 DEPOSIT ABSOLUTE MONOTONY MON_INCREASE /end AXIS_DESCR
 /begin AXIS_DESCR STD_AXIS iItfInput.m_t UMR_NM__1_1_0_S6_S3 8 -400 1640 DEPOSIT ABSOLUTE MONOTONY MON_INCREASE /end AXIS_DESCR
/end CHARACTERISTIC
/begin CHARACTERISTIC KF_NTMT_ADPULS_SEK_E "Aktivierungsschwellen Pulsadaption - Sekundearadaption" MAP 0x21DDB8 kf_si16_S6_S3 1 UMR___1_1_0_S6_S3 0 1
 /begin AXIS_DESCR STD_AXIS iItfInput.n_t UMR_U_MIN_1_1_0_S6_S3 8 0 8160 DEPOSIT ABSOLUTE MONOTONY MON_INCREASE /end AXIS_DESCR
 /begin AXIS_DESCR STD_AXIS iItfInput.m_t UMR_NM__1_1_0_S6_S3 8 -400 1640 DEPOSIT ABSOLUTE MONOTONY MON_INCREASE /end AXIS_DESCR
/end CHARACTERISTIC
/begin CHARACTERISTIC KF_NTMT_ADPULS_SEK_E_EL "Aktivierungsschwellen Pulsadaption - Sekundearadaption" MAP 0x21DE60 kf_si16_S6_S3 1 UMR___1_1_0_S6_S3 0 1
 /begin AXIS_DESCR STD_AXIS iItfInput.n_t UMR_U_MIN_1_1_0_S6_S3 8 0 8160 DEPOSIT ABSOLUTE MONOTONY MON_INCREASE /end AXIS_DESCR
 /begin AXIS_DESCR STD_AXIS iItfInput.m_t UMR_NM__1_1_0_S6_S3 8 -400 1640 DEPOSIT ABSOLUTE MONOTONY MON_INCREASE /end AXIS_DESCR
/end CHARACTERISTIC
/begin CHARACTERISTIC KL_CS_PFADPULSUN_K0 "minimale Temp. Grenze fuer PF- Pulsada abhaenig BPZ" CURVE 0x21DF08 kl_ui16_S6_S3 190 UMR_GRADC__1_1_M40_S6_S3 -40 150
 /begin AXIS_DESCR STD_AXIS NO_INPUT_QUANTITY UMR___1_1_0_S6_S3 3 0 65535 DEPOSIT ABSOLUTE MONOTONY MON_INCREASE /end AXIS_DESCR
/end CHARACTERISTIC
/begin CHARACTERISTIC KL_CS_TSFADPULSUN_K0 "minimale Temp. Grenze fuer TSF- Pulsada abhaenig BPZ" CURVE 0x21DF18 kl_ui16_S6_S3 190 UMR_GRADC__1_1_M40_S6_S3 -40 150
 /begin AXIS_DESCR STD_AXIS NO_INPUT_QUANTITY UMR___1_1_0_S6_S3 3 0 65535 DEPOSIT ABSOLUTE MONOTONY MON_INCREASE /end AXIS_DESCR
/end CHARACTERISTIC
/begin CHARACTERISTIC KF_NTMT_ADPULS_K0 "Aktivierungsschwellen Pulsadaption - Lebensdauer" MAP 0x21DF28 kf_si16_S6_S3 1 UMR___1_1_0_S6_S3 0 1
 /begin AXIS_DESCR STD_AXIS iItfInput.n_t UMR_U_MIN_1_1_0_S6_S3 8 0 8160 DEPOSIT ABSOLUTE MONOTONY MON_INCREASE /end AXIS_DESCR
 /begin AXIS_DESCR STD_AXIS iItfInput.m_t UMR_NM__1_1_0_S6_S3 8 -400 1640 DEPOSIT ABSOLUTE MONOTONY MON_INCREASE /end AXIS_DESCR
/end CHARACTERISTIC
/begin CHARACTERISTIC KF_NTMT_ADPULS_SEK_K0 "Aktivierungsschwellen Pulsadaption - Sekundearadaption" MAP 0x21DFD0 kf_si16_S6_S3 1 UMR___1_1_0_S6_S3 0 1
 /begin AXIS_DESCR STD_AXIS iItfInput.n_t UMR_U_MIN_1_1_0_S6_S3 8 0 8160 DEPOSIT ABSOLUTE MONOTONY MON_INCREASE /end AXIS_DESCR
 /begin AXIS_DESCR STD_AXIS iItfInput.m_t UMR_NM__1_1_0_S6_S3 8 -400 1640 DEPOSIT ABSOLUTE MONOTONY MON_INCREASE /end AXIS_DESCR
/end CHARACTERISTIC
/begin CHARACTERISTIC PO_FVORADA_A "Offset auf PF-Puls bei 1.Puls" VALUE 0x26D406 kw_si16_S6_S3 12 UMR_BAR__1_1000_0_S6_S3 -6 6 /end CHARACTERISTIC
/begin CHARACTERISTIC PO_FVORADASTART_A "Offset auf PF-Puls bei 1.Puls zu Beginn der Getriebelaufzeit" VALUE 0x26D408 kw_si16_S6_S3 12 UMR_BAR__1_1000_0_S6_S3 -6 6 /end CHARACTERISTIC
/begin CHARACTERISTIC PO_FNACHADA_A "Offset auf Zwischenspeicher vor Eintrag in Adaspeicher" VALUE 0x26D40A kw_si16_S6_S3 12 UMR_BAR__1_1000_0_S6_S3 -6 6 /end CHARACTERISTIC
/begin CHARACTERISTIC T_PFPULS_A "Pulsdauer PF-Puls" VALUE 0x26D40C kw_ui16_S6_S3 2500 UMR_MSEC__10_1_0_S6_S3 0 2500 /end CHARACTERISTIC
/begin CHARACTERISTIC T_PFPULS_SEK_A "Pulsdauer PF-Puls bei aktiver SEK Adaption" VALUE 0x26D40E kw_ui16_S6_S3 2500 UMR_MSEC__10_1_0_S6_S3 0 2500 /end CHARACTERISTIC
/begin CHARACTERISTIC T_VPFPULS_A "Verzoegerungszeit fuer PF-Puls" VALUE 0x26D410 kw_ui16_S6_S3 2500 UMR_MSEC__10_1_0_S6_S3 0 2500 /end CHARACTERISTIC
/begin CHARACTERISTIC P_PFPULS_A "Pulshoehe PF-Puls" VALUE 0x26D412 kw_si16_S6_S3 6 UMR_BAR__1_1000_0_S6_S3 0 6 /end CHARACTERISTIC
/begin CHARACTERISTIC P_PFPULS_SEK_A "Pulshoehe PF-Puls bei aktiver SEK Adaption" VALUE 0x26D414 kw_si16_S6_S3 6 UMR_BAR__1_1000_0_S6_S3 0 6 /end CHARACTERISTIC
/begin CHARACTERISTIC T_UEBEWNEGBPF_A "Start negatives Ueberwachungsfenster" VALUE 0x26E463 kw_ui8_S6_S3 2500 UMR_MSEC__10_1_0_S6_S3 0 2500 /end CHARACTERISTIC
/begin CHARACTERISTIC T_UEBEWNEGEPF_A "Ende negatives Ueberwachungsfenster" VALUE 0x26E464 kw_ui8_S6_S3 2500 UMR_MSEC__10_1_0_S6_S3 0 2500 /end CHARACTERISTIC
/begin CHARACTERISTIC T_UEBEWPOSBPF_A "Start positives Ueberwachungsfenster" VALUE 0x26E465 kw_ui8_S6_S3 2500 UMR_MSEC__10_1_0_S6_S3 0 2500 /end CHARACTERISTIC
/begin CHARACTERISTIC T_UEBEWPOSEPF_A "Ende positives Ueberwachungsfenster" VALUE 0x26E466 kw_ui8_S6_S3 2500 UMR_MSEC__10_1_0_S6_S3 0 2500 /end CHARACTERISTIC
/begin CHARACTERISTIC T_UEAMPPF_A "Zeitfenster f.Erkennung Amplitude" VALUE 0x26E467 kw_ui8_S6_S3 2500 UMR_MSEC__10_1_0_S6_S3 0 2500 /end CHARACTERISTIC
/begin CHARACTERISTIC PO_FVORADA_B "Offset auf PF-Puls bei 1.Puls" VALUE 0x26D416 kw_si16_S6_S3 12 UMR_BAR__1_1000_0_S6_S3 -6 6 /end CHARACTERISTIC
/begin CHARACTERISTIC PO_FVORADASTART_B "Offset auf PF-Puls bei 1.Puls zu Beginn der Getriebelaufzeit" VALUE 0x26D418 kw_si16_S6_S3 12 UMR_BAR__1_1000_0_S6_S3 -6 6 /end CHARACTERISTIC
/begin CHARACTERISTIC PO_FNACHADA_B "Offset auf Zwischenspeicher vor Eintrag in Adaspeicher" VALUE 0x26D41A kw_si16_S6_S3 12 UMR_BAR__1_1000_0_S6_S3 -6 6 /end CHARACTERISTIC
/begin CHARACTERISTIC T_PFPULS_B "Pulsdauer PF-Puls" VALUE 0x26D41C kw_ui16_S6_S3 2500 UMR_MSEC__10_1_0_S6_S3 0 2500 /end CHARACTERISTIC
/begin CHARACTERISTIC T_PFPULS_SEK_B "Pulsdauer PF-Puls bei aktiver SEK Adaption" VALUE 0x26D41E kw_ui16_S6_S3 2500 UMR_MSEC__10_1_0_S6_S3 0 2500 /end CHARACTERISTIC
/begin CHARACTERISTIC T_VPFPULS_B "Verzoegerungszeit fuer PF-Puls" VALUE 0x26D420 kw_ui16_S6_S3 2500 UMR_MSEC__10_1_0_S6_S3 0 2500 /end CHARACTERISTIC
/begin CHARACTERISTIC P_PFPULS_B "Pulshoehe PF-Puls" VALUE 0x26D422 kw_si16_S6_S3 6 UMR_BAR__1_1000_0_S6_S3 0 6 /end CHARACTERISTIC
/begin CHARACTERISTIC P_PFPULS_SEK_B "Pulshoehe PF-Puls bei aktiver SEK Adaption" VALUE 0x26D424 kw_si16_S6_S3 6 UMR_BAR__1_1000_0_S6_S3 0 6 /end CHARACTERISTIC
/begin CHARACTERISTIC T_UEBEWNEGBPF_B "Start negatives Ueberwachungsfenster" VALUE 0x26E468 kw_ui8_S6_S3 2500 UMR_MSEC__10_1_0_S6_S3 0 2500 /end CHARACTERISTIC
/begin CHARACTERISTIC T_UEBEWNEGEPF_B "Ende negatives Ueberwachungsfenster" VALUE 0x26E469 kw_ui8_S6_S3 2500 UMR_MSEC__10_1_0_S6_S3 0 2500 /end CHARACTERISTIC
/begin CHARACTERISTIC T_UEBEWPOSBPF_B "Start positives Ueberwachungsfenster" VALUE 0x26E46A kw_ui8_S6_S3 2500 UMR_MSEC__10_1_0_S6_S3 0 2500 /end CHARACTERISTIC
/begin CHARACTERISTIC T_UEBEWPOSEPF_B "Ende positives Ueberwachungsfenster" VALUE 0x26E46B kw_ui8_S6_S3 2500 UMR_MSEC__10_1_0_S6_S3 0 2500 /end CHARACTERISTIC
/begin CHARACTERISTIC T_UEAMPPF_B "Zeitfenster f.Erkennung Amplitude" VALUE 0x26E46C kw_ui8_S6_S3 2500 UMR_MSEC__10_1_0_S6_S3 0 2500 /end CHARACTERISTIC
/begin CHARACTERISTIC PO_FVORADA_C "Offset auf PF-Puls bei 1.Puls" VALUE 0x26D426 kw_si16_S6_S3 12 UMR_BAR__1_1000_0_S6_S3 -6 6 /end CHARACTERISTIC
/begin CHARACTERISTIC PO_FVORADASTART_C "Offset auf PF-Puls bei 1.Puls zu Beginn der Getriebelaufzeit" VALUE 0x26D428 kw_si16_S6_S3 12 UMR_BAR__1_1000_0_S6_S3 -6 6 /end CHARACTERISTIC
/begin CHARACTERISTIC PO_FNACHADA_C "Offset auf Zwischenspeicher vor Eintrag in Adaspeicher" VALUE 0x26D42A kw_si16_S6_S3 12 UMR_BAR__1_1000_0_S6_S3 -6 6 /end CHARACTERISTIC
/begin CHARACTERISTIC T_PFPULS_C "Pulsdauer PF-Puls" VALUE 0x26D42C kw_ui16_S6_S3 2500 UMR_MSEC__10_1_0_S6_S3 0 2500 /end CHARACTERISTIC
/begin CHARACTERISTIC T_PFPULS_SEK_C "Pulsdauer PF-Puls bei aktiver SEK Adaption" VALUE 0x26D42E kw_ui16_S6_S3 2500 UMR_MSEC__10_1_0_S6_S3 0 2500 /end CHARACTERISTIC
/begin CHARACTERISTIC T_VPFPULS_C "Verzoegerungszeit fuer PF-Puls" VALUE 0x26D430 kw_ui16_S6_S3 2500 UMR_MSEC__10_1_0_S6_S3 0 2500 /end CHARACTERISTIC
/begin CHARACTERISTIC P_PFPULS_C "Pulshoehe PF-Puls" VALUE 0x26D432 kw_si16_S6_S3 6 UMR_BAR__1_1000_0_S6_S3 0 6 /end CHARACTERISTIC
/begin CHARACTERISTIC P_PFPULS_SEK_C "Pulshoehe PF-Puls bei aktiver SEK Adaption" VALUE 0x26D434 kw_si16_S6_S3 6 UMR_BAR__1_1000_0_S6_S3 0 6 /end CHARACTERISTIC
/begin CHARACTERISTIC T_UEBEWNEGBPF_C "Start negatives Ueberwachungsfenster" VALUE 0x26E46D kw_ui8_S6_S3 2500 UMR_MSEC__10_1_0_S6_S3 0 2500 /end CHARACTERISTIC
/begin CHARACTERISTIC T_UEBEWNEGEPF_C "Ende negatives Ueberwachungsfenster" VALUE 0x26E46E kw_ui8_S6_S3 2500 UMR_MSEC__10_1_0_S6_S3 0 2500 /end CHARACTERISTIC
/begin CHARACTERISTIC T_UEBEWPOSBPF_C "Start positives Ueberwachungsfenster" VALUE 0x26E46F kw_ui8_S6_S3 2500 UMR_MSEC__10_1_0_S6_S3 0 2500 /end CHARACTERISTIC
/begin CHARACTERISTIC T_UEBEWPOSEPF_C "Ende positives Ueberwachungsfenster" VALUE 0x26E470 kw_ui8_S6_S3 2500 UMR_MSEC__10_1_0_S6_S3 0 2500 /end CHARACTERISTIC
/begin CHARACTERISTIC T_UEAMPPF_C "Zeitfenster f.Erkennung Amplitude" VALUE 0x26E471 kw_ui8_S6_S3 2500 UMR_MSEC__10_1_0_S6_S3 0 2500 /end CHARACTERISTIC
/begin CHARACTERISTIC PO_FVORADA_D "Offset auf PF-Puls bei 1.Puls" VALUE 0x26D436 kw_si16_S6_S3 12 UMR_BAR__1_1000_0_S6_S3 -6 6 /end CHARACTERISTIC
/begin CHARACTERISTIC PO_FVORADASTART_D "Offset auf PF-Puls bei 1.Puls zu Beginn der Getriebelaufzeit" VALUE 0x26D438 kw_si16_S6_S3 12 UMR_BAR__1_1000_0_S6_S3 -6 6 /end CHARACTERISTIC
/begin CHARACTERISTIC PO_FNACHADA_D "Offset auf Zwischenspeicher vor Eintrag in Adaspeicher" VALUE 0x26D43A kw_si16_S6_S3 12 UMR_BAR__1_1000_0_S6_S3 -6 6 /end CHARACTERISTIC
/begin CHARACTERISTIC T_PFPULS_D "Pulsdauer PF-Puls" VALUE 0x26D43C kw_ui16_S6_S3 2500 UMR_MSEC__10_1_0_S6_S3 0 2500 /end CHARACTERISTIC
/begin CHARACTERISTIC T_PFPULS_SEK_D "Pulsdauer PF-Puls bei aktiver SEK Adaption" VALUE 0x26D43E kw_ui16_S6_S3 2500 UMR_MSEC__10_1_0_S6_S3 0 2500 /end CHARACTERISTIC
/begin CHARACTERISTIC T_VPFPULS_D "Verzoegerungszeit fuer PF-Puls" VALUE 0x26D440 kw_ui16_S6_S3 2500 UMR_MSEC__10_1_0_S6_S3 0 2500 /end CHARACTERISTIC
/begin CHARACTERISTIC P_PFPULS_D "Pulshoehe PF-Puls" VALUE 0x26D442 kw_si16_S6_S3 6 UMR_BAR__1_1000_0_S6_S3 0 6 /end CHARACTERISTIC
/begin CHARACTERISTIC P_PFPULS_SEK_D "Pulshoehe PF-Puls bei aktiver SEK Adaption" VALUE 0x26D444 kw_si16_S6_S3 6 UMR_BAR__1_1000_0_S6_S3 0 6 /end CHARACTERISTIC
/begin CHARACTERISTIC T_UEBEWNEGBPF_D "Start negatives Ueberwachungsfenster" VALUE 0x26E472 kw_ui8_S6_S3 2500 UMR_MSEC__10_1_0_S6_S3 0 2500 /end CHARACTERISTIC
/begin CHARACTERISTIC T_UEBEWNEGEPF_D "Ende negatives Ueberwachungsfenster" VALUE 0x26E473 kw_ui8_S6_S3 2500 UMR_MSEC__10_1_0_S6_S3 0 2500 /end CHARACTERISTIC
/begin CHARACTERISTIC T_UEBEWPOSBPF_D "Start positives Ueberwachungsfenster" VALUE 0x26E474 kw_ui8_S6_S3 2500 UMR_MSEC__10_1_0_S6_S3 0 2500 /end CHARACTERISTIC
/begin CHARACTERISTIC T_UEBEWPOSEPF_D "Ende positives Ueberwachungsfenster" VALUE 0x26E475 kw_ui8_S6_S3 2500 UMR_MSEC__10_1_0_S6_S3 0 2500 /end CHARACTERISTIC
/begin CHARACTERISTIC T_UEAMPPF_D "Zeitfenster f.Erkennung Amplitude" VALUE 0x26E476 kw_ui8_S6_S3 2500 UMR_MSEC__10_1_0_S6_S3 0 2500 /end CHARACTERISTIC
/begin CHARACTERISTIC PO_FVORADA_E "Offset auf PF-Puls bei 1.Puls" VALUE 0x26D446 kw_si16_S6_S3 12 UMR_BAR__1_1000_0_S6_S3 -6 6 /end CHARACTERISTIC
/begin CHARACTERISTIC PO_FVORADASTART_E "Offset auf PF-Puls bei 1.Puls zu Beginn der Getriebelaufzeit" VALUE 0x26D448 kw_si16_S6_S3 12 UMR_BAR__1_1000_0_S6_S3 -6 6 /end CHARACTERISTIC
/begin CHARACTERISTIC PO_FNACHADA_E "Offset auf Zwischenspeicher vor Eintrag in Adaspeicher" VALUE 0x26D44A kw_si16_S6_S3 12 UMR_BAR__1_1000_0_S6_S3 -6 6 /end CHARACTERISTIC
/begin CHARACTERISTIC T_PFPULS_E "Pulsdauer PF-Puls" VALUE 0x26D44C kw_ui16_S6_S3 2500 UMR_MSEC__10_1_0_S6_S3 0 2500 /end CHARACTERISTIC
/begin CHARACTERISTIC T_PFPULS_SEK_E "Pulsdauer PF-Puls bei aktiver SEK Adaption" VALUE 0x26D44E kw_ui16_S6_S3 2500 UMR_MSEC__10_1_0_S6_S3 0 2500 /end CHARACTERISTIC
/begin CHARACTERISTIC T_VPFPULS_E "Verzoegerungszeit fuer PF-Puls" VALUE 0x26D450 kw_ui16_S6_S3 2500 UMR_MSEC__10_1_0_S6_S3 0 2500 /end CHARACTERISTIC
/begin CHARACTERISTIC P_PFPULS_E "Pulshoehe PF-Puls" VALUE 0x26D452 kw_si16_S6_S3 6 UMR_BAR__1_1000_0_S6_S3 0 6 /end CHARACTERISTIC
/begin CHARACTERISTIC P_PFPULS_SEK_E "Pulshoehe PF-Puls bei aktiver SEK Adaption" VALUE 0x26D454 kw_si16_S6_S3 6 UMR_BAR__1_1000_0_S6_S3 0 6 /end CHARACTERISTIC
/begin CHARACTERISTIC T_UEBEWNEGBPF_E "Start negatives Ueberwachungsfenster" VALUE 0x26E477 kw_ui8_S6_S3 2500 UMR_MSEC__10_1_0_S6_S3 0 2500 /end CHARACTERISTIC
/begin CHARACTERISTIC T_UEBEWNEGEPF_E "Ende negatives Ueberwachungsfenster" VALUE 0x26E478 kw_ui8_S6_S3 2500 UMR_MSEC__10_1_0_S6_S3 0 2500 /end CHARACTERISTIC
/begin CHARACTERISTIC T_UEBEWPOSBPF_E "Start positives Ueberwachungsfenster" VALUE 0x26E479 kw_ui8_S6_S3 2500 UMR_MSEC__10_1_0_S6_S3 0 2500 /end CHARACTERISTIC
/begin CHARACTERISTIC T_UEBEWPOSEPF_E "Ende positives Ueberwachungsfenster" VALUE 0x26E47A kw_ui8_S6_S3 2500 UMR_MSEC__10_1_0_S6_S3 0 2500 /end CHARACTERISTIC
/begin CHARACTERISTIC T_UEAMPPF_E "Zeitfenster f.Erkennung Amplitude" VALUE 0x26E47B kw_ui8_S6_S3 2500 UMR_MSEC__10_1_0_S6_S3 0 2500 /end CHARACTERISTIC
/begin CHARACTERISTIC PO_FVORADA_K0 "Offset auf PF-Puls bei 1.Puls" VALUE 0x26D456 kw_si16_S6_S3 12 UMR_BAR__1_1000_0_S6_S3 -6 6 /end CHARACTERISTIC
/begin CHARACTERISTIC PO_FVORADASTART_K0 "Offset auf PF-Puls bei 1.Puls zu Beginn der Getriebelaufzeit" VALUE 0x26D458 kw_si16_S6_S3 12 UMR_BAR__1_1000_0_S6_S3 -6 6 /end CHARACTERISTIC
/begin CHARACTERISTIC PO_FNACHADA_K0 "Offset auf Zwischenspeicher vor Eintrag in Adaspeicher" VALUE 0x26D45A kw_si16_S6_S3 12 UMR_BAR__1_1000_0_S6_S3 -6 6 /end CHARACTERISTIC
/begin CHARACTERISTIC T_PFPULS_K0 "Pulsdauer PF-Puls" VALUE 0x26D45C kw_ui16_S6_S3 2500 UMR_MSEC__10_1_0_S6_S3 0 2500 /end CHARACTERISTIC
/begin CHARACTERISTIC T_PFPULS_SEK_K0 "Pulsdauer PF-Puls bei aktiver SEK Adaption" VALUE 0x26D45E kw_ui16_S6_S3 2500 UMR_MSEC__10_1_0_S6_S3 0 2500 /end CHARACTERISTIC
/begin CHARACTERISTIC T_VPFPULS_K0 "Verzoegerungszeit fuer PF-Puls" VALUE 0x26D460 kw_ui16_S6_S3 2500 UMR_MSEC__10_1_0_S6_S3 0 2500 /end CHARACTERISTIC
/begin CHARACTERISTIC P_PFPULS_K0 "Pulshoehe PF-Puls" VALUE 0x26D462 kw_si16_S6_S3 6 UMR_BAR__1_1000_0_S6_S3 0 6 /end CHARACTERISTIC
/begin CHARACTERISTIC P_PFPULS_SEK_K0 "Pulshoehe PF-Puls bei aktiver SEK Adaption" VALUE 0x26D464 kw_si16_S6_S3 6 UMR_BAR__1_1000_0_S6_S3 0 6 /end CHARACTERISTIC
/begin CHARACTERISTIC T_UEBEWNEGBPF_K0 "Start negatives Ueberwachungsfenster" VALUE 0x26E47C kw_ui8_S6_S3 2500 UMR_MSEC__10_1_0_S6_S3 0 2500 /end CHARACTERISTIC
/begin CHARACTERISTIC T_UEBEWNEGEPF_K0 "Ende negatives Ueberwachungsfenster" VALUE 0x26E47D kw_ui8_S6_S3 2500 UMR_MSEC__10_1_0_S6_S3 0 2500 /end CHARACTERISTIC
/begin CHARACTERISTIC T_UEBEWPOSBPF_K0 "Start positives Ueberwachungsfenster" VALUE 0x26E47E kw_ui8_S6_S3 2500 UMR_MSEC__10_1_0_S6_S3 0 2500 /end CHARACTERISTIC
/begin CHARACTERISTIC T_UEBEWPOSEPF_K0 "Ende positives Ueberwachungsfenster" VALUE 0x26E47F kw_ui8_S6_S3 2500 UMR_MSEC__10_1_0_S6_S3 0 2500 /end CHARACTERISTIC
/begin CHARACTERISTIC T_UEAMPPF_K0 "Zeitfenster f.Erkennung Amplitude" VALUE 0x26E480 kw_ui8_S6_S3 2500 UMR_MSEC__10_1_0_S6_S3 0 2500 /end CHARACTERISTIC
/begin CHARACTERISTIC TO_SFVORADA_A "Offset auf SF-Puls bei 1.Puls" VALUE 0x26D46E kw_si16_S6_S3 2000 UMR_MSEC__1_1_0_S6_S3 -1000 1000 /end CHARACTERISTIC
/begin CHARACTERISTIC TO_SFNACHADA_A "Offset auf SF-Puls nach Adaption" VALUE 0x26E481 kw_si8_S6_S3 2000 UMR_MSEC__10_1_0_S6_S3 -1000 1000 /end CHARACTERISTIC
/begin CHARACTERISTIC T_UEBEWNEGBTSF_A "Start negatives Ueberwachungsfenster" VALUE 0x26E482 kw_ui8_S6_S3 2500 UMR_MSEC__10_1_0_S6_S3 0 2500 /end CHARACTERISTIC
/begin CHARACTERISTIC T_UEBEWNEGETSF_A "Ende negatives Ueberwachungsfenster" VALUE 0x26E483 kw_ui8_S6_S3 2500 UMR_MSEC__10_1_0_S6_S3 0 2500 /end CHARACTERISTIC
/begin CHARACTERISTIC T_UEBEWPOSBTSF_A "Start positives Ueberwachungsfenster" VALUE 0x26E484 kw_ui8_S6_S3 2500 UMR_MSEC__10_1_0_S6_S3 0 2500 /end CHARACTERISTIC
/begin CHARACTERISTIC T_UEBEWPOSETSF_A "Ende positives Ueberwachungsfenster" VALUE 0x26E485 kw_ui8_S6_S3 2500 UMR_MSEC__10_1_0_S6_S3 0 2500 /end CHARACTERISTIC
/begin CHARACTERISTIC T_UEAMPTSF_A "Zeitfenster f.Erkennung Amplitude" VALUE 0x26E486 kw_ui8_S6_S3 2500 UMR_MSEC__10_1_0_S6_S3 0 2500 /end CHARACTERISTIC
/begin CHARACTERISTIC TO_SFVORADA_B "Offset auf SF-Puls bei 1.Puls" VALUE 0x26D470 kw_si16_S6_S3 2000 UMR_MSEC__1_1_0_S6_S3 -1000 1000 /end CHARACTERISTIC
/begin CHARACTERISTIC TO_SFNACHADA_B "Offset auf SF-Puls nach Adaption" VALUE 0x26E487 kw_si8_S6_S3 2000 UMR_MSEC__10_1_0_S6_S3 -1000 1000 /end CHARACTERISTIC
/begin CHARACTERISTIC T_UEBEWNEGBTSF_B "Start negatives Ueberwachungsfenster" VALUE 0x26E488 kw_ui8_S6_S3 2500 UMR_MSEC__10_1_0_S6_S3 0 2500 /end CHARACTERISTIC
/begin CHARACTERISTIC T_UEBEWNEGETSF_B "Ende negatives Ueberwachungsfenster" VALUE 0x26E489 kw_ui8_S6_S3 2500 UMR_MSEC__10_1_0_S6_S3 0 2500 /end CHARACTERISTIC
/begin CHARACTERISTIC T_UEBEWPOSBTSF_B "Start positives Ueberwachungsfenster" VALUE 0x26E48A kw_ui8_S6_S3 2500 UMR_MSEC__10_1_0_S6_S3 0 2500 /end CHARACTERISTIC
/begin CHARACTERISTIC T_UEBEWPOSETSF_B "Ende positives Ueberwachungsfenster" VALUE 0x26E48B kw_ui8_S6_S3 2500 UMR_MSEC__10_1_0_S6_S3 0 2500 /end CHARACTERISTIC
/begin CHARACTERISTIC T_UEAMPTSF_B "Zeitfenster f.Erkennung Amplitude" VALUE 0x26E48C kw_ui8_S6_S3 2500 UMR_MSEC__10_1_0_S6_S3 0 2500 /end CHARACTERISTIC
/begin CHARACTERISTIC TO_SFVORADA_C "Offset auf SF-Puls bei 1.Puls" VALUE 0x26D472 kw_si16_S6_S3 2000 UMR_MSEC__1_1_0_S6_S3 -1000 1000 /end CHARACTERISTIC
/begin CHARACTERISTIC TO_SFNACHADA_C "Offset auf SF-Puls nach Adaption" VALUE 0x26E48D kw_si8_S6_S3 2000 UMR_MSEC__10_1_0_S6_S3 -1000 1000 /end CHARACTERISTIC
/begin CHARACTERISTIC T_UEBEWNEGBTSF_C "Start negatives Ueberwachungsfenster" VALUE 0x26E48E kw_ui8_S6_S3 2500 UMR_MSEC__10_1_0_S6_S3 0 2500 /end CHARACTERISTIC
/begin CHARACTERISTIC T_UEBEWNEGETSF_C "Ende negatives Ueberwachungsfenster" VALUE 0x26E48F kw_ui8_S6_S3 2500 UMR_MSEC__10_1_0_S6_S3 0 2500 /end CHARACTERISTIC
/begin CHARACTERISTIC T_UEBEWPOSBTSF_C "Start positives Ueberwachungsfenster" VALUE 0x26E490 kw_ui8_S6_S3 2500 UMR_MSEC__10_1_0_S6_S3 0 2500 /end CHARACTERISTIC
/begin CHARACTERISTIC T_UEBEWPOSETSF_C "Ende positives Ueberwachungsfenster" VALUE 0x26E491 kw_ui8_S6_S3 2500 UMR_MSEC__10_1_0_S6_S3 0 2500 /end CHARACTERISTIC
/begin CHARACTERISTIC T_UEAMPTSF_C "Zeitfenster f.Erkennung Amplitude" VALUE 0x26E492 kw_ui8_S6_S3 2500 UMR_MSEC__10_1_0_S6_S3 0 2500 /end CHARACTERISTIC
/begin CHARACTERISTIC TO_SFVORADA_D "Offset auf SF-Puls bei 1.Puls" VALUE 0x26D474 kw_si16_S6_S3 2000 UMR_MSEC__1_1_0_S6_S3 -1000 1000 /end CHARACTERISTIC
/begin CHARACTERISTIC TO_SFNACHADA_D "Offset auf SF-Puls nach Adaption" VALUE 0x26E493 kw_si8_S6_S3 2000 UMR_MSEC__10_1_0_S6_S3 -1000 1000 /end CHARACTERISTIC
/begin CHARACTERISTIC T_UEBEWNEGBTSF_D "Start negatives Ueberwachungsfenster" VALUE 0x26E494 kw_ui8_S6_S3 2500 UMR_MSEC__10_1_0_S6_S3 0 2500 /end CHARACTERISTIC
/begin CHARACTERISTIC T_UEBEWNEGETSF_D "Ende negatives Ueberwachungsfenster" VALUE 0x26E495 kw_ui8_S6_S3 2500 UMR_MSEC__10_1_0_S6_S3 0 2500 /end CHARACTERISTIC
/begin CHARACTERISTIC T_UEBEWPOSBTSF_D "Start positives Ueberwachungsfenster" VALUE 0x26E496 kw_ui8_S6_S3 2500 UMR_MSEC__10_1_0_S6_S3 0 2500 /end CHARACTERISTIC
/begin CHARACTERISTIC T_UEBEWPOSETSF_D "Ende positives Ueberwachungsfenster" VALUE 0x26E497 kw_ui8_S6_S3 2500 UMR_MSEC__10_1_0_S6_S3 0 2500 /end CHARACTERISTIC
/begin CHARACTERISTIC T_UEAMPTSF_D "Zeitfenster f.Erkennung Amplitude" VALUE 0x26E498 kw_ui8_S6_S3 2500 UMR_MSEC__10_1_0_S6_S3 0 2500 /end CHARACTERISTIC
/begin CHARACTERISTIC TO_SFVORADA_E "Offset auf SF-Puls bei 1.Puls" VALUE 0x26D476 kw_si16_S6_S3 2000 UMR_MSEC__1_1_0_S6_S3 -1000 1000 /end CHARACTERISTIC
/begin CHARACTERISTIC TO_SFNACHADA_E "Offset auf SF-Puls nach Adaption" VALUE 0x26E499 kw_si8_S6_S3 2000 UMR_MSEC__10_1_0_S6_S3 -1000 1000 /end CHARACTERISTIC
/begin CHARACTERISTIC T_UEBEWNEGBTSF_E "Start negatives Ueberwachungsfenster" VALUE 0x26E49A kw_ui8_S6_S3 2500 UMR_MSEC__10_1_0_S6_S3 0 2500 /end CHARACTERISTIC
/begin CHARACTERISTIC T_UEBEWNEGETSF_E "Ende negatives Ueberwachungsfenster" VALUE 0x26E49B kw_ui8_S6_S3 2500 UMR_MSEC__10_1_0_S6_S3 0 2500 /end CHARACTERISTIC
/begin CHARACTERISTIC T_UEBEWPOSBTSF_E "Start positives Ueberwachungsfenster" VALUE 0x26E49C kw_ui8_S6_S3 2500 UMR_MSEC__10_1_0_S6_S3 0 2500 /end CHARACTERISTIC
/begin CHARACTERISTIC T_UEBEWPOSETSF_E "Ende positives Ueberwachungsfenster" VALUE 0x26E49D kw_ui8_S6_S3 2500 UMR_MSEC__10_1_0_S6_S3 0 2500 /end CHARACTERISTIC
/begin CHARACTERISTIC T_UEAMPTSF_E "Zeitfenster f.Erkennung Amplitude" VALUE 0x26E49E kw_ui8_S6_S3 2500 UMR_MSEC__10_1_0_S6_S3 0 2500 /end CHARACTERISTIC
/begin CHARACTERISTIC TO_SFVORADA_K0 "Offset auf SF-Puls bei 1.Puls" VALUE 0x26D478 kw_si16_S6_S3 2000 UMR_MSEC__1_1_0_S6_S3 -1000 1000 /end CHARACTERISTIC
/begin CHARACTERISTIC TO_SFNACHADA_K0 "Offset auf SF-Puls nach Adaption" VALUE 0x26E49F kw_si8_S6_S3 2000 UMR_MSEC__10_1_0_S6_S3 -1000 1000 /end CHARACTERISTIC
/begin CHARACTERISTIC T_UEBEWNEGBTSF_K0 "Start negatives Ueberwachungsfenster" VALUE 0x26E4A0 kw_ui8_S6_S3 2500 UMR_MSEC__10_1_0_S6_S3 0 2500 /end CHARACTERISTIC
/begin CHARACTERISTIC T_UEBEWNEGETSF_K0 "Ende negatives Ueberwachungsfenster" VALUE 0x26E4A1 kw_ui8_S6_S3 2500 UMR_MSEC__10_1_0_S6_S3 0 2500 /end CHARACTERISTIC
/begin CHARACTERISTIC T_UEBEWPOSBTSF_K0 "Start positives Ueberwachungsfenster" VALUE 0x26E4A2 kw_ui8_S6_S3 2500 UMR_MSEC__10_1_0_S6_S3 0 2500 /end CHARACTERISTIC
/begin CHARACTERISTIC T_UEBEWPOSETSF_K0 "Ende positives Ueberwachungsfenster" VALUE 0x26E4A3 kw_ui8_S6_S3 2500 UMR_MSEC__10_1_0_S6_S3 0 2500 /end CHARACTERISTIC
/begin CHARACTERISTIC T_UEAMPTSF_K0 "Zeitfenster f.Erkennung Amplitude" VALUE 0x26E4A4 kw_ui8_S6_S3 2500 UMR_MSEC__10_1_0_S6_S3 0 2500 /end CHARACTERISTIC
/begin CHARACTERISTIC TAB_HAINCTSF_STADA "Schrittweite fuer Hochadaption TSF-Adaption (0=K_A, 1=K_B, ...)" CURVE 0x21CCE0 tab_si16_S6_S3 2000 UMR_MSEC__1_1_0_S6_S3 0 2000
 /begin AXIS_DESCR FIX_AXIS iAdaPstzs.kup_puls_stada UMR___1_1_0_S6_S3 6 1 6 FIX_AXIS_PAR_DIST 1 1 6 /end AXIS_DESCR
/end CHARACTERISTIC
/begin CHARACTERISTIC T_RAINCTSF_STADA "Schrittweite fuer Rueckadaption" VALUE 0x26D3CE kw_si16_S6_S3 2000 UMR_MSEC__1_1_0_S6_S3 -2000 0 /end CHARACTERISTIC
/begin CHARACTERISTIC T_ZWTSFINC_STADA "Schrittweite fuer Zwangsrueckadaption" VALUE 0x26D3D0 kw_si16_S6_S3 2000 UMR_MSEC__1_1_0_S6_S3 -2000 0 /end CHARACTERISTIC
/begin CHARACTERISTIC T_RAUEBINCTSF_STADA "Schrittweite Rueckadaption Ueberpruefschleife" VALUE 0x26D3D2 kw_si16_S6_S3 2000 UMR_MSEC__1_1_0_S6_S3 -2000 0 /end CHARACTERISTIC
/begin CHARACTERISTIC TAB_TSF_ADMAX_STADA "Tabelle zur Bestimmung des maximalen \\n Schnellfüllzeitadaptions-offsetwerts einer \\n Kupplung (0=K_A, 1=K_B, ...)" CURVE 0x21CCF0 tab_si16_S6_S3 1000 UMR_MSEC__1_1_0_S6_S3 0 1000
 /begin AXIS_DESCR FIX_AXIS iAdaPstzs.kup_puls_stada UMR___1_1_0_S6_S3 6 1 6 FIX_AXIS_PAR_DIST 1 1 6 /end AXIS_DESCR
/end CHARACTERISTIC
/begin CHARACTERISTIC TAB_TSF_ADMIN_STADA "Tabelle zur Bestimmung des minimalen \\n Schnellfüllzeitadaptions-offsetwerts einer \\n Kupplung (0=K_A, 1=K_B, ...)" CURVE 0x21CD00 tab_si16_S6_S3 1000 UMR_MSEC__1_1_0_S6_S3 -1000 0
 /begin AXIS_DESCR FIX_AXIS iAdaPstzs.kup_puls_stada UMR___1_1_0_S6_S3 6 1 6 FIX_AXIS_PAR_DIST 1 1 6 /end AXIS_DESCR
/end CHARACTERISTIC
/begin CHARACTERISTIC KL_TSF_MAXADAWERTDELTA_STADA "Maximal zulässige Änderung des Adaptionswertes" CURVE 0x21CD10 kl_si16_S6_S3 200 UMR_MSEC__1_1_0_S6_S3 0 200
 /begin AXIS_DESCR STD_AXIS NO_INPUT_QUANTITY UMR___1_1_0_S6_S3 3 0 255 DEPOSIT ABSOLUTE MONOTONY MON_INCREASE /end AXIS_DESCR
/end CHARACTERISTIC
/begin CHARACTERISTIC F_TVABBR_PF_STADA "Faktor fuer Verbotszeit auf Abfrage ND_ADABBR bei PF" VALUE 0x26E414 kw_ui8_S6_S3 99.6078 UMR_PROZENT__20_51_0_S6_S3 0 99.6078431373 /end CHARACTERISTIC
/begin CHARACTERISTIC F_TVABBR_SF_STADA "Faktor fuer Verbotszeit auf Abfrage ND_ADABBR bei SF" VALUE 0x26E415 kw_ui8_S6_S3 99.6078 UMR_PROZENT__20_51_0_S6_S3 0 99.6078431373 /end CHARACTERISTIC
/begin CHARACTERISTIC TAB_HAINCPF_STADA "Schrittweite fuer Hochadaption PF-Adaption (0=K_A, 1=K_B, ...)" CURVE 0x21CC94 tab_si16_S6_S3 6 UMR_BAR__1_1000_0_S6_S3 0 6
 /begin AXIS_DESCR FIX_AXIS iAdaPstzs.kup_puls_stada UMR___1_1_0_S6_S3 6 1 6 FIX_AXIS_PAR_DIST 1 1 6 /end AXIS_DESCR
/end CHARACTERISTIC
/begin CHARACTERISTIC P_RAINCPF_STADA "Schrittweite fuer Rueckadaption" VALUE 0x26D380 kw_si16_S6_S3 6 UMR_BAR__1_1000_0_S6_S3 -6 0 /end CHARACTERISTIC
/begin CHARACTERISTIC P_ZWPFINC_STADA "Schrittweite fuer Zwangsrueckadaption" VALUE 0x26D382 kw_si16_S6_S3 6 UMR_BAR__1_1000_0_S6_S3 -6 0 /end CHARACTERISTIC
/begin CHARACTERISTIC P_RAUEBINCPF_STADA "Schrittweite Rueckadaption Ueberpruefgsschleife" VALUE 0x26D384 kw_si16_S6_S3 6 UMR_BAR__1_1000_0_S6_S3 -6 0 /end CHARACTERISTIC
/begin CHARACTERISTIC TAB_PF_ADMAX_STADA "Tabelle zur Bestimmung des maximalen \\n Fülldruckadaptions-offsetwerts einer Kupplung.\\n (0=K_A, 1=K_B, ...)" CURVE 0x21CCA4 tab_si16_S6_S3 6 UMR_BAR__1_1000_0_S6_S3 0 6
 /begin AXIS_DESCR FIX_AXIS iAdaPstzs.kup_puls_stada UMR___1_1_0_S6_S3 6 1 6 FIX_AXIS_PAR_DIST 1 1 6 /end AXIS_DESCR
/end CHARACTERISTIC
/begin CHARACTERISTIC TAB_PF_ADMIN_STADA "Tabelle zur Bestimmung des minimalen \\n Fülldruckadaptions-offsetwerts einer Kupplung.\\n (0=K_A, 1=K_B, ...)" CURVE 0x21CCB4 tab_si16_S6_S3 6 UMR_BAR__1_1000_0_S6_S3 -6 0
 /begin AXIS_DESCR FIX_AXIS iAdaPstzs.kup_puls_stada UMR___1_1_0_S6_S3 6 1 6 FIX_AXIS_PAR_DIST 1 1 6 /end AXIS_DESCR
/end CHARACTERISTIC
/begin CHARACTERISTIC KL_PF_MAXADAWERTDELTA_STADA "Maximal zulässige Änderung des Adaptionswertes" CURVE 0x21CCC4 kl_si16_S6_S3 1 UMR_BAR__1_1000_0_S6_S3 0 1
 /begin AXIS_DESCR STD_AXIS NO_INPUT_QUANTITY UMR___1_1_0_S6_S3 3 0 255 DEPOSIT ABSOLUTE MONOTONY MON_INCREASE /end AXIS_DESCR
/end CHARACTERISTIC
/begin CHARACTERISTIC TO_VPFPULS_DITHEROFF_STADA "Vorhalt fuer Dither Deaktivierung" VALUE 0x26E416 kw_ui8_S6_S3 1000 UMR_MSEC__10_1_0_S6_S3 0 1000 /end CHARACTERISTIC
/begin CHARACTERISTIC TAB_SWI_DEAKT_DITHER_STADA "Schalter Dither bei Ada deaktivieren" CURVE 0x21CCD4 tab_bool8_S6_S3 1 UMR___1_1_0_S6_S3 0 1
 /begin AXIS_DESCR FIX_AXIS iAdaPulzs.kup_puls UMR___1_1_0_S6_S3 6 1 6 FIX_AXIS_PAR_DIST 1 1 6 /end AXIS_DESCR
/end CHARACTERISTIC
/begin CHARACTERISTIC T_VPFPULS_STADA_A "Verzoegerungszeit fuer PF-Puls" VALUE 0x26D386 kw_ui16_S6_S3 2500 UMR_MSEC__10_1_0_S6_S3 0 2500 /end CHARACTERISTIC
/begin CHARACTERISTIC PO_FVORADA_STADA_A "Offset auf PF-Puls bei 1.Puls" VALUE 0x26D388 kw_si16_S6_S3 12 UMR_BAR__1_1000_0_S6_S3 -6 6 /end CHARACTERISTIC
/begin CHARACTERISTIC PO_FNACHADA_STADA_A "Offset auf Zwischenspeicher vor Eintrag in Adaspeicher" VALUE 0x26D38A kw_si16_S6_S3 12 UMR_BAR__1_1000_0_S6_S3 -6 6 /end CHARACTERISTIC
/begin CHARACTERISTIC T_PFPULS_STADA_A "Pulsdauer PF-Puls" VALUE 0x26D38C kw_ui16_S6_S3 2550 UMR_MSEC__10_1_0_S6_S3 0 2550 /end CHARACTERISTIC
/begin CHARACTERISTIC P_PFPULS_STADA_A "Pulshoehe PF-Puls" VALUE 0x26D38E kw_si16_S6_S3 6 UMR_BAR__1_1000_0_S6_S3 0 6 /end CHARACTERISTIC
/begin CHARACTERISTIC T_UEBEWNEGBPF_STADA_A "Start negatives Ueberwachungsfenster" VALUE 0x26E417 kw_ui8_S6_S3 2500 UMR_MSEC__10_1_0_S6_S3 0 2500 /end CHARACTERISTIC
/begin CHARACTERISTIC T_UEBEWNEGEPF_STADA_A "Ende negatives Ueberwachungsfenster" VALUE 0x26E418 kw_ui8_S6_S3 2500 UMR_MSEC__10_1_0_S6_S3 0 2500 /end CHARACTERISTIC
/begin CHARACTERISTIC T_UEBEWPOSBPF_STADA_A "Start positives Ueberwachungsfenster" VALUE 0x26E419 kw_ui8_S6_S3 2500 UMR_MSEC__10_1_0_S6_S3 0 2500 /end CHARACTERISTIC
/begin CHARACTERISTIC T_UEBEWPOSEPF_STADA_A "Ende positives Ueberwachungsfenster" VALUE 0x26E41A kw_ui8_S6_S3 2500 UMR_MSEC__10_1_0_S6_S3 0 2500 /end CHARACTERISTIC
/begin CHARACTERISTIC T_UEAMPPF_STADA_A "Zeitfenster f.Erkennung Amplitude" VALUE 0x26E41B kw_ui8_S6_S3 2500 UMR_MSEC__10_1_0_S6_S3 0 2500 /end CHARACTERISTIC
/begin CHARACTERISTIC TO_SFRED_STADA_A "Offset zur TSF Reduktion während PF Prüfpuls" VALUE 0x26D390 kw_si16_S6_S3 2000 UMR_MSEC__1_1_0_S6_S3 -1000 1000 /end CHARACTERISTIC
/begin CHARACTERISTIC T_VPFPULS_STADA_B "Verzoegerungszeit fuer PF-Puls" VALUE 0x26D392 kw_ui16_S6_S3 2500 UMR_MSEC__10_1_0_S6_S3 0 2500 /end CHARACTERISTIC
/begin CHARACTERISTIC PO_FVORADA_STADA_B "Offset auf PF-Puls bei 1.Puls" VALUE 0x26D394 kw_si16_S6_S3 12 UMR_BAR__1_1000_0_S6_S3 -6 6 /end CHARACTERISTIC
/begin CHARACTERISTIC PO_FNACHADA_STADA_B "Offset auf Zwischenspeicher vor Eintrag in Adaspeicher" VALUE 0x26D396 kw_si16_S6_S3 12 UMR_BAR__1_1000_0_S6_S3 -6 6 /end CHARACTERISTIC
/begin CHARACTERISTIC T_PFPULS_STADA_B "Pulsdauer PF-Puls" VALUE 0x26D398 kw_ui16_S6_S3 2550 UMR_MSEC__10_1_0_S6_S3 0 2550 /end CHARACTERISTIC
/begin CHARACTERISTIC P_PFPULS_STADA_B "Pulshoehe PF-Puls" VALUE 0x26D39A kw_si16_S6_S3 6 UMR_BAR__1_1000_0_S6_S3 0 6 /end CHARACTERISTIC
/begin CHARACTERISTIC T_UEBEWNEGBPF_STADA_B "Start negatives Ueberwachungsfenster" VALUE 0x26E41C kw_ui8_S6_S3 2500 UMR_MSEC__10_1_0_S6_S3 0 2500 /end CHARACTERISTIC
/begin CHARACTERISTIC T_UEBEWNEGEPF_STADA_B "Ende negatives Ueberwachungsfenster" VALUE 0x26E41D kw_ui8_S6_S3 2500 UMR_MSEC__10_1_0_S6_S3 0 2500 /end CHARACTERISTIC
/begin CHARACTERISTIC T_UEBEWPOSBPF_STADA_B "Start positives Ueberwachungsfenster" VALUE 0x26E41E kw_ui8_S6_S3 2500 UMR_MSEC__10_1_0_S6_S3 0 2500 /end CHARACTERISTIC
/begin CHARACTERISTIC T_UEBEWPOSEPF_STADA_B "Ende positives Ueberwachungsfenster" VALUE 0x26E41F kw_ui8_S6_S3 2500 UMR_MSEC__10_1_0_S6_S3 0 2500 /end CHARACTERISTIC
/begin CHARACTERISTIC T_UEAMPPF_STADA_B "Zeitfenster f.Erkennung Amplitude" VALUE 0x26E420 kw_ui8_S6_S3 2500 UMR_MSEC__10_1_0_S6_S3 0 2500 /end CHARACTERISTIC
/begin CHARACTERISTIC TO_SFRED_STADA_B "Offset zur TSF Reduktion während PF Prüfpuls" VALUE 0x26D39C kw_si16_S6_S3 2000 UMR_MSEC__1_1_0_S6_S3 -1000 1000 /end CHARACTERISTIC
/begin CHARACTERISTIC T_VPFPULS_STADA_C "Verzoegerungszeit fuer PF-Puls" VALUE 0x26D39E kw_ui16_S6_S3 2500 UMR_MSEC__10_1_0_S6_S3 0 2500 /end CHARACTERISTIC
/begin CHARACTERISTIC PO_FVORADA_STADA_C "Offset auf PF-Puls bei 1.Puls" VALUE 0x26D3A0 kw_si16_S6_S3 12 UMR_BAR__1_1000_0_S6_S3 -6 6 /end CHARACTERISTIC
/begin CHARACTERISTIC PO_FNACHADA_STADA_C "Offset auf Zwischenspeicher vor Eintrag in Adaspeicher" VALUE 0x26D3A2 kw_si16_S6_S3 12 UMR_BAR__1_1000_0_S6_S3 -6 6 /end CHARACTERISTIC
/begin CHARACTERISTIC T_PFPULS_STADA_C "Pulsdauer PF-Puls" VALUE 0x26D3A4 kw_ui16_S6_S3 2550 UMR_MSEC__10_1_0_S6_S3 0 2550 /end CHARACTERISTIC
/begin CHARACTERISTIC P_PFPULS_STADA_C "Pulshoehe PF-Puls" VALUE 0x26D3A6 kw_si16_S6_S3 6 UMR_BAR__1_1000_0_S6_S3 0 6 /end CHARACTERISTIC
/begin CHARACTERISTIC T_UEBEWNEGBPF_STADA_C "Start negatives Ueberwachungsfenster" VALUE 0x26E421 kw_ui8_S6_S3 2500 UMR_MSEC__10_1_0_S6_S3 0 2500 /end CHARACTERISTIC
/begin CHARACTERISTIC T_UEBEWNEGEPF_STADA_C "Ende negatives Ueberwachungsfenster" VALUE 0x26E422 kw_ui8_S6_S3 2500 UMR_MSEC__10_1_0_S6_S3 0 2500 /end CHARACTERISTIC
/begin CHARACTERISTIC T_UEBEWPOSBPF_STADA_C "Start positives Ueberwachungsfenster" VALUE 0x26E423 kw_ui8_S6_S3 2500 UMR_MSEC__10_1_0_S6_S3 0 2500 /end CHARACTERISTIC
/begin CHARACTERISTIC T_UEBEWPOSEPF_STADA_C "Ende positives Ueberwachungsfenster" VALUE 0x26E424 kw_ui8_S6_S3 2500 UMR_MSEC__10_1_0_S6_S3 0 2500 /end CHARACTERISTIC
/begin CHARACTERISTIC T_UEAMPPF_STADA_C "Zeitfenster f.Erkennung Amplitude" VALUE 0x26E425 kw_ui8_S6_S3 2500 UMR_MSEC__10_1_0_S6_S3 0 2500 /end CHARACTERISTIC
/begin CHARACTERISTIC TO_SFRED_STADA_C "Offset zur TSF Reduktion während PF Prüfpuls" VALUE 0x26D3A8 kw_si16_S6_S3 2000 UMR_MSEC__1_1_0_S6_S3 -1000 1000 /end CHARACTERISTIC
/begin CHARACTERISTIC T_VPFPULS_STADA_D "Verzoegerungszeit fuer PF-Puls" VALUE 0x26D3AA kw_ui16_S6_S3 2500 UMR_MSEC__10_1_0_S6_S3 0 2500 /end CHARACTERISTIC
/begin CHARACTERISTIC PO_FVORADA_STADA_D "Offset auf PF-Puls bei 1.Puls" VALUE 0x26D3AC kw_si16_S6_S3 12 UMR_BAR__1_1000_0_S6_S3 -6 6 /end CHARACTERISTIC
/begin CHARACTERISTIC PO_FNACHADA_STADA_D "Offset auf Zwischenspeicher vor Eintrag in Adaspeicher" VALUE 0x26D3AE kw_si16_S6_S3 12 UMR_BAR__1_1000_0_S6_S3 -6 6 /end CHARACTERISTIC
/begin CHARACTERISTIC T_PFPULS_STADA_D "Pulsdauer PF-Puls" VALUE 0x26D3B0 kw_ui16_S6_S3 2550 UMR_MSEC__10_1_0_S6_S3 0 2550 /end CHARACTERISTIC
/begin CHARACTERISTIC P_PFPULS_STADA_D "Pulshoehe PF-Puls" VALUE 0x26D3B2 kw_si16_S6_S3 6 UMR_BAR__1_1000_0_S6_S3 0 6 /end CHARACTERISTIC
/begin CHARACTERISTIC T_UEBEWNEGBPF_STADA_D "Start negatives Ueberwachungsfenster" VALUE 0x26E426 kw_ui8_S6_S3 2500 UMR_MSEC__10_1_0_S6_S3 0 2500 /end CHARACTERISTIC
/begin CHARACTERISTIC T_UEBEWNEGEPF_STADA_D "Ende negatives Ueberwachungsfenster" VALUE 0x26E427 kw_ui8_S6_S3 2500 UMR_MSEC__10_1_0_S6_S3 0 2500 /end CHARACTERISTIC
/begin CHARACTERISTIC T_UEBEWPOSBPF_STADA_D "Start positives Ueberwachungsfenster" VALUE 0x26E428 kw_ui8_S6_S3 2500 UMR_MSEC__10_1_0_S6_S3 0 2500 /end CHARACTERISTIC
/begin CHARACTERISTIC T_UEBEWPOSEPF_STADA_D "Ende positives Ueberwachungsfenster" VALUE 0x26E429 kw_ui8_S6_S3 2500 UMR_MSEC__10_1_0_S6_S3 0 2500 /end CHARACTERISTIC
/begin CHARACTERISTIC T_UEAMPPF_STADA_D "Zeitfenster f.Erkennung Amplitude" VALUE 0x26E42A kw_ui8_S6_S3 2500 UMR_MSEC__10_1_0_S6_S3 0 2500 /end CHARACTERISTIC
/begin CHARACTERISTIC TO_SFRED_STADA_D "Offset zur TSF Reduktion während PF Prüfpuls" VALUE 0x26D3B4 kw_si16_S6_S3 2000 UMR_MSEC__1_1_0_S6_S3 -1000 1000 /end CHARACTERISTIC
/begin CHARACTERISTIC T_VPFPULS_STADA_E "Verzoegerungszeit fuer PF-Puls" VALUE 0x26D3B6 kw_ui16_S6_S3 2500 UMR_MSEC__10_1_0_S6_S3 0 2500 /end CHARACTERISTIC
/begin CHARACTERISTIC PO_FVORADA_STADA_E "Offset auf PF-Puls bei 1.Puls" VALUE 0x26D3B8 kw_si16_S6_S3 12 UMR_BAR__1_1000_0_S6_S3 -6 6 /end CHARACTERISTIC
/begin CHARACTERISTIC PO_FNACHADA_STADA_E "Offset auf Zwischenspeicher vor Eintrag in Adaspeicher" VALUE 0x26D3BA kw_si16_S6_S3 12 UMR_BAR__1_1000_0_S6_S3 -6 6 /end CHARACTERISTIC
/begin CHARACTERISTIC T_PFPULS_STADA_E "Pulsdauer PF-Puls" VALUE 0x26D3BC kw_ui16_S6_S3 2550 UMR_MSEC__10_1_0_S6_S3 0 2550 /end CHARACTERISTIC
/begin CHARACTERISTIC P_PFPULS_STADA_E "Pulshoehe PF-Puls" VALUE 0x26D3BE kw_si16_S6_S3 6 UMR_BAR__1_1000_0_S6_S3 0 6 /end CHARACTERISTIC
/begin CHARACTERISTIC T_UEBEWNEGBPF_STADA_E "Start negatives Ueberwachungsfenster" VALUE 0x26E42B kw_ui8_S6_S3 2500 UMR_MSEC__10_1_0_S6_S3 0 2500 /end CHARACTERISTIC
/begin CHARACTERISTIC T_UEBEWNEGEPF_STADA_E "Ende negatives Ueberwachungsfenster" VALUE 0x26E42C kw_ui8_S6_S3 2500 UMR_MSEC__10_1_0_S6_S3 0 2500 /end CHARACTERISTIC
/begin CHARACTERISTIC T_UEBEWPOSBPF_STADA_E "Start positives Ueberwachungsfenster" VALUE 0x26E42D kw_ui8_S6_S3 2500 UMR_MSEC__10_1_0_S6_S3 0 2500 /end CHARACTERISTIC
/begin CHARACTERISTIC T_UEBEWPOSEPF_STADA_E "Ende positives Ueberwachungsfenster" VALUE 0x26E42E kw_ui8_S6_S3 2500 UMR_MSEC__10_1_0_S6_S3 0 2500 /end CHARACTERISTIC
/begin CHARACTERISTIC T_UEAMPPF_STADA_E "Zeitfenster f.Erkennung Amplitude" VALUE 0x26E42F kw_ui8_S6_S3 2500 UMR_MSEC__10_1_0_S6_S3 0 2500 /end CHARACTERISTIC
/begin CHARACTERISTIC TO_SFRED_STADA_E "Offset zur TSF Reduktion während PF Prüfpuls" VALUE 0x26D3C0 kw_si16_S6_S3 2000 UMR_MSEC__1_1_0_S6_S3 -1000 1000 /end CHARACTERISTIC
/begin CHARACTERISTIC T_VPFPULS_STADA_K0 "Verzoegerungszeit fuer PF-Puls" VALUE 0x26D3C2 kw_ui16_S6_S3 2500 UMR_MSEC__10_1_0_S6_S3 0 2500 /end CHARACTERISTIC
/begin CHARACTERISTIC PO_FVORADA_STADA_K0 "Offset auf PF-Puls bei 1.Puls" VALUE 0x26D3C4 kw_si16_S6_S3 12 UMR_BAR__1_1000_0_S6_S3 -6 6 /end CHARACTERISTIC
/begin CHARACTERISTIC PO_FNACHADA_STADA_K0 "Offset auf Zwischenspeicher vor Eintrag in Adaspeicher" VALUE 0x26D3C6 kw_si16_S6_S3 12 UMR_BAR__1_1000_0_S6_S3 -6 6 /end CHARACTERISTIC
/begin CHARACTERISTIC T_PFPULS_STADA_K0 "Pulsdauer PF-Puls" VALUE 0x26D3C8 kw_ui16_S6_S3 2550 UMR_MSEC__10_1_0_S6_S3 0 2550 /end CHARACTERISTIC
/begin CHARACTERISTIC P_PFPULS_STADA_K0 "Pulshoehe PF-Puls" VALUE 0x26D3CA kw_si16_S6_S3 6 UMR_BAR__1_1000_0_S6_S3 0 6 /end CHARACTERISTIC
/begin CHARACTERISTIC T_UEBEWNEGBPF_STADA_K0 "Start negatives Ueberwachungsfenster" VALUE 0x26E430 kw_ui8_S6_S3 2500 UMR_MSEC__10_1_0_S6_S3 0 2500 /end CHARACTERISTIC
/begin CHARACTERISTIC T_UEBEWNEGEPF_STADA_K0 "Ende negatives Ueberwachungsfenster" VALUE 0x26E431 kw_ui8_S6_S3 2500 UMR_MSEC__10_1_0_S6_S3 0 2500 /end CHARACTERISTIC
/begin CHARACTERISTIC T_UEBEWPOSBPF_STADA_K0 "Start positives Ueberwachungsfenster" VALUE 0x26E432 kw_ui8_S6_S3 2500 UMR_MSEC__10_1_0_S6_S3 0 2500 /end CHARACTERISTIC
/begin CHARACTERISTIC T_UEBEWPOSEPF_STADA_K0 "Ende positives Ueberwachungsfenster" VALUE 0x26E433 kw_ui8_S6_S3 2500 UMR_MSEC__10_1_0_S6_S3 0 2500 /end CHARACTERISTIC
/begin CHARACTERISTIC T_UEAMPPF_STADA_K0 "Zeitfenster f.Erkennung Amplitude" VALUE 0x26E434 kw_ui8_S6_S3 2500 UMR_MSEC__10_1_0_S6_S3 0 2500 /end CHARACTERISTIC
/begin CHARACTERISTIC TO_SFRED_STADA_K0 "Offset zur TSF Reduktion während PF Prüfpuls" VALUE 0x26D3CC kw_si16_S6_S3 2000 UMR_MSEC__1_1_0_S6_S3 -1000 1000 /end CHARACTERISTIC
/begin CHARACTERISTIC TAB_ND_PULSAMP_STADA_TSF "ND-Schwelle zur Ausgleichsgeraden im Überwachungsfenster (0=K_A, 1=K_B, ...)" CURVE 0x21CBF4 tab_si16_S6_S3 1000 UMR_U_MIN_1_1_0_S6_S3 0 1000
 /begin AXIS_DESCR FIX_AXIS iAdaPstzs.kup_puls_stada UMR___1_1_0_S6_S3 6 1 6 FIX_AXIS_PAR_DIST 1 1 6 /end AXIS_DESCR
/end CHARACTERISTIC
/begin CHARACTERISTIC TAB_ND_PULSNEG_STADA_TSF "negative ND-Schwelle zur Ausgleichsgeraden im Überwachungsfenster (0=K_A, 1=K_B, ...)" CURVE 0x21CC04 tab_si16_S6_S3 1000 UMR_U_MIN_1_1_0_S6_S3 0 1000
 /begin AXIS_DESCR FIX_AXIS iAdaPstzs.kup_puls_stada UMR___1_1_0_S6_S3 6 1 6 FIX_AXIS_PAR_DIST 1 1 6 /end AXIS_DESCR
/end CHARACTERISTIC
/begin CHARACTERISTIC TAB_ND_PULSPOS_STADA_TSF "positive ND-Schwelle zur Ausgleichsgeraden im Überwachungsfenster (0=K_A, 1=K_B, ...)" CURVE 0x21CC14 tab_si16_S6_S3 1000 UMR_U_MIN_1_1_0_S6_S3 0 1000
 /begin AXIS_DESCR FIX_AXIS iAdaPstzs.kup_puls_stada UMR___1_1_0_S6_S3 6 1 6 FIX_AXIS_PAR_DIST 1 1 6 /end AXIS_DESCR
/end CHARACTERISTIC
/begin CHARACTERISTIC TAB_ND_PULSZWNEG_STADA_TSF "negative ND-Schwelle fuer Zwangsrueckadaption (0=K_A, 1=K_B, ...)" CURVE 0x21CC24 tab_si16_S6_S3 1000 UMR_U_MIN_1_1_0_S6_S3 0 1000
 /begin AXIS_DESCR FIX_AXIS iAdaPstzs.kup_puls_stada UMR___1_1_0_S6_S3 6 1 6 FIX_AXIS_PAR_DIST 1 1 6 /end AXIS_DESCR
/end CHARACTERISTIC
/begin CHARACTERISTIC TAB_ND_PULSZWPOS_STADA_TSF "positive ND-Schwelle fuer Zwangsrueckadaption (0=K_A, 1=K_B, ...)" CURVE 0x21CC34 tab_si16_S6_S3 1000 UMR_U_MIN_1_1_0_S6_S3 0 1000
 /begin AXIS_DESCR FIX_AXIS iAdaPstzs.kup_puls_stada UMR___1_1_0_S6_S3 6 1 6 FIX_AXIS_PAR_DIST 1 1 6 /end AXIS_DESCR
/end CHARACTERISTIC
/begin CHARACTERISTIC TAB_ND_PULSAMP_STADA_PF "ND-Schwelle zur Ausgleichsgeraden im Überwachungsfenster (0=K_A, 1=K_B, ...)" CURVE 0x21CC44 tab_si16_S6_S3 1000 UMR_U_MIN_1_1_0_S6_S3 0 1000
 /begin AXIS_DESCR FIX_AXIS iAdaPstzs.kup_puls_stada UMR___1_1_0_S6_S3 6 1 6 FIX_AXIS_PAR_DIST 1 1 6 /end AXIS_DESCR
/end CHARACTERISTIC
/begin CHARACTERISTIC TAB_ND_PULSNEG_STADA_PF "negative ND-Schwelle zur Ausgleichsgeraden im Überwachungsfenster (0=K_A, 1=K_B, ...)" CURVE 0x21CC54 tab_si16_S6_S3 1000 UMR_U_MIN_1_1_0_S6_S3 0 1000
 /begin AXIS_DESCR FIX_AXIS iAdaPstzs.kup_puls_stada UMR___1_1_0_S6_S3 6 1 6 FIX_AXIS_PAR_DIST 1 1 6 /end AXIS_DESCR
/end CHARACTERISTIC
/begin CHARACTERISTIC TAB_ND_PULSPOS_STADA_PF "positive ND-Schwelle zur Ausgleichsgeraden im Überwachungsfenster (0=K_A, 1=K_B, ...)" CURVE 0x21CC64 tab_si16_S6_S3 1000 UMR_U_MIN_1_1_0_S6_S3 0 1000
 /begin AXIS_DESCR FIX_AXIS iAdaPstzs.kup_puls_stada UMR___1_1_0_S6_S3 6 1 6 FIX_AXIS_PAR_DIST 1 1 6 /end AXIS_DESCR
/end CHARACTERISTIC
/begin CHARACTERISTIC TAB_ND_PULSZWNEG_STADA_PF "negative ND-Schwelle fuer Zwangsrueckadaption (0=K_A, 1=K_B, ...)" CURVE 0x21CC74 tab_si16_S6_S3 1000 UMR_U_MIN_1_1_0_S6_S3 0 1000
 /begin AXIS_DESCR FIX_AXIS iAdaPstzs.kup_puls_stada UMR___1_1_0_S6_S3 6 1 6 FIX_AXIS_PAR_DIST 1 1 6 /end AXIS_DESCR
/end CHARACTERISTIC
/begin CHARACTERISTIC TAB_ND_PULSZWPOS_STADA_PF "positive ND-Schwelle fuer Zwangsrueckadaption (0=K_A, 1=K_B, ...)" CURVE 0x21CC84 tab_si16_S6_S3 1000 UMR_U_MIN_1_1_0_S6_S3 0 1000
 /begin AXIS_DESCR FIX_AXIS iAdaPstzs.kup_puls_stada UMR___1_1_0_S6_S3 6 1 6 FIX_AXIS_PAR_DIST 1 1 6 /end AXIS_DESCR
/end CHARACTERISTIC
/begin CHARACTERISTIC T_SPTSFPULS_STADA_A "Sperrzeit nach letzter Schaltung oder Pruefung" VALUE 0x26D3F4 kw_ui16_S6_S3 2500 UMR_MSEC__10_1_0_S6_S3 0 2500 /end CHARACTERISTIC
/begin CHARACTERISTIC T_SPTSFPULS_STADA_B "Sperrzeit nach letzter Schaltung oder Pruefung" VALUE 0x26D3F6 kw_ui16_S6_S3 2500 UMR_MSEC__10_1_0_S6_S3 0 2500 /end CHARACTERISTIC
/begin CHARACTERISTIC T_SPTSFPULS_STADA_C "Sperrzeit nach letzter Schaltung oder Pruefung" VALUE 0x26D3F8 kw_ui16_S6_S3 2500 UMR_MSEC__10_1_0_S6_S3 0 2500 /end CHARACTERISTIC
/begin CHARACTERISTIC T_SPTSFPULS_STADA_D "Sperrzeit nach letzter Schaltung oder Pruefung" VALUE 0x26D3FA kw_ui16_S6_S3 2500 UMR_MSEC__10_1_0_S6_S3 0 2500 /end CHARACTERISTIC
/begin CHARACTERISTIC T_SPTSFPULS_STADA_E "Sperrzeit nach letzter Schaltung oder Pruefung" VALUE 0x26D3FC kw_ui16_S6_S3 2500 UMR_MSEC__10_1_0_S6_S3 0 2500 /end CHARACTERISTIC
/begin CHARACTERISTIC T_SPTSFPULS_STADA_K0 "Sperrzeit nach letzter Schaltung oder Pruefung" VALUE 0x26D3FE kw_ui16_S6_S3 2500 UMR_MSEC__10_1_0_S6_S3 0 2500 /end CHARACTERISTIC
/begin CHARACTERISTIC P_RA_VORSTADA_A "Vor-Rampe gegen leergelaufene Kupplung" VALUE 0x26D376 kw_ui16_S6_S3 100 UMR_BAR_SEC_1_10_0_S6_S3 0 100 /end CHARACTERISTIC
/begin CHARACTERISTIC T_RA_VORSTADA_AUF_A "Vor-Rampe gegen leergelaufene Kupplung" VALUE 0x26E40A kw_ui8_S6_S3 2000 UMR_MSEC__10_1_0_S6_S3 0 2000 /end CHARACTERISTIC
/begin CHARACTERISTIC T_RA_VORSTADA_AB_A "Vor-Rampe gegen leergelaufene Kupplung" VALUE 0x26E40B kw_ui8_S6_S3 2000 UMR_MSEC__10_1_0_S6_S3 0 2000 /end CHARACTERISTIC
/begin CHARACTERISTIC P_RA_VORSTADA_B "Vor-Rampe gegen leergelaufene Kupplung" VALUE 0x26D378 kw_ui16_S6_S3 100 UMR_BAR_SEC_1_10_0_S6_S3 0 100 /end CHARACTERISTIC
/begin CHARACTERISTIC T_RA_VORSTADA_AUF_B "Vor-Rampe gegen leergelaufene Kupplung" VALUE 0x26E40C kw_ui8_S6_S3 2000 UMR_MSEC__10_1_0_S6_S3 0 2000 /end CHARACTERISTIC
/begin CHARACTERISTIC T_RA_VORSTADA_AB_B "Vor-Rampe gegen leergelaufene Kupplung" VALUE 0x26E40D kw_ui8_S6_S3 2000 UMR_MSEC__10_1_0_S6_S3 0 2000 /end CHARACTERISTIC
/begin CHARACTERISTIC P_RA_VORSTADA_C "Vor-Rampe gegen leergelaufene Kupplung" VALUE 0x26D37A kw_ui16_S6_S3 100 UMR_BAR_SEC_1_10_0_S6_S3 0 100 /end CHARACTERISTIC
/begin CHARACTERISTIC T_RA_VORSTADA_AUF_C "Vor-Rampe gegen leergelaufene Kupplung" VALUE 0x26E40E kw_ui8_S6_S3 2000 UMR_MSEC__10_1_0_S6_S3 0 2000 /end CHARACTERISTIC
/begin CHARACTERISTIC T_RA_VORSTADA_AB_C "Vor-Rampe gegen leergelaufene Kupplung" VALUE 0x26E40F kw_ui8_S6_S3 2000 UMR_MSEC__10_1_0_S6_S3 0 2000 /end CHARACTERISTIC
/begin CHARACTERISTIC P_RA_VORSTADA_D "Vor-Rampe gegen leergelaufene Kupplung" VALUE 0x26D37C kw_ui16_S6_S3 100 UMR_BAR_SEC_1_10_0_S6_S3 0 100 /end CHARACTERISTIC
/begin CHARACTERISTIC T_RA_VORSTADA_AUF_D "Vor-Rampe gegen leergelaufene Kupplung" VALUE 0x26E410 kw_ui8_S6_S3 2000 UMR_MSEC__10_1_0_S6_S3 0 2000 /end CHARACTERISTIC
/begin CHARACTERISTIC T_RA_VORSTADA_AB_D "Vor-Rampe gegen leergelaufene Kupplung" VALUE 0x26E411 kw_ui8_S6_S3 2000 UMR_MSEC__10_1_0_S6_S3 0 2000 /end CHARACTERISTIC
/begin CHARACTERISTIC P_RA_VORSTADA_E "Vor-Rampe gegen leergelaufene Kupplung" VALUE 0x26D37E kw_ui16_S6_S3 100 UMR_BAR_SEC_1_10_0_S6_S3 0 100 /end CHARACTERISTIC
/begin CHARACTERISTIC T_RA_VORSTADA_AUF_E "Vor-Rampe gegen leergelaufene Kupplung" VALUE 0x26E412 kw_ui8_S6_S3 2000 UMR_MSEC__10_1_0_S6_S3 0 2000 /end CHARACTERISTIC
/begin CHARACTERISTIC T_RA_VORSTADA_AB_E "Vor-Rampe gegen leergelaufene Kupplung" VALUE 0x26E413 kw_ui8_S6_S3 2000 UMR_MSEC__10_1_0_S6_S3 0 2000 /end CHARACTERISTIC
/begin CHARACTERISTIC DKIS_STADA "DKI Schwelle fuer Testeradaption" VALUE 0x26E459 kw_ui8_S6_S3 100 UMR_PROZENT__20_51_0_S6_S3 0 100 /end CHARACTERISTIC
/begin CHARACTERISTIC PS_STADA "Bremsdruchschwelle" VALUE 0x26D3E0 kw_si16_S6_S3 99 UMR_BAR__1_1_0_S6_S3 1 100 /end CHARACTERISTIC
/begin CHARACTERISTIC NS_AB_STADA "Abtriebsdrehzahlschwelle" VALUE 0x26D3E2 kw_ui16_S6_S3 250 UMR_U_MIN_1_1_0_S6_S3 0 250 /end CHARACTERISTIC
/begin CHARACTERISTIC NS_MOTDELTA_STADA "Max zulaessige Motordrehzal Aenderung VM" VALUE 0x26D3E4 kw_ui16_S6_S3 1000 UMR_U_MIN_1_1_0_S6_S3 0 1000 /end CHARACTERISTIC
/begin CHARACTERISTIC NS_EMDELTA_STADA "Max zulaessige Motordrehzal Aenderung EM" VALUE 0x26D3E6 kw_ui16_S6_S3 1000 UMR_U_MIN_1_1_0_S6_S3 0 1000 /end CHARACTERISTIC
/begin CHARACTERISTIC CS_UN_STADA "untere c_getr-Schwelle fuer Tester Pulsadapton" VALUE 0x26E45A kw_ui8_S6_S3 190 UMR_GRADC__1_1_M40_S6_S3 -40 150 /end CHARACTERISTIC
/begin CHARACTERISTIC CS_OB_STADA "obere c_getr-Schwelle fuer Tester Pulsadapton" VALUE 0x26E45B kw_ui8_S6_S3 190 UMR_GRADC__1_1_M40_S6_S3 -40 150 /end CHARACTERISTIC
/begin CHARACTERISTIC CS_HYSUN_STADA "Hysterese fuer untere Temp. Schwelle CS_UN_STADA" VALUE 0x26E45C kw_ui8_S6_S3 50 UMR_GRADC__1_1_0_S6_S3 0 50 /end CHARACTERISTIC
/begin CHARACTERISTIC CS_HYSOB_STADA "Hysterese fuer obere Temp. Schwelle CS_OB_STADA" VALUE 0x26E45D kw_ui8_S6_S3 50 UMR_GRADC__1_1_0_S6_S3 0 50 /end CHARACTERISTIC
/begin CHARACTERISTIC NS_MOTUN_STADA "Untere Drehzahlschelle VM" VALUE 0x26D3E8 kw_ui16_S6_S3 1550 UMR_U_MIN_1_1_0_S6_S3 0 1550 /end CHARACTERISTIC
/begin CHARACTERISTIC NS_MOTOB_STADA "Obere Drehzahlschwelle VM" VALUE 0x26D3EA kw_ui16_S6_S3 1550 UMR_U_MIN_1_1_0_S6_S3 0 1550 /end CHARACTERISTIC
/begin CHARACTERISTIC NS_EMUN_STADA "Untere Drehzahlschelle EM" VALUE 0x26D3EC kw_ui16_S6_S3 1550 UMR_U_MIN_1_1_0_S6_S3 0 1550 /end CHARACTERISTIC
/begin CHARACTERISTIC NS_EMOB_STADA "Obere Drehzahlschwelle EM" VALUE 0x26D3EE kw_ui16_S6_S3 1550 UMR_U_MIN_1_1_0_S6_S3 0 1550 /end CHARACTERISTIC
/begin CHARACTERISTIC TAB_ND_ADABBR_STADA "ND-Schwelle fuer Abbruch Befuellpruefung gangabhaengig" CURVE 0x21CD20 tab_si16_S6_S3 2000 UMR_U_MIN_1_1_0_S6_S3 -1000 1000
 /begin AXIS_DESCR FIX_AXIS zff_atsys._.iSignale._.obj.sig_istgang UMR___1_1_0_S6_S3 10 -1 8 FIX_AXIS_PAR_DIST -1 1 10 /end AXIS_DESCR
/end CHARACTERISTIC
/begin CHARACTERISTIC N_PULSGRENZ_STADA "max. Anzahl Pulse pro Pruefzyklus" VALUE 0x26E45E kw_ui8_S6_S3 255 UMR___1_1_0_S6_S3 0 255 /end CHARACTERISTIC
/begin CHARACTERISTIC TS_MAX_INIT_STADA "Zeitschwelle fuer Maxzeit im Zustand Initialisierung" VALUE 0x26E45F kw_ui8_S6_S3 100 UMR_SEC__1_1_0_S6_S3 0 100 /end CHARACTERISTIC
/begin CHARACTERISTIC TS_NMOTLEERSOLL_AKTIV_STADA "Zeitschwelle für Start Pulsausgabe nach Leerlaufdrehzahlanhebung" VALUE 0x26D3F0 kw_ui16_S6_S3 10000 UMR_MSEC__10_1_0_S6_S3 0 10000 /end CHARACTERISTIC
/begin CHARACTERISTIC TAB_SWIPRUEF_STADA_TSF "Kupplunsspezifische aktivierung der TSF Stillstandsadaption KUP A-E(F/K0): 0=keine Pruefung, 1=Pruefung" CURVE 0x21CD38 tab_bool8_S6_S3 1 UMR___1_1_0_S6_S3 0 1
 /begin AXIS_DESCR FIX_AXIS iAdaPstzs.kup_puls_stada UMR___1_1_0_S6_S3 6 1 6 FIX_AXIS_PAR_DIST 1 1 6 /end AXIS_DESCR
/end CHARACTERISTIC
/begin CHARACTERISTIC TAB_SWIPRUEF_STADA_PF "Kupplunsspezifische aktivierung der PF Stillstandsadaption KUP A-E(F/K0): 0=keine Pruefung, 1=Pruefung" CURVE 0x21CD44 tab_bool8_S6_S3 1 UMR___1_1_0_S6_S3 0 1
 /begin AXIS_DESCR FIX_AXIS iAdaPstzs.kup_puls_stada UMR___1_1_0_S6_S3 6 1 6 FIX_AXIS_PAR_DIST 1 1 6 /end AXIS_DESCR
/end CHARACTERISTIC
/begin CHARACTERISTIC TAB_TESTFALL_KUPADA_STADA "Aktivierung der Moeglichen Testfaelle aus der Testfalltabelle 0=nicht aktiv , 1=beide Kupplungen , 2=Prio1 Kupplung , 3=Prio2 Kupplung" CURVE 0x21CD50 tab_ui8_S6_S3 3 UMR___1_1_0_S6_S3 0 3
 /begin AXIS_DESCR FIX_AXIS NO_INPUT_QUANTITY UMR___1_1_0_S6_S3 13 0 12 FIX_AXIS_PAR_DIST 0 1 13 /end AXIS_DESCR
/end CHARACTERISTIC
/begin CHARACTERISTIC FI_ADANEU_STADA "Filteranzahl f.Gewichtung des neuen ADA-Werts" VALUE 0x26E460 kw_ui8_S6_S3 9 UMR___1_1_0_S6_S3 1 10 /end CHARACTERISTIC
/begin CHARACTERISTIC KL_FIADAAKT_NPRUEFZYKL_POS_STADA "Filteranzahl f.Gewichtung des alten ADA-Werts bei pos. Abweichung" CURVE 0x21CD64 kl_ui8_S6_S3 10 UMR___1_1_0_S6_S3 0 10
 /begin AXIS_DESCR STD_AXIS NO_INPUT_QUANTITY UMR___1_1_0_S6_S3 3 0 255 DEPOSIT ABSOLUTE MONOTONY MON_INCREASE /end AXIS_DESCR
/end CHARACTERISTIC
/begin CHARACTERISTIC KL_FIADAAKT_NPRUEFZYKL_NEG_STADA "Filteranzahl f.Gewichtung des alten ADA-Werts bei neg. Abweichung" CURVE 0x21CD70 kl_ui8_S6_S3 10 UMR___1_1_0_S6_S3 0 10
 /begin AXIS_DESCR STD_AXIS NO_INPUT_QUANTITY UMR___1_1_0_S6_S3 3 0 255 DEPOSIT ABSOLUTE MONOTONY MON_INCREASE /end AXIS_DESCR
/end CHARACTERISTIC
/begin CHARACTERISTIC NS_VMPULS_STADA "Drehzahlschwelle Verbrennungsmotor" VALUE 0x26D3F2 kw_ui16_S6_S3 1000 UMR_U_MIN_1_1_0_S6_S3 0 1000 /end CHARACTERISTIC
/begin CHARACTERISTIC TO_SFVORADA_STADA_A "Offset auf SF-Puls bei 1.Puls" VALUE 0x26D3D4 kw_si16_S6_S3 2000 UMR_MSEC__1_1_0_S6_S3 -1000 1000 /end CHARACTERISTIC
/begin CHARACTERISTIC TO_SFNACHADA_STADA_A "Offset auf SF-Puls nach Adaption" VALUE 0x26E435 kw_si8_S6_S3 2000 UMR_MSEC__10_1_0_S6_S3 -1000 1000 /end CHARACTERISTIC
/begin CHARACTERISTIC T_UEBEWNEGBTSF_STADA_A "Start negatives Ueberwachungsfenster" VALUE 0x26E436 kw_ui8_S6_S3 2550 UMR_MSEC__10_1_0_S6_S3 0 2550 /end CHARACTERISTIC
/begin CHARACTERISTIC T_UEBEWNEGETSF_STADA_A "Ende negatives Ueberwachungsfenster" VALUE 0x26E437 kw_ui8_S6_S3 2550 UMR_MSEC__10_1_0_S6_S3 0 2550 /end CHARACTERISTIC
/begin CHARACTERISTIC T_UEBEWPOSBTSF_STADA_A "Start positives Ueberwachungsfenster" VALUE 0x26E438 kw_ui8_S6_S3 2500 UMR_MSEC__10_1_0_S6_S3 0 2500 /end CHARACTERISTIC
/begin CHARACTERISTIC T_UEBEWPOSETSF_STADA_A "Ende positives Ueberwachungsfenster" VALUE 0x26E439 kw_ui8_S6_S3 2500 UMR_MSEC__10_1_0_S6_S3 0 2500 /end CHARACTERISTIC
/begin CHARACTERISTIC T_UEAMPTSF_STADA_A "Zeitfenster f.Erkennung Amplitude" VALUE 0x26E43A kw_ui8_S6_S3 2500 UMR_MSEC__10_1_0_S6_S3 0 2500 /end CHARACTERISTIC
/begin CHARACTERISTIC TO_SFVORADA_STADA_B "Offset auf SF-Puls bei 1.Puls" VALUE 0x26D3D6 kw_si16_S6_S3 2000 UMR_MSEC__1_1_0_S6_S3 -1000 1000 /end CHARACTERISTIC
/begin CHARACTERISTIC TO_SFNACHADA_STADA_B "Offset auf SF-Puls nach Adaption" VALUE 0x26E43B kw_si8_S6_S3 2000 UMR_MSEC__10_1_0_S6_S3 -1000 1000 /end CHARACTERISTIC
/begin CHARACTERISTIC T_UEBEWNEGBTSF_STADA_B "Start negatives Ueberwachungsfenster" VALUE 0x26E43C kw_ui8_S6_S3 2550 UMR_MSEC__10_1_0_S6_S3 0 2550 /end CHARACTERISTIC
/begin CHARACTERISTIC T_UEBEWNEGETSF_STADA_B "Ende negatives Ueberwachungsfenster" VALUE 0x26E43D kw_ui8_S6_S3 2550 UMR_MSEC__10_1_0_S6_S3 0 2550 /end CHARACTERISTIC
/begin CHARACTERISTIC T_UEBEWPOSBTSF_STADA_B "Start positives Ueberwachungsfenster" VALUE 0x26E43E kw_ui8_S6_S3 2500 UMR_MSEC__10_1_0_S6_S3 0 2500 /end CHARACTERISTIC
/begin CHARACTERISTIC T_UEBEWPOSETSF_STADA_B "Ende positives Ueberwachungsfenster" VALUE 0x26E43F kw_ui8_S6_S3 2500 UMR_MSEC__10_1_0_S6_S3 0 2500 /end CHARACTERISTIC
/begin CHARACTERISTIC T_UEAMPTSF_STADA_B "Zeitfenster f.Erkennung Amplitude" VALUE 0x26E440 kw_ui8_S6_S3 2500 UMR_MSEC__10_1_0_S6_S3 0 2500 /end CHARACTERISTIC
/begin CHARACTERISTIC TO_SFVORADA_STADA_C "Offset auf SF-Puls bei 1.Puls" VALUE 0x26D3D8 kw_si16_S6_S3 2000 UMR_MSEC__1_1_0_S6_S3 -1000 1000 /end CHARACTERISTIC
/begin CHARACTERISTIC TO_SFNACHADA_STADA_C "Offset auf SF-Puls nach Adaption" VALUE 0x26E441 kw_si8_S6_S3 2000 UMR_MSEC__10_1_0_S6_S3 -1000 1000 /end CHARACTERISTIC
/begin CHARACTERISTIC T_UEBEWNEGBTSF_STADA_C "Start negatives Ueberwachungsfenster" VALUE 0x26E442 kw_ui8_S6_S3 2550 UMR_MSEC__10_1_0_S6_S3 0 2550 /end CHARACTERISTIC
/begin CHARACTERISTIC T_UEBEWNEGETSF_STADA_C "Ende negatives Ueberwachungsfenster" VALUE 0x26E443 kw_ui8_S6_S3 2550 UMR_MSEC__10_1_0_S6_S3 0 2550 /end CHARACTERISTIC
/begin CHARACTERISTIC T_UEBEWPOSBTSF_STADA_C "Start positives Ueberwachungsfenster" VALUE 0x26E444 kw_ui8_S6_S3 2500 UMR_MSEC__10_1_0_S6_S3 0 2500 /end CHARACTERISTIC
/begin CHARACTERISTIC T_UEBEWPOSETSF_STADA_C "Ende positives Ueberwachungsfenster" VALUE 0x26E445 kw_ui8_S6_S3 2500 UMR_MSEC__10_1_0_S6_S3 0 2500 /end CHARACTERISTIC
/begin CHARACTERISTIC T_UEAMPTSF_STADA_C "Zeitfenster f.Erkennung Amplitude" VALUE 0x26E446 kw_ui8_S6_S3 2500 UMR_MSEC__10_1_0_S6_S3 0 2500 /end CHARACTERISTIC
/begin CHARACTERISTIC TO_SFVORADA_STADA_D "Offset auf SF-Puls bei 1.Puls" VALUE 0x26D3DA kw_si16_S6_S3 2000 UMR_MSEC__1_1_0_S6_S3 -1000 1000 /end CHARACTERISTIC
/begin CHARACTERISTIC TO_SFNACHADA_STADA_D "Offset auf SF-Puls nach Adaption" VALUE 0x26E447 kw_si8_S6_S3 2000 UMR_MSEC__10_1_0_S6_S3 -1000 1000 /end CHARACTERISTIC
/begin CHARACTERISTIC T_UEBEWNEGBTSF_STADA_D "Start negatives Ueberwachungsfenster" VALUE 0x26E448 kw_ui8_S6_S3 2550 UMR_MSEC__10_1_0_S6_S3 0 2550 /end CHARACTERISTIC
/begin CHARACTERISTIC T_UEBEWNEGETSF_STADA_D "Ende negatives Ueberwachungsfenster" VALUE 0x26E449 kw_ui8_S6_S3 2550 UMR_MSEC__10_1_0_S6_S3 0 2550 /end CHARACTERISTIC
/begin CHARACTERISTIC T_UEBEWPOSBTSF_STADA_D "Start positives Ueberwachungsfenster" VALUE 0x26E44A kw_ui8_S6_S3 2500 UMR_MSEC__10_1_0_S6_S3 0 2500 /end CHARACTERISTIC
/begin CHARACTERISTIC T_UEBEWPOSETSF_STADA_D "Ende positives Ueberwachungsfenster" VALUE 0x26E44B kw_ui8_S6_S3 2500 UMR_MSEC__10_1_0_S6_S3 0 2500 /end CHARACTERISTIC
/begin CHARACTERISTIC T_UEAMPTSF_STADA_D "Zeitfenster f.Erkennung Amplitude" VALUE 0x26E44C kw_ui8_S6_S3 2500 UMR_MSEC__10_1_0_S6_S3 0 2500 /end CHARACTERISTIC
/begin CHARACTERISTIC TO_SFVORADA_STADA_E "Offset auf SF-Puls bei 1.Puls" VALUE 0x26D3DC kw_si16_S6_S3 2000 UMR_MSEC__1_1_0_S6_S3 -1000 1000 /end CHARACTERISTIC
/begin CHARACTERISTIC TO_SFNACHADA_STADA_E "Offset auf SF-Puls nach Adaption" VALUE 0x26E44D kw_si8_S6_S3 2000 UMR_MSEC__10_1_0_S6_S3 -1000 1000 /end CHARACTERISTIC
/begin CHARACTERISTIC T_UEBEWNEGBTSF_STADA_E "Start negatives Ueberwachungsfenster" VALUE 0x26E44E kw_ui8_S6_S3 2550 UMR_MSEC__10_1_0_S6_S3 0 2550 /end CHARACTERISTIC
/begin CHARACTERISTIC T_UEBEWNEGETSF_STADA_E "Ende negatives Ueberwachungsfenster" VALUE 0x26E44F kw_ui8_S6_S3 2550 UMR_MSEC__10_1_0_S6_S3 0 2550 /end CHARACTERISTIC
/begin CHARACTERISTIC T_UEBEWPOSBTSF_STADA_E "Start positives Ueberwachungsfenster" VALUE 0x26E450 kw_ui8_S6_S3 2500 UMR_MSEC__10_1_0_S6_S3 0 2500 /end CHARACTERISTIC
/begin CHARACTERISTIC T_UEBEWPOSETSF_STADA_E "Ende positives Ueberwachungsfenster" VALUE 0x26E451 kw_ui8_S6_S3 2500 UMR_MSEC__10_1_0_S6_S3 0 2500 /end CHARACTERISTIC
/begin CHARACTERISTIC T_UEAMPTSF_STADA_E "Zeitfenster f.Erkennung Amplitude" VALUE 0x26E452 kw_ui8_S6_S3 2500 UMR_MSEC__10_1_0_S6_S3 0 2500 /end CHARACTERISTIC
/begin CHARACTERISTIC TO_SFVORADA_STADA_K0 "Offset auf SF-Puls bei 1.Puls" VALUE 0x26D3DE kw_si16_S6_S3 2000 UMR_MSEC__1_1_0_S6_S3 -1000 1000 /end CHARACTERISTIC
/begin CHARACTERISTIC TO_SFNACHADA_STADA_K0 "Offset auf SF-Puls nach Adaption" VALUE 0x26E453 kw_si8_S6_S3 2000 UMR_MSEC__10_1_0_S6_S3 -1000 1000 /end CHARACTERISTIC
/begin CHARACTERISTIC T_UEBEWNEGBTSF_STADA_K0 "Start negatives Ueberwachungsfenster" VALUE 0x26E454 kw_ui8_S6_S3 2550 UMR_MSEC__10_1_0_S6_S3 0 2550 /end CHARACTERISTIC
/begin CHARACTERISTIC T_UEBEWNEGETSF_STADA_K0 "Ende negatives Ueberwachungsfenster" VALUE 0x26E455 kw_ui8_S6_S3 2550 UMR_MSEC__10_1_0_S6_S3 0 2550 /end CHARACTERISTIC
/begin CHARACTERISTIC T_UEBEWPOSBTSF_STADA_K0 "Start positives Ueberwachungsfenster" VALUE 0x26E456 kw_ui8_S6_S3 2500 UMR_MSEC__10_1_0_S6_S3 0 2500 /end CHARACTERISTIC
/begin CHARACTERISTIC T_UEBEWPOSETSF_STADA_K0 "Ende positives Ueberwachungsfenster" VALUE 0x26E457 kw_ui8_S6_S3 2500 UMR_MSEC__10_1_0_S6_S3 0 2500 /end CHARACTERISTIC
/begin CHARACTERISTIC T_UEAMPTSF_STADA_K0 "Zeitfenster f.Erkennung Amplitude" VALUE 0x26E458 kw_ui8_S6_S3 2500 UMR_MSEC__10_1_0_S6_S3 0 2500 /end CHARACTERISTIC
/begin CHARACTERISTIC CS_SCHALTUNG_URL "Temperaturschwelle Sonderfunktion Urluftdetektion" VALUE 0x26E4B2 kw_ui8_S6_S3 190 UMR_GRADC__1_1_M40_S6_S3 -40 150 /end CHARACTERISTIC
/begin CHARACTERISTIC MT_KUPADA_URL "Turbinenmomentschwelle Sonderfunktion Urluftdetektion" VALUE 0x26D48A kw_si16_S6_S3 1300 UMR_NM__1_1_0_S6_S3 -300 1000 /end CHARACTERISTIC
/begin CHARACTERISTIC PS_SCHALTUNG_URL "Bremsdruckschwelle Sonderfunktion Urluftdetektion" VALUE 0x26E4B3 kw_ui8_S6_S3 100 UMR_BAR__1_1_0_S6_S3 0 100 /end CHARACTERISTIC
/begin CHARACTERISTIC MS_MOTIST_URL "Schwelle für Istmomentänderung Sonderfunktion Urluftdetektion" VALUE 0x26D48C kw_si16_S6_S3 1000 UMR_NM__1_1_0_S6_S3 0 1000 /end CHARACTERISTIC
/begin CHARACTERISTIC SWI_NTNAB_URL "Schalter zur Auswahl n_t bzw. n_ab zur Gradientenberechnung Sonderfunktion Urluftdetektion" VALUE 0x26E4B4 kw_ui8_S6_S3 1 UMR___1_1_0_S6_S3 0 1 /end CHARACTERISTIC
/begin CHARACTERISTIC MPT_URL "PT1 Filter für Drehzahlgradienenfilterung Sonderfunktion Urluftdetektion" VALUE 0x26E4B5 kw_ui8_S6_S3 0.99 UMR___1_100_0_S6_S3 0.01 1 /end CHARACTERISTIC
/begin CHARACTERISTIC TAB_TBEW_SCHALTUNG_URL "Bewertungsfenster für Sonderfunktion Urluftdetektion" CURVE 0x21E0C0 tab_ui8_S6_S3 1500 UMR_MSEC__10_1_0_S6_S3 0 1500
 /begin AXIS_DESCR FIX_AXIS NO_INPUT_QUANTITY UMR___1_1_0_S6_S3 5 1 5 FIX_AXIS_PAR_DIST 1 1 5 /end AXIS_DESCR
/end CHARACTERISTIC
/begin CHARACTERISTIC TAB_NG_SCHALTUNG_URL "Tabelle zur Bewertung des Drehzahlgradienten während Schaltung bei aktiver Sonderfunktion Urluftdetektion" CURVE 0x21E0CC tab_ui16_S6_S3 10000 UMR_U_MINSEC_10_1_0_S6_S3 0 10000
 /begin AXIS_DESCR FIX_AXIS NO_INPUT_QUANTITY UMR___1_1_0_S6_S3 5 1 5 FIX_AXIS_PAR_DIST 1 1 5 /end AXIS_DESCR
/end CHARACTERISTIC
/begin CHARACTERISTIC TAB_TBEW_KUPADA_URL "Bewertungsfenster für Sonderfunktion Urluftdetektion" CURVE 0x21E094 tab_ui8_S6_S3 1500 UMR_MSEC__10_1_0_S6_S3 0 1500
 /begin AXIS_DESCR FIX_AXIS NO_INPUT_QUANTITY UMR___1_1_0_S6_S3 6 1 6 FIX_AXIS_PAR_DIST 1 1 6 /end AXIS_DESCR
/end CHARACTERISTIC
/begin CHARACTERISTIC TAB_NGUETETSF_KUPADA_URL "Tabelle zur Bewertung von n_guete während Pulsprüfung TSF bei aktiver Sonderfunktion Urluftdetektion" CURVE 0x21E0A0 tab_ui16_S6_S3 1000 UMR_U_MIN_1_1_0_S6_S3 0 1000
 /begin AXIS_DESCR FIX_AXIS NO_INPUT_QUANTITY UMR___1_1_0_S6_S3 6 1 6 FIX_AXIS_PAR_DIST 1 1 6 /end AXIS_DESCR
/end CHARACTERISTIC
/begin CHARACTERISTIC TAB_NGUETEPF_KUPADA_URL "Tabelle zur Bewertung von n_guete während Pulsprüfung PF bei aktiver Sonderfunktion Urluftdetektion" CURVE 0x21E0B0 tab_ui16_S6_S3 1000 UMR_U_MIN_1_1_0_S6_S3 0 1000
 /begin AXIS_DESCR FIX_AXIS NO_INPUT_QUANTITY UMR___1_1_0_S6_S3 6 1 6 FIX_AXIS_PAR_DIST 1 1 6 /end AXIS_DESCR
/end CHARACTERISTIC
/begin CHARACTERISTIC TAB_SWI_URL "Tabelle zur Aktivierung der Sonderfunktion Urluftdetektion KUP A-E(F)(K0): 0=keine, 1=Puls, 2=Schaltung, 3=Puls und Schaltung" CURVE 0x21E078 tab_ui8_S6_S3 3 UMR___1_1_0_S6_S3 0 3
 /begin AXIS_DESCR FIX_AXIS NO_INPUT_QUANTITY UMR___1_1_0_S6_S3 6 1 6 FIX_AXIS_PAR_DIST 1 1 6 /end AXIS_DESCR
/end CHARACTERISTIC
/begin CHARACTERISTIC TAB_PRUEFTSF_URL "Anzahl Befüllprüfungen bis zur Deaktivierung der Sonderfunktion Urluftdetektion" CURVE 0x21E084 tab_ui16_S6_S3 10000 UMR___1_1_0_S6_S3 0 10000
 /begin AXIS_DESCR FIX_AXIS NO_INPUT_QUANTITY UMR___1_1_0_S6_S3 6 1 6 FIX_AXIS_PAR_DIST 1 1 6 /end AXIS_DESCR
/end CHARACTERISTIC
/begin CHARACTERISTIC SWI_PRUEFTSF_URL "Auswahl-Switch Urluftdetektion dauerhaft aktiv" VALUE 0x26E4B1 kw_bool8_S6_S3 1 UMR___1_1_0_S6_S3 0 1 /end CHARACTERISTIC
/begin CHARACTERISTIC KF_PGLSAD_KF1_12 "Adaptionswert in Abh. des mittl. Regeleingr. KF1" MAP 0x218AA8 kf_si16_S6_S3 2.5 UMR_BAR__1_100_0_S6_S3 -1.25 1.25
 /begin AXIS_DESCR STD_AXIS iAdaGlast.pm_gls_korr UMR_BAR__1_100_0_S6_S3 8 -2.55 2.55 DEPOSIT ABSOLUTE MONOTONY MON_INCREASE /end AXIS_DESCR
 /begin AXIS_DESCR STD_AXIS NO_INPUT_QUANTITY UMR_GRADC__1_1_M40_S6_S3 4 -40 215 DEPOSIT ABSOLUTE MONOTONY MON_INCREASE /end AXIS_DESCR
/end CHARACTERISTIC
/begin CHARACTERISTIC KF_F_PMGLSKF1KORR12 "Korr.faktor für pm_gls KF1" MAP 0x218B08 kf_si16_S6_S3 2 UMR___1_100_0_S6_S3 0 2
 /begin AXIS_DESCR STD_AXIS iItfInput.n_t UMR_U_MIN_1_1_0_S6_S3 6 0 8160 DEPOSIT ABSOLUTE MONOTONY MON_INCREASE /end AXIS_DESCR
 /begin AXIS_DESCR STD_AXIS iItfInput.m_t UMR_NM__1_1_0_S6_S3 4 -400 1640 DEPOSIT ABSOLUTE MONOTONY MON_INCREASE /end AXIS_DESCR
/end CHARACTERISTIC
/begin CHARACTERISTIC KF_PGLSAD_KF2_12 "Adaptionswert in Abh. des mittl. Regeleingr. KF2" MAP 0x218B54 kf_si16_S6_S3 2.5 UMR_BAR__1_100_0_S6_S3 -1.25 1.25
 /begin AXIS_DESCR STD_AXIS iAdaGlast.pm_gls_korr UMR_BAR__1_100_0_S6_S3 8 -2.55 2.55 DEPOSIT ABSOLUTE MONOTONY MON_INCREASE /end AXIS_DESCR
 /begin AXIS_DESCR STD_AXIS NO_INPUT_QUANTITY UMR_GRADC__1_1_M40_S6_S3 4 -40 215 DEPOSIT ABSOLUTE MONOTONY MON_INCREASE /end AXIS_DESCR
/end CHARACTERISTIC
/begin CHARACTERISTIC KF_F_PMGLSKF2KORR12 "Korr.faktor für pm_gls KF 2" MAP 0x218BB4 kf_si16_S6_S3 2 UMR___1_100_0_S6_S3 0 2
 /begin AXIS_DESCR STD_AXIS iItfInput.n_t UMR_U_MIN_1_1_0_S6_S3 6 0 8160 DEPOSIT ABSOLUTE MONOTONY MON_INCREASE /end AXIS_DESCR
 /begin AXIS_DESCR STD_AXIS iItfInput.m_t UMR_NM__1_1_0_S6_S3 4 -400 1640 DEPOSIT ABSOLUTE MONOTONY MON_INCREASE /end AXIS_DESCR
/end CHARACTERISTIC
/begin CHARACTERISTIC KF_F_PMGLSKF1KORRKALT12 "Korr.faktor für pm_gls KF 1 Kalt" MAP 0x218C00 kf_si16_S6_S3 2 UMR___1_100_0_S6_S3 0 2
 /begin AXIS_DESCR STD_AXIS iItfInput.n_t UMR_U_MIN_1_1_0_S6_S3 6 0 8160 DEPOSIT ABSOLUTE MONOTONY MON_INCREASE /end AXIS_DESCR
 /begin AXIS_DESCR STD_AXIS iItfInput.m_t UMR_NM__1_1_0_S6_S3 4 -400 1640 DEPOSIT ABSOLUTE MONOTONY MON_INCREASE /end AXIS_DESCR
/end CHARACTERISTIC
/begin CHARACTERISTIC KF_F_PMGLSKF2KORRKALT12 "Korr.faktor für pm_gls KF2 Kalt" MAP 0x218C4C kf_si16_S6_S3 2 UMR___1_100_0_S6_S3 0 2
 /begin AXIS_DESCR STD_AXIS iItfInput.n_t UMR_U_MIN_1_1_0_S6_S3 6 0 8160 DEPOSIT ABSOLUTE MONOTONY MON_INCREASE /end AXIS_DESCR
 /begin AXIS_DESCR STD_AXIS iItfInput.m_t UMR_NM__1_1_0_S6_S3 4 -400 1640 DEPOSIT ABSOLUTE MONOTONY MON_INCREASE /end AXIS_DESCR
/end CHARACTERISTIC
/begin CHARACTERISTIC KF_PGLSAD_KF3_12 "Adaptionswert in Abh. des mittl. Regeleingr. HS KF3" MAP 0x218C98 kf_si16_S6_S3 2.5 UMR_BAR__1_100_0_S6_S3 -1.25 1.25
 /begin AXIS_DESCR STD_AXIS iAdaGlast.pm_gls_korr UMR_BAR__1_100_0_S6_S3 8 -2.55 2.55 DEPOSIT ABSOLUTE MONOTONY MON_INCREASE /end AXIS_DESCR
 /begin AXIS_DESCR STD_AXIS NO_INPUT_QUANTITY UMR_GRADC__1_1_M40_S6_S3 4 -40 215 DEPOSIT ABSOLUTE MONOTONY MON_INCREASE /end AXIS_DESCR
/end CHARACTERISTIC
/begin CHARACTERISTIC KF_F_PMGLSKF3KORR12 "Korr.faktor für pm_gls KF 3" MAP 0x218CF8 kf_si16_S6_S3 2 UMR___1_100_0_S6_S3 0 2
 /begin AXIS_DESCR STD_AXIS iItfInput.n_t UMR_U_MIN_1_1_0_S6_S3 6 0 8160 DEPOSIT ABSOLUTE MONOTONY MON_INCREASE /end AXIS_DESCR
 /begin AXIS_DESCR STD_AXIS iItfInput.m_t UMR_NM__1_1_0_S6_S3 4 -400 1640 DEPOSIT ABSOLUTE MONOTONY MON_INCREASE /end AXIS_DESCR
/end CHARACTERISTIC
/begin CHARACTERISTIC KF_F_PMGLSKF3KORRKALT12 "Korr.faktor für pm_gls KF3 Kalt" MAP 0x218D44 kf_si16_S6_S3 2 UMR___1_100_0_S6_S3 0 2
 /begin AXIS_DESCR STD_AXIS iItfInput.n_t UMR_U_MIN_1_1_0_S6_S3 6 0 8160 DEPOSIT ABSOLUTE MONOTONY MON_INCREASE /end AXIS_DESCR
 /begin AXIS_DESCR STD_AXIS iItfInput.m_t UMR_NM__1_1_0_S6_S3 4 -400 1640 DEPOSIT ABSOLUTE MONOTONY MON_INCREASE /end AXIS_DESCR
/end CHARACTERISTIC
/begin CHARACTERISTIC KF_PGLSAD_KF1_23 "Adaptionswert in Abh. des mittl. Regeleingr. KF1" MAP 0x218D90 kf_si16_S6_S3 2.5 UMR_BAR__1_100_0_S6_S3 -1.25 1.25
 /begin AXIS_DESCR STD_AXIS iAdaGlast.pm_gls_korr UMR_BAR__1_100_0_S6_S3 8 -2.55 2.55 DEPOSIT ABSOLUTE MONOTONY MON_INCREASE /end AXIS_DESCR
 /begin AXIS_DESCR STD_AXIS NO_INPUT_QUANTITY UMR_GRADC__1_1_M40_S6_S3 4 -40 215 DEPOSIT ABSOLUTE MONOTONY MON_INCREASE /end AXIS_DESCR
/end CHARACTERISTIC
/begin CHARACTERISTIC KF_F_PMGLSKF1KORR23 "Korr.faktor für pm_gls KF1" MAP 0x218DF0 kf_si16_S6_S3 2 UMR___1_100_0_S6_S3 0 2
 /begin AXIS_DESCR STD_AXIS iItfInput.n_t UMR_U_MIN_1_1_0_S6_S3 6 0 8160 DEPOSIT ABSOLUTE MONOTONY MON_INCREASE /end AXIS_DESCR
 /begin AXIS_DESCR STD_AXIS iItfInput.m_t UMR_NM__1_1_0_S6_S3 4 -400 1640 DEPOSIT ABSOLUTE MONOTONY MON_INCREASE /end AXIS_DESCR
/end CHARACTERISTIC
/begin CHARACTERISTIC KF_PGLSAD_KF2_23 "Adaptionswert in Abh. des mittl. Regeleingr. KF2" MAP 0x218E3C kf_si16_S6_S3 2.5 UMR_BAR__1_100_0_S6_S3 -1.25 1.25
 /begin AXIS_DESCR STD_AXIS iAdaGlast.pm_gls_korr UMR_BAR__1_100_0_S6_S3 8 -2.55 2.55 DEPOSIT ABSOLUTE MONOTONY MON_INCREASE /end AXIS_DESCR
 /begin AXIS_DESCR STD_AXIS NO_INPUT_QUANTITY UMR_GRADC__1_1_M40_S6_S3 4 -40 215 DEPOSIT ABSOLUTE MONOTONY MON_INCREASE /end AXIS_DESCR
/end CHARACTERISTIC
/begin CHARACTERISTIC KF_F_PMGLSKF2KORR23 "Korr.faktor für pm_gls KF 2" MAP 0x218E9C kf_si16_S6_S3 2 UMR___1_100_0_S6_S3 0 2
 /begin AXIS_DESCR STD_AXIS iItfInput.n_t UMR_U_MIN_1_1_0_S6_S3 6 0 8160 DEPOSIT ABSOLUTE MONOTONY MON_INCREASE /end AXIS_DESCR
 /begin AXIS_DESCR STD_AXIS iItfInput.m_t UMR_NM__1_1_0_S6_S3 4 -400 1640 DEPOSIT ABSOLUTE MONOTONY MON_INCREASE /end AXIS_DESCR
/end CHARACTERISTIC
/begin CHARACTERISTIC KF_F_PMGLSKF1KORRKALT23 "Korr.faktor für pm_gls KF 1 Kalt" MAP 0x218EE8 kf_si16_S6_S3 2 UMR___1_100_0_S6_S3 0 2
 /begin AXIS_DESCR STD_AXIS iItfInput.n_t UMR_U_MIN_1_1_0_S6_S3 6 0 8160 DEPOSIT ABSOLUTE MONOTONY MON_INCREASE /end AXIS_DESCR
 /begin AXIS_DESCR STD_AXIS iItfInput.m_t UMR_NM__1_1_0_S6_S3 4 -400 1640 DEPOSIT ABSOLUTE MONOTONY MON_INCREASE /end AXIS_DESCR
/end CHARACTERISTIC
/begin CHARACTERISTIC KF_F_PMGLSKF2KORRKALT23 "Korr.faktor für pm_gls KF2 Kalt" MAP 0x218F34 kf_si16_S6_S3 2 UMR___1_100_0_S6_S3 0 2
 /begin AXIS_DESCR STD_AXIS iItfInput.n_t UMR_U_MIN_1_1_0_S6_S3 6 0 8160 DEPOSIT ABSOLUTE MONOTONY MON_INCREASE /end AXIS_DESCR
 /begin AXIS_DESCR STD_AXIS iItfInput.m_t UMR_NM__1_1_0_S6_S3 4 -400 1640 DEPOSIT ABSOLUTE MONOTONY MON_INCREASE /end AXIS_DESCR
/end CHARACTERISTIC
/begin CHARACTERISTIC KF_PGLSAD_KF3_23 "Adaptionswert in Abh. des mittl. Regeleingr. HS KF3" MAP 0x218F80 kf_si16_S6_S3 2.5 UMR_BAR__1_100_0_S6_S3 -1.25 1.25
 /begin AXIS_DESCR STD_AXIS iAdaGlast.pm_gls_korr UMR_BAR__1_100_0_S6_S3 8 -2.55 2.55 DEPOSIT ABSOLUTE MONOTONY MON_INCREASE /end AXIS_DESCR
 /begin AXIS_DESCR STD_AXIS NO_INPUT_QUANTITY UMR_GRADC__1_1_M40_S6_S3 4 -40 215 DEPOSIT ABSOLUTE MONOTONY MON_INCREASE /end AXIS_DESCR
/end CHARACTERISTIC
/begin CHARACTERISTIC KF_F_PMGLSKF3KORR23 "Korr.faktor für pm_gls KF 3" MAP 0x218FE0 kf_si16_S6_S3 2 UMR___1_100_0_S6_S3 0 2
 /begin AXIS_DESCR STD_AXIS iItfInput.n_t UMR_U_MIN_1_1_0_S6_S3 6 0 8160 DEPOSIT ABSOLUTE MONOTONY MON_INCREASE /end AXIS_DESCR
 /begin AXIS_DESCR STD_AXIS iItfInput.m_t UMR_NM__1_1_0_S6_S3 4 -400 1640 DEPOSIT ABSOLUTE MONOTONY MON_INCREASE /end AXIS_DESCR
/end CHARACTERISTIC
/begin CHARACTERISTIC KF_F_PMGLSKF3KORRKALT23 "Korr.faktor für pm_gls KF3 Kalt" MAP 0x21902C kf_si16_S6_S3 2 UMR___1_100_0_S6_S3 0 2
 /begin AXIS_DESCR STD_AXIS iItfInput.n_t UMR_U_MIN_1_1_0_S6_S3 6 0 8160 DEPOSIT ABSOLUTE MONOTONY MON_INCREASE /end AXIS_DESCR
 /begin AXIS_DESCR STD_AXIS iItfInput.m_t UMR_NM__1_1_0_S6_S3 4 -400 1640 DEPOSIT ABSOLUTE MONOTONY MON_INCREASE /end AXIS_DESCR
/end CHARACTERISTIC
/begin CHARACTERISTIC KF_PGLSAD_KF1_34 "Adaptionswert in Abh. des mittl. Regeleingr. KF1" MAP 0x219078 kf_si16_S6_S3 2.5 UMR_BAR__1_100_0_S6_S3 -1.25 1.25
 /begin AXIS_DESCR STD_AXIS iAdaGlast.pm_gls_korr UMR_BAR__1_100_0_S6_S3 8 -2.55 2.55 DEPOSIT ABSOLUTE MONOTONY MON_INCREASE /end AXIS_DESCR
 /begin AXIS_DESCR STD_AXIS NO_INPUT_QUANTITY UMR_GRADC__1_1_M40_S6_S3 4 -40 215 DEPOSIT ABSOLUTE MONOTONY MON_INCREASE /end AXIS_DESCR
/end CHARACTERISTIC
/begin CHARACTERISTIC KF_F_PMGLSKF1KORR34 "Korr.faktor für pm_gls KF1" MAP 0x2190D8 kf_si16_S6_S3 2 UMR___1_100_0_S6_S3 0 2
 /begin AXIS_DESCR STD_AXIS iItfInput.n_t UMR_U_MIN_1_1_0_S6_S3 6 0 8160 DEPOSIT ABSOLUTE MONOTONY MON_INCREASE /end AXIS_DESCR
 /begin AXIS_DESCR STD_AXIS iItfInput.m_t UMR_NM__1_1_0_S6_S3 4 -400 1640 DEPOSIT ABSOLUTE MONOTONY MON_INCREASE /end AXIS_DESCR
/end CHARACTERISTIC
/begin CHARACTERISTIC KF_PGLSAD_KF2_34 "Adaptionswert in Abh. des mittl. Regeleingr. KF2" MAP 0x219124 kf_si16_S6_S3 2.5 UMR_BAR__1_100_0_S6_S3 -1.25 1.25
 /begin AXIS_DESCR STD_AXIS iAdaGlast.pm_gls_korr UMR_BAR__1_100_0_S6_S3 8 -2.55 2.55 DEPOSIT ABSOLUTE MONOTONY MON_INCREASE /end AXIS_DESCR
 /begin AXIS_DESCR STD_AXIS NO_INPUT_QUANTITY UMR_GRADC__1_1_M40_S6_S3 4 -40 215 DEPOSIT ABSOLUTE MONOTONY MON_INCREASE /end AXIS_DESCR
/end CHARACTERISTIC
/begin CHARACTERISTIC KF_F_PMGLSKF2KORR34 "Korr.faktor für pm_gls KF 2" MAP 0x219184 kf_si16_S6_S3 2 UMR___1_100_0_S6_S3 0 2
 /begin AXIS_DESCR STD_AXIS iItfInput.n_t UMR_U_MIN_1_1_0_S6_S3 6 0 8160 DEPOSIT ABSOLUTE MONOTONY MON_INCREASE /end AXIS_DESCR
 /begin AXIS_DESCR STD_AXIS iItfInput.m_t UMR_NM__1_1_0_S6_S3 4 -400 1640 DEPOSIT ABSOLUTE MONOTONY MON_INCREASE /end AXIS_DESCR
/end CHARACTERISTIC
/begin CHARACTERISTIC KF_F_PMGLSKF1KORRKALT34 "Korr.faktor für pm_gls KF 1 Kalt" MAP 0x2191D0 kf_si16_S6_S3 2 UMR___1_100_0_S6_S3 0 2
 /begin AXIS_DESCR STD_AXIS iItfInput.n_t UMR_U_MIN_1_1_0_S6_S3 6 0 8160 DEPOSIT ABSOLUTE MONOTONY MON_INCREASE /end AXIS_DESCR
 /begin AXIS_DESCR STD_AXIS iItfInput.m_t UMR_NM__1_1_0_S6_S3 4 -400 1640 DEPOSIT ABSOLUTE MONOTONY MON_INCREASE /end AXIS_DESCR
/end CHARACTERISTIC
/begin CHARACTERISTIC KF_F_PMGLSKF2KORRKALT34 "Korr.faktor für pm_gls KF2 Kalt" MAP 0x21921C kf_si16_S6_S3 2 UMR___1_100_0_S6_S3 0 2
 /begin AXIS_DESCR STD_AXIS iItfInput.n_t UMR_U_MIN_1_1_0_S6_S3 6 0 8160 DEPOSIT ABSOLUTE MONOTONY MON_INCREASE /end AXIS_DESCR
 /begin AXIS_DESCR STD_AXIS iItfInput.m_t UMR_NM__1_1_0_S6_S3 4 -400 1640 DEPOSIT ABSOLUTE MONOTONY MON_INCREASE /end AXIS_DESCR
/end CHARACTERISTIC
/begin CHARACTERISTIC KF_PGLSAD_KF3_34 "Adaptionswert in Abh. des mittl. Regeleingr. HS KF3" MAP 0x219268 kf_si16_S6_S3 2.5 UMR_BAR__1_100_0_S6_S3 -1.25 1.25
 /begin AXIS_DESCR STD_AXIS iAdaGlast.pm_gls_korr UMR_BAR__1_100_0_S6_S3 8 -2.55 2.55 DEPOSIT ABSOLUTE MONOTONY MON_INCREASE /end AXIS_DESCR
 /begin AXIS_DESCR STD_AXIS NO_INPUT_QUANTITY UMR_GRADC__1_1_M40_S6_S3 4 -40 215 DEPOSIT ABSOLUTE MONOTONY MON_INCREASE /end AXIS_DESCR
/end CHARACTERISTIC
/begin CHARACTERISTIC KF_F_PMGLSKF3KORR34 "Korr.faktor für pm_gls KF 3" MAP 0x2192C8 kf_si16_S6_S3 2 UMR___1_100_0_S6_S3 0 2
 /begin AXIS_DESCR STD_AXIS iItfInput.n_t UMR_U_MIN_1_1_0_S6_S3 6 0 8160 DEPOSIT ABSOLUTE MONOTONY MON_INCREASE /end AXIS_DESCR
 /begin AXIS_DESCR STD_AXIS iItfInput.m_t UMR_NM__1_1_0_S6_S3 4 -400 1640 DEPOSIT ABSOLUTE MONOTONY MON_INCREASE /end AXIS_DESCR
/end CHARACTERISTIC
/begin CHARACTERISTIC KF_F_PMGLSKF3KORRKALT34 "Korr.faktor für pm_gls KF3 Kalt" MAP 0x219314 kf_si16_S6_S3 2 UMR___1_100_0_S6_S3 0 2
 /begin AXIS_DESCR STD_AXIS iItfInput.n_t UMR_U_MIN_1_1_0_S6_S3 6 0 8160 DEPOSIT ABSOLUTE MONOTONY MON_INCREASE /end AXIS_DESCR
 /begin AXIS_DESCR STD_AXIS iItfInput.m_t UMR_NM__1_1_0_S6_S3 4 -400 1640 DEPOSIT ABSOLUTE MONOTONY MON_INCREASE /end AXIS_DESCR
/end CHARACTERISTIC
/begin CHARACTERISTIC KF_PGLSAD_KF1_45 "Adaptionswert in Abh. des mittl. Regeleingr. KF1" MAP 0x219360 kf_si16_S6_S3 2.5 UMR_BAR__1_100_0_S6_S3 -1.25 1.25
 /begin AXIS_DESCR STD_AXIS iAdaGlast.pm_gls_korr UMR_BAR__1_100_0_S6_S3 8 -2.55 2.55 DEPOSIT ABSOLUTE MONOTONY MON_INCREASE /end AXIS_DESCR
 /begin AXIS_DESCR STD_AXIS NO_INPUT_QUANTITY UMR_GRADC__1_1_M40_S6_S3 4 -40 215 DEPOSIT ABSOLUTE MONOTONY MON_INCREASE /end AXIS_DESCR
/end CHARACTERISTIC
/begin CHARACTERISTIC KF_F_PMGLSKF1KORR45 "Korr.faktor für pm_gls KF1" MAP 0x2193C0 kf_si16_S6_S3 2 UMR___1_100_0_S6_S3 0 2
 /begin AXIS_DESCR STD_AXIS iItfInput.n_t UMR_U_MIN_1_1_0_S6_S3 6 0 8160 DEPOSIT ABSOLUTE MONOTONY MON_INCREASE /end AXIS_DESCR
 /begin AXIS_DESCR STD_AXIS iItfInput.m_t UMR_NM__1_1_0_S6_S3 4 -400 1640 DEPOSIT ABSOLUTE MONOTONY MON_INCREASE /end AXIS_DESCR
/end CHARACTERISTIC
/begin CHARACTERISTIC KF_PGLSAD_KF2_45 "Adaptionswert in Abh. des mittl. Regeleingr. KF2" MAP 0x21940C kf_si16_S6_S3 2.5 UMR_BAR__1_100_0_S6_S3 -1.25 1.25
 /begin AXIS_DESCR STD_AXIS iAdaGlast.pm_gls_korr UMR_BAR__1_100_0_S6_S3 8 -2.55 2.55 DEPOSIT ABSOLUTE MONOTONY MON_INCREASE /end AXIS_DESCR
 /begin AXIS_DESCR STD_AXIS NO_INPUT_QUANTITY UMR_GRADC__1_1_M40_S6_S3 4 -40 215 DEPOSIT ABSOLUTE MONOTONY MON_INCREASE /end AXIS_DESCR
/end CHARACTERISTIC
/begin CHARACTERISTIC KF_F_PMGLSKF2KORR45 "Korr.faktor für pm_gls KF 2" MAP 0x21946C kf_si16_S6_S3 2 UMR___1_100_0_S6_S3 0 2
 /begin AXIS_DESCR STD_AXIS iItfInput.n_t UMR_U_MIN_1_1_0_S6_S3 6 0 8160 DEPOSIT ABSOLUTE MONOTONY MON_INCREASE /end AXIS_DESCR
 /begin AXIS_DESCR STD_AXIS iItfInput.m_t UMR_NM__1_1_0_S6_S3 4 -400 1640 DEPOSIT ABSOLUTE MONOTONY MON_INCREASE /end AXIS_DESCR
/end CHARACTERISTIC
/begin CHARACTERISTIC KF_F_PMGLSKF1KORRKALT45 "Korr.faktor für pm_gls KF 1 Kalt" MAP 0x2194B8 kf_si16_S6_S3 2 UMR___1_100_0_S6_S3 0 2
 /begin AXIS_DESCR STD_AXIS iItfInput.n_t UMR_U_MIN_1_1_0_S6_S3 6 0 8160 DEPOSIT ABSOLUTE MONOTONY MON_INCREASE /end AXIS_DESCR
 /begin AXIS_DESCR STD_AXIS iItfInput.m_t UMR_NM__1_1_0_S6_S3 4 -400 1640 DEPOSIT ABSOLUTE MONOTONY MON_INCREASE /end AXIS_DESCR
/end CHARACTERISTIC
/begin CHARACTERISTIC KF_F_PMGLSKF2KORRKALT45 "Korr.faktor für pm_gls KF2 Kalt" MAP 0x219504 kf_si16_S6_S3 2 UMR___1_100_0_S6_S3 0 2
 /begin AXIS_DESCR STD_AXIS iItfInput.n_t UMR_U_MIN_1_1_0_S6_S3 6 0 8160 DEPOSIT ABSOLUTE MONOTONY MON_INCREASE /end AXIS_DESCR
 /begin AXIS_DESCR STD_AXIS iItfInput.m_t UMR_NM__1_1_0_S6_S3 4 -400 1640 DEPOSIT ABSOLUTE MONOTONY MON_INCREASE /end AXIS_DESCR
/end CHARACTERISTIC
/begin CHARACTERISTIC KF_PGLSAD_KF3_45 "Adaptionswert in Abh. des mittl. Regeleingr. HS KF3" MAP 0x219550 kf_si16_S6_S3 2.5 UMR_BAR__1_100_0_S6_S3 -1.25 1.25
 /begin AXIS_DESCR STD_AXIS iAdaGlast.pm_gls_korr UMR_BAR__1_100_0_S6_S3 8 -2.55 2.55 DEPOSIT ABSOLUTE MONOTONY MON_INCREASE /end AXIS_DESCR
 /begin AXIS_DESCR STD_AXIS NO_INPUT_QUANTITY UMR_GRADC__1_1_M40_S6_S3 4 -40 215 DEPOSIT ABSOLUTE MONOTONY MON_INCREASE /end AXIS_DESCR
/end CHARACTERISTIC
/begin CHARACTERISTIC KF_F_PMGLSKF3KORR45 "Korr.faktor für pm_gls KF 3" MAP 0x2195B0 kf_si16_S6_S3 2 UMR___1_100_0_S6_S3 0 2
 /begin AXIS_DESCR STD_AXIS iItfInput.n_t UMR_U_MIN_1_1_0_S6_S3 6 0 8160 DEPOSIT ABSOLUTE MONOTONY MON_INCREASE /end AXIS_DESCR
 /begin AXIS_DESCR STD_AXIS iItfInput.m_t UMR_NM__1_1_0_S6_S3 4 -400 1640 DEPOSIT ABSOLUTE MONOTONY MON_INCREASE /end AXIS_DESCR
/end CHARACTERISTIC
/begin CHARACTERISTIC KF_F_PMGLSKF3KORRKALT45 "Korr.faktor für pm_gls KF3 Kalt" MAP 0x2195FC kf_si16_S6_S3 2 UMR___1_100_0_S6_S3 0 2
 /begin AXIS_DESCR STD_AXIS iItfInput.n_t UMR_U_MIN_1_1_0_S6_S3 6 0 8160 DEPOSIT ABSOLUTE MONOTONY MON_INCREASE /end AXIS_DESCR
 /begin AXIS_DESCR STD_AXIS iItfInput.m_t UMR_NM__1_1_0_S6_S3 4 -400 1640 DEPOSIT ABSOLUTE MONOTONY MON_INCREASE /end AXIS_DESCR
/end CHARACTERISTIC
/begin CHARACTERISTIC KF_PGLSAD_KF1_56 "Adaptionswert in Abh. des mittl. Regeleingr. KF1" MAP 0x219648 kf_si16_S6_S3 2.5 UMR_BAR__1_100_0_S6_S3 -1.25 1.25
 /begin AXIS_DESCR STD_AXIS iAdaGlast.pm_gls_korr UMR_BAR__1_100_0_S6_S3 8 -2.55 2.55 DEPOSIT ABSOLUTE MONOTONY MON_INCREASE /end AXIS_DESCR
 /begin AXIS_DESCR STD_AXIS NO_INPUT_QUANTITY UMR_GRADC__1_1_M40_S6_S3 4 -40 215 DEPOSIT ABSOLUTE MONOTONY MON_INCREASE /end AXIS_DESCR
/end CHARACTERISTIC
/begin CHARACTERISTIC KF_F_PMGLSKF1KORR56 "Korr.faktor für pm_gls KF1" MAP 0x2196A8 kf_si16_S6_S3 2 UMR___1_100_0_S6_S3 0 2
 /begin AXIS_DESCR STD_AXIS iItfInput.n_t UMR_U_MIN_1_1_0_S6_S3 6 0 8160 DEPOSIT ABSOLUTE MONOTONY MON_INCREASE /end AXIS_DESCR
 /begin AXIS_DESCR STD_AXIS iItfInput.m_t UMR_NM__1_1_0_S6_S3 4 -400 1640 DEPOSIT ABSOLUTE MONOTONY MON_INCREASE /end AXIS_DESCR
/end CHARACTERISTIC
/begin CHARACTERISTIC KF_PGLSAD_KF2_56 "Adaptionswert in Abh. des mittl. Regeleingr. KF2" MAP 0x2196F4 kf_si16_S6_S3 2.5 UMR_BAR__1_100_0_S6_S3 -1.25 1.25
 /begin AXIS_DESCR STD_AXIS iAdaGlast.pm_gls_korr UMR_BAR__1_100_0_S6_S3 8 -2.55 2.55 DEPOSIT ABSOLUTE MONOTONY MON_INCREASE /end AXIS_DESCR
 /begin AXIS_DESCR STD_AXIS NO_INPUT_QUANTITY UMR_GRADC__1_1_M40_S6_S3 4 -40 215 DEPOSIT ABSOLUTE MONOTONY MON_INCREASE /end AXIS_DESCR
/end CHARACTERISTIC
/begin CHARACTERISTIC KF_F_PMGLSKF2KORR56 "Korr.faktor für pm_gls KF 2" MAP 0x219754 kf_si16_S6_S3 2 UMR___1_100_0_S6_S3 0 2
 /begin AXIS_DESCR STD_AXIS iItfInput.n_t UMR_U_MIN_1_1_0_S6_S3 6 0 8160 DEPOSIT ABSOLUTE MONOTONY MON_INCREASE /end AXIS_DESCR
 /begin AXIS_DESCR STD_AXIS iItfInput.m_t UMR_NM__1_1_0_S6_S3 4 -400 1640 DEPOSIT ABSOLUTE MONOTONY MON_INCREASE /end AXIS_DESCR
/end CHARACTERISTIC
/begin CHARACTERISTIC KF_F_PMGLSKF1KORRKALT56 "Korr.faktor für pm_gls KF 1 Kalt" MAP 0x2197A0 kf_si16_S6_S3 2 UMR___1_100_0_S6_S3 0 2
 /begin AXIS_DESCR STD_AXIS iItfInput.n_t UMR_U_MIN_1_1_0_S6_S3 6 0 8160 DEPOSIT ABSOLUTE MONOTONY MON_INCREASE /end AXIS_DESCR
 /begin AXIS_DESCR STD_AXIS iItfInput.m_t UMR_NM__1_1_0_S6_S3 4 -400 1640 DEPOSIT ABSOLUTE MONOTONY MON_INCREASE /end AXIS_DESCR
/end CHARACTERISTIC
/begin CHARACTERISTIC KF_F_PMGLSKF2KORRKALT56 "Korr.faktor für pm_gls KF2 Kalt" MAP 0x2197EC kf_si16_S6_S3 2 UMR___1_100_0_S6_S3 0 2
 /begin AXIS_DESCR STD_AXIS iItfInput.n_t UMR_U_MIN_1_1_0_S6_S3 6 0 8160 DEPOSIT ABSOLUTE MONOTONY MON_INCREASE /end AXIS_DESCR
 /begin AXIS_DESCR STD_AXIS iItfInput.m_t UMR_NM__1_1_0_S6_S3 4 -400 1640 DEPOSIT ABSOLUTE MONOTONY MON_INCREASE /end AXIS_DESCR
/end CHARACTERISTIC
/begin CHARACTERISTIC KF_PGLSAD_KF3_56 "Adaptionswert in Abh. des mittl. Regeleingr. HS KF3" MAP 0x219838 kf_si16_S6_S3 2.5 UMR_BAR__1_100_0_S6_S3 -1.25 1.25
 /begin AXIS_DESCR STD_AXIS iAdaGlast.pm_gls_korr UMR_BAR__1_100_0_S6_S3 8 -2.55 2.55 DEPOSIT ABSOLUTE MONOTONY MON_INCREASE /end AXIS_DESCR
 /begin AXIS_DESCR STD_AXIS NO_INPUT_QUANTITY UMR_GRADC__1_1_M40_S6_S3 4 -40 215 DEPOSIT ABSOLUTE MONOTONY MON_INCREASE /end AXIS_DESCR
/end CHARACTERISTIC
/begin CHARACTERISTIC KF_F_PMGLSKF3KORR56 "Korr.faktor für pm_gls KF 3" MAP 0x219898 kf_si16_S6_S3 2 UMR___1_100_0_S6_S3 0 2
 /begin AXIS_DESCR STD_AXIS iItfInput.n_t UMR_U_MIN_1_1_0_S6_S3 6 0 8160 DEPOSIT ABSOLUTE MONOTONY MON_INCREASE /end AXIS_DESCR
 /begin AXIS_DESCR STD_AXIS iItfInput.m_t UMR_NM__1_1_0_S6_S3 4 -400 1640 DEPOSIT ABSOLUTE MONOTONY MON_INCREASE /end AXIS_DESCR
/end CHARACTERISTIC
/begin CHARACTERISTIC KF_F_PMGLSKF3KORRKALT56 "Korr.faktor für pm_gls KF3 Kalt" MAP 0x2198E4 kf_si16_S6_S3 2 UMR___1_100_0_S6_S3 0 2
 /begin AXIS_DESCR STD_AXIS iItfInput.n_t UMR_U_MIN_1_1_0_S6_S3 6 0 8160 DEPOSIT ABSOLUTE MONOTONY MON_INCREASE /end AXIS_DESCR
 /begin AXIS_DESCR STD_AXIS iItfInput.m_t UMR_NM__1_1_0_S6_S3 4 -400 1640 DEPOSIT ABSOLUTE MONOTONY MON_INCREASE /end AXIS_DESCR
/end CHARACTERISTIC
/begin CHARACTERISTIC KF_PGLSAD_KF1_67 "Adaptionswert in Abh. des mittl. Regeleingr. KF1" MAP 0x219930 kf_si16_S6_S3 2.5 UMR_BAR__1_100_0_S6_S3 -1.25 1.25
 /begin AXIS_DESCR STD_AXIS iAdaGlast.pm_gls_korr UMR_BAR__1_100_0_S6_S3 8 -2.55 2.55 DEPOSIT ABSOLUTE MONOTONY MON_INCREASE /end AXIS_DESCR
 /begin AXIS_DESCR STD_AXIS NO_INPUT_QUANTITY UMR_GRADC__1_1_M40_S6_S3 4 -40 215 DEPOSIT ABSOLUTE MONOTONY MON_INCREASE /end AXIS_DESCR
/end CHARACTERISTIC
/begin CHARACTERISTIC KF_F_PMGLSKF1KORR67 "Korr.faktor für pm_gls KF1" MAP 0x219990 kf_si16_S6_S3 2 UMR___1_100_0_S6_S3 0 2
 /begin AXIS_DESCR STD_AXIS iItfInput.n_t UMR_U_MIN_1_1_0_S6_S3 6 0 8160 DEPOSIT ABSOLUTE MONOTONY MON_INCREASE /end AXIS_DESCR
 /begin AXIS_DESCR STD_AXIS iItfInput.m_t UMR_NM__1_1_0_S6_S3 4 -400 1640 DEPOSIT ABSOLUTE MONOTONY MON_INCREASE /end AXIS_DESCR
/end CHARACTERISTIC
/begin CHARACTERISTIC KF_PGLSAD_KF2_67 "Adaptionswert in Abh. des mittl. Regeleingr. KF2" MAP 0x2199DC kf_si16_S6_S3 2.5 UMR_BAR__1_100_0_S6_S3 -1.25 1.25
 /begin AXIS_DESCR STD_AXIS iAdaGlast.pm_gls_korr UMR_BAR__1_100_0_S6_S3 8 -2.55 2.55 DEPOSIT ABSOLUTE MONOTONY MON_INCREASE /end AXIS_DESCR
 /begin AXIS_DESCR STD_AXIS NO_INPUT_QUANTITY UMR_GRADC__1_1_M40_S6_S3 4 -40 215 DEPOSIT ABSOLUTE MONOTONY MON_INCREASE /end AXIS_DESCR
/end CHARACTERISTIC
/begin CHARACTERISTIC KF_F_PMGLSKF2KORR67 "Korr.faktor für pm_gls KF 2" MAP 0x219A3C kf_si16_S6_S3 2 UMR___1_100_0_S6_S3 0 2
 /begin AXIS_DESCR STD_AXIS iItfInput.n_t UMR_U_MIN_1_1_0_S6_S3 6 0 8160 DEPOSIT ABSOLUTE MONOTONY MON_INCREASE /end AXIS_DESCR
 /begin AXIS_DESCR STD_AXIS iItfInput.m_t UMR_NM__1_1_0_S6_S3 4 -400 1640 DEPOSIT ABSOLUTE MONOTONY MON_INCREASE /end AXIS_DESCR
/end CHARACTERISTIC
/begin CHARACTERISTIC KF_F_PMGLSKF1KORRKALT67 "Korr.faktor für pm_gls KF 1 Kalt" MAP 0x219A88 kf_si16_S6_S3 2 UMR___1_100_0_S6_S3 0 2
 /begin AXIS_DESCR STD_AXIS iItfInput.n_t UMR_U_MIN_1_1_0_S6_S3 6 0 8160 DEPOSIT ABSOLUTE MONOTONY MON_INCREASE /end AXIS_DESCR
 /begin AXIS_DESCR STD_AXIS iItfInput.m_t UMR_NM__1_1_0_S6_S3 4 -400 1640 DEPOSIT ABSOLUTE MONOTONY MON_INCREASE /end AXIS_DESCR
/end CHARACTERISTIC
/begin CHARACTERISTIC KF_F_PMGLSKF2KORRKALT67 "Korr.faktor für pm_gls KF2 Kalt" MAP 0x219AD4 kf_si16_S6_S3 2 UMR___1_100_0_S6_S3 0 2
 /begin AXIS_DESCR STD_AXIS iItfInput.n_t UMR_U_MIN_1_1_0_S6_S3 6 0 8160 DEPOSIT ABSOLUTE MONOTONY MON_INCREASE /end AXIS_DESCR
 /begin AXIS_DESCR STD_AXIS iItfInput.m_t UMR_NM__1_1_0_S6_S3 4 -400 1640 DEPOSIT ABSOLUTE MONOTONY MON_INCREASE /end AXIS_DESCR
/end CHARACTERISTIC
/begin CHARACTERISTIC KF_PGLSAD_KF3_67 "Adaptionswert in Abh. des mittl. Regeleingr. HS KF3" MAP 0x219B20 kf_si16_S6_S3 2.5 UMR_BAR__1_100_0_S6_S3 -1.25 1.25
 /begin AXIS_DESCR STD_AXIS iAdaGlast.pm_gls_korr UMR_BAR__1_100_0_S6_S3 8 -2.55 2.55 DEPOSIT ABSOLUTE MONOTONY MON_INCREASE /end AXIS_DESCR
 /begin AXIS_DESCR STD_AXIS NO_INPUT_QUANTITY UMR_GRADC__1_1_M40_S6_S3 4 -40 215 DEPOSIT ABSOLUTE MONOTONY MON_INCREASE /end AXIS_DESCR
/end CHARACTERISTIC
/begin CHARACTERISTIC KF_F_PMGLSKF3KORR67 "Korr.faktor für pm_gls KF 3" MAP 0x219B80 kf_si16_S6_S3 2 UMR___1_100_0_S6_S3 0 2
 /begin AXIS_DESCR STD_AXIS iItfInput.n_t UMR_U_MIN_1_1_0_S6_S3 6 0 8160 DEPOSIT ABSOLUTE MONOTONY MON_INCREASE /end AXIS_DESCR
 /begin AXIS_DESCR STD_AXIS iItfInput.m_t UMR_NM__1_1_0_S6_S3 4 -400 1640 DEPOSIT ABSOLUTE MONOTONY MON_INCREASE /end AXIS_DESCR
/end CHARACTERISTIC
/begin CHARACTERISTIC KF_F_PMGLSKF3KORRKALT67 "Korr.faktor für pm_gls KF3 Kalt" MAP 0x219BCC kf_si16_S6_S3 2 UMR___1_100_0_S6_S3 0 2
 /begin AXIS_DESCR STD_AXIS iItfInput.n_t UMR_U_MIN_1_1_0_S6_S3 6 0 8160 DEPOSIT ABSOLUTE MONOTONY MON_INCREASE /end AXIS_DESCR
 /begin AXIS_DESCR STD_AXIS iItfInput.m_t UMR_NM__1_1_0_S6_S3 4 -400 1640 DEPOSIT ABSOLUTE MONOTONY MON_INCREASE /end AXIS_DESCR
/end CHARACTERISTIC
/begin CHARACTERISTIC KF_PGLSAD_KF1_78 "Adaptionswert in Abh. des mittl. Regeleingr. KF1" MAP 0x219C18 kf_si16_S6_S3 2.5 UMR_BAR__1_100_0_S6_S3 -1.25 1.25
 /begin AXIS_DESCR STD_AXIS iAdaGlast.pm_gls_korr UMR_BAR__1_100_0_S6_S3 8 -2.55 2.55 DEPOSIT ABSOLUTE MONOTONY MON_INCREASE /end AXIS_DESCR
 /begin AXIS_DESCR STD_AXIS NO_INPUT_QUANTITY UMR_GRADC__1_1_M40_S6_S3 4 -40 215 DEPOSIT ABSOLUTE MONOTONY MON_INCREASE /end AXIS_DESCR
/end CHARACTERISTIC
/begin CHARACTERISTIC KF_F_PMGLSKF1KORR78 "Korr.faktor für pm_gls KF1" MAP 0x219C78 kf_si16_S6_S3 2 UMR___1_100_0_S6_S3 0 2
 /begin AXIS_DESCR STD_AXIS iItfInput.n_t UMR_U_MIN_1_1_0_S6_S3 6 0 8160 DEPOSIT ABSOLUTE MONOTONY MON_INCREASE /end AXIS_DESCR
 /begin AXIS_DESCR STD_AXIS iItfInput.m_t UMR_NM__1_1_0_S6_S3 4 -400 1640 DEPOSIT ABSOLUTE MONOTONY MON_INCREASE /end AXIS_DESCR
/end CHARACTERISTIC
/begin CHARACTERISTIC KF_PGLSAD_KF2_78 "Adaptionswert in Abh. des mittl. Regeleingr. KF2" MAP 0x219CC4 kf_si16_S6_S3 2.5 UMR_BAR__1_100_0_S6_S3 -1.25 1.25
 /begin AXIS_DESCR STD_AXIS iAdaGlast.pm_gls_korr UMR_BAR__1_100_0_S6_S3 8 -2.55 2.55 DEPOSIT ABSOLUTE MONOTONY MON_INCREASE /end AXIS_DESCR
 /begin AXIS_DESCR STD_AXIS NO_INPUT_QUANTITY UMR_GRADC__1_1_M40_S6_S3 4 -40 215 DEPOSIT ABSOLUTE MONOTONY MON_INCREASE /end AXIS_DESCR
/end CHARACTERISTIC
/begin CHARACTERISTIC KF_F_PMGLSKF2KORR78 "Korr.faktor für pm_gls KF 2" MAP 0x219D24 kf_si16_S6_S3 2 UMR___1_100_0_S6_S3 0 2
 /begin AXIS_DESCR STD_AXIS iItfInput.n_t UMR_U_MIN_1_1_0_S6_S3 6 0 8160 DEPOSIT ABSOLUTE MONOTONY MON_INCREASE /end AXIS_DESCR
 /begin AXIS_DESCR STD_AXIS iItfInput.m_t UMR_NM__1_1_0_S6_S3 4 -400 1640 DEPOSIT ABSOLUTE MONOTONY MON_INCREASE /end AXIS_DESCR
/end CHARACTERISTIC
/begin CHARACTERISTIC KF_F_PMGLSKF1KORRKALT78 "Korr.faktor für pm_gls KF 1 Kalt" MAP 0x219D70 kf_si16_S6_S3 2 UMR___1_100_0_S6_S3 0 2
 /begin AXIS_DESCR STD_AXIS iItfInput.n_t UMR_U_MIN_1_1_0_S6_S3 6 0 8160 DEPOSIT ABSOLUTE MONOTONY MON_INCREASE /end AXIS_DESCR
 /begin AXIS_DESCR STD_AXIS iItfInput.m_t UMR_NM__1_1_0_S6_S3 4 -400 1640 DEPOSIT ABSOLUTE MONOTONY MON_INCREASE /end AXIS_DESCR
/end CHARACTERISTIC
/begin CHARACTERISTIC KF_F_PMGLSKF2KORRKALT78 "Korr.faktor für pm_gls KF2 Kalt" MAP 0x219DBC kf_si16_S6_S3 2 UMR___1_100_0_S6_S3 0 2
 /begin AXIS_DESCR STD_AXIS iItfInput.n_t UMR_U_MIN_1_1_0_S6_S3 6 0 8160 DEPOSIT ABSOLUTE MONOTONY MON_INCREASE /end AXIS_DESCR
 /begin AXIS_DESCR STD_AXIS iItfInput.m_t UMR_NM__1_1_0_S6_S3 4 -400 1640 DEPOSIT ABSOLUTE MONOTONY MON_INCREASE /end AXIS_DESCR
/end CHARACTERISTIC
/begin CHARACTERISTIC KF_PGLSAD_KF3_78 "Adaptionswert in Abh. des mittl. Regeleingr. HS KF3" MAP 0x219E08 kf_si16_S6_S3 2.5 UMR_BAR__1_100_0_S6_S3 -1.25 1.25
 /begin AXIS_DESCR STD_AXIS iAdaGlast.pm_gls_korr UMR_BAR__1_100_0_S6_S3 8 -2.55 2.55 DEPOSIT ABSOLUTE MONOTONY MON_INCREASE /end AXIS_DESCR
 /begin AXIS_DESCR STD_AXIS NO_INPUT_QUANTITY UMR_GRADC__1_1_M40_S6_S3 4 -40 215 DEPOSIT ABSOLUTE MONOTONY MON_INCREASE /end AXIS_DESCR
/end CHARACTERISTIC
/begin CHARACTERISTIC KF_F_PMGLSKF3KORR78 "Korr.faktor für pm_gls KF 3" MAP 0x219E68 kf_si16_S6_S3 2 UMR___1_100_0_S6_S3 0 2
 /begin AXIS_DESCR STD_AXIS iItfInput.n_t UMR_U_MIN_1_1_0_S6_S3 6 0 8160 DEPOSIT ABSOLUTE MONOTONY MON_INCREASE /end AXIS_DESCR
 /begin AXIS_DESCR STD_AXIS iItfInput.m_t UMR_NM__1_1_0_S6_S3 4 -400 1640 DEPOSIT ABSOLUTE MONOTONY MON_INCREASE /end AXIS_DESCR
/end CHARACTERISTIC
/begin CHARACTERISTIC KF_F_PMGLSKF3KORRKALT78 "Korr.faktor für pm_gls KF3 Kalt" MAP 0x219EB4 kf_si16_S6_S3 2 UMR___1_100_0_S6_S3 0 2
 /begin AXIS_DESCR STD_AXIS iItfInput.n_t UMR_U_MIN_1_1_0_S6_S3 6 0 8160 DEPOSIT ABSOLUTE MONOTONY MON_INCREASE /end AXIS_DESCR
 /begin AXIS_DESCR STD_AXIS iItfInput.m_t UMR_NM__1_1_0_S6_S3 4 -400 1640 DEPOSIT ABSOLUTE MONOTONY MON_INCREASE /end AXIS_DESCR
/end CHARACTERISTIC
/begin CHARACTERISTIC KF_PGLSAD_KF1_13 "Adaptionswert in Abh. des mittl. Regeleingr. KF1" MAP 0x219F00 kf_si16_S6_S3 2.5 UMR_BAR__1_100_0_S6_S3 -1.25 1.25
 /begin AXIS_DESCR STD_AXIS iAdaGlast.pm_gls_korr UMR_BAR__1_100_0_S6_S3 8 -2.55 2.55 DEPOSIT ABSOLUTE MONOTONY MON_INCREASE /end AXIS_DESCR
 /begin AXIS_DESCR STD_AXIS NO_INPUT_QUANTITY UMR_GRADC__1_1_M40_S6_S3 4 -40 215 DEPOSIT ABSOLUTE MONOTONY MON_INCREASE /end AXIS_DESCR
/end CHARACTERISTIC
/begin CHARACTERISTIC KF_F_PMGLSKF1KORR13 "Korr.faktor für pm_gls KF1" MAP 0x219F60 kf_si16_S6_S3 2 UMR___1_100_0_S6_S3 0 2
 /begin AXIS_DESCR STD_AXIS iItfInput.n_t UMR_U_MIN_1_1_0_S6_S3 6 0 8160 DEPOSIT ABSOLUTE MONOTONY MON_INCREASE /end AXIS_DESCR
 /begin AXIS_DESCR STD_AXIS iItfInput.m_t UMR_NM__1_1_0_S6_S3 4 -400 1640 DEPOSIT ABSOLUTE MONOTONY MON_INCREASE /end AXIS_DESCR
/end CHARACTERISTIC
/begin CHARACTERISTIC KF_F_PMGLSKF1KORRKALT13 "Korr.faktor für pm_gls KF 1 Kalt" MAP 0x219FAC kf_si16_S6_S3 2 UMR___1_100_0_S6_S3 0 2
 /begin AXIS_DESCR STD_AXIS iItfInput.n_t UMR_U_MIN_1_1_0_S6_S3 6 0 8160 DEPOSIT ABSOLUTE MONOTONY MON_INCREASE /end AXIS_DESCR
 /begin AXIS_DESCR STD_AXIS iItfInput.m_t UMR_NM__1_1_0_S6_S3 4 -400 1640 DEPOSIT ABSOLUTE MONOTONY MON_INCREASE /end AXIS_DESCR
/end CHARACTERISTIC
/begin CHARACTERISTIC KF_PGLSAD_KF1_24 "Adaptionswert in Abh. des mittl. Regeleingr. KF1" MAP 0x219FF8 kf_si16_S6_S3 2.5 UMR_BAR__1_100_0_S6_S3 -1.25 1.25
 /begin AXIS_DESCR STD_AXIS iAdaGlast.pm_gls_korr UMR_BAR__1_100_0_S6_S3 8 -2.55 2.55 DEPOSIT ABSOLUTE MONOTONY MON_INCREASE /end AXIS_DESCR
 /begin AXIS_DESCR STD_AXIS NO_INPUT_QUANTITY UMR_GRADC__1_1_M40_S6_S3 4 -40 215 DEPOSIT ABSOLUTE MONOTONY MON_INCREASE /end AXIS_DESCR
/end CHARACTERISTIC
/begin CHARACTERISTIC KF_F_PMGLSKF1KORR24 "Korr.faktor für pm_gls KF1" MAP 0x21A058 kf_si16_S6_S3 2 UMR___1_100_0_S6_S3 0 2
 /begin AXIS_DESCR STD_AXIS iItfInput.n_t UMR_U_MIN_1_1_0_S6_S3 6 0 8160 DEPOSIT ABSOLUTE MONOTONY MON_INCREASE /end AXIS_DESCR
 /begin AXIS_DESCR STD_AXIS iItfInput.m_t UMR_NM__1_1_0_S6_S3 4 -400 1640 DEPOSIT ABSOLUTE MONOTONY MON_INCREASE /end AXIS_DESCR
/end CHARACTERISTIC
/begin CHARACTERISTIC KF_F_PMGLSKF1KORRKALT24 "Korr.faktor für pm_gls KF 1 Kalt" MAP 0x21A0A4 kf_si16_S6_S3 2 UMR___1_100_0_S6_S3 0 2
 /begin AXIS_DESCR STD_AXIS iItfInput.n_t UMR_U_MIN_1_1_0_S6_S3 6 0 8160 DEPOSIT ABSOLUTE MONOTONY MON_INCREASE /end AXIS_DESCR
 /begin AXIS_DESCR STD_AXIS iItfInput.m_t UMR_NM__1_1_0_S6_S3 4 -400 1640 DEPOSIT ABSOLUTE MONOTONY MON_INCREASE /end AXIS_DESCR
/end CHARACTERISTIC
/begin CHARACTERISTIC KF_PGLSAD_KF1_35 "Adaptionswert in Abh. des mittl. Regeleingr. KF1" MAP 0x21A0F0 kf_si16_S6_S3 2.5 UMR_BAR__1_100_0_S6_S3 -1.25 1.25
 /begin AXIS_DESCR STD_AXIS iAdaGlast.pm_gls_korr UMR_BAR__1_100_0_S6_S3 8 -2.55 2.55 DEPOSIT ABSOLUTE MONOTONY MON_INCREASE /end AXIS_DESCR
 /begin AXIS_DESCR STD_AXIS NO_INPUT_QUANTITY UMR_GRADC__1_1_M40_S6_S3 4 -40 215 DEPOSIT ABSOLUTE MONOTONY MON_INCREASE /end AXIS_DESCR
/end CHARACTERISTIC
/begin CHARACTERISTIC KF_F_PMGLSKF1KORR35 "Korr.faktor für pm_gls KF1" MAP 0x21A150 kf_si16_S6_S3 2 UMR___1_100_0_S6_S3 0 2
 /begin AXIS_DESCR STD_AXIS iItfInput.n_t UMR_U_MIN_1_1_0_S6_S3 6 0 8160 DEPOSIT ABSOLUTE MONOTONY MON_INCREASE /end AXIS_DESCR
 /begin AXIS_DESCR STD_AXIS iItfInput.m_t UMR_NM__1_1_0_S6_S3 4 -400 1640 DEPOSIT ABSOLUTE MONOTONY MON_INCREASE /end AXIS_DESCR
/end CHARACTERISTIC
/begin CHARACTERISTIC KF_F_PMGLSKF1KORRKALT35 "Korr.faktor für pm_gls KF 1 Kalt" MAP 0x21A19C kf_si16_S6_S3 2 UMR___1_100_0_S6_S3 0 2
 /begin AXIS_DESCR STD_AXIS iItfInput.n_t UMR_U_MIN_1_1_0_S6_S3 6 0 8160 DEPOSIT ABSOLUTE MONOTONY MON_INCREASE /end AXIS_DESCR
 /begin AXIS_DESCR STD_AXIS iItfInput.m_t UMR_NM__1_1_0_S6_S3 4 -400 1640 DEPOSIT ABSOLUTE MONOTONY MON_INCREASE /end AXIS_DESCR
/end CHARACTERISTIC
/begin CHARACTERISTIC KF_PGLSAD_KF1_46 "Adaptionswert in Abh. des mittl. Regeleingr. KF1" MAP 0x21A1E8 kf_si16_S6_S3 2.5 UMR_BAR__1_100_0_S6_S3 -1.25 1.25
 /begin AXIS_DESCR STD_AXIS iAdaGlast.pm_gls_korr UMR_BAR__1_100_0_S6_S3 8 -2.55 2.55 DEPOSIT ABSOLUTE MONOTONY MON_INCREASE /end AXIS_DESCR
 /begin AXIS_DESCR STD_AXIS NO_INPUT_QUANTITY UMR_GRADC__1_1_M40_S6_S3 4 -40 215 DEPOSIT ABSOLUTE MONOTONY MON_INCREASE /end AXIS_DESCR
/end CHARACTERISTIC
/begin CHARACTERISTIC KF_F_PMGLSKF1KORR46 "Korr.faktor für pm_gls KF1" MAP 0x21A248 kf_si16_S6_S3 2 UMR___1_100_0_S6_S3 0 2
 /begin AXIS_DESCR STD_AXIS iItfInput.n_t UMR_U_MIN_1_1_0_S6_S3 6 0 8160 DEPOSIT ABSOLUTE MONOTONY MON_INCREASE /end AXIS_DESCR
 /begin AXIS_DESCR STD_AXIS iItfInput.m_t UMR_NM__1_1_0_S6_S3 4 -400 1640 DEPOSIT ABSOLUTE MONOTONY MON_INCREASE /end AXIS_DESCR
/end CHARACTERISTIC
/begin CHARACTERISTIC KF_F_PMGLSKF1KORRKALT46 "Korr.faktor für pm_gls KF 1 Kalt" MAP 0x21A294 kf_si16_S6_S3 2 UMR___1_100_0_S6_S3 0 2
 /begin AXIS_DESCR STD_AXIS iItfInput.n_t UMR_U_MIN_1_1_0_S6_S3 6 0 8160 DEPOSIT ABSOLUTE MONOTONY MON_INCREASE /end AXIS_DESCR
 /begin AXIS_DESCR STD_AXIS iItfInput.m_t UMR_NM__1_1_0_S6_S3 4 -400 1640 DEPOSIT ABSOLUTE MONOTONY MON_INCREASE /end AXIS_DESCR
/end CHARACTERISTIC
/begin CHARACTERISTIC KF_PGLSAD_KF1_57 "Adaptionswert in Abh. des mittl. Regeleingr. KF1" MAP 0x21A2E0 kf_si16_S6_S3 2.5 UMR_BAR__1_100_0_S6_S3 -1.25 1.25
 /begin AXIS_DESCR STD_AXIS iAdaGlast.pm_gls_korr UMR_BAR__1_100_0_S6_S3 8 -2.55 2.55 DEPOSIT ABSOLUTE MONOTONY MON_INCREASE /end AXIS_DESCR
 /begin AXIS_DESCR STD_AXIS NO_INPUT_QUANTITY UMR_GRADC__1_1_M40_S6_S3 4 -40 215 DEPOSIT ABSOLUTE MONOTONY MON_INCREASE /end AXIS_DESCR
/end CHARACTERISTIC
/begin CHARACTERISTIC KF_F_PMGLSKF1KORR57 "Korr.faktor für pm_gls KF1" MAP 0x21A340 kf_si16_S6_S3 2 UMR___1_100_0_S6_S3 0 2
 /begin AXIS_DESCR STD_AXIS iItfInput.n_t UMR_U_MIN_1_1_0_S6_S3 6 0 8160 DEPOSIT ABSOLUTE MONOTONY MON_INCREASE /end AXIS_DESCR
 /begin AXIS_DESCR STD_AXIS iItfInput.m_t UMR_NM__1_1_0_S6_S3 4 -400 1640 DEPOSIT ABSOLUTE MONOTONY MON_INCREASE /end AXIS_DESCR
/end CHARACTERISTIC
/begin CHARACTERISTIC KF_F_PMGLSKF1KORRKALT57 "Korr.faktor für pm_gls KF 1 Kalt" MAP 0x21A38C kf_si16_S6_S3 2 UMR___1_100_0_S6_S3 0 2
 /begin AXIS_DESCR STD_AXIS iItfInput.n_t UMR_U_MIN_1_1_0_S6_S3 6 0 8160 DEPOSIT ABSOLUTE MONOTONY MON_INCREASE /end AXIS_DESCR
 /begin AXIS_DESCR STD_AXIS iItfInput.m_t UMR_NM__1_1_0_S6_S3 4 -400 1640 DEPOSIT ABSOLUTE MONOTONY MON_INCREASE /end AXIS_DESCR
/end CHARACTERISTIC
/begin CHARACTERISTIC KF_PGLSAD_KF1_68 "Adaptionswert in Abh. des mittl. Regeleingr. KF1" MAP 0x21A3D8 kf_si16_S6_S3 2.5 UMR_BAR__1_100_0_S6_S3 -1.25 1.25
 /begin AXIS_DESCR STD_AXIS iAdaGlast.pm_gls_korr UMR_BAR__1_100_0_S6_S3 8 -2.55 2.55 DEPOSIT ABSOLUTE MONOTONY MON_INCREASE /end AXIS_DESCR
 /begin AXIS_DESCR STD_AXIS NO_INPUT_QUANTITY UMR_GRADC__1_1_M40_S6_S3 4 -40 215 DEPOSIT ABSOLUTE MONOTONY MON_INCREASE /end AXIS_DESCR
/end CHARACTERISTIC
/begin CHARACTERISTIC KF_F_PMGLSKF1KORR68 "Korr.faktor für pm_gls KF1" MAP 0x21A438 kf_si16_S6_S3 2 UMR___1_100_0_S6_S3 0 2
 /begin AXIS_DESCR STD_AXIS iItfInput.n_t UMR_U_MIN_1_1_0_S6_S3 6 0 8160 DEPOSIT ABSOLUTE MONOTONY MON_INCREASE /end AXIS_DESCR
 /begin AXIS_DESCR STD_AXIS iItfInput.m_t UMR_NM__1_1_0_S6_S3 4 -400 1640 DEPOSIT ABSOLUTE MONOTONY MON_INCREASE /end AXIS_DESCR
/end CHARACTERISTIC
/begin CHARACTERISTIC KF_F_PMGLSKF1KORRKALT68 "Korr.faktor für pm_gls KF 1 Kalt" MAP 0x21A484 kf_si16_S6_S3 2 UMR___1_100_0_S6_S3 0 2
 /begin AXIS_DESCR STD_AXIS iItfInput.n_t UMR_U_MIN_1_1_0_S6_S3 6 0 8160 DEPOSIT ABSOLUTE MONOTONY MON_INCREASE /end AXIS_DESCR
 /begin AXIS_DESCR STD_AXIS iItfInput.m_t UMR_NM__1_1_0_S6_S3 4 -400 1640 DEPOSIT ABSOLUTE MONOTONY MON_INCREASE /end AXIS_DESCR
/end CHARACTERISTIC
/begin CHARACTERISTIC KF_PGLSAD_KF1_21 "Adaptionswert in Abh. des mittl. Regeleingr. KF1" MAP 0x21A4D0 kf_si16_S6_S3 2.5 UMR_BAR__1_100_0_S6_S3 -1.25 1.25
 /begin AXIS_DESCR STD_AXIS iAdaGlast.pm_gls_korr UMR_BAR__1_100_0_S6_S3 8 -2.55 2.55 DEPOSIT ABSOLUTE MONOTONY MON_INCREASE /end AXIS_DESCR
 /begin AXIS_DESCR STD_AXIS NO_INPUT_QUANTITY UMR_GRADC__1_1_M40_S6_S3 4 -40 215 DEPOSIT ABSOLUTE MONOTONY MON_INCREASE /end AXIS_DESCR
/end CHARACTERISTIC
/begin CHARACTERISTIC KF_F_PMGLSKF1KORR21 "Korr.faktor für pm_gls KF1" MAP 0x21A530 kf_si16_S6_S3 2 UMR___1_100_0_S6_S3 0 2
 /begin AXIS_DESCR STD_AXIS iItfInput.n_t UMR_U_MIN_1_1_0_S6_S3 6 0 8160 DEPOSIT ABSOLUTE MONOTONY MON_INCREASE /end AXIS_DESCR
 /begin AXIS_DESCR STD_AXIS iItfInput.m_t UMR_NM__1_1_0_S6_S3 4 -400 1640 DEPOSIT ABSOLUTE MONOTONY MON_INCREASE /end AXIS_DESCR
/end CHARACTERISTIC
/begin CHARACTERISTIC KF_PGLSAD_KF2_21 "Adaptionswert in Abh. des mittl. Regeleingr. KF2" MAP 0x21A57C kf_si16_S6_S3 2.5 UMR_BAR__1_100_0_S6_S3 -1.25 1.25
 /begin AXIS_DESCR STD_AXIS iAdaGlast.pm_gls_korr UMR_BAR__1_100_0_S6_S3 8 -2.55 2.55 DEPOSIT ABSOLUTE MONOTONY MON_INCREASE /end AXIS_DESCR
 /begin AXIS_DESCR STD_AXIS NO_INPUT_QUANTITY UMR_GRADC__1_1_M40_S6_S3 4 -40 215 DEPOSIT ABSOLUTE MONOTONY MON_INCREASE /end AXIS_DESCR
/end CHARACTERISTIC
/begin CHARACTERISTIC KF_F_PMGLSKF2KORR21 "Korr.faktor für pm_gls KF 2" MAP 0x21A5DC kf_si16_S6_S3 2 UMR___1_100_0_S6_S3 0 2
 /begin AXIS_DESCR STD_AXIS iItfInput.n_t UMR_U_MIN_1_1_0_S6_S3 6 0 8160 DEPOSIT ABSOLUTE MONOTONY MON_INCREASE /end AXIS_DESCR
 /begin AXIS_DESCR STD_AXIS iItfInput.m_t UMR_NM__1_1_0_S6_S3 4 -400 1640 DEPOSIT ABSOLUTE MONOTONY MON_INCREASE /end AXIS_DESCR
/end CHARACTERISTIC
/begin CHARACTERISTIC KF_PGLSAD_KF1_32 "Adaptionswert in Abh. des mittl. Regeleingr. KF1" MAP 0x21A628 kf_si16_S6_S3 2.5 UMR_BAR__1_100_0_S6_S3 -1.25 1.25
 /begin AXIS_DESCR STD_AXIS iAdaGlast.pm_gls_korr UMR_BAR__1_100_0_S6_S3 8 -2.55 2.55 DEPOSIT ABSOLUTE MONOTONY MON_INCREASE /end AXIS_DESCR
 /begin AXIS_DESCR STD_AXIS NO_INPUT_QUANTITY UMR_GRADC__1_1_M40_S6_S3 4 -40 215 DEPOSIT ABSOLUTE MONOTONY MON_INCREASE /end AXIS_DESCR
/end CHARACTERISTIC
/begin CHARACTERISTIC KF_F_PMGLSKF1KORR32 "Korr.faktor für pm_gls KF1" MAP 0x21A688 kf_si16_S6_S3 2 UMR___1_100_0_S6_S3 0 2
 /begin AXIS_DESCR STD_AXIS iItfInput.n_t UMR_U_MIN_1_1_0_S6_S3 6 0 8160 DEPOSIT ABSOLUTE MONOTONY MON_INCREASE /end AXIS_DESCR
 /begin AXIS_DESCR STD_AXIS iItfInput.m_t UMR_NM__1_1_0_S6_S3 4 -400 1640 DEPOSIT ABSOLUTE MONOTONY MON_INCREASE /end AXIS_DESCR
/end CHARACTERISTIC
/begin CHARACTERISTIC KF_PGLSAD_KF2_32 "Adaptionswert in Abh. des mittl. Regeleingr. KF2" MAP 0x21A6D4 kf_si16_S6_S3 2.5 UMR_BAR__1_100_0_S6_S3 -1.25 1.25
 /begin AXIS_DESCR STD_AXIS iAdaGlast.pm_gls_korr UMR_BAR__1_100_0_S6_S3 8 -2.55 2.55 DEPOSIT ABSOLUTE MONOTONY MON_INCREASE /end AXIS_DESCR
 /begin AXIS_DESCR STD_AXIS NO_INPUT_QUANTITY UMR_GRADC__1_1_M40_S6_S3 4 -40 215 DEPOSIT ABSOLUTE MONOTONY MON_INCREASE /end AXIS_DESCR
/end CHARACTERISTIC
/begin CHARACTERISTIC KF_F_PMGLSKF2KORR32 "Korr.faktor für pm_gls KF 2" MAP 0x21A734 kf_si16_S6_S3 2 UMR___1_100_0_S6_S3 0 2
 /begin AXIS_DESCR STD_AXIS iItfInput.n_t UMR_U_MIN_1_1_0_S6_S3 6 0 8160 DEPOSIT ABSOLUTE MONOTONY MON_INCREASE /end AXIS_DESCR
 /begin AXIS_DESCR STD_AXIS iItfInput.m_t UMR_NM__1_1_0_S6_S3 4 -400 1640 DEPOSIT ABSOLUTE MONOTONY MON_INCREASE /end AXIS_DESCR
/end CHARACTERISTIC
/begin CHARACTERISTIC KF_PGLSAD_KF1_43 "Adaptionswert in Abh. des mittl. Regeleingr. KF1" MAP 0x21A780 kf_si16_S6_S3 2.5 UMR_BAR__1_100_0_S6_S3 -1.25 1.25
 /begin AXIS_DESCR STD_AXIS iAdaGlast.pm_gls_korr UMR_BAR__1_100_0_S6_S3 8 -2.55 2.55 DEPOSIT ABSOLUTE MONOTONY MON_INCREASE /end AXIS_DESCR
 /begin AXIS_DESCR STD_AXIS NO_INPUT_QUANTITY UMR_GRADC__1_1_M40_S6_S3 4 -40 215 DEPOSIT ABSOLUTE MONOTONY MON_INCREASE /end AXIS_DESCR
/end CHARACTERISTIC
/begin CHARACTERISTIC KF_F_PMGLSKF1KORR43 "Korr.faktor für pm_gls KF1" MAP 0x21A7E0 kf_si16_S6_S3 2 UMR___1_100_0_S6_S3 0 2
 /begin AXIS_DESCR STD_AXIS iItfInput.n_t UMR_U_MIN_1_1_0_S6_S3 6 0 8160 DEPOSIT ABSOLUTE MONOTONY MON_INCREASE /end AXIS_DESCR
 /begin AXIS_DESCR STD_AXIS iItfInput.m_t UMR_NM__1_1_0_S6_S3 4 -400 1640 DEPOSIT ABSOLUTE MONOTONY MON_INCREASE /end AXIS_DESCR
/end CHARACTERISTIC
/begin CHARACTERISTIC KF_PGLSAD_KF2_43 "Adaptionswert in Abh. des mittl. Regeleingr. KF2" MAP 0x21A82C kf_si16_S6_S3 2.5 UMR_BAR__1_100_0_S6_S3 -1.25 1.25
 /begin AXIS_DESCR STD_AXIS iAdaGlast.pm_gls_korr UMR_BAR__1_100_0_S6_S3 8 -2.55 2.55 DEPOSIT ABSOLUTE MONOTONY MON_INCREASE /end AXIS_DESCR
 /begin AXIS_DESCR STD_AXIS NO_INPUT_QUANTITY UMR_GRADC__1_1_M40_S6_S3 4 -40 215 DEPOSIT ABSOLUTE MONOTONY MON_INCREASE /end AXIS_DESCR
/end CHARACTERISTIC
/begin CHARACTERISTIC KF_F_PMGLSKF2KORR43 "Korr.faktor für pm_gls KF 2" MAP 0x21A88C kf_si16_S6_S3 2 UMR___1_100_0_S6_S3 0 2
 /begin AXIS_DESCR STD_AXIS iItfInput.n_t UMR_U_MIN_1_1_0_S6_S3 6 0 8160 DEPOSIT ABSOLUTE MONOTONY MON_INCREASE /end AXIS_DESCR
 /begin AXIS_DESCR STD_AXIS iItfInput.m_t UMR_NM__1_1_0_S6_S3 4 -400 1640 DEPOSIT ABSOLUTE MONOTONY MON_INCREASE /end AXIS_DESCR
/end CHARACTERISTIC
/begin CHARACTERISTIC KF_PGLSAD_KF1_54 "Adaptionswert in Abh. des mittl. Regeleingr. KF1" MAP 0x21A8D8 kf_si16_S6_S3 2.5 UMR_BAR__1_100_0_S6_S3 -1.25 1.25
 /begin AXIS_DESCR STD_AXIS iAdaGlast.pm_gls_korr UMR_BAR__1_100_0_S6_S3 8 -2.55 2.55 DEPOSIT ABSOLUTE MONOTONY MON_INCREASE /end AXIS_DESCR
 /begin AXIS_DESCR STD_AXIS NO_INPUT_QUANTITY UMR_GRADC__1_1_M40_S6_S3 4 -40 215 DEPOSIT ABSOLUTE MONOTONY MON_INCREASE /end AXIS_DESCR
/end CHARACTERISTIC
/begin CHARACTERISTIC KF_F_PMGLSKF1KORR54 "Korr.faktor für pm_gls KF1" MAP 0x21A938 kf_si16_S6_S3 2 UMR___1_100_0_S6_S3 0 2
 /begin AXIS_DESCR STD_AXIS iItfInput.n_t UMR_U_MIN_1_1_0_S6_S3 6 0 8160 DEPOSIT ABSOLUTE MONOTONY MON_INCREASE /end AXIS_DESCR
 /begin AXIS_DESCR STD_AXIS iItfInput.m_t UMR_NM__1_1_0_S6_S3 4 -400 1640 DEPOSIT ABSOLUTE MONOTONY MON_INCREASE /end AXIS_DESCR
/end CHARACTERISTIC
/begin CHARACTERISTIC KF_PGLSAD_KF2_54 "Adaptionswert in Abh. des mittl. Regeleingr. KF2" MAP 0x21A984 kf_si16_S6_S3 2.5 UMR_BAR__1_100_0_S6_S3 -1.25 1.25
 /begin AXIS_DESCR STD_AXIS iAdaGlast.pm_gls_korr UMR_BAR__1_100_0_S6_S3 8 -2.55 2.55 DEPOSIT ABSOLUTE MONOTONY MON_INCREASE /end AXIS_DESCR
 /begin AXIS_DESCR STD_AXIS NO_INPUT_QUANTITY UMR_GRADC__1_1_M40_S6_S3 4 -40 215 DEPOSIT ABSOLUTE MONOTONY MON_INCREASE /end AXIS_DESCR
/end CHARACTERISTIC
/begin CHARACTERISTIC KF_F_PMGLSKF2KORR54 "Korr.faktor für pm_gls KF 2" MAP 0x21A9E4 kf_si16_S6_S3 2 UMR___1_100_0_S6_S3 0 2
 /begin AXIS_DESCR STD_AXIS iItfInput.n_t UMR_U_MIN_1_1_0_S6_S3 6 0 8160 DEPOSIT ABSOLUTE MONOTONY MON_INCREASE /end AXIS_DESCR
 /begin AXIS_DESCR STD_AXIS iItfInput.m_t UMR_NM__1_1_0_S6_S3 4 -400 1640 DEPOSIT ABSOLUTE MONOTONY MON_INCREASE /end AXIS_DESCR
/end CHARACTERISTIC
/begin CHARACTERISTIC KF_PGLSAD_KF1_65 "Adaptionswert in Abh. des mittl. Regeleingr. KF1" MAP 0x21AA30 kf_si16_S6_S3 2.5 UMR_BAR__1_100_0_S6_S3 -1.25 1.25
 /begin AXIS_DESCR STD_AXIS iAdaGlast.pm_gls_korr UMR_BAR__1_100_0_S6_S3 8 -2.55 2.55 DEPOSIT ABSOLUTE MONOTONY MON_INCREASE /end AXIS_DESCR
 /begin AXIS_DESCR STD_AXIS NO_INPUT_QUANTITY UMR_GRADC__1_1_M40_S6_S3 4 -40 215 DEPOSIT ABSOLUTE MONOTONY MON_INCREASE /end AXIS_DESCR
/end CHARACTERISTIC
/begin CHARACTERISTIC KF_F_PMGLSKF1KORR65 "Korr.faktor für pm_gls KF1" MAP 0x21AA90 kf_si16_S6_S3 2 UMR___1_100_0_S6_S3 0 2
 /begin AXIS_DESCR STD_AXIS iItfInput.n_t UMR_U_MIN_1_1_0_S6_S3 6 0 8160 DEPOSIT ABSOLUTE MONOTONY MON_INCREASE /end AXIS_DESCR
 /begin AXIS_DESCR STD_AXIS iItfInput.m_t UMR_NM__1_1_0_S6_S3 4 -400 1640 DEPOSIT ABSOLUTE MONOTONY MON_INCREASE /end AXIS_DESCR
/end CHARACTERISTIC
/begin CHARACTERISTIC KF_PGLSAD_KF2_65 "Adaptionswert in Abh. des mittl. Regeleingr. KF2" MAP 0x21AADC kf_si16_S6_S3 2.5 UMR_BAR__1_100_0_S6_S3 -1.25 1.25
 /begin AXIS_DESCR STD_AXIS iAdaGlast.pm_gls_korr UMR_BAR__1_100_0_S6_S3 8 -2.55 2.55 DEPOSIT ABSOLUTE MONOTONY MON_INCREASE /end AXIS_DESCR
 /begin AXIS_DESCR STD_AXIS NO_INPUT_QUANTITY UMR_GRADC__1_1_M40_S6_S3 4 -40 215 DEPOSIT ABSOLUTE MONOTONY MON_INCREASE /end AXIS_DESCR
/end CHARACTERISTIC
/begin CHARACTERISTIC KF_F_PMGLSKF2KORR65 "Korr.faktor für pm_gls KF 2" MAP 0x21AB3C kf_si16_S6_S3 2 UMR___1_100_0_S6_S3 0 2
 /begin AXIS_DESCR STD_AXIS iItfInput.n_t UMR_U_MIN_1_1_0_S6_S3 6 0 8160 DEPOSIT ABSOLUTE MONOTONY MON_INCREASE /end AXIS_DESCR
 /begin AXIS_DESCR STD_AXIS iItfInput.m_t UMR_NM__1_1_0_S6_S3 4 -400 1640 DEPOSIT ABSOLUTE MONOTONY MON_INCREASE /end AXIS_DESCR
/end CHARACTERISTIC
/begin CHARACTERISTIC KF_PGLSAD_KF1_76 "Adaptionswert in Abh. des mittl. Regeleingr. KF1" MAP 0x21AB88 kf_si16_S6_S3 2.5 UMR_BAR__1_100_0_S6_S3 -1.25 1.25
 /begin AXIS_DESCR STD_AXIS iAdaGlast.pm_gls_korr UMR_BAR__1_100_0_S6_S3 8 -2.55 2.55 DEPOSIT ABSOLUTE MONOTONY MON_INCREASE /end AXIS_DESCR
 /begin AXIS_DESCR STD_AXIS NO_INPUT_QUANTITY UMR_GRADC__1_1_M40_S6_S3 4 -40 215 DEPOSIT ABSOLUTE MONOTONY MON_INCREASE /end AXIS_DESCR
/end CHARACTERISTIC
/begin CHARACTERISTIC KF_F_PMGLSKF1KORR76 "Korr.faktor für pm_gls KF1" MAP 0x21ABE8 kf_si16_S6_S3 2 UMR___1_100_0_S6_S3 0 2
 /begin AXIS_DESCR STD_AXIS iItfInput.n_t UMR_U_MIN_1_1_0_S6_S3 6 0 8160 DEPOSIT ABSOLUTE MONOTONY MON_INCREASE /end AXIS_DESCR
 /begin AXIS_DESCR STD_AXIS iItfInput.m_t UMR_NM__1_1_0_S6_S3 4 -400 1640 DEPOSIT ABSOLUTE MONOTONY MON_INCREASE /end AXIS_DESCR
/end CHARACTERISTIC
/begin CHARACTERISTIC KF_PGLSAD_KF2_76 "Adaptionswert in Abh. des mittl. Regeleingr. KF2" MAP 0x21AC34 kf_si16_S6_S3 2.5 UMR_BAR__1_100_0_S6_S3 -1.25 1.25
 /begin AXIS_DESCR STD_AXIS iAdaGlast.pm_gls_korr UMR_BAR__1_100_0_S6_S3 8 -2.55 2.55 DEPOSIT ABSOLUTE MONOTONY MON_INCREASE /end AXIS_DESCR
 /begin AXIS_DESCR STD_AXIS NO_INPUT_QUANTITY UMR_GRADC__1_1_M40_S6_S3 4 -40 215 DEPOSIT ABSOLUTE MONOTONY MON_INCREASE /end AXIS_DESCR
/end CHARACTERISTIC
/begin CHARACTERISTIC KF_F_PMGLSKF2KORR76 "Korr.faktor für pm_gls KF 2" MAP 0x21AC94 kf_si16_S6_S3 2 UMR___1_100_0_S6_S3 0 2
 /begin AXIS_DESCR STD_AXIS iItfInput.n_t UMR_U_MIN_1_1_0_S6_S3 6 0 8160 DEPOSIT ABSOLUTE MONOTONY MON_INCREASE /end AXIS_DESCR
 /begin AXIS_DESCR STD_AXIS iItfInput.m_t UMR_NM__1_1_0_S6_S3 4 -400 1640 DEPOSIT ABSOLUTE MONOTONY MON_INCREASE /end AXIS_DESCR
/end CHARACTERISTIC
/begin CHARACTERISTIC KF_PGLSAD_KF1_87 "Adaptionswert in Abh. des mittl. Regeleingr. KF1" MAP 0x21ACE0 kf_si16_S6_S3 2.5 UMR_BAR__1_100_0_S6_S3 -1.25 1.25
 /begin AXIS_DESCR STD_AXIS iAdaGlast.pm_gls_korr UMR_BAR__1_100_0_S6_S3 8 -2.55 2.55 DEPOSIT ABSOLUTE MONOTONY MON_INCREASE /end AXIS_DESCR
 /begin AXIS_DESCR STD_AXIS NO_INPUT_QUANTITY UMR_GRADC__1_1_M40_S6_S3 4 -40 215 DEPOSIT ABSOLUTE MONOTONY MON_INCREASE /end AXIS_DESCR
/end CHARACTERISTIC
/begin CHARACTERISTIC KF_F_PMGLSKF1KORR87 "Korr.faktor für pm_gls KF1" MAP 0x21AD40 kf_si16_S6_S3 2 UMR___1_100_0_S6_S3 0 2
 /begin AXIS_DESCR STD_AXIS iItfInput.n_t UMR_U_MIN_1_1_0_S6_S3 6 0 8160 DEPOSIT ABSOLUTE MONOTONY MON_INCREASE /end AXIS_DESCR
 /begin AXIS_DESCR STD_AXIS iItfInput.m_t UMR_NM__1_1_0_S6_S3 4 -400 1640 DEPOSIT ABSOLUTE MONOTONY MON_INCREASE /end AXIS_DESCR
/end CHARACTERISTIC
/begin CHARACTERISTIC KF_PGLSAD_KF2_87 "Adaptionswert in Abh. des mittl. Regeleingr. KF2" MAP 0x21AD8C kf_si16_S6_S3 2.5 UMR_BAR__1_100_0_S6_S3 -1.25 1.25
 /begin AXIS_DESCR STD_AXIS iAdaGlast.pm_gls_korr UMR_BAR__1_100_0_S6_S3 8 -2.55 2.55 DEPOSIT ABSOLUTE MONOTONY MON_INCREASE /end AXIS_DESCR
 /begin AXIS_DESCR STD_AXIS NO_INPUT_QUANTITY UMR_GRADC__1_1_M40_S6_S3 4 -40 215 DEPOSIT ABSOLUTE MONOTONY MON_INCREASE /end AXIS_DESCR
/end CHARACTERISTIC
/begin CHARACTERISTIC KF_F_PMGLSKF2KORR87 "Korr.faktor für pm_gls KF 2" MAP 0x21ADEC kf_si16_S6_S3 2 UMR___1_100_0_S6_S3 0 2
 /begin AXIS_DESCR STD_AXIS iItfInput.n_t UMR_U_MIN_1_1_0_S6_S3 6 0 8160 DEPOSIT ABSOLUTE MONOTONY MON_INCREASE /end AXIS_DESCR
 /begin AXIS_DESCR STD_AXIS iItfInput.m_t UMR_NM__1_1_0_S6_S3 4 -400 1640 DEPOSIT ABSOLUTE MONOTONY MON_INCREASE /end AXIS_DESCR
/end CHARACTERISTIC
/begin CHARACTERISTIC KF_PGLSAD_KF1_31 "Adaptionswert in Abh. des mittl. Regeleingr. KF1" MAP 0x21AE38 kf_si16_S6_S3 2.5 UMR_BAR__1_100_0_S6_S3 -1.25 1.25
 /begin AXIS_DESCR STD_AXIS iAdaGlast.pm_gls_korr UMR_BAR__1_100_0_S6_S3 8 -2.55 2.55 DEPOSIT ABSOLUTE MONOTONY MON_INCREASE /end AXIS_DESCR
 /begin AXIS_DESCR STD_AXIS NO_INPUT_QUANTITY UMR_GRADC__1_1_M40_S6_S3 4 -40 215 DEPOSIT ABSOLUTE MONOTONY MON_INCREASE /end AXIS_DESCR
/end CHARACTERISTIC
/begin CHARACTERISTIC KF_F_PMGLSKF1KORR31 "Korr.faktor für pm_gls KF1" MAP 0x21AE98 kf_si16_S6_S3 2 UMR___1_100_0_S6_S3 0 2
 /begin AXIS_DESCR STD_AXIS iItfInput.n_t UMR_U_MIN_1_1_0_S6_S3 6 0 8160 DEPOSIT ABSOLUTE MONOTONY MON_INCREASE /end AXIS_DESCR
 /begin AXIS_DESCR STD_AXIS iItfInput.m_t UMR_NM__1_1_0_S6_S3 4 -400 1640 DEPOSIT ABSOLUTE MONOTONY MON_INCREASE /end AXIS_DESCR
/end CHARACTERISTIC
/begin CHARACTERISTIC KF_PGLSAD_KF1_42 "Adaptionswert in Abh. des mittl. Regeleingr. KF1" MAP 0x21AEE4 kf_si16_S6_S3 2.5 UMR_BAR__1_100_0_S6_S3 -1.25 1.25
 /begin AXIS_DESCR STD_AXIS iAdaGlast.pm_gls_korr UMR_BAR__1_100_0_S6_S3 8 -2.55 2.55 DEPOSIT ABSOLUTE MONOTONY MON_INCREASE /end AXIS_DESCR
 /begin AXIS_DESCR STD_AXIS NO_INPUT_QUANTITY UMR_GRADC__1_1_M40_S6_S3 4 -40 215 DEPOSIT ABSOLUTE MONOTONY MON_INCREASE /end AXIS_DESCR
/end CHARACTERISTIC
/begin CHARACTERISTIC KF_F_PMGLSKF1KORR42 "Korr.faktor für pm_gls KF1" MAP 0x21AF44 kf_si16_S6_S3 2 UMR___1_100_0_S6_S3 0 2
 /begin AXIS_DESCR STD_AXIS iItfInput.n_t UMR_U_MIN_1_1_0_S6_S3 6 0 8160 DEPOSIT ABSOLUTE MONOTONY MON_INCREASE /end AXIS_DESCR
 /begin AXIS_DESCR STD_AXIS iItfInput.m_t UMR_NM__1_1_0_S6_S3 4 -400 1640 DEPOSIT ABSOLUTE MONOTONY MON_INCREASE /end AXIS_DESCR
/end CHARACTERISTIC
/begin CHARACTERISTIC KF_PGLSAD_KF1_51 "Adaptionswert in Abh. des mittl. Regeleingr. KF1" MAP 0x21AF90 kf_si16_S6_S3 2.5 UMR_BAR__1_100_0_S6_S3 -1.25 1.25
 /begin AXIS_DESCR STD_AXIS iAdaGlast.pm_gls_korr UMR_BAR__1_100_0_S6_S3 8 -2.55 2.55 DEPOSIT ABSOLUTE MONOTONY MON_INCREASE /end AXIS_DESCR
 /begin AXIS_DESCR STD_AXIS NO_INPUT_QUANTITY UMR_GRADC__1_1_M40_S6_S3 4 -40 215 DEPOSIT ABSOLUTE MONOTONY MON_INCREASE /end AXIS_DESCR
/end CHARACTERISTIC
/begin CHARACTERISTIC KF_F_PMGLSKF1KORR51 "Korr.faktor für pm_gls KF1" MAP 0x21AFF0 kf_si16_S6_S3 2 UMR___1_100_0_S6_S3 0 2
 /begin AXIS_DESCR STD_AXIS iItfInput.n_t UMR_U_MIN_1_1_0_S6_S3 6 0 8160 DEPOSIT ABSOLUTE MONOTONY MON_INCREASE /end AXIS_DESCR
 /begin AXIS_DESCR STD_AXIS iItfInput.m_t UMR_NM__1_1_0_S6_S3 4 -400 1640 DEPOSIT ABSOLUTE MONOTONY MON_INCREASE /end AXIS_DESCR
/end CHARACTERISTIC
/begin CHARACTERISTIC KF_PGLSAD_KF1_53 "Adaptionswert in Abh. des mittl. Regeleingr. KF1" MAP 0x21B03C kf_si16_S6_S3 2.5 UMR_BAR__1_100_0_S6_S3 -1.25 1.25
 /begin AXIS_DESCR STD_AXIS iAdaGlast.pm_gls_korr UMR_BAR__1_100_0_S6_S3 8 -2.55 2.55 DEPOSIT ABSOLUTE MONOTONY MON_INCREASE /end AXIS_DESCR
 /begin AXIS_DESCR STD_AXIS NO_INPUT_QUANTITY UMR_GRADC__1_1_M40_S6_S3 4 -40 215 DEPOSIT ABSOLUTE MONOTONY MON_INCREASE /end AXIS_DESCR
/end CHARACTERISTIC
/begin CHARACTERISTIC KF_F_PMGLSKF1KORR53 "Korr.faktor für pm_gls KF1" MAP 0x21B09C kf_si16_S6_S3 2 UMR___1_100_0_S6_S3 0 2
 /begin AXIS_DESCR STD_AXIS iItfInput.n_t UMR_U_MIN_1_1_0_S6_S3 6 0 8160 DEPOSIT ABSOLUTE MONOTONY MON_INCREASE /end AXIS_DESCR
 /begin AXIS_DESCR STD_AXIS iItfInput.m_t UMR_NM__1_1_0_S6_S3 4 -400 1640 DEPOSIT ABSOLUTE MONOTONY MON_INCREASE /end AXIS_DESCR
/end CHARACTERISTIC
/begin CHARACTERISTIC KF_PGLSAD_KF1_63 "Adaptionswert in Abh. des mittl. Regeleingr. KF1" MAP 0x21B0E8 kf_si16_S6_S3 2.5 UMR_BAR__1_100_0_S6_S3 -1.25 1.25
 /begin AXIS_DESCR STD_AXIS iAdaGlast.pm_gls_korr UMR_BAR__1_100_0_S6_S3 8 -2.55 2.55 DEPOSIT ABSOLUTE MONOTONY MON_INCREASE /end AXIS_DESCR
 /begin AXIS_DESCR STD_AXIS NO_INPUT_QUANTITY UMR_GRADC__1_1_M40_S6_S3 4 -40 215 DEPOSIT ABSOLUTE MONOTONY MON_INCREASE /end AXIS_DESCR
/end CHARACTERISTIC
/begin CHARACTERISTIC KF_F_PMGLSKF1KORR63 "Korr.faktor für pm_gls KF1" MAP 0x21B148 kf_si16_S6_S3 2 UMR___1_100_0_S6_S3 0 2
 /begin AXIS_DESCR STD_AXIS iItfInput.n_t UMR_U_MIN_1_1_0_S6_S3 6 0 8160 DEPOSIT ABSOLUTE MONOTONY MON_INCREASE /end AXIS_DESCR
 /begin AXIS_DESCR STD_AXIS iItfInput.m_t UMR_NM__1_1_0_S6_S3 4 -400 1640 DEPOSIT ABSOLUTE MONOTONY MON_INCREASE /end AXIS_DESCR
/end CHARACTERISTIC
/begin CHARACTERISTIC KF_PGLSAD_KF1_64 "Adaptionswert in Abh. des mittl. Regeleingr. KF1" MAP 0x21B194 kf_si16_S6_S3 2.5 UMR_BAR__1_100_0_S6_S3 -1.25 1.25
 /begin AXIS_DESCR STD_AXIS iAdaGlast.pm_gls_korr UMR_BAR__1_100_0_S6_S3 8 -2.55 2.55 DEPOSIT ABSOLUTE MONOTONY MON_INCREASE /end AXIS_DESCR
 /begin AXIS_DESCR STD_AXIS NO_INPUT_QUANTITY UMR_GRADC__1_1_M40_S6_S3 4 -40 215 DEPOSIT ABSOLUTE MONOTONY MON_INCREASE /end AXIS_DESCR
/end CHARACTERISTIC
/begin CHARACTERISTIC KF_F_PMGLSKF1KORR64 "Korr.faktor für pm_gls KF1" MAP 0x21B1F4 kf_si16_S6_S3 2 UMR___1_100_0_S6_S3 0 2
 /begin AXIS_DESCR STD_AXIS iItfInput.n_t UMR_U_MIN_1_1_0_S6_S3 6 0 8160 DEPOSIT ABSOLUTE MONOTONY MON_INCREASE /end AXIS_DESCR
 /begin AXIS_DESCR STD_AXIS iItfInput.m_t UMR_NM__1_1_0_S6_S3 4 -400 1640 DEPOSIT ABSOLUTE MONOTONY MON_INCREASE /end AXIS_DESCR
/end CHARACTERISTIC
/begin CHARACTERISTIC KF_PGLSAD_KF1_71 "Adaptionswert in Abh. des mittl. Regeleingr. KF1" MAP 0x21B240 kf_si16_S6_S3 2.5 UMR_BAR__1_100_0_S6_S3 -1.25 1.25
 /begin AXIS_DESCR STD_AXIS iAdaGlast.pm_gls_korr UMR_BAR__1_100_0_S6_S3 8 -2.55 2.55 DEPOSIT ABSOLUTE MONOTONY MON_INCREASE /end AXIS_DESCR
 /begin AXIS_DESCR STD_AXIS NO_INPUT_QUANTITY UMR_GRADC__1_1_M40_S6_S3 4 -40 215 DEPOSIT ABSOLUTE MONOTONY MON_INCREASE /end AXIS_DESCR
/end CHARACTERISTIC
/begin CHARACTERISTIC KF_F_PMGLSKF1KORR71 "Korr.faktor für pm_gls KF1" MAP 0x21B2A0 kf_si16_S6_S3 2 UMR___1_100_0_S6_S3 0 2
 /begin AXIS_DESCR STD_AXIS iItfInput.n_t UMR_U_MIN_1_1_0_S6_S3 6 0 8160 DEPOSIT ABSOLUTE MONOTONY MON_INCREASE /end AXIS_DESCR
 /begin AXIS_DESCR STD_AXIS iItfInput.m_t UMR_NM__1_1_0_S6_S3 4 -400 1640 DEPOSIT ABSOLUTE MONOTONY MON_INCREASE /end AXIS_DESCR
/end CHARACTERISTIC
/begin CHARACTERISTIC KF_PGLSAD_KF1_75 "Adaptionswert in Abh. des mittl. Regeleingr. KF1" MAP 0x21B2EC kf_si16_S6_S3 2.5 UMR_BAR__1_100_0_S6_S3 -1.25 1.25
 /begin AXIS_DESCR STD_AXIS iAdaGlast.pm_gls_korr UMR_BAR__1_100_0_S6_S3 8 -2.55 2.55 DEPOSIT ABSOLUTE MONOTONY MON_INCREASE /end AXIS_DESCR
 /begin AXIS_DESCR STD_AXIS NO_INPUT_QUANTITY UMR_GRADC__1_1_M40_S6_S3 4 -40 215 DEPOSIT ABSOLUTE MONOTONY MON_INCREASE /end AXIS_DESCR
/end CHARACTERISTIC
/begin CHARACTERISTIC KF_F_PMGLSKF1KORR75 "Korr.faktor für pm_gls KF1" MAP 0x21B34C kf_si16_S6_S3 2 UMR___1_100_0_S6_S3 0 2
 /begin AXIS_DESCR STD_AXIS iItfInput.n_t UMR_U_MIN_1_1_0_S6_S3 6 0 8160 DEPOSIT ABSOLUTE MONOTONY MON_INCREASE /end AXIS_DESCR
 /begin AXIS_DESCR STD_AXIS iItfInput.m_t UMR_NM__1_1_0_S6_S3 4 -400 1640 DEPOSIT ABSOLUTE MONOTONY MON_INCREASE /end AXIS_DESCR
/end CHARACTERISTIC
/begin CHARACTERISTIC KF_PGLSAD_KF1_82 "Adaptionswert in Abh. des mittl. Regeleingr. KF1" MAP 0x21B398 kf_si16_S6_S3 2.5 UMR_BAR__1_100_0_S6_S3 -1.25 1.25
 /begin AXIS_DESCR STD_AXIS iAdaGlast.pm_gls_korr UMR_BAR__1_100_0_S6_S3 8 -2.55 2.55 DEPOSIT ABSOLUTE MONOTONY MON_INCREASE /end AXIS_DESCR
 /begin AXIS_DESCR STD_AXIS NO_INPUT_QUANTITY UMR_GRADC__1_1_M40_S6_S3 4 -40 215 DEPOSIT ABSOLUTE MONOTONY MON_INCREASE /end AXIS_DESCR
/end CHARACTERISTIC
/begin CHARACTERISTIC KF_F_PMGLSKF1KORR82 "Korr.faktor für pm_gls KF1" MAP 0x21B3F8 kf_si16_S6_S3 2 UMR___1_100_0_S6_S3 0 2
 /begin AXIS_DESCR STD_AXIS iItfInput.n_t UMR_U_MIN_1_1_0_S6_S3 6 0 8160 DEPOSIT ABSOLUTE MONOTONY MON_INCREASE /end AXIS_DESCR
 /begin AXIS_DESCR STD_AXIS iItfInput.m_t UMR_NM__1_1_0_S6_S3 4 -400 1640 DEPOSIT ABSOLUTE MONOTONY MON_INCREASE /end AXIS_DESCR
/end CHARACTERISTIC
/begin CHARACTERISTIC KF_PGLSAD_KF1_84 "Adaptionswert in Abh. des mittl. Regeleingr. KF1" MAP 0x21B444 kf_si16_S6_S3 2.5 UMR_BAR__1_100_0_S6_S3 -1.25 1.25
 /begin AXIS_DESCR STD_AXIS iAdaGlast.pm_gls_korr UMR_BAR__1_100_0_S6_S3 8 -2.55 2.55 DEPOSIT ABSOLUTE MONOTONY MON_INCREASE /end AXIS_DESCR
 /begin AXIS_DESCR STD_AXIS NO_INPUT_QUANTITY UMR_GRADC__1_1_M40_S6_S3 4 -40 215 DEPOSIT ABSOLUTE MONOTONY MON_INCREASE /end AXIS_DESCR
/end CHARACTERISTIC
/begin CHARACTERISTIC KF_F_PMGLSKF1KORR84 "Korr.faktor für pm_gls KF1" MAP 0x21B4A4 kf_si16_S6_S3 2 UMR___1_100_0_S6_S3 0 2
 /begin AXIS_DESCR STD_AXIS iItfInput.n_t UMR_U_MIN_1_1_0_S6_S3 6 0 8160 DEPOSIT ABSOLUTE MONOTONY MON_INCREASE /end AXIS_DESCR
 /begin AXIS_DESCR STD_AXIS iItfInput.m_t UMR_NM__1_1_0_S6_S3 4 -400 1640 DEPOSIT ABSOLUTE MONOTONY MON_INCREASE /end AXIS_DESCR
/end CHARACTERISTIC
/begin CHARACTERISTIC KF_PGLSAD_KF1_86 "Adaptionswert in Abh. des mittl. Regeleingr. KF1" MAP 0x21B4F0 kf_si16_S6_S3 2.5 UMR_BAR__1_100_0_S6_S3 -1.25 1.25
 /begin AXIS_DESCR STD_AXIS iAdaGlast.pm_gls_korr UMR_BAR__1_100_0_S6_S3 8 -2.55 2.55 DEPOSIT ABSOLUTE MONOTONY MON_INCREASE /end AXIS_DESCR
 /begin AXIS_DESCR STD_AXIS NO_INPUT_QUANTITY UMR_GRADC__1_1_M40_S6_S3 4 -40 215 DEPOSIT ABSOLUTE MONOTONY MON_INCREASE /end AXIS_DESCR
/end CHARACTERISTIC
/begin CHARACTERISTIC KF_F_PMGLSKF1KORR86 "Korr.faktor für pm_gls KF1" MAP 0x21B550 kf_si16_S6_S3 2 UMR___1_100_0_S6_S3 0 2
 /begin AXIS_DESCR STD_AXIS iItfInput.n_t UMR_U_MIN_1_1_0_S6_S3 6 0 8160 DEPOSIT ABSOLUTE MONOTONY MON_INCREASE /end AXIS_DESCR
 /begin AXIS_DESCR STD_AXIS iItfInput.m_t UMR_NM__1_1_0_S6_S3 4 -400 1640 DEPOSIT ABSOLUTE MONOTONY MON_INCREASE /end AXIS_DESCR
/end CHARACTERISTIC
/begin CHARACTERISTIC TAB_CSOBKPLGLSAD "maximale Temperatur der beteiligten Kupplung bei GLS-Adaption" CURVE 0x218894 tab_si16_S6_S3 1000 UMR_GRADC__1_1_0_S6_S3 0 1000
 /begin AXIS_DESCR FIX_AXIS NO_INPUT_QUANTITY UMR___1_1_0_S6_S3 5 0 4 FIX_AXIS_PAR_DIST 0 1 5 /end AXIS_DESCR
/end CHARACTERISTIC
/begin CHARACTERISTIC TAB_SWI_GLSADKALT_AKTIV "Aktivierung der Kalt-Ada fuer jede einzelne Schaltung" MAP 0x2188A4 tab2d_bool8_S6_S3 1 UMR___1_1_0_S6_S3 0 1
 /begin AXIS_DESCR FIX_AXIS NO_INPUT_QUANTITY UMR___1_1_0_S6_S3 7 1 7 FIX_AXIS_PAR_DIST 1 1 7 /end AXIS_DESCR
 /begin AXIS_DESCR FIX_AXIS NO_INPUT_QUANTITY UMR___1_1_0_S6_S3 3 1 3 FIX_AXIS_PAR_DIST 1 1 3 /end AXIS_DESCR
/end CHARACTERISTIC
/begin CHARACTERISTIC TAB_N_MIN_GLSADHSWARM "Mindestanzahl Warmbewertungen vor Kalt-Aktivierung" MAP 0x2188C4 tab2d_ui8_S6_S3 200 UMR___1_1_0_S6_S3 0 200
 /begin AXIS_DESCR FIX_AXIS NO_INPUT_QUANTITY UMR___1_1_0_S6_S3 7 1 7 FIX_AXIS_PAR_DIST 1 1 7 /end AXIS_DESCR
 /begin AXIS_DESCR FIX_AXIS NO_INPUT_QUANTITY UMR___1_1_0_S6_S3 3 1 3 FIX_AXIS_PAR_DIST 1 1 3 /end AXIS_DESCR
/end CHARACTERISTIC
/begin CHARACTERISTIC TAB_SWI_DHS_GLSADKALT_AKTIV "Aktivierung der Kalt-Ada fuer jede einzelne DHS Schaltung" CURVE 0x2188E4 tab_bool8_S6_S3 1 UMR___1_1_0_S6_S3 0 1
 /begin AXIS_DESCR FIX_AXIS NO_INPUT_QUANTITY UMR___1_1_0_S6_S3 6 1 6 FIX_AXIS_PAR_DIST 1 1 6 /end AXIS_DESCR
/end CHARACTERISTIC
/begin CHARACTERISTIC TAB_N_MIN_GLSADDHSWARM "Mindestanzahl Warmbewertungen vor Kalt-Aktivierung bei DHS" CURVE 0x2188F0 tab_ui8_S6_S3 200 UMR___1_1_0_S6_S3 0 200
 /begin AXIS_DESCR FIX_AXIS NO_INPUT_QUANTITY UMR___1_1_0_S6_S3 6 1 6 FIX_AXIS_PAR_DIST 1 1 6 /end AXIS_DESCR
/end CHARACTERISTIC
/begin CHARACTERISTIC N_MIN_GLSADXRS "Min. BewCtr zur Aktivierung GLS-Beeinflussung RS" VALUE 0x26E3C4 kw_ui8_S6_S3 200 UMR___1_1_0_S6_S3 0 200 /end CHARACTERISTIC
/begin CHARACTERISTIC TAB_SWI_GLSAD "Schalter GLS-Adaption 0=Off, 1=On, 2=nur VM, 3=nur EM - TAB fuer EHS, ERS, DHS, DRS, NFRS" CURVE 0x2188FC tab_ui8_S6_S3 3 UMR___1_1_0_S6_S3 0 3
 /begin AXIS_DESCR FIX_AXIS NO_INPUT_QUANTITY UMR___1_1_0_S6_S3 5 0 4 FIX_AXIS_PAR_DIST 0 1 5 /end AXIS_DESCR
/end CHARACTERISTIC
/begin CHARACTERISTIC SWI_GLS_TRIM "Schalter zur Aktivierung der GLS Trimm Dich Funktion 0=Aus 1=VerschRS 2=DRS/MRS 3=On" VALUE 0x26E3C5 kw_ui8_S6_S3 3 UMR___1_1_0_S6_S3 0 3 /end CHARACTERISTIC
/begin CHARACTERISTIC SHIFTCOUNTERGLSRSKF1_TRIM "GLS-Trimm Fkt: Schwelle GLS-Ada RS Kennfeld 1 gilt als bewertet" VALUE 0x26E3C6 kw_ui8_S6_S3 255 UMR___1_1_0_S6_S3 0 255 /end CHARACTERISTIC
/begin CHARACTERISTIC SHIFTCOUNTERGLSRSKF2_TRIM "GLS-Trimm Fkt: Schwelle GLS-Ada RS Kennfeld 2 gilt als bewertet" VALUE 0x26E3C7 kw_ui8_S6_S3 255 UMR___1_1_0_S6_S3 0 255 /end CHARACTERISTIC
/begin CHARACTERISTIC SHIFTCOUNTERGLSHS_TRIM "GLS-Trimm Fkt: Schwelle GLS-Ada HS Kennfeld 1/2 gilt als bewertet" VALUE 0x26E3C8 kw_ui8_S6_S3 255 UMR___1_1_0_S6_S3 0 255 /end CHARACTERISTIC
/begin CHARACTERISTIC DKIS_TRIMMOFF "DKI-Schwelle zur Deaktivierung der GLS-Trimm Fkttionen" VALUE 0x26E3C9 kw_ui8_S6_S3 100 UMR_PROZENT__20_51_0_S6_S3 0 100 /end CHARACTERISTIC
/begin CHARACTERISTIC SWI_TRIMMUNDODER_KPLBP "GLS-Trimm Fkt: Auswahl der Trimm Counter fuer Spontanitaets-Beeinflussung" VALUE 0x26E3CA kw_ui8_S6_S3 3 UMR___1_1_0_S6_S3 0 3 /end CHARACTERISTIC
/begin CHARACTERISTIC SWI_TRIMM_SCHUTZ_VERS "GLS-Trimm Fkt als Klauen-Schutz Funktion" VALUE 0x26E3CB kw_bool8_S6_S3 1 UMR___1_1_0_S6_S3 0 1 /end CHARACTERISTIC
/begin CHARACTERISTIC SWI_ZKINDEX_GLS "Zugkraft-Korrektur-Kriterium fuer GLS ADA" VALUE 0x26E3CC kw_bool8_S6_S3 1 UMR___1_1_0_S6_S3 0 1 /end CHARACTERISTIC
/begin CHARACTERISTIC KL_SBAKLZ_GLS "Uebersprechfaktor Abh. von Anzahl Schaltungen" CURVE 0x218908 kl_ui16_S6_S3 1 UMR___1_100_0_S6_S3 0 1
 /begin AXIS_DESCR STD_AXIS NO_INPUT_QUANTITY UMR___1_1_0_S6_S3 8 0 65535 DEPOSIT ABSOLUTE MONOTONY MON_INCREASE /end AXIS_DESCR
/end CHARACTERISTIC
/begin CHARACTERISTIC SWI_ABBRGLS_PFADA "Schalter fuer Abbruch GLS-Ada, wenn PF-Ada waehrend HS aktiv 0=deakt., 1=akt." VALUE 0x26E3CD kw_bool8_S6_S3 1 UMR___1_1_0_S6_S3 0 1 /end CHARACTERISTIC
/begin CHARACTERISTIC CSOB_GLSAD "obere Temperatur-Schwelle fuer GLS-Ada" VALUE 0x26E3CE kw_ui8_S6_S3 190 UMR_GRADC__1_1_M40_S6_S3 -40 150 /end CHARACTERISTIC
/begin CHARACTERISTIC CSUN_GLSAD "untere Temperatur-Schwelle fuer GLS-Ada" VALUE 0x26E3CF kw_ui8_S6_S3 190 UMR_GRADC__1_1_M40_S6_S3 -40 150 /end CHARACTERISTIC
/begin CHARACTERISTIC P_GLSADMAX "Maximal zulaessiger Adaptionsdruck" VALUE 0x26D2F6 kw_si16_S6_S3 1.25 UMR_BAR__1_100_0_S6_S3 0 1.25 /end CHARACTERISTIC
/begin CHARACTERISTIC P_GLSADMIN "Minimal zulaessiger Adaptionsdruck" VALUE 0x26D2F8 kw_si16_S6_S3 1.25 UMR_BAR__1_100_0_S6_S3 -1.25 0 /end CHARACTERISTIC
/begin CHARACTERISTIC TAB_MT_GLSADGR_HS "Turbinenmomentklassengrenze GLS Adaption EHS" CURVE 0x21892C tab_si16_S6_S3 2040 UMR_NM__1_1_0_S6_S3 -400 1640
 /begin AXIS_DESCR FIX_AXIS NO_INPUT_QUANTITY UMR___1_1_0_S6_S3 8 0 7 FIX_AXIS_PAR_DIST 0 1 8 /end AXIS_DESCR
/end CHARACTERISTIC
/begin CHARACTERISTIC TAB_NT_GLSADGR_HS "Turbinendrehzahlklassengrenze GLS Adaption EHS" CURVE 0x218940 tab_ui16_S6_S3 8160 UMR_U_MIN_1_1_0_S6_S3 0 8160
 /begin AXIS_DESCR FIX_AXIS NO_INPUT_QUANTITY UMR___1_1_0_S6_S3 8 0 7 FIX_AXIS_PAR_DIST 0 1 8 /end AXIS_DESCR
/end CHARACTERISTIC
/begin CHARACTERISTIC TAB_MTUN_GLSAD_HS "untere Turbinenmoment-Grenze GLS Adaption EHS" CURVE 0x218954 tab_si16_S6_S3 2040 UMR_NM__1_1_0_S6_S3 -400 1640
 /begin AXIS_DESCR FIX_AXIS NO_INPUT_QUANTITY UMR___1_1_0_S6_S3 7 0 6 FIX_AXIS_PAR_DIST 0 1 7 /end AXIS_DESCR
/end CHARACTERISTIC
/begin CHARACTERISTIC TAB_MT_GLSADGR_HS_E "Turbinenmomentklassengrenze GLS Adaption EHS KF3" CURVE 0x218968 tab_si16_S6_S3 2040 UMR_NM__1_1_0_S6_S3 -400 1640
 /begin AXIS_DESCR FIX_AXIS NO_INPUT_QUANTITY UMR___1_1_0_S6_S3 4 0 3 FIX_AXIS_PAR_DIST 0 1 4 /end AXIS_DESCR
/end CHARACTERISTIC
/begin CHARACTERISTIC TAB_NT_GLSADGR_HS_E "Turbinendrehzahlklassengrenze GLS Adaption EHS KF3" CURVE 0x218974 tab_ui16_S6_S3 8160 UMR_U_MIN_1_1_0_S6_S3 0 8160
 /begin AXIS_DESCR FIX_AXIS NO_INPUT_QUANTITY UMR___1_1_0_S6_S3 4 0 3 FIX_AXIS_PAR_DIST 0 1 4 /end AXIS_DESCR
/end CHARACTERISTIC
/begin CHARACTERISTIC TAB_MT_GLSADGR_DHS "Turbinenmomentklassengrenze GLS Adaption DHS" CURVE 0x218980 tab_si16_S6_S3 2040 UMR_NM__1_1_0_S6_S3 -400 1640
 /begin AXIS_DESCR FIX_AXIS NO_INPUT_QUANTITY UMR___1_1_0_S6_S3 4 0 3 FIX_AXIS_PAR_DIST 0 1 4 /end AXIS_DESCR
/end CHARACTERISTIC
/begin CHARACTERISTIC TAB_NT_GLSADGR_DHS "Turbinendrehzahlklassengrenze GLS Adaption DHS" CURVE 0x21898C tab_ui16_S6_S3 8160 UMR_U_MIN_1_1_0_S6_S3 0 8160
 /begin AXIS_DESCR FIX_AXIS NO_INPUT_QUANTITY UMR___1_1_0_S6_S3 6 0 5 FIX_AXIS_PAR_DIST 0 1 6 /end AXIS_DESCR
/end CHARACTERISTIC
/begin CHARACTERISTIC TAB_MTUN_GLSAD_DHS "untere Turbinenmoment-Grenze GLS Adaption DHS" CURVE 0x21899C tab_si16_S6_S3 2040 UMR_NM__1_1_0_S6_S3 -400 1640
 /begin AXIS_DESCR FIX_AXIS NO_INPUT_QUANTITY UMR___1_1_0_S6_S3 6 0 5 FIX_AXIS_PAR_DIST 0 1 6 /end AXIS_DESCR
/end CHARACTERISTIC
/begin CHARACTERISTIC TAB_MT_GLSADGR_RS "Turbinenmomentklassengrenze GLS Adaption ERS" CURVE 0x2189AC tab_si16_S6_S3 2040 UMR_NM__1_1_0_S6_S3 -400 1640
 /begin AXIS_DESCR FIX_AXIS NO_INPUT_QUANTITY UMR___1_1_0_S6_S3 8 0 7 FIX_AXIS_PAR_DIST 0 1 8 /end AXIS_DESCR
/end CHARACTERISTIC
/begin CHARACTERISTIC TAB_NT_GLSADGR_RS "Turbinendrehzahlklassengrenze GLS Adaption ERS" CURVE 0x2189C0 tab_ui16_S6_S3 8160 UMR_U_MIN_1_1_0_S6_S3 0 8160
 /begin AXIS_DESCR FIX_AXIS NO_INPUT_QUANTITY UMR___1_1_0_S6_S3 8 0 7 FIX_AXIS_PAR_DIST 0 1 8 /end AXIS_DESCR
/end CHARACTERISTIC
/begin CHARACTERISTIC TAB_MTUN_GLSAD_RS "untere Turbinenmoment-Grenze GLS Adaption ERS" CURVE 0x2189D4 tab_si16_S6_S3 2040 UMR_NM__1_1_0_S6_S3 -400 1640
 /begin AXIS_DESCR FIX_AXIS NO_INPUT_QUANTITY UMR___1_1_0_S6_S3 7 0 6 FIX_AXIS_PAR_DIST 0 1 7 /end AXIS_DESCR
/end CHARACTERISTIC
/begin CHARACTERISTIC TAB_MT_GLSADGR_DRS "Turbinenmomentklassengrenze GLS Adaption DRS" CURVE 0x2189E8 tab_si16_S6_S3 2040 UMR_NM__1_1_0_S6_S3 -400 1640
 /begin AXIS_DESCR FIX_AXIS NO_INPUT_QUANTITY UMR___1_1_0_S6_S3 8 0 7 FIX_AXIS_PAR_DIST 0 1 8 /end AXIS_DESCR
/end CHARACTERISTIC
/begin CHARACTERISTIC TAB_NT_GLSADGR_DRS "Turbinendrehzahlklassengrenze GLS Adaption DRS" CURVE 0x2189FC tab_ui16_S6_S3 8160 UMR_U_MIN_1_1_0_S6_S3 0 8160
 /begin AXIS_DESCR FIX_AXIS NO_INPUT_QUANTITY UMR___1_1_0_S6_S3 8 0 7 FIX_AXIS_PAR_DIST 0 1 8 /end AXIS_DESCR
/end CHARACTERISTIC
/begin CHARACTERISTIC TAB_MTUN_GLSAD_DRS "untere Turbinenmoment-Grenze GLS Adaption DRS" CURVE 0x218A10 tab_si16_S6_S3 2040 UMR_NM__1_1_0_S6_S3 -400 1640
 /begin AXIS_DESCR FIX_AXIS NO_INPUT_QUANTITY UMR___1_1_0_S6_S3 6 0 5 FIX_AXIS_PAR_DIST 0 1 6 /end AXIS_DESCR
/end CHARACTERISTIC
/begin CHARACTERISTIC TAB_MT_GLSADGR_NFRS "Turbinenmomentklassengrenze GLS Adaption NFRS" CURVE 0x218A20 tab_si16_S6_S3 2040 UMR_NM__1_1_0_S6_S3 -400 1640
 /begin AXIS_DESCR FIX_AXIS NO_INPUT_QUANTITY UMR___1_1_0_S6_S3 6 0 5 FIX_AXIS_PAR_DIST 0 1 6 /end AXIS_DESCR
/end CHARACTERISTIC
/begin CHARACTERISTIC TAB_NT_GLSADGR_NFRS "Turbinendrehzahlklassengrenze GLS Adaption NFRS" CURVE 0x218A30 tab_ui16_S6_S3 8160 UMR_U_MIN_1_1_0_S6_S3 0 8160
 /begin AXIS_DESCR FIX_AXIS NO_INPUT_QUANTITY UMR___1_1_0_S6_S3 4 0 3 FIX_AXIS_PAR_DIST 0 1 4 /end AXIS_DESCR
/end CHARACTERISTIC
/begin CHARACTERISTIC TAB_MTUN_GLSAD_NFRS "untere Turbinenmoment-Grenze GLS Adaption NFRS" CURVE 0x218A3C tab_si16_S6_S3 2040 UMR_NM__1_1_0_S6_S3 -400 1640
 /begin AXIS_DESCR FIX_AXIS NO_INPUT_QUANTITY UMR___1_1_0_S6_S3 5 0 4 FIX_AXIS_PAR_DIST 0 1 5 /end AXIS_DESCR
/end CHARACTERISTIC
/begin CHARACTERISTIC DKI_PSGLSADHS "Zul. Differenz zum Anfangswert von DKI bei HS" VALUE 0x26E3D0 kw_ui8_S6_S3 100 UMR_PROZENT__20_51_0_S6_S3 0 100 /end CHARACTERISTIC
/begin CHARACTERISTIC DKI_PSGLSADRS "Zul. Differenz zum Anfangswert von DKI bei RS" VALUE 0x26E3D1 kw_ui8_S6_S3 100 UMR_PROZENT__20_51_0_S6_S3 0 100 /end CHARACTERISTIC
/begin CHARACTERISTIC KL_F_GLSADLZ "Faktor Abh. von Anzahl Schaltungen" CURVE 0x218A4C kl_ui16_S6_S3 10 UMR___1_100_0_S6_S3 0 10
 /begin AXIS_DESCR STD_AXIS NO_INPUT_QUANTITY UMR___1_1_0_S6_S3 5 0 65535 DEPOSIT ABSOLUTE MONOTONY MON_INCREASE /end AXIS_DESCR
/end CHARACTERISTIC
/begin CHARACTERISTIC SWI_GLSAD_LOESCH_ISTGANG "Switch zum Loeschen von ADA-GLS Kennfelder" VALUE 0x26E3D2 kw_ui8_S6_S3 8 UMR___1_1_0_S6_S3 0 8 /end CHARACTERISTIC
/begin CHARACTERISTIC SWI_GLSAD_LOESCH_ZIELGANG "Switch zum Loeschen von ADA-GLS Kennfelder" VALUE 0x26E3D3 kw_ui8_S6_S3 8 UMR___1_1_0_S6_S3 0 8 /end CHARACTERISTIC
/begin CHARACTERISTIC TAB_SWI_HYBEW "Laufende Schaltung ist EHS, MHS, MRS, MRS oder keine Schaltung" CURVE 0x218A64 tab_bool8_S6_S3 1 UMR___1_1_0_S6_S3 0 1
 /begin AXIS_DESCR FIX_AXIS iAdaGlosc.ada_schaltinfo UMR___1_1_0_S6_S3 5 0 4 FIX_AXIS_PAR_DIST 0 1 5 /end AXIS_DESCR
/end CHARACTERISTIC
/begin CHARACTERISTIC TAB_GLSAD_KF "GLS-Ada KF: 0=kein, 1=KF1, 2=KF2. X-Achse: QS0, QS1, QS2, AMax. Y-Achse: HS, RS, DHS, DRS, NFRS" MAP 0x218A70 tab2d_ui8_S6_S3 2 UMR___1_1_0_S6_S3 0 2
 /begin AXIS_DESCR FIX_AXIS iAdaGlast.bew_index UMR___1_1_0_S6_S3 4 0 3 FIX_AXIS_PAR_DIST 0 1 4 /end AXIS_DESCR
 /begin AXIS_DESCR FIX_AXIS iAdaGlast.bew_schalttyp UMR___1_1_0_S6_S3 5 0 4 FIX_AXIS_PAR_DIST 0 1 5 /end AXIS_DESCR
/end CHARACTERISTIC
/begin CHARACTERISTIC TAB_GLSAD_LESEN_SCHREIBEN "GLS-Ada KF lesen/schreiben: 0=nix, 1=nur lesen, 2=lesen/schreiben. X-Achse: QS0, QS1, QS2, AMax. Y-Achse: HS, RS, DHS, DRS, NFRS" MAP 0x218A8C tab2d_ui8_S6_S3 2 UMR___1_1_0_S6_S3 0 2
 /begin AXIS_DESCR FIX_AXIS iAdaGlast.bew_index UMR___1_1_0_S6_S3 4 0 3 FIX_AXIS_PAR_DIST 0 1 4 /end AXIS_DESCR
 /begin AXIS_DESCR FIX_AXIS iAdaGlast.bew_schalttyp UMR___1_1_0_S6_S3 5 0 4 FIX_AXIS_PAR_DIST 0 1 5 /end AXIS_DESCR
/end CHARACTERISTIC
/begin CHARACTERISTIC SWI_GLSADVERBOT_SLTSF_ESTART_BEW "Aktivierung der GLS-Adaption bei SLTSF" VALUE 0x26E3D4 kw_bool8_S6_S3 1 UMR___1_1_0_S6_S3 0 1 /end CHARACTERISTIC
/begin CHARACTERISTIC SWI_EEPROM_INIT "0: ATSYS EEPROM Daten nicht lesen nach Neustart 1: ATSYS EEPROM Daten verwenden nach Neustart (Standard) 2: ATSYS EEPROM Daten immer initialisieren" VALUE 0x26E3C2 kw_ui8_S6_S3 2 UMR___1_1_0_S6_S3 0 2 /end CHARACTERISTIC
/begin CHARACTERISTIC SWI_EEPROM_CHECKSUMME "0 keine Checksummen/Pruefpattern-Ueberpruefung 1 zyklische Checksummen/Pattern- Ueberpruefung aktiv (Standard) 2 einmalige Neuberechnung der Checksumme/Pruefpattern" VALUE 0x26E3C3 kw_ui8_S6_S3 2 UMR___1_1_0_S6_S3 0 2 /end CHARACTERISTIC
/begin COMPU_METHOD SAB_N_RPM25_S2_S3 "int = ((phys * 25) / 1) - (0) U/min" RAT_FUNC "%5.3" "U/min" COEFFS 0 25 -0 0 0 1 /end COMPU_METHOD
/begin COMPU_METHOD SAB_N_RPM8_S2_S3 "int = ((phys * 8) / 1) - (0) 1/min" RAT_FUNC "%5.3" "1/min" COEFFS 0 8 -0 0 0 1 /end COMPU_METHOD
/begin COMPU_METHOD SAB_N_RPM32_S2_S3 "int = ((phys * 32) / 1) - (0) 1/min" RAT_FUNC "%5.3" "1/min" COEFFS 0 32 -0 0 0 1 /end COMPU_METHOD
/begin COMPU_METHOD SAB_PROZENT10_M127_S2_S3 "int = ((phys * 10) / 1) - (-127) %" RAT_FUNC "%5.3" "%" COEFFS 0 10 127 0 0 1 /end COMPU_METHOD
/begin COMPU_METHOD SAB_PROZENT_M100_S2_S3 "int = ((phys * 1) / 1) - (-100) %" RAT_FUNC "%2.0" "%" COEFFS 0 1 100 0 0 1 /end COMPU_METHOD
/begin COMPU_METHOD SAB_PROZENT_100PROZENT125_1016M10_S2_S3 "int = ((phys * 125) / 100) - (-127) %" RAT_FUNC "%5.3" "%" COEFFS 0 125 12700 0 0 100 /end COMPU_METHOD
/begin COMPU_METHOD SAB_PROZENT_100PROZENT255_S2_S3 "int = ((phys * 255) / 100) - (0) %" RAT_FUNC "%8.6" "%" COEFFS 0 255 -0 0 0 100 /end COMPU_METHOD
/begin COMPU_METHOD SAB_PROZENT_PROZENT100_S2_S3 "int = ((phys * 100) / 1) - (0) %" RAT_FUNC "%4.2" "%" COEFFS 0 100 -0 0 0 1 /end COMPU_METHOD
/begin COMPU_METHOD SAB_PROZENT_12PROZENT100_S2_S3 "int = ((phys * 100) / 12) - (0) %" RAT_FUNC "%5.3" "%" COEFFS 0 100 -0 0 0 12 /end COMPU_METHOD
/begin COMPU_METHOD SAB_PROZENT_PROZENT10_M300_S2_S3 "int = ((phys * 10) / 1) - (-3000) %" RAT_FUNC "%5.3" "%" COEFFS 0 10 3000 0 0 1 /end COMPU_METHOD
/begin COMPU_METHOD SAB_15PROZENT1000_1P10_S2_S3 "int = ((phys * 1000) / 15) - (7) %" RAT_FUNC "%5.3" "%" COEFFS 0 1000 -105 0 0 15 /end COMPU_METHOD
/begin COMPU_METHOD SAB_14PROZENT100_S2_S3 "int = ((phys * 14) / 100) - (0) %" RAT_FUNC "%5.3" "%" COEFFS 0 14 -0 0 0 100 /end COMPU_METHOD
/begin COMPU_METHOD SAB_GRAD10_S2_S3 "int = ((phys * 10) / 1) - (0) Grad" RAT_FUNC "%5.3" "Grad" COEFFS 0 10 -0 0 0 1 /end COMPU_METHOD
/begin COMPU_METHOD SAB_GRAD4_M124_S2_S3 "int = ((phys * 4) / 1) - (-124) Grad" RAT_FUNC "%5.3" "Grad" COEFFS 0 4 124 0 0 1 /end COMPU_METHOD
/begin COMPU_METHOD UMR___1_100_0_S6_S3 "int = ((phys * 100) / 1) - (0) [-]" RAT_FUNC "%4.2" "[-]" COEFFS 0 100 -0 0 0 1 /end COMPU_METHOD
/begin COMPU_METHOD UMR___1_1_0_S6_S3 "int = ((phys * 1) / 1) - (0) [-]" RAT_FUNC "%2.0" "[-]" COEFFS 0 1 -0 0 0 1 /end COMPU_METHOD
/begin COMPU_METHOD UMR_NM__1_1_0_S6_S3 "int = ((phys * 1) / 1) - (0) [Nm]" RAT_FUNC "%2.0" "[Nm]" COEFFS 0 1 -0 0 0 1 /end COMPU_METHOD
/begin COMPU_METHOD UMR_BAR__1_1000_0_S6_S3 "int = ((phys * 1000) / 1) - (0) [bar]" RAT_FUNC "%5.3" "[bar]" COEFFS 0 1000 -0 0 0 1 /end COMPU_METHOD
/begin COMPU_METHOD UMR_BAR__1_100_0_S6_S3 "int = ((phys * 100) / 1) - (0) [bar]" RAT_FUNC "%4.2" "[bar]" COEFFS 0 100 -0 0 0 1 /end COMPU_METHOD
/begin COMPU_METHOD UMR_BAR__1_1_0_S6_S3 "int = ((phys * 1) / 1) - (0) [bar]" RAT_FUNC "%2.0" "[bar]" COEFFS 0 1 -0 0 0 1 /end COMPU_METHOD
/begin COMPU_METHOD UMR_BAR_SEC_1_10_0_S6_S3 "int = ((phys * 10) / 1) - (0) [bar/s]" RAT_FUNC "%3.1" "[bar/s]" COEFFS 0 10 -0 0 0 1 /end COMPU_METHOD
/begin COMPU_METHOD UMR_U_MIN_1_1_0_S6_S3 "int = ((phys * 1) / 1) - (0) [U/min]" RAT_FUNC "%2.0" "[U/min]" COEFFS 0 1 -0 0 0 1 /end COMPU_METHOD
/begin COMPU_METHOD UMR_U_MINSEC_10_1_0_S6_S3 "int = ((phys * 1) / 10) - (0) [U/(min*s)]" RAT_FUNC "%2.0" "[U/(min*s)]" COEFFS 0 1 -0 0 0 10 /end COMPU_METHOD
/begin COMPU_METHOD UMR_MSEC__1_1_0_S6_S3 "int = ((phys * 1) / 1) - (0) [ms]" RAT_FUNC "%2.0" "[ms]" COEFFS 0 1 -0 0 0 1 /end COMPU_METHOD
/begin COMPU_METHOD UMR_MSEC__10_1_0_S6_S3 "int = ((phys * 1) / 10) - (0) [ms]" RAT_FUNC "%2.0" "[ms]" COEFFS 0 1 -0 0 0 10 /end COMPU_METHOD
/begin COMPU_METHOD UMR_SEC__1_1_0_S6_S3 "int = ((phys * 1) / 1) - (0) [s]" RAT_FUNC "%2.0" "[s]" COEFFS 0 1 -0 0 0 1 /end COMPU_METHOD
/begin COMPU_METHOD UMR_GRADC__1_1_0_S6_S3 "int = ((phys * 1) / 1) - (0) [°C]" RAT_FUNC "%2.0" "[°C]" COEFFS 0 1 -0 0 0 1 /end COMPU_METHOD
/begin COMPU_METHOD UMR_GRADC__1_1_M40_S6_S3 "int = ((phys * 1) / 1) - (-40) [°C]" RAT_FUNC "%2.0" "[°C]" COEFFS 0 1 40 0 0 1 /end COMPU_METHOD
/begin COMPU_METHOD UMR_PROZENT__20_51_0_S6_S3 "int = ((phys * 51) / 20) - (0) [%]" RAT_FUNC "%6.4" "[%]" COEFFS 0 51 -0 0 0 20 /end COMPU_METHOD
/begin FUNCTION jAdaPulbwXSF_Fktn "Applikationesgroessen Instanz jAdaPulbwXSF"
 /begin DEF_CHARACTERISTIC TAB_ND_PULSAMP_SEK_TSF TAB_ND_PULSAMP_TSF TAB_ND_PULSNEG_SEK_TSF TAB_ND_PULSNEG_TSF TAB_ND_PULSPOS_SEK_TSF TAB_ND_PULSPOS_TSF TAB_ND_PULSZWNEG_TSF TAB_ND_PULSZWPOS_TSF /end DEF_CHARACTERISTIC
/end FUNCTION
/begin FUNCTION jAdaPulbwXPF_Fktn "Applikationesgroessen Instanz jAdaPulbwXPF"
 /begin DEF_CHARACTERISTIC TAB_ND_PULSAMP_PF TAB_ND_PULSAMP_SEK_PF TAB_ND_PULSNEG_PF TAB_ND_PULSNEG_SEK_PF TAB_ND_PULSPOS_PF TAB_ND_PULSPOS_SEK_PF TAB_ND_PULSZWNEG_PF TAB_ND_PULSZWPOS_PF /end DEF_CHARACTERISTIC
/end FUNCTION
/begin FUNCTION dAdaPulpf_Fktn "Applikationesgroessen der Komponente dAdaPulpf" /begin SUB_FUNCTION jAdaPulpf_Fktn /end SUB_FUNCTION /end FUNCTION
/begin FUNCTION jAdaPulpf_Fktn "Applikationesgroessen Instanz jAdaPulpf"
 /begin DEF_CHARACTERISTIC F_TVABBR P_RAINCPF P_RAUEBINCPF P_ZWPFINC TAB_HAINCPF TAB_POPULSADAGANG TAB_SWI_DEAKT_DITHER_PULS TO_VPFPULS_DITHEROFF /end DEF_CHARACTERISTIC
/end FUNCTION
/begin FUNCTION dAdaPulzs_Fktn "Applikationesgroessen der Komponente dAdaPulzs" /begin SUB_FUNCTION jAdaPulzs_Fktn /end SUB_FUNCTION /end FUNCTION
/begin FUNCTION jAdaPulzs_Fktn "Applikationesgroessen Instanz jAdaPulzs"
 /begin DEF_CHARACTERISTIC CS_ADPULSHYS DKI_ADPULS FI_ADANEU KF_NMOTMT_ADPULS_K0 KL_FIADAAKT_NPRUEFZYKL_NEG KL_FIADAAKT_NPRUEFZYKL_POS KL_NPRUEFZYKL_KBP MT_ADPULS NS_ABPULS NS_EMSOLLEERPULS NS_HYS_EMSOLLEERPULS NS_VMPULS N_PULSGRENZ N_PULSGRENZSTART SWI_DEAKSD SWI_POSPULS TAB_CS_ADPULSOB TAB_KUPPULS1 TAB_KUPPULS2 TAB_ND_ADABBR TAB_NSTARTWERTE_KPAD TAB_NTHSU TAB_SEKKUPPULS_PF TAB_SEKKUPPULS_TSF TAB_SWI_ADPULSEFAHREN TAB_SWI_KUPPADA_AE TAB_SWI_STILLSTANDPULS T_SPNACHREAKTION T_SPPULS T_SPTSFPULS T_VDEAK_DAEMPFER_PULS T_VHSUABBRUCH T_VPSYSPULS T_VZDEAKSD2_RUH T_VZDEAKSD2_UEBERF /end DEF_CHARACTERISTIC
/end FUNCTION
/begin FUNCTION dAdaPulsf_Fktn "Applikationesgroessen der Komponente dAdaPulsf" /begin SUB_FUNCTION jAdaPulsf_Fktn /end SUB_FUNCTION /end FUNCTION
/begin FUNCTION jAdaPulsf_Fktn "Applikationesgroessen Instanz jAdaPulsf"
 /begin DEF_CHARACTERISTIC TAB_HAINCTSF TAB_TOPULSADAGANG TO_SFRED_K0 T_RAINCTSF T_RAUEBINCTSF T_ZWTSFINC /end DEF_CHARACTERISTIC
/end FUNCTION
/begin FUNCTION dAdaPulzsK_Fktn "Applikationesgroessen der Komponente dAdaPulzsK"
 /begin SUB_FUNCTION jAdaPulzsKA_Fktn jAdaPulzsKB_Fktn jAdaPulzsKC_Fktn jAdaPulzsKD_Fktn jAdaPulzsKE_Fktn jAdaPulzsKK0_Fktn /end SUB_FUNCTION
/end FUNCTION
/begin FUNCTION jAdaPulzsKA_Fktn "Applikationesgroessen Instanz jAdaPulzsKA"
 /begin DEF_CHARACTERISTIC KF_NTMT_ADPULS_A KF_NTMT_ADPULS_A_EL KF_NTMT_ADPULS_SEK_A KF_NTMT_ADPULS_SEK_A_EL KL_CS_PFADPULSUN_A KL_CS_TSFADPULSUN_A /end DEF_CHARACTERISTIC
/end FUNCTION
/begin FUNCTION jAdaPulzsKB_Fktn "Applikationesgroessen Instanz jAdaPulzsKB"
 /begin DEF_CHARACTERISTIC KF_NTMT_ADPULS_B KF_NTMT_ADPULS_B_EL KF_NTMT_ADPULS_SEK_B KF_NTMT_ADPULS_SEK_B_EL KL_CS_PFADPULSUN_B KL_CS_TSFADPULSUN_B /end DEF_CHARACTERISTIC
/end FUNCTION
/begin FUNCTION jAdaPulzsKC_Fktn "Applikationesgroessen Instanz jAdaPulzsKC"
 /begin DEF_CHARACTERISTIC KF_NTMT_ADPULS_C KF_NTMT_ADPULS_C_EL KF_NTMT_ADPULS_SEK_C KF_NTMT_ADPULS_SEK_C_EL KL_CS_PFADPULSUN_C KL_CS_TSFADPULSUN_C /end DEF_CHARACTERISTIC
/end FUNCTION
/begin FUNCTION jAdaPulzsKD_Fktn "Applikationesgroessen Instanz jAdaPulzsKD"
 /begin DEF_CHARACTERISTIC KF_NTMT_ADPULS_D KF_NTMT_ADPULS_D_EL KF_NTMT_ADPULS_SEK_D KF_NTMT_ADPULS_SEK_D_EL KL_CS_PFADPULSUN_D KL_CS_TSFADPULSUN_D /end DEF_CHARACTERISTIC
/end FUNCTION
/begin FUNCTION jAdaPulzsKE_Fktn "Applikationesgroessen Instanz jAdaPulzsKE"
 /begin DEF_CHARACTERISTIC KF_NTMT_ADPULS_E KF_NTMT_ADPULS_E_EL KF_NTMT_ADPULS_SEK_E KF_NTMT_ADPULS_SEK_E_EL KL_CS_PFADPULSUN_E KL_CS_TSFADPULSUN_E /end DEF_CHARACTERISTIC
/end FUNCTION
/begin FUNCTION jAdaPulzsKK0_Fktn "Applikationesgroessen Instanz jAdaPulzsKK0"
 /begin DEF_CHARACTERISTIC KF_NTMT_ADPULS_K0 KF_NTMT_ADPULS_SEK_K0 KL_CS_PFADPULSUN_K0 KL_CS_TSFADPULSUN_K0 /end DEF_CHARACTERISTIC
/end FUNCTION
/begin FUNCTION dAdaPulpfK_Fktn "Applikationesgroessen der Komponente dAdaPulpfK"
 /begin SUB_FUNCTION jAdaPulpfKA_Fktn jAdaPulpfKB_Fktn jAdaPulpfKC_Fktn jAdaPulpfKD_Fktn jAdaPulpfKE_Fktn jAdaPulpfKK0_Fktn /end SUB_FUNCTION
/end FUNCTION
/begin FUNCTION jAdaPulpfKA_Fktn "Applikationesgroessen Instanz jAdaPulpfKA"
 /begin DEF_CHARACTERISTIC PO_FNACHADA_A PO_FVORADASTART_A PO_FVORADA_A P_PFPULS_A P_PFPULS_SEK_A T_PFPULS_A T_PFPULS_SEK_A T_UEAMPPF_A T_UEBEWNEGBPF_A T_UEBEWNEGEPF_A T_UEBEWPOSBPF_A T_UEBEWPOSEPF_A T_VPFPULS_A /end DEF_CHARACTERISTIC
/end FUNCTION
/begin FUNCTION jAdaPulpfKB_Fktn "Applikationesgroessen Instanz jAdaPulpfKB"
 /begin DEF_CHARACTERISTIC PO_FNACHADA_B PO_FVORADASTART_B PO_FVORADA_B P_PFPULS_B P_PFPULS_SEK_B T_PFPULS_B T_PFPULS_SEK_B T_UEAMPPF_B T_UEBEWNEGBPF_B T_UEBEWNEGEPF_B T_UEBEWPOSBPF_B T_UEBEWPOSEPF_B T_VPFPULS_B /end DEF_CHARACTERISTIC
/end FUNCTION
/begin FUNCTION jAdaPulpfKC_Fktn "Applikationesgroessen Instanz jAdaPulpfKC"
 /begin DEF_CHARACTERISTIC PO_FNACHADA_C PO_FVORADASTART_C PO_FVORADA_C P_PFPULS_C P_PFPULS_SEK_C T_PFPULS_C T_PFPULS_SEK_C T_UEAMPPF_C T_UEBEWNEGBPF_C T_UEBEWNEGEPF_C T_UEBEWPOSBPF_C T_UEBEWPOSEPF_C T_VPFPULS_C /end DEF_CHARACTERISTIC
/end FUNCTION
/begin FUNCTION jAdaPulpfKD_Fktn "Applikationesgroessen Instanz jAdaPulpfKD"
 /begin DEF_CHARACTERISTIC PO_FNACHADA_D PO_FVORADASTART_D PO_FVORADA_D P_PFPULS_D P_PFPULS_SEK_D T_PFPULS_D T_PFPULS_SEK_D T_UEAMPPF_D T_UEBEWNEGBPF_D T_UEBEWNEGEPF_D T_UEBEWPOSBPF_D T_UEBEWPOSEPF_D T_VPFPULS_D /end DEF_CHARACTERISTIC
/end FUNCTION
/begin FUNCTION jAdaPulpfKE_Fktn "Applikationesgroessen Instanz jAdaPulpfKE"
 /begin DEF_CHARACTERISTIC PO_FNACHADA_E PO_FVORADASTART_E PO_FVORADA_E P_PFPULS_E P_PFPULS_SEK_E T_PFPULS_E T_PFPULS_SEK_E T_UEAMPPF_E T_UEBEWNEGBPF_E T_UEBEWNEGEPF_E T_UEBEWPOSBPF_E T_UEBEWPOSEPF_E T_VPFPULS_E /end DEF_CHARACTERISTIC
/end FUNCTION
/begin FUNCTION jAdaPulpfKK0_Fktn "Applikationesgroessen Instanz jAdaPulpfKK0"
 /begin DEF_CHARACTERISTIC PO_FNACHADA_K0 PO_FVORADASTART_K0 PO_FVORADA_K0 P_PFPULS_K0 P_PFPULS_SEK_K0 T_PFPULS_K0 T_PFPULS_SEK_K0 T_UEAMPPF_K0 T_UEBEWNEGBPF_K0 T_UEBEWNEGEPF_K0 T_UEBEWPOSBPF_K0 T_UEBEWPOSEPF_K0 T_VPFPULS_K0 /end DEF_CHARACTERISTIC
/end FUNCTION
/begin FUNCTION dAdaPulsfK_Fktn "Applikationesgroessen der Komponente dAdaPulsfK"
 /begin SUB_FUNCTION jAdaPulsfKA_Fktn jAdaPulsfKB_Fktn jAdaPulsfKC_Fktn jAdaPulsfKD_Fktn jAdaPulsfKE_Fktn jAdaPulsfKK0_Fktn /end SUB_FUNCTION
/end FUNCTION
/begin FUNCTION jAdaPulsfKA_Fktn "Applikationesgroessen Instanz jAdaPulsfKA"
 /begin DEF_CHARACTERISTIC TO_SFNACHADA_A TO_SFVORADA_A T_UEAMPTSF_A T_UEBEWNEGBTSF_A T_UEBEWNEGETSF_A T_UEBEWPOSBTSF_A T_UEBEWPOSETSF_A /end DEF_CHARACTERISTIC
/end FUNCTION
/begin FUNCTION jAdaPulsfKB_Fktn "Applikationesgroessen Instanz jAdaPulsfKB"
 /begin DEF_CHARACTERISTIC TO_SFNACHADA_B TO_SFVORADA_B T_UEAMPTSF_B T_UEBEWNEGBTSF_B T_UEBEWNEGETSF_B T_UEBEWPOSBTSF_B T_UEBEWPOSETSF_B /end DEF_CHARACTERISTIC
/end FUNCTION
/begin FUNCTION jAdaPulsfKC_Fktn "Applikationesgroessen Instanz jAdaPulsfKC"
 /begin DEF_CHARACTERISTIC TO_SFNACHADA_C TO_SFVORADA_C T_UEAMPTSF_C T_UEBEWNEGBTSF_C T_UEBEWNEGETSF_C T_UEBEWPOSBTSF_C T_UEBEWPOSETSF_C /end DEF_CHARACTERISTIC
/end FUNCTION
/begin FUNCTION jAdaPulsfKD_Fktn "Applikationesgroessen Instanz jAdaPulsfKD"
 /begin DEF_CHARACTERISTIC TO_SFNACHADA_D TO_SFVORADA_D T_UEAMPTSF_D T_UEBEWNEGBTSF_D T_UEBEWNEGETSF_D T_UEBEWPOSBTSF_D T_UEBEWPOSETSF_D /end DEF_CHARACTERISTIC
/end FUNCTION
/begin FUNCTION jAdaPulsfKE_Fktn "Applikationesgroessen Instanz jAdaPulsfKE"
 /begin DEF_CHARACTERISTIC TO_SFNACHADA_E TO_SFVORADA_E T_UEAMPTSF_E T_UEBEWNEGBTSF_E T_UEBEWNEGETSF_E T_UEBEWPOSBTSF_E T_UEBEWPOSETSF_E /end DEF_CHARACTERISTIC
/end FUNCTION
/begin FUNCTION jAdaPulsfKK0_Fktn "Applikationesgroessen Instanz jAdaPulsfKK0"
 /begin DEF_CHARACTERISTIC TO_SFNACHADA_K0 TO_SFVORADA_K0 T_UEAMPTSF_K0 T_UEBEWNEGBTSF_K0 T_UEBEWNEGETSF_K0 T_UEBEWPOSBTSF_K0 T_UEBEWPOSETSF_K0 /end DEF_CHARACTERISTIC
/end FUNCTION
/begin FUNCTION dAdaPstsf_Fktn "Applikationesgroessen der Komponente dAdaPstsf" /begin SUB_FUNCTION jAdaPstsf_Fktn /end SUB_FUNCTION /end FUNCTION
/begin FUNCTION jAdaPstsf_Fktn "Applikationesgroessen Instanz jAdaPstsf"
 /begin DEF_CHARACTERISTIC KL_TSF_MAXADAWERTDELTA_STADA TAB_HAINCTSF_STADA TAB_TSF_ADMAX_STADA TAB_TSF_ADMIN_STADA T_RAINCTSF_STADA T_RAUEBINCTSF_STADA T_ZWTSFINC_STADA /end DEF_CHARACTERISTIC
/end FUNCTION
/begin FUNCTION dAdaPstpf_Fktn "Applikationesgroessen der Komponente dAdaPstpf" /begin SUB_FUNCTION jAdaPstpf_Fktn /end SUB_FUNCTION /end FUNCTION
/begin FUNCTION jAdaPstpf_Fktn "Applikationesgroessen Instanz jAdaPstpf"
 /begin DEF_CHARACTERISTIC F_TVABBR_PF_STADA F_TVABBR_SF_STADA KL_PF_MAXADAWERTDELTA_STADA P_RAINCPF_STADA P_RAUEBINCPF_STADA P_ZWPFINC_STADA TAB_HAINCPF_STADA TAB_PF_ADMAX_STADA TAB_PF_ADMIN_STADA TAB_SWI_DEAKT_DITHER_STADA TO_VPFPULS_DITHEROFF_STADA /end DEF_CHARACTERISTIC
/end FUNCTION
/begin FUNCTION dAdaPstpfK_Fktn "Applikationesgroessen der Komponente dAdaPstpfK"
 /begin SUB_FUNCTION jAdaPstpfKA_Fktn jAdaPstpfKB_Fktn jAdaPstpfKC_Fktn jAdaPstpfKD_Fktn jAdaPstpfKE_Fktn jAdaPstpfKK0_Fktn /end SUB_FUNCTION
/end FUNCTION
/begin FUNCTION jAdaPstpfKA_Fktn "Applikationesgroessen Instanz jAdaPstpfKA"
 /begin DEF_CHARACTERISTIC PO_FNACHADA_STADA_A PO_FVORADA_STADA_A P_PFPULS_STADA_A TO_SFRED_STADA_A T_PFPULS_STADA_A T_UEAMPPF_STADA_A T_UEBEWNEGBPF_STADA_A T_UEBEWNEGEPF_STADA_A T_UEBEWPOSBPF_STADA_A T_UEBEWPOSEPF_STADA_A T_VPFPULS_STADA_A /end DEF_CHARACTERISTIC
/end FUNCTION
/begin FUNCTION jAdaPstpfKB_Fktn "Applikationesgroessen Instanz jAdaPstpfKB"
 /begin DEF_CHARACTERISTIC PO_FNACHADA_STADA_B PO_FVORADA_STADA_B P_PFPULS_STADA_B TO_SFRED_STADA_B T_PFPULS_STADA_B T_UEAMPPF_STADA_B T_UEBEWNEGBPF_STADA_B T_UEBEWNEGEPF_STADA_B T_UEBEWPOSBPF_STADA_B T_UEBEWPOSEPF_STADA_B T_VPFPULS_STADA_B /end DEF_CHARACTERISTIC
/end FUNCTION
/begin FUNCTION jAdaPstpfKC_Fktn "Applikationesgroessen Instanz jAdaPstpfKC"
 /begin DEF_CHARACTERISTIC PO_FNACHADA_STADA_C PO_FVORADA_STADA_C P_PFPULS_STADA_C TO_SFRED_STADA_C T_PFPULS_STADA_C T_UEAMPPF_STADA_C T_UEBEWNEGBPF_STADA_C T_UEBEWNEGEPF_STADA_C T_UEBEWPOSBPF_STADA_C T_UEBEWPOSEPF_STADA_C T_VPFPULS_STADA_C /end DEF_CHARACTERISTIC
/end FUNCTION
/begin FUNCTION jAdaPstpfKD_Fktn "Applikationesgroessen Instanz jAdaPstpfKD"
 /begin DEF_CHARACTERISTIC PO_FNACHADA_STADA_D PO_FVORADA_STADA_D P_PFPULS_STADA_D TO_SFRED_STADA_D T_PFPULS_STADA_D T_UEAMPPF_STADA_D T_UEBEWNEGBPF_STADA_D T_UEBEWNEGEPF_STADA_D T_UEBEWPOSBPF_STADA_D T_UEBEWPOSEPF_STADA_D T_VPFPULS_STADA_D /end DEF_CHARACTERISTIC
/end FUNCTION
/begin FUNCTION jAdaPstpfKE_Fktn "Applikationesgroessen Instanz jAdaPstpfKE"
 /begin DEF_CHARACTERISTIC PO_FNACHADA_STADA_E PO_FVORADA_STADA_E P_PFPULS_STADA_E TO_SFRED_STADA_E T_PFPULS_STADA_E T_UEAMPPF_STADA_E T_UEBEWNEGBPF_STADA_E T_UEBEWNEGEPF_STADA_E T_UEBEWPOSBPF_STADA_E T_UEBEWPOSEPF_STADA_E T_VPFPULS_STADA_E /end DEF_CHARACTERISTIC
/end FUNCTION
/begin FUNCTION jAdaPstpfKK0_Fktn "Applikationesgroessen Instanz jAdaPstpfKK0"
 /begin DEF_CHARACTERISTIC PO_FNACHADA_STADA_K0 PO_FVORADA_STADA_K0 P_PFPULS_STADA_K0 TO_SFRED_STADA_K0 T_PFPULS_STADA_K0 T_UEAMPPF_STADA_K0 T_UEBEWNEGBPF_STADA_K0 T_UEBEWNEGEPF_STADA_K0 T_UEBEWPOSBPF_STADA_K0 T_UEBEWPOSEPF_STADA_K0 T_VPFPULS_STADA_K0 /end DEF_CHARACTERISTIC
/end FUNCTION
/begin FUNCTION dAdaPstbwX_Fktn "Applikationesgroessen der Komponente dAdaPstbwX" /begin SUB_FUNCTION jAdaPstbwXSF_Fktn jAdaPstbwXPF_Fktn /end SUB_FUNCTION /end FUNCTION
/begin FUNCTION jAdaPstbwXSF_Fktn "Applikationesgroessen Instanz jAdaPstbwXSF"
 /begin DEF_CHARACTERISTIC TAB_ND_PULSAMP_STADA_TSF TAB_ND_PULSNEG_STADA_TSF TAB_ND_PULSPOS_STADA_TSF TAB_ND_PULSZWNEG_STADA_TSF TAB_ND_PULSZWPOS_STADA_TSF /end DEF_CHARACTERISTIC
/end FUNCTION
/begin FUNCTION jAdaPstbwXPF_Fktn "Applikationesgroessen Instanz jAdaPstbwXPF"
 /begin DEF_CHARACTERISTIC TAB_ND_PULSAMP_STADA_PF TAB_ND_PULSNEG_STADA_PF TAB_ND_PULSPOS_STADA_PF TAB_ND_PULSZWNEG_STADA_PF TAB_ND_PULSZWPOS_STADA_PF /end DEF_CHARACTERISTIC
/end FUNCTION
/begin FUNCTION dAdaPstzsK_Fktn "Applikationesgroessen der Komponente dAdaPstzsK"
 /begin SUB_FUNCTION jAdaPstzsKA_Fktn jAdaPstzsKB_Fktn jAdaPstzsKC_Fktn jAdaPstzsKD_Fktn jAdaPstzsKE_Fktn jAdaPstzsKK0_Fktn /end SUB_FUNCTION
/end FUNCTION
/begin FUNCTION jAdaPstzsKA_Fktn "Applikationesgroessen Instanz jAdaPstzsKA" /begin DEF_CHARACTERISTIC T_SPTSFPULS_STADA_A /end DEF_CHARACTERISTIC /end FUNCTION
/begin FUNCTION jAdaPstzsKB_Fktn "Applikationesgroessen Instanz jAdaPstzsKB" /begin DEF_CHARACTERISTIC T_SPTSFPULS_STADA_B /end DEF_CHARACTERISTIC /end FUNCTION
/begin FUNCTION jAdaPstzsKC_Fktn "Applikationesgroessen Instanz jAdaPstzsKC" /begin DEF_CHARACTERISTIC T_SPTSFPULS_STADA_C /end DEF_CHARACTERISTIC /end FUNCTION
/begin FUNCTION jAdaPstzsKD_Fktn "Applikationesgroessen Instanz jAdaPstzsKD" /begin DEF_CHARACTERISTIC T_SPTSFPULS_STADA_D /end DEF_CHARACTERISTIC /end FUNCTION
/begin FUNCTION jAdaPstzsKE_Fktn "Applikationesgroessen Instanz jAdaPstzsKE" /begin DEF_CHARACTERISTIC T_SPTSFPULS_STADA_E /end DEF_CHARACTERISTIC /end FUNCTION
/begin FUNCTION jAdaPstzsKK0_Fktn "Applikationesgroessen Instanz jAdaPstzsKK0" /begin DEF_CHARACTERISTIC T_SPTSFPULS_STADA_K0 /end DEF_CHARACTERISTIC /end FUNCTION
/begin FUNCTION dAdaPstPrepulsK_Fktn "Applikationesgroessen der Komponente dAdaPstPrepulsK"
 /begin SUB_FUNCTION jAdaPstPrepulsKA_Fktn jAdaPstPrepulsKB_Fktn jAdaPstPrepulsKC_Fktn jAdaPstPrepulsKD_Fktn jAdaPstPrepulsKE_Fktn /end SUB_FUNCTION
/end FUNCTION
/begin FUNCTION jAdaPstPrepulsKA_Fktn "Applikationesgroessen Instanz jAdaPstPrepulsKA" /begin DEF_CHARACTERISTIC P_RA_VORSTADA_A T_RA_VORSTADA_AB_A T_RA_VORSTADA_AUF_A /end DEF_CHARACTERISTIC /end FUNCTION
/begin FUNCTION jAdaPstPrepulsKB_Fktn "Applikationesgroessen Instanz jAdaPstPrepulsKB" /begin DEF_CHARACTERISTIC P_RA_VORSTADA_B T_RA_VORSTADA_AB_B T_RA_VORSTADA_AUF_B /end DEF_CHARACTERISTIC /end FUNCTION
/begin FUNCTION jAdaPstPrepulsKC_Fktn "Applikationesgroessen Instanz jAdaPstPrepulsKC" /begin DEF_CHARACTERISTIC P_RA_VORSTADA_C T_RA_VORSTADA_AB_C T_RA_VORSTADA_AUF_C /end DEF_CHARACTERISTIC /end FUNCTION
/begin FUNCTION jAdaPstPrepulsKD_Fktn "Applikationesgroessen Instanz jAdaPstPrepulsKD" /begin DEF_CHARACTERISTIC P_RA_VORSTADA_D T_RA_VORSTADA_AB_D T_RA_VORSTADA_AUF_D /end DEF_CHARACTERISTIC /end FUNCTION
/begin FUNCTION jAdaPstPrepulsKE_Fktn "Applikationesgroessen Instanz jAdaPstPrepulsKE" /begin DEF_CHARACTERISTIC P_RA_VORSTADA_E T_RA_VORSTADA_AB_E T_RA_VORSTADA_AUF_E /end DEF_CHARACTERISTIC /end FUNCTION
/begin FUNCTION dAdaPstzs_Fktn "Applikationesgroessen der Komponente dAdaPstzs" /begin SUB_FUNCTION jAdaPstzs_Fktn /end SUB_FUNCTION /end FUNCTION
/begin FUNCTION jAdaPstzs_Fktn "Applikationesgroessen Instanz jAdaPstzs"
 /begin DEF_CHARACTERISTIC CS_HYSOB_STADA CS_HYSUN_STADA CS_OB_STADA CS_UN_STADA DKIS_STADA FI_ADANEU_STADA KL_FIADAAKT_NPRUEFZYKL_NEG_STADA KL_FIADAAKT_NPRUEFZYKL_POS_STADA NS_AB_STADA NS_EMDELTA_STADA NS_EMOB_STADA NS_EMUN_STADA NS_MOTDELTA_STADA NS_MOTOB_STADA NS_MOTUN_STADA NS_VMPULS_STADA N_PULSGRENZ_STADA PS_STADA TAB_ND_ADABBR_STADA TAB_SWIPRUEF_STADA_PF TAB_SWIPRUEF_STADA_TSF TAB_TESTFALL_KUPADA_STADA TS_MAX_INIT_STADA TS_NMOTLEERSOLL_AKTIV_STADA /end DEF_CHARACTERISTIC
/end FUNCTION
/begin FUNCTION dAdaPstsfK_Fktn "Applikationesgroessen der Komponente dAdaPstsfK"
 /begin SUB_FUNCTION jAdaPstsfKA_Fktn jAdaPstsfKB_Fktn jAdaPstsfKC_Fktn jAdaPstsfKD_Fktn jAdaPstsfKE_Fktn jAdaPstsfKK0_Fktn /end SUB_FUNCTION
/end FUNCTION
/begin FUNCTION jAdaPstsfKA_Fktn "Applikationesgroessen Instanz jAdaPstsfKA"
 /begin DEF_CHARACTERISTIC TO_SFNACHADA_STADA_A TO_SFVORADA_STADA_A T_UEAMPTSF_STADA_A T_UEBEWNEGBTSF_STADA_A T_UEBEWNEGETSF_STADA_A T_UEBEWPOSBTSF_STADA_A T_UEBEWPOSETSF_STADA_A /end DEF_CHARACTERISTIC
/end FUNCTION
/begin FUNCTION jAdaPstsfKB_Fktn "Applikationesgroessen Instanz jAdaPstsfKB"
 /begin DEF_CHARACTERISTIC TO_SFNACHADA_STADA_B TO_SFVORADA_STADA_B T_UEAMPTSF_STADA_B T_UEBEWNEGBTSF_STADA_B T_UEBEWNEGETSF_STADA_B T_UEBEWPOSBTSF_STADA_B T_UEBEWPOSETSF_STADA_B /end DEF_CHARACTERISTIC
/end FUNCTION
/begin FUNCTION jAdaPstsfKC_Fktn "Applikationesgroessen Instanz jAdaPstsfKC"
 /begin DEF_CHARACTERISTIC TO_SFNACHADA_STADA_C TO_SFVORADA_STADA_C T_UEAMPTSF_STADA_C T_UEBEWNEGBTSF_STADA_C T_UEBEWNEGETSF_STADA_C T_UEBEWPOSBTSF_STADA_C T_UEBEWPOSETSF_STADA_C /end DEF_CHARACTERISTIC
/end FUNCTION
/begin FUNCTION jAdaPstsfKD_Fktn "Applikationesgroessen Instanz jAdaPstsfKD"
 /begin DEF_CHARACTERISTIC TO_SFNACHADA_STADA_D TO_SFVORADA_STADA_D T_UEAMPTSF_STADA_D T_UEBEWNEGBTSF_STADA_D T_UEBEWNEGETSF_STADA_D T_UEBEWPOSBTSF_STADA_D T_UEBEWPOSETSF_STADA_D /end DEF_CHARACTERISTIC
/end FUNCTION
/begin FUNCTION jAdaPstsfKE_Fktn "Applikationesgroessen Instanz jAdaPstsfKE"
 /begin DEF_CHARACTERISTIC TO_SFNACHADA_STADA_E TO_SFVORADA_STADA_E T_UEAMPTSF_STADA_E T_UEBEWNEGBTSF_STADA_E T_UEBEWNEGETSF_STADA_E T_UEBEWPOSBTSF_STADA_E T_UEBEWPOSETSF_STADA_E /end DEF_CHARACTERISTIC
/end FUNCTION
/begin FUNCTION jAdaPstsfKK0_Fktn "Applikationesgroessen Instanz jAdaPstsfKK0"
 /begin DEF_CHARACTERISTIC TO_SFNACHADA_STADA_K0 TO_SFVORADA_STADA_K0 T_UEAMPTSF_STADA_K0 T_UEBEWNEGBTSF_STADA_K0 T_UEBEWNEGETSF_STADA_K0 T_UEBEWPOSBTSF_STADA_K0 T_UEBEWPOSETSF_STADA_K0 /end DEF_CHARACTERISTIC
/end FUNCTION
/begin FUNCTION dAdaUrlufterkSchaltung_Fktn "Applikationesgroessen der Komponente dAdaUrlufterkSchaltung" /begin SUB_FUNCTION jAdaUrlufterkSchaltung_Fktn /end SUB_FUNCTION /end FUNCTION
/begin FUNCTION jAdaUrlufterkSchaltung_Fktn "Applikationesgroessen Instanz jAdaUrlufterkSchaltung"
 /begin DEF_CHARACTERISTIC CS_SCHALTUNG_URL MPT_URL MS_MOTIST_URL MT_KUPADA_URL PS_SCHALTUNG_URL SWI_NTNAB_URL TAB_NG_SCHALTUNG_URL TAB_TBEW_SCHALTUNG_URL /end DEF_CHARACTERISTIC
/end FUNCTION
/begin FUNCTION dAdaUrlufterkPuls_Fktn "Applikationesgroessen der Komponente dAdaUrlufterkPuls" /begin SUB_FUNCTION jAdaUrlufterkPuls_Fktn /end SUB_FUNCTION /end FUNCTION
/begin FUNCTION jAdaUrlufterkPuls_Fktn "Applikationesgroessen Instanz jAdaUrlufterkPuls"
 /begin DEF_CHARACTERISTIC TAB_NGUETEPF_KUPADA_URL TAB_NGUETETSF_KUPADA_URL TAB_TBEW_KUPADA_URL /end DEF_CHARACTERISTIC
/end FUNCTION
/begin FUNCTION dAdaUrlufterk_Fktn "Applikationesgroessen der Komponente dAdaUrlufterk" /begin SUB_FUNCTION jAdaUrlufterk_Fktn /end SUB_FUNCTION /end FUNCTION
/begin FUNCTION jAdaUrlufterk_Fktn "Applikationesgroessen Instanz jAdaUrlufterk" /begin DEF_CHARACTERISTIC SWI_PRUEFTSF_URL TAB_PRUEFTSF_URL TAB_SWI_URL /end DEF_CHARACTERISTIC /end FUNCTION
/begin FUNCTION dAdaGlastS_Fktn "Applikationesgroessen der Komponente dAdaGlastS"
 /begin SUB_FUNCTION jAdaGlastHS12_Fktn jAdaGlastHS23_Fktn jAdaGlastHS34_Fktn jAdaGlastHS45_Fktn jAdaGlastHS56_Fktn jAdaGlastHS67_Fktn jAdaGlastHS78_Fktn jAdaGlastHS13_Fktn jAdaGlastHS24_Fktn jAdaGlastHS35_Fktn jAdaGlastHS46_Fktn jAdaGlastHS57_Fktn jAdaGlastHS68_Fktn jAdaGlastRS21_Fktn jAdaGlastRS32_Fktn jAdaGlastRS43_Fktn jAdaGlastRS54_Fktn jAdaGlastRS65_Fktn jAdaGlastRS76_Fktn jAdaGlastRS87_Fktn jAdaGlastRS31_Fktn jAdaGlastRS42_Fktn jAdaGlastRS51_Fktn jAdaGlastRS53_Fktn jAdaGlastRS63_Fktn jAdaGlastRS64_Fktn jAdaGlastRS71_Fktn jAdaGlastRS75_Fktn jAdaGlastRS82_Fktn jAdaGlastRS84_Fktn jAdaGlastRS86_Fktn /end SUB_FUNCTION
/end FUNCTION
/begin FUNCTION jAdaGlastHS12_Fktn "Applikationesgroessen Instanz jAdaGlastHS12"
 /begin DEF_CHARACTERISTIC KF_F_PMGLSKF1KORR12 KF_F_PMGLSKF1KORRKALT12 KF_F_PMGLSKF2KORR12 KF_F_PMGLSKF2KORRKALT12 KF_F_PMGLSKF3KORR12 KF_F_PMGLSKF3KORRKALT12 KF_PGLSAD_KF1_12 KF_PGLSAD_KF2_12 KF_PGLSAD_KF3_12 /end DEF_CHARACTERISTIC
/end FUNCTION
/begin FUNCTION jAdaGlastHS23_Fktn "Applikationesgroessen Instanz jAdaGlastHS23"
 /begin DEF_CHARACTERISTIC KF_F_PMGLSKF1KORR23 KF_F_PMGLSKF1KORRKALT23 KF_F_PMGLSKF2KORR23 KF_F_PMGLSKF2KORRKALT23 KF_F_PMGLSKF3KORR23 KF_F_PMGLSKF3KORRKALT23 KF_PGLSAD_KF1_23 KF_PGLSAD_KF2_23 KF_PGLSAD_KF3_23 /end DEF_CHARACTERISTIC
/end FUNCTION
/begin FUNCTION jAdaGlastHS34_Fktn "Applikationesgroessen Instanz jAdaGlastHS34"
 /begin DEF_CHARACTERISTIC KF_F_PMGLSKF1KORR34 KF_F_PMGLSKF1KORRKALT34 KF_F_PMGLSKF2KORR34 KF_F_PMGLSKF2KORRKALT34 KF_F_PMGLSKF3KORR34 KF_F_PMGLSKF3KORRKALT34 KF_PGLSAD_KF1_34 KF_PGLSAD_KF2_34 KF_PGLSAD_KF3_34 /end DEF_CHARACTERISTIC
/end FUNCTION
/begin FUNCTION jAdaGlastHS45_Fktn "Applikationesgroessen Instanz jAdaGlastHS45"
 /begin DEF_CHARACTERISTIC KF_F_PMGLSKF1KORR45 KF_F_PMGLSKF1KORRKALT45 KF_F_PMGLSKF2KORR45 KF_F_PMGLSKF2KORRKALT45 KF_F_PMGLSKF3KORR45 KF_F_PMGLSKF3KORRKALT45 KF_PGLSAD_KF1_45 KF_PGLSAD_KF2_45 KF_PGLSAD_KF3_45 /end DEF_CHARACTERISTIC
/end FUNCTION
/begin FUNCTION jAdaGlastHS56_Fktn "Applikationesgroessen Instanz jAdaGlastHS56"
 /begin DEF_CHARACTERISTIC KF_F_PMGLSKF1KORR56 KF_F_PMGLSKF1KORRKALT56 KF_F_PMGLSKF2KORR56 KF_F_PMGLSKF2KORRKALT56 KF_F_PMGLSKF3KORR56 KF_F_PMGLSKF3KORRKALT56 KF_PGLSAD_KF1_56 KF_PGLSAD_KF2_56 KF_PGLSAD_KF3_56 /end DEF_CHARACTERISTIC
/end FUNCTION
/begin FUNCTION jAdaGlastHS67_Fktn "Applikationesgroessen Instanz jAdaGlastHS67"
 /begin DEF_CHARACTERISTIC KF_F_PMGLSKF1KORR67 KF_F_PMGLSKF1KORRKALT67 KF_F_PMGLSKF2KORR67 KF_F_PMGLSKF2KORRKALT67 KF_F_PMGLSKF3KORR67 KF_F_PMGLSKF3KORRKALT67 KF_PGLSAD_KF1_67 KF_PGLSAD_KF2_67 KF_PGLSAD_KF3_67 /end DEF_CHARACTERISTIC
/end FUNCTION
/begin FUNCTION jAdaGlastHS78_Fktn "Applikationesgroessen Instanz jAdaGlastHS78"
 /begin DEF_CHARACTERISTIC KF_F_PMGLSKF1KORR78 KF_F_PMGLSKF1KORRKALT78 KF_F_PMGLSKF2KORR78 KF_F_PMGLSKF2KORRKALT78 KF_F_PMGLSKF3KORR78 KF_F_PMGLSKF3KORRKALT78 KF_PGLSAD_KF1_78 KF_PGLSAD_KF2_78 KF_PGLSAD_KF3_78 /end DEF_CHARACTERISTIC
/end FUNCTION
/begin FUNCTION jAdaGlastHS13_Fktn "Applikationesgroessen Instanz jAdaGlastHS13"
 /begin DEF_CHARACTERISTIC KF_F_PMGLSKF1KORR13 KF_F_PMGLSKF1KORRKALT13 KF_PGLSAD_KF1_13 /end DEF_CHARACTERISTIC
/end FUNCTION
/begin FUNCTION jAdaGlastHS24_Fktn "Applikationesgroessen Instanz jAdaGlastHS24"
 /begin DEF_CHARACTERISTIC KF_F_PMGLSKF1KORR24 KF_F_PMGLSKF1KORRKALT24 KF_PGLSAD_KF1_24 /end DEF_CHARACTERISTIC
/end FUNCTION
/begin FUNCTION jAdaGlastHS35_Fktn "Applikationesgroessen Instanz jAdaGlastHS35"
 /begin DEF_CHARACTERISTIC KF_F_PMGLSKF1KORR35 KF_F_PMGLSKF1KORRKALT35 KF_PGLSAD_KF1_35 /end DEF_CHARACTERISTIC
/end FUNCTION
/begin FUNCTION jAdaGlastHS46_Fktn "Applikationesgroessen Instanz jAdaGlastHS46"
 /begin DEF_CHARACTERISTIC KF_F_PMGLSKF1KORR46 KF_F_PMGLSKF1KORRKALT46 KF_PGLSAD_KF1_46 /end DEF_CHARACTERISTIC
/end FUNCTION
/begin FUNCTION jAdaGlastHS57_Fktn "Applikationesgroessen Instanz jAdaGlastHS57"
 /begin DEF_CHARACTERISTIC KF_F_PMGLSKF1KORR57 KF_F_PMGLSKF1KORRKALT57 KF_PGLSAD_KF1_57 /end DEF_CHARACTERISTIC
/end FUNCTION
/begin FUNCTION jAdaGlastHS68_Fktn "Applikationesgroessen Instanz jAdaGlastHS68"
 /begin DEF_CHARACTERISTIC KF_F_PMGLSKF1KORR68 KF_F_PMGLSKF1KORRKALT68 KF_PGLSAD_KF1_68 /end DEF_CHARACTERISTIC
/end FUNCTION
/begin FUNCTION jAdaGlastRS21_Fktn "Applikationesgroessen Instanz jAdaGlastRS21"
 /begin DEF_CHARACTERISTIC KF_F_PMGLSKF1KORR21 KF_F_PMGLSKF2KORR21 KF_PGLSAD_KF1_21 KF_PGLSAD_KF2_21 /end DEF_CHARACTERISTIC
/end FUNCTION
/begin FUNCTION jAdaGlastRS32_Fktn "Applikationesgroessen Instanz jAdaGlastRS32"
 /begin DEF_CHARACTERISTIC KF_F_PMGLSKF1KORR32 KF_F_PMGLSKF2KORR32 KF_PGLSAD_KF1_32 KF_PGLSAD_KF2_32 /end DEF_CHARACTERISTIC
/end FUNCTION
/begin FUNCTION jAdaGlastRS43_Fktn "Applikationesgroessen Instanz jAdaGlastRS43"
 /begin DEF_CHARACTERISTIC KF_F_PMGLSKF1KORR43 KF_F_PMGLSKF2KORR43 KF_PGLSAD_KF1_43 KF_PGLSAD_KF2_43 /end DEF_CHARACTERISTIC
/end FUNCTION
/begin FUNCTION jAdaGlastRS54_Fktn "Applikationesgroessen Instanz jAdaGlastRS54"
 /begin DEF_CHARACTERISTIC KF_F_PMGLSKF1KORR54 KF_F_PMGLSKF2KORR54 KF_PGLSAD_KF1_54 KF_PGLSAD_KF2_54 /end DEF_CHARACTERISTIC
/end FUNCTION
/begin FUNCTION jAdaGlastRS65_Fktn "Applikationesgroessen Instanz jAdaGlastRS65"
 /begin DEF_CHARACTERISTIC KF_F_PMGLSKF1KORR65 KF_F_PMGLSKF2KORR65 KF_PGLSAD_KF1_65 KF_PGLSAD_KF2_65 /end DEF_CHARACTERISTIC
/end FUNCTION
/begin FUNCTION jAdaGlastRS76_Fktn "Applikationesgroessen Instanz jAdaGlastRS76"
 /begin DEF_CHARACTERISTIC KF_F_PMGLSKF1KORR76 KF_F_PMGLSKF2KORR76 KF_PGLSAD_KF1_76 KF_PGLSAD_KF2_76 /end DEF_CHARACTERISTIC
/end FUNCTION
/begin FUNCTION jAdaGlastRS87_Fktn "Applikationesgroessen Instanz jAdaGlastRS87"
 /begin DEF_CHARACTERISTIC KF_F_PMGLSKF1KORR87 KF_F_PMGLSKF2KORR87 KF_PGLSAD_KF1_87 KF_PGLSAD_KF2_87 /end DEF_CHARACTERISTIC
/end FUNCTION
/begin FUNCTION jAdaGlastRS31_Fktn "Applikationesgroessen Instanz jAdaGlastRS31" /begin DEF_CHARACTERISTIC KF_F_PMGLSKF1KORR31 KF_PGLSAD_KF1_31 /end DEF_CHARACTERISTIC /end FUNCTION
/begin FUNCTION jAdaGlastRS42_Fktn "Applikationesgroessen Instanz jAdaGlastRS42" /begin DEF_CHARACTERISTIC KF_F_PMGLSKF1KORR42 KF_PGLSAD_KF1_42 /end DEF_CHARACTERISTIC /end FUNCTION
/begin FUNCTION jAdaGlastRS51_Fktn "Applikationesgroessen Instanz jAdaGlastRS51" /begin DEF_CHARACTERISTIC KF_F_PMGLSKF1KORR51 KF_PGLSAD_KF1_51 /end DEF_CHARACTERISTIC /end FUNCTION
/begin FUNCTION jAdaGlastRS53_Fktn "Applikationesgroessen Instanz jAdaGlastRS53" /begin DEF_CHARACTERISTIC KF_F_PMGLSKF1KORR53 KF_PGLSAD_KF1_53 /end DEF_CHARACTERISTIC /end FUNCTION
/begin FUNCTION jAdaGlastRS63_Fktn "Applikationesgroessen Instanz jAdaGlastRS63" /begin DEF_CHARACTERISTIC KF_F_PMGLSKF1KORR63 KF_PGLSAD_KF1_63 /end DEF_CHARACTERISTIC /end FUNCTION
/begin FUNCTION jAdaGlastRS64_Fktn "Applikationesgroessen Instanz jAdaGlastRS64" /begin DEF_CHARACTERISTIC KF_F_PMGLSKF1KORR64 KF_PGLSAD_KF1_64 /end DEF_CHARACTERISTIC /end FUNCTION
/begin FUNCTION jAdaGlastRS71_Fktn "Applikationesgroessen Instanz jAdaGlastRS71" /begin DEF_CHARACTERISTIC KF_F_PMGLSKF1KORR71 KF_PGLSAD_KF1_71 /end DEF_CHARACTERISTIC /end FUNCTION
/begin FUNCTION jAdaGlastRS75_Fktn "Applikationesgroessen Instanz jAdaGlastRS75" /begin DEF_CHARACTERISTIC KF_F_PMGLSKF1KORR75 KF_PGLSAD_KF1_75 /end DEF_CHARACTERISTIC /end FUNCTION
/begin FUNCTION jAdaGlastRS82_Fktn "Applikationesgroessen Instanz jAdaGlastRS82" /begin DEF_CHARACTERISTIC KF_F_PMGLSKF1KORR82 KF_PGLSAD_KF1_82 /end DEF_CHARACTERISTIC /end FUNCTION
/begin FUNCTION jAdaGlastRS84_Fktn "Applikationesgroessen Instanz jAdaGlastRS84" /begin DEF_CHARACTERISTIC KF_F_PMGLSKF1KORR84 KF_PGLSAD_KF1_84 /end DEF_CHARACTERISTIC /end FUNCTION
/begin FUNCTION jAdaGlastRS86_Fktn "Applikationesgroessen Instanz jAdaGlastRS86" /begin DEF_CHARACTERISTIC KF_F_PMGLSKF1KORR86 KF_PGLSAD_KF1_86 /end DEF_CHARACTERISTIC /end FUNCTION
/begin FUNCTION dAdaGlast_Fktn "Applikationesgroessen der Komponente dAdaGlast" /begin SUB_FUNCTION jAdaGlast_Fktn /end SUB_FUNCTION /end FUNCTION
/begin FUNCTION jAdaGlast_Fktn "Applikationesgroessen Instanz jAdaGlast"
 /begin DEF_CHARACTERISTIC CSOB_GLSAD CSUN_GLSAD DKIS_TRIMMOFF DKI_PSGLSADHS DKI_PSGLSADRS KL_F_GLSADLZ KL_SBAKLZ_GLS N_MIN_GLSADXRS P_GLSADMAX P_GLSADMIN SHIFTCOUNTERGLSHS_TRIM SHIFTCOUNTERGLSRSKF1_TRIM SHIFTCOUNTERGLSRSKF2_TRIM SWI_ABBRGLS_PFADA SWI_GLSADVERBOT_SLTSF_ESTART_BEW SWI_GLSAD_LOESCH_ISTGANG SWI_GLSAD_LOESCH_ZIELGANG SWI_GLS_TRIM SWI_TRIMMUNDODER_KPLBP SWI_TRIMM_SCHUTZ_VERS SWI_ZKINDEX_GLS TAB_CSOBKPLGLSAD TAB_GLSAD_KF TAB_GLSAD_LESEN_SCHREIBEN TAB_MTUN_GLSAD_DHS TAB_MTUN_GLSAD_DRS TAB_MTUN_GLSAD_HS TAB_MTUN_GLSAD_NFRS TAB_MTUN_GLSAD_RS TAB_MT_GLSADGR_DHS TAB_MT_GLSADGR_DRS TAB_MT_GLSADGR_HS TAB_MT_GLSADGR_HS_E TAB_MT_GLSADGR_NFRS TAB_MT_GLSADGR_RS TAB_NT_GLSADGR_DHS TAB_NT_GLSADGR_DRS TAB_NT_GLSADGR_HS TAB_NT_GLSADGR_HS_E TAB_NT_GLSADGR_NFRS TAB_NT_GLSADGR_RS TAB_N_MIN_GLSADDHSWARM TAB_N_MIN_GLSADHSWARM TAB_SWI_DHS_GLSADKALT_AKTIV TAB_SWI_GLSAD TAB_SWI_GLSADKALT_AKTIV TAB_SWI_HYBEW /end DEF_CHARACTERISTIC
/end FUNCTION
/begin FUNCTION dNvrContr_Fktn "Applikationesgroessen der Komponente dNvrContr" /begin SUB_FUNCTION jNvrContr_Fktn /end SUB_FUNCTION /end FUNCTION
/begin FUNCTION jNvrContr_Fktn "Applikationesgroessen Instanz jNvrContr" /begin DEF_CHARACTERISTIC SWI_EEPROM_CHECKSUMME SWI_EEPROM_INIT /end DEF_CHARACTERISTIC /end FUNCTION
/begin FUNCTION dKasEkopl_Fktn "Applikationesgroessen der Komponente dKasEkopl" /begin SUB_FUNCTION jKasEkopl_Fktn /end SUB_FUNCTION /end FUNCTION
/begin RECORD_LAYOUT kw_bool8_S6_S3 FNC_VALUES 1 UBYTE COLUMN_DIR DIRECT /end RECORD_LAYOUT
/begin RECORD_LAYOUT kw_ui8_S6_S3 FNC_VALUES 1 UBYTE COLUMN_DIR DIRECT /end RECORD_LAYOUT
/begin RECORD_LAYOUT kw_ui16_S6_S3 FNC_VALUES 1 UWORD COLUMN_DIR DIRECT /end RECORD_LAYOUT
/begin RECORD_LAYOUT kw_si8_S6_S3 FNC_VALUES 1 SBYTE COLUMN_DIR DIRECT /end RECORD_LAYOUT
/begin RECORD_LAYOUT kw_si16_S6_S3 FNC_VALUES 1 SWORD COLUMN_DIR DIRECT /end RECORD_LAYOUT
/begin RECORD_LAYOUT tab_bool8_S6_S3 FNC_VALUES 2 UBYTE COLUMN_DIR DIRECT NO_AXIS_PTS_X 1 ULONG /end RECORD_LAYOUT
/begin RECORD_LAYOUT tab_ui8_S6_S3 FNC_VALUES 2 UBYTE COLUMN_DIR DIRECT NO_AXIS_PTS_X 1 ULONG /end RECORD_LAYOUT
/begin RECORD_LAYOUT tab_ui16_S6_S3 FNC_VALUES 2 UWORD COLUMN_DIR DIRECT NO_AXIS_PTS_X 1 ULONG /end RECORD_LAYOUT
/begin RECORD_LAYOUT tab_si16_S6_S3 FNC_VALUES 2 SWORD COLUMN_DIR DIRECT NO_AXIS_PTS_X 1 ULONG /end RECORD_LAYOUT
/begin RECORD_LAYOUT tab2d_bool8_S6_S3 FNC_VALUES 3 UBYTE ROW_DIR DIRECT NO_AXIS_PTS_X 1 ULONG NO_AXIS_PTS_Y 2 ULONG /end RECORD_LAYOUT
/begin RECORD_LAYOUT tab2d_ui8_S6_S3 FNC_VALUES 3 UBYTE ROW_DIR DIRECT NO_AXIS_PTS_X 1 ULONG NO_AXIS_PTS_Y 2 ULONG /end RECORD_LAYOUT
/begin RECORD_LAYOUT tab2d_si16_S6_S3 FNC_VALUES 3 SWORD ROW_DIR DIRECT NO_AXIS_PTS_X 1 ULONG NO_AXIS_PTS_Y 2 ULONG /end RECORD_LAYOUT
/begin RECORD_LAYOUT kl_ui8_S6_S3 FNC_VALUES 3 UBYTE COLUMN_DIR DIRECT AXIS_PTS_X 2 UBYTE INDEX_INCR DIRECT NO_AXIS_PTS_X 1 ULONG /end RECORD_LAYOUT
/begin RECORD_LAYOUT kl_ui16_S6_S3 FNC_VALUES 3 UWORD COLUMN_DIR DIRECT AXIS_PTS_X 2 UWORD INDEX_INCR DIRECT NO_AXIS_PTS_X 1 ULONG /end RECORD_LAYOUT
/begin RECORD_LAYOUT kl_si16_S6_S3 FNC_VALUES 3 SWORD COLUMN_DIR DIRECT AXIS_PTS_X 2 SWORD INDEX_INCR DIRECT NO_AXIS_PTS_X 1 ULONG /end RECORD_LAYOUT
/begin RECORD_LAYOUT kf_si16_S6_S3 FNC_VALUES 5 SWORD ROW_DIR DIRECT AXIS_PTS_X 3 SWORD INDEX_INCR DIRECT AXIS_PTS_Y 4 SWORD INDEX_INCR DIRECT NO_AXIS_PTS_X 1 ULONG NO_AXIS_PTS_Y 2 ULONG /end RECORD_LAYOUT
/end MODULE
/end PROJECT
