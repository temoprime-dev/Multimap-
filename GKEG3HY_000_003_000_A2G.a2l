ASAP2_VERSION 1 51
/begin PROJECT _929_929 "Gen2_BMW_System_Supplier_Lib"
/begin HEADER "" VERSION "C_03_03" PROJECT_NO _929_929 /end HEADER
/begin MODULE DIM ""
/begin MOD_COMMON "" BYTE_ORDER MSB_FIRST ALIGNMENT_BYTE 1 ALIGNMENT_WORD 2 ALIGNMENT_LONG 4 ALIGNMENT_FLOAT32_IEEE 4 /end MOD_COMMON
/begin CHARACTERISTIC KL_TSYNMTRAKZUSP12 "Zeit vor sync. Ende Schaltdruck/Start 3. Rampe KZU" CURVE 0x2514DC kl_ui8_S6_S3 1280 UMR_MSEC__10_1_M128_S6_S3 -1280 0
 /begin AXIS_DESCR STD_AXIS zff_atsys._.iSignale._.obj.sig_m_t8 UMR_NM__8_1_M50_S6_S3 4 -400 1640 DEPOSIT ABSOLUTE MONOTONY MON_INCREASE /end AXIS_DESCR
/end CHARACTERISTIC
/begin CHARACTERISTIC KF_TFCGNTSP12 "Fuellzeit" MAP 0x2514E8 kf_ui8_S6_S3 2540 UMR_MSEC__10_1_0_S6_S3 0 2540
 /begin AXIS_DESCR STD_AXIS zff_atsys._.iSignale._.obj.sig_c_getr UMR_GRADC__1_1_M40_S6_S3 6 -40 150 DEPOSIT ABSOLUTE MONOTONY MON_INCREASE /end AXIS_DESCR
 /begin AXIS_DESCR STD_AXIS zff_atsys._.iSignale._.obj.sig_n_t8 UMR_U_MIN_32_1_0_S6_S3 3 0 8160 DEPOSIT ABSOLUTE MONOTONY MON_INCREASE /end AXIS_DESCR
/end CHARACTERISTIC
/begin CHARACTERISTIC T_VKZUSP12 "Verzoegerungszeit zuschaltende Kupplung nach Schaltbeginn" VALUE 0x26E871 kw_ui8_S6_S3 2540 UMR_MSEC__10_1_0_S6_S3 0 2540 /end CHARACTERISTIC
/begin CHARACTERISTIC KF_POFMTNSP12 "Kennfeld Fuelldruckoffset(n_t, m_t)" MAP 0x25150C kf_si16_S6_S3 12.75 UMR_BAR__1_1000_0_S6_S3 -6.4 6.35
 /begin AXIS_DESCR STD_AXIS zff_atsys._.iSignale._.obj.sig_n_t UMR_U_MIN_1_1_0_S6_S3 4 0 8160 DEPOSIT ABSOLUTE MONOTONY MON_INCREASE /end AXIS_DESCR
 /begin AXIS_DESCR STD_AXIS zff_atsys._.iSignale._.obj.sig_m_t UMR_NM__1_1_0_S6_S3 6 -400 1640 DEPOSIT ABSOLUTE MONOTONY MON_INCREASE /end AXIS_DESCR
/end CHARACTERISTIC
/begin CHARACTERISTIC KF_T_DT_IG_CHANGESP12 "Kennfeld Zeitvorhalt für Übergabe Rampenzeit auf Schaltdruck" MAP 0x251558 kf_si16_S6_S3 5080 UMR_MSEC__10_1_0_S6_S3 -2540 2540
 /begin AXIS_DESCR STD_AXIS zff_atsys._.iSignale._.obj.sig_n_t UMR_U_MIN_1_1_0_S6_S3 4 0 8160 DEPOSIT ABSOLUTE MONOTONY MON_INCREASE /end AXIS_DESCR
 /begin AXIS_DESCR STD_AXIS zff_atsys._.iSignale._.obj.sig_m_t UMR_NM__1_1_0_S6_S3 4 -400 1640 DEPOSIT ABSOLUTE MONOTONY MON_INCREASE /end AXIS_DESCR
/end CHARACTERISTIC
/begin CHARACTERISTIC KF_T2_DT_IG_CHANGESP12 "2. Kennfeld Zeitvorhalt für Übergabe Rampenzeit auf Schaltdruck" MAP 0x251590 kf_si16_S6_S3 5080 UMR_MSEC__10_1_0_S6_S3 -2540 2540
 /begin AXIS_DESCR STD_AXIS zff_atsys._.iSignale._.obj.sig_n_t UMR_U_MIN_1_1_0_S6_S3 4 0 8160 DEPOSIT ABSOLUTE MONOTONY MON_INCREASE /end AXIS_DESCR
 /begin AXIS_DESCR STD_AXIS zff_atsys._.iSignale._.obj.sig_m_t UMR_NM__1_1_0_S6_S3 4 -400 1640 DEPOSIT ABSOLUTE MONOTONY MON_INCREASE /end AXIS_DESCR
/end CHARACTERISTIC
/begin CHARACTERISTIC KF_TRAMTNTSP12 "Zeit 1. Rampe der zuschaltenden Kupplung" MAP 0x2515C8 kf_ui8_S6_S3 2540 UMR_MSEC__10_1_0_S6_S3 0 2540
 /begin AXIS_DESCR STD_AXIS zff_atsys._.iSignale._.obj.sig_m_t8 UMR_NM__8_1_M50_S6_S3 4 -400 1640 DEPOSIT ABSOLUTE MONOTONY MON_INCREASE /end AXIS_DESCR
 /begin AXIS_DESCR STD_AXIS zff_atsys._.iSignale._.obj.sig_n_t8 UMR_U_MIN_32_1_0_S6_S3 4 0 8160 DEPOSIT ABSOLUTE MONOTONY MON_INCREASE /end AXIS_DESCR
/end CHARACTERISTIC
/begin CHARACTERISTIC KF_PKZUSP12 "Schaltdruck zuschaltende Kupplung" MAP 0x2515E8 kf_si16_S6_S3 12.75 UMR_BAR__1_1000_0_S6_S3 0 12.75
 /begin AXIS_DESCR STD_AXIS iSasZentr.iSchaltend.n_tkf UMR_U_MIN_32_1_0_S6_S3 8 0 8160 DEPOSIT ABSOLUTE MONOTONY MON_INCREASE /end AXIS_DESCR
 /begin AXIS_DESCR STD_AXIS zff_atsys._.iSignale._.obj.sig_m_t UMR_NM__1_1_0_S6_S3 10 -400 1640 DEPOSIT ABSOLUTE MONOTONY MON_INCREASE /end AXIS_DESCR
/end CHARACTERISTIC
/begin CHARACTERISTIC F_PRASP12 "Druckfaktor waehrend Rampe auf Schaltdruck" VALUE 0x26E872 kw_ui8_S6_S3 1 UMR___1_100_0_S6_S3 0 1 /end CHARACTERISTIC
/begin CHARACTERISTIC F_TRASP12 "Zeitfaktor waehrend Rampe auf Schaltdruck" VALUE 0x26E873 kw_ui8_S6_S3 1 UMR___1_100_0_S6_S3 0 1 /end CHARACTERISTIC
/begin CHARACTERISTIC KF_PGOKZUMTNTSP12 "Schaltdruckgradient" MAP 0x2516B4 kf_si16_S6_S3 200 UMR_BAR_SEC_1_10_0_S6_S3 -100 100
 /begin AXIS_DESCR STD_AXIS zff_atsys._.iSignale._.obj.sig_m_t UMR_NM__1_1_0_S6_S3 6 -400 1640 DEPOSIT ABSOLUTE MONOTONY MON_INCREASE /end AXIS_DESCR
 /begin AXIS_DESCR STD_AXIS zff_atsys._.iSignale._.obj.sig_n_t UMR_U_MIN_1_1_0_S6_S3 4 0 8160 DEPOSIT ABSOLUTE MONOTONY MON_INCREASE /end AXIS_DESCR
/end CHARACTERISTIC
/begin CHARACTERISTIC KF_POKZUMTCGSP12 "Schaltdruckoffset" MAP 0x251700 kf_si16_S6_S3 12.75 UMR_BAR__1_1000_0_S6_S3 -6.4 6.35
 /begin AXIS_DESCR STD_AXIS zff_atsys._.iSignale._.obj.sig_m_t UMR_NM__1_1_0_S6_S3 8 -400 1640 DEPOSIT ABSOLUTE MONOTONY MON_INCREASE /end AXIS_DESCR
 /begin AXIS_DESCR STD_AXIS zff_atsys._.iSignale._.obj.sig_c_getr UMR_GRADC__1_1_M40_S6_S3 10 -40 150 DEPOSIT ABSOLUTE MONOTONY MON_INCREASE /end AXIS_DESCR
/end CHARACTERISTIC
/begin CHARACTERISTIC KL_TSYNMTRAKZUSP23 "Zeit vor sync. Ende Schaltdruck/Start 3. Rampe KZU" CURVE 0x2517CC kl_ui8_S6_S3 1280 UMR_MSEC__10_1_M128_S6_S3 -1280 0
 /begin AXIS_DESCR STD_AXIS zff_atsys._.iSignale._.obj.sig_m_t8 UMR_NM__8_1_M50_S6_S3 4 -400 1640 DEPOSIT ABSOLUTE MONOTONY MON_INCREASE /end AXIS_DESCR
/end CHARACTERISTIC
/begin CHARACTERISTIC KF_TFCGNTSP23 "Fuellzeit" MAP 0x2517D8 kf_ui8_S6_S3 2540 UMR_MSEC__10_1_0_S6_S3 0 2540
 /begin AXIS_DESCR STD_AXIS zff_atsys._.iSignale._.obj.sig_c_getr UMR_GRADC__1_1_M40_S6_S3 6 -40 150 DEPOSIT ABSOLUTE MONOTONY MON_INCREASE /end AXIS_DESCR
 /begin AXIS_DESCR STD_AXIS zff_atsys._.iSignale._.obj.sig_n_t8 UMR_U_MIN_32_1_0_S6_S3 3 0 8160 DEPOSIT ABSOLUTE MONOTONY MON_INCREASE /end AXIS_DESCR
/end CHARACTERISTIC
/begin CHARACTERISTIC T_VKZUSP23 "Verzoegerungszeit zuschaltende Kupplung nach Schaltbeginn" VALUE 0x26E874 kw_ui8_S6_S3 2540 UMR_MSEC__10_1_0_S6_S3 0 2540 /end CHARACTERISTIC
/begin CHARACTERISTIC KF_POFMTNSP23 "Kennfeld Fuelldruckoffset(n_t, m_t)" MAP 0x2517FC kf_si16_S6_S3 12.75 UMR_BAR__1_1000_0_S6_S3 -6.4 6.35
 /begin AXIS_DESCR STD_AXIS zff_atsys._.iSignale._.obj.sig_n_t UMR_U_MIN_1_1_0_S6_S3 4 0 8160 DEPOSIT ABSOLUTE MONOTONY MON_INCREASE /end AXIS_DESCR
 /begin AXIS_DESCR STD_AXIS zff_atsys._.iSignale._.obj.sig_m_t UMR_NM__1_1_0_S6_S3 6 -400 1640 DEPOSIT ABSOLUTE MONOTONY MON_INCREASE /end AXIS_DESCR
/end CHARACTERISTIC
/begin CHARACTERISTIC KF_T_DT_IG_CHANGESP23 "Kennfeld Zeitvorhalt für Übergabe Rampenzeit auf Schaltdruck" MAP 0x251848 kf_si16_S6_S3 5080 UMR_MSEC__10_1_0_S6_S3 -2540 2540
 /begin AXIS_DESCR STD_AXIS zff_atsys._.iSignale._.obj.sig_n_t UMR_U_MIN_1_1_0_S6_S3 4 0 8160 DEPOSIT ABSOLUTE MONOTONY MON_INCREASE /end AXIS_DESCR
 /begin AXIS_DESCR STD_AXIS zff_atsys._.iSignale._.obj.sig_m_t UMR_NM__1_1_0_S6_S3 4 -400 1640 DEPOSIT ABSOLUTE MONOTONY MON_INCREASE /end AXIS_DESCR
/end CHARACTERISTIC
/begin CHARACTERISTIC KF_T2_DT_IG_CHANGESP23 "2. Kennfeld Zeitvorhalt für Übergabe Rampenzeit auf Schaltdruck" MAP 0x251880 kf_si16_S6_S3 5080 UMR_MSEC__10_1_0_S6_S3 -2540 2540
 /begin AXIS_DESCR STD_AXIS zff_atsys._.iSignale._.obj.sig_n_t UMR_U_MIN_1_1_0_S6_S3 4 0 8160 DEPOSIT ABSOLUTE MONOTONY MON_INCREASE /end AXIS_DESCR
 /begin AXIS_DESCR STD_AXIS zff_atsys._.iSignale._.obj.sig_m_t UMR_NM__1_1_0_S6_S3 4 -400 1640 DEPOSIT ABSOLUTE MONOTONY MON_INCREASE /end AXIS_DESCR
/end CHARACTERISTIC
/begin CHARACTERISTIC KF_TRAMTNTSP23 "Zeit 1. Rampe der zuschaltenden Kupplung" MAP 0x2518B8 kf_ui8_S6_S3 2540 UMR_MSEC__10_1_0_S6_S3 0 2540
 /begin AXIS_DESCR STD_AXIS zff_atsys._.iSignale._.obj.sig_m_t8 UMR_NM__8_1_M50_S6_S3 4 -400 1640 DEPOSIT ABSOLUTE MONOTONY MON_INCREASE /end AXIS_DESCR
 /begin AXIS_DESCR STD_AXIS zff_atsys._.iSignale._.obj.sig_n_t8 UMR_U_MIN_32_1_0_S6_S3 4 0 8160 DEPOSIT ABSOLUTE MONOTONY MON_INCREASE /end AXIS_DESCR
/end CHARACTERISTIC
/begin CHARACTERISTIC KF_PKZUSP23 "Schaltdruck zuschaltende Kupplung" MAP 0x2518D8 kf_si16_S6_S3 12.75 UMR_BAR__1_1000_0_S6_S3 0 12.75
 /begin AXIS_DESCR STD_AXIS iSasZentr.iSchaltend.n_tkf UMR_U_MIN_32_1_0_S6_S3 8 0 8160 DEPOSIT ABSOLUTE MONOTONY MON_INCREASE /end AXIS_DESCR
 /begin AXIS_DESCR STD_AXIS zff_atsys._.iSignale._.obj.sig_m_t UMR_NM__1_1_0_S6_S3 10 -400 1640 DEPOSIT ABSOLUTE MONOTONY MON_INCREASE /end AXIS_DESCR
/end CHARACTERISTIC
/begin CHARACTERISTIC F_PRASP23 "Druckfaktor waehrend Rampe auf Schaltdruck" VALUE 0x26E875 kw_ui8_S6_S3 1 UMR___1_100_0_S6_S3 0 1 /end CHARACTERISTIC
/begin CHARACTERISTIC F_TRASP23 "Zeitfaktor waehrend Rampe auf Schaltdruck" VALUE 0x26E876 kw_ui8_S6_S3 1 UMR___1_100_0_S6_S3 0 1 /end CHARACTERISTIC
/begin CHARACTERISTIC KF_PGOKZUMTNTSP23 "Schaltdruckgradient" MAP 0x2519A4 kf_si16_S6_S3 200 UMR_BAR_SEC_1_10_0_S6_S3 -100 100
 /begin AXIS_DESCR STD_AXIS zff_atsys._.iSignale._.obj.sig_m_t UMR_NM__1_1_0_S6_S3 6 -400 1640 DEPOSIT ABSOLUTE MONOTONY MON_INCREASE /end AXIS_DESCR
 /begin AXIS_DESCR STD_AXIS zff_atsys._.iSignale._.obj.sig_n_t UMR_U_MIN_1_1_0_S6_S3 4 0 8160 DEPOSIT ABSOLUTE MONOTONY MON_INCREASE /end AXIS_DESCR
/end CHARACTERISTIC
/begin CHARACTERISTIC KF_POKZUMTCGSP23 "Schaltdruckoffset" MAP 0x2519F0 kf_si16_S6_S3 12.75 UMR_BAR__1_1000_0_S6_S3 -6.4 6.35
 /begin AXIS_DESCR STD_AXIS zff_atsys._.iSignale._.obj.sig_m_t UMR_NM__1_1_0_S6_S3 8 -400 1640 DEPOSIT ABSOLUTE MONOTONY MON_INCREASE /end AXIS_DESCR
 /begin AXIS_DESCR STD_AXIS zff_atsys._.iSignale._.obj.sig_c_getr UMR_GRADC__1_1_M40_S6_S3 10 -40 150 DEPOSIT ABSOLUTE MONOTONY MON_INCREASE /end AXIS_DESCR
/end CHARACTERISTIC
/begin CHARACTERISTIC KL_TSYNMTRAKZUSP34 "Zeit vor sync. Ende Schaltdruck/Start 3. Rampe KZU" CURVE 0x251ABC kl_ui8_S6_S3 1280 UMR_MSEC__10_1_M128_S6_S3 -1280 0
 /begin AXIS_DESCR STD_AXIS zff_atsys._.iSignale._.obj.sig_m_t8 UMR_NM__8_1_M50_S6_S3 4 -400 1640 DEPOSIT ABSOLUTE MONOTONY MON_INCREASE /end AXIS_DESCR
/end CHARACTERISTIC
/begin CHARACTERISTIC KF_TFCGNTSP34 "Fuellzeit" MAP 0x251AC8 kf_ui8_S6_S3 2540 UMR_MSEC__10_1_0_S6_S3 0 2540
 /begin AXIS_DESCR STD_AXIS zff_atsys._.iSignale._.obj.sig_c_getr UMR_GRADC__1_1_M40_S6_S3 6 -40 150 DEPOSIT ABSOLUTE MONOTONY MON_INCREASE /end AXIS_DESCR
 /begin AXIS_DESCR STD_AXIS zff_atsys._.iSignale._.obj.sig_n_t8 UMR_U_MIN_32_1_0_S6_S3 3 0 8160 DEPOSIT ABSOLUTE MONOTONY MON_INCREASE /end AXIS_DESCR
/end CHARACTERISTIC
/begin CHARACTERISTIC T_VKZUSP34 "Verzoegerungszeit zuschaltende Kupplung nach Schaltbeginn" VALUE 0x26E877 kw_ui8_S6_S3 2540 UMR_MSEC__10_1_0_S6_S3 0 2540 /end CHARACTERISTIC
/begin CHARACTERISTIC KF_POFMTNSP34 "Kennfeld Fuelldruckoffset(n_t, m_t)" MAP 0x251AEC kf_si16_S6_S3 12.75 UMR_BAR__1_1000_0_S6_S3 -6.4 6.35
 /begin AXIS_DESCR STD_AXIS zff_atsys._.iSignale._.obj.sig_n_t UMR_U_MIN_1_1_0_S6_S3 4 0 8160 DEPOSIT ABSOLUTE MONOTONY MON_INCREASE /end AXIS_DESCR
 /begin AXIS_DESCR STD_AXIS zff_atsys._.iSignale._.obj.sig_m_t UMR_NM__1_1_0_S6_S3 6 -400 1640 DEPOSIT ABSOLUTE MONOTONY MON_INCREASE /end AXIS_DESCR
/end CHARACTERISTIC
/begin CHARACTERISTIC KF_T_DT_IG_CHANGESP34 "Kennfeld Zeitvorhalt für Übergabe Rampenzeit auf Schaltdruck" MAP 0x251B38 kf_si16_S6_S3 5080 UMR_MSEC__10_1_0_S6_S3 -2540 2540
 /begin AXIS_DESCR STD_AXIS zff_atsys._.iSignale._.obj.sig_n_t UMR_U_MIN_1_1_0_S6_S3 4 0 8160 DEPOSIT ABSOLUTE MONOTONY MON_INCREASE /end AXIS_DESCR
 /begin AXIS_DESCR STD_AXIS zff_atsys._.iSignale._.obj.sig_m_t UMR_NM__1_1_0_S6_S3 4 -400 1640 DEPOSIT ABSOLUTE MONOTONY MON_INCREASE /end AXIS_DESCR
/end CHARACTERISTIC
/begin CHARACTERISTIC KF_T2_DT_IG_CHANGESP34 "2. Kennfeld Zeitvorhalt für Übergabe Rampenzeit auf Schaltdruck" MAP 0x251B70 kf_si16_S6_S3 5080 UMR_MSEC__10_1_0_S6_S3 -2540 2540
 /begin AXIS_DESCR STD_AXIS zff_atsys._.iSignale._.obj.sig_n_t UMR_U_MIN_1_1_0_S6_S3 4 0 8160 DEPOSIT ABSOLUTE MONOTONY MON_INCREASE /end AXIS_DESCR
 /begin AXIS_DESCR STD_AXIS zff_atsys._.iSignale._.obj.sig_m_t UMR_NM__1_1_0_S6_S3 4 -400 1640 DEPOSIT ABSOLUTE MONOTONY MON_INCREASE /end AXIS_DESCR
/end CHARACTERISTIC
/begin CHARACTERISTIC KF_TRAMTNTSP34 "Zeit 1. Rampe der zuschaltenden Kupplung" MAP 0x251BA8 kf_ui8_S6_S3 2540 UMR_MSEC__10_1_0_S6_S3 0 2540
 /begin AXIS_DESCR STD_AXIS zff_atsys._.iSignale._.obj.sig_m_t8 UMR_NM__8_1_M50_S6_S3 4 -400 1640 DEPOSIT ABSOLUTE MONOTONY MON_INCREASE /end AXIS_DESCR
 /begin AXIS_DESCR STD_AXIS zff_atsys._.iSignale._.obj.sig_n_t8 UMR_U_MIN_32_1_0_S6_S3 4 0 8160 DEPOSIT ABSOLUTE MONOTONY MON_INCREASE /end AXIS_DESCR
/end CHARACTERISTIC
/begin CHARACTERISTIC KF_PKZUSP34 "Schaltdruck zuschaltende Kupplung" MAP 0x251BC8 kf_si16_S6_S3 12.75 UMR_BAR__1_1000_0_S6_S3 0 12.75
 /begin AXIS_DESCR STD_AXIS iSasZentr.iSchaltend.n_tkf UMR_U_MIN_32_1_0_S6_S3 8 0 8160 DEPOSIT ABSOLUTE MONOTONY MON_INCREASE /end AXIS_DESCR
 /begin AXIS_DESCR STD_AXIS zff_atsys._.iSignale._.obj.sig_m_t UMR_NM__1_1_0_S6_S3 10 -400 1640 DEPOSIT ABSOLUTE MONOTONY MON_INCREASE /end AXIS_DESCR
/end CHARACTERISTIC
/begin CHARACTERISTIC F_PRASP34 "Druckfaktor waehrend Rampe auf Schaltdruck" VALUE 0x26E878 kw_ui8_S6_S3 1 UMR___1_100_0_S6_S3 0 1 /end CHARACTERISTIC
/begin CHARACTERISTIC F_TRASP34 "Zeitfaktor waehrend Rampe auf Schaltdruck" VALUE 0x26E879 kw_ui8_S6_S3 1 UMR___1_100_0_S6_S3 0 1 /end CHARACTERISTIC
/begin CHARACTERISTIC KF_PGOKZUMTNTSP34 "Schaltdruckgradient" MAP 0x251C94 kf_si16_S6_S3 200 UMR_BAR_SEC_1_10_0_S6_S3 -100 100
 /begin AXIS_DESCR STD_AXIS zff_atsys._.iSignale._.obj.sig_m_t UMR_NM__1_1_0_S6_S3 6 -400 1640 DEPOSIT ABSOLUTE MONOTONY MON_INCREASE /end AXIS_DESCR
 /begin AXIS_DESCR STD_AXIS zff_atsys._.iSignale._.obj.sig_n_t UMR_U_MIN_1_1_0_S6_S3 4 0 8160 DEPOSIT ABSOLUTE MONOTONY MON_INCREASE /end AXIS_DESCR
/end CHARACTERISTIC
/begin CHARACTERISTIC KF_POKZUMTCGSP34 "Schaltdruckoffset" MAP 0x251CE0 kf_si16_S6_S3 12.75 UMR_BAR__1_1000_0_S6_S3 -6.4 6.35
 /begin AXIS_DESCR STD_AXIS zff_atsys._.iSignale._.obj.sig_m_t UMR_NM__1_1_0_S6_S3 8 -400 1640 DEPOSIT ABSOLUTE MONOTONY MON_INCREASE /end AXIS_DESCR
 /begin AXIS_DESCR STD_AXIS zff_atsys._.iSignale._.obj.sig_c_getr UMR_GRADC__1_1_M40_S6_S3 10 -40 150 DEPOSIT ABSOLUTE MONOTONY MON_INCREASE /end AXIS_DESCR
/end CHARACTERISTIC
/begin CHARACTERISTIC KL_TSYNMTRAKZUSP45 "Zeit vor sync. Ende Schaltdruck/Start 3. Rampe KZU" CURVE 0x251DAC kl_ui8_S6_S3 1280 UMR_MSEC__10_1_M128_S6_S3 -1280 0
 /begin AXIS_DESCR STD_AXIS zff_atsys._.iSignale._.obj.sig_m_t8 UMR_NM__8_1_M50_S6_S3 4 -400 1640 DEPOSIT ABSOLUTE MONOTONY MON_INCREASE /end AXIS_DESCR
/end CHARACTERISTIC
/begin CHARACTERISTIC KF_TFCGNTSP45 "Fuellzeit" MAP 0x251DB8 kf_ui8_S6_S3 2540 UMR_MSEC__10_1_0_S6_S3 0 2540
 /begin AXIS_DESCR STD_AXIS zff_atsys._.iSignale._.obj.sig_c_getr UMR_GRADC__1_1_M40_S6_S3 6 -40 150 DEPOSIT ABSOLUTE MONOTONY MON_INCREASE /end AXIS_DESCR
 /begin AXIS_DESCR STD_AXIS zff_atsys._.iSignale._.obj.sig_n_t8 UMR_U_MIN_32_1_0_S6_S3 3 0 8160 DEPOSIT ABSOLUTE MONOTONY MON_INCREASE /end AXIS_DESCR
/end CHARACTERISTIC
/begin CHARACTERISTIC T_VKZUSP45 "Verzoegerungszeit zuschaltende Kupplung nach Schaltbeginn" VALUE 0x26E87A kw_ui8_S6_S3 2540 UMR_MSEC__10_1_0_S6_S3 0 2540 /end CHARACTERISTIC
/begin CHARACTERISTIC KF_POFMTNSP45 "Kennfeld Fuelldruckoffset(n_t, m_t)" MAP 0x251DDC kf_si16_S6_S3 12.75 UMR_BAR__1_1000_0_S6_S3 -6.4 6.35
 /begin AXIS_DESCR STD_AXIS zff_atsys._.iSignale._.obj.sig_n_t UMR_U_MIN_1_1_0_S6_S3 4 0 8160 DEPOSIT ABSOLUTE MONOTONY MON_INCREASE /end AXIS_DESCR
 /begin AXIS_DESCR STD_AXIS zff_atsys._.iSignale._.obj.sig_m_t UMR_NM__1_1_0_S6_S3 6 -400 1640 DEPOSIT ABSOLUTE MONOTONY MON_INCREASE /end AXIS_DESCR
/end CHARACTERISTIC
/begin CHARACTERISTIC KF_T_DT_IG_CHANGESP45 "Kennfeld Zeitvorhalt für Übergabe Rampenzeit auf Schaltdruck" MAP 0x251E28 kf_si16_S6_S3 5080 UMR_MSEC__10_1_0_S6_S3 -2540 2540
 /begin AXIS_DESCR STD_AXIS zff_atsys._.iSignale._.obj.sig_n_t UMR_U_MIN_1_1_0_S6_S3 4 0 8160 DEPOSIT ABSOLUTE MONOTONY MON_INCREASE /end AXIS_DESCR
 /begin AXIS_DESCR STD_AXIS zff_atsys._.iSignale._.obj.sig_m_t UMR_NM__1_1_0_S6_S3 4 -400 1640 DEPOSIT ABSOLUTE MONOTONY MON_INCREASE /end AXIS_DESCR
/end CHARACTERISTIC
/begin CHARACTERISTIC KF_T2_DT_IG_CHANGESP45 "2. Kennfeld Zeitvorhalt für Übergabe Rampenzeit auf Schaltdruck" MAP 0x251E60 kf_si16_S6_S3 5080 UMR_MSEC__10_1_0_S6_S3 -2540 2540
 /begin AXIS_DESCR STD_AXIS zff_atsys._.iSignale._.obj.sig_n_t UMR_U_MIN_1_1_0_S6_S3 4 0 8160 DEPOSIT ABSOLUTE MONOTONY MON_INCREASE /end AXIS_DESCR
 /begin AXIS_DESCR STD_AXIS zff_atsys._.iSignale._.obj.sig_m_t UMR_NM__1_1_0_S6_S3 4 -400 1640 DEPOSIT ABSOLUTE MONOTONY MON_INCREASE /end AXIS_DESCR
/end CHARACTERISTIC
/begin CHARACTERISTIC KF_TRAMTNTSP45 "Zeit 1. Rampe der zuschaltenden Kupplung" MAP 0x251E98 kf_ui8_S6_S3 2540 UMR_MSEC__10_1_0_S6_S3 0 2540
 /begin AXIS_DESCR STD_AXIS zff_atsys._.iSignale._.obj.sig_m_t8 UMR_NM__8_1_M50_S6_S3 4 -400 1640 DEPOSIT ABSOLUTE MONOTONY MON_INCREASE /end AXIS_DESCR
 /begin AXIS_DESCR STD_AXIS zff_atsys._.iSignale._.obj.sig_n_t8 UMR_U_MIN_32_1_0_S6_S3 4 0 8160 DEPOSIT ABSOLUTE MONOTONY MON_INCREASE /end AXIS_DESCR
/end CHARACTERISTIC
/begin CHARACTERISTIC KF_PKZUSP45 "Schaltdruck zuschaltende Kupplung" MAP 0x251EB8 kf_si16_S6_S3 12.75 UMR_BAR__1_1000_0_S6_S3 0 12.75
 /begin AXIS_DESCR STD_AXIS iSasZentr.iSchaltend.n_tkf UMR_U_MIN_32_1_0_S6_S3 8 0 8160 DEPOSIT ABSOLUTE MONOTONY MON_INCREASE /end AXIS_DESCR
 /begin AXIS_DESCR STD_AXIS zff_atsys._.iSignale._.obj.sig_m_t UMR_NM__1_1_0_S6_S3 10 -400 1640 DEPOSIT ABSOLUTE MONOTONY MON_INCREASE /end AXIS_DESCR
/end CHARACTERISTIC
/begin CHARACTERISTIC F_PRASP45 "Druckfaktor waehrend Rampe auf Schaltdruck" VALUE 0x26E87B kw_ui8_S6_S3 1 UMR___1_100_0_S6_S3 0 1 /end CHARACTERISTIC
/begin CHARACTERISTIC F_TRASP45 "Zeitfaktor waehrend Rampe auf Schaltdruck" VALUE 0x26E87C kw_ui8_S6_S3 1 UMR___1_100_0_S6_S3 0 1 /end CHARACTERISTIC
/begin CHARACTERISTIC KF_PGOKZUMTNTSP45 "Schaltdruckgradient" MAP 0x251F84 kf_si16_S6_S3 200 UMR_BAR_SEC_1_10_0_S6_S3 -100 100
 /begin AXIS_DESCR STD_AXIS zff_atsys._.iSignale._.obj.sig_m_t UMR_NM__1_1_0_S6_S3 6 -400 1640 DEPOSIT ABSOLUTE MONOTONY MON_INCREASE /end AXIS_DESCR
 /begin AXIS_DESCR STD_AXIS zff_atsys._.iSignale._.obj.sig_n_t UMR_U_MIN_1_1_0_S6_S3 4 0 8160 DEPOSIT ABSOLUTE MONOTONY MON_INCREASE /end AXIS_DESCR
/end CHARACTERISTIC
/begin CHARACTERISTIC KF_POKZUMTCGSP45 "Schaltdruckoffset" MAP 0x251FD0 kf_si16_S6_S3 12.75 UMR_BAR__1_1000_0_S6_S3 -6.4 6.35
 /begin AXIS_DESCR STD_AXIS zff_atsys._.iSignale._.obj.sig_m_t UMR_NM__1_1_0_S6_S3 8 -400 1640 DEPOSIT ABSOLUTE MONOTONY MON_INCREASE /end AXIS_DESCR
 /begin AXIS_DESCR STD_AXIS zff_atsys._.iSignale._.obj.sig_c_getr UMR_GRADC__1_1_M40_S6_S3 10 -40 150 DEPOSIT ABSOLUTE MONOTONY MON_INCREASE /end AXIS_DESCR
/end CHARACTERISTIC
/begin CHARACTERISTIC KL_TSYNMTRAKZUSP56 "Zeit vor sync. Ende Schaltdruck/Start 3. Rampe KZU" CURVE 0x25209C kl_ui8_S6_S3 1280 UMR_MSEC__10_1_M128_S6_S3 -1280 0
 /begin AXIS_DESCR STD_AXIS zff_atsys._.iSignale._.obj.sig_m_t8 UMR_NM__8_1_M50_S6_S3 4 -400 1640 DEPOSIT ABSOLUTE MONOTONY MON_INCREASE /end AXIS_DESCR
/end CHARACTERISTIC
/begin CHARACTERISTIC KF_TFCGNTSP56 "Fuellzeit" MAP 0x2520A8 kf_ui8_S6_S3 2540 UMR_MSEC__10_1_0_S6_S3 0 2540
 /begin AXIS_DESCR STD_AXIS zff_atsys._.iSignale._.obj.sig_c_getr UMR_GRADC__1_1_M40_S6_S3 6 -40 150 DEPOSIT ABSOLUTE MONOTONY MON_INCREASE /end AXIS_DESCR
 /begin AXIS_DESCR STD_AXIS zff_atsys._.iSignale._.obj.sig_n_t8 UMR_U_MIN_32_1_0_S6_S3 3 0 8160 DEPOSIT ABSOLUTE MONOTONY MON_INCREASE /end AXIS_DESCR
/end CHARACTERISTIC
/begin CHARACTERISTIC T_VKZUSP56 "Verzoegerungszeit zuschaltende Kupplung nach Schaltbeginn" VALUE 0x26E87D kw_ui8_S6_S3 2540 UMR_MSEC__10_1_0_S6_S3 0 2540 /end CHARACTERISTIC
/begin CHARACTERISTIC KF_POFMTNSP56 "Kennfeld Fuelldruckoffset(n_t, m_t)" MAP 0x2520CC kf_si16_S6_S3 12.75 UMR_BAR__1_1000_0_S6_S3 -6.4 6.35
 /begin AXIS_DESCR STD_AXIS zff_atsys._.iSignale._.obj.sig_n_t UMR_U_MIN_1_1_0_S6_S3 4 0 8160 DEPOSIT ABSOLUTE MONOTONY MON_INCREASE /end AXIS_DESCR
 /begin AXIS_DESCR STD_AXIS zff_atsys._.iSignale._.obj.sig_m_t UMR_NM__1_1_0_S6_S3 6 -400 1640 DEPOSIT ABSOLUTE MONOTONY MON_INCREASE /end AXIS_DESCR
/end CHARACTERISTIC
/begin CHARACTERISTIC KF_T_DT_IG_CHANGESP56 "Kennfeld Zeitvorhalt für Übergabe Rampenzeit auf Schaltdruck" MAP 0x252118 kf_si16_S6_S3 5080 UMR_MSEC__10_1_0_S6_S3 -2540 2540
 /begin AXIS_DESCR STD_AXIS zff_atsys._.iSignale._.obj.sig_n_t UMR_U_MIN_1_1_0_S6_S3 4 0 8160 DEPOSIT ABSOLUTE MONOTONY MON_INCREASE /end AXIS_DESCR
 /begin AXIS_DESCR STD_AXIS zff_atsys._.iSignale._.obj.sig_m_t UMR_NM__1_1_0_S6_S3 4 -400 1640 DEPOSIT ABSOLUTE MONOTONY MON_INCREASE /end AXIS_DESCR
/end CHARACTERISTIC
/begin CHARACTERISTIC KF_T2_DT_IG_CHANGESP56 "2. Kennfeld Zeitvorhalt für Übergabe Rampenzeit auf Schaltdruck" MAP 0x252150 kf_si16_S6_S3 5080 UMR_MSEC__10_1_0_S6_S3 -2540 2540
 /begin AXIS_DESCR STD_AXIS zff_atsys._.iSignale._.obj.sig_n_t UMR_U_MIN_1_1_0_S6_S3 4 0 8160 DEPOSIT ABSOLUTE MONOTONY MON_INCREASE /end AXIS_DESCR
 /begin AXIS_DESCR STD_AXIS zff_atsys._.iSignale._.obj.sig_m_t UMR_NM__1_1_0_S6_S3 4 -400 1640 DEPOSIT ABSOLUTE MONOTONY MON_INCREASE /end AXIS_DESCR
/end CHARACTERISTIC
/begin CHARACTERISTIC KF_TRAMTNTSP56 "Zeit 1. Rampe der zuschaltenden Kupplung" MAP 0x252188 kf_ui8_S6_S3 2540 UMR_MSEC__10_1_0_S6_S3 0 2540
 /begin AXIS_DESCR STD_AXIS zff_atsys._.iSignale._.obj.sig_m_t8 UMR_NM__8_1_M50_S6_S3 4 -400 1640 DEPOSIT ABSOLUTE MONOTONY MON_INCREASE /end AXIS_DESCR
 /begin AXIS_DESCR STD_AXIS zff_atsys._.iSignale._.obj.sig_n_t8 UMR_U_MIN_32_1_0_S6_S3 4 0 8160 DEPOSIT ABSOLUTE MONOTONY MON_INCREASE /end AXIS_DESCR
/end CHARACTERISTIC
/begin CHARACTERISTIC KF_PKZUSP56 "Schaltdruck zuschaltende Kupplung" MAP 0x2521A8 kf_si16_S6_S3 12.75 UMR_BAR__1_1000_0_S6_S3 0 12.75
 /begin AXIS_DESCR STD_AXIS iSasZentr.iSchaltend.n_tkf UMR_U_MIN_32_1_0_S6_S3 8 0 8160 DEPOSIT ABSOLUTE MONOTONY MON_INCREASE /end AXIS_DESCR
 /begin AXIS_DESCR STD_AXIS zff_atsys._.iSignale._.obj.sig_m_t UMR_NM__1_1_0_S6_S3 10 -400 1640 DEPOSIT ABSOLUTE MONOTONY MON_INCREASE /end AXIS_DESCR
/end CHARACTERISTIC
/begin CHARACTERISTIC F_PRASP56 "Druckfaktor waehrend Rampe auf Schaltdruck" VALUE 0x26E87E kw_ui8_S6_S3 1 UMR___1_100_0_S6_S3 0 1 /end CHARACTERISTIC
/begin CHARACTERISTIC F_TRASP56 "Zeitfaktor waehrend Rampe auf Schaltdruck" VALUE 0x26E87F kw_ui8_S6_S3 1 UMR___1_100_0_S6_S3 0 1 /end CHARACTERISTIC
/begin CHARACTERISTIC KF_PGOKZUMTNTSP56 "Schaltdruckgradient" MAP 0x252274 kf_si16_S6_S3 200 UMR_BAR_SEC_1_10_0_S6_S3 -100 100
 /begin AXIS_DESCR STD_AXIS zff_atsys._.iSignale._.obj.sig_m_t UMR_NM__1_1_0_S6_S3 6 -400 1640 DEPOSIT ABSOLUTE MONOTONY MON_INCREASE /end AXIS_DESCR
 /begin AXIS_DESCR STD_AXIS zff_atsys._.iSignale._.obj.sig_n_t UMR_U_MIN_1_1_0_S6_S3 4 0 8160 DEPOSIT ABSOLUTE MONOTONY MON_INCREASE /end AXIS_DESCR
/end CHARACTERISTIC
/begin CHARACTERISTIC KF_POKZUMTCGSP56 "Schaltdruckoffset" MAP 0x2522C0 kf_si16_S6_S3 12.75 UMR_BAR__1_1000_0_S6_S3 -6.4 6.35
 /begin AXIS_DESCR STD_AXIS zff_atsys._.iSignale._.obj.sig_m_t UMR_NM__1_1_0_S6_S3 8 -400 1640 DEPOSIT ABSOLUTE MONOTONY MON_INCREASE /end AXIS_DESCR
 /begin AXIS_DESCR STD_AXIS zff_atsys._.iSignale._.obj.sig_c_getr UMR_GRADC__1_1_M40_S6_S3 10 -40 150 DEPOSIT ABSOLUTE MONOTONY MON_INCREASE /end AXIS_DESCR
/end CHARACTERISTIC
/begin CHARACTERISTIC KL_TSYNMTRAKZUSP67 "Zeit vor sync. Ende Schaltdruck/Start 3. Rampe KZU" CURVE 0x25238C kl_ui8_S6_S3 1280 UMR_MSEC__10_1_M128_S6_S3 -1280 0
 /begin AXIS_DESCR STD_AXIS zff_atsys._.iSignale._.obj.sig_m_t8 UMR_NM__8_1_M50_S6_S3 4 -400 1640 DEPOSIT ABSOLUTE MONOTONY MON_INCREASE /end AXIS_DESCR
/end CHARACTERISTIC
/begin CHARACTERISTIC KF_TFCGNTSP67 "Fuellzeit" MAP 0x252398 kf_ui8_S6_S3 2540 UMR_MSEC__10_1_0_S6_S3 0 2540
 /begin AXIS_DESCR STD_AXIS zff_atsys._.iSignale._.obj.sig_c_getr UMR_GRADC__1_1_M40_S6_S3 6 -40 150 DEPOSIT ABSOLUTE MONOTONY MON_INCREASE /end AXIS_DESCR
 /begin AXIS_DESCR STD_AXIS zff_atsys._.iSignale._.obj.sig_n_t8 UMR_U_MIN_32_1_0_S6_S3 3 0 8160 DEPOSIT ABSOLUTE MONOTONY MON_INCREASE /end AXIS_DESCR
/end CHARACTERISTIC
/begin CHARACTERISTIC T_VKZUSP67 "Verzoegerungszeit zuschaltende Kupplung nach Schaltbeginn" VALUE 0x26E880 kw_ui8_S6_S3 2540 UMR_MSEC__10_1_0_S6_S3 0 2540 /end CHARACTERISTIC
/begin CHARACTERISTIC KF_POFMTNSP67 "Kennfeld Fuelldruckoffset(n_t, m_t)" MAP 0x2523BC kf_si16_S6_S3 12.75 UMR_BAR__1_1000_0_S6_S3 -6.4 6.35
 /begin AXIS_DESCR STD_AXIS zff_atsys._.iSignale._.obj.sig_n_t UMR_U_MIN_1_1_0_S6_S3 4 0 8160 DEPOSIT ABSOLUTE MONOTONY MON_INCREASE /end AXIS_DESCR
 /begin AXIS_DESCR STD_AXIS zff_atsys._.iSignale._.obj.sig_m_t UMR_NM__1_1_0_S6_S3 6 -400 1640 DEPOSIT ABSOLUTE MONOTONY MON_INCREASE /end AXIS_DESCR
/end CHARACTERISTIC
/begin CHARACTERISTIC KF_T_DT_IG_CHANGESP67 "Kennfeld Zeitvorhalt für Übergabe Rampenzeit auf Schaltdruck" MAP 0x252408 kf_si16_S6_S3 5080 UMR_MSEC__10_1_0_S6_S3 -2540 2540
 /begin AXIS_DESCR STD_AXIS zff_atsys._.iSignale._.obj.sig_n_t UMR_U_MIN_1_1_0_S6_S3 4 0 8160 DEPOSIT ABSOLUTE MONOTONY MON_INCREASE /end AXIS_DESCR
 /begin AXIS_DESCR STD_AXIS zff_atsys._.iSignale._.obj.sig_m_t UMR_NM__1_1_0_S6_S3 4 -400 1640 DEPOSIT ABSOLUTE MONOTONY MON_INCREASE /end AXIS_DESCR
/end CHARACTERISTIC
/begin CHARACTERISTIC KF_T2_DT_IG_CHANGESP67 "2. Kennfeld Zeitvorhalt für Übergabe Rampenzeit auf Schaltdruck" MAP 0x252440 kf_si16_S6_S3 5080 UMR_MSEC__10_1_0_S6_S3 -2540 2540
 /begin AXIS_DESCR STD_AXIS zff_atsys._.iSignale._.obj.sig_n_t UMR_U_MIN_1_1_0_S6_S3 4 0 8160 DEPOSIT ABSOLUTE MONOTONY MON_INCREASE /end AXIS_DESCR
 /begin AXIS_DESCR STD_AXIS zff_atsys._.iSignale._.obj.sig_m_t UMR_NM__1_1_0_S6_S3 4 -400 1640 DEPOSIT ABSOLUTE MONOTONY MON_INCREASE /end AXIS_DESCR
/end CHARACTERISTIC
/begin CHARACTERISTIC KF_TRAMTNTSP67 "Zeit 1. Rampe der zuschaltenden Kupplung" MAP 0x252478 kf_ui8_S6_S3 2540 UMR_MSEC__10_1_0_S6_S3 0 2540
 /begin AXIS_DESCR STD_AXIS zff_atsys._.iSignale._.obj.sig_m_t8 UMR_NM__8_1_M50_S6_S3 4 -400 1640 DEPOSIT ABSOLUTE MONOTONY MON_INCREASE /end AXIS_DESCR
 /begin AXIS_DESCR STD_AXIS zff_atsys._.iSignale._.obj.sig_n_t8 UMR_U_MIN_32_1_0_S6_S3 4 0 8160 DEPOSIT ABSOLUTE MONOTONY MON_INCREASE /end AXIS_DESCR
/end CHARACTERISTIC
/begin CHARACTERISTIC KF_PKZUSP67 "Schaltdruck zuschaltende Kupplung" MAP 0x252498 kf_si16_S6_S3 12.75 UMR_BAR__1_1000_0_S6_S3 0 12.75
 /begin AXIS_DESCR STD_AXIS iSasZentr.iSchaltend.n_tkf UMR_U_MIN_32_1_0_S6_S3 8 0 8160 DEPOSIT ABSOLUTE MONOTONY MON_INCREASE /end AXIS_DESCR
 /begin AXIS_DESCR STD_AXIS zff_atsys._.iSignale._.obj.sig_m_t UMR_NM__1_1_0_S6_S3 10 -400 1640 DEPOSIT ABSOLUTE MONOTONY MON_INCREASE /end AXIS_DESCR
/end CHARACTERISTIC
/begin CHARACTERISTIC F_PRASP67 "Druckfaktor waehrend Rampe auf Schaltdruck" VALUE 0x26E881 kw_ui8_S6_S3 1 UMR___1_100_0_S6_S3 0 1 /end CHARACTERISTIC
/begin CHARACTERISTIC F_TRASP67 "Zeitfaktor waehrend Rampe auf Schaltdruck" VALUE 0x26E882 kw_ui8_S6_S3 1 UMR___1_100_0_S6_S3 0 1 /end CHARACTERISTIC
/begin CHARACTERISTIC KF_PGOKZUMTNTSP67 "Schaltdruckgradient" MAP 0x252564 kf_si16_S6_S3 200 UMR_BAR_SEC_1_10_0_S6_S3 -100 100
 /begin AXIS_DESCR STD_AXIS zff_atsys._.iSignale._.obj.sig_m_t UMR_NM__1_1_0_S6_S3 6 -400 1640 DEPOSIT ABSOLUTE MONOTONY MON_INCREASE /end AXIS_DESCR
 /begin AXIS_DESCR STD_AXIS zff_atsys._.iSignale._.obj.sig_n_t UMR_U_MIN_1_1_0_S6_S3 4 0 8160 DEPOSIT ABSOLUTE MONOTONY MON_INCREASE /end AXIS_DESCR
/end CHARACTERISTIC
/begin CHARACTERISTIC KF_POKZUMTCGSP67 "Schaltdruckoffset" MAP 0x2525B0 kf_si16_S6_S3 12.75 UMR_BAR__1_1000_0_S6_S3 -6.4 6.35
 /begin AXIS_DESCR STD_AXIS zff_atsys._.iSignale._.obj.sig_m_t UMR_NM__1_1_0_S6_S3 8 -400 1640 DEPOSIT ABSOLUTE MONOTONY MON_INCREASE /end AXIS_DESCR
 /begin AXIS_DESCR STD_AXIS zff_atsys._.iSignale._.obj.sig_c_getr UMR_GRADC__1_1_M40_S6_S3 10 -40 150 DEPOSIT ABSOLUTE MONOTONY MON_INCREASE /end AXIS_DESCR
/end CHARACTERISTIC
/begin CHARACTERISTIC KL_TSYNMTRAKZUSP78 "Zeit vor sync. Ende Schaltdruck/Start 3. Rampe KZU" CURVE 0x25267C kl_ui8_S6_S3 1280 UMR_MSEC__10_1_M128_S6_S3 -1280 0
 /begin AXIS_DESCR STD_AXIS zff_atsys._.iSignale._.obj.sig_m_t8 UMR_NM__8_1_M50_S6_S3 4 -400 1640 DEPOSIT ABSOLUTE MONOTONY MON_INCREASE /end AXIS_DESCR
/end CHARACTERISTIC
/begin CHARACTERISTIC KF_TFCGNTSP78 "Fuellzeit" MAP 0x252688 kf_ui8_S6_S3 2540 UMR_MSEC__10_1_0_S6_S3 0 2540
 /begin AXIS_DESCR STD_AXIS zff_atsys._.iSignale._.obj.sig_c_getr UMR_GRADC__1_1_M40_S6_S3 6 -40 150 DEPOSIT ABSOLUTE MONOTONY MON_INCREASE /end AXIS_DESCR
 /begin AXIS_DESCR STD_AXIS zff_atsys._.iSignale._.obj.sig_n_t8 UMR_U_MIN_32_1_0_S6_S3 3 0 8160 DEPOSIT ABSOLUTE MONOTONY MON_INCREASE /end AXIS_DESCR
/end CHARACTERISTIC
/begin CHARACTERISTIC T_VKZUSP78 "Verzoegerungszeit zuschaltende Kupplung nach Schaltbeginn" VALUE 0x26E883 kw_ui8_S6_S3 2540 UMR_MSEC__10_1_0_S6_S3 0 2540 /end CHARACTERISTIC
/begin CHARACTERISTIC KF_POFMTNSP78 "Kennfeld Fuelldruckoffset(n_t, m_t)" MAP 0x2526AC kf_si16_S6_S3 12.75 UMR_BAR__1_1000_0_S6_S3 -6.4 6.35
 /begin AXIS_DESCR STD_AXIS zff_atsys._.iSignale._.obj.sig_n_t UMR_U_MIN_1_1_0_S6_S3 4 0 8160 DEPOSIT ABSOLUTE MONOTONY MON_INCREASE /end AXIS_DESCR
 /begin AXIS_DESCR STD_AXIS zff_atsys._.iSignale._.obj.sig_m_t UMR_NM__1_1_0_S6_S3 6 -400 1640 DEPOSIT ABSOLUTE MONOTONY MON_INCREASE /end AXIS_DESCR
/end CHARACTERISTIC
/begin CHARACTERISTIC KF_T_DT_IG_CHANGESP78 "Kennfeld Zeitvorhalt für Übergabe Rampenzeit auf Schaltdruck" MAP 0x2526F8 kf_si16_S6_S3 5080 UMR_MSEC__10_1_0_S6_S3 -2540 2540
 /begin AXIS_DESCR STD_AXIS zff_atsys._.iSignale._.obj.sig_n_t UMR_U_MIN_1_1_0_S6_S3 4 0 8160 DEPOSIT ABSOLUTE MONOTONY MON_INCREASE /end AXIS_DESCR
 /begin AXIS_DESCR STD_AXIS zff_atsys._.iSignale._.obj.sig_m_t UMR_NM__1_1_0_S6_S3 4 -400 1640 DEPOSIT ABSOLUTE MONOTONY MON_INCREASE /end AXIS_DESCR
/end CHARACTERISTIC
/begin CHARACTERISTIC KF_T2_DT_IG_CHANGESP78 "2. Kennfeld Zeitvorhalt für Übergabe Rampenzeit auf Schaltdruck" MAP 0x252730 kf_si16_S6_S3 5080 UMR_MSEC__10_1_0_S6_S3 -2540 2540
 /begin AXIS_DESCR STD_AXIS zff_atsys._.iSignale._.obj.sig_n_t UMR_U_MIN_1_1_0_S6_S3 4 0 8160 DEPOSIT ABSOLUTE MONOTONY MON_INCREASE /end AXIS_DESCR
 /begin AXIS_DESCR STD_AXIS zff_atsys._.iSignale._.obj.sig_m_t UMR_NM__1_1_0_S6_S3 4 -400 1640 DEPOSIT ABSOLUTE MONOTONY MON_INCREASE /end AXIS_DESCR
/end CHARACTERISTIC
/begin CHARACTERISTIC KF_TRAMTNTSP78 "Zeit 1. Rampe der zuschaltenden Kupplung" MAP 0x252768 kf_ui8_S6_S3 2540 UMR_MSEC__10_1_0_S6_S3 0 2540
 /begin AXIS_DESCR STD_AXIS zff_atsys._.iSignale._.obj.sig_m_t8 UMR_NM__8_1_M50_S6_S3 4 -400 1640 DEPOSIT ABSOLUTE MONOTONY MON_INCREASE /end AXIS_DESCR
 /begin AXIS_DESCR STD_AXIS zff_atsys._.iSignale._.obj.sig_n_t8 UMR_U_MIN_32_1_0_S6_S3 4 0 8160 DEPOSIT ABSOLUTE MONOTONY MON_INCREASE /end AXIS_DESCR
/end CHARACTERISTIC
/begin CHARACTERISTIC KF_PKZUSP78 "Schaltdruck zuschaltende Kupplung" MAP 0x252788 kf_si16_S6_S3 12.75 UMR_BAR__1_1000_0_S6_S3 0 12.75
 /begin AXIS_DESCR STD_AXIS iSasZentr.iSchaltend.n_tkf UMR_U_MIN_32_1_0_S6_S3 8 0 8160 DEPOSIT ABSOLUTE MONOTONY MON_INCREASE /end AXIS_DESCR
 /begin AXIS_DESCR STD_AXIS zff_atsys._.iSignale._.obj.sig_m_t UMR_NM__1_1_0_S6_S3 10 -400 1640 DEPOSIT ABSOLUTE MONOTONY MON_INCREASE /end AXIS_DESCR
/end CHARACTERISTIC
/begin CHARACTERISTIC F_PRASP78 "Druckfaktor waehrend Rampe auf Schaltdruck" VALUE 0x26E884 kw_ui8_S6_S3 1 UMR___1_100_0_S6_S3 0 1 /end CHARACTERISTIC
/begin CHARACTERISTIC F_TRASP78 "Zeitfaktor waehrend Rampe auf Schaltdruck" VALUE 0x26E885 kw_ui8_S6_S3 1 UMR___1_100_0_S6_S3 0 1 /end CHARACTERISTIC
/begin CHARACTERISTIC KF_PGOKZUMTNTSP78 "Schaltdruckgradient" MAP 0x252854 kf_si16_S6_S3 200 UMR_BAR_SEC_1_10_0_S6_S3 -100 100
 /begin AXIS_DESCR STD_AXIS zff_atsys._.iSignale._.obj.sig_m_t UMR_NM__1_1_0_S6_S3 6 -400 1640 DEPOSIT ABSOLUTE MONOTONY MON_INCREASE /end AXIS_DESCR
 /begin AXIS_DESCR STD_AXIS zff_atsys._.iSignale._.obj.sig_n_t UMR_U_MIN_1_1_0_S6_S3 4 0 8160 DEPOSIT ABSOLUTE MONOTONY MON_INCREASE /end AXIS_DESCR
/end CHARACTERISTIC
/begin CHARACTERISTIC KF_POKZUMTCGSP78 "Schaltdruckoffset" MAP 0x2528A0 kf_si16_S6_S3 12.75 UMR_BAR__1_1000_0_S6_S3 -6.4 6.35
 /begin AXIS_DESCR STD_AXIS zff_atsys._.iSignale._.obj.sig_m_t UMR_NM__1_1_0_S6_S3 8 -400 1640 DEPOSIT ABSOLUTE MONOTONY MON_INCREASE /end AXIS_DESCR
 /begin AXIS_DESCR STD_AXIS zff_atsys._.iSignale._.obj.sig_c_getr UMR_GRADC__1_1_M40_S6_S3 10 -40 150 DEPOSIT ABSOLUTE MONOTONY MON_INCREASE /end AXIS_DESCR
/end CHARACTERISTIC
/begin CHARACTERISTIC KL_TSYNMTRAKZUSPORT12 "Zeit vor sync. Ende Schaltdruck/Start 3. Rampe KZU" CURVE 0x25296C kl_ui8_S6_S3 1280 UMR_MSEC__10_1_M128_S6_S3 -1280 0
 /begin AXIS_DESCR STD_AXIS zff_atsys._.iSignale._.obj.sig_m_t8 UMR_NM__8_1_M50_S6_S3 4 -400 1640 DEPOSIT ABSOLUTE MONOTONY MON_INCREASE /end AXIS_DESCR
/end CHARACTERISTIC
/begin CHARACTERISTIC KF_TFCGNTSPORT12 "Fuellzeit" MAP 0x252978 kf_ui8_S6_S3 2540 UMR_MSEC__10_1_0_S6_S3 0 2540
 /begin AXIS_DESCR STD_AXIS zff_atsys._.iSignale._.obj.sig_c_getr UMR_GRADC__1_1_M40_S6_S3 6 -40 150 DEPOSIT ABSOLUTE MONOTONY MON_INCREASE /end AXIS_DESCR
 /begin AXIS_DESCR STD_AXIS zff_atsys._.iSignale._.obj.sig_n_t8 UMR_U_MIN_32_1_0_S6_S3 3 0 8160 DEPOSIT ABSOLUTE MONOTONY MON_INCREASE /end AXIS_DESCR
/end CHARACTERISTIC
/begin CHARACTERISTIC T_VKZUSPORT12 "Verzoegerungszeit zuschaltende Kupplung nach Schaltbeginn" VALUE 0x26E886 kw_ui8_S6_S3 2540 UMR_MSEC__10_1_0_S6_S3 0 2540 /end CHARACTERISTIC
/begin CHARACTERISTIC KF_POFMTNSPORT12 "Kennfeld Fuelldruckoffset(n_t, m_t)" MAP 0x25299C kf_si16_S6_S3 12.75 UMR_BAR__1_1000_0_S6_S3 -6.4 6.35
 /begin AXIS_DESCR STD_AXIS zff_atsys._.iSignale._.obj.sig_n_t UMR_U_MIN_1_1_0_S6_S3 4 0 8160 DEPOSIT ABSOLUTE MONOTONY MON_INCREASE /end AXIS_DESCR
 /begin AXIS_DESCR STD_AXIS zff_atsys._.iSignale._.obj.sig_m_t UMR_NM__1_1_0_S6_S3 6 -400 1640 DEPOSIT ABSOLUTE MONOTONY MON_INCREASE /end AXIS_DESCR
/end CHARACTERISTIC
/begin CHARACTERISTIC KF_T_DT_IG_CHANGESPORT12 "Kennfeld Zeitvorhalt für Übergabe Rampenzeit auf Schaltdruck" MAP 0x2529E8 kf_si16_S6_S3 5080 UMR_MSEC__10_1_0_S6_S3 -2540 2540
 /begin AXIS_DESCR STD_AXIS zff_atsys._.iSignale._.obj.sig_n_t UMR_U_MIN_1_1_0_S6_S3 4 0 8160 DEPOSIT ABSOLUTE MONOTONY MON_INCREASE /end AXIS_DESCR
 /begin AXIS_DESCR STD_AXIS zff_atsys._.iSignale._.obj.sig_m_t UMR_NM__1_1_0_S6_S3 4 -400 1640 DEPOSIT ABSOLUTE MONOTONY MON_INCREASE /end AXIS_DESCR
/end CHARACTERISTIC
/begin CHARACTERISTIC KF_T2_DT_IG_CHANGESPORT12 "2. Kennfeld Zeitvorhalt für Übergabe Rampenzeit auf Schaltdruck" MAP 0x252A20 kf_si16_S6_S3 5080 UMR_MSEC__10_1_0_S6_S3 -2540 2540
 /begin AXIS_DESCR STD_AXIS zff_atsys._.iSignale._.obj.sig_n_t UMR_U_MIN_1_1_0_S6_S3 4 0 8160 DEPOSIT ABSOLUTE MONOTONY MON_INCREASE /end AXIS_DESCR
 /begin AXIS_DESCR STD_AXIS zff_atsys._.iSignale._.obj.sig_m_t UMR_NM__1_1_0_S6_S3 4 -400 1640 DEPOSIT ABSOLUTE MONOTONY MON_INCREASE /end AXIS_DESCR
/end CHARACTERISTIC
/begin CHARACTERISTIC KF_TRAMTNTSPORT12 "Zeit 1. Rampe der zuschaltenden Kupplung" MAP 0x252A58 kf_ui8_S6_S3 2540 UMR_MSEC__10_1_0_S6_S3 0 2540
 /begin AXIS_DESCR STD_AXIS zff_atsys._.iSignale._.obj.sig_m_t8 UMR_NM__8_1_M50_S6_S3 4 -400 1640 DEPOSIT ABSOLUTE MONOTONY MON_INCREASE /end AXIS_DESCR
 /begin AXIS_DESCR STD_AXIS zff_atsys._.iSignale._.obj.sig_n_t8 UMR_U_MIN_32_1_0_S6_S3 4 0 8160 DEPOSIT ABSOLUTE MONOTONY MON_INCREASE /end AXIS_DESCR
/end CHARACTERISTIC
/begin CHARACTERISTIC KF_PKZUSPORT12 "Schaltdruck zuschaltende Kupplung" MAP 0x252A78 kf_si16_S6_S3 12.75 UMR_BAR__1_1000_0_S6_S3 0 12.75
 /begin AXIS_DESCR STD_AXIS iSasZentr.iSchaltend.n_tkf UMR_U_MIN_32_1_0_S6_S3 8 0 8160 DEPOSIT ABSOLUTE MONOTONY MON_INCREASE /end AXIS_DESCR
 /begin AXIS_DESCR STD_AXIS zff_atsys._.iSignale._.obj.sig_m_t UMR_NM__1_1_0_S6_S3 10 -400 1640 DEPOSIT ABSOLUTE MONOTONY MON_INCREASE /end AXIS_DESCR
/end CHARACTERISTIC
/begin CHARACTERISTIC F_PRASPORT12 "Druckfaktor waehrend Rampe auf Schaltdruck" VALUE 0x26E887 kw_ui8_S6_S3 1 UMR___1_100_0_S6_S3 0 1 /end CHARACTERISTIC
/begin CHARACTERISTIC F_TRASPORT12 "Zeitfaktor waehrend Rampe auf Schaltdruck" VALUE 0x26E888 kw_ui8_S6_S3 1 UMR___1_100_0_S6_S3 0 1 /end CHARACTERISTIC
/begin CHARACTERISTIC KF_PGOKZUMTNTSPORT12 "Schaltdruckgradient" MAP 0x252B44 kf_si16_S6_S3 200 UMR_BAR_SEC_1_10_0_S6_S3 -100 100
 /begin AXIS_DESCR STD_AXIS zff_atsys._.iSignale._.obj.sig_m_t UMR_NM__1_1_0_S6_S3 6 -400 1640 DEPOSIT ABSOLUTE MONOTONY MON_INCREASE /end AXIS_DESCR
 /begin AXIS_DESCR STD_AXIS zff_atsys._.iSignale._.obj.sig_n_t UMR_U_MIN_1_1_0_S6_S3 4 0 8160 DEPOSIT ABSOLUTE MONOTONY MON_INCREASE /end AXIS_DESCR
/end CHARACTERISTIC
/begin CHARACTERISTIC KF_POKZUMTCGSPORT12 "Schaltdruckoffset" MAP 0x252B90 kf_si16_S6_S3 12.75 UMR_BAR__1_1000_0_S6_S3 -6.4 6.35
 /begin AXIS_DESCR STD_AXIS zff_atsys._.iSignale._.obj.sig_m_t UMR_NM__1_1_0_S6_S3 8 -400 1640 DEPOSIT ABSOLUTE MONOTONY MON_INCREASE /end AXIS_DESCR
 /begin AXIS_DESCR STD_AXIS zff_atsys._.iSignale._.obj.sig_c_getr UMR_GRADC__1_1_M40_S6_S3 10 -40 150 DEPOSIT ABSOLUTE MONOTONY MON_INCREASE /end AXIS_DESCR
/end CHARACTERISTIC
/begin CHARACTERISTIC KL_TSYNMTRAKZUSPORT23 "Zeit vor sync. Ende Schaltdruck/Start 3. Rampe KZU" CURVE 0x252C5C kl_ui8_S6_S3 1280 UMR_MSEC__10_1_M128_S6_S3 -1280 0
 /begin AXIS_DESCR STD_AXIS zff_atsys._.iSignale._.obj.sig_m_t8 UMR_NM__8_1_M50_S6_S3 4 -400 1640 DEPOSIT ABSOLUTE MONOTONY MON_INCREASE /end AXIS_DESCR
/end CHARACTERISTIC
/begin CHARACTERISTIC KF_TFCGNTSPORT23 "Fuellzeit" MAP 0x252C68 kf_ui8_S6_S3 2540 UMR_MSEC__10_1_0_S6_S3 0 2540
 /begin AXIS_DESCR STD_AXIS zff_atsys._.iSignale._.obj.sig_c_getr UMR_GRADC__1_1_M40_S6_S3 6 -40 150 DEPOSIT ABSOLUTE MONOTONY MON_INCREASE /end AXIS_DESCR
 /begin AXIS_DESCR STD_AXIS zff_atsys._.iSignale._.obj.sig_n_t8 UMR_U_MIN_32_1_0_S6_S3 3 0 8160 DEPOSIT ABSOLUTE MONOTONY MON_INCREASE /end AXIS_DESCR
/end CHARACTERISTIC
/begin CHARACTERISTIC T_VKZUSPORT23 "Verzoegerungszeit zuschaltende Kupplung nach Schaltbeginn" VALUE 0x26E889 kw_ui8_S6_S3 2540 UMR_MSEC__10_1_0_S6_S3 0 2540 /end CHARACTERISTIC
/begin CHARACTERISTIC KF_POFMTNSPORT23 "Kennfeld Fuelldruckoffset(n_t, m_t)" MAP 0x252C8C kf_si16_S6_S3 12.75 UMR_BAR__1_1000_0_S6_S3 -6.4 6.35
 /begin AXIS_DESCR STD_AXIS zff_atsys._.iSignale._.obj.sig_n_t UMR_U_MIN_1_1_0_S6_S3 4 0 8160 DEPOSIT ABSOLUTE MONOTONY MON_INCREASE /end AXIS_DESCR
 /begin AXIS_DESCR STD_AXIS zff_atsys._.iSignale._.obj.sig_m_t UMR_NM__1_1_0_S6_S3 6 -400 1640 DEPOSIT ABSOLUTE MONOTONY MON_INCREASE /end AXIS_DESCR
/end CHARACTERISTIC
/begin CHARACTERISTIC KF_T_DT_IG_CHANGESPORT23 "Kennfeld Zeitvorhalt für Übergabe Rampenzeit auf Schaltdruck" MAP 0x252CD8 kf_si16_S6_S3 5080 UMR_MSEC__10_1_0_S6_S3 -2540 2540
 /begin AXIS_DESCR STD_AXIS zff_atsys._.iSignale._.obj.sig_n_t UMR_U_MIN_1_1_0_S6_S3 4 0 8160 DEPOSIT ABSOLUTE MONOTONY MON_INCREASE /end AXIS_DESCR
 /begin AXIS_DESCR STD_AXIS zff_atsys._.iSignale._.obj.sig_m_t UMR_NM__1_1_0_S6_S3 4 -400 1640 DEPOSIT ABSOLUTE MONOTONY MON_INCREASE /end AXIS_DESCR
/end CHARACTERISTIC
/begin CHARACTERISTIC KF_T2_DT_IG_CHANGESPORT23 "2. Kennfeld Zeitvorhalt für Übergabe Rampenzeit auf Schaltdruck" MAP 0x252D10 kf_si16_S6_S3 5080 UMR_MSEC__10_1_0_S6_S3 -2540 2540
 /begin AXIS_DESCR STD_AXIS zff_atsys._.iSignale._.obj.sig_n_t UMR_U_MIN_1_1_0_S6_S3 4 0 8160 DEPOSIT ABSOLUTE MONOTONY MON_INCREASE /end AXIS_DESCR
 /begin AXIS_DESCR STD_AXIS zff_atsys._.iSignale._.obj.sig_m_t UMR_NM__1_1_0_S6_S3 4 -400 1640 DEPOSIT ABSOLUTE MONOTONY MON_INCREASE /end AXIS_DESCR
/end CHARACTERISTIC
/begin CHARACTERISTIC KF_TRAMTNTSPORT23 "Zeit 1. Rampe der zuschaltenden Kupplung" MAP 0x252D48 kf_ui8_S6_S3 2540 UMR_MSEC__10_1_0_S6_S3 0 2540
 /begin AXIS_DESCR STD_AXIS zff_atsys._.iSignale._.obj.sig_m_t8 UMR_NM__8_1_M50_S6_S3 4 -400 1640 DEPOSIT ABSOLUTE MONOTONY MON_INCREASE /end AXIS_DESCR
 /begin AXIS_DESCR STD_AXIS zff_atsys._.iSignale._.obj.sig_n_t8 UMR_U_MIN_32_1_0_S6_S3 4 0 8160 DEPOSIT ABSOLUTE MONOTONY MON_INCREASE /end AXIS_DESCR
/end CHARACTERISTIC
/begin CHARACTERISTIC KF_PKZUSPORT23 "Schaltdruck zuschaltende Kupplung" MAP 0x252D68 kf_si16_S6_S3 12.75 UMR_BAR__1_1000_0_S6_S3 0 12.75
 /begin AXIS_DESCR STD_AXIS iSasZentr.iSchaltend.n_tkf UMR_U_MIN_32_1_0_S6_S3 8 0 8160 DEPOSIT ABSOLUTE MONOTONY MON_INCREASE /end AXIS_DESCR
 /begin AXIS_DESCR STD_AXIS zff_atsys._.iSignale._.obj.sig_m_t UMR_NM__1_1_0_S6_S3 10 -400 1640 DEPOSIT ABSOLUTE MONOTONY MON_INCREASE /end AXIS_DESCR
/end CHARACTERISTIC
/begin CHARACTERISTIC F_PRASPORT23 "Druckfaktor waehrend Rampe auf Schaltdruck" VALUE 0x26E88A kw_ui8_S6_S3 1 UMR___1_100_0_S6_S3 0 1 /end CHARACTERISTIC
/begin CHARACTERISTIC F_TRASPORT23 "Zeitfaktor waehrend Rampe auf Schaltdruck" VALUE 0x26E88B kw_ui8_S6_S3 1 UMR___1_100_0_S6_S3 0 1 /end CHARACTERISTIC
/begin CHARACTERISTIC KF_PGOKZUMTNTSPORT23 "Schaltdruckgradient" MAP 0x252E34 kf_si16_S6_S3 200 UMR_BAR_SEC_1_10_0_S6_S3 -100 100
 /begin AXIS_DESCR STD_AXIS zff_atsys._.iSignale._.obj.sig_m_t UMR_NM__1_1_0_S6_S3 6 -400 1640 DEPOSIT ABSOLUTE MONOTONY MON_INCREASE /end AXIS_DESCR
 /begin AXIS_DESCR STD_AXIS zff_atsys._.iSignale._.obj.sig_n_t UMR_U_MIN_1_1_0_S6_S3 4 0 8160 DEPOSIT ABSOLUTE MONOTONY MON_INCREASE /end AXIS_DESCR
/end CHARACTERISTIC
/begin CHARACTERISTIC KF_POKZUMTCGSPORT23 "Schaltdruckoffset" MAP 0x252E80 kf_si16_S6_S3 12.75 UMR_BAR__1_1000_0_S6_S3 -6.4 6.35
 /begin AXIS_DESCR STD_AXIS zff_atsys._.iSignale._.obj.sig_m_t UMR_NM__1_1_0_S6_S3 8 -400 1640 DEPOSIT ABSOLUTE MONOTONY MON_INCREASE /end AXIS_DESCR
 /begin AXIS_DESCR STD_AXIS zff_atsys._.iSignale._.obj.sig_c_getr UMR_GRADC__1_1_M40_S6_S3 10 -40 150 DEPOSIT ABSOLUTE MONOTONY MON_INCREASE /end AXIS_DESCR
/end CHARACTERISTIC
/begin CHARACTERISTIC KL_TSYNMTRAKZUSPORT34 "Zeit vor sync. Ende Schaltdruck/Start 3. Rampe KZU" CURVE 0x252F4C kl_ui8_S6_S3 1280 UMR_MSEC__10_1_M128_S6_S3 -1280 0
 /begin AXIS_DESCR STD_AXIS zff_atsys._.iSignale._.obj.sig_m_t8 UMR_NM__8_1_M50_S6_S3 4 -400 1640 DEPOSIT ABSOLUTE MONOTONY MON_INCREASE /end AXIS_DESCR
/end CHARACTERISTIC
/begin CHARACTERISTIC KF_TFCGNTSPORT34 "Fuellzeit" MAP 0x252F58 kf_ui8_S6_S3 2540 UMR_MSEC__10_1_0_S6_S3 0 2540
 /begin AXIS_DESCR STD_AXIS zff_atsys._.iSignale._.obj.sig_c_getr UMR_GRADC__1_1_M40_S6_S3 6 -40 150 DEPOSIT ABSOLUTE MONOTONY MON_INCREASE /end AXIS_DESCR
 /begin AXIS_DESCR STD_AXIS zff_atsys._.iSignale._.obj.sig_n_t8 UMR_U_MIN_32_1_0_S6_S3 3 0 8160 DEPOSIT ABSOLUTE MONOTONY MON_INCREASE /end AXIS_DESCR
/end CHARACTERISTIC
/begin CHARACTERISTIC T_VKZUSPORT34 "Verzoegerungszeit zuschaltende Kupplung nach Schaltbeginn" VALUE 0x26E88C kw_ui8_S6_S3 2540 UMR_MSEC__10_1_0_S6_S3 0 2540 /end CHARACTERISTIC
/begin CHARACTERISTIC KF_POFMTNSPORT34 "Kennfeld Fuelldruckoffset(n_t, m_t)" MAP 0x252F7C kf_si16_S6_S3 12.75 UMR_BAR__1_1000_0_S6_S3 -6.4 6.35
 /begin AXIS_DESCR STD_AXIS zff_atsys._.iSignale._.obj.sig_n_t UMR_U_MIN_1_1_0_S6_S3 4 0 8160 DEPOSIT ABSOLUTE MONOTONY MON_INCREASE /end AXIS_DESCR
 /begin AXIS_DESCR STD_AXIS zff_atsys._.iSignale._.obj.sig_m_t UMR_NM__1_1_0_S6_S3 6 -400 1640 DEPOSIT ABSOLUTE MONOTONY MON_INCREASE /end AXIS_DESCR
/end CHARACTERISTIC
/begin CHARACTERISTIC KF_T_DT_IG_CHANGESPORT34 "Kennfeld Zeitvorhalt für Übergabe Rampenzeit auf Schaltdruck" MAP 0x252FC8 kf_si16_S6_S3 5080 UMR_MSEC__10_1_0_S6_S3 -2540 2540
 /begin AXIS_DESCR STD_AXIS zff_atsys._.iSignale._.obj.sig_n_t UMR_U_MIN_1_1_0_S6_S3 4 0 8160 DEPOSIT ABSOLUTE MONOTONY MON_INCREASE /end AXIS_DESCR
 /begin AXIS_DESCR STD_AXIS zff_atsys._.iSignale._.obj.sig_m_t UMR_NM__1_1_0_S6_S3 4 -400 1640 DEPOSIT ABSOLUTE MONOTONY MON_INCREASE /end AXIS_DESCR
/end CHARACTERISTIC
/begin CHARACTERISTIC KF_T2_DT_IG_CHANGESPORT34 "2. Kennfeld Zeitvorhalt für Übergabe Rampenzeit auf Schaltdruck" MAP 0x253000 kf_si16_S6_S3 5080 UMR_MSEC__10_1_0_S6_S3 -2540 2540
 /begin AXIS_DESCR STD_AXIS zff_atsys._.iSignale._.obj.sig_n_t UMR_U_MIN_1_1_0_S6_S3 4 0 8160 DEPOSIT ABSOLUTE MONOTONY MON_INCREASE /end AXIS_DESCR
 /begin AXIS_DESCR STD_AXIS zff_atsys._.iSignale._.obj.sig_m_t UMR_NM__1_1_0_S6_S3 4 -400 1640 DEPOSIT ABSOLUTE MONOTONY MON_INCREASE /end AXIS_DESCR
/end CHARACTERISTIC
/begin CHARACTERISTIC KF_TRAMTNTSPORT34 "Zeit 1. Rampe der zuschaltenden Kupplung" MAP 0x253038 kf_ui8_S6_S3 2540 UMR_MSEC__10_1_0_S6_S3 0 2540
 /begin AXIS_DESCR STD_AXIS zff_atsys._.iSignale._.obj.sig_m_t8 UMR_NM__8_1_M50_S6_S3 4 -400 1640 DEPOSIT ABSOLUTE MONOTONY MON_INCREASE /end AXIS_DESCR
 /begin AXIS_DESCR STD_AXIS zff_atsys._.iSignale._.obj.sig_n_t8 UMR_U_MIN_32_1_0_S6_S3 4 0 8160 DEPOSIT ABSOLUTE MONOTONY MON_INCREASE /end AXIS_DESCR
/end CHARACTERISTIC
/begin CHARACTERISTIC KF_PKZUSPORT34 "Schaltdruck zuschaltende Kupplung" MAP 0x253058 kf_si16_S6_S3 12.75 UMR_BAR__1_1000_0_S6_S3 0 12.75
 /begin AXIS_DESCR STD_AXIS iSasZentr.iSchaltend.n_tkf UMR_U_MIN_32_1_0_S6_S3 8 0 8160 DEPOSIT ABSOLUTE MONOTONY MON_INCREASE /end AXIS_DESCR
 /begin AXIS_DESCR STD_AXIS zff_atsys._.iSignale._.obj.sig_m_t UMR_NM__1_1_0_S6_S3 10 -400 1640 DEPOSIT ABSOLUTE MONOTONY MON_INCREASE /end AXIS_DESCR
/end CHARACTERISTIC
/begin CHARACTERISTIC F_PRASPORT34 "Druckfaktor waehrend Rampe auf Schaltdruck" VALUE 0x26E88D kw_ui8_S6_S3 1 UMR___1_100_0_S6_S3 0 1 /end CHARACTERISTIC
/begin CHARACTERISTIC F_TRASPORT34 "Zeitfaktor waehrend Rampe auf Schaltdruck" VALUE 0x26E88E kw_ui8_S6_S3 1 UMR___1_100_0_S6_S3 0 1 /end CHARACTERISTIC
/begin CHARACTERISTIC KF_PGOKZUMTNTSPORT34 "Schaltdruckgradient" MAP 0x253124 kf_si16_S6_S3 200 UMR_BAR_SEC_1_10_0_S6_S3 -100 100
 /begin AXIS_DESCR STD_AXIS zff_atsys._.iSignale._.obj.sig_m_t UMR_NM__1_1_0_S6_S3 6 -400 1640 DEPOSIT ABSOLUTE MONOTONY MON_INCREASE /end AXIS_DESCR
 /begin AXIS_DESCR STD_AXIS zff_atsys._.iSignale._.obj.sig_n_t UMR_U_MIN_1_1_0_S6_S3 4 0 8160 DEPOSIT ABSOLUTE MONOTONY MON_INCREASE /end AXIS_DESCR
/end CHARACTERISTIC
/begin CHARACTERISTIC KF_POKZUMTCGSPORT34 "Schaltdruckoffset" MAP 0x253170 kf_si16_S6_S3 12.75 UMR_BAR__1_1000_0_S6_S3 -6.4 6.35
 /begin AXIS_DESCR STD_AXIS zff_atsys._.iSignale._.obj.sig_m_t UMR_NM__1_1_0_S6_S3 8 -400 1640 DEPOSIT ABSOLUTE MONOTONY MON_INCREASE /end AXIS_DESCR
 /begin AXIS_DESCR STD_AXIS zff_atsys._.iSignale._.obj.sig_c_getr UMR_GRADC__1_1_M40_S6_S3 10 -40 150 DEPOSIT ABSOLUTE MONOTONY MON_INCREASE /end AXIS_DESCR
/end CHARACTERISTIC
/begin CHARACTERISTIC KL_TSYNMTRAKZUSPORT45 "Zeit vor sync. Ende Schaltdruck/Start 3. Rampe KZU" CURVE 0x25323C kl_ui8_S6_S3 1280 UMR_MSEC__10_1_M128_S6_S3 -1280 0
 /begin AXIS_DESCR STD_AXIS zff_atsys._.iSignale._.obj.sig_m_t8 UMR_NM__8_1_M50_S6_S3 4 -400 1640 DEPOSIT ABSOLUTE MONOTONY MON_INCREASE /end AXIS_DESCR
/end CHARACTERISTIC
/begin CHARACTERISTIC KF_TFCGNTSPORT45 "Fuellzeit" MAP 0x253248 kf_ui8_S6_S3 2540 UMR_MSEC__10_1_0_S6_S3 0 2540
 /begin AXIS_DESCR STD_AXIS zff_atsys._.iSignale._.obj.sig_c_getr UMR_GRADC__1_1_M40_S6_S3 6 -40 150 DEPOSIT ABSOLUTE MONOTONY MON_INCREASE /end AXIS_DESCR
 /begin AXIS_DESCR STD_AXIS zff_atsys._.iSignale._.obj.sig_n_t8 UMR_U_MIN_32_1_0_S6_S3 3 0 8160 DEPOSIT ABSOLUTE MONOTONY MON_INCREASE /end AXIS_DESCR
/end CHARACTERISTIC
/begin CHARACTERISTIC T_VKZUSPORT45 "Verzoegerungszeit zuschaltende Kupplung nach Schaltbeginn" VALUE 0x26E88F kw_ui8_S6_S3 2540 UMR_MSEC__10_1_0_S6_S3 0 2540 /end CHARACTERISTIC
/begin CHARACTERISTIC KF_POFMTNSPORT45 "Kennfeld Fuelldruckoffset(n_t, m_t)" MAP 0x25326C kf_si16_S6_S3 12.75 UMR_BAR__1_1000_0_S6_S3 -6.4 6.35
 /begin AXIS_DESCR STD_AXIS zff_atsys._.iSignale._.obj.sig_n_t UMR_U_MIN_1_1_0_S6_S3 4 0 8160 DEPOSIT ABSOLUTE MONOTONY MON_INCREASE /end AXIS_DESCR
 /begin AXIS_DESCR STD_AXIS zff_atsys._.iSignale._.obj.sig_m_t UMR_NM__1_1_0_S6_S3 6 -400 1640 DEPOSIT ABSOLUTE MONOTONY MON_INCREASE /end AXIS_DESCR
/end CHARACTERISTIC
/begin CHARACTERISTIC KF_T_DT_IG_CHANGESPORT45 "Kennfeld Zeitvorhalt für Übergabe Rampenzeit auf Schaltdruck" MAP 0x2532B8 kf_si16_S6_S3 5080 UMR_MSEC__10_1_0_S6_S3 -2540 2540
 /begin AXIS_DESCR STD_AXIS zff_atsys._.iSignale._.obj.sig_n_t UMR_U_MIN_1_1_0_S6_S3 4 0 8160 DEPOSIT ABSOLUTE MONOTONY MON_INCREASE /end AXIS_DESCR
 /begin AXIS_DESCR STD_AXIS zff_atsys._.iSignale._.obj.sig_m_t UMR_NM__1_1_0_S6_S3 4 -400 1640 DEPOSIT ABSOLUTE MONOTONY MON_INCREASE /end AXIS_DESCR
/end CHARACTERISTIC
/begin CHARACTERISTIC KF_T2_DT_IG_CHANGESPORT45 "2. Kennfeld Zeitvorhalt für Übergabe Rampenzeit auf Schaltdruck" MAP 0x2532F0 kf_si16_S6_S3 5080 UMR_MSEC__10_1_0_S6_S3 -2540 2540
 /begin AXIS_DESCR STD_AXIS zff_atsys._.iSignale._.obj.sig_n_t UMR_U_MIN_1_1_0_S6_S3 4 0 8160 DEPOSIT ABSOLUTE MONOTONY MON_INCREASE /end AXIS_DESCR
 /begin AXIS_DESCR STD_AXIS zff_atsys._.iSignale._.obj.sig_m_t UMR_NM__1_1_0_S6_S3 4 -400 1640 DEPOSIT ABSOLUTE MONOTONY MON_INCREASE /end AXIS_DESCR
/end CHARACTERISTIC
/begin CHARACTERISTIC KF_TRAMTNTSPORT45 "Zeit 1. Rampe der zuschaltenden Kupplung" MAP 0x253328 kf_ui8_S6_S3 2540 UMR_MSEC__10_1_0_S6_S3 0 2540
 /begin AXIS_DESCR STD_AXIS zff_atsys._.iSignale._.obj.sig_m_t8 UMR_NM__8_1_M50_S6_S3 4 -400 1640 DEPOSIT ABSOLUTE MONOTONY MON_INCREASE /end AXIS_DESCR
 /begin AXIS_DESCR STD_AXIS zff_atsys._.iSignale._.obj.sig_n_t8 UMR_U_MIN_32_1_0_S6_S3 4 0 8160 DEPOSIT ABSOLUTE MONOTONY MON_INCREASE /end AXIS_DESCR
/end CHARACTERISTIC
/begin CHARACTERISTIC KF_PKZUSPORT45 "Schaltdruck zuschaltende Kupplung" MAP 0x253348 kf_si16_S6_S3 12.75 UMR_BAR__1_1000_0_S6_S3 0 12.75
 /begin AXIS_DESCR STD_AXIS iSasZentr.iSchaltend.n_tkf UMR_U_MIN_32_1_0_S6_S3 8 0 8160 DEPOSIT ABSOLUTE MONOTONY MON_INCREASE /end AXIS_DESCR
 /begin AXIS_DESCR STD_AXIS zff_atsys._.iSignale._.obj.sig_m_t UMR_NM__1_1_0_S6_S3 10 -400 1640 DEPOSIT ABSOLUTE MONOTONY MON_INCREASE /end AXIS_DESCR
/end CHARACTERISTIC
/begin CHARACTERISTIC F_PRASPORT45 "Druckfaktor waehrend Rampe auf Schaltdruck" VALUE 0x26E890 kw_ui8_S6_S3 1 UMR___1_100_0_S6_S3 0 1 /end CHARACTERISTIC
/begin CHARACTERISTIC F_TRASPORT45 "Zeitfaktor waehrend Rampe auf Schaltdruck" VALUE 0x26E891 kw_ui8_S6_S3 1 UMR___1_100_0_S6_S3 0 1 /end CHARACTERISTIC
/begin CHARACTERISTIC KF_PGOKZUMTNTSPORT45 "Schaltdruckgradient" MAP 0x253414 kf_si16_S6_S3 200 UMR_BAR_SEC_1_10_0_S6_S3 -100 100
 /begin AXIS_DESCR STD_AXIS zff_atsys._.iSignale._.obj.sig_m_t UMR_NM__1_1_0_S6_S3 6 -400 1640 DEPOSIT ABSOLUTE MONOTONY MON_INCREASE /end AXIS_DESCR
 /begin AXIS_DESCR STD_AXIS zff_atsys._.iSignale._.obj.sig_n_t UMR_U_MIN_1_1_0_S6_S3 4 0 8160 DEPOSIT ABSOLUTE MONOTONY MON_INCREASE /end AXIS_DESCR
/end CHARACTERISTIC
/begin CHARACTERISTIC KF_POKZUMTCGSPORT45 "Schaltdruckoffset" MAP 0x253460 kf_si16_S6_S3 12.75 UMR_BAR__1_1000_0_S6_S3 -6.4 6.35
 /begin AXIS_DESCR STD_AXIS zff_atsys._.iSignale._.obj.sig_m_t UMR_NM__1_1_0_S6_S3 8 -400 1640 DEPOSIT ABSOLUTE MONOTONY MON_INCREASE /end AXIS_DESCR
 /begin AXIS_DESCR STD_AXIS zff_atsys._.iSignale._.obj.sig_c_getr UMR_GRADC__1_1_M40_S6_S3 10 -40 150 DEPOSIT ABSOLUTE MONOTONY MON_INCREASE /end AXIS_DESCR
/end CHARACTERISTIC
/begin CHARACTERISTIC KL_TSYNMTRAKZUSPORT56 "Zeit vor sync. Ende Schaltdruck/Start 3. Rampe KZU" CURVE 0x25352C kl_ui8_S6_S3 1280 UMR_MSEC__10_1_M128_S6_S3 -1280 0
 /begin AXIS_DESCR STD_AXIS zff_atsys._.iSignale._.obj.sig_m_t8 UMR_NM__8_1_M50_S6_S3 4 -400 1640 DEPOSIT ABSOLUTE MONOTONY MON_INCREASE /end AXIS_DESCR
/end CHARACTERISTIC
/begin CHARACTERISTIC KF_TFCGNTSPORT56 "Fuellzeit" MAP 0x253538 kf_ui8_S6_S3 2540 UMR_MSEC__10_1_0_S6_S3 0 2540
 /begin AXIS_DESCR STD_AXIS zff_atsys._.iSignale._.obj.sig_c_getr UMR_GRADC__1_1_M40_S6_S3 6 -40 150 DEPOSIT ABSOLUTE MONOTONY MON_INCREASE /end AXIS_DESCR
 /begin AXIS_DESCR STD_AXIS zff_atsys._.iSignale._.obj.sig_n_t8 UMR_U_MIN_32_1_0_S6_S3 3 0 8160 DEPOSIT ABSOLUTE MONOTONY MON_INCREASE /end AXIS_DESCR
/end CHARACTERISTIC
/begin CHARACTERISTIC T_VKZUSPORT56 "Verzoegerungszeit zuschaltende Kupplung nach Schaltbeginn" VALUE 0x26E892 kw_ui8_S6_S3 2540 UMR_MSEC__10_1_0_S6_S3 0 2540 /end CHARACTERISTIC
/begin CHARACTERISTIC KF_POFMTNSPORT56 "Kennfeld Fuelldruckoffset(n_t, m_t)" MAP 0x25355C kf_si16_S6_S3 12.75 UMR_BAR__1_1000_0_S6_S3 -6.4 6.35
 /begin AXIS_DESCR STD_AXIS zff_atsys._.iSignale._.obj.sig_n_t UMR_U_MIN_1_1_0_S6_S3 4 0 8160 DEPOSIT ABSOLUTE MONOTONY MON_INCREASE /end AXIS_DESCR
 /begin AXIS_DESCR STD_AXIS zff_atsys._.iSignale._.obj.sig_m_t UMR_NM__1_1_0_S6_S3 6 -400 1640 DEPOSIT ABSOLUTE MONOTONY MON_INCREASE /end AXIS_DESCR
/end CHARACTERISTIC
/begin CHARACTERISTIC KF_T_DT_IG_CHANGESPORT56 "Kennfeld Zeitvorhalt für Übergabe Rampenzeit auf Schaltdruck" MAP 0x2535A8 kf_si16_S6_S3 5080 UMR_MSEC__10_1_0_S6_S3 -2540 2540
 /begin AXIS_DESCR STD_AXIS zff_atsys._.iSignale._.obj.sig_n_t UMR_U_MIN_1_1_0_S6_S3 4 0 8160 DEPOSIT ABSOLUTE MONOTONY MON_INCREASE /end AXIS_DESCR
 /begin AXIS_DESCR STD_AXIS zff_atsys._.iSignale._.obj.sig_m_t UMR_NM__1_1_0_S6_S3 4 -400 1640 DEPOSIT ABSOLUTE MONOTONY MON_INCREASE /end AXIS_DESCR
/end CHARACTERISTIC
/begin CHARACTERISTIC KF_T2_DT_IG_CHANGESPORT56 "2. Kennfeld Zeitvorhalt für Übergabe Rampenzeit auf Schaltdruck" MAP 0x2535E0 kf_si16_S6_S3 5080 UMR_MSEC__10_1_0_S6_S3 -2540 2540
 /begin AXIS_DESCR STD_AXIS zff_atsys._.iSignale._.obj.sig_n_t UMR_U_MIN_1_1_0_S6_S3 4 0 8160 DEPOSIT ABSOLUTE MONOTONY MON_INCREASE /end AXIS_DESCR
 /begin AXIS_DESCR STD_AXIS zff_atsys._.iSignale._.obj.sig_m_t UMR_NM__1_1_0_S6_S3 4 -400 1640 DEPOSIT ABSOLUTE MONOTONY MON_INCREASE /end AXIS_DESCR
/end CHARACTERISTIC
/begin CHARACTERISTIC KF_TRAMTNTSPORT56 "Zeit 1. Rampe der zuschaltenden Kupplung" MAP 0x253618 kf_ui8_S6_S3 2540 UMR_MSEC__10_1_0_S6_S3 0 2540
 /begin AXIS_DESCR STD_AXIS zff_atsys._.iSignale._.obj.sig_m_t8 UMR_NM__8_1_M50_S6_S3 4 -400 1640 DEPOSIT ABSOLUTE MONOTONY MON_INCREASE /end AXIS_DESCR
 /begin AXIS_DESCR STD_AXIS zff_atsys._.iSignale._.obj.sig_n_t8 UMR_U_MIN_32_1_0_S6_S3 4 0 8160 DEPOSIT ABSOLUTE MONOTONY MON_INCREASE /end AXIS_DESCR
/end CHARACTERISTIC
/begin CHARACTERISTIC KF_PKZUSPORT56 "Schaltdruck zuschaltende Kupplung" MAP 0x253638 kf_si16_S6_S3 12.75 UMR_BAR__1_1000_0_S6_S3 0 12.75
 /begin AXIS_DESCR STD_AXIS iSasZentr.iSchaltend.n_tkf UMR_U_MIN_32_1_0_S6_S3 8 0 8160 DEPOSIT ABSOLUTE MONOTONY MON_INCREASE /end AXIS_DESCR
 /begin AXIS_DESCR STD_AXIS zff_atsys._.iSignale._.obj.sig_m_t UMR_NM__1_1_0_S6_S3 10 -400 1640 DEPOSIT ABSOLUTE MONOTONY MON_INCREASE /end AXIS_DESCR
/end CHARACTERISTIC
/begin CHARACTERISTIC F_PRASPORT56 "Druckfaktor waehrend Rampe auf Schaltdruck" VALUE 0x26E893 kw_ui8_S6_S3 1 UMR___1_100_0_S6_S3 0 1 /end CHARACTERISTIC
/begin CHARACTERISTIC F_TRASPORT56 "Zeitfaktor waehrend Rampe auf Schaltdruck" VALUE 0x26E894 kw_ui8_S6_S3 1 UMR___1_100_0_S6_S3 0 1 /end CHARACTERISTIC
/begin CHARACTERISTIC KF_PGOKZUMTNTSPORT56 "Schaltdruckgradient" MAP 0x253704 kf_si16_S6_S3 200 UMR_BAR_SEC_1_10_0_S6_S3 -100 100
 /begin AXIS_DESCR STD_AXIS zff_atsys._.iSignale._.obj.sig_m_t UMR_NM__1_1_0_S6_S3 6 -400 1640 DEPOSIT ABSOLUTE MONOTONY MON_INCREASE /end AXIS_DESCR
 /begin AXIS_DESCR STD_AXIS zff_atsys._.iSignale._.obj.sig_n_t UMR_U_MIN_1_1_0_S6_S3 4 0 8160 DEPOSIT ABSOLUTE MONOTONY MON_INCREASE /end AXIS_DESCR
/end CHARACTERISTIC
/begin CHARACTERISTIC KF_POKZUMTCGSPORT56 "Schaltdruckoffset" MAP 0x253750 kf_si16_S6_S3 12.75 UMR_BAR__1_1000_0_S6_S3 -6.4 6.35
 /begin AXIS_DESCR STD_AXIS zff_atsys._.iSignale._.obj.sig_m_t UMR_NM__1_1_0_S6_S3 8 -400 1640 DEPOSIT ABSOLUTE MONOTONY MON_INCREASE /end AXIS_DESCR
 /begin AXIS_DESCR STD_AXIS zff_atsys._.iSignale._.obj.sig_c_getr UMR_GRADC__1_1_M40_S6_S3 10 -40 150 DEPOSIT ABSOLUTE MONOTONY MON_INCREASE /end AXIS_DESCR
/end CHARACTERISTIC
/begin CHARACTERISTIC KL_TSYNMTRAKZUSPORT67 "Zeit vor sync. Ende Schaltdruck/Start 3. Rampe KZU" CURVE 0x25381C kl_ui8_S6_S3 1280 UMR_MSEC__10_1_M128_S6_S3 -1280 0
 /begin AXIS_DESCR STD_AXIS zff_atsys._.iSignale._.obj.sig_m_t8 UMR_NM__8_1_M50_S6_S3 4 -400 1640 DEPOSIT ABSOLUTE MONOTONY MON_INCREASE /end AXIS_DESCR
/end CHARACTERISTIC
/begin CHARACTERISTIC KF_TFCGNTSPORT67 "Fuellzeit" MAP 0x253828 kf_ui8_S6_S3 2540 UMR_MSEC__10_1_0_S6_S3 0 2540
 /begin AXIS_DESCR STD_AXIS zff_atsys._.iSignale._.obj.sig_c_getr UMR_GRADC__1_1_M40_S6_S3 6 -40 150 DEPOSIT ABSOLUTE MONOTONY MON_INCREASE /end AXIS_DESCR
 /begin AXIS_DESCR STD_AXIS zff_atsys._.iSignale._.obj.sig_n_t8 UMR_U_MIN_32_1_0_S6_S3 3 0 8160 DEPOSIT ABSOLUTE MONOTONY MON_INCREASE /end AXIS_DESCR
/end CHARACTERISTIC
/begin CHARACTERISTIC T_VKZUSPORT67 "Verzoegerungszeit zuschaltende Kupplung nach Schaltbeginn" VALUE 0x26E895 kw_ui8_S6_S3 2540 UMR_MSEC__10_1_0_S6_S3 0 2540 /end CHARACTERISTIC
/begin CHARACTERISTIC KF_POFMTNSPORT67 "Kennfeld Fuelldruckoffset(n_t, m_t)" MAP 0x25384C kf_si16_S6_S3 12.75 UMR_BAR__1_1000_0_S6_S3 -6.4 6.35
 /begin AXIS_DESCR STD_AXIS zff_atsys._.iSignale._.obj.sig_n_t UMR_U_MIN_1_1_0_S6_S3 4 0 8160 DEPOSIT ABSOLUTE MONOTONY MON_INCREASE /end AXIS_DESCR
 /begin AXIS_DESCR STD_AXIS zff_atsys._.iSignale._.obj.sig_m_t UMR_NM__1_1_0_S6_S3 6 -400 1640 DEPOSIT ABSOLUTE MONOTONY MON_INCREASE /end AXIS_DESCR
/end CHARACTERISTIC
/begin CHARACTERISTIC KF_T_DT_IG_CHANGESPORT67 "Kennfeld Zeitvorhalt für Übergabe Rampenzeit auf Schaltdruck" MAP 0x253898 kf_si16_S6_S3 5080 UMR_MSEC__10_1_0_S6_S3 -2540 2540
 /begin AXIS_DESCR STD_AXIS zff_atsys._.iSignale._.obj.sig_n_t UMR_U_MIN_1_1_0_S6_S3 4 0 8160 DEPOSIT ABSOLUTE MONOTONY MON_INCREASE /end AXIS_DESCR
 /begin AXIS_DESCR STD_AXIS zff_atsys._.iSignale._.obj.sig_m_t UMR_NM__1_1_0_S6_S3 4 -400 1640 DEPOSIT ABSOLUTE MONOTONY MON_INCREASE /end AXIS_DESCR
/end CHARACTERISTIC
/begin CHARACTERISTIC KF_T2_DT_IG_CHANGESPORT67 "2. Kennfeld Zeitvorhalt für Übergabe Rampenzeit auf Schaltdruck" MAP 0x2538D0 kf_si16_S6_S3 5080 UMR_MSEC__10_1_0_S6_S3 -2540 2540
 /begin AXIS_DESCR STD_AXIS zff_atsys._.iSignale._.obj.sig_n_t UMR_U_MIN_1_1_0_S6_S3 4 0 8160 DEPOSIT ABSOLUTE MONOTONY MON_INCREASE /end AXIS_DESCR
 /begin AXIS_DESCR STD_AXIS zff_atsys._.iSignale._.obj.sig_m_t UMR_NM__1_1_0_S6_S3 4 -400 1640 DEPOSIT ABSOLUTE MONOTONY MON_INCREASE /end AXIS_DESCR
/end CHARACTERISTIC
/begin CHARACTERISTIC KF_TRAMTNTSPORT67 "Zeit 1. Rampe der zuschaltenden Kupplung" MAP 0x253908 kf_ui8_S6_S3 2540 UMR_MSEC__10_1_0_S6_S3 0 2540
 /begin AXIS_DESCR STD_AXIS zff_atsys._.iSignale._.obj.sig_m_t8 UMR_NM__8_1_M50_S6_S3 4 -400 1640 DEPOSIT ABSOLUTE MONOTONY MON_INCREASE /end AXIS_DESCR
 /begin AXIS_DESCR STD_AXIS zff_atsys._.iSignale._.obj.sig_n_t8 UMR_U_MIN_32_1_0_S6_S3 4 0 8160 DEPOSIT ABSOLUTE MONOTONY MON_INCREASE /end AXIS_DESCR
/end CHARACTERISTIC
/begin CHARACTERISTIC KF_PKZUSPORT67 "Schaltdruck zuschaltende Kupplung" MAP 0x253928 kf_si16_S6_S3 12.75 UMR_BAR__1_1000_0_S6_S3 0 12.75
 /begin AXIS_DESCR STD_AXIS iSasZentr.iSchaltend.n_tkf UMR_U_MIN_32_1_0_S6_S3 8 0 8160 DEPOSIT ABSOLUTE MONOTONY MON_INCREASE /end AXIS_DESCR
 /begin AXIS_DESCR STD_AXIS zff_atsys._.iSignale._.obj.sig_m_t UMR_NM__1_1_0_S6_S3 10 -400 1640 DEPOSIT ABSOLUTE MONOTONY MON_INCREASE /end AXIS_DESCR
/end CHARACTERISTIC
/begin CHARACTERISTIC F_PRASPORT67 "Druckfaktor waehrend Rampe auf Schaltdruck" VALUE 0x26E896 kw_ui8_S6_S3 1 UMR___1_100_0_S6_S3 0 1 /end CHARACTERISTIC
/begin CHARACTERISTIC F_TRASPORT67 "Zeitfaktor waehrend Rampe auf Schaltdruck" VALUE 0x26E897 kw_ui8_S6_S3 1 UMR___1_100_0_S6_S3 0 1 /end CHARACTERISTIC
/begin CHARACTERISTIC KF_PGOKZUMTNTSPORT67 "Schaltdruckgradient" MAP 0x2539F4 kf_si16_S6_S3 200 UMR_BAR_SEC_1_10_0_S6_S3 -100 100
 /begin AXIS_DESCR STD_AXIS zff_atsys._.iSignale._.obj.sig_m_t UMR_NM__1_1_0_S6_S3 6 -400 1640 DEPOSIT ABSOLUTE MONOTONY MON_INCREASE /end AXIS_DESCR
 /begin AXIS_DESCR STD_AXIS zff_atsys._.iSignale._.obj.sig_n_t UMR_U_MIN_1_1_0_S6_S3 4 0 8160 DEPOSIT ABSOLUTE MONOTONY MON_INCREASE /end AXIS_DESCR
/end CHARACTERISTIC
/begin CHARACTERISTIC KF_POKZUMTCGSPORT67 "Schaltdruckoffset" MAP 0x253A40 kf_si16_S6_S3 12.75 UMR_BAR__1_1000_0_S6_S3 -6.4 6.35
 /begin AXIS_DESCR STD_AXIS zff_atsys._.iSignale._.obj.sig_m_t UMR_NM__1_1_0_S6_S3 8 -400 1640 DEPOSIT ABSOLUTE MONOTONY MON_INCREASE /end AXIS_DESCR
 /begin AXIS_DESCR STD_AXIS zff_atsys._.iSignale._.obj.sig_c_getr UMR_GRADC__1_1_M40_S6_S3 10 -40 150 DEPOSIT ABSOLUTE MONOTONY MON_INCREASE /end AXIS_DESCR
/end CHARACTERISTIC
/begin CHARACTERISTIC KL_TSYNMTRAKZUSPORT78 "Zeit vor sync. Ende Schaltdruck/Start 3. Rampe KZU" CURVE 0x253B0C kl_ui8_S6_S3 1280 UMR_MSEC__10_1_M128_S6_S3 -1280 0
 /begin AXIS_DESCR STD_AXIS zff_atsys._.iSignale._.obj.sig_m_t8 UMR_NM__8_1_M50_S6_S3 4 -400 1640 DEPOSIT ABSOLUTE MONOTONY MON_INCREASE /end AXIS_DESCR
/end CHARACTERISTIC
/begin CHARACTERISTIC KF_TFCGNTSPORT78 "Fuellzeit" MAP 0x253B18 kf_ui8_S6_S3 2540 UMR_MSEC__10_1_0_S6_S3 0 2540
 /begin AXIS_DESCR STD_AXIS zff_atsys._.iSignale._.obj.sig_c_getr UMR_GRADC__1_1_M40_S6_S3 6 -40 150 DEPOSIT ABSOLUTE MONOTONY MON_INCREASE /end AXIS_DESCR
 /begin AXIS_DESCR STD_AXIS zff_atsys._.iSignale._.obj.sig_n_t8 UMR_U_MIN_32_1_0_S6_S3 3 0 8160 DEPOSIT ABSOLUTE MONOTONY MON_INCREASE /end AXIS_DESCR
/end CHARACTERISTIC
/begin CHARACTERISTIC T_VKZUSPORT78 "Verzoegerungszeit zuschaltende Kupplung nach Schaltbeginn" VALUE 0x26E898 kw_ui8_S6_S3 2540 UMR_MSEC__10_1_0_S6_S3 0 2540 /end CHARACTERISTIC
/begin CHARACTERISTIC KF_POFMTNSPORT78 "Kennfeld Fuelldruckoffset(n_t, m_t)" MAP 0x253B3C kf_si16_S6_S3 12.75 UMR_BAR__1_1000_0_S6_S3 -6.4 6.35
 /begin AXIS_DESCR STD_AXIS zff_atsys._.iSignale._.obj.sig_n_t UMR_U_MIN_1_1_0_S6_S3 4 0 8160 DEPOSIT ABSOLUTE MONOTONY MON_INCREASE /end AXIS_DESCR
 /begin AXIS_DESCR STD_AXIS zff_atsys._.iSignale._.obj.sig_m_t UMR_NM__1_1_0_S6_S3 6 -400 1640 DEPOSIT ABSOLUTE MONOTONY MON_INCREASE /end AXIS_DESCR
/end CHARACTERISTIC
/begin CHARACTERISTIC KF_T_DT_IG_CHANGESPORT78 "Kennfeld Zeitvorhalt für Übergabe Rampenzeit auf Schaltdruck" MAP 0x253B88 kf_si16_S6_S3 5080 UMR_MSEC__10_1_0_S6_S3 -2540 2540
 /begin AXIS_DESCR STD_AXIS zff_atsys._.iSignale._.obj.sig_n_t UMR_U_MIN_1_1_0_S6_S3 4 0 8160 DEPOSIT ABSOLUTE MONOTONY MON_INCREASE /end AXIS_DESCR
 /begin AXIS_DESCR STD_AXIS zff_atsys._.iSignale._.obj.sig_m_t UMR_NM__1_1_0_S6_S3 4 -400 1640 DEPOSIT ABSOLUTE MONOTONY MON_INCREASE /end AXIS_DESCR
/end CHARACTERISTIC
/begin CHARACTERISTIC KF_T2_DT_IG_CHANGESPORT78 "2. Kennfeld Zeitvorhalt für Übergabe Rampenzeit auf Schaltdruck" MAP 0x253BC0 kf_si16_S6_S3 5080 UMR_MSEC__10_1_0_S6_S3 -2540 2540
 /begin AXIS_DESCR STD_AXIS zff_atsys._.iSignale._.obj.sig_n_t UMR_U_MIN_1_1_0_S6_S3 4 0 8160 DEPOSIT ABSOLUTE MONOTONY MON_INCREASE /end AXIS_DESCR
 /begin AXIS_DESCR STD_AXIS zff_atsys._.iSignale._.obj.sig_m_t UMR_NM__1_1_0_S6_S3 4 -400 1640 DEPOSIT ABSOLUTE MONOTONY MON_INCREASE /end AXIS_DESCR
/end CHARACTERISTIC
/begin CHARACTERISTIC KF_TRAMTNTSPORT78 "Zeit 1. Rampe der zuschaltenden Kupplung" MAP 0x253BF8 kf_ui8_S6_S3 2540 UMR_MSEC__10_1_0_S6_S3 0 2540
 /begin AXIS_DESCR STD_AXIS zff_atsys._.iSignale._.obj.sig_m_t8 UMR_NM__8_1_M50_S6_S3 4 -400 1640 DEPOSIT ABSOLUTE MONOTONY MON_INCREASE /end AXIS_DESCR
 /begin AXIS_DESCR STD_AXIS zff_atsys._.iSignale._.obj.sig_n_t8 UMR_U_MIN_32_1_0_S6_S3 4 0 8160 DEPOSIT ABSOLUTE MONOTONY MON_INCREASE /end AXIS_DESCR
/end CHARACTERISTIC
/begin CHARACTERISTIC KF_PKZUSPORT78 "Schaltdruck zuschaltende Kupplung" MAP 0x253C18 kf_si16_S6_S3 12.75 UMR_BAR__1_1000_0_S6_S3 0 12.75
 /begin AXIS_DESCR STD_AXIS iSasZentr.iSchaltend.n_tkf UMR_U_MIN_32_1_0_S6_S3 8 0 8160 DEPOSIT ABSOLUTE MONOTONY MON_INCREASE /end AXIS_DESCR
 /begin AXIS_DESCR STD_AXIS zff_atsys._.iSignale._.obj.sig_m_t UMR_NM__1_1_0_S6_S3 10 -400 1640 DEPOSIT ABSOLUTE MONOTONY MON_INCREASE /end AXIS_DESCR
/end CHARACTERISTIC
/begin CHARACTERISTIC F_PRASPORT78 "Druckfaktor waehrend Rampe auf Schaltdruck" VALUE 0x26E899 kw_ui8_S6_S3 1 UMR___1_100_0_S6_S3 0 1 /end CHARACTERISTIC
/begin CHARACTERISTIC F_TRASPORT78 "Zeitfaktor waehrend Rampe auf Schaltdruck" VALUE 0x26E89A kw_ui8_S6_S3 1 UMR___1_100_0_S6_S3 0 1 /end CHARACTERISTIC
/begin CHARACTERISTIC KF_PGOKZUMTNTSPORT78 "Schaltdruckgradient" MAP 0x253CE4 kf_si16_S6_S3 200 UMR_BAR_SEC_1_10_0_S6_S3 -100 100
 /begin AXIS_DESCR STD_AXIS zff_atsys._.iSignale._.obj.sig_m_t UMR_NM__1_1_0_S6_S3 6 -400 1640 DEPOSIT ABSOLUTE MONOTONY MON_INCREASE /end AXIS_DESCR
 /begin AXIS_DESCR STD_AXIS zff_atsys._.iSignale._.obj.sig_n_t UMR_U_MIN_1_1_0_S6_S3 4 0 8160 DEPOSIT ABSOLUTE MONOTONY MON_INCREASE /end AXIS_DESCR
/end CHARACTERISTIC
/begin CHARACTERISTIC KF_POKZUMTCGSPORT78 "Schaltdruckoffset" MAP 0x253D30 kf_si16_S6_S3 12.75 UMR_BAR__1_1000_0_S6_S3 -6.4 6.35
 /begin AXIS_DESCR STD_AXIS zff_atsys._.iSignale._.obj.sig_m_t UMR_NM__1_1_0_S6_S3 8 -400 1640 DEPOSIT ABSOLUTE MONOTONY MON_INCREASE /end AXIS_DESCR
 /begin AXIS_DESCR STD_AXIS zff_atsys._.iSignale._.obj.sig_c_getr UMR_GRADC__1_1_M40_S6_S3 10 -40 150 DEPOSIT ABSOLUTE MONOTONY MON_INCREASE /end AXIS_DESCR
/end CHARACTERISTIC
/begin CHARACTERISTIC KL_TSYNMTRAKZU13 "Zeit vor sync. Ende Schaltdruck/Start 3. Rampe KZU" CURVE 0x253DFC kl_ui8_S6_S3 1280 UMR_MSEC__10_1_M128_S6_S3 -1280 0
 /begin AXIS_DESCR STD_AXIS zff_atsys._.iSignale._.obj.sig_m_t8 UMR_NM__8_1_M50_S6_S3 4 -400 1640 DEPOSIT ABSOLUTE MONOTONY MON_INCREASE /end AXIS_DESCR
/end CHARACTERISTIC
/begin CHARACTERISTIC KF_TFCGNT13 "Fuellzeit" MAP 0x253E08 kf_ui8_S6_S3 2540 UMR_MSEC__10_1_0_S6_S3 0 2540
 /begin AXIS_DESCR STD_AXIS zff_atsys._.iSignale._.obj.sig_c_getr UMR_GRADC__1_1_M40_S6_S3 6 -40 150 DEPOSIT ABSOLUTE MONOTONY MON_INCREASE /end AXIS_DESCR
 /begin AXIS_DESCR STD_AXIS zff_atsys._.iSignale._.obj.sig_n_t8 UMR_U_MIN_32_1_0_S6_S3 3 0 8160 DEPOSIT ABSOLUTE MONOTONY MON_INCREASE /end AXIS_DESCR
/end CHARACTERISTIC
/begin CHARACTERISTIC T_VKZU13 "Verzoegerungszeit zuschaltende Kupplung nach Schaltbeginn" VALUE 0x26E89B kw_ui8_S6_S3 2540 UMR_MSEC__10_1_0_S6_S3 0 2540 /end CHARACTERISTIC
/begin CHARACTERISTIC KF_POFMTN13 "Kennfeld Fuelldruckoffset(n_t, m_t)" MAP 0x253E2C kf_si16_S6_S3 12.75 UMR_BAR__1_1000_0_S6_S3 -6.4 6.35
 /begin AXIS_DESCR STD_AXIS zff_atsys._.iSignale._.obj.sig_n_t UMR_U_MIN_1_1_0_S6_S3 4 0 8160 DEPOSIT ABSOLUTE MONOTONY MON_INCREASE /end AXIS_DESCR
 /begin AXIS_DESCR STD_AXIS zff_atsys._.iSignale._.obj.sig_m_t UMR_NM__1_1_0_S6_S3 6 -400 1640 DEPOSIT ABSOLUTE MONOTONY MON_INCREASE /end AXIS_DESCR
/end CHARACTERISTIC
/begin CHARACTERISTIC KF_T_DT_IG_CHANGE13 "Kennfeld Zeitvorhalt für Übergabe Rampenzeit auf Schaltdruck" MAP 0x253E78 kf_si16_S6_S3 5080 UMR_MSEC__10_1_0_S6_S3 -2540 2540
 /begin AXIS_DESCR STD_AXIS zff_atsys._.iSignale._.obj.sig_n_t UMR_U_MIN_1_1_0_S6_S3 4 0 8160 DEPOSIT ABSOLUTE MONOTONY MON_INCREASE /end AXIS_DESCR
 /begin AXIS_DESCR STD_AXIS zff_atsys._.iSignale._.obj.sig_m_t UMR_NM__1_1_0_S6_S3 4 -400 1640 DEPOSIT ABSOLUTE MONOTONY MON_INCREASE /end AXIS_DESCR
/end CHARACTERISTIC
/begin CHARACTERISTIC KF_T2_DT_IG_CHANGE13 "2. Kennfeld Zeitvorhalt für Übergabe Rampenzeit auf Schaltdruck" MAP 0x253EB0 kf_si16_S6_S3 5080 UMR_MSEC__10_1_0_S6_S3 -2540 2540
 /begin AXIS_DESCR STD_AXIS zff_atsys._.iSignale._.obj.sig_n_t UMR_U_MIN_1_1_0_S6_S3 4 0 8160 DEPOSIT ABSOLUTE MONOTONY MON_INCREASE /end AXIS_DESCR
 /begin AXIS_DESCR STD_AXIS zff_atsys._.iSignale._.obj.sig_m_t UMR_NM__1_1_0_S6_S3 4 -400 1640 DEPOSIT ABSOLUTE MONOTONY MON_INCREASE /end AXIS_DESCR
/end CHARACTERISTIC
/begin CHARACTERISTIC KF_TRAMTNT13 "Zeit 1. Rampe der zuschaltenden Kupplung" MAP 0x253EE8 kf_ui8_S6_S3 2540 UMR_MSEC__10_1_0_S6_S3 0 2540
 /begin AXIS_DESCR STD_AXIS zff_atsys._.iSignale._.obj.sig_m_t8 UMR_NM__8_1_M50_S6_S3 4 -400 1640 DEPOSIT ABSOLUTE MONOTONY MON_INCREASE /end AXIS_DESCR
 /begin AXIS_DESCR STD_AXIS zff_atsys._.iSignale._.obj.sig_n_t8 UMR_U_MIN_32_1_0_S6_S3 4 0 8160 DEPOSIT ABSOLUTE MONOTONY MON_INCREASE /end AXIS_DESCR
/end CHARACTERISTIC
/begin CHARACTERISTIC KF_PKZU13 "Schaltdruck zuschaltende Kupplung" MAP 0x253F08 kf_si16_S6_S3 12.75 UMR_BAR__1_1000_0_S6_S3 0 12.75
 /begin AXIS_DESCR STD_AXIS iSasZentr.iSchaltend.n_tkf UMR_U_MIN_32_1_0_S6_S3 8 0 8160 DEPOSIT ABSOLUTE MONOTONY MON_INCREASE /end AXIS_DESCR
 /begin AXIS_DESCR STD_AXIS zff_atsys._.iSignale._.obj.sig_m_t UMR_NM__1_1_0_S6_S3 10 -400 1640 DEPOSIT ABSOLUTE MONOTONY MON_INCREASE /end AXIS_DESCR
/end CHARACTERISTIC
/begin CHARACTERISTIC F_PRA13 "Druckfaktor waehrend Rampe auf Schaltdruck" VALUE 0x26E89C kw_ui8_S6_S3 1 UMR___1_100_0_S6_S3 0 1 /end CHARACTERISTIC
/begin CHARACTERISTIC F_TRA13 "Zeitfaktor waehrend Rampe auf Schaltdruck" VALUE 0x26E89D kw_ui8_S6_S3 1 UMR___1_100_0_S6_S3 0 1 /end CHARACTERISTIC
/begin CHARACTERISTIC KF_PGOKZUMTNT13 "Schaltdruckgradient" MAP 0x253FD4 kf_si16_S6_S3 200 UMR_BAR_SEC_1_10_0_S6_S3 -100 100
 /begin AXIS_DESCR STD_AXIS zff_atsys._.iSignale._.obj.sig_m_t UMR_NM__1_1_0_S6_S3 6 -400 1640 DEPOSIT ABSOLUTE MONOTONY MON_INCREASE /end AXIS_DESCR
 /begin AXIS_DESCR STD_AXIS zff_atsys._.iSignale._.obj.sig_n_t UMR_U_MIN_1_1_0_S6_S3 4 0 8160 DEPOSIT ABSOLUTE MONOTONY MON_INCREASE /end AXIS_DESCR
/end CHARACTERISTIC
/begin CHARACTERISTIC KF_POKZUMTCG13 "Schaltdruckoffset" MAP 0x254020 kf_si16_S6_S3 12.75 UMR_BAR__1_1000_0_S6_S3 -6.4 6.35
 /begin AXIS_DESCR STD_AXIS zff_atsys._.iSignale._.obj.sig_m_t UMR_NM__1_1_0_S6_S3 8 -400 1640 DEPOSIT ABSOLUTE MONOTONY MON_INCREASE /end AXIS_DESCR
 /begin AXIS_DESCR STD_AXIS zff_atsys._.iSignale._.obj.sig_c_getr UMR_GRADC__1_1_M40_S6_S3 10 -40 150 DEPOSIT ABSOLUTE MONOTONY MON_INCREASE /end AXIS_DESCR
/end CHARACTERISTIC
/begin CHARACTERISTIC KF_POKZUMTCG13_EL "Schaltdruckoffset" MAP 0x2540EC kf_si16_S6_S3 12.75 UMR_BAR__1_1000_0_S6_S3 -6.4 6.35
 /begin AXIS_DESCR STD_AXIS zff_atsys._.iSignale._.obj.sig_m_t UMR_NM__1_1_0_S6_S3 8 -400 1640 DEPOSIT ABSOLUTE MONOTONY MON_INCREASE /end AXIS_DESCR
 /begin AXIS_DESCR STD_AXIS zff_atsys._.iSignale._.obj.sig_c_getr UMR_GRADC__1_1_M40_S6_S3 10 -40 150 DEPOSIT ABSOLUTE MONOTONY MON_INCREASE /end AXIS_DESCR
/end CHARACTERISTIC
/begin CHARACTERISTIC KL_TSYNMTRAKZU24 "Zeit vor sync. Ende Schaltdruck/Start 3. Rampe KZU" CURVE 0x2541B8 kl_ui8_S6_S3 1280 UMR_MSEC__10_1_M128_S6_S3 -1280 0
 /begin AXIS_DESCR STD_AXIS zff_atsys._.iSignale._.obj.sig_m_t8 UMR_NM__8_1_M50_S6_S3 4 -400 1640 DEPOSIT ABSOLUTE MONOTONY MON_INCREASE /end AXIS_DESCR
/end CHARACTERISTIC
/begin CHARACTERISTIC KF_TFCGNT24 "Fuellzeit" MAP 0x2541C4 kf_ui8_S6_S3 2540 UMR_MSEC__10_1_0_S6_S3 0 2540
 /begin AXIS_DESCR STD_AXIS zff_atsys._.iSignale._.obj.sig_c_getr UMR_GRADC__1_1_M40_S6_S3 6 -40 150 DEPOSIT ABSOLUTE MONOTONY MON_INCREASE /end AXIS_DESCR
 /begin AXIS_DESCR STD_AXIS zff_atsys._.iSignale._.obj.sig_n_t8 UMR_U_MIN_32_1_0_S6_S3 3 0 8160 DEPOSIT ABSOLUTE MONOTONY MON_INCREASE /end AXIS_DESCR
/end CHARACTERISTIC
/begin CHARACTERISTIC T_VKZU24 "Verzoegerungszeit zuschaltende Kupplung nach Schaltbeginn" VALUE 0x26E89E kw_ui8_S6_S3 2540 UMR_MSEC__10_1_0_S6_S3 0 2540 /end CHARACTERISTIC
/begin CHARACTERISTIC KF_POFMTN24 "Kennfeld Fuelldruckoffset(n_t, m_t)" MAP 0x2541E8 kf_si16_S6_S3 12.75 UMR_BAR__1_1000_0_S6_S3 -6.4 6.35
 /begin AXIS_DESCR STD_AXIS zff_atsys._.iSignale._.obj.sig_n_t UMR_U_MIN_1_1_0_S6_S3 4 0 8160 DEPOSIT ABSOLUTE MONOTONY MON_INCREASE /end AXIS_DESCR
 /begin AXIS_DESCR STD_AXIS zff_atsys._.iSignale._.obj.sig_m_t UMR_NM__1_1_0_S6_S3 6 -400 1640 DEPOSIT ABSOLUTE MONOTONY MON_INCREASE /end AXIS_DESCR
/end CHARACTERISTIC
/begin CHARACTERISTIC KF_T_DT_IG_CHANGE24 "Kennfeld Zeitvorhalt für Übergabe Rampenzeit auf Schaltdruck" MAP 0x254234 kf_si16_S6_S3 5080 UMR_MSEC__10_1_0_S6_S3 -2540 2540
 /begin AXIS_DESCR STD_AXIS zff_atsys._.iSignale._.obj.sig_n_t UMR_U_MIN_1_1_0_S6_S3 4 0 8160 DEPOSIT ABSOLUTE MONOTONY MON_INCREASE /end AXIS_DESCR
 /begin AXIS_DESCR STD_AXIS zff_atsys._.iSignale._.obj.sig_m_t UMR_NM__1_1_0_S6_S3 4 -400 1640 DEPOSIT ABSOLUTE MONOTONY MON_INCREASE /end AXIS_DESCR
/end CHARACTERISTIC
/begin CHARACTERISTIC KF_T2_DT_IG_CHANGE24 "2. Kennfeld Zeitvorhalt für Übergabe Rampenzeit auf Schaltdruck" MAP 0x25426C kf_si16_S6_S3 5080 UMR_MSEC__10_1_0_S6_S3 -2540 2540
 /begin AXIS_DESCR STD_AXIS zff_atsys._.iSignale._.obj.sig_n_t UMR_U_MIN_1_1_0_S6_S3 4 0 8160 DEPOSIT ABSOLUTE MONOTONY MON_INCREASE /end AXIS_DESCR
 /begin AXIS_DESCR STD_AXIS zff_atsys._.iSignale._.obj.sig_m_t UMR_NM__1_1_0_S6_S3 4 -400 1640 DEPOSIT ABSOLUTE MONOTONY MON_INCREASE /end AXIS_DESCR
/end CHARACTERISTIC
/begin CHARACTERISTIC KF_TRAMTNT24 "Zeit 1. Rampe der zuschaltenden Kupplung" MAP 0x2542A4 kf_ui8_S6_S3 2540 UMR_MSEC__10_1_0_S6_S3 0 2540
 /begin AXIS_DESCR STD_AXIS zff_atsys._.iSignale._.obj.sig_m_t8 UMR_NM__8_1_M50_S6_S3 4 -400 1640 DEPOSIT ABSOLUTE MONOTONY MON_INCREASE /end AXIS_DESCR
 /begin AXIS_DESCR STD_AXIS zff_atsys._.iSignale._.obj.sig_n_t8 UMR_U_MIN_32_1_0_S6_S3 4 0 8160 DEPOSIT ABSOLUTE MONOTONY MON_INCREASE /end AXIS_DESCR
/end CHARACTERISTIC
/begin CHARACTERISTIC KF_PKZU24 "Schaltdruck zuschaltende Kupplung" MAP 0x2542C4 kf_si16_S6_S3 12.75 UMR_BAR__1_1000_0_S6_S3 0 12.75
 /begin AXIS_DESCR STD_AXIS iSasZentr.iSchaltend.n_tkf UMR_U_MIN_32_1_0_S6_S3 8 0 8160 DEPOSIT ABSOLUTE MONOTONY MON_INCREASE /end AXIS_DESCR
 /begin AXIS_DESCR STD_AXIS zff_atsys._.iSignale._.obj.sig_m_t UMR_NM__1_1_0_S6_S3 10 -400 1640 DEPOSIT ABSOLUTE MONOTONY MON_INCREASE /end AXIS_DESCR
/end CHARACTERISTIC
/begin CHARACTERISTIC F_PRA24 "Druckfaktor waehrend Rampe auf Schaltdruck" VALUE 0x26E89F kw_ui8_S6_S3 1 UMR___1_100_0_S6_S3 0 1 /end CHARACTERISTIC
/begin CHARACTERISTIC F_TRA24 "Zeitfaktor waehrend Rampe auf Schaltdruck" VALUE 0x26E8A0 kw_ui8_S6_S3 1 UMR___1_100_0_S6_S3 0 1 /end CHARACTERISTIC
/begin CHARACTERISTIC KF_PGOKZUMTNT24 "Schaltdruckgradient" MAP 0x254390 kf_si16_S6_S3 200 UMR_BAR_SEC_1_10_0_S6_S3 -100 100
 /begin AXIS_DESCR STD_AXIS zff_atsys._.iSignale._.obj.sig_m_t UMR_NM__1_1_0_S6_S3 6 -400 1640 DEPOSIT ABSOLUTE MONOTONY MON_INCREASE /end AXIS_DESCR
 /begin AXIS_DESCR STD_AXIS zff_atsys._.iSignale._.obj.sig_n_t UMR_U_MIN_1_1_0_S6_S3 4 0 8160 DEPOSIT ABSOLUTE MONOTONY MON_INCREASE /end AXIS_DESCR
/end CHARACTERISTIC
/begin CHARACTERISTIC KF_POKZUMTCG24 "Schaltdruckoffset" MAP 0x2543DC kf_si16_S6_S3 12.75 UMR_BAR__1_1000_0_S6_S3 -6.4 6.35
 /begin AXIS_DESCR STD_AXIS zff_atsys._.iSignale._.obj.sig_m_t UMR_NM__1_1_0_S6_S3 8 -400 1640 DEPOSIT ABSOLUTE MONOTONY MON_INCREASE /end AXIS_DESCR
 /begin AXIS_DESCR STD_AXIS zff_atsys._.iSignale._.obj.sig_c_getr UMR_GRADC__1_1_M40_S6_S3 10 -40 150 DEPOSIT ABSOLUTE MONOTONY MON_INCREASE /end AXIS_DESCR
/end CHARACTERISTIC
/begin CHARACTERISTIC KF_POKZUMTCG24_EL "Schaltdruckoffset" MAP 0x2544A8 kf_si16_S6_S3 12.75 UMR_BAR__1_1000_0_S6_S3 -6.4 6.35
 /begin AXIS_DESCR STD_AXIS zff_atsys._.iSignale._.obj.sig_m_t UMR_NM__1_1_0_S6_S3 8 -400 1640 DEPOSIT ABSOLUTE MONOTONY MON_INCREASE /end AXIS_DESCR
 /begin AXIS_DESCR STD_AXIS zff_atsys._.iSignale._.obj.sig_c_getr UMR_GRADC__1_1_M40_S6_S3 10 -40 150 DEPOSIT ABSOLUTE MONOTONY MON_INCREASE /end AXIS_DESCR
/end CHARACTERISTIC
/begin CHARACTERISTIC KL_TSYNMTRAKZU35 "Zeit vor sync. Ende Schaltdruck/Start 3. Rampe KZU" CURVE 0x254574 kl_ui8_S6_S3 1280 UMR_MSEC__10_1_M128_S6_S3 -1280 0
 /begin AXIS_DESCR STD_AXIS zff_atsys._.iSignale._.obj.sig_m_t8 UMR_NM__8_1_M50_S6_S3 4 -400 1640 DEPOSIT ABSOLUTE MONOTONY MON_INCREASE /end AXIS_DESCR
/end CHARACTERISTIC
/begin CHARACTERISTIC KF_TFCGNT35 "Fuellzeit" MAP 0x254580 kf_ui8_S6_S3 2540 UMR_MSEC__10_1_0_S6_S3 0 2540
 /begin AXIS_DESCR STD_AXIS zff_atsys._.iSignale._.obj.sig_c_getr UMR_GRADC__1_1_M40_S6_S3 6 -40 150 DEPOSIT ABSOLUTE MONOTONY MON_INCREASE /end AXIS_DESCR
 /begin AXIS_DESCR STD_AXIS zff_atsys._.iSignale._.obj.sig_n_t8 UMR_U_MIN_32_1_0_S6_S3 3 0 8160 DEPOSIT ABSOLUTE MONOTONY MON_INCREASE /end AXIS_DESCR
/end CHARACTERISTIC
/begin CHARACTERISTIC T_VKZU35 "Verzoegerungszeit zuschaltende Kupplung nach Schaltbeginn" VALUE 0x26E8A1 kw_ui8_S6_S3 2540 UMR_MSEC__10_1_0_S6_S3 0 2540 /end CHARACTERISTIC
/begin CHARACTERISTIC KF_POFMTN35 "Kennfeld Fuelldruckoffset(n_t, m_t)" MAP 0x2545A4 kf_si16_S6_S3 12.75 UMR_BAR__1_1000_0_S6_S3 -6.4 6.35
 /begin AXIS_DESCR STD_AXIS zff_atsys._.iSignale._.obj.sig_n_t UMR_U_MIN_1_1_0_S6_S3 4 0 8160 DEPOSIT ABSOLUTE MONOTONY MON_INCREASE /end AXIS_DESCR
 /begin AXIS_DESCR STD_AXIS zff_atsys._.iSignale._.obj.sig_m_t UMR_NM__1_1_0_S6_S3 6 -400 1640 DEPOSIT ABSOLUTE MONOTONY MON_INCREASE /end AXIS_DESCR
/end CHARACTERISTIC
/begin CHARACTERISTIC KF_T_DT_IG_CHANGE35 "Kennfeld Zeitvorhalt für Übergabe Rampenzeit auf Schaltdruck" MAP 0x2545F0 kf_si16_S6_S3 5080 UMR_MSEC__10_1_0_S6_S3 -2540 2540
 /begin AXIS_DESCR STD_AXIS zff_atsys._.iSignale._.obj.sig_n_t UMR_U_MIN_1_1_0_S6_S3 4 0 8160 DEPOSIT ABSOLUTE MONOTONY MON_INCREASE /end AXIS_DESCR
 /begin AXIS_DESCR STD_AXIS zff_atsys._.iSignale._.obj.sig_m_t UMR_NM__1_1_0_S6_S3 4 -400 1640 DEPOSIT ABSOLUTE MONOTONY MON_INCREASE /end AXIS_DESCR
/end CHARACTERISTIC
/begin CHARACTERISTIC KF_T2_DT_IG_CHANGE35 "2. Kennfeld Zeitvorhalt für Übergabe Rampenzeit auf Schaltdruck" MAP 0x254628 kf_si16_S6_S3 5080 UMR_MSEC__10_1_0_S6_S3 -2540 2540
 /begin AXIS_DESCR STD_AXIS zff_atsys._.iSignale._.obj.sig_n_t UMR_U_MIN_1_1_0_S6_S3 4 0 8160 DEPOSIT ABSOLUTE MONOTONY MON_INCREASE /end AXIS_DESCR
 /begin AXIS_DESCR STD_AXIS zff_atsys._.iSignale._.obj.sig_m_t UMR_NM__1_1_0_S6_S3 4 -400 1640 DEPOSIT ABSOLUTE MONOTONY MON_INCREASE /end AXIS_DESCR
/end CHARACTERISTIC
/begin CHARACTERISTIC KF_TRAMTNT35 "Zeit 1. Rampe der zuschaltenden Kupplung" MAP 0x254660 kf_ui8_S6_S3 2540 UMR_MSEC__10_1_0_S6_S3 0 2540
 /begin AXIS_DESCR STD_AXIS zff_atsys._.iSignale._.obj.sig_m_t8 UMR_NM__8_1_M50_S6_S3 4 -400 1640 DEPOSIT ABSOLUTE MONOTONY MON_INCREASE /end AXIS_DESCR
 /begin AXIS_DESCR STD_AXIS zff_atsys._.iSignale._.obj.sig_n_t8 UMR_U_MIN_32_1_0_S6_S3 4 0 8160 DEPOSIT ABSOLUTE MONOTONY MON_INCREASE /end AXIS_DESCR
/end CHARACTERISTIC
/begin CHARACTERISTIC KF_PKZU35 "Schaltdruck zuschaltende Kupplung" MAP 0x254680 kf_si16_S6_S3 12.75 UMR_BAR__1_1000_0_S6_S3 0 12.75
 /begin AXIS_DESCR STD_AXIS iSasZentr.iSchaltend.n_tkf UMR_U_MIN_32_1_0_S6_S3 8 0 8160 DEPOSIT ABSOLUTE MONOTONY MON_INCREASE /end AXIS_DESCR
 /begin AXIS_DESCR STD_AXIS zff_atsys._.iSignale._.obj.sig_m_t UMR_NM__1_1_0_S6_S3 10 -400 1640 DEPOSIT ABSOLUTE MONOTONY MON_INCREASE /end AXIS_DESCR
/end CHARACTERISTIC
/begin CHARACTERISTIC F_PRA35 "Druckfaktor waehrend Rampe auf Schaltdruck" VALUE 0x26E8A2 kw_ui8_S6_S3 1 UMR___1_100_0_S6_S3 0 1 /end CHARACTERISTIC
/begin CHARACTERISTIC F_TRA35 "Zeitfaktor waehrend Rampe auf Schaltdruck" VALUE 0x26E8A3 kw_ui8_S6_S3 1 UMR___1_100_0_S6_S3 0 1 /end CHARACTERISTIC
/begin CHARACTERISTIC KF_PGOKZUMTNT35 "Schaltdruckgradient" MAP 0x25474C kf_si16_S6_S3 200 UMR_BAR_SEC_1_10_0_S6_S3 -100 100
 /begin AXIS_DESCR STD_AXIS zff_atsys._.iSignale._.obj.sig_m_t UMR_NM__1_1_0_S6_S3 6 -400 1640 DEPOSIT ABSOLUTE MONOTONY MON_INCREASE /end AXIS_DESCR
 /begin AXIS_DESCR STD_AXIS zff_atsys._.iSignale._.obj.sig_n_t UMR_U_MIN_1_1_0_S6_S3 4 0 8160 DEPOSIT ABSOLUTE MONOTONY MON_INCREASE /end AXIS_DESCR
/end CHARACTERISTIC
/begin CHARACTERISTIC KF_POKZUMTCG35 "Schaltdruckoffset" MAP 0x254798 kf_si16_S6_S3 12.75 UMR_BAR__1_1000_0_S6_S3 -6.4 6.35
 /begin AXIS_DESCR STD_AXIS zff_atsys._.iSignale._.obj.sig_m_t UMR_NM__1_1_0_S6_S3 8 -400 1640 DEPOSIT ABSOLUTE MONOTONY MON_INCREASE /end AXIS_DESCR
 /begin AXIS_DESCR STD_AXIS zff_atsys._.iSignale._.obj.sig_c_getr UMR_GRADC__1_1_M40_S6_S3 10 -40 150 DEPOSIT ABSOLUTE MONOTONY MON_INCREASE /end AXIS_DESCR
/end CHARACTERISTIC
/begin CHARACTERISTIC KF_POKZUMTCG35_EL "Schaltdruckoffset" MAP 0x254864 kf_si16_S6_S3 12.75 UMR_BAR__1_1000_0_S6_S3 -6.4 6.35
 /begin AXIS_DESCR STD_AXIS zff_atsys._.iSignale._.obj.sig_m_t UMR_NM__1_1_0_S6_S3 8 -400 1640 DEPOSIT ABSOLUTE MONOTONY MON_INCREASE /end AXIS_DESCR
 /begin AXIS_DESCR STD_AXIS zff_atsys._.iSignale._.obj.sig_c_getr UMR_GRADC__1_1_M40_S6_S3 10 -40 150 DEPOSIT ABSOLUTE MONOTONY MON_INCREASE /end AXIS_DESCR
/end CHARACTERISTIC
/begin CHARACTERISTIC KL_TSYNMTRAKZU46 "Zeit vor sync. Ende Schaltdruck/Start 3. Rampe KZU" CURVE 0x254930 kl_ui8_S6_S3 1280 UMR_MSEC__10_1_M128_S6_S3 -1280 0
 /begin AXIS_DESCR STD_AXIS zff_atsys._.iSignale._.obj.sig_m_t8 UMR_NM__8_1_M50_S6_S3 4 -400 1640 DEPOSIT ABSOLUTE MONOTONY MON_INCREASE /end AXIS_DESCR
/end CHARACTERISTIC
/begin CHARACTERISTIC KF_TFCGNT46 "Fuellzeit" MAP 0x25493C kf_ui8_S6_S3 2540 UMR_MSEC__10_1_0_S6_S3 0 2540
 /begin AXIS_DESCR STD_AXIS zff_atsys._.iSignale._.obj.sig_c_getr UMR_GRADC__1_1_M40_S6_S3 6 -40 150 DEPOSIT ABSOLUTE MONOTONY MON_INCREASE /end AXIS_DESCR
 /begin AXIS_DESCR STD_AXIS zff_atsys._.iSignale._.obj.sig_n_t8 UMR_U_MIN_32_1_0_S6_S3 3 0 8160 DEPOSIT ABSOLUTE MONOTONY MON_INCREASE /end AXIS_DESCR
/end CHARACTERISTIC
/begin CHARACTERISTIC T_VKZU46 "Verzoegerungszeit zuschaltende Kupplung nach Schaltbeginn" VALUE 0x26E8A4 kw_ui8_S6_S3 2540 UMR_MSEC__10_1_0_S6_S3 0 2540 /end CHARACTERISTIC
/begin CHARACTERISTIC KF_POFMTN46 "Kennfeld Fuelldruckoffset(n_t, m_t)" MAP 0x254960 kf_si16_S6_S3 12.75 UMR_BAR__1_1000_0_S6_S3 -6.4 6.35
 /begin AXIS_DESCR STD_AXIS zff_atsys._.iSignale._.obj.sig_n_t UMR_U_MIN_1_1_0_S6_S3 4 0 8160 DEPOSIT ABSOLUTE MONOTONY MON_INCREASE /end AXIS_DESCR
 /begin AXIS_DESCR STD_AXIS zff_atsys._.iSignale._.obj.sig_m_t UMR_NM__1_1_0_S6_S3 6 -400 1640 DEPOSIT ABSOLUTE MONOTONY MON_INCREASE /end AXIS_DESCR
/end CHARACTERISTIC
/begin CHARACTERISTIC KF_T_DT_IG_CHANGE46 "Kennfeld Zeitvorhalt für Übergabe Rampenzeit auf Schaltdruck" MAP 0x2549AC kf_si16_S6_S3 5080 UMR_MSEC__10_1_0_S6_S3 -2540 2540
 /begin AXIS_DESCR STD_AXIS zff_atsys._.iSignale._.obj.sig_n_t UMR_U_MIN_1_1_0_S6_S3 4 0 8160 DEPOSIT ABSOLUTE MONOTONY MON_INCREASE /end AXIS_DESCR
 /begin AXIS_DESCR STD_AXIS zff_atsys._.iSignale._.obj.sig_m_t UMR_NM__1_1_0_S6_S3 4 -400 1640 DEPOSIT ABSOLUTE MONOTONY MON_INCREASE /end AXIS_DESCR
/end CHARACTERISTIC
/begin CHARACTERISTIC KF_T2_DT_IG_CHANGE46 "2. Kennfeld Zeitvorhalt für Übergabe Rampenzeit auf Schaltdruck" MAP 0x2549E4 kf_si16_S6_S3 5080 UMR_MSEC__10_1_0_S6_S3 -2540 2540
 /begin AXIS_DESCR STD_AXIS zff_atsys._.iSignale._.obj.sig_n_t UMR_U_MIN_1_1_0_S6_S3 4 0 8160 DEPOSIT ABSOLUTE MONOTONY MON_INCREASE /end AXIS_DESCR
 /begin AXIS_DESCR STD_AXIS zff_atsys._.iSignale._.obj.sig_m_t UMR_NM__1_1_0_S6_S3 4 -400 1640 DEPOSIT ABSOLUTE MONOTONY MON_INCREASE /end AXIS_DESCR
/end CHARACTERISTIC
/begin CHARACTERISTIC KF_TRAMTNT46 "Zeit 1. Rampe der zuschaltenden Kupplung" MAP 0x254A1C kf_ui8_S6_S3 2540 UMR_MSEC__10_1_0_S6_S3 0 2540
 /begin AXIS_DESCR STD_AXIS zff_atsys._.iSignale._.obj.sig_m_t8 UMR_NM__8_1_M50_S6_S3 4 -400 1640 DEPOSIT ABSOLUTE MONOTONY MON_INCREASE /end AXIS_DESCR
 /begin AXIS_DESCR STD_AXIS zff_atsys._.iSignale._.obj.sig_n_t8 UMR_U_MIN_32_1_0_S6_S3 4 0 8160 DEPOSIT ABSOLUTE MONOTONY MON_INCREASE /end AXIS_DESCR
/end CHARACTERISTIC
/begin CHARACTERISTIC KF_PKZU46 "Schaltdruck zuschaltende Kupplung" MAP 0x254A3C kf_si16_S6_S3 12.75 UMR_BAR__1_1000_0_S6_S3 0 12.75
 /begin AXIS_DESCR STD_AXIS iSasZentr.iSchaltend.n_tkf UMR_U_MIN_32_1_0_S6_S3 8 0 8160 DEPOSIT ABSOLUTE MONOTONY MON_INCREASE /end AXIS_DESCR
 /begin AXIS_DESCR STD_AXIS zff_atsys._.iSignale._.obj.sig_m_t UMR_NM__1_1_0_S6_S3 10 -400 1640 DEPOSIT ABSOLUTE MONOTONY MON_INCREASE /end AXIS_DESCR
/end CHARACTERISTIC
/begin CHARACTERISTIC F_PRA46 "Druckfaktor waehrend Rampe auf Schaltdruck" VALUE 0x26E8A5 kw_ui8_S6_S3 1 UMR___1_100_0_S6_S3 0 1 /end CHARACTERISTIC
/begin CHARACTERISTIC F_TRA46 "Zeitfaktor waehrend Rampe auf Schaltdruck" VALUE 0x26E8A6 kw_ui8_S6_S3 1 UMR___1_100_0_S6_S3 0 1 /end CHARACTERISTIC
/begin CHARACTERISTIC KF_PGOKZUMTNT46 "Schaltdruckgradient" MAP 0x254B08 kf_si16_S6_S3 200 UMR_BAR_SEC_1_10_0_S6_S3 -100 100
 /begin AXIS_DESCR STD_AXIS zff_atsys._.iSignale._.obj.sig_m_t UMR_NM__1_1_0_S6_S3 6 -400 1640 DEPOSIT ABSOLUTE MONOTONY MON_INCREASE /end AXIS_DESCR
 /begin AXIS_DESCR STD_AXIS zff_atsys._.iSignale._.obj.sig_n_t UMR_U_MIN_1_1_0_S6_S3 4 0 8160 DEPOSIT ABSOLUTE MONOTONY MON_INCREASE /end AXIS_DESCR
/end CHARACTERISTIC
/begin CHARACTERISTIC KF_POKZUMTCG46 "Schaltdruckoffset" MAP 0x254B54 kf_si16_S6_S3 12.75 UMR_BAR__1_1000_0_S6_S3 -6.4 6.35
 /begin AXIS_DESCR STD_AXIS zff_atsys._.iSignale._.obj.sig_m_t UMR_NM__1_1_0_S6_S3 8 -400 1640 DEPOSIT ABSOLUTE MONOTONY MON_INCREASE /end AXIS_DESCR
 /begin AXIS_DESCR STD_AXIS zff_atsys._.iSignale._.obj.sig_c_getr UMR_GRADC__1_1_M40_S6_S3 10 -40 150 DEPOSIT ABSOLUTE MONOTONY MON_INCREASE /end AXIS_DESCR
/end CHARACTERISTIC
/begin CHARACTERISTIC KF_POKZUMTCG46_EL "Schaltdruckoffset" MAP 0x254C20 kf_si16_S6_S3 12.75 UMR_BAR__1_1000_0_S6_S3 -6.4 6.35
 /begin AXIS_DESCR STD_AXIS zff_atsys._.iSignale._.obj.sig_m_t UMR_NM__1_1_0_S6_S3 8 -400 1640 DEPOSIT ABSOLUTE MONOTONY MON_INCREASE /end AXIS_DESCR
 /begin AXIS_DESCR STD_AXIS zff_atsys._.iSignale._.obj.sig_c_getr UMR_GRADC__1_1_M40_S6_S3 10 -40 150 DEPOSIT ABSOLUTE MONOTONY MON_INCREASE /end AXIS_DESCR
/end CHARACTERISTIC
/begin CHARACTERISTIC KL_TSYNMTRAKZU57 "Zeit vor sync. Ende Schaltdruck/Start 3. Rampe KZU" CURVE 0x254CEC kl_ui8_S6_S3 1280 UMR_MSEC__10_1_M128_S6_S3 -1280 0
 /begin AXIS_DESCR STD_AXIS zff_atsys._.iSignale._.obj.sig_m_t8 UMR_NM__8_1_M50_S6_S3 4 -400 1640 DEPOSIT ABSOLUTE MONOTONY MON_INCREASE /end AXIS_DESCR
/end CHARACTERISTIC
/begin CHARACTERISTIC KF_TFCGNT57 "Fuellzeit" MAP 0x254CF8 kf_ui8_S6_S3 2540 UMR_MSEC__10_1_0_S6_S3 0 2540
 /begin AXIS_DESCR STD_AXIS zff_atsys._.iSignale._.obj.sig_c_getr UMR_GRADC__1_1_M40_S6_S3 6 -40 150 DEPOSIT ABSOLUTE MONOTONY MON_INCREASE /end AXIS_DESCR
 /begin AXIS_DESCR STD_AXIS zff_atsys._.iSignale._.obj.sig_n_t8 UMR_U_MIN_32_1_0_S6_S3 3 0 8160 DEPOSIT ABSOLUTE MONOTONY MON_INCREASE /end AXIS_DESCR
/end CHARACTERISTIC
/begin CHARACTERISTIC T_VKZU57 "Verzoegerungszeit zuschaltende Kupplung nach Schaltbeginn" VALUE 0x26E8A7 kw_ui8_S6_S3 2540 UMR_MSEC__10_1_0_S6_S3 0 2540 /end CHARACTERISTIC
/begin CHARACTERISTIC KF_POFMTN57 "Kennfeld Fuelldruckoffset(n_t, m_t)" MAP 0x254D1C kf_si16_S6_S3 12.75 UMR_BAR__1_1000_0_S6_S3 -6.4 6.35
 /begin AXIS_DESCR STD_AXIS zff_atsys._.iSignale._.obj.sig_n_t UMR_U_MIN_1_1_0_S6_S3 4 0 8160 DEPOSIT ABSOLUTE MONOTONY MON_INCREASE /end AXIS_DESCR
 /begin AXIS_DESCR STD_AXIS zff_atsys._.iSignale._.obj.sig_m_t UMR_NM__1_1_0_S6_S3 6 -400 1640 DEPOSIT ABSOLUTE MONOTONY MON_INCREASE /end AXIS_DESCR
/end CHARACTERISTIC
/begin CHARACTERISTIC KF_T_DT_IG_CHANGE57 "Kennfeld Zeitvorhalt für Übergabe Rampenzeit auf Schaltdruck" MAP 0x254D68 kf_si16_S6_S3 5080 UMR_MSEC__10_1_0_S6_S3 -2540 2540
 /begin AXIS_DESCR STD_AXIS zff_atsys._.iSignale._.obj.sig_n_t UMR_U_MIN_1_1_0_S6_S3 4 0 8160 DEPOSIT ABSOLUTE MONOTONY MON_INCREASE /end AXIS_DESCR
 /begin AXIS_DESCR STD_AXIS zff_atsys._.iSignale._.obj.sig_m_t UMR_NM__1_1_0_S6_S3 4 -400 1640 DEPOSIT ABSOLUTE MONOTONY MON_INCREASE /end AXIS_DESCR
/end CHARACTERISTIC
/begin CHARACTERISTIC KF_T2_DT_IG_CHANGE57 "2. Kennfeld Zeitvorhalt für Übergabe Rampenzeit auf Schaltdruck" MAP 0x254DA0 kf_si16_S6_S3 5080 UMR_MSEC__10_1_0_S6_S3 -2540 2540
 /begin AXIS_DESCR STD_AXIS zff_atsys._.iSignale._.obj.sig_n_t UMR_U_MIN_1_1_0_S6_S3 4 0 8160 DEPOSIT ABSOLUTE MONOTONY MON_INCREASE /end AXIS_DESCR
 /begin AXIS_DESCR STD_AXIS zff_atsys._.iSignale._.obj.sig_m_t UMR_NM__1_1_0_S6_S3 4 -400 1640 DEPOSIT ABSOLUTE MONOTONY MON_INCREASE /end AXIS_DESCR
/end CHARACTERISTIC
/begin CHARACTERISTIC KF_TRAMTNT57 "Zeit 1. Rampe der zuschaltenden Kupplung" MAP 0x254DD8 kf_ui8_S6_S3 2540 UMR_MSEC__10_1_0_S6_S3 0 2540
 /begin AXIS_DESCR STD_AXIS zff_atsys._.iSignale._.obj.sig_m_t8 UMR_NM__8_1_M50_S6_S3 4 -400 1640 DEPOSIT ABSOLUTE MONOTONY MON_INCREASE /end AXIS_DESCR
 /begin AXIS_DESCR STD_AXIS zff_atsys._.iSignale._.obj.sig_n_t8 UMR_U_MIN_32_1_0_S6_S3 4 0 8160 DEPOSIT ABSOLUTE MONOTONY MON_INCREASE /end AXIS_DESCR
/end CHARACTERISTIC
/begin CHARACTERISTIC KF_PKZU57 "Schaltdruck zuschaltende Kupplung" MAP 0x254DF8 kf_si16_S6_S3 12.75 UMR_BAR__1_1000_0_S6_S3 0 12.75
 /begin AXIS_DESCR STD_AXIS iSasZentr.iSchaltend.n_tkf UMR_U_MIN_32_1_0_S6_S3 8 0 8160 DEPOSIT ABSOLUTE MONOTONY MON_INCREASE /end AXIS_DESCR
 /begin AXIS_DESCR STD_AXIS zff_atsys._.iSignale._.obj.sig_m_t UMR_NM__1_1_0_S6_S3 10 -400 1640 DEPOSIT ABSOLUTE MONOTONY MON_INCREASE /end AXIS_DESCR
/end CHARACTERISTIC
/begin CHARACTERISTIC F_PRA57 "Druckfaktor waehrend Rampe auf Schaltdruck" VALUE 0x26E8A8 kw_ui8_S6_S3 1 UMR___1_100_0_S6_S3 0 1 /end CHARACTERISTIC
/begin CHARACTERISTIC F_TRA57 "Zeitfaktor waehrend Rampe auf Schaltdruck" VALUE 0x26E8A9 kw_ui8_S6_S3 1 UMR___1_100_0_S6_S3 0 1 /end CHARACTERISTIC
/begin CHARACTERISTIC KF_PGOKZUMTNT57 "Schaltdruckgradient" MAP 0x254EC4 kf_si16_S6_S3 200 UMR_BAR_SEC_1_10_0_S6_S3 -100 100
 /begin AXIS_DESCR STD_AXIS zff_atsys._.iSignale._.obj.sig_m_t UMR_NM__1_1_0_S6_S3 6 -400 1640 DEPOSIT ABSOLUTE MONOTONY MON_INCREASE /end AXIS_DESCR
 /begin AXIS_DESCR STD_AXIS zff_atsys._.iSignale._.obj.sig_n_t UMR_U_MIN_1_1_0_S6_S3 4 0 8160 DEPOSIT ABSOLUTE MONOTONY MON_INCREASE /end AXIS_DESCR
/end CHARACTERISTIC
/begin CHARACTERISTIC KF_POKZUMTCG57 "Schaltdruckoffset" MAP 0x254F10 kf_si16_S6_S3 12.75 UMR_BAR__1_1000_0_S6_S3 -6.4 6.35
 /begin AXIS_DESCR STD_AXIS zff_atsys._.iSignale._.obj.sig_m_t UMR_NM__1_1_0_S6_S3 8 -400 1640 DEPOSIT ABSOLUTE MONOTONY MON_INCREASE /end AXIS_DESCR
 /begin AXIS_DESCR STD_AXIS zff_atsys._.iSignale._.obj.sig_c_getr UMR_GRADC__1_1_M40_S6_S3 10 -40 150 DEPOSIT ABSOLUTE MONOTONY MON_INCREASE /end AXIS_DESCR
/end CHARACTERISTIC
/begin CHARACTERISTIC KF_POKZUMTCG57_EL "Schaltdruckoffset" MAP 0x254FDC kf_si16_S6_S3 12.75 UMR_BAR__1_1000_0_S6_S3 -6.4 6.35
 /begin AXIS_DESCR STD_AXIS zff_atsys._.iSignale._.obj.sig_m_t UMR_NM__1_1_0_S6_S3 8 -400 1640 DEPOSIT ABSOLUTE MONOTONY MON_INCREASE /end AXIS_DESCR
 /begin AXIS_DESCR STD_AXIS zff_atsys._.iSignale._.obj.sig_c_getr UMR_GRADC__1_1_M40_S6_S3 10 -40 150 DEPOSIT ABSOLUTE MONOTONY MON_INCREASE /end AXIS_DESCR
/end CHARACTERISTIC
/begin CHARACTERISTIC KL_TSYNMTRAKZU68 "Zeit vor sync. Ende Schaltdruck/Start 3. Rampe KZU" CURVE 0x2550A8 kl_ui8_S6_S3 1280 UMR_MSEC__10_1_M128_S6_S3 -1280 0
 /begin AXIS_DESCR STD_AXIS zff_atsys._.iSignale._.obj.sig_m_t8 UMR_NM__8_1_M50_S6_S3 4 -400 1640 DEPOSIT ABSOLUTE MONOTONY MON_INCREASE /end AXIS_DESCR
/end CHARACTERISTIC
/begin CHARACTERISTIC KF_TFCGNT68 "Fuellzeit" MAP 0x2550B4 kf_ui8_S6_S3 2540 UMR_MSEC__10_1_0_S6_S3 0 2540
 /begin AXIS_DESCR STD_AXIS zff_atsys._.iSignale._.obj.sig_c_getr UMR_GRADC__1_1_M40_S6_S3 6 -40 150 DEPOSIT ABSOLUTE MONOTONY MON_INCREASE /end AXIS_DESCR
 /begin AXIS_DESCR STD_AXIS zff_atsys._.iSignale._.obj.sig_n_t8 UMR_U_MIN_32_1_0_S6_S3 3 0 8160 DEPOSIT ABSOLUTE MONOTONY MON_INCREASE /end AXIS_DESCR
/end CHARACTERISTIC
/begin CHARACTERISTIC T_VKZU68 "Verzoegerungszeit zuschaltende Kupplung nach Schaltbeginn" VALUE 0x26E8AA kw_ui8_S6_S3 2540 UMR_MSEC__10_1_0_S6_S3 0 2540 /end CHARACTERISTIC
/begin CHARACTERISTIC KF_POFMTN68 "Kennfeld Fuelldruckoffset(n_t, m_t)" MAP 0x2550D8 kf_si16_S6_S3 12.75 UMR_BAR__1_1000_0_S6_S3 -6.4 6.35
 /begin AXIS_DESCR STD_AXIS zff_atsys._.iSignale._.obj.sig_n_t UMR_U_MIN_1_1_0_S6_S3 4 0 8160 DEPOSIT ABSOLUTE MONOTONY MON_INCREASE /end AXIS_DESCR
 /begin AXIS_DESCR STD_AXIS zff_atsys._.iSignale._.obj.sig_m_t UMR_NM__1_1_0_S6_S3 6 -400 1640 DEPOSIT ABSOLUTE MONOTONY MON_INCREASE /end AXIS_DESCR
/end CHARACTERISTIC
/begin CHARACTERISTIC KF_T_DT_IG_CHANGE68 "Kennfeld Zeitvorhalt für Übergabe Rampenzeit auf Schaltdruck" MAP 0x255124 kf_si16_S6_S3 5080 UMR_MSEC__10_1_0_S6_S3 -2540 2540
 /begin AXIS_DESCR STD_AXIS zff_atsys._.iSignale._.obj.sig_n_t UMR_U_MIN_1_1_0_S6_S3 4 0 8160 DEPOSIT ABSOLUTE MONOTONY MON_INCREASE /end AXIS_DESCR
 /begin AXIS_DESCR STD_AXIS zff_atsys._.iSignale._.obj.sig_m_t UMR_NM__1_1_0_S6_S3 4 -400 1640 DEPOSIT ABSOLUTE MONOTONY MON_INCREASE /end AXIS_DESCR
/end CHARACTERISTIC
/begin CHARACTERISTIC KF_T2_DT_IG_CHANGE68 "2. Kennfeld Zeitvorhalt für Übergabe Rampenzeit auf Schaltdruck" MAP 0x25515C kf_si16_S6_S3 5080 UMR_MSEC__10_1_0_S6_S3 -2540 2540
 /begin AXIS_DESCR STD_AXIS zff_atsys._.iSignale._.obj.sig_n_t UMR_U_MIN_1_1_0_S6_S3 4 0 8160 DEPOSIT ABSOLUTE MONOTONY MON_INCREASE /end AXIS_DESCR
 /begin AXIS_DESCR STD_AXIS zff_atsys._.iSignale._.obj.sig_m_t UMR_NM__1_1_0_S6_S3 4 -400 1640 DEPOSIT ABSOLUTE MONOTONY MON_INCREASE /end AXIS_DESCR
/end CHARACTERISTIC
/begin CHARACTERISTIC KF_TRAMTNT68 "Zeit 1. Rampe der zuschaltenden Kupplung" MAP 0x255194 kf_ui8_S6_S3 2540 UMR_MSEC__10_1_0_S6_S3 0 2540
 /begin AXIS_DESCR STD_AXIS zff_atsys._.iSignale._.obj.sig_m_t8 UMR_NM__8_1_M50_S6_S3 4 -400 1640 DEPOSIT ABSOLUTE MONOTONY MON_INCREASE /end AXIS_DESCR
 /begin AXIS_DESCR STD_AXIS zff_atsys._.iSignale._.obj.sig_n_t8 UMR_U_MIN_32_1_0_S6_S3 4 0 8160 DEPOSIT ABSOLUTE MONOTONY MON_INCREASE /end AXIS_DESCR
/end CHARACTERISTIC
/begin CHARACTERISTIC KF_PKZU68 "Schaltdruck zuschaltende Kupplung" MAP 0x2551B4 kf_si16_S6_S3 12.75 UMR_BAR__1_1000_0_S6_S3 0 12.75
 /begin AXIS_DESCR STD_AXIS iSasZentr.iSchaltend.n_tkf UMR_U_MIN_32_1_0_S6_S3 8 0 8160 DEPOSIT ABSOLUTE MONOTONY MON_INCREASE /end AXIS_DESCR
 /begin AXIS_DESCR STD_AXIS zff_atsys._.iSignale._.obj.sig_m_t UMR_NM__1_1_0_S6_S3 10 -400 1640 DEPOSIT ABSOLUTE MONOTONY MON_INCREASE /end AXIS_DESCR
/end CHARACTERISTIC
/begin CHARACTERISTIC F_PRA68 "Druckfaktor waehrend Rampe auf Schaltdruck" VALUE 0x26E8AB kw_ui8_S6_S3 1 UMR___1_100_0_S6_S3 0 1 /end CHARACTERISTIC
/begin CHARACTERISTIC F_TRA68 "Zeitfaktor waehrend Rampe auf Schaltdruck" VALUE 0x26E8AC kw_ui8_S6_S3 1 UMR___1_100_0_S6_S3 0 1 /end CHARACTERISTIC
/begin CHARACTERISTIC KF_PGOKZUMTNT68 "Schaltdruckgradient" MAP 0x255280 kf_si16_S6_S3 200 UMR_BAR_SEC_1_10_0_S6_S3 -100 100
 /begin AXIS_DESCR STD_AXIS zff_atsys._.iSignale._.obj.sig_m_t UMR_NM__1_1_0_S6_S3 6 -400 1640 DEPOSIT ABSOLUTE MONOTONY MON_INCREASE /end AXIS_DESCR
 /begin AXIS_DESCR STD_AXIS zff_atsys._.iSignale._.obj.sig_n_t UMR_U_MIN_1_1_0_S6_S3 4 0 8160 DEPOSIT ABSOLUTE MONOTONY MON_INCREASE /end AXIS_DESCR
/end CHARACTERISTIC
/begin CHARACTERISTIC KF_POKZUMTCG68 "Schaltdruckoffset" MAP 0x2552CC kf_si16_S6_S3 12.75 UMR_BAR__1_1000_0_S6_S3 -6.4 6.35
 /begin AXIS_DESCR STD_AXIS zff_atsys._.iSignale._.obj.sig_m_t UMR_NM__1_1_0_S6_S3 8 -400 1640 DEPOSIT ABSOLUTE MONOTONY MON_INCREASE /end AXIS_DESCR
 /begin AXIS_DESCR STD_AXIS zff_atsys._.iSignale._.obj.sig_c_getr UMR_GRADC__1_1_M40_S6_S3 10 -40 150 DEPOSIT ABSOLUTE MONOTONY MON_INCREASE /end AXIS_DESCR
/end CHARACTERISTIC
/begin CHARACTERISTIC KF_POKZUMTCG68_EL "Schaltdruckoffset" MAP 0x255398 kf_si16_S6_S3 12.75 UMR_BAR__1_1000_0_S6_S3 -6.4 6.35
 /begin AXIS_DESCR STD_AXIS zff_atsys._.iSignale._.obj.sig_m_t UMR_NM__1_1_0_S6_S3 8 -400 1640 DEPOSIT ABSOLUTE MONOTONY MON_INCREASE /end AXIS_DESCR
 /begin AXIS_DESCR STD_AXIS zff_atsys._.iSignale._.obj.sig_c_getr UMR_GRADC__1_1_M40_S6_S3 10 -40 150 DEPOSIT ABSOLUTE MONOTONY MON_INCREASE /end AXIS_DESCR
/end CHARACTERISTIC
/begin CHARACTERISTIC KL_TSYNMTRAKZUSP13 "Zeit vor sync. Ende Schaltdruck/Start 3. Rampe KZU" CURVE 0x255464 kl_ui8_S6_S3 1280 UMR_MSEC__10_1_M128_S6_S3 -1280 0
 /begin AXIS_DESCR STD_AXIS zff_atsys._.iSignale._.obj.sig_m_t8 UMR_NM__8_1_M50_S6_S3 4 -400 1640 DEPOSIT ABSOLUTE MONOTONY MON_INCREASE /end AXIS_DESCR
/end CHARACTERISTIC
/begin CHARACTERISTIC KF_TFCGNTSP13 "Fuellzeit" MAP 0x255470 kf_ui8_S6_S3 2540 UMR_MSEC__10_1_0_S6_S3 0 2540
 /begin AXIS_DESCR STD_AXIS zff_atsys._.iSignale._.obj.sig_c_getr UMR_GRADC__1_1_M40_S6_S3 6 -40 150 DEPOSIT ABSOLUTE MONOTONY MON_INCREASE /end AXIS_DESCR
 /begin AXIS_DESCR STD_AXIS zff_atsys._.iSignale._.obj.sig_n_t8 UMR_U_MIN_32_1_0_S6_S3 3 0 8160 DEPOSIT ABSOLUTE MONOTONY MON_INCREASE /end AXIS_DESCR
/end CHARACTERISTIC
/begin CHARACTERISTIC T_VKZUSP13 "Verzoegerungszeit zuschaltende Kupplung nach Schaltbeginn" VALUE 0x26E8AD kw_ui8_S6_S3 2540 UMR_MSEC__10_1_0_S6_S3 0 2540 /end CHARACTERISTIC
/begin CHARACTERISTIC KF_POFMTNSP13 "Kennfeld Fuelldruckoffset(n_t, m_t)" MAP 0x255494 kf_si16_S6_S3 12.75 UMR_BAR__1_1000_0_S6_S3 -6.4 6.35
 /begin AXIS_DESCR STD_AXIS zff_atsys._.iSignale._.obj.sig_n_t UMR_U_MIN_1_1_0_S6_S3 4 0 8160 DEPOSIT ABSOLUTE MONOTONY MON_INCREASE /end AXIS_DESCR
 /begin AXIS_DESCR STD_AXIS zff_atsys._.iSignale._.obj.sig_m_t UMR_NM__1_1_0_S6_S3 6 -400 1640 DEPOSIT ABSOLUTE MONOTONY MON_INCREASE /end AXIS_DESCR
/end CHARACTERISTIC
/begin CHARACTERISTIC KF_T_DT_IG_CHANGESP13 "Kennfeld Zeitvorhalt für Übergabe Rampenzeit auf Schaltdruck" MAP 0x2554E0 kf_si16_S6_S3 5080 UMR_MSEC__10_1_0_S6_S3 -2540 2540
 /begin AXIS_DESCR STD_AXIS zff_atsys._.iSignale._.obj.sig_n_t UMR_U_MIN_1_1_0_S6_S3 4 0 8160 DEPOSIT ABSOLUTE MONOTONY MON_INCREASE /end AXIS_DESCR
 /begin AXIS_DESCR STD_AXIS zff_atsys._.iSignale._.obj.sig_m_t UMR_NM__1_1_0_S6_S3 4 -400 1640 DEPOSIT ABSOLUTE MONOTONY MON_INCREASE /end AXIS_DESCR
/end CHARACTERISTIC
/begin CHARACTERISTIC KF_T2_DT_IG_CHANGESP13 "2. Kennfeld Zeitvorhalt für Übergabe Rampenzeit auf Schaltdruck" MAP 0x255518 kf_si16_S6_S3 5080 UMR_MSEC__10_1_0_S6_S3 -2540 2540
 /begin AXIS_DESCR STD_AXIS zff_atsys._.iSignale._.obj.sig_n_t UMR_U_MIN_1_1_0_S6_S3 4 0 8160 DEPOSIT ABSOLUTE MONOTONY MON_INCREASE /end AXIS_DESCR
 /begin AXIS_DESCR STD_AXIS zff_atsys._.iSignale._.obj.sig_m_t UMR_NM__1_1_0_S6_S3 4 -400 1640 DEPOSIT ABSOLUTE MONOTONY MON_INCREASE /end AXIS_DESCR
/end CHARACTERISTIC
/begin CHARACTERISTIC KF_TRAMTNTSP13 "Zeit 1. Rampe der zuschaltenden Kupplung" MAP 0x255550 kf_ui8_S6_S3 2540 UMR_MSEC__10_1_0_S6_S3 0 2540
 /begin AXIS_DESCR STD_AXIS zff_atsys._.iSignale._.obj.sig_m_t8 UMR_NM__8_1_M50_S6_S3 4 -400 1640 DEPOSIT ABSOLUTE MONOTONY MON_INCREASE /end AXIS_DESCR
 /begin AXIS_DESCR STD_AXIS zff_atsys._.iSignale._.obj.sig_n_t8 UMR_U_MIN_32_1_0_S6_S3 4 0 8160 DEPOSIT ABSOLUTE MONOTONY MON_INCREASE /end AXIS_DESCR
/end CHARACTERISTIC
/begin CHARACTERISTIC KF_PKZUSP13 "Schaltdruck zuschaltende Kupplung" MAP 0x255570 kf_si16_S6_S3 12.75 UMR_BAR__1_1000_0_S6_S3 0 12.75
 /begin AXIS_DESCR STD_AXIS iSasZentr.iSchaltend.n_tkf UMR_U_MIN_32_1_0_S6_S3 8 0 8160 DEPOSIT ABSOLUTE MONOTONY MON_INCREASE /end AXIS_DESCR
 /begin AXIS_DESCR STD_AXIS zff_atsys._.iSignale._.obj.sig_m_t UMR_NM__1_1_0_S6_S3 10 -400 1640 DEPOSIT ABSOLUTE MONOTONY MON_INCREASE /end AXIS_DESCR
/end CHARACTERISTIC
/begin CHARACTERISTIC F_PRASP13 "Druckfaktor waehrend Rampe auf Schaltdruck" VALUE 0x26E8AE kw_ui8_S6_S3 1 UMR___1_100_0_S6_S3 0 1 /end CHARACTERISTIC
/begin CHARACTERISTIC F_TRASP13 "Zeitfaktor waehrend Rampe auf Schaltdruck" VALUE 0x26E8AF kw_ui8_S6_S3 1 UMR___1_100_0_S6_S3 0 1 /end CHARACTERISTIC
/begin CHARACTERISTIC KF_PGOKZUMTNTSP13 "Schaltdruckgradient" MAP 0x25563C kf_si16_S6_S3 200 UMR_BAR_SEC_1_10_0_S6_S3 -100 100
 /begin AXIS_DESCR STD_AXIS zff_atsys._.iSignale._.obj.sig_m_t UMR_NM__1_1_0_S6_S3 6 -400 1640 DEPOSIT ABSOLUTE MONOTONY MON_INCREASE /end AXIS_DESCR
 /begin AXIS_DESCR STD_AXIS zff_atsys._.iSignale._.obj.sig_n_t UMR_U_MIN_1_1_0_S6_S3 4 0 8160 DEPOSIT ABSOLUTE MONOTONY MON_INCREASE /end AXIS_DESCR
/end CHARACTERISTIC
/begin CHARACTERISTIC KF_POKZUMTCGSP13 "Schaltdruckoffset" MAP 0x255688 kf_si16_S6_S3 12.75 UMR_BAR__1_1000_0_S6_S3 -6.4 6.35
 /begin AXIS_DESCR STD_AXIS zff_atsys._.iSignale._.obj.sig_m_t UMR_NM__1_1_0_S6_S3 8 -400 1640 DEPOSIT ABSOLUTE MONOTONY MON_INCREASE /end AXIS_DESCR
 /begin AXIS_DESCR STD_AXIS zff_atsys._.iSignale._.obj.sig_c_getr UMR_GRADC__1_1_M40_S6_S3 10 -40 150 DEPOSIT ABSOLUTE MONOTONY MON_INCREASE /end AXIS_DESCR
/end CHARACTERISTIC
/begin CHARACTERISTIC KL_TSYNMTRAKZUSP24 "Zeit vor sync. Ende Schaltdruck/Start 3. Rampe KZU" CURVE 0x255754 kl_ui8_S6_S3 1280 UMR_MSEC__10_1_M128_S6_S3 -1280 0
 /begin AXIS_DESCR STD_AXIS zff_atsys._.iSignale._.obj.sig_m_t8 UMR_NM__8_1_M50_S6_S3 4 -400 1640 DEPOSIT ABSOLUTE MONOTONY MON_INCREASE /end AXIS_DESCR
/end CHARACTERISTIC
/begin CHARACTERISTIC KF_TFCGNTSP24 "Fuellzeit" MAP 0x255760 kf_ui8_S6_S3 2540 UMR_MSEC__10_1_0_S6_S3 0 2540
 /begin AXIS_DESCR STD_AXIS zff_atsys._.iSignale._.obj.sig_c_getr UMR_GRADC__1_1_M40_S6_S3 6 -40 150 DEPOSIT ABSOLUTE MONOTONY MON_INCREASE /end AXIS_DESCR
 /begin AXIS_DESCR STD_AXIS zff_atsys._.iSignale._.obj.sig_n_t8 UMR_U_MIN_32_1_0_S6_S3 3 0 8160 DEPOSIT ABSOLUTE MONOTONY MON_INCREASE /end AXIS_DESCR
/end CHARACTERISTIC
/begin CHARACTERISTIC T_VKZUSP24 "Verzoegerungszeit zuschaltende Kupplung nach Schaltbeginn" VALUE 0x26E8B0 kw_ui8_S6_S3 2540 UMR_MSEC__10_1_0_S6_S3 0 2540 /end CHARACTERISTIC
/begin CHARACTERISTIC KF_POFMTNSP24 "Kennfeld Fuelldruckoffset(n_t, m_t)" MAP 0x255784 kf_si16_S6_S3 12.75 UMR_BAR__1_1000_0_S6_S3 -6.4 6.35
 /begin AXIS_DESCR STD_AXIS zff_atsys._.iSignale._.obj.sig_n_t UMR_U_MIN_1_1_0_S6_S3 4 0 8160 DEPOSIT ABSOLUTE MONOTONY MON_INCREASE /end AXIS_DESCR
 /begin AXIS_DESCR STD_AXIS zff_atsys._.iSignale._.obj.sig_m_t UMR_NM__1_1_0_S6_S3 6 -400 1640 DEPOSIT ABSOLUTE MONOTONY MON_INCREASE /end AXIS_DESCR
/end CHARACTERISTIC
/begin CHARACTERISTIC KF_T_DT_IG_CHANGESP24 "Kennfeld Zeitvorhalt für Übergabe Rampenzeit auf Schaltdruck" MAP 0x2557D0 kf_si16_S6_S3 5080 UMR_MSEC__10_1_0_S6_S3 -2540 2540
 /begin AXIS_DESCR STD_AXIS zff_atsys._.iSignale._.obj.sig_n_t UMR_U_MIN_1_1_0_S6_S3 4 0 8160 DEPOSIT ABSOLUTE MONOTONY MON_INCREASE /end AXIS_DESCR
 /begin AXIS_DESCR STD_AXIS zff_atsys._.iSignale._.obj.sig_m_t UMR_NM__1_1_0_S6_S3 4 -400 1640 DEPOSIT ABSOLUTE MONOTONY MON_INCREASE /end AXIS_DESCR
/end CHARACTERISTIC
/begin CHARACTERISTIC KF_T2_DT_IG_CHANGESP24 "2. Kennfeld Zeitvorhalt für Übergabe Rampenzeit auf Schaltdruck" MAP 0x255808 kf_si16_S6_S3 5080 UMR_MSEC__10_1_0_S6_S3 -2540 2540
 /begin AXIS_DESCR STD_AXIS zff_atsys._.iSignale._.obj.sig_n_t UMR_U_MIN_1_1_0_S6_S3 4 0 8160 DEPOSIT ABSOLUTE MONOTONY MON_INCREASE /end AXIS_DESCR
 /begin AXIS_DESCR STD_AXIS zff_atsys._.iSignale._.obj.sig_m_t UMR_NM__1_1_0_S6_S3 4 -400 1640 DEPOSIT ABSOLUTE MONOTONY MON_INCREASE /end AXIS_DESCR
/end CHARACTERISTIC
/begin CHARACTERISTIC KF_TRAMTNTSP24 "Zeit 1. Rampe der zuschaltenden Kupplung" MAP 0x255840 kf_ui8_S6_S3 2540 UMR_MSEC__10_1_0_S6_S3 0 2540
 /begin AXIS_DESCR STD_AXIS zff_atsys._.iSignale._.obj.sig_m_t8 UMR_NM__8_1_M50_S6_S3 4 -400 1640 DEPOSIT ABSOLUTE MONOTONY MON_INCREASE /end AXIS_DESCR
 /begin AXIS_DESCR STD_AXIS zff_atsys._.iSignale._.obj.sig_n_t8 UMR_U_MIN_32_1_0_S6_S3 4 0 8160 DEPOSIT ABSOLUTE MONOTONY MON_INCREASE /end AXIS_DESCR
/end CHARACTERISTIC
/begin CHARACTERISTIC KF_PKZUSP24 "Schaltdruck zuschaltende Kupplung" MAP 0x255860 kf_si16_S6_S3 12.75 UMR_BAR__1_1000_0_S6_S3 0 12.75
 /begin AXIS_DESCR STD_AXIS iSasZentr.iSchaltend.n_tkf UMR_U_MIN_32_1_0_S6_S3 8 0 8160 DEPOSIT ABSOLUTE MONOTONY MON_INCREASE /end AXIS_DESCR
 /begin AXIS_DESCR STD_AXIS zff_atsys._.iSignale._.obj.sig_m_t UMR_NM__1_1_0_S6_S3 10 -400 1640 DEPOSIT ABSOLUTE MONOTONY MON_INCREASE /end AXIS_DESCR
/end CHARACTERISTIC
/begin CHARACTERISTIC F_PRASP24 "Druckfaktor waehrend Rampe auf Schaltdruck" VALUE 0x26E8B1 kw_ui8_S6_S3 1 UMR___1_100_0_S6_S3 0 1 /end CHARACTERISTIC
/begin CHARACTERISTIC F_TRASP24 "Zeitfaktor waehrend Rampe auf Schaltdruck" VALUE 0x26E8B2 kw_ui8_S6_S3 1 UMR___1_100_0_S6_S3 0 1 /end CHARACTERISTIC
/begin CHARACTERISTIC KF_PGOKZUMTNTSP24 "Schaltdruckgradient" MAP 0x25592C kf_si16_S6_S3 200 UMR_BAR_SEC_1_10_0_S6_S3 -100 100
 /begin AXIS_DESCR STD_AXIS zff_atsys._.iSignale._.obj.sig_m_t UMR_NM__1_1_0_S6_S3 6 -400 1640 DEPOSIT ABSOLUTE MONOTONY MON_INCREASE /end AXIS_DESCR
 /begin AXIS_DESCR STD_AXIS zff_atsys._.iSignale._.obj.sig_n_t UMR_U_MIN_1_1_0_S6_S3 4 0 8160 DEPOSIT ABSOLUTE MONOTONY MON_INCREASE /end AXIS_DESCR
/end CHARACTERISTIC
/begin CHARACTERISTIC KF_POKZUMTCGSP24 "Schaltdruckoffset" MAP 0x255978 kf_si16_S6_S3 12.75 UMR_BAR__1_1000_0_S6_S3 -6.4 6.35
 /begin AXIS_DESCR STD_AXIS zff_atsys._.iSignale._.obj.sig_m_t UMR_NM__1_1_0_S6_S3 8 -400 1640 DEPOSIT ABSOLUTE MONOTONY MON_INCREASE /end AXIS_DESCR
 /begin AXIS_DESCR STD_AXIS zff_atsys._.iSignale._.obj.sig_c_getr UMR_GRADC__1_1_M40_S6_S3 10 -40 150 DEPOSIT ABSOLUTE MONOTONY MON_INCREASE /end AXIS_DESCR
/end CHARACTERISTIC
/begin CHARACTERISTIC KL_TSYNMTRAKZUSP35 "Zeit vor sync. Ende Schaltdruck/Start 3. Rampe KZU" CURVE 0x255A44 kl_ui8_S6_S3 1280 UMR_MSEC__10_1_M128_S6_S3 -1280 0
 /begin AXIS_DESCR STD_AXIS zff_atsys._.iSignale._.obj.sig_m_t8 UMR_NM__8_1_M50_S6_S3 4 -400 1640 DEPOSIT ABSOLUTE MONOTONY MON_INCREASE /end AXIS_DESCR
/end CHARACTERISTIC
/begin CHARACTERISTIC KF_TFCGNTSP35 "Fuellzeit" MAP 0x255A50 kf_ui8_S6_S3 2540 UMR_MSEC__10_1_0_S6_S3 0 2540
 /begin AXIS_DESCR STD_AXIS zff_atsys._.iSignale._.obj.sig_c_getr UMR_GRADC__1_1_M40_S6_S3 6 -40 150 DEPOSIT ABSOLUTE MONOTONY MON_INCREASE /end AXIS_DESCR
 /begin AXIS_DESCR STD_AXIS zff_atsys._.iSignale._.obj.sig_n_t8 UMR_U_MIN_32_1_0_S6_S3 3 0 8160 DEPOSIT ABSOLUTE MONOTONY MON_INCREASE /end AXIS_DESCR
/end CHARACTERISTIC
/begin CHARACTERISTIC T_VKZUSP35 "Verzoegerungszeit zuschaltende Kupplung nach Schaltbeginn" VALUE 0x26E8B3 kw_ui8_S6_S3 2540 UMR_MSEC__10_1_0_S6_S3 0 2540 /end CHARACTERISTIC
/begin CHARACTERISTIC KF_POFMTNSP35 "Kennfeld Fuelldruckoffset(n_t, m_t)" MAP 0x255A74 kf_si16_S6_S3 12.75 UMR_BAR__1_1000_0_S6_S3 -6.4 6.35
 /begin AXIS_DESCR STD_AXIS zff_atsys._.iSignale._.obj.sig_n_t UMR_U_MIN_1_1_0_S6_S3 4 0 8160 DEPOSIT ABSOLUTE MONOTONY MON_INCREASE /end AXIS_DESCR
 /begin AXIS_DESCR STD_AXIS zff_atsys._.iSignale._.obj.sig_m_t UMR_NM__1_1_0_S6_S3 6 -400 1640 DEPOSIT ABSOLUTE MONOTONY MON_INCREASE /end AXIS_DESCR
/end CHARACTERISTIC
/begin CHARACTERISTIC KF_T_DT_IG_CHANGESP35 "Kennfeld Zeitvorhalt für Übergabe Rampenzeit auf Schaltdruck" MAP 0x255AC0 kf_si16_S6_S3 5080 UMR_MSEC__10_1_0_S6_S3 -2540 2540
 /begin AXIS_DESCR STD_AXIS zff_atsys._.iSignale._.obj.sig_n_t UMR_U_MIN_1_1_0_S6_S3 4 0 8160 DEPOSIT ABSOLUTE MONOTONY MON_INCREASE /end AXIS_DESCR
 /begin AXIS_DESCR STD_AXIS zff_atsys._.iSignale._.obj.sig_m_t UMR_NM__1_1_0_S6_S3 4 -400 1640 DEPOSIT ABSOLUTE MONOTONY MON_INCREASE /end AXIS_DESCR
/end CHARACTERISTIC
/begin CHARACTERISTIC KF_T2_DT_IG_CHANGESP35 "2. Kennfeld Zeitvorhalt für Übergabe Rampenzeit auf Schaltdruck" MAP 0x255AF8 kf_si16_S6_S3 5080 UMR_MSEC__10_1_0_S6_S3 -2540 2540
 /begin AXIS_DESCR STD_AXIS zff_atsys._.iSignale._.obj.sig_n_t UMR_U_MIN_1_1_0_S6_S3 4 0 8160 DEPOSIT ABSOLUTE MONOTONY MON_INCREASE /end AXIS_DESCR
 /begin AXIS_DESCR STD_AXIS zff_atsys._.iSignale._.obj.sig_m_t UMR_NM__1_1_0_S6_S3 4 -400 1640 DEPOSIT ABSOLUTE MONOTONY MON_INCREASE /end AXIS_DESCR
/end CHARACTERISTIC
/begin CHARACTERISTIC KF_TRAMTNTSP35 "Zeit 1. Rampe der zuschaltenden Kupplung" MAP 0x255B30 kf_ui8_S6_S3 2540 UMR_MSEC__10_1_0_S6_S3 0 2540
 /begin AXIS_DESCR STD_AXIS zff_atsys._.iSignale._.obj.sig_m_t8 UMR_NM__8_1_M50_S6_S3 4 -400 1640 DEPOSIT ABSOLUTE MONOTONY MON_INCREASE /end AXIS_DESCR
 /begin AXIS_DESCR STD_AXIS zff_atsys._.iSignale._.obj.sig_n_t8 UMR_U_MIN_32_1_0_S6_S3 4 0 8160 DEPOSIT ABSOLUTE MONOTONY MON_INCREASE /end AXIS_DESCR
/end CHARACTERISTIC
/begin CHARACTERISTIC KF_PKZUSP35 "Schaltdruck zuschaltende Kupplung" MAP 0x255B50 kf_si16_S6_S3 12.75 UMR_BAR__1_1000_0_S6_S3 0 12.75
 /begin AXIS_DESCR STD_AXIS iSasZentr.iSchaltend.n_tkf UMR_U_MIN_32_1_0_S6_S3 8 0 8160 DEPOSIT ABSOLUTE MONOTONY MON_INCREASE /end AXIS_DESCR
 /begin AXIS_DESCR STD_AXIS zff_atsys._.iSignale._.obj.sig_m_t UMR_NM__1_1_0_S6_S3 10 -400 1640 DEPOSIT ABSOLUTE MONOTONY MON_INCREASE /end AXIS_DESCR
/end CHARACTERISTIC
/begin CHARACTERISTIC F_PRASP35 "Druckfaktor waehrend Rampe auf Schaltdruck" VALUE 0x26E8B4 kw_ui8_S6_S3 1 UMR___1_100_0_S6_S3 0 1 /end CHARACTERISTIC
/begin CHARACTERISTIC F_TRASP35 "Zeitfaktor waehrend Rampe auf Schaltdruck" VALUE 0x26E8B5 kw_ui8_S6_S3 1 UMR___1_100_0_S6_S3 0 1 /end CHARACTERISTIC
/begin CHARACTERISTIC KF_PGOKZUMTNTSP35 "Schaltdruckgradient" MAP 0x255C1C kf_si16_S6_S3 200 UMR_BAR_SEC_1_10_0_S6_S3 -100 100
 /begin AXIS_DESCR STD_AXIS zff_atsys._.iSignale._.obj.sig_m_t UMR_NM__1_1_0_S6_S3 6 -400 1640 DEPOSIT ABSOLUTE MONOTONY MON_INCREASE /end AXIS_DESCR
 /begin AXIS_DESCR STD_AXIS zff_atsys._.iSignale._.obj.sig_n_t UMR_U_MIN_1_1_0_S6_S3 4 0 8160 DEPOSIT ABSOLUTE MONOTONY MON_INCREASE /end AXIS_DESCR
/end CHARACTERISTIC
/begin CHARACTERISTIC KF_POKZUMTCGSP35 "Schaltdruckoffset" MAP 0x255C68 kf_si16_S6_S3 12.75 UMR_BAR__1_1000_0_S6_S3 -6.4 6.35
 /begin AXIS_DESCR STD_AXIS zff_atsys._.iSignale._.obj.sig_m_t UMR_NM__1_1_0_S6_S3 8 -400 1640 DEPOSIT ABSOLUTE MONOTONY MON_INCREASE /end AXIS_DESCR
 /begin AXIS_DESCR STD_AXIS zff_atsys._.iSignale._.obj.sig_c_getr UMR_GRADC__1_1_M40_S6_S3 10 -40 150 DEPOSIT ABSOLUTE MONOTONY MON_INCREASE /end AXIS_DESCR
/end CHARACTERISTIC
/begin CHARACTERISTIC KL_TSYNMTRAKZUSP46 "Zeit vor sync. Ende Schaltdruck/Start 3. Rampe KZU" CURVE 0x255D34 kl_ui8_S6_S3 1280 UMR_MSEC__10_1_M128_S6_S3 -1280 0
 /begin AXIS_DESCR STD_AXIS zff_atsys._.iSignale._.obj.sig_m_t8 UMR_NM__8_1_M50_S6_S3 4 -400 1640 DEPOSIT ABSOLUTE MONOTONY MON_INCREASE /end AXIS_DESCR
/end CHARACTERISTIC
/begin CHARACTERISTIC KF_TFCGNTSP46 "Fuellzeit" MAP 0x255D40 kf_ui8_S6_S3 2540 UMR_MSEC__10_1_0_S6_S3 0 2540
 /begin AXIS_DESCR STD_AXIS zff_atsys._.iSignale._.obj.sig_c_getr UMR_GRADC__1_1_M40_S6_S3 6 -40 150 DEPOSIT ABSOLUTE MONOTONY MON_INCREASE /end AXIS_DESCR
 /begin AXIS_DESCR STD_AXIS zff_atsys._.iSignale._.obj.sig_n_t8 UMR_U_MIN_32_1_0_S6_S3 3 0 8160 DEPOSIT ABSOLUTE MONOTONY MON_INCREASE /end AXIS_DESCR
/end CHARACTERISTIC
/begin CHARACTERISTIC T_VKZUSP46 "Verzoegerungszeit zuschaltende Kupplung nach Schaltbeginn" VALUE 0x26E8B6 kw_ui8_S6_S3 2540 UMR_MSEC__10_1_0_S6_S3 0 2540 /end CHARACTERISTIC
/begin CHARACTERISTIC KF_POFMTNSP46 "Kennfeld Fuelldruckoffset(n_t, m_t)" MAP 0x255D64 kf_si16_S6_S3 12.75 UMR_BAR__1_1000_0_S6_S3 -6.4 6.35
 /begin AXIS_DESCR STD_AXIS zff_atsys._.iSignale._.obj.sig_n_t UMR_U_MIN_1_1_0_S6_S3 4 0 8160 DEPOSIT ABSOLUTE MONOTONY MON_INCREASE /end AXIS_DESCR
 /begin AXIS_DESCR STD_AXIS zff_atsys._.iSignale._.obj.sig_m_t UMR_NM__1_1_0_S6_S3 6 -400 1640 DEPOSIT ABSOLUTE MONOTONY MON_INCREASE /end AXIS_DESCR
/end CHARACTERISTIC
/begin CHARACTERISTIC KF_T_DT_IG_CHANGESP46 "Kennfeld Zeitvorhalt für Übergabe Rampenzeit auf Schaltdruck" MAP 0x255DB0 kf_si16_S6_S3 5080 UMR_MSEC__10_1_0_S6_S3 -2540 2540
 /begin AXIS_DESCR STD_AXIS zff_atsys._.iSignale._.obj.sig_n_t UMR_U_MIN_1_1_0_S6_S3 4 0 8160 DEPOSIT ABSOLUTE MONOTONY MON_INCREASE /end AXIS_DESCR
 /begin AXIS_DESCR STD_AXIS zff_atsys._.iSignale._.obj.sig_m_t UMR_NM__1_1_0_S6_S3 4 -400 1640 DEPOSIT ABSOLUTE MONOTONY MON_INCREASE /end AXIS_DESCR
/end CHARACTERISTIC
/begin CHARACTERISTIC KF_T2_DT_IG_CHANGESP46 "2. Kennfeld Zeitvorhalt für Übergabe Rampenzeit auf Schaltdruck" MAP 0x255DE8 kf_si16_S6_S3 5080 UMR_MSEC__10_1_0_S6_S3 -2540 2540
 /begin AXIS_DESCR STD_AXIS zff_atsys._.iSignale._.obj.sig_n_t UMR_U_MIN_1_1_0_S6_S3 4 0 8160 DEPOSIT ABSOLUTE MONOTONY MON_INCREASE /end AXIS_DESCR
 /begin AXIS_DESCR STD_AXIS zff_atsys._.iSignale._.obj.sig_m_t UMR_NM__1_1_0_S6_S3 4 -400 1640 DEPOSIT ABSOLUTE MONOTONY MON_INCREASE /end AXIS_DESCR
/end CHARACTERISTIC
/begin CHARACTERISTIC KF_TRAMTNTSP46 "Zeit 1. Rampe der zuschaltenden Kupplung" MAP 0x255E20 kf_ui8_S6_S3 2540 UMR_MSEC__10_1_0_S6_S3 0 2540
 /begin AXIS_DESCR STD_AXIS zff_atsys._.iSignale._.obj.sig_m_t8 UMR_NM__8_1_M50_S6_S3 4 -400 1640 DEPOSIT ABSOLUTE MONOTONY MON_INCREASE /end AXIS_DESCR
 /begin AXIS_DESCR STD_AXIS zff_atsys._.iSignale._.obj.sig_n_t8 UMR_U_MIN_32_1_0_S6_S3 4 0 8160 DEPOSIT ABSOLUTE MONOTONY MON_INCREASE /end AXIS_DESCR
/end CHARACTERISTIC
/begin CHARACTERISTIC KF_PKZUSP46 "Schaltdruck zuschaltende Kupplung" MAP 0x255E40 kf_si16_S6_S3 12.75 UMR_BAR__1_1000_0_S6_S3 0 12.75
 /begin AXIS_DESCR STD_AXIS iSasZentr.iSchaltend.n_tkf UMR_U_MIN_32_1_0_S6_S3 8 0 8160 DEPOSIT ABSOLUTE MONOTONY MON_INCREASE /end AXIS_DESCR
 /begin AXIS_DESCR STD_AXIS zff_atsys._.iSignale._.obj.sig_m_t UMR_NM__1_1_0_S6_S3 10 -400 1640 DEPOSIT ABSOLUTE MONOTONY MON_INCREASE /end AXIS_DESCR
/end CHARACTERISTIC
/begin CHARACTERISTIC F_PRASP46 "Druckfaktor waehrend Rampe auf Schaltdruck" VALUE 0x26E8B7 kw_ui8_S6_S3 1 UMR___1_100_0_S6_S3 0 1 /end CHARACTERISTIC
/begin CHARACTERISTIC F_TRASP46 "Zeitfaktor waehrend Rampe auf Schaltdruck" VALUE 0x26E8B8 kw_ui8_S6_S3 1 UMR___1_100_0_S6_S3 0 1 /end CHARACTERISTIC
/begin CHARACTERISTIC KF_PGOKZUMTNTSP46 "Schaltdruckgradient" MAP 0x255F0C kf_si16_S6_S3 200 UMR_BAR_SEC_1_10_0_S6_S3 -100 100
 /begin AXIS_DESCR STD_AXIS zff_atsys._.iSignale._.obj.sig_m_t UMR_NM__1_1_0_S6_S3 6 -400 1640 DEPOSIT ABSOLUTE MONOTONY MON_INCREASE /end AXIS_DESCR
 /begin AXIS_DESCR STD_AXIS zff_atsys._.iSignale._.obj.sig_n_t UMR_U_MIN_1_1_0_S6_S3 4 0 8160 DEPOSIT ABSOLUTE MONOTONY MON_INCREASE /end AXIS_DESCR
/end CHARACTERISTIC
/begin CHARACTERISTIC KF_POKZUMTCGSP46 "Schaltdruckoffset" MAP 0x255F58 kf_si16_S6_S3 12.75 UMR_BAR__1_1000_0_S6_S3 -6.4 6.35
 /begin AXIS_DESCR STD_AXIS zff_atsys._.iSignale._.obj.sig_m_t UMR_NM__1_1_0_S6_S3 8 -400 1640 DEPOSIT ABSOLUTE MONOTONY MON_INCREASE /end AXIS_DESCR
 /begin AXIS_DESCR STD_AXIS zff_atsys._.iSignale._.obj.sig_c_getr UMR_GRADC__1_1_M40_S6_S3 10 -40 150 DEPOSIT ABSOLUTE MONOTONY MON_INCREASE /end AXIS_DESCR
/end CHARACTERISTIC
/begin CHARACTERISTIC KL_TSYNMTRAKZUSP57 "Zeit vor sync. Ende Schaltdruck/Start 3. Rampe KZU" CURVE 0x256024 kl_ui8_S6_S3 1280 UMR_MSEC__10_1_M128_S6_S3 -1280 0
 /begin AXIS_DESCR STD_AXIS zff_atsys._.iSignale._.obj.sig_m_t8 UMR_NM__8_1_M50_S6_S3 4 -400 1640 DEPOSIT ABSOLUTE MONOTONY MON_INCREASE /end AXIS_DESCR
/end CHARACTERISTIC
/begin CHARACTERISTIC KF_TFCGNTSP57 "Fuellzeit" MAP 0x256030 kf_ui8_S6_S3 2540 UMR_MSEC__10_1_0_S6_S3 0 2540
 /begin AXIS_DESCR STD_AXIS zff_atsys._.iSignale._.obj.sig_c_getr UMR_GRADC__1_1_M40_S6_S3 6 -40 150 DEPOSIT ABSOLUTE MONOTONY MON_INCREASE /end AXIS_DESCR
 /begin AXIS_DESCR STD_AXIS zff_atsys._.iSignale._.obj.sig_n_t8 UMR_U_MIN_32_1_0_S6_S3 3 0 8160 DEPOSIT ABSOLUTE MONOTONY MON_INCREASE /end AXIS_DESCR
/end CHARACTERISTIC
/begin CHARACTERISTIC T_VKZUSP57 "Verzoegerungszeit zuschaltende Kupplung nach Schaltbeginn" VALUE 0x26E8B9 kw_ui8_S6_S3 2540 UMR_MSEC__10_1_0_S6_S3 0 2540 /end CHARACTERISTIC
/begin CHARACTERISTIC KF_POFMTNSP57 "Kennfeld Fuelldruckoffset(n_t, m_t)" MAP 0x256054 kf_si16_S6_S3 12.75 UMR_BAR__1_1000_0_S6_S3 -6.4 6.35
 /begin AXIS_DESCR STD_AXIS zff_atsys._.iSignale._.obj.sig_n_t UMR_U_MIN_1_1_0_S6_S3 4 0 8160 DEPOSIT ABSOLUTE MONOTONY MON_INCREASE /end AXIS_DESCR
 /begin AXIS_DESCR STD_AXIS zff_atsys._.iSignale._.obj.sig_m_t UMR_NM__1_1_0_S6_S3 6 -400 1640 DEPOSIT ABSOLUTE MONOTONY MON_INCREASE /end AXIS_DESCR
/end CHARACTERISTIC
/begin CHARACTERISTIC KF_T_DT_IG_CHANGESP57 "Kennfeld Zeitvorhalt für Übergabe Rampenzeit auf Schaltdruck" MAP 0x2560A0 kf_si16_S6_S3 5080 UMR_MSEC__10_1_0_S6_S3 -2540 2540
 /begin AXIS_DESCR STD_AXIS zff_atsys._.iSignale._.obj.sig_n_t UMR_U_MIN_1_1_0_S6_S3 4 0 8160 DEPOSIT ABSOLUTE MONOTONY MON_INCREASE /end AXIS_DESCR
 /begin AXIS_DESCR STD_AXIS zff_atsys._.iSignale._.obj.sig_m_t UMR_NM__1_1_0_S6_S3 4 -400 1640 DEPOSIT ABSOLUTE MONOTONY MON_INCREASE /end AXIS_DESCR
/end CHARACTERISTIC
/begin CHARACTERISTIC KF_T2_DT_IG_CHANGESP57 "2. Kennfeld Zeitvorhalt für Übergabe Rampenzeit auf Schaltdruck" MAP 0x2560D8 kf_si16_S6_S3 5080 UMR_MSEC__10_1_0_S6_S3 -2540 2540
 /begin AXIS_DESCR STD_AXIS zff_atsys._.iSignale._.obj.sig_n_t UMR_U_MIN_1_1_0_S6_S3 4 0 8160 DEPOSIT ABSOLUTE MONOTONY MON_INCREASE /end AXIS_DESCR
 /begin AXIS_DESCR STD_AXIS zff_atsys._.iSignale._.obj.sig_m_t UMR_NM__1_1_0_S6_S3 4 -400 1640 DEPOSIT ABSOLUTE MONOTONY MON_INCREASE /end AXIS_DESCR
/end CHARACTERISTIC
/begin CHARACTERISTIC KF_TRAMTNTSP57 "Zeit 1. Rampe der zuschaltenden Kupplung" MAP 0x256110 kf_ui8_S6_S3 2540 UMR_MSEC__10_1_0_S6_S3 0 2540
 /begin AXIS_DESCR STD_AXIS zff_atsys._.iSignale._.obj.sig_m_t8 UMR_NM__8_1_M50_S6_S3 4 -400 1640 DEPOSIT ABSOLUTE MONOTONY MON_INCREASE /end AXIS_DESCR
 /begin AXIS_DESCR STD_AXIS zff_atsys._.iSignale._.obj.sig_n_t8 UMR_U_MIN_32_1_0_S6_S3 4 0 8160 DEPOSIT ABSOLUTE MONOTONY MON_INCREASE /end AXIS_DESCR
/end CHARACTERISTIC
/begin CHARACTERISTIC KF_PKZUSP57 "Schaltdruck zuschaltende Kupplung" MAP 0x256130 kf_si16_S6_S3 12.75 UMR_BAR__1_1000_0_S6_S3 0 12.75
 /begin AXIS_DESCR STD_AXIS iSasZentr.iSchaltend.n_tkf UMR_U_MIN_32_1_0_S6_S3 8 0 8160 DEPOSIT ABSOLUTE MONOTONY MON_INCREASE /end AXIS_DESCR
 /begin AXIS_DESCR STD_AXIS zff_atsys._.iSignale._.obj.sig_m_t UMR_NM__1_1_0_S6_S3 10 -400 1640 DEPOSIT ABSOLUTE MONOTONY MON_INCREASE /end AXIS_DESCR
/end CHARACTERISTIC
/begin CHARACTERISTIC F_PRASP57 "Druckfaktor waehrend Rampe auf Schaltdruck" VALUE 0x26E8BA kw_ui8_S6_S3 1 UMR___1_100_0_S6_S3 0 1 /end CHARACTERISTIC
/begin CHARACTERISTIC F_TRASP57 "Zeitfaktor waehrend Rampe auf Schaltdruck" VALUE 0x26E8BB kw_ui8_S6_S3 1 UMR___1_100_0_S6_S3 0 1 /end CHARACTERISTIC
/begin CHARACTERISTIC KF_PGOKZUMTNTSP57 "Schaltdruckgradient" MAP 0x2561FC kf_si16_S6_S3 200 UMR_BAR_SEC_1_10_0_S6_S3 -100 100
 /begin AXIS_DESCR STD_AXIS zff_atsys._.iSignale._.obj.sig_m_t UMR_NM__1_1_0_S6_S3 6 -400 1640 DEPOSIT ABSOLUTE MONOTONY MON_INCREASE /end AXIS_DESCR
 /begin AXIS_DESCR STD_AXIS zff_atsys._.iSignale._.obj.sig_n_t UMR_U_MIN_1_1_0_S6_S3 4 0 8160 DEPOSIT ABSOLUTE MONOTONY MON_INCREASE /end AXIS_DESCR
/end CHARACTERISTIC
/begin CHARACTERISTIC KF_POKZUMTCGSP57 "Schaltdruckoffset" MAP 0x256248 kf_si16_S6_S3 12.75 UMR_BAR__1_1000_0_S6_S3 -6.4 6.35
 /begin AXIS_DESCR STD_AXIS zff_atsys._.iSignale._.obj.sig_m_t UMR_NM__1_1_0_S6_S3 8 -400 1640 DEPOSIT ABSOLUTE MONOTONY MON_INCREASE /end AXIS_DESCR
 /begin AXIS_DESCR STD_AXIS zff_atsys._.iSignale._.obj.sig_c_getr UMR_GRADC__1_1_M40_S6_S3 10 -40 150 DEPOSIT ABSOLUTE MONOTONY MON_INCREASE /end AXIS_DESCR
/end CHARACTERISTIC
/begin CHARACTERISTIC KL_TSYNMTRAKZUSP68 "Zeit vor sync. Ende Schaltdruck/Start 3. Rampe KZU" CURVE 0x256314 kl_ui8_S6_S3 1280 UMR_MSEC__10_1_M128_S6_S3 -1280 0
 /begin AXIS_DESCR STD_AXIS zff_atsys._.iSignale._.obj.sig_m_t8 UMR_NM__8_1_M50_S6_S3 4 -400 1640 DEPOSIT ABSOLUTE MONOTONY MON_INCREASE /end AXIS_DESCR
/end CHARACTERISTIC
/begin CHARACTERISTIC KF_TFCGNTSP68 "Fuellzeit" MAP 0x256320 kf_ui8_S6_S3 2540 UMR_MSEC__10_1_0_S6_S3 0 2540
 /begin AXIS_DESCR STD_AXIS zff_atsys._.iSignale._.obj.sig_c_getr UMR_GRADC__1_1_M40_S6_S3 6 -40 150 DEPOSIT ABSOLUTE MONOTONY MON_INCREASE /end AXIS_DESCR
 /begin AXIS_DESCR STD_AXIS zff_atsys._.iSignale._.obj.sig_n_t8 UMR_U_MIN_32_1_0_S6_S3 3 0 8160 DEPOSIT ABSOLUTE MONOTONY MON_INCREASE /end AXIS_DESCR
/end CHARACTERISTIC
/begin CHARACTERISTIC T_VKZUSP68 "Verzoegerungszeit zuschaltende Kupplung nach Schaltbeginn" VALUE 0x26E8BC kw_ui8_S6_S3 2540 UMR_MSEC__10_1_0_S6_S3 0 2540 /end CHARACTERISTIC
/begin CHARACTERISTIC KF_POFMTNSP68 "Kennfeld Fuelldruckoffset(n_t, m_t)" MAP 0x256344 kf_si16_S6_S3 12.75 UMR_BAR__1_1000_0_S6_S3 -6.4 6.35
 /begin AXIS_DESCR STD_AXIS zff_atsys._.iSignale._.obj.sig_n_t UMR_U_MIN_1_1_0_S6_S3 4 0 8160 DEPOSIT ABSOLUTE MONOTONY MON_INCREASE /end AXIS_DESCR
 /begin AXIS_DESCR STD_AXIS zff_atsys._.iSignale._.obj.sig_m_t UMR_NM__1_1_0_S6_S3 6 -400 1640 DEPOSIT ABSOLUTE MONOTONY MON_INCREASE /end AXIS_DESCR
/end CHARACTERISTIC
/begin CHARACTERISTIC KF_T_DT_IG_CHANGESP68 "Kennfeld Zeitvorhalt für Übergabe Rampenzeit auf Schaltdruck" MAP 0x256390 kf_si16_S6_S3 5080 UMR_MSEC__10_1_0_S6_S3 -2540 2540
 /begin AXIS_DESCR STD_AXIS zff_atsys._.iSignale._.obj.sig_n_t UMR_U_MIN_1_1_0_S6_S3 4 0 8160 DEPOSIT ABSOLUTE MONOTONY MON_INCREASE /end AXIS_DESCR
 /begin AXIS_DESCR STD_AXIS zff_atsys._.iSignale._.obj.sig_m_t UMR_NM__1_1_0_S6_S3 4 -400 1640 DEPOSIT ABSOLUTE MONOTONY MON_INCREASE /end AXIS_DESCR
/end CHARACTERISTIC
/begin CHARACTERISTIC KF_T2_DT_IG_CHANGESP68 "2. Kennfeld Zeitvorhalt für Übergabe Rampenzeit auf Schaltdruck" MAP 0x2563C8 kf_si16_S6_S3 5080 UMR_MSEC__10_1_0_S6_S3 -2540 2540
 /begin AXIS_DESCR STD_AXIS zff_atsys._.iSignale._.obj.sig_n_t UMR_U_MIN_1_1_0_S6_S3 4 0 8160 DEPOSIT ABSOLUTE MONOTONY MON_INCREASE /end AXIS_DESCR
 /begin AXIS_DESCR STD_AXIS zff_atsys._.iSignale._.obj.sig_m_t UMR_NM__1_1_0_S6_S3 4 -400 1640 DEPOSIT ABSOLUTE MONOTONY MON_INCREASE /end AXIS_DESCR
/end CHARACTERISTIC
/begin CHARACTERISTIC KF_TRAMTNTSP68 "Zeit 1. Rampe der zuschaltenden Kupplung" MAP 0x256400 kf_ui8_S6_S3 2540 UMR_MSEC__10_1_0_S6_S3 0 2540
 /begin AXIS_DESCR STD_AXIS zff_atsys._.iSignale._.obj.sig_m_t8 UMR_NM__8_1_M50_S6_S3 4 -400 1640 DEPOSIT ABSOLUTE MONOTONY MON_INCREASE /end AXIS_DESCR
 /begin AXIS_DESCR STD_AXIS zff_atsys._.iSignale._.obj.sig_n_t8 UMR_U_MIN_32_1_0_S6_S3 4 0 8160 DEPOSIT ABSOLUTE MONOTONY MON_INCREASE /end AXIS_DESCR
/end CHARACTERISTIC
/begin CHARACTERISTIC KF_PKZUSP68 "Schaltdruck zuschaltende Kupplung" MAP 0x256420 kf_si16_S6_S3 12.75 UMR_BAR__1_1000_0_S6_S3 0 12.75
 /begin AXIS_DESCR STD_AXIS iSasZentr.iSchaltend.n_tkf UMR_U_MIN_32_1_0_S6_S3 8 0 8160 DEPOSIT ABSOLUTE MONOTONY MON_INCREASE /end AXIS_DESCR
 /begin AXIS_DESCR STD_AXIS zff_atsys._.iSignale._.obj.sig_m_t UMR_NM__1_1_0_S6_S3 10 -400 1640 DEPOSIT ABSOLUTE MONOTONY MON_INCREASE /end AXIS_DESCR
/end CHARACTERISTIC
/begin CHARACTERISTIC F_PRASP68 "Druckfaktor waehrend Rampe auf Schaltdruck" VALUE 0x26E8BD kw_ui8_S6_S3 1 UMR___1_100_0_S6_S3 0 1 /end CHARACTERISTIC
/begin CHARACTERISTIC F_TRASP68 "Zeitfaktor waehrend Rampe auf Schaltdruck" VALUE 0x26E8BE kw_ui8_S6_S3 1 UMR___1_100_0_S6_S3 0 1 /end CHARACTERISTIC
/begin CHARACTERISTIC KF_PGOKZUMTNTSP68 "Schaltdruckgradient" MAP 0x2564EC kf_si16_S6_S3 200 UMR_BAR_SEC_1_10_0_S6_S3 -100 100
 /begin AXIS_DESCR STD_AXIS zff_atsys._.iSignale._.obj.sig_m_t UMR_NM__1_1_0_S6_S3 6 -400 1640 DEPOSIT ABSOLUTE MONOTONY MON_INCREASE /end AXIS_DESCR
 /begin AXIS_DESCR STD_AXIS zff_atsys._.iSignale._.obj.sig_n_t UMR_U_MIN_1_1_0_S6_S3 4 0 8160 DEPOSIT ABSOLUTE MONOTONY MON_INCREASE /end AXIS_DESCR
/end CHARACTERISTIC
/begin CHARACTERISTIC KF_POKZUMTCGSP68 "Schaltdruckoffset" MAP 0x256538 kf_si16_S6_S3 12.75 UMR_BAR__1_1000_0_S6_S3 -6.4 6.35
 /begin AXIS_DESCR STD_AXIS zff_atsys._.iSignale._.obj.sig_m_t UMR_NM__1_1_0_S6_S3 8 -400 1640 DEPOSIT ABSOLUTE MONOTONY MON_INCREASE /end AXIS_DESCR
 /begin AXIS_DESCR STD_AXIS zff_atsys._.iSignale._.obj.sig_c_getr UMR_GRADC__1_1_M40_S6_S3 10 -40 150 DEPOSIT ABSOLUTE MONOTONY MON_INCREASE /end AXIS_DESCR
/end CHARACTERISTIC
/begin CHARACTERISTIC KL_TSYNMTRAKZUSPORT13 "Zeit vor sync. Ende Schaltdruck/Start 3. Rampe KZU" CURVE 0x256604 kl_ui8_S6_S3 1280 UMR_MSEC__10_1_M128_S6_S3 -1280 0
 /begin AXIS_DESCR STD_AXIS zff_atsys._.iSignale._.obj.sig_m_t8 UMR_NM__8_1_M50_S6_S3 4 -400 1640 DEPOSIT ABSOLUTE MONOTONY MON_INCREASE /end AXIS_DESCR
/end CHARACTERISTIC
/begin CHARACTERISTIC KF_TFCGNTSPORT13 "Fuellzeit" MAP 0x256610 kf_ui8_S6_S3 2540 UMR_MSEC__10_1_0_S6_S3 0 2540
 /begin AXIS_DESCR STD_AXIS zff_atsys._.iSignale._.obj.sig_c_getr UMR_GRADC__1_1_M40_S6_S3 6 -40 150 DEPOSIT ABSOLUTE MONOTONY MON_INCREASE /end AXIS_DESCR
 /begin AXIS_DESCR STD_AXIS zff_atsys._.iSignale._.obj.sig_n_t8 UMR_U_MIN_32_1_0_S6_S3 3 0 8160 DEPOSIT ABSOLUTE MONOTONY MON_INCREASE /end AXIS_DESCR
/end CHARACTERISTIC
/begin CHARACTERISTIC T_VKZUSPORT13 "Verzoegerungszeit zuschaltende Kupplung nach Schaltbeginn" VALUE 0x26E8BF kw_ui8_S6_S3 2540 UMR_MSEC__10_1_0_S6_S3 0 2540 /end CHARACTERISTIC
/begin CHARACTERISTIC KF_POFMTNSPORT13 "Kennfeld Fuelldruckoffset(n_t, m_t)" MAP 0x256634 kf_si16_S6_S3 12.75 UMR_BAR__1_1000_0_S6_S3 -6.4 6.35
 /begin AXIS_DESCR STD_AXIS zff_atsys._.iSignale._.obj.sig_n_t UMR_U_MIN_1_1_0_S6_S3 4 0 8160 DEPOSIT ABSOLUTE MONOTONY MON_INCREASE /end AXIS_DESCR
 /begin AXIS_DESCR STD_AXIS zff_atsys._.iSignale._.obj.sig_m_t UMR_NM__1_1_0_S6_S3 6 -400 1640 DEPOSIT ABSOLUTE MONOTONY MON_INCREASE /end AXIS_DESCR
/end CHARACTERISTIC
/begin CHARACTERISTIC KF_T_DT_IG_CHANGESPORT13 "Kennfeld Zeitvorhalt für Übergabe Rampenzeit auf Schaltdruck" MAP 0x256680 kf_si16_S6_S3 5080 UMR_MSEC__10_1_0_S6_S3 -2540 2540
 /begin AXIS_DESCR STD_AXIS zff_atsys._.iSignale._.obj.sig_n_t UMR_U_MIN_1_1_0_S6_S3 4 0 8160 DEPOSIT ABSOLUTE MONOTONY MON_INCREASE /end AXIS_DESCR
 /begin AXIS_DESCR STD_AXIS zff_atsys._.iSignale._.obj.sig_m_t UMR_NM__1_1_0_S6_S3 4 -400 1640 DEPOSIT ABSOLUTE MONOTONY MON_INCREASE /end AXIS_DESCR
/end CHARACTERISTIC
/begin CHARACTERISTIC KF_T2_DT_IG_CHANGESPORT13 "2. Kennfeld Zeitvorhalt für Übergabe Rampenzeit auf Schaltdruck" MAP 0x2566B8 kf_si16_S6_S3 5080 UMR_MSEC__10_1_0_S6_S3 -2540 2540
 /begin AXIS_DESCR STD_AXIS zff_atsys._.iSignale._.obj.sig_n_t UMR_U_MIN_1_1_0_S6_S3 4 0 8160 DEPOSIT ABSOLUTE MONOTONY MON_INCREASE /end AXIS_DESCR
 /begin AXIS_DESCR STD_AXIS zff_atsys._.iSignale._.obj.sig_m_t UMR_NM__1_1_0_S6_S3 4 -400 1640 DEPOSIT ABSOLUTE MONOTONY MON_INCREASE /end AXIS_DESCR
/end CHARACTERISTIC
/begin CHARACTERISTIC KF_TRAMTNTSPORT13 "Zeit 1. Rampe der zuschaltenden Kupplung" MAP 0x2566F0 kf_ui8_S6_S3 2540 UMR_MSEC__10_1_0_S6_S3 0 2540
 /begin AXIS_DESCR STD_AXIS zff_atsys._.iSignale._.obj.sig_m_t8 UMR_NM__8_1_M50_S6_S3 4 -400 1640 DEPOSIT ABSOLUTE MONOTONY MON_INCREASE /end AXIS_DESCR
 /begin AXIS_DESCR STD_AXIS zff_atsys._.iSignale._.obj.sig_n_t8 UMR_U_MIN_32_1_0_S6_S3 4 0 8160 DEPOSIT ABSOLUTE MONOTONY MON_INCREASE /end AXIS_DESCR
/end CHARACTERISTIC
/begin CHARACTERISTIC KF_PKZUSPORT13 "Schaltdruck zuschaltende Kupplung" MAP 0x256710 kf_si16_S6_S3 12.75 UMR_BAR__1_1000_0_S6_S3 0 12.75
 /begin AXIS_DESCR STD_AXIS iSasZentr.iSchaltend.n_tkf UMR_U_MIN_32_1_0_S6_S3 8 0 8160 DEPOSIT ABSOLUTE MONOTONY MON_INCREASE /end AXIS_DESCR
 /begin AXIS_DESCR STD_AXIS zff_atsys._.iSignale._.obj.sig_m_t UMR_NM__1_1_0_S6_S3 10 -400 1640 DEPOSIT ABSOLUTE MONOTONY MON_INCREASE /end AXIS_DESCR
/end CHARACTERISTIC
/begin CHARACTERISTIC F_PRASPORT13 "Druckfaktor waehrend Rampe auf Schaltdruck" VALUE 0x26E8C0 kw_ui8_S6_S3 1 UMR___1_100_0_S6_S3 0 1 /end CHARACTERISTIC
/begin CHARACTERISTIC F_TRASPORT13 "Zeitfaktor waehrend Rampe auf Schaltdruck" VALUE 0x26E8C1 kw_ui8_S6_S3 1 UMR___1_100_0_S6_S3 0 1 /end CHARACTERISTIC
/begin CHARACTERISTIC KF_PGOKZUMTNTSPORT13 "Schaltdruckgradient" MAP 0x2567DC kf_si16_S6_S3 200 UMR_BAR_SEC_1_10_0_S6_S3 -100 100
 /begin AXIS_DESCR STD_AXIS zff_atsys._.iSignale._.obj.sig_m_t UMR_NM__1_1_0_S6_S3 6 -400 1640 DEPOSIT ABSOLUTE MONOTONY MON_INCREASE /end AXIS_DESCR
 /begin AXIS_DESCR STD_AXIS zff_atsys._.iSignale._.obj.sig_n_t UMR_U_MIN_1_1_0_S6_S3 4 0 8160 DEPOSIT ABSOLUTE MONOTONY MON_INCREASE /end AXIS_DESCR
/end CHARACTERISTIC
/begin CHARACTERISTIC KF_POKZUMTCGSPORT13 "Schaltdruckoffset" MAP 0x256828 kf_si16_S6_S3 12.75 UMR_BAR__1_1000_0_S6_S3 -6.4 6.35
 /begin AXIS_DESCR STD_AXIS zff_atsys._.iSignale._.obj.sig_m_t UMR_NM__1_1_0_S6_S3 8 -400 1640 DEPOSIT ABSOLUTE MONOTONY MON_INCREASE /end AXIS_DESCR
 /begin AXIS_DESCR STD_AXIS zff_atsys._.iSignale._.obj.sig_c_getr UMR_GRADC__1_1_M40_S6_S3 10 -40 150 DEPOSIT ABSOLUTE MONOTONY MON_INCREASE /end AXIS_DESCR
/end CHARACTERISTIC
/begin CHARACTERISTIC KL_TSYNMTRAKZUSPORT24 "Zeit vor sync. Ende Schaltdruck/Start 3. Rampe KZU" CURVE 0x2568F4 kl_ui8_S6_S3 1280 UMR_MSEC__10_1_M128_S6_S3 -1280 0
 /begin AXIS_DESCR STD_AXIS zff_atsys._.iSignale._.obj.sig_m_t8 UMR_NM__8_1_M50_S6_S3 4 -400 1640 DEPOSIT ABSOLUTE MONOTONY MON_INCREASE /end AXIS_DESCR
/end CHARACTERISTIC
/begin CHARACTERISTIC KF_TFCGNTSPORT24 "Fuellzeit" MAP 0x256900 kf_ui8_S6_S3 2540 UMR_MSEC__10_1_0_S6_S3 0 2540
 /begin AXIS_DESCR STD_AXIS zff_atsys._.iSignale._.obj.sig_c_getr UMR_GRADC__1_1_M40_S6_S3 6 -40 150 DEPOSIT ABSOLUTE MONOTONY MON_INCREASE /end AXIS_DESCR
 /begin AXIS_DESCR STD_AXIS zff_atsys._.iSignale._.obj.sig_n_t8 UMR_U_MIN_32_1_0_S6_S3 3 0 8160 DEPOSIT ABSOLUTE MONOTONY MON_INCREASE /end AXIS_DESCR
/end CHARACTERISTIC
/begin CHARACTERISTIC T_VKZUSPORT24 "Verzoegerungszeit zuschaltende Kupplung nach Schaltbeginn" VALUE 0x26E8C2 kw_ui8_S6_S3 2540 UMR_MSEC__10_1_0_S6_S3 0 2540 /end CHARACTERISTIC
/begin CHARACTERISTIC KF_POFMTNSPORT24 "Kennfeld Fuelldruckoffset(n_t, m_t)" MAP 0x256924 kf_si16_S6_S3 12.75 UMR_BAR__1_1000_0_S6_S3 -6.4 6.35
 /begin AXIS_DESCR STD_AXIS zff_atsys._.iSignale._.obj.sig_n_t UMR_U_MIN_1_1_0_S6_S3 4 0 8160 DEPOSIT ABSOLUTE MONOTONY MON_INCREASE /end AXIS_DESCR
 /begin AXIS_DESCR STD_AXIS zff_atsys._.iSignale._.obj.sig_m_t UMR_NM__1_1_0_S6_S3 6 -400 1640 DEPOSIT ABSOLUTE MONOTONY MON_INCREASE /end AXIS_DESCR
/end CHARACTERISTIC
/begin CHARACTERISTIC KF_T_DT_IG_CHANGESPORT24 "Kennfeld Zeitvorhalt für Übergabe Rampenzeit auf Schaltdruck" MAP 0x256970 kf_si16_S6_S3 5080 UMR_MSEC__10_1_0_S6_S3 -2540 2540
 /begin AXIS_DESCR STD_AXIS zff_atsys._.iSignale._.obj.sig_n_t UMR_U_MIN_1_1_0_S6_S3 4 0 8160 DEPOSIT ABSOLUTE MONOTONY MON_INCREASE /end AXIS_DESCR
 /begin AXIS_DESCR STD_AXIS zff_atsys._.iSignale._.obj.sig_m_t UMR_NM__1_1_0_S6_S3 4 -400 1640 DEPOSIT ABSOLUTE MONOTONY MON_INCREASE /end AXIS_DESCR
/end CHARACTERISTIC
/begin CHARACTERISTIC KF_T2_DT_IG_CHANGESPORT24 "2. Kennfeld Zeitvorhalt für Übergabe Rampenzeit auf Schaltdruck" MAP 0x2569A8 kf_si16_S6_S3 5080 UMR_MSEC__10_1_0_S6_S3 -2540 2540
 /begin AXIS_DESCR STD_AXIS zff_atsys._.iSignale._.obj.sig_n_t UMR_U_MIN_1_1_0_S6_S3 4 0 8160 DEPOSIT ABSOLUTE MONOTONY MON_INCREASE /end AXIS_DESCR
 /begin AXIS_DESCR STD_AXIS zff_atsys._.iSignale._.obj.sig_m_t UMR_NM__1_1_0_S6_S3 4 -400 1640 DEPOSIT ABSOLUTE MONOTONY MON_INCREASE /end AXIS_DESCR
/end CHARACTERISTIC
/begin CHARACTERISTIC KF_TRAMTNTSPORT24 "Zeit 1. Rampe der zuschaltenden Kupplung" MAP 0x2569E0 kf_ui8_S6_S3 2540 UMR_MSEC__10_1_0_S6_S3 0 2540
 /begin AXIS_DESCR STD_AXIS zff_atsys._.iSignale._.obj.sig_m_t8 UMR_NM__8_1_M50_S6_S3 4 -400 1640 DEPOSIT ABSOLUTE MONOTONY MON_INCREASE /end AXIS_DESCR
 /begin AXIS_DESCR STD_AXIS zff_atsys._.iSignale._.obj.sig_n_t8 UMR_U_MIN_32_1_0_S6_S3 4 0 8160 DEPOSIT ABSOLUTE MONOTONY MON_INCREASE /end AXIS_DESCR
/end CHARACTERISTIC
/begin CHARACTERISTIC KF_PKZUSPORT24 "Schaltdruck zuschaltende Kupplung" MAP 0x256A00 kf_si16_S6_S3 12.75 UMR_BAR__1_1000_0_S6_S3 0 12.75
 /begin AXIS_DESCR STD_AXIS iSasZentr.iSchaltend.n_tkf UMR_U_MIN_32_1_0_S6_S3 8 0 8160 DEPOSIT ABSOLUTE MONOTONY MON_INCREASE /end AXIS_DESCR
 /begin AXIS_DESCR STD_AXIS zff_atsys._.iSignale._.obj.sig_m_t UMR_NM__1_1_0_S6_S3 10 -400 1640 DEPOSIT ABSOLUTE MONOTONY MON_INCREASE /end AXIS_DESCR
/end CHARACTERISTIC
/begin CHARACTERISTIC F_PRASPORT24 "Druckfaktor waehrend Rampe auf Schaltdruck" VALUE 0x26E8C3 kw_ui8_S6_S3 1 UMR___1_100_0_S6_S3 0 1 /end CHARACTERISTIC
/begin CHARACTERISTIC F_TRASPORT24 "Zeitfaktor waehrend Rampe auf Schaltdruck" VALUE 0x26E8C4 kw_ui8_S6_S3 1 UMR___1_100_0_S6_S3 0 1 /end CHARACTERISTIC
/begin CHARACTERISTIC KF_PGOKZUMTNTSPORT24 "Schaltdruckgradient" MAP 0x256ACC kf_si16_S6_S3 200 UMR_BAR_SEC_1_10_0_S6_S3 -100 100
 /begin AXIS_DESCR STD_AXIS zff_atsys._.iSignale._.obj.sig_m_t UMR_NM__1_1_0_S6_S3 6 -400 1640 DEPOSIT ABSOLUTE MONOTONY MON_INCREASE /end AXIS_DESCR
 /begin AXIS_DESCR STD_AXIS zff_atsys._.iSignale._.obj.sig_n_t UMR_U_MIN_1_1_0_S6_S3 4 0 8160 DEPOSIT ABSOLUTE MONOTONY MON_INCREASE /end AXIS_DESCR
/end CHARACTERISTIC
/begin CHARACTERISTIC KF_POKZUMTCGSPORT24 "Schaltdruckoffset" MAP 0x256B18 kf_si16_S6_S3 12.75 UMR_BAR__1_1000_0_S6_S3 -6.4 6.35
 /begin AXIS_DESCR STD_AXIS zff_atsys._.iSignale._.obj.sig_m_t UMR_NM__1_1_0_S6_S3 8 -400 1640 DEPOSIT ABSOLUTE MONOTONY MON_INCREASE /end AXIS_DESCR
 /begin AXIS_DESCR STD_AXIS zff_atsys._.iSignale._.obj.sig_c_getr UMR_GRADC__1_1_M40_S6_S3 10 -40 150 DEPOSIT ABSOLUTE MONOTONY MON_INCREASE /end AXIS_DESCR
/end CHARACTERISTIC
/begin CHARACTERISTIC KL_TSYNMTRAKZUSPORT35 "Zeit vor sync. Ende Schaltdruck/Start 3. Rampe KZU" CURVE 0x256BE4 kl_ui8_S6_S3 1280 UMR_MSEC__10_1_M128_S6_S3 -1280 0
 /begin AXIS_DESCR STD_AXIS zff_atsys._.iSignale._.obj.sig_m_t8 UMR_NM__8_1_M50_S6_S3 4 -400 1640 DEPOSIT ABSOLUTE MONOTONY MON_INCREASE /end AXIS_DESCR
/end CHARACTERISTIC
/begin CHARACTERISTIC KF_TFCGNTSPORT35 "Fuellzeit" MAP 0x256BF0 kf_ui8_S6_S3 2540 UMR_MSEC__10_1_0_S6_S3 0 2540
 /begin AXIS_DESCR STD_AXIS zff_atsys._.iSignale._.obj.sig_c_getr UMR_GRADC__1_1_M40_S6_S3 6 -40 150 DEPOSIT ABSOLUTE MONOTONY MON_INCREASE /end AXIS_DESCR
 /begin AXIS_DESCR STD_AXIS zff_atsys._.iSignale._.obj.sig_n_t8 UMR_U_MIN_32_1_0_S6_S3 3 0 8160 DEPOSIT ABSOLUTE MONOTONY MON_INCREASE /end AXIS_DESCR
/end CHARACTERISTIC
/begin CHARACTERISTIC T_VKZUSPORT35 "Verzoegerungszeit zuschaltende Kupplung nach Schaltbeginn" VALUE 0x26E8C5 kw_ui8_S6_S3 2540 UMR_MSEC__10_1_0_S6_S3 0 2540 /end CHARACTERISTIC
/begin CHARACTERISTIC KF_POFMTNSPORT35 "Kennfeld Fuelldruckoffset(n_t, m_t)" MAP 0x256C14 kf_si16_S6_S3 12.75 UMR_BAR__1_1000_0_S6_S3 -6.4 6.35
 /begin AXIS_DESCR STD_AXIS zff_atsys._.iSignale._.obj.sig_n_t UMR_U_MIN_1_1_0_S6_S3 4 0 8160 DEPOSIT ABSOLUTE MONOTONY MON_INCREASE /end AXIS_DESCR
 /begin AXIS_DESCR STD_AXIS zff_atsys._.iSignale._.obj.sig_m_t UMR_NM__1_1_0_S6_S3 6 -400 1640 DEPOSIT ABSOLUTE MONOTONY MON_INCREASE /end AXIS_DESCR
/end CHARACTERISTIC
/begin CHARACTERISTIC KF_T_DT_IG_CHANGESPORT35 "Kennfeld Zeitvorhalt für Übergabe Rampenzeit auf Schaltdruck" MAP 0x256C60 kf_si16_S6_S3 5080 UMR_MSEC__10_1_0_S6_S3 -2540 2540
 /begin AXIS_DESCR STD_AXIS zff_atsys._.iSignale._.obj.sig_n_t UMR_U_MIN_1_1_0_S6_S3 4 0 8160 DEPOSIT ABSOLUTE MONOTONY MON_INCREASE /end AXIS_DESCR
 /begin AXIS_DESCR STD_AXIS zff_atsys._.iSignale._.obj.sig_m_t UMR_NM__1_1_0_S6_S3 4 -400 1640 DEPOSIT ABSOLUTE MONOTONY MON_INCREASE /end AXIS_DESCR
/end CHARACTERISTIC
/begin CHARACTERISTIC KF_T2_DT_IG_CHANGESPORT35 "2. Kennfeld Zeitvorhalt für Übergabe Rampenzeit auf Schaltdruck" MAP 0x256C98 kf_si16_S6_S3 5080 UMR_MSEC__10_1_0_S6_S3 -2540 2540
 /begin AXIS_DESCR STD_AXIS zff_atsys._.iSignale._.obj.sig_n_t UMR_U_MIN_1_1_0_S6_S3 4 0 8160 DEPOSIT ABSOLUTE MONOTONY MON_INCREASE /end AXIS_DESCR
 /begin AXIS_DESCR STD_AXIS zff_atsys._.iSignale._.obj.sig_m_t UMR_NM__1_1_0_S6_S3 4 -400 1640 DEPOSIT ABSOLUTE MONOTONY MON_INCREASE /end AXIS_DESCR
/end CHARACTERISTIC
/begin CHARACTERISTIC KF_TRAMTNTSPORT35 "Zeit 1. Rampe der zuschaltenden Kupplung" MAP 0x256CD0 kf_ui8_S6_S3 2540 UMR_MSEC__10_1_0_S6_S3 0 2540
 /begin AXIS_DESCR STD_AXIS zff_atsys._.iSignale._.obj.sig_m_t8 UMR_NM__8_1_M50_S6_S3 4 -400 1640 DEPOSIT ABSOLUTE MONOTONY MON_INCREASE /end AXIS_DESCR
 /begin AXIS_DESCR STD_AXIS zff_atsys._.iSignale._.obj.sig_n_t8 UMR_U_MIN_32_1_0_S6_S3 4 0 8160 DEPOSIT ABSOLUTE MONOTONY MON_INCREASE /end AXIS_DESCR
/end CHARACTERISTIC
/begin CHARACTERISTIC KF_PKZUSPORT35 "Schaltdruck zuschaltende Kupplung" MAP 0x256CF0 kf_si16_S6_S3 12.75 UMR_BAR__1_1000_0_S6_S3 0 12.75
 /begin AXIS_DESCR STD_AXIS iSasZentr.iSchaltend.n_tkf UMR_U_MIN_32_1_0_S6_S3 8 0 8160 DEPOSIT ABSOLUTE MONOTONY MON_INCREASE /end AXIS_DESCR
 /begin AXIS_DESCR STD_AXIS zff_atsys._.iSignale._.obj.sig_m_t UMR_NM__1_1_0_S6_S3 10 -400 1640 DEPOSIT ABSOLUTE MONOTONY MON_INCREASE /end AXIS_DESCR
/end CHARACTERISTIC
/begin CHARACTERISTIC F_PRASPORT35 "Druckfaktor waehrend Rampe auf Schaltdruck" VALUE 0x26E8C6 kw_ui8_S6_S3 1 UMR___1_100_0_S6_S3 0 1 /end CHARACTERISTIC
/begin CHARACTERISTIC F_TRASPORT35 "Zeitfaktor waehrend Rampe auf Schaltdruck" VALUE 0x26E8C7 kw_ui8_S6_S3 1 UMR___1_100_0_S6_S3 0 1 /end CHARACTERISTIC
/begin CHARACTERISTIC KF_PGOKZUMTNTSPORT35 "Schaltdruckgradient" MAP 0x256DBC kf_si16_S6_S3 200 UMR_BAR_SEC_1_10_0_S6_S3 -100 100
 /begin AXIS_DESCR STD_AXIS zff_atsys._.iSignale._.obj.sig_m_t UMR_NM__1_1_0_S6_S3 6 -400 1640 DEPOSIT ABSOLUTE MONOTONY MON_INCREASE /end AXIS_DESCR
 /begin AXIS_DESCR STD_AXIS zff_atsys._.iSignale._.obj.sig_n_t UMR_U_MIN_1_1_0_S6_S3 4 0 8160 DEPOSIT ABSOLUTE MONOTONY MON_INCREASE /end AXIS_DESCR
/end CHARACTERISTIC
/begin CHARACTERISTIC KF_POKZUMTCGSPORT35 "Schaltdruckoffset" MAP 0x256E08 kf_si16_S6_S3 12.75 UMR_BAR__1_1000_0_S6_S3 -6.4 6.35
 /begin AXIS_DESCR STD_AXIS zff_atsys._.iSignale._.obj.sig_m_t UMR_NM__1_1_0_S6_S3 8 -400 1640 DEPOSIT ABSOLUTE MONOTONY MON_INCREASE /end AXIS_DESCR
 /begin AXIS_DESCR STD_AXIS zff_atsys._.iSignale._.obj.sig_c_getr UMR_GRADC__1_1_M40_S6_S3 10 -40 150 DEPOSIT ABSOLUTE MONOTONY MON_INCREASE /end AXIS_DESCR
/end CHARACTERISTIC
/begin CHARACTERISTIC KL_TSYNMTRAKZUSPORT46 "Zeit vor sync. Ende Schaltdruck/Start 3. Rampe KZU" CURVE 0x256ED4 kl_ui8_S6_S3 1280 UMR_MSEC__10_1_M128_S6_S3 -1280 0
 /begin AXIS_DESCR STD_AXIS zff_atsys._.iSignale._.obj.sig_m_t8 UMR_NM__8_1_M50_S6_S3 4 -400 1640 DEPOSIT ABSOLUTE MONOTONY MON_INCREASE /end AXIS_DESCR
/end CHARACTERISTIC
/begin CHARACTERISTIC KF_TFCGNTSPORT46 "Fuellzeit" MAP 0x256EE0 kf_ui8_S6_S3 2540 UMR_MSEC__10_1_0_S6_S3 0 2540
 /begin AXIS_DESCR STD_AXIS zff_atsys._.iSignale._.obj.sig_c_getr UMR_GRADC__1_1_M40_S6_S3 6 -40 150 DEPOSIT ABSOLUTE MONOTONY MON_INCREASE /end AXIS_DESCR
 /begin AXIS_DESCR STD_AXIS zff_atsys._.iSignale._.obj.sig_n_t8 UMR_U_MIN_32_1_0_S6_S3 3 0 8160 DEPOSIT ABSOLUTE MONOTONY MON_INCREASE /end AXIS_DESCR
/end CHARACTERISTIC
/begin CHARACTERISTIC T_VKZUSPORT46 "Verzoegerungszeit zuschaltende Kupplung nach Schaltbeginn" VALUE 0x26E8C8 kw_ui8_S6_S3 2540 UMR_MSEC__10_1_0_S6_S3 0 2540 /end CHARACTERISTIC
/begin CHARACTERISTIC KF_POFMTNSPORT46 "Kennfeld Fuelldruckoffset(n_t, m_t)" MAP 0x256F04 kf_si16_S6_S3 12.75 UMR_BAR__1_1000_0_S6_S3 -6.4 6.35
 /begin AXIS_DESCR STD_AXIS zff_atsys._.iSignale._.obj.sig_n_t UMR_U_MIN_1_1_0_S6_S3 4 0 8160 DEPOSIT ABSOLUTE MONOTONY MON_INCREASE /end AXIS_DESCR
 /begin AXIS_DESCR STD_AXIS zff_atsys._.iSignale._.obj.sig_m_t UMR_NM__1_1_0_S6_S3 6 -400 1640 DEPOSIT ABSOLUTE MONOTONY MON_INCREASE /end AXIS_DESCR
/end CHARACTERISTIC
/begin CHARACTERISTIC KF_T_DT_IG_CHANGESPORT46 "Kennfeld Zeitvorhalt für Übergabe Rampenzeit auf Schaltdruck" MAP 0x256F50 kf_si16_S6_S3 5080 UMR_MSEC__10_1_0_S6_S3 -2540 2540
 /begin AXIS_DESCR STD_AXIS zff_atsys._.iSignale._.obj.sig_n_t UMR_U_MIN_1_1_0_S6_S3 4 0 8160 DEPOSIT ABSOLUTE MONOTONY MON_INCREASE /end AXIS_DESCR
 /begin AXIS_DESCR STD_AXIS zff_atsys._.iSignale._.obj.sig_m_t UMR_NM__1_1_0_S6_S3 4 -400 1640 DEPOSIT ABSOLUTE MONOTONY MON_INCREASE /end AXIS_DESCR
/end CHARACTERISTIC
/begin CHARACTERISTIC KF_T2_DT_IG_CHANGESPORT46 "2. Kennfeld Zeitvorhalt für Übergabe Rampenzeit auf Schaltdruck" MAP 0x256F88 kf_si16_S6_S3 5080 UMR_MSEC__10_1_0_S6_S3 -2540 2540
 /begin AXIS_DESCR STD_AXIS zff_atsys._.iSignale._.obj.sig_n_t UMR_U_MIN_1_1_0_S6_S3 4 0 8160 DEPOSIT ABSOLUTE MONOTONY MON_INCREASE /end AXIS_DESCR
 /begin AXIS_DESCR STD_AXIS zff_atsys._.iSignale._.obj.sig_m_t UMR_NM__1_1_0_S6_S3 4 -400 1640 DEPOSIT ABSOLUTE MONOTONY MON_INCREASE /end AXIS_DESCR
/end CHARACTERISTIC
/begin CHARACTERISTIC KF_TRAMTNTSPORT46 "Zeit 1. Rampe der zuschaltenden Kupplung" MAP 0x256FC0 kf_ui8_S6_S3 2540 UMR_MSEC__10_1_0_S6_S3 0 2540
 /begin AXIS_DESCR STD_AXIS zff_atsys._.iSignale._.obj.sig_m_t8 UMR_NM__8_1_M50_S6_S3 4 -400 1640 DEPOSIT ABSOLUTE MONOTONY MON_INCREASE /end AXIS_DESCR
 /begin AXIS_DESCR STD_AXIS zff_atsys._.iSignale._.obj.sig_n_t8 UMR_U_MIN_32_1_0_S6_S3 4 0 8160 DEPOSIT ABSOLUTE MONOTONY MON_INCREASE /end AXIS_DESCR
/end CHARACTERISTIC
/begin CHARACTERISTIC KF_PKZUSPORT46 "Schaltdruck zuschaltende Kupplung" MAP 0x256FE0 kf_si16_S6_S3 12.75 UMR_BAR__1_1000_0_S6_S3 0 12.75
 /begin AXIS_DESCR STD_AXIS iSasZentr.iSchaltend.n_tkf UMR_U_MIN_32_1_0_S6_S3 8 0 8160 DEPOSIT ABSOLUTE MONOTONY MON_INCREASE /end AXIS_DESCR
 /begin AXIS_DESCR STD_AXIS zff_atsys._.iSignale._.obj.sig_m_t UMR_NM__1_1_0_S6_S3 10 -400 1640 DEPOSIT ABSOLUTE MONOTONY MON_INCREASE /end AXIS_DESCR
/end CHARACTERISTIC
/begin CHARACTERISTIC F_PRASPORT46 "Druckfaktor waehrend Rampe auf Schaltdruck" VALUE 0x26E8C9 kw_ui8_S6_S3 1 UMR___1_100_0_S6_S3 0 1 /end CHARACTERISTIC
/begin CHARACTERISTIC F_TRASPORT46 "Zeitfaktor waehrend Rampe auf Schaltdruck" VALUE 0x26E8CA kw_ui8_S6_S3 1 UMR___1_100_0_S6_S3 0 1 /end CHARACTERISTIC
/begin CHARACTERISTIC KF_PGOKZUMTNTSPORT46 "Schaltdruckgradient" MAP 0x2570AC kf_si16_S6_S3 200 UMR_BAR_SEC_1_10_0_S6_S3 -100 100
 /begin AXIS_DESCR STD_AXIS zff_atsys._.iSignale._.obj.sig_m_t UMR_NM__1_1_0_S6_S3 6 -400 1640 DEPOSIT ABSOLUTE MONOTONY MON_INCREASE /end AXIS_DESCR
 /begin AXIS_DESCR STD_AXIS zff_atsys._.iSignale._.obj.sig_n_t UMR_U_MIN_1_1_0_S6_S3 4 0 8160 DEPOSIT ABSOLUTE MONOTONY MON_INCREASE /end AXIS_DESCR
/end CHARACTERISTIC
/begin CHARACTERISTIC KF_POKZUMTCGSPORT46 "Schaltdruckoffset" MAP 0x2570F8 kf_si16_S6_S3 12.75 UMR_BAR__1_1000_0_S6_S3 -6.4 6.35
 /begin AXIS_DESCR STD_AXIS zff_atsys._.iSignale._.obj.sig_m_t UMR_NM__1_1_0_S6_S3 8 -400 1640 DEPOSIT ABSOLUTE MONOTONY MON_INCREASE /end AXIS_DESCR
 /begin AXIS_DESCR STD_AXIS zff_atsys._.iSignale._.obj.sig_c_getr UMR_GRADC__1_1_M40_S6_S3 10 -40 150 DEPOSIT ABSOLUTE MONOTONY MON_INCREASE /end AXIS_DESCR
/end CHARACTERISTIC
/begin CHARACTERISTIC KL_TSYNMTRAKZUSPORT57 "Zeit vor sync. Ende Schaltdruck/Start 3. Rampe KZU" CURVE 0x2571C4 kl_ui8_S6_S3 1280 UMR_MSEC__10_1_M128_S6_S3 -1280 0
 /begin AXIS_DESCR STD_AXIS zff_atsys._.iSignale._.obj.sig_m_t8 UMR_NM__8_1_M50_S6_S3 4 -400 1640 DEPOSIT ABSOLUTE MONOTONY MON_INCREASE /end AXIS_DESCR
/end CHARACTERISTIC
/begin CHARACTERISTIC KF_TFCGNTSPORT57 "Fuellzeit" MAP 0x2571D0 kf_ui8_S6_S3 2540 UMR_MSEC__10_1_0_S6_S3 0 2540
 /begin AXIS_DESCR STD_AXIS zff_atsys._.iSignale._.obj.sig_c_getr UMR_GRADC__1_1_M40_S6_S3 6 -40 150 DEPOSIT ABSOLUTE MONOTONY MON_INCREASE /end AXIS_DESCR
 /begin AXIS_DESCR STD_AXIS zff_atsys._.iSignale._.obj.sig_n_t8 UMR_U_MIN_32_1_0_S6_S3 3 0 8160 DEPOSIT ABSOLUTE MONOTONY MON_INCREASE /end AXIS_DESCR
/end CHARACTERISTIC
/begin CHARACTERISTIC T_VKZUSPORT57 "Verzoegerungszeit zuschaltende Kupplung nach Schaltbeginn" VALUE 0x26E8CB kw_ui8_S6_S3 2540 UMR_MSEC__10_1_0_S6_S3 0 2540 /end CHARACTERISTIC
/begin CHARACTERISTIC KF_POFMTNSPORT57 "Kennfeld Fuelldruckoffset(n_t, m_t)" MAP 0x2571F4 kf_si16_S6_S3 12.75 UMR_BAR__1_1000_0_S6_S3 -6.4 6.35
 /begin AXIS_DESCR STD_AXIS zff_atsys._.iSignale._.obj.sig_n_t UMR_U_MIN_1_1_0_S6_S3 4 0 8160 DEPOSIT ABSOLUTE MONOTONY MON_INCREASE /end AXIS_DESCR
 /begin AXIS_DESCR STD_AXIS zff_atsys._.iSignale._.obj.sig_m_t UMR_NM__1_1_0_S6_S3 6 -400 1640 DEPOSIT ABSOLUTE MONOTONY MON_INCREASE /end AXIS_DESCR
/end CHARACTERISTIC
/begin CHARACTERISTIC KF_T_DT_IG_CHANGESPORT57 "Kennfeld Zeitvorhalt für Übergabe Rampenzeit auf Schaltdruck" MAP 0x257240 kf_si16_S6_S3 5080 UMR_MSEC__10_1_0_S6_S3 -2540 2540
 /begin AXIS_DESCR STD_AXIS zff_atsys._.iSignale._.obj.sig_n_t UMR_U_MIN_1_1_0_S6_S3 4 0 8160 DEPOSIT ABSOLUTE MONOTONY MON_INCREASE /end AXIS_DESCR
 /begin AXIS_DESCR STD_AXIS zff_atsys._.iSignale._.obj.sig_m_t UMR_NM__1_1_0_S6_S3 4 -400 1640 DEPOSIT ABSOLUTE MONOTONY MON_INCREASE /end AXIS_DESCR
/end CHARACTERISTIC
/begin CHARACTERISTIC KF_T2_DT_IG_CHANGESPORT57 "2. Kennfeld Zeitvorhalt für Übergabe Rampenzeit auf Schaltdruck" MAP 0x257278 kf_si16_S6_S3 5080 UMR_MSEC__10_1_0_S6_S3 -2540 2540
 /begin AXIS_DESCR STD_AXIS zff_atsys._.iSignale._.obj.sig_n_t UMR_U_MIN_1_1_0_S6_S3 4 0 8160 DEPOSIT ABSOLUTE MONOTONY MON_INCREASE /end AXIS_DESCR
 /begin AXIS_DESCR STD_AXIS zff_atsys._.iSignale._.obj.sig_m_t UMR_NM__1_1_0_S6_S3 4 -400 1640 DEPOSIT ABSOLUTE MONOTONY MON_INCREASE /end AXIS_DESCR
/end CHARACTERISTIC
/begin CHARACTERISTIC KF_TRAMTNTSPORT57 "Zeit 1. Rampe der zuschaltenden Kupplung" MAP 0x2572B0 kf_ui8_S6_S3 2540 UMR_MSEC__10_1_0_S6_S3 0 2540
 /begin AXIS_DESCR STD_AXIS zff_atsys._.iSignale._.obj.sig_m_t8 UMR_NM__8_1_M50_S6_S3 4 -400 1640 DEPOSIT ABSOLUTE MONOTONY MON_INCREASE /end AXIS_DESCR
 /begin AXIS_DESCR STD_AXIS zff_atsys._.iSignale._.obj.sig_n_t8 UMR_U_MIN_32_1_0_S6_S3 4 0 8160 DEPOSIT ABSOLUTE MONOTONY MON_INCREASE /end AXIS_DESCR
/end CHARACTERISTIC
/begin CHARACTERISTIC KF_PKZUSPORT57 "Schaltdruck zuschaltende Kupplung" MAP 0x2572D0 kf_si16_S6_S3 12.75 UMR_BAR__1_1000_0_S6_S3 0 12.75
 /begin AXIS_DESCR STD_AXIS iSasZentr.iSchaltend.n_tkf UMR_U_MIN_32_1_0_S6_S3 8 0 8160 DEPOSIT ABSOLUTE MONOTONY MON_INCREASE /end AXIS_DESCR
 /begin AXIS_DESCR STD_AXIS zff_atsys._.iSignale._.obj.sig_m_t UMR_NM__1_1_0_S6_S3 10 -400 1640 DEPOSIT ABSOLUTE MONOTONY MON_INCREASE /end AXIS_DESCR
/end CHARACTERISTIC
/begin CHARACTERISTIC F_PRASPORT57 "Druckfaktor waehrend Rampe auf Schaltdruck" VALUE 0x26E8CC kw_ui8_S6_S3 1 UMR___1_100_0_S6_S3 0 1 /end CHARACTERISTIC
/begin CHARACTERISTIC F_TRASPORT57 "Zeitfaktor waehrend Rampe auf Schaltdruck" VALUE 0x26E8CD kw_ui8_S6_S3 1 UMR___1_100_0_S6_S3 0 1 /end CHARACTERISTIC
/begin CHARACTERISTIC KF_PGOKZUMTNTSPORT57 "Schaltdruckgradient" MAP 0x25739C kf_si16_S6_S3 200 UMR_BAR_SEC_1_10_0_S6_S3 -100 100
 /begin AXIS_DESCR STD_AXIS zff_atsys._.iSignale._.obj.sig_m_t UMR_NM__1_1_0_S6_S3 6 -400 1640 DEPOSIT ABSOLUTE MONOTONY MON_INCREASE /end AXIS_DESCR
 /begin AXIS_DESCR STD_AXIS zff_atsys._.iSignale._.obj.sig_n_t UMR_U_MIN_1_1_0_S6_S3 4 0 8160 DEPOSIT ABSOLUTE MONOTONY MON_INCREASE /end AXIS_DESCR
/end CHARACTERISTIC
/begin CHARACTERISTIC KF_POKZUMTCGSPORT57 "Schaltdruckoffset" MAP 0x2573E8 kf_si16_S6_S3 12.75 UMR_BAR__1_1000_0_S6_S3 -6.4 6.35
 /begin AXIS_DESCR STD_AXIS zff_atsys._.iSignale._.obj.sig_m_t UMR_NM__1_1_0_S6_S3 8 -400 1640 DEPOSIT ABSOLUTE MONOTONY MON_INCREASE /end AXIS_DESCR
 /begin AXIS_DESCR STD_AXIS zff_atsys._.iSignale._.obj.sig_c_getr UMR_GRADC__1_1_M40_S6_S3 10 -40 150 DEPOSIT ABSOLUTE MONOTONY MON_INCREASE /end AXIS_DESCR
/end CHARACTERISTIC
/begin CHARACTERISTIC KL_TSYNMTRAKZUSPORT68 "Zeit vor sync. Ende Schaltdruck/Start 3. Rampe KZU" CURVE 0x2574B4 kl_ui8_S6_S3 1280 UMR_MSEC__10_1_M128_S6_S3 -1280 0
 /begin AXIS_DESCR STD_AXIS zff_atsys._.iSignale._.obj.sig_m_t8 UMR_NM__8_1_M50_S6_S3 4 -400 1640 DEPOSIT ABSOLUTE MONOTONY MON_INCREASE /end AXIS_DESCR
/end CHARACTERISTIC
/begin CHARACTERISTIC KF_TFCGNTSPORT68 "Fuellzeit" MAP 0x2574C0 kf_ui8_S6_S3 2540 UMR_MSEC__10_1_0_S6_S3 0 2540
 /begin AXIS_DESCR STD_AXIS zff_atsys._.iSignale._.obj.sig_c_getr UMR_GRADC__1_1_M40_S6_S3 6 -40 150 DEPOSIT ABSOLUTE MONOTONY MON_INCREASE /end AXIS_DESCR
 /begin AXIS_DESCR STD_AXIS zff_atsys._.iSignale._.obj.sig_n_t8 UMR_U_MIN_32_1_0_S6_S3 3 0 8160 DEPOSIT ABSOLUTE MONOTONY MON_INCREASE /end AXIS_DESCR
/end CHARACTERISTIC
/begin CHARACTERISTIC T_VKZUSPORT68 "Verzoegerungszeit zuschaltende Kupplung nach Schaltbeginn" VALUE 0x26E8CE kw_ui8_S6_S3 2540 UMR_MSEC__10_1_0_S6_S3 0 2540 /end CHARACTERISTIC
/begin CHARACTERISTIC KF_POFMTNSPORT68 "Kennfeld Fuelldruckoffset(n_t, m_t)" MAP 0x2574E4 kf_si16_S6_S3 12.75 UMR_BAR__1_1000_0_S6_S3 -6.4 6.35
 /begin AXIS_DESCR STD_AXIS zff_atsys._.iSignale._.obj.sig_n_t UMR_U_MIN_1_1_0_S6_S3 4 0 8160 DEPOSIT ABSOLUTE MONOTONY MON_INCREASE /end AXIS_DESCR
 /begin AXIS_DESCR STD_AXIS zff_atsys._.iSignale._.obj.sig_m_t UMR_NM__1_1_0_S6_S3 6 -400 1640 DEPOSIT ABSOLUTE MONOTONY MON_INCREASE /end AXIS_DESCR
/end CHARACTERISTIC
/begin CHARACTERISTIC KF_T_DT_IG_CHANGESPORT68 "Kennfeld Zeitvorhalt für Übergabe Rampenzeit auf Schaltdruck" MAP 0x257530 kf_si16_S6_S3 5080 UMR_MSEC__10_1_0_S6_S3 -2540 2540
 /begin AXIS_DESCR STD_AXIS zff_atsys._.iSignale._.obj.sig_n_t UMR_U_MIN_1_1_0_S6_S3 4 0 8160 DEPOSIT ABSOLUTE MONOTONY MON_INCREASE /end AXIS_DESCR
 /begin AXIS_DESCR STD_AXIS zff_atsys._.iSignale._.obj.sig_m_t UMR_NM__1_1_0_S6_S3 4 -400 1640 DEPOSIT ABSOLUTE MONOTONY MON_INCREASE /end AXIS_DESCR
/end CHARACTERISTIC
/begin CHARACTERISTIC KF_T2_DT_IG_CHANGESPORT68 "2. Kennfeld Zeitvorhalt für Übergabe Rampenzeit auf Schaltdruck" MAP 0x257568 kf_si16_S6_S3 5080 UMR_MSEC__10_1_0_S6_S3 -2540 2540
 /begin AXIS_DESCR STD_AXIS zff_atsys._.iSignale._.obj.sig_n_t UMR_U_MIN_1_1_0_S6_S3 4 0 8160 DEPOSIT ABSOLUTE MONOTONY MON_INCREASE /end AXIS_DESCR
 /begin AXIS_DESCR STD_AXIS zff_atsys._.iSignale._.obj.sig_m_t UMR_NM__1_1_0_S6_S3 4 -400 1640 DEPOSIT ABSOLUTE MONOTONY MON_INCREASE /end AXIS_DESCR
/end CHARACTERISTIC
/begin CHARACTERISTIC KF_TRAMTNTSPORT68 "Zeit 1. Rampe der zuschaltenden Kupplung" MAP 0x2575A0 kf_ui8_S6_S3 2540 UMR_MSEC__10_1_0_S6_S3 0 2540
 /begin AXIS_DESCR STD_AXIS zff_atsys._.iSignale._.obj.sig_m_t8 UMR_NM__8_1_M50_S6_S3 4 -400 1640 DEPOSIT ABSOLUTE MONOTONY MON_INCREASE /end AXIS_DESCR
 /begin AXIS_DESCR STD_AXIS zff_atsys._.iSignale._.obj.sig_n_t8 UMR_U_MIN_32_1_0_S6_S3 4 0 8160 DEPOSIT ABSOLUTE MONOTONY MON_INCREASE /end AXIS_DESCR
/end CHARACTERISTIC
/begin CHARACTERISTIC KF_PKZUSPORT68 "Schaltdruck zuschaltende Kupplung" MAP 0x2575C0 kf_si16_S6_S3 12.75 UMR_BAR__1_1000_0_S6_S3 0 12.75
 /begin AXIS_DESCR STD_AXIS iSasZentr.iSchaltend.n_tkf UMR_U_MIN_32_1_0_S6_S3 8 0 8160 DEPOSIT ABSOLUTE MONOTONY MON_INCREASE /end AXIS_DESCR
 /begin AXIS_DESCR STD_AXIS zff_atsys._.iSignale._.obj.sig_m_t UMR_NM__1_1_0_S6_S3 10 -400 1640 DEPOSIT ABSOLUTE MONOTONY MON_INCREASE /end AXIS_DESCR
/end CHARACTERISTIC
/begin CHARACTERISTIC F_PRASPORT68 "Druckfaktor waehrend Rampe auf Schaltdruck" VALUE 0x26E8CF kw_ui8_S6_S3 1 UMR___1_100_0_S6_S3 0 1 /end CHARACTERISTIC
/begin CHARACTERISTIC F_TRASPORT68 "Zeitfaktor waehrend Rampe auf Schaltdruck" VALUE 0x26E8D0 kw_ui8_S6_S3 1 UMR___1_100_0_S6_S3 0 1 /end CHARACTERISTIC
/begin CHARACTERISTIC KF_PGOKZUMTNTSPORT68 "Schaltdruckgradient" MAP 0x25768C kf_si16_S6_S3 200 UMR_BAR_SEC_1_10_0_S6_S3 -100 100
 /begin AXIS_DESCR STD_AXIS zff_atsys._.iSignale._.obj.sig_m_t UMR_NM__1_1_0_S6_S3 6 -400 1640 DEPOSIT ABSOLUTE MONOTONY MON_INCREASE /end AXIS_DESCR
 /begin AXIS_DESCR STD_AXIS zff_atsys._.iSignale._.obj.sig_n_t UMR_U_MIN_1_1_0_S6_S3 4 0 8160 DEPOSIT ABSOLUTE MONOTONY MON_INCREASE /end AXIS_DESCR
/end CHARACTERISTIC
/begin CHARACTERISTIC KF_POKZUMTCGSPORT68 "Schaltdruckoffset" MAP 0x2576D8 kf_si16_S6_S3 12.75 UMR_BAR__1_1000_0_S6_S3 -6.4 6.35
 /begin AXIS_DESCR STD_AXIS zff_atsys._.iSignale._.obj.sig_m_t UMR_NM__1_1_0_S6_S3 8 -400 1640 DEPOSIT ABSOLUTE MONOTONY MON_INCREASE /end AXIS_DESCR
 /begin AXIS_DESCR STD_AXIS zff_atsys._.iSignale._.obj.sig_c_getr UMR_GRADC__1_1_M40_S6_S3 10 -40 150 DEPOSIT ABSOLUTE MONOTONY MON_INCREASE /end AXIS_DESCR
/end CHARACTERISTIC
/begin CHARACTERISTIC KL_TSYNMTKZUSFV12 "Zeit vor sync. Start Schnellfuellung vorb. KZU" CURVE 0x24C544 kl_si16_S6_S3 5000 UMR_MSEC__10_1_0_S6_S3 -5000 0
 /begin AXIS_DESCR STD_AXIS zff_atsys._.iSignale._.obj.sig_m_t UMR_NM__1_1_0_S6_S3 4 -400 1640 DEPOSIT ABSOLUTE MONOTONY MON_INCREASE /end AXIS_DESCR
/end CHARACTERISTIC
/begin CHARACTERISTIC KL_TSYNMTFKZUV12 "Zeit vor sync. Ende Fuellausgleich vorb. KZU" CURVE 0x24C558 kl_ui8_S6_S3 1280 UMR_MSEC__10_1_M128_S6_S3 -1280 0
 /begin AXIS_DESCR STD_AXIS zff_atsys._.iSignale._.obj.sig_m_t8 UMR_NM__8_1_M50_S6_S3 4 -400 1640 DEPOSIT ABSOLUTE MONOTONY MON_INCREASE /end AXIS_DESCR
/end CHARACTERISTIC
/begin CHARACTERISTIC KL_TSYNMTKZUSFV23 "Zeit vor sync. Start Schnellfuellung vorb. KZU" CURVE 0x24C564 kl_si16_S6_S3 5000 UMR_MSEC__10_1_0_S6_S3 -5000 0
 /begin AXIS_DESCR STD_AXIS zff_atsys._.iSignale._.obj.sig_m_t UMR_NM__1_1_0_S6_S3 4 -400 1640 DEPOSIT ABSOLUTE MONOTONY MON_INCREASE /end AXIS_DESCR
/end CHARACTERISTIC
/begin CHARACTERISTIC KL_TSYNMTFKZUV23 "Zeit vor sync. Ende Fuellausgleich vorb. KZU" CURVE 0x24C578 kl_ui8_S6_S3 1280 UMR_MSEC__10_1_M128_S6_S3 -1280 0
 /begin AXIS_DESCR STD_AXIS zff_atsys._.iSignale._.obj.sig_m_t8 UMR_NM__8_1_M50_S6_S3 4 -400 1640 DEPOSIT ABSOLUTE MONOTONY MON_INCREASE /end AXIS_DESCR
/end CHARACTERISTIC
/begin CHARACTERISTIC KL_TSYNMTKZUSFV34 "Zeit vor sync. Start Schnellfuellung vorb. KZU" CURVE 0x24C584 kl_si16_S6_S3 5000 UMR_MSEC__10_1_0_S6_S3 -5000 0
 /begin AXIS_DESCR STD_AXIS zff_atsys._.iSignale._.obj.sig_m_t UMR_NM__1_1_0_S6_S3 4 -400 1640 DEPOSIT ABSOLUTE MONOTONY MON_INCREASE /end AXIS_DESCR
/end CHARACTERISTIC
/begin CHARACTERISTIC KL_TSYNMTFKZUV34 "Zeit vor sync. Ende Fuellausgleich vorb. KZU" CURVE 0x24C598 kl_ui8_S6_S3 1280 UMR_MSEC__10_1_M128_S6_S3 -1280 0
 /begin AXIS_DESCR STD_AXIS zff_atsys._.iSignale._.obj.sig_m_t8 UMR_NM__8_1_M50_S6_S3 4 -400 1640 DEPOSIT ABSOLUTE MONOTONY MON_INCREASE /end AXIS_DESCR
/end CHARACTERISTIC
/begin CHARACTERISTIC KL_TSYNMTKZUSFV45 "Zeit vor sync. Start Schnellfuellung vorb. KZU" CURVE 0x24C5A4 kl_si16_S6_S3 5000 UMR_MSEC__10_1_0_S6_S3 -5000 0
 /begin AXIS_DESCR STD_AXIS zff_atsys._.iSignale._.obj.sig_m_t UMR_NM__1_1_0_S6_S3 4 -400 1640 DEPOSIT ABSOLUTE MONOTONY MON_INCREASE /end AXIS_DESCR
/end CHARACTERISTIC
/begin CHARACTERISTIC KL_TSYNMTFKZUV45 "Zeit vor sync. Ende Fuellausgleich vorb. KZU" CURVE 0x24C5B8 kl_ui8_S6_S3 1280 UMR_MSEC__10_1_M128_S6_S3 -1280 0
 /begin AXIS_DESCR STD_AXIS zff_atsys._.iSignale._.obj.sig_m_t8 UMR_NM__8_1_M50_S6_S3 4 -400 1640 DEPOSIT ABSOLUTE MONOTONY MON_INCREASE /end AXIS_DESCR
/end CHARACTERISTIC
/begin CHARACTERISTIC KL_TSYNMTKZUSFV56 "Zeit vor sync. Start Schnellfuellung vorb. KZU" CURVE 0x24C5C4 kl_si16_S6_S3 5000 UMR_MSEC__10_1_0_S6_S3 -5000 0
 /begin AXIS_DESCR STD_AXIS zff_atsys._.iSignale._.obj.sig_m_t UMR_NM__1_1_0_S6_S3 4 -400 1640 DEPOSIT ABSOLUTE MONOTONY MON_INCREASE /end AXIS_DESCR
/end CHARACTERISTIC
/begin CHARACTERISTIC KL_TSYNMTFKZUV56 "Zeit vor sync. Ende Fuellausgleich vorb. KZU" CURVE 0x24C5D8 kl_ui8_S6_S3 1280 UMR_MSEC__10_1_M128_S6_S3 -1280 0
 /begin AXIS_DESCR STD_AXIS zff_atsys._.iSignale._.obj.sig_m_t8 UMR_NM__8_1_M50_S6_S3 4 -400 1640 DEPOSIT ABSOLUTE MONOTONY MON_INCREASE /end AXIS_DESCR
/end CHARACTERISTIC
/begin CHARACTERISTIC KL_TSYNMTKZUSFV67 "Zeit vor sync. Start Schnellfuellung vorb. KZU" CURVE 0x24C5E4 kl_si16_S6_S3 5000 UMR_MSEC__10_1_0_S6_S3 -5000 0
 /begin AXIS_DESCR STD_AXIS zff_atsys._.iSignale._.obj.sig_m_t UMR_NM__1_1_0_S6_S3 4 -400 1640 DEPOSIT ABSOLUTE MONOTONY MON_INCREASE /end AXIS_DESCR
/end CHARACTERISTIC
/begin CHARACTERISTIC KL_TSYNMTFKZUV67 "Zeit vor sync. Ende Fuellausgleich vorb. KZU" CURVE 0x24C5F8 kl_ui8_S6_S3 1280 UMR_MSEC__10_1_M128_S6_S3 -1280 0
 /begin AXIS_DESCR STD_AXIS zff_atsys._.iSignale._.obj.sig_m_t8 UMR_NM__8_1_M50_S6_S3 4 -400 1640 DEPOSIT ABSOLUTE MONOTONY MON_INCREASE /end AXIS_DESCR
/end CHARACTERISTIC
/begin CHARACTERISTIC KL_TSYNMTKZUSFV78 "Zeit vor sync. Start Schnellfuellung vorb. KZU" CURVE 0x24C604 kl_si16_S6_S3 5000 UMR_MSEC__10_1_0_S6_S3 -5000 0
 /begin AXIS_DESCR STD_AXIS zff_atsys._.iSignale._.obj.sig_m_t UMR_NM__1_1_0_S6_S3 4 -400 1640 DEPOSIT ABSOLUTE MONOTONY MON_INCREASE /end AXIS_DESCR
/end CHARACTERISTIC
/begin CHARACTERISTIC KL_TSYNMTFKZUV78 "Zeit vor sync. Ende Fuellausgleich vorb. KZU" CURVE 0x24C618 kl_ui8_S6_S3 1280 UMR_MSEC__10_1_M128_S6_S3 -1280 0
 /begin AXIS_DESCR STD_AXIS zff_atsys._.iSignale._.obj.sig_m_t8 UMR_NM__8_1_M50_S6_S3 4 -400 1640 DEPOSIT ABSOLUTE MONOTONY MON_INCREASE /end AXIS_DESCR
/end CHARACTERISTIC
/begin CHARACTERISTIC F_PRA21 "Druckfaktor waehrend Rampe auf Schaltdruck" VALUE 0x26E905 kw_ui8_S6_S3 1 UMR___1_100_0_S6_S3 0 1 /end CHARACTERISTIC
/begin CHARACTERISTIC F_PRA21_EL "Druckfaktor waehrend Rampe auf Schaltdruck" VALUE 0x26E906 kw_ui8_S6_S3 1 UMR___1_100_0_S6_S3 0 1 /end CHARACTERISTIC
/begin CHARACTERISTIC F_TRA21 "Zeitfaktor waehrend Rampe auf Schaltdruck" VALUE 0x26E907 kw_ui8_S6_S3 1 UMR___1_100_0_S6_S3 0 1 /end CHARACTERISTIC
/begin CHARACTERISTIC F_TRA21_EL "Zeitfaktor waehrend Rampe auf Schaltdruck" VALUE 0x26E908 kw_ui8_S6_S3 1 UMR___1_100_0_S6_S3 0 1 /end CHARACTERISTIC
/begin CHARACTERISTIC T_F21 "Fuellzeit" VALUE 0x26E909 kw_ui8_S6_S3 2540 UMR_MSEC__10_1_0_S6_S3 0 2540 /end CHARACTERISTIC
/begin CHARACTERISTIC T_F21_EL "Fuellzeit" VALUE 0x26E90A kw_ui8_S6_S3 2540 UMR_MSEC__10_1_0_S6_S3 0 2540 /end CHARACTERISTIC
/begin CHARACTERISTIC KL_TRA21 "Kennlinie Zeit Erste Rampe" CURVE 0x258AC8 kl_ui8_S6_S3 2540 UMR_MSEC__10_1_0_S6_S3 0 2540
 /begin AXIS_DESCR STD_AXIS zff_atsys._.iSignale._.obj.sig_m_t8 UMR_NM__8_1_M50_S6_S3 4 -400 1640 DEPOSIT ABSOLUTE MONOTONY MON_INCREASE /end AXIS_DESCR
/end CHARACTERISTIC
/begin CHARACTERISTIC KL_TRA21_EL "Kennlinie Zeit Erste Rampe" CURVE 0x258AD4 kl_ui8_S6_S3 2540 UMR_MSEC__10_1_0_S6_S3 0 2540
 /begin AXIS_DESCR STD_AXIS zff_atsys._.iSignale._.obj.sig_m_t8 UMR_NM__8_1_M50_S6_S3 4 -400 1640 DEPOSIT ABSOLUTE MONOTONY MON_INCREASE /end AXIS_DESCR
/end CHARACTERISTIC
/begin CHARACTERISTIC KL_PGRASYN21 "Schliessrampenradient" CURVE 0x258AE0 kl_si16_S6_S3 6553.4 UMR_BAR_SEC_1_10_0_S6_S3 -3276.7 3276.7
 /begin AXIS_DESCR STD_AXIS zff_atsys._.iSignale._.obj.sig_m_t UMR_NM__1_1_0_S6_S3 6 -400 1640 DEPOSIT ABSOLUTE MONOTONY MON_INCREASE /end AXIS_DESCR
/end CHARACTERISTIC
/begin CHARACTERISTIC KF_POFMTN21 "Kennfeld Fuelldruckoffset(n_t, m_t)" MAP 0x258AFC kf_si16_S6_S3 12.75 UMR_BAR__1_1000_0_S6_S3 -6.4 6.35
 /begin AXIS_DESCR STD_AXIS zff_atsys._.iSignale._.obj.sig_n_t UMR_U_MIN_1_1_0_S6_S3 4 0 8160 DEPOSIT ABSOLUTE MONOTONY MON_INCREASE /end AXIS_DESCR
 /begin AXIS_DESCR STD_AXIS zff_atsys._.iSignale._.obj.sig_m_t UMR_NM__1_1_0_S6_S3 6 -400 1640 DEPOSIT ABSOLUTE MONOTONY MON_INCREASE /end AXIS_DESCR
/end CHARACTERISTIC
/begin CHARACTERISTIC KF_POFMTN21_EL "Kennfeld Fuelldruckoffset(n_t, m_t)" MAP 0x258B48 kf_si16_S6_S3 12.75 UMR_BAR__1_1000_0_S6_S3 -6.4 6.35
 /begin AXIS_DESCR STD_AXIS zff_atsys._.iSignale._.obj.sig_n_t UMR_U_MIN_1_1_0_S6_S3 4 0 8160 DEPOSIT ABSOLUTE MONOTONY MON_INCREASE /end AXIS_DESCR
 /begin AXIS_DESCR STD_AXIS zff_atsys._.iSignale._.obj.sig_m_t UMR_NM__1_1_0_S6_S3 6 -400 1640 DEPOSIT ABSOLUTE MONOTONY MON_INCREASE /end AXIS_DESCR
/end CHARACTERISTIC
/begin CHARACTERISTIC KF_PKZU21 "Schaltdruck zuschaltende Kupplung" MAP 0x258B94 kf_si16_S6_S3 12.75 UMR_BAR__1_1000_0_S6_S3 0 12.75
 /begin AXIS_DESCR STD_AXIS iSasZentr.iSchaltend.n_tkf UMR_U_MIN_32_1_0_S6_S3 8 0 8160 DEPOSIT ABSOLUTE MONOTONY MON_INCREASE /end AXIS_DESCR
 /begin AXIS_DESCR STD_AXIS zff_atsys._.iSignale._.obj.sig_m_t UMR_NM__1_1_0_S6_S3 8 -400 1640 DEPOSIT ABSOLUTE MONOTONY MON_INCREASE /end AXIS_DESCR
/end CHARACTERISTIC
/begin CHARACTERISTIC KF_PKZU21_EL "Schaltdruck zuschaltende Kupplung" MAP 0x258C3C kf_si16_S6_S3 12.75 UMR_BAR__1_1000_0_S6_S3 0 12.75
 /begin AXIS_DESCR STD_AXIS iSasZentr.iSchaltend.n_tkf UMR_U_MIN_32_1_0_S6_S3 8 0 8160 DEPOSIT ABSOLUTE MONOTONY MON_INCREASE /end AXIS_DESCR
 /begin AXIS_DESCR STD_AXIS zff_atsys._.iSignale._.obj.sig_m_t UMR_NM__1_1_0_S6_S3 8 -400 1640 DEPOSIT ABSOLUTE MONOTONY MON_INCREASE /end AXIS_DESCR
/end CHARACTERISTIC
/begin CHARACTERISTIC KF_POHINSYNKZU21 "Kennfeld Haltedruckoffset(n_tkf, m_t) bei Haltephase in Synchron" MAP 0x258CE4 kf_si16_S6_S3 12.75 UMR_BAR__1_1000_0_S6_S3 -6.4 6.35
 /begin AXIS_DESCR STD_AXIS iSasZentr.iSchaltend.n_tkf UMR_U_MIN_32_1_0_S6_S3 4 0 8160 DEPOSIT ABSOLUTE MONOTONY MON_INCREASE /end AXIS_DESCR
 /begin AXIS_DESCR STD_AXIS zff_atsys._.iSignale._.obj.sig_m_t UMR_NM__1_1_0_S6_S3 4 -400 1640 DEPOSIT ABSOLUTE MONOTONY MON_INCREASE /end AXIS_DESCR
/end CHARACTERISTIC
/begin CHARACTERISTIC KL_TSYNCGHINSYNEKZU21 "Zeit fuer Ende Haltephase in Synchron KZU" CURVE 0x258D1C kl_ui8_S6_S3 2550 UMR_MSEC__10_1_M128_S6_S3 -1280 1270
 /begin AXIS_DESCR STD_AXIS zff_atsys._.iSignale._.obj.sig_c_getr UMR_GRADC__1_1_M40_S6_S3 4 -40 150 DEPOSIT ABSOLUTE MONOTONY MON_INCREASE /end AXIS_DESCR
/end CHARACTERISTIC
/begin CHARACTERISTIC F_PRA32 "Druckfaktor waehrend Rampe auf Schaltdruck" VALUE 0x26E90B kw_ui8_S6_S3 1 UMR___1_100_0_S6_S3 0 1 /end CHARACTERISTIC
/begin CHARACTERISTIC F_PRA32_EL "Druckfaktor waehrend Rampe auf Schaltdruck" VALUE 0x26E90C kw_ui8_S6_S3 1 UMR___1_100_0_S6_S3 0 1 /end CHARACTERISTIC
/begin CHARACTERISTIC F_TRA32 "Zeitfaktor waehrend Rampe auf Schaltdruck" VALUE 0x26E90D kw_ui8_S6_S3 1 UMR___1_100_0_S6_S3 0 1 /end CHARACTERISTIC
/begin CHARACTERISTIC F_TRA32_EL "Zeitfaktor waehrend Rampe auf Schaltdruck" VALUE 0x26E90E kw_ui8_S6_S3 1 UMR___1_100_0_S6_S3 0 1 /end CHARACTERISTIC
/begin CHARACTERISTIC T_F32 "Fuellzeit" VALUE 0x26E90F kw_ui8_S6_S3 2540 UMR_MSEC__10_1_0_S6_S3 0 2540 /end CHARACTERISTIC
/begin CHARACTERISTIC T_F32_EL "Fuellzeit" VALUE 0x26E910 kw_ui8_S6_S3 2540 UMR_MSEC__10_1_0_S6_S3 0 2540 /end CHARACTERISTIC
/begin CHARACTERISTIC KL_TRA32 "Kennlinie Zeit Erste Rampe" CURVE 0x258D28 kl_ui8_S6_S3 2540 UMR_MSEC__10_1_0_S6_S3 0 2540
 /begin AXIS_DESCR STD_AXIS zff_atsys._.iSignale._.obj.sig_m_t8 UMR_NM__8_1_M50_S6_S3 4 -400 1640 DEPOSIT ABSOLUTE MONOTONY MON_INCREASE /end AXIS_DESCR
/end CHARACTERISTIC
/begin CHARACTERISTIC KL_TRA32_EL "Kennlinie Zeit Erste Rampe" CURVE 0x258D34 kl_ui8_S6_S3 2540 UMR_MSEC__10_1_0_S6_S3 0 2540
 /begin AXIS_DESCR STD_AXIS zff_atsys._.iSignale._.obj.sig_m_t8 UMR_NM__8_1_M50_S6_S3 4 -400 1640 DEPOSIT ABSOLUTE MONOTONY MON_INCREASE /end AXIS_DESCR
/end CHARACTERISTIC
/begin CHARACTERISTIC KL_PGRASYN32 "Schliessrampenradient" CURVE 0x258D40 kl_si16_S6_S3 6553.4 UMR_BAR_SEC_1_10_0_S6_S3 -3276.7 3276.7
 /begin AXIS_DESCR STD_AXIS zff_atsys._.iSignale._.obj.sig_m_t UMR_NM__1_1_0_S6_S3 6 -400 1640 DEPOSIT ABSOLUTE MONOTONY MON_INCREASE /end AXIS_DESCR
/end CHARACTERISTIC
/begin CHARACTERISTIC KF_POFMTN32 "Kennfeld Fuelldruckoffset(n_t, m_t)" MAP 0x258D5C kf_si16_S6_S3 12.75 UMR_BAR__1_1000_0_S6_S3 -6.4 6.35
 /begin AXIS_DESCR STD_AXIS zff_atsys._.iSignale._.obj.sig_n_t UMR_U_MIN_1_1_0_S6_S3 4 0 8160 DEPOSIT ABSOLUTE MONOTONY MON_INCREASE /end AXIS_DESCR
 /begin AXIS_DESCR STD_AXIS zff_atsys._.iSignale._.obj.sig_m_t UMR_NM__1_1_0_S6_S3 6 -400 1640 DEPOSIT ABSOLUTE MONOTONY MON_INCREASE /end AXIS_DESCR
/end CHARACTERISTIC
/begin CHARACTERISTIC KF_POFMTN32_EL "Kennfeld Fuelldruckoffset(n_t, m_t)" MAP 0x258DA8 kf_si16_S6_S3 12.75 UMR_BAR__1_1000_0_S6_S3 -6.4 6.35
 /begin AXIS_DESCR STD_AXIS zff_atsys._.iSignale._.obj.sig_n_t UMR_U_MIN_1_1_0_S6_S3 4 0 8160 DEPOSIT ABSOLUTE MONOTONY MON_INCREASE /end AXIS_DESCR
 /begin AXIS_DESCR STD_AXIS zff_atsys._.iSignale._.obj.sig_m_t UMR_NM__1_1_0_S6_S3 6 -400 1640 DEPOSIT ABSOLUTE MONOTONY MON_INCREASE /end AXIS_DESCR
/end CHARACTERISTIC
/begin CHARACTERISTIC KF_PKZU32 "Schaltdruck zuschaltende Kupplung" MAP 0x258DF4 kf_si16_S6_S3 12.75 UMR_BAR__1_1000_0_S6_S3 0 12.75
 /begin AXIS_DESCR STD_AXIS iSasZentr.iSchaltend.n_tkf UMR_U_MIN_32_1_0_S6_S3 8 0 8160 DEPOSIT ABSOLUTE MONOTONY MON_INCREASE /end AXIS_DESCR
 /begin AXIS_DESCR STD_AXIS zff_atsys._.iSignale._.obj.sig_m_t UMR_NM__1_1_0_S6_S3 8 -400 1640 DEPOSIT ABSOLUTE MONOTONY MON_INCREASE /end AXIS_DESCR
/end CHARACTERISTIC
/begin CHARACTERISTIC KF_PKZU32_EL "Schaltdruck zuschaltende Kupplung" MAP 0x258E9C kf_si16_S6_S3 12.75 UMR_BAR__1_1000_0_S6_S3 0 12.75
 /begin AXIS_DESCR STD_AXIS iSasZentr.iSchaltend.n_tkf UMR_U_MIN_32_1_0_S6_S3 8 0 8160 DEPOSIT ABSOLUTE MONOTONY MON_INCREASE /end AXIS_DESCR
 /begin AXIS_DESCR STD_AXIS zff_atsys._.iSignale._.obj.sig_m_t UMR_NM__1_1_0_S6_S3 8 -400 1640 DEPOSIT ABSOLUTE MONOTONY MON_INCREASE /end AXIS_DESCR
/end CHARACTERISTIC
/begin CHARACTERISTIC KF_POHINSYNKZU32 "Kennfeld Haltedruckoffset(n_tkf, m_t) bei Haltephase in Synchron" MAP 0x258F44 kf_si16_S6_S3 12.75 UMR_BAR__1_1000_0_S6_S3 -6.4 6.35
 /begin AXIS_DESCR STD_AXIS iSasZentr.iSchaltend.n_tkf UMR_U_MIN_32_1_0_S6_S3 4 0 8160 DEPOSIT ABSOLUTE MONOTONY MON_INCREASE /end AXIS_DESCR
 /begin AXIS_DESCR STD_AXIS zff_atsys._.iSignale._.obj.sig_m_t UMR_NM__1_1_0_S6_S3 4 -400 1640 DEPOSIT ABSOLUTE MONOTONY MON_INCREASE /end AXIS_DESCR
/end CHARACTERISTIC
/begin CHARACTERISTIC KL_TSYNCGHINSYNEKZU32 "Zeit fuer Ende Haltephase in Synchron KZU" CURVE 0x258F7C kl_ui8_S6_S3 2550 UMR_MSEC__10_1_M128_S6_S3 -1280 1270
 /begin AXIS_DESCR STD_AXIS zff_atsys._.iSignale._.obj.sig_c_getr UMR_GRADC__1_1_M40_S6_S3 4 -40 150 DEPOSIT ABSOLUTE MONOTONY MON_INCREASE /end AXIS_DESCR
/end CHARACTERISTIC
/begin CHARACTERISTIC F_PRA43 "Druckfaktor waehrend Rampe auf Schaltdruck" VALUE 0x26E911 kw_ui8_S6_S3 1 UMR___1_100_0_S6_S3 0 1 /end CHARACTERISTIC
/begin CHARACTERISTIC F_PRA43_EL "Druckfaktor waehrend Rampe auf Schaltdruck" VALUE 0x26E912 kw_ui8_S6_S3 1 UMR___1_100_0_S6_S3 0 1 /end CHARACTERISTIC
/begin CHARACTERISTIC F_TRA43 "Zeitfaktor waehrend Rampe auf Schaltdruck" VALUE 0x26E913 kw_ui8_S6_S3 1 UMR___1_100_0_S6_S3 0 1 /end CHARACTERISTIC
/begin CHARACTERISTIC F_TRA43_EL "Zeitfaktor waehrend Rampe auf Schaltdruck" VALUE 0x26E914 kw_ui8_S6_S3 1 UMR___1_100_0_S6_S3 0 1 /end CHARACTERISTIC
/begin CHARACTERISTIC T_F43 "Fuellzeit" VALUE 0x26E915 kw_ui8_S6_S3 2540 UMR_MSEC__10_1_0_S6_S3 0 2540 /end CHARACTERISTIC
/begin CHARACTERISTIC T_F43_EL "Fuellzeit" VALUE 0x26E916 kw_ui8_S6_S3 2540 UMR_MSEC__10_1_0_S6_S3 0 2540 /end CHARACTERISTIC
/begin CHARACTERISTIC KL_TRA43 "Kennlinie Zeit Erste Rampe" CURVE 0x258F88 kl_ui8_S6_S3 2540 UMR_MSEC__10_1_0_S6_S3 0 2540
 /begin AXIS_DESCR STD_AXIS zff_atsys._.iSignale._.obj.sig_m_t8 UMR_NM__8_1_M50_S6_S3 4 -400 1640 DEPOSIT ABSOLUTE MONOTONY MON_INCREASE /end AXIS_DESCR
/end CHARACTERISTIC
/begin CHARACTERISTIC KL_TRA43_EL "Kennlinie Zeit Erste Rampe" CURVE 0x258F94 kl_ui8_S6_S3 2540 UMR_MSEC__10_1_0_S6_S3 0 2540
 /begin AXIS_DESCR STD_AXIS zff_atsys._.iSignale._.obj.sig_m_t8 UMR_NM__8_1_M50_S6_S3 4 -400 1640 DEPOSIT ABSOLUTE MONOTONY MON_INCREASE /end AXIS_DESCR
/end CHARACTERISTIC
/begin CHARACTERISTIC KL_PGRASYN43 "Schliessrampenradient" CURVE 0x258FA0 kl_si16_S6_S3 6553.4 UMR_BAR_SEC_1_10_0_S6_S3 -3276.7 3276.7
 /begin AXIS_DESCR STD_AXIS zff_atsys._.iSignale._.obj.sig_m_t UMR_NM__1_1_0_S6_S3 6 -400 1640 DEPOSIT ABSOLUTE MONOTONY MON_INCREASE /end AXIS_DESCR
/end CHARACTERISTIC
/begin CHARACTERISTIC KF_POFMTN43 "Kennfeld Fuelldruckoffset(n_t, m_t)" MAP 0x258FBC kf_si16_S6_S3 12.75 UMR_BAR__1_1000_0_S6_S3 -6.4 6.35
 /begin AXIS_DESCR STD_AXIS zff_atsys._.iSignale._.obj.sig_n_t UMR_U_MIN_1_1_0_S6_S3 4 0 8160 DEPOSIT ABSOLUTE MONOTONY MON_INCREASE /end AXIS_DESCR
 /begin AXIS_DESCR STD_AXIS zff_atsys._.iSignale._.obj.sig_m_t UMR_NM__1_1_0_S6_S3 6 -400 1640 DEPOSIT ABSOLUTE MONOTONY MON_INCREASE /end AXIS_DESCR
/end CHARACTERISTIC
/begin CHARACTERISTIC KF_POFMTN43_EL "Kennfeld Fuelldruckoffset(n_t, m_t)" MAP 0x259008 kf_si16_S6_S3 12.75 UMR_BAR__1_1000_0_S6_S3 -6.4 6.35
 /begin AXIS_DESCR STD_AXIS zff_atsys._.iSignale._.obj.sig_n_t UMR_U_MIN_1_1_0_S6_S3 4 0 8160 DEPOSIT ABSOLUTE MONOTONY MON_INCREASE /end AXIS_DESCR
 /begin AXIS_DESCR STD_AXIS zff_atsys._.iSignale._.obj.sig_m_t UMR_NM__1_1_0_S6_S3 6 -400 1640 DEPOSIT ABSOLUTE MONOTONY MON_INCREASE /end AXIS_DESCR
/end CHARACTERISTIC
/begin CHARACTERISTIC KF_PKZU43 "Schaltdruck zuschaltende Kupplung" MAP 0x259054 kf_si16_S6_S3 12.75 UMR_BAR__1_1000_0_S6_S3 0 12.75
 /begin AXIS_DESCR STD_AXIS iSasZentr.iSchaltend.n_tkf UMR_U_MIN_32_1_0_S6_S3 8 0 8160 DEPOSIT ABSOLUTE MONOTONY MON_INCREASE /end AXIS_DESCR
 /begin AXIS_DESCR STD_AXIS zff_atsys._.iSignale._.obj.sig_m_t UMR_NM__1_1_0_S6_S3 8 -400 1640 DEPOSIT ABSOLUTE MONOTONY MON_INCREASE /end AXIS_DESCR
/end CHARACTERISTIC
/begin CHARACTERISTIC KF_PKZU43_EL "Schaltdruck zuschaltende Kupplung" MAP 0x2590FC kf_si16_S6_S3 12.75 UMR_BAR__1_1000_0_S6_S3 0 12.75
 /begin AXIS_DESCR STD_AXIS iSasZentr.iSchaltend.n_tkf UMR_U_MIN_32_1_0_S6_S3 8 0 8160 DEPOSIT ABSOLUTE MONOTONY MON_INCREASE /end AXIS_DESCR
 /begin AXIS_DESCR STD_AXIS zff_atsys._.iSignale._.obj.sig_m_t UMR_NM__1_1_0_S6_S3 8 -400 1640 DEPOSIT ABSOLUTE MONOTONY MON_INCREASE /end AXIS_DESCR
/end CHARACTERISTIC
/begin CHARACTERISTIC KF_POHINSYNKZU43 "Kennfeld Haltedruckoffset(n_tkf, m_t) bei Haltephase in Synchron" MAP 0x2591A4 kf_si16_S6_S3 12.75 UMR_BAR__1_1000_0_S6_S3 -6.4 6.35
 /begin AXIS_DESCR STD_AXIS iSasZentr.iSchaltend.n_tkf UMR_U_MIN_32_1_0_S6_S3 4 0 8160 DEPOSIT ABSOLUTE MONOTONY MON_INCREASE /end AXIS_DESCR
 /begin AXIS_DESCR STD_AXIS zff_atsys._.iSignale._.obj.sig_m_t UMR_NM__1_1_0_S6_S3 4 -400 1640 DEPOSIT ABSOLUTE MONOTONY MON_INCREASE /end AXIS_DESCR
/end CHARACTERISTIC
/begin CHARACTERISTIC KL_TSYNCGHINSYNEKZU43 "Zeit fuer Ende Haltephase in Synchron KZU" CURVE 0x2591DC kl_ui8_S6_S3 2550 UMR_MSEC__10_1_M128_S6_S3 -1280 1270
 /begin AXIS_DESCR STD_AXIS zff_atsys._.iSignale._.obj.sig_c_getr UMR_GRADC__1_1_M40_S6_S3 4 -40 150 DEPOSIT ABSOLUTE MONOTONY MON_INCREASE /end AXIS_DESCR
/end CHARACTERISTIC
/begin CHARACTERISTIC F_PRA54 "Druckfaktor waehrend Rampe auf Schaltdruck" VALUE 0x26E917 kw_ui8_S6_S3 1 UMR___1_100_0_S6_S3 0 1 /end CHARACTERISTIC
/begin CHARACTERISTIC F_PRA54_EL "Druckfaktor waehrend Rampe auf Schaltdruck" VALUE 0x26E918 kw_ui8_S6_S3 1 UMR___1_100_0_S6_S3 0 1 /end CHARACTERISTIC
/begin CHARACTERISTIC F_TRA54 "Zeitfaktor waehrend Rampe auf Schaltdruck" VALUE 0x26E919 kw_ui8_S6_S3 1 UMR___1_100_0_S6_S3 0 1 /end CHARACTERISTIC
/begin CHARACTERISTIC F_TRA54_EL "Zeitfaktor waehrend Rampe auf Schaltdruck" VALUE 0x26E91A kw_ui8_S6_S3 1 UMR___1_100_0_S6_S3 0 1 /end CHARACTERISTIC
/begin CHARACTERISTIC T_F54 "Fuellzeit" VALUE 0x26E91B kw_ui8_S6_S3 2540 UMR_MSEC__10_1_0_S6_S3 0 2540 /end CHARACTERISTIC
/begin CHARACTERISTIC T_F54_EL "Fuellzeit" VALUE 0x26E91C kw_ui8_S6_S3 2540 UMR_MSEC__10_1_0_S6_S3 0 2540 /end CHARACTERISTIC
/begin CHARACTERISTIC KL_TRA54 "Kennlinie Zeit Erste Rampe" CURVE 0x2591E8 kl_ui8_S6_S3 2540 UMR_MSEC__10_1_0_S6_S3 0 2540
 /begin AXIS_DESCR STD_AXIS zff_atsys._.iSignale._.obj.sig_m_t8 UMR_NM__8_1_M50_S6_S3 4 -400 1640 DEPOSIT ABSOLUTE MONOTONY MON_INCREASE /end AXIS_DESCR
/end CHARACTERISTIC
/begin CHARACTERISTIC KL_TRA54_EL "Kennlinie Zeit Erste Rampe" CURVE 0x2591F4 kl_ui8_S6_S3 2540 UMR_MSEC__10_1_0_S6_S3 0 2540
 /begin AXIS_DESCR STD_AXIS zff_atsys._.iSignale._.obj.sig_m_t8 UMR_NM__8_1_M50_S6_S3 4 -400 1640 DEPOSIT ABSOLUTE MONOTONY MON_INCREASE /end AXIS_DESCR
/end CHARACTERISTIC
/begin CHARACTERISTIC KL_PGRASYN54 "Schliessrampenradient" CURVE 0x259200 kl_si16_S6_S3 6553.4 UMR_BAR_SEC_1_10_0_S6_S3 -3276.7 3276.7
 /begin AXIS_DESCR STD_AXIS zff_atsys._.iSignale._.obj.sig_m_t UMR_NM__1_1_0_S6_S3 6 -400 1640 DEPOSIT ABSOLUTE MONOTONY MON_INCREASE /end AXIS_DESCR
/end CHARACTERISTIC
/begin CHARACTERISTIC KF_POFMTN54 "Kennfeld Fuelldruckoffset(n_t, m_t)" MAP 0x25921C kf_si16_S6_S3 12.75 UMR_BAR__1_1000_0_S6_S3 -6.4 6.35
 /begin AXIS_DESCR STD_AXIS zff_atsys._.iSignale._.obj.sig_n_t UMR_U_MIN_1_1_0_S6_S3 4 0 8160 DEPOSIT ABSOLUTE MONOTONY MON_INCREASE /end AXIS_DESCR
 /begin AXIS_DESCR STD_AXIS zff_atsys._.iSignale._.obj.sig_m_t UMR_NM__1_1_0_S6_S3 6 -400 1640 DEPOSIT ABSOLUTE MONOTONY MON_INCREASE /end AXIS_DESCR
/end CHARACTERISTIC
/begin CHARACTERISTIC KF_POFMTN54_EL "Kennfeld Fuelldruckoffset(n_t, m_t)" MAP 0x259268 kf_si16_S6_S3 12.75 UMR_BAR__1_1000_0_S6_S3 -6.4 6.35
 /begin AXIS_DESCR STD_AXIS zff_atsys._.iSignale._.obj.sig_n_t UMR_U_MIN_1_1_0_S6_S3 4 0 8160 DEPOSIT ABSOLUTE MONOTONY MON_INCREASE /end AXIS_DESCR
 /begin AXIS_DESCR STD_AXIS zff_atsys._.iSignale._.obj.sig_m_t UMR_NM__1_1_0_S6_S3 6 -400 1640 DEPOSIT ABSOLUTE MONOTONY MON_INCREASE /end AXIS_DESCR
/end CHARACTERISTIC
/begin CHARACTERISTIC KF_PKZU54 "Schaltdruck zuschaltende Kupplung" MAP 0x2592B4 kf_si16_S6_S3 12.75 UMR_BAR__1_1000_0_S6_S3 0 12.75
 /begin AXIS_DESCR STD_AXIS iSasZentr.iSchaltend.n_tkf UMR_U_MIN_32_1_0_S6_S3 8 0 8160 DEPOSIT ABSOLUTE MONOTONY MON_INCREASE /end AXIS_DESCR
 /begin AXIS_DESCR STD_AXIS zff_atsys._.iSignale._.obj.sig_m_t UMR_NM__1_1_0_S6_S3 8 -400 1640 DEPOSIT ABSOLUTE MONOTONY MON_INCREASE /end AXIS_DESCR
/end CHARACTERISTIC
/begin CHARACTERISTIC KF_PKZU54_EL "Schaltdruck zuschaltende Kupplung" MAP 0x25935C kf_si16_S6_S3 12.75 UMR_BAR__1_1000_0_S6_S3 0 12.75
 /begin AXIS_DESCR STD_AXIS iSasZentr.iSchaltend.n_tkf UMR_U_MIN_32_1_0_S6_S3 8 0 8160 DEPOSIT ABSOLUTE MONOTONY MON_INCREASE /end AXIS_DESCR
 /begin AXIS_DESCR STD_AXIS zff_atsys._.iSignale._.obj.sig_m_t UMR_NM__1_1_0_S6_S3 8 -400 1640 DEPOSIT ABSOLUTE MONOTONY MON_INCREASE /end AXIS_DESCR
/end CHARACTERISTIC
/begin CHARACTERISTIC KF_POHINSYNKZU54 "Kennfeld Haltedruckoffset(n_tkf, m_t) bei Haltephase in Synchron" MAP 0x259404 kf_si16_S6_S3 12.75 UMR_BAR__1_1000_0_S6_S3 -6.4 6.35
 /begin AXIS_DESCR STD_AXIS iSasZentr.iSchaltend.n_tkf UMR_U_MIN_32_1_0_S6_S3 4 0 8160 DEPOSIT ABSOLUTE MONOTONY MON_INCREASE /end AXIS_DESCR
 /begin AXIS_DESCR STD_AXIS zff_atsys._.iSignale._.obj.sig_m_t UMR_NM__1_1_0_S6_S3 4 -400 1640 DEPOSIT ABSOLUTE MONOTONY MON_INCREASE /end AXIS_DESCR
/end CHARACTERISTIC
/begin CHARACTERISTIC KL_TSYNCGHINSYNEKZU54 "Zeit fuer Ende Haltephase in Synchron KZU" CURVE 0x25943C kl_ui8_S6_S3 2550 UMR_MSEC__10_1_M128_S6_S3 -1280 1270
 /begin AXIS_DESCR STD_AXIS zff_atsys._.iSignale._.obj.sig_c_getr UMR_GRADC__1_1_M40_S6_S3 4 -40 150 DEPOSIT ABSOLUTE MONOTONY MON_INCREASE /end AXIS_DESCR
/end CHARACTERISTIC
/begin CHARACTERISTIC F_PRA65 "Druckfaktor waehrend Rampe auf Schaltdruck" VALUE 0x26E91D kw_ui8_S6_S3 1 UMR___1_100_0_S6_S3 0 1 /end CHARACTERISTIC
/begin CHARACTERISTIC F_PRA65_EL "Druckfaktor waehrend Rampe auf Schaltdruck" VALUE 0x26E91E kw_ui8_S6_S3 1 UMR___1_100_0_S6_S3 0 1 /end CHARACTERISTIC
/begin CHARACTERISTIC F_TRA65 "Zeitfaktor waehrend Rampe auf Schaltdruck" VALUE 0x26E91F kw_ui8_S6_S3 1 UMR___1_100_0_S6_S3 0 1 /end CHARACTERISTIC
/begin CHARACTERISTIC F_TRA65_EL "Zeitfaktor waehrend Rampe auf Schaltdruck" VALUE 0x26E920 kw_ui8_S6_S3 1 UMR___1_100_0_S6_S3 0 1 /end CHARACTERISTIC
/begin CHARACTERISTIC T_F65 "Fuellzeit" VALUE 0x26E921 kw_ui8_S6_S3 2540 UMR_MSEC__10_1_0_S6_S3 0 2540 /end CHARACTERISTIC
/begin CHARACTERISTIC T_F65_EL "Fuellzeit" VALUE 0x26E922 kw_ui8_S6_S3 2540 UMR_MSEC__10_1_0_S6_S3 0 2540 /end CHARACTERISTIC
/begin CHARACTERISTIC KL_TRA65 "Kennlinie Zeit Erste Rampe" CURVE 0x259448 kl_ui8_S6_S3 2540 UMR_MSEC__10_1_0_S6_S3 0 2540
 /begin AXIS_DESCR STD_AXIS zff_atsys._.iSignale._.obj.sig_m_t8 UMR_NM__8_1_M50_S6_S3 4 -400 1640 DEPOSIT ABSOLUTE MONOTONY MON_INCREASE /end AXIS_DESCR
/end CHARACTERISTIC
/begin CHARACTERISTIC KL_TRA65_EL "Kennlinie Zeit Erste Rampe" CURVE 0x259454 kl_ui8_S6_S3 2540 UMR_MSEC__10_1_0_S6_S3 0 2540
 /begin AXIS_DESCR STD_AXIS zff_atsys._.iSignale._.obj.sig_m_t8 UMR_NM__8_1_M50_S6_S3 4 -400 1640 DEPOSIT ABSOLUTE MONOTONY MON_INCREASE /end AXIS_DESCR
/end CHARACTERISTIC
/begin CHARACTERISTIC KL_PGRASYN65 "Schliessrampenradient" CURVE 0x259460 kl_si16_S6_S3 6553.4 UMR_BAR_SEC_1_10_0_S6_S3 -3276.7 3276.7
 /begin AXIS_DESCR STD_AXIS zff_atsys._.iSignale._.obj.sig_m_t UMR_NM__1_1_0_S6_S3 6 -400 1640 DEPOSIT ABSOLUTE MONOTONY MON_INCREASE /end AXIS_DESCR
/end CHARACTERISTIC
/begin CHARACTERISTIC KF_POFMTN65 "Kennfeld Fuelldruckoffset(n_t, m_t)" MAP 0x25947C kf_si16_S6_S3 12.75 UMR_BAR__1_1000_0_S6_S3 -6.4 6.35
 /begin AXIS_DESCR STD_AXIS zff_atsys._.iSignale._.obj.sig_n_t UMR_U_MIN_1_1_0_S6_S3 4 0 8160 DEPOSIT ABSOLUTE MONOTONY MON_INCREASE /end AXIS_DESCR
 /begin AXIS_DESCR STD_AXIS zff_atsys._.iSignale._.obj.sig_m_t UMR_NM__1_1_0_S6_S3 6 -400 1640 DEPOSIT ABSOLUTE MONOTONY MON_INCREASE /end AXIS_DESCR
/end CHARACTERISTIC
/begin CHARACTERISTIC KF_POFMTN65_EL "Kennfeld Fuelldruckoffset(n_t, m_t)" MAP 0x2594C8 kf_si16_S6_S3 12.75 UMR_BAR__1_1000_0_S6_S3 -6.4 6.35
 /begin AXIS_DESCR STD_AXIS zff_atsys._.iSignale._.obj.sig_n_t UMR_U_MIN_1_1_0_S6_S3 4 0 8160 DEPOSIT ABSOLUTE MONOTONY MON_INCREASE /end AXIS_DESCR
 /begin AXIS_DESCR STD_AXIS zff_atsys._.iSignale._.obj.sig_m_t UMR_NM__1_1_0_S6_S3 6 -400 1640 DEPOSIT ABSOLUTE MONOTONY MON_INCREASE /end AXIS_DESCR
/end CHARACTERISTIC
/begin CHARACTERISTIC KF_PKZU65 "Schaltdruck zuschaltende Kupplung" MAP 0x259514 kf_si16_S6_S3 12.75 UMR_BAR__1_1000_0_S6_S3 0 12.75
 /begin AXIS_DESCR STD_AXIS iSasZentr.iSchaltend.n_tkf UMR_U_MIN_32_1_0_S6_S3 8 0 8160 DEPOSIT ABSOLUTE MONOTONY MON_INCREASE /end AXIS_DESCR
 /begin AXIS_DESCR STD_AXIS zff_atsys._.iSignale._.obj.sig_m_t UMR_NM__1_1_0_S6_S3 8 -400 1640 DEPOSIT ABSOLUTE MONOTONY MON_INCREASE /end AXIS_DESCR
/end CHARACTERISTIC
/begin CHARACTERISTIC KF_PKZU65_EL "Schaltdruck zuschaltende Kupplung" MAP 0x2595BC kf_si16_S6_S3 12.75 UMR_BAR__1_1000_0_S6_S3 0 12.75
 /begin AXIS_DESCR STD_AXIS iSasZentr.iSchaltend.n_tkf UMR_U_MIN_32_1_0_S6_S3 8 0 8160 DEPOSIT ABSOLUTE MONOTONY MON_INCREASE /end AXIS_DESCR
 /begin AXIS_DESCR STD_AXIS zff_atsys._.iSignale._.obj.sig_m_t UMR_NM__1_1_0_S6_S3 8 -400 1640 DEPOSIT ABSOLUTE MONOTONY MON_INCREASE /end AXIS_DESCR
/end CHARACTERISTIC
/begin CHARACTERISTIC KF_POHINSYNKZU65 "Kennfeld Haltedruckoffset(n_tkf, m_t) bei Haltephase in Synchron" MAP 0x259664 kf_si16_S6_S3 12.75 UMR_BAR__1_1000_0_S6_S3 -6.4 6.35
 /begin AXIS_DESCR STD_AXIS iSasZentr.iSchaltend.n_tkf UMR_U_MIN_32_1_0_S6_S3 4 0 8160 DEPOSIT ABSOLUTE MONOTONY MON_INCREASE /end AXIS_DESCR
 /begin AXIS_DESCR STD_AXIS zff_atsys._.iSignale._.obj.sig_m_t UMR_NM__1_1_0_S6_S3 4 -400 1640 DEPOSIT ABSOLUTE MONOTONY MON_INCREASE /end AXIS_DESCR
/end CHARACTERISTIC
/begin CHARACTERISTIC KL_TSYNCGHINSYNEKZU65 "Zeit fuer Ende Haltephase in Synchron KZU" CURVE 0x25969C kl_ui8_S6_S3 2550 UMR_MSEC__10_1_M128_S6_S3 -1280 1270
 /begin AXIS_DESCR STD_AXIS zff_atsys._.iSignale._.obj.sig_c_getr UMR_GRADC__1_1_M40_S6_S3 4 -40 150 DEPOSIT ABSOLUTE MONOTONY MON_INCREASE /end AXIS_DESCR
/end CHARACTERISTIC
/begin CHARACTERISTIC F_PRA76 "Druckfaktor waehrend Rampe auf Schaltdruck" VALUE 0x26E923 kw_ui8_S6_S3 1 UMR___1_100_0_S6_S3 0 1 /end CHARACTERISTIC
/begin CHARACTERISTIC F_PRA76_EL "Druckfaktor waehrend Rampe auf Schaltdruck" VALUE 0x26E924 kw_ui8_S6_S3 1 UMR___1_100_0_S6_S3 0 1 /end CHARACTERISTIC
/begin CHARACTERISTIC F_TRA76 "Zeitfaktor waehrend Rampe auf Schaltdruck" VALUE 0x26E925 kw_ui8_S6_S3 1 UMR___1_100_0_S6_S3 0 1 /end CHARACTERISTIC
/begin CHARACTERISTIC F_TRA76_EL "Zeitfaktor waehrend Rampe auf Schaltdruck" VALUE 0x26E926 kw_ui8_S6_S3 1 UMR___1_100_0_S6_S3 0 1 /end CHARACTERISTIC
/begin CHARACTERISTIC T_F76 "Fuellzeit" VALUE 0x26E927 kw_ui8_S6_S3 2540 UMR_MSEC__10_1_0_S6_S3 0 2540 /end CHARACTERISTIC
/begin CHARACTERISTIC T_F76_EL "Fuellzeit" VALUE 0x26E928 kw_ui8_S6_S3 2540 UMR_MSEC__10_1_0_S6_S3 0 2540 /end CHARACTERISTIC
/begin CHARACTERISTIC KL_TRA76 "Kennlinie Zeit Erste Rampe" CURVE 0x2596A8 kl_ui8_S6_S3 2540 UMR_MSEC__10_1_0_S6_S3 0 2540
 /begin AXIS_DESCR STD_AXIS zff_atsys._.iSignale._.obj.sig_m_t8 UMR_NM__8_1_M50_S6_S3 4 -400 1640 DEPOSIT ABSOLUTE MONOTONY MON_INCREASE /end AXIS_DESCR
/end CHARACTERISTIC
/begin CHARACTERISTIC KL_TRA76_EL "Kennlinie Zeit Erste Rampe" CURVE 0x2596B4 kl_ui8_S6_S3 2540 UMR_MSEC__10_1_0_S6_S3 0 2540
 /begin AXIS_DESCR STD_AXIS zff_atsys._.iSignale._.obj.sig_m_t8 UMR_NM__8_1_M50_S6_S3 4 -400 1640 DEPOSIT ABSOLUTE MONOTONY MON_INCREASE /end AXIS_DESCR
/end CHARACTERISTIC
/begin CHARACTERISTIC KL_PGRASYN76 "Schliessrampenradient" CURVE 0x2596C0 kl_si16_S6_S3 6553.4 UMR_BAR_SEC_1_10_0_S6_S3 -3276.7 3276.7
 /begin AXIS_DESCR STD_AXIS zff_atsys._.iSignale._.obj.sig_m_t UMR_NM__1_1_0_S6_S3 6 -400 1640 DEPOSIT ABSOLUTE MONOTONY MON_INCREASE /end AXIS_DESCR
/end CHARACTERISTIC
/begin CHARACTERISTIC KF_POFMTN76 "Kennfeld Fuelldruckoffset(n_t, m_t)" MAP 0x2596DC kf_si16_S6_S3 12.75 UMR_BAR__1_1000_0_S6_S3 -6.4 6.35
 /begin AXIS_DESCR STD_AXIS zff_atsys._.iSignale._.obj.sig_n_t UMR_U_MIN_1_1_0_S6_S3 4 0 8160 DEPOSIT ABSOLUTE MONOTONY MON_INCREASE /end AXIS_DESCR
 /begin AXIS_DESCR STD_AXIS zff_atsys._.iSignale._.obj.sig_m_t UMR_NM__1_1_0_S6_S3 6 -400 1640 DEPOSIT ABSOLUTE MONOTONY MON_INCREASE /end AXIS_DESCR
/end CHARACTERISTIC
/begin CHARACTERISTIC KF_POFMTN76_EL "Kennfeld Fuelldruckoffset(n_t, m_t)" MAP 0x259728 kf_si16_S6_S3 12.75 UMR_BAR__1_1000_0_S6_S3 -6.4 6.35
 /begin AXIS_DESCR STD_AXIS zff_atsys._.iSignale._.obj.sig_n_t UMR_U_MIN_1_1_0_S6_S3 4 0 8160 DEPOSIT ABSOLUTE MONOTONY MON_INCREASE /end AXIS_DESCR
 /begin AXIS_DESCR STD_AXIS zff_atsys._.iSignale._.obj.sig_m_t UMR_NM__1_1_0_S6_S3 6 -400 1640 DEPOSIT ABSOLUTE MONOTONY MON_INCREASE /end AXIS_DESCR
/end CHARACTERISTIC
/begin CHARACTERISTIC KF_PKZU76 "Schaltdruck zuschaltende Kupplung" MAP 0x259774 kf_si16_S6_S3 12.75 UMR_BAR__1_1000_0_S6_S3 0 12.75
 /begin AXIS_DESCR STD_AXIS iSasZentr.iSchaltend.n_tkf UMR_U_MIN_32_1_0_S6_S3 8 0 8160 DEPOSIT ABSOLUTE MONOTONY MON_INCREASE /end AXIS_DESCR
 /begin AXIS_DESCR STD_AXIS zff_atsys._.iSignale._.obj.sig_m_t UMR_NM__1_1_0_S6_S3 8 -400 1640 DEPOSIT ABSOLUTE MONOTONY MON_INCREASE /end AXIS_DESCR
/end CHARACTERISTIC
/begin CHARACTERISTIC KF_PKZU76_EL "Schaltdruck zuschaltende Kupplung" MAP 0x25981C kf_si16_S6_S3 12.75 UMR_BAR__1_1000_0_S6_S3 0 12.75
 /begin AXIS_DESCR STD_AXIS iSasZentr.iSchaltend.n_tkf UMR_U_MIN_32_1_0_S6_S3 8 0 8160 DEPOSIT ABSOLUTE MONOTONY MON_INCREASE /end AXIS_DESCR
 /begin AXIS_DESCR STD_AXIS zff_atsys._.iSignale._.obj.sig_m_t UMR_NM__1_1_0_S6_S3 8 -400 1640 DEPOSIT ABSOLUTE MONOTONY MON_INCREASE /end AXIS_DESCR
/end CHARACTERISTIC
/begin CHARACTERISTIC KF_POHINSYNKZU76 "Kennfeld Haltedruckoffset(n_tkf, m_t) bei Haltephase in Synchron" MAP 0x2598C4 kf_si16_S6_S3 12.75 UMR_BAR__1_1000_0_S6_S3 -6.4 6.35
 /begin AXIS_DESCR STD_AXIS iSasZentr.iSchaltend.n_tkf UMR_U_MIN_32_1_0_S6_S3 4 0 8160 DEPOSIT ABSOLUTE MONOTONY MON_INCREASE /end AXIS_DESCR
 /begin AXIS_DESCR STD_AXIS zff_atsys._.iSignale._.obj.sig_m_t UMR_NM__1_1_0_S6_S3 4 -400 1640 DEPOSIT ABSOLUTE MONOTONY MON_INCREASE /end AXIS_DESCR
/end CHARACTERISTIC
/begin CHARACTERISTIC KL_TSYNCGHINSYNEKZU76 "Zeit fuer Ende Haltephase in Synchron KZU" CURVE 0x2598FC kl_ui8_S6_S3 2550 UMR_MSEC__10_1_M128_S6_S3 -1280 1270
 /begin AXIS_DESCR STD_AXIS zff_atsys._.iSignale._.obj.sig_c_getr UMR_GRADC__1_1_M40_S6_S3 4 -40 150 DEPOSIT ABSOLUTE MONOTONY MON_INCREASE /end AXIS_DESCR
/end CHARACTERISTIC
/begin COMPU_METHOD SAB_A_MPSS32_M16_S2_S3 "int = ((phys * 32) / 1) - (-512) m/s^2" RAT_FUNC "%5.3" "m/s^2" COEFFS 0 32 512 0 0 1 /end COMPU_METHOD
/begin COMPU_METHOD SAB_A_MPSS10_M150_S2_S3 "int = ((phys * 10) / 1) - (-15) m/s^2" RAT_FUNC "%5.3" "m/s^2" COEFFS 0 10 15 0 0 1 /end COMPU_METHOD
/begin COMPU_METHOD SAB_A_MPSS10_S2_S3 "int = ((phys * 10) / 1) - (0) m/s^2" RAT_FUNC "%5.3" "m/s^2" COEFFS 0 10 -0 0 0 1 /end COMPU_METHOD
/begin COMPU_METHOD SAB_A_MPSS32_M126_S2_S3 "int = ((phys * 32) / 1) - (-126) m/s^2" RAT_FUNC "%5.3" "m/s^2" COEFFS 0 32 126 0 0 1 /end COMPU_METHOD
/begin COMPU_METHOD SAB_A_1MPSS40_M2048_S2_S3 "int = ((phys * 40) / 1) - (-2048) m/s^2" RAT_FUNC "%5.3" "m/s^2" COEFFS 0 40 2048 0 0 1 /end COMPU_METHOD
/begin COMPU_METHOD SAB_A_024MPSS1000_S2_S3 "int = ((phys * 1000) / 24) - (0) m/s^2" RAT_FUNC "%5.3" "m/s^2" COEFFS 0 1000 -0 0 0 24 /end COMPU_METHOD
/begin COMPU_METHOD UMR___1_100_0_S6_S3 "int = ((phys * 100) / 1) - (0) [-]" RAT_FUNC "%4.2" "[-]" COEFFS 0 100 -0 0 0 1 /end COMPU_METHOD
/begin COMPU_METHOD UMR_NM__1_1_0_S6_S3 "int = ((phys * 1) / 1) - (0) [Nm]" RAT_FUNC "%2.0" "[Nm]" COEFFS 0 1 -0 0 0 1 /end COMPU_METHOD
/begin COMPU_METHOD UMR_NM__8_1_M50_S6_S3 "int = ((phys * 1) / 8) - (-50) [Nm]" RAT_FUNC "%2.0" "[Nm]" COEFFS 0 1 400 0 0 8 /end COMPU_METHOD
/begin COMPU_METHOD UMR_BAR__1_1000_0_S6_S3 "int = ((phys * 1000) / 1) - (0) [bar]" RAT_FUNC "%5.3" "[bar]" COEFFS 0 1000 -0 0 0 1 /end COMPU_METHOD
/begin COMPU_METHOD UMR_BAR_SEC_1_10_0_S6_S3 "int = ((phys * 10) / 1) - (0) [bar/s]" RAT_FUNC "%3.1" "[bar/s]" COEFFS 0 10 -0 0 0 1 /end COMPU_METHOD
/begin COMPU_METHOD UMR_U_MIN_1_1_0_S6_S3 "int = ((phys * 1) / 1) - (0) [U/min]" RAT_FUNC "%2.0" "[U/min]" COEFFS 0 1 -0 0 0 1 /end COMPU_METHOD
/begin COMPU_METHOD UMR_U_MIN_32_1_0_S6_S3 "int = ((phys * 1) / 32) - (0) [U/min]" RAT_FUNC "%2.0" "[U/min]" COEFFS 0 1 -0 0 0 32 /end COMPU_METHOD
/begin COMPU_METHOD UMR_MSEC__10_1_0_S6_S3 "int = ((phys * 1) / 10) - (0) [ms]" RAT_FUNC "%2.0" "[ms]" COEFFS 0 1 -0 0 0 10 /end COMPU_METHOD
/begin COMPU_METHOD UMR_MSEC__10_1_M128_S6_S3 "int = ((phys * 1) / 10) - (-128) [ms]" RAT_FUNC "%2.0" "[ms]" COEFFS 0 1 1280 0 0 10 /end COMPU_METHOD
/begin COMPU_METHOD UMR_GRADC__1_1_M40_S6_S3 "int = ((phys * 1) / 1) - (-40) [°C]" RAT_FUNC "%2.0" "[°C]" COEFFS 0 1 40 0 0 1 /end COMPU_METHOD
/begin FUNCTION jSasKzuHSP212_Fktn "Applikationesgroessen Instanz jSasKzuHSP212"
 /begin DEF_CHARACTERISTIC F_PRASP12 F_TRASP12 KF_PGOKZUMTNTSP12 KF_PKZUSP12 KF_POFMTNSP12 KF_POKZUMTCGSP12 KF_T2_DT_IG_CHANGESP12 KF_TFCGNTSP12 KF_TRAMTNTSP12 KF_T_DT_IG_CHANGESP12 KL_TSYNMTRAKZUSP12 T_VKZUSP12 /end DEF_CHARACTERISTIC
/end FUNCTION
/begin FUNCTION jSasKzuHSP223_Fktn "Applikationesgroessen Instanz jSasKzuHSP223"
 /begin DEF_CHARACTERISTIC F_PRASP23 F_TRASP23 KF_PGOKZUMTNTSP23 KF_PKZUSP23 KF_POFMTNSP23 KF_POKZUMTCGSP23 KF_T2_DT_IG_CHANGESP23 KF_TFCGNTSP23 KF_TRAMTNTSP23 KF_T_DT_IG_CHANGESP23 KL_TSYNMTRAKZUSP23 T_VKZUSP23 /end DEF_CHARACTERISTIC
/end FUNCTION
/begin FUNCTION jSasKzuHSP234_Fktn "Applikationesgroessen Instanz jSasKzuHSP234"
 /begin DEF_CHARACTERISTIC F_PRASP34 F_TRASP34 KF_PGOKZUMTNTSP34 KF_PKZUSP34 KF_POFMTNSP34 KF_POKZUMTCGSP34 KF_T2_DT_IG_CHANGESP34 KF_TFCGNTSP34 KF_TRAMTNTSP34 KF_T_DT_IG_CHANGESP34 KL_TSYNMTRAKZUSP34 T_VKZUSP34 /end DEF_CHARACTERISTIC
/end FUNCTION
/begin FUNCTION jSasKzuHSP245_Fktn "Applikationesgroessen Instanz jSasKzuHSP245"
 /begin DEF_CHARACTERISTIC F_PRASP45 F_TRASP45 KF_PGOKZUMTNTSP45 KF_PKZUSP45 KF_POFMTNSP45 KF_POKZUMTCGSP45 KF_T2_DT_IG_CHANGESP45 KF_TFCGNTSP45 KF_TRAMTNTSP45 KF_T_DT_IG_CHANGESP45 KL_TSYNMTRAKZUSP45 T_VKZUSP45 /end DEF_CHARACTERISTIC
/end FUNCTION
/begin FUNCTION jSasKzuHSP256_Fktn "Applikationesgroessen Instanz jSasKzuHSP256"
 /begin DEF_CHARACTERISTIC F_PRASP56 F_TRASP56 KF_PGOKZUMTNTSP56 KF_PKZUSP56 KF_POFMTNSP56 KF_POKZUMTCGSP56 KF_T2_DT_IG_CHANGESP56 KF_TFCGNTSP56 KF_TRAMTNTSP56 KF_T_DT_IG_CHANGESP56 KL_TSYNMTRAKZUSP56 T_VKZUSP56 /end DEF_CHARACTERISTIC
/end FUNCTION
/begin FUNCTION jSasKzuHSP267_Fktn "Applikationesgroessen Instanz jSasKzuHSP267"
 /begin DEF_CHARACTERISTIC F_PRASP67 F_TRASP67 KF_PGOKZUMTNTSP67 KF_PKZUSP67 KF_POFMTNSP67 KF_POKZUMTCGSP67 KF_T2_DT_IG_CHANGESP67 KF_TFCGNTSP67 KF_TRAMTNTSP67 KF_T_DT_IG_CHANGESP67 KL_TSYNMTRAKZUSP67 T_VKZUSP67 /end DEF_CHARACTERISTIC
/end FUNCTION
/begin FUNCTION jSasKzuHSP278_Fktn "Applikationesgroessen Instanz jSasKzuHSP278"
 /begin DEF_CHARACTERISTIC F_PRASP78 F_TRASP78 KF_PGOKZUMTNTSP78 KF_PKZUSP78 KF_POFMTNSP78 KF_POKZUMTCGSP78 KF_T2_DT_IG_CHANGESP78 KF_TFCGNTSP78 KF_TRAMTNTSP78 KF_T_DT_IG_CHANGESP78 KL_TSYNMTRAKZUSP78 T_VKZUSP78 /end DEF_CHARACTERISTIC
/end FUNCTION
/begin FUNCTION jSasKzuHSP312_Fktn "Applikationesgroessen Instanz jSasKzuHSP312"
 /begin DEF_CHARACTERISTIC F_PRASPORT12 F_TRASPORT12 KF_PGOKZUMTNTSPORT12 KF_PKZUSPORT12 KF_POFMTNSPORT12 KF_POKZUMTCGSPORT12 KF_T2_DT_IG_CHANGESPORT12 KF_TFCGNTSPORT12 KF_TRAMTNTSPORT12 KF_T_DT_IG_CHANGESPORT12 KL_TSYNMTRAKZUSPORT12 T_VKZUSPORT12 /end DEF_CHARACTERISTIC
/end FUNCTION
/begin FUNCTION jSasKzuHSP323_Fktn "Applikationesgroessen Instanz jSasKzuHSP323"
 /begin DEF_CHARACTERISTIC F_PRASPORT23 F_TRASPORT23 KF_PGOKZUMTNTSPORT23 KF_PKZUSPORT23 KF_POFMTNSPORT23 KF_POKZUMTCGSPORT23 KF_T2_DT_IG_CHANGESPORT23 KF_TFCGNTSPORT23 KF_TRAMTNTSPORT23 KF_T_DT_IG_CHANGESPORT23 KL_TSYNMTRAKZUSPORT23 T_VKZUSPORT23 /end DEF_CHARACTERISTIC
/end FUNCTION
/begin FUNCTION jSasKzuHSP334_Fktn "Applikationesgroessen Instanz jSasKzuHSP334"
 /begin DEF_CHARACTERISTIC F_PRASPORT34 F_TRASPORT34 KF_PGOKZUMTNTSPORT34 KF_PKZUSPORT34 KF_POFMTNSPORT34 KF_POKZUMTCGSPORT34 KF_T2_DT_IG_CHANGESPORT34 KF_TFCGNTSPORT34 KF_TRAMTNTSPORT34 KF_T_DT_IG_CHANGESPORT34 KL_TSYNMTRAKZUSPORT34 T_VKZUSPORT34 /end DEF_CHARACTERISTIC
/end FUNCTION
/begin FUNCTION jSasKzuHSP345_Fktn "Applikationesgroessen Instanz jSasKzuHSP345"
 /begin DEF_CHARACTERISTIC F_PRASPORT45 F_TRASPORT45 KF_PGOKZUMTNTSPORT45 KF_PKZUSPORT45 KF_POFMTNSPORT45 KF_POKZUMTCGSPORT45 KF_T2_DT_IG_CHANGESPORT45 KF_TFCGNTSPORT45 KF_TRAMTNTSPORT45 KF_T_DT_IG_CHANGESPORT45 KL_TSYNMTRAKZUSPORT45 T_VKZUSPORT45 /end DEF_CHARACTERISTIC
/end FUNCTION
/begin FUNCTION jSasKzuHSP356_Fktn "Applikationesgroessen Instanz jSasKzuHSP356"
 /begin DEF_CHARACTERISTIC F_PRASPORT56 F_TRASPORT56 KF_PGOKZUMTNTSPORT56 KF_PKZUSPORT56 KF_POFMTNSPORT56 KF_POKZUMTCGSPORT56 KF_T2_DT_IG_CHANGESPORT56 KF_TFCGNTSPORT56 KF_TRAMTNTSPORT56 KF_T_DT_IG_CHANGESPORT56 KL_TSYNMTRAKZUSPORT56 T_VKZUSPORT56 /end DEF_CHARACTERISTIC
/end FUNCTION
/begin FUNCTION jSasKzuHSP367_Fktn "Applikationesgroessen Instanz jSasKzuHSP367"
 /begin DEF_CHARACTERISTIC F_PRASPORT67 F_TRASPORT67 KF_PGOKZUMTNTSPORT67 KF_PKZUSPORT67 KF_POFMTNSPORT67 KF_POKZUMTCGSPORT67 KF_T2_DT_IG_CHANGESPORT67 KF_TFCGNTSPORT67 KF_TRAMTNTSPORT67 KF_T_DT_IG_CHANGESPORT67 KL_TSYNMTRAKZUSPORT67 T_VKZUSPORT67 /end DEF_CHARACTERISTIC
/end FUNCTION
/begin FUNCTION jSasKzuHSP378_Fktn "Applikationesgroessen Instanz jSasKzuHSP378"
 /begin DEF_CHARACTERISTIC F_PRASPORT78 F_TRASPORT78 KF_PGOKZUMTNTSPORT78 KF_PKZUSPORT78 KF_POFMTNSPORT78 KF_POKZUMTCGSPORT78 KF_T2_DT_IG_CHANGESPORT78 KF_TFCGNTSPORT78 KF_TRAMTNTSPORT78 KF_T_DT_IG_CHANGESPORT78 KL_TSYNMTRAKZUSPORT78 T_VKZUSPORT78 /end DEF_CHARACTERISTIC
/end FUNCTION
/begin FUNCTION jSasKzuHSP113_Fktn "Applikationesgroessen Instanz jSasKzuHSP113"
 /begin DEF_CHARACTERISTIC F_PRA13 F_TRA13 KF_PGOKZUMTNT13 KF_PKZU13 KF_POFMTN13 KF_POKZUMTCG13 KF_POKZUMTCG13_EL KF_T2_DT_IG_CHANGE13 KF_TFCGNT13 KF_TRAMTNT13 KF_T_DT_IG_CHANGE13 KL_TSYNMTRAKZU13 T_VKZU13 /end DEF_CHARACTERISTIC
/end FUNCTION
/begin FUNCTION jSasKzuHSP124_Fktn "Applikationesgroessen Instanz jSasKzuHSP124"
 /begin DEF_CHARACTERISTIC F_PRA24 F_TRA24 KF_PGOKZUMTNT24 KF_PKZU24 KF_POFMTN24 KF_POKZUMTCG24 KF_POKZUMTCG24_EL KF_T2_DT_IG_CHANGE24 KF_TFCGNT24 KF_TRAMTNT24 KF_T_DT_IG_CHANGE24 KL_TSYNMTRAKZU24 T_VKZU24 /end DEF_CHARACTERISTIC
/end FUNCTION
/begin FUNCTION jSasKzuHSP135_Fktn "Applikationesgroessen Instanz jSasKzuHSP135"
 /begin DEF_CHARACTERISTIC F_PRA35 F_TRA35 KF_PGOKZUMTNT35 KF_PKZU35 KF_POFMTN35 KF_POKZUMTCG35 KF_POKZUMTCG35_EL KF_T2_DT_IG_CHANGE35 KF_TFCGNT35 KF_TRAMTNT35 KF_T_DT_IG_CHANGE35 KL_TSYNMTRAKZU35 T_VKZU35 /end DEF_CHARACTERISTIC
/end FUNCTION
/begin FUNCTION jSasKzuHSP146_Fktn "Applikationesgroessen Instanz jSasKzuHSP146"
 /begin DEF_CHARACTERISTIC F_PRA46 F_TRA46 KF_PGOKZUMTNT46 KF_PKZU46 KF_POFMTN46 KF_POKZUMTCG46 KF_POKZUMTCG46_EL KF_T2_DT_IG_CHANGE46 KF_TFCGNT46 KF_TRAMTNT46 KF_T_DT_IG_CHANGE46 KL_TSYNMTRAKZU46 T_VKZU46 /end DEF_CHARACTERISTIC
/end FUNCTION
/begin FUNCTION jSasKzuHSP157_Fktn "Applikationesgroessen Instanz jSasKzuHSP157"
 /begin DEF_CHARACTERISTIC F_PRA57 F_TRA57 KF_PGOKZUMTNT57 KF_PKZU57 KF_POFMTN57 KF_POKZUMTCG57 KF_POKZUMTCG57_EL KF_T2_DT_IG_CHANGE57 KF_TFCGNT57 KF_TRAMTNT57 KF_T_DT_IG_CHANGE57 KL_TSYNMTRAKZU57 T_VKZU57 /end DEF_CHARACTERISTIC
/end FUNCTION
/begin FUNCTION jSasKzuHSP168_Fktn "Applikationesgroessen Instanz jSasKzuHSP168"
 /begin DEF_CHARACTERISTIC F_PRA68 F_TRA68 KF_PGOKZUMTNT68 KF_PKZU68 KF_POFMTN68 KF_POKZUMTCG68 KF_POKZUMTCG68_EL KF_T2_DT_IG_CHANGE68 KF_TFCGNT68 KF_TRAMTNT68 KF_T_DT_IG_CHANGE68 KL_TSYNMTRAKZU68 T_VKZU68 /end DEF_CHARACTERISTIC
/end FUNCTION
/begin FUNCTION jSasKzuHSP213_Fktn "Applikationesgroessen Instanz jSasKzuHSP213"
 /begin DEF_CHARACTERISTIC F_PRASP13 F_TRASP13 KF_PGOKZUMTNTSP13 KF_PKZUSP13 KF_POFMTNSP13 KF_POKZUMTCGSP13 KF_T2_DT_IG_CHANGESP13 KF_TFCGNTSP13 KF_TRAMTNTSP13 KF_T_DT_IG_CHANGESP13 KL_TSYNMTRAKZUSP13 T_VKZUSP13 /end DEF_CHARACTERISTIC
/end FUNCTION
/begin FUNCTION jSasKzuHSP224_Fktn "Applikationesgroessen Instanz jSasKzuHSP224"
 /begin DEF_CHARACTERISTIC F_PRASP24 F_TRASP24 KF_PGOKZUMTNTSP24 KF_PKZUSP24 KF_POFMTNSP24 KF_POKZUMTCGSP24 KF_T2_DT_IG_CHANGESP24 KF_TFCGNTSP24 KF_TRAMTNTSP24 KF_T_DT_IG_CHANGESP24 KL_TSYNMTRAKZUSP24 T_VKZUSP24 /end DEF_CHARACTERISTIC
/end FUNCTION
/begin FUNCTION jSasKzuHSP235_Fktn "Applikationesgroessen Instanz jSasKzuHSP235"
 /begin DEF_CHARACTERISTIC F_PRASP35 F_TRASP35 KF_PGOKZUMTNTSP35 KF_PKZUSP35 KF_POFMTNSP35 KF_POKZUMTCGSP35 KF_T2_DT_IG_CHANGESP35 KF_TFCGNTSP35 KF_TRAMTNTSP35 KF_T_DT_IG_CHANGESP35 KL_TSYNMTRAKZUSP35 T_VKZUSP35 /end DEF_CHARACTERISTIC
/end FUNCTION
/begin FUNCTION jSasKzuHSP246_Fktn "Applikationesgroessen Instanz jSasKzuHSP246"
 /begin DEF_CHARACTERISTIC F_PRASP46 F_TRASP46 KF_PGOKZUMTNTSP46 KF_PKZUSP46 KF_POFMTNSP46 KF_POKZUMTCGSP46 KF_T2_DT_IG_CHANGESP46 KF_TFCGNTSP46 KF_TRAMTNTSP46 KF_T_DT_IG_CHANGESP46 KL_TSYNMTRAKZUSP46 T_VKZUSP46 /end DEF_CHARACTERISTIC
/end FUNCTION
/begin FUNCTION jSasKzuHSP257_Fktn "Applikationesgroessen Instanz jSasKzuHSP257"
 /begin DEF_CHARACTERISTIC F_PRASP57 F_TRASP57 KF_PGOKZUMTNTSP57 KF_PKZUSP57 KF_POFMTNSP57 KF_POKZUMTCGSP57 KF_T2_DT_IG_CHANGESP57 KF_TFCGNTSP57 KF_TRAMTNTSP57 KF_T_DT_IG_CHANGESP57 KL_TSYNMTRAKZUSP57 T_VKZUSP57 /end DEF_CHARACTERISTIC
/end FUNCTION
/begin FUNCTION jSasKzuHSP268_Fktn "Applikationesgroessen Instanz jSasKzuHSP268"
 /begin DEF_CHARACTERISTIC F_PRASP68 F_TRASP68 KF_PGOKZUMTNTSP68 KF_PKZUSP68 KF_POFMTNSP68 KF_POKZUMTCGSP68 KF_T2_DT_IG_CHANGESP68 KF_TFCGNTSP68 KF_TRAMTNTSP68 KF_T_DT_IG_CHANGESP68 KL_TSYNMTRAKZUSP68 T_VKZUSP68 /end DEF_CHARACTERISTIC
/end FUNCTION
/begin FUNCTION jSasKzuHSP313_Fktn "Applikationesgroessen Instanz jSasKzuHSP313"
 /begin DEF_CHARACTERISTIC F_PRASPORT13 F_TRASPORT13 KF_PGOKZUMTNTSPORT13 KF_PKZUSPORT13 KF_POFMTNSPORT13 KF_POKZUMTCGSPORT13 KF_T2_DT_IG_CHANGESPORT13 KF_TFCGNTSPORT13 KF_TRAMTNTSPORT13 KF_T_DT_IG_CHANGESPORT13 KL_TSYNMTRAKZUSPORT13 T_VKZUSPORT13 /end DEF_CHARACTERISTIC
/end FUNCTION
/begin FUNCTION jSasKzuHSP324_Fktn "Applikationesgroessen Instanz jSasKzuHSP324"
 /begin DEF_CHARACTERISTIC F_PRASPORT24 F_TRASPORT24 KF_PGOKZUMTNTSPORT24 KF_PKZUSPORT24 KF_POFMTNSPORT24 KF_POKZUMTCGSPORT24 KF_T2_DT_IG_CHANGESPORT24 KF_TFCGNTSPORT24 KF_TRAMTNTSPORT24 KF_T_DT_IG_CHANGESPORT24 KL_TSYNMTRAKZUSPORT24 T_VKZUSPORT24 /end DEF_CHARACTERISTIC
/end FUNCTION
/begin FUNCTION jSasKzuHSP335_Fktn "Applikationesgroessen Instanz jSasKzuHSP335"
 /begin DEF_CHARACTERISTIC F_PRASPORT35 F_TRASPORT35 KF_PGOKZUMTNTSPORT35 KF_PKZUSPORT35 KF_POFMTNSPORT35 KF_POKZUMTCGSPORT35 KF_T2_DT_IG_CHANGESPORT35 KF_TFCGNTSPORT35 KF_TRAMTNTSPORT35 KF_T_DT_IG_CHANGESPORT35 KL_TSYNMTRAKZUSPORT35 T_VKZUSPORT35 /end DEF_CHARACTERISTIC
/end FUNCTION
/begin FUNCTION jSasKzuHSP346_Fktn "Applikationesgroessen Instanz jSasKzuHSP346"
 /begin DEF_CHARACTERISTIC F_PRASPORT46 F_TRASPORT46 KF_PGOKZUMTNTSPORT46 KF_PKZUSPORT46 KF_POFMTNSPORT46 KF_POKZUMTCGSPORT46 KF_T2_DT_IG_CHANGESPORT46 KF_TFCGNTSPORT46 KF_TRAMTNTSPORT46 KF_T_DT_IG_CHANGESPORT46 KL_TSYNMTRAKZUSPORT46 T_VKZUSPORT46 /end DEF_CHARACTERISTIC
/end FUNCTION
/begin FUNCTION jSasKzuHSP357_Fktn "Applikationesgroessen Instanz jSasKzuHSP357"
 /begin DEF_CHARACTERISTIC F_PRASPORT57 F_TRASPORT57 KF_PGOKZUMTNTSPORT57 KF_PKZUSPORT57 KF_POFMTNSPORT57 KF_POKZUMTCGSPORT57 KF_T2_DT_IG_CHANGESPORT57 KF_TFCGNTSPORT57 KF_TRAMTNTSPORT57 KF_T_DT_IG_CHANGESPORT57 KL_TSYNMTRAKZUSPORT57 T_VKZUSPORT57 /end DEF_CHARACTERISTIC
/end FUNCTION
/begin FUNCTION jSasKzuHSP368_Fktn "Applikationesgroessen Instanz jSasKzuHSP368"
 /begin DEF_CHARACTERISTIC F_PRASPORT68 F_TRASPORT68 KF_PGOKZUMTNTSPORT68 KF_PKZUSPORT68 KF_POFMTNSPORT68 KF_POKZUMTCGSPORT68 KF_T2_DT_IG_CHANGESPORT68 KF_TFCGNTSPORT68 KF_TRAMTNTSPORT68 KF_T_DT_IG_CHANGESPORT68 KL_TSYNMTRAKZUSPORT68 T_VKZUSPORT68 /end DEF_CHARACTERISTIC
/end FUNCTION
/begin FUNCTION dSasKzuEHS_Fktn "Applikationesgroessen der Komponente dSasKzuEHS"
 /begin SUB_FUNCTION jSasKzuEHS12_Fktn jSasKzuEHS23_Fktn jSasKzuEHS34_Fktn jSasKzuEHS45_Fktn jSasKzuEHS56_Fktn jSasKzuEHS67_Fktn jSasKzuEHS78_Fktn /end SUB_FUNCTION
/end FUNCTION
/begin FUNCTION jSasKzuEHS12_Fktn "Applikationesgroessen Instanz jSasKzuEHS12" /begin DEF_CHARACTERISTIC KL_TSYNMTFKZUV12 KL_TSYNMTKZUSFV12 /end DEF_CHARACTERISTIC /end FUNCTION
/begin FUNCTION jSasKzuEHS23_Fktn "Applikationesgroessen Instanz jSasKzuEHS23" /begin DEF_CHARACTERISTIC KL_TSYNMTFKZUV23 KL_TSYNMTKZUSFV23 /end DEF_CHARACTERISTIC /end FUNCTION
/begin FUNCTION jSasKzuEHS34_Fktn "Applikationesgroessen Instanz jSasKzuEHS34" /begin DEF_CHARACTERISTIC KL_TSYNMTFKZUV34 KL_TSYNMTKZUSFV34 /end DEF_CHARACTERISTIC /end FUNCTION
/begin FUNCTION jSasKzuEHS45_Fktn "Applikationesgroessen Instanz jSasKzuEHS45" /begin DEF_CHARACTERISTIC KL_TSYNMTFKZUV45 KL_TSYNMTKZUSFV45 /end DEF_CHARACTERISTIC /end FUNCTION
/begin FUNCTION jSasKzuEHS56_Fktn "Applikationesgroessen Instanz jSasKzuEHS56" /begin DEF_CHARACTERISTIC KL_TSYNMTFKZUV56 KL_TSYNMTKZUSFV56 /end DEF_CHARACTERISTIC /end FUNCTION
/begin FUNCTION jSasKzuEHS67_Fktn "Applikationesgroessen Instanz jSasKzuEHS67" /begin DEF_CHARACTERISTIC KL_TSYNMTFKZUV67 KL_TSYNMTKZUSFV67 /end DEF_CHARACTERISTIC /end FUNCTION
/begin FUNCTION jSasKzuEHS78_Fktn "Applikationesgroessen Instanz jSasKzuEHS78" /begin DEF_CHARACTERISTIC KL_TSYNMTFKZUV78 KL_TSYNMTKZUSFV78 /end DEF_CHARACTERISTIC /end FUNCTION
/begin FUNCTION dSasKzuRSP_Fktn "Applikationesgroessen der Komponente dSasKzuRSP"
 /begin SUB_FUNCTION jSasKzuRSP121_Fktn jSasKzuRSP132_Fktn jSasKzuRSP143_Fktn jSasKzuRSP154_Fktn jSasKzuRSP165_Fktn jSasKzuRSP176_Fktn jSasKzuRSP187_Fktn jSasKzuRSP221_Fktn jSasKzuRSP232_Fktn jSasKzuRSP243_Fktn jSasKzuRSP254_Fktn jSasKzuRSP265_Fktn jSasKzuRSP276_Fktn jSasKzuRSP287_Fktn jSasKzuRSP231_Fktn jSasKzuRSP242_Fktn jSasKzuRSP251_Fktn jSasKzuRSP253_Fktn jSasKzuRSP263_Fktn jSasKzuRSP264_Fktn jSasKzuRSP271_Fktn jSasKzuRSP275_Fktn jSasKzuRSP282_Fktn jSasKzuRSP284_Fktn jSasKzuRSP286_Fktn jSasKzuRSP321_Fktn jSasKzuRSP332_Fktn jSasKzuRSP343_Fktn jSasKzuRSP354_Fktn jSasKzuRSP365_Fktn jSasKzuRSP376_Fktn jSasKzuRSP387_Fktn jSasKzuRSP331_Fktn jSasKzuRSP342_Fktn jSasKzuRSP351_Fktn jSasKzuRSP353_Fktn jSasKzuRSP363_Fktn jSasKzuRSP364_Fktn jSasKzuRSP371_Fktn jSasKzuRSP375_Fktn jSasKzuRSP382_Fktn jSasKzuRSP384_Fktn jSasKzuRSP386_Fktn /end SUB_FUNCTION
/end FUNCTION
/begin FUNCTION jSasKzuRSP121_Fktn "Applikationesgroessen Instanz jSasKzuRSP121"
 /begin DEF_CHARACTERISTIC F_PRA21 F_PRA21_EL F_TRA21 F_TRA21_EL KF_PKZU21 KF_PKZU21_EL KF_POFMTN21 KF_POFMTN21_EL KF_POHINSYNKZU21 KL_PGRASYN21 KL_TRA21 KL_TRA21_EL KL_TSYNCGHINSYNEKZU21 T_F21 T_F21_EL /end DEF_CHARACTERISTIC
/end FUNCTION
/begin FUNCTION jSasKzuRSP132_Fktn "Applikationesgroessen Instanz jSasKzuRSP132"
 /begin DEF_CHARACTERISTIC F_PRA32 F_PRA32_EL F_TRA32 F_TRA32_EL KF_PKZU32 KF_PKZU32_EL KF_POFMTN32 KF_POFMTN32_EL KF_POHINSYNKZU32 KL_PGRASYN32 KL_TRA32 KL_TRA32_EL KL_TSYNCGHINSYNEKZU32 T_F32 T_F32_EL /end DEF_CHARACTERISTIC
/end FUNCTION
/begin FUNCTION jSasKzuRSP143_Fktn "Applikationesgroessen Instanz jSasKzuRSP143"
 /begin DEF_CHARACTERISTIC F_PRA43 F_PRA43_EL F_TRA43 F_TRA43_EL KF_PKZU43 KF_PKZU43_EL KF_POFMTN43 KF_POFMTN43_EL KF_POHINSYNKZU43 KL_PGRASYN43 KL_TRA43 KL_TRA43_EL KL_TSYNCGHINSYNEKZU43 T_F43 T_F43_EL /end DEF_CHARACTERISTIC
/end FUNCTION
/begin FUNCTION jSasKzuRSP154_Fktn "Applikationesgroessen Instanz jSasKzuRSP154"
 /begin DEF_CHARACTERISTIC F_PRA54 F_PRA54_EL F_TRA54 F_TRA54_EL KF_PKZU54 KF_PKZU54_EL KF_POFMTN54 KF_POFMTN54_EL KF_POHINSYNKZU54 KL_PGRASYN54 KL_TRA54 KL_TRA54_EL KL_TSYNCGHINSYNEKZU54 T_F54 T_F54_EL /end DEF_CHARACTERISTIC
/end FUNCTION
/begin FUNCTION jSasKzuRSP165_Fktn "Applikationesgroessen Instanz jSasKzuRSP165"
 /begin DEF_CHARACTERISTIC F_PRA65 F_PRA65_EL F_TRA65 F_TRA65_EL KF_PKZU65 KF_PKZU65_EL KF_POFMTN65 KF_POFMTN65_EL KF_POHINSYNKZU65 KL_PGRASYN65 KL_TRA65 KL_TRA65_EL KL_TSYNCGHINSYNEKZU65 T_F65 T_F65_EL /end DEF_CHARACTERISTIC
/end FUNCTION
/begin FUNCTION jSasKzuRSP176_Fktn "Applikationesgroessen Instanz jSasKzuRSP176"
 /begin DEF_CHARACTERISTIC F_PRA76 F_PRA76_EL F_TRA76 F_TRA76_EL KF_PKZU76 KF_PKZU76_EL KF_POFMTN76 KF_POFMTN76_EL KF_POHINSYNKZU76 KL_PGRASYN76 KL_TRA76 KL_TRA76_EL KL_TSYNCGHINSYNEKZU76 T_F76 T_F76_EL /end DEF_CHARACTERISTIC
/end FUNCTION
/begin RECORD_LAYOUT kw_ui8_S6_S3 FNC_VALUES 1 UBYTE COLUMN_DIR DIRECT /end RECORD_LAYOUT
/begin RECORD_LAYOUT kl_ui8_S6_S3 FNC_VALUES 3 UBYTE COLUMN_DIR DIRECT AXIS_PTS_X 2 UBYTE INDEX_INCR DIRECT NO_AXIS_PTS_X 1 ULONG /end RECORD_LAYOUT
/begin RECORD_LAYOUT kl_si16_S6_S3 FNC_VALUES 3 SWORD COLUMN_DIR DIRECT AXIS_PTS_X 2 SWORD INDEX_INCR DIRECT NO_AXIS_PTS_X 1 ULONG /end RECORD_LAYOUT
/begin RECORD_LAYOUT kf_ui8_S6_S3 FNC_VALUES 5 UBYTE ROW_DIR DIRECT AXIS_PTS_X 3 UBYTE INDEX_INCR DIRECT AXIS_PTS_Y 4 UBYTE INDEX_INCR DIRECT NO_AXIS_PTS_X 1 ULONG NO_AXIS_PTS_Y 2 ULONG /end RECORD_LAYOUT
/begin RECORD_LAYOUT kf_si16_S6_S3 FNC_VALUES 5 SWORD ROW_DIR DIRECT AXIS_PTS_X 3 SWORD INDEX_INCR DIRECT AXIS_PTS_Y 4 SWORD INDEX_INCR DIRECT NO_AXIS_PTS_X 1 ULONG NO_AXIS_PTS_Y 2 ULONG /end RECORD_LAYOUT
/end MODULE
/end PROJECT
