ASAP2_VERSION 1 51
/begin PROJECT _929_929 "Gen2_BMW_System_Supplier_Lib"
/begin HEADER "" VERSION "C_03_03" PROJECT_NO _929_929 /end HEADER
/begin MODULE DIM ""
/begin MOD_COMMON "" BYTE_ORDER MSB_FIRST ALIGNMENT_BYTE 1 ALIGNMENT_WORD 2 ALIGNMENT_LONG 4 ALIGNMENT_FLOAT32_IEEE 4 /end MOD_COMMON
/begin CHARACTERISTIC SWI_UNTERDR_ME "Schalter zur aktivierung Motoreingriffsunterdrückung bei unterschrittener Motorleerlaufdrehzahl" VALUE 0x26E56F kw_bool8_S6_S3 1 UMR___1_1_0_S6_S3 0 1 /end CHARACTERISTIC
/begin CHARACTERISTIC NS_HYS_UNTERDR_ME "Hysterese der Drehzahlschwelle für deaktivierung Motoreingriffsunterdrückung" VALUE 0x26D7CC kw_ui16_S6_S3 500 UMR_U_MIN_1_1_0_S6_S3 0 500 /end CHARACTERISTIC
/begin CHARACTERISTIC KL_UNTERDRNGNMOT "VM-Gradientenabhängiger Offset für Reduzierender ME bei Unterschreitung von n_mot_solleer" CURVE 0x22AEF8 kl_si16_S6_S3 1000 UMR_U_MIN_1_1_0_S6_S3 0 1000
 /begin AXIS_DESCR STD_AXIS iItfInput.ng_mot UMR_U_MINSEC_1_1_0_S6_S3 4 -10000 10000 DEPOSIT ABSOLUTE MONOTONY MON_INCREASE /end AXIS_DESCR
/end CHARACTERISTIC
/begin CHARACTERISTIC SWI_MEKLASS "Schalter zur aktivierung der Motoreingriffsklassifizierung" VALUE 0x26E570 kw_bool8_S6_S3 1 UMR___1_1_0_S6_S3 0 1 /end CHARACTERISTIC
/begin CHARACTERISTIC TAB_SWI_MEQS0LM_KLASS "Schaltungsabhängige Tabelle zur aktivierung ME über Luft bei Normalen (QS0) Schaltungen" MAP 0x22AF0C tab2d_ui8_S6_S3 1 UMR___1_1_0_S6_S3 0 1
 /begin AXIS_DESCR FIX_AXIS zff_atsys._.iSignale._.obj.sig_istgang UMR___1_1_0_S6_S3 10 -1 8 FIX_AXIS_PAR_DIST -1 1 10 /end AXIS_DESCR
 /begin AXIS_DESCR FIX_AXIS zff_atsys._.iSignale._.obj.sig_zielgang UMR___1_1_0_S6_S3 10 -1 8 FIX_AXIS_PAR_DIST -1 1 10 /end AXIS_DESCR
/end CHARACTERISTIC
/begin CHARACTERISTIC SWI_ME_EZAQS0_KLASS "Schalter zur aktivierung Einzelzylinderausblendung bei Normalen (QS0) Schaltungen" VALUE 0x26E571 kw_bool8_S6_S3 1 UMR___1_1_0_S6_S3 0 1 /end CHARACTERISTIC
/begin CHARACTERISTIC T_FNGABMESAS "Filterzeit Abtriebsdrehzahlgradient Motoreingriff" VALUE 0x26D7CE kw_ui16_S6_S3 999 UMR_MSEC__1_1_0_S6_S3 1 1000 /end CHARACTERISTIC
/begin CHARACTERISTIC CS_MEPOS "Getriebetemperaturschwelle fuer Momentenerhoehung" VALUE 0x26E572 kw_ui8_S6_S3 190 UMR_GRADC__1_1_M40_S6_S3 -40 150 /end CHARACTERISTIC
/begin CHARACTERISTIC SWI_MSTSSCHR "Schalter Motoreingriff bei Schrittschaltung" VALUE 0x26E573 kw_bool8_S6_S3 1 UMR___1_1_0_S6_S3 0 1 /end CHARACTERISTIC
/begin CHARACTERISTIC T_MEMAXHSGE "Maximaldauer Motoreingriff bei Hochschaltungen und Gangeinlegen" VALUE 0x26D7D0 kw_ui16_S6_S3 10000 UMR_MSEC__10_1_0_S6_S3 0 10000 /end CHARACTERISTIC
/begin CHARACTERISTIC T_MEMAXRS "Maximaldauer Motoreingriff bei Rueckschaltungen" VALUE 0x26D7D2 kw_ui16_S6_S3 10000 UMR_MSEC__10_1_0_S6_S3 0 10000 /end CHARACTERISTIC
/begin CHARACTERISTIC KL_MEKREDCM_D "Reduzierfaktor ME f(Mot.temp) Gangeinlegen D1 bis D6" CURVE 0x22AF78 kl_ui8_S6_S3 100 UMR_PROZENT__20_51_0_S6_S3 0 100
 /begin AXIS_DESCR STD_AXIS zff_atsys._.iSignale._.obj.sig_c_mot UMR_GRADC__1_1_M48_S6_S3 4 -48 144 DEPOSIT ABSOLUTE MONOTONY MON_INCREASE /end AXIS_DESCR
/end CHARACTERISTIC
/begin CHARACTERISTIC KL_MEKREDCM_R "Reduzierfaktor ME f(Mot.temp) Gangeinlegen nach R" CURVE 0x22AF84 kl_ui8_S6_S3 100 UMR_PROZENT__20_51_0_S6_S3 0 100
 /begin AXIS_DESCR STD_AXIS zff_atsys._.iSignale._.obj.sig_c_mot UMR_GRADC__1_1_M48_S6_S3 4 -48 144 DEPOSIT ABSOLUTE MONOTONY MON_INCREASE /end AXIS_DESCR
/end CHARACTERISTIC
/begin CHARACTERISTIC KL_FMENDIAE "Faktor Motoreingriff IAE offen/geregelt fuer RS" CURVE 0x22AF90 kl_si16_S6_S3 100 UMR_PROZENT__20_51_0_S6_S3 0 100
 /begin AXIS_DESCR STD_AXIS iIaeSigna.nd_iae UMR_U_MIN_1_1_0_S6_S3 4 -8160 8160 DEPOSIT ABSOLUTE MONOTONY MON_INCREASE /end AXIS_DESCR
/end CHARACTERISTIC
/begin CHARACTERISTIC TAB_SWI_MEPOSRS "Aktivierung positiver Motoreingriff aus Index" CURVE 0x22AFA4 tab_bool8_S6_S3 1 UMR___1_1_0_S6_S3 0 1
 /begin AXIS_DESCR FIX_AXIS zff_atsys._.iSignale._.obj.sig_index_sp_sps UMR___1_1_0_S6_S3 100 0 99 FIX_AXIS_PAR_DIST 0 1 100 /end AXIS_DESCR
/end CHARACTERISTIC
/begin CHARACTERISTIC TAB_SWI_MEPOSHS "Aktivierung positiver Motoreingriff aus Index" CURVE 0x22B00C tab_bool8_S6_S3 1 UMR___1_1_0_S6_S3 0 1
 /begin AXIS_DESCR FIX_AXIS zff_atsys._.iSignale._.obj.sig_index_sp_sps UMR___1_1_0_S6_S3 100 0 99 FIX_AXIS_PAR_DIST 0 1 100 /end AXIS_DESCR
/end CHARACTERISTIC
/begin CHARACTERISTIC TAB_SWI_MEPOSRSVOR "Aktivierung positiver voreilender ME aus Index" CURVE 0x22B074 tab_bool8_S6_S3 1 UMR___1_1_0_S6_S3 0 1
 /begin AXIS_DESCR FIX_AXIS zff_atsys._.iSignale._.obj.sig_index_sp_sps UMR___1_1_0_S6_S3 100 0 99 FIX_AXIS_PAR_DIST 0 1 100 /end AXIS_DESCR
/end CHARACTERISTIC
/begin CHARACTERISTIC TAB_SWI_MEPOSHSVOR "Aktivierung positiver voreilender ME aus Index" CURVE 0x22B0DC tab_bool8_S6_S3 1 UMR___1_1_0_S6_S3 0 1
 /begin AXIS_DESCR FIX_AXIS zff_atsys._.iSignale._.obj.sig_index_sp_sps UMR___1_1_0_S6_S3 100 0 99 FIX_AXIS_PAR_DIST 0 1 100 /end AXIS_DESCR
/end CHARACTERISTIC
/begin CHARACTERISTIC ND_MEPOSHAUPTA "Drehzahlkriterium für Start Hauptmotoreingriff bei POSME Anforderung" VALUE 0x26D7D4 kw_ui16_S6_S3 8000 UMR_U_MIN_1_1_0_S6_S3 0 8000 /end CHARACTERISTIC
/begin CHARACTERISTIC TAB_MSMMOT_LRHS "Momentenschwelle Lastrücknahmefunktion" CURVE 0x22B144 tab_si16_S6_S3 1700 UMR_NM__1_1_0_S6_S3 -400 1300
 /begin AXIS_DESCR FIX_AXIS zff_atsys._.iSignale._.obj.sig_istgang UMR___1_1_0_S6_S3 10 -1 8 FIX_AXIS_PAR_DIST -1 1 10 /end AXIS_DESCR
/end CHARACTERISTIC
/begin CHARACTERISTIC HYS_MSMMOT_LRHS "Hysterese auf Momentenschwelle Lastrücknahmefunktion" VALUE 0x26D7D6 kw_si16_S6_S3 100 UMR_NM__1_1_0_S6_S3 0 100 /end CHARACTERISTIC
/begin CHARACTERISTIC KL_TSYNMTMEHAUPTE12 "Zeit vor Erkennen synchron fuer Ende Haupt-ME" CURVE 0x2274C0 kl_ui8_S6_S3 1280 UMR_MSEC__10_1_M128_S6_S3 -1280 0
 /begin AXIS_DESCR STD_AXIS zff_atsys._.iSignale._.obj.sig_m_t8 UMR_NM__8_1_M50_S6_S3 6 -400 1640 DEPOSIT ABSOLUTE MONOTONY MON_INCREASE /end AXIS_DESCR
/end CHARACTERISTIC
/begin CHARACTERISTIC KL_TSYNMTMEHAUPTE12_EL "Zeit vor Erkennen synchron fuer Ende Haupt-ME" CURVE 0x2274D0 kl_ui8_S6_S3 1280 UMR_MSEC__10_1_M128_S6_S3 -1280 0
 /begin AXIS_DESCR STD_AXIS zff_atsys._.iSignale._.obj.sig_m_t8 UMR_NM__8_1_M50_S6_S3 6 -400 1640 DEPOSIT ABSOLUTE MONOTONY MON_INCREASE /end AXIS_DESCR
/end CHARACTERISTIC
/begin CHARACTERISTIC KF_FTSYNNTMEHAUPTE12 "Faktor auf Haupt-ME fuer Nach-ME" MAP 0x2274E0 kf_si16_S6_S3 1 UMR___1_100_0_S6_S3 0 1
 /begin AXIS_DESCR STD_AXIS iSasZentr.iSchaltend.t_syn UMR_MSEC__10_1_0_S6_S3 6 -5000 5000 DEPOSIT ABSOLUTE MONOTONY MON_INCREASE /end AXIS_DESCR
 /begin AXIS_DESCR STD_AXIS zff_atsys._.iSignale._.obj.sig_n_t UMR_U_MIN_1_1_0_S6_S3 4 0 8160 DEPOSIT ABSOLUTE MONOTONY MON_INCREASE /end AXIS_DESCR
/end CHARACTERISTIC
/begin CHARACTERISTIC KF_FTSYNNTMEHAUPTE12_EL "Faktor auf Haupt-ME fuer Nach-ME" MAP 0x22752C kf_si16_S6_S3 1 UMR___1_100_0_S6_S3 0 1
 /begin AXIS_DESCR STD_AXIS iSasZentr.iSchaltend.t_syn UMR_MSEC__10_1_0_S6_S3 6 -5000 5000 DEPOSIT ABSOLUTE MONOTONY MON_INCREASE /end AXIS_DESCR
 /begin AXIS_DESCR STD_AXIS zff_atsys._.iSignale._.obj.sig_n_t UMR_U_MIN_1_1_0_S6_S3 4 0 8160 DEPOSIT ABSOLUTE MONOTONY MON_INCREASE /end AXIS_DESCR
/end CHARACTERISTIC
/begin CHARACTERISTIC KL_TVDKIMEA12 "Fahrpedalabhängige Verzögerungszeit Start Haupt ME" CURVE 0x227578 kl_ui8_S6_S3 2000 UMR_MSEC__10_1_M128_S6_S3 -1000 1000
 /begin AXIS_DESCR STD_AXIS zff_atsys._.iSignale._.obj.sig_dki UMR_PROZENT__20_51_0_S6_S3 4 0 100 DEPOSIT ABSOLUTE MONOTONY MON_INCREASE /end AXIS_DESCR
/end CHARACTERISTIC
/begin CHARACTERISTIC KF_TVMEA12 "Verzoegerungszeit fuer Beginn Haupt-ME" MAP 0x227584 kf_si16_S6_S3 2000 UMR_MSEC__10_1_0_S6_S3 -1000 1000
 /begin AXIS_DESCR STD_AXIS zff_atsys._.iSignale._.obj.sig_n_t8 UMR_U_MIN_32_1_0_S6_S3 8 0 8160 DEPOSIT ABSOLUTE MONOTONY MON_INCREASE /end AXIS_DESCR
 /begin AXIS_DESCR STD_AXIS zff_atsys._.iSignale._.obj.sig_m_t8 UMR_NM__8_1_M50_S6_S3 4 -400 1640 DEPOSIT ABSOLUTE MONOTONY MON_INCREASE /end AXIS_DESCR
/end CHARACTERISTIC
/begin CHARACTERISTIC KF_TVMEA12_EL "Verzoegerungszeit fuer Beginn Haupt-ME" MAP 0x2275E4 kf_si16_S6_S3 2000 UMR_MSEC__10_1_0_S6_S3 -1000 1000
 /begin AXIS_DESCR STD_AXIS zff_atsys._.iSignale._.obj.sig_n_t8 UMR_U_MIN_32_1_0_S6_S3 8 0 8160 DEPOSIT ABSOLUTE MONOTONY MON_INCREASE /end AXIS_DESCR
 /begin AXIS_DESCR STD_AXIS zff_atsys._.iSignale._.obj.sig_m_t8 UMR_NM__8_1_M50_S6_S3 4 -400 1640 DEPOSIT ABSOLUTE MONOTONY MON_INCREASE /end AXIS_DESCR
/end CHARACTERISTIC
/begin CHARACTERISTIC KL_TVCGMEA12 "Temperaturabhängige Verzögerungszeit fuer Beginn Haupt-ME" CURVE 0x227644 kl_ui8_S6_S3 2000 UMR_MSEC__10_1_M128_S6_S3 -1000 1000
 /begin AXIS_DESCR STD_AXIS zff_atsys._.iSignale._.obj.sig_c_getr UMR_GRADC__1_1_M40_S6_S3 4 -40 150 DEPOSIT ABSOLUTE MONOTONY MON_INCREASE /end AXIS_DESCR
/end CHARACTERISTIC
/begin CHARACTERISTIC T_FMEHAUPTA12 "Filterzeit Start Hauptmotoreingriff" VALUE 0x26D6B2 kw_si16_S6_S3 508 UMR_MSEC__1_1_0_S6_S3 -254 254 /end CHARACTERISTIC
/begin CHARACTERISTIC K_FMEHAUPTA12 "Filterkonstante (aehnl INPT) Start Hauptmotoreingriff" VALUE 0x26D6B4 kw_si16_S6_S3 65.535 UMR___1_1000_0_S6_S3 -32.768 32.767 /end CHARACTERISTIC
/begin CHARACTERISTIC K_FMEHAUPTA12_EL "Filterkonstante (aehnl INPT) Start Hauptmotoreingriff" VALUE 0x26D6B6 kw_si16_S6_S3 65.535 UMR___1_1000_0_S6_S3 -32.768 32.767 /end CHARACTERISTIC
/begin CHARACTERISTIC KL_TSYNMTMEHAUPTE23 "Zeit vor Erkennen synchron fuer Ende Haupt-ME" CURVE 0x227650 kl_ui8_S6_S3 1280 UMR_MSEC__10_1_M128_S6_S3 -1280 0
 /begin AXIS_DESCR STD_AXIS zff_atsys._.iSignale._.obj.sig_m_t8 UMR_NM__8_1_M50_S6_S3 6 -400 1640 DEPOSIT ABSOLUTE MONOTONY MON_INCREASE /end AXIS_DESCR
/end CHARACTERISTIC
/begin CHARACTERISTIC KL_TSYNMTMEHAUPTE23_EL "Zeit vor Erkennen synchron fuer Ende Haupt-ME" CURVE 0x227660 kl_ui8_S6_S3 1280 UMR_MSEC__10_1_M128_S6_S3 -1280 0
 /begin AXIS_DESCR STD_AXIS zff_atsys._.iSignale._.obj.sig_m_t8 UMR_NM__8_1_M50_S6_S3 6 -400 1640 DEPOSIT ABSOLUTE MONOTONY MON_INCREASE /end AXIS_DESCR
/end CHARACTERISTIC
/begin CHARACTERISTIC KF_FTSYNNTMEHAUPTE23 "Faktor auf Haupt-ME fuer Nach-ME" MAP 0x227670 kf_si16_S6_S3 1 UMR___1_100_0_S6_S3 0 1
 /begin AXIS_DESCR STD_AXIS iSasZentr.iSchaltend.t_syn UMR_MSEC__10_1_0_S6_S3 6 -5000 5000 DEPOSIT ABSOLUTE MONOTONY MON_INCREASE /end AXIS_DESCR
 /begin AXIS_DESCR STD_AXIS zff_atsys._.iSignale._.obj.sig_n_t UMR_U_MIN_1_1_0_S6_S3 4 0 8160 DEPOSIT ABSOLUTE MONOTONY MON_INCREASE /end AXIS_DESCR
/end CHARACTERISTIC
/begin CHARACTERISTIC KF_FTSYNNTMEHAUPTE23_EL "Faktor auf Haupt-ME fuer Nach-ME" MAP 0x2276BC kf_si16_S6_S3 1 UMR___1_100_0_S6_S3 0 1
 /begin AXIS_DESCR STD_AXIS iSasZentr.iSchaltend.t_syn UMR_MSEC__10_1_0_S6_S3 6 -5000 5000 DEPOSIT ABSOLUTE MONOTONY MON_INCREASE /end AXIS_DESCR
 /begin AXIS_DESCR STD_AXIS zff_atsys._.iSignale._.obj.sig_n_t UMR_U_MIN_1_1_0_S6_S3 4 0 8160 DEPOSIT ABSOLUTE MONOTONY MON_INCREASE /end AXIS_DESCR
/end CHARACTERISTIC
/begin CHARACTERISTIC KL_TVDKIMEA23 "Fahrpedalabhängige Verzögerungszeit Start Haupt ME" CURVE 0x227708 kl_ui8_S6_S3 2000 UMR_MSEC__10_1_M128_S6_S3 -1000 1000
 /begin AXIS_DESCR STD_AXIS zff_atsys._.iSignale._.obj.sig_dki UMR_PROZENT__20_51_0_S6_S3 4 0 100 DEPOSIT ABSOLUTE MONOTONY MON_INCREASE /end AXIS_DESCR
/end CHARACTERISTIC
/begin CHARACTERISTIC KF_TVMEA23 "Verzoegerungszeit fuer Beginn Haupt-ME" MAP 0x227714 kf_si16_S6_S3 2000 UMR_MSEC__10_1_0_S6_S3 -1000 1000
 /begin AXIS_DESCR STD_AXIS zff_atsys._.iSignale._.obj.sig_n_t8 UMR_U_MIN_32_1_0_S6_S3 8 0 8160 DEPOSIT ABSOLUTE MONOTONY MON_INCREASE /end AXIS_DESCR
 /begin AXIS_DESCR STD_AXIS zff_atsys._.iSignale._.obj.sig_m_t8 UMR_NM__8_1_M50_S6_S3 4 -400 1640 DEPOSIT ABSOLUTE MONOTONY MON_INCREASE /end AXIS_DESCR
/end CHARACTERISTIC
/begin CHARACTERISTIC KF_TVMEA23_EL "Verzoegerungszeit fuer Beginn Haupt-ME" MAP 0x227774 kf_si16_S6_S3 2000 UMR_MSEC__10_1_0_S6_S3 -1000 1000
 /begin AXIS_DESCR STD_AXIS zff_atsys._.iSignale._.obj.sig_n_t8 UMR_U_MIN_32_1_0_S6_S3 8 0 8160 DEPOSIT ABSOLUTE MONOTONY MON_INCREASE /end AXIS_DESCR
 /begin AXIS_DESCR STD_AXIS zff_atsys._.iSignale._.obj.sig_m_t8 UMR_NM__8_1_M50_S6_S3 4 -400 1640 DEPOSIT ABSOLUTE MONOTONY MON_INCREASE /end AXIS_DESCR
/end CHARACTERISTIC
/begin CHARACTERISTIC KL_TVCGMEA23 "Temperaturabhängige Verzögerungszeit fuer Beginn Haupt-ME" CURVE 0x2277D4 kl_ui8_S6_S3 2000 UMR_MSEC__10_1_M128_S6_S3 -1000 1000
 /begin AXIS_DESCR STD_AXIS zff_atsys._.iSignale._.obj.sig_c_getr UMR_GRADC__1_1_M40_S6_S3 4 -40 150 DEPOSIT ABSOLUTE MONOTONY MON_INCREASE /end AXIS_DESCR
/end CHARACTERISTIC
/begin CHARACTERISTIC T_FMEHAUPTA23 "Filterzeit Start Hauptmotoreingriff" VALUE 0x26D6B8 kw_si16_S6_S3 508 UMR_MSEC__1_1_0_S6_S3 -254 254 /end CHARACTERISTIC
/begin CHARACTERISTIC K_FMEHAUPTA23 "Filterkonstante (aehnl INPT) Start Hauptmotoreingriff" VALUE 0x26D6BA kw_si16_S6_S3 65.535 UMR___1_1000_0_S6_S3 -32.768 32.767 /end CHARACTERISTIC
/begin CHARACTERISTIC K_FMEHAUPTA23_EL "Filterkonstante (aehnl INPT) Start Hauptmotoreingriff" VALUE 0x26D6BC kw_si16_S6_S3 65.535 UMR___1_1000_0_S6_S3 -32.768 32.767 /end CHARACTERISTIC
/begin CHARACTERISTIC KL_TSYNMTMEHAUPTE34 "Zeit vor Erkennen synchron fuer Ende Haupt-ME" CURVE 0x2277E0 kl_ui8_S6_S3 1280 UMR_MSEC__10_1_M128_S6_S3 -1280 0
 /begin AXIS_DESCR STD_AXIS zff_atsys._.iSignale._.obj.sig_m_t8 UMR_NM__8_1_M50_S6_S3 6 -400 1640 DEPOSIT ABSOLUTE MONOTONY MON_INCREASE /end AXIS_DESCR
/end CHARACTERISTIC
/begin CHARACTERISTIC KL_TSYNMTMEHAUPTE34_EL "Zeit vor Erkennen synchron fuer Ende Haupt-ME" CURVE 0x2277F0 kl_ui8_S6_S3 1280 UMR_MSEC__10_1_M128_S6_S3 -1280 0
 /begin AXIS_DESCR STD_AXIS zff_atsys._.iSignale._.obj.sig_m_t8 UMR_NM__8_1_M50_S6_S3 6 -400 1640 DEPOSIT ABSOLUTE MONOTONY MON_INCREASE /end AXIS_DESCR
/end CHARACTERISTIC
/begin CHARACTERISTIC KF_FTSYNNTMEHAUPTE34 "Faktor auf Haupt-ME fuer Nach-ME" MAP 0x227800 kf_si16_S6_S3 1 UMR___1_100_0_S6_S3 0 1
 /begin AXIS_DESCR STD_AXIS iSasZentr.iSchaltend.t_syn UMR_MSEC__10_1_0_S6_S3 6 -5000 5000 DEPOSIT ABSOLUTE MONOTONY MON_INCREASE /end AXIS_DESCR
 /begin AXIS_DESCR STD_AXIS zff_atsys._.iSignale._.obj.sig_n_t UMR_U_MIN_1_1_0_S6_S3 4 0 8160 DEPOSIT ABSOLUTE MONOTONY MON_INCREASE /end AXIS_DESCR
/end CHARACTERISTIC
/begin CHARACTERISTIC KF_FTSYNNTMEHAUPTE34_EL "Faktor auf Haupt-ME fuer Nach-ME" MAP 0x22784C kf_si16_S6_S3 1 UMR___1_100_0_S6_S3 0 1
 /begin AXIS_DESCR STD_AXIS iSasZentr.iSchaltend.t_syn UMR_MSEC__10_1_0_S6_S3 6 -5000 5000 DEPOSIT ABSOLUTE MONOTONY MON_INCREASE /end AXIS_DESCR
 /begin AXIS_DESCR STD_AXIS zff_atsys._.iSignale._.obj.sig_n_t UMR_U_MIN_1_1_0_S6_S3 4 0 8160 DEPOSIT ABSOLUTE MONOTONY MON_INCREASE /end AXIS_DESCR
/end CHARACTERISTIC
/begin CHARACTERISTIC KL_TVDKIMEA34 "Fahrpedalabhängige Verzögerungszeit Start Haupt ME" CURVE 0x227898 kl_ui8_S6_S3 2000 UMR_MSEC__10_1_M128_S6_S3 -1000 1000
 /begin AXIS_DESCR STD_AXIS zff_atsys._.iSignale._.obj.sig_dki UMR_PROZENT__20_51_0_S6_S3 4 0 100 DEPOSIT ABSOLUTE MONOTONY MON_INCREASE /end AXIS_DESCR
/end CHARACTERISTIC
/begin CHARACTERISTIC KF_TVMEA34 "Verzoegerungszeit fuer Beginn Haupt-ME" MAP 0x2278A4 kf_si16_S6_S3 2000 UMR_MSEC__10_1_0_S6_S3 -1000 1000
 /begin AXIS_DESCR STD_AXIS zff_atsys._.iSignale._.obj.sig_n_t8 UMR_U_MIN_32_1_0_S6_S3 8 0 8160 DEPOSIT ABSOLUTE MONOTONY MON_INCREASE /end AXIS_DESCR
 /begin AXIS_DESCR STD_AXIS zff_atsys._.iSignale._.obj.sig_m_t8 UMR_NM__8_1_M50_S6_S3 4 -400 1640 DEPOSIT ABSOLUTE MONOTONY MON_INCREASE /end AXIS_DESCR
/end CHARACTERISTIC
/begin CHARACTERISTIC KF_TVMEA34_EL "Verzoegerungszeit fuer Beginn Haupt-ME" MAP 0x227904 kf_si16_S6_S3 2000 UMR_MSEC__10_1_0_S6_S3 -1000 1000
 /begin AXIS_DESCR STD_AXIS zff_atsys._.iSignale._.obj.sig_n_t8 UMR_U_MIN_32_1_0_S6_S3 8 0 8160 DEPOSIT ABSOLUTE MONOTONY MON_INCREASE /end AXIS_DESCR
 /begin AXIS_DESCR STD_AXIS zff_atsys._.iSignale._.obj.sig_m_t8 UMR_NM__8_1_M50_S6_S3 4 -400 1640 DEPOSIT ABSOLUTE MONOTONY MON_INCREASE /end AXIS_DESCR
/end CHARACTERISTIC
/begin CHARACTERISTIC KL_TVCGMEA34 "Temperaturabhängige Verzögerungszeit fuer Beginn Haupt-ME" CURVE 0x227964 kl_ui8_S6_S3 2000 UMR_MSEC__10_1_M128_S6_S3 -1000 1000
 /begin AXIS_DESCR STD_AXIS zff_atsys._.iSignale._.obj.sig_c_getr UMR_GRADC__1_1_M40_S6_S3 4 -40 150 DEPOSIT ABSOLUTE MONOTONY MON_INCREASE /end AXIS_DESCR
/end CHARACTERISTIC
/begin CHARACTERISTIC T_FMEHAUPTA34 "Filterzeit Start Hauptmotoreingriff" VALUE 0x26D6BE kw_si16_S6_S3 508 UMR_MSEC__1_1_0_S6_S3 -254 254 /end CHARACTERISTIC
/begin CHARACTERISTIC K_FMEHAUPTA34 "Filterkonstante (aehnl INPT) Start Hauptmotoreingriff" VALUE 0x26D6C0 kw_si16_S6_S3 65.535 UMR___1_1000_0_S6_S3 -32.768 32.767 /end CHARACTERISTIC
/begin CHARACTERISTIC K_FMEHAUPTA34_EL "Filterkonstante (aehnl INPT) Start Hauptmotoreingriff" VALUE 0x26D6C2 kw_si16_S6_S3 65.535 UMR___1_1000_0_S6_S3 -32.768 32.767 /end CHARACTERISTIC
/begin CHARACTERISTIC KL_TSYNMTMEHAUPTE45 "Zeit vor Erkennen synchron fuer Ende Haupt-ME" CURVE 0x227970 kl_ui8_S6_S3 1280 UMR_MSEC__10_1_M128_S6_S3 -1280 0
 /begin AXIS_DESCR STD_AXIS zff_atsys._.iSignale._.obj.sig_m_t8 UMR_NM__8_1_M50_S6_S3 6 -400 1640 DEPOSIT ABSOLUTE MONOTONY MON_INCREASE /end AXIS_DESCR
/end CHARACTERISTIC
/begin CHARACTERISTIC KL_TSYNMTMEHAUPTE45_EL "Zeit vor Erkennen synchron fuer Ende Haupt-ME" CURVE 0x227980 kl_ui8_S6_S3 1280 UMR_MSEC__10_1_M128_S6_S3 -1280 0
 /begin AXIS_DESCR STD_AXIS zff_atsys._.iSignale._.obj.sig_m_t8 UMR_NM__8_1_M50_S6_S3 6 -400 1640 DEPOSIT ABSOLUTE MONOTONY MON_INCREASE /end AXIS_DESCR
/end CHARACTERISTIC
/begin CHARACTERISTIC KF_FTSYNNTMEHAUPTE45 "Faktor auf Haupt-ME fuer Nach-ME" MAP 0x227990 kf_si16_S6_S3 1 UMR___1_100_0_S6_S3 0 1
 /begin AXIS_DESCR STD_AXIS iSasZentr.iSchaltend.t_syn UMR_MSEC__10_1_0_S6_S3 6 -5000 5000 DEPOSIT ABSOLUTE MONOTONY MON_INCREASE /end AXIS_DESCR
 /begin AXIS_DESCR STD_AXIS zff_atsys._.iSignale._.obj.sig_n_t UMR_U_MIN_1_1_0_S6_S3 4 0 8160 DEPOSIT ABSOLUTE MONOTONY MON_INCREASE /end AXIS_DESCR
/end CHARACTERISTIC
/begin CHARACTERISTIC KF_FTSYNNTMEHAUPTE45_EL "Faktor auf Haupt-ME fuer Nach-ME" MAP 0x2279DC kf_si16_S6_S3 1 UMR___1_100_0_S6_S3 0 1
 /begin AXIS_DESCR STD_AXIS iSasZentr.iSchaltend.t_syn UMR_MSEC__10_1_0_S6_S3 6 -5000 5000 DEPOSIT ABSOLUTE MONOTONY MON_INCREASE /end AXIS_DESCR
 /begin AXIS_DESCR STD_AXIS zff_atsys._.iSignale._.obj.sig_n_t UMR_U_MIN_1_1_0_S6_S3 4 0 8160 DEPOSIT ABSOLUTE MONOTONY MON_INCREASE /end AXIS_DESCR
/end CHARACTERISTIC
/begin CHARACTERISTIC KL_TVDKIMEA45 "Fahrpedalabhängige Verzögerungszeit Start Haupt ME" CURVE 0x227A28 kl_ui8_S6_S3 2000 UMR_MSEC__10_1_M128_S6_S3 -1000 1000
 /begin AXIS_DESCR STD_AXIS zff_atsys._.iSignale._.obj.sig_dki UMR_PROZENT__20_51_0_S6_S3 4 0 100 DEPOSIT ABSOLUTE MONOTONY MON_INCREASE /end AXIS_DESCR
/end CHARACTERISTIC
/begin CHARACTERISTIC KF_TVMEA45 "Verzoegerungszeit fuer Beginn Haupt-ME" MAP 0x227A34 kf_si16_S6_S3 2000 UMR_MSEC__10_1_0_S6_S3 -1000 1000
 /begin AXIS_DESCR STD_AXIS zff_atsys._.iSignale._.obj.sig_n_t8 UMR_U_MIN_32_1_0_S6_S3 8 0 8160 DEPOSIT ABSOLUTE MONOTONY MON_INCREASE /end AXIS_DESCR
 /begin AXIS_DESCR STD_AXIS zff_atsys._.iSignale._.obj.sig_m_t8 UMR_NM__8_1_M50_S6_S3 4 -400 1640 DEPOSIT ABSOLUTE MONOTONY MON_INCREASE /end AXIS_DESCR
/end CHARACTERISTIC
/begin CHARACTERISTIC KF_TVMEA45_EL "Verzoegerungszeit fuer Beginn Haupt-ME" MAP 0x227A94 kf_si16_S6_S3 2000 UMR_MSEC__10_1_0_S6_S3 -1000 1000
 /begin AXIS_DESCR STD_AXIS zff_atsys._.iSignale._.obj.sig_n_t8 UMR_U_MIN_32_1_0_S6_S3 8 0 8160 DEPOSIT ABSOLUTE MONOTONY MON_INCREASE /end AXIS_DESCR
 /begin AXIS_DESCR STD_AXIS zff_atsys._.iSignale._.obj.sig_m_t8 UMR_NM__8_1_M50_S6_S3 4 -400 1640 DEPOSIT ABSOLUTE MONOTONY MON_INCREASE /end AXIS_DESCR
/end CHARACTERISTIC
/begin CHARACTERISTIC KL_TVCGMEA45 "Temperaturabhängige Verzögerungszeit fuer Beginn Haupt-ME" CURVE 0x227AF4 kl_ui8_S6_S3 2000 UMR_MSEC__10_1_M128_S6_S3 -1000 1000
 /begin AXIS_DESCR STD_AXIS zff_atsys._.iSignale._.obj.sig_c_getr UMR_GRADC__1_1_M40_S6_S3 4 -40 150 DEPOSIT ABSOLUTE MONOTONY MON_INCREASE /end AXIS_DESCR
/end CHARACTERISTIC
/begin CHARACTERISTIC T_FMEHAUPTA45 "Filterzeit Start Hauptmotoreingriff" VALUE 0x26D6C4 kw_si16_S6_S3 508 UMR_MSEC__1_1_0_S6_S3 -254 254 /end CHARACTERISTIC
/begin CHARACTERISTIC K_FMEHAUPTA45 "Filterkonstante (aehnl INPT) Start Hauptmotoreingriff" VALUE 0x26D6C6 kw_si16_S6_S3 65.535 UMR___1_1000_0_S6_S3 -32.768 32.767 /end CHARACTERISTIC
/begin CHARACTERISTIC K_FMEHAUPTA45_EL "Filterkonstante (aehnl INPT) Start Hauptmotoreingriff" VALUE 0x26D6C8 kw_si16_S6_S3 65.535 UMR___1_1000_0_S6_S3 -32.768 32.767 /end CHARACTERISTIC
/begin CHARACTERISTIC KL_TSYNMTMEHAUPTE56 "Zeit vor Erkennen synchron fuer Ende Haupt-ME" CURVE 0x227B00 kl_ui8_S6_S3 1280 UMR_MSEC__10_1_M128_S6_S3 -1280 0
 /begin AXIS_DESCR STD_AXIS zff_atsys._.iSignale._.obj.sig_m_t8 UMR_NM__8_1_M50_S6_S3 6 -400 1640 DEPOSIT ABSOLUTE MONOTONY MON_INCREASE /end AXIS_DESCR
/end CHARACTERISTIC
/begin CHARACTERISTIC KL_TSYNMTMEHAUPTE56_EL "Zeit vor Erkennen synchron fuer Ende Haupt-ME" CURVE 0x227B10 kl_ui8_S6_S3 1280 UMR_MSEC__10_1_M128_S6_S3 -1280 0
 /begin AXIS_DESCR STD_AXIS zff_atsys._.iSignale._.obj.sig_m_t8 UMR_NM__8_1_M50_S6_S3 6 -400 1640 DEPOSIT ABSOLUTE MONOTONY MON_INCREASE /end AXIS_DESCR
/end CHARACTERISTIC
/begin CHARACTERISTIC KF_FTSYNNTMEHAUPTE56 "Faktor auf Haupt-ME fuer Nach-ME" MAP 0x227B20 kf_si16_S6_S3 1 UMR___1_100_0_S6_S3 0 1
 /begin AXIS_DESCR STD_AXIS iSasZentr.iSchaltend.t_syn UMR_MSEC__10_1_0_S6_S3 6 -5000 5000 DEPOSIT ABSOLUTE MONOTONY MON_INCREASE /end AXIS_DESCR
 /begin AXIS_DESCR STD_AXIS zff_atsys._.iSignale._.obj.sig_n_t UMR_U_MIN_1_1_0_S6_S3 4 0 8160 DEPOSIT ABSOLUTE MONOTONY MON_INCREASE /end AXIS_DESCR
/end CHARACTERISTIC
/begin CHARACTERISTIC KF_FTSYNNTMEHAUPTE56_EL "Faktor auf Haupt-ME fuer Nach-ME" MAP 0x227B6C kf_si16_S6_S3 1 UMR___1_100_0_S6_S3 0 1
 /begin AXIS_DESCR STD_AXIS iSasZentr.iSchaltend.t_syn UMR_MSEC__10_1_0_S6_S3 6 -5000 5000 DEPOSIT ABSOLUTE MONOTONY MON_INCREASE /end AXIS_DESCR
 /begin AXIS_DESCR STD_AXIS zff_atsys._.iSignale._.obj.sig_n_t UMR_U_MIN_1_1_0_S6_S3 4 0 8160 DEPOSIT ABSOLUTE MONOTONY MON_INCREASE /end AXIS_DESCR
/end CHARACTERISTIC
/begin CHARACTERISTIC KL_TVDKIMEA56 "Fahrpedalabhängige Verzögerungszeit Start Haupt ME" CURVE 0x227BB8 kl_ui8_S6_S3 2000 UMR_MSEC__10_1_M128_S6_S3 -1000 1000
 /begin AXIS_DESCR STD_AXIS zff_atsys._.iSignale._.obj.sig_dki UMR_PROZENT__20_51_0_S6_S3 4 0 100 DEPOSIT ABSOLUTE MONOTONY MON_INCREASE /end AXIS_DESCR
/end CHARACTERISTIC
/begin CHARACTERISTIC KF_TVMEA56 "Verzoegerungszeit fuer Beginn Haupt-ME" MAP 0x227BC4 kf_si16_S6_S3 2000 UMR_MSEC__10_1_0_S6_S3 -1000 1000
 /begin AXIS_DESCR STD_AXIS zff_atsys._.iSignale._.obj.sig_n_t8 UMR_U_MIN_32_1_0_S6_S3 8 0 8160 DEPOSIT ABSOLUTE MONOTONY MON_INCREASE /end AXIS_DESCR
 /begin AXIS_DESCR STD_AXIS zff_atsys._.iSignale._.obj.sig_m_t8 UMR_NM__8_1_M50_S6_S3 4 -400 1640 DEPOSIT ABSOLUTE MONOTONY MON_INCREASE /end AXIS_DESCR
/end CHARACTERISTIC
/begin CHARACTERISTIC KF_TVMEA56_EL "Verzoegerungszeit fuer Beginn Haupt-ME" MAP 0x227C24 kf_si16_S6_S3 2000 UMR_MSEC__10_1_0_S6_S3 -1000 1000
 /begin AXIS_DESCR STD_AXIS zff_atsys._.iSignale._.obj.sig_n_t8 UMR_U_MIN_32_1_0_S6_S3 8 0 8160 DEPOSIT ABSOLUTE MONOTONY MON_INCREASE /end AXIS_DESCR
 /begin AXIS_DESCR STD_AXIS zff_atsys._.iSignale._.obj.sig_m_t8 UMR_NM__8_1_M50_S6_S3 4 -400 1640 DEPOSIT ABSOLUTE MONOTONY MON_INCREASE /end AXIS_DESCR
/end CHARACTERISTIC
/begin CHARACTERISTIC KL_TVCGMEA56 "Temperaturabhängige Verzögerungszeit fuer Beginn Haupt-ME" CURVE 0x227C84 kl_ui8_S6_S3 2000 UMR_MSEC__10_1_M128_S6_S3 -1000 1000
 /begin AXIS_DESCR STD_AXIS zff_atsys._.iSignale._.obj.sig_c_getr UMR_GRADC__1_1_M40_S6_S3 4 -40 150 DEPOSIT ABSOLUTE MONOTONY MON_INCREASE /end AXIS_DESCR
/end CHARACTERISTIC
/begin CHARACTERISTIC T_FMEHAUPTA56 "Filterzeit Start Hauptmotoreingriff" VALUE 0x26D6CA kw_si16_S6_S3 508 UMR_MSEC__1_1_0_S6_S3 -254 254 /end CHARACTERISTIC
/begin CHARACTERISTIC K_FMEHAUPTA56 "Filterkonstante (aehnl INPT) Start Hauptmotoreingriff" VALUE 0x26D6CC kw_si16_S6_S3 65.535 UMR___1_1000_0_S6_S3 -32.768 32.767 /end CHARACTERISTIC
/begin CHARACTERISTIC K_FMEHAUPTA56_EL "Filterkonstante (aehnl INPT) Start Hauptmotoreingriff" VALUE 0x26D6CE kw_si16_S6_S3 65.535 UMR___1_1000_0_S6_S3 -32.768 32.767 /end CHARACTERISTIC
/begin CHARACTERISTIC KL_TSYNMTMEHAUPTE67 "Zeit vor Erkennen synchron fuer Ende Haupt-ME" CURVE 0x227C90 kl_ui8_S6_S3 1280 UMR_MSEC__10_1_M128_S6_S3 -1280 0
 /begin AXIS_DESCR STD_AXIS zff_atsys._.iSignale._.obj.sig_m_t8 UMR_NM__8_1_M50_S6_S3 6 -400 1640 DEPOSIT ABSOLUTE MONOTONY MON_INCREASE /end AXIS_DESCR
/end CHARACTERISTIC
/begin CHARACTERISTIC KL_TSYNMTMEHAUPTE67_EL "Zeit vor Erkennen synchron fuer Ende Haupt-ME" CURVE 0x227CA0 kl_ui8_S6_S3 1280 UMR_MSEC__10_1_M128_S6_S3 -1280 0
 /begin AXIS_DESCR STD_AXIS zff_atsys._.iSignale._.obj.sig_m_t8 UMR_NM__8_1_M50_S6_S3 6 -400 1640 DEPOSIT ABSOLUTE MONOTONY MON_INCREASE /end AXIS_DESCR
/end CHARACTERISTIC
/begin CHARACTERISTIC KF_FTSYNNTMEHAUPTE67 "Faktor auf Haupt-ME fuer Nach-ME" MAP 0x227CB0 kf_si16_S6_S3 1 UMR___1_100_0_S6_S3 0 1
 /begin AXIS_DESCR STD_AXIS iSasZentr.iSchaltend.t_syn UMR_MSEC__10_1_0_S6_S3 6 -5000 5000 DEPOSIT ABSOLUTE MONOTONY MON_INCREASE /end AXIS_DESCR
 /begin AXIS_DESCR STD_AXIS zff_atsys._.iSignale._.obj.sig_n_t UMR_U_MIN_1_1_0_S6_S3 4 0 8160 DEPOSIT ABSOLUTE MONOTONY MON_INCREASE /end AXIS_DESCR
/end CHARACTERISTIC
/begin CHARACTERISTIC KF_FTSYNNTMEHAUPTE67_EL "Faktor auf Haupt-ME fuer Nach-ME" MAP 0x227CFC kf_si16_S6_S3 1 UMR___1_100_0_S6_S3 0 1
 /begin AXIS_DESCR STD_AXIS iSasZentr.iSchaltend.t_syn UMR_MSEC__10_1_0_S6_S3 6 -5000 5000 DEPOSIT ABSOLUTE MONOTONY MON_INCREASE /end AXIS_DESCR
 /begin AXIS_DESCR STD_AXIS zff_atsys._.iSignale._.obj.sig_n_t UMR_U_MIN_1_1_0_S6_S3 4 0 8160 DEPOSIT ABSOLUTE MONOTONY MON_INCREASE /end AXIS_DESCR
/end CHARACTERISTIC
/begin CHARACTERISTIC KL_TVDKIMEA67 "Fahrpedalabhängige Verzögerungszeit Start Haupt ME" CURVE 0x227D48 kl_ui8_S6_S3 2000 UMR_MSEC__10_1_M128_S6_S3 -1000 1000
 /begin AXIS_DESCR STD_AXIS zff_atsys._.iSignale._.obj.sig_dki UMR_PROZENT__20_51_0_S6_S3 4 0 100 DEPOSIT ABSOLUTE MONOTONY MON_INCREASE /end AXIS_DESCR
/end CHARACTERISTIC
/begin CHARACTERISTIC KF_TVMEA67 "Verzoegerungszeit fuer Beginn Haupt-ME" MAP 0x227D54 kf_si16_S6_S3 2000 UMR_MSEC__10_1_0_S6_S3 -1000 1000
 /begin AXIS_DESCR STD_AXIS zff_atsys._.iSignale._.obj.sig_n_t8 UMR_U_MIN_32_1_0_S6_S3 8 0 8160 DEPOSIT ABSOLUTE MONOTONY MON_INCREASE /end AXIS_DESCR
 /begin AXIS_DESCR STD_AXIS zff_atsys._.iSignale._.obj.sig_m_t8 UMR_NM__8_1_M50_S6_S3 4 -400 1640 DEPOSIT ABSOLUTE MONOTONY MON_INCREASE /end AXIS_DESCR
/end CHARACTERISTIC
/begin CHARACTERISTIC KF_TVMEA67_EL "Verzoegerungszeit fuer Beginn Haupt-ME" MAP 0x227DB4 kf_si16_S6_S3 2000 UMR_MSEC__10_1_0_S6_S3 -1000 1000
 /begin AXIS_DESCR STD_AXIS zff_atsys._.iSignale._.obj.sig_n_t8 UMR_U_MIN_32_1_0_S6_S3 8 0 8160 DEPOSIT ABSOLUTE MONOTONY MON_INCREASE /end AXIS_DESCR
 /begin AXIS_DESCR STD_AXIS zff_atsys._.iSignale._.obj.sig_m_t8 UMR_NM__8_1_M50_S6_S3 4 -400 1640 DEPOSIT ABSOLUTE MONOTONY MON_INCREASE /end AXIS_DESCR
/end CHARACTERISTIC
/begin CHARACTERISTIC KL_TVCGMEA67 "Temperaturabhängige Verzögerungszeit fuer Beginn Haupt-ME" CURVE 0x227E14 kl_ui8_S6_S3 2000 UMR_MSEC__10_1_M128_S6_S3 -1000 1000
 /begin AXIS_DESCR STD_AXIS zff_atsys._.iSignale._.obj.sig_c_getr UMR_GRADC__1_1_M40_S6_S3 4 -40 150 DEPOSIT ABSOLUTE MONOTONY MON_INCREASE /end AXIS_DESCR
/end CHARACTERISTIC
/begin CHARACTERISTIC T_FMEHAUPTA67 "Filterzeit Start Hauptmotoreingriff" VALUE 0x26D6D0 kw_si16_S6_S3 508 UMR_MSEC__1_1_0_S6_S3 -254 254 /end CHARACTERISTIC
/begin CHARACTERISTIC K_FMEHAUPTA67 "Filterkonstante (aehnl INPT) Start Hauptmotoreingriff" VALUE 0x26D6D2 kw_si16_S6_S3 65.535 UMR___1_1000_0_S6_S3 -32.768 32.767 /end CHARACTERISTIC
/begin CHARACTERISTIC K_FMEHAUPTA67_EL "Filterkonstante (aehnl INPT) Start Hauptmotoreingriff" VALUE 0x26D6D4 kw_si16_S6_S3 65.535 UMR___1_1000_0_S6_S3 -32.768 32.767 /end CHARACTERISTIC
/begin CHARACTERISTIC KL_TSYNMTMEHAUPTE78 "Zeit vor Erkennen synchron fuer Ende Haupt-ME" CURVE 0x227E20 kl_ui8_S6_S3 1280 UMR_MSEC__10_1_M128_S6_S3 -1280 0
 /begin AXIS_DESCR STD_AXIS zff_atsys._.iSignale._.obj.sig_m_t8 UMR_NM__8_1_M50_S6_S3 6 -400 1640 DEPOSIT ABSOLUTE MONOTONY MON_INCREASE /end AXIS_DESCR
/end CHARACTERISTIC
/begin CHARACTERISTIC KL_TSYNMTMEHAUPTE78_EL "Zeit vor Erkennen synchron fuer Ende Haupt-ME" CURVE 0x227E30 kl_ui8_S6_S3 1280 UMR_MSEC__10_1_M128_S6_S3 -1280 0
 /begin AXIS_DESCR STD_AXIS zff_atsys._.iSignale._.obj.sig_m_t8 UMR_NM__8_1_M50_S6_S3 6 -400 1640 DEPOSIT ABSOLUTE MONOTONY MON_INCREASE /end AXIS_DESCR
/end CHARACTERISTIC
/begin CHARACTERISTIC KF_FTSYNNTMEHAUPTE78 "Faktor auf Haupt-ME fuer Nach-ME" MAP 0x227E40 kf_si16_S6_S3 1 UMR___1_100_0_S6_S3 0 1
 /begin AXIS_DESCR STD_AXIS iSasZentr.iSchaltend.t_syn UMR_MSEC__10_1_0_S6_S3 6 -5000 5000 DEPOSIT ABSOLUTE MONOTONY MON_INCREASE /end AXIS_DESCR
 /begin AXIS_DESCR STD_AXIS zff_atsys._.iSignale._.obj.sig_n_t UMR_U_MIN_1_1_0_S6_S3 4 0 8160 DEPOSIT ABSOLUTE MONOTONY MON_INCREASE /end AXIS_DESCR
/end CHARACTERISTIC
/begin CHARACTERISTIC KF_FTSYNNTMEHAUPTE78_EL "Faktor auf Haupt-ME fuer Nach-ME" MAP 0x227E8C kf_si16_S6_S3 1 UMR___1_100_0_S6_S3 0 1
 /begin AXIS_DESCR STD_AXIS iSasZentr.iSchaltend.t_syn UMR_MSEC__10_1_0_S6_S3 6 -5000 5000 DEPOSIT ABSOLUTE MONOTONY MON_INCREASE /end AXIS_DESCR
 /begin AXIS_DESCR STD_AXIS zff_atsys._.iSignale._.obj.sig_n_t UMR_U_MIN_1_1_0_S6_S3 4 0 8160 DEPOSIT ABSOLUTE MONOTONY MON_INCREASE /end AXIS_DESCR
/end CHARACTERISTIC
/begin CHARACTERISTIC KL_TVDKIMEA78 "Fahrpedalabhängige Verzögerungszeit Start Haupt ME" CURVE 0x227ED8 kl_ui8_S6_S3 2000 UMR_MSEC__10_1_M128_S6_S3 -1000 1000
 /begin AXIS_DESCR STD_AXIS zff_atsys._.iSignale._.obj.sig_dki UMR_PROZENT__20_51_0_S6_S3 4 0 100 DEPOSIT ABSOLUTE MONOTONY MON_INCREASE /end AXIS_DESCR
/end CHARACTERISTIC
/begin CHARACTERISTIC KF_TVMEA78 "Verzoegerungszeit fuer Beginn Haupt-ME" MAP 0x227EE4 kf_si16_S6_S3 2000 UMR_MSEC__10_1_0_S6_S3 -1000 1000
 /begin AXIS_DESCR STD_AXIS zff_atsys._.iSignale._.obj.sig_n_t8 UMR_U_MIN_32_1_0_S6_S3 8 0 8160 DEPOSIT ABSOLUTE MONOTONY MON_INCREASE /end AXIS_DESCR
 /begin AXIS_DESCR STD_AXIS zff_atsys._.iSignale._.obj.sig_m_t8 UMR_NM__8_1_M50_S6_S3 4 -400 1640 DEPOSIT ABSOLUTE MONOTONY MON_INCREASE /end AXIS_DESCR
/end CHARACTERISTIC
/begin CHARACTERISTIC KF_TVMEA78_EL "Verzoegerungszeit fuer Beginn Haupt-ME" MAP 0x227F44 kf_si16_S6_S3 2000 UMR_MSEC__10_1_0_S6_S3 -1000 1000
 /begin AXIS_DESCR STD_AXIS zff_atsys._.iSignale._.obj.sig_n_t8 UMR_U_MIN_32_1_0_S6_S3 8 0 8160 DEPOSIT ABSOLUTE MONOTONY MON_INCREASE /end AXIS_DESCR
 /begin AXIS_DESCR STD_AXIS zff_atsys._.iSignale._.obj.sig_m_t8 UMR_NM__8_1_M50_S6_S3 4 -400 1640 DEPOSIT ABSOLUTE MONOTONY MON_INCREASE /end AXIS_DESCR
/end CHARACTERISTIC
/begin CHARACTERISTIC KL_TVCGMEA78 "Temperaturabhängige Verzögerungszeit fuer Beginn Haupt-ME" CURVE 0x227FA4 kl_ui8_S6_S3 2000 UMR_MSEC__10_1_M128_S6_S3 -1000 1000
 /begin AXIS_DESCR STD_AXIS zff_atsys._.iSignale._.obj.sig_c_getr UMR_GRADC__1_1_M40_S6_S3 4 -40 150 DEPOSIT ABSOLUTE MONOTONY MON_INCREASE /end AXIS_DESCR
/end CHARACTERISTIC
/begin CHARACTERISTIC T_FMEHAUPTA78 "Filterzeit Start Hauptmotoreingriff" VALUE 0x26D6D6 kw_si16_S6_S3 508 UMR_MSEC__1_1_0_S6_S3 -254 254 /end CHARACTERISTIC
/begin CHARACTERISTIC K_FMEHAUPTA78 "Filterkonstante (aehnl INPT) Start Hauptmotoreingriff" VALUE 0x26D6D8 kw_si16_S6_S3 65.535 UMR___1_1000_0_S6_S3 -32.768 32.767 /end CHARACTERISTIC
/begin CHARACTERISTIC K_FMEHAUPTA78_EL "Filterkonstante (aehnl INPT) Start Hauptmotoreingriff" VALUE 0x26D6DA kw_si16_S6_S3 65.535 UMR___1_1000_0_S6_S3 -32.768 32.767 /end CHARACTERISTIC
/begin CHARACTERISTIC KL_TSYNMTMEHAUPTE13 "Zeit vor Erkennen synchron fuer Ende Haupt-ME" CURVE 0x227FB0 kl_ui8_S6_S3 1280 UMR_MSEC__10_1_M128_S6_S3 -1280 0
 /begin AXIS_DESCR STD_AXIS zff_atsys._.iSignale._.obj.sig_m_t8 UMR_NM__8_1_M50_S6_S3 6 -400 1640 DEPOSIT ABSOLUTE MONOTONY MON_INCREASE /end AXIS_DESCR
/end CHARACTERISTIC
/begin CHARACTERISTIC KF_FTSYNNTMEHAUPTE13 "Faktor auf Haupt-ME fuer Nach-ME" MAP 0x227FC0 kf_si16_S6_S3 1 UMR___1_100_0_S6_S3 0 1
 /begin AXIS_DESCR STD_AXIS iSasZentr.iSchaltend.t_syn UMR_MSEC__10_1_0_S6_S3 6 -5000 5000 DEPOSIT ABSOLUTE MONOTONY MON_INCREASE /end AXIS_DESCR
 /begin AXIS_DESCR STD_AXIS zff_atsys._.iSignale._.obj.sig_n_t UMR_U_MIN_1_1_0_S6_S3 4 0 8160 DEPOSIT ABSOLUTE MONOTONY MON_INCREASE /end AXIS_DESCR
/end CHARACTERISTIC
/begin CHARACTERISTIC KL_TVDKIMEA13 "Fahrpedalabhängige Verzögerungszeit Start Haupt ME" CURVE 0x22800C kl_ui8_S6_S3 2000 UMR_MSEC__10_1_M128_S6_S3 -1000 1000
 /begin AXIS_DESCR STD_AXIS zff_atsys._.iSignale._.obj.sig_dki UMR_PROZENT__20_51_0_S6_S3 4 0 100 DEPOSIT ABSOLUTE MONOTONY MON_INCREASE /end AXIS_DESCR
/end CHARACTERISTIC
/begin CHARACTERISTIC KF_TVMEA13 "Verzoegerungszeit fuer Beginn Haupt-ME" MAP 0x228018 kf_si16_S6_S3 2000 UMR_MSEC__10_1_0_S6_S3 -1000 1000
 /begin AXIS_DESCR STD_AXIS zff_atsys._.iSignale._.obj.sig_n_t8 UMR_U_MIN_32_1_0_S6_S3 8 0 8160 DEPOSIT ABSOLUTE MONOTONY MON_INCREASE /end AXIS_DESCR
 /begin AXIS_DESCR STD_AXIS zff_atsys._.iSignale._.obj.sig_m_t8 UMR_NM__8_1_M50_S6_S3 4 -400 1640 DEPOSIT ABSOLUTE MONOTONY MON_INCREASE /end AXIS_DESCR
/end CHARACTERISTIC
/begin CHARACTERISTIC KL_TVCGMEA13 "Temperaturabhängige Verzögerungszeit fuer Beginn Haupt-ME" CURVE 0x228078 kl_ui8_S6_S3 2000 UMR_MSEC__10_1_M128_S6_S3 -1000 1000
 /begin AXIS_DESCR STD_AXIS zff_atsys._.iSignale._.obj.sig_c_getr UMR_GRADC__1_1_M40_S6_S3 4 -40 150 DEPOSIT ABSOLUTE MONOTONY MON_INCREASE /end AXIS_DESCR
/end CHARACTERISTIC
/begin CHARACTERISTIC T_FMEHAUPTA13 "Filterzeit Start Hauptmotoreingriff" VALUE 0x26D6DC kw_si16_S6_S3 508 UMR_MSEC__1_1_0_S6_S3 -254 254 /end CHARACTERISTIC
/begin CHARACTERISTIC K_FMEHAUPTA13 "Filterkonstante (aehnl INPT) Start Hauptmotoreingriff" VALUE 0x26D6DE kw_si16_S6_S3 65.535 UMR___1_1000_0_S6_S3 -32.768 32.767 /end CHARACTERISTIC
/begin CHARACTERISTIC KL_TSYNMTMEHAUPTE24 "Zeit vor Erkennen synchron fuer Ende Haupt-ME" CURVE 0x228084 kl_ui8_S6_S3 1280 UMR_MSEC__10_1_M128_S6_S3 -1280 0
 /begin AXIS_DESCR STD_AXIS zff_atsys._.iSignale._.obj.sig_m_t8 UMR_NM__8_1_M50_S6_S3 6 -400 1640 DEPOSIT ABSOLUTE MONOTONY MON_INCREASE /end AXIS_DESCR
/end CHARACTERISTIC
/begin CHARACTERISTIC KF_FTSYNNTMEHAUPTE24 "Faktor auf Haupt-ME fuer Nach-ME" MAP 0x228094 kf_si16_S6_S3 1 UMR___1_100_0_S6_S3 0 1
 /begin AXIS_DESCR STD_AXIS iSasZentr.iSchaltend.t_syn UMR_MSEC__10_1_0_S6_S3 6 -5000 5000 DEPOSIT ABSOLUTE MONOTONY MON_INCREASE /end AXIS_DESCR
 /begin AXIS_DESCR STD_AXIS zff_atsys._.iSignale._.obj.sig_n_t UMR_U_MIN_1_1_0_S6_S3 4 0 8160 DEPOSIT ABSOLUTE MONOTONY MON_INCREASE /end AXIS_DESCR
/end CHARACTERISTIC
/begin CHARACTERISTIC KL_TVDKIMEA24 "Fahrpedalabhängige Verzögerungszeit Start Haupt ME" CURVE 0x2280E0 kl_ui8_S6_S3 2000 UMR_MSEC__10_1_M128_S6_S3 -1000 1000
 /begin AXIS_DESCR STD_AXIS zff_atsys._.iSignale._.obj.sig_dki UMR_PROZENT__20_51_0_S6_S3 4 0 100 DEPOSIT ABSOLUTE MONOTONY MON_INCREASE /end AXIS_DESCR
/end CHARACTERISTIC
/begin CHARACTERISTIC KF_TVMEA24 "Verzoegerungszeit fuer Beginn Haupt-ME" MAP 0x2280EC kf_si16_S6_S3 2000 UMR_MSEC__10_1_0_S6_S3 -1000 1000
 /begin AXIS_DESCR STD_AXIS zff_atsys._.iSignale._.obj.sig_n_t8 UMR_U_MIN_32_1_0_S6_S3 8 0 8160 DEPOSIT ABSOLUTE MONOTONY MON_INCREASE /end AXIS_DESCR
 /begin AXIS_DESCR STD_AXIS zff_atsys._.iSignale._.obj.sig_m_t8 UMR_NM__8_1_M50_S6_S3 4 -400 1640 DEPOSIT ABSOLUTE MONOTONY MON_INCREASE /end AXIS_DESCR
/end CHARACTERISTIC
/begin CHARACTERISTIC KL_TVCGMEA24 "Temperaturabhängige Verzögerungszeit fuer Beginn Haupt-ME" CURVE 0x22814C kl_ui8_S6_S3 2000 UMR_MSEC__10_1_M128_S6_S3 -1000 1000
 /begin AXIS_DESCR STD_AXIS zff_atsys._.iSignale._.obj.sig_c_getr UMR_GRADC__1_1_M40_S6_S3 4 -40 150 DEPOSIT ABSOLUTE MONOTONY MON_INCREASE /end AXIS_DESCR
/end CHARACTERISTIC
/begin CHARACTERISTIC T_FMEHAUPTA24 "Filterzeit Start Hauptmotoreingriff" VALUE 0x26D6E0 kw_si16_S6_S3 508 UMR_MSEC__1_1_0_S6_S3 -254 254 /end CHARACTERISTIC
/begin CHARACTERISTIC K_FMEHAUPTA24 "Filterkonstante (aehnl INPT) Start Hauptmotoreingriff" VALUE 0x26D6E2 kw_si16_S6_S3 65.535 UMR___1_1000_0_S6_S3 -32.768 32.767 /end CHARACTERISTIC
/begin CHARACTERISTIC KL_TSYNMTMEHAUPTE35 "Zeit vor Erkennen synchron fuer Ende Haupt-ME" CURVE 0x228158 kl_ui8_S6_S3 1280 UMR_MSEC__10_1_M128_S6_S3 -1280 0
 /begin AXIS_DESCR STD_AXIS zff_atsys._.iSignale._.obj.sig_m_t8 UMR_NM__8_1_M50_S6_S3 6 -400 1640 DEPOSIT ABSOLUTE MONOTONY MON_INCREASE /end AXIS_DESCR
/end CHARACTERISTIC
/begin CHARACTERISTIC KF_FTSYNNTMEHAUPTE35 "Faktor auf Haupt-ME fuer Nach-ME" MAP 0x228168 kf_si16_S6_S3 1 UMR___1_100_0_S6_S3 0 1
 /begin AXIS_DESCR STD_AXIS iSasZentr.iSchaltend.t_syn UMR_MSEC__10_1_0_S6_S3 6 -5000 5000 DEPOSIT ABSOLUTE MONOTONY MON_INCREASE /end AXIS_DESCR
 /begin AXIS_DESCR STD_AXIS zff_atsys._.iSignale._.obj.sig_n_t UMR_U_MIN_1_1_0_S6_S3 4 0 8160 DEPOSIT ABSOLUTE MONOTONY MON_INCREASE /end AXIS_DESCR
/end CHARACTERISTIC
/begin CHARACTERISTIC KL_TVDKIMEA35 "Fahrpedalabhängige Verzögerungszeit Start Haupt ME" CURVE 0x2281B4 kl_ui8_S6_S3 2000 UMR_MSEC__10_1_M128_S6_S3 -1000 1000
 /begin AXIS_DESCR STD_AXIS zff_atsys._.iSignale._.obj.sig_dki UMR_PROZENT__20_51_0_S6_S3 4 0 100 DEPOSIT ABSOLUTE MONOTONY MON_INCREASE /end AXIS_DESCR
/end CHARACTERISTIC
/begin CHARACTERISTIC KF_TVMEA35 "Verzoegerungszeit fuer Beginn Haupt-ME" MAP 0x2281C0 kf_si16_S6_S3 2000 UMR_MSEC__10_1_0_S6_S3 -1000 1000
 /begin AXIS_DESCR STD_AXIS zff_atsys._.iSignale._.obj.sig_n_t8 UMR_U_MIN_32_1_0_S6_S3 8 0 8160 DEPOSIT ABSOLUTE MONOTONY MON_INCREASE /end AXIS_DESCR
 /begin AXIS_DESCR STD_AXIS zff_atsys._.iSignale._.obj.sig_m_t8 UMR_NM__8_1_M50_S6_S3 4 -400 1640 DEPOSIT ABSOLUTE MONOTONY MON_INCREASE /end AXIS_DESCR
/end CHARACTERISTIC
/begin CHARACTERISTIC KL_TVCGMEA35 "Temperaturabhängige Verzögerungszeit fuer Beginn Haupt-ME" CURVE 0x228220 kl_ui8_S6_S3 2000 UMR_MSEC__10_1_M128_S6_S3 -1000 1000
 /begin AXIS_DESCR STD_AXIS zff_atsys._.iSignale._.obj.sig_c_getr UMR_GRADC__1_1_M40_S6_S3 4 -40 150 DEPOSIT ABSOLUTE MONOTONY MON_INCREASE /end AXIS_DESCR
/end CHARACTERISTIC
/begin CHARACTERISTIC T_FMEHAUPTA35 "Filterzeit Start Hauptmotoreingriff" VALUE 0x26D6E4 kw_si16_S6_S3 508 UMR_MSEC__1_1_0_S6_S3 -254 254 /end CHARACTERISTIC
/begin CHARACTERISTIC K_FMEHAUPTA35 "Filterkonstante (aehnl INPT) Start Hauptmotoreingriff" VALUE 0x26D6E6 kw_si16_S6_S3 65.535 UMR___1_1000_0_S6_S3 -32.768 32.767 /end CHARACTERISTIC
/begin CHARACTERISTIC KL_TSYNMTMEHAUPTE46 "Zeit vor Erkennen synchron fuer Ende Haupt-ME" CURVE 0x22822C kl_ui8_S6_S3 1280 UMR_MSEC__10_1_M128_S6_S3 -1280 0
 /begin AXIS_DESCR STD_AXIS zff_atsys._.iSignale._.obj.sig_m_t8 UMR_NM__8_1_M50_S6_S3 6 -400 1640 DEPOSIT ABSOLUTE MONOTONY MON_INCREASE /end AXIS_DESCR
/end CHARACTERISTIC
/begin CHARACTERISTIC KF_FTSYNNTMEHAUPTE46 "Faktor auf Haupt-ME fuer Nach-ME" MAP 0x22823C kf_si16_S6_S3 1 UMR___1_100_0_S6_S3 0 1
 /begin AXIS_DESCR STD_AXIS iSasZentr.iSchaltend.t_syn UMR_MSEC__10_1_0_S6_S3 6 -5000 5000 DEPOSIT ABSOLUTE MONOTONY MON_INCREASE /end AXIS_DESCR
 /begin AXIS_DESCR STD_AXIS zff_atsys._.iSignale._.obj.sig_n_t UMR_U_MIN_1_1_0_S6_S3 4 0 8160 DEPOSIT ABSOLUTE MONOTONY MON_INCREASE /end AXIS_DESCR
/end CHARACTERISTIC
/begin CHARACTERISTIC KL_TVDKIMEA46 "Fahrpedalabhängige Verzögerungszeit Start Haupt ME" CURVE 0x228288 kl_ui8_S6_S3 2000 UMR_MSEC__10_1_M128_S6_S3 -1000 1000
 /begin AXIS_DESCR STD_AXIS zff_atsys._.iSignale._.obj.sig_dki UMR_PROZENT__20_51_0_S6_S3 4 0 100 DEPOSIT ABSOLUTE MONOTONY MON_INCREASE /end AXIS_DESCR
/end CHARACTERISTIC
/begin CHARACTERISTIC KF_TVMEA46 "Verzoegerungszeit fuer Beginn Haupt-ME" MAP 0x228294 kf_si16_S6_S3 2000 UMR_MSEC__10_1_0_S6_S3 -1000 1000
 /begin AXIS_DESCR STD_AXIS zff_atsys._.iSignale._.obj.sig_n_t8 UMR_U_MIN_32_1_0_S6_S3 8 0 8160 DEPOSIT ABSOLUTE MONOTONY MON_INCREASE /end AXIS_DESCR
 /begin AXIS_DESCR STD_AXIS zff_atsys._.iSignale._.obj.sig_m_t8 UMR_NM__8_1_M50_S6_S3 4 -400 1640 DEPOSIT ABSOLUTE MONOTONY MON_INCREASE /end AXIS_DESCR
/end CHARACTERISTIC
/begin CHARACTERISTIC KL_TVCGMEA46 "Temperaturabhängige Verzögerungszeit fuer Beginn Haupt-ME" CURVE 0x2282F4 kl_ui8_S6_S3 2000 UMR_MSEC__10_1_M128_S6_S3 -1000 1000
 /begin AXIS_DESCR STD_AXIS zff_atsys._.iSignale._.obj.sig_c_getr UMR_GRADC__1_1_M40_S6_S3 4 -40 150 DEPOSIT ABSOLUTE MONOTONY MON_INCREASE /end AXIS_DESCR
/end CHARACTERISTIC
/begin CHARACTERISTIC T_FMEHAUPTA46 "Filterzeit Start Hauptmotoreingriff" VALUE 0x26D6E8 kw_si16_S6_S3 508 UMR_MSEC__1_1_0_S6_S3 -254 254 /end CHARACTERISTIC
/begin CHARACTERISTIC K_FMEHAUPTA46 "Filterkonstante (aehnl INPT) Start Hauptmotoreingriff" VALUE 0x26D6EA kw_si16_S6_S3 65.535 UMR___1_1000_0_S6_S3 -32.768 32.767 /end CHARACTERISTIC
/begin CHARACTERISTIC KL_TSYNMTMEHAUPTE57 "Zeit vor Erkennen synchron fuer Ende Haupt-ME" CURVE 0x228300 kl_ui8_S6_S3 1280 UMR_MSEC__10_1_M128_S6_S3 -1280 0
 /begin AXIS_DESCR STD_AXIS zff_atsys._.iSignale._.obj.sig_m_t8 UMR_NM__8_1_M50_S6_S3 6 -400 1640 DEPOSIT ABSOLUTE MONOTONY MON_INCREASE /end AXIS_DESCR
/end CHARACTERISTIC
/begin CHARACTERISTIC KF_FTSYNNTMEHAUPTE57 "Faktor auf Haupt-ME fuer Nach-ME" MAP 0x228310 kf_si16_S6_S3 1 UMR___1_100_0_S6_S3 0 1
 /begin AXIS_DESCR STD_AXIS iSasZentr.iSchaltend.t_syn UMR_MSEC__10_1_0_S6_S3 6 -5000 5000 DEPOSIT ABSOLUTE MONOTONY MON_INCREASE /end AXIS_DESCR
 /begin AXIS_DESCR STD_AXIS zff_atsys._.iSignale._.obj.sig_n_t UMR_U_MIN_1_1_0_S6_S3 4 0 8160 DEPOSIT ABSOLUTE MONOTONY MON_INCREASE /end AXIS_DESCR
/end CHARACTERISTIC
/begin CHARACTERISTIC KL_TVDKIMEA57 "Fahrpedalabhängige Verzögerungszeit Start Haupt ME" CURVE 0x22835C kl_ui8_S6_S3 2000 UMR_MSEC__10_1_M128_S6_S3 -1000 1000
 /begin AXIS_DESCR STD_AXIS zff_atsys._.iSignale._.obj.sig_dki UMR_PROZENT__20_51_0_S6_S3 4 0 100 DEPOSIT ABSOLUTE MONOTONY MON_INCREASE /end AXIS_DESCR
/end CHARACTERISTIC
/begin CHARACTERISTIC KF_TVMEA57 "Verzoegerungszeit fuer Beginn Haupt-ME" MAP 0x228368 kf_si16_S6_S3 2000 UMR_MSEC__10_1_0_S6_S3 -1000 1000
 /begin AXIS_DESCR STD_AXIS zff_atsys._.iSignale._.obj.sig_n_t8 UMR_U_MIN_32_1_0_S6_S3 8 0 8160 DEPOSIT ABSOLUTE MONOTONY MON_INCREASE /end AXIS_DESCR
 /begin AXIS_DESCR STD_AXIS zff_atsys._.iSignale._.obj.sig_m_t8 UMR_NM__8_1_M50_S6_S3 4 -400 1640 DEPOSIT ABSOLUTE MONOTONY MON_INCREASE /end AXIS_DESCR
/end CHARACTERISTIC
/begin CHARACTERISTIC KL_TVCGMEA57 "Temperaturabhängige Verzögerungszeit fuer Beginn Haupt-ME" CURVE 0x2283C8 kl_ui8_S6_S3 2000 UMR_MSEC__10_1_M128_S6_S3 -1000 1000
 /begin AXIS_DESCR STD_AXIS zff_atsys._.iSignale._.obj.sig_c_getr UMR_GRADC__1_1_M40_S6_S3 4 -40 150 DEPOSIT ABSOLUTE MONOTONY MON_INCREASE /end AXIS_DESCR
/end CHARACTERISTIC
/begin CHARACTERISTIC T_FMEHAUPTA57 "Filterzeit Start Hauptmotoreingriff" VALUE 0x26D6EC kw_si16_S6_S3 508 UMR_MSEC__1_1_0_S6_S3 -254 254 /end CHARACTERISTIC
/begin CHARACTERISTIC K_FMEHAUPTA57 "Filterkonstante (aehnl INPT) Start Hauptmotoreingriff" VALUE 0x26D6EE kw_si16_S6_S3 65.535 UMR___1_1000_0_S6_S3 -32.768 32.767 /end CHARACTERISTIC
/begin CHARACTERISTIC KL_TSYNMTMEHAUPTE68 "Zeit vor Erkennen synchron fuer Ende Haupt-ME" CURVE 0x2283D4 kl_ui8_S6_S3 1280 UMR_MSEC__10_1_M128_S6_S3 -1280 0
 /begin AXIS_DESCR STD_AXIS zff_atsys._.iSignale._.obj.sig_m_t8 UMR_NM__8_1_M50_S6_S3 6 -400 1640 DEPOSIT ABSOLUTE MONOTONY MON_INCREASE /end AXIS_DESCR
/end CHARACTERISTIC
/begin CHARACTERISTIC KF_FTSYNNTMEHAUPTE68 "Faktor auf Haupt-ME fuer Nach-ME" MAP 0x2283E4 kf_si16_S6_S3 1 UMR___1_100_0_S6_S3 0 1
 /begin AXIS_DESCR STD_AXIS iSasZentr.iSchaltend.t_syn UMR_MSEC__10_1_0_S6_S3 6 -5000 5000 DEPOSIT ABSOLUTE MONOTONY MON_INCREASE /end AXIS_DESCR
 /begin AXIS_DESCR STD_AXIS zff_atsys._.iSignale._.obj.sig_n_t UMR_U_MIN_1_1_0_S6_S3 4 0 8160 DEPOSIT ABSOLUTE MONOTONY MON_INCREASE /end AXIS_DESCR
/end CHARACTERISTIC
/begin CHARACTERISTIC KL_TVDKIMEA68 "Fahrpedalabhängige Verzögerungszeit Start Haupt ME" CURVE 0x228430 kl_ui8_S6_S3 2000 UMR_MSEC__10_1_M128_S6_S3 -1000 1000
 /begin AXIS_DESCR STD_AXIS zff_atsys._.iSignale._.obj.sig_dki UMR_PROZENT__20_51_0_S6_S3 4 0 100 DEPOSIT ABSOLUTE MONOTONY MON_INCREASE /end AXIS_DESCR
/end CHARACTERISTIC
/begin CHARACTERISTIC KF_TVMEA68 "Verzoegerungszeit fuer Beginn Haupt-ME" MAP 0x22843C kf_si16_S6_S3 2000 UMR_MSEC__10_1_0_S6_S3 -1000 1000
 /begin AXIS_DESCR STD_AXIS zff_atsys._.iSignale._.obj.sig_n_t8 UMR_U_MIN_32_1_0_S6_S3 8 0 8160 DEPOSIT ABSOLUTE MONOTONY MON_INCREASE /end AXIS_DESCR
 /begin AXIS_DESCR STD_AXIS zff_atsys._.iSignale._.obj.sig_m_t8 UMR_NM__8_1_M50_S6_S3 4 -400 1640 DEPOSIT ABSOLUTE MONOTONY MON_INCREASE /end AXIS_DESCR
/end CHARACTERISTIC
/begin CHARACTERISTIC KL_TVCGMEA68 "Temperaturabhängige Verzögerungszeit fuer Beginn Haupt-ME" CURVE 0x22849C kl_ui8_S6_S3 2000 UMR_MSEC__10_1_M128_S6_S3 -1000 1000
 /begin AXIS_DESCR STD_AXIS zff_atsys._.iSignale._.obj.sig_c_getr UMR_GRADC__1_1_M40_S6_S3 4 -40 150 DEPOSIT ABSOLUTE MONOTONY MON_INCREASE /end AXIS_DESCR
/end CHARACTERISTIC
/begin CHARACTERISTIC T_FMEHAUPTA68 "Filterzeit Start Hauptmotoreingriff" VALUE 0x26D6F0 kw_si16_S6_S3 508 UMR_MSEC__1_1_0_S6_S3 -254 254 /end CHARACTERISTIC
/begin CHARACTERISTIC K_FMEHAUPTA68 "Filterkonstante (aehnl INPT) Start Hauptmotoreingriff" VALUE 0x26D6F2 kw_si16_S6_S3 65.535 UMR___1_1000_0_S6_S3 -32.768 32.767 /end CHARACTERISTIC
/begin CHARACTERISTIC KL_TSYNMTMEHAUPTESP12 "Zeit vor Erkennen synchron fuer Ende Haupt-ME" CURVE 0x2284A8 kl_ui8_S6_S3 1280 UMR_MSEC__10_1_M128_S6_S3 -1280 0
 /begin AXIS_DESCR STD_AXIS zff_atsys._.iSignale._.obj.sig_m_t8 UMR_NM__8_1_M50_S6_S3 6 -400 1640 DEPOSIT ABSOLUTE MONOTONY MON_INCREASE /end AXIS_DESCR
/end CHARACTERISTIC
/begin CHARACTERISTIC KF_FTSYNNTMEHAUPTESP12 "Faktor auf Haupt-ME fuer Nach-ME" MAP 0x2284B8 kf_si16_S6_S3 1 UMR___1_100_0_S6_S3 0 1
 /begin AXIS_DESCR STD_AXIS iSasZentr.iSchaltend.t_syn UMR_MSEC__10_1_0_S6_S3 6 -5000 5000 DEPOSIT ABSOLUTE MONOTONY MON_INCREASE /end AXIS_DESCR
 /begin AXIS_DESCR STD_AXIS zff_atsys._.iSignale._.obj.sig_n_t UMR_U_MIN_1_1_0_S6_S3 4 0 8160 DEPOSIT ABSOLUTE MONOTONY MON_INCREASE /end AXIS_DESCR
/end CHARACTERISTIC
/begin CHARACTERISTIC KL_TVDKIMEASP12 "Fahrpedalabhängige Verzögerungszeit Start Haupt ME" CURVE 0x228504 kl_ui8_S6_S3 2000 UMR_MSEC__10_1_M128_S6_S3 -1000 1000
 /begin AXIS_DESCR STD_AXIS zff_atsys._.iSignale._.obj.sig_dki UMR_PROZENT__20_51_0_S6_S3 4 0 100 DEPOSIT ABSOLUTE MONOTONY MON_INCREASE /end AXIS_DESCR
/end CHARACTERISTIC
/begin CHARACTERISTIC KF_TVMEASP12 "Verzoegerungszeit fuer Beginn Haupt-ME" MAP 0x228510 kf_si16_S6_S3 2000 UMR_MSEC__10_1_0_S6_S3 -1000 1000
 /begin AXIS_DESCR STD_AXIS zff_atsys._.iSignale._.obj.sig_n_t8 UMR_U_MIN_32_1_0_S6_S3 8 0 8160 DEPOSIT ABSOLUTE MONOTONY MON_INCREASE /end AXIS_DESCR
 /begin AXIS_DESCR STD_AXIS zff_atsys._.iSignale._.obj.sig_m_t8 UMR_NM__8_1_M50_S6_S3 4 -400 1640 DEPOSIT ABSOLUTE MONOTONY MON_INCREASE /end AXIS_DESCR
/end CHARACTERISTIC
/begin CHARACTERISTIC KL_TVCGMEASP12 "Temperaturabhängige Verzögerungszeit fuer Beginn Haupt-ME" CURVE 0x228570 kl_ui8_S6_S3 2000 UMR_MSEC__10_1_M128_S6_S3 -1000 1000
 /begin AXIS_DESCR STD_AXIS zff_atsys._.iSignale._.obj.sig_c_getr UMR_GRADC__1_1_M40_S6_S3 4 -40 150 DEPOSIT ABSOLUTE MONOTONY MON_INCREASE /end AXIS_DESCR
/end CHARACTERISTIC
/begin CHARACTERISTIC T_FMEHAUPTASP12 "Filterzeit Start Hauptmotoreingriff" VALUE 0x26D6F4 kw_si16_S6_S3 508 UMR_MSEC__1_1_0_S6_S3 -254 254 /end CHARACTERISTIC
/begin CHARACTERISTIC K_FMEHAUPTASP12 "Filterkonstante (aehnl INPT) Start Hauptmotoreingriff" VALUE 0x26D6F6 kw_si16_S6_S3 65.535 UMR___1_1000_0_S6_S3 -32.768 32.767 /end CHARACTERISTIC
/begin CHARACTERISTIC KL_TSYNMTMEHAUPTESP23 "Zeit vor Erkennen synchron fuer Ende Haupt-ME" CURVE 0x22857C kl_ui8_S6_S3 1280 UMR_MSEC__10_1_M128_S6_S3 -1280 0
 /begin AXIS_DESCR STD_AXIS zff_atsys._.iSignale._.obj.sig_m_t8 UMR_NM__8_1_M50_S6_S3 6 -400 1640 DEPOSIT ABSOLUTE MONOTONY MON_INCREASE /end AXIS_DESCR
/end CHARACTERISTIC
/begin CHARACTERISTIC KF_FTSYNNTMEHAUPTESP23 "Faktor auf Haupt-ME fuer Nach-ME" MAP 0x22858C kf_si16_S6_S3 1 UMR___1_100_0_S6_S3 0 1
 /begin AXIS_DESCR STD_AXIS iSasZentr.iSchaltend.t_syn UMR_MSEC__10_1_0_S6_S3 6 -5000 5000 DEPOSIT ABSOLUTE MONOTONY MON_INCREASE /end AXIS_DESCR
 /begin AXIS_DESCR STD_AXIS zff_atsys._.iSignale._.obj.sig_n_t UMR_U_MIN_1_1_0_S6_S3 4 0 8160 DEPOSIT ABSOLUTE MONOTONY MON_INCREASE /end AXIS_DESCR
/end CHARACTERISTIC
/begin CHARACTERISTIC KL_TVDKIMEASP23 "Fahrpedalabhängige Verzögerungszeit Start Haupt ME" CURVE 0x2285D8 kl_ui8_S6_S3 2000 UMR_MSEC__10_1_M128_S6_S3 -1000 1000
 /begin AXIS_DESCR STD_AXIS zff_atsys._.iSignale._.obj.sig_dki UMR_PROZENT__20_51_0_S6_S3 4 0 100 DEPOSIT ABSOLUTE MONOTONY MON_INCREASE /end AXIS_DESCR
/end CHARACTERISTIC
/begin CHARACTERISTIC KF_TVMEASP23 "Verzoegerungszeit fuer Beginn Haupt-ME" MAP 0x2285E4 kf_si16_S6_S3 2000 UMR_MSEC__10_1_0_S6_S3 -1000 1000
 /begin AXIS_DESCR STD_AXIS zff_atsys._.iSignale._.obj.sig_n_t8 UMR_U_MIN_32_1_0_S6_S3 8 0 8160 DEPOSIT ABSOLUTE MONOTONY MON_INCREASE /end AXIS_DESCR
 /begin AXIS_DESCR STD_AXIS zff_atsys._.iSignale._.obj.sig_m_t8 UMR_NM__8_1_M50_S6_S3 4 -400 1640 DEPOSIT ABSOLUTE MONOTONY MON_INCREASE /end AXIS_DESCR
/end CHARACTERISTIC
/begin CHARACTERISTIC KL_TVCGMEASP23 "Temperaturabhängige Verzögerungszeit fuer Beginn Haupt-ME" CURVE 0x228644 kl_ui8_S6_S3 2000 UMR_MSEC__10_1_M128_S6_S3 -1000 1000
 /begin AXIS_DESCR STD_AXIS zff_atsys._.iSignale._.obj.sig_c_getr UMR_GRADC__1_1_M40_S6_S3 4 -40 150 DEPOSIT ABSOLUTE MONOTONY MON_INCREASE /end AXIS_DESCR
/end CHARACTERISTIC
/begin CHARACTERISTIC T_FMEHAUPTASP23 "Filterzeit Start Hauptmotoreingriff" VALUE 0x26D6F8 kw_si16_S6_S3 508 UMR_MSEC__1_1_0_S6_S3 -254 254 /end CHARACTERISTIC
/begin CHARACTERISTIC K_FMEHAUPTASP23 "Filterkonstante (aehnl INPT) Start Hauptmotoreingriff" VALUE 0x26D6FA kw_si16_S6_S3 65.535 UMR___1_1000_0_S6_S3 -32.768 32.767 /end CHARACTERISTIC
/begin CHARACTERISTIC KL_TSYNMTMEHAUPTESP34 "Zeit vor Erkennen synchron fuer Ende Haupt-ME" CURVE 0x228650 kl_ui8_S6_S3 1280 UMR_MSEC__10_1_M128_S6_S3 -1280 0
 /begin AXIS_DESCR STD_AXIS zff_atsys._.iSignale._.obj.sig_m_t8 UMR_NM__8_1_M50_S6_S3 6 -400 1640 DEPOSIT ABSOLUTE MONOTONY MON_INCREASE /end AXIS_DESCR
/end CHARACTERISTIC
/begin CHARACTERISTIC KF_FTSYNNTMEHAUPTESP34 "Faktor auf Haupt-ME fuer Nach-ME" MAP 0x228660 kf_si16_S6_S3 1 UMR___1_100_0_S6_S3 0 1
 /begin AXIS_DESCR STD_AXIS iSasZentr.iSchaltend.t_syn UMR_MSEC__10_1_0_S6_S3 6 -5000 5000 DEPOSIT ABSOLUTE MONOTONY MON_INCREASE /end AXIS_DESCR
 /begin AXIS_DESCR STD_AXIS zff_atsys._.iSignale._.obj.sig_n_t UMR_U_MIN_1_1_0_S6_S3 4 0 8160 DEPOSIT ABSOLUTE MONOTONY MON_INCREASE /end AXIS_DESCR
/end CHARACTERISTIC
/begin CHARACTERISTIC KL_TVDKIMEASP34 "Fahrpedalabhängige Verzögerungszeit Start Haupt ME" CURVE 0x2286AC kl_ui8_S6_S3 2000 UMR_MSEC__10_1_M128_S6_S3 -1000 1000
 /begin AXIS_DESCR STD_AXIS zff_atsys._.iSignale._.obj.sig_dki UMR_PROZENT__20_51_0_S6_S3 4 0 100 DEPOSIT ABSOLUTE MONOTONY MON_INCREASE /end AXIS_DESCR
/end CHARACTERISTIC
/begin CHARACTERISTIC KF_TVMEASP34 "Verzoegerungszeit fuer Beginn Haupt-ME" MAP 0x2286B8 kf_si16_S6_S3 2000 UMR_MSEC__10_1_0_S6_S3 -1000 1000
 /begin AXIS_DESCR STD_AXIS zff_atsys._.iSignale._.obj.sig_n_t8 UMR_U_MIN_32_1_0_S6_S3 8 0 8160 DEPOSIT ABSOLUTE MONOTONY MON_INCREASE /end AXIS_DESCR
 /begin AXIS_DESCR STD_AXIS zff_atsys._.iSignale._.obj.sig_m_t8 UMR_NM__8_1_M50_S6_S3 4 -400 1640 DEPOSIT ABSOLUTE MONOTONY MON_INCREASE /end AXIS_DESCR
/end CHARACTERISTIC
/begin CHARACTERISTIC KL_TVCGMEASP34 "Temperaturabhängige Verzögerungszeit fuer Beginn Haupt-ME" CURVE 0x228718 kl_ui8_S6_S3 2000 UMR_MSEC__10_1_M128_S6_S3 -1000 1000
 /begin AXIS_DESCR STD_AXIS zff_atsys._.iSignale._.obj.sig_c_getr UMR_GRADC__1_1_M40_S6_S3 4 -40 150 DEPOSIT ABSOLUTE MONOTONY MON_INCREASE /end AXIS_DESCR
/end CHARACTERISTIC
/begin CHARACTERISTIC T_FMEHAUPTASP34 "Filterzeit Start Hauptmotoreingriff" VALUE 0x26D6FC kw_si16_S6_S3 508 UMR_MSEC__1_1_0_S6_S3 -254 254 /end CHARACTERISTIC
/begin CHARACTERISTIC K_FMEHAUPTASP34 "Filterkonstante (aehnl INPT) Start Hauptmotoreingriff" VALUE 0x26D6FE kw_si16_S6_S3 65.535 UMR___1_1000_0_S6_S3 -32.768 32.767 /end CHARACTERISTIC
/begin CHARACTERISTIC KL_TSYNMTMEHAUPTESP45 "Zeit vor Erkennen synchron fuer Ende Haupt-ME" CURVE 0x228724 kl_ui8_S6_S3 1280 UMR_MSEC__10_1_M128_S6_S3 -1280 0
 /begin AXIS_DESCR STD_AXIS zff_atsys._.iSignale._.obj.sig_m_t8 UMR_NM__8_1_M50_S6_S3 6 -400 1640 DEPOSIT ABSOLUTE MONOTONY MON_INCREASE /end AXIS_DESCR
/end CHARACTERISTIC
/begin CHARACTERISTIC KF_FTSYNNTMEHAUPTESP45 "Faktor auf Haupt-ME fuer Nach-ME" MAP 0x228734 kf_si16_S6_S3 1 UMR___1_100_0_S6_S3 0 1
 /begin AXIS_DESCR STD_AXIS iSasZentr.iSchaltend.t_syn UMR_MSEC__10_1_0_S6_S3 6 -5000 5000 DEPOSIT ABSOLUTE MONOTONY MON_INCREASE /end AXIS_DESCR
 /begin AXIS_DESCR STD_AXIS zff_atsys._.iSignale._.obj.sig_n_t UMR_U_MIN_1_1_0_S6_S3 4 0 8160 DEPOSIT ABSOLUTE MONOTONY MON_INCREASE /end AXIS_DESCR
/end CHARACTERISTIC
/begin CHARACTERISTIC KL_TVDKIMEASP45 "Fahrpedalabhängige Verzögerungszeit Start Haupt ME" CURVE 0x228780 kl_ui8_S6_S3 2000 UMR_MSEC__10_1_M128_S6_S3 -1000 1000
 /begin AXIS_DESCR STD_AXIS zff_atsys._.iSignale._.obj.sig_dki UMR_PROZENT__20_51_0_S6_S3 4 0 100 DEPOSIT ABSOLUTE MONOTONY MON_INCREASE /end AXIS_DESCR
/end CHARACTERISTIC
/begin CHARACTERISTIC KF_TVMEASP45 "Verzoegerungszeit fuer Beginn Haupt-ME" MAP 0x22878C kf_si16_S6_S3 2000 UMR_MSEC__10_1_0_S6_S3 -1000 1000
 /begin AXIS_DESCR STD_AXIS zff_atsys._.iSignale._.obj.sig_n_t8 UMR_U_MIN_32_1_0_S6_S3 8 0 8160 DEPOSIT ABSOLUTE MONOTONY MON_INCREASE /end AXIS_DESCR
 /begin AXIS_DESCR STD_AXIS zff_atsys._.iSignale._.obj.sig_m_t8 UMR_NM__8_1_M50_S6_S3 4 -400 1640 DEPOSIT ABSOLUTE MONOTONY MON_INCREASE /end AXIS_DESCR
/end CHARACTERISTIC
/begin CHARACTERISTIC KL_TVCGMEASP45 "Temperaturabhängige Verzögerungszeit fuer Beginn Haupt-ME" CURVE 0x2287EC kl_ui8_S6_S3 2000 UMR_MSEC__10_1_M128_S6_S3 -1000 1000
 /begin AXIS_DESCR STD_AXIS zff_atsys._.iSignale._.obj.sig_c_getr UMR_GRADC__1_1_M40_S6_S3 4 -40 150 DEPOSIT ABSOLUTE MONOTONY MON_INCREASE /end AXIS_DESCR
/end CHARACTERISTIC
/begin CHARACTERISTIC T_FMEHAUPTASP45 "Filterzeit Start Hauptmotoreingriff" VALUE 0x26D700 kw_si16_S6_S3 508 UMR_MSEC__1_1_0_S6_S3 -254 254 /end CHARACTERISTIC
/begin CHARACTERISTIC K_FMEHAUPTASP45 "Filterkonstante (aehnl INPT) Start Hauptmotoreingriff" VALUE 0x26D702 kw_si16_S6_S3 65.535 UMR___1_1000_0_S6_S3 -32.768 32.767 /end CHARACTERISTIC
/begin CHARACTERISTIC KL_TSYNMTMEHAUPTESP56 "Zeit vor Erkennen synchron fuer Ende Haupt-ME" CURVE 0x2287F8 kl_ui8_S6_S3 1280 UMR_MSEC__10_1_M128_S6_S3 -1280 0
 /begin AXIS_DESCR STD_AXIS zff_atsys._.iSignale._.obj.sig_m_t8 UMR_NM__8_1_M50_S6_S3 6 -400 1640 DEPOSIT ABSOLUTE MONOTONY MON_INCREASE /end AXIS_DESCR
/end CHARACTERISTIC
/begin CHARACTERISTIC KF_FTSYNNTMEHAUPTESP56 "Faktor auf Haupt-ME fuer Nach-ME" MAP 0x228808 kf_si16_S6_S3 1 UMR___1_100_0_S6_S3 0 1
 /begin AXIS_DESCR STD_AXIS iSasZentr.iSchaltend.t_syn UMR_MSEC__10_1_0_S6_S3 6 -5000 5000 DEPOSIT ABSOLUTE MONOTONY MON_INCREASE /end AXIS_DESCR
 /begin AXIS_DESCR STD_AXIS zff_atsys._.iSignale._.obj.sig_n_t UMR_U_MIN_1_1_0_S6_S3 4 0 8160 DEPOSIT ABSOLUTE MONOTONY MON_INCREASE /end AXIS_DESCR
/end CHARACTERISTIC
/begin CHARACTERISTIC KL_TVDKIMEASP56 "Fahrpedalabhängige Verzögerungszeit Start Haupt ME" CURVE 0x228854 kl_ui8_S6_S3 2000 UMR_MSEC__10_1_M128_S6_S3 -1000 1000
 /begin AXIS_DESCR STD_AXIS zff_atsys._.iSignale._.obj.sig_dki UMR_PROZENT__20_51_0_S6_S3 4 0 100 DEPOSIT ABSOLUTE MONOTONY MON_INCREASE /end AXIS_DESCR
/end CHARACTERISTIC
/begin CHARACTERISTIC KF_TVMEASP56 "Verzoegerungszeit fuer Beginn Haupt-ME" MAP 0x228860 kf_si16_S6_S3 2000 UMR_MSEC__10_1_0_S6_S3 -1000 1000
 /begin AXIS_DESCR STD_AXIS zff_atsys._.iSignale._.obj.sig_n_t8 UMR_U_MIN_32_1_0_S6_S3 8 0 8160 DEPOSIT ABSOLUTE MONOTONY MON_INCREASE /end AXIS_DESCR
 /begin AXIS_DESCR STD_AXIS zff_atsys._.iSignale._.obj.sig_m_t8 UMR_NM__8_1_M50_S6_S3 4 -400 1640 DEPOSIT ABSOLUTE MONOTONY MON_INCREASE /end AXIS_DESCR
/end CHARACTERISTIC
/begin CHARACTERISTIC KL_TVCGMEASP56 "Temperaturabhängige Verzögerungszeit fuer Beginn Haupt-ME" CURVE 0x2288C0 kl_ui8_S6_S3 2000 UMR_MSEC__10_1_M128_S6_S3 -1000 1000
 /begin AXIS_DESCR STD_AXIS zff_atsys._.iSignale._.obj.sig_c_getr UMR_GRADC__1_1_M40_S6_S3 4 -40 150 DEPOSIT ABSOLUTE MONOTONY MON_INCREASE /end AXIS_DESCR
/end CHARACTERISTIC
/begin CHARACTERISTIC T_FMEHAUPTASP56 "Filterzeit Start Hauptmotoreingriff" VALUE 0x26D704 kw_si16_S6_S3 508 UMR_MSEC__1_1_0_S6_S3 -254 254 /end CHARACTERISTIC
/begin CHARACTERISTIC K_FMEHAUPTASP56 "Filterkonstante (aehnl INPT) Start Hauptmotoreingriff" VALUE 0x26D706 kw_si16_S6_S3 65.535 UMR___1_1000_0_S6_S3 -32.768 32.767 /end CHARACTERISTIC
/begin CHARACTERISTIC KL_TSYNMTMEHAUPTESP67 "Zeit vor Erkennen synchron fuer Ende Haupt-ME" CURVE 0x2288CC kl_ui8_S6_S3 1280 UMR_MSEC__10_1_M128_S6_S3 -1280 0
 /begin AXIS_DESCR STD_AXIS zff_atsys._.iSignale._.obj.sig_m_t8 UMR_NM__8_1_M50_S6_S3 6 -400 1640 DEPOSIT ABSOLUTE MONOTONY MON_INCREASE /end AXIS_DESCR
/end CHARACTERISTIC
/begin CHARACTERISTIC KF_FTSYNNTMEHAUPTESP67 "Faktor auf Haupt-ME fuer Nach-ME" MAP 0x2288DC kf_si16_S6_S3 1 UMR___1_100_0_S6_S3 0 1
 /begin AXIS_DESCR STD_AXIS iSasZentr.iSchaltend.t_syn UMR_MSEC__10_1_0_S6_S3 6 -5000 5000 DEPOSIT ABSOLUTE MONOTONY MON_INCREASE /end AXIS_DESCR
 /begin AXIS_DESCR STD_AXIS zff_atsys._.iSignale._.obj.sig_n_t UMR_U_MIN_1_1_0_S6_S3 4 0 8160 DEPOSIT ABSOLUTE MONOTONY MON_INCREASE /end AXIS_DESCR
/end CHARACTERISTIC
/begin CHARACTERISTIC KL_TVDKIMEASP67 "Fahrpedalabhängige Verzögerungszeit Start Haupt ME" CURVE 0x228928 kl_ui8_S6_S3 2000 UMR_MSEC__10_1_M128_S6_S3 -1000 1000
 /begin AXIS_DESCR STD_AXIS zff_atsys._.iSignale._.obj.sig_dki UMR_PROZENT__20_51_0_S6_S3 4 0 100 DEPOSIT ABSOLUTE MONOTONY MON_INCREASE /end AXIS_DESCR
/end CHARACTERISTIC
/begin CHARACTERISTIC KF_TVMEASP67 "Verzoegerungszeit fuer Beginn Haupt-ME" MAP 0x228934 kf_si16_S6_S3 2000 UMR_MSEC__10_1_0_S6_S3 -1000 1000
 /begin AXIS_DESCR STD_AXIS zff_atsys._.iSignale._.obj.sig_n_t8 UMR_U_MIN_32_1_0_S6_S3 8 0 8160 DEPOSIT ABSOLUTE MONOTONY MON_INCREASE /end AXIS_DESCR
 /begin AXIS_DESCR STD_AXIS zff_atsys._.iSignale._.obj.sig_m_t8 UMR_NM__8_1_M50_S6_S3 4 -400 1640 DEPOSIT ABSOLUTE MONOTONY MON_INCREASE /end AXIS_DESCR
/end CHARACTERISTIC
/begin CHARACTERISTIC KL_TVCGMEASP67 "Temperaturabhängige Verzögerungszeit fuer Beginn Haupt-ME" CURVE 0x228994 kl_ui8_S6_S3 2000 UMR_MSEC__10_1_M128_S6_S3 -1000 1000
 /begin AXIS_DESCR STD_AXIS zff_atsys._.iSignale._.obj.sig_c_getr UMR_GRADC__1_1_M40_S6_S3 4 -40 150 DEPOSIT ABSOLUTE MONOTONY MON_INCREASE /end AXIS_DESCR
/end CHARACTERISTIC
/begin CHARACTERISTIC T_FMEHAUPTASP67 "Filterzeit Start Hauptmotoreingriff" VALUE 0x26D708 kw_si16_S6_S3 508 UMR_MSEC__1_1_0_S6_S3 -254 254 /end CHARACTERISTIC
/begin CHARACTERISTIC K_FMEHAUPTASP67 "Filterkonstante (aehnl INPT) Start Hauptmotoreingriff" VALUE 0x26D70A kw_si16_S6_S3 65.535 UMR___1_1000_0_S6_S3 -32.768 32.767 /end CHARACTERISTIC
/begin CHARACTERISTIC KL_TSYNMTMEHAUPTESP78 "Zeit vor Erkennen synchron fuer Ende Haupt-ME" CURVE 0x2289A0 kl_ui8_S6_S3 1280 UMR_MSEC__10_1_M128_S6_S3 -1280 0
 /begin AXIS_DESCR STD_AXIS zff_atsys._.iSignale._.obj.sig_m_t8 UMR_NM__8_1_M50_S6_S3 6 -400 1640 DEPOSIT ABSOLUTE MONOTONY MON_INCREASE /end AXIS_DESCR
/end CHARACTERISTIC
/begin CHARACTERISTIC KF_FTSYNNTMEHAUPTESP78 "Faktor auf Haupt-ME fuer Nach-ME" MAP 0x2289B0 kf_si16_S6_S3 1 UMR___1_100_0_S6_S3 0 1
 /begin AXIS_DESCR STD_AXIS iSasZentr.iSchaltend.t_syn UMR_MSEC__10_1_0_S6_S3 6 -5000 5000 DEPOSIT ABSOLUTE MONOTONY MON_INCREASE /end AXIS_DESCR
 /begin AXIS_DESCR STD_AXIS zff_atsys._.iSignale._.obj.sig_n_t UMR_U_MIN_1_1_0_S6_S3 4 0 8160 DEPOSIT ABSOLUTE MONOTONY MON_INCREASE /end AXIS_DESCR
/end CHARACTERISTIC
/begin CHARACTERISTIC KL_TVDKIMEASP78 "Fahrpedalabhängige Verzögerungszeit Start Haupt ME" CURVE 0x2289FC kl_ui8_S6_S3 2000 UMR_MSEC__10_1_M128_S6_S3 -1000 1000
 /begin AXIS_DESCR STD_AXIS zff_atsys._.iSignale._.obj.sig_dki UMR_PROZENT__20_51_0_S6_S3 4 0 100 DEPOSIT ABSOLUTE MONOTONY MON_INCREASE /end AXIS_DESCR
/end CHARACTERISTIC
/begin CHARACTERISTIC KF_TVMEASP78 "Verzoegerungszeit fuer Beginn Haupt-ME" MAP 0x228A08 kf_si16_S6_S3 2000 UMR_MSEC__10_1_0_S6_S3 -1000 1000
 /begin AXIS_DESCR STD_AXIS zff_atsys._.iSignale._.obj.sig_n_t8 UMR_U_MIN_32_1_0_S6_S3 8 0 8160 DEPOSIT ABSOLUTE MONOTONY MON_INCREASE /end AXIS_DESCR
 /begin AXIS_DESCR STD_AXIS zff_atsys._.iSignale._.obj.sig_m_t8 UMR_NM__8_1_M50_S6_S3 4 -400 1640 DEPOSIT ABSOLUTE MONOTONY MON_INCREASE /end AXIS_DESCR
/end CHARACTERISTIC
/begin CHARACTERISTIC KL_TVCGMEASP78 "Temperaturabhängige Verzögerungszeit fuer Beginn Haupt-ME" CURVE 0x228A68 kl_ui8_S6_S3 2000 UMR_MSEC__10_1_M128_S6_S3 -1000 1000
 /begin AXIS_DESCR STD_AXIS zff_atsys._.iSignale._.obj.sig_c_getr UMR_GRADC__1_1_M40_S6_S3 4 -40 150 DEPOSIT ABSOLUTE MONOTONY MON_INCREASE /end AXIS_DESCR
/end CHARACTERISTIC
/begin CHARACTERISTIC T_FMEHAUPTASP78 "Filterzeit Start Hauptmotoreingriff" VALUE 0x26D70C kw_si16_S6_S3 508 UMR_MSEC__1_1_0_S6_S3 -254 254 /end CHARACTERISTIC
/begin CHARACTERISTIC K_FMEHAUPTASP78 "Filterkonstante (aehnl INPT) Start Hauptmotoreingriff" VALUE 0x26D70E kw_si16_S6_S3 65.535 UMR___1_1000_0_S6_S3 -32.768 32.767 /end CHARACTERISTIC
/begin CHARACTERISTIC KL_TSYNMTMEHAUPTESP13 "Zeit vor Erkennen synchron fuer Ende Haupt-ME" CURVE 0x228A74 kl_ui8_S6_S3 1280 UMR_MSEC__10_1_M128_S6_S3 -1280 0
 /begin AXIS_DESCR STD_AXIS zff_atsys._.iSignale._.obj.sig_m_t8 UMR_NM__8_1_M50_S6_S3 6 -400 1640 DEPOSIT ABSOLUTE MONOTONY MON_INCREASE /end AXIS_DESCR
/end CHARACTERISTIC
/begin CHARACTERISTIC KF_FTSYNNTMEHAUPTESP13 "Faktor auf Haupt-ME fuer Nach-ME" MAP 0x228A84 kf_si16_S6_S3 1 UMR___1_100_0_S6_S3 0 1
 /begin AXIS_DESCR STD_AXIS iSasZentr.iSchaltend.t_syn UMR_MSEC__10_1_0_S6_S3 6 -5000 5000 DEPOSIT ABSOLUTE MONOTONY MON_INCREASE /end AXIS_DESCR
 /begin AXIS_DESCR STD_AXIS zff_atsys._.iSignale._.obj.sig_n_t UMR_U_MIN_1_1_0_S6_S3 4 0 8160 DEPOSIT ABSOLUTE MONOTONY MON_INCREASE /end AXIS_DESCR
/end CHARACTERISTIC
/begin CHARACTERISTIC KL_TVDKIMEASP13 "Fahrpedalabhängige Verzögerungszeit Start Haupt ME" CURVE 0x228AD0 kl_ui8_S6_S3 2000 UMR_MSEC__10_1_M128_S6_S3 -1000 1000
 /begin AXIS_DESCR STD_AXIS zff_atsys._.iSignale._.obj.sig_dki UMR_PROZENT__20_51_0_S6_S3 4 0 100 DEPOSIT ABSOLUTE MONOTONY MON_INCREASE /end AXIS_DESCR
/end CHARACTERISTIC
/begin CHARACTERISTIC KF_TVMEASP13 "Verzoegerungszeit fuer Beginn Haupt-ME" MAP 0x228ADC kf_si16_S6_S3 2000 UMR_MSEC__10_1_0_S6_S3 -1000 1000
 /begin AXIS_DESCR STD_AXIS zff_atsys._.iSignale._.obj.sig_n_t8 UMR_U_MIN_32_1_0_S6_S3 8 0 8160 DEPOSIT ABSOLUTE MONOTONY MON_INCREASE /end AXIS_DESCR
 /begin AXIS_DESCR STD_AXIS zff_atsys._.iSignale._.obj.sig_m_t8 UMR_NM__8_1_M50_S6_S3 4 -400 1640 DEPOSIT ABSOLUTE MONOTONY MON_INCREASE /end AXIS_DESCR
/end CHARACTERISTIC
/begin CHARACTERISTIC KL_TVCGMEASP13 "Temperaturabhängige Verzögerungszeit fuer Beginn Haupt-ME" CURVE 0x228B3C kl_ui8_S6_S3 2000 UMR_MSEC__10_1_M128_S6_S3 -1000 1000
 /begin AXIS_DESCR STD_AXIS zff_atsys._.iSignale._.obj.sig_c_getr UMR_GRADC__1_1_M40_S6_S3 4 -40 150 DEPOSIT ABSOLUTE MONOTONY MON_INCREASE /end AXIS_DESCR
/end CHARACTERISTIC
/begin CHARACTERISTIC T_FMEHAUPTASP13 "Filterzeit Start Hauptmotoreingriff" VALUE 0x26D710 kw_si16_S6_S3 508 UMR_MSEC__1_1_0_S6_S3 -254 254 /end CHARACTERISTIC
/begin CHARACTERISTIC K_FMEHAUPTASP13 "Filterkonstante (aehnl INPT) Start Hauptmotoreingriff" VALUE 0x26D712 kw_si16_S6_S3 65.535 UMR___1_1000_0_S6_S3 -32.768 32.767 /end CHARACTERISTIC
/begin CHARACTERISTIC KL_TSYNMTMEHAUPTESP24 "Zeit vor Erkennen synchron fuer Ende Haupt-ME" CURVE 0x228B48 kl_ui8_S6_S3 1280 UMR_MSEC__10_1_M128_S6_S3 -1280 0
 /begin AXIS_DESCR STD_AXIS zff_atsys._.iSignale._.obj.sig_m_t8 UMR_NM__8_1_M50_S6_S3 6 -400 1640 DEPOSIT ABSOLUTE MONOTONY MON_INCREASE /end AXIS_DESCR
/end CHARACTERISTIC
/begin CHARACTERISTIC KF_FTSYNNTMEHAUPTESP24 "Faktor auf Haupt-ME fuer Nach-ME" MAP 0x228B58 kf_si16_S6_S3 1 UMR___1_100_0_S6_S3 0 1
 /begin AXIS_DESCR STD_AXIS iSasZentr.iSchaltend.t_syn UMR_MSEC__10_1_0_S6_S3 6 -5000 5000 DEPOSIT ABSOLUTE MONOTONY MON_INCREASE /end AXIS_DESCR
 /begin AXIS_DESCR STD_AXIS zff_atsys._.iSignale._.obj.sig_n_t UMR_U_MIN_1_1_0_S6_S3 4 0 8160 DEPOSIT ABSOLUTE MONOTONY MON_INCREASE /end AXIS_DESCR
/end CHARACTERISTIC
/begin CHARACTERISTIC KL_TVDKIMEASP24 "Fahrpedalabhängige Verzögerungszeit Start Haupt ME" CURVE 0x228BA4 kl_ui8_S6_S3 2000 UMR_MSEC__10_1_M128_S6_S3 -1000 1000
 /begin AXIS_DESCR STD_AXIS zff_atsys._.iSignale._.obj.sig_dki UMR_PROZENT__20_51_0_S6_S3 4 0 100 DEPOSIT ABSOLUTE MONOTONY MON_INCREASE /end AXIS_DESCR
/end CHARACTERISTIC
/begin CHARACTERISTIC KF_TVMEASP24 "Verzoegerungszeit fuer Beginn Haupt-ME" MAP 0x228BB0 kf_si16_S6_S3 2000 UMR_MSEC__10_1_0_S6_S3 -1000 1000
 /begin AXIS_DESCR STD_AXIS zff_atsys._.iSignale._.obj.sig_n_t8 UMR_U_MIN_32_1_0_S6_S3 8 0 8160 DEPOSIT ABSOLUTE MONOTONY MON_INCREASE /end AXIS_DESCR
 /begin AXIS_DESCR STD_AXIS zff_atsys._.iSignale._.obj.sig_m_t8 UMR_NM__8_1_M50_S6_S3 4 -400 1640 DEPOSIT ABSOLUTE MONOTONY MON_INCREASE /end AXIS_DESCR
/end CHARACTERISTIC
/begin CHARACTERISTIC KL_TVCGMEASP24 "Temperaturabhängige Verzögerungszeit fuer Beginn Haupt-ME" CURVE 0x228C10 kl_ui8_S6_S3 2000 UMR_MSEC__10_1_M128_S6_S3 -1000 1000
 /begin AXIS_DESCR STD_AXIS zff_atsys._.iSignale._.obj.sig_c_getr UMR_GRADC__1_1_M40_S6_S3 4 -40 150 DEPOSIT ABSOLUTE MONOTONY MON_INCREASE /end AXIS_DESCR
/end CHARACTERISTIC
/begin CHARACTERISTIC T_FMEHAUPTASP24 "Filterzeit Start Hauptmotoreingriff" VALUE 0x26D714 kw_si16_S6_S3 508 UMR_MSEC__1_1_0_S6_S3 -254 254 /end CHARACTERISTIC
/begin CHARACTERISTIC K_FMEHAUPTASP24 "Filterkonstante (aehnl INPT) Start Hauptmotoreingriff" VALUE 0x26D716 kw_si16_S6_S3 65.535 UMR___1_1000_0_S6_S3 -32.768 32.767 /end CHARACTERISTIC
/begin CHARACTERISTIC KL_TSYNMTMEHAUPTESP35 "Zeit vor Erkennen synchron fuer Ende Haupt-ME" CURVE 0x228C1C kl_ui8_S6_S3 1280 UMR_MSEC__10_1_M128_S6_S3 -1280 0
 /begin AXIS_DESCR STD_AXIS zff_atsys._.iSignale._.obj.sig_m_t8 UMR_NM__8_1_M50_S6_S3 6 -400 1640 DEPOSIT ABSOLUTE MONOTONY MON_INCREASE /end AXIS_DESCR
/end CHARACTERISTIC
/begin CHARACTERISTIC KF_FTSYNNTMEHAUPTESP35 "Faktor auf Haupt-ME fuer Nach-ME" MAP 0x228C2C kf_si16_S6_S3 1 UMR___1_100_0_S6_S3 0 1
 /begin AXIS_DESCR STD_AXIS iSasZentr.iSchaltend.t_syn UMR_MSEC__10_1_0_S6_S3 6 -5000 5000 DEPOSIT ABSOLUTE MONOTONY MON_INCREASE /end AXIS_DESCR
 /begin AXIS_DESCR STD_AXIS zff_atsys._.iSignale._.obj.sig_n_t UMR_U_MIN_1_1_0_S6_S3 4 0 8160 DEPOSIT ABSOLUTE MONOTONY MON_INCREASE /end AXIS_DESCR
/end CHARACTERISTIC
/begin CHARACTERISTIC KL_TVDKIMEASP35 "Fahrpedalabhängige Verzögerungszeit Start Haupt ME" CURVE 0x228C78 kl_ui8_S6_S3 2000 UMR_MSEC__10_1_M128_S6_S3 -1000 1000
 /begin AXIS_DESCR STD_AXIS zff_atsys._.iSignale._.obj.sig_dki UMR_PROZENT__20_51_0_S6_S3 4 0 100 DEPOSIT ABSOLUTE MONOTONY MON_INCREASE /end AXIS_DESCR
/end CHARACTERISTIC
/begin CHARACTERISTIC KF_TVMEASP35 "Verzoegerungszeit fuer Beginn Haupt-ME" MAP 0x228C84 kf_si16_S6_S3 2000 UMR_MSEC__10_1_0_S6_S3 -1000 1000
 /begin AXIS_DESCR STD_AXIS zff_atsys._.iSignale._.obj.sig_n_t8 UMR_U_MIN_32_1_0_S6_S3 8 0 8160 DEPOSIT ABSOLUTE MONOTONY MON_INCREASE /end AXIS_DESCR
 /begin AXIS_DESCR STD_AXIS zff_atsys._.iSignale._.obj.sig_m_t8 UMR_NM__8_1_M50_S6_S3 4 -400 1640 DEPOSIT ABSOLUTE MONOTONY MON_INCREASE /end AXIS_DESCR
/end CHARACTERISTIC
/begin CHARACTERISTIC KL_TVCGMEASP35 "Temperaturabhängige Verzögerungszeit fuer Beginn Haupt-ME" CURVE 0x228CE4 kl_ui8_S6_S3 2000 UMR_MSEC__10_1_M128_S6_S3 -1000 1000
 /begin AXIS_DESCR STD_AXIS zff_atsys._.iSignale._.obj.sig_c_getr UMR_GRADC__1_1_M40_S6_S3 4 -40 150 DEPOSIT ABSOLUTE MONOTONY MON_INCREASE /end AXIS_DESCR
/end CHARACTERISTIC
/begin CHARACTERISTIC T_FMEHAUPTASP35 "Filterzeit Start Hauptmotoreingriff" VALUE 0x26D718 kw_si16_S6_S3 508 UMR_MSEC__1_1_0_S6_S3 -254 254 /end CHARACTERISTIC
/begin CHARACTERISTIC K_FMEHAUPTASP35 "Filterkonstante (aehnl INPT) Start Hauptmotoreingriff" VALUE 0x26D71A kw_si16_S6_S3 65.535 UMR___1_1000_0_S6_S3 -32.768 32.767 /end CHARACTERISTIC
/begin CHARACTERISTIC KL_TSYNMTMEHAUPTESP46 "Zeit vor Erkennen synchron fuer Ende Haupt-ME" CURVE 0x228CF0 kl_ui8_S6_S3 1280 UMR_MSEC__10_1_M128_S6_S3 -1280 0
 /begin AXIS_DESCR STD_AXIS zff_atsys._.iSignale._.obj.sig_m_t8 UMR_NM__8_1_M50_S6_S3 6 -400 1640 DEPOSIT ABSOLUTE MONOTONY MON_INCREASE /end AXIS_DESCR
/end CHARACTERISTIC
/begin CHARACTERISTIC KF_FTSYNNTMEHAUPTESP46 "Faktor auf Haupt-ME fuer Nach-ME" MAP 0x228D00 kf_si16_S6_S3 1 UMR___1_100_0_S6_S3 0 1
 /begin AXIS_DESCR STD_AXIS iSasZentr.iSchaltend.t_syn UMR_MSEC__10_1_0_S6_S3 6 -5000 5000 DEPOSIT ABSOLUTE MONOTONY MON_INCREASE /end AXIS_DESCR
 /begin AXIS_DESCR STD_AXIS zff_atsys._.iSignale._.obj.sig_n_t UMR_U_MIN_1_1_0_S6_S3 4 0 8160 DEPOSIT ABSOLUTE MONOTONY MON_INCREASE /end AXIS_DESCR
/end CHARACTERISTIC
/begin CHARACTERISTIC KL_TVDKIMEASP46 "Fahrpedalabhängige Verzögerungszeit Start Haupt ME" CURVE 0x228D4C kl_ui8_S6_S3 2000 UMR_MSEC__10_1_M128_S6_S3 -1000 1000
 /begin AXIS_DESCR STD_AXIS zff_atsys._.iSignale._.obj.sig_dki UMR_PROZENT__20_51_0_S6_S3 4 0 100 DEPOSIT ABSOLUTE MONOTONY MON_INCREASE /end AXIS_DESCR
/end CHARACTERISTIC
/begin CHARACTERISTIC KF_TVMEASP46 "Verzoegerungszeit fuer Beginn Haupt-ME" MAP 0x228D58 kf_si16_S6_S3 2000 UMR_MSEC__10_1_0_S6_S3 -1000 1000
 /begin AXIS_DESCR STD_AXIS zff_atsys._.iSignale._.obj.sig_n_t8 UMR_U_MIN_32_1_0_S6_S3 8 0 8160 DEPOSIT ABSOLUTE MONOTONY MON_INCREASE /end AXIS_DESCR
 /begin AXIS_DESCR STD_AXIS zff_atsys._.iSignale._.obj.sig_m_t8 UMR_NM__8_1_M50_S6_S3 4 -400 1640 DEPOSIT ABSOLUTE MONOTONY MON_INCREASE /end AXIS_DESCR
/end CHARACTERISTIC
/begin CHARACTERISTIC KL_TVCGMEASP46 "Temperaturabhängige Verzögerungszeit fuer Beginn Haupt-ME" CURVE 0x228DB8 kl_ui8_S6_S3 2000 UMR_MSEC__10_1_M128_S6_S3 -1000 1000
 /begin AXIS_DESCR STD_AXIS zff_atsys._.iSignale._.obj.sig_c_getr UMR_GRADC__1_1_M40_S6_S3 4 -40 150 DEPOSIT ABSOLUTE MONOTONY MON_INCREASE /end AXIS_DESCR
/end CHARACTERISTIC
/begin CHARACTERISTIC T_FMEHAUPTASP46 "Filterzeit Start Hauptmotoreingriff" VALUE 0x26D71C kw_si16_S6_S3 508 UMR_MSEC__1_1_0_S6_S3 -254 254 /end CHARACTERISTIC
/begin CHARACTERISTIC K_FMEHAUPTASP46 "Filterkonstante (aehnl INPT) Start Hauptmotoreingriff" VALUE 0x26D71E kw_si16_S6_S3 65.535 UMR___1_1000_0_S6_S3 -32.768 32.767 /end CHARACTERISTIC
/begin CHARACTERISTIC KL_TSYNMTMEHAUPTESP57 "Zeit vor Erkennen synchron fuer Ende Haupt-ME" CURVE 0x228DC4 kl_ui8_S6_S3 1280 UMR_MSEC__10_1_M128_S6_S3 -1280 0
 /begin AXIS_DESCR STD_AXIS zff_atsys._.iSignale._.obj.sig_m_t8 UMR_NM__8_1_M50_S6_S3 6 -400 1640 DEPOSIT ABSOLUTE MONOTONY MON_INCREASE /end AXIS_DESCR
/end CHARACTERISTIC
/begin CHARACTERISTIC KF_FTSYNNTMEHAUPTESP57 "Faktor auf Haupt-ME fuer Nach-ME" MAP 0x228DD4 kf_si16_S6_S3 1 UMR___1_100_0_S6_S3 0 1
 /begin AXIS_DESCR STD_AXIS iSasZentr.iSchaltend.t_syn UMR_MSEC__10_1_0_S6_S3 6 -5000 5000 DEPOSIT ABSOLUTE MONOTONY MON_INCREASE /end AXIS_DESCR
 /begin AXIS_DESCR STD_AXIS zff_atsys._.iSignale._.obj.sig_n_t UMR_U_MIN_1_1_0_S6_S3 4 0 8160 DEPOSIT ABSOLUTE MONOTONY MON_INCREASE /end AXIS_DESCR
/end CHARACTERISTIC
/begin CHARACTERISTIC KL_TVDKIMEASP57 "Fahrpedalabhängige Verzögerungszeit Start Haupt ME" CURVE 0x228E20 kl_ui8_S6_S3 2000 UMR_MSEC__10_1_M128_S6_S3 -1000 1000
 /begin AXIS_DESCR STD_AXIS zff_atsys._.iSignale._.obj.sig_dki UMR_PROZENT__20_51_0_S6_S3 4 0 100 DEPOSIT ABSOLUTE MONOTONY MON_INCREASE /end AXIS_DESCR
/end CHARACTERISTIC
/begin CHARACTERISTIC KF_TVMEASP57 "Verzoegerungszeit fuer Beginn Haupt-ME" MAP 0x228E2C kf_si16_S6_S3 2000 UMR_MSEC__10_1_0_S6_S3 -1000 1000
 /begin AXIS_DESCR STD_AXIS zff_atsys._.iSignale._.obj.sig_n_t8 UMR_U_MIN_32_1_0_S6_S3 8 0 8160 DEPOSIT ABSOLUTE MONOTONY MON_INCREASE /end AXIS_DESCR
 /begin AXIS_DESCR STD_AXIS zff_atsys._.iSignale._.obj.sig_m_t8 UMR_NM__8_1_M50_S6_S3 4 -400 1640 DEPOSIT ABSOLUTE MONOTONY MON_INCREASE /end AXIS_DESCR
/end CHARACTERISTIC
/begin CHARACTERISTIC KL_TVCGMEASP57 "Temperaturabhängige Verzögerungszeit fuer Beginn Haupt-ME" CURVE 0x228E8C kl_ui8_S6_S3 2000 UMR_MSEC__10_1_M128_S6_S3 -1000 1000
 /begin AXIS_DESCR STD_AXIS zff_atsys._.iSignale._.obj.sig_c_getr UMR_GRADC__1_1_M40_S6_S3 4 -40 150 DEPOSIT ABSOLUTE MONOTONY MON_INCREASE /end AXIS_DESCR
/end CHARACTERISTIC
/begin CHARACTERISTIC T_FMEHAUPTASP57 "Filterzeit Start Hauptmotoreingriff" VALUE 0x26D720 kw_si16_S6_S3 508 UMR_MSEC__1_1_0_S6_S3 -254 254 /end CHARACTERISTIC
/begin CHARACTERISTIC K_FMEHAUPTASP57 "Filterkonstante (aehnl INPT) Start Hauptmotoreingriff" VALUE 0x26D722 kw_si16_S6_S3 65.535 UMR___1_1000_0_S6_S3 -32.768 32.767 /end CHARACTERISTIC
/begin CHARACTERISTIC KL_TSYNMTMEHAUPTESP68 "Zeit vor Erkennen synchron fuer Ende Haupt-ME" CURVE 0x228E98 kl_ui8_S6_S3 1280 UMR_MSEC__10_1_M128_S6_S3 -1280 0
 /begin AXIS_DESCR STD_AXIS zff_atsys._.iSignale._.obj.sig_m_t8 UMR_NM__8_1_M50_S6_S3 6 -400 1640 DEPOSIT ABSOLUTE MONOTONY MON_INCREASE /end AXIS_DESCR
/end CHARACTERISTIC
/begin CHARACTERISTIC KF_FTSYNNTMEHAUPTESP68 "Faktor auf Haupt-ME fuer Nach-ME" MAP 0x228EA8 kf_si16_S6_S3 1 UMR___1_100_0_S6_S3 0 1
 /begin AXIS_DESCR STD_AXIS iSasZentr.iSchaltend.t_syn UMR_MSEC__10_1_0_S6_S3 6 -5000 5000 DEPOSIT ABSOLUTE MONOTONY MON_INCREASE /end AXIS_DESCR
 /begin AXIS_DESCR STD_AXIS zff_atsys._.iSignale._.obj.sig_n_t UMR_U_MIN_1_1_0_S6_S3 4 0 8160 DEPOSIT ABSOLUTE MONOTONY MON_INCREASE /end AXIS_DESCR
/end CHARACTERISTIC
/begin CHARACTERISTIC KL_TVDKIMEASP68 "Fahrpedalabhängige Verzögerungszeit Start Haupt ME" CURVE 0x228EF4 kl_ui8_S6_S3 2000 UMR_MSEC__10_1_M128_S6_S3 -1000 1000
 /begin AXIS_DESCR STD_AXIS zff_atsys._.iSignale._.obj.sig_dki UMR_PROZENT__20_51_0_S6_S3 4 0 100 DEPOSIT ABSOLUTE MONOTONY MON_INCREASE /end AXIS_DESCR
/end CHARACTERISTIC
/begin CHARACTERISTIC KF_TVMEASP68 "Verzoegerungszeit fuer Beginn Haupt-ME" MAP 0x228F00 kf_si16_S6_S3 2000 UMR_MSEC__10_1_0_S6_S3 -1000 1000
 /begin AXIS_DESCR STD_AXIS zff_atsys._.iSignale._.obj.sig_n_t8 UMR_U_MIN_32_1_0_S6_S3 8 0 8160 DEPOSIT ABSOLUTE MONOTONY MON_INCREASE /end AXIS_DESCR
 /begin AXIS_DESCR STD_AXIS zff_atsys._.iSignale._.obj.sig_m_t8 UMR_NM__8_1_M50_S6_S3 4 -400 1640 DEPOSIT ABSOLUTE MONOTONY MON_INCREASE /end AXIS_DESCR
/end CHARACTERISTIC
/begin CHARACTERISTIC KL_TVCGMEASP68 "Temperaturabhängige Verzögerungszeit fuer Beginn Haupt-ME" CURVE 0x228F60 kl_ui8_S6_S3 2000 UMR_MSEC__10_1_M128_S6_S3 -1000 1000
 /begin AXIS_DESCR STD_AXIS zff_atsys._.iSignale._.obj.sig_c_getr UMR_GRADC__1_1_M40_S6_S3 4 -40 150 DEPOSIT ABSOLUTE MONOTONY MON_INCREASE /end AXIS_DESCR
/end CHARACTERISTIC
/begin CHARACTERISTIC T_FMEHAUPTASP68 "Filterzeit Start Hauptmotoreingriff" VALUE 0x26D724 kw_si16_S6_S3 508 UMR_MSEC__1_1_0_S6_S3 -254 254 /end CHARACTERISTIC
/begin CHARACTERISTIC K_FMEHAUPTASP68 "Filterkonstante (aehnl INPT) Start Hauptmotoreingriff" VALUE 0x26D726 kw_si16_S6_S3 65.535 UMR___1_1000_0_S6_S3 -32.768 32.767 /end CHARACTERISTIC
/begin CHARACTERISTIC KL_TSYNMTMEHAUPTESPORT12 "Zeit vor Erkennen synchron fuer Ende Haupt-ME" CURVE 0x228F6C kl_ui8_S6_S3 1280 UMR_MSEC__10_1_M128_S6_S3 -1280 0
 /begin AXIS_DESCR STD_AXIS zff_atsys._.iSignale._.obj.sig_m_t8 UMR_NM__8_1_M50_S6_S3 6 -400 1640 DEPOSIT ABSOLUTE MONOTONY MON_INCREASE /end AXIS_DESCR
/end CHARACTERISTIC
/begin CHARACTERISTIC KF_FTSYNNTMEHAUPTESPORT12 "Faktor auf Haupt-ME fuer Nach-ME" MAP 0x228F7C kf_si16_S6_S3 1 UMR___1_100_0_S6_S3 0 1
 /begin AXIS_DESCR STD_AXIS iSasZentr.iSchaltend.t_syn UMR_MSEC__10_1_0_S6_S3 6 -5000 5000 DEPOSIT ABSOLUTE MONOTONY MON_INCREASE /end AXIS_DESCR
 /begin AXIS_DESCR STD_AXIS zff_atsys._.iSignale._.obj.sig_n_t UMR_U_MIN_1_1_0_S6_S3 4 0 8160 DEPOSIT ABSOLUTE MONOTONY MON_INCREASE /end AXIS_DESCR
/end CHARACTERISTIC
/begin CHARACTERISTIC KL_TVDKIMEASPORT12 "Fahrpedalabhängige Verzögerungszeit Start Haupt ME" CURVE 0x228FC8 kl_ui8_S6_S3 2000 UMR_MSEC__10_1_M128_S6_S3 -1000 1000
 /begin AXIS_DESCR STD_AXIS zff_atsys._.iSignale._.obj.sig_dki UMR_PROZENT__20_51_0_S6_S3 4 0 100 DEPOSIT ABSOLUTE MONOTONY MON_INCREASE /end AXIS_DESCR
/end CHARACTERISTIC
/begin CHARACTERISTIC KF_TVMEASPORT12 "Verzoegerungszeit fuer Beginn Haupt-ME" MAP 0x228FD4 kf_si16_S6_S3 2000 UMR_MSEC__10_1_0_S6_S3 -1000 1000
 /begin AXIS_DESCR STD_AXIS zff_atsys._.iSignale._.obj.sig_n_t8 UMR_U_MIN_32_1_0_S6_S3 8 0 8160 DEPOSIT ABSOLUTE MONOTONY MON_INCREASE /end AXIS_DESCR
 /begin AXIS_DESCR STD_AXIS zff_atsys._.iSignale._.obj.sig_m_t8 UMR_NM__8_1_M50_S6_S3 4 -400 1640 DEPOSIT ABSOLUTE MONOTONY MON_INCREASE /end AXIS_DESCR
/end CHARACTERISTIC
/begin CHARACTERISTIC KL_TVCGMEASPORT12 "Temperaturabhängige Verzögerungszeit fuer Beginn Haupt-ME" CURVE 0x229034 kl_ui8_S6_S3 2000 UMR_MSEC__10_1_M128_S6_S3 -1000 1000
 /begin AXIS_DESCR STD_AXIS zff_atsys._.iSignale._.obj.sig_c_getr UMR_GRADC__1_1_M40_S6_S3 4 -40 150 DEPOSIT ABSOLUTE MONOTONY MON_INCREASE /end AXIS_DESCR
/end CHARACTERISTIC
/begin CHARACTERISTIC T_FMEHAUPTASPORT12 "Filterzeit Start Hauptmotoreingriff" VALUE 0x26D728 kw_si16_S6_S3 508 UMR_MSEC__1_1_0_S6_S3 -254 254 /end CHARACTERISTIC
/begin CHARACTERISTIC K_FMEHAUPTASPORT12 "Filterkonstante (aehnl INPT) Start Hauptmotoreingriff" VALUE 0x26D72A kw_si16_S6_S3 65.535 UMR___1_1000_0_S6_S3 -32.768 32.767 /end CHARACTERISTIC
/begin CHARACTERISTIC KL_TSYNMTMEHAUPTESPORT23 "Zeit vor Erkennen synchron fuer Ende Haupt-ME" CURVE 0x229040 kl_ui8_S6_S3 1280 UMR_MSEC__10_1_M128_S6_S3 -1280 0
 /begin AXIS_DESCR STD_AXIS zff_atsys._.iSignale._.obj.sig_m_t8 UMR_NM__8_1_M50_S6_S3 6 -400 1640 DEPOSIT ABSOLUTE MONOTONY MON_INCREASE /end AXIS_DESCR
/end CHARACTERISTIC
/begin CHARACTERISTIC KF_FTSYNNTMEHAUPTESPORT23 "Faktor auf Haupt-ME fuer Nach-ME" MAP 0x229050 kf_si16_S6_S3 1 UMR___1_100_0_S6_S3 0 1
 /begin AXIS_DESCR STD_AXIS iSasZentr.iSchaltend.t_syn UMR_MSEC__10_1_0_S6_S3 6 -5000 5000 DEPOSIT ABSOLUTE MONOTONY MON_INCREASE /end AXIS_DESCR
 /begin AXIS_DESCR STD_AXIS zff_atsys._.iSignale._.obj.sig_n_t UMR_U_MIN_1_1_0_S6_S3 4 0 8160 DEPOSIT ABSOLUTE MONOTONY MON_INCREASE /end AXIS_DESCR
/end CHARACTERISTIC
/begin CHARACTERISTIC KL_TVDKIMEASPORT23 "Fahrpedalabhängige Verzögerungszeit Start Haupt ME" CURVE 0x22909C kl_ui8_S6_S3 2000 UMR_MSEC__10_1_M128_S6_S3 -1000 1000
 /begin AXIS_DESCR STD_AXIS zff_atsys._.iSignale._.obj.sig_dki UMR_PROZENT__20_51_0_S6_S3 4 0 100 DEPOSIT ABSOLUTE MONOTONY MON_INCREASE /end AXIS_DESCR
/end CHARACTERISTIC
/begin CHARACTERISTIC KF_TVMEASPORT23 "Verzoegerungszeit fuer Beginn Haupt-ME" MAP 0x2290A8 kf_si16_S6_S3 2000 UMR_MSEC__10_1_0_S6_S3 -1000 1000
 /begin AXIS_DESCR STD_AXIS zff_atsys._.iSignale._.obj.sig_n_t8 UMR_U_MIN_32_1_0_S6_S3 8 0 8160 DEPOSIT ABSOLUTE MONOTONY MON_INCREASE /end AXIS_DESCR
 /begin AXIS_DESCR STD_AXIS zff_atsys._.iSignale._.obj.sig_m_t8 UMR_NM__8_1_M50_S6_S3 4 -400 1640 DEPOSIT ABSOLUTE MONOTONY MON_INCREASE /end AXIS_DESCR
/end CHARACTERISTIC
/begin CHARACTERISTIC KL_TVCGMEASPORT23 "Temperaturabhängige Verzögerungszeit fuer Beginn Haupt-ME" CURVE 0x229108 kl_ui8_S6_S3 2000 UMR_MSEC__10_1_M128_S6_S3 -1000 1000
 /begin AXIS_DESCR STD_AXIS zff_atsys._.iSignale._.obj.sig_c_getr UMR_GRADC__1_1_M40_S6_S3 4 -40 150 DEPOSIT ABSOLUTE MONOTONY MON_INCREASE /end AXIS_DESCR
/end CHARACTERISTIC
/begin CHARACTERISTIC T_FMEHAUPTASPORT23 "Filterzeit Start Hauptmotoreingriff" VALUE 0x26D72C kw_si16_S6_S3 508 UMR_MSEC__1_1_0_S6_S3 -254 254 /end CHARACTERISTIC
/begin CHARACTERISTIC K_FMEHAUPTASPORT23 "Filterkonstante (aehnl INPT) Start Hauptmotoreingriff" VALUE 0x26D72E kw_si16_S6_S3 65.535 UMR___1_1000_0_S6_S3 -32.768 32.767 /end CHARACTERISTIC
/begin CHARACTERISTIC KL_TSYNMTMEHAUPTESPORT34 "Zeit vor Erkennen synchron fuer Ende Haupt-ME" CURVE 0x229114 kl_ui8_S6_S3 1280 UMR_MSEC__10_1_M128_S6_S3 -1280 0
 /begin AXIS_DESCR STD_AXIS zff_atsys._.iSignale._.obj.sig_m_t8 UMR_NM__8_1_M50_S6_S3 6 -400 1640 DEPOSIT ABSOLUTE MONOTONY MON_INCREASE /end AXIS_DESCR
/end CHARACTERISTIC
/begin CHARACTERISTIC KF_FTSYNNTMEHAUPTESPORT34 "Faktor auf Haupt-ME fuer Nach-ME" MAP 0x229124 kf_si16_S6_S3 1 UMR___1_100_0_S6_S3 0 1
 /begin AXIS_DESCR STD_AXIS iSasZentr.iSchaltend.t_syn UMR_MSEC__10_1_0_S6_S3 6 -5000 5000 DEPOSIT ABSOLUTE MONOTONY MON_INCREASE /end AXIS_DESCR
 /begin AXIS_DESCR STD_AXIS zff_atsys._.iSignale._.obj.sig_n_t UMR_U_MIN_1_1_0_S6_S3 4 0 8160 DEPOSIT ABSOLUTE MONOTONY MON_INCREASE /end AXIS_DESCR
/end CHARACTERISTIC
/begin CHARACTERISTIC KL_TVDKIMEASPORT34 "Fahrpedalabhängige Verzögerungszeit Start Haupt ME" CURVE 0x229170 kl_ui8_S6_S3 2000 UMR_MSEC__10_1_M128_S6_S3 -1000 1000
 /begin AXIS_DESCR STD_AXIS zff_atsys._.iSignale._.obj.sig_dki UMR_PROZENT__20_51_0_S6_S3 4 0 100 DEPOSIT ABSOLUTE MONOTONY MON_INCREASE /end AXIS_DESCR
/end CHARACTERISTIC
/begin CHARACTERISTIC KF_TVMEASPORT34 "Verzoegerungszeit fuer Beginn Haupt-ME" MAP 0x22917C kf_si16_S6_S3 2000 UMR_MSEC__10_1_0_S6_S3 -1000 1000
 /begin AXIS_DESCR STD_AXIS zff_atsys._.iSignale._.obj.sig_n_t8 UMR_U_MIN_32_1_0_S6_S3 8 0 8160 DEPOSIT ABSOLUTE MONOTONY MON_INCREASE /end AXIS_DESCR
 /begin AXIS_DESCR STD_AXIS zff_atsys._.iSignale._.obj.sig_m_t8 UMR_NM__8_1_M50_S6_S3 4 -400 1640 DEPOSIT ABSOLUTE MONOTONY MON_INCREASE /end AXIS_DESCR
/end CHARACTERISTIC
/begin CHARACTERISTIC KL_TVCGMEASPORT34 "Temperaturabhängige Verzögerungszeit fuer Beginn Haupt-ME" CURVE 0x2291DC kl_ui8_S6_S3 2000 UMR_MSEC__10_1_M128_S6_S3 -1000 1000
 /begin AXIS_DESCR STD_AXIS zff_atsys._.iSignale._.obj.sig_c_getr UMR_GRADC__1_1_M40_S6_S3 4 -40 150 DEPOSIT ABSOLUTE MONOTONY MON_INCREASE /end AXIS_DESCR
/end CHARACTERISTIC
/begin CHARACTERISTIC T_FMEHAUPTASPORT34 "Filterzeit Start Hauptmotoreingriff" VALUE 0x26D730 kw_si16_S6_S3 508 UMR_MSEC__1_1_0_S6_S3 -254 254 /end CHARACTERISTIC
/begin CHARACTERISTIC K_FMEHAUPTASPORT34 "Filterkonstante (aehnl INPT) Start Hauptmotoreingriff" VALUE 0x26D732 kw_si16_S6_S3 65.535 UMR___1_1000_0_S6_S3 -32.768 32.767 /end CHARACTERISTIC
/begin CHARACTERISTIC KL_TSYNMTMEHAUPTESPORT45 "Zeit vor Erkennen synchron fuer Ende Haupt-ME" CURVE 0x2291E8 kl_ui8_S6_S3 1280 UMR_MSEC__10_1_M128_S6_S3 -1280 0
 /begin AXIS_DESCR STD_AXIS zff_atsys._.iSignale._.obj.sig_m_t8 UMR_NM__8_1_M50_S6_S3 6 -400 1640 DEPOSIT ABSOLUTE MONOTONY MON_INCREASE /end AXIS_DESCR
/end CHARACTERISTIC
/begin CHARACTERISTIC KF_FTSYNNTMEHAUPTESPORT45 "Faktor auf Haupt-ME fuer Nach-ME" MAP 0x2291F8 kf_si16_S6_S3 1 UMR___1_100_0_S6_S3 0 1
 /begin AXIS_DESCR STD_AXIS iSasZentr.iSchaltend.t_syn UMR_MSEC__10_1_0_S6_S3 6 -5000 5000 DEPOSIT ABSOLUTE MONOTONY MON_INCREASE /end AXIS_DESCR
 /begin AXIS_DESCR STD_AXIS zff_atsys._.iSignale._.obj.sig_n_t UMR_U_MIN_1_1_0_S6_S3 4 0 8160 DEPOSIT ABSOLUTE MONOTONY MON_INCREASE /end AXIS_DESCR
/end CHARACTERISTIC
/begin CHARACTERISTIC KL_TVDKIMEASPORT45 "Fahrpedalabhängige Verzögerungszeit Start Haupt ME" CURVE 0x229244 kl_ui8_S6_S3 2000 UMR_MSEC__10_1_M128_S6_S3 -1000 1000
 /begin AXIS_DESCR STD_AXIS zff_atsys._.iSignale._.obj.sig_dki UMR_PROZENT__20_51_0_S6_S3 4 0 100 DEPOSIT ABSOLUTE MONOTONY MON_INCREASE /end AXIS_DESCR
/end CHARACTERISTIC
/begin CHARACTERISTIC KF_TVMEASPORT45 "Verzoegerungszeit fuer Beginn Haupt-ME" MAP 0x229250 kf_si16_S6_S3 2000 UMR_MSEC__10_1_0_S6_S3 -1000 1000
 /begin AXIS_DESCR STD_AXIS zff_atsys._.iSignale._.obj.sig_n_t8 UMR_U_MIN_32_1_0_S6_S3 8 0 8160 DEPOSIT ABSOLUTE MONOTONY MON_INCREASE /end AXIS_DESCR
 /begin AXIS_DESCR STD_AXIS zff_atsys._.iSignale._.obj.sig_m_t8 UMR_NM__8_1_M50_S6_S3 4 -400 1640 DEPOSIT ABSOLUTE MONOTONY MON_INCREASE /end AXIS_DESCR
/end CHARACTERISTIC
/begin CHARACTERISTIC KL_TVCGMEASPORT45 "Temperaturabhängige Verzögerungszeit fuer Beginn Haupt-ME" CURVE 0x2292B0 kl_ui8_S6_S3 2000 UMR_MSEC__10_1_M128_S6_S3 -1000 1000
 /begin AXIS_DESCR STD_AXIS zff_atsys._.iSignale._.obj.sig_c_getr UMR_GRADC__1_1_M40_S6_S3 4 -40 150 DEPOSIT ABSOLUTE MONOTONY MON_INCREASE /end AXIS_DESCR
/end CHARACTERISTIC
/begin CHARACTERISTIC T_FMEHAUPTASPORT45 "Filterzeit Start Hauptmotoreingriff" VALUE 0x26D734 kw_si16_S6_S3 508 UMR_MSEC__1_1_0_S6_S3 -254 254 /end CHARACTERISTIC
/begin CHARACTERISTIC K_FMEHAUPTASPORT45 "Filterkonstante (aehnl INPT) Start Hauptmotoreingriff" VALUE 0x26D736 kw_si16_S6_S3 65.535 UMR___1_1000_0_S6_S3 -32.768 32.767 /end CHARACTERISTIC
/begin CHARACTERISTIC KL_TSYNMTMEHAUPTESPORT56 "Zeit vor Erkennen synchron fuer Ende Haupt-ME" CURVE 0x2292BC kl_ui8_S6_S3 1280 UMR_MSEC__10_1_M128_S6_S3 -1280 0
 /begin AXIS_DESCR STD_AXIS zff_atsys._.iSignale._.obj.sig_m_t8 UMR_NM__8_1_M50_S6_S3 6 -400 1640 DEPOSIT ABSOLUTE MONOTONY MON_INCREASE /end AXIS_DESCR
/end CHARACTERISTIC
/begin CHARACTERISTIC KF_FTSYNNTMEHAUPTESPORT56 "Faktor auf Haupt-ME fuer Nach-ME" MAP 0x2292CC kf_si16_S6_S3 1 UMR___1_100_0_S6_S3 0 1
 /begin AXIS_DESCR STD_AXIS iSasZentr.iSchaltend.t_syn UMR_MSEC__10_1_0_S6_S3 6 -5000 5000 DEPOSIT ABSOLUTE MONOTONY MON_INCREASE /end AXIS_DESCR
 /begin AXIS_DESCR STD_AXIS zff_atsys._.iSignale._.obj.sig_n_t UMR_U_MIN_1_1_0_S6_S3 4 0 8160 DEPOSIT ABSOLUTE MONOTONY MON_INCREASE /end AXIS_DESCR
/end CHARACTERISTIC
/begin CHARACTERISTIC KL_TVDKIMEASPORT56 "Fahrpedalabhängige Verzögerungszeit Start Haupt ME" CURVE 0x229318 kl_ui8_S6_S3 2000 UMR_MSEC__10_1_M128_S6_S3 -1000 1000
 /begin AXIS_DESCR STD_AXIS zff_atsys._.iSignale._.obj.sig_dki UMR_PROZENT__20_51_0_S6_S3 4 0 100 DEPOSIT ABSOLUTE MONOTONY MON_INCREASE /end AXIS_DESCR
/end CHARACTERISTIC
/begin CHARACTERISTIC KF_TVMEASPORT56 "Verzoegerungszeit fuer Beginn Haupt-ME" MAP 0x229324 kf_si16_S6_S3 2000 UMR_MSEC__10_1_0_S6_S3 -1000 1000
 /begin AXIS_DESCR STD_AXIS zff_atsys._.iSignale._.obj.sig_n_t8 UMR_U_MIN_32_1_0_S6_S3 8 0 8160 DEPOSIT ABSOLUTE MONOTONY MON_INCREASE /end AXIS_DESCR
 /begin AXIS_DESCR STD_AXIS zff_atsys._.iSignale._.obj.sig_m_t8 UMR_NM__8_1_M50_S6_S3 4 -400 1640 DEPOSIT ABSOLUTE MONOTONY MON_INCREASE /end AXIS_DESCR
/end CHARACTERISTIC
/begin CHARACTERISTIC KL_TVCGMEASPORT56 "Temperaturabhängige Verzögerungszeit fuer Beginn Haupt-ME" CURVE 0x229384 kl_ui8_S6_S3 2000 UMR_MSEC__10_1_M128_S6_S3 -1000 1000
 /begin AXIS_DESCR STD_AXIS zff_atsys._.iSignale._.obj.sig_c_getr UMR_GRADC__1_1_M40_S6_S3 4 -40 150 DEPOSIT ABSOLUTE MONOTONY MON_INCREASE /end AXIS_DESCR
/end CHARACTERISTIC
/begin CHARACTERISTIC T_FMEHAUPTASPORT56 "Filterzeit Start Hauptmotoreingriff" VALUE 0x26D738 kw_si16_S6_S3 508 UMR_MSEC__1_1_0_S6_S3 -254 254 /end CHARACTERISTIC
/begin CHARACTERISTIC K_FMEHAUPTASPORT56 "Filterkonstante (aehnl INPT) Start Hauptmotoreingriff" VALUE 0x26D73A kw_si16_S6_S3 65.535 UMR___1_1000_0_S6_S3 -32.768 32.767 /end CHARACTERISTIC
/begin CHARACTERISTIC KL_TSYNMTMEHAUPTESPORT67 "Zeit vor Erkennen synchron fuer Ende Haupt-ME" CURVE 0x229390 kl_ui8_S6_S3 1280 UMR_MSEC__10_1_M128_S6_S3 -1280 0
 /begin AXIS_DESCR STD_AXIS zff_atsys._.iSignale._.obj.sig_m_t8 UMR_NM__8_1_M50_S6_S3 6 -400 1640 DEPOSIT ABSOLUTE MONOTONY MON_INCREASE /end AXIS_DESCR
/end CHARACTERISTIC
/begin CHARACTERISTIC KF_FTSYNNTMEHAUPTESPORT67 "Faktor auf Haupt-ME fuer Nach-ME" MAP 0x2293A0 kf_si16_S6_S3 1 UMR___1_100_0_S6_S3 0 1
 /begin AXIS_DESCR STD_AXIS iSasZentr.iSchaltend.t_syn UMR_MSEC__10_1_0_S6_S3 6 -5000 5000 DEPOSIT ABSOLUTE MONOTONY MON_INCREASE /end AXIS_DESCR
 /begin AXIS_DESCR STD_AXIS zff_atsys._.iSignale._.obj.sig_n_t UMR_U_MIN_1_1_0_S6_S3 4 0 8160 DEPOSIT ABSOLUTE MONOTONY MON_INCREASE /end AXIS_DESCR
/end CHARACTERISTIC
/begin CHARACTERISTIC KL_TVDKIMEASPORT67 "Fahrpedalabhängige Verzögerungszeit Start Haupt ME" CURVE 0x2293EC kl_ui8_S6_S3 2000 UMR_MSEC__10_1_M128_S6_S3 -1000 1000
 /begin AXIS_DESCR STD_AXIS zff_atsys._.iSignale._.obj.sig_dki UMR_PROZENT__20_51_0_S6_S3 4 0 100 DEPOSIT ABSOLUTE MONOTONY MON_INCREASE /end AXIS_DESCR
/end CHARACTERISTIC
/begin CHARACTERISTIC KF_TVMEASPORT67 "Verzoegerungszeit fuer Beginn Haupt-ME" MAP 0x2293F8 kf_si16_S6_S3 2000 UMR_MSEC__10_1_0_S6_S3 -1000 1000
 /begin AXIS_DESCR STD_AXIS zff_atsys._.iSignale._.obj.sig_n_t8 UMR_U_MIN_32_1_0_S6_S3 8 0 8160 DEPOSIT ABSOLUTE MONOTONY MON_INCREASE /end AXIS_DESCR
 /begin AXIS_DESCR STD_AXIS zff_atsys._.iSignale._.obj.sig_m_t8 UMR_NM__8_1_M50_S6_S3 4 -400 1640 DEPOSIT ABSOLUTE MONOTONY MON_INCREASE /end AXIS_DESCR
/end CHARACTERISTIC
/begin CHARACTERISTIC KL_TVCGMEASPORT67 "Temperaturabhängige Verzögerungszeit fuer Beginn Haupt-ME" CURVE 0x229458 kl_ui8_S6_S3 2000 UMR_MSEC__10_1_M128_S6_S3 -1000 1000
 /begin AXIS_DESCR STD_AXIS zff_atsys._.iSignale._.obj.sig_c_getr UMR_GRADC__1_1_M40_S6_S3 4 -40 150 DEPOSIT ABSOLUTE MONOTONY MON_INCREASE /end AXIS_DESCR
/end CHARACTERISTIC
/begin CHARACTERISTIC T_FMEHAUPTASPORT67 "Filterzeit Start Hauptmotoreingriff" VALUE 0x26D73C kw_si16_S6_S3 508 UMR_MSEC__1_1_0_S6_S3 -254 254 /end CHARACTERISTIC
/begin CHARACTERISTIC K_FMEHAUPTASPORT67 "Filterkonstante (aehnl INPT) Start Hauptmotoreingriff" VALUE 0x26D73E kw_si16_S6_S3 65.535 UMR___1_1000_0_S6_S3 -32.768 32.767 /end CHARACTERISTIC
/begin CHARACTERISTIC KL_TSYNMTMEHAUPTESPORT78 "Zeit vor Erkennen synchron fuer Ende Haupt-ME" CURVE 0x229464 kl_ui8_S6_S3 1280 UMR_MSEC__10_1_M128_S6_S3 -1280 0
 /begin AXIS_DESCR STD_AXIS zff_atsys._.iSignale._.obj.sig_m_t8 UMR_NM__8_1_M50_S6_S3 6 -400 1640 DEPOSIT ABSOLUTE MONOTONY MON_INCREASE /end AXIS_DESCR
/end CHARACTERISTIC
/begin CHARACTERISTIC KF_FTSYNNTMEHAUPTESPORT78 "Faktor auf Haupt-ME fuer Nach-ME" MAP 0x229474 kf_si16_S6_S3 1 UMR___1_100_0_S6_S3 0 1
 /begin AXIS_DESCR STD_AXIS iSasZentr.iSchaltend.t_syn UMR_MSEC__10_1_0_S6_S3 6 -5000 5000 DEPOSIT ABSOLUTE MONOTONY MON_INCREASE /end AXIS_DESCR
 /begin AXIS_DESCR STD_AXIS zff_atsys._.iSignale._.obj.sig_n_t UMR_U_MIN_1_1_0_S6_S3 4 0 8160 DEPOSIT ABSOLUTE MONOTONY MON_INCREASE /end AXIS_DESCR
/end CHARACTERISTIC
/begin CHARACTERISTIC KL_TVDKIMEASPORT78 "Fahrpedalabhängige Verzögerungszeit Start Haupt ME" CURVE 0x2294C0 kl_ui8_S6_S3 2000 UMR_MSEC__10_1_M128_S6_S3 -1000 1000
 /begin AXIS_DESCR STD_AXIS zff_atsys._.iSignale._.obj.sig_dki UMR_PROZENT__20_51_0_S6_S3 4 0 100 DEPOSIT ABSOLUTE MONOTONY MON_INCREASE /end AXIS_DESCR
/end CHARACTERISTIC
/begin CHARACTERISTIC KF_TVMEASPORT78 "Verzoegerungszeit fuer Beginn Haupt-ME" MAP 0x2294CC kf_si16_S6_S3 2000 UMR_MSEC__10_1_0_S6_S3 -1000 1000
 /begin AXIS_DESCR STD_AXIS zff_atsys._.iSignale._.obj.sig_n_t8 UMR_U_MIN_32_1_0_S6_S3 8 0 8160 DEPOSIT ABSOLUTE MONOTONY MON_INCREASE /end AXIS_DESCR
 /begin AXIS_DESCR STD_AXIS zff_atsys._.iSignale._.obj.sig_m_t8 UMR_NM__8_1_M50_S6_S3 4 -400 1640 DEPOSIT ABSOLUTE MONOTONY MON_INCREASE /end AXIS_DESCR
/end CHARACTERISTIC
/begin CHARACTERISTIC KL_TVCGMEASPORT78 "Temperaturabhängige Verzögerungszeit fuer Beginn Haupt-ME" CURVE 0x22952C kl_ui8_S6_S3 2000 UMR_MSEC__10_1_M128_S6_S3 -1000 1000
 /begin AXIS_DESCR STD_AXIS zff_atsys._.iSignale._.obj.sig_c_getr UMR_GRADC__1_1_M40_S6_S3 4 -40 150 DEPOSIT ABSOLUTE MONOTONY MON_INCREASE /end AXIS_DESCR
/end CHARACTERISTIC
/begin CHARACTERISTIC T_FMEHAUPTASPORT78 "Filterzeit Start Hauptmotoreingriff" VALUE 0x26D740 kw_si16_S6_S3 508 UMR_MSEC__1_1_0_S6_S3 -254 254 /end CHARACTERISTIC
/begin CHARACTERISTIC K_FMEHAUPTASPORT78 "Filterkonstante (aehnl INPT) Start Hauptmotoreingriff" VALUE 0x26D742 kw_si16_S6_S3 65.535 UMR___1_1000_0_S6_S3 -32.768 32.767 /end CHARACTERISTIC
/begin CHARACTERISTIC KL_TSYNMTMEHAUPTESPORT13 "Zeit vor Erkennen synchron fuer Ende Haupt-ME" CURVE 0x229538 kl_ui8_S6_S3 1280 UMR_MSEC__10_1_M128_S6_S3 -1280 0
 /begin AXIS_DESCR STD_AXIS zff_atsys._.iSignale._.obj.sig_m_t8 UMR_NM__8_1_M50_S6_S3 6 -400 1640 DEPOSIT ABSOLUTE MONOTONY MON_INCREASE /end AXIS_DESCR
/end CHARACTERISTIC
/begin CHARACTERISTIC KF_FTSYNNTMEHAUPTESPORT13 "Faktor auf Haupt-ME fuer Nach-ME" MAP 0x229548 kf_si16_S6_S3 1 UMR___1_100_0_S6_S3 0 1
 /begin AXIS_DESCR STD_AXIS iSasZentr.iSchaltend.t_syn UMR_MSEC__10_1_0_S6_S3 6 -5000 5000 DEPOSIT ABSOLUTE MONOTONY MON_INCREASE /end AXIS_DESCR
 /begin AXIS_DESCR STD_AXIS zff_atsys._.iSignale._.obj.sig_n_t UMR_U_MIN_1_1_0_S6_S3 4 0 8160 DEPOSIT ABSOLUTE MONOTONY MON_INCREASE /end AXIS_DESCR
/end CHARACTERISTIC
/begin CHARACTERISTIC KL_TVDKIMEASPORT13 "Fahrpedalabhängige Verzögerungszeit Start Haupt ME" CURVE 0x229594 kl_ui8_S6_S3 2000 UMR_MSEC__10_1_M128_S6_S3 -1000 1000
 /begin AXIS_DESCR STD_AXIS zff_atsys._.iSignale._.obj.sig_dki UMR_PROZENT__20_51_0_S6_S3 4 0 100 DEPOSIT ABSOLUTE MONOTONY MON_INCREASE /end AXIS_DESCR
/end CHARACTERISTIC
/begin CHARACTERISTIC KF_TVMEASPORT13 "Verzoegerungszeit fuer Beginn Haupt-ME" MAP 0x2295A0 kf_si16_S6_S3 2000 UMR_MSEC__10_1_0_S6_S3 -1000 1000
 /begin AXIS_DESCR STD_AXIS zff_atsys._.iSignale._.obj.sig_n_t8 UMR_U_MIN_32_1_0_S6_S3 8 0 8160 DEPOSIT ABSOLUTE MONOTONY MON_INCREASE /end AXIS_DESCR
 /begin AXIS_DESCR STD_AXIS zff_atsys._.iSignale._.obj.sig_m_t8 UMR_NM__8_1_M50_S6_S3 4 -400 1640 DEPOSIT ABSOLUTE MONOTONY MON_INCREASE /end AXIS_DESCR
/end CHARACTERISTIC
/begin CHARACTERISTIC KL_TVCGMEASPORT13 "Temperaturabhängige Verzögerungszeit fuer Beginn Haupt-ME" CURVE 0x229600 kl_ui8_S6_S3 2000 UMR_MSEC__10_1_M128_S6_S3 -1000 1000
 /begin AXIS_DESCR STD_AXIS zff_atsys._.iSignale._.obj.sig_c_getr UMR_GRADC__1_1_M40_S6_S3 4 -40 150 DEPOSIT ABSOLUTE MONOTONY MON_INCREASE /end AXIS_DESCR
/end CHARACTERISTIC
/begin CHARACTERISTIC T_FMEHAUPTASPORT13 "Filterzeit Start Hauptmotoreingriff" VALUE 0x26D744 kw_si16_S6_S3 508 UMR_MSEC__1_1_0_S6_S3 -254 254 /end CHARACTERISTIC
/begin CHARACTERISTIC K_FMEHAUPTASPORT13 "Filterkonstante (aehnl INPT) Start Hauptmotoreingriff" VALUE 0x26D746 kw_si16_S6_S3 65.535 UMR___1_1000_0_S6_S3 -32.768 32.767 /end CHARACTERISTIC
/begin CHARACTERISTIC KL_TSYNMTMEHAUPTESPORT24 "Zeit vor Erkennen synchron fuer Ende Haupt-ME" CURVE 0x22960C kl_ui8_S6_S3 1280 UMR_MSEC__10_1_M128_S6_S3 -1280 0
 /begin AXIS_DESCR STD_AXIS zff_atsys._.iSignale._.obj.sig_m_t8 UMR_NM__8_1_M50_S6_S3 6 -400 1640 DEPOSIT ABSOLUTE MONOTONY MON_INCREASE /end AXIS_DESCR
/end CHARACTERISTIC
/begin CHARACTERISTIC KF_FTSYNNTMEHAUPTESPORT24 "Faktor auf Haupt-ME fuer Nach-ME" MAP 0x22961C kf_si16_S6_S3 1 UMR___1_100_0_S6_S3 0 1
 /begin AXIS_DESCR STD_AXIS iSasZentr.iSchaltend.t_syn UMR_MSEC__10_1_0_S6_S3 6 -5000 5000 DEPOSIT ABSOLUTE MONOTONY MON_INCREASE /end AXIS_DESCR
 /begin AXIS_DESCR STD_AXIS zff_atsys._.iSignale._.obj.sig_n_t UMR_U_MIN_1_1_0_S6_S3 4 0 8160 DEPOSIT ABSOLUTE MONOTONY MON_INCREASE /end AXIS_DESCR
/end CHARACTERISTIC
/begin CHARACTERISTIC KL_TVDKIMEASPORT24 "Fahrpedalabhängige Verzögerungszeit Start Haupt ME" CURVE 0x229668 kl_ui8_S6_S3 2000 UMR_MSEC__10_1_M128_S6_S3 -1000 1000
 /begin AXIS_DESCR STD_AXIS zff_atsys._.iSignale._.obj.sig_dki UMR_PROZENT__20_51_0_S6_S3 4 0 100 DEPOSIT ABSOLUTE MONOTONY MON_INCREASE /end AXIS_DESCR
/end CHARACTERISTIC
/begin CHARACTERISTIC KF_TVMEASPORT24 "Verzoegerungszeit fuer Beginn Haupt-ME" MAP 0x229674 kf_si16_S6_S3 2000 UMR_MSEC__10_1_0_S6_S3 -1000 1000
 /begin AXIS_DESCR STD_AXIS zff_atsys._.iSignale._.obj.sig_n_t8 UMR_U_MIN_32_1_0_S6_S3 8 0 8160 DEPOSIT ABSOLUTE MONOTONY MON_INCREASE /end AXIS_DESCR
 /begin AXIS_DESCR STD_AXIS zff_atsys._.iSignale._.obj.sig_m_t8 UMR_NM__8_1_M50_S6_S3 4 -400 1640 DEPOSIT ABSOLUTE MONOTONY MON_INCREASE /end AXIS_DESCR
/end CHARACTERISTIC
/begin CHARACTERISTIC KL_TVCGMEASPORT24 "Temperaturabhängige Verzögerungszeit fuer Beginn Haupt-ME" CURVE 0x2296D4 kl_ui8_S6_S3 2000 UMR_MSEC__10_1_M128_S6_S3 -1000 1000
 /begin AXIS_DESCR STD_AXIS zff_atsys._.iSignale._.obj.sig_c_getr UMR_GRADC__1_1_M40_S6_S3 4 -40 150 DEPOSIT ABSOLUTE MONOTONY MON_INCREASE /end AXIS_DESCR
/end CHARACTERISTIC
/begin CHARACTERISTIC T_FMEHAUPTASPORT24 "Filterzeit Start Hauptmotoreingriff" VALUE 0x26D748 kw_si16_S6_S3 508 UMR_MSEC__1_1_0_S6_S3 -254 254 /end CHARACTERISTIC
/begin CHARACTERISTIC K_FMEHAUPTASPORT24 "Filterkonstante (aehnl INPT) Start Hauptmotoreingriff" VALUE 0x26D74A kw_si16_S6_S3 65.535 UMR___1_1000_0_S6_S3 -32.768 32.767 /end CHARACTERISTIC
/begin CHARACTERISTIC KL_TSYNMTMEHAUPTESPORT35 "Zeit vor Erkennen synchron fuer Ende Haupt-ME" CURVE 0x2296E0 kl_ui8_S6_S3 1280 UMR_MSEC__10_1_M128_S6_S3 -1280 0
 /begin AXIS_DESCR STD_AXIS zff_atsys._.iSignale._.obj.sig_m_t8 UMR_NM__8_1_M50_S6_S3 6 -400 1640 DEPOSIT ABSOLUTE MONOTONY MON_INCREASE /end AXIS_DESCR
/end CHARACTERISTIC
/begin CHARACTERISTIC KF_FTSYNNTMEHAUPTESPORT35 "Faktor auf Haupt-ME fuer Nach-ME" MAP 0x2296F0 kf_si16_S6_S3 1 UMR___1_100_0_S6_S3 0 1
 /begin AXIS_DESCR STD_AXIS iSasZentr.iSchaltend.t_syn UMR_MSEC__10_1_0_S6_S3 6 -5000 5000 DEPOSIT ABSOLUTE MONOTONY MON_INCREASE /end AXIS_DESCR
 /begin AXIS_DESCR STD_AXIS zff_atsys._.iSignale._.obj.sig_n_t UMR_U_MIN_1_1_0_S6_S3 4 0 8160 DEPOSIT ABSOLUTE MONOTONY MON_INCREASE /end AXIS_DESCR
/end CHARACTERISTIC
/begin CHARACTERISTIC KL_TVDKIMEASPORT35 "Fahrpedalabhängige Verzögerungszeit Start Haupt ME" CURVE 0x22973C kl_ui8_S6_S3 2000 UMR_MSEC__10_1_M128_S6_S3 -1000 1000
 /begin AXIS_DESCR STD_AXIS zff_atsys._.iSignale._.obj.sig_dki UMR_PROZENT__20_51_0_S6_S3 4 0 100 DEPOSIT ABSOLUTE MONOTONY MON_INCREASE /end AXIS_DESCR
/end CHARACTERISTIC
/begin CHARACTERISTIC KF_TVMEASPORT35 "Verzoegerungszeit fuer Beginn Haupt-ME" MAP 0x229748 kf_si16_S6_S3 2000 UMR_MSEC__10_1_0_S6_S3 -1000 1000
 /begin AXIS_DESCR STD_AXIS zff_atsys._.iSignale._.obj.sig_n_t8 UMR_U_MIN_32_1_0_S6_S3 8 0 8160 DEPOSIT ABSOLUTE MONOTONY MON_INCREASE /end AXIS_DESCR
 /begin AXIS_DESCR STD_AXIS zff_atsys._.iSignale._.obj.sig_m_t8 UMR_NM__8_1_M50_S6_S3 4 -400 1640 DEPOSIT ABSOLUTE MONOTONY MON_INCREASE /end AXIS_DESCR
/end CHARACTERISTIC
/begin CHARACTERISTIC KL_TVCGMEASPORT35 "Temperaturabhängige Verzögerungszeit fuer Beginn Haupt-ME" CURVE 0x2297A8 kl_ui8_S6_S3 2000 UMR_MSEC__10_1_M128_S6_S3 -1000 1000
 /begin AXIS_DESCR STD_AXIS zff_atsys._.iSignale._.obj.sig_c_getr UMR_GRADC__1_1_M40_S6_S3 4 -40 150 DEPOSIT ABSOLUTE MONOTONY MON_INCREASE /end AXIS_DESCR
/end CHARACTERISTIC
/begin CHARACTERISTIC T_FMEHAUPTASPORT35 "Filterzeit Start Hauptmotoreingriff" VALUE 0x26D74C kw_si16_S6_S3 508 UMR_MSEC__1_1_0_S6_S3 -254 254 /end CHARACTERISTIC
/begin CHARACTERISTIC K_FMEHAUPTASPORT35 "Filterkonstante (aehnl INPT) Start Hauptmotoreingriff" VALUE 0x26D74E kw_si16_S6_S3 65.535 UMR___1_1000_0_S6_S3 -32.768 32.767 /end CHARACTERISTIC
/begin CHARACTERISTIC KL_TSYNMTMEHAUPTESPORT46 "Zeit vor Erkennen synchron fuer Ende Haupt-ME" CURVE 0x2297B4 kl_ui8_S6_S3 1280 UMR_MSEC__10_1_M128_S6_S3 -1280 0
 /begin AXIS_DESCR STD_AXIS zff_atsys._.iSignale._.obj.sig_m_t8 UMR_NM__8_1_M50_S6_S3 6 -400 1640 DEPOSIT ABSOLUTE MONOTONY MON_INCREASE /end AXIS_DESCR
/end CHARACTERISTIC
/begin CHARACTERISTIC KF_FTSYNNTMEHAUPTESPORT46 "Faktor auf Haupt-ME fuer Nach-ME" MAP 0x2297C4 kf_si16_S6_S3 1 UMR___1_100_0_S6_S3 0 1
 /begin AXIS_DESCR STD_AXIS iSasZentr.iSchaltend.t_syn UMR_MSEC__10_1_0_S6_S3 6 -5000 5000 DEPOSIT ABSOLUTE MONOTONY MON_INCREASE /end AXIS_DESCR
 /begin AXIS_DESCR STD_AXIS zff_atsys._.iSignale._.obj.sig_n_t UMR_U_MIN_1_1_0_S6_S3 4 0 8160 DEPOSIT ABSOLUTE MONOTONY MON_INCREASE /end AXIS_DESCR
/end CHARACTERISTIC
/begin CHARACTERISTIC KL_TVDKIMEASPORT46 "Fahrpedalabhängige Verzögerungszeit Start Haupt ME" CURVE 0x229810 kl_ui8_S6_S3 2000 UMR_MSEC__10_1_M128_S6_S3 -1000 1000
 /begin AXIS_DESCR STD_AXIS zff_atsys._.iSignale._.obj.sig_dki UMR_PROZENT__20_51_0_S6_S3 4 0 100 DEPOSIT ABSOLUTE MONOTONY MON_INCREASE /end AXIS_DESCR
/end CHARACTERISTIC
/begin CHARACTERISTIC KF_TVMEASPORT46 "Verzoegerungszeit fuer Beginn Haupt-ME" MAP 0x22981C kf_si16_S6_S3 2000 UMR_MSEC__10_1_0_S6_S3 -1000 1000
 /begin AXIS_DESCR STD_AXIS zff_atsys._.iSignale._.obj.sig_n_t8 UMR_U_MIN_32_1_0_S6_S3 8 0 8160 DEPOSIT ABSOLUTE MONOTONY MON_INCREASE /end AXIS_DESCR
 /begin AXIS_DESCR STD_AXIS zff_atsys._.iSignale._.obj.sig_m_t8 UMR_NM__8_1_M50_S6_S3 4 -400 1640 DEPOSIT ABSOLUTE MONOTONY MON_INCREASE /end AXIS_DESCR
/end CHARACTERISTIC
/begin CHARACTERISTIC KL_TVCGMEASPORT46 "Temperaturabhängige Verzögerungszeit fuer Beginn Haupt-ME" CURVE 0x22987C kl_ui8_S6_S3 2000 UMR_MSEC__10_1_M128_S6_S3 -1000 1000
 /begin AXIS_DESCR STD_AXIS zff_atsys._.iSignale._.obj.sig_c_getr UMR_GRADC__1_1_M40_S6_S3 4 -40 150 DEPOSIT ABSOLUTE MONOTONY MON_INCREASE /end AXIS_DESCR
/end CHARACTERISTIC
/begin CHARACTERISTIC T_FMEHAUPTASPORT46 "Filterzeit Start Hauptmotoreingriff" VALUE 0x26D750 kw_si16_S6_S3 508 UMR_MSEC__1_1_0_S6_S3 -254 254 /end CHARACTERISTIC
/begin CHARACTERISTIC K_FMEHAUPTASPORT46 "Filterkonstante (aehnl INPT) Start Hauptmotoreingriff" VALUE 0x26D752 kw_si16_S6_S3 65.535 UMR___1_1000_0_S6_S3 -32.768 32.767 /end CHARACTERISTIC
/begin CHARACTERISTIC KL_TSYNMTMEHAUPTESPORT57 "Zeit vor Erkennen synchron fuer Ende Haupt-ME" CURVE 0x229888 kl_ui8_S6_S3 1280 UMR_MSEC__10_1_M128_S6_S3 -1280 0
 /begin AXIS_DESCR STD_AXIS zff_atsys._.iSignale._.obj.sig_m_t8 UMR_NM__8_1_M50_S6_S3 6 -400 1640 DEPOSIT ABSOLUTE MONOTONY MON_INCREASE /end AXIS_DESCR
/end CHARACTERISTIC
/begin CHARACTERISTIC KF_FTSYNNTMEHAUPTESPORT57 "Faktor auf Haupt-ME fuer Nach-ME" MAP 0x229898 kf_si16_S6_S3 1 UMR___1_100_0_S6_S3 0 1
 /begin AXIS_DESCR STD_AXIS iSasZentr.iSchaltend.t_syn UMR_MSEC__10_1_0_S6_S3 6 -5000 5000 DEPOSIT ABSOLUTE MONOTONY MON_INCREASE /end AXIS_DESCR
 /begin AXIS_DESCR STD_AXIS zff_atsys._.iSignale._.obj.sig_n_t UMR_U_MIN_1_1_0_S6_S3 4 0 8160 DEPOSIT ABSOLUTE MONOTONY MON_INCREASE /end AXIS_DESCR
/end CHARACTERISTIC
/begin CHARACTERISTIC KL_TVDKIMEASPORT57 "Fahrpedalabhängige Verzögerungszeit Start Haupt ME" CURVE 0x2298E4 kl_ui8_S6_S3 2000 UMR_MSEC__10_1_M128_S6_S3 -1000 1000
 /begin AXIS_DESCR STD_AXIS zff_atsys._.iSignale._.obj.sig_dki UMR_PROZENT__20_51_0_S6_S3 4 0 100 DEPOSIT ABSOLUTE MONOTONY MON_INCREASE /end AXIS_DESCR
/end CHARACTERISTIC
/begin CHARACTERISTIC KF_TVMEASPORT57 "Verzoegerungszeit fuer Beginn Haupt-ME" MAP 0x2298F0 kf_si16_S6_S3 2000 UMR_MSEC__10_1_0_S6_S3 -1000 1000
 /begin AXIS_DESCR STD_AXIS zff_atsys._.iSignale._.obj.sig_n_t8 UMR_U_MIN_32_1_0_S6_S3 8 0 8160 DEPOSIT ABSOLUTE MONOTONY MON_INCREASE /end AXIS_DESCR
 /begin AXIS_DESCR STD_AXIS zff_atsys._.iSignale._.obj.sig_m_t8 UMR_NM__8_1_M50_S6_S3 4 -400 1640 DEPOSIT ABSOLUTE MONOTONY MON_INCREASE /end AXIS_DESCR
/end CHARACTERISTIC
/begin CHARACTERISTIC KL_TVCGMEASPORT57 "Temperaturabhängige Verzögerungszeit fuer Beginn Haupt-ME" CURVE 0x229950 kl_ui8_S6_S3 2000 UMR_MSEC__10_1_M128_S6_S3 -1000 1000
 /begin AXIS_DESCR STD_AXIS zff_atsys._.iSignale._.obj.sig_c_getr UMR_GRADC__1_1_M40_S6_S3 4 -40 150 DEPOSIT ABSOLUTE MONOTONY MON_INCREASE /end AXIS_DESCR
/end CHARACTERISTIC
/begin CHARACTERISTIC T_FMEHAUPTASPORT57 "Filterzeit Start Hauptmotoreingriff" VALUE 0x26D754 kw_si16_S6_S3 508 UMR_MSEC__1_1_0_S6_S3 -254 254 /end CHARACTERISTIC
/begin CHARACTERISTIC K_FMEHAUPTASPORT57 "Filterkonstante (aehnl INPT) Start Hauptmotoreingriff" VALUE 0x26D756 kw_si16_S6_S3 65.535 UMR___1_1000_0_S6_S3 -32.768 32.767 /end CHARACTERISTIC
/begin CHARACTERISTIC KL_TSYNMTMEHAUPTESPORT68 "Zeit vor Erkennen synchron fuer Ende Haupt-ME" CURVE 0x22995C kl_ui8_S6_S3 1280 UMR_MSEC__10_1_M128_S6_S3 -1280 0
 /begin AXIS_DESCR STD_AXIS zff_atsys._.iSignale._.obj.sig_m_t8 UMR_NM__8_1_M50_S6_S3 6 -400 1640 DEPOSIT ABSOLUTE MONOTONY MON_INCREASE /end AXIS_DESCR
/end CHARACTERISTIC
/begin CHARACTERISTIC KF_FTSYNNTMEHAUPTESPORT68 "Faktor auf Haupt-ME fuer Nach-ME" MAP 0x22996C kf_si16_S6_S3 1 UMR___1_100_0_S6_S3 0 1
 /begin AXIS_DESCR STD_AXIS iSasZentr.iSchaltend.t_syn UMR_MSEC__10_1_0_S6_S3 6 -5000 5000 DEPOSIT ABSOLUTE MONOTONY MON_INCREASE /end AXIS_DESCR
 /begin AXIS_DESCR STD_AXIS zff_atsys._.iSignale._.obj.sig_n_t UMR_U_MIN_1_1_0_S6_S3 4 0 8160 DEPOSIT ABSOLUTE MONOTONY MON_INCREASE /end AXIS_DESCR
/end CHARACTERISTIC
/begin CHARACTERISTIC KL_TVDKIMEASPORT68 "Fahrpedalabhängige Verzögerungszeit Start Haupt ME" CURVE 0x2299B8 kl_ui8_S6_S3 2000 UMR_MSEC__10_1_M128_S6_S3 -1000 1000
 /begin AXIS_DESCR STD_AXIS zff_atsys._.iSignale._.obj.sig_dki UMR_PROZENT__20_51_0_S6_S3 4 0 100 DEPOSIT ABSOLUTE MONOTONY MON_INCREASE /end AXIS_DESCR
/end CHARACTERISTIC
/begin CHARACTERISTIC KF_TVMEASPORT68 "Verzoegerungszeit fuer Beginn Haupt-ME" MAP 0x2299C4 kf_si16_S6_S3 2000 UMR_MSEC__10_1_0_S6_S3 -1000 1000
 /begin AXIS_DESCR STD_AXIS zff_atsys._.iSignale._.obj.sig_n_t8 UMR_U_MIN_32_1_0_S6_S3 8 0 8160 DEPOSIT ABSOLUTE MONOTONY MON_INCREASE /end AXIS_DESCR
 /begin AXIS_DESCR STD_AXIS zff_atsys._.iSignale._.obj.sig_m_t8 UMR_NM__8_1_M50_S6_S3 4 -400 1640 DEPOSIT ABSOLUTE MONOTONY MON_INCREASE /end AXIS_DESCR
/end CHARACTERISTIC
/begin CHARACTERISTIC KL_TVCGMEASPORT68 "Temperaturabhängige Verzögerungszeit fuer Beginn Haupt-ME" CURVE 0x229A24 kl_ui8_S6_S3 2000 UMR_MSEC__10_1_M128_S6_S3 -1000 1000
 /begin AXIS_DESCR STD_AXIS zff_atsys._.iSignale._.obj.sig_c_getr UMR_GRADC__1_1_M40_S6_S3 4 -40 150 DEPOSIT ABSOLUTE MONOTONY MON_INCREASE /end AXIS_DESCR
/end CHARACTERISTIC
/begin CHARACTERISTIC T_FMEHAUPTASPORT68 "Filterzeit Start Hauptmotoreingriff" VALUE 0x26D758 kw_si16_S6_S3 508 UMR_MSEC__1_1_0_S6_S3 -254 254 /end CHARACTERISTIC
/begin CHARACTERISTIC K_FMEHAUPTASPORT68 "Filterkonstante (aehnl INPT) Start Hauptmotoreingriff" VALUE 0x26D75A kw_si16_S6_S3 65.535 UMR___1_1000_0_S6_S3 -32.768 32.767 /end CHARACTERISTIC
/begin CHARACTERISTIC KL_TSYNMTMEHAUPTE_EZA12 "Zeit vor Erkennen synchron fuer Ende Haupt-ME" CURVE 0x229A30 kl_ui8_S6_S3 1280 UMR_MSEC__10_1_M128_S6_S3 -1280 0
 /begin AXIS_DESCR STD_AXIS zff_atsys._.iSignale._.obj.sig_m_t8 UMR_NM__8_1_M50_S6_S3 6 -400 1640 DEPOSIT ABSOLUTE MONOTONY MON_INCREASE /end AXIS_DESCR
/end CHARACTERISTIC
/begin CHARACTERISTIC KF_FTSYNNTMEHAUPTE_EZA12 "Faktor auf Haupt-ME fuer Nach-ME" MAP 0x229A40 kf_si16_S6_S3 1 UMR___1_100_0_S6_S3 0 1
 /begin AXIS_DESCR STD_AXIS iSasZentr.iSchaltend.t_syn UMR_MSEC__10_1_0_S6_S3 6 -5000 5000 DEPOSIT ABSOLUTE MONOTONY MON_INCREASE /end AXIS_DESCR
 /begin AXIS_DESCR STD_AXIS zff_atsys._.iSignale._.obj.sig_n_t UMR_U_MIN_1_1_0_S6_S3 4 0 8160 DEPOSIT ABSOLUTE MONOTONY MON_INCREASE /end AXIS_DESCR
/end CHARACTERISTIC
/begin CHARACTERISTIC KL_TVDKIMEA_EZA12 "Fahrpedalabhängige Verzögerungszeit Start Haupt ME" CURVE 0x229A8C kl_ui8_S6_S3 2000 UMR_MSEC__10_1_M128_S6_S3 -1000 1000
 /begin AXIS_DESCR STD_AXIS zff_atsys._.iSignale._.obj.sig_dki UMR_PROZENT__20_51_0_S6_S3 4 0 100 DEPOSIT ABSOLUTE MONOTONY MON_INCREASE /end AXIS_DESCR
/end CHARACTERISTIC
/begin CHARACTERISTIC KF_TVMEA_EZA12 "Verzoegerungszeit fuer Beginn Haupt-ME" MAP 0x229A98 kf_si16_S6_S3 2000 UMR_MSEC__10_1_0_S6_S3 -1000 1000
 /begin AXIS_DESCR STD_AXIS zff_atsys._.iSignale._.obj.sig_n_t8 UMR_U_MIN_32_1_0_S6_S3 8 0 8160 DEPOSIT ABSOLUTE MONOTONY MON_INCREASE /end AXIS_DESCR
 /begin AXIS_DESCR STD_AXIS zff_atsys._.iSignale._.obj.sig_m_t8 UMR_NM__8_1_M50_S6_S3 4 -400 1640 DEPOSIT ABSOLUTE MONOTONY MON_INCREASE /end AXIS_DESCR
/end CHARACTERISTIC
/begin CHARACTERISTIC KL_TVCGMEA_EZA12 "Temperaturabhängige Verzögerungszeit fuer Beginn Haupt-ME" CURVE 0x229AF8 kl_ui8_S6_S3 2000 UMR_MSEC__10_1_M128_S6_S3 -1000 1000
 /begin AXIS_DESCR STD_AXIS zff_atsys._.iSignale._.obj.sig_c_getr UMR_GRADC__1_1_M40_S6_S3 4 -40 150 DEPOSIT ABSOLUTE MONOTONY MON_INCREASE /end AXIS_DESCR
/end CHARACTERISTIC
/begin CHARACTERISTIC T_FMEHAUPTA_EZA12 "Filterzeit Start Hauptmotoreingriff" VALUE 0x26D75C kw_si16_S6_S3 508 UMR_MSEC__1_1_0_S6_S3 -254 254 /end CHARACTERISTIC
/begin CHARACTERISTIC K_FMEHAUPTA_EZA12 "Filterkonstante (aehnl INPT) Start Hauptmotoreingriff" VALUE 0x26D75E kw_si16_S6_S3 65.535 UMR___1_1000_0_S6_S3 -32.768 32.767 /end CHARACTERISTIC
/begin CHARACTERISTIC KL_TSYNMTMEHAUPTE_EZA23 "Zeit vor Erkennen synchron fuer Ende Haupt-ME" CURVE 0x229B04 kl_ui8_S6_S3 1280 UMR_MSEC__10_1_M128_S6_S3 -1280 0
 /begin AXIS_DESCR STD_AXIS zff_atsys._.iSignale._.obj.sig_m_t8 UMR_NM__8_1_M50_S6_S3 6 -400 1640 DEPOSIT ABSOLUTE MONOTONY MON_INCREASE /end AXIS_DESCR
/end CHARACTERISTIC
/begin CHARACTERISTIC KF_FTSYNNTMEHAUPTE_EZA23 "Faktor auf Haupt-ME fuer Nach-ME" MAP 0x229B14 kf_si16_S6_S3 1 UMR___1_100_0_S6_S3 0 1
 /begin AXIS_DESCR STD_AXIS iSasZentr.iSchaltend.t_syn UMR_MSEC__10_1_0_S6_S3 6 -5000 5000 DEPOSIT ABSOLUTE MONOTONY MON_INCREASE /end AXIS_DESCR
 /begin AXIS_DESCR STD_AXIS zff_atsys._.iSignale._.obj.sig_n_t UMR_U_MIN_1_1_0_S6_S3 4 0 8160 DEPOSIT ABSOLUTE MONOTONY MON_INCREASE /end AXIS_DESCR
/end CHARACTERISTIC
/begin CHARACTERISTIC KL_TVDKIMEA_EZA23 "Fahrpedalabhängige Verzögerungszeit Start Haupt ME" CURVE 0x229B60 kl_ui8_S6_S3 2000 UMR_MSEC__10_1_M128_S6_S3 -1000 1000
 /begin AXIS_DESCR STD_AXIS zff_atsys._.iSignale._.obj.sig_dki UMR_PROZENT__20_51_0_S6_S3 4 0 100 DEPOSIT ABSOLUTE MONOTONY MON_INCREASE /end AXIS_DESCR
/end CHARACTERISTIC
/begin CHARACTERISTIC KF_TVMEA_EZA23 "Verzoegerungszeit fuer Beginn Haupt-ME" MAP 0x229B6C kf_si16_S6_S3 2000 UMR_MSEC__10_1_0_S6_S3 -1000 1000
 /begin AXIS_DESCR STD_AXIS zff_atsys._.iSignale._.obj.sig_n_t8 UMR_U_MIN_32_1_0_S6_S3 8 0 8160 DEPOSIT ABSOLUTE MONOTONY MON_INCREASE /end AXIS_DESCR
 /begin AXIS_DESCR STD_AXIS zff_atsys._.iSignale._.obj.sig_m_t8 UMR_NM__8_1_M50_S6_S3 4 -400 1640 DEPOSIT ABSOLUTE MONOTONY MON_INCREASE /end AXIS_DESCR
/end CHARACTERISTIC
/begin CHARACTERISTIC KL_TVCGMEA_EZA23 "Temperaturabhängige Verzögerungszeit fuer Beginn Haupt-ME" CURVE 0x229BCC kl_ui8_S6_S3 2000 UMR_MSEC__10_1_M128_S6_S3 -1000 1000
 /begin AXIS_DESCR STD_AXIS zff_atsys._.iSignale._.obj.sig_c_getr UMR_GRADC__1_1_M40_S6_S3 4 -40 150 DEPOSIT ABSOLUTE MONOTONY MON_INCREASE /end AXIS_DESCR
/end CHARACTERISTIC
/begin CHARACTERISTIC T_FMEHAUPTA_EZA23 "Filterzeit Start Hauptmotoreingriff" VALUE 0x26D760 kw_si16_S6_S3 508 UMR_MSEC__1_1_0_S6_S3 -254 254 /end CHARACTERISTIC
/begin CHARACTERISTIC K_FMEHAUPTA_EZA23 "Filterkonstante (aehnl INPT) Start Hauptmotoreingriff" VALUE 0x26D762 kw_si16_S6_S3 65.535 UMR___1_1000_0_S6_S3 -32.768 32.767 /end CHARACTERISTIC
/begin CHARACTERISTIC KL_TSYNMTMEHAUPTE_EZA34 "Zeit vor Erkennen synchron fuer Ende Haupt-ME" CURVE 0x229BD8 kl_ui8_S6_S3 1280 UMR_MSEC__10_1_M128_S6_S3 -1280 0
 /begin AXIS_DESCR STD_AXIS zff_atsys._.iSignale._.obj.sig_m_t8 UMR_NM__8_1_M50_S6_S3 6 -400 1640 DEPOSIT ABSOLUTE MONOTONY MON_INCREASE /end AXIS_DESCR
/end CHARACTERISTIC
/begin CHARACTERISTIC KF_FTSYNNTMEHAUPTE_EZA34 "Faktor auf Haupt-ME fuer Nach-ME" MAP 0x229BE8 kf_si16_S6_S3 1 UMR___1_100_0_S6_S3 0 1
 /begin AXIS_DESCR STD_AXIS iSasZentr.iSchaltend.t_syn UMR_MSEC__10_1_0_S6_S3 6 -5000 5000 DEPOSIT ABSOLUTE MONOTONY MON_INCREASE /end AXIS_DESCR
 /begin AXIS_DESCR STD_AXIS zff_atsys._.iSignale._.obj.sig_n_t UMR_U_MIN_1_1_0_S6_S3 4 0 8160 DEPOSIT ABSOLUTE MONOTONY MON_INCREASE /end AXIS_DESCR
/end CHARACTERISTIC
/begin CHARACTERISTIC KL_TVDKIMEA_EZA34 "Fahrpedalabhängige Verzögerungszeit Start Haupt ME" CURVE 0x229C34 kl_ui8_S6_S3 2000 UMR_MSEC__10_1_M128_S6_S3 -1000 1000
 /begin AXIS_DESCR STD_AXIS zff_atsys._.iSignale._.obj.sig_dki UMR_PROZENT__20_51_0_S6_S3 4 0 100 DEPOSIT ABSOLUTE MONOTONY MON_INCREASE /end AXIS_DESCR
/end CHARACTERISTIC
/begin CHARACTERISTIC KF_TVMEA_EZA34 "Verzoegerungszeit fuer Beginn Haupt-ME" MAP 0x229C40 kf_si16_S6_S3 2000 UMR_MSEC__10_1_0_S6_S3 -1000 1000
 /begin AXIS_DESCR STD_AXIS zff_atsys._.iSignale._.obj.sig_n_t8 UMR_U_MIN_32_1_0_S6_S3 8 0 8160 DEPOSIT ABSOLUTE MONOTONY MON_INCREASE /end AXIS_DESCR
 /begin AXIS_DESCR STD_AXIS zff_atsys._.iSignale._.obj.sig_m_t8 UMR_NM__8_1_M50_S6_S3 4 -400 1640 DEPOSIT ABSOLUTE MONOTONY MON_INCREASE /end AXIS_DESCR
/end CHARACTERISTIC
/begin CHARACTERISTIC KL_TVCGMEA_EZA34 "Temperaturabhängige Verzögerungszeit fuer Beginn Haupt-ME" CURVE 0x229CA0 kl_ui8_S6_S3 2000 UMR_MSEC__10_1_M128_S6_S3 -1000 1000
 /begin AXIS_DESCR STD_AXIS zff_atsys._.iSignale._.obj.sig_c_getr UMR_GRADC__1_1_M40_S6_S3 4 -40 150 DEPOSIT ABSOLUTE MONOTONY MON_INCREASE /end AXIS_DESCR
/end CHARACTERISTIC
/begin CHARACTERISTIC T_FMEHAUPTA_EZA34 "Filterzeit Start Hauptmotoreingriff" VALUE 0x26D764 kw_si16_S6_S3 508 UMR_MSEC__1_1_0_S6_S3 -254 254 /end CHARACTERISTIC
/begin CHARACTERISTIC K_FMEHAUPTA_EZA34 "Filterkonstante (aehnl INPT) Start Hauptmotoreingriff" VALUE 0x26D766 kw_si16_S6_S3 65.535 UMR___1_1000_0_S6_S3 -32.768 32.767 /end CHARACTERISTIC
/begin CHARACTERISTIC KL_TSYNMTMEHAUPTE_EZA45 "Zeit vor Erkennen synchron fuer Ende Haupt-ME" CURVE 0x229CAC kl_ui8_S6_S3 1280 UMR_MSEC__10_1_M128_S6_S3 -1280 0
 /begin AXIS_DESCR STD_AXIS zff_atsys._.iSignale._.obj.sig_m_t8 UMR_NM__8_1_M50_S6_S3 6 -400 1640 DEPOSIT ABSOLUTE MONOTONY MON_INCREASE /end AXIS_DESCR
/end CHARACTERISTIC
/begin CHARACTERISTIC KF_FTSYNNTMEHAUPTE_EZA45 "Faktor auf Haupt-ME fuer Nach-ME" MAP 0x229CBC kf_si16_S6_S3 1 UMR___1_100_0_S6_S3 0 1
 /begin AXIS_DESCR STD_AXIS iSasZentr.iSchaltend.t_syn UMR_MSEC__10_1_0_S6_S3 6 -5000 5000 DEPOSIT ABSOLUTE MONOTONY MON_INCREASE /end AXIS_DESCR
 /begin AXIS_DESCR STD_AXIS zff_atsys._.iSignale._.obj.sig_n_t UMR_U_MIN_1_1_0_S6_S3 4 0 8160 DEPOSIT ABSOLUTE MONOTONY MON_INCREASE /end AXIS_DESCR
/end CHARACTERISTIC
/begin CHARACTERISTIC KL_TVDKIMEA_EZA45 "Fahrpedalabhängige Verzögerungszeit Start Haupt ME" CURVE 0x229D08 kl_ui8_S6_S3 2000 UMR_MSEC__10_1_M128_S6_S3 -1000 1000
 /begin AXIS_DESCR STD_AXIS zff_atsys._.iSignale._.obj.sig_dki UMR_PROZENT__20_51_0_S6_S3 4 0 100 DEPOSIT ABSOLUTE MONOTONY MON_INCREASE /end AXIS_DESCR
/end CHARACTERISTIC
/begin CHARACTERISTIC KF_TVMEA_EZA45 "Verzoegerungszeit fuer Beginn Haupt-ME" MAP 0x229D14 kf_si16_S6_S3 2000 UMR_MSEC__10_1_0_S6_S3 -1000 1000
 /begin AXIS_DESCR STD_AXIS zff_atsys._.iSignale._.obj.sig_n_t8 UMR_U_MIN_32_1_0_S6_S3 8 0 8160 DEPOSIT ABSOLUTE MONOTONY MON_INCREASE /end AXIS_DESCR
 /begin AXIS_DESCR STD_AXIS zff_atsys._.iSignale._.obj.sig_m_t8 UMR_NM__8_1_M50_S6_S3 4 -400 1640 DEPOSIT ABSOLUTE MONOTONY MON_INCREASE /end AXIS_DESCR
/end CHARACTERISTIC
/begin CHARACTERISTIC KL_TVCGMEA_EZA45 "Temperaturabhängige Verzögerungszeit fuer Beginn Haupt-ME" CURVE 0x229D74 kl_ui8_S6_S3 2000 UMR_MSEC__10_1_M128_S6_S3 -1000 1000
 /begin AXIS_DESCR STD_AXIS zff_atsys._.iSignale._.obj.sig_c_getr UMR_GRADC__1_1_M40_S6_S3 4 -40 150 DEPOSIT ABSOLUTE MONOTONY MON_INCREASE /end AXIS_DESCR
/end CHARACTERISTIC
/begin CHARACTERISTIC T_FMEHAUPTA_EZA45 "Filterzeit Start Hauptmotoreingriff" VALUE 0x26D768 kw_si16_S6_S3 508 UMR_MSEC__1_1_0_S6_S3 -254 254 /end CHARACTERISTIC
/begin CHARACTERISTIC K_FMEHAUPTA_EZA45 "Filterkonstante (aehnl INPT) Start Hauptmotoreingriff" VALUE 0x26D76A kw_si16_S6_S3 65.535 UMR___1_1000_0_S6_S3 -32.768 32.767 /end CHARACTERISTIC
/begin CHARACTERISTIC KL_TSYNMTMEHAUPTE_EZA56 "Zeit vor Erkennen synchron fuer Ende Haupt-ME" CURVE 0x229D80 kl_ui8_S6_S3 1280 UMR_MSEC__10_1_M128_S6_S3 -1280 0
 /begin AXIS_DESCR STD_AXIS zff_atsys._.iSignale._.obj.sig_m_t8 UMR_NM__8_1_M50_S6_S3 6 -400 1640 DEPOSIT ABSOLUTE MONOTONY MON_INCREASE /end AXIS_DESCR
/end CHARACTERISTIC
/begin CHARACTERISTIC KF_FTSYNNTMEHAUPTE_EZA56 "Faktor auf Haupt-ME fuer Nach-ME" MAP 0x229D90 kf_si16_S6_S3 1 UMR___1_100_0_S6_S3 0 1
 /begin AXIS_DESCR STD_AXIS iSasZentr.iSchaltend.t_syn UMR_MSEC__10_1_0_S6_S3 6 -5000 5000 DEPOSIT ABSOLUTE MONOTONY MON_INCREASE /end AXIS_DESCR
 /begin AXIS_DESCR STD_AXIS zff_atsys._.iSignale._.obj.sig_n_t UMR_U_MIN_1_1_0_S6_S3 4 0 8160 DEPOSIT ABSOLUTE MONOTONY MON_INCREASE /end AXIS_DESCR
/end CHARACTERISTIC
/begin CHARACTERISTIC KL_TVDKIMEA_EZA56 "Fahrpedalabhängige Verzögerungszeit Start Haupt ME" CURVE 0x229DDC kl_ui8_S6_S3 2000 UMR_MSEC__10_1_M128_S6_S3 -1000 1000
 /begin AXIS_DESCR STD_AXIS zff_atsys._.iSignale._.obj.sig_dki UMR_PROZENT__20_51_0_S6_S3 4 0 100 DEPOSIT ABSOLUTE MONOTONY MON_INCREASE /end AXIS_DESCR
/end CHARACTERISTIC
/begin CHARACTERISTIC KF_TVMEA_EZA56 "Verzoegerungszeit fuer Beginn Haupt-ME" MAP 0x229DE8 kf_si16_S6_S3 2000 UMR_MSEC__10_1_0_S6_S3 -1000 1000
 /begin AXIS_DESCR STD_AXIS zff_atsys._.iSignale._.obj.sig_n_t8 UMR_U_MIN_32_1_0_S6_S3 8 0 8160 DEPOSIT ABSOLUTE MONOTONY MON_INCREASE /end AXIS_DESCR
 /begin AXIS_DESCR STD_AXIS zff_atsys._.iSignale._.obj.sig_m_t8 UMR_NM__8_1_M50_S6_S3 4 -400 1640 DEPOSIT ABSOLUTE MONOTONY MON_INCREASE /end AXIS_DESCR
/end CHARACTERISTIC
/begin CHARACTERISTIC KL_TVCGMEA_EZA56 "Temperaturabhängige Verzögerungszeit fuer Beginn Haupt-ME" CURVE 0x229E48 kl_ui8_S6_S3 2000 UMR_MSEC__10_1_M128_S6_S3 -1000 1000
 /begin AXIS_DESCR STD_AXIS zff_atsys._.iSignale._.obj.sig_c_getr UMR_GRADC__1_1_M40_S6_S3 4 -40 150 DEPOSIT ABSOLUTE MONOTONY MON_INCREASE /end AXIS_DESCR
/end CHARACTERISTIC
/begin CHARACTERISTIC T_FMEHAUPTA_EZA56 "Filterzeit Start Hauptmotoreingriff" VALUE 0x26D76C kw_si16_S6_S3 508 UMR_MSEC__1_1_0_S6_S3 -254 254 /end CHARACTERISTIC
/begin CHARACTERISTIC K_FMEHAUPTA_EZA56 "Filterkonstante (aehnl INPT) Start Hauptmotoreingriff" VALUE 0x26D76E kw_si16_S6_S3 65.535 UMR___1_1000_0_S6_S3 -32.768 32.767 /end CHARACTERISTIC
/begin CHARACTERISTIC KL_TSYNMTMEHAUPTE_EZA67 "Zeit vor Erkennen synchron fuer Ende Haupt-ME" CURVE 0x229E54 kl_ui8_S6_S3 1280 UMR_MSEC__10_1_M128_S6_S3 -1280 0
 /begin AXIS_DESCR STD_AXIS zff_atsys._.iSignale._.obj.sig_m_t8 UMR_NM__8_1_M50_S6_S3 6 -400 1640 DEPOSIT ABSOLUTE MONOTONY MON_INCREASE /end AXIS_DESCR
/end CHARACTERISTIC
/begin CHARACTERISTIC KF_FTSYNNTMEHAUPTE_EZA67 "Faktor auf Haupt-ME fuer Nach-ME" MAP 0x229E64 kf_si16_S6_S3 1 UMR___1_100_0_S6_S3 0 1
 /begin AXIS_DESCR STD_AXIS iSasZentr.iSchaltend.t_syn UMR_MSEC__10_1_0_S6_S3 6 -5000 5000 DEPOSIT ABSOLUTE MONOTONY MON_INCREASE /end AXIS_DESCR
 /begin AXIS_DESCR STD_AXIS zff_atsys._.iSignale._.obj.sig_n_t UMR_U_MIN_1_1_0_S6_S3 4 0 8160 DEPOSIT ABSOLUTE MONOTONY MON_INCREASE /end AXIS_DESCR
/end CHARACTERISTIC
/begin CHARACTERISTIC KL_TVDKIMEA_EZA67 "Fahrpedalabhängige Verzögerungszeit Start Haupt ME" CURVE 0x229EB0 kl_ui8_S6_S3 2000 UMR_MSEC__10_1_M128_S6_S3 -1000 1000
 /begin AXIS_DESCR STD_AXIS zff_atsys._.iSignale._.obj.sig_dki UMR_PROZENT__20_51_0_S6_S3 4 0 100 DEPOSIT ABSOLUTE MONOTONY MON_INCREASE /end AXIS_DESCR
/end CHARACTERISTIC
/begin CHARACTERISTIC KF_TVMEA_EZA67 "Verzoegerungszeit fuer Beginn Haupt-ME" MAP 0x229EBC kf_si16_S6_S3 2000 UMR_MSEC__10_1_0_S6_S3 -1000 1000
 /begin AXIS_DESCR STD_AXIS zff_atsys._.iSignale._.obj.sig_n_t8 UMR_U_MIN_32_1_0_S6_S3 8 0 8160 DEPOSIT ABSOLUTE MONOTONY MON_INCREASE /end AXIS_DESCR
 /begin AXIS_DESCR STD_AXIS zff_atsys._.iSignale._.obj.sig_m_t8 UMR_NM__8_1_M50_S6_S3 4 -400 1640 DEPOSIT ABSOLUTE MONOTONY MON_INCREASE /end AXIS_DESCR
/end CHARACTERISTIC
/begin CHARACTERISTIC KL_TVCGMEA_EZA67 "Temperaturabhängige Verzögerungszeit fuer Beginn Haupt-ME" CURVE 0x229F1C kl_ui8_S6_S3 2000 UMR_MSEC__10_1_M128_S6_S3 -1000 1000
 /begin AXIS_DESCR STD_AXIS zff_atsys._.iSignale._.obj.sig_c_getr UMR_GRADC__1_1_M40_S6_S3 4 -40 150 DEPOSIT ABSOLUTE MONOTONY MON_INCREASE /end AXIS_DESCR
/end CHARACTERISTIC
/begin CHARACTERISTIC T_FMEHAUPTA_EZA67 "Filterzeit Start Hauptmotoreingriff" VALUE 0x26D770 kw_si16_S6_S3 508 UMR_MSEC__1_1_0_S6_S3 -254 254 /end CHARACTERISTIC
/begin CHARACTERISTIC K_FMEHAUPTA_EZA67 "Filterkonstante (aehnl INPT) Start Hauptmotoreingriff" VALUE 0x26D772 kw_si16_S6_S3 65.535 UMR___1_1000_0_S6_S3 -32.768 32.767 /end CHARACTERISTIC
/begin CHARACTERISTIC KL_TSYNMTMEHAUPTE_EZA78 "Zeit vor Erkennen synchron fuer Ende Haupt-ME" CURVE 0x229F28 kl_ui8_S6_S3 1280 UMR_MSEC__10_1_M128_S6_S3 -1280 0
 /begin AXIS_DESCR STD_AXIS zff_atsys._.iSignale._.obj.sig_m_t8 UMR_NM__8_1_M50_S6_S3 6 -400 1640 DEPOSIT ABSOLUTE MONOTONY MON_INCREASE /end AXIS_DESCR
/end CHARACTERISTIC
/begin CHARACTERISTIC KF_FTSYNNTMEHAUPTE_EZA78 "Faktor auf Haupt-ME fuer Nach-ME" MAP 0x229F38 kf_si16_S6_S3 1 UMR___1_100_0_S6_S3 0 1
 /begin AXIS_DESCR STD_AXIS iSasZentr.iSchaltend.t_syn UMR_MSEC__10_1_0_S6_S3 6 -5000 5000 DEPOSIT ABSOLUTE MONOTONY MON_INCREASE /end AXIS_DESCR
 /begin AXIS_DESCR STD_AXIS zff_atsys._.iSignale._.obj.sig_n_t UMR_U_MIN_1_1_0_S6_S3 4 0 8160 DEPOSIT ABSOLUTE MONOTONY MON_INCREASE /end AXIS_DESCR
/end CHARACTERISTIC
/begin CHARACTERISTIC KL_TVDKIMEA_EZA78 "Fahrpedalabhängige Verzögerungszeit Start Haupt ME" CURVE 0x229F84 kl_ui8_S6_S3 2000 UMR_MSEC__10_1_M128_S6_S3 -1000 1000
 /begin AXIS_DESCR STD_AXIS zff_atsys._.iSignale._.obj.sig_dki UMR_PROZENT__20_51_0_S6_S3 4 0 100 DEPOSIT ABSOLUTE MONOTONY MON_INCREASE /end AXIS_DESCR
/end CHARACTERISTIC
/begin CHARACTERISTIC KF_TVMEA_EZA78 "Verzoegerungszeit fuer Beginn Haupt-ME" MAP 0x229F90 kf_si16_S6_S3 2000 UMR_MSEC__10_1_0_S6_S3 -1000 1000
 /begin AXIS_DESCR STD_AXIS zff_atsys._.iSignale._.obj.sig_n_t8 UMR_U_MIN_32_1_0_S6_S3 8 0 8160 DEPOSIT ABSOLUTE MONOTONY MON_INCREASE /end AXIS_DESCR
 /begin AXIS_DESCR STD_AXIS zff_atsys._.iSignale._.obj.sig_m_t8 UMR_NM__8_1_M50_S6_S3 4 -400 1640 DEPOSIT ABSOLUTE MONOTONY MON_INCREASE /end AXIS_DESCR
/end CHARACTERISTIC
/begin CHARACTERISTIC KL_TVCGMEA_EZA78 "Temperaturabhängige Verzögerungszeit fuer Beginn Haupt-ME" CURVE 0x229FF0 kl_ui8_S6_S3 2000 UMR_MSEC__10_1_M128_S6_S3 -1000 1000
 /begin AXIS_DESCR STD_AXIS zff_atsys._.iSignale._.obj.sig_c_getr UMR_GRADC__1_1_M40_S6_S3 4 -40 150 DEPOSIT ABSOLUTE MONOTONY MON_INCREASE /end AXIS_DESCR
/end CHARACTERISTIC
/begin CHARACTERISTIC T_FMEHAUPTA_EZA78 "Filterzeit Start Hauptmotoreingriff" VALUE 0x26D774 kw_si16_S6_S3 508 UMR_MSEC__1_1_0_S6_S3 -254 254 /end CHARACTERISTIC
/begin CHARACTERISTIC K_FMEHAUPTA_EZA78 "Filterkonstante (aehnl INPT) Start Hauptmotoreingriff" VALUE 0x26D776 kw_si16_S6_S3 65.535 UMR___1_1000_0_S6_S3 -32.768 32.767 /end CHARACTERISTIC
/begin CHARACTERISTIC KL_TSYNMTMEHAUPTESP_EZA12 "Zeit vor Erkennen synchron fuer Ende Haupt-ME" CURVE 0x229FFC kl_ui8_S6_S3 1280 UMR_MSEC__10_1_M128_S6_S3 -1280 0
 /begin AXIS_DESCR STD_AXIS zff_atsys._.iSignale._.obj.sig_m_t8 UMR_NM__8_1_M50_S6_S3 6 -400 1640 DEPOSIT ABSOLUTE MONOTONY MON_INCREASE /end AXIS_DESCR
/end CHARACTERISTIC
/begin CHARACTERISTIC KF_FTSYNNTMEHAUPTESP_EZA12 "Faktor auf Haupt-ME fuer Nach-ME" MAP 0x22A00C kf_si16_S6_S3 1 UMR___1_100_0_S6_S3 0 1
 /begin AXIS_DESCR STD_AXIS iSasZentr.iSchaltend.t_syn UMR_MSEC__10_1_0_S6_S3 6 -5000 5000 DEPOSIT ABSOLUTE MONOTONY MON_INCREASE /end AXIS_DESCR
 /begin AXIS_DESCR STD_AXIS zff_atsys._.iSignale._.obj.sig_n_t UMR_U_MIN_1_1_0_S6_S3 4 0 8160 DEPOSIT ABSOLUTE MONOTONY MON_INCREASE /end AXIS_DESCR
/end CHARACTERISTIC
/begin CHARACTERISTIC KL_TVDKIMEASP_EZA12 "Fahrpedalabhängige Verzögerungszeit Start Haupt ME" CURVE 0x22A058 kl_ui8_S6_S3 2000 UMR_MSEC__10_1_M128_S6_S3 -1000 1000
 /begin AXIS_DESCR STD_AXIS zff_atsys._.iSignale._.obj.sig_dki UMR_PROZENT__20_51_0_S6_S3 4 0 100 DEPOSIT ABSOLUTE MONOTONY MON_INCREASE /end AXIS_DESCR
/end CHARACTERISTIC
/begin CHARACTERISTIC KF_TVMEASP_EZA12 "Verzoegerungszeit fuer Beginn Haupt-ME" MAP 0x22A064 kf_si16_S6_S3 2000 UMR_MSEC__10_1_0_S6_S3 -1000 1000
 /begin AXIS_DESCR STD_AXIS zff_atsys._.iSignale._.obj.sig_n_t8 UMR_U_MIN_32_1_0_S6_S3 8 0 8160 DEPOSIT ABSOLUTE MONOTONY MON_INCREASE /end AXIS_DESCR
 /begin AXIS_DESCR STD_AXIS zff_atsys._.iSignale._.obj.sig_m_t8 UMR_NM__8_1_M50_S6_S3 4 -400 1640 DEPOSIT ABSOLUTE MONOTONY MON_INCREASE /end AXIS_DESCR
/end CHARACTERISTIC
/begin CHARACTERISTIC KL_TVCGMEASP_EZA12 "Temperaturabhängige Verzögerungszeit fuer Beginn Haupt-ME" CURVE 0x22A0C4 kl_ui8_S6_S3 2000 UMR_MSEC__10_1_M128_S6_S3 -1000 1000
 /begin AXIS_DESCR STD_AXIS zff_atsys._.iSignale._.obj.sig_c_getr UMR_GRADC__1_1_M40_S6_S3 4 -40 150 DEPOSIT ABSOLUTE MONOTONY MON_INCREASE /end AXIS_DESCR
/end CHARACTERISTIC
/begin CHARACTERISTIC T_FMEHAUPTASP_EZA12 "Filterzeit Start Hauptmotoreingriff" VALUE 0x26D778 kw_si16_S6_S3 508 UMR_MSEC__1_1_0_S6_S3 -254 254 /end CHARACTERISTIC
/begin CHARACTERISTIC K_FMEHAUPTASP_EZA12 "Filterkonstante (aehnl INPT) Start Hauptmotoreingriff" VALUE 0x26D77A kw_si16_S6_S3 65.535 UMR___1_1000_0_S6_S3 -32.768 32.767 /end CHARACTERISTIC
/begin CHARACTERISTIC KL_TSYNMTMEHAUPTESP_EZA23 "Zeit vor Erkennen synchron fuer Ende Haupt-ME" CURVE 0x22A0D0 kl_ui8_S6_S3 1280 UMR_MSEC__10_1_M128_S6_S3 -1280 0
 /begin AXIS_DESCR STD_AXIS zff_atsys._.iSignale._.obj.sig_m_t8 UMR_NM__8_1_M50_S6_S3 6 -400 1640 DEPOSIT ABSOLUTE MONOTONY MON_INCREASE /end AXIS_DESCR
/end CHARACTERISTIC
/begin CHARACTERISTIC KF_FTSYNNTMEHAUPTESP_EZA23 "Faktor auf Haupt-ME fuer Nach-ME" MAP 0x22A0E0 kf_si16_S6_S3 1 UMR___1_100_0_S6_S3 0 1
 /begin AXIS_DESCR STD_AXIS iSasZentr.iSchaltend.t_syn UMR_MSEC__10_1_0_S6_S3 6 -5000 5000 DEPOSIT ABSOLUTE MONOTONY MON_INCREASE /end AXIS_DESCR
 /begin AXIS_DESCR STD_AXIS zff_atsys._.iSignale._.obj.sig_n_t UMR_U_MIN_1_1_0_S6_S3 4 0 8160 DEPOSIT ABSOLUTE MONOTONY MON_INCREASE /end AXIS_DESCR
/end CHARACTERISTIC
/begin CHARACTERISTIC KL_TVDKIMEASP_EZA23 "Fahrpedalabhängige Verzögerungszeit Start Haupt ME" CURVE 0x22A12C kl_ui8_S6_S3 2000 UMR_MSEC__10_1_M128_S6_S3 -1000 1000
 /begin AXIS_DESCR STD_AXIS zff_atsys._.iSignale._.obj.sig_dki UMR_PROZENT__20_51_0_S6_S3 4 0 100 DEPOSIT ABSOLUTE MONOTONY MON_INCREASE /end AXIS_DESCR
/end CHARACTERISTIC
/begin CHARACTERISTIC KF_TVMEASP_EZA23 "Verzoegerungszeit fuer Beginn Haupt-ME" MAP 0x22A138 kf_si16_S6_S3 2000 UMR_MSEC__10_1_0_S6_S3 -1000 1000
 /begin AXIS_DESCR STD_AXIS zff_atsys._.iSignale._.obj.sig_n_t8 UMR_U_MIN_32_1_0_S6_S3 8 0 8160 DEPOSIT ABSOLUTE MONOTONY MON_INCREASE /end AXIS_DESCR
 /begin AXIS_DESCR STD_AXIS zff_atsys._.iSignale._.obj.sig_m_t8 UMR_NM__8_1_M50_S6_S3 4 -400 1640 DEPOSIT ABSOLUTE MONOTONY MON_INCREASE /end AXIS_DESCR
/end CHARACTERISTIC
/begin CHARACTERISTIC KL_TVCGMEASP_EZA23 "Temperaturabhängige Verzögerungszeit fuer Beginn Haupt-ME" CURVE 0x22A198 kl_ui8_S6_S3 2000 UMR_MSEC__10_1_M128_S6_S3 -1000 1000
 /begin AXIS_DESCR STD_AXIS zff_atsys._.iSignale._.obj.sig_c_getr UMR_GRADC__1_1_M40_S6_S3 4 -40 150 DEPOSIT ABSOLUTE MONOTONY MON_INCREASE /end AXIS_DESCR
/end CHARACTERISTIC
/begin CHARACTERISTIC T_FMEHAUPTASP_EZA23 "Filterzeit Start Hauptmotoreingriff" VALUE 0x26D77C kw_si16_S6_S3 508 UMR_MSEC__1_1_0_S6_S3 -254 254 /end CHARACTERISTIC
/begin CHARACTERISTIC K_FMEHAUPTASP_EZA23 "Filterkonstante (aehnl INPT) Start Hauptmotoreingriff" VALUE 0x26D77E kw_si16_S6_S3 65.535 UMR___1_1000_0_S6_S3 -32.768 32.767 /end CHARACTERISTIC
/begin CHARACTERISTIC KL_TSYNMTMEHAUPTESP_EZA34 "Zeit vor Erkennen synchron fuer Ende Haupt-ME" CURVE 0x22A1A4 kl_ui8_S6_S3 1280 UMR_MSEC__10_1_M128_S6_S3 -1280 0
 /begin AXIS_DESCR STD_AXIS zff_atsys._.iSignale._.obj.sig_m_t8 UMR_NM__8_1_M50_S6_S3 6 -400 1640 DEPOSIT ABSOLUTE MONOTONY MON_INCREASE /end AXIS_DESCR
/end CHARACTERISTIC
/begin CHARACTERISTIC KF_FTSYNNTMEHAUPTESP_EZA34 "Faktor auf Haupt-ME fuer Nach-ME" MAP 0x22A1B4 kf_si16_S6_S3 1 UMR___1_100_0_S6_S3 0 1
 /begin AXIS_DESCR STD_AXIS iSasZentr.iSchaltend.t_syn UMR_MSEC__10_1_0_S6_S3 6 -5000 5000 DEPOSIT ABSOLUTE MONOTONY MON_INCREASE /end AXIS_DESCR
 /begin AXIS_DESCR STD_AXIS zff_atsys._.iSignale._.obj.sig_n_t UMR_U_MIN_1_1_0_S6_S3 4 0 8160 DEPOSIT ABSOLUTE MONOTONY MON_INCREASE /end AXIS_DESCR
/end CHARACTERISTIC
/begin CHARACTERISTIC KL_TVDKIMEASP_EZA34 "Fahrpedalabhängige Verzögerungszeit Start Haupt ME" CURVE 0x22A200 kl_ui8_S6_S3 2000 UMR_MSEC__10_1_M128_S6_S3 -1000 1000
 /begin AXIS_DESCR STD_AXIS zff_atsys._.iSignale._.obj.sig_dki UMR_PROZENT__20_51_0_S6_S3 4 0 100 DEPOSIT ABSOLUTE MONOTONY MON_INCREASE /end AXIS_DESCR
/end CHARACTERISTIC
/begin CHARACTERISTIC KF_TVMEASP_EZA34 "Verzoegerungszeit fuer Beginn Haupt-ME" MAP 0x22A20C kf_si16_S6_S3 2000 UMR_MSEC__10_1_0_S6_S3 -1000 1000
 /begin AXIS_DESCR STD_AXIS zff_atsys._.iSignale._.obj.sig_n_t8 UMR_U_MIN_32_1_0_S6_S3 8 0 8160 DEPOSIT ABSOLUTE MONOTONY MON_INCREASE /end AXIS_DESCR
 /begin AXIS_DESCR STD_AXIS zff_atsys._.iSignale._.obj.sig_m_t8 UMR_NM__8_1_M50_S6_S3 4 -400 1640 DEPOSIT ABSOLUTE MONOTONY MON_INCREASE /end AXIS_DESCR
/end CHARACTERISTIC
/begin CHARACTERISTIC KL_TVCGMEASP_EZA34 "Temperaturabhängige Verzögerungszeit fuer Beginn Haupt-ME" CURVE 0x22A26C kl_ui8_S6_S3 2000 UMR_MSEC__10_1_M128_S6_S3 -1000 1000
 /begin AXIS_DESCR STD_AXIS zff_atsys._.iSignale._.obj.sig_c_getr UMR_GRADC__1_1_M40_S6_S3 4 -40 150 DEPOSIT ABSOLUTE MONOTONY MON_INCREASE /end AXIS_DESCR
/end CHARACTERISTIC
/begin CHARACTERISTIC T_FMEHAUPTASP_EZA34 "Filterzeit Start Hauptmotoreingriff" VALUE 0x26D780 kw_si16_S6_S3 508 UMR_MSEC__1_1_0_S6_S3 -254 254 /end CHARACTERISTIC
/begin CHARACTERISTIC K_FMEHAUPTASP_EZA34 "Filterkonstante (aehnl INPT) Start Hauptmotoreingriff" VALUE 0x26D782 kw_si16_S6_S3 65.535 UMR___1_1000_0_S6_S3 -32.768 32.767 /end CHARACTERISTIC
/begin CHARACTERISTIC KL_TSYNMTMEHAUPTESP_EZA45 "Zeit vor Erkennen synchron fuer Ende Haupt-ME" CURVE 0x22A278 kl_ui8_S6_S3 1280 UMR_MSEC__10_1_M128_S6_S3 -1280 0
 /begin AXIS_DESCR STD_AXIS zff_atsys._.iSignale._.obj.sig_m_t8 UMR_NM__8_1_M50_S6_S3 6 -400 1640 DEPOSIT ABSOLUTE MONOTONY MON_INCREASE /end AXIS_DESCR
/end CHARACTERISTIC
/begin CHARACTERISTIC KF_FTSYNNTMEHAUPTESP_EZA45 "Faktor auf Haupt-ME fuer Nach-ME" MAP 0x22A288 kf_si16_S6_S3 1 UMR___1_100_0_S6_S3 0 1
 /begin AXIS_DESCR STD_AXIS iSasZentr.iSchaltend.t_syn UMR_MSEC__10_1_0_S6_S3 6 -5000 5000 DEPOSIT ABSOLUTE MONOTONY MON_INCREASE /end AXIS_DESCR
 /begin AXIS_DESCR STD_AXIS zff_atsys._.iSignale._.obj.sig_n_t UMR_U_MIN_1_1_0_S6_S3 4 0 8160 DEPOSIT ABSOLUTE MONOTONY MON_INCREASE /end AXIS_DESCR
/end CHARACTERISTIC
/begin CHARACTERISTIC KL_TVDKIMEASP_EZA45 "Fahrpedalabhängige Verzögerungszeit Start Haupt ME" CURVE 0x22A2D4 kl_ui8_S6_S3 2000 UMR_MSEC__10_1_M128_S6_S3 -1000 1000
 /begin AXIS_DESCR STD_AXIS zff_atsys._.iSignale._.obj.sig_dki UMR_PROZENT__20_51_0_S6_S3 4 0 100 DEPOSIT ABSOLUTE MONOTONY MON_INCREASE /end AXIS_DESCR
/end CHARACTERISTIC
/begin CHARACTERISTIC KF_TVMEASP_EZA45 "Verzoegerungszeit fuer Beginn Haupt-ME" MAP 0x22A2E0 kf_si16_S6_S3 2000 UMR_MSEC__10_1_0_S6_S3 -1000 1000
 /begin AXIS_DESCR STD_AXIS zff_atsys._.iSignale._.obj.sig_n_t8 UMR_U_MIN_32_1_0_S6_S3 8 0 8160 DEPOSIT ABSOLUTE MONOTONY MON_INCREASE /end AXIS_DESCR
 /begin AXIS_DESCR STD_AXIS zff_atsys._.iSignale._.obj.sig_m_t8 UMR_NM__8_1_M50_S6_S3 4 -400 1640 DEPOSIT ABSOLUTE MONOTONY MON_INCREASE /end AXIS_DESCR
/end CHARACTERISTIC
/begin CHARACTERISTIC KL_TVCGMEASP_EZA45 "Temperaturabhängige Verzögerungszeit fuer Beginn Haupt-ME" CURVE 0x22A340 kl_ui8_S6_S3 2000 UMR_MSEC__10_1_M128_S6_S3 -1000 1000
 /begin AXIS_DESCR STD_AXIS zff_atsys._.iSignale._.obj.sig_c_getr UMR_GRADC__1_1_M40_S6_S3 4 -40 150 DEPOSIT ABSOLUTE MONOTONY MON_INCREASE /end AXIS_DESCR
/end CHARACTERISTIC
/begin CHARACTERISTIC T_FMEHAUPTASP_EZA45 "Filterzeit Start Hauptmotoreingriff" VALUE 0x26D784 kw_si16_S6_S3 508 UMR_MSEC__1_1_0_S6_S3 -254 254 /end CHARACTERISTIC
/begin CHARACTERISTIC K_FMEHAUPTASP_EZA45 "Filterkonstante (aehnl INPT) Start Hauptmotoreingriff" VALUE 0x26D786 kw_si16_S6_S3 65.535 UMR___1_1000_0_S6_S3 -32.768 32.767 /end CHARACTERISTIC
/begin CHARACTERISTIC KL_TSYNMTMEHAUPTESP_EZA56 "Zeit vor Erkennen synchron fuer Ende Haupt-ME" CURVE 0x22A34C kl_ui8_S6_S3 1280 UMR_MSEC__10_1_M128_S6_S3 -1280 0
 /begin AXIS_DESCR STD_AXIS zff_atsys._.iSignale._.obj.sig_m_t8 UMR_NM__8_1_M50_S6_S3 6 -400 1640 DEPOSIT ABSOLUTE MONOTONY MON_INCREASE /end AXIS_DESCR
/end CHARACTERISTIC
/begin CHARACTERISTIC KF_FTSYNNTMEHAUPTESP_EZA56 "Faktor auf Haupt-ME fuer Nach-ME" MAP 0x22A35C kf_si16_S6_S3 1 UMR___1_100_0_S6_S3 0 1
 /begin AXIS_DESCR STD_AXIS iSasZentr.iSchaltend.t_syn UMR_MSEC__10_1_0_S6_S3 6 -5000 5000 DEPOSIT ABSOLUTE MONOTONY MON_INCREASE /end AXIS_DESCR
 /begin AXIS_DESCR STD_AXIS zff_atsys._.iSignale._.obj.sig_n_t UMR_U_MIN_1_1_0_S6_S3 4 0 8160 DEPOSIT ABSOLUTE MONOTONY MON_INCREASE /end AXIS_DESCR
/end CHARACTERISTIC
/begin CHARACTERISTIC KL_TVDKIMEASP_EZA56 "Fahrpedalabhängige Verzögerungszeit Start Haupt ME" CURVE 0x22A3A8 kl_ui8_S6_S3 2000 UMR_MSEC__10_1_M128_S6_S3 -1000 1000
 /begin AXIS_DESCR STD_AXIS zff_atsys._.iSignale._.obj.sig_dki UMR_PROZENT__20_51_0_S6_S3 4 0 100 DEPOSIT ABSOLUTE MONOTONY MON_INCREASE /end AXIS_DESCR
/end CHARACTERISTIC
/begin CHARACTERISTIC KF_TVMEASP_EZA56 "Verzoegerungszeit fuer Beginn Haupt-ME" MAP 0x22A3B4 kf_si16_S6_S3 2000 UMR_MSEC__10_1_0_S6_S3 -1000 1000
 /begin AXIS_DESCR STD_AXIS zff_atsys._.iSignale._.obj.sig_n_t8 UMR_U_MIN_32_1_0_S6_S3 8 0 8160 DEPOSIT ABSOLUTE MONOTONY MON_INCREASE /end AXIS_DESCR
 /begin AXIS_DESCR STD_AXIS zff_atsys._.iSignale._.obj.sig_m_t8 UMR_NM__8_1_M50_S6_S3 4 -400 1640 DEPOSIT ABSOLUTE MONOTONY MON_INCREASE /end AXIS_DESCR
/end CHARACTERISTIC
/begin CHARACTERISTIC KL_TVCGMEASP_EZA56 "Temperaturabhängige Verzögerungszeit fuer Beginn Haupt-ME" CURVE 0x22A414 kl_ui8_S6_S3 2000 UMR_MSEC__10_1_M128_S6_S3 -1000 1000
 /begin AXIS_DESCR STD_AXIS zff_atsys._.iSignale._.obj.sig_c_getr UMR_GRADC__1_1_M40_S6_S3 4 -40 150 DEPOSIT ABSOLUTE MONOTONY MON_INCREASE /end AXIS_DESCR
/end CHARACTERISTIC
/begin CHARACTERISTIC T_FMEHAUPTASP_EZA56 "Filterzeit Start Hauptmotoreingriff" VALUE 0x26D788 kw_si16_S6_S3 508 UMR_MSEC__1_1_0_S6_S3 -254 254 /end CHARACTERISTIC
/begin CHARACTERISTIC K_FMEHAUPTASP_EZA56 "Filterkonstante (aehnl INPT) Start Hauptmotoreingriff" VALUE 0x26D78A kw_si16_S6_S3 65.535 UMR___1_1000_0_S6_S3 -32.768 32.767 /end CHARACTERISTIC
/begin CHARACTERISTIC KL_TSYNMTMEHAUPTESP_EZA67 "Zeit vor Erkennen synchron fuer Ende Haupt-ME" CURVE 0x22A420 kl_ui8_S6_S3 1280 UMR_MSEC__10_1_M128_S6_S3 -1280 0
 /begin AXIS_DESCR STD_AXIS zff_atsys._.iSignale._.obj.sig_m_t8 UMR_NM__8_1_M50_S6_S3 6 -400 1640 DEPOSIT ABSOLUTE MONOTONY MON_INCREASE /end AXIS_DESCR
/end CHARACTERISTIC
/begin CHARACTERISTIC KF_FTSYNNTMEHAUPTESP_EZA67 "Faktor auf Haupt-ME fuer Nach-ME" MAP 0x22A430 kf_si16_S6_S3 1 UMR___1_100_0_S6_S3 0 1
 /begin AXIS_DESCR STD_AXIS iSasZentr.iSchaltend.t_syn UMR_MSEC__10_1_0_S6_S3 6 -5000 5000 DEPOSIT ABSOLUTE MONOTONY MON_INCREASE /end AXIS_DESCR
 /begin AXIS_DESCR STD_AXIS zff_atsys._.iSignale._.obj.sig_n_t UMR_U_MIN_1_1_0_S6_S3 4 0 8160 DEPOSIT ABSOLUTE MONOTONY MON_INCREASE /end AXIS_DESCR
/end CHARACTERISTIC
/begin CHARACTERISTIC KL_TVDKIMEASP_EZA67 "Fahrpedalabhängige Verzögerungszeit Start Haupt ME" CURVE 0x22A47C kl_ui8_S6_S3 2000 UMR_MSEC__10_1_M128_S6_S3 -1000 1000
 /begin AXIS_DESCR STD_AXIS zff_atsys._.iSignale._.obj.sig_dki UMR_PROZENT__20_51_0_S6_S3 4 0 100 DEPOSIT ABSOLUTE MONOTONY MON_INCREASE /end AXIS_DESCR
/end CHARACTERISTIC
/begin CHARACTERISTIC KF_TVMEASP_EZA67 "Verzoegerungszeit fuer Beginn Haupt-ME" MAP 0x22A488 kf_si16_S6_S3 2000 UMR_MSEC__10_1_0_S6_S3 -1000 1000
 /begin AXIS_DESCR STD_AXIS zff_atsys._.iSignale._.obj.sig_n_t8 UMR_U_MIN_32_1_0_S6_S3 8 0 8160 DEPOSIT ABSOLUTE MONOTONY MON_INCREASE /end AXIS_DESCR
 /begin AXIS_DESCR STD_AXIS zff_atsys._.iSignale._.obj.sig_m_t8 UMR_NM__8_1_M50_S6_S3 4 -400 1640 DEPOSIT ABSOLUTE MONOTONY MON_INCREASE /end AXIS_DESCR
/end CHARACTERISTIC
/begin CHARACTERISTIC KL_TVCGMEASP_EZA67 "Temperaturabhängige Verzögerungszeit fuer Beginn Haupt-ME" CURVE 0x22A4E8 kl_ui8_S6_S3 2000 UMR_MSEC__10_1_M128_S6_S3 -1000 1000
 /begin AXIS_DESCR STD_AXIS zff_atsys._.iSignale._.obj.sig_c_getr UMR_GRADC__1_1_M40_S6_S3 4 -40 150 DEPOSIT ABSOLUTE MONOTONY MON_INCREASE /end AXIS_DESCR
/end CHARACTERISTIC
/begin CHARACTERISTIC T_FMEHAUPTASP_EZA67 "Filterzeit Start Hauptmotoreingriff" VALUE 0x26D78C kw_si16_S6_S3 508 UMR_MSEC__1_1_0_S6_S3 -254 254 /end CHARACTERISTIC
/begin CHARACTERISTIC K_FMEHAUPTASP_EZA67 "Filterkonstante (aehnl INPT) Start Hauptmotoreingriff" VALUE 0x26D78E kw_si16_S6_S3 65.535 UMR___1_1000_0_S6_S3 -32.768 32.767 /end CHARACTERISTIC
/begin CHARACTERISTIC KL_TSYNMTMEHAUPTESP_EZA78 "Zeit vor Erkennen synchron fuer Ende Haupt-ME" CURVE 0x22A4F4 kl_ui8_S6_S3 1280 UMR_MSEC__10_1_M128_S6_S3 -1280 0
 /begin AXIS_DESCR STD_AXIS zff_atsys._.iSignale._.obj.sig_m_t8 UMR_NM__8_1_M50_S6_S3 6 -400 1640 DEPOSIT ABSOLUTE MONOTONY MON_INCREASE /end AXIS_DESCR
/end CHARACTERISTIC
/begin CHARACTERISTIC KF_FTSYNNTMEHAUPTESP_EZA78 "Faktor auf Haupt-ME fuer Nach-ME" MAP 0x22A504 kf_si16_S6_S3 1 UMR___1_100_0_S6_S3 0 1
 /begin AXIS_DESCR STD_AXIS iSasZentr.iSchaltend.t_syn UMR_MSEC__10_1_0_S6_S3 6 -5000 5000 DEPOSIT ABSOLUTE MONOTONY MON_INCREASE /end AXIS_DESCR
 /begin AXIS_DESCR STD_AXIS zff_atsys._.iSignale._.obj.sig_n_t UMR_U_MIN_1_1_0_S6_S3 4 0 8160 DEPOSIT ABSOLUTE MONOTONY MON_INCREASE /end AXIS_DESCR
/end CHARACTERISTIC
/begin CHARACTERISTIC KL_TVDKIMEASP_EZA78 "Fahrpedalabhängige Verzögerungszeit Start Haupt ME" CURVE 0x22A550 kl_ui8_S6_S3 2000 UMR_MSEC__10_1_M128_S6_S3 -1000 1000
 /begin AXIS_DESCR STD_AXIS zff_atsys._.iSignale._.obj.sig_dki UMR_PROZENT__20_51_0_S6_S3 4 0 100 DEPOSIT ABSOLUTE MONOTONY MON_INCREASE /end AXIS_DESCR
/end CHARACTERISTIC
/begin CHARACTERISTIC KF_TVMEASP_EZA78 "Verzoegerungszeit fuer Beginn Haupt-ME" MAP 0x22A55C kf_si16_S6_S3 2000 UMR_MSEC__10_1_0_S6_S3 -1000 1000
 /begin AXIS_DESCR STD_AXIS zff_atsys._.iSignale._.obj.sig_n_t8 UMR_U_MIN_32_1_0_S6_S3 8 0 8160 DEPOSIT ABSOLUTE MONOTONY MON_INCREASE /end AXIS_DESCR
 /begin AXIS_DESCR STD_AXIS zff_atsys._.iSignale._.obj.sig_m_t8 UMR_NM__8_1_M50_S6_S3 4 -400 1640 DEPOSIT ABSOLUTE MONOTONY MON_INCREASE /end AXIS_DESCR
/end CHARACTERISTIC
/begin CHARACTERISTIC KL_TVCGMEASP_EZA78 "Temperaturabhängige Verzögerungszeit fuer Beginn Haupt-ME" CURVE 0x22A5BC kl_ui8_S6_S3 2000 UMR_MSEC__10_1_M128_S6_S3 -1000 1000
 /begin AXIS_DESCR STD_AXIS zff_atsys._.iSignale._.obj.sig_c_getr UMR_GRADC__1_1_M40_S6_S3 4 -40 150 DEPOSIT ABSOLUTE MONOTONY MON_INCREASE /end AXIS_DESCR
/end CHARACTERISTIC
/begin CHARACTERISTIC T_FMEHAUPTASP_EZA78 "Filterzeit Start Hauptmotoreingriff" VALUE 0x26D790 kw_si16_S6_S3 508 UMR_MSEC__1_1_0_S6_S3 -254 254 /end CHARACTERISTIC
/begin CHARACTERISTIC K_FMEHAUPTASP_EZA78 "Filterkonstante (aehnl INPT) Start Hauptmotoreingriff" VALUE 0x26D792 kw_si16_S6_S3 65.535 UMR___1_1000_0_S6_S3 -32.768 32.767 /end CHARACTERISTIC
/begin CHARACTERISTIC KL_TSYNMTMEHAUPTESPORT_EZA12 "Zeit vor Erkennen synchron fuer Ende Haupt-ME" CURVE 0x22A5C8 kl_ui8_S6_S3 1280 UMR_MSEC__10_1_M128_S6_S3 -1280 0
 /begin AXIS_DESCR STD_AXIS zff_atsys._.iSignale._.obj.sig_m_t8 UMR_NM__8_1_M50_S6_S3 6 -400 1640 DEPOSIT ABSOLUTE MONOTONY MON_INCREASE /end AXIS_DESCR
/end CHARACTERISTIC
/begin CHARACTERISTIC KF_FTSYNNTMEHAUPTESPORT_EZA12 "Faktor auf Haupt-ME fuer Nach-ME" MAP 0x22A5D8 kf_si16_S6_S3 1 UMR___1_100_0_S6_S3 0 1
 /begin AXIS_DESCR STD_AXIS iSasZentr.iSchaltend.t_syn UMR_MSEC__10_1_0_S6_S3 6 -5000 5000 DEPOSIT ABSOLUTE MONOTONY MON_INCREASE /end AXIS_DESCR
 /begin AXIS_DESCR STD_AXIS zff_atsys._.iSignale._.obj.sig_n_t UMR_U_MIN_1_1_0_S6_S3 4 0 8160 DEPOSIT ABSOLUTE MONOTONY MON_INCREASE /end AXIS_DESCR
/end CHARACTERISTIC
/begin CHARACTERISTIC KL_TVDKIMEASPORT_EZA12 "Fahrpedalabhängige Verzögerungszeit Start Haupt ME" CURVE 0x22A624 kl_ui8_S6_S3 2000 UMR_MSEC__10_1_M128_S6_S3 -1000 1000
 /begin AXIS_DESCR STD_AXIS zff_atsys._.iSignale._.obj.sig_dki UMR_PROZENT__20_51_0_S6_S3 4 0 100 DEPOSIT ABSOLUTE MONOTONY MON_INCREASE /end AXIS_DESCR
/end CHARACTERISTIC
/begin CHARACTERISTIC KF_TVMEASPORT_EZA12 "Verzoegerungszeit fuer Beginn Haupt-ME" MAP 0x22A630 kf_si16_S6_S3 2000 UMR_MSEC__10_1_0_S6_S3 -1000 1000
 /begin AXIS_DESCR STD_AXIS zff_atsys._.iSignale._.obj.sig_n_t8 UMR_U_MIN_32_1_0_S6_S3 8 0 8160 DEPOSIT ABSOLUTE MONOTONY MON_INCREASE /end AXIS_DESCR
 /begin AXIS_DESCR STD_AXIS zff_atsys._.iSignale._.obj.sig_m_t8 UMR_NM__8_1_M50_S6_S3 4 -400 1640 DEPOSIT ABSOLUTE MONOTONY MON_INCREASE /end AXIS_DESCR
/end CHARACTERISTIC
/begin CHARACTERISTIC KL_TVCGMEASPORT_EZA12 "Temperaturabhängige Verzögerungszeit fuer Beginn Haupt-ME" CURVE 0x22A690 kl_ui8_S6_S3 2000 UMR_MSEC__10_1_M128_S6_S3 -1000 1000
 /begin AXIS_DESCR STD_AXIS zff_atsys._.iSignale._.obj.sig_c_getr UMR_GRADC__1_1_M40_S6_S3 4 -40 150 DEPOSIT ABSOLUTE MONOTONY MON_INCREASE /end AXIS_DESCR
/end CHARACTERISTIC
/begin CHARACTERISTIC T_FMEHAUPTASPORT_EZA12 "Filterzeit Start Hauptmotoreingriff" VALUE 0x26D794 kw_si16_S6_S3 508 UMR_MSEC__1_1_0_S6_S3 -254 254 /end CHARACTERISTIC
/begin CHARACTERISTIC K_FMEHAUPTASPORT_EZA12 "Filterkonstante (aehnl INPT) Start Hauptmotoreingriff" VALUE 0x26D796 kw_si16_S6_S3 65.535 UMR___1_1000_0_S6_S3 -32.768 32.767 /end CHARACTERISTIC
/begin CHARACTERISTIC KL_TSYNMTMEHAUPTESPORT_EZA23 "Zeit vor Erkennen synchron fuer Ende Haupt-ME" CURVE 0x22A69C kl_ui8_S6_S3 1280 UMR_MSEC__10_1_M128_S6_S3 -1280 0
 /begin AXIS_DESCR STD_AXIS zff_atsys._.iSignale._.obj.sig_m_t8 UMR_NM__8_1_M50_S6_S3 6 -400 1640 DEPOSIT ABSOLUTE MONOTONY MON_INCREASE /end AXIS_DESCR
/end CHARACTERISTIC
/begin CHARACTERISTIC KF_FTSYNNTMEHAUPTESPORT_EZA23 "Faktor auf Haupt-ME fuer Nach-ME" MAP 0x22A6AC kf_si16_S6_S3 1 UMR___1_100_0_S6_S3 0 1
 /begin AXIS_DESCR STD_AXIS iSasZentr.iSchaltend.t_syn UMR_MSEC__10_1_0_S6_S3 6 -5000 5000 DEPOSIT ABSOLUTE MONOTONY MON_INCREASE /end AXIS_DESCR
 /begin AXIS_DESCR STD_AXIS zff_atsys._.iSignale._.obj.sig_n_t UMR_U_MIN_1_1_0_S6_S3 4 0 8160 DEPOSIT ABSOLUTE MONOTONY MON_INCREASE /end AXIS_DESCR
/end CHARACTERISTIC
/begin CHARACTERISTIC KL_TVDKIMEASPORT_EZA23 "Fahrpedalabhängige Verzögerungszeit Start Haupt ME" CURVE 0x22A6F8 kl_ui8_S6_S3 2000 UMR_MSEC__10_1_M128_S6_S3 -1000 1000
 /begin AXIS_DESCR STD_AXIS zff_atsys._.iSignale._.obj.sig_dki UMR_PROZENT__20_51_0_S6_S3 4 0 100 DEPOSIT ABSOLUTE MONOTONY MON_INCREASE /end AXIS_DESCR
/end CHARACTERISTIC
/begin CHARACTERISTIC KF_TVMEASPORT_EZA23 "Verzoegerungszeit fuer Beginn Haupt-ME" MAP 0x22A704 kf_si16_S6_S3 2000 UMR_MSEC__10_1_0_S6_S3 -1000 1000
 /begin AXIS_DESCR STD_AXIS zff_atsys._.iSignale._.obj.sig_n_t8 UMR_U_MIN_32_1_0_S6_S3 8 0 8160 DEPOSIT ABSOLUTE MONOTONY MON_INCREASE /end AXIS_DESCR
 /begin AXIS_DESCR STD_AXIS zff_atsys._.iSignale._.obj.sig_m_t8 UMR_NM__8_1_M50_S6_S3 4 -400 1640 DEPOSIT ABSOLUTE MONOTONY MON_INCREASE /end AXIS_DESCR
/end CHARACTERISTIC
/begin CHARACTERISTIC KL_TVCGMEASPORT_EZA23 "Temperaturabhängige Verzögerungszeit fuer Beginn Haupt-ME" CURVE 0x22A764 kl_ui8_S6_S3 2000 UMR_MSEC__10_1_M128_S6_S3 -1000 1000
 /begin AXIS_DESCR STD_AXIS zff_atsys._.iSignale._.obj.sig_c_getr UMR_GRADC__1_1_M40_S6_S3 4 -40 150 DEPOSIT ABSOLUTE MONOTONY MON_INCREASE /end AXIS_DESCR
/end CHARACTERISTIC
/begin CHARACTERISTIC T_FMEHAUPTASPORT_EZA23 "Filterzeit Start Hauptmotoreingriff" VALUE 0x26D798 kw_si16_S6_S3 508 UMR_MSEC__1_1_0_S6_S3 -254 254 /end CHARACTERISTIC
/begin CHARACTERISTIC K_FMEHAUPTASPORT_EZA23 "Filterkonstante (aehnl INPT) Start Hauptmotoreingriff" VALUE 0x26D79A kw_si16_S6_S3 65.535 UMR___1_1000_0_S6_S3 -32.768 32.767 /end CHARACTERISTIC
/begin CHARACTERISTIC KL_TSYNMTMEHAUPTESPORT_EZA34 "Zeit vor Erkennen synchron fuer Ende Haupt-ME" CURVE 0x22A770 kl_ui8_S6_S3 1280 UMR_MSEC__10_1_M128_S6_S3 -1280 0
 /begin AXIS_DESCR STD_AXIS zff_atsys._.iSignale._.obj.sig_m_t8 UMR_NM__8_1_M50_S6_S3 6 -400 1640 DEPOSIT ABSOLUTE MONOTONY MON_INCREASE /end AXIS_DESCR
/end CHARACTERISTIC
/begin CHARACTERISTIC KF_FTSYNNTMEHAUPTESPORT_EZA34 "Faktor auf Haupt-ME fuer Nach-ME" MAP 0x22A780 kf_si16_S6_S3 1 UMR___1_100_0_S6_S3 0 1
 /begin AXIS_DESCR STD_AXIS iSasZentr.iSchaltend.t_syn UMR_MSEC__10_1_0_S6_S3 6 -5000 5000 DEPOSIT ABSOLUTE MONOTONY MON_INCREASE /end AXIS_DESCR
 /begin AXIS_DESCR STD_AXIS zff_atsys._.iSignale._.obj.sig_n_t UMR_U_MIN_1_1_0_S6_S3 4 0 8160 DEPOSIT ABSOLUTE MONOTONY MON_INCREASE /end AXIS_DESCR
/end CHARACTERISTIC
/begin CHARACTERISTIC KL_TVDKIMEASPORT_EZA34 "Fahrpedalabhängige Verzögerungszeit Start Haupt ME" CURVE 0x22A7CC kl_ui8_S6_S3 2000 UMR_MSEC__10_1_M128_S6_S3 -1000 1000
 /begin AXIS_DESCR STD_AXIS zff_atsys._.iSignale._.obj.sig_dki UMR_PROZENT__20_51_0_S6_S3 4 0 100 DEPOSIT ABSOLUTE MONOTONY MON_INCREASE /end AXIS_DESCR
/end CHARACTERISTIC
/begin CHARACTERISTIC KF_TVMEASPORT_EZA34 "Verzoegerungszeit fuer Beginn Haupt-ME" MAP 0x22A7D8 kf_si16_S6_S3 2000 UMR_MSEC__10_1_0_S6_S3 -1000 1000
 /begin AXIS_DESCR STD_AXIS zff_atsys._.iSignale._.obj.sig_n_t8 UMR_U_MIN_32_1_0_S6_S3 8 0 8160 DEPOSIT ABSOLUTE MONOTONY MON_INCREASE /end AXIS_DESCR
 /begin AXIS_DESCR STD_AXIS zff_atsys._.iSignale._.obj.sig_m_t8 UMR_NM__8_1_M50_S6_S3 4 -400 1640 DEPOSIT ABSOLUTE MONOTONY MON_INCREASE /end AXIS_DESCR
/end CHARACTERISTIC
/begin CHARACTERISTIC KL_TVCGMEASPORT_EZA34 "Temperaturabhängige Verzögerungszeit fuer Beginn Haupt-ME" CURVE 0x22A838 kl_ui8_S6_S3 2000 UMR_MSEC__10_1_M128_S6_S3 -1000 1000
 /begin AXIS_DESCR STD_AXIS zff_atsys._.iSignale._.obj.sig_c_getr UMR_GRADC__1_1_M40_S6_S3 4 -40 150 DEPOSIT ABSOLUTE MONOTONY MON_INCREASE /end AXIS_DESCR
/end CHARACTERISTIC
/begin CHARACTERISTIC T_FMEHAUPTASPORT_EZA34 "Filterzeit Start Hauptmotoreingriff" VALUE 0x26D79C kw_si16_S6_S3 508 UMR_MSEC__1_1_0_S6_S3 -254 254 /end CHARACTERISTIC
/begin CHARACTERISTIC K_FMEHAUPTASPORT_EZA34 "Filterkonstante (aehnl INPT) Start Hauptmotoreingriff" VALUE 0x26D79E kw_si16_S6_S3 65.535 UMR___1_1000_0_S6_S3 -32.768 32.767 /end CHARACTERISTIC
/begin CHARACTERISTIC KL_TSYNMTMEHAUPTESPORT_EZA45 "Zeit vor Erkennen synchron fuer Ende Haupt-ME" CURVE 0x22A844 kl_ui8_S6_S3 1280 UMR_MSEC__10_1_M128_S6_S3 -1280 0
 /begin AXIS_DESCR STD_AXIS zff_atsys._.iSignale._.obj.sig_m_t8 UMR_NM__8_1_M50_S6_S3 6 -400 1640 DEPOSIT ABSOLUTE MONOTONY MON_INCREASE /end AXIS_DESCR
/end CHARACTERISTIC
/begin CHARACTERISTIC KF_FTSYNNTMEHAUPTESPORT_EZA45 "Faktor auf Haupt-ME fuer Nach-ME" MAP 0x22A854 kf_si16_S6_S3 1 UMR___1_100_0_S6_S3 0 1
 /begin AXIS_DESCR STD_AXIS iSasZentr.iSchaltend.t_syn UMR_MSEC__10_1_0_S6_S3 6 -5000 5000 DEPOSIT ABSOLUTE MONOTONY MON_INCREASE /end AXIS_DESCR
 /begin AXIS_DESCR STD_AXIS zff_atsys._.iSignale._.obj.sig_n_t UMR_U_MIN_1_1_0_S6_S3 4 0 8160 DEPOSIT ABSOLUTE MONOTONY MON_INCREASE /end AXIS_DESCR
/end CHARACTERISTIC
/begin CHARACTERISTIC KL_TVDKIMEASPORT_EZA45 "Fahrpedalabhängige Verzögerungszeit Start Haupt ME" CURVE 0x22A8A0 kl_ui8_S6_S3 2000 UMR_MSEC__10_1_M128_S6_S3 -1000 1000
 /begin AXIS_DESCR STD_AXIS zff_atsys._.iSignale._.obj.sig_dki UMR_PROZENT__20_51_0_S6_S3 4 0 100 DEPOSIT ABSOLUTE MONOTONY MON_INCREASE /end AXIS_DESCR
/end CHARACTERISTIC
/begin CHARACTERISTIC KF_TVMEASPORT_EZA45 "Verzoegerungszeit fuer Beginn Haupt-ME" MAP 0x22A8AC kf_si16_S6_S3 2000 UMR_MSEC__10_1_0_S6_S3 -1000 1000
 /begin AXIS_DESCR STD_AXIS zff_atsys._.iSignale._.obj.sig_n_t8 UMR_U_MIN_32_1_0_S6_S3 8 0 8160 DEPOSIT ABSOLUTE MONOTONY MON_INCREASE /end AXIS_DESCR
 /begin AXIS_DESCR STD_AXIS zff_atsys._.iSignale._.obj.sig_m_t8 UMR_NM__8_1_M50_S6_S3 4 -400 1640 DEPOSIT ABSOLUTE MONOTONY MON_INCREASE /end AXIS_DESCR
/end CHARACTERISTIC
/begin CHARACTERISTIC KL_TVCGMEASPORT_EZA45 "Temperaturabhängige Verzögerungszeit fuer Beginn Haupt-ME" CURVE 0x22A90C kl_ui8_S6_S3 2000 UMR_MSEC__10_1_M128_S6_S3 -1000 1000
 /begin AXIS_DESCR STD_AXIS zff_atsys._.iSignale._.obj.sig_c_getr UMR_GRADC__1_1_M40_S6_S3 4 -40 150 DEPOSIT ABSOLUTE MONOTONY MON_INCREASE /end AXIS_DESCR
/end CHARACTERISTIC
/begin CHARACTERISTIC T_FMEHAUPTASPORT_EZA45 "Filterzeit Start Hauptmotoreingriff" VALUE 0x26D7A0 kw_si16_S6_S3 508 UMR_MSEC__1_1_0_S6_S3 -254 254 /end CHARACTERISTIC
/begin CHARACTERISTIC K_FMEHAUPTASPORT_EZA45 "Filterkonstante (aehnl INPT) Start Hauptmotoreingriff" VALUE 0x26D7A2 kw_si16_S6_S3 65.535 UMR___1_1000_0_S6_S3 -32.768 32.767 /end CHARACTERISTIC
/begin CHARACTERISTIC KL_TSYNMTMEHAUPTESPORT_EZA56 "Zeit vor Erkennen synchron fuer Ende Haupt-ME" CURVE 0x22A918 kl_ui8_S6_S3 1280 UMR_MSEC__10_1_M128_S6_S3 -1280 0
 /begin AXIS_DESCR STD_AXIS zff_atsys._.iSignale._.obj.sig_m_t8 UMR_NM__8_1_M50_S6_S3 6 -400 1640 DEPOSIT ABSOLUTE MONOTONY MON_INCREASE /end AXIS_DESCR
/end CHARACTERISTIC
/begin CHARACTERISTIC KF_FTSYNNTMEHAUPTESPORT_EZA56 "Faktor auf Haupt-ME fuer Nach-ME" MAP 0x22A928 kf_si16_S6_S3 1 UMR___1_100_0_S6_S3 0 1
 /begin AXIS_DESCR STD_AXIS iSasZentr.iSchaltend.t_syn UMR_MSEC__10_1_0_S6_S3 6 -5000 5000 DEPOSIT ABSOLUTE MONOTONY MON_INCREASE /end AXIS_DESCR
 /begin AXIS_DESCR STD_AXIS zff_atsys._.iSignale._.obj.sig_n_t UMR_U_MIN_1_1_0_S6_S3 4 0 8160 DEPOSIT ABSOLUTE MONOTONY MON_INCREASE /end AXIS_DESCR
/end CHARACTERISTIC
/begin CHARACTERISTIC KL_TVDKIMEASPORT_EZA56 "Fahrpedalabhängige Verzögerungszeit Start Haupt ME" CURVE 0x22A974 kl_ui8_S6_S3 2000 UMR_MSEC__10_1_M128_S6_S3 -1000 1000
 /begin AXIS_DESCR STD_AXIS zff_atsys._.iSignale._.obj.sig_dki UMR_PROZENT__20_51_0_S6_S3 4 0 100 DEPOSIT ABSOLUTE MONOTONY MON_INCREASE /end AXIS_DESCR
/end CHARACTERISTIC
/begin CHARACTERISTIC KF_TVMEASPORT_EZA56 "Verzoegerungszeit fuer Beginn Haupt-ME" MAP 0x22A980 kf_si16_S6_S3 2000 UMR_MSEC__10_1_0_S6_S3 -1000 1000
 /begin AXIS_DESCR STD_AXIS zff_atsys._.iSignale._.obj.sig_n_t8 UMR_U_MIN_32_1_0_S6_S3 8 0 8160 DEPOSIT ABSOLUTE MONOTONY MON_INCREASE /end AXIS_DESCR
 /begin AXIS_DESCR STD_AXIS zff_atsys._.iSignale._.obj.sig_m_t8 UMR_NM__8_1_M50_S6_S3 4 -400 1640 DEPOSIT ABSOLUTE MONOTONY MON_INCREASE /end AXIS_DESCR
/end CHARACTERISTIC
/begin CHARACTERISTIC KL_TVCGMEASPORT_EZA56 "Temperaturabhängige Verzögerungszeit fuer Beginn Haupt-ME" CURVE 0x22A9E0 kl_ui8_S6_S3 2000 UMR_MSEC__10_1_M128_S6_S3 -1000 1000
 /begin AXIS_DESCR STD_AXIS zff_atsys._.iSignale._.obj.sig_c_getr UMR_GRADC__1_1_M40_S6_S3 4 -40 150 DEPOSIT ABSOLUTE MONOTONY MON_INCREASE /end AXIS_DESCR
/end CHARACTERISTIC
/begin CHARACTERISTIC T_FMEHAUPTASPORT_EZA56 "Filterzeit Start Hauptmotoreingriff" VALUE 0x26D7A4 kw_si16_S6_S3 508 UMR_MSEC__1_1_0_S6_S3 -254 254 /end CHARACTERISTIC
/begin CHARACTERISTIC K_FMEHAUPTASPORT_EZA56 "Filterkonstante (aehnl INPT) Start Hauptmotoreingriff" VALUE 0x26D7A6 kw_si16_S6_S3 65.535 UMR___1_1000_0_S6_S3 -32.768 32.767 /end CHARACTERISTIC
/begin CHARACTERISTIC KL_TSYNMTMEHAUPTESPORT_EZA67 "Zeit vor Erkennen synchron fuer Ende Haupt-ME" CURVE 0x22A9EC kl_ui8_S6_S3 1280 UMR_MSEC__10_1_M128_S6_S3 -1280 0
 /begin AXIS_DESCR STD_AXIS zff_atsys._.iSignale._.obj.sig_m_t8 UMR_NM__8_1_M50_S6_S3 6 -400 1640 DEPOSIT ABSOLUTE MONOTONY MON_INCREASE /end AXIS_DESCR
/end CHARACTERISTIC
/begin CHARACTERISTIC KF_FTSYNNTMEHAUPTESPORT_EZA67 "Faktor auf Haupt-ME fuer Nach-ME" MAP 0x22A9FC kf_si16_S6_S3 1 UMR___1_100_0_S6_S3 0 1
 /begin AXIS_DESCR STD_AXIS iSasZentr.iSchaltend.t_syn UMR_MSEC__10_1_0_S6_S3 6 -5000 5000 DEPOSIT ABSOLUTE MONOTONY MON_INCREASE /end AXIS_DESCR
 /begin AXIS_DESCR STD_AXIS zff_atsys._.iSignale._.obj.sig_n_t UMR_U_MIN_1_1_0_S6_S3 4 0 8160 DEPOSIT ABSOLUTE MONOTONY MON_INCREASE /end AXIS_DESCR
/end CHARACTERISTIC
/begin CHARACTERISTIC KL_TVDKIMEASPORT_EZA67 "Fahrpedalabhängige Verzögerungszeit Start Haupt ME" CURVE 0x22AA48 kl_ui8_S6_S3 2000 UMR_MSEC__10_1_M128_S6_S3 -1000 1000
 /begin AXIS_DESCR STD_AXIS zff_atsys._.iSignale._.obj.sig_dki UMR_PROZENT__20_51_0_S6_S3 4 0 100 DEPOSIT ABSOLUTE MONOTONY MON_INCREASE /end AXIS_DESCR
/end CHARACTERISTIC
/begin CHARACTERISTIC KF_TVMEASPORT_EZA67 "Verzoegerungszeit fuer Beginn Haupt-ME" MAP 0x22AA54 kf_si16_S6_S3 2000 UMR_MSEC__10_1_0_S6_S3 -1000 1000
 /begin AXIS_DESCR STD_AXIS zff_atsys._.iSignale._.obj.sig_n_t8 UMR_U_MIN_32_1_0_S6_S3 8 0 8160 DEPOSIT ABSOLUTE MONOTONY MON_INCREASE /end AXIS_DESCR
 /begin AXIS_DESCR STD_AXIS zff_atsys._.iSignale._.obj.sig_m_t8 UMR_NM__8_1_M50_S6_S3 4 -400 1640 DEPOSIT ABSOLUTE MONOTONY MON_INCREASE /end AXIS_DESCR
/end CHARACTERISTIC
/begin CHARACTERISTIC KL_TVCGMEASPORT_EZA67 "Temperaturabhängige Verzögerungszeit fuer Beginn Haupt-ME" CURVE 0x22AAB4 kl_ui8_S6_S3 2000 UMR_MSEC__10_1_M128_S6_S3 -1000 1000
 /begin AXIS_DESCR STD_AXIS zff_atsys._.iSignale._.obj.sig_c_getr UMR_GRADC__1_1_M40_S6_S3 4 -40 150 DEPOSIT ABSOLUTE MONOTONY MON_INCREASE /end AXIS_DESCR
/end CHARACTERISTIC
/begin CHARACTERISTIC T_FMEHAUPTASPORT_EZA67 "Filterzeit Start Hauptmotoreingriff" VALUE 0x26D7A8 kw_si16_S6_S3 508 UMR_MSEC__1_1_0_S6_S3 -254 254 /end CHARACTERISTIC
/begin CHARACTERISTIC K_FMEHAUPTASPORT_EZA67 "Filterkonstante (aehnl INPT) Start Hauptmotoreingriff" VALUE 0x26D7AA kw_si16_S6_S3 65.535 UMR___1_1000_0_S6_S3 -32.768 32.767 /end CHARACTERISTIC
/begin CHARACTERISTIC KL_TSYNMTMEHAUPTESPORT_EZA78 "Zeit vor Erkennen synchron fuer Ende Haupt-ME" CURVE 0x22AAC0 kl_ui8_S6_S3 1280 UMR_MSEC__10_1_M128_S6_S3 -1280 0
 /begin AXIS_DESCR STD_AXIS zff_atsys._.iSignale._.obj.sig_m_t8 UMR_NM__8_1_M50_S6_S3 6 -400 1640 DEPOSIT ABSOLUTE MONOTONY MON_INCREASE /end AXIS_DESCR
/end CHARACTERISTIC
/begin CHARACTERISTIC KF_FTSYNNTMEHAUPTESPORT_EZA78 "Faktor auf Haupt-ME fuer Nach-ME" MAP 0x22AAD0 kf_si16_S6_S3 1 UMR___1_100_0_S6_S3 0 1
 /begin AXIS_DESCR STD_AXIS iSasZentr.iSchaltend.t_syn UMR_MSEC__10_1_0_S6_S3 6 -5000 5000 DEPOSIT ABSOLUTE MONOTONY MON_INCREASE /end AXIS_DESCR
 /begin AXIS_DESCR STD_AXIS zff_atsys._.iSignale._.obj.sig_n_t UMR_U_MIN_1_1_0_S6_S3 4 0 8160 DEPOSIT ABSOLUTE MONOTONY MON_INCREASE /end AXIS_DESCR
/end CHARACTERISTIC
/begin CHARACTERISTIC KL_TVDKIMEASPORT_EZA78 "Fahrpedalabhängige Verzögerungszeit Start Haupt ME" CURVE 0x22AB1C kl_ui8_S6_S3 2000 UMR_MSEC__10_1_M128_S6_S3 -1000 1000
 /begin AXIS_DESCR STD_AXIS zff_atsys._.iSignale._.obj.sig_dki UMR_PROZENT__20_51_0_S6_S3 4 0 100 DEPOSIT ABSOLUTE MONOTONY MON_INCREASE /end AXIS_DESCR
/end CHARACTERISTIC
/begin CHARACTERISTIC KF_TVMEASPORT_EZA78 "Verzoegerungszeit fuer Beginn Haupt-ME" MAP 0x22AB28 kf_si16_S6_S3 2000 UMR_MSEC__10_1_0_S6_S3 -1000 1000
 /begin AXIS_DESCR STD_AXIS zff_atsys._.iSignale._.obj.sig_n_t8 UMR_U_MIN_32_1_0_S6_S3 8 0 8160 DEPOSIT ABSOLUTE MONOTONY MON_INCREASE /end AXIS_DESCR
 /begin AXIS_DESCR STD_AXIS zff_atsys._.iSignale._.obj.sig_m_t8 UMR_NM__8_1_M50_S6_S3 4 -400 1640 DEPOSIT ABSOLUTE MONOTONY MON_INCREASE /end AXIS_DESCR
/end CHARACTERISTIC
/begin CHARACTERISTIC KL_TVCGMEASPORT_EZA78 "Temperaturabhängige Verzögerungszeit fuer Beginn Haupt-ME" CURVE 0x22AB88 kl_ui8_S6_S3 2000 UMR_MSEC__10_1_M128_S6_S3 -1000 1000
 /begin AXIS_DESCR STD_AXIS zff_atsys._.iSignale._.obj.sig_c_getr UMR_GRADC__1_1_M40_S6_S3 4 -40 150 DEPOSIT ABSOLUTE MONOTONY MON_INCREASE /end AXIS_DESCR
/end CHARACTERISTIC
/begin CHARACTERISTIC T_FMEHAUPTASPORT_EZA78 "Filterzeit Start Hauptmotoreingriff" VALUE 0x26D7AC kw_si16_S6_S3 508 UMR_MSEC__1_1_0_S6_S3 -254 254 /end CHARACTERISTIC
/begin CHARACTERISTIC K_FMEHAUPTASPORT_EZA78 "Filterkonstante (aehnl INPT) Start Hauptmotoreingriff" VALUE 0x26D7AE kw_si16_S6_S3 65.535 UMR___1_1000_0_S6_S3 -32.768 32.767 /end CHARACTERISTIC
/begin CHARACTERISTIC KL_TSYNMTMEHAUPTE_LM12 "Zeit vor Erkennen synchron fuer Ende Haupt-ME" CURVE 0x22AB94 kl_ui8_S6_S3 1280 UMR_MSEC__10_1_M128_S6_S3 -1280 0
 /begin AXIS_DESCR STD_AXIS zff_atsys._.iSignale._.obj.sig_m_t8 UMR_NM__8_1_M50_S6_S3 6 -400 1640 DEPOSIT ABSOLUTE MONOTONY MON_INCREASE /end AXIS_DESCR
/end CHARACTERISTIC
/begin CHARACTERISTIC KF_TVMEA_LM12 "Verzoegerungszeit fuer Beginn Haupt-ME" MAP 0x22ABA4 kf_si16_S6_S3 2000 UMR_MSEC__10_1_0_S6_S3 -1000 1000
 /begin AXIS_DESCR STD_AXIS zff_atsys._.iSignale._.obj.sig_n_t8 UMR_U_MIN_32_1_0_S6_S3 8 0 8160 DEPOSIT ABSOLUTE MONOTONY MON_INCREASE /end AXIS_DESCR
 /begin AXIS_DESCR STD_AXIS zff_atsys._.iSignale._.obj.sig_m_t8 UMR_NM__8_1_M50_S6_S3 4 -400 1640 DEPOSIT ABSOLUTE MONOTONY MON_INCREASE /end AXIS_DESCR
/end CHARACTERISTIC
/begin CHARACTERISTIC KL_TVCGMEA_LM12 "Temperaturabhängige Verzögerungszeit fuer Beginn Haupt-ME" CURVE 0x22AC04 kl_ui8_S6_S3 2000 UMR_MSEC__10_1_M128_S6_S3 -1000 1000
 /begin AXIS_DESCR STD_AXIS zff_atsys._.iSignale._.obj.sig_c_getr UMR_GRADC__1_1_M40_S6_S3 4 -40 150 DEPOSIT ABSOLUTE MONOTONY MON_INCREASE /end AXIS_DESCR
/end CHARACTERISTIC
/begin CHARACTERISTIC T_FMEHAUPTA_LM12 "Filterzeit Start Hauptmotoreingriff" VALUE 0x26D7B0 kw_si16_S6_S3 508 UMR_MSEC__1_1_0_S6_S3 -254 254 /end CHARACTERISTIC
/begin CHARACTERISTIC K_FMEHAUPTA_LM12 "Filterkonstante (aehnl INPT) Start Hauptmotoreingriff" VALUE 0x26D7B2 kw_si16_S6_S3 65.535 UMR___1_1000_0_S6_S3 -32.768 32.767 /end CHARACTERISTIC
/begin CHARACTERISTIC KL_TSYNMTMEHAUPTE_LM23 "Zeit vor Erkennen synchron fuer Ende Haupt-ME" CURVE 0x22AC10 kl_ui8_S6_S3 1280 UMR_MSEC__10_1_M128_S6_S3 -1280 0
 /begin AXIS_DESCR STD_AXIS zff_atsys._.iSignale._.obj.sig_m_t8 UMR_NM__8_1_M50_S6_S3 6 -400 1640 DEPOSIT ABSOLUTE MONOTONY MON_INCREASE /end AXIS_DESCR
/end CHARACTERISTIC
/begin CHARACTERISTIC KF_TVMEA_LM23 "Verzoegerungszeit fuer Beginn Haupt-ME" MAP 0x22AC20 kf_si16_S6_S3 2000 UMR_MSEC__10_1_0_S6_S3 -1000 1000
 /begin AXIS_DESCR STD_AXIS zff_atsys._.iSignale._.obj.sig_n_t8 UMR_U_MIN_32_1_0_S6_S3 8 0 8160 DEPOSIT ABSOLUTE MONOTONY MON_INCREASE /end AXIS_DESCR
 /begin AXIS_DESCR STD_AXIS zff_atsys._.iSignale._.obj.sig_m_t8 UMR_NM__8_1_M50_S6_S3 4 -400 1640 DEPOSIT ABSOLUTE MONOTONY MON_INCREASE /end AXIS_DESCR
/end CHARACTERISTIC
/begin CHARACTERISTIC KL_TVCGMEA_LM23 "Temperaturabhängige Verzögerungszeit fuer Beginn Haupt-ME" CURVE 0x22AC80 kl_ui8_S6_S3 2000 UMR_MSEC__10_1_M128_S6_S3 -1000 1000
 /begin AXIS_DESCR STD_AXIS zff_atsys._.iSignale._.obj.sig_c_getr UMR_GRADC__1_1_M40_S6_S3 4 -40 150 DEPOSIT ABSOLUTE MONOTONY MON_INCREASE /end AXIS_DESCR
/end CHARACTERISTIC
/begin CHARACTERISTIC T_FMEHAUPTA_LM23 "Filterzeit Start Hauptmotoreingriff" VALUE 0x26D7B4 kw_si16_S6_S3 508 UMR_MSEC__1_1_0_S6_S3 -254 254 /end CHARACTERISTIC
/begin CHARACTERISTIC K_FMEHAUPTA_LM23 "Filterkonstante (aehnl INPT) Start Hauptmotoreingriff" VALUE 0x26D7B6 kw_si16_S6_S3 65.535 UMR___1_1000_0_S6_S3 -32.768 32.767 /end CHARACTERISTIC
/begin CHARACTERISTIC KL_TSYNMTMEHAUPTE_LM34 "Zeit vor Erkennen synchron fuer Ende Haupt-ME" CURVE 0x22AC8C kl_ui8_S6_S3 1280 UMR_MSEC__10_1_M128_S6_S3 -1280 0
 /begin AXIS_DESCR STD_AXIS zff_atsys._.iSignale._.obj.sig_m_t8 UMR_NM__8_1_M50_S6_S3 6 -400 1640 DEPOSIT ABSOLUTE MONOTONY MON_INCREASE /end AXIS_DESCR
/end CHARACTERISTIC
/begin CHARACTERISTIC KF_TVMEA_LM34 "Verzoegerungszeit fuer Beginn Haupt-ME" MAP 0x22AC9C kf_si16_S6_S3 2000 UMR_MSEC__10_1_0_S6_S3 -1000 1000
 /begin AXIS_DESCR STD_AXIS zff_atsys._.iSignale._.obj.sig_n_t8 UMR_U_MIN_32_1_0_S6_S3 8 0 8160 DEPOSIT ABSOLUTE MONOTONY MON_INCREASE /end AXIS_DESCR
 /begin AXIS_DESCR STD_AXIS zff_atsys._.iSignale._.obj.sig_m_t8 UMR_NM__8_1_M50_S6_S3 4 -400 1640 DEPOSIT ABSOLUTE MONOTONY MON_INCREASE /end AXIS_DESCR
/end CHARACTERISTIC
/begin CHARACTERISTIC KL_TVCGMEA_LM34 "Temperaturabhängige Verzögerungszeit fuer Beginn Haupt-ME" CURVE 0x22ACFC kl_ui8_S6_S3 2000 UMR_MSEC__10_1_M128_S6_S3 -1000 1000
 /begin AXIS_DESCR STD_AXIS zff_atsys._.iSignale._.obj.sig_c_getr UMR_GRADC__1_1_M40_S6_S3 4 -40 150 DEPOSIT ABSOLUTE MONOTONY MON_INCREASE /end AXIS_DESCR
/end CHARACTERISTIC
/begin CHARACTERISTIC T_FMEHAUPTA_LM34 "Filterzeit Start Hauptmotoreingriff" VALUE 0x26D7B8 kw_si16_S6_S3 508 UMR_MSEC__1_1_0_S6_S3 -254 254 /end CHARACTERISTIC
/begin CHARACTERISTIC K_FMEHAUPTA_LM34 "Filterkonstante (aehnl INPT) Start Hauptmotoreingriff" VALUE 0x26D7BA kw_si16_S6_S3 65.535 UMR___1_1000_0_S6_S3 -32.768 32.767 /end CHARACTERISTIC
/begin CHARACTERISTIC KL_TSYNMTMEHAUPTE_LM45 "Zeit vor Erkennen synchron fuer Ende Haupt-ME" CURVE 0x22AD08 kl_ui8_S6_S3 1280 UMR_MSEC__10_1_M128_S6_S3 -1280 0
 /begin AXIS_DESCR STD_AXIS zff_atsys._.iSignale._.obj.sig_m_t8 UMR_NM__8_1_M50_S6_S3 6 -400 1640 DEPOSIT ABSOLUTE MONOTONY MON_INCREASE /end AXIS_DESCR
/end CHARACTERISTIC
/begin CHARACTERISTIC KF_TVMEA_LM45 "Verzoegerungszeit fuer Beginn Haupt-ME" MAP 0x22AD18 kf_si16_S6_S3 2000 UMR_MSEC__10_1_0_S6_S3 -1000 1000
 /begin AXIS_DESCR STD_AXIS zff_atsys._.iSignale._.obj.sig_n_t8 UMR_U_MIN_32_1_0_S6_S3 8 0 8160 DEPOSIT ABSOLUTE MONOTONY MON_INCREASE /end AXIS_DESCR
 /begin AXIS_DESCR STD_AXIS zff_atsys._.iSignale._.obj.sig_m_t8 UMR_NM__8_1_M50_S6_S3 4 -400 1640 DEPOSIT ABSOLUTE MONOTONY MON_INCREASE /end AXIS_DESCR
/end CHARACTERISTIC
/begin CHARACTERISTIC KL_TVCGMEA_LM45 "Temperaturabhängige Verzögerungszeit fuer Beginn Haupt-ME" CURVE 0x22AD78 kl_ui8_S6_S3 2000 UMR_MSEC__10_1_M128_S6_S3 -1000 1000
 /begin AXIS_DESCR STD_AXIS zff_atsys._.iSignale._.obj.sig_c_getr UMR_GRADC__1_1_M40_S6_S3 4 -40 150 DEPOSIT ABSOLUTE MONOTONY MON_INCREASE /end AXIS_DESCR
/end CHARACTERISTIC
/begin CHARACTERISTIC T_FMEHAUPTA_LM45 "Filterzeit Start Hauptmotoreingriff" VALUE 0x26D7BC kw_si16_S6_S3 508 UMR_MSEC__1_1_0_S6_S3 -254 254 /end CHARACTERISTIC
/begin CHARACTERISTIC K_FMEHAUPTA_LM45 "Filterkonstante (aehnl INPT) Start Hauptmotoreingriff" VALUE 0x26D7BE kw_si16_S6_S3 65.535 UMR___1_1000_0_S6_S3 -32.768 32.767 /end CHARACTERISTIC
/begin CHARACTERISTIC KL_TSYNMTMEHAUPTE_LM56 "Zeit vor Erkennen synchron fuer Ende Haupt-ME" CURVE 0x22AD84 kl_ui8_S6_S3 1280 UMR_MSEC__10_1_M128_S6_S3 -1280 0
 /begin AXIS_DESCR STD_AXIS zff_atsys._.iSignale._.obj.sig_m_t8 UMR_NM__8_1_M50_S6_S3 6 -400 1640 DEPOSIT ABSOLUTE MONOTONY MON_INCREASE /end AXIS_DESCR
/end CHARACTERISTIC
/begin CHARACTERISTIC KF_TVMEA_LM56 "Verzoegerungszeit fuer Beginn Haupt-ME" MAP 0x22AD94 kf_si16_S6_S3 2000 UMR_MSEC__10_1_0_S6_S3 -1000 1000
 /begin AXIS_DESCR STD_AXIS zff_atsys._.iSignale._.obj.sig_n_t8 UMR_U_MIN_32_1_0_S6_S3 8 0 8160 DEPOSIT ABSOLUTE MONOTONY MON_INCREASE /end AXIS_DESCR
 /begin AXIS_DESCR STD_AXIS zff_atsys._.iSignale._.obj.sig_m_t8 UMR_NM__8_1_M50_S6_S3 4 -400 1640 DEPOSIT ABSOLUTE MONOTONY MON_INCREASE /end AXIS_DESCR
/end CHARACTERISTIC
/begin CHARACTERISTIC KL_TVCGMEA_LM56 "Temperaturabhängige Verzögerungszeit fuer Beginn Haupt-ME" CURVE 0x22ADF4 kl_ui8_S6_S3 2000 UMR_MSEC__10_1_M128_S6_S3 -1000 1000
 /begin AXIS_DESCR STD_AXIS zff_atsys._.iSignale._.obj.sig_c_getr UMR_GRADC__1_1_M40_S6_S3 4 -40 150 DEPOSIT ABSOLUTE MONOTONY MON_INCREASE /end AXIS_DESCR
/end CHARACTERISTIC
/begin CHARACTERISTIC T_FMEHAUPTA_LM56 "Filterzeit Start Hauptmotoreingriff" VALUE 0x26D7C0 kw_si16_S6_S3 508 UMR_MSEC__1_1_0_S6_S3 -254 254 /end CHARACTERISTIC
/begin CHARACTERISTIC K_FMEHAUPTA_LM56 "Filterkonstante (aehnl INPT) Start Hauptmotoreingriff" VALUE 0x26D7C2 kw_si16_S6_S3 65.535 UMR___1_1000_0_S6_S3 -32.768 32.767 /end CHARACTERISTIC
/begin CHARACTERISTIC KL_TSYNMTMEHAUPTE_LM67 "Zeit vor Erkennen synchron fuer Ende Haupt-ME" CURVE 0x22AE00 kl_ui8_S6_S3 1280 UMR_MSEC__10_1_M128_S6_S3 -1280 0
 /begin AXIS_DESCR STD_AXIS zff_atsys._.iSignale._.obj.sig_m_t8 UMR_NM__8_1_M50_S6_S3 6 -400 1640 DEPOSIT ABSOLUTE MONOTONY MON_INCREASE /end AXIS_DESCR
/end CHARACTERISTIC
/begin CHARACTERISTIC KF_TVMEA_LM67 "Verzoegerungszeit fuer Beginn Haupt-ME" MAP 0x22AE10 kf_si16_S6_S3 2000 UMR_MSEC__10_1_0_S6_S3 -1000 1000
 /begin AXIS_DESCR STD_AXIS zff_atsys._.iSignale._.obj.sig_n_t8 UMR_U_MIN_32_1_0_S6_S3 8 0 8160 DEPOSIT ABSOLUTE MONOTONY MON_INCREASE /end AXIS_DESCR
 /begin AXIS_DESCR STD_AXIS zff_atsys._.iSignale._.obj.sig_m_t8 UMR_NM__8_1_M50_S6_S3 4 -400 1640 DEPOSIT ABSOLUTE MONOTONY MON_INCREASE /end AXIS_DESCR
/end CHARACTERISTIC
/begin CHARACTERISTIC KL_TVCGMEA_LM67 "Temperaturabhängige Verzögerungszeit fuer Beginn Haupt-ME" CURVE 0x22AE70 kl_ui8_S6_S3 2000 UMR_MSEC__10_1_M128_S6_S3 -1000 1000
 /begin AXIS_DESCR STD_AXIS zff_atsys._.iSignale._.obj.sig_c_getr UMR_GRADC__1_1_M40_S6_S3 4 -40 150 DEPOSIT ABSOLUTE MONOTONY MON_INCREASE /end AXIS_DESCR
/end CHARACTERISTIC
/begin CHARACTERISTIC T_FMEHAUPTA_LM67 "Filterzeit Start Hauptmotoreingriff" VALUE 0x26D7C4 kw_si16_S6_S3 508 UMR_MSEC__1_1_0_S6_S3 -254 254 /end CHARACTERISTIC
/begin CHARACTERISTIC K_FMEHAUPTA_LM67 "Filterkonstante (aehnl INPT) Start Hauptmotoreingriff" VALUE 0x26D7C6 kw_si16_S6_S3 65.535 UMR___1_1000_0_S6_S3 -32.768 32.767 /end CHARACTERISTIC
/begin CHARACTERISTIC KL_TSYNMTMEHAUPTE_LM78 "Zeit vor Erkennen synchron fuer Ende Haupt-ME" CURVE 0x22AE7C kl_ui8_S6_S3 1280 UMR_MSEC__10_1_M128_S6_S3 -1280 0
 /begin AXIS_DESCR STD_AXIS zff_atsys._.iSignale._.obj.sig_m_t8 UMR_NM__8_1_M50_S6_S3 6 -400 1640 DEPOSIT ABSOLUTE MONOTONY MON_INCREASE /end AXIS_DESCR
/end CHARACTERISTIC
/begin CHARACTERISTIC KF_TVMEA_LM78 "Verzoegerungszeit fuer Beginn Haupt-ME" MAP 0x22AE8C kf_si16_S6_S3 2000 UMR_MSEC__10_1_0_S6_S3 -1000 1000
 /begin AXIS_DESCR STD_AXIS zff_atsys._.iSignale._.obj.sig_n_t8 UMR_U_MIN_32_1_0_S6_S3 8 0 8160 DEPOSIT ABSOLUTE MONOTONY MON_INCREASE /end AXIS_DESCR
 /begin AXIS_DESCR STD_AXIS zff_atsys._.iSignale._.obj.sig_m_t8 UMR_NM__8_1_M50_S6_S3 4 -400 1640 DEPOSIT ABSOLUTE MONOTONY MON_INCREASE /end AXIS_DESCR
/end CHARACTERISTIC
/begin CHARACTERISTIC KL_TVCGMEA_LM78 "Temperaturabhängige Verzögerungszeit fuer Beginn Haupt-ME" CURVE 0x22AEEC kl_ui8_S6_S3 2000 UMR_MSEC__10_1_M128_S6_S3 -1000 1000
 /begin AXIS_DESCR STD_AXIS zff_atsys._.iSignale._.obj.sig_c_getr UMR_GRADC__1_1_M40_S6_S3 4 -40 150 DEPOSIT ABSOLUTE MONOTONY MON_INCREASE /end AXIS_DESCR
/end CHARACTERISTIC
/begin CHARACTERISTIC T_FMEHAUPTA_LM78 "Filterzeit Start Hauptmotoreingriff" VALUE 0x26D7C8 kw_si16_S6_S3 508 UMR_MSEC__1_1_0_S6_S3 -254 254 /end CHARACTERISTIC
/begin CHARACTERISTIC K_FMEHAUPTA_LM78 "Filterkonstante (aehnl INPT) Start Hauptmotoreingriff" VALUE 0x26D7CA kw_si16_S6_S3 65.535 UMR___1_1000_0_S6_S3 -32.768 32.767 /end CHARACTERISTIC
/begin CHARACTERISTIC ND_MEHAUPTAGE_R "Drehzahlkriterium Start Haupt-ME Gangeinlegen" VALUE 0x26D7E6 kw_si16_S6_S3 1000 UMR_U_MIN_1_1_0_S6_S3 0 1000 /end CHARACTERISTIC
/begin CHARACTERISTIC T_RAMEE_R "Dauer Rampe ME bei Ende Gangeinlegen" VALUE 0x26E574 kw_ui8_S6_S3 2540 UMR_MSEC__10_1_0_S6_S3 0 2540 /end CHARACTERISTIC
/begin CHARACTERISTIC T_FMEHAUPTA_R "Filterzeit Start Hauptmotoreingriff" VALUE 0x26D7E8 kw_si16_S6_S3 508 UMR_MSEC__1_1_0_S6_S3 -254 254 /end CHARACTERISTIC
/begin CHARACTERISTIC K_FMEHAUPTA_R "Filterkonstante (aehnl INPT) Start Hauptmotoreingriff" VALUE 0x26D7EA kw_si16_S6_S3 65.535 UMR___1_1000_0_S6_S3 -32.768 32.767 /end CHARACTERISTIC
/begin CHARACTERISTIC KF_FMEHAUPTGEDKINMOT_R "Faktor auf Haupt-ME f(dki) Gangeinlegen D1 bis D6" MAP 0x22BAFC kf_ui8_S6_S3 100 UMR_PROZENT__20_51_0_S6_S3 0 100
 /begin AXIS_DESCR STD_AXIS zff_atsys._.iSignale._.obj.sig_dki UMR_PROZENT__20_51_0_S6_S3 4 0 100 DEPOSIT ABSOLUTE MONOTONY MON_INCREASE /end AXIS_DESCR
 /begin AXIS_DESCR STD_AXIS zff_atsys._.iSignale._.obj.sig_n_mot8 UMR_U_MIN_32_1_0_S6_S3 4 0 8160 DEPOSIT ABSOLUTE MONOTONY MON_INCREASE /end AXIS_DESCR
/end CHARACTERISTIC
/begin CHARACTERISTIC KF_MEHAUPT_R "Hauptmotoreingriff Schaltablauf" MAP 0x22BB1C kf_ui8_S6_S3 870 UMR_NM__6_1_M145_S6_S3 -870 0
 /begin AXIS_DESCR STD_AXIS NO_INPUT_QUANTITY UMR_U_MIN_32_1_0_S6_S3 6 0 8160 DEPOSIT ABSOLUTE MONOTONY MON_INCREASE /end AXIS_DESCR
 /begin AXIS_DESCR STD_AXIS zff_atsys._.iSignale._.obj.sig_m_t8 UMR_NM__8_1_M50_S6_S3 6 -400 1640 DEPOSIT ABSOLUTE MONOTONY MON_INCREASE /end AXIS_DESCR
/end CHARACTERISTIC
/begin CHARACTERISTIC KF_FTSYNNTMEHAUPTE_R "Faktor auf Haupt-ME fuer Nach-ME" MAP 0x22BB54 kf_si16_S6_S3 1 UMR___1_100_0_S6_S3 0 1
 /begin AXIS_DESCR STD_AXIS iSasZentr.iSchaltend.t_syn UMR_MSEC__10_1_0_S6_S3 4 -5000 5000 DEPOSIT ABSOLUTE MONOTONY MON_INCREASE /end AXIS_DESCR
 /begin AXIS_DESCR STD_AXIS zff_atsys._.iSignale._.obj.sig_n_t UMR_U_MIN_1_1_0_S6_S3 4 0 8160 DEPOSIT ABSOLUTE MONOTONY MON_INCREASE /end AXIS_DESCR
/end CHARACTERISTIC
/begin CHARACTERISTIC KL_TSYNMTMEHAUPTE_R "Zeit vor Erkennen synchron fuer Ende Haupt-ME" CURVE 0x22BB8C kl_ui8_S6_S3 1280 UMR_MSEC__10_1_M128_S6_S3 -1280 0
 /begin AXIS_DESCR STD_AXIS zff_atsys._.iSignale._.obj.sig_m_t8 UMR_NM__8_1_M50_S6_S3 6 -400 1640 DEPOSIT ABSOLUTE MONOTONY MON_INCREASE /end AXIS_DESCR
/end CHARACTERISTIC
/begin CHARACTERISTIC KL_TVMEA_R "Verzoegerungszeit fuer Beginn Haupt-ME" CURVE 0x22BB9C kl_si16_S6_S3 2000 UMR_MSEC__10_1_0_S6_S3 -1000 1000
 /begin AXIS_DESCR STD_AXIS zff_atsys._.iSignale._.obj.sig_n_t8 UMR_U_MIN_32_1_0_S6_S3 8 0 8160 DEPOSIT ABSOLUTE MONOTONY MON_INCREASE /end AXIS_DESCR
/end CHARACTERISTIC
/begin CHARACTERISTIC T_SPERRSYN_R "Sperrzeit ende Haupt-ME GE" VALUE 0x26E575 kw_ui8_S6_S3 2540 UMR_MSEC__10_1_0_S6_S3 0 2540 /end CHARACTERISTIC
/begin CHARACTERISTIC ND_MEHAUPTAGE_1 "Drehzahlkriterium Start Haupt-ME Gangeinlegen" VALUE 0x26D7EC kw_si16_S6_S3 1000 UMR_U_MIN_1_1_0_S6_S3 0 1000 /end CHARACTERISTIC
/begin CHARACTERISTIC T_RAMEE_1 "Dauer Rampe ME bei Ende Gangeinlegen" VALUE 0x26E576 kw_ui8_S6_S3 2540 UMR_MSEC__10_1_0_S6_S3 0 2540 /end CHARACTERISTIC
/begin CHARACTERISTIC T_FMEHAUPTA_1 "Filterzeit Start Hauptmotoreingriff" VALUE 0x26D7EE kw_si16_S6_S3 508 UMR_MSEC__1_1_0_S6_S3 -254 254 /end CHARACTERISTIC
/begin CHARACTERISTIC K_FMEHAUPTA_1 "Filterkonstante (aehnl INPT) Start Hauptmotoreingriff" VALUE 0x26D7F0 kw_si16_S6_S3 65.535 UMR___1_1000_0_S6_S3 -32.768 32.767 /end CHARACTERISTIC
/begin CHARACTERISTIC KF_FMEHAUPTGEDKINMOT_1 "Faktor auf Haupt-ME f(dki) Gangeinlegen D1 bis D6" MAP 0x22BBC0 kf_ui8_S6_S3 100 UMR_PROZENT__20_51_0_S6_S3 0 100
 /begin AXIS_DESCR STD_AXIS zff_atsys._.iSignale._.obj.sig_dki UMR_PROZENT__20_51_0_S6_S3 4 0 100 DEPOSIT ABSOLUTE MONOTONY MON_INCREASE /end AXIS_DESCR
 /begin AXIS_DESCR STD_AXIS zff_atsys._.iSignale._.obj.sig_n_mot8 UMR_U_MIN_32_1_0_S6_S3 4 0 8160 DEPOSIT ABSOLUTE MONOTONY MON_INCREASE /end AXIS_DESCR
/end CHARACTERISTIC
/begin CHARACTERISTIC KF_MEHAUPT_1 "Hauptmotoreingriff Schaltablauf" MAP 0x22BBE0 kf_ui8_S6_S3 870 UMR_NM__6_1_M145_S6_S3 -870 0
 /begin AXIS_DESCR STD_AXIS NO_INPUT_QUANTITY UMR_U_MIN_32_1_0_S6_S3 6 0 8160 DEPOSIT ABSOLUTE MONOTONY MON_INCREASE /end AXIS_DESCR
 /begin AXIS_DESCR STD_AXIS zff_atsys._.iSignale._.obj.sig_m_t8 UMR_NM__8_1_M50_S6_S3 6 -400 1640 DEPOSIT ABSOLUTE MONOTONY MON_INCREASE /end AXIS_DESCR
/end CHARACTERISTIC
/begin CHARACTERISTIC KF_FTSYNNTMEHAUPTE_1 "Faktor auf Haupt-ME fuer Nach-ME" MAP 0x22BC18 kf_si16_S6_S3 1 UMR___1_100_0_S6_S3 0 1
 /begin AXIS_DESCR STD_AXIS iSasZentr.iSchaltend.t_syn UMR_MSEC__10_1_0_S6_S3 4 -5000 5000 DEPOSIT ABSOLUTE MONOTONY MON_INCREASE /end AXIS_DESCR
 /begin AXIS_DESCR STD_AXIS zff_atsys._.iSignale._.obj.sig_n_t UMR_U_MIN_1_1_0_S6_S3 4 0 8160 DEPOSIT ABSOLUTE MONOTONY MON_INCREASE /end AXIS_DESCR
/end CHARACTERISTIC
/begin CHARACTERISTIC KL_TSYNMTMEHAUPTE_1 "Zeit vor Erkennen synchron fuer Ende Haupt-ME" CURVE 0x22BC50 kl_ui8_S6_S3 1280 UMR_MSEC__10_1_M128_S6_S3 -1280 0
 /begin AXIS_DESCR STD_AXIS zff_atsys._.iSignale._.obj.sig_m_t8 UMR_NM__8_1_M50_S6_S3 6 -400 1640 DEPOSIT ABSOLUTE MONOTONY MON_INCREASE /end AXIS_DESCR
/end CHARACTERISTIC
/begin CHARACTERISTIC KL_TVMEA_1 "Verzoegerungszeit fuer Beginn Haupt-ME" CURVE 0x22BC60 kl_si16_S6_S3 2000 UMR_MSEC__10_1_0_S6_S3 -1000 1000
 /begin AXIS_DESCR STD_AXIS zff_atsys._.iSignale._.obj.sig_n_t8 UMR_U_MIN_32_1_0_S6_S3 8 0 8160 DEPOSIT ABSOLUTE MONOTONY MON_INCREASE /end AXIS_DESCR
/end CHARACTERISTIC
/begin CHARACTERISTIC T_SPERRSYN_1 "Sperrzeit ende Haupt-ME GE" VALUE 0x26E577 kw_ui8_S6_S3 2540 UMR_MSEC__10_1_0_S6_S3 0 2540 /end CHARACTERISTIC
/begin COMPU_METHOD SAB_A_24MPSS1000_2016M1000_S2_S3 "int = ((phys * 1000) / 24) - (-84) m/s^2" RAT_FUNC "%5.3" "m/s^2" COEFFS 0 1000 2016 0 0 24 /end COMPU_METHOD
/begin COMPU_METHOD SAB_A_24MPSS1000_M3980_S2_S3 "int = ((phys * 1000) / 24) - (-166) m/s^2" RAT_FUNC "%5.3" "m/s^2" COEFFS 0 1000 3984 0 0 24 /end COMPU_METHOD
/begin COMPU_METHOD SAB_A_24MPSS1000_S2_S3 "int = ((phys * 1000) / 24) - (0) m/s^2" RAT_FUNC "%5.3" "m/s^2" COEFFS 0 1000 -0 0 0 24 /end COMPU_METHOD
/begin COMPU_METHOD SAB_A_24MPSS1000_3984M1000_S2_S3 "int = ((phys * 1000) / 24) - (-166) m/s^2" RAT_FUNC "%5.3" "m/s^2" COEFFS 0 1000 3984 0 0 24 /end COMPU_METHOD
/begin COMPU_METHOD SAB_A_MPSS40_S2_S3 "int = ((phys * 40) / 1) - (0) m/s^2" RAT_FUNC "%5.3" "m/s^2" COEFFS 0 40 -0 0 0 1 /end COMPU_METHOD
/begin COMPU_METHOD SAB_A_MPSS100_S2_S3 "int = ((phys * 100) / 1) - (0) m/s^2" RAT_FUNC "%5.3" "m/s^2" COEFFS 0 100 -0 0 0 1 /end COMPU_METHOD
/begin COMPU_METHOD SAB_A_478G10000_M512_S2_S3 "int = ((phys * 10000) / 478) - (-512) m/s^2" RAT_FUNC "%5.3" "m/s^2" COEFFS 0 10000 244736 0 0 478 /end COMPU_METHOD
/begin COMPU_METHOD SAB_A_478515625MPSS10000000000_245M10_S2_S3 "int = ((phys * 1.0E10) / 4.78515625E8) - (-512) m/s^2" RAT_FUNC "%5.3" "m/s^2" COEFFS 0 10000000000 245000000000 0 0 478515625 /end COMPU_METHOD
/begin COMPU_METHOD SAB_A_MPSS800_1024M100_S2_S3 "int = ((phys * 100) / 8) - (-128) m/s^2" RAT_FUNC "%5.3" "m/s^2" COEFFS 0 100 1024 0 0 8 /end COMPU_METHOD
/begin COMPU_METHOD UMR___1_1000_0_S6_S3 "int = ((phys * 1000) / 1) - (0) [-]" RAT_FUNC "%5.3" "[-]" COEFFS 0 1000 -0 0 0 1 /end COMPU_METHOD
/begin COMPU_METHOD UMR___1_100_0_S6_S3 "int = ((phys * 100) / 1) - (0) [-]" RAT_FUNC "%4.2" "[-]" COEFFS 0 100 -0 0 0 1 /end COMPU_METHOD
/begin COMPU_METHOD UMR___1_1_0_S6_S3 "int = ((phys * 1) / 1) - (0) [-]" RAT_FUNC "%2.0" "[-]" COEFFS 0 1 -0 0 0 1 /end COMPU_METHOD
/begin COMPU_METHOD UMR_NM__1_1_0_S6_S3 "int = ((phys * 1) / 1) - (0) [Nm]" RAT_FUNC "%2.0" "[Nm]" COEFFS 0 1 -0 0 0 1 /end COMPU_METHOD
/begin COMPU_METHOD UMR_NM__6_1_M145_S6_S3 "int = ((phys * 1) / 6) - (-145) [Nm]" RAT_FUNC "%2.0" "[Nm]" COEFFS 0 1 870 0 0 6 /end COMPU_METHOD
/begin COMPU_METHOD UMR_NM__8_1_M50_S6_S3 "int = ((phys * 1) / 8) - (-50) [Nm]" RAT_FUNC "%2.0" "[Nm]" COEFFS 0 1 400 0 0 8 /end COMPU_METHOD
/begin COMPU_METHOD UMR_U_MIN_1_1_0_S6_S3 "int = ((phys * 1) / 1) - (0) [U/min]" RAT_FUNC "%2.0" "[U/min]" COEFFS 0 1 -0 0 0 1 /end COMPU_METHOD
/begin COMPU_METHOD UMR_U_MIN_32_1_0_S6_S3 "int = ((phys * 1) / 32) - (0) [U/min]" RAT_FUNC "%2.0" "[U/min]" COEFFS 0 1 -0 0 0 32 /end COMPU_METHOD
/begin COMPU_METHOD UMR_U_MINSEC_1_1_0_S6_S3 "int = ((phys * 1) / 1) - (0) [U/(min*s)]" RAT_FUNC "%2.0" "[U/(min*s)]" COEFFS 0 1 -0 0 0 1 /end COMPU_METHOD
/begin COMPU_METHOD UMR_MSEC__1_1_0_S6_S3 "int = ((phys * 1) / 1) - (0) [ms]" RAT_FUNC "%2.0" "[ms]" COEFFS 0 1 -0 0 0 1 /end COMPU_METHOD
/begin COMPU_METHOD UMR_MSEC__10_1_0_S6_S3 "int = ((phys * 1) / 10) - (0) [ms]" RAT_FUNC "%2.0" "[ms]" COEFFS 0 1 -0 0 0 10 /end COMPU_METHOD
/begin COMPU_METHOD UMR_MSEC__10_1_M128_S6_S3 "int = ((phys * 1) / 10) - (-128) [ms]" RAT_FUNC "%2.0" "[ms]" COEFFS 0 1 1280 0 0 10 /end COMPU_METHOD
/begin COMPU_METHOD UMR_GRADC__1_1_M40_S6_S3 "int = ((phys * 1) / 1) - (-40) [°C]" RAT_FUNC "%2.0" "[°C]" COEFFS 0 1 40 0 0 1 /end COMPU_METHOD
/begin COMPU_METHOD UMR_GRADC__1_1_M48_S6_S3 "int = ((phys * 1) / 1) - (-48) [°C]" RAT_FUNC "%2.0" "[°C]" COEFFS 0 1 48 0 0 1 /end COMPU_METHOD
/begin COMPU_METHOD UMR_PROZENT__20_51_0_S6_S3 "int = ((phys * 51) / 20) - (0) [%]" RAT_FUNC "%6.4" "[%]" COEFFS 0 51 -0 0 0 20 /end COMPU_METHOD
/begin FUNCTION jMoeSasAl_Fktn "Applikationesgroessen Instanz jMoeSasAl"
 /begin DEF_CHARACTERISTIC CS_MEPOS HYS_MSMMOT_LRHS KL_FMENDIAE KL_MEKREDCM_D KL_MEKREDCM_R KL_UNTERDRNGNMOT ND_MEPOSHAUPTA NS_HYS_UNTERDR_ME SWI_MEKLASS SWI_ME_EZAQS0_KLASS SWI_MSTSSCHR SWI_UNTERDR_ME TAB_MSMMOT_LRHS TAB_SWI_MEPOSHS TAB_SWI_MEPOSHSVOR TAB_SWI_MEPOSRS TAB_SWI_MEPOSRSVOR TAB_SWI_MEQS0LM_KLASS T_FNGABMESAS T_MEMAXHSGE T_MEMAXRS /end DEF_CHARACTERISTIC
/end FUNCTION
/begin FUNCTION dMoeMekHSP_Fktn "Applikationesgroessen der Komponente dMoeMekHSP"
 /begin SUB_FUNCTION jMoeZwrHSP112_Fktn jMoeZwrHSP123_Fktn jMoeZwrHSP134_Fktn jMoeZwrHSP145_Fktn jMoeZwrHSP156_Fktn jMoeZwrHSP167_Fktn jMoeZwrHSP178_Fktn jMoeZwrHSP113_Fktn jMoeZwrHSP124_Fktn jMoeZwrHSP135_Fktn jMoeZwrHSP146_Fktn jMoeZwrHSP157_Fktn jMoeZwrHSP168_Fktn jMoeZwrHSP212_Fktn jMoeZwrHSP223_Fktn jMoeZwrHSP234_Fktn jMoeZwrHSP245_Fktn jMoeZwrHSP256_Fktn jMoeZwrHSP267_Fktn jMoeZwrHSP278_Fktn jMoeZwrHSP213_Fktn jMoeZwrHSP224_Fktn jMoeZwrHSP235_Fktn jMoeZwrHSP246_Fktn jMoeZwrHSP257_Fktn jMoeZwrHSP268_Fktn jMoeZwrHSP312_Fktn jMoeZwrHSP323_Fktn jMoeZwrHSP334_Fktn jMoeZwrHSP345_Fktn jMoeZwrHSP356_Fktn jMoeZwrHSP367_Fktn jMoeZwrHSP378_Fktn jMoeZwrHSP313_Fktn jMoeZwrHSP324_Fktn jMoeZwrHSP335_Fktn jMoeZwrHSP346_Fktn jMoeZwrHSP357_Fktn jMoeZwrHSP368_Fktn jMoeEzaHSP112_Fktn jMoeEzaHSP123_Fktn jMoeEzaHSP134_Fktn jMoeEzaHSP145_Fktn jMoeEzaHSP156_Fktn jMoeEzaHSP167_Fktn jMoeEzaHSP178_Fktn jMoeEzaHSP212_Fktn jMoeEzaHSP223_Fktn jMoeEzaHSP234_Fktn jMoeEzaHSP245_Fktn jMoeEzaHSP256_Fktn jMoeEzaHSP267_Fktn jMoeEzaHSP278_Fktn jMoeEzaHSP312_Fktn jMoeEzaHSP323_Fktn jMoeEzaHSP334_Fktn jMoeEzaHSP345_Fktn jMoeEzaHSP356_Fktn jMoeEzaHSP367_Fktn jMoeEzaHSP378_Fktn jMoeLMeHSP112_Fktn jMoeLMeHSP123_Fktn jMoeLMeHSP134_Fktn jMoeLMeHSP145_Fktn jMoeLMeHSP156_Fktn jMoeLMeHSP167_Fktn jMoeLMeHSP178_Fktn /end SUB_FUNCTION
/end FUNCTION
/begin FUNCTION jMoeZwrHSP112_Fktn "Applikationesgroessen Instanz jMoeZwrHSP112"
 /begin DEF_CHARACTERISTIC KF_FTSYNNTMEHAUPTE12 KF_FTSYNNTMEHAUPTE12_EL KF_TVMEA12 KF_TVMEA12_EL KL_TSYNMTMEHAUPTE12 KL_TSYNMTMEHAUPTE12_EL KL_TVCGMEA12 KL_TVDKIMEA12 K_FMEHAUPTA12 K_FMEHAUPTA12_EL T_FMEHAUPTA12 /end DEF_CHARACTERISTIC
/end FUNCTION
/begin FUNCTION jMoeZwrHSP123_Fktn "Applikationesgroessen Instanz jMoeZwrHSP123"
 /begin DEF_CHARACTERISTIC KF_FTSYNNTMEHAUPTE23 KF_FTSYNNTMEHAUPTE23_EL KF_TVMEA23 KF_TVMEA23_EL KL_TSYNMTMEHAUPTE23 KL_TSYNMTMEHAUPTE23_EL KL_TVCGMEA23 KL_TVDKIMEA23 K_FMEHAUPTA23 K_FMEHAUPTA23_EL T_FMEHAUPTA23 /end DEF_CHARACTERISTIC
/end FUNCTION
/begin FUNCTION jMoeZwrHSP134_Fktn "Applikationesgroessen Instanz jMoeZwrHSP134"
 /begin DEF_CHARACTERISTIC KF_FTSYNNTMEHAUPTE34 KF_FTSYNNTMEHAUPTE34_EL KF_TVMEA34 KF_TVMEA34_EL KL_TSYNMTMEHAUPTE34 KL_TSYNMTMEHAUPTE34_EL KL_TVCGMEA34 KL_TVDKIMEA34 K_FMEHAUPTA34 K_FMEHAUPTA34_EL T_FMEHAUPTA34 /end DEF_CHARACTERISTIC
/end FUNCTION
/begin FUNCTION jMoeZwrHSP145_Fktn "Applikationesgroessen Instanz jMoeZwrHSP145"
 /begin DEF_CHARACTERISTIC KF_FTSYNNTMEHAUPTE45 KF_FTSYNNTMEHAUPTE45_EL KF_TVMEA45 KF_TVMEA45_EL KL_TSYNMTMEHAUPTE45 KL_TSYNMTMEHAUPTE45_EL KL_TVCGMEA45 KL_TVDKIMEA45 K_FMEHAUPTA45 K_FMEHAUPTA45_EL T_FMEHAUPTA45 /end DEF_CHARACTERISTIC
/end FUNCTION
/begin FUNCTION jMoeZwrHSP156_Fktn "Applikationesgroessen Instanz jMoeZwrHSP156"
 /begin DEF_CHARACTERISTIC KF_FTSYNNTMEHAUPTE56 KF_FTSYNNTMEHAUPTE56_EL KF_TVMEA56 KF_TVMEA56_EL KL_TSYNMTMEHAUPTE56 KL_TSYNMTMEHAUPTE56_EL KL_TVCGMEA56 KL_TVDKIMEA56 K_FMEHAUPTA56 K_FMEHAUPTA56_EL T_FMEHAUPTA56 /end DEF_CHARACTERISTIC
/end FUNCTION
/begin FUNCTION jMoeZwrHSP167_Fktn "Applikationesgroessen Instanz jMoeZwrHSP167"
 /begin DEF_CHARACTERISTIC KF_FTSYNNTMEHAUPTE67 KF_FTSYNNTMEHAUPTE67_EL KF_TVMEA67 KF_TVMEA67_EL KL_TSYNMTMEHAUPTE67 KL_TSYNMTMEHAUPTE67_EL KL_TVCGMEA67 KL_TVDKIMEA67 K_FMEHAUPTA67 K_FMEHAUPTA67_EL T_FMEHAUPTA67 /end DEF_CHARACTERISTIC
/end FUNCTION
/begin FUNCTION jMoeZwrHSP178_Fktn "Applikationesgroessen Instanz jMoeZwrHSP178"
 /begin DEF_CHARACTERISTIC KF_FTSYNNTMEHAUPTE78 KF_FTSYNNTMEHAUPTE78_EL KF_TVMEA78 KF_TVMEA78_EL KL_TSYNMTMEHAUPTE78 KL_TSYNMTMEHAUPTE78_EL KL_TVCGMEA78 KL_TVDKIMEA78 K_FMEHAUPTA78 K_FMEHAUPTA78_EL T_FMEHAUPTA78 /end DEF_CHARACTERISTIC
/end FUNCTION
/begin FUNCTION jMoeZwrHSP113_Fktn "Applikationesgroessen Instanz jMoeZwrHSP113"
 /begin DEF_CHARACTERISTIC KF_FTSYNNTMEHAUPTE13 KF_TVMEA13 KL_TSYNMTMEHAUPTE13 KL_TVCGMEA13 KL_TVDKIMEA13 K_FMEHAUPTA13 T_FMEHAUPTA13 /end DEF_CHARACTERISTIC
/end FUNCTION
/begin FUNCTION jMoeZwrHSP124_Fktn "Applikationesgroessen Instanz jMoeZwrHSP124"
 /begin DEF_CHARACTERISTIC KF_FTSYNNTMEHAUPTE24 KF_TVMEA24 KL_TSYNMTMEHAUPTE24 KL_TVCGMEA24 KL_TVDKIMEA24 K_FMEHAUPTA24 T_FMEHAUPTA24 /end DEF_CHARACTERISTIC
/end FUNCTION
/begin FUNCTION jMoeZwrHSP135_Fktn "Applikationesgroessen Instanz jMoeZwrHSP135"
 /begin DEF_CHARACTERISTIC KF_FTSYNNTMEHAUPTE35 KF_TVMEA35 KL_TSYNMTMEHAUPTE35 KL_TVCGMEA35 KL_TVDKIMEA35 K_FMEHAUPTA35 T_FMEHAUPTA35 /end DEF_CHARACTERISTIC
/end FUNCTION
/begin FUNCTION jMoeZwrHSP146_Fktn "Applikationesgroessen Instanz jMoeZwrHSP146"
 /begin DEF_CHARACTERISTIC KF_FTSYNNTMEHAUPTE46 KF_TVMEA46 KL_TSYNMTMEHAUPTE46 KL_TVCGMEA46 KL_TVDKIMEA46 K_FMEHAUPTA46 T_FMEHAUPTA46 /end DEF_CHARACTERISTIC
/end FUNCTION
/begin FUNCTION jMoeZwrHSP157_Fktn "Applikationesgroessen Instanz jMoeZwrHSP157"
 /begin DEF_CHARACTERISTIC KF_FTSYNNTMEHAUPTE57 KF_TVMEA57 KL_TSYNMTMEHAUPTE57 KL_TVCGMEA57 KL_TVDKIMEA57 K_FMEHAUPTA57 T_FMEHAUPTA57 /end DEF_CHARACTERISTIC
/end FUNCTION
/begin FUNCTION jMoeZwrHSP168_Fktn "Applikationesgroessen Instanz jMoeZwrHSP168"
 /begin DEF_CHARACTERISTIC KF_FTSYNNTMEHAUPTE68 KF_TVMEA68 KL_TSYNMTMEHAUPTE68 KL_TVCGMEA68 KL_TVDKIMEA68 K_FMEHAUPTA68 T_FMEHAUPTA68 /end DEF_CHARACTERISTIC
/end FUNCTION
/begin FUNCTION jMoeZwrHSP212_Fktn "Applikationesgroessen Instanz jMoeZwrHSP212"
 /begin DEF_CHARACTERISTIC KF_FTSYNNTMEHAUPTESP12 KF_TVMEASP12 KL_TSYNMTMEHAUPTESP12 KL_TVCGMEASP12 KL_TVDKIMEASP12 K_FMEHAUPTASP12 T_FMEHAUPTASP12 /end DEF_CHARACTERISTIC
/end FUNCTION
/begin FUNCTION jMoeZwrHSP223_Fktn "Applikationesgroessen Instanz jMoeZwrHSP223"
 /begin DEF_CHARACTERISTIC KF_FTSYNNTMEHAUPTESP23 KF_TVMEASP23 KL_TSYNMTMEHAUPTESP23 KL_TVCGMEASP23 KL_TVDKIMEASP23 K_FMEHAUPTASP23 T_FMEHAUPTASP23 /end DEF_CHARACTERISTIC
/end FUNCTION
/begin FUNCTION jMoeZwrHSP234_Fktn "Applikationesgroessen Instanz jMoeZwrHSP234"
 /begin DEF_CHARACTERISTIC KF_FTSYNNTMEHAUPTESP34 KF_TVMEASP34 KL_TSYNMTMEHAUPTESP34 KL_TVCGMEASP34 KL_TVDKIMEASP34 K_FMEHAUPTASP34 T_FMEHAUPTASP34 /end DEF_CHARACTERISTIC
/end FUNCTION
/begin FUNCTION jMoeZwrHSP245_Fktn "Applikationesgroessen Instanz jMoeZwrHSP245"
 /begin DEF_CHARACTERISTIC KF_FTSYNNTMEHAUPTESP45 KF_TVMEASP45 KL_TSYNMTMEHAUPTESP45 KL_TVCGMEASP45 KL_TVDKIMEASP45 K_FMEHAUPTASP45 T_FMEHAUPTASP45 /end DEF_CHARACTERISTIC
/end FUNCTION
/begin FUNCTION jMoeZwrHSP256_Fktn "Applikationesgroessen Instanz jMoeZwrHSP256"
 /begin DEF_CHARACTERISTIC KF_FTSYNNTMEHAUPTESP56 KF_TVMEASP56 KL_TSYNMTMEHAUPTESP56 KL_TVCGMEASP56 KL_TVDKIMEASP56 K_FMEHAUPTASP56 T_FMEHAUPTASP56 /end DEF_CHARACTERISTIC
/end FUNCTION
/begin FUNCTION jMoeZwrHSP267_Fktn "Applikationesgroessen Instanz jMoeZwrHSP267"
 /begin DEF_CHARACTERISTIC KF_FTSYNNTMEHAUPTESP67 KF_TVMEASP67 KL_TSYNMTMEHAUPTESP67 KL_TVCGMEASP67 KL_TVDKIMEASP67 K_FMEHAUPTASP67 T_FMEHAUPTASP67 /end DEF_CHARACTERISTIC
/end FUNCTION
/begin FUNCTION jMoeZwrHSP278_Fktn "Applikationesgroessen Instanz jMoeZwrHSP278"
 /begin DEF_CHARACTERISTIC KF_FTSYNNTMEHAUPTESP78 KF_TVMEASP78 KL_TSYNMTMEHAUPTESP78 KL_TVCGMEASP78 KL_TVDKIMEASP78 K_FMEHAUPTASP78 T_FMEHAUPTASP78 /end DEF_CHARACTERISTIC
/end FUNCTION
/begin FUNCTION jMoeZwrHSP213_Fktn "Applikationesgroessen Instanz jMoeZwrHSP213"
 /begin DEF_CHARACTERISTIC KF_FTSYNNTMEHAUPTESP13 KF_TVMEASP13 KL_TSYNMTMEHAUPTESP13 KL_TVCGMEASP13 KL_TVDKIMEASP13 K_FMEHAUPTASP13 T_FMEHAUPTASP13 /end DEF_CHARACTERISTIC
/end FUNCTION
/begin FUNCTION jMoeZwrHSP224_Fktn "Applikationesgroessen Instanz jMoeZwrHSP224"
 /begin DEF_CHARACTERISTIC KF_FTSYNNTMEHAUPTESP24 KF_TVMEASP24 KL_TSYNMTMEHAUPTESP24 KL_TVCGMEASP24 KL_TVDKIMEASP24 K_FMEHAUPTASP24 T_FMEHAUPTASP24 /end DEF_CHARACTERISTIC
/end FUNCTION
/begin FUNCTION jMoeZwrHSP235_Fktn "Applikationesgroessen Instanz jMoeZwrHSP235"
 /begin DEF_CHARACTERISTIC KF_FTSYNNTMEHAUPTESP35 KF_TVMEASP35 KL_TSYNMTMEHAUPTESP35 KL_TVCGMEASP35 KL_TVDKIMEASP35 K_FMEHAUPTASP35 T_FMEHAUPTASP35 /end DEF_CHARACTERISTIC
/end FUNCTION
/begin FUNCTION jMoeZwrHSP246_Fktn "Applikationesgroessen Instanz jMoeZwrHSP246"
 /begin DEF_CHARACTERISTIC KF_FTSYNNTMEHAUPTESP46 KF_TVMEASP46 KL_TSYNMTMEHAUPTESP46 KL_TVCGMEASP46 KL_TVDKIMEASP46 K_FMEHAUPTASP46 T_FMEHAUPTASP46 /end DEF_CHARACTERISTIC
/end FUNCTION
/begin FUNCTION jMoeZwrHSP257_Fktn "Applikationesgroessen Instanz jMoeZwrHSP257"
 /begin DEF_CHARACTERISTIC KF_FTSYNNTMEHAUPTESP57 KF_TVMEASP57 KL_TSYNMTMEHAUPTESP57 KL_TVCGMEASP57 KL_TVDKIMEASP57 K_FMEHAUPTASP57 T_FMEHAUPTASP57 /end DEF_CHARACTERISTIC
/end FUNCTION
/begin FUNCTION jMoeZwrHSP268_Fktn "Applikationesgroessen Instanz jMoeZwrHSP268"
 /begin DEF_CHARACTERISTIC KF_FTSYNNTMEHAUPTESP68 KF_TVMEASP68 KL_TSYNMTMEHAUPTESP68 KL_TVCGMEASP68 KL_TVDKIMEASP68 K_FMEHAUPTASP68 T_FMEHAUPTASP68 /end DEF_CHARACTERISTIC
/end FUNCTION
/begin FUNCTION jMoeZwrHSP312_Fktn "Applikationesgroessen Instanz jMoeZwrHSP312"
 /begin DEF_CHARACTERISTIC KF_FTSYNNTMEHAUPTESPORT12 KF_TVMEASPORT12 KL_TSYNMTMEHAUPTESPORT12 KL_TVCGMEASPORT12 KL_TVDKIMEASPORT12 K_FMEHAUPTASPORT12 T_FMEHAUPTASPORT12 /end DEF_CHARACTERISTIC
/end FUNCTION
/begin FUNCTION jMoeZwrHSP323_Fktn "Applikationesgroessen Instanz jMoeZwrHSP323"
 /begin DEF_CHARACTERISTIC KF_FTSYNNTMEHAUPTESPORT23 KF_TVMEASPORT23 KL_TSYNMTMEHAUPTESPORT23 KL_TVCGMEASPORT23 KL_TVDKIMEASPORT23 K_FMEHAUPTASPORT23 T_FMEHAUPTASPORT23 /end DEF_CHARACTERISTIC
/end FUNCTION
/begin FUNCTION jMoeZwrHSP334_Fktn "Applikationesgroessen Instanz jMoeZwrHSP334"
 /begin DEF_CHARACTERISTIC KF_FTSYNNTMEHAUPTESPORT34 KF_TVMEASPORT34 KL_TSYNMTMEHAUPTESPORT34 KL_TVCGMEASPORT34 KL_TVDKIMEASPORT34 K_FMEHAUPTASPORT34 T_FMEHAUPTASPORT34 /end DEF_CHARACTERISTIC
/end FUNCTION
/begin FUNCTION jMoeZwrHSP345_Fktn "Applikationesgroessen Instanz jMoeZwrHSP345"
 /begin DEF_CHARACTERISTIC KF_FTSYNNTMEHAUPTESPORT45 KF_TVMEASPORT45 KL_TSYNMTMEHAUPTESPORT45 KL_TVCGMEASPORT45 KL_TVDKIMEASPORT45 K_FMEHAUPTASPORT45 T_FMEHAUPTASPORT45 /end DEF_CHARACTERISTIC
/end FUNCTION
/begin FUNCTION jMoeZwrHSP356_Fktn "Applikationesgroessen Instanz jMoeZwrHSP356"
 /begin DEF_CHARACTERISTIC KF_FTSYNNTMEHAUPTESPORT56 KF_TVMEASPORT56 KL_TSYNMTMEHAUPTESPORT56 KL_TVCGMEASPORT56 KL_TVDKIMEASPORT56 K_FMEHAUPTASPORT56 T_FMEHAUPTASPORT56 /end DEF_CHARACTERISTIC
/end FUNCTION
/begin FUNCTION jMoeZwrHSP367_Fktn "Applikationesgroessen Instanz jMoeZwrHSP367"
 /begin DEF_CHARACTERISTIC KF_FTSYNNTMEHAUPTESPORT67 KF_TVMEASPORT67 KL_TSYNMTMEHAUPTESPORT67 KL_TVCGMEASPORT67 KL_TVDKIMEASPORT67 K_FMEHAUPTASPORT67 T_FMEHAUPTASPORT67 /end DEF_CHARACTERISTIC
/end FUNCTION
/begin FUNCTION jMoeZwrHSP378_Fktn "Applikationesgroessen Instanz jMoeZwrHSP378"
 /begin DEF_CHARACTERISTIC KF_FTSYNNTMEHAUPTESPORT78 KF_TVMEASPORT78 KL_TSYNMTMEHAUPTESPORT78 KL_TVCGMEASPORT78 KL_TVDKIMEASPORT78 K_FMEHAUPTASPORT78 T_FMEHAUPTASPORT78 /end DEF_CHARACTERISTIC
/end FUNCTION
/begin FUNCTION jMoeZwrHSP313_Fktn "Applikationesgroessen Instanz jMoeZwrHSP313"
 /begin DEF_CHARACTERISTIC KF_FTSYNNTMEHAUPTESPORT13 KF_TVMEASPORT13 KL_TSYNMTMEHAUPTESPORT13 KL_TVCGMEASPORT13 KL_TVDKIMEASPORT13 K_FMEHAUPTASPORT13 T_FMEHAUPTASPORT13 /end DEF_CHARACTERISTIC
/end FUNCTION
/begin FUNCTION jMoeZwrHSP324_Fktn "Applikationesgroessen Instanz jMoeZwrHSP324"
 /begin DEF_CHARACTERISTIC KF_FTSYNNTMEHAUPTESPORT24 KF_TVMEASPORT24 KL_TSYNMTMEHAUPTESPORT24 KL_TVCGMEASPORT24 KL_TVDKIMEASPORT24 K_FMEHAUPTASPORT24 T_FMEHAUPTASPORT24 /end DEF_CHARACTERISTIC
/end FUNCTION
/begin FUNCTION jMoeZwrHSP335_Fktn "Applikationesgroessen Instanz jMoeZwrHSP335"
 /begin DEF_CHARACTERISTIC KF_FTSYNNTMEHAUPTESPORT35 KF_TVMEASPORT35 KL_TSYNMTMEHAUPTESPORT35 KL_TVCGMEASPORT35 KL_TVDKIMEASPORT35 K_FMEHAUPTASPORT35 T_FMEHAUPTASPORT35 /end DEF_CHARACTERISTIC
/end FUNCTION
/begin FUNCTION jMoeZwrHSP346_Fktn "Applikationesgroessen Instanz jMoeZwrHSP346"
 /begin DEF_CHARACTERISTIC KF_FTSYNNTMEHAUPTESPORT46 KF_TVMEASPORT46 KL_TSYNMTMEHAUPTESPORT46 KL_TVCGMEASPORT46 KL_TVDKIMEASPORT46 K_FMEHAUPTASPORT46 T_FMEHAUPTASPORT46 /end DEF_CHARACTERISTIC
/end FUNCTION
/begin FUNCTION jMoeZwrHSP357_Fktn "Applikationesgroessen Instanz jMoeZwrHSP357"
 /begin DEF_CHARACTERISTIC KF_FTSYNNTMEHAUPTESPORT57 KF_TVMEASPORT57 KL_TSYNMTMEHAUPTESPORT57 KL_TVCGMEASPORT57 KL_TVDKIMEASPORT57 K_FMEHAUPTASPORT57 T_FMEHAUPTASPORT57 /end DEF_CHARACTERISTIC
/end FUNCTION
/begin FUNCTION jMoeZwrHSP368_Fktn "Applikationesgroessen Instanz jMoeZwrHSP368"
 /begin DEF_CHARACTERISTIC KF_FTSYNNTMEHAUPTESPORT68 KF_TVMEASPORT68 KL_TSYNMTMEHAUPTESPORT68 KL_TVCGMEASPORT68 KL_TVDKIMEASPORT68 K_FMEHAUPTASPORT68 T_FMEHAUPTASPORT68 /end DEF_CHARACTERISTIC
/end FUNCTION
/begin FUNCTION jMoeEzaHSP112_Fktn "Applikationesgroessen Instanz jMoeEzaHSP112"
 /begin DEF_CHARACTERISTIC KF_FTSYNNTMEHAUPTE_EZA12 KF_TVMEA_EZA12 KL_TSYNMTMEHAUPTE_EZA12 KL_TVCGMEA_EZA12 KL_TVDKIMEA_EZA12 K_FMEHAUPTA_EZA12 T_FMEHAUPTA_EZA12 /end DEF_CHARACTERISTIC
/end FUNCTION
/begin FUNCTION jMoeEzaHSP123_Fktn "Applikationesgroessen Instanz jMoeEzaHSP123"
 /begin DEF_CHARACTERISTIC KF_FTSYNNTMEHAUPTE_EZA23 KF_TVMEA_EZA23 KL_TSYNMTMEHAUPTE_EZA23 KL_TVCGMEA_EZA23 KL_TVDKIMEA_EZA23 K_FMEHAUPTA_EZA23 T_FMEHAUPTA_EZA23 /end DEF_CHARACTERISTIC
/end FUNCTION
/begin FUNCTION jMoeEzaHSP134_Fktn "Applikationesgroessen Instanz jMoeEzaHSP134"
 /begin DEF_CHARACTERISTIC KF_FTSYNNTMEHAUPTE_EZA34 KF_TVMEA_EZA34 KL_TSYNMTMEHAUPTE_EZA34 KL_TVCGMEA_EZA34 KL_TVDKIMEA_EZA34 K_FMEHAUPTA_EZA34 T_FMEHAUPTA_EZA34 /end DEF_CHARACTERISTIC
/end FUNCTION
/begin FUNCTION jMoeEzaHSP145_Fktn "Applikationesgroessen Instanz jMoeEzaHSP145"
 /begin DEF_CHARACTERISTIC KF_FTSYNNTMEHAUPTE_EZA45 KF_TVMEA_EZA45 KL_TSYNMTMEHAUPTE_EZA45 KL_TVCGMEA_EZA45 KL_TVDKIMEA_EZA45 K_FMEHAUPTA_EZA45 T_FMEHAUPTA_EZA45 /end DEF_CHARACTERISTIC
/end FUNCTION
/begin FUNCTION jMoeEzaHSP156_Fktn "Applikationesgroessen Instanz jMoeEzaHSP156"
 /begin DEF_CHARACTERISTIC KF_FTSYNNTMEHAUPTE_EZA56 KF_TVMEA_EZA56 KL_TSYNMTMEHAUPTE_EZA56 KL_TVCGMEA_EZA56 KL_TVDKIMEA_EZA56 K_FMEHAUPTA_EZA56 T_FMEHAUPTA_EZA56 /end DEF_CHARACTERISTIC
/end FUNCTION
/begin FUNCTION jMoeEzaHSP167_Fktn "Applikationesgroessen Instanz jMoeEzaHSP167"
 /begin DEF_CHARACTERISTIC KF_FTSYNNTMEHAUPTE_EZA67 KF_TVMEA_EZA67 KL_TSYNMTMEHAUPTE_EZA67 KL_TVCGMEA_EZA67 KL_TVDKIMEA_EZA67 K_FMEHAUPTA_EZA67 T_FMEHAUPTA_EZA67 /end DEF_CHARACTERISTIC
/end FUNCTION
/begin FUNCTION jMoeEzaHSP178_Fktn "Applikationesgroessen Instanz jMoeEzaHSP178"
 /begin DEF_CHARACTERISTIC KF_FTSYNNTMEHAUPTE_EZA78 KF_TVMEA_EZA78 KL_TSYNMTMEHAUPTE_EZA78 KL_TVCGMEA_EZA78 KL_TVDKIMEA_EZA78 K_FMEHAUPTA_EZA78 T_FMEHAUPTA_EZA78 /end DEF_CHARACTERISTIC
/end FUNCTION
/begin FUNCTION jMoeEzaHSP212_Fktn "Applikationesgroessen Instanz jMoeEzaHSP212"
 /begin DEF_CHARACTERISTIC KF_FTSYNNTMEHAUPTESP_EZA12 KF_TVMEASP_EZA12 KL_TSYNMTMEHAUPTESP_EZA12 KL_TVCGMEASP_EZA12 KL_TVDKIMEASP_EZA12 K_FMEHAUPTASP_EZA12 T_FMEHAUPTASP_EZA12 /end DEF_CHARACTERISTIC
/end FUNCTION
/begin FUNCTION jMoeEzaHSP223_Fktn "Applikationesgroessen Instanz jMoeEzaHSP223"
 /begin DEF_CHARACTERISTIC KF_FTSYNNTMEHAUPTESP_EZA23 KF_TVMEASP_EZA23 KL_TSYNMTMEHAUPTESP_EZA23 KL_TVCGMEASP_EZA23 KL_TVDKIMEASP_EZA23 K_FMEHAUPTASP_EZA23 T_FMEHAUPTASP_EZA23 /end DEF_CHARACTERISTIC
/end FUNCTION
/begin FUNCTION jMoeEzaHSP234_Fktn "Applikationesgroessen Instanz jMoeEzaHSP234"
 /begin DEF_CHARACTERISTIC KF_FTSYNNTMEHAUPTESP_EZA34 KF_TVMEASP_EZA34 KL_TSYNMTMEHAUPTESP_EZA34 KL_TVCGMEASP_EZA34 KL_TVDKIMEASP_EZA34 K_FMEHAUPTASP_EZA34 T_FMEHAUPTASP_EZA34 /end DEF_CHARACTERISTIC
/end FUNCTION
/begin FUNCTION jMoeEzaHSP245_Fktn "Applikationesgroessen Instanz jMoeEzaHSP245"
 /begin DEF_CHARACTERISTIC KF_FTSYNNTMEHAUPTESP_EZA45 KF_TVMEASP_EZA45 KL_TSYNMTMEHAUPTESP_EZA45 KL_TVCGMEASP_EZA45 KL_TVDKIMEASP_EZA45 K_FMEHAUPTASP_EZA45 T_FMEHAUPTASP_EZA45 /end DEF_CHARACTERISTIC
/end FUNCTION
/begin FUNCTION jMoeEzaHSP256_Fktn "Applikationesgroessen Instanz jMoeEzaHSP256"
 /begin DEF_CHARACTERISTIC KF_FTSYNNTMEHAUPTESP_EZA56 KF_TVMEASP_EZA56 KL_TSYNMTMEHAUPTESP_EZA56 KL_TVCGMEASP_EZA56 KL_TVDKIMEASP_EZA56 K_FMEHAUPTASP_EZA56 T_FMEHAUPTASP_EZA56 /end DEF_CHARACTERISTIC
/end FUNCTION
/begin FUNCTION jMoeEzaHSP267_Fktn "Applikationesgroessen Instanz jMoeEzaHSP267"
 /begin DEF_CHARACTERISTIC KF_FTSYNNTMEHAUPTESP_EZA67 KF_TVMEASP_EZA67 KL_TSYNMTMEHAUPTESP_EZA67 KL_TVCGMEASP_EZA67 KL_TVDKIMEASP_EZA67 K_FMEHAUPTASP_EZA67 T_FMEHAUPTASP_EZA67 /end DEF_CHARACTERISTIC
/end FUNCTION
/begin FUNCTION jMoeEzaHSP278_Fktn "Applikationesgroessen Instanz jMoeEzaHSP278"
 /begin DEF_CHARACTERISTIC KF_FTSYNNTMEHAUPTESP_EZA78 KF_TVMEASP_EZA78 KL_TSYNMTMEHAUPTESP_EZA78 KL_TVCGMEASP_EZA78 KL_TVDKIMEASP_EZA78 K_FMEHAUPTASP_EZA78 T_FMEHAUPTASP_EZA78 /end DEF_CHARACTERISTIC
/end FUNCTION
/begin FUNCTION jMoeEzaHSP312_Fktn "Applikationesgroessen Instanz jMoeEzaHSP312"
 /begin DEF_CHARACTERISTIC KF_FTSYNNTMEHAUPTESPORT_EZA12 KF_TVMEASPORT_EZA12 KL_TSYNMTMEHAUPTESPORT_EZA12 KL_TVCGMEASPORT_EZA12 KL_TVDKIMEASPORT_EZA12 K_FMEHAUPTASPORT_EZA12 T_FMEHAUPTASPORT_EZA12 /end DEF_CHARACTERISTIC
/end FUNCTION
/begin FUNCTION jMoeEzaHSP323_Fktn "Applikationesgroessen Instanz jMoeEzaHSP323"
 /begin DEF_CHARACTERISTIC KF_FTSYNNTMEHAUPTESPORT_EZA23 KF_TVMEASPORT_EZA23 KL_TSYNMTMEHAUPTESPORT_EZA23 KL_TVCGMEASPORT_EZA23 KL_TVDKIMEASPORT_EZA23 K_FMEHAUPTASPORT_EZA23 T_FMEHAUPTASPORT_EZA23 /end DEF_CHARACTERISTIC
/end FUNCTION
/begin FUNCTION jMoeEzaHSP334_Fktn "Applikationesgroessen Instanz jMoeEzaHSP334"
 /begin DEF_CHARACTERISTIC KF_FTSYNNTMEHAUPTESPORT_EZA34 KF_TVMEASPORT_EZA34 KL_TSYNMTMEHAUPTESPORT_EZA34 KL_TVCGMEASPORT_EZA34 KL_TVDKIMEASPORT_EZA34 K_FMEHAUPTASPORT_EZA34 T_FMEHAUPTASPORT_EZA34 /end DEF_CHARACTERISTIC
/end FUNCTION
/begin FUNCTION jMoeEzaHSP345_Fktn "Applikationesgroessen Instanz jMoeEzaHSP345"
 /begin DEF_CHARACTERISTIC KF_FTSYNNTMEHAUPTESPORT_EZA45 KF_TVMEASPORT_EZA45 KL_TSYNMTMEHAUPTESPORT_EZA45 KL_TVCGMEASPORT_EZA45 KL_TVDKIMEASPORT_EZA45 K_FMEHAUPTASPORT_EZA45 T_FMEHAUPTASPORT_EZA45 /end DEF_CHARACTERISTIC
/end FUNCTION
/begin FUNCTION jMoeEzaHSP356_Fktn "Applikationesgroessen Instanz jMoeEzaHSP356"
 /begin DEF_CHARACTERISTIC KF_FTSYNNTMEHAUPTESPORT_EZA56 KF_TVMEASPORT_EZA56 KL_TSYNMTMEHAUPTESPORT_EZA56 KL_TVCGMEASPORT_EZA56 KL_TVDKIMEASPORT_EZA56 K_FMEHAUPTASPORT_EZA56 T_FMEHAUPTASPORT_EZA56 /end DEF_CHARACTERISTIC
/end FUNCTION
/begin FUNCTION jMoeEzaHSP367_Fktn "Applikationesgroessen Instanz jMoeEzaHSP367"
 /begin DEF_CHARACTERISTIC KF_FTSYNNTMEHAUPTESPORT_EZA67 KF_TVMEASPORT_EZA67 KL_TSYNMTMEHAUPTESPORT_EZA67 KL_TVCGMEASPORT_EZA67 KL_TVDKIMEASPORT_EZA67 K_FMEHAUPTASPORT_EZA67 T_FMEHAUPTASPORT_EZA67 /end DEF_CHARACTERISTIC
/end FUNCTION
/begin FUNCTION jMoeEzaHSP378_Fktn "Applikationesgroessen Instanz jMoeEzaHSP378"
 /begin DEF_CHARACTERISTIC KF_FTSYNNTMEHAUPTESPORT_EZA78 KF_TVMEASPORT_EZA78 KL_TSYNMTMEHAUPTESPORT_EZA78 KL_TVCGMEASPORT_EZA78 KL_TVDKIMEASPORT_EZA78 K_FMEHAUPTASPORT_EZA78 T_FMEHAUPTASPORT_EZA78 /end DEF_CHARACTERISTIC
/end FUNCTION
/begin FUNCTION jMoeLMeHSP112_Fktn "Applikationesgroessen Instanz jMoeLMeHSP112"
 /begin DEF_CHARACTERISTIC KF_TVMEA_LM12 KL_TSYNMTMEHAUPTE_LM12 KL_TVCGMEA_LM12 K_FMEHAUPTA_LM12 T_FMEHAUPTA_LM12 /end DEF_CHARACTERISTIC
/end FUNCTION
/begin FUNCTION jMoeLMeHSP123_Fktn "Applikationesgroessen Instanz jMoeLMeHSP123"
 /begin DEF_CHARACTERISTIC KF_TVMEA_LM23 KL_TSYNMTMEHAUPTE_LM23 KL_TVCGMEA_LM23 K_FMEHAUPTA_LM23 T_FMEHAUPTA_LM23 /end DEF_CHARACTERISTIC
/end FUNCTION
/begin FUNCTION jMoeLMeHSP134_Fktn "Applikationesgroessen Instanz jMoeLMeHSP134"
 /begin DEF_CHARACTERISTIC KF_TVMEA_LM34 KL_TSYNMTMEHAUPTE_LM34 KL_TVCGMEA_LM34 K_FMEHAUPTA_LM34 T_FMEHAUPTA_LM34 /end DEF_CHARACTERISTIC
/end FUNCTION
/begin FUNCTION jMoeLMeHSP145_Fktn "Applikationesgroessen Instanz jMoeLMeHSP145"
 /begin DEF_CHARACTERISTIC KF_TVMEA_LM45 KL_TSYNMTMEHAUPTE_LM45 KL_TVCGMEA_LM45 K_FMEHAUPTA_LM45 T_FMEHAUPTA_LM45 /end DEF_CHARACTERISTIC
/end FUNCTION
/begin FUNCTION jMoeLMeHSP156_Fktn "Applikationesgroessen Instanz jMoeLMeHSP156"
 /begin DEF_CHARACTERISTIC KF_TVMEA_LM56 KL_TSYNMTMEHAUPTE_LM56 KL_TVCGMEA_LM56 K_FMEHAUPTA_LM56 T_FMEHAUPTA_LM56 /end DEF_CHARACTERISTIC
/end FUNCTION
/begin FUNCTION jMoeLMeHSP167_Fktn "Applikationesgroessen Instanz jMoeLMeHSP167"
 /begin DEF_CHARACTERISTIC KF_TVMEA_LM67 KL_TSYNMTMEHAUPTE_LM67 KL_TVCGMEA_LM67 K_FMEHAUPTA_LM67 T_FMEHAUPTA_LM67 /end DEF_CHARACTERISTIC
/end FUNCTION
/begin FUNCTION jMoeLMeHSP178_Fktn "Applikationesgroessen Instanz jMoeLMeHSP178"
 /begin DEF_CHARACTERISTIC KF_TVMEA_LM78 KL_TSYNMTMEHAUPTE_LM78 KL_TVCGMEA_LM78 K_FMEHAUPTA_LM78 T_FMEHAUPTA_LM78 /end DEF_CHARACTERISTIC
/end FUNCTION
/begin FUNCTION dMoeSasGeG_Fktn "Applikationesgroessen der Komponente dMoeSasGeG"
 /begin SUB_FUNCTION jMoeSasGeGR_Fktn jMoeSasGeG1_Fktn jMoeSasGeG2_Fktn jMoeSasGeG3_Fktn jMoeSasGeG4_Fktn jMoeSasGeG5_Fktn jMoeSasGeG6_Fktn jMoeSasGeG7_Fktn jMoeSasGeG8_Fktn /end SUB_FUNCTION
/end FUNCTION
/begin FUNCTION jMoeSasGeGR_Fktn "Applikationesgroessen Instanz jMoeSasGeGR"
 /begin DEF_CHARACTERISTIC KF_FMEHAUPTGEDKINMOT_R KF_FTSYNNTMEHAUPTE_R KF_MEHAUPT_R KL_TSYNMTMEHAUPTE_R KL_TVMEA_R K_FMEHAUPTA_R ND_MEHAUPTAGE_R T_FMEHAUPTA_R T_RAMEE_R T_SPERRSYN_R /end DEF_CHARACTERISTIC
/end FUNCTION
/begin FUNCTION jMoeSasGeG1_Fktn "Applikationesgroessen Instanz jMoeSasGeG1"
 /begin DEF_CHARACTERISTIC KF_FMEHAUPTGEDKINMOT_1 KF_FTSYNNTMEHAUPTE_1 KF_MEHAUPT_1 KL_TSYNMTMEHAUPTE_1 KL_TVMEA_1 K_FMEHAUPTA_1 ND_MEHAUPTAGE_1 T_FMEHAUPTA_1 T_RAMEE_1 T_SPERRSYN_1 /end DEF_CHARACTERISTIC
/end FUNCTION
/begin RECORD_LAYOUT kw_bool8_S6_S3 FNC_VALUES 1 UBYTE COLUMN_DIR DIRECT /end RECORD_LAYOUT
/begin RECORD_LAYOUT kw_ui8_S6_S3 FNC_VALUES 1 UBYTE COLUMN_DIR DIRECT /end RECORD_LAYOUT
/begin RECORD_LAYOUT kw_ui16_S6_S3 FNC_VALUES 1 UWORD COLUMN_DIR DIRECT /end RECORD_LAYOUT
/begin RECORD_LAYOUT kw_si16_S6_S3 FNC_VALUES 1 SWORD COLUMN_DIR DIRECT /end RECORD_LAYOUT
/begin RECORD_LAYOUT tab_bool8_S6_S3 FNC_VALUES 2 UBYTE COLUMN_DIR DIRECT NO_AXIS_PTS_X 1 ULONG /end RECORD_LAYOUT
/begin RECORD_LAYOUT tab_si16_S6_S3 FNC_VALUES 2 SWORD COLUMN_DIR DIRECT NO_AXIS_PTS_X 1 ULONG /end RECORD_LAYOUT
/begin RECORD_LAYOUT tab2d_ui8_S6_S3 FNC_VALUES 3 UBYTE ROW_DIR DIRECT NO_AXIS_PTS_X 1 ULONG NO_AXIS_PTS_Y 2 ULONG /end RECORD_LAYOUT
/begin RECORD_LAYOUT kl_ui8_S6_S3 FNC_VALUES 3 UBYTE COLUMN_DIR DIRECT AXIS_PTS_X 2 UBYTE INDEX_INCR DIRECT NO_AXIS_PTS_X 1 ULONG /end RECORD_LAYOUT
/begin RECORD_LAYOUT kl_si16_S6_S3 FNC_VALUES 3 SWORD COLUMN_DIR DIRECT AXIS_PTS_X 2 SWORD INDEX_INCR DIRECT NO_AXIS_PTS_X 1 ULONG /end RECORD_LAYOUT
/begin RECORD_LAYOUT kf_ui8_S6_S3 FNC_VALUES 5 UBYTE ROW_DIR DIRECT AXIS_PTS_X 3 UBYTE INDEX_INCR DIRECT AXIS_PTS_Y 4 UBYTE INDEX_INCR DIRECT NO_AXIS_PTS_X 1 ULONG NO_AXIS_PTS_Y 2 ULONG /end RECORD_LAYOUT
/begin RECORD_LAYOUT kf_si16_S6_S3 FNC_VALUES 5 SWORD ROW_DIR DIRECT AXIS_PTS_X 3 SWORD INDEX_INCR DIRECT AXIS_PTS_Y 4 SWORD INDEX_INCR DIRECT NO_AXIS_PTS_X 1 ULONG NO_AXIS_PTS_Y 2 ULONG /end RECORD_LAYOUT
/end MODULE
/end PROJECT
