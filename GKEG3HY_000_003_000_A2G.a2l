ASAP2_VERSION 1 51
/begin PROJECT _929_929 "Gen2_BMW_System_Supplier_Lib"
/begin HEADER "" VERSION "C_03_03" PROJECT_NO _929_929 /end HEADER
/begin MODULE DIM ""
/begin MOD_COMMON "" BYTE_ORDER MSB_FIRST ALIGNMENT_BYTE 1 ALIGNMENT_WORD 2 ALIGNMENT_LONG 4 ALIGNMENT_FLOAT32_IEEE 4 /end MOD_COMMON
/begin CHARACTERISTIC D_n_EEPromDataAgs "Size of layer AGS data area in 32-Bit words" VALUE 0x217F80 ZF_KW_NAT8_S2_S3 254 SAB_STANDARD_S2_S3 0 254 /end CHARACTERISTIC
/begin CHARACTERISTIC D_t_IEP_ShutdownDelay "IEP shutdown delay time" VALUE 0x217F52 ZF_KW_NAT8_S2_S3 200 SAB_T_TIMER_10MS_S2_S3 0 200 /end CHARACTERISTIC
/begin CHARACTERISTIC SWI_Brake_Intervention "this switch determines whether the external brake intervention input signals are used or not. if they are not used the output variables are set to 0" VALUE 0x217F53 ZF_KW_NAT8_S2_S3 1 SAB_STANDARD_S2_S3 0 1 /end CHARACTERISTIC
/begin CHARACTERISTIC SWI_ClearLearnedMsgStatus "Switch to clean the learned CAN messages 0-no request 1- reset learned messages" VALUE 0x217F58 ZF_KW_NAT8_S2_S3 1 SAB_STANDARD_S2_S3 0 1 /end CHARACTERISTIC
/begin CHARACTERISTIC D_u_Diag "threshold voltage for CAN diagnosis" VALUE 0x21810E ZF_KW_NAT16_S2_S3 20 SAB_U_1VOLT1000_S2_S3 0 20 /end CHARACTERISTIC
/begin CHARACTERISTIC SWI_CANControlMonitoring "Bits to control monitoring for CAN message(Bit0=Timeout,Bit1=Checksum,Bit2=Alive counter)" CURVE 0x201C1C ZF_TAB_NAT8_S2_S3 255 SAB_STANDARD_S2_S3 0 255
 /begin AXIS_DESCR FIX_AXIS NO_INPUT_QUANTITY SAB_STANDARD_S2_S3 64 0 63 FIX_AXIS_PAR_DIST 0 1 64 /end AXIS_DESCR
/end CHARACTERISTIC
/begin CHARACTERISTIC SWI_CANDiagDelay "stop diagnosis for CAN message (0=sv_KL15 1=Sleep Indication bit is set)" CURVE 0x201C60 ZF_TAB_NAT8_S2_S3 1 SAB_STANDARD_S2_S3 0 1
 /begin AXIS_DESCR FIX_AXIS NO_INPUT_QUANTITY SAB_STANDARD_S2_S3 64 0 63 FIX_AXIS_PAR_DIST 0 1 64 /end AXIS_DESCR
/end CHARACTERISTIC
/begin CHARACTERISTIC D_t_CANDiagDelay "Diagnosis delay time for each CAN message after change of sv_KL15 Off to On" CURVE 0x201CA4 ZF_TAB_NAT16_S2_S3 655350 SAB_T_TIMER_10MS_S2_S3 0 655350
 /begin AXIS_DESCR FIX_AXIS NO_INPUT_QUANTITY SAB_STANDARD_S2_S3 64 0 63 FIX_AXIS_PAR_DIST 0 1 64 /end AXIS_DESCR
/end CHARACTERISTIC
/begin CHARACTERISTIC SWI_CANLearnID "One Switch for each CAN message(0= always monitored;1=only monitored,when message was learned)" CURVE 0x201D28 ZF_TAB_NAT8_S2_S3 1 SAB_STANDARD_S2_S3 0 1
 /begin AXIS_DESCR FIX_AXIS NO_INPUT_QUANTITY SAB_STANDARD_S2_S3 64 0 63 FIX_AXIS_PAR_DIST 0 1 64 /end AXIS_DESCR
/end CHARACTERISTIC
/begin CHARACTERISTIC D_CAN_GROUP_FC "information about which message belongs to a group error code or to the same ECU" CURVE 0x201D6C ZF_TAB_NAT8_S2_S3 20 SAB_STANDARD_S2_S3 0 20
 /begin AXIS_DESCR FIX_AXIS NO_INPUT_QUANTITY SAB_STANDARD_S2_S3 64 0 63 FIX_AXIS_PAR_DIST 0 1 64 /end AXIS_DESCR
/end CHARACTERISTIC
/begin CHARACTERISTIC D_u_CanDiagLTh "if voltage gets below the threshold value the CAN diagnosis gets stopped" VALUE 0x218110 ZF_KW_NAT16_S2_S3 60 SAB_U_1VOLT1000_S2_S3 0 60 /end CHARACTERISTIC
/begin CHARACTERISTIC D_u_CanDiagHTh "if voltage gets above the threshold value the CAN diagnosis gets stopped" VALUE 0x218112 ZF_KW_NAT16_S2_S3 60 SAB_U_1VOLT1000_S2_S3 0 60 /end CHARACTERISTIC
/begin CHARACTERISTIC D_t_CAN1BusDiagDelay "Delay time of A-CAN diagnosis after: ingition on or voltage out of range or bus disturbance." VALUE 0x218114 ZF_KW_NAT16_S2_S3 655350 SAB_T_TIMER_10MS_S2_S3 0 655350 /end CHARACTERISTIC
/begin CHARACTERISTIC D_CAN1BusBitmask "Bits to decide if the errocode for a BusOff or ErrorPassive on the CANBus must be set (bit0 allows to set the error in case of BusOff and Bit2 allows to set the error in case of ErrorPassive)" VALUE 0x217F59 ZF_KW_NAT8_S2_S3 255 SAB_STANDARD_S2_S3 0 255 /end CHARACTERISTIC
/begin CHARACTERISTIC D_t_CAN2BusDiagDelay "Delay time of SBW-CAN diagnosis after: ingition on or voltage out of range or bus disturbance." VALUE 0x218116 ZF_KW_NAT16_S2_S3 655350 SAB_T_TIMER_10MS_S2_S3 0 655350 /end CHARACTERISTIC
/begin CHARACTERISTIC D_CAN2BusBitmask "Bits to decide if the errocode for a BusOff or ErrorPassive on the A-CANBus must be set (bit0 allows to set the error in case of BusOff and Bit2 allows to set the error in case of ErrorPassive)" VALUE 0x217F5A ZF_KW_NAT8_S2_S3 255 SAB_STANDARD_S2_S3 0 255 /end CHARACTERISTIC
/begin CHARACTERISTIC SWI_Calc_CanMsgErrorBitmask_cyclic "Switch to calc the st_CanMsgErrorBitmask in each cycle (=1) or triggerd by AmbConditions (enter of a KFC) (=0)" VALUE 0x217F5B ZF_KW_NAT8_S2_S3 1 SAB_STANDARD_S2_S3 0 1 /end CHARACTERISTIC
/begin CHARACTERISTIC D_tmr_CAN_Hys "This hysteresis time determines how long the FACan stays primary CAN after the ACAN is valid again" VALUE 0x217F5C ZF_KW_NAT8_S2_S3 2550 SAB_T_TIMER_10MS_S2_S3 0 2550 /end CHARACTERISTIC
/begin CHARACTERISTIC SWI_ACAN_FACAN "Application Parameter to switch between which CAN is used A(0) FA(1) both faulty (3)" VALUE 0x217F5D ZF_KW_NAT8_S2_S3 3 SAB_STANDARD_S2_S3 0 3 /end CHARACTERISTIC
/begin CHARACTERISTIC D_BitmaskNIC "Bitmask for NIC" VALUE 0x218130 ZF_KW_NAT16_S2_S3 65535 SAB_STANDARD_S2_S3 0 65535 /end CHARACTERISTIC
/begin CHARACTERISTIC SWI_SwapHighLowByte_Inputs "0=do nothing --- 1=swaps the high byte with the low byte of the input values" VALUE 0x217F79 ZF_KW_NAT8_S2_S3 1 SAB_STANDARD_S2_S3 0 1 /end CHARACTERISTIC
/begin CHARACTERISTIC D_CodingApp "Bitmask for bitwise activation of Sport button if selected by D_CodingVehOrCodingApp" VALUE 0x218132 ZF_KW_NAT16_S2_S3 65535 SAB_STANDARD_S2_S3 0 65535 /end CHARACTERISTIC
/begin CHARACTERISTIC D_CodingElectrical "Bitmask for bitwise activation of NIC if selected by D_CodingVehOrCodingElectrical" VALUE 0x218134 ZF_KW_NAT16_S2_S3 65535 SAB_STANDARD_S2_S3 0 65535 /end CHARACTERISTIC
/begin CHARACTERISTIC D_CodingVehOrCodingApp "Bitmask for bitwise selection of input signal iv_CodingAppl: bitx=0 bit x is taken from input signal iv_CodingAppl --- bitx=1 bit x is taken from D_CodingApp" VALUE 0x218136 ZF_KW_NAT16_S2_S3 65535 SAB_STANDARD_S2_S3 0 65535 /end CHARACTERISTIC
/begin CHARACTERISTIC D_CodingVehOrCodingElectrical "Bitmask for bitwise selection of input signal iv_CodingElectrical: bitx=0 bit x is taken from input signal iv_CodingElectrical --- bitx=1 bit x is taken from D_CodingElectrical" VALUE 0x218138 ZF_KW_NAT16_S2_S3 65535 SAB_STANDARD_S2_S3 0 65535 /end CHARACTERISTIC
/begin CHARACTERISTIC D_n_Eng_PreConTh "Communication Precondition Engine Speed Threshold" VALUE 0x21813A ZF_KW_NAT16_S2_S3 65535 SAB_N_1RPM_S2_S3 0 65535 /end CHARACTERISTIC
/begin CHARACTERISTIC D_n_Turbine_PreConTh "Communication Precondition Turbine Speed Threshold" VALUE 0x21813C ZF_KW_NAT16_S2_S3 65535 SAB_N_1RPM_S2_S3 0 65535 /end CHARACTERISTIC
/begin CHARACTERISTIC D_n_Ab_PreConTh "Communication Precondition Transmission Output Speed Threshold" VALUE 0x21813E ZF_KW_NAT16_S2_S3 65535 SAB_N_1RPM_S2_S3 0 65535 /end CHARACTERISTIC
/begin CHARACTERISTIC D_v_Veh_PreConTh "Communication Precondition Vehicle Speed Threshold" VALUE 0x218140 ZF_KW_NAT16_S2_S3 65535 SAB_V_1KMH_S2_S3 0 65535 /end CHARACTERISTIC
/begin CHARACTERISTIC SWI_PreConditions "SWI for deactivating conditions (set condition fulfilled): Bit0=EngineSpeed Bit1=TurbineSpeed Bit2=TransmissionOutputSpeed Bit3=VehicleSpeed Bit4=Pos Bit5=KL15PIN Bit6=KL15CAN Bit7=DriveState Bit8=EWS Bit9=Ignition Bit10=MSA_MotorStop Bit11=VehReadytoD..." VALUE 0x218142 ZF_KW_NAT16_S2_S3 65535 SAB_STANDARD_S2_S3 0 65535
 /begin ANNOTATION ANNOTATION_LABEL "Description"
  /begin ANNOTATION_TEXT "SWI for deactivating conditions (set condition fulfilled): Bit0=EngineSpeed Bit1=TurbineSpeed Bit2=TransmissionOutputSpeed Bit3=VehicleSpeed Bit4=Pos Bit5=KL15PIN Bit6=KL15CAN Bit7=DriveState Bit8=EWS Bit9=Ignition Bit10=MSA_MotorStop Bit11=VehReadytoDriv" "e Bit13=OBD_Qualified Bit14=OBD_StsInfo Bit15=notused" /end ANNOTATION_TEXT
 /end ANNOTATION
/end CHARACTERISTIC
/begin CHARACTERISTIC D_m_IstVM_Default "Substituted value for m_IstVM" VALUE 0x218144 ZF_KW_NAT16_S2_S3 1640 SAB_M_1NM_S2_S3 0 1640 /end CHARACTERISTIC
/begin CHARACTERISTIC D_m_IstEM1 "Substituted value for m_IstEM1" VALUE 0x217F7A ZF_KW_INT8_S2_S3 30 SAB_M_1NM_S2_S3 -15 15 /end CHARACTERISTIC
/begin CHARACTERISTIC SWI_DriveDirByNabOrNwheel "Switch for selection of source of driving direction 0=Prio 1: nAb; 1=Prio 1: Wheels; 2=just nAb; 3=only Wheels" VALUE 0x217F7D ZF_KW_NAT8_S2_S3 3 SAB_N_1RPM_S2_S3 0 3 /end CHARACTERISTIC
/begin CHARACTERISTIC D_t_HoldDirection "Delay time to inhibit undef driving direction; 0 ms = without inhibit" VALUE 0x217F7E ZF_KW_NAT8_S2_S3 2550 SAB_T_TIMER_10MS_S2_S3 0 2550 /end CHARACTERISTIC
/begin CHARACTERISTIC D_tmr_GearSubst "minimum time of forced N during D-substitute function Elektrisches Notprogramm 1. - 8. Gear" VALUE 0x21814A ZF_KW_NAT16_S2_S3 655350 SAB_T_TIMER_10MS_S2_S3 0 655350 /end CHARACTERISTIC
/begin CHARACTERISTIC D_tmr_GearSubst1 "minimum time of forced N during D-substitute function Elektrisches Notprogramm KMN_ENPGxFIX" VALUE 0x21814C ZF_KW_NAT16_S2_S3 655350 SAB_T_TIMER_10MS_S2_S3 0 655350 /end CHARACTERISTIC
/begin CHARACTERISTIC D_n_iGangAb_LowSpeedTh "Threshold to request if IEP has a problem" VALUE 0x21814E ZF_KW_NAT16_S2_S3 11000 SAB_N_1RPM_S2_S3 0 11000 /end CHARACTERISTIC
/begin CHARACTERISTIC D_n_InputSpeed_ENPGxFIXTh "Threshold for input motor speed" VALUE 0x218150 ZF_KW_NAT16_S2_S3 11000 SAB_N_1RPM_S2_S3 0 11000 /end CHARACTERISTIC
/begin CHARACTERISTIC D_n_iGangAb_GearSubstTh "VM Abwuergeschwelle" VALUE 0x218152 ZF_KW_NAT16_S2_S3 11000 SAB_N_1RPM_S2_S3 0 11000 /end CHARACTERISTIC
/begin CHARACTERISTIC D_n_iGangAb_GearSubstUth "Gangeinlegeschwelle bei der der VM noch nicht gedrueckt wird" VALUE 0x218154 ZF_KW_NAT16_S2_S3 11000 SAB_N_1RPM_S2_S3 0 11000 /end CHARACTERISTIC
/begin CHARACTERISTIC D_n_iGangAb_GearSubstIEPTh "description" VALUE 0x218156 ZF_KW_NAT16_S2_S3 11000 SAB_N_1RPM_S2_S3 0 11000 /end CHARACTERISTIC
/begin CHARACTERISTIC D_n_iGangAb_GearSubstC0LTh "description" VALUE 0x218158 ZF_KW_NAT16_S2_S3 11000 SAB_N_1RPM_S2_S3 0 11000 /end CHARACTERISTIC
/begin CHARACTERISTIC D_n_iGangAb_GearSubstC0Th "description" VALUE 0x21815A ZF_KW_NAT16_S2_S3 11000 SAB_N_1RPM_S2_S3 0 11000 /end CHARACTERISTIC
/begin CHARACTERISTIC D_n_iGangAb_GearSubstC0Hys "description" VALUE 0x21815C ZF_KW_NAT16_S2_S3 11000 SAB_N_1RPM_S2_S3 0 11000 /end CHARACTERISTIC
/begin CHARACTERISTIC D_n_AbUThGearSubst1 "NAB-Threshold for KMN_ENPG1" VALUE 0x21815E ZF_KW_NAT16_S2_S3 65535 SAB_N_1RPM_S2_S3 0 65535 /end CHARACTERISTIC
/begin CHARACTERISTIC D_n_AbUThGearSubst2 "NAB-Threshold for KMN_ENPG2" VALUE 0x218160 ZF_KW_NAT16_S2_S3 65535 SAB_N_1RPM_S2_S3 0 65535 /end CHARACTERISTIC
/begin CHARACTERISTIC D_n_AbUThGearSubst3 "NAB-Threshold for KMN_ENPG3" VALUE 0x218162 ZF_KW_NAT16_S2_S3 65535 SAB_N_1RPM_S2_S3 0 65535 /end CHARACTERISTIC
/begin CHARACTERISTIC D_n_AbUThGearSubst4 "NAB-Threshold for KMN_ENPG4" VALUE 0x218164 ZF_KW_NAT16_S2_S3 65535 SAB_N_1RPM_S2_S3 0 65535 /end CHARACTERISTIC
/begin CHARACTERISTIC D_n_AbUThGearSubst5 "NAB-Threshold for KMN_ENPG5" VALUE 0x218166 ZF_KW_NAT16_S2_S3 65535 SAB_N_1RPM_S2_S3 0 65535 /end CHARACTERISTIC
/begin CHARACTERISTIC D_n_AbUThGearSubst6 "NAB-Threshold for KMN_ENPG6" VALUE 0x218168 ZF_KW_NAT16_S2_S3 65535 SAB_N_1RPM_S2_S3 0 65535 /end CHARACTERISTIC
/begin CHARACTERISTIC D_v_ThGearSubst1 "Speed threshold for KMN_ENPG1" VALUE 0x21816A ZF_KW_NAT16_S2_S3 500 SAB_V_1KMH_S2_S3 0 500 /end CHARACTERISTIC
/begin CHARACTERISTIC D_v_ThGearSubst2 "Speed threshold for KMN_ENPG2" VALUE 0x21816C ZF_KW_NAT16_S2_S3 500 SAB_V_1KMH_S2_S3 0 500 /end CHARACTERISTIC
/begin CHARACTERISTIC D_v_ThGearSubst3 "Speed threshold for KMN_ENPG3 and KMN_G3FIX" VALUE 0x21816E ZF_KW_NAT16_S2_S3 500 SAB_V_1KMH_S2_S3 0 500 /end CHARACTERISTIC
/begin CHARACTERISTIC D_v_ThGearSubst4 "Speed threshold for KMN_ENPG4 and KMN_G4FIX" VALUE 0x218170 ZF_KW_NAT16_S2_S3 500 SAB_V_1KMH_S2_S3 0 500 /end CHARACTERISTIC
/begin CHARACTERISTIC D_v_ThGearSubst5 "Speed threshold for KMN_ENPG5 and KMN_G5FIX" VALUE 0x218172 ZF_KW_NAT16_S2_S3 500 SAB_V_1KMH_S2_S3 0 500 /end CHARACTERISTIC
/begin CHARACTERISTIC D_v_ThGearSubst6 "Speed threshold for KMN_ENPG6" VALUE 0x218174 ZF_KW_NAT16_S2_S3 500 SAB_V_1KMH_S2_S3 0 500 /end CHARACTERISTIC
/begin CHARACTERISTIC D_n_EnTh1 "Engine threshold for KMN_ENPG1" VALUE 0x218176 ZF_KW_NAT16_S2_S3 11000 SAB_N_1RPM_S2_S3 0 11000 /end CHARACTERISTIC
/begin CHARACTERISTIC D_n_EnTh2 "Engine threshold for KMN_ENPG2" VALUE 0x218178 ZF_KW_NAT16_S2_S3 11000 SAB_N_1RPM_S2_S3 0 11000 /end CHARACTERISTIC
/begin CHARACTERISTIC D_n_EnTh3 "Engine threshold for KMN_ENPG3 and KMN_G3FIX" VALUE 0x21817A ZF_KW_NAT16_S2_S3 11000 SAB_N_1RPM_S2_S3 0 11000 /end CHARACTERISTIC
/begin CHARACTERISTIC D_n_EnTh4 "Engine threshold for KMN_ENPG4 and KMN_G4FIX" VALUE 0x21817C ZF_KW_NAT16_S2_S3 11000 SAB_N_1RPM_S2_S3 0 11000 /end CHARACTERISTIC
/begin CHARACTERISTIC D_n_EnTh5 "Engine threshold for KMN_ENPG5 and KMN_G5FIX" VALUE 0x21817E ZF_KW_NAT16_S2_S3 11000 SAB_N_1RPM_S2_S3 0 11000 /end CHARACTERISTIC
/begin CHARACTERISTIC D_n_EnTh6 "Engine threshold for KMN_ENPG5" VALUE 0x218180 ZF_KW_NAT16_S2_S3 11000 SAB_N_1RPM_S2_S3 0 11000 /end CHARACTERISTIC
/begin CHARACTERISTIC D_n_TuTh1 "Turbine threshold for KMN_ENPG1" VALUE 0x218182 ZF_KW_NAT16_S2_S3 11000 SAB_N_1RPM_S2_S3 0 11000 /end CHARACTERISTIC
/begin CHARACTERISTIC D_n_TuTh2 "Turbine threshold for KMN_ENPG2" VALUE 0x218184 ZF_KW_NAT16_S2_S3 11000 SAB_N_1RPM_S2_S3 0 11000 /end CHARACTERISTIC
/begin CHARACTERISTIC D_n_TuTh3 "Turbine threshold for KMN_ENPG3 and KMN_G3FIX" VALUE 0x218186 ZF_KW_NAT16_S2_S3 11000 SAB_N_1RPM_S2_S3 0 11000 /end CHARACTERISTIC
/begin CHARACTERISTIC D_n_TuTh4 "Turbine threshold for KMN_ENPG4 and KMN_G4FIX" VALUE 0x218188 ZF_KW_NAT16_S2_S3 11000 SAB_N_1RPM_S2_S3 0 11000 /end CHARACTERISTIC
/begin CHARACTERISTIC D_n_TuTh5 "Turbine threshold for KMN_ENPG5 and KMN_G5FIX" VALUE 0x21818A ZF_KW_NAT16_S2_S3 11000 SAB_N_1RPM_S2_S3 0 11000 /end CHARACTERISTIC
/begin CHARACTERISTIC D_n_TuTh6 "Turbine threshold for KMN_ENPG6" VALUE 0x21818C ZF_KW_NAT16_S2_S3 11000 SAB_N_1RPM_S2_S3 0 11000 /end CHARACTERISTIC
/begin CHARACTERISTIC SWI_n_AbUThGearSubst1 "Switch to chose between calculated or Fix NAB for 1. Gear" VALUE 0x217F81 ZF_KW_NAT8_S2_S3 1 SAB_STANDARD_S2_S3 0 1 /end CHARACTERISTIC
/begin CHARACTERISTIC SWI_n_AbUThGearSubst2 "Switch to chose between calculated or Fix NAB for 2. Gear" VALUE 0x217F82 ZF_KW_NAT8_S2_S3 1 SAB_STANDARD_S2_S3 0 1 /end CHARACTERISTIC
/begin CHARACTERISTIC SWI_n_AbUThGearSubst3 "Switch to chose between calculated or Fix NAB for 3. Gear" VALUE 0x217F83 ZF_KW_NAT8_S2_S3 1 SAB_STANDARD_S2_S3 0 1 /end CHARACTERISTIC
/begin CHARACTERISTIC SWI_n_AbUThGearSubst4 "Switch to chose between calculated or Fix NAB for 4. Gear" VALUE 0x217F84 ZF_KW_NAT8_S2_S3 1 SAB_STANDARD_S2_S3 0 1 /end CHARACTERISTIC
/begin CHARACTERISTIC SWI_n_AbUThGearSubst5 "Switch to chose between calculated or Fix NAB for 5. Gear" VALUE 0x217F85 ZF_KW_NAT8_S2_S3 1 SAB_STANDARD_S2_S3 0 1 /end CHARACTERISTIC
/begin CHARACTERISTIC SWI_n_AbUThGearSubst6 "Switch to chose between calculated or Fix NAB for 6. Gear" VALUE 0x217F86 ZF_KW_NAT8_S2_S3 1 SAB_STANDARD_S2_S3 0 1 /end CHARACTERISTIC
/begin CHARACTERISTIC SWI_n_EnUTh "Switch to chose between calculated or Fix Engine-Limitation-RPM" VALUE 0x217F87 ZF_KW_NAT8_S2_S3 1 SAB_STANDARD_S2_S3 0 1 /end CHARACTERISTIC
/begin CHARACTERISTIC D_n_EnUTh "Upper threshold of Engine-RPM" VALUE 0x21818E ZF_KW_NAT16_S2_S3 10000 SAB_N_1RPM_S2_S3 0 10000 /end CHARACTERISTIC
/begin CHARACTERISTIC SWI_UpShiftInhibit "UP shift inhibit when KMN_UPSHIFTINHIBIT is active bit0=1to2 bit1=2to3 ... bit6=7to8" VALUE 0x217F88 ZF_KW_NAT8_S2_S3 127 SAB_STANDARD_S2_S3 0 127 /end CHARACTERISTIC
/begin CHARACTERISTIC D_c_Eng "Application parameter replacement value for engine temperature" VALUE 0x217F89 ZF_KW_NAT8_S2_S3 190 SAB_C_CMO_1CEL_M48_S2_S3 -48 142 /end CHARACTERISTIC
/begin CHARACTERISTIC D_u_BattLth_NMOFLL "If the battery voltage is higher than this threshold an error code (KFC_NMOFLL) is forward filtering" VALUE 0x218190 ZF_KW_NAT16_S2_S3 24 SAB_U_1VOLT1000_S2_S3 0 24 /end CHARACTERISTIC
/begin CHARACTERISTIC D_n_EngIdleInit "Applicative init value for desired engine idle speed" VALUE 0x218192 ZF_KW_NAT16_S2_S3 20000 SAB_N_1RPM_S2_S3 0 20000 /end CHARACTERISTIC
/begin CHARACTERISTIC SWI_n_EngIdle "Application switch to select input signal: 0 = use both iv_n_EngIdle and iv_n_EngIdleExt 1 = use iv_n_EngIdle 2 = use iv_n_EngIdleExt" VALUE 0x217F8A ZF_KW_NAT8_S2_S3 2 SAB_STANDARD_S2_S3 0 2 /end CHARACTERISTIC
/begin CHARACTERISTIC D_u_BattLth_ENGSIG "Test condition battery-voltage threshold for the Diagnosis of Engine signals" VALUE 0x218194 ZF_KW_NAT16_S2_S3 20 SAB_U_1VOLT1000_S2_S3 0 20 /end CHARACTERISTIC
/begin CHARACTERISTIC SWI_EngMonitor_1ENGSIGTRQ "Datafield to switch on/off monitoring torque-failure" VALUE 0x217F8B ZF_KW_NAT8_S2_S3 255 SAB_STANDARD_S2_S3 0 255 /end CHARACTERISTIC
/begin CHARACTERISTIC SWI_EngMonitor_2ENGSIGTRQ "Datafield to switch on/off monitoring torque-failure" VALUE 0x217F8C ZF_KW_NAT8_S2_S3 255 SAB_STANDARD_S2_S3 0 255 /end CHARACTERISTIC
/begin CHARACTERISTIC SWI_UseNEmSignalStatus "Switch to check the message status relative to the error flag of the engine speed" VALUE 0x217F8D ZF_KW_NAT8_S2_S3 1 SAB_STANDARD_S2_S3 0 1 /end CHARACTERISTIC
/begin CHARACTERISTIC D_u_BattLth_PINFO "battery-voltage threshold for KFC_PINFO" VALUE 0x2181A4 ZF_KW_NAT16_S2_S3 20 SAB_U_1VOLT1000_S2_S3 0 20 /end CHARACTERISTIC
/begin CHARACTERISTIC SWI_GearLimitSubst_L "4-lower bytes of bitmask to check if GearLimit must be set" VALUE 0x201EC8 ZF_KW_NAT32_S2_S3 4.29497E+009 SAB_STANDARD_S2_S3 0 4294967295 /end CHARACTERISTIC
/begin CHARACTERISTIC SWI_GearLimitSubst_H "4-higher bytes of bitmask to check if GearLimit must be set" VALUE 0x201ECC ZF_KW_NAT32_S2_S3 4.29497E+009 SAB_STANDARD_S2_S3 0 4294967295 /end CHARACTERISTIC
/begin CHARACTERISTIC D_n_AbLth "lower threshold of n_ab" VALUE 0x2181AA ZF_KW_NAT16_S2_S3 11000 SAB_N_1RPM_S2_S3 0 11000 /end CHARACTERISTIC
/begin CHARACTERISTIC D_n_AbUth "upper threshold of n_ab" VALUE 0x2181AC ZF_KW_NAT16_S2_S3 11000 SAB_N_1RPM_S2_S3 0 11000 /end CHARACTERISTIC
/begin CHARACTERISTIC D_ctl_GearLimit "gears to be suppressed when gear suppression is active" VALUE 0x217F99 ZF_KW_NAT8_S2_S3 63 SAB_STANDARD_S2_S3 0 63 /end CHARACTERISTIC
/begin CHARACTERISTIC D_CrankshaftStopPosition "Substitute value for crankshaft angular displacement" VALUE 0x217FA4 ZF_KW_NAT8_S2_S3 360 SAB_PHI_2GRAD_S2_S3 0 360 /end CHARACTERISTIC
/begin CHARACTERISTIC SWI_Inclination "0: keine Beruecksichtigung des CAN Signals 1: Beruecksichtigung des CAN Signals" VALUE 0x217FAD ZF_KW_NAT8_S2_S3 1 SAB_STANDARD_S2_S3 0 1 /end CHARACTERISTIC
/begin CHARACTERISTIC SWI_InclinationSignalNegated "0: leave CAN-signal 1: negate CAN-signal" VALUE 0x217FAE ZF_KW_NAT8_S2_S3 1 SAB_STANDARD_S2_S3 0 1 /end CHARACTERISTIC
/begin CHARACTERISTIC D_u_BattLth_DMEOBD "Low battery threshold to detect the fault code KFC_DMEOBD" VALUE 0x2181C6 ZF_KW_NAT16_S2_S3 24 SAB_U_1VOLT1000_S2_S3 0 24 /end CHARACTERISTIC
/begin CHARACTERISTIC D_u_BattLth_OBDCYCLES "Low battery threshold to detect the fault code KFC_OBDCYCLES" VALUE 0x2181C8 ZF_KW_NAT16_S2_S3 20 SAB_U_1VOLT1000_S2_S3 0 20 /end CHARACTERISTIC
/begin CHARACTERISTIC SWI_extended_analyse "Activation for analysis of message special coding with 0 = inactiv 1 = activ" VALUE 0x217FB1 ZF_KW_NAT8_S2_S3 1 SAB_STANDARD_S2_S3 0 1 /end CHARACTERISTIC
/begin CHARACTERISTIC D_n_EngOSModeTh "RPM Threshold for Engine" VALUE 0x2181CA ZF_KW_NAT16_S2_S3 65535 SAB_N_1RPM_S2_S3 0 65535 /end CHARACTERISTIC
/begin CHARACTERISTIC D_n_TuOSModeTh "RPM Threshold for Turbine" VALUE 0x2181CC ZF_KW_NAT16_S2_S3 65535 SAB_N_1RPM_S2_S3 0 65535 /end CHARACTERISTIC
/begin CHARACTERISTIC D_u_BattOSModeUth "If the battery voltage is upper than this threshold it is not possible to switch from OSMode Standby to OSMode Cruse" VALUE 0x2181CE ZF_KW_NAT16_S2_S3 65.535 SAB_U_1VOLT1000_S2_S3 0 65.535 /end CHARACTERISTIC
/begin CHARACTERISTIC D_u_BattOSModeLth "If the battery voltage is lower than this threshold it is not possible to switch from OSMode Standby to OSMode Cruse" VALUE 0x2181D0 ZF_KW_NAT16_S2_S3 65.535 SAB_U_1VOLT1000_S2_S3 0 65.535 /end CHARACTERISTIC
/begin CHARACTERISTIC D_n_Ab_PowerDownLth "lower threshold for n_Ab Powerdown condition - if n_Ab is lower this threshold the SBW may informed to enable the shutdown. - if n_Ab is greater this threshold the power down gets blocked." VALUE 0x2181D4 ZF_KW_NAT16_S2_S3 10000 SAB_N_1RPM_S2_S3 0 10000 /end CHARACTERISTIC
/begin CHARACTERISTIC D_tmr_PowerDown "delay time for powerdown condition. Delays the powerdown after ignition off. - this delay time occures before SBW gets informed to enable the shutdown." VALUE 0x2181D6 ZF_KW_NAT16_S2_S3 65000 SAB_T_10MS_S2_S3 0 65000 /end CHARACTERISTIC
/begin CHARACTERISTIC D_tmr_PowerDown_IEP "delay time for _SET_IEP_SHUTDOWN" VALUE 0x217FB5 ZF_KW_NAT8_S2_S3 2550 SAB_T_10MS_S2_S3 0 2550 /end CHARACTERISTIC
/begin CHARACTERISTIC D_DCM_DIAGOBD_IDENT1 "Application parameter 1 for diagnosis of logistic data. 0+1:OBD MY or hash value 2:Country variant bit coded 3:Identification of the variant in decimal 4:Revision of DCM in decimal 5:Labelindex in ASCII 6+7:Release level in decimal" CURVE 0x201ED0 ZF_TAB_NAT8_S2_S3 255 SAB_STANDARD_S2_S3 0 255
 /begin AXIS_DESCR FIX_AXIS NO_INPUT_QUANTITY SAB_STANDARD_S2_S3 8 0 7 FIX_AXIS_PAR_DIST 0 1 8 /end AXIS_DESCR
/end CHARACTERISTIC
/begin CHARACTERISTIC D_DCM_DIAGOBD_IDENT2 "Application parameter 1 for diagnosis of logistic data. 0+1:OBD MY or hash value 2:Country variant bit coded 3:Identification of the variant in decimal 4:Revision of DCM in decimal 5:Labelindex in ASCII 6+7: Release level in decimal" CURVE 0x201EDC ZF_TAB_NAT8_S2_S3 255 SAB_STANDARD_S2_S3 0 255
 /begin AXIS_DESCR FIX_AXIS NO_INPUT_QUANTITY SAB_STANDARD_S2_S3 8 0 7 FIX_AXIS_PAR_DIST 0 1 8 /end AXIS_DESCR
/end CHARACTERISTIC
/begin CHARACTERISTIC SWI_IG_HA_Learn "Appplication switch for activating rear axle ratio learning function (0 = deactivated 1 = activated)" VALUE 0x217FC7 ZF_KW_NAT8_S2_S3 1 SAB_STANDARD_S2_S3 0 1 /end CHARACTERISTIC
/begin CHARACTERISTIC D_tmr_IG_HA_LearnDif "Application parameter for time during which n_Ab must not change for more than D_n_AbDif" VALUE 0x2181F4 ZF_KW_NAT16_S2_S3 655350 SAB_T_TIMER_10MS_S2_S3 0 655350 /end CHARACTERISTIC
/begin CHARACTERISTIC D_n_AbDif "Application parameter for max difference of n_Ab during time D_tmr_IG_HA_LearnDif" VALUE 0x217FC8 ZF_KW_NAT8_S2_S3 255 SAB_N_1RPM_S2_S3 0 255 /end CHARACTERISTIC
/begin CHARACTERISTIC D_n_AbLearnLth "No description available" VALUE 0x2181F6 ZF_KW_NAT16_S2_S3 65535 SAB_N_1RPM_S2_S3 0 65535 /end CHARACTERISTIC
/begin CHARACTERISTIC D_Filt_v_WheelActiveAvgNew "Application parameter weighting the current value of v_WheelActiveAvg in filter algorithm" VALUE 0x217FC9 ZF_KW_NAT8_S2_S3 31 SAB_STANDARD_S2_S3 0 31 /end CHARACTERISTIC
/begin CHARACTERISTIC D_Filt_v_WheelActiveAvgOld "Application parameter weighting the former value of v_WheelActiveAvg in filter algorithm" VALUE 0x217FCA ZF_KW_NAT8_S2_S3 31 SAB_STANDARD_S2_S3 0 31 /end CHARACTERISTIC
/begin CHARACTERISTIC D_k_AbNew_HALearn "Applikationsgroesse Filter" VALUE 0x217FCB ZF_KW_NAT8_S2_S3 19 SAB_STANDARD_S2_S3 1 20 /end CHARACTERISTIC
/begin CHARACTERISTIC D_k_AbOld_HALearn "Applikationsgroesse Filter" VALUE 0x217FCC ZF_KW_NAT8_S2_S3 20 SAB_STANDARD_S2_S3 0 20 /end CHARACTERISTIC
/begin CHARACTERISTIC D_v_WheelDif "Application parameter for max difference of filtered v_WheelActiveAvg during time D_tmr_IG_HA_LearnDif" VALUE 0x2181F8 ZF_KW_NAT16_S2_S3 12.5 SAB_V_KMH16_S2_S3 0 12.5 /end CHARACTERISTIC
/begin CHARACTERISTIC D_IG_HA_Tab "Application parameter field filled with possible values for RearAxleRatio" CURVE 0x201EE8 ZF_TAB_NAT16_S2_S3 4.27 SAB_K100_S2_S3 0 4.27
 /begin AXIS_DESCR FIX_AXIS NO_INPUT_QUANTITY SAB_STANDARD_S2_S3 20 0 19 FIX_AXIS_PAR_DIST 0 1 20 /end AXIS_DESCR
/end CHARACTERISTIC
/begin CHARACTERISTIC xha_Wert_Nummax "Application parameter for max number of calculated RearAxleRatio values paramters will also be used by SABeeprom class" VALUE 0x217FCD ZF_KW_NAT8_S2_S3 30 SAB_STANDARD_S2_S3 0 30 /end CHARACTERISTIC
/begin CHARACTERISTIC s_mmm "Application parameter for the maximal allowed jitter of the torque signal mmm. This parameter defines the offset in min and max direction as well" VALUE 0x2181FA ZF_KW_NAT16_S2_S3 65535 SAB_M_1NM_S2_S3 0 65535 /end CHARACTERISTIC
/begin CHARACTERISTIC SWI_HA_Learn_Reset "Appplication switch for reseting rear axle ratio learning function (0xA5 = reset)" VALUE 0x217FCE ZF_KW_NAT8_S2_S3 255 SAB_STANDARD_S2_S3 0 255 /end CHARACTERISTIC
/begin CHARACTERISTIC SWI_ForceLearnRearAxleRatio "Appplication switch for activating Forced Learn (0=activated; 0xA5=deactivated)" VALUE 0x217FCF ZF_KW_NAT8_S2_S3 255 SAB_STANDARD_S2_S3 0 255 /end CHARACTERISTIC
/begin CHARACTERISTIC D_t_ForceLearnRearAxleRatio "Application parameter for Force Learn timer - set LearnedFlag when elapsed" VALUE 0x217FD0 ZF_KW_NAT8_S2_S3 2550 SAB_T_10S_S2_S3 0 2550 /end CHARACTERISTIC
/begin CHARACTERISTIC D_n_EngForceLearnRearAxleRatioOn "Engine speed threshold - needed to start forced learn" VALUE 0x2181FC ZF_KW_NAT16_S2_S3 20000 SAB_N_1RPM_S2_S3 0 20000 /end CHARACTERISTIC
/begin CHARACTERISTIC D_IG_HA_Default "Application parameter for default value of rear axle ratio if learning function passiv" VALUE 0x2181FE ZF_KW_NAT16_S2_S3 9.99 SAB_K100_S2_S3 0.01 10 /end CHARACTERISTIC
/begin CHARACTERISTIC D_t_hillholdDelay "start value for Delay-Timer of Hillhold function" VALUE 0x217FD1 ZF_KW_NAT8_S2_S3 2550 SAB_T_TIMER_10MS_S2_S3 0 2550 /end CHARACTERISTIC
/begin CHARACTERISTIC SWI_RCControlStoppNRC0x24 "SWI to activate ckeck stop during state Basic setting not running" VALUE 0x217FD2 ZF_KW_NAT8_S2_S3 1 SAB_STANDARD_S2_S3 0 1 /end CHARACTERISTIC
/begin CHARACTERISTIC D_ManualPreAdapService "manual start/stop Preadaption Service 0==deactivated 1==start" VALUE 0x217FD3 ZF_KW_NAT8_S2_S3 1 SAB_STANDARD_S2_S3 0 1 /end CHARACTERISTIC
/begin CHARACTERISTIC D_tmr_PreadaptionSOC0x80 "threshold time for accepted undefined Preadaption status" VALUE 0x218200 ZF_KW_NAT16_S2_S3 655350 SAB_T_TIMER_10MS_S2_S3 0 655350 /end CHARACTERISTIC
/begin CHARACTERISTIC D_MappingAbortPreadaption "Mapping table tester service SOC and costumer abort reason" MAP 0x201F14 ZF_TAB2D_NAT8_S2_S3 255 SAB_STANDARD_S2_S3 0 255
 /begin AXIS_DESCR FIX_AXIS NO_INPUT_QUANTITY SAB_STANDARD_S2_S3 32 0 31 FIX_AXIS_PAR_DIST 0 1 32 /end AXIS_DESCR
 /begin AXIS_DESCR FIX_AXIS NO_INPUT_QUANTITY SAB_STANDARD_S2_S3 3 0 2 FIX_AXIS_PAR_DIST 0 1 3 /end AXIS_DESCR
/end CHARACTERISTIC
/begin CHARACTERISTIC D_tmr_IEP_Test_LS1 "test time for IEP test power level 1" VALUE 0x218202 ZF_KW_NAT16_S2_S3 655350 SAB_T_TIMER_10MS_S2_S3 0 655350 /end CHARACTERISTIC
/begin CHARACTERISTIC D_tmr_IEP_Test_LS2 "test time for IEP test power level 2" VALUE 0x218204 ZF_KW_NAT16_S2_S3 655350 SAB_T_TIMER_10MS_S2_S3 0 655350 /end CHARACTERISTIC
/begin CHARACTERISTIC D_tmr_IEP_Test_LS3 "test time for IEP test power level 3" VALUE 0x218206 ZF_KW_NAT16_S2_S3 655350 SAB_T_TIMER_10MS_S2_S3 0 655350 /end CHARACTERISTIC
/begin CHARACTERISTIC SWI_EE_Update_PreConditions "Switch to select the conditions which have to be fulfilled (for bit coding see SWI_PreConditions)" VALUE 0x218208 ZF_KW_NAT16_S2_S3 65535 SAB_STANDARD_S2_S3 0 65535 /end CHARACTERISTIC
/begin CHARACTERISTIC D_RzNinCruise_KMN_Lo "The Bitmap defines the lower bits which has to be evaluated for relevant KMNs" VALUE 0x201B24 ZF_KW_NAT32_S2_S3 4.29497E+009 SAB_STANDARD_S2_S3 0 4294967295 /end CHARACTERISTIC
/begin CHARACTERISTIC D_RzNinCruise_KMN_Hi "The Bitmap defines the higher bits which has to be evaluated for relevant KMNs" VALUE 0x201B28 ZF_KW_NAT32_S2_S3 4.29497E+009 SAB_STANDARD_S2_S3 0 4294967295 /end CHARACTERISTIC
/begin CHARACTERISTIC D_t_delay_Limphome "Delay before the reset takes places when a relevant KFC is still active" VALUE 0x217F4F ZF_KW_NAT8_S2_S3 255 SAB_T_TIMER_1S_S2_S3 0 255 /end CHARACTERISTIC
/begin CHARACTERISTIC D_TabRzNinCruise_KFC "List of relevant KFCs that could lead to a KMN" CURVE 0x201B2C ZF_KL_NAT16_S2_S3 65535 SAB_STANDARD_S2_S3 0 65535
 /begin AXIS_DESCR STD_AXIS NO_INPUT_QUANTITY SAB_STANDARD_S2_S3 29 0 65535 DEPOSIT ABSOLUTE MONOTONY MON_INCREASE /end AXIS_DESCR
/end CHARACTERISTIC
/begin CHARACTERISTIC D_cnt_LimphomeRst "Maximum number of resets" VALUE 0x217F50 ZF_KW_NAT8_S2_S3 255 SAB_STANDARD_S2_S3 0 255 /end CHARACTERISTIC
/begin CHARACTERISTIC D_n_AbRzNinCruise "Minimum rpm of transmission output to allow RzN" VALUE 0x21810A ZF_KW_NAT16_S2_S3 11000 SAB_N_1RPM_S2_S3 0 11000 /end CHARACTERISTIC
/begin CHARACTERISTIC D_TabRzNinCruiseCnt_KFC "List of relevant KFCs that should be checked after a RzN reset. If one of those KFC is still active the reset failed" CURVE 0x201BA4 ZF_KL_NAT16_S2_S3 65535 SAB_STANDARD_S2_S3 0 65535
 /begin AXIS_DESCR STD_AXIS NO_INPUT_QUANTITY SAB_STANDARD_S2_S3 29 0 65535 DEPOSIT ABSOLUTE MONOTONY MON_INCREASE /end AXIS_DESCR
/end CHARACTERISTIC
/begin CHARACTERISTIC D_t_delay_LimphomeCnt "Delay before the global reset counters for failed or successful RzN resets will be incremented" VALUE 0x217F51 ZF_KW_NAT8_S2_S3 2550 SAB_T_10MS_S2_S3 0 2550 /end CHARACTERISTIC
/begin CHARACTERISTIC SWI_Brakelight_BRAKEx "Switch for Diagnosis of KFC_BRAKEF according to f_BrakeErr 0 = diag off 1 = diag breaklight on 2 = diag breaksignal on" VALUE 0x217F54 ZF_KW_NAT8_S2_S3 3 SAB_STANDARD_S2_S3 0 3 /end CHARACTERISTIC
/begin CHARACTERISTIC D_u_BattLth_BRAKEx "battery-voltage threshold for Diagnosis of KFC_BRAKEF" VALUE 0x21810C ZF_KW_NAT16_S2_S3 24 SAB_U_1VOLT1000_S2_S3 0 24 /end CHARACTERISTIC
/begin CHARACTERISTIC D_p_BrakeTh "pressure threshold for Lev2 output value" VALUE 0x217F55 ZF_KW_NAT8_S2_S3 127.5 SAB_P_BAR2_S2_S3 0 127.5 /end CHARACTERISTIC
/begin CHARACTERISTIC D_k_MtoP "constant for aproximating the brakepressure signal" VALUE 0x217F56 ZF_KW_NAT8_S2_S3 254 SAB_STANDARD_S2_S3 1 255 /end CHARACTERISTIC
/begin CHARACTERISTIC SWI_BrakeDiag_BRAKEx "Switch for Diagnosis of Brake Torque Signal" VALUE 0x217F57 ZF_KW_NAT8_S2_S3 1 SAB_STANDARD_S2_S3 0 1 /end CHARACTERISTIC
/begin CHARACTERISTIC SWI_SmokeCalc "Appplication switch for consideration of smoke limitation (0 = no consideration 1 = consideration)" VALUE 0x217F7B ZF_KW_NAT8_S2_S3 1 SAB_STANDARD_S2_S3 0 1 /end CHARACTERISTIC
/begin CHARACTERISTIC D_u_BattLth_DOOR "battery-voltage threshold" VALUE 0x218146 ZF_KW_NAT16_S2_S3 20 SAB_U_1VOLT1000_S2_S3 0 20 /end CHARACTERISTIC
/begin CHARACTERISTIC SWI_DoorD "Switch to select primary or secondary input signal of DoorD" VALUE 0x217F7C ZF_KW_NAT8_S2_S3 1 SAB_STANDARD_S2_S3 0 1 /end CHARACTERISTIC
/begin CHARACTERISTIC D_u_BattLth_SEAT "battery-voltage threshold" VALUE 0x218148 ZF_KW_NAT16_S2_S3 20 SAB_U_1VOLT1000_S2_S3 0 20 /end CHARACTERISTIC
/begin CHARACTERISTIC SWI_CalAbForEMSubVal "Schalter um als weiteren Ersatzwert fuer die EM Drehzahl die rueckgerechnete Abtriebsdrehzahl bereitzustellen" VALUE 0x217F8E ZF_KW_NAT8_S2_S3 1 SAB_STANDARD_S2_S3 0 1 /end CHARACTERISTIC
/begin CHARACTERISTIC D_i_C0_SecureClosed "Stromschwelle ab dem sich die C0 in Ueberanpressung befindet" VALUE 0x218196 ZF_KW_NAT16_S2_S3 6553.5 SAB_I_MA10_S2_S3 0 6553.5 /end CHARACTERISTIC
/begin CHARACTERISTIC SWI_LinExtrapolationEngVM "Switch to activate or deactivate linear extrapolation of engine speed" VALUE 0x217F8F ZF_KW_NAT8_S2_S3 1 SAB_STANDARD_S2_S3 0 1 /end CHARACTERISTIC
/begin CHARACTERISTIC D_n_ExtrapolationLimitUth "Upper extrapolation limit" VALUE 0x218198 ZF_KW_NAT16_S2_S3 65535 SAB_N_1RPM_S2_S3 0 65535 /end CHARACTERISTIC
/begin CHARACTERISTIC D_n_ExtrapolationLimitLth "Lower extrapolation limit" VALUE 0x21819A ZF_KW_NAT16_S2_S3 65535 SAB_N_1RPM_S2_S3 0 65535 /end CHARACTERISTIC
/begin CHARACTERISTIC D_n_EngRedNormal "Engine speed reduction threshold - not reduced" VALUE 0x21819C ZF_KW_NAT16_S2_S3 10000 SAB_N_1RPM_S2_S3 0 10000 /end CHARACTERISTIC
/begin CHARACTERISTIC D_n_EngRedShort "Engine speed reduction threshold - minor reduced" VALUE 0x21819E ZF_KW_NAT16_S2_S3 10000 SAB_N_1RPM_S2_S3 0 10000 /end CHARACTERISTIC
/begin CHARACTERISTIC D_n_EngRedHigh "Engine speed reduction threshold - severely reduced" VALUE 0x2181A0 ZF_KW_NAT16_S2_S3 10000 SAB_N_1RPM_S2_S3 0 10000 /end CHARACTERISTIC
/begin CHARACTERISTIC SWI_n_EngMaxRed "selector switch for sv_n_EngRed and sv_n_EngMaxRed calculation method" VALUE 0x217F90 ZF_KW_NAT8_S2_S3 3 SAB_STANDARD_S2_S3 0 3 /end CHARACTERISTIC
/begin CHARACTERISTIC SWI_CalcMinMom "switch to change the calculation of the output macros GET_M_MOT and GET_M_MOT_STATUS" VALUE 0x217F91 ZF_KW_NAT8_S2_S3 1 SAB_STANDARD_S2_S3 0 1 /end CHARACTERISTIC
/begin CHARACTERISTIC D_ThrottlePosition_Raw100 "Raw value for 100% ThrottleBlade" VALUE 0x217F92 ZF_KW_NAT8_S2_S3 199 SAB_1PROZENT_S2_S3 1 200 /end CHARACTERISTIC
/begin CHARACTERISTIC D_ThrottlePosition "Substitute value for ThrottleBlade" VALUE 0x217F93 ZF_KW_NAT8_S2_S3 100.006 SAB_1004PROZENT2550_S2_S3 0 100.00627451 /end CHARACTERISTIC
/begin CHARACTERISTIC D_ThrottlePositionVirt_Raw100 "Raw value for 100% virtual ThrottleBlade" VALUE 0x217F94 ZF_KW_NAT8_S2_S3 199 SAB_1PROZENT_S2_S3 1 200 /end CHARACTERISTIC
/begin CHARACTERISTIC D_ThrottlePositionVirt "Substitute value for virtual ThrottleBlade" VALUE 0x217F95 ZF_KW_NAT8_S2_S3 100.006 SAB_1004PROZENT2550_S2_S3 0 100.00627451 /end CHARACTERISTIC
/begin CHARACTERISTIC SWI_CGT_CCHIP "switch to select the desired output for the temprature over CAN SWI_CGT_CCHIP == 1: Chip SWI_CGT_CCHIP == 0: CGT" VALUE 0x217FA1 ZF_KW_NAT8_S2_S3 1 SAB_STANDARD_S2_S3 0 1 /end CHARACTERISTIC
/begin CHARACTERISTIC D_c_ChipOffset "offset between chiptemperature and oil temperature" VALUE 0x217FA2 ZF_KW_NAT8_S2_S3 25 SAB_C_1CEL_S2_S3 0 25 /end CHARACTERISTIC
/begin CHARACTERISTIC D_c_OilTransSubst "replacement value of gearbox oil temperature" VALUE 0x217FA3 ZF_KW_NAT8_S2_S3 255 SAB_C_CGT_1CEL_M40_S2_S3 -40 215 /end CHARACTERISTIC
/begin CHARACTERISTIC D_n_EngPlausi_CGTLEV2_CCHIP12LEV2 "engine / turbine speed threshold for inspection of plausibility" VALUE 0x2181C0 ZF_KW_NAT16_S2_S3 11000 SAB_N_1RPM_S2_S3 0 11000 /end CHARACTERISTIC
/begin CHARACTERISTIC D_t_Plausi_CGTLEV2_CCHIP12LEV2 "engine / turbine speed threshold for inspection of plausibility" VALUE 0x2181C2 ZF_KW_NAT16_S2_S3 6553.5 SAB_T_TIMER_S10_S2_S3 0 6553.5 /end CHARACTERISTIC
/begin CHARACTERISTIC SWI_LeverType "Parameter for type-selection of lever (automatic/sport/IEX E70) SWI_LeverType == 0 relative signal SWI_LeverType == 1 absolute signal" VALUE 0x217F96 ZF_KW_NAT8_S2_S3 2 SAB_STANDARD_S2_S3 0 2 /end CHARACTERISTIC
/begin CHARACTERISTIC SWI_PButtonSignal "Parameter for Park-taster-selection SWI_PButtonSignal == 0:use the both raw signals for parktaster SWI_PButtonSignal == 1:use the lever raw signal and the respective complement signal" VALUE 0x217F97 ZF_KW_NAT8_S2_S3 1 SAB_STANDARD_S2_S3 0 1 /end CHARACTERISTIC
/begin CHARACTERISTIC D_u_BattLth_POSINFO2 "battery-voltage threshold" VALUE 0x2181A6 ZF_KW_NAT16_S2_S3 20 SAB_U_1VOLT1000_S2_S3 0 20 /end CHARACTERISTIC
/begin CHARACTERISTIC D_u_BattLth_POSINFO1 "battery-voltage threshold" VALUE 0x2181A8 ZF_KW_NAT16_S2_S3 20 SAB_U_1VOLT1000_S2_S3 0 20 /end CHARACTERISTIC
/begin CHARACTERISTIC SWI_SignalSource "parameter to switch between S1 and S2-Data" VALUE 0x217F98 ZF_KW_NAT8_S2_S3 3 SAB_STANDARD_S2_S3 0 3 /end CHARACTERISTIC
/begin CHARACTERISTIC D_n_AbWheelTh "Activation threshold for f_n_AbWheelErr" VALUE 0x2181AE ZF_KW_NAT16_S2_S3 11000 SAB_N_1RPM_S2_S3 0 11000 /end CHARACTERISTIC
/begin CHARACTERISTIC D_n_AbWheelThRtn "Deactivation threshold for f_n_AbWheelErr" VALUE 0x2181B0 ZF_KW_NAT16_S2_S3 11000 SAB_N_1RPM_S2_S3 0 11000 /end CHARACTERISTIC
/begin CHARACTERISTIC D_n_Abn6Th "Activation threshold for f_n_Abn6Err" VALUE 0x2181B2 ZF_KW_NAT16_S2_S3 11000 SAB_N_1RPM_S2_S3 0 11000 /end CHARACTERISTIC
/begin CHARACTERISTIC D_n_Abn6ThRtn "Deactivation threshold for f_n_Abn6Err" VALUE 0x2181B4 ZF_KW_NAT16_S2_S3 11000 SAB_N_1RPM_S2_S3 0 11000 /end CHARACTERISTIC
/begin CHARACTERISTIC D_n6WheelTh "Activation threshold for f_n6WheelErr" VALUE 0x2181B6 ZF_KW_NAT16_S2_S3 11000 SAB_N_1RPM_S2_S3 0 11000 /end CHARACTERISTIC
/begin CHARACTERISTIC D_n6WheelThRtn "Deactivation threshold for f_n6WheelErr" VALUE 0x2181B8 ZF_KW_NAT16_S2_S3 11000 SAB_N_1RPM_S2_S3 0 11000 /end CHARACTERISTIC
/begin CHARACTERISTIC D_t_iGangDiagDelay "After this time has elapsed in a fixed gear the plausibility check is activated" VALUE 0x217F9A ZF_KW_NAT8_S2_S3 2550 SAB_T_TIMER_10MS_S2_S3 0 2550 /end CHARACTERISTIC
/begin CHARACTERISTIC SWI_SpdPlausiCompMeth "Switch to select calculation 0: nAb-related 1: nTu-related" VALUE 0x217F9B ZF_KW_NAT8_S2_S3 1 SAB_STANDARD_S2_S3 0 1 /end CHARACTERISTIC
/begin CHARACTERISTIC D_n_EngThTuPlausi "Activation threshold for turbine speed plausibility check - below this threshold the oil pressure is not sufficient to activate clutches - iGang is not reliable" VALUE 0x2181BA ZF_KW_NAT16_S2_S3 11000 SAB_N_1RPM_S2_S3 0 11000 /end CHARACTERISTIC
/begin CHARACTERISTIC D_t_nDiagDelay "After KL15 is switched to ON and this time has elapsed the plausibility check of - CAN provided - wheel speed signal is activated" VALUE 0x217F9C ZF_KW_NAT8_S2_S3 2550 SAB_T_TIMER_10MS_S2_S3 0 2550 /end CHARACTERISTIC
/begin CHARACTERISTIC D_t_IAEClose "This is the maximum time for a over pressure request of IAE" VALUE 0x217F9D ZF_KW_NAT8_S2_S3 2550 SAB_T_TIMER_10MS_S2_S3 0 2550 /end CHARACTERISTIC
/begin CHARACTERISTIC D_t_IAECloseDelay "If this time has elapsed it is assumed that the over pressure state has been reached by IAE" VALUE 0x217F9E ZF_KW_NAT8_S2_S3 2550 SAB_T_TIMER_10MS_S2_S3 0 2550 /end CHARACTERISTIC
/begin CHARACTERISTIC D_t_nTuVirtLev2Delay "Diagnose delay for plausibility check of n_TuVirt level_1 (iv_n_Tu) to level_2 (n_TuVirtLev2)" VALUE 0x217F9F ZF_KW_NAT8_S2_S3 2550 SAB_T_TIMER_10MS_S2_S3 0 2550 /end CHARACTERISTIC
/begin CHARACTERISTIC D_t_nTuVirtPlausiErrDelay "Diagnose delay for setting of f_n_TuVirtPlausiErr flag on a too big difference of n_TuVirt level_1 (iv_n_Tu) to level_2 (n_TuVirtLev2)" VALUE 0x217FA0 ZF_KW_NAT8_S2_S3 2550 SAB_T_TIMER_10MS_S2_S3 0 2550 /end CHARACTERISTIC
/begin CHARACTERISTIC D_n_EngTolTh "Allowed tolerance value of n_TuVirtLev2 to n_EM =n_Eng -- used in state IAE over pressure for a n6 plausibility check" VALUE 0x2181BC ZF_KW_NAT16_S2_S3 11000 SAB_N_1RPM_S2_S3 0 11000 /end CHARACTERISTIC
/begin CHARACTERISTIC D_n_TuTolTh "Allowed tolerance value of n_TuVirtLev2 to n_TuVirt Lev1" VALUE 0x2181BE ZF_KW_NAT16_S2_S3 11000 SAB_N_1RPM_S2_S3 0 11000 /end CHARACTERISTIC
/begin CHARACTERISTIC D_t_holdStateVehicleReadyToDrive "Maximum time the vehicle ready to drive bit has to be hold" VALUE 0x217FA5 ZF_KW_NAT8_S2_S3 25.5 SAB_T_TIMER_S10_S2_S3 0 25.5 /end CHARACTERISTIC
/begin CHARACTERISTIC D_t_ToStartVM "Time to debounce VehicleReadyToDrive in case of an electrical engine defect" VALUE 0x217FA6 ZF_KW_NAT8_S2_S3 2550 SAB_T_TIMER_10MS_S2_S3 0 2550 /end CHARACTERISTIC
/begin CHARACTERISTIC D_t_IgnFilter "dropout delay time of the terminal 15 pin- after switching off terminal 15 f_KL15_Pin keeps on for this amount of time" VALUE 0x217FA7 ZF_KW_NAT8_S2_S3 1000 SAB_T_TIMER_10MS_S2_S3 0 1000 /end CHARACTERISTIC
/begin CHARACTERISTIC D_u_KL15_PinLth "lower threshold to determine the f_KL15Pin on - if iv_u_KL15_Pin is lower D_u_KL15_PinLth then f_KL15Pin = (nat8)0) else f_KL15Pin = (nat8)1)" VALUE 0x2181C4 ZF_KW_NAT16_S2_S3 65.535 SAB_U_1VOLT1000_S2_S3 0 65.535 /end CHARACTERISTIC
/begin CHARACTERISTIC SWI_UseQualifier "1 = the diversity can signal is used 0 = the diversity can signal is not used" VALUE 0x217FA8 ZF_KW_NAT8_S2_S3 1 SAB_STANDARD_S2_S3 0 1 /end CHARACTERISTIC
/begin CHARACTERISTIC SWI_IgnPlausiActive "flag to activate or deactivate the plausible check for CAN signal against hardware signal" VALUE 0x217FA9 ZF_KW_NAT8_S2_S3 1 SAB_STANDARD_S2_S3 0 1 /end CHARACTERISTIC
/begin CHARACTERISTIC D_t_IgnPlausiTol "maximum time that allows a difference between CAN and hardware signal on state change ON_OFF" VALUE 0x217FAA ZF_KW_NAT8_S2_S3 2550 SAB_T_TIMER_10MS_S2_S3 0 2550 /end CHARACTERISTIC
/begin CHARACTERISTIC D_t_IgnDelayPin "Minimum value of the system timer to allow Kl15 PIN on" VALUE 0x217FAB ZF_KW_NAT8_S2_S3 2550 SAB_T_TIMER_10MS_S2_S3 0 2550 /end CHARACTERISTIC
/begin CHARACTERISTIC D_t_IgnPlausiDelay "Time to delay Kl15 CAN on after TCU startup" VALUE 0x217FAC ZF_KW_NAT8_S2_S3 2550 SAB_T_TIMER_10MS_S2_S3 0 2550 /end CHARACTERISTIC
/begin CHARACTERISTIC SWI_HIS_verbaut "Schalter fuer die Aktivierung des HIS Lernmodus. 0: HIS Learnmodus 1: HIS Ein 2: HIS Aus" VALUE 0x217FB0 ZF_KW_NAT8_S2_S3 2 SAB_STANDARD_S2_S3 0 2 /end CHARACTERISTIC
/begin CHARACTERISTIC SWI_LTog_PARK "Toggle event for backward filter KFC_PARK Bit 0: L3 Bit 1: L4" VALUE 0x217FB3 ZF_KW_NAT8_S2_S3 3 SAB_STANDARD_S2_S3 0 3 /end CHARACTERISTIC
/begin CHARACTERISTIC D_t_PosZMax_PARK "Maximum allowed time of iv_PSens1 and iv_PSens2 to be 0 at the same time" VALUE 0x217FB4 ZF_KW_NAT8_S2_S3 2550 SAB_T_TIMER_10MS_S2_S3 0 2550 /end CHARACTERISTIC
/begin CHARACTERISTIC SWI_PMA_RCP_FunctionActive "SWI to deactivate or activate the PMA function; 0: PMA function deactivated; 1: PMA function activated; 2: Activate PMA function from CAN" VALUE 0x217FB2 ZF_KW_NAT8_S2_S3 2 SAB_STANDARD_S2_S3 0 2 /end CHARACTERISTIC
/begin CHARACTERISTIC D_t_delay_N6LEV2 "A detected error is valid only if this timer is not active anymore" VALUE 0x217FB6 ZF_KW_NAT8_S2_S3 2550 SAB_T_TIMER_10MS_S2_S3 0 2550 /end CHARACTERISTIC
/begin CHARACTERISTIC D_u_BattLth_NWHEELLEV2 "Low battery threshold to detect the trouble code KFC_NWHEELLEV2" VALUE 0x2181D8 ZF_KW_NAT16_S2_S3 20 SAB_U_1VOLT1000_S2_S3 0 20 /end CHARACTERISTIC
/begin CHARACTERISTIC D_u_BattUth_NWHEELLEV2 "Upper battery threshold to detect the trouble code KFC_NWHEELLEV2" VALUE 0x2181DA ZF_KW_NAT16_S2_S3 20 SAB_U_1VOLT1000_S2_S3 0 20 /end CHARACTERISTIC
/begin CHARACTERISTIC D_t_delay_N6PLAUSILEV2 "A detected error is valide only if this timer is not active anymore" VALUE 0x217FB7 ZF_KW_NAT8_S2_S3 2550 SAB_T_TIMER_10MS_S2_S3 0 2550 /end CHARACTERISTIC
/begin CHARACTERISTIC D_u_BattLth_NWHEELPLAUSILEV2 "A detected error is valid only if battery voltage is higher than this threshold" VALUE 0x2181DC ZF_KW_NAT16_S2_S3 20 SAB_U_1VOLT1000_S2_S3 0 20 /end CHARACTERISTIC
/begin CHARACTERISTIC D_n_AbLth_NWHEELPLAUSILEV2 "A detected error is valid only if the vehicle speed is higher than this threshold" VALUE 0x2181DE ZF_KW_NAT16_S2_S3 11000 SAB_N_1RPM_S2_S3 0 11000 /end CHARACTERISTIC
/begin CHARACTERISTIC D_n_AbLth_SENSORLEV2 "Activation threshold for rpm plausibility check - below this speed the wheels may turn in different directions and leed to a wrong nWheelAvg" VALUE 0x2181E0 ZF_KW_NAT16_S2_S3 11000 SAB_N_1RPM_S2_S3 0 11000 /end CHARACTERISTIC
/begin CHARACTERISTIC D_t_delay_1SENSORLEV2 "a detected error is valid only if this timer has elapsed" VALUE 0x217FB8 ZF_KW_NAT8_S2_S3 2550 SAB_T_TIMER_10MS_S2_S3 0 2550 /end CHARACTERISTIC
/begin CHARACTERISTIC D_t_delay_SENSORLEV2 "a detected error is valid only if this timer has elapsed" VALUE 0x217FB9 ZF_KW_NAT8_S2_S3 2550 SAB_T_TIMER_10MS_S2_S3 0 2550 /end CHARACTERISTIC
/begin CHARACTERISTIC D_n_EngLth_SENSORLEV2 "Activation threshold for rpm plausibility check - below this threshold the oil pressure is not sufficient to activate clutches - iGang is not reliable" VALUE 0x2181E2 ZF_KW_NAT16_S2_S3 11000 SAB_N_1RPM_S2_S3 0 11000 /end CHARACTERISTIC
/begin CHARACTERISTIC D_t_delay_NTUVIRTLEV2 "A detected error is valid only if this time has elapsed" VALUE 0x217FBA ZF_KW_NAT8_S2_S3 2550 SAB_T_TIMER_10MS_S2_S3 0 2550 /end CHARACTERISTIC
/begin CHARACTERISTIC SWI_n_AbTuPlausi_SENSORLEV2 "Switch to enable check of a nTu-nAb error while a the rear axle ratio is not learned 0=Disabled 1=Enabled" VALUE 0x217FBB ZF_KW_NAT8_S2_S3 1 SAB_STANDARD_S2_S3 0 1 /end CHARACTERISTIC
/begin CHARACTERISTIC D_n_AbMin "minimal sensable output speed - reinit necessary to apply" VALUE 0x2181E4 ZF_KW_NAT16_S2_S3 16535 SAB_N_1RPM_S2_S3 0 16535 /end CHARACTERISTIC
/begin CHARACTERISTIC D_n_AbNoTeeth "number of trigger-wheels teeth - reinit necessary to apply" VALUE 0x217FBC ZF_KW_NAT8_S2_S3 254 SAB_STANDARD_S2_S3 1 255 /end CHARACTERISTIC
/begin CHARACTERISTIC D_t_n_AbOffset "timer for startup state to hold applicable RPM value D_n_AbOffsetLevel" VALUE 0x2181E6 ZF_KW_NAT16_S2_S3 25500 SAB_T_TIMER_10MS_S2_S3 0 25500 /end CHARACTERISTIC
/begin CHARACTERISTIC D_n_AbOffsetLevel "applicable RPM which is used after sensing the first tooth until more teeth are sensed or D_t_n_AbOffset is elapsed" VALUE 0x2181E8 ZF_KW_NAT16_S2_S3 65535 SAB_N_1RPM_S2_S3 0 65535 /end CHARACTERISTIC
/begin CHARACTERISTIC D_n_AbDirection "above this value check if the direction fits to the gearlevers position" VALUE 0x2181EA ZF_KW_NAT16_S2_S3 11000 SAB_N_1RPM_S2_S3 0 11000 /end CHARACTERISTIC
/begin CHARACTERISTIC D_n_TuMin "minimal sensable turbine speed - reinit necessary to apply" VALUE 0x2181EC ZF_KW_NAT16_S2_S3 16535 SAB_N_1RPM_S2_S3 0 16535 /end CHARACTERISTIC
/begin CHARACTERISTIC D_n_TuNoTeeth "number of teeth of turbine speed impulse wheel" VALUE 0x217FBD ZF_KW_NAT8_S2_S3 254 SAB_STANDARD_S2_S3 1 255 /end CHARACTERISTIC
/begin CHARACTERISTIC D_t_n_TuOffset "timer for startup state to hold applicable RPM value D_n_TuOffsetLevel" VALUE 0x2181EE ZF_KW_NAT16_S2_S3 25500 SAB_T_TIMER_10MS_S2_S3 0 25500 /end CHARACTERISTIC
/begin CHARACTERISTIC D_n_TuOffsetLevel "applicable RPM which is used after sensing the first tooth until more teeth are sensed or D_t_n_TuOffset is elapsed" VALUE 0x2181F0 ZF_KW_NAT16_S2_S3 65535 SAB_N_1RPM_S2_S3 0 65535 /end CHARACTERISTIC
/begin CHARACTERISTIC D_NAB_PulseWidthTypFw "typical pulsewidth for the direction forward for NAB" VALUE 0x217FBE ZF_KW_NAT8_S2_S3 255 SAB_T_TIMER_1US_S2_S3 0 255 /end CHARACTERISTIC
/begin CHARACTERISTIC D_NAB_PulseWidthTypBw "typical pulsewidth for the direction backward for NAB" VALUE 0x217FBF ZF_KW_NAT8_S2_S3 255 SAB_T_TIMER_1US_S2_S3 0 255 /end CHARACTERISTIC
/begin CHARACTERISTIC D_NAB_PulseWidthTolFw "tolerance of the forward-pulsewidth for NAB" VALUE 0x217FC0 ZF_KW_NAT8_S2_S3 255 SAB_T_TIMER_1US_S2_S3 0 255 /end CHARACTERISTIC
/begin CHARACTERISTIC D_NAB_PulseWidthTolBw "tolerance of the backward-pulsewidth for NAB" VALUE 0x217FC1 ZF_KW_NAT8_S2_S3 255 SAB_T_TIMER_1US_S2_S3 0 255 /end CHARACTERISTIC
/begin CHARACTERISTIC D_NT_PulseWidthTypFw "typical pulsewidth for the direction forward for NT" VALUE 0x217FC2 ZF_KW_NAT8_S2_S3 255 SAB_T_TIMER_1US_S2_S3 0 255 /end CHARACTERISTIC
/begin CHARACTERISTIC D_NT_PulseWidthTypBw "typical pulsewidth for the direction backward for NT" VALUE 0x217FC3 ZF_KW_NAT8_S2_S3 255 SAB_T_TIMER_1US_S2_S3 0 255 /end CHARACTERISTIC
/begin CHARACTERISTIC D_NT_PulseWidthTolFw "tolerance of the forward-pulsewidth for NT" VALUE 0x217FC4 ZF_KW_NAT8_S2_S3 255 SAB_T_TIMER_1US_S2_S3 0 255 /end CHARACTERISTIC
/begin CHARACTERISTIC D_NT_PulseWidthTolBw "tolerance of the backward-pulsewidth for NT" VALUE 0x217FC5 ZF_KW_NAT8_S2_S3 255 SAB_T_TIMER_1US_S2_S3 0 255 /end CHARACTERISTIC
/begin CHARACTERISTIC D_frq_HoldDirection "defined frequency threshold value of the speedsensor to hold the direction if frequency is higher than this value" VALUE 0x2181F2 ZF_KW_NAT16_S2_S3 15000 SAB_FRQ_1HZ_S2_S3 0 15000 /end CHARACTERISTIC
/begin CHARACTERISTIC D_n_TuDir "applicable direction for n_Tu for the start-up case when car accelerates to 1 pulse per sampling cycle 0=undefined 1=forward 2=backward 3=standstill 4=out of pulse wide range 5=implausible signal" VALUE 0x217FC6 ZF_KW_NAT8_S2_S3 5 SAB_STANDARD_S2_S3 0 5 /end CHARACTERISTIC
/begin CHARACTERISTIC D_t_delay_USENS "A detected error is valid only if this timer is not active anymore" VALUE 0x217FD4 ZF_KW_NAT8_S2_S3 2550 SAB_T_TIMER_10MS_S2_S3 0 2550 /end CHARACTERISTIC
/begin CHARACTERISTIC D_t_VUNPLAUSILEV2_pred "Zeit nach Gradientensprung waehrend der ein ABS-Ausfall die vehicle speed unplausible macht" VALUE 0x217FD5 ZF_KW_NAT8_S2_S3 2000 SAB_T_TIMER_10MS_S2_S3 0 2000 /end CHARACTERISTIC
/begin CHARACTERISTIC D_n_AbGraTh_VUNPLAUSILEV2_pred "Drehzahlschwelle zur Erkennung unzulaessig negativer Gradient wenn zunaechst kein ABS-Ausfall" VALUE 0x21820A ZF_KW_NAT16_S2_S3 11000 SAB_N_1RPM_S2_S3 0 11000 /end CHARACTERISTIC
/begin CHARACTERISTIC D_t_DelayGra_VUNPLAUSILEV2_pred "Entprellzeit fuer die Gradientenerkennung wenn zunaechst kein ABS-Ausfall" VALUE 0x217FD6 ZF_KW_NAT8_S2_S3 2550 SAB_T_TIMER_10MS_S2_S3 0 2550 /end CHARACTERISTIC
/begin CHARACTERISTIC D_n_AbLth_VUNPLAUSILEV2_pred "Drehzahlschwelle zur Aktivierung sv_v_unplausi wenn zunaechst kein ABS-Ausfall" VALUE 0x21820C ZF_KW_NAT16_S2_S3 11000 SAB_N_1RPM_S2_S3 0 11000 /end CHARACTERISTIC
/begin CHARACTERISTIC D_n_AbGraTh_VUNPLAUSILEV2 "Drehzahlschwelle zur Erkennung unzulaessig negativer Gradient" VALUE 0x21820E ZF_KW_NAT16_S2_S3 11000 SAB_N_1RPM_S2_S3 0 11000 /end CHARACTERISTIC
/begin CHARACTERISTIC D_n_AbGraThRtn_VUNPLAUSILEV2 "Drehzahlschwelle zur Erkennung Raederhochlauf" VALUE 0x218210 ZF_KW_NAT16_S2_S3 11000 SAB_N_1RPM_S2_S3 0 11000 /end CHARACTERISTIC
/begin CHARACTERISTIC D_n_AbLth_VUNPLAUSILEV2 "Drehzahlschwelle zur Aktivierung sv_v_unplausi" VALUE 0x218212 ZF_KW_NAT16_S2_S3 11000 SAB_N_1RPM_S2_S3 0 11000 /end CHARACTERISTIC
/begin CHARACTERISTIC D_n_AbDeactLth_VUNPLAUSILEV2 "Drehzahlschwelle zur Deaktivierung sv_v_unplausi" VALUE 0x218214 ZF_KW_NAT16_S2_S3 11000 SAB_N_1RPM_S2_S3 0 11000 /end CHARACTERISTIC
/begin CHARACTERISTIC D_t_DelayGra_VUNPLAUSILEV2 "Entprellzeit fuer die Gradientenerkennung" VALUE 0x217FD7 ZF_KW_NAT8_S2_S3 2550 SAB_T_TIMER_10MS_S2_S3 0 2550 /end CHARACTERISTIC
/begin CHARACTERISTIC D_t_DelayBrake_VUNPLAUSILEV2 "Entprellzeit zur Erkennung -Bremse geloest-" VALUE 0x217FD8 ZF_KW_NAT8_S2_S3 2550 SAB_T_TIMER_10MS_S2_S3 0 2550 /end CHARACTERISTIC
/begin CHARACTERISTIC D_t_DelayTo_VUNPLAUSILEV2 "Timeoutzeit zur Deaktivierung sv_v_unplausi" VALUE 0x218216 ZF_KW_NAT16_S2_S3 255000 SAB_T_TIMER_10MS_S2_S3 0 255000 /end CHARACTERISTIC
/begin CHARACTERISTIC D_t_DelayDeactGra_VUNPLAUSILEV2 "Entprellzeit zur Erkennung einer plausiblen Geschwindigkeit" VALUE 0x217FD9 ZF_KW_NAT8_S2_S3 2550 SAB_T_TIMER_10MS_S2_S3 0 2550 /end CHARACTERISTIC
/begin CHARACTERISTIC SWI_ABSOff_VUNPLAUSILEV2 "Schalter zum Deaktiven des ABS-Signals" VALUE 0x217FDA ZF_KW_NAT8_S2_S3 1 SAB_STANDARD_S2_S3 0 1 /end CHARACTERISTIC
/begin CHARACTERISTIC D_cdmaxGrad "adapt supply temp of model sampling points x: SAB_C_1CEL_M40 and sampling points y: Grad C/10s" CURVE 0x201F7C ZF_KL_NAT8_S2_S3 255 SAB_C_1CEL_S2_S3 0 255
 /begin AXIS_DESCR STD_AXIS NO_INPUT_QUANTITY SAB_C_CGT_1CEL_M40_S2_S3 6 -40 215 DEPOSIT ABSOLUTE MONOTONY MON_INCREASE /end AXIS_DESCR
/end CHARACTERISTIC
/begin CHARACTERISTIC D_c_OilMax_CGTLEV2 "Temperature difference for detecting a temperature jump" VALUE 0x217FE0 ZF_KW_NAT8_S2_S3 215 SAB_C_1CEL_S2_S3 0 215 /end CHARACTERISTIC
/begin CHARACTERISTIC D_c_OilHys_CGTLEV2 "Temperature difference to cancel a temperature jump" VALUE 0x217FE1 ZF_KW_NAT8_S2_S3 215 SAB_C_1CEL_S2_S3 0 215 /end CHARACTERISTIC
/begin CHARACTERISTIC D_c_TolWide_CGTLEV2 "Wide tolerance for iv_c_OilTrans at major temperature gradients" VALUE 0x217FE2 ZF_KW_NAT8_S2_S3 215 SAB_C_1CEL_S2_S3 0 215 /end CHARACTERISTIC
/begin CHARACTERISTIC D_c_TolClose_CGTLEV2 "Small tolerance for iv_c_OilTrans at major temperature gradients" VALUE 0x217FE3 ZF_KW_NAT8_S2_S3 215 SAB_C_1CEL_S2_S3 0 215 /end CHARACTERISTIC
/begin CHARACTERISTIC D_t_TolCheck1_CGTLEV2 "Time interval for adapting of cnt_Tolerance to the respective temperature range reduction" VALUE 0x21821A ZF_KW_NAT16_S2_S3 6553.5 SAB_T_TIMER_S10_S2_S3 0 6553.5 /end CHARACTERISTIC
/begin CHARACTERISTIC D_t_TolCheck2_CGTLEV2 "Time interval for adapting of cnt_Tolerance to the respective temperature range extention" VALUE 0x21821C ZF_KW_NAT16_S2_S3 6553.5 SAB_T_TIMER_S10_S2_S3 0 6553.5 /end CHARACTERISTIC
/begin CHARACTERISTIC D_t_PlausiMaxErr_CGTLEV2 "Threshold value for error filtering" VALUE 0x21821E ZF_KW_NAT16_S2_S3 6553.5 SAB_T_TIMER_S10_S2_S3 0 6553.5 /end CHARACTERISTIC
/begin CHARACTERISTIC D_t_PlausiMaxErrRtn_CGTLEV2 "time for backward filtering of the plausibility flags" VALUE 0x218220 ZF_KW_NAT16_S2_S3 6553.5 SAB_T_TIMER_S10_S2_S3 0 6553.5 /end CHARACTERISTIC
/begin CHARACTERISTIC D_c_TolCheck_CGTLEV2 "Schwelle in der sich die Temperatur bewegen darf damit auf das kleine Temperaturband umgeschaltet werden kann" VALUE 0x217FE4 ZF_KW_NAT8_S2_S3 215 SAB_C_1CEL_S2_S3 0 215 /end CHARACTERISTIC
/begin CHARACTERISTIC D_t_DiagDelay_CCHIP12LEV2 "Zeit in der eine Abweischung zwischen den CChip Sensoren vorhanden sein muss" VALUE 0x218222 ZF_KW_NAT16_S2_S3 6553.5 SAB_T_TIMER_S10_S2_S3 0 6553.5 /end CHARACTERISTIC
/begin CHARACTERISTIC D_t_DiagDelayRtn_CCHIP12LEV2 "time for backward filtering of the plausibility flags" VALUE 0x218224 ZF_KW_NAT16_S2_S3 6553.5 SAB_T_TIMER_S10_S2_S3 0 6553.5 /end CHARACTERISTIC
/begin CHARACTERISTIC D_c_Th_CCHIP12LEV2 "Schwelle Plaisibilisierung der CChip Sensor" VALUE 0x217FE5 ZF_KW_NAT8_S2_S3 215 SAB_C_1CEL_S2_S3 0 215 /end CHARACTERISTIC
/begin CHARACTERISTIC SWI_Source_Nab_NWheel "switch to choose the n_Ab output source" VALUE 0x217FED ZF_KW_NAT8_S2_S3 2 SAB_STANDARD_S2_S3 0 2 /end CHARACTERISTIC
/begin CHARACTERISTIC D_tmr_Init_n_AbFilt_aktiv "time how long the init value of N_AB is sent over CAN" VALUE 0x21822A ZF_KW_NAT16_S2_S3 2000 SAB_T_TIMER_10MS_S2_S3 0 2000 /end CHARACTERISTIC
/begin CHARACTERISTIC D_n_Init_AbFilt_CAN "Init value of N_AB which is sent over CAN" VALUE 0x21822C ZF_KW_NAT16_S2_S3 65535 SAB_N_1RPM_S2_S3 0 65535 /end CHARACTERISTIC
/begin CHARACTERISTIC SWI_n_AbMaxCalc "switch to choose between Max Selection Variants 0=GET_NAB_MAX = GET_NAB 1=GET_NAB_MAX = MAX Select outside a defined gear and a difference between n_Ab and n_WheelAvg 2=GET_NAB_MAX = MAX Select always" VALUE 0x217FEE ZF_KW_NAT8_S2_S3 2 SAB_STANDARD_S2_S3 0 2 /end CHARACTERISTIC
/begin CHARACTERISTIC D_t_DelayNAbMaxCalc "debounce timer after unplausi before MAX selection is used" VALUE 0x217FEF ZF_KW_NAT8_S2_S3 1275 SAB_T_TIMER_5MS_S2_S3 0 1275 /end CHARACTERISTIC
/begin CHARACTERISTIC D_k_AbOld_CAN "filtering-factor of n_AbFilt" VALUE 0x217FF0 ZF_KW_NAT8_S2_S3 20 SAB_STANDARD_S2_S3 0 20 /end CHARACTERISTIC
/begin CHARACTERISTIC D_k_AbNew_CAN "filtering-factor of n_AbFilt" VALUE 0x217FF1 ZF_KW_NAT8_S2_S3 19 SAB_STANDARD_S2_S3 1 20 /end CHARACTERISTIC
/begin MEASUREMENT ZFFSAB._.HandBrakeIn.iv_HandBrake "CAN-Rawsignal: GETBUS0_RX_ST_CT_HABR :: Dieses Signal enthaelt den gefilterten Zustand des Handbremsschaltkontaktes. E60: Dieses Signal wird nicht versandt." UBYTE SAB_STANDARD_S2_S3 1 100 0 3 DISPLAY_IDENTIFIER iv_HandBrake.HandBrakeIn._.ZFFSAB ECU_ADDRESS 0xFFF9008D /end MEASUREMENT
/begin MEASUREMENT ZFFSAB._.HandBrakeIn.iv_HandBrakeSts "Status for the CAN-Signal: GETBUS0_RX_ST_CT_HABR :: Bit coded- 0:Signal Ok 1:Time-Out 2:Bus error 3:CAN-version error 4:Checksum error 5:Alive counter error 6:Level 2 error 7:Complement error 8:Bus deactivated or Msg not received on StartUp" UBYTE SAB_STANDARD_S2_S3 1 100 0 255 DISPLAY_IDENTIFIER iv_HandBrakeSts.HandBrakeIn._.ZFFSAB ECU_ADDRESS 0xFFF9008E /end MEASUREMENT
/begin MEASUREMENT ZFFSAB._.HandBrakeIn.sv_f_HandBrake "Output signal of GET_PARKING_BRAKE: 0=Parking brake not active 1=Parking brake active" UBYTE SAB_STANDARD_S2_S3 1 100 0 1 DISPLAY_IDENTIFIER sv_f_HandBrake.HandBrakeIn._.ZFFSAB ECU_ADDRESS 0xFFF9008F /end MEASUREMENT
/begin MEASUREMENT ZFFSAB._.HandBrakeIn.sv_HandBrakeSts "Output signal status: 0=no error 1=dynamic substitute signal 2=static substitute signal" UBYTE SAB_STANDARD_S2_S3 1 100 0 2 DISPLAY_IDENTIFIER sv_HandBrakeSts.HandBrakeIn._.ZFFSAB ECU_ADDRESS 0xFFF90090 /end MEASUREMENT
/begin MEASUREMENT ZFFSAB._.HandBrakeIn.f_HandBrakeErr "Error flag for local diagnosis: 0=no error 1=error detected" UBYTE SAB_STANDARD_S2_S3 1 100 0 1 DISPLAY_IDENTIFIER f_HandBrakeErr.HandBrakeIn._.ZFFSAB ECU_ADDRESS 0xFFF90091 /end MEASUREMENT
/begin MEASUREMENT ZFFSAB._.DrivingStabilitySystemError.iv_ASCPas "CAN-Rawsignal: GETCANFA_RX_QU_FN_FDR :: Funktions-Qualifier zur FDR." UWORD SAB_STANDARD_S2_S3 1 100 0 4095 DISPLAY_IDENTIFIER iv_ASCPas.DrivingStabilitySystemError._.ZFFSAB ECU_ADDRESS 0xFFF8F4DC /end MEASUREMENT
/begin MEASUREMENT ZFFSAB._.DrivingStabilitySystemError.iv_ASCReg "CAN-Rawsignal: GETCANFA_RX_QU_FN_ASC :: Funktions-Qualifier zur ASC." UWORD SAB_STANDARD_S2_S3 1 100 0 4095 DISPLAY_IDENTIFIER iv_ASCReg.DrivingStabilitySystemError._.ZFFSAB ECU_ADDRESS 0xFFF8F4DE /end MEASUREMENT
/begin MEASUREMENT ZFFSAB._.DrivingStabilitySystemError.iv_ABSReg "CAN-Rawsignal: GETCANFA_RX_QU_FN_ABS :: Funktions-Qualifier zur ABS." UWORD SAB_STANDARD_S2_S3 1 100 0 4095 DISPLAY_IDENTIFIER iv_ABSReg.DrivingStabilitySystemError._.ZFFSAB ECU_ADDRESS 0xFFF8F4E0 /end MEASUREMENT
/begin MEASUREMENT ZFFSAB._.DrivingStabilitySystemError.sv_f_VehStabnSysErr "0= alle Stabilitaetssysteme sind betriebsbereit 1= mindestens ein Stabilitaetssystem hat eine Stoerung" UBYTE SAB_STANDARD_S2_S3 1 100 0 1 DISPLAY_IDENTIFIER sv_f_VehStabnSysErr.DrivingStabilitySystemError._.ZFFSAB ECU_ADDRESS 0xFFF8F4E2 /end MEASUREMENT
/begin MEASUREMENT ZFFSAB._.DrivingStabilitySystemError.f_ASCPasRdy "f_ASCPasRdy" UBYTE SAB_STANDARD_S2_S3 1 100 0 1 DISPLAY_IDENTIFIER f_ASCPasRdy.DrivingStabilitySystemError._.ZFFSAB ECU_ADDRESS 0xFFF8F4E3 /end MEASUREMENT
/begin MEASUREMENT ZFFSAB._.DrivingStabilitySystemError.f_ABSRdy "f_ABSRdy" UBYTE SAB_STANDARD_S2_S3 1 100 0 1 DISPLAY_IDENTIFIER f_ABSRdy.DrivingStabilitySystemError._.ZFFSAB ECU_ADDRESS 0xFFF8F4E4 /end MEASUREMENT
/begin MEASUREMENT ZFFSAB._.DrivingStabilitySystemError.f_ASCRegRdy "f_ASCRegRdy" UBYTE SAB_STANDARD_S2_S3 1 100 0 1 DISPLAY_IDENTIFIER f_ASCRegRdy.DrivingStabilitySystemError._.ZFFSAB ECU_ADDRESS 0xFFF8F4E5 /end MEASUREMENT
/begin MEASUREMENT ZFFSAB._.ASCRegIn.iv_ASCReg "CAN-Rawsignal: GETCANFA_RX_QU_FN_ASC :: Funktions-Qualifier zur ASC." UWORD SAB_STANDARD_S2_S3 1 100 0 4095 DISPLAY_IDENTIFIER iv_ASCReg.ASCRegIn._.ZFFSAB ECU_ADDRESS 0xFFF8F4E8 /end MEASUREMENT
/begin MEASUREMENT ZFFSAB._.ASCRegIn.iv_ASCRegSts "CAN-Rawsignal: GETCANFA_RX_QU_FN_ASC :: Funktions-Qualifier zur ASC." UBYTE SAB_STANDARD_S2_S3 1 100 0 255 DISPLAY_IDENTIFIER iv_ASCRegSts.ASCRegIn._.ZFFSAB ECU_ADDRESS 0xFFF8F4EA /end MEASUREMENT
/begin MEASUREMENT ZFFSAB._.ASCRegIn.sv_f_ASCReg "none" UBYTE SAB_STANDARD_S2_S3 1 100 0 1 DISPLAY_IDENTIFIER sv_f_ASCReg.ASCRegIn._.ZFFSAB ECU_ADDRESS 0xFFF8F4EB /end MEASUREMENT
/begin MEASUREMENT ZFFSAB._.ASCRegIn.sv_ASCRegSts "none" UBYTE SAB_STANDARD_S2_S3 1 100 0 2 DISPLAY_IDENTIFIER sv_ASCRegSts.ASCRegIn._.ZFFSAB ECU_ADDRESS 0xFFF8F4EC /end MEASUREMENT
/begin MEASUREMENT ZFFSAB._.ASCRegIn.sv_f_AscErr2 "none" UBYTE SAB_STANDARD_S2_S3 1 100 0 1 DISPLAY_IDENTIFIER sv_f_AscErr2.ASCRegIn._.ZFFSAB ECU_ADDRESS 0xFFF8F4ED /end MEASUREMENT
/begin MEASUREMENT ZFFSAB._.ASCRegIn.f_AscRegErr "none" UBYTE SAB_STANDARD_S2_S3 1 100 0 1 DISPLAY_IDENTIFIER f_AscRegErr.ASCRegIn._.ZFFSAB ECU_ADDRESS 0xFFF8F4EE /end MEASUREMENT
/begin MEASUREMENT ZFFSAB._.CDD_GearboxState.iv_u_BattFilt "filtered battery voltage used for test conditions" UWORD SAB_U_VOLT1000_S2_S3 1 100 0 65.535 DISPLAY_IDENTIFIER iv_u_BattFilt.CDD_GearboxState._.ZFFSAB ECU_ADDRESS 0xFFF8F5CC /end MEASUREMENT
/begin MEASUREMENT ZFFSAB._.CDD_GearboxState.iv_Fet0Active "Input value for state of FET0: 0: FET switched off by ZF 1: FET switched on by ZF 2: FET is switched off by HW 3: FET is currently tested by HW 4: FET is currently switched off due to undervoltage." UBYTE SAB_STANDARD_S2_S3 1 100 0 255 DISPLAY_IDENTIFIER iv_Fet0Active.CDD_GearboxState._.ZFFSAB ECU_ADDRESS 0xFFF8F5CE /end MEASUREMENT
/begin MEASUREMENT ZFFSAB._.CDD_GearboxState.iv_i_Out0 "Target current on Out0" UWORD SAB_I_MA10_S2_S3 1 100 0 6553.5 DISPLAY_IDENTIFIER iv_i_Out0.CDD_GearboxState._.ZFFSAB ECU_ADDRESS 0xFFF8F5D0 /end MEASUREMENT
/begin MEASUREMENT ZFFSAB._.CDD_GearboxState.iv_i_Out1 "Target current on Out1" UWORD SAB_I_MA10_S2_S3 1 100 0 6553.5 DISPLAY_IDENTIFIER iv_i_Out1.CDD_GearboxState._.ZFFSAB ECU_ADDRESS 0xFFF8F5D2 /end MEASUREMENT
/begin MEASUREMENT ZFFSAB._.CDD_GearboxState.iv_i_Out2 "Target current on Out2" UWORD SAB_I_MA10_S2_S3 1 100 0 6553.5 DISPLAY_IDENTIFIER iv_i_Out2.CDD_GearboxState._.ZFFSAB ECU_ADDRESS 0xFFF8F5D4 /end MEASUREMENT
/begin MEASUREMENT ZFFSAB._.CDD_GearboxState.iv_i_Out3 "Target current on Out3" UWORD SAB_I_MA10_S2_S3 1 100 0 6553.5 DISPLAY_IDENTIFIER iv_i_Out3.CDD_GearboxState._.ZFFSAB ECU_ADDRESS 0xFFF8F5D6 /end MEASUREMENT
/begin MEASUREMENT ZFFSAB._.CDD_GearboxState.iv_i_Out4 "Target current on Out4" UWORD SAB_I_MA10_S2_S3 1 100 0 6553.5 DISPLAY_IDENTIFIER iv_i_Out4.CDD_GearboxState._.ZFFSAB ECU_ADDRESS 0xFFF8F5D8 /end MEASUREMENT
/begin MEASUREMENT ZFFSAB._.CDD_GearboxState.iv_i_Out5 "Target current on Out5" UWORD SAB_I_MA10_S2_S3 1 100 0 6553.5 DISPLAY_IDENTIFIER iv_i_Out5.CDD_GearboxState._.ZFFSAB ECU_ADDRESS 0xFFF8F5DA /end MEASUREMENT
/begin MEASUREMENT ZFFSAB._.CDD_GearboxState.iv_i_Out6 "Target current on Out6" UWORD SAB_I_MA10_S2_S3 1 100 0 6553.5 DISPLAY_IDENTIFIER iv_i_Out6.CDD_GearboxState._.ZFFSAB ECU_ADDRESS 0xFFF8F5DC /end MEASUREMENT
/begin MEASUREMENT ZFFSAB._.CDD_GearboxState.iv_i_Out7 "Target current on Out7" UWORD SAB_I_MA10_S2_S3 1 100 0 6553.5 DISPLAY_IDENTIFIER iv_i_Out7.CDD_GearboxState._.ZFFSAB ECU_ADDRESS 0xFFF8F5DE /end MEASUREMENT
/begin MEASUREMENT ZFFSAB._.CDD_GearboxState.iv_Pos "Gear lever position 0=D1 1=D2 2=D3 3=D4 4=D5 5=D 6=N 7=R 8=P" UBYTE SAB_STANDARD_S2_S3 1 100 0 8 DISPLAY_IDENTIFIER iv_Pos.CDD_GearboxState._.ZFFSAB ECU_ADDRESS 0xFFF8F5E0 /end MEASUREMENT
/begin MEASUREMENT ZFFSAB._.CDD_GearboxState.sv_StatusLimphome "Output of limp-home LH status: 0: No LH active normal case 1: Hydr. LH active LSS off 2: Mech. LH active HSS off 3: LH active LSS and HSS off For ASIL-C states 1 2 3 must be treated together as LH active!" UBYTE SAB_STANDARD_S2_S3 1 100 0 3 DISPLAY_IDENTIFIER sv_StatusLimphome.CDD_GearboxState._.ZFFSAB ECU_ADDRESS 0xFFF8F5E1 /end MEASUREMENT
/begin MEASUREMENT ZFFSAB._.CDD_GearboxState.sv_StatusLimphome_ "Output complement signal of limphome status" UBYTE SAB_STANDARD_S2_S3 1 100 0 255 DISPLAY_IDENTIFIER sv_StatusLimphome_.CDD_GearboxState._.ZFFSAB ECU_ADDRESS 0xFFF8F5E2 /end MEASUREMENT
/begin MEASUREMENT ZFFSAB._.CDD_GearboxState.f_LssOpen "Flag set to true if all LSS are open" UBYTE SAB_STANDARD_S2_S3 1 100 0 1 DISPLAY_IDENTIFIER f_LssOpen.CDD_GearboxState._.ZFFSAB ECU_ADDRESS 0xFFF8F5E3 /end MEASUREMENT
/begin MEASUREMENT ZFFSAB._.CDD_GearboxState.f_HssOpen "Flag set to true if HSS is open" UBYTE SAB_STANDARD_S2_S3 1 100 0 1 DISPLAY_IDENTIFIER f_HssOpen.CDD_GearboxState._.ZFFSAB ECU_ADDRESS 0xFFF8F5E4 /end MEASUREMENT
/begin MEASUREMENT ZFFSAB._.DesiredBrakeTorqueIn.iv_BrakeTorqDvch "Aktuelles radbezogenes Bremsmoment das der Fahrer ueber das Bremspedal versucht zu stellen. Ein negatives Bremsmoment entspricht einer Rebikraft entgegen der Fahrzeugbewegung 0..32000 = Bremsmoment 0xFFFF = Fehlerwert" UWORD SAB_M_NM_M32000_S2_S3 1 100 -32000 33535 DISPLAY_IDENTIFIER iv_BrakeTorqDvch.DesiredBrakeTorqueIn._.ZFFSAB ECU_ADDRESS 0xFFF90074 /end MEASUREMENT
/begin MEASUREMENT ZFFSAB._.DesiredBrakeTorqueIn.iv_BrakeTorqDvchSts "Status for the CAN-Signal: GETCAN_RX_AVL_TORQ_CRSH :: Bit coded- 0:Signal Ok 1:Time-Out 2:Bus error 3:CAN-version error 4:Checksum error 5:Alive counter error 6:Level 2 error 7:Complement error 8:Bus deactivated or Msg not received on StartUp" UBYTE SAB_STANDARD_S2_S3 1 100 0 255 DISPLAY_IDENTIFIER iv_BrakeTorqDvchSts.DesiredBrakeTorqueIn._.ZFFSAB ECU_ADDRESS 0xFFF90076 /end MEASUREMENT
/begin MEASUREMENT ZFFSAB._.DesiredBrakeTorqueIn.iv_m_BrakeDvchQF "Erweiterter Status Qualifier zum Signal Ist_Bremsmoment_Fahrerwunsch 1000 = Initialisierung 0010 = Signalwert gueltig 0100 = Ersatzwert Nutzsignal gesetzt 1100 = Abgeleichswert Nutzsignal gesetzt 0110 = Signalwert ist ungueltig 1111 = Signal ungueltig" UBYTE SAB_STANDARD_S2_S3 1 100 0 255 DISPLAY_IDENTIFIER iv_m_BrakeDvchQF.DesiredBrakeTorqueIn._.ZFFSAB ECU_ADDRESS 0xFFF90077 /end MEASUREMENT
/begin MEASUREMENT ZFFSAB._.DesiredBrakeTorqueIn.sv_m_BrakeDvch "Output signal of Ist_Bremsmoment_Summe_Fahrerwunsch: Aktuelles radbezogenes Bremsmoment das der Fahrer ueber das Bremspedal versucht zu stellen. 0...32000 = Aktuelles Bremsmoment 65535 = Fehlerwert" UWORD SAB_M_NM_M32000_S2_S3 1 100 -32000 33535 DISPLAY_IDENTIFIER sv_m_BrakeDvch.DesiredBrakeTorqueIn._.ZFFSAB ECU_ADDRESS 0xFFF90078 /end MEASUREMENT
/begin MEASUREMENT ZFFSAB._.DesiredBrakeTorqueIn.sv_m_BrakeDvch_AGS "Output signal of Ist_Bremsmoment_Summe_Fahrerwunsch: Aktuelles radbezogenes Bremsmoment das der Fahrer ueber das Bremspedal versucht zu stellen. 0...32000 = Aktuelles Bremsmoment 65535 = Fehlerwert" UWORD SAB_M_NM_M32000_S2_S3 1 100 -32000 33535 DISPLAY_IDENTIFIER sv_m_BrakeDvch_AGS.DesiredBrakeTorqueIn._.ZFFSAB ECU_ADDRESS 0xFFF9007A /end MEASUREMENT
/begin MEASUREMENT ZFFSAB._.DesiredBrakeTorqueIn.sv_m_BrakeTorqDvchSts "Output signal status: 0=no error 1=dynamic substitute signal 2=static substitute signal" UBYTE SAB_STANDARD_S2_S3 1 100 0 2 DISPLAY_IDENTIFIER sv_m_BrakeTorqDvchSts.DesiredBrakeTorqueIn._.ZFFSAB ECU_ADDRESS 0xFFF9007C /end MEASUREMENT
/begin MEASUREMENT ZFFSAB._.DesiredBrakeTorqueIn.f_m_BrakeDvchErr "Error flag for local diagnosis: 0=no error 1=error detected" UBYTE SAB_STANDARD_S2_S3 1 100 0 1 DISPLAY_IDENTIFIER f_m_BrakeDvchErr.DesiredBrakeTorqueIn._.ZFFSAB ECU_ADDRESS 0xFFF9007D /end MEASUREMENT
/begin MEASUREMENT ZFFSAB._.CDD_GearboxStateFl.iv_u_BattFiltInt "filtered battery voltage used for test conditions" UWORD SAB_U_VOLT1000_S2_S3 1 100 0 65.535 DISPLAY_IDENTIFIER iv_u_BattFiltInt.CDD_GearboxStateFl._.ZFFSAB ECU_ADDRESS 0xFFF8F7B4 /end MEASUREMENT
/begin MEASUREMENT ZFFSAB._.CDD_GearboxStateFl.iv_Fet0ActiveInt "Input value for state of FET0: 0: FET switched off by ZF 1: FET switched on by ZF 2: FET is switched off by HW 3: FET is currently tested by HW 4: FET is currently switched off due to undervoltage." UBYTE SAB_STANDARD_S2_S3 1 100 0 255 DISPLAY_IDENTIFIER iv_Fet0ActiveInt.CDD_GearboxStateFl._.ZFFSAB ECU_ADDRESS 0xFFF8F7B6 /end MEASUREMENT
/begin MEASUREMENT ZFFSAB._.CDD_GearboxStateFl.iv_Fet0ActiveInt_ "Input complement value for state of FET0" UBYTE SAB_STANDARD_S2_S3 1 100 0 255 DISPLAY_IDENTIFIER iv_Fet0ActiveInt_.CDD_GearboxStateFl._.ZFFSAB ECU_ADDRESS 0xFFF8F7B7 /end MEASUREMENT
/begin MEASUREMENT ZFFSAB._.CDD_GearboxStateFl.iv_i_Out0Int "Target current on Out0" UWORD SAB_I_MA10_S2_S3 1 100 0 6553.5 DISPLAY_IDENTIFIER iv_i_Out0Int.CDD_GearboxStateFl._.ZFFSAB ECU_ADDRESS 0xFFF8F7B8 /end MEASUREMENT
/begin MEASUREMENT ZFFSAB._.CDD_GearboxStateFl.iv_i_Out1Int "Target current on Out1" UWORD SAB_I_MA10_S2_S3 1 100 0 6553.5 DISPLAY_IDENTIFIER iv_i_Out1Int.CDD_GearboxStateFl._.ZFFSAB ECU_ADDRESS 0xFFF8F7BA /end MEASUREMENT
/begin MEASUREMENT ZFFSAB._.CDD_GearboxStateFl.iv_i_Out2Int "Target current on Out2" UWORD SAB_I_MA10_S2_S3 1 100 0 6553.5 DISPLAY_IDENTIFIER iv_i_Out2Int.CDD_GearboxStateFl._.ZFFSAB ECU_ADDRESS 0xFFF8F7BC /end MEASUREMENT
/begin MEASUREMENT ZFFSAB._.CDD_GearboxStateFl.iv_i_Out3Int "Target current on Out3" UWORD SAB_I_MA10_S2_S3 1 100 0 6553.5 DISPLAY_IDENTIFIER iv_i_Out3Int.CDD_GearboxStateFl._.ZFFSAB ECU_ADDRESS 0xFFF8F7BE /end MEASUREMENT
/begin MEASUREMENT ZFFSAB._.CDD_GearboxStateFl.iv_i_Out4Int "Target current on Out4" UWORD SAB_I_MA10_S2_S3 1 100 0 6553.5 DISPLAY_IDENTIFIER iv_i_Out4Int.CDD_GearboxStateFl._.ZFFSAB ECU_ADDRESS 0xFFF8F7C0 /end MEASUREMENT
/begin MEASUREMENT ZFFSAB._.CDD_GearboxStateFl.iv_i_Out5Int "Target current on Out5" UWORD SAB_I_MA10_S2_S3 1 100 0 6553.5 DISPLAY_IDENTIFIER iv_i_Out5Int.CDD_GearboxStateFl._.ZFFSAB ECU_ADDRESS 0xFFF8F7C2 /end MEASUREMENT
/begin MEASUREMENT ZFFSAB._.CDD_GearboxStateFl.iv_i_Out6Int "Target current on Out6" UWORD SAB_I_MA10_S2_S3 1 100 0 6553.5 DISPLAY_IDENTIFIER iv_i_Out6Int.CDD_GearboxStateFl._.ZFFSAB ECU_ADDRESS 0xFFF8F7C4 /end MEASUREMENT
/begin MEASUREMENT ZFFSAB._.CDD_GearboxStateFl.iv_i_Out7Int "Target current on Out7" UWORD SAB_I_MA10_S2_S3 1 100 0 6553.5 DISPLAY_IDENTIFIER iv_i_Out7Int.CDD_GearboxStateFl._.ZFFSAB ECU_ADDRESS 0xFFF8F7C6 /end MEASUREMENT
/begin MEASUREMENT ZFFSAB._.CDD_GearboxStateFl.iv_i_Out0Int_ "Complement of Target current on Out0" UWORD SAB_STANDARD_S2_S3 1 100 0 65535 DISPLAY_IDENTIFIER iv_i_Out0Int_.CDD_GearboxStateFl._.ZFFSAB ECU_ADDRESS 0xFFF8F7C8 /end MEASUREMENT
/begin MEASUREMENT ZFFSAB._.CDD_GearboxStateFl.iv_i_Out1Int_ "Complement of Target current on Out1" UWORD SAB_STANDARD_S2_S3 1 100 0 65535 DISPLAY_IDENTIFIER iv_i_Out1Int_.CDD_GearboxStateFl._.ZFFSAB ECU_ADDRESS 0xFFF8F7CA /end MEASUREMENT
/begin MEASUREMENT ZFFSAB._.CDD_GearboxStateFl.iv_i_Out2Int_ "Complement of Target current on Out2" UWORD SAB_STANDARD_S2_S3 1 100 0 65535 DISPLAY_IDENTIFIER iv_i_Out2Int_.CDD_GearboxStateFl._.ZFFSAB ECU_ADDRESS 0xFFF8F7CC /end MEASUREMENT
/begin MEASUREMENT ZFFSAB._.CDD_GearboxStateFl.iv_i_Out3Int_ "Complement of Target current on Out3" UWORD SAB_STANDARD_S2_S3 1 100 0 65535 DISPLAY_IDENTIFIER iv_i_Out3Int_.CDD_GearboxStateFl._.ZFFSAB ECU_ADDRESS 0xFFF8F7CE /end MEASUREMENT
/begin MEASUREMENT ZFFSAB._.CDD_GearboxStateFl.iv_i_Out4Int_ "Complement of Target current on Out4" UWORD SAB_STANDARD_S2_S3 1 100 0 65535 DISPLAY_IDENTIFIER iv_i_Out4Int_.CDD_GearboxStateFl._.ZFFSAB ECU_ADDRESS 0xFFF8F7D0 /end MEASUREMENT
/begin MEASUREMENT ZFFSAB._.CDD_GearboxStateFl.iv_i_Out5Int_ "Complement of Target current on Out5" UWORD SAB_STANDARD_S2_S3 1 100 0 65535 DISPLAY_IDENTIFIER iv_i_Out5Int_.CDD_GearboxStateFl._.ZFFSAB ECU_ADDRESS 0xFFF8F7D2 /end MEASUREMENT
/begin MEASUREMENT ZFFSAB._.CDD_GearboxStateFl.iv_i_Out6Int_ "Complement of Target current on Out6" UWORD SAB_STANDARD_S2_S3 1 100 0 65535 DISPLAY_IDENTIFIER iv_i_Out6Int_.CDD_GearboxStateFl._.ZFFSAB ECU_ADDRESS 0xFFF8F7D4 /end MEASUREMENT
/begin MEASUREMENT ZFFSAB._.CDD_GearboxStateFl.iv_i_Out7Int_ "Complement of Target current on Out7" UWORD SAB_STANDARD_S2_S3 1 100 0 65535 DISPLAY_IDENTIFIER iv_i_Out7Int_.CDD_GearboxStateFl._.ZFFSAB ECU_ADDRESS 0xFFF8F7D6 /end MEASUREMENT
/begin MEASUREMENT ZFFSAB._.CDD_GearboxStateFl.iv_PosInt "Gear lever position 0=D1 1=D2 2=D3 3=D4 4=D5 5=D 6=N 7=R 8=P" UBYTE SAB_STANDARD_S2_S3 1 100 0 8 DISPLAY_IDENTIFIER iv_PosInt.CDD_GearboxStateFl._.ZFFSAB ECU_ADDRESS 0xFFF8F7D8 /end MEASUREMENT
/begin MEASUREMENT ZFFSAB._.CDD_GearboxStateFl.iv_PosInt_ "Complement of GET_POS" UBYTE SAB_STANDARD_S2_S3 1 100 0 255 DISPLAY_IDENTIFIER iv_PosInt_.CDD_GearboxStateFl._.ZFFSAB ECU_ADDRESS 0xFFF8F7D9 /end MEASUREMENT
/begin MEASUREMENT ZFFSAB._.CDD_GearboxStateFl.StatusLimphomeFl "Output of limp-home LH status: 0: No LH active normal case 1: Hydr. LH active LSS off 2: Mech. LH active HSS off 3: LH active LSS and HSS off For ASIL-C states 1 2 3 must be treated together as LH active!" FLOAT32_IEEE SAB_STANDARD_S2_S3 1 100 0 3 FORMAT "%5.3" DISPLAY_IDENTIFIER StatusLimphomeFl.CDD_GearboxStateFl._.ZFFSAB ECU_ADDRESS 0xFFF8F7DC /end MEASUREMENT
/begin MEASUREMENT ZFFSAB._.CDD_GearboxStateFl.StatusLimphomeFl_ "Float output complement signal of Gearbox Staus" FLOAT32_IEEE SAB_STANDARD_S2_S3 1 100 -4 0 FORMAT "%5.3" DISPLAY_IDENTIFIER StatusLimphomeFl_.CDD_GearboxStateFl._.ZFFSAB ECU_ADDRESS 0xFFF8F7E0 /end MEASUREMENT
/begin MEASUREMENT ZFFSAB._.CDD_GearboxStateFl.f_LssOpenFl "Float flag set to true if All Lss open" FLOAT32_IEEE SAB_STANDARD_S2_S3 1 100 0 1 FORMAT "%5.3" DISPLAY_IDENTIFIER f_LssOpenFl.CDD_GearboxStateFl._.ZFFSAB ECU_ADDRESS 0xFFF8F7E4 /end MEASUREMENT
/begin MEASUREMENT ZFFSAB._.CDD_GearboxStateFl.f_HssOpenFl "Float flag set to true if Hss open" FLOAT32_IEEE SAB_STANDARD_S2_S3 1 100 0 1 FORMAT "%5.3" DISPLAY_IDENTIFIER f_HssOpenFl.CDD_GearboxStateFl._.ZFFSAB ECU_ADDRESS 0xFFF8F7E8 /end MEASUREMENT
/begin MEASUREMENT ZFFSAB._.CDD_GearboxStateFl.loc_iv_u_BattFiltFl "Float input filtered battery voltage used for test conditions" FLOAT32_IEEE SAB_U_VOLT1000_S2_S3 1 100 0 65.535 DISPLAY_IDENTIFIER loc_iv_u_BattFiltFl.CDD_GearboxStateFl._.ZFFSAB ECU_ADDRESS 0xFFF8F7EC /end MEASUREMENT
/begin MEASUREMENT ZFFSAB._.CDD_GearboxStateFl.loc_iv_Fet0ActiveFl "Flaot input complement value for state of FET0" FLOAT32_IEEE SAB_STANDARD_S2_S3 1 100 0 255 FORMAT "%5.3" DISPLAY_IDENTIFIER loc_iv_Fet0ActiveFl.CDD_GearboxStateFl._.ZFFSAB ECU_ADDRESS 0xFFF8F7F0 /end MEASUREMENT
/begin MEASUREMENT ZFFSAB._.CDD_GearboxStateFl.loc_iv_i_Out0Fl "Float target current on Out0" FLOAT32_IEEE SAB_I_MA10_S2_S3 1 100 0 6553.5 DISPLAY_IDENTIFIER loc_iv_i_Out0Fl.CDD_GearboxStateFl._.ZFFSAB ECU_ADDRESS 0xFFF8F7F4 /end MEASUREMENT
/begin MEASUREMENT ZFFSAB._.CDD_GearboxStateFl.loc_iv_i_Out1Fl "Float target current on Out1" FLOAT32_IEEE SAB_I_MA10_S2_S3 1 100 0 6553.5 DISPLAY_IDENTIFIER loc_iv_i_Out1Fl.CDD_GearboxStateFl._.ZFFSAB ECU_ADDRESS 0xFFF8F7F8 /end MEASUREMENT
/begin MEASUREMENT ZFFSAB._.CDD_GearboxStateFl.loc_iv_i_Out2Fl "Float target current on Out2" FLOAT32_IEEE SAB_I_MA10_S2_S3 1 100 0 6553.5 DISPLAY_IDENTIFIER loc_iv_i_Out2Fl.CDD_GearboxStateFl._.ZFFSAB ECU_ADDRESS 0xFFF8F7FC /end MEASUREMENT
/begin MEASUREMENT ZFFSAB._.CDD_GearboxStateFl.loc_iv_i_Out3Fl "Float target current on Out3" FLOAT32_IEEE SAB_I_MA10_S2_S3 1 100 0 6553.5 DISPLAY_IDENTIFIER loc_iv_i_Out3Fl.CDD_GearboxStateFl._.ZFFSAB ECU_ADDRESS 0xFFF8F800 /end MEASUREMENT
/begin MEASUREMENT ZFFSAB._.CDD_GearboxStateFl.loc_iv_i_Out4Fl "Float target current on Out4" FLOAT32_IEEE SAB_I_MA10_S2_S3 1 100 0 6553.5 DISPLAY_IDENTIFIER loc_iv_i_Out4Fl.CDD_GearboxStateFl._.ZFFSAB ECU_ADDRESS 0xFFF8F804 /end MEASUREMENT
/begin MEASUREMENT ZFFSAB._.CDD_GearboxStateFl.loc_iv_i_Out5Fl "Float target current on Out5" FLOAT32_IEEE SAB_I_MA10_S2_S3 1 100 0 6553.5 DISPLAY_IDENTIFIER loc_iv_i_Out5Fl.CDD_GearboxStateFl._.ZFFSAB ECU_ADDRESS 0xFFF8F808 /end MEASUREMENT
/begin MEASUREMENT ZFFSAB._.CDD_GearboxStateFl.loc_iv_i_Out6Fl "Float target current on Out6" FLOAT32_IEEE SAB_I_MA10_S2_S3 1 100 0 6553.5 DISPLAY_IDENTIFIER loc_iv_i_Out6Fl.CDD_GearboxStateFl._.ZFFSAB ECU_ADDRESS 0xFFF8F80C /end MEASUREMENT
/begin MEASUREMENT ZFFSAB._.CDD_GearboxStateFl.loc_iv_i_Out7Fl "Float target current on Out7" FLOAT32_IEEE SAB_I_MA10_S2_S3 1 100 0 6553.5 DISPLAY_IDENTIFIER loc_iv_i_Out7Fl.CDD_GearboxStateFl._.ZFFSAB ECU_ADDRESS 0xFFF8F810 /end MEASUREMENT
/begin MEASUREMENT ZFFSAB._.CDD_GearboxStateFl.loc_iv_PosFl "Float gear lever position 0=D1 1=D2 2=D3 3=D4 4=D5 5=D 6=N 7=R 8=P" FLOAT32_IEEE SAB_STANDARD_S2_S3 1 100 0 8 FORMAT "%5.3" DISPLAY_IDENTIFIER loc_iv_PosFl.CDD_GearboxStateFl._.ZFFSAB ECU_ADDRESS 0xFFF8F814 /end MEASUREMENT
/begin MEASUREMENT ZFFSAB._.ABSIn.iv_ABSReg "CAN-Rawsignal: GETCANFA_RX_QU_FN_ABS :: Funktions-Qualifier zur ABS. Die untersten 4 Bits dieses Signals koennen vom DSC fuer Entwicklungszwecke belegt werden sind aber nicht auszuwerten. Weitere Details finden sich im DSC-KomponentenLH" UWORD SAB_STANDARD_S2_S3 1 100 0 4095 DISPLAY_IDENTIFIER iv_ABSReg.ABSIn._.ZFFSAB ECU_ADDRESS 0xFFF8F818 /end MEASUREMENT
/begin MEASUREMENT ZFFSAB._.ABSIn.iv_ABSRegSts "Status for the CAN-Signal: GETCANFA_RX_QU_FN_ABS :: Bit coded- 0:Signal Ok 1:Time-Out 2:Bus error 3:CAN-version error 4:Checksum error 5:Alive counter error 6:Level 2 error 7:Complement error 8:Bus deactivated or Msg not received on StartUp" UBYTE SAB_STANDARD_S2_S3 1 100 0 255 DISPLAY_IDENTIFIER iv_ABSRegSts.ABSIn._.ZFFSAB ECU_ADDRESS 0xFFF8F81A /end MEASUREMENT
/begin MEASUREMENT ZFFSAB._.ABSIn.iv_ABSReg_ "CAN-Rawsignal: GETCANFA_RX_QU_FN_ABS_KOMP :: Complement of signal QU_FN_ABS." UWORD SAB_STANDARD_S2_S3 1 100 0 65535 DISPLAY_IDENTIFIER iv_ABSReg_.ABSIn._.ZFFSAB ECU_ADDRESS 0xFFF8F81C /end MEASUREMENT
/begin MEASUREMENT ZFFSAB._.ABSIn.iv_ABSRegSts_ "Status for the CAN-Signal: GETCANFA_RX_QU_FN_ABS_KOMP :: Bit coded- 0:Signal Ok 1:Time-Out 2:Bus error 3:CAN-version error 4:Checksum error 5:Alive counter error 6:Level 2 error 7:Complement error 8:Bus deactivated or Msg not received on StartUp" UBYTE SAB_STANDARD_S2_S3 1 100 0 255 DISPLAY_IDENTIFIER iv_ABSRegSts_.ABSIn._.ZFFSAB ECU_ADDRESS 0xFFF8F81E /end MEASUREMENT
/begin MEASUREMENT ZFFSAB._.ABSIn.sv_ABSReg "Status for the CAN-Signal: GETCANFA_RX_QU_FN_ABS :: Bit coded- 0:Signal Ok 1:Time-Out 2:Bus error 3:CAN-version error 4:Checksum error 5:Alive counter error 6:Level 2 error 7:Complement error 8:Bus deactivated or Msg not received on StartUp" UBYTE SAB_STANDARD_S2_S3 1 100 0 2 DISPLAY_IDENTIFIER sv_ABSReg.ABSIn._.ZFFSAB ECU_ADDRESS 0xFFF8F81F /end MEASUREMENT
/begin MEASUREMENT ZFFSAB._.ABSIn.sv_ABSRegSts "Output signal status: 0=no error 1=dynamic substitute signal 2=static substitute signal" UBYTE SAB_STANDARD_S2_S3 1 100 0 2 DISPLAY_IDENTIFIER sv_ABSRegSts.ABSIn._.ZFFSAB ECU_ADDRESS 0xFFF8F820 /end MEASUREMENT
/begin MEASUREMENT ZFFSAB._.ABSIn.f_ABSRegErr "Error flag for local diagnosis: 0=no error 1=error detected" UBYTE SAB_STANDARD_S2_S3 1 100 0 1 DISPLAY_IDENTIFIER f_ABSRegErr.ABSIn._.ZFFSAB ECU_ADDRESS 0xFFF8F821 /end MEASUREMENT
/begin MEASUREMENT ZFFSAB._.ABSIn.sv_ABSReg_ "Complement of GET_ABS_REG" UBYTE SAB_STANDARD_S2_S3 1 100 0 255 DISPLAY_IDENTIFIER sv_ABSReg_.ABSIn._.ZFFSAB ECU_ADDRESS 0xFFF8F822 /end MEASUREMENT
/begin MEASUREMENT ZFFSAB._.ABSIn.sv_ABSRegSts_ "Complement of GET_ABS_REG_STATUS" UBYTE SAB_STANDARD_S2_S3 1 100 0 255 DISPLAY_IDENTIFIER sv_ABSRegSts_.ABSIn._.ZFFSAB ECU_ADDRESS 0xFFF8F823 /end MEASUREMENT
/begin MEASUREMENT ZFFSAB._.ABSIn.f_ABSOff "f_ABSOff" UBYTE SAB_STANDARD_S2_S3 1 100 0 1 DISPLAY_IDENTIFIER f_ABSOff.ABSIn._.ZFFSAB ECU_ADDRESS 0xFFF8F824 /end MEASUREMENT
/begin MEASUREMENT ZFFSAB._.ABSIn.f_ABSOff_ "f_ABSOff_" UBYTE SAB_STANDARD_S2_S3 1 100 0 255 DISPLAY_IDENTIFIER f_ABSOff_.ABSIn._.ZFFSAB ECU_ADDRESS 0xFFF8F825 /end MEASUREMENT
/begin MEASUREMENT ZFFSAB._.ABSIn.f_ABSOffSts "f_ABSOffSts" UBYTE SAB_STANDARD_S2_S3 1 100 0 1 DISPLAY_IDENTIFIER f_ABSOffSts.ABSIn._.ZFFSAB ECU_ADDRESS 0xFFF8F826 /end MEASUREMENT
/begin MEASUREMENT ZFFSAB._.EngineSpeedRedIn.iv_n_EngMaxRed "Input value reduction of rpm maximum from CAN" UBYTE SAB_STANDARD_S2_S3 1 100 0 3 DISPLAY_IDENTIFIER iv_n_EngMaxRed.EngineSpeedRedIn._.ZFFSAB ECU_ADDRESS 0xFFF8FB78 /end MEASUREMENT
/begin MEASUREMENT ZFFSAB._.EngineSpeedRedIn.iv_n_EngMaxRed_ "Input value of complement of reduction of rpm maximum from CAN" UBYTE SAB_STANDARD_S2_S3 1 100 0 255 DISPLAY_IDENTIFIER iv_n_EngMaxRed_.EngineSpeedRedIn._.ZFFSAB ECU_ADDRESS 0xFFF8FB79 /end MEASUREMENT
/begin MEASUREMENT ZFFSAB._.EngineSpeedRedIn.iv_n_EngMaxRedSts "Input value of message status of reduction of rpm maximum" UBYTE SAB_STANDARD_S2_S3 1 100 0 255 DISPLAY_IDENTIFIER iv_n_EngMaxRedSts.EngineSpeedRedIn._.ZFFSAB ECU_ADDRESS 0xFFF8FB7A /end MEASUREMENT
/begin MEASUREMENT ZFFSAB._.EngineSpeedRedIn.iv_n_EngMaxRedSts_ "Input value of message status of reduction of rpm maximum" UBYTE SAB_STANDARD_S2_S3 1 100 0 255 DISPLAY_IDENTIFIER iv_n_EngMaxRedSts_.EngineSpeedRedIn._.ZFFSAB ECU_ADDRESS 0xFFF8FB7B /end MEASUREMENT
/begin MEASUREMENT ZFFSAB._.EngineSpeedRedIn.iv_n_EngMaxAlw "Input value of maximum allowed rpm of the engine from CAN" UBYTE SAB_N_50RPM_S2_S3 1 100 0 12750 DISPLAY_IDENTIFIER iv_n_EngMaxAlw.EngineSpeedRedIn._.ZFFSAB ECU_ADDRESS 0xFFF8FB7C /end MEASUREMENT
/begin MEASUREMENT ZFFSAB._.EngineSpeedRedIn.iv_n_EngMaxAlw_ "Complementary input value of maximum allowed rpm of the engine from CAN" UBYTE SAB_STANDARD_S2_S3 1 100 0 255 DISPLAY_IDENTIFIER iv_n_EngMaxAlw_.EngineSpeedRedIn._.ZFFSAB ECU_ADDRESS 0xFFF8FB7D /end MEASUREMENT
/begin MEASUREMENT ZFFSAB._.EngineSpeedRedIn.sv_n_EngMaxRed "Output value reduction rpm" UBYTE SAB_STANDARD_S2_S3 1 100 0 2 DISPLAY_IDENTIFIER sv_n_EngMaxRed.EngineSpeedRedIn._.ZFFSAB ECU_ADDRESS 0xFFF8FB7E /end MEASUREMENT
/begin MEASUREMENT ZFFSAB._.EngineSpeedRedIn.sv_n_EngMaxRedSts "Output value signal status of reduction rpm" UBYTE SAB_STANDARD_S2_S3 1 100 0 2 DISPLAY_IDENTIFIER sv_n_EngMaxRedSts.EngineSpeedRedIn._.ZFFSAB ECU_ADDRESS 0xFFF8FB7F /end MEASUREMENT
/begin MEASUREMENT ZFFSAB._.EngineSpeedRedIn.sv_n_EngRed "Output value threshold reduction engine rpm" UWORD SAB_N_1RPM_S2_S3 1 100 0 10000 DISPLAY_IDENTIFIER sv_n_EngRed.EngineSpeedRedIn._.ZFFSAB ECU_ADDRESS 0xFFF8FB80 /end MEASUREMENT
/begin MEASUREMENT ZFFSAB._.EngineSpeedRedIn.sv_n_EngRed_ "Output value threshold reduction engine rpm complement" UWORD SAB_STANDARD_S2_S3 1 100 0 65535 DISPLAY_IDENTIFIER sv_n_EngRed_.EngineSpeedRedIn._.ZFFSAB ECU_ADDRESS 0xFFF8FB82 /end MEASUREMENT
/begin MEASUREMENT ZFFSAB._.SensorSupplyMonitoring.iv_u_Sens1ESts "Input voltage sensor1 electrical status" UBYTE SAB_STANDARD_S2_S3 1 100 0 255 DISPLAY_IDENTIFIER iv_u_Sens1ESts.SensorSupplyMonitoring._.ZFFSAB ECU_ADDRESS 0xFFF8FB94 /end MEASUREMENT
/begin MEASUREMENT ZFFSAB._.SensorSupplyMonitoring.iv_u_Sens1ESts_ "Complementary input voltage sensor1 electrical status" UBYTE SAB_STANDARD_S2_S3 1 100 0 255 DISPLAY_IDENTIFIER iv_u_Sens1ESts_.SensorSupplyMonitoring._.ZFFSAB ECU_ADDRESS 0xFFF8FB95 /end MEASUREMENT
/begin MEASUREMENT ZFFSAB._.ModeEDriveStatusIn.iv_AGS_Soc_Mode "CAN-Rawsignal: GETCANFA_RX_ST_MOD_SOC :: This signals specifies the electric driving mode state of charge: 0=Entladen 1=Ladung erhalten 2=SOC halten F=Signal ungueltig." UBYTE SAB_STANDARD_S2_S3 1 100 0 3 DISPLAY_IDENTIFIER iv_AGS_Soc_Mode.ModeEDriveStatusIn._.ZFFSAB ECU_ADDRESS 0xFFF973BC /end MEASUREMENT
/begin MEASUREMENT ZFFSAB._.ModeEDriveStatusIn.iv_AGS_Soc_ModeSts "Status for the CAN-Signal: GETCANFA_RX_ST_MOD_SOC :: Bit coded- 0000.0000: Signal is Ok xxxx.xxx1: Time-Out error xxxx.xx1x: CAN-bus error xxxx.x1xx: CAN-version error xxxx.1xxx: Checksum error xxx1.xxxx: Alive counter error xx1x.xxxx: Level 2 error x1..." UBYTE SAB_STANDARD_S2_S3 1 100 0 255
 /begin ANNOTATION ANNOTATION_LABEL "Description"
  /begin ANNOTATION_TEXT "Status for the CAN-Signal: GETCANFA_RX_ST_MOD_SOC :: Bit coded- 0000.0000: Signal is Ok xxxx.xxx1: Time-Out error xxxx.xx1x: CAN-bus error xxxx.x1xx: CAN-version error xxxx.1xxx: Checksum error xxx1.xxxx: Alive counter error xx1x.xxxx: Level 2 error x1xx." "xxxx: Complement error 1xxx.xxxx: CAN bus deactivated by calibration or CAN-message never received since StartUp" /end ANNOTATION_TEXT
 /end ANNOTATION
 DISPLAY_IDENTIFIER iv_AGS_Soc_ModeSts.ModeEDriveStatusIn._.ZFFSAB ECU_ADDRESS 0xFFF973BD /end MEASUREMENT
/begin MEASUREMENT ZFFSAB._.ModeEDriveStatusIn.sv_ModeEDrive "Output Signal electric driving mode state of charge: 0=Dissipate electric energy 1=Keep electric energy" UBYTE SAB_STANDARD_S2_S3 1 100 0 1 DISPLAY_IDENTIFIER sv_ModeEDrive.ModeEDriveStatusIn._.ZFFSAB ECU_ADDRESS 0xFFF973BE /end MEASUREMENT
/begin MEASUREMENT ZFFSAB._.ModeEDriveStatusIn.sv_ModeEDriveSts "Output signal status for sv_ModeEDrive: 0=no error 1=dynamic substitute signal 2=static substitute signal" UBYTE SAB_STANDARD_S2_S3 1 100 0 2 DISPLAY_IDENTIFIER sv_ModeEDriveSts.ModeEDriveStatusIn._.ZFFSAB ECU_ADDRESS 0xFFF973BF /end MEASUREMENT
/begin MEASUREMENT ZFFSAB._.EngineIdleIn.iv_EngIdleActive "CAN-Rawsignal: GETCAN_RX_ST_IDLG_ENG_DRV :: This signals specifies if the engine is idling or not. This information will be needed for the stabilizing of the display for the rotational-speed counter and for the recognition for the range in which the en..." UBYTE SAB_STANDARD_S2_S3 1 100 0 3
 /begin ANNOTATION ANNOTATION_LABEL "Description"
  /begin ANNOTATION_TEXT "CAN-Rawsignal: GETCAN_RX_ST_IDLG_ENG_DRV :: This signals specifies if the engine is idling or not. This information will be needed for the stabilizing of the display for the rotational-speed counter and for the recognition for the range in which the engin" "e can not be set for ACC and similar Systems . Old name / Alter Name: Status_Leerlauf_Motor. 00=Engine idling 01=Engine not idling 11=signal invalid." /end ANNOTATION_TEXT
 /end ANNOTATION
 DISPLAY_IDENTIFIER iv_EngIdleActive.EngineIdleIn._.ZFFSAB ECU_ADDRESS 0xFFF983AC /end MEASUREMENT
/begin MEASUREMENT ZFFSAB._.EngineIdleIn.iv_EngIdleActiveSts "Status for the CAN-Signal: GETCAN_RX_ST_IDLG_ENG_DRV :: Bit coded- 0000.0000: Signal is Ok xxxx.xxx1: Time-Out error xxxx.xx1x: CAN-bus error xxxx.x1xx: CAN-version error xxxx.1xxx: Checksum error xxx1.xxxx: Alive counter error xx1x.xxxx: Level 2 error..." UBYTE SAB_STANDARD_S2_S3 1 100 0 255
 /begin ANNOTATION ANNOTATION_LABEL "Description"
  /begin ANNOTATION_TEXT "Status for the CAN-Signal: GETCAN_RX_ST_IDLG_ENG_DRV :: Bit coded- 0000.0000: Signal is Ok xxxx.xxx1: Time-Out error xxxx.xx1x: CAN-bus error xxxx.x1xx: CAN-version error xxxx.1xxx: Checksum error xxx1.xxxx: Alive counter error xx1x.xxxx: Level 2 error x1" "xx.xxxx: Complement error 1xxx.xxxx: CAN bus deactivated by calibration or CAN-message never received since StartUp" /end ANNOTATION_TEXT
 /end ANNOTATION
 DISPLAY_IDENTIFIER iv_EngIdleActiveSts.EngineIdleIn._.ZFFSAB ECU_ADDRESS 0xFFF983AD /end MEASUREMENT
/begin MEASUREMENT ZFFSAB._.EngineIdleIn.sv_EngIdleActive "Output Signal Engine Idle Active: 0=Engine Idle active 1=Engine Idle not active" UBYTE SAB_STANDARD_S2_S3 1 100 0 1 DISPLAY_IDENTIFIER sv_EngIdleActive.EngineIdleIn._.ZFFSAB ECU_ADDRESS 0xFFF983AE /end MEASUREMENT
/begin MEASUREMENT ZFFSAB._.EngineIdleIn.sv_EngIdleActiveSts "Output signal status for sv_EngIdleActive: 0=no error 1=dynamic substitute signal 2=static substitute signal" UBYTE SAB_STANDARD_S2_S3 1 100 0 2 DISPLAY_IDENTIFIER sv_EngIdleActiveSts.EngineIdleIn._.ZFFSAB ECU_ADDRESS 0xFFF983AF /end MEASUREMENT
/begin MEASUREMENT ZFFSAB._.EngineIdleIn.f_EngIdleActiveErr "Error flag for local diagnosis: 0=no error 1=error detected" UBYTE SAB_STANDARD_S2_S3 1 100 0 1 DISPLAY_IDENTIFIER f_EngIdleActiveErr.EngineIdleIn._.ZFFSAB ECU_ADDRESS 0xFFF983B0 /end MEASUREMENT
/begin MEASUREMENT ZFFSAB._.EngineStartStopButtonIn.iv_StartStopButton "CAN-Rawsignal: GETCANFA_RX_ST_SSP :: 3 = Signal ungueltig 2 = zwei Taster - Hallsensor erkannt 1 = ein Taster - Hallsensor erkannt 0 = kein Taster - Hallsensor erkannt" UBYTE SAB_STANDARD_S2_S3 1 100 0 3 DISPLAY_IDENTIFIER iv_StartStopButton.EngineStartStopButtonIn._.ZFFSAB ECU_ADDRESS 0xFFF973C0 /end MEASUREMENT
/begin MEASUREMENT ZFFSAB._.EngineStartStopButtonIn.iv_StartStopButtonSts "Status for the CAN-Signal: GETCANFA_RX_STATUS_ST_SSP :: Bit coded- 0:Signal Ok 1:Time-Out 2:Bus error 3:CAN-version error 4:Checksum error 5:Alive counter error 6:Level 2 error 7:Complement error 8:Bus deactivated or Msg not received on StartUp" UBYTE SAB_STANDARD_S2_S3 1 100 0 255 DISPLAY_IDENTIFIER iv_StartStopButtonSts.EngineStartStopButtonIn._.ZFFSAB ECU_ADDRESS 0xFFF973C1 /end MEASUREMENT
/begin MEASUREMENT ZFFSAB._.EngineStartStopButtonIn.sv_f_StartStopButton "Output signal of GET_START_STOP_BUTTON: 0 = Start-Stopp Taster unbekannt oder nicht betaetigt 1 = Start-Stopp Taster betaetigt" UBYTE SAB_STANDARD_S2_S3 1 100 0 1 DISPLAY_IDENTIFIER sv_f_StartStopButton.EngineStartStopButtonIn._.ZFFSAB ECU_ADDRESS 0xFFF973C2 /end MEASUREMENT
/begin MEASUREMENT ZFFSAB._.EngineStartStopButtonIn.f_StartStopButtonErr "Error flag for local diagnosis: 0=no error 1=error detected" UBYTE SAB_STANDARD_S2_S3 1 100 0 1 DISPLAY_IDENTIFIER f_StartStopButtonErr.EngineStartStopButtonIn._.ZFFSAB ECU_ADDRESS 0xFFF973C3 /end MEASUREMENT
/begin MEASUREMENT ZFFSAB._.HybridChargingPlugIn.iv_ChargingPlug "CAN-Rawsignal: GETCAN_RX_ENERG_BN_RDI_DRVG :: 15 - Signal ungueltig 5 - Keine HV-Freig. Ladest. unbek. 4 - Keine HV-Freig. Ladest. steckt 3 - HV-Freigabe Ladestecker unbek. 2 - HV-Freigabe Ladestecker steckt 1 - HV-Freigabe kein Ladestecker 0 - Keine H..." UBYTE SAB_STANDARD_S2_S3 1 100 0 15
 /begin ANNOTATION ANNOTATION_LABEL "Description"
  /begin ANNOTATION_TEXT "CAN-Rawsignal: GETCAN_RX_ENERG_BN_RDI_DRVG :: 15 - Signal ungueltig 5 - Keine HV-Freig. Ladest. unbek. 4 - Keine HV-Freig. Ladest. steckt 3 - HV-Freigabe Ladestecker unbek. 2 - HV-Freigabe Ladestecker steckt 1 - HV-Freigabe kein Ladestecker 0 - Keine HV-F" "reigabe" /end ANNOTATION_TEXT
 /end ANNOTATION
 DISPLAY_IDENTIFIER iv_ChargingPlug.HybridChargingPlugIn._.ZFFSAB ECU_ADDRESS 0xFFF983B2 /end MEASUREMENT
/begin MEASUREMENT ZFFSAB._.HybridChargingPlugIn.iv_ChargingPlugSts "Status for the CAN-Signal: GETCAN_RX_ENERG_BN_RDI_DRVG :: Bit coded- 0:Signal Ok 1:Time-Out 2:Bus error 3:CAN-version error 4:Checksum error 5:Alive counter error 6:Level 2 error 7:Complement error 8:Bus deactivated or Msg not received on StartUp" UBYTE SAB_STANDARD_S2_S3 1 100 0 255 DISPLAY_IDENTIFIER iv_ChargingPlugSts.HybridChargingPlugIn._.ZFFSAB ECU_ADDRESS 0xFFF983B3 /end MEASUREMENT
/begin MEASUREMENT ZFFSAB._.HybridChargingPlugIn.sv_ChargingPlug "Output signal of GET_STATE_CHARGING_PLUG 0 - Charging plug is not inserted 1 - Charging plug is unknown 2 - Charging plug is inserted" UBYTE SAB_STANDARD_S2_S3 1 100 0 2 DISPLAY_IDENTIFIER sv_ChargingPlug.HybridChargingPlugIn._.ZFFSAB ECU_ADDRESS 0xFFF983B4 /end MEASUREMENT
/begin MEASUREMENT ZFFSAB._.HybridChargingPlugIn.sv_ChargingPlugSts "Output signal status: 0 = Signal valid 1 = Signal contains dynamic substitute value 2 = Signal invalid" UBYTE SAB_STANDARD_S2_S3 1 100 0 2 DISPLAY_IDENTIFIER sv_ChargingPlugSts.HybridChargingPlugIn._.ZFFSAB ECU_ADDRESS 0xFFF983B5 /end MEASUREMENT
/begin MEASUREMENT ZFFSAB._.HybridChargingPlugIn.f_ChargingPlugErr "Error flag for local diagnosis: 0=no error 1=error detected" UBYTE SAB_STANDARD_S2_S3 1 100 0 1 DISPLAY_IDENTIFIER f_ChargingPlugErr.HybridChargingPlugIn._.ZFFSAB ECU_ADDRESS 0xFFF983B6 /end MEASUREMENT
/begin MEASUREMENT ZFFSAB._.TransportModeIn.iv_TransportMode "Reports the state of energy mode and extended mode: bit 0: Energy mode flash active bit 1: Energy mode transport active bit 2: Energy mode production active bit 3-6: reserved bit 7: Extended mode active" UBYTE SAB_STANDARD_S2_S3 1 100 0 255 DISPLAY_IDENTIFIER iv_TransportMode.TransportModeIn._.ZFFSAB ECU_ADDRESS 0xFFF973C8 /end MEASUREMENT
/begin MEASUREMENT ZFFSAB._.TransportModeIn.sv_f_TransportMode "Flag is set to one if the transport mode is active" UBYTE SAB_STANDARD_S2_S3 1 100 0 1 DISPLAY_IDENTIFIER sv_f_TransportMode.TransportModeIn._.ZFFSAB ECU_ADDRESS 0xFFF973C9 /end MEASUREMENT
/begin MEASUREMENT ZFFSAB._.CDD_ActuatorOut.loc_cnt_100ms "Local 100ms counter variable" UBYTE SAB_STANDARD_S2_S3 1 100 0 10 DISPLAY_IDENTIFIER loc_cnt_100ms.CDD_ActuatorOut._.ZFFSAB ECU_ADDRESS 0xFFF973D0 /end MEASUREMENT
/begin MEASUREMENT ZFFSAB._.CDD_ActuatorOut.iv_f_ReqDitherOff[0] "Table where the values of GET_REQ_DITHER_OFF_OUTx are stored" UBYTE SAB_STANDARD_S2_S3 1 100 0 1 DISPLAY_IDENTIFIER iv_f_ReqDitherOff[0].CDD_ActuatorOut._.ZFFSAB ECU_ADDRESS 0xFFF973D1 /end MEASUREMENT
/begin MEASUREMENT ZFFSAB._.CDD_ActuatorOut.iv_f_ReqDitherOff[1] "Table where the values of GET_REQ_DITHER_OFF_OUTx are stored" UBYTE SAB_STANDARD_S2_S3 1 100 0 1 DISPLAY_IDENTIFIER iv_f_ReqDitherOff[1].CDD_ActuatorOut._.ZFFSAB ECU_ADDRESS 0xFFF973D2 /end MEASUREMENT
/begin MEASUREMENT ZFFSAB._.CDD_ActuatorOut.iv_f_ReqDitherOff[2] "Table where the values of GET_REQ_DITHER_OFF_OUTx are stored" UBYTE SAB_STANDARD_S2_S3 1 100 0 1 DISPLAY_IDENTIFIER iv_f_ReqDitherOff[2].CDD_ActuatorOut._.ZFFSAB ECU_ADDRESS 0xFFF973D3 /end MEASUREMENT
/begin MEASUREMENT ZFFSAB._.CDD_ActuatorOut.iv_f_ReqDitherOff[3] "Table where the values of GET_REQ_DITHER_OFF_OUTx are stored" UBYTE SAB_STANDARD_S2_S3 1 100 0 1 DISPLAY_IDENTIFIER iv_f_ReqDitherOff[3].CDD_ActuatorOut._.ZFFSAB ECU_ADDRESS 0xFFF973D4 /end MEASUREMENT
/begin MEASUREMENT ZFFSAB._.CDD_ActuatorOut.iv_f_ReqDitherOff[4] "Table where the values of GET_REQ_DITHER_OFF_OUTx are stored" UBYTE SAB_STANDARD_S2_S3 1 100 0 1 DISPLAY_IDENTIFIER iv_f_ReqDitherOff[4].CDD_ActuatorOut._.ZFFSAB ECU_ADDRESS 0xFFF973D5 /end MEASUREMENT
/begin MEASUREMENT ZFFSAB._.CDD_ActuatorOut.iv_f_ReqDitherOff[5] "Table where the values of GET_REQ_DITHER_OFF_OUTx are stored" UBYTE SAB_STANDARD_S2_S3 1 100 0 1 DISPLAY_IDENTIFIER iv_f_ReqDitherOff[5].CDD_ActuatorOut._.ZFFSAB ECU_ADDRESS 0xFFF973D6 /end MEASUREMENT
/begin MEASUREMENT ZFFSAB._.CDD_ActuatorOut.iv_f_ReqDitherOff[6] "Table where the values of GET_REQ_DITHER_OFF_OUTx are stored" UBYTE SAB_STANDARD_S2_S3 1 100 0 1 DISPLAY_IDENTIFIER iv_f_ReqDitherOff[6].CDD_ActuatorOut._.ZFFSAB ECU_ADDRESS 0xFFF973D7 /end MEASUREMENT
/begin MEASUREMENT ZFFSAB._.CDD_ActuatorOut.iv_f_ReqDitherOff[7] "Table where the values of GET_REQ_DITHER_OFF_OUTx are stored" UBYTE SAB_STANDARD_S2_S3 1 100 0 1 DISPLAY_IDENTIFIER iv_f_ReqDitherOff[7].CDD_ActuatorOut._.ZFFSAB ECU_ADDRESS 0xFFF973D8 /end MEASUREMENT
/begin MEASUREMENT ZFFSAB._.CDD_ActuatorOut.f_ReqDitherOff_old[0] "Table where the previous values of GET_REQ_DITHER_OFF_OUTx are stored" UBYTE SAB_STANDARD_S2_S3 1 100 0 1 DISPLAY_IDENTIFIER f_ReqDitherOff_old[0].CDD_ActuatorOut._.ZFFSAB ECU_ADDRESS 0xFFF973D9 /end MEASUREMENT
/begin MEASUREMENT ZFFSAB._.CDD_ActuatorOut.f_ReqDitherOff_old[1] "Table where the previous values of GET_REQ_DITHER_OFF_OUTx are stored" UBYTE SAB_STANDARD_S2_S3 1 100 0 1 DISPLAY_IDENTIFIER f_ReqDitherOff_old[1].CDD_ActuatorOut._.ZFFSAB ECU_ADDRESS 0xFFF973DA /end MEASUREMENT
/begin MEASUREMENT ZFFSAB._.CDD_ActuatorOut.f_ReqDitherOff_old[2] "Table where the previous values of GET_REQ_DITHER_OFF_OUTx are stored" UBYTE SAB_STANDARD_S2_S3 1 100 0 1 DISPLAY_IDENTIFIER f_ReqDitherOff_old[2].CDD_ActuatorOut._.ZFFSAB ECU_ADDRESS 0xFFF973DB /end MEASUREMENT
/begin MEASUREMENT ZFFSAB._.CDD_ActuatorOut.f_ReqDitherOff_old[3] "Table where the previous values of GET_REQ_DITHER_OFF_OUTx are stored" UBYTE SAB_STANDARD_S2_S3 1 100 0 1 DISPLAY_IDENTIFIER f_ReqDitherOff_old[3].CDD_ActuatorOut._.ZFFSAB ECU_ADDRESS 0xFFF973DC /end MEASUREMENT
/begin MEASUREMENT ZFFSAB._.CDD_ActuatorOut.f_ReqDitherOff_old[4] "Table where the previous values of GET_REQ_DITHER_OFF_OUTx are stored" UBYTE SAB_STANDARD_S2_S3 1 100 0 1 DISPLAY_IDENTIFIER f_ReqDitherOff_old[4].CDD_ActuatorOut._.ZFFSAB ECU_ADDRESS 0xFFF973DD /end MEASUREMENT
/begin MEASUREMENT ZFFSAB._.CDD_ActuatorOut.f_ReqDitherOff_old[5] "Table where the previous values of GET_REQ_DITHER_OFF_OUTx are stored" UBYTE SAB_STANDARD_S2_S3 1 100 0 1 DISPLAY_IDENTIFIER f_ReqDitherOff_old[5].CDD_ActuatorOut._.ZFFSAB ECU_ADDRESS 0xFFF973DE /end MEASUREMENT
/begin MEASUREMENT ZFFSAB._.CDD_ActuatorOut.f_ReqDitherOff_old[6] "Table where the previous values of GET_REQ_DITHER_OFF_OUTx are stored" UBYTE SAB_STANDARD_S2_S3 1 100 0 1 DISPLAY_IDENTIFIER f_ReqDitherOff_old[6].CDD_ActuatorOut._.ZFFSAB ECU_ADDRESS 0xFFF973DF /end MEASUREMENT
/begin MEASUREMENT ZFFSAB._.CDD_ActuatorOut.f_ReqDitherOff_old[7] "Table where the previous values of GET_REQ_DITHER_OFF_OUTx are stored" UBYTE SAB_STANDARD_S2_S3 1 100 0 1 DISPLAY_IDENTIFIER f_ReqDitherOff_old[7].CDD_ActuatorOut._.ZFFSAB ECU_ADDRESS 0xFFF973E0 /end MEASUREMENT
/begin MEASUREMENT ZFFSAB._.CDD_RoutineControlFlashProgLIN_IEP.iv_ProgrammingStateIEP "Returns the actual state of the flash programming procedure regarding the IEP integrated electrical pump internal program code. 0 = Since startup of the control unit no flashing of IEP was started 1 = flashing of IEP is running 2 = flashing was finishe..." UBYTE SAB_STANDARD_S2_S3 1 100 0 5
 /begin ANNOTATION ANNOTATION_LABEL "Description"
  /begin ANNOTATION_TEXT "Returns the actual state of the flash programming procedure regarding the IEP integrated electrical pump internal program code. 0 = Since startup of the control unit no flashing of IEP was started 1 = flashing of IEP is running 2 = flashing was finished v" "erify is running 3 = verify was finished flashing of IEP was successfull 4 = verify was finished and verify was not successfull 5 = flashing of IEP was not successfull" /end ANNOTATION_TEXT
 /end ANNOTATION
 DISPLAY_IDENTIFIER iv_ProgrammingStateIEP.CDD_RoutineControlFlashProgLIN_IEP._.ZFFSAB ECU_ADDRESS 0xFFF973E8 /end MEASUREMENT
/begin MEASUREMENT ZFFSAB._.CDD_RoutineControlFlashProgLIN_IEP.iv_PreConditions "Input variable of Com PreConditions: All bits 0 means that all test requirements are fulfilled If a bit is not set the respective test requirement is not fulfilled." UWORD SAB_STANDARD_S2_S3 1 100 0 65535 DISPLAY_IDENTIFIER iv_PreConditions.CDD_RoutineControlFlashProgLIN_IEP._.ZFFSAB ECU_ADDRESS 0xFFF973EA /end MEASUREMENT
/begin MEASUREMENT ZFFSAB._.CDD_PermanentFaultCodes.iv_mileage "Anzeigewert des Gesamtwegstreckenzaehlers" UWORD SAB_L_10KM_S2_S3 1 100 0 655350 DISPLAY_IDENTIFIER iv_mileage.CDD_PermanentFaultCodes._.ZFFSAB ECU_ADDRESS 0xFFF973F2 /end MEASUREMENT
/begin MEASUREMENT ZFFSAB._.CDD_PermanentFaultCodes.sv_f_OBD_PFC_Activation "Schnittstelle um Permanent Fault Codes waehrend der Produktion abschalten zu koennen Quantisation: 0 = Permanent Fault Codes sind deaktiviert 1 = Permanent Fault Codes sind aktiviert" UBYTE SAB_STANDARD_S2_S3 1 100 0 1 DISPLAY_IDENTIFIER sv_f_OBD_PFC_Activation.CDD_PermanentFaultCodes._.ZFFSAB ECU_ADDRESS 0xFFF973F4 /end MEASUREMENT
/begin MEASUREMENT ZFFSAB._.CDD_PermanentFaultCodes.loc_return "locel return of set function to avoid lint" UBYTE SAB_STANDARD_S2_S3 1 100 0 1 DISPLAY_IDENTIFIER loc_return.CDD_PermanentFaultCodes._.ZFFSAB ECU_ADDRESS 0xFFF973F5 /end MEASUREMENT
/begin MEASUREMENT ZFFSAB._.PMA_ErrorHandling.iv_u_Batt_Diag "actual battery voltage" UWORD SAB_U_VOLT1000_S2_S3 1 100 0 65.535 DISPLAY_IDENTIFIER iv_u_Batt_Diag.PMA_ErrorHandling._.ZFFSAB ECU_ADDRESS 0xFFF973FC /end MEASUREMENT
/begin MEASUREMENT ZFFSAB._.PMA_ErrorHandling.iv_FASModeSts "Status for the CAN-Signal: GETCAN_RX_RQ_OPMO_GRDT_DRS :: Bit coded- 0:Signal Ok 1:Time-Out 2:Bus error 3:CAN-version error 4:Checksum error 5:Alive counter error 6:Level 2 error 7:Complement error 8:Bus deactivated or Msg not received on StartUp" UBYTE SAB_STANDARD_S2_S3 1 100 0 255 DISPLAY_IDENTIFIER iv_FASModeSts.PMA_ErrorHandling._.ZFFSAB ECU_ADDRESS 0xFFF973FE /end MEASUREMENT
/begin MEASUREMENT ZFFSAB._.PMA_ErrorHandling.iv_FASPosSts "Status for the CAN-Signal: GETCAN_RX_STATUS_TAR_OPMO_PT_GRB :: Bit coded- 0:Signal Ok 1:Time-Out 2:Bus error 3:CAN-version error 4:Checksum error 5:Alive counter error 6:Level 2 error 7:Complement error 8:Bus deactivated or Msg not received on StartUp" UBYTE SAB_STANDARD_S2_S3 1 100 0 255 DISPLAY_IDENTIFIER iv_FASPosSts.PMA_ErrorHandling._.ZFFSAB ECU_ADDRESS 0xFFF973FF /end MEASUREMENT
/begin MEASUREMENT ZFFSAB._.PMA_ErrorHandling.iv_BrakeSts "Status for the CAN-Signal: GETCANFA_RX_ST_BRG_DV :: Bit coded- 0:Signal Ok 1:Time-Out 2:Bus error 3:CAN-version error 4:Checksum error 5:Alive counter error 6:Level 2 error 7:Complement error 8:Bus deactivated or Msg not received on StartUp" UBYTE SAB_STANDARD_S2_S3 1 100 0 255 DISPLAY_IDENTIFIER iv_BrakeSts.PMA_ErrorHandling._.ZFFSAB ECU_ADDRESS 0xFFF97400 /end MEASUREMENT
/begin MEASUREMENT ZFFSAB._.PMA_ErrorHandling.iv_Brake "CAN-Rawsignal: GETCANFA_RX_ST_BRG_DV :: Statusinformation ueber den Bremseingriff durch den Fahrer oder durch Fahrerassistenzsysteme." UBYTE SAB_STANDARD_S2_S3 1 100 0 63 DISPLAY_IDENTIFIER iv_Brake.PMA_ErrorHandling._.ZFFSAB ECU_ADDRESS 0xFFF97401 /end MEASUREMENT
/begin MEASUREMENT ZFFSAB._.PMA_ErrorHandling.iv_FASMode "CAN-Rawsignal: GETCAN_RX_RQ_OPMO_GRDT_DRS :: Mit diesem Signal uebermittelt das Motorsteuergeraet dem Getriebe die von den FAS angeforderten Betriebsarten." UBYTE SAB_STANDARD_S2_S3 1 100 0 15 DISPLAY_IDENTIFIER iv_FASMode.PMA_ErrorHandling._.ZFFSAB ECU_ADDRESS 0xFFF97402 /end MEASUREMENT
/begin MEASUREMENT ZFFSAB._.PMA_ErrorHandling.iv_FASPos "CAN-Rawsignal: GETCAN_RX_RQ_OPMO_GRDT_DRS :: Mit diesem Signal uebermittelt das Motorsteuergeraet dem Getriebe die von den FAS angeforderten Betriebsarten." UBYTE SAB_STANDARD_S2_S3 1 100 0 15 DISPLAY_IDENTIFIER iv_FASPos.PMA_ErrorHandling._.ZFFSAB ECU_ADDRESS 0xFFF97403 /end MEASUREMENT
/begin MEASUREMENT ZFFSAB._.PMA_ErrorHandling.f_PMA_Error "Error flag for local diagnosis: 0=no error 1=error detected" UBYTE SAB_STANDARD_S2_S3 1 100 0 1 DISPLAY_IDENTIFIER f_PMA_Error.PMA_ErrorHandling._.ZFFSAB ECU_ADDRESS 0xFFF97404 /end MEASUREMENT
/begin MEASUREMENT ZFFSAB._.PMA_ErrorHandling.f_PMA_TestCondition "Testcondition for local diagnosis: 0=not valid 1=valid" UBYTE SAB_STANDARD_S2_S3 1 100 0 1 DISPLAY_IDENTIFIER f_PMA_TestCondition.PMA_ErrorHandling._.ZFFSAB ECU_ADDRESS 0xFFF97405 /end MEASUREMENT
/begin MEASUREMENT ZFFSAB._.PMA_ErrorHandling.f_PMA_active_old "Previous value of sv_FASGearbox" UBYTE SAB_STANDARD_S2_S3 1 100 0 1 DISPLAY_IDENTIFIER f_PMA_active_old.PMA_ErrorHandling._.ZFFSAB ECU_ADDRESS 0xFFF97406 /end MEASUREMENT
/begin MEASUREMENT ZFFSAB._.TargetTorqueK0_In.iv_TargetTorqueK0 "Input A-CAN Signal: GETCAN_RX_DSTN_TORQ_K0: K0 target torque while start." UBYTE SAB_M_4NM_S2_S3 1 100 0 1020 DISPLAY_IDENTIFIER iv_TargetTorqueK0.TargetTorqueK0_In._.ZFFSAB ECU_ADDRESS 0xFFF97408 /end MEASUREMENT
/begin MEASUREMENT ZFFSAB._.TargetTorqueK0_In.iv_TargetTorqueK0Sts "Input A-CAN message status of GETCAN_RX_STATUS_DSTN_TORQ_K0" UBYTE SAB_STANDARD_S2_S3 1 100 0 255 DISPLAY_IDENTIFIER iv_TargetTorqueK0Sts.TargetTorqueK0_In._.ZFFSAB ECU_ADDRESS 0xFFF97409 /end MEASUREMENT
/begin MEASUREMENT ZFFSAB._.TargetTorqueK0_In.sv_TargetTorqueK0 "Output signal: Target torque of K0 snet by ECU" SWORD SAB_M_NM_S2_S3 1 100 -1000 2000 DISPLAY_IDENTIFIER sv_TargetTorqueK0.TargetTorqueK0_In._.ZFFSAB ECU_ADDRESS 0xFFF9740A /end MEASUREMENT
/begin MEASUREMENT ZFFSAB._.CrankShaftMaxTorqueEMIn.iv_Vor_Lang_m_crsh_Max "Input raw signal Prozent_Drehmoment_Maximal_E-Motor_1_statisch_Betriebsstrategie" UBYTE SAB_4PROZENT10_S2_S3 1 100 0 102 DISPLAY_IDENTIFIER iv_Vor_Lang_m_crsh_Max.CrankShaftMaxTorqueEMIn._.ZFFSAB ECU_ADDRESS 0xFFF9740C /end MEASUREMENT
/begin MEASUREMENT ZFFSAB._.CrankShaftMaxTorqueEMIn.iv_Vor_Lang_m_crsh_Min "Input raw signal Prozent_Drehmoment_Minimal_E-Motor_1_statisch_Betriebsstrategie" UBYTE SAB_4PROZENT10_S2_S3 1 100 0 102 DISPLAY_IDENTIFIER iv_Vor_Lang_m_crsh_Min.CrankShaftMaxTorqueEMIn._.ZFFSAB ECU_ADDRESS 0xFFF9740D /end MEASUREMENT
/begin MEASUREMENT ZFFSAB._.CrankShaftMaxTorqueEMIn.iv_Vor_Lang_m_crsh_MaxSts "Input CAN message status Prozent_Drehmoment_Maximal_E-Motor_1_statisch_Betriebsstrategie" UBYTE SAB_STANDARD_S2_S3 1 100 0 255 DISPLAY_IDENTIFIER iv_Vor_Lang_m_crsh_MaxSts.CrankShaftMaxTorqueEMIn._.ZFFSAB ECU_ADDRESS 0xFFF9740E /end MEASUREMENT
/begin MEASUREMENT ZFFSAB._.CrankShaftMaxTorqueEMIn.iv_Vor_Lang_m_crsh_MinSts "Input CAN message status Prozent_Drehmoment_Minimal_E-Motor_1_statisch_Betriebsstrategie" UBYTE SAB_STANDARD_S2_S3 1 100 0 255 DISPLAY_IDENTIFIER iv_Vor_Lang_m_crsh_MinSts.CrankShaftMaxTorqueEMIn._.ZFFSAB ECU_ADDRESS 0xFFF9740F /end MEASUREMENT
/begin MEASUREMENT ZFFSAB._.CrankShaftMaxTorqueEMIn.sv_Vor_Lang_m_crsh_Max "Output signal of Prozent_Drehmoment_Maximal_E-Motor_1_statisch_Betriebsstrategie" UWORD SAB_4PROZENT10_S2_S3 1 100 0 102 DISPLAY_IDENTIFIER sv_Vor_Lang_m_crsh_Max.CrankShaftMaxTorqueEMIn._.ZFFSAB ECU_ADDRESS 0xFFF97410 /end MEASUREMENT
/begin MEASUREMENT ZFFSAB._.CrankShaftMaxTorqueEMIn.sv_Vor_Lang_m_crsh_Min "Output signal of Prozent_Drehmoment_Minimal_E-Motor_1_statisch_Betriebsstrategie" UWORD SAB_4PROZENT10_S2_S3 1 100 0 102 DISPLAY_IDENTIFIER sv_Vor_Lang_m_crsh_Min.CrankShaftMaxTorqueEMIn._.ZFFSAB ECU_ADDRESS 0xFFF97412 /end MEASUREMENT
/begin MEASUREMENT ZFFSAB._.CrankRequestOut.iv_zStartModus "requests/ recommendations to combustion engine concerning kind of start process. 0=No reques 1=Additional starting device starter is recommended 2=Electric motor is recommended 3=Additional starting device starter is requested" UBYTE SAB_STANDARD_S2_S3 1 100 0 3 DISPLAY_IDENTIFIER iv_zStartModus.CrankRequestOut._.ZFFSAB ECU_ADDRESS 0xFFF9844C /end MEASUREMENT
/begin MEASUREMENT ZFFSAB._.CrankRequestOut.sv_zStartModus "requests/ recommendations to combustion engine concerning start process to be sent on CAN-Signal RQ_TYP_ENGSTA. 0=no rerquest 1=Electric motor is recommended 2=starter is recommended 3=starter is requested 4-6=reserved 7=signal not filled/invalid" UBYTE SAB_STANDARD_S2_S3 1 100 0 7 DISPLAY_IDENTIFIER sv_zStartModus.CrankRequestOut._.ZFFSAB ECU_ADDRESS 0xFFF9844D /end MEASUREMENT
/begin MEASUREMENT ZFFSAB._.DesiredIdleSpeedModeOut.iv_IdleSpeedMode "Request for raising mode of target engine idle speed: 0: No raising 1: Fast raising 2: Quickly raising 3: Comfortable raising" UBYTE SAB_STANDARD_S2_S3 1 100 0 3 DISPLAY_IDENTIFIER iv_IdleSpeedMode.DesiredIdleSpeedModeOut._.ZFFSAB ECU_ADDRESS 0xFFF9844E /end MEASUREMENT
/begin MEASUREMENT ZFFSAB._.DesiredIdleSpeedModeOut.sv_IdleSpeedMode "Output signal of raising mode of target engine idle speed: 0: Fast raising 1: Quickly raising 2: Comfortable raising 3: Signal faulty" UBYTE SAB_STANDARD_S2_S3 1 100 0 3 DISPLAY_IDENTIFIER sv_IdleSpeedMode.DesiredIdleSpeedModeOut._.ZFFSAB ECU_ADDRESS 0xFFF9844F /end MEASUREMENT
/begin MEASUREMENT ZFFSAB._.CDD_LINBusStartStop.iv_ChargingPlug "Charging Plug State 0 - Charging plug is not inserted 1 - Charging plug is unknown 2 - Charging plug is inserted" UBYTE SAB_STANDARD_S2_S3 1 100 0 2 DISPLAY_IDENTIFIER iv_ChargingPlug.CDD_LINBusStartStop._.ZFFSAB ECU_ADDRESS 0xFFF9741C /end MEASUREMENT
/begin MEASUREMENT ZFFSAB._.CDD_LINBusStartStop.iv_ChargingPlugSts "Charging Plug State signal status 0 = Signal valid 1 = Signal contains dynamic substitute value 2 = Signal invalid" UBYTE SAB_STANDARD_S2_S3 1 100 0 2 DISPLAY_IDENTIFIER iv_ChargingPlugSts.CDD_LINBusStartStop._.ZFFSAB ECU_ADDRESS 0xFFF9741D /end MEASUREMENT
/begin MEASUREMENT ZFFSAB._.CDD_LINBusStartStop.f_KMN_LINBUSOFF "Flag to indicate if KMN_LINBUSOFF is active 0: KMN not active 1: KMN is active" UBYTE SAB_STANDARD_S2_S3 1 100 0 1 DISPLAY_IDENTIFIER f_KMN_LINBUSOFF.CDD_LINBusStartStop._.ZFFSAB ECU_ADDRESS 0xFFF9741E /end MEASUREMENT
/begin MEASUREMENT ZFFSAB._.CDD_LINBusStartStop.f_LINBusOffEnable "Flag to indicate if LIN Bus Off via KMN_LINBUSOFF is enabled 0: LIN Bus active 1: LIN Bus off" UBYTE SAB_STANDARD_S2_S3 1 100 0 1 DISPLAY_IDENTIFIER f_LINBusOffEnable.CDD_LINBusStartStop._.ZFFSAB ECU_ADDRESS 0xFFF9741F /end MEASUREMENT
/begin MEASUREMENT ZFFSAB._.CDD_LINBusStartStop.st_chargingPlug "Current state of charging plug statemachine If charging plug is is inserted LINBSS_CP_PLUGGED IEP Sleep Mode LIN Bus off is active States 0 : LINBSS_CP_UNPLUGGED 1: LINBSS_CP_WAIT 2: LINBSS_CP_PLUGGED" UBYTE SAB_STANDARD_S2_S3 1 100 0 2 DISPLAY_IDENTIFIER st_chargingPlug.CDD_LINBusStartStop._.ZFFSAB ECU_ADDRESS 0xFFF97420 /end MEASUREMENT
/begin MEASUREMENT ZFFSAB._.CDD_LINBusStartStop.f_IEPSleepEnable "Flag indicates that IEP Sleepmode is enabled 0: IEP active 1: IEP in SleepMode LIN Bus off" UBYTE SAB_STANDARD_S2_S3 1 100 0 1 DISPLAY_IDENTIFIER f_IEPSleepEnable.CDD_LINBusStartStop._.ZFFSAB ECU_ADDRESS 0xFFF97421 /end MEASUREMENT
/begin MEASUREMENT ZFFSAB._.CDD_ZfData.sv_Dummy "Dummy delete me if SABA Tool error fixed. Error: If there are only ConstPorts but no variable SABA generates the constructor and wants to initialize variables but there are no vars -> compiler error" ULONG SAB_STANDARD_S2_S3 1 100 0 1 DISPLAY_IDENTIFIER sv_Dummy.CDD_ZfData._.ZFFSAB ECU_ADDRESS 0xFFF9742C /end MEASUREMENT
/begin MEASUREMENT ZFFSAB._.ChargeConditionIn.iv_Charge "Aktueller Ladezustand SoC: State of Charge des Hochvoltspeichers bezogen auf dessen Nennkapazitaet" UWORD SAB_PROZENT10_S2_S3 1 100 0 100 DISPLAY_IDENTIFIER iv_Charge.ChargeConditionIn._.ZFFSAB ECU_ADDRESS 0xFFF98450 /end MEASUREMENT
/begin MEASUREMENT ZFFSAB._.ChargeConditionIn.iv_ChargeSts "Input CAN message status of GETCAN_RX_CHGCOND_HVSTO: Aktueller Ladezustand SoC: State of Charge des Hochvoltspeichers bezogen auf dessen Nennkapazitaet" UBYTE SAB_STANDARD_S2_S3 1 100 0 255 DISPLAY_IDENTIFIER iv_ChargeSts.ChargeConditionIn._.ZFFSAB ECU_ADDRESS 0xFFF98452 /end MEASUREMENT
/begin MEASUREMENT ZFFSAB._.ChargeConditionIn.sv_Charge "State of charge as percent" UBYTE SAB_STANDARD_S2_S3 1 100 0 100 DISPLAY_IDENTIFIER sv_Charge.ChargeConditionIn._.ZFFSAB ECU_ADDRESS 0xFFF98453 /end MEASUREMENT
/begin MEASUREMENT ZFFSAB._.ChargeConditionIn.sv_ChargeSts "Output signal status: 0=no error 1=dynamic substitute signal 2=static substitute signal" UBYTE SAB_STANDARD_S2_S3 1 100 0 2 DISPLAY_IDENTIFIER sv_ChargeSts.ChargeConditionIn._.ZFFSAB ECU_ADDRESS 0xFFF98454 /end MEASUREMENT
/begin MEASUREMENT ZFFSAB._.ChargeConditionIn.f_ChargeErr "Error flag used internally" UBYTE SAB_STANDARD_S2_S3 1 100 0 1 DISPLAY_IDENTIFIER f_ChargeErr.ChargeConditionIn._.ZFFSAB ECU_ADDRESS 0xFFF98455 /end MEASUREMENT
/begin MEASUREMENT ZFFSAB._.HybridOpModeEMIn.iv_ModusEM "CAN-Rawsignal: GETCAN_RX_OPMO_AVL_MOT_1 :: Aktuelle Betriebsart der EM 1." UBYTE SAB_STANDARD_S2_S3 1 100 0 15 DISPLAY_IDENTIFIER iv_ModusEM.HybridOpModeEMIn._.ZFFSAB ECU_ADDRESS 0xFFF98456 /end MEASUREMENT
/begin MEASUREMENT ZFFSAB._.HybridOpModeEMIn.iv_ModusEMSts "Status for the CAN-Signal: GETCAN_RX_OPMO_AVL_MOT_1 :: Bit coded- 0:Signal Ok 1:Time-Out 2:Bus error 3:CAN-version error 4:Checksum error 5:Alive counter error 6:Level 2 error 7:Complement error 8:Bus deactivated or Msg not received on StartUp" UBYTE SAB_STANDARD_S2_S3 1 100 0 255 DISPLAY_IDENTIFIER iv_ModusEMSts.HybridOpModeEMIn._.ZFFSAB ECU_ADDRESS 0xFFF98457 /end MEASUREMENT
/begin MEASUREMENT ZFFSAB._.HybridOpModeEMIn.iv_DmpEM "CAN-Rawsignal: GETCAN_RX_ST_DMPNG_VIB :: Dieses Signal gibt die Statusinformation an fuer welche Antriebskomponente die Schwingungsdaempfung Anti-Ruckelfunktion aktiv ist." UBYTE SAB_STANDARD_S2_S3 1 100 0 15 DISPLAY_IDENTIFIER iv_DmpEM.HybridOpModeEMIn._.ZFFSAB ECU_ADDRESS 0xFFF98458 /end MEASUREMENT
/begin MEASUREMENT ZFFSAB._.HybridOpModeEMIn.iv_DmpEMSts "Status for the CAN-Signal: GETCAN_RX_ST_DMPNG_VIB :: Bit coded- 0:Signal Ok 1:Time-Out 2:Bus error 3:CAN-version error 4:Checksum error 5:Alive counter error 6:Level 2 error 7:Complement error 8:Bus deactivated or Msg not received on StartUp" UBYTE SAB_STANDARD_S2_S3 1 100 0 255 DISPLAY_IDENTIFIER iv_DmpEMSts.HybridOpModeEMIn._.ZFFSAB ECU_ADDRESS 0xFFF98459 /end MEASUREMENT
/begin MEASUREMENT ZFFSAB._.HybridOpModeEMIn.sv_ModusEM "Output signal for mode of operation of electric motor" UBYTE SAB_STANDARD_S2_S3 1 100 0 15 DISPLAY_IDENTIFIER sv_ModusEM.HybridOpModeEMIn._.ZFFSAB ECU_ADDRESS 0xFFF9845A /end MEASUREMENT
/begin MEASUREMENT ZFFSAB._.HybridOpModeEMIn.sv_ModusEMSts "Output signal for the status of electic motor" UBYTE SAB_STANDARD_S2_S3 1 100 0 2 DISPLAY_IDENTIFIER sv_ModusEMSts.HybridOpModeEMIn._.ZFFSAB ECU_ADDRESS 0xFFF9845B /end MEASUREMENT
/begin MEASUREMENT ZFFSAB._.HybridOpModeEMIn.f_ModusEMErr "Error flag for Modus EM" UBYTE SAB_STANDARD_S2_S3 1 100 0 1 DISPLAY_IDENTIFIER f_ModusEMErr.HybridOpModeEMIn._.ZFFSAB ECU_ADDRESS 0xFFF9845C /end MEASUREMENT
/begin MEASUREMENT ZFFSAB._.HybridOpModeEMIn.sv_f_DmpEM "Output signal for damping of electric motor" UBYTE SAB_STANDARD_S2_S3 1 100 0 1 DISPLAY_IDENTIFIER sv_f_DmpEM.HybridOpModeEMIn._.ZFFSAB ECU_ADDRESS 0xFFF9845D /end MEASUREMENT
/begin MEASUREMENT ZFFSAB._.HybridOpModeEMIn.sv_DmpEMSts "Output signal for the status of damping electric motor" UBYTE SAB_STANDARD_S2_S3 1 100 0 2 DISPLAY_IDENTIFIER sv_DmpEMSts.HybridOpModeEMIn._.ZFFSAB ECU_ADDRESS 0xFFF9845E /end MEASUREMENT
/begin MEASUREMENT ZFFSAB._.HybridOpModeEMIn.f_DmpEMErr "Error flag for State of active damping electrical Of The Electric-Motor" UBYTE SAB_STANDARD_S2_S3 1 100 0 1 DISPLAY_IDENTIFIER f_DmpEMErr.HybridOpModeEMIn._.ZFFSAB ECU_ADDRESS 0xFFF9845F /end MEASUREMENT
/begin MEASUREMENT ZFFSAB._.LayerAGS.sv_AGS_CkbTout "Output value ambient temperature in LayerAGS" UBYTE SAB_C_TEMPEXTERN_CEL2_M40_S2_S3 1 100 -40 87.5 DISPLAY_IDENTIFIER sv_AGS_CkbTout.LayerAGS._.ZFFSAB ECU_ADDRESS 0xFFF97434 /end MEASUREMENT
/begin MEASUREMENT ZFFSAB._.LayerAGS.sv_AGS_EngStartTyp "Output value engine start mode in LayerAGS" UBYTE SAB_STANDARD_S2_S3 1 100 0 4 DISPLAY_IDENTIFIER sv_AGS_EngStartTyp.LayerAGS._.ZFFSAB ECU_ADDRESS 0xFFF97435 /end MEASUREMENT
/begin MEASUREMENT ZFFSAB._.LayerAGS.sv_AGS_ForceHs "Input value current forced changing gears up in LayerAGS" UBYTE SAB_STANDARD_S2_S3 1 100 0 3 DISPLAY_IDENTIFIER sv_AGS_ForceHs.LayerAGS._.ZFFSAB ECU_ADDRESS 0xFFF97436 /end MEASUREMENT
/begin MEASUREMENT ZFFSAB._.LayerAGS.sv_AGS_K0IstZustand "Output value actual state K0 clutch in LayerAGS" UBYTE SAB_STANDARD_S2_S3 1 100 0 5 DISPLAY_IDENTIFIER sv_AGS_K0IstZustand.LayerAGS._.ZFFSAB ECU_ADDRESS 0xFFF97437 /end MEASUREMENT
/begin MEASUREMENT ZFFSAB._.LayerAGS.sv_AGS_K0ZielZustand "Output value target state K0 clutch in LayerAGS" UBYTE SAB_STANDARD_S2_S3 1 100 0 5 DISPLAY_IDENTIFIER sv_AGS_K0ZielZustand.LayerAGS._.ZFFSAB ECU_ADDRESS 0xFFF97438 /end MEASUREMENT
/begin MEASUREMENT ZFFSAB._.LayerAGS.sv_AGS_MEm "Output value Electrical machine torque in LayerAGS" SWORD SAB_M_1NM_S2_S3 1 100 -8192 8192 DISPLAY_IDENTIFIER sv_AGS_MEm.LayerAGS._.ZFFSAB ECU_ADDRESS 0xFFF9743A /end MEASUREMENT
/begin MEASUREMENT ZFFSAB._.LayerAGS.sv_AGS_Pos "Output value braketorque in LayerAGS" UBYTE SAB_STANDARD_S2_S3 1 100 0 255 DISPLAY_IDENTIFIER sv_AGS_Pos.LayerAGS._.ZFFSAB ECU_ADDRESS 0xFFF9743C /end MEASUREMENT
/begin MEASUREMENT ZFFSAB._.LayerAGS.sv_AGS_PosStat "Output value braketorque status in LayerAGS" UBYTE SAB_STANDARD_S2_S3 1 100 0 2 DISPLAY_IDENTIFIER sv_AGS_PosStat.LayerAGS._.ZFFSAB ECU_ADDRESS 0xFFF9743D /end MEASUREMENT
/begin MEASUREMENT ZFFSAB._.LayerAGS.sv_AGS_PtDampgActive "Output value power train damping is active in LayerAGS" UBYTE SAB_STANDARD_S2_S3 1 100 0 1 DISPLAY_IDENTIFIER sv_AGS_PtDampgActive.LayerAGS._.ZFFSAB ECU_ADDRESS 0xFFF9743E /end MEASUREMENT
/begin MEASUREMENT ZFFSAB._.LayerAGS.sv_AGS_RpmEngMax "Output value max allowed engine speed from engine unit in LayerAGS" UBYTE SAB_N_50RPM_S2_S3 1 100 0 12750 DISPLAY_IDENTIFIER sv_AGS_RpmEngMax.LayerAGS._.ZFFSAB ECU_ADDRESS 0xFFF9743F /end MEASUREMENT
/begin MEASUREMENT ZFFSAB._.LayerAGS.sv_AGS_SportGetriebe "Output value current forced changing gears up in LayerAGS" UBYTE SAB_STANDARD_S2_S3 1 100 0 15 DISPLAY_IDENTIFIER sv_AGS_SportGetriebe.LayerAGS._.ZFFSAB ECU_ADDRESS 0xFFF97440 /end MEASUREMENT
/begin MEASUREMENT ZFFSAB._.LayerAGS.sv_AGS_VVehPlausi "Output value Plausibility of car speed in LayerAGS" UBYTE SAB_STANDARD_S2_S3 1 100 0 5 DISPLAY_IDENTIFIER sv_AGS_VVehPlausi.LayerAGS._.ZFFSAB ECU_ADDRESS 0xFFF97441 /end MEASUREMENT
/begin MEASUREMENT ZFFSAB._.LayerAGS.sv_AGS_ZK0Soll "Output value K0 state request in LayerAGS" UBYTE SAB_STANDARD_S2_S3 1 100 0 3 DISPLAY_IDENTIFIER sv_AGS_ZK0Soll.LayerAGS._.ZFFSAB ECU_ADDRESS 0xFFF97442 /end MEASUREMENT
/begin MEASUREMENT ZFFSAB._.LayerAGS.sv_f_TrailerInfo_AGS "Output value trailer active in LayerAGS" UBYTE SAB_STANDARD_S2_S3 1 100 0 255 DISPLAY_IDENTIFIER sv_f_TrailerInfo_AGS.LayerAGS._.ZFFSAB ECU_ADDRESS 0xFFF97443 /end MEASUREMENT
/begin MEASUREMENT ZFFSAB._.LayerAGS.sv_AGS_MTurbine "Output value Turbine Torque in LayerAGS" UWORD SAB_M_1NM_M32000_S2_S3 1 100 -32000 33535 DISPLAY_IDENTIFIER sv_AGS_MTurbine.LayerAGS._.ZFFSAB ECU_ADDRESS 0xFFF97444 /end MEASUREMENT
/begin MEASUREMENT ZFFSAB._.LayerAGS.ZielGangAGS "Calculated ZF-Zielgang" SBYTE SAB_STANDARD_S2_S3 1 100 -128 127 DISPLAY_IDENTIFIER ZielGangAGS.LayerAGS._.ZFFSAB ECU_ADDRESS 0xFFF97446 /end MEASUREMENT
/begin MEASUREMENT ZFFSAB._.LayerAGS.IstGangAGS "Calculated ZF-Istgang" SBYTE SAB_STANDARD_S2_S3 1 100 -128 127 DISPLAY_IDENTIFIER IstGangAGS.LayerAGS._.ZFFSAB ECU_ADDRESS 0xFFF97447 /end MEASUREMENT
/begin MEASUREMENT ZFFSAB._.LayerAGS.sv_AGS_ZGangSoll "Output value Request for ZGangSoll in LayerAGS" SBYTE SAB_STANDARD_S2_S3 1 100 0 8 DISPLAY_IDENTIFIER sv_AGS_ZGangSoll.LayerAGS._.ZFFSAB ECU_ADDRESS 0xFFF97448 /end MEASUREMENT
/begin MEASUREMENT ZFFSAB._.LayerAGS.sv_AGS_IstGang "Output value IstGang in LayerAGS" UBYTE SAB_STANDARD_S2_S3 1 100 0 12 DISPLAY_IDENTIFIER sv_AGS_IstGang.LayerAGS._.ZFFSAB ECU_ADDRESS 0xFFF97449 /end MEASUREMENT
/begin MEASUREMENT ZFFSAB._.LayerAGS.sv_AGS_ZielGang "Output value ZielGang in LayerAGS" UBYTE SAB_STANDARD_S2_S3 1 100 0 12 DISPLAY_IDENTIFIER sv_AGS_ZielGang.LayerAGS._.ZFFSAB ECU_ADDRESS 0xFFF9744A /end MEASUREMENT
/begin MEASUREMENT ZFFSAB._.LayerAGS.sv_AGS_ShiftDelay "Output value ShiftDelay in LayerAGS" UBYTE SAB_STANDARD_S2_S3 1 100 0 1 DISPLAY_IDENTIFIER sv_AGS_ShiftDelay.LayerAGS._.ZFFSAB ECU_ADDRESS 0xFFF9744B /end MEASUREMENT
/begin MEASUREMENT ZFFSAB._.LayerAGS.sv_AGS_ZHasIst "Output value actual State of HAS in LayerAGS" UBYTE SAB_STANDARD_S2_S3 1 100 0 15 DISPLAY_IDENTIFIER sv_AGS_ZHasIst.LayerAGS._.ZFFSAB ECU_ADDRESS 0xFFF9744C /end MEASUREMENT
/begin MEASUREMENT ZFFSAB._.LayerAGS.sv_AGS_ZHasZiel "Output value target State of HAS in LayerAGS" UBYTE SAB_STANDARD_S2_S3 1 100 0 15 DISPLAY_IDENTIFIER sv_AGS_ZHasZiel.LayerAGS._.ZFFSAB ECU_ADDRESS 0xFFF9744D /end MEASUREMENT
/begin MEASUREMENT ZFFSAB._.LayerAGS.SollGangMoeglich "Calculated possible Request for ZGangSoll" SBYTE SAB_STANDARD_S2_S3 1 100 -1 8 DISPLAY_IDENTIFIER SollGangMoeglich.LayerAGS._.ZFFSAB ECU_ADDRESS 0xFFF9744E /end MEASUREMENT
/begin MEASUREMENT ZFFSAB._.LayerAGS.sv_AGS_GangZielAgs "Output value possible Request for ZGangSoll in LayerAGS" UBYTE SAB_STANDARD_S2_S3 1 100 0 12 DISPLAY_IDENTIFIER sv_AGS_GangZielAgs.LayerAGS._.ZFFSAB ECU_ADDRESS 0xFFF9744F /end MEASUREMENT
/begin MEASUREMENT ZFFSAB._.LayerAGS.sv_AGS_BetrStratEngStart "Output value present Abschaltverhinderer Einschaltaufforderer or Deaktivierer in LayerAGS" UWORD SAB_STANDARD_S2_S3 1 100 0 65535 DISPLAY_IDENTIFIER sv_AGS_BetrStratEngStart.LayerAGS._.ZFFSAB ECU_ADDRESS 0xFFF97450 /end MEASUREMENT
/begin MEASUREMENT ZFFSAB._.LayerAGS.sv_AGS_RqShpoOstr "Output value engine Schaltanforderung durch LastPunktAnhebung in LayerAGS" UBYTE SAB_STANDARD_S2_S3 1 100 0 255 DISPLAY_IDENTIFIER sv_AGS_RqShpoOstr.LayerAGS._.ZFFSAB ECU_ADDRESS 0xFFF97452 /end MEASUREMENT
/begin MEASUREMENT ZFFSAB._.LayerAGS.sv_AGS_Soc_Mode "Output value engine Status Mode SOC in LayerAGS" UBYTE SAB_STANDARD_S2_S3 1 100 0 255 DISPLAY_IDENTIFIER sv_AGS_Soc_Mode.LayerAGS._.ZFFSAB ECU_ADDRESS 0xFFF97453 /end MEASUREMENT
/begin MEASUREMENT ZFFSAB._.LayerAGS.sv_AGS_StIdc "Output value defines the lamps that are blinking in LayerAGS" UBYTE SAB_STANDARD_S2_S3 1 100 0 2 DISPLAY_IDENTIFIER sv_AGS_StIdc.LayerAGS._.ZFFSAB ECU_ADDRESS 0xFFF97454 /end MEASUREMENT
/begin MEASUREMENT ZFFSAB._.LayerAGS.iv_AGS_DispRpmEngCrsh "Input value Dynamical engine speed in LayerAGS" UWORD SAB_N_10RPM_S2_S3 1 100 0 100000 DISPLAY_IDENTIFIER iv_AGS_DispRpmEngCrsh.LayerAGS._.ZFFSAB ECU_ADDRESS 0xFFF97456 /end MEASUREMENT
/begin MEASUREMENT ZFFSAB._.LayerAGS.iv_AGS_IdxGrbDyn "Input value Dynamic Gearbox Index in LayerAGS" UBYTE SAB_STANDARD_S2_S3 1 100 0 255 DISPLAY_IDENTIFIER iv_AGS_IdxGrbDyn.LayerAGS._.ZFFSAB ECU_ADDRESS 0xFFF97458 /end MEASUREMENT
/begin MEASUREMENT ZFFSAB._.LayerAGS.iv_AGS_K0ZielZustand "Input value target state K0 clutch in LayerAGS" UBYTE SAB_STANDARD_S2_S3 1 100 0 6 DISPLAY_IDENTIFIER iv_AGS_K0ZielZustand.LayerAGS._.ZFFSAB ECU_ADDRESS 0xFFF97459 /end MEASUREMENT
/begin MEASUREMENT ZFFSAB._.LayerAGS.iv_AGS_MSA "MSA-request to ATSYS in LayerAGS" UBYTE SAB_STANDARD_S2_S3 1 100 0 1 DISPLAY_IDENTIFIER iv_AGS_MSA.LayerAGS._.ZFFSAB ECU_ADDRESS 0xFFF9745A /end MEASUREMENT
/begin MEASUREMENT ZFFSAB._.LayerAGS.iv_AGS_RpmDynOut "Input value Dynamical revolution counter request in LayerAGS" UBYTE SAB_STANDARD_S2_S3 1 100 0 1 DISPLAY_IDENTIFIER iv_AGS_RpmDynOut.LayerAGS._.ZFFSAB ECU_ADDRESS 0xFFF9745B /end MEASUREMENT
/begin MEASUREMENT ZFFSAB._.LayerAGS.iv_AGS_ZGangSoll "Input value ZGangSoll in LayerAGS" UBYTE SAB_STANDARD_S2_S3 1 100 0 12 DISPLAY_IDENTIFIER iv_AGS_ZGangSoll.LayerAGS._.ZFFSAB ECU_ADDRESS 0xFFF9745C /end MEASUREMENT
/begin MEASUREMENT ZFFSAB._.LayerAGS.iv_AGS_ZkaIndex "Interpretation of drivers request to ATSYS in LayerAGS" UBYTE SAB_STANDARD_S2_S3 1 100 0 14 DISPLAY_IDENTIFIER iv_AGS_ZkaIndex.LayerAGS._.ZFFSAB ECU_ADDRESS 0xFFF9745D /end MEASUREMENT
/begin MEASUREMENT ZFFSAB._.LayerAGS.iv_AGS_ZK0Soll "Input value K0 state request in LayerAGS" UBYTE SAB_STANDARD_S2_S3 1 100 0 5 DISPLAY_IDENTIFIER iv_AGS_ZK0Soll.LayerAGS._.ZFFSAB ECU_ADDRESS 0xFFF9745E /end MEASUREMENT
/begin MEASUREMENT ZFFSAB._.LayerAGS.iv_AGS_RqShpoOstr "Input CAN message. Schaltanforderung durch LastPunktAnhebung in LayerAGS." UBYTE SAB_STANDARD_S2_S3 1 100 0 255 DISPLAY_IDENTIFIER iv_AGS_RqShpoOstr.LayerAGS._.ZFFSAB ECU_ADDRESS 0xFFF9745F /end MEASUREMENT
/begin MEASUREMENT ZFFSAB._.LayerAGS.iv_AGS_RqShpoOstrSts "Input CAN message status. Schaltanforderung durch LastPunktAnhebung in LayerAGS." UBYTE SAB_STANDARD_S2_S3 1 100 0 255 DISPLAY_IDENTIFIER iv_AGS_RqShpoOstrSts.LayerAGS._.ZFFSAB ECU_ADDRESS 0xFFF97460 /end MEASUREMENT
/begin MEASUREMENT ZFFSAB._.LayerAGS.iv_AGS_BetrStratEngStart "Input CAN message. Present Abschaltverhinderer Einschaltaufforderer or Deaktivierer in LayerAGS." UWORD SAB_STANDARD_S2_S3 1 100 0 65355 DISPLAY_IDENTIFIER iv_AGS_BetrStratEngStart.LayerAGS._.ZFFSAB ECU_ADDRESS 0xFFF97462 /end MEASUREMENT
/begin MEASUREMENT ZFFSAB._.LayerAGS.iv_AGS_BetrStratEngStartSts "Input CAN message status. Present Abschaltverhinderer Einschaltaufforderer or Deaktivierer in LayerAGS." UBYTE SAB_STANDARD_S2_S3 1 100 0 255 DISPLAY_IDENTIFIER iv_AGS_BetrStratEngStartSts.LayerAGS._.ZFFSAB ECU_ADDRESS 0xFFF97464 /end MEASUREMENT
/begin MEASUREMENT ZFFSAB._.LayerAGS.iv_AGS_EFahrKL "Input CAN message. Control index to choose energetic Operationstrategie." UBYTE SAB_STANDARD_S2_S3 1 100 0 15 DISPLAY_IDENTIFIER iv_AGS_EFahrKL.LayerAGS._.ZFFSAB ECU_ADDRESS 0xFFF97465 /end MEASUREMENT
/begin MEASUREMENT ZFFSAB._.LayerAGS.iv_AGS_EFahrKLSts "Input CAN message status. Control index to choose energetic Operationstrategie." UBYTE SAB_STANDARD_S2_S3 1 100 0 255 DISPLAY_IDENTIFIER iv_AGS_EFahrKLSts.LayerAGS._.ZFFSAB ECU_ADDRESS 0xFFF97466 /end MEASUREMENT
/begin MEASUREMENT ZFFSAB._.LayerAGS.iv_AGS_MEm "Input CAN message. Input value Electrical machine torque in LayerAGS" UWORD SAB_M_NM2_M2047_S2_S3 1 100 -1023.5 1024 DISPLAY_IDENTIFIER iv_AGS_MEm.LayerAGS._.ZFFSAB ECU_ADDRESS 0xFFF97468 /end MEASUREMENT
/begin MEASUREMENT ZFFSAB._.LayerAGS.iv_AGS_MEmSts "Input CAN message status. Input value Electrical machine torque in LayerAGS" UBYTE SAB_STANDARD_S2_S3 1 100 0 255 DISPLAY_IDENTIFIER iv_AGS_MEmSts.LayerAGS._.ZFFSAB ECU_ADDRESS 0xFFF9746A /end MEASUREMENT
/begin MEASUREMENT ZFFSAB._.LayerAGS.iv_AGS_EngStartTyp "Input CAN message. Input value engine start modein LayerAGS." UBYTE SAB_STANDARD_S2_S3 1 100 0 15 DISPLAY_IDENTIFIER iv_AGS_EngStartTyp.LayerAGS._.ZFFSAB ECU_ADDRESS 0xFFF9746B /end MEASUREMENT
/begin MEASUREMENT ZFFSAB._.LayerAGS.iv_AGS_EngStartTypSts "Input CAN message status. Input value Status of engine start mode in LayerAGS." UBYTE SAB_STANDARD_S2_S3 1 100 0 255 DISPLAY_IDENTIFIER iv_AGS_EngStartTypSts.LayerAGS._.ZFFSAB ECU_ADDRESS 0xFFF9746C /end MEASUREMENT
/begin MEASUREMENT ZFFSAB._.LayerAGS.iv_AGS_Soc_Mode "Input CAN message. Input value Status Mode SOC in LayerAGS." UBYTE SAB_STANDARD_S2_S3 1 100 0 15 DISPLAY_IDENTIFIER iv_AGS_Soc_Mode.LayerAGS._.ZFFSAB ECU_ADDRESS 0xFFF9746D /end MEASUREMENT
/begin MEASUREMENT ZFFSAB._.LayerAGS.iv_AGS_Soc_ModeSts "Input CAN message status. Input value Status of Status Mode SOC in LayerAGS." UBYTE SAB_STANDARD_S2_S3 1 100 0 255 DISPLAY_IDENTIFIER iv_AGS_Soc_ModeSts.LayerAGS._.ZFFSAB ECU_ADDRESS 0xFFF9746E /end MEASUREMENT
/begin MEASUREMENT ZFFSAB._.LayerAGS.iv_AGS_StIdc "Input CAN message. Defines the lamps that are blinking." UBYTE SAB_STANDARD_S2_S3 1 100 0 7 DISPLAY_IDENTIFIER iv_AGS_StIdc.LayerAGS._.ZFFSAB ECU_ADDRESS 0xFFF9746F /end MEASUREMENT
/begin MEASUREMENT ZFFSAB._.LayerAGS.iv_AGS_StIdcSts "Input CAN message status. Defines the lamps that are blinking." UBYTE SAB_STANDARD_S2_S3 1 100 0 255 DISPLAY_IDENTIFIER iv_AGS_StIdcSts.LayerAGS._.ZFFSAB ECU_ADDRESS 0xFFF97470 /end MEASUREMENT
/begin MEASUREMENT ZFFSAB._.LayerAGS.sv_AGS_EFahrKL "Output value current electronic driving strategy in LayerAGS" UBYTE SAB_STANDARD_S2_S3 1 100 0 5 DISPLAY_IDENTIFIER sv_AGS_EFahrKL.LayerAGS._.ZFFSAB ECU_ADDRESS 0xFFF97471 /end MEASUREMENT
/begin MEASUREMENT ZFFSAB._.ComConditionsIn.iv_PreConKL15CanSts "Input value value of terminal 15 status" UBYTE SAB_STANDARD_S2_S3 1 100 0 255 DISPLAY_IDENTIFIER iv_PreConKL15CanSts.ComConditionsIn._.ZFFSAB ECU_ADDRESS 0xFFF97A20 /end MEASUREMENT
/begin MEASUREMENT ZFFSAB._.ComConditionsIn.iv_PreConEWS "state of immobilizer (EWS): 0 = blocked 1 = free 2 = init 3 = reset" UBYTE SAB_STANDARD_S2_S3 1 100 0 3 DISPLAY_IDENTIFIER iv_PreConEWS.ComConditionsIn._.ZFFSAB ECU_ADDRESS 0xFFF97A21 /end MEASUREMENT
/begin MEASUREMENT ZFFSAB._.ComConditionsIn.Preconditions "Output signal of ComConditionsIn" UWORD SAB_STANDARD_S2_S3 1 100 0 65535 DISPLAY_IDENTIFIER Preconditions.ComConditionsIn._.ZFFSAB ECU_ADDRESS 0xFFF97A22 /end MEASUREMENT
/begin MEASUREMENT ZFFSAB._.EngineSignalDiagnosis.iv_Status_K0 "actual state of clutch K0" UBYTE SAB_STANDARD_S2_S3 1 100 0 5 DISPLAY_IDENTIFIER iv_Status_K0.EngineSignalDiagnosis._.ZFFSAB ECU_ADDRESS 0xFFF97A30 /end MEASUREMENT
/begin MEASUREMENT ZFFSAB._.AGS_LayerMessages.Nav1Buf[0] "Output Array contains data of message (NAV_GRAPH)" UBYTE SAB_STANDARD_S2_S3 1 100 0 255 DISPLAY_IDENTIFIER Nav1Buf[0].AGS_LayerMessages._.ZFFSAB ECU_ADDRESS 0xFFF97A8C /end MEASUREMENT
/begin MEASUREMENT ZFFSAB._.AGS_LayerMessages.Nav1Buf[1] "Output Array contains data of message (NAV_GRAPH)" UBYTE SAB_STANDARD_S2_S3 1 100 0 255 DISPLAY_IDENTIFIER Nav1Buf[1].AGS_LayerMessages._.ZFFSAB ECU_ADDRESS 0xFFF97A8D /end MEASUREMENT
/begin MEASUREMENT ZFFSAB._.AGS_LayerMessages.Nav1Buf[2] "Output Array contains data of message (NAV_GRAPH)" UBYTE SAB_STANDARD_S2_S3 1 100 0 255 DISPLAY_IDENTIFIER Nav1Buf[2].AGS_LayerMessages._.ZFFSAB ECU_ADDRESS 0xFFF97A8E /end MEASUREMENT
/begin MEASUREMENT ZFFSAB._.AGS_LayerMessages.Nav1Buf[3] "Output Array contains data of message (NAV_GRAPH)" UBYTE SAB_STANDARD_S2_S3 1 100 0 255 DISPLAY_IDENTIFIER Nav1Buf[3].AGS_LayerMessages._.ZFFSAB ECU_ADDRESS 0xFFF97A8F /end MEASUREMENT
/begin MEASUREMENT ZFFSAB._.AGS_LayerMessages.Nav1Buf[4] "Output Array contains data of message (NAV_GRAPH)" UBYTE SAB_STANDARD_S2_S3 1 100 0 255 DISPLAY_IDENTIFIER Nav1Buf[4].AGS_LayerMessages._.ZFFSAB ECU_ADDRESS 0xFFF97A90 /end MEASUREMENT
/begin MEASUREMENT ZFFSAB._.AGS_LayerMessages.Nav1Buf[5] "Output Array contains data of message (NAV_GRAPH)" UBYTE SAB_STANDARD_S2_S3 1 100 0 255 DISPLAY_IDENTIFIER Nav1Buf[5].AGS_LayerMessages._.ZFFSAB ECU_ADDRESS 0xFFF97A91 /end MEASUREMENT
/begin MEASUREMENT ZFFSAB._.AGS_LayerMessages.Nav1Buf[6] "Output Array contains data of message (NAV_GRAPH)" UBYTE SAB_STANDARD_S2_S3 1 100 0 255 DISPLAY_IDENTIFIER Nav1Buf[6].AGS_LayerMessages._.ZFFSAB ECU_ADDRESS 0xFFF97A92 /end MEASUREMENT
/begin MEASUREMENT ZFFSAB._.AGS_LayerMessages.Nav1Buf[7] "Output Array contains data of message (NAV_GRAPH)" UBYTE SAB_STANDARD_S2_S3 1 100 0 255 DISPLAY_IDENTIFIER Nav1Buf[7].AGS_LayerMessages._.ZFFSAB ECU_ADDRESS 0xFFF97A93 /end MEASUREMENT
/begin MEASUREMENT ZFFSAB._.AGS_LayerMessages.Nav2Buf[0] "Output Array contains data of message (NAV_GRAPH_SYNC)" UBYTE SAB_STANDARD_S2_S3 1 100 0 255 DISPLAY_IDENTIFIER Nav2Buf[0].AGS_LayerMessages._.ZFFSAB ECU_ADDRESS 0xFFF97A94 /end MEASUREMENT
/begin MEASUREMENT ZFFSAB._.AGS_LayerMessages.Nav2Buf[1] "Output Array contains data of message (NAV_GRAPH_SYNC)" UBYTE SAB_STANDARD_S2_S3 1 100 0 255 DISPLAY_IDENTIFIER Nav2Buf[1].AGS_LayerMessages._.ZFFSAB ECU_ADDRESS 0xFFF97A95 /end MEASUREMENT
/begin MEASUREMENT ZFFSAB._.AGS_LayerMessages.Nav2Buf[2] "Output Array contains data of message (NAV_GRAPH_SYNC)" UBYTE SAB_STANDARD_S2_S3 1 100 0 255 DISPLAY_IDENTIFIER Nav2Buf[2].AGS_LayerMessages._.ZFFSAB ECU_ADDRESS 0xFFF97A96 /end MEASUREMENT
/begin MEASUREMENT ZFFSAB._.AGS_LayerMessages.Nav2Buf[3] "Output Array contains data of message (NAV_GRAPH_SYNC)" UBYTE SAB_STANDARD_S2_S3 1 100 0 255 DISPLAY_IDENTIFIER Nav2Buf[3].AGS_LayerMessages._.ZFFSAB ECU_ADDRESS 0xFFF97A97 /end MEASUREMENT
/begin MEASUREMENT ZFFSAB._.AGS_LayerMessages.Nav2Buf[4] "Output Array contains data of message (NAV_GRAPH_SYNC)" UBYTE SAB_STANDARD_S2_S3 1 100 0 255 DISPLAY_IDENTIFIER Nav2Buf[4].AGS_LayerMessages._.ZFFSAB ECU_ADDRESS 0xFFF97A98 /end MEASUREMENT
/begin MEASUREMENT ZFFSAB._.AGS_LayerMessages.Nav2Buf[5] "Output Array contains data of message (NAV_GRAPH_SYNC)" UBYTE SAB_STANDARD_S2_S3 1 100 0 255 DISPLAY_IDENTIFIER Nav2Buf[5].AGS_LayerMessages._.ZFFSAB ECU_ADDRESS 0xFFF97A99 /end MEASUREMENT
/begin MEASUREMENT ZFFSAB._.AGS_LayerMessages.Nav2Buf[6] "Output Array contains data of message (NAV_GRAPH_SYNC)" UBYTE SAB_STANDARD_S2_S3 1 100 0 255 DISPLAY_IDENTIFIER Nav2Buf[6].AGS_LayerMessages._.ZFFSAB ECU_ADDRESS 0xFFF97A9A /end MEASUREMENT
/begin MEASUREMENT ZFFSAB._.AGS_LayerMessages.Nav2Buf[7] "Output Array contains data of message (NAV_GRAPH_SYNC)" UBYTE SAB_STANDARD_S2_S3 1 100 0 255 DISPLAY_IDENTIFIER Nav2Buf[7].AGS_LayerMessages._.ZFFSAB ECU_ADDRESS 0xFFF97A9B /end MEASUREMENT
/begin MEASUREMENT ZFFSAB._.AGS_LayerMessages.Nav3Buf[0] "Output Array contains data of message (NAV_SYS_INF)" UBYTE SAB_STANDARD_S2_S3 1 100 0 255 DISPLAY_IDENTIFIER Nav3Buf[0].AGS_LayerMessages._.ZFFSAB ECU_ADDRESS 0xFFF97A9C /end MEASUREMENT
/begin MEASUREMENT ZFFSAB._.AGS_LayerMessages.Nav3Buf[1] "Output Array contains data of message (NAV_SYS_INF)" UBYTE SAB_STANDARD_S2_S3 1 100 0 255 DISPLAY_IDENTIFIER Nav3Buf[1].AGS_LayerMessages._.ZFFSAB ECU_ADDRESS 0xFFF97A9D /end MEASUREMENT
/begin MEASUREMENT ZFFSAB._.AGS_LayerMessages.Nav3Buf[2] "Output Array contains data of message (NAV_SYS_INF)" UBYTE SAB_STANDARD_S2_S3 1 100 0 255 DISPLAY_IDENTIFIER Nav3Buf[2].AGS_LayerMessages._.ZFFSAB ECU_ADDRESS 0xFFF97A9E /end MEASUREMENT
/begin MEASUREMENT ZFFSAB._.AGS_LayerMessages.Nav3Buf[3] "Output Array contains data of message (NAV_SYS_INF)" UBYTE SAB_STANDARD_S2_S3 1 100 0 255 DISPLAY_IDENTIFIER Nav3Buf[3].AGS_LayerMessages._.ZFFSAB ECU_ADDRESS 0xFFF97A9F /end MEASUREMENT
/begin MEASUREMENT ZFFSAB._.AGS_LayerMessages.Nav3Buf[4] "Output Array contains data of message (NAV_SYS_INF)" UBYTE SAB_STANDARD_S2_S3 1 100 0 255 DISPLAY_IDENTIFIER Nav3Buf[4].AGS_LayerMessages._.ZFFSAB ECU_ADDRESS 0xFFF97AA0 /end MEASUREMENT
/begin MEASUREMENT ZFFSAB._.AGS_LayerMessages.Nav3Buf[5] "Output Array contains data of message (NAV_SYS_INF)" UBYTE SAB_STANDARD_S2_S3 1 100 0 255 DISPLAY_IDENTIFIER Nav3Buf[5].AGS_LayerMessages._.ZFFSAB ECU_ADDRESS 0xFFF97AA1 /end MEASUREMENT
/begin MEASUREMENT ZFFSAB._.AGS_LayerMessages.Nav3Buf[6] "Output Array contains data of message (NAV_SYS_INF)" UBYTE SAB_STANDARD_S2_S3 1 100 0 255 DISPLAY_IDENTIFIER Nav3Buf[6].AGS_LayerMessages._.ZFFSAB ECU_ADDRESS 0xFFF97AA2 /end MEASUREMENT
/begin MEASUREMENT ZFFSAB._.AGS_LayerMessages.Nav3Buf[7] "Output Array contains data of message (NAV_SYS_INF)" UBYTE SAB_STANDARD_S2_S3 1 100 0 255 DISPLAY_IDENTIFIER Nav3Buf[7].AGS_LayerMessages._.ZFFSAB ECU_ADDRESS 0xFFF97AA3 /end MEASUREMENT
/begin MEASUREMENT ZFFSAB._.AGS_LayerMessages.Nav4Buf[0] "Output Array contains data of message (NAV_GRAPH_V)" UBYTE SAB_STANDARD_S2_S3 1 100 0 255 DISPLAY_IDENTIFIER Nav4Buf[0].AGS_LayerMessages._.ZFFSAB ECU_ADDRESS 0xFFF97AA4 /end MEASUREMENT
/begin MEASUREMENT ZFFSAB._.AGS_LayerMessages.Nav4Buf[1] "Output Array contains data of message (NAV_GRAPH_V)" UBYTE SAB_STANDARD_S2_S3 1 100 0 255 DISPLAY_IDENTIFIER Nav4Buf[1].AGS_LayerMessages._.ZFFSAB ECU_ADDRESS 0xFFF97AA5 /end MEASUREMENT
/begin MEASUREMENT ZFFSAB._.AGS_LayerMessages.Nav4Buf[2] "Output Array contains data of message (NAV_GRAPH_V)" UBYTE SAB_STANDARD_S2_S3 1 100 0 255 DISPLAY_IDENTIFIER Nav4Buf[2].AGS_LayerMessages._.ZFFSAB ECU_ADDRESS 0xFFF97AA6 /end MEASUREMENT
/begin MEASUREMENT ZFFSAB._.AGS_LayerMessages.Nav4Buf[3] "Output Array contains data of message (NAV_GRAPH_V)" UBYTE SAB_STANDARD_S2_S3 1 100 0 255 DISPLAY_IDENTIFIER Nav4Buf[3].AGS_LayerMessages._.ZFFSAB ECU_ADDRESS 0xFFF97AA7 /end MEASUREMENT
/begin MEASUREMENT ZFFSAB._.AGS_LayerMessages.Nav4Buf[4] "Output Array contains data of message (NAV_GRAPH_V)" UBYTE SAB_STANDARD_S2_S3 1 100 0 255 DISPLAY_IDENTIFIER Nav4Buf[4].AGS_LayerMessages._.ZFFSAB ECU_ADDRESS 0xFFF97AA8 /end MEASUREMENT
/begin MEASUREMENT ZFFSAB._.AGS_LayerMessages.Nav4Buf[5] "Output Array contains data of message (NAV_GRAPH_V)" UBYTE SAB_STANDARD_S2_S3 1 100 0 255 DISPLAY_IDENTIFIER Nav4Buf[5].AGS_LayerMessages._.ZFFSAB ECU_ADDRESS 0xFFF97AA9 /end MEASUREMENT
/begin MEASUREMENT ZFFSAB._.AGS_LayerMessages.Nav4Buf[6] "Output Array contains data of message (NAV_GRAPH_V)" UBYTE SAB_STANDARD_S2_S3 1 100 0 255 DISPLAY_IDENTIFIER Nav4Buf[6].AGS_LayerMessages._.ZFFSAB ECU_ADDRESS 0xFFF97AAA /end MEASUREMENT
/begin MEASUREMENT ZFFSAB._.AGS_LayerMessages.Nav4Buf[7] "Output Array contains data of message (NAV_GRAPH_V)" UBYTE SAB_STANDARD_S2_S3 1 100 0 255 DISPLAY_IDENTIFIER Nav4Buf[7].AGS_LayerMessages._.ZFFSAB ECU_ADDRESS 0xFFF97AAB /end MEASUREMENT
/begin MEASUREMENT ZFFSAB._.AGS_LayerMessages.Nav5Buf[0] "Output Array contains data of message (NAV_GRAPH_MAPDATA)" UBYTE SAB_STANDARD_S2_S3 1 100 0 255 DISPLAY_IDENTIFIER Nav5Buf[0].AGS_LayerMessages._.ZFFSAB ECU_ADDRESS 0xFFF97AAC /end MEASUREMENT
/begin MEASUREMENT ZFFSAB._.AGS_LayerMessages.Nav5Buf[1] "Output Array contains data of message (NAV_GRAPH_MAPDATA)" UBYTE SAB_STANDARD_S2_S3 1 100 0 255 DISPLAY_IDENTIFIER Nav5Buf[1].AGS_LayerMessages._.ZFFSAB ECU_ADDRESS 0xFFF97AAD /end MEASUREMENT
/begin MEASUREMENT ZFFSAB._.AGS_LayerMessages.Nav5Buf[2] "Output Array contains data of message (NAV_GRAPH_MAPDATA)" UBYTE SAB_STANDARD_S2_S3 1 100 0 255 DISPLAY_IDENTIFIER Nav5Buf[2].AGS_LayerMessages._.ZFFSAB ECU_ADDRESS 0xFFF97AAE /end MEASUREMENT
/begin MEASUREMENT ZFFSAB._.AGS_LayerMessages.Nav5Buf[3] "Output Array contains data of message (NAV_GRAPH_MAPDATA)" UBYTE SAB_STANDARD_S2_S3 1 100 0 255 DISPLAY_IDENTIFIER Nav5Buf[3].AGS_LayerMessages._.ZFFSAB ECU_ADDRESS 0xFFF97AAF /end MEASUREMENT
/begin MEASUREMENT ZFFSAB._.AGS_LayerMessages.Nav5Buf[4] "Output Array contains data of message (NAV_GRAPH_MAPDATA)" UBYTE SAB_STANDARD_S2_S3 1 100 0 255 DISPLAY_IDENTIFIER Nav5Buf[4].AGS_LayerMessages._.ZFFSAB ECU_ADDRESS 0xFFF97AB0 /end MEASUREMENT
/begin MEASUREMENT ZFFSAB._.AGS_LayerMessages.Nav5Buf[5] "Output Array contains data of message (NAV_GRAPH_MAPDATA)" UBYTE SAB_STANDARD_S2_S3 1 100 0 255 DISPLAY_IDENTIFIER Nav5Buf[5].AGS_LayerMessages._.ZFFSAB ECU_ADDRESS 0xFFF97AB1 /end MEASUREMENT
/begin MEASUREMENT ZFFSAB._.AGS_LayerMessages.Nav5Buf[6] "Output Array contains data of message (NAV_GRAPH_MAPDATA)" UBYTE SAB_STANDARD_S2_S3 1 100 0 255 DISPLAY_IDENTIFIER Nav5Buf[6].AGS_LayerMessages._.ZFFSAB ECU_ADDRESS 0xFFF97AB2 /end MEASUREMENT
/begin MEASUREMENT ZFFSAB._.AGS_LayerMessages.Nav5Buf[7] "Output Array contains data of message (NAV_GRAPH_MAPDATA)" UBYTE SAB_STANDARD_S2_S3 1 100 0 255 DISPLAY_IDENTIFIER Nav5Buf[7].AGS_LayerMessages._.ZFFSAB ECU_ADDRESS 0xFFF97AB3 /end MEASUREMENT
/begin MEASUREMENT ZFFSAB._.AGS_LayerMessages.Nav6Buf[0] "Output Array contains data of message (NAV_GRAPH_LNE)" UBYTE SAB_STANDARD_S2_S3 1 100 0 255 DISPLAY_IDENTIFIER Nav6Buf[0].AGS_LayerMessages._.ZFFSAB ECU_ADDRESS 0xFFF97AB4 /end MEASUREMENT
/begin MEASUREMENT ZFFSAB._.AGS_LayerMessages.Nav6Buf[1] "Output Array contains data of message (NAV_GRAPH_LNE)" UBYTE SAB_STANDARD_S2_S3 1 100 0 255 DISPLAY_IDENTIFIER Nav6Buf[1].AGS_LayerMessages._.ZFFSAB ECU_ADDRESS 0xFFF97AB5 /end MEASUREMENT
/begin MEASUREMENT ZFFSAB._.AGS_LayerMessages.Nav6Buf[2] "Output Array contains data of message (NAV_GRAPH_LNE)" UBYTE SAB_STANDARD_S2_S3 1 100 0 255 DISPLAY_IDENTIFIER Nav6Buf[2].AGS_LayerMessages._.ZFFSAB ECU_ADDRESS 0xFFF97AB6 /end MEASUREMENT
/begin MEASUREMENT ZFFSAB._.AGS_LayerMessages.Nav6Buf[3] "Output Array contains data of message (NAV_GRAPH_LNE)" UBYTE SAB_STANDARD_S2_S3 1 100 0 255 DISPLAY_IDENTIFIER Nav6Buf[3].AGS_LayerMessages._.ZFFSAB ECU_ADDRESS 0xFFF97AB7 /end MEASUREMENT
/begin MEASUREMENT ZFFSAB._.AGS_LayerMessages.Nav6Buf[4] "Output Array contains data of message (NAV_GRAPH_LNE)" UBYTE SAB_STANDARD_S2_S3 1 100 0 255 DISPLAY_IDENTIFIER Nav6Buf[4].AGS_LayerMessages._.ZFFSAB ECU_ADDRESS 0xFFF97AB8 /end MEASUREMENT
/begin MEASUREMENT ZFFSAB._.AGS_LayerMessages.Nav6Buf[5] "Output Array contains data of message (NAV_GRAPH_LNE)" UBYTE SAB_STANDARD_S2_S3 1 100 0 255 DISPLAY_IDENTIFIER Nav6Buf[5].AGS_LayerMessages._.ZFFSAB ECU_ADDRESS 0xFFF97AB9 /end MEASUREMENT
/begin MEASUREMENT ZFFSAB._.AGS_LayerMessages.Nav6Buf[6] "Output Array contains data of message (NAV_GRAPH_LNE)" UBYTE SAB_STANDARD_S2_S3 1 100 0 255 DISPLAY_IDENTIFIER Nav6Buf[6].AGS_LayerMessages._.ZFFSAB ECU_ADDRESS 0xFFF97ABA /end MEASUREMENT
/begin MEASUREMENT ZFFSAB._.AGS_LayerMessages.Nav6Buf[7] "Output Array contains data of message (NAV_GRAPH_LNE)" UBYTE SAB_STANDARD_S2_S3 1 100 0 255 DISPLAY_IDENTIFIER Nav6Buf[7].AGS_LayerMessages._.ZFFSAB ECU_ADDRESS 0xFFF97ABB /end MEASUREMENT
/begin MEASUREMENT ZFFSAB._.AGS_LayerMessages.Nav7Buf[0] "Output Array contains data of message (NAV_GRAPH_MATCH)" UBYTE SAB_STANDARD_S2_S3 1 100 0 255 DISPLAY_IDENTIFIER Nav7Buf[0].AGS_LayerMessages._.ZFFSAB ECU_ADDRESS 0xFFF97ABC /end MEASUREMENT
/begin MEASUREMENT ZFFSAB._.AGS_LayerMessages.Nav7Buf[1] "Output Array contains data of message (NAV_GRAPH_MATCH)" UBYTE SAB_STANDARD_S2_S3 1 100 0 255 DISPLAY_IDENTIFIER Nav7Buf[1].AGS_LayerMessages._.ZFFSAB ECU_ADDRESS 0xFFF97ABD /end MEASUREMENT
/begin MEASUREMENT ZFFSAB._.AGS_LayerMessages.Nav7Buf[2] "Output Array contains data of message (NAV_GRAPH_MATCH)" UBYTE SAB_STANDARD_S2_S3 1 100 0 255 DISPLAY_IDENTIFIER Nav7Buf[2].AGS_LayerMessages._.ZFFSAB ECU_ADDRESS 0xFFF97ABE /end MEASUREMENT
/begin MEASUREMENT ZFFSAB._.AGS_LayerMessages.Nav7Buf[3] "Output Array contains data of message (NAV_GRAPH_MATCH)" UBYTE SAB_STANDARD_S2_S3 1 100 0 255 DISPLAY_IDENTIFIER Nav7Buf[3].AGS_LayerMessages._.ZFFSAB ECU_ADDRESS 0xFFF97ABF /end MEASUREMENT
/begin MEASUREMENT ZFFSAB._.AGS_LayerMessages.Nav7Buf[4] "Output Array contains data of message (NAV_GRAPH_MATCH)" UBYTE SAB_STANDARD_S2_S3 1 100 0 255 DISPLAY_IDENTIFIER Nav7Buf[4].AGS_LayerMessages._.ZFFSAB ECU_ADDRESS 0xFFF97AC0 /end MEASUREMENT
/begin MEASUREMENT ZFFSAB._.AGS_LayerMessages.Nav7Buf[5] "Output Array contains data of message (NAV_GRAPH_MATCH)" UBYTE SAB_STANDARD_S2_S3 1 100 0 255 DISPLAY_IDENTIFIER Nav7Buf[5].AGS_LayerMessages._.ZFFSAB ECU_ADDRESS 0xFFF97AC1 /end MEASUREMENT
/begin MEASUREMENT ZFFSAB._.AGS_LayerMessages.Nav7Buf[6] "Output Array contains data of message (NAV_GRAPH_MATCH)" UBYTE SAB_STANDARD_S2_S3 1 100 0 255 DISPLAY_IDENTIFIER Nav7Buf[6].AGS_LayerMessages._.ZFFSAB ECU_ADDRESS 0xFFF97AC2 /end MEASUREMENT
/begin MEASUREMENT ZFFSAB._.AGS_LayerMessages.Nav7Buf[7] "Output Array contains data of message (NAV_GRAPH_MATCH)" UBYTE SAB_STANDARD_S2_S3 1 100 0 255 DISPLAY_IDENTIFIER Nav7Buf[7].AGS_LayerMessages._.ZFFSAB ECU_ADDRESS 0xFFF97AC3 /end MEASUREMENT
/begin MEASUREMENT ZFFSAB._.AGS_LayerMessages.iv_AGS_Nav5CANSts "Input CAN message status of NAV_GRAPH_MAPDATA" UBYTE SAB_STANDARD_S2_S3 1 100 0 255 DISPLAY_IDENTIFIER iv_AGS_Nav5CANSts.AGS_LayerMessages._.ZFFSAB ECU_ADDRESS 0xFFF97AC4 /end MEASUREMENT
/begin MEASUREMENT ZFFSAB._.AGS_LayerMessages.iv_AGS_Nav7CANSts "Input CAN message status of NAV_GRAPH_MATCH" UBYTE SAB_STANDARD_S2_S3 1 100 0 255 DISPLAY_IDENTIFIER iv_AGS_Nav7CANSts.AGS_LayerMessages._.ZFFSAB ECU_ADDRESS 0xFFF97AC5 /end MEASUREMENT
/begin MEASUREMENT ZFFSAB._.AGS_LayerMessages.iv_AGS_Nav2CANSts "Input CAN message status of NAV_GRAPH_SYNC" UBYTE SAB_STANDARD_S2_S3 1 100 0 255 DISPLAY_IDENTIFIER iv_AGS_Nav2CANSts.AGS_LayerMessages._.ZFFSAB ECU_ADDRESS 0xFFF97AC6 /end MEASUREMENT
/begin MEASUREMENT ZFFSAB._.AGS_LayerMessages.iv_AGS_Nav3CANSts "Input CAN message status of NAV_SYS_INF" UBYTE SAB_STANDARD_S2_S3 1 100 0 255 DISPLAY_IDENTIFIER iv_AGS_Nav3CANSts.AGS_LayerMessages._.ZFFSAB ECU_ADDRESS 0xFFF97AC7 /end MEASUREMENT
/begin MEASUREMENT ZFFSAB._.AGS_LayerMessages.sv_AGS_Nav2Cnt "Output signal provides a message counter which increments (0-254) if the content of the CAN-Message NAV_GRAPH_SYNC changes." UBYTE SAB_STANDARD_S2_S3 1 100 0 255 DISPLAY_IDENTIFIER sv_AGS_Nav2Cnt.AGS_LayerMessages._.ZFFSAB ECU_ADDRESS 0xFFF97AC8 /end MEASUREMENT
/begin MEASUREMENT ZFFSAB._.AGS_LayerMessages.sv_AGS_Nav3Sts "Output signal provides the quality of NAV_SYS_INF" UBYTE SAB_STANDARD_S2_S3 1 100 0 2 DISPLAY_IDENTIFIER sv_AGS_Nav3Sts.AGS_LayerMessages._.ZFFSAB ECU_ADDRESS 0xFFF97AC9 /end MEASUREMENT
/begin MEASUREMENT ZFFSAB._.AGS_LayerMessages.sv_AGS_Nav5Cnt "Output signal provides a message counter which increments (0-254) if the content of the CAN-Message NAV_GRAPH_MAPDATA changes." UBYTE SAB_STANDARD_S2_S3 1 100 0 255 DISPLAY_IDENTIFIER sv_AGS_Nav5Cnt.AGS_LayerMessages._.ZFFSAB ECU_ADDRESS 0xFFF97ACA /end MEASUREMENT
/begin MEASUREMENT ZFFSAB._.AGS_LayerMessages.sv_AGS_Nav7Sts "Output signal provides the quality of NAV_GRAPH_MAPDATA" UBYTE SAB_STANDARD_S2_S3 1 100 0 2 DISPLAY_IDENTIFIER sv_AGS_Nav7Sts.AGS_LayerMessages._.ZFFSAB ECU_ADDRESS 0xFFF97ACB /end MEASUREMENT
/begin MEASUREMENT ZFFSAB._.BootJump.reset_allowance "Output signal of CALL_JUMP2BOOT. 0: Jump not allowed 1: Jump allowed 2: Pending" UBYTE SAB_STANDARD_S2_S3 1 100 0 2 DISPLAY_IDENTIFIER reset_allowance.BootJump._.ZFFSAB ECU_ADDRESS 0xFFF97B25 /end MEASUREMENT
/begin MEASUREMENT ZFFSAB._.EEpromZentralHandler.sv_f_EeUpdateAll "Request an update off all available eeprom channels. Remark: The state of the update will be provided by the macro GET_EE_UPDATE_ALL_STATE." UBYTE SAB_STANDARD_S2_S3 1 100 0 1 DISPLAY_IDENTIFIER sv_f_EeUpdateAll.EEpromZentralHandler._.ZFFSAB ECU_ADDRESS 0xFFF97FEB /end MEASUREMENT
/begin MEASUREMENT ZFFSAB._.EEpromZentralHandler.sv_EeUpdateAllCompleted "0=Update is in progress 1=Update completed without error 2=Update completed with error" UBYTE SAB_STANDARD_S2_S3 1 100 0 2 DISPLAY_IDENTIFIER sv_EeUpdateAllCompleted.EEpromZentralHandler._.ZFFSAB ECU_ADDRESS 0xFFF97FEC /end MEASUREMENT
/begin COMPU_METHOD UMR_MBSE_MSEC_50_1_0_S1_S3 "Umrechnung von 50 msec in msec\\nint = ((phys * 1) / 50) - (0) msec" RAT_FUNC "%5.3" "msec" COEFFS 0 1 -0 0 0 50 /end COMPU_METHOD
/begin COMPU_METHOD UMR_SEC_1_100_0_S1_S3 "int = ((phys * 100) / 1) - (0) [s]" RAT_FUNC "%5.3" "[s]" COEFFS 0 100 -0 0 0 1 /end COMPU_METHOD
/begin COMPU_METHOD UMR_MBSE_SEC_10_1_0_S1_S3 "Umrechnung von 10 sec in sec\\nint = ((phys * 1) / 10) - (0) sec" RAT_FUNC "%5.3" "sec" COEFFS 0 1 -0 0 0 10 /end COMPU_METHOD
/begin COMPU_METHOD UMR_POW_1_360K_0_S1_S3 "int = ((phys * 360000) / 1) - (0) [mAh]" RAT_FUNC "%8.6" "[mAh]" COEFFS 0 360000 -0 0 0 1 /end COMPU_METHOD
/begin COMPU_METHOD UMR_U_1_1_0_S1_S3 "int = ((phys * 1) / 1) - (0) [V]" RAT_FUNC "%2.0" "[V]" COEFFS 0 1 -0 0 0 1 /end COMPU_METHOD
/begin COMPU_METHOD UMR_VWL__1_20_S1_S3 "int = ((phys * 20) / 1) - (0) [Grad/s]" RAT_FUNC "%5.3" "[Grad/s]" COEFFS 0 20 -0 0 0 1 /end COMPU_METHOD
/begin COMPU_METHOD UMR_VWL_1_1_0_S1_S3 "int = ((phys * 1) / 1) - (0) [Grad/s]" RAT_FUNC "%2.0" "[Grad/s]" COEFFS 0 1 -0 0 0 1 /end COMPU_METHOD
/begin COMPU_METHOD UMR_WL_M_7_160_0_S1_S3 "int = ((phys * 160) / 7) - (0) [Grad]" RAT_FUNC "%5.3" "[Grad]" COEFFS 0 160 -0 0 0 7 /end COMPU_METHOD
/begin COMPU_METHOD UMR_WL_1_1_0_S1_S3 "int = ((phys * 1) / 1) - (0) [Grad]" RAT_FUNC "%2.0" "[Grad]" COEFFS 0 1 -0 0 0 1 /end COMPU_METHOD
/begin COMPU_METHOD UMR_VKMH_1_1_0_S1_S3 "Umrechnung in km/h\\nint = ((phys * 1) / 1) - (0) km/h" RAT_FUNC "%2.0" "km/h" COEFFS 0 1 -0 0 0 1 /end COMPU_METHOD
/begin COMPU_METHOD UMR_VKMH__1_160_0_S1_S3 "Umrechnung von 1/160 km/h in km/h\\nint = ((phys * 160) / 1) - (0) km/h" RAT_FUNC "%5.3" "km/h" COEFFS 0 160 -0 0 0 1 /end COMPU_METHOD
/begin COMPU_METHOD UMR_P_BREMSE_1_2_0_S1_S3 "int = ((phys * 2) / 1) - (0) [bar]" RAT_FUNC "%5.3" "[bar]" COEFFS 0 2 -0 0 0 1 /end COMPU_METHOD
/begin COMPU_METHOD eReqDispGear_S1_S3 "" TAB_VERB "%2.0" "" COMPU_TAB_REF eReqDispGear_S1_S3 /end COMPU_METHOD
/begin COMPU_METHOD eCodingMarket_S1_S3 "" TAB_VERB "%2.0" "" COMPU_TAB_REF eCodingMarket_S1_S3 /end COMPU_METHOD
/begin COMPU_METHOD ePosPRNDNA_S1_S3 "" TAB_VERB "%2.0" "" COMPU_TAB_REF ePosPRNDNA_S1_S3 /end COMPU_METHOD
/begin COMPU_METHOD ePosPRNDS_S1_S3 "" TAB_VERB "%2.0" "" COMPU_TAB_REF ePosPRNDS_S1_S3 /end COMPU_METHOD
/begin COMPU_METHOD eLeverPos_Z1234NA_S1_S3 "" TAB_VERB "%2.0" "" COMPU_TAB_REF eLeverPos_Z1234NA_S1_S3 /end COMPU_METHOD
/begin COMPU_METHOD SAB_STANDARD_S2_S3 "int = ((phys * 1) / 1) - (0) -" RAT_FUNC "%2.0" "-" COEFFS 0 1 -0 0 0 1 /end COMPU_METHOD
/begin COMPU_METHOD SAB_PROZENT10_S2_S3 "int = ((phys * 10) / 1) - (0) %" RAT_FUNC "%5.3" "%" COEFFS 0 10 -0 0 0 1 /end COMPU_METHOD
/begin COMPU_METHOD SAB_T_TIMER_1US_S2_S3 "int = ((phys * 1) / 1) - (0) us" RAT_FUNC "%2.0" "us" COEFFS 0 1 -0 0 0 1 /end COMPU_METHOD
/begin COMPU_METHOD SAB_T_TIMER_5MS_S2_S3 "int = ((phys * 1) / 5) - (0) ms" RAT_FUNC "%5.3" "ms" COEFFS 0 1 -0 0 0 5 /end COMPU_METHOD
/begin COMPU_METHOD SAB_T_TIMER_10MS_S2_S3 "int = ((phys * 1) / 10) - (0) ms" RAT_FUNC "%5.3" "ms" COEFFS 0 1 -0 0 0 10 /end COMPU_METHOD
/begin COMPU_METHOD SAB_T_TIMER_1S_S2_S3 "int = ((phys * 1) / 1) - (0) s" RAT_FUNC "%2.0" "s" COEFFS 0 1 -0 0 0 1 /end COMPU_METHOD
/begin COMPU_METHOD SAB_T_TIMER_S10_S2_S3 "int = ((phys * 10) / 1) - (0) s" RAT_FUNC "%5.3" "s" COEFFS 0 10 -0 0 0 1 /end COMPU_METHOD
/begin COMPU_METHOD SAB_N_1RPM_S2_S3 "int = ((phys * 1) / 1) - (0) 1/min" RAT_FUNC "%2.0" "1/min" COEFFS 0 1 -0 0 0 1 /end COMPU_METHOD
/begin COMPU_METHOD SAB_C_CMO_1CEL_M48_S2_S3 "int = ((phys * 1) / 1) - (-48) Grad Celsius" RAT_FUNC "%2.0" "Grad Celsius" COEFFS 0 1 48 0 0 1 /end COMPU_METHOD
/begin COMPU_METHOD SAB_C_1CEL_S2_S3 "int = ((phys * 1) / 1) - (0) Grad Celsius" RAT_FUNC "%2.0" "Grad Celsius" COEFFS 0 1 -0 0 0 1 /end COMPU_METHOD
/begin COMPU_METHOD SAB_C_CGT_1CEL_M40_S2_S3 "int = ((phys * 1) / 1) - (-40) Grad Celsius" RAT_FUNC "%2.0" "Grad Celsius" COEFFS 0 1 40 0 0 1 /end COMPU_METHOD
/begin COMPU_METHOD SAB_C_TEMPEXTERN_CEL2_M40_S2_S3 "int = ((phys * 2) / 1) - (-80) Grad Celsius" RAT_FUNC "%5.3" "Grad Celsius" COEFFS 0 2 80 0 0 1 /end COMPU_METHOD
/begin COMPU_METHOD SAB_M_NM_S2_S3 "int = ((phys * 1) / 1) - (0) Nm" RAT_FUNC "%2.0" "Nm" COEFFS 0 1 -0 0 0 1 /end COMPU_METHOD
/begin COMPU_METHOD SAB_M_NM_M32000_S2_S3 "int = ((phys * 1) / 1) - (-32000) Nm" RAT_FUNC "%2.0" "Nm" COEFFS 0 1 32000 0 0 1 /end COMPU_METHOD
/begin COMPU_METHOD SAB_M_1NM_S2_S3 "int = ((phys * 1) / 1) - (0) Nm" RAT_FUNC "%2.0" "Nm" COEFFS 0 1 -0 0 0 1 /end COMPU_METHOD
/begin COMPU_METHOD SAB_P_BAR2_S2_S3 "int = ((phys * 2) / 1) - (0) bar" RAT_FUNC "%5.3" "bar" COEFFS 0 2 -0 0 0 1 /end COMPU_METHOD
/begin COMPU_METHOD SAB_PHI_2GRAD_S2_S3 "int = ((phys * 1) / 2) - (0) grad" RAT_FUNC "%5.3" "grad" COEFFS 0 1 -0 0 0 2 /end COMPU_METHOD
/begin COMPU_METHOD SAB_L_10KM_S2_S3 "int = ((phys * 1) / 10) - (0) km" RAT_FUNC "%5.3" "km" COEFFS 0 1 -0 0 0 10 /end COMPU_METHOD
/begin COMPU_METHOD SAB_T_10S_S2_S3 "int = ((phys * 1) / 10) - (0) s" RAT_FUNC "%5.3" "s" COEFFS 0 1 -0 0 0 10 /end COMPU_METHOD
/begin COMPU_METHOD SAB_N_10RPM_S2_S3 "int = ((phys * 1) / 10) - (0) 1/min" RAT_FUNC "%5.3" "1/min" COEFFS 0 1 -0 0 0 10 /end COMPU_METHOD
/begin COMPU_METHOD SAB_1004PROZENT2550_S2_S3 "int = ((phys * 2550) / 1004) - (0) %" RAT_FUNC "%5.3" "%" COEFFS 0 2550 -0 0 0 1004 /end COMPU_METHOD
/begin COMPU_METHOD SAB_4PROZENT10_S2_S3 "int = ((phys * 10) / 4) - (0) %" RAT_FUNC "%5.3" "%" COEFFS 0 10 -0 0 0 4 /end COMPU_METHOD
/begin COMPU_METHOD SAB_M_4NM_S2_S3 "int = ((phys * 1) / 4) - (0) Nm" RAT_FUNC "%5.3" "Nm" COEFFS 0 1 -0 0 0 4 /end COMPU_METHOD
/begin COMPU_METHOD SAB_V_1KMH_S2_S3 "int = ((phys * 1) / 1) - (0) km/h" RAT_FUNC "%2.0" "km/h" COEFFS 0 1 -0 0 0 1 /end COMPU_METHOD
/begin COMPU_METHOD SAB_V_KMH16_S2_S3 "int = ((phys * 16) / 1) - (0) km/h" RAT_FUNC "%5.3" "km/h" COEFFS 0 16 -0 0 0 1 /end COMPU_METHOD
/begin COMPU_METHOD SAB_K100_S2_S3 "int = ((phys * 100) / 1) - (0) -" RAT_FUNC "%5.3" "-" COEFFS 0 100 -0 0 0 1 /end COMPU_METHOD
/begin COMPU_METHOD SAB_1PROZENT_S2_S3 "int = ((phys * 1) / 1) - (0) %" RAT_FUNC "%2.0" "%" COEFFS 0 1 -0 0 0 1 /end COMPU_METHOD
/begin COMPU_METHOD SAB_M_1NM_M32000_S2_S3 "int = ((phys * 1) / 1) - (-32000) Nm" RAT_FUNC "%2.0" "Nm" COEFFS 0 1 32000 0 0 1 /end COMPU_METHOD
/begin COMPU_METHOD SAB_N_50RPM_S2_S3 "int = ((phys * 1) / 50) - (0) 1/min" RAT_FUNC "%5.3" "1/min" COEFFS 0 1 -0 0 0 50 /end COMPU_METHOD
/begin COMPU_METHOD SAB_T_10MS_S2_S3 "int = ((phys * 1) / 10) - (0) ms" RAT_FUNC "%5.3" "ms" COEFFS 0 1 -0 0 0 10 /end COMPU_METHOD
/begin COMPU_METHOD SAB_U_1VOLT1000_S2_S3 "int = ((phys * 1000) / 1) - (0) Volt" RAT_FUNC "%5.3" "Volt" COEFFS 0 1000 -0 0 0 1 /end COMPU_METHOD
/begin COMPU_METHOD SAB_U_VOLT1000_S2_S3 "int = ((phys * 1000) / 1) - (0) V" RAT_FUNC "%5.3" "V" COEFFS 0 1000 -0 0 0 1 /end COMPU_METHOD
/begin COMPU_METHOD SAB_M_NM2_M2047_S2_S3 "int = ((phys * 2) / 1) - (-2047) Nm" RAT_FUNC "%5.3" "Nm" COEFFS 0 2 2047 0 0 1 /end COMPU_METHOD
/begin COMPU_METHOD SAB_I_MA10_S2_S3 "int = ((phys * 10) / 1) - (0) mA" RAT_FUNC "%5.3" "mA" COEFFS 0 10 -0 0 0 1 /end COMPU_METHOD
/begin COMPU_METHOD SAB_FRQ_1HZ_S2_S3 "int = ((phys * 1) / 1) - (0) Hz" RAT_FUNC "%2.0" "Hz" COEFFS 0 1 -0 0 0 1 /end COMPU_METHOD
/begin COMPU_VTAB eReqDispGear_S1_S3 "" TAB_VERB 4 0 "E_st_ReqDispGear_0_DS" 1 "E_st_ReqDispGear_1_D" 2 "E_st_ReqDispGear_2_S" 3 "E_st_ReqDispGear_3_None" /end COMPU_VTAB
/begin COMPU_VTAB eCodingMarket_S1_S3 "" TAB_VERB 2 0 "E_MARKET_DEFAULT" 1 "E_MARKET_CHINA" /end COMPU_VTAB
/begin COMPU_VTAB ePosPRNDNA_S1_S3 "" TAB_VERB 5 0 "E_PRNDNA_P" 1 "E_PRNDNA_R" 2 "E_PRNDNA_N" 3 "E_PRNDNA_D" 4 "E_PRNDNA_NA" /end COMPU_VTAB
/begin COMPU_VTAB ePosPRNDS_S1_S3 "" TAB_VERB 5 0 "E_PRNDS_P" 1 "E_PRNDS_R" 2 "E_PRNDS_N" 3 "E_PRNDS_D" 4 "E_PRNDS_S" /end COMPU_VTAB
/begin COMPU_VTAB eLeverPos_Z1234NA_S1_S3 "" TAB_VERB 5 0 "E_Z1234NA_Z1" 1 "E_Z1234NA_Z2" 2 "E_Z1234NA_Z3" 3 "E_Z1234NA_Z4" 4 "E_Z1234NA_NA" /end COMPU_VTAB
/begin FUNCTION zf_SAB_EEpromZentralHandler "desc_en"
 /begin LOC_MEASUREMENT ZFFSAB._.EEpromZentralHandler.sv_EeUpdateAllCompleted ZFFSAB._.EEpromZentralHandler.sv_f_EeUpdateAll /end LOC_MEASUREMENT
/end FUNCTION
/begin FUNCTION zf_SAB_ComConditionsIn "desc_en"
 /begin LOC_MEASUREMENT ZFFSAB._.ComConditionsIn.Preconditions ZFFSAB._.ComConditionsIn.iv_PreConEWS ZFFSAB._.ComConditionsIn.iv_PreConKL15CanSts /end LOC_MEASUREMENT
/end FUNCTION
/begin FUNCTION zf_SAB_LayerAGS "desc_en"
 /begin LOC_MEASUREMENT ZFFSAB._.LayerAGS.IstGangAGS ZFFSAB._.LayerAGS.SollGangMoeglich ZFFSAB._.LayerAGS.ZielGangAGS ZFFSAB._.LayerAGS.iv_AGS_BetrStratEngStart ZFFSAB._.LayerAGS.iv_AGS_BetrStratEngStartSts ZFFSAB._.LayerAGS.iv_AGS_DispRpmEngCrsh ZFFSAB._.LayerAGS.iv_AGS_EFahrKL ZFFSAB._.LayerAGS.iv_AGS_EFahrKLSts ZFFSAB._.LayerAGS.iv_AGS_EngStartTyp ZFFSAB._.LayerAGS.iv_AGS_EngStartTypSts ZFFSAB._.LayerAGS.iv_AGS_IdxGrbDyn ZFFSAB._.LayerAGS.iv_AGS_K0ZielZustand ZFFSAB._.LayerAGS.iv_AGS_MEm ZFFSAB._.LayerAGS.iv_AGS_MEmSts ZFFSAB._.LayerAGS.iv_AGS_MSA ZFFSAB._.LayerAGS.iv_AGS_RpmDynOut ZFFSAB._.LayerAGS.iv_AGS_RqShpoOstr ZFFSAB._.LayerAGS.iv_AGS_RqShpoOstrSts ZFFSAB._.LayerAGS.iv_AGS_Soc_Mode ZFFSAB._.LayerAGS.iv_AGS_Soc_ModeSts ZFFSAB._.LayerAGS.iv_AGS_StIdc ZFFSAB._.LayerAGS.iv_AGS_StIdcSts ZFFSAB._.LayerAGS.iv_AGS_ZGangSoll ZFFSAB._.LayerAGS.iv_AGS_ZK0Soll ZFFSAB._.LayerAGS.iv_AGS_ZkaIndex ZFFSAB._.LayerAGS.sv_AGS_BetrStratEngStart ZFFSAB._.LayerAGS.sv_AGS_CkbTout ZFFSAB._.LayerAGS.sv_AGS_EFahrKL ZFFSAB._.LayerAGS.sv_AGS_EngStartTyp ZFFSAB._.LayerAGS.sv_AGS_ForceHs ZFFSAB._.LayerAGS.sv_AGS_GangZielAgs ZFFSAB._.LayerAGS.sv_AGS_IstGang ZFFSAB._.LayerAGS.sv_AGS_K0IstZustand ZFFSAB._.LayerAGS.sv_AGS_K0ZielZustand ZFFSAB._.LayerAGS.sv_AGS_MEm ZFFSAB._.LayerAGS.sv_AGS_MTurbine ZFFSAB._.LayerAGS.sv_AGS_Pos ZFFSAB._.LayerAGS.sv_AGS_PosStat ZFFSAB._.LayerAGS.sv_AGS_PtDampgActive ZFFSAB._.LayerAGS.sv_AGS_RpmEngMax ZFFSAB._.LayerAGS.sv_AGS_RqShpoOstr ZFFSAB._.LayerAGS.sv_AGS_ShiftDelay ZFFSAB._.LayerAGS.sv_AGS_Soc_Mode ZFFSAB._.LayerAGS.sv_AGS_SportGetriebe ZFFSAB._.LayerAGS.sv_AGS_StIdc ZFFSAB._.LayerAGS.sv_AGS_VVehPlausi ZFFSAB._.LayerAGS.sv_AGS_ZGangSoll ZFFSAB._.LayerAGS.sv_AGS_ZHasIst ZFFSAB._.LayerAGS.sv_AGS_ZHasZiel ZFFSAB._.LayerAGS.sv_AGS_ZK0Soll ZFFSAB._.LayerAGS.sv_AGS_ZielGang ZFFSAB._.LayerAGS.sv_f_TrailerInfo_AGS /end LOC_MEASUREMENT
/end FUNCTION
/begin FUNCTION zf_SAB_EngineSignalDiagnosis "desc_en" /begin LOC_MEASUREMENT ZFFSAB._.EngineSignalDiagnosis.iv_Status_K0 /end LOC_MEASUREMENT /end FUNCTION
/begin FUNCTION zf_SAB_EngineSpeedRedIn "desc_en"
 /begin LOC_MEASUREMENT ZFFSAB._.EngineSpeedRedIn.iv_n_EngMaxAlw ZFFSAB._.EngineSpeedRedIn.iv_n_EngMaxAlw_ ZFFSAB._.EngineSpeedRedIn.iv_n_EngMaxRed ZFFSAB._.EngineSpeedRedIn.iv_n_EngMaxRedSts ZFFSAB._.EngineSpeedRedIn.iv_n_EngMaxRedSts_ ZFFSAB._.EngineSpeedRedIn.iv_n_EngMaxRed_ ZFFSAB._.EngineSpeedRedIn.sv_n_EngMaxRed ZFFSAB._.EngineSpeedRedIn.sv_n_EngMaxRedSts ZFFSAB._.EngineSpeedRedIn.sv_n_EngRed ZFFSAB._.EngineSpeedRedIn.sv_n_EngRed_ /end LOC_MEASUREMENT
/end FUNCTION
/begin FUNCTION zf_SAB_SensorSupplyMonitoring "desc_en"
 /begin LOC_MEASUREMENT ZFFSAB._.SensorSupplyMonitoring.iv_u_Sens1ESts ZFFSAB._.SensorSupplyMonitoring.iv_u_Sens1ESts_ /end LOC_MEASUREMENT
/end FUNCTION
/begin FUNCTION zf_SAB_AGS_LayerMessages "desc_en"
 /begin LOC_MEASUREMENT ZFFSAB._.AGS_LayerMessages.Nav1Buf[0] ZFFSAB._.AGS_LayerMessages.Nav1Buf[1] ZFFSAB._.AGS_LayerMessages.Nav1Buf[2] ZFFSAB._.AGS_LayerMessages.Nav1Buf[3] ZFFSAB._.AGS_LayerMessages.Nav1Buf[4] ZFFSAB._.AGS_LayerMessages.Nav1Buf[5] ZFFSAB._.AGS_LayerMessages.Nav1Buf[6] ZFFSAB._.AGS_LayerMessages.Nav1Buf[7] ZFFSAB._.AGS_LayerMessages.Nav2Buf[0] ZFFSAB._.AGS_LayerMessages.Nav2Buf[1] ZFFSAB._.AGS_LayerMessages.Nav2Buf[2] ZFFSAB._.AGS_LayerMessages.Nav2Buf[3] ZFFSAB._.AGS_LayerMessages.Nav2Buf[4] ZFFSAB._.AGS_LayerMessages.Nav2Buf[5] ZFFSAB._.AGS_LayerMessages.Nav2Buf[6] ZFFSAB._.AGS_LayerMessages.Nav2Buf[7] ZFFSAB._.AGS_LayerMessages.Nav3Buf[0] ZFFSAB._.AGS_LayerMessages.Nav3Buf[1] ZFFSAB._.AGS_LayerMessages.Nav3Buf[2] ZFFSAB._.AGS_LayerMessages.Nav3Buf[3] ZFFSAB._.AGS_LayerMessages.Nav3Buf[4] ZFFSAB._.AGS_LayerMessages.Nav3Buf[5] ZFFSAB._.AGS_LayerMessages.Nav3Buf[6] ZFFSAB._.AGS_LayerMessages.Nav3Buf[7] ZFFSAB._.AGS_LayerMessages.Nav4Buf[0] ZFFSAB._.AGS_LayerMessages.Nav4Buf[1] ZFFSAB._.AGS_LayerMessages.Nav4Buf[2] ZFFSAB._.AGS_LayerMessages.Nav4Buf[3] ZFFSAB._.AGS_LayerMessages.Nav4Buf[4] ZFFSAB._.AGS_LayerMessages.Nav4Buf[5] ZFFSAB._.AGS_LayerMessages.Nav4Buf[6] ZFFSAB._.AGS_LayerMessages.Nav4Buf[7] ZFFSAB._.AGS_LayerMessages.Nav5Buf[0] ZFFSAB._.AGS_LayerMessages.Nav5Buf[1] ZFFSAB._.AGS_LayerMessages.Nav5Buf[2] ZFFSAB._.AGS_LayerMessages.Nav5Buf[3] ZFFSAB._.AGS_LayerMessages.Nav5Buf[4] ZFFSAB._.AGS_LayerMessages.Nav5Buf[5] ZFFSAB._.AGS_LayerMessages.Nav5Buf[6] ZFFSAB._.AGS_LayerMessages.Nav5Buf[7] ZFFSAB._.AGS_LayerMessages.Nav6Buf[0] ZFFSAB._.AGS_LayerMessages.Nav6Buf[1] ZFFSAB._.AGS_LayerMessages.Nav6Buf[2] ZFFSAB._.AGS_LayerMessages.Nav6Buf[3] ZFFSAB._.AGS_LayerMessages.Nav6Buf[4] ZFFSAB._.AGS_LayerMessages.Nav6Buf[5] ZFFSAB._.AGS_LayerMessages.Nav6Buf[6] ZFFSAB._.AGS_LayerMessages.Nav6Buf[7] ZFFSAB._.AGS_LayerMessages.Nav7Buf[0] ZFFSAB._.AGS_LayerMessages.Nav7Buf[1] ZFFSAB._.AGS_LayerMessages.Nav7Buf[2] ZFFSAB._.AGS_LayerMessages.Nav7Buf[3] ZFFSAB._.AGS_LayerMessages.Nav7Buf[4] ZFFSAB._.AGS_LayerMessages.Nav7Buf[5] ZFFSAB._.AGS_LayerMessages.Nav7Buf[6] ZFFSAB._.AGS_LayerMessages.Nav7Buf[7] ZFFSAB._.AGS_LayerMessages.iv_AGS_Nav2CANSts ZFFSAB._.AGS_LayerMessages.iv_AGS_Nav3CANSts ZFFSAB._.AGS_LayerMessages.iv_AGS_Nav5CANSts ZFFSAB._.AGS_LayerMessages.iv_AGS_Nav7CANSts ZFFSAB._.AGS_LayerMessages.sv_AGS_Nav2Cnt ZFFSAB._.AGS_LayerMessages.sv_AGS_Nav3Sts ZFFSAB._.AGS_LayerMessages.sv_AGS_Nav5Cnt ZFFSAB._.AGS_LayerMessages.sv_AGS_Nav7Sts /end LOC_MEASUREMENT
/end FUNCTION
/begin FUNCTION zf_SAB_BootJump "desc_en" /begin LOC_MEASUREMENT ZFFSAB._.BootJump.reset_allowance /end LOC_MEASUREMENT /end FUNCTION
/begin FUNCTION zf_SAB_ModeEDriveStatusIn "desc_en"
 /begin LOC_MEASUREMENT ZFFSAB._.ModeEDriveStatusIn.iv_AGS_Soc_Mode ZFFSAB._.ModeEDriveStatusIn.iv_AGS_Soc_ModeSts ZFFSAB._.ModeEDriveStatusIn.sv_ModeEDrive ZFFSAB._.ModeEDriveStatusIn.sv_ModeEDriveSts /end LOC_MEASUREMENT
/end FUNCTION
/begin FUNCTION zf_SAB_HandBrakeIn "desc_en"
 /begin LOC_MEASUREMENT ZFFSAB._.HandBrakeIn.f_HandBrakeErr ZFFSAB._.HandBrakeIn.iv_HandBrake ZFFSAB._.HandBrakeIn.iv_HandBrakeSts ZFFSAB._.HandBrakeIn.sv_HandBrakeSts ZFFSAB._.HandBrakeIn.sv_f_HandBrake /end LOC_MEASUREMENT
/end FUNCTION
/begin FUNCTION zf_SAB_EngineIdleIn "desc_en"
 /begin LOC_MEASUREMENT ZFFSAB._.EngineIdleIn.f_EngIdleActiveErr ZFFSAB._.EngineIdleIn.iv_EngIdleActive ZFFSAB._.EngineIdleIn.iv_EngIdleActiveSts ZFFSAB._.EngineIdleIn.sv_EngIdleActive ZFFSAB._.EngineIdleIn.sv_EngIdleActiveSts /end LOC_MEASUREMENT
/end FUNCTION
/begin FUNCTION zf_SAB_EngineStartStopButtonIn "desc_en"
 /begin LOC_MEASUREMENT ZFFSAB._.EngineStartStopButtonIn.f_StartStopButtonErr ZFFSAB._.EngineStartStopButtonIn.iv_StartStopButton ZFFSAB._.EngineStartStopButtonIn.iv_StartStopButtonSts ZFFSAB._.EngineStartStopButtonIn.sv_f_StartStopButton /end LOC_MEASUREMENT
/end FUNCTION
/begin FUNCTION zf_SAB_DrivingStabilitySystemError "desc_en"
 /begin LOC_MEASUREMENT ZFFSAB._.DrivingStabilitySystemError.f_ABSRdy ZFFSAB._.DrivingStabilitySystemError.f_ASCPasRdy ZFFSAB._.DrivingStabilitySystemError.f_ASCRegRdy ZFFSAB._.DrivingStabilitySystemError.iv_ABSReg ZFFSAB._.DrivingStabilitySystemError.iv_ASCPas ZFFSAB._.DrivingStabilitySystemError.iv_ASCReg ZFFSAB._.DrivingStabilitySystemError.sv_f_VehStabnSysErr /end LOC_MEASUREMENT
/end FUNCTION
/begin FUNCTION zf_SAB_ASCRegIn "desc_en"
 /begin LOC_MEASUREMENT ZFFSAB._.ASCRegIn.f_AscRegErr ZFFSAB._.ASCRegIn.iv_ASCReg ZFFSAB._.ASCRegIn.iv_ASCRegSts ZFFSAB._.ASCRegIn.sv_ASCRegSts ZFFSAB._.ASCRegIn.sv_f_ASCReg ZFFSAB._.ASCRegIn.sv_f_AscErr2 /end LOC_MEASUREMENT
/end FUNCTION
/begin FUNCTION zf_SAB_HybridChargingPlugIn "desc_en"
 /begin LOC_MEASUREMENT ZFFSAB._.HybridChargingPlugIn.f_ChargingPlugErr ZFFSAB._.HybridChargingPlugIn.iv_ChargingPlug ZFFSAB._.HybridChargingPlugIn.iv_ChargingPlugSts ZFFSAB._.HybridChargingPlugIn.sv_ChargingPlug ZFFSAB._.HybridChargingPlugIn.sv_ChargingPlugSts /end LOC_MEASUREMENT
/end FUNCTION
/begin FUNCTION zf_SAB_TransportModeIn "desc_en"
 /begin LOC_MEASUREMENT ZFFSAB._.TransportModeIn.iv_TransportMode ZFFSAB._.TransportModeIn.sv_f_TransportMode /end LOC_MEASUREMENT
/end FUNCTION
/begin FUNCTION zf_SAB_CDD_ActuatorOut "desc_en"
 /begin LOC_MEASUREMENT ZFFSAB._.CDD_ActuatorOut.f_ReqDitherOff_old[0] ZFFSAB._.CDD_ActuatorOut.f_ReqDitherOff_old[1] ZFFSAB._.CDD_ActuatorOut.f_ReqDitherOff_old[2] ZFFSAB._.CDD_ActuatorOut.f_ReqDitherOff_old[3] ZFFSAB._.CDD_ActuatorOut.f_ReqDitherOff_old[4] ZFFSAB._.CDD_ActuatorOut.f_ReqDitherOff_old[5] ZFFSAB._.CDD_ActuatorOut.f_ReqDitherOff_old[6] ZFFSAB._.CDD_ActuatorOut.f_ReqDitherOff_old[7] ZFFSAB._.CDD_ActuatorOut.iv_f_ReqDitherOff[0] ZFFSAB._.CDD_ActuatorOut.iv_f_ReqDitherOff[1] ZFFSAB._.CDD_ActuatorOut.iv_f_ReqDitherOff[2] ZFFSAB._.CDD_ActuatorOut.iv_f_ReqDitherOff[3] ZFFSAB._.CDD_ActuatorOut.iv_f_ReqDitherOff[4] ZFFSAB._.CDD_ActuatorOut.iv_f_ReqDitherOff[5] ZFFSAB._.CDD_ActuatorOut.iv_f_ReqDitherOff[6] ZFFSAB._.CDD_ActuatorOut.iv_f_ReqDitherOff[7] ZFFSAB._.CDD_ActuatorOut.loc_cnt_100ms /end LOC_MEASUREMENT
/end FUNCTION
/begin FUNCTION zf_SAB_CDD_RoutineControlFlashProgLIN_IEP "desc_en"
 /begin LOC_MEASUREMENT ZFFSAB._.CDD_RoutineControlFlashProgLIN_IEP.iv_PreConditions ZFFSAB._.CDD_RoutineControlFlashProgLIN_IEP.iv_ProgrammingStateIEP /end LOC_MEASUREMENT
/end FUNCTION
/begin FUNCTION zf_SAB_CDD_GearboxState "desc_en"
 /begin LOC_MEASUREMENT ZFFSAB._.CDD_GearboxState.f_HssOpen ZFFSAB._.CDD_GearboxState.f_LssOpen ZFFSAB._.CDD_GearboxState.iv_Fet0Active ZFFSAB._.CDD_GearboxState.iv_Pos ZFFSAB._.CDD_GearboxState.iv_i_Out0 ZFFSAB._.CDD_GearboxState.iv_i_Out1 ZFFSAB._.CDD_GearboxState.iv_i_Out2 ZFFSAB._.CDD_GearboxState.iv_i_Out3 ZFFSAB._.CDD_GearboxState.iv_i_Out4 ZFFSAB._.CDD_GearboxState.iv_i_Out5 ZFFSAB._.CDD_GearboxState.iv_i_Out6 ZFFSAB._.CDD_GearboxState.iv_i_Out7 ZFFSAB._.CDD_GearboxState.iv_u_BattFilt ZFFSAB._.CDD_GearboxState.sv_StatusLimphome ZFFSAB._.CDD_GearboxState.sv_StatusLimphome_ /end LOC_MEASUREMENT
/end FUNCTION
/begin FUNCTION zf_SAB_CDD_GearboxStateFl "desc_en"
 /begin LOC_MEASUREMENT ZFFSAB._.CDD_GearboxStateFl.StatusLimphomeFl ZFFSAB._.CDD_GearboxStateFl.StatusLimphomeFl_ ZFFSAB._.CDD_GearboxStateFl.f_HssOpenFl ZFFSAB._.CDD_GearboxStateFl.f_LssOpenFl ZFFSAB._.CDD_GearboxStateFl.iv_Fet0ActiveInt ZFFSAB._.CDD_GearboxStateFl.iv_Fet0ActiveInt_ ZFFSAB._.CDD_GearboxStateFl.iv_PosInt ZFFSAB._.CDD_GearboxStateFl.iv_PosInt_ ZFFSAB._.CDD_GearboxStateFl.iv_i_Out0Int ZFFSAB._.CDD_GearboxStateFl.iv_i_Out0Int_ ZFFSAB._.CDD_GearboxStateFl.iv_i_Out1Int ZFFSAB._.CDD_GearboxStateFl.iv_i_Out1Int_ ZFFSAB._.CDD_GearboxStateFl.iv_i_Out2Int ZFFSAB._.CDD_GearboxStateFl.iv_i_Out2Int_ ZFFSAB._.CDD_GearboxStateFl.iv_i_Out3Int ZFFSAB._.CDD_GearboxStateFl.iv_i_Out3Int_ ZFFSAB._.CDD_GearboxStateFl.iv_i_Out4Int ZFFSAB._.CDD_GearboxStateFl.iv_i_Out4Int_ ZFFSAB._.CDD_GearboxStateFl.iv_i_Out5Int ZFFSAB._.CDD_GearboxStateFl.iv_i_Out5Int_ ZFFSAB._.CDD_GearboxStateFl.iv_i_Out6Int ZFFSAB._.CDD_GearboxStateFl.iv_i_Out6Int_ ZFFSAB._.CDD_GearboxStateFl.iv_i_Out7Int ZFFSAB._.CDD_GearboxStateFl.iv_i_Out7Int_ ZFFSAB._.CDD_GearboxStateFl.iv_u_BattFiltInt ZFFSAB._.CDD_GearboxStateFl.loc_iv_Fet0ActiveFl ZFFSAB._.CDD_GearboxStateFl.loc_iv_PosFl ZFFSAB._.CDD_GearboxStateFl.loc_iv_i_Out0Fl ZFFSAB._.CDD_GearboxStateFl.loc_iv_i_Out1Fl ZFFSAB._.CDD_GearboxStateFl.loc_iv_i_Out2Fl ZFFSAB._.CDD_GearboxStateFl.loc_iv_i_Out3Fl ZFFSAB._.CDD_GearboxStateFl.loc_iv_i_Out4Fl ZFFSAB._.CDD_GearboxStateFl.loc_iv_i_Out5Fl ZFFSAB._.CDD_GearboxStateFl.loc_iv_i_Out6Fl ZFFSAB._.CDD_GearboxStateFl.loc_iv_i_Out7Fl ZFFSAB._.CDD_GearboxStateFl.loc_iv_u_BattFiltFl /end LOC_MEASUREMENT
/end FUNCTION
/begin FUNCTION zf_SAB_CDD_PermanentFaultCodes "desc_en"
 /begin LOC_MEASUREMENT ZFFSAB._.CDD_PermanentFaultCodes.iv_mileage ZFFSAB._.CDD_PermanentFaultCodes.loc_return ZFFSAB._.CDD_PermanentFaultCodes.sv_f_OBD_PFC_Activation /end LOC_MEASUREMENT
/end FUNCTION
/begin FUNCTION zf_SAB_PMA_ErrorHandling "desc_en"
 /begin LOC_MEASUREMENT ZFFSAB._.PMA_ErrorHandling.f_PMA_Error ZFFSAB._.PMA_ErrorHandling.f_PMA_TestCondition ZFFSAB._.PMA_ErrorHandling.f_PMA_active_old ZFFSAB._.PMA_ErrorHandling.iv_Brake ZFFSAB._.PMA_ErrorHandling.iv_BrakeSts ZFFSAB._.PMA_ErrorHandling.iv_FASMode ZFFSAB._.PMA_ErrorHandling.iv_FASModeSts ZFFSAB._.PMA_ErrorHandling.iv_FASPos ZFFSAB._.PMA_ErrorHandling.iv_FASPosSts ZFFSAB._.PMA_ErrorHandling.iv_u_Batt_Diag /end LOC_MEASUREMENT
/end FUNCTION
/begin FUNCTION zf_SAB_ABSIn "desc_en"
 /begin LOC_MEASUREMENT ZFFSAB._.ABSIn.f_ABSOff ZFFSAB._.ABSIn.f_ABSOffSts ZFFSAB._.ABSIn.f_ABSOff_ ZFFSAB._.ABSIn.f_ABSRegErr ZFFSAB._.ABSIn.iv_ABSReg ZFFSAB._.ABSIn.iv_ABSRegSts ZFFSAB._.ABSIn.iv_ABSRegSts_ ZFFSAB._.ABSIn.iv_ABSReg_ ZFFSAB._.ABSIn.sv_ABSReg ZFFSAB._.ABSIn.sv_ABSRegSts ZFFSAB._.ABSIn.sv_ABSRegSts_ ZFFSAB._.ABSIn.sv_ABSReg_ /end LOC_MEASUREMENT
/end FUNCTION
/begin FUNCTION zf_SAB_TargetTorqueK0_In "desc_en"
 /begin LOC_MEASUREMENT ZFFSAB._.TargetTorqueK0_In.iv_TargetTorqueK0 ZFFSAB._.TargetTorqueK0_In.iv_TargetTorqueK0Sts ZFFSAB._.TargetTorqueK0_In.sv_TargetTorqueK0 /end LOC_MEASUREMENT
/end FUNCTION
/begin FUNCTION zf_SAB_CrankShaftMaxTorqueEMIn "desc_en"
 /begin LOC_MEASUREMENT ZFFSAB._.CrankShaftMaxTorqueEMIn.iv_Vor_Lang_m_crsh_Max ZFFSAB._.CrankShaftMaxTorqueEMIn.iv_Vor_Lang_m_crsh_MaxSts ZFFSAB._.CrankShaftMaxTorqueEMIn.iv_Vor_Lang_m_crsh_Min ZFFSAB._.CrankShaftMaxTorqueEMIn.iv_Vor_Lang_m_crsh_MinSts ZFFSAB._.CrankShaftMaxTorqueEMIn.sv_Vor_Lang_m_crsh_Max ZFFSAB._.CrankShaftMaxTorqueEMIn.sv_Vor_Lang_m_crsh_Min /end LOC_MEASUREMENT
/end FUNCTION
/begin FUNCTION zf_SAB_CrankRequestOut "desc_en"
 /begin LOC_MEASUREMENT ZFFSAB._.CrankRequestOut.iv_zStartModus ZFFSAB._.CrankRequestOut.sv_zStartModus /end LOC_MEASUREMENT
/end FUNCTION
/begin FUNCTION zf_SAB_DesiredIdleSpeedModeOut "desc_en"
 /begin LOC_MEASUREMENT ZFFSAB._.DesiredIdleSpeedModeOut.iv_IdleSpeedMode ZFFSAB._.DesiredIdleSpeedModeOut.sv_IdleSpeedMode /end LOC_MEASUREMENT
/end FUNCTION
/begin FUNCTION zf_SAB_DesiredBrakeTorqueIn "desc_en"
 /begin LOC_MEASUREMENT ZFFSAB._.DesiredBrakeTorqueIn.f_m_BrakeDvchErr ZFFSAB._.DesiredBrakeTorqueIn.iv_BrakeTorqDvch ZFFSAB._.DesiredBrakeTorqueIn.iv_BrakeTorqDvchSts ZFFSAB._.DesiredBrakeTorqueIn.iv_m_BrakeDvchQF ZFFSAB._.DesiredBrakeTorqueIn.sv_m_BrakeDvch ZFFSAB._.DesiredBrakeTorqueIn.sv_m_BrakeDvch_AGS ZFFSAB._.DesiredBrakeTorqueIn.sv_m_BrakeTorqDvchSts /end LOC_MEASUREMENT
/end FUNCTION
/begin FUNCTION zf_SAB_CDD_LINBusStartStop "desc_en"
 /begin LOC_MEASUREMENT ZFFSAB._.CDD_LINBusStartStop.f_IEPSleepEnable ZFFSAB._.CDD_LINBusStartStop.f_KMN_LINBUSOFF ZFFSAB._.CDD_LINBusStartStop.f_LINBusOffEnable ZFFSAB._.CDD_LINBusStartStop.iv_ChargingPlug ZFFSAB._.CDD_LINBusStartStop.iv_ChargingPlugSts ZFFSAB._.CDD_LINBusStartStop.st_chargingPlug /end LOC_MEASUREMENT
/end FUNCTION
/begin FUNCTION zf_SAB_CDD_ZfData "desc_en" /begin LOC_MEASUREMENT ZFFSAB._.CDD_ZfData.sv_Dummy /end LOC_MEASUREMENT /end FUNCTION
/begin FUNCTION zf_SAB_ChargeConditionIn "desc_en"
 /begin LOC_MEASUREMENT ZFFSAB._.ChargeConditionIn.f_ChargeErr ZFFSAB._.ChargeConditionIn.iv_Charge ZFFSAB._.ChargeConditionIn.iv_ChargeSts ZFFSAB._.ChargeConditionIn.sv_Charge ZFFSAB._.ChargeConditionIn.sv_ChargeSts /end LOC_MEASUREMENT
/end FUNCTION
/begin FUNCTION zf_SAB_HybridOpModeEMIn "desc_en"
 /begin LOC_MEASUREMENT ZFFSAB._.HybridOpModeEMIn.f_DmpEMErr ZFFSAB._.HybridOpModeEMIn.f_ModusEMErr ZFFSAB._.HybridOpModeEMIn.iv_DmpEM ZFFSAB._.HybridOpModeEMIn.iv_DmpEMSts ZFFSAB._.HybridOpModeEMIn.iv_ModusEM ZFFSAB._.HybridOpModeEMIn.iv_ModusEMSts ZFFSAB._.HybridOpModeEMIn.sv_DmpEMSts ZFFSAB._.HybridOpModeEMIn.sv_ModusEM ZFFSAB._.HybridOpModeEMIn.sv_ModusEMSts ZFFSAB._.HybridOpModeEMIn.sv_f_DmpEM /end LOC_MEASUREMENT
/end FUNCTION
/begin FUNCTION zff_SABIN_Applikationsgroessen "all calibration values of signal processing"
 /begin SUB_FUNCTION dData_zf_SAB_EEpromZentralHandler_Fktn dData_zf_SAB_BootJump_Fktn dData_zf_SAB_ExtBrakeInterventionIn_Fktn dData_zf_SAB_CAN_Handling_Fktn dData_zf_SAB_CAN_SwitchingIn_Fktn dData_zf_SAB_Coding_Fktn dData_zf_SAB_ComConditionsIn_Fktn dData_zf_SAB_CrankShaftCurTorqueIn_Fktn dData_zf_SAB_DrivingDirectionIn_Fktn dData_zf_SAB_EmergencyGearInfo_Fktn dData_zf_SAB_EngineCoolantTempIn_Fktn dData_zf_SAB_EngineIdleSpeedReqIn_Fktn dData_zf_SAB_EngineSignalDiagnosis_Fktn dData_zf_SAB_GearLeverDiagnosis_Fktn dData_zf_SAB_GearLimitation_Fktn dData_zf_SAB_HybridSignalsIn_Fktn dData_zf_SAB_InclinationIn_Fktn dData_zf_SAB_OBD_CyclesIn_Fktn dData_zf_SAB_OSModeSwitchingOut_Fktn dData_zf_SAB_PowerdownIn_Fktn dData_zf_SAB_ReadECUIdentification_Fktn dData_zf_SAB_RearAxleRatioIn_Fktn dData_zf_SAB_RollPreventIn_Fktn dData_zf_SAB_RoutineControl_UDS_Fktn dData_zf_SAB_BackToNormalFunctionViaReset_Fktn dData_zf_SAB_BrakePedalIn_Fktn dData_zf_SAB_BrakeTorqueIn_Fktn dData_zf_SAB_DesiredTorqueIn_Fktn dData_zf_SAB_DoorStatusIn_Fktn dData_zf_SAB_DriverSeatStatusIn_Fktn dData_zf_SAB_EngineSpeedIn_Fktn dData_zf_SAB_EngineSpeedRedIn_Fktn dData_zf_SAB_EngineTorqueIn_Fktn dData_zf_SAB_FpDkVpIn_Fktn dData_zf_SAB_GearboxTempIn_Fktn dData_zf_SAB_GearLeverIn_Fktn dData_zf_SAB_GearRatioByCurrents_Fktn dData_zf_SAB_HybridVehicleReadyToDriveIn_Fktn dData_zf_SAB_IgnitionStatusIn_Fktn dData_zf_SAB_MSAIn_Fktn dData_zf_SAB_ParklockSensorIn_Fktn dData_zf_SAB_ParkManeuverAssistant_Fktn dData_zf_SAB_RPM_Diagnosis_Fktn dData_zf_SAB_RPM_SensingIn_Fktn dData_zf_SAB_SensorSupplyMonitoring_Fktn dData_zf_SAB_SpeedPlausibilityIn_Fktn dData_zf_SAB_TempDiagnosis_Fktn dData_zf_SAB_TransmissionOutputSpeedIn_Fktn dData_zf_SAB_TurbineSpeedIn_Fktn dData_zf_SAB_TurbineSpeedVirtualIn_Fktn dData_zf_SAB_VehicleSpeedIn_Fktn dData_zf_SAB_SportButtonIn_Fktn dData_zf_SAB_SubstTempIn_Fktn dData_zf_SAB_TimeEGSOffIn_Fktn dData_zf_SAB_TipTasterIn_Fktn dData_zf_SAB_TorqueReserveIn_Fktn dData_zf_SAB_TurbineTorqueIn_Fktn dData_zf_SAB_VoltageMonitoringOut_Fktn dData_zf_SAB_WheelIn_Fktn dData_zf_SAB_AzgDriver_Fktn dData_zf_SAB_LayerAGS_Fktn dData_zf_SAB_CDD_ActuatorOut_Fktn dData_zf_SAB_CDD_GearboxStateFl_Fktn dData_zf_SAB_CDD_IEP_Control_Fktn dData_zf_SAB_CDD_LINBusStartStop_Fktn dData_zf_SAB_CDD_PermanentFaultCodes_Fktn dData_zf_SAB_CDD_RoutineControlFlashProgLIN_IEP_Fktn dData_zf_SAB_CDD_ZfDataCRC_Fktn dData_zf_SAB_DrivingStabilitySystemError_Fktn dData_zf_SAB_GLI_ErrorHandling_Fktn dData_zf_SAB_PMA_ErrorHandling_Fktn dData_zf_SAB_TransportModeIn_Fktn /end SUB_FUNCTION
/end FUNCTION
/begin FUNCTION dData_zf_SAB_EEpromZentralHandler_Fktn "Calibration values of the Component dData_zf_SAB_EEpromZentralHandler" /begin SUB_FUNCTION jData_zf_SAB_EEpromZentralHandler_Fktn /end SUB_FUNCTION /end FUNCTION
/begin FUNCTION jData_zf_SAB_EEpromZentralHandler_Fktn "Calibration values of the Instance jData_zf_SAB_EEpromZentralHandler" /begin DEF_CHARACTERISTIC D_n_EEPromDataAgs /end DEF_CHARACTERISTIC /end FUNCTION
/begin FUNCTION dData_zf_SAB_BootJump_Fktn "Calibration values of the Component dData_zf_SAB_BootJump" /begin SUB_FUNCTION jData_zf_SAB_BootJump_Fktn /end SUB_FUNCTION /end FUNCTION
/begin FUNCTION jData_zf_SAB_BootJump_Fktn "Calibration values of the Instance jData_zf_SAB_BootJump" /begin DEF_CHARACTERISTIC D_t_IEP_ShutdownDelay /end DEF_CHARACTERISTIC /end FUNCTION
/begin FUNCTION dData_zf_SAB_ExtBrakeInterventionIn_Fktn "Calibration values of the Component dData_zf_SAB_ExtBrakeInterventionIn" /begin SUB_FUNCTION jData_zf_SAB_ExtBrakeInterventionIn_Fktn /end SUB_FUNCTION /end FUNCTION
/begin FUNCTION jData_zf_SAB_ExtBrakeInterventionIn_Fktn "Calibration values of the Instance jData_zf_SAB_ExtBrakeInterventionIn" /begin DEF_CHARACTERISTIC SWI_Brake_Intervention /end DEF_CHARACTERISTIC /end FUNCTION
/begin FUNCTION dData_zf_SAB_CAN_Handling_Fktn "Calibration values of the Component dData_zf_SAB_CAN_Handling" /begin SUB_FUNCTION jData_zf_SAB_CAN_Handling_Fktn /end SUB_FUNCTION /end FUNCTION
/begin FUNCTION jData_zf_SAB_CAN_Handling_Fktn "Calibration values of the Instance jData_zf_SAB_CAN_Handling"
 /begin DEF_CHARACTERISTIC D_CAN1BusBitmask D_CAN2BusBitmask D_CAN_GROUP_FC D_t_CAN1BusDiagDelay D_t_CAN2BusDiagDelay D_t_CANDiagDelay D_u_CanDiagHTh D_u_CanDiagLTh D_u_Diag SWI_CANControlMonitoring SWI_CANDiagDelay SWI_CANLearnID SWI_Calc_CanMsgErrorBitmask_cyclic SWI_ClearLearnedMsgStatus /end DEF_CHARACTERISTIC
/end FUNCTION
/begin FUNCTION dData_zf_SAB_CAN_SwitchingIn_Fktn "Calibration values of the Component dData_zf_SAB_CAN_SwitchingIn" /begin SUB_FUNCTION jData_zf_SAB_CAN_SwitchingIn_Fktn /end SUB_FUNCTION /end FUNCTION
/begin FUNCTION jData_zf_SAB_CAN_SwitchingIn_Fktn "Calibration values of the Instance jData_zf_SAB_CAN_SwitchingIn" /begin DEF_CHARACTERISTIC D_tmr_CAN_Hys SWI_ACAN_FACAN /end DEF_CHARACTERISTIC /end FUNCTION
/begin FUNCTION dData_zf_SAB_Coding_Fktn "Calibration values of the Component dData_zf_SAB_Coding" /begin SUB_FUNCTION jData_zf_SAB_Coding_Fktn /end SUB_FUNCTION /end FUNCTION
/begin FUNCTION jData_zf_SAB_Coding_Fktn "Calibration values of the Instance jData_zf_SAB_Coding"
 /begin DEF_CHARACTERISTIC D_BitmaskNIC D_CodingApp D_CodingElectrical D_CodingVehOrCodingApp D_CodingVehOrCodingElectrical SWI_SwapHighLowByte_Inputs /end DEF_CHARACTERISTIC
/end FUNCTION
/begin FUNCTION dData_zf_SAB_ComConditionsIn_Fktn "Calibration values of the Component dData_zf_SAB_ComConditionsIn" /begin SUB_FUNCTION jData_zf_SAB_ComConditionsIn_Fktn /end SUB_FUNCTION /end FUNCTION
/begin FUNCTION jData_zf_SAB_ComConditionsIn_Fktn "Calibration values of the Instance jData_zf_SAB_ComConditionsIn"
 /begin DEF_CHARACTERISTIC D_n_Ab_PreConTh D_n_Eng_PreConTh D_n_Turbine_PreConTh D_v_Veh_PreConTh SWI_PreConditions /end DEF_CHARACTERISTIC
/end FUNCTION
/begin FUNCTION dData_zf_SAB_CrankShaftCurTorqueIn_Fktn "Calibration values of the Component dData_zf_SAB_CrankShaftCurTorqueIn" /begin SUB_FUNCTION jData_zf_SAB_CrankShaftCurTorqueIn_Fktn /end SUB_FUNCTION /end FUNCTION
/begin FUNCTION jData_zf_SAB_CrankShaftCurTorqueIn_Fktn "Calibration values of the Instance jData_zf_SAB_CrankShaftCurTorqueIn" /begin DEF_CHARACTERISTIC D_m_IstEM1 D_m_IstVM_Default /end DEF_CHARACTERISTIC /end FUNCTION
/begin FUNCTION dData_zf_SAB_DrivingDirectionIn_Fktn "Calibration values of the Component dData_zf_SAB_DrivingDirectionIn" /begin SUB_FUNCTION jData_zf_SAB_DrivingDirectionIn_Fktn /end SUB_FUNCTION /end FUNCTION
/begin FUNCTION jData_zf_SAB_DrivingDirectionIn_Fktn "Calibration values of the Instance jData_zf_SAB_DrivingDirectionIn" /begin DEF_CHARACTERISTIC D_t_HoldDirection SWI_DriveDirByNabOrNwheel /end DEF_CHARACTERISTIC /end FUNCTION
/begin FUNCTION dData_zf_SAB_EmergencyGearInfo_Fktn "Calibration values of the Component dData_zf_SAB_EmergencyGearInfo" /begin SUB_FUNCTION jData_zf_SAB_EmergencyGearInfo_Fktn /end SUB_FUNCTION /end FUNCTION
/begin FUNCTION jData_zf_SAB_EmergencyGearInfo_Fktn "Calibration values of the Instance jData_zf_SAB_EmergencyGearInfo"
 /begin DEF_CHARACTERISTIC D_n_AbUThGearSubst1 D_n_AbUThGearSubst2 D_n_AbUThGearSubst3 D_n_AbUThGearSubst4 D_n_AbUThGearSubst5 D_n_AbUThGearSubst6 D_n_EnTh1 D_n_EnTh2 D_n_EnTh3 D_n_EnTh4 D_n_EnTh5 D_n_EnTh6 D_n_EnUTh D_n_InputSpeed_ENPGxFIXTh D_n_TuTh1 D_n_TuTh2 D_n_TuTh3 D_n_TuTh4 D_n_TuTh5 D_n_TuTh6 D_n_iGangAb_GearSubstC0Hys D_n_iGangAb_GearSubstC0LTh D_n_iGangAb_GearSubstC0Th D_n_iGangAb_GearSubstIEPTh D_n_iGangAb_GearSubstTh D_n_iGangAb_GearSubstUth D_n_iGangAb_LowSpeedTh D_tmr_GearSubst D_tmr_GearSubst1 D_v_ThGearSubst1 D_v_ThGearSubst2 D_v_ThGearSubst3 D_v_ThGearSubst4 D_v_ThGearSubst5 D_v_ThGearSubst6 SWI_UpShiftInhibit SWI_n_AbUThGearSubst1 SWI_n_AbUThGearSubst2 SWI_n_AbUThGearSubst3 SWI_n_AbUThGearSubst4 SWI_n_AbUThGearSubst5 SWI_n_AbUThGearSubst6 SWI_n_EnUTh /end DEF_CHARACTERISTIC
/end FUNCTION
/begin FUNCTION dData_zf_SAB_EngineCoolantTempIn_Fktn "Calibration values of the Component dData_zf_SAB_EngineCoolantTempIn" /begin SUB_FUNCTION jData_zf_SAB_EngineCoolantTempIn_Fktn /end SUB_FUNCTION /end FUNCTION
/begin FUNCTION jData_zf_SAB_EngineCoolantTempIn_Fktn "Calibration values of the Instance jData_zf_SAB_EngineCoolantTempIn" /begin DEF_CHARACTERISTIC D_c_Eng /end DEF_CHARACTERISTIC /end FUNCTION
/begin FUNCTION dData_zf_SAB_EngineIdleSpeedReqIn_Fktn "Calibration values of the Component dData_zf_SAB_EngineIdleSpeedReqIn" /begin SUB_FUNCTION jData_zf_SAB_EngineIdleSpeedReqIn_Fktn /end SUB_FUNCTION /end FUNCTION
/begin FUNCTION jData_zf_SAB_EngineIdleSpeedReqIn_Fktn "Calibration values of the Instance jData_zf_SAB_EngineIdleSpeedReqIn" /begin DEF_CHARACTERISTIC D_n_EngIdleInit D_u_BattLth_NMOFLL SWI_n_EngIdle /end DEF_CHARACTERISTIC /end FUNCTION
/begin FUNCTION dData_zf_SAB_EngineSignalDiagnosis_Fktn "Calibration values of the Component dData_zf_SAB_EngineSignalDiagnosis" /begin SUB_FUNCTION jData_zf_SAB_EngineSignalDiagnosis_Fktn /end SUB_FUNCTION /end FUNCTION
/begin FUNCTION jData_zf_SAB_EngineSignalDiagnosis_Fktn "Calibration values of the Instance jData_zf_SAB_EngineSignalDiagnosis"
 /begin DEF_CHARACTERISTIC D_u_BattLth_ENGSIG SWI_EngMonitor_1ENGSIGTRQ SWI_EngMonitor_2ENGSIGTRQ SWI_UseNEmSignalStatus /end DEF_CHARACTERISTIC
/end FUNCTION
/begin FUNCTION dData_zf_SAB_GearLeverDiagnosis_Fktn "Calibration values of the Component dData_zf_SAB_GearLeverDiagnosis" /begin SUB_FUNCTION jData_zf_SAB_GearLeverDiagnosis_Fktn /end SUB_FUNCTION /end FUNCTION
/begin FUNCTION jData_zf_SAB_GearLeverDiagnosis_Fktn "Calibration values of the Instance jData_zf_SAB_GearLeverDiagnosis" /begin DEF_CHARACTERISTIC D_u_BattLth_PINFO /end DEF_CHARACTERISTIC /end FUNCTION
/begin FUNCTION dData_zf_SAB_GearLimitation_Fktn "Calibration values of the Component dData_zf_SAB_GearLimitation" /begin SUB_FUNCTION jData_zf_SAB_GearLimitation_Fktn /end SUB_FUNCTION /end FUNCTION
/begin FUNCTION jData_zf_SAB_GearLimitation_Fktn "Calibration values of the Instance jData_zf_SAB_GearLimitation"
 /begin DEF_CHARACTERISTIC D_ctl_GearLimit D_n_AbLth D_n_AbUth SWI_GearLimitSubst_H SWI_GearLimitSubst_L /end DEF_CHARACTERISTIC
/end FUNCTION
/begin FUNCTION dData_zf_SAB_HybridSignalsIn_Fktn "Calibration values of the Component dData_zf_SAB_HybridSignalsIn" /begin SUB_FUNCTION jData_zf_SAB_HybridSignalsIn_Fktn /end SUB_FUNCTION /end FUNCTION
/begin FUNCTION jData_zf_SAB_HybridSignalsIn_Fktn "Calibration values of the Instance jData_zf_SAB_HybridSignalsIn" /begin DEF_CHARACTERISTIC D_CrankshaftStopPosition /end DEF_CHARACTERISTIC /end FUNCTION
/begin FUNCTION dData_zf_SAB_InclinationIn_Fktn "Calibration values of the Component dData_zf_SAB_InclinationIn" /begin SUB_FUNCTION jData_zf_SAB_InclinationIn_Fktn /end SUB_FUNCTION /end FUNCTION
/begin FUNCTION jData_zf_SAB_InclinationIn_Fktn "Calibration values of the Instance jData_zf_SAB_InclinationIn" /begin DEF_CHARACTERISTIC SWI_Inclination SWI_InclinationSignalNegated /end DEF_CHARACTERISTIC /end FUNCTION
/begin FUNCTION dData_zf_SAB_OBD_CyclesIn_Fktn "Calibration values of the Component dData_zf_SAB_OBD_CyclesIn" /begin SUB_FUNCTION jData_zf_SAB_OBD_CyclesIn_Fktn /end SUB_FUNCTION /end FUNCTION
/begin FUNCTION jData_zf_SAB_OBD_CyclesIn_Fktn "Calibration values of the Instance jData_zf_SAB_OBD_CyclesIn"
 /begin DEF_CHARACTERISTIC D_u_BattLth_DMEOBD D_u_BattLth_OBDCYCLES SWI_extended_analyse /end DEF_CHARACTERISTIC
/end FUNCTION
/begin FUNCTION dData_zf_SAB_OSModeSwitchingOut_Fktn "Calibration values of the Component dData_zf_SAB_OSModeSwitchingOut" /begin SUB_FUNCTION jData_zf_SAB_OSModeSwitchingOut_Fktn /end SUB_FUNCTION /end FUNCTION
/begin FUNCTION jData_zf_SAB_OSModeSwitchingOut_Fktn "Calibration values of the Instance jData_zf_SAB_OSModeSwitchingOut"
 /begin DEF_CHARACTERISTIC D_n_EngOSModeTh D_n_TuOSModeTh D_u_BattOSModeLth D_u_BattOSModeUth /end DEF_CHARACTERISTIC
/end FUNCTION
/begin FUNCTION dData_zf_SAB_PowerdownIn_Fktn "Calibration values of the Component dData_zf_SAB_PowerdownIn" /begin SUB_FUNCTION jData_zf_SAB_PowerdownIn_Fktn /end SUB_FUNCTION /end FUNCTION
/begin FUNCTION jData_zf_SAB_PowerdownIn_Fktn "Calibration values of the Instance jData_zf_SAB_PowerdownIn" /begin DEF_CHARACTERISTIC D_n_Ab_PowerDownLth D_tmr_PowerDown D_tmr_PowerDown_IEP /end DEF_CHARACTERISTIC /end FUNCTION
/begin FUNCTION dData_zf_SAB_ReadECUIdentification_Fktn "Calibration values of the Component dData_zf_SAB_ReadECUIdentification" /begin SUB_FUNCTION jData_zf_SAB_ReadECUIdentification_Fktn /end SUB_FUNCTION /end FUNCTION
/begin FUNCTION jData_zf_SAB_ReadECUIdentification_Fktn "Calibration values of the Instance jData_zf_SAB_ReadECUIdentification" /begin DEF_CHARACTERISTIC D_DCM_DIAGOBD_IDENT1 D_DCM_DIAGOBD_IDENT2 /end DEF_CHARACTERISTIC /end FUNCTION
/begin FUNCTION dData_zf_SAB_RearAxleRatioIn_Fktn "Calibration values of the Component dData_zf_SAB_RearAxleRatioIn" /begin SUB_FUNCTION jData_zf_SAB_RearAxleRatioIn_Fktn /end SUB_FUNCTION /end FUNCTION
/begin FUNCTION jData_zf_SAB_RearAxleRatioIn_Fktn "Calibration values of the Instance jData_zf_SAB_RearAxleRatioIn"
 /begin DEF_CHARACTERISTIC D_Filt_v_WheelActiveAvgNew D_Filt_v_WheelActiveAvgOld D_IG_HA_Default D_IG_HA_Tab D_k_AbNew_HALearn D_k_AbOld_HALearn D_n_AbDif D_n_AbLearnLth D_n_EngForceLearnRearAxleRatioOn D_t_ForceLearnRearAxleRatio D_tmr_IG_HA_LearnDif D_v_WheelDif SWI_ForceLearnRearAxleRatio SWI_HA_Learn_Reset SWI_IG_HA_Learn s_mmm xha_Wert_Nummax /end DEF_CHARACTERISTIC
/end FUNCTION
/begin FUNCTION dData_zf_SAB_RollPreventIn_Fktn "Calibration values of the Component dData_zf_SAB_RollPreventIn" /begin SUB_FUNCTION jData_zf_SAB_RollPreventIn_Fktn /end SUB_FUNCTION /end FUNCTION
/begin FUNCTION jData_zf_SAB_RollPreventIn_Fktn "Calibration values of the Instance jData_zf_SAB_RollPreventIn" /begin DEF_CHARACTERISTIC D_t_hillholdDelay /end DEF_CHARACTERISTIC /end FUNCTION
/begin FUNCTION dData_zf_SAB_RoutineControl_UDS_Fktn "Calibration values of the Component dData_zf_SAB_RoutineControl_UDS" /begin SUB_FUNCTION jData_zf_SAB_RoutineControl_UDS_Fktn /end SUB_FUNCTION /end FUNCTION
/begin FUNCTION jData_zf_SAB_RoutineControl_UDS_Fktn "Calibration values of the Instance jData_zf_SAB_RoutineControl_UDS"
 /begin DEF_CHARACTERISTIC D_ManualPreAdapService D_MappingAbortPreadaption D_tmr_IEP_Test_LS1 D_tmr_IEP_Test_LS2 D_tmr_IEP_Test_LS3 D_tmr_PreadaptionSOC0x80 SWI_EE_Update_PreConditions SWI_RCControlStoppNRC0x24 /end DEF_CHARACTERISTIC
/end FUNCTION
/begin FUNCTION dData_zf_SAB_BackToNormalFunctionViaReset_Fktn "Calibration values of the Component dData_zf_SAB_BackToNormalFunctionViaReset" /begin SUB_FUNCTION jData_zf_SAB_BackToNormalFunctionViaReset_Fktn /end SUB_FUNCTION /end FUNCTION
/begin FUNCTION jData_zf_SAB_BackToNormalFunctionViaReset_Fktn "Calibration values of the Instance jData_zf_SAB_BackToNormalFunctionViaReset"
 /begin DEF_CHARACTERISTIC D_RzNinCruise_KMN_Hi D_RzNinCruise_KMN_Lo D_TabRzNinCruiseCnt_KFC D_TabRzNinCruise_KFC D_cnt_LimphomeRst D_n_AbRzNinCruise D_t_delay_Limphome D_t_delay_LimphomeCnt /end DEF_CHARACTERISTIC
/end FUNCTION
/begin FUNCTION dData_zf_SAB_BrakePedalIn_Fktn "Calibration values of the Component dData_zf_SAB_BrakePedalIn" /begin SUB_FUNCTION jData_zf_SAB_BrakePedalIn_Fktn /end SUB_FUNCTION /end FUNCTION
/begin FUNCTION jData_zf_SAB_BrakePedalIn_Fktn "Calibration values of the Instance jData_zf_SAB_BrakePedalIn" /begin DEF_CHARACTERISTIC D_p_BrakeTh D_u_BattLth_BRAKEx SWI_Brakelight_BRAKEx /end DEF_CHARACTERISTIC /end FUNCTION
/begin FUNCTION dData_zf_SAB_BrakeTorqueIn_Fktn "Calibration values of the Component dData_zf_SAB_BrakeTorqueIn" /begin SUB_FUNCTION jData_zf_SAB_BrakeTorqueIn_Fktn /end SUB_FUNCTION /end FUNCTION
/begin FUNCTION jData_zf_SAB_BrakeTorqueIn_Fktn "Calibration values of the Instance jData_zf_SAB_BrakeTorqueIn" /begin DEF_CHARACTERISTIC D_k_MtoP SWI_BrakeDiag_BRAKEx /end DEF_CHARACTERISTIC /end FUNCTION
/begin FUNCTION dData_zf_SAB_DesiredTorqueIn_Fktn "Calibration values of the Component dData_zf_SAB_DesiredTorqueIn" /begin SUB_FUNCTION jData_zf_SAB_DesiredTorqueIn_Fktn /end SUB_FUNCTION /end FUNCTION
/begin FUNCTION jData_zf_SAB_DesiredTorqueIn_Fktn "Calibration values of the Instance jData_zf_SAB_DesiredTorqueIn" /begin DEF_CHARACTERISTIC SWI_SmokeCalc /end DEF_CHARACTERISTIC /end FUNCTION
/begin FUNCTION dData_zf_SAB_DoorStatusIn_Fktn "Calibration values of the Component dData_zf_SAB_DoorStatusIn" /begin SUB_FUNCTION jData_zf_SAB_DoorStatusIn_Fktn /end SUB_FUNCTION /end FUNCTION
/begin FUNCTION jData_zf_SAB_DoorStatusIn_Fktn "Calibration values of the Instance jData_zf_SAB_DoorStatusIn" /begin DEF_CHARACTERISTIC D_u_BattLth_DOOR SWI_DoorD /end DEF_CHARACTERISTIC /end FUNCTION
/begin FUNCTION dData_zf_SAB_DriverSeatStatusIn_Fktn "Calibration values of the Component dData_zf_SAB_DriverSeatStatusIn" /begin SUB_FUNCTION jData_zf_SAB_DriverSeatStatusIn_Fktn /end SUB_FUNCTION /end FUNCTION
/begin FUNCTION jData_zf_SAB_DriverSeatStatusIn_Fktn "Calibration values of the Instance jData_zf_SAB_DriverSeatStatusIn" /begin DEF_CHARACTERISTIC D_u_BattLth_SEAT /end DEF_CHARACTERISTIC /end FUNCTION
/begin FUNCTION dData_zf_SAB_EngineSpeedIn_Fktn "Calibration values of the Component dData_zf_SAB_EngineSpeedIn" /begin SUB_FUNCTION jData_zf_SAB_EngineSpeedIn_Fktn /end SUB_FUNCTION /end FUNCTION
/begin FUNCTION jData_zf_SAB_EngineSpeedIn_Fktn "Calibration values of the Instance jData_zf_SAB_EngineSpeedIn"
 /begin DEF_CHARACTERISTIC D_i_C0_SecureClosed D_n_ExtrapolationLimitLth D_n_ExtrapolationLimitUth SWI_CalAbForEMSubVal SWI_LinExtrapolationEngVM /end DEF_CHARACTERISTIC
/end FUNCTION
/begin FUNCTION dData_zf_SAB_EngineSpeedRedIn_Fktn "Calibration values of the Component dData_zf_SAB_EngineSpeedRedIn" /begin SUB_FUNCTION jData_zf_SAB_EngineSpeedRedIn_Fktn /end SUB_FUNCTION /end FUNCTION
/begin FUNCTION jData_zf_SAB_EngineSpeedRedIn_Fktn "Calibration values of the Instance jData_zf_SAB_EngineSpeedRedIn"
 /begin DEF_CHARACTERISTIC D_n_EngRedHigh D_n_EngRedNormal D_n_EngRedShort SWI_n_EngMaxRed /end DEF_CHARACTERISTIC
/end FUNCTION
/begin FUNCTION dData_zf_SAB_EngineTorqueIn_Fktn "Calibration values of the Component dData_zf_SAB_EngineTorqueIn" /begin SUB_FUNCTION jData_zf_SAB_EngineTorqueIn_Fktn /end SUB_FUNCTION /end FUNCTION
/begin FUNCTION jData_zf_SAB_EngineTorqueIn_Fktn "Calibration values of the Instance jData_zf_SAB_EngineTorqueIn" /begin DEF_CHARACTERISTIC SWI_CalcMinMom /end DEF_CHARACTERISTIC /end FUNCTION
/begin FUNCTION dData_zf_SAB_FpDkVpIn_Fktn "Calibration values of the Component dData_zf_SAB_FpDkVpIn" /begin SUB_FUNCTION jData_zf_SAB_FpDkVpIn_Fktn /end SUB_FUNCTION /end FUNCTION
/begin FUNCTION jData_zf_SAB_FpDkVpIn_Fktn "Calibration values of the Instance jData_zf_SAB_FpDkVpIn"
 /begin DEF_CHARACTERISTIC D_ThrottlePosition D_ThrottlePositionVirt D_ThrottlePositionVirt_Raw100 D_ThrottlePosition_Raw100 /end DEF_CHARACTERISTIC
/end FUNCTION
/begin FUNCTION dData_zf_SAB_GearboxTempIn_Fktn "Calibration values of the Component dData_zf_SAB_GearboxTempIn" /begin SUB_FUNCTION jData_zf_SAB_GearboxTempIn_Fktn /end SUB_FUNCTION /end FUNCTION
/begin FUNCTION jData_zf_SAB_GearboxTempIn_Fktn "Calibration values of the Instance jData_zf_SAB_GearboxTempIn"
 /begin DEF_CHARACTERISTIC D_c_ChipOffset D_c_OilTransSubst D_n_EngPlausi_CGTLEV2_CCHIP12LEV2 D_t_Plausi_CGTLEV2_CCHIP12LEV2 SWI_CGT_CCHIP /end DEF_CHARACTERISTIC
/end FUNCTION
/begin FUNCTION dData_zf_SAB_GearLeverIn_Fktn "Calibration values of the Component dData_zf_SAB_GearLeverIn" /begin SUB_FUNCTION jData_zf_SAB_GearLeverIn_Fktn /end SUB_FUNCTION /end FUNCTION
/begin FUNCTION jData_zf_SAB_GearLeverIn_Fktn "Calibration values of the Instance jData_zf_SAB_GearLeverIn"
 /begin DEF_CHARACTERISTIC D_u_BattLth_POSINFO1 D_u_BattLth_POSINFO2 SWI_LeverType SWI_PButtonSignal SWI_SignalSource /end DEF_CHARACTERISTIC
/end FUNCTION
/begin FUNCTION dData_zf_SAB_GearRatioByCurrents_Fktn "Calibration values of the Component dData_zf_SAB_GearRatioByCurrents" /begin SUB_FUNCTION jData_zf_SAB_GearRatioByCurrents_Fktn /end SUB_FUNCTION /end FUNCTION
/begin FUNCTION jData_zf_SAB_GearRatioByCurrents_Fktn "Calibration values of the Instance jData_zf_SAB_GearRatioByCurrents"
 /begin DEF_CHARACTERISTIC D_n6WheelTh D_n6WheelThRtn D_n_AbWheelTh D_n_AbWheelThRtn D_n_Abn6Th D_n_Abn6ThRtn D_n_EngThTuPlausi D_n_EngTolTh D_n_TuTolTh D_t_IAEClose D_t_IAECloseDelay D_t_iGangDiagDelay D_t_nDiagDelay D_t_nTuVirtLev2Delay D_t_nTuVirtPlausiErrDelay SWI_SpdPlausiCompMeth /end DEF_CHARACTERISTIC
/end FUNCTION
/begin FUNCTION dData_zf_SAB_HybridVehicleReadyToDriveIn_Fktn "Calibration values of the Component dData_zf_SAB_HybridVehicleReadyToDriveIn" /begin SUB_FUNCTION jData_zf_SAB_HybridVehicleReadyToDriveIn_Fktn /end SUB_FUNCTION /end FUNCTION
/begin FUNCTION jData_zf_SAB_HybridVehicleReadyToDriveIn_Fktn "Calibration values of the Instance jData_zf_SAB_HybridVehicleReadyToDriveIn" /begin DEF_CHARACTERISTIC D_t_ToStartVM D_t_holdStateVehicleReadyToDrive /end DEF_CHARACTERISTIC /end FUNCTION
/begin FUNCTION dData_zf_SAB_IgnitionStatusIn_Fktn "Calibration values of the Component dData_zf_SAB_IgnitionStatusIn" /begin SUB_FUNCTION jData_zf_SAB_IgnitionStatusIn_Fktn /end SUB_FUNCTION /end FUNCTION
/begin FUNCTION jData_zf_SAB_IgnitionStatusIn_Fktn "Calibration values of the Instance jData_zf_SAB_IgnitionStatusIn"
 /begin DEF_CHARACTERISTIC D_t_IgnDelayPin D_t_IgnFilter D_t_IgnPlausiDelay D_t_IgnPlausiTol D_u_KL15_PinLth SWI_IgnPlausiActive SWI_UseQualifier /end DEF_CHARACTERISTIC
/end FUNCTION
/begin FUNCTION dData_zf_SAB_MSAIn_Fktn "Calibration values of the Component dData_zf_SAB_MSAIn" /begin SUB_FUNCTION jData_zf_SAB_MSAIn_Fktn /end SUB_FUNCTION /end FUNCTION
/begin FUNCTION jData_zf_SAB_MSAIn_Fktn "Calibration values of the Instance jData_zf_SAB_MSAIn" /begin DEF_CHARACTERISTIC SWI_HIS_verbaut /end DEF_CHARACTERISTIC /end FUNCTION
/begin FUNCTION dData_zf_SAB_ParklockSensorIn_Fktn "Calibration values of the Component dData_zf_SAB_ParklockSensorIn" /begin SUB_FUNCTION jData_zf_SAB_ParklockSensorIn_Fktn /end SUB_FUNCTION /end FUNCTION
/begin FUNCTION jData_zf_SAB_ParklockSensorIn_Fktn "Calibration values of the Instance jData_zf_SAB_ParklockSensorIn" /begin DEF_CHARACTERISTIC D_t_PosZMax_PARK SWI_LTog_PARK /end DEF_CHARACTERISTIC /end FUNCTION
/begin FUNCTION dData_zf_SAB_ParkManeuverAssistant_Fktn "Calibration values of the Component dData_zf_SAB_ParkManeuverAssistant" /begin SUB_FUNCTION jData_zf_SAB_ParkManeuverAssistant_Fktn /end SUB_FUNCTION /end FUNCTION
/begin FUNCTION jData_zf_SAB_ParkManeuverAssistant_Fktn "Calibration values of the Instance jData_zf_SAB_ParkManeuverAssistant" /begin DEF_CHARACTERISTIC SWI_PMA_RCP_FunctionActive /end DEF_CHARACTERISTIC /end FUNCTION
/begin FUNCTION dData_zf_SAB_RPM_Diagnosis_Fktn "Calibration values of the Component dData_zf_SAB_RPM_Diagnosis" /begin SUB_FUNCTION jData_zf_SAB_RPM_Diagnosis_Fktn /end SUB_FUNCTION /end FUNCTION
/begin FUNCTION jData_zf_SAB_RPM_Diagnosis_Fktn "Calibration values of the Instance jData_zf_SAB_RPM_Diagnosis"
 /begin DEF_CHARACTERISTIC D_n_AbLth_NWHEELPLAUSILEV2 D_n_AbLth_SENSORLEV2 D_n_EngLth_SENSORLEV2 D_t_delay_1SENSORLEV2 D_t_delay_N6LEV2 D_t_delay_N6PLAUSILEV2 D_t_delay_NTUVIRTLEV2 D_t_delay_SENSORLEV2 D_u_BattLth_NWHEELLEV2 D_u_BattLth_NWHEELPLAUSILEV2 D_u_BattUth_NWHEELLEV2 SWI_n_AbTuPlausi_SENSORLEV2 /end DEF_CHARACTERISTIC
/end FUNCTION
/begin FUNCTION dData_zf_SAB_RPM_SensingIn_Fktn "Calibration values of the Component dData_zf_SAB_RPM_SensingIn" /begin SUB_FUNCTION jData_zf_SAB_RPM_SensingIn_Fktn /end SUB_FUNCTION /end FUNCTION
/begin FUNCTION jData_zf_SAB_RPM_SensingIn_Fktn "Calibration values of the Instance jData_zf_SAB_RPM_SensingIn"
 /begin DEF_CHARACTERISTIC D_NAB_PulseWidthTolBw D_NAB_PulseWidthTolFw D_NAB_PulseWidthTypBw D_NAB_PulseWidthTypFw D_NT_PulseWidthTolBw D_NT_PulseWidthTolFw D_NT_PulseWidthTypBw D_NT_PulseWidthTypFw D_frq_HoldDirection D_n_AbDirection D_n_AbMin D_n_AbNoTeeth D_n_AbOffsetLevel D_n_TuDir D_n_TuMin D_n_TuNoTeeth D_n_TuOffsetLevel D_t_n_AbOffset D_t_n_TuOffset /end DEF_CHARACTERISTIC
/end FUNCTION
/begin FUNCTION dData_zf_SAB_SensorSupplyMonitoring_Fktn "Calibration values of the Component dData_zf_SAB_SensorSupplyMonitoring" /begin SUB_FUNCTION jData_zf_SAB_SensorSupplyMonitoring_Fktn /end SUB_FUNCTION /end FUNCTION
/begin FUNCTION jData_zf_SAB_SensorSupplyMonitoring_Fktn "Calibration values of the Instance jData_zf_SAB_SensorSupplyMonitoring" /begin DEF_CHARACTERISTIC D_t_delay_USENS /end DEF_CHARACTERISTIC /end FUNCTION
/begin FUNCTION dData_zf_SAB_SpeedPlausibilityIn_Fktn "Calibration values of the Component dData_zf_SAB_SpeedPlausibilityIn" /begin SUB_FUNCTION jData_zf_SAB_SpeedPlausibilityIn_Fktn /end SUB_FUNCTION /end FUNCTION
/begin FUNCTION jData_zf_SAB_SpeedPlausibilityIn_Fktn "Calibration values of the Instance jData_zf_SAB_SpeedPlausibilityIn"
 /begin DEF_CHARACTERISTIC D_n_AbDeactLth_VUNPLAUSILEV2 D_n_AbGraThRtn_VUNPLAUSILEV2 D_n_AbGraTh_VUNPLAUSILEV2 D_n_AbGraTh_VUNPLAUSILEV2_pred D_n_AbLth_VUNPLAUSILEV2 D_n_AbLth_VUNPLAUSILEV2_pred D_t_DelayBrake_VUNPLAUSILEV2 D_t_DelayDeactGra_VUNPLAUSILEV2 D_t_DelayGra_VUNPLAUSILEV2 D_t_DelayGra_VUNPLAUSILEV2_pred D_t_DelayTo_VUNPLAUSILEV2 D_t_VUNPLAUSILEV2_pred SWI_ABSOff_VUNPLAUSILEV2 /end DEF_CHARACTERISTIC
/end FUNCTION
/begin FUNCTION dData_zf_SAB_TempDiagnosis_Fktn "Calibration values of the Component dData_zf_SAB_TempDiagnosis" /begin SUB_FUNCTION jData_zf_SAB_TempDiagnosis_Fktn /end SUB_FUNCTION /end FUNCTION
/begin FUNCTION jData_zf_SAB_TempDiagnosis_Fktn "Calibration values of the Instance jData_zf_SAB_TempDiagnosis"
 /begin DEF_CHARACTERISTIC D_c_OilHys_CGTLEV2 D_c_OilMax_CGTLEV2 D_c_Th_CCHIP12LEV2 D_c_TolCheck_CGTLEV2 D_c_TolClose_CGTLEV2 D_c_TolWide_CGTLEV2 D_cdmaxGrad D_t_DiagDelayRtn_CCHIP12LEV2 D_t_DiagDelay_CCHIP12LEV2 D_t_PlausiMaxErrRtn_CGTLEV2 D_t_PlausiMaxErr_CGTLEV2 D_t_TolCheck1_CGTLEV2 D_t_TolCheck2_CGTLEV2 /end DEF_CHARACTERISTIC
/end FUNCTION
/begin FUNCTION dData_zf_SAB_TransmissionOutputSpeedIn_Fktn "Calibration values of the Component dData_zf_SAB_TransmissionOutputSpeedIn" /begin SUB_FUNCTION jData_zf_SAB_TransmissionOutputSpeedIn_Fktn /end SUB_FUNCTION /end FUNCTION
/begin FUNCTION jData_zf_SAB_TransmissionOutputSpeedIn_Fktn "Calibration values of the Instance jData_zf_SAB_TransmissionOutputSpeedIn"
 /begin DEF_CHARACTERISTIC D_k_AbNew_CAN D_k_AbOld_CAN D_n_Init_AbFilt_CAN D_t_DelayNAbMaxCalc D_tmr_Init_n_AbFilt_aktiv SWI_Source_Nab_NWheel SWI_n_AbMaxCalc /end DEF_CHARACTERISTIC
/end FUNCTION
/begin FUNCTION dData_zf_SAB_TurbineSpeedIn_Fktn "Calibration values of the Component dData_zf_SAB_TurbineSpeedIn" /begin SUB_FUNCTION jData_zf_SAB_TurbineSpeedIn_Fktn /end SUB_FUNCTION /end FUNCTION
/begin RECORD_LAYOUT ZF_KW_NAT8_S2_S3 FNC_VALUES 1 UBYTE COLUMN_DIR DIRECT /end RECORD_LAYOUT
/begin RECORD_LAYOUT ZF_KW_NAT16_S2_S3 FNC_VALUES 1 UWORD COLUMN_DIR DIRECT /end RECORD_LAYOUT
/begin RECORD_LAYOUT ZF_KW_NAT32_S2_S3 FNC_VALUES 1 ULONG COLUMN_DIR DIRECT /end RECORD_LAYOUT
/begin RECORD_LAYOUT ZF_KW_INT8_S2_S3 FNC_VALUES 1 SBYTE COLUMN_DIR DIRECT /end RECORD_LAYOUT
/begin RECORD_LAYOUT ZF_TAB_NAT8_S2_S3 FNC_VALUES 2 UBYTE COLUMN_DIR DIRECT NO_AXIS_PTS_X 1 ULONG /end RECORD_LAYOUT
/begin RECORD_LAYOUT ZF_TAB_NAT16_S2_S3 FNC_VALUES 2 UWORD COLUMN_DIR DIRECT NO_AXIS_PTS_X 1 ULONG /end RECORD_LAYOUT
/begin RECORD_LAYOUT ZF_TAB2D_NAT8_S2_S3 FNC_VALUES 3 UBYTE ROW_DIR DIRECT NO_AXIS_PTS_X 1 ULONG NO_AXIS_PTS_Y 2 ULONG /end RECORD_LAYOUT
/begin RECORD_LAYOUT ZF_KL_NAT8_S2_S3 FNC_VALUES 3 UBYTE COLUMN_DIR DIRECT AXIS_PTS_X 2 UBYTE INDEX_INCR DIRECT NO_AXIS_PTS_X 1 ULONG /end RECORD_LAYOUT
/begin RECORD_LAYOUT ZF_KL_NAT16_S2_S3 FNC_VALUES 3 UWORD COLUMN_DIR DIRECT AXIS_PTS_X 2 UWORD INDEX_INCR DIRECT NO_AXIS_PTS_X 1 ULONG /end RECORD_LAYOUT
/end MODULE
/end PROJECT
