ASAP2_VERSION 1 51
/begin PROJECT _929_929 "Gen2_BMW_System_Supplier_Lib"
/begin HEADER "" VERSION "C_03_03" PROJECT_NO _929_929 /end HEADER
/begin MODULE DIM ""
/begin MOD_COMMON "" BYTE_ORDER MSB_FIRST ALIGNMENT_BYTE 1 ALIGNMENT_WORD 2 ALIGNMENT_LONG 4 ALIGNMENT_FLOAT32_IEEE 4 /end MOD_COMMON
/begin CHARACTERISTIC AtfPrfl_qtAtfMin_C "F9306: Minimum quality for undisturbed ATF temperature (no SERAP)" VALUE 0x2019E5 AblGLKWub_S1 8 Q_SIG_S1 0 8 FORMAT "%13.11" /end CHARACTERISTIC
/begin CHARACTERISTIC AtfPrfl_tAtf_C "F9306: ATF temperature profile thresholds (no SERAP)" VAL_BLK 0x2015DA AblGLKWBsw_S1 210 T0_0625_S1 -40 170 NUMBER 11 FORMAT "%8.4" /end CHARACTERISTIC
/begin CHARACTERISTIC ChpPrfl_qtChpMin_C "F9305: Minimum quality for undisturbed chip temperature (no SERAP)" VALUE 0x2019E6 AblGLKWub_S1 8 Q_SIG_S1 0 8 FORMAT "%13.11" /end CHARACTERISTIC
/begin CHARACTERISTIC ChpPrfl_tChp_C "F9305: Chip temperature profile thresholds (no SERAP)" VAL_BLK 0x2015F0 AblGLKWBsw_S1 210 T0_0625_S1 -40 170 NUMBER 11 FORMAT "%8.4" /end CHARACTERISTIC
/begin CHARACTERISTIC SET_UNDERVOLTAGE_TC_C "F9155: set test condition of undervoltage reset faults" VALUE 0x2019DA AblGLKWub_S1 1 B_TRUE_S1 0 1 FORMAT "%13.11" /end CHARACTERISTIC
/begin CHARACTERISTIC SrvShr_FrFltCc08_C "F9140: forced error entry active (Bit0=SG, Bit1=SB)" VAL_BLK 0x2015AE AblGLKWBub_S1 3 X1_S1 0 3 NUMBER 10 FORMAT "%5.3" /end CHARACTERISTIC
/begin CHARACTERISTIC SrvShr_FrFltLss_C "F9140: forced error entry active (Bit0=SG, Bit1=SB)" VAL_BLK 0x2019DC AblGLKWBub_S1 3 X1_S1 0 3 NUMBER 5 FORMAT "%5.3" /end CHARACTERISTIC
/begin CHARACTERISTIC SrvShr_idxSol1_C "F9140: OUT-Channel used as on/off solenoid output (no SERAP)" VALUE 0x2019DB AblGLKWub_S1 255 X1_S1 0 255 FORMAT "%5.1" /end CHARACTERISTIC
/begin CHARACTERISTIC SrvShr_iSol1_C "F9140: current characteristic to control Sol1 by pressure regulator stage (no SERAP)" VAL_BLK 0x2005A0 AblGLKWBuw_S1 2 I0_0001_S1 0 2 NUMBER 6 FORMAT "%8.6" /end CHARACTERISTIC
/begin CHARACTERISTIC SrvShr_swtBypOn_C "F9140: activation switch for bypassing OUT11 (0x5AA5=on) (no SERAP)" VALUE 0x2015AA AblGLKWuw_S1 65535 X1_S1 0 65535 FORMAT "%8.2" /end CHARACTERISTIC
/begin CHARACTERISTIC SrvShr_swtFdbkAdcOut10_C "F9140: Activation of special feedback determination from ADC-result classification (27381=on) (no SERAP)" VALUE 0x2015AC AblGLKWuw_S1 65535 X1_S1 0 65535 FORMAT "%8.2" /end CHARACTERISTIC
/begin CHARACTERISTIC SrvShr_tiFrFlt_C "F9140: Start value to check error entry on PSply after start up" VAL_BLK 0x2015B8 AblGLKWBub_S1 1275 TI1_M_CYCLE_S1 0 1275 NUMBER 2 FORMAT "%5.0" /end CHARACTERISTIC
/begin CHARACTERISTIC SrvShr_tiPSplyOff_C "F2523: Start value of lag counter for power supply while its OFF to ON change" VAL_BLK 0x2015BA AblGLKWBub_S1 150 TI1_M_CYCLE_S1 0 150 NUMBER 2 FORMAT "%5.1" /end CHARACTERISTIC
/begin MEASUREMENT AtfPrfl_ti "F9306: Array for ATF temperature profile, highest index used for disturbed temperatures" ULONG TI1_S1 1 100 0 4294967295 FORMAT "%13.2" ARRAY_SIZE 13 ECU_ADDRESS 0xFFF947E8 /end MEASUREMENT
/begin MEASUREMENT AtfPrfl_tiBuf "F9306: ATF temperature counter intermediate buffer" UWORD TI1_M_S1 1 100 0 65535 FORMAT "%8.2" ECU_ADDRESS 0xFFF94F0A /end MEASUREMENT
/begin MEASUREMENT AtfPrfl_tMax "F9306: Maximum undisturbed temperature seen" SWORD T0_0625_S1 1 100 -40 170 FORMAT "%8.4" ECU_ADDRESS 0xFFF94F0C /end MEASUREMENT
/begin MEASUREMENT ChpPrfl_ti "F9305: Array for chip temperature profile, highest index used for disturbed temperatures" ULONG TI1_S1 1 100 0 4294967295 FORMAT "%13.2" ARRAY_SIZE 13 ECU_ADDRESS 0xFFF9481C /end MEASUREMENT
/begin MEASUREMENT ChpPrfl_tiBuf "F9305: Chip temperature counter intermediate buffer" UWORD TI1_M_S1 1 100 0 65535 FORMAT "%8.2" ECU_ADDRESS 0xFFF94F0E /end MEASUREMENT
/begin MEASUREMENT ChpPrfl_tMax "F9305: Maximum undisturbed temperature seen" SWORD T0_0625_S1 1 100 -40 170 FORMAT "%8.4" ECU_ADDRESS 0xFFF94F10 /end MEASUREMENT
/begin MEASUREMENT GEH_ctStrt "F9200: System startup counter" UWORD X1_S1 1 100 0 65535 FORMAT "%8.2" ECU_ADDRESS 0xFFF80E24 /end MEASUREMENT
/begin MEASUREMENT GEH_sLstExcp "F9200: Last exception information" UBYTE X1_S1 1 100 0 255 FORMAT "%5.1" ECU_ADDRESS 0xFFF80E2B /end MEASUREMENT
/begin MEASUREMENT GEH_sReg_Valid "F9200: Status of exception storage, valid marker" UWORD X1_S1 1 100 0 65535 FORMAT "%8.2" ECU_ADDRESS 0xFFF80E26 /end MEASUREMENT
/begin MEASUREMENT GEH_xRegBuf_Cnt "F9200: Startups since this exception (only last exception entry is updated)" UWORD X1_S1 1 100 0 65535 FORMAT "%8.2" ARRAY_SIZE 10 ECU_ADDRESS 0xFFF80DB8 /end MEASUREMENT
/begin MEASUREMENT GEH_xRegBuf_Ind "F9200: Index for ring buffer" UBYTE X1_S1 1 100 0 255 FORMAT "%5.1" ECU_ADDRESS 0xFFF80E2A /end MEASUREMENT
/begin MEASUREMENT GEH_xRegBuf_Par1 "F9200: 1st parameter passed by the calling function, zero in case of CPU exceptions, ring buffer" ULONG X1_S1 1 100 0 4294967295 FORMAT "%13.2" ARRAY_SIZE 10 ECU_ADDRESS 0xFFF80D2C /end MEASUREMENT
/begin MEASUREMENT GEH_xRegBuf_PC "F9200: Program counter for next command at time of last exceptions, ring buffer" ULONG X1_S1 1 100 0 4294967295 FORMAT "%13.2" ARRAY_SIZE 10 ECU_ADDRESS 0xFFF80D54 /end MEASUREMENT
/begin MEASUREMENT GEH_xRegBuf_SP "F9200: Stack pointer at time of last exceptions, ring buffer" ULONG X1_S1 1 100 0 4294967295 FORMAT "%13.2" ARRAY_SIZE 10 ECU_ADDRESS 0xFFF80D7C /end MEASUREMENT
/begin MEASUREMENT GEH_xRegBuf_Vec "F9200: Vector (subset) of last exceptions, ring buffer" UWORD X1_S1 1 100 0 65535 FORMAT "%8.2" ARRAY_SIZE 10 ECU_ADDRESS 0xFFF80DA4 /end MEASUREMENT
/begin MEASUREMENT GEH_xReg_FPSCR "F9200: FPU status register at time of last exception" ULONG X1_S1 1 100 0 4294967295 FORMAT "%13.2" ECU_ADDRESS 0xFFF80DCC /end MEASUREMENT
/begin MEASUREMENT GEH_xReg_Par1 "F9200: 1st parameter passed by the calling function, zero in case of CPU exceptions" ULONG X1_S1 1 100 0 4294967295 FORMAT "%13.2" ECU_ADDRESS 0xFFF80DE0 /end MEASUREMENT
/begin MEASUREMENT GEH_xReg_PC "F9200: Program counter for next command at time of last exception" ULONG X1_S1 1 100 0 4294967295 FORMAT "%13.2" ECU_ADDRESS 0xFFF80DD0 /end MEASUREMENT
/begin MEASUREMENT GEH_xReg_PR "F9200: Procedure register for next command at time of last exception" ULONG X1_S1 1 100 0 4294967295 FORMAT "%13.2" ECU_ADDRESS 0xFFF80DD4 /end MEASUREMENT
/begin MEASUREMENT GEH_xReg_SP "F9200: Stack pointer at time of last exception" ULONG X1_S1 1 100 0 4294967295 FORMAT "%13.2" ECU_ADDRESS 0xFFF80DD8 /end MEASUREMENT
/begin MEASUREMENT GEH_xReg_SR "F9200: Status register at time of last exception" ULONG X1_S1 1 100 0 4294967295 FORMAT "%13.2" ECU_ADDRESS 0xFFF80DDC /end MEASUREMENT
/begin MEASUREMENT GEH_xReg_Stck "F9200: Stack buffer  at time of last exception" ULONG X1_S1 1 100 0 4294967295 FORMAT "%13.2" ARRAY_SIZE 16 ECU_ADDRESS 0xFFF80DE4 /end MEASUREMENT
/begin MEASUREMENT GEH_xReg_Vec "F9200: Vector (subset) of last exception" UWORD X1_S1 1 100 0 65535 FORMAT "%8.2" ECU_ADDRESS 0xFFF80E28 /end MEASUREMENT
/begin MEASUREMENT GmoRstFaultTypCus "F9155: Customer specific fault type" UBYTE X1_S1 1 100 0 255 FORMAT "%5.1" ECU_ADDRESS 0xFFF80D26 /end MEASUREMENT
/begin MEASUREMENT GmoRstFaultTypCusStrd "F9155: Stored customer specific fault type" UBYTE X1_S1 1 100 0 255 FORMAT "%5.1" ECU_ADDRESS 0xFFF95574 /end MEASUREMENT
/begin MEASUREMENT GmoRst_stFaultCus "F9155: Customer specific fault occurred" UBYTE X1_S1 1 100 0 255 FORMAT "%5.1" ECU_ADDRESS 0xFFF80D27 /end MEASUREMENT
/begin MEASUREMENT LftCnt_ti "F9300: TCU lifetime counter - total" ULONG TI1_S1 1 100 0 4294967295 FORMAT "%13.2" ECU_ADDRESS 0xFFF94850 /end MEASUREMENT
/begin MEASUREMENT LftCnt_tiBuf "F9300: TCU lifetime counter intermediate buffer" UWORD TI1_M_S1 1 100 0 65535 FORMAT "%8.2" ECU_ADDRESS 0xFFF94F12 /end MEASUREMENT
/begin MEASUREMENT LftCnt_ti_Hour "F9300: TCU lifetime counter - hours" UWORD TI1_H_S1 1 100 0 65535 FORMAT "%8.2" ECU_ADDRESS 0xFFF94F14 /end MEASUREMENT
/begin MEASUREMENT LftCnt_ti_Min "F9300: TCU lifetime counter - minutes" UBYTE TI1_MIN_S1 1 100 0 255 FORMAT "%5.1" ECU_ADDRESS 0xFFF955BF /end MEASUREMENT
/begin MEASUREMENT LftCnt_ti_Sec "F9300: TCU lifetime counter - seconds" UBYTE TI1_S1 1 100 0 255 FORMAT "%5.1" ECU_ADDRESS 0xFFF955C0 /end MEASUREMENT
/begin MEASUREMENT ShrGmoHot_stChp2Chp1 "F9156: Status of temperature sensors at time of hot shut down (B01:tChp2,B23:tChp1;00=Ok,01=subst.,10=error)" UBYTE X1_S1 1 100 0 255 FORMAT "%5.1" ECU_ADDRESS 0xFFF95570 /end MEASUREMENT
/begin MEASUREMENT ShrGmoHot_tChp1 "F9156: Chip temperature (CG130) at time of hot shut down" UBYTE T1_OFFS_40_S1 1 100 -40 215 FORMAT "%5.1" ECU_ADDRESS 0xFFF95571 /end MEASUREMENT
/begin MEASUREMENT ShrGmoHot_tChp2 "F9156: Chip temperature (LM71) at time of hot shut down" UBYTE T1_OFFS_40_S1 1 100 -40 215 FORMAT "%5.1" ECU_ADDRESS 0xFFF95572 /end MEASUREMENT
/begin MEASUREMENT ShrGmoHot_tHot "F9156: Temperature threshold at time of hot shut down" UBYTE T1_OFFS_40_S1 1 100 -40 215 FORMAT "%5.1" ECU_ADDRESS 0xFFF95573 /end MEASUREMENT
/begin MEASUREMENT ShrGmoRst_xReg_Par "F9155: Parameter of last exception" ULONG X1_S1 1 100 0 4294967295 FORMAT "%13.2" ECU_ADDRESS 0xFFF94768 /end MEASUREMENT
/begin MEASUREMENT ShrGmoRst_xReg_Vec "F9155: Vector (subset) of last exception" UWORD X1_S1 1 100 0 65535 FORMAT "%8.2" ECU_ADDRESS 0xFFF94E98 /end MEASUREMENT
/begin MEASUREMENT SrvShr_bPSplyDsmRd "F9140: Semaphore flag for Psply error reporting" UBYTE B_TRUE_S1 1 100 0 1 FORMAT "%13.11" ARRAY_SIZE 2 ECU_ADDRESS 0xFFF94E9E /end MEASUREMENT
/begin MEASUREMENT SrvShr_DITHER_FREQ_LOCK "F9140: lock dither frequency switching (0=frequency switching allowed,1=frequency switching locked,others ignored" UBYTE X1_S1 1 100 0 255 FORMAT "%5.1" ECU_ADDRESS 0xFFF9557D /end MEASUREMENT
/begin MEASUREMENT SrvShr_FET_ACTIVE "F9140: status of FET (0:off,1:on,2:int.fault,3:test,4:low batt)" UBYTE X1_S1 1 100 0 255 FORMAT "%5.1" ARRAY_SIZE 2 ECU_ADDRESS 0xFFF84C00 /end MEASUREMENT
/begin MEASUREMENT SrvShr_FET_ACTIVE_KOMP "F9140: status of FET complement (255:off,254:on,253:int.fault,252:test,251:low batt)" UBYTE X1_S1 1 100 0 255 FORMAT "%5.1" ARRAY_SIZE 2 ECU_ADDRESS 0xFFF84C02 /end MEASUREMENT
/begin MEASUREMENT SrvShr_FrFltCc08 "F9140: Forced error entry Cc08 (Bit0:VFS0,...)" UWORD X1_S1 1 100 0 65535 FORMAT "%8.2" ECU_ADDRESS 0xFFF94EA0 /end MEASUREMENT
/begin MEASUREMENT SrvShr_FrFltLss "F9140: Forced error entry Lss (Bit0:LSS0,...)" UWORD X1_S1 1 100 0 65535 FORMAT "%8.2" ECU_ADDRESS 0xFFF94EA2 /end MEASUREMENT
/begin MEASUREMENT SrvShr_FrFltPSply "F9140: Flag for forced error entries on low sides" UBYTE B_TRUE_S1 1 100 0 1 FORMAT "%13.11" ARRAY_SIZE 2 ECU_ADDRESS 0xFFF94EA4 /end MEASUREMENT
/begin MEASUREMENT SrvShr_iOUT "F9140: requested output current" UWORD I0_0001_S1 1 100 0 6.5535 FORMAT "%8.6" ARRAY_SIZE 15 ECU_ADDRESS 0xFFF84C04 /end MEASUREMENT
/begin MEASUREMENT SrvShr_iOUT_KOMP "F9140: requested output current (complement)" UWORD I0_0001_S1 1 100 0 6.5535 FORMAT "%8.6" ARRAY_SIZE 15 ECU_ADDRESS 0xFFF84C22 /end MEASUREMENT
/begin MEASUREMENT SrvShr_OUT0_AKT "F9140: model-based current feedback" UWORD I0_0001_S1 1 100 0 6.5535 FORMAT "%8.6" ECU_ADDRESS 0xFFF94EA6 /end MEASUREMENT
/begin MEASUREMENT SrvShr_OUT0_DI_RDY "F9140: test condition information of VFS current (B0:SG,B1:SB,B2:OP,B5:LOW,B6:HIGH,B4:undef)" UBYTE X1_S1 1 100 0 255 FORMAT "%5.1" ECU_ADDRESS 0xFFF9557E /end MEASUREMENT
/begin MEASUREMENT SrvShr_OUT0_ESTATUS "F9140: diagnosis information of VFS current (B0:SG,B1:SB,B2:OP,B5:LOW,B6:HIGH,B4:undef)" UBYTE X1_S1 1 100 0 255 FORMAT "%5.1" ECU_ADDRESS 0xFFF9557F /end MEASUREMENT
/begin MEASUREMENT SrvShr_OUT10_AKT "F9140: output control state or feedback" UWORD X1_S1 1 100 0 65535 FORMAT "%8.2" ECU_ADDRESS 0xFFF94EA8 /end MEASUREMENT
/begin MEASUREMENT SrvShr_OUT10_DI_OFF "F9140: switch output and diagnosis off for solenoid (1=off, others normal mode)" UBYTE X1_S1 1 100 0 255 FORMAT "%5.1" ECU_ADDRESS 0xFFF96410 /end MEASUREMENT
/begin MEASUREMENT SrvShr_OUT10_DI_OFFCpl "F9140: switch output and diagnosis off for solenoid, complement (254=off, others normal mode)" UBYTE X1_S1 1 100 0 255 FORMAT "%5.1" ECU_ADDRESS 0xFFF96280 /end MEASUREMENT
/begin MEASUREMENT SrvShr_OUT10_DI_RDY "F9140: test condition information of solenoid (B0:SG,B1:SB,B2:OP,B4:undef)" UBYTE X1_S1 1 100 0 255 FORMAT "%5.1" ECU_ADDRESS 0xFFF95580 /end MEASUREMENT
/begin MEASUREMENT SrvShr_OUT10_ESTATUS "F9140: diagnosis information of solenoid (B0:SG,B1:SB,B2:OP,B4:undef)" UBYTE X1_S1 1 100 0 255 FORMAT "%5.1" ECU_ADDRESS 0xFFF95581 /end MEASUREMENT
/begin MEASUREMENT SrvShr_OUT11_AKT "F9140: output control state" UWORD X1_S1 1 100 0 65535 FORMAT "%8.2" ECU_ADDRESS 0xFFF94EAA /end MEASUREMENT
/begin MEASUREMENT SrvShr_OUT11_DI_RDY "F9140: test condition information of solenoid (B0:SG,B1:SB,B2:OP,B4:undef)" UBYTE X1_S1 1 100 0 255 FORMAT "%5.1" ECU_ADDRESS 0xFFF95582 /end MEASUREMENT
/begin MEASUREMENT SrvShr_OUT11_ESTATUS "F9140: diagnosis information of solenoid (B0:SG,B1:SB,B2:OP,B4:undef)" UBYTE X1_S1 1 100 0 255 FORMAT "%5.1" ECU_ADDRESS 0xFFF95583 /end MEASUREMENT
/begin MEASUREMENT SrvShr_OUT12_AKT "F9140: output control state" UWORD X1_S1 1 100 0 65535 FORMAT "%8.2" ECU_ADDRESS 0xFFF94EAC /end MEASUREMENT
/begin MEASUREMENT SrvShr_OUT12_DI_RDY "F9140: test condition information of solenoid (B0:SG,B1:SB,B2:OP,B4:undef)" UBYTE X1_S1 1 100 0 255 FORMAT "%5.1" ECU_ADDRESS 0xFFF95584 /end MEASUREMENT
/begin MEASUREMENT SrvShr_OUT12_ESTATUS "F9140: diagnosis information of solenoid (B0:SG,B1:SB,B2:OP,B4:undef)" UBYTE X1_S1 1 100 0 255 FORMAT "%5.1" ECU_ADDRESS 0xFFF95585 /end MEASUREMENT
/begin MEASUREMENT SrvShr_OUT13_AKT "F9140: output control state" UWORD X1_S1 1 100 0 65535 FORMAT "%8.2" ECU_ADDRESS 0xFFF94EAE /end MEASUREMENT
/begin MEASUREMENT SrvShr_OUT13_DI_OFF "F9140: switch output and diagnosis off for solenoid (1=off, others normal mode)" UBYTE X1_S1 1 100 0 255 FORMAT "%5.1" ECU_ADDRESS 0xFFF96411 /end MEASUREMENT
/begin MEASUREMENT SrvShr_OUT13_DI_OFFCpl "F9140: switch output and diagnosis off for solenoid, complement (254=off, others normal mode)" UBYTE X1_S1 1 100 0 255 FORMAT "%5.1" ECU_ADDRESS 0xFFF96281 /end MEASUREMENT
/begin MEASUREMENT SrvShr_OUT13_DI_RDY "F9140: test condition information of solenoid (B0:SG,B1:SB,B2:OP,B4:undef)" UBYTE X1_S1 1 100 0 255 FORMAT "%5.1" ECU_ADDRESS 0xFFF95586 /end MEASUREMENT
/begin MEASUREMENT SrvShr_OUT13_ESTATUS "F9140: diagnosis information of solenoid (B0:SG,B1:SB,B2:OP,B4:undef)" UBYTE X1_S1 1 100 0 255 FORMAT "%5.1" ECU_ADDRESS 0xFFF95587 /end MEASUREMENT
/begin MEASUREMENT SrvShr_OUT14_AKT "F9140: output control state" UWORD X1_S1 1 100 0 65535 FORMAT "%8.2" ECU_ADDRESS 0xFFF94EB0 /end MEASUREMENT
/begin MEASUREMENT SrvShr_OUT14_DI_RDY "F9140: test condition information of solenoid (B0:SG,B1:SB,B2:OP,B4:undef)" UBYTE X1_S1 1 100 0 255 FORMAT "%5.1" ECU_ADDRESS 0xFFF95588 /end MEASUREMENT
/begin MEASUREMENT SrvShr_OUT14_ESTATUS "F9140: diagnosis information of solenoid (B0:SG,B1:SB,B2:OP,B4:undef)" UBYTE X1_S1 1 100 0 255 FORMAT "%5.1" ECU_ADDRESS 0xFFF95589 /end MEASUREMENT
/begin MEASUREMENT SrvShr_OUT1_AKT "F9140: model-based current feedback" UWORD I0_0001_S1 1 100 0 6.5535 FORMAT "%8.6" ECU_ADDRESS 0xFFF94EB2 /end MEASUREMENT
/begin MEASUREMENT SrvShr_OUT1_DI_RDY "F9140: test condition information of VFS current (B0:SG,B1:SB,B2:OP,B5:LOW,B6:HIGH,B4:undef)" UBYTE X1_S1 1 100 0 255 FORMAT "%5.1" ECU_ADDRESS 0xFFF9558A /end MEASUREMENT
/begin MEASUREMENT SrvShr_OUT1_ESTATUS "F9140: diagnosis information of VFS current (B0:SG,B1:SB,B2:OP,B5:LOW,B6:HIGH,B4:undef)" UBYTE X1_S1 1 100 0 255 FORMAT "%5.1" ECU_ADDRESS 0xFFF9558B /end MEASUREMENT
/begin MEASUREMENT SrvShr_OUT2_AKT "F9140: model-based current feedback" UWORD I0_0001_S1 1 100 0 6.5535 FORMAT "%8.6" ECU_ADDRESS 0xFFF94EB4 /end MEASUREMENT
/begin MEASUREMENT SrvShr_OUT2_DI_RDY "F9140: test condition information of VFS current (B0:SG,B1:SB,B2:OP,B5:LOW,B6:HIGH,B4:undef)" UBYTE X1_S1 1 100 0 255 FORMAT "%5.1" ECU_ADDRESS 0xFFF9558C /end MEASUREMENT
/begin MEASUREMENT SrvShr_OUT2_ESTATUS "F9140: diagnosis information of VFS current (B0:SG,B1:SB,B2:OP,B5:LOW,B6:HIGH,B4:undef)" UBYTE X1_S1 1 100 0 255 FORMAT "%5.1" ECU_ADDRESS 0xFFF9558D /end MEASUREMENT
/begin MEASUREMENT SrvShr_OUT3_AKT "F9140: model-based current feedback" UWORD I0_0001_S1 1 100 0 6.5535 FORMAT "%8.6" ECU_ADDRESS 0xFFF94EB6 /end MEASUREMENT
/begin MEASUREMENT SrvShr_OUT3_DI_RDY "F9140: test condition information of VFS current (B0:SG,B1:SB,B2:OP,B5:LOW,B6:HIGH,B4:undef)" UBYTE X1_S1 1 100 0 255 FORMAT "%5.1" ECU_ADDRESS 0xFFF9558E /end MEASUREMENT
/begin MEASUREMENT SrvShr_OUT3_ESTATUS "F9140: diagnosis information of VFS current (B0:SG,B1:SB,B2:OP,B5:LOW,B6:HIGH,B4:undef)" UBYTE X1_S1 1 100 0 255 FORMAT "%5.1" ECU_ADDRESS 0xFFF9558F /end MEASUREMENT
/begin MEASUREMENT SrvShr_OUT4_AKT "F9140: model-based current feedback" UWORD I0_0001_S1 1 100 0 6.5535 FORMAT "%8.6" ECU_ADDRESS 0xFFF94EB8 /end MEASUREMENT
/begin MEASUREMENT SrvShr_OUT4_DI_RDY "F9140: test condition information of VFS current (B0:SG,B1:SB,B2:OP,B5:LOW,B6:HIGH,B4:undef)" UBYTE X1_S1 1 100 0 255 FORMAT "%5.1" ECU_ADDRESS 0xFFF95590 /end MEASUREMENT
/begin MEASUREMENT SrvShr_OUT4_ESTATUS "F9140: diagnosis information of VFS current (B0:SG,B1:SB,B2:OP,B5:LOW,B6:HIGH,B4:undef)" UBYTE X1_S1 1 100 0 255 FORMAT "%5.1" ECU_ADDRESS 0xFFF95591 /end MEASUREMENT
/begin MEASUREMENT SrvShr_OUT5_AKT "F9140: model-based current feedback" UWORD I0_0001_S1 1 100 0 6.5535 FORMAT "%8.6" ECU_ADDRESS 0xFFF94EBA /end MEASUREMENT
/begin MEASUREMENT SrvShr_OUT5_DI_RDY "F9140: test condition information of VFS current (B0:SG,B1:SB,B2:OP,B5:LOW,B6:HIGH,B4:undef)" UBYTE X1_S1 1 100 0 255 FORMAT "%5.1" ECU_ADDRESS 0xFFF95592 /end MEASUREMENT
/begin MEASUREMENT SrvShr_OUT5_ESTATUS "F9140: diagnosis information of VFS current (B0:SG,B1:SB,B2:OP,B5:LOW,B6:HIGH,B4:undef)" UBYTE X1_S1 1 100 0 255 FORMAT "%5.1" ECU_ADDRESS 0xFFF95593 /end MEASUREMENT
/begin MEASUREMENT SrvShr_OUT6_AKT "F9140: model-based current feedback" UWORD I0_0001_S1 1 100 0 6.5535 FORMAT "%8.6" ECU_ADDRESS 0xFFF94EBC /end MEASUREMENT
/begin MEASUREMENT SrvShr_OUT6_DI_RDY "F9140: test condition information of VFS current (B0:SG,B1:SB,B2:OP,B5:LOW,B6:HIGH,B4:undef)" UBYTE X1_S1 1 100 0 255 FORMAT "%5.1" ECU_ADDRESS 0xFFF95594 /end MEASUREMENT
/begin MEASUREMENT SrvShr_OUT6_ESTATUS "F9140: diagnosis information of VFS current (B0:SG,B1:SB,B2:OP,B5:LOW,B6:HIGH,B4:undef)" UBYTE X1_S1 1 100 0 255 FORMAT "%5.1" ECU_ADDRESS 0xFFF95595 /end MEASUREMENT
/begin MEASUREMENT SrvShr_OUT7_AKT "F9140: model-based current feedback" UWORD I0_0001_S1 1 100 0 6.5535 FORMAT "%8.6" ECU_ADDRESS 0xFFF94EBE /end MEASUREMENT
/begin MEASUREMENT SrvShr_OUT7_DI_RDY "F9140: test condition information of VFS current (B0:SG,B1:SB,B2:OP,B5:LOW,B6:HIGH,B4:undef)" UBYTE X1_S1 1 100 0 255 FORMAT "%5.1" ECU_ADDRESS 0xFFF95596 /end MEASUREMENT
/begin MEASUREMENT SrvShr_OUT7_ESTATUS "F9140: diagnosis information of VFS current (B0:SG,B1:SB,B2:OP,B5:LOW,B6:HIGH,B4:undef)" UBYTE X1_S1 1 100 0 255 FORMAT "%5.1" ECU_ADDRESS 0xFFF95597 /end MEASUREMENT
/begin MEASUREMENT SrvShr_OUT8_AKT "F9140: model-based current feedback" UWORD I0_0001_S1 1 100 0 6.5535 FORMAT "%8.6" ECU_ADDRESS 0xFFF94EC0 /end MEASUREMENT
/begin MEASUREMENT SrvShr_OUT8_DI_RDY "F9140: test condition information of VFS current (B0:SG,B1:SB,B2:OP,B5:LOW,B6:HIGH,B4:undef)" UBYTE X1_S1 1 100 0 255 FORMAT "%5.1" ECU_ADDRESS 0xFFF95598 /end MEASUREMENT
/begin MEASUREMENT SrvShr_OUT8_ESTATUS "F9140: diagnosis information of VFS current (B0:SG,B1:SB,B2:OP,B5:LOW,B6:HIGH,B4:undef)" UBYTE X1_S1 1 100 0 255 FORMAT "%5.1" ECU_ADDRESS 0xFFF95599 /end MEASUREMENT
/begin MEASUREMENT SrvShr_OUT9_AKT "F9140: model-based current feedback" UWORD I0_0001_S1 1 100 0 6.5535 FORMAT "%8.6" ECU_ADDRESS 0xFFF94EC2 /end MEASUREMENT
/begin MEASUREMENT SrvShr_OUT9_DI_RDY "F9140: test condition information of VFS current (B0:SG,B1:SB,B2:OP,B5:LOW,B6:HIGH,B4:undef)" UBYTE X1_S1 1 100 0 255 FORMAT "%5.1" ECU_ADDRESS 0xFFF9559A /end MEASUREMENT
/begin MEASUREMENT SrvShr_OUT9_ESTATUS "F9140: diagnosis information of VFS current (B0:SG,B1:SB,B2:OP,B5:LOW,B6:HIGH,B4:undef)" UBYTE X1_S1 1 100 0 255 FORMAT "%5.1" ECU_ADDRESS 0xFFF9559B /end MEASUREMENT
/begin MEASUREMENT SrvShr_OUT_DITHER_ACTIVE "F9140: dither amplitude control (0=off, 1=by HW supplier, 2=by interface SET_OUT#_DITHER_AMP, others ignored" UBYTE X1_S1 1 100 0 255 FORMAT "%5.1" ARRAY_SIZE 10 ECU_ADDRESS 0xFFF94EC4 /end MEASUREMENT
/begin MEASUREMENT SrvShr_OUT_DITHER_AMP "F9140: dither amplitude" UWORD I0_0001_S1 1 100 0 6.5535 FORMAT "%8.6" ARRAY_SIZE 10 ECU_ADDRESS 0xFFF9477C /end MEASUREMENT
/begin MEASUREMENT SrvShr_stCc08_Fault "F9140: bit coded Cc08 fault status (memorized information)" UWORD X1_S1 1 100 0 65535 FORMAT "%8.2" ARRAY_SIZE 10 ECU_ADDRESS 0xFFF94790 /end MEASUREMENT
/begin MEASUREMENT SrvShr_stCc08_KFA "F9140: fault type reported to DI_FILTER (B0-B3:KFA, B4=OK, B6:direct, B7:KFC2 instead KFC1)" UBYTE X1_S1 1 100 0 255 FORMAT "%5.1" ARRAY_SIZE 10 ECU_ADDRESS 0xFFF94ECE /end MEASUREMENT
/begin MEASUREMENT SrvShr_stCc08_Test "F9140: Cc08 test condition bitmask" UWORD X1_S1 1 100 0 65535 FORMAT "%8.2" ARRAY_SIZE 10 ECU_ADDRESS 0xFFF947A4 /end MEASUREMENT
/begin MEASUREMENT SrvShr_stLss_Fault "F9140: bit coded Lss fault status (memorized information)" UWORD X1_S1 1 100 0 65535 FORMAT "%8.2" ARRAY_SIZE 5 ECU_ADDRESS 0xFFF94ED8 /end MEASUREMENT
/begin MEASUREMENT SrvShr_stLss_KFA "F9140: fault type reported to DI_FILTER (B0-B3:KFA, B4=OK, B6:direct, B7:KFC2 instead KFC1)" UBYTE X1_S1 1 100 0 255 FORMAT "%5.1" ARRAY_SIZE 5 ECU_ADDRESS 0xFFF9559C /end MEASUREMENT
/begin MEASUREMENT SrvShr_stLss_Test "F9140: Lss test condition bitmask" UWORD X1_S1 1 100 0 65535 FORMAT "%8.2" ARRAY_SIZE 5 ECU_ADDRESS 0xFFF94EE2 /end MEASUREMENT
/begin MEASUREMENT SrvShr_stPSply "F9140: requested PSply configuration (0=off,1=on)" UBYTE X1_S1 1 100 0 255 FORMAT "%5.1" ARRAY_SIZE 2 ECU_ADDRESS 0xFFF94EEC /end MEASUREMENT
/begin MEASUREMENT SrvShr_stPSply_Fault "F9140: bit coded PSply fault status (memorized information)" UWORD X1_S1 1 100 0 65535 FORMAT "%8.2" ARRAY_SIZE 2 ECU_ADDRESS 0xFFF947B8 /end MEASUREMENT
/begin MEASUREMENT SrvShr_stPSply_KFA "F9140: fault type reported to DI_FILTER (B0-B3:KFA, B4=OK, B6:direct, B7:KFC2 instead KFC1)" UBYTE X1_S1 1 100 0 255 FORMAT "%5.1" ARRAY_SIZE 2 ECU_ADDRESS 0xFFF94EEE /end MEASUREMENT
/begin MEASUREMENT SrvShr_stPSply_Test "F9140: PSply test condition bitmask" UWORD X1_S1 1 100 0 65535 FORMAT "%8.2" ARRAY_SIZE 2 ECU_ADDRESS 0xFFF947BC /end MEASUREMENT
/begin MEASUREMENT SrvShr_tiFrFlt "F9140: Timer to check error entry on PSply after start up" UBYTE TI1_M_CYCLE_S1 1 100 0 1275 FORMAT "%5.0" ARRAY_SIZE 2 ECU_ADDRESS 0xFFF95CAC /end MEASUREMENT
/begin MEASUREMENT SrvShr_tiPSplyOff "F9140: Lag counter for power supply while its OFF to ON change" UBYTE TI1_M_CYCLE_S1 1 100 0 1275 FORMAT "%5.0" ARRAY_SIZE 2 ECU_ADDRESS 0xFFF95CAE /end MEASUREMENT
/begin MEASUREMENT SrvShr_tiPSplyOffCpl "F9140: Lag counter for power supply while its OFF to ON change (for complement path)" UBYTE TI1_M_CYCLE_S1 1 100 0 1275 FORMAT "%5.0" ARRAY_SIZE 2 ECU_ADDRESS 0xFFF95CB0 /end MEASUREMENT
/begin MEASUREMENT SrvStrtT_ti "F9310: Time stamps of TCU start up" ULONG TI0_001_M_S1 1 100 0 200 FORMAT "%13.9" ARRAY_SIZE 7 ECU_ADDRESS 0xFFF80C64 /end MEASUREMENT
/begin MEASUREMENT SrvUtl_idLibHw_Build "F9260: Component identifier for test only, build version. 4 characters BCD" UWORD X1_S1 1 100 0 65535 FORMAT "%8.2" ECU_ADDRESS 0xFFF84BF2 /end MEASUREMENT
/begin MEASUREMENT SrvUtl_idLibHw_Name "F9260: Component identifier for test only, name. 6 characters ASCII" UBYTE X1_S1 1 100 0 255 FORMAT "%5.1" ARRAY_SIZE 6 ECU_ADDRESS 0xFFF84BEC /end MEASUREMENT
/begin MEASUREMENT GlobalSignals.tmr_P12BadOp.time "test_timer" UBYTE SBW_TIMER_10MS_S1_S3 1 100 0 2550 DISPLAY_IDENTIFIER time.tmr_P12BadOp.GlobalSignals ECU_ADDRESS 0xFFF8A6B8 /end MEASUREMENT
/begin MEASUREMENT GlobalSignals.tmr_P12BadOp.f_IsExpired "test_timer" UBYTE SBW_STANDARD_S1_S3 1 100 0 255 DISPLAY_IDENTIFIER f_IsExpired.tmr_P12BadOp.GlobalSignals ECU_ADDRESS 0xFFF8A6B9 /end MEASUREMENT
/begin MEASUREMENT GlobalSignals.tmr_E_GNER.time "test_timer" UWORD SBW_TIMER_10MS_S1_S3 1 100 0 655350 DISPLAY_IDENTIFIER time.tmr_E_GNER.GlobalSignals ECU_ADDRESS 0xFFF8A6BA /end MEASUREMENT
/begin MEASUREMENT GlobalSignals.tmr_E_GNER.f_IsExpired "test_timer" UBYTE SBW_STANDARD_S1_S3 1 100 0 255 DISPLAY_IDENTIFIER f_IsExpired.tmr_E_GNER.GlobalSignals ECU_ADDRESS 0xFFF8A6BC /end MEASUREMENT
/begin MEASUREMENT GlobalSignals.tmr_E_GNER_Misuse.time "test_timer" UWORD SBW_TIMER_10MS_S1_S3 1 100 0 655350 DISPLAY_IDENTIFIER time.tmr_E_GNER_Misuse.GlobalSignals ECU_ADDRESS 0xFFF8A6BE /end MEASUREMENT
/begin MEASUREMENT GlobalSignals.tmr_E_GNER_Misuse.f_IsExpired "test_timer" UBYTE SBW_STANDARD_S1_S3 1 100 0 255 DISPLAY_IDENTIFIER f_IsExpired.tmr_E_GNER_Misuse.GlobalSignals ECU_ADDRESS 0xFFF8A6C0 /end MEASUREMENT
/begin MEASUREMENT GlobalSignals.tmr_E_GNERPrecond.time "test_timer" UWORD SBW_TIMER_10MS_S1_S3 1 100 0 655350 DISPLAY_IDENTIFIER time.tmr_E_GNERPrecond.GlobalSignals ECU_ADDRESS 0xFFF8A6C2 /end MEASUREMENT
/begin MEASUREMENT GlobalSignals.tmr_E_GNERPrecond.f_IsExpired "test_timer" UBYTE SBW_STANDARD_S1_S3 1 100 0 255 DISPLAY_IDENTIFIER f_IsExpired.tmr_E_GNERPrecond.GlobalSignals ECU_ADDRESS 0xFFF8A6C4 /end MEASUREMENT
/begin MEASUREMENT GlobalSignals.tmr_DebounceOilChipTransErr.time "test_timer" UWORD SBW_TIMER_10MS_S1_S3 1 100 0 655350 DISPLAY_IDENTIFIER time.tmr_DebounceOilChipTransErr.GlobalSignals ECU_ADDRESS 0xFFF8A6C6 /end MEASUREMENT
/begin MEASUREMENT GlobalSignals.tmr_DebounceOilChipTransErr.f_IsExpired "test_timer" UBYTE SBW_STANDARD_S1_S3 1 100 0 255 DISPLAY_IDENTIFIER f_IsExpired.tmr_DebounceOilChipTransErr.GlobalSignals ECU_ADDRESS 0xFFF8A6C8 /end MEASUREMENT
/begin MEASUREMENT GlobalSignals.tmr_FlashN.time "test_timer" UWORD SBW_TIMER_10MS_S1_S3 1 100 0 655350 DISPLAY_IDENTIFIER time.tmr_FlashN.GlobalSignals ECU_ADDRESS 0xFFF8A6CA /end MEASUREMENT
/begin MEASUREMENT GlobalSignals.tmr_FlashN.f_IsExpired "test_timer" UBYTE SBW_STANDARD_S1_S3 1 100 0 255 DISPLAY_IDENTIFIER f_IsExpired.tmr_FlashN.GlobalSignals ECU_ADDRESS 0xFFF8A6CC /end MEASUREMENT
/begin MEASUREMENT GlobalSignals.f_IgnOn "state ignition on/off" UBYTE SBW_STANDARD_S1_S3 1 100 0 1 BIT_MASK 0x1 DISPLAY_IDENTIFIER f_IgnOn.GlobalSignals ECU_ADDRESS 0xFFF8A6CE /end MEASUREMENT
/begin MEASUREMENT GlobalSignals.f_IgnOn_old "previous state ignition on/off" UBYTE SBW_STANDARD_S1_S3 1 100 0 1 BIT_MASK 0x1 DISPLAY_IDENTIFIER f_IgnOn_old.GlobalSignals ECU_ADDRESS 0xFFF8A6CF /end MEASUREMENT
/begin MEASUREMENT GlobalSignals.IgnOnSts "signal status ignition" UBYTE SBW_STANDARD_S1_S3 1 100 0 2 DISPLAY_IDENTIFIER IgnOnSts.GlobalSignals ECU_ADDRESS 0xFFF8A6D0 /end MEASUREMENT
/begin MEASUREMENT GlobalSignals.f_IgnOn_RisingEdg "state ignition becomes on at present" UBYTE SBW_STANDARD_S1_S3 1 100 0 1 BIT_MASK 0x1 DISPLAY_IDENTIFIER f_IgnOn_RisingEdg.GlobalSignals ECU_ADDRESS 0xFFF8A6D1 /end MEASUREMENT
/begin MEASUREMENT GlobalSignals.v_VehSpdMin "mimimum of vram_Aktiv and vfz" UWORD SBW_VKMH_16_S1_S3 1 100 0 21.875 DISPLAY_IDENTIFIER v_VehSpdMin.GlobalSignals ECU_ADDRESS 0xFFF8A6D2 /end MEASUREMENT
/begin MEASUREMENT GlobalSignals.f_ParkLock "flag parking lock" UBYTE SBW_STANDARD_S1_S3 1 100 0 1 BIT_MASK 0x1 DISPLAY_IDENTIFIER f_ParkLock.GlobalSignals ECU_ADDRESS 0xFFF8A6D4 /end MEASUREMENT
/begin MEASUREMENT GlobalSignals.f_MechLimp "flag mech. limphome-mode" UBYTE SBW_STANDARD_S1_S3 1 100 0 1 BIT_MASK 0x1 DISPLAY_IDENTIFIER f_MechLimp.GlobalSignals ECU_ADDRESS 0xFFF8A6D5 /end MEASUREMENT
/begin MEASUREMENT GlobalSignals.f_P12BadOp "Flag for bad operation of P12Button after delay timer" UBYTE SBW_STANDARD_S1_S3 1 100 0 1 BIT_MASK 0x1 DISPLAY_IDENTIFIER f_P12BadOp.GlobalSignals ECU_ADDRESS 0xFFF8A6D6 /end MEASUREMENT
/begin MEASUREMENT GlobalSignals.f_P12BadOpOld "Old value of Flag for bad operation" UBYTE SBW_STANDARD_S1_S3 1 100 0 1 BIT_MASK 0x1 DISPLAY_IDENTIFIER f_P12BadOpOld.GlobalSignals ECU_ADDRESS 0xFFF8A6D7 /end MEASUREMENT
/begin MEASUREMENT GlobalSignals.f_P12BadOpTrig "Triggered flag for bad operation" UBYTE SBW_STANDARD_S1_S3 1 100 0 1 BIT_MASK 0x1 DISPLAY_IDENTIFIER f_P12BadOpTrig.GlobalSignals ECU_ADDRESS 0xFFF8A6D8 /end MEASUREMENT
/begin MEASUREMENT GlobalSignals.f_AcceleratorPedalPressed "Accelerator Pedal is pressed" UBYTE SBW_STANDARD_S1_S3 1 100 0 1 BIT_MASK 0x1 DISPLAY_IDENTIFIER f_AcceleratorPedalPressed.GlobalSignals ECU_ADDRESS 0xFFF8A6D9 /end MEASUREMENT
/begin MEASUREMENT GlobalSignals.f_ResyncNeeded "after communication errors lever must return in middle position / gearbox position to accept new driver request" UBYTE SBW_STANDARD_S1_S3 1 100 0 1 BIT_MASK 0x1 DISPLAY_IDENTIFIER f_ResyncNeeded.GlobalSignals ECU_ADDRESS 0xFFF8A6DA /end MEASUREMENT
/begin MEASUREMENT GlobalSignals.st_Hotmode "Status for Hotmode 0: oil-temp.o.k. 1:over threshold1 2:over thresh.2" UBYTE SBW_STANDARD_S1_S3 1 100 0 2 DISPLAY_IDENTIFIER st_Hotmode.GlobalSignals ECU_ADDRESS 0xFFF8A6DB /end MEASUREMENT
/begin MEASUREMENT GlobalSignals.st_Hotmode_pre "preleminary Status for Hotmode 0: oil-temp.o.k. 1:over threshold1 2:over thresh.2" UBYTE SBW_STANDARD_S1_S3 1 100 0 2 DISPLAY_IDENTIFIER st_Hotmode_pre.GlobalSignals ECU_ADDRESS 0xFFF8A6DC /end MEASUREMENT
/begin MEASUREMENT GlobalSignals.f_HotCondReset "oil chip and converter temperatures are under hotmode threshold1" UBYTE SBW_STANDARD_S1_S3 1 100 0 1 BIT_MASK 0x1 DISPLAY_IDENTIFIER f_HotCondReset.GlobalSignals ECU_ADDRESS 0xFFF8A6DD /end MEASUREMENT
/begin MEASUREMENT GlobalSignals.f_HotCond_1 "oil chip and converter temperatures are above hotmode threshold1" UBYTE SBW_STANDARD_S1_S3 1 100 0 1 BIT_MASK 0x1 DISPLAY_IDENTIFIER f_HotCond_1.GlobalSignals ECU_ADDRESS 0xFFF8A6DE /end MEASUREMENT
/begin MEASUREMENT GlobalSignals.f_HotCond_2 "oil chip and converter temperatures are above hotmode threshold2" UBYTE SBW_STANDARD_S1_S3 1 100 0 1 BIT_MASK 0x1 DISPLAY_IDENTIFIER f_HotCond_2.GlobalSignals ECU_ADDRESS 0xFFF8A6DF /end MEASUREMENT
/begin MEASUREMENT GlobalSignals.f_HotCond_3 "oil chip and converter temperatures are above hotmode threshold3" UBYTE SBW_STANDARD_S1_S3 1 100 0 1 BIT_MASK 0x1 DISPLAY_IDENTIFIER f_HotCond_3.GlobalSignals ECU_ADDRESS 0xFFF8A6E0 /end MEASUREMENT
/begin MEASUREMENT GlobalSignals.st_SpeedCondP "speed condition for driver request P 0:Accept 1:Store 2:Reject" UBYTE SBW_STANDARD_S1_S3 1 100 0 2 DISPLAY_IDENTIFIER st_SpeedCondP.GlobalSignals ECU_ADDRESS 0xFFF8A6E1 /end MEASUREMENT
/begin MEASUREMENT GlobalSignals.st_SpeedCondR "speed condition for driver request P 0:Accept 1:Store 2:Reject" UBYTE SBW_STANDARD_S1_S3 1 100 0 2 DISPLAY_IDENTIFIER st_SpeedCondR.GlobalSignals ECU_ADDRESS 0xFFF8A6E2 /end MEASUREMENT
/begin MEASUREMENT GlobalSignals.st_SpeedCondD "speed condition for driver request P 0:Accept 1:Store 2:Reject" UBYTE SBW_STANDARD_S1_S3 1 100 0 2 DISPLAY_IDENTIFIER st_SpeedCondD.GlobalSignals ECU_ADDRESS 0xFFF8A6E3 /end MEASUREMENT
/begin MEASUREMENT GlobalSignals.st_E_GNER "state of E_GNER state machine" UBYTE SBW_STANDARD_S1_S3 1 100 0 4 DISPLAY_IDENTIFIER st_E_GNER.GlobalSignals ECU_ADDRESS 0xFFF8A6E4 /end MEASUREMENT
/begin MEASUREMENT GlobalSignals.st_E_GNEROld "state of E_GNER state machine during last cycle" UBYTE SBW_STANDARD_S1_S3 1 100 0 4 DISPLAY_IDENTIFIER st_E_GNEROld.GlobalSignals ECU_ADDRESS 0xFFF8A6E5 /end MEASUREMENT
/begin MEASUREMENT GlobalSignals.f_E_GNER_Activation "flag to detect if st_E_GNER is in state 3 (activation)" UBYTE SBW_STANDARD_S1_S3 1 100 0 1 BIT_MASK 0x1 DISPLAY_IDENTIFIER f_E_GNER_Activation.GlobalSignals ECU_ADDRESS 0xFFF8A6E6 /end MEASUREMENT
/begin MEASUREMENT GlobalSignals.f_E_GNER_Active "flag to detect if st_E_GNER is in state 4 (active)" UBYTE SBW_STANDARD_S1_S3 1 100 0 1 BIT_MASK 0x1 DISPLAY_IDENTIFIER f_E_GNER_Active.GlobalSignals ECU_ADDRESS 0xFFF8A6E7 /end MEASUREMENT
/begin MEASUREMENT GlobalSignals.f_E_GNER_Enabled "flag to detect if parklock has been released correctly by eGNER" UBYTE SBW_STANDARD_S1_S3 1 100 0 1 BIT_MASK 0x1 DISPLAY_IDENTIFIER f_E_GNER_Enabled.GlobalSignals ECU_ADDRESS 0xFFF8A6E8 /end MEASUREMENT
/begin MEASUREMENT GlobalSignals.f_EgnerFailedCnt "flag to detect if EgnerFailedCnt has been incremented by failed eGNER" UBYTE SBW_STANDARD_S1_S3 1 100 0 1 BIT_MASK 0x1 DISPLAY_IDENTIFIER f_EgnerFailedCnt.GlobalSignals ECU_ADDRESS 0xFFF8A6E9 /end MEASUREMENT
/begin MEASUREMENT GlobalSignals.f_E_GNER_NoMisuse "flag to detect eGNER misuse" UBYTE SBW_STANDARD_S1_S3 1 100 0 1 BIT_MASK 0x1 DISPLAY_IDENTIFIER f_E_GNER_NoMisuse.GlobalSignals ECU_ADDRESS 0xFFF8A6EA /end MEASUREMENT
/begin MEASUREMENT GlobalSignals.st_IEP_SollEgner "mode states of external oil pump useable for electrical emergency programs" UBYTE SBW_STANDARD_S1_S3 1 100 0 4 DISPLAY_IDENTIFIER st_IEP_SollEgner.GlobalSignals ECU_ADDRESS 0xFFF8A6EB /end MEASUREMENT
/begin MEASUREMENT GlobalSignals.f_EgnerRdy "flag to detect eGNER readyness by PWF" UBYTE SBW_STANDARD_S1_S3 1 100 0 1 BIT_MASK 0x1 DISPLAY_IDENTIFIER f_EgnerRdy.GlobalSignals ECU_ADDRESS 0xFFF8A6EC /end MEASUREMENT
/begin MEASUREMENT GlobalSignals.f_EgnerRdy_Old "flag to detect eGNER readyness of prvoious state by PWF" UBYTE SBW_STANDARD_S1_S3 1 100 0 1 BIT_MASK 0x1 DISPLAY_IDENTIFIER f_EgnerRdy_Old.GlobalSignals ECU_ADDRESS 0xFFF8A6ED /end MEASUREMENT
/begin MEASUREMENT GlobalSignals.f_EgnerRdy_RisingEdge "flag which detects when f_EgnerRdy rises from 0 to 1" UBYTE SBW_STANDARD_S1_S3 1 100 0 1 BIT_MASK 0x1 DISPLAY_IDENTIFIER f_EgnerRdy_RisingEdge.GlobalSignals ECU_ADDRESS 0xFFF8A6EE /end MEASUREMENT
/begin MEASUREMENT GlobalSignals.f_BrakePedalSL "Brake signal with fallback" UBYTE SBW_STANDARD_S1_S3 1 100 0 1 BIT_MASK 0x1 DISPLAY_IDENTIFIER f_BrakePedalSL.GlobalSignals ECU_ADDRESS 0xFFF8A6EF /end MEASUREMENT
/begin MEASUREMENT GlobalSignals.f_PosChangeByDiag "diagnosis position or auto position changes gearbox position" UBYTE SBW_STANDARD_S1_S3 1 100 0 1 BIT_MASK 0x1 DISPLAY_IDENTIFIER f_PosChangeByDiag.GlobalSignals ECU_ADDRESS 0xFFF8A6F0 /end MEASUREMENT
/begin MEASUREMENT GlobalSignals.f_RemoteStart "f_RemoteStartRaw with signal status and KMN_NOREMOTESTART" UBYTE SBW_STANDARD_S1_S3 1 100 0 1 BIT_MASK 0x1 DISPLAY_IDENTIFIER f_RemoteStart.GlobalSignals ECU_ADDRESS 0xFFF8A6F1 /end MEASUREMENT
/begin MEASUREMENT GlobalSignals.f_RemoteStart_SLDisable "permanent deactivation of shiftlock remote start for complete ignition cycle" UBYTE SBW_STANDARD_S1_S3 1 100 0 1 BIT_MASK 0x1 DISPLAY_IDENTIFIER f_RemoteStart_SLDisable.GlobalSignals ECU_ADDRESS 0xFFF8A6F2 /end MEASUREMENT
/begin MEASUREMENT CyclePos10msIn20ms.cnt_Position "for example 10/-ms=1 10/20ms=2 if reset at end in 20msCycle" UBYTE SBW_STANDARD_S1_S3 1 100 0 255 DISPLAY_IDENTIFIER cnt_Position.CyclePos10msIn20ms ECU_ADDRESS 0xFFF8A293 /end MEASUREMENT
/begin MEASUREMENT EngineSignals.tmr_DebounceGearboxReady.time "test_timer" UBYTE SBW_TIMER_10MS_S1_S3 1 100 0 2550 DISPLAY_IDENTIFIER time.tmr_DebounceGearboxReady.EngineSignals ECU_ADDRESS 0xFFF8A6F4 /end MEASUREMENT
/begin MEASUREMENT EngineSignals.tmr_DebounceGearboxReady.f_IsExpired "test_timer" UBYTE SBW_STANDARD_S1_S3 1 100 0 255 DISPLAY_IDENTIFIER f_IsExpired.tmr_DebounceGearboxReady.EngineSignals ECU_ADDRESS 0xFFF8A6F5 /end MEASUREMENT
/begin MEASUREMENT EngineSignals.tmr_DebounceGearboxReadySts.time "test_timer" UBYTE SBW_TIMER_10MS_S1_S3 1 100 0 2550 DISPLAY_IDENTIFIER time.tmr_DebounceGearboxReadySts.EngineSignals ECU_ADDRESS 0xFFF8A6F6 /end MEASUREMENT
/begin MEASUREMENT EngineSignals.tmr_DebounceGearboxReadySts.f_IsExpired "test_timer" UBYTE SBW_STANDARD_S1_S3 1 100 0 255 DISPLAY_IDENTIFIER f_IsExpired.tmr_DebounceGearboxReadySts.EngineSignals ECU_ADDRESS 0xFFF8A6F7 /end MEASUREMENT
/begin MEASUREMENT EngineSignals.st_EngOn "status engine on for SBW [shift by wire] 0=off 1=on 2=standby 3=starter running" UBYTE SBW_STANDARD_S1_S3 1 100 0 3 DISPLAY_IDENTIFIER st_EngOn.EngineSignals ECU_ADDRESS 0xFFF8A6F8 /end MEASUREMENT
/begin MEASUREMENT EngineSignals.st_EngOn_Old "status engine on for SBW from last cycle 0=off 1=on 2=standby 3=starter running" UBYTE SBW_STANDARD_S1_S3 1 100 0 3 DISPLAY_IDENTIFIER st_EngOn_Old.EngineSignals ECU_ADDRESS 0xFFF8A6F9 /end MEASUREMENT
/begin MEASUREMENT EngineSignals.n_EngSubSts "state of signal n_EngSub" UBYTE SBW_STANDARD_S1_S3 1 100 0 255 DISPLAY_IDENTIFIER n_EngSubSts.EngineSignals ECU_ADDRESS 0xFFF8A6FA /end MEASUREMENT
/begin MEASUREMENT EngineSignals.n_EngSub "engine rev.s subst value" UWORD SBW_STANDARD_S1_S3 1 100 0 65535 DISPLAY_IDENTIFIER n_EngSub.EngineSignals ECU_ADDRESS 0xFFF8A6FC /end MEASUREMENT
/begin MEASUREMENT EngineSignals.f_GearboxReady_Old "gearbox ready for SBW from last cycle 0=off 1=on" UBYTE SBW_STANDARD_S1_S3 1 100 0 1 BIT_MASK 0x1 DISPLAY_IDENTIFIER f_GearboxReady_Old.EngineSignals ECU_ADDRESS 0xFFF8A6FE /end MEASUREMENT
/begin MEASUREMENT EngineSignals.f_GearboxReadySts_Old "gearbox status ready for SBW from last cycle 0=off 1=on" UBYTE SBW_STANDARD_S1_S3 1 100 0 1 BIT_MASK 0x1 DISPLAY_IDENTIFIER f_GearboxReadySts_Old.EngineSignals ECU_ADDRESS 0xFFF8A6FF /end MEASUREMENT
/begin MEASUREMENT EngineSignals.f_GearboxDrvRdy "flag signalling gearbox readiness" UBYTE SBW_STANDARD_S1_S3 1 100 0 1 BIT_MASK 0x1 DISPLAY_IDENTIFIER f_GearboxDrvRdy.EngineSignals ECU_ADDRESS 0xFFF8A700 /end MEASUREMENT
/begin MEASUREMENT EngineSignals.f_EngOn "flag engine on for SBW [shift by wire]" UBYTE SBW_STANDARD_S1_S3 1 100 0 1 BIT_MASK 0x1 DISPLAY_IDENTIFIER f_EngOn.EngineSignals ECU_ADDRESS 0xFFF8A701 /end MEASUREMENT
/begin MEASUREMENT EngineSignals.f_Starter_IEP "state starter on/off by IEP" UBYTE SBW_STANDARD_S1_S3 1 100 0 1 BIT_MASK 0x1 DISPLAY_IDENTIFIER f_Starter_IEP.EngineSignals ECU_ADDRESS 0xFFF8A702 /end MEASUREMENT
/begin MEASUREMENT PAKConfig.PAKConfig_TEST "Only a TestValue" UBYTE SBW_STANDARD_S1_S3 1 100 1 7 DISPLAY_IDENTIFIER PAKConfig_TEST.PAKConfig ECU_ADDRESS 0xFFF8A294 /end MEASUREMENT
/begin MEASUREMENT DrvPresenceDetector.tmr_DrvLeavesCarInN.time "test_timer" UWORD SBW_TIMER_10MS_S1_S3 1 100 0 655350 DISPLAY_IDENTIFIER time.tmr_DrvLeavesCarInN.DrvPresenceDetector ECU_ADDRESS 0xFFF8A704 /end MEASUREMENT
/begin MEASUREMENT DrvPresenceDetector.tmr_DrvLeavesCarInN.f_IsExpired "test_timer" UBYTE SBW_STANDARD_S1_S3 1 100 0 255 DISPLAY_IDENTIFIER f_IsExpired.tmr_DrvLeavesCarInN.DrvPresenceDetector ECU_ADDRESS 0xFFF8A706 /end MEASUREMENT
/begin MEASUREMENT DrvPresenceDetector.f_CC_DrvLeavesCar "Flag for CC message Driver leaves Car" UBYTE SBW_STANDARD_S1_S3 1 100 0 1 BIT_MASK 0x1 DISPLAY_IDENTIFIER f_CC_DrvLeavesCar.DrvPresenceDetector ECU_ADDRESS 0xFFF8A708 /end MEASUREMENT
/begin MEASUREMENT DrvPresenceDetector.f_DrvLeavesCarDoorSeatb "Flag for combined Door Seatbelt status" UBYTE SBW_STANDARD_S1_S3 1 100 0 1 BIT_MASK 0x1 DISPLAY_IDENTIFIER f_DrvLeavesCarDoorSeatb.DrvPresenceDetector ECU_ADDRESS 0xFFF8A709 /end MEASUREMENT
/begin MEASUREMENT DrvPresenceDetector.f_DrvLeavesCarBrakeAccPed "Flag for combined Door Seatbelt status" UBYTE SBW_STANDARD_S1_S3 1 100 0 1 BIT_MASK 0x1 DISPLAY_IDENTIFIER f_DrvLeavesCarBrakeAccPed.DrvPresenceDetector ECU_ADDRESS 0xFFF8A70A /end MEASUREMENT
/begin MEASUREMENT DrvPresenceDetector.f_DrvLeavesCar "Indicates that the driver leaves the car" UBYTE SBW_STANDARD_S1_S3 1 100 0 1 BIT_MASK 0x1 DISPLAY_IDENTIFIER f_DrvLeavesCar.DrvPresenceDetector ECU_ADDRESS 0xFFF8A70B /end MEASUREMENT
/begin MEASUREMENT DrvPresenceDetector.f_CC_DrvLeavesCarBeltLocked "Flag: Driver leaves car with seat belt locked" UBYTE SBW_STANDARD_S1_S3 1 100 0 1 BIT_MASK 0x1 DISPLAY_IDENTIFIER f_CC_DrvLeavesCarBeltLocked.DrvPresenceDetector ECU_ADDRESS 0xFFF8A70C /end MEASUREMENT
/begin MEASUREMENT DrvPresenceDetector.f_DrvLeavesCarInN "Flag: debounced flag info for driver leaves car in pos. N" UBYTE SBW_STANDARD_S1_S3 1 100 0 1 BIT_MASK 0x1 DISPLAY_IDENTIFIER f_DrvLeavesCarInN.DrvPresenceDetector ECU_ADDRESS 0xFFF8A70D /end MEASUREMENT
/begin MEASUREMENT DrvPresenceDetector.st_tmr_DrvLeavesCarInN "state of tmr_DrvLeavesCarInN - 0x10=initial - 0x02=set_startvalue - 0x01=running - 0x00=elapsed" UBYTE SBW_STANDARD_S1_S3 1 100 0 16 DISPLAY_IDENTIFIER st_tmr_DrvLeavesCarInN.DrvPresenceDetector ECU_ADDRESS 0xFFF8A70E /end MEASUREMENT
/begin MEASUREMENT DrvPresenceDetector.st_DriverPresence "Driver presence status" UBYTE SBW_STANDARD_S1_S3 1 100 0 2 DISPLAY_IDENTIFIER st_DriverPresence.DrvPresenceDetector ECU_ADDRESS 0xFFF8A70F /end MEASUREMENT
/begin MEASUREMENT SignalConditioning.tmr_DiagSysPressureHIS.time "test_timer" UWORD SBW_TIMER_10MS_S1_S3 1 100 0 655350 DISPLAY_IDENTIFIER time.tmr_DiagSysPressureHIS.SignalConditioning ECU_ADDRESS 0xFFF89FCE /end MEASUREMENT
/begin MEASUREMENT SignalConditioning.tmr_DiagSysPressureHIS.f_IsExpired "test_timer" UBYTE SBW_STANDARD_S1_S3 1 100 0 255 DISPLAY_IDENTIFIER f_IsExpired.tmr_DiagSysPressureHIS.SignalConditioning ECU_ADDRESS 0xFFF89FD0 /end MEASUREMENT
/begin MEASUREMENT SignalConditioning.tmr_DiagSysPressureEng.time "test_timer" UWORD SBW_TIMER_10MS_S1_S3 1 100 0 655350 DISPLAY_IDENTIFIER time.tmr_DiagSysPressureEng.SignalConditioning ECU_ADDRESS 0xFFF89FD2 /end MEASUREMENT
/begin MEASUREMENT SignalConditioning.tmr_DiagSysPressureEng.f_IsExpired "test_timer" UBYTE SBW_STANDARD_S1_S3 1 100 0 255 DISPLAY_IDENTIFIER f_IsExpired.tmr_DiagSysPressureEng.SignalConditioning ECU_ADDRESS 0xFFF89FD4 /end MEASUREMENT
/begin MEASUREMENT SignalConditioning.tmr_DiagSysPressureEngStart.time "test_timer" UWORD SBW_TIMER_10MS_S1_S3 1 100 0 655350 DISPLAY_IDENTIFIER time.tmr_DiagSysPressureEngStart.SignalConditioning ECU_ADDRESS 0xFFF89FD6 /end MEASUREMENT
/begin MEASUREMENT SignalConditioning.tmr_DiagSysPressureEngStart.f_IsExpired "test_timer" UBYTE SBW_STANDARD_S1_S3 1 100 0 255 DISPLAY_IDENTIFIER f_IsExpired.tmr_DiagSysPressureEngStart.SignalConditioning ECU_ADDRESS 0xFFF89FD8 /end MEASUREMENT
/begin MEASUREMENT SignalConditioning.tmr_PEngaged.time "test_timer" UWORD SBW_TIMER_10MS_S1_S3 1 100 0 655350 DISPLAY_IDENTIFIER time.tmr_PEngaged.SignalConditioning ECU_ADDRESS 0xFFF89FDA /end MEASUREMENT
/begin MEASUREMENT SignalConditioning.tmr_PEngaged.f_IsExpired "test_timer" UBYTE SBW_STANDARD_S1_S3 1 100 0 255 DISPLAY_IDENTIFIER f_IsExpired.tmr_PEngaged.SignalConditioning ECU_ADDRESS 0xFFF89FDC /end MEASUREMENT
/begin MEASUREMENT SignalConditioning.tmr_PEngagedAfterEngStart.time "test_timer" UWORD SBW_TIMER_10MS_S1_S3 1 100 0 655350 DISPLAY_IDENTIFIER time.tmr_PEngagedAfterEngStart.SignalConditioning ECU_ADDRESS 0xFFF89FDE /end MEASUREMENT
/begin MEASUREMENT SignalConditioning.tmr_PEngagedAfterEngStart.f_IsExpired "test_timer" UBYTE SBW_STANDARD_S1_S3 1 100 0 255 DISPLAY_IDENTIFIER f_IsExpired.tmr_PEngagedAfterEngStart.SignalConditioning ECU_ADDRESS 0xFFF89FE0 /end MEASUREMENT
/begin MEASUREMENT SignalConditioning.f_cc_PSAbuse "flag signaling mech.parklock-abuse conditions" UBYTE SBW_STANDARD_S1_S3 1 100 0 1 BIT_MASK 0x1 DISPLAY_IDENTIFIER f_cc_PSAbuse.SignalConditioning ECU_ADDRESS 0xFFF89FE2 /end MEASUREMENT
/begin MEASUREMENT SignalConditioning.f_PSEnableCondition "flag signaling PS enable conditions" UBYTE SBW_STANDARD_S1_S3 1 100 0 1 BIT_MASK 0x1 DISPLAY_IDENTIFIER f_PSEnableCondition.SignalConditioning ECU_ADDRESS 0xFFF89FE3 /end MEASUREMENT
/begin MEASUREMENT TipSignals.st_TipMinus1Old "old value of st_TipMinus1" UBYTE SBW_STANDARD_S1_S3 1 100 0 2 DISPLAY_IDENTIFIER st_TipMinus1Old.TipSignals ECU_ADDRESS 0xFFF8A710 /end MEASUREMENT
/begin MEASUREMENT TipSignals.st_TipMinus1Trig "tip minus event from shift lever 0=noTip 1=singleTip 2=doubleTip" UBYTE SBW_STANDARD_S1_S3 1 100 0 2 DISPLAY_IDENTIFIER st_TipMinus1Trig.TipSignals ECU_ADDRESS 0xFFF8A711 /end MEASUREMENT
/begin MEASUREMENT TipSignals.st_TipPlus1Old "old value of st_TipPlus1" UBYTE SBW_STANDARD_S1_S3 1 100 0 2 DISPLAY_IDENTIFIER st_TipPlus1Old.TipSignals ECU_ADDRESS 0xFFF8A712 /end MEASUREMENT
/begin MEASUREMENT TipSignals.st_TipPlus1Trig "tip plus event from shift lever 0=noTip 1=singleTip 2=doubleTip" UBYTE SBW_STANDARD_S1_S3 1 100 0 2 DISPLAY_IDENTIFIER st_TipPlus1Trig.TipSignals ECU_ADDRESS 0xFFF8A713 /end MEASUREMENT
/begin MEASUREMENT TipSignals.st_TipMinus2Old "old value of st_TipMinus2" UBYTE SBW_STANDARD_S1_S3 1 100 0 2 DISPLAY_IDENTIFIER st_TipMinus2Old.TipSignals ECU_ADDRESS 0xFFF8A714 /end MEASUREMENT
/begin MEASUREMENT TipSignals.st_TipMinus2Trig "tip minus event from steering wheel 0=noTip 1=singleTip 2=doubleTip" UBYTE SBW_STANDARD_S1_S3 1 100 0 2 DISPLAY_IDENTIFIER st_TipMinus2Trig.TipSignals ECU_ADDRESS 0xFFF8A715 /end MEASUREMENT
/begin MEASUREMENT TipSignals.st_TipPlus2Old "old value of st_TipPlus2" UBYTE SBW_STANDARD_S1_S3 1 100 0 2 DISPLAY_IDENTIFIER st_TipPlus2Old.TipSignals ECU_ADDRESS 0xFFF8A716 /end MEASUREMENT
/begin MEASUREMENT TipSignals.st_TipPlus2Trig "tip plus event from steering wheel 0=noTip 1=singleTip 2=doubleTip" UBYTE SBW_STANDARD_S1_S3 1 100 0 2 DISPLAY_IDENTIFIER st_TipPlus2Trig.TipSignals ECU_ADDRESS 0xFFF8A717 /end MEASUREMENT
/begin MEASUREMENT Interfi.st_Serap "0 : Reference / 1 : Working" UBYTE SBW_STANDARD_S1_S3 1 100 0 2 DISPLAY_IDENTIFIER st_Serap.Interfi ECU_ADDRESS 0xFFF8A718 /end MEASUREMENT
/begin MEASUREMENT Interfi.st_DiagNUWIG "state UWIG symptom" UBYTE SBW_STANDARD_S1_S3 1 100 0 3 DISPLAY_IDENTIFIER st_DiagNUWIG.Interfi ECU_ADDRESS 0xFFF8A719 /end MEASUREMENT
/begin MEASUREMENT Interfi.st_ParkLock "State of Parklock from HPSYS: 0 undef ** 1 loose ** 2 loosing ** 3 engaging ** 4 engaged" UBYTE SBW_STANDARD_S1_S3 1 100 0 1 DISPLAY_IDENTIFIER st_ParkLock.Interfi ECU_ADDRESS 0xFFF8A71A /end MEASUREMENT
/begin MEASUREMENT Interfi.st_ModeDisplay "current display mode from AGS" UBYTE SBW_STANDARD_S1_S3 1 100 0 10 DISPLAY_IDENTIFIER st_ModeDisplay.Interfi ECU_ADDRESS 0xFFF8A71B /end MEASUREMENT
/begin MEASUREMENT Interfi.st_VehDrvRdy "Vehicle drive ready status" UBYTE SBW_STANDARD_S1_S3 1 100 0 255 DISPLAY_IDENTIFIER st_VehDrvRdy.Interfi ECU_ADDRESS 0xFFF8A71C /end MEASUREMENT
/begin MEASUREMENT Interfi.f_StrtStpButton "flag Start Stop Button" UBYTE SBW_STANDARD_S1_S3 1 100 0 1 DISPLAY_IDENTIFIER f_StrtStpButton.Interfi ECU_ADDRESS 0xFFF8A71D /end MEASUREMENT
/begin MEASUREMENT Interfi.v_VehSpdSts "Signal status actual vehicel speed" UBYTE SBW_STANDARD_S1_S3 1 100 0 2 DISPLAY_IDENTIFIER v_VehSpdSts.Interfi ECU_ADDRESS 0xFFF8A71E /end MEASUREMENT
/begin MEASUREMENT Interfi.f_ParkingBrake "flag parking brake" UBYTE SBW_STANDARD_S1_S3 1 100 0 1 DISPLAY_IDENTIFIER f_ParkingBrake.Interfi ECU_ADDRESS 0xFFF8A71F /end MEASUREMENT
/begin MEASUREMENT Interfi.ParkingBrakeSts "flag parking brake status" UBYTE SBW_STANDARD_S1_S3 1 100 0 2 DISPLAY_IDENTIFIER ParkingBrakeSts.Interfi ECU_ADDRESS 0xFFF8A720 /end MEASUREMENT
/begin MEASUREMENT Interfi.f_V_Implausible "flag car velocity implausible" UBYTE SBW_STANDARD_S1_S3 1 100 0 1 DISPLAY_IDENTIFIER f_V_Implausible.Interfi ECU_ADDRESS 0xFFF8A721 /end MEASUREMENT
/begin MEASUREMENT Interfi.AcceleratorPedalAngle "Accelerator Pedal Angle" UBYTE SBW_HDK_M_S1_S3 1 100 0 100.4 DISPLAY_IDENTIFIER AcceleratorPedalAngle.Interfi ECU_ADDRESS 0xFFF8A722 /end MEASUREMENT
/begin MEASUREMENT Interfi.AcceleratorPedalAngleSts "Signal status of Accelerator Pedal Angle" UBYTE SBW_STANDARD_S1_S3 1 100 0 2 DISPLAY_IDENTIFIER AcceleratorPedalAngleSts.Interfi ECU_ADDRESS 0xFFF8A723 /end MEASUREMENT
/begin MEASUREMENT Interfi.st_OsMode "state/mode of Operating System: 0 = Init 1=Stdby 2=Cruise 3=Limphome" UBYTE SBW_STANDARD_S1_S3 1 100 0 3 DISPLAY_IDENTIFIER st_OsMode.Interfi ECU_ADDRESS 0xFFF8A724 /end MEASUREMENT
/begin MEASUREMENT Interfi.BrakePedalSts "break pedal status" UBYTE SBW_STANDARD_S1_S3 1 100 0 2 DISPLAY_IDENTIFIER BrakePedalSts.Interfi ECU_ADDRESS 0xFFF8A725 /end MEASUREMENT
/begin MEASUREMENT Interfi.EepromBusy "Eeprom Update is active so dont change variables in mirror" UBYTE SBW_STANDARD_S1_S3 1 100 0 1 DISPLAY_IDENTIFIER EepromBusy.Interfi ECU_ADDRESS 0xFFF8A726 /end MEASUREMENT
/begin MEASUREMENT Interfi.EepromStoreInProgress "Eeprom Store in Progress reports end of eeprom-write-process" UBYTE SBW_STANDARD_S1_S3 1 100 0 255 DISPLAY_IDENTIFIER EepromStoreInProgress.Interfi ECU_ADDRESS 0xFFF8A727 /end MEASUREMENT
/begin MEASUREMENT Interfi.EepromUpdCnt "Eeprom Update count reports nr. of successful eeprom-write-attempts" ULONG SBW_STANDARD_S1_S3 1 100 0 4294967295 DISPLAY_IDENTIFIER EepromUpdCnt.Interfi ECU_ADDRESS 0xFFF8A728 /end MEASUREMENT
/begin MEASUREMENT Interfi.c_OilTrans "gearbox oil temperature" UBYTE SBW_CGT40_M_S1_S3 1 100 -40 215 DISPLAY_IDENTIFIER c_OilTrans.Interfi ECU_ADDRESS 0xFFF8A72C /end MEASUREMENT
/begin MEASUREMENT Interfi.c_OilTransSts "signal state of c_OilTrans [0=ok 1=subst.sig 2=sig.fault]" UBYTE SBW_STANDARD_S1_S3 1 100 0 2 DISPLAY_IDENTIFIER c_OilTransSts.Interfi ECU_ADDRESS 0xFFF8A72D /end MEASUREMENT
/begin MEASUREMENT Interfi.c_ChipTrans "EGS chip substrat temperature" UBYTE SBW_CGT40_M_S1_S3 1 100 -40 215 DISPLAY_IDENTIFIER c_ChipTrans.Interfi ECU_ADDRESS 0xFFF8A72E /end MEASUREMENT
/begin MEASUREMENT Interfi.n_Eng "engine rev.s; INT=value[r.p.m.]" UWORD SBW_N_1_M_S1_S3 1 100 0 65535 DISPLAY_IDENTIFIER n_Eng.Interfi ECU_ADDRESS 0xFFF8A730 /end MEASUREMENT
/begin MEASUREMENT Interfi.n_EngSts "state of signal n_Eng" UBYTE SBW_STANDARD_S1_S3 1 100 0 255 DISPLAY_IDENTIFIER n_EngSts.Interfi ECU_ADDRESS 0xFFF8A732 /end MEASUREMENT
/begin MEASUREMENT Interfi.st_GearboxDrvRdy "bitcoded state of gear-change-pressure: 0x00=sys.press. n.avail. - 0x04set: sys.press.incr. - 0x20set: sys.press.decr. - 0x80 set:sys.press. avail." UBYTE SBW_STANDARD_S1_S3 1 100 0 255 DISPLAY_IDENTIFIER st_GearboxDrvRdy.Interfi ECU_ADDRESS 0xFFF8A733 /end MEASUREMENT
/begin MEASUREMENT Interfi.GearboxDrvRdySts "state of signal st_GearboxDrvRdy" UBYTE SBW_STANDARD_S1_S3 1 100 0 2 DISPLAY_IDENTIFIER GearboxDrvRdySts.Interfi ECU_ADDRESS 0xFFF8A734 /end MEASUREMENT
/begin MEASUREMENT Interfi.VehicleDrvRdy "op.readiness info from hybrid-master" UBYTE SBW_STANDARD_S1_S3 1 100 0 255 DISPLAY_IDENTIFIER VehicleDrvRdy.Interfi ECU_ADDRESS 0xFFF8A735 /end MEASUREMENT
/begin MEASUREMENT Interfi.VehicleDrvRdySts "state of signal VehicleDrvRdy" UBYTE SBW_STANDARD_S1_S3 1 100 0 2 DISPLAY_IDENTIFIER VehicleDrvRdySts.Interfi ECU_ADDRESS 0xFFF8A736 /end MEASUREMENT
/begin MEASUREMENT Interfi.st_IgnOnRaw "state ignition on/off [raw-value]" UBYTE SBW_STANDARD_S1_S3 1 100 0 4 DISPLAY_IDENTIFIER st_IgnOnRaw.Interfi ECU_ADDRESS 0xFFF8A737 /end MEASUREMENT
/begin MEASUREMENT Interfi.IgnOnRawSts "state ignition [raw-value]" UBYTE SBW_STANDARD_S1_S3 1 100 0 2 DISPLAY_IDENTIFIER IgnOnRawSts.Interfi ECU_ADDRESS 0xFFF8A738 /end MEASUREMENT
/begin MEASUREMENT Interfi.n_AbRaw "drive/output rev.s [raw- or subst.value]" UWORD SBW_N_1_M_S1_S3 1 100 0 20000 DISPLAY_IDENTIFIER n_AbRaw.Interfi ECU_ADDRESS 0xFFF8A73A /end MEASUREMENT
/begin MEASUREMENT Interfi.PSensor "state of the parking lock [0=not engaged; 1=engaged; 2=intermediate pos.; 3=unknown]" UBYTE SBW_STANDARD_S1_S3 1 100 0 255 DISPLAY_IDENTIFIER PSensor.Interfi ECU_ADDRESS 0xFFF8A73C /end MEASUREMENT
/begin MEASUREMENT Interfi.DrivingDirection "sense of rotation of driven wheels [1:fw; 2:bw; 0:err resp. ud]" UBYTE SBW_STANDARD_S1_S3 1 100 0 255 DISPLAY_IDENTIFIER DrivingDirection.Interfi ECU_ADDRESS 0xFFF8A73D /end MEASUREMENT
/begin MEASUREMENT Interfi.DrivingDirectionSts "state of signal DrivingDirection" UBYTE SBW_STANDARD_S1_S3 1 100 0 255 DISPLAY_IDENTIFIER DrivingDirectionSts.Interfi ECU_ADDRESS 0xFFF8A73E /end MEASUREMENT
/begin MEASUREMENT Interfi.f_BrakePedal "flag brake light/brake test" UBYTE SBW_STANDARD_S1_S3 1 100 0 1 DISPLAY_IDENTIFIER f_BrakePedal.Interfi ECU_ADDRESS 0xFFF8A73F /end MEASUREMENT
/begin MEASUREMENT Interfi.v_VehSpd_nab "vehicle speed by n_ab" UWORD SBW_VKMH_16_S1_S3 1 100 0 21.875 DISPLAY_IDENTIFIER v_VehSpd_nab.Interfi ECU_ADDRESS 0xFFF8A740 /end MEASUREMENT
/begin MEASUREMENT Interfi.PSensorSts "state P-sensor signal [0: ok 1: subst 2: err]" UBYTE SBW_STANDARD_S1_S3 1 100 0 2 DISPLAY_IDENTIFIER PSensorSts.Interfi ECU_ADDRESS 0xFFF8A742 /end MEASUREMENT
/begin MEASUREMENT Interfi.st_Limphome "st_Limphome: xxxx xxx1: lowside switch opened xxxx xx1x: highside switch [FET] opened" UBYTE SBW_STANDARD_S1_S3 1 100 0 255 DISPLAY_IDENTIFIER st_Limphome.Interfi ECU_ADDRESS 0xFFF8A743 /end MEASUREMENT
/begin MEASUREMENT Interfi.f_PowDownCondOK "flag EGS in overshoot-state waiting for permission to power down" UBYTE SBW_STANDARD_S1_S3 1 100 0 1 DISPLAY_IDENTIFIER f_PowDownCondOK.Interfi ECU_ADDRESS 0xFFF8A744 /end MEASUREMENT
/begin MEASUREMENT Interfi.st_ChargingPlug "Status of charging plug. 0:No Plug 1:Plug unknown 2:Plug present" UBYTE SBW_STANDARD_S1_S3 1 100 0 2 DISPLAY_IDENTIFIER st_ChargingPlug.Interfi ECU_ADDRESS 0xFFF8A745 /end MEASUREMENT
/begin MEASUREMENT Interfi.ChargingPlugSts "Signal status of st_ChargingPlug" UBYTE SBW_STANDARD_S1_S3 1 100 0 2 DISPLAY_IDENTIFIER ChargingPlugSts.Interfi ECU_ADDRESS 0xFFF8A746 /end MEASUREMENT
/begin MEASUREMENT Interfi.u_mv3 "supply voltage for pressure regulators and solenoid valves" UWORD SBW_TAUSENDSTEL_U_S1_S3 1 100 0 0.025 DISPLAY_IDENTIFIER u_mv3.Interfi ECU_ADDRESS 0xFFF8A748 /end MEASUREMENT
/begin MEASUREMENT Interfi.u_BattDiag "supply voltage used for diagnosis" UWORD SBW_TAUSENDSTEL_U_S1_S3 1 100 0 0.025 DISPLAY_IDENTIFIER u_BattDiag.Interfi ECU_ADDRESS 0xFFF8A74A /end MEASUREMENT
/begin MEASUREMENT Interfi.f_FaultKFC_PINFO "flag returned by RB macro 'DI_GET_FAULT_ACTIVE[KFC_PINFO]'" UBYTE SBW_STANDARD_S1_S3 1 100 0 1 DISPLAY_IDENTIFIER f_FaultKFC_PINFO.Interfi ECU_ADDRESS 0xFFF8A74C /end MEASUREMENT
/begin MEASUREMENT Interfi.f_FaultKFC_PSIN "flag error entry ActivePSIN" UBYTE SBW_STANDARD_S1_S3 1 100 0 1 DISPLAY_IDENTIFIER f_FaultKFC_PSIN.Interfi ECU_ADDRESS 0xFFF8A74D /end MEASUREMENT
/begin MEASUREMENT Interfi.f_SubstNoStoringPos "flag returned by RB macro 'DI_GET_SUBST_FUNCT[KMN_NOSTORINGPOS]'" UBYTE SBW_STANDARD_S1_S3 1 100 0 1 DISPLAY_IDENTIFIER f_SubstNoStoringPos.Interfi ECU_ADDRESS 0xFFF8A74E /end MEASUREMENT
/begin MEASUREMENT Interfi.f_SubstWarnLight "'DI_GET_SUBST_FUNCT[KMN_FAULTINFO]' from RB-SW" UBYTE SBW_STANDARD_S1_S3 1 100 0 1 DISPLAY_IDENTIFIER f_SubstWarnLight.Interfi ECU_ADDRESS 0xFFF8A74F /end MEASUREMENT
/begin MEASUREMENT Interfi.f_SubstAdaptivModeFix "flag fixed adaptive mode" UBYTE SBW_STANDARD_S1_S3 1 100 0 1 DISPLAY_IDENTIFIER f_SubstAdaptivModeFix.Interfi ECU_ADDRESS 0xFFF8A750 /end MEASUREMENT
/begin MEASUREMENT Interfi.f_SubstHSS1Off "flag highside1 off" UBYTE SBW_STANDARD_S1_S3 1 100 0 1 DISPLAY_IDENTIFIER f_SubstHSS1Off.Interfi ECU_ADDRESS 0xFFF8A751 /end MEASUREMENT
/begin MEASUREMENT Interfi.f_SubstHoldP "flag substitution function 'hold pos P' is active" UBYTE SBW_STANDARD_S1_S3 1 100 0 1 DISPLAY_IDENTIFIER f_SubstHoldP.Interfi ECU_ADDRESS 0xFFF8A752 /end MEASUREMENT
/begin MEASUREMENT Interfi.f_SubstNoD "flag substitution function 'NoD' is active" UBYTE SBW_STANDARD_S1_S3 1 100 0 1 DISPLAY_IDENTIFIER f_SubstNoD.Interfi ECU_ADDRESS 0xFFF8A753 /end MEASUREMENT
/begin MEASUREMENT Interfi.f_SubstNoR "flag substitution function 'NoR' is active" UBYTE SBW_STANDARD_S1_S3 1 100 0 1 DISPLAY_IDENTIFIER f_SubstNoR.Interfi ECU_ADDRESS 0xFFF8A754 /end MEASUREMENT
/begin MEASUREMENT Interfi.st_SubstAll "Return Subst Functions of Errorhandler lower 32 Bits" ULONG SBW_STANDARD_S1_S3 1 100 0 4294967295 DISPLAY_IDENTIFIER st_SubstAll.Interfi ECU_ADDRESS 0xFFF8A758 /end MEASUREMENT
/begin MEASUREMENT Interfi.st_SubstAllHi "Return Subst Functions of Errorhandler upper 32 Bits" ULONG SBW_STANDARD_S1_S3 1 100 0 4294967295 DISPLAY_IDENTIFIER st_SubstAllHi.Interfi ECU_ADDRESS 0xFFF8A75C /end MEASUREMENT
/begin MEASUREMENT Interfi.f_SubstKMN_CCID419 "flag substitute actions KMN_CCID419" UBYTE SBW_STANDARD_S1_S3 1 100 0 1 DISPLAY_IDENTIFIER f_SubstKMN_CCID419.Interfi ECU_ADDRESS 0xFFF8A760 /end MEASUREMENT
/begin MEASUREMENT Interfi.f_SubstKMN_CCID420 "flag substitute actions KMN_CCID420" UBYTE SBW_STANDARD_S1_S3 1 100 0 1 DISPLAY_IDENTIFIER f_SubstKMN_CCID420.Interfi ECU_ADDRESS 0xFFF8A761 /end MEASUREMENT
/begin MEASUREMENT Interfi.f_SportButtonRaw "raw value for sport button" UBYTE SBW_STANDARD_S1_S3 1 100 0 1 DISPLAY_IDENTIFIER f_SportButtonRaw.Interfi ECU_ADDRESS 0xFFF8A762 /end MEASUREMENT
/begin MEASUREMENT Interfi.DriveLogicRaw "raw value for DriveLogic" UBYTE SBW_STANDARD_S1_S3 1 100 0 2 DISPLAY_IDENTIFIER DriveLogicRaw.Interfi ECU_ADDRESS 0xFFF8A763 /end MEASUREMENT
/begin MEASUREMENT Interfi.PosRaw "raw val. of driver request [absolute or relative position]" UBYTE SBW_STANDARD_S1_S3 1 100 0 32 DISPLAY_IDENTIFIER PosRaw.Interfi ECU_ADDRESS 0xFFF8A764 /end MEASUREMENT
/begin MEASUREMENT Interfi.CtrlSignalSourceSts "Status of source of signal GET_POS_RAW" UBYTE SBW_STANDARD_S1_S3 1 100 0 2 DISPLAY_IDENTIFIER CtrlSignalSourceSts.Interfi ECU_ADDRESS 0xFFF8A765 /end MEASUREMENT
/begin MEASUREMENT Interfi.st_LeverType "state of application lable SWI_LEVERTYPE 0=Automatic lever - bistable rel pos 1=Automatic lever - bistable abs pos 2=IEX or Sport - monostable abs pos" UBYTE SBW_STANDARD_S1_S3 1 100 0 2 DISPLAY_IDENTIFIER st_LeverType.Interfi ECU_ADDRESS 0xFFF8A766 /end MEASUREMENT
/begin MEASUREMENT Interfi.f_DoorD "driver side door open" UBYTE SBW_STANDARD_S1_S3 1 100 0 1 DISPLAY_IDENTIFIER f_DoorD.Interfi ECU_ADDRESS 0xFFF8A767 /end MEASUREMENT
/begin MEASUREMENT Interfi.DoorDSts "status of signal 'door open'" UBYTE SBW_STANDARD_S1_S3 1 100 0 2 DISPLAY_IDENTIFIER DoorDSts.Interfi ECU_ADDRESS 0xFFF8A768 /end MEASUREMENT
/begin MEASUREMENT Interfi.f_KeyValid "flag for ignition key valid" UBYTE SBW_STANDARD_S1_S3 1 100 0 1 DISPLAY_IDENTIFIER f_KeyValid.Interfi ECU_ADDRESS 0xFFF8A769 /end MEASUREMENT
/begin MEASUREMENT Interfi.KeyValidSts "status of signal ignition key valid" UBYTE SBW_STANDARD_S1_S3 1 100 0 2 DISPLAY_IDENTIFIER KeyValidSts.Interfi ECU_ADDRESS 0xFFF8A76A /end MEASUREMENT
/begin MEASUREMENT Interfi.t_systime_secs "system-time of std.core counting in secs after 1st jan 2000 phys=int_hex*1[secs]" ULONG SBW_TIMER_1S_S1_S3 1 100 0 4294967295 DISPLAY_IDENTIFIER t_systime_secs.Interfi ECU_ADDRESS 0xFFF8A76C /end MEASUREMENT
/begin MEASUREMENT Interfi.s_mileage_10km "actual km-state of vehicle via CAN phys=int_hex*10[km]" UWORD SBW_KM_10_S1_S3 1 100 0 655350 DISPLAY_IDENTIFIER s_mileage_10km.Interfi ECU_ADDRESS 0xFFF8A770 /end MEASUREMENT
/begin MEASUREMENT Interfi.st_IAE_Hotmode "State Value for IAE [Clutch] temperature level 0=no Message 1=State I [Pulsen] 2=State II [IAE open] 3-7->not defined" UBYTE SBW_STANDARD_S1_S3 1 100 0 1 DISPLAY_IDENTIFIER st_IAE_Hotmode.Interfi ECU_ADDRESS 0xFFF8A772 /end MEASUREMENT
/begin MEASUREMENT Interfi.f_SeatBelt "driver seat belt 0=open 1=closed" UBYTE SBW_STANDARD_S1_S3 1 100 0 1 DISPLAY_IDENTIFIER f_SeatBelt.Interfi ECU_ADDRESS 0xFFF8A773 /end MEASUREMENT
/begin MEASUREMENT Interfi.SeatBeltSts "status of signal f_SeatBelt" UBYTE SBW_STANDARD_S1_S3 1 100 0 2 DISPLAY_IDENTIFIER SeatBeltSts.Interfi ECU_ADDRESS 0xFFF8A774 /end MEASUREMENT
/begin MEASUREMENT Interfi.f_PN "request shiftlock activation via CAN" UBYTE SBW_STANDARD_S1_S3 1 100 0 1 DISPLAY_IDENTIFIER f_PN.Interfi ECU_ADDRESS 0xFFF8A775 /end MEASUREMENT
/begin MEASUREMENT Interfi.GatePosRaw "raw val. of gate position - left-right-noaction" UBYTE SBW_STANDARD_S1_S3 1 100 0 255 DISPLAY_IDENTIFIER GatePosRaw.Interfi ECU_ADDRESS 0xFFF8A776 /end MEASUREMENT
/begin MEASUREMENT Interfi.f_KeyRemoteStart "flag for engine remote start" UBYTE SBW_STANDARD_S1_S3 1 100 0 1 DISPLAY_IDENTIFIER f_KeyRemoteStart.Interfi ECU_ADDRESS 0xFFF8A777 /end MEASUREMENT
/begin MEASUREMENT Interfi.f_P12Button "flag park-button pressed" UBYTE SBW_STANDARD_S1_S3 1 100 0 1 DISPLAY_IDENTIFIER f_P12Button.Interfi ECU_ADDRESS 0xFFF8A778 /end MEASUREMENT
/begin MEASUREMENT Interfi.f_P12TwoErr "flag park-button two errors" UBYTE SBW_STANDARD_S1_S3 1 100 0 1 DISPLAY_IDENTIFIER f_P12TwoErr.Interfi ECU_ADDRESS 0xFFF8A779 /end MEASUREMENT
/begin MEASUREMENT Interfi.f_P12BadOpRaw "flag park-button bad operation" UBYTE SBW_STANDARD_S1_S3 1 100 0 1 DISPLAY_IDENTIFIER f_P12BadOpRaw.Interfi ECU_ADDRESS 0xFFF8A77A /end MEASUREMENT
/begin MEASUREMENT Interfi.f_SDButtonRaw "flag sport lever action [S/D modeswitch]" UBYTE SBW_STANDARD_S1_S3 1 100 0 1 DISPLAY_IDENTIFIER f_SDButtonRaw.Interfi ECU_ADDRESS 0xFFF8A77B /end MEASUREMENT
/begin MEASUREMENT Interfi.st_TipMinus1_Raw "flag manual tip1 gearlever to minus 0=noTip 1=singleTip 2=doubleTip" UBYTE SBW_STANDARD_S1_S3 1 100 0 2 DISPLAY_IDENTIFIER st_TipMinus1_Raw.Interfi ECU_ADDRESS 0xFFF8A77C /end MEASUREMENT
/begin MEASUREMENT Interfi.st_TipPlus1_Raw "flag manual tip1 gearlever to plus 0=noTip 1=singleTip 2=doubleTip" UBYTE SBW_STANDARD_S1_S3 1 100 0 2 DISPLAY_IDENTIFIER st_TipPlus1_Raw.Interfi ECU_ADDRESS 0xFFF8A77D /end MEASUREMENT
/begin MEASUREMENT Interfi.st_TipMinus2_Raw "flag manual tip2 gearlever to minus 0=noTip 1=singleTip 2=doubleTip" UBYTE SBW_STANDARD_S1_S3 1 100 0 2 DISPLAY_IDENTIFIER st_TipMinus2_Raw.Interfi ECU_ADDRESS 0xFFF8A77E /end MEASUREMENT
/begin MEASUREMENT Interfi.st_TipPlus2_Raw "flag manual tip2 gearlever to plus 0=noTip 1=singleTip 2=doubleTip" UBYTE SBW_STANDARD_S1_S3 1 100 0 2 DISPLAY_IDENTIFIER st_TipPlus2_Raw.Interfi ECU_ADDRESS 0xFFF8A77F /end MEASUREMENT
/begin MEASUREMENT Interfi.PosDrvAssistRaw "FAS/DAS request for driving-direction: 0=NA 5=D 6=N 7=R 8=P" UBYTE SBW_STANDARD_S1_S3 1 100 0 8 DISPLAY_IDENTIFIER PosDrvAssistRaw.Interfi ECU_ADDRESS 0xFFF8A780 /end MEASUREMENT
/begin MEASUREMENT Interfi.PosDrvAssistRawSts "signal status of _GET_POS_DRV_ASSIST_RAW: 0=signal o.k. 1=signal subst.value 2=signal n.o.k./err." UBYTE SBW_STANDARD_S1_S3 1 100 0 2 DISPLAY_IDENTIFIER PosDrvAssistRawSts.Interfi ECU_ADDRESS 0xFFF8A781 /end MEASUREMENT
/begin MEASUREMENT Interfi.f_ModeDrvAssistVeh "FAS/DAS activation signal: 0=inactive 1=active" UBYTE SBW_STANDARD_S1_S3 1 100 0 1 DISPLAY_IDENTIFIER f_ModeDrvAssistVeh.Interfi ECU_ADDRESS 0xFFF8A782 /end MEASUREMENT
/begin MEASUREMENT Interfi.ModeDrvAssistVehSts "signal status of _GET_MODE_DRV_ASSIST_VEH: 0=signal o.k. 1=signal subst.value 2=signal n.o.k./err." UBYTE SBW_STANDARD_S1_S3 1 100 0 2 DISPLAY_IDENTIFIER ModeDrvAssistVehSts.Interfi ECU_ADDRESS 0xFFF8A783 /end MEASUREMENT
/begin MEASUREMENT Interfi.f_BrakePedalDrvAssist "brake-activation flag by FAS [PMA/RCP] from ICM-ECU: 0=brake by FAS inactive 1=brake by FAS active" UBYTE SBW_STANDARD_S1_S3 1 100 0 1 DISPLAY_IDENTIFIER f_BrakePedalDrvAssist.Interfi ECU_ADDRESS 0xFFF8A784 /end MEASUREMENT
/begin MEASUREMENT Interfi.BrakePedalDrvAssistSts "signal status of _GET_FBR_DRV_ASSIST: 0=signal o.k. 1=signal subst.value 2=signal n.o.k./err." UBYTE SBW_STANDARD_S1_S3 1 100 0 2 DISPLAY_IDENTIFIER BrakePedalDrvAssistSts.Interfi ECU_ADDRESS 0xFFF8A785 /end MEASUREMENT
/begin MEASUREMENT Interfi.st_EmfP "state for EMF 'help' request" UBYTE SBW_STANDARD_S1_S3 1 100 0 2 DISPLAY_IDENTIFIER st_EmfP.Interfi ECU_ADDRESS 0xFFF8A786 /end MEASUREMENT
/begin MEASUREMENT Interfi.i_Out10Akt "per promille of current measured at output OUT10" UWORD SBW_TAUSENDSTEL_S1_S3 1 100 0 0.001 DISPLAY_IDENTIFIER i_Out10Akt.Interfi ECU_ADDRESS 0xFFF8A788 /end MEASUREMENT
/begin MEASUREMENT Interfi.Out10Sts "Electric status of output OUT10" UBYTE SBW_STANDARD_S1_S3 1 100 0 1 DISPLAY_IDENTIFIER Out10Sts.Interfi ECU_ADDRESS 0xFFF8A78A /end MEASUREMENT
/begin MEASUREMENT Interfi.st_LowMode "state of LowMode:0=noLowMode 1=LowMode 3=LowModeInvalid" UBYTE SBW_STANDARD_S1_S3 1 100 0 3 DISPLAY_IDENTIFIER st_LowMode.Interfi ECU_ADDRESS 0xFFF8A78B /end MEASUREMENT
/begin MEASUREMENT Interfi.f_resync_req "trigger resyncronication of NAVI" UBYTE SBW_STANDARD_S1_S3 1 100 0 255 DISPLAY_IDENTIFIER f_resync_req.Interfi ECU_ADDRESS 0xFFF8A78C /end MEASUREMENT
/begin MEASUREMENT Interfi.st_cout_navgraph_sync "status counter of navgraph sync" UBYTE SBW_STANDARD_S1_S3 1 100 0 255 DISPLAY_IDENTIFIER st_cout_navgraph_sync.Interfi ECU_ADDRESS 0xFFF8A78D /end MEASUREMENT
/begin MEASUREMENT Interfi.st_err_no_rcvr_navi "status error if no receiver navi" UBYTE SBW_STANDARD_S1_S3 1 100 0 255 DISPLAY_IDENTIFIER st_err_no_rcvr_navi.Interfi ECU_ADDRESS 0xFFF8A78E /end MEASUREMENT
/begin MEASUREMENT Interfi.st_MSA_Function "MSA information to send via CAN" UBYTE SBW_STANDARD_S1_S3 1 100 0 255 DISPLAY_IDENTIFIER st_MSA_Function.Interfi ECU_ADDRESS 0xFFF8A78F /end MEASUREMENT
/begin MEASUREMENT Interfi.st_MSA_FunctionRequester "ID of ECU which requests MSA information to send via CAN" UBYTE SBW_STANDARD_S1_S3 1 100 0 255 DISPLAY_IDENTIFIER st_MSA_FunctionRequester.Interfi ECU_ADDRESS 0xFFF8A790 /end MEASUREMENT
/begin MEASUREMENT Interfi.st_PreAdaptation "State of preadaptation from atsys" UBYTE SBW_STANDARD_S1_S3 1 100 0 4 DISPLAY_IDENTIFIER st_PreAdaptation.Interfi ECU_ADDRESS 0xFFF8A791 /end MEASUREMENT
/begin MEASUREMENT Interfi.st_GearCurr "current gear from HPSYS/ATSYS (8HPFT: -1=r-gear)" SBYTE SBW_STANDARD_S1_S3 1 100 -10 10 DISPLAY_IDENTIFIER st_GearCurr.Interfi ECU_ADDRESS 0xFFF8A792 /end MEASUREMENT
/begin MEASUREMENT Interfi.st_GearDest "destination gear (next gear) from HPSYS/ATSYS (8HPFT: -1=r-gear)" SBYTE SBW_STANDARD_S1_S3 1 100 -10 10 DISPLAY_IDENTIFIER st_GearDest.Interfi ECU_ADDRESS 0xFFF8A793 /end MEASUREMENT
/begin MEASUREMENT Interfi.st_GearShiftStrat "display gear from shifting strategy" UBYTE SBW_STANDARD_S1_S3 1 100 0 10 DISPLAY_IDENTIFIER st_GearShiftStrat.Interfi ECU_ADDRESS 0xFFF8A794 /end MEASUREMENT
/begin MEASUREMENT RelToAbs.DrvReq_Raw_ByRelativelever "Absolute Driver Request computed of relative lever signal" UBYTE SBW_STANDARD_S1_S3 1 100 0 8 DISPLAY_IDENTIFIER DrvReq_Raw_ByRelativelever.RelToAbs ECU_ADDRESS 0xFFF8A297 /end MEASUREMENT
/begin MEASUREMENT RelToAbs.st_RelToAbs_Stm "state to detect correct action after lever movement" UBYTE SBW_STANDARD_S1_S3 1 100 0 5 DISPLAY_IDENTIFIER st_RelToAbs_Stm.RelToAbs ECU_ADDRESS 0xFFF8A298 /end MEASUREMENT
/begin MEASUREMENT RelToAbs.MaxLeverpos "maximum lever position until lever is back in NA" UBYTE SBW_STANDARD_S1_S3 1 100 0 32 DISPLAY_IDENTIFIER MaxLeverpos.RelToAbs ECU_ADDRESS 0xFFF8A299 /end MEASUREMENT
/begin MEASUREMENT RelToAbs.MaxLeverposIdx "index of x-axis in table D_Tab_RelToAbsConversion corresponding to actual MaxLeverpos" UBYTE SBW_STANDARD_S1_S3 1 100 0 3 DISPLAY_IDENTIFIER MaxLeverposIdx.RelToAbs ECU_ADDRESS 0xFFF8A29A /end MEASUREMENT
/begin MEASUREMENT RelToAbs.StartPosPRND "position needed as start position for conversion relative to absolute lever position" UBYTE SBW_STANDARD_S1_S3 1 100 0 8 DISPLAY_IDENTIFIER StartPosPRND.RelToAbs ECU_ADDRESS 0xFFF8A29B /end MEASUREMENT
/begin MEASUREMENT RelToAbs.StartPosPRNDIdx "index of y-axis in table D_Tab_RelToAbsConversion corresponding to StartPosPRND" UBYTE SBW_STANDARD_S1_S3 1 100 0 6 DISPLAY_IDENTIFIER StartPosPRNDIdx.RelToAbs ECU_ADDRESS 0xFFF8A29C /end MEASUREMENT
/begin MEASUREMENT RelToAbs.PosRawRelOld "old value of PosRawRel" UBYTE SBW_STANDARD_S1_S3 1 100 0 32 DISPLAY_IDENTIFIER PosRawRelOld.RelToAbs ECU_ADDRESS 0xFFF8A29D /end MEASUREMENT
/begin MEASUREMENT ModeIn.tmr_DelayMGate.time "test_timer" UWORD SBW_TIMER_10MS_S1_S3 1 100 0 655350 DISPLAY_IDENTIFIER time.tmr_DelayMGate.ModeIn ECU_ADDRESS 0xFFF8A798 /end MEASUREMENT
/begin MEASUREMENT ModeIn.tmr_DelayMGate.f_IsExpired "test_timer" UBYTE SBW_STANDARD_S1_S3 1 100 0 255 DISPLAY_IDENTIFIER f_IsExpired.tmr_DelayMGate.ModeIn ECU_ADDRESS 0xFFF8A79A /end MEASUREMENT
/begin MEASUREMENT ModeIn.f_MGate "flag to detect if lever is in manual gate" UBYTE SBW_STANDARD_S1_S3 1 100 0 1 BIT_MASK 0x1 DISPLAY_IDENTIFIER f_MGate.ModeIn ECU_ADDRESS 0xFFF8A79C /end MEASUREMENT
/begin MEASUREMENT ModeIn.f_MGateOld "flag to detect if lever was in manual during last cycle" UBYTE SBW_STANDARD_S1_S3 1 100 0 1 BIT_MASK 0x1 DISPLAY_IDENTIFIER f_MGateOld.ModeIn ECU_ADDRESS 0xFFF8A79D /end MEASUREMENT
/begin MEASUREMENT ModeIn.f_MGateOn "Triggered flag when M-Gate is switched on" UBYTE SBW_STANDARD_S1_S3 1 100 0 1 BIT_MASK 0x1 DISPLAY_IDENTIFIER f_MGateOn.ModeIn ECU_ADDRESS 0xFFF8A79E /end MEASUREMENT
/begin MEASUREMENT ModeIn.f_MGateOff "Triggered flag when M-Gate is switched off" UBYTE SBW_STANDARD_S1_S3 1 100 0 1 BIT_MASK 0x1 DISPLAY_IDENTIFIER f_MGateOff.ModeIn ECU_ADDRESS 0xFFF8A79F /end MEASUREMENT
/begin MEASUREMENT ModeIn.f_TempMan "information whether temporary mode manual is active or not" UBYTE SBW_STANDARD_S1_S3 1 100 0 1 BIT_MASK 0x1 DISPLAY_IDENTIFIER f_TempMan.ModeIn ECU_ADDRESS 0xFFF8A7A0 /end MEASUREMENT
/begin MEASUREMENT ModeIn.f_SportButtonRawOld "old value of f_SportButtonRaw" UBYTE SBW_STANDARD_S1_S3 1 100 0 1 BIT_MASK 0x1 DISPLAY_IDENTIFIER f_SportButtonRawOld.ModeIn ECU_ADDRESS 0xFFF8A7A1 /end MEASUREMENT
/begin MEASUREMENT ModeIn.f_SportButtonRaw "sport button pressed continous signal" UBYTE SBW_STANDARD_S1_S3 1 100 0 1 BIT_MASK 0x1 DISPLAY_IDENTIFIER f_SportButtonRaw.ModeIn ECU_ADDRESS 0xFFF8A7A2 /end MEASUREMENT
/begin MEASUREMENT ModeIn.f_SportButtonTrig "sport button pressed event" UBYTE SBW_STANDARD_S1_S3 1 100 0 1 BIT_MASK 0x1 DISPLAY_IDENTIFIER f_SportButtonTrig.ModeIn ECU_ADDRESS 0xFFF8A7A3 /end MEASUREMENT
/begin MEASUREMENT ModeIn.f_LowModeButton "detection of state change of st_LowMode 0 to 1" UBYTE SBW_STANDARD_S1_S3 1 100 0 1 BIT_MASK 0x1 DISPLAY_IDENTIFIER f_LowModeButton.ModeIn ECU_ADDRESS 0xFFF8A7A4 /end MEASUREMENT
/begin MEASUREMENT ModeIn.f_LowModeInvalid "detection of state change of st_LowMode to 3" UBYTE SBW_STANDARD_S1_S3 1 100 0 1 BIT_MASK 0x1 DISPLAY_IDENTIFIER f_LowModeInvalid.ModeIn ECU_ADDRESS 0xFFF8A7A5 /end MEASUREMENT
/begin MEASUREMENT ModeIn.st_LowModeOld "last cycle state of 'GET_LOW_MODE'" UBYTE SBW_STANDARD_S1_S3 1 100 0 3 DISPLAY_IDENTIFIER st_LowModeOld.ModeIn ECU_ADDRESS 0xFFF8A7A6 /end MEASUREMENT
/begin MEASUREMENT LeverSignalMerge.DrvReq_Raw "lever independant driver request" UBYTE SBW_STANDARD_S1_S3 1 100 1 255 DISPLAY_IDENTIFIER DrvReq_Raw.LeverSignalMerge ECU_ADDRESS 0xFFF8A29E /end MEASUREMENT
/begin MEASUREMENT MultAccess.st_TipMinus1 "tip minus from shift lever 0=noTip 1=singleTip 2=doubleTip" UBYTE SBW_STANDARD_S1_S3 1 100 0 2 DISPLAY_IDENTIFIER st_TipMinus1.MultAccess ECU_ADDRESS 0xFFF8A29F /end MEASUREMENT
/begin MEASUREMENT MultAccess.st_TipPlus1 "tip plus from shift lever 0=noTip 1=singleTip 2=doubleTip" UBYTE SBW_STANDARD_S1_S3 1 100 0 2 DISPLAY_IDENTIFIER st_TipPlus1.MultAccess ECU_ADDRESS 0xFFF8A2A0 /end MEASUREMENT
/begin MEASUREMENT MultAccess.st_TipMinus2 "tip minus from steering wheel 0=noTip 1=singleTip 2=doubleTip" UBYTE SBW_STANDARD_S1_S3 1 100 0 2 DISPLAY_IDENTIFIER st_TipMinus2.MultAccess ECU_ADDRESS 0xFFF8A2A1 /end MEASUREMENT
/begin MEASUREMENT MultAccess.st_TipPlus2 "tip plus from steering wheel 0=noTip 1=singleTip 2=doubleTip" UBYTE SBW_STANDARD_S1_S3 1 100 0 2 DISPLAY_IDENTIFIER st_TipPlus2.MultAccess ECU_ADDRESS 0xFFF8A2A2 /end MEASUREMENT
/begin MEASUREMENT MultAccess.f_SDButtonRawOld "old value of f_SDButtonRaw" UBYTE SBW_STANDARD_S1_S3 1 100 0 1 BIT_MASK 0x1 DISPLAY_IDENTIFIER f_SDButtonRawOld.MultAccess ECU_ADDRESS 0xFFF8A2A3 /end MEASUREMENT
/begin MEASUREMENT MultAccess.f_SDButtonRawOn "sport/drive button pressed event" UBYTE SBW_STANDARD_S1_S3 1 100 0 1 BIT_MASK 0x1 DISPLAY_IDENTIFIER f_SDButtonRawOn.MultAccess ECU_ADDRESS 0xFFF8A2A4 /end MEASUREMENT
/begin MEASUREMENT MultAccess.f_SDButtonRawOff "sport/drive button unpressed event" UBYTE SBW_STANDARD_S1_S3 1 100 0 1 BIT_MASK 0x1 DISPLAY_IDENTIFIER f_SDButtonRawOff.MultAccess ECU_ADDRESS 0xFFF8A2A5 /end MEASUREMENT
/begin MEASUREMENT MultAccess.f_SDButton "sport/drive button pressed (also used to indicate sport gate)" UBYTE SBW_STANDARD_S1_S3 1 100 0 1 BIT_MASK 0x1 DISPLAY_IDENTIFIER f_SDButton.MultAccess ECU_ADDRESS 0xFFF8A2A6 /end MEASUREMENT
/begin MEASUREMENT MultAccess.DrvReq_Old "old value of RelToAbs.DrvReq_Raw" UBYTE SBW_STANDARD_S1_S3 1 100 0 8 DISPLAY_IDENTIFIER DrvReq_Old.MultAccess ECU_ADDRESS 0xFFF8A2A7 /end MEASUREMENT
/begin MEASUREMENT MultAccess.DrvReq_Trig "actual value of RelToAbs.DrvReq_Raw" UBYTE SBW_STANDARD_S1_S3 1 100 0 8 DISPLAY_IDENTIFIER DrvReq_Trig.MultAccess ECU_ADDRESS 0xFFF8A2A8 /end MEASUREMENT
/begin MEASUREMENT MultAccess.DrvReqPRND_Raw "raw value of driver request" UBYTE SBW_STANDARD_S1_S3 1 100 0 8 DISPLAY_IDENTIFIER DrvReqPRND_Raw.MultAccess ECU_ADDRESS 0xFFF8A2A9 /end MEASUREMENT
/begin MEASUREMENT MultAccess.f_P12ButtonOld "old value of Interfi.f_P12Button" UBYTE SBW_STANDARD_S1_S3 1 100 0 1 BIT_MASK 0x1 DISPLAY_IDENTIFIER f_P12ButtonOld.MultAccess ECU_ADDRESS 0xFFF8A2AA /end MEASUREMENT
/begin MEASUREMENT MultAccess.DrvReqP_Trig "P button pressed event" UBYTE SBW_STANDARD_S1_S3 1 100 0 1 BIT_MASK 0x1 DISPLAY_IDENTIFIER DrvReqP_Trig.MultAccess ECU_ADDRESS 0xFFF8A2AB /end MEASUREMENT
/begin MEASUREMENT MultAccess.GatePosOld "old value of SafeGuard.GatePosRawSafe" UBYTE SBW_STANDARD_S1_S3 1 100 0 3 DISPLAY_IDENTIFIER GatePosOld.MultAccess ECU_ADDRESS 0xFFF8A2AC /end MEASUREMENT
/begin MEASUREMENT MultAccess.GatePos "gate position of the shift lever (see constant C_GatePosPRND and other)" UBYTE SBW_STANDARD_S1_S3 1 100 0 3 DISPLAY_IDENTIFIER GatePos.MultAccess ECU_ADDRESS 0xFFF8A2AD /end MEASUREMENT
/begin MEASUREMENT MultAccess.DriveLogicOld "old value of DriveLogic" UBYTE SBW_STANDARD_S1_S3 1 100 0 2 DISPLAY_IDENTIFIER DriveLogicOld.MultAccess ECU_ADDRESS 0xFFF8A2AE /end MEASUREMENT
/begin MEASUREMENT MultAccess.DriveLogicTrig "drive logic rocker event (0=no action 1=Plus 2=Minus)" UBYTE SBW_STANDARD_S1_S3 1 100 0 2 DISPLAY_IDENTIFIER DriveLogicTrig.MultAccess ECU_ADDRESS 0xFFF8A2AF /end MEASUREMENT
/begin MEASUREMENT MultAccess.DriveLogic "drive logic rocker (0=no action 1=Plus 2=Minus)" UBYTE SBW_STANDARD_S1_S3 1 100 0 2 DISPLAY_IDENTIFIER DriveLogic.MultAccess ECU_ADDRESS 0xFFF8A2B0 /end MEASUREMENT
/begin MEASUREMENT MultAccess.st_EmfP_Old "Old value of st_EmfP" UBYTE SBW_STANDARD_S1_S3 1 100 0 2 DISPLAY_IDENTIFIER st_EmfP_Old.MultAccess ECU_ADDRESS 0xFFF8A2B1 /end MEASUREMENT
/begin MEASUREMENT MultAccess.st_EmfP_Trig "event for EMF-help call" UBYTE SBW_STANDARD_S1_S3 1 100 0 2 DISPLAY_IDENTIFIER st_EmfP_Trig.MultAccess ECU_ADDRESS 0xFFF8A2B2 /end MEASUREMENT
/begin MEASUREMENT MultAccess.cnt_SimOperations "counter to detect simultanious pressed buttons paddles etc" UBYTE SBW_STANDARD_S1_S3 1 100 0 4 DISPLAY_IDENTIFIER cnt_SimOperations.MultAccess ECU_ADDRESS 0xFFF8A2B3 /end MEASUREMENT
/begin MEASUREMENT Mode.tmr_ModeReturnTip1.time "test_timer" UWORD SBW_TIMER_10MS_S1_S3 1 100 0 655350 DISPLAY_IDENTIFIER time.tmr_ModeReturnTip1.Mode ECU_ADDRESS 0xFFF89FF0 /end MEASUREMENT
/begin MEASUREMENT Mode.tmr_ModeReturnTip1.f_IsExpired "test_timer" UBYTE SBW_STANDARD_S1_S3 1 100 0 255 DISPLAY_IDENTIFIER f_IsExpired.tmr_ModeReturnTip1.Mode ECU_ADDRESS 0xFFF89FF2 /end MEASUREMENT
/begin MEASUREMENT Mode.tmr_ModeReturnTip2.time "test_timer" UWORD SBW_TIMER_10MS_S1_S3 1 100 0 655350 DISPLAY_IDENTIFIER time.tmr_ModeReturnTip2.Mode ECU_ADDRESS 0xFFF89FF4 /end MEASUREMENT
/begin MEASUREMENT Mode.tmr_ModeReturnTip2.f_IsExpired "test_timer" UBYTE SBW_STANDARD_S1_S3 1 100 0 255 DISPLAY_IDENTIFIER f_IsExpired.tmr_ModeReturnTip2.Mode ECU_ADDRESS 0xFFF89FF6 /end MEASUREMENT
/begin MEASUREMENT Mode.tmr_TipPlusOn.time "test_timer" UBYTE SBW_TIMER_10MS_S1_S3 1 100 0 2550 DISPLAY_IDENTIFIER time.tmr_TipPlusOn.Mode ECU_ADDRESS 0xFFF89FF8 /end MEASUREMENT
/begin MEASUREMENT Mode.tmr_TipPlusOn.f_IsExpired "test_timer" UBYTE SBW_STANDARD_S1_S3 1 100 0 255 DISPLAY_IDENTIFIER f_IsExpired.tmr_TipPlusOn.Mode ECU_ADDRESS 0xFFF89FF9 /end MEASUREMENT
/begin MEASUREMENT Mode.tmr_TipMinusOn.time "test_timer" UBYTE SBW_TIMER_10MS_S1_S3 1 100 0 2550 DISPLAY_IDENTIFIER time.tmr_TipMinusOn.Mode ECU_ADDRESS 0xFFF89FFA /end MEASUREMENT
/begin MEASUREMENT Mode.tmr_TipMinusOn.f_IsExpired "test_timer" UBYTE SBW_STANDARD_S1_S3 1 100 0 255 DISPLAY_IDENTIFIER f_IsExpired.tmr_TipMinusOn.Mode ECU_ADDRESS 0xFFF89FFB /end MEASUREMENT
/begin MEASUREMENT DebounceDrvReq.tmr_DebounceDrvReq.time "test_timer" UBYTE SBW_TIMER_10MS_S1_S3 1 100 0 2550 DISPLAY_IDENTIFIER time.tmr_DebounceDrvReq.DebounceDrvReq ECU_ADDRESS 0xFFF8A2B4 /end MEASUREMENT
/begin MEASUREMENT DebounceDrvReq.tmr_DebounceDrvReq.f_IsExpired "test_timer" UBYTE SBW_STANDARD_S1_S3 1 100 0 255 DISPLAY_IDENTIFIER f_IsExpired.tmr_DebounceDrvReq.DebounceDrvReq ECU_ADDRESS 0xFFF8A2B5 /end MEASUREMENT
/begin MEASUREMENT DebounceDrvReq.DrvReqPRND_Filt "Driver Request after Debouncing" UBYTE SBW_STANDARD_S1_S3 1 100 0 8 DISPLAY_IDENTIFIER DrvReqPRND_Filt.DebounceDrvReq ECU_ADDRESS 0xFFF8A2B6 /end MEASUREMENT
/begin MEASUREMENT DebounceDrvReq.st_Debounce "0:NoDebounce 1:DebounceNA2N 2:DebounceRD2N 3:DebouncePN2R 4:DebounceN2R 5:DebounceP2R 6:DebounceP2N" UBYTE SBW_STANDARD_S1_S3 1 100 0 9 DISPLAY_IDENTIFIER st_Debounce.DebounceDrvReq ECU_ADDRESS 0xFFF8A2B7 /end MEASUREMENT
/begin MEASUREMENT DebounceDrvReq.f_AllowTimerCompute "flag to detect if tmr_DebounceDrvReq is allowed to compute" UBYTE SBW_STANDARD_S1_S3 1 100 0 1 BIT_MASK 0x1 DISPLAY_IDENTIFIER f_AllowTimerCompute.DebounceDrvReq ECU_ADDRESS 0xFFF8A2B8 /end MEASUREMENT
/begin MEASUREMENT DebounceDrvReq.f_StartOrResetOfDebounceOccured "if debounce started this flag prevents from being stopped in the same cycle" UBYTE SBW_STANDARD_S1_S3 1 100 0 1 BIT_MASK 0x1 DISPLAY_IDENTIFIER f_StartOrResetOfDebounceOccured.DebounceDrvReq ECU_ADDRESS 0xFFF8A2B9 /end MEASUREMENT
/begin MEASUREMENT DebounceDrvReq.LastValidDrvReqPRND_Raw "Last valid value of peak signal DrvReqPRND_Raw" UBYTE SBW_STANDARD_S1_S3 1 100 0 8 DISPLAY_IDENTIFIER LastValidDrvReqPRND_Raw.DebounceDrvReq ECU_ADDRESS 0xFFF8A2BA /end MEASUREMENT
/begin MEASUREMENT DebounceDrvReq.f_NoDebounceRD2N "error flag to prevent store of D/R -> N" UBYTE SBW_STANDARD_S1_S3 1 100 0 1 BIT_MASK 0x1 DISPLAY_IDENTIFIER f_NoDebounceRD2N.DebounceDrvReq ECU_ADDRESS 0xFFF8A2BB /end MEASUREMENT
/begin MEASUREMENT DebounceDrvReq.f_NoDebounceNA2N "error flag to prevent debounce of NA -> N" UBYTE SBW_STANDARD_S1_S3 1 100 0 1 BIT_MASK 0x1 DISPLAY_IDENTIFIER f_NoDebounceNA2N.DebounceDrvReq ECU_ADDRESS 0xFFF8A2BC /end MEASUREMENT
/begin MEASUREMENT StoreDrvReq.tmr_StorePRND.time "test_timer" UWORD SBW_TIMER_10MS_S1_S3 1 100 0 655350 DISPLAY_IDENTIFIER time.tmr_StorePRND.StoreDrvReq ECU_ADDRESS 0xFFF8A7A8 /end MEASUREMENT
/begin MEASUREMENT StoreDrvReq.tmr_StorePRND.f_IsExpired "test_timer" UBYTE SBW_STANDARD_S1_S3 1 100 0 255 DISPLAY_IDENTIFIER f_IsExpired.tmr_StorePRND.StoreDrvReq ECU_ADDRESS 0xFFF8A7AA /end MEASUREMENT
/begin MEASUREMENT StoreDrvReq.DrvReqPRND "Driver Request after Storing Position" UBYTE SBW_STANDARD_S1_S3 1 100 0 8 DISPLAY_IDENTIFIER DrvReqPRND.StoreDrvReq ECU_ADDRESS 0xFFF8A7AC /end MEASUREMENT
/begin MEASUREMENT StoreDrvReq.st_StorePRND "Stored position" UBYTE SBW_STANDARD_S1_S3 1 100 0 8 DISPLAY_IDENTIFIER st_StorePRND.StoreDrvReq ECU_ADDRESS 0xFFF8A7AD /end MEASUREMENT
/begin MEASUREMENT StoreDrvReq.f_StartRestartOrResetOfStorageOccured "if storage started this flag prevents from being stopped in the same cycle" UBYTE SBW_STANDARD_S1_S3 1 100 0 1 BIT_MASK 0x1 DISPLAY_IDENTIFIER f_StartRestartOrResetOfStorageOccured.StoreDrvReq ECU_ADDRESS 0xFFF8A7AE /end MEASUREMENT
/begin MEASUREMENT StoreDrvReq.DrvReqPRND_FiltPrev "Last Position of Driver Request after Debouncing" UBYTE SBW_STANDARD_S1_S3 1 100 0 8 DISPLAY_IDENTIFIER DrvReqPRND_FiltPrev.StoreDrvReq ECU_ADDRESS 0xFFF8A7AF /end MEASUREMENT
/begin MEASUREMENT StoreDrvReq.f_NoStoreP "error flag which prevents storage of P" UBYTE SBW_STANDARD_S1_S3 1 100 0 1 BIT_MASK 0x1 DISPLAY_IDENTIFIER f_NoStoreP.StoreDrvReq ECU_ADDRESS 0xFFF8A7B0 /end MEASUREMENT
/begin MEASUREMENT StoreDrvReq.f_NoStoreRD "error flag which prevents storage of R or D" UBYTE SBW_STANDARD_S1_S3 1 100 0 1 BIT_MASK 0x1 DISPLAY_IDENTIFIER f_NoStoreRD.StoreDrvReq ECU_ADDRESS 0xFFF8A7B1 /end MEASUREMENT
/begin MEASUREMENT StoreDrvReq.f_NoStoreN "error flag which prevents storage of N" UBYTE SBW_STANDARD_S1_S3 1 100 0 1 BIT_MASK 0x1 DISPLAY_IDENTIFIER f_NoStoreN.StoreDrvReq ECU_ADDRESS 0xFFF8A7B2 /end MEASUREMENT
/begin MEASUREMENT FASReq2Pos.tmr_PosDrvAssistFilt.time "test_timer" UBYTE SBW_TIMER_10MS_S1_S3 1 100 0 2550 DISPLAY_IDENTIFIER time.tmr_PosDrvAssistFilt.FASReq2Pos ECU_ADDRESS 0xFFF8A004 /end MEASUREMENT
/begin MEASUREMENT FASReq2Pos.tmr_PosDrvAssistFilt.f_IsExpired "test_timer" UBYTE SBW_STANDARD_S1_S3 1 100 0 255 DISPLAY_IDENTIFIER f_IsExpired.tmr_PosDrvAssistFilt.FASReq2Pos ECU_ADDRESS 0xFFF8A005 /end MEASUREMENT
/begin MEASUREMENT DiagPos.tmr_DebounceWrongDriveDir.time "test_timer" UBYTE SBW_TIMER_10MS_S1_S3 1 100 0 2550 DISPLAY_IDENTIFIER time.tmr_DebounceWrongDriveDir.DiagPos ECU_ADDRESS 0xFFF8A012 /end MEASUREMENT
/begin MEASUREMENT DiagPos.tmr_DebounceWrongDriveDir.f_IsExpired "test_timer" UBYTE SBW_STANDARD_S1_S3 1 100 0 255 DISPLAY_IDENTIFIER f_IsExpired.tmr_DebounceWrongDriveDir.DiagPos ECU_ADDRESS 0xFFF8A013 /end MEASUREMENT
/begin MEASUREMENT DiagPos.tmr_DebounceWrongDrvDirMinTime.time "test_timer" UBYTE SBW_TIMER_10MS_S1_S3 1 100 0 2550 DISPLAY_IDENTIFIER time.tmr_DebounceWrongDrvDirMinTime.DiagPos ECU_ADDRESS 0xFFF8A014 /end MEASUREMENT
/begin MEASUREMENT DiagPos.tmr_DebounceWrongDrvDirMinTime.f_IsExpired "test_timer" UBYTE SBW_STANDARD_S1_S3 1 100 0 255 DISPLAY_IDENTIFIER f_IsExpired.tmr_DebounceWrongDrvDirMinTime.DiagPos ECU_ADDRESS 0xFFF8A015 /end MEASUREMENT
/begin MEASUREMENT InitPosBPRAM.PosPRNDBuf "buffered PosPRND" UBYTE SBW_STANDARD_S1_S3 1 100 0 255 DISPLAY_IDENTIFIER PosPRNDBuf.InitPosBPRAM ECU_ADDRESS 0xFFF83AE8 /end MEASUREMENT
/begin MEASUREMENT InitPosBPRAM.PosPRNDBuf_ "Complement of buffered PosPRND" UBYTE SBW_STANDARD_S1_S3 1 100 0 255 DISPLAY_IDENTIFIER PosPRNDBuf_.InitPosBPRAM ECU_ADDRESS 0xFFF83AE9 /end MEASUREMENT
/begin MEASUREMENT InitPosBPRAM.PosPRND_4RzN_Buf "buffered PosPRND used by RzN" UBYTE SBW_STANDARD_S1_S3 1 100 0 255 DISPLAY_IDENTIFIER PosPRND_4RzN_Buf.InitPosBPRAM ECU_ADDRESS 0xFFF83AEA /end MEASUREMENT
/begin MEASUREMENT InitPosBPRAM.PosPRND_4RzN_Buf_ "Complement of buffered PosPRND used by RzN" UBYTE SBW_STANDARD_S1_S3 1 100 0 255 DISPLAY_IDENTIFIER PosPRND_4RzN_Buf_.InitPosBPRAM ECU_ADDRESS 0xFFF83AEB /end MEASUREMENT
/begin MEASUREMENT InitPosBPRAM.DirBuf "buffered driving direction [with grip/force transmission = Kraftschluss]" UBYTE SBW_STANDARD_S1_S3 1 100 0 255 DISPLAY_IDENTIFIER DirBuf.InitPosBPRAM ECU_ADDRESS 0xFFF83AEC /end MEASUREMENT
/begin MEASUREMENT InitPosBPRAM.DirBuf_ "Complement of buffered driving direction [with grip/force transmission = Kraftschluss]" UBYTE SBW_STANDARD_S1_S3 1 100 0 255 DISPLAY_IDENTIFIER DirBuf_.InitPosBPRAM ECU_ADDRESS 0xFFF83AED /end MEASUREMENT
/begin MEASUREMENT InitPosBPRAM.st_InverseCoasting "buffered inverse coasting" UBYTE SBW_STANDARD_S1_S3 1 100 0 255 DISPLAY_IDENTIFIER st_InverseCoasting.InitPosBPRAM ECU_ADDRESS 0xFFF83AEE /end MEASUREMENT
/begin MEASUREMENT InitPosBPRAM.st_InverseCoasting_ "Complement of buffered inverse coasting" UBYTE SBW_STANDARD_S1_S3 1 100 0 255 DISPLAY_IDENTIFIER st_InverseCoasting_.InitPosBPRAM ECU_ADDRESS 0xFFF83AEF /end MEASUREMENT
/begin MEASUREMENT InitPosBPRAM.f_MechLimpBuf "buffered flag f_MechLimp" UBYTE SBW_STANDARD_S1_S3 1 100 0 1 BIT_MASK 0x1 DISPLAY_IDENTIFIER f_MechLimpBuf.InitPosBPRAM ECU_ADDRESS 0xFFF83AF0 /end MEASUREMENT
/begin MEASUREMENT InitPosBPRAM.f_MechLimpBuf_ "Complement of buffered flag f_MechLimp" UBYTE SBW_STANDARD_S1_S3 1 100 0 255 DISPLAY_IDENTIFIER f_MechLimpBuf_.InitPosBPRAM ECU_ADDRESS 0xFFF83AF1 /end MEASUREMENT
/begin MEASUREMENT InitPos.f_ResUBatt "flag for recognition of resets in case of undervoltage" UBYTE SBW_STANDARD_S1_S3 1 100 0 1 BIT_MASK 0x1 DISPLAY_IDENTIFIER f_ResUBatt.InitPos ECU_ADDRESS 0xFFF8A2BD /end MEASUREMENT
/begin MEASUREMENT KombiMsg.tmr_P12BadOpDisp.time "test_timer" UWORD SBW_TIMER_10MS_S1_S3 1 100 0 655350 DISPLAY_IDENTIFIER time.tmr_P12BadOpDisp.KombiMsg ECU_ADDRESS 0xFFF8A020 /end MEASUREMENT
/begin MEASUREMENT KombiMsg.tmr_P12BadOpDisp.f_IsExpired "test_timer" UBYTE SBW_STANDARD_S1_S3 1 100 0 255 DISPLAY_IDENTIFIER f_IsExpired.tmr_P12BadOpDisp.KombiMsg ECU_ADDRESS 0xFFF8A022 /end MEASUREMENT
/begin MEASUREMENT KombiMsg.tmr_IgnOnNeverDetected.time "test_timer" UBYTE SBW_TIMER_10MS_S1_S3 1 100 0 2550 DISPLAY_IDENTIFIER time.tmr_IgnOnNeverDetected.KombiMsg ECU_ADDRESS 0xFFF8A024 /end MEASUREMENT
/begin MEASUREMENT KombiMsg.tmr_IgnOnNeverDetected.f_IsExpired "test_timer" UBYTE SBW_STANDARD_S1_S3 1 100 0 255 DISPLAY_IDENTIFIER f_IsExpired.tmr_IgnOnNeverDetected.KombiMsg ECU_ADDRESS 0xFFF8A025 /end MEASUREMENT
/begin MEASUREMENT KombiMsg.f_IgnOnNeverDetected "flag to detect state 'STDBY before CRUISE' - is default set true by Ctor. - reset in eshift-code" UBYTE SBW_STANDARD_S1_S3 1 100 0 1 BIT_MASK 0x1 DISPLAY_IDENTIFIER f_IgnOnNeverDetected.KombiMsg ECU_ADDRESS 0xFFF8A026 /end MEASUREMENT
/begin MEASUREMENT KombiMsg.f_StandbyBeforeCruise "flag to indicate state standby before cruise" UBYTE SBW_STANDARD_S1_S3 1 100 0 1 BIT_MASK 0x1 DISPLAY_IDENTIFIER f_StandbyBeforeCruise.KombiMsg ECU_ADDRESS 0xFFF8A027 /end MEASUREMENT
/begin MEASUREMENT KombiMsg.f_FlashPosBadOp "flag to request flashing due to bad operation of park button (tmr_P12BadOpDisp > 0)" UBYTE SBW_STANDARD_S1_S3 1 100 0 1 BIT_MASK 0x1 DISPLAY_IDENTIFIER f_FlashPosBadOp.KombiMsg ECU_ADDRESS 0xFFF8A028 /end MEASUREMENT
/begin MEASUREMENT KombiMsg.f_freezeDisplayPReq "flag to indicate request shift to P - freeze mode; gear; pos until P engaged" UBYTE SBW_STANDARD_S1_S3 1 100 0 1 BIT_MASK 0x1 DISPLAY_IDENTIFIER f_freezeDisplayPReq.KombiMsg ECU_ADDRESS 0xFFF8A029 /end MEASUREMENT
/begin MEASUREMENT KombiMsgPos.DisplayPos "SBW-internal display position (same coding as PosPRND: P=8 R=7 N=6 D=5 noaction=0)" UBYTE SBW_STANDARD_S1_S3 1 100 0 8 DISPLAY_IDENTIFIER DisplayPos.KombiMsgPos ECU_ADDRESS 0xFFF8A810 /end MEASUREMENT
/begin MEASUREMENT KombiMsgPos.DisplayPos_ "SBW-internal display position complement" UBYTE SBW_STANDARD_S1_S3 1 100 248 255 DISPLAY_IDENTIFIER DisplayPos_.KombiMsgPos ECU_ADDRESS 0xFFF8A811 /end MEASUREMENT
/begin MEASUREMENT KombiMsgPos.DisplayPosFlash "SBW-internal flashing display position (coding: C_FlashON=1; C_FlashOFF=0; C_FlashInvalid=3;)" UBYTE SBW_STANDARD_S1_S3 1 100 0 3 DISPLAY_IDENTIFIER DisplayPosFlash.KombiMsgPos ECU_ADDRESS 0xFFF8A812 /end MEASUREMENT
/begin MEASUREMENT KombiMsgPos.DisplayPosRule "Diagnose Value for checking by which Display Position Rule value was given" UBYTE SBW_STANDARD_S1_S3 1 100 0 71 DISPLAY_IDENTIFIER DisplayPosRule.KombiMsgPos ECU_ADDRESS 0xFFF8A813 /end MEASUREMENT
/begin MEASUREMENT KombiMsgMode.SelectedDispMode "interim value for selected mode dependent on SWI_DispMode" UBYTE SBW_STANDARD_S1_S3 1 100 0 255 DISPLAY_IDENTIFIER SelectedDispMode.KombiMsgMode ECU_ADDRESS 0xFFF8A02A /end MEASUREMENT
/begin MEASUREMENT KombiMsgMode.DisplayMode "SBW-internal mode displayed on kombi (coding: C_ModeAdaptive=0; C_ModeSport=1; C_ModeManual=2; C_ModeManualSport=3 or further byte-codings if unfiltered mode from FS)" UBYTE SBW_STANDARD_S1_S3 1 100 0 255 DISPLAY_IDENTIFIER DisplayMode.KombiMsgMode ECU_ADDRESS 0xFFF8A02B /end MEASUREMENT
/begin MEASUREMENT KombiMsgGear.DisplayGear "SBW-internal display gear (coding: 1st gear=1 ... 6th gear=6 (7th=7)(8th=8) 0=dark (also r-gear=dark)" UBYTE SBW_STANDARD_S1_S3 1 100 0 8 DISPLAY_IDENTIFIER DisplayGear.KombiMsgGear ECU_ADDRESS 0xFFF8A2C6 /end MEASUREMENT
/begin MEASUREMENT KombiMsgFlash.tmr_FlashNInWrongDrvDir.time "test_timer" UWORD SBW_TIMER_10MS_S1_S3 1 100 0 655350 DISPLAY_IDENTIFIER time.tmr_FlashNInWrongDrvDir.KombiMsgFlash ECU_ADDRESS 0xFFF8A02C /end MEASUREMENT
/begin MEASUREMENT KombiMsgFlash.tmr_FlashNInWrongDrvDir.f_IsExpired "test_timer" UBYTE SBW_STANDARD_S1_S3 1 100 0 255 DISPLAY_IDENTIFIER f_IsExpired.tmr_FlashNInWrongDrvDir.KombiMsgFlash ECU_ADDRESS 0xFFF8A02E /end MEASUREMENT
/begin MEASUREMENT KombiMsgFlash.st_KombiPosFlash "Status of Kombi display for flashing position" UBYTE SBW_STANDARD_S1_S3 1 100 0 8 DISPLAY_IDENTIFIER st_KombiPosFlash.KombiMsgFlash ECU_ADDRESS 0xFFF8A030 /end MEASUREMENT
/begin MEASUREMENT KombiMsgFlash.f_CC_PL_Fault "Flag for CC-Message: 175" UBYTE SBW_STANDARD_S1_S3 1 100 0 1 BIT_MASK 0x1 DISPLAY_IDENTIFIER f_CC_PL_Fault.KombiMsgFlash ECU_ADDRESS 0xFFF8A031 /end MEASUREMENT
/begin MEASUREMENT PowerDown.tmr_PowDownDelay.time "test_timer" UWORD SBW_TIMER_10MS_S1_S3 1 100 0 655350 DISPLAY_IDENTIFIER time.tmr_PowDownDelay.PowerDown ECU_ADDRESS 0xFFF8A032 /end MEASUREMENT
/begin MEASUREMENT PowerDown.tmr_PowDownDelay.f_IsExpired "test_timer" UBYTE SBW_STANDARD_S1_S3 1 100 0 255 DISPLAY_IDENTIFIER f_IsExpired.tmr_PowDownDelay.PowerDown ECU_ADDRESS 0xFFF8A034 /end MEASUREMENT
/begin MEASUREMENT SrvcMsgHandler.tmr_MSA_MsgCyclicSend.time "test_timer" UBYTE SBW_TIMER_10MS_S1_S3 1 100 0 2550 DISPLAY_IDENTIFIER time.tmr_MSA_MsgCyclicSend.SrvcMsgHandler ECU_ADDRESS 0xFFF8A824 /end MEASUREMENT
/begin MEASUREMENT SrvcMsgHandler.tmr_MSA_MsgCyclicSend.f_IsExpired "test_timer" UBYTE SBW_STANDARD_S1_S3 1 100 0 255 DISPLAY_IDENTIFIER f_IsExpired.tmr_MSA_MsgCyclicSend.SrvcMsgHandler ECU_ADDRESS 0xFFF8A825 /end MEASUREMENT
/begin MEASUREMENT SrvcMsgHandler.tmr_MSA_MsgDebouncing.time "test_timer" UBYTE SBW_TIMER_10MS_S1_S3 1 100 0 2550 DISPLAY_IDENTIFIER time.tmr_MSA_MsgDebouncing.SrvcMsgHandler ECU_ADDRESS 0xFFF8A826 /end MEASUREMENT
/begin MEASUREMENT SrvcMsgHandler.tmr_MSA_MsgDebouncing.f_IsExpired "test_timer" UBYTE SBW_STANDARD_S1_S3 1 100 0 255 DISPLAY_IDENTIFIER f_IsExpired.tmr_MSA_MsgDebouncing.SrvcMsgHandler ECU_ADDRESS 0xFFF8A827 /end MEASUREMENT
/begin MEASUREMENT SrvcMsgHandler.tmr_MSA_MsgWaitResend.time "test_timer" UBYTE SBW_TIMER_10MS_S1_S3 1 100 0 2550 DISPLAY_IDENTIFIER time.tmr_MSA_MsgWaitResend.SrvcMsgHandler ECU_ADDRESS 0xFFF8A828 /end MEASUREMENT
/begin MEASUREMENT SrvcMsgHandler.tmr_MSA_MsgWaitResend.f_IsExpired "test_timer" UBYTE SBW_STANDARD_S1_S3 1 100 0 255 DISPLAY_IDENTIFIER f_IsExpired.tmr_MSA_MsgWaitResend.SrvcMsgHandler ECU_ADDRESS 0xFFF8A829 /end MEASUREMENT
/begin MEASUREMENT SrvcMsgHandler.tmr_last_sending_100ms_ago.time "test_timer" UBYTE SBW_TIMER_10MS_S1_S3 1 100 0 2550 DISPLAY_IDENTIFIER time.tmr_last_sending_100ms_ago.SrvcMsgHandler ECU_ADDRESS 0xFFF8A82A /end MEASUREMENT
/begin MEASUREMENT SrvcMsgHandler.tmr_last_sending_100ms_ago.f_IsExpired "test_timer" UBYTE SBW_STANDARD_S1_S3 1 100 0 255 DISPLAY_IDENTIFIER f_IsExpired.tmr_last_sending_100ms_ago.SrvcMsgHandler ECU_ADDRESS 0xFFF8A82B /end MEASUREMENT
/begin MEASUREMENT CCMsg.ID_Hotmode1.cCC_ID._.tmr_ID_delay.time "test_timer" UWORD SBW_TIMER_10MS_S1_S3 1 100 0 655350 DISPLAY_IDENTIFIER time.tmr_ID_delay._.cCC_ID.ID_Hotmode1.CCMsg ECU_ADDRESS 0xFFF8A83A /end MEASUREMENT
/begin MEASUREMENT CCMsg.ID_Hotmode1.cCC_ID._.tmr_ID_delay.f_IsExpired "test_timer" UBYTE SBW_STANDARD_S1_S3 1 100 0 255 DISPLAY_IDENTIFIER f_IsExpired.tmr_ID_delay._.cCC_ID.ID_Hotmode1.CCMsg ECU_ADDRESS 0xFFF8A83C /end MEASUREMENT
/begin MEASUREMENT CCMsg.ID_Hotmode1.cCC_ID._.tmr_ID_CycleTime.time "test_timer" UWORD SBW_TIMER_10MS_S1_S3 1 100 0 655350 DISPLAY_IDENTIFIER time.tmr_ID_CycleTime._.cCC_ID.ID_Hotmode1.CCMsg ECU_ADDRESS 0xFFF8A83E /end MEASUREMENT
/begin MEASUREMENT CCMsg.ID_Hotmode1.cCC_ID._.tmr_ID_CycleTime.f_IsExpired "test_timer" UBYTE SBW_STANDARD_S1_S3 1 100 0 255 DISPLAY_IDENTIFIER f_IsExpired.tmr_ID_CycleTime._.cCC_ID.ID_Hotmode1.CCMsg ECU_ADDRESS 0xFFF8A840 /end MEASUREMENT
/begin MEASUREMENT CCMsg.ID_Hotmode1.cCC_ID._.tmr_ID_MinTime.time "test_timer" UWORD SBW_TIMER_10MS_S1_S3 1 100 0 655350 DISPLAY_IDENTIFIER time.tmr_ID_MinTime._.cCC_ID.ID_Hotmode1.CCMsg ECU_ADDRESS 0xFFF8A842 /end MEASUREMENT
/begin MEASUREMENT CCMsg.ID_Hotmode1.cCC_ID._.tmr_ID_MinTime.f_IsExpired "test_timer" UBYTE SBW_STANDARD_S1_S3 1 100 0 255 DISPLAY_IDENTIFIER f_IsExpired.tmr_ID_MinTime._.cCC_ID.ID_Hotmode1.CCMsg ECU_ADDRESS 0xFFF8A844 /end MEASUREMENT
/begin MEASUREMENT CCMsg.ID_Hotmode1.cCC_ID._.tmr_ID_HoldCC.time "test_timer" UWORD SBW_TIMER_10MS_S1_S3 1 100 0 655350 DISPLAY_IDENTIFIER time.tmr_ID_HoldCC._.cCC_ID.ID_Hotmode1.CCMsg ECU_ADDRESS 0xFFF8A846 /end MEASUREMENT
/begin MEASUREMENT CCMsg.ID_Hotmode1.cCC_ID._.tmr_ID_HoldCC.f_IsExpired "test_timer" UBYTE SBW_STANDARD_S1_S3 1 100 0 255 DISPLAY_IDENTIFIER f_IsExpired.tmr_ID_HoldCC._.cCC_ID.ID_Hotmode1.CCMsg ECU_ADDRESS 0xFFF8A848 /end MEASUREMENT
/begin MEASUREMENT CCMsg.ID_Hotmode3.cCC_ID._.tmr_ID_delay.time "test_timer" UWORD SBW_TIMER_10MS_S1_S3 1 100 0 655350 DISPLAY_IDENTIFIER time.tmr_ID_delay._.cCC_ID.ID_Hotmode3.CCMsg ECU_ADDRESS 0xFFF8A85A /end MEASUREMENT
/begin MEASUREMENT CCMsg.ID_Hotmode3.cCC_ID._.tmr_ID_delay.f_IsExpired "test_timer" UBYTE SBW_STANDARD_S1_S3 1 100 0 255 DISPLAY_IDENTIFIER f_IsExpired.tmr_ID_delay._.cCC_ID.ID_Hotmode3.CCMsg ECU_ADDRESS 0xFFF8A85C /end MEASUREMENT
/begin MEASUREMENT CCMsg.ID_Hotmode3.cCC_ID._.tmr_ID_CycleTime.time "test_timer" UWORD SBW_TIMER_10MS_S1_S3 1 100 0 655350 DISPLAY_IDENTIFIER time.tmr_ID_CycleTime._.cCC_ID.ID_Hotmode3.CCMsg ECU_ADDRESS 0xFFF8A85E /end MEASUREMENT
/begin MEASUREMENT CCMsg.ID_Hotmode3.cCC_ID._.tmr_ID_CycleTime.f_IsExpired "test_timer" UBYTE SBW_STANDARD_S1_S3 1 100 0 255 DISPLAY_IDENTIFIER f_IsExpired.tmr_ID_CycleTime._.cCC_ID.ID_Hotmode3.CCMsg ECU_ADDRESS 0xFFF8A860 /end MEASUREMENT
/begin MEASUREMENT CCMsg.ID_Hotmode3.cCC_ID._.tmr_ID_MinTime.time "test_timer" UWORD SBW_TIMER_10MS_S1_S3 1 100 0 655350 DISPLAY_IDENTIFIER time.tmr_ID_MinTime._.cCC_ID.ID_Hotmode3.CCMsg ECU_ADDRESS 0xFFF8A862 /end MEASUREMENT
/begin MEASUREMENT CCMsg.ID_Hotmode3.cCC_ID._.tmr_ID_MinTime.f_IsExpired "test_timer" UBYTE SBW_STANDARD_S1_S3 1 100 0 255 DISPLAY_IDENTIFIER f_IsExpired.tmr_ID_MinTime._.cCC_ID.ID_Hotmode3.CCMsg ECU_ADDRESS 0xFFF8A864 /end MEASUREMENT
/begin MEASUREMENT CCMsg.ID_Hotmode3.cCC_ID._.tmr_ID_HoldCC.time "test_timer" UWORD SBW_TIMER_10MS_S1_S3 1 100 0 655350 DISPLAY_IDENTIFIER time.tmr_ID_HoldCC._.cCC_ID.ID_Hotmode3.CCMsg ECU_ADDRESS 0xFFF8A866 /end MEASUREMENT
/begin MEASUREMENT CCMsg.ID_Hotmode3.cCC_ID._.tmr_ID_HoldCC.f_IsExpired "test_timer" UBYTE SBW_STANDARD_S1_S3 1 100 0 255 DISPLAY_IDENTIFIER f_IsExpired.tmr_ID_HoldCC._.cCC_ID.ID_Hotmode3.CCMsg ECU_ADDRESS 0xFFF8A868 /end MEASUREMENT
/begin MEASUREMENT CCMsg.ID_MechLimpInP.cCC_ID._.tmr_ID_delay.time "test_timer" UWORD SBW_TIMER_10MS_S1_S3 1 100 0 655350 DISPLAY_IDENTIFIER time.tmr_ID_delay._.cCC_ID.ID_MechLimpInP.CCMsg ECU_ADDRESS 0xFFF8A87A /end MEASUREMENT
/begin MEASUREMENT CCMsg.ID_MechLimpInP.cCC_ID._.tmr_ID_delay.f_IsExpired "test_timer" UBYTE SBW_STANDARD_S1_S3 1 100 0 255 DISPLAY_IDENTIFIER f_IsExpired.tmr_ID_delay._.cCC_ID.ID_MechLimpInP.CCMsg ECU_ADDRESS 0xFFF8A87C /end MEASUREMENT
/begin MEASUREMENT CCMsg.ID_MechLimpInP.cCC_ID._.tmr_ID_CycleTime.time "test_timer" UWORD SBW_TIMER_10MS_S1_S3 1 100 0 655350 DISPLAY_IDENTIFIER time.tmr_ID_CycleTime._.cCC_ID.ID_MechLimpInP.CCMsg ECU_ADDRESS 0xFFF8A87E /end MEASUREMENT
/begin MEASUREMENT CCMsg.ID_MechLimpInP.cCC_ID._.tmr_ID_CycleTime.f_IsExpired "test_timer" UBYTE SBW_STANDARD_S1_S3 1 100 0 255 DISPLAY_IDENTIFIER f_IsExpired.tmr_ID_CycleTime._.cCC_ID.ID_MechLimpInP.CCMsg ECU_ADDRESS 0xFFF8A880 /end MEASUREMENT
/begin MEASUREMENT CCMsg.ID_MechLimpInP.cCC_ID._.tmr_ID_MinTime.time "test_timer" UWORD SBW_TIMER_10MS_S1_S3 1 100 0 655350 DISPLAY_IDENTIFIER time.tmr_ID_MinTime._.cCC_ID.ID_MechLimpInP.CCMsg ECU_ADDRESS 0xFFF8A882 /end MEASUREMENT
/begin MEASUREMENT CCMsg.ID_MechLimpInP.cCC_ID._.tmr_ID_MinTime.f_IsExpired "test_timer" UBYTE SBW_STANDARD_S1_S3 1 100 0 255 DISPLAY_IDENTIFIER f_IsExpired.tmr_ID_MinTime._.cCC_ID.ID_MechLimpInP.CCMsg ECU_ADDRESS 0xFFF8A884 /end MEASUREMENT
/begin MEASUREMENT CCMsg.ID_MechLimpInP.cCC_ID._.tmr_ID_HoldCC.time "test_timer" UWORD SBW_TIMER_10MS_S1_S3 1 100 0 655350 DISPLAY_IDENTIFIER time.tmr_ID_HoldCC._.cCC_ID.ID_MechLimpInP.CCMsg ECU_ADDRESS 0xFFF8A886 /end MEASUREMENT
/begin MEASUREMENT CCMsg.ID_MechLimpInP.cCC_ID._.tmr_ID_HoldCC.f_IsExpired "test_timer" UBYTE SBW_STANDARD_S1_S3 1 100 0 255 DISPLAY_IDENTIFIER f_IsExpired.tmr_ID_HoldCC._.cCC_ID.ID_MechLimpInP.CCMsg ECU_ADDRESS 0xFFF8A888 /end MEASUREMENT
/begin MEASUREMENT CCMsg.ID_MechLimpInPNoRD.cCC_ID._.tmr_ID_delay.time "test_timer" UWORD SBW_TIMER_10MS_S1_S3 1 100 0 655350 DISPLAY_IDENTIFIER time.tmr_ID_delay._.cCC_ID.ID_MechLimpInPNoRD.CCMsg ECU_ADDRESS 0xFFF8A89A /end MEASUREMENT
/begin MEASUREMENT CCMsg.ID_MechLimpInPNoRD.cCC_ID._.tmr_ID_delay.f_IsExpired "test_timer" UBYTE SBW_STANDARD_S1_S3 1 100 0 255 DISPLAY_IDENTIFIER f_IsExpired.tmr_ID_delay._.cCC_ID.ID_MechLimpInPNoRD.CCMsg ECU_ADDRESS 0xFFF8A89C /end MEASUREMENT
/begin MEASUREMENT CCMsg.ID_MechLimpInPNoRD.cCC_ID._.tmr_ID_CycleTime.time "test_timer" UWORD SBW_TIMER_10MS_S1_S3 1 100 0 655350 DISPLAY_IDENTIFIER time.tmr_ID_CycleTime._.cCC_ID.ID_MechLimpInPNoRD.CCMsg ECU_ADDRESS 0xFFF8A89E /end MEASUREMENT
/begin MEASUREMENT CCMsg.ID_MechLimpInPNoRD.cCC_ID._.tmr_ID_CycleTime.f_IsExpired "test_timer" UBYTE SBW_STANDARD_S1_S3 1 100 0 255 DISPLAY_IDENTIFIER f_IsExpired.tmr_ID_CycleTime._.cCC_ID.ID_MechLimpInPNoRD.CCMsg ECU_ADDRESS 0xFFF8A8A0 /end MEASUREMENT
/begin MEASUREMENT CCMsg.ID_MechLimpInPNoRD.cCC_ID._.tmr_ID_MinTime.time "test_timer" UWORD SBW_TIMER_10MS_S1_S3 1 100 0 655350 DISPLAY_IDENTIFIER time.tmr_ID_MinTime._.cCC_ID.ID_MechLimpInPNoRD.CCMsg ECU_ADDRESS 0xFFF8A8A2 /end MEASUREMENT
/begin MEASUREMENT CCMsg.ID_MechLimpInPNoRD.cCC_ID._.tmr_ID_MinTime.f_IsExpired "test_timer" UBYTE SBW_STANDARD_S1_S3 1 100 0 255 DISPLAY_IDENTIFIER f_IsExpired.tmr_ID_MinTime._.cCC_ID.ID_MechLimpInPNoRD.CCMsg ECU_ADDRESS 0xFFF8A8A4 /end MEASUREMENT
/begin MEASUREMENT CCMsg.ID_MechLimpInPNoRD.cCC_ID._.tmr_ID_HoldCC.time "test_timer" UWORD SBW_TIMER_10MS_S1_S3 1 100 0 655350 DISPLAY_IDENTIFIER time.tmr_ID_HoldCC._.cCC_ID.ID_MechLimpInPNoRD.CCMsg ECU_ADDRESS 0xFFF8A8A6 /end MEASUREMENT
/begin MEASUREMENT CCMsg.ID_MechLimpInPNoRD.cCC_ID._.tmr_ID_HoldCC.f_IsExpired "test_timer" UBYTE SBW_STANDARD_S1_S3 1 100 0 255 DISPLAY_IDENTIFIER f_IsExpired.tmr_ID_HoldCC._.cCC_ID.ID_MechLimpInPNoRD.CCMsg ECU_ADDRESS 0xFFF8A8A8 /end MEASUREMENT
/begin MEASUREMENT CCMsg.ID_MechLimpInD.cCC_ID._.tmr_ID_delay.time "test_timer" UWORD SBW_TIMER_10MS_S1_S3 1 100 0 655350 DISPLAY_IDENTIFIER time.tmr_ID_delay._.cCC_ID.ID_MechLimpInD.CCMsg ECU_ADDRESS 0xFFF8A8BA /end MEASUREMENT
/begin MEASUREMENT CCMsg.ID_MechLimpInD.cCC_ID._.tmr_ID_delay.f_IsExpired "test_timer" UBYTE SBW_STANDARD_S1_S3 1 100 0 255 DISPLAY_IDENTIFIER f_IsExpired.tmr_ID_delay._.cCC_ID.ID_MechLimpInD.CCMsg ECU_ADDRESS 0xFFF8A8BC /end MEASUREMENT
/begin MEASUREMENT CCMsg.ID_MechLimpInD.cCC_ID._.tmr_ID_CycleTime.time "test_timer" UWORD SBW_TIMER_10MS_S1_S3 1 100 0 655350 DISPLAY_IDENTIFIER time.tmr_ID_CycleTime._.cCC_ID.ID_MechLimpInD.CCMsg ECU_ADDRESS 0xFFF8A8BE /end MEASUREMENT
/begin MEASUREMENT CCMsg.ID_MechLimpInD.cCC_ID._.tmr_ID_CycleTime.f_IsExpired "test_timer" UBYTE SBW_STANDARD_S1_S3 1 100 0 255 DISPLAY_IDENTIFIER f_IsExpired.tmr_ID_CycleTime._.cCC_ID.ID_MechLimpInD.CCMsg ECU_ADDRESS 0xFFF8A8C0 /end MEASUREMENT
/begin MEASUREMENT CCMsg.ID_MechLimpInD.cCC_ID._.tmr_ID_MinTime.time "test_timer" UWORD SBW_TIMER_10MS_S1_S3 1 100 0 655350 DISPLAY_IDENTIFIER time.tmr_ID_MinTime._.cCC_ID.ID_MechLimpInD.CCMsg ECU_ADDRESS 0xFFF8A8C2 /end MEASUREMENT
/begin MEASUREMENT CCMsg.ID_MechLimpInD.cCC_ID._.tmr_ID_MinTime.f_IsExpired "test_timer" UBYTE SBW_STANDARD_S1_S3 1 100 0 255 DISPLAY_IDENTIFIER f_IsExpired.tmr_ID_MinTime._.cCC_ID.ID_MechLimpInD.CCMsg ECU_ADDRESS 0xFFF8A8C4 /end MEASUREMENT
/begin MEASUREMENT CCMsg.ID_MechLimpInD.cCC_ID._.tmr_ID_HoldCC.time "test_timer" UWORD SBW_TIMER_10MS_S1_S3 1 100 0 655350 DISPLAY_IDENTIFIER time.tmr_ID_HoldCC._.cCC_ID.ID_MechLimpInD.CCMsg ECU_ADDRESS 0xFFF8A8C6 /end MEASUREMENT
/begin MEASUREMENT CCMsg.ID_MechLimpInD.cCC_ID._.tmr_ID_HoldCC.f_IsExpired "test_timer" UBYTE SBW_STANDARD_S1_S3 1 100 0 255 DISPLAY_IDENTIFIER f_IsExpired.tmr_ID_HoldCC._.cCC_ID.ID_MechLimpInD.CCMsg ECU_ADDRESS 0xFFF8A8C8 /end MEASUREMENT
/begin MEASUREMENT CCMsg.ID_Speed2HighForDrvReqP.cCC_ID._.tmr_ID_delay.time "test_timer" UWORD SBW_TIMER_10MS_S1_S3 1 100 0 655350 DISPLAY_IDENTIFIER time.tmr_ID_delay._.cCC_ID.ID_Speed2HighForDrvReqP.CCMsg ECU_ADDRESS 0xFFF8A8DA /end MEASUREMENT
/begin MEASUREMENT CCMsg.ID_Speed2HighForDrvReqP.cCC_ID._.tmr_ID_delay.f_IsExpired "test_timer" UBYTE SBW_STANDARD_S1_S3 1 100 0 255 DISPLAY_IDENTIFIER f_IsExpired.tmr_ID_delay._.cCC_ID.ID_Speed2HighForDrvReqP.CCMsg ECU_ADDRESS 0xFFF8A8DC /end MEASUREMENT
/begin MEASUREMENT CCMsg.ID_Speed2HighForDrvReqP.cCC_ID._.tmr_ID_CycleTime.time "test_timer" UWORD SBW_TIMER_10MS_S1_S3 1 100 0 655350 DISPLAY_IDENTIFIER time.tmr_ID_CycleTime._.cCC_ID.ID_Speed2HighForDrvReqP.CCMsg ECU_ADDRESS 0xFFF8A8DE /end MEASUREMENT
/begin MEASUREMENT CCMsg.ID_Speed2HighForDrvReqP.cCC_ID._.tmr_ID_CycleTime.f_IsExpired "test_timer" UBYTE SBW_STANDARD_S1_S3 1 100 0 255 DISPLAY_IDENTIFIER f_IsExpired.tmr_ID_CycleTime._.cCC_ID.ID_Speed2HighForDrvReqP.CCMsg ECU_ADDRESS 0xFFF8A8E0 /end MEASUREMENT
/begin MEASUREMENT CCMsg.ID_Speed2HighForDrvReqP.cCC_ID._.tmr_ID_MinTime.time "test_timer" UWORD SBW_TIMER_10MS_S1_S3 1 100 0 655350 DISPLAY_IDENTIFIER time.tmr_ID_MinTime._.cCC_ID.ID_Speed2HighForDrvReqP.CCMsg ECU_ADDRESS 0xFFF8A8E2 /end MEASUREMENT
/begin MEASUREMENT CCMsg.ID_Speed2HighForDrvReqP.cCC_ID._.tmr_ID_MinTime.f_IsExpired "test_timer" UBYTE SBW_STANDARD_S1_S3 1 100 0 255 DISPLAY_IDENTIFIER f_IsExpired.tmr_ID_MinTime._.cCC_ID.ID_Speed2HighForDrvReqP.CCMsg ECU_ADDRESS 0xFFF8A8E4 /end MEASUREMENT
/begin MEASUREMENT CCMsg.ID_Speed2HighForDrvReqP.cCC_ID._.tmr_ID_HoldCC.time "test_timer" UWORD SBW_TIMER_10MS_S1_S3 1 100 0 655350 DISPLAY_IDENTIFIER time.tmr_ID_HoldCC._.cCC_ID.ID_Speed2HighForDrvReqP.CCMsg ECU_ADDRESS 0xFFF8A8E6 /end MEASUREMENT
/begin MEASUREMENT CCMsg.ID_Speed2HighForDrvReqP.cCC_ID._.tmr_ID_HoldCC.f_IsExpired "test_timer" UBYTE SBW_STANDARD_S1_S3 1 100 0 255 DISPLAY_IDENTIFIER f_IsExpired.tmr_ID_HoldCC._.cCC_ID.ID_Speed2HighForDrvReqP.CCMsg ECU_ADDRESS 0xFFF8A8E8 /end MEASUREMENT
/begin MEASUREMENT CCMsg.ID_Speed2HighInPosP.cCC_ID._.tmr_ID_delay.time "test_timer" UWORD SBW_TIMER_10MS_S1_S3 1 100 0 655350 DISPLAY_IDENTIFIER time.tmr_ID_delay._.cCC_ID.ID_Speed2HighInPosP.CCMsg ECU_ADDRESS 0xFFF8A8FA /end MEASUREMENT
/begin MEASUREMENT CCMsg.ID_Speed2HighInPosP.cCC_ID._.tmr_ID_delay.f_IsExpired "test_timer" UBYTE SBW_STANDARD_S1_S3 1 100 0 255 DISPLAY_IDENTIFIER f_IsExpired.tmr_ID_delay._.cCC_ID.ID_Speed2HighInPosP.CCMsg ECU_ADDRESS 0xFFF8A8FC /end MEASUREMENT
/begin MEASUREMENT CCMsg.ID_Speed2HighInPosP.cCC_ID._.tmr_ID_CycleTime.time "test_timer" UWORD SBW_TIMER_10MS_S1_S3 1 100 0 655350 DISPLAY_IDENTIFIER time.tmr_ID_CycleTime._.cCC_ID.ID_Speed2HighInPosP.CCMsg ECU_ADDRESS 0xFFF8A8FE /end MEASUREMENT
/begin MEASUREMENT CCMsg.ID_Speed2HighInPosP.cCC_ID._.tmr_ID_CycleTime.f_IsExpired "test_timer" UBYTE SBW_STANDARD_S1_S3 1 100 0 255 DISPLAY_IDENTIFIER f_IsExpired.tmr_ID_CycleTime._.cCC_ID.ID_Speed2HighInPosP.CCMsg ECU_ADDRESS 0xFFF8A900 /end MEASUREMENT
/begin MEASUREMENT CCMsg.ID_Speed2HighInPosP.cCC_ID._.tmr_ID_MinTime.time "test_timer" UWORD SBW_TIMER_10MS_S1_S3 1 100 0 655350 DISPLAY_IDENTIFIER time.tmr_ID_MinTime._.cCC_ID.ID_Speed2HighInPosP.CCMsg ECU_ADDRESS 0xFFF8A902 /end MEASUREMENT
/begin MEASUREMENT CCMsg.ID_Speed2HighInPosP.cCC_ID._.tmr_ID_MinTime.f_IsExpired "test_timer" UBYTE SBW_STANDARD_S1_S3 1 100 0 255 DISPLAY_IDENTIFIER f_IsExpired.tmr_ID_MinTime._.cCC_ID.ID_Speed2HighInPosP.CCMsg ECU_ADDRESS 0xFFF8A904 /end MEASUREMENT
/begin MEASUREMENT CCMsg.ID_Speed2HighInPosP.cCC_ID._.tmr_ID_HoldCC.time "test_timer" UWORD SBW_TIMER_10MS_S1_S3 1 100 0 655350 DISPLAY_IDENTIFIER time.tmr_ID_HoldCC._.cCC_ID.ID_Speed2HighInPosP.CCMsg ECU_ADDRESS 0xFFF8A906 /end MEASUREMENT
/begin MEASUREMENT CCMsg.ID_Speed2HighInPosP.cCC_ID._.tmr_ID_HoldCC.f_IsExpired "test_timer" UBYTE SBW_STANDARD_S1_S3 1 100 0 255 DISPLAY_IDENTIFIER f_IsExpired.tmr_ID_HoldCC._.cCC_ID.ID_Speed2HighInPosP.CCMsg ECU_ADDRESS 0xFFF8A908 /end MEASUREMENT
/begin MEASUREMENT CCMsg.ID_ParkLockFault.cCC_ID._.tmr_ID_delay.time "test_timer" UWORD SBW_TIMER_10MS_S1_S3 1 100 0 655350 DISPLAY_IDENTIFIER time.tmr_ID_delay._.cCC_ID.ID_ParkLockFault.CCMsg ECU_ADDRESS 0xFFF8A91A /end MEASUREMENT
/begin MEASUREMENT CCMsg.ID_ParkLockFault.cCC_ID._.tmr_ID_delay.f_IsExpired "test_timer" UBYTE SBW_STANDARD_S1_S3 1 100 0 255 DISPLAY_IDENTIFIER f_IsExpired.tmr_ID_delay._.cCC_ID.ID_ParkLockFault.CCMsg ECU_ADDRESS 0xFFF8A91C /end MEASUREMENT
/begin MEASUREMENT CCMsg.ID_ParkLockFault.cCC_ID._.tmr_ID_CycleTime.time "test_timer" UWORD SBW_TIMER_10MS_S1_S3 1 100 0 655350 DISPLAY_IDENTIFIER time.tmr_ID_CycleTime._.cCC_ID.ID_ParkLockFault.CCMsg ECU_ADDRESS 0xFFF8A91E /end MEASUREMENT
/begin MEASUREMENT CCMsg.ID_ParkLockFault.cCC_ID._.tmr_ID_CycleTime.f_IsExpired "test_timer" UBYTE SBW_STANDARD_S1_S3 1 100 0 255 DISPLAY_IDENTIFIER f_IsExpired.tmr_ID_CycleTime._.cCC_ID.ID_ParkLockFault.CCMsg ECU_ADDRESS 0xFFF8A920 /end MEASUREMENT
/begin MEASUREMENT CCMsg.ID_ParkLockFault.cCC_ID._.tmr_ID_MinTime.time "test_timer" UWORD SBW_TIMER_10MS_S1_S3 1 100 0 655350 DISPLAY_IDENTIFIER time.tmr_ID_MinTime._.cCC_ID.ID_ParkLockFault.CCMsg ECU_ADDRESS 0xFFF8A922 /end MEASUREMENT
/begin MEASUREMENT CCMsg.ID_ParkLockFault.cCC_ID._.tmr_ID_MinTime.f_IsExpired "test_timer" UBYTE SBW_STANDARD_S1_S3 1 100 0 255 DISPLAY_IDENTIFIER f_IsExpired.tmr_ID_MinTime._.cCC_ID.ID_ParkLockFault.CCMsg ECU_ADDRESS 0xFFF8A924 /end MEASUREMENT
/begin MEASUREMENT CCMsg.ID_ParkLockFault.cCC_ID._.tmr_ID_HoldCC.time "test_timer" UWORD SBW_TIMER_10MS_S1_S3 1 100 0 655350 DISPLAY_IDENTIFIER time.tmr_ID_HoldCC._.cCC_ID.ID_ParkLockFault.CCMsg ECU_ADDRESS 0xFFF8A926 /end MEASUREMENT
/begin MEASUREMENT CCMsg.ID_ParkLockFault.cCC_ID._.tmr_ID_HoldCC.f_IsExpired "test_timer" UBYTE SBW_STANDARD_S1_S3 1 100 0 255 DISPLAY_IDENTIFIER f_IsExpired.tmr_ID_HoldCC._.cCC_ID.ID_ParkLockFault.CCMsg ECU_ADDRESS 0xFFF8A928 /end MEASUREMENT
/begin MEASUREMENT CCMsg.ID_ParkLockFault_InMechLimp.cCC_ID._.tmr_ID_delay.time "test_timer" UWORD SBW_TIMER_10MS_S1_S3 1 100 0 655350 DISPLAY_IDENTIFIER time.tmr_ID_delay._.cCC_ID.ID_ParkLockFault_InMechLimp.CCMsg ECU_ADDRESS 0xFFF8A93A /end MEASUREMENT
/begin MEASUREMENT CCMsg.ID_ParkLockFault_InMechLimp.cCC_ID._.tmr_ID_delay.f_IsExpired "test_timer" UBYTE SBW_STANDARD_S1_S3 1 100 0 255 DISPLAY_IDENTIFIER f_IsExpired.tmr_ID_delay._.cCC_ID.ID_ParkLockFault_InMechLimp.CCMsg ECU_ADDRESS 0xFFF8A93C /end MEASUREMENT
/begin MEASUREMENT CCMsg.ID_ParkLockFault_InMechLimp.cCC_ID._.tmr_ID_CycleTime.time "test_timer" UWORD SBW_TIMER_10MS_S1_S3 1 100 0 655350 DISPLAY_IDENTIFIER time.tmr_ID_CycleTime._.cCC_ID.ID_ParkLockFault_InMechLimp.CCMsg ECU_ADDRESS 0xFFF8A93E /end MEASUREMENT
/begin MEASUREMENT CCMsg.ID_ParkLockFault_InMechLimp.cCC_ID._.tmr_ID_CycleTime.f_IsExpired "test_timer" UBYTE SBW_STANDARD_S1_S3 1 100 0 255 DISPLAY_IDENTIFIER f_IsExpired.tmr_ID_CycleTime._.cCC_ID.ID_ParkLockFault_InMechLimp.CCMsg ECU_ADDRESS 0xFFF8A940 /end MEASUREMENT
/begin MEASUREMENT CCMsg.ID_ParkLockFault_InMechLimp.cCC_ID._.tmr_ID_MinTime.time "test_timer" UWORD SBW_TIMER_10MS_S1_S3 1 100 0 655350 DISPLAY_IDENTIFIER time.tmr_ID_MinTime._.cCC_ID.ID_ParkLockFault_InMechLimp.CCMsg ECU_ADDRESS 0xFFF8A942 /end MEASUREMENT
/begin MEASUREMENT CCMsg.ID_ParkLockFault_InMechLimp.cCC_ID._.tmr_ID_MinTime.f_IsExpired "test_timer" UBYTE SBW_STANDARD_S1_S3 1 100 0 255 DISPLAY_IDENTIFIER f_IsExpired.tmr_ID_MinTime._.cCC_ID.ID_ParkLockFault_InMechLimp.CCMsg ECU_ADDRESS 0xFFF8A944 /end MEASUREMENT
/begin MEASUREMENT CCMsg.ID_ParkLockFault_InMechLimp.cCC_ID._.tmr_ID_HoldCC.time "test_timer" UWORD SBW_TIMER_10MS_S1_S3 1 100 0 655350 DISPLAY_IDENTIFIER time.tmr_ID_HoldCC._.cCC_ID.ID_ParkLockFault_InMechLimp.CCMsg ECU_ADDRESS 0xFFF8A946 /end MEASUREMENT
/begin MEASUREMENT CCMsg.ID_ParkLockFault_InMechLimp.cCC_ID._.tmr_ID_HoldCC.f_IsExpired "test_timer" UBYTE SBW_STANDARD_S1_S3 1 100 0 255 DISPLAY_IDENTIFIER f_IsExpired.tmr_ID_HoldCC._.cCC_ID.ID_ParkLockFault_InMechLimp.CCMsg ECU_ADDRESS 0xFFF8A948 /end MEASUREMENT
/begin MEASUREMENT CCMsg.ID_ParkLockFault_IEP_On.cCC_ID._.tmr_ID_delay.time "test_timer" UWORD SBW_TIMER_10MS_S1_S3 1 100 0 655350 DISPLAY_IDENTIFIER time.tmr_ID_delay._.cCC_ID.ID_ParkLockFault_IEP_On.CCMsg ECU_ADDRESS 0xFFF8A95A /end MEASUREMENT
/begin MEASUREMENT CCMsg.ID_ParkLockFault_IEP_On.cCC_ID._.tmr_ID_delay.f_IsExpired "test_timer" UBYTE SBW_STANDARD_S1_S3 1 100 0 255 DISPLAY_IDENTIFIER f_IsExpired.tmr_ID_delay._.cCC_ID.ID_ParkLockFault_IEP_On.CCMsg ECU_ADDRESS 0xFFF8A95C /end MEASUREMENT
/begin MEASUREMENT CCMsg.ID_ParkLockFault_IEP_On.cCC_ID._.tmr_ID_CycleTime.time "test_timer" UWORD SBW_TIMER_10MS_S1_S3 1 100 0 655350 DISPLAY_IDENTIFIER time.tmr_ID_CycleTime._.cCC_ID.ID_ParkLockFault_IEP_On.CCMsg ECU_ADDRESS 0xFFF8A95E /end MEASUREMENT
/begin MEASUREMENT CCMsg.ID_ParkLockFault_IEP_On.cCC_ID._.tmr_ID_CycleTime.f_IsExpired "test_timer" UBYTE SBW_STANDARD_S1_S3 1 100 0 255 DISPLAY_IDENTIFIER f_IsExpired.tmr_ID_CycleTime._.cCC_ID.ID_ParkLockFault_IEP_On.CCMsg ECU_ADDRESS 0xFFF8A960 /end MEASUREMENT
/begin MEASUREMENT CCMsg.ID_ParkLockFault_IEP_On.cCC_ID._.tmr_ID_MinTime.time "test_timer" UWORD SBW_TIMER_10MS_S1_S3 1 100 0 655350 DISPLAY_IDENTIFIER time.tmr_ID_MinTime._.cCC_ID.ID_ParkLockFault_IEP_On.CCMsg ECU_ADDRESS 0xFFF8A962 /end MEASUREMENT
/begin MEASUREMENT CCMsg.ID_ParkLockFault_IEP_On.cCC_ID._.tmr_ID_MinTime.f_IsExpired "test_timer" UBYTE SBW_STANDARD_S1_S3 1 100 0 255 DISPLAY_IDENTIFIER f_IsExpired.tmr_ID_MinTime._.cCC_ID.ID_ParkLockFault_IEP_On.CCMsg ECU_ADDRESS 0xFFF8A964 /end MEASUREMENT
/begin MEASUREMENT CCMsg.ID_ParkLockFault_IEP_On.cCC_ID._.tmr_ID_HoldCC.time "test_timer" UWORD SBW_TIMER_10MS_S1_S3 1 100 0 655350 DISPLAY_IDENTIFIER time.tmr_ID_HoldCC._.cCC_ID.ID_ParkLockFault_IEP_On.CCMsg ECU_ADDRESS 0xFFF8A966 /end MEASUREMENT
/begin MEASUREMENT CCMsg.ID_ParkLockFault_IEP_On.cCC_ID._.tmr_ID_HoldCC.f_IsExpired "test_timer" UBYTE SBW_STANDARD_S1_S3 1 100 0 255 DISPLAY_IDENTIFIER f_IsExpired.tmr_ID_HoldCC._.cCC_ID.ID_ParkLockFault_IEP_On.CCMsg ECU_ADDRESS 0xFFF8A968 /end MEASUREMENT
/begin MEASUREMENT CCMsg.ID_E_GNERActive.cCC_ID._.tmr_ID_delay.time "test_timer" UWORD SBW_TIMER_10MS_S1_S3 1 100 0 655350 DISPLAY_IDENTIFIER time.tmr_ID_delay._.cCC_ID.ID_E_GNERActive.CCMsg ECU_ADDRESS 0xFFF8A97A /end MEASUREMENT
/begin MEASUREMENT CCMsg.ID_E_GNERActive.cCC_ID._.tmr_ID_delay.f_IsExpired "test_timer" UBYTE SBW_STANDARD_S1_S3 1 100 0 255 DISPLAY_IDENTIFIER f_IsExpired.tmr_ID_delay._.cCC_ID.ID_E_GNERActive.CCMsg ECU_ADDRESS 0xFFF8A97C /end MEASUREMENT
/begin MEASUREMENT CCMsg.ID_E_GNERActive.cCC_ID._.tmr_ID_CycleTime.time "test_timer" UWORD SBW_TIMER_10MS_S1_S3 1 100 0 655350 DISPLAY_IDENTIFIER time.tmr_ID_CycleTime._.cCC_ID.ID_E_GNERActive.CCMsg ECU_ADDRESS 0xFFF8A97E /end MEASUREMENT
/begin MEASUREMENT CCMsg.ID_E_GNERActive.cCC_ID._.tmr_ID_CycleTime.f_IsExpired "test_timer" UBYTE SBW_STANDARD_S1_S3 1 100 0 255 DISPLAY_IDENTIFIER f_IsExpired.tmr_ID_CycleTime._.cCC_ID.ID_E_GNERActive.CCMsg ECU_ADDRESS 0xFFF8A980 /end MEASUREMENT
/begin MEASUREMENT CCMsg.ID_E_GNERActive.cCC_ID._.tmr_ID_MinTime.time "test_timer" UWORD SBW_TIMER_10MS_S1_S3 1 100 0 655350 DISPLAY_IDENTIFIER time.tmr_ID_MinTime._.cCC_ID.ID_E_GNERActive.CCMsg ECU_ADDRESS 0xFFF8A982 /end MEASUREMENT
/begin MEASUREMENT CCMsg.ID_E_GNERActive.cCC_ID._.tmr_ID_MinTime.f_IsExpired "test_timer" UBYTE SBW_STANDARD_S1_S3 1 100 0 255 DISPLAY_IDENTIFIER f_IsExpired.tmr_ID_MinTime._.cCC_ID.ID_E_GNERActive.CCMsg ECU_ADDRESS 0xFFF8A984 /end MEASUREMENT
/begin MEASUREMENT CCMsg.ID_E_GNERActive.cCC_ID._.tmr_ID_HoldCC.time "test_timer" UWORD SBW_TIMER_10MS_S1_S3 1 100 0 655350 DISPLAY_IDENTIFIER time.tmr_ID_HoldCC._.cCC_ID.ID_E_GNERActive.CCMsg ECU_ADDRESS 0xFFF8A986 /end MEASUREMENT
/begin MEASUREMENT CCMsg.ID_E_GNERActive.cCC_ID._.tmr_ID_HoldCC.f_IsExpired "test_timer" UBYTE SBW_STANDARD_S1_S3 1 100 0 255 DISPLAY_IDENTIFIER f_IsExpired.tmr_ID_HoldCC._.cCC_ID.ID_E_GNERActive.CCMsg ECU_ADDRESS 0xFFF8A988 /end MEASUREMENT
/begin MEASUREMENT CCMsg.ID_PosN_Warning.cCC_ID._.tmr_ID_delay.time "test_timer" UWORD SBW_TIMER_10MS_S1_S3 1 100 0 655350 DISPLAY_IDENTIFIER time.tmr_ID_delay._.cCC_ID.ID_PosN_Warning.CCMsg ECU_ADDRESS 0xFFF8A99A /end MEASUREMENT
/begin MEASUREMENT CCMsg.ID_PosN_Warning.cCC_ID._.tmr_ID_delay.f_IsExpired "test_timer" UBYTE SBW_STANDARD_S1_S3 1 100 0 255 DISPLAY_IDENTIFIER f_IsExpired.tmr_ID_delay._.cCC_ID.ID_PosN_Warning.CCMsg ECU_ADDRESS 0xFFF8A99C /end MEASUREMENT
/begin MEASUREMENT CCMsg.ID_PosN_Warning.cCC_ID._.tmr_ID_CycleTime.time "test_timer" UWORD SBW_TIMER_10MS_S1_S3 1 100 0 655350 DISPLAY_IDENTIFIER time.tmr_ID_CycleTime._.cCC_ID.ID_PosN_Warning.CCMsg ECU_ADDRESS 0xFFF8A99E /end MEASUREMENT
/begin MEASUREMENT CCMsg.ID_PosN_Warning.cCC_ID._.tmr_ID_CycleTime.f_IsExpired "test_timer" UBYTE SBW_STANDARD_S1_S3 1 100 0 255 DISPLAY_IDENTIFIER f_IsExpired.tmr_ID_CycleTime._.cCC_ID.ID_PosN_Warning.CCMsg ECU_ADDRESS 0xFFF8A9A0 /end MEASUREMENT
/begin MEASUREMENT CCMsg.ID_PosN_Warning.cCC_ID._.tmr_ID_MinTime.time "test_timer" UWORD SBW_TIMER_10MS_S1_S3 1 100 0 655350 DISPLAY_IDENTIFIER time.tmr_ID_MinTime._.cCC_ID.ID_PosN_Warning.CCMsg ECU_ADDRESS 0xFFF8A9A2 /end MEASUREMENT
/begin MEASUREMENT CCMsg.ID_PosN_Warning.cCC_ID._.tmr_ID_MinTime.f_IsExpired "test_timer" UBYTE SBW_STANDARD_S1_S3 1 100 0 255 DISPLAY_IDENTIFIER f_IsExpired.tmr_ID_MinTime._.cCC_ID.ID_PosN_Warning.CCMsg ECU_ADDRESS 0xFFF8A9A4 /end MEASUREMENT
/begin MEASUREMENT CCMsg.ID_PosN_Warning.cCC_ID._.tmr_ID_HoldCC.time "test_timer" UWORD SBW_TIMER_10MS_S1_S3 1 100 0 655350 DISPLAY_IDENTIFIER time.tmr_ID_HoldCC._.cCC_ID.ID_PosN_Warning.CCMsg ECU_ADDRESS 0xFFF8A9A6 /end MEASUREMENT
/begin MEASUREMENT CCMsg.ID_PosN_Warning.cCC_ID._.tmr_ID_HoldCC.f_IsExpired "test_timer" UBYTE SBW_STANDARD_S1_S3 1 100 0 255 DISPLAY_IDENTIFIER f_IsExpired.tmr_ID_HoldCC._.cCC_ID.ID_PosN_Warning.CCMsg ECU_ADDRESS 0xFFF8A9A8 /end MEASUREMENT
/begin MEASUREMENT CCMsg.ID_ShiftlockBrakeWarning.cCC_ID._.tmr_ID_delay.time "test_timer" UWORD SBW_TIMER_10MS_S1_S3 1 100 0 655350 DISPLAY_IDENTIFIER time.tmr_ID_delay._.cCC_ID.ID_ShiftlockBrakeWarning.CCMsg ECU_ADDRESS 0xFFF8A9BA /end MEASUREMENT
/begin MEASUREMENT CCMsg.ID_ShiftlockBrakeWarning.cCC_ID._.tmr_ID_delay.f_IsExpired "test_timer" UBYTE SBW_STANDARD_S1_S3 1 100 0 255 DISPLAY_IDENTIFIER f_IsExpired.tmr_ID_delay._.cCC_ID.ID_ShiftlockBrakeWarning.CCMsg ECU_ADDRESS 0xFFF8A9BC /end MEASUREMENT
/begin MEASUREMENT CCMsg.ID_ShiftlockBrakeWarning.cCC_ID._.tmr_ID_CycleTime.time "test_timer" UWORD SBW_TIMER_10MS_S1_S3 1 100 0 655350 DISPLAY_IDENTIFIER time.tmr_ID_CycleTime._.cCC_ID.ID_ShiftlockBrakeWarning.CCMsg ECU_ADDRESS 0xFFF8A9BE /end MEASUREMENT
/begin MEASUREMENT CCMsg.ID_ShiftlockBrakeWarning.cCC_ID._.tmr_ID_CycleTime.f_IsExpired "test_timer" UBYTE SBW_STANDARD_S1_S3 1 100 0 255 DISPLAY_IDENTIFIER f_IsExpired.tmr_ID_CycleTime._.cCC_ID.ID_ShiftlockBrakeWarning.CCMsg ECU_ADDRESS 0xFFF8A9C0 /end MEASUREMENT
/begin MEASUREMENT CCMsg.ID_ShiftlockBrakeWarning.cCC_ID._.tmr_ID_MinTime.time "test_timer" UWORD SBW_TIMER_10MS_S1_S3 1 100 0 655350 DISPLAY_IDENTIFIER time.tmr_ID_MinTime._.cCC_ID.ID_ShiftlockBrakeWarning.CCMsg ECU_ADDRESS 0xFFF8A9C2 /end MEASUREMENT
/begin MEASUREMENT CCMsg.ID_ShiftlockBrakeWarning.cCC_ID._.tmr_ID_MinTime.f_IsExpired "test_timer" UBYTE SBW_STANDARD_S1_S3 1 100 0 255 DISPLAY_IDENTIFIER f_IsExpired.tmr_ID_MinTime._.cCC_ID.ID_ShiftlockBrakeWarning.CCMsg ECU_ADDRESS 0xFFF8A9C4 /end MEASUREMENT
/begin MEASUREMENT CCMsg.ID_ShiftlockBrakeWarning.cCC_ID._.tmr_ID_HoldCC.time "test_timer" UWORD SBW_TIMER_10MS_S1_S3 1 100 0 655350 DISPLAY_IDENTIFIER time.tmr_ID_HoldCC._.cCC_ID.ID_ShiftlockBrakeWarning.CCMsg ECU_ADDRESS 0xFFF8A9C6 /end MEASUREMENT
/begin MEASUREMENT CCMsg.ID_ShiftlockBrakeWarning.cCC_ID._.tmr_ID_HoldCC.f_IsExpired "test_timer" UBYTE SBW_STANDARD_S1_S3 1 100 0 255 DISPLAY_IDENTIFIER f_IsExpired.tmr_ID_HoldCC._.cCC_ID.ID_ShiftlockBrakeWarning.CCMsg ECU_ADDRESS 0xFFF8A9C8 /end MEASUREMENT
/begin MEASUREMENT CCMsg.ID_ShiftWithoutBrakeWarning.cCC_ID._.tmr_ID_delay.time "test_timer" UWORD SBW_TIMER_10MS_S1_S3 1 100 0 655350 DISPLAY_IDENTIFIER time.tmr_ID_delay._.cCC_ID.ID_ShiftWithoutBrakeWarning.CCMsg ECU_ADDRESS 0xFFF8A9DA /end MEASUREMENT
/begin MEASUREMENT CCMsg.ID_ShiftWithoutBrakeWarning.cCC_ID._.tmr_ID_delay.f_IsExpired "test_timer" UBYTE SBW_STANDARD_S1_S3 1 100 0 255 DISPLAY_IDENTIFIER f_IsExpired.tmr_ID_delay._.cCC_ID.ID_ShiftWithoutBrakeWarning.CCMsg ECU_ADDRESS 0xFFF8A9DC /end MEASUREMENT
/begin MEASUREMENT CCMsg.ID_ShiftWithoutBrakeWarning.cCC_ID._.tmr_ID_CycleTime.time "test_timer" UWORD SBW_TIMER_10MS_S1_S3 1 100 0 655350 DISPLAY_IDENTIFIER time.tmr_ID_CycleTime._.cCC_ID.ID_ShiftWithoutBrakeWarning.CCMsg ECU_ADDRESS 0xFFF8A9DE /end MEASUREMENT
/begin MEASUREMENT CCMsg.ID_ShiftWithoutBrakeWarning.cCC_ID._.tmr_ID_CycleTime.f_IsExpired "test_timer" UBYTE SBW_STANDARD_S1_S3 1 100 0 255 DISPLAY_IDENTIFIER f_IsExpired.tmr_ID_CycleTime._.cCC_ID.ID_ShiftWithoutBrakeWarning.CCMsg ECU_ADDRESS 0xFFF8A9E0 /end MEASUREMENT
/begin MEASUREMENT CCMsg.ID_ShiftWithoutBrakeWarning.cCC_ID._.tmr_ID_MinTime.time "test_timer" UWORD SBW_TIMER_10MS_S1_S3 1 100 0 655350 DISPLAY_IDENTIFIER time.tmr_ID_MinTime._.cCC_ID.ID_ShiftWithoutBrakeWarning.CCMsg ECU_ADDRESS 0xFFF8A9E2 /end MEASUREMENT
/begin MEASUREMENT CCMsg.ID_ShiftWithoutBrakeWarning.cCC_ID._.tmr_ID_MinTime.f_IsExpired "test_timer" UBYTE SBW_STANDARD_S1_S3 1 100 0 255 DISPLAY_IDENTIFIER f_IsExpired.tmr_ID_MinTime._.cCC_ID.ID_ShiftWithoutBrakeWarning.CCMsg ECU_ADDRESS 0xFFF8A9E4 /end MEASUREMENT
/begin MEASUREMENT CCMsg.ID_ShiftWithoutBrakeWarning.cCC_ID._.tmr_ID_HoldCC.time "test_timer" UWORD SBW_TIMER_10MS_S1_S3 1 100 0 655350 DISPLAY_IDENTIFIER time.tmr_ID_HoldCC._.cCC_ID.ID_ShiftWithoutBrakeWarning.CCMsg ECU_ADDRESS 0xFFF8A9E6 /end MEASUREMENT
/begin MEASUREMENT CCMsg.ID_ShiftWithoutBrakeWarning.cCC_ID._.tmr_ID_HoldCC.f_IsExpired "test_timer" UBYTE SBW_STANDARD_S1_S3 1 100 0 255 DISPLAY_IDENTIFIER f_IsExpired.tmr_ID_HoldCC._.cCC_ID.ID_ShiftWithoutBrakeWarning.CCMsg ECU_ADDRESS 0xFFF8A9E8 /end MEASUREMENT
/begin MEASUREMENT CCMsg.ID_GongWrongDrvDir.cCC_ID._.tmr_ID_delay.time "test_timer" UWORD SBW_TIMER_10MS_S1_S3 1 100 0 655350 DISPLAY_IDENTIFIER time.tmr_ID_delay._.cCC_ID.ID_GongWrongDrvDir.CCMsg ECU_ADDRESS 0xFFF8A9FA /end MEASUREMENT
/begin MEASUREMENT CCMsg.ID_GongWrongDrvDir.cCC_ID._.tmr_ID_delay.f_IsExpired "test_timer" UBYTE SBW_STANDARD_S1_S3 1 100 0 255 DISPLAY_IDENTIFIER f_IsExpired.tmr_ID_delay._.cCC_ID.ID_GongWrongDrvDir.CCMsg ECU_ADDRESS 0xFFF8A9FC /end MEASUREMENT
/begin MEASUREMENT CCMsg.ID_GongWrongDrvDir.cCC_ID._.tmr_ID_CycleTime.time "test_timer" UWORD SBW_TIMER_10MS_S1_S3 1 100 0 655350 DISPLAY_IDENTIFIER time.tmr_ID_CycleTime._.cCC_ID.ID_GongWrongDrvDir.CCMsg ECU_ADDRESS 0xFFF8A9FE /end MEASUREMENT
/begin MEASUREMENT CCMsg.ID_GongWrongDrvDir.cCC_ID._.tmr_ID_CycleTime.f_IsExpired "test_timer" UBYTE SBW_STANDARD_S1_S3 1 100 0 255 DISPLAY_IDENTIFIER f_IsExpired.tmr_ID_CycleTime._.cCC_ID.ID_GongWrongDrvDir.CCMsg ECU_ADDRESS 0xFFF8AA00 /end MEASUREMENT
/begin MEASUREMENT CCMsg.ID_GongWrongDrvDir.cCC_ID._.tmr_ID_MinTime.time "test_timer" UWORD SBW_TIMER_10MS_S1_S3 1 100 0 655350 DISPLAY_IDENTIFIER time.tmr_ID_MinTime._.cCC_ID.ID_GongWrongDrvDir.CCMsg ECU_ADDRESS 0xFFF8AA02 /end MEASUREMENT
/begin MEASUREMENT CCMsg.ID_GongWrongDrvDir.cCC_ID._.tmr_ID_MinTime.f_IsExpired "test_timer" UBYTE SBW_STANDARD_S1_S3 1 100 0 255 DISPLAY_IDENTIFIER f_IsExpired.tmr_ID_MinTime._.cCC_ID.ID_GongWrongDrvDir.CCMsg ECU_ADDRESS 0xFFF8AA04 /end MEASUREMENT
/begin MEASUREMENT CCMsg.ID_GongWrongDrvDir.cCC_ID._.tmr_ID_HoldCC.time "test_timer" UWORD SBW_TIMER_10MS_S1_S3 1 100 0 655350 DISPLAY_IDENTIFIER time.tmr_ID_HoldCC._.cCC_ID.ID_GongWrongDrvDir.CCMsg ECU_ADDRESS 0xFFF8AA06 /end MEASUREMENT
/begin MEASUREMENT CCMsg.ID_GongWrongDrvDir.cCC_ID._.tmr_ID_HoldCC.f_IsExpired "test_timer" UBYTE SBW_STANDARD_S1_S3 1 100 0 255 DISPLAY_IDENTIFIER f_IsExpired.tmr_ID_HoldCC._.cCC_ID.ID_GongWrongDrvDir.CCMsg ECU_ADDRESS 0xFFF8AA08 /end MEASUREMENT
/begin MEASUREMENT CCMsg.ID_GongInMechLimp.cCC_ID._.tmr_ID_delay.time "test_timer" UWORD SBW_TIMER_10MS_S1_S3 1 100 0 655350 DISPLAY_IDENTIFIER time.tmr_ID_delay._.cCC_ID.ID_GongInMechLimp.CCMsg ECU_ADDRESS 0xFFF8AA1A /end MEASUREMENT
/begin MEASUREMENT CCMsg.ID_GongInMechLimp.cCC_ID._.tmr_ID_delay.f_IsExpired "test_timer" UBYTE SBW_STANDARD_S1_S3 1 100 0 255 DISPLAY_IDENTIFIER f_IsExpired.tmr_ID_delay._.cCC_ID.ID_GongInMechLimp.CCMsg ECU_ADDRESS 0xFFF8AA1C /end MEASUREMENT
/begin MEASUREMENT CCMsg.ID_GongInMechLimp.cCC_ID._.tmr_ID_CycleTime.time "test_timer" UWORD SBW_TIMER_10MS_S1_S3 1 100 0 655350 DISPLAY_IDENTIFIER time.tmr_ID_CycleTime._.cCC_ID.ID_GongInMechLimp.CCMsg ECU_ADDRESS 0xFFF8AA1E /end MEASUREMENT
/begin MEASUREMENT CCMsg.ID_GongInMechLimp.cCC_ID._.tmr_ID_CycleTime.f_IsExpired "test_timer" UBYTE SBW_STANDARD_S1_S3 1 100 0 255 DISPLAY_IDENTIFIER f_IsExpired.tmr_ID_CycleTime._.cCC_ID.ID_GongInMechLimp.CCMsg ECU_ADDRESS 0xFFF8AA20 /end MEASUREMENT
/begin MEASUREMENT CCMsg.ID_GongInMechLimp.cCC_ID._.tmr_ID_MinTime.time "test_timer" UWORD SBW_TIMER_10MS_S1_S3 1 100 0 655350 DISPLAY_IDENTIFIER time.tmr_ID_MinTime._.cCC_ID.ID_GongInMechLimp.CCMsg ECU_ADDRESS 0xFFF8AA22 /end MEASUREMENT
/begin MEASUREMENT CCMsg.ID_GongInMechLimp.cCC_ID._.tmr_ID_MinTime.f_IsExpired "test_timer" UBYTE SBW_STANDARD_S1_S3 1 100 0 255 DISPLAY_IDENTIFIER f_IsExpired.tmr_ID_MinTime._.cCC_ID.ID_GongInMechLimp.CCMsg ECU_ADDRESS 0xFFF8AA24 /end MEASUREMENT
/begin MEASUREMENT CCMsg.ID_GongInMechLimp.cCC_ID._.tmr_ID_HoldCC.time "test_timer" UWORD SBW_TIMER_10MS_S1_S3 1 100 0 655350 DISPLAY_IDENTIFIER time.tmr_ID_HoldCC._.cCC_ID.ID_GongInMechLimp.CCMsg ECU_ADDRESS 0xFFF8AA26 /end MEASUREMENT
/begin MEASUREMENT CCMsg.ID_GongInMechLimp.cCC_ID._.tmr_ID_HoldCC.f_IsExpired "test_timer" UBYTE SBW_STANDARD_S1_S3 1 100 0 255 DISPLAY_IDENTIFIER f_IsExpired.tmr_ID_HoldCC._.cCC_ID.ID_GongInMechLimp.CCMsg ECU_ADDRESS 0xFFF8AA28 /end MEASUREMENT
/begin MEASUREMENT CCMsg.ID_GongBadOp.cCC_ID._.tmr_ID_delay.time "test_timer" UWORD SBW_TIMER_10MS_S1_S3 1 100 0 655350 DISPLAY_IDENTIFIER time.tmr_ID_delay._.cCC_ID.ID_GongBadOp.CCMsg ECU_ADDRESS 0xFFF8AA3A /end MEASUREMENT
/begin MEASUREMENT CCMsg.ID_GongBadOp.cCC_ID._.tmr_ID_delay.f_IsExpired "test_timer" UBYTE SBW_STANDARD_S1_S3 1 100 0 255 DISPLAY_IDENTIFIER f_IsExpired.tmr_ID_delay._.cCC_ID.ID_GongBadOp.CCMsg ECU_ADDRESS 0xFFF8AA3C /end MEASUREMENT
/begin MEASUREMENT CCMsg.ID_GongBadOp.cCC_ID._.tmr_ID_CycleTime.time "test_timer" UWORD SBW_TIMER_10MS_S1_S3 1 100 0 655350 DISPLAY_IDENTIFIER time.tmr_ID_CycleTime._.cCC_ID.ID_GongBadOp.CCMsg ECU_ADDRESS 0xFFF8AA3E /end MEASUREMENT
/begin MEASUREMENT CCMsg.ID_GongBadOp.cCC_ID._.tmr_ID_CycleTime.f_IsExpired "test_timer" UBYTE SBW_STANDARD_S1_S3 1 100 0 255 DISPLAY_IDENTIFIER f_IsExpired.tmr_ID_CycleTime._.cCC_ID.ID_GongBadOp.CCMsg ECU_ADDRESS 0xFFF8AA40 /end MEASUREMENT
/begin MEASUREMENT CCMsg.ID_GongBadOp.cCC_ID._.tmr_ID_MinTime.time "test_timer" UWORD SBW_TIMER_10MS_S1_S3 1 100 0 655350 DISPLAY_IDENTIFIER time.tmr_ID_MinTime._.cCC_ID.ID_GongBadOp.CCMsg ECU_ADDRESS 0xFFF8AA42 /end MEASUREMENT
/begin MEASUREMENT CCMsg.ID_GongBadOp.cCC_ID._.tmr_ID_MinTime.f_IsExpired "test_timer" UBYTE SBW_STANDARD_S1_S3 1 100 0 255 DISPLAY_IDENTIFIER f_IsExpired.tmr_ID_MinTime._.cCC_ID.ID_GongBadOp.CCMsg ECU_ADDRESS 0xFFF8AA44 /end MEASUREMENT
/begin MEASUREMENT CCMsg.ID_GongBadOp.cCC_ID._.tmr_ID_HoldCC.time "test_timer" UWORD SBW_TIMER_10MS_S1_S3 1 100 0 655350 DISPLAY_IDENTIFIER time.tmr_ID_HoldCC._.cCC_ID.ID_GongBadOp.CCMsg ECU_ADDRESS 0xFFF8AA46 /end MEASUREMENT
/begin MEASUREMENT CCMsg.ID_GongBadOp.cCC_ID._.tmr_ID_HoldCC.f_IsExpired "test_timer" UBYTE SBW_STANDARD_S1_S3 1 100 0 255 DISPLAY_IDENTIFIER f_IsExpired.tmr_ID_HoldCC._.cCC_ID.ID_GongBadOp.CCMsg ECU_ADDRESS 0xFFF8AA48 /end MEASUREMENT
/begin MEASUREMENT CCMsg.ID_Hotmode2.cCC_ID._.tmr_ID_delay.time "test_timer" UWORD SBW_TIMER_10MS_S1_S3 1 100 0 655350 DISPLAY_IDENTIFIER time.tmr_ID_delay._.cCC_ID.ID_Hotmode2.CCMsg ECU_ADDRESS 0xFFF8AA5A /end MEASUREMENT
/begin MEASUREMENT CCMsg.ID_Hotmode2.cCC_ID._.tmr_ID_delay.f_IsExpired "test_timer" UBYTE SBW_STANDARD_S1_S3 1 100 0 255 DISPLAY_IDENTIFIER f_IsExpired.tmr_ID_delay._.cCC_ID.ID_Hotmode2.CCMsg ECU_ADDRESS 0xFFF8AA5C /end MEASUREMENT
/begin MEASUREMENT CCMsg.ID_Hotmode2.cCC_ID._.tmr_ID_CycleTime.time "test_timer" UWORD SBW_TIMER_10MS_S1_S3 1 100 0 655350 DISPLAY_IDENTIFIER time.tmr_ID_CycleTime._.cCC_ID.ID_Hotmode2.CCMsg ECU_ADDRESS 0xFFF8AA5E /end MEASUREMENT
/begin MEASUREMENT CCMsg.ID_Hotmode2.cCC_ID._.tmr_ID_CycleTime.f_IsExpired "test_timer" UBYTE SBW_STANDARD_S1_S3 1 100 0 255 DISPLAY_IDENTIFIER f_IsExpired.tmr_ID_CycleTime._.cCC_ID.ID_Hotmode2.CCMsg ECU_ADDRESS 0xFFF8AA60 /end MEASUREMENT
/begin MEASUREMENT CCMsg.ID_Hotmode2.cCC_ID._.tmr_ID_MinTime.time "test_timer" UWORD SBW_TIMER_10MS_S1_S3 1 100 0 655350 DISPLAY_IDENTIFIER time.tmr_ID_MinTime._.cCC_ID.ID_Hotmode2.CCMsg ECU_ADDRESS 0xFFF8AA62 /end MEASUREMENT
/begin MEASUREMENT CCMsg.ID_Hotmode2.cCC_ID._.tmr_ID_MinTime.f_IsExpired "test_timer" UBYTE SBW_STANDARD_S1_S3 1 100 0 255 DISPLAY_IDENTIFIER f_IsExpired.tmr_ID_MinTime._.cCC_ID.ID_Hotmode2.CCMsg ECU_ADDRESS 0xFFF8AA64 /end MEASUREMENT
/begin MEASUREMENT CCMsg.ID_Hotmode2.cCC_ID._.tmr_ID_HoldCC.time "test_timer" UWORD SBW_TIMER_10MS_S1_S3 1 100 0 655350 DISPLAY_IDENTIFIER time.tmr_ID_HoldCC._.cCC_ID.ID_Hotmode2.CCMsg ECU_ADDRESS 0xFFF8AA66 /end MEASUREMENT
/begin MEASUREMENT CCMsg.ID_Hotmode2.cCC_ID._.tmr_ID_HoldCC.f_IsExpired "test_timer" UBYTE SBW_STANDARD_S1_S3 1 100 0 255 DISPLAY_IDENTIFIER f_IsExpired.tmr_ID_HoldCC._.cCC_ID.ID_Hotmode2.CCMsg ECU_ADDRESS 0xFFF8AA68 /end MEASUREMENT
/begin MEASUREMENT CCMsg.ID_DrvLeavesCar.cCC_ID._.tmr_ID_delay.time "test_timer" UWORD SBW_TIMER_10MS_S1_S3 1 100 0 655350 DISPLAY_IDENTIFIER time.tmr_ID_delay._.cCC_ID.ID_DrvLeavesCar.CCMsg ECU_ADDRESS 0xFFF8AA7A /end MEASUREMENT
/begin MEASUREMENT CCMsg.ID_DrvLeavesCar.cCC_ID._.tmr_ID_delay.f_IsExpired "test_timer" UBYTE SBW_STANDARD_S1_S3 1 100 0 255 DISPLAY_IDENTIFIER f_IsExpired.tmr_ID_delay._.cCC_ID.ID_DrvLeavesCar.CCMsg ECU_ADDRESS 0xFFF8AA7C /end MEASUREMENT
/begin MEASUREMENT CCMsg.ID_DrvLeavesCar.cCC_ID._.tmr_ID_CycleTime.time "test_timer" UWORD SBW_TIMER_10MS_S1_S3 1 100 0 655350 DISPLAY_IDENTIFIER time.tmr_ID_CycleTime._.cCC_ID.ID_DrvLeavesCar.CCMsg ECU_ADDRESS 0xFFF8AA7E /end MEASUREMENT
/begin MEASUREMENT CCMsg.ID_DrvLeavesCar.cCC_ID._.tmr_ID_CycleTime.f_IsExpired "test_timer" UBYTE SBW_STANDARD_S1_S3 1 100 0 255 DISPLAY_IDENTIFIER f_IsExpired.tmr_ID_CycleTime._.cCC_ID.ID_DrvLeavesCar.CCMsg ECU_ADDRESS 0xFFF8AA80 /end MEASUREMENT
/begin MEASUREMENT CCMsg.ID_DrvLeavesCar.cCC_ID._.tmr_ID_MinTime.time "test_timer" UWORD SBW_TIMER_10MS_S1_S3 1 100 0 655350 DISPLAY_IDENTIFIER time.tmr_ID_MinTime._.cCC_ID.ID_DrvLeavesCar.CCMsg ECU_ADDRESS 0xFFF8AA82 /end MEASUREMENT
/begin MEASUREMENT CCMsg.ID_DrvLeavesCar.cCC_ID._.tmr_ID_MinTime.f_IsExpired "test_timer" UBYTE SBW_STANDARD_S1_S3 1 100 0 255 DISPLAY_IDENTIFIER f_IsExpired.tmr_ID_MinTime._.cCC_ID.ID_DrvLeavesCar.CCMsg ECU_ADDRESS 0xFFF8AA84 /end MEASUREMENT
/begin MEASUREMENT CCMsg.ID_DrvLeavesCar.cCC_ID._.tmr_ID_HoldCC.time "test_timer" UWORD SBW_TIMER_10MS_S1_S3 1 100 0 655350 DISPLAY_IDENTIFIER time.tmr_ID_HoldCC._.cCC_ID.ID_DrvLeavesCar.CCMsg ECU_ADDRESS 0xFFF8AA86 /end MEASUREMENT
/begin MEASUREMENT CCMsg.ID_DrvLeavesCar.cCC_ID._.tmr_ID_HoldCC.f_IsExpired "test_timer" UBYTE SBW_STANDARD_S1_S3 1 100 0 255 DISPLAY_IDENTIFIER f_IsExpired.tmr_ID_HoldCC._.cCC_ID.ID_DrvLeavesCar.CCMsg ECU_ADDRESS 0xFFF8AA88 /end MEASUREMENT
/begin MEASUREMENT CCMsg.ID_ShifterError.cCC_ID._.tmr_ID_delay.time "test_timer" UWORD SBW_TIMER_10MS_S1_S3 1 100 0 655350 DISPLAY_IDENTIFIER time.tmr_ID_delay._.cCC_ID.ID_ShifterError.CCMsg ECU_ADDRESS 0xFFF8AA9A /end MEASUREMENT
/begin MEASUREMENT CCMsg.ID_ShifterError.cCC_ID._.tmr_ID_delay.f_IsExpired "test_timer" UBYTE SBW_STANDARD_S1_S3 1 100 0 255 DISPLAY_IDENTIFIER f_IsExpired.tmr_ID_delay._.cCC_ID.ID_ShifterError.CCMsg ECU_ADDRESS 0xFFF8AA9C /end MEASUREMENT
/begin MEASUREMENT CCMsg.ID_ShifterError.cCC_ID._.tmr_ID_CycleTime.time "test_timer" UWORD SBW_TIMER_10MS_S1_S3 1 100 0 655350 DISPLAY_IDENTIFIER time.tmr_ID_CycleTime._.cCC_ID.ID_ShifterError.CCMsg ECU_ADDRESS 0xFFF8AA9E /end MEASUREMENT
/begin MEASUREMENT CCMsg.ID_ShifterError.cCC_ID._.tmr_ID_CycleTime.f_IsExpired "test_timer" UBYTE SBW_STANDARD_S1_S3 1 100 0 255 DISPLAY_IDENTIFIER f_IsExpired.tmr_ID_CycleTime._.cCC_ID.ID_ShifterError.CCMsg ECU_ADDRESS 0xFFF8AAA0 /end MEASUREMENT
/begin MEASUREMENT CCMsg.ID_ShifterError.cCC_ID._.tmr_ID_MinTime.time "test_timer" UWORD SBW_TIMER_10MS_S1_S3 1 100 0 655350 DISPLAY_IDENTIFIER time.tmr_ID_MinTime._.cCC_ID.ID_ShifterError.CCMsg ECU_ADDRESS 0xFFF8AAA2 /end MEASUREMENT
/begin MEASUREMENT CCMsg.ID_ShifterError.cCC_ID._.tmr_ID_MinTime.f_IsExpired "test_timer" UBYTE SBW_STANDARD_S1_S3 1 100 0 255 DISPLAY_IDENTIFIER f_IsExpired.tmr_ID_MinTime._.cCC_ID.ID_ShifterError.CCMsg ECU_ADDRESS 0xFFF8AAA4 /end MEASUREMENT
/begin MEASUREMENT CCMsg.ID_ShifterError.cCC_ID._.tmr_ID_HoldCC.time "test_timer" UWORD SBW_TIMER_10MS_S1_S3 1 100 0 655350 DISPLAY_IDENTIFIER time.tmr_ID_HoldCC._.cCC_ID.ID_ShifterError.CCMsg ECU_ADDRESS 0xFFF8AAA6 /end MEASUREMENT
/begin MEASUREMENT CCMsg.ID_ShifterError.cCC_ID._.tmr_ID_HoldCC.f_IsExpired "test_timer" UBYTE SBW_STANDARD_S1_S3 1 100 0 255 DISPLAY_IDENTIFIER f_IsExpired.tmr_ID_HoldCC._.cCC_ID.ID_ShifterError.CCMsg ECU_ADDRESS 0xFFF8AAA8 /end MEASUREMENT
/begin MEASUREMENT CCMsg.ID_P_ButtonError.cCC_ID._.tmr_ID_delay.time "test_timer" UWORD SBW_TIMER_10MS_S1_S3 1 100 0 655350 DISPLAY_IDENTIFIER time.tmr_ID_delay._.cCC_ID.ID_P_ButtonError.CCMsg ECU_ADDRESS 0xFFF8AABA /end MEASUREMENT
/begin MEASUREMENT CCMsg.ID_P_ButtonError.cCC_ID._.tmr_ID_delay.f_IsExpired "test_timer" UBYTE SBW_STANDARD_S1_S3 1 100 0 255 DISPLAY_IDENTIFIER f_IsExpired.tmr_ID_delay._.cCC_ID.ID_P_ButtonError.CCMsg ECU_ADDRESS 0xFFF8AABC /end MEASUREMENT
/begin MEASUREMENT CCMsg.ID_P_ButtonError.cCC_ID._.tmr_ID_CycleTime.time "test_timer" UWORD SBW_TIMER_10MS_S1_S3 1 100 0 655350 DISPLAY_IDENTIFIER time.tmr_ID_CycleTime._.cCC_ID.ID_P_ButtonError.CCMsg ECU_ADDRESS 0xFFF8AABE /end MEASUREMENT
/begin MEASUREMENT CCMsg.ID_P_ButtonError.cCC_ID._.tmr_ID_CycleTime.f_IsExpired "test_timer" UBYTE SBW_STANDARD_S1_S3 1 100 0 255 DISPLAY_IDENTIFIER f_IsExpired.tmr_ID_CycleTime._.cCC_ID.ID_P_ButtonError.CCMsg ECU_ADDRESS 0xFFF8AAC0 /end MEASUREMENT
/begin MEASUREMENT CCMsg.ID_P_ButtonError.cCC_ID._.tmr_ID_MinTime.time "test_timer" UWORD SBW_TIMER_10MS_S1_S3 1 100 0 655350 DISPLAY_IDENTIFIER time.tmr_ID_MinTime._.cCC_ID.ID_P_ButtonError.CCMsg ECU_ADDRESS 0xFFF8AAC2 /end MEASUREMENT
/begin MEASUREMENT CCMsg.ID_P_ButtonError.cCC_ID._.tmr_ID_MinTime.f_IsExpired "test_timer" UBYTE SBW_STANDARD_S1_S3 1 100 0 255 DISPLAY_IDENTIFIER f_IsExpired.tmr_ID_MinTime._.cCC_ID.ID_P_ButtonError.CCMsg ECU_ADDRESS 0xFFF8AAC4 /end MEASUREMENT
/begin MEASUREMENT CCMsg.ID_P_ButtonError.cCC_ID._.tmr_ID_HoldCC.time "test_timer" UWORD SBW_TIMER_10MS_S1_S3 1 100 0 655350 DISPLAY_IDENTIFIER time.tmr_ID_HoldCC._.cCC_ID.ID_P_ButtonError.CCMsg ECU_ADDRESS 0xFFF8AAC6 /end MEASUREMENT
/begin MEASUREMENT CCMsg.ID_P_ButtonError.cCC_ID._.tmr_ID_HoldCC.f_IsExpired "test_timer" UBYTE SBW_STANDARD_S1_S3 1 100 0 255 DISPLAY_IDENTIFIER f_IsExpired.tmr_ID_HoldCC._.cCC_ID.ID_P_ButtonError.CCMsg ECU_ADDRESS 0xFFF8AAC8 /end MEASUREMENT
/begin MEASUREMENT CCMsg.ID_GearboxWarning2.cCC_ID._.tmr_ID_delay.time "test_timer" UWORD SBW_TIMER_10MS_S1_S3 1 100 0 655350 DISPLAY_IDENTIFIER time.tmr_ID_delay._.cCC_ID.ID_GearboxWarning2.CCMsg ECU_ADDRESS 0xFFF8AADA /end MEASUREMENT
/begin MEASUREMENT CCMsg.ID_GearboxWarning2.cCC_ID._.tmr_ID_delay.f_IsExpired "test_timer" UBYTE SBW_STANDARD_S1_S3 1 100 0 255 DISPLAY_IDENTIFIER f_IsExpired.tmr_ID_delay._.cCC_ID.ID_GearboxWarning2.CCMsg ECU_ADDRESS 0xFFF8AADC /end MEASUREMENT
/begin MEASUREMENT CCMsg.ID_GearboxWarning2.cCC_ID._.tmr_ID_CycleTime.time "test_timer" UWORD SBW_TIMER_10MS_S1_S3 1 100 0 655350 DISPLAY_IDENTIFIER time.tmr_ID_CycleTime._.cCC_ID.ID_GearboxWarning2.CCMsg ECU_ADDRESS 0xFFF8AADE /end MEASUREMENT
/begin MEASUREMENT CCMsg.ID_GearboxWarning2.cCC_ID._.tmr_ID_CycleTime.f_IsExpired "test_timer" UBYTE SBW_STANDARD_S1_S3 1 100 0 255 DISPLAY_IDENTIFIER f_IsExpired.tmr_ID_CycleTime._.cCC_ID.ID_GearboxWarning2.CCMsg ECU_ADDRESS 0xFFF8AAE0 /end MEASUREMENT
/begin MEASUREMENT CCMsg.ID_GearboxWarning2.cCC_ID._.tmr_ID_MinTime.time "test_timer" UWORD SBW_TIMER_10MS_S1_S3 1 100 0 655350 DISPLAY_IDENTIFIER time.tmr_ID_MinTime._.cCC_ID.ID_GearboxWarning2.CCMsg ECU_ADDRESS 0xFFF8AAE2 /end MEASUREMENT
/begin MEASUREMENT CCMsg.ID_GearboxWarning2.cCC_ID._.tmr_ID_MinTime.f_IsExpired "test_timer" UBYTE SBW_STANDARD_S1_S3 1 100 0 255 DISPLAY_IDENTIFIER f_IsExpired.tmr_ID_MinTime._.cCC_ID.ID_GearboxWarning2.CCMsg ECU_ADDRESS 0xFFF8AAE4 /end MEASUREMENT
/begin MEASUREMENT CCMsg.ID_GearboxWarning2.cCC_ID._.tmr_ID_HoldCC.time "test_timer" UWORD SBW_TIMER_10MS_S1_S3 1 100 0 655350 DISPLAY_IDENTIFIER time.tmr_ID_HoldCC._.cCC_ID.ID_GearboxWarning2.CCMsg ECU_ADDRESS 0xFFF8AAE6 /end MEASUREMENT
/begin MEASUREMENT CCMsg.ID_GearboxWarning2.cCC_ID._.tmr_ID_HoldCC.f_IsExpired "test_timer" UBYTE SBW_STANDARD_S1_S3 1 100 0 255 DISPLAY_IDENTIFIER f_IsExpired.tmr_ID_HoldCC._.cCC_ID.ID_GearboxWarning2.CCMsg ECU_ADDRESS 0xFFF8AAE8 /end MEASUREMENT
/begin MEASUREMENT CCMsg.ID_GearboxWarning1.cCC_ID._.tmr_ID_delay.time "test_timer" UWORD SBW_TIMER_10MS_S1_S3 1 100 0 655350 DISPLAY_IDENTIFIER time.tmr_ID_delay._.cCC_ID.ID_GearboxWarning1.CCMsg ECU_ADDRESS 0xFFF8AAFA /end MEASUREMENT
/begin MEASUREMENT CCMsg.ID_GearboxWarning1.cCC_ID._.tmr_ID_delay.f_IsExpired "test_timer" UBYTE SBW_STANDARD_S1_S3 1 100 0 255 DISPLAY_IDENTIFIER f_IsExpired.tmr_ID_delay._.cCC_ID.ID_GearboxWarning1.CCMsg ECU_ADDRESS 0xFFF8AAFC /end MEASUREMENT
/begin MEASUREMENT CCMsg.ID_GearboxWarning1.cCC_ID._.tmr_ID_CycleTime.time "test_timer" UWORD SBW_TIMER_10MS_S1_S3 1 100 0 655350 DISPLAY_IDENTIFIER time.tmr_ID_CycleTime._.cCC_ID.ID_GearboxWarning1.CCMsg ECU_ADDRESS 0xFFF8AAFE /end MEASUREMENT
/begin MEASUREMENT CCMsg.ID_GearboxWarning1.cCC_ID._.tmr_ID_CycleTime.f_IsExpired "test_timer" UBYTE SBW_STANDARD_S1_S3 1 100 0 255 DISPLAY_IDENTIFIER f_IsExpired.tmr_ID_CycleTime._.cCC_ID.ID_GearboxWarning1.CCMsg ECU_ADDRESS 0xFFF8AB00 /end MEASUREMENT
/begin MEASUREMENT CCMsg.ID_GearboxWarning1.cCC_ID._.tmr_ID_MinTime.time "test_timer" UWORD SBW_TIMER_10MS_S1_S3 1 100 0 655350 DISPLAY_IDENTIFIER time.tmr_ID_MinTime._.cCC_ID.ID_GearboxWarning1.CCMsg ECU_ADDRESS 0xFFF8AB02 /end MEASUREMENT
/begin MEASUREMENT CCMsg.ID_GearboxWarning1.cCC_ID._.tmr_ID_MinTime.f_IsExpired "test_timer" UBYTE SBW_STANDARD_S1_S3 1 100 0 255 DISPLAY_IDENTIFIER f_IsExpired.tmr_ID_MinTime._.cCC_ID.ID_GearboxWarning1.CCMsg ECU_ADDRESS 0xFFF8AB04 /end MEASUREMENT
/begin MEASUREMENT CCMsg.ID_GearboxWarning1.cCC_ID._.tmr_ID_HoldCC.time "test_timer" UWORD SBW_TIMER_10MS_S1_S3 1 100 0 655350 DISPLAY_IDENTIFIER time.tmr_ID_HoldCC._.cCC_ID.ID_GearboxWarning1.CCMsg ECU_ADDRESS 0xFFF8AB06 /end MEASUREMENT
/begin MEASUREMENT CCMsg.ID_GearboxWarning1.cCC_ID._.tmr_ID_HoldCC.f_IsExpired "test_timer" UBYTE SBW_STANDARD_S1_S3 1 100 0 255 DISPLAY_IDENTIFIER f_IsExpired.tmr_ID_HoldCC._.cCC_ID.ID_GearboxWarning1.CCMsg ECU_ADDRESS 0xFFF8AB08 /end MEASUREMENT
/begin MEASUREMENT CCMsg.ID_PS_Abuse.cCC_ID._.tmr_ID_delay.time "test_timer" UWORD SBW_TIMER_10MS_S1_S3 1 100 0 655350 DISPLAY_IDENTIFIER time.tmr_ID_delay._.cCC_ID.ID_PS_Abuse.CCMsg ECU_ADDRESS 0xFFF8AB1A /end MEASUREMENT
/begin MEASUREMENT CCMsg.ID_PS_Abuse.cCC_ID._.tmr_ID_delay.f_IsExpired "test_timer" UBYTE SBW_STANDARD_S1_S3 1 100 0 255 DISPLAY_IDENTIFIER f_IsExpired.tmr_ID_delay._.cCC_ID.ID_PS_Abuse.CCMsg ECU_ADDRESS 0xFFF8AB1C /end MEASUREMENT
/begin MEASUREMENT CCMsg.ID_PS_Abuse.cCC_ID._.tmr_ID_CycleTime.time "test_timer" UWORD SBW_TIMER_10MS_S1_S3 1 100 0 655350 DISPLAY_IDENTIFIER time.tmr_ID_CycleTime._.cCC_ID.ID_PS_Abuse.CCMsg ECU_ADDRESS 0xFFF8AB1E /end MEASUREMENT
/begin MEASUREMENT CCMsg.ID_PS_Abuse.cCC_ID._.tmr_ID_CycleTime.f_IsExpired "test_timer" UBYTE SBW_STANDARD_S1_S3 1 100 0 255 DISPLAY_IDENTIFIER f_IsExpired.tmr_ID_CycleTime._.cCC_ID.ID_PS_Abuse.CCMsg ECU_ADDRESS 0xFFF8AB20 /end MEASUREMENT
/begin MEASUREMENT CCMsg.ID_PS_Abuse.cCC_ID._.tmr_ID_MinTime.time "test_timer" UWORD SBW_TIMER_10MS_S1_S3 1 100 0 655350 DISPLAY_IDENTIFIER time.tmr_ID_MinTime._.cCC_ID.ID_PS_Abuse.CCMsg ECU_ADDRESS 0xFFF8AB22 /end MEASUREMENT
/begin MEASUREMENT CCMsg.ID_PS_Abuse.cCC_ID._.tmr_ID_MinTime.f_IsExpired "test_timer" UBYTE SBW_STANDARD_S1_S3 1 100 0 255 DISPLAY_IDENTIFIER f_IsExpired.tmr_ID_MinTime._.cCC_ID.ID_PS_Abuse.CCMsg ECU_ADDRESS 0xFFF8AB24 /end MEASUREMENT
/begin MEASUREMENT CCMsg.ID_PS_Abuse.cCC_ID._.tmr_ID_HoldCC.time "test_timer" UWORD SBW_TIMER_10MS_S1_S3 1 100 0 655350 DISPLAY_IDENTIFIER time.tmr_ID_HoldCC._.cCC_ID.ID_PS_Abuse.CCMsg ECU_ADDRESS 0xFFF8AB26 /end MEASUREMENT
/begin MEASUREMENT CCMsg.ID_PS_Abuse.cCC_ID._.tmr_ID_HoldCC.f_IsExpired "test_timer" UBYTE SBW_STANDARD_S1_S3 1 100 0 255 DISPLAY_IDENTIFIER f_IsExpired.tmr_ID_HoldCC._.cCC_ID.ID_PS_Abuse.CCMsg ECU_ADDRESS 0xFFF8AB28 /end MEASUREMENT
/begin MEASUREMENT CCMsg.ID_V_ImplausibleInPosP.cCC_ID._.tmr_ID_delay.time "test_timer" UWORD SBW_TIMER_10MS_S1_S3 1 100 0 655350 DISPLAY_IDENTIFIER time.tmr_ID_delay._.cCC_ID.ID_V_ImplausibleInPosP.CCMsg ECU_ADDRESS 0xFFF8AB3A /end MEASUREMENT
/begin MEASUREMENT CCMsg.ID_V_ImplausibleInPosP.cCC_ID._.tmr_ID_delay.f_IsExpired "test_timer" UBYTE SBW_STANDARD_S1_S3 1 100 0 255 DISPLAY_IDENTIFIER f_IsExpired.tmr_ID_delay._.cCC_ID.ID_V_ImplausibleInPosP.CCMsg ECU_ADDRESS 0xFFF8AB3C /end MEASUREMENT
/begin MEASUREMENT CCMsg.ID_V_ImplausibleInPosP.cCC_ID._.tmr_ID_CycleTime.time "test_timer" UWORD SBW_TIMER_10MS_S1_S3 1 100 0 655350 DISPLAY_IDENTIFIER time.tmr_ID_CycleTime._.cCC_ID.ID_V_ImplausibleInPosP.CCMsg ECU_ADDRESS 0xFFF8AB3E /end MEASUREMENT
/begin MEASUREMENT CCMsg.ID_V_ImplausibleInPosP.cCC_ID._.tmr_ID_CycleTime.f_IsExpired "test_timer" UBYTE SBW_STANDARD_S1_S3 1 100 0 255 DISPLAY_IDENTIFIER f_IsExpired.tmr_ID_CycleTime._.cCC_ID.ID_V_ImplausibleInPosP.CCMsg ECU_ADDRESS 0xFFF8AB40 /end MEASUREMENT
/begin MEASUREMENT CCMsg.ID_V_ImplausibleInPosP.cCC_ID._.tmr_ID_MinTime.time "test_timer" UWORD SBW_TIMER_10MS_S1_S3 1 100 0 655350 DISPLAY_IDENTIFIER time.tmr_ID_MinTime._.cCC_ID.ID_V_ImplausibleInPosP.CCMsg ECU_ADDRESS 0xFFF8AB42 /end MEASUREMENT
/begin MEASUREMENT CCMsg.ID_V_ImplausibleInPosP.cCC_ID._.tmr_ID_MinTime.f_IsExpired "test_timer" UBYTE SBW_STANDARD_S1_S3 1 100 0 255 DISPLAY_IDENTIFIER f_IsExpired.tmr_ID_MinTime._.cCC_ID.ID_V_ImplausibleInPosP.CCMsg ECU_ADDRESS 0xFFF8AB44 /end MEASUREMENT
/begin MEASUREMENT CCMsg.ID_V_ImplausibleInPosP.cCC_ID._.tmr_ID_HoldCC.time "test_timer" UWORD SBW_TIMER_10MS_S1_S3 1 100 0 655350 DISPLAY_IDENTIFIER time.tmr_ID_HoldCC._.cCC_ID.ID_V_ImplausibleInPosP.CCMsg ECU_ADDRESS 0xFFF8AB46 /end MEASUREMENT
/begin MEASUREMENT CCMsg.ID_V_ImplausibleInPosP.cCC_ID._.tmr_ID_HoldCC.f_IsExpired "test_timer" UBYTE SBW_STANDARD_S1_S3 1 100 0 255 DISPLAY_IDENTIFIER f_IsExpired.tmr_ID_HoldCC._.cCC_ID.ID_V_ImplausibleInPosP.CCMsg ECU_ADDRESS 0xFFF8AB48 /end MEASUREMENT
/begin MEASUREMENT CCMsg.ID_IgnitionError.cCC_ID._.tmr_ID_delay.time "test_timer" UWORD SBW_TIMER_10MS_S1_S3 1 100 0 655350 DISPLAY_IDENTIFIER time.tmr_ID_delay._.cCC_ID.ID_IgnitionError.CCMsg ECU_ADDRESS 0xFFF8AB5A /end MEASUREMENT
/begin MEASUREMENT CCMsg.ID_IgnitionError.cCC_ID._.tmr_ID_delay.f_IsExpired "test_timer" UBYTE SBW_STANDARD_S1_S3 1 100 0 255 DISPLAY_IDENTIFIER f_IsExpired.tmr_ID_delay._.cCC_ID.ID_IgnitionError.CCMsg ECU_ADDRESS 0xFFF8AB5C /end MEASUREMENT
/begin MEASUREMENT CCMsg.ID_IgnitionError.cCC_ID._.tmr_ID_CycleTime.time "test_timer" UWORD SBW_TIMER_10MS_S1_S3 1 100 0 655350 DISPLAY_IDENTIFIER time.tmr_ID_CycleTime._.cCC_ID.ID_IgnitionError.CCMsg ECU_ADDRESS 0xFFF8AB5E /end MEASUREMENT
/begin MEASUREMENT CCMsg.ID_IgnitionError.cCC_ID._.tmr_ID_CycleTime.f_IsExpired "test_timer" UBYTE SBW_STANDARD_S1_S3 1 100 0 255 DISPLAY_IDENTIFIER f_IsExpired.tmr_ID_CycleTime._.cCC_ID.ID_IgnitionError.CCMsg ECU_ADDRESS 0xFFF8AB60 /end MEASUREMENT
/begin MEASUREMENT CCMsg.ID_IgnitionError.cCC_ID._.tmr_ID_MinTime.time "test_timer" UWORD SBW_TIMER_10MS_S1_S3 1 100 0 655350 DISPLAY_IDENTIFIER time.tmr_ID_MinTime._.cCC_ID.ID_IgnitionError.CCMsg ECU_ADDRESS 0xFFF8AB62 /end MEASUREMENT
/begin MEASUREMENT CCMsg.ID_IgnitionError.cCC_ID._.tmr_ID_MinTime.f_IsExpired "test_timer" UBYTE SBW_STANDARD_S1_S3 1 100 0 255 DISPLAY_IDENTIFIER f_IsExpired.tmr_ID_MinTime._.cCC_ID.ID_IgnitionError.CCMsg ECU_ADDRESS 0xFFF8AB64 /end MEASUREMENT
/begin MEASUREMENT CCMsg.ID_IgnitionError.cCC_ID._.tmr_ID_HoldCC.time "test_timer" UWORD SBW_TIMER_10MS_S1_S3 1 100 0 655350 DISPLAY_IDENTIFIER time.tmr_ID_HoldCC._.cCC_ID.ID_IgnitionError.CCMsg ECU_ADDRESS 0xFFF8AB66 /end MEASUREMENT
/begin MEASUREMENT CCMsg.ID_IgnitionError.cCC_ID._.tmr_ID_HoldCC.f_IsExpired "test_timer" UBYTE SBW_STANDARD_S1_S3 1 100 0 255 DISPLAY_IDENTIFIER f_IsExpired.tmr_ID_HoldCC._.cCC_ID.ID_IgnitionError.CCMsg ECU_ADDRESS 0xFFF8AB68 /end MEASUREMENT
/begin MEASUREMENT CCMsg.ID_DrvLeavesCar_BeltLocked.cCC_ID._.tmr_ID_delay.time "test_timer" UWORD SBW_TIMER_10MS_S1_S3 1 100 0 655350 DISPLAY_IDENTIFIER time.tmr_ID_delay._.cCC_ID.ID_DrvLeavesCar_BeltLocked.CCMsg ECU_ADDRESS 0xFFF8AB7A /end MEASUREMENT
/begin MEASUREMENT CCMsg.ID_DrvLeavesCar_BeltLocked.cCC_ID._.tmr_ID_delay.f_IsExpired "test_timer" UBYTE SBW_STANDARD_S1_S3 1 100 0 255 DISPLAY_IDENTIFIER f_IsExpired.tmr_ID_delay._.cCC_ID.ID_DrvLeavesCar_BeltLocked.CCMsg ECU_ADDRESS 0xFFF8AB7C /end MEASUREMENT
/begin MEASUREMENT CCMsg.ID_DrvLeavesCar_BeltLocked.cCC_ID._.tmr_ID_CycleTime.time "test_timer" UWORD SBW_TIMER_10MS_S1_S3 1 100 0 655350 DISPLAY_IDENTIFIER time.tmr_ID_CycleTime._.cCC_ID.ID_DrvLeavesCar_BeltLocked.CCMsg ECU_ADDRESS 0xFFF8AB7E /end MEASUREMENT
/begin MEASUREMENT CCMsg.ID_DrvLeavesCar_BeltLocked.cCC_ID._.tmr_ID_CycleTime.f_IsExpired "test_timer" UBYTE SBW_STANDARD_S1_S3 1 100 0 255 DISPLAY_IDENTIFIER f_IsExpired.tmr_ID_CycleTime._.cCC_ID.ID_DrvLeavesCar_BeltLocked.CCMsg ECU_ADDRESS 0xFFF8AB80 /end MEASUREMENT
/begin MEASUREMENT CCMsg.ID_DrvLeavesCar_BeltLocked.cCC_ID._.tmr_ID_MinTime.time "test_timer" UWORD SBW_TIMER_10MS_S1_S3 1 100 0 655350 DISPLAY_IDENTIFIER time.tmr_ID_MinTime._.cCC_ID.ID_DrvLeavesCar_BeltLocked.CCMsg ECU_ADDRESS 0xFFF8AB82 /end MEASUREMENT
/begin MEASUREMENT CCMsg.ID_DrvLeavesCar_BeltLocked.cCC_ID._.tmr_ID_MinTime.f_IsExpired "test_timer" UBYTE SBW_STANDARD_S1_S3 1 100 0 255 DISPLAY_IDENTIFIER f_IsExpired.tmr_ID_MinTime._.cCC_ID.ID_DrvLeavesCar_BeltLocked.CCMsg ECU_ADDRESS 0xFFF8AB84 /end MEASUREMENT
/begin MEASUREMENT CCMsg.ID_DrvLeavesCar_BeltLocked.cCC_ID._.tmr_ID_HoldCC.time "test_timer" UWORD SBW_TIMER_10MS_S1_S3 1 100 0 655350 DISPLAY_IDENTIFIER time.tmr_ID_HoldCC._.cCC_ID.ID_DrvLeavesCar_BeltLocked.CCMsg ECU_ADDRESS 0xFFF8AB86 /end MEASUREMENT
/begin MEASUREMENT CCMsg.ID_DrvLeavesCar_BeltLocked.cCC_ID._.tmr_ID_HoldCC.f_IsExpired "test_timer" UBYTE SBW_STANDARD_S1_S3 1 100 0 255 DISPLAY_IDENTIFIER f_IsExpired.tmr_ID_HoldCC._.cCC_ID.ID_DrvLeavesCar_BeltLocked.CCMsg ECU_ADDRESS 0xFFF8AB88 /end MEASUREMENT
/begin MEASUREMENT CCMsg.IDEmpty.cCC_ID._.tmr_ID_delay.time "test_timer" UWORD SBW_TIMER_10MS_S1_S3 1 100 0 655350 DISPLAY_IDENTIFIER time.tmr_ID_delay._.cCC_ID.IDEmpty.CCMsg ECU_ADDRESS 0xFFF8AB9A /end MEASUREMENT
/begin MEASUREMENT CCMsg.IDEmpty.cCC_ID._.tmr_ID_delay.f_IsExpired "test_timer" UBYTE SBW_STANDARD_S1_S3 1 100 0 255 DISPLAY_IDENTIFIER f_IsExpired.tmr_ID_delay._.cCC_ID.IDEmpty.CCMsg ECU_ADDRESS 0xFFF8AB9C /end MEASUREMENT
/begin MEASUREMENT CCMsg.IDEmpty.cCC_ID._.tmr_ID_CycleTime.time "test_timer" UWORD SBW_TIMER_10MS_S1_S3 1 100 0 655350 DISPLAY_IDENTIFIER time.tmr_ID_CycleTime._.cCC_ID.IDEmpty.CCMsg ECU_ADDRESS 0xFFF8AB9E /end MEASUREMENT
/begin MEASUREMENT CCMsg.IDEmpty.cCC_ID._.tmr_ID_CycleTime.f_IsExpired "test_timer" UBYTE SBW_STANDARD_S1_S3 1 100 0 255 DISPLAY_IDENTIFIER f_IsExpired.tmr_ID_CycleTime._.cCC_ID.IDEmpty.CCMsg ECU_ADDRESS 0xFFF8ABA0 /end MEASUREMENT
/begin MEASUREMENT CCMsg.IDEmpty.cCC_ID._.tmr_ID_MinTime.time "test_timer" UWORD SBW_TIMER_10MS_S1_S3 1 100 0 655350 DISPLAY_IDENTIFIER time.tmr_ID_MinTime._.cCC_ID.IDEmpty.CCMsg ECU_ADDRESS 0xFFF8ABA2 /end MEASUREMENT
/begin MEASUREMENT CCMsg.IDEmpty.cCC_ID._.tmr_ID_MinTime.f_IsExpired "test_timer" UBYTE SBW_STANDARD_S1_S3 1 100 0 255 DISPLAY_IDENTIFIER f_IsExpired.tmr_ID_MinTime._.cCC_ID.IDEmpty.CCMsg ECU_ADDRESS 0xFFF8ABA4 /end MEASUREMENT
/begin MEASUREMENT CCMsg.IDEmpty.cCC_ID._.tmr_ID_HoldCC.time "test_timer" UWORD SBW_TIMER_10MS_S1_S3 1 100 0 655350 DISPLAY_IDENTIFIER time.tmr_ID_HoldCC._.cCC_ID.IDEmpty.CCMsg ECU_ADDRESS 0xFFF8ABA6 /end MEASUREMENT
/begin MEASUREMENT CCMsg.IDEmpty.cCC_ID._.tmr_ID_HoldCC.f_IsExpired "test_timer" UBYTE SBW_STANDARD_S1_S3 1 100 0 255 DISPLAY_IDENTIFIER f_IsExpired.tmr_ID_HoldCC._.cCC_ID.IDEmpty.CCMsg ECU_ADDRESS 0xFFF8ABA8 /end MEASUREMENT
/begin MEASUREMENT tmr_StarterReleaseBPRam.timeBuf.value "checksum protected timer" UWORD SBW_TIMER_10MS_S1_S3 1 100 0 655350 DISPLAY_IDENTIFIER value.timeBuf.tmr_StarterReleaseBPRam ECU_ADDRESS 0xFFF83B00 /end MEASUREMENT
/begin MEASUREMENT tmr_StarterReleaseBPRam.f_IsExpired.value "Timer expired" UBYTE SBW_STANDARD_S1_S3 1 100 0 1 BIT_MASK 0x1 DISPLAY_IDENTIFIER value.f_IsExpired.tmr_StarterReleaseBPRam ECU_ADDRESS 0xFFF83B02 /end MEASUREMENT
/begin MEASUREMENT tmr_StarterReleaseBPRam.checksum "Checksum of TimerDownChecksumUi16" ULONG SBW_STANDARD_S1_S3 1 100 0 4294967295 DISPLAY_IDENTIFIER checksum.tmr_StarterReleaseBPRam ECU_ADDRESS 0xFFF83B04 /end MEASUREMENT
/begin MEASUREMENT L2_EngineSignals.L2_tmr_DebounceGearboxReady.time.Value "test_timer" UBYTE SBW_TIMER_10MS_S1_S3 1 100 0 2550 DISPLAY_IDENTIFIER Value.time.L2_tmr_DebounceGearboxReady.L2_EngineSignals ECU_ADDRESS 0xFFF99932 /end MEASUREMENT
/begin MEASUREMENT L2_EngineSignals.L2_tmr_DebounceGearboxReady.time.Complement "test_timer" UBYTE SBW_STANDARD_S1_S3 1 100 0 255 DISPLAY_IDENTIFIER Complement.time.L2_tmr_DebounceGearboxReady.L2_EngineSignals ECU_ADDRESS 0xFFF99933 /end MEASUREMENT
/begin MEASUREMENT L2_EngineSignals.L2_tmr_DebounceGearboxReady.f_IsExpired.Value "test_timer" UBYTE SBW_STANDARD_S1_S3 1 100 0 255 DISPLAY_IDENTIFIER Value.f_IsExpired.L2_tmr_DebounceGearboxReady.L2_EngineSignals ECU_ADDRESS 0xFFF99934 /end MEASUREMENT
/begin MEASUREMENT L2_EngineSignals.L2_tmr_DebounceGearboxReady.f_IsExpired.Complement "test_timer" UBYTE SBW_STANDARD_S1_S3 1 100 0 255 DISPLAY_IDENTIFIER Complement.f_IsExpired.L2_tmr_DebounceGearboxReady.L2_EngineSignals ECU_ADDRESS 0xFFF99935 /end MEASUREMENT
/begin MEASUREMENT L2_EngineSignals.L2_tmr_DebounceGearboxReadySts.time.Value "test_timer" UBYTE SBW_TIMER_10MS_S1_S3 1 100 0 2550 DISPLAY_IDENTIFIER Value.time.L2_tmr_DebounceGearboxReadySts.L2_EngineSignals ECU_ADDRESS 0xFFF99936 /end MEASUREMENT
/begin MEASUREMENT L2_EngineSignals.L2_tmr_DebounceGearboxReadySts.time.Complement "test_timer" UBYTE SBW_STANDARD_S1_S3 1 100 0 255 DISPLAY_IDENTIFIER Complement.time.L2_tmr_DebounceGearboxReadySts.L2_EngineSignals ECU_ADDRESS 0xFFF99937 /end MEASUREMENT
/begin MEASUREMENT L2_EngineSignals.L2_tmr_DebounceGearboxReadySts.f_IsExpired.Value "test_timer" UBYTE SBW_STANDARD_S1_S3 1 100 0 255 DISPLAY_IDENTIFIER Value.f_IsExpired.L2_tmr_DebounceGearboxReadySts.L2_EngineSignals ECU_ADDRESS 0xFFF99938 /end MEASUREMENT
/begin MEASUREMENT L2_EngineSignals.L2_tmr_DebounceGearboxReadySts.f_IsExpired.Complement "test_timer" UBYTE SBW_STANDARD_S1_S3 1 100 0 255 DISPLAY_IDENTIFIER Complement.f_IsExpired.L2_tmr_DebounceGearboxReadySts.L2_EngineSignals ECU_ADDRESS 0xFFF99939 /end MEASUREMENT
/begin MEASUREMENT L2_Interfi.L2_f_BrakePedal.Value "flag brake light/brake test" UBYTE SBW_STANDARD_S1_S3 1 100 0 1 BIT_MASK 0x1 DISPLAY_IDENTIFIER Value.L2_f_BrakePedal.L2_Interfi ECU_ADDRESS 0xFFF9853E /end MEASUREMENT
/begin MEASUREMENT L2_Interfi.L2_f_BrakePedal.Complement "flag brake light/brake test" UBYTE SBW_STANDARD_S1_S3 1 100 0 1 BIT_MASK 0x1 DISPLAY_IDENTIFIER Complement.L2_f_BrakePedal.L2_Interfi ECU_ADDRESS 0xFFF9853F /end MEASUREMENT
/begin MEASUREMENT L2_Interfi.L2_BrakePressureSts.Value "flag brake light/brake test" UBYTE SBW_STANDARD_S1_S3 1 100 0 2 DISPLAY_IDENTIFIER Value.L2_BrakePressureSts.L2_Interfi ECU_ADDRESS 0xFFF98540 /end MEASUREMENT
/begin MEASUREMENT L2_Interfi.L2_BrakePressureSts.Complement "flag brake light/brake test" UBYTE SBW_STANDARD_S1_S3 1 100 0 2 DISPLAY_IDENTIFIER Complement.L2_BrakePressureSts.L2_Interfi ECU_ADDRESS 0xFFF98541 /end MEASUREMENT
/begin MEASUREMENT L2_Interfi.L2_BrakePedalSts.Value "state of signal BrakePedal" UBYTE SBW_STANDARD_S1_S3 1 100 0 2 DISPLAY_IDENTIFIER Value.L2_BrakePedalSts.L2_Interfi ECU_ADDRESS 0xFFF98542 /end MEASUREMENT
/begin MEASUREMENT L2_Interfi.L2_BrakePedalSts.Complement "state of signal BrakePedal" UBYTE SBW_STANDARD_S1_S3 1 100 0 2 DISPLAY_IDENTIFIER Complement.L2_BrakePedalSts.L2_Interfi ECU_ADDRESS 0xFFF98543 /end MEASUREMENT
/begin MEASUREMENT PosMonitoring.L2_tmr_N_Request.time.Value "test_timer" UWORD SBW_TIMER_10MS_S1_S3 1 100 0 655350 DISPLAY_IDENTIFIER Value.time.L2_tmr_N_Request.PosMonitoring ECU_ADDRESS 0xFFF9855C /end MEASUREMENT
/begin MEASUREMENT PosMonitoring.L2_tmr_N_Request.time.Complement "test_timer" UWORD SBW_STANDARD_S1_S3 1 100 0 65535 DISPLAY_IDENTIFIER Complement.time.L2_tmr_N_Request.PosMonitoring ECU_ADDRESS 0xFFF9855E /end MEASUREMENT
/begin MEASUREMENT PosMonitoring.L2_tmr_N_Request.f_IsExpired.Value "test_timer" UBYTE SBW_STANDARD_S1_S3 1 100 0 255 DISPLAY_IDENTIFIER Value.f_IsExpired.L2_tmr_N_Request.PosMonitoring ECU_ADDRESS 0xFFF98560 /end MEASUREMENT
/begin MEASUREMENT PosMonitoring.L2_tmr_N_Request.f_IsExpired.Complement "test_timer" UBYTE SBW_STANDARD_S1_S3 1 100 0 255 DISPLAY_IDENTIFIER Complement.f_IsExpired.L2_tmr_N_Request.PosMonitoring ECU_ADDRESS 0xFFF98561 /end MEASUREMENT
/begin MEASUREMENT PosMonitoring.L2_tmr_D_t_StoreN.time.Value "test_timer" UWORD SBW_TIMER_10MS_S1_S3 1 100 0 655350 DISPLAY_IDENTIFIER Value.time.L2_tmr_D_t_StoreN.PosMonitoring ECU_ADDRESS 0xFFF98562 /end MEASUREMENT
/begin MEASUREMENT PosMonitoring.L2_tmr_D_t_StoreN.time.Complement "test_timer" UWORD SBW_STANDARD_S1_S3 1 100 0 65535 DISPLAY_IDENTIFIER Complement.time.L2_tmr_D_t_StoreN.PosMonitoring ECU_ADDRESS 0xFFF98564 /end MEASUREMENT
/begin MEASUREMENT PosMonitoring.L2_tmr_D_t_StoreN.f_IsExpired.Value "test_timer" UBYTE SBW_STANDARD_S1_S3 1 100 0 255 DISPLAY_IDENTIFIER Value.f_IsExpired.L2_tmr_D_t_StoreN.PosMonitoring ECU_ADDRESS 0xFFF98566 /end MEASUREMENT
/begin MEASUREMENT PosMonitoring.L2_tmr_D_t_StoreN.f_IsExpired.Complement "test_timer" UBYTE SBW_STANDARD_S1_S3 1 100 0 255 DISPLAY_IDENTIFIER Complement.f_IsExpired.L2_tmr_D_t_StoreN.PosMonitoring ECU_ADDRESS 0xFFF98567 /end MEASUREMENT
/begin MEASUREMENT DebounceMonitoring.L2_tmr_WaitForDebouncedDrvReq.time.Value "test_timer" UWORD SBW_TIMER_10MS_S1_S3 1 100 0 655350 DISPLAY_IDENTIFIER Value.time.L2_tmr_WaitForDebouncedDrvReq.DebounceMonitoring ECU_ADDRESS 0xFFF99950 /end MEASUREMENT
/begin MEASUREMENT DebounceMonitoring.L2_tmr_WaitForDebouncedDrvReq.time.Complement "test_timer" UWORD SBW_STANDARD_S1_S3 1 100 0 65535 DISPLAY_IDENTIFIER Complement.time.L2_tmr_WaitForDebouncedDrvReq.DebounceMonitoring ECU_ADDRESS 0xFFF99952 /end MEASUREMENT
/begin MEASUREMENT DebounceMonitoring.L2_tmr_WaitForDebouncedDrvReq.f_IsExpired.Value "test_timer" UBYTE SBW_STANDARD_S1_S3 1 100 0 255 DISPLAY_IDENTIFIER Value.f_IsExpired.L2_tmr_WaitForDebouncedDrvReq.DebounceMonitoring ECU_ADDRESS 0xFFF99954 /end MEASUREMENT
/begin MEASUREMENT DebounceMonitoring.L2_tmr_WaitForDebouncedDrvReq.f_IsExpired.Complement "test_timer" UBYTE SBW_STANDARD_S1_S3 1 100 0 255 DISPLAY_IDENTIFIER Complement.f_IsExpired.L2_tmr_WaitForDebouncedDrvReq.DebounceMonitoring ECU_ADDRESS 0xFFF99955 /end MEASUREMENT
/begin MEASUREMENT UnintendedTraction.L2_tmr_R_Request.time.Value "test_timer" ULONG SBW_TIMER_10MS_S1_S3 1 100 0 42949672950 DISPLAY_IDENTIFIER Value.time.L2_tmr_R_Request.UnintendedTraction ECU_ADDRESS 0xFFF9856C /end MEASUREMENT
/begin MEASUREMENT UnintendedTraction.L2_tmr_R_Request.time.Complement "test_timer" ULONG SBW_STANDARD_S1_S3 1 100 0 4294967295 DISPLAY_IDENTIFIER Complement.time.L2_tmr_R_Request.UnintendedTraction ECU_ADDRESS 0xFFF98570 /end MEASUREMENT
/begin MEASUREMENT UnintendedTraction.L2_tmr_R_Request.f_IsExpired.Value "test_timer" UBYTE SBW_STANDARD_S1_S3 1 100 0 255 DISPLAY_IDENTIFIER Value.f_IsExpired.L2_tmr_R_Request.UnintendedTraction ECU_ADDRESS 0xFFF98574 /end MEASUREMENT
/begin MEASUREMENT UnintendedTraction.L2_tmr_R_Request.f_IsExpired.Complement "test_timer" UBYTE SBW_STANDARD_S1_S3 1 100 0 255 DISPLAY_IDENTIFIER Complement.f_IsExpired.L2_tmr_R_Request.UnintendedTraction ECU_ADDRESS 0xFFF98575 /end MEASUREMENT
/begin MEASUREMENT UnintendedTraction.L2_tmr_D_Request.time.Value "test_timer" ULONG SBW_TIMER_10MS_S1_S3 1 100 0 42949672950 DISPLAY_IDENTIFIER Value.time.L2_tmr_D_Request.UnintendedTraction ECU_ADDRESS 0xFFF98578 /end MEASUREMENT
/begin MEASUREMENT UnintendedTraction.L2_tmr_D_Request.time.Complement "test_timer" ULONG SBW_STANDARD_S1_S3 1 100 0 4294967295 DISPLAY_IDENTIFIER Complement.time.L2_tmr_D_Request.UnintendedTraction ECU_ADDRESS 0xFFF9857C /end MEASUREMENT
/begin MEASUREMENT UnintendedTraction.L2_tmr_D_Request.f_IsExpired.Value "test_timer" UBYTE SBW_STANDARD_S1_S3 1 100 0 255 DISPLAY_IDENTIFIER Value.f_IsExpired.L2_tmr_D_Request.UnintendedTraction ECU_ADDRESS 0xFFF98580 /end MEASUREMENT
/begin MEASUREMENT UnintendedTraction.L2_tmr_D_Request.f_IsExpired.Complement "test_timer" UBYTE SBW_STANDARD_S1_S3 1 100 0 255 DISPLAY_IDENTIFIER Complement.f_IsExpired.L2_tmr_D_Request.UnintendedTraction ECU_ADDRESS 0xFFF98581 /end MEASUREMENT
/begin MEASUREMENT L2_DrvReq.L2_tmr_PosDrvAssistReject.time.Value "test_timer" UBYTE SBW_TIMER_10MS_S1_S3 1 100 0 2550 DISPLAY_IDENTIFIER Value.time.L2_tmr_PosDrvAssistReject.L2_DrvReq ECU_ADDRESS 0xFFF9995A /end MEASUREMENT
/begin MEASUREMENT L2_DrvReq.L2_tmr_PosDrvAssistReject.time.Complement "test_timer" UBYTE SBW_STANDARD_S1_S3 1 100 0 255 DISPLAY_IDENTIFIER Complement.time.L2_tmr_PosDrvAssistReject.L2_DrvReq ECU_ADDRESS 0xFFF9995B /end MEASUREMENT
/begin MEASUREMENT L2_DrvReq.L2_tmr_PosDrvAssistReject.f_IsExpired.Value "test_timer" UBYTE SBW_STANDARD_S1_S3 1 100 0 255 DISPLAY_IDENTIFIER Value.f_IsExpired.L2_tmr_PosDrvAssistReject.L2_DrvReq ECU_ADDRESS 0xFFF9995C /end MEASUREMENT
/begin MEASUREMENT L2_DrvReq.L2_tmr_PosDrvAssistReject.f_IsExpired.Complement "test_timer" UBYTE SBW_STANDARD_S1_S3 1 100 0 255 DISPLAY_IDENTIFIER Complement.f_IsExpired.L2_tmr_PosDrvAssistReject.L2_DrvReq ECU_ADDRESS 0xFFF9995D /end MEASUREMENT
/begin MEASUREMENT DisplayMonitoring.L2_tmr_FilterNPorRDinsteadDR.time.Value "test_timer" UBYTE SBW_TIMER_10MS_S1_S3 1 100 0 2550 DISPLAY_IDENTIFIER Value.time.L2_tmr_FilterNPorRDinsteadDR.DisplayMonitoring ECU_ADDRESS 0xFFF99982 /end MEASUREMENT
/begin MEASUREMENT DisplayMonitoring.L2_tmr_FilterNPorRDinsteadDR.time.Complement "test_timer" UBYTE SBW_STANDARD_S1_S3 1 100 0 255 DISPLAY_IDENTIFIER Complement.time.L2_tmr_FilterNPorRDinsteadDR.DisplayMonitoring ECU_ADDRESS 0xFFF99983 /end MEASUREMENT
/begin MEASUREMENT DisplayMonitoring.L2_tmr_FilterNPorRDinsteadDR.f_IsExpired.Value "test_timer" UBYTE SBW_STANDARD_S1_S3 1 100 0 255 DISPLAY_IDENTIFIER Value.f_IsExpired.L2_tmr_FilterNPorRDinsteadDR.DisplayMonitoring ECU_ADDRESS 0xFFF99984 /end MEASUREMENT
/begin MEASUREMENT DisplayMonitoring.L2_tmr_FilterNPorRDinsteadDR.f_IsExpired.Complement "test_timer" UBYTE SBW_STANDARD_S1_S3 1 100 0 255 DISPLAY_IDENTIFIER Complement.f_IsExpired.L2_tmr_FilterNPorRDinsteadDR.DisplayMonitoring ECU_ADDRESS 0xFFF99985 /end MEASUREMENT
/begin MEASUREMENT DisplayMonitoring.L2_tmr_BackFilterNPorRDinsteadDR.time.Value "test_timer" UBYTE SBW_TIMER_10MS_S1_S3 1 100 0 2550 DISPLAY_IDENTIFIER Value.time.L2_tmr_BackFilterNPorRDinsteadDR.DisplayMonitoring ECU_ADDRESS 0xFFF99986 /end MEASUREMENT
/begin MEASUREMENT DisplayMonitoring.L2_tmr_BackFilterNPorRDinsteadDR.time.Complement "test_timer" UBYTE SBW_STANDARD_S1_S3 1 100 0 255 DISPLAY_IDENTIFIER Complement.time.L2_tmr_BackFilterNPorRDinsteadDR.DisplayMonitoring ECU_ADDRESS 0xFFF99987 /end MEASUREMENT
/begin MEASUREMENT DisplayMonitoring.L2_tmr_BackFilterNPorRDinsteadDR.f_IsExpired.Value "test_timer" UBYTE SBW_STANDARD_S1_S3 1 100 0 255 DISPLAY_IDENTIFIER Value.f_IsExpired.L2_tmr_BackFilterNPorRDinsteadDR.DisplayMonitoring ECU_ADDRESS 0xFFF99988 /end MEASUREMENT
/begin MEASUREMENT DisplayMonitoring.L2_tmr_BackFilterNPorRDinsteadDR.f_IsExpired.Complement "test_timer" UBYTE SBW_STANDARD_S1_S3 1 100 0 255 DISPLAY_IDENTIFIER Complement.f_IsExpired.L2_tmr_BackFilterNPorRDinsteadDR.DisplayMonitoring ECU_ADDRESS 0xFFF99989 /end MEASUREMENT
/begin MEASUREMENT DisplayMonitoring.L2_tmr_FilterPosPinPosN.time.Value "test_timer" UBYTE SBW_TIMER_10MS_S1_S3 1 100 0 2550 DISPLAY_IDENTIFIER Value.time.L2_tmr_FilterPosPinPosN.DisplayMonitoring ECU_ADDRESS 0xFFF9998A /end MEASUREMENT
/begin MEASUREMENT DisplayMonitoring.L2_tmr_FilterPosPinPosN.time.Complement "test_timer" UBYTE SBW_STANDARD_S1_S3 1 100 0 255 DISPLAY_IDENTIFIER Complement.time.L2_tmr_FilterPosPinPosN.DisplayMonitoring ECU_ADDRESS 0xFFF9998B /end MEASUREMENT
/begin MEASUREMENT DisplayMonitoring.L2_tmr_FilterPosPinPosN.f_IsExpired.Value "test_timer" UBYTE SBW_STANDARD_S1_S3 1 100 0 255 DISPLAY_IDENTIFIER Value.f_IsExpired.L2_tmr_FilterPosPinPosN.DisplayMonitoring ECU_ADDRESS 0xFFF9998C /end MEASUREMENT
/begin MEASUREMENT DisplayMonitoring.L2_tmr_FilterPosPinPosN.f_IsExpired.Complement "test_timer" UBYTE SBW_STANDARD_S1_S3 1 100 0 255 DISPLAY_IDENTIFIER Complement.f_IsExpired.L2_tmr_FilterPosPinPosN.DisplayMonitoring ECU_ADDRESS 0xFFF9998D /end MEASUREMENT
/begin MEASUREMENT DisplayMonitoring.L2_tmr_BackFilterPosPinPosN.time.Value "test_timer" UBYTE SBW_TIMER_10MS_S1_S3 1 100 0 2550 DISPLAY_IDENTIFIER Value.time.L2_tmr_BackFilterPosPinPosN.DisplayMonitoring ECU_ADDRESS 0xFFF9998E /end MEASUREMENT
/begin MEASUREMENT DisplayMonitoring.L2_tmr_BackFilterPosPinPosN.time.Complement "test_timer" UBYTE SBW_STANDARD_S1_S3 1 100 0 255 DISPLAY_IDENTIFIER Complement.time.L2_tmr_BackFilterPosPinPosN.DisplayMonitoring ECU_ADDRESS 0xFFF9998F /end MEASUREMENT
/begin MEASUREMENT DisplayMonitoring.L2_tmr_BackFilterPosPinPosN.f_IsExpired.Value "test_timer" UBYTE SBW_STANDARD_S1_S3 1 100 0 255 DISPLAY_IDENTIFIER Value.f_IsExpired.L2_tmr_BackFilterPosPinPosN.DisplayMonitoring ECU_ADDRESS 0xFFF99990 /end MEASUREMENT
/begin MEASUREMENT DisplayMonitoring.L2_tmr_BackFilterPosPinPosN.f_IsExpired.Complement "test_timer" UBYTE SBW_STANDARD_S1_S3 1 100 0 255 DISPLAY_IDENTIFIER Complement.f_IsExpired.L2_tmr_BackFilterPosPinPosN.DisplayMonitoring ECU_ADDRESS 0xFFF99991 /end MEASUREMENT
/begin MEASUREMENT DisplayMonitoring.L2_tmr_FlashN.time.Value "test_timer" UBYTE SBW_TIMER_10MS_S1_S3 1 100 0 2550 DISPLAY_IDENTIFIER Value.time.L2_tmr_FlashN.DisplayMonitoring ECU_ADDRESS 0xFFF99992 /end MEASUREMENT
/begin MEASUREMENT DisplayMonitoring.L2_tmr_FlashN.time.Complement "test_timer" UBYTE SBW_STANDARD_S1_S3 1 100 0 255 DISPLAY_IDENTIFIER Complement.time.L2_tmr_FlashN.DisplayMonitoring ECU_ADDRESS 0xFFF99993 /end MEASUREMENT
/begin MEASUREMENT DisplayMonitoring.L2_tmr_FlashN.f_IsExpired.Value "test_timer" UBYTE SBW_STANDARD_S1_S3 1 100 0 255 DISPLAY_IDENTIFIER Value.f_IsExpired.L2_tmr_FlashN.DisplayMonitoring ECU_ADDRESS 0xFFF99994 /end MEASUREMENT
/begin MEASUREMENT DisplayMonitoring.L2_tmr_FlashN.f_IsExpired.Complement "test_timer" UBYTE SBW_STANDARD_S1_S3 1 100 0 255 DISPLAY_IDENTIFIER Complement.f_IsExpired.L2_tmr_FlashN.DisplayMonitoring ECU_ADDRESS 0xFFF99995 /end MEASUREMENT
/begin COMPU_METHOD B_TRUE_S1 "boolean states, positive logic" TAB_VERB "%6.3" "" COMPU_TAB_REF B_TRUE_S1 /end COMPU_METHOD
/begin COMPU_METHOD I0_0001_S1 "[0.0001A] current" RAT_FUNC "%7.6" "A" COEFFS 0 10000 0 0 0 1 /end COMPU_METHOD
/begin COMPU_METHOD Q_SIG_S1 "signal quality information" TAB_VERB "%6.3" "" COMPU_TAB_REF Q_SIG_S1 /end COMPU_METHOD
/begin COMPU_METHOD T0_0625_S1 "[0.0625°C] temperature" RAT_FUNC "%6.4" "°C" COEFFS 0 16 0 0 0 1 /end COMPU_METHOD
/begin COMPU_METHOD T1_OFFS_40_S1 "[1°C -40°C] temperature" RAT_FUNC "%6.2" "°C" COEFFS 0 1 40 0 0 1 /end COMPU_METHOD
/begin COMPU_METHOD TI0_001_M_S1 "[0.001ms] time" RAT_FUNC "%6.5" "ms" COEFFS 0 1000 0 0 0 1 /end COMPU_METHOD
/begin COMPU_METHOD TI1_S1 "[1s] time" RAT_FUNC "%6.2" "s" COEFFS 0 1 0 0 0 1 /end COMPU_METHOD
/begin COMPU_METHOD TI1_H_S1 "[0.1h] time" RAT_FUNC "%6.2" "h" COEFFS 0 1 0 0 0 1 /end COMPU_METHOD
/begin COMPU_METHOD TI1_M_S1 "[1ms] time" RAT_FUNC "%6.2" "ms" COEFFS 0 1 0 0 0 1 /end COMPU_METHOD
/begin COMPU_METHOD TI1_MIN_S1 "[min] time" RAT_FUNC "%6.2" "min" COEFFS 0 1 0 0 0 1 /end COMPU_METHOD
/begin COMPU_METHOD TI1_M_CYCLE_S1 "[ms] resolution in multiples of main task (time*ROS_NUM_MNTSK_100MS_SY/100.0ms)" RAT_FUNC "%6.2" "ms" COEFFS 0 0.2 0 0 0 1 /end COMPU_METHOD
/begin COMPU_METHOD X1_S1 "[1] no unit" RAT_FUNC "%6.2" "" COEFFS 0 1 0 0 0 1 /end COMPU_METHOD
/begin COMPU_METHOD _CNV_R_R_Umr_trmp_200_CM_S2 "" RAT_FUNC "%6.3" "trmp" COEFFS 0 16 0 0 0 1 /end COMPU_METHOD
/begin COMPU_METHOD _CNV_R_R_Umr_20_zu__201_CM_S2 "" RAT_FUNC "%6.3" "°" COEFFS 0 20 0 0 0 1 /end COMPU_METHOD
/begin COMPU_METHOD _CNV_R_R_Umr_128_zu_204_CM_S2 "" RAT_FUNC "%6.3" "km/h" COEFFS 0 128 0 0 0 1 /end COMPU_METHOD
/begin COMPU_METHOD _CNV_S_4_Enum_EFAHR_206_CM_S2 "" TAB_VERB "%6.3" "" COMPU_TAB_REF _CNV_S_4_Enum_EFAHR_206_S2 /end COMPU_METHOD
/begin COMPU_METHOD SBW_STANDARD_S1_S3 "int = ((phys * 1) / 1) - (0) -" RAT_FUNC "%2.0" "-" COEFFS 0 1 -0 0 0 1 /end COMPU_METHOD
/begin COMPU_METHOD SBW_TIMER_1S_S1_S3 "int = ((phys * 1) / 1) - (0) s" RAT_FUNC "%2.0" "s" COEFFS 0 1 -0 0 0 1 /end COMPU_METHOD
/begin COMPU_METHOD SBW_TIMER_10MS_S1_S3 "int = ((phys * 1) / 10) - (0) ms" RAT_FUNC "%2.0" "ms" COEFFS 0 1 -0 0 0 10 /end COMPU_METHOD
/begin COMPU_METHOD SBW_HDK_M_S1_S3 "int = ((phys * 2550) / 1004) - (0) %" RAT_FUNC "%4.2" "%" COEFFS 0 2550 -0 0 0 1004 /end COMPU_METHOD
/begin COMPU_METHOD SBW_N_1_M_S1_S3 "int = ((phys * 1) / 1) - (0) 1/min" RAT_FUNC "%2.0" "1/min" COEFFS 0 1 -0 0 0 1 /end COMPU_METHOD
/begin COMPU_METHOD SBW_CGT40_M_S1_S3 "int = ((phys * 1) / 1) - (-40) Grad Celsius" RAT_FUNC "%2.0" "Grad Celsius" COEFFS 0 1 40 0 0 1 /end COMPU_METHOD
/begin COMPU_METHOD SBW_VKMH_16_S1_S3 "int = ((phys * 16) / 1) - (0) km/h" RAT_FUNC "%4.2" "km/h" COEFFS 0 16 -0 0 0 1 /end COMPU_METHOD
/begin COMPU_METHOD SBW_KM_10_S1_S3 "int = ((phys * 1) / 10) - (0) km" RAT_FUNC "%2.0" "km" COEFFS 0 1 -0 0 0 10 /end COMPU_METHOD
/begin COMPU_METHOD SBW_TAUSENDSTEL_S1_S3 "int = ((phys * 1000) / 1) - (0) -" RAT_FUNC "%5.3" "-" COEFFS 0 1000 -0 0 0 1 /end COMPU_METHOD
/begin COMPU_METHOD SBW_TAUSENDSTEL_U_S1_S3 "int = ((phys * 1000) / 1) - (0) V" RAT_FUNC "%5.3" "V" COEFFS 0 1000 -0 0 0 1 /end COMPU_METHOD
/begin COMPU_VTAB B_TRUE_S1 "boolean states, positive logic" TAB_VERB 2 0 "FALSE" 1 "TRUE" DEFAULT_VALUE "xxxxx" /end COMPU_VTAB
/begin COMPU_VTAB Q_SIG_S1 "signal quality information" TAB_VERB 9 0 "init" 1 "not_available" 2 "no_source" 3 "fix" 4 "fix_source" 5 "model_based" 6 "diff_source" 7 "ok_disturbed" 8 "ok" DEFAULT_VALUE "xxxxx" /end COMPU_VTAB
/begin COMPU_VTAB _CNV_S_4_Enum_EFAHR_206_S2 "" TAB_VERB 4 0 "FDS_BASIS" 1 "FDS_KOMFORT" 2 "FDS_ECO" 3 "EV_MODUS" /end COMPU_VTAB
/begin FUNCTION F9140_SHRSOLVFS "F9140: Output Signals available via Software Sharing Interface"
 /begin DEF_CHARACTERISTIC SrvShr_FrFltCc08_C SrvShr_FrFltLss_C SrvShr_idxSol1_C SrvShr_iSol1_C SrvShr_swtBypOn_C SrvShr_swtFdbkAdcOut10_C SrvShr_tiFrFlt_C SrvShr_tiPSplyOff_C /end DEF_CHARACTERISTIC
 /begin OUT_MEASUREMENT SrvShr_bPSplyDsmRd SrvShr_DITHER_FREQ_LOCK SrvShr_FET_ACTIVE SrvShr_FET_ACTIVE_KOMP SrvShr_FrFltCc08 SrvShr_FrFltLss SrvShr_FrFltPSply SrvShr_iOUT SrvShr_iOUT_KOMP SrvShr_OUT0_AKT SrvShr_OUT0_DI_RDY SrvShr_OUT0_ESTATUS SrvShr_OUT10_AKT SrvShr_OUT10_DI_OFF SrvShr_OUT10_DI_OFFCpl SrvShr_OUT10_DI_RDY SrvShr_OUT10_ESTATUS SrvShr_OUT11_AKT SrvShr_OUT11_DI_RDY SrvShr_OUT11_ESTATUS SrvShr_OUT12_AKT SrvShr_OUT12_DI_RDY SrvShr_OUT12_ESTATUS SrvShr_OUT13_AKT SrvShr_OUT13_DI_OFF SrvShr_OUT13_DI_OFFCpl SrvShr_OUT13_DI_RDY SrvShr_OUT13_ESTATUS SrvShr_OUT14_AKT SrvShr_OUT14_DI_RDY SrvShr_OUT14_ESTATUS SrvShr_OUT1_AKT SrvShr_OUT1_DI_RDY SrvShr_OUT1_ESTATUS SrvShr_OUT2_AKT SrvShr_OUT2_DI_RDY SrvShr_OUT2_ESTATUS SrvShr_OUT3_AKT SrvShr_OUT3_DI_RDY SrvShr_OUT3_ESTATUS SrvShr_OUT4_AKT SrvShr_OUT4_DI_RDY SrvShr_OUT4_ESTATUS SrvShr_OUT5_AKT SrvShr_OUT5_DI_RDY SrvShr_OUT5_ESTATUS SrvShr_OUT6_AKT SrvShr_OUT6_DI_RDY SrvShr_OUT6_ESTATUS SrvShr_OUT7_AKT SrvShr_OUT7_DI_RDY SrvShr_OUT7_ESTATUS SrvShr_OUT8_AKT SrvShr_OUT8_DI_RDY SrvShr_OUT8_ESTATUS SrvShr_OUT9_AKT SrvShr_OUT9_DI_RDY SrvShr_OUT9_ESTATUS SrvShr_OUT_DITHER_ACTIVE SrvShr_OUT_DITHER_AMP SrvShr_stCc08_Fault SrvShr_stCc08_KFA SrvShr_stCc08_Test SrvShr_stLss_Fault SrvShr_stLss_KFA SrvShr_stLss_Test SrvShr_stPSply SrvShr_stPSply_Fault SrvShr_stPSply_KFA SrvShr_stPSply_Test SrvShr_tiFrFlt SrvShr_tiPSplyOff SrvShr_tiPSplyOffCpl /end OUT_MEASUREMENT
/end FUNCTION
/begin FUNCTION F9155_SHRGMORST "F9155: Reset monitoring interface within SW sharing" /begin DEF_CHARACTERISTIC SET_UNDERVOLTAGE_TC_C /end DEF_CHARACTERISTIC
 /begin OUT_MEASUREMENT GmoRstFaultTypCus GmoRstFaultTypCusStrd GmoRst_stFaultCus ShrGmoRst_xReg_Par ShrGmoRst_xReg_Vec /end OUT_MEASUREMENT
/end FUNCTION
/begin FUNCTION F9156_SHRGMOHOT "F9156: Hot shut down monitoring interface within SW sharing"
 /begin OUT_MEASUREMENT ShrGmoHot_stChp2Chp1 ShrGmoHot_tChp1 ShrGmoHot_tChp2 ShrGmoHot_tHot /end OUT_MEASUREMENT
/end FUNCTION
/begin FUNCTION F9200_GEH "F9200: General exception handler"
 /begin OUT_MEASUREMENT GEH_ctStrt GEH_sLstExcp GEH_sReg_Valid GEH_xRegBuf_Cnt GEH_xRegBuf_Ind GEH_xRegBuf_Par1 GEH_xRegBuf_PC GEH_xRegBuf_SP GEH_xRegBuf_Vec GEH_xReg_FPSCR GEH_xReg_Par1 GEH_xReg_PC GEH_xReg_PR GEH_xReg_SP GEH_xReg_SR GEH_xReg_Stck GEH_xReg_Vec /end OUT_MEASUREMENT
/end FUNCTION
/begin FUNCTION F9260_IDLIBHW "F9260: Hardware Library Identification" /begin OUT_MEASUREMENT SrvUtl_idLibHw_Build SrvUtl_idLibHw_Name /end OUT_MEASUREMENT /end FUNCTION
/begin FUNCTION F9300_LFTCNT "F9300: TCU lifetime counter"
 /begin OUT_MEASUREMENT LftCnt_ti LftCnt_tiBuf LftCnt_ti_Hour LftCnt_ti_Min LftCnt_ti_Sec /end OUT_MEASUREMENT
/end FUNCTION
/begin FUNCTION F9305_CHPPRFL "F9305: Chip Temperature Profile" /begin DEF_CHARACTERISTIC ChpPrfl_qtChpMin_C ChpPrfl_tChp_C /end DEF_CHARACTERISTIC /begin OUT_MEASUREMENT ChpPrfl_ti ChpPrfl_tiBuf ChpPrfl_tMax /end OUT_MEASUREMENT /end FUNCTION
/begin FUNCTION F9306_ATFPRFL "F9306: ATF Temperature Profile" /begin DEF_CHARACTERISTIC AtfPrfl_qtAtfMin_C AtfPrfl_tAtf_C /end DEF_CHARACTERISTIC /begin OUT_MEASUREMENT AtfPrfl_ti AtfPrfl_tiBuf AtfPrfl_tMax /end OUT_MEASUREMENT /end FUNCTION
/begin FUNCTION F9310_SRVSTRTT "F9310: TCU start up timing" /begin OUT_MEASUREMENT SrvStrtT_ti /end OUT_MEASUREMENT /end FUNCTION
/begin FUNCTION zff_SBW "data of E/M-Schaltung" /begin SUB_FUNCTION zff_SBW_Messgroessen zff_SBW_Applikationsgroessen /end SUB_FUNCTION /end FUNCTION
/begin FUNCTION zff_SBW_Messgroessen "all measurements of E/M-Schaltung"
 /begin SUB_FUNCTION zff_ABK_INTERFI zff_ABK_TIMER zff_ABK_DRVPRESENCEDETECTOR zff_ABK_SIGNALS zff_ABK_ENGINESIGNALS zff_ABK_PAKCONFIG zff_ABK_SIGNAL_CONDITIONING zff_ABK_TIPSIGNALS zff_ABK_RELTOABS zff_ABK_MODEIN zff_ABK_LEVERSIGNALMERGE zff_ABK_KOMBI_MSG zff_ABK_KOMBIMSGPOS zff_ABK_KOMBIMSGMODE zff_ABK_KOMBIMSGGEAR zff_ABK_KOMBIMSGFLASH zff_ABK_MULTACCESS zff_ABK_DEBOUNCEDRVREQ zff_ABK_STOREDRVREQ zff_ABK_SHIFTLOCK zff_ABK_FASREQ2POS zff_ABK_DRVREQ2POS zff_ABK_DIAGPOS zff_ABK_AUTOPOS zff_ABK_POS_INITPOS zff_ABK_PAK_SBWOUT zff_ABK_EWS4 zff_ABK_EEPROM zff_ABK_CARWASHMODE zff_ABK_MODE zff_ABK_KOMBIMSGOUTBMW zff_ABK_L2_KOMBIMSGOUTOEM zff_ABK_POWERDOWN zff_ABK_SRVCMSGHANDLER zff_ABK_CC_MSG zff_ABK_LEVEL2DIAG zff_ABK_TESTERACCESS zff_ABK_INTOSCALLSRAM zff_ABK_STARTERRELEASE zff_ABK_STARTERRELEASEBPRAM zff_ABK_STATISTICCOUNTER zff_ABK_GEARBOXSTATE /end SUB_FUNCTION
/end FUNCTION
/begin FUNCTION zff_ABK_INTERFI "desc_en"
 /begin LOC_MEASUREMENT Interfi.AcceleratorPedalAngle Interfi.AcceleratorPedalAngleSts Interfi.BrakePedalDrvAssistSts Interfi.BrakePedalSts Interfi.ChargingPlugSts Interfi.CtrlSignalSourceSts Interfi.DoorDSts Interfi.DriveLogicRaw Interfi.DrivingDirection Interfi.DrivingDirectionSts Interfi.EepromBusy Interfi.EepromStoreInProgress Interfi.EepromUpdCnt Interfi.GatePosRaw Interfi.GearboxDrvRdySts Interfi.IgnOnRawSts Interfi.KeyValidSts Interfi.ModeDrvAssistVehSts Interfi.Out10Sts Interfi.PSensor Interfi.PSensorSts Interfi.ParkingBrakeSts Interfi.PosDrvAssistRaw Interfi.PosDrvAssistRawSts Interfi.PosRaw Interfi.SeatBeltSts Interfi.VehicleDrvRdy Interfi.VehicleDrvRdySts Interfi.c_ChipTrans Interfi.c_OilTrans Interfi.c_OilTransSts Interfi.f_BrakePedal Interfi.f_BrakePedalDrvAssist Interfi.f_DoorD Interfi.f_FaultKFC_PINFO Interfi.f_FaultKFC_PSIN Interfi.f_KeyRemoteStart Interfi.f_KeyValid Interfi.f_ModeDrvAssistVeh Interfi.f_P12BadOpRaw Interfi.f_P12Button Interfi.f_P12TwoErr Interfi.f_PN Interfi.f_ParkingBrake Interfi.f_PowDownCondOK Interfi.f_SDButtonRaw Interfi.f_SeatBelt Interfi.f_SportButtonRaw Interfi.f_StrtStpButton Interfi.f_SubstAdaptivModeFix Interfi.f_SubstHSS1Off Interfi.f_SubstHoldP Interfi.f_SubstKMN_CCID419 Interfi.f_SubstKMN_CCID420 Interfi.f_SubstNoD Interfi.f_SubstNoR Interfi.f_SubstNoStoringPos Interfi.f_SubstWarnLight Interfi.f_V_Implausible Interfi.f_resync_req Interfi.i_Out10Akt Interfi.n_AbRaw Interfi.n_Eng Interfi.n_EngSts Interfi.s_mileage_10km Interfi.st_ChargingPlug Interfi.st_DiagNUWIG Interfi.st_EmfP Interfi.st_GearCurr Interfi.st_GearDest Interfi.st_GearShiftStrat Interfi.st_GearboxDrvRdy Interfi.st_IAE_Hotmode Interfi.st_IgnOnRaw Interfi.st_LeverType Interfi.st_Limphome Interfi.st_LowMode Interfi.st_MSA_Function Interfi.st_MSA_FunctionRequester Interfi.st_ModeDisplay Interfi.st_OsMode Interfi.st_ParkLock Interfi.st_PreAdaptation Interfi.st_Serap Interfi.st_SubstAll Interfi.st_SubstAllHi Interfi.st_TipMinus1_Raw Interfi.st_TipMinus2_Raw Interfi.st_TipPlus1_Raw Interfi.st_TipPlus2_Raw Interfi.st_VehDrvRdy Interfi.st_cout_navgraph_sync Interfi.st_err_no_rcvr_navi Interfi.t_systime_secs Interfi.u_BattDiag Interfi.u_mv3 Interfi.v_VehSpdSts Interfi.v_VehSpd_nab L2_Interfi.L2_BrakePedalSts.Complement L2_Interfi.L2_BrakePedalSts.Value L2_Interfi.L2_BrakePressureSts.Complement L2_Interfi.L2_BrakePressureSts.Value L2_Interfi.L2_f_BrakePedal.Complement L2_Interfi.L2_f_BrakePedal.Value /end LOC_MEASUREMENT
/end FUNCTION
/begin FUNCTION zff_ABK_TIMER "desc_en"
 /begin LOC_MEASUREMENT CCMsg.IDEmpty.cCC_ID._.tmr_ID_CycleTime.f_IsExpired CCMsg.IDEmpty.cCC_ID._.tmr_ID_CycleTime.time CCMsg.IDEmpty.cCC_ID._.tmr_ID_HoldCC.f_IsExpired CCMsg.IDEmpty.cCC_ID._.tmr_ID_HoldCC.time CCMsg.IDEmpty.cCC_ID._.tmr_ID_MinTime.f_IsExpired CCMsg.IDEmpty.cCC_ID._.tmr_ID_MinTime.time CCMsg.IDEmpty.cCC_ID._.tmr_ID_delay.f_IsExpired CCMsg.IDEmpty.cCC_ID._.tmr_ID_delay.time CCMsg.ID_DrvLeavesCar.cCC_ID._.tmr_ID_CycleTime.f_IsExpired CCMsg.ID_DrvLeavesCar.cCC_ID._.tmr_ID_CycleTime.time CCMsg.ID_DrvLeavesCar.cCC_ID._.tmr_ID_HoldCC.f_IsExpired CCMsg.ID_DrvLeavesCar.cCC_ID._.tmr_ID_HoldCC.time CCMsg.ID_DrvLeavesCar.cCC_ID._.tmr_ID_MinTime.f_IsExpired CCMsg.ID_DrvLeavesCar.cCC_ID._.tmr_ID_MinTime.time CCMsg.ID_DrvLeavesCar.cCC_ID._.tmr_ID_delay.f_IsExpired CCMsg.ID_DrvLeavesCar.cCC_ID._.tmr_ID_delay.time CCMsg.ID_DrvLeavesCar_BeltLocked.cCC_ID._.tmr_ID_CycleTime.f_IsExpired CCMsg.ID_DrvLeavesCar_BeltLocked.cCC_ID._.tmr_ID_CycleTime.time CCMsg.ID_DrvLeavesCar_BeltLocked.cCC_ID._.tmr_ID_HoldCC.f_IsExpired CCMsg.ID_DrvLeavesCar_BeltLocked.cCC_ID._.tmr_ID_HoldCC.time CCMsg.ID_DrvLeavesCar_BeltLocked.cCC_ID._.tmr_ID_MinTime.f_IsExpired CCMsg.ID_DrvLeavesCar_BeltLocked.cCC_ID._.tmr_ID_MinTime.time CCMsg.ID_DrvLeavesCar_BeltLocked.cCC_ID._.tmr_ID_delay.f_IsExpired CCMsg.ID_DrvLeavesCar_BeltLocked.cCC_ID._.tmr_ID_delay.time CCMsg.ID_E_GNERActive.cCC_ID._.tmr_ID_CycleTime.f_IsExpired CCMsg.ID_E_GNERActive.cCC_ID._.tmr_ID_CycleTime.time CCMsg.ID_E_GNERActive.cCC_ID._.tmr_ID_HoldCC.f_IsExpired CCMsg.ID_E_GNERActive.cCC_ID._.tmr_ID_HoldCC.time CCMsg.ID_E_GNERActive.cCC_ID._.tmr_ID_MinTime.f_IsExpired CCMsg.ID_E_GNERActive.cCC_ID._.tmr_ID_MinTime.time CCMsg.ID_E_GNERActive.cCC_ID._.tmr_ID_delay.f_IsExpired CCMsg.ID_E_GNERActive.cCC_ID._.tmr_ID_delay.time CCMsg.ID_GearboxWarning1.cCC_ID._.tmr_ID_CycleTime.f_IsExpired CCMsg.ID_GearboxWarning1.cCC_ID._.tmr_ID_CycleTime.time CCMsg.ID_GearboxWarning1.cCC_ID._.tmr_ID_HoldCC.f_IsExpired CCMsg.ID_GearboxWarning1.cCC_ID._.tmr_ID_HoldCC.time CCMsg.ID_GearboxWarning1.cCC_ID._.tmr_ID_MinTime.f_IsExpired CCMsg.ID_GearboxWarning1.cCC_ID._.tmr_ID_MinTime.time CCMsg.ID_GearboxWarning1.cCC_ID._.tmr_ID_delay.f_IsExpired CCMsg.ID_GearboxWarning1.cCC_ID._.tmr_ID_delay.time CCMsg.ID_GearboxWarning2.cCC_ID._.tmr_ID_CycleTime.f_IsExpired CCMsg.ID_GearboxWarning2.cCC_ID._.tmr_ID_CycleTime.time CCMsg.ID_GearboxWarning2.cCC_ID._.tmr_ID_HoldCC.f_IsExpired CCMsg.ID_GearboxWarning2.cCC_ID._.tmr_ID_HoldCC.time CCMsg.ID_GearboxWarning2.cCC_ID._.tmr_ID_MinTime.f_IsExpired CCMsg.ID_GearboxWarning2.cCC_ID._.tmr_ID_MinTime.time CCMsg.ID_GearboxWarning2.cCC_ID._.tmr_ID_delay.f_IsExpired CCMsg.ID_GearboxWarning2.cCC_ID._.tmr_ID_delay.time CCMsg.ID_GongBadOp.cCC_ID._.tmr_ID_CycleTime.f_IsExpired CCMsg.ID_GongBadOp.cCC_ID._.tmr_ID_CycleTime.time CCMsg.ID_GongBadOp.cCC_ID._.tmr_ID_HoldCC.f_IsExpired CCMsg.ID_GongBadOp.cCC_ID._.tmr_ID_HoldCC.time CCMsg.ID_GongBadOp.cCC_ID._.tmr_ID_MinTime.f_IsExpired CCMsg.ID_GongBadOp.cCC_ID._.tmr_ID_MinTime.time CCMsg.ID_GongBadOp.cCC_ID._.tmr_ID_delay.f_IsExpired CCMsg.ID_GongBadOp.cCC_ID._.tmr_ID_delay.time CCMsg.ID_GongInMechLimp.cCC_ID._.tmr_ID_CycleTime.f_IsExpired CCMsg.ID_GongInMechLimp.cCC_ID._.tmr_ID_CycleTime.time CCMsg.ID_GongInMechLimp.cCC_ID._.tmr_ID_HoldCC.f_IsExpired CCMsg.ID_GongInMechLimp.cCC_ID._.tmr_ID_HoldCC.time CCMsg.ID_GongInMechLimp.cCC_ID._.tmr_ID_MinTime.f_IsExpired CCMsg.ID_GongInMechLimp.cCC_ID._.tmr_ID_MinTime.time CCMsg.ID_GongInMechLimp.cCC_ID._.tmr_ID_delay.f_IsExpired CCMsg.ID_GongInMechLimp.cCC_ID._.tmr_ID_delay.time CCMsg.ID_GongWrongDrvDir.cCC_ID._.tmr_ID_CycleTime.f_IsExpired CCMsg.ID_GongWrongDrvDir.cCC_ID._.tmr_ID_CycleTime.time CCMsg.ID_GongWrongDrvDir.cCC_ID._.tmr_ID_HoldCC.f_IsExpired CCMsg.ID_GongWrongDrvDir.cCC_ID._.tmr_ID_HoldCC.time CCMsg.ID_GongWrongDrvDir.cCC_ID._.tmr_ID_MinTime.f_IsExpired CCMsg.ID_GongWrongDrvDir.cCC_ID._.tmr_ID_MinTime.time CCMsg.ID_GongWrongDrvDir.cCC_ID._.tmr_ID_delay.f_IsExpired CCMsg.ID_GongWrongDrvDir.cCC_ID._.tmr_ID_delay.time CCMsg.ID_Hotmode1.cCC_ID._.tmr_ID_CycleTime.f_IsExpired CCMsg.ID_Hotmode1.cCC_ID._.tmr_ID_CycleTime.time CCMsg.ID_Hotmode1.cCC_ID._.tmr_ID_HoldCC.f_IsExpired CCMsg.ID_Hotmode1.cCC_ID._.tmr_ID_HoldCC.time CCMsg.ID_Hotmode1.cCC_ID._.tmr_ID_MinTime.f_IsExpired CCMsg.ID_Hotmode1.cCC_ID._.tmr_ID_MinTime.time CCMsg.ID_Hotmode1.cCC_ID._.tmr_ID_delay.f_IsExpired CCMsg.ID_Hotmode1.cCC_ID._.tmr_ID_delay.time CCMsg.ID_Hotmode2.cCC_ID._.tmr_ID_CycleTime.f_IsExpired CCMsg.ID_Hotmode2.cCC_ID._.tmr_ID_CycleTime.time CCMsg.ID_Hotmode2.cCC_ID._.tmr_ID_HoldCC.f_IsExpired CCMsg.ID_Hotmode2.cCC_ID._.tmr_ID_HoldCC.time CCMsg.ID_Hotmode2.cCC_ID._.tmr_ID_MinTime.f_IsExpired CCMsg.ID_Hotmode2.cCC_ID._.tmr_ID_MinTime.time CCMsg.ID_Hotmode2.cCC_ID._.tmr_ID_delay.f_IsExpired CCMsg.ID_Hotmode2.cCC_ID._.tmr_ID_delay.time CCMsg.ID_Hotmode3.cCC_ID._.tmr_ID_CycleTime.f_IsExpired CCMsg.ID_Hotmode3.cCC_ID._.tmr_ID_CycleTime.time CCMsg.ID_Hotmode3.cCC_ID._.tmr_ID_HoldCC.f_IsExpired CCMsg.ID_Hotmode3.cCC_ID._.tmr_ID_HoldCC.time CCMsg.ID_Hotmode3.cCC_ID._.tmr_ID_MinTime.f_IsExpired CCMsg.ID_Hotmode3.cCC_ID._.tmr_ID_MinTime.time CCMsg.ID_Hotmode3.cCC_ID._.tmr_ID_delay.f_IsExpired CCMsg.ID_Hotmode3.cCC_ID._.tmr_ID_delay.time CCMsg.ID_IgnitionError.cCC_ID._.tmr_ID_CycleTime.f_IsExpired CCMsg.ID_IgnitionError.cCC_ID._.tmr_ID_CycleTime.time CCMsg.ID_IgnitionError.cCC_ID._.tmr_ID_HoldCC.f_IsExpired CCMsg.ID_IgnitionError.cCC_ID._.tmr_ID_HoldCC.time CCMsg.ID_IgnitionError.cCC_ID._.tmr_ID_MinTime.f_IsExpired CCMsg.ID_IgnitionError.cCC_ID._.tmr_ID_MinTime.time CCMsg.ID_IgnitionError.cCC_ID._.tmr_ID_delay.f_IsExpired CCMsg.ID_IgnitionError.cCC_ID._.tmr_ID_delay.time CCMsg.ID_MechLimpInD.cCC_ID._.tmr_ID_CycleTime.f_IsExpired CCMsg.ID_MechLimpInD.cCC_ID._.tmr_ID_CycleTime.time CCMsg.ID_MechLimpInD.cCC_ID._.tmr_ID_HoldCC.f_IsExpired CCMsg.ID_MechLimpInD.cCC_ID._.tmr_ID_HoldCC.time CCMsg.ID_MechLimpInD.cCC_ID._.tmr_ID_MinTime.f_IsExpired CCMsg.ID_MechLimpInD.cCC_ID._.tmr_ID_MinTime.time CCMsg.ID_MechLimpInD.cCC_ID._.tmr_ID_delay.f_IsExpired CCMsg.ID_MechLimpInD.cCC_ID._.tmr_ID_delay.time CCMsg.ID_MechLimpInP.cCC_ID._.tmr_ID_CycleTime.f_IsExpired CCMsg.ID_MechLimpInP.cCC_ID._.tmr_ID_CycleTime.time CCMsg.ID_MechLimpInP.cCC_ID._.tmr_ID_HoldCC.f_IsExpired CCMsg.ID_MechLimpInP.cCC_ID._.tmr_ID_HoldCC.time CCMsg.ID_MechLimpInP.cCC_ID._.tmr_ID_MinTime.f_IsExpired CCMsg.ID_MechLimpInP.cCC_ID._.tmr_ID_MinTime.time CCMsg.ID_MechLimpInP.cCC_ID._.tmr_ID_delay.f_IsExpired CCMsg.ID_MechLimpInP.cCC_ID._.tmr_ID_delay.time CCMsg.ID_MechLimpInPNoRD.cCC_ID._.tmr_ID_CycleTime.f_IsExpired CCMsg.ID_MechLimpInPNoRD.cCC_ID._.tmr_ID_CycleTime.time CCMsg.ID_MechLimpInPNoRD.cCC_ID._.tmr_ID_HoldCC.f_IsExpired CCMsg.ID_MechLimpInPNoRD.cCC_ID._.tmr_ID_HoldCC.time CCMsg.ID_MechLimpInPNoRD.cCC_ID._.tmr_ID_MinTime.f_IsExpired CCMsg.ID_MechLimpInPNoRD.cCC_ID._.tmr_ID_MinTime.time CCMsg.ID_MechLimpInPNoRD.cCC_ID._.tmr_ID_delay.f_IsExpired CCMsg.ID_MechLimpInPNoRD.cCC_ID._.tmr_ID_delay.time CCMsg.ID_PS_Abuse.cCC_ID._.tmr_ID_CycleTime.f_IsExpired CCMsg.ID_PS_Abuse.cCC_ID._.tmr_ID_CycleTime.time CCMsg.ID_PS_Abuse.cCC_ID._.tmr_ID_HoldCC.f_IsExpired CCMsg.ID_PS_Abuse.cCC_ID._.tmr_ID_HoldCC.time CCMsg.ID_PS_Abuse.cCC_ID._.tmr_ID_MinTime.f_IsExpired CCMsg.ID_PS_Abuse.cCC_ID._.tmr_ID_MinTime.time CCMsg.ID_PS_Abuse.cCC_ID._.tmr_ID_delay.f_IsExpired CCMsg.ID_PS_Abuse.cCC_ID._.tmr_ID_delay.time CCMsg.ID_P_ButtonError.cCC_ID._.tmr_ID_CycleTime.f_IsExpired CCMsg.ID_P_ButtonError.cCC_ID._.tmr_ID_CycleTime.time CCMsg.ID_P_ButtonError.cCC_ID._.tmr_ID_HoldCC.f_IsExpired CCMsg.ID_P_ButtonError.cCC_ID._.tmr_ID_HoldCC.time CCMsg.ID_P_ButtonError.cCC_ID._.tmr_ID_MinTime.f_IsExpired CCMsg.ID_P_ButtonError.cCC_ID._.tmr_ID_MinTime.time CCMsg.ID_P_ButtonError.cCC_ID._.tmr_ID_delay.f_IsExpired CCMsg.ID_P_ButtonError.cCC_ID._.tmr_ID_delay.time CCMsg.ID_ParkLockFault.cCC_ID._.tmr_ID_CycleTime.f_IsExpired CCMsg.ID_ParkLockFault.cCC_ID._.tmr_ID_CycleTime.time CCMsg.ID_ParkLockFault.cCC_ID._.tmr_ID_HoldCC.f_IsExpired CCMsg.ID_ParkLockFault.cCC_ID._.tmr_ID_HoldCC.time CCMsg.ID_ParkLockFault.cCC_ID._.tmr_ID_MinTime.f_IsExpired CCMsg.ID_ParkLockFault.cCC_ID._.tmr_ID_MinTime.time CCMsg.ID_ParkLockFault.cCC_ID._.tmr_ID_delay.f_IsExpired CCMsg.ID_ParkLockFault.cCC_ID._.tmr_ID_delay.time CCMsg.ID_ParkLockFault_IEP_On.cCC_ID._.tmr_ID_CycleTime.f_IsExpired CCMsg.ID_ParkLockFault_IEP_On.cCC_ID._.tmr_ID_CycleTime.time CCMsg.ID_ParkLockFault_IEP_On.cCC_ID._.tmr_ID_HoldCC.f_IsExpired CCMsg.ID_ParkLockFault_IEP_On.cCC_ID._.tmr_ID_HoldCC.time CCMsg.ID_ParkLockFault_IEP_On.cCC_ID._.tmr_ID_MinTime.f_IsExpired CCMsg.ID_ParkLockFault_IEP_On.cCC_ID._.tmr_ID_MinTime.time CCMsg.ID_ParkLockFault_IEP_On.cCC_ID._.tmr_ID_delay.f_IsExpired CCMsg.ID_ParkLockFault_IEP_On.cCC_ID._.tmr_ID_delay.time CCMsg.ID_ParkLockFault_InMechLimp.cCC_ID._.tmr_ID_CycleTime.f_IsExpired CCMsg.ID_ParkLockFault_InMechLimp.cCC_ID._.tmr_ID_CycleTime.time CCMsg.ID_ParkLockFault_InMechLimp.cCC_ID._.tmr_ID_HoldCC.f_IsExpired CCMsg.ID_ParkLockFault_InMechLimp.cCC_ID._.tmr_ID_HoldCC.time CCMsg.ID_ParkLockFault_InMechLimp.cCC_ID._.tmr_ID_MinTime.f_IsExpired CCMsg.ID_ParkLockFault_InMechLimp.cCC_ID._.tmr_ID_MinTime.time CCMsg.ID_ParkLockFault_InMechLimp.cCC_ID._.tmr_ID_delay.f_IsExpired CCMsg.ID_ParkLockFault_InMechLimp.cCC_ID._.tmr_ID_delay.time CCMsg.ID_PosN_Warning.cCC_ID._.tmr_ID_CycleTime.f_IsExpired CCMsg.ID_PosN_Warning.cCC_ID._.tmr_ID_CycleTime.time CCMsg.ID_PosN_Warning.cCC_ID._.tmr_ID_HoldCC.f_IsExpired CCMsg.ID_PosN_Warning.cCC_ID._.tmr_ID_HoldCC.time CCMsg.ID_PosN_Warning.cCC_ID._.tmr_ID_MinTime.f_IsExpired CCMsg.ID_PosN_Warning.cCC_ID._.tmr_ID_MinTime.time CCMsg.ID_PosN_Warning.cCC_ID._.tmr_ID_delay.f_IsExpired CCMsg.ID_PosN_Warning.cCC_ID._.tmr_ID_delay.time CCMsg.ID_ShiftWithoutBrakeWarning.cCC_ID._.tmr_ID_CycleTime.f_IsExpired CCMsg.ID_ShiftWithoutBrakeWarning.cCC_ID._.tmr_ID_CycleTime.time CCMsg.ID_ShiftWithoutBrakeWarning.cCC_ID._.tmr_ID_HoldCC.f_IsExpired CCMsg.ID_ShiftWithoutBrakeWarning.cCC_ID._.tmr_ID_HoldCC.time CCMsg.ID_ShiftWithoutBrakeWarning.cCC_ID._.tmr_ID_MinTime.f_IsExpired CCMsg.ID_ShiftWithoutBrakeWarning.cCC_ID._.tmr_ID_MinTime.time CCMsg.ID_ShiftWithoutBrakeWarning.cCC_ID._.tmr_ID_delay.f_IsExpired CCMsg.ID_ShiftWithoutBrakeWarning.cCC_ID._.tmr_ID_delay.time CCMsg.ID_ShifterError.cCC_ID._.tmr_ID_CycleTime.f_IsExpired CCMsg.ID_ShifterError.cCC_ID._.tmr_ID_CycleTime.time CCMsg.ID_ShifterError.cCC_ID._.tmr_ID_HoldCC.f_IsExpired CCMsg.ID_ShifterError.cCC_ID._.tmr_ID_HoldCC.time CCMsg.ID_ShifterError.cCC_ID._.tmr_ID_MinTime.f_IsExpired CCMsg.ID_ShifterError.cCC_ID._.tmr_ID_MinTime.time CCMsg.ID_ShifterError.cCC_ID._.tmr_ID_delay.f_IsExpired CCMsg.ID_ShifterError.cCC_ID._.tmr_ID_delay.time CCMsg.ID_ShiftlockBrakeWarning.cCC_ID._.tmr_ID_CycleTime.f_IsExpired CCMsg.ID_ShiftlockBrakeWarning.cCC_ID._.tmr_ID_CycleTime.time CCMsg.ID_ShiftlockBrakeWarning.cCC_ID._.tmr_ID_HoldCC.f_IsExpired CCMsg.ID_ShiftlockBrakeWarning.cCC_ID._.tmr_ID_HoldCC.time CCMsg.ID_ShiftlockBrakeWarning.cCC_ID._.tmr_ID_MinTime.f_IsExpired CCMsg.ID_ShiftlockBrakeWarning.cCC_ID._.tmr_ID_MinTime.time CCMsg.ID_ShiftlockBrakeWarning.cCC_ID._.tmr_ID_delay.f_IsExpired CCMsg.ID_ShiftlockBrakeWarning.cCC_ID._.tmr_ID_delay.time CCMsg.ID_Speed2HighForDrvReqP.cCC_ID._.tmr_ID_CycleTime.f_IsExpired CCMsg.ID_Speed2HighForDrvReqP.cCC_ID._.tmr_ID_CycleTime.time CCMsg.ID_Speed2HighForDrvReqP.cCC_ID._.tmr_ID_HoldCC.f_IsExpired CCMsg.ID_Speed2HighForDrvReqP.cCC_ID._.tmr_ID_HoldCC.time CCMsg.ID_Speed2HighForDrvReqP.cCC_ID._.tmr_ID_MinTime.f_IsExpired CCMsg.ID_Speed2HighForDrvReqP.cCC_ID._.tmr_ID_MinTime.time CCMsg.ID_Speed2HighForDrvReqP.cCC_ID._.tmr_ID_delay.f_IsExpired CCMsg.ID_Speed2HighForDrvReqP.cCC_ID._.tmr_ID_delay.time CCMsg.ID_Speed2HighInPosP.cCC_ID._.tmr_ID_CycleTime.f_IsExpired CCMsg.ID_Speed2HighInPosP.cCC_ID._.tmr_ID_CycleTime.time CCMsg.ID_Speed2HighInPosP.cCC_ID._.tmr_ID_HoldCC.f_IsExpired CCMsg.ID_Speed2HighInPosP.cCC_ID._.tmr_ID_HoldCC.time CCMsg.ID_Speed2HighInPosP.cCC_ID._.tmr_ID_MinTime.f_IsExpired CCMsg.ID_Speed2HighInPosP.cCC_ID._.tmr_ID_MinTime.time CCMsg.ID_Speed2HighInPosP.cCC_ID._.tmr_ID_delay.f_IsExpired CCMsg.ID_Speed2HighInPosP.cCC_ID._.tmr_ID_delay.time CCMsg.ID_V_ImplausibleInPosP.cCC_ID._.tmr_ID_CycleTime.f_IsExpired CCMsg.ID_V_ImplausibleInPosP.cCC_ID._.tmr_ID_CycleTime.time CCMsg.ID_V_ImplausibleInPosP.cCC_ID._.tmr_ID_HoldCC.f_IsExpired CCMsg.ID_V_ImplausibleInPosP.cCC_ID._.tmr_ID_HoldCC.time CCMsg.ID_V_ImplausibleInPosP.cCC_ID._.tmr_ID_MinTime.f_IsExpired CCMsg.ID_V_ImplausibleInPosP.cCC_ID._.tmr_ID_MinTime.time CCMsg.ID_V_ImplausibleInPosP.cCC_ID._.tmr_ID_delay.f_IsExpired CCMsg.ID_V_ImplausibleInPosP.cCC_ID._.tmr_ID_delay.time DebounceDrvReq.tmr_DebounceDrvReq.f_IsExpired DebounceDrvReq.tmr_DebounceDrvReq.time DebounceMonitoring.L2_tmr_WaitForDebouncedDrvReq.f_IsExpired.Complement DebounceMonitoring.L2_tmr_WaitForDebouncedDrvReq.f_IsExpired.Value DebounceMonitoring.L2_tmr_WaitForDebouncedDrvReq.time.Complement DebounceMonitoring.L2_tmr_WaitForDebouncedDrvReq.time.Value DiagPos.tmr_DebounceWrongDriveDir.f_IsExpired DiagPos.tmr_DebounceWrongDriveDir.time DiagPos.tmr_DebounceWrongDrvDirMinTime.f_IsExpired DiagPos.tmr_DebounceWrongDrvDirMinTime.time DisplayMonitoring.L2_tmr_BackFilterNPorRDinsteadDR.f_IsExpired.Complement DisplayMonitoring.L2_tmr_BackFilterNPorRDinsteadDR.f_IsExpired.Value DisplayMonitoring.L2_tmr_BackFilterNPorRDinsteadDR.time.Complement DisplayMonitoring.L2_tmr_BackFilterNPorRDinsteadDR.time.Value DisplayMonitoring.L2_tmr_BackFilterPosPinPosN.f_IsExpired.Complement DisplayMonitoring.L2_tmr_BackFilterPosPinPosN.f_IsExpired.Value DisplayMonitoring.L2_tmr_BackFilterPosPinPosN.time.Complement DisplayMonitoring.L2_tmr_BackFilterPosPinPosN.time.Value DisplayMonitoring.L2_tmr_FilterNPorRDinsteadDR.f_IsExpired.Complement DisplayMonitoring.L2_tmr_FilterNPorRDinsteadDR.f_IsExpired.Value DisplayMonitoring.L2_tmr_FilterNPorRDinsteadDR.time.Complement DisplayMonitoring.L2_tmr_FilterNPorRDinsteadDR.time.Value DisplayMonitoring.L2_tmr_FilterPosPinPosN.f_IsExpired.Complement DisplayMonitoring.L2_tmr_FilterPosPinPosN.f_IsExpired.Value DisplayMonitoring.L2_tmr_FilterPosPinPosN.time.Complement DisplayMonitoring.L2_tmr_FilterPosPinPosN.time.Value DisplayMonitoring.L2_tmr_FlashN.f_IsExpired.Complement DisplayMonitoring.L2_tmr_FlashN.f_IsExpired.Value DisplayMonitoring.L2_tmr_FlashN.time.Complement DisplayMonitoring.L2_tmr_FlashN.time.Value DrvPresenceDetector.tmr_DrvLeavesCarInN.f_IsExpired DrvPresenceDetector.tmr_DrvLeavesCarInN.time EngineSignals.tmr_DebounceGearboxReady.f_IsExpired EngineSignals.tmr_DebounceGearboxReady.time EngineSignals.tmr_DebounceGearboxReadySts.f_IsExpired EngineSignals.tmr_DebounceGearboxReadySts.time FASReq2Pos.tmr_PosDrvAssistFilt.f_IsExpired FASReq2Pos.tmr_PosDrvAssistFilt.time GlobalSignals.tmr_DebounceOilChipTransErr.f_IsExpired GlobalSignals.tmr_DebounceOilChipTransErr.time GlobalSignals.tmr_E_GNER.f_IsExpired GlobalSignals.tmr_E_GNER.time GlobalSignals.tmr_E_GNERPrecond.f_IsExpired GlobalSignals.tmr_E_GNERPrecond.time GlobalSignals.tmr_E_GNER_Misuse.f_IsExpired GlobalSignals.tmr_E_GNER_Misuse.time GlobalSignals.tmr_FlashN.f_IsExpired GlobalSignals.tmr_FlashN.time GlobalSignals.tmr_P12BadOp.f_IsExpired GlobalSignals.tmr_P12BadOp.time KombiMsg.tmr_IgnOnNeverDetected.f_IsExpired KombiMsg.tmr_IgnOnNeverDetected.time KombiMsg.tmr_P12BadOpDisp.f_IsExpired KombiMsg.tmr_P12BadOpDisp.time KombiMsgFlash.tmr_FlashNInWrongDrvDir.f_IsExpired KombiMsgFlash.tmr_FlashNInWrongDrvDir.time L2_DrvReq.L2_tmr_PosDrvAssistReject.f_IsExpired.Complement L2_DrvReq.L2_tmr_PosDrvAssistReject.f_IsExpired.Value L2_DrvReq.L2_tmr_PosDrvAssistReject.time.Complement L2_DrvReq.L2_tmr_PosDrvAssistReject.time.Value L2_EngineSignals.L2_tmr_DebounceGearboxReady.f_IsExpired.Complement L2_EngineSignals.L2_tmr_DebounceGearboxReady.f_IsExpired.Value L2_EngineSignals.L2_tmr_DebounceGearboxReady.time.Complement L2_EngineSignals.L2_tmr_DebounceGearboxReady.time.Value L2_EngineSignals.L2_tmr_DebounceGearboxReadySts.f_IsExpired.Complement L2_EngineSignals.L2_tmr_DebounceGearboxReadySts.f_IsExpired.Value L2_EngineSignals.L2_tmr_DebounceGearboxReadySts.time.Complement L2_EngineSignals.L2_tmr_DebounceGearboxReadySts.time.Value Mode.tmr_ModeReturnTip1.f_IsExpired Mode.tmr_ModeReturnTip1.time Mode.tmr_ModeReturnTip2.f_IsExpired Mode.tmr_ModeReturnTip2.time Mode.tmr_TipMinusOn.f_IsExpired Mode.tmr_TipMinusOn.time Mode.tmr_TipPlusOn.f_IsExpired Mode.tmr_TipPlusOn.time ModeIn.tmr_DelayMGate.f_IsExpired ModeIn.tmr_DelayMGate.time PosMonitoring.L2_tmr_D_t_StoreN.f_IsExpired.Complement PosMonitoring.L2_tmr_D_t_StoreN.f_IsExpired.Value PosMonitoring.L2_tmr_D_t_StoreN.time.Complement PosMonitoring.L2_tmr_D_t_StoreN.time.Value PosMonitoring.L2_tmr_N_Request.f_IsExpired.Complement PosMonitoring.L2_tmr_N_Request.f_IsExpired.Value PosMonitoring.L2_tmr_N_Request.time.Complement PosMonitoring.L2_tmr_N_Request.time.Value PowerDown.tmr_PowDownDelay.f_IsExpired PowerDown.tmr_PowDownDelay.time SignalConditioning.tmr_DiagSysPressureEng.f_IsExpired SignalConditioning.tmr_DiagSysPressureEng.time SignalConditioning.tmr_DiagSysPressureEngStart.f_IsExpired SignalConditioning.tmr_DiagSysPressureEngStart.time SignalConditioning.tmr_DiagSysPressureHIS.f_IsExpired SignalConditioning.tmr_DiagSysPressureHIS.time SignalConditioning.tmr_PEngaged.f_IsExpired SignalConditioning.tmr_PEngaged.time SignalConditioning.tmr_PEngagedAfterEngStart.f_IsExpired SignalConditioning.tmr_PEngagedAfterEngStart.time SrvcMsgHandler.tmr_MSA_MsgCyclicSend.f_IsExpired SrvcMsgHandler.tmr_MSA_MsgCyclicSend.time SrvcMsgHandler.tmr_MSA_MsgDebouncing.f_IsExpired SrvcMsgHandler.tmr_MSA_MsgDebouncing.time SrvcMsgHandler.tmr_MSA_MsgWaitResend.f_IsExpired SrvcMsgHandler.tmr_MSA_MsgWaitResend.time SrvcMsgHandler.tmr_last_sending_100ms_ago.f_IsExpired SrvcMsgHandler.tmr_last_sending_100ms_ago.time StoreDrvReq.tmr_StorePRND.f_IsExpired StoreDrvReq.tmr_StorePRND.time UnintendedTraction.L2_tmr_D_Request.f_IsExpired.Complement UnintendedTraction.L2_tmr_D_Request.f_IsExpired.Value UnintendedTraction.L2_tmr_D_Request.time.Complement UnintendedTraction.L2_tmr_D_Request.time.Value UnintendedTraction.L2_tmr_R_Request.f_IsExpired.Complement UnintendedTraction.L2_tmr_R_Request.f_IsExpired.Value UnintendedTraction.L2_tmr_R_Request.time.Complement UnintendedTraction.L2_tmr_R_Request.time.Value tmr_StarterReleaseBPRam.checksum tmr_StarterReleaseBPRam.f_IsExpired.value tmr_StarterReleaseBPRam.timeBuf.value /end LOC_MEASUREMENT
/end FUNCTION
/begin FUNCTION zff_ABK_DRVPRESENCEDETECTOR "desc_en"
 /begin LOC_MEASUREMENT DrvPresenceDetector.f_CC_DrvLeavesCar DrvPresenceDetector.f_CC_DrvLeavesCarBeltLocked DrvPresenceDetector.f_DrvLeavesCar DrvPresenceDetector.f_DrvLeavesCarBrakeAccPed DrvPresenceDetector.f_DrvLeavesCarDoorSeatb DrvPresenceDetector.f_DrvLeavesCarInN DrvPresenceDetector.st_DriverPresence DrvPresenceDetector.st_tmr_DrvLeavesCarInN /end LOC_MEASUREMENT
/end FUNCTION
/begin FUNCTION zff_ABK_SIGNALS "desc_en"
 /begin LOC_MEASUREMENT CyclePos10msIn20ms.cnt_Position GlobalSignals.IgnOnSts GlobalSignals.f_AcceleratorPedalPressed GlobalSignals.f_BrakePedalSL GlobalSignals.f_E_GNER_Activation GlobalSignals.f_E_GNER_Active GlobalSignals.f_E_GNER_Enabled GlobalSignals.f_E_GNER_NoMisuse GlobalSignals.f_EgnerFailedCnt GlobalSignals.f_EgnerRdy GlobalSignals.f_EgnerRdy_Old GlobalSignals.f_EgnerRdy_RisingEdge GlobalSignals.f_HotCondReset GlobalSignals.f_HotCond_1 GlobalSignals.f_HotCond_2 GlobalSignals.f_HotCond_3 GlobalSignals.f_IgnOn GlobalSignals.f_IgnOn_RisingEdg GlobalSignals.f_IgnOn_old GlobalSignals.f_MechLimp GlobalSignals.f_P12BadOp GlobalSignals.f_P12BadOpOld GlobalSignals.f_P12BadOpTrig GlobalSignals.f_ParkLock GlobalSignals.f_PosChangeByDiag GlobalSignals.f_RemoteStart GlobalSignals.f_RemoteStart_SLDisable GlobalSignals.f_ResyncNeeded GlobalSignals.st_E_GNER GlobalSignals.st_E_GNEROld GlobalSignals.st_Hotmode GlobalSignals.st_Hotmode_pre GlobalSignals.st_IEP_SollEgner GlobalSignals.st_SpeedCondD GlobalSignals.st_SpeedCondP GlobalSignals.st_SpeedCondR GlobalSignals.v_VehSpdMin InitPos.f_ResUBatt InitPosBPRAM.DirBuf InitPosBPRAM.DirBuf_ InitPosBPRAM.PosPRNDBuf InitPosBPRAM.PosPRNDBuf_ InitPosBPRAM.PosPRND_4RzN_Buf InitPosBPRAM.PosPRND_4RzN_Buf_ InitPosBPRAM.f_MechLimpBuf InitPosBPRAM.f_MechLimpBuf_ InitPosBPRAM.st_InverseCoasting InitPosBPRAM.st_InverseCoasting_ /end LOC_MEASUREMENT
/end FUNCTION
/begin FUNCTION zff_ABK_ENGINESIGNALS "desc_en"
 /begin LOC_MEASUREMENT EngineSignals.f_EngOn EngineSignals.f_GearboxDrvRdy EngineSignals.f_GearboxReadySts_Old EngineSignals.f_GearboxReady_Old EngineSignals.f_Starter_IEP EngineSignals.n_EngSub EngineSignals.n_EngSubSts EngineSignals.st_EngOn EngineSignals.st_EngOn_Old /end LOC_MEASUREMENT
/end FUNCTION
/begin FUNCTION zff_ABK_PAKCONFIG "desc_en" /begin LOC_MEASUREMENT PAKConfig.PAKConfig_TEST /end LOC_MEASUREMENT /end FUNCTION
/begin FUNCTION zff_ABK_SIGNAL_CONDITIONING "desc_en"
 /begin LOC_MEASUREMENT SignalConditioning.f_PSEnableCondition SignalConditioning.f_cc_PSAbuse /end LOC_MEASUREMENT
/end FUNCTION
/begin FUNCTION zff_ABK_TIPSIGNALS "desc_en"
 /begin LOC_MEASUREMENT TipSignals.st_TipMinus1Old TipSignals.st_TipMinus1Trig TipSignals.st_TipMinus2Old TipSignals.st_TipMinus2Trig TipSignals.st_TipPlus1Old TipSignals.st_TipPlus1Trig TipSignals.st_TipPlus2Old TipSignals.st_TipPlus2Trig /end LOC_MEASUREMENT
/end FUNCTION
/begin FUNCTION zff_ABK_RELTOABS "desc_en"
 /begin LOC_MEASUREMENT RelToAbs.DrvReq_Raw_ByRelativelever RelToAbs.MaxLeverpos RelToAbs.MaxLeverposIdx RelToAbs.PosRawRelOld RelToAbs.StartPosPRND RelToAbs.StartPosPRNDIdx RelToAbs.st_RelToAbs_Stm /end LOC_MEASUREMENT
/end FUNCTION
/begin FUNCTION zff_ABK_MODEIN "desc_en"
 /begin LOC_MEASUREMENT ModeIn.f_LowModeButton ModeIn.f_LowModeInvalid ModeIn.f_MGate ModeIn.f_MGateOff ModeIn.f_MGateOld ModeIn.f_MGateOn ModeIn.f_SportButtonRaw ModeIn.f_SportButtonRawOld ModeIn.f_SportButtonTrig ModeIn.f_TempMan ModeIn.st_LowModeOld /end LOC_MEASUREMENT
/end FUNCTION
/begin FUNCTION zff_ABK_LEVERSIGNALMERGE "desc_en" /begin LOC_MEASUREMENT LeverSignalMerge.DrvReq_Raw /end LOC_MEASUREMENT /end FUNCTION
/begin FUNCTION zff_ABK_KOMBI_MSG "desc_en"
 /begin LOC_MEASUREMENT KombiMsg.f_FlashPosBadOp KombiMsg.f_IgnOnNeverDetected KombiMsg.f_StandbyBeforeCruise KombiMsg.f_freezeDisplayPReq /end LOC_MEASUREMENT
/end FUNCTION
/begin FUNCTION zff_ABK_KOMBIMSGPOS "desc_en"
 /begin LOC_MEASUREMENT KombiMsgPos.DisplayPos KombiMsgPos.DisplayPosFlash KombiMsgPos.DisplayPosRule KombiMsgPos.DisplayPos_ /end LOC_MEASUREMENT
/end FUNCTION
/begin FUNCTION zff_ABK_KOMBIMSGMODE "desc_en" /begin LOC_MEASUREMENT KombiMsgMode.DisplayMode KombiMsgMode.SelectedDispMode /end LOC_MEASUREMENT /end FUNCTION
/begin FUNCTION zff_ABK_KOMBIMSGGEAR "desc_en" /begin LOC_MEASUREMENT KombiMsgGear.DisplayGear /end LOC_MEASUREMENT /end FUNCTION
/begin FUNCTION zff_ABK_KOMBIMSGFLASH "desc_en" /begin LOC_MEASUREMENT KombiMsgFlash.f_CC_PL_Fault KombiMsgFlash.st_KombiPosFlash /end LOC_MEASUREMENT /end FUNCTION
/begin FUNCTION zff_ABK_MULTACCESS "desc_en"
 /begin LOC_MEASUREMENT MultAccess.DriveLogic MultAccess.DriveLogicOld MultAccess.DriveLogicTrig MultAccess.DrvReqPRND_Raw MultAccess.DrvReqP_Trig MultAccess.DrvReq_Old MultAccess.DrvReq_Trig MultAccess.GatePos MultAccess.GatePosOld MultAccess.cnt_SimOperations MultAccess.f_P12ButtonOld MultAccess.f_SDButton MultAccess.f_SDButtonRawOff MultAccess.f_SDButtonRawOld MultAccess.f_SDButtonRawOn MultAccess.st_EmfP_Old MultAccess.st_EmfP_Trig MultAccess.st_TipMinus1 MultAccess.st_TipMinus2 MultAccess.st_TipPlus1 MultAccess.st_TipPlus2 /end LOC_MEASUREMENT
/end FUNCTION
/begin FUNCTION zff_ABK_DEBOUNCEDRVREQ "desc_en"
 /begin LOC_MEASUREMENT DebounceDrvReq.DrvReqPRND_Filt DebounceDrvReq.LastValidDrvReqPRND_Raw DebounceDrvReq.f_AllowTimerCompute DebounceDrvReq.f_NoDebounceNA2N DebounceDrvReq.f_NoDebounceRD2N DebounceDrvReq.f_StartOrResetOfDebounceOccured DebounceDrvReq.st_Debounce /end LOC_MEASUREMENT
/end FUNCTION
/begin FUNCTION zff_ABK_STOREDRVREQ "desc_en"
 /begin LOC_MEASUREMENT StoreDrvReq.DrvReqPRND StoreDrvReq.DrvReqPRND_FiltPrev StoreDrvReq.f_NoStoreN StoreDrvReq.f_NoStoreP StoreDrvReq.f_NoStoreRD StoreDrvReq.f_StartRestartOrResetOfStorageOccured StoreDrvReq.st_StorePRND /end LOC_MEASUREMENT
/end FUNCTION
/begin RECORD_LAYOUT AblGLKWBsw_S1 FNC_VALUES 1 SWORD COLUMN_DIR DIRECT /end RECORD_LAYOUT
/begin RECORD_LAYOUT AblGLKWBub_S1 FNC_VALUES 1 UBYTE COLUMN_DIR DIRECT /end RECORD_LAYOUT
/begin RECORD_LAYOUT AblGLKWBuw_S1 FNC_VALUES 1 UWORD COLUMN_DIR DIRECT /end RECORD_LAYOUT
/begin RECORD_LAYOUT AblGLKWub_S1 FNC_VALUES 1 UBYTE COLUMN_DIR DIRECT /end RECORD_LAYOUT
/begin RECORD_LAYOUT AblGLKWuw_S1 FNC_VALUES 1 UWORD COLUMN_DIR DIRECT /end RECORD_LAYOUT
/end MODULE
/end PROJECT
