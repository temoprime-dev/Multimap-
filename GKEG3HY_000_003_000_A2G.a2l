ASAP2_VERSION 1 51
/begin PROJECT _929_929 "Gen2_BMW_System_Supplier_Lib"
/begin HEADER "" VERSION "C_03_03" PROJECT_NO _929_929 /end HEADER
/begin MODULE DIM ""
/begin MOD_COMMON "" BYTE_ORDER MSB_FIRST ALIGNMENT_BYTE 1 ALIGNMENT_WORD 2 ALIGNMENT_LONG 4 ALIGNMENT_FLOAT32_IEEE 4 /end MOD_COMMON
/begin CHARACTERISTIC TAB_SWI_GLOBALSTROMSCHL "Übergeordnete Zuordnung Stromschleife." CURVE 0x224530 tab_ui8_S6_S3 2 UMR___1_1_0_S6_S3 0 2
 /begin AXIS_DESCR FIX_AXIS NO_INPUT_QUANTITY UMR___1_1_0_S6_S3 6 0 5 FIX_AXIS_PAR_DIST 0 1 6 /end AXIS_DESCR
/end CHARACTERISTIC
/begin CHARACTERISTIC TAB_SWISTROMSCHL "Schalter gangabhängige Stromschleife (0=aus, 1=ein, 2=sp aus, 3=sport/amax aus)" MAP 0x22453C tab2d_ui8_S6_S3 4 UMR___1_1_0_S6_S3 0 4
 /begin AXIS_DESCR FIX_AXIS zff_atsys._.iSignale._.obj.sig_istgang UMR___1_1_0_S6_S3 10 -1 8 FIX_AXIS_PAR_DIST -1 1 10 /end AXIS_DESCR
 /begin AXIS_DESCR FIX_AXIS zff_atsys._.iSignale._.obj.sig_zielgang UMR___1_1_0_S6_S3 10 -1 8 FIX_AXIS_PAR_DIST -1 1 10 /end AXIS_DESCR
/end CHARACTERISTIC
/begin CHARACTERISTIC TAB_PMAXKV "Max.druck 0-2=Dummy; 3=KV_A; 4=KV_B; 5=Dummy; 6=KV_C; 7=Dummy; 8=KV_D; 9=KV_E;" CURVE 0x2245A8 tab_ui16_S6_S3 23 UMR_BAR__1_1000_0_S6_S3 0 23
 /begin AXIS_DESCR FIX_AXIS NO_INPUT_QUANTITY UMR___1_1_0_S6_S3 10 0 9 FIX_AXIS_PAR_DIST 0 1 10 /end AXIS_DESCR
/end CHARACTERISTIC
/begin CHARACTERISTIC PO_SAEND "Druckoffset auf max. Gesamtdruck" VALUE 0x26D670 kw_si16_S6_S3 12.7 UMR_BAR__1_1000_0_S6_S3 0 12.7 /end CHARACTERISTIC
/begin CHARACTERISTIC TS_KPL_AKTIV "Zeit bis 'Kupplung aktiv' erkannt wird." VALUE 0x26D672 kw_ui16_S6_S3 31999 UMR_SEC__1_1_0_S6_S3 1 32000 /end CHARACTERISTIC
/begin CHARACTERISTIC TS_KPL_INAKTIV "Zeit bis 'Kupplung inaktiv' erkannt wird." VALUE 0x26D674 kw_ui16_S6_S3 31999 UMR_SEC__1_1_0_S6_S3 1 32000 /end CHARACTERISTIC
/begin CHARACTERISTIC TAB_SWI_PREPULS "Schalter Prepuls Schnellfuellung (0=inaktiv, 1=aktiv, 2=norm/sp aktiv, 3=sport/sp aktiv, 4=sport aktiv)" CURVE 0x2245C0 tab_ui8_S6_S3 4 UMR___1_1_0_S6_S3 0 4
 /begin AXIS_DESCR FIX_AXIS NO_INPUT_QUANTITY UMR___1_1_0_S6_S3 6 0 5 FIX_AXIS_PAR_DIST 0 1 6 /end AXIS_DESCR
/end CHARACTERISTIC
/begin CHARACTERISTIC F_TSFADAESTARTSTART_E "Faktor für Schnellfüllzeitadaptionswert Kup. E ESTART" VALUE 0x26E55D kw_ui8_S6_S3 1 UMR___1_100_0_S6_S3 0 1 /end CHARACTERISTIC
/begin CHARACTERISTIC KF_PSFCGMTESTART_E "Kennfeld Schnellfülldruck Kup. E ESTART" MAP 0x2245CC kf_si16_S6_S3 12.75 UMR_BAR__1_1000_0_S6_S3 0 12.75
 /begin AXIS_DESCR STD_AXIS zff_atsys._.iSignale._.obj.sig_c_getr UMR_GRADC__1_1_M40_S6_S3 8 -40 150 DEPOSIT ABSOLUTE MONOTONY MON_INCREASE /end AXIS_DESCR
 /begin AXIS_DESCR STD_AXIS zff_atsys._.iSignale._.obj.sig_m_t8 UMR_NM__8_1_M50_S6_S3 4 -400 1640 DEPOSIT ABSOLUTE MONOTONY MON_INCREASE /end AXIS_DESCR
/end CHARACTERISTIC
/begin CHARACTERISTIC KL_TSFCGESTART_E "Schnellfüllzeit Kup. E ESTART" CURVE 0x22462C kl_ui16_S6_S3 2540 UMR_MSEC__1_1_0_S6_S3 0 2540
 /begin AXIS_DESCR STD_AXIS zff_atsys._.iSignale._.obj.sig_c_getr UMR_GRADC__1_1_M40_S6_S3 10 -40 150 DEPOSIT ABSOLUTE MONOTONY MON_INCREASE /end AXIS_DESCR
/end CHARACTERISTIC
/begin CHARACTERISTIC KL_TOSFNKESTART "Schnellfüllzeitoffset Kup. E ESTART" CURVE 0x224658 kl_si16_S6_S3 3540 UMR_MSEC__1_1_0_S6_S3 -1000 2540
 /begin AXIS_DESCR STD_AXIS NO_INPUT_QUANTITY UMR_U_MIN_1_1_0_S6_S3 8 0 11000 DEPOSIT ABSOLUTE MONOTONY MON_INCREASE /end AXIS_DESCR
/end CHARACTERISTIC
/begin CHARACTERISTIC KL_PGRAPSFFUELLRED_K0 "Rampengradient fuer SF K0" CURVE 0x22467C kl_ui16_S6_S3 640 UMR_BAR_SEC_1_10_0_S6_S3 0 640
 /begin AXIS_DESCR STD_AXIS zff_atsys._.iSignale._.obj.sig_c_getr UMR_GRADC__1_1_M40_S6_S3 4 -40 150 DEPOSIT ABSOLUTE MONOTONY MON_INCREASE /end AXIS_DESCR
/end CHARACTERISTIC
/begin CHARACTERISTIC KF_PCTG_FUELLK0 "Gradient der Befüllung des K0-Stauraums" MAP 0x224690 kf_si16_S6_S3 20000 UMR_PROZENT_SEC_1_1_0_S6_S3 -10000 10000
 /begin AXIS_DESCR STD_AXIS iIaeKuehl.vp_sek_k0_iae UMR_LITER_MIN_1_10_0_S6_S3 6 0 50 DEPOSIT ABSOLUTE MONOTONY MON_INCREASE /end AXIS_DESCR
 /begin AXIS_DESCR STD_AXIS zff_atsys._.iSignale._.obj.sig_c_getr UMR_GRADC__1_1_M40_S6_S3 4 -40 150 DEPOSIT ABSOLUTE MONOTONY MON_INCREASE /end AXIS_DESCR
/end CHARACTERISTIC
/begin CHARACTERISTIC KF_PCTG_ENTLEERK0 "Gradient der Entleerung des K0-Stauraums" MAP 0x2246DC kf_si16_S6_S3 20000 UMR_PROZENT_SEC_1_1_0_S6_S3 -10000 10000
 /begin AXIS_DESCR STD_AXIS zff_atsys._.iSignale._.obj.sig_n_mot UMR_U_MIN_1_1_0_S6_S3 6 0 8160 DEPOSIT ABSOLUTE MONOTONY MON_INCREASE /end AXIS_DESCR
 /begin AXIS_DESCR STD_AXIS zff_atsys._.iSignale._.obj.sig_c_getr UMR_GRADC__1_1_M40_S6_S3 4 -40 150 DEPOSIT ABSOLUTE MONOTONY MON_INCREASE /end AXIS_DESCR
/end CHARACTERISTIC
/begin CHARACTERISTIC KF_PO_BEFUELLGRAD_K0 "Offset auf p_fmin der K0 in Abhängigkeit des Befüllgrads" MAP 0x224728 kf_si16_S6_S3 1 UMR_BAR__1_1000_0_S6_S3 -1 0
 /begin AXIS_DESCR STD_AXIS zff_atsys._.iSignale._.obj.sig_n_mot UMR_U_MIN_1_1_0_S6_S3 6 0 8160 DEPOSIT ABSOLUTE MONOTONY MON_INCREASE /end AXIS_DESCR
 /begin AXIS_DESCR STD_AXIS iModKupSfktK0.befuellgrad_k0 UMR_PROZENT__1_100_0_S6_S3 4 0 100 DEPOSIT ABSOLUTE MONOTONY MON_INCREASE /end AXIS_DESCR
/end CHARACTERISTIC
/begin CHARACTERISTIC KF_TO_BEFUELLGRAD_K0 "Offset auf die Schnellfüllzeit der K0 in Abhängigkeit des Befüllgrads" MAP 0x224774 kf_si16_S6_S3 1000 UMR_MSEC__1_1_0_S6_S3 -1000 0
 /begin AXIS_DESCR STD_AXIS zff_atsys._.iSignale._.obj.sig_n_mot UMR_U_MIN_1_1_0_S6_S3 6 0 8160 DEPOSIT ABSOLUTE MONOTONY MON_INCREASE /end AXIS_DESCR
 /begin AXIS_DESCR STD_AXIS iModKupSfktK0.befuellgrad_k0 UMR_PROZENT__1_100_0_S6_S3 4 0 100 DEPOSIT ABSOLUTE MONOTONY MON_INCREASE /end AXIS_DESCR
/end CHARACTERISTIC
/begin CHARACTERISTIC KL_F_TO_BEFUELLGRAD_K0 "Temp abhaengiger Korrekturfaktor fuer KF_TO_BEFUELLGRAD_K0" CURVE 0x2247C0 kl_ui16_S6_S3 2 UMR___1_100_0_S6_S3 0 2
 /begin AXIS_DESCR STD_AXIS zff_atsys._.iSignale._.obj.sig_c_getr UMR_GRADC__1_1_M40_S6_S3 4 -40 150 DEPOSIT ABSOLUTE MONOTONY MON_INCREASE /end AXIS_DESCR
/end CHARACTERISTIC
/begin CHARACTERISTIC KL_F_TSFADAFUELLREDCGT_K0 "Temp abhaengiger Korrekturfaktor fuer F_TSFADAFUELLRED" CURVE 0x2247D4 kl_ui16_S6_S3 10 UMR___1_100_0_S6_S3 0 10
 /begin AXIS_DESCR STD_AXIS zff_atsys._.iSignale._.obj.sig_c_getr UMR_GRADC__1_1_M40_S6_S3 6 -40 150 DEPOSIT ABSOLUTE MONOTONY MON_INCREASE /end AXIS_DESCR
/end CHARACTERISTIC
/begin CHARACTERISTIC TAB_SWI_DEAKT_DITHER_SF "Kupplungsbezogene Deaktivierung der Ditherung waehrend Schnellfuellung" CURVE 0x2247F0 tab_bool8_S6_S3 1 UMR___1_1_0_S6_S3 0 1
 /begin AXIS_DESCR FIX_AXIS NO_INPUT_QUANTITY UMR___1_1_0_S6_S3 6 0 5 FIX_AXIS_PAR_DIST 0 1 6 /end AXIS_DESCR
/end CHARACTERISTIC
/begin CHARACTERISTIC KL_POFMIN_IAE "Druckoffset auf Minimaldruck p_fmin" CURVE 0x2247FC kl_si16_S6_S3 2 UMR_BAR__1_1000_0_S6_S3 0 2
 /begin AXIS_DESCR STD_AXIS zff_atsys._.iSignale._.obj.sig_c_getr UMR_GRADC__1_1_M40_S6_S3 6 -40 150 DEPOSIT ABSOLUTE MONOTONY MON_INCREASE /end AXIS_DESCR
/end CHARACTERISTIC
/begin CHARACTERISTIC KL_TFPWIRK_A "Filterzeit für Kupplungswirkdruck in ms" CURVE 0x224818 kl_ui8_S6_S3 254 UMR_MSEC__1_1_0_S6_S3 0 254
 /begin AXIS_DESCR STD_AXIS zff_atsys._.iSignale._.obj.sig_c_getr UMR_GRADC__1_1_M40_S6_S3 3 -40 150 DEPOSIT ABSOLUTE MONOTONY MON_INCREASE /end AXIS_DESCR
/end CHARACTERISTIC
/begin CHARACTERISTIC KF_PSFCGMT_A "Kennfeld Schnellfülldruck" MAP 0x224824 kf_si16_S6_S3 12.75 UMR_BAR__1_1000_0_S6_S3 0 12.75
 /begin AXIS_DESCR STD_AXIS zff_atsys._.iSignale._.obj.sig_c_getr UMR_GRADC__1_1_M40_S6_S3 8 -40 150 DEPOSIT ABSOLUTE MONOTONY MON_INCREASE /end AXIS_DESCR
 /begin AXIS_DESCR STD_AXIS zff_atsys._.iSignale._.obj.sig_m_t8 UMR_NM__8_1_M50_S6_S3 4 -400 1640 DEPOSIT ABSOLUTE MONOTONY MON_INCREASE /end AXIS_DESCR
/end CHARACTERISTIC
/begin CHARACTERISTIC KF_PSFCGMTFUELLRED_A "Kennfeld Schnellfülldruck" MAP 0x224884 kf_si16_S6_S3 12.75 UMR_BAR__1_1000_0_S6_S3 0 12.75
 /begin AXIS_DESCR STD_AXIS zff_atsys._.iSignale._.obj.sig_c_getr UMR_GRADC__1_1_M40_S6_S3 8 -40 150 DEPOSIT ABSOLUTE MONOTONY MON_INCREASE /end AXIS_DESCR
 /begin AXIS_DESCR STD_AXIS zff_atsys._.iSignale._.obj.sig_m_t8 UMR_NM__8_1_M50_S6_S3 4 -400 1640 DEPOSIT ABSOLUTE MONOTONY MON_INCREASE /end AXIS_DESCR
/end CHARACTERISTIC
/begin CHARACTERISTIC KF_PSFCGMTFUELLOPT_A "Kennfeld Schnellfülldruck" MAP 0x2248E4 kf_si16_S6_S3 12.75 UMR_BAR__1_1000_0_S6_S3 0 12.75
 /begin AXIS_DESCR STD_AXIS zff_atsys._.iSignale._.obj.sig_c_getr UMR_GRADC__1_1_M40_S6_S3 8 -40 150 DEPOSIT ABSOLUTE MONOTONY MON_INCREASE /end AXIS_DESCR
 /begin AXIS_DESCR STD_AXIS zff_atsys._.iSignale._.obj.sig_m_t8 UMR_NM__8_1_M50_S6_S3 4 -400 1640 DEPOSIT ABSOLUTE MONOTONY MON_INCREASE /end AXIS_DESCR
/end CHARACTERISTIC
/begin CHARACTERISTIC KF_POSFCGNAB_A "Kennfeld Schnellfülldruckoffset" MAP 0x224944 kf_si16_S6_S3 5 UMR_BAR__1_1000_0_S6_S3 -5 0
 /begin AXIS_DESCR STD_AXIS zff_atsys._.iSignale._.obj.sig_c_getr UMR_GRADC__1_1_M40_S6_S3 2 -40 150 DEPOSIT ABSOLUTE MONOTONY MON_INCREASE /end AXIS_DESCR
 /begin AXIS_DESCR STD_AXIS zff_atsys._.iSignale._.obj.sig_n_ab8 UMR_U_MIN_32_1_0_S6_S3 2 0 8160 DEPOSIT ABSOLUTE MONOTONY MON_INCREASE /end AXIS_DESCR
/end CHARACTERISTIC
/begin CHARACTERISTIC KL_TSFCG_A "Schnellfüllzeit" CURVE 0x22495C kl_ui16_S6_S3 2540 UMR_MSEC__1_1_0_S6_S3 0 2540
 /begin AXIS_DESCR STD_AXIS zff_atsys._.iSignale._.obj.sig_c_getr UMR_GRADC__1_1_M40_S6_S3 10 -40 150 DEPOSIT ABSOLUTE MONOTONY MON_INCREASE /end AXIS_DESCR
/end CHARACTERISTIC
/begin CHARACTERISTIC KL_TSFCGFUELLRED_A "Schnellfüllzeit reduzierte Befüllung" CURVE 0x224988 kl_ui16_S6_S3 2540 UMR_MSEC__1_1_0_S6_S3 0 2540
 /begin AXIS_DESCR STD_AXIS zff_atsys._.iSignale._.obj.sig_c_getr UMR_GRADC__1_1_M40_S6_S3 10 -40 150 DEPOSIT ABSOLUTE MONOTONY MON_INCREASE /end AXIS_DESCR
/end CHARACTERISTIC
/begin CHARACTERISTIC KL_TSFCGFUELLOPT_A "Schnellfüllzeit optimierte Befüllung" CURVE 0x2249B4 kl_ui16_S6_S3 2540 UMR_MSEC__1_1_0_S6_S3 0 2540
 /begin AXIS_DESCR STD_AXIS zff_atsys._.iSignale._.obj.sig_c_getr UMR_GRADC__1_1_M40_S6_S3 10 -40 150 DEPOSIT ABSOLUTE MONOTONY MON_INCREASE /end AXIS_DESCR
/end CHARACTERISTIC
/begin CHARACTERISTIC KL_TOSFNK_A "Schnellfüllzeitoffset" CURVE 0x2249E0 kl_si16_S6_S3 3540 UMR_MSEC__1_1_0_S6_S3 -1000 2540
 /begin AXIS_DESCR STD_AXIS NO_INPUT_QUANTITY UMR_U_MIN_1_1_0_S6_S3 8 0 11000 DEPOSIT ABSOLUTE MONOTONY MON_INCREASE /end AXIS_DESCR
/end CHARACTERISTIC
/begin CHARACTERISTIC KL_TOSFNKFUELLRED_A "Schnellfüllzeitoffset reduzierte Befüllung" CURVE 0x224A04 kl_si16_S6_S3 3540 UMR_MSEC__1_1_0_S6_S3 -1000 2540
 /begin AXIS_DESCR STD_AXIS NO_INPUT_QUANTITY UMR_U_MIN_1_1_0_S6_S3 8 0 11000 DEPOSIT ABSOLUTE MONOTONY MON_INCREASE /end AXIS_DESCR
/end CHARACTERISTIC
/begin CHARACTERISTIC KL_TOSFNKFUELLOPT_A "Schnellfüllzeitoffset optimierte Befüllung" CURVE 0x224A28 kl_si16_S6_S3 3540 UMR_MSEC__1_1_0_S6_S3 -1000 2540
 /begin AXIS_DESCR STD_AXIS NO_INPUT_QUANTITY UMR_U_MIN_1_1_0_S6_S3 8 0 11000 DEPOSIT ABSOLUTE MONOTONY MON_INCREASE /end AXIS_DESCR
/end CHARACTERISTIC
/begin CHARACTERISTIC KF_TOSFGE_A "Offset auf Schnellfüllzeit beim Gangeinlegen" MAP 0x224A4C kf_si16_S6_S3 2000 UMR_MSEC__1_1_0_S6_S3 -1000 1000
 /begin AXIS_DESCR STD_AXIS zff_atsys._.iSignale._.obj.sig_c_getr UMR_GRADC__1_1_M40_S6_S3 4 -40 150 DEPOSIT ABSOLUTE MONOTONY MON_INCREASE /end AXIS_DESCR
 /begin AXIS_DESCR STD_AXIS zff_atsys._.iSignale._.obj.sig_m_t UMR_NM__1_1_0_S6_S3 4 -400 1640 DEPOSIT ABSOLUTE MONOTONY MON_INCREASE /end AXIS_DESCR
/end CHARACTERISTIC
/begin CHARACTERISTIC KF_TOSFHS_A "Schnellfüllzeitoffset HS" MAP 0x224A84 kf_si16_S6_S3 2000 UMR_MSEC__1_1_0_S6_S3 -1000 1000
 /begin AXIS_DESCR STD_AXIS zff_atsys._.iSignale._.obj.sig_n_t UMR_U_MIN_1_1_0_S6_S3 4 0 8160 DEPOSIT ABSOLUTE MONOTONY MON_INCREASE /end AXIS_DESCR
 /begin AXIS_DESCR STD_AXIS zff_atsys._.iSignale._.obj.sig_m_t UMR_NM__1_1_0_S6_S3 4 -400 1640 DEPOSIT ABSOLUTE MONOTONY MON_INCREASE /end AXIS_DESCR
/end CHARACTERISTIC
/begin CHARACTERISTIC KF_TOSFHS_A_EL "Schnellfüllzeitoffset HS" MAP 0x224ABC kf_si16_S6_S3 2000 UMR_MSEC__1_1_0_S6_S3 -1000 1000
 /begin AXIS_DESCR STD_AXIS zff_atsys._.iSignale._.obj.sig_n_t UMR_U_MIN_1_1_0_S6_S3 4 0 8160 DEPOSIT ABSOLUTE MONOTONY MON_INCREASE /end AXIS_DESCR
 /begin AXIS_DESCR STD_AXIS zff_atsys._.iSignale._.obj.sig_m_t UMR_NM__1_1_0_S6_S3 4 -400 1640 DEPOSIT ABSOLUTE MONOTONY MON_INCREASE /end AXIS_DESCR
/end CHARACTERISTIC
/begin CHARACTERISTIC KF_TOSFHSSP_A "Schnellfüllzeitoffset spontane HS" MAP 0x224AF4 kf_si16_S6_S3 2000 UMR_MSEC__1_1_0_S6_S3 -1000 1000
 /begin AXIS_DESCR STD_AXIS zff_atsys._.iSignale._.obj.sig_n_t UMR_U_MIN_1_1_0_S6_S3 4 0 8160 DEPOSIT ABSOLUTE MONOTONY MON_INCREASE /end AXIS_DESCR
 /begin AXIS_DESCR STD_AXIS zff_atsys._.iSignale._.obj.sig_m_t UMR_NM__1_1_0_S6_S3 4 -400 1640 DEPOSIT ABSOLUTE MONOTONY MON_INCREASE /end AXIS_DESCR
/end CHARACTERISTIC
/begin CHARACTERISTIC KF_TOSFHSSPORT_A "Schnellfüllzeitoffset sportliche HS" MAP 0x224B2C kf_si16_S6_S3 2000 UMR_MSEC__1_1_0_S6_S3 -1000 1000
 /begin AXIS_DESCR STD_AXIS zff_atsys._.iSignale._.obj.sig_n_t UMR_U_MIN_1_1_0_S6_S3 4 0 8160 DEPOSIT ABSOLUTE MONOTONY MON_INCREASE /end AXIS_DESCR
 /begin AXIS_DESCR STD_AXIS zff_atsys._.iSignale._.obj.sig_m_t UMR_NM__1_1_0_S6_S3 4 -400 1640 DEPOSIT ABSOLUTE MONOTONY MON_INCREASE /end AXIS_DESCR
/end CHARACTERISTIC
/begin CHARACTERISTIC KF_TOSFHSFUELLOPT_A "Schnellfüllzeitoffset HS mit opt. Befüllung" MAP 0x224B64 kf_si16_S6_S3 2000 UMR_MSEC__1_1_0_S6_S3 -1000 1000
 /begin AXIS_DESCR STD_AXIS zff_atsys._.iSignale._.obj.sig_n_t UMR_U_MIN_1_1_0_S6_S3 4 0 8160 DEPOSIT ABSOLUTE MONOTONY MON_INCREASE /end AXIS_DESCR
 /begin AXIS_DESCR STD_AXIS zff_atsys._.iSignale._.obj.sig_m_t UMR_NM__1_1_0_S6_S3 4 -400 1640 DEPOSIT ABSOLUTE MONOTONY MON_INCREASE /end AXIS_DESCR
/end CHARACTERISTIC
/begin CHARACTERISTIC KF_TOSFRS_A "Schnellfüllzeitoffset RS" MAP 0x224B9C kf_si16_S6_S3 2000 UMR_MSEC__1_1_0_S6_S3 -1000 1000
 /begin AXIS_DESCR STD_AXIS zff_atsys._.iSignale._.obj.sig_n_t UMR_U_MIN_1_1_0_S6_S3 4 0 8160 DEPOSIT ABSOLUTE MONOTONY MON_INCREASE /end AXIS_DESCR
 /begin AXIS_DESCR STD_AXIS zff_atsys._.iSignale._.obj.sig_m_t UMR_NM__1_1_0_S6_S3 4 -400 1640 DEPOSIT ABSOLUTE MONOTONY MON_INCREASE /end AXIS_DESCR
/end CHARACTERISTIC
/begin CHARACTERISTIC KF_TOSFRS_A_EL "Schnellfüllzeitoffset RS" MAP 0x224BD4 kf_si16_S6_S3 2000 UMR_MSEC__1_1_0_S6_S3 -1000 1000
 /begin AXIS_DESCR STD_AXIS zff_atsys._.iSignale._.obj.sig_n_t UMR_U_MIN_1_1_0_S6_S3 4 0 8160 DEPOSIT ABSOLUTE MONOTONY MON_INCREASE /end AXIS_DESCR
 /begin AXIS_DESCR STD_AXIS zff_atsys._.iSignale._.obj.sig_m_t UMR_NM__1_1_0_S6_S3 4 -400 1640 DEPOSIT ABSOLUTE MONOTONY MON_INCREASE /end AXIS_DESCR
/end CHARACTERISTIC
/begin CHARACTERISTIC KF_TOSFRSSP_A "Schnellfüllzeitoffset spontane RS" MAP 0x224C0C kf_si16_S6_S3 2000 UMR_MSEC__1_1_0_S6_S3 -1000 1000
 /begin AXIS_DESCR STD_AXIS zff_atsys._.iSignale._.obj.sig_n_t UMR_U_MIN_1_1_0_S6_S3 4 0 8160 DEPOSIT ABSOLUTE MONOTONY MON_INCREASE /end AXIS_DESCR
 /begin AXIS_DESCR STD_AXIS zff_atsys._.iSignale._.obj.sig_m_t UMR_NM__1_1_0_S6_S3 4 -400 1640 DEPOSIT ABSOLUTE MONOTONY MON_INCREASE /end AXIS_DESCR
/end CHARACTERISTIC
/begin CHARACTERISTIC KF_TOSFRSSPORT_A "Schnellfüllzeitoffset sportliche RS" MAP 0x224C44 kf_si16_S6_S3 2000 UMR_MSEC__1_1_0_S6_S3 -1000 1000
 /begin AXIS_DESCR STD_AXIS zff_atsys._.iSignale._.obj.sig_n_t UMR_U_MIN_1_1_0_S6_S3 4 0 8160 DEPOSIT ABSOLUTE MONOTONY MON_INCREASE /end AXIS_DESCR
 /begin AXIS_DESCR STD_AXIS zff_atsys._.iSignale._.obj.sig_m_t UMR_NM__1_1_0_S6_S3 4 -400 1640 DEPOSIT ABSOLUTE MONOTONY MON_INCREASE /end AXIS_DESCR
/end CHARACTERISTIC
/begin CHARACTERISTIC F_TSFADAFUELLOPT_A "Faktor für Schnellfüllzeitadaptionswert opt. Befüllung" VALUE 0x26E55E kw_ui8_S6_S3 1 UMR___1_100_0_S6_S3 0 1 /end CHARACTERISTIC
/begin CHARACTERISTIC F_TSFADAFUELLRED_A "Faktor für Schnellfüllzeitadaptionswert red. Befüllung" VALUE 0x26E55F kw_ui8_S6_S3 2 UMR___1_100_0_S6_S3 0 2 /end CHARACTERISTIC
/begin CHARACTERISTIC KL_FPFCGADAFUELLRED_A "Faktor für Fülldruckadaptionswert red. Befüllung" CURVE 0x224C7C kl_ui8_S6_S3 1 UMR___1_100_0_S6_S3 0 1
 /begin AXIS_DESCR STD_AXIS zff_atsys._.iSignale._.obj.sig_c_getr UMR_GRADC__1_1_M40_S6_S3 4 -40 150 DEPOSIT ABSOLUTE MONOTONY MON_INCREASE /end AXIS_DESCR
/end CHARACTERISTIC
/begin CHARACTERISTIC KF_TO1SFCG_A "Schnellfüllzeitoffset erste Befüllung" MAP 0x224C88 kf_si16_S6_S3 2550 UMR_MSEC__1_1_0_S6_S3 -1280 1270
 /begin AXIS_DESCR STD_AXIS zff_atsys._.iSignale._.obj.sig_c_getr UMR_GRADC__1_1_M40_S6_S3 10 -40 150 DEPOSIT ABSOLUTE MONOTONY MON_INCREASE /end AXIS_DESCR
 /begin AXIS_DESCR STD_AXIS iItfInput.c_getrabst UMR_GRADC__1_1_M40_S6_S3 6 -40 150 DEPOSIT ABSOLUTE MONOTONY MON_INCREASE /end AXIS_DESCR
/end CHARACTERISTIC
/begin CHARACTERISTIC T_O1SFAUSSB_A "Schnellfüllzeitoffset erste Befüllung nach Neustart aus Standby" VALUE 0x26D676 kw_si16_S6_S3 1270 UMR_MSEC__1_1_0_S6_S3 0 1270 /end CHARACTERISTIC
/begin CHARACTERISTIC KL_TTOTFUELL_A "Totzeit" CURVE 0x224D28 kl_ui8_S6_S3 2000 UMR_MSEC__10_1_0_S6_S3 0 2000
 /begin AXIS_DESCR STD_AXIS zff_atsys._.iSignale._.obj.sig_c_getr UMR_GRADC__1_1_M40_S6_S3 5 -40 150 DEPOSIT ABSOLUTE MONOTONY MON_INCREASE /end AXIS_DESCR
/end CHARACTERISTIC
/begin CHARACTERISTIC KF_TENTLEER_A "Entleerzeit der Kupplung" MAP 0x224D38 kf_ui16_S6_S3 20000 UMR_MSEC__10_1_0_S6_S3 0 20000
 /begin AXIS_DESCR STD_AXIS zff_atsys._.iSignale._.obj.sig_c_getr UMR_GRADC__1_1_M40_S6_S3 10 -40 150 DEPOSIT ABSOLUTE MONOTONY MON_INCREASE /end AXIS_DESCR
 /begin AXIS_DESCR STD_AXIS NO_INPUT_QUANTITY UMR_U_MIN_1_1_0_S6_S3 8 0 11000 DEPOSIT ABSOLUTE MONOTONY MON_INCREASE /end AXIS_DESCR
/end CHARACTERISTIC
/begin CHARACTERISTIC KF_TOENTLEERCGADA_A "Entleerzeit der Kupplung" MAP 0x224E04 kf_si16_S6_S3 21000 UMR_MSEC__10_1_0_S6_S3 -1000 20000
 /begin AXIS_DESCR STD_AXIS zff_atsys._.iSignale._.obj.sig_c_getr UMR_GRADC__1_1_M40_S6_S3 8 -40 150 DEPOSIT ABSOLUTE MONOTONY MON_INCREASE /end AXIS_DESCR
 /begin AXIS_DESCR STD_AXIS NO_INPUT_QUANTITY UMR_MSEC__1_1_0_S6_S3 6 -32768 32767 DEPOSIT ABSOLUTE MONOTONY MON_INCREASE /end AXIS_DESCR
/end CHARACTERISTIC
/begin CHARACTERISTIC TOENTLEERSR_A "Offset auf Entleerzeit bei aktiver Stromrampe" VALUE 0x26D678 kw_si16_S6_S3 2000 UMR_MSEC__1_1_0_S6_S3 0 2000 /end CHARACTERISTIC
/begin CHARACTERISTIC PO_KOLBENPOSKOR_A "Druckoffset für Start timer_kolbenpos_kor" VALUE 0x26D67A kw_ui16_S6_S3 2 UMR_BAR__1_1000_0_S6_S3 0 2 /end CHARACTERISTIC
/begin CHARACTERISTIC KL_FKOLBENPOSCGKOR_A "Faktor auf Basiskolbenposition" CURVE 0x224E88 kl_ui8_S6_S3 1 UMR___1_100_0_S6_S3 1 2
 /begin AXIS_DESCR STD_AXIS zff_atsys._.iSignale._.obj.sig_c_getr UMR_GRADC__1_1_M40_S6_S3 4 -40 150 DEPOSIT ABSOLUTE MONOTONY MON_INCREASE /end AXIS_DESCR
/end CHARACTERISTIC
/begin CHARACTERISTIC KF_FKOLBENPOSKOR_A "Faktor auf Basiskolbenposition" MAP 0x224E94 kf_si16_S6_S3 1 UMR___1_100_0_S6_S3 0 1
 /begin AXIS_DESCR STD_AXIS NO_INPUT_QUANTITY UMR_MSEC__10_1_0_S6_S3 6 0 2550 DEPOSIT ABSOLUTE MONOTONY MON_INCREASE /end AXIS_DESCR
 /begin AXIS_DESCR STD_AXIS NO_INPUT_QUANTITY UMR_MSEC__1_1_0_S6_S3 4 -32768 32767 DEPOSIT ABSOLUTE MONOTONY MON_INCREASE /end AXIS_DESCR
/end CHARACTERISTIC
/begin CHARACTERISTIC PO_KOLBENPOSKORGA_A "Druckoffset bei GA für Start timer_kolbenpos_kor" VALUE 0x26D67C kw_ui16_S6_S3 2 UMR_BAR__1_1000_0_S6_S3 0 2 /end CHARACTERISTIC
/begin CHARACTERISTIC KF_FKOLBENPOSKORGA_A "Faktor auf Basiskolbenposition bei GA" MAP 0x224EE0 kf_si16_S6_S3 1 UMR___1_100_0_S6_S3 0 1
 /begin AXIS_DESCR STD_AXIS NO_INPUT_QUANTITY UMR_MSEC__10_1_0_S6_S3 6 0 2550 DEPOSIT ABSOLUTE MONOTONY MON_INCREASE /end AXIS_DESCR
 /begin AXIS_DESCR STD_AXIS NO_INPUT_QUANTITY UMR_MSEC__1_1_0_S6_S3 4 -32768 32767 DEPOSIT ABSOLUTE MONOTONY MON_INCREASE /end AXIS_DESCR
/end CHARACTERISTIC
/begin CHARACTERISTIC KL_PFHYSCG_A "Fülldruckhysterese" CURVE 0x224F2C kl_si16_S6_S3 12.7 UMR_BAR__1_1000_0_S6_S3 0 12.7
 /begin AXIS_DESCR STD_AXIS zff_atsys._.iSignale._.obj.sig_c_getr UMR_GRADC__1_1_M40_S6_S3 10 -40 150 DEPOSIT ABSOLUTE MONOTONY MON_INCREASE /end AXIS_DESCR
/end CHARACTERISTIC
/begin CHARACTERISTIC KL_TVCGSAENDHS_A "Verzoegerungszeit für Umstellung auf Schaltungsende bei HS" CURVE 0x224F58 kl_ui8_S6_S3 2000 UMR_MSEC__10_1_0_S6_S3 0 2000
 /begin AXIS_DESCR STD_AXIS zff_atsys._.iSignale._.obj.sig_c_getr UMR_GRADC__1_1_M40_S6_S3 3 -40 150 DEPOSIT ABSOLUTE MONOTONY MON_INCREASE /end AXIS_DESCR
/end CHARACTERISTIC
/begin CHARACTERISTIC KL_TVCGSAENDRS_A "Verzoegerungszeit für Umstellung auf Schaltungsende bei RS" CURVE 0x224F64 kl_ui8_S6_S3 2000 UMR_MSEC__10_1_0_S6_S3 0 2000
 /begin AXIS_DESCR STD_AXIS zff_atsys._.iSignale._.obj.sig_c_getr UMR_GRADC__1_1_M40_S6_S3 3 -40 150 DEPOSIT ABSOLUTE MONOTONY MON_INCREASE /end AXIS_DESCR
/end CHARACTERISTIC
/begin CHARACTERISTIC KL_TVCGSAENDGE_A "Verzoegerungszeit für Umstellung auf Schaltungsende bei GE" CURVE 0x224F70 kl_ui8_S6_S3 2000 UMR_MSEC__10_1_0_S6_S3 0 2000
 /begin AXIS_DESCR STD_AXIS zff_atsys._.iSignale._.obj.sig_c_getr UMR_GRADC__1_1_M40_S6_S3 3 -40 150 DEPOSIT ABSOLUTE MONOTONY MON_INCREASE /end AXIS_DESCR
/end CHARACTERISTIC
/begin CHARACTERISTIC TO_ABBRUCHSAEND_A "Offset auf Verzoegerungszeit zur Umstellung auf Schaltungsende" VALUE 0x26E560 kw_si8_S6_S3 2000 UMR_MSEC__10_1_0_S6_S3 -1000 1000 /end CHARACTERISTIC
/begin CHARACTERISTIC KL_PFCGGA_A "Fülldruck bei Gangauslegen" CURVE 0x224F7C kl_si16_S6_S3 12.75 UMR_BAR__1_1000_0_S6_S3 0 12.75
 /begin AXIS_DESCR STD_AXIS zff_atsys._.iSignale._.obj.sig_c_getr UMR_GRADC__1_1_M40_S6_S3 10 -40 150 DEPOSIT ABSOLUTE MONOTONY MON_INCREASE /end AXIS_DESCR
/end CHARACTERISTIC
/begin CHARACTERISTIC KL_PKUPPSTROM_A "Druckwert für Stromschleife" CURVE 0x224FA8 kl_ui16_S6_S3 5 UMR_BAR__1_1000_0_S6_S3 0 5
 /begin AXIS_DESCR STD_AXIS zff_atsys._.iSignale._.obj.sig_c_getr UMR_GRADC__1_1_M40_S6_S3 4 -40 150 DEPOSIT ABSOLUTE MONOTONY MON_INCREASE /end AXIS_DESCR
/end CHARACTERISTIC
/begin CHARACTERISTIC KL_PFCG_A "Fülldruck" CURVE 0x224FBC kl_si16_S6_S3 12.75 UMR_BAR__1_1000_0_S6_S3 0 12.75
 /begin AXIS_DESCR STD_AXIS zff_atsys._.iSignale._.obj.sig_c_getr UMR_GRADC__1_1_M40_S6_S3 10 -40 150 DEPOSIT ABSOLUTE MONOTONY MON_INCREASE /end AXIS_DESCR
/end CHARACTERISTIC
/begin CHARACTERISTIC IGKABENTLEER_A "Gradient Stromrampe Kupplung entleeren" VALUE 0x26D67E kw_si16_S6_S3 200 UMR_A_SEC_1_10_0_S6_S3 -100 100 /end CHARACTERISTIC
/begin CHARACTERISTIC KL_TFPWIRK_B "Filterzeit für Kupplungswirkdruck in ms" CURVE 0x224FE8 kl_ui8_S6_S3 254 UMR_MSEC__1_1_0_S6_S3 0 254
 /begin AXIS_DESCR STD_AXIS zff_atsys._.iSignale._.obj.sig_c_getr UMR_GRADC__1_1_M40_S6_S3 3 -40 150 DEPOSIT ABSOLUTE MONOTONY MON_INCREASE /end AXIS_DESCR
/end CHARACTERISTIC
/begin CHARACTERISTIC KF_PSFCGMT_B "Kennfeld Schnellfülldruck" MAP 0x224FF4 kf_si16_S6_S3 12.75 UMR_BAR__1_1000_0_S6_S3 0 12.75
 /begin AXIS_DESCR STD_AXIS zff_atsys._.iSignale._.obj.sig_c_getr UMR_GRADC__1_1_M40_S6_S3 8 -40 150 DEPOSIT ABSOLUTE MONOTONY MON_INCREASE /end AXIS_DESCR
 /begin AXIS_DESCR STD_AXIS zff_atsys._.iSignale._.obj.sig_m_t8 UMR_NM__8_1_M50_S6_S3 4 -400 1640 DEPOSIT ABSOLUTE MONOTONY MON_INCREASE /end AXIS_DESCR
/end CHARACTERISTIC
/begin CHARACTERISTIC KF_PSFCGMTFUELLRED_B "Kennfeld Schnellfülldruck" MAP 0x225054 kf_si16_S6_S3 12.75 UMR_BAR__1_1000_0_S6_S3 0 12.75
 /begin AXIS_DESCR STD_AXIS zff_atsys._.iSignale._.obj.sig_c_getr UMR_GRADC__1_1_M40_S6_S3 8 -40 150 DEPOSIT ABSOLUTE MONOTONY MON_INCREASE /end AXIS_DESCR
 /begin AXIS_DESCR STD_AXIS zff_atsys._.iSignale._.obj.sig_m_t8 UMR_NM__8_1_M50_S6_S3 4 -400 1640 DEPOSIT ABSOLUTE MONOTONY MON_INCREASE /end AXIS_DESCR
/end CHARACTERISTIC
/begin CHARACTERISTIC KF_PSFCGMTFUELLOPT_B "Kennfeld Schnellfülldruck" MAP 0x2250B4 kf_si16_S6_S3 12.75 UMR_BAR__1_1000_0_S6_S3 0 12.75
 /begin AXIS_DESCR STD_AXIS zff_atsys._.iSignale._.obj.sig_c_getr UMR_GRADC__1_1_M40_S6_S3 8 -40 150 DEPOSIT ABSOLUTE MONOTONY MON_INCREASE /end AXIS_DESCR
 /begin AXIS_DESCR STD_AXIS zff_atsys._.iSignale._.obj.sig_m_t8 UMR_NM__8_1_M50_S6_S3 4 -400 1640 DEPOSIT ABSOLUTE MONOTONY MON_INCREASE /end AXIS_DESCR
/end CHARACTERISTIC
/begin CHARACTERISTIC KF_POSFCGNAB_B "Kennfeld Schnellfülldruckoffset" MAP 0x225114 kf_si16_S6_S3 5 UMR_BAR__1_1000_0_S6_S3 -5 0
 /begin AXIS_DESCR STD_AXIS zff_atsys._.iSignale._.obj.sig_c_getr UMR_GRADC__1_1_M40_S6_S3 2 -40 150 DEPOSIT ABSOLUTE MONOTONY MON_INCREASE /end AXIS_DESCR
 /begin AXIS_DESCR STD_AXIS zff_atsys._.iSignale._.obj.sig_n_ab8 UMR_U_MIN_32_1_0_S6_S3 2 0 8160 DEPOSIT ABSOLUTE MONOTONY MON_INCREASE /end AXIS_DESCR
/end CHARACTERISTIC
/begin CHARACTERISTIC KL_TSFCG_B "Schnellfüllzeit" CURVE 0x22512C kl_ui16_S6_S3 2540 UMR_MSEC__1_1_0_S6_S3 0 2540
 /begin AXIS_DESCR STD_AXIS zff_atsys._.iSignale._.obj.sig_c_getr UMR_GRADC__1_1_M40_S6_S3 10 -40 150 DEPOSIT ABSOLUTE MONOTONY MON_INCREASE /end AXIS_DESCR
/end CHARACTERISTIC
/begin CHARACTERISTIC KL_TSFCGFUELLRED_B "Schnellfüllzeit reduzierte Befüllung" CURVE 0x225158 kl_ui16_S6_S3 2540 UMR_MSEC__1_1_0_S6_S3 0 2540
 /begin AXIS_DESCR STD_AXIS zff_atsys._.iSignale._.obj.sig_c_getr UMR_GRADC__1_1_M40_S6_S3 10 -40 150 DEPOSIT ABSOLUTE MONOTONY MON_INCREASE /end AXIS_DESCR
/end CHARACTERISTIC
/begin CHARACTERISTIC KL_TSFCGFUELLOPT_B "Schnellfüllzeit optimierte Befüllung" CURVE 0x225184 kl_ui16_S6_S3 2540 UMR_MSEC__1_1_0_S6_S3 0 2540
 /begin AXIS_DESCR STD_AXIS zff_atsys._.iSignale._.obj.sig_c_getr UMR_GRADC__1_1_M40_S6_S3 10 -40 150 DEPOSIT ABSOLUTE MONOTONY MON_INCREASE /end AXIS_DESCR
/end CHARACTERISTIC
/begin CHARACTERISTIC KL_TOSFNK_B "Schnellfüllzeitoffset" CURVE 0x2251B0 kl_si16_S6_S3 3540 UMR_MSEC__1_1_0_S6_S3 -1000 2540
 /begin AXIS_DESCR STD_AXIS NO_INPUT_QUANTITY UMR_U_MIN_1_1_0_S6_S3 8 0 11000 DEPOSIT ABSOLUTE MONOTONY MON_INCREASE /end AXIS_DESCR
/end CHARACTERISTIC
/begin CHARACTERISTIC KL_TOSFNKFUELLRED_B "Schnellfüllzeitoffset reduzierte Befüllung" CURVE 0x2251D4 kl_si16_S6_S3 3540 UMR_MSEC__1_1_0_S6_S3 -1000 2540
 /begin AXIS_DESCR STD_AXIS NO_INPUT_QUANTITY UMR_U_MIN_1_1_0_S6_S3 8 0 11000 DEPOSIT ABSOLUTE MONOTONY MON_INCREASE /end AXIS_DESCR
/end CHARACTERISTIC
/begin CHARACTERISTIC KL_TOSFNKFUELLOPT_B "Schnellfüllzeitoffset optimierte Befüllung" CURVE 0x2251F8 kl_si16_S6_S3 3540 UMR_MSEC__1_1_0_S6_S3 -1000 2540
 /begin AXIS_DESCR STD_AXIS NO_INPUT_QUANTITY UMR_U_MIN_1_1_0_S6_S3 8 0 11000 DEPOSIT ABSOLUTE MONOTONY MON_INCREASE /end AXIS_DESCR
/end CHARACTERISTIC
/begin CHARACTERISTIC KF_TOSFGE_B "Offset auf Schnellfüllzeit beim Gangeinlegen" MAP 0x22521C kf_si16_S6_S3 2000 UMR_MSEC__1_1_0_S6_S3 -1000 1000
 /begin AXIS_DESCR STD_AXIS zff_atsys._.iSignale._.obj.sig_c_getr UMR_GRADC__1_1_M40_S6_S3 4 -40 150 DEPOSIT ABSOLUTE MONOTONY MON_INCREASE /end AXIS_DESCR
 /begin AXIS_DESCR STD_AXIS zff_atsys._.iSignale._.obj.sig_m_t UMR_NM__1_1_0_S6_S3 4 -400 1640 DEPOSIT ABSOLUTE MONOTONY MON_INCREASE /end AXIS_DESCR
/end CHARACTERISTIC
/begin CHARACTERISTIC KF_TOSFHS_B "Schnellfüllzeitoffset HS" MAP 0x225254 kf_si16_S6_S3 2000 UMR_MSEC__1_1_0_S6_S3 -1000 1000
 /begin AXIS_DESCR STD_AXIS zff_atsys._.iSignale._.obj.sig_n_t UMR_U_MIN_1_1_0_S6_S3 4 0 8160 DEPOSIT ABSOLUTE MONOTONY MON_INCREASE /end AXIS_DESCR
 /begin AXIS_DESCR STD_AXIS zff_atsys._.iSignale._.obj.sig_m_t UMR_NM__1_1_0_S6_S3 4 -400 1640 DEPOSIT ABSOLUTE MONOTONY MON_INCREASE /end AXIS_DESCR
/end CHARACTERISTIC
/begin CHARACTERISTIC KF_TOSFHS_B_EL "Schnellfüllzeitoffset HS" MAP 0x22528C kf_si16_S6_S3 2000 UMR_MSEC__1_1_0_S6_S3 -1000 1000
 /begin AXIS_DESCR STD_AXIS zff_atsys._.iSignale._.obj.sig_n_t UMR_U_MIN_1_1_0_S6_S3 4 0 8160 DEPOSIT ABSOLUTE MONOTONY MON_INCREASE /end AXIS_DESCR
 /begin AXIS_DESCR STD_AXIS zff_atsys._.iSignale._.obj.sig_m_t UMR_NM__1_1_0_S6_S3 4 -400 1640 DEPOSIT ABSOLUTE MONOTONY MON_INCREASE /end AXIS_DESCR
/end CHARACTERISTIC
/begin CHARACTERISTIC KF_TOSFHSSP_B "Schnellfüllzeitoffset spontane HS" MAP 0x2252C4 kf_si16_S6_S3 2000 UMR_MSEC__1_1_0_S6_S3 -1000 1000
 /begin AXIS_DESCR STD_AXIS zff_atsys._.iSignale._.obj.sig_n_t UMR_U_MIN_1_1_0_S6_S3 4 0 8160 DEPOSIT ABSOLUTE MONOTONY MON_INCREASE /end AXIS_DESCR
 /begin AXIS_DESCR STD_AXIS zff_atsys._.iSignale._.obj.sig_m_t UMR_NM__1_1_0_S6_S3 4 -400 1640 DEPOSIT ABSOLUTE MONOTONY MON_INCREASE /end AXIS_DESCR
/end CHARACTERISTIC
/begin CHARACTERISTIC KF_TOSFHSSPORT_B "Schnellfüllzeitoffset sportliche HS" MAP 0x2252FC kf_si16_S6_S3 2000 UMR_MSEC__1_1_0_S6_S3 -1000 1000
 /begin AXIS_DESCR STD_AXIS zff_atsys._.iSignale._.obj.sig_n_t UMR_U_MIN_1_1_0_S6_S3 4 0 8160 DEPOSIT ABSOLUTE MONOTONY MON_INCREASE /end AXIS_DESCR
 /begin AXIS_DESCR STD_AXIS zff_atsys._.iSignale._.obj.sig_m_t UMR_NM__1_1_0_S6_S3 4 -400 1640 DEPOSIT ABSOLUTE MONOTONY MON_INCREASE /end AXIS_DESCR
/end CHARACTERISTIC
/begin CHARACTERISTIC KF_TOSFHSFUELLOPT_B "Schnellfüllzeitoffset HS mit opt. Befüllung" MAP 0x225334 kf_si16_S6_S3 2000 UMR_MSEC__1_1_0_S6_S3 -1000 1000
 /begin AXIS_DESCR STD_AXIS zff_atsys._.iSignale._.obj.sig_n_t UMR_U_MIN_1_1_0_S6_S3 4 0 8160 DEPOSIT ABSOLUTE MONOTONY MON_INCREASE /end AXIS_DESCR
 /begin AXIS_DESCR STD_AXIS zff_atsys._.iSignale._.obj.sig_m_t UMR_NM__1_1_0_S6_S3 4 -400 1640 DEPOSIT ABSOLUTE MONOTONY MON_INCREASE /end AXIS_DESCR
/end CHARACTERISTIC
/begin CHARACTERISTIC KF_TOSFRS_B "Schnellfüllzeitoffset RS" MAP 0x22536C kf_si16_S6_S3 2000 UMR_MSEC__1_1_0_S6_S3 -1000 1000
 /begin AXIS_DESCR STD_AXIS zff_atsys._.iSignale._.obj.sig_n_t UMR_U_MIN_1_1_0_S6_S3 4 0 8160 DEPOSIT ABSOLUTE MONOTONY MON_INCREASE /end AXIS_DESCR
 /begin AXIS_DESCR STD_AXIS zff_atsys._.iSignale._.obj.sig_m_t UMR_NM__1_1_0_S6_S3 4 -400 1640 DEPOSIT ABSOLUTE MONOTONY MON_INCREASE /end AXIS_DESCR
/end CHARACTERISTIC
/begin CHARACTERISTIC KF_TOSFRS_B_EL "Schnellfüllzeitoffset RS" MAP 0x2253A4 kf_si16_S6_S3 2000 UMR_MSEC__1_1_0_S6_S3 -1000 1000
 /begin AXIS_DESCR STD_AXIS zff_atsys._.iSignale._.obj.sig_n_t UMR_U_MIN_1_1_0_S6_S3 4 0 8160 DEPOSIT ABSOLUTE MONOTONY MON_INCREASE /end AXIS_DESCR
 /begin AXIS_DESCR STD_AXIS zff_atsys._.iSignale._.obj.sig_m_t UMR_NM__1_1_0_S6_S3 4 -400 1640 DEPOSIT ABSOLUTE MONOTONY MON_INCREASE /end AXIS_DESCR
/end CHARACTERISTIC
/begin CHARACTERISTIC KF_TOSFRSSP_B "Schnellfüllzeitoffset spontane RS" MAP 0x2253DC kf_si16_S6_S3 2000 UMR_MSEC__1_1_0_S6_S3 -1000 1000
 /begin AXIS_DESCR STD_AXIS zff_atsys._.iSignale._.obj.sig_n_t UMR_U_MIN_1_1_0_S6_S3 4 0 8160 DEPOSIT ABSOLUTE MONOTONY MON_INCREASE /end AXIS_DESCR
 /begin AXIS_DESCR STD_AXIS zff_atsys._.iSignale._.obj.sig_m_t UMR_NM__1_1_0_S6_S3 4 -400 1640 DEPOSIT ABSOLUTE MONOTONY MON_INCREASE /end AXIS_DESCR
/end CHARACTERISTIC
/begin CHARACTERISTIC KF_TOSFRSSPORT_B "Schnellfüllzeitoffset sportliche RS" MAP 0x225414 kf_si16_S6_S3 2000 UMR_MSEC__1_1_0_S6_S3 -1000 1000
 /begin AXIS_DESCR STD_AXIS zff_atsys._.iSignale._.obj.sig_n_t UMR_U_MIN_1_1_0_S6_S3 4 0 8160 DEPOSIT ABSOLUTE MONOTONY MON_INCREASE /end AXIS_DESCR
 /begin AXIS_DESCR STD_AXIS zff_atsys._.iSignale._.obj.sig_m_t UMR_NM__1_1_0_S6_S3 4 -400 1640 DEPOSIT ABSOLUTE MONOTONY MON_INCREASE /end AXIS_DESCR
/end CHARACTERISTIC
/begin CHARACTERISTIC F_TSFADAFUELLOPT_B "Faktor für Schnellfüllzeitadaptionswert opt. Befüllung" VALUE 0x26E561 kw_ui8_S6_S3 1 UMR___1_100_0_S6_S3 0 1 /end CHARACTERISTIC
/begin CHARACTERISTIC F_TSFADAFUELLRED_B "Faktor für Schnellfüllzeitadaptionswert red. Befüllung" VALUE 0x26E562 kw_ui8_S6_S3 2 UMR___1_100_0_S6_S3 0 2 /end CHARACTERISTIC
/begin CHARACTERISTIC KL_FPFCGADAFUELLRED_B "Faktor für Fülldruckadaptionswert red. Befüllung" CURVE 0x22544C kl_ui8_S6_S3 1 UMR___1_100_0_S6_S3 0 1
 /begin AXIS_DESCR STD_AXIS zff_atsys._.iSignale._.obj.sig_c_getr UMR_GRADC__1_1_M40_S6_S3 4 -40 150 DEPOSIT ABSOLUTE MONOTONY MON_INCREASE /end AXIS_DESCR
/end CHARACTERISTIC
/begin CHARACTERISTIC KF_TO1SFCG_B "Schnellfüllzeitoffset erste Befüllung" MAP 0x225458 kf_si16_S6_S3 2550 UMR_MSEC__1_1_0_S6_S3 -1280 1270
 /begin AXIS_DESCR STD_AXIS zff_atsys._.iSignale._.obj.sig_c_getr UMR_GRADC__1_1_M40_S6_S3 10 -40 150 DEPOSIT ABSOLUTE MONOTONY MON_INCREASE /end AXIS_DESCR
 /begin AXIS_DESCR STD_AXIS iItfInput.c_getrabst UMR_GRADC__1_1_M40_S6_S3 6 -40 150 DEPOSIT ABSOLUTE MONOTONY MON_INCREASE /end AXIS_DESCR
/end CHARACTERISTIC
/begin CHARACTERISTIC T_O1SFAUSSB_B "Schnellfüllzeitoffset erste Befüllung nach Neustart aus Standby" VALUE 0x26D680 kw_si16_S6_S3 1270 UMR_MSEC__1_1_0_S6_S3 0 1270 /end CHARACTERISTIC
/begin CHARACTERISTIC KL_TTOTFUELL_B "Totzeit" CURVE 0x2254F8 kl_ui8_S6_S3 2000 UMR_MSEC__10_1_0_S6_S3 0 2000
 /begin AXIS_DESCR STD_AXIS zff_atsys._.iSignale._.obj.sig_c_getr UMR_GRADC__1_1_M40_S6_S3 5 -40 150 DEPOSIT ABSOLUTE MONOTONY MON_INCREASE /end AXIS_DESCR
/end CHARACTERISTIC
/begin CHARACTERISTIC KF_TENTLEER_B "Entleerzeit der Kupplung" MAP 0x225508 kf_ui16_S6_S3 20000 UMR_MSEC__10_1_0_S6_S3 0 20000
 /begin AXIS_DESCR STD_AXIS zff_atsys._.iSignale._.obj.sig_c_getr UMR_GRADC__1_1_M40_S6_S3 10 -40 150 DEPOSIT ABSOLUTE MONOTONY MON_INCREASE /end AXIS_DESCR
 /begin AXIS_DESCR STD_AXIS NO_INPUT_QUANTITY UMR_U_MIN_1_1_0_S6_S3 8 0 11000 DEPOSIT ABSOLUTE MONOTONY MON_INCREASE /end AXIS_DESCR
/end CHARACTERISTIC
/begin CHARACTERISTIC KF_TOENTLEERCGADA_B "Entleerzeit der Kupplung" MAP 0x2255D4 kf_si16_S6_S3 21000 UMR_MSEC__10_1_0_S6_S3 -1000 20000
 /begin AXIS_DESCR STD_AXIS zff_atsys._.iSignale._.obj.sig_c_getr UMR_GRADC__1_1_M40_S6_S3 8 -40 150 DEPOSIT ABSOLUTE MONOTONY MON_INCREASE /end AXIS_DESCR
 /begin AXIS_DESCR STD_AXIS NO_INPUT_QUANTITY UMR_MSEC__1_1_0_S6_S3 6 -32768 32767 DEPOSIT ABSOLUTE MONOTONY MON_INCREASE /end AXIS_DESCR
/end CHARACTERISTIC
/begin CHARACTERISTIC TOENTLEERSR_B "Offset auf Entleerzeit bei aktiver Stromrampe" VALUE 0x26D682 kw_si16_S6_S3 2000 UMR_MSEC__1_1_0_S6_S3 0 2000 /end CHARACTERISTIC
/begin CHARACTERISTIC PO_KOLBENPOSKOR_B "Druckoffset für Start timer_kolbenpos_kor" VALUE 0x26D684 kw_ui16_S6_S3 2 UMR_BAR__1_1000_0_S6_S3 0 2 /end CHARACTERISTIC
/begin CHARACTERISTIC KL_FKOLBENPOSCGKOR_B "Faktor auf Basiskolbenposition" CURVE 0x225658 kl_ui8_S6_S3 1 UMR___1_100_0_S6_S3 1 2
 /begin AXIS_DESCR STD_AXIS zff_atsys._.iSignale._.obj.sig_c_getr UMR_GRADC__1_1_M40_S6_S3 4 -40 150 DEPOSIT ABSOLUTE MONOTONY MON_INCREASE /end AXIS_DESCR
/end CHARACTERISTIC
/begin CHARACTERISTIC KF_FKOLBENPOSKOR_B "Faktor auf Basiskolbenposition" MAP 0x225664 kf_si16_S6_S3 1 UMR___1_100_0_S6_S3 0 1
 /begin AXIS_DESCR STD_AXIS NO_INPUT_QUANTITY UMR_MSEC__10_1_0_S6_S3 6 0 2550 DEPOSIT ABSOLUTE MONOTONY MON_INCREASE /end AXIS_DESCR
 /begin AXIS_DESCR STD_AXIS NO_INPUT_QUANTITY UMR_MSEC__1_1_0_S6_S3 4 -32768 32767 DEPOSIT ABSOLUTE MONOTONY MON_INCREASE /end AXIS_DESCR
/end CHARACTERISTIC
/begin CHARACTERISTIC PO_KOLBENPOSKORGA_B "Druckoffset bei GA für Start timer_kolbenpos_kor" VALUE 0x26D686 kw_ui16_S6_S3 2 UMR_BAR__1_1000_0_S6_S3 0 2 /end CHARACTERISTIC
/begin CHARACTERISTIC KF_FKOLBENPOSKORGA_B "Faktor auf Basiskolbenposition bei GA" MAP 0x2256B0 kf_si16_S6_S3 1 UMR___1_100_0_S6_S3 0 1
 /begin AXIS_DESCR STD_AXIS NO_INPUT_QUANTITY UMR_MSEC__10_1_0_S6_S3 6 0 2550 DEPOSIT ABSOLUTE MONOTONY MON_INCREASE /end AXIS_DESCR
 /begin AXIS_DESCR STD_AXIS NO_INPUT_QUANTITY UMR_MSEC__1_1_0_S6_S3 4 -32768 32767 DEPOSIT ABSOLUTE MONOTONY MON_INCREASE /end AXIS_DESCR
/end CHARACTERISTIC
/begin CHARACTERISTIC KL_PFHYSCG_B "Fülldruckhysterese" CURVE 0x2256FC kl_si16_S6_S3 12.7 UMR_BAR__1_1000_0_S6_S3 0 12.7
 /begin AXIS_DESCR STD_AXIS zff_atsys._.iSignale._.obj.sig_c_getr UMR_GRADC__1_1_M40_S6_S3 10 -40 150 DEPOSIT ABSOLUTE MONOTONY MON_INCREASE /end AXIS_DESCR
/end CHARACTERISTIC
/begin CHARACTERISTIC KL_TVCGSAENDHS_B "Verzoegerungszeit für Umstellung auf Schaltungsende bei HS" CURVE 0x225728 kl_ui8_S6_S3 2000 UMR_MSEC__10_1_0_S6_S3 0 2000
 /begin AXIS_DESCR STD_AXIS zff_atsys._.iSignale._.obj.sig_c_getr UMR_GRADC__1_1_M40_S6_S3 3 -40 150 DEPOSIT ABSOLUTE MONOTONY MON_INCREASE /end AXIS_DESCR
/end CHARACTERISTIC
/begin CHARACTERISTIC KL_TVCGSAENDRS_B "Verzoegerungszeit für Umstellung auf Schaltungsende bei RS" CURVE 0x225734 kl_ui8_S6_S3 2000 UMR_MSEC__10_1_0_S6_S3 0 2000
 /begin AXIS_DESCR STD_AXIS zff_atsys._.iSignale._.obj.sig_c_getr UMR_GRADC__1_1_M40_S6_S3 3 -40 150 DEPOSIT ABSOLUTE MONOTONY MON_INCREASE /end AXIS_DESCR
/end CHARACTERISTIC
/begin CHARACTERISTIC KL_TVCGSAENDGE_B "Verzoegerungszeit für Umstellung auf Schaltungsende bei GE" CURVE 0x225740 kl_ui8_S6_S3 2000 UMR_MSEC__10_1_0_S6_S3 0 2000
 /begin AXIS_DESCR STD_AXIS zff_atsys._.iSignale._.obj.sig_c_getr UMR_GRADC__1_1_M40_S6_S3 3 -40 150 DEPOSIT ABSOLUTE MONOTONY MON_INCREASE /end AXIS_DESCR
/end CHARACTERISTIC
/begin CHARACTERISTIC TO_ABBRUCHSAEND_B "Offset auf Verzoegerungszeit zur Umstellung auf Schaltungsende" VALUE 0x26E563 kw_si8_S6_S3 2000 UMR_MSEC__10_1_0_S6_S3 -1000 1000 /end CHARACTERISTIC
/begin CHARACTERISTIC KL_PFCGGA_B "Fülldruck bei Gangauslegen" CURVE 0x22574C kl_si16_S6_S3 12.75 UMR_BAR__1_1000_0_S6_S3 0 12.75
 /begin AXIS_DESCR STD_AXIS zff_atsys._.iSignale._.obj.sig_c_getr UMR_GRADC__1_1_M40_S6_S3 10 -40 150 DEPOSIT ABSOLUTE MONOTONY MON_INCREASE /end AXIS_DESCR
/end CHARACTERISTIC
/begin CHARACTERISTIC KL_PKUPPSTROM_B "Druckwert für Stromschleife" CURVE 0x225778 kl_ui16_S6_S3 5 UMR_BAR__1_1000_0_S6_S3 0 5
 /begin AXIS_DESCR STD_AXIS zff_atsys._.iSignale._.obj.sig_c_getr UMR_GRADC__1_1_M40_S6_S3 4 -40 150 DEPOSIT ABSOLUTE MONOTONY MON_INCREASE /end AXIS_DESCR
/end CHARACTERISTIC
/begin CHARACTERISTIC KL_PFCG_B "Fülldruck" CURVE 0x22578C kl_si16_S6_S3 12.75 UMR_BAR__1_1000_0_S6_S3 0 12.75
 /begin AXIS_DESCR STD_AXIS zff_atsys._.iSignale._.obj.sig_c_getr UMR_GRADC__1_1_M40_S6_S3 10 -40 150 DEPOSIT ABSOLUTE MONOTONY MON_INCREASE /end AXIS_DESCR
/end CHARACTERISTIC
/begin CHARACTERISTIC IGKABENTLEER_B "Gradient Stromrampe Kupplung entleeren" VALUE 0x26D688 kw_si16_S6_S3 200 UMR_A_SEC_1_10_0_S6_S3 -100 100 /end CHARACTERISTIC
/begin CHARACTERISTIC KL_TFPWIRK_C "Filterzeit für Kupplungswirkdruck in ms" CURVE 0x2257B8 kl_ui8_S6_S3 254 UMR_MSEC__1_1_0_S6_S3 0 254
 /begin AXIS_DESCR STD_AXIS zff_atsys._.iSignale._.obj.sig_c_getr UMR_GRADC__1_1_M40_S6_S3 3 -40 150 DEPOSIT ABSOLUTE MONOTONY MON_INCREASE /end AXIS_DESCR
/end CHARACTERISTIC
/begin CHARACTERISTIC KF_PSFCGMT_C "Kennfeld Schnellfülldruck" MAP 0x2257C4 kf_si16_S6_S3 12.75 UMR_BAR__1_1000_0_S6_S3 0 12.75
 /begin AXIS_DESCR STD_AXIS zff_atsys._.iSignale._.obj.sig_c_getr UMR_GRADC__1_1_M40_S6_S3 8 -40 150 DEPOSIT ABSOLUTE MONOTONY MON_INCREASE /end AXIS_DESCR
 /begin AXIS_DESCR STD_AXIS zff_atsys._.iSignale._.obj.sig_m_t8 UMR_NM__8_1_M50_S6_S3 4 -400 1640 DEPOSIT ABSOLUTE MONOTONY MON_INCREASE /end AXIS_DESCR
/end CHARACTERISTIC
/begin CHARACTERISTIC KF_PSFCGMTFUELLRED_C "Kennfeld Schnellfülldruck" MAP 0x225824 kf_si16_S6_S3 12.75 UMR_BAR__1_1000_0_S6_S3 0 12.75
 /begin AXIS_DESCR STD_AXIS zff_atsys._.iSignale._.obj.sig_c_getr UMR_GRADC__1_1_M40_S6_S3 8 -40 150 DEPOSIT ABSOLUTE MONOTONY MON_INCREASE /end AXIS_DESCR
 /begin AXIS_DESCR STD_AXIS zff_atsys._.iSignale._.obj.sig_m_t8 UMR_NM__8_1_M50_S6_S3 4 -400 1640 DEPOSIT ABSOLUTE MONOTONY MON_INCREASE /end AXIS_DESCR
/end CHARACTERISTIC
/begin CHARACTERISTIC KF_PSFCGMTFUELLOPT_C "Kennfeld Schnellfülldruck" MAP 0x225884 kf_si16_S6_S3 12.75 UMR_BAR__1_1000_0_S6_S3 0 12.75
 /begin AXIS_DESCR STD_AXIS zff_atsys._.iSignale._.obj.sig_c_getr UMR_GRADC__1_1_M40_S6_S3 8 -40 150 DEPOSIT ABSOLUTE MONOTONY MON_INCREASE /end AXIS_DESCR
 /begin AXIS_DESCR STD_AXIS zff_atsys._.iSignale._.obj.sig_m_t8 UMR_NM__8_1_M50_S6_S3 4 -400 1640 DEPOSIT ABSOLUTE MONOTONY MON_INCREASE /end AXIS_DESCR
/end CHARACTERISTIC
/begin CHARACTERISTIC KF_POSFCGNAB_C "Kennfeld Schnellfülldruckoffset" MAP 0x2258E4 kf_si16_S6_S3 5 UMR_BAR__1_1000_0_S6_S3 -5 0
 /begin AXIS_DESCR STD_AXIS zff_atsys._.iSignale._.obj.sig_c_getr UMR_GRADC__1_1_M40_S6_S3 2 -40 150 DEPOSIT ABSOLUTE MONOTONY MON_INCREASE /end AXIS_DESCR
 /begin AXIS_DESCR STD_AXIS zff_atsys._.iSignale._.obj.sig_n_ab8 UMR_U_MIN_32_1_0_S6_S3 2 0 8160 DEPOSIT ABSOLUTE MONOTONY MON_INCREASE /end AXIS_DESCR
/end CHARACTERISTIC
/begin CHARACTERISTIC KL_TSFCG_C "Schnellfüllzeit" CURVE 0x2258FC kl_ui16_S6_S3 2540 UMR_MSEC__1_1_0_S6_S3 0 2540
 /begin AXIS_DESCR STD_AXIS zff_atsys._.iSignale._.obj.sig_c_getr UMR_GRADC__1_1_M40_S6_S3 10 -40 150 DEPOSIT ABSOLUTE MONOTONY MON_INCREASE /end AXIS_DESCR
/end CHARACTERISTIC
/begin CHARACTERISTIC KL_TSFCGFUELLRED_C "Schnellfüllzeit reduzierte Befüllung" CURVE 0x225928 kl_ui16_S6_S3 2540 UMR_MSEC__1_1_0_S6_S3 0 2540
 /begin AXIS_DESCR STD_AXIS zff_atsys._.iSignale._.obj.sig_c_getr UMR_GRADC__1_1_M40_S6_S3 10 -40 150 DEPOSIT ABSOLUTE MONOTONY MON_INCREASE /end AXIS_DESCR
/end CHARACTERISTIC
/begin CHARACTERISTIC KL_TSFCGFUELLOPT_C "Schnellfüllzeit optimierte Befüllung" CURVE 0x225954 kl_ui16_S6_S3 2540 UMR_MSEC__1_1_0_S6_S3 0 2540
 /begin AXIS_DESCR STD_AXIS zff_atsys._.iSignale._.obj.sig_c_getr UMR_GRADC__1_1_M40_S6_S3 10 -40 150 DEPOSIT ABSOLUTE MONOTONY MON_INCREASE /end AXIS_DESCR
/end CHARACTERISTIC
/begin CHARACTERISTIC KL_TOSFNK_C "Schnellfüllzeitoffset" CURVE 0x225980 kl_si16_S6_S3 3540 UMR_MSEC__1_1_0_S6_S3 -1000 2540
 /begin AXIS_DESCR STD_AXIS NO_INPUT_QUANTITY UMR_U_MIN_1_1_0_S6_S3 8 0 11000 DEPOSIT ABSOLUTE MONOTONY MON_INCREASE /end AXIS_DESCR
/end CHARACTERISTIC
/begin CHARACTERISTIC KL_TOSFNKFUELLRED_C "Schnellfüllzeitoffset reduzierte Befüllung" CURVE 0x2259A4 kl_si16_S6_S3 3540 UMR_MSEC__1_1_0_S6_S3 -1000 2540
 /begin AXIS_DESCR STD_AXIS NO_INPUT_QUANTITY UMR_U_MIN_1_1_0_S6_S3 8 0 11000 DEPOSIT ABSOLUTE MONOTONY MON_INCREASE /end AXIS_DESCR
/end CHARACTERISTIC
/begin CHARACTERISTIC KL_TOSFNKFUELLOPT_C "Schnellfüllzeitoffset optimierte Befüllung" CURVE 0x2259C8 kl_si16_S6_S3 3540 UMR_MSEC__1_1_0_S6_S3 -1000 2540
 /begin AXIS_DESCR STD_AXIS NO_INPUT_QUANTITY UMR_U_MIN_1_1_0_S6_S3 8 0 11000 DEPOSIT ABSOLUTE MONOTONY MON_INCREASE /end AXIS_DESCR
/end CHARACTERISTIC
/begin CHARACTERISTIC KF_TOSFGE_C "Offset auf Schnellfüllzeit beim Gangeinlegen" MAP 0x2259EC kf_si16_S6_S3 2000 UMR_MSEC__1_1_0_S6_S3 -1000 1000
 /begin AXIS_DESCR STD_AXIS zff_atsys._.iSignale._.obj.sig_c_getr UMR_GRADC__1_1_M40_S6_S3 4 -40 150 DEPOSIT ABSOLUTE MONOTONY MON_INCREASE /end AXIS_DESCR
 /begin AXIS_DESCR STD_AXIS zff_atsys._.iSignale._.obj.sig_m_t UMR_NM__1_1_0_S6_S3 4 -400 1640 DEPOSIT ABSOLUTE MONOTONY MON_INCREASE /end AXIS_DESCR
/end CHARACTERISTIC
/begin CHARACTERISTIC KF_TOSFHS_C "Schnellfüllzeitoffset HS" MAP 0x225A24 kf_si16_S6_S3 2000 UMR_MSEC__1_1_0_S6_S3 -1000 1000
 /begin AXIS_DESCR STD_AXIS zff_atsys._.iSignale._.obj.sig_n_t UMR_U_MIN_1_1_0_S6_S3 4 0 8160 DEPOSIT ABSOLUTE MONOTONY MON_INCREASE /end AXIS_DESCR
 /begin AXIS_DESCR STD_AXIS zff_atsys._.iSignale._.obj.sig_m_t UMR_NM__1_1_0_S6_S3 4 -400 1640 DEPOSIT ABSOLUTE MONOTONY MON_INCREASE /end AXIS_DESCR
/end CHARACTERISTIC
/begin CHARACTERISTIC KF_TOSFHS_C_EL "Schnellfüllzeitoffset HS" MAP 0x225A5C kf_si16_S6_S3 2000 UMR_MSEC__1_1_0_S6_S3 -1000 1000
 /begin AXIS_DESCR STD_AXIS zff_atsys._.iSignale._.obj.sig_n_t UMR_U_MIN_1_1_0_S6_S3 4 0 8160 DEPOSIT ABSOLUTE MONOTONY MON_INCREASE /end AXIS_DESCR
 /begin AXIS_DESCR STD_AXIS zff_atsys._.iSignale._.obj.sig_m_t UMR_NM__1_1_0_S6_S3 4 -400 1640 DEPOSIT ABSOLUTE MONOTONY MON_INCREASE /end AXIS_DESCR
/end CHARACTERISTIC
/begin CHARACTERISTIC KF_TOSFHSSP_C "Schnellfüllzeitoffset spontane HS" MAP 0x225A94 kf_si16_S6_S3 2000 UMR_MSEC__1_1_0_S6_S3 -1000 1000
 /begin AXIS_DESCR STD_AXIS zff_atsys._.iSignale._.obj.sig_n_t UMR_U_MIN_1_1_0_S6_S3 4 0 8160 DEPOSIT ABSOLUTE MONOTONY MON_INCREASE /end AXIS_DESCR
 /begin AXIS_DESCR STD_AXIS zff_atsys._.iSignale._.obj.sig_m_t UMR_NM__1_1_0_S6_S3 4 -400 1640 DEPOSIT ABSOLUTE MONOTONY MON_INCREASE /end AXIS_DESCR
/end CHARACTERISTIC
/begin CHARACTERISTIC KF_TOSFHSSPORT_C "Schnellfüllzeitoffset sportliche HS" MAP 0x225ACC kf_si16_S6_S3 2000 UMR_MSEC__1_1_0_S6_S3 -1000 1000
 /begin AXIS_DESCR STD_AXIS zff_atsys._.iSignale._.obj.sig_n_t UMR_U_MIN_1_1_0_S6_S3 4 0 8160 DEPOSIT ABSOLUTE MONOTONY MON_INCREASE /end AXIS_DESCR
 /begin AXIS_DESCR STD_AXIS zff_atsys._.iSignale._.obj.sig_m_t UMR_NM__1_1_0_S6_S3 4 -400 1640 DEPOSIT ABSOLUTE MONOTONY MON_INCREASE /end AXIS_DESCR
/end CHARACTERISTIC
/begin CHARACTERISTIC KF_TOSFHSFUELLOPT_C "Schnellfüllzeitoffset HS mit opt. Befüllung" MAP 0x225B04 kf_si16_S6_S3 2000 UMR_MSEC__1_1_0_S6_S3 -1000 1000
 /begin AXIS_DESCR STD_AXIS zff_atsys._.iSignale._.obj.sig_n_t UMR_U_MIN_1_1_0_S6_S3 4 0 8160 DEPOSIT ABSOLUTE MONOTONY MON_INCREASE /end AXIS_DESCR
 /begin AXIS_DESCR STD_AXIS zff_atsys._.iSignale._.obj.sig_m_t UMR_NM__1_1_0_S6_S3 4 -400 1640 DEPOSIT ABSOLUTE MONOTONY MON_INCREASE /end AXIS_DESCR
/end CHARACTERISTIC
/begin CHARACTERISTIC KF_TOSFRS_C "Schnellfüllzeitoffset RS" MAP 0x225B3C kf_si16_S6_S3 2000 UMR_MSEC__1_1_0_S6_S3 -1000 1000
 /begin AXIS_DESCR STD_AXIS zff_atsys._.iSignale._.obj.sig_n_t UMR_U_MIN_1_1_0_S6_S3 4 0 8160 DEPOSIT ABSOLUTE MONOTONY MON_INCREASE /end AXIS_DESCR
 /begin AXIS_DESCR STD_AXIS zff_atsys._.iSignale._.obj.sig_m_t UMR_NM__1_1_0_S6_S3 4 -400 1640 DEPOSIT ABSOLUTE MONOTONY MON_INCREASE /end AXIS_DESCR
/end CHARACTERISTIC
/begin CHARACTERISTIC KF_TOSFRS_C_EL "Schnellfüllzeitoffset RS" MAP 0x225B74 kf_si16_S6_S3 2000 UMR_MSEC__1_1_0_S6_S3 -1000 1000
 /begin AXIS_DESCR STD_AXIS zff_atsys._.iSignale._.obj.sig_n_t UMR_U_MIN_1_1_0_S6_S3 4 0 8160 DEPOSIT ABSOLUTE MONOTONY MON_INCREASE /end AXIS_DESCR
 /begin AXIS_DESCR STD_AXIS zff_atsys._.iSignale._.obj.sig_m_t UMR_NM__1_1_0_S6_S3 4 -400 1640 DEPOSIT ABSOLUTE MONOTONY MON_INCREASE /end AXIS_DESCR
/end CHARACTERISTIC
/begin CHARACTERISTIC KF_TOSFRSSP_C "Schnellfüllzeitoffset spontane RS" MAP 0x225BAC kf_si16_S6_S3 2000 UMR_MSEC__1_1_0_S6_S3 -1000 1000
 /begin AXIS_DESCR STD_AXIS zff_atsys._.iSignale._.obj.sig_n_t UMR_U_MIN_1_1_0_S6_S3 4 0 8160 DEPOSIT ABSOLUTE MONOTONY MON_INCREASE /end AXIS_DESCR
 /begin AXIS_DESCR STD_AXIS zff_atsys._.iSignale._.obj.sig_m_t UMR_NM__1_1_0_S6_S3 4 -400 1640 DEPOSIT ABSOLUTE MONOTONY MON_INCREASE /end AXIS_DESCR
/end CHARACTERISTIC
/begin CHARACTERISTIC KF_TOSFRSSPORT_C "Schnellfüllzeitoffset sportliche RS" MAP 0x225BE4 kf_si16_S6_S3 2000 UMR_MSEC__1_1_0_S6_S3 -1000 1000
 /begin AXIS_DESCR STD_AXIS zff_atsys._.iSignale._.obj.sig_n_t UMR_U_MIN_1_1_0_S6_S3 4 0 8160 DEPOSIT ABSOLUTE MONOTONY MON_INCREASE /end AXIS_DESCR
 /begin AXIS_DESCR STD_AXIS zff_atsys._.iSignale._.obj.sig_m_t UMR_NM__1_1_0_S6_S3 4 -400 1640 DEPOSIT ABSOLUTE MONOTONY MON_INCREASE /end AXIS_DESCR
/end CHARACTERISTIC
/begin CHARACTERISTIC F_TSFADAFUELLOPT_C "Faktor für Schnellfüllzeitadaptionswert opt. Befüllung" VALUE 0x26E564 kw_ui8_S6_S3 1 UMR___1_100_0_S6_S3 0 1 /end CHARACTERISTIC
/begin CHARACTERISTIC F_TSFADAFUELLRED_C "Faktor für Schnellfüllzeitadaptionswert red. Befüllung" VALUE 0x26E565 kw_ui8_S6_S3 2 UMR___1_100_0_S6_S3 0 2 /end CHARACTERISTIC
/begin CHARACTERISTIC KL_FPFCGADAFUELLRED_C "Faktor für Fülldruckadaptionswert red. Befüllung" CURVE 0x225C1C kl_ui8_S6_S3 1 UMR___1_100_0_S6_S3 0 1
 /begin AXIS_DESCR STD_AXIS zff_atsys._.iSignale._.obj.sig_c_getr UMR_GRADC__1_1_M40_S6_S3 4 -40 150 DEPOSIT ABSOLUTE MONOTONY MON_INCREASE /end AXIS_DESCR
/end CHARACTERISTIC
/begin CHARACTERISTIC KF_TO1SFCG_C "Schnellfüllzeitoffset erste Befüllung" MAP 0x225C28 kf_si16_S6_S3 2550 UMR_MSEC__1_1_0_S6_S3 -1280 1270
 /begin AXIS_DESCR STD_AXIS zff_atsys._.iSignale._.obj.sig_c_getr UMR_GRADC__1_1_M40_S6_S3 10 -40 150 DEPOSIT ABSOLUTE MONOTONY MON_INCREASE /end AXIS_DESCR
 /begin AXIS_DESCR STD_AXIS iItfInput.c_getrabst UMR_GRADC__1_1_M40_S6_S3 6 -40 150 DEPOSIT ABSOLUTE MONOTONY MON_INCREASE /end AXIS_DESCR
/end CHARACTERISTIC
/begin CHARACTERISTIC T_O1SFAUSSB_C "Schnellfüllzeitoffset erste Befüllung nach Neustart aus Standby" VALUE 0x26D68A kw_si16_S6_S3 1270 UMR_MSEC__1_1_0_S6_S3 0 1270 /end CHARACTERISTIC
/begin CHARACTERISTIC KL_TTOTFUELL_C "Totzeit" CURVE 0x225CC8 kl_ui8_S6_S3 2000 UMR_MSEC__10_1_0_S6_S3 0 2000
 /begin AXIS_DESCR STD_AXIS zff_atsys._.iSignale._.obj.sig_c_getr UMR_GRADC__1_1_M40_S6_S3 5 -40 150 DEPOSIT ABSOLUTE MONOTONY MON_INCREASE /end AXIS_DESCR
/end CHARACTERISTIC
/begin CHARACTERISTIC KF_TENTLEER_C "Entleerzeit der Kupplung" MAP 0x225CD8 kf_ui16_S6_S3 20000 UMR_MSEC__10_1_0_S6_S3 0 20000
 /begin AXIS_DESCR STD_AXIS zff_atsys._.iSignale._.obj.sig_c_getr UMR_GRADC__1_1_M40_S6_S3 10 -40 150 DEPOSIT ABSOLUTE MONOTONY MON_INCREASE /end AXIS_DESCR
 /begin AXIS_DESCR STD_AXIS NO_INPUT_QUANTITY UMR_U_MIN_1_1_0_S6_S3 8 0 11000 DEPOSIT ABSOLUTE MONOTONY MON_INCREASE /end AXIS_DESCR
/end CHARACTERISTIC
/begin CHARACTERISTIC KF_TOENTLEERCGADA_C "Entleerzeit der Kupplung" MAP 0x225DA4 kf_si16_S6_S3 21000 UMR_MSEC__10_1_0_S6_S3 -1000 20000
 /begin AXIS_DESCR STD_AXIS zff_atsys._.iSignale._.obj.sig_c_getr UMR_GRADC__1_1_M40_S6_S3 8 -40 150 DEPOSIT ABSOLUTE MONOTONY MON_INCREASE /end AXIS_DESCR
 /begin AXIS_DESCR STD_AXIS NO_INPUT_QUANTITY UMR_MSEC__1_1_0_S6_S3 6 -32768 32767 DEPOSIT ABSOLUTE MONOTONY MON_INCREASE /end AXIS_DESCR
/end CHARACTERISTIC
/begin CHARACTERISTIC TOENTLEERSR_C "Offset auf Entleerzeit bei aktiver Stromrampe" VALUE 0x26D68C kw_si16_S6_S3 2000 UMR_MSEC__1_1_0_S6_S3 0 2000 /end CHARACTERISTIC
/begin CHARACTERISTIC PO_KOLBENPOSKOR_C "Druckoffset für Start timer_kolbenpos_kor" VALUE 0x26D68E kw_ui16_S6_S3 2 UMR_BAR__1_1000_0_S6_S3 0 2 /end CHARACTERISTIC
/begin CHARACTERISTIC KL_FKOLBENPOSCGKOR_C "Faktor auf Basiskolbenposition" CURVE 0x225E28 kl_ui8_S6_S3 1 UMR___1_100_0_S6_S3 1 2
 /begin AXIS_DESCR STD_AXIS zff_atsys._.iSignale._.obj.sig_c_getr UMR_GRADC__1_1_M40_S6_S3 4 -40 150 DEPOSIT ABSOLUTE MONOTONY MON_INCREASE /end AXIS_DESCR
/end CHARACTERISTIC
/begin CHARACTERISTIC KF_FKOLBENPOSKOR_C "Faktor auf Basiskolbenposition" MAP 0x225E34 kf_si16_S6_S3 1 UMR___1_100_0_S6_S3 0 1
 /begin AXIS_DESCR STD_AXIS NO_INPUT_QUANTITY UMR_MSEC__10_1_0_S6_S3 6 0 2550 DEPOSIT ABSOLUTE MONOTONY MON_INCREASE /end AXIS_DESCR
 /begin AXIS_DESCR STD_AXIS NO_INPUT_QUANTITY UMR_MSEC__1_1_0_S6_S3 4 -32768 32767 DEPOSIT ABSOLUTE MONOTONY MON_INCREASE /end AXIS_DESCR
/end CHARACTERISTIC
/begin CHARACTERISTIC PO_KOLBENPOSKORGA_C "Druckoffset bei GA für Start timer_kolbenpos_kor" VALUE 0x26D690 kw_ui16_S6_S3 2 UMR_BAR__1_1000_0_S6_S3 0 2 /end CHARACTERISTIC
/begin CHARACTERISTIC KF_FKOLBENPOSKORGA_C "Faktor auf Basiskolbenposition bei GA" MAP 0x225E80 kf_si16_S6_S3 1 UMR___1_100_0_S6_S3 0 1
 /begin AXIS_DESCR STD_AXIS NO_INPUT_QUANTITY UMR_MSEC__10_1_0_S6_S3 6 0 2550 DEPOSIT ABSOLUTE MONOTONY MON_INCREASE /end AXIS_DESCR
 /begin AXIS_DESCR STD_AXIS NO_INPUT_QUANTITY UMR_MSEC__1_1_0_S6_S3 4 -32768 32767 DEPOSIT ABSOLUTE MONOTONY MON_INCREASE /end AXIS_DESCR
/end CHARACTERISTIC
/begin CHARACTERISTIC KL_PFHYSCG_C "Fülldruckhysterese" CURVE 0x225ECC kl_si16_S6_S3 12.7 UMR_BAR__1_1000_0_S6_S3 0 12.7
 /begin AXIS_DESCR STD_AXIS zff_atsys._.iSignale._.obj.sig_c_getr UMR_GRADC__1_1_M40_S6_S3 10 -40 150 DEPOSIT ABSOLUTE MONOTONY MON_INCREASE /end AXIS_DESCR
/end CHARACTERISTIC
/begin CHARACTERISTIC KL_TVCGSAENDHS_C "Verzoegerungszeit für Umstellung auf Schaltungsende bei HS" CURVE 0x225EF8 kl_ui8_S6_S3 2000 UMR_MSEC__10_1_0_S6_S3 0 2000
 /begin AXIS_DESCR STD_AXIS zff_atsys._.iSignale._.obj.sig_c_getr UMR_GRADC__1_1_M40_S6_S3 3 -40 150 DEPOSIT ABSOLUTE MONOTONY MON_INCREASE /end AXIS_DESCR
/end CHARACTERISTIC
/begin CHARACTERISTIC KL_TVCGSAENDRS_C "Verzoegerungszeit für Umstellung auf Schaltungsende bei RS" CURVE 0x225F04 kl_ui8_S6_S3 2000 UMR_MSEC__10_1_0_S6_S3 0 2000
 /begin AXIS_DESCR STD_AXIS zff_atsys._.iSignale._.obj.sig_c_getr UMR_GRADC__1_1_M40_S6_S3 3 -40 150 DEPOSIT ABSOLUTE MONOTONY MON_INCREASE /end AXIS_DESCR
/end CHARACTERISTIC
/begin CHARACTERISTIC KL_TVCGSAENDGE_C "Verzoegerungszeit für Umstellung auf Schaltungsende bei GE" CURVE 0x225F10 kl_ui8_S6_S3 2000 UMR_MSEC__10_1_0_S6_S3 0 2000
 /begin AXIS_DESCR STD_AXIS zff_atsys._.iSignale._.obj.sig_c_getr UMR_GRADC__1_1_M40_S6_S3 3 -40 150 DEPOSIT ABSOLUTE MONOTONY MON_INCREASE /end AXIS_DESCR
/end CHARACTERISTIC
/begin CHARACTERISTIC TO_ABBRUCHSAEND_C "Offset auf Verzoegerungszeit zur Umstellung auf Schaltungsende" VALUE 0x26E566 kw_si8_S6_S3 2000 UMR_MSEC__10_1_0_S6_S3 -1000 1000 /end CHARACTERISTIC
/begin CHARACTERISTIC KL_PFCGGA_C "Fülldruck bei Gangauslegen" CURVE 0x225F1C kl_si16_S6_S3 12.75 UMR_BAR__1_1000_0_S6_S3 0 12.75
 /begin AXIS_DESCR STD_AXIS zff_atsys._.iSignale._.obj.sig_c_getr UMR_GRADC__1_1_M40_S6_S3 10 -40 150 DEPOSIT ABSOLUTE MONOTONY MON_INCREASE /end AXIS_DESCR
/end CHARACTERISTIC
/begin CHARACTERISTIC KL_PKUPPSTROM_C "Druckwert für Stromschleife" CURVE 0x225F48 kl_ui16_S6_S3 5 UMR_BAR__1_1000_0_S6_S3 0 5
 /begin AXIS_DESCR STD_AXIS zff_atsys._.iSignale._.obj.sig_c_getr UMR_GRADC__1_1_M40_S6_S3 4 -40 150 DEPOSIT ABSOLUTE MONOTONY MON_INCREASE /end AXIS_DESCR
/end CHARACTERISTIC
/begin CHARACTERISTIC KL_PFCG_C "Fülldruck" CURVE 0x225F5C kl_si16_S6_S3 12.75 UMR_BAR__1_1000_0_S6_S3 0 12.75
 /begin AXIS_DESCR STD_AXIS zff_atsys._.iSignale._.obj.sig_c_getr UMR_GRADC__1_1_M40_S6_S3 10 -40 150 DEPOSIT ABSOLUTE MONOTONY MON_INCREASE /end AXIS_DESCR
/end CHARACTERISTIC
/begin CHARACTERISTIC IGKABENTLEER_C "Gradient Stromrampe Kupplung entleeren" VALUE 0x26D692 kw_si16_S6_S3 200 UMR_A_SEC_1_10_0_S6_S3 -100 100 /end CHARACTERISTIC
/begin CHARACTERISTIC KL_TFPWIRK_D "Filterzeit für Kupplungswirkdruck in ms" CURVE 0x225F88 kl_ui8_S6_S3 254 UMR_MSEC__1_1_0_S6_S3 0 254
 /begin AXIS_DESCR STD_AXIS zff_atsys._.iSignale._.obj.sig_c_getr UMR_GRADC__1_1_M40_S6_S3 3 -40 150 DEPOSIT ABSOLUTE MONOTONY MON_INCREASE /end AXIS_DESCR
/end CHARACTERISTIC
/begin CHARACTERISTIC KF_PSFCGMT_D "Kennfeld Schnellfülldruck" MAP 0x225F94 kf_si16_S6_S3 12.75 UMR_BAR__1_1000_0_S6_S3 0 12.75
 /begin AXIS_DESCR STD_AXIS zff_atsys._.iSignale._.obj.sig_c_getr UMR_GRADC__1_1_M40_S6_S3 8 -40 150 DEPOSIT ABSOLUTE MONOTONY MON_INCREASE /end AXIS_DESCR
 /begin AXIS_DESCR STD_AXIS zff_atsys._.iSignale._.obj.sig_m_t8 UMR_NM__8_1_M50_S6_S3 4 -400 1640 DEPOSIT ABSOLUTE MONOTONY MON_INCREASE /end AXIS_DESCR
/end CHARACTERISTIC
/begin CHARACTERISTIC KF_PSFCGMTFUELLRED_D "Kennfeld Schnellfülldruck" MAP 0x225FF4 kf_si16_S6_S3 12.75 UMR_BAR__1_1000_0_S6_S3 0 12.75
 /begin AXIS_DESCR STD_AXIS zff_atsys._.iSignale._.obj.sig_c_getr UMR_GRADC__1_1_M40_S6_S3 8 -40 150 DEPOSIT ABSOLUTE MONOTONY MON_INCREASE /end AXIS_DESCR
 /begin AXIS_DESCR STD_AXIS zff_atsys._.iSignale._.obj.sig_m_t8 UMR_NM__8_1_M50_S6_S3 4 -400 1640 DEPOSIT ABSOLUTE MONOTONY MON_INCREASE /end AXIS_DESCR
/end CHARACTERISTIC
/begin CHARACTERISTIC KF_PSFCGMTFUELLOPT_D "Kennfeld Schnellfülldruck" MAP 0x226054 kf_si16_S6_S3 12.75 UMR_BAR__1_1000_0_S6_S3 0 12.75
 /begin AXIS_DESCR STD_AXIS zff_atsys._.iSignale._.obj.sig_c_getr UMR_GRADC__1_1_M40_S6_S3 8 -40 150 DEPOSIT ABSOLUTE MONOTONY MON_INCREASE /end AXIS_DESCR
 /begin AXIS_DESCR STD_AXIS zff_atsys._.iSignale._.obj.sig_m_t8 UMR_NM__8_1_M50_S6_S3 4 -400 1640 DEPOSIT ABSOLUTE MONOTONY MON_INCREASE /end AXIS_DESCR
/end CHARACTERISTIC
/begin CHARACTERISTIC KF_POSFCGNAB_D "Kennfeld Schnellfülldruckoffset" MAP 0x2260B4 kf_si16_S6_S3 5 UMR_BAR__1_1000_0_S6_S3 -5 0
 /begin AXIS_DESCR STD_AXIS zff_atsys._.iSignale._.obj.sig_c_getr UMR_GRADC__1_1_M40_S6_S3 2 -40 150 DEPOSIT ABSOLUTE MONOTONY MON_INCREASE /end AXIS_DESCR
 /begin AXIS_DESCR STD_AXIS zff_atsys._.iSignale._.obj.sig_n_ab8 UMR_U_MIN_32_1_0_S6_S3 2 0 8160 DEPOSIT ABSOLUTE MONOTONY MON_INCREASE /end AXIS_DESCR
/end CHARACTERISTIC
/begin CHARACTERISTIC KL_TSFCG_D "Schnellfüllzeit" CURVE 0x2260CC kl_ui16_S6_S3 2540 UMR_MSEC__1_1_0_S6_S3 0 2540
 /begin AXIS_DESCR STD_AXIS zff_atsys._.iSignale._.obj.sig_c_getr UMR_GRADC__1_1_M40_S6_S3 10 -40 150 DEPOSIT ABSOLUTE MONOTONY MON_INCREASE /end AXIS_DESCR
/end CHARACTERISTIC
/begin CHARACTERISTIC KL_TSFCGFUELLRED_D "Schnellfüllzeit reduzierte Befüllung" CURVE 0x2260F8 kl_ui16_S6_S3 2540 UMR_MSEC__1_1_0_S6_S3 0 2540
 /begin AXIS_DESCR STD_AXIS zff_atsys._.iSignale._.obj.sig_c_getr UMR_GRADC__1_1_M40_S6_S3 10 -40 150 DEPOSIT ABSOLUTE MONOTONY MON_INCREASE /end AXIS_DESCR
/end CHARACTERISTIC
/begin CHARACTERISTIC KL_TSFCGFUELLOPT_D "Schnellfüllzeit optimierte Befüllung" CURVE 0x226124 kl_ui16_S6_S3 2540 UMR_MSEC__1_1_0_S6_S3 0 2540
 /begin AXIS_DESCR STD_AXIS zff_atsys._.iSignale._.obj.sig_c_getr UMR_GRADC__1_1_M40_S6_S3 10 -40 150 DEPOSIT ABSOLUTE MONOTONY MON_INCREASE /end AXIS_DESCR
/end CHARACTERISTIC
/begin CHARACTERISTIC KL_TOSFNK_D "Schnellfüllzeitoffset" CURVE 0x226150 kl_si16_S6_S3 3540 UMR_MSEC__1_1_0_S6_S3 -1000 2540
 /begin AXIS_DESCR STD_AXIS NO_INPUT_QUANTITY UMR_U_MIN_1_1_0_S6_S3 8 0 11000 DEPOSIT ABSOLUTE MONOTONY MON_INCREASE /end AXIS_DESCR
/end CHARACTERISTIC
/begin CHARACTERISTIC KL_TOSFNKFUELLRED_D "Schnellfüllzeitoffset reduzierte Befüllung" CURVE 0x226174 kl_si16_S6_S3 3540 UMR_MSEC__1_1_0_S6_S3 -1000 2540
 /begin AXIS_DESCR STD_AXIS NO_INPUT_QUANTITY UMR_U_MIN_1_1_0_S6_S3 8 0 11000 DEPOSIT ABSOLUTE MONOTONY MON_INCREASE /end AXIS_DESCR
/end CHARACTERISTIC
/begin CHARACTERISTIC KL_TOSFNKFUELLOPT_D "Schnellfüllzeitoffset optimierte Befüllung" CURVE 0x226198 kl_si16_S6_S3 3540 UMR_MSEC__1_1_0_S6_S3 -1000 2540
 /begin AXIS_DESCR STD_AXIS NO_INPUT_QUANTITY UMR_U_MIN_1_1_0_S6_S3 8 0 11000 DEPOSIT ABSOLUTE MONOTONY MON_INCREASE /end AXIS_DESCR
/end CHARACTERISTIC
/begin CHARACTERISTIC KF_TOSFGE_D "Offset auf Schnellfüllzeit beim Gangeinlegen" MAP 0x2261BC kf_si16_S6_S3 2000 UMR_MSEC__1_1_0_S6_S3 -1000 1000
 /begin AXIS_DESCR STD_AXIS zff_atsys._.iSignale._.obj.sig_c_getr UMR_GRADC__1_1_M40_S6_S3 4 -40 150 DEPOSIT ABSOLUTE MONOTONY MON_INCREASE /end AXIS_DESCR
 /begin AXIS_DESCR STD_AXIS zff_atsys._.iSignale._.obj.sig_m_t UMR_NM__1_1_0_S6_S3 4 -400 1640 DEPOSIT ABSOLUTE MONOTONY MON_INCREASE /end AXIS_DESCR
/end CHARACTERISTIC
/begin CHARACTERISTIC KF_TOSFHS_D "Schnellfüllzeitoffset HS" MAP 0x2261F4 kf_si16_S6_S3 2000 UMR_MSEC__1_1_0_S6_S3 -1000 1000
 /begin AXIS_DESCR STD_AXIS zff_atsys._.iSignale._.obj.sig_n_t UMR_U_MIN_1_1_0_S6_S3 4 0 8160 DEPOSIT ABSOLUTE MONOTONY MON_INCREASE /end AXIS_DESCR
 /begin AXIS_DESCR STD_AXIS zff_atsys._.iSignale._.obj.sig_m_t UMR_NM__1_1_0_S6_S3 4 -400 1640 DEPOSIT ABSOLUTE MONOTONY MON_INCREASE /end AXIS_DESCR
/end CHARACTERISTIC
/begin CHARACTERISTIC KF_TOSFHS_D_EL "Schnellfüllzeitoffset HS" MAP 0x22622C kf_si16_S6_S3 2000 UMR_MSEC__1_1_0_S6_S3 -1000 1000
 /begin AXIS_DESCR STD_AXIS zff_atsys._.iSignale._.obj.sig_n_t UMR_U_MIN_1_1_0_S6_S3 4 0 8160 DEPOSIT ABSOLUTE MONOTONY MON_INCREASE /end AXIS_DESCR
 /begin AXIS_DESCR STD_AXIS zff_atsys._.iSignale._.obj.sig_m_t UMR_NM__1_1_0_S6_S3 4 -400 1640 DEPOSIT ABSOLUTE MONOTONY MON_INCREASE /end AXIS_DESCR
/end CHARACTERISTIC
/begin CHARACTERISTIC KF_TOSFHSSP_D "Schnellfüllzeitoffset spontane HS" MAP 0x226264 kf_si16_S6_S3 2000 UMR_MSEC__1_1_0_S6_S3 -1000 1000
 /begin AXIS_DESCR STD_AXIS zff_atsys._.iSignale._.obj.sig_n_t UMR_U_MIN_1_1_0_S6_S3 4 0 8160 DEPOSIT ABSOLUTE MONOTONY MON_INCREASE /end AXIS_DESCR
 /begin AXIS_DESCR STD_AXIS zff_atsys._.iSignale._.obj.sig_m_t UMR_NM__1_1_0_S6_S3 4 -400 1640 DEPOSIT ABSOLUTE MONOTONY MON_INCREASE /end AXIS_DESCR
/end CHARACTERISTIC
/begin CHARACTERISTIC KF_TOSFHSSPORT_D "Schnellfüllzeitoffset sportliche HS" MAP 0x22629C kf_si16_S6_S3 2000 UMR_MSEC__1_1_0_S6_S3 -1000 1000
 /begin AXIS_DESCR STD_AXIS zff_atsys._.iSignale._.obj.sig_n_t UMR_U_MIN_1_1_0_S6_S3 4 0 8160 DEPOSIT ABSOLUTE MONOTONY MON_INCREASE /end AXIS_DESCR
 /begin AXIS_DESCR STD_AXIS zff_atsys._.iSignale._.obj.sig_m_t UMR_NM__1_1_0_S6_S3 4 -400 1640 DEPOSIT ABSOLUTE MONOTONY MON_INCREASE /end AXIS_DESCR
/end CHARACTERISTIC
/begin CHARACTERISTIC KF_TOSFHSFUELLOPT_D "Schnellfüllzeitoffset HS mit opt. Befüllung" MAP 0x2262D4 kf_si16_S6_S3 2000 UMR_MSEC__1_1_0_S6_S3 -1000 1000
 /begin AXIS_DESCR STD_AXIS zff_atsys._.iSignale._.obj.sig_n_t UMR_U_MIN_1_1_0_S6_S3 4 0 8160 DEPOSIT ABSOLUTE MONOTONY MON_INCREASE /end AXIS_DESCR
 /begin AXIS_DESCR STD_AXIS zff_atsys._.iSignale._.obj.sig_m_t UMR_NM__1_1_0_S6_S3 4 -400 1640 DEPOSIT ABSOLUTE MONOTONY MON_INCREASE /end AXIS_DESCR
/end CHARACTERISTIC
/begin CHARACTERISTIC KF_TOSFRS_D "Schnellfüllzeitoffset RS" MAP 0x22630C kf_si16_S6_S3 2000 UMR_MSEC__1_1_0_S6_S3 -1000 1000
 /begin AXIS_DESCR STD_AXIS zff_atsys._.iSignale._.obj.sig_n_t UMR_U_MIN_1_1_0_S6_S3 4 0 8160 DEPOSIT ABSOLUTE MONOTONY MON_INCREASE /end AXIS_DESCR
 /begin AXIS_DESCR STD_AXIS zff_atsys._.iSignale._.obj.sig_m_t UMR_NM__1_1_0_S6_S3 4 -400 1640 DEPOSIT ABSOLUTE MONOTONY MON_INCREASE /end AXIS_DESCR
/end CHARACTERISTIC
/begin CHARACTERISTIC KF_TOSFRS_D_EL "Schnellfüllzeitoffset RS" MAP 0x226344 kf_si16_S6_S3 2000 UMR_MSEC__1_1_0_S6_S3 -1000 1000
 /begin AXIS_DESCR STD_AXIS zff_atsys._.iSignale._.obj.sig_n_t UMR_U_MIN_1_1_0_S6_S3 4 0 8160 DEPOSIT ABSOLUTE MONOTONY MON_INCREASE /end AXIS_DESCR
 /begin AXIS_DESCR STD_AXIS zff_atsys._.iSignale._.obj.sig_m_t UMR_NM__1_1_0_S6_S3 4 -400 1640 DEPOSIT ABSOLUTE MONOTONY MON_INCREASE /end AXIS_DESCR
/end CHARACTERISTIC
/begin CHARACTERISTIC KF_TOSFRSSP_D "Schnellfüllzeitoffset spontane RS" MAP 0x22637C kf_si16_S6_S3 2000 UMR_MSEC__1_1_0_S6_S3 -1000 1000
 /begin AXIS_DESCR STD_AXIS zff_atsys._.iSignale._.obj.sig_n_t UMR_U_MIN_1_1_0_S6_S3 4 0 8160 DEPOSIT ABSOLUTE MONOTONY MON_INCREASE /end AXIS_DESCR
 /begin AXIS_DESCR STD_AXIS zff_atsys._.iSignale._.obj.sig_m_t UMR_NM__1_1_0_S6_S3 4 -400 1640 DEPOSIT ABSOLUTE MONOTONY MON_INCREASE /end AXIS_DESCR
/end CHARACTERISTIC
/begin CHARACTERISTIC KF_TOSFRSSPORT_D "Schnellfüllzeitoffset sportliche RS" MAP 0x2263B4 kf_si16_S6_S3 2000 UMR_MSEC__1_1_0_S6_S3 -1000 1000
 /begin AXIS_DESCR STD_AXIS zff_atsys._.iSignale._.obj.sig_n_t UMR_U_MIN_1_1_0_S6_S3 4 0 8160 DEPOSIT ABSOLUTE MONOTONY MON_INCREASE /end AXIS_DESCR
 /begin AXIS_DESCR STD_AXIS zff_atsys._.iSignale._.obj.sig_m_t UMR_NM__1_1_0_S6_S3 4 -400 1640 DEPOSIT ABSOLUTE MONOTONY MON_INCREASE /end AXIS_DESCR
/end CHARACTERISTIC
/begin CHARACTERISTIC F_TSFADAFUELLOPT_D "Faktor für Schnellfüllzeitadaptionswert opt. Befüllung" VALUE 0x26E567 kw_ui8_S6_S3 1 UMR___1_100_0_S6_S3 0 1 /end CHARACTERISTIC
/begin CHARACTERISTIC F_TSFADAFUELLRED_D "Faktor für Schnellfüllzeitadaptionswert red. Befüllung" VALUE 0x26E568 kw_ui8_S6_S3 2 UMR___1_100_0_S6_S3 0 2 /end CHARACTERISTIC
/begin CHARACTERISTIC KL_FPFCGADAFUELLRED_D "Faktor für Fülldruckadaptionswert red. Befüllung" CURVE 0x2263EC kl_ui8_S6_S3 1 UMR___1_100_0_S6_S3 0 1
 /begin AXIS_DESCR STD_AXIS zff_atsys._.iSignale._.obj.sig_c_getr UMR_GRADC__1_1_M40_S6_S3 4 -40 150 DEPOSIT ABSOLUTE MONOTONY MON_INCREASE /end AXIS_DESCR
/end CHARACTERISTIC
/begin CHARACTERISTIC KF_TO1SFCG_D "Schnellfüllzeitoffset erste Befüllung" MAP 0x2263F8 kf_si16_S6_S3 2550 UMR_MSEC__1_1_0_S6_S3 -1280 1270
 /begin AXIS_DESCR STD_AXIS zff_atsys._.iSignale._.obj.sig_c_getr UMR_GRADC__1_1_M40_S6_S3 10 -40 150 DEPOSIT ABSOLUTE MONOTONY MON_INCREASE /end AXIS_DESCR
 /begin AXIS_DESCR STD_AXIS iItfInput.c_getrabst UMR_GRADC__1_1_M40_S6_S3 6 -40 150 DEPOSIT ABSOLUTE MONOTONY MON_INCREASE /end AXIS_DESCR
/end CHARACTERISTIC
/begin CHARACTERISTIC T_O1SFAUSSB_D "Schnellfüllzeitoffset erste Befüllung nach Neustart aus Standby" VALUE 0x26D694 kw_si16_S6_S3 1270 UMR_MSEC__1_1_0_S6_S3 0 1270 /end CHARACTERISTIC
/begin CHARACTERISTIC KL_TTOTFUELL_D "Totzeit" CURVE 0x226498 kl_ui8_S6_S3 2000 UMR_MSEC__10_1_0_S6_S3 0 2000
 /begin AXIS_DESCR STD_AXIS zff_atsys._.iSignale._.obj.sig_c_getr UMR_GRADC__1_1_M40_S6_S3 5 -40 150 DEPOSIT ABSOLUTE MONOTONY MON_INCREASE /end AXIS_DESCR
/end CHARACTERISTIC
/begin CHARACTERISTIC KF_TENTLEER_D "Entleerzeit der Kupplung" MAP 0x2264A8 kf_ui16_S6_S3 20000 UMR_MSEC__10_1_0_S6_S3 0 20000
 /begin AXIS_DESCR STD_AXIS zff_atsys._.iSignale._.obj.sig_c_getr UMR_GRADC__1_1_M40_S6_S3 10 -40 150 DEPOSIT ABSOLUTE MONOTONY MON_INCREASE /end AXIS_DESCR
 /begin AXIS_DESCR STD_AXIS NO_INPUT_QUANTITY UMR_U_MIN_1_1_0_S6_S3 8 0 11000 DEPOSIT ABSOLUTE MONOTONY MON_INCREASE /end AXIS_DESCR
/end CHARACTERISTIC
/begin CHARACTERISTIC KF_TOENTLEERCGADA_D "Entleerzeit der Kupplung" MAP 0x226574 kf_si16_S6_S3 21000 UMR_MSEC__10_1_0_S6_S3 -1000 20000
 /begin AXIS_DESCR STD_AXIS zff_atsys._.iSignale._.obj.sig_c_getr UMR_GRADC__1_1_M40_S6_S3 8 -40 150 DEPOSIT ABSOLUTE MONOTONY MON_INCREASE /end AXIS_DESCR
 /begin AXIS_DESCR STD_AXIS NO_INPUT_QUANTITY UMR_MSEC__1_1_0_S6_S3 6 -32768 32767 DEPOSIT ABSOLUTE MONOTONY MON_INCREASE /end AXIS_DESCR
/end CHARACTERISTIC
/begin CHARACTERISTIC TOENTLEERSR_D "Offset auf Entleerzeit bei aktiver Stromrampe" VALUE 0x26D696 kw_si16_S6_S3 2000 UMR_MSEC__1_1_0_S6_S3 0 2000 /end CHARACTERISTIC
/begin CHARACTERISTIC PO_KOLBENPOSKOR_D "Druckoffset für Start timer_kolbenpos_kor" VALUE 0x26D698 kw_ui16_S6_S3 2 UMR_BAR__1_1000_0_S6_S3 0 2 /end CHARACTERISTIC
/begin CHARACTERISTIC KL_FKOLBENPOSCGKOR_D "Faktor auf Basiskolbenposition" CURVE 0x2265F8 kl_ui8_S6_S3 1 UMR___1_100_0_S6_S3 1 2
 /begin AXIS_DESCR STD_AXIS zff_atsys._.iSignale._.obj.sig_c_getr UMR_GRADC__1_1_M40_S6_S3 4 -40 150 DEPOSIT ABSOLUTE MONOTONY MON_INCREASE /end AXIS_DESCR
/end CHARACTERISTIC
/begin CHARACTERISTIC KF_FKOLBENPOSKOR_D "Faktor auf Basiskolbenposition" MAP 0x226604 kf_si16_S6_S3 1 UMR___1_100_0_S6_S3 0 1
 /begin AXIS_DESCR STD_AXIS NO_INPUT_QUANTITY UMR_MSEC__10_1_0_S6_S3 6 0 2550 DEPOSIT ABSOLUTE MONOTONY MON_INCREASE /end AXIS_DESCR
 /begin AXIS_DESCR STD_AXIS NO_INPUT_QUANTITY UMR_MSEC__1_1_0_S6_S3 4 -32768 32767 DEPOSIT ABSOLUTE MONOTONY MON_INCREASE /end AXIS_DESCR
/end CHARACTERISTIC
/begin CHARACTERISTIC PO_KOLBENPOSKORGA_D "Druckoffset bei GA für Start timer_kolbenpos_kor" VALUE 0x26D69A kw_ui16_S6_S3 2 UMR_BAR__1_1000_0_S6_S3 0 2 /end CHARACTERISTIC
/begin CHARACTERISTIC KF_FKOLBENPOSKORGA_D "Faktor auf Basiskolbenposition bei GA" MAP 0x226650 kf_si16_S6_S3 1 UMR___1_100_0_S6_S3 0 1
 /begin AXIS_DESCR STD_AXIS NO_INPUT_QUANTITY UMR_MSEC__10_1_0_S6_S3 6 0 2550 DEPOSIT ABSOLUTE MONOTONY MON_INCREASE /end AXIS_DESCR
 /begin AXIS_DESCR STD_AXIS NO_INPUT_QUANTITY UMR_MSEC__1_1_0_S6_S3 4 -32768 32767 DEPOSIT ABSOLUTE MONOTONY MON_INCREASE /end AXIS_DESCR
/end CHARACTERISTIC
/begin CHARACTERISTIC KL_PFHYSCG_D "Fülldruckhysterese" CURVE 0x22669C kl_si16_S6_S3 12.7 UMR_BAR__1_1000_0_S6_S3 0 12.7
 /begin AXIS_DESCR STD_AXIS zff_atsys._.iSignale._.obj.sig_c_getr UMR_GRADC__1_1_M40_S6_S3 10 -40 150 DEPOSIT ABSOLUTE MONOTONY MON_INCREASE /end AXIS_DESCR
/end CHARACTERISTIC
/begin CHARACTERISTIC KL_TVCGSAENDHS_D "Verzoegerungszeit für Umstellung auf Schaltungsende bei HS" CURVE 0x2266C8 kl_ui8_S6_S3 2000 UMR_MSEC__10_1_0_S6_S3 0 2000
 /begin AXIS_DESCR STD_AXIS zff_atsys._.iSignale._.obj.sig_c_getr UMR_GRADC__1_1_M40_S6_S3 3 -40 150 DEPOSIT ABSOLUTE MONOTONY MON_INCREASE /end AXIS_DESCR
/end CHARACTERISTIC
/begin CHARACTERISTIC KL_TVCGSAENDRS_D "Verzoegerungszeit für Umstellung auf Schaltungsende bei RS" CURVE 0x2266D4 kl_ui8_S6_S3 2000 UMR_MSEC__10_1_0_S6_S3 0 2000
 /begin AXIS_DESCR STD_AXIS zff_atsys._.iSignale._.obj.sig_c_getr UMR_GRADC__1_1_M40_S6_S3 3 -40 150 DEPOSIT ABSOLUTE MONOTONY MON_INCREASE /end AXIS_DESCR
/end CHARACTERISTIC
/begin CHARACTERISTIC KL_TVCGSAENDGE_D "Verzoegerungszeit für Umstellung auf Schaltungsende bei GE" CURVE 0x2266E0 kl_ui8_S6_S3 2000 UMR_MSEC__10_1_0_S6_S3 0 2000
 /begin AXIS_DESCR STD_AXIS zff_atsys._.iSignale._.obj.sig_c_getr UMR_GRADC__1_1_M40_S6_S3 3 -40 150 DEPOSIT ABSOLUTE MONOTONY MON_INCREASE /end AXIS_DESCR
/end CHARACTERISTIC
/begin CHARACTERISTIC TO_ABBRUCHSAEND_D "Offset auf Verzoegerungszeit zur Umstellung auf Schaltungsende" VALUE 0x26E569 kw_si8_S6_S3 2000 UMR_MSEC__10_1_0_S6_S3 -1000 1000 /end CHARACTERISTIC
/begin CHARACTERISTIC KL_PFCGGA_D "Fülldruck bei Gangauslegen" CURVE 0x2266EC kl_si16_S6_S3 12.75 UMR_BAR__1_1000_0_S6_S3 0 12.75
 /begin AXIS_DESCR STD_AXIS zff_atsys._.iSignale._.obj.sig_c_getr UMR_GRADC__1_1_M40_S6_S3 10 -40 150 DEPOSIT ABSOLUTE MONOTONY MON_INCREASE /end AXIS_DESCR
/end CHARACTERISTIC
/begin CHARACTERISTIC KL_PKUPPSTROM_D "Druckwert für Stromschleife" CURVE 0x226718 kl_ui16_S6_S3 5 UMR_BAR__1_1000_0_S6_S3 0 5
 /begin AXIS_DESCR STD_AXIS zff_atsys._.iSignale._.obj.sig_c_getr UMR_GRADC__1_1_M40_S6_S3 4 -40 150 DEPOSIT ABSOLUTE MONOTONY MON_INCREASE /end AXIS_DESCR
/end CHARACTERISTIC
/begin CHARACTERISTIC KL_PFCG_D "Fülldruck" CURVE 0x22672C kl_si16_S6_S3 12.75 UMR_BAR__1_1000_0_S6_S3 0 12.75
 /begin AXIS_DESCR STD_AXIS zff_atsys._.iSignale._.obj.sig_c_getr UMR_GRADC__1_1_M40_S6_S3 10 -40 150 DEPOSIT ABSOLUTE MONOTONY MON_INCREASE /end AXIS_DESCR
/end CHARACTERISTIC
/begin CHARACTERISTIC IGKABENTLEER_D "Gradient Stromrampe Kupplung entleeren" VALUE 0x26D69C kw_si16_S6_S3 200 UMR_A_SEC_1_10_0_S6_S3 -100 100 /end CHARACTERISTIC
/begin CHARACTERISTIC KL_TFPWIRK_E "Filterzeit für Kupplungswirkdruck in ms" CURVE 0x226758 kl_ui8_S6_S3 254 UMR_MSEC__1_1_0_S6_S3 0 254
 /begin AXIS_DESCR STD_AXIS zff_atsys._.iSignale._.obj.sig_c_getr UMR_GRADC__1_1_M40_S6_S3 3 -40 150 DEPOSIT ABSOLUTE MONOTONY MON_INCREASE /end AXIS_DESCR
/end CHARACTERISTIC
/begin CHARACTERISTIC KF_PSFCGMT_E "Kennfeld Schnellfülldruck" MAP 0x226764 kf_si16_S6_S3 12.75 UMR_BAR__1_1000_0_S6_S3 0 12.75
 /begin AXIS_DESCR STD_AXIS zff_atsys._.iSignale._.obj.sig_c_getr UMR_GRADC__1_1_M40_S6_S3 8 -40 150 DEPOSIT ABSOLUTE MONOTONY MON_INCREASE /end AXIS_DESCR
 /begin AXIS_DESCR STD_AXIS zff_atsys._.iSignale._.obj.sig_m_t8 UMR_NM__8_1_M50_S6_S3 4 -400 1640 DEPOSIT ABSOLUTE MONOTONY MON_INCREASE /end AXIS_DESCR
/end CHARACTERISTIC
/begin CHARACTERISTIC KF_PSFCGMTFUELLRED_E "Kennfeld Schnellfülldruck" MAP 0x2267C4 kf_si16_S6_S3 12.75 UMR_BAR__1_1000_0_S6_S3 0 12.75
 /begin AXIS_DESCR STD_AXIS zff_atsys._.iSignale._.obj.sig_c_getr UMR_GRADC__1_1_M40_S6_S3 8 -40 150 DEPOSIT ABSOLUTE MONOTONY MON_INCREASE /end AXIS_DESCR
 /begin AXIS_DESCR STD_AXIS zff_atsys._.iSignale._.obj.sig_m_t8 UMR_NM__8_1_M50_S6_S3 4 -400 1640 DEPOSIT ABSOLUTE MONOTONY MON_INCREASE /end AXIS_DESCR
/end CHARACTERISTIC
/begin CHARACTERISTIC KF_PSFCGMTFUELLOPT_E "Kennfeld Schnellfülldruck" MAP 0x226824 kf_si16_S6_S3 12.75 UMR_BAR__1_1000_0_S6_S3 0 12.75
 /begin AXIS_DESCR STD_AXIS zff_atsys._.iSignale._.obj.sig_c_getr UMR_GRADC__1_1_M40_S6_S3 8 -40 150 DEPOSIT ABSOLUTE MONOTONY MON_INCREASE /end AXIS_DESCR
 /begin AXIS_DESCR STD_AXIS zff_atsys._.iSignale._.obj.sig_m_t8 UMR_NM__8_1_M50_S6_S3 4 -400 1640 DEPOSIT ABSOLUTE MONOTONY MON_INCREASE /end AXIS_DESCR
/end CHARACTERISTIC
/begin CHARACTERISTIC KF_POSFCGNAB_E "Kennfeld Schnellfülldruckoffset" MAP 0x226884 kf_si16_S6_S3 5 UMR_BAR__1_1000_0_S6_S3 -5 0
 /begin AXIS_DESCR STD_AXIS zff_atsys._.iSignale._.obj.sig_c_getr UMR_GRADC__1_1_M40_S6_S3 2 -40 150 DEPOSIT ABSOLUTE MONOTONY MON_INCREASE /end AXIS_DESCR
 /begin AXIS_DESCR STD_AXIS zff_atsys._.iSignale._.obj.sig_n_ab8 UMR_U_MIN_32_1_0_S6_S3 2 0 8160 DEPOSIT ABSOLUTE MONOTONY MON_INCREASE /end AXIS_DESCR
/end CHARACTERISTIC
/begin CHARACTERISTIC KL_TSFCG_E "Schnellfüllzeit" CURVE 0x22689C kl_ui16_S6_S3 2540 UMR_MSEC__1_1_0_S6_S3 0 2540
 /begin AXIS_DESCR STD_AXIS zff_atsys._.iSignale._.obj.sig_c_getr UMR_GRADC__1_1_M40_S6_S3 10 -40 150 DEPOSIT ABSOLUTE MONOTONY MON_INCREASE /end AXIS_DESCR
/end CHARACTERISTIC
/begin CHARACTERISTIC KL_TSFCGFUELLRED_E "Schnellfüllzeit reduzierte Befüllung" CURVE 0x2268C8 kl_ui16_S6_S3 2540 UMR_MSEC__1_1_0_S6_S3 0 2540
 /begin AXIS_DESCR STD_AXIS zff_atsys._.iSignale._.obj.sig_c_getr UMR_GRADC__1_1_M40_S6_S3 10 -40 150 DEPOSIT ABSOLUTE MONOTONY MON_INCREASE /end AXIS_DESCR
/end CHARACTERISTIC
/begin CHARACTERISTIC KL_TSFCGFUELLOPT_E "Schnellfüllzeit optimierte Befüllung" CURVE 0x2268F4 kl_ui16_S6_S3 2540 UMR_MSEC__1_1_0_S6_S3 0 2540
 /begin AXIS_DESCR STD_AXIS zff_atsys._.iSignale._.obj.sig_c_getr UMR_GRADC__1_1_M40_S6_S3 10 -40 150 DEPOSIT ABSOLUTE MONOTONY MON_INCREASE /end AXIS_DESCR
/end CHARACTERISTIC
/begin CHARACTERISTIC KL_TOSFNK_E "Schnellfüllzeitoffset" CURVE 0x226920 kl_si16_S6_S3 3540 UMR_MSEC__1_1_0_S6_S3 -1000 2540
 /begin AXIS_DESCR STD_AXIS NO_INPUT_QUANTITY UMR_U_MIN_1_1_0_S6_S3 8 0 11000 DEPOSIT ABSOLUTE MONOTONY MON_INCREASE /end AXIS_DESCR
/end CHARACTERISTIC
/begin CHARACTERISTIC KL_TOSFNKFUELLRED_E "Schnellfüllzeitoffset reduzierte Befüllung" CURVE 0x226944 kl_si16_S6_S3 3540 UMR_MSEC__1_1_0_S6_S3 -1000 2540
 /begin AXIS_DESCR STD_AXIS NO_INPUT_QUANTITY UMR_U_MIN_1_1_0_S6_S3 8 0 11000 DEPOSIT ABSOLUTE MONOTONY MON_INCREASE /end AXIS_DESCR
/end CHARACTERISTIC
/begin CHARACTERISTIC KL_TOSFNKFUELLOPT_E "Schnellfüllzeitoffset optimierte Befüllung" CURVE 0x226968 kl_si16_S6_S3 3540 UMR_MSEC__1_1_0_S6_S3 -1000 2540
 /begin AXIS_DESCR STD_AXIS NO_INPUT_QUANTITY UMR_U_MIN_1_1_0_S6_S3 8 0 11000 DEPOSIT ABSOLUTE MONOTONY MON_INCREASE /end AXIS_DESCR
/end CHARACTERISTIC
/begin CHARACTERISTIC KF_TOSFGE_E "Offset auf Schnellfüllzeit beim Gangeinlegen" MAP 0x22698C kf_si16_S6_S3 2000 UMR_MSEC__1_1_0_S6_S3 -1000 1000
 /begin AXIS_DESCR STD_AXIS zff_atsys._.iSignale._.obj.sig_c_getr UMR_GRADC__1_1_M40_S6_S3 4 -40 150 DEPOSIT ABSOLUTE MONOTONY MON_INCREASE /end AXIS_DESCR
 /begin AXIS_DESCR STD_AXIS zff_atsys._.iSignale._.obj.sig_m_t UMR_NM__1_1_0_S6_S3 4 -400 1640 DEPOSIT ABSOLUTE MONOTONY MON_INCREASE /end AXIS_DESCR
/end CHARACTERISTIC
/begin CHARACTERISTIC KF_TOSFHS_E "Schnellfüllzeitoffset HS" MAP 0x2269C4 kf_si16_S6_S3 2000 UMR_MSEC__1_1_0_S6_S3 -1000 1000
 /begin AXIS_DESCR STD_AXIS zff_atsys._.iSignale._.obj.sig_n_t UMR_U_MIN_1_1_0_S6_S3 4 0 8160 DEPOSIT ABSOLUTE MONOTONY MON_INCREASE /end AXIS_DESCR
 /begin AXIS_DESCR STD_AXIS zff_atsys._.iSignale._.obj.sig_m_t UMR_NM__1_1_0_S6_S3 4 -400 1640 DEPOSIT ABSOLUTE MONOTONY MON_INCREASE /end AXIS_DESCR
/end CHARACTERISTIC
/begin CHARACTERISTIC KF_TOSFHS_E_EL "Schnellfüllzeitoffset HS" MAP 0x2269FC kf_si16_S6_S3 2000 UMR_MSEC__1_1_0_S6_S3 -1000 1000
 /begin AXIS_DESCR STD_AXIS zff_atsys._.iSignale._.obj.sig_n_t UMR_U_MIN_1_1_0_S6_S3 4 0 8160 DEPOSIT ABSOLUTE MONOTONY MON_INCREASE /end AXIS_DESCR
 /begin AXIS_DESCR STD_AXIS zff_atsys._.iSignale._.obj.sig_m_t UMR_NM__1_1_0_S6_S3 4 -400 1640 DEPOSIT ABSOLUTE MONOTONY MON_INCREASE /end AXIS_DESCR
/end CHARACTERISTIC
/begin CHARACTERISTIC KF_TOSFHSSP_E "Schnellfüllzeitoffset spontane HS" MAP 0x226A34 kf_si16_S6_S3 2000 UMR_MSEC__1_1_0_S6_S3 -1000 1000
 /begin AXIS_DESCR STD_AXIS zff_atsys._.iSignale._.obj.sig_n_t UMR_U_MIN_1_1_0_S6_S3 4 0 8160 DEPOSIT ABSOLUTE MONOTONY MON_INCREASE /end AXIS_DESCR
 /begin AXIS_DESCR STD_AXIS zff_atsys._.iSignale._.obj.sig_m_t UMR_NM__1_1_0_S6_S3 4 -400 1640 DEPOSIT ABSOLUTE MONOTONY MON_INCREASE /end AXIS_DESCR
/end CHARACTERISTIC
/begin CHARACTERISTIC KF_TOSFHSSPORT_E "Schnellfüllzeitoffset sportliche HS" MAP 0x226A6C kf_si16_S6_S3 2000 UMR_MSEC__1_1_0_S6_S3 -1000 1000
 /begin AXIS_DESCR STD_AXIS zff_atsys._.iSignale._.obj.sig_n_t UMR_U_MIN_1_1_0_S6_S3 4 0 8160 DEPOSIT ABSOLUTE MONOTONY MON_INCREASE /end AXIS_DESCR
 /begin AXIS_DESCR STD_AXIS zff_atsys._.iSignale._.obj.sig_m_t UMR_NM__1_1_0_S6_S3 4 -400 1640 DEPOSIT ABSOLUTE MONOTONY MON_INCREASE /end AXIS_DESCR
/end CHARACTERISTIC
/begin CHARACTERISTIC KF_TOSFHSFUELLOPT_E "Schnellfüllzeitoffset HS mit opt. Befüllung" MAP 0x226AA4 kf_si16_S6_S3 2000 UMR_MSEC__1_1_0_S6_S3 -1000 1000
 /begin AXIS_DESCR STD_AXIS zff_atsys._.iSignale._.obj.sig_n_t UMR_U_MIN_1_1_0_S6_S3 4 0 8160 DEPOSIT ABSOLUTE MONOTONY MON_INCREASE /end AXIS_DESCR
 /begin AXIS_DESCR STD_AXIS zff_atsys._.iSignale._.obj.sig_m_t UMR_NM__1_1_0_S6_S3 4 -400 1640 DEPOSIT ABSOLUTE MONOTONY MON_INCREASE /end AXIS_DESCR
/end CHARACTERISTIC
/begin CHARACTERISTIC KF_TOSFRS_E "Schnellfüllzeitoffset RS" MAP 0x226ADC kf_si16_S6_S3 2000 UMR_MSEC__1_1_0_S6_S3 -1000 1000
 /begin AXIS_DESCR STD_AXIS zff_atsys._.iSignale._.obj.sig_n_t UMR_U_MIN_1_1_0_S6_S3 4 0 8160 DEPOSIT ABSOLUTE MONOTONY MON_INCREASE /end AXIS_DESCR
 /begin AXIS_DESCR STD_AXIS zff_atsys._.iSignale._.obj.sig_m_t UMR_NM__1_1_0_S6_S3 4 -400 1640 DEPOSIT ABSOLUTE MONOTONY MON_INCREASE /end AXIS_DESCR
/end CHARACTERISTIC
/begin CHARACTERISTIC KF_TOSFRS_E_EL "Schnellfüllzeitoffset RS" MAP 0x226B14 kf_si16_S6_S3 2000 UMR_MSEC__1_1_0_S6_S3 -1000 1000
 /begin AXIS_DESCR STD_AXIS zff_atsys._.iSignale._.obj.sig_n_t UMR_U_MIN_1_1_0_S6_S3 4 0 8160 DEPOSIT ABSOLUTE MONOTONY MON_INCREASE /end AXIS_DESCR
 /begin AXIS_DESCR STD_AXIS zff_atsys._.iSignale._.obj.sig_m_t UMR_NM__1_1_0_S6_S3 4 -400 1640 DEPOSIT ABSOLUTE MONOTONY MON_INCREASE /end AXIS_DESCR
/end CHARACTERISTIC
/begin CHARACTERISTIC KF_TOSFRSSP_E "Schnellfüllzeitoffset spontane RS" MAP 0x226B4C kf_si16_S6_S3 2000 UMR_MSEC__1_1_0_S6_S3 -1000 1000
 /begin AXIS_DESCR STD_AXIS zff_atsys._.iSignale._.obj.sig_n_t UMR_U_MIN_1_1_0_S6_S3 4 0 8160 DEPOSIT ABSOLUTE MONOTONY MON_INCREASE /end AXIS_DESCR
 /begin AXIS_DESCR STD_AXIS zff_atsys._.iSignale._.obj.sig_m_t UMR_NM__1_1_0_S6_S3 4 -400 1640 DEPOSIT ABSOLUTE MONOTONY MON_INCREASE /end AXIS_DESCR
/end CHARACTERISTIC
/begin CHARACTERISTIC KF_TOSFRSSPORT_E "Schnellfüllzeitoffset sportliche RS" MAP 0x226B84 kf_si16_S6_S3 2000 UMR_MSEC__1_1_0_S6_S3 -1000 1000
 /begin AXIS_DESCR STD_AXIS zff_atsys._.iSignale._.obj.sig_n_t UMR_U_MIN_1_1_0_S6_S3 4 0 8160 DEPOSIT ABSOLUTE MONOTONY MON_INCREASE /end AXIS_DESCR
 /begin AXIS_DESCR STD_AXIS zff_atsys._.iSignale._.obj.sig_m_t UMR_NM__1_1_0_S6_S3 4 -400 1640 DEPOSIT ABSOLUTE MONOTONY MON_INCREASE /end AXIS_DESCR
/end CHARACTERISTIC
/begin CHARACTERISTIC F_TSFADAFUELLOPT_E "Faktor für Schnellfüllzeitadaptionswert opt. Befüllung" VALUE 0x26E56A kw_ui8_S6_S3 1 UMR___1_100_0_S6_S3 0 1 /end CHARACTERISTIC
/begin CHARACTERISTIC F_TSFADAFUELLRED_E "Faktor für Schnellfüllzeitadaptionswert red. Befüllung" VALUE 0x26E56B kw_ui8_S6_S3 2 UMR___1_100_0_S6_S3 0 2 /end CHARACTERISTIC
/begin CHARACTERISTIC KL_FPFCGADAFUELLRED_E "Faktor für Fülldruckadaptionswert red. Befüllung" CURVE 0x226BBC kl_ui8_S6_S3 1 UMR___1_100_0_S6_S3 0 1
 /begin AXIS_DESCR STD_AXIS zff_atsys._.iSignale._.obj.sig_c_getr UMR_GRADC__1_1_M40_S6_S3 4 -40 150 DEPOSIT ABSOLUTE MONOTONY MON_INCREASE /end AXIS_DESCR
/end CHARACTERISTIC
/begin CHARACTERISTIC KF_TO1SFCG_E "Schnellfüllzeitoffset erste Befüllung" MAP 0x226BC8 kf_si16_S6_S3 2550 UMR_MSEC__1_1_0_S6_S3 -1280 1270
 /begin AXIS_DESCR STD_AXIS zff_atsys._.iSignale._.obj.sig_c_getr UMR_GRADC__1_1_M40_S6_S3 10 -40 150 DEPOSIT ABSOLUTE MONOTONY MON_INCREASE /end AXIS_DESCR
 /begin AXIS_DESCR STD_AXIS iItfInput.c_getrabst UMR_GRADC__1_1_M40_S6_S3 6 -40 150 DEPOSIT ABSOLUTE MONOTONY MON_INCREASE /end AXIS_DESCR
/end CHARACTERISTIC
/begin CHARACTERISTIC T_O1SFAUSSB_E "Schnellfüllzeitoffset erste Befüllung nach Neustart aus Standby" VALUE 0x26D69E kw_si16_S6_S3 1270 UMR_MSEC__1_1_0_S6_S3 0 1270 /end CHARACTERISTIC
/begin CHARACTERISTIC KL_TTOTFUELL_E "Totzeit" CURVE 0x226C68 kl_ui8_S6_S3 2000 UMR_MSEC__10_1_0_S6_S3 0 2000
 /begin AXIS_DESCR STD_AXIS zff_atsys._.iSignale._.obj.sig_c_getr UMR_GRADC__1_1_M40_S6_S3 5 -40 150 DEPOSIT ABSOLUTE MONOTONY MON_INCREASE /end AXIS_DESCR
/end CHARACTERISTIC
/begin CHARACTERISTIC KF_TENTLEER_E "Entleerzeit der Kupplung" MAP 0x226C78 kf_ui16_S6_S3 20000 UMR_MSEC__10_1_0_S6_S3 0 20000
 /begin AXIS_DESCR STD_AXIS zff_atsys._.iSignale._.obj.sig_c_getr UMR_GRADC__1_1_M40_S6_S3 10 -40 150 DEPOSIT ABSOLUTE MONOTONY MON_INCREASE /end AXIS_DESCR
 /begin AXIS_DESCR STD_AXIS NO_INPUT_QUANTITY UMR_U_MIN_1_1_0_S6_S3 8 0 11000 DEPOSIT ABSOLUTE MONOTONY MON_INCREASE /end AXIS_DESCR
/end CHARACTERISTIC
/begin CHARACTERISTIC KF_TOENTLEERCGADA_E "Entleerzeit der Kupplung" MAP 0x226D44 kf_si16_S6_S3 21000 UMR_MSEC__10_1_0_S6_S3 -1000 20000
 /begin AXIS_DESCR STD_AXIS zff_atsys._.iSignale._.obj.sig_c_getr UMR_GRADC__1_1_M40_S6_S3 8 -40 150 DEPOSIT ABSOLUTE MONOTONY MON_INCREASE /end AXIS_DESCR
 /begin AXIS_DESCR STD_AXIS NO_INPUT_QUANTITY UMR_MSEC__1_1_0_S6_S3 6 -32768 32767 DEPOSIT ABSOLUTE MONOTONY MON_INCREASE /end AXIS_DESCR
/end CHARACTERISTIC
/begin CHARACTERISTIC TOENTLEERSR_E "Offset auf Entleerzeit bei aktiver Stromrampe" VALUE 0x26D6A0 kw_si16_S6_S3 2000 UMR_MSEC__1_1_0_S6_S3 0 2000 /end CHARACTERISTIC
/begin CHARACTERISTIC PO_KOLBENPOSKOR_E "Druckoffset für Start timer_kolbenpos_kor" VALUE 0x26D6A2 kw_ui16_S6_S3 2 UMR_BAR__1_1000_0_S6_S3 0 2 /end CHARACTERISTIC
/begin CHARACTERISTIC KL_FKOLBENPOSCGKOR_E "Faktor auf Basiskolbenposition" CURVE 0x226DC8 kl_ui8_S6_S3 1 UMR___1_100_0_S6_S3 1 2
 /begin AXIS_DESCR STD_AXIS zff_atsys._.iSignale._.obj.sig_c_getr UMR_GRADC__1_1_M40_S6_S3 4 -40 150 DEPOSIT ABSOLUTE MONOTONY MON_INCREASE /end AXIS_DESCR
/end CHARACTERISTIC
/begin CHARACTERISTIC KF_FKOLBENPOSKOR_E "Faktor auf Basiskolbenposition" MAP 0x226DD4 kf_si16_S6_S3 1 UMR___1_100_0_S6_S3 0 1
 /begin AXIS_DESCR STD_AXIS NO_INPUT_QUANTITY UMR_MSEC__10_1_0_S6_S3 6 0 2550 DEPOSIT ABSOLUTE MONOTONY MON_INCREASE /end AXIS_DESCR
 /begin AXIS_DESCR STD_AXIS NO_INPUT_QUANTITY UMR_MSEC__1_1_0_S6_S3 4 -32768 32767 DEPOSIT ABSOLUTE MONOTONY MON_INCREASE /end AXIS_DESCR
/end CHARACTERISTIC
/begin CHARACTERISTIC PO_KOLBENPOSKORGA_E "Druckoffset bei GA für Start timer_kolbenpos_kor" VALUE 0x26D6A4 kw_ui16_S6_S3 2 UMR_BAR__1_1000_0_S6_S3 0 2 /end CHARACTERISTIC
/begin CHARACTERISTIC KF_FKOLBENPOSKORGA_E "Faktor auf Basiskolbenposition bei GA" MAP 0x226E20 kf_si16_S6_S3 1 UMR___1_100_0_S6_S3 0 1
 /begin AXIS_DESCR STD_AXIS NO_INPUT_QUANTITY UMR_MSEC__10_1_0_S6_S3 6 0 2550 DEPOSIT ABSOLUTE MONOTONY MON_INCREASE /end AXIS_DESCR
 /begin AXIS_DESCR STD_AXIS NO_INPUT_QUANTITY UMR_MSEC__1_1_0_S6_S3 4 -32768 32767 DEPOSIT ABSOLUTE MONOTONY MON_INCREASE /end AXIS_DESCR
/end CHARACTERISTIC
/begin CHARACTERISTIC KL_PFHYSCG_E "Fülldruckhysterese" CURVE 0x226E6C kl_si16_S6_S3 12.7 UMR_BAR__1_1000_0_S6_S3 0 12.7
 /begin AXIS_DESCR STD_AXIS zff_atsys._.iSignale._.obj.sig_c_getr UMR_GRADC__1_1_M40_S6_S3 10 -40 150 DEPOSIT ABSOLUTE MONOTONY MON_INCREASE /end AXIS_DESCR
/end CHARACTERISTIC
/begin CHARACTERISTIC KL_TVCGSAENDHS_E "Verzoegerungszeit für Umstellung auf Schaltungsende bei HS" CURVE 0x226E98 kl_ui8_S6_S3 2000 UMR_MSEC__10_1_0_S6_S3 0 2000
 /begin AXIS_DESCR STD_AXIS zff_atsys._.iSignale._.obj.sig_c_getr UMR_GRADC__1_1_M40_S6_S3 3 -40 150 DEPOSIT ABSOLUTE MONOTONY MON_INCREASE /end AXIS_DESCR
/end CHARACTERISTIC
/begin CHARACTERISTIC KL_TVCGSAENDRS_E "Verzoegerungszeit für Umstellung auf Schaltungsende bei RS" CURVE 0x226EA4 kl_ui8_S6_S3 2000 UMR_MSEC__10_1_0_S6_S3 0 2000
 /begin AXIS_DESCR STD_AXIS zff_atsys._.iSignale._.obj.sig_c_getr UMR_GRADC__1_1_M40_S6_S3 3 -40 150 DEPOSIT ABSOLUTE MONOTONY MON_INCREASE /end AXIS_DESCR
/end CHARACTERISTIC
/begin CHARACTERISTIC KL_TVCGSAENDGE_E "Verzoegerungszeit für Umstellung auf Schaltungsende bei GE" CURVE 0x226EB0 kl_ui8_S6_S3 2000 UMR_MSEC__10_1_0_S6_S3 0 2000
 /begin AXIS_DESCR STD_AXIS zff_atsys._.iSignale._.obj.sig_c_getr UMR_GRADC__1_1_M40_S6_S3 3 -40 150 DEPOSIT ABSOLUTE MONOTONY MON_INCREASE /end AXIS_DESCR
/end CHARACTERISTIC
/begin CHARACTERISTIC TO_ABBRUCHSAEND_E "Offset auf Verzoegerungszeit zur Umstellung auf Schaltungsende" VALUE 0x26E56C kw_si8_S6_S3 2000 UMR_MSEC__10_1_0_S6_S3 -1000 1000 /end CHARACTERISTIC
/begin CHARACTERISTIC KL_PFCGGA_E "Fülldruck bei Gangauslegen" CURVE 0x226EBC kl_si16_S6_S3 12.75 UMR_BAR__1_1000_0_S6_S3 0 12.75
 /begin AXIS_DESCR STD_AXIS zff_atsys._.iSignale._.obj.sig_c_getr UMR_GRADC__1_1_M40_S6_S3 10 -40 150 DEPOSIT ABSOLUTE MONOTONY MON_INCREASE /end AXIS_DESCR
/end CHARACTERISTIC
/begin CHARACTERISTIC KL_PKUPPSTROM_E "Druckwert für Stromschleife" CURVE 0x226EE8 kl_ui16_S6_S3 5 UMR_BAR__1_1000_0_S6_S3 0 5
 /begin AXIS_DESCR STD_AXIS zff_atsys._.iSignale._.obj.sig_c_getr UMR_GRADC__1_1_M40_S6_S3 4 -40 150 DEPOSIT ABSOLUTE MONOTONY MON_INCREASE /end AXIS_DESCR
/end CHARACTERISTIC
/begin CHARACTERISTIC KL_PFCG_E "Fülldruck" CURVE 0x226EFC kl_si16_S6_S3 12.75 UMR_BAR__1_1000_0_S6_S3 0 12.75
 /begin AXIS_DESCR STD_AXIS zff_atsys._.iSignale._.obj.sig_c_getr UMR_GRADC__1_1_M40_S6_S3 10 -40 150 DEPOSIT ABSOLUTE MONOTONY MON_INCREASE /end AXIS_DESCR
/end CHARACTERISTIC
/begin CHARACTERISTIC IGKABENTLEER_E "Gradient Stromrampe Kupplung entleeren" VALUE 0x26D6A6 kw_si16_S6_S3 200 UMR_A_SEC_1_10_0_S6_S3 -100 100 /end CHARACTERISTIC
/begin CHARACTERISTIC KL_TFPWIRK_K0 "Filterzeit für Kupplungswirkdruck in ms" CURVE 0x226F28 kl_ui8_S6_S3 254 UMR_MSEC__1_1_0_S6_S3 0 254
 /begin AXIS_DESCR STD_AXIS zff_atsys._.iSignale._.obj.sig_c_getr UMR_GRADC__1_1_M40_S6_S3 3 -40 150 DEPOSIT ABSOLUTE MONOTONY MON_INCREASE /end AXIS_DESCR
/end CHARACTERISTIC
/begin CHARACTERISTIC KF_PSFCGMT_K0 "Kennfeld Schnellfülldruck" MAP 0x226F34 kf_si16_S6_S3 12.75 UMR_BAR__1_1000_0_S6_S3 0 12.75
 /begin AXIS_DESCR STD_AXIS zff_atsys._.iSignale._.obj.sig_c_getr UMR_GRADC__1_1_M40_S6_S3 8 -40 150 DEPOSIT ABSOLUTE MONOTONY MON_INCREASE /end AXIS_DESCR
 /begin AXIS_DESCR STD_AXIS zff_atsys._.iSignale._.obj.sig_m_t8 UMR_NM__8_1_M50_S6_S3 4 -400 1640 DEPOSIT ABSOLUTE MONOTONY MON_INCREASE /end AXIS_DESCR
/end CHARACTERISTIC
/begin CHARACTERISTIC KF_PSFCGMTFUELLRED_K0 "Kennfeld Schnellfülldruck" MAP 0x226F94 kf_si16_S6_S3 12.75 UMR_BAR__1_1000_0_S6_S3 0 12.75
 /begin AXIS_DESCR STD_AXIS zff_atsys._.iSignale._.obj.sig_c_getr UMR_GRADC__1_1_M40_S6_S3 8 -40 150 DEPOSIT ABSOLUTE MONOTONY MON_INCREASE /end AXIS_DESCR
 /begin AXIS_DESCR STD_AXIS zff_atsys._.iSignale._.obj.sig_m_t8 UMR_NM__8_1_M50_S6_S3 4 -400 1640 DEPOSIT ABSOLUTE MONOTONY MON_INCREASE /end AXIS_DESCR
/end CHARACTERISTIC
/begin CHARACTERISTIC KF_PSFCGMTFUELLOPT_K0 "Kennfeld Schnellfülldruck" MAP 0x226FF4 kf_si16_S6_S3 12.75 UMR_BAR__1_1000_0_S6_S3 0 12.75
 /begin AXIS_DESCR STD_AXIS zff_atsys._.iSignale._.obj.sig_c_getr UMR_GRADC__1_1_M40_S6_S3 8 -40 150 DEPOSIT ABSOLUTE MONOTONY MON_INCREASE /end AXIS_DESCR
 /begin AXIS_DESCR STD_AXIS zff_atsys._.iSignale._.obj.sig_m_t8 UMR_NM__8_1_M50_S6_S3 4 -400 1640 DEPOSIT ABSOLUTE MONOTONY MON_INCREASE /end AXIS_DESCR
/end CHARACTERISTIC
/begin CHARACTERISTIC KF_POSFCGNAB_K0 "Kennfeld Schnellfülldruckoffset" MAP 0x227054 kf_si16_S6_S3 5 UMR_BAR__1_1000_0_S6_S3 -5 0
 /begin AXIS_DESCR STD_AXIS zff_atsys._.iSignale._.obj.sig_c_getr UMR_GRADC__1_1_M40_S6_S3 2 -40 150 DEPOSIT ABSOLUTE MONOTONY MON_INCREASE /end AXIS_DESCR
 /begin AXIS_DESCR STD_AXIS zff_atsys._.iSignale._.obj.sig_n_ab8 UMR_U_MIN_32_1_0_S6_S3 2 0 8160 DEPOSIT ABSOLUTE MONOTONY MON_INCREASE /end AXIS_DESCR
/end CHARACTERISTIC
/begin CHARACTERISTIC KL_TSFCG_K0 "Schnellfüllzeit" CURVE 0x22706C kl_ui16_S6_S3 2540 UMR_MSEC__1_1_0_S6_S3 0 2540
 /begin AXIS_DESCR STD_AXIS zff_atsys._.iSignale._.obj.sig_c_getr UMR_GRADC__1_1_M40_S6_S3 10 -40 150 DEPOSIT ABSOLUTE MONOTONY MON_INCREASE /end AXIS_DESCR
/end CHARACTERISTIC
/begin CHARACTERISTIC KL_TSFCGFUELLRED_K0 "Schnellfüllzeit reduzierte Befüllung" CURVE 0x227098 kl_ui16_S6_S3 2540 UMR_MSEC__1_1_0_S6_S3 0 2540
 /begin AXIS_DESCR STD_AXIS zff_atsys._.iSignale._.obj.sig_c_getr UMR_GRADC__1_1_M40_S6_S3 10 -40 150 DEPOSIT ABSOLUTE MONOTONY MON_INCREASE /end AXIS_DESCR
/end CHARACTERISTIC
/begin CHARACTERISTIC KL_TSFCGFUELLOPT_K0 "Schnellfüllzeit optimierte Befüllung" CURVE 0x2270C4 kl_ui16_S6_S3 2540 UMR_MSEC__1_1_0_S6_S3 0 2540
 /begin AXIS_DESCR STD_AXIS zff_atsys._.iSignale._.obj.sig_c_getr UMR_GRADC__1_1_M40_S6_S3 10 -40 150 DEPOSIT ABSOLUTE MONOTONY MON_INCREASE /end AXIS_DESCR
/end CHARACTERISTIC
/begin CHARACTERISTIC KL_TOSFNK_K0 "Schnellfüllzeitoffset" CURVE 0x2270F0 kl_si16_S6_S3 3540 UMR_MSEC__1_1_0_S6_S3 -1000 2540
 /begin AXIS_DESCR STD_AXIS NO_INPUT_QUANTITY UMR_U_MIN_1_1_0_S6_S3 8 0 11000 DEPOSIT ABSOLUTE MONOTONY MON_INCREASE /end AXIS_DESCR
/end CHARACTERISTIC
/begin CHARACTERISTIC KL_TOSFNKFUELLRED_K0 "Schnellfüllzeitoffset reduzierte Befüllung" CURVE 0x227114 kl_si16_S6_S3 3540 UMR_MSEC__1_1_0_S6_S3 -1000 2540
 /begin AXIS_DESCR STD_AXIS NO_INPUT_QUANTITY UMR_U_MIN_1_1_0_S6_S3 8 0 11000 DEPOSIT ABSOLUTE MONOTONY MON_INCREASE /end AXIS_DESCR
/end CHARACTERISTIC
/begin CHARACTERISTIC KL_TOSFNKFUELLOPT_K0 "Schnellfüllzeitoffset optimierte Befüllung" CURVE 0x227138 kl_si16_S6_S3 3540 UMR_MSEC__1_1_0_S6_S3 -1000 2540
 /begin AXIS_DESCR STD_AXIS NO_INPUT_QUANTITY UMR_U_MIN_1_1_0_S6_S3 8 0 11000 DEPOSIT ABSOLUTE MONOTONY MON_INCREASE /end AXIS_DESCR
/end CHARACTERISTIC
/begin CHARACTERISTIC F_TSFADAFUELLOPT_K0 "Faktor für Schnellfüllzeitadaptionswert opt. Befüllung" VALUE 0x26E56D kw_ui8_S6_S3 1 UMR___1_100_0_S6_S3 0 1 /end CHARACTERISTIC
/begin CHARACTERISTIC F_TSFADAFUELLRED_K0 "Faktor für Schnellfüllzeitadaptionswert red. Befüllung" VALUE 0x26E56E kw_ui8_S6_S3 2 UMR___1_100_0_S6_S3 0 2 /end CHARACTERISTIC
/begin CHARACTERISTIC KL_FPFCGADAFUELLRED_K0 "Faktor für Fülldruckadaptionswert red. Befüllung" CURVE 0x22715C kl_ui8_S6_S3 1 UMR___1_100_0_S6_S3 0 1
 /begin AXIS_DESCR STD_AXIS zff_atsys._.iSignale._.obj.sig_c_getr UMR_GRADC__1_1_M40_S6_S3 4 -40 150 DEPOSIT ABSOLUTE MONOTONY MON_INCREASE /end AXIS_DESCR
/end CHARACTERISTIC
/begin CHARACTERISTIC KF_TO1SFCG_K0 "Schnellfüllzeitoffset erste Befüllung" MAP 0x227168 kf_si16_S6_S3 2550 UMR_MSEC__1_1_0_S6_S3 -1280 1270
 /begin AXIS_DESCR STD_AXIS zff_atsys._.iSignale._.obj.sig_c_getr UMR_GRADC__1_1_M40_S6_S3 10 -40 150 DEPOSIT ABSOLUTE MONOTONY MON_INCREASE /end AXIS_DESCR
 /begin AXIS_DESCR STD_AXIS iItfInput.c_getrabst UMR_GRADC__1_1_M40_S6_S3 6 -40 150 DEPOSIT ABSOLUTE MONOTONY MON_INCREASE /end AXIS_DESCR
/end CHARACTERISTIC
/begin CHARACTERISTIC T_O1SFAUSSB_K0 "Schnellfüllzeitoffset erste Befüllung nach Neustart aus Standby" VALUE 0x26D6A8 kw_si16_S6_S3 1270 UMR_MSEC__1_1_0_S6_S3 0 1270 /end CHARACTERISTIC
/begin CHARACTERISTIC KL_TTOTFUELL_K0 "Totzeit" CURVE 0x227208 kl_ui8_S6_S3 2000 UMR_MSEC__10_1_0_S6_S3 0 2000
 /begin AXIS_DESCR STD_AXIS zff_atsys._.iSignale._.obj.sig_c_getr UMR_GRADC__1_1_M40_S6_S3 5 -40 150 DEPOSIT ABSOLUTE MONOTONY MON_INCREASE /end AXIS_DESCR
/end CHARACTERISTIC
/begin CHARACTERISTIC KF_TENTLEER_K0 "Entleerzeit der Kupplung" MAP 0x227218 kf_ui16_S6_S3 20000 UMR_MSEC__10_1_0_S6_S3 0 20000
 /begin AXIS_DESCR STD_AXIS zff_atsys._.iSignale._.obj.sig_c_getr UMR_GRADC__1_1_M40_S6_S3 10 -40 150 DEPOSIT ABSOLUTE MONOTONY MON_INCREASE /end AXIS_DESCR
 /begin AXIS_DESCR STD_AXIS NO_INPUT_QUANTITY UMR_U_MIN_1_1_0_S6_S3 8 0 11000 DEPOSIT ABSOLUTE MONOTONY MON_INCREASE /end AXIS_DESCR
/end CHARACTERISTIC
/begin CHARACTERISTIC KF_TOENTLEERCGADA_K0 "Entleerzeit der Kupplung" MAP 0x2272E4 kf_si16_S6_S3 21000 UMR_MSEC__10_1_0_S6_S3 -1000 20000
 /begin AXIS_DESCR STD_AXIS zff_atsys._.iSignale._.obj.sig_c_getr UMR_GRADC__1_1_M40_S6_S3 8 -40 150 DEPOSIT ABSOLUTE MONOTONY MON_INCREASE /end AXIS_DESCR
 /begin AXIS_DESCR STD_AXIS NO_INPUT_QUANTITY UMR_MSEC__1_1_0_S6_S3 6 -32768 32767 DEPOSIT ABSOLUTE MONOTONY MON_INCREASE /end AXIS_DESCR
/end CHARACTERISTIC
/begin CHARACTERISTIC TOENTLEERSR_K0 "Offset auf Entleerzeit bei aktiver Stromrampe" VALUE 0x26D6AA kw_si16_S6_S3 2000 UMR_MSEC__1_1_0_S6_S3 0 2000 /end CHARACTERISTIC
/begin CHARACTERISTIC PO_KOLBENPOSKOR_K0 "Druckoffset für Start timer_kolbenpos_kor" VALUE 0x26D6AC kw_ui16_S6_S3 2 UMR_BAR__1_1000_0_S6_S3 0 2 /end CHARACTERISTIC
/begin CHARACTERISTIC KL_FKOLBENPOSCGKOR_K0 "Faktor auf Basiskolbenposition" CURVE 0x227368 kl_ui8_S6_S3 1 UMR___1_100_0_S6_S3 1 2
 /begin AXIS_DESCR STD_AXIS zff_atsys._.iSignale._.obj.sig_c_getr UMR_GRADC__1_1_M40_S6_S3 4 -40 150 DEPOSIT ABSOLUTE MONOTONY MON_INCREASE /end AXIS_DESCR
/end CHARACTERISTIC
/begin CHARACTERISTIC KF_FKOLBENPOSKOR_K0 "Faktor auf Basiskolbenposition" MAP 0x227374 kf_si16_S6_S3 1 UMR___1_100_0_S6_S3 0 1
 /begin AXIS_DESCR STD_AXIS NO_INPUT_QUANTITY UMR_MSEC__10_1_0_S6_S3 6 0 2550 DEPOSIT ABSOLUTE MONOTONY MON_INCREASE /end AXIS_DESCR
 /begin AXIS_DESCR STD_AXIS NO_INPUT_QUANTITY UMR_MSEC__1_1_0_S6_S3 4 -32768 32767 DEPOSIT ABSOLUTE MONOTONY MON_INCREASE /end AXIS_DESCR
/end CHARACTERISTIC
/begin CHARACTERISTIC PO_KOLBENPOSKORGA_K0 "Druckoffset bei GA für Start timer_kolbenpos_kor" VALUE 0x26D6AE kw_ui16_S6_S3 2 UMR_BAR__1_1000_0_S6_S3 0 2 /end CHARACTERISTIC
/begin CHARACTERISTIC KF_FKOLBENPOSKORGA_K0 "Faktor auf Basiskolbenposition bei GA" MAP 0x2273C0 kf_si16_S6_S3 1 UMR___1_100_0_S6_S3 0 1
 /begin AXIS_DESCR STD_AXIS NO_INPUT_QUANTITY UMR_MSEC__10_1_0_S6_S3 6 0 2550 DEPOSIT ABSOLUTE MONOTONY MON_INCREASE /end AXIS_DESCR
 /begin AXIS_DESCR STD_AXIS NO_INPUT_QUANTITY UMR_MSEC__1_1_0_S6_S3 4 -32768 32767 DEPOSIT ABSOLUTE MONOTONY MON_INCREASE /end AXIS_DESCR
/end CHARACTERISTIC
/begin CHARACTERISTIC KL_PFHYSCG_K0 "Fülldruckhysterese" CURVE 0x22740C kl_si16_S6_S3 12.7 UMR_BAR__1_1000_0_S6_S3 0 12.7
 /begin AXIS_DESCR STD_AXIS zff_atsys._.iSignale._.obj.sig_c_getr UMR_GRADC__1_1_M40_S6_S3 10 -40 150 DEPOSIT ABSOLUTE MONOTONY MON_INCREASE /end AXIS_DESCR
/end CHARACTERISTIC
/begin CHARACTERISTIC KL_PKUPPSTROM_K0 "Druckwert für Stromschleife" CURVE 0x227438 kl_ui16_S6_S3 5 UMR_BAR__1_1000_0_S6_S3 0 5
 /begin AXIS_DESCR STD_AXIS zff_atsys._.iSignale._.obj.sig_c_getr UMR_GRADC__1_1_M40_S6_S3 4 -40 150 DEPOSIT ABSOLUTE MONOTONY MON_INCREASE /end AXIS_DESCR
/end CHARACTERISTIC
/begin CHARACTERISTIC KF_PFCGNMOT_K0 "Fülldruck" MAP 0x22744C kf_si16_S6_S3 12.75 UMR_BAR__1_1000_0_S6_S3 0 12.75
 /begin AXIS_DESCR STD_AXIS zff_atsys._.iSignale._.obj.sig_c_getr UMR_GRADC__1_1_M40_S6_S3 10 -40 150 DEPOSIT ABSOLUTE MONOTONY MON_INCREASE /end AXIS_DESCR
 /begin AXIS_DESCR STD_AXIS zff_atsys._.iSignale._.obj.sig_n_mot UMR_U_MIN_1_1_0_S6_S3 4 0 8160 DEPOSIT ABSOLUTE MONOTONY MON_INCREASE /end AXIS_DESCR
/end CHARACTERISTIC
/begin CHARACTERISTIC IGKABENTLEER_K0 "Gradient Stromrampe Kupplung entleeren" VALUE 0x26D6B0 kw_si16_S6_S3 200 UMR_A_SEC_1_10_0_S6_S3 -100 100 /end CHARACTERISTIC
/begin CHARACTERISTIC KL_TVPARKSPCGNP "Verzoegerung Zustand Parksperre eingelegt fuer N nach P" CURVE 0x234C10 kl_ui8_S6_S3 2500 UMR_MSEC__10_1_0_S6_S3 0 2500
 /begin AXIS_DESCR STD_AXIS zff_atsys._.iSignale._.obj.sig_c_getr UMR_GRADC__1_1_M40_S6_S3 4 -40 215 DEPOSIT ABSOLUTE MONOTONY MON_INCREASE /end AXIS_DESCR
/end CHARACTERISTIC
/begin CHARACTERISTIC T_VPARKSPPN "Verzoegerung Zustand Parksperre geloest fuer P nach N" VALUE 0x26E61E kw_ui8_S6_S3 2540 UMR_MSEC__10_1_0_S6_S3 0 2540 /end CHARACTERISTIC
/begin CHARACTERISTIC KL_TVPSEIN "Verzoegerungszeit für das Einlegen der Parksperre aus einer Kraftflußrichtung" CURVE 0x234C1C kl_ui8_S6_S3 2540 UMR_MSEC__10_1_0_S6_S3 0 2540
 /begin AXIS_DESCR STD_AXIS zff_atsys._.iSignale._.obj.sig_c_getr UMR_GRADC__1_1_M40_S6_S3 5 -40 150 DEPOSIT ABSOLUTE MONOTONY MON_INCREASE /end AXIS_DESCR
/end CHARACTERISTIC
/begin CHARACTERISTIC T_MINOUT11 "Mindestzeit Ansteuerung Parksperrenmagnet" VALUE 0x26E61F kw_ui8_S6_S3 1000 UMR_MSEC__10_1_0_S6_S3 0 1000 /end CHARACTERISTIC
/begin CHARACTERISTIC T_MAXOUT11 "Maximalzeit Ansteuerung Parksperrenmagnet" VALUE 0x26D86E kw_ui16_S6_S3 299 UMR_SEC__1_1_0_S6_S3 1 300 /end CHARACTERISTIC
/begin CHARACTERISTIC PS_BRTVPSEIN "Druckschwelle fuer Anwendung der Verzoegerungszeit KL_TVPSEIN" VALUE 0x26D870 kw_si16_S6_S3 200 UMR_BAR__1_1_0_S6_S3 0 200 /end CHARACTERISTIC
/begin CHARACTERISTIC N_ABBRTVPSEIN "Abtriebsdrehzahlschwelle fuer die Fkt. Verzoegertes einlegen P" VALUE 0x26D872 kw_ui16_S6_S3 2000 UMR_U_MIN_1_1_0_S6_S3 0 2000 /end CHARACTERISTIC
/begin CHARACTERISTIC SWI_ADA_LOESCH "Auswahl-Switch um einzelne Adaspeicher zu loeschen" VALUE 0x26E3D5 kw_ui8_S6_S3 255 UMR___1_1_0_S6_S3 0 255 /end CHARACTERISTIC
/begin CHARACTERISTIC TAB_ADAVERSION "Versions-Nummer um einzelne Adaptionen zu loeschen" CURVE 0x21B59C tab_ui8_S6_S3 255 UMR___1_1_0_S6_S3 0 255
 /begin AXIS_DESCR FIX_AXIS iAdaGlosc.ada_version UMR___1_1_0_S6_S3 58 0 57 FIX_AXIS_PAR_DIST 0 1 58 /end AXIS_DESCR
/end CHARACTERISTIC
/begin CHARACTERISTIC SWI_VERSIONRG_SCHARF "Loeschen durch Versionierung aktiv" VALUE 0x26E3D6 kw_bool8_S6_S3 1 UMR___1_1_0_S6_S3 0 1 /end CHARACTERISTIC
/begin CHARACTERISTIC SWI_AXREF_ADAOFF "Schalter um Ada-Bew-Verbot durch Laengs-Beschleunigung zu aktivieren" VALUE 0x26E3D7 kw_bool8_S6_S3 1 UMR___1_1_0_S6_S3 0 1 /end CHARACTERISTIC
/begin CHARACTERISTIC AL_AXREF_ADAOFF "Schwelle um Ada-Bew-Verbot durch Laengs-Beschleunigung zu deaktivieren" VALUE 0x26E3D8 kw_ui8_S6_S3 5 UMR_M_SEC2_1_32_0_S6_S3 0 5 /end CHARACTERISTIC
/begin CHARACTERISTIC MPT_AXREF_ADAOFF "Filterkonstante fuer Laengs-Beschleunigung um Ada-Bew zu verbieten" VALUE 0x26E3D9 kw_ui8_S6_S3 1 UMR___1_100_0_S6_S3 0 1 /end CHARACTERISTIC
/begin CHARACTERISTIC TAB_SWI_SPS_ADAOFF "Aktivierung einiger Adaptionen in Abhaengigkeit des index_sps" CURVE 0x21B5DC tab_bool8_S6_S3 1 UMR___1_1_0_S6_S3 0 1
 /begin AXIS_DESCR FIX_AXIS zff_atsys._.iSignale._.obj.sig_index_sp_sps UMR___1_1_0_S6_S3 100 0 99 FIX_AXIS_PAR_DIST 0 1 100 /end AXIS_DESCR
/end CHARACTERISTIC
/begin CHARACTERISTIC SWI_PARTFILTAKTIV "Ada Abbruchkriterium Partikelfilter-Regeneration applizierbar" VALUE 0x26E3DA kw_bool8_S6_S3 1 UMR___1_1_0_S6_S3 0 1 /end CHARACTERISTIC
/begin CHARACTERISTIC TAB_SWI_ADKUPLEER "Switch zur Abschaltung von Adaptionen wenn die Kup. länger inaktiv war" CURVE 0x21B644 tab_bool8_S6_S3 1 UMR___1_1_0_S6_S3 0 1
 /begin AXIS_DESCR FIX_AXIS NO_INPUT_QUANTITY UMR___1_1_0_S6_S3 6 1 6 FIX_AXIS_PAR_DIST 1 1 6 /end AXIS_DESCR
/end CHARACTERISTIC
/begin CHARACTERISTIC TAB_BEW_VERBOT_MODUS_EM "EM Status abhaenige Adaptionsdeaktivierung. Jedem Bit von GET_MODUS_EM ist ein Wert Tabellen Index zugeordnet" CURVE 0x21B650 tab_bool8_S6_S3 1 UMR___1_1_0_S6_S3 0 1
 /begin AXIS_DESCR FIX_AXIS NO_INPUT_QUANTITY UMR___1_1_0_S6_S3 16 0 15 FIX_AXIS_PAR_DIST 0 1 16 /end AXIS_DESCR
/end CHARACTERISTIC
/begin CHARACTERISTIC CS_UN_ADAKALT "Untere Temperaturschwelle Adaptionsklasse kalt" VALUE 0x26E3DB kw_ui8_S6_S3 89 UMR_GRADC__1_1_M40_S6_S3 -40 49 /end CHARACTERISTIC
/begin CHARACTERISTIC CS_OB_ADAKALT "Obere Temperaturschwelle Adaptionsklasse kalt" VALUE 0x26E3DC kw_ui8_S6_S3 89 UMR_GRADC__1_1_M40_S6_S3 -40 49 /end CHARACTERISTIC
/begin CHARACTERISTIC CS_UN_ADAWARM "Untere Temperaturschwelle Adaptionsklasse warm" VALUE 0x26E3DD kw_ui8_S6_S3 100 UMR_GRADC__1_1_M40_S6_S3 50 150 /end CHARACTERISTIC
/begin CHARACTERISTIC CS_OB_ADAWARM "Obere Temperaturschwelle Adaptionsklasse warm" VALUE 0x26E3DE kw_ui8_S6_S3 100 UMR_GRADC__1_1_M40_S6_S3 50 150 /end CHARACTERISTIC
/begin CHARACTERISTIC MIN_TPADA_UEFIAE "Mindestanzahl TP-Adaptionen" VALUE 0x26E3F6 kw_ui8_S6_S3 100 UMR___1_1_0_S6_S3 0 100 /end CHARACTERISTIC
/begin CHARACTERISTIC SBAKLZ_ND_UEFIAE "Breitenfaktor Übersprechfunktion" VALUE 0x26E3F7 kw_ui8_S6_S3 1 UMR___1_100_0_S6_S3 0 1 /end CHARACTERISTIC
/begin CHARACTERISTIC TAB_STUETZ_ND_UEFIAE "Adaptionsklassen von nd_iae" CURVE 0x21B874 tab_si16_S6_S3 6000 UMR_U_MIN_1_1_0_S6_S3 -3000 3000
 /begin AXIS_DESCR FIX_AXIS NO_INPUT_QUANTITY UMR___1_1_0_S6_S3 6 0 5 FIX_AXIS_PAR_DIST 0 1 6 /end AXIS_DESCR
/end CHARACTERISTIC
/begin CHARACTERISTIC TAB_STUETZ_MSTELL_UEFIAE "Adaptionsklassen von m_stell_iae" CURVE 0x21B884 tab_si16_S6_S3 1000 UMR_NM__1_1_0_S6_S3 0 1000
 /begin AXIS_DESCR FIX_AXIS NO_INPUT_QUANTITY UMR___1_1_0_S6_S3 6 0 5 FIX_AXIS_PAR_DIST 0 1 6 /end AXIS_DESCR
/end CHARACTERISTIC
/begin CHARACTERISTIC MUE_KOR_MAX_UEFIAE "Max-Grenze für Adaptionsoffset" VALUE 0x26E3F8 kw_si8_S6_S3 100 UMR_NM_BAR_1_1_0_S6_S3 0 100 /end CHARACTERISTIC
/begin CHARACTERISTIC MUE_KOR_MIN_UEFIAE "Min-Grenze für Adaptionsoffset" VALUE 0x26E3F9 kw_si8_S6_S3 100 UMR_NM_BAR_1_1_0_S6_S3 -100 0 /end CHARACTERISTIC
/begin CHARACTERISTIC SWI_GE_APERK_IAE "Beschraenkung der APERK-Durchführung auf Wechsel aus INAKTIV, nach Gangeinlegen" VALUE 0x26E3DF kw_bool8_S6_S3 1 UMR___1_1_0_S6_S3 0 1 /end CHARACTERISTIC
/begin CHARACTERISTIC SWI_ADAIAE_KPLBINN "Schalter um den Ada-Wert fuer N zu Aktivieren IAE-APADA" VALUE 0x26E3E0 kw_bool8_S6_S3 1 UMR___1_1_0_S6_S3 0 1 /end CHARACTERISTIC
/begin CHARACTERISTIC SWI_APERK_IAE "Schalter zur Aktivierung und Aufschaltung der IAE-APADA" VALUE 0x26E3E1 kw_bool8_S6_S3 1 UMR___1_1_0_S6_S3 0 1 /end CHARACTERISTIC
/begin CHARACTERISTIC SWI_VORINFO_APERK_IAE "Vorabausgabe der Drehzahlanforderung der IAE-APADA" VALUE 0x26E3E2 kw_bool8_S6_S3 1 UMR___1_1_0_S6_S3 0 1 /end CHARACTERISTIC
/begin CHARACTERISTIC SWI_M_MOTIST_ADA_IAE "Korrektur Motor Ist Moment ueber Motortraegheit" VALUE 0x26E3E3 kw_bool8_S6_S3 1 UMR___1_1_0_S6_S3 0 1 /end CHARACTERISTIC
/begin CHARACTERISTIC ZIELGANG_APERK_IAE "IAE-APADA darf nur in diesem Gang durchgeführt werden" VALUE 0x26E3E4 kw_si8_S6_S3 9 UMR___1_1_0_S6_S3 -1 8 /end CHARACTERISTIC
/begin CHARACTERISTIC C_DELTA_MAX_APADA "Temperatur-Differenz als Eingangskriterium fuer IAE-APADA" VALUE 0x26E3E5 kw_ui8_S6_S3 100 UMR_GRADC__1_1_0_S6_S3 0 100 /end CHARACTERISTIC
/begin CHARACTERISTIC MS_MMOT_ABBRUCH_APERK_IAE "Momentenschwelle fuer max. zulaessiges Motor-Moment waehrend Prueframpe" VALUE 0x26E3E6 kw_ui8_S6_S3 100 UMR_NM__1_1_0_S6_S3 0 100 /end CHARACTERISTIC
/begin CHARACTERISTIC NS_NAB_ABBRUCH_APERK_IAE "Drehzahlschwelle Abbruch- und Startbedingung" VALUE 0x26D2FA kw_ui16_S6_S3 500 UMR_U_MIN_1_1_0_S6_S3 0 500 /end CHARACTERISTIC
/begin CHARACTERISTIC NS_MOTSOLL_LL_MIN_APERK_IAE "Mindest Leerlauf-Drehzahl AdaIae" VALUE 0x26D2FC kw_ui16_S6_S3 1000 UMR_U_MIN_1_1_0_S6_S3 0 1000 /end CHARACTERISTIC
/begin CHARACTERISTIC NDS_NMOTSOLL_LL_APERK_IAE "Max Abstand der Istdrehzahl zur Soll-LL Drehzahl" VALUE 0x26D2FE kw_ui16_S6_S3 1000 UMR_U_MIN_1_1_0_S6_S3 0 1000 /end CHARACTERISTIC
/begin CHARACTERISTIC MGS_ABS_MMOT_APERK_IAE "Betragsschwelle Momentengradient, Startbedingung" VALUE 0x26D300 kw_si16_S6_S3 100 UMR_NM_SEC_1_1_0_S6_S3 0 100 /end CHARACTERISTIC
/begin CHARACTERISTIC MGS_MOT_ABSENK_APERK_IAE "Schwelle Momentengradient fuer Ende der Absenkrampe" VALUE 0x26D302 kw_si16_S6_S3 200 UMR_NM_SEC_1_1_0_S6_S3 -100 100 /end CHARACTERISTIC
/begin CHARACTERISTIC NGS_ABS_NMOT_APERK_IAE "Betragsschwelle Drehzahlgradient, Startbedingung" VALUE 0x26D304 kw_si16_S6_S3 500 UMR_U_MIN_1_1_0_S6_S3 0 500 /end CHARACTERISTIC
/begin CHARACTERISTIC MO_STELL_ABBRUCH_APERK_IAE "Abbruch Differenz-Schwelle zu m_stell_start_ada_iae" VALUE 0x26D306 kw_si16_S6_S3 1000 UMR_NM__1_1_0_S6_S3 0 1000 /end CHARACTERISTIC
/begin CHARACTERISTIC PO_BREMS_ABBRUCH_APERK_IAE "Offset auf Bremsdruckschwelle, Abbruchkriterium" VALUE 0x26D308 kw_si16_S6_S3 100 UMR_BAR__1_100_0_S6_S3 0 100 /end CHARACTERISTIC
/begin CHARACTERISTIC PG_BREMS_ABBRUCH_APERK_IAE "Brems-Gradientenschwelle, Abbruchkriterium" VALUE 0x26D30A kw_si16_S6_S3 10000 UMR_BAR_SEC_1_1_0_S6_S3 -10000 0 /end CHARACTERISTIC
/begin CHARACTERISTIC T_WARTEN_APERK_IAE "Dauer der Signalprüfung vor Beginn der APERK" VALUE 0x26D30C kw_ui16_S6_S3 60000 UMR_MSEC__10_1_0_S6_S3 0 60000 /end CHARACTERISTIC
/begin CHARACTERISTIC T_MAXWARTEN_APERK_IAE "maximale Dauer der Signalprüfung vor Beginn der APERK" VALUE 0x26D30E kw_ui16_S6_S3 60000 UMR_MSEC__10_1_0_S6_S3 0 60000 /end CHARACTERISTIC
/begin CHARACTERISTIC T_HALTE_RAMPENINIT_APERK_IAE "Zeit der konstanten Ansteuerung wahrend Zustand -Prueframpe-" VALUE 0x26D310 kw_ui16_S6_S3 60000 UMR_MSEC__10_1_0_S6_S3 0 60000 /end CHARACTERISTIC
/begin CHARACTERISTIC T_HYSSCHLEIFE_APERK_IAE "Dauer der Hysschleife im Fall ANGELEGT" VALUE 0x26D312 kw_ui16_S6_S3 60000 UMR_MSEC__10_1_0_S6_S3 0 60000 /end CHARACTERISTIC
/begin CHARACTERISTIC TS_PRUEFEN_APERK_IAE "Maximale Verweilzeit im Zustand EINSTIEG_PRUEFEN" VALUE 0x26D314 kw_ui16_S6_S3 9990 UMR_MSEC__10_1_0_S6_S3 10 10000 /end CHARACTERISTIC
/begin CHARACTERISTIC T_SPERR_APERK_IAE "Sperrzeit zum Start der Adaption bei IAE Stillstand" VALUE 0x26D316 kw_ui16_S6_S3 10000 UMR_MSEC__10_1_0_S6_S3 0 10000 /end CHARACTERISTIC
/begin CHARACTERISTIC T_UEF_ABSENK_APERK_IAE "Dauer der Überführungsphase in ABSENKEN" VALUE 0x26E3E7 kw_ui8_S6_S3 1000 UMR_MSEC__10_1_0_S6_S3 0 1000 /end CHARACTERISTIC
/begin CHARACTERISTIC T_UEF_ABSENK_START_APERK_IAE "Dauer der Ueberführungsphase zum ABSENKEN" VALUE 0x26E3E8 kw_ui8_S6_S3 1000 UMR_MSEC__10_1_0_S6_S3 0 1000 /end CHARACTERISTIC
/begin CHARACTERISTIC MDS_MOT_APERK_IAE "Momentenschwelle Erkennungskriterium" VALUE 0x26D318 kw_si16_S6_S3 20 UMR_NM__1_1_0_S6_S3 0 20 /end CHARACTERISTIC
/begin CHARACTERISTIC MDS_MOT_INIT_APERK_IAE "Momentenschwelle Erkennungskriterium Konst-Phase" VALUE 0x26D31A kw_si16_S6_S3 100 UMR_NM__1_1_0_S6_S3 0 100 /end CHARACTERISTIC
/begin CHARACTERISTIC KL_PO_APERK_IAE "negativer Druck Offset fuer Ada-Wert Berechnung" CURVE 0x21B664 kl_si16_S6_S3 1 UMR_BAR__1_1000_0_S6_S3 -1 0
 /begin AXIS_DESCR STD_AXIS zff_atsys._.iSignale._.obj.sig_c_getr UMR_GRADC__1_1_M40_S6_S3 8 -40 215 DEPOSIT ABSOLUTE MONOTONY MON_INCREASE /end AXIS_DESCR
/end CHARACTERISTIC
/begin CHARACTERISTIC MG_MREF_APERK_IAE "Gradient zur Nachführung der Momentenreferenz" VALUE 0x26D31C kw_si16_S6_S3 100 UMR_NM_SEC_1_1_0_S6_S3 0 100 /end CHARACTERISTIC
/begin CHARACTERISTIC NG_NREF_APERK_IAE "Gradient zur Nachführung der Drehzahlreferenz" VALUE 0x26D31E kw_si16_S6_S3 100 UMR_U_MIN_1_1_0_S6_S3 -100 0 /end CHARACTERISTIC
/begin CHARACTERISTIC PG_NEG_ABBRUCH_APERK_IAE "Druckgradient Überführung im Abbruchfall, neg Richtung" VALUE 0x26D320 kw_si16_S6_S3 100 UMR_BAR_SEC_1_10_0_S6_S3 -100 0 /end CHARACTERISTIC
/begin CHARACTERISTIC PG_POS_ABBRUCH_APERK_IAE "Druckgradient Überführung im Abbruchfall, pos Richtung" VALUE 0x26D322 kw_si16_S6_S3 99.9 UMR_BAR_SEC_1_10_0_S6_S3 0.1 100 /end CHARACTERISTIC
/begin CHARACTERISTIC PG_NEG_HYS_APERK_IAE "Druckgradient Überführung im Erkennungsfall, neg Richtung" VALUE 0x26D324 kw_si16_S6_S3 100.1 UMR_BAR_SEC_1_10_0_S6_S3 -100 0.1 /end CHARACTERISTIC
/begin CHARACTERISTIC PG_POS_HYS_APERK_IAE "Druckgradient Überführung im Erkennungsfall, pos Richtung" VALUE 0x26D326 kw_si16_S6_S3 100 UMR_BAR_SEC_1_10_0_S6_S3 0 100 /end CHARACTERISTIC
/begin CHARACTERISTIC PG_PRUEF_APERK_IAE "Gradient der Testrampe" VALUE 0x26D328 kw_si16_S6_S3 10 UMR_BAR_SEC_1_1000_0_S6_S3 0 10 /end CHARACTERISTIC
/begin CHARACTERISTIC PO_HYSSCHLEIFE_APERK_IAE "Druckoffset der Hysschleife im Fall ANGELEGT" VALUE 0x26D32A kw_si16_S6_S3 20 UMR_BAR__1_1000_0_S6_S3 -10 10 /end CHARACTERISTIC
/begin CHARACTERISTIC KL_PO_RAMPENINIT_APERK_IAE "Druckoffset Rampenstartwert, relativ zu po_apada_eeprom" CURVE 0x21B688 kl_si16_S6_S3 2 UMR_BAR__1_1000_0_S6_S3 -1 1
 /begin AXIS_DESCR STD_AXIS NO_INPUT_QUANTITY UMR_NM__1_1_0_S6_S3 4 -400 1640 DEPOSIT ABSOLUTE MONOTONY MON_INCREASE /end AXIS_DESCR
/end CHARACTERISTIC
/begin CHARACTERISTIC PO_PRUEF_MAX_APERK_IAE "Druckoffset Rampenstartwert, relativ zu po_apada_eeprom" VALUE 0x26D32C kw_si16_S6_S3 10 UMR_BAR__1_1000_0_S6_S3 0 10 /end CHARACTERISTIC
/begin CHARACTERISTIC PO_ABSENK_APERK_IAE "Druckabsenkung in Zustand Abgesenkt, relativ zu po_apada_eeprom" VALUE 0x26D32E kw_si16_S6_S3 1 UMR_BAR__1_1000_0_S6_S3 -1 0 /end CHARACTERISTIC
/begin CHARACTERISTIC KL_UEF_ABSENK_APERK_IAE "Ueberfuehrung auf Startniveau der Ada-Rampe, relativ zu po_apada_eeprom" CURVE 0x21B69C kl_si16_S6_S3 1 UMR___1_100_0_S6_S3 0 1
 /begin AXIS_DESCR STD_AXIS NO_INPUT_QUANTITY UMR_MSEC__10_1_0_S6_S3 4 0 1000 DEPOSIT ABSOLUTE MONOTONY MON_INCREASE /end AXIS_DESCR
/end CHARACTERISTIC
/begin CHARACTERISTIC KL_UEF_ABSENK_START_APERK_IAE "Ueberfuehrung auf Absenk-Niveau" CURVE 0x21B6B0 kl_si16_S6_S3 1 UMR___1_100_0_S6_S3 0 1
 /begin AXIS_DESCR STD_AXIS NO_INPUT_QUANTITY UMR_MSEC__10_1_0_S6_S3 4 0 1000 DEPOSIT ABSOLUTE MONOTONY MON_INCREASE /end AXIS_DESCR
/end CHARACTERISTIC
/begin CHARACTERISTIC KL_FD_APADA_IAE "Daempfungsfaktor Abh. von Anzahl Bewertungen" CURVE 0x21B6C4 kl_ui16_S6_S3 1 UMR___1_100_0_S6_S3 0 1
 /begin AXIS_DESCR STD_AXIS NO_INPUT_QUANTITY UMR___1_1_0_S6_S3 5 0 65535 DEPOSIT ABSOLUTE MONOTONY MON_INCREASE /end AXIS_DESCR
/end CHARACTERISTIC
/begin CHARACTERISTIC KL_CTRSTART_APERK_IAE "Zaehlerschwelle zur Aktivierung der Ada" CURVE 0x21B6DC kl_ui16_S6_S3 10000 UMR___1_1_0_S6_S3 0 10000
 /begin AXIS_DESCR STD_AXIS NO_INPUT_QUANTITY UMR___1_1_0_S6_S3 4 0 65535 DEPOSIT ABSOLUTE MONOTONY MON_INCREASE /end AXIS_DESCR
/end CHARACTERISTIC
/begin CHARACTERISTIC F_BEWCTR_APERK_IAE "Bewertungsfaktor zur Auswahl, welche Adaption aktiv wird" VALUE 0x26E3E9 kw_ui8_S6_S3 100 UMR___1_1_0_S6_S3 0 100 /end CHARACTERISTIC
/begin CHARACTERISTIC KL_CGETR_MIN_APADA_IAE "untere Temp-Schwelle in Abh. von Anzahl Bewertungen" CURVE 0x21B6F0 kl_ui16_S6_S3 140 UMR_GRADC__1_1_M40_S6_S3 -40 100
 /begin AXIS_DESCR STD_AXIS NO_INPUT_QUANTITY UMR___1_1_0_S6_S3 4 0 65535 DEPOSIT ABSOLUTE MONOTONY MON_INCREASE /end AXIS_DESCR
/end CHARACTERISTIC
/begin CHARACTERISTIC CGETR_MAX_APADA_IAE "obere Temp-Schwelle" VALUE 0x26E3EA kw_ui8_S6_S3 215 UMR_GRADC__1_1_M40_S6_S3 0 215 /end CHARACTERISTIC
/begin CHARACTERISTIC PO_TABMAX_APADA_IAE "Obere Grenze fuer Ada-Wert" VALUE 0x26D330 kw_si16_S6_S3 20 UMR_BAR__1_1000_0_S6_S3 0 20 /end CHARACTERISTIC
/begin CHARACTERISTIC PO_TABMIN_APADA_IAE "Untere Grenze fuer Ada-Wert" VALUE 0x26D332 kw_si16_S6_S3 20 UMR_BAR__1_1000_0_S6_S3 -20 0 /end CHARACTERISTIC
/begin CHARACTERISTIC PO_DELTA_MAX_APADA_IAE "Maximale Aenderung eines Ada-Wertes" VALUE 0x26D334 kw_si16_S6_S3 1 UMR_BAR__1_1000_0_S6_S3 0 1 /end CHARACTERISTIC
/begin CHARACTERISTIC KL_PO_NEG_APERK_IAE "Abzug bei zu hoch erkanntem Touchpoint" CURVE 0x21B704 kl_si16_S6_S3 1 UMR_BAR__1_1000_0_S6_S3 -1 0
 /begin AXIS_DESCR STD_AXIS NO_INPUT_QUANTITY UMR_NM__1_1_0_S6_S3 4 0 100 DEPOSIT ABSOLUTE MONOTONY MON_INCREASE /end AXIS_DESCR
/end CHARACTERISTIC
/begin CHARACTERISTIC CS_MAXDRIFT_APADA_IAE "maximale zulaessige Temp- Aenderung waehrend Prueframpe" VALUE 0x26E3EB kw_ui8_S6_S3 200 UMR_GRADC__1_1_0_S6_S3 0 200 /end CHARACTERISTIC
/begin CHARACTERISTIC VPS_MAX_KUEHL_APERK_IAE "Max-Schwelle der B-Kuehlung zum Start der IAE-Ada" VALUE 0x26D336 kw_si16_S6_S3 30 UMR_LITER_MIN_1_10_0_S6_S3 0 30 /end CHARACTERISTIC
/begin CHARACTERISTIC MPT_NMOT_APERK_IAE "Filterzeitkonstante n_mot der IAE-Ada" VALUE 0x26E3EC kw_ui8_S6_S3 0.99 UMR___1_100_0_S6_S3 0.01 1 /end CHARACTERISTIC
/begin CHARACTERISTIC MPT_NMOT_FF_APERK_IAE "Filterzeitkonstante n_mot der IAE-Ada (Floatfilter)" VALUE 0x26E3ED kw_ui8_S6_S3 0.99 UMR___1_100_0_S6_S3 0.01 1 /end CHARACTERISTIC
/begin CHARACTERISTIC MPT_MMOTIST_APERK_IAE "Filterzeitkonstante m_motist der IAE-Ada" VALUE 0x26E3EE kw_ui8_S6_S3 0.99 UMR___1_100_0_S6_S3 0.01 1 /end CHARACTERISTIC
/begin CHARACTERISTIC MPT_MMOTIST_FF_APERK_IAE "Filterzeitkonstante m_motist der IAE-Ada (Floatfilter)" VALUE 0x26E3EF kw_ui8_S6_S3 0.99 UMR___1_100_0_S6_S3 0.01 1 /end CHARACTERISTIC
/begin CHARACTERISTIC MDT_MGMOTIST_APERK_IAE "Filterzeitkonstante der Gradientenbildung Momentengradient mg_motist_ada_iae" VALUE 0x26E3F0 kw_ui8_S6_S3 1 UMR___1_100_0_S6_S3 0 1 /end CHARACTERISTIC
/begin CHARACTERISTIC MDT_NGMOT_APERK_IAE "Filterzeitkonstante der Gradientenbildung Drehzahlgradient ng_mot_ada_iae" VALUE 0x26E3F1 kw_ui8_S6_S3 1 UMR___1_100_0_S6_S3 0 1 /end CHARACTERISTIC
/begin CHARACTERISTIC T_PT2_MGMOTIST_APERK_IAE "Filterzeitkonstante der Gradientenbildung PT2 Momentengradient mg_motist_ada_iae" VALUE 0x21B718 kw_fl32_S6_S3 3.97 UMR_SEC__1_1_0_S6_S3 0.03 4 FORMAT "%5.3" /end CHARACTERISTIC
/begin CHARACTERISTIC T_PT2_NGMOT_APERK_IAE "Filterzeitkonstante der Gradientenbildung PT2 Drehzahlgradient ng_mot_ada_iae" VALUE 0x21B71C kw_fl32_S6_S3 3.97 UMR_SEC__1_1_0_S6_S3 0.03 4 FORMAT "%5.3" /end CHARACTERISTIC
/begin CHARACTERISTIC TAB_NDS_NMOT_ABBRUCH_APERK_IAE "n_mot Abbruch-Schwelle der IAE Ada - Abhaengig vom IAE-Modus" CURVE 0x21B720 tab_si16_S6_S3 2000 UMR_U_MIN_1_1_0_S6_S3 -1000 1000
 /begin AXIS_DESCR FIX_AXIS NO_INPUT_QUANTITY UMR___1_1_0_S6_S3 3 0 2 FIX_AXIS_PAR_DIST 0 1 3 /end AXIS_DESCR
/end CHARACTERISTIC
/begin CHARACTERISTIC TAB_Z_MODUS_IAE_APERK_IAE "Aktivierung der Ada in Abhaengigkeit der Hybrid Betriebsart" CURVE 0x21B72C tab_bool8_S6_S3 1 UMR___1_1_0_S6_S3 0 1
 /begin AXIS_DESCR FIX_AXIS NO_INPUT_QUANTITY UMR___1_1_0_S6_S3 3 0 2 FIX_AXIS_PAR_DIST 0 1 3 /end AXIS_DESCR
/end CHARACTERISTIC
/begin CHARACTERISTIC MS_LLPRUEF_APERK_IAE "Momentenschwelle Schleppmoment Motor-Pruefung (IAE-Ada)" VALUE 0x26E3F2 kw_si8_S6_S3 200 UMR_NM__1_1_0_S6_S3 -100 100 /end CHARACTERISTIC
/begin CHARACTERISTIC T_RUN_LLPRUEF_APERK_IAE "Verweilsdauer in Motor-Pruefung (IAE-Ada)" VALUE 0x26D338 kw_ui16_S6_S3 9990 UMR_MSEC__10_1_0_S6_S3 10 10000 /end CHARACTERISTIC
/begin CHARACTERISTIC T_WAIT_LLPRUEF_APERK_IAE "Wartedauer vor Motor-Pruefung (IAE-Ada)" VALUE 0x26D33A kw_ui16_S6_S3 9990 UMR_MSEC__10_1_0_S6_S3 10 10000 /end CHARACTERISTIC
/begin CHARACTERISTIC TS_LLPRUEF_APERK_IAE "Verweildauer zur Beurteilung innerhalb Motor-Pruefung (IAE-Ada)" VALUE 0x26D33C kw_ui16_S6_S3 9990 UMR_MSEC__10_1_0_S6_S3 10 10000 /end CHARACTERISTIC
/begin CHARACTERISTIC PG_ABSENK_APERK_IAE "Druckgradient in der Absenkphase (IAE-Ada)" VALUE 0x26D33E kw_si16_S6_S3 2 UMR_BAR_SEC_1_1000_0_S6_S3 -2 0 /end CHARACTERISTIC
/begin CHARACTERISTIC MS_MOT_ABSENK_APERK_IAE "Motoristmomentschwelle fuer Absenkrampe (IAE-Ada)" VALUE 0x26E3F3 kw_ui8_S6_S3 100 UMR_NM__1_1_0_S6_S3 0 100 /end CHARACTERISTIC
/begin CHARACTERISTIC PS_MIN_ABSENK_APERK_IAE "Minimaler Absolutdruck in der IAE waehrend Absenkphase (IAE-Ada)" VALUE 0x26D340 kw_ui16_S6_S3 2 UMR_BAR__1_1000_0_S6_S3 0 2 /end CHARACTERISTIC
/begin CHARACTERISTIC KF_M_SCHLEPP_ADA_IAE "Getriebeschleppmomente fuer die IAE-Adaption" MAP 0x21B734 kf_si16_S6_S3 50 UMR_NM__1_1_0_S6_S3 0 50
 /begin AXIS_DESCR STD_AXIS NO_INPUT_QUANTITY UMR_GRADC__1_1_M40_S6_S3 4 -40 215 DEPOSIT ABSOLUTE MONOTONY MON_INCREASE /end AXIS_DESCR
 /begin AXIS_DESCR STD_AXIS NO_INPUT_QUANTITY UMR_U_MIN_1_1_0_S6_S3 2 0 8160 DEPOSIT ABSOLUTE MONOTONY MON_INCREASE /end AXIS_DESCR
/end CHARACTERISTIC
/begin CHARACTERISTIC SWI_APERK_IEP_IAE "Schalter zur Aktivierung und Aufschaltung der IAE-IEP-APADA" VALUE 0x26E3F4 kw_bool8_S6_S3 1 UMR___1_1_0_S6_S3 0 1 /end CHARACTERISTIC
/begin CHARACTERISTIC KL_CTRSTART_APERK_IEP_IAE "Zaehlerschwelle zur Aktivierung der Ada" CURVE 0x21B758 kl_ui16_S6_S3 10000 UMR_SEC__1_1_0_S6_S3 0 10000
 /begin AXIS_DESCR STD_AXIS NO_INPUT_QUANTITY UMR___1_1_0_S6_S3 6 0 65535 DEPOSIT ABSOLUTE MONOTONY MON_INCREASE /end AXIS_DESCR
/end CHARACTERISTIC
/begin CHARACTERISTIC CGETR_MIN_APADA_IEP_IAE "untere Temp-Schwelle in Abh. von Anzahl Bewertungen" VALUE 0x26D342 kw_ui16_S6_S3 255 UMR_GRADC__1_1_M40_S6_S3 -40 215 /end CHARACTERISTIC
/begin CHARACTERISTIC CGETR_MAX_APADA_IEP_IAE "obere Temp-Schwelle" VALUE 0x26E3F5 kw_ui8_S6_S3 215 UMR_GRADC__1_1_M40_S6_S3 0 215 /end CHARACTERISTIC
/begin CHARACTERISTIC TAB_CK_APERK_IEP_IAE "Definition der Temperaturklassen" CURVE 0x21B774 tab_ui8_S6_S3 250 UMR_GRADC__1_1_M40_S6_S3 -40 210
 /begin AXIS_DESCR FIX_AXIS NO_INPUT_QUANTITY UMR___1_1_0_S6_S3 4 0 3 FIX_AXIS_PAR_DIST 0 1 4 /end AXIS_DESCR
/end CHARACTERISTIC
/begin CHARACTERISTIC T_M_MOTREF_APERK_IEP_IAE "Verweilzeit in M_MOT_REF" VALUE 0x26D344 kw_ui16_S6_S3 60000 UMR_MSEC__10_1_0_S6_S3 0 60000 /end CHARACTERISTIC
/begin CHARACTERISTIC T_M_MOTIEP_APERK_IEP_IAE "Verweilzeit in M_MOT_REF" VALUE 0x26D346 kw_ui16_S6_S3 60000 UMR_MSEC__10_1_0_S6_S3 0 60000 /end CHARACTERISTIC
/begin CHARACTERISTIC T_WARTEN_ABSENKEN_IAE "Verweilzeit in N_MOT_ABSENKEN" VALUE 0x26D348 kw_ui16_S6_S3 60000 UMR_MSEC__10_1_0_S6_S3 0 60000 /end CHARACTERISTIC
/begin CHARACTERISTIC T_MAXABSENKEN_APERK_IEP_IAE "Maximale Verweilzeit in N_MOT_ABSENKEN" VALUE 0x26D34A kw_ui16_S6_S3 60000 UMR_MSEC__10_1_0_S6_S3 0 60000 /end CHARACTERISTIC
/begin CHARACTERISTIC NS_MOT_APERK_IEP_IAE "Drehtzahlschwelle weahrend TP_Adaption weahrend IEP_Betrieb" VALUE 0x26D34C kw_ui16_S6_S3 1000 UMR_U_MIN_1_1_0_S6_S3 0 1000 /end CHARACTERISTIC
/begin CHARACTERISTIC KF_PO_APERK_IEP_IAE "Ermittlung des Adaptionswerts bei TP-Adaption während IEP-Betrieb" MAP 0x21B77C kf_si16_S6_S3 2 UMR_BAR__1_1000_0_S6_S3 -1 1
 /begin AXIS_DESCR STD_AXIS NO_INPUT_QUANTITY UMR_NM__1_1_0_S6_S3 6 -2040 2040 DEPOSIT ABSOLUTE MONOTONY MON_INCREASE /end AXIS_DESCR
 /begin AXIS_DESCR STD_AXIS NO_INPUT_QUANTITY UMR_GRADC__1_1_M40_S6_S3 4 -40 215 DEPOSIT ABSOLUTE MONOTONY MON_INCREASE /end AXIS_DESCR
/end CHARACTERISTIC
/begin CHARACTERISTIC KL_FD_APADA_IEP_IAE "Daempfungsfaktor Abh. von Anzahl Bewertungen" CURVE 0x21B7C8 kl_ui16_S6_S3 1 UMR___1_100_0_S6_S3 0 1
 /begin AXIS_DESCR STD_AXIS NO_INPUT_QUANTITY UMR___1_100_0_S6_S3 5 0 655.35 DEPOSIT ABSOLUTE MONOTONY MON_INCREASE /end AXIS_DESCR
/end CHARACTERISTIC
/begin CHARACTERISTIC KL_PO_TABMIN_APADA_IEP_IAE "Minwertbegrenzung TP_Adaption weahrend IEP-Betrieb" CURVE 0x21B7E0 kl_si16_S6_S3 1 UMR_BAR__1_1000_0_S6_S3 -1 0
 /begin AXIS_DESCR STD_AXIS NO_INPUT_QUANTITY UMR_GRADC__1_1_M40_S6_S3 8 -40 215 DEPOSIT ABSOLUTE MONOTONY MON_INCREASE /end AXIS_DESCR
/end CHARACTERISTIC
/begin CHARACTERISTIC KL_PO_TABMAX_APADA_IEP_IAE "Maxwertbegrenzung TP_Adaption weahrend IEP-Betrieb" CURVE 0x21B804 kl_si16_S6_S3 1 UMR_BAR__1_1000_0_S6_S3 0 1
 /begin AXIS_DESCR STD_AXIS NO_INPUT_QUANTITY UMR_GRADC__1_1_M40_S6_S3 8 -40 215 DEPOSIT ABSOLUTE MONOTONY MON_INCREASE /end AXIS_DESCR
/end CHARACTERISTIC
/begin CHARACTERISTIC KF_F_ADAWERTIEP_IAE "Gewichtung des IAE-AP-IEP Adaptionswert beim Auslesen" MAP 0x21B828 kf_si16_S6_S3 1 UMR_PROZENT__1_100_0_S6_S3 0 1
 /begin AXIS_DESCR STD_AXIS NO_INPUT_QUANTITY UMR_U_MIN_1_1_0_S6_S3 6 0 8160 DEPOSIT ABSOLUTE MONOTONY MON_INCREASE /end AXIS_DESCR
 /begin AXIS_DESCR STD_AXIS NO_INPUT_QUANTITY UMR_GRADC__1_1_M40_S6_S3 4 -40 215 DEPOSIT ABSOLUTE MONOTONY MON_INCREASE /end AXIS_DESCR
/end CHARACTERISTIC
/begin CHARACTERISTIC TAB_SWI_KUPADA_START_PF "Adaption zu Beginn der Getriebelaufzeit (0 = deaktiviert, 1 = aktiviert). X-Achse (Kupplungen): A-E(F)(K0). Y-Achse (Adaptionen): 1:HS-ADA, 2:SAD, 3:IAE-ADA, 4:GE-ADA, 5:GA-ADA, 6:RS-ADA" MAP 0x2185A4 tab2d_ui8_S6_S3 1 UMR___1_1_0_S6_S3 0 1
 /begin AXIS_DESCR FIX_AXIS iAdaPulzs.kup_puls UMR___1_1_0_S6_S3 6 1 6 FIX_AXIS_PAR_DIST 1 1 6 /end AXIS_DESCR
 /begin AXIS_DESCR FIX_AXIS iAdaGloku.index_startada_pf UMR___1_1_0_S6_S3 6 1 6 FIX_AXIS_PAR_DIST 1 1 6 /end AXIS_DESCR
/end CHARACTERISTIC
/begin CHARACTERISTIC TAB_SWI_SEK_KUPADA_PF "Auswahl des Funktionstyps der SEK Pulsadaption KUP A-E(F): 0=keine, 1=SEK ueber BPZ, 2=SEK immer aktiv" CURVE 0x2185D0 tab_ui8_S6_S3 2 UMR___1_1_0_S6_S3 0 2
 /begin AXIS_DESCR FIX_AXIS NO_INPUT_QUANTITY UMR___1_1_0_S6_S3 6 0 5 FIX_AXIS_PAR_DIST 0 1 6 /end AXIS_DESCR
/end CHARACTERISTIC
/begin CHARACTERISTIC TAB_SWI_KUPADA_PF "Adaption KUP A-E(F)(K0): 0=keine, 1=PULS, 2=PF-Schaltung HS, 3=SAD, (4=IaeTP), (5=GE-Ada), 7=PF-Schaltung RS" CURVE 0x2185DC tab_ui8_S6_S3 7 UMR___1_1_0_S6_S3 0 7
 /begin AXIS_DESCR FIX_AXIS NO_INPUT_QUANTITY UMR___1_1_0_S6_S3 6 0 5 FIX_AXIS_PAR_DIST 0 1 6 /end AXIS_DESCR
/end CHARACTERISTIC
/begin CHARACTERISTIC TAB_KUPADA_SCHLECHTWEG "Offset auf Schalungsschwelle zur reaktivierung der Startadaption" CURVE 0x2185E8 tab_ui16_S6_S3 10000 UMR___1_1_0_S6_S3 0 10000
 /begin AXIS_DESCR FIX_AXIS NO_INPUT_QUANTITY UMR___1_1_0_S6_S3 6 0 5 FIX_AXIS_PAR_DIST 0 1 6 /end AXIS_DESCR
/end CHARACTERISTIC
/begin CHARACTERISTIC SWI_KUPADASTART_SCHLECHTWEG "Auswahl-Switch Schlechtwege Funktion aktiv" VALUE 0x26E3B0 kw_bool8_S6_S3 1 UMR___1_1_0_S6_S3 0 1 /end CHARACTERISTIC
/begin CHARACTERISTIC TAB_NSTARTPRUEF_KUPADA_PF "Anzahl Startada Befuellpruefzyklen f. die zu Beginn der Getriebelaufzeit eine andere PF-Adaption gewaehlt wird" CURVE 0x2185F8 tab_ui8_S6_S3 100 UMR___1_1_0_S6_S3 0 100
 /begin AXIS_DESCR FIX_AXIS NO_INPUT_QUANTITY UMR___1_1_0_S6_S3 6 0 5 FIX_AXIS_PAR_DIST 0 1 6 /end AXIS_DESCR
/end CHARACTERISTIC
/begin CHARACTERISTIC TAB_NHAUPTSTARTPRUEF_KUPADA_PF "Anzahl Hauptada Befuellpruefzyklen f. die zu Beginn der Getriebelaufzeit eine andere PF-Adaption gewaehlt wird" CURVE 0x218604 tab_ui8_S6_S3 100 UMR___1_1_0_S6_S3 0 100
 /begin AXIS_DESCR FIX_AXIS NO_INPUT_QUANTITY UMR___1_1_0_S6_S3 6 0 5 FIX_AXIS_PAR_DIST 0 1 6 /end AXIS_DESCR
/end CHARACTERISTIC
/begin CHARACTERISTIC TAB_NSEKPRUEF_KUPADA_PF "Anzahl Befuellpruefzyklen f. die die SEK Pulsada aktiv ist" CURVE 0x218610 tab_ui8_S6_S3 100 UMR___1_1_0_S6_S3 0 100
 /begin AXIS_DESCR FIX_AXIS NO_INPUT_QUANTITY UMR___1_1_0_S6_S3 6 0 5 FIX_AXIS_PAR_DIST 0 1 6 /end AXIS_DESCR
/end CHARACTERISTIC
/begin CHARACTERISTIC KL_PF_MAXADAWERTDELTA "Maximal zulässige Änderung des Adaptionswertes" CURVE 0x21861C kl_si16_S6_S3 1 UMR_BAR__1_1000_0_S6_S3 0 1
 /begin AXIS_DESCR STD_AXIS NO_INPUT_QUANTITY UMR___1_1_0_S6_S3 3 0 255 DEPOSIT ABSOLUTE MONOTONY MON_INCREASE /end AXIS_DESCR
/end CHARACTERISTIC
/begin CHARACTERISTIC TAB_PF_ADMIN "Untere Begrenzung PF-Adaptionswerte KUP 0=A...4=E(, 5=F)" CURVE 0x21862C tab_si16_S6_S3 6 UMR_BAR__1_1000_0_S6_S3 -6 0
 /begin AXIS_DESCR FIX_AXIS NO_INPUT_QUANTITY UMR___1_1_0_S6_S3 6 0 5 FIX_AXIS_PAR_DIST 0 1 6 /end AXIS_DESCR
/end CHARACTERISTIC
/begin CHARACTERISTIC TAB_PF_ADMAX "Obere Begrenzung PF-Adaptionswerte KUP 0=A...4=E(, 5=F)" CURVE 0x21863C tab_si16_S6_S3 6 UMR_BAR__1_1000_0_S6_S3 0 6
 /begin AXIS_DESCR FIX_AXIS NO_INPUT_QUANTITY UMR___1_1_0_S6_S3 6 0 5 FIX_AXIS_PAR_DIST 0 1 6 /end AXIS_DESCR
/end CHARACTERISTIC
/begin CHARACTERISTIC TAB_PF_KALT_DELTAMAX "Maximaler Betrag des Kalt Adaptionswerts KUP 0=A...4=E(, 5=F)" CURVE 0x21864C tab_si16_S6_S3 6 UMR_BAR__1_1000_0_S6_S3 0 6
 /begin AXIS_DESCR FIX_AXIS NO_INPUT_QUANTITY UMR___1_1_0_S6_S3 6 0 5 FIX_AXIS_PAR_DIST 0 1 6 /end AXIS_DESCR
/end CHARACTERISTIC
/begin CHARACTERISTIC SWI_REDBEFPULSVERB_K0 "Moeglichkeit einer Adaption der K0 auch bei reduzierter Befuellung" VALUE 0x26E3B1 kw_bool8_S6_S3 1 UMR___1_1_0_S6_S3 0 1 /end CHARACTERISTIC
/begin CHARACTERISTIC TAB_SWI_KUPADA_TSF "Adaption KUP A-E(F): 0=keine, 1=PULS" CURVE 0x21865C tab_ui8_S6_S3 1 UMR___1_1_0_S6_S3 0 1
 /begin AXIS_DESCR FIX_AXIS NO_INPUT_QUANTITY UMR___1_1_0_S6_S3 6 0 5 FIX_AXIS_PAR_DIST 0 1 6 /end AXIS_DESCR
/end CHARACTERISTIC
/begin CHARACTERISTIC TAB_SWI_SEK_KUPADA_TSF "Auswahl des Funktionstyps der SEK Pulsadaption KUP A-E(F): 0=keine, 1=SEK ueber BPZ, 2=SEK immer aktiv" CURVE 0x218668 tab_ui8_S6_S3 2 UMR___1_1_0_S6_S3 0 2
 /begin AXIS_DESCR FIX_AXIS NO_INPUT_QUANTITY UMR___1_1_0_S6_S3 6 0 5 FIX_AXIS_PAR_DIST 0 1 6 /end AXIS_DESCR
/end CHARACTERISTIC
/begin CHARACTERISTIC TAB_NSEKPRUEF_KUPADA_TSF "Anzahl Befuellpruefzyklen f. die die SEK Pulsada aktiv ist" CURVE 0x218674 tab_ui8_S6_S3 100 UMR___1_1_0_S6_S3 0 100
 /begin AXIS_DESCR FIX_AXIS NO_INPUT_QUANTITY UMR___1_1_0_S6_S3 6 0 5 FIX_AXIS_PAR_DIST 0 1 6 /end AXIS_DESCR
/end CHARACTERISTIC
/begin CHARACTERISTIC KL_TSF_MAXADAWERTDELTA "Maximal zulässige Änderung des Adaptionswertes" CURVE 0x218680 kl_si16_S6_S3 200 UMR_MSEC__1_1_0_S6_S3 0 200
 /begin AXIS_DESCR STD_AXIS NO_INPUT_QUANTITY UMR___1_1_0_S6_S3 3 0 255 DEPOSIT ABSOLUTE MONOTONY MON_INCREASE /end AXIS_DESCR
/end CHARACTERISTIC
/begin CHARACTERISTIC TAB_TSF_ADMIN "Untere Begrenzung TSF-Adaptionswerte KUP 0=A...4=E(, 5=F)" CURVE 0x218690 tab_si16_S6_S3 1000 UMR_MSEC__1_1_0_S6_S3 -1000 0
 /begin AXIS_DESCR FIX_AXIS NO_INPUT_QUANTITY UMR___1_1_0_S6_S3 6 0 5 FIX_AXIS_PAR_DIST 0 1 6 /end AXIS_DESCR
/end CHARACTERISTIC
/begin CHARACTERISTIC TAB_TSF_ADMAX "Obere Begrenzung TSF-Adaptionswerte KUP 0=A...4=E(, 5=F)" CURVE 0x2186A0 tab_si16_S6_S3 1000 UMR_MSEC__1_1_0_S6_S3 0 1000
 /begin AXIS_DESCR FIX_AXIS NO_INPUT_QUANTITY UMR___1_1_0_S6_S3 6 0 5 FIX_AXIS_PAR_DIST 0 1 6 /end AXIS_DESCR
/end CHARACTERISTIC
/begin CHARACTERISTIC CS_LOCK "Temperatur-Schwelle fuer Puls-Ada K0 Lock" VALUE 0x26E3B2 kw_ui8_S6_S3 190 UMR_GRADC__1_1_M40_S6_S3 -40 150 /end CHARACTERISTIC
/begin CHARACTERISTIC GANG_LOCK "Gang fuer Puls-Ada K0 Lock" VALUE 0x26E3B3 kw_ui8_S6_S3 7 UMR___1_1_0_S6_S3 1 8 /end CHARACTERISTIC
/begin CHARACTERISTIC SWI_KPL_LOCK "Auswahl-Switch fuer Puls-Ada K0 Lock" VALUE 0x26E3B4 kw_ui8_S6_S3 1 UMR___1_1_0_S6_S3 0 1 /end CHARACTERISTIC
/begin CHARACTERISTIC TS_LOCK "Schwelle fuer Timer: AdaK0.Timer.Lock (Puls-Ada K0 Lock)" VALUE 0x26E3B5 kw_ui8_S6_S3 250 UMR_SEC__1_1_0_S6_S3 0 250 /end CHARACTERISTIC
/begin CHARACTERISTIC TS_MAX_LOCK "Schwelle fuer Timer: AdaK0.Timer.Maxlock (Puls-Ada K0 Lock)" VALUE 0x26D2E0 kw_ui16_S6_S3 10000 UMR___1_1_0_S6_S3 0 10000 /end CHARACTERISTIC
/begin CHARACTERISTIC TAB_MINBPZHSAD "Anzahl PF HS Bewertungen damit QS Schaltung erlaubt wird" CURVE 0x2186B0 tab_ui16_S6_S3 65535 UMR___1_1_0_S6_S3 0 65535
 /begin AXIS_DESCR FIX_AXIS NO_INPUT_QUANTITY UMR___1_1_0_S6_S3 5 0 4 FIX_AXIS_PAR_DIST 0 1 5 /end AXIS_DESCR
/end CHARACTERISTIC
/begin CHARACTERISTIC TAB_SWI_KUPADA_PF_KALT "Adaption KUP A-E(F)(K0): 0=keine, 1=PULS, 2=PF-Schaltung HS, 3=SAD, (4=IaeTP), (5=GE-Ada), 7=PF-Schaltung RS" CURVE 0x2186C0 tab_ui8_S6_S3 7 UMR___1_1_0_S6_S3 0 7
 /begin AXIS_DESCR FIX_AXIS NO_INPUT_QUANTITY UMR___1_1_0_S6_S3 6 0 5 FIX_AXIS_PAR_DIST 0 1 6 /end AXIS_DESCR
/end CHARACTERISTIC
/begin CHARACTERISTIC TAB_NMINPRUEF_TSF_PFKALT "Min. Anzahl TSF Befuellpruefungen" CURVE 0x2186CC tab_ui8_S6_S3 100 UMR___1_1_0_S6_S3 0 100
 /begin AXIS_DESCR FIX_AXIS NO_INPUT_QUANTITY UMR___1_1_0_S6_S3 6 0 5 FIX_AXIS_PAR_DIST 0 1 6 /end AXIS_DESCR
/end CHARACTERISTIC
/begin CHARACTERISTIC TAB_SWI_GLSBEEINFL_KALT "Aktivierung Beeinflussung von PF-Kalt in GLS-Kalt" CURVE 0x2186D8 tab_ui8_S6_S3 1 UMR___1_1_0_S6_S3 0 1
 /begin AXIS_DESCR FIX_AXIS NO_INPUT_QUANTITY UMR___1_1_0_S6_S3 31 1 31 FIX_AXIS_PAR_DIST 1 1 31 /end AXIS_DESCR
/end CHARACTERISTIC
/begin CHARACTERISTIC KL_PRUEFKAD_TSF_A "Kennlinie zur Bestimmg d.Pruefintervalls der SF-Hauptadaption" CURVE 0x2186FC kl_ui16_S6_S3 10000 UMR___1_1_0_S6_S3 0 10000
 /begin AXIS_DESCR STD_AXIS NO_INPUT_QUANTITY UMR___1_1_0_S6_S3 4 0 255 DEPOSIT ABSOLUTE MONOTONY MON_INCREASE /end AXIS_DESCR
/end CHARACTERISTIC
/begin CHARACTERISTIC KL_PRUEFKAD_PF_A "Kennlinie zur Bestimmg d.Pruefintervalls der PF-Hauptadaption" CURVE 0x218710 kl_ui16_S6_S3 10000 UMR___1_1_0_S6_S3 0 10000
 /begin AXIS_DESCR STD_AXIS NO_INPUT_QUANTITY UMR___1_1_0_S6_S3 4 0 255 DEPOSIT ABSOLUTE MONOTONY MON_INCREASE /end AXIS_DESCR
/end CHARACTERISTIC
/begin CHARACTERISTIC SHIFTCOUNTERGLSKPLBP_A "GLS-Trimm Fkt: Schwelle Pruefzaehler der k_ab" VALUE 0x26E3B6 kw_ui8_S6_S3 255 UMR___1_1_0_S6_S3 0 255 /end CHARACTERISTIC
/begin CHARACTERISTIC KL_PRUEFKAD_TSF_B "Kennlinie zur Bestimmg d.Pruefintervalls der SF-Hauptadaption" CURVE 0x218724 kl_ui16_S6_S3 10000 UMR___1_1_0_S6_S3 0 10000
 /begin AXIS_DESCR STD_AXIS NO_INPUT_QUANTITY UMR___1_1_0_S6_S3 4 0 255 DEPOSIT ABSOLUTE MONOTONY MON_INCREASE /end AXIS_DESCR
/end CHARACTERISTIC
/begin CHARACTERISTIC KL_PRUEFKAD_PF_B "Kennlinie zur Bestimmg d.Pruefintervalls der PF-Hauptadaption" CURVE 0x218738 kl_ui16_S6_S3 10000 UMR___1_1_0_S6_S3 0 10000
 /begin AXIS_DESCR STD_AXIS NO_INPUT_QUANTITY UMR___1_1_0_S6_S3 4 0 255 DEPOSIT ABSOLUTE MONOTONY MON_INCREASE /end AXIS_DESCR
/end CHARACTERISTIC
/begin CHARACTERISTIC SHIFTCOUNTERGLSKPLBP_B "GLS-Trimm Fkt: Schwelle Pruefzaehler der k_ab" VALUE 0x26E3B7 kw_ui8_S6_S3 255 UMR___1_1_0_S6_S3 0 255 /end CHARACTERISTIC
/begin CHARACTERISTIC KL_PRUEFKAD_TSF_C "Kennlinie zur Bestimmg d.Pruefintervalls der SF-Hauptadaption" CURVE 0x21874C kl_ui16_S6_S3 10000 UMR___1_1_0_S6_S3 0 10000
 /begin AXIS_DESCR STD_AXIS NO_INPUT_QUANTITY UMR___1_1_0_S6_S3 4 0 255 DEPOSIT ABSOLUTE MONOTONY MON_INCREASE /end AXIS_DESCR
/end CHARACTERISTIC
/begin CHARACTERISTIC KL_PRUEFKAD_PF_C "Kennlinie zur Bestimmg d.Pruefintervalls der PF-Hauptadaption" CURVE 0x218760 kl_ui16_S6_S3 10000 UMR___1_1_0_S6_S3 0 10000
 /begin AXIS_DESCR STD_AXIS NO_INPUT_QUANTITY UMR___1_1_0_S6_S3 4 0 255 DEPOSIT ABSOLUTE MONOTONY MON_INCREASE /end AXIS_DESCR
/end CHARACTERISTIC
/begin CHARACTERISTIC SHIFTCOUNTERGLSKPLBP_C "GLS-Trimm Fkt: Schwelle Pruefzaehler der k_ab" VALUE 0x26E3B8 kw_ui8_S6_S3 255 UMR___1_1_0_S6_S3 0 255 /end CHARACTERISTIC
/begin CHARACTERISTIC KL_PRUEFKAD_TSF_D "Kennlinie zur Bestimmg d.Pruefintervalls der SF-Hauptadaption" CURVE 0x218774 kl_ui16_S6_S3 10000 UMR___1_1_0_S6_S3 0 10000
 /begin AXIS_DESCR STD_AXIS NO_INPUT_QUANTITY UMR___1_1_0_S6_S3 4 0 255 DEPOSIT ABSOLUTE MONOTONY MON_INCREASE /end AXIS_DESCR
/end CHARACTERISTIC
/begin CHARACTERISTIC KL_PRUEFKAD_PF_D "Kennlinie zur Bestimmg d.Pruefintervalls der PF-Hauptadaption" CURVE 0x218788 kl_ui16_S6_S3 10000 UMR___1_1_0_S6_S3 0 10000
 /begin AXIS_DESCR STD_AXIS NO_INPUT_QUANTITY UMR___1_1_0_S6_S3 4 0 255 DEPOSIT ABSOLUTE MONOTONY MON_INCREASE /end AXIS_DESCR
/end CHARACTERISTIC
/begin CHARACTERISTIC SHIFTCOUNTERGLSKPLBP_D "GLS-Trimm Fkt: Schwelle Pruefzaehler der k_ab" VALUE 0x26E3B9 kw_ui8_S6_S3 255 UMR___1_1_0_S6_S3 0 255 /end CHARACTERISTIC
/begin CHARACTERISTIC KL_PRUEFKAD_TSF_E "Kennlinie zur Bestimmg d.Pruefintervalls der SF-Hauptadaption" CURVE 0x21879C kl_ui16_S6_S3 10000 UMR___1_1_0_S6_S3 0 10000
 /begin AXIS_DESCR STD_AXIS NO_INPUT_QUANTITY UMR___1_1_0_S6_S3 4 0 255 DEPOSIT ABSOLUTE MONOTONY MON_INCREASE /end AXIS_DESCR
/end CHARACTERISTIC
/begin CHARACTERISTIC KL_PRUEFKAD_PF_E "Kennlinie zur Bestimmg d.Pruefintervalls der PF-Hauptadaption" CURVE 0x2187B0 kl_ui16_S6_S3 10000 UMR___1_1_0_S6_S3 0 10000
 /begin AXIS_DESCR STD_AXIS NO_INPUT_QUANTITY UMR___1_1_0_S6_S3 4 0 255 DEPOSIT ABSOLUTE MONOTONY MON_INCREASE /end AXIS_DESCR
/end CHARACTERISTIC
/begin CHARACTERISTIC SHIFTCOUNTERGLSKPLBP_E "GLS-Trimm Fkt: Schwelle Pruefzaehler der k_ab" VALUE 0x26E3BA kw_ui8_S6_S3 255 UMR___1_1_0_S6_S3 0 255 /end CHARACTERISTIC
/begin CHARACTERISTIC KL_PRUEFKAD_TSF_K0 "Kennlinie zur Bestimmg d.Pruefintervalls der SF-Hauptadaption" CURVE 0x2187C4 kl_ui16_S6_S3 10000 UMR___1_1_0_S6_S3 0 10000
 /begin AXIS_DESCR STD_AXIS NO_INPUT_QUANTITY UMR___1_1_0_S6_S3 4 0 255 DEPOSIT ABSOLUTE MONOTONY MON_INCREASE /end AXIS_DESCR
/end CHARACTERISTIC
/begin CHARACTERISTIC KL_PRUEFKAD_PF_K0 "Kennlinie zur Bestimmg d.Pruefintervalls der PF-Hauptadaption" CURVE 0x2187D8 kl_ui16_S6_S3 10000 UMR___1_1_0_S6_S3 0 10000
 /begin AXIS_DESCR STD_AXIS NO_INPUT_QUANTITY UMR___1_1_0_S6_S3 4 0 255 DEPOSIT ABSOLUTE MONOTONY MON_INCREASE /end AXIS_DESCR
/end CHARACTERISTIC
/begin CHARACTERISTIC SHIFTCOUNTERGLSKPLBP_K0 "GLS-Trimm Fkt: Schwelle Pruefzaehler der k_ab" VALUE 0x26E3BB kw_ui8_S6_S3 255 UMR___1_1_0_S6_S3 0 255 /end CHARACTERISTIC
/begin CHARACTERISTIC KF_PFADMTHS12 "Adaptionswert PFAD fuer xy-Schaltung" MAP 0x21B978 kf_si16_S6_S3 2.5 UMR_BAR__1_1000_0_S6_S3 -1.25 1.25
 /begin AXIS_DESCR STD_AXIS iAdaPfusf.td_pfad UMR_MSEC__10_1_0_S6_S3 10 -5000 5000 DEPOSIT ABSOLUTE MONOTONY MON_INCREASE /end AXIS_DESCR
 /begin AXIS_DESCR STD_AXIS iAdaPfusf.m_t_pfad UMR_NM__1_1_0_S6_S3 5 -400 1640 DEPOSIT ABSOLUTE MONOTONY MON_INCREASE /end AXIS_DESCR
/end CHARACTERISTIC
/begin CHARACTERISTIC KF_PFADMTHS12_EL "Adaptionswert PFAD fuer xy-Schaltung" MAP 0x21BA04 kf_si16_S6_S3 2.5 UMR_BAR__1_1000_0_S6_S3 -1.25 1.25
 /begin AXIS_DESCR STD_AXIS iAdaPfusf.td_pfad UMR_MSEC__10_1_0_S6_S3 10 -5000 5000 DEPOSIT ABSOLUTE MONOTONY MON_INCREASE /end AXIS_DESCR
 /begin AXIS_DESCR STD_AXIS iAdaPfusf.m_t_pfad UMR_NM__1_1_0_S6_S3 5 -400 1640 DEPOSIT ABSOLUTE MONOTONY MON_INCREASE /end AXIS_DESCR
/end CHARACTERISTIC
/begin CHARACTERISTIC KF_HSADEINZPKT12 "Solleinzugszeitpunkt nach Ende Rampe 1" MAP 0x21BA90 kf_si16_S6_S3 20000 UMR_MSEC__10_1_0_S6_S3 -10000 10000
 /begin AXIS_DESCR STD_AXIS iItfInput.n_t UMR_U_MIN_1_1_0_S6_S3 5 0 8000 DEPOSIT ABSOLUTE MONOTONY MON_INCREASE /end AXIS_DESCR
 /begin AXIS_DESCR STD_AXIS iItfInput.m_t UMR_NM__1_1_0_S6_S3 5 -400 1640 DEPOSIT ABSOLUTE MONOTONY MON_INCREASE /end AXIS_DESCR
/end CHARACTERISTIC
/begin CHARACTERISTIC KF_HSADEINZPKT12_EL "Solleinzugszeitpunkt nach Ende Rampe 1" MAP 0x21BAE0 kf_si16_S6_S3 20000 UMR_MSEC__10_1_0_S6_S3 -10000 10000
 /begin AXIS_DESCR STD_AXIS iItfInput.n_t UMR_U_MIN_1_1_0_S6_S3 5 0 8000 DEPOSIT ABSOLUTE MONOTONY MON_INCREASE /end AXIS_DESCR
 /begin AXIS_DESCR STD_AXIS iItfInput.m_t UMR_NM__1_1_0_S6_S3 5 -400 1640 DEPOSIT ABSOLUTE MONOTONY MON_INCREASE /end AXIS_DESCR
/end CHARACTERISTIC
/begin CHARACTERISTIC T_VPFADHS12 "Verzoegerungszeit Bewertung Schaltung xy" VALUE 0x26E403 kw_ui8_S6_S3 1000 UMR_MSEC__10_1_0_S6_S3 0 1000 /end CHARACTERISTIC
/begin CHARACTERISTIC KL_MTPFADHSOB12 "Obere schaltungsabhaengige Momentenschwelle bei xy-Schaltung" CURVE 0x21BB30 kl_si16_S6_S3 2040 UMR_NM__1_1_0_S6_S3 -400 1640
 /begin AXIS_DESCR STD_AXIS NO_INPUT_QUANTITY UMR___1_1_0_S6_S3 3 0 32767 DEPOSIT ABSOLUTE MONOTONY MON_INCREASE /end AXIS_DESCR
/end CHARACTERISTIC
/begin CHARACTERISTIC KL_MTPFADHSOB12_EL "Obere schaltungsabhaengige Momentenschwelle bei xy-Schaltung" CURVE 0x21BB40 kl_si16_S6_S3 2040 UMR_NM__1_1_0_S6_S3 -400 1640
 /begin AXIS_DESCR STD_AXIS NO_INPUT_QUANTITY UMR___1_1_0_S6_S3 3 0 32767 DEPOSIT ABSOLUTE MONOTONY MON_INCREASE /end AXIS_DESCR
/end CHARACTERISTIC
/begin CHARACTERISTIC KL_MTPFADHSUN12 "Untere schaltungsabhaengige Momentenschwelle bei xy-Schaltung" CURVE 0x21BB50 kl_si16_S6_S3 2040 UMR_NM__1_1_0_S6_S3 -400 1640
 /begin AXIS_DESCR STD_AXIS NO_INPUT_QUANTITY UMR___1_1_0_S6_S3 3 0 32767 DEPOSIT ABSOLUTE MONOTONY MON_INCREASE /end AXIS_DESCR
/end CHARACTERISTIC
/begin CHARACTERISTIC KL_MTPFADHSUN12_EL "Untere schaltungsabhaengige Momentenschwelle bei xy-Schaltung" CURVE 0x21BB60 kl_si16_S6_S3 2040 UMR_NM__1_1_0_S6_S3 -400 1640
 /begin AXIS_DESCR STD_AXIS NO_INPUT_QUANTITY UMR___1_1_0_S6_S3 3 0 32767 DEPOSIT ABSOLUTE MONOTONY MON_INCREASE /end AXIS_DESCR
/end CHARACTERISTIC
/begin CHARACTERISTIC KL_NTPFADHSOB12 "Obere schaltungsabhaengige Drehzahlschwelle bei xy-Schaltung" CURVE 0x21BB70 kl_ui16_S6_S3 8200 UMR_U_MIN_1_1_0_S6_S3 0 8200
 /begin AXIS_DESCR STD_AXIS NO_INPUT_QUANTITY UMR___1_1_0_S6_S3 3 0 65535 DEPOSIT ABSOLUTE MONOTONY MON_INCREASE /end AXIS_DESCR
/end CHARACTERISTIC
/begin CHARACTERISTIC KL_NTPFADHSOB12_EL "Obere schaltungsabhaengige Drehzahlschwelle bei xy-Schaltung" CURVE 0x21BB80 kl_ui16_S6_S3 8200 UMR_U_MIN_1_1_0_S6_S3 0 8200
 /begin AXIS_DESCR STD_AXIS NO_INPUT_QUANTITY UMR___1_1_0_S6_S3 3 0 65535 DEPOSIT ABSOLUTE MONOTONY MON_INCREASE /end AXIS_DESCR
/end CHARACTERISTIC
/begin CHARACTERISTIC KL_NTPFADHSUN12 "Untere schaltungsabhaengige Drehzahlschwelle bei xy-Schaltung" CURVE 0x21BB90 kl_ui16_S6_S3 8200 UMR_U_MIN_1_1_0_S6_S3 0 8200
 /begin AXIS_DESCR STD_AXIS NO_INPUT_QUANTITY UMR___1_1_0_S6_S3 3 0 65535 DEPOSIT ABSOLUTE MONOTONY MON_INCREASE /end AXIS_DESCR
/end CHARACTERISTIC
/begin CHARACTERISTIC KL_NTPFADHSUN12_EL "Untere schaltungsabhaengige Drehzahlschwelle bei xy-Schaltung" CURVE 0x21BBA0 kl_ui16_S6_S3 8200 UMR_U_MIN_1_1_0_S6_S3 0 8200
 /begin AXIS_DESCR STD_AXIS NO_INPUT_QUANTITY UMR___1_1_0_S6_S3 3 0 65535 DEPOSIT ABSOLUTE MONOTONY MON_INCREASE /end AXIS_DESCR
/end CHARACTERISTIC
/begin CHARACTERISTIC ND_PFADHS12 "Differenzdrehzahl zu Synchron alter Gang zur Erkenng Drehzahleinzug" VALUE 0x26D35A kw_ui16_S6_S3 8200 UMR_U_MIN_1_1_0_S6_S3 0 8200 /end CHARACTERISTIC
/begin CHARACTERISTIC KF_PFADMTHS23 "Adaptionswert PFAD fuer xy-Schaltung" MAP 0x21BBB0 kf_si16_S6_S3 2.5 UMR_BAR__1_1000_0_S6_S3 -1.25 1.25
 /begin AXIS_DESCR STD_AXIS iAdaPfusf.td_pfad UMR_MSEC__10_1_0_S6_S3 10 -5000 5000 DEPOSIT ABSOLUTE MONOTONY MON_INCREASE /end AXIS_DESCR
 /begin AXIS_DESCR STD_AXIS iAdaPfusf.m_t_pfad UMR_NM__1_1_0_S6_S3 5 -400 1640 DEPOSIT ABSOLUTE MONOTONY MON_INCREASE /end AXIS_DESCR
/end CHARACTERISTIC
/begin CHARACTERISTIC KF_PFADMTHS23_EL "Adaptionswert PFAD fuer xy-Schaltung" MAP 0x21BC3C kf_si16_S6_S3 2.5 UMR_BAR__1_1000_0_S6_S3 -1.25 1.25
 /begin AXIS_DESCR STD_AXIS iAdaPfusf.td_pfad UMR_MSEC__10_1_0_S6_S3 10 -5000 5000 DEPOSIT ABSOLUTE MONOTONY MON_INCREASE /end AXIS_DESCR
 /begin AXIS_DESCR STD_AXIS iAdaPfusf.m_t_pfad UMR_NM__1_1_0_S6_S3 5 -400 1640 DEPOSIT ABSOLUTE MONOTONY MON_INCREASE /end AXIS_DESCR
/end CHARACTERISTIC
/begin CHARACTERISTIC KF_HSADEINZPKT23 "Solleinzugszeitpunkt nach Ende Rampe 1" MAP 0x21BCC8 kf_si16_S6_S3 20000 UMR_MSEC__10_1_0_S6_S3 -10000 10000
 /begin AXIS_DESCR STD_AXIS iItfInput.n_t UMR_U_MIN_1_1_0_S6_S3 5 0 8000 DEPOSIT ABSOLUTE MONOTONY MON_INCREASE /end AXIS_DESCR
 /begin AXIS_DESCR STD_AXIS iItfInput.m_t UMR_NM__1_1_0_S6_S3 5 -400 1640 DEPOSIT ABSOLUTE MONOTONY MON_INCREASE /end AXIS_DESCR
/end CHARACTERISTIC
/begin CHARACTERISTIC KF_HSADEINZPKT23_EL "Solleinzugszeitpunkt nach Ende Rampe 1" MAP 0x21BD18 kf_si16_S6_S3 20000 UMR_MSEC__10_1_0_S6_S3 -10000 10000
 /begin AXIS_DESCR STD_AXIS iItfInput.n_t UMR_U_MIN_1_1_0_S6_S3 5 0 8000 DEPOSIT ABSOLUTE MONOTONY MON_INCREASE /end AXIS_DESCR
 /begin AXIS_DESCR STD_AXIS iItfInput.m_t UMR_NM__1_1_0_S6_S3 5 -400 1640 DEPOSIT ABSOLUTE MONOTONY MON_INCREASE /end AXIS_DESCR
/end CHARACTERISTIC
/begin CHARACTERISTIC T_VPFADHS23 "Verzoegerungszeit Bewertung Schaltung xy" VALUE 0x26E404 kw_ui8_S6_S3 1000 UMR_MSEC__10_1_0_S6_S3 0 1000 /end CHARACTERISTIC
/begin CHARACTERISTIC KL_MTPFADHSOB23 "Obere schaltungsabhaengige Momentenschwelle bei xy-Schaltung" CURVE 0x21BD68 kl_si16_S6_S3 2040 UMR_NM__1_1_0_S6_S3 -400 1640
 /begin AXIS_DESCR STD_AXIS NO_INPUT_QUANTITY UMR___1_1_0_S6_S3 3 0 32767 DEPOSIT ABSOLUTE MONOTONY MON_INCREASE /end AXIS_DESCR
/end CHARACTERISTIC
/begin CHARACTERISTIC KL_MTPFADHSOB23_EL "Obere schaltungsabhaengige Momentenschwelle bei xy-Schaltung" CURVE 0x21BD78 kl_si16_S6_S3 2040 UMR_NM__1_1_0_S6_S3 -400 1640
 /begin AXIS_DESCR STD_AXIS NO_INPUT_QUANTITY UMR___1_1_0_S6_S3 3 0 32767 DEPOSIT ABSOLUTE MONOTONY MON_INCREASE /end AXIS_DESCR
/end CHARACTERISTIC
/begin CHARACTERISTIC KL_MTPFADHSUN23 "Untere schaltungsabhaengige Momentenschwelle bei xy-Schaltung" CURVE 0x21BD88 kl_si16_S6_S3 2040 UMR_NM__1_1_0_S6_S3 -400 1640
 /begin AXIS_DESCR STD_AXIS NO_INPUT_QUANTITY UMR___1_1_0_S6_S3 3 0 32767 DEPOSIT ABSOLUTE MONOTONY MON_INCREASE /end AXIS_DESCR
/end CHARACTERISTIC
/begin CHARACTERISTIC KL_MTPFADHSUN23_EL "Untere schaltungsabhaengige Momentenschwelle bei xy-Schaltung" CURVE 0x21BD98 kl_si16_S6_S3 2040 UMR_NM__1_1_0_S6_S3 -400 1640
 /begin AXIS_DESCR STD_AXIS NO_INPUT_QUANTITY UMR___1_1_0_S6_S3 3 0 32767 DEPOSIT ABSOLUTE MONOTONY MON_INCREASE /end AXIS_DESCR
/end CHARACTERISTIC
/begin CHARACTERISTIC KL_NTPFADHSOB23 "Obere schaltungsabhaengige Drehzahlschwelle bei xy-Schaltung" CURVE 0x21BDA8 kl_ui16_S6_S3 8200 UMR_U_MIN_1_1_0_S6_S3 0 8200
 /begin AXIS_DESCR STD_AXIS NO_INPUT_QUANTITY UMR___1_1_0_S6_S3 3 0 65535 DEPOSIT ABSOLUTE MONOTONY MON_INCREASE /end AXIS_DESCR
/end CHARACTERISTIC
/begin CHARACTERISTIC KL_NTPFADHSOB23_EL "Obere schaltungsabhaengige Drehzahlschwelle bei xy-Schaltung" CURVE 0x21BDB8 kl_ui16_S6_S3 8200 UMR_U_MIN_1_1_0_S6_S3 0 8200
 /begin AXIS_DESCR STD_AXIS NO_INPUT_QUANTITY UMR___1_1_0_S6_S3 3 0 65535 DEPOSIT ABSOLUTE MONOTONY MON_INCREASE /end AXIS_DESCR
/end CHARACTERISTIC
/begin CHARACTERISTIC KL_NTPFADHSUN23 "Untere schaltungsabhaengige Drehzahlschwelle bei xy-Schaltung" CURVE 0x21BDC8 kl_ui16_S6_S3 8200 UMR_U_MIN_1_1_0_S6_S3 0 8200
 /begin AXIS_DESCR STD_AXIS NO_INPUT_QUANTITY UMR___1_1_0_S6_S3 3 0 65535 DEPOSIT ABSOLUTE MONOTONY MON_INCREASE /end AXIS_DESCR
/end CHARACTERISTIC
/begin CHARACTERISTIC KL_NTPFADHSUN23_EL "Untere schaltungsabhaengige Drehzahlschwelle bei xy-Schaltung" CURVE 0x21BDD8 kl_ui16_S6_S3 8200 UMR_U_MIN_1_1_0_S6_S3 0 8200
 /begin AXIS_DESCR STD_AXIS NO_INPUT_QUANTITY UMR___1_1_0_S6_S3 3 0 65535 DEPOSIT ABSOLUTE MONOTONY MON_INCREASE /end AXIS_DESCR
/end CHARACTERISTIC
/begin CHARACTERISTIC ND_PFADHS23 "Differenzdrehzahl zu Synchron alter Gang zur Erkenng Drehzahleinzug" VALUE 0x26D35C kw_ui16_S6_S3 8200 UMR_U_MIN_1_1_0_S6_S3 0 8200 /end CHARACTERISTIC
/begin CHARACTERISTIC KF_PFADMTHS34 "Adaptionswert PFAD fuer xy-Schaltung" MAP 0x21BDE8 kf_si16_S6_S3 2.5 UMR_BAR__1_1000_0_S6_S3 -1.25 1.25
 /begin AXIS_DESCR STD_AXIS iAdaPfusf.td_pfad UMR_MSEC__10_1_0_S6_S3 10 -5000 5000 DEPOSIT ABSOLUTE MONOTONY MON_INCREASE /end AXIS_DESCR
 /begin AXIS_DESCR STD_AXIS iAdaPfusf.m_t_pfad UMR_NM__1_1_0_S6_S3 5 -400 1640 DEPOSIT ABSOLUTE MONOTONY MON_INCREASE /end AXIS_DESCR
/end CHARACTERISTIC
/begin CHARACTERISTIC KF_PFADMTHS34_EL "Adaptionswert PFAD fuer xy-Schaltung" MAP 0x21BE74 kf_si16_S6_S3 2.5 UMR_BAR__1_1000_0_S6_S3 -1.25 1.25
 /begin AXIS_DESCR STD_AXIS iAdaPfusf.td_pfad UMR_MSEC__10_1_0_S6_S3 10 -5000 5000 DEPOSIT ABSOLUTE MONOTONY MON_INCREASE /end AXIS_DESCR
 /begin AXIS_DESCR STD_AXIS iAdaPfusf.m_t_pfad UMR_NM__1_1_0_S6_S3 5 -400 1640 DEPOSIT ABSOLUTE MONOTONY MON_INCREASE /end AXIS_DESCR
/end CHARACTERISTIC
/begin CHARACTERISTIC KF_HSADEINZPKT34 "Solleinzugszeitpunkt nach Ende Rampe 1" MAP 0x21BF00 kf_si16_S6_S3 20000 UMR_MSEC__10_1_0_S6_S3 -10000 10000
 /begin AXIS_DESCR STD_AXIS iItfInput.n_t UMR_U_MIN_1_1_0_S6_S3 5 0 8000 DEPOSIT ABSOLUTE MONOTONY MON_INCREASE /end AXIS_DESCR
 /begin AXIS_DESCR STD_AXIS iItfInput.m_t UMR_NM__1_1_0_S6_S3 5 -400 1640 DEPOSIT ABSOLUTE MONOTONY MON_INCREASE /end AXIS_DESCR
/end CHARACTERISTIC
/begin CHARACTERISTIC KF_HSADEINZPKT34_EL "Solleinzugszeitpunkt nach Ende Rampe 1" MAP 0x21BF50 kf_si16_S6_S3 20000 UMR_MSEC__10_1_0_S6_S3 -10000 10000
 /begin AXIS_DESCR STD_AXIS iItfInput.n_t UMR_U_MIN_1_1_0_S6_S3 5 0 8000 DEPOSIT ABSOLUTE MONOTONY MON_INCREASE /end AXIS_DESCR
 /begin AXIS_DESCR STD_AXIS iItfInput.m_t UMR_NM__1_1_0_S6_S3 5 -400 1640 DEPOSIT ABSOLUTE MONOTONY MON_INCREASE /end AXIS_DESCR
/end CHARACTERISTIC
/begin CHARACTERISTIC T_VPFADHS34 "Verzoegerungszeit Bewertung Schaltung xy" VALUE 0x26E405 kw_ui8_S6_S3 1000 UMR_MSEC__10_1_0_S6_S3 0 1000 /end CHARACTERISTIC
/begin CHARACTERISTIC KL_MTPFADHSOB34 "Obere schaltungsabhaengige Momentenschwelle bei xy-Schaltung" CURVE 0x21BFA0 kl_si16_S6_S3 2040 UMR_NM__1_1_0_S6_S3 -400 1640
 /begin AXIS_DESCR STD_AXIS NO_INPUT_QUANTITY UMR___1_1_0_S6_S3 3 0 32767 DEPOSIT ABSOLUTE MONOTONY MON_INCREASE /end AXIS_DESCR
/end CHARACTERISTIC
/begin CHARACTERISTIC KL_MTPFADHSOB34_EL "Obere schaltungsabhaengige Momentenschwelle bei xy-Schaltung" CURVE 0x21BFB0 kl_si16_S6_S3 2040 UMR_NM__1_1_0_S6_S3 -400 1640
 /begin AXIS_DESCR STD_AXIS NO_INPUT_QUANTITY UMR___1_1_0_S6_S3 3 0 32767 DEPOSIT ABSOLUTE MONOTONY MON_INCREASE /end AXIS_DESCR
/end CHARACTERISTIC
/begin CHARACTERISTIC KL_MTPFADHSUN34 "Untere schaltungsabhaengige Momentenschwelle bei xy-Schaltung" CURVE 0x21BFC0 kl_si16_S6_S3 2040 UMR_NM__1_1_0_S6_S3 -400 1640
 /begin AXIS_DESCR STD_AXIS NO_INPUT_QUANTITY UMR___1_1_0_S6_S3 3 0 32767 DEPOSIT ABSOLUTE MONOTONY MON_INCREASE /end AXIS_DESCR
/end CHARACTERISTIC
/begin CHARACTERISTIC KL_MTPFADHSUN34_EL "Untere schaltungsabhaengige Momentenschwelle bei xy-Schaltung" CURVE 0x21BFD0 kl_si16_S6_S3 2040 UMR_NM__1_1_0_S6_S3 -400 1640
 /begin AXIS_DESCR STD_AXIS NO_INPUT_QUANTITY UMR___1_1_0_S6_S3 3 0 32767 DEPOSIT ABSOLUTE MONOTONY MON_INCREASE /end AXIS_DESCR
/end CHARACTERISTIC
/begin CHARACTERISTIC KL_NTPFADHSOB34 "Obere schaltungsabhaengige Drehzahlschwelle bei xy-Schaltung" CURVE 0x21BFE0 kl_ui16_S6_S3 8200 UMR_U_MIN_1_1_0_S6_S3 0 8200
 /begin AXIS_DESCR STD_AXIS NO_INPUT_QUANTITY UMR___1_1_0_S6_S3 3 0 65535 DEPOSIT ABSOLUTE MONOTONY MON_INCREASE /end AXIS_DESCR
/end CHARACTERISTIC
/begin CHARACTERISTIC KL_NTPFADHSOB34_EL "Obere schaltungsabhaengige Drehzahlschwelle bei xy-Schaltung" CURVE 0x21BFF0 kl_ui16_S6_S3 8200 UMR_U_MIN_1_1_0_S6_S3 0 8200
 /begin AXIS_DESCR STD_AXIS NO_INPUT_QUANTITY UMR___1_1_0_S6_S3 3 0 65535 DEPOSIT ABSOLUTE MONOTONY MON_INCREASE /end AXIS_DESCR
/end CHARACTERISTIC
/begin CHARACTERISTIC KL_NTPFADHSUN34 "Untere schaltungsabhaengige Drehzahlschwelle bei xy-Schaltung" CURVE 0x21C000 kl_ui16_S6_S3 8200 UMR_U_MIN_1_1_0_S6_S3 0 8200
 /begin AXIS_DESCR STD_AXIS NO_INPUT_QUANTITY UMR___1_1_0_S6_S3 3 0 65535 DEPOSIT ABSOLUTE MONOTONY MON_INCREASE /end AXIS_DESCR
/end CHARACTERISTIC
/begin CHARACTERISTIC KL_NTPFADHSUN34_EL "Untere schaltungsabhaengige Drehzahlschwelle bei xy-Schaltung" CURVE 0x21C010 kl_ui16_S6_S3 8200 UMR_U_MIN_1_1_0_S6_S3 0 8200
 /begin AXIS_DESCR STD_AXIS NO_INPUT_QUANTITY UMR___1_1_0_S6_S3 3 0 65535 DEPOSIT ABSOLUTE MONOTONY MON_INCREASE /end AXIS_DESCR
/end CHARACTERISTIC
/begin CHARACTERISTIC ND_PFADHS34 "Differenzdrehzahl zu Synchron alter Gang zur Erkenng Drehzahleinzug" VALUE 0x26D35E kw_ui16_S6_S3 8200 UMR_U_MIN_1_1_0_S6_S3 0 8200 /end CHARACTERISTIC
/begin CHARACTERISTIC KF_PFADMTHS45 "Adaptionswert PFAD fuer xy-Schaltung" MAP 0x21C020 kf_si16_S6_S3 2.5 UMR_BAR__1_1000_0_S6_S3 -1.25 1.25
 /begin AXIS_DESCR STD_AXIS iAdaPfusf.td_pfad UMR_MSEC__10_1_0_S6_S3 10 -5000 5000 DEPOSIT ABSOLUTE MONOTONY MON_INCREASE /end AXIS_DESCR
 /begin AXIS_DESCR STD_AXIS iAdaPfusf.m_t_pfad UMR_NM__1_1_0_S6_S3 5 -400 1640 DEPOSIT ABSOLUTE MONOTONY MON_INCREASE /end AXIS_DESCR
/end CHARACTERISTIC
/begin CHARACTERISTIC KF_PFADMTHS45_EL "Adaptionswert PFAD fuer xy-Schaltung" MAP 0x21C0AC kf_si16_S6_S3 2.5 UMR_BAR__1_1000_0_S6_S3 -1.25 1.25
 /begin AXIS_DESCR STD_AXIS iAdaPfusf.td_pfad UMR_MSEC__10_1_0_S6_S3 10 -5000 5000 DEPOSIT ABSOLUTE MONOTONY MON_INCREASE /end AXIS_DESCR
 /begin AXIS_DESCR STD_AXIS iAdaPfusf.m_t_pfad UMR_NM__1_1_0_S6_S3 5 -400 1640 DEPOSIT ABSOLUTE MONOTONY MON_INCREASE /end AXIS_DESCR
/end CHARACTERISTIC
/begin CHARACTERISTIC KF_HSADEINZPKT45 "Solleinzugszeitpunkt nach Ende Rampe 1" MAP 0x21C138 kf_si16_S6_S3 20000 UMR_MSEC__10_1_0_S6_S3 -10000 10000
 /begin AXIS_DESCR STD_AXIS iItfInput.n_t UMR_U_MIN_1_1_0_S6_S3 5 0 8000 DEPOSIT ABSOLUTE MONOTONY MON_INCREASE /end AXIS_DESCR
 /begin AXIS_DESCR STD_AXIS iItfInput.m_t UMR_NM__1_1_0_S6_S3 5 -400 1640 DEPOSIT ABSOLUTE MONOTONY MON_INCREASE /end AXIS_DESCR
/end CHARACTERISTIC
/begin CHARACTERISTIC KF_HSADEINZPKT45_EL "Solleinzugszeitpunkt nach Ende Rampe 1" MAP 0x21C188 kf_si16_S6_S3 20000 UMR_MSEC__10_1_0_S6_S3 -10000 10000
 /begin AXIS_DESCR STD_AXIS iItfInput.n_t UMR_U_MIN_1_1_0_S6_S3 5 0 8000 DEPOSIT ABSOLUTE MONOTONY MON_INCREASE /end AXIS_DESCR
 /begin AXIS_DESCR STD_AXIS iItfInput.m_t UMR_NM__1_1_0_S6_S3 5 -400 1640 DEPOSIT ABSOLUTE MONOTONY MON_INCREASE /end AXIS_DESCR
/end CHARACTERISTIC
/begin CHARACTERISTIC T_VPFADHS45 "Verzoegerungszeit Bewertung Schaltung xy" VALUE 0x26E406 kw_ui8_S6_S3 1000 UMR_MSEC__10_1_0_S6_S3 0 1000 /end CHARACTERISTIC
/begin CHARACTERISTIC KL_MTPFADHSOB45 "Obere schaltungsabhaengige Momentenschwelle bei xy-Schaltung" CURVE 0x21C1D8 kl_si16_S6_S3 2040 UMR_NM__1_1_0_S6_S3 -400 1640
 /begin AXIS_DESCR STD_AXIS NO_INPUT_QUANTITY UMR___1_1_0_S6_S3 3 0 32767 DEPOSIT ABSOLUTE MONOTONY MON_INCREASE /end AXIS_DESCR
/end CHARACTERISTIC
/begin CHARACTERISTIC KL_MTPFADHSOB45_EL "Obere schaltungsabhaengige Momentenschwelle bei xy-Schaltung" CURVE 0x21C1E8 kl_si16_S6_S3 2040 UMR_NM__1_1_0_S6_S3 -400 1640
 /begin AXIS_DESCR STD_AXIS NO_INPUT_QUANTITY UMR___1_1_0_S6_S3 3 0 32767 DEPOSIT ABSOLUTE MONOTONY MON_INCREASE /end AXIS_DESCR
/end CHARACTERISTIC
/begin CHARACTERISTIC KL_MTPFADHSUN45 "Untere schaltungsabhaengige Momentenschwelle bei xy-Schaltung" CURVE 0x21C1F8 kl_si16_S6_S3 2040 UMR_NM__1_1_0_S6_S3 -400 1640
 /begin AXIS_DESCR STD_AXIS NO_INPUT_QUANTITY UMR___1_1_0_S6_S3 3 0 32767 DEPOSIT ABSOLUTE MONOTONY MON_INCREASE /end AXIS_DESCR
/end CHARACTERISTIC
/begin CHARACTERISTIC KL_MTPFADHSUN45_EL "Untere schaltungsabhaengige Momentenschwelle bei xy-Schaltung" CURVE 0x21C208 kl_si16_S6_S3 2040 UMR_NM__1_1_0_S6_S3 -400 1640
 /begin AXIS_DESCR STD_AXIS NO_INPUT_QUANTITY UMR___1_1_0_S6_S3 3 0 32767 DEPOSIT ABSOLUTE MONOTONY MON_INCREASE /end AXIS_DESCR
/end CHARACTERISTIC
/begin CHARACTERISTIC KL_NTPFADHSOB45 "Obere schaltungsabhaengige Drehzahlschwelle bei xy-Schaltung" CURVE 0x21C218 kl_ui16_S6_S3 8200 UMR_U_MIN_1_1_0_S6_S3 0 8200
 /begin AXIS_DESCR STD_AXIS NO_INPUT_QUANTITY UMR___1_1_0_S6_S3 3 0 65535 DEPOSIT ABSOLUTE MONOTONY MON_INCREASE /end AXIS_DESCR
/end CHARACTERISTIC
/begin CHARACTERISTIC KL_NTPFADHSOB45_EL "Obere schaltungsabhaengige Drehzahlschwelle bei xy-Schaltung" CURVE 0x21C228 kl_ui16_S6_S3 8200 UMR_U_MIN_1_1_0_S6_S3 0 8200
 /begin AXIS_DESCR STD_AXIS NO_INPUT_QUANTITY UMR___1_1_0_S6_S3 3 0 65535 DEPOSIT ABSOLUTE MONOTONY MON_INCREASE /end AXIS_DESCR
/end CHARACTERISTIC
/begin CHARACTERISTIC KL_NTPFADHSUN45 "Untere schaltungsabhaengige Drehzahlschwelle bei xy-Schaltung" CURVE 0x21C238 kl_ui16_S6_S3 8200 UMR_U_MIN_1_1_0_S6_S3 0 8200
 /begin AXIS_DESCR STD_AXIS NO_INPUT_QUANTITY UMR___1_1_0_S6_S3 3 0 65535 DEPOSIT ABSOLUTE MONOTONY MON_INCREASE /end AXIS_DESCR
/end CHARACTERISTIC
/begin CHARACTERISTIC KL_NTPFADHSUN45_EL "Untere schaltungsabhaengige Drehzahlschwelle bei xy-Schaltung" CURVE 0x21C248 kl_ui16_S6_S3 8200 UMR_U_MIN_1_1_0_S6_S3 0 8200
 /begin AXIS_DESCR STD_AXIS NO_INPUT_QUANTITY UMR___1_1_0_S6_S3 3 0 65535 DEPOSIT ABSOLUTE MONOTONY MON_INCREASE /end AXIS_DESCR
/end CHARACTERISTIC
/begin CHARACTERISTIC ND_PFADHS45 "Differenzdrehzahl zu Synchron alter Gang zur Erkenng Drehzahleinzug" VALUE 0x26D360 kw_ui16_S6_S3 8200 UMR_U_MIN_1_1_0_S6_S3 0 8200 /end CHARACTERISTIC
/begin CHARACTERISTIC KF_PFADMTHS56 "Adaptionswert PFAD fuer xy-Schaltung" MAP 0x21C258 kf_si16_S6_S3 2.5 UMR_BAR__1_1000_0_S6_S3 -1.25 1.25
 /begin AXIS_DESCR STD_AXIS iAdaPfusf.td_pfad UMR_MSEC__10_1_0_S6_S3 10 -5000 5000 DEPOSIT ABSOLUTE MONOTONY MON_INCREASE /end AXIS_DESCR
 /begin AXIS_DESCR STD_AXIS iAdaPfusf.m_t_pfad UMR_NM__1_1_0_S6_S3 5 -400 1640 DEPOSIT ABSOLUTE MONOTONY MON_INCREASE /end AXIS_DESCR
/end CHARACTERISTIC
/begin CHARACTERISTIC KF_PFADMTHS56_EL "Adaptionswert PFAD fuer xy-Schaltung" MAP 0x21C2E4 kf_si16_S6_S3 2.5 UMR_BAR__1_1000_0_S6_S3 -1.25 1.25
 /begin AXIS_DESCR STD_AXIS iAdaPfusf.td_pfad UMR_MSEC__10_1_0_S6_S3 10 -5000 5000 DEPOSIT ABSOLUTE MONOTONY MON_INCREASE /end AXIS_DESCR
 /begin AXIS_DESCR STD_AXIS iAdaPfusf.m_t_pfad UMR_NM__1_1_0_S6_S3 5 -400 1640 DEPOSIT ABSOLUTE MONOTONY MON_INCREASE /end AXIS_DESCR
/end CHARACTERISTIC
/begin CHARACTERISTIC KF_HSADEINZPKT56 "Solleinzugszeitpunkt nach Ende Rampe 1" MAP 0x21C370 kf_si16_S6_S3 20000 UMR_MSEC__10_1_0_S6_S3 -10000 10000
 /begin AXIS_DESCR STD_AXIS iItfInput.n_t UMR_U_MIN_1_1_0_S6_S3 5 0 8000 DEPOSIT ABSOLUTE MONOTONY MON_INCREASE /end AXIS_DESCR
 /begin AXIS_DESCR STD_AXIS iItfInput.m_t UMR_NM__1_1_0_S6_S3 5 -400 1640 DEPOSIT ABSOLUTE MONOTONY MON_INCREASE /end AXIS_DESCR
/end CHARACTERISTIC
/begin CHARACTERISTIC KF_HSADEINZPKT56_EL "Solleinzugszeitpunkt nach Ende Rampe 1" MAP 0x21C3C0 kf_si16_S6_S3 20000 UMR_MSEC__10_1_0_S6_S3 -10000 10000
 /begin AXIS_DESCR STD_AXIS iItfInput.n_t UMR_U_MIN_1_1_0_S6_S3 5 0 8000 DEPOSIT ABSOLUTE MONOTONY MON_INCREASE /end AXIS_DESCR
 /begin AXIS_DESCR STD_AXIS iItfInput.m_t UMR_NM__1_1_0_S6_S3 5 -400 1640 DEPOSIT ABSOLUTE MONOTONY MON_INCREASE /end AXIS_DESCR
/end CHARACTERISTIC
/begin CHARACTERISTIC T_VPFADHS56 "Verzoegerungszeit Bewertung Schaltung xy" VALUE 0x26E407 kw_ui8_S6_S3 1000 UMR_MSEC__10_1_0_S6_S3 0 1000 /end CHARACTERISTIC
/begin CHARACTERISTIC KL_MTPFADHSOB56 "Obere schaltungsabhaengige Momentenschwelle bei xy-Schaltung" CURVE 0x21C410 kl_si16_S6_S3 2040 UMR_NM__1_1_0_S6_S3 -400 1640
 /begin AXIS_DESCR STD_AXIS NO_INPUT_QUANTITY UMR___1_1_0_S6_S3 3 0 32767 DEPOSIT ABSOLUTE MONOTONY MON_INCREASE /end AXIS_DESCR
/end CHARACTERISTIC
/begin CHARACTERISTIC KL_MTPFADHSOB56_EL "Obere schaltungsabhaengige Momentenschwelle bei xy-Schaltung" CURVE 0x21C420 kl_si16_S6_S3 2040 UMR_NM__1_1_0_S6_S3 -400 1640
 /begin AXIS_DESCR STD_AXIS NO_INPUT_QUANTITY UMR___1_1_0_S6_S3 3 0 32767 DEPOSIT ABSOLUTE MONOTONY MON_INCREASE /end AXIS_DESCR
/end CHARACTERISTIC
/begin CHARACTERISTIC KL_MTPFADHSUN56 "Untere schaltungsabhaengige Momentenschwelle bei xy-Schaltung" CURVE 0x21C430 kl_si16_S6_S3 2040 UMR_NM__1_1_0_S6_S3 -400 1640
 /begin AXIS_DESCR STD_AXIS NO_INPUT_QUANTITY UMR___1_1_0_S6_S3 3 0 32767 DEPOSIT ABSOLUTE MONOTONY MON_INCREASE /end AXIS_DESCR
/end CHARACTERISTIC
/begin CHARACTERISTIC KL_MTPFADHSUN56_EL "Untere schaltungsabhaengige Momentenschwelle bei xy-Schaltung" CURVE 0x21C440 kl_si16_S6_S3 2040 UMR_NM__1_1_0_S6_S3 -400 1640
 /begin AXIS_DESCR STD_AXIS NO_INPUT_QUANTITY UMR___1_1_0_S6_S3 3 0 32767 DEPOSIT ABSOLUTE MONOTONY MON_INCREASE /end AXIS_DESCR
/end CHARACTERISTIC
/begin CHARACTERISTIC KL_NTPFADHSOB56 "Obere schaltungsabhaengige Drehzahlschwelle bei xy-Schaltung" CURVE 0x21C450 kl_ui16_S6_S3 8200 UMR_U_MIN_1_1_0_S6_S3 0 8200
 /begin AXIS_DESCR STD_AXIS NO_INPUT_QUANTITY UMR___1_1_0_S6_S3 3 0 65535 DEPOSIT ABSOLUTE MONOTONY MON_INCREASE /end AXIS_DESCR
/end CHARACTERISTIC
/begin CHARACTERISTIC KL_NTPFADHSOB56_EL "Obere schaltungsabhaengige Drehzahlschwelle bei xy-Schaltung" CURVE 0x21C460 kl_ui16_S6_S3 8200 UMR_U_MIN_1_1_0_S6_S3 0 8200
 /begin AXIS_DESCR STD_AXIS NO_INPUT_QUANTITY UMR___1_1_0_S6_S3 3 0 65535 DEPOSIT ABSOLUTE MONOTONY MON_INCREASE /end AXIS_DESCR
/end CHARACTERISTIC
/begin CHARACTERISTIC KL_NTPFADHSUN56 "Untere schaltungsabhaengige Drehzahlschwelle bei xy-Schaltung" CURVE 0x21C470 kl_ui16_S6_S3 8200 UMR_U_MIN_1_1_0_S6_S3 0 8200
 /begin AXIS_DESCR STD_AXIS NO_INPUT_QUANTITY UMR___1_1_0_S6_S3 3 0 65535 DEPOSIT ABSOLUTE MONOTONY MON_INCREASE /end AXIS_DESCR
/end CHARACTERISTIC
/begin CHARACTERISTIC KL_NTPFADHSUN56_EL "Untere schaltungsabhaengige Drehzahlschwelle bei xy-Schaltung" CURVE 0x21C480 kl_ui16_S6_S3 8200 UMR_U_MIN_1_1_0_S6_S3 0 8200
 /begin AXIS_DESCR STD_AXIS NO_INPUT_QUANTITY UMR___1_1_0_S6_S3 3 0 65535 DEPOSIT ABSOLUTE MONOTONY MON_INCREASE /end AXIS_DESCR
/end CHARACTERISTIC
/begin CHARACTERISTIC ND_PFADHS56 "Differenzdrehzahl zu Synchron alter Gang zur Erkenng Drehzahleinzug" VALUE 0x26D362 kw_ui16_S6_S3 8200 UMR_U_MIN_1_1_0_S6_S3 0 8200 /end CHARACTERISTIC
/begin CHARACTERISTIC KF_PFADMTHS67 "Adaptionswert PFAD fuer xy-Schaltung" MAP 0x21C490 kf_si16_S6_S3 2.5 UMR_BAR__1_1000_0_S6_S3 -1.25 1.25
 /begin AXIS_DESCR STD_AXIS iAdaPfusf.td_pfad UMR_MSEC__10_1_0_S6_S3 10 -5000 5000 DEPOSIT ABSOLUTE MONOTONY MON_INCREASE /end AXIS_DESCR
 /begin AXIS_DESCR STD_AXIS iAdaPfusf.m_t_pfad UMR_NM__1_1_0_S6_S3 5 -400 1640 DEPOSIT ABSOLUTE MONOTONY MON_INCREASE /end AXIS_DESCR
/end CHARACTERISTIC
/begin CHARACTERISTIC KF_PFADMTHS67_EL "Adaptionswert PFAD fuer xy-Schaltung" MAP 0x21C51C kf_si16_S6_S3 2.5 UMR_BAR__1_1000_0_S6_S3 -1.25 1.25
 /begin AXIS_DESCR STD_AXIS iAdaPfusf.td_pfad UMR_MSEC__10_1_0_S6_S3 10 -5000 5000 DEPOSIT ABSOLUTE MONOTONY MON_INCREASE /end AXIS_DESCR
 /begin AXIS_DESCR STD_AXIS iAdaPfusf.m_t_pfad UMR_NM__1_1_0_S6_S3 5 -400 1640 DEPOSIT ABSOLUTE MONOTONY MON_INCREASE /end AXIS_DESCR
/end CHARACTERISTIC
/begin CHARACTERISTIC KF_HSADEINZPKT67 "Solleinzugszeitpunkt nach Ende Rampe 1" MAP 0x21C5A8 kf_si16_S6_S3 20000 UMR_MSEC__10_1_0_S6_S3 -10000 10000
 /begin AXIS_DESCR STD_AXIS iItfInput.n_t UMR_U_MIN_1_1_0_S6_S3 5 0 8000 DEPOSIT ABSOLUTE MONOTONY MON_INCREASE /end AXIS_DESCR
 /begin AXIS_DESCR STD_AXIS iItfInput.m_t UMR_NM__1_1_0_S6_S3 5 -400 1640 DEPOSIT ABSOLUTE MONOTONY MON_INCREASE /end AXIS_DESCR
/end CHARACTERISTIC
/begin CHARACTERISTIC KF_HSADEINZPKT67_EL "Solleinzugszeitpunkt nach Ende Rampe 1" MAP 0x21C5F8 kf_si16_S6_S3 20000 UMR_MSEC__10_1_0_S6_S3 -10000 10000
 /begin AXIS_DESCR STD_AXIS iItfInput.n_t UMR_U_MIN_1_1_0_S6_S3 5 0 8000 DEPOSIT ABSOLUTE MONOTONY MON_INCREASE /end AXIS_DESCR
 /begin AXIS_DESCR STD_AXIS iItfInput.m_t UMR_NM__1_1_0_S6_S3 5 -400 1640 DEPOSIT ABSOLUTE MONOTONY MON_INCREASE /end AXIS_DESCR
/end CHARACTERISTIC
/begin CHARACTERISTIC T_VPFADHS67 "Verzoegerungszeit Bewertung Schaltung xy" VALUE 0x26E408 kw_ui8_S6_S3 1000 UMR_MSEC__10_1_0_S6_S3 0 1000 /end CHARACTERISTIC
/begin CHARACTERISTIC KL_MTPFADHSOB67 "Obere schaltungsabhaengige Momentenschwelle bei xy-Schaltung" CURVE 0x21C648 kl_si16_S6_S3 2040 UMR_NM__1_1_0_S6_S3 -400 1640
 /begin AXIS_DESCR STD_AXIS NO_INPUT_QUANTITY UMR___1_1_0_S6_S3 3 0 32767 DEPOSIT ABSOLUTE MONOTONY MON_INCREASE /end AXIS_DESCR
/end CHARACTERISTIC
/begin CHARACTERISTIC KL_MTPFADHSOB67_EL "Obere schaltungsabhaengige Momentenschwelle bei xy-Schaltung" CURVE 0x21C658 kl_si16_S6_S3 2040 UMR_NM__1_1_0_S6_S3 -400 1640
 /begin AXIS_DESCR STD_AXIS NO_INPUT_QUANTITY UMR___1_1_0_S6_S3 3 0 32767 DEPOSIT ABSOLUTE MONOTONY MON_INCREASE /end AXIS_DESCR
/end CHARACTERISTIC
/begin CHARACTERISTIC KL_MTPFADHSUN67 "Untere schaltungsabhaengige Momentenschwelle bei xy-Schaltung" CURVE 0x21C668 kl_si16_S6_S3 2040 UMR_NM__1_1_0_S6_S3 -400 1640
 /begin AXIS_DESCR STD_AXIS NO_INPUT_QUANTITY UMR___1_1_0_S6_S3 3 0 32767 DEPOSIT ABSOLUTE MONOTONY MON_INCREASE /end AXIS_DESCR
/end CHARACTERISTIC
/begin CHARACTERISTIC KL_MTPFADHSUN67_EL "Untere schaltungsabhaengige Momentenschwelle bei xy-Schaltung" CURVE 0x21C678 kl_si16_S6_S3 2040 UMR_NM__1_1_0_S6_S3 -400 1640
 /begin AXIS_DESCR STD_AXIS NO_INPUT_QUANTITY UMR___1_1_0_S6_S3 3 0 32767 DEPOSIT ABSOLUTE MONOTONY MON_INCREASE /end AXIS_DESCR
/end CHARACTERISTIC
/begin CHARACTERISTIC KL_NTPFADHSOB67 "Obere schaltungsabhaengige Drehzahlschwelle bei xy-Schaltung" CURVE 0x21C688 kl_ui16_S6_S3 8200 UMR_U_MIN_1_1_0_S6_S3 0 8200
 /begin AXIS_DESCR STD_AXIS NO_INPUT_QUANTITY UMR___1_1_0_S6_S3 3 0 65535 DEPOSIT ABSOLUTE MONOTONY MON_INCREASE /end AXIS_DESCR
/end CHARACTERISTIC
/begin CHARACTERISTIC KL_NTPFADHSOB67_EL "Obere schaltungsabhaengige Drehzahlschwelle bei xy-Schaltung" CURVE 0x21C698 kl_ui16_S6_S3 8200 UMR_U_MIN_1_1_0_S6_S3 0 8200
 /begin AXIS_DESCR STD_AXIS NO_INPUT_QUANTITY UMR___1_1_0_S6_S3 3 0 65535 DEPOSIT ABSOLUTE MONOTONY MON_INCREASE /end AXIS_DESCR
/end CHARACTERISTIC
/begin CHARACTERISTIC KL_NTPFADHSUN67 "Untere schaltungsabhaengige Drehzahlschwelle bei xy-Schaltung" CURVE 0x21C6A8 kl_ui16_S6_S3 8200 UMR_U_MIN_1_1_0_S6_S3 0 8200
 /begin AXIS_DESCR STD_AXIS NO_INPUT_QUANTITY UMR___1_1_0_S6_S3 3 0 65535 DEPOSIT ABSOLUTE MONOTONY MON_INCREASE /end AXIS_DESCR
/end CHARACTERISTIC
/begin CHARACTERISTIC KL_NTPFADHSUN67_EL "Untere schaltungsabhaengige Drehzahlschwelle bei xy-Schaltung" CURVE 0x21C6B8 kl_ui16_S6_S3 8200 UMR_U_MIN_1_1_0_S6_S3 0 8200
 /begin AXIS_DESCR STD_AXIS NO_INPUT_QUANTITY UMR___1_1_0_S6_S3 3 0 65535 DEPOSIT ABSOLUTE MONOTONY MON_INCREASE /end AXIS_DESCR
/end CHARACTERISTIC
/begin CHARACTERISTIC ND_PFADHS67 "Differenzdrehzahl zu Synchron alter Gang zur Erkenng Drehzahleinzug" VALUE 0x26D364 kw_ui16_S6_S3 8200 UMR_U_MIN_1_1_0_S6_S3 0 8200 /end CHARACTERISTIC
/begin CHARACTERISTIC KF_PFADMTHS78 "Adaptionswert PFAD fuer xy-Schaltung" MAP 0x21C6C8 kf_si16_S6_S3 2.5 UMR_BAR__1_1000_0_S6_S3 -1.25 1.25
 /begin AXIS_DESCR STD_AXIS iAdaPfusf.td_pfad UMR_MSEC__10_1_0_S6_S3 10 -5000 5000 DEPOSIT ABSOLUTE MONOTONY MON_INCREASE /end AXIS_DESCR
 /begin AXIS_DESCR STD_AXIS iAdaPfusf.m_t_pfad UMR_NM__1_1_0_S6_S3 5 -400 1640 DEPOSIT ABSOLUTE MONOTONY MON_INCREASE /end AXIS_DESCR
/end CHARACTERISTIC
/begin CHARACTERISTIC KF_PFADMTHS78_EL "Adaptionswert PFAD fuer xy-Schaltung" MAP 0x21C754 kf_si16_S6_S3 2.5 UMR_BAR__1_1000_0_S6_S3 -1.25 1.25
 /begin AXIS_DESCR STD_AXIS iAdaPfusf.td_pfad UMR_MSEC__10_1_0_S6_S3 10 -5000 5000 DEPOSIT ABSOLUTE MONOTONY MON_INCREASE /end AXIS_DESCR
 /begin AXIS_DESCR STD_AXIS iAdaPfusf.m_t_pfad UMR_NM__1_1_0_S6_S3 5 -400 1640 DEPOSIT ABSOLUTE MONOTONY MON_INCREASE /end AXIS_DESCR
/end CHARACTERISTIC
/begin CHARACTERISTIC KF_HSADEINZPKT78 "Solleinzugszeitpunkt nach Ende Rampe 1" MAP 0x21C7E0 kf_si16_S6_S3 20000 UMR_MSEC__10_1_0_S6_S3 -10000 10000
 /begin AXIS_DESCR STD_AXIS iItfInput.n_t UMR_U_MIN_1_1_0_S6_S3 5 0 8000 DEPOSIT ABSOLUTE MONOTONY MON_INCREASE /end AXIS_DESCR
 /begin AXIS_DESCR STD_AXIS iItfInput.m_t UMR_NM__1_1_0_S6_S3 5 -400 1640 DEPOSIT ABSOLUTE MONOTONY MON_INCREASE /end AXIS_DESCR
/end CHARACTERISTIC
/begin CHARACTERISTIC KF_HSADEINZPKT78_EL "Solleinzugszeitpunkt nach Ende Rampe 1" MAP 0x21C830 kf_si16_S6_S3 20000 UMR_MSEC__10_1_0_S6_S3 -10000 10000
 /begin AXIS_DESCR STD_AXIS iItfInput.n_t UMR_U_MIN_1_1_0_S6_S3 5 0 8000 DEPOSIT ABSOLUTE MONOTONY MON_INCREASE /end AXIS_DESCR
 /begin AXIS_DESCR STD_AXIS iItfInput.m_t UMR_NM__1_1_0_S6_S3 5 -400 1640 DEPOSIT ABSOLUTE MONOTONY MON_INCREASE /end AXIS_DESCR
/end CHARACTERISTIC
/begin CHARACTERISTIC T_VPFADHS78 "Verzoegerungszeit Bewertung Schaltung xy" VALUE 0x26E409 kw_ui8_S6_S3 1000 UMR_MSEC__10_1_0_S6_S3 0 1000 /end CHARACTERISTIC
/begin CHARACTERISTIC KL_MTPFADHSOB78 "Obere schaltungsabhaengige Momentenschwelle bei xy-Schaltung" CURVE 0x21C880 kl_si16_S6_S3 2040 UMR_NM__1_1_0_S6_S3 -400 1640
 /begin AXIS_DESCR STD_AXIS NO_INPUT_QUANTITY UMR___1_1_0_S6_S3 3 0 32767 DEPOSIT ABSOLUTE MONOTONY MON_INCREASE /end AXIS_DESCR
/end CHARACTERISTIC
/begin CHARACTERISTIC KL_MTPFADHSOB78_EL "Obere schaltungsabhaengige Momentenschwelle bei xy-Schaltung" CURVE 0x21C890 kl_si16_S6_S3 2040 UMR_NM__1_1_0_S6_S3 -400 1640
 /begin AXIS_DESCR STD_AXIS NO_INPUT_QUANTITY UMR___1_1_0_S6_S3 3 0 32767 DEPOSIT ABSOLUTE MONOTONY MON_INCREASE /end AXIS_DESCR
/end CHARACTERISTIC
/begin CHARACTERISTIC KL_MTPFADHSUN78 "Untere schaltungsabhaengige Momentenschwelle bei xy-Schaltung" CURVE 0x21C8A0 kl_si16_S6_S3 2040 UMR_NM__1_1_0_S6_S3 -400 1640
 /begin AXIS_DESCR STD_AXIS NO_INPUT_QUANTITY UMR___1_1_0_S6_S3 3 0 32767 DEPOSIT ABSOLUTE MONOTONY MON_INCREASE /end AXIS_DESCR
/end CHARACTERISTIC
/begin CHARACTERISTIC KL_MTPFADHSUN78_EL "Untere schaltungsabhaengige Momentenschwelle bei xy-Schaltung" CURVE 0x21C8B0 kl_si16_S6_S3 2040 UMR_NM__1_1_0_S6_S3 -400 1640
 /begin AXIS_DESCR STD_AXIS NO_INPUT_QUANTITY UMR___1_1_0_S6_S3 3 0 32767 DEPOSIT ABSOLUTE MONOTONY MON_INCREASE /end AXIS_DESCR
/end CHARACTERISTIC
/begin CHARACTERISTIC KL_NTPFADHSOB78 "Obere schaltungsabhaengige Drehzahlschwelle bei xy-Schaltung" CURVE 0x21C8C0 kl_ui16_S6_S3 8200 UMR_U_MIN_1_1_0_S6_S3 0 8200
 /begin AXIS_DESCR STD_AXIS NO_INPUT_QUANTITY UMR___1_1_0_S6_S3 3 0 65535 DEPOSIT ABSOLUTE MONOTONY MON_INCREASE /end AXIS_DESCR
/end CHARACTERISTIC
/begin CHARACTERISTIC KL_NTPFADHSOB78_EL "Obere schaltungsabhaengige Drehzahlschwelle bei xy-Schaltung" CURVE 0x21C8D0 kl_ui16_S6_S3 8200 UMR_U_MIN_1_1_0_S6_S3 0 8200
 /begin AXIS_DESCR STD_AXIS NO_INPUT_QUANTITY UMR___1_1_0_S6_S3 3 0 65535 DEPOSIT ABSOLUTE MONOTONY MON_INCREASE /end AXIS_DESCR
/end CHARACTERISTIC
/begin CHARACTERISTIC KL_NTPFADHSUN78 "Untere schaltungsabhaengige Drehzahlschwelle bei xy-Schaltung" CURVE 0x21C8E0 kl_ui16_S6_S3 8200 UMR_U_MIN_1_1_0_S6_S3 0 8200
 /begin AXIS_DESCR STD_AXIS NO_INPUT_QUANTITY UMR___1_1_0_S6_S3 3 0 65535 DEPOSIT ABSOLUTE MONOTONY MON_INCREASE /end AXIS_DESCR
/end CHARACTERISTIC
/begin CHARACTERISTIC KL_NTPFADHSUN78_EL "Untere schaltungsabhaengige Drehzahlschwelle bei xy-Schaltung" CURVE 0x21C8F0 kl_ui16_S6_S3 8200 UMR_U_MIN_1_1_0_S6_S3 0 8200
 /begin AXIS_DESCR STD_AXIS NO_INPUT_QUANTITY UMR___1_1_0_S6_S3 3 0 65535 DEPOSIT ABSOLUTE MONOTONY MON_INCREASE /end AXIS_DESCR
/end CHARACTERISTIC
/begin CHARACTERISTIC ND_PFADHS78 "Differenzdrehzahl zu Synchron alter Gang zur Erkenng Drehzahleinzug" VALUE 0x26D366 kw_ui16_S6_S3 8200 UMR_U_MIN_1_1_0_S6_S3 0 8200 /end CHARACTERISTIC
/begin CHARACTERISTIC SWI_PFADHSSPABBR "Abbruch Fuelldruckadaption bei kurze HS" VALUE 0x26E3FA kw_bool8_S6_S3 1 UMR___1_1_0_S6_S3 0 1 /end CHARACTERISTIC
/begin CHARACTERISTIC SWI_PFADRSSPABBR "Abbruch Fuelldruckadaption bei kurze RS" VALUE 0x26E3FB kw_bool8_S6_S3 1 UMR___1_1_0_S6_S3 0 1 /end CHARACTERISTIC
/begin CHARACTERISTIC SWI_ZKINDEX_PFHS "Zugkraft-Korrektur-Kriterium fuer PF HS ADA" VALUE 0x26E3FC kw_bool8_S6_S3 1 UMR___1_1_0_S6_S3 0 1 /end CHARACTERISTIC
/begin CHARACTERISTIC SWI_ZKINDEX_PFRS "Zugkraft-Korrektur-Kriterium fuer PF RS ADA" VALUE 0x26E3FD kw_bool8_S6_S3 1 UMR___1_1_0_S6_S3 0 1 /end CHARACTERISTIC
/begin CHARACTERISTIC PS_PFADRS "Bremsdruck Schwelle fuer Adaption RS" VALUE 0x26E3FE kw_ui8_S6_S3 100 UMR_BAR__1_1_0_S6_S3 0 100 /end CHARACTERISTIC
/begin CHARACTERISTIC CS_PFADRSUN "Untere Grenztemperatur fuer Adaption RS" VALUE 0x26E3FF kw_ui8_S6_S3 190 UMR_GRADC__1_1_M40_S6_S3 -40 150 /end CHARACTERISTIC
/begin CHARACTERISTIC KL_CSPFADHSUN "Untere Grenztemperatur fuer Adaption HS" CURVE 0x21B894 kl_ui16_S6_S3 190 UMR_GRADC__1_1_M40_S6_S3 -40 150
 /begin AXIS_DESCR STD_AXIS NO_INPUT_QUANTITY UMR___1_1_0_S6_S3 3 0 65535 DEPOSIT ABSOLUTE MONOTONY MON_INCREASE /end AXIS_DESCR
/end CHARACTERISTIC
/begin CHARACTERISTIC CS_PFADOB "Obere Grenztemperatur fuer Adaption" VALUE 0x26E400 kw_ui8_S6_S3 190 UMR_GRADC__1_1_M40_S6_S3 -40 150 /end CHARACTERISTIC
/begin CHARACTERISTIC KL_FPFADLZ "Gewichtungsfaktor des Adaptionswertes" CURVE 0x21B8A4 kl_ui16_S6_S3 1 UMR___1_100_0_S6_S3 0 1
 /begin AXIS_DESCR STD_AXIS NO_INPUT_QUANTITY UMR___1_1_0_S6_S3 5 0 65535 DEPOSIT ABSOLUTE MONOTONY MON_INCREASE /end AXIS_DESCR
/end CHARACTERISTIC
/begin CHARACTERISTIC T_FNGABADA "Filterzeit Gradientenfilter Abtriebsdrehzahl" VALUE 0x26D34E kw_ui16_S6_S3 1000 UMR_MSEC__1_1_0_S6_S3 0 1000 /end CHARACTERISTIC
/begin CHARACTERISTIC TAB_SWIPFADHS "Schaltungsabhaengige Aktivierung der Adaption bei HS" CURVE 0x21B8BC tab_ui8_S6_S3 3 UMR___1_1_0_S6_S3 0 3
 /begin AXIS_DESCR FIX_AXIS NO_INPUT_QUANTITY UMR___1_1_0_S6_S3 7 0 6 FIX_AXIS_PAR_DIST 0 1 7 /end AXIS_DESCR
/end CHARACTERISTIC
/begin CHARACTERISTIC TAB_MAXFLARE_ADAPF "maximales Flare waehrend PF Adaption fuer Zwangsbewertung HS" CURVE 0x21B8C8 tab_ui16_S6_S3 500 UMR_U_MIN_1_1_0_S6_S3 0 500
 /begin AXIS_DESCR FIX_AXIS NO_INPUT_QUANTITY UMR___1_1_0_S6_S3 7 0 6 FIX_AXIS_PAR_DIST 0 1 7 /end AXIS_DESCR
/end CHARACTERISTIC
/begin CHARACTERISTIC TAB_ZWANGSBEW_ADAPF "Fuelldruck Zwangsbewertung PF Adaption HS (=minimales Adaptions-Delta)" CURVE 0x21B8DC tab_si16_S6_S3 1 UMR_BAR__1_1000_0_S6_S3 0 1
 /begin AXIS_DESCR FIX_AXIS NO_INPUT_QUANTITY UMR___1_1_0_S6_S3 5 0 4 FIX_AXIS_PAR_DIST 0 1 5 /end AXIS_DESCR
/end CHARACTERISTIC
/begin CHARACTERISTIC KL_DKISPFADMTHS "Grenzwert Lastaenderung fuer PF-Adaption" CURVE 0x21B8EC kl_si16_S6_S3 100 UMR_PROZENT__20_51_0_S6_S3 0 100
 /begin AXIS_DESCR STD_AXIS zff_atsys._.iSignale._.obj.sig_m_t UMR_NM__1_1_0_S6_S3 3 -400 1640 DEPOSIT ABSOLUTE MONOTONY MON_INCREASE /end AXIS_DESCR
/end CHARACTERISTIC
/begin CHARACTERISTIC KL_NGSABPFADMTHSUN "Untere Abtriebsdrehzahlgradientenschwelle Fuelldruckadaption HS" CURVE 0x21B8FC kl_si16_S6_S3 10000 UMR_U_MINSEC_1_1_0_S6_S3 -5000 5000
 /begin AXIS_DESCR STD_AXIS zff_atsys._.iSignale._.obj.sig_m_t UMR_NM__1_1_0_S6_S3 3 -400 1640 DEPOSIT ABSOLUTE MONOTONY MON_INCREASE /end AXIS_DESCR
/end CHARACTERISTIC
/begin CHARACTERISTIC KL_NGSABPFADMTHSOB "Obere Abtriebsdrehzahlgradientenschwelle Fuelldruckadaption HS" CURVE 0x21B90C kl_si16_S6_S3 10000 UMR_U_MINSEC_1_1_0_S6_S3 -5000 5000
 /begin AXIS_DESCR STD_AXIS zff_atsys._.iSignale._.obj.sig_m_t UMR_NM__1_1_0_S6_S3 3 -400 1640 DEPOSIT ABSOLUTE MONOTONY MON_INCREASE /end AXIS_DESCR
/end CHARACTERISTIC
/begin CHARACTERISTIC TAB_SWIPFADRS "Schaltungsabhaengige Aktivierung der Adaption bei RS" CURVE 0x21B91C tab_ui8_S6_S3 3 UMR___1_1_0_S6_S3 0 3
 /begin AXIS_DESCR FIX_AXIS NO_INPUT_QUANTITY UMR___1_1_0_S6_S3 7 0 6 FIX_AXIS_PAR_DIST 0 1 7 /end AXIS_DESCR
/end CHARACTERISTIC
/begin CHARACTERISTIC TAB_NTPFADRSUN "Untere schaltungsabhaengige Drehzahlschwelle bei RS" CURVE 0x21B928 tab_ui16_S6_S3 8200 UMR_U_MIN_1_1_0_S6_S3 0 8200
 /begin AXIS_DESCR FIX_AXIS NO_INPUT_QUANTITY UMR___1_1_0_S6_S3 7 0 6 FIX_AXIS_PAR_DIST 0 1 7 /end AXIS_DESCR
/end CHARACTERISTIC
/begin CHARACTERISTIC TAB_NTPFADRSOB "Obere schaltungsabhaengige Drehzahlschwelle bei RS" CURVE 0x21B93C tab_ui16_S6_S3 8200 UMR_U_MIN_1_1_0_S6_S3 0 8200
 /begin AXIS_DESCR FIX_AXIS NO_INPUT_QUANTITY UMR___1_1_0_S6_S3 7 0 6 FIX_AXIS_PAR_DIST 0 1 7 /end AXIS_DESCR
/end CHARACTERISTIC
/begin CHARACTERISTIC TAB_MTPFADRSUN "Untere schaltungsabhaengige Momentenschwelle bei RS" CURVE 0x21B950 tab_si16_S6_S3 2040 UMR_NM__1_1_0_S6_S3 -400 1640
 /begin AXIS_DESCR FIX_AXIS NO_INPUT_QUANTITY UMR___1_1_0_S6_S3 7 0 6 FIX_AXIS_PAR_DIST 0 1 7 /end AXIS_DESCR
/end CHARACTERISTIC
/begin CHARACTERISTIC TAB_MTPFADRSOB "Obere schaltungsabhaengige Momentenschwelle bei RS" CURVE 0x21B964 tab_si16_S6_S3 2040 UMR_NM__1_1_0_S6_S3 -400 1640
 /begin AXIS_DESCR FIX_AXIS NO_INPUT_QUANTITY UMR___1_1_0_S6_S3 7 0 6 FIX_AXIS_PAR_DIST 0 1 7 /end AXIS_DESCR
/end CHARACTERISTIC
/begin CHARACTERISTIC NGS_ABPFADRSUN "Untere Abtriebsdrehzahlgradientenschwelle Fuelldruckadaption RS" VALUE 0x26D350 kw_si16_S6_S3 10000 UMR_U_MINSEC_1_1_0_S6_S3 -5000 5000 /end CHARACTERISTIC
/begin CHARACTERISTIC NGS_ABPFADRSOB "Obere Abtriebsdrehzahlgradientenschwelle Fuelldruckadaption RS" VALUE 0x26D352 kw_si16_S6_S3 10000 UMR_U_MINSEC_1_1_0_S6_S3 -5000 5000 /end CHARACTERISTIC
/begin CHARACTERISTIC NS_MOTPFADRS "Motordrehzahlschwellwert fuer Adaptionsbewertung" VALUE 0x26D354 kw_ui16_S6_S3 8200 UMR_U_MIN_1_1_0_S6_S3 0 8200 /end CHARACTERISTIC
/begin CHARACTERISTIC NS_PFADRS "Drehzahlschwellwert fuer Adaptionsbewertung" VALUE 0x26D356 kw_ui16_S6_S3 8200 UMR_U_MIN_1_1_0_S6_S3 0 8200 /end CHARACTERISTIC
/begin CHARACTERISTIC ND_SYNISTGANG_KEINMTABBR "Diff-Drehzahl-Schwelle zur Deaktivierung m_t-Kriterium PFAD" VALUE 0x26D358 kw_si16_S6_S3 8000 UMR_U_MIN_1_1_0_S6_S3 -8000 0 /end CHARACTERISTIC
/begin CHARACTERISTIC DKIS_MOTPFADRS "DKI-Schwelle bei RS PFAD" VALUE 0x26E401 kw_ui8_S6_S3 100 UMR_PROZENT__20_51_0_S6_S3 0 100 /end CHARACTERISTIC
/begin CHARACTERISTIC SWI_HSADNOSPORT "Schalter um Trimm Fkt HS Ada fuer QS Schaltungs-Beeinflussung zu aktivieren" VALUE 0x26E402 kw_bool8_S6_S3 1 UMR___1_1_0_S6_S3 0 1 /end CHARACTERISTIC
/begin CHARACTERISTIC KL_PFADTSYN21 "Schaltungsabhaengige Sollschleifzeit PF Ada" CURVE 0x21C900 kl_ui16_S6_S3 2550 UMR_MSEC__10_1_0_S6_S3 0 2550
 /begin AXIS_DESCR STD_AXIS zff_atsys._.iSignale._.obj.sig_n_t UMR_U_MIN_1_1_0_S6_S3 2 0 8200 DEPOSIT ABSOLUTE MONOTONY MON_INCREASE /end AXIS_DESCR
/end CHARACTERISTIC
/begin CHARACTERISTIC KF_PFADRS21 "Schaltungsabhaengiger Adaptionswert PF ADAPFN" MAP 0x21C90C kf_si16_S6_S3 2.5 UMR_BAR__1_100_0_S6_S3 -1.25 1.25
 /begin AXIS_DESCR STD_AXIS iAdaPfusf.td_pfadtsyn UMR_MSEC__10_1_0_S6_S3 8 -300 300 DEPOSIT ABSOLUTE MONOTONY MON_INCREASE /end AXIS_DESCR
 /begin AXIS_DESCR STD_AXIS iAdaPfusf.pm_gls_pfad UMR_BAR__1_100_0_S6_S3 4 -1.25 1.25 DEPOSIT ABSOLUTE MONOTONY MON_INCREASE /end AXIS_DESCR
/end CHARACTERISTIC
/begin CHARACTERISTIC ND_PFADRS21 "Schaltungsabhaengige Differenzdrehzahl zu Synchron alter Gang PF Ada" VALUE 0x26D368 kw_ui16_S6_S3 8200 UMR_U_MIN_1_1_0_S6_S3 0 8200 /end CHARACTERISTIC
/begin CHARACTERISTIC KL_PFADTSYN32 "Schaltungsabhaengige Sollschleifzeit PF Ada" CURVE 0x21C96C kl_ui16_S6_S3 2550 UMR_MSEC__10_1_0_S6_S3 0 2550
 /begin AXIS_DESCR STD_AXIS zff_atsys._.iSignale._.obj.sig_n_t UMR_U_MIN_1_1_0_S6_S3 2 0 8200 DEPOSIT ABSOLUTE MONOTONY MON_INCREASE /end AXIS_DESCR
/end CHARACTERISTIC
/begin CHARACTERISTIC KF_PFADRS32 "Schaltungsabhaengiger Adaptionswert PF ADAPFN" MAP 0x21C978 kf_si16_S6_S3 2.5 UMR_BAR__1_100_0_S6_S3 -1.25 1.25
 /begin AXIS_DESCR STD_AXIS iAdaPfusf.td_pfadtsyn UMR_MSEC__10_1_0_S6_S3 8 -300 300 DEPOSIT ABSOLUTE MONOTONY MON_INCREASE /end AXIS_DESCR
 /begin AXIS_DESCR STD_AXIS iAdaPfusf.pm_gls_pfad UMR_BAR__1_100_0_S6_S3 4 -1.25 1.25 DEPOSIT ABSOLUTE MONOTONY MON_INCREASE /end AXIS_DESCR
/end CHARACTERISTIC
/begin CHARACTERISTIC ND_PFADRS32 "Schaltungsabhaengige Differenzdrehzahl zu Synchron alter Gang PF Ada" VALUE 0x26D36A kw_ui16_S6_S3 8200 UMR_U_MIN_1_1_0_S6_S3 0 8200 /end CHARACTERISTIC
/begin CHARACTERISTIC KL_PFADTSYN43 "Schaltungsabhaengige Sollschleifzeit PF Ada" CURVE 0x21C9D8 kl_ui16_S6_S3 2550 UMR_MSEC__10_1_0_S6_S3 0 2550
 /begin AXIS_DESCR STD_AXIS zff_atsys._.iSignale._.obj.sig_n_t UMR_U_MIN_1_1_0_S6_S3 2 0 8200 DEPOSIT ABSOLUTE MONOTONY MON_INCREASE /end AXIS_DESCR
/end CHARACTERISTIC
/begin CHARACTERISTIC KF_PFADRS43 "Schaltungsabhaengiger Adaptionswert PF ADAPFN" MAP 0x21C9E4 kf_si16_S6_S3 2.5 UMR_BAR__1_100_0_S6_S3 -1.25 1.25
 /begin AXIS_DESCR STD_AXIS iAdaPfusf.td_pfadtsyn UMR_MSEC__10_1_0_S6_S3 8 -300 300 DEPOSIT ABSOLUTE MONOTONY MON_INCREASE /end AXIS_DESCR
 /begin AXIS_DESCR STD_AXIS iAdaPfusf.pm_gls_pfad UMR_BAR__1_100_0_S6_S3 4 -1.25 1.25 DEPOSIT ABSOLUTE MONOTONY MON_INCREASE /end AXIS_DESCR
/end CHARACTERISTIC
/begin CHARACTERISTIC ND_PFADRS43 "Schaltungsabhaengige Differenzdrehzahl zu Synchron alter Gang PF Ada" VALUE 0x26D36C kw_ui16_S6_S3 8200 UMR_U_MIN_1_1_0_S6_S3 0 8200 /end CHARACTERISTIC
/begin CHARACTERISTIC KL_PFADTSYN54 "Schaltungsabhaengige Sollschleifzeit PF Ada" CURVE 0x21CA44 kl_ui16_S6_S3 2550 UMR_MSEC__10_1_0_S6_S3 0 2550
 /begin AXIS_DESCR STD_AXIS zff_atsys._.iSignale._.obj.sig_n_t UMR_U_MIN_1_1_0_S6_S3 2 0 8200 DEPOSIT ABSOLUTE MONOTONY MON_INCREASE /end AXIS_DESCR
/end CHARACTERISTIC
/begin CHARACTERISTIC KF_PFADRS54 "Schaltungsabhaengiger Adaptionswert PF ADAPFN" MAP 0x21CA50 kf_si16_S6_S3 2.5 UMR_BAR__1_100_0_S6_S3 -1.25 1.25
 /begin AXIS_DESCR STD_AXIS iAdaPfusf.td_pfadtsyn UMR_MSEC__10_1_0_S6_S3 8 -300 300 DEPOSIT ABSOLUTE MONOTONY MON_INCREASE /end AXIS_DESCR
 /begin AXIS_DESCR STD_AXIS iAdaPfusf.pm_gls_pfad UMR_BAR__1_100_0_S6_S3 4 -1.25 1.25 DEPOSIT ABSOLUTE MONOTONY MON_INCREASE /end AXIS_DESCR
/end CHARACTERISTIC
/begin CHARACTERISTIC ND_PFADRS54 "Schaltungsabhaengige Differenzdrehzahl zu Synchron alter Gang PF Ada" VALUE 0x26D36E kw_ui16_S6_S3 8200 UMR_U_MIN_1_1_0_S6_S3 0 8200 /end CHARACTERISTIC
/begin CHARACTERISTIC KL_PFADTSYN65 "Schaltungsabhaengige Sollschleifzeit PF Ada" CURVE 0x21CAB0 kl_ui16_S6_S3 2550 UMR_MSEC__10_1_0_S6_S3 0 2550
 /begin AXIS_DESCR STD_AXIS zff_atsys._.iSignale._.obj.sig_n_t UMR_U_MIN_1_1_0_S6_S3 2 0 8200 DEPOSIT ABSOLUTE MONOTONY MON_INCREASE /end AXIS_DESCR
/end CHARACTERISTIC
/begin CHARACTERISTIC KF_PFADRS65 "Schaltungsabhaengiger Adaptionswert PF ADAPFN" MAP 0x21CABC kf_si16_S6_S3 2.5 UMR_BAR__1_100_0_S6_S3 -1.25 1.25
 /begin AXIS_DESCR STD_AXIS iAdaPfusf.td_pfadtsyn UMR_MSEC__10_1_0_S6_S3 8 -300 300 DEPOSIT ABSOLUTE MONOTONY MON_INCREASE /end AXIS_DESCR
 /begin AXIS_DESCR STD_AXIS iAdaPfusf.pm_gls_pfad UMR_BAR__1_100_0_S6_S3 4 -1.25 1.25 DEPOSIT ABSOLUTE MONOTONY MON_INCREASE /end AXIS_DESCR
/end CHARACTERISTIC
/begin CHARACTERISTIC ND_PFADRS65 "Schaltungsabhaengige Differenzdrehzahl zu Synchron alter Gang PF Ada" VALUE 0x26D370 kw_ui16_S6_S3 8200 UMR_U_MIN_1_1_0_S6_S3 0 8200 /end CHARACTERISTIC
/begin CHARACTERISTIC KL_PFADTSYN76 "Schaltungsabhaengige Sollschleifzeit PF Ada" CURVE 0x21CB1C kl_ui16_S6_S3 2550 UMR_MSEC__10_1_0_S6_S3 0 2550
 /begin AXIS_DESCR STD_AXIS zff_atsys._.iSignale._.obj.sig_n_t UMR_U_MIN_1_1_0_S6_S3 2 0 8200 DEPOSIT ABSOLUTE MONOTONY MON_INCREASE /end AXIS_DESCR
/end CHARACTERISTIC
/begin CHARACTERISTIC KF_PFADRS76 "Schaltungsabhaengiger Adaptionswert PF ADAPFN" MAP 0x21CB28 kf_si16_S6_S3 2.5 UMR_BAR__1_100_0_S6_S3 -1.25 1.25
 /begin AXIS_DESCR STD_AXIS iAdaPfusf.td_pfadtsyn UMR_MSEC__10_1_0_S6_S3 8 -300 300 DEPOSIT ABSOLUTE MONOTONY MON_INCREASE /end AXIS_DESCR
 /begin AXIS_DESCR STD_AXIS iAdaPfusf.pm_gls_pfad UMR_BAR__1_100_0_S6_S3 4 -1.25 1.25 DEPOSIT ABSOLUTE MONOTONY MON_INCREASE /end AXIS_DESCR
/end CHARACTERISTIC
/begin CHARACTERISTIC ND_PFADRS76 "Schaltungsabhaengige Differenzdrehzahl zu Synchron alter Gang PF Ada" VALUE 0x26D372 kw_ui16_S6_S3 8200 UMR_U_MIN_1_1_0_S6_S3 0 8200 /end CHARACTERISTIC
/begin CHARACTERISTIC KL_PFADTSYN87 "Schaltungsabhaengige Sollschleifzeit PF Ada" CURVE 0x21CB88 kl_ui16_S6_S3 2550 UMR_MSEC__10_1_0_S6_S3 0 2550
 /begin AXIS_DESCR STD_AXIS zff_atsys._.iSignale._.obj.sig_n_t UMR_U_MIN_1_1_0_S6_S3 2 0 8200 DEPOSIT ABSOLUTE MONOTONY MON_INCREASE /end AXIS_DESCR
/end CHARACTERISTIC
/begin CHARACTERISTIC KF_PFADRS87 "Schaltungsabhaengiger Adaptionswert PF ADAPFN" MAP 0x21CB94 kf_si16_S6_S3 2.5 UMR_BAR__1_100_0_S6_S3 -1.25 1.25
 /begin AXIS_DESCR STD_AXIS iAdaPfusf.td_pfadtsyn UMR_MSEC__10_1_0_S6_S3 8 -300 300 DEPOSIT ABSOLUTE MONOTONY MON_INCREASE /end AXIS_DESCR
 /begin AXIS_DESCR STD_AXIS iAdaPfusf.pm_gls_pfad UMR_BAR__1_100_0_S6_S3 4 -1.25 1.25 DEPOSIT ABSOLUTE MONOTONY MON_INCREASE /end AXIS_DESCR
/end CHARACTERISTIC
/begin CHARACTERISTIC ND_PFADRS87 "Schaltungsabhaengige Differenzdrehzahl zu Synchron alter Gang PF Ada" VALUE 0x26D374 kw_ui16_S6_S3 8200 UMR_U_MIN_1_1_0_S6_S3 0 8200 /end CHARACTERISTIC
/begin COMPU_METHOD SAB_N_125RPM1000_S2_S3 "int = ((phys * 1000) / 125) - (0) U/min" RAT_FUNC "%5.3" "U/min" COEFFS 0 1000 -0 0 0 125 /end COMPU_METHOD
/begin COMPU_METHOD SAB_N_417RPM10000_S2_S3 "int = ((phys * 10000) / 417) - (0) 1/min" RAT_FUNC "%5.3" "1/min" COEFFS 0 10000 -0 0 0 417 /end COMPU_METHOD
/begin COMPU_METHOD SAB_N_RPM2_M10000_S2_S3 "int = ((phys * 2) / 1) - (-20000) 1/min" RAT_FUNC "%5.3" "1/min" COEFFS 0 2 20000 0 0 1 /end COMPU_METHOD
/begin COMPU_METHOD SAB_N_RPM2_M20000_S2_S3 "int = ((phys * 2) / 1) - (-20000) 1/min" RAT_FUNC "%3.1" "1/min" COEFFS 0 2 20000 0 0 1 /end COMPU_METHOD
/begin COMPU_METHOD SAB_N_RPM10_S2_S3 "int = ((phys * 10) / 1) - (0) 1/min" RAT_FUNC "%5.3" "1/min" COEFFS 0 10 -0 0 0 1 /end COMPU_METHOD
/begin COMPU_METHOD UMR___1_100_0_S6_S3 "int = ((phys * 100) / 1) - (0) [-]" RAT_FUNC "%4.2" "[-]" COEFFS 0 100 -0 0 0 1 /end COMPU_METHOD
/begin COMPU_METHOD UMR___1_1_0_S6_S3 "int = ((phys * 1) / 1) - (0) [-]" RAT_FUNC "%2.0" "[-]" COEFFS 0 1 -0 0 0 1 /end COMPU_METHOD
/begin COMPU_METHOD UMR_A_SEC_1_10_0_S6_S3 "int = ((phys * 10) / 1) - (0) [A/s]" RAT_FUNC "%3.1" "[A/s]" COEFFS 0 10 -0 0 0 1 /end COMPU_METHOD
/begin COMPU_METHOD UMR_NM__1_1_0_S6_S3 "int = ((phys * 1) / 1) - (0) [Nm]" RAT_FUNC "%2.0" "[Nm]" COEFFS 0 1 -0 0 0 1 /end COMPU_METHOD
/begin COMPU_METHOD UMR_NM__8_1_M50_S6_S3 "int = ((phys * 1) / 8) - (-50) [Nm]" RAT_FUNC "%2.0" "[Nm]" COEFFS 0 1 400 0 0 8 /end COMPU_METHOD
/begin COMPU_METHOD UMR_NM_SEC_1_1_0_S6_S3 "int = ((phys * 1) / 1) - (0) [Nm/s]" RAT_FUNC "%2.0" "[Nm/s]" COEFFS 0 1 -0 0 0 1 /end COMPU_METHOD
/begin COMPU_METHOD UMR_NM_BAR_1_1_0_S6_S3 "int = ((phys * 1) / 1) - (0) [Nm/bar]" RAT_FUNC "%2.0" "[Nm/bar]" COEFFS 0 1 -0 0 0 1 /end COMPU_METHOD
/begin COMPU_METHOD UMR_BAR__1_1000_0_S6_S3 "int = ((phys * 1000) / 1) - (0) [bar]" RAT_FUNC "%5.3" "[bar]" COEFFS 0 1000 -0 0 0 1 /end COMPU_METHOD
/begin COMPU_METHOD UMR_BAR__1_100_0_S6_S3 "int = ((phys * 100) / 1) - (0) [bar]" RAT_FUNC "%4.2" "[bar]" COEFFS 0 100 -0 0 0 1 /end COMPU_METHOD
/begin COMPU_METHOD UMR_BAR__1_1_0_S6_S3 "int = ((phys * 1) / 1) - (0) [bar]" RAT_FUNC "%2.0" "[bar]" COEFFS 0 1 -0 0 0 1 /end COMPU_METHOD
/begin COMPU_METHOD UMR_BAR_SEC_1_10_0_S6_S3 "int = ((phys * 10) / 1) - (0) [bar/s]" RAT_FUNC "%3.1" "[bar/s]" COEFFS 0 10 -0 0 0 1 /end COMPU_METHOD
/begin COMPU_METHOD UMR_BAR_SEC_1_1000_0_S6_S3 "int = ((phys * 1000) / 1) - (0) [bar/s]" RAT_FUNC "%6.4" "[bar/s]" COEFFS 0 1000 -0 0 0 1 /end COMPU_METHOD
/begin COMPU_METHOD UMR_BAR_SEC_1_1_0_S6_S3 "int = ((phys * 1) / 1) - (0) [bar/s]" RAT_FUNC "%2.0" "[bar/s]" COEFFS 0 1 -0 0 0 1 /end COMPU_METHOD
/begin COMPU_METHOD UMR_U_MIN_1_1_0_S6_S3 "int = ((phys * 1) / 1) - (0) [U/min]" RAT_FUNC "%2.0" "[U/min]" COEFFS 0 1 -0 0 0 1 /end COMPU_METHOD
/begin COMPU_METHOD UMR_U_MIN_32_1_0_S6_S3 "int = ((phys * 1) / 32) - (0) [U/min]" RAT_FUNC "%2.0" "[U/min]" COEFFS 0 1 -0 0 0 32 /end COMPU_METHOD
/begin COMPU_METHOD UMR_U_MINSEC_1_1_0_S6_S3 "int = ((phys * 1) / 1) - (0) [U/(min*s)]" RAT_FUNC "%2.0" "[U/(min*s)]" COEFFS 0 1 -0 0 0 1 /end COMPU_METHOD
/begin COMPU_METHOD UMR_MSEC__1_1_0_S6_S3 "int = ((phys * 1) / 1) - (0) [ms]" RAT_FUNC "%2.0" "[ms]" COEFFS 0 1 -0 0 0 1 /end COMPU_METHOD
/begin COMPU_METHOD UMR_MSEC__10_1_0_S6_S3 "int = ((phys * 1) / 10) - (0) [ms]" RAT_FUNC "%2.0" "[ms]" COEFFS 0 1 -0 0 0 10 /end COMPU_METHOD
/begin COMPU_METHOD UMR_SEC__1_1_0_S6_S3 "int = ((phys * 1) / 1) - (0) [s]" RAT_FUNC "%2.0" "[s]" COEFFS 0 1 -0 0 0 1 /end COMPU_METHOD
/begin COMPU_METHOD UMR_GRADC__1_1_0_S6_S3 "int = ((phys * 1) / 1) - (0) [°C]" RAT_FUNC "%2.0" "[°C]" COEFFS 0 1 -0 0 0 1 /end COMPU_METHOD
/begin COMPU_METHOD UMR_GRADC__1_1_M40_S6_S3 "int = ((phys * 1) / 1) - (-40) [°C]" RAT_FUNC "%2.0" "[°C]" COEFFS 0 1 40 0 0 1 /end COMPU_METHOD
/begin COMPU_METHOD UMR_PROZENT__1_100_0_S6_S3 "int = ((phys * 100) / 1) - (0) [%]" RAT_FUNC "%4.2" "[%]" COEFFS 0 100 -0 0 0 1 /end COMPU_METHOD
/begin COMPU_METHOD UMR_PROZENT__20_51_0_S6_S3 "int = ((phys * 51) / 20) - (0) [%]" RAT_FUNC "%6.4" "[%]" COEFFS 0 51 -0 0 0 20 /end COMPU_METHOD
/begin COMPU_METHOD UMR_PROZENT_SEC_1_1_0_S6_S3 "int = ((phys * 1) / 1) - (0) [%/s]" RAT_FUNC "%2.0" "[%/s]" COEFFS 0 1 -0 0 0 1 /end COMPU_METHOD
/begin COMPU_METHOD UMR_LITER_MIN_1_10_0_S6_S3 "int = ((phys * 10) / 1) - (0) [Liter/min]" RAT_FUNC "%3.1" "[Liter/min]" COEFFS 0 10 -0 0 0 1 /end COMPU_METHOD
/begin COMPU_METHOD UMR_M_SEC2_1_32_0_S6_S3 "int = ((phys * 32) / 1) - (0) [m/s^2]" RAT_FUNC "%4.2" "[m/s^2]" COEFFS 0 32 -0 0 0 1 /end COMPU_METHOD
/begin FUNCTION jModKuppl_Fktn "Applikationesgroessen Instanz jModKuppl"
 /begin DEF_CHARACTERISTIC F_TSFADAESTARTSTART_E KF_PCTG_ENTLEERK0 KF_PCTG_FUELLK0 KF_PO_BEFUELLGRAD_K0 KF_PSFCGMTESTART_E KF_TO_BEFUELLGRAD_K0 KL_F_TO_BEFUELLGRAD_K0 KL_F_TSFADAFUELLREDCGT_K0 KL_PGRAPSFFUELLRED_K0 KL_POFMIN_IAE KL_TOSFNKESTART KL_TSFCGESTART_E PO_SAEND TAB_PMAXKV TAB_SWISTROMSCHL TAB_SWI_DEAKT_DITHER_SF TAB_SWI_GLOBALSTROMSCHL TAB_SWI_PREPULS TS_KPL_AKTIV TS_KPL_INAKTIV /end DEF_CHARACTERISTIC
/end FUNCTION
/begin FUNCTION dModKupplK_Fktn "Applikationesgroessen der Komponente dModKupplK"
 /begin SUB_FUNCTION jModKupplKA_Fktn jModKupplKB_Fktn jModKupplKC_Fktn jModKupplKD_Fktn jModKupplKE_Fktn jModKupplK0_Fktn /end SUB_FUNCTION
/end FUNCTION
/begin FUNCTION jModKupplKA_Fktn "Applikationesgroessen Instanz jModKupplKA"
 /begin DEF_CHARACTERISTIC F_TSFADAFUELLOPT_A F_TSFADAFUELLRED_A IGKABENTLEER_A KF_FKOLBENPOSKORGA_A KF_FKOLBENPOSKOR_A KF_POSFCGNAB_A KF_PSFCGMTFUELLOPT_A KF_PSFCGMTFUELLRED_A KF_PSFCGMT_A KF_TENTLEER_A KF_TO1SFCG_A KF_TOENTLEERCGADA_A KF_TOSFGE_A KF_TOSFHSFUELLOPT_A KF_TOSFHSSPORT_A KF_TOSFHSSP_A KF_TOSFHS_A KF_TOSFHS_A_EL KF_TOSFRSSPORT_A KF_TOSFRSSP_A KF_TOSFRS_A KF_TOSFRS_A_EL KL_FKOLBENPOSCGKOR_A KL_FPFCGADAFUELLRED_A KL_PFCGGA_A KL_PFCG_A KL_PFHYSCG_A KL_PKUPPSTROM_A KL_TFPWIRK_A KL_TOSFNKFUELLOPT_A KL_TOSFNKFUELLRED_A KL_TOSFNK_A KL_TSFCGFUELLOPT_A KL_TSFCGFUELLRED_A KL_TSFCG_A KL_TTOTFUELL_A KL_TVCGSAENDGE_A KL_TVCGSAENDHS_A KL_TVCGSAENDRS_A PO_KOLBENPOSKORGA_A PO_KOLBENPOSKOR_A TOENTLEERSR_A TO_ABBRUCHSAEND_A T_O1SFAUSSB_A /end DEF_CHARACTERISTIC
/end FUNCTION
/begin FUNCTION jModKupplKB_Fktn "Applikationesgroessen Instanz jModKupplKB"
 /begin DEF_CHARACTERISTIC F_TSFADAFUELLOPT_B F_TSFADAFUELLRED_B IGKABENTLEER_B KF_FKOLBENPOSKORGA_B KF_FKOLBENPOSKOR_B KF_POSFCGNAB_B KF_PSFCGMTFUELLOPT_B KF_PSFCGMTFUELLRED_B KF_PSFCGMT_B KF_TENTLEER_B KF_TO1SFCG_B KF_TOENTLEERCGADA_B KF_TOSFGE_B KF_TOSFHSFUELLOPT_B KF_TOSFHSSPORT_B KF_TOSFHSSP_B KF_TOSFHS_B KF_TOSFHS_B_EL KF_TOSFRSSPORT_B KF_TOSFRSSP_B KF_TOSFRS_B KF_TOSFRS_B_EL KL_FKOLBENPOSCGKOR_B KL_FPFCGADAFUELLRED_B KL_PFCGGA_B KL_PFCG_B KL_PFHYSCG_B KL_PKUPPSTROM_B KL_TFPWIRK_B KL_TOSFNKFUELLOPT_B KL_TOSFNKFUELLRED_B KL_TOSFNK_B KL_TSFCGFUELLOPT_B KL_TSFCGFUELLRED_B KL_TSFCG_B KL_TTOTFUELL_B KL_TVCGSAENDGE_B KL_TVCGSAENDHS_B KL_TVCGSAENDRS_B PO_KOLBENPOSKORGA_B PO_KOLBENPOSKOR_B TOENTLEERSR_B TO_ABBRUCHSAEND_B T_O1SFAUSSB_B /end DEF_CHARACTERISTIC
/end FUNCTION
/begin FUNCTION jModKupplKC_Fktn "Applikationesgroessen Instanz jModKupplKC"
 /begin DEF_CHARACTERISTIC F_TSFADAFUELLOPT_C F_TSFADAFUELLRED_C IGKABENTLEER_C KF_FKOLBENPOSKORGA_C KF_FKOLBENPOSKOR_C KF_POSFCGNAB_C KF_PSFCGMTFUELLOPT_C KF_PSFCGMTFUELLRED_C KF_PSFCGMT_C KF_TENTLEER_C KF_TO1SFCG_C KF_TOENTLEERCGADA_C KF_TOSFGE_C KF_TOSFHSFUELLOPT_C KF_TOSFHSSPORT_C KF_TOSFHSSP_C KF_TOSFHS_C KF_TOSFHS_C_EL KF_TOSFRSSPORT_C KF_TOSFRSSP_C KF_TOSFRS_C KF_TOSFRS_C_EL KL_FKOLBENPOSCGKOR_C KL_FPFCGADAFUELLRED_C KL_PFCGGA_C KL_PFCG_C KL_PFHYSCG_C KL_PKUPPSTROM_C KL_TFPWIRK_C KL_TOSFNKFUELLOPT_C KL_TOSFNKFUELLRED_C KL_TOSFNK_C KL_TSFCGFUELLOPT_C KL_TSFCGFUELLRED_C KL_TSFCG_C KL_TTOTFUELL_C KL_TVCGSAENDGE_C KL_TVCGSAENDHS_C KL_TVCGSAENDRS_C PO_KOLBENPOSKORGA_C PO_KOLBENPOSKOR_C TOENTLEERSR_C TO_ABBRUCHSAEND_C T_O1SFAUSSB_C /end DEF_CHARACTERISTIC
/end FUNCTION
/begin FUNCTION jModKupplKD_Fktn "Applikationesgroessen Instanz jModKupplKD"
 /begin DEF_CHARACTERISTIC F_TSFADAFUELLOPT_D F_TSFADAFUELLRED_D IGKABENTLEER_D KF_FKOLBENPOSKORGA_D KF_FKOLBENPOSKOR_D KF_POSFCGNAB_D KF_PSFCGMTFUELLOPT_D KF_PSFCGMTFUELLRED_D KF_PSFCGMT_D KF_TENTLEER_D KF_TO1SFCG_D KF_TOENTLEERCGADA_D KF_TOSFGE_D KF_TOSFHSFUELLOPT_D KF_TOSFHSSPORT_D KF_TOSFHSSP_D KF_TOSFHS_D KF_TOSFHS_D_EL KF_TOSFRSSPORT_D KF_TOSFRSSP_D KF_TOSFRS_D KF_TOSFRS_D_EL KL_FKOLBENPOSCGKOR_D KL_FPFCGADAFUELLRED_D KL_PFCGGA_D KL_PFCG_D KL_PFHYSCG_D KL_PKUPPSTROM_D KL_TFPWIRK_D KL_TOSFNKFUELLOPT_D KL_TOSFNKFUELLRED_D KL_TOSFNK_D KL_TSFCGFUELLOPT_D KL_TSFCGFUELLRED_D KL_TSFCG_D KL_TTOTFUELL_D KL_TVCGSAENDGE_D KL_TVCGSAENDHS_D KL_TVCGSAENDRS_D PO_KOLBENPOSKORGA_D PO_KOLBENPOSKOR_D TOENTLEERSR_D TO_ABBRUCHSAEND_D T_O1SFAUSSB_D /end DEF_CHARACTERISTIC
/end FUNCTION
/begin FUNCTION jModKupplKE_Fktn "Applikationesgroessen Instanz jModKupplKE"
 /begin DEF_CHARACTERISTIC F_TSFADAFUELLOPT_E F_TSFADAFUELLRED_E IGKABENTLEER_E KF_FKOLBENPOSKORGA_E KF_FKOLBENPOSKOR_E KF_POSFCGNAB_E KF_PSFCGMTFUELLOPT_E KF_PSFCGMTFUELLRED_E KF_PSFCGMT_E KF_TENTLEER_E KF_TO1SFCG_E KF_TOENTLEERCGADA_E KF_TOSFGE_E KF_TOSFHSFUELLOPT_E KF_TOSFHSSPORT_E KF_TOSFHSSP_E KF_TOSFHS_E KF_TOSFHS_E_EL KF_TOSFRSSPORT_E KF_TOSFRSSP_E KF_TOSFRS_E KF_TOSFRS_E_EL KL_FKOLBENPOSCGKOR_E KL_FPFCGADAFUELLRED_E KL_PFCGGA_E KL_PFCG_E KL_PFHYSCG_E KL_PKUPPSTROM_E KL_TFPWIRK_E KL_TOSFNKFUELLOPT_E KL_TOSFNKFUELLRED_E KL_TOSFNK_E KL_TSFCGFUELLOPT_E KL_TSFCGFUELLRED_E KL_TSFCG_E KL_TTOTFUELL_E KL_TVCGSAENDGE_E KL_TVCGSAENDHS_E KL_TVCGSAENDRS_E PO_KOLBENPOSKORGA_E PO_KOLBENPOSKOR_E TOENTLEERSR_E TO_ABBRUCHSAEND_E T_O1SFAUSSB_E /end DEF_CHARACTERISTIC
/end FUNCTION
/begin FUNCTION jModKupplK0_Fktn "Applikationesgroessen Instanz jModKupplK0"
 /begin DEF_CHARACTERISTIC F_TSFADAFUELLOPT_K0 F_TSFADAFUELLRED_K0 IGKABENTLEER_K0 KF_FKOLBENPOSKORGA_K0 KF_FKOLBENPOSKOR_K0 KF_PFCGNMOT_K0 KF_POSFCGNAB_K0 KF_PSFCGMTFUELLOPT_K0 KF_PSFCGMTFUELLRED_K0 KF_PSFCGMT_K0 KF_TENTLEER_K0 KF_TO1SFCG_K0 KF_TOENTLEERCGADA_K0 KL_FKOLBENPOSCGKOR_K0 KL_FPFCGADAFUELLRED_K0 KL_PFHYSCG_K0 KL_PKUPPSTROM_K0 KL_TFPWIRK_K0 KL_TOSFNKFUELLOPT_K0 KL_TOSFNKFUELLRED_K0 KL_TOSFNK_K0 KL_TSFCGFUELLOPT_K0 KL_TSFCGFUELLRED_K0 KL_TSFCG_K0 KL_TTOTFUELL_K0 PO_KOLBENPOSKORGA_K0 PO_KOLBENPOSKOR_K0 TOENTLEERSR_K0 T_O1SFAUSSB_K0 /end DEF_CHARACTERISTIC
/end FUNCTION
/begin FUNCTION dMvsZentr_Fktn "Applikationesgroessen der Komponente dMvsZentr" /begin SUB_FUNCTION jMvsZentr_Fktn /end SUB_FUNCTION /end FUNCTION
/begin FUNCTION jMvsZentr_Fktn "Applikationesgroessen Instanz jMvsZentr"
 /begin DEF_CHARACTERISTIC KL_TVPARKSPCGNP KL_TVPSEIN N_ABBRTVPSEIN PS_BRTVPSEIN T_MAXOUT11 T_MINOUT11 T_VPARKSPPN /end DEF_CHARACTERISTIC
/end FUNCTION
/begin FUNCTION dAdaGlosc_Fktn "Applikationesgroessen der Komponente dAdaGlosc" /begin SUB_FUNCTION jAdaGlosc_Fktn /end SUB_FUNCTION /end FUNCTION
/begin FUNCTION jAdaGlosc_Fktn "Applikationesgroessen Instanz jAdaGlosc"
 /begin DEF_CHARACTERISTIC AL_AXREF_ADAOFF CS_OB_ADAKALT CS_OB_ADAWARM CS_UN_ADAKALT CS_UN_ADAWARM MPT_AXREF_ADAOFF SWI_ADA_LOESCH SWI_AXREF_ADAOFF SWI_PARTFILTAKTIV SWI_VERSIONRG_SCHARF TAB_ADAVERSION TAB_BEW_VERBOT_MODUS_EM TAB_SWI_ADKUPLEER TAB_SWI_SPS_ADAOFF /end DEF_CHARACTERISTIC
/end FUNCTION
/begin FUNCTION dAdaIaeuf_Fktn "Applikationesgroessen der Komponente dAdaIaeuf" /begin SUB_FUNCTION jAdaIaeuf_Fktn /end SUB_FUNCTION /end FUNCTION
/begin FUNCTION jAdaIaeuf_Fktn "Applikationesgroessen Instanz jAdaIaeuf"
 /begin DEF_CHARACTERISTIC MIN_TPADA_UEFIAE MUE_KOR_MAX_UEFIAE MUE_KOR_MIN_UEFIAE SBAKLZ_ND_UEFIAE TAB_STUETZ_MSTELL_UEFIAE TAB_STUETZ_ND_UEFIAE /end DEF_CHARACTERISTIC
/end FUNCTION
/begin FUNCTION dAdaIaeap_Fktn "Applikationesgroessen der Komponente dAdaIaeap" /begin SUB_FUNCTION jAdaIaeap_Fktn /end SUB_FUNCTION /end FUNCTION
/begin FUNCTION jAdaIaeap_Fktn "Applikationesgroessen Instanz jAdaIaeap"
 /begin DEF_CHARACTERISTIC CGETR_MAX_APADA_IAE CGETR_MAX_APADA_IEP_IAE CGETR_MIN_APADA_IEP_IAE CS_MAXDRIFT_APADA_IAE C_DELTA_MAX_APADA F_BEWCTR_APERK_IAE KF_F_ADAWERTIEP_IAE KF_M_SCHLEPP_ADA_IAE KF_PO_APERK_IEP_IAE KL_CGETR_MIN_APADA_IAE KL_CTRSTART_APERK_IAE KL_CTRSTART_APERK_IEP_IAE KL_FD_APADA_IAE KL_FD_APADA_IEP_IAE KL_PO_APERK_IAE KL_PO_NEG_APERK_IAE KL_PO_RAMPENINIT_APERK_IAE KL_PO_TABMAX_APADA_IEP_IAE KL_PO_TABMIN_APADA_IEP_IAE KL_UEF_ABSENK_APERK_IAE KL_UEF_ABSENK_START_APERK_IAE MDS_MOT_APERK_IAE MDS_MOT_INIT_APERK_IAE MDT_MGMOTIST_APERK_IAE MDT_NGMOT_APERK_IAE MGS_ABS_MMOT_APERK_IAE MGS_MOT_ABSENK_APERK_IAE MG_MREF_APERK_IAE MO_STELL_ABBRUCH_APERK_IAE MPT_MMOTIST_APERK_IAE MPT_MMOTIST_FF_APERK_IAE MPT_NMOT_APERK_IAE MPT_NMOT_FF_APERK_IAE MS_LLPRUEF_APERK_IAE MS_MMOT_ABBRUCH_APERK_IAE MS_MOT_ABSENK_APERK_IAE NDS_NMOTSOLL_LL_APERK_IAE NGS_ABS_NMOT_APERK_IAE NG_NREF_APERK_IAE NS_MOTSOLL_LL_MIN_APERK_IAE NS_MOT_APERK_IEP_IAE NS_NAB_ABBRUCH_APERK_IAE PG_ABSENK_APERK_IAE PG_BREMS_ABBRUCH_APERK_IAE PG_NEG_ABBRUCH_APERK_IAE PG_NEG_HYS_APERK_IAE PG_POS_ABBRUCH_APERK_IAE PG_POS_HYS_APERK_IAE PG_PRUEF_APERK_IAE PO_ABSENK_APERK_IAE PO_BREMS_ABBRUCH_APERK_IAE PO_DELTA_MAX_APADA_IAE PO_HYSSCHLEIFE_APERK_IAE PO_PRUEF_MAX_APERK_IAE PO_TABMAX_APADA_IAE PO_TABMIN_APADA_IAE PS_MIN_ABSENK_APERK_IAE SWI_ADAIAE_KPLBINN SWI_APERK_IAE SWI_APERK_IEP_IAE SWI_GE_APERK_IAE SWI_M_MOTIST_ADA_IAE SWI_VORINFO_APERK_IAE TAB_CK_APERK_IEP_IAE TAB_NDS_NMOT_ABBRUCH_APERK_IAE TAB_Z_MODUS_IAE_APERK_IAE TS_LLPRUEF_APERK_IAE TS_PRUEFEN_APERK_IAE T_HALTE_RAMPENINIT_APERK_IAE T_HYSSCHLEIFE_APERK_IAE T_MAXABSENKEN_APERK_IEP_IAE T_MAXWARTEN_APERK_IAE T_M_MOTIEP_APERK_IEP_IAE T_M_MOTREF_APERK_IEP_IAE T_PT2_MGMOTIST_APERK_IAE T_PT2_NGMOT_APERK_IAE T_RUN_LLPRUEF_APERK_IAE T_SPERR_APERK_IAE T_UEF_ABSENK_APERK_IAE T_UEF_ABSENK_START_APERK_IAE T_WAIT_LLPRUEF_APERK_IAE T_WARTEN_ABSENKEN_IAE T_WARTEN_APERK_IAE VPS_MAX_KUEHL_APERK_IAE ZIELGANG_APERK_IAE /end DEF_CHARACTERISTIC
/end FUNCTION
/begin FUNCTION dAdaGloku_Fktn "Applikationesgroessen der Komponente dAdaGloku" /begin SUB_FUNCTION jAdaGloku_Fktn /end SUB_FUNCTION /end FUNCTION
/begin FUNCTION jAdaGloku_Fktn "Applikationesgroessen Instanz jAdaGloku"
 /begin DEF_CHARACTERISTIC CS_LOCK GANG_LOCK KL_PF_MAXADAWERTDELTA KL_TSF_MAXADAWERTDELTA SWI_KPL_LOCK SWI_KUPADASTART_SCHLECHTWEG SWI_REDBEFPULSVERB_K0 TAB_KUPADA_SCHLECHTWEG TAB_MINBPZHSAD TAB_NHAUPTSTARTPRUEF_KUPADA_PF TAB_NMINPRUEF_TSF_PFKALT TAB_NSEKPRUEF_KUPADA_PF TAB_NSEKPRUEF_KUPADA_TSF TAB_NSTARTPRUEF_KUPADA_PF TAB_PF_ADMAX TAB_PF_ADMIN TAB_PF_KALT_DELTAMAX TAB_SWI_GLSBEEINFL_KALT TAB_SWI_KUPADA_PF TAB_SWI_KUPADA_PF_KALT TAB_SWI_KUPADA_START_PF TAB_SWI_KUPADA_TSF TAB_SWI_SEK_KUPADA_PF TAB_SWI_SEK_KUPADA_TSF TAB_TSF_ADMAX TAB_TSF_ADMIN TS_LOCK TS_MAX_LOCK /end DEF_CHARACTERISTIC
/end FUNCTION
/begin FUNCTION dAdaGlokuK_Fktn "Applikationesgroessen der Komponente dAdaGlokuK"
 /begin SUB_FUNCTION jAdaGlokuKA_Fktn jAdaGlokuKB_Fktn jAdaGlokuKC_Fktn jAdaGlokuKD_Fktn jAdaGlokuKE_Fktn jAdaGlokuKK0_Fktn /end SUB_FUNCTION
/end FUNCTION
/begin FUNCTION jAdaGlokuKA_Fktn "Applikationesgroessen Instanz jAdaGlokuKA" /begin DEF_CHARACTERISTIC KL_PRUEFKAD_PF_A KL_PRUEFKAD_TSF_A SHIFTCOUNTERGLSKPLBP_A /end DEF_CHARACTERISTIC /end FUNCTION
/begin FUNCTION jAdaGlokuKB_Fktn "Applikationesgroessen Instanz jAdaGlokuKB" /begin DEF_CHARACTERISTIC KL_PRUEFKAD_PF_B KL_PRUEFKAD_TSF_B SHIFTCOUNTERGLSKPLBP_B /end DEF_CHARACTERISTIC /end FUNCTION
/begin FUNCTION jAdaGlokuKC_Fktn "Applikationesgroessen Instanz jAdaGlokuKC" /begin DEF_CHARACTERISTIC KL_PRUEFKAD_PF_C KL_PRUEFKAD_TSF_C SHIFTCOUNTERGLSKPLBP_C /end DEF_CHARACTERISTIC /end FUNCTION
/begin FUNCTION jAdaGlokuKD_Fktn "Applikationesgroessen Instanz jAdaGlokuKD" /begin DEF_CHARACTERISTIC KL_PRUEFKAD_PF_D KL_PRUEFKAD_TSF_D SHIFTCOUNTERGLSKPLBP_D /end DEF_CHARACTERISTIC /end FUNCTION
/begin FUNCTION jAdaGlokuKE_Fktn "Applikationesgroessen Instanz jAdaGlokuKE" /begin DEF_CHARACTERISTIC KL_PRUEFKAD_PF_E KL_PRUEFKAD_TSF_E SHIFTCOUNTERGLSKPLBP_E /end DEF_CHARACTERISTIC /end FUNCTION
/begin FUNCTION jAdaGlokuKK0_Fktn "Applikationesgroessen Instanz jAdaGlokuKK0"
 /begin DEF_CHARACTERISTIC KL_PRUEFKAD_PF_K0 KL_PRUEFKAD_TSF_K0 SHIFTCOUNTERGLSKPLBP_K0 /end DEF_CHARACTERISTIC
/end FUNCTION
/begin FUNCTION dAdaPfusfEHS_Fktn "Applikationesgroessen der Komponente dAdaPfusfEHS"
 /begin SUB_FUNCTION jAdaPfusfEHS12_Fktn jAdaPfusfEHS23_Fktn jAdaPfusfEHS34_Fktn jAdaPfusfEHS45_Fktn jAdaPfusfEHS56_Fktn jAdaPfusfEHS67_Fktn jAdaPfusfEHS78_Fktn /end SUB_FUNCTION
/end FUNCTION
/begin FUNCTION jAdaPfusfEHS12_Fktn "Applikationesgroessen Instanz jAdaPfusfEHS12"
 /begin DEF_CHARACTERISTIC KF_HSADEINZPKT12 KF_HSADEINZPKT12_EL KF_PFADMTHS12 KF_PFADMTHS12_EL KL_MTPFADHSOB12 KL_MTPFADHSOB12_EL KL_MTPFADHSUN12 KL_MTPFADHSUN12_EL KL_NTPFADHSOB12 KL_NTPFADHSOB12_EL KL_NTPFADHSUN12 KL_NTPFADHSUN12_EL ND_PFADHS12 T_VPFADHS12 /end DEF_CHARACTERISTIC
/end FUNCTION
/begin FUNCTION jAdaPfusfEHS23_Fktn "Applikationesgroessen Instanz jAdaPfusfEHS23"
 /begin DEF_CHARACTERISTIC KF_HSADEINZPKT23 KF_HSADEINZPKT23_EL KF_PFADMTHS23 KF_PFADMTHS23_EL KL_MTPFADHSOB23 KL_MTPFADHSOB23_EL KL_MTPFADHSUN23 KL_MTPFADHSUN23_EL KL_NTPFADHSOB23 KL_NTPFADHSOB23_EL KL_NTPFADHSUN23 KL_NTPFADHSUN23_EL ND_PFADHS23 T_VPFADHS23 /end DEF_CHARACTERISTIC
/end FUNCTION
/begin FUNCTION jAdaPfusfEHS34_Fktn "Applikationesgroessen Instanz jAdaPfusfEHS34"
 /begin DEF_CHARACTERISTIC KF_HSADEINZPKT34 KF_HSADEINZPKT34_EL KF_PFADMTHS34 KF_PFADMTHS34_EL KL_MTPFADHSOB34 KL_MTPFADHSOB34_EL KL_MTPFADHSUN34 KL_MTPFADHSUN34_EL KL_NTPFADHSOB34 KL_NTPFADHSOB34_EL KL_NTPFADHSUN34 KL_NTPFADHSUN34_EL ND_PFADHS34 T_VPFADHS34 /end DEF_CHARACTERISTIC
/end FUNCTION
/begin FUNCTION jAdaPfusfEHS45_Fktn "Applikationesgroessen Instanz jAdaPfusfEHS45"
 /begin DEF_CHARACTERISTIC KF_HSADEINZPKT45 KF_HSADEINZPKT45_EL KF_PFADMTHS45 KF_PFADMTHS45_EL KL_MTPFADHSOB45 KL_MTPFADHSOB45_EL KL_MTPFADHSUN45 KL_MTPFADHSUN45_EL KL_NTPFADHSOB45 KL_NTPFADHSOB45_EL KL_NTPFADHSUN45 KL_NTPFADHSUN45_EL ND_PFADHS45 T_VPFADHS45 /end DEF_CHARACTERISTIC
/end FUNCTION
/begin FUNCTION jAdaPfusfEHS56_Fktn "Applikationesgroessen Instanz jAdaPfusfEHS56"
 /begin DEF_CHARACTERISTIC KF_HSADEINZPKT56 KF_HSADEINZPKT56_EL KF_PFADMTHS56 KF_PFADMTHS56_EL KL_MTPFADHSOB56 KL_MTPFADHSOB56_EL KL_MTPFADHSUN56 KL_MTPFADHSUN56_EL KL_NTPFADHSOB56 KL_NTPFADHSOB56_EL KL_NTPFADHSUN56 KL_NTPFADHSUN56_EL ND_PFADHS56 T_VPFADHS56 /end DEF_CHARACTERISTIC
/end FUNCTION
/begin FUNCTION jAdaPfusfEHS67_Fktn "Applikationesgroessen Instanz jAdaPfusfEHS67"
 /begin DEF_CHARACTERISTIC KF_HSADEINZPKT67 KF_HSADEINZPKT67_EL KF_PFADMTHS67 KF_PFADMTHS67_EL KL_MTPFADHSOB67 KL_MTPFADHSOB67_EL KL_MTPFADHSUN67 KL_MTPFADHSUN67_EL KL_NTPFADHSOB67 KL_NTPFADHSOB67_EL KL_NTPFADHSUN67 KL_NTPFADHSUN67_EL ND_PFADHS67 T_VPFADHS67 /end DEF_CHARACTERISTIC
/end FUNCTION
/begin FUNCTION jAdaPfusfEHS78_Fktn "Applikationesgroessen Instanz jAdaPfusfEHS78"
 /begin DEF_CHARACTERISTIC KF_HSADEINZPKT78 KF_HSADEINZPKT78_EL KF_PFADMTHS78 KF_PFADMTHS78_EL KL_MTPFADHSOB78 KL_MTPFADHSOB78_EL KL_MTPFADHSUN78 KL_MTPFADHSUN78_EL KL_NTPFADHSOB78 KL_NTPFADHSOB78_EL KL_NTPFADHSUN78 KL_NTPFADHSUN78_EL ND_PFADHS78 T_VPFADHS78 /end DEF_CHARACTERISTIC
/end FUNCTION
/begin FUNCTION dAdaPfusf_Fktn "Applikationesgroessen der Komponente dAdaPfusf" /begin SUB_FUNCTION jAdaPfusf_Fktn /end SUB_FUNCTION /end FUNCTION
/begin FUNCTION jAdaPfusf_Fktn "Applikationesgroessen Instanz jAdaPfusf"
 /begin DEF_CHARACTERISTIC CS_PFADOB CS_PFADRSUN DKIS_MOTPFADRS KL_CSPFADHSUN KL_DKISPFADMTHS KL_FPFADLZ KL_NGSABPFADMTHSOB KL_NGSABPFADMTHSUN ND_SYNISTGANG_KEINMTABBR NGS_ABPFADRSOB NGS_ABPFADRSUN NS_MOTPFADRS NS_PFADRS PS_PFADRS SWI_HSADNOSPORT SWI_PFADHSSPABBR SWI_PFADRSSPABBR SWI_ZKINDEX_PFHS SWI_ZKINDEX_PFRS TAB_MAXFLARE_ADAPF TAB_MTPFADRSOB TAB_MTPFADRSUN TAB_NTPFADRSOB TAB_NTPFADRSUN TAB_SWIPFADHS TAB_SWIPFADRS TAB_ZWANGSBEW_ADAPF T_FNGABADA /end DEF_CHARACTERISTIC
/end FUNCTION
/begin FUNCTION dAdaPfusfERS_Fktn "Applikationesgroessen der Komponente dAdaPfusfERS"
 /begin SUB_FUNCTION jAdaPfusfERS21_Fktn jAdaPfusfERS32_Fktn jAdaPfusfERS43_Fktn jAdaPfusfERS54_Fktn jAdaPfusfERS65_Fktn jAdaPfusfERS76_Fktn jAdaPfusfERS87_Fktn /end SUB_FUNCTION
/end FUNCTION
/begin FUNCTION jAdaPfusfERS21_Fktn "Applikationesgroessen Instanz jAdaPfusfERS21" /begin DEF_CHARACTERISTIC KF_PFADRS21 KL_PFADTSYN21 ND_PFADRS21 /end DEF_CHARACTERISTIC /end FUNCTION
/begin FUNCTION jAdaPfusfERS32_Fktn "Applikationesgroessen Instanz jAdaPfusfERS32" /begin DEF_CHARACTERISTIC KF_PFADRS32 KL_PFADTSYN32 ND_PFADRS32 /end DEF_CHARACTERISTIC /end FUNCTION
/begin FUNCTION jAdaPfusfERS43_Fktn "Applikationesgroessen Instanz jAdaPfusfERS43" /begin DEF_CHARACTERISTIC KF_PFADRS43 KL_PFADTSYN43 ND_PFADRS43 /end DEF_CHARACTERISTIC /end FUNCTION
/begin FUNCTION jAdaPfusfERS54_Fktn "Applikationesgroessen Instanz jAdaPfusfERS54" /begin DEF_CHARACTERISTIC KF_PFADRS54 KL_PFADTSYN54 ND_PFADRS54 /end DEF_CHARACTERISTIC /end FUNCTION
/begin FUNCTION jAdaPfusfERS65_Fktn "Applikationesgroessen Instanz jAdaPfusfERS65" /begin DEF_CHARACTERISTIC KF_PFADRS65 KL_PFADTSYN65 ND_PFADRS65 /end DEF_CHARACTERISTIC /end FUNCTION
/begin FUNCTION jAdaPfusfERS76_Fktn "Applikationesgroessen Instanz jAdaPfusfERS76" /begin DEF_CHARACTERISTIC KF_PFADRS76 KL_PFADTSYN76 ND_PFADRS76 /end DEF_CHARACTERISTIC /end FUNCTION
/begin FUNCTION jAdaPfusfERS87_Fktn "Applikationesgroessen Instanz jAdaPfusfERS87" /begin DEF_CHARACTERISTIC KF_PFADRS87 KL_PFADTSYN87 ND_PFADRS87 /end DEF_CHARACTERISTIC /end FUNCTION
/begin FUNCTION dAdaPulbwX_Fktn "Applikationesgroessen der Komponente dAdaPulbwX" /begin SUB_FUNCTION jAdaPulbwXSF_Fktn jAdaPulbwXPF_Fktn /end SUB_FUNCTION /end FUNCTION
/begin RECORD_LAYOUT kw_bool8_S6_S3 FNC_VALUES 1 UBYTE COLUMN_DIR DIRECT /end RECORD_LAYOUT
/begin RECORD_LAYOUT kw_ui8_S6_S3 FNC_VALUES 1 UBYTE COLUMN_DIR DIRECT /end RECORD_LAYOUT
/begin RECORD_LAYOUT kw_ui16_S6_S3 FNC_VALUES 1 UWORD COLUMN_DIR DIRECT /end RECORD_LAYOUT
/begin RECORD_LAYOUT kw_si8_S6_S3 FNC_VALUES 1 SBYTE COLUMN_DIR DIRECT /end RECORD_LAYOUT
/begin RECORD_LAYOUT kw_si16_S6_S3 FNC_VALUES 1 SWORD COLUMN_DIR DIRECT /end RECORD_LAYOUT
/begin RECORD_LAYOUT kw_fl32_S6_S3 FNC_VALUES 1 FLOAT32_IEEE COLUMN_DIR DIRECT /end RECORD_LAYOUT
/begin RECORD_LAYOUT tab_bool8_S6_S3 FNC_VALUES 2 UBYTE COLUMN_DIR DIRECT NO_AXIS_PTS_X 1 ULONG /end RECORD_LAYOUT
/begin RECORD_LAYOUT tab_ui8_S6_S3 FNC_VALUES 2 UBYTE COLUMN_DIR DIRECT NO_AXIS_PTS_X 1 ULONG /end RECORD_LAYOUT
/begin RECORD_LAYOUT tab_ui16_S6_S3 FNC_VALUES 2 UWORD COLUMN_DIR DIRECT NO_AXIS_PTS_X 1 ULONG /end RECORD_LAYOUT
/begin RECORD_LAYOUT tab_si16_S6_S3 FNC_VALUES 2 SWORD COLUMN_DIR DIRECT NO_AXIS_PTS_X 1 ULONG /end RECORD_LAYOUT
/begin RECORD_LAYOUT tab2d_ui8_S6_S3 FNC_VALUES 3 UBYTE ROW_DIR DIRECT NO_AXIS_PTS_X 1 ULONG NO_AXIS_PTS_Y 2 ULONG /end RECORD_LAYOUT
/begin RECORD_LAYOUT kl_ui8_S6_S3 FNC_VALUES 3 UBYTE COLUMN_DIR DIRECT AXIS_PTS_X 2 UBYTE INDEX_INCR DIRECT NO_AXIS_PTS_X 1 ULONG /end RECORD_LAYOUT
/begin RECORD_LAYOUT kl_ui16_S6_S3 FNC_VALUES 3 UWORD COLUMN_DIR DIRECT AXIS_PTS_X 2 UWORD INDEX_INCR DIRECT NO_AXIS_PTS_X 1 ULONG /end RECORD_LAYOUT
/begin RECORD_LAYOUT kl_si16_S6_S3 FNC_VALUES 3 SWORD COLUMN_DIR DIRECT AXIS_PTS_X 2 SWORD INDEX_INCR DIRECT NO_AXIS_PTS_X 1 ULONG /end RECORD_LAYOUT
/begin RECORD_LAYOUT kf_ui16_S6_S3 FNC_VALUES 5 UWORD ROW_DIR DIRECT AXIS_PTS_X 3 UWORD INDEX_INCR DIRECT AXIS_PTS_Y 4 UWORD INDEX_INCR DIRECT NO_AXIS_PTS_X 1 ULONG NO_AXIS_PTS_Y 2 ULONG /end RECORD_LAYOUT
/begin RECORD_LAYOUT kf_si16_S6_S3 FNC_VALUES 5 SWORD ROW_DIR DIRECT AXIS_PTS_X 3 SWORD INDEX_INCR DIRECT AXIS_PTS_Y 4 SWORD INDEX_INCR DIRECT NO_AXIS_PTS_X 1 ULONG NO_AXIS_PTS_Y 2 ULONG /end RECORD_LAYOUT
/end MODULE
/end PROJECT
