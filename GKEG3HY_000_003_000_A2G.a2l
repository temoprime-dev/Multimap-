ASAP2_VERSION 1 51
/begin PROJECT _929_929 "Gen2_BMW_System_Supplier_Lib"
/begin HEADER "" VERSION "C_03_03" PROJECT_NO _929_929 /end HEADER
/begin MODULE DIM ""
/begin MOD_COMMON "" BYTE_ORDER MSB_FIRST ALIGNMENT_BYTE 1 ALIGNMENT_WORD 2 ALIGNMENT_LONG 4 ALIGNMENT_FLOAT32_IEEE 4 /end MOD_COMMON
/begin MEASUREMENT Z_ENTPR_ENBL_DYNDZM "" UBYTE _CNV_S_3_Enum_EENTP_157_CM_S2 1 0 0 2 ECU_ADDRESS 0xFFF91443 /end MEASUREMENT
/begin MEASUREMENT Z_FAHREN_DYNDZM "" UBYTE _CNV_S_3_Enum_EDYND_167_CM_S2 1 0 0 2 ECU_ADDRESS 0xFFF91444 /end MEASUREMENT
/begin MEASUREMENT Z_FREILAUF_DYNDZM "" UBYTE _CNV_S_4_Enum_EDYND_168_CM_S2 1 0 0 3 ECU_ADDRESS 0xFFF91445 /end MEASUREMENT
/begin MEASUREMENT Z_GANG_AGSSTART_DYNDZM "" UBYTE _CNV_S_9_Enum_EGANG_30_CM_S2 1 0 0 8 ECU_ADDRESS 0xFFF91446 /end MEASUREMENT
/begin MEASUREMENT Z_GANG_ISTSTART_DYNDZM "" UBYTE _CNV_S_9_Enum_EGANG_30_CM_S2 1 0 0 8 ECU_ADDRESS 0xFFF91447 /end MEASUREMENT
/begin MEASUREMENT Z_GANG_SOLL_SCHALTUNG_DYNDZM "" UBYTE _CNV_S_9_Enum_EGANG_30_CM_S2 1 0 0 8 ECU_ADDRESS 0xFFF91448 /end MEASUREMENT
/begin MEASUREMENT Z_GANG_ZIELSTART_DYNDZM "" UBYTE _CNV_S_9_Enum_EGANG_30_CM_S2 1 0 0 8 ECU_ADDRESS 0xFFF91449 /end MEASUREMENT
/begin MEASUREMENT Z_KRAFTSCHLUSS_DYNDZM "" UBYTE _CNV_S_5_Enum_EDYND_169_CM_S2 1 0 0 4 ECU_ADDRESS 0xFFF9144A /end MEASUREMENT
/begin MEASUREMENT Z_MOD_DYNDZM "" UBYTE _CNV_S_6_Enum_EDYND_170_CM_S2 1 0 0 5 ECU_ADDRESS 0xFFF9144B /end MEASUREMENT
/begin MEASUREMENT Z_NAB_DYNDZM "" UBYTE _CNV_R_R_Umr_1_zu_1_2_CM_S2 1 0 0 255 ECU_ADDRESS 0xFFF9144C /end MEASUREMENT
/begin MEASUREMENT Z_RANGIEREN_ANGLEICH_DYNDZM "" UBYTE _CNV_S_4_Enum_EDYND_171_CM_S2 1 0 0 3 ECU_ADDRESS 0xFFF9144D /end MEASUREMENT
/begin MEASUREMENT Z_RANGIEREN_DYNDZM "" UBYTE _CNV_S_6_Enum_EDYND_172_CM_S2 1 0 0 5 ECU_ADDRESS 0xFFF9144E /end MEASUREMENT
/begin MEASUREMENT Z_SCHALTUNG_ABBRUCH_DYNDZM "" UBYTE _CNV_S_4_Enum_EDYND_173_CM_S2 1 0 0 3 ECU_ADDRESS 0xFFF9144F /end MEASUREMENT
/begin MEASUREMENT Z_SCHALTUNG_AENDERUNG_DYNDZM "" UBYTE _CNV_S_4_Enum_EDYND_173_CM_S2 1 0 0 3 ECU_ADDRESS 0xFFF91450 /end MEASUREMENT
/begin MEASUREMENT Z_SCHALTUNG_DYNDZM "" UBYTE _CNV_S_7_Enum_EDYND_174_CM_S2 1 0 0 6 ECU_ADDRESS 0xFFF91451 /end MEASUREMENT
/begin MEASUREMENT Z_SCHALTUNG_DYNDZM_ALT "" UBYTE _CNV_R_R_Umr_1_zu_1_2_CM_S2 1 0 0 255 ECU_ADDRESS 0xFFF91452 /end MEASUREMENT
/begin MEASUREMENT Z_SCHALTUNG_ERST_DYNDZM "" UBYTE _CNV_S_4_Enum_EDYND_173_CM_S2 1 0 0 3 ECU_ADDRESS 0xFFF91453 /end MEASUREMENT
/begin MEASUREMENT Z_SCHALTUNG_FOLGE_DYNDZM "" UBYTE _CNV_S_4_Enum_EDYND_173_CM_S2 1 0 0 3 ECU_ADDRESS 0xFFF91454 /end MEASUREMENT
/begin MEASUREMENT Z_SCHALTUNG_FOLGE_DYNDZM_ALT "" UBYTE _CNV_S_4_Enum_EDYND_173_CM_S2 1 0 0 3 ECU_ADDRESS 0xFFF91455 /end MEASUREMENT
/begin MEASUREMENT Z_SCHALTUNG_WARTE_DYNDZM "" UBYTE _CNV_S_3_Enum_EDYND_175_CM_S2 1 0 0 2 ECU_ADDRESS 0xFFF91456 /end MEASUREMENT
/begin MEASUREMENT Z_SEGELN_DYNDZM "" UBYTE _CNV_S_9_Enum_EDYND_176_CM_S2 1 0 0 8 ECU_ADDRESS 0xFFF91457 /end MEASUREMENT
/begin MEASUREMENT Z_SIMULATE_DYNDZM "" UBYTE _CNV_R_R_Umr_1_zu_1_2_CM_S2 1 0 0 255 ECU_ADDRESS 0xFFF91458 /end MEASUREMENT
/begin MEASUREMENT Z_TEMPMIN_DYNDZM "" UBYTE _CNV_R_R_Umr_1_zu_1_2_CM_S2 1 0 0 255 ECU_ADDRESS 0xFFF91459 /end MEASUREMENT
/begin MEASUREMENT GANG_SPRUNG_TIPP "" UBYTE _CNV_R_R_Umr_1_zu_1_2_CM_S2 1 0 0 255 ECU_ADDRESS 0xFFF9129E /end MEASUREMENT
/begin MEASUREMENT N_GETR_EINGANG_VIRT "" UWORD _CNV_R_R_Umr_1_zu_1_3_CM_S2 1 0 0 20000 FORMAT "%2.0" ECU_ADDRESS 0xFFF90AE6 /end MEASUREMENT
/begin MEASUREMENT N_HS_MIN_STEPS "" UWORD _CNV_R_R_Umr_1_zu_1_3_CM_S2 1 0 0 20000 FORMAT "%2.0" ECU_ADDRESS 0xFFF90AE8 /end MEASUREMENT
/begin MEASUREMENT N_MOT_SOLLLL_STEPTR "" UWORD _CNV_R_R_Umr_1_zu_1_3_CM_S2 1 0 0 3000 FORMAT "%2.0" ECU_ADDRESS 0xFFF90AEA /end MEASUREMENT
/begin MEASUREMENT N_RS_STPTR "" UWORD _CNV_R_R_Umr_1_zu_1_3_CM_S2 1 0 0 20000 FORMAT "%2.0" ECU_ADDRESS 0xFFF90AEC /end MEASUREMENT
/begin MEASUREMENT SCHN_T_MAXSPEICHER_TIPP_MINUS "" UWORD _CNV_R_R_Umr_1_zu_1_3_CM_S2 1 0 0 20000 FORMAT "%2.0" ECU_ADDRESS 0xFFF90AEE /end MEASUREMENT
/begin MEASUREMENT S_DUE_ERK "" UBYTE _CNV_P_2_A_I_5_CM_S2 1 0 0 255 ECU_ADDRESS 0xFFF9129F /end MEASUREMENT
/begin MEASUREMENT S_ERSTER_TIPP_IGNORIERT "" UBYTE _CNV_R_R_Umr_1_zu_1_2_CM_S2 1 0 0 1 FORMAT "%2.0" ECU_ADDRESS 0xFFF912A0 /end MEASUREMENT
/begin MEASUREMENT S_FZG_STEHT_STEPS "" UBYTE _CNV_S_2_Schalter_A_4_CM_S2 1 0 0 1 ECU_ADDRESS 0xFFF912A1 /end MEASUREMENT
/begin MEASUREMENT S_GANGSPEICHER_TIPP_MINUS "" UBYTE _CNV_P_2_A_I_5_CM_S2 1 0 0 255 ECU_ADDRESS 0xFFF912A2 /end MEASUREMENT
/begin MEASUREMENT S_GEGEN_TIPP_STEPS "" UBYTE _CNV_S_2_Schalter_A_4_CM_S2 1 0 0 1 ECU_ADDRESS 0xFFF912A3 /end MEASUREMENT
/begin MEASUREMENT S_KDRS_STEPS "" UBYTE _CNV_S_2_Schalter_A_4_CM_S2 1 0 0 1 ECU_ADDRESS 0xFFF912A4 /end MEASUREMENT
/begin MEASUREMENT S_KD_SPERR "" UBYTE _CNV_P_2_A_I_5_CM_S2 1 0 0 255 ECU_ADDRESS 0xFFF912A5 /end MEASUREMENT
/begin MEASUREMENT S_MINUSPADDLE_DRS_STEPS "" UBYTE _CNV_R_R_Umr_1_zu_1_2_CM_S2 1 0 0 1 FORMAT "%2.0" ECU_ADDRESS 0xFFF912A6 /end MEASUREMENT
/begin MEASUREMENT S_MINUS_ALT_STEPS "" UBYTE _CNV_P_2_A_I_5_CM_S2 1 0 0 255 ECU_ADDRESS 0xFFF912A7 /end MEASUREMENT
/begin MEASUREMENT S_MINUS_TIPP "" UBYTE _CNV_P_2_A_I_5_CM_S2 1 0 0 255 ECU_ADDRESS 0xFFF912A8 /end MEASUREMENT
/begin MEASUREMENT S_PLUS_ALT_STEPS "" UBYTE _CNV_P_2_A_I_5_CM_S2 1 0 0 255 ECU_ADDRESS 0xFFF912A9 /end MEASUREMENT
/begin MEASUREMENT S_PLUS_TIPP "" UBYTE _CNV_P_2_A_I_5_CM_S2 1 0 0 255 ECU_ADDRESS 0xFFF912AA /end MEASUREMENT
/begin MEASUREMENT S_RSZ_VERBOT_DUE "" UBYTE _CNV_P_2_A_I_5_CM_S2 1 0 0 255 ECU_ADDRESS 0xFFF912AB /end MEASUREMENT
/begin MEASUREMENT S_SPERR_TIPP_STEPS "" UBYTE _CNV_S_2_Schalter_A_4_CM_S2 1 0 0 1 ECU_ADDRESS 0xFFF912AC /end MEASUREMENT
/begin MEASUREMENT S_STEIGUNG_STEPS "" UBYTE _CNV_S_2_Schalter_A_4_CM_S2 1 0 0 1 ECU_ADDRESS 0xFFF912AD /end MEASUREMENT
/begin MEASUREMENT S_T_MINUSPADDLE_DRS_STEPS "" UBYTE _CNV_R_R_Umr_1_zu_1_2_CM_S2 1 0 0 1 FORMAT "%2.0" ECU_ADDRESS 0xFFF912AE /end MEASUREMENT
/begin MEASUREMENT S_VERBOT_EINSTIEG_TID "" UBYTE _CNV_S_2_Schalter_A_4_CM_S2 1 0 0 1 ECU_ADDRESS 0xFFF9153A /end MEASUREMENT
/begin MEASUREMENT S_ZHSKDRS_VERBOT_STEPS "" UBYTE _CNV_S_2_Schalter_A_4_CM_S2 1 0 0 1 ECU_ADDRESS 0xFFF912AF /end MEASUREMENT
/begin MEASUREMENT S_ZHS_VERBOT_STEPS "" UBYTE _CNV_P_2_A_I_5_CM_S2 1 0 0 255 ECU_ADDRESS 0xFFF912B0 /end MEASUREMENT
/begin MEASUREMENT S_ZRS_MOD_STEPS "" UBYTE _CNV_S_2_Schalter_A_4_CM_S2 1 0 0 1 ECU_ADDRESS 0xFFF912B1 /end MEASUREMENT
/begin MEASUREMENT S_ZWANG_HSRS_AKTIV "" UBYTE _CNV_S_2_Schalter_A_4_CM_S2 1 0 0 1 ECU_ADDRESS 0xFFF912B2 /end MEASUREMENT
/begin MEASUREMENT S_ZWANG_HSRS_AKTIV_ALT "" UBYTE _CNV_S_2_Schalter_A_4_CM_S2 1 0 0 1 ECU_ADDRESS 0xFFF912B3 /end MEASUREMENT
/begin MEASUREMENT S_ZWANG_HSRS_STPTRsport "" UBYTE _CNV_S_2_Schalter_A_4_CM_S2 1 0 0 1 ECU_ADDRESS 0xFFF912B4 /end MEASUREMENT
/begin MEASUREMENT T_BUFFERSPEICHER_TIPP_MINUS "" ULONG _CNV_R_R_Umr_1_zu_1_2_CM_S2 1 0 0 4294967295 FORMAT "%2.0" ECU_ADDRESS 0xFFF90164 /end MEASUREMENT
/begin MEASUREMENT T_BUFFER_VORWAHL_MINUS "" ULONG _CNV_R_R_Umr_1_zu_1_6_CM_S2 1 0 0 4294967295 FORMAT "%2.0" ECU_ADDRESS 0xFFF90168 /end MEASUREMENT
/begin MEASUREMENT T_BUFFER_VORWAHL_PLUS "" ULONG _CNV_R_R_Umr_1_zu_1_6_CM_S2 1 0 0 4294967295 FORMAT "%2.0" ECU_ADDRESS 0xFFF9016C /end MEASUREMENT
/begin MEASUREMENT T_BUF_ENTPR_FLANKW_VERL_STEP "" ULONG _CNV_R_R_Umr_1_zu_1_6_CM_S2 1 0 0 4294967295 FORMAT "%2.0" ECU_ADDRESS 0xFFF902F0 /end MEASUREMENT
/begin MEASUREMENT T_ENTPR_FLANKW_VERL_STEP "" ULONG _CNV_R_R_Umr_1_zu_1_6_CM_S2 1 0 0 4294967295 FORMAT "%2.0" ECU_ADDRESS 0xFFF902F4 /end MEASUREMENT
/begin MEASUREMENT T_GANG_ZIEL_STPTRsport "" ULONG _CNV_R_R_Umr_1_zu_1_6_CM_S2 1 0 0 2147483647 FORMAT "%2.0" ECU_ADDRESS 0xFFF90170 /end MEASUREMENT
/begin MEASUREMENT T_MINUSPADDLE_DRS_STEPS "" UWORD _CNV_R_R_Umr_1_zu_1_183_CM_S2 1 0 0 65535 FORMAT "%2.0" ECU_ADDRESS 0xFFF90AF0 /end MEASUREMENT
/begin MEASUREMENT T_PADDLE_VERL_STEP "" ULONG _CNV_R_R_Umr_1_zu_1_6_CM_S2 1 0 0 2147483647 FORMAT "%2.0" ECU_ADDRESS 0xFFF902F8 /end MEASUREMENT
/begin MEASUREMENT T_PADDLE_VERL_STEP_ALT "" ULONG _CNV_R_R_Umr_1_zu_1_6_CM_S2 1 0 0 2147483647 FORMAT "%2.0" ECU_ADDRESS 0xFFF902FC /end MEASUREMENT
/begin MEASUREMENT T_SPEICHER_TIPP_MINUS "" UWORD _CNV_R_R_Umr_1_zu_1_2_CM_S2 1 0 0 65535 FORMAT "%2.0" ECU_ADDRESS 0xFFF90AF2 /end MEASUREMENT
/begin MEASUREMENT T_TIPP_STEPS "" ULONG _CNV_R_R_Umr_1_zu_1_6_CM_S2 1 0 0 2147483647 FORMAT "%2.0" ECU_ADDRESS 0xFFF90174 /end MEASUREMENT
/begin MEASUREMENT T_VORWAHL "" UWORD _CNV_R_R_Umr_1_zu_1_6_CM_S2 1 0 0 65535 FORMAT "%2.0" ECU_ADDRESS 0xFFF90AF4 /end MEASUREMENT
/begin MEASUREMENT T_VORWAHL_MINUS "" UWORD _CNV_R_R_Umr_1_zu_1_6_CM_S2 1 0 0 65535 FORMAT "%2.0" ECU_ADDRESS 0xFFF90AF6 /end MEASUREMENT
/begin MEASUREMENT T_VORWAHL_PLUS "" UWORD _CNV_R_R_Umr_1_zu_1_6_CM_S2 1 0 0 65535 FORMAT "%2.0" ECU_ADDRESS 0xFFF90AF8 /end MEASUREMENT
/begin MEASUREMENT T_ZWANG_HSRS_STPTRsport "" ULONG _CNV_R_R_Umr_1_zu_1_6_CM_S2 1 0 0 2147483647 FORMAT "%2.0" ECU_ADDRESS 0xFFF90178 /end MEASUREMENT
/begin MEASUREMENT Z_AGS_MODBEDEL_ALT_STEPS "" UBYTE _CNV_S_2_Enum_EAGS_25_CM_S2 1 0 0 1 ECU_ADDRESS 0xFFF912B5 /end MEASUREMENT
/begin MEASUREMENT Z_GANG_KDRS_STEPS "" UBYTE _CNV_S_9_Enum_EGANG_30_CM_S2 1 0 0 8 ECU_ADDRESS 0xFFF912B6 /end MEASUREMENT
/begin MEASUREMENT Z_GANG_MANUELL "" UBYTE _CNV_S_9_Enum_EGANG_30_CM_S2 1 0 0 8 ECU_ADDRESS 0xFFF912B7 /end MEASUREMENT
/begin MEASUREMENT Z_GANG_STEPTR_SPORT "" UBYTE _CNV_S_9_Enum_EGANG_30_CM_S2 1 0 0 8 ECU_ADDRESS 0xFFF912B8 /end MEASUREMENT
/begin MEASUREMENT Z_GANG_STEPTR_SPORT_ROH "" UBYTE _CNV_S_9_Enum_EGANG_30_CM_S2 1 0 0 8 ECU_ADDRESS 0xFFF912B9 /end MEASUREMENT
/begin MEASUREMENT Z_GANG_TIPP_SPORT "" UBYTE _CNV_S_9_Enum_EGANG_30_CM_S2 1 0 0 8 ECU_ADDRESS 0xFFF912BA /end MEASUREMENT
/begin MEASUREMENT Z_GANG_TIPP_SPORT_ALT "" UBYTE _CNV_S_9_Enum_EGANG_30_CM_S2 1 0 0 8 ECU_ADDRESS 0xFFF912BB /end MEASUREMENT
/begin MEASUREMENT Z_GANG_VORWAHL "" UBYTE _CNV_S_9_Enum_EGANG_30_CM_S2 1 0 0 8 ECU_ADDRESS 0xFFF912BC /end MEASUREMENT
/begin MEASUREMENT Z_GANG_ZWANG_SPORT "" UBYTE _CNV_S_9_Enum_EGANG_30_CM_S2 1 0 0 8 ECU_ADDRESS 0xFFF912BD /end MEASUREMENT
/begin MEASUREMENT Z_HOTDUE "" UBYTE _CNV_S_3_Enum_EHOTD_180_CM_S2 1 0 0 2 ECU_ADDRESS 0xFFF912BE /end MEASUREMENT
/begin MEASUREMENT Z_KDRS_STEPS "" UBYTE _CNV_R_R_Umr_1_zu_1_2_CM_S2 1 0 0 3 FORMAT "%2.0" ECU_ADDRESS 0xFFF912BF /end MEASUREMENT
/begin MEASUREMENT Z_STEPTRONIC_INIT "" UBYTE _CNV_S_2_Schalter_A_4_CM_S2 1 0 0 1 ECU_ADDRESS 0xFFF912C0 /end MEASUREMENT
/begin MEASUREMENT AUINF_NAVGRPH_SYNC_ADAS "" UBYTE _CNV_R_R_Umr_1_zu_1_2_CM_S2 1 0 0 255 FORMAT "%2.0" ECU_ADDRESS 0xFFF912E8 /end MEASUREMENT
/begin MEASUREMENT AUXINF_SEG_NAVGRPH_ADAS "" UBYTE _CNV_R_R_Umr_1_zu_1_2_CM_S2 1 0 0 255 FORMAT "%2.0" ECU_ADDRESS 0xFFF912E9 /end MEASUREMENT
/begin MEASUREMENT A_QMAX_KREIS_COS "" UWORD _CNV_R_R_Umr_10_zu__46_CM_S2 1 0 0 6553.5 FORMAT "%3.1" ECU_ADDRESS 0xFFF90C38 /end MEASUREMENT
/begin MEASUREMENT A_QMAX_KURVE_COS "" UWORD _CNV_R_R_Umr_10_zu__46_CM_S2 1 0 0 6553.5 FORMAT "%3.1" ECU_ADDRESS 0xFFF90C3A /end MEASUREMENT
/begin MEASUREMENT COU_NAVGRPH_SYNC_ADAS "" UBYTE _CNV_R_R_Umr_1_zu_1_2_CM_S2 1 0 0 255 FORMAT "%2.0" ECU_ADDRESS 0xFFF912EA /end MEASUREMENT
/begin MEASUREMENT CRC16_NAVGRPH_SYNC_ADAS "" UWORD _CNV_R_R_Umr_1_zu_1_2_CM_S2 1 0 0 65535 FORMAT "%2.0" ECU_ADDRESS 0xFFF90B08 /end MEASUREMENT
/begin MEASUREMENT CTR_DEL_NAVGRPH_ADAS "" UBYTE _CNV_R_R_Umr_1_zu_1_2_CM_S2 1 0 0 255 FORMAT "%2.0" ECU_ADDRESS 0xFFF912EB /end MEASUREMENT
/begin MEASUREMENT C_ERR_DLPLS_COS "" UBYTE _CNV_R_R_Umr_1_zu_1_2_CM_S2 1 0 0 255 FORMAT "%2.0" ARRAY_SIZE 4 ECU_ADDRESS 0xFFF901D8 MATRIX_DIM 4 1 1 /end MEASUREMENT
/begin MEASUREMENT DBG_ADAS_1 "" ULONG _CNV_R_R_Umr_1_zu_1_192_CM_S2 1 0 0 4294967295 ECU_ADDRESS 0xFFF900BC /end MEASUREMENT
/begin MEASUREMENT DBG_ADAS_10 "" UWORD _CNV_R_R_Umr_1_zu_1_123_CM_S2 1 0 0 65535 ECU_ADDRESS 0xFFF90C3C /end MEASUREMENT
/begin MEASUREMENT DBG_ADAS_11 "" UWORD _CNV_R_R_Umr_1_zu_1_123_CM_S2 1 0 0 65535 ECU_ADDRESS 0xFFF90C3E /end MEASUREMENT
/begin MEASUREMENT DBG_ADAS_12 "" UWORD _CNV_R_R_Umr_1_zu_1_123_CM_S2 1 0 0 65535 ECU_ADDRESS 0xFFF90C40 /end MEASUREMENT
/begin MEASUREMENT DBG_ADAS_13 "" UWORD _CNV_R_R_Umr_1_zu_1_123_CM_S2 1 0 0 65535 ECU_ADDRESS 0xFFF90C42 /end MEASUREMENT
/begin MEASUREMENT DBG_ADAS_14 "" UBYTE _CNV_R_R_Umr_1_zu_1_2_CM_S2 1 0 0 255 ECU_ADDRESS 0xFFF914DD /end MEASUREMENT
/begin MEASUREMENT DBG_ADAS_15 "" UBYTE _CNV_R_R_Umr_1_zu_1_2_CM_S2 1 0 0 255 ECU_ADDRESS 0xFFF914DE /end MEASUREMENT
/begin MEASUREMENT DBG_ADAS_16 "" UBYTE _CNV_R_R_Umr_1_zu_1_2_CM_S2 1 0 0 255 ECU_ADDRESS 0xFFF914DF /end MEASUREMENT
/begin MEASUREMENT DBG_ADAS_2 "" ULONG _CNV_R_R_Umr_1_zu_1_192_CM_S2 1 0 0 4294967295 ECU_ADDRESS 0xFFF901C8 /end MEASUREMENT
/begin MEASUREMENT DBG_ADAS_3 "" ULONG _CNV_R_R_Umr_1_zu_1_192_CM_S2 1 0 0 4294967295 ECU_ADDRESS 0xFFF901CC /end MEASUREMENT
/begin MEASUREMENT DBG_ADAS_4 "" ULONG _CNV_R_R_Umr_1_zu_1_192_CM_S2 1 0 0 4294967295 ECU_ADDRESS 0xFFF901D0 /end MEASUREMENT
/begin MEASUREMENT DBG_ADAS_6 "" UWORD _CNV_R_R_Umr_1_zu_1_123_CM_S2 1 0 0 65535 ECU_ADDRESS 0xFFF90C44 /end MEASUREMENT
/begin MEASUREMENT DBG_ADAS_8 "" UWORD _CNV_R_R_Umr_1_zu_1_123_CM_S2 1 0 0 65535 ECU_ADDRESS 0xFFF90C46 /end MEASUREMENT
/begin MEASUREMENT DIAG_DECODER_STATUS_DCODR "" UBYTE _CNV_R_R_Umr_1_zu_1_2_CM_S2 1 0 0 255 FORMAT "%2.0" ECU_ADDRESS 0xFFF9141A /end MEASUREMENT
/begin MEASUREMENT DIAG_INFO_ERR_CTR_DCODR "" ULONG _CNV_R_R_Umr_1_zu_1_2_CM_S2 1 0 0 4294967295 FORMAT "%2.0" ECU_ADDRESS 0xFFF901E0 /end MEASUREMENT
/begin MEASUREMENT DIAG_INFO_KILLALL_CTR_DCODR "" ULONG _CNV_R_R_Umr_1_zu_1_2_CM_S2 1 0 0 4294967295 FORMAT "%2.0" ECU_ADDRESS 0xFFF901E4 /end MEASUREMENT
/begin MEASUREMENT DIAG_INFO_LAST_ERROR_DCODR "" UBYTE _CNV_R_R_Umr_1_zu_1_2_CM_S2 1 0 0 255 FORMAT "%2.0" ECU_ADDRESS 0xFFF9141B /end MEASUREMENT
/begin MEASUREMENT DIAG_INFO_LAST_REC_ERROR_DCODR "" UBYTE _CNV_R_R_Umr_1_zu_1_2_CM_S2 1 0 0 255 FORMAT "%2.0" ECU_ADDRESS 0xFFF9141C /end MEASUREMENT
/begin MEASUREMENT DIAG_INFO_MSG_CTR_DCODR "" ULONG _CNV_R_R_Umr_1_zu_1_2_CM_S2 1 0 0 4294967295 FORMAT "%2.0" ECU_ADDRESS 0xFFF901E8 /end MEASUREMENT
/begin MEASUREMENT DIAG_INFO_REC_ERR_CTR_DCODR "" ULONG _CNV_R_R_Umr_1_zu_1_2_CM_S2 1 0 0 4294967295 FORMAT "%2.0" ECU_ADDRESS 0xFFF901EC /end MEASUREMENT
/begin MEASUREMENT DIAG_LOCAL_POSITION_DCODR "" UBYTE _CNV_R_R_Umr_1_zu_1_2_CM_S2 1 0 0 255 FORMAT "%2.0" ECU_ADDRESS 0xFFF9141D /end MEASUREMENT
/begin MEASUREMENT DIAG_MATCH_SEGMENT_DCODR "" UBYTE _CNV_R_R_Umr_1_zu_1_2_CM_S2 1 0 0 255 FORMAT "%2.0" ECU_ADDRESS 0xFFF9141E /end MEASUREMENT
/begin MEASUREMENT DL_AAF_ANF_DCODR "" UWORD _CNV_R_R_Umr_1_zu_1_123_CM_S2 1 0 0 65535 FORMAT "%2.0" ECU_ADDRESS 0xFFF908F2 /end MEASUREMENT
/begin MEASUREMENT DL_AAF_ANF_DCODR_ERK_MAX "" UWORD _CNV_R_R_Umr_1_zu_1_123_CM_S2 1 0 0 65535 FORMAT "%2.0" ECU_ADDRESS 0xFFF908F4 /end MEASUREMENT
/begin MEASUREMENT DL_AAF_ANF_DCODR_FREEZED "" UWORD _CNV_R_R_Umr_1_zu_1_123_CM_S2 1 0 0 65535 FORMAT "%2.0" ECU_ADDRESS 0xFFF90C6E /end MEASUREMENT
/begin MEASUREMENT DL_AAF_ENDE_DCODR "" UWORD _CNV_R_R_Umr_1_zu_1_123_CM_S2 1 0 0 65535 FORMAT "%2.0" ECU_ADDRESS 0xFFF908F6 /end MEASUREMENT
/begin MEASUREMENT DL_GEFAELLE_ANF_DCODR "" UWORD _CNV_R_R_Umr_1_zu_1_123_CM_S2 1 0 0 65535 FORMAT "%2.0" ECU_ADDRESS 0xFFF90C7E /end MEASUREMENT
/begin MEASUREMENT DL_GEFAELLE_ENDE_DCODR "" UWORD _CNV_R_R_Umr_1_zu_1_123_CM_S2 1 0 0 65535 FORMAT "%2.0" ECU_ADDRESS 0xFFF90C80 /end MEASUREMENT
/begin MEASUREMENT DL_KREIS_ALMAX_COS "" UWORD _CNV_R_R_Umr_1_zu_1_123_CM_S2 1 0 0 65535 FORMAT "%2.0" ECU_ADDRESS 0xFFF90DF2 /end MEASUREMENT
/begin MEASUREMENT DL_KREIS_ANF_DCODR_ERK_MAX "" UWORD _CNV_R_R_Umr_1_zu_1_123_CM_S2 1 0 0 65535 FORMAT "%2.0" ECU_ADDRESS 0xFFF908F8 /end MEASUREMENT
/begin MEASUREMENT DL_KREIS_DCODR "" UWORD _CNV_R_R_Umr_1_zu_1_123_CM_S2 1 0 0 65535 FORMAT "%2.0" ECU_ADDRESS 0xFFF90DE0 /end MEASUREMENT
/begin MEASUREMENT DL_KREIS_DCODR_FREEZED "" UWORD _CNV_R_R_Umr_1_zu_1_123_CM_S2 1 0 0 65535 FORMAT "%2.0" ECU_ADDRESS 0xFFF90C70 /end MEASUREMENT
/begin MEASUREMENT DL_KRZG_ALMAX_COS "" UWORD _CNV_R_R_Umr_1_zu_1_123_CM_S2 1 0 0 65535 FORMAT "%2.0" ECU_ADDRESS 0xFFF90DF4 /end MEASUREMENT
/begin MEASUREMENT DL_KRZG_ANF_DCODR "" UWORD _CNV_R_R_Umr_1_zu_1_123_CM_S2 1 0 0 65535 FORMAT "%2.0" ECU_ADDRESS 0xFFF90DE2 /end MEASUREMENT
/begin MEASUREMENT DL_KRZG_ANF_DCODR_ALT "" UWORD _CNV_R_R_Umr_1_zu_1_123_CM_S2 1 0 0 65535 FORMAT "%2.0" ECU_ADDRESS 0xFFF908FA /end MEASUREMENT
/begin MEASUREMENT DL_KRZG_ANF_DCODR_ERK_MAX "" UWORD _CNV_R_R_Umr_1_zu_1_123_CM_S2 1 0 0 65535 FORMAT "%2.0" ECU_ADDRESS 0xFFF908FC /end MEASUREMENT
/begin MEASUREMENT DL_KRZG_ANF_DCODR_FREEZED "" UWORD _CNV_R_R_Umr_1_zu_1_123_CM_S2 1 0 0 65535 FORMAT "%2.0" ECU_ADDRESS 0xFFF90C72 /end MEASUREMENT
/begin MEASUREMENT DL_KRZG_MAX_BLINKEN_COS "" UWORD _CNV_R_R_Umr_1_zu_1_123_CM_S2 1 0 0 65535 FORMAT "%2.0" ECU_ADDRESS 0xFFF908FE /end MEASUREMENT
/begin MEASUREMENT DL_KRZG_MIN_BLINKEN_COS "" UWORD _CNV_R_R_Umr_1_zu_1_123_CM_S2 1 0 0 65535 FORMAT "%2.0" ECU_ADDRESS 0xFFF90900 /end MEASUREMENT
/begin MEASUREMENT DL_KURVE_ALMAX_COS "" UWORD _CNV_R_R_Umr_1_zu_1_123_CM_S2 1 0 0 65535 FORMAT "%2.0" ECU_ADDRESS 0xFFF90DF6 /end MEASUREMENT
/begin MEASUREMENT DL_KURVE_ANF_DCODR "" UWORD _CNV_R_R_Umr_1_zu_1_123_CM_S2 1 0 0 65535 FORMAT "%2.0" ECU_ADDRESS 0xFFF90DE4 /end MEASUREMENT
/begin MEASUREMENT DL_KURVE_ANF_DCODR_ERK_MAX "" UWORD _CNV_R_R_Umr_1_zu_1_123_CM_S2 1 0 0 65535 FORMAT "%2.0" ECU_ADDRESS 0xFFF90902 /end MEASUREMENT
/begin MEASUREMENT DL_KURVE_ANF_DCODR_FREEZED "" UWORD _CNV_R_R_Umr_1_zu_1_123_CM_S2 1 0 0 65535 FORMAT "%2.0" ECU_ADDRESS 0xFFF90C74 /end MEASUREMENT
/begin MEASUREMENT DL_KURVE_ENDE_DCODR "" UWORD _CNV_R_R_Umr_1_zu_1_123_CM_S2 1 0 0 65535 FORMAT "%2.0" ECU_ADDRESS 0xFFF90904 /end MEASUREMENT
/begin MEASUREMENT DL_KURVE_MIN_RAD_DCODR "" ULONG _CNV_R_R_Umr_1_zu_1_123_CM_S2 1 0 0 4294967295 FORMAT "%2.0" ECU_ADDRESS 0xFFF904B4 /end MEASUREMENT
/begin MEASUREMENT DL_KURVE_MIN_RAD_DCODR_FREEZED "" ULONG _CNV_R_R_Umr_1_zu_1_123_CM_S2 1 0 0 4294967295 FORMAT "%2.0" ECU_ADDRESS 0xFFF901DC /end MEASUREMENT
/begin MEASUREMENT DL_MATCH_RELPOSITION_DCODR "" UBYTE _CNV_R_R_Umr_1_zu_1_123_CM_S2 1 0 0 255 FORMAT "%2.0" ECU_ADDRESS 0xFFF91420 /end MEASUREMENT
/begin MEASUREMENT DL_SPEEDLIMIT_ANF_DCODR "" UWORD _CNV_R_R_Umr_1_zu_1_123_CM_S2 1 0 0 65535 FORMAT "%2.0" ECU_ADDRESS 0xFFF90C84 /end MEASUREMENT
/begin MEASUREMENT DL_STEIGUNG_ANF_DCODR "" UWORD _CNV_R_R_Umr_1_zu_1_123_CM_S2 1 0 0 65535 FORMAT "%2.0" ECU_ADDRESS 0xFFF90C86 /end MEASUREMENT
/begin MEASUREMENT DL_STEIGUNG_ENDE_DCODR "" UWORD _CNV_R_R_Umr_1_zu_1_123_CM_S2 1 0 0 65535 FORMAT "%2.0" ECU_ADDRESS 0xFFF90C88 /end MEASUREMENT
/begin MEASUREMENT DL_TOPO_DCODR_AZG "" UBYTE _CNV_R_R_Umr_1_zu_1_123_CM_S2 1 0 0 255 FORMAT "%2.0" ECU_ADDRESS 0xFFF911C7 /end MEASUREMENT
/begin MEASUREMENT DL_VIRT_KURVE_ANF_DCODR "" UWORD _CNV_R_R_Umr_1_zu_1_123_CM_S2 1 0 0 65535 FORMAT "%2.0" ECU_ADDRESS 0xFFF90C8A /end MEASUREMENT
/begin MEASUREMENT DL_VIRT_KURVE_ENDE_DCODR "" UWORD _CNV_R_R_Umr_1_zu_1_123_CM_S2 1 0 0 65535 FORMAT "%2.0" ECU_ADDRESS 0xFFF90C8C /end MEASUREMENT
/begin MEASUREMENT DL_VIRT_KURVE_MIN_RAD_DCODR "" ULONG _CNV_R_R_Umr_1_zu_1_123_CM_S2 1 0 0 4294967295 FORMAT "%2.0" ECU_ADDRESS 0xFFF901F0 /end MEASUREMENT
/begin MEASUREMENT DVREL_SEGLIM_FZG_COS "" SWORD _CNV_R_R_Umr_1_zu_1_53_CM_S2 1 0 -32768 32767 FORMAT "%2.0" ECU_ADDRESS 0xFFF90C64 /end MEASUREMENT
/begin MEASUREMENT DVREL_SEGPRD_FZG_COS "" SWORD _CNV_R_R_Umr_1_zu_1_53_CM_S2 1 0 -32768 32767 FORMAT "%2.0" ECU_ADDRESS 0xFFF90C66 /end MEASUREMENT
/begin MEASUREMENT DV_SEGLIM_FZG_COS "" SWORD _CNV_R_R_Umr_1_zu_1_8_CM_S2 1 0 -250 250 FORMAT "%2.0" ECU_ADDRESS 0xFFF90C5A /end MEASUREMENT
/begin MEASUREMENT DV_SEGPRD_FZG_COS "" SWORD _CNV_R_R_Umr_1_zu_1_8_CM_S2 1 0 -250 250 FORMAT "%2.0" ECU_ADDRESS 0xFFF90C68 /end MEASUREMENT
/begin MEASUREMENT FN_STREET_CLAS_NAVGRPH_ADAS "" UBYTE _CNV_R_R_Umr_1_zu_1_2_CM_S2 1 0 0 255 FORMAT "%2.0" ECU_ADDRESS 0xFFF912EC /end MEASUREMENT
/begin MEASUREMENT FUNKINIT_DONE_ADAS "" UBYTE _CNV_R_R_Umr_1_zu_1_2_CM_S2 1 0 0 255 FORMAT "%2.0" ECU_ADDRESS 0xFFF91421 /end MEASUREMENT
/begin MEASUREMENT GRAD_NAVGRPH_ADAS "" UBYTE _CNV_R_R_Umr_1_zu_1_2_CM_S2 1 0 0 255 FORMAT "%2.0" ECU_ADDRESS 0xFFF912ED /end MEASUREMENT
/begin MEASUREMENT IDX_FSEG_NAVGRPH_ADAS "" UBYTE _CNV_R_R_Umr_1_zu_1_2_CM_S2 1 0 0 255 FORMAT "%2.0" ECU_ADDRESS 0xFFF912EE /end MEASUREMENT
/begin MEASUREMENT IDX_SEG_DEL_NAVGRPH_ADAS "" UBYTE _CNV_R_R_Umr_1_zu_1_2_CM_S2 1 0 0 255 FORMAT "%2.0" ECU_ADDRESS 0xFFF912EF /end MEASUREMENT
/begin MEASUREMENT IDX_SEG_NAVGRPH_ADAS "" UBYTE _CNV_R_R_Umr_1_zu_1_2_CM_S2 1 0 0 255 FORMAT "%2.0" ECU_ADDRESS 0xFFF912F0 /end MEASUREMENT
/begin MEASUREMENT IDX_SEG_NAVGRPH_LNE_ADAS "" UBYTE _CNV_R_R_Umr_1_zu_1_2_CM_S2 1 0 0 255 FORMAT "%2.0" ECU_ADDRESS 0xFFF912F1 /end MEASUREMENT
/begin MEASUREMENT IDX_SEG_NAVGRPH_MAP_DT_ADAS "" UBYTE _CNV_R_R_Umr_1_zu_1_2_CM_S2 1 0 0 255 FORMAT "%2.0" ECU_ADDRESS 0xFFF912F2 /end MEASUREMENT
/begin MEASUREMENT IDX_SEG_NAVGRPH_V_ADAS "" UBYTE _CNV_R_R_Umr_1_zu_1_2_CM_S2 1 0 0 255 FORMAT "%2.0" ECU_ADDRESS 0xFFF912F3 /end MEASUREMENT
/begin MEASUREMENT INFO_EXT_LNS_1_ADAS "" ULONG _CNV_R_R_Umr_1_zu_1_2_CM_S2 1 0 0 4294967295 FORMAT "%2.0" ECU_ADDRESS 0xFFF90188 /end MEASUREMENT
/begin MEASUREMENT INFO_EXT_LNS_2_ADAS "" ULONG _CNV_R_R_Umr_1_zu_1_2_CM_S2 1 0 0 4294967295 FORMAT "%2.0" ECU_ADDRESS 0xFFF9018C /end MEASUREMENT
/begin MEASUREMENT LIM_V_CDL_ADAS "" UBYTE _CNV_R_R_Umr_1_zu_1_2_CM_S2 1 0 0 255 FORMAT "%2.0" ECU_ADDRESS 0xFFF912F4 /end MEASUREMENT
/begin MEASUREMENT LIM_V_NAVGRPH_ADAS "" UBYTE _CNV_R_R_Umr_1_zu_1_2_CM_S2 1 0 0 255 FORMAT "%2.0" ECU_ADDRESS 0xFFF912F5 /end MEASUREMENT
/begin MEASUREMENT L_MATCH_DCODR "" UWORD _CNV_R_R_Umr_1_zu_1_123_CM_S2 1 0 0 65535 FORMAT "%2.0" ECU_ADDRESS 0xFFF90C78 /end MEASUREMENT
/begin MEASUREMENT L_MPP_DCODR "" UWORD _CNV_R_R_Umr_1_zu_1_123_CM_S2 1 0 0 65535 FORMAT "%2.0" ECU_ADDRESS 0xFFF90C90 /end MEASUREMENT
/begin MEASUREMENT L_SEG_NAVGRPH_ADAS "" UBYTE _CNV_R_R_Umr_1_zu_1_2_CM_S2 1 0 0 255 FORMAT "%2.0" ECU_ADDRESS 0xFFF912F6 /end MEASUREMENT
/begin MEASUREMENT MOD_TRNSM_NAVGRPH_SYNC_ADAS "" UBYTE _CNV_R_R_Umr_1_zu_1_2_CM_S2 1 0 0 255 FORMAT "%2.0" ECU_ADDRESS 0xFFF912F7 /end MEASUREMENT
/begin MEASUREMENT MSG_ID_DCODR "" UBYTE _CNV_S_6_Enum_EMSGI_193_CM_S2 1 0 0 61 ECU_ADDRESS 0xFFF912F8 /end MEASUREMENT
/begin MEASUREMENT ODL_NEG_KRZG_DCODR "" UWORD _CNV_R_R_Umr_1_zu_1_123_CM_S2 1 0 0 65535 FORMAT "%2.0" ECU_ADDRESS 0xFFF90C7A /end MEASUREMENT
/begin MEASUREMENT PREQ_LIM_V_ADAS "" UBYTE _CNV_R_R_Umr_1_zu_1_2_CM_S2 1 0 0 255 FORMAT "%2.0" ECU_ADDRESS 0xFFF912F9 /end MEASUREMENT
/begin MEASUREMENT PRES_LCL_IDEN_CHA_1_NAVGRPH_ADAS "" UBYTE _CNV_R_R_Umr_1_zu_1_2_CM_S2 1 0 0 255 FORMAT "%2.0" ECU_ADDRESS 0xFFF912FA /end MEASUREMENT
/begin MEASUREMENT PRES_LCL_IDEN_CHA_2_NAVGRPH_ADAS "" UBYTE _CNV_R_R_Umr_1_zu_1_2_CM_S2 1 0 0 255 FORMAT "%2.0" ECU_ADDRESS 0xFFF912FB /end MEASUREMENT
/begin MEASUREMENT PRES_LCL_IDEN_CHA_3_NAVGRPH_ADAS "" UBYTE _CNV_R_R_Umr_1_zu_1_2_CM_S2 1 0 0 255 FORMAT "%2.0" ECU_ADDRESS 0xFFF912FC /end MEASUREMENT
/begin MEASUREMENT PRES_LNE_ADAS "" UBYTE _CNV_R_R_Umr_1_zu_1_2_CM_S2 1 0 0 255 FORMAT "%2.0" ECU_ADDRESS 0xFFF912FD /end MEASUREMENT
/begin MEASUREMENT PROFIL_STREET_NAVGRPH_ADAS "" UBYTE _CNV_R_R_Umr_1_zu_1_2_CM_S2 1 0 0 255 FORMAT "%2.0" ECU_ADDRESS 0xFFF912FE /end MEASUREMENT
/begin MEASUREMENT PROP_MAP_NAVGRPH_ADAS "" UWORD _CNV_R_R_Umr_1_zu_1_2_CM_S2 1 0 0 65535 FORMAT "%2.0" ECU_ADDRESS 0xFFF90B0A /end MEASUREMENT
/begin MEASUREMENT QUAN_LNS_EXT_ADAS "" UBYTE _CNV_R_R_Umr_1_zu_1_2_CM_S2 1 0 0 255 FORMAT "%2.0" ECU_ADDRESS 0xFFF912FF /end MEASUREMENT
/begin MEASUREMENT QUAN_LNS_NAVGRPH_ADAS "" UBYTE _CNV_R_R_Umr_1_zu_1_2_CM_S2 1 0 0 255 FORMAT "%2.0" ECU_ADDRESS 0xFFF91300 /end MEASUREMENT
/begin MEASUREMENT RAD_SEG_NAVGRPH_ADAS "" SWORD _CNV_R_R_Umr_1_zu_1_2_CM_S2 1 0 -32768 32767 FORMAT "%2.0" ECU_ADDRESS 0xFFF90B0C /end MEASUREMENT
/begin MEASUREMENT RAD_SEG_NAVGRPH_V_ADAS "" SWORD _CNV_R_R_Umr_1_zu_1_2_CM_S2 1 0 -32768 32767 FORMAT "%2.0" ECU_ADDRESS 0xFFF90B0E /end MEASUREMENT
/begin MEASUREMENT R_KREIS_MIN_DCODR "" UWORD _CNV_R_R_Umr_1_zu_1_123_CM_S2 1 0 0 65535 FORMAT "%2.0" ECU_ADDRESS 0xFFF90906 /end MEASUREMENT
/begin MEASUREMENT R_KURVE_MIN_DCODR "" UWORD _CNV_R_R_Umr_1_zu_1_123_CM_S2 1 0 0 65535 FORMAT "%2.0" ECU_ADDRESS 0xFFF90908 /end MEASUREMENT
/begin MEASUREMENT R_KURVE_MIN_DCODR_ERK_MAX "" UWORD _CNV_R_R_Umr_1_zu_1_123_CM_S2 1 0 0 65535 FORMAT "%2.0" ECU_ADDRESS 0xFFF9090A /end MEASUREMENT
/begin MEASUREMENT R_MATCH_DCODR "" UWORD _CNV_R_R_Umr_1_zu_1_123_CM_S2 1 0 0 65535 FORMAT "%2.0" ECU_ADDRESS 0xFFF9090C /end MEASUREMENT
/begin MEASUREMENT R_VIRT_KURVE_MIN_DCODR "" UWORD _CNV_R_R_Umr_1_zu_1_123_CM_S2 1 0 0 65535 FORMAT "%2.0" ECU_ADDRESS 0xFFF90C92 /end MEASUREMENT
/begin MEASUREMENT SMPL_GEFAELLE_MAX_DCODR "" SWORD _CNV_R_R_Umr_1_zu_1_53_CM_S2 1 0 -32768 32767 FORMAT "%2.0" ECU_ADDRESS 0xFFF9090E /end MEASUREMENT
/begin MEASUREMENT SMPL_KRZGSEG_PROB_L_DCODR "" UBYTE _CNV_R_R_Umr_1_zu_1_53_CM_S2 1 0 0 100 FORMAT "%2.0" ECU_ADDRESS 0xFFF91422 /end MEASUREMENT
/begin MEASUREMENT SMPL_KRZGSEG_PROB_MAX_DCODR "" UBYTE _CNV_R_R_Umr_1_zu_1_53_CM_S2 1 0 0 100 FORMAT "%2.0" ECU_ADDRESS 0xFFF91423 /end MEASUREMENT
/begin MEASUREMENT SMPL_KRZGSEG_PROB_R_DCODR "" UBYTE _CNV_R_R_Umr_1_zu_1_53_CM_S2 1 0 0 100 FORMAT "%2.0" ECU_ADDRESS 0xFFF91424 /end MEASUREMENT
/begin MEASUREMENT SMPL_MATCH_PROBABILITY_DCODR "" UBYTE _CNV_R_R_Umr_1_zu_1_53_CM_S2 1 0 0 255 FORMAT "%2.0" ECU_ADDRESS 0xFFF911CA /end MEASUREMENT
/begin MEASUREMENT SMPL_MATCH_SLOPE_DCODR "" SBYTE _CNV_R_R_Umr_1_zu_1_53_CM_S2 1 0 -128 127 FORMAT "%2.0" ECU_ADDRESS 0xFFF91425 /end MEASUREMENT
/begin MEASUREMENT SMPL_STEIGUNG_MAX_DCODR "" SWORD _CNV_R_R_Umr_1_zu_1_53_CM_S2 1 0 -32768 32767 FORMAT "%2.0" ECU_ADDRESS 0xFFF90910 /end MEASUREMENT
/begin MEASUREMENT ST_CNCD_NAVI_ADAS "" UWORD _CNV_R_R_Umr_1_zu_1_2_CM_S2 1 0 0 65535 FORMAT "%2.0" ECU_ADDRESS 0xFFF90B12 /end MEASUREMENT
/begin MEASUREMENT ST_CNCD_NAVI_ADAS_ALT "" UWORD _CNV_R_R_Umr_1_zu_1_2_CM_S2 1 0 0 65535 FORMAT "%2.0" ECU_ADDRESS 0xFFF90C6A /end MEASUREMENT
/begin MEASUREMENT ST_MTCH_HDG_HRZTL_ADAS "" UWORD _CNV_R_R_Umr_1_zu_1_2_CM_S2 1 0 0 255 FORMAT "%2.0" ECU_ADDRESS 0xFFF90B06 /end MEASUREMENT
/begin MEASUREMENT ST_MTCH_IDX_SEG_ADAS "" UBYTE _CNV_R_R_Umr_1_zu_1_2_CM_S2 1 0 0 255 FORMAT "%2.0" ECU_ADDRESS 0xFFF91301 /end MEASUREMENT
/begin MEASUREMENT ST_MTCH_PO_REL_ADAS "" UBYTE _CNV_R_R_Umr_1_zu_1_2_CM_S2 1 0 0 255 FORMAT "%2.0" ECU_ADDRESS 0xFFF91302 /end MEASUREMENT
/begin MEASUREMENT ST_MTCH_QUAL_ADAS "" UBYTE _CNV_R_R_Umr_1_zu_1_2_CM_S2 1 0 0 255 FORMAT "%2.0" ECU_ADDRESS 0xFFF91303 /end MEASUREMENT
/begin MEASUREMENT ST_MTCH_TSTMP_ADAS "" UWORD _CNV_R_R_Umr_1_zu_1_2_CM_S2 1 0 0 65535 FORMAT "%2.0" ECU_ADDRESS 0xFFF90B10 /end MEASUREMENT
/begin MEASUREMENT ST_MTCH_UNIQ_PO_ADAS "" UBYTE _CNV_R_R_Umr_1_zu_1_2_CM_S2 1 0 0 255 FORMAT "%2.0" ECU_ADDRESS 0xFFF91304 /end MEASUREMENT
/begin MEASUREMENT ST_OPET_NAVI_ADAS "" ULONG _CNV_R_R_Umr_1_zu_1_2_CM_S2 1 0 0 4294967295 FORMAT "%2.0" ECU_ADDRESS 0xFFF90190 /end MEASUREMENT
/begin MEASUREMENT ST_QUAN_PCKGS_ADAS "" UBYTE _CNV_R_R_Umr_1_zu_1_2_CM_S2 1 0 0 255 FORMAT "%2.0" ECU_ADDRESS 0xFFF91305 /end MEASUREMENT
/begin MEASUREMENT ST_VRS_HW_NAVI_ADAS "" UBYTE _CNV_R_R_Umr_1_zu_1_2_CM_S2 1 0 0 255 FORMAT "%2.0" ECU_ADDRESS 0xFFF9130D /end MEASUREMENT
/begin MEASUREMENT ST_VRS_HW_NAVI_MANU_ADAS "" UBYTE _CNV_R_R_Umr_1_zu_1_2_CM_S2 1 0 0 255 FORMAT "%2.0" ECU_ADDRESS 0xFFF9130E /end MEASUREMENT
/begin MEASUREMENT ST_VRS_MAP_NAVI_ADAS "" UBYTE _CNV_R_R_Umr_1_zu_1_2_CM_S2 1 0 0 255 FORMAT "%2.0" ECU_ADDRESS 0xFFF9130F /end MEASUREMENT
/begin MEASUREMENT ST_VRS_MAP_NAVI_MANU_ADAS "" UBYTE _CNV_R_R_Umr_1_zu_1_2_CM_S2 1 0 0 255 FORMAT "%2.0" ECU_ADDRESS 0xFFF91310 /end MEASUREMENT
/begin MEASUREMENT ST_VRS_PRTL_NAVI_ADAS "" UBYTE _CNV_R_R_Umr_1_zu_1_2_CM_S2 1 0 0 255 FORMAT "%2.0" ECU_ADDRESS 0xFFF91311 /end MEASUREMENT
/begin MEASUREMENT S_AAF_ERK_DCODR "" UBYTE _CNV_R_R_Umr_1_zu_1_2_CM_S2 1 0 0 255 FORMAT "%2.0" ECU_ADDRESS 0xFFF911CB /end MEASUREMENT
/begin MEASUREMENT S_ADAS_ANFRESYNC "" UBYTE _CNV_R_R_Umr_1_zu_1_2_CM_S2 1 0 0 1 FORMAT "%2.0" ECU_ADDRESS 0xFFF91426 /end MEASUREMENT
/begin MEASUREMENT S_ADAS_COMPLIANT_BRS_COS "" UBYTE _CNV_R_R_Umr_1_zu_1_2_CM_S2 1 0 0 1 FORMAT "%2.0" ECU_ADDRESS 0xFFF911CC /end MEASUREMENT
/begin MEASUREMENT S_ADAS_COMPLIANT_DERS_COS "" UBYTE _CNV_R_R_Umr_1_zu_1_2_CM_S2 1 0 0 1 FORMAT "%2.0" ECU_ADDRESS 0xFFF911CD /end MEASUREMENT
/begin MEASUREMENT S_ADAS_COMPLIANT_HSURE_COS "" UBYTE _CNV_R_R_Umr_1_zu_1_2_CM_S2 1 0 0 1 FORMAT "%2.0" ECU_ADDRESS 0xFFF911CE /end MEASUREMENT
/begin MEASUREMENT S_ADAS_RECERR_KOOPVERBOT_COS "" UBYTE _CNV_R_R_Umr_1_zu_1_2_CM_S2 1 0 0 255 FORMAT "%2.0" ECU_ADDRESS 0xFFF911D4 /end MEASUREMENT
/begin MEASUREMENT S_AUF_AAF_DCODR "" UBYTE _CNV_R_R_Umr_1_zu_1_2_CM_S2 1 0 0 255 FORMAT "%2.0" ECU_ADDRESS 0xFFF911D5 /end MEASUREMENT
/begin MEASUREMENT S_AUF_GEFAELLE_DCODR "" UBYTE _CNV_R_R_Umr_1_zu_1_2_CM_S2 1 0 0 255 FORMAT "%2.0" ECU_ADDRESS 0xFFF911D6 /end MEASUREMENT
/begin MEASUREMENT S_AUF_KREIS_DCODR "" UBYTE _CNV_R_R_Umr_1_zu_1_2_CM_S2 1 0 0 255 FORMAT "%2.0" ECU_ADDRESS 0xFFF911D7 /end MEASUREMENT
/begin MEASUREMENT S_AUF_KURVE_DCODR "" UBYTE _CNV_R_R_Umr_1_zu_1_2_CM_S2 1 0 0 255 FORMAT "%2.0" ECU_ADDRESS 0xFFF911D8 /end MEASUREMENT
/begin MEASUREMENT S_AUF_STEIGUNG_DCODR "" UBYTE _CNV_R_R_Umr_1_zu_1_2_CM_S2 1 0 0 255 FORMAT "%2.0" ECU_ADDRESS 0xFFF911D9 /end MEASUREMENT
/begin MEASUREMENT S_AUF_VIRT_KURVE_DCODR "" UBYTE _CNV_R_R_Umr_1_zu_1_2_CM_S2 1 0 0 255 FORMAT "%2.0" ECU_ADDRESS 0xFFF9142A /end MEASUREMENT
/begin MEASUREMENT S_AUTOBAHN_DCODR "" UBYTE _CNV_R_R_Umr_1_zu_1_2_CM_S2 1 0 0 1 FORMAT "%2.0" ECU_ADDRESS 0xFFF911DA /end MEASUREMENT
/begin MEASUREMENT S_ERR_DLPLS_COS "" UBYTE _CNV_R_R_Umr_1_zu_1_2_CM_S2 1 0 0 1 ECU_ADDRESS 0xFFF911DB /end MEASUREMENT
/begin MEASUREMENT S_GEFAELLE_ERK_DCODR "" UBYTE _CNV_R_R_Umr_1_zu_1_2_CM_S2 1 0 0 255 FORMAT "%2.0" ECU_ADDRESS 0xFFF9142B /end MEASUREMENT
/begin MEASUREMENT S_KREIS_ERK_DCODR "" UBYTE _CNV_R_R_Umr_1_zu_1_2_CM_S2 1 0 0 255 FORMAT "%2.0" ECU_ADDRESS 0xFFF911DC /end MEASUREMENT
/begin MEASUREMENT S_KRZG_ERK_DCODR "" UBYTE _CNV_R_R_Umr_1_zu_1_2_CM_S2 1 0 0 255 FORMAT "%2.0" ECU_ADDRESS 0xFFF911DD /end MEASUREMENT
/begin MEASUREMENT S_KURVE_ERK_DCODR "" UBYTE _CNV_R_R_Umr_1_zu_1_2_CM_S2 1 0 0 255 FORMAT "%2.0" ECU_ADDRESS 0xFFF911DE /end MEASUREMENT
/begin MEASUREMENT S_MPP_TOPO_BRS_COS "" UBYTE _CNV_R_R_Umr_1_zu_1_2_CM_S2 1 0 0 1 FORMAT "%2.0" ECU_ADDRESS 0xFFF911CF /end MEASUREMENT
/begin MEASUREMENT S_MPP_TOPO_DERS_COS "" UBYTE _CNV_R_R_Umr_1_zu_1_2_CM_S2 1 0 0 1 FORMAT "%2.0" ECU_ADDRESS 0xFFF911D0 /end MEASUREMENT
/begin MEASUREMENT S_MPP_TOPO_HSURE_COS "" UBYTE _CNV_R_R_Umr_1_zu_1_2_CM_S2 1 0 0 1 FORMAT "%2.0" ECU_ADDRESS 0xFFF911D1 /end MEASUREMENT
/begin MEASUREMENT S_NAVI_COUNTRY_CODE_CHANGED "" UBYTE _CNV_R_R_Umr_1_zu_1_2_CM_S2 1 0 0 1 FORMAT "%2.0" ECU_ADDRESS 0xFFF91414 /end MEASUREMENT
/begin MEASUREMENT S_NAVI_COUNTRY_CODE_ENBL "" UBYTE _CNV_R_R_Umr_1_zu_1_2_CM_S2 1 0 0 1 FORMAT "%2.0" ECU_ADDRESS 0xFFF91415 /end MEASUREMENT
/begin MEASUREMENT S_NAVI_HWSW_ADAS_PROT "" UBYTE _CNV_R_R_Umr_1_zu_1_2_CM_S2 1 0 0 1 FORMAT "%2.0" ECU_ADDRESS 0xFFF91416 /end MEASUREMENT
/begin MEASUREMENT S_NAVI_POS_MATCH "" UBYTE _CNV_R_R_Umr_1_zu_1_2_CM_S2 1 0 0 1 FORMAT "%2.0" ECU_ADDRESS 0xFFF91417 /end MEASUREMENT
/begin MEASUREMENT S_RADIUS_AVAIL_DCODR "" UBYTE _CNV_R_R_Umr_1_zu_1_2_CM_S2 1 0 0 255 FORMAT "%2.0" ECU_ADDRESS 0xFFF9131A /end MEASUREMENT
/begin MEASUREMENT S_RESYNC_GESENDET "" UBYTE _CNV_R_R_Umr_1_zu_1_2_CM_S2 1 0 0 255 FORMAT "%2.0" ECU_ADDRESS 0xFFF9131B /end MEASUREMENT
/begin MEASUREMENT S_SPEEDLIMIT_ERK_DCODR "" UBYTE _CNV_R_R_Umr_1_zu_1_2_CM_S2 1 0 0 255 FORMAT "%2.0" ECU_ADDRESS 0xFFF91430 /end MEASUREMENT
/begin MEASUREMENT S_STEIGUNG_ERK_DCODR "" UBYTE _CNV_R_R_Umr_1_zu_1_2_CM_S2 1 0 0 255 FORMAT "%2.0" ECU_ADDRESS 0xFFF91431 /end MEASUREMENT
/begin MEASUREMENT S_VIRT_KURVE_ERK_DCODR "" UBYTE _CNV_R_R_Umr_1_zu_1_2_CM_S2 1 0 0 255 FORMAT "%2.0" ECU_ADDRESS 0xFFF91432 /end MEASUREMENT
/begin MEASUREMENT S_V_FZG_COG_FREEZED "" UBYTE _CNV_R_R_Umr_1_zu_1_2_CM_S2 1 0 0 1 FORMAT "%2.0" ECU_ADDRESS 0xFFF911DF /end MEASUREMENT
/begin MEASUREMENT S_V_MPH_ADAS "" UBYTE _CNV_R_R_Umr_1_zu_1_2_CM_S2 1 0 0 1 FORMAT "%2.0" ECU_ADDRESS 0xFFF91306 /end MEASUREMENT
/begin MEASUREMENT TRSG_V_VAR_ADAS "" UBYTE _CNV_R_R_Umr_1_zu_1_2_CM_S2 1 0 0 255 FORMAT "%2.0" ECU_ADDRESS 0xFFF91307 /end MEASUREMENT
/begin MEASUREMENT TYP_STREET_NAVGRPH_ADAS "" UBYTE _CNV_R_R_Umr_1_zu_1_2_CM_S2 1 0 0 255 FORMAT "%2.0" ECU_ADDRESS 0xFFF91308 /end MEASUREMENT
/begin MEASUREMENT T_AAF_DOWNGRADE_COS "" SWORD _CNV_R_R_Umr_1_zu_1_6_CM_S2 1 0 0 10000 FORMAT "%2.0" ECU_ADDRESS 0xFFF90C5C /end MEASUREMENT
/begin MEASUREMENT T_BLINKEN_COS "" UWORD _CNV_R_R_Umr_1_zu_1_6_CM_S2 1 0 0 65535 FORMAT "%2.0" ECU_ADDRESS 0xFFF90912 /end MEASUREMENT
/begin MEASUREMENT T_DLPLS_COS "" UWORD _CNV_R_R_Umr_1_zu_1_6_CM_S2 1 0 0 65535 FORMAT "%2.0" ECU_ADDRESS 0xFFF90C76 /end MEASUREMENT
/begin MEASUREMENT T_KREIS_DOWNGRADE_COS "" SWORD _CNV_R_R_Umr_1_zu_1_6_CM_S2 1 0 0 10000 FORMAT "%2.0" ECU_ADDRESS 0xFFF90C5E /end MEASUREMENT
/begin MEASUREMENT T_KRZG_DOWNGRADE_COS "" SWORD _CNV_R_R_Umr_1_zu_1_6_CM_S2 1 0 0 10000 FORMAT "%2.0" ECU_ADDRESS 0xFFF90C60 /end MEASUREMENT
/begin MEASUREMENT T_KURVE_DOWNGRADE_COS "" SWORD _CNV_R_R_Umr_1_zu_1_6_CM_S2 1 0 0 10000 FORMAT "%2.0" ECU_ADDRESS 0xFFF90C62 /end MEASUREMENT
/begin MEASUREMENT VLDY_T_END_ADAS "" UBYTE _CNV_R_R_Umr_1_zu_1_2_CM_S2 1 0 0 255 FORMAT "%2.0" ECU_ADDRESS 0xFFF91309 /end MEASUREMENT
/begin MEASUREMENT VLDY_T_STA_ADAS "" UBYTE _CNV_R_R_Umr_1_zu_1_2_CM_S2 1 0 0 255 FORMAT "%2.0" ECU_ADDRESS 0xFFF9130A /end MEASUREMENT
/begin MEASUREMENT V_CLAS_NAVGRPH_ADAS "" UBYTE _CNV_R_R_Umr_1_zu_1_2_CM_S2 1 0 0 255 FORMAT "%2.0" ECU_ADDRESS 0xFFF9130B /end MEASUREMENT
/begin MEASUREMENT V_FZG_COG_ADAS "" UWORD _CNV_R_R_Umr_64_zu__44_CM_S2 1 0 0 350 FORMAT "%4.2" ECU_ADDRESS 0xFFF90914 /end MEASUREMENT
/begin MEASUREMENT V_LIM_CAP_NAVGRPH_ADAS "" UBYTE _CNV_R_R_Umr_1_zu_1_2_CM_S2 1 0 0 255 FORMAT "%2.0" ECU_ADDRESS 0xFFF9130C /end MEASUREMENT
/begin MEASUREMENT V_MATCH_SPEEDLIMIT_DCODR "" UWORD _CNV_R_R_Umr_1_zu_1_8_CM_S2 1 0 0 400 FORMAT "%2.0" ECU_ADDRESS 0xFFF90C7C /end MEASUREMENT
/begin MEASUREMENT V_PRD_KREIS_COS "" UWORD _CNV_R_R_Umr_10_zu__190_CM_S2 1 0 0 350 FORMAT "%3.1" ECU_ADDRESS 0xFFF90916 /end MEASUREMENT
/begin MEASUREMENT V_PRD_KREIS_COS_NAEHERUNG_0 "" UWORD _CNV_R_R_Umr_10_zu__191_CM_S2 1 0 0 6553.5 FORMAT "%3.1" ECU_ADDRESS 0xFFF90C48 /end MEASUREMENT
/begin MEASUREMENT V_PRD_KREIS_COS_NAEHERUNG_1 "" UWORD _CNV_R_R_Umr_10_zu__191_CM_S2 1 0 0 6553.5 FORMAT "%3.1" ECU_ADDRESS 0xFFF90C4A /end MEASUREMENT
/begin MEASUREMENT V_PRD_KREIS_COS_NAEHERUNG_2 "" UWORD _CNV_R_R_Umr_10_zu__191_CM_S2 1 0 0 6553.5 FORMAT "%3.1" ECU_ADDRESS 0xFFF90C4C /end MEASUREMENT
/begin MEASUREMENT V_PRD_KREIS_COS_RADIKANT "" UWORD _CNV_R_R_Umr_100_zu_189_CM_S2 1 0 0 655.35 FORMAT "%4.2" ECU_ADDRESS 0xFFF90C4E /end MEASUREMENT
/begin MEASUREMENT V_PRD_KRZG_COS "" UWORD _CNV_R_R_Umr_10_zu__190_CM_S2 1 0 0 350 FORMAT "%3.1" ECU_ADDRESS 0xFFF90C50 /end MEASUREMENT
/begin MEASUREMENT V_PRD_KURVE_COS "" UWORD _CNV_R_R_Umr_10_zu__190_CM_S2 1 0 0 350 FORMAT "%3.1" ECU_ADDRESS 0xFFF90918 /end MEASUREMENT
/begin MEASUREMENT V_PRD_KURVE_COS_NAEHERUNG_0 "" UWORD _CNV_R_R_Umr_10_zu__191_CM_S2 1 0 0 6553.5 FORMAT "%3.1" ECU_ADDRESS 0xFFF90C52 /end MEASUREMENT
/begin MEASUREMENT V_PRD_KURVE_COS_NAEHERUNG_1 "" UWORD _CNV_R_R_Umr_10_zu__191_CM_S2 1 0 0 6553.5 FORMAT "%3.1" ECU_ADDRESS 0xFFF90C54 /end MEASUREMENT
/begin MEASUREMENT V_PRD_KURVE_COS_NAEHERUNG_2 "" UWORD _CNV_R_R_Umr_10_zu__191_CM_S2 1 0 0 6553.5 FORMAT "%3.1" ECU_ADDRESS 0xFFF90C56 /end MEASUREMENT
/begin MEASUREMENT V_PRD_KURVE_COS_RADIKANT "" UWORD _CNV_R_R_Umr_100_zu_189_CM_S2 1 0 0 655.35 FORMAT "%4.2" ECU_ADDRESS 0xFFF90C58 /end MEASUREMENT
/begin MEASUREMENT V_SEGLIM_DCODR "" UWORD _CNV_R_R_Umr_1_zu_1_8_CM_S2 1 0 0 400 FORMAT "%2.0" ECU_ADDRESS 0xFFF9091A /end MEASUREMENT
/begin MEASUREMENT V_SEGPRD_DCODR "" UWORD _CNV_R_R_Umr_10_zu__190_CM_S2 1 0 0 350 FORMAT "%3.1" ECU_ADDRESS 0xFFF90C6C /end MEASUREMENT
/begin MEASUREMENT V_SEGPRD_DCODR_AZG "" UWORD _CNV_R_R_Umr_10_zu__190_CM_S2 1 0 0 250 FORMAT "%3.1" ECU_ADDRESS 0xFFF908F0 /end MEASUREMENT
/begin MEASUREMENT W_KRZGSEG_ADAS_COS "" UWORD _CNV_R_R_Umr_1_zu_1_138_CM_S2 1 0 0 180 FORMAT "%2.0" ECU_ADDRESS 0xFFF90DEA /end MEASUREMENT
/begin MEASUREMENT W_KRZGSEG_L_DCODR "" UBYTE _CNV_R_R_Umr_1_zu_1_138_CM_S2 1 0 0 255 FORMAT "%2.0" ECU_ADDRESS 0xFFF911E0 /end MEASUREMENT
/begin MEASUREMENT W_KRZGSEG_MAX_PROB_DCODR "" SWORD _CNV_R_R_Umr_1_zu_1_138_CM_S2 1 0 -180 180 FORMAT "%2.0" ECU_ADDRESS 0xFFF90C94 /end MEASUREMENT
/begin MEASUREMENT W_KRZGSEG_R_DCODR "" UBYTE _CNV_R_R_Umr_1_zu_1_138_CM_S2 1 0 0 255 FORMAT "%2.0" ECU_ADDRESS 0xFFF911E1 /end MEASUREMENT
/begin MEASUREMENT W_VIRT_CUMULATED_ANGLE_DCODR "" SWORD _CNV_R_R_Umr_1_zu_1_138_CM_S2 1 0 -32768 32767 FORMAT "%2.0" ECU_ADDRESS 0xFFF90C98 /end MEASUREMENT
/begin MEASUREMENT Z_ADAS_RESYNCSTCOUNT "" UBYTE _CNV_R_R_Umr_1_zu_1_2_CM_S2 1 0 0 255 FORMAT "%2.0" ECU_ADDRESS 0xFFF91427 /end MEASUREMENT
/begin MEASUREMENT Z_ADAS_RESYNCSTERR "" UBYTE _CNV_R_R_Umr_1_zu_1_2_CM_S2 1 0 0 255 FORMAT "%2.0" ECU_ADDRESS 0xFFF91428 /end MEASUREMENT
/begin MEASUREMENT Z_BLINKEN_COS "" UBYTE _CNV_S_4_Enum_EBLIN_194_CM_S2 1 0 0 3 ECU_ADDRESS 0xFFF911E2 /end MEASUREMENT
/begin MEASUREMENT Z_BLINKEN_COS_ALT "" UBYTE _CNV_S_4_Enum_EBLIN_194_CM_S2 1 0 0 3 ECU_ADDRESS 0xFFF911E3 /end MEASUREMENT
/begin MEASUREMENT Z_COS_AAF "" UBYTE _CNV_S_3_Enum_ETOPO_195_CM_S2 1 0 0 2 ECU_ADDRESS 0xFFF91312 /end MEASUREMENT
/begin MEASUREMENT Z_COS_AAF_ALT "" UBYTE _CNV_S_3_Enum_ETOPO_195_CM_S2 1 0 0 2 ECU_ADDRESS 0xFFF91313 /end MEASUREMENT
/begin MEASUREMENT Z_COS_AAF_ALT2 "" UBYTE _CNV_S_3_Enum_ETOPO_195_CM_S2 1 0 0 2 ECU_ADDRESS 0xFFF91410 /end MEASUREMENT
/begin MEASUREMENT Z_COS_KREIS "" UBYTE _CNV_S_3_Enum_ETOPO_195_CM_S2 1 0 0 2 ECU_ADDRESS 0xFFF91314 /end MEASUREMENT
/begin MEASUREMENT Z_COS_KREIS_ALT "" UBYTE _CNV_S_3_Enum_ETOPO_195_CM_S2 1 0 0 2 ECU_ADDRESS 0xFFF91315 /end MEASUREMENT
/begin MEASUREMENT Z_COS_KREIS_ALT2 "" UBYTE _CNV_S_3_Enum_ETOPO_195_CM_S2 1 0 0 2 ECU_ADDRESS 0xFFF91411 /end MEASUREMENT
/begin MEASUREMENT Z_COS_KRZG "" UBYTE _CNV_S_3_Enum_ETOPO_195_CM_S2 1 0 0 2 ECU_ADDRESS 0xFFF91316 /end MEASUREMENT
/begin MEASUREMENT Z_COS_KRZG_ALT "" UBYTE _CNV_S_3_Enum_ETOPO_195_CM_S2 1 0 0 2 ECU_ADDRESS 0xFFF91317 /end MEASUREMENT
/begin MEASUREMENT Z_COS_KRZG_ALT2 "" UBYTE _CNV_S_3_Enum_ETOPO_195_CM_S2 1 0 0 2 ECU_ADDRESS 0xFFF91412 /end MEASUREMENT
/begin MEASUREMENT Z_COS_KURVE "" UBYTE _CNV_S_3_Enum_ETOPO_195_CM_S2 1 0 0 2 ECU_ADDRESS 0xFFF91318 /end MEASUREMENT
/begin MEASUREMENT Z_COS_KURVE_ALT "" UBYTE _CNV_S_3_Enum_ETOPO_195_CM_S2 1 0 0 2 ECU_ADDRESS 0xFFF91319 /end MEASUREMENT
/begin MEASUREMENT Z_COS_KURVE_ALT2 "" UBYTE _CNV_S_3_Enum_ETOPO_195_CM_S2 1 0 0 2 ECU_ADDRESS 0xFFF91413 /end MEASUREMENT
/begin MEASUREMENT Z_ERKARR2_COS "" UBYTE _CNV_R_R_Umr_1_zu_1_2_CM_S2 1 0 0 2 FORMAT "%2.0" ARRAY_SIZE 4 ECU_ADDRESS 0xFFF901D4 MATRIX_DIM 4 1 1 /end MEASUREMENT
/begin MEASUREMENT Z_ERKARR_COS "" UBYTE _CNV_R_R_Umr_1_zu_1_2_CM_S2 1 0 0 2 FORMAT "%2.0" ARRAY_SIZE 4 ECU_ADDRESS 0xFFF900C0 MATRIX_DIM 4 1 1 /end MEASUREMENT
/begin MEASUREMENT Z_KRZG_ANZKINDER_DCODR "" UBYTE _CNV_R_R_Umr_1_zu_1_2_CM_S2 1 0 0 255 FORMAT "%2.0" ECU_ADDRESS 0xFFF91433 /end MEASUREMENT
/begin MEASUREMENT Z_KRZG_TYP_DCODR "" UBYTE _CNV_S_10_Enum_EADAS_196_CM_S2 1 0 0 9 ECU_ADDRESS 0xFFF911E4 /end MEASUREMENT
/begin MEASUREMENT Z_MASK_ADAS_COS "" UBYTE _CNV_R_R_Umr_1_zu_1_2_CM_S2 1 0 0 255 FORMAT "%2.0" ECU_ADDRESS 0xFFF911D2 /end MEASUREMENT
/begin MEASUREMENT Z_MASK_ERR_DLPLS_COS "" UBYTE _CNV_R_R_Umr_1_zu_1_2_CM_S2 1 0 0 255 FORMAT "%2.0" ECU_ADDRESS 0xFFF91419 /end MEASUREMENT
/begin MEASUREMENT Z_MASK_TOPO1_COS "" UBYTE _CNV_R_R_Umr_1_zu_1_2_CM_S2 1 0 0 255 FORMAT "%2.0" ECU_ADDRESS 0xFFF911D3 /end MEASUREMENT
/begin MEASUREMENT Z_MASK_TOPOENBL_DCODR "" UBYTE _CNV_R_R_Umr_1_zu_1_2_CM_S2 1 0 0 255 FORMAT "%2.0" ECU_ADDRESS 0xFFF911E5 /end MEASUREMENT
/begin MEASUREMENT Z_MATCH_ANZKINDER_DCODR "" UBYTE _CNV_R_R_Umr_1_zu_1_2_CM_S2 1 0 0 255 FORMAT "%2.0" ECU_ADDRESS 0xFFF91434 /end MEASUREMENT
/begin MEASUREMENT Z_MATCH_ANZSPUR_DCODR "" UBYTE _CNV_R_R_Umr_1_zu_1_2_CM_S2 1 0 0 255 FORMAT "%2.0" ECU_ADDRESS 0xFFF91435 /end MEASUREMENT
/begin MEASUREMENT Z_MATCH_FID_DCODR "" UBYTE _CNV_R_R_Umr_1_zu_1_2_CM_S2 1 0 0 255 FORMAT "%2.0" ECU_ADDRESS 0xFFF91436 /end MEASUREMENT
/begin MEASUREMENT Z_MATCH_ID_DCODR "" UBYTE _CNV_R_R_Umr_1_zu_1_2_CM_S2 1 0 0 255 FORMAT "%2.0" ECU_ADDRESS 0xFFF91437 /end MEASUREMENT
/begin MEASUREMENT Z_MATCH_TYPSTRASSE_DCODR "" UBYTE _CNV_R_R_Umr_1_zu_1_2_CM_S2 1 0 0 255 FORMAT "%2.0" ECU_ADDRESS 0xFFF911E6 /end MEASUREMENT
/begin MEASUREMENT Z_NAVI_COUNTRY_CODE_IDX "" UBYTE _CNV_R_R_Umr_1_zu_1_2_CM_S2 1 0 0 255 FORMAT "%2.0" ECU_ADDRESS 0xFFF91418 /end MEASUREMENT
/begin MEASUREMENT Z_NUM_VIRT_SEGMENTS_DCODR "" UBYTE _CNV_R_R_Umr_1_zu_1_2_CM_S2 1 0 0 255 FORMAT "%2.0" ECU_ADDRESS 0xFFF91439 /end MEASUREMENT
/begin MEASUREMENT Z_TOPOLOGIE_COS "" UBYTE _CNV_R_R_Umr_1_zu_1_2_CM_S2 1 0 0 15 FORMAT "%2.0" ECU_ADDRESS 0xFFF911C8 /end MEASUREMENT
/begin MEASUREMENT Z_TOPOLOGIE_COS_AZG "" UBYTE _CNV_R_R_Umr_1_zu_1_2_CM_S2 1 0 0 255 FORMAT "%2.0" ECU_ADDRESS 0xFFF911C9 /end MEASUREMENT
/begin MEASUREMENT N_EIN_IST "" UWORD _CNV_R_R_Umr_1_zu_1_3_CM_S2 1 0 0 20000 FORMAT "%2.0" ECU_ADDRESS 0xFFF9091C /end MEASUREMENT
/begin MEASUREMENT N_EIN_START "" UWORD _CNV_R_R_Umr_1_zu_1_3_CM_S2 1 0 0 20000 FORMAT "%2.0" ECU_ADDRESS 0xFFF9091E /end MEASUREMENT
/begin MEASUREMENT N_EIN_ZIEL "" UWORD _CNV_R_R_Umr_1_zu_1_3_CM_S2 1 0 0 20000 FORMAT "%2.0" ECU_ADDRESS 0xFFF90920 /end MEASUREMENT
/begin MEASUREMENT N_MOT_ANZEIGE "" UWORD _CNV_R_R_Umr_1_zu_1_3_CM_S2 1 0 0 20000 FORMAT "%2.0" ECU_ADDRESS 0xFFF90922 /end MEASUREMENT
/begin MEASUREMENT N_RATIO_ANZEIGE "" SWORD _CNV_R_R_Umr_100_zu_54_CM_S2 1 0 -10 10 FORMAT "%4.2" ECU_ADDRESS 0xFFF90924 /end MEASUREMENT
/begin MEASUREMENT S_GANG_ANZEIGE_FREEZE "" UBYTE _CNV_S_2_Schalter_A_4_CM_S2 1 0 0 1 ECU_ADDRESS 0xFFF911E7 /end MEASUREMENT
/begin MEASUREMENT S_HS "" UBYTE _CNV_S_2_Schalter_A_4_CM_S2 1 0 0 1 ECU_ADDRESS 0xFFF911E8 /end MEASUREMENT
/begin MEASUREMENT S_N_ANGLEICH "" UBYTE _CNV_S_2_Schalter_A_4_CM_S2 1 0 0 1 ECU_ADDRESS 0xFFF911E9 /end MEASUREMENT
/begin MEASUREMENT T_KEINGANG_ANZ_NACHL "" UWORD _CNV_R_R_Umr_1_zu_1_6_CM_S2 1 0 0 65535 FORMAT "%2.0" ECU_ADDRESS 0xFFF90926 /end MEASUREMENT
/begin MEASUREMENT Z_ANZEIGEART_GANG "" UBYTE _CNV_S_6_Enum_EANZE_208_CM_S2 1 0 0 5 ECU_ADDRESS 0xFFF911EA /end MEASUREMENT
/begin MEASUREMENT Z_ANZEIGEART_GANG_ALT "" UBYTE _CNV_S_6_Enum_EANZE_208_CM_S2 1 0 0 5 ECU_ADDRESS 0xFFF911EB /end MEASUREMENT
/begin MEASUREMENT Z_ANZGANGART "" UBYTE _CNV_S_6_Enum_EANZG_205_CM_S2 1 0 0 5 ECU_ADDRESS 0xFFF911EC /end MEASUREMENT
/begin MEASUREMENT Z_DRIVEDYN_MODE "" UBYTE _CNV_S_4_Enum_EPROG_35_CM_S2 1 0 0 3 ECU_ADDRESS 0xFFF911ED /end MEASUREMENT
/begin MEASUREMENT Z_GANGWHL_AZG "" UBYTE _CNV_S_14_Enum_EGANG_88_CM_S2 1 0 0 13 ECU_ADDRESS 0xFFF911EE /end MEASUREMENT
/begin MEASUREMENT Z_GANG_ANZEIGE_ANGLEICH "" UBYTE _CNV_S_9_Enum_EGANG_30_CM_S2 1 0 0 8 ECU_ADDRESS 0xFFF911EF /end MEASUREMENT
/begin MEASUREMENT Z_GANG_ANZEIGE_AUT "" UBYTE _CNV_S_9_Enum_EGANG_30_CM_S2 1 0 0 8 ECU_ADDRESS 0xFFF911F0 /end MEASUREMENT
/begin MEASUREMENT Z_GANG_ANZEIGE_AUT_ALT "" UBYTE _CNV_S_9_Enum_EGANG_30_CM_S2 1 0 0 8 ECU_ADDRESS 0xFFF911F1 /end MEASUREMENT
/begin MEASUREMENT Z_GANG_ANZEIGE_AUT_START "" UBYTE _CNV_S_9_Enum_EGANG_30_CM_S2 1 0 0 8 ECU_ADDRESS 0xFFF911F2 /end MEASUREMENT
/begin MEASUREMENT Z_GANG_IST_ANZEIGE_ALT "" UBYTE _CNV_S_9_Enum_EGANG_30_CM_S2 1 0 0 8 ECU_ADDRESS 0xFFF911F3 /end MEASUREMENT
/begin MEASUREMENT Z_GANG_ZIEL_ANZEIGE_ALT "" UBYTE _CNV_S_9_Enum_EGANG_30_CM_S2 1 0 0 8 ECU_ADDRESS 0xFFF911F4 /end MEASUREMENT
/begin MEASUREMENT Z_PROGINF_AZG "" UBYTE _CNV_S_4_Enum_EKOMB_93_CM_S2 1 0 0 3 ECU_ADDRESS 0xFFF911F5 /end MEASUREMENT
/begin MEASUREMENT Z_PROGINF_AZG_ALT "" UBYTE _CNV_S_4_Enum_EKOMB_93_CM_S2 1 0 0 3 ECU_ADDRESS 0xFFF911F6 /end MEASUREMENT
/begin MEASUREMENT Z_SCHALTUNGSTYP "" UBYTE _CNV_S_6_Enum_ESCHA_152_CM_S2 1 0 0 5 ECU_ADDRESS 0xFFF911F7 /end MEASUREMENT
/begin MEASUREMENT C_ABREGLER "" UWORD _CNV_R_R_Umr_1_zu_1_2_CM_S2 1 0 0 65535 FORMAT "%2.0" ECU_ADDRESS 0xFFF90E1E /end MEASUREMENT
/begin MEASUREMENT FAKT_N_MOTABREGEL_MDS "" UBYTE _CNV_R_R_Umr_1_zu_1_53_CM_S2 1 0 100 115 FORMAT "%2.0" ECU_ADDRESS 0xFFF915A7 /end MEASUREMENT
/begin MEASUREMENT IG_GANG_SOLLMDS "" UWORD _CNV_R_R_Umr_1000_z_57_CM_S2 1 0 0 10 FORMAT "%5.3" ECU_ADDRESS 0xFFF90E20 /end MEASUREMENT
/begin MEASUREMENT N_MOT_NACHRS_MDSSCHUB "" UWORD _CNV_R_R_Umr_1_zu_1_3_CM_S2 1 0 0 20000 FORMAT "%2.0" ECU_ADDRESS 0xFFF90E1A /end MEASUREMENT
/begin MEASUREMENT N_T_HS_MDS "" UWORD _CNV_R_R_Umr_1_zu_1_3_CM_S2 1 0 0 65535 FORMAT "%2.0" ECU_ADDRESS 0xFFF90E22 /end MEASUREMENT
/begin MEASUREMENT N_T_RS_MDS "" UWORD _CNV_R_R_Umr_1_zu_1_3_CM_S2 1 0 0 20000 FORMAT "%2.0" ECU_ADDRESS 0xFFF90E24 /end MEASUREMENT
/begin MEASUREMENT SCHN_MOT_RSHS_MDSSCHUB "" UWORD _CNV_R_R_Umr_1_zu_1_3_CM_S2 1 0 0 20000 FORMAT "%2.0" ECU_ADDRESS 0xFFF90E1C /end MEASUREMENT
/begin MEASUREMENT SCHN_T_MDSMAXRS "" UWORD _CNV_R_R_Umr_1_zu_1_3_CM_S2 1 0 0 20000 FORMAT "%2.0" ECU_ADDRESS 0xFFF90E26 /end MEASUREMENT
/begin MEASUREMENT S_ABREGLERHILFE "" UBYTE _CNV_S_2_Schalter_A_4_CM_S2 1 0 0 1 ECU_ADDRESS 0xFFF915A2 /end MEASUREMENT
/begin MEASUREMENT S_ABREGLERSCHLUPF "" UBYTE _CNV_S_2_Schalter_A_4_CM_S2 1 0 0 1 ECU_ADDRESS 0xFFF915A3 /end MEASUREMENT
/begin MEASUREMENT S_FORCE_HS_MDSSCHUB "" UBYTE _CNV_S_2_Schalter_A_4_CM_S2 1 0 0 1 ECU_ADDRESS 0xFFF9159E /end MEASUREMENT
/begin MEASUREMENT S_STAT_ZHS "" UBYTE _CNV_P_2_A_I_5_CM_S2 1 0 0 255 ECU_ADDRESS 0xFFF915A4 /end MEASUREMENT
/begin MEASUREMENT S_T_MDSSCHUB_LAEUFT "" UBYTE _CNV_S_2_Schalter_A_4_CM_S2 1 0 0 1 ECU_ADDRESS 0xFFF9159F /end MEASUREMENT
/begin MEASUREMENT S_T_MDSSCHUB_REGEN_LAEUFT "" UBYTE _CNV_S_2_Schalter_A_4_CM_S2 1 0 0 1 ECU_ADDRESS 0xFFF915A0 /end MEASUREMENT
/begin MEASUREMENT S_VERBOT_RSHS_MDSSCHUB "" UBYTE _CNV_R_R_Umr_1_zu_1_2_CM_S2 1 0 0 1 FORMAT "%2.0" ECU_ADDRESS 0xFFF915A1 /end MEASUREMENT
/begin MEASUREMENT S_ZHS_VERBOT_DUE "" UBYTE _CNV_S_2_Schalter_A_4_CM_S2 1 0 0 1 ECU_ADDRESS 0xFFF915A5 /end MEASUREMENT
/begin MEASUREMENT S_ZHS_VERBOT_KOORD "" UBYTE _CNV_S_2_Schalter_A_4_CM_S2 1 0 0 1 ECU_ADDRESS 0xFFF915A6 /end MEASUREMENT
/begin MEASUREMENT T_ABREGLER_NXT_DECR "" ULONG _CNV_R_R_Umr_1_zu_1_6_CM_S2 1 0 0 4294967295 FORMAT "%2.0" ECU_ADDRESS 0xFFF904DC /end MEASUREMENT
/begin MEASUREMENT T_BUFFER_MDSSCHUB "" ULONG _CNV_R_R_Umr_1_zu_1_6_CM_S2 1 0 0 4294967295 FORMAT "%2.0" ECU_ADDRESS 0xFFF904CC /end MEASUREMENT
/begin MEASUREMENT T_BUFFER_MDSSCHUB_REGEN "" ULONG _CNV_R_R_Umr_1_zu_1_6_CM_S2 1 0 0 4294967295 FORMAT "%2.0" ECU_ADDRESS 0xFFF904D0 /end MEASUREMENT
/begin MEASUREMENT T_MDSSCHUB "" SLONG _CNV_R_R_Umr_1_zu_1_6_CM_S2 1 0 -2147483648 2147483647 FORMAT "%2.0" ECU_ADDRESS 0xFFF904D4 /end MEASUREMENT
/begin MEASUREMENT T_MDSSCHUB_REGEN "" SLONG _CNV_R_R_Umr_1_zu_1_6_CM_S2 1 0 -2147483648 2147483647 FORMAT "%2.0" ECU_ADDRESS 0xFFF904D8 /end MEASUREMENT
/begin MEASUREMENT CONTROL_QSHIFT_GWFP1 "" UWORD _CNV_S_3_Enum_EQSHI_226_CM_S2 1 0 0 2 ECU_ADDRESS 0xFFF90CE2 /end MEASUREMENT
/begin MEASUREMENT CONTROL_QSHIFT_GWFP2 "" UWORD _CNV_S_3_Enum_EQSHI_226_CM_S2 1 0 0 2 ECU_ADDRESS 0xFFF90CE4 /end MEASUREMENT
/begin MEASUREMENT CONTROL_QSHIFT_MFRS "" UWORD _CNV_S_3_Enum_EQSHI_226_CM_S2 1 0 0 2 ECU_ADDRESS 0xFFF90CE6 /end MEASUREMENT
/begin MEASUREMENT C_DMRSDYNAMIK_ERR "" ULONG _CNV_R_R_Umr_1_zu_1_2_CM_S2 1 0 0 4294967295 FORMAT "%2.0" ECU_ADDRESS 0xFFF900C4 /end MEASUREMENT
/begin MEASUREMENT GW_FP_MAX_QSHIFT1 "" SWORD _CNV_R_R_Umr_1_zu_1_7_CM_S2 1 0 -32768 32767 FORMAT "%2.0" ECU_ADDRESS 0xFFF90CE8 /end MEASUREMENT
/begin MEASUREMENT GW_FP_MAX_QSHIFT2 "" SWORD _CNV_R_R_Umr_1_zu_1_7_CM_S2 1 0 -32768 32767 FORMAT "%2.0" ECU_ADDRESS 0xFFF90CEA /end MEASUREMENT
/begin MEASUREMENT SCHN_MOT_QS_DOWNGRADE "" UWORD _CNV_R_R_Umr_1_zu_1_3_CM_S2 1 0 0 20000 FORMAT "%2.0" ECU_ADDRESS 0xFFF90928 /end MEASUREMENT
/begin MEASUREMENT S_DYNAMIKZYK "" UBYTE _CNV_P_2_A_I_5_CM_S2 1 0 0 255 ECU_ADDRESS 0xFFF911F8 /end MEASUREMENT
/begin MEASUREMENT S_DYNAMIK_FFG "" UBYTE _CNV_P_2_A_I_5_CM_S2 1 0 0 255 ARRAY_SIZE 15 ECU_ADDRESS 0xFFF911F9 MATRIX_DIM 15 1 1 /end MEASUREMENT
/begin MEASUREMENT S_DYN_RSAUSROLL "" UBYTE _CNV_P_2_A_I_5_CM_S2 1 0 0 255 ECU_ADDRESS 0xFFF91208 /end MEASUREMENT
/begin MEASUREMENT S_QS3_SOLL "" UBYTE _CNV_R_R_Umr_1_zu_1_2_CM_S2 1 0 0 1 FORMAT "%2.0" ECU_ADDRESS 0xFFF91475 /end MEASUREMENT
/begin MEASUREMENT S_QSHIFT_AQUER "" UBYTE _CNV_R_R_Umr_1_zu_1_2_CM_S2 1 0 0 1 ECU_ADDRESS 0xFFF91476 /end MEASUREMENT
/begin MEASUREMENT S_QSHIFT_ARR "" UBYTE _CNV_P_2_A_I_5_CM_S2 1 0 0 255 ARRAY_SIZE 43 ECU_ADDRESS 0xFFF91477 MATRIX_DIM 43 1 1 /end MEASUREMENT
/begin MEASUREMENT S_QSHIFT_DSC_AUS "" UBYTE _CNV_P_2_A_I_5_CM_S2 1 0 0 255 ECU_ADDRESS 0xFFF914A2 /end MEASUREMENT
/begin MEASUREMENT S_QSHIFT_DSC_DTC "" UBYTE _CNV_P_2_A_I_5_CM_S2 1 0 0 255 ECU_ADDRESS 0xFFF914A3 /end MEASUREMENT
/begin MEASUREMENT S_QSHIFT_EXCFKT1 "" UBYTE _CNV_P_2_A_I_5_CM_S2 1 0 0 255 ECU_ADDRESS 0xFFF914A4 /end MEASUREMENT
/begin MEASUREMENT S_QSHIFT_EXCFKT2 "" UBYTE _CNV_P_2_A_I_5_CM_S2 1 0 0 255 ECU_ADDRESS 0xFFF914A5 /end MEASUREMENT
/begin MEASUREMENT S_QSHIFT_EXCFKT3 "" UBYTE _CNV_P_2_A_I_5_CM_S2 1 0 0 255 ECU_ADDRESS 0xFFF914A6 /end MEASUREMENT
/begin MEASUREMENT S_QSHIFT_EXCFKT4 "" UBYTE _CNV_P_2_A_I_5_CM_S2 1 0 0 255 ECU_ADDRESS 0xFFF914A7 /end MEASUREMENT
/begin MEASUREMENT S_QSHIFT_EXCFKT5 "" UBYTE _CNV_P_2_A_I_5_CM_S2 1 0 0 255 ECU_ADDRESS 0xFFF914A8 /end MEASUREMENT
/begin MEASUREMENT S_QSHIFT_EXCFKT6 "" UBYTE _CNV_P_2_A_I_5_CM_S2 1 0 0 255 ECU_ADDRESS 0xFFF914A9 /end MEASUREMENT
/begin MEASUREMENT S_QSHIFT_EXCFKT7 "" UBYTE _CNV_P_2_A_I_5_CM_S2 1 0 0 255 ECU_ADDRESS 0xFFF914AA /end MEASUREMENT
/begin MEASUREMENT S_QSHIFT_EXCFKT8 "" UBYTE _CNV_P_2_A_I_5_CM_S2 1 0 0 255 ECU_ADDRESS 0xFFF914AB /end MEASUREMENT
/begin MEASUREMENT S_QSHIFT_GWDKKD1 "" UBYTE _CNV_P_2_A_I_5_CM_S2 1 0 0 255 ECU_ADDRESS 0xFFF914AC /end MEASUREMENT
/begin MEASUREMENT S_QSHIFT_GWDKKD2 "" UBYTE _CNV_P_2_A_I_5_CM_S2 1 0 0 255 ECU_ADDRESS 0xFFF914AD /end MEASUREMENT
/begin MEASUREMENT S_QSHIFT_MFHS "" UBYTE _CNV_P_2_A_I_5_CM_S2 1 0 0 255 ECU_ADDRESS 0xFFF914AE /end MEASUREMENT
/begin MEASUREMENT S_QSHIFT_MFRS "" UBYTE _CNV_P_2_A_I_5_CM_S2 1 0 0 255 ECU_ADDRESS 0xFFF914AF /end MEASUREMENT
/begin MEASUREMENT S_QSHIFT_NULLAST "" UBYTE _CNV_P_2_A_I_5_CM_S2 1 0 0 255 ECU_ADDRESS 0xFFF914B0 /end MEASUREMENT
/begin MEASUREMENT S_QSHIFT_RS "" UBYTE _CNV_S_2_Schalter_A_4_CM_S2 1 0 0 1 ECU_ADDRESS 0xFFF914B1 /end MEASUREMENT
/begin MEASUREMENT S_QSHIFT_TEMPGETR "" UBYTE _CNV_P_2_A_I_5_CM_S2 1 0 0 255 ECU_ADDRESS 0xFFF914B2 /end MEASUREMENT
/begin MEASUREMENT S_QSHIFT_TEMPKUPA "" UBYTE _CNV_P_2_A_I_5_CM_S2 1 0 0 255 ECU_ADDRESS 0xFFF914B3 /end MEASUREMENT
/begin MEASUREMENT S_QSHIFT_WDKKD1 "" UBYTE _CNV_P_2_A_I_5_CM_S2 1 0 0 255 ECU_ADDRESS 0xFFF914B4 /end MEASUREMENT
/begin MEASUREMENT S_QSHIFT_WDKKD2 "" UBYTE _CNV_P_2_A_I_5_CM_S2 1 0 0 255 ECU_ADDRESS 0xFFF914B5 /end MEASUREMENT
/begin MEASUREMENT S_QSHIFT_WDKKD3 "" UBYTE _CNV_P_2_A_I_5_CM_S2 1 0 0 255 ECU_ADDRESS 0xFFF914B6 /end MEASUREMENT
/begin MEASUREMENT T_BUFFER_DYNAMIKZYK "" ULONG _CNV_R_R_Umr_1_zu_1_6_CM_S2 1 0 0 2147483647 FORMAT "%2.0" ECU_ADDRESS 0xFFF900C8 /end MEASUREMENT
/begin MEASUREMENT T_BUFFER_QSHIFTMFRS_ACTIVE "" ULONG _CNV_R_R_Umr_1_zu_1_6_CM_S2 1 0 0 2147483647 FORMAT "%2.0" ECU_ADDRESS 0xFFF9021C /end MEASUREMENT
/begin MEASUREMENT T_BUFFER_QSHIFTMFRS_WAIT "" ULONG _CNV_R_R_Umr_1_zu_1_6_CM_S2 1 0 0 2147483647 FORMAT "%2.0" ECU_ADDRESS 0xFFF90220 /end MEASUREMENT
/begin MEASUREMENT T_DYNAMIKZYK "" SLONG _CNV_R_R_Umr_1_zu_1_6_CM_S2 1 0 -2147483647 2147483647 FORMAT "%2.0" ECU_ADDRESS 0xFFF900CC /end MEASUREMENT
/begin MEASUREMENT T_NACHLAUF_QS3 "" ULONG _CNV_R_R_Umr_1000_z_12_CM_S2 1 0 0 1024 FORMAT "%5.3" ECU_ADDRESS 0xFFF900D0 /end MEASUREMENT
/begin MEASUREMENT T_QSHIFTMFRS_ACTIVE "" SLONG _CNV_R_R_Umr_1_zu_1_6_CM_S2 1 0 -2147483647 2147483647 FORMAT "%2.0" ECU_ADDRESS 0xFFF90224 /end MEASUREMENT
/begin MEASUREMENT T_QSHIFTMFRS_WAIT "" SLONG _CNV_R_R_Umr_1_zu_1_6_CM_S2 1 0 -2147483647 2147483647 FORMAT "%2.0" ECU_ADDRESS 0xFFF90228 /end MEASUREMENT
/begin MEASUREMENT Z_ANZAHL_QS3 "" UWORD _CNV_R_R_Umr_1_zu_1_2_CM_S2 1 0 0 1024 FORMAT "%2.0" ECU_ADDRESS 0xFFF9092A /end MEASUREMENT
/begin MEASUREMENT Z_DMRS_DYN "" UBYTE _CNV_S_3_Enum_EDYN__227_CM_S2 1 0 0 2 ECU_ADDRESS 0xFFF91209 /end MEASUREMENT
/begin MEASUREMENT Z_DYNAMIK "" UBYTE _CNV_P_2_A_I_5_CM_S2 1 0 0 255 ECU_ADDRESS 0xFFF9120F /end MEASUREMENT
/begin MEASUREMENT Z_DYNAMIK_ENBL "" UBYTE _CNV_P_2_A_I_5_CM_S2 1 0 0 255 ECU_ADDRESS 0xFFF9120A /end MEASUREMENT
/begin MEASUREMENT Z_DYNAMIK_YIDX "" UBYTE _CNV_R_R_Umr_1_zu_1_2_CM_S2 1 0 0 24 FORMAT "%2.0" ECU_ADDRESS 0xFFF9120B /end MEASUREMENT
/begin MEASUREMENT Z_FPKF_DYN "" UBYTE _CNV_S_3_Enum_EDYN__228_CM_S2 1 0 0 2 ECU_ADDRESS 0xFFF9120C /end MEASUREMENT
/begin MEASUREMENT Z_GANG_SOLLALT_QSHIFT "" UBYTE _CNV_S_9_Enum_EGANG_30_CM_S2 1 0 0 8 ECU_ADDRESS 0xFFF91210 /end MEASUREMENT
/begin MEASUREMENT Z_HS_DYN "" UBYTE _CNV_S_4_Enum_EDYN__229_CM_S2 1 0 0 3 ECU_ADDRESS 0xFFF9120D /end MEASUREMENT
/begin MEASUREMENT Z_IDXGRBDYN "" UBYTE _CNV_S_16_Enum_EIDXG_225_CM_S2 1 0 0 15 ECU_ADDRESS 0xFFF914B7 /end MEASUREMENT
/begin MEASUREMENT Z_QSHIFT_XIDX "" UBYTE _CNV_S_43_Enum_EQSHI_219_CM_S2 1 0 0 42 ECU_ADDRESS 0xFFF914B8 /end MEASUREMENT
/begin MEASUREMENT Z_QSHIFT_YIDX "" UBYTE _CNV_R_R_Umr_1_zu_1_2_CM_S2 1 0 0 19 FORMAT "%2.0" ECU_ADDRESS 0xFFF914B9 /end MEASUREMENT
/begin MEASUREMENT Z_RS_DYN "" UBYTE _CNV_S_4_Enum_EDYN__230_CM_S2 1 0 0 3 ECU_ADDRESS 0xFFF9120E /end MEASUREMENT
/begin MEASUREMENT Z_SCHALTDYN "" UBYTE _CNV_S_7_Enum_ESDYN_151_CM_S2 1 0 0 6 ECU_ADDRESS 0xFFF91212 /end MEASUREMENT
/begin MEASUREMENT Z_SCHALTDYN_ALT "" UBYTE _CNV_S_7_Enum_ESDYN_151_CM_S2 1 0 0 6 ECU_ADDRESS 0xFFF91213 /end MEASUREMENT
/begin MEASUREMENT Z_SCHALTDYN_ENBL "" UBYTE _CNV_S_7_Enum_ESDYN_151_CM_S2 1 0 0 6 ECU_ADDRESS 0xFFF914BA /end MEASUREMENT
/begin MEASUREMENT Z_WKANBIND_DYN "" UBYTE _CNV_S_2_Enum_EDYN__231_CM_S2 1 0 0 1 ECU_ADDRESS 0xFFF91214 /end MEASUREMENT
/begin MEASUREMENT Z_WKSOLL_IDX "" UBYTE _CNV_S_2_Enum_EWKAN_217_CM_S2 1 0 0 1 ECU_ADDRESS 0xFFF91215 /end MEASUREMENT
/begin MEASUREMENT S_MARS_BR "" UBYTE _CNV_S_2_Schalter_A_4_CM_S2 1 0 0 1 ECU_ADDRESS 0xFFF91663 /end MEASUREMENT
/begin MEASUREMENT S_MARS_DBM "" UBYTE _CNV_R_R_Umr_1_zu_1_2_CM_S2 1 0 0 255 FORMAT "%2.0" ECU_ADDRESS 0xFFF91664 /end MEASUREMENT
/begin MEASUREMENT S_MARS_G2W "" UBYTE _CNV_S_2_Schalter_A_4_CM_S2 1 0 0 1 ECU_ADDRESS 0xFFF91665 /end MEASUREMENT
/begin MEASUREMENT Z_GANG_MARS "" UBYTE _CNV_S_9_Enum_EGANG_30_CM_S2 1 0 0 8 ECU_ADDRESS 0xFFF91666 /end MEASUREMENT
/begin MEASUREMENT Z_GANG_SKLMARS "" UBYTE _CNV_S_9_Enum_EGANG_30_CM_S2 1 0 0 8 ECU_ADDRESS 0xFFF91667 /end MEASUREMENT
/begin MEASUREMENT S_ZRSGANG1_ERK "" UBYTE _CNV_P_2_A_I_5_CM_S2 1 0 0 255 ECU_ADDRESS 0xFFF9150B /end MEASUREMENT
/begin MEASUREMENT S_ZRSGANG1_EXT_ERK "" UBYTE _CNV_R_R_Umr_1_zu_1_2_CM_S2 1 0 0 1 ECU_ADDRESS 0xFFF9150C /end MEASUREMENT
/begin MEASUREMENT DBG_BRMAX_ZKA "" SWORD _CNV_R_R_Umr_1_zu_1_42_CM_S2 1 0 -32768 32767 FORMAT "%2.0" ECU_ADDRESS 0xFFF90E5A /end MEASUREMENT
/begin MEASUREMENT DBG_BRMIN_ZKA "" SWORD _CNV_R_R_Umr_1_zu_1_42_CM_S2 1 0 -32768 32767 FORMAT "%2.0" ECU_ADDRESS 0xFFF90E5C /end MEASUREMENT
/begin MEASUREMENT DBG_DYN2_ZKA_2 "" UBYTE _CNV_R_R_Umr_1_zu_1_2_CM_S2 1 0 0 255 FORMAT "%2.0" ECU_ADDRESS 0xFFF915B1 /end MEASUREMENT
/begin MEASUREMENT DBG_GANG_DIFF_ZKA "" SWORD _CNV_R_R_Umr_1_zu_1_2_CM_S2 1 0 -8 8 FORMAT "%2.0" ECU_ADDRESS 0xFFF90E5E /end MEASUREMENT
/begin MEASUREMENT DBG_GANG_KLOPT_ZKA "" UBYTE _CNV_S_9_Enum_EGANG_30_CM_S2 1 0 0 8 ECU_ADDRESS 0xFFF915B2 /end MEASUREMENT
/begin MEASUREMENT DBG_ILOC_ZKA "" UWORD _CNV_R_R_Umr_1_zu_1_2_CM_S2 1 0 0 8 FORMAT "%2.0" ECU_ADDRESS 0xFFF90E60 /end MEASUREMENT
/begin MEASUREMENT DBG_KL_GANGAKT_SCHUB_ZKA "" UWORD _CNV_R_R_Umr_1_zu_1_2_CM_S2 1 0 0 65535 FORMAT "%2.0" ECU_ADDRESS 0xFFF90E62 /end MEASUREMENT
/begin MEASUREMENT DBG_KL_GANGAKT_ZKA2 "" UWORD _CNV_R_R_Umr_1_zu_1_2_CM_S2 1 0 0 65535 FORMAT "%2.0" ECU_ADDRESS 0xFFF90E64 /end MEASUREMENT
/begin MEASUREMENT DBG_KL_HIGH_SCHUB_ZKA "" UWORD _CNV_R_R_Umr_1_zu_1_2_CM_S2 1 0 0 65535 FORMAT "%2.0" ECU_ADDRESS 0xFFF90E66 /end MEASUREMENT
/begin MEASUREMENT DBG_KL_HIGH_ZKA "" UWORD _CNV_R_R_Umr_1_zu_1_2_CM_S2 1 0 0 65535 FORMAT "%2.0" ECU_ADDRESS 0xFFF90E68 /end MEASUREMENT
/begin MEASUREMENT DBG_KL_LOW_SCHUB_ZKA "" UWORD _CNV_R_R_Umr_1_zu_1_2_CM_S2 1 0 0 65535 FORMAT "%2.0" ECU_ADDRESS 0xFFF90E6A /end MEASUREMENT
/begin MEASUREMENT DBG_KL_LOW_ZKA2 "" UWORD _CNV_R_R_Umr_1_zu_1_2_CM_S2 1 0 0 65535 FORMAT "%2.0" ECU_ADDRESS 0xFFF90E6C /end MEASUREMENT
/begin MEASUREMENT DBG_KRIT_ENBL1 "" UBYTE _CNV_R_R_Umr_1_zu_1_2_CM_S2 1 0 0 1 FORMAT "%2.0" ECU_ADDRESS 0xFFF915B3 /end MEASUREMENT
/begin MEASUREMENT DBG_KRIT_ENBL3 "" UBYTE _CNV_R_R_Umr_1_zu_1_2_CM_S2 1 0 0 1 FORMAT "%2.0" ECU_ADDRESS 0xFFF915B4 /end MEASUREMENT
/begin MEASUREMENT DBG_NGE_G_ZKA "" UWORD _CNV_R_R_Umr_1_zu_1_2_CM_S2 1 0 0 20000 FORMAT "%2.0" ECU_ADDRESS 0xFFF90E6E /end MEASUREMENT
/begin MEASUREMENT DBG_POT_KL_OPT_FAKT_ZKA "" SLONG _CNV_R_R_Umr_1_zu_1_2_CM_S2 1 0 -2147483648 2147483647 FORMAT "%2.0" ECU_ADDRESS 0xFFF904FC /end MEASUREMENT
/begin MEASUREMENT DBG_POT_KL_OPT_ZKA "" SLONG _CNV_R_R_Umr_1_zu_1_2_CM_S2 1 0 -2147483648 2147483647 FORMAT "%2.0" ECU_ADDRESS 0xFFF90500 /end MEASUREMENT
/begin MEASUREMENT DBG_STABKRI_RICHT_ZKA "" UBYTE _CNV_R_R_Umr_1_zu_1_2_CM_S2 1 0 0 1 FORMAT "%2.0" ECU_ADDRESS 0xFFF915B5 /end MEASUREMENT
/begin MEASUREMENT DBG_STABKRI_VETO_ZKA "" UBYTE _CNV_R_R_Umr_1_zu_1_2_CM_S2 1 0 0 1 FORMAT "%2.0" ECU_ADDRESS 0xFFF915B6 /end MEASUREMENT
/begin MEASUREMENT DBG_STRAT_VAL_1_ZKA "" UWORD _CNV_R_R_Umr_1_zu_1_2_CM_S2 1 0 0 65535 FORMAT "%2.0" ECU_ADDRESS 0xFFF90E70 /end MEASUREMENT
/begin MEASUREMENT FAKT_MMOT_DYNKOR_ZKA "" UBYTE _CNV_R_R_Umr_1_zu_1_53_CM_S2 1 0 0 100 FORMAT "%2.0" ECU_ADDRESS 0xFFF9163B /end MEASUREMENT
/begin MEASUREMENT FAKT_M_MOTDYNGEW_HKOR_ZKA "" UBYTE _CNV_R_R_Umr_1_zu_1_53_CM_S2 1 0 0 200 FORMAT "%2.0" ECU_ADDRESS 0xFFF915AF /end MEASUREMENT
/begin MEASUREMENT MDRAD_FWSBERG_ZKA "" SWORD _CNV_R_R_Umr_1_zu_1_42_CM_S2 1 0 -32768 32767 FORMAT "%2.0" ECU_ADDRESS 0xFFF90E72 /end MEASUREMENT
/begin MEASUREMENT MDRAD_FWSEBENE_ZKA "" SWORD _CNV_R_R_Umr_1_zu_1_42_CM_S2 1 0 -32768 32767 FORMAT "%2.0" ECU_ADDRESS 0xFFF90E74 /end MEASUREMENT
/begin MEASUREMENT M_EM1MAX_SS_ZKA "" SWORD _CNV_R_R_Umr_1_zu_1_42_CM_S2 1 0 -1023.5 1023.5 FORMAT "%2.0" ECU_ADDRESS 0xFFF90E76 /end MEASUREMENT
/begin MEASUREMENT M_EM1MIN_SS_ZKA "" SWORD _CNV_R_R_Umr_1_zu_1_42_CM_S2 1 0 -32768 32767 FORMAT "%2.0" ECU_ADDRESS 0xFFF90E78 /end MEASUREMENT
/begin MEASUREMENT M_GE_EM1MAX_ZKA "" SWORD _CNV_R_R_Umr_1_zu_1_42_CM_S2 1 0 0 1023.5 FORMAT "%2.0" ECU_ADDRESS 0xFFF90E7A /end MEASUREMENT
/begin MEASUREMENT M_GE_EM1MIN_ZKA "" SWORD _CNV_R_R_Umr_1_zu_1_42_CM_S2 1 0 -1023.5 0 FORMAT "%2.0" ECU_ADDRESS 0xFFF90E7C /end MEASUREMENT
/begin MEASUREMENT M_GE_MOTMAX_ZKA "" SLONG _CNV_R_R_Umr_1_zu_1_42_CM_S2 1 0 0 1000 FORMAT "%2.0" ECU_ADDRESS 0xFFF90504 /end MEASUREMENT
/begin MEASUREMENT M_GE_MOTMIN_ZKA "" SLONG _CNV_R_R_Umr_1_zu_1_42_CM_S2 1 0 -200 0 FORMAT "%2.0" ECU_ADDRESS 0xFFF90508 /end MEASUREMENT
/begin MEASUREMENT M_MOT_GANGPOT_ZKA "" SLONG _CNV_R_R_Umr_1_zu_1_42_CM_S2 1 0 -32000000 32000000 FORMAT "%2.0" ECU_ADDRESS 0xFFF904E8 /end MEASUREMENT
/begin MEASUREMENT M_MOT_MINDME_ZKA "" SWORD _CNV_R_R_Umr_1_zu_1_42_CM_S2 1 0 -32767 0 FORMAT "%2.0" ECU_ADDRESS 0xFFF90E7E /end MEASUREMENT
/begin MEASUREMENT M_MOT_POT_HKOR_ZKA "" SWORD _CNV_R_R_Umr_1_zu_1_42_CM_S2 1 0 -32768 32767 FORMAT "%2.0" ECU_ADDRESS 0xFFF90E80 /end MEASUREMENT
/begin MEASUREMENT M_RADSOLL_STABKRI_START_ZKA "" SLONG _CNV_R_R_Umr_1_zu_1_42_CM_S2 1 0 -2147483648 2147483647 FORMAT "%2.0" ECU_ADDRESS 0xFFF9050C /end MEASUREMENT
/begin MEASUREMENT M_RAD_AKTOPT_ZKA "" SLONG _CNV_R_R_Umr_1_zu_1_42_CM_S2 1 0 -2147483648 2147483647 FORMAT "%2.0" ECU_ADDRESS 0xFFF904EC /end MEASUREMENT
/begin MEASUREMENT M_RAD_GANGPOT_ZKA "" SLONG _CNV_R_R_Umr_1_zu_1_42_CM_S2 1 0 -32000000 32000000 FORMAT "%2.0" ECU_ADDRESS 0xFFF904F0 /end MEASUREMENT
/begin MEASUREMENT M_RAD_HIGHOPT_ZKA "" SLONG _CNV_R_R_Umr_1_zu_1_42_CM_S2 1 0 -2147483648 2147483647 FORMAT "%2.0" ECU_ADDRESS 0xFFF904F4 /end MEASUREMENT
/begin MEASUREMENT M_RAD_LOWOPT_ZKA "" SLONG _CNV_R_R_Umr_1_zu_1_42_CM_S2 1 0 -2147483648 2147483647 FORMAT "%2.0" ECU_ADDRESS 0xFFF904F8 /end MEASUREMENT
/begin MEASUREMENT M_RAD_OPT_ZKA "" SLONG _CNV_R_R_Umr_1_zu_1_42_CM_S2 1 0 -32000000 32000000 FORMAT "%2.0" ARRAY_SIZE 9 ECU_ADDRESS 0xFFF90510 MATRIX_DIM 9 1 1 /end MEASUREMENT
/begin MEASUREMENT M_RAD_POT_ZKA "" SLONG _CNV_R_R_Umr_1_zu_1_42_CM_S2 1 0 -32000000 32000000 FORMAT "%2.0" ARRAY_SIZE 9 ECU_ADDRESS 0xFFF90534 MATRIX_DIM 9 1 1 /end MEASUREMENT
/begin MEASUREMENT M_RAD_WUNSCH_MOD_ZKA "" SWORD _CNV_R_R_Umr_1_zu_1_42_CM_S2 1 0 -32768 32767 FORMAT "%2.0" ECU_ADDRESS 0xFFF90E82 /end MEASUREMENT
/begin MEASUREMENT M_RAD_WUNSCH_ZKA "" SWORD _CNV_R_R_Umr_1_zu_1_42_CM_S2 1 0 -32768 32767 FORMAT "%2.0" ECU_ADDRESS 0xFFF90E84 /end MEASUREMENT
/begin MEASUREMENT P_LUFT_ZKA "" SWORD _CNV_R_R_Umr_1_zu_1_0_CM_S2 1 0 598 1108 FORMAT "%2.0" ECU_ADDRESS 0xFFF90E86 /end MEASUREMENT
/begin MEASUREMENT SCHW_MRADSOLL_STABKRI_HIGH_ZKA "" SLONG _CNV_R_R_Umr_1_zu_1_42_CM_S2 1 0 -2147483648 2147483647 FORMAT "%2.0" ECU_ADDRESS 0xFFF90558 /end MEASUREMENT
/begin MEASUREMENT SCHW_MRADSOLL_STABKRI_LOW_ZKA "" SLONG _CNV_R_R_Umr_1_zu_1_42_CM_S2 1 0 -2147483648 2147483647 FORMAT "%2.0" ECU_ADDRESS 0xFFF9055C /end MEASUREMENT
/begin MEASUREMENT SCHW_VFZG_STABKRI_HIGH_ZKA "" SLONG _CNV_R_R_Umr_1_zu_1_8_CM_S2 1 0 -2147483648 2147483647 FORMAT "%2.0" ECU_ADDRESS 0xFFF90560 /end MEASUREMENT
/begin MEASUREMENT SCHW_VFZG_STABKRI_LOW_ZKA "" SLONG _CNV_R_R_Umr_1_zu_1_8_CM_S2 1 0 -2147483648 2147483647 FORMAT "%2.0" ECU_ADDRESS 0xFFF90564 /end MEASUREMENT
/begin MEASUREMENT S_EM1_ZKA "" UBYTE _CNV_R_R_Umr_1_zu_1_2_CM_S2 1 0 0 255 FORMAT "%2.0" ECU_ADDRESS 0xFFF9168F /end MEASUREMENT
/begin MEASUREMENT S_EM2_ZKA "" UBYTE _CNV_R_R_Umr_1_zu_1_2_CM_S2 1 0 0 255 FORMAT "%2.0" ECU_ADDRESS 0xFFF91690 /end MEASUREMENT
/begin MEASUREMENT S_MRADWUNSCH_BEGRENZT_ZKA "" UBYTE _CNV_R_R_Umr_1_zu_1_2_CM_S2 1 0 0 255 FORMAT "%2.0" ECU_ADDRESS 0xFFF915B7 /end MEASUREMENT
/begin MEASUREMENT S_T_MFRSSTART_ZKA "" UBYTE _CNV_R_R_Umr_1_zu_1_2_CM_S2 1 0 0 255 FORMAT "%2.0" ECU_ADDRESS 0xFFF915B8 /end MEASUREMENT
/begin MEASUREMENT T_MSCTR_ALT_ZKA "" ULONG _CNV_R_R_Umr_1_zu_1_6_CM_S2 1 0 0 4294967295 FORMAT "%2.0" ECU_ADDRESS 0xFFF90568 /end MEASUREMENT
/begin MEASUREMENT T_MSCTR_DIFF_ZKA "" ULONG _CNV_R_R_Umr_1_zu_1_6_CM_S2 1 0 0 4294967295 FORMAT "%2.0" ECU_ADDRESS 0xFFF9056C /end MEASUREMENT
/begin MEASUREMENT T_MSCTR_ZKA "" ULONG _CNV_R_R_Umr_1_zu_1_6_CM_S2 1 0 0 4294967295 FORMAT "%2.0" ECU_ADDRESS 0xFFF90570 /end MEASUREMENT
/begin MEASUREMENT T_SEQ_SCHALT_ZKA "" SLONG _CNV_R_R_Umr_1_zu_1_146_CM_S2 1 0 -2147483648 2147483647 FORMAT "%2.0" ECU_ADDRESS 0xFFF90574 /end MEASUREMENT
/begin MEASUREMENT T_SPERRHS_LDMMODEW_ZKA "" SLONG _CNV_R_R_Umr_1_zu_1_6_CM_S2 1 0 -2147483648 2147483647 FORMAT "%2.0" ECU_ADDRESS 0xFFF90578 /end MEASUREMENT
/begin MEASUREMENT T_STABKRI_ZKA "" SLONG _CNV_R_R_Umr_1_zu_1_2_CM_S2 1 0 -2147483648 2147483647 FORMAT "%2.0" ECU_ADDRESS 0xFFF9057C /end MEASUREMENT
/begin MEASUREMENT VALID_GEARS_ZKA "" SWORD _CNV_S_5_Enum_EVALI_246_CM_S2 1 0 0 30 ARRAY_SIZE 9 ECU_ADDRESS 0xFFF90E88 MATRIX_DIM 9 1 1 /end MEASUREMENT
/begin MEASUREMENT V_FZG_STABKRI_START_ZKA "" SLONG _CNV_R_R_Umr_1_zu_1_8_CM_S2 1 0 -2147483648 2147483647 FORMAT "%2.0" ECU_ADDRESS 0xFFF90580 /end MEASUREMENT
/begin MEASUREMENT ZKA_DBG17 "" UWORD _CNV_R_R_Umr_1_zu_1_2_CM_S2 1 0 0 65535 FORMAT "%2.0" ECU_ADDRESS 0xFFF90E9A /end MEASUREMENT
/begin MEASUREMENT ZKA_DBG19 "" SWORD _CNV_R_R_Umr_1_zu_1_2_CM_S2 1 0 -32768 32767 FORMAT "%2.0" ECU_ADDRESS 0xFFF90E9C /end MEASUREMENT
/begin MEASUREMENT ZKA_DBG23 "" SWORD _CNV_R_R_Umr_1_zu_1_2_CM_S2 1 0 -32768 32767 FORMAT "%2.0" ECU_ADDRESS 0xFFF90E9E /end MEASUREMENT
/begin MEASUREMENT ZKA_DBG24 "" SWORD _CNV_R_R_Umr_1_zu_1_2_CM_S2 1 0 -32768 32767 FORMAT "%2.0" ECU_ADDRESS 0xFFF90EA0 /end MEASUREMENT
/begin MEASUREMENT ZKA_DBG26 "" SWORD _CNV_R_R_Umr_1_zu_1_2_CM_S2 1 0 -32768 32767 FORMAT "%2.0" ECU_ADDRESS 0xFFF90EA2 /end MEASUREMENT
/begin MEASUREMENT Z_GANG_ALGO_ZKA "" UBYTE _CNV_S_9_Enum_EGANG_30_CM_S2 1 0 0 8 ECU_ADDRESS 0xFFF915B9 /end MEASUREMENT
/begin MEASUREMENT Z_GANG_KD_ZKA "" UBYTE _CNV_S_9_Enum_EGANG_30_CM_S2 1 0 0 8 ECU_ADDRESS 0xFFF915BA /end MEASUREMENT
/begin MEASUREMENT Z_GANG_SEQ_ZKA "" UBYTE _CNV_S_9_Enum_EGANG_30_CM_S2 1 0 0 8 ECU_ADDRESS 0xFFF915BB /end MEASUREMENT
/begin MEASUREMENT Z_GANG_SOLL_ZKA "" UBYTE _CNV_S_9_Enum_EGANG_30_CM_S2 1 0 0 8 ECU_ADDRESS 0xFFF915BC /end MEASUREMENT
/begin MEASUREMENT Z_GANG_SPERRHS_ZKA "" UBYTE _CNV_S_9_Enum_EGANG_30_CM_S2 1 0 0 8 ECU_ADDRESS 0xFFF915BD /end MEASUREMENT
/begin MEASUREMENT Z_GEARS_ZKA_MASK "" UBYTE _CNV_R_R_Umr_1_zu_1_2_CM_S2 1 0 0 255 FORMAT "%2.0" ECU_ADDRESS 0xFFF915BE /end MEASUREMENT
/begin MEASUREMENT Z_MAXHS_ZKA "" UBYTE _CNV_R_R_Umr_1_zu_1_2_CM_S2 1 0 0 255 FORMAT "%2.0" ECU_ADDRESS 0xFFF91691 /end MEASUREMENT
/begin MEASUREMENT Z_MAXRS_ZKA "" UBYTE _CNV_R_R_Umr_1_zu_1_2_CM_S2 1 0 0 255 FORMAT "%2.0" ECU_ADDRESS 0xFFF91692 /end MEASUREMENT
/begin MEASUREMENT Z_MAX_KRIT_ZKA "" SWORD _CNV_S_5_Enum_EVALI_246_CM_S2 1 0 0 30 ECU_ADDRESS 0xFFF90EA4 /end MEASUREMENT
/begin MEASUREMENT Z_MRADSOLL_STABKRI_ZKA "" UBYTE _CNV_R_R_Umr_1_zu_1_2_CM_S2 1 0 0 1 FORMAT "%2.0" ECU_ADDRESS 0xFFF915BF /end MEASUREMENT
/begin MEASUREMENT Z_MRAD_BEGRENZT_ZKA "" UBYTE _CNV_R_R_Umr_1_zu_1_2_CM_S2 1 0 0 255 FORMAT "%2.0" ECU_ADDRESS 0xFFF915B0 /end MEASUREMENT
/begin MEASUREMENT Z_PRISQ_IDX_ZKA "" SBYTE _CNV_S_6_Enum_EZKAT_247_CM_S2 1 0 -1 4 ARRAY_SIZE 5 ECU_ADDRESS 0xFFF915C0 MATRIX_DIM 5 1 1 /end MEASUREMENT
/begin MEASUREMENT Z_SCHUB_ERK_ZKA "" UBYTE _CNV_R_R_Umr_1_zu_1_2_CM_S2 1 0 0 1 FORMAT "%2.0" ECU_ADDRESS 0xFFF915C5 /end MEASUREMENT
/begin MEASUREMENT Z_VFZG_STABKRI_ZKA "" UBYTE _CNV_R_R_Umr_1_zu_1_8_CM_S2 1 0 0 1 FORMAT "%2.0" ECU_ADDRESS 0xFFF915C6 /end MEASUREMENT
/begin MEASUREMENT N_T_MIN_NACHRS "" UWORD _CNV_R_R_Umr_1_zu_1_3_CM_S2 1 0 0 20000 FORMAT "%2.0" ECU_ADDRESS 0xFFF911AA /end MEASUREMENT
/begin MEASUREMENT S_DDRS_NTMIN "" UBYTE _CNV_P_2_A_I_5_CM_S2 1 0 0 255 ECU_ADDRESS 0xFFF91780 /end MEASUREMENT
/begin MEASUREMENT T_DDRS "" UWORD _CNV_R_R_Umr_1_zu_1_6_CM_S2 1 0 0 65535 FORMAT "%2.0" ECU_ADDRESS 0xFFF911AC /end MEASUREMENT
/begin MEASUREMENT T_STARTBUF_DDRS "" ULONG _CNV_R_R_Umr_1_zu_1_6_CM_S2 1 0 0 4294967295 FORMAT "%2.0" ECU_ADDRESS 0xFFF90884 /end MEASUREMENT
/begin MEASUREMENT W_DKKD_DDRS_NTMIN "" UWORD _CNV_R_R_Umr_10_zu__9_CM_S2 1 0 0 110 FORMAT "%3.1" ECU_ADDRESS 0xFFF911AE /end MEASUREMENT
/begin MEASUREMENT Z_Gang_DDRS_NTMIN "" UBYTE _CNV_S_9_Enum_EGANG_30_CM_S2 1 0 0 8 ECU_ADDRESS 0xFFF91781 /end MEASUREMENT
/begin MEASUREMENT SCHN_AB_DERS "" UWORD _CNV_R_R_Umr_1_zu_1_3_CM_S2 1 0 0 20000 FORMAT "%2.0" ECU_ADDRESS 0xFFF90DEC /end MEASUREMENT
/begin MEASUREMENT S_DERS "" UBYTE _CNV_R_R_Umr_1_zu_1_2_CM_S2 1 0 0 1 FORMAT "%2.0" ECU_ADDRESS 0xFFF914CE /end MEASUREMENT
/begin MEASUREMENT S_DERS_DMRS "" UBYTE _CNV_R_R_Umr_1_zu_1_2_CM_S2 1 0 0 1 FORMAT "%2.0" ECU_ADDRESS 0xFFF914CF /end MEASUREMENT
/begin MEASUREMENT S_DERS_ERK "" UBYTE _CNV_R_R_Umr_1_zu_1_2_CM_S2 1 0 0 1 FORMAT "%2.0" ECU_ADDRESS 0xFFF914D0 /end MEASUREMENT
/begin MEASUREMENT S_DERS_LWVA "" UBYTE _CNV_R_R_Umr_1_zu_1_2_CM_S2 1 0 0 1 FORMAT "%2.0" ECU_ADDRESS 0xFFF914D1 /end MEASUREMENT
/begin MEASUREMENT S_DERS_NIC "" UBYTE _CNV_R_R_Umr_1_zu_1_2_CM_S2 1 0 0 1 FORMAT "%2.0" ECU_ADDRESS 0xFFF914D2 /end MEASUREMENT
/begin MEASUREMENT S_DERS_NL "" UBYTE _CNV_R_R_Umr_1_zu_1_2_CM_S2 1 0 0 1 FORMAT "%2.0" ECU_ADDRESS 0xFFF914D3 /end MEASUREMENT
/begin MEASUREMENT S_DERS_WAIT "" UBYTE _CNV_R_R_Umr_1_zu_1_2_CM_S2 1 0 0 1 FORMAT "%2.0" ECU_ADDRESS 0xFFF91582 /end MEASUREMENT
/begin MEASUREMENT S_T_DERS_HS "" UBYTE _CNV_R_R_Umr_1_zu_1_2_CM_S2 1 0 0 1 FORMAT "%2.0" ECU_ADDRESS 0xFFF914D4 /end MEASUREMENT
/begin MEASUREMENT S_T_DERS_LAEUFT "" UBYTE _CNV_R_R_Umr_1_zu_1_2_CM_S2 1 0 0 1 FORMAT "%2.0" ECU_ADDRESS 0xFFF914D5 /end MEASUREMENT
/begin MEASUREMENT S_T_DERS_NL_HS "" UBYTE _CNV_R_R_Umr_1_zu_1_2_CM_S2 1 0 0 1 FORMAT "%2.0" ECU_ADDRESS 0xFFF914D6 /end MEASUREMENT
/begin MEASUREMENT T_BUFFER_DERS "" ULONG _CNV_R_R_Umr_1_zu_1_6_CM_S2 1 0 0 2147483647 FORMAT "%2.0" ECU_ADDRESS 0xFFF9023C /end MEASUREMENT
/begin MEASUREMENT T_BUFFER_DERS_HS "" ULONG _CNV_R_R_Umr_1_zu_1_6_CM_S2 1 0 0 2147483647 FORMAT "%2.0" ECU_ADDRESS 0xFFF90240 /end MEASUREMENT
/begin MEASUREMENT T_BUFFER_DERS_WAIT "" ULONG _CNV_R_R_Umr_1_zu_1_6_CM_S2 1 0 0 2147483647 FORMAT "%2.0" ECU_ADDRESS 0xFFF904B8 /end MEASUREMENT
/begin MEASUREMENT T_DERS "" UWORD _CNV_R_R_Umr_1_zu_1_6_CM_S2 1 0 0 65535 FORMAT "%2.0" ECU_ADDRESS 0xFFF90CFC /end MEASUREMENT
/begin MEASUREMENT T_DERS_HS "" UWORD _CNV_R_R_Umr_1_zu_1_6_CM_S2 1 0 0 65535 FORMAT "%2.0" ECU_ADDRESS 0xFFF90CFE /end MEASUREMENT
/begin MEASUREMENT T_DERS_WAIT "" UWORD _CNV_R_R_Umr_1_zu_1_6_CM_S2 1 0 0 65535 FORMAT "%2.0" ECU_ADDRESS 0xFFF90DEE /end MEASUREMENT
/begin MEASUREMENT W_DKKD_DERS "" UWORD _CNV_R_R_Umr_10_zu__9_CM_S2 1 0 0 6553.5 FORMAT "%3.1" ECU_ADDRESS 0xFFF90D00 /end MEASUREMENT
/begin MEASUREMENT W_DKKD_DERSALT "" UWORD _CNV_R_R_Umr_10_zu__9_CM_S2 1 0 0 6553.5 FORMAT "%3.1" ECU_ADDRESS 0xFFF90D02 /end MEASUREMENT
/begin MEASUREMENT Z_DERS_YIDX "" UBYTE _CNV_R_R_Umr_1_zu_1_2_CM_S2 1 0 0 1 ECU_ADDRESS 0xFFF914D7 /end MEASUREMENT
/begin MEASUREMENT Z_GANG_DERS "" UBYTE _CNV_S_9_Enum_EGANG_30_CM_S2 1 0 0 8 ECU_ADDRESS 0xFFF91583 /end MEASUREMENT
/begin MEASUREMENT Z_GANG_KOOP_DERS "" UBYTE _CNV_S_9_Enum_EGANG_30_CM_S2 1 0 0 8 ECU_ADDRESS 0xFFF91584 /end MEASUREMENT
/begin MEASUREMENT C_BMWAGS2_BREAK "" UWORD _CNV_R_R_Umr_1_zu_1_2_CM_S2 1 0 0 65535 FORMAT "%2.0" ECU_ADDRESS 0xFFF908C4 /end MEASUREMENT
/begin MEASUREMENT DBG_SYNC_IN "" ULONG _CNV_R_R_Umr_1_zu_1_2_CM_S2 1 0 0 4294967295 FORMAT "%2.0" ECU_ADDRESS 0xFFF900B4 /end MEASUREMENT
/begin MEASUREMENT DBG_SYNC_OUT "" ULONG _CNV_R_R_Umr_1_zu_1_2_CM_S2 1 0 0 4294967295 FORMAT "%2.0" ECU_ADDRESS 0xFFF900B8 /end MEASUREMENT
/begin MEASUREMENT S_BMWAGS2_AKTIV "" UBYTE _CNV_S_2_Schalter_A_4_CM_S2 1 0 0 1 ECU_ADDRESS 0xFFF911C6 /end MEASUREMENT
/begin MEASUREMENT T_RUNTIME_ADAS "" UWORD _CNV_R_R_Umr_1_zu_1_2_CM_S2 1 0 0 65535 FORMAT "%2.0" ECU_ADDRESS 0xFFF908C6 /end MEASUREMENT
/begin MEASUREMENT T_RUNTIME_AGS "" UWORD _CNV_R_R_Umr_100_zu_104_CM_S2 1 0 0 655.35 FORMAT "%4.2" ECU_ADDRESS 0xFFF908C8 /end MEASUREMENT
/begin MEASUREMENT T_RUNTIME_AUTOMAT "" UWORD _CNV_R_R_Umr_1_zu_1_132_CM_S2 1 0 0 65535 FORMAT "%2.0" ECU_ADDRESS 0xFFF908CA /end MEASUREMENT
/begin MEASUREMENT T_RUNTIME_BMWCRUISE10_1 "" UWORD _CNV_R_R_Umr_1_zu_1_132_CM_S2 1 0 0 65535 FORMAT "%2.0" ECU_ADDRESS 0xFFF908CC /end MEASUREMENT
/begin MEASUREMENT T_RUNTIME_BMWCRUISE10_2 "" UWORD _CNV_R_R_Umr_1_zu_1_132_CM_S2 1 0 0 65535 FORMAT "%2.0" ECU_ADDRESS 0xFFF908CE /end MEASUREMENT
/begin MEASUREMENT T_RUNTIME_DBM "" UWORD _CNV_R_R_Umr_1_zu_1_132_CM_S2 1 0 0 65535 FORMAT "%2.0" ECU_ADDRESS 0xFFF908D0 /end MEASUREMENT
/begin MEASUREMENT T_RUNTIME_DYNAMIK "" UWORD _CNV_R_R_Umr_1_zu_1_132_CM_S2 1 0 0 65535 FORMAT "%2.0" ECU_ADDRESS 0xFFF908D2 /end MEASUREMENT
/begin MEASUREMENT T_RUNTIME_ERKKOOP "" UWORD _CNV_R_R_Umr_1_zu_1_132_CM_S2 1 0 0 65535 FORMAT "%2.0" ECU_ADDRESS 0xFFF908D4 /end MEASUREMENT
/begin MEASUREMENT T_RUNTIME_ERKPRISQPRIO "" UWORD _CNV_R_R_Umr_1_zu_1_132_CM_S2 1 0 0 65535 FORMAT "%2.0" ECU_ADDRESS 0xFFF908D6 /end MEASUREMENT
/begin MEASUREMENT T_RUNTIME_FAHRERASSISTENT "" UWORD _CNV_R_R_Umr_1_zu_1_132_CM_S2 1 0 0 65535 FORMAT "%2.0" ECU_ADDRESS 0xFFF908D8 /end MEASUREMENT
/begin MEASUREMENT T_RUNTIME_FFG "" UWORD _CNV_R_R_Umr_1_zu_1_132_CM_S2 1 0 0 65535 FORMAT "%2.0" ECU_ADDRESS 0xFFF908DA /end MEASUREMENT
/begin MEASUREMENT T_RUNTIME_GFBMW30MS "" UWORD _CNV_R_R_Umr_1_zu_1_132_CM_S2 1 0 0 65535 FORMAT "%2.0" ECU_ADDRESS 0xFFF908DC /end MEASUREMENT
/begin MEASUREMENT T_RUNTIME_K0 "" UWORD _CNV_R_R_Umr_1_zu_1_132_CM_S2 1 0 0 65535 FORMAT "%2.0" ECU_ADDRESS 0xFFF908DE /end MEASUREMENT
/begin MEASUREMENT T_RUNTIME_KOMBIANZEIGE "" UWORD _CNV_R_R_Umr_1_zu_1_132_CM_S2 1 0 0 65535 FORMAT "%2.0" ECU_ADDRESS 0xFFF908E0 /end MEASUREMENT
/begin MEASUREMENT T_RUNTIME_KOORDSLOW "" UWORD _CNV_R_R_Umr_1_zu_1_132_CM_S2 1 0 0 65535 FORMAT "%2.0" ECU_ADDRESS 0xFFF908E2 /end MEASUREMENT
/begin MEASUREMENT T_RUNTIME_KRAFTSCHLUSS "" UWORD _CNV_R_R_Umr_1_zu_1_132_CM_S2 1 0 0 65535 FORMAT "%2.0" ECU_ADDRESS 0xFFF908E4 /end MEASUREMENT
/begin MEASUREMENT T_RUNTIME_LAYEROUTPUT "" UWORD _CNV_R_R_Umr_1_zu_1_132_CM_S2 1 0 0 65535 FORMAT "%2.0" ECU_ADDRESS 0xFFF908E6 /end MEASUREMENT
/begin MEASUREMENT T_RUNTIME_MSA "" UWORD _CNV_R_R_Umr_1_zu_1_132_CM_S2 1 0 0 65535 FORMAT "%2.0" ECU_ADDRESS 0xFFF908E8 /end MEASUREMENT
/begin MEASUREMENT T_RUNTIME_SIGNALPOOL "" UWORD _CNV_R_R_Umr_1_zu_1_132_CM_S2 1 0 0 65535 FORMAT "%2.0" ECU_ADDRESS 0xFFF908EA /end MEASUREMENT
/begin MEASUREMENT T_RUNTIME_STEPTRONIC "" UWORD _CNV_R_R_Umr_1_zu_1_132_CM_S2 1 0 0 65535 FORMAT "%2.0" ECU_ADDRESS 0xFFF908EC /end MEASUREMENT
/begin MEASUREMENT T_RUNTIME_ZKA "" UWORD _CNV_R_R_Umr_1_zu_1_132_CM_S2 1 0 0 65535 FORMAT "%2.0" ECU_ADDRESS 0xFFF908EE /end MEASUREMENT
/begin MEASUREMENT A_Q_KURVE_ALT "" SWORD _CNV_R_R_Umr_10_zu__46_CM_S2 1 0 -3276.8 3276.7 FORMAT "%3.1" ECU_ADDRESS 0xFFF9108C /end MEASUREMENT
/begin MEASUREMENT CONTROL_GV "" UWORD _CNV_S_3_Enum_EGV_255_CM_S2 1 0 0 2 ECU_ADDRESS 0xFFF90B14 /end MEASUREMENT
/begin MEASUREMENT C_AKTINDEX_MOTFWFILT "" UBYTE _CNV_R_R_Umr_1_zu_1_2_CM_S2 1 0 0 8 FORMAT "%2.0" ECU_ADDRESS 0xFFF91633 /end MEASUREMENT
/begin MEASUREMENT C_DECR_HHKOR_DYNHSPV "" UBYTE _CNV_R_R_Umr_1_zu_1_2_CM_S2 1 0 0 10 FORMAT "%2.0" ECU_ADDRESS 0xFFF91674 /end MEASUREMENT
/begin MEASUREMENT C_INSERT_NTBUFFER "" UBYTE _CNV_R_R_Umr_1_zu_1_2_CM_S2 1 0 0 255 FORMAT "%2.0" ECU_ADDRESS 0xFFF91630 /end MEASUREMENT
/begin MEASUREMENT C_NAVGRAPH_MAPDATA_ALT "" UBYTE _CNV_R_R_Umr_1_zu_1_2_CM_S2 1 0 0 255 FORMAT "%2.0" ECU_ADDRESS 0xFFF913F3 /end MEASUREMENT
/begin MEASUREMENT C_NAVGRAPH_SYNC_ALT "" UBYTE _CNV_R_R_Umr_1_zu_1_2_CM_S2 1 0 0 255 FORMAT "%2.0" ECU_ADDRESS 0xFFF913F4 /end MEASUREMENT
/begin MEASUREMENT C_QW_STEIGUNG "" UBYTE _CNV_R_R_Umr_1_zu_1_2_CM_S2 1 0 0 255 FORMAT "%2.0" ECU_ADDRESS 0xFFF9167F /end MEASUREMENT
/begin MEASUREMENT C_UPDATE_GN_MTTRAD "" UBYTE _CNV_R_R_Umr_1_zu_1_2_CM_S2 1 0 0 255 FORMAT "%2.0" ECU_ADDRESS 0xFFF91668 /end MEASUREMENT
/begin MEASUREMENT C_VALID_GNTMED "" UWORD _CNV_R_R_Umr_1_zu_1_2_CM_S2 1 0 0 65535 FORMAT "%2.0" ECU_ADDRESS 0xFFF9102C /end MEASUREMENT
/begin MEASUREMENT DN_MOT_HSZIEL_HKOR "" UWORD _CNV_R_R_Umr_1_zu_1_3_CM_S2 1 0 0 20000 FORMAT "%2.0" ECU_ADDRESS 0xFFF910D8 /end MEASUREMENT
/begin MEASUREMENT FAKT_DREHZAHLANGLEICH "" UWORD _CNV_R_R_Umr_100_zu_54_CM_S2 1 0 0 1 FORMAT "%4.2" ECU_ADDRESS 0xFFF90C1C /end MEASUREMENT
/begin MEASUREMENT FAKT_MMOTGEW_DYNKOR "" UBYTE _CNV_R_R_Umr_1_zu_1_53_CM_S2 1 0 0 100 FORMAT "%2.0" ECU_ADDRESS 0xFFF91638 /end MEASUREMENT
/begin MEASUREMENT FAKT_MMOTMIN_DYNKOR "" UBYTE _CNV_R_R_Umr_1_zu_1_53_CM_S2 1 0 0 100 FORMAT "%2.0" ECU_ADDRESS 0xFFF91639 /end MEASUREMENT
/begin MEASUREMENT FAKT_MMOT_DYNKOR "" UBYTE _CNV_R_R_Umr_1_zu_1_53_CM_S2 1 0 0 100 FORMAT "%2.0" ECU_ADDRESS 0xFFF9163A /end MEASUREMENT
/begin MEASUREMENT FUNKINIT_DONE_DYNHSPV "" UBYTE _CNV_P_2_A_I_5_CM_S2 1 0 0 255 ECU_ADDRESS 0xFFF91669 /end MEASUREMENT
/begin MEASUREMENT FUNKINIT_DONE_GNTMED "" UBYTE _CNV_P_2_A_I_5_CM_S2 1 0 0 255 ECU_ADDRESS 0xFFF91631 /end MEASUREMENT
/begin MEASUREMENT FUNKINIT_DONE_HKOR "" UBYTE _CNV_R_R_Umr_1_zu_1_2_CM_S2 1 0 0 255 FORMAT "%2.0" ECU_ADDRESS 0xFFF91634 /end MEASUREMENT
/begin MEASUREMENT FUNKINIT_DONE_MMOTFWFILT "" UBYTE _CNV_R_R_Umr_1_zu_1_2_CM_S2 1 0 0 1 FORMAT "%2.0" ECU_ADDRESS 0xFFF91635 /end MEASUREMENT
/begin MEASUREMENT FUNKINIT_DONE_SIGNALPOOL "" UBYTE _CNV_R_R_Umr_1_zu_1_2_CM_S2 1 0 0 255 FORMAT "%2.0" ECU_ADDRESS 0xFFF915D6 /end MEASUREMENT
/begin MEASUREMENT FUNKINIT_DONE_VFZG "" UBYTE _CNV_R_R_Umr_1_zu_1_2_CM_S2 1 0 0 255 FORMAT "%2.0" ECU_ADDRESS 0xFFF915D7 /end MEASUREMENT
/begin MEASUREMENT FUNKINIT_DONE_VMMOTFILT "" UBYTE _CNV_R_R_Umr_1_zu_1_2_CM_S2 1 0 0 1 FORMAT "%2.0" ECU_ADDRESS 0xFFF91636 /end MEASUREMENT
/begin MEASUREMENT G2W_AB_DYNHSPV "" SWORD _CNV_R_R_Umr_10_zu__181_CM_S2 1 0 -3276.8 3276.7 FORMAT "%3.1" ECU_ADDRESS 0xFFF910AC /end MEASUREMENT
/begin MEASUREMENT G2W_AB_REFDYNHSPV "" SWORD _CNV_R_R_Umr_10_zu__181_CM_S2 1 0 -3276.8 3276.7 FORMAT "%3.1" ECU_ADDRESS 0xFFF910AE /end MEASUREMENT
/begin MEASUREMENT GEW_NTNAB_SCHALT_DYNHSPV "" UWORD _CNV_R_R_Umr_1_zu_1_2_CM_S2 1 0 0 1000 FORMAT "%2.0" ECU_ADDRESS 0xFFF910B0 /end MEASUREMENT
/begin MEASUREMENT GEW_N_MOTTUR_DYNHSPV "" UBYTE _CNV_R_R_Umr_1_zu_1_53_CM_S2 1 0 0 250 FORMAT "%4.2" ECU_ADDRESS 0xFFF9166A /end MEASUREMENT
/begin MEASUREMENT GEW_N_TURRAD_DYNHSPV "" UBYTE _CNV_R_R_Umr_1_zu_1_53_CM_S2 1 0 0 250 FORMAT "%4.2" ECU_ADDRESS 0xFFF9166B /end MEASUREMENT
/begin MEASUREMENT GM_BR_SOLL "" SWORD _CNV_R_R_Umr_1_zu_1_199_CM_S2 1 0 -32768 32767 FORMAT "%2.0" ECU_ADDRESS 0xFFF90EEE /end MEASUREMENT
/begin MEASUREMENT GM_BR_SOLL_FILT "" SWORD _CNV_R_R_Umr_1_zu_1_199_CM_S2 1 0 -32768 32767 FORMAT "%2.0" ECU_ADDRESS 0xFFF90EF0 /end MEASUREMENT
/begin MEASUREMENT GM_BR_SOLL_FILTREST "" SWORD _CNV_R_R_Umr_1_zu_1_199_CM_S2 1 0 -32768 32767 FORMAT "%2.0" ECU_ADDRESS 0xFFF90EF2 /end MEASUREMENT
/begin MEASUREMENT GM_MOT_FW_FILT "" SWORD _CNV_R_R_Umr_1_zu_1_199_CM_S2 1 0 -32768 32767 FORMAT "%2.0" ECU_ADDRESS 0xFFF9105E /end MEASUREMENT
/begin MEASUREMENT GM_MOT_FW_FILTMAX "" SWORD _CNV_R_R_Umr_1_zu_1_199_CM_S2 1 0 -32768 32767 FORMAT "%2.0" ECU_ADDRESS 0xFFF91060 /end MEASUREMENT
/begin MEASUREMENT GM_RAD_RSU "" SLONG _CNV_R_R_Umr_1_zu_1_199_CM_S2 1 0 -1000000 1000000 FORMAT "%2.0" ECU_ADDRESS 0xFFF906A4 /end MEASUREMENT
/begin MEASUREMENT GN_MT "" SWORD _CNV_R_R_Umr_100_zu_254_CM_S2 1 0 -327.68 327.67 FORMAT "%4.2" ECU_ADDRESS 0xFFF910B2 /end MEASUREMENT
/begin MEASUREMENT GN_MTTRAD "" SWORD _CNV_R_R_Umr_100_zu_254_CM_S2 1 0 -327.68 327.67 FORMAT "%4.2" ECU_ADDRESS 0xFFF910B4 /end MEASUREMENT
/begin MEASUREMENT GN_MTTRAD_FILT "" SWORD _CNV_R_R_Umr_100_zu_254_CM_S2 1 0 -327.68 327.67 FORMAT "%4.2" ECU_ADDRESS 0xFFF910B6 /end MEASUREMENT
/begin MEASUREMENT GN_MTTRAD_FILT1 "" SWORD _CNV_R_R_Umr_100_zu_254_CM_S2 1 0 -327.68 327.67 FORMAT "%4.2" ECU_ADDRESS 0xFFF910B8 /end MEASUREMENT
/begin MEASUREMENT GN_MTTRAD_FILT2 "" SWORD _CNV_R_R_Umr_100_zu_254_CM_S2 1 0 -327.68 327.67 FORMAT "%4.2" ECU_ADDRESS 0xFFF910BA /end MEASUREMENT
/begin MEASUREMENT GN_MTTRAD_FILTKOR "" SWORD _CNV_R_R_Umr_100_zu_254_CM_S2 1 0 -327.68 327.67 FORMAT "%4.2" ECU_ADDRESS 0xFFF910BC /end MEASUREMENT
/begin MEASUREMENT GN_MTTRAD_PT1TRAEG "" UBYTE _CNV_R_R_Umr_100_zu_54_CM_S2 1 0 0 2 FORMAT "%4.2" ECU_ADDRESS 0xFFF9166C /end MEASUREMENT
/begin MEASUREMENT GN_MTTRAD_PT1VERST "" UBYTE _CNV_R_R_Umr_100_zu_54_CM_S2 1 0 0 2 FORMAT "%4.2" ECU_ADDRESS 0xFFF9166D /end MEASUREMENT
/begin MEASUREMENT GN_T "" SWORD _CNV_R_R_Umr_100_zu_254_CM_S2 1 0 -327.68 327.67 FORMAT "%4.2" ECU_ADDRESS 0xFFF9102E /end MEASUREMENT
/begin MEASUREMENT GN_TNAB "" SWORD _CNV_R_R_Umr_100_zu_254_CM_S2 1 0 -327.68 327.67 FORMAT "%4.2" ECU_ADDRESS 0xFFF910BE /end MEASUREMENT
/begin MEASUREMENT GN_TRAD "" SWORD _CNV_R_R_Umr_100_zu_254_CM_S2 1 0 -327.68 327.67 FORMAT "%4.2" ECU_ADDRESS 0xFFF910C0 /end MEASUREMENT
/begin MEASUREMENT GN_T_FILT "" SWORD _CNV_R_R_Umr_100_zu_254_CM_S2 1 0 -327.68 327.67 FORMAT "%4.2" ECU_ADDRESS 0xFFF91030 /end MEASUREMENT
/begin MEASUREMENT GN_T_FILTREST "" SWORD _CNV_R_R_Umr_100_zu_54_CM_S2 1 0 -327.68 327.67 FORMAT "%4.2" ECU_ADDRESS 0xFFF91032 /end MEASUREMENT
/begin MEASUREMENT GN_T_MED "" SWORD _CNV_R_R_Umr_100_zu_254_CM_S2 1 0 -327.68 327.67 FORMAT "%4.2" ECU_ADDRESS 0xFFF91034 /end MEASUREMENT
/begin MEASUREMENT GN_T_MEDBUFFER "" SWORD _CNV_R_R_Umr_100_zu_254_CM_S2 1 0 -327.68 327.67 FORMAT "%4.2" ARRAY_SIZE 17 ECU_ADDRESS 0xFFF91036 MATRIX_DIM 17 1 1 /end MEASUREMENT
/begin MEASUREMENT IG_GANG "" UWORD _CNV_R_R_Umr_1000_z_57_CM_S2 1 0 0 20 FORMAT "%5.3" ARRAY_SIZE 9 ECU_ADDRESS 0xFFF90B16 MATRIX_DIM 9 1 1 /end MEASUREMENT
/begin MEASUREMENT IG_GANG_ZIELGANG_SAS "" UWORD _CNV_R_R_Umr_1000_z_57_CM_S2 1 0 0 65.535 FORMAT "%5.3" ECU_ADDRESS 0xFFF90B2E /end MEASUREMENT
/begin MEASUREMENT I_GANG_REAL "" UWORD _CNV_R_R_Umr_1000_z_57_CM_S2 1 0 0 20 FORMAT "%5.3" ECU_ADDRESS 0xFFF90C1E /end MEASUREMENT
/begin MEASUREMENT I_STRANG_NMOT_HSVIRT "" UWORD _CNV_R_R_Umr_80_zu__252_CM_S2 1 0 0.125 511 FORMAT "%4.2" ECU_ADDRESS 0xFFF910C2 /end MEASUREMENT
/begin MEASUREMENT M_BR_SOLL_BUFFER "" SWORD _CNV_R_R_Umr_1_zu_1_42_CM_S2 1 0 -32000 0 FORMAT "%2.0" ARRAY_SIZE 2 ECU_ADDRESS 0xFFF905AC MATRIX_DIM 2 1 1 /end MEASUREMENT
/begin MEASUREMENT M_BR_SOLL_FILT "" SWORD _CNV_R_R_Umr_1_zu_1_42_CM_S2 1 0 -32000 0 FORMAT "%2.0" ECU_ADDRESS 0xFFF90C20 /end MEASUREMENT
/begin MEASUREMENT M_BR_SOLL_FILTREST "" SWORD _CNV_R_R_Umr_1_zu_1_42_CM_S2 1 0 -32768 32767 FORMAT "%2.0" ECU_ADDRESS 0xFFF90C22 /end MEASUREMENT
/begin MEASUREMENT M_MOT_DMEE_FILT "" SWORD _CNV_R_R_Umr_1_zu_1_42_CM_S2 1 0 -8192 8192 FORMAT "%2.0" ECU_ADDRESS 0xFFF90C24 /end MEASUREMENT
/begin MEASUREMENT M_MOT_DMEE_FILTREST "" SWORD _CNV_R_R_Umr_1_zu_1_42_CM_S2 1 0 -8192 8192 FORMAT "%2.0" ECU_ADDRESS 0xFFF90C26 /end MEASUREMENT
/begin MEASUREMENT M_MOT_FW_FILT "" SWORD _CNV_R_R_Umr_1_zu_1_42_CM_S2 1 0 -8192 8192 FORMAT "%2.0" ECU_ADDRESS 0xFFF91062 /end MEASUREMENT
/begin MEASUREMENT M_MOT_FW_FILTALT "" SWORD _CNV_R_R_Umr_1_zu_1_42_CM_S2 1 0 -8192 8192 FORMAT "%2.0" ECU_ADDRESS 0xFFF91064 /end MEASUREMENT
/begin MEASUREMENT M_MOT_FW_FILTBUFFER "" SWORD _CNV_R_R_Umr_1_zu_1_42_CM_S2 1 0 -8192 8192 FORMAT "%2.0" ARRAY_SIZE 8 ECU_ADDRESS 0xFFF90714 MATRIX_DIM 8 1 1 /end MEASUREMENT
/begin MEASUREMENT M_MOT_FW_FILTREST "" SWORD _CNV_R_R_Umr_1_zu_1_42_CM_S2 1 0 -32768 32767 FORMAT "%2.0" ECU_ADDRESS 0xFFF91066 /end MEASUREMENT
/begin MEASUREMENT M_RAD_RSU "" SWORD _CNV_R_R_Umr_1_zu_1_42_CM_S2 1 0 -32000 32000 FORMAT "%2.0" ECU_ADDRESS 0xFFF9101C /end MEASUREMENT
/begin MEASUREMENT N_AB_ALT "" UWORD _CNV_R_R_Umr_1_zu_1_3_CM_S2 1 0 0 20000 FORMAT "%2.0" ECU_ADDRESS 0xFFF90C2E /end MEASUREMENT
/begin MEASUREMENT N_AB_UNFILT_ALT "" UWORD _CNV_R_R_Umr_1_zu_1_3_CM_S2 1 0 0 20000 FORMAT "%2.0" ECU_ADDRESS 0xFFF90C30 /end MEASUREMENT
/begin MEASUREMENT N_GETR_EINGANG_ZIEL_1RS "" UWORD _CNV_R_R_Umr_1_zu_1_3_CM_S2 1 0 0 65535 FORMAT "%2.0" ECU_ADDRESS 0xFFF90C28 /end MEASUREMENT
/begin MEASUREMENT N_GE_NAB_ZIELGANG "" UWORD _CNV_R_R_Umr_1_zu_1_3_CM_S2 1 0 0 10000 FORMAT "%2.0" ECU_ADDRESS 0xFFF91068 /end MEASUREMENT
/begin MEASUREMENT N_MOT_ALT "" UWORD _CNV_R_R_Umr_1_zu_1_3_CM_S2 1 0 0 20000 FORMAT "%2.0" ECU_ADDRESS 0xFFF90C32 /end MEASUREMENT
/begin MEASUREMENT N_MOT_DYNHSPV "" UWORD _CNV_R_R_Umr_1_zu_1_3_CM_S2 1 0 0 65535 FORMAT "%2.0" ECU_ADDRESS 0xFFF910C4 /end MEASUREMENT
/begin MEASUREMENT N_MOT_DYNHSPV_OffSET "" UWORD _CNV_R_R_Umr_1_zu_1_3_CM_S2 1 0 0 65535 FORMAT "%2.0" ECU_ADDRESS 0xFFF910C6 /end MEASUREMENT
/begin MEASUREMENT N_MOT_HSVIRT "" UWORD _CNV_R_R_Umr_1_zu_1_3_CM_S2 1 0 0 20000 FORMAT "%2.0" ECU_ADDRESS 0xFFF910C8 /end MEASUREMENT
/begin MEASUREMENT N_MOT_HSVIRT_DYN "" SLONG _CNV_R_R_Umr_1_zu_1_3_CM_S2 1 0 -2147483648 2147483647 FORMAT "%2.0" ECU_ADDRESS 0xFFF907A8 /end MEASUREMENT
/begin MEASUREMENT N_MOT_HSVIRT_STAT "" UWORD _CNV_R_R_Umr_1_zu_1_3_CM_S2 1 0 0 20000 FORMAT "%2.0" ECU_ADDRESS 0xFFF910CA /end MEASUREMENT
/begin MEASUREMENT N_MOT_HSZIEL "" UWORD _CNV_R_R_Umr_1_zu_1_3_CM_S2 1 0 0 20000 FORMAT "%2.0" ECU_ADDRESS 0xFFF910DA /end MEASUREMENT
/begin MEASUREMENT N_MOT_HSZIELKD "" UWORD _CNV_R_R_Umr_1_zu_1_3_CM_S2 1 0 0 20000 FORMAT "%2.0" ECU_ADDRESS 0xFFF910DC /end MEASUREMENT
/begin MEASUREMENT N_MOT_RSZIEL "" UWORD _CNV_R_R_Umr_1_zu_1_3_CM_S2 1 0 0 20000 FORMAT "%2.0" ECU_ADDRESS 0xFFF910DE /end MEASUREMENT
/begin MEASUREMENT N_MOT_RSZIELKD "" UWORD _CNV_R_R_Umr_1_zu_1_3_CM_S2 1 0 0 20000 FORMAT "%2.0" ECU_ADDRESS 0xFFF910E0 /end MEASUREMENT
/begin MEASUREMENT N_MT "" UWORD _CNV_R_R_Umr_1_zu_1_3_CM_S2 1 0 0 20000 FORMAT "%2.0" ECU_ADDRESS 0xFFF910CC /end MEASUREMENT
/begin MEASUREMENT N_MT_ALT "" UWORD _CNV_R_R_Umr_1_zu_1_3_CM_S2 1 0 0 20000 FORMAT "%2.0" ECU_ADDRESS 0xFFF910CE /end MEASUREMENT
/begin MEASUREMENT N_TRAD "" UWORD _CNV_R_R_Umr_1_zu_1_3_CM_S2 1 0 0 20000 FORMAT "%2.0" ECU_ADDRESS 0xFFF90F0E /end MEASUREMENT
/begin MEASUREMENT N_TRAD_ALT "" UWORD _CNV_R_R_Umr_1_zu_1_3_CM_S2 1 0 0 20000 FORMAT "%2.0" ECU_ADDRESS 0xFFF910D0 /end MEASUREMENT
/begin MEASUREMENT N_T_BUFFER "" UWORD _CNV_R_R_Umr_1_zu_1_3_CM_S2 1 0 0 20000 FORMAT "%2.0" ARRAY_SIZE 16 ECU_ADDRESS 0xFFF906B0 MATRIX_DIM 16 1 1 /end MEASUREMENT
/begin MEASUREMENT SCHN_MOT_HSZIEL_HKOR_ENBL "" UWORD _CNV_R_R_Umr_1_zu_1_3_CM_S2 1 0 0 20000 FORMAT "%2.0" ECU_ADDRESS 0xFFF910E2 /end MEASUREMENT
/begin MEASUREMENT S_AGS_INIT "" UBYTE _CNV_R_R_Umr_1_zu_1_2_CM_S2 1 0 0 2 FORMAT "%2.0" ECU_ADDRESS 0xFFF9167C /end MEASUREMENT
/begin MEASUREMENT S_BCA_FAS "" UBYTE _CNV_P_2_A_I_5_CM_S2 1 0 0 255 ECU_ADDRESS 0xFFF915DB /end MEASUREMENT
/begin MEASUREMENT S_B_ALT "" UBYTE _CNV_S_3_Enum_EB_ST_256_CM_S2 1 0 0 2 ECU_ADDRESS 0xFFF913F5 /end MEASUREMENT
/begin MEASUREMENT S_B_BCA "" UBYTE _CNV_P_2_A_I_5_CM_S2 1 0 0 1 ECU_ADDRESS 0xFFF915DC /end MEASUREMENT
/begin MEASUREMENT S_B_BCAALT "" UBYTE _CNV_P_2_A_I_5_CM_S2 1 0 0 255 ECU_ADDRESS 0xFFF913F6 /end MEASUREMENT
/begin MEASUREMENT S_B_LDM "" UBYTE _CNV_P_2_A_I_5_CM_S2 1 0 0 255 ECU_ADDRESS 0xFFF91654 /end MEASUREMENT
/begin MEASUREMENT S_COD_COS_VERBOT "" UBYTE _CNV_S_2_Schalter_A_4_CM_S2 1 0 0 1 ECU_ADDRESS 0xFFF915E2 /end MEASUREMENT
/begin MEASUREMENT S_COD_GETRTYP "" UBYTE _CNV_S_2_Enum_ECOD__23_CM_S2 1 0 0 1 ECU_ADDRESS 0xFFF915E3 /end MEASUREMENT
/begin MEASUREMENT S_COD_MAB "" UBYTE _CNV_R_R_Umr_1_zu_1_2_CM_S2 1 0 0 1 FORMAT "%2.0" ECU_ADDRESS 0xFFF915E4 /end MEASUREMENT
/begin MEASUREMENT S_COD_STOPGO "" UBYTE _CNV_S_2_Schalter_A_4_CM_S2 1 0 0 1 ECU_ADDRESS 0xFFF915E6 /end MEASUREMENT
/begin MEASUREMENT S_FESTBREMS "" UBYTE _CNV_P_2_A_I_5_CM_S2 1 0 0 255 ECU_ADDRESS 0xFFF915DD /end MEASUREMENT
/begin MEASUREMENT S_GN_MT_FREEZE "" UBYTE _CNV_R_R_Umr_1_zu_1_2_CM_S2 1 0 0 255 ECU_ADDRESS 0xFFF9166E /end MEASUREMENT
/begin MEASUREMENT S_GN_TRAD_FREEZE "" UBYTE _CNV_R_R_Umr_1_zu_1_2_CM_S2 1 0 0 255 ECU_ADDRESS 0xFFF9166F /end MEASUREMENT
/begin MEASUREMENT S_HKOR_AKTIV "" UBYTE _CNV_R_R_Umr_1_zu_1_2_CM_S2 1 0 0 1 FORMAT "%2.0" ECU_ADDRESS 0xFFF91637 /end MEASUREMENT
/begin MEASUREMENT S_HSZEIT_START "" UBYTE _CNV_R_R_Umr_1_zu_1_2_CM_S2 1 0 0 1 FORMAT "%2.0" ECU_ADDRESS 0xFFF91670 /end MEASUREMENT
/begin MEASUREMENT S_HSZIEL_FLM "" UBYTE _CNV_R_R_Umr_1_zu_1_2_CM_S2 1 0 0 1 FORMAT "%2.0" ECU_ADDRESS 0xFFF91671 /end MEASUREMENT
/begin MEASUREMENT S_HYS_EIN_TRAKTION "" UBYTE _CNV_R_R_Umr_1_zu_1_2_CM_S2 1 0 0 1 FORMAT "%2.0" ECU_ADDRESS 0xFFF915EB /end MEASUREMENT
/begin MEASUREMENT S_KD_ALT "" UBYTE _CNV_R_R_Umr_1_zu_1_2_CM_S2 1 0 0 1 FORMAT "%2.0" ECU_ADDRESS 0xFFF913F7 /end MEASUREMENT
/begin MEASUREMENT S_MINUS_ALT "" UBYTE _CNV_R_R_Umr_1_zu_1_2_CM_S2 1 0 0 1 FORMAT "%2.0" ECU_ADDRESS 0xFFF913F8 /end MEASUREMENT
/begin MEASUREMENT S_MINUS_PADDLE_ALT "" UBYTE _CNV_P_2_A_I_5_CM_S2 1 0 0 255 ECU_ADDRESS 0xFFF913F9 /end MEASUREMENT
/begin MEASUREMENT S_MINUS_PADDLE_EFAHREN_ALT "" UBYTE _CNV_R_R_Umr_1_zu_1_2_CM_S2 1 0 0 1 FORMAT "%2.0" ECU_ADDRESS 0xFFF91686 /end MEASUREMENT
/begin MEASUREMENT S_NSC_REQ_ALT "" UBYTE _CNV_S_2_Schalter_A_4_CM_S2 1 0 0 1 ECU_ADDRESS 0xFFF913FA /end MEASUREMENT
/begin MEASUREMENT S_PLUS_ALT "" UBYTE _CNV_R_R_Umr_1_zu_1_2_CM_S2 1 0 0 1 FORMAT "%2.0" ECU_ADDRESS 0xFFF913FB /end MEASUREMENT
/begin MEASUREMENT S_PLUS_PADDLE_ALT "" UBYTE _CNV_P_2_A_I_5_CM_S2 1 0 0 255 ECU_ADDRESS 0xFFF913FC /end MEASUREMENT
/begin MEASUREMENT S_PLUS_PADDLE_EFAHREN_ALT "" UBYTE _CNV_R_R_Umr_1_zu_1_2_CM_S2 1 0 0 1 FORMAT "%2.0" ECU_ADDRESS 0xFFF91687 /end MEASUREMENT
/begin MEASUREMENT S_REG_HSEARLIERLATERDSC "" UBYTE _CNV_P_2_A_I_5_CM_S2 1 0 0 255 ECU_ADDRESS 0xFFF91632 /end MEASUREMENT
/begin MEASUREMENT S_REKUPRS "" UBYTE _CNV_P_2_A_I_5_CM_S2 1 0 0 255 ECU_ADDRESS 0xFFF9167B /end MEASUREMENT
/begin MEASUREMENT S_ROLLE "" UBYTE _CNV_P_2_A_I_5_CM_S2 1 0 0 255 ECU_ADDRESS 0xFFF91682 /end MEASUREMENT
/begin MEASUREMENT S_START_CRUISE "" UBYTE _CNV_P_2_A_I_5_CM_S2 1 0 0 255 ECU_ADDRESS 0xFFF9131C /end MEASUREMENT
/begin MEASUREMENT S_START_CRUISE_ALT "" UBYTE _CNV_P_2_A_I_5_CM_S2 1 0 0 255 ECU_ADDRESS 0xFFF913FD /end MEASUREMENT
/begin MEASUREMENT S_START_POS "" UBYTE _CNV_R_R_Umr_1_zu_1_2_CM_S2 1 0 0 1 FORMAT "%2.0" ECU_ADDRESS 0xFFF913EC /end MEASUREMENT
/begin MEASUREMENT S_START_POS_ALT "" UBYTE _CNV_R_R_Umr_1_zu_1_2_CM_S2 1 0 0 1 FORMAT "%2.0" ECU_ADDRESS 0xFFF913FE /end MEASUREMENT
/begin MEASUREMENT S_STAT_SPORT "" UBYTE _CNV_S_2_Enum_ESPOR_253_CM_S2 1 0 0 1 ECU_ADDRESS 0xFFF915E7 /end MEASUREMENT
/begin MEASUREMENT S_TID_EFAHREN_ERK_ALT "" UBYTE _CNV_R_R_Umr_1_zu_1_2_CM_S2 1 0 0 1 FORMAT "%2.0" ECU_ADDRESS 0xFFF9140F /end MEASUREMENT
/begin MEASUREMENT S_TID_EFAHREN_ZUSTART "" UBYTE _CNV_R_R_Umr_1_zu_1_2_CM_S2 1 0 0 1 FORMAT "%2.0" ECU_ADDRESS 0xFFF91688 /end MEASUREMENT
/begin MEASUREMENT S_TRPMOD_ERK "" UBYTE _CNV_R_R_Umr_1_zu_1_2_CM_S2 1 0 0 1 FORMAT "%2.0" ECU_ADDRESS 0xFFF913ED /end MEASUREMENT
/begin MEASUREMENT S_TRPMOD_FFG "" UBYTE _CNV_R_R_Umr_1_zu_1_2_CM_S2 1 0 0 1 FORMAT "%2.0" ECU_ADDRESS 0xFFF913EE /end MEASUREMENT
/begin MEASUREMENT S_UPDATE_GN_MTTRAD "" UBYTE _CNV_P_2_A_I_5_CM_S2 1 0 0 1 ECU_ADDRESS 0xFFF91672 /end MEASUREMENT
/begin MEASUREMENT S_VALID_BER_DYNKOR "" UBYTE _CNV_R_R_Umr_1_zu_1_2_CM_S2 1 0 0 1 FORMAT "%2.0" ECU_ADDRESS 0xFFF9163C /end MEASUREMENT
/begin MEASUREMENT S_VALID_GNTMED "" UWORD _CNV_P_2_A_I_68_CM_S2 1 0 0 65535 ECU_ADDRESS 0xFFF9102A /end MEASUREMENT
/begin MEASUREMENT S_VFZG_PLAUSI_ALT "" UBYTE _CNV_S_2_Schalter_A_4_CM_S2 1 0 0 1 ECU_ADDRESS 0xFFF913FF /end MEASUREMENT
/begin MEASUREMENT S_ZUG_ERK "" UBYTE _CNV_R_R_Umr_1_zu_1_2_CM_S2 1 0 0 1 FORMAT "%2.0" ECU_ADDRESS 0xFFF913EF /end MEASUREMENT
/begin MEASUREMENT S_ZUG_ERK_ALT "" UBYTE _CNV_R_R_Umr_1_zu_1_2_CM_S2 1 0 0 1 FORMAT "%2.0" ECU_ADDRESS 0xFFF91400 /end MEASUREMENT
/begin MEASUREMENT T_BUFFER "" ULONG _CNV_R_R_Umr_1_zu_1_6_CM_S2 1 0 0 4294967295 FORMAT "%2.0" ARRAY_SIZE 16 ECU_ADDRESS 0xFFF906D0 MATRIX_DIM 16 1 1 /end MEASUREMENT
/begin MEASUREMENT T_BUFFER_GM_BR[0] "" ULONG _CNV_R_R_Umr_1_zu_1_6_CM_S2 1 0 0 4294967295 FORMAT "%2.0" ECU_ADDRESS 0xFFF905B0 /end MEASUREMENT
/begin MEASUREMENT T_BUFFER_GM_BR[1] "" ULONG _CNV_R_R_Umr_1_zu_1_6_CM_S2 1 0 0 4294967295 FORMAT "%2.0" ECU_ADDRESS 0xFFF905B4 /end MEASUREMENT
/begin MEASUREMENT T_BUFFER_STARTLM "" ULONG _CNV_R_R_Umr_1_zu_1_6_CM_S2 1 0 0 4294967295 FORMAT "%2.0" ECU_ADDRESS 0xFFF902E8 /end MEASUREMENT
/begin MEASUREMENT T_GN_MTALT "" ULONG _CNV_R_R_Umr_1_zu_1_6_CM_S2 1 0 0 4294967295 FORMAT "%2.0" ECU_ADDRESS 0xFFF907AC /end MEASUREMENT
/begin MEASUREMENT T_GN_TRADALT "" ULONG _CNV_R_R_Umr_1_zu_1_6_CM_S2 1 0 0 4294967295 FORMAT "%2.0" ECU_ADDRESS 0xFFF907B0 /end MEASUREMENT
/begin MEASUREMENT T_HSZEIT_ALT "" UWORD _CNV_R_R_Umr_1_zu_1_6_CM_S2 1 0 0 5000 FORMAT "%2.0" ECU_ADDRESS 0xFFF90C34 /end MEASUREMENT
/begin MEASUREMENT T_HSZEIT_KOR "" UWORD _CNV_R_R_Umr_1_zu_1_6_CM_S2 1 0 0 65535 FORMAT "%2.0" ECU_ADDRESS 0xFFF910D2 /end MEASUREMENT
/begin MEASUREMENT T_HSZEIT_MAX "" UWORD _CNV_R_R_Umr_1_zu_1_6_CM_S2 1 0 0 65535 FORMAT "%2.0" ECU_ADDRESS 0xFFF910D4 /end MEASUREMENT
/begin MEASUREMENT T_HSZEIT_START "" UWORD _CNV_R_R_Umr_1_zu_1_6_CM_S2 1 0 0 5000 FORMAT "%2.0" ECU_ADDRESS 0xFFF910D6 /end MEASUREMENT
/begin MEASUREMENT T_LAYERIN_MSCTR_ALT "" ULONG _CNV_R_R_Umr_1_zu_1_6_CM_S2 1 0 0 4294967295 FORMAT "%2.0" ECU_ADDRESS 0xFFF901C4 /end MEASUREMENT
/begin MEASUREMENT T_STARTLM "" SLONG _CNV_R_R_Umr_1_zu_1_6_CM_S2 1 0 -2147483647 2147483647 FORMAT "%2.0" ECU_ADDRESS 0xFFF902EC /end MEASUREMENT
/begin MEASUREMENT T_VM_MOT_ISTFW "" SWORD _CNV_R_R_Umr_1_zu_1_6_CM_S2 1 0 0 2500 FORMAT "%2.0" ECU_ADDRESS 0xFFF9106A /end MEASUREMENT
/begin MEASUREMENT VM_MOT_HKOR "" UWORD _CNV_R_R_Umr_1_zu_1_53_CM_S2 1 0 0 200 FORMAT "%2.0" ECU_ADDRESS 0xFFF9106C /end MEASUREMENT
/begin MEASUREMENT VM_MOT_HKORROH "" UWORD _CNV_R_R_Umr_1_zu_1_53_CM_S2 1 0 0 200 FORMAT "%2.0" ECU_ADDRESS 0xFFF9106E /end MEASUREMENT
/begin MEASUREMENT VM_MOT_HKOR_FILTREST "" UWORD _CNV_R_R_Umr_1_zu_1_53_CM_S2 1 0 0 65535 FORMAT "%2.0" ECU_ADDRESS 0xFFF91070 /end MEASUREMENT
/begin MEASUREMENT VM_MOT_ISTFW "" UWORD _CNV_R_R_Umr_100_zu_104_CM_S2 1 0 0 3 FORMAT "%4.2" ECU_ADDRESS 0xFFF91072 /end MEASUREMENT
/begin MEASUREMENT VM_MOT_ISTFW_FILT "" UWORD _CNV_R_R_Umr_100_zu_104_CM_S2 1 0 0 3 FORMAT "%4.2" ECU_ADDRESS 0xFFF91074 /end MEASUREMENT
/begin MEASUREMENT VM_MOT_ISTFW_FILTREST "" UWORD _CNV_R_R_Umr_1_zu_1_2_CM_S2 1 0 0 65535 FORMAT "%2.0" ECU_ADDRESS 0xFFF91076 /end MEASUREMENT
/begin MEASUREMENT VM_MOT_ISTFW_KOR "" UWORD _CNV_R_R_Umr_100_zu_104_CM_S2 1 0 0 2 FORMAT "%4.2" ECU_ADDRESS 0xFFF91078 /end MEASUREMENT
/begin MEASUREMENT W_DKKD_ALT "" UWORD _CNV_R_R_Umr_10_zu__9_CM_S2 1 0 0 110 FORMAT "%3.1" ECU_ADDRESS 0xFFF90C36 /end MEASUREMENT
/begin MEASUREMENT Z_ADAPT_REQ_ALT "" UBYTE _CNV_S_3_Enum_EREQA_118_CM_S2 1 0 0 2 ECU_ADDRESS 0xFFF91401 /end MEASUREMENT
/begin MEASUREMENT Z_AGS_MODBEDEL "" UBYTE _CNV_S_2_Enum_EAGS_25_CM_S2 1 0 0 1 ECU_ADDRESS 0xFFF9167D /end MEASUREMENT
/begin MEASUREMENT Z_AGS_MODBEDEL_ALT "" UBYTE _CNV_S_2_Enum_EAGS_25_CM_S2 1 0 0 1 ECU_ADDRESS 0xFFF91402 /end MEASUREMENT
/begin MEASUREMENT Z_B "" UBYTE _CNV_S_4_Enum_EB_257_CM_S2 1 0 0 3 ECU_ADDRESS 0xFFF915DE /end MEASUREMENT
/begin MEASUREMENT Z_BSMODE_ALT "" UBYTE _CNV_S_4_Enum_EBSMO_258_CM_S2 1 0 0 3 ECU_ADDRESS 0xFFF91403 /end MEASUREMENT
/begin MEASUREMENT Z_BSMODE_TRANS "" UBYTE _CNV_S_7_Enum_EBSMO_259_CM_S2 1 0 0 6 ECU_ADDRESS 0xFFF9131D /end MEASUREMENT
/begin MEASUREMENT Z_B_BCA "" UBYTE _CNV_S_4_Enum_EB_257_CM_S2 1 0 0 3 ECU_ADDRESS 0xFFF915DF /end MEASUREMENT
/begin MEASUREMENT Z_EFAHR_AUSSTIEG "" UBYTE _CNV_S_3_Enum_EEFAH_251_CM_S2 1 0 0 2 ECU_ADDRESS 0xFFF9152C /end MEASUREMENT
/begin MEASUREMENT Z_EXCFKT_FFG_ALT "" UBYTE _CNV_R_R_Umr_1_zu_1_2_CM_S2 1 0 0 1 FORMAT "%2.0" ECU_ADDRESS 0xFFF91404 /end MEASUREMENT
/begin MEASUREMENT Z_GANG_IST_ALT "" UBYTE _CNV_S_9_Enum_EGANG_30_CM_S2 1 0 0 8 ECU_ADDRESS 0xFFF91405 /end MEASUREMENT
/begin MEASUREMENT Z_GANG_MAX "" UBYTE _CNV_S_9_Enum_EGANG_30_CM_S2 1 0 0 8 ECU_ADDRESS 0xFFF9131E /end MEASUREMENT
/begin MEASUREMENT Z_GANG_MIN "" UBYTE _CNV_S_9_Enum_EGANG_30_CM_S2 1 0 0 8 ECU_ADDRESS 0xFFF9131F /end MEASUREMENT
/begin MEASUREMENT Z_GANG_SOLL_ALT "" UBYTE _CNV_S_9_Enum_EGANG_30_CM_S2 1 0 0 8 ECU_ADDRESS 0xFFF91406 /end MEASUREMENT
/begin MEASUREMENT Z_GANG_TGG_SOLLSTB_ALT "" UBYTE _CNV_S_9_Enum_EGANG_30_CM_S2 1 0 0 8 ECU_ADDRESS 0xFFF91407 /end MEASUREMENT
/begin MEASUREMENT Z_GANG_TGG_SOLLSTB_ALT2 "" UBYTE _CNV_S_9_Enum_EGANG_30_CM_S2 1 0 0 8 ECU_ADDRESS 0xFFF91408 /end MEASUREMENT
/begin MEASUREMENT Z_GANG_WK "" UBYTE _CNV_S_9_Enum_EGANG_30_CM_S2 1 0 0 8 ECU_ADDRESS 0xFFF913F2 /end MEASUREMENT
/begin MEASUREMENT Z_GANG_ZIELALT_DYNHSPV "" UBYTE _CNV_S_9_Enum_EGANG_30_CM_S2 1 0 0 8 ECU_ADDRESS 0xFFF91673 /end MEASUREMENT
/begin MEASUREMENT Z_GANG_ZIEL_ALT "" UBYTE _CNV_S_9_Enum_EGANG_30_CM_S2 1 0 0 8 ECU_ADDRESS 0xFFF91409 /end MEASUREMENT
/begin MEASUREMENT Z_GANG_ZIEL_SAS_ALT "" UBYTE _CNV_S_9_Enum_EGANG_30_CM_S2 1 0 0 8 ECU_ADDRESS 0xFFF9140A /end MEASUREMENT
/begin MEASUREMENT Z_HSUBEDALT "" UBYTE _CNV_S_8_Enum_EHSUB_119_CM_S2 1 0 0 7 ECU_ADDRESS 0xFFF9140B /end MEASUREMENT
/begin MEASUREMENT Z_POS_ALT "" UBYTE _CNV_S_8_Enum_EPOS_33_CM_S2 1 0 0 7 ECU_ADDRESS 0xFFF9140C /end MEASUREMENT
/begin MEASUREMENT Z_POS_ALT_ALT "" UBYTE _CNV_S_8_Enum_EPOS_33_CM_S2 1 0 0 7 ECU_ADDRESS 0xFFF9140D /end MEASUREMENT
/begin MEASUREMENT Z_PROG_MODEALT "" UBYTE _CNV_S_4_Enum_EPROG_35_CM_S2 1 0 0 3 ECU_ADDRESS 0xFFF9140E /end MEASUREMENT
/begin MEASUREMENT Z_SOFTWAREVERSION "" UWORD _CNV_R_R_Umr_100_zu_54_CM_S2 1 0 0 655.35 FORMAT "%4.2" ECU_ADDRESS 0xFFF90C2A /end MEASUREMENT
/begin MEASUREMENT Z_STARTLM_STATE "" UBYTE _CNV_S_7_Enum_ESTAR_260_CM_S2 1 0 0 6 ECU_ADDRESS 0xFFF91536 /end MEASUREMENT
/begin MEASUREMENT A_FZG_G2W_AB "" SWORD _CNV_R_R_Umr_10_zu__46_CM_S2 1 0 -20 20 FORMAT "%3.1" ECU_ADDRESS 0xFFF90EB6 /end MEASUREMENT
/begin MEASUREMENT A_L "" SWORD _CNV_R_R_Umr_10_zu__46_CM_S2 1 0 -3276.8 3276.7 FORMAT "%3.1" ECU_ADDRESS 0xFFF90EB8 /end MEASUREMENT
/begin MEASUREMENT A_L_75MS "" SWORD _CNV_R_R_Umr_10_zu__46_CM_S2 1 0 -3276.8 3276.7 FORMAT "%3.1" ECU_ADDRESS 0xFFF90EBA /end MEASUREMENT
/begin MEASUREMENT A_L_75MSFILT "" SWORD _CNV_R_R_Umr_10_zu__46_CM_S2 1 0 -3276.8 3276.7 FORMAT "%3.1" ECU_ADDRESS 0xFFF90EBC /end MEASUREMENT
/begin MEASUREMENT A_L_75MSFILTREST "" SWORD _CNV_R_R_Umr_10_zu__46_CM_S2 1 0 -3276.8 3276.7 FORMAT "%3.1" ECU_ADDRESS 0xFFF90EBE /end MEASUREMENT
/begin MEASUREMENT A_L_FILT "" SWORD _CNV_R_R_Umr_10_zu__46_CM_S2 1 0 -3276.8 3276.7 FORMAT "%3.1" ECU_ADDRESS 0xFFF90EC0 /end MEASUREMENT
/begin MEASUREMENT A_L_FILTREST "" SWORD _CNV_R_R_Umr_10_zu__46_CM_S2 1 0 -3276.8 3276.7 FORMAT "%3.1" ECU_ADDRESS 0xFFF90EC2 /end MEASUREMENT
/begin MEASUREMENT A_L_MUELOW_FILT "" SWORD _CNV_R_R_Umr_10_zu__46_CM_S2 1 0 -20 20 FORMAT "%3.1" ECU_ADDRESS 0xFFF90EC4 /end MEASUREMENT
/begin MEASUREMENT A_L_MUELOW_FILT1 "" SWORD _CNV_R_R_Umr_10_zu__46_CM_S2 1 0 -20 20 FORMAT "%3.1" ECU_ADDRESS 0xFFF90EC6 /end MEASUREMENT
/begin MEASUREMENT A_L_MUELOW_FILT2 "" SWORD _CNV_R_R_Umr_10_zu__46_CM_S2 1 0 -20 20 FORMAT "%3.1" ECU_ADDRESS 0xFFF90EC8 /end MEASUREMENT
/begin MEASUREMENT A_L_MUELOW_PT1TRAEG "" UBYTE _CNV_R_R_Umr_100_zu_54_CM_S2 1 0 0 2 FORMAT "%4.2" ECU_ADDRESS 0xFFF915D0 /end MEASUREMENT
/begin MEASUREMENT A_L_MUELOW_PT1VERST "" UBYTE _CNV_R_R_Umr_100_zu_54_CM_S2 1 0 0 2 FORMAT "%4.2" ECU_ADDRESS 0xFFF915D1 /end MEASUREMENT
/begin MEASUREMENT A_L_NF "" SWORD _CNV_R_R_Umr_10_zu__46_CM_S2 1 0 -3276.8 3276.7 FORMAT "%3.1" ECU_ADDRESS 0xFFF90ECA /end MEASUREMENT
/begin MEASUREMENT A_L_REFFILT "" SWORD _CNV_R_R_Umr_32_zu__202_CM_S2 1 0 -1024 1023.96875 FORMAT "%4.2" ECU_ADDRESS 0xFFF90ECC /end MEASUREMENT
/begin MEASUREMENT A_L_REFFILTREST "" SWORD _CNV_R_R_Umr_32_zu__202_CM_S2 1 0 -1024 1023.96875 FORMAT "%4.2" ECU_ADDRESS 0xFFF90ECE /end MEASUREMENT
/begin MEASUREMENT A_L_REFINT "" SWORD _CNV_R_R_Umr_10_zu__46_CM_S2 1 0 -3276.8 3276.7 FORMAT "%3.1" ECU_ADDRESS 0xFFF90ED0 /end MEASUREMENT
/begin MEASUREMENT A_MUELOW_FILT "" SWORD _CNV_R_R_Umr_10_zu__46_CM_S2 1 0 -20 20 FORMAT "%3.1" ECU_ADDRESS 0xFFF90ED2 /end MEASUREMENT
/begin MEASUREMENT A_MUELOW_NAEHERUNG "" UWORD _CNV_R_R_Umr_10_zu__46_CM_S2 1 0 0 20 FORMAT "%3.1" ECU_ADDRESS 0xFFF90ED4 /end MEASUREMENT
/begin MEASUREMENT A_MUELOW_RADIKANT "" UWORD _CNV_R_R_Umr_100_zu_264_CM_S2 1 0 0 655.35 FORMAT "%4.2" ECU_ADDRESS 0xFFF90ED6 /end MEASUREMENT
/begin MEASUREMENT A_Q "" SWORD _CNV_R_R_Umr_10_zu__46_CM_S2 1 0 -3276.8 3276.7 FORMAT "%3.1" ECU_ADDRESS 0xFFF90ED8 /end MEASUREMENT
/begin MEASUREMENT A_QGIER "" SWORD _CNV_R_R_Umr_10_zu__46_CM_S2 1 0 -3276.8 3276.7 FORMAT "%3.1" ECU_ADDRESS 0xFFF90EDA /end MEASUREMENT
/begin MEASUREMENT A_QGIER_FILT "" SWORD _CNV_R_R_Umr_10_zu__46_CM_S2 1 0 -3276.8 3276.7 FORMAT "%3.1" ECU_ADDRESS 0xFFF90EDC /end MEASUREMENT
/begin MEASUREMENT A_QGIER_FILTREST "" SWORD _CNV_R_R_Umr_10_zu__46_CM_S2 1 0 -3276.8 3276.7 FORMAT "%3.1" ECU_ADDRESS 0xFFF90EDE /end MEASUREMENT
/begin MEASUREMENT A_Q_FAKT "" ULONG _CNV_R_R_Umr_1_zu_1_2_CM_S2 1 0 0 4294967295 FORMAT "%2.0" ECU_ADDRESS 0xFFF905A8 /end MEASUREMENT
/begin MEASUREMENT A_Q_FILT "" SWORD _CNV_R_R_Umr_10_zu__46_CM_S2 1 0 -3276.8 3276.7 FORMAT "%3.1" ECU_ADDRESS 0xFFF90EE0 /end MEASUREMENT
/begin MEASUREMENT A_Q_FILTINT "" SWORD _CNV_R_R_Umr_10_zu__46_CM_S2 1 0 -3276.8 3276.7 FORMAT "%3.1" ECU_ADDRESS 0xFFF90EE2 /end MEASUREMENT
/begin MEASUREMENT A_Q_FILTINTREST "" SWORD _CNV_R_R_Umr_10_zu__46_CM_S2 1 0 -3276.8 3276.7 FORMAT "%3.1" ECU_ADDRESS 0xFFF90EE4 /end MEASUREMENT
/begin MEASUREMENT A_Q_MUELOW_FILT "" SWORD _CNV_R_R_Umr_10_zu__46_CM_S2 1 0 -20 20 FORMAT "%3.1" ECU_ADDRESS 0xFFF90EE6 /end MEASUREMENT
/begin MEASUREMENT A_Q_MUELOW_FILT1 "" SWORD _CNV_R_R_Umr_10_zu__46_CM_S2 1 0 -20 20 FORMAT "%3.1" ECU_ADDRESS 0xFFF90EE8 /end MEASUREMENT
/begin MEASUREMENT A_Q_MUELOW_FILT2 "" SWORD _CNV_R_R_Umr_10_zu__46_CM_S2 1 0 -20 20 FORMAT "%3.1" ECU_ADDRESS 0xFFF90EEA /end MEASUREMENT
/begin MEASUREMENT A_Q_MUELOW_PT1TRAEG "" UBYTE _CNV_R_R_Umr_100_zu_54_CM_S2 1 0 0 2 FORMAT "%4.2" ECU_ADDRESS 0xFFF915D2 /end MEASUREMENT
/begin MEASUREMENT A_Q_MUELOW_PT1VERST "" UBYTE _CNV_R_R_Umr_100_zu_54_CM_S2 1 0 0 2 FORMAT "%4.2" ECU_ADDRESS 0xFFF915D3 /end MEASUREMENT
/begin MEASUREMENT A_Q_REFINT "" SWORD _CNV_R_R_Umr_10_zu__46_CM_S2 1 0 -3276.8 3276.7 FORMAT "%3.1" ECU_ADDRESS 0xFFF90EEC /end MEASUREMENT
/begin MEASUREMENT A_RAD_VL "" SWORD _CNV_R_R_Umr_1_zu_1_265_CM_S2 1 0 -32768 32767 FORMAT "%3.1" ECU_ADDRESS 0xFFF90FBA /end MEASUREMENT
/begin MEASUREMENT A_RAD_VR "" SWORD _CNV_R_R_Umr_1_zu_1_265_CM_S2 1 0 -32768 32767 FORMAT "%3.1" ECU_ADDRESS 0xFFF90FBC /end MEASUREMENT
/begin MEASUREMENT C_FILT_MEDTASK "" UBYTE _CNV_R_R_Umr_1_zu_1_2_CM_S2 1 0 0 255 FORMAT "%2.0" ECU_ADDRESS 0xFFF9162C /end MEASUREMENT
/begin MEASUREMENT C_INSERT_G2WABBUFFER "" UBYTE _CNV_R_R_Umr_1_zu_1_2_CM_S2 1 0 0 255 FORMAT "%2.0" ECU_ADDRESS 0xFFF9162D /end MEASUREMENT
/begin MEASUREMENT C_INSERT_GWFPMAXBUFFER "" UBYTE _CNV_R_R_Umr_1_zu_1_2_CM_S2 1 0 0 255 FORMAT "%2.0" ECU_ADDRESS 0xFFF915F5 /end MEASUREMENT
/begin MEASUREMENT C_INSERT_MRADRSUBUFFER "" UBYTE _CNV_R_R_Umr_1_zu_1_2_CM_S2 1 0 0 255 FORMAT "%2.0" ECU_ADDRESS 0xFFF9162E /end MEASUREMENT
/begin MEASUREMENT C_INSERT_NABBUFFER "" UBYTE _CNV_R_R_Umr_1_zu_1_2_CM_S2 1 0 0 255 FORMAT "%2.0" ECU_ADDRESS 0xFFF9162F /end MEASUREMENT
/begin MEASUREMENT C_INSERT_TBUFFERSGG "" UBYTE _CNV_R_R_Umr_1_zu_1_2_CM_S2 1 0 0 255 FORMAT "%2.0" ECU_ADDRESS 0xFFF913EA /end MEASUREMENT
/begin MEASUREMENT C_INSERT_VFZGMSBUFFER "" UBYTE _CNV_R_R_Umr_1_zu_1_2_CM_S2 1 0 0 255 FORMAT "%2.0" ECU_ADDRESS 0xFFF915D4 /end MEASUREMENT
/begin MEASUREMENT C_INSERT_VRADRTKORBUFFER "" UBYTE _CNV_R_R_Umr_1_zu_1_2_CM_S2 1 0 0 255 FORMAT "%2.0" ECU_ADDRESS 0xFFF91627 /end MEASUREMENT
/begin MEASUREMENT DN_MOT_FILT "" SWORD _CNV_R_R_Umr_10_zu__181_CM_S2 1 0 -2000 2000 FORMAT "%3.1" ECU_ADDRESS 0xFFF91024 /end MEASUREMENT
/begin MEASUREMENT DN_MOT_FILTREST "" SWORD _CNV_R_R_Umr_10_zu__181_CM_S2 1 0 -3276.8 3276.7 FORMAT "%3.1" ECU_ADDRESS 0xFFF91026 /end MEASUREMENT
/begin MEASUREMENT DN_RAD_HA "" SWORD _CNV_R_R_Umr_1_zu_1_3_CM_S2 1 0 0 20000 FORMAT "%2.0" ECU_ADDRESS 0xFFF910E4 /end MEASUREMENT
/begin MEASUREMENT DN_RAD_HLVA "" SWORD _CNV_R_R_Umr_1_zu_1_3_CM_S2 1 0 0 20000 FORMAT "%2.0" ECU_ADDRESS 0xFFF910E6 /end MEASUREMENT
/begin MEASUREMENT DN_RAD_HRVA "" SWORD _CNV_R_R_Umr_1_zu_1_3_CM_S2 1 0 0 20000 FORMAT "%2.0" ECU_ADDRESS 0xFFF910E8 /end MEASUREMENT
/begin MEASUREMENT DN_RAD_VA "" SWORD _CNV_R_R_Umr_1_zu_1_3_CM_S2 1 0 0 20000 FORMAT "%2.0" ECU_ADDRESS 0xFFF910EA /end MEASUREMENT
/begin MEASUREMENT DN_RAD_VLHA "" SWORD _CNV_R_R_Umr_1_zu_1_3_CM_S2 1 0 0 20000 FORMAT "%2.0" ECU_ADDRESS 0xFFF910EC /end MEASUREMENT
/begin MEASUREMENT DN_RAD_VRHA "" SWORD _CNV_R_R_Umr_1_zu_1_3_CM_S2 1 0 0 20000 FORMAT "%2.0" ECU_ADDRESS 0xFFF910EE /end MEASUREMENT
/begin MEASUREMENT FAKTA_Q_NAB_KOR "" UBYTE _CNV_R_R_Umr_100_zu_54_CM_S2 1 0 0 1 FORMAT "%4.2" ECU_ADDRESS 0xFFF915D5 /end MEASUREMENT
/begin MEASUREMENT G2W_AB "" SWORD _CNV_R_R_Umr_10_zu__181_CM_S2 1 0 -3276.8 3276.7 FORMAT "%3.1" ECU_ADDRESS 0xFFF9100A /end MEASUREMENT
/begin MEASUREMENT G2W_AB_BUFFER "" SWORD _CNV_R_R_Umr_10_zu__181_CM_S2 1 0 -3276.8 3276.7 FORMAT "%3.1" ARRAY_SIZE 10 ECU_ADDRESS 0xFFF90664 MATRIX_DIM 10 1 1 /end MEASUREMENT
/begin MEASUREMENT G2W_AB_FILT "" SWORD _CNV_R_R_Umr_10_zu__181_CM_S2 1 0 -3276.8 3276.7 FORMAT "%3.1" ECU_ADDRESS 0xFFF9100C /end MEASUREMENT
/begin MEASUREMENT G2W_AB_FILTMARSREST "" SWORD _CNV_R_R_Umr_1_zu_1_2_CM_S2 1 0 -32767 32767 FORMAT "%2.0" ECU_ADDRESS 0xFFF9100E /end MEASUREMENT
/begin MEASUREMENT G2W_AB_FILTREST "" SWORD _CNV_R_R_Umr_1_zu_1_2_CM_S2 1 0 -32767 32767 FORMAT "%2.0" ECU_ADDRESS 0xFFF91010 /end MEASUREMENT
/begin MEASUREMENT G2W_AB_FILT_MARS "" SWORD _CNV_R_R_Umr_10_zu__181_CM_S2 1 0 -3276.8 3276.7 FORMAT "%3.1" ECU_ADDRESS 0xFFF91012 /end MEASUREMENT
/begin MEASUREMENT G2W_AB_FILT_MODWHYB "" SWORD _CNV_R_R_Umr_10_zu__181_CM_S2 1 0 -3276.8 3276.7 FORMAT "%3.1" ECU_ADDRESS 0xFFF91014 /end MEASUREMENT
/begin MEASUREMENT G2W_AB_FWSFILT "" SWORD _CNV_R_R_Umr_10_zu__181_CM_S2 1 0 -3276.8 3276.7 FORMAT "%3.1" ECU_ADDRESS 0xFFF91016 /end MEASUREMENT
/begin MEASUREMENT G2W_AB_FWSFILTREST "" SWORD _CNV_R_R_Umr_1_zu_1_2_CM_S2 1 0 -32767 32767 FORMAT "%2.0" ECU_ADDRESS 0xFFF91018 /end MEASUREMENT
/begin MEASUREMENT G2W_AB_MED "" SWORD _CNV_R_R_Umr_10_zu__181_CM_S2 1 0 -3276.8 3276.7 FORMAT "%3.1" ECU_ADDRESS 0xFFF9101A /end MEASUREMENT
/begin MEASUREMENT G2W_AB_SUMME "" SLONG _CNV_R_R_Umr_10_zu__181_CM_S2 1 0 -214748364.7 214748364.7 FORMAT "%3.1" ECU_ADDRESS 0xFFF906A0 /end MEASUREMENT
/begin MEASUREMENT GN_EM "" SWORD _CNV_R_R_Umr_10_zu__181_CM_S2 1 0 -2000 2000 FORMAT "%3.1" ECU_ADDRESS 0xFFF91022 /end MEASUREMENT
/begin MEASUREMENT GN_MOT "" SWORD _CNV_R_R_Umr_10_zu__181_CM_S2 1 0 -2000 2000 FORMAT "%3.1" ECU_ADDRESS 0xFFF91028 /end MEASUREMENT
/begin MEASUREMENT GN_VM "" SWORD _CNV_R_R_Umr_10_zu__181_CM_S2 1 0 -2000 2000 FORMAT "%3.1" ECU_ADDRESS 0xFFF91058 /end MEASUREMENT
/begin MEASUREMENT GWFP_MAX_HSURE "" SWORD _CNV_R_R_Umr_1_zu_1_7_CM_S2 1 0 -32768 32767 FORMAT "%2.0" ECU_ADDRESS 0xFFF90F10 /end MEASUREMENT
/begin MEASUREMENT GW_FP "" SWORD _CNV_R_R_Umr_1_zu_1_7_CM_S2 1 0 -32768 32767 FORMAT "%2.0" ECU_ADDRESS 0xFFF90F12 /end MEASUREMENT
/begin MEASUREMENT GW_FP_FILT "" SWORD _CNV_R_R_Umr_1_zu_1_7_CM_S2 1 0 -32768 32767 FORMAT "%2.0" ECU_ADDRESS 0xFFF90F14 /end MEASUREMENT
/begin MEASUREMENT GW_FP_FILTREST "" SWORD _CNV_R_R_Umr_1_zu_1_7_CM_S2 1 0 -32768 32767 FORMAT "%2.0" ECU_ADDRESS 0xFFF90F16 /end MEASUREMENT
/begin MEASUREMENT GW_FP_FILTREST_HSURE "" SWORD _CNV_R_R_Umr_1_zu_1_7_CM_S2 1 0 -32768 32767 FORMAT "%2.0" ECU_ADDRESS 0xFFF90F18 /end MEASUREMENT
/begin MEASUREMENT GW_FP_FILT_HSURE "" SWORD _CNV_R_R_Umr_1_zu_1_7_CM_S2 1 0 -32768 32767 FORMAT "%2.0" ECU_ADDRESS 0xFFF90F1A /end MEASUREMENT
/begin MEASUREMENT GW_FP_MAXBUFFER "" SWORD _CNV_R_R_Umr_1_zu_1_7_CM_S2 1 0 -32768 32767 FORMAT "%2.0" ARRAY_SIZE 10 ECU_ADDRESS 0xFFF905B8 MATRIX_DIM 10 1 1 /end MEASUREMENT
/begin MEASUREMENT GW_FP_MAXFILT "" SWORD _CNV_R_R_Umr_1_zu_1_7_CM_S2 1 0 -32768 32767 FORMAT "%2.0" ECU_ADDRESS 0xFFF90F1C /end MEASUREMENT
/begin MEASUREMENT MN_RAD_HA "" UWORD _CNV_R_R_Umr_1_zu_1_3_CM_S2 1 0 0 20000 FORMAT "%2.0" ECU_ADDRESS 0xFFF910F0 /end MEASUREMENT
/begin MEASUREMENT MN_RAD_VA "" UWORD _CNV_R_R_Umr_1_zu_1_3_CM_S2 1 0 0 20000 FORMAT "%2.0" ECU_ADDRESS 0xFFF910F2 /end MEASUREMENT
/begin MEASUREMENT M_RAD_RSU_BUFFER "" SWORD _CNV_R_R_Umr_1_zu_1_3_CM_S2 1 0 0 20000 FORMAT "%2.0" ARRAY_SIZE 10 ECU_ADDRESS 0xFFF90678 MATRIX_DIM 10 1 1 /end MEASUREMENT
/begin MEASUREMENT N_ABNA "" UWORD _CNV_R_R_Umr_1_zu_1_3_CM_S2 1 0 0 20000 FORMAT "%2.0" ECU_ADDRESS 0xFFF90EF4 /end MEASUREMENT
/begin MEASUREMENT N_ABRAD "" UWORD _CNV_R_R_Umr_1_zu_1_3_CM_S2 1 0 0 20000 FORMAT "%2.0" ECU_ADDRESS 0xFFF90EF6 /end MEASUREMENT
/begin MEASUREMENT N_AB_BUFFER "" UWORD _CNV_R_R_Umr_1_zu_1_3_CM_S2 1 0 0 20000 FORMAT "%2.0" ARRAY_SIZE 10 ECU_ADDRESS 0xFFF9068C MATRIX_DIM 10 1 1 /end MEASUREMENT
/begin MEASUREMENT N_AB_FILT "" UWORD _CNV_R_R_Umr_1_zu_1_3_CM_S2 1 0 0 20000 FORMAT "%2.0" ECU_ADDRESS 0xFFF9101E /end MEASUREMENT
/begin MEASUREMENT N_AB_FILTREST "" UWORD _CNV_R_R_Umr_1_zu_1_3_CM_S2 1 0 0 65535 FORMAT "%2.0" ECU_ADDRESS 0xFFF91020 /end MEASUREMENT
/begin MEASUREMENT N_AB_REST "" UWORD _CNV_R_R_Umr_1_zu_1_3_CM_S2 1 0 0 65535 FORMAT "%2.0" ECU_ADDRESS 0xFFF90EB4 /end MEASUREMENT
/begin MEASUREMENT N_EMBUFFER "" SWORD _CNV_R_R_Umr_1_zu_1_3_CM_S2 1 0 -20000 20000 FORMAT "%2.0" ARRAY_SIZE 2 ECU_ADDRESS 0xFFF906A8 MATRIX_DIM 2 1 1 /end MEASUREMENT
/begin MEASUREMENT N_GETR_EINGANG "" UWORD _CNV_R_R_Umr_1_zu_1_2_CM_S2 1 0 0 32767 FORMAT "%2.0" ARRAY_SIZE 9 ECU_ADDRESS 0xFFF90EF8 MATRIX_DIM 9 1 1 /end MEASUREMENT
/begin MEASUREMENT N_GETR_EINGANG_IST "" UWORD _CNV_R_R_Umr_1_zu_1_3_CM_S2 1 0 0 20000 FORMAT "%2.0" ECU_ADDRESS 0xFFF90F0A /end MEASUREMENT
/begin MEASUREMENT N_GETR_EINGANG_ZIEL "" UWORD _CNV_R_R_Umr_1_zu_1_3_CM_S2 1 0 0 20000 FORMAT "%2.0" ECU_ADDRESS 0xFFF90F0C /end MEASUREMENT
/begin MEASUREMENT N_MOT "" UWORD _CNV_R_R_Umr_1_zu_1_3_CM_S2 1 0 0 20000 FORMAT "%2.0" ECU_ADDRESS 0xFFF90B6C /end MEASUREMENT
/begin MEASUREMENT N_MOTBUFFER "" UWORD _CNV_R_R_Umr_1_zu_1_3_CM_S2 1 0 0 20000 FORMAT "%2.0" ARRAY_SIZE 2 ECU_ADDRESS 0xFFF906AC MATRIX_DIM 2 1 1 /end MEASUREMENT
/begin MEASUREMENT N_RAD_HL "" UWORD _CNV_R_R_Umr_1_zu_1_3_CM_S2 1 0 0 20000 FORMAT "%2.0" ECU_ADDRESS 0xFFF910F4 /end MEASUREMENT
/begin MEASUREMENT N_RAD_HR "" UWORD _CNV_R_R_Umr_1_zu_1_3_CM_S2 1 0 0 20000 FORMAT "%2.0" ECU_ADDRESS 0xFFF910F6 /end MEASUREMENT
/begin MEASUREMENT N_RAD_VL "" UWORD _CNV_R_R_Umr_1_zu_1_3_CM_S2 1 0 0 20000 FORMAT "%2.0" ECU_ADDRESS 0xFFF910F8 /end MEASUREMENT
/begin MEASUREMENT N_RAD_VR "" UWORD _CNV_R_R_Umr_1_zu_1_3_CM_S2 1 0 0 20000 FORMAT "%2.0" ECU_ADDRESS 0xFFF910FA /end MEASUREMENT
/begin MEASUREMENT N_RELATION_VAHA "" UWORD _CNV_R_R_Umr_100_zu_54_CM_S2 1 0 0 1 FORMAT "%4.2" ECU_ADDRESS 0xFFF910FC /end MEASUREMENT
/begin MEASUREMENT N_VMBUFFER "" UWORD _CNV_R_R_Umr_1_zu_1_3_CM_S2 1 0 0 20000 FORMAT "%2.0" ARRAY_SIZE 2 ECU_ADDRESS 0xFFF90710 MATRIX_DIM 2 1 1 /end MEASUREMENT
/begin MEASUREMENT SCHDN_SCHLUPF_HA "" UWORD _CNV_R_R_Umr_1_zu_1_3_CM_S2 1 0 0 20000 FORMAT "%2.0" ECU_ADDRESS 0xFFF910FE /end MEASUREMENT
/begin MEASUREMENT SCHDN_SCHLUPF_VA "" UWORD _CNV_R_R_Umr_1_zu_1_3_CM_S2 1 0 0 20000 FORMAT "%2.0" ECU_ADDRESS 0xFFF91100 /end MEASUREMENT
/begin MEASUREMENT SCHDN_SCHLUPF_VFZG "" UWORD _CNV_R_R_Umr_1_zu_1_3_CM_S2 1 0 0 20000 FORMAT "%2.0" ECU_ADDRESS 0xFFF91102 /end MEASUREMENT
/begin MEASUREMENT S_A_RADABSFILT "" UBYTE _CNV_R_R_Umr_1_zu_1_2_CM_S2 1 0 0 255 FORMAT "%2.0" ECU_ADDRESS 0xFFF91628 /end MEASUREMENT
/begin MEASUREMENT S_FZG_STEHT "" UBYTE _CNV_P_2_A_I_5_CM_S2 1 0 0 255 ECU_ADDRESS 0xFFF915D8 /end MEASUREMENT
/begin MEASUREMENT S_FZG_STEHT_AUFSTART "" UBYTE _CNV_R_R_Umr_1_zu_1_2_CM_S2 1 0 0 1 FORMAT "%2.0" ECU_ADDRESS 0xFFF915D9 /end MEASUREMENT
/begin MEASUREMENT S_REG_ABS_NACHL "" UBYTE _CNV_R_R_Umr_1_zu_1_2_CM_S2 1 0 0 1 ECU_ADDRESS 0xFFF915CE /end MEASUREMENT
/begin MEASUREMENT S_REG_ASCNACHL "" UBYTE _CNV_P_2_A_I_5_CM_S2 1 0 0 255 ECU_ADDRESS 0xFFF915CF /end MEASUREMENT
/begin MEASUREMENT S_RESET_VFZGPLAUSI "" UBYTE _CNV_S_2_Schalter_A_4_CM_S2 1 0 0 1 ECU_ADDRESS 0xFFF915DA /end MEASUREMENT
/begin MEASUREMENT S_STEIGUNG_FILT_SCHNELL "" UBYTE _CNV_S_2_Schalter_A_4_CM_S2 1 0 0 1 ECU_ADDRESS 0xFFF91680 /end MEASUREMENT
/begin MEASUREMENT S_VFZG_COG "" UBYTE _CNV_R_R_Umr_1_zu_1_2_CM_S2 1 0 0 1 FORMAT "%2.0" ECU_ADDRESS 0xFFF91629 /end MEASUREMENT
/begin MEASUREMENT S_VFZG_FILT "" UBYTE _CNV_R_R_Umr_1_zu_1_2_CM_S2 1 0 0 1 FORMAT "%2.0" ECU_ADDRESS 0xFFF9162A /end MEASUREMENT
/begin MEASUREMENT S_ZUG_FZGERK "" UBYTE _CNV_R_R_Umr_1_zu_1_2_CM_S2 1 0 0 2 FORMAT "%2.0" ECU_ADDRESS 0xFFF9162B /end MEASUREMENT
/begin MEASUREMENT T_BUFFER_ARADABSFILT "" ULONG _CNV_R_R_Umr_1_zu_1_6_CM_S2 1 0 0 4294967295 FORMAT "%2.0" ECU_ADDRESS 0xFFF90658 /end MEASUREMENT
/begin MEASUREMENT T_BUFFER_SGG "" ULONG _CNV_R_R_Umr_1_zu_1_6_CM_S2 1 0 0 4294967295 FORMAT "%2.0" ARRAY_SIZE 10 ECU_ADDRESS 0xFFF9019C MATRIX_DIM 10 1 1 /end MEASUREMENT
/begin MEASUREMENT T_BUFFER_STEIGUNG_FILT "" ULONG _CNV_R_R_Umr_1_zu_1_6_CM_S2 1 0 0 4294967295 FORMAT "%2.0" ECU_ADDRESS 0xFFF907B4 /end MEASUREMENT
/begin MEASUREMENT T_RAD_FZGBUFFER "" ULONG _CNV_R_R_Umr_1_zu_1_6_CM_S2 1 0 0 4294967295 FORMAT "%2.0" ARRAY_SIZE 2 ECU_ADDRESS 0xFFF9065C MATRIX_DIM 2 1 1 /end MEASUREMENT
/begin MEASUREMENT T_REG_ABS_NACHL "" SLONG _CNV_R_R_Umr_1_zu_1_6_CM_S2 1 0 -2147483647 2147483647 FORMAT "%2.0" ECU_ADDRESS 0xFFF9058C /end MEASUREMENT
/begin MEASUREMENT T_REG_ABS_NACHLBUF "" ULONG _CNV_R_R_Umr_1_zu_1_6_CM_S2 1 0 0 4294967295 FORMAT "%2.0" ECU_ADDRESS 0xFFF90590 /end MEASUREMENT
/begin MEASUREMENT T_REG_ASCNACHL "" SLONG _CNV_R_R_Umr_1_zu_1_6_CM_S2 1 0 -2147483647 2147483647 FORMAT "%2.0" ECU_ADDRESS 0xFFF90594 /end MEASUREMENT
/begin MEASUREMENT T_REG_ASCNACHLBUF "" ULONG _CNV_R_R_Umr_1_zu_1_6_CM_S2 1 0 0 4294967295 FORMAT "%2.0" ECU_ADDRESS 0xFFF90598 /end MEASUREMENT
/begin MEASUREMENT T_STEIGUNG_FILT "" SLONG _CNV_R_R_Umr_1_zu_1_6_CM_S2 1 0 -2147483648 2147483647 FORMAT "%2.0" ECU_ADDRESS 0xFFF907B8 /end MEASUREMENT
/begin MEASUREMENT V_FZG "" UWORD _CNV_R_R_Umr_1_zu_1_8_CM_S2 1 0 0 400 FORMAT "%2.0" ECU_ADDRESS 0xFFF90FBE /end MEASUREMENT
/begin MEASUREMENT V_FZG_BER "" UWORD _CNV_R_R_Umr_1_zu_1_8_CM_S2 1 0 0 400 FORMAT "%2.0" ECU_ADDRESS 0xFFF90FC0 /end MEASUREMENT
/begin MEASUREMENT V_FZG_FILT "" UWORD _CNV_R_R_Umr_1_zu_1_8_CM_S2 1 0 0 400 FORMAT "%2.0" ECU_ADDRESS 0xFFF90FC2 /end MEASUREMENT
/begin MEASUREMENT V_FZG_FILTREST "" UWORD _CNV_R_R_Umr_1_zu_1_8_CM_S2 1 0 0 65535 FORMAT "%2.0" ECU_ADDRESS 0xFFF90FC4 /end MEASUREMENT
/begin MEASUREMENT V_FZG_MSBUFFER "" UWORD _CNV_R_R_Umr_10_zu__191_CM_S2 1 0 0 300 FORMAT "%3.1" ARRAY_SIZE 6 ECU_ADDRESS 0xFFF9059C MATRIX_DIM 6 1 1 /end MEASUREMENT
/begin MEASUREMENT V_FZG_OHNEABS "" UWORD _CNV_R_R_Umr_1_zu_1_8_CM_S2 1 0 0 400 FORMAT "%2.0" ECU_ADDRESS 0xFFF90FC6 /end MEASUREMENT
/begin MEASUREMENT V_FZG_OHNEABSFILT "" UWORD _CNV_R_R_Umr_1_zu_1_8_CM_S2 1 0 0 400 FORMAT "%2.0" ECU_ADDRESS 0xFFF90FC8 /end MEASUREMENT
/begin MEASUREMENT V_FZG_OHNEABSFILTREST "" UWORD _CNV_R_R_Umr_1_zu_1_8_CM_S2 1 0 0 65535 FORMAT "%2.0" ECU_ADDRESS 0xFFF90FCA /end MEASUREMENT
/begin MEASUREMENT V_RAD_FAKT "" UWORD _CNV_R_R_Umr_1_zu_1_2_CM_S2 1 0 0 65535 FORMAT "%2.0" ECU_ADDRESS 0xFFF90FCC /end MEASUREMENT
/begin MEASUREMENT V_RAD_HLRTKOR "" UWORD _CNV_R_R_Umr_16_zu__186_CM_S2 1 0 0 400 FORMAT "%4.2" ECU_ADDRESS 0xFFF90FCE /end MEASUREMENT
/begin MEASUREMENT V_RAD_HLRTKORBUFFER "" UWORD _CNV_R_R_Umr_16_zu__186_CM_S2 1 0 0 400 FORMAT "%4.2" ARRAY_SIZE 10 ECU_ADDRESS 0xFFF905F8 MATRIX_DIM 10 1 1 /end MEASUREMENT
/begin MEASUREMENT V_RAD_HLRTKORMAX "" UWORD _CNV_R_R_Umr_16_zu__186_CM_S2 1 0 0 400 FORMAT "%4.2" ECU_ADDRESS 0xFFF90FD0 /end MEASUREMENT
/begin MEASUREMENT V_RAD_HLRTKORMIN "" UWORD _CNV_R_R_Umr_16_zu__186_CM_S2 1 0 0 400 FORMAT "%4.2" ECU_ADDRESS 0xFFF90FD2 /end MEASUREMENT
/begin MEASUREMENT V_RAD_HLRTKORMIT "" UWORD _CNV_R_R_Umr_16_zu__186_CM_S2 1 0 0 400 FORMAT "%4.2" ECU_ADDRESS 0xFFF90FD4 /end MEASUREMENT
/begin MEASUREMENT V_RAD_HRRTKOR "" UWORD _CNV_R_R_Umr_16_zu__186_CM_S2 1 0 0 400 FORMAT "%4.2" ECU_ADDRESS 0xFFF90FD6 /end MEASUREMENT
/begin MEASUREMENT V_RAD_HRRTKORBUFFER "" UWORD _CNV_R_R_Umr_16_zu__186_CM_S2 1 0 0 400 FORMAT "%4.2" ARRAY_SIZE 10 ECU_ADDRESS 0xFFF9060C MATRIX_DIM 10 1 1 /end MEASUREMENT
/begin MEASUREMENT V_RAD_HRRTKORMAX "" UWORD _CNV_R_R_Umr_16_zu__186_CM_S2 1 0 0 400 FORMAT "%4.2" ECU_ADDRESS 0xFFF90FD8 /end MEASUREMENT
/begin MEASUREMENT V_RAD_HRRTKORMIN "" UWORD _CNV_R_R_Umr_16_zu__186_CM_S2 1 0 0 400 FORMAT "%4.2" ECU_ADDRESS 0xFFF90FDA /end MEASUREMENT
/begin MEASUREMENT V_RAD_HRRTKORMIT "" UWORD _CNV_R_R_Umr_16_zu__186_CM_S2 1 0 0 400 FORMAT "%4.2" ECU_ADDRESS 0xFFF90FDC /end MEASUREMENT
/begin MEASUREMENT V_RAD_MAXMAX "" UWORD _CNV_R_R_Umr_16_zu__186_CM_S2 1 0 0 400 FORMAT "%4.2" ECU_ADDRESS 0xFFF90FDE /end MEASUREMENT
/begin MEASUREMENT V_RAD_MIN "" UWORD _CNV_R_R_Umr_16_zu__186_CM_S2 1 0 0 400 FORMAT "%4.2" ECU_ADDRESS 0xFFF90FE0 /end MEASUREMENT
/begin MEASUREMENT V_RAD_OHNEABS "" UWORD _CNV_R_R_Umr_16_zu__186_CM_S2 1 0 0 400 FORMAT "%4.2" ECU_ADDRESS 0xFFF90FE2 /end MEASUREMENT
/begin MEASUREMENT V_RAD_OHNEABSFILT "" UWORD _CNV_R_R_Umr_16_zu__186_CM_S2 1 0 0 400 FORMAT "%4.2" ECU_ADDRESS 0xFFF90FE4 /end MEASUREMENT
/begin MEASUREMENT V_RAD_OHNEABSFILTREST "" UWORD _CNV_R_R_Umr_16_zu__186_CM_S2 1 0 0 4095.9375 FORMAT "%4.2" ECU_ADDRESS 0xFFF90FE6 /end MEASUREMENT
/begin MEASUREMENT V_RAD_VA2FILT "" UWORD _CNV_R_R_Umr_16_zu__186_CM_S2 1 0 0 400 FORMAT "%4.2" ECU_ADDRESS 0xFFF90FE8 /end MEASUREMENT
/begin MEASUREMENT V_RAD_VA2FILTREST "" UWORD _CNV_R_R_Umr_16_zu__186_CM_S2 1 0 0 4095.9375 FORMAT "%4.2" ECU_ADDRESS 0xFFF90FEA /end MEASUREMENT
/begin MEASUREMENT V_RAD_VABUFFER "" UWORD _CNV_R_R_Umr_1_zu_1_8_CM_S2 1 0 0 400 FORMAT "%2.0" ARRAY_SIZE 4 ECU_ADDRESS 0xFFF90620 MATRIX_DIM 4 1 1 /end MEASUREMENT
/begin MEASUREMENT V_RAD_VAFILT "" UWORD _CNV_R_R_Umr_16_zu__186_CM_S2 1 0 0 400 FORMAT "%4.2" ECU_ADDRESS 0xFFF90FEC /end MEASUREMENT
/begin MEASUREMENT V_RAD_VLRTKOR "" UWORD _CNV_R_R_Umr_16_zu__186_CM_S2 1 0 0 400 FORMAT "%4.2" ECU_ADDRESS 0xFFF90FEE /end MEASUREMENT
/begin MEASUREMENT V_RAD_VLRTKORALT "" UWORD _CNV_R_R_Umr_16_zu__186_CM_S2 1 0 0 400 FORMAT "%4.2" ECU_ADDRESS 0xFFF90FF0 /end MEASUREMENT
/begin MEASUREMENT V_RAD_VLRTKORBUFFER "" UWORD _CNV_R_R_Umr_16_zu__186_CM_S2 1 0 0 400 FORMAT "%4.2" ARRAY_SIZE 10 ECU_ADDRESS 0xFFF90628 MATRIX_DIM 10 1 1 /end MEASUREMENT
/begin MEASUREMENT V_RAD_VLRTKORERSATZ "" UWORD _CNV_R_R_Umr_16_zu__186_CM_S2 1 0 0 400 FORMAT "%4.2" ECU_ADDRESS 0xFFF90FF2 /end MEASUREMENT
/begin MEASUREMENT V_RAD_VLRTKORMAX "" UWORD _CNV_R_R_Umr_16_zu__186_CM_S2 1 0 0 400 FORMAT "%4.2" ECU_ADDRESS 0xFFF90FF4 /end MEASUREMENT
/begin MEASUREMENT V_RAD_VLRTKORMIN "" UWORD _CNV_R_R_Umr_16_zu__186_CM_S2 1 0 0 400 FORMAT "%4.2" ECU_ADDRESS 0xFFF90FF6 /end MEASUREMENT
/begin MEASUREMENT V_RAD_VLRTKORMIT "" UWORD _CNV_R_R_Umr_16_zu__186_CM_S2 1 0 0 400 FORMAT "%4.2" ECU_ADDRESS 0xFFF90FF8 /end MEASUREMENT
/begin MEASUREMENT V_RAD_VLRTKORMSBUFFER "" UWORD _CNV_R_R_Umr_100_zu_266_CM_S2 1 0 0 120 FORMAT "%4.2" ARRAY_SIZE 2 ECU_ADDRESS 0xFFF9063C MATRIX_DIM 2 1 1 /end MEASUREMENT
/begin MEASUREMENT V_RAD_VLRTKORMSERSATZ "" UWORD _CNV_R_R_Umr_100_zu_266_CM_S2 1 0 0 120 FORMAT "%4.2" ECU_ADDRESS 0xFFF90FFA /end MEASUREMENT
/begin MEASUREMENT V_RAD_VRRTKOR "" UWORD _CNV_R_R_Umr_16_zu__186_CM_S2 1 0 0 400 FORMAT "%4.2" ECU_ADDRESS 0xFFF90FFC /end MEASUREMENT
/begin MEASUREMENT V_RAD_VRRTKORALT "" UWORD _CNV_R_R_Umr_16_zu__186_CM_S2 1 0 0 400 FORMAT "%4.2" ECU_ADDRESS 0xFFF90FFE /end MEASUREMENT
/begin MEASUREMENT V_RAD_VRRTKORBUFFER "" UWORD _CNV_R_R_Umr_16_zu__186_CM_S2 1 0 0 400 FORMAT "%4.2" ARRAY_SIZE 10 ECU_ADDRESS 0xFFF90640 MATRIX_DIM 10 1 1 /end MEASUREMENT
/begin MEASUREMENT V_RAD_VRRTKORERSATZ "" UWORD _CNV_R_R_Umr_16_zu__186_CM_S2 1 0 0 400 FORMAT "%4.2" ECU_ADDRESS 0xFFF91000 /end MEASUREMENT
/begin MEASUREMENT V_RAD_VRRTKORMAX "" UWORD _CNV_R_R_Umr_16_zu__186_CM_S2 1 0 0 400 FORMAT "%4.2" ECU_ADDRESS 0xFFF91002 /end MEASUREMENT
/begin MEASUREMENT V_RAD_VRRTKORMIN "" UWORD _CNV_R_R_Umr_16_zu__186_CM_S2 1 0 0 400 FORMAT "%4.2" ECU_ADDRESS 0xFFF91004 /end MEASUREMENT
/begin MEASUREMENT V_RAD_VRRTKORMIT "" UWORD _CNV_R_R_Umr_16_zu__186_CM_S2 1 0 0 400 FORMAT "%4.2" ECU_ADDRESS 0xFFF91006 /end MEASUREMENT
/begin MEASUREMENT V_RAD_VRRTKORMSBUFFER "" UWORD _CNV_R_R_Umr_100_zu_266_CM_S2 1 0 0 120 FORMAT "%4.2" ARRAY_SIZE 2 ECU_ADDRESS 0xFFF90654 MATRIX_DIM 2 1 1 /end MEASUREMENT
/begin MEASUREMENT V_RAD_VRRTKORMSERSATZ "" UWORD _CNV_R_R_Umr_100_zu_266_CM_S2 1 0 0 120 FORMAT "%4.2" ECU_ADDRESS 0xFFF91008 /end MEASUREMENT
/begin MEASUREMENT W_DKKD "" UWORD _CNV_R_R_Umr_10_zu__9_CM_S2 1 0 0 110 FORMAT "%3.1" ECU_ADDRESS 0xFFF90F1E /end MEASUREMENT
/begin MEASUREMENT W_DK_LIN "" UWORD _CNV_R_R_Umr_10_zu__9_CM_S2 1 0 0 110 FORMAT "%3.1" ECU_ADDRESS 0xFFF90F20 /end MEASUREMENT
/begin MEASUREMENT W_DK_LINBUFFER "" UWORD _CNV_R_R_Umr_10_zu__9_CM_S2 1 0 0 110 FORMAT "%3.1" ARRAY_SIZE 2 ECU_ADDRESS 0xFFF905CC MATRIX_DIM 2 1 1 /end MEASUREMENT
/begin MEASUREMENT W_STEIGUNGERRSLOW_FILT "" SWORD _CNV_R_R_Umr_10_zu__9_CM_S2 1 0 -200 200 FORMAT "%3.1" ECU_ADDRESS 0xFFF91104 /end MEASUREMENT
/begin MEASUREMENT W_STEIGUNGERRSLOW_FILT_REST "" SWORD _CNV_R_R_Umr_10_zu__9_CM_S2 1 0 -200 200 FORMAT "%3.1" ECU_ADDRESS 0xFFF91106 /end MEASUREMENT
/begin MEASUREMENT W_STEIGUNG_KORFILT "" SWORD _CNV_R_R_Umr_10_zu__9_CM_S2 1 0 -200 200 FORMAT "%3.1" ECU_ADDRESS 0xFFF91108 /end MEASUREMENT
/begin MEASUREMENT W_STEIGUNG_KORFILT_REST "" SWORD _CNV_R_R_Umr_10_zu__9_CM_S2 1 0 -200 200 FORMAT "%3.1" ECU_ADDRESS 0xFFF9110A /end MEASUREMENT
/begin MEASUREMENT Z_SCHLUPF_ANTRIEB_RL "" UBYTE _CNV_S_3_Enum_ESCHL_41_CM_S2 1 0 0 2 ECU_ADDRESS 0xFFF91675 /end MEASUREMENT
/begin MEASUREMENT Z_SCHLUPF_ANTRIEB_RR "" UBYTE _CNV_S_3_Enum_ESCHL_41_CM_S2 1 0 0 2 ECU_ADDRESS 0xFFF91676 /end MEASUREMENT
/begin MEASUREMENT Z_SCHLUPF_HL "" UBYTE _CNV_S_3_Enum_ESCHL_41_CM_S2 1 0 0 2 ECU_ADDRESS 0xFFF91677 /end MEASUREMENT
/begin MEASUREMENT Z_SCHLUPF_HR "" UBYTE _CNV_S_3_Enum_ESCHL_41_CM_S2 1 0 0 2 ECU_ADDRESS 0xFFF91678 /end MEASUREMENT
/begin MEASUREMENT Z_SCHLUPF_VL "" UBYTE _CNV_S_3_Enum_ESCHL_41_CM_S2 1 0 0 2 ECU_ADDRESS 0xFFF91679 /end MEASUREMENT
/begin MEASUREMENT Z_SCHLUPF_VR "" UBYTE _CNV_S_3_Enum_ESCHL_41_CM_S2 1 0 0 2 ECU_ADDRESS 0xFFF9167A /end MEASUREMENT
/begin MEASUREMENT A_L_REF_ROH "" SWORD _CNV_R_R_Umr_1_zu_1_2_CM_S2 1 0 -32768 32767 ECU_ADDRESS 0xFFF90BB0 /end MEASUREMENT
/begin MEASUREMENT A_Q_REF_ROH "" SWORD _CNV_R_R_Umr_1_zu_1_2_CM_S2 1 0 -32768 32767 ECU_ADDRESS 0xFFF90BB2 /end MEASUREMENT
/begin MEASUREMENT C_FBIT_AN "" UWORD _CNV_R_R_Umr_1_zu_1_2_CM_S2 1 0 0 65535 ECU_ADDRESS 0xFFF90FB8 /end MEASUREMENT
/begin MEASUREMENT C_NAVGRAPH_MAPDATA_ROH "" UBYTE _CNV_R_R_Umr_1_zu_1_2_CM_S2 1 0 0 255 FORMAT "%2.0" ECU_ADDRESS 0xFFF9138D /end MEASUREMENT
/begin MEASUREMENT C_NAVGRAPH_SYNC_ROH "" UBYTE _CNV_R_R_Umr_1_zu_1_2_CM_S2 1 0 0 255 FORMAT "%2.0" ECU_ADDRESS 0xFFF9138E /end MEASUREMENT
/begin MEASUREMENT GW_GIER_ROH "" SWORD _CNV_R_R_Umr_1_zu_1_2_CM_S2 1 0 -1638.4 1638.35 FORMAT "%4.2" ECU_ADDRESS 0xFFF90BB4 /end MEASUREMENT
/begin MEASUREMENT IG_HA_ROH "" UWORD _CNV_R_R_Umr_1_zu_1_2_CM_S2 1 0 0 65535 ECU_ADDRESS 0xFFF90BB6 /end MEASUREMENT
/begin MEASUREMENT I_STRANG_ROH "" UWORD _CNV_R_R_Umr_1_zu_1_2_CM_S2 1 0 0.000125 511 FORMAT "%4.2" ECU_ADDRESS 0xFFF90BB8 /end MEASUREMENT
/begin MEASUREMENT MASSE_FZG_EST_ROH "" UWORD _CNV_R_R_Umr_1_zu_1_2_CM_S2 1 0 0 4094 FORMAT "%2.0" ECU_ADDRESS 0xFFF90BBC /end MEASUREMENT
/begin MEASUREMENT M_AB_DYN_ROH "" SWORD _CNV_R_R_Umr_1_zu_1_2_CM_S2 1 0 -32768 32767 FORMAT "%2.0" ECU_ADDRESS 0xFFF90BBE /end MEASUREMENT
/begin MEASUREMENT M_BR_ROH "" UWORD _CNV_R_R_Umr_1_zu_1_2_CM_S2 1 0 0 65535 ECU_ADDRESS 0xFFF90BC0 /end MEASUREMENT
/begin MEASUREMENT M_BR_SOLL_ROH "" UWORD _CNV_R_R_Umr_1_zu_1_2_CM_S2 1 0 0 32000 FORMAT "%2.0" ECU_ADDRESS 0xFFF90BC2 /end MEASUREMENT
/begin MEASUREMENT M_EM_MAXKURZ_PRED_ROH "" UWORD _CNV_R_R_Umr_1_zu_1_2_CM_S2 1 0 0 4094 FORMAT "%2.0" ECU_ADDRESS 0xFFF90BC4 /end MEASUREMENT
/begin MEASUREMENT M_EM_MAXLANG_PRED_ROH "" UWORD _CNV_R_R_Umr_1_zu_1_2_CM_S2 1 0 0 4094 FORMAT "%2.0" ECU_ADDRESS 0xFFF90BC6 /end MEASUREMENT
/begin MEASUREMENT M_EM_MINKURZ_PRED_ROH "" UWORD _CNV_R_R_Umr_1_zu_1_2_CM_S2 1 0 0 4094 FORMAT "%2.0" ECU_ADDRESS 0xFFF90BC8 /end MEASUREMENT
/begin MEASUREMENT M_EM_MINLANG_PRED_ROH "" UWORD _CNV_R_R_Umr_1_zu_1_2_CM_S2 1 0 0 4094 FORMAT "%2.0" ECU_ADDRESS 0xFFF90BCA /end MEASUREMENT
/begin MEASUREMENT M_EM_ROH "" SWORD _CNV_R_R_Umr_1_zu_1_2_CM_S2 1 0 -32768 32767 ECU_ADDRESS 0xFFF90BD2 /end MEASUREMENT
/begin MEASUREMENT M_LDM_SOLL_ROH "" SWORD _CNV_R_R_Umr_1_zu_1_42_CM_S2 1 0 -32768 32767 FORMAT "%2.0" ECU_ADDRESS 0xFFF90BBA /end MEASUREMENT
/begin MEASUREMENT M_MOT_DMEE_ROH "" SWORD _CNV_R_R_Umr_1_zu_1_2_CM_S2 1 0 -32768 32767 ECU_ADDRESS 0xFFF90BD4 /end MEASUREMENT
/begin MEASUREMENT M_MOT_FW_ROH "" SWORD _CNV_R_R_Umr_1_zu_1_2_CM_S2 1 0 -32768 32767 ECU_ADDRESS 0xFFF90BD6 /end MEASUREMENT
/begin MEASUREMENT M_MOT_IST_ROH "" SWORD _CNV_R_R_Umr_1_zu_1_42_CM_S2 1 0 -32768 32767 ECU_ADDRESS 0xFFF90BD8 /end MEASUREMENT
/begin MEASUREMENT M_MOT_MAXDME_ROH "" SWORD _CNV_R_R_Umr_1_zu_1_2_CM_S2 1 0 -32768 32767 ECU_ADDRESS 0xFFF90BDA /end MEASUREMENT
/begin MEASUREMENT M_MOT_REIB_ROH "" UWORD _CNV_R_R_Umr_1_zu_1_2_CM_S2 1 0 0 32000 ECU_ADDRESS 0xFFF90BDC /end MEASUREMENT
/begin MEASUREMENT M_RAD_HDC_SOLL_ROH "" SWORD _CNV_R_R_Umr_1_zu_1_42_CM_S2 1 0 -32768 32767 FORMAT "%2.0" ECU_ADDRESS 0xFFF90BDE /end MEASUREMENT
/begin MEASUREMENT M_RAD_IST_ROH "" UWORD _CNV_R_R_Umr_1_zu_1_2_CM_S2 1 0 0 64000 FORMAT "%2.0" ECU_ADDRESS 0xFFF90BE0 /end MEASUREMENT
/begin MEASUREMENT M_RAD_REKUPMAX_IST_ROH "" UWORD _CNV_R_R_Umr_1_zu_1_2_CM_S2 1 0 0 64000 FORMAT "%2.0" ECU_ADDRESS 0xFFF90BCC /end MEASUREMENT
/begin MEASUREMENT M_RAD_REKUPMAX_PRED_ROH "" UWORD _CNV_R_R_Umr_1_zu_1_2_CM_S2 1 0 0 32000 FORMAT "%2.0" ECU_ADDRESS 0xFFF90BCE /end MEASUREMENT
/begin MEASUREMENT M_RAD_REKUP_SOLL_ROH "" UWORD _CNV_R_R_Umr_1_zu_1_2_CM_S2 1 0 0 64000 FORMAT "%2.0" ECU_ADDRESS 0xFFF90BD0 /end MEASUREMENT
/begin MEASUREMENT M_RAD_SCHLEPPUNT_IST_ROH "" UWORD _CNV_R_R_Umr_1_zu_1_2_CM_S2 1 0 0 64000 FORMAT "%2.0" ECU_ADDRESS 0xFFF90BE2 /end MEASUREMENT
/begin MEASUREMENT M_RAD_WUNSCH_ROH "" SWORD _CNV_R_R_Umr_1_zu_1_42_CM_S2 1 0 -32768 32767 FORMAT "%2.0" ECU_ADDRESS 0xFFF90BE4 /end MEASUREMENT
/begin MEASUREMENT M_T_ROH "" UWORD _CNV_R_R_Umr_1_zu_1_2_CM_S2 1 0 0 64000 FORMAT "%2.0" ECU_ADDRESS 0xFFF90BE6 /end MEASUREMENT
/begin MEASUREMENT M_VM_ROH "" SWORD _CNV_R_R_Umr_1_zu_1_42_CM_S2 1 0 -32768 32767 FORMAT "%2.0" ECU_ADDRESS 0xFFF90BE8 /end MEASUREMENT
/begin MEASUREMENT N_AB_ROH "" UWORD _CNV_R_R_Umr_1_zu_1_3_CM_S2 1 0 0 20000 FORMAT "%2.0" ECU_ADDRESS 0xFFF90BEA /end MEASUREMENT
/begin MEASUREMENT N_EM_ROH "" UWORD _CNV_R_R_Umr_1_zu_1_3_CM_S2 1 0 0 32767 FORMAT "%2.0" ECU_ADDRESS 0xFFF90BEC /end MEASUREMENT
/begin MEASUREMENT N_MOT_ABREGEL_ROH "" UWORD _CNV_R_R_Umr_1_zu_1_3_CM_S2 1 0 0 10000 FORMAT "%2.0" ECU_ADDRESS 0xFFF90BEE /end MEASUREMENT
/begin MEASUREMENT N_MOT_SOLLLL_ROH "" UWORD _CNV_R_R_Umr_1_zu_1_2_CM_S2 1 0 0 65535 ECU_ADDRESS 0xFFF90BF0 /end MEASUREMENT
/begin MEASUREMENT N_T_ROH "" UWORD _CNV_R_R_Umr_1_zu_1_2_CM_S2 1 0 0 65535 ECU_ADDRESS 0xFFF90BF2 /end MEASUREMENT
/begin MEASUREMENT N_VM_ROH "" UWORD _CNV_R_R_Umr_1_zu_1_2_CM_S2 1 0 0 65535 ECU_ADDRESS 0xFFF90BF4 /end MEASUREMENT
/begin MEASUREMENT P_LUFT_ROH "" UWORD _CNV_R_R_Umr_1_zu_1_2_CM_S2 1 0 0 65535 ECU_ADDRESS 0xFFF90BF8 /end MEASUREMENT
/begin MEASUREMENT QA_L_REF_ROH "" UBYTE _CNV_R_R_Umr_1_zu_1_2_CM_S2 1 0 0 255 ECU_ADDRESS 0xFFF9138F /end MEASUREMENT
/begin MEASUREMENT QA_Q_REF_ROH "" UBYTE _CNV_R_R_Umr_1_zu_1_2_CM_S2 1 0 0 255 ECU_ADDRESS 0xFFF91390 /end MEASUREMENT
/begin MEASUREMENT QGW_GIER_ROH "" UBYTE _CNV_R_R_Umr_1_zu_1_2_CM_S2 1 0 0 255 ECU_ADDRESS 0xFFF91391 /end MEASUREMENT
/begin MEASUREMENT QMASSE_FZG_EST_ROH "" UBYTE _CNV_R_R_Umr_1_zu_1_2_CM_S2 1 0 0 255 ECU_ADDRESS 0xFFF91392 /end MEASUREMENT
/begin MEASUREMENT QM_BR_ROH "" UBYTE _CNV_R_R_Umr_1_zu_1_2_CM_S2 1 0 0 255 ECU_ADDRESS 0xFFF91393 /end MEASUREMENT
/begin MEASUREMENT QM_LDM_STATUS_ROH "" UBYTE _CNV_R_R_Umr_1_zu_1_2_CM_S2 1 0 0 255 ECU_ADDRESS 0xFFF913A5 /end MEASUREMENT
/begin MEASUREMENT QM_MOT_MAXDME_ROH "" UBYTE _CNV_R_R_Umr_1_zu_1_2_CM_S2 1 0 0 255 ECU_ADDRESS 0xFFF91394 /end MEASUREMENT
/begin MEASUREMENT QM_RAD_IST_ROH "" UBYTE _CNV_R_R_Umr_1_zu_1_2_CM_S2 1 0 0 255 ECU_ADDRESS 0xFFF91395 /end MEASUREMENT
/begin MEASUREMENT QN_AB_ROH "" UBYTE _CNV_S_3_Enum_EQ_79_CM_S2 1 0 0 2 ECU_ADDRESS 0xFFF913A8 /end MEASUREMENT
/begin MEASUREMENT QN_MOT_SOLLLL_ROH "" UBYTE _CNV_S_3_Enum_EQ_79_CM_S2 1 0 0 2 ECU_ADDRESS 0xFFF91396 /end MEASUREMENT
/begin MEASUREMENT QN_T_ROH "" UBYTE _CNV_S_3_Enum_EQ_79_CM_S2 1 0 0 2 ECU_ADDRESS 0xFFF913A9 /end MEASUREMENT
/begin MEASUREMENT QV_FZG_COG_ROH "" UBYTE _CNV_R_R_Umr_1_zu_1_2_CM_S2 1 0 0 255 ECU_ADDRESS 0xFFF91397 /end MEASUREMENT
/begin MEASUREMENT QV_RAD_HL_ROH "" UBYTE _CNV_R_R_Umr_1_zu_1_2_CM_S2 1 0 0 255 ECU_ADDRESS 0xFFF913AB /end MEASUREMENT
/begin MEASUREMENT QV_RAD_HR_ROH "" UBYTE _CNV_R_R_Umr_1_zu_1_2_CM_S2 1 0 0 255 ECU_ADDRESS 0xFFF913AC /end MEASUREMENT
/begin MEASUREMENT QV_RAD_VL_ROH "" UBYTE _CNV_R_R_Umr_1_zu_1_2_CM_S2 1 0 0 255 ECU_ADDRESS 0xFFF913AD /end MEASUREMENT
/begin MEASUREMENT QV_RAD_VR_ROH "" UBYTE _CNV_R_R_Umr_1_zu_1_2_CM_S2 1 0 0 255 ECU_ADDRESS 0xFFF913AE /end MEASUREMENT
/begin MEASUREMENT QW_STEIGUNG_ROH "" UBYTE _CNV_R_R_Umr_1_zu_1_2_CM_S2 1 0 0 255 ECU_ADDRESS 0xFFF913AF /end MEASUREMENT
/begin MEASUREMENT Q_NAVGRAPH_MATCH_ROH "" UBYTE _CNV_R_R_Umr_1_zu_1_2_CM_S2 1 0 0 255 FORMAT "%2.0" ECU_ADDRESS 0xFFF913B0 /end MEASUREMENT
/begin MEASUREMENT R_RAD_DYN_ROH "" UWORD _CNV_R_R_Umr_1_zu_1_2_CM_S2 1 0 0 65535 ECU_ADDRESS 0xFFF90BFA /end MEASUREMENT
/begin MEASUREMENT S_AEP_REQ_ROH "" UBYTE _CNV_R_R_Umr_1_zu_1_2_CM_S2 1 0 0 255 ECU_ADDRESS 0xFFF91398 /end MEASUREMENT
/begin MEASUREMENT S_B_ROH "" UBYTE _CNV_R_R_Umr_1_zu_1_2_CM_S2 1 0 0 255 ECU_ADDRESS 0xFFF91399 /end MEASUREMENT
/begin MEASUREMENT S_EM_DAEMPFUNG_ROH "" UBYTE _CNV_R_R_Umr_1_zu_1_2_CM_S2 1 0 0 255 FORMAT "%2.0" ECU_ADDRESS 0xFFF913B2 /end MEASUREMENT
/begin MEASUREMENT S_ERR_ASC_ROH "" UBYTE _CNV_P_2_A_I_5_CM_S2 1 0 0 255 ECU_ADDRESS 0xFFF913B3 /end MEASUREMENT
/begin MEASUREMENT S_ERR_DSC_ROH "" UBYTE _CNV_R_R_Umr_1_zu_1_2_CM_S2 1 0 0 255 ECU_ADDRESS 0xFFF913B4 /end MEASUREMENT
/begin MEASUREMENT S_KD_ROH "" UBYTE _CNV_R_R_Umr_1_zu_1_2_CM_S2 1 0 0 255 ECU_ADDRESS 0xFFF9139A /end MEASUREMENT
/begin MEASUREMENT S_MINUS_GWS_ROH "" UBYTE _CNV_S_2_Schalter_A_4_CM_S2 1 0 0 1 ECU_ADDRESS 0xFFF913B6 /end MEASUREMENT
/begin MEASUREMENT S_MINUS_PADDLE_ROH "" UBYTE _CNV_P_2_A_I_5_CM_S2 1 0 0 255 ECU_ADDRESS 0xFFF913B7 /end MEASUREMENT
/begin MEASUREMENT S_MSA_ADAPT_RS_ROH "" UBYTE _CNV_R_R_Umr_1_zu_1_2_CM_S2 1 0 0 255 ECU_ADDRESS 0xFFF913B8 /end MEASUREMENT
/begin MEASUREMENT S_MSA_STAT_ROH "" UBYTE _CNV_R_R_Umr_1_zu_1_2_CM_S2 1 0 0 255 ECU_ADDRESS 0xFFF913B9 /end MEASUREMENT
/begin MEASUREMENT S_OVERRIDE_GANG_ROH "" UBYTE _CNV_R_R_Umr_1_zu_1_2_CM_S2 1 0 0 255 ECU_ADDRESS 0xFFF913BA /end MEASUREMENT
/begin MEASUREMENT S_PLUS_GWS_ROH "" UBYTE _CNV_S_2_Schalter_A_4_CM_S2 1 0 0 1 ECU_ADDRESS 0xFFF913BB /end MEASUREMENT
/begin MEASUREMENT S_PLUS_PADDLE_ROH "" UBYTE _CNV_P_2_A_I_5_CM_S2 1 0 0 255 ECU_ADDRESS 0xFFF913BC /end MEASUREMENT
/begin MEASUREMENT S_REG_ASC_ROH "" UBYTE _CNV_R_R_Umr_1_zu_1_2_CM_S2 1 0 0 255 ECU_ADDRESS 0xFFF913BD /end MEASUREMENT
/begin MEASUREMENT S_ROLLE_CAN_ROH "" UBYTE _CNV_R_R_Umr_1_zu_1_2_CM_S2 1 0 0 255 ECU_ADDRESS 0xFFF9139B /end MEASUREMENT
/begin MEASUREMENT S_SCHALTVERZUG_ROH "" UBYTE _CNV_R_R_Umr_1_zu_1_2_CM_S2 1 0 0 1 FORMAT "%2.0" ECU_ADDRESS 0xFFF913BE /end MEASUREMENT
/begin MEASUREMENT S_TRPMOD_ROH "" UBYTE _CNV_R_R_Umr_1_zu_1_2_CM_S2 1 0 0 255 FORMAT "%2.0" ECU_ADDRESS 0xFFF913BF /end MEASUREMENT
/begin MEASUREMENT S_VFZG_PLAUSI_ROH "" UBYTE _CNV_R_R_Umr_1_zu_1_2_CM_S2 1 0 0 255 ECU_ADDRESS 0xFFF913C0 /end MEASUREMENT
/begin MEASUREMENT TEMP_EM_ROH "" UBYTE _CNV_R_R_Umr_1_zu_1_2_CM_S2 1 0 0 255 FORMAT "%2.0" ECU_ADDRESS 0xFFF913C1 /end MEASUREMENT
/begin MEASUREMENT TEMP_GETR_ROH "" UBYTE _CNV_R_R_Umr_1_zu_1_2_CM_S2 1 0 0 255 FORMAT "%2.0" ECU_ADDRESS 0xFFF913C2 /end MEASUREMENT
/begin MEASUREMENT TEMP_KUP_A_ROH "" SWORD _CNV_R_R_Umr_1_zu_1_2_CM_S2 1 0 -40 500 FORMAT "%2.0" ECU_ADDRESS 0xFFF90BFC /end MEASUREMENT
/begin MEASUREMENT TEMP_KUP_B_ROH "" SWORD _CNV_R_R_Umr_1_zu_1_2_CM_S2 1 0 -40 500 FORMAT "%2.0" ECU_ADDRESS 0xFFF90BFE /end MEASUREMENT
/begin MEASUREMENT TEMP_KUP_C_ROH "" SWORD _CNV_R_R_Umr_1_zu_1_2_CM_S2 1 0 -40 500 FORMAT "%2.0" ECU_ADDRESS 0xFFF90C00 /end MEASUREMENT
/begin MEASUREMENT TEMP_KUP_D_ROH "" SWORD _CNV_R_R_Umr_1_zu_1_2_CM_S2 1 0 -40 500 FORMAT "%2.0" ECU_ADDRESS 0xFFF90C02 /end MEASUREMENT
/begin MEASUREMENT TEMP_KUP_E_ROH "" SWORD _CNV_R_R_Umr_1_zu_1_2_CM_S2 1 0 -40 500 FORMAT "%2.0" ECU_ADDRESS 0xFFF90C04 /end MEASUREMENT
/begin MEASUREMENT TEMP_MOT_ROH "" UBYTE _CNV_R_R_Umr_1_zu_1_2_CM_S2 1 0 0 255 ECU_ADDRESS 0xFFF913C3 /end MEASUREMENT
/begin MEASUREMENT TEMP_UMG_ROH "" UBYTE _CNV_R_R_Umr_1_zu_1_2_CM_S2 1 0 0 255 ECU_ADDRESS 0xFFF913C4 /end MEASUREMENT
/begin MEASUREMENT T_HSZEIT_ROH "" UWORD _CNV_R_R_Umr_1_zu_1_6_CM_S2 1 0 0 5000 FORMAT "%2.0" ECU_ADDRESS 0xFFF90C06 /end MEASUREMENT
/begin MEASUREMENT V_FZG_COG_ROH "" UWORD _CNV_R_R_Umr_1_zu_1_2_CM_S2 1 0 0 22400 ECU_ADDRESS 0xFFF90C08 /end MEASUREMENT
/begin MEASUREMENT V_RAD_HL_ROH "" UWORD _CNV_R_R_Umr_1_zu_1_2_CM_S2 1 0 0 65535 ECU_ADDRESS 0xFFF90C0A /end MEASUREMENT
/begin MEASUREMENT V_RAD_HR_ROH "" UWORD _CNV_R_R_Umr_1_zu_1_2_CM_S2 1 0 0 65535 ECU_ADDRESS 0xFFF90C0C /end MEASUREMENT
/begin MEASUREMENT V_RAD_VL_ROH "" UWORD _CNV_R_R_Umr_1_zu_1_2_CM_S2 1 0 0 65535 ECU_ADDRESS 0xFFF90C0E /end MEASUREMENT
/begin MEASUREMENT V_RAD_VR_ROH "" UWORD _CNV_R_R_Umr_1_zu_1_2_CM_S2 1 0 0 65535 ECU_ADDRESS 0xFFF90C10 /end MEASUREMENT
/begin MEASUREMENT W_DK_REAL_ROH "" UBYTE _CNV_R_R_Umr_1_zu_1_2_CM_S2 1 0 0 255 FORMAT "%2.0" ECU_ADDRESS 0xFFF913C5 /end MEASUREMENT
/begin MEASUREMENT W_DK_VIRT_ROH "" UBYTE _CNV_R_R_Umr_1_zu_1_2_CM_S2 1 0 0 255 ECU_ADDRESS 0xFFF913C6 /end MEASUREMENT
/begin MEASUREMENT W_LWVA_EFF_ROH "" UWORD _CNV_R_R_Umr_1_zu_1_2_CM_S2 1 0 0 0 FORMAT "%2.0" ECU_ADDRESS 0xFFF90C12 /end MEASUREMENT
/begin MEASUREMENT W_STEIGUNG_SLOW_ROH "" UWORD _CNV_R_R_Umr_1_zu_1_2_CM_S2 1 0 0 4000 ECU_ADDRESS 0xFFF90C16 /end MEASUREMENT
/begin MEASUREMENT Z_ADAPT_REQ_ROH "" UBYTE _CNV_P_2_A_I_5_CM_S2 1 0 0 255 ECU_ADDRESS 0xFFF913C8 /end MEASUREMENT
/begin MEASUREMENT Z_ANTRIEB_ROH "" UBYTE _CNV_R_R_Umr_1_zu_1_2_CM_S2 1 0 0 255 ECU_ADDRESS 0xFFF913C9 /end MEASUREMENT
/begin MEASUREMENT Z_BLINKEN_ROH "" UBYTE _CNV_R_R_Umr_1_zu_1_2_CM_S2 1 0 0 255 ECU_ADDRESS 0xFFF913B1 /end MEASUREMENT
/begin MEASUREMENT Z_BSMODE_ROH "" UBYTE _CNV_R_R_Umr_1_zu_1_2_CM_S2 1 0 0 255 ECU_ADDRESS 0xFFF913CA /end MEASUREMENT
/begin MEASUREMENT Z_CODIERUNG_OBD_ROH "" UBYTE _CNV_R_R_Umr_1_zu_1_2_CM_S2 1 0 0 255 ECU_ADDRESS 0xFFF913CB /end MEASUREMENT
/begin MEASUREMENT Z_CODIERUNG_ROH "" UBYTE _CNV_R_R_Umr_1_zu_1_2_CM_S2 1 0 0 255 ECU_ADDRESS 0xFFF913CC /end MEASUREMENT
/begin MEASUREMENT Z_DRIVEDYN_ROH "" UWORD _CNV_R_R_Umr_1_zu_1_2_CM_S2 1 0 0 65535 ECU_ADDRESS 0xFFF90C1A /end MEASUREMENT
/begin MEASUREMENT Z_DSC_ROH "" UBYTE _CNV_R_R_Umr_1_zu_1_2_CM_S2 1 0 0 255 ECU_ADDRESS 0xFFF913CE /end MEASUREMENT
/begin MEASUREMENT Z_EFAHRKL_ROH "" UBYTE _CNV_R_R_Umr_1_zu_1_2_CM_S2 1 0 0 5 FORMAT "%2.0" ECU_ADDRESS 0xFFF913CF /end MEASUREMENT
/begin MEASUREMENT Z_EGS_REAKTION_N_RED_ROH "" UBYTE _CNV_R_R_Umr_1_zu_1_2_CM_S2 1 0 0 255 ECU_ADDRESS 0xFFF913D0 /end MEASUREMENT
/begin MEASUREMENT Z_EIN_TRAKTION_ROH "" UBYTE _CNV_R_R_Umr_1_zu_1_2_CM_S2 1 0 0 255 ECU_ADDRESS 0xFFF9139C /end MEASUREMENT
/begin MEASUREMENT Z_FBIT_FELD "" UBYTE _CNV_P_2_A_I_5_CM_S2 1 0 0 255 ARRAY_SIZE 33 ECU_ADDRESS 0xFFF91606 MATRIX_DIM 33 1 1 /end MEASUREMENT
/begin MEASUREMENT Z_FZG_ANH_ROH "" UBYTE _CNV_R_R_Umr_1_zu_1_2_CM_S2 1 0 0 255 ECU_ADDRESS 0xFFF9139D /end MEASUREMENT
/begin MEASUREMENT Z_GANG_DEFAULT_ROH "" UBYTE _CNV_S_11_Enum_EGANG_89_CM_S2 1 0 1 13 ECU_ADDRESS 0xFFF913D1 /end MEASUREMENT
/begin MEASUREMENT Z_GANG_IST_ROH "" UBYTE _CNV_S_11_Enum_EGANG_89_CM_S2 1 0 1 13 ECU_ADDRESS 0xFFF913D2 /end MEASUREMENT
/begin MEASUREMENT Z_GANG_ZIEL_AGS_ROH "" UBYTE _CNV_S_11_Enum_EGANG_89_CM_S2 1 0 1 13 ECU_ADDRESS 0xFFF913D3 /end MEASUREMENT
/begin MEASUREMENT Z_GANG_ZIEL_ROH "" UBYTE _CNV_S_11_Enum_EGANG_89_CM_S2 1 0 1 13 ECU_ADDRESS 0xFFF913D4 /end MEASUREMENT
/begin MEASUREMENT Z_GEARREDUCTION_ROH "" UBYTE _CNV_S_7_Enum_EGEAR_267_CM_S2 1 0 0 6 ECU_ADDRESS 0xFFF913D5 /end MEASUREMENT
/begin MEASUREMENT Z_HAS_IST_ROH "" UBYTE _CNV_R_R_Umr_1_zu_1_2_CM_S2 1 0 0 255 ECU_ADDRESS 0xFFF913D6 /end MEASUREMENT
/begin MEASUREMENT Z_HAS_ZIEL_ROH "" UBYTE _CNV_R_R_Umr_1_zu_1_2_CM_S2 1 0 0 255 ECU_ADDRESS 0xFFF913D7 /end MEASUREMENT
/begin MEASUREMENT Z_HDC_ROH "" UBYTE _CNV_R_R_Umr_1_zu_1_2_CM_S2 1 0 0 255 ECU_ADDRESS 0xFFF9139E /end MEASUREMENT
/begin MEASUREMENT Z_HOTMODE_ROH "" UBYTE _CNV_R_R_Umr_1_zu_1_2_CM_S2 1 0 0 255 ECU_ADDRESS 0xFFF913D9 /end MEASUREMENT
/begin MEASUREMENT Z_INFS_ROH "" UBYTE _CNV_P_2_A_I_5_CM_S2 1 0 0 255 ECU_ADDRESS 0xFFF9139F /end MEASUREMENT
/begin MEASUREMENT Z_K0_IST_ROH "" UBYTE _CNV_R_R_Umr_1_zu_1_2_CM_S2 1 0 0 255 ECU_ADDRESS 0xFFF913DA /end MEASUREMENT
/begin MEASUREMENT Z_K0_ZIEL_ROH "" UBYTE _CNV_R_R_Umr_1_zu_1_2_CM_S2 1 0 0 255 ECU_ADDRESS 0xFFF913DB /end MEASUREMENT
/begin MEASUREMENT Z_LDMMOD_ROH "" UBYTE _CNV_S_7_Enum_ELDMM_80_CM_S2 1 0 0 15 ECU_ADDRESS 0xFFF913A6 /end MEASUREMENT
/begin MEASUREMENT Z_LDM_DYNAMIC2_ROH "" UBYTE _CNV_R_R_Umr_1_zu_1_2_CM_S2 1 0 0 1 FORMAT "%2.0" ECU_ADDRESS 0xFFF913A0 /end MEASUREMENT
/begin MEASUREMENT Z_LDM_DYNAMIC_ROH "" UBYTE _CNV_R_R_Umr_1_zu_1_2_CM_S2 1 0 0 15 FORMAT "%2.0" ECU_ADDRESS 0xFFF913A7 /end MEASUREMENT
/begin MEASUREMENT Z_LWVA_EFF_STAT_ROH "" UBYTE _CNV_R_R_Umr_1_zu_1_2_CM_S2 1 0 0 255 ECU_ADDRESS 0xFFF913A1 /end MEASUREMENT
/begin MEASUREMENT Z_MOTOR_NOTLAUF_ROH "" UBYTE _CNV_S_3_Enum_ENOTL_18_CM_S2 1 0 0 2 ECU_ADDRESS 0xFFF913A2 /end MEASUREMENT
/begin MEASUREMENT Z_MOTSTART_TYP_ROH "" UBYTE _CNV_R_R_Umr_1_zu_1_2_CM_S2 1 0 0 255 FORMAT "%2.0" ECU_ADDRESS 0xFFF913DD /end MEASUREMENT
/begin MEASUREMENT Z_NABNEGATIV_ROH "" UBYTE _CNV_R_R_Umr_1_zu_1_2_CM_S2 1 0 0 255 ECU_ADDRESS 0xFFF913DE /end MEASUREMENT
/begin MEASUREMENT Z_POS_ROH "" UBYTE _CNV_R_R_Umr_1_zu_1_2_CM_S2 1 0 0 255 ECU_ADDRESS 0xFFF913E0 /end MEASUREMENT
/begin MEASUREMENT Z_POS_STAT_ROH "" UBYTE _CNV_S_3_Enum_EPOSS_268_CM_S2 1 0 0 2 ECU_ADDRESS 0xFFF913E1 /end MEASUREMENT
/begin MEASUREMENT Z_PROG_MODE_ROH "" UBYTE _CNV_S_4_Enum_EPROG_35_CM_S2 1 0 0 3 ECU_ADDRESS 0xFFF913E2 /end MEASUREMENT
/begin MEASUREMENT Z_REG_ABS_ROH "" UBYTE _CNV_R_R_Umr_1_zu_1_2_CM_S2 1 0 0 255 ECU_ADDRESS 0xFFF913E3 /end MEASUREMENT
/begin MEASUREMENT Z_REQUEST_LPA_ROH "" UBYTE _CNV_R_R_Umr_1_zu_1_2_CM_S2 1 0 0 255 FORMAT "%2.0" ECU_ADDRESS 0xFFF913E4 /end MEASUREMENT
/begin MEASUREMENT Z_SERAP_ASRS_ROH "" UBYTE _CNV_P_2_A_I_5_CM_S2 1 0 0 255 ECU_ADDRESS 0xFFF913E5 /end MEASUREMENT
/begin MEASUREMENT Z_SOC_MODE_ROH "" UBYTE _CNV_R_R_Umr_1_zu_1_2_CM_S2 1 0 0 255 ECU_ADDRESS 0xFFF913E6 /end MEASUREMENT
/begin MEASUREMENT Z_SOC_ROH "" UBYTE _CNV_R_R_Umr_1_zu_1_2_CM_S2 1 0 0 255 ECU_ADDRESS 0xFFF913E7 /end MEASUREMENT
/begin MEASUREMENT Z_SPA_REGEN_ROH "" UBYTE _CNV_R_R_Umr_1_zu_1_2_CM_S2 1 0 0 255 ECU_ADDRESS 0xFFF913E8 /end MEASUREMENT
/begin MEASUREMENT Z_STATUS_ANTRIEB_FZG_ROH "" UBYTE _CNV_R_R_Umr_1_zu_1_2_CM_S2 1 0 0 255 ECU_ADDRESS 0xFFF913E9 /end MEASUREMENT
/begin MEASUREMENT Z_WARMLAUF_ROH "" UBYTE _CNV_R_R_Umr_1_zu_1_2_CM_S2 1 0 0 255 ECU_ADDRESS 0xFFF913A3 /end MEASUREMENT
/begin MEASUREMENT A_L_REF "" SWORD _CNV_R_R_Umr_32_zu__202_CM_S2 1 0 -50 50 FORMAT "%4.2" ECU_ADDRESS 0xFFF90B28 /end MEASUREMENT
/begin MEASUREMENT A_Q_REF "" SWORD _CNV_R_R_Umr_32_zu__202_CM_S2 1 0 -50 50 FORMAT "%4.2" ECU_ADDRESS 0xFFF90B2A /end MEASUREMENT
/begin MEASUREMENT C_NAVGRAPH_MAPDATA "" UBYTE _CNV_R_R_Umr_1_zu_1_2_CM_S2 1 0 0 255 FORMAT "%2.0" ECU_ADDRESS 0xFFF91323 /end MEASUREMENT
/begin MEASUREMENT C_NAVGRAPH_SYNC "" UBYTE _CNV_R_R_Umr_1_zu_1_2_CM_S2 1 0 0 255 FORMAT "%2.0" ECU_ADDRESS 0xFFF91324 /end MEASUREMENT
/begin MEASUREMENT GW_GIER "" SWORD _CNV_R_R_Umr_20_zu__203_CM_S2 1 0 -100 100 FORMAT "%4.2" ECU_ADDRESS 0xFFF90B2C /end MEASUREMENT
/begin MEASUREMENT IG_HA "" UWORD _CNV_R_R_Umr_100_zu_54_CM_S2 1 0 1 10 FORMAT "%4.2" ECU_ADDRESS 0xFFF90B30 /end MEASUREMENT
/begin MEASUREMENT MASSE_FZG_EST "" UWORD _CNV_R_R_Umr_1_zu_1_270_CM_S2 1 0 0 8188 FORMAT "%2.0" ECU_ADDRESS 0xFFF90B32 /end MEASUREMENT
/begin MEASUREMENT M_AB_DYN "" SWORD _CNV_R_R_Umr_1_zu_1_42_CM_S2 1 0 -32768 32767 FORMAT "%2.0" ECU_ADDRESS 0xFFF90B34 /end MEASUREMENT
/begin MEASUREMENT M_BR "" SWORD _CNV_R_R_Umr_1_zu_1_42_CM_S2 1 0 -32768 32767 FORMAT "%2.0" ECU_ADDRESS 0xFFF90B36 /end MEASUREMENT
/begin MEASUREMENT M_BR_CAN "" SWORD _CNV_R_R_Umr_1_zu_1_42_CM_S2 1 0 -32768 32767 FORMAT "%2.0" ECU_ADDRESS 0xFFF90B38 /end MEASUREMENT
/begin MEASUREMENT M_BR_SOLL "" SWORD _CNV_R_R_Umr_1_zu_1_42_CM_S2 1 0 -32000 0 FORMAT "%2.0" ECU_ADDRESS 0xFFF90B3A /end MEASUREMENT
/begin MEASUREMENT M_EM "" SWORD _CNV_R_R_Umr_1_zu_1_42_CM_S2 1 0 -8192 8192 FORMAT "%2.0" ECU_ADDRESS 0xFFF90B3C /end MEASUREMENT
/begin MEASUREMENT M_EM_MAXKURZ_PRED "" SWORD _CNV_R_R_Umr_1_zu_1_42_CM_S2 1 0 -1023.5 1023.5 FORMAT "%3.1" ECU_ADDRESS 0xFFF90B3E /end MEASUREMENT
/begin MEASUREMENT M_EM_MAXLANG_PRED "" SWORD _CNV_R_R_Umr_1_zu_1_42_CM_S2 1 0 -1023.5 1023.5 FORMAT "%3.1" ECU_ADDRESS 0xFFF90B40 /end MEASUREMENT
/begin MEASUREMENT M_EM_MINKURZ_PRED "" SWORD _CNV_R_R_Umr_1_zu_1_42_CM_S2 1 0 -1023.5 1023.5 FORMAT "%3.1" ECU_ADDRESS 0xFFF90B42 /end MEASUREMENT
/begin MEASUREMENT M_EM_MINLANG_PRED "" SWORD _CNV_R_R_Umr_1_zu_1_42_CM_S2 1 0 -1023.5 1023.5 FORMAT "%3.1" ECU_ADDRESS 0xFFF90B44 /end MEASUREMENT
/begin MEASUREMENT M_MOT_DMEE "" SWORD _CNV_R_R_Umr_1_zu_1_42_CM_S2 1 0 -8192 8192 FORMAT "%2.0" ECU_ADDRESS 0xFFF90B4C /end MEASUREMENT
/begin MEASUREMENT M_MOT_FW "" SWORD _CNV_R_R_Umr_1_zu_1_42_CM_S2 1 0 -8192 8192 FORMAT "%2.0" ECU_ADDRESS 0xFFF90B4E /end MEASUREMENT
/begin MEASUREMENT M_MOT_IST "" SWORD _CNV_R_R_Umr_1_zu_1_42_CM_S2 1 0 -8192 8192 FORMAT "%2.0" ECU_ADDRESS 0xFFF90B50 /end MEASUREMENT
/begin MEASUREMENT M_MOT_MAXDME "" SWORD _CNV_R_R_Umr_1_zu_1_42_CM_S2 1 0 -8192 8192 FORMAT "%2.0" ECU_ADDRESS 0xFFF90B52 /end MEASUREMENT
/begin MEASUREMENT M_MOT_REIB "" SWORD _CNV_R_R_Umr_1_zu_1_42_CM_S2 1 0 -32768 32767 FORMAT "%2.0" ECU_ADDRESS 0xFFF90B54 /end MEASUREMENT
/begin MEASUREMENT M_MOT_STAT "" SWORD _CNV_R_R_Umr_1_zu_1_42_CM_S2 1 0 -32768 32767 FORMAT "%2.0" ECU_ADDRESS 0xFFF90B56 /end MEASUREMENT
/begin MEASUREMENT M_RAD_HDC_SOLL "" SWORD _CNV_R_R_Umr_1_zu_1_42_CM_S2 1 0 -32768 32767 FORMAT "%2.0" ECU_ADDRESS 0xFFF90B58 /end MEASUREMENT
/begin MEASUREMENT M_RAD_IST "" SWORD _CNV_R_R_Umr_1_zu_1_42_CM_S2 1 0 -32000 32000 FORMAT "%2.0" ECU_ADDRESS 0xFFF90B5A /end MEASUREMENT
/begin MEASUREMENT M_RAD_REKUPMAX_IST "" SWORD _CNV_R_R_Umr_1_zu_1_42_CM_S2 1 0 -32000 32000 FORMAT "%2.0" ECU_ADDRESS 0xFFF90B46 /end MEASUREMENT
/begin MEASUREMENT M_RAD_REKUPMAX_PRED "" SWORD _CNV_R_R_Umr_1_zu_1_42_CM_S2 1 0 -32000 0 FORMAT "%2.0" ECU_ADDRESS 0xFFF90B48 /end MEASUREMENT
/begin MEASUREMENT M_RAD_REKUP_SOLL "" SWORD _CNV_R_R_Umr_1_zu_1_42_CM_S2 1 0 -32000 32000 FORMAT "%2.0" ECU_ADDRESS 0xFFF90B4A /end MEASUREMENT
/begin MEASUREMENT M_RAD_SCHLEPPUNT_IST "" SWORD _CNV_R_R_Umr_1_zu_1_42_CM_S2 1 0 -32000 32000 FORMAT "%2.0" ECU_ADDRESS 0xFFF90B5C /end MEASUREMENT
/begin MEASUREMENT M_RAD_WUNSCH "" SWORD _CNV_R_R_Umr_1_zu_1_42_CM_S2 1 0 -32768 32767 FORMAT "%2.0" ECU_ADDRESS 0xFFF90B5E /end MEASUREMENT
/begin MEASUREMENT M_T "" SWORD _CNV_R_R_Umr_1_zu_1_42_CM_S2 1 0 -32000 32000 FORMAT "%2.0" ECU_ADDRESS 0xFFF90B62 /end MEASUREMENT
/begin MEASUREMENT M_VM "" SWORD _CNV_R_R_Umr_1_zu_1_42_CM_S2 1 0 -1024 1024 FORMAT "%2.0" ECU_ADDRESS 0xFFF90B64 /end MEASUREMENT
/begin MEASUREMENT N_AB "" UWORD _CNV_R_R_Umr_1_zu_1_3_CM_S2 1 0 0 20000 FORMAT "%2.0" ECU_ADDRESS 0xFFF90B66 /end MEASUREMENT
/begin MEASUREMENT N_AB_UNFILT "" UWORD _CNV_R_R_Umr_1_zu_1_3_CM_S2 1 0 0 20000 FORMAT "%2.0" ECU_ADDRESS 0xFFF90B68 /end MEASUREMENT
/begin MEASUREMENT N_EM "" SWORD _CNV_R_R_Umr_1_zu_1_3_CM_S2 1 0 -5000 27767 FORMAT "%2.0" ECU_ADDRESS 0xFFF90B6A /end MEASUREMENT
/begin MEASUREMENT N_MOT_ABREGEL "" UWORD _CNV_R_R_Umr_1_zu_1_3_CM_S2 1 0 0 10000 FORMAT "%2.0" ECU_ADDRESS 0xFFF90B6E /end MEASUREMENT
/begin MEASUREMENT N_MOT_BEGR "" UWORD _CNV_R_R_Umr_1_zu_1_3_CM_S2 1 0 0 10000 FORMAT "%2.0" ECU_ADDRESS 0xFFF90B70 /end MEASUREMENT
/begin MEASUREMENT N_MOT_SOLLLL "" UWORD _CNV_R_R_Umr_1_zu_1_3_CM_S2 1 0 0 3000 FORMAT "%2.0" ECU_ADDRESS 0xFFF90B72 /end MEASUREMENT
/begin MEASUREMENT N_T "" UWORD _CNV_R_R_Umr_1_zu_1_3_CM_S2 1 0 0 20000 FORMAT "%2.0" ECU_ADDRESS 0xFFF90B74 /end MEASUREMENT
/begin MEASUREMENT N_VM "" UWORD _CNV_R_R_Umr_1_zu_1_3_CM_S2 1 0 0 20000 FORMAT "%2.0" ECU_ADDRESS 0xFFF9105A /end MEASUREMENT
/begin MEASUREMENT N_VM_ALT "" UWORD _CNV_R_R_Umr_1_zu_1_3_CM_S2 1 0 0 20000 FORMAT "%2.0" ECU_ADDRESS 0xFFF9105C /end MEASUREMENT
/begin MEASUREMENT P_BR "" UWORD _CNV_R_R_Umr_2_zu_1_238_CM_S2 1 0 0 32767 FORMAT "%3.1" ECU_ADDRESS 0xFFF90B76 /end MEASUREMENT
/begin MEASUREMENT P_LUFT "" UWORD _CNV_R_R_Umr_1_zu_1_0_CM_S2 1 0 598 1108 FORMAT "%2.0" ECU_ADDRESS 0xFFF90B78 /end MEASUREMENT
/begin MEASUREMENT QA_L_REF "" UBYTE _CNV_S_3_Enum_EQ_79_CM_S2 1 0 0 2 ECU_ADDRESS 0xFFF91325 /end MEASUREMENT
/begin MEASUREMENT QA_Q_REF "" UBYTE _CNV_S_3_Enum_EQ_79_CM_S2 1 0 0 2 ECU_ADDRESS 0xFFF91326 /end MEASUREMENT
/begin MEASUREMENT QGW_GIER "" UBYTE _CNV_S_3_Enum_EQ_79_CM_S2 1 0 0 2 ECU_ADDRESS 0xFFF91327 /end MEASUREMENT
/begin MEASUREMENT QMASSE_FZG_EST "" UBYTE _CNV_S_3_Enum_EQ_79_CM_S2 1 0 0 2 ECU_ADDRESS 0xFFF91328 /end MEASUREMENT
/begin MEASUREMENT QM_BR "" UBYTE _CNV_S_3_Enum_EQ_79_CM_S2 1 0 0 2 ECU_ADDRESS 0xFFF91329 /end MEASUREMENT
/begin MEASUREMENT QM_BR_SOLL "" UBYTE _CNV_S_3_Enum_EQ_79_CM_S2 1 0 0 2 ECU_ADDRESS 0xFFF9132A /end MEASUREMENT
/begin MEASUREMENT QM_MOT_MAXDME "" UBYTE _CNV_S_3_Enum_EQ_79_CM_S2 1 0 0 2 ECU_ADDRESS 0xFFF9132B /end MEASUREMENT
/begin MEASUREMENT QM_RAD_IST "" UBYTE _CNV_S_3_Enum_EQ_79_CM_S2 1 0 0 2 ECU_ADDRESS 0xFFF9132C /end MEASUREMENT
/begin MEASUREMENT QN_MOT_SOLLLL "" UBYTE _CNV_S_3_Enum_EQ_79_CM_S2 1 0 0 2 ECU_ADDRESS 0xFFF9132D /end MEASUREMENT
/begin MEASUREMENT QN_T "" UBYTE _CNV_S_3_Enum_EQ_79_CM_S2 1 0 0 2 ECU_ADDRESS 0xFFF9132E /end MEASUREMENT
/begin MEASUREMENT QP_BR "" UBYTE _CNV_S_3_Enum_EQ_79_CM_S2 1 0 0 2 ECU_ADDRESS 0xFFF9132F /end MEASUREMENT
/begin MEASUREMENT QV_FZG_COG "" UBYTE _CNV_S_3_Enum_EQ_79_CM_S2 1 0 0 2 ECU_ADDRESS 0xFFF91330 /end MEASUREMENT
/begin MEASUREMENT QV_RAD_HL "" UBYTE _CNV_S_3_Enum_EQ_79_CM_S2 1 0 0 2 ECU_ADDRESS 0xFFF91331 /end MEASUREMENT
/begin MEASUREMENT QV_RAD_HR "" UBYTE _CNV_S_3_Enum_EQ_79_CM_S2 1 0 0 2 ECU_ADDRESS 0xFFF91332 /end MEASUREMENT
/begin MEASUREMENT QV_RAD_VL "" UBYTE _CNV_S_3_Enum_EQ_79_CM_S2 1 0 0 2 ECU_ADDRESS 0xFFF91333 /end MEASUREMENT
/begin MEASUREMENT QV_RAD_VR "" UBYTE _CNV_S_3_Enum_EQ_79_CM_S2 1 0 0 2 ECU_ADDRESS 0xFFF91334 /end MEASUREMENT
/begin MEASUREMENT QW_STEIGUNG "" UBYTE _CNV_S_3_Enum_EQ_79_CM_S2 1 0 0 2 ECU_ADDRESS 0xFFF91335 /end MEASUREMENT
/begin MEASUREMENT Q_NAVGRAPH_MATCH "" UBYTE _CNV_S_3_Enum_EQ_79_CM_S2 1 0 0 2 ECU_ADDRESS 0xFFF91336 /end MEASUREMENT
/begin MEASUREMENT R_RAD_DYN "" UWORD _CNV_R_R_Umr_1_zu_1_2_CM_S2 1 0 159 436 FORMAT "%2.0" ECU_ADDRESS 0xFFF90B7A /end MEASUREMENT
/begin MEASUREMENT S_AEP_REQ "" UBYTE _CNV_S_2_Schalter_A_4_CM_S2 1 0 0 1 ECU_ADDRESS 0xFFF91338 /end MEASUREMENT
/begin MEASUREMENT S_ALLRAD "" UBYTE _CNV_R_R_Umr_1_zu_1_2_CM_S2 1 0 0 1 FORMAT "%2.0" ECU_ADDRESS 0xFFF915E0 /end MEASUREMENT
/begin MEASUREMENT S_B "" UBYTE _CNV_S_3_Enum_EB_ST_256_CM_S2 1 0 0 2 ECU_ADDRESS 0xFFF91339 /end MEASUREMENT
/begin MEASUREMENT S_B_AGS "" UBYTE _CNV_S_3_Enum_EB_ST_256_CM_S2 1 0 0 2 ECU_ADDRESS 0xFFF9133A /end MEASUREMENT
/begin MEASUREMENT S_COD_ALLRAD "" UBYTE _CNV_S_2_Schalter_A_4_CM_S2 1 0 0 1 ECU_ADDRESS 0xFFF915E1 /end MEASUREMENT
/begin MEASUREMENT S_DRIVEDYN_VALID "" UBYTE _CNV_R_R_Umr_1_zu_1_2_CM_S2 1 0 0 255 FORMAT "%2.0" ECU_ADDRESS 0xFFF915EC /end MEASUREMENT
/begin MEASUREMENT S_ECO_ERK "" UBYTE _CNV_P_2_A_I_5_CM_S2 1 0 0 255 ECU_ADDRESS 0xFFF915F0 /end MEASUREMENT
/begin MEASUREMENT S_EM_DAEMPFUNG "" UBYTE _CNV_S_2_Schalter_A_4_CM_S2 1 0 0 1 ECU_ADDRESS 0xFFF9133B /end MEASUREMENT
/begin MEASUREMENT S_ERR_ASC "" UBYTE _CNV_P_2_A_I_5_CM_S2 1 0 0 255 ECU_ADDRESS 0xFFF9133C /end MEASUREMENT
/begin MEASUREMENT S_ERR_DSC "" UBYTE _CNV_S_2_Enum_ERRDS_271_CM_S2 1 0 0 1 ECU_ADDRESS 0xFFF9133D /end MEASUREMENT
/begin MEASUREMENT S_ERR_DSC_ALT "" UBYTE _CNV_S_2_Enum_ERRDS_271_CM_S2 1 0 0 1 ECU_ADDRESS 0xFFF91681 /end MEASUREMENT
/begin MEASUREMENT S_ERR_DSC_ROLLECAN "" UBYTE _CNV_S_3_Enum_ERRDS_86_CM_S2 1 0 0 2 ECU_ADDRESS 0xFFF9133E /end MEASUREMENT
/begin MEASUREMENT S_FDC "" UBYTE _CNV_P_2_A_I_5_CM_S2 1 0 0 255 ECU_ADDRESS 0xFFF9133F /end MEASUREMENT
/begin MEASUREMENT S_FDC_REAL "" UBYTE _CNV_P_2_A_I_5_CM_S2 1 0 0 255 ECU_ADDRESS 0xFFF91340 /end MEASUREMENT
/begin MEASUREMENT S_KD "" UBYTE _CNV_P_2_A_I_5_CM_S2 1 0 0 255 ECU_ADDRESS 0xFFF91341 /end MEASUREMENT
/begin MEASUREMENT S_MINUS "" UBYTE _CNV_P_2_A_I_5_CM_S2 1 0 0 255 ECU_ADDRESS 0xFFF91683 /end MEASUREMENT
/begin MEASUREMENT S_MINUS_GWS "" UBYTE _CNV_P_2_A_I_5_CM_S2 1 0 0 255 ECU_ADDRESS 0xFFF91342 /end MEASUREMENT
/begin MEASUREMENT S_MINUS_PADDLE "" UBYTE _CNV_P_2_A_I_5_CM_S2 1 0 0 255 ECU_ADDRESS 0xFFF91685 /end MEASUREMENT
/begin MEASUREMENT S_MSA_STAT "" UBYTE _CNV_S_2_Schalter_A_4_CM_S2 1 0 0 1 ECU_ADDRESS 0xFFF91343 /end MEASUREMENT
/begin MEASUREMENT S_NSC_REQ "" UBYTE _CNV_S_2_Schalter_A_4_CM_S2 1 0 0 1 ECU_ADDRESS 0xFFF91344 /end MEASUREMENT
/begin MEASUREMENT S_OVERRIDE_GANG "" UBYTE _CNV_P_2_A_I_5_CM_S2 1 0 0 255 ECU_ADDRESS 0xFFF91345 /end MEASUREMENT
/begin MEASUREMENT S_PADDLE_AUS "" UBYTE _CNV_S_2_Schalter_A_4_CM_S2 1 0 0 1 ECU_ADDRESS 0xFFF91689 /end MEASUREMENT
/begin MEASUREMENT S_PADDLE_TIMER "" UBYTE _CNV_S_2_Schalter_A_4_CM_S2 1 0 0 1 ECU_ADDRESS 0xFFF9168A /end MEASUREMENT
/begin MEASUREMENT S_PLUS "" UBYTE _CNV_P_2_A_I_5_CM_S2 1 0 0 255 ECU_ADDRESS 0xFFF9168B /end MEASUREMENT
/begin MEASUREMENT S_PLUS_GWS "" UBYTE _CNV_P_2_A_I_5_CM_S2 1 0 0 255 ECU_ADDRESS 0xFFF91346 /end MEASUREMENT
/begin MEASUREMENT S_PLUS_PADDLE "" UBYTE _CNV_P_2_A_I_5_CM_S2 1 0 0 255 ECU_ADDRESS 0xFFF9168D /end MEASUREMENT
/begin MEASUREMENT S_PMA "" UBYTE _CNV_R_R_Umr_1_zu_1_2_CM_S2 1 0 0 1 ECU_ADDRESS 0xFFF9165A /end MEASUREMENT
/begin MEASUREMENT S_PMA_ENBL "" UBYTE _CNV_R_R_Umr_1_zu_1_2_CM_S2 1 0 0 1 ECU_ADDRESS 0xFFF9165B /end MEASUREMENT
/begin MEASUREMENT S_PMA_ERK "" UBYTE _CNV_R_R_Umr_1_zu_1_2_CM_S2 1 0 0 1 ECU_ADDRESS 0xFFF9165C /end MEASUREMENT
/begin MEASUREMENT S_REG_ASC "" UBYTE _CNV_P_2_A_I_5_CM_S2 1 0 0 255 ECU_ADDRESS 0xFFF91347 /end MEASUREMENT
/begin MEASUREMENT S_RENNSTART "" UBYTE _CNV_S_2_Schalter_A_4_CM_S2 1 0 0 1 ECU_ADDRESS 0xFFF91348 /end MEASUREMENT
/begin MEASUREMENT S_ROLLE_CAN "" UBYTE _CNV_S_2_Schalter_A_4_CM_S2 1 0 0 1 ECU_ADDRESS 0xFFF91349 /end MEASUREMENT
/begin MEASUREMENT S_SCHALTVERZUG "" UBYTE _CNV_S_2_Schalter_A_4_CM_S2 1 0 0 1 ECU_ADDRESS 0xFFF9134A /end MEASUREMENT
/begin MEASUREMENT S_SPA_REGEN "" UBYTE _CNV_S_2_Schalter_A_4_CM_S2 1 0 0 1 ECU_ADDRESS 0xFFF9134B /end MEASUREMENT
/begin MEASUREMENT S_TID_EFAHREN_ERK "" UBYTE _CNV_R_R_Umr_1_zu_1_2_CM_S2 1 0 0 1 FORMAT "%2.0" ECU_ADDRESS 0xFFF9168E /end MEASUREMENT
/begin MEASUREMENT S_TRPMOD "" UBYTE _CNV_R_R_Umr_1_zu_1_2_CM_S2 1 0 0 1 ECU_ADDRESS 0xFFF9134C /end MEASUREMENT
/begin MEASUREMENT S_VFZG_PLAUSI "" UBYTE _CNV_S_2_Schalter_A_4_CM_S2 1 0 0 1 ECU_ADDRESS 0xFFF9134D /end MEASUREMENT
/begin MEASUREMENT S_ZIELGANG_AGS_SKLDMRS "" UBYTE _CNV_R_R_Umr_1_zu_1_2_CM_S2 1 0 0 255 ECU_ADDRESS 0xFFF9134E /end MEASUREMENT
/begin MEASUREMENT TASKZEIT "" UWORD _CNV_R_R_Umr_1_zu_1_6_CM_S2 1 0 0 65535 FORMAT "%2.0" ECU_ADDRESS 0xFFF90BAC /end MEASUREMENT
/begin MEASUREMENT TEMP_EM "" SWORD _CNV_R_R_Umr_1_zu_1_1_CM_S2 1 0 -50 220 FORMAT "%2.0" ECU_ADDRESS 0xFFF90B7C /end MEASUREMENT
/begin MEASUREMENT TEMP_GETR "" SWORD _CNV_R_R_Umr_1_zu_1_1_CM_S2 1 0 -200 200 FORMAT "%2.0" ECU_ADDRESS 0xFFF90B7E /end MEASUREMENT
/begin MEASUREMENT TEMP_KUP_A "" SWORD _CNV_R_R_Umr_1_zu_1_1_CM_S2 1 0 -40 500 FORMAT "%2.0" ECU_ADDRESS 0xFFF90B80 /end MEASUREMENT
/begin MEASUREMENT TEMP_KUP_B "" SWORD _CNV_R_R_Umr_1_zu_1_1_CM_S2 1 0 -40 500 FORMAT "%2.0" ECU_ADDRESS 0xFFF90B82 /end MEASUREMENT
/begin MEASUREMENT TEMP_KUP_C "" SWORD _CNV_R_R_Umr_1_zu_1_1_CM_S2 1 0 -40 500 FORMAT "%2.0" ECU_ADDRESS 0xFFF90B84 /end MEASUREMENT
/begin MEASUREMENT TEMP_KUP_D "" SWORD _CNV_R_R_Umr_1_zu_1_1_CM_S2 1 0 -40 500 FORMAT "%2.0" ECU_ADDRESS 0xFFF90B86 /end MEASUREMENT
/begin MEASUREMENT TEMP_KUP_E "" SWORD _CNV_R_R_Umr_1_zu_1_1_CM_S2 1 0 -40 500 FORMAT "%2.0" ECU_ADDRESS 0xFFF90B88 /end MEASUREMENT
/begin MEASUREMENT TEMP_MOT "" SWORD _CNV_R_R_Umr_1_zu_1_1_CM_S2 1 0 -200 200 FORMAT "%2.0" ECU_ADDRESS 0xFFF90B8A /end MEASUREMENT
/begin MEASUREMENT TEMP_UMG "" SWORD _CNV_R_R_Umr_1_zu_1_1_CM_S2 1 0 -50 220 FORMAT "%2.0" ECU_ADDRESS 0xFFF90B8C /end MEASUREMENT
/begin MEASUREMENT T_BUFFER_PADDLE_AUS "" ULONG _CNV_R_R_Umr_1_zu_1_6_CM_S2 1 0 0 4294967295 FORMAT "%2.0" ECU_ADDRESS 0xFFF907BC /end MEASUREMENT
/begin MEASUREMENT T_HSZEIT "" UWORD _CNV_R_R_Umr_1_zu_1_6_CM_S2 1 0 0 5000 FORMAT "%2.0" ECU_ADDRESS 0xFFF90B8E /end MEASUREMENT
/begin MEASUREMENT T_LAYERIN_MSCTR "" ULONG _CNV_R_R_Umr_1_zu_1_6_CM_S2 1 0 0 4294967295 FORMAT "%2.0" ECU_ADDRESS 0xFFF90194 /end MEASUREMENT
/begin MEASUREMENT T_OVERRIDE_GANG "" SWORD _CNV_R_R_Umr_1_zu_1_6_CM_S2 1 0 0 3000 FORMAT "%2.0" ECU_ADDRESS 0xFFF91098 /end MEASUREMENT
/begin MEASUREMENT T_PADDLE_AUS "" ULONG _CNV_R_R_Umr_1_zu_1_6_CM_S2 1 0 0 4294967281 FORMAT "%2.0" ECU_ADDRESS 0xFFF907C0 /end MEASUREMENT
/begin MEASUREMENT T_SOC_MODE_NL "" ULONG _CNV_R_R_Umr_1_zu_1_6_CM_S2 1 0 0 4294967295 FORMAT "%2.0" ECU_ADDRESS 0xFFF90198 /end MEASUREMENT
/begin MEASUREMENT T_TID_EFAHREN "" ULONG _CNV_R_R_Umr_1_zu_1_6_CM_S2 1 0 0 200 FORMAT "%2.0" ECU_ADDRESS 0xFFF907C4 /end MEASUREMENT
/begin MEASUREMENT T_WARTE_POSWECHSEL "" UWORD _CNV_R_R_Umr_1_zu_1_6_CM_S2 1 0 0 30000 FORMAT "%2.0" ECU_ADDRESS 0xFFF90BAE /end MEASUREMENT
/begin MEASUREMENT V_FZG_COG "" UWORD _CNV_R_R_Umr_64_zu__44_CM_S2 1 0 0 350 FORMAT "%4.2" ECU_ADDRESS 0xFFF90B90 /end MEASUREMENT
/begin MEASUREMENT V_FZG_PRD "" UWORD _CNV_R_R_Umr_64_zu__44_CM_S2 1 0 0 1023.984375 FORMAT "%4.2" ECU_ADDRESS 0xFFF90B92 /end MEASUREMENT
/begin MEASUREMENT V_RAD_HL "" UWORD _CNV_R_R_Umr_16_zu__186_CM_S2 1 0 0 400 FORMAT "%4.2" ECU_ADDRESS 0xFFF90B94 /end MEASUREMENT
/begin MEASUREMENT V_RAD_HR "" UWORD _CNV_R_R_Umr_16_zu__186_CM_S2 1 0 0 400 FORMAT "%4.2" ECU_ADDRESS 0xFFF90B96 /end MEASUREMENT
/begin MEASUREMENT V_RAD_VL "" UWORD _CNV_R_R_Umr_16_zu__186_CM_S2 1 0 0 400 FORMAT "%4.2" ECU_ADDRESS 0xFFF90B98 /end MEASUREMENT
/begin MEASUREMENT V_RAD_VR "" UWORD _CNV_R_R_Umr_16_zu__186_CM_S2 1 0 0 400 FORMAT "%4.2" ECU_ADDRESS 0xFFF90B9A /end MEASUREMENT
/begin MEASUREMENT W_DK "" UWORD _CNV_R_R_Umr_10_zu__9_CM_S2 1 0 0 110 FORMAT "%3.1" ECU_ADDRESS 0xFFF90B9C /end MEASUREMENT
/begin MEASUREMENT W_DK_REAL "" UWORD _CNV_R_R_Umr_10_zu__9_CM_S2 1 0 0 110 FORMAT "%3.1" ECU_ADDRESS 0xFFF90B9E /end MEASUREMENT
/begin MEASUREMENT W_DK_VIRT "" UWORD _CNV_R_R_Umr_10_zu__9_CM_S2 1 0 0 110 FORMAT "%3.1" ECU_ADDRESS 0xFFF90BA0 /end MEASUREMENT
/begin COMPU_METHOD _CNV_R_R_Umr_1_zu_1_0_CM_S2 "" RAT_FUNC "%6.3" "hPa" COEFFS 0 1 0 0 0 1 /end COMPU_METHOD
/begin COMPU_METHOD _CNV_R_R_Umr_1_zu_1_1_CM_S2 "" RAT_FUNC "%6.3" "°C" COEFFS 0 1 0 0 0 1 /end COMPU_METHOD
/begin COMPU_METHOD _CNV_R_R_Umr_1_zu_1_2_CM_S2 "" RAT_FUNC "%6.3" "" COEFFS 0 1 0 0 0 1 /end COMPU_METHOD
/begin COMPU_METHOD _CNV_R_R_Umr_1_zu_1_3_CM_S2 "" RAT_FUNC "%6.3" "U/min" COEFFS 0 1 0 0 0 1 /end COMPU_METHOD
/begin COMPU_METHOD _CNV_S_2_Schalter_A_4_CM_S2 "Schalter: 0 = AUS, 1 = EIN" TAB_VERB "%6.3" "" COMPU_TAB_REF _CNV_S_2_Schalter_A_4_S2 /end COMPU_METHOD
/begin COMPU_METHOD _CNV_P_2_A_I_5_CM_S2 "" TAB_INTP "%6.3" "" COMPU_TAB_REF _CNV_P_2_A_I_5_S2 /end COMPU_METHOD
/begin COMPU_METHOD _CNV_R_R_Umr_1_zu_1_6_CM_S2 "" RAT_FUNC "%6.3" "ms" COEFFS 0 1 0 0 0 1 /end COMPU_METHOD
/begin COMPU_METHOD _CNV_R_R_Umr_1_zu_1_7_CM_S2 "" RAT_FUNC "%6.3" "%/s" COEFFS 0 1 0 0 0 1 /end COMPU_METHOD
/begin COMPU_METHOD _CNV_R_R_Umr_1_zu_1_8_CM_S2 "" RAT_FUNC "%6.3" "km/h" COEFFS 0 1 0 0 0 1 /end COMPU_METHOD
/begin COMPU_METHOD _CNV_R_R_Umr_10_zu__9_CM_S2 "" RAT_FUNC "%6.3" "%" COEFFS 0 10 0 0 0 1 /end COMPU_METHOD
/begin COMPU_METHOD _CNV_R_R_Umr_1000_z_12_CM_S2 "" RAT_FUNC "%6.3" "s" COEFFS 0 1000 0 0 0 1 /end COMPU_METHOD
/begin COMPU_METHOD _CNV_S_3_Enum_ENOTL_18_CM_S2 "" TAB_VERB "%6.3" "" COMPU_TAB_REF _CNV_S_3_Enum_ENOTL_18_S2 /end COMPU_METHOD
/begin COMPU_METHOD _CNV_S_2_Enum_ECOD__23_CM_S2 "" TAB_VERB "%6.3" "" COMPU_TAB_REF _CNV_S_2_Enum_ECOD__23_S2 /end COMPU_METHOD
/begin COMPU_METHOD _CNV_S_2_Enum_EAGS_25_CM_S2 "" TAB_VERB "%6.3" "" COMPU_TAB_REF _CNV_S_2_Enum_EAGS_25_S2 /end COMPU_METHOD
/begin COMPU_METHOD _CNV_S_9_Enum_EGANG_30_CM_S2 "" TAB_VERB "%6.3" "" COMPU_TAB_REF _CNV_S_9_Enum_EGANG_30_S2 /end COMPU_METHOD
/begin COMPU_METHOD _CNV_S_8_Enum_EPOS_33_CM_S2 "" TAB_VERB "%6.3" "" COMPU_TAB_REF _CNV_S_8_Enum_EPOS_33_S2 /end COMPU_METHOD
/begin COMPU_METHOD _CNV_S_4_Enum_EPROG_35_CM_S2 "" TAB_VERB "%6.3" "" COMPU_TAB_REF _CNV_S_4_Enum_EPROG_35_S2 /end COMPU_METHOD
/begin COMPU_METHOD _CNV_S_3_Enum_ESCHL_41_CM_S2 "" TAB_VERB "%6.3" "" COMPU_TAB_REF _CNV_S_3_Enum_ESCHL_41_S2 /end COMPU_METHOD
/begin COMPU_METHOD _CNV_R_R_Umr_1_zu_1_42_CM_S2 "" RAT_FUNC "%6.3" "Nm" COEFFS 0 1 0 0 0 1 /end COMPU_METHOD
/begin COMPU_METHOD _CNV_R_R_Umr_64_zu__44_CM_S2 "" RAT_FUNC "%6.3" "km/h" COEFFS 0 64 0 0 0 1 /end COMPU_METHOD
/begin COMPU_METHOD _CNV_R_R_Umr_10_zu__46_CM_S2 "" RAT_FUNC "%6.3" "m/s*s" COEFFS 0 10 0 0 0 1 /end COMPU_METHOD
/begin COMPU_METHOD _CNV_R_R_Umr_1_zu_1_53_CM_S2 "" RAT_FUNC "%6.3" "%" COEFFS 0 1 0 0 0 1 /end COMPU_METHOD
/begin COMPU_METHOD _CNV_R_R_Umr_100_zu_54_CM_S2 "" RAT_FUNC "%6.3" "" COEFFS 0 100 0 0 0 1 /end COMPU_METHOD
/begin COMPU_METHOD _CNV_R_R_Umr_1000_z_57_CM_S2 "" RAT_FUNC "%6.3" "" COEFFS 0 1000 0 0 0 1 /end COMPU_METHOD
/begin COMPU_METHOD _CNV_P_2_A_I_68_CM_S2 "" TAB_INTP "%6.3" "" COMPU_TAB_REF _CNV_P_2_A_I_68_S2 /end COMPU_METHOD
/begin COMPU_METHOD _CNV_S_3_Enum_EQ_79_CM_S2 "" TAB_VERB "%6.3" "" COMPU_TAB_REF _CNV_S_3_Enum_EQ_79_S2 /end COMPU_METHOD
/begin COMPU_METHOD _CNV_S_7_Enum_ELDMM_80_CM_S2 "" TAB_VERB "%6.3" "" COMPU_TAB_REF _CNV_S_7_Enum_ELDMM_80_S2 /end COMPU_METHOD
/begin COMPU_METHOD _CNV_S_3_Enum_ERRDS_86_CM_S2 "" TAB_VERB "%6.3" "" COMPU_TAB_REF _CNV_S_3_Enum_ERRDS_86_S2 /end COMPU_METHOD
/begin COMPU_METHOD _CNV_S_14_Enum_EGANG_88_CM_S2 "Ganganzeige" TAB_VERB "%6.3" "" COMPU_TAB_REF _CNV_S_14_Enum_EGANG_88_S2 /end COMPU_METHOD
/begin COMPU_METHOD _CNV_S_11_Enum_EGANG_89_CM_S2 "" TAB_VERB "%6.3" "" COMPU_TAB_REF _CNV_S_11_Enum_EGANG_89_S2 /end COMPU_METHOD
/begin COMPU_METHOD _CNV_S_4_Enum_EKOMB_93_CM_S2 "" TAB_VERB "%6.3" "" COMPU_TAB_REF _CNV_S_4_Enum_EKOMB_93_S2 /end COMPU_METHOD
/begin COMPU_METHOD _CNV_R_R_Umr_100_zu_104_CM_S2 "" RAT_FUNC "%6.3" "%" COEFFS 0 100 0 0 0 1 /end COMPU_METHOD
/begin COMPU_METHOD _CNV_S_3_Enum_EREQA_118_CM_S2 "" TAB_VERB "%6.3" "" COMPU_TAB_REF _CNV_S_3_Enum_EREQA_118_S2 /end COMPU_METHOD
/begin COMPU_METHOD _CNV_S_8_Enum_EHSUB_119_CM_S2 "" TAB_VERB "%6.3" "" COMPU_TAB_REF _CNV_S_8_Enum_EHSUB_119_S2 /end COMPU_METHOD
/begin COMPU_METHOD _CNV_R_R_Umr_1_zu_1_123_CM_S2 "" RAT_FUNC "%6.3" "m" COEFFS 0 1 0 0 0 1 /end COMPU_METHOD
/begin COMPU_METHOD _CNV_R_R_Umr_1_zu_1_132_CM_S2 "" RAT_FUNC "%6.3" "usec" COEFFS 0 1 0 0 0 1 /end COMPU_METHOD
/begin COMPU_METHOD _CNV_R_R_Umr_1_zu_1_138_CM_S2 "" RAT_FUNC "%6.3" "°" COEFFS 0 1 0 0 0 1 /end COMPU_METHOD
/begin COMPU_METHOD _CNV_R_R_Umr_1_zu_1_146_CM_S2 "" RAT_FUNC "%6.3" "s" COEFFS 0 1 0 0 0 1 /end COMPU_METHOD
/begin COMPU_METHOD _CNV_S_7_Enum_ESDYN_151_CM_S2 "" TAB_VERB "%6.3" "" COMPU_TAB_REF _CNV_S_7_Enum_ESDYN_151_S2 /end COMPU_METHOD
/begin COMPU_METHOD _CNV_S_6_Enum_ESCHA_152_CM_S2 "" TAB_VERB "%6.3" "" COMPU_TAB_REF _CNV_S_6_Enum_ESCHA_152_S2 /end COMPU_METHOD
/begin COMPU_METHOD _CNV_S_3_Enum_EENTP_157_CM_S2 "" TAB_VERB "%6.3" "" COMPU_TAB_REF _CNV_S_3_Enum_EENTP_157_S2 /end COMPU_METHOD
/begin COMPU_METHOD _CNV_S_3_Enum_EDYND_167_CM_S2 "" TAB_VERB "%6.3" "" COMPU_TAB_REF _CNV_S_3_Enum_EDYND_167_S2 /end COMPU_METHOD
/begin COMPU_METHOD _CNV_S_4_Enum_EDYND_168_CM_S2 "" TAB_VERB "%6.3" "" COMPU_TAB_REF _CNV_S_4_Enum_EDYND_168_S2 /end COMPU_METHOD
/begin COMPU_METHOD _CNV_S_5_Enum_EDYND_169_CM_S2 "" TAB_VERB "%6.3" "" COMPU_TAB_REF _CNV_S_5_Enum_EDYND_169_S2 /end COMPU_METHOD
/begin COMPU_METHOD _CNV_S_6_Enum_EDYND_170_CM_S2 "" TAB_VERB "%6.3" "" COMPU_TAB_REF _CNV_S_6_Enum_EDYND_170_S2 /end COMPU_METHOD
/begin COMPU_METHOD _CNV_S_4_Enum_EDYND_171_CM_S2 "" TAB_VERB "%6.3" "" COMPU_TAB_REF _CNV_S_4_Enum_EDYND_171_S2 /end COMPU_METHOD
/begin COMPU_METHOD _CNV_S_6_Enum_EDYND_172_CM_S2 "" TAB_VERB "%6.3" "" COMPU_TAB_REF _CNV_S_6_Enum_EDYND_172_S2 /end COMPU_METHOD
/begin COMPU_METHOD _CNV_S_4_Enum_EDYND_173_CM_S2 "" TAB_VERB "%6.3" "" COMPU_TAB_REF _CNV_S_4_Enum_EDYND_173_S2 /end COMPU_METHOD
/begin COMPU_METHOD _CNV_S_7_Enum_EDYND_174_CM_S2 "" TAB_VERB "%6.3" "" COMPU_TAB_REF _CNV_S_7_Enum_EDYND_174_S2 /end COMPU_METHOD
/begin COMPU_METHOD _CNV_S_3_Enum_EDYND_175_CM_S2 "" TAB_VERB "%6.3" "" COMPU_TAB_REF _CNV_S_3_Enum_EDYND_175_S2 /end COMPU_METHOD
/begin COMPU_METHOD _CNV_S_9_Enum_EDYND_176_CM_S2 "" TAB_VERB "%6.3" "" COMPU_TAB_REF _CNV_S_9_Enum_EDYND_176_S2 /end COMPU_METHOD
/begin COMPU_METHOD _CNV_S_3_Enum_EHOTD_180_CM_S2 "" TAB_VERB "%6.3" "" COMPU_TAB_REF _CNV_S_3_Enum_EHOTD_180_S2 /end COMPU_METHOD
/begin COMPU_METHOD _CNV_R_R_Umr_10_zu__181_CM_S2 "" RAT_FUNC "%6.3" "1/s²" COEFFS 0 10 0 0 0 1 /end COMPU_METHOD
/begin COMPU_METHOD _CNV_R_R_Umr_1_zu_1_183_CM_S2 "" RAT_FUNC "%6.3" "m/s" COEFFS 0 1 0 0 0 1 /end COMPU_METHOD
/begin COMPU_METHOD _CNV_R_R_Umr_16_zu__186_CM_S2 "" RAT_FUNC "%6.3" "km/h" COEFFS 0 16 0 0 0 1 /end COMPU_METHOD
/begin COMPU_METHOD _CNV_R_R_Umr_100_zu_189_CM_S2 "" RAT_FUNC "%6.3" "m*m/s*s" COEFFS 0 100 0 0 0 1 /end COMPU_METHOD
/begin COMPU_METHOD _CNV_R_R_Umr_10_zu__190_CM_S2 "" RAT_FUNC "%6.3" "km/h" COEFFS 0 10 0 0 0 1 /end COMPU_METHOD
/begin COMPU_METHOD _CNV_R_R_Umr_10_zu__191_CM_S2 "" RAT_FUNC "%6.3" "m/s" COEFFS 0 10 0 0 0 1 /end COMPU_METHOD
/begin COMPU_METHOD _CNV_R_R_Umr_1_zu_1_192_CM_S2 "" RAT_FUNC "%6.3" "m*m/s*s" COEFFS 0 1 0 0 0 1 /end COMPU_METHOD
/begin COMPU_METHOD _CNV_S_6_Enum_EMSGI_193_CM_S2 "" TAB_VERB "%6.3" "" COMPU_TAB_REF _CNV_S_6_Enum_EMSGI_193_S2 /end COMPU_METHOD
/begin COMPU_METHOD _CNV_S_4_Enum_EBLIN_194_CM_S2 "" TAB_VERB "%6.3" "" COMPU_TAB_REF _CNV_S_4_Enum_EBLIN_194_S2 /end COMPU_METHOD
/begin COMPU_METHOD _CNV_S_3_Enum_ETOPO_195_CM_S2 "" TAB_VERB "%6.3" "" COMPU_TAB_REF _CNV_S_3_Enum_ETOPO_195_S2 /end COMPU_METHOD
/begin COMPU_METHOD _CNV_S_10_Enum_EADAS_196_CM_S2 "" TAB_VERB "%6.3" "" COMPU_TAB_REF _CNV_S_10_Enum_EADAS_196_S2 /end COMPU_METHOD
/begin COMPU_METHOD _CNV_R_R_Umr_1_zu_1_199_CM_S2 "" RAT_FUNC "%6.3" "Nm/s" COEFFS 0 1 0 0 0 1 /end COMPU_METHOD
/begin COMPU_METHOD _CNV_R_R_Umr_32_zu__202_CM_S2 "" RAT_FUNC "%6.3" "m/s*s" COEFFS 0 32 0 0 0 1 /end COMPU_METHOD
/begin COMPU_METHOD _CNV_R_R_Umr_20_zu__203_CM_S2 "" RAT_FUNC "%6.3" "°/s" COEFFS 0 20 0 0 0 1 /end COMPU_METHOD
/begin COMPU_METHOD _CNV_S_6_Enum_EANZG_205_CM_S2 "" TAB_VERB "%6.3" "" COMPU_TAB_REF _CNV_S_6_Enum_EANZG_205_S2 /end COMPU_METHOD
/begin COMPU_METHOD _CNV_S_6_Enum_EANZE_208_CM_S2 "" TAB_VERB "%6.3" "" COMPU_TAB_REF _CNV_S_6_Enum_EANZE_208_S2 /end COMPU_METHOD
/begin COMPU_METHOD _CNV_S_2_Enum_EWKAN_217_CM_S2 "" TAB_VERB "%6.3" "" COMPU_TAB_REF _CNV_S_2_Enum_EWKAN_217_S2 /end COMPU_METHOD
/begin COMPU_METHOD _CNV_S_43_Enum_EQSHI_219_CM_S2 "" TAB_VERB "%6.3" "" COMPU_TAB_REF _CNV_S_43_Enum_EQSHI_219_S2 /end COMPU_METHOD
/begin COMPU_METHOD _CNV_S_16_Enum_EIDXG_225_CM_S2 "" TAB_VERB "%6.3" "" COMPU_TAB_REF _CNV_S_16_Enum_EIDXG_225_S2 /end COMPU_METHOD
/begin COMPU_METHOD _CNV_S_3_Enum_EQSHI_226_CM_S2 "" TAB_VERB "%6.3" "" COMPU_TAB_REF _CNV_S_3_Enum_EQSHI_226_S2 /end COMPU_METHOD
/begin COMPU_METHOD _CNV_S_3_Enum_EDYN__227_CM_S2 "" TAB_VERB "%6.3" "" COMPU_TAB_REF _CNV_S_3_Enum_EDYN__227_S2 /end COMPU_METHOD
/begin COMPU_METHOD _CNV_S_3_Enum_EDYN__228_CM_S2 "" TAB_VERB "%6.3" "" COMPU_TAB_REF _CNV_S_3_Enum_EDYN__228_S2 /end COMPU_METHOD
/begin COMPU_METHOD _CNV_S_4_Enum_EDYN__229_CM_S2 "" TAB_VERB "%6.3" "" COMPU_TAB_REF _CNV_S_4_Enum_EDYN__229_S2 /end COMPU_METHOD
/begin COMPU_METHOD _CNV_S_4_Enum_EDYN__230_CM_S2 "" TAB_VERB "%6.3" "" COMPU_TAB_REF _CNV_S_4_Enum_EDYN__230_S2 /end COMPU_METHOD
/begin COMPU_METHOD _CNV_S_2_Enum_EDYN__231_CM_S2 "" TAB_VERB "%6.3" "" COMPU_TAB_REF _CNV_S_2_Enum_EDYN__231_S2 /end COMPU_METHOD
/begin COMPU_METHOD _CNV_R_R_Umr_2_zu_1_238_CM_S2 "" RAT_FUNC "%6.3" "Bar" COEFFS 0 2 0 0 0 1 /end COMPU_METHOD
/begin COMPU_METHOD _CNV_S_5_Enum_EVALI_246_CM_S2 "" TAB_VERB "%6.3" "" COMPU_TAB_REF _CNV_S_5_Enum_EVALI_246_S2 /end COMPU_METHOD
/begin COMPU_METHOD _CNV_S_6_Enum_EZKAT_247_CM_S2 "" TAB_VERB "%6.3" "" COMPU_TAB_REF _CNV_S_6_Enum_EZKAT_247_S2 /end COMPU_METHOD
/begin COMPU_METHOD _CNV_S_3_Enum_EEFAH_251_CM_S2 "" TAB_VERB "%6.3" "" COMPU_TAB_REF _CNV_S_3_Enum_EEFAH_251_S2 /end COMPU_METHOD
/begin COMPU_METHOD _CNV_R_R_Umr_80_zu__252_CM_S2 "" RAT_FUNC "%6.3" "" COEFFS 0 80 0 0 0 1 /end COMPU_METHOD
/begin COMPU_METHOD _CNV_S_2_Enum_ESPOR_253_CM_S2 "" TAB_VERB "%6.3" "" COMPU_TAB_REF _CNV_S_2_Enum_ESPOR_253_S2 /end COMPU_METHOD
/begin COMPU_METHOD _CNV_R_R_Umr_100_zu_254_CM_S2 "" RAT_FUNC "%6.3" "U/(min*ms)" COEFFS 0 100 0 0 0 1 /end COMPU_METHOD
/begin COMPU_METHOD _CNV_S_3_Enum_EGV_255_CM_S2 "" TAB_VERB "%6.3" "" COMPU_TAB_REF _CNV_S_3_Enum_EGV_255_S2 /end COMPU_METHOD
/begin COMPU_METHOD _CNV_S_3_Enum_EB_ST_256_CM_S2 "" TAB_VERB "%6.3" "" COMPU_TAB_REF _CNV_S_3_Enum_EB_ST_256_S2 /end COMPU_METHOD
/begin COMPU_METHOD _CNV_S_4_Enum_EB_257_CM_S2 "" TAB_VERB "%6.3" "" COMPU_TAB_REF _CNV_S_4_Enum_EB_257_S2 /end COMPU_METHOD
/begin COMPU_METHOD _CNV_S_4_Enum_EBSMO_258_CM_S2 "" TAB_VERB "%6.3" "" COMPU_TAB_REF _CNV_S_4_Enum_EBSMO_258_S2 /end COMPU_METHOD
/begin COMPU_METHOD _CNV_S_7_Enum_EBSMO_259_CM_S2 "" TAB_VERB "%6.3" "" COMPU_TAB_REF _CNV_S_7_Enum_EBSMO_259_S2 /end COMPU_METHOD
/begin COMPU_METHOD _CNV_S_7_Enum_ESTAR_260_CM_S2 "" TAB_VERB "%6.3" "" COMPU_TAB_REF _CNV_S_7_Enum_ESTAR_260_S2 /end COMPU_METHOD
/begin COMPU_METHOD _CNV_R_R_Umr_100_zu_264_CM_S2 "" RAT_FUNC "%6.3" "m*m/s*s*s*s" COEFFS 0 100 0 0 0 1 /end COMPU_METHOD
/begin COMPU_METHOD _CNV_R_R_Umr_1_zu_1_265_CM_S2 "" RAT_FUNC "%6.3" "0.1g" COEFFS 0 1 0 0 0 1 /end COMPU_METHOD
/begin COMPU_METHOD _CNV_R_R_Umr_100_zu_266_CM_S2 "" RAT_FUNC "%6.3" "m/s" COEFFS 0 100 0 0 0 1 /end COMPU_METHOD
/begin COMPU_METHOD _CNV_S_7_Enum_EGEAR_267_CM_S2 "" TAB_VERB "%6.3" "" COMPU_TAB_REF _CNV_S_7_Enum_EGEAR_267_S2 /end COMPU_METHOD
/begin COMPU_METHOD _CNV_S_3_Enum_EPOSS_268_CM_S2 "" TAB_VERB "%6.3" "" COMPU_TAB_REF _CNV_S_3_Enum_EPOSS_268_S2 /end COMPU_METHOD
/begin COMPU_METHOD _CNV_R_R_Umr_1_zu_1_270_CM_S2 "" RAT_FUNC "%6.3" "kg" COEFFS 0 1 0 0 0 1 /end COMPU_METHOD
/begin COMPU_METHOD _CNV_S_2_Enum_ERRDS_271_CM_S2 "" TAB_VERB "%6.3" "" COMPU_TAB_REF _CNV_S_2_Enum_ERRDS_271_S2 /end COMPU_METHOD
/begin COMPU_METHOD UMR_STUNDE__1_1_0_S6_S3 "int = ((phys * 1) / 1) - (0) [stunde]" RAT_FUNC "%2.0" "[stunde]" COEFFS 0 1 -0 0 0 1 /end COMPU_METHOD
/begin COMPU_METHOD UMR_MSEC_10MS_10_1_0_S6_S3 "int = ((phys * 1) / 10) - (0) [ms/10ms]" RAT_FUNC "%2.0" "[ms/10ms]" COEFFS 0 1 -0 0 0 10 /end COMPU_METHOD
/begin COMPU_METHOD UMR__SEC_1_10000_0_S6_S3 "int = ((phys * 10000) / 1) - (0) [1/s]" RAT_FUNC "%6.4" "[1/s]" COEFFS 0 10000 -0 0 0 1 /end COMPU_METHOD
/begin COMPU_METHOD UMR__SEC_1_100_0_S6_S3 "int = ((phys * 100) / 1) - (0) [1/s]" RAT_FUNC "%4.2" "[1/s]" COEFFS 0 100 -0 0 0 1 /end COMPU_METHOD
/begin COMPU_METHOD UMR_GRADC__1_1_M50_S6_S3 "int = ((phys * 1) / 1) - (-50) [°C]" RAT_FUNC "%2.0" "[°C]" COEFFS 0 1 50 0 0 1 /end COMPU_METHOD
/begin COMPU_METHOD UMR_K_NM_1_1_0_S6_S3 "int = ((phys * 1) / 1) - (0) [K/Nm]" RAT_FUNC "%2.0" "[K/Nm]" COEFFS 0 1 -0 0 0 1 /end COMPU_METHOD
/begin COMPU_METHOD UMR_PROZENT__1_10_0_S6_S3 "int = ((phys * 10) / 1) - (0) [%]" RAT_FUNC "%3.1" "[%]" COEFFS 0 10 -0 0 0 1 /end COMPU_METHOD
/begin COMPU_METHOD UMR_PROZENT__4_10_0_S6_S3 "int = ((phys * 10) / 4) - (0) [%]" RAT_FUNC "%3.1" "[%]" COEFFS 0 10 -0 0 0 4 /end COMPU_METHOD
/begin COMPU_METHOD UMR_PROZENT__1_10_M3000_S6_S3 "int = ((phys * 10) / 1) - (-3000) [%]" RAT_FUNC "%3.1" "[%]" COEFFS 0 10 3000 0 0 1 /end COMPU_METHOD
/begin COMPU_METHOD UMR_PROZENT_SEC_1_10_0_S6_S3 "int = ((phys * 10) / 1) - (0) [%/s]" RAT_FUNC "%3.1" "[%/s]" COEFFS 0 10 -0 0 0 1 /end COMPU_METHOD
/begin COMPU_METHOD UMR_NMMINSEC__1_1_0_S6_S3 "int = ((phys * 1) / 1) - (0) [0,16Nm/(1/(min*s))]" RAT_FUNC "%2.0" "[0,16Nm/(1/(min*s))]" COEFFS 0 1 -0 0 0 1 /end COMPU_METHOD
/begin COMPU_METHOD UMR_NMMINSEC_10MSEC_1_1_0_S6_S3 "int = ((phys * 1) / 1) - (0) [0,000025Nm/(10ms/(min*s))]" RAT_FUNC "%2.0" "[0,000025Nm/(10ms/(min*s))]" COEFFS 0 1 -0 0 0 1 /end COMPU_METHOD
/begin COMPU_METHOD UMR_KG__1_1_0_S6_S3 "int = ((phys * 1) / 1) - (0) [kg]" RAT_FUNC "%2.0" "[kg]" COEFFS 0 1 -0 0 0 1 /end COMPU_METHOD
/begin COMPU_METHOD UMR_KGM2__1_10000_0_S6_S3 "int = ((phys * 10000) / 1) - (0) [kg*m^2]" RAT_FUNC "%6.4" "[kg*m^2]" COEFFS 0 10000 -0 0 0 1 /end COMPU_METHOD
/begin COMPU_METHOD UMR_KGM2__1_1_0_S6_S3 "int = ((phys * 1) / 1) - (0) [kg*m^2]" RAT_FUNC "%2.0" "[kg*m^2]" COEFFS 0 1 -0 0 0 1 /end COMPU_METHOD
/begin COMPU_METHOD UMR_M__1_100_0_S6_S3 "int = ((phys * 100) / 1) - (0) [m]" RAT_FUNC "%4.2" "[m]" COEFFS 0 100 -0 0 0 1 /end COMPU_METHOD
/begin COMPU_METHOD UMR_KM__10_1_0_S6_S3 "int = ((phys * 1) / 10) - (0) [Km]" RAT_FUNC "%2.0" "[Km]" COEFFS 0 1 -0 0 0 10 /end COMPU_METHOD
/begin COMPU_METHOD UMR_KM__100_1_0_S6_S3 "int = ((phys * 1) / 100) - (0) [Km]" RAT_FUNC "%2.0" "[Km]" COEFFS 0 1 -0 0 0 100 /end COMPU_METHOD
/begin COMPU_METHOD UMR_KM__200_1_0_S6_S3 "int = ((phys * 1) / 200) - (0) [Km]" RAT_FUNC "%2.0" "[Km]" COEFFS 0 1 -0 0 0 200 /end COMPU_METHOD
/begin COMPU_METHOD UMR_MM__1_256_0_S6_S3 "int = ((phys * 256) / 1) - (0) [mm]" RAT_FUNC "%5.3" "[mm]" COEFFS 0 256 -0 0 0 1 /end COMPU_METHOD
/begin COMPU_METHOD UMR_MM__1_10_0_S6_S3 "int = ((phys * 10) / 1) - (0) [mm]" RAT_FUNC "%3.1" "[mm]" COEFFS 0 10 -0 0 0 1 /end COMPU_METHOD
/begin COMPU_METHOD UMR_KM_H_1_10_0_S6_S3 "int = ((phys * 10) / 1) - (0) [km/h]" RAT_FUNC "%3.1" "[km/h]" COEFFS 0 10 -0 0 0 1 /end COMPU_METHOD
/begin COMPU_METHOD UMR_GRAD__1_3_M126_S6_S3 "int = ((phys * 3) / 1) - (-126) [Grad]" RAT_FUNC "%5.3" "[Grad]" COEFFS 0 3 126 0 0 1 /end COMPU_METHOD
/begin COMPU_METHOD UMR_GRAD__1_3_M42_S6_S3 "int = ((phys * 3) / 1) - (-42) [Grad]" RAT_FUNC "%5.3" "[Grad]" COEFFS 0 3 42 0 0 1 /end COMPU_METHOD
/begin COMPU_METHOD UMR_GRAD__7_160_0_S6_S3 "int = ((phys * 160) / 7) - (0) [Grad]" RAT_FUNC "%5.3" "[Grad]" COEFFS 0 160 -0 0 0 7 /end COMPU_METHOD
/begin COMPU_METHOD UMR_W__1_10_0_S6_S3 "int = ((phys * 10) / 1) - (0) [W]" RAT_FUNC "%3.1" "[W]" COEFFS 0 10 -0 0 0 1 /end COMPU_METHOD
/begin COMPU_METHOD UMR_W_MM2_1_1_0_S6_S3 "int = ((phys * 1) / 1) - (0) [W/(mm^2)]" RAT_FUNC "%2.0" "[W/(mm^2)]" COEFFS 0 1 -0 0 0 1 /end COMPU_METHOD
/begin COMPU_METHOD UMR_W_MM2_1_1000_0_S6_S3 "int = ((phys * 1000) / 1) - (0) [W/(mm^2)]" RAT_FUNC "%5.3" "[W/(mm^2)]" COEFFS 0 1000 -0 0 0 1 /end COMPU_METHOD
/begin COMPU_METHOD UMR_W_K_1_1_0_1_S6_S3 "int = ((phys * 1) / 1) - (0) [W/K]" RAT_FUNC "%2.0" "[W/K]" COEFFS 0 1 -0 0 0 1 /end COMPU_METHOD
/begin COMPU_METHOD UMR_W_K_1_1_0_2_S6_S3 "int = ((phys * 1) / 1) - (0) [W/K]" RAT_FUNC "%2.0" "[W/K]" COEFFS 0 1 -0 0 0 1 /end COMPU_METHOD
/begin COMPU_METHOD UMR_W_K_1_10_0_S6_S3 "int = ((phys * 10) / 1) - (0) [W/K]" RAT_FUNC "%7.5" "[W/K]" COEFFS 0 10 -0 0 0 1 /end COMPU_METHOD
/begin COMPU_METHOD UMR_J__1_1_0_S6_S3 "int = ((phys * 1) / 1) - (0) [J]" RAT_FUNC "%2.0" "[J]" COEFFS 0 1 -0 0 0 1 /end COMPU_METHOD
/begin COMPU_METHOD UMR_J__1_1_0_3_S6_S3 "int = ((phys * 1) / 1) - (0) [J]" RAT_FUNC "%2.0" "[J]" COEFFS 0 1 -0 0 0 1 /end COMPU_METHOD
/begin COMPU_METHOD UMR_J__1_100_0_S6_S3 "int = ((phys * 100) / 1) - (0) [J]" RAT_FUNC "%5.3" "[J]" COEFFS 0 100 -0 0 0 1 /end COMPU_METHOD
/begin COMPU_METHOD UMR_J__1_1000_0_S6_S3 "int = ((phys * 1000) / 1) - (0) [J]" RAT_FUNC "%6.4" "[J]" COEFFS 0 1000 -0 0 0 1 /end COMPU_METHOD
/begin COMPU_METHOD UMR_J__1_100000_0_S6_S3 "int = ((phys * 100000) / 1) - (0) [J]" RAT_FUNC "%8.6" "[J]" COEFFS 0 100000 -0 0 0 1 /end COMPU_METHOD
/begin COMPU_METHOD UMR_J_MM2_1_1_0_S6_S3 "int = ((phys * 1) / 1) - (0) [J/(mm^2)]" RAT_FUNC "%2.0" "[J/(mm^2)]" COEFFS 0 1 -0 0 0 1 /end COMPU_METHOD
/begin COMPU_METHOD UMR_J_MM2_1_100_0_S6_S3 "int = ((phys * 100) / 1) - (0) [J/(mm^2)]" RAT_FUNC "%4.2" "[J/(mm^2)]" COEFFS 0 100 -0 0 0 1 /end COMPU_METHOD
/begin COMPU_METHOD UMR_J_MM2_1_1000_0_S6_S3 "int = ((phys * 1000) / 1) - (0) [J/(mm^2)]" RAT_FUNC "%6.4" "[J/(mm^2)]" COEFFS 0 1000 -0 0 0 1 /end COMPU_METHOD
/begin COMPU_METHOD UMR_J_MM2_1_100000_0_S6_S3 "int = ((phys * 100000) / 1) - (0) [J/(mm^2)]" RAT_FUNC "%8.6" "[J/(mm^2)]" COEFFS 0 100000 -0 0 0 1 /end COMPU_METHOD
/begin COMPU_METHOD UMR_J_K_1_1000_0_S6_S3 "int = ((phys * 1000) / 1) - (0) [J/(K)]" RAT_FUNC "%5.3" "[J/(K)]" COEFFS 0 1000 -0 0 0 1 /end COMPU_METHOD
/begin COMPU_METHOD UMR_J_G_1_10_0_S6_S3 "int = ((phys * 10) / 1) - (0) [J/(g)]" RAT_FUNC "%3.1" "[J/(g)]" COEFFS 0 10 -0 0 0 1 /end COMPU_METHOD
/begin COMPU_METHOD UMR_J_G_1_1000_0_S6_S3 "int = ((phys * 1000) / 1) - (0) [J/(g)]" RAT_FUNC "%5.3" "[J/(g)]" COEFFS 0 1000 -0 0 0 1 /end COMPU_METHOD
/begin COMPU_METHOD UMR_MM2__1_1_0_S6_S3 "int = ((phys * 1) / 1) - (0) [mm^2]" RAT_FUNC "%2.0" "[mm^2]" COEFFS 0 1 -0 0 0 1 /end COMPU_METHOD
/begin COMPU_METHOD UMR_LITER__1_10000_0_S6_S3 "int = ((phys * 10000) / 1) - (0) [Liter]" RAT_FUNC "%6.4" "[Liter]" COEFFS 0 10000 -0 0 0 1 /end COMPU_METHOD
/begin COMPU_METHOD UMR_LITER_MIN_1_100_0_S6_S3 "int = ((phys * 100) / 1) - (0) [Liter/min]" RAT_FUNC "%4.2" "[Liter/min]" COEFFS 0 100 -0 0 0 1 /end COMPU_METHOD
/begin COMPU_METHOD UMR_LITER_MIN_1_32_0_S6_S3 "int = ((phys * 32) / 1) - (0) [Liter/min]" RAT_FUNC "%6.4" "[Liter/min]" COEFFS 0 32 -0 0 0 1 /end COMPU_METHOD
/begin COMPU_METHOD UMR_LITER_MIN_1_1_0_S6_S3 "int = ((phys * 1) / 1) - (0) [Liter/min]" RAT_FUNC "%2.0" "[Liter/min]" COEFFS 0 1 -0 0 0 1 /end COMPU_METHOD
/begin COMPU_METHOD UMR_LITER_MIN_1_1_0_2_S6_S3 "int = ((phys * 1) / 1) - (0) [Liter/min]" RAT_FUNC "%2.0" "[Liter/min]" COEFFS 0 1 -0 0 0 1 /end COMPU_METHOD
/begin COMPU_METHOD UMR_LITER_MIN_1_1_0_4_S6_S3 "int = ((phys * 1) / 1) - (0) [Liter/min]" RAT_FUNC "%2.0" "[Liter/min]" COEFFS 0 1 -0 0 0 1 /end COMPU_METHOD
/begin COMPU_METHOD UMR_LITER_SEC_1_1_0_S6_S3 "int = ((phys * 1) / 1) - (0) [Liter/s]" RAT_FUNC "%2.0" "[Liter/s]" COEFFS 0 1 -0 0 0 1 /end COMPU_METHOD
/begin COMPU_METHOD UMR_M_SEC2_1_100_0_S6_S3 "int = ((phys * 100) / 1) - (0) [m/s^2]" RAT_FUNC "%4.2" "[m/s^2]" COEFFS 0 100 -0 0 0 1 /end COMPU_METHOD
/begin COMPU_METHOD eASD_S6_S3 "" TAB_VERB "%2.0" "" COMPU_TAB_REF eASD_S6_S3 /end COMPU_METHOD
/begin COMPU_METHOD UMRM___1_10_0_S6_S3 "Umskalierung um Faktor 10\\nint = ((phys * 10) / 1) - (0) [-]" RAT_FUNC "%5.3" "[-]" COEFFS 0 10 -0 0 0 1 /end COMPU_METHOD
/begin COMPU_METHOD UMRM_NM__6_1_0_S6_S3 "Umrechnung Moment auf ui8\\nint = ((phys * 1) / 6) - (0) [Nm]" RAT_FUNC "%5.3" "[Nm]" COEFFS 0 1 -0 0 0 6 /end COMPU_METHOD
/begin COMPU_METHOD UMRM_NM__1_10_0_S6_S3 "Umrechnung von Nm in 0.1 Nm\\nint = ((phys * 10) / 1) - (0) [Nm]" RAT_FUNC "%5.3" "[Nm]" COEFFS 0 10 -0 0 0 1 /end COMPU_METHOD
/begin COMPU_METHOD UMRM_BAR_SEC_1_10_0_S6_S3 "Umrechnung von bar/sec in 100mbar/sec\\nint = ((phys * 10) / 1) - (0) [bar/s]" RAT_FUNC "%5.3" "[bar/s]" COEFFS 0 10 -0 0 0 1 /end COMPU_METHOD
/begin COMPU_METHOD UMRM_U_MIN_32_1_0_S6_S3 "Umrechnung von ui16 auf ui8\\nint = ((phys * 1) / 32) - (0) [U/min]" RAT_FUNC "%5.3" "[U/min]" COEFFS 0 1 -0 0 0 32 /end COMPU_METHOD
/begin COMPU_METHOD UMRM_MSEC__1_1_0_S6_S3 "Umrechnung in msec\\nint = ((phys * 1) / 1) - (0) [ms]" RAT_FUNC "%2.0" "[ms]" COEFFS 0 1 -0 0 0 1 /end COMPU_METHOD
/begin COMPU_METHOD UMRM_MSEC__1_10_0_S6_S3 "Umrechnung in 0.1 sec\\nint = ((phys * 10) / 1) - (0) [ms]" RAT_FUNC "%5.3" "[ms]" COEFFS 0 10 -0 0 0 1 /end COMPU_METHOD
/begin COMPU_METHOD UMRM_PROZENT__1_1_0_S6_S3 "Umrechnung von auf 100%\\nint = ((phys * 1) / 1) - (0) [%]" RAT_FUNC "%2.0" "[%]" COEFFS 0 1 -0 0 0 1 /end COMPU_METHOD
/begin COMPU_METHOD UMRM_PROZENT__1_10_M300_S6_S3 "Umrechnung auf 1 %\\nint = ((phys * 10) / 1) - (-3000) [%]" RAT_FUNC "%5.3" "[%]" COEFFS 0 10 3000 0 0 1 /end COMPU_METHOD
/begin COMPU_METHOD UMRM_LITER_MIN_1_10_0_S6_S3 "Darstellung in Liter/min\\nint = ((phys * 10) / 1) - (0) [liter/min]" RAT_FUNC "%5.3" "[liter/min]" COEFFS 0 10 -0 0 0 1 /end COMPU_METHOD
/begin COMPU_METHOD UMRM_KGM2__1_100_0_S6_S3 "Umrechnung in 0.01 kg*m^2\\nint = ((phys * 100) / 1) - (0) [kg*m^2]" RAT_FUNC "%5.3" "[kg*m^2]" COEFFS 0 100 -0 0 0 1 /end COMPU_METHOD
/begin COMPU_METHOD UMRM_J_K_1_1_0_S6_S3 "Darstellung in Joule/Kelvin\\nint = ((phys * 1) / 1) - (0) [J/K]" RAT_FUNC "%2.0" "[J/K]" COEFFS 0 1 -0 0 0 1 /end COMPU_METHOD
/begin COMPU_METHOD UMRM_MA__1_1_0_S6_S3 "Darstellung in Milliampere\\nint = ((phys * 1) / 1) - (0) [mA]" RAT_FUNC "%2.0" "[mA]" COEFFS 0 1 -0 0 0 1 /end COMPU_METHOD
/begin COMPU_METHOD UMRM_MA__1_10_0_S6_S3 "Darstellung in Zehntel Milliampere\\nint = ((phys * 10) / 1) - (0) [mA]" RAT_FUNC "%5.3" "[mA]" COEFFS 0 10 -0 0 0 1 /end COMPU_METHOD
/begin COMPU_METHOD UMRM_KG__1_1_0_S6_S3 "Umrechnung kg\\nint = ((phys * 1) / 1) - (0) [kg]" RAT_FUNC "%2.0" "[kg]" COEFFS 0 1 -0 0 0 1 /end COMPU_METHOD
/begin COMPU_METHOD UMRM_MM__1_10_0_S6_S3 "Quantisierung in 1/10 mm\\nint = ((phys * 10) / 1) - (0) [mm]" RAT_FUNC "%5.3" "[mm]" COEFFS 0 10 -0 0 0 1 /end COMPU_METHOD
/begin COMPU_METHOD UMRM_MM__1_256_0_S6_S3 "Quantisierung in 1/256 mm\\nint = ((phys * 256) / 1) - (0) [mm]" RAT_FUNC "%5.3" "[mm]" COEFFS 0 256 -0 0 0 1 /end COMPU_METHOD
/begin COMPU_METHOD UMRM_M_S2_1_32_0_S6_S3 "Quantisierung in 1/32 m/s2\\nint = ((phys * 32) / 1) - (0) [m/s2]" RAT_FUNC "%5.3" "[m/s2]" COEFFS 0 32 -0 0 0 1 /end COMPU_METHOD
/begin COMPU_METHOD eInterpretationStatus_S6_S3 "" TAB_VERB "%2.0" "" COMPU_TAB_REF eInterpretationStatus_S6_S3 /end COMPU_METHOD
/begin COMPU_METHOD eBefuellung_S6_S3 "" TAB_VERB "%2.0" "" COMPU_TAB_REF eBefuellung_S6_S3 /end COMPU_METHOD
/begin COMPU_METHOD eKFL_S6_S3 "" TAB_VERB "%2.0" "" COMPU_TAB_REF eKFL_S6_S3 /end COMPU_METHOD
/begin COMPU_METHOD eSchaltung_S6_S3 "" TAB_VERB "%2.0" "" COMPU_TAB_REF eSchaltung_S6_S3 /end COMPU_METHOD
/begin COMPU_METHOD eSchaltungsPhase_S6_S3 "" TAB_VERB "%2.0" "" COMPU_TAB_REF eSchaltungsPhase_S6_S3 /end COMPU_METHOD
/begin COMPU_METHOD ng_fl_S1_S7_S3 "Drehzahlgradient" RAT_FUNC "%12.6" "1/min/s" COEFFS 0 1 0 0 0 1 /end COMPU_METHOD
/begin COMPU_METHOD ng_int_S1_S7_S3 "Drehzahlgradient" RAT_FUNC "%5.0" "1/min/s" COEFFS 0 1 0 0 0 1 /end COMPU_METHOD
/begin COMPU_METHOD t_fl_S1_S7_S3 "Zeit" RAT_FUNC "%12.6" "s" COEFFS 0 1 0 0 0 1 /end COMPU_METHOD
/begin COMPU_TAB _CNV_P_2_A_I_5_S2 "" TAB_INTP 2 0 0 255 255 /end COMPU_TAB
/begin COMPU_TAB _CNV_P_2_A_I_68_S2 "" TAB_INTP 2 0 0 65535 65535 /end COMPU_TAB
/begin COMPU_VTAB _CNV_S_2_Schalter_A_4_S2 "Schalter: 0 = AUS, 1 = EIN" TAB_VERB 2 0 "AUS" 1 "EIN" /end COMPU_VTAB
/begin COMPU_VTAB _CNV_S_3_Enum_ENOTL_18_S2 "" TAB_VERB 3 0 "MOTOR_KEIN_NOTLAUF" 1 "MOTOR_NOTLAUF_1" 2 "MOTOR_NOTLAUF_2" /end COMPU_VTAB
/begin COMPU_VTAB _CNV_S_2_Enum_ECOD__23_S2 "" TAB_VERB 2 0 "KEIN_SPORTSCHALTER" 1 "SPORTSCHALTER" /end COMPU_VTAB
/begin COMPU_VTAB _CNV_S_2_Enum_EAGS_25_S2 "" TAB_VERB 2 0 "A_AGS" 1 "S_AGS" /end COMPU_VTAB
/begin COMPU_VTAB _CNV_S_9_Enum_EGANG_30_S2 "" TAB_VERB 9 0 "GANG_1" 1 "GANG_2" 2 "GANG_3" 3 "GANG_4" 4 "GANG_5" 5 "GANG_6" 6 "GANG_7" 7 "GANG_8" 8 "GANG_9" /end COMPU_VTAB
/begin COMPU_VTAB _CNV_S_8_Enum_EPOS_33_S2 "" TAB_VERB 8 0 "POS_1" 1 "POS_2" 2 "POS_3" 3 "POS_4" 4 "POS_D" 5 "POS_N" 6 "POS_R" 7 "POS_P" /end COMPU_VTAB
/begin COMPU_VTAB _CNV_S_4_Enum_EPROG_35_S2 "" TAB_VERB 4 0 "NORMAL_MODE" 1 "SPORT_MODE" 2 "STEPTRONIC_MODE" 3 "L_MODE" /end COMPU_VTAB
/begin COMPU_VTAB _CNV_S_3_Enum_ESCHL_41_S2 "" TAB_VERB 3 0 "HAFT_REIBUNG" 1 "ZUG_SCHLUPF" 2 "SCHUB_SCHLUPF" /end COMPU_VTAB
/begin COMPU_VTAB _CNV_S_3_Enum_EQ_79_S2 "" TAB_VERB 3 0 "SIGNAL_OK" 1 "ERSATZWERT" 2 "FEHLER" /end COMPU_VTAB
/begin COMPU_VTAB _CNV_S_7_Enum_ELDMM_80_S2 "" TAB_VERB 7 0 "LDM_AUS" 1 "LDM_AN_STD" 2 "BN2020_SLD_AKTIV" 3 "BN2020_PMA_AKTIV_ODER_BN2000_LDM_AN_BREMSE" 4 "BN2000_LDM_AN_UEBERTRITT" 5 "BN2000_LDM_AUS_CASYSTEMBREMSUNG" 15 "BN2000_LDM_INIT" /end COMPU_VTAB
/begin COMPU_VTAB _CNV_S_3_Enum_ERRDS_86_S2 "" TAB_VERB 3 0 "ABS_DSC_Ok" 1 "ABS_DSC_ERR_RolleCAN_False" 2 "ABS_DSC_ERR_RolleCAN_True" /end COMPU_VTAB
/begin COMPU_VTAB _CNV_S_14_Enum_EGANG_88_S2 "Ganganzeige" TAB_VERB 14 0 "GANG_WHL_AZG_NODISP" 1 "GANG_WHL_AZG_N" 2 "GANG_WHL_AZG_R" 3 "GANG_WHL_AZG_P" 4 "GANG_WHL_AZG_D" 5 "GANG_WHL_AZG_1" 6 "GANG_WHL_AZG_2" 7 "GANG_WHL_AZG_3" 8 "GANG_WHL_AZG_4" 9 "GANG_WHL_AZG_5" 10 "GANG_WHL_AZG_6" 11 "GANG_WHL_AZG_7" 12 "GANG_WHL_AZG_8" 13 "GANG_WHL_AZG_9" /end COMPU_VTAB
/begin COMPU_VTAB _CNV_S_11_Enum_EGANG_89_S2 "" TAB_VERB 11 1 "GANGSS_KEIN_GANG" 2 "GANGSS_R" 5 "GANGSS_1" 6 "GANGSS_2" 7 "GANGSS_3" 8 "GANGSS_4" 9 "GANGSS_5" 10 "GANGSS_6" 11 "GANGSS_7" 12 "GANGSS_8" 13 "GANGSS_9" /end COMPU_VTAB
/begin COMPU_VTAB _CNV_S_4_Enum_EKOMB_93_S2 "" TAB_VERB 4 0 "DARK_KOMBI" 1 "SPORT_KOMBI" 2 "STEPTRONIC_KOMBI" 3 "L_KOMBI" /end COMPU_VTAB
/begin COMPU_VTAB _CNV_S_3_Enum_EREQA_118_S2 "" TAB_VERB 3 0 "NO_REQUEST" 1 "REQUEST_PRIO_LOW" 2 "REQUEST_PRIO_HIGH" /end COMPU_VTAB
/begin COMPU_VTAB _CNV_S_8_Enum_EHSUB_119_S2 "" TAB_VERB 8 0 "HSUBEDAUS_D" 1 "HSUBEDAUS_D_FDC" 2 "HSUBEDAUS_S" 3 "HSUBEDAUS_S_FDC" 4 "HSUBEDAUS_STEP" 5 "HSUBEDAUS_STEP_FDC" 6 "HSUBEDAUS_TID" 7 "HSUBEDAUS_TID_FDC" /end COMPU_VTAB
/begin COMPU_VTAB _CNV_S_7_Enum_ESDYN_151_S2 "" TAB_VERB 7 0 "KOMFORT_SDYN" 1 "QS1_SDYN" 2 "QS2_SDYN" 3 "QS3_SDYN" 4 "QS4_SDYN" 5 "QS5_SDYN" 6 "QS6_SDYN" /end COMPU_VTAB
/begin COMPU_VTAB _CNV_S_6_Enum_ESCHA_152_S2 "" TAB_VERB 6 0 "ZUG_HOCH" 1 "ZUG_RUECK" 2 "SCHUB_HOCH" 3 "SCHUB_RUECK" 4 "SCHUB_RUECK_POSME" 5 "SCHUB_RUECK_OFFEN" /end COMPU_VTAB
/begin COMPU_VTAB _CNV_S_3_Enum_EENTP_157_S2 "" TAB_VERB 3 0 "Aktivierung: steigende Flanke S_DYNDZM_FFG" 1 "Deaktivierung: fallende Flanke S_DYNDZM_FFG" 2 "Verzoegerung bei Aktivierung" /end COMPU_VTAB
/begin COMPU_VTAB _CNV_S_3_Enum_EDYND_167_S2 "" TAB_VERB 3 0 "Init" 1 "Anfahren" 2 "Fahren" /end COMPU_VTAB
/begin COMPU_VTAB _CNV_S_4_Enum_EDYND_168_S2 "" TAB_VERB 4 0 "Init" 1 "Anzeige_MOT" 2 "Hochrampen" 3 "Runterrampen" /end COMPU_VTAB
/begin COMPU_VTAB _CNV_S_5_Enum_EDYND_169_S2 "" TAB_VERB 5 0 "Init" 1 "Anzeigedrehzahl_zu_hoch" 2 "Anzeigedrehzahl_zu_niedrig" 3 "Kein_Kraftschluss" 4 "Aufbau_Kraftschluss" /end COMPU_VTAB
/begin COMPU_VTAB _CNV_S_6_Enum_EDYND_170_S2 "" TAB_VERB 6 0 "Init (Anzeige_N_DYNDZMRE_BER)" 1 "Uebergang_Anzeige_MOT (runterrampen)" 2 "Uebergang_Anzeige_MOT (hochrampen)" 3 "Anzeige_MOT" 4 "Uebergang_Anzeige_N_DYNDZMRE_BER (runterrampen)" 5 "Uebergang_Anzeige_N_DYNDZMRE_BER (hochrampen)" /end COMPU_VTAB
/begin COMPU_VTAB _CNV_S_4_Enum_EDYND_171_S2 "" TAB_VERB 4 0 "Init" 1 "N_VM (Kriechen->Fahren)" 2 "N_VM (Fahren->Kriechen)" 3 "N_MOT_SOLLLL (Fahren->Kriechen)" /end COMPU_VTAB
/begin COMPU_VTAB _CNV_S_6_Enum_EDYND_172_S2 "" TAB_VERB 6 0 "Init" 1 "Motor_steht" 2 "Motor_laeuft Anzeige_MOT" 3 "Motor_laeuft Anzeige_SOLLLL" 4 "Motor_abstellen" 5 "Angleich" /end COMPU_VTAB
/begin COMPU_VTAB _CNV_S_4_Enum_EDYND_173_S2 "" TAB_VERB 4 0 "Init" 1 "RS" 2 "HS" 3 "Angleich" /end COMPU_VTAB
/begin COMPU_VTAB _CNV_S_7_Enum_EDYND_174_S2 "" TAB_VERB 7 0 "Init" 1 "Wartezeit" 2 "Schaltung" 3 "Folgeschaltung" 4 "Abschluss" 5 "Aenderungsschaltung" 6 "Abbruchschaltung" /end COMPU_VTAB
/begin COMPU_VTAB _CNV_S_3_Enum_EDYND_175_S2 "" TAB_VERB 3 0 "Init" 1 "N_MOT" 2 "N_AB-Berechnung" /end COMPU_VTAB
/begin COMPU_VTAB _CNV_S_9_Enum_EDYND_176_S2 "" TAB_VERB 9 0 "Init" 1 "Segeleinstieg" 2 "Anzeige_SOLLLL" 3 "Uebergang_Anzeige_MOT" 4 "Anzeige_MOT" 5 "Segelausstieg" 6 "Wartezeit_Segelausstieg" 7 "Uebergang_Anzeige_SOLLLL" 8 "Uebergang_Rangieren_und_Neutral" /end COMPU_VTAB
/begin COMPU_VTAB _CNV_S_3_Enum_EHOTD_180_S2 "" TAB_VERB 3 0 "DUE" 1 "DUE_RSZVERBOT" 2 "HOTMODE" /end COMPU_VTAB
/begin COMPU_VTAB _CNV_S_6_Enum_EMSGI_193_S2 "" TAB_VERB 6 0 "KEINE_MSG_NEU" 2 "NUR_SYNC_MSG_NEU" 4 "NUR_MATCH_MSG_NEU" 6 "SYNC_UND_MATCH_MSG_NEU" 57 "NAV_MSG_NEU" 61 "NAV_UND_MATCH_MSG_NEU" /end COMPU_VTAB
/begin COMPU_VTAB _CNV_S_4_Enum_EBLIN_194_S2 "" TAB_VERB 4 0 "BLINKER_AUS" 1 "BLINKER_LINKS" 2 "BLINKER_RECHTS" 3 "BLINKER_BEIDE" /end COMPU_VTAB
/begin COMPU_VTAB _CNV_S_3_Enum_ETOPO_195_S2 "" TAB_VERB 3 0 "NICHT_ERKANNT" 1 "TOPOLOGIE_ERKANNT" 2 "AUF_TOPOLOGIE" /end COMPU_VTAB
/begin COMPU_VTAB _CNV_S_10_Enum_EADAS_196_S2 "" TAB_VERB 10 0 "unbekannt" 1 "li_0-60" 2 "re_0-60" 3 "li_60-75" 4 "re_60-75" 5 "li_75-180" 6 "re_75-180" 7 "T-Kreuzung" 8 "4er" 9 "4er_kmplx" /end COMPU_VTAB
/begin COMPU_VTAB _CNV_S_6_Enum_EANZG_205_S2 "" TAB_VERB 6 0 "GANGART_AUTOMAT" 1 "GANGART_MANUELL" 2 "GANGART_SPORT" 3 "GANGART_FAS" 4 "GANGART_ZKA" 5 "GANGART_LMODE" /end COMPU_VTAB
/begin COMPU_VTAB _CNV_S_6_Enum_EANZE_208_S2 "" TAB_VERB 6 0 "MANUELLGANG_ANZ" 1 "ISTGANG_ANZ" 2 "ZIELGANG_ANZ" 3 "AUTOMATGANG_ANZ" 4 "LMODEGANG_ANZ" 5 "KEINGANG_ANZ" /end COMPU_VTAB
/begin COMPU_VTAB _CNV_S_2_Enum_EWKAN_217_S2 "" TAB_VERB 2 0 "GER_WKSOLL" 1 "ZU_WKSOLL" /end COMPU_VTAB
/begin COMPU_VTAB _CNV_S_43_Enum_EQSHI_219_S2 "" TAB_VERB 43 0 "ZWANGSCH_STEP" 1 "FT_BR_E" 2 "FT_BR_S" 3 "FT_BR_XS" 4 "GWDKKD1" 5 "GWDKKD2" 6 "MFRS" 7 "MFHS" 8 "WDKKD1" 9 "WDKKD2" 10 "WDKKD3" 11 "NULLAST" 12 "DSC_DTC" 13 "DSC_AUS" 14 "S_QS3_SOLL" 15 "ANH" 16 "ASC" 17 "A_Q_KURVE" 18 "TEMP_GETR" 19 "TEMP_KUP_A" 20 "WL2" 21 "ECO" 22 "COD_GETRTYP" 23 "EXCFKT1" 24 "EXCFKT2" 25 "EXCFKT3" 26 "EXCFKT4" 27 "EXCFKT5" 28 "EXCFKT6" 29 "EXCFKT7" 30 "EXCFKT8" 31 "HOCHSCH" 32 "RUECKSCH" 33 "ISTGANG_1" 34 "ISTGANG_2" 35 "ISTGANG_3" 36 "ISTGANG_4" 37 "ISTGANG_5" 38 "ISTGANG_6" 39 "ISTGANG_7" 40 "ISTGANG_8" 41 "ISTGANG_9" 42 "DYNAMIK" /end COMPU_VTAB
/begin COMPU_VTAB _CNV_S_16_Enum_EIDXG_225_S2 "" TAB_VERB 16 0 "Index_0" 1 "Index_1" 2 "Index_2" 3 "Index_3" 4 "Index_4" 5 "Index_5" 6 "Index_6" 7 "Index_7" 8 "Index_8" 9 "Index_9" 10 "Index_10" 11 "Index_11" 12 "Index_12" 13 "Index_13" 14 "Index_14" 15 "SIGNAL_UNGUELTIG" DEFAULT_VALUE "0" /end COMPU_VTAB
/begin COMPU_VTAB _CNV_S_3_Enum_EQSHI_226_S2 "" TAB_VERB 3 0 "INIT_QSHIFT" 1 "WAIT_QSHIFT" 2 "ACTIVE_QSHIFT" /end COMPU_VTAB
/begin COMPU_VTAB _CNV_S_3_Enum_EDYN__227_S2 "" TAB_VERB 3 0 "DYN_DMRS_PME_KOMFORT" 1 "DYN_DMRS_PME_QS1" 2 "DYN_DMRS_PME_QS2" /end COMPU_VTAB
/begin COMPU_VTAB _CNV_S_3_Enum_EDYN__228_S2 "" TAB_VERB 3 0 "DYN_FPKF_KOMFORT" 1 "DYN_FPKF_SPORT" 2 "DYN_FPKF_ECO" /end COMPU_VTAB
/begin COMPU_VTAB _CNV_S_4_Enum_EDYN__229_S2 "" TAB_VERB 4 0 "DYN_HS_KOMFORT" 1 "DYN_HS_QS1" 2 "DYN_HS_QS2" 3 "DYN_HS_QS3" /end COMPU_VTAB
/begin COMPU_VTAB _CNV_S_4_Enum_EDYN__230_S2 "" TAB_VERB 4 0 "DYN_RS_PME_KOMFORT" 1 "DYN_RS_PME_QS1" 2 "DYN_RS_PME_QS2" 3 "DYN_RS_KOMFORT" /end COMPU_VTAB
/begin COMPU_VTAB _CNV_S_2_Enum_EDYN__231_S2 "" TAB_VERB 2 0 "DYN_WKANBIND_KOMFORT" 1 "DYN_WKANBIND_DIREKT" /end COMPU_VTAB
/begin COMPU_VTAB _CNV_S_5_Enum_EVALI_246_S2 "" TAB_VERB 5 0 "INVALID" 2 "INVALID_LDM" 5 "DREHZAHLGRENZEN" 10 "DREHZAHLEN" 30 "BEWERTUNG" /end COMPU_VTAB
/begin COMPU_VTAB _CNV_S_6_Enum_EZKAT_247_S2 "" TAB_VERB 6 -1 "ZKA_IDX_DEAKTIVIERT" 0 "ZKA_IDX1" 1 "ZKA_IDX2" 2 "ZKA_IDX3" 3 "ZKA_IDX4" 4 "ZKA_IDX5" /end COMPU_VTAB
/begin COMPU_VTAB _CNV_S_3_Enum_EEFAH_251_S2 "" TAB_VERB 3 0 "KEIN_AUSSTIEG" 1 "AUSSTIEG_EMODE" 2 "AUSSTIEG_AUTOEV" /end COMPU_VTAB
/begin COMPU_VTAB _CNV_S_2_Enum_ESPOR_253_S2 "" TAB_VERB 2 0 "AUTOMATC" 1 "SPORT" /end COMPU_VTAB
/begin COMPU_VTAB _CNV_S_3_Enum_EGV_255_S2 "" TAB_VERB 3 0 "INITIALISIERUNG" 1 "GANGFINDUNG_AKTIV" 2 "SCHALTPUNKTSTEUERUNG_AKTIV" /end COMPU_VTAB
/begin COMPU_VTAB _CNV_S_3_Enum_EB_ST_256_S2 "" TAB_VERB 3 0 "B_NOT_PUSHED" 1 "B_PUSHED" 2 "B_FAILURE" /end COMPU_VTAB
/begin COMPU_VTAB _CNV_S_4_Enum_EB_257_S2 "" TAB_VERB 4 0 "NICHT_GETRETEN" 1 "UEB_NICHT_GETR_GETR" 2 "DAUERHAFT_GETRETEN" 3 "UEB_GETR_NICHT_GETR" /end COMPU_VTAB
/begin COMPU_VTAB _CNV_S_4_Enum_EBSMO_258_S2 "" TAB_VERB 4 0 "BSMODE_INIT" 1 "BSMODE_STBY" 2 "BSMODE_CRUISE" 3 "BSMODE_LMPH" /end COMPU_VTAB
/begin COMPU_VTAB _CNV_S_7_Enum_EBSMO_259_S2 "" TAB_VERB 7 0 "NO_TRANS" 1 "INIT_STBY" 2 "STBY_CRUISE" 3 "STBY_LMPH" 4 "CRUISE_STBY" 5 "CRUISE_LMPH" 6 "LMPH_STBY" /end COMPU_VTAB
/begin COMPU_VTAB _CNV_S_7_Enum_ESTAR_260_S2 "" TAB_VERB 7 0 "STARTLM_NICHT" 1 "STARTLM_STEP1" 2 "STARTLM_STEP2" 3 "STARTLM_STEP3" 4 "STARTLM_TIPP1" 5 "STARTLM_TIPP2" 6 "STARTLM_OK" /end COMPU_VTAB
/begin COMPU_VTAB _CNV_S_7_Enum_EGEAR_267_S2 "" TAB_VERB 7 0 "NO_GEAR_REDUCTION" 1 "REDUCE_GEAR_1" 2 "REDUCE_GEAR_2" 3 "REDUCE_GEAR_3" 4 "REDUCE_GEAR_4" 5 "REDUCE_GEAR_5" 6 "REDUCE_GEAR_6" /end COMPU_VTAB
/begin COMPU_VTAB _CNV_S_3_Enum_EPOSS_268_S2 "" TAB_VERB 3 0 "POS_CORRECT" 1 "POS_INTERMEDIATE" 2 "POS_ILLEGAL" /end COMPU_VTAB
/begin COMPU_VTAB _CNV_S_2_Enum_ERRDS_271_S2 "" TAB_VERB 2 0 "ABS_DSC_Ok" 1 "ABS_DSC_nOk" /end COMPU_VTAB
/begin COMPU_VTAB eASD_S6_S3 "" TAB_VERB 2 0 "E_K0" 1 "E_K0ASD" /end COMPU_VTAB
/begin COMPU_VTAB eInterpretationStatus_S6_S3 "" TAB_VERB 3 0 "E_Signal_ok" 1 "E_Signal_Ersatzwert" 2 "E_Signal_Fehlerhaft" /end COMPU_VTAB
/begin COMPU_VTAB eBefuellung_S6_S3 "" TAB_VERB 3 0 "E_NORMAL" 1 "E_OPTIMIERT" 2 "E_REDUZIERT" /end COMPU_VTAB
/begin COMPU_VTAB eKFL_S6_S3 "" TAB_VERB 3 0 "E_KEIN_KFL" 1 "E_KFL_VORWAERTS" 2 "E_KFL_RUECKWAERTS" /end COMPU_VTAB
/begin COMPU_VTAB eSchaltung_S6_S3 "" TAB_VERB 5 -2 "E_Mehrfachrueckschaltung" -1 "E_Rueckschaltung" 0 "E_KeineSchaltung_k0" 1 "E_Hochschaltung" 2 "E_Mehrfachochschaltung" /end COMPU_VTAB
/begin COMPU_VTAB eSchaltungsPhase_S6_S3 "" TAB_VERB 5 0 "KeineSchaltung" 1 "SchaltBefehl" 2 "Gleitphase" 3 "VerschachtelteSchaltung" 4 "Schaltungsende" /end COMPU_VTAB
/begin RECORD_LAYOUT ZF_KW_NAT8_S1_S3 FNC_VALUES 1 UBYTE COLUMN_DIR DIRECT /end RECORD_LAYOUT
/begin RECORD_LAYOUT ZF_KW_NAT16_S1_S3 FNC_VALUES 1 UWORD COLUMN_DIR DIRECT /end RECORD_LAYOUT
/begin RECORD_LAYOUT ZF_KW_NAT32_S1_S3 FNC_VALUES 1 ULONG COLUMN_DIR DIRECT /end RECORD_LAYOUT
/begin RECORD_LAYOUT ZF_KW_INT8_S1_S3 FNC_VALUES 1 SBYTE COLUMN_DIR DIRECT /end RECORD_LAYOUT
/begin RECORD_LAYOUT ZF_KW_INT16_S1_S3 FNC_VALUES 1 SWORD COLUMN_DIR DIRECT /end RECORD_LAYOUT
/begin RECORD_LAYOUT ZF_KW_INT32_S1_S3 FNC_VALUES 1 SLONG COLUMN_DIR DIRECT /end RECORD_LAYOUT
/begin RECORD_LAYOUT ZF_TAB_NAT8_S1_S3 FNC_VALUES 2 UBYTE COLUMN_DIR DIRECT NO_AXIS_PTS_X 1 ULONG /end RECORD_LAYOUT
/begin RECORD_LAYOUT ZF_TAB_NAT16_S1_S3 FNC_VALUES 2 UWORD COLUMN_DIR DIRECT NO_AXIS_PTS_X 1 ULONG /end RECORD_LAYOUT
/begin RECORD_LAYOUT ZF_TAB_NAT32_S1_S3 FNC_VALUES 2 ULONG COLUMN_DIR DIRECT NO_AXIS_PTS_X 1 ULONG /end RECORD_LAYOUT
/begin RECORD_LAYOUT ZF_TAB_INT8_S1_S3 FNC_VALUES 2 SBYTE COLUMN_DIR DIRECT NO_AXIS_PTS_X 1 ULONG /end RECORD_LAYOUT
/begin RECORD_LAYOUT ZF_TAB_INT16_S1_S3 FNC_VALUES 2 SWORD COLUMN_DIR DIRECT NO_AXIS_PTS_X 1 ULONG /end RECORD_LAYOUT
/begin RECORD_LAYOUT ZF_TAB_INT32_S1_S3 FNC_VALUES 2 SLONG COLUMN_DIR DIRECT NO_AXIS_PTS_X 1 ULONG /end RECORD_LAYOUT
/begin RECORD_LAYOUT ZF_TAB2D_NAT8_S1_S3 FNC_VALUES 3 UBYTE ROW_DIR DIRECT NO_AXIS_PTS_X 1 ULONG NO_AXIS_PTS_Y 2 ULONG /end RECORD_LAYOUT
/begin RECORD_LAYOUT ZF_TAB2D_NAT16_S1_S3 FNC_VALUES 3 UWORD ROW_DIR DIRECT NO_AXIS_PTS_X 1 ULONG NO_AXIS_PTS_Y 2 ULONG /end RECORD_LAYOUT
/begin RECORD_LAYOUT ZF_TAB2D_NAT32_S1_S3 FNC_VALUES 3 ULONG ROW_DIR DIRECT NO_AXIS_PTS_X 1 ULONG NO_AXIS_PTS_Y 2 ULONG /end RECORD_LAYOUT
/begin RECORD_LAYOUT ZF_TAB2D_INT8_S1_S3 FNC_VALUES 3 SBYTE ROW_DIR DIRECT NO_AXIS_PTS_X 1 ULONG NO_AXIS_PTS_Y 2 ULONG /end RECORD_LAYOUT
/begin RECORD_LAYOUT ZF_TAB2D_INT16_S1_S3 FNC_VALUES 3 SWORD ROW_DIR DIRECT NO_AXIS_PTS_X 1 ULONG NO_AXIS_PTS_Y 2 ULONG /end RECORD_LAYOUT
/begin RECORD_LAYOUT ZF_TAB2D_INT32_S1_S3 FNC_VALUES 3 SLONG ROW_DIR DIRECT NO_AXIS_PTS_X 1 ULONG NO_AXIS_PTS_Y 2 ULONG /end RECORD_LAYOUT
/begin RECORD_LAYOUT ZF_KL_NAT8_S1_S3 FNC_VALUES 3 UBYTE COLUMN_DIR DIRECT AXIS_PTS_X 2 UBYTE INDEX_INCR DIRECT NO_AXIS_PTS_X 1 ULONG /end RECORD_LAYOUT
/begin RECORD_LAYOUT ZF_KL_NAT16_S1_S3 FNC_VALUES 3 UWORD COLUMN_DIR DIRECT AXIS_PTS_X 2 UWORD INDEX_INCR DIRECT NO_AXIS_PTS_X 1 ULONG /end RECORD_LAYOUT
/begin RECORD_LAYOUT ZF_KL_NAT32_S1_S3 FNC_VALUES 3 ULONG COLUMN_DIR DIRECT AXIS_PTS_X 2 ULONG INDEX_INCR DIRECT NO_AXIS_PTS_X 1 ULONG /end RECORD_LAYOUT
/begin RECORD_LAYOUT ZF_KL_INT8_S1_S3 FNC_VALUES 3 SBYTE COLUMN_DIR DIRECT AXIS_PTS_X 2 SBYTE INDEX_INCR DIRECT NO_AXIS_PTS_X 1 ULONG /end RECORD_LAYOUT
/begin RECORD_LAYOUT ZF_KL_INT16_S1_S3 FNC_VALUES 3 SWORD COLUMN_DIR DIRECT AXIS_PTS_X 2 SWORD INDEX_INCR DIRECT NO_AXIS_PTS_X 1 ULONG /end RECORD_LAYOUT
/begin RECORD_LAYOUT ZF_KL_INT32_S1_S3 FNC_VALUES 3 SLONG COLUMN_DIR DIRECT AXIS_PTS_X 2 SLONG INDEX_INCR DIRECT NO_AXIS_PTS_X 1 ULONG /end RECORD_LAYOUT
/begin RECORD_LAYOUT ZF_KF_NAT8_S1_S3 FNC_VALUES 5 UBYTE ROW_DIR DIRECT AXIS_PTS_X 3 UBYTE INDEX_INCR DIRECT AXIS_PTS_Y 4 UBYTE INDEX_INCR DIRECT NO_AXIS_PTS_X 1 ULONG NO_AXIS_PTS_Y 2 ULONG /end RECORD_LAYOUT
/begin RECORD_LAYOUT ZF_KF_NAT16_S1_S3 FNC_VALUES 5 UWORD ROW_DIR DIRECT AXIS_PTS_X 3 UWORD INDEX_INCR DIRECT AXIS_PTS_Y 4 UWORD INDEX_INCR DIRECT NO_AXIS_PTS_X 1 ULONG NO_AXIS_PTS_Y 2 ULONG /end RECORD_LAYOUT
/begin RECORD_LAYOUT ZF_KF_NAT32_S1_S3 FNC_VALUES 5 ULONG ROW_DIR DIRECT AXIS_PTS_X 3 ULONG INDEX_INCR DIRECT AXIS_PTS_Y 4 ULONG INDEX_INCR DIRECT NO_AXIS_PTS_X 1 ULONG NO_AXIS_PTS_Y 2 ULONG /end RECORD_LAYOUT
/begin RECORD_LAYOUT ZF_KF_INT8_S1_S3 FNC_VALUES 5 SBYTE ROW_DIR DIRECT AXIS_PTS_X 3 SBYTE INDEX_INCR DIRECT AXIS_PTS_Y 4 SBYTE INDEX_INCR DIRECT NO_AXIS_PTS_X 1 ULONG NO_AXIS_PTS_Y 2 ULONG /end RECORD_LAYOUT
/begin RECORD_LAYOUT ZF_KF_INT16_S1_S3 FNC_VALUES 5 SWORD ROW_DIR DIRECT AXIS_PTS_X 3 SWORD INDEX_INCR DIRECT AXIS_PTS_Y 4 SWORD INDEX_INCR DIRECT NO_AXIS_PTS_X 1 ULONG NO_AXIS_PTS_Y 2 ULONG /end RECORD_LAYOUT
/begin RECORD_LAYOUT ZF_KF_INT32_S1_S3 FNC_VALUES 5 SLONG ROW_DIR DIRECT AXIS_PTS_X 3 SLONG INDEX_INCR DIRECT AXIS_PTS_Y 4 SLONG INDEX_INCR DIRECT NO_AXIS_PTS_X 1 ULONG NO_AXIS_PTS_Y 2 ULONG /end RECORD_LAYOUT
/begin RECORD_LAYOUT ZF_KW_INT32_S2_S3 FNC_VALUES 1 SLONG COLUMN_DIR DIRECT /end RECORD_LAYOUT
/begin RECORD_LAYOUT ZF_TAB_INT8_S2_S3 FNC_VALUES 2 SBYTE COLUMN_DIR DIRECT NO_AXIS_PTS_X 1 ULONG /end RECORD_LAYOUT
/begin RECORD_LAYOUT ZF_TAB_INT16_S2_S3 FNC_VALUES 2 SWORD COLUMN_DIR DIRECT NO_AXIS_PTS_X 1 ULONG /end RECORD_LAYOUT
/begin RECORD_LAYOUT ZF_TAB_INT32_S2_S3 FNC_VALUES 2 SLONG COLUMN_DIR DIRECT NO_AXIS_PTS_X 1 ULONG /end RECORD_LAYOUT
/begin RECORD_LAYOUT ZF_TAB_OI_NAT8_S2_S3 FNC_VALUES 1 UBYTE COLUMN_DIR DIRECT /end RECORD_LAYOUT
/begin RECORD_LAYOUT ZF_TAB_OI_NAT16_S2_S3 FNC_VALUES 1 UWORD COLUMN_DIR DIRECT /end RECORD_LAYOUT
/begin RECORD_LAYOUT ZF_TAB_OI_NAT32_S2_S3 FNC_VALUES 1 ULONG COLUMN_DIR DIRECT /end RECORD_LAYOUT
/begin RECORD_LAYOUT ZF_TAB_OI_INT8_S2_S3 FNC_VALUES 1 SBYTE COLUMN_DIR DIRECT /end RECORD_LAYOUT
/begin RECORD_LAYOUT ZF_TAB_OI_INT16_S2_S3 FNC_VALUES 1 SWORD COLUMN_DIR DIRECT /end RECORD_LAYOUT
/begin RECORD_LAYOUT ZF_TAB_OI_INT32_S2_S3 FNC_VALUES 1 SLONG COLUMN_DIR DIRECT /end RECORD_LAYOUT
/begin RECORD_LAYOUT ZF_TAB2D_NAT32_S2_S3 FNC_VALUES 3 ULONG ROW_DIR DIRECT NO_AXIS_PTS_X 1 ULONG NO_AXIS_PTS_Y 2 ULONG /end RECORD_LAYOUT
/begin RECORD_LAYOUT ZF_TAB2D_INT8_S2_S3 FNC_VALUES 3 SBYTE ROW_DIR DIRECT NO_AXIS_PTS_X 1 ULONG NO_AXIS_PTS_Y 2 ULONG /end RECORD_LAYOUT
/begin RECORD_LAYOUT ZF_TAB2D_INT16_S2_S3 FNC_VALUES 3 SWORD ROW_DIR DIRECT NO_AXIS_PTS_X 1 ULONG NO_AXIS_PTS_Y 2 ULONG /end RECORD_LAYOUT
/begin RECORD_LAYOUT ZF_TAB2D_INT32_S2_S3 FNC_VALUES 3 SLONG ROW_DIR DIRECT NO_AXIS_PTS_X 1 ULONG NO_AXIS_PTS_Y 2 ULONG /end RECORD_LAYOUT
/begin RECORD_LAYOUT ZF_TAB2D_OI_NAT8_S2_S3 FNC_VALUES 1 UBYTE ROW_DIR DIRECT /end RECORD_LAYOUT
/begin RECORD_LAYOUT ZF_TAB2D_OI_NAT16_S2_S3 FNC_VALUES 1 UWORD ROW_DIR DIRECT /end RECORD_LAYOUT
/begin RECORD_LAYOUT ZF_TAB2D_OI_NAT32_S2_S3 FNC_VALUES 1 ULONG ROW_DIR DIRECT /end RECORD_LAYOUT
/begin RECORD_LAYOUT ZF_TAB2D_OI_INT8_S2_S3 FNC_VALUES 1 SBYTE ROW_DIR DIRECT /end RECORD_LAYOUT
/begin RECORD_LAYOUT ZF_TAB2D_OI_INT16_S2_S3 FNC_VALUES 1 SWORD ROW_DIR DIRECT /end RECORD_LAYOUT
/begin RECORD_LAYOUT ZF_TAB2D_OI_INT32_S2_S3 FNC_VALUES 1 SLONG ROW_DIR DIRECT /end RECORD_LAYOUT
/begin RECORD_LAYOUT ZF_KL_INT8_S2_S3 FNC_VALUES 3 SBYTE COLUMN_DIR DIRECT AXIS_PTS_X 2 SBYTE INDEX_INCR DIRECT NO_AXIS_PTS_X 1 ULONG /end RECORD_LAYOUT
/begin RECORD_LAYOUT ZF_KL_INT32_S2_S3 FNC_VALUES 3 SLONG COLUMN_DIR DIRECT AXIS_PTS_X 2 SLONG INDEX_INCR DIRECT NO_AXIS_PTS_X 1 ULONG /end RECORD_LAYOUT
/begin RECORD_LAYOUT ZF_KF_NAT8_S2_S3 FNC_VALUES 5 UBYTE ROW_DIR DIRECT AXIS_PTS_X 3 UBYTE INDEX_INCR DIRECT AXIS_PTS_Y 4 UBYTE INDEX_INCR DIRECT NO_AXIS_PTS_X 1 ULONG NO_AXIS_PTS_Y 2 ULONG /end RECORD_LAYOUT
/begin RECORD_LAYOUT ZF_KF_NAT16_S2_S3 FNC_VALUES 5 UWORD ROW_DIR DIRECT AXIS_PTS_X 3 UWORD INDEX_INCR DIRECT AXIS_PTS_Y 4 UWORD INDEX_INCR DIRECT NO_AXIS_PTS_X 1 ULONG NO_AXIS_PTS_Y 2 ULONG /end RECORD_LAYOUT
/begin RECORD_LAYOUT ZF_KF_NAT32_S2_S3 FNC_VALUES 5 ULONG ROW_DIR DIRECT AXIS_PTS_X 3 ULONG INDEX_INCR DIRECT AXIS_PTS_Y 4 ULONG INDEX_INCR DIRECT NO_AXIS_PTS_X 1 ULONG NO_AXIS_PTS_Y 2 ULONG /end RECORD_LAYOUT
/begin RECORD_LAYOUT ZF_KF_INT8_S2_S3 FNC_VALUES 5 SBYTE ROW_DIR DIRECT AXIS_PTS_X 3 SBYTE INDEX_INCR DIRECT AXIS_PTS_Y 4 SBYTE INDEX_INCR DIRECT NO_AXIS_PTS_X 1 ULONG NO_AXIS_PTS_Y 2 ULONG /end RECORD_LAYOUT
/begin RECORD_LAYOUT ZF_KF_INT16_S2_S3 FNC_VALUES 5 SWORD ROW_DIR DIRECT AXIS_PTS_X 3 SWORD INDEX_INCR DIRECT AXIS_PTS_Y 4 SWORD INDEX_INCR DIRECT NO_AXIS_PTS_X 1 ULONG NO_AXIS_PTS_Y 2 ULONG /end RECORD_LAYOUT
/begin RECORD_LAYOUT ZF_KF_INT32_S2_S3 FNC_VALUES 5 SLONG ROW_DIR DIRECT AXIS_PTS_X 3 SLONG INDEX_INCR DIRECT AXIS_PTS_Y 4 SLONG INDEX_INCR DIRECT NO_AXIS_PTS_X 1 ULONG NO_AXIS_PTS_Y 2 ULONG /end RECORD_LAYOUT
/begin RECORD_LAYOUT ZF_KW_INT8_S3_S3 FNC_VALUES 1 SBYTE COLUMN_DIR DIRECT /end RECORD_LAYOUT
/begin RECORD_LAYOUT ZF_KW_INT16_S3_S3 FNC_VALUES 1 SWORD COLUMN_DIR DIRECT /end RECORD_LAYOUT
/begin RECORD_LAYOUT ZF_KW_INT32_S3_S3 FNC_VALUES 1 SLONG COLUMN_DIR DIRECT /end RECORD_LAYOUT
/begin RECORD_LAYOUT ZF_TAB_NAT16_S3_S3 FNC_VALUES 2 UWORD COLUMN_DIR DIRECT NO_AXIS_PTS_X 1 ULONG /end RECORD_LAYOUT
/begin RECORD_LAYOUT ZF_TAB_NAT32_S3_S3 FNC_VALUES 2 ULONG COLUMN_DIR DIRECT NO_AXIS_PTS_X 1 ULONG /end RECORD_LAYOUT
/begin RECORD_LAYOUT ZF_TAB_INT8_S3_S3 FNC_VALUES 2 SBYTE COLUMN_DIR DIRECT NO_AXIS_PTS_X 1 ULONG /end RECORD_LAYOUT
/begin RECORD_LAYOUT ZF_TAB_INT16_S3_S3 FNC_VALUES 2 SWORD COLUMN_DIR DIRECT NO_AXIS_PTS_X 1 ULONG /end RECORD_LAYOUT
/begin RECORD_LAYOUT ZF_TAB_INT32_S3_S3 FNC_VALUES 2 SLONG COLUMN_DIR DIRECT NO_AXIS_PTS_X 1 ULONG /end RECORD_LAYOUT
/begin RECORD_LAYOUT ZF_TAB_OI_NAT8_S3_S3 FNC_VALUES 1 UBYTE COLUMN_DIR DIRECT /end RECORD_LAYOUT
/begin RECORD_LAYOUT ZF_TAB_OI_NAT16_S3_S3 FNC_VALUES 1 UWORD COLUMN_DIR DIRECT /end RECORD_LAYOUT
/begin RECORD_LAYOUT ZF_TAB_OI_NAT32_S3_S3 FNC_VALUES 1 ULONG COLUMN_DIR DIRECT /end RECORD_LAYOUT
/end MODULE
/end PROJECT
