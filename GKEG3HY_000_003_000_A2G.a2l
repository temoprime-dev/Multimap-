ASAP2_VERSION 1 51
/begin PROJECT _929_929 "Gen2_BMW_System_Supplier_Lib"
/begin HEADER "" VERSION "C_03_03" PROJECT_NO _929_929 /end HEADER
/begin MODULE DIM ""
/begin MOD_COMMON "" BYTE_ORDER MSB_FIRST ALIGNMENT_BYTE 1 ALIGNMENT_WORD 2 ALIGNMENT_LONG 4 ALIGNMENT_FLOAT32_IEEE 4 /end MOD_COMMON
/begin CHARACTERISTIC XTAB9SCHN_ABMINLO_LPA_DBM "" CURVE 0x275566 _REC_A1CUR_30_s2_u2_S2 32000 _CNV_R_R_Umr_1_zu_1_3_CM_S2 0 32000 FORMAT "%2.0"
 /begin AXIS_DESCR FIX_AXIS NO_INPUT_QUANTITY _CNV_S_9_Enum_EGANG_30_CM_S2 9 0 8 /begin FIX_AXIS_PAR_LIST 0 1 2 3 4 5 6 7 8 /end FIX_AXIS_PAR_LIST READ_ONLY /end AXIS_DESCR
/end CHARACTERISTIC
/begin CHARACTERISTIC XTAB9SCHN_ECK_MIN_MODWHYB "" CURVE 0x275578 _REC_A1CUR_30_s2_u2_S2 32000 _CNV_R_R_Umr_1_zu_1_3_CM_S2 0 32000 FORMAT "%2.0"
 /begin AXIS_DESCR FIX_AXIS NO_INPUT_QUANTITY _CNV_S_9_Enum_EGANG_30_CM_S2 9 0 8 /begin FIX_AXIS_PAR_LIST 0 1 2 3 4 5 6 7 8 /end FIX_AXIS_PAR_LIST READ_ONLY /end AXIS_DESCR
/end CHARACTERISTIC
/begin CHARACTERISTIC XTAB9SCHN_MAXAKT_TMS_DBM "" CURVE 0x275066 _REC_A1CUR_30_s2_u2_S2 32000 _CNV_R_R_Umr_1_zu_1_3_CM_S2 0 32000 FORMAT "%2.0"
 /begin AXIS_DESCR FIX_AXIS NO_INPUT_QUANTITY _CNV_S_9_Enum_EGANG_30_CM_S2 9 0 8 /begin FIX_AXIS_PAR_LIST 0 1 2 3 4 5 6 7 8 /end FIX_AXIS_PAR_LIST READ_ONLY /end AXIS_DESCR
/end CHARACTERISTIC
/begin CHARACTERISTIC XTAB9SCHN_MAXHI_TMS_DBM "" CURVE 0x275078 _REC_A1CUR_30_s2_u2_S2 32000 _CNV_R_R_Umr_1_zu_1_3_CM_S2 0 32000 FORMAT "%2.0"
 /begin AXIS_DESCR FIX_AXIS NO_INPUT_QUANTITY _CNV_S_9_Enum_EGANG_30_CM_S2 9 0 8 /begin FIX_AXIS_PAR_LIST 0 1 2 3 4 5 6 7 8 /end FIX_AXIS_PAR_LIST READ_ONLY /end AXIS_DESCR
/end CHARACTERISTIC
/begin CHARACTERISTIC XTAB9SCHN_MINAKT_AFU_DBM "" CURVE 0x27508A _REC_A1CUR_30_s2_u2_S2 32000 _CNV_R_R_Umr_1_zu_1_3_CM_S2 0 32000 FORMAT "%2.0"
 /begin AXIS_DESCR FIX_AXIS NO_INPUT_QUANTITY _CNV_S_9_Enum_EGANG_30_CM_S2 9 0 8 /begin FIX_AXIS_PAR_LIST 0 1 2 3 4 5 6 7 8 /end FIX_AXIS_PAR_LIST READ_ONLY /end AXIS_DESCR
/end CHARACTERISTIC
/begin CHARACTERISTIC XTAB9SCHN_MINAKT_DPFREG_DBM "" CURVE 0x27509C _REC_A1CUR_30_s2_u2_S2 32000 _CNV_R_R_Umr_1_zu_1_3_CM_S2 0 32000 FORMAT "%2.0"
 /begin AXIS_DESCR FIX_AXIS NO_INPUT_QUANTITY _CNV_S_9_Enum_EGANG_30_CM_S2 9 0 8 /begin FIX_AXIS_PAR_LIST 0 1 2 3 4 5 6 7 8 /end FIX_AXIS_PAR_LIST READ_ONLY /end AXIS_DESCR
/end CHARACTERISTIC
/begin CHARACTERISTIC XTAB9SCHN_MINAKT_HOTMODE_DBM "" CURVE 0x2750AE _REC_A1CUR_30_s2_u2_S2 32000 _CNV_R_R_Umr_1_zu_1_3_CM_S2 0 32000 FORMAT "%2.0"
 /begin AXIS_DESCR FIX_AXIS NO_INPUT_QUANTITY _CNV_S_9_Enum_EGANG_30_CM_S2 9 0 8 /begin FIX_AXIS_PAR_LIST 0 1 2 3 4 5 6 7 8 /end FIX_AXIS_PAR_LIST READ_ONLY /end AXIS_DESCR
/end CHARACTERISTIC
/begin CHARACTERISTIC XTAB9SCHN_MINLOW_AFU_DBM "" CURVE 0x2750C0 _REC_A1CUR_30_s2_u2_S2 32000 _CNV_R_R_Umr_1_zu_1_3_CM_S2 0 32000 FORMAT "%2.0"
 /begin AXIS_DESCR FIX_AXIS NO_INPUT_QUANTITY _CNV_S_9_Enum_EGANG_30_CM_S2 9 0 8 /begin FIX_AXIS_PAR_LIST 0 1 2 3 4 5 6 7 8 /end FIX_AXIS_PAR_LIST READ_ONLY /end AXIS_DESCR
/end CHARACTERISTIC
/begin CHARACTERISTIC XTAB9SCHN_MINLO_DPFREG_DBM "" CURVE 0x2750D2 _REC_A1CUR_30_s2_u2_S2 32000 _CNV_R_R_Umr_1_zu_1_3_CM_S2 0 32000 FORMAT "%2.0"
 /begin AXIS_DESCR FIX_AXIS NO_INPUT_QUANTITY _CNV_S_9_Enum_EGANG_30_CM_S2 9 0 8 /begin FIX_AXIS_PAR_LIST 0 1 2 3 4 5 6 7 8 /end FIX_AXIS_PAR_LIST READ_ONLY /end AXIS_DESCR
/end CHARACTERISTIC
/begin CHARACTERISTIC XTAB9SCHN_MINLO_HOTMODE_DBM "" CURVE 0x2750E4 _REC_A1CUR_30_s2_u2_S2 32000 _CNV_R_R_Umr_1_zu_1_3_CM_S2 0 32000 FORMAT "%2.0"
 /begin AXIS_DESCR FIX_AXIS NO_INPUT_QUANTITY _CNV_S_9_Enum_EGANG_30_CM_S2 9 0 8 /begin FIX_AXIS_PAR_LIST 0 1 2 3 4 5 6 7 8 /end FIX_AXIS_PAR_LIST READ_ONLY /end AXIS_DESCR
/end CHARACTERISTIC
/begin CHARACTERISTIC XTAB9S_NAB_ARSSTDENBL_DBM "" CURVE 0x2750F6 _REC_A1CUR_30_s2_s2_S2 1 _CNV_R_R_Umr_1_zu_1_2_CM_S2 0 1 FORMAT "%2.0"
 /begin AXIS_DESCR FIX_AXIS NO_INPUT_QUANTITY _CNV_S_9_Enum_EARSS_315_CM_S2 9 0 8 /begin FIX_AXIS_PAR_LIST 0 1 2 3 4 5 6 7 8 /end FIX_AXIS_PAR_LIST READ_ONLY /end AXIS_DESCR
/end CHARACTERISTIC
/begin CHARACTERISTIC XTAB9X10SCHN_ABMAXAKT_FAS_DBM "" MAP 0x26FD40 _REC_A1MAP_8_s2_u2_u2_S2 32000 _CNV_R_R_Umr_1_zu_1_3_CM_S2 0 32000 FORMAT "%2.0"
 /begin AXIS_DESCR FIX_AXIS NO_INPUT_QUANTITY _CNV_S_9_Enum_EGANG_30_CM_S2 9 0 8 /begin FIX_AXIS_PAR_LIST 0 1 2 3 4 5 6 7 8 /end FIX_AXIS_PAR_LIST READ_ONLY /end AXIS_DESCR
 /begin AXIS_DESCR FIX_AXIS NO_INPUT_QUANTITY _CNV_S_10_Enum_EDBMT_317_CM_S2 10 0 9 /begin FIX_AXIS_PAR_LIST 0 1 2 3 4 5 6 7 8 9 /end FIX_AXIS_PAR_LIST READ_ONLY /end AXIS_DESCR
/end CHARACTERISTIC
/begin CHARACTERISTIC XTAB9X10SCHN_ABMAXAKT_ZKA_DBM "" MAP 0x26FDF4 _REC_A1MAP_8_s2_u2_u2_S2 32000 _CNV_R_R_Umr_1_zu_1_3_CM_S2 0 32000 FORMAT "%2.0"
 /begin AXIS_DESCR FIX_AXIS NO_INPUT_QUANTITY _CNV_S_9_Enum_EGANG_30_CM_S2 9 0 8 /begin FIX_AXIS_PAR_LIST 0 1 2 3 4 5 6 7 8 /end FIX_AXIS_PAR_LIST READ_ONLY /end AXIS_DESCR
 /begin AXIS_DESCR FIX_AXIS NO_INPUT_QUANTITY _CNV_S_10_Enum_EDBMT_317_CM_S2 10 0 9 /begin FIX_AXIS_PAR_LIST 0 1 2 3 4 5 6 7 8 9 /end FIX_AXIS_PAR_LIST READ_ONLY /end AXIS_DESCR
/end CHARACTERISTIC
/begin CHARACTERISTIC XTAB9X10SCHN_ABMAXHI_FAS_DBM "" MAP 0x26FEA8 _REC_A1MAP_8_s2_u2_u2_S2 32000 _CNV_R_R_Umr_1_zu_1_3_CM_S2 0 32000 FORMAT "%2.0"
 /begin AXIS_DESCR FIX_AXIS NO_INPUT_QUANTITY _CNV_S_9_Enum_EGANG_30_CM_S2 9 0 8 /begin FIX_AXIS_PAR_LIST 0 1 2 3 4 5 6 7 8 /end FIX_AXIS_PAR_LIST READ_ONLY /end AXIS_DESCR
 /begin AXIS_DESCR FIX_AXIS NO_INPUT_QUANTITY _CNV_S_10_Enum_EDBMT_317_CM_S2 10 0 9 /begin FIX_AXIS_PAR_LIST 0 1 2 3 4 5 6 7 8 9 /end FIX_AXIS_PAR_LIST READ_ONLY /end AXIS_DESCR
/end CHARACTERISTIC
/begin CHARACTERISTIC XTAB9X10SCHN_ABMAXHI_ZKA_DBM "" MAP 0x26FF5C _REC_A1MAP_8_s2_u2_u2_S2 32000 _CNV_R_R_Umr_1_zu_1_3_CM_S2 0 32000 FORMAT "%2.0"
 /begin AXIS_DESCR FIX_AXIS NO_INPUT_QUANTITY _CNV_S_9_Enum_EGANG_30_CM_S2 9 0 8 /begin FIX_AXIS_PAR_LIST 0 1 2 3 4 5 6 7 8 /end FIX_AXIS_PAR_LIST READ_ONLY /end AXIS_DESCR
 /begin AXIS_DESCR FIX_AXIS NO_INPUT_QUANTITY _CNV_S_10_Enum_EDBMT_317_CM_S2 10 0 9 /begin FIX_AXIS_PAR_LIST 0 1 2 3 4 5 6 7 8 9 /end FIX_AXIS_PAR_LIST READ_ONLY /end AXIS_DESCR
/end CHARACTERISTIC
/begin CHARACTERISTIC XTAB9X10SCHN_ABMINAKT_FAS_DBM "" MAP 0x270010 _REC_A1MAP_8_s2_u2_u2_S2 32000 _CNV_R_R_Umr_1_zu_1_3_CM_S2 0 32000 FORMAT "%2.0"
 /begin AXIS_DESCR FIX_AXIS NO_INPUT_QUANTITY _CNV_S_9_Enum_EGANG_30_CM_S2 9 0 8 /begin FIX_AXIS_PAR_LIST 0 1 2 3 4 5 6 7 8 /end FIX_AXIS_PAR_LIST READ_ONLY /end AXIS_DESCR
 /begin AXIS_DESCR FIX_AXIS NO_INPUT_QUANTITY _CNV_S_10_Enum_EDBMT_317_CM_S2 10 0 9 /begin FIX_AXIS_PAR_LIST 0 1 2 3 4 5 6 7 8 9 /end FIX_AXIS_PAR_LIST READ_ONLY /end AXIS_DESCR
/end CHARACTERISTIC
/begin CHARACTERISTIC XTAB9X10SCHN_ABMINAKT_ZKA_DBM "" MAP 0x2700C4 _REC_A1MAP_8_s2_u2_u2_S2 32000 _CNV_R_R_Umr_1_zu_1_3_CM_S2 0 32000 FORMAT "%2.0"
 /begin AXIS_DESCR FIX_AXIS NO_INPUT_QUANTITY _CNV_S_9_Enum_EGANG_30_CM_S2 9 0 8 /begin FIX_AXIS_PAR_LIST 0 1 2 3 4 5 6 7 8 /end FIX_AXIS_PAR_LIST READ_ONLY /end AXIS_DESCR
 /begin AXIS_DESCR FIX_AXIS NO_INPUT_QUANTITY _CNV_S_10_Enum_EDBMT_317_CM_S2 10 0 9 /begin FIX_AXIS_PAR_LIST 0 1 2 3 4 5 6 7 8 9 /end FIX_AXIS_PAR_LIST READ_ONLY /end AXIS_DESCR
/end CHARACTERISTIC
/begin CHARACTERISTIC XTAB9X10SCHN_ABMINLO_FAS_DBM "" MAP 0x270178 _REC_A1MAP_8_s2_u2_u2_S2 32000 _CNV_R_R_Umr_1_zu_1_3_CM_S2 0 32000 FORMAT "%2.0"
 /begin AXIS_DESCR FIX_AXIS NO_INPUT_QUANTITY _CNV_S_9_Enum_EGANG_30_CM_S2 9 0 8 /begin FIX_AXIS_PAR_LIST 0 1 2 3 4 5 6 7 8 /end FIX_AXIS_PAR_LIST READ_ONLY /end AXIS_DESCR
 /begin AXIS_DESCR FIX_AXIS NO_INPUT_QUANTITY _CNV_S_10_Enum_EDBMT_317_CM_S2 10 0 9 /begin FIX_AXIS_PAR_LIST 0 1 2 3 4 5 6 7 8 9 /end FIX_AXIS_PAR_LIST READ_ONLY /end AXIS_DESCR
/end CHARACTERISTIC
/begin CHARACTERISTIC XTAB9X10SCHN_ABMINLO_ZKA_DBM "" MAP 0x27022C _REC_A1MAP_8_s2_u2_u2_S2 32000 _CNV_R_R_Umr_1_zu_1_3_CM_S2 0 32000 FORMAT "%2.0"
 /begin AXIS_DESCR FIX_AXIS NO_INPUT_QUANTITY _CNV_S_9_Enum_EGANG_30_CM_S2 9 0 8 /begin FIX_AXIS_PAR_LIST 0 1 2 3 4 5 6 7 8 /end FIX_AXIS_PAR_LIST READ_ONLY /end AXIS_DESCR
 /begin AXIS_DESCR FIX_AXIS NO_INPUT_QUANTITY _CNV_S_10_Enum_EDBMT_317_CM_S2 10 0 9 /begin FIX_AXIS_PAR_LIST 0 1 2 3 4 5 6 7 8 9 /end FIX_AXIS_PAR_LIST READ_ONLY /end AXIS_DESCR
/end CHARACTERISTIC
/begin CHARACTERISTIC XTAB9X2A_INSTAT_MODWHYB_DBM "" MAP 0x270DD4 _REC_A1MAP_9_s2_u1_u1_S2 10 _CNV_R_R_Umr_100_zu_54_CM_S2 -5 5 FORMAT "%4.2"
 /begin AXIS_DESCR FIX_AXIS Z_GANG_ZIEL_SAS _CNV_S_9_Enum_EGANG_30_CM_S2 9 0 8 FIX_AXIS_PAR_DIST 0 1 9 READ_ONLY /end AXIS_DESCR
 /begin AXIS_DESCR FIX_AXIS NO_INPUT_QUANTITY _CNV_R_R_Umr_1_zu_1_2_CM_S2 2 0 255 /begin FIX_AXIS_PAR_LIST 0 1 /end FIX_AXIS_PAR_LIST READ_ONLY /end AXIS_DESCR
/end CHARACTERISTIC
/begin CHARACTERISTIC XTAB9X2D_GANGMAX_MODEW_DBM "" MAP 0x275108 _REC_A1MAP_8_u1_u2_u1_S2 4 _CNV_R_R_Umr_1_zu_1_3_CM_S2 0 4 FORMAT "%2.0"
 /begin AXIS_DESCR FIX_AXIS NO_INPUT_QUANTITY _CNV_S_9_Enum_EGANG_30_CM_S2 9 0 8 /begin FIX_AXIS_PAR_LIST 0 1 2 3 4 5 6 7 8 /end FIX_AXIS_PAR_LIST READ_ONLY /end AXIS_DESCR
 /begin AXIS_DESCR FIX_AXIS NO_INPUT_QUANTITY _CNV_S_2_Enum_ELOWH_321_CM_S2 2 0 1 FIX_AXIS_PAR_DIST 0 1 2 READ_ONLY /end AXIS_DESCR
/end CHARACTERISTIC
/begin CHARACTERISTIC XTAB9X2D_GANGMAX_MODEW_FES_DBM "" MAP 0x27511A _REC_A1MAP_8_u1_u2_u1_S2 8 _CNV_R_R_Umr_1_zu_1_3_CM_S2 0 8 FORMAT "%2.0"
 /begin AXIS_DESCR FIX_AXIS NO_INPUT_QUANTITY _CNV_S_9_Enum_EGANG_30_CM_S2 9 0 8 /begin FIX_AXIS_PAR_LIST 0 1 2 3 4 5 6 7 8 /end FIX_AXIS_PAR_LIST READ_ONLY /end AXIS_DESCR
 /begin AXIS_DESCR FIX_AXIS NO_INPUT_QUANTITY _CNV_S_2_Enum_ELOWH_321_CM_S2 2 0 1 FIX_AXIS_PAR_DIST 0 1 2 READ_ONLY /end AXIS_DESCR
/end CHARACTERISTIC
/begin CHARACTERISTIC XTAB9X2SCHN_ABMAXHIS_FAS_DBM "" MAP 0x2702E0 _REC_A1MAP_8_s2_u2_u1_S2 10000 _CNV_R_R_Umr_1_zu_1_3_CM_S2 0 10000 FORMAT "%2.0"
 /begin AXIS_DESCR FIX_AXIS NO_INPUT_QUANTITY _CNV_S_9_Enum_EGANG_30_CM_S2 9 0 8 /begin FIX_AXIS_PAR_LIST 0 1 2 3 4 5 6 7 8 /end FIX_AXIS_PAR_LIST READ_ONLY /end AXIS_DESCR
 /begin AXIS_DESCR FIX_AXIS Z_AGS_MODBEDEL _CNV_S_2_Enum_EAGS_25_CM_S2 2 0 1 FIX_AXIS_PAR_DIST 0 1 2 READ_ONLY /end AXIS_DESCR
/end CHARACTERISTIC
/begin CHARACTERISTIC XTAB9X2SCHN_ABMINAKTS_FAS_DBM "" MAP 0x270304 _REC_A1MAP_8_s2_u2_u1_S2 10000 _CNV_R_R_Umr_1_zu_1_3_CM_S2 0 10000 FORMAT "%2.0"
 /begin AXIS_DESCR FIX_AXIS NO_INPUT_QUANTITY _CNV_S_9_Enum_EGANG_30_CM_S2 9 0 8 /begin FIX_AXIS_PAR_LIST 0 1 2 3 4 5 6 7 8 /end FIX_AXIS_PAR_LIST READ_ONLY /end AXIS_DESCR
 /begin AXIS_DESCR FIX_AXIS Z_AGS_MODBEDEL _CNV_S_2_Enum_EAGS_25_CM_S2 2 0 1 FIX_AXIS_PAR_DIST 0 1 2 READ_ONLY /end AXIS_DESCR
/end CHARACTERISTIC
/begin CHARACTERISTIC XTAB9X4Z_MAX_RFWSIDX_DBM "" MAP 0x270DF8 _REC_A1MAP_9_u1_u1_u2_S2 15 _CNV_S_16_Enum_EMAXR_326_CM_S2 0 15
 /begin AXIS_DESCR FIX_AXIS Z_AGSMOD_ECO_EFAHREN _CNV_S_4_Enum_EAGS__24_CM_S2 4 0 3 FIX_AXIS_PAR_DIST 0 1 4 READ_ONLY /end AXIS_DESCR
 /begin AXIS_DESCR FIX_AXIS NO_INPUT_QUANTITY _CNV_S_9_Enum_EGANG_30_CM_S2 9 0 8 /begin FIX_AXIS_PAR_LIST 0 1 2 3 4 5 6 7 8 /end FIX_AXIS_PAR_LIST READ_ONLY /end AXIS_DESCR
/end CHARACTERISTIC
/begin CHARACTERISTIC XTAB9X4Z_MIN_RFWSIDX_DBM "" MAP 0x270E1C _REC_A1MAP_9_u1_u1_u2_S2 15 _CNV_S_16_Enum_EMINR_327_CM_S2 0 15
 /begin AXIS_DESCR FIX_AXIS Z_AGSMOD_ECO_EFAHREN _CNV_S_4_Enum_EAGS__24_CM_S2 4 0 3 FIX_AXIS_PAR_DIST 0 1 4 READ_ONLY /end AXIS_DESCR
 /begin AXIS_DESCR FIX_AXIS NO_INPUT_QUANTITY _CNV_S_9_Enum_EGANG_30_CM_S2 9 0 8 /begin FIX_AXIS_PAR_LIST 0 1 2 3 4 5 6 7 8 /end FIX_AXIS_PAR_LIST READ_ONLY /end AXIS_DESCR
/end CHARACTERISTIC
/begin CHARACTERISTIC XTAB9X5SCHN_MINAKT_AEP_DBM "" MAP 0x27540C _REC_S3MAP_54_s2_s2_u2_S2 32000 _CNV_R_R_Umr_1_zu_1_3_CM_S2 0 32000 FORMAT "%2.0"
 /begin AXIS_DESCR STD_AXIS W_STEIGUNG_KORFILT _CNV_R_R_Umr_10_zu__9_CM_S2 5 -3276.8 3276.7 /end AXIS_DESCR
 /begin AXIS_DESCR FIX_AXIS NO_INPUT_QUANTITY _CNV_S_9_Enum_EGANG_30_CM_S2 9 0 8 /begin FIX_AXIS_PAR_LIST 0 1 2 3 4 5 6 7 8 /end FIX_AXIS_PAR_LIST READ_ONLY /end AXIS_DESCR
/end CHARACTERISTIC
/begin CHARACTERISTIC XTAB9X5SCHN_MINAK_REKUPRS_DBM "" MAP 0x27512C _REC_A1MAP_8_s2_u1_u2_S2 10000 _CNV_R_R_Umr_1_zu_1_3_CM_S2 0 10000 FORMAT "%2.0"
 /begin AXIS_DESCR FIX_AXIS Z_REKUP_IDX_DBM _CNV_S_5_Enum_REKUP_320_CM_S2 5 0 4 /begin FIX_AXIS_PAR_LIST 0 1 2 3 4 /end FIX_AXIS_PAR_LIST READ_ONLY /end AXIS_DESCR
 /begin AXIS_DESCR FIX_AXIS NO_INPUT_QUANTITY _CNV_S_9_Enum_EGANG_30_CM_S2 9 0 8 /begin FIX_AXIS_PAR_LIST 0 1 2 3 4 5 6 7 8 /end FIX_AXIS_PAR_LIST READ_ONLY /end AXIS_DESCR
/end CHARACTERISTIC
/begin CHARACTERISTIC XTAB9X5SCHN_MINLO_AEP_DBM "" MAP 0x275472 _REC_S3MAP_54_s2_s2_u2_S2 32000 _CNV_R_R_Umr_1_zu_1_3_CM_S2 0 32000 FORMAT "%2.0"
 /begin AXIS_DESCR STD_AXIS W_STEIGUNG_KORFILT _CNV_R_R_Umr_10_zu__9_CM_S2 5 -3276.8 3276.7 /end AXIS_DESCR
 /begin AXIS_DESCR FIX_AXIS NO_INPUT_QUANTITY _CNV_S_9_Enum_EGANG_30_CM_S2 9 0 8 /begin FIX_AXIS_PAR_LIST 0 1 2 3 4 5 6 7 8 /end FIX_AXIS_PAR_LIST READ_ONLY /end AXIS_DESCR
/end CHARACTERISTIC
/begin CHARACTERISTIC XTAB9X5SCHN_MINLO_REKUPRS_DBM "" MAP 0x275186 _REC_A1MAP_8_s2_u1_u2_S2 10000 _CNV_R_R_Umr_1_zu_1_3_CM_S2 0 10000 FORMAT "%2.0"
 /begin AXIS_DESCR FIX_AXIS Z_REKUP_IDX_DBM _CNV_S_5_Enum_REKUP_320_CM_S2 5 0 4 /begin FIX_AXIS_PAR_LIST 0 1 2 3 4 /end FIX_AXIS_PAR_LIST READ_ONLY /end AXIS_DESCR
 /begin AXIS_DESCR FIX_AXIS NO_INPUT_QUANTITY _CNV_S_9_Enum_EGANG_30_CM_S2 9 0 8 /begin FIX_AXIS_PAR_LIST 0 1 2 3 4 5 6 7 8 /end FIX_AXIS_PAR_LIST READ_ONLY /end AXIS_DESCR
/end CHARACTERISTIC
/begin CHARACTERISTIC XTAB9Z_GANG_MARS_DBM "" CURVE 0x27B5A1 _REC_A1CUR_30_u1_u1_S2 8 _CNV_S_9_Enum_EGANG_30_CM_S2 0 8
 /begin AXIS_DESCR FIX_AXIS Z_GANG_ZIEL_DBM _CNV_S_9_Enum_EGANG_30_CM_S2 9 0 8 FIX_AXIS_PAR_DIST 0 1 9 READ_ONLY /end AXIS_DESCR
/end CHARACTERISTIC
/begin CHARACTERISTIC XTAB9Z_IDX_CGT_DBM "" CURVE 0x27AE99 _REC_A1CUR_30_u1_u2_S2 2 _CNV_S_3_Enum_EIDX0_325_CM_S2 0 2
 /begin AXIS_DESCR FIX_AXIS NO_INPUT_QUANTITY _CNV_S_9_Enum_EGANG_30_CM_S2 9 0 8 /begin FIX_AXIS_PAR_LIST 0 1 2 3 4 5 6 7 8 /end FIX_AXIS_PAR_LIST READ_ONLY /end AXIS_DESCR
/end CHARACTERISTIC
/begin CHARACTERISTIC XTAB9Z_MINTUMGPLUFT_IDX_DBM "" CURVE 0x27AEA2 _REC_A1CUR_30_u1_u1_S2 3 _CNV_S_4_Enum_EIDX_328_CM_S2 0 3
 /begin AXIS_DESCR FIX_AXIS Z_GANG_ZIEL_DBM _CNV_S_9_Enum_EGANG_30_CM_S2 9 0 8 FIX_AXIS_PAR_DIST 0 1 9 READ_ONLY /end AXIS_DESCR
/end CHARACTERISTIC
/begin CHARACTERISTIC XA_MODWHYB_DBM "" VALUE 0x27558C _REC_S1VAL_1_s2_S2 10 _CNV_R_R_Umr_100_zu_54_CM_S2 -5 5 FORMAT "%4.2" /end CHARACTERISTIC
/begin CHARACTERISTIC XDN_K0_MAX_1 "" VALUE 0x2755B0 _REC_S1VAL_1_s2_S2 10000 _CNV_R_R_Umr_1_zu_1_3_CM_S2 0 10000 FORMAT "%2.0" /end CHARACTERISTIC
/begin CHARACTERISTIC XDN_K0_MAX_2 "" VALUE 0x2755B2 _REC_S1VAL_1_s2_S2 10000 _CNV_R_R_Umr_1_zu_1_3_CM_S2 0 10000 FORMAT "%2.0" /end CHARACTERISTIC
/begin CHARACTERISTIC XFAKT_MRAD_MODWHYB "" VALUE 0x27558E _REC_S1VAL_1_u2_S2 5 _CNV_R_R_Umr_100_zu_54_CM_S2 0 5 FORMAT "%4.2" /end CHARACTERISTIC
/begin CHARACTERISTIC XHDM_RFWS_AUS_DBM "" VALUE 0x275590 _REC_S1VAL_1_s2_S2 65535 _CNV_R_R_Umr_1_zu_1_42_CM_S2 -32768 32767 FORMAT "%2.0" /end CHARACTERISTIC
/begin CHARACTERISTIC XHSCHN_T_NMOTSOLLLL_DBM "" VALUE 0x275592 _REC_S1VAL_1_s2_S2 32000 _CNV_R_R_Umr_1_zu_1_3_CM_S2 0 32000 FORMAT "%2.0" /end CHARACTERISTIC
/begin CHARACTERISTIC XM_EM_MODWHYB "" VALUE 0x275594 _REC_S1VAL_1_s2_S2 500 _CNV_R_R_Umr_1_zu_1_2_CM_S2 0 500 FORMAT "%2.0" /end CHARACTERISTIC
/begin CHARACTERISTIC XODM_RFWS_ROLLE_DBM "" VALUE 0x275596 _REC_S1VAL_1_s2_S2 32767 _CNV_R_R_Umr_1_zu_1_42_CM_S2 0 32767 FORMAT "%2.0" /end CHARACTERISTIC
/begin CHARACTERISTIC XOM_REKUPRS_DBM "" VALUE 0x275598 _REC_S1VAL_1_s2_S2 1023 _CNV_R_R_Umr_1_zu_1_42_CM_S2 0 1023 FORMAT "%2.0" /end CHARACTERISTIC
/begin CHARACTERISTIC XON_AB_MIN_AFU_DBM "" VALUE 0x27559A _REC_S1VAL_1_s2_S2 500 _CNV_R_R_Umr_1_zu_1_3_CM_S2 0 500 FORMAT "%2.0" /end CHARACTERISTIC
/begin CHARACTERISTIC XSCHN_ABMAX_ANFGANG2_AFU_DBM "" VALUE 0x27559C _REC_S1VAL_1_s2_S2 20000 _CNV_R_R_Umr_1_zu_1_3_CM_S2 0 20000 FORMAT "%2.0" /end CHARACTERISTIC
/begin CHARACTERISTIC XSCHN_GEMIN_MODWHYB_DBM "" VALUE 0x27558A _REC_S1VAL_1_u2_S2 7000 _CNV_R_R_Umr_1_zu_1_3_CM_S2 0 7000 FORMAT "%2.0" /end CHARACTERISTIC
/begin CHARACTERISTIC XSCHN_GE_MAXGRENZ_DBM "" VALUE 0x27559E _REC_S1VAL_1_s2_S2 10000 _CNV_R_R_Umr_1_zu_1_3_CM_S2 0 10000 FORMAT "%2.0" /end CHARACTERISTIC
/begin CHARACTERISTIC XSCHN_GE_MINGRENZ_DBM "" VALUE 0x2755A0 _REC_S1VAL_1_s2_S2 10000 _CNV_R_R_Umr_1_zu_1_3_CM_S2 0 10000 FORMAT "%2.0" /end CHARACTERISTIC
/begin CHARACTERISTIC XSCHN_MAXAKT_EMHIGH_DBM "" VALUE 0x2755A2 _REC_S1VAL_1_s2_S2 65535 _CNV_R_R_Umr_1_zu_1_3_CM_S2 -32768 32767 FORMAT "%2.0" /end CHARACTERISTIC
/begin CHARACTERISTIC XSCHN_MAXAKT_EMLOW_DBM "" VALUE 0x2755A4 _REC_S1VAL_1_s2_S2 65535 _CNV_R_R_Umr_1_zu_1_3_CM_S2 -32768 32767 FORMAT "%2.0" /end CHARACTERISTIC
/begin CHARACTERISTIC XSCHN_MAXHI_EMHIGH_DBM "" VALUE 0x2755A6 _REC_S1VAL_1_s2_S2 65535 _CNV_R_R_Umr_1_zu_1_3_CM_S2 -32768 32767 FORMAT "%2.0" /end CHARACTERISTIC
/begin CHARACTERISTIC XSCHN_MAXHI_EMLOW_DBM "" VALUE 0x2755A8 _REC_S1VAL_1_s2_S2 65535 _CNV_R_R_Umr_1_zu_1_3_CM_S2 -32768 32767 FORMAT "%2.0" /end CHARACTERISTIC
/begin CHARACTERISTIC XSCHN_MOT_ABREGEL_MAXHI_DBM "" VALUE 0x2755AA _REC_S1VAL_1_s2_S2 20000 _CNV_R_R_Umr_1_zu_1_3_CM_S2 0 20000 FORMAT "%2.0" /end CHARACTERISTIC
/begin CHARACTERISTIC XSCHW_DKKD_REKUPRS_DBM "" VALUE 0x2755AC _REC_S1VAL_1_u2_S2 110 _CNV_R_R_Umr_10_zu__9_CM_S2 0 110 FORMAT "%3.1" /end CHARACTERISTIC
/begin CHARACTERISTIC XSCHW_DKKD_RSMAX_DYNSPV "" VALUE 0x2755AE _REC_S1VAL_1_u2_S2 110 _CNV_R_R_Umr_10_zu__9_CM_S2 0 110 FORMAT "%3.1" /end CHARACTERISTIC
/begin CHARACTERISTIC XS_AMODWHYB_INSTAT_DBM "" VALUE 0x27AEAE _REC_S1VAL_1_u1_S2 1 _CNV_R_R_Umr_1_zu_1_2_CM_S2 0 1 FORMAT "%2.0" /end CHARACTERISTIC
/begin CHARACTERISTIC XS_ARSSTD_FASZKA_DBM "" VALUE 0x27AEAF _REC_S1VAL_1_u1_S2 1 _CNV_R_R_Umr_1_zu_1_2_CM_S2 0 1 FORMAT "%2.0" /end CHARACTERISTIC
/begin CHARACTERISTIC XS_DMRS_PRUEFUNG_DBM "" VALUE 0x27AEB0 _REC_S1VAL_1_u1_S2 1 _CNV_R_R_Umr_1_zu_1_2_CM_S2 0 1 FORMAT "%2.0" /end CHARACTERISTIC
/begin CHARACTERISTIC XS_DSPV_MINSTRAT_DBM "" VALUE 0x27AEB1 _REC_S1VAL_1_u1_S2 1 _CNV_R_R_Umr_1_zu_1_2_CM_S2 0 1 FORMAT "%2.0" /end CHARACTERISTIC
/begin CHARACTERISTIC XS_HSVIRT_NECK_MODWHYB "" VALUE 0x27AEB2 _REC_S1VAL_1_u1_S2 1 _CNV_R_R_Umr_1_zu_1_2_CM_S2 0 1 FORMAT "%2.0" /end CHARACTERISTIC
/begin CHARACTERISTIC XS_LDM_NTMINMODEW_DBM "" VALUE 0x27AEC7 _REC_S1VAL_1_u1_S2 1 _CNV_R_R_Umr_1_zu_1_2_CM_S2 0 1 FORMAT "%2.0" /end CHARACTERISTIC
/begin CHARACTERISTIC XS_MINMAX_LDM_SCHUB_DBM "" VALUE 0x27AEB3 _REC_S1VAL_1_u1_S2 1 _CNV_R_R_Umr_1_zu_1_2_CM_S2 0 1 FORMAT "%2.0" /end CHARACTERISTIC
/begin CHARACTERISTIC XS_MINMAX_LDM_ZUG_DBM "" VALUE 0x27AEB4 _REC_S1VAL_1_u1_S2 1 _CNV_R_R_Umr_1_zu_1_2_CM_S2 0 1 FORMAT "%2.0" /end CHARACTERISTIC
/begin CHARACTERISTIC XS_MODWHYB_RS_DBM "" VALUE 0x27AEAB _REC_S1VAL_1_u1_S2 1 _CNV_R_R_Umr_1_zu_1_2_CM_S2 0 1 FORMAT "%2.0" /end CHARACTERISTIC
/begin CHARACTERISTIC XS_NMIN_MODWHYB_DBM "" VALUE 0x27AEAC _REC_S1VAL_1_u1_S2 1 _CNV_R_R_Umr_1_zu_1_2_CM_S2 0 1 FORMAT "%2.0" /end CHARACTERISTIC
/begin CHARACTERISTIC XS_SOURCE_MREKUP_DBM "" VALUE 0x27AEB5 _REC_S1VAL_1_u1_S2 1 _CNV_R_R_Umr_1_zu_1_2_CM_S2 0 1 FORMAT "%2.0" /end CHARACTERISTIC
/begin CHARACTERISTIC XS_SOURCE_NGENAB_DBM "" VALUE 0x27AEB6 _REC_S1VAL_1_u1_S2 1 _CNV_R_R_Umr_1_zu_1_2_CM_S2 0 1 FORMAT "%2.0" /end CHARACTERISTIC
/begin CHARACTERISTIC XS_STABI_SCHALTUNG_DBM "" VALUE 0x27AEB7 _REC_S1VAL_1_u1_S2 1 _CNV_R_R_Umr_1_zu_1_2_CM_S2 0 1 FORMAT "%2.0" /end CHARACTERISTIC
/begin CHARACTERISTIC XS_USE_DYNHSP_EFAHREN "" VALUE 0x27AEB8 _REC_S1VAL_1_u1_S2 2 _CNV_R_R_Umr_1_zu_1_2_CM_S2 0 2 FORMAT "%2.0" /end CHARACTERISTIC
/begin CHARACTERISTIC XS_USE_NMOTVIRT_DBM "" VALUE 0x27AEB9 _REC_S1VAL_1_u1_S2 2 _CNV_R_R_Umr_1_zu_1_2_CM_S2 0 2 FORMAT "%2.0" /end CHARACTERISTIC
/begin CHARACTERISTIC XS_USE_PRISQDBM_LDM_DBM "" VALUE 0x27AEBA _REC_S1VAL_1_u1_S2 1 _CNV_R_R_Umr_1_zu_1_2_CM_S2 0 1 FORMAT "%2.0" /end CHARACTERISTIC
/begin CHARACTERISTIC XS_WKSCHLUPF_HIGANG_ZKA "" VALUE 0x27AEBB _REC_S1VAL_1_u1_S2 1 _CNV_S_2_Schalter_A_4_CM_S2 0 1 /end CHARACTERISTIC
/begin CHARACTERISTIC XZN_AB_FILT_DBM "" VALUE 0x27AEBC _REC_S1VAL_1_u1_S2 2 _CNV_S_3_Enum_ESOUR_333_CM_S2 0 2 /end CHARACTERISTIC
/begin CHARACTERISTIC XZ_BERECHNUNG_GANG_DBM "" VALUE 0x27AEBD _REC_S1VAL_1_u1_S2 1 _CNV_R_R_Umr_1_zu_1_2_CM_S2 0 1 FORMAT "%2.0" /end CHARACTERISTIC
/begin CHARACTERISTIC XZ_DLBASIS_MODEW_DBM "" VALUE 0x27AEBE _REC_S1VAL_1_u1_S2 2 _CNV_S_3_Enum_DLBAS_334_CM_S2 0 2 /end CHARACTERISTIC
/begin CHARACTERISTIC XZ_DLSPORT_MODEW_DBM "" VALUE 0x27AEBF _REC_S1VAL_1_u1_S2 2 _CNV_S_3_Enum_DLBAS_334_CM_S2 0 2 /end CHARACTERISTIC
/begin CHARACTERISTIC XZ_DSPV_GANGHALTEN_DBM "" VALUE 0x27AEC0 _REC_S1VAL_1_u1_S2 3 _CNV_S_4_Enum_EDPSV_335_CM_S2 0 3 /end CHARACTERISTIC
/begin CHARACTERISTIC XZ_GANG_MAXARSFWS_DBM "" VALUE 0x27AEC1 _REC_S1VAL_1_u1_S2 8 _CNV_S_9_Enum_EGANG_30_CM_S2 0 8 /end CHARACTERISTIC
/begin CHARACTERISTIC XZ_GANG_MINAKT_SOLLLL_DBM "" VALUE 0x27AEC2 _REC_S1VAL_1_u1_S2 8 _CNV_S_9_Enum_EGANG_30_CM_S2 0 8 /end CHARACTERISTIC
/begin CHARACTERISTIC XZ_GANG_MINARS_DBM "" VALUE 0x27AEC3 _REC_S1VAL_1_u1_S2 8 _CNV_S_9_Enum_EGANG_30_CM_S2 0 8 /end CHARACTERISTIC
/begin CHARACTERISTIC XZ_GANG_MINLOW_SOLLLL_DBM "" VALUE 0x27AEC4 _REC_S1VAL_1_u1_S2 8 _CNV_S_9_Enum_EGANG_30_CM_S2 0 8 /end CHARACTERISTIC
/begin CHARACTERISTIC XZ_MODWHYB_DBM "" VALUE 0x27AEAD _REC_S1VAL_1_u1_S2 2 _CNV_R_R_Umr_1_zu_1_2_CM_S2 0 2 FORMAT "%2.0" /end CHARACTERISTIC
/begin CHARACTERISTIC XZ_M_REKUPRS_DBM "" VALUE 0x27AEC5 _REC_S1VAL_1_u1_S2 2 _CNV_R_R_Umr_1_zu_1_2_CM_S2 0 2 FORMAT "%2.0" /end CHARACTERISTIC
/begin CHARACTERISTIC XZ_PRUEF_MODBEDEL_DBM "" VALUE 0x27AEC6 _REC_S1VAL_1_u1_S2 4 _CNV_R_R_Umr_1_zu_1_2_CM_S2 0 4 /end CHARACTERISTIC
/begin CHARACTERISTIC XTAB2SCHW_DKKD_TID_AUSMIN "" CURVE 0x273F0C _REC_A1CUR_30_u2_u1_S2 110 _CNV_R_R_Umr_10_zu__45_CM_S2 0 110 FORMAT "%3.1"
 /begin AXIS_DESCR FIX_AXIS S_LDM_ERK _CNV_R_R_Umr_1_zu_1_2_CM_S2 2 0 255 MONOTONY MON_INCREASE /begin FIX_AXIS_PAR_LIST 0 1 /end FIX_AXIS_PAR_LIST FORMAT "%2.0" READ_ONLY /end AXIS_DESCR
/end CHARACTERISTIC
/begin CHARACTERISTIC XTAB4T_TID_AUSSTIEG "" CURVE 0x27A7C4 _REC_S7CUR_53_u2_u2_S2 65535 _CNV_R_R_Umr_1_zu_1_6_CM_S2 0 65535 FORMAT "%2.0"
 /begin AXIS_DESCR STD_AXIS T_TID_AUSSTIEG _CNV_R_R_Umr_1_zu_1_6_CM_S2 4 0 65535 MONOTONY MON_INCREASE FORMAT "%2.0" /end AXIS_DESCR
/end CHARACTERISTIC
/begin CHARACTERISTIC XTAB4_TID_AUSSTIEG_ENBL "" CURVE 0x273F10 _REC_A1CUR_30_u2_u2_S2 1 _CNV_R_R_Umr_1_zu_1_2_CM_S2 0 1 FORMAT "%2.0"
 /begin AXIS_DESCR FIX_AXIS NO_INPUT_QUANTITY _CNV_S_4_Enum_ETIDA_336_CM_S2 4 0 3 FIX_AXIS_PAR_DIST 0 1 4 READ_ONLY /end AXIS_DESCR
/end CHARACTERISTIC
/begin CHARACTERISTIC XTAB6X6OW_DKKD_DL "" MAP 0x27A800 _REC_S3MAP_54_s2_s2_u1_S2 220 _CNV_R_R_Umr_10_zu__9_CM_S2 -110 110 FORMAT "%3.1"
 /begin AXIS_DESCR STD_AXIS W_STEIGUNG_KORFILT _CNV_R_R_Umr_10_zu__9_CM_S2 6 -200 200 FORMAT "%3.1" /end AXIS_DESCR
 /begin AXIS_DESCR FIX_AXIS Z_DRIVELOGIC _CNV_S_6_Enum_EDL_11_CM_S2 6 1 6 FIX_AXIS_PAR_DIST 1 1 6 READ_ONLY /end AXIS_DESCR
/end CHARACTERISTIC
/begin CHARACTERISTIC XTAB9SCHW_DKKD_TID_AUSMAX "" CURVE 0x27A7D6 _REC_S7CUR_53_u2_u2_S2 110 _CNV_R_R_Umr_10_zu__9_CM_S2 0 110 FORMAT "%3.1" /begin AXIS_DESCR STD_AXIS N_AB _CNV_R_R_Umr_1_zu_1_3_CM_S2 10 0 20000 /end AXIS_DESCR /end CHARACTERISTIC
/begin CHARACTERISTIC XHN_AB_TID_IM_STAND "" VALUE 0x27A856 _REC_S1VAL_1_u2_S2 2000 _CNV_R_R_Umr_1_zu_1_3_CM_S2 0 2000 FORMAT "%2.0" /end CHARACTERISTIC
/begin CHARACTERISTIC XSCHN_AB_TID_AUS "" VALUE 0x27A858 _REC_S1VAL_1_u2_S2 20000 _CNV_R_R_Umr_1_zu_1_3_CM_S2 0 20000 FORMAT "%2.0" /end CHARACTERISTIC
/begin CHARACTERISTIC XT_TID_AUSSTIEG "" VALUE 0x273F18 _REC_S1VAL_1_u4_S2 2.14748E+009 _CNV_R_R_Umr_1_zu_1_6_CM_S2 0 2147483647 FORMAT "%2.0" /end CHARACTERISTIC
/begin CHARACTERISTIC XKLKORR_SCHGW_FP_DMRS_GANG4 "" CURVE 0x27A42C _REC_S7CUR_53_u2_u2_S2 200 _CNV_R_R_Umr_1_zu_1_53_CM_S2 0 200 FORMAT "%2.0"
 /begin AXIS_DESCR STD_AXIS N_AB _CNV_R_R_Umr_1_zu_1_3_CM_S2 5 0 10000 FORMAT "%2.0" /end AXIS_DESCR
/end CHARACTERISTIC
/begin CHARACTERISTIC XKLKORR_SCHGW_FP_DMRS_GANG5 "" CURVE 0x27A442 _REC_S7CUR_53_u2_u2_S2 200 _CNV_R_R_Umr_1_zu_1_53_CM_S2 0 200 FORMAT "%2.0"
 /begin AXIS_DESCR STD_AXIS N_AB _CNV_R_R_Umr_1_zu_1_3_CM_S2 5 0 10000 FORMAT "%2.0" /end AXIS_DESCR
/end CHARACTERISTIC
/begin CHARACTERISTIC XKLKORR_SCHGW_FP_DMRS_GANG6 "" CURVE 0x27A458 _REC_S7CUR_53_u2_u2_S2 200 _CNV_R_R_Umr_1_zu_1_53_CM_S2 0 200 FORMAT "%2.0"
 /begin AXIS_DESCR STD_AXIS N_AB _CNV_R_R_Umr_1_zu_1_3_CM_S2 5 0 10000 FORMAT "%2.0" /end AXIS_DESCR
/end CHARACTERISTIC
/begin CHARACTERISTIC XKLKORR_SCHGW_FP_DMRS_GANG7 "" CURVE 0x27A46E _REC_S7CUR_53_u2_u2_S2 200 _CNV_R_R_Umr_1_zu_1_53_CM_S2 0 200 FORMAT "%2.0"
 /begin AXIS_DESCR STD_AXIS N_AB _CNV_R_R_Umr_1_zu_1_3_CM_S2 5 0 10000 FORMAT "%2.0" /end AXIS_DESCR
/end CHARACTERISTIC
/begin CHARACTERISTIC XKLKORR_SCHGW_FP_DMRS_GANG8 "" CURVE 0x27A484 _REC_S7CUR_53_u2_u2_S2 200 _CNV_R_R_Umr_1_zu_1_53_CM_S2 0 200 FORMAT "%2.0"
 /begin AXIS_DESCR STD_AXIS N_AB _CNV_R_R_Umr_1_zu_1_3_CM_S2 5 0 10000 FORMAT "%2.0" /end AXIS_DESCR
/end CHARACTERISTIC
/begin CHARACTERISTIC XKLKORR_SCHGW_FP_DMRS_GANG9 "" CURVE 0x27A49A _REC_S7CUR_53_u2_u2_S2 200 _CNV_R_R_Umr_1_zu_1_53_CM_S2 0 200 FORMAT "%2.0"
 /begin AXIS_DESCR STD_AXIS N_AB _CNV_R_R_Umr_1_zu_1_3_CM_S2 5 0 10000 FORMAT "%2.0" /end AXIS_DESCR
/end CHARACTERISTIC
/begin CHARACTERISTIC XTAB20X9S_DMRS_FIND "" MAP 0x272A60 _REC_A1MAP_8_u2_u2_u1_S2 8160 _CNV_R_R_Umr_1_zu_1_2_CM_S2 0 8160 FORMAT "%2.0"
 /begin AXIS_DESCR FIX_AXIS NO_INPUT_QUANTITY _CNV_S_9_Enum_EDMRS_337_CM_S2 9 0 8 FIX_AXIS_PAR_DIST 0 1 9 READ_ONLY /end AXIS_DESCR
 /begin AXIS_DESCR FIX_AXIS Z_DMRS_FINDTABIDX _CNV_R_R_Umr_1_zu_1_2_CM_S2 20 0 19 FIX_AXIS_PAR_DIST 0 1 20 READ_ONLY /end AXIS_DESCR
/end CHARACTERISTIC
/begin CHARACTERISTIC XTAB4SCHN_MOTMAX_MODWHYB_DMRS "" CURVE 0x272BC8 _REC_A1CUR_30_u2_u1_S2 10000 _CNV_R_R_Umr_1_zu_1_3_CM_S2 0 10000 FORMAT "%2.0"
 /begin AXIS_DESCR FIX_AXIS Z_SOC_MODE _CNV_S_4_Enum_ESOCM_142_CM_S2 4 0 3 FIX_AXIS_PAR_DIST 0 1 4 READ_ONLY /end AXIS_DESCR
/end CHARACTERISTIC
/begin CHARACTERISTIC XTAB5T_DMRS_WAIT "" CURVE 0x272BD0 _REC_A1CUR_30_u4_u2_S2 2.14748E+009 _CNV_R_R_Umr_1_zu_1_6_CM_S2 0 2147483647 FORMAT "%2.0"
 /begin AXIS_DESCR FIX_AXIS NO_INPUT_QUANTITY _CNV_S_5_Enum_EDMRS_338_CM_S2 5 0 4 FIX_AXIS_PAR_DIST 0 1 5 READ_ONLY /end AXIS_DESCR
/end CHARACTERISTIC
/begin CHARACTERISTIC XTAB8DW_DKKD_DMRS_0 "" CURVE 0x27A4B0 _REC_S7CUR_53_s2_u2_S2 200 _CNV_R_R_Umr_1_zu_1_339_CM_S2 -100 100 FORMAT "%2.0"
 /begin AXIS_DESCR STD_AXIS N_AB _CNV_R_R_Umr_1_zu_1_3_CM_S2 8 0 20000 FORMAT "%2.0" /end AXIS_DESCR
/end CHARACTERISTIC
/begin CHARACTERISTIC XTAB8DW_DKKD_DMRS_1 "" CURVE 0x27A4D2 _REC_S7CUR_53_s2_u2_S2 200 _CNV_R_R_Umr_1_zu_1_339_CM_S2 -100 100 FORMAT "%2.0"
 /begin AXIS_DESCR STD_AXIS N_AB _CNV_R_R_Umr_1_zu_1_3_CM_S2 8 0 20000 FORMAT "%2.0" /end AXIS_DESCR
/end CHARACTERISTIC
/begin CHARACTERISTIC XTAB8DW_DKKD_DMRS_10 "" CURVE 0x27A4F4 _REC_S7CUR_53_s2_u2_S2 200 _CNV_R_R_Umr_1_zu_1_339_CM_S2 -100 100 FORMAT "%2.0"
 /begin AXIS_DESCR STD_AXIS N_AB _CNV_R_R_Umr_1_zu_1_3_CM_S2 8 0 20000 FORMAT "%2.0" /end AXIS_DESCR
/end CHARACTERISTIC
/begin CHARACTERISTIC XTAB8DW_DKKD_DMRS_11 "" CURVE 0x27A516 _REC_S7CUR_53_s2_u2_S2 200 _CNV_R_R_Umr_1_zu_1_339_CM_S2 -100 100 FORMAT "%2.0"
 /begin AXIS_DESCR STD_AXIS N_AB _CNV_R_R_Umr_1_zu_1_3_CM_S2 8 0 20000 FORMAT "%2.0" /end AXIS_DESCR
/end CHARACTERISTIC
/begin CHARACTERISTIC XTAB8DW_DKKD_DMRS_12 "" CURVE 0x27A538 _REC_S7CUR_53_s2_u2_S2 200 _CNV_R_R_Umr_1_zu_1_339_CM_S2 -100 100 FORMAT "%2.0"
 /begin AXIS_DESCR STD_AXIS N_AB _CNV_R_R_Umr_1_zu_1_3_CM_S2 8 0 20000 FORMAT "%2.0" /end AXIS_DESCR
/end CHARACTERISTIC
/begin CHARACTERISTIC XTAB8DW_DKKD_DMRS_13 "" CURVE 0x27A55A _REC_S7CUR_53_s2_u2_S2 200 _CNV_R_R_Umr_1_zu_1_339_CM_S2 -100 100 FORMAT "%2.0"
 /begin AXIS_DESCR STD_AXIS N_AB _CNV_R_R_Umr_1_zu_1_3_CM_S2 8 0 20000 FORMAT "%2.0" /end AXIS_DESCR
/end CHARACTERISTIC
/begin CHARACTERISTIC XTAB8DW_DKKD_DMRS_14 "" CURVE 0x27A57C _REC_S7CUR_53_s2_u2_S2 200 _CNV_R_R_Umr_1_zu_1_339_CM_S2 -100 100 FORMAT "%2.0"
 /begin AXIS_DESCR STD_AXIS N_AB _CNV_R_R_Umr_1_zu_1_3_CM_S2 8 0 20000 FORMAT "%2.0" /end AXIS_DESCR
/end CHARACTERISTIC
/begin CHARACTERISTIC XTAB8DW_DKKD_DMRS_2 "" CURVE 0x27A59E _REC_S7CUR_53_s2_u2_S2 200 _CNV_R_R_Umr_1_zu_1_339_CM_S2 -100 100 FORMAT "%2.0"
 /begin AXIS_DESCR STD_AXIS N_AB _CNV_R_R_Umr_1_zu_1_3_CM_S2 8 0 20000 FORMAT "%2.0" /end AXIS_DESCR
/end CHARACTERISTIC
/begin CHARACTERISTIC XTAB8DW_DKKD_DMRS_3 "" CURVE 0x27A5C0 _REC_S7CUR_53_s2_u2_S2 200 _CNV_R_R_Umr_1_zu_1_339_CM_S2 -100 100 FORMAT "%2.0"
 /begin AXIS_DESCR STD_AXIS N_AB _CNV_R_R_Umr_1_zu_1_3_CM_S2 8 0 20000 FORMAT "%2.0" /end AXIS_DESCR
/end CHARACTERISTIC
/begin CHARACTERISTIC XTAB8DW_DKKD_DMRS_4 "" CURVE 0x27A5E2 _REC_S7CUR_53_s2_u2_S2 200 _CNV_R_R_Umr_1_zu_1_339_CM_S2 -100 100 FORMAT "%2.0"
 /begin AXIS_DESCR STD_AXIS N_AB _CNV_R_R_Umr_1_zu_1_3_CM_S2 8 0 20000 FORMAT "%2.0" /end AXIS_DESCR
/end CHARACTERISTIC
/begin CHARACTERISTIC XTAB8DW_DKKD_DMRS_5 "" CURVE 0x27A604 _REC_S7CUR_53_s2_u2_S2 200 _CNV_R_R_Umr_1_zu_1_339_CM_S2 -100 100 FORMAT "%2.0"
 /begin AXIS_DESCR STD_AXIS N_AB _CNV_R_R_Umr_1_zu_1_3_CM_S2 8 0 20000 FORMAT "%2.0" /end AXIS_DESCR
/end CHARACTERISTIC
/begin CHARACTERISTIC XTAB8DW_DKKD_DMRS_6 "" CURVE 0x27A626 _REC_S7CUR_53_s2_u2_S2 200 _CNV_R_R_Umr_1_zu_1_339_CM_S2 -100 100 FORMAT "%2.0"
 /begin AXIS_DESCR STD_AXIS N_AB _CNV_R_R_Umr_1_zu_1_3_CM_S2 8 0 20000 FORMAT "%2.0" /end AXIS_DESCR
/end CHARACTERISTIC
/begin CHARACTERISTIC XTAB8DW_DKKD_DMRS_7 "" CURVE 0x27A648 _REC_S7CUR_53_s2_u2_S2 200 _CNV_R_R_Umr_1_zu_1_339_CM_S2 -100 100 FORMAT "%2.0"
 /begin AXIS_DESCR STD_AXIS N_AB _CNV_R_R_Umr_1_zu_1_3_CM_S2 8 0 20000 FORMAT "%2.0" /end AXIS_DESCR
/end CHARACTERISTIC
/begin CHARACTERISTIC XTAB8DW_DKKD_DMRS_8 "" CURVE 0x27A66A _REC_S7CUR_53_s2_u2_S2 200 _CNV_R_R_Umr_1_zu_1_339_CM_S2 -100 100 FORMAT "%2.0"
 /begin AXIS_DESCR STD_AXIS N_AB _CNV_R_R_Umr_1_zu_1_3_CM_S2 8 0 20000 FORMAT "%2.0" /end AXIS_DESCR
/end CHARACTERISTIC
/begin CHARACTERISTIC XTAB8DW_DKKD_DMRS_9 "" CURVE 0x27A68C _REC_S7CUR_53_s2_u2_S2 200 _CNV_R_R_Umr_1_zu_1_339_CM_S2 -100 100 FORMAT "%2.0"
 /begin AXIS_DESCR STD_AXIS N_AB _CNV_R_R_Umr_1_zu_1_3_CM_S2 8 0 20000 FORMAT "%2.0" /end AXIS_DESCR
/end CHARACTERISTIC
/begin CHARACTERISTIC XTAB9GW_FP_DMRSUP_MODWHYB "" CURVE 0x276A80 _REC_A1CUR_30_s2_u1_S2 32000 _CNV_R_R_Umr_1_zu_1_7_CM_S2 0 32000 FORMAT "%2.0"
 /begin AXIS_DESCR FIX_AXIS Z_GANG_ZIELSTART_DMRS _CNV_S_9_Enum_EGANG_30_CM_S2 9 0 8 FIX_AXIS_PAR_DIST 0 1 9 READ_ONLY /end AXIS_DESCR
/end CHARACTERISTIC
/begin CHARACTERISTIC XTAB9X10SCHGW_FP_DMRSDOWN "" MAP 0x271498 _REC_A1MAP_9_s2_u1_u1_S2 65535 _CNV_R_R_Umr_1_zu_1_7_CM_S2 -32768 32767 FORMAT "%2.0"
 /begin AXIS_DESCR FIX_AXIS Z_GANG_ZIELSTART_DMRS _CNV_S_9_Enum_EGANG_30_CM_S2 9 0 8 FIX_AXIS_PAR_DIST 0 1 9 READ_ONLY /end AXIS_DESCR
 /begin AXIS_DESCR FIX_AXIS Z_GWFP_DMRS_AGS _CNV_S_10_Enum_EDMRS_31_CM_S2 10 0 9 FIX_AXIS_PAR_DIST 0 1 10 READ_ONLY /end AXIS_DESCR
/end CHARACTERISTIC
/begin CHARACTERISTIC XTAB9X10SCHGW_FP_DMRSUP "" MAP 0x27154C _REC_A1MAP_9_s2_u1_u1_S2 65535 _CNV_R_R_Umr_1_zu_1_7_CM_S2 -32768 32767 FORMAT "%2.0"
 /begin AXIS_DESCR FIX_AXIS Z_GANG_ZIELSTART_DMRS _CNV_S_9_Enum_EGANG_30_CM_S2 9 0 8 FIX_AXIS_PAR_DIST 0 1 9 READ_ONLY /end AXIS_DESCR
 /begin AXIS_DESCR FIX_AXIS Z_GWFP_DMRS_AGS _CNV_S_10_Enum_EDMRS_31_CM_S2 10 0 9 FIX_AXIS_PAR_DIST 0 1 10 READ_ONLY /end AXIS_DESCR
/end CHARACTERISTIC
/begin CHARACTERISTIC XTAB9X10Z_DWDKKD_DMRS "" MAP 0x276AC8 _REC_A1MAP_9_u1_u1_u1_S2 14 _CNV_R_R_Umr_1_zu_1_339_CM_S2 0 14 FORMAT "%2.0"
 /begin AXIS_DESCR FIX_AXIS Z_GANG_ZIELSTART_DMRS _CNV_S_9_Enum_EGANG_30_CM_S2 9 0 8 FIX_AXIS_PAR_DIST 0 1 9 READ_ONLY /end AXIS_DESCR
 /begin AXIS_DESCR FIX_AXIS Z_DWDKKD_DMRS_AGS _CNV_S_10_Enum_EDMRS_31_CM_S2 10 0 9 FIX_AXIS_PAR_DIST 0 1 10 READ_ONLY /end AXIS_DESCR
/end CHARACTERISTIC
/begin CHARACTERISTIC XTAB9X3N_MOTMAX_MODWHYB_EMODE "" MAP 0x276A92 _REC_A1MAP_9_u2_u2_u1_S2 10000 _CNV_R_R_Umr_1_zu_1_3_CM_S2 0 10000 FORMAT "%2.0"
 /begin AXIS_DESCR FIX_AXIS NO_INPUT_QUANTITY _CNV_S_9_Enum_EGANG_30_CM_S2 9 0 8 /begin FIX_AXIS_PAR_LIST 0 1 2 3 4 5 6 7 8 /end FIX_AXIS_PAR_LIST READ_ONLY /end AXIS_DESCR
 /begin AXIS_DESCR FIX_AXIS Z_EFAHR_AUSSTIEG _CNV_S_3_Enum_EEFAH_251_CM_S2 3 0 2 FIX_AXIS_PAR_DIST 0 1 3 READ_ONLY /end AXIS_DESCR
/end CHARACTERISTIC
/begin CHARACTERISTIC XD_PRUEFGANG_AUSG_DMRS "" VALUE 0x27B5C5 _REC_S1VAL_1_u1_S2 7 _CNV_R_R_Umr_1_zu_1_2_CM_S2 0 7 FORMAT "%2.0" /end CHARACTERISTIC
/begin CHARACTERISTIC XGW_FPFILT_DMRS_INGEW "" VALUE 0x2761F2 _REC_S1VAL_1_s2_S2 250 _CNV_R_R_Umr_1_zu_1_2_CM_S2 0 250 FORMAT "%2.0" /end CHARACTERISTIC
/begin CHARACTERISTIC XGW_FPFILT_DMRS_OUTGEW "" VALUE 0x2761F4 _REC_S1VAL_1_s2_S2 250 _CNV_R_R_Umr_1_zu_1_2_CM_S2 0 250 FORMAT "%2.0" /end CHARACTERISTIC
/begin CHARACTERISTIC XSCHN_MOT_MAX_DMRS "" VALUE 0x276B22 _REC_S1VAL_1_u2_S2 10000 _CNV_R_R_Umr_1_zu_1_3_CM_S2 0 10000 FORMAT "%2.0" /end CHARACTERISTIC
/begin CHARACTERISTIC XSCHW_DKKD_DMRSDOWNSPERR "" VALUE 0x2761F6 _REC_S1VAL_1_u2_S2 110 _CNV_R_R_Umr_10_zu__9_CM_S2 0 110 FORMAT "%3.1" /end CHARACTERISTIC
/begin CHARACTERISTIC XSCHW_DKKD_DMRSMAX "" VALUE 0x2761F8 _REC_S1VAL_1_u2_S2 110 _CNV_R_R_Umr_10_zu__9_CM_S2 0 110 FORMAT "%3.1" /end CHARACTERISTIC
/begin CHARACTERISTIC XSCHW_DKKD_DMRSMIN "" VALUE 0x2761FA _REC_S1VAL_1_u2_S2 110 _CNV_R_R_Umr_10_zu__9_CM_S2 0 110 FORMAT "%3.1" /end CHARACTERISTIC
/begin CHARACTERISTIC XS_PRUEF_RSSKLDERS_DMRS "" VALUE 0x27B5C6 _REC_S1VAL_1_u1_S2 1 _CNV_R_R_Umr_1_zu_1_2_CM_S2 0 1 FORMAT "%2.0" /end CHARACTERISTIC
/begin CHARACTERISTIC XS_USE_DMRSVG_SKLKD "" VALUE 0x27B5C7 _REC_S1VAL_1_u1_S2 1 _CNV_S_2_Schalter_A_4_CM_S2 0 1 /end CHARACTERISTIC
/begin CHARACTERISTIC XS_USE_DMRSVG_TIMERRESET "" VALUE 0x27B5C8 _REC_S1VAL_1_u1_S2 1 _CNV_S_2_Schalter_A_4_CM_S2 0 1 /end CHARACTERISTIC
/begin CHARACTERISTIC XTAB20X2Z_GANGTGG_FST_SOLLSTB "" MAP 0x2728B8 _REC_A1MAP_9_u1_u1_u1_S2 8 _CNV_S_9_Enum_EGANG_30_CM_S2 0 8
 /begin AXIS_DESCR FIX_AXIS C_GANGGENERATOR_SOLLSTB _CNV_R_R_Umr_1_zu_1_2_CM_S2 20 0 255 MONOTONY MON_INCREASE /begin FIX_AXIS_PAR_LIST 0 1 2 3 4 5 6 7 8 9 10 11 12 13 14 15 16 17 18 19 /end FIX_AXIS_PAR_LIST FORMAT "%2.0" READ_ONLY /end AXIS_DESCR
 /begin AXIS_DESCR FIX_AXIS NO_INPUT_QUANTITY _CNV_S_3_Enum_ETEST_344_CM_S2 2 0 2 MONOTONY MON_INCREASE /begin FIX_AXIS_PAR_LIST 0 1 /end FIX_AXIS_PAR_LIST READ_ONLY /end AXIS_DESCR
/end CHARACTERISTIC
/begin CHARACTERISTIC XTAB20X2Z_GANGTGG_REL_SOLLSTB "" MAP 0x2728E0 _REC_A1MAP_9_s1_u1_u1_S2 16 _CNV_R_R_Umr_1_zu_1_2_CM_S2 -8 8 FORMAT "%2.0"
 /begin AXIS_DESCR FIX_AXIS C_GANGGENERATOR_SOLLSTB _CNV_R_R_Umr_1_zu_1_2_CM_S2 20 0 255 MONOTONY MON_INCREASE /begin FIX_AXIS_PAR_LIST 0 1 2 3 4 5 6 7 8 9 10 11 12 13 14 15 16 17 18 19 /end FIX_AXIS_PAR_LIST FORMAT "%2.0" READ_ONLY /end AXIS_DESCR
 /begin AXIS_DESCR FIX_AXIS NO_INPUT_QUANTITY _CNV_S_3_Enum_ETEST_344_CM_S2 2 0 2 MONOTONY MON_INCREASE /begin FIX_AXIS_PAR_LIST 0 1 /end FIX_AXIS_PAR_LIST READ_ONLY /end AXIS_DESCR
/end CHARACTERISTIC
/begin CHARACTERISTIC XTAB4C_GANGW_SOLLSTB_FLW "" CURVE 0x2728B0 _REC_A1CUR_30_u1_u1_S2 255 _CNV_R_R_Umr_1_zu_1_2_CM_S2 0 255 FORMAT "%2.0"
 /begin AXIS_DESCR FIX_AXIS Z_EXCFKT_FFG _CNV_S_4_Enum_EEXCF_101_CM_S2 4 0 3 /begin FIX_AXIS_PAR_LIST 0 1 2 3 /end FIX_AXIS_PAR_LIST READ_ONLY /end AXIS_DESCR
/end CHARACTERISTIC
/begin CHARACTERISTIC XTAB4C_GANGW_SOLLSTB_ZHK "" CURVE 0x2728B4 _REC_A1CUR_30_u1_u1_S2 255 _CNV_R_R_Umr_1_zu_1_2_CM_S2 0 255 FORMAT "%2.0"
 /begin AXIS_DESCR FIX_AXIS Z_EXCFKT_FFG _CNV_S_4_Enum_EEXCF_101_CM_S2 4 0 3 /begin FIX_AXIS_PAR_LIST 0 1 2 3 /end FIX_AXIS_PAR_LIST READ_ONLY /end AXIS_DESCR
/end CHARACTERISTIC
/begin CHARACTERISTIC XTAB4T_MIN_GANG_SOLLSTB "" CURVE 0x27667A _REC_S7CUR_53_u2_s2_S2 2550 _CNV_R_R_Umr_1_zu_1_6_CM_S2 0 2550 FORMAT "%2.0"
 /begin AXIS_DESCR STD_AXIS TEMP_GETR _CNV_R_R_Umr_1_zu_1_1_CM_S2 4 -200 200 MONOTONY MON_INCREASE FORMAT "%2.0" /end AXIS_DESCR
/end CHARACTERISTIC
/begin CHARACTERISTIC XTAB5Z_TESTFALL_SOLLSTB "" CURVE 0x27B5B3 _REC_A1CUR_30_u1_u1_S2 2 _CNV_S_3_Enum_ETEST_344_CM_S2 0 2
 /begin AXIS_DESCR FIX_AXIS NO_INPUT_QUANTITY _CNV_R_R_Umr_1_zu_1_2_CM_S2 5 0 255 /begin FIX_AXIS_PAR_LIST 0 1 2 3 4 /end FIX_AXIS_PAR_LIST READ_ONLY /end AXIS_DESCR
/end CHARACTERISTIC
/begin CHARACTERISTIC XC_FENSTER_SOLLSTB_ZHK "" VALUE 0x27B5AA _REC_S1VAL_1_u1_S2 255 _CNV_R_R_Umr_1_zu_1_2_CM_S2 0 255 FORMAT "%2.0" /end CHARACTERISTIC
/begin CHARACTERISTIC XHN_NMOT_SCHUB_SOLLSTB "" VALUE 0x27668C _REC_S1VAL_1_s2_S2 2000 _CNV_R_R_Umr_1_zu_1_3_CM_S2 -1000 1000 FORMAT "%2.0" /end CHARACTERISTIC
/begin CHARACTERISTIC XON_MOTSOLLLL_SOLLSTB "" VALUE 0x27668E _REC_S1VAL_1_s2_S2 1000 _CNV_R_R_Umr_1_zu_1_3_CM_S2 -500 500 FORMAT "%2.0" /end CHARACTERISTIC
/begin CHARACTERISTIC XON_MOT_ABREGEL_SOLLSTB "" VALUE 0x276690 _REC_S1VAL_1_s2_S2 1000 _CNV_R_R_Umr_1_zu_1_3_CM_S2 -500 500 FORMAT "%2.0" /end CHARACTERISTIC
/begin CHARACTERISTIC XSCHG2W_ABFILT_SCHUB_SOLLSTB "" VALUE 0x276692 _REC_S1VAL_1_s2_S2 6553.5 _CNV_R_R_Umr_10_zu__181_CM_S2 -3276.8 3276.7 FORMAT "%3.1" /end CHARACTERISTIC
/begin CHARACTERISTIC XSCHM_BRSOLL_SCHUB_SOLLSTB "" VALUE 0x276694 _REC_S1VAL_1_s2_S2 32767 _CNV_R_R_Umr_1_zu_1_42_CM_S2 -32767 0 FORMAT "%2.0" /end CHARACTERISTIC
/begin CHARACTERISTIC XSCHM_BR_SCHUB_SOLLSTB "" VALUE 0x276696 _REC_S1VAL_1_s2_S2 32767 _CNV_R_R_Umr_1_zu_1_42_CM_S2 -32767 0 FORMAT "%2.0" /end CHARACTERISTIC
/begin CHARACTERISTIC XSCHM_RADWUNSCH_SCHUB_SOLLSTB "" VALUE 0x276698 _REC_S1VAL_1_s2_S2 65535 _CNV_R_R_Umr_1_zu_1_42_CM_S2 -32768 32767 FORMAT "%2.0" /end CHARACTERISTIC
/begin CHARACTERISTIC XSCHW_DKKD_SCHUB_SOLLSTB "" VALUE 0x27669A _REC_S1VAL_1_s2_S2 400 _CNV_R_R_Umr_10_zu__9_CM_S2 -200 200 FORMAT "%3.1" /end CHARACTERISTIC
/begin CHARACTERISTIC XS_ABBRUCH_ISTGANG_SOLLSTB "" VALUE 0x27B5AB _REC_S1VAL_1_u1_S2 1 _CNV_R_R_Umr_1_zu_1_2_CM_S2 0 1 FORMAT "%2.0" /end CHARACTERISTIC
/begin CHARACTERISTIC XS_FREEZE_GANG_BER_SOLLSTB "" VALUE 0x27B5AC _REC_S1VAL_1_u1_S2 1 _CNV_R_R_Umr_1_zu_1_2_CM_S2 0 1 FORMAT "%2.0" /end CHARACTERISTIC
/begin CHARACTERISTIC XS_ISTGANG_SCHUB_BER_SOLLSTB "" VALUE 0x27B5AD _REC_S1VAL_1_u1_S2 1 _CNV_R_R_Umr_1_zu_1_2_CM_S2 0 1 FORMAT "%2.0" /end CHARACTERISTIC
/begin CHARACTERISTIC XS_ISTGANG_ZUG_BER_SOLLSTB "" VALUE 0x27B5AE _REC_S1VAL_1_u1_S2 1 _CNV_R_R_Umr_1_zu_1_2_CM_S2 0 1 FORMAT "%2.0" /end CHARACTERISTIC
/begin CHARACTERISTIC XS_STABIL_SCHALT_SOLLSTB "" VALUE 0x27B5AF _REC_S1VAL_1_u1_S2 1 _CNV_R_R_Umr_1_zu_1_2_CM_S2 0 1 FORMAT "%2.0" /end CHARACTERISTIC
/begin CHARACTERISTIC XS_TESTFALLGENERATOR_RELATIV "" VALUE 0x27B5B8 _REC_S1VAL_1_u1_S2 255 _CNV_R_R_Umr_1_zu_1_2_CM_S2 0 255 FORMAT "%2.0" /end CHARACTERISTIC
/begin CHARACTERISTIC XS_T_FREEZE_SCHALT_SOLLSTB "" VALUE 0x27B5B0 _REC_S1VAL_1_u1_S2 1 _CNV_R_R_Umr_1_zu_1_2_CM_S2 0 1 FORMAT "%2.0" /end CHARACTERISTIC
/begin CHARACTERISTIC XT_MAX_GANG_SOLLSTB "" VALUE 0x27669C _REC_S1VAL_1_u2_S2 2550 _CNV_R_R_Umr_1_zu_1_6_CM_S2 0 2550 FORMAT "%2.0" /end CHARACTERISTIC
/begin CHARACTERISTIC XT_MIN_ZUG_SOLLSTB "" VALUE 0x27669E _REC_S1VAL_1_u2_S2 2550 _CNV_R_R_Umr_1_zu_1_6_CM_S2 0 2550 FORMAT "%2.0" /end CHARACTERISTIC
/begin CHARACTERISTIC XZ_GANGREF_SCHUB_SOLLAGS "" VALUE 0x27B5B1 _REC_S1VAL_1_u1_S2 2 _CNV_R_R_Umr_1_zu_1_2_CM_S2 0 2 FORMAT "%2.0" /end CHARACTERISTIC
/begin CHARACTERISTIC XZ_GANGREF_ZUG_SOLLAGS "" VALUE 0x27B5B2 _REC_S1VAL_1_u1_S2 2 _CNV_R_R_Umr_1_zu_1_2_CM_S2 0 2 FORMAT "%2.0" /end CHARACTERISTIC
/begin CHARACTERISTIC XTAB5ON_MOTMAX_WK_RSUMUELOW "" CURVE 0x27A6AE _REC_A1CUR_30_u2_u2_S2 2000 _CNV_R_R_Umr_1_zu_1_3_CM_S2 0 2000 FORMAT "%2.0"
 /begin AXIS_DESCR FIX_AXIS NO_INPUT_QUANTITY _CNV_S_9_Enum_EGANG_30_CM_S2 5 0 8 /begin FIX_AXIS_PAR_LIST 0 1 2 3 4 /end FIX_AXIS_PAR_LIST READ_ONLY /end AXIS_DESCR
/end CHARACTERISTIC
/begin CHARACTERISTIC XTAB5T_SEQ_RSUMUELOW "" CURVE 0x27AC48 _REC_S7CUR_53_u2_u2_S2 5000 _CNV_R_R_Umr_1_zu_1_6_CM_S2 0 5000 FORMAT "%2.0"
 /begin AXIS_DESCR STD_AXIS N_MOT_NACHRS_RSUMUELOW _CNV_R_R_Umr_1_zu_1_3_CM_S2 5 0 10000 FORMAT "%2.0" /end AXIS_DESCR
/end CHARACTERISTIC
/begin CHARACTERISTIC XTAB5X4SCHNMOTMAX1_RSUMUELOW "" MAP 0x273D94 _REC_S7MAP_53_u2_u2_u2_S2 10000 _CNV_R_R_Umr_1_zu_1_3_CM_S2 0 10000 FORMAT "%2.0"
 /begin AXIS_DESCR STD_AXIS MUE_DYN _CNV_R_R_Umr_1000_z_57_CM_S2 5 0 1 FORMAT "%5.3" /end AXIS_DESCR
 /begin AXIS_DESCR STD_AXIS W_DKKD _CNV_R_R_Umr_10_zu__9_CM_S2 4 0 110 FORMAT "%3.1" /end AXIS_DESCR
/end CHARACTERISTIC
/begin CHARACTERISTIC XTAB5X4SCHNMOTMAX2_RSUMUELOW "" MAP 0x273DD0 _REC_S7MAP_53_u2_u2_u2_S2 10000 _CNV_R_R_Umr_1_zu_1_3_CM_S2 0 10000 FORMAT "%2.0"
 /begin AXIS_DESCR STD_AXIS MUE_DYN _CNV_R_R_Umr_1000_z_57_CM_S2 5 0 1 FORMAT "%5.3" /end AXIS_DESCR
 /begin AXIS_DESCR STD_AXIS W_DKKD _CNV_R_R_Umr_10_zu__9_CM_S2 4 0 110 FORMAT "%3.1" /end AXIS_DESCR
/end CHARACTERISTIC
/begin CHARACTERISTIC XTAB5X4SCHNMOTMAX3_RSUMUELOW "" MAP 0x273E0C _REC_S7MAP_53_u2_u2_u2_S2 10000 _CNV_R_R_Umr_1_zu_1_3_CM_S2 0 10000 FORMAT "%2.0"
 /begin AXIS_DESCR STD_AXIS MUE_DYN _CNV_R_R_Umr_1000_z_57_CM_S2 5 0 1 FORMAT "%5.3" /end AXIS_DESCR
 /begin AXIS_DESCR STD_AXIS W_DKKD _CNV_R_R_Umr_10_zu__9_CM_S2 4 0 110 FORMAT "%3.1" /end AXIS_DESCR
/end CHARACTERISTIC
/begin CHARACTERISTIC XTAB5Z_IDX_MOTMAX_RSUMUELOW "" CURVE 0x27B78A _REC_A1CUR_30_u1_u2_S2 2 _CNV_S_3_Enum_EIDX__345_CM_S2 0 2
 /begin AXIS_DESCR FIX_AXIS NO_INPUT_QUANTITY _CNV_S_9_Enum_EGANG_30_CM_S2 5 0 8 /begin FIX_AXIS_PAR_LIST 0 1 2 3 4 /end FIX_AXIS_PAR_LIST READ_ONLY /end AXIS_DESCR
/end CHARACTERISTIC
/begin CHARACTERISTIC XSCHM_BR_MIN_RSUMUELOW "" VALUE 0x27649C _REC_S1VAL_1_s2_S2 65535 _CNV_R_R_Umr_1_zu_1_42_CM_S2 -32768 32767 FORMAT "%2.0" /end CHARACTERISTIC
/begin CHARACTERISTIC XSCHW_DKKD_MIN_RSUMUELOW "" VALUE 0x27649E _REC_S1VAL_1_u2_S2 110 _CNV_R_R_Umr_10_zu__9_CM_S2 0 110 FORMAT "%3.1" /end CHARACTERISTIC
/begin CHARACTERISTIC XSCHW_DKKD_RSSEQ_RSUMUELOW "" VALUE 0x27AC5E _REC_S1VAL_1_u2_S2 120 _CNV_R_R_Umr_10_zu__9_CM_S2 0 120 FORMAT "%3.1" /end CHARACTERISTIC
/begin CHARACTERISTIC XS_BER_NMOT_NACHRS_RSUMUELOW "" VALUE 0x27B7BC _REC_S1VAL_1_u1_S2 1 _CNV_R_R_Umr_1_zu_1_2_CM_S2 0 1 FORMAT "%2.0" /end CHARACTERISTIC
/begin CHARACTERISTIC XS_D2RS_RSSEQ_RSUMUELOW "" VALUE 0x27B7BD _REC_S1VAL_1_u1_S2 1 _CNV_R_R_Umr_1_zu_1_2_CM_S2 0 1 FORMAT "%2.0" /end CHARACTERISTIC
/begin CHARACTERISTIC XS_MARS_RSUMUELOW "" VALUE 0x27B53F _REC_S1VAL_1_u1_S2 1 _CNV_S_2_Enum_EMARS_346_CM_S2 0 1 /end CHARACTERISTIC
/begin CHARACTERISTIC XS_MINRS_SEQ_RSUMUELOW "" VALUE 0x27B7BE _REC_S1VAL_1_u1_S2 1 _CNV_R_R_Umr_1_zu_1_2_CM_S2 0 1 FORMAT "%2.0" /end CHARACTERISTIC
/begin CHARACTERISTIC XZ_RES_ANZAHL_QS3 "" VALUE 0x27AE72 _REC_S1VAL_1_u1_S2 1 _CNV_R_R_Umr_1_zu_1_2_CM_S2 0 1 FORMAT "%2.0" /end CHARACTERISTIC
/begin CHARACTERISTIC XTAB2N_GEAAF2_BRS_COS "" CURVE 0x272908 _REC_A1CUR_30_u2_u1_S2 10000 _CNV_R_R_Umr_1_zu_1_3_CM_S2 0 10000 FORMAT "%2.0"
 /begin AXIS_DESCR FIX_AXIS Z_AGS_MODBEDEL _CNV_S_2_Enum_EAGS_25_CM_S2 2 0 1 FIX_AXIS_PAR_DIST 0 1 2 READ_ONLY /end AXIS_DESCR
/end CHARACTERISTIC
/begin CHARACTERISTIC XTAB2N_GEKURVE1_BAB_BRS_COS "" CURVE 0x27290C _REC_A1CUR_30_u2_u1_S2 10000 _CNV_R_R_Umr_1_zu_1_3_CM_S2 0 10000 FORMAT "%2.0"
 /begin AXIS_DESCR FIX_AXIS Z_AGS_MODBEDEL _CNV_S_2_Enum_EAGS_25_CM_S2 2 0 1 FIX_AXIS_PAR_DIST 0 1 2 READ_ONLY /end AXIS_DESCR
/end CHARACTERISTIC
/begin CHARACTERISTIC XTAB2ON_GEKREIS2_BRS_COS "" CURVE 0x272910 _REC_A1CUR_30_s2_u1_S2 65535 _CNV_R_R_Umr_1_zu_1_3_CM_S2 -32768 32767 FORMAT "%2.0"
 /begin AXIS_DESCR FIX_AXIS Z_AGS_MODBEDEL _CNV_S_2_Enum_EAGS_25_CM_S2 2 0 1 FIX_AXIS_PAR_DIST 0 1 2 READ_ONLY /end AXIS_DESCR
/end CHARACTERISTIC
/begin CHARACTERISTIC XTAB2ON_GEKRZG2_BRS_COS "" CURVE 0x272914 _REC_A1CUR_30_s2_u1_S2 65535 _CNV_R_R_Umr_1_zu_1_3_CM_S2 -32768 32767 FORMAT "%2.0"
 /begin AXIS_DESCR FIX_AXIS Z_AGS_MODBEDEL _CNV_S_2_Enum_EAGS_25_CM_S2 2 0 1 FIX_AXIS_PAR_DIST 0 1 2 READ_ONLY /end AXIS_DESCR
/end CHARACTERISTIC
/begin CHARACTERISTIC XTAB2ON_GEKURVE2_BRS_COS "" CURVE 0x272918 _REC_A1CUR_30_s2_u1_S2 65535 _CNV_R_R_Umr_1_zu_1_3_CM_S2 -32768 32767 FORMAT "%2.0"
 /begin AXIS_DESCR FIX_AXIS Z_AGS_MODBEDEL _CNV_S_2_Enum_EAGS_25_CM_S2 2 0 1 FIX_AXIS_PAR_DIST 0 1 2 READ_ONLY /end AXIS_DESCR
/end CHARACTERISTIC
/begin CHARACTERISTIC XTAB2Z_GANG_BABKURVE_BRS_COS "" CURVE 0x276982 _REC_A1CUR_30_u1_u1_S2 8 _CNV_S_9_Enum_EGANG_30_CM_S2 0 8
 /begin AXIS_DESCR FIX_AXIS Z_AGS_MODBEDEL _CNV_S_2_Enum_EAGS_25_CM_S2 2 0 1 FIX_AXIS_PAR_DIST 0 1 2 READ_ONLY /end AXIS_DESCR
/end CHARACTERISTIC
/begin CHARACTERISTIC XTAB3X9N_GEKRZG1A_BRS_COS "" MAP 0x276984 _REC_S3MAP_54_u2_u2_u1_S2 65535 _CNV_R_R_Umr_1_zu_1_3_CM_S2 0 65535 FORMAT "%2.0"
 /begin AXIS_DESCR STD_AXIS W_KRZGSEG_ADAS_COS _CNV_R_R_Umr_1_zu_1_138_CM_S2 3 0 180 FORMAT "%2.0" /end AXIS_DESCR
 /begin AXIS_DESCR FIX_AXIS Z_GANG_BRS_COS_ERS _CNV_S_9_Enum_EGANG_30_CM_S2 9 0 8 FIX_AXIS_PAR_DIST 0 1 9 READ_ONLY /end AXIS_DESCR
/end CHARACTERISTIC
/begin CHARACTERISTIC XTAB3X9N_GEKRZG1S_BRS_COS "" MAP 0x2769C2 _REC_S3MAP_54_u2_u2_u1_S2 65535 _CNV_R_R_Umr_1_zu_1_3_CM_S2 0 65535 FORMAT "%2.0"
 /begin AXIS_DESCR STD_AXIS W_KRZGSEG_ADAS_COS _CNV_R_R_Umr_1_zu_1_138_CM_S2 3 0 180 FORMAT "%2.0" /end AXIS_DESCR
 /begin AXIS_DESCR FIX_AXIS Z_GANG_BRS_COS_ERS _CNV_S_9_Enum_EGANG_30_CM_S2 9 0 8 FIX_AXIS_PAR_DIST 0 1 9 READ_ONLY /end AXIS_DESCR
/end CHARACTERISTIC
/begin CHARACTERISTIC XTAB4ON_GEKURVE_STEIG_BRS_COS "" CURVE 0x276A00 _REC_S7CUR_53_s2_s2_S2 2000 _CNV_R_R_Umr_1_zu_1_3_CM_S2 -1000 1000 FORMAT "%2.0"
 /begin AXIS_DESCR STD_AXIS W_STEIGUNG_KORFILT _CNV_R_R_Umr_10_zu__9_CM_S2 4 -200 200 FORMAT "%3.1" /end AXIS_DESCR
/end CHARACTERISTIC
/begin CHARACTERISTIC XTAB4X2Z_GANGMIN2_BRS_COS "" MAP 0x27291C _REC_A1MAP_9_u1_u1_u1_S2 8 _CNV_S_9_Enum_EGANG_30_CM_S2 0 8
 /begin AXIS_DESCR FIX_AXIS NO_INPUT_QUANTITY _CNV_S_4_Enum_EADAS_13_CM_S2 4 0 3 FIX_AXIS_PAR_DIST 0 1 4 READ_ONLY /end AXIS_DESCR
 /begin AXIS_DESCR FIX_AXIS Z_AGS_MODBEDEL _CNV_S_2_Enum_EAGS_25_CM_S2 2 0 1 FIX_AXIS_PAR_DIST 0 1 2 READ_ONLY /end AXIS_DESCR
/end CHARACTERISTIC
/begin CHARACTERISTIC XTAB9X2N_GEAAF1_BRS_COS "" MAP 0x272924 _REC_A1MAP_9_u2_u1_u1_S2 10000 _CNV_R_R_Umr_1_zu_1_3_CM_S2 0 10000 FORMAT "%2.0"
 /begin AXIS_DESCR FIX_AXIS Z_GANG_BRS_COS_ERS _CNV_S_9_Enum_EGANG_30_CM_S2 9 0 8 FIX_AXIS_PAR_DIST 0 1 9 READ_ONLY /end AXIS_DESCR
 /begin AXIS_DESCR FIX_AXIS Z_AGS_MODBEDEL _CNV_S_2_Enum_EAGS_25_CM_S2 2 0 1 FIX_AXIS_PAR_DIST 0 1 2 READ_ONLY /end AXIS_DESCR
/end CHARACTERISTIC
/begin CHARACTERISTIC XTAB9X2N_GEKREIS1_BRS_COS "" MAP 0x272948 _REC_A1MAP_9_u2_u1_u1_S2 10000 _CNV_R_R_Umr_1_zu_1_3_CM_S2 0 10000 FORMAT "%2.0"
 /begin AXIS_DESCR FIX_AXIS Z_GANG_BRS_COS_ERS _CNV_S_9_Enum_EGANG_30_CM_S2 9 0 8 FIX_AXIS_PAR_DIST 0 1 9 READ_ONLY /end AXIS_DESCR
 /begin AXIS_DESCR FIX_AXIS Z_AGS_MODBEDEL _CNV_S_2_Enum_EAGS_25_CM_S2 2 0 1 FIX_AXIS_PAR_DIST 0 1 2 READ_ONLY /end AXIS_DESCR
/end CHARACTERISTIC
/begin CHARACTERISTIC XTAB9X2N_GEKURVE1_BRS_COS "" MAP 0x27296C _REC_A1MAP_9_u2_u1_u1_S2 10000 _CNV_R_R_Umr_1_zu_1_3_CM_S2 0 10000 FORMAT "%2.0"
 /begin AXIS_DESCR FIX_AXIS Z_GANG_BRS_COS_ERS _CNV_S_9_Enum_EGANG_30_CM_S2 9 0 8 FIX_AXIS_PAR_DIST 0 1 9 READ_ONLY /end AXIS_DESCR
 /begin AXIS_DESCR FIX_AXIS Z_AGS_MODBEDEL _CNV_S_2_Enum_EAGS_25_CM_S2 2 0 1 FIX_AXIS_PAR_DIST 0 1 2 READ_ONLY /end AXIS_DESCR
/end CHARACTERISTIC
/begin CHARACTERISTIC XDL_AAF1_BRS_COS "" VALUE 0x27B5BB _REC_S1VAL_1_u1_S2 255 _CNV_R_R_Umr_1_zu_1_123_CM_S2 0 255 FORMAT "%2.0" /end CHARACTERISTIC
/begin CHARACTERISTIC XDL_KREIS1_BRS_COS "" VALUE 0x27B5BC _REC_S1VAL_1_u1_S2 255 _CNV_R_R_Umr_1_zu_1_123_CM_S2 0 255 FORMAT "%2.0" /end CHARACTERISTIC
/begin CHARACTERISTIC XDL_KRZG1_BRS_COS "" VALUE 0x27B5BD _REC_S1VAL_1_u1_S2 255 _CNV_R_R_Umr_1_zu_1_123_CM_S2 0 255 FORMAT "%2.0" /end CHARACTERISTIC
/begin CHARACTERISTIC XDL_KURVEANF1_BRS_COS "" VALUE 0x276A14 _REC_S1VAL_1_u2_S2 65535 _CNV_R_R_Umr_1_zu_1_123_CM_S2 0 65535 FORMAT "%2.0" /end CHARACTERISTIC
/begin CHARACTERISTIC XDL_KURVESP1_BRS_COS "" VALUE 0x276A16 _REC_S1VAL_1_u2_S2 65535 _CNV_R_R_Umr_1_zu_1_123_CM_S2 0 65535 FORMAT "%2.0" /end CHARACTERISTIC
/begin CHARACTERISTIC XDL_KURVESP2_BRS_COS "" VALUE 0x276A18 _REC_S1VAL_1_u2_S2 65535 _CNV_R_R_Umr_1_zu_1_123_CM_S2 0 65535 FORMAT "%2.0" /end CHARACTERISTIC
/begin CHARACTERISTIC XFN_GEMAX_DSPORT_BRS_COS "" VALUE 0x27B5BE _REC_S1VAL_1_u1_S2 2.5 _CNV_R_R_Umr_100_zu_54_CM_S2 0 2.5 FORMAT "%4.2" /end CHARACTERISTIC
/begin CHARACTERISTIC XM_BR_AAF1_BRS_COS "" VALUE 0x276A1A _REC_S1VAL_1_s2_S2 65535 _CNV_R_R_Umr_1_zu_1_42_CM_S2 -32768 32767 FORMAT "%2.0" /end CHARACTERISTIC
/begin CHARACTERISTIC XM_BR_AAF2_BRS_COS "" VALUE 0x276A1C _REC_S1VAL_1_s2_S2 65535 _CNV_R_R_Umr_1_zu_1_42_CM_S2 -32768 32767 FORMAT "%2.0" /end CHARACTERISTIC
/begin CHARACTERISTIC XM_BR_KREIS1_BRS_COS "" VALUE 0x276A1E _REC_S1VAL_1_s2_S2 65535 _CNV_R_R_Umr_1_zu_1_42_CM_S2 -32768 32767 FORMAT "%2.0" /end CHARACTERISTIC
/begin CHARACTERISTIC XM_BR_KREIS2_BRS_COS "" VALUE 0x276A20 _REC_S1VAL_1_s2_S2 65535 _CNV_R_R_Umr_1_zu_1_42_CM_S2 -32768 32767 FORMAT "%2.0" /end CHARACTERISTIC
/begin CHARACTERISTIC XM_BR_KRZG1_BRS_COS "" VALUE 0x276A22 _REC_S1VAL_1_s2_S2 65535 _CNV_R_R_Umr_1_zu_1_42_CM_S2 -32768 32767 FORMAT "%2.0" /end CHARACTERISTIC
/begin CHARACTERISTIC XM_BR_KRZG2_BRS_COS "" VALUE 0x276A24 _REC_S1VAL_1_s2_S2 65535 _CNV_R_R_Umr_1_zu_1_42_CM_S2 -32768 32767 FORMAT "%2.0" /end CHARACTERISTIC
/begin CHARACTERISTIC XM_BR_KURVE1_BRS_COS "" VALUE 0x276A26 _REC_S1VAL_1_s2_S2 65535 _CNV_R_R_Umr_1_zu_1_42_CM_S2 -32768 32767 FORMAT "%2.0" /end CHARACTERISTIC
/begin CHARACTERISTIC XM_BR_KURVE2_BRS_COS "" VALUE 0x276A28 _REC_S1VAL_1_s2_S2 65535 _CNV_R_R_Umr_1_zu_1_42_CM_S2 -32768 32767 FORMAT "%2.0" /end CHARACTERISTIC
/begin CHARACTERISTIC XON_GENEG_VRKURVE_BRS_COS "" VALUE 0x276A2A _REC_S1VAL_1_u2_S2 10000 _CNV_R_R_Umr_1_zu_1_3_CM_S2 0 10000 FORMAT "%2.0" /end CHARACTERISTIC
/begin CHARACTERISTIC XSCHMASK_ADAS_BRS_COS "" VALUE 0x27B4E0 _REC_S1VAL_1_u1_S2 255 _CNV_R_R_Umr_1_zu_1_2_CM_S2 0 255 FORMAT "%2.0" /end CHARACTERISTIC
/begin CHARACTERISTIC XW_KRZGSEG_BRS_COS "" VALUE 0x276A12 _REC_S1VAL_1_u2_S2 180 _CNV_R_R_Umr_1_zu_1_138_CM_S2 0 180 FORMAT "%2.0" /end CHARACTERISTIC
/begin CHARACTERISTIC XW_STEIG_GANG_KURVE_BRS_COS "" VALUE 0x276A2C _REC_S1VAL_1_s2_S2 200 _CNV_R_R_Umr_10_zu__45_CM_S2 -200 0 FORMAT "%3.1" /end CHARACTERISTIC
/begin CHARACTERISTIC XTAB2N_GEAAF2_DERS_COS "" CURVE 0x2729B4 _REC_A1CUR_30_u2_u1_S2 10000 _CNV_R_R_Umr_1_zu_1_3_CM_S2 0 10000 FORMAT "%2.0"
 /begin AXIS_DESCR FIX_AXIS Z_AGS_MODBEDEL _CNV_S_2_Enum_EAGS_25_CM_S2 2 0 1 FIX_AXIS_PAR_DIST 0 1 2 READ_ONLY /end AXIS_DESCR
/end CHARACTERISTIC
/begin CHARACTERISTIC XTAB2N_GEKREIS2_DERS_COS "" CURVE 0x2729B8 _REC_A1CUR_30_u2_u1_S2 10000 _CNV_R_R_Umr_1_zu_1_3_CM_S2 0 10000 FORMAT "%2.0"
 /begin AXIS_DESCR FIX_AXIS Z_AGS_MODBEDEL _CNV_S_2_Enum_EAGS_25_CM_S2 2 0 1 FIX_AXIS_PAR_DIST 0 1 2 READ_ONLY /end AXIS_DESCR
/end CHARACTERISTIC
/begin CHARACTERISTIC XTAB2N_GEKRZG2_DERS_COS "" CURVE 0x2729BC _REC_A1CUR_30_u2_u1_S2 10000 _CNV_R_R_Umr_1_zu_1_3_CM_S2 0 10000 FORMAT "%2.0"
 /begin AXIS_DESCR FIX_AXIS Z_AGS_MODBEDEL _CNV_S_2_Enum_EAGS_25_CM_S2 2 0 1 FIX_AXIS_PAR_DIST 0 1 2 READ_ONLY /end AXIS_DESCR
/end CHARACTERISTIC
/begin CHARACTERISTIC XTAB2N_GEKURVE1_BAB_DERS_COS "" CURVE 0x2729C0 _REC_A1CUR_30_u2_u1_S2 10000 _CNV_R_R_Umr_1_zu_1_3_CM_S2 0 10000 FORMAT "%2.0"
 /begin AXIS_DESCR FIX_AXIS Z_AGS_MODBEDEL _CNV_S_2_Enum_EAGS_25_CM_S2 2 0 1 FIX_AXIS_PAR_DIST 0 1 2 READ_ONLY /end AXIS_DESCR
/end CHARACTERISTIC
/begin CHARACTERISTIC XTAB2N_GEKURVE2_DERS_COS "" CURVE 0x2729C4 _REC_A1CUR_30_u2_u1_S2 10000 _CNV_R_R_Umr_1_zu_1_3_CM_S2 0 10000 FORMAT "%2.0"
 /begin AXIS_DESCR FIX_AXIS Z_AGS_MODBEDEL _CNV_S_2_Enum_EAGS_25_CM_S2 2 0 1 FIX_AXIS_PAR_DIST 0 1 2 READ_ONLY /end AXIS_DESCR
/end CHARACTERISTIC
/begin CHARACTERISTIC XTAB2Z_GANG_BABKURVE_DERS_COS "" CURVE 0x276A52 _REC_A1CUR_30_u1_u1_S2 8 _CNV_S_9_Enum_EGANG_30_CM_S2 0 8
 /begin AXIS_DESCR FIX_AXIS Z_AGS_MODBEDEL _CNV_S_2_Enum_EAGS_25_CM_S2 2 0 1 FIX_AXIS_PAR_DIST 0 1 2 READ_ONLY /end AXIS_DESCR
/end CHARACTERISTIC
/begin CHARACTERISTIC XTAB3F_NGEKRZG1_DERS_COS "" CURVE 0x276A54 _REC_S7CUR_53_u2_u2_S2 200 _CNV_R_R_Umr_1_zu_1_53_CM_S2 0 200 FORMAT "%2.0"
 /begin AXIS_DESCR STD_AXIS W_KRZGSEG_ADAS_COS _CNV_R_R_Umr_1_zu_1_138_CM_S2 3 0 180 FORMAT "%2.0" /end AXIS_DESCR
/end CHARACTERISTIC
/begin CHARACTERISTIC XTAB3X2SCHW_DKKD_NL_COS "" MAP 0x27141C _REC_S3MAP_54_u2_s2_u1_S2 120 _CNV_R_R_Umr_10_zu__9_CM_S2 0 120 FORMAT "%3.1"
 /begin AXIS_DESCR STD_AXIS W_STEIGUNG_KORFILT _CNV_R_R_Umr_10_zu__9_CM_S2 3 -200 200 FORMAT "%3.1" /end AXIS_DESCR
 /begin AXIS_DESCR FIX_AXIS Z_AGS_MODBEDEL _CNV_S_2_Enum_EAGS_25_CM_S2 2 0 1 FIX_AXIS_PAR_DIST 0 1 2 READ_ONLY /end AXIS_DESCR
/end CHARACTERISTIC
/begin CHARACTERISTIC XTAB4ON_GEKURVE_STEIG_DERS_COS "" CURVE 0x276A62 _REC_S7CUR_53_s2_s2_S2 2000 _CNV_R_R_Umr_1_zu_1_3_CM_S2 -1000 1000 FORMAT "%2.0"
 /begin AXIS_DESCR STD_AXIS W_STEIGUNG_KORFILT _CNV_R_R_Umr_10_zu__9_CM_S2 4 -200 200 FORMAT "%3.1" /end AXIS_DESCR
/end CHARACTERISTIC
/begin CHARACTERISTIC XTAB4X2Z_GANGMIN2_DERS_COS "" MAP 0x2729C8 _REC_A1MAP_9_u1_u1_u1_S2 8 _CNV_S_9_Enum_EGANG_30_CM_S2 0 8
 /begin AXIS_DESCR FIX_AXIS NO_INPUT_QUANTITY _CNV_S_4_Enum_EADAS_13_CM_S2 4 0 3 FIX_AXIS_PAR_DIST 0 1 4 READ_ONLY /end AXIS_DESCR
 /begin AXIS_DESCR FIX_AXIS Z_AGS_MODBEDEL _CNV_S_2_Enum_EAGS_25_CM_S2 2 0 1 FIX_AXIS_PAR_DIST 0 1 2 READ_ONLY /end AXIS_DESCR
/end CHARACTERISTIC
/begin CHARACTERISTIC XTAB9X2N_GEAAF1_DERS_COS "" MAP 0x2729D0 _REC_A1MAP_9_u2_u1_u1_S2 10000 _CNV_R_R_Umr_1_zu_1_3_CM_S2 0 10000 FORMAT "%2.0"
 /begin AXIS_DESCR FIX_AXIS Z_GANG_DERS_COS_1RS _CNV_S_9_Enum_EGANG_30_CM_S2 9 0 8 FIX_AXIS_PAR_DIST 0 1 9 READ_ONLY /end AXIS_DESCR
 /begin AXIS_DESCR FIX_AXIS Z_AGS_MODBEDEL _CNV_S_2_Enum_EAGS_25_CM_S2 2 0 1 FIX_AXIS_PAR_DIST 0 1 2 READ_ONLY /end AXIS_DESCR
/end CHARACTERISTIC
/begin CHARACTERISTIC XTAB9X2N_GEKREIS1_DERS_COS "" MAP 0x2729F4 _REC_A1MAP_9_u2_u1_u1_S2 10000 _CNV_R_R_Umr_1_zu_1_3_CM_S2 0 10000 FORMAT "%2.0"
 /begin AXIS_DESCR FIX_AXIS Z_GANG_DERS_COS_1RS _CNV_S_9_Enum_EGANG_30_CM_S2 9 0 8 FIX_AXIS_PAR_DIST 0 1 9 READ_ONLY /end AXIS_DESCR
 /begin AXIS_DESCR FIX_AXIS Z_AGS_MODBEDEL _CNV_S_2_Enum_EAGS_25_CM_S2 2 0 1 FIX_AXIS_PAR_DIST 0 1 2 READ_ONLY /end AXIS_DESCR
/end CHARACTERISTIC
/begin CHARACTERISTIC XTAB9X2N_GEKRZG1_DERS_COS "" MAP 0x272A18 _REC_A1MAP_9_u2_u1_u1_S2 10000 _CNV_R_R_Umr_1_zu_1_3_CM_S2 0 10000 FORMAT "%2.0"
 /begin AXIS_DESCR FIX_AXIS Z_GANG_DERS_COS_1RS _CNV_S_9_Enum_EGANG_30_CM_S2 9 0 8 FIX_AXIS_PAR_DIST 0 1 9 READ_ONLY /end AXIS_DESCR
 /begin AXIS_DESCR FIX_AXIS Z_AGS_MODBEDEL _CNV_S_2_Enum_EAGS_25_CM_S2 2 0 1 FIX_AXIS_PAR_DIST 0 1 2 READ_ONLY /end AXIS_DESCR
/end CHARACTERISTIC
/begin CHARACTERISTIC XTAB9X2N_GEKURVE1_DERS_COS "" MAP 0x272A3C _REC_A1MAP_9_u2_u1_u1_S2 10000 _CNV_R_R_Umr_1_zu_1_3_CM_S2 0 10000 FORMAT "%2.0"
 /begin AXIS_DESCR FIX_AXIS Z_GANG_DERS_COS_1RS _CNV_S_9_Enum_EGANG_30_CM_S2 9 0 8 FIX_AXIS_PAR_DIST 0 1 9 READ_ONLY /end AXIS_DESCR
 /begin AXIS_DESCR FIX_AXIS Z_AGS_MODBEDEL _CNV_S_2_Enum_EAGS_25_CM_S2 2 0 1 FIX_AXIS_PAR_DIST 0 1 2 READ_ONLY /end AXIS_DESCR
/end CHARACTERISTIC
/begin CHARACTERISTIC XDL_AAF1_DERS_COS "" VALUE 0x27B5C1 _REC_S1VAL_1_u1_S2 255 _CNV_R_R_Umr_1_zu_1_123_CM_S2 0 255 FORMAT "%2.0" /end CHARACTERISTIC
/begin CHARACTERISTIC XDL_KREIS1_DERS_COS "" VALUE 0x27B5C2 _REC_S1VAL_1_u1_S2 255 _CNV_R_R_Umr_1_zu_1_123_CM_S2 0 255 FORMAT "%2.0" /end CHARACTERISTIC
/begin CHARACTERISTIC XDL_KRZG1_DERS_COS "" VALUE 0x27B5C3 _REC_S1VAL_1_u1_S2 255 _CNV_R_R_Umr_1_zu_1_123_CM_S2 0 255 FORMAT "%2.0" /end CHARACTERISTIC
/begin CHARACTERISTIC XDL_KURVEANF1_DERS_COS "" VALUE 0x276A76 _REC_S1VAL_1_u2_S2 65535 _CNV_R_R_Umr_1_zu_1_123_CM_S2 0 65535 FORMAT "%2.0" /end CHARACTERISTIC
/begin CHARACTERISTIC XDL_KURVESP1_DERS_COS "" VALUE 0x276A78 _REC_S1VAL_1_u2_S2 65535 _CNV_R_R_Umr_1_zu_1_123_CM_S2 0 65535 FORMAT "%2.0" /end CHARACTERISTIC
/begin CHARACTERISTIC XDL_KURVESP2_DERS_COS "" VALUE 0x276A7A _REC_S1VAL_1_u2_S2 65535 _CNV_R_R_Umr_1_zu_1_123_CM_S2 0 65535 FORMAT "%2.0" /end CHARACTERISTIC
/begin CHARACTERISTIC XFN_GEMAX_DSPORT_DERS_COS "" VALUE 0x27B5C4 _REC_S1VAL_1_u1_S2 2.5 _CNV_R_R_Umr_100_zu_54_CM_S2 0 2.5 FORMAT "%4.2" /end CHARACTERISTIC
/begin CHARACTERISTIC XON_GENEG_VRKURVE_DERS_COS "" VALUE 0x276A7C _REC_S1VAL_1_u2_S2 10000 _CNV_R_R_Umr_1_zu_1_3_CM_S2 0 10000 FORMAT "%2.0" /end CHARACTERISTIC
/begin CHARACTERISTIC XSCHA_Q_FILT_COS "" VALUE 0x2761B0 _REC_S1VAL_1_s2_S2 6553.5 _CNV_R_R_Umr_10_zu__46_CM_S2 -3276.8 3276.7 FORMAT "%3.1" /end CHARACTERISTIC
/begin CHARACTERISTIC XSCHMASK_ADAS_DERS_COS "" VALUE 0x27B5C0 _REC_S1VAL_1_u1_S2 255 _CNV_R_R_Umr_1_zu_1_2_CM_S2 0 255 FORMAT "%2.0" /end CHARACTERISTIC
/begin CHARACTERISTIC XS_BAB_DERS_COS "" VALUE 0x27B4E1 _REC_S1VAL_1_u1_S2 1 _CNV_R_R_Umr_1_zu_1_2_CM_S2 0 1 FORMAT "%2.0" /end CHARACTERISTIC
/begin CHARACTERISTIC XW_KRZGSEG_DERS_COS "" VALUE 0x276A74 _REC_S1VAL_1_u2_S2 180 _CNV_R_R_Umr_1_zu_1_138_CM_S2 0 180 FORMAT "%2.0" /end CHARACTERISTIC
/begin CHARACTERISTIC XW_STEIG_GANG_KURVE_DERS_COS "" VALUE 0x276A7E _REC_S1VAL_1_s2_S2 200 _CNV_R_R_Umr_10_zu__45_CM_S2 -200 0 FORMAT "%3.1" /end CHARACTERISTIC
/begin CHARACTERISTIC XTAB15X11S_PRISQ_SPA_FIND "" MAP 0x27AF93 _REC_A1MAP_8_u1_u1_u1_S2 1 _CNV_R_R_Umr_1_zu_1_2_CM_S2 0 1 FORMAT "%2.0"
 /begin AXIS_DESCR FIX_AXIS NO_INPUT_QUANTITY _CNV_S_11_Enum_EFKT__348_CM_S2 11 0 10 FIX_AXIS_PAR_DIST 0 1 11 READ_ONLY /end AXIS_DESCR
 /begin AXIS_DESCR FIX_AXIS Z_PRISQ_SPA_PRIOIDX _CNV_S_15_Enum_EPRIS_351_CM_S2 15 0 14 FIX_AXIS_PAR_DIST 0 1 15 READ_ONLY /end AXIS_DESCR
/end CHARACTERISTIC
/begin CHARACTERISTIC XTAB15Z_PRISQ_SPA_PROG "" CURVE 0x27B038 _REC_A1CUR_30_u1_u1_S2 20 _CNV_R_R_Umr_1_zu_1_2_CM_S2 0 20 FORMAT "%2.0"
 /begin AXIS_DESCR FIX_AXIS Z_PRISQ_SPA_PRIOIDX _CNV_S_15_Enum_EPRIS_351_CM_S2 15 0 14 FIX_AXIS_PAR_DIST 0 1 15 READ_ONLY /end AXIS_DESCR
/end CHARACTERISTIC
/begin CHARACTERISTIC XTAB2GWFP_SPA "" CURVE 0x27125C _REC_A1CUR_30_s2_u1_S2 20000 _CNV_R_R_Umr_1_zu_1_7_CM_S2 -10000 10000 FORMAT "%2.0"
 /begin AXIS_DESCR FIX_AXIS NO_INPUT_QUANTITY _CNV_S_2_Enum_EGW_F_349_CM_S2 2 0 1 FIX_AXIS_PAR_DIST 0 1 2 READ_ONLY /end AXIS_DESCR
/end CHARACTERISTIC
/begin CHARACTERISTIC XTAB2X2SCHW_DKKD_SPA "" MAP 0x271260 _REC_A1MAP_9_u2_u1_u1_S2 200 _CNV_R_R_Umr_10_zu__9_CM_S2 0 200 FORMAT "%3.1"
 /begin AXIS_DESCR FIX_AXIS NO_INPUT_QUANTITY _CNV_S_2_Enum_EGW_F_349_CM_S2 2 0 1 FIX_AXIS_PAR_DIST 0 1 2 READ_ONLY /end AXIS_DESCR
 /begin AXIS_DESCR FIX_AXIS NO_INPUT_QUANTITY _CNV_S_2_Enum_ERS_S_350_CM_S2 2 0 1 FIX_AXIS_PAR_DIST 0 1 2 READ_ONLY /end AXIS_DESCR
/end CHARACTERISTIC
/begin CHARACTERISTIC XTAB9N_GE_MAXRS_SPA "" CURVE 0x27610C _REC_A1CUR_30_u2_u1_S2 10000 _CNV_R_R_Umr_1_zu_1_3_CM_S2 0 10000 FORMAT "%2.0"
 /begin AXIS_DESCR FIX_AXIS Z_GANG_ZIEL_SSTEP _CNV_S_9_Enum_EGANG_30_CM_S2 9 0 8 FIX_AXIS_PAR_DIST 0 1 9 READ_ONLY /end AXIS_DESCR
/end CHARACTERISTIC
/begin CHARACTERISTIC XTAB9SCHG2W_AB_FILT_SPA "" CURVE 0x27611E _REC_A1CUR_30_s2_u1_S2 6000 _CNV_R_R_Umr_10_zu__181_CM_S2 -3000 3000 FORMAT "%3.1"
 /begin AXIS_DESCR FIX_AXIS Z_GANG_IST _CNV_S_9_Enum_EGANG_30_CM_S2 9 0 8 FIX_AXIS_PAR_DIST 0 1 9 READ_ONLY /end AXIS_DESCR
/end CHARACTERISTIC
/begin CHARACTERISTIC XGANG_MIN_SPA "" VALUE 0x27B047 _REC_S1VAL_1_u1_S2 8 _CNV_S_9_Enum_EGANG_30_CM_S2 0 8 /end CHARACTERISTIC
/begin CHARACTERISTIC XGW_FP_FILT_OUTGEW_SPA "" VALUE 0x276130 _REC_S1VAL_1_s2_S2 65535 _CNV_R_R_Umr_1_zu_1_2_CM_S2 -32768 32767 FORMAT "%2.0" /end CHARACTERISTIC
/begin CHARACTERISTIC XHA_Q_SPA "" VALUE 0x276132 _REC_S1VAL_1_s2_S2 200 _CNV_R_R_Umr_10_zu__46_CM_S2 -100 100 FORMAT "%3.1" /end CHARACTERISTIC
/begin CHARACTERISTIC XHG2W_AB_FILT_SPA "" VALUE 0x276134 _REC_S1VAL_1_s2_S2 2000 _CNV_R_R_Umr_10_zu__181_CM_S2 -1000 1000 FORMAT "%3.1" /end CHARACTERISTIC
/begin CHARACTERISTIC XHM_BR_SPA "" VALUE 0x276136 _REC_S1VAL_1_s2_S2 10000 _CNV_R_R_Umr_1_zu_1_42_CM_S2 0 10000 FORMAT "%2.0" /end CHARACTERISTIC
/begin CHARACTERISTIC XHN_AB_SKL_SPA "" VALUE 0x276138 _REC_S1VAL_1_u2_S2 10000 _CNV_R_R_Umr_1_zu_1_3_CM_S2 0 10000 FORMAT "%2.0" /end CHARACTERISTIC
/begin CHARACTERISTIC XHW_DKKD_SKL_SPA "" VALUE 0x27613A _REC_S1VAL_1_u2_S2 550 _CNV_R_R_Umr_10_zu__9_CM_S2 0 550 FORMAT "%3.1" /end CHARACTERISTIC
/begin CHARACTERISTIC XHW_DKKD_SPA "" VALUE 0x27613C _REC_S1VAL_1_u2_S2 200 _CNV_R_R_Umr_10_zu__9_CM_S2 0 200 FORMAT "%3.1" /end CHARACTERISTIC
/begin CHARACTERISTIC XSCHA_Q_SPA "" VALUE 0x27613E _REC_S1VAL_1_s2_S2 200 _CNV_R_R_Umr_10_zu__46_CM_S2 -100 100 FORMAT "%3.1" /end CHARACTERISTIC
/begin CHARACTERISTIC XSCHM_BR_SPA "" VALUE 0x276140 _REC_S1VAL_1_s2_S2 20000 _CNV_R_R_Umr_1_zu_1_42_CM_S2 -10000 10000 FORMAT "%2.0" /end CHARACTERISTIC
/begin CHARACTERISTIC XS_GANGWHL_AZG_AUS_SPA "" VALUE 0x27B048 _REC_S1VAL_1_u1_S2 1 _CNV_R_R_Umr_1_zu_1_2_CM_S2 0 1 FORMAT "%2.0" /end CHARACTERISTIC
/begin CHARACTERISTIC XS_SCHALTUNG_EIN_SPA "" VALUE 0x27B049 _REC_S1VAL_1_u1_S2 1 _CNV_R_R_Umr_1_zu_1_2_CM_S2 0 1 FORMAT "%2.0" /end CHARACTERISTIC
/begin CHARACTERISTIC XS_USE_SPA "" VALUE 0x27B04A _REC_S1VAL_1_u1_S2 1 _CNV_S_2_Schalter_A_4_CM_S2 0 1 /end CHARACTERISTIC
/begin CHARACTERISTIC XT_DUNKEL_AKTIV_SPA "" VALUE 0x276142 _REC_S1VAL_1_u2_S2 10000 _CNV_R_R_Umr_1_zu_1_6_CM_S2 0 10000 FORMAT "%2.0" /end CHARACTERISTIC
/begin CHARACTERISTIC XT_GWFP_SPA "" VALUE 0x276144 _REC_S1VAL_1_u2_S2 10000 _CNV_R_R_Umr_1_zu_1_6_CM_S2 0 10000 FORMAT "%2.0" /end CHARACTERISTIC
/begin CHARACTERISTIC XT_SPERR_SPA "" VALUE 0x276146 _REC_S1VAL_1_u2_S2 10000 _CNV_R_R_Umr_1_zu_1_6_CM_S2 0 10000 FORMAT "%2.0" /end CHARACTERISTIC
/begin CHARACTERISTIC XT_TIPP_SPA "" VALUE 0x276148 _REC_S1VAL_1_u2_S2 10000 _CNV_R_R_Umr_1_zu_1_6_CM_S2 0 10000 FORMAT "%2.0" /end CHARACTERISTIC
/begin CHARACTERISTIC XT_WDKKD_SPA "" VALUE 0x27614A _REC_S1VAL_1_u2_S2 10000 _CNV_R_R_Umr_1_zu_1_6_CM_S2 0 10000 FORMAT "%2.0" /end CHARACTERISTIC
/begin CHARACTERISTIC XTAB3HV_GANGVBEGR "" CURVE 0x27A6C0 _REC_S7CUR_53_u2_u2_S2 100 _CNV_R_R_Umr_1_zu_1_8_CM_S2 0 100 FORMAT "%2.0"
 /begin AXIS_DESCR STD_AXIS NO_INPUT_QUANTITY _CNV_R_R_Umr_1_zu_1_2_CM_S2 3 0 8 FORMAT "%2.0" /end AXIS_DESCR
/end CHARACTERISTIC
/begin CHARACTERISTIC XTAB3SCHW_DKKD_GANGVBEGR_AUS "" CURVE 0x27A6CE _REC_S7CUR_53_u2_s2_S2 110 _CNV_R_R_Umr_10_zu__9_CM_S2 0 110 FORMAT "%3.1"
 /begin AXIS_DESCR STD_AXIS DM_AB_FWSKOR_FILTSLOW _CNV_R_R_Umr_1_zu_1_42_CM_S2 3 -2500 2500 FORMAT "%2.0" /end AXIS_DESCR
/end CHARACTERISTIC
/begin CHARACTERISTIC XTAB3X2SCHV_GANGVBEGR "" MAP 0x273EAC _REC_S7MAP_53_u2_u2_u2_S2 400 _CNV_R_R_Umr_1_zu_1_8_CM_S2 0 400 FORMAT "%2.0"
 /begin AXIS_DESCR STD_AXIS NO_INPUT_QUANTITY _CNV_R_R_Umr_1_zu_1_2_CM_S2 3 0 8 FORMAT "%2.0" /end AXIS_DESCR
 /begin AXIS_DESCR STD_AXIS NO_INPUT_QUANTITY _CNV_P_2_A_I_68_CM_S2 2 0 65535 FORMAT "%2.0" READ_ONLY /end AXIS_DESCR
/end CHARACTERISTIC
/begin CHARACTERISTIC XC_DECRVAL_GANGVBEGR_AUS "" VALUE 0x27B790 _REC_S1VAL_1_u1_S2 255 _CNV_R_R_Umr_1_zu_1_2_CM_S2 0 255 FORMAT "%2.0" /end CHARACTERISTIC
/begin CHARACTERISTIC XHW_DKKD_RS_GANGVBEGR "" VALUE 0x27A6DC _REC_S1VAL_1_u2_S2 100 _CNV_R_R_Umr_10_zu__9_CM_S2 0 100 FORMAT "%3.1" /end CHARACTERISTIC
/begin CHARACTERISTIC XSCHGW_FP_FILT_GANGVBEGR_AUS "" VALUE 0x27A6DE _REC_S1VAL_1_s2_S2 6000 _CNV_R_R_Umr_1_zu_1_2_CM_S2 -3000 3000 FORMAT "%2.0" /end CHARACTERISTIC
/begin CHARACTERISTIC XS_HSU_HIGH_GANGVBEGR "" VALUE 0x27B791 _REC_S1VAL_1_u1_S2 1 _CNV_R_R_Umr_1_zu_1_2_CM_S2 0 1 FORMAT "%2.0" /end CHARACTERISTIC
/begin CHARACTERISTIC XT_GANGVBEGR_AUS "" VALUE 0x27A6E0 _REC_S1VAL_1_u2_S2 65535 _CNV_R_R_Umr_1_zu_1_2_CM_S2 0 65535 FORMAT "%2.0" /end CHARACTERISTIC
/begin CHARACTERISTIC XW_MINDKKD_RS_GANGVBEGR "" VALUE 0x27A6E2 _REC_S1VAL_1_u2_S2 100 _CNV_R_R_Umr_10_zu__9_CM_S2 0 100 FORMAT "%3.1" /end CHARACTERISTIC
/begin CHARACTERISTIC XTAB4S_EFAHRKL_RSU_ENBL "" CURVE 0x273E48 _REC_A1CUR_30_u1_u1_S2 1 _CNV_R_R_Umr_1_zu_1_2_CM_S2 0 1 FORMAT "%2.0"
 /begin AXIS_DESCR FIX_AXIS Z_EFAHREN_ERK _CNV_S_4_Enum_Z_EFA_354_CM_S2 4 0 3 /begin FIX_AXIS_PAR_LIST 0 1 2 3 /end FIX_AXIS_PAR_LIST READ_ONLY /end AXIS_DESCR
/end CHARACTERISTIC
/begin CHARACTERISTIC XTAB6M_RSUMODWHYB_VORHALT_EIN "" CURVE 0x273E4C _REC_A1CUR_30_s2_u1_S2 20000 _CNV_R_R_Umr_1_zu_1_42_CM_S2 -10000 10000 FORMAT "%2.0"
 /begin AXIS_DESCR FIX_AXIS NO_INPUT_QUANTITY _CNV_S_9_Enum_EGANG_30_CM_S2 6 0 8 /begin FIX_AXIS_PAR_LIST 0 1 2 3 4 5 /end FIX_AXIS_PAR_LIST READ_ONLY /end AXIS_DESCR
/end CHARACTERISTIC
/begin CHARACTERISTIC XTAB6T_AKTGANG_RSU_EIN "" CURVE 0x273E58 _REC_A1CUR_30_s4_u1_S2 20000 _CNV_R_R_Umr_1_zu_1_6_CM_S2 -10000 10000 FORMAT "%2.0"
 /begin AXIS_DESCR FIX_AXIS NO_INPUT_QUANTITY _CNV_S_9_Enum_EGANG_30_CM_S2 6 0 8 /begin FIX_AXIS_PAR_LIST 0 1 2 3 4 5 /end FIX_AXIS_PAR_LIST READ_ONLY /end AXIS_DESCR
/end CHARACTERISTIC
/begin CHARACTERISTIC XTAB6T_HIGANG_RSU_EIN "" CURVE 0x273E70 _REC_A1CUR_30_s4_u1_S2 20000 _CNV_R_R_Umr_1_zu_1_6_CM_S2 -10000 10000 FORMAT "%2.0"
 /begin AXIS_DESCR FIX_AXIS NO_INPUT_QUANTITY _CNV_S_9_Enum_EGANG_30_CM_S2 6 0 8 /begin FIX_AXIS_PAR_LIST 0 1 2 3 4 5 /end FIX_AXIS_PAR_LIST READ_ONLY /end AXIS_DESCR
/end CHARACTERISTIC
/begin CHARACTERISTIC XTAB9X2T_RSUMODWHYB_VORHALT_AUS "" MAP 0x273E88 _REC_A1MAP_9_u2_u1_u1_S2 10000 _CNV_R_R_Umr_1_zu_1_6_CM_S2 0 10000 FORMAT "%2.0"
 /begin AXIS_DESCR FIX_AXIS Z_GANG_SOLL _CNV_S_9_Enum_EGANG_30_CM_S2 9 0 8 FIX_AXIS_PAR_DIST 0 1 9 READ_ONLY /end AXIS_DESCR
 /begin AXIS_DESCR FIX_AXIS NO_INPUT_QUANTITY _CNV_R_R_Umr_1_zu_1_2_CM_S2 2 0 255 FIX_AXIS_PAR_DIST 0 1 2 READ_ONLY /end AXIS_DESCR
/end CHARACTERISTIC
/begin CHARACTERISTIC XS_RSUMODWHYB_EMODE "" VALUE 0x27B78F _REC_S1VAL_1_u1_S2 1 _CNV_R_R_Umr_1_zu_1_2_CM_S2 0 1 FORMAT "%2.0" /end CHARACTERISTIC
/begin CHARACTERISTIC XT_HIGANG_RSUMODWHYB_AUS "" VALUE 0x27A6B8 _REC_S1VAL_1_u2_S2 10000 _CNV_R_R_Umr_1_zu_1_6_CM_S2 0 10000 FORMAT "%2.0" /end CHARACTERISTIC
/begin CHARACTERISTIC XT_HIGANG_RSUMODWHYB_AUS_RESET "" VALUE 0x27A6BA _REC_S1VAL_1_u2_S2 10000 _CNV_R_R_Umr_1_zu_1_6_CM_S2 0 10000 FORMAT "%2.0" /end CHARACTERISTIC
/begin CHARACTERISTIC XT_RSUMODWHYB_AUS_AKTGANG "" VALUE 0x27A6BC _REC_S1VAL_1_u2_S2 10000 _CNV_R_R_Umr_1_zu_1_6_CM_S2 0 10000 FORMAT "%2.0" /end CHARACTERISTIC
/begin CHARACTERISTIC XT_RSUMODWHYB_AUS_HIGANG "" VALUE 0x27A6BE _REC_S1VAL_1_u2_S2 10000 _CNV_R_R_Umr_1_zu_1_6_CM_S2 0 10000 FORMAT "%2.0" /end CHARACTERISTIC
/begin MEASUREMENT FUNKINIT_DONE_WL "" UBYTE _CNV_R_R_Umr_1_zu_1_2_CM_S2 1 0 0 255 FORMAT "%2.0" ECU_ADDRESS 0xFFF91553 /end MEASUREMENT
/begin MEASUREMENT FUNKINIT_DONE_WL2 "" UBYTE _CNV_R_R_Umr_1_zu_1_2_CM_S2 1 0 0 1 FORMAT "%2.0" ECU_ADDRESS 0xFFF91550 /end MEASUREMENT
/begin MEASUREMENT ON_AB_WLSPV "" UWORD _CNV_R_R_Umr_1_zu_1_3_CM_S2 1 0 0 20000 FORMAT "%2.0" ECU_ADDRESS 0xFFF90DBA /end MEASUREMENT
/begin MEASUREMENT S_DPF_REG_ERK "" UBYTE _CNV_S_2_Schalter_A_4_CM_S2 1 0 0 1 ECU_ADDRESS 0xFFF91554 /end MEASUREMENT
/begin MEASUREMENT S_STOP_WL "" UBYTE _CNV_P_2_A_I_5_CM_S2 1 0 0 255 ECU_ADDRESS 0xFFF91555 /end MEASUREMENT
/begin MEASUREMENT S_WL "" UBYTE _CNV_P_2_A_I_5_CM_S2 1 0 0 255 ECU_ADDRESS 0xFFF91556 /end MEASUREMENT
/begin MEASUREMENT S_WL2_ERK "" UBYTE _CNV_S_2_Schalter_A_4_CM_S2 1 0 0 1 ECU_ADDRESS 0xFFF91551 /end MEASUREMENT
/begin MEASUREMENT S_WLPRED "" UBYTE _CNV_S_2_Schalter_A_4_CM_S2 1 0 0 1 ECU_ADDRESS 0xFFF91552 /end MEASUREMENT
/begin MEASUREMENT S_WLSPV_ERK "" UBYTE _CNV_P_2_A_I_5_CM_S2 1 0 0 255 ECU_ADDRESS 0xFFF91557 /end MEASUREMENT
/begin MEASUREMENT S_WL_ERK "" UBYTE _CNV_P_2_A_I_5_CM_S2 1 0 0 255 ECU_ADDRESS 0xFFF91558 /end MEASUREMENT
/begin MEASUREMENT T_BUFFER_WL "" ULONG _CNV_R_R_Umr_1_zu_1_6_CM_S2 1 0 0 4294967295 FORMAT "%2.0" ECU_ADDRESS 0xFFF90358 /end MEASUREMENT
/begin MEASUREMENT T_BUFFER_WL2 "" ULONG _CNV_R_R_Umr_1_zu_1_6_CM_S2 1 0 0 4294967295 FORMAT "%2.0" ECU_ADDRESS 0xFFF90348 /end MEASUREMENT
/begin MEASUREMENT T_BUFFER_WLPRED "" ULONG _CNV_R_R_Umr_1_zu_1_6_CM_S2 1 0 0 4294967295 FORMAT "%2.0" ECU_ADDRESS 0xFFF9034C /end MEASUREMENT
/begin MEASUREMENT T_WL "" SLONG _CNV_R_R_Umr_1_zu_1_6_CM_S2 1 0 -2147483647 2147483647 FORMAT "%2.0" ECU_ADDRESS 0xFFF9035C /end MEASUREMENT
/begin MEASUREMENT T_WL2 "" ULONG _CNV_R_R_Umr_1_zu_1_6_CM_S2 1 0 0 4294967295 FORMAT "%2.0" ECU_ADDRESS 0xFFF90350 /end MEASUREMENT
/begin MEASUREMENT T_WLPRED "" ULONG _CNV_R_R_Umr_1_zu_1_6_CM_S2 1 0 0 4294967295 FORMAT "%2.0" ECU_ADDRESS 0xFFF90354 /end MEASUREMENT
/begin MEASUREMENT C_SCHLUPF_BUFFER "" UWORD _CNV_R_R_Umr_1_zu_1_2_CM_S2 1 0 0 65535 FORMAT "%2.0" ECU_ADDRESS 0xFFF90D9C /end MEASUREMENT
/begin MEASUREMENT ISMPL_SCHLUPF_GEW "" UWORD _CNV_R_R_Umr_1_zu_1_2_CM_S2 1 0 0 65535 FORMAT "%2.0" ECU_ADDRESS 0xFFF90D9E /end MEASUREMENT
/begin MEASUREMENT SCHA_FZG_MUELOW_EIN_GRADIENT "" SWORD _CNV_R_R_Umr_10_zu__46_CM_S2 1 0 -20 20 FORMAT "%3.1" ECU_ADDRESS 0xFFF90DA0 /end MEASUREMENT
/begin MEASUREMENT SCHA_MUELOW_AUS_BESCHL "" SWORD _CNV_R_R_Umr_10_zu__46_CM_S2 1 0 -20 20 FORMAT "%3.1" ECU_ADDRESS 0xFFF90DA2 /end MEASUREMENT
/begin MEASUREMENT SCHA_MUELOW_AUS_BREMS "" SWORD _CNV_R_R_Umr_10_zu__46_CM_S2 1 0 -40 40 FORMAT "%3.1" ECU_ADDRESS 0xFFF90DA4 /end MEASUREMENT
/begin MEASUREMENT SCHG2W_AB_MUELOW_EIN_GRADIENT "" UWORD _CNV_R_R_Umr_10_zu__47_CM_S2 1 0 0 256 FORMAT "%3.1" ECU_ADDRESS 0xFFF90DA6 /end MEASUREMENT
/begin MEASUREMENT SCHM_RAD_MUELOW_AUS_LAST "" UWORD _CNV_R_R_Umr_1_zu_1_42_CM_S2 1 0 0 65535 FORMAT "%2.0" ECU_ADDRESS 0xFFF90DA8 /end MEASUREMENT
/begin MEASUREMENT SMPL_SCHLUPF_GEW "" UWORD _CNV_R_R_Umr_1_zu_1_2_CM_S2 1 0 0 65535 FORMAT "%2.0" ECU_ADDRESS 0xFFF90DAA /end MEASUREMENT
/begin MEASUREMENT SMPL_SCHLUPF_GEWBUFFER "" UWORD _CNV_R_R_Umr_1_zu_1_2_CM_S2 1 0 0 65535 FORMAT "%2.0" ARRAY_SIZE 16 ECU_ADDRESS 0xFFF90300 MATRIX_DIM 16 1 1 /end MEASUREMENT
/begin MEASUREMENT S_MUELOW "" UBYTE _CNV_R_R_Umr_1_zu_1_2_CM_S2 1 0 0 1 ECU_ADDRESS 0xFFF9153D /end MEASUREMENT
/begin MEASUREMENT S_MUELOW_ALT "" UBYTE _CNV_R_R_Umr_1_zu_1_2_CM_S2 1 0 0 1 FORMAT "%2.0" ECU_ADDRESS 0xFFF9153E /end MEASUREMENT
/begin MEASUREMENT S_MUELOW_AUS_BESCHL "" UBYTE _CNV_R_R_Umr_1_zu_1_2_CM_S2 1 0 0 1 ECU_ADDRESS 0xFFF9153F /end MEASUREMENT
/begin MEASUREMENT S_MUELOW_AUS_BREMS "" UBYTE _CNV_R_R_Umr_1_zu_1_2_CM_S2 1 0 0 1 ECU_ADDRESS 0xFFF91540 /end MEASUREMENT
/begin MEASUREMENT S_MUELOW_AUS_LAST "" UBYTE _CNV_R_R_Umr_1_zu_1_2_CM_S2 1 0 0 1 ECU_ADDRESS 0xFFF91541 /end MEASUREMENT
/begin MEASUREMENT S_MUELOW_AUS_POS "" UBYTE _CNV_R_R_Umr_1_zu_1_2_CM_S2 1 0 0 1 ECU_ADDRESS 0xFFF91542 /end MEASUREMENT
/begin MEASUREMENT S_MUELOW_AUS_SS "" UBYTE _CNV_R_R_Umr_1_zu_1_2_CM_S2 1 0 0 1 ECU_ADDRESS 0xFFF91543 /end MEASUREMENT
/begin MEASUREMENT S_MUELOW_AUS_TDSC "" UBYTE _CNV_R_R_Umr_1_zu_1_2_CM_S2 1 0 0 1 ECU_ADDRESS 0xFFF91544 /end MEASUREMENT
/begin MEASUREMENT S_MUELOW_EIN_ABS "" UBYTE _CNV_R_R_Umr_1_zu_1_2_CM_S2 1 0 0 1 ECU_ADDRESS 0xFFF91545 /end MEASUREMENT
/begin MEASUREMENT S_MUELOW_EIN_DSC "" UBYTE _CNV_R_R_Umr_1_zu_1_2_CM_S2 1 0 0 1 ECU_ADDRESS 0xFFF91546 /end MEASUREMENT
/begin MEASUREMENT S_MUELOW_EIN_GRADIENT "" UBYTE _CNV_R_R_Umr_1_zu_1_2_CM_S2 1 0 0 1 ECU_ADDRESS 0xFFF91547 /end MEASUREMENT
/begin MEASUREMENT S_MUELOW_EIN_SCHLUPF "" UBYTE _CNV_R_R_Umr_1_zu_1_2_CM_S2 1 0 0 1 ECU_ADDRESS 0xFFF91548 /end MEASUREMENT
/begin MEASUREMENT S_MUELOW_EIN_SS "" UBYTE _CNV_R_R_Umr_1_zu_1_2_CM_S2 1 0 0 1 ECU_ADDRESS 0xFFF91549 /end MEASUREMENT
/begin MEASUREMENT S_MUELOW_ERK "" UBYTE _CNV_P_2_A_I_5_CM_S2 1 0 0 255 ECU_ADDRESS 0xFFF9154A /end MEASUREMENT
/begin MEASUREMENT S_REGERK "" UBYTE _CNV_R_R_Umr_1_zu_1_2_CM_S2 1 0 0 1 ECU_ADDRESS 0xFFF9153C /end MEASUREMENT
/begin MEASUREMENT S_SCHLUPF_NACHL "" UBYTE _CNV_P_2_A_I_5_CM_S2 1 0 0 255 ECU_ADDRESS 0xFFF9154B /end MEASUREMENT
/begin MEASUREMENT S_SCHLUPF_NACHLZWEI "" UBYTE _CNV_P_2_A_I_5_CM_S2 1 0 0 255 ECU_ADDRESS 0xFFF9154C /end MEASUREMENT
/begin MEASUREMENT S_TMR_BSCHLUPF "" UBYTE _CNV_P_2_A_I_5_CM_S2 1 0 0 255 ECU_ADDRESS 0xFFF9154D /end MEASUREMENT
/begin MEASUREMENT T_BUFFER_BSCHLUPF "" ULONG _CNV_R_R_Umr_1_zu_1_6_CM_S2 1 0 0 4294967295 FORMAT "%2.0" ECU_ADDRESS 0xFFF90320 /end MEASUREMENT
/begin MEASUREMENT T_MUELOW_AUS_BESCHL "" UWORD _CNV_R_R_Umr_1_zu_1_6_CM_S2 1 0 0 65535 FORMAT "%2.0" ECU_ADDRESS 0xFFF90DAC /end MEASUREMENT
/begin MEASUREMENT T_MUELOW_AUS_BESCHL_BUF "" ULONG _CNV_R_R_Umr_1_zu_1_6_CM_S2 1 0 0 4294967295 FORMAT "%2.0" ECU_ADDRESS 0xFFF90324 /end MEASUREMENT
/begin MEASUREMENT T_MUELOW_AUS_BREMS "" UWORD _CNV_R_R_Umr_1_zu_1_6_CM_S2 1 0 0 5000 FORMAT "%2.0" ECU_ADDRESS 0xFFF90DAE /end MEASUREMENT
/begin MEASUREMENT T_MUELOW_AUS_BREMS_BUF "" ULONG _CNV_R_R_Umr_1_zu_1_6_CM_S2 1 0 0 4294967295 FORMAT "%2.0" ECU_ADDRESS 0xFFF90328 /end MEASUREMENT
/begin MEASUREMENT T_MUELOW_AUS_LAST "" UWORD _CNV_R_R_Umr_1_zu_1_6_CM_S2 1 0 0 65535 FORMAT "%2.0" ECU_ADDRESS 0xFFF90DB0 /end MEASUREMENT
/begin MEASUREMENT T_MUELOW_AUS_LAST_BUF "" ULONG _CNV_R_R_Umr_1_zu_1_6_CM_S2 1 0 0 4294967295 FORMAT "%2.0" ECU_ADDRESS 0xFFF9032C /end MEASUREMENT
/begin MEASUREMENT T_MUELOW_EIN_ABS "" UWORD _CNV_R_R_Umr_1_zu_1_6_CM_S2 1 0 0 65535 FORMAT "%2.0" ECU_ADDRESS 0xFFF90DB8 /end MEASUREMENT
/begin MEASUREMENT T_MUELOW_EIN_ABS_BUF "" ULONG _CNV_R_R_Umr_1_zu_1_6_CM_S2 1 0 0 4294967295 FORMAT "%2.0" ECU_ADDRESS 0xFFF90330 /end MEASUREMENT
/begin MEASUREMENT T_MUELOW_EIN_DSC "" UWORD _CNV_R_R_Umr_1_zu_1_6_CM_S2 1 0 0 65535 FORMAT "%2.0" ECU_ADDRESS 0xFFF90DB2 /end MEASUREMENT
/begin MEASUREMENT T_MUELOW_EIN_DSC_BUF "" ULONG _CNV_R_R_Umr_1_zu_1_6_CM_S2 1 0 0 4294967295 FORMAT "%2.0" ECU_ADDRESS 0xFFF90334 /end MEASUREMENT
/begin MEASUREMENT T_MUELOW_EIN_GRADIENT "" UWORD _CNV_R_R_Umr_1_zu_1_6_CM_S2 1 0 0 65535 FORMAT "%2.0" ECU_ADDRESS 0xFFF90DB4 /end MEASUREMENT
/begin MEASUREMENT T_MUELOW_EIN_GRADIENT_BUF "" ULONG _CNV_R_R_Umr_1_zu_1_6_CM_S2 1 0 0 4294967295 FORMAT "%2.0" ECU_ADDRESS 0xFFF90338 /end MEASUREMENT
/begin MEASUREMENT T_SCHLUPF_NACHL "" SLONG _CNV_R_R_Umr_1_zu_1_6_CM_S2 1 0 -2147483647 2147483647 FORMAT "%2.0" ECU_ADDRESS 0xFFF9033C /end MEASUREMENT
/begin MEASUREMENT T_SCHLUPF_NACHLBUF "" ULONG _CNV_R_R_Umr_1_zu_1_6_CM_S2 1 0 0 4294967295 FORMAT "%2.0" ECU_ADDRESS 0xFFF90340 /end MEASUREMENT
/begin MEASUREMENT T_SCHLUPF_NACHLZWEI "" UWORD _CNV_R_R_Umr_1_zu_1_6_CM_S2 1 0 0 65535 FORMAT "%2.0" ECU_ADDRESS 0xFFF90DB6 /end MEASUREMENT
/begin MEASUREMENT T_SCHLUPF_NACHLZWEI_BUF "" ULONG _CNV_R_R_Umr_1_zu_1_6_CM_S2 1 0 0 4294967295 FORMAT "%2.0" ECU_ADDRESS 0xFFF90344 /end MEASUREMENT
/begin MEASUREMENT Z_MUELOW_AUS_MASK "" UBYTE _CNV_R_R_Umr_1_zu_1_2_CM_S2 1 0 0 255 ECU_ADDRESS 0xFFF9154E /end MEASUREMENT
/begin MEASUREMENT Z_MUELOW_EIN_MASK "" UBYTE _CNV_R_R_Umr_1_zu_1_2_CM_S2 1 0 0 255 ECU_ADDRESS 0xFFF9154F /end MEASUREMENT
/begin MEASUREMENT CONTROL_EIN_NAB_BAB "" UWORD _CNV_S_2_Enum_ECONT_55_CM_S2 1 0 0 1 ECU_ADDRESS 0xFFF90CEE /end MEASUREMENT
/begin MEASUREMENT CONTROL_RSZ_BAB "" UWORD _CNV_S_3_Enum_ECONT_56_CM_S2 1 0 0 2 ECU_ADDRESS 0xFFF91194 /end MEASUREMENT
/begin MEASUREMENT DM_AB_FWSRSZ "" SWORD _CNV_R_R_Umr_1_zu_1_42_CM_S2 1 0 -32768 32767 FORMAT "%2.0" ECU_ADDRESS 0xFFF91196 /end MEASUREMENT
/begin MEASUREMENT DM_AB_FWS_FILT_BAB "" SWORD _CNV_R_R_Umr_1_zu_1_42_CM_S2 1 0 -32768 32767 FORMAT "%2.0" ECU_ADDRESS 0xFFF90CF0 /end MEASUREMENT
/begin MEASUREMENT FAKT_EM_POT_REKUP_BAB "" UBYTE _CNV_R_R_Umr_1_zu_1_53_CM_S2 1 0 0 100 FORMAT "%2.0" ECU_ADDRESS 0xFFF9176D /end MEASUREMENT
/begin MEASUREMENT FAKT_SOC_NMOTMAXRS_BAB "" UBYTE _CNV_R_R_Umr_100_zu_54_CM_S2 1 0 0 1 FORMAT "%4.2" ECU_ADDRESS 0xFFF9176F /end MEASUREMENT
/begin MEASUREMENT FUNKINIT_DONE_BABLOG "" UBYTE _CNV_P_2_A_I_5_CM_S2 1 0 0 255 ECU_ADDRESS 0xFFF914C0 /end MEASUREMENT
/begin MEASUREMENT FUNKINIT_DONE_BABSIG "" UBYTE _CNV_P_2_A_I_5_CM_S2 1 0 0 255 ECU_ADDRESS 0xFFF914C1 /end MEASUREMENT
/begin MEASUREMENT I_FAKT_EINFRS "" UWORD _CNV_R_R_Umr_1000_z_57_CM_S2 1 0 0 5 FORMAT "%5.3" ECU_ADDRESS 0xFFF91198 /end MEASUREMENT
/begin MEASUREMENT I_FAKT_MFRSZ "" UWORD _CNV_R_R_Umr_1000_z_57_CM_S2 1 0 0 5 FORMAT "%5.3" ECU_ADDRESS 0xFFF9119A /end MEASUREMENT
/begin MEASUREMENT M_AB_REKUPMAX "" SWORD _CNV_R_R_Umr_1_zu_1_42_CM_S2 1 0 -20000 20000 ECU_ADDRESS 0xFFF9119C /end MEASUREMENT
/begin MEASUREMENT M_AB_REKUPMAX_FILT "" SWORD _CNV_R_R_Umr_1_zu_1_42_CM_S2 1 0 -32768 32767 ECU_ADDRESS 0xFFF9119E /end MEASUREMENT
/begin MEASUREMENT M_AB_REKUPMAX_FILTREST "" SWORD _CNV_R_R_Umr_1_zu_1_42_CM_S2 1 0 -32768 32767 FORMAT "%2.0" ECU_ADDRESS 0xFFF911A0 /end MEASUREMENT
/begin MEASUREMENT M_AB_REKUP_BAB "" SWORD _CNV_R_R_Umr_1_zu_1_42_CM_S2 1 0 -32768 32767 FORMAT "%2.0" ECU_ADDRESS 0xFFF911A2 /end MEASUREMENT
/begin MEASUREMENT N_AB_REFBAB "" UWORD _CNV_R_R_Umr_1_zu_1_3_CM_S2 1 0 0 20000 FORMAT "%2.0" ECU_ADDRESS 0xFFF90CF2 /end MEASUREMENT
/begin MEASUREMENT N_MOT_EINFRS "" UWORD _CNV_R_R_Umr_1_zu_1_3_CM_S2 1 0 0 20000 FORMAT "%2.0" ECU_ADDRESS 0xFFF911A4 /end MEASUREMENT
/begin MEASUREMENT N_MOT_MFRSZ "" UWORD _CNV_R_R_Umr_1_zu_1_3_CM_S2 1 0 0 20000 FORMAT "%2.0" ECU_ADDRESS 0xFFF911A6 /end MEASUREMENT
/begin MEASUREMENT SCHN_MOTMAX_RSZ_BAB "" UWORD _CNV_R_R_Umr_1_zu_1_3_CM_S2 1 0 0 65535 FORMAT "%2.0" ECU_ADDRESS 0xFFF911A8 /end MEASUREMENT
/begin MEASUREMENT SCHW_STEIGUNG_BABAUS "" SWORD _CNV_R_R_Umr_10_zu__9_CM_S2 1 0 -3276.8 3276.7 FORMAT "%3.1" ECU_ADDRESS 0xFFF90CF4 /end MEASUREMENT
/begin MEASUREMENT SCHW_STEIGUNG_BABEIN "" SWORD _CNV_R_R_Umr_10_zu__9_CM_S2 1 0 -3276.8 3276.7 FORMAT "%3.1" ECU_ADDRESS 0xFFF90CF6 /end MEASUREMENT
/begin MEASUREMENT S_BAB_ERK "" UBYTE _CNV_P_2_A_I_5_CM_S2 1 0 0 255 ECU_ADDRESS 0xFFF914C2 /end MEASUREMENT
/begin MEASUREMENT S_BAB_FGRKF "" UBYTE _CNV_S_2_Enum_EBABF_58_CM_S2 1 0 0 1 ECU_ADDRESS 0xFFF91770 /end MEASUREMENT
/begin MEASUREMENT S_EIN_BAB "" UBYTE _CNV_P_2_A_I_5_CM_S2 1 0 0 255 ECU_ADDRESS 0xFFF914C3 /end MEASUREMENT
/begin MEASUREMENT S_EIN_BAB_NAB "" UBYTE _CNV_P_2_A_I_5_CM_S2 1 0 0 255 ECU_ADDRESS 0xFFF914C4 /end MEASUREMENT
/begin MEASUREMENT S_EIN_BAB_STEIGUNG "" UBYTE _CNV_P_2_A_I_5_CM_S2 1 0 0 255 ECU_ADDRESS 0xFFF914C5 /end MEASUREMENT
/begin MEASUREMENT S_MRSZ_BAB "" UBYTE _CNV_P_2_A_I_5_CM_S2 1 0 0 255 ECU_ADDRESS 0xFFF91771 /end MEASUREMENT
/begin MEASUREMENT S_MRSZ_KURVEAUS "" UBYTE _CNV_P_2_A_I_5_CM_S2 1 0 0 255 ECU_ADDRESS 0xFFF91772 /end MEASUREMENT
/begin MEASUREMENT S_RSZ_BAB "" UBYTE _CNV_P_2_A_I_5_CM_S2 1 0 0 255 ECU_ADDRESS 0xFFF91773 /end MEASUREMENT
/begin MEASUREMENT S_RSZ_ZUL "" UBYTE _CNV_P_2_A_I_5_CM_S2 1 0 0 255 ECU_ADDRESS 0xFFF91774 /end MEASUREMENT
/begin MEASUREMENT S_SCHALT_BAB "" UBYTE _CNV_P_2_A_I_5_CM_S2 1 0 0 255 ECU_ADDRESS 0xFFF91775 /end MEASUREMENT
/begin MEASUREMENT S_SCHALT_BABERK "" UBYTE _CNV_P_2_A_I_5_CM_S2 1 0 0 255 ECU_ADDRESS 0xFFF91776 /end MEASUREMENT
/begin MEASUREMENT S_TSET_BABFGR "" UBYTE _CNV_P_2_A_I_5_CM_S2 1 0 0 255 ECU_ADDRESS 0xFFF91777 /end MEASUREMENT
/begin MEASUREMENT S_V_RSZBAB "" UBYTE _CNV_P_2_A_I_5_CM_S2 1 0 0 255 ECU_ADDRESS 0xFFF91778 /end MEASUREMENT
/begin MEASUREMENT T_BAB_FGR "" SLONG _CNV_R_R_Umr_1_zu_1_6_CM_S2 1 0 -2147483647 2147483647 FORMAT "%2.0" ECU_ADDRESS 0xFFF90864 /end MEASUREMENT
/begin MEASUREMENT T_BUFFER_BAB "" ULONG _CNV_R_R_Umr_1_zu_1_6_CM_S2 1 0 0 2147483647 FORMAT "%2.0" ECU_ADDRESS 0xFFF9022C /end MEASUREMENT
/begin MEASUREMENT T_BUFFER_BABFGR "" ULONG _CNV_R_R_Umr_1_zu_1_6_CM_S2 1 0 0 2147483647 FORMAT "%2.0" ECU_ADDRESS 0xFFF90868 /end MEASUREMENT
/begin MEASUREMENT T_BUFFER_EIN "" ULONG _CNV_R_R_Umr_1_zu_1_6_CM_S2 1 0 0 2147483647 FORMAT "%2.0" ECU_ADDRESS 0xFFF90230 /end MEASUREMENT
/begin MEASUREMENT T_BUFFER_MFRSZBAB "" ULONG _CNV_R_R_Umr_1_zu_1_6_CM_S2 1 0 0 2147483647 FORMAT "%2.0" ECU_ADDRESS 0xFFF9086C /end MEASUREMENT
/begin MEASUREMENT T_BUFFER_SPERRRSZBAB "" ULONG _CNV_R_R_Umr_1_zu_1_6_CM_S2 1 0 0 2147483647 FORMAT "%2.0" ECU_ADDRESS 0xFFF90870 /end MEASUREMENT
/begin MEASUREMENT T_BUFFER_VRSZBAB "" ULONG _CNV_R_R_Umr_1_zu_1_6_CM_S2 1 0 0 2147483647 FORMAT "%2.0" ECU_ADDRESS 0xFFF90874 /end MEASUREMENT
/begin MEASUREMENT T_EIN_BAB "" SLONG _CNV_R_R_Umr_1_zu_1_6_CM_S2 1 0 -2147483648 2147483647 FORMAT "%2.0" ECU_ADDRESS 0xFFF90234 /end MEASUREMENT
/begin MEASUREMENT T_MFRSZ_BAB "" SLONG _CNV_R_R_Umr_1_zu_1_6_CM_S2 1 0 -2147483647 2147483647 FORMAT "%2.0" ECU_ADDRESS 0xFFF90878 /end MEASUREMENT
/begin MEASUREMENT T_NACHL_BAB "" SLONG _CNV_R_R_Umr_1_zu_1_6_CM_S2 1 0 -2147483647 2147483647 FORMAT "%2.0" ECU_ADDRESS 0xFFF90238 /end MEASUREMENT
/begin MEASUREMENT T_SPERR_RSZBAB "" SLONG _CNV_R_R_Umr_1_zu_1_6_CM_S2 1 0 -2147483647 2147483647 FORMAT "%2.0" ECU_ADDRESS 0xFFF9087C /end MEASUREMENT
/begin MEASUREMENT T_V_RSZBAB "" SLONG _CNV_R_R_Umr_1_zu_1_6_CM_S2 1 0 -2147483647 2147483647 FORMAT "%2.0" ECU_ADDRESS 0xFFF90880 /end MEASUREMENT
/begin MEASUREMENT W_STEIGUNG_KORFILT_SLOW "" SWORD _CNV_R_R_Umr_10_zu__9_CM_S2 1 0 -200 200 FORMAT "%3.1" ECU_ADDRESS 0xFFF90CF8 /end MEASUREMENT
/begin MEASUREMENT W_STEIGUNG_KORFILT_SLOW_REST "" SWORD _CNV_R_R_Umr_10_zu__9_CM_S2 1 0 -200 200 FORMAT "%3.1" ECU_ADDRESS 0xFFF90CFA /end MEASUREMENT
/begin MEASUREMENT Z_ERK_BAB "" UBYTE _CNV_S_3_Enum_EBAB_59_CM_S2 1 0 0 2 ECU_ADDRESS 0xFFF914C6 /end MEASUREMENT
/begin MEASUREMENT Z_GANG_BAB "" UBYTE _CNV_S_9_Enum_EGANG_30_CM_S2 1 0 0 8 ECU_ADDRESS 0xFFF91779 /end MEASUREMENT
/begin MEASUREMENT Z_GANG_BABRSZ "" UBYTE _CNV_S_9_Enum_EGANG_30_CM_S2 1 0 0 8 ECU_ADDRESS 0xFFF9177A /end MEASUREMENT
/begin MEASUREMENT Z_GANG_RSZFWS "" UBYTE _CNV_S_9_Enum_EGANG_30_CM_S2 1 0 0 8 ECU_ADDRESS 0xFFF9177B /end MEASUREMENT
/begin MEASUREMENT Z_GANG_RSZMOT "" UBYTE _CNV_S_9_Enum_EGANG_30_CM_S2 1 0 0 8 ECU_ADDRESS 0xFFF9177C /end MEASUREMENT
/begin MEASUREMENT Z_GANG_RSZROH "" UBYTE _CNV_S_9_Enum_EGANG_30_CM_S2 1 0 0 8 ECU_ADDRESS 0xFFF9177D /end MEASUREMENT
/begin MEASUREMENT Z_GANG_RSZSEQ_BAB "" UBYTE _CNV_S_9_Enum_EGANG_30_CM_S2 1 0 0 8 ECU_ADDRESS 0xFFF9177E /end MEASUREMENT
/begin MEASUREMENT Z_GANG_ZIELALT_BAB "" UBYTE _CNV_S_9_Enum_EGANG_30_CM_S2 1 0 0 8 ECU_ADDRESS 0xFFF9177F /end MEASUREMENT
/begin MEASUREMENT Z_STATUS_ANTRIEB_FZG_BAB "" UBYTE _CNV_R_R_Umr_1_zu_1_2_CM_S2 1 0 0 255 ECU_ADDRESS 0xFFF9176E /end MEASUREMENT
/begin MEASUREMENT CONTROL_USESERP_BGH "" UWORD _CNV_R_R_Umr_1_zu_1_2_CM_S2 1 0 0 1 ECU_ADDRESS 0xFFF90D86 /end MEASUREMENT
/begin MEASUREMENT DM_AB_FWSBGHNACHLDELTA "" SWORD _CNV_R_R_Umr_1_zu_1_42_CM_S2 1 0 -32768 32767 FORMAT "%2.0" ECU_ADDRESS 0xFFF90D88 /end MEASUREMENT
/begin MEASUREMENT DM_AB_FWSKOR_FILTFAST_BGH "" SWORD _CNV_R_R_Umr_1_zu_1_42_CM_S2 1 0 -32768 32767 FORMAT "%2.0" ECU_ADDRESS 0xFFF90D8A /end MEASUREMENT
/begin MEASUREMENT DM_AB_FWSKOR_FILTSLOW_BGH "" SWORD _CNV_R_R_Umr_1_zu_1_42_CM_S2 1 0 -32768 32767 FORMAT "%2.0" ECU_ADDRESS 0xFFF90D8C /end MEASUREMENT
/begin MEASUREMENT DM_AB_FWSSERPFAST "" SWORD _CNV_R_R_Umr_1_zu_1_42_CM_S2 1 0 -32768 32767 FORMAT "%2.0" ECU_ADDRESS 0xFFF90D8E /end MEASUREMENT
/begin MEASUREMENT DM_AB_FWSSERPSLOW "" SWORD _CNV_R_R_Umr_1_zu_1_42_CM_S2 1 0 -32768 32767 FORMAT "%2.0" ECU_ADDRESS 0xFFF90D90 /end MEASUREMENT
/begin MEASUREMENT FUNKINIT_DONE_BERGANH "" UBYTE _CNV_R_R_Umr_1_zu_1_2_CM_S2 1 0 0 255 FORMAT "%2.0" ECU_ADDRESS 0xFFF9150D /end MEASUREMENT
/begin MEASUREMENT SCHDM_AB_FWSDOWN_BGH "" SWORD _CNV_R_R_Umr_1_zu_1_42_CM_S2 1 0 -32768 32767 FORMAT "%2.0" ECU_ADDRESS 0xFFF90D92 /end MEASUREMENT
/begin MEASUREMENT SCHDM_AB_FWSUP_BGH "" SWORD _CNV_R_R_Umr_1_zu_1_42_CM_S2 1 0 -32768 32767 FORMAT "%2.0" ECU_ADDRESS 0xFFF90D94 /end MEASUREMENT
/begin MEASUREMENT SCHDM_AB_FWSZW_HS "" SWORD _CNV_R_R_Umr_1_zu_1_42_CM_S2 1 0 -32768 32767 FORMAT "%2.0" ECU_ADDRESS 0xFFF90D96 /end MEASUREMENT
/begin MEASUREMENT S_BERG_A1_ERK "" UBYTE _CNV_P_2_A_I_5_CM_S2 1 0 0 255 ECU_ADDRESS 0xFFF9150E /end MEASUREMENT
/begin MEASUREMENT S_BERG_A2_ERK "" UBYTE _CNV_P_2_A_I_5_CM_S2 1 0 0 255 ECU_ADDRESS 0xFFF9150F /end MEASUREMENT
/begin MEASUREMENT S_BERG_A3_ERK "" UBYTE _CNV_P_2_A_I_5_CM_S2 1 0 0 255 ECU_ADDRESS 0xFFF91510 /end MEASUREMENT
/begin MEASUREMENT S_BERG_A4_ERK "" UBYTE _CNV_P_2_A_I_5_CM_S2 1 0 0 255 ECU_ADDRESS 0xFFF91511 /end MEASUREMENT
/begin MEASUREMENT S_BERG_A5_ERK "" UBYTE _CNV_P_2_A_I_5_CM_S2 1 0 0 255 ECU_ADDRESS 0xFFF91512 /end MEASUREMENT
/begin MEASUREMENT S_BERG_PROGNACHL "" UBYTE _CNV_P_2_A_I_5_CM_S2 1 0 0 255 ECU_ADDRESS 0xFFF91513 /end MEASUREMENT
/begin MEASUREMENT S_EIN_ERKBERGANH "" UBYTE _CNV_P_2_A_I_5_CM_S2 1 0 0 255 ECU_ADDRESS 0xFFF91514 /end MEASUREMENT
/begin MEASUREMENT S_ON_AB_HSFWS "" UBYTE _CNV_P_2_A_I_5_CM_S2 1 0 0 255 ECU_ADDRESS 0xFFF91515 /end MEASUREMENT
/begin MEASUREMENT T_BERG_PROGNACHL "" SLONG _CNV_R_R_Umr_1_zu_1_6_CM_S2 1 0 -50 100000 FORMAT "%2.0" ECU_ADDRESS 0xFFF902DC /end MEASUREMENT
/begin MEASUREMENT T_BGH_NACHLSTART "" ULONG _CNV_R_R_Umr_1_zu_1_6_CM_S2 1 0 0 4294967295 FORMAT "%2.0" ECU_ADDRESS 0xFFF902E0 /end MEASUREMENT
/begin MEASUREMENT T_BGH_NACHLVERGANGEN "" ULONG _CNV_R_R_Umr_1_zu_1_6_CM_S2 1 0 0 4294967295 FORMAT "%2.0" ECU_ADDRESS 0xFFF902E4 /end MEASUREMENT
/begin MEASUREMENT Z_BERGANH "" UBYTE _CNV_S_6_Enum_EBERG_61_CM_S2 1 0 0 5 ECU_ADDRESS 0xFFF91516 /end MEASUREMENT
/begin MEASUREMENT Z_BERGANH_ALT "" UBYTE _CNV_S_6_Enum_EBERG_61_CM_S2 1 0 0 5 ECU_ADDRESS 0xFFF91517 /end MEASUREMENT
/begin MEASUREMENT Z_PROG_HDMABFWSDOWN "" UBYTE _CNV_S_6_Enum_EBERG_61_CM_S2 1 0 0 5 ECU_ADDRESS 0xFFF91518 /end MEASUREMENT
/begin MEASUREMENT Z_PROG_HDMABFWSDOWNOLD "" UBYTE _CNV_S_6_Enum_EBERG_61_CM_S2 1 0 0 5 ECU_ADDRESS 0xFFF91519 /end MEASUREMENT
/begin MEASUREMENT Z_PROG_HDMABFWSUP "" UBYTE _CNV_S_6_Enum_EBERG_61_CM_S2 1 0 0 5 ECU_ADDRESS 0xFFF9151A /end MEASUREMENT
/begin MEASUREMENT Z_SERP_CLEAREINSTIEG "" UBYTE _CNV_P_2_A_I_5_CM_S2 1 0 0 255 ECU_ADDRESS 0xFFF9151B /end MEASUREMENT
/begin MEASUREMENT S_BRS_AKTION "" UBYTE _CNV_P_2_A_I_5_CM_S2 1 0 0 255 ECU_ADDRESS 0xFFF91577 /end MEASUREMENT
/begin MEASUREMENT S_BRS_ERK "" UBYTE _CNV_P_2_A_I_5_CM_S2 1 0 0 255 ECU_ADDRESS 0xFFF914C7 /end MEASUREMENT
/begin MEASUREMENT S_BRS_MARS_ERK "" UBYTE _CNV_P_2_A_I_5_CM_S2 1 0 0 255 ECU_ADDRESS 0xFFF914C8 /end MEASUREMENT
/begin MEASUREMENT S_D2RS_BRS_AKTION "" UBYTE _CNV_P_2_A_I_5_CM_S2 1 0 0 255 ECU_ADDRESS 0xFFF91578 /end MEASUREMENT
/begin MEASUREMENT Z_BRS_IDX "" UBYTE _CNV_S_5_Enum_EBRS__26_CM_S2 1 0 0 4 ECU_ADDRESS 0xFFF91579 /end MEASUREMENT
/begin MEASUREMENT Z_GANG_BRS "" UBYTE _CNV_S_9_Enum_EGANG_30_CM_S2 1 0 0 8 ECU_ADDRESS 0xFFF9157A /end MEASUREMENT
/begin MEASUREMENT Z_GANG_BRSMBR "" UBYTE _CNV_S_9_Enum_EGANG_30_CM_S2 1 0 0 8 ECU_ADDRESS 0xFFF9157B /end MEASUREMENT
/begin MEASUREMENT Z_GANG_D2BRSMBR "" UBYTE _CNV_S_9_Enum_EGANG_30_CM_S2 1 0 0 8 ECU_ADDRESS 0xFFF9157C /end MEASUREMENT
/begin MEASUREMENT Z_PROG_MODE_BRS "" UBYTE _CNV_S_3_Enum_EPROG_37_CM_S2 1 0 0 2 ECU_ADDRESS 0xFFF9157D /end MEASUREMENT
/begin MEASUREMENT T_BUFFER_DUEAUS "" ULONG _CNV_R_R_Umr_1_zu_1_6_CM_S2 1 0 0 4294967295 FORMAT "%2.0" ECU_ADDRESS 0xFFF90888 /end MEASUREMENT
/begin MEASUREMENT T_BUFFER_DUEEIN "" ULONG _CNV_R_R_Umr_1_zu_1_6_CM_S2 1 0 0 4294967295 FORMAT "%2.0" ECU_ADDRESS 0xFFF9088C /end MEASUREMENT
/begin MEASUREMENT T_DUE_AUS "" SLONG _CNV_R_R_Umr_1_zu_1_6_CM_S2 1 0 -2147483647 2147483647 FORMAT "%2.0" ECU_ADDRESS 0xFFF90890 /end MEASUREMENT
/begin MEASUREMENT T_DUE_EIN "" SLONG _CNV_R_R_Umr_1_zu_1_6_CM_S2 1 0 -2147483647 2147483647 FORMAT "%2.0" ECU_ADDRESS 0xFFF90894 /end MEASUREMENT
/begin MEASUREMENT S_DRIVELOGIK2_ERK "" UBYTE _CNV_R_R_Umr_1_zu_1_2_CM_S2 1 0 0 1 FORMAT "%2.0" ECU_ADDRESS 0xFFF9121A /end MEASUREMENT
/begin MEASUREMENT S_DRIVELOGIK3_ERK "" UBYTE _CNV_R_R_Umr_1_zu_1_2_CM_S2 1 0 0 1 FORMAT "%2.0" ECU_ADDRESS 0xFFF9121B /end MEASUREMENT
/begin MEASUREMENT S_DRIVELOGIK4_ERK "" UBYTE _CNV_R_R_Umr_1_zu_1_2_CM_S2 1 0 0 1 FORMAT "%2.0" ECU_ADDRESS 0xFFF9121C /end MEASUREMENT
/begin MEASUREMENT S_DRIVELOGIK5_ERK "" UBYTE _CNV_R_R_Umr_1_zu_1_2_CM_S2 1 0 0 1 FORMAT "%2.0" ECU_ADDRESS 0xFFF9121D /end MEASUREMENT
/begin MEASUREMENT S_DRIVELOGIK6_ERK "" UBYTE _CNV_R_R_Umr_1_zu_1_2_CM_S2 1 0 0 1 FORMAT "%2.0" ECU_ADDRESS 0xFFF9121E /end MEASUREMENT
/begin MEASUREMENT S_HOTMODE_ERK "" UBYTE _CNV_P_2_A_I_5_CM_S2 1 0 0 255 ECU_ADDRESS 0xFFF9151E /end MEASUREMENT
/begin MEASUREMENT S_LM "" UBYTE _CNV_P_2_A_I_5_CM_S2 1 0 0 255 ECU_ADDRESS 0xFFF91532 /end MEASUREMENT
/begin MEASUREMENT S_LM_ERK "" UBYTE _CNV_P_2_A_I_5_CM_S2 1 0 0 255 ECU_ADDRESS 0xFFF91533 /end MEASUREMENT
/begin MEASUREMENT S_MINUS_ALT_LM "" UBYTE _CNV_P_2_A_I_5_CM_S2 1 0 0 255 ECU_ADDRESS 0xFFF91534 /end MEASUREMENT
/begin MEASUREMENT S_STEPTR_ERK "" UBYTE _CNV_P_2_A_I_5_CM_S2 1 0 0 255 ECU_ADDRESS 0xFFF91537 /end MEASUREMENT
/begin MEASUREMENT S_TMS_ERK "" UBYTE _CNV_P_2_A_I_5_CM_S2 1 0 0 1 ECU_ADDRESS 0xFFF9121F /end MEASUREMENT
/begin MEASUREMENT Z_DSC_ALT_LM "" UBYTE _CNV_S_3_Enum_EDSCS_28_CM_S2 1 0 0 2 ECU_ADDRESS 0xFFF91535 /end MEASUREMENT
/begin MEASUREMENT S_ANFGANG2_ERK "" UBYTE _CNV_P_2_A_I_5_CM_S2 1 0 0 255 ECU_ADDRESS 0xFFF914BB /end MEASUREMENT
/begin MEASUREMENT S_ANFGANG2_FL_ERK "" UBYTE _CNV_P_2_A_I_5_CM_S2 1 0 0 255 ECU_ADDRESS 0xFFF914BC /end MEASUREMENT
/begin MEASUREMENT S_FLM_ERK "" UBYTE _CNV_P_2_A_I_5_CM_S2 1 0 0 255 ECU_ADDRESS 0xFFF914BD /end MEASUREMENT
/begin MEASUREMENT S_MUELOW_FREISCH_ERK "" UBYTE _CNV_R_R_Umr_1_zu_1_2_CM_S2 1 0 0 1 FORMAT "%2.0" ECU_ADDRESS 0xFFF914BE /end MEASUREMENT
/begin MEASUREMENT T_MUELOW_FREISCH "" UWORD _CNV_R_R_Umr_1_zu_1_2_CM_S2 1 0 0 30000 FORMAT "%2.0" ECU_ADDRESS 0xFFF90CEC /end MEASUREMENT
/begin MEASUREMENT Z_AGSMOD_ECO_EFAHREN "" UBYTE _CNV_S_4_Enum_EAGS__24_CM_S2 1 0 0 3 ECU_ADDRESS 0xFFF91218 /end MEASUREMENT
/begin MEASUREMENT Z_AGSMOD_ECO_EFAHREN_ALT "" UBYTE _CNV_S_4_Enum_EAGS__24_CM_S2 1 0 0 3 ECU_ADDRESS 0xFFF91219 /end MEASUREMENT
/begin MEASUREMENT Z_GANG_GANGVBEGR "" UBYTE _CNV_S_9_Enum_EGANG_30_CM_S2 1 0 0 8 ECU_ADDRESS 0xFFF9159B /end MEASUREMENT
/begin MEASUREMENT SSTERGW_DKKD_BPL.anz "" UBYTE _CNV_P_2_A_I_5_CM_S2 1 0 0 255 ECU_ADDRESS 0xFFF908A8 /end MEASUREMENT
/begin MEASUREMENT SSTERGW_DKKD_BPL.index "" UBYTE _CNV_P_2_A_I_5_CM_S2 1 0 0 255 ECU_ADDRESS 0xFFF908A9 /end MEASUREMENT
/begin MEASUREMENT SSTERGW_DKKD_BPL.ratio "" UWORD _CNV_P_2_A_I_68_CM_S2 1 0 0 65535 ECU_ADDRESS 0xFFF908AA /end MEASUREMENT
/begin MEASUREMENT CONTROL_KFE "" UWORD _CNV_S_4_Enum_EGB_71_CM_S2 1 0 0 3 ECU_ADDRESS 0xFFF9116E /end MEASUREMENT
/begin MEASUREMENT C_FT "" SWORD _CNV_R_R_Umr_1_zu_1_2_CM_S2 1 0 -32768 32767 FORMAT "%2.0" ECU_ADDRESS 0xFFF9115C /end MEASUREMENT
/begin MEASUREMENT C_FT_AGS "" SWORD _CNV_R_R_Umr_1_zu_1_2_CM_S2 1 0 -32768 32767 FORMAT "%2.0" ECU_ADDRESS 0xFFF9115E /end MEASUREMENT
/begin MEASUREMENT C_FT_BEGR "" SWORD _CNV_R_R_Umr_1_zu_1_2_CM_S2 1 0 -32768 32767 FORMAT "%2.0" ECU_ADDRESS 0xFFF91160 /end MEASUREMENT
/begin MEASUREMENT C_FT_CR "" SWORD _CNV_R_R_Umr_1_zu_1_2_CM_S2 1 0 -32768 32767 FORMAT "%2.0" ECU_ADDRESS 0xFFF91162 /end MEASUREMENT
/begin MEASUREMENT C_FT_KON "" SWORD _CNV_R_R_Umr_1_zu_1_2_CM_S2 1 0 -32768 32767 FORMAT "%2.0" ECU_ADDRESS 0xFFF91164 /end MEASUREMENT
/begin MEASUREMENT C_SCHLEPP_AGS "" SWORD _CNV_R_R_Umr_1_zu_1_2_CM_S2 1 0 -32768 32767 FORMAT "%2.0" ECU_ADDRESS 0xFFF91174 /end MEASUREMENT
/begin MEASUREMENT C_SCHLEPP_ALT "" SWORD _CNV_R_R_Umr_1_zu_1_2_CM_S2 1 0 -32768 32767 FORMAT "%2.0" ECU_ADDRESS 0xFFF91176 /end MEASUREMENT
/begin MEASUREMENT C_SCHLEPP_CTSZG "" SWORD _CNV_R_R_Umr_1_zu_1_2_CM_S2 1 0 -32768 32767 FORMAT "%2.0" ECU_ADDRESS 0xFFF91178 /end MEASUREMENT
/begin MEASUREMENT C_SCHLEPP_FT "" SWORD _CNV_R_R_Umr_1_zu_1_2_CM_S2 1 0 -32768 32767 FORMAT "%2.0" ECU_ADDRESS 0xFFF9117A /end MEASUREMENT
/begin MEASUREMENT C_SCHLEPP_GES "" SWORD _CNV_R_R_Umr_1_zu_1_2_CM_S2 1 0 -32768 32767 FORMAT "%2.0" ECU_ADDRESS 0xFFF9117C /end MEASUREMENT
/begin MEASUREMENT C_SCHLEPP_REF "" SWORD _CNV_R_R_Umr_1_zu_1_2_CM_S2 1 0 -32768 32767 FORMAT "%2.0" ECU_ADDRESS 0xFFF9117E /end MEASUREMENT
/begin MEASUREMENT DC_SCHLEPP_BR "" SWORD _CNV_R_R_Umr_1_zu_1_2_CM_S2 1 0 -32768 32767 FORMAT "%2.0" ECU_ADDRESS 0xFFF91150 /end MEASUREMENT
/begin MEASUREMENT DC_SCHLEPP_BRMAX "" SWORD _CNV_R_R_Umr_1_zu_1_2_CM_S2 1 0 -32768 32767 FORMAT "%2.0" ECU_ADDRESS 0xFFF91152 /end MEASUREMENT
/begin MEASUREMENT DC_SCHLEPP_KICKFAST "" SWORD _CNV_R_R_Umr_1_zu_1_2_CM_S2 1 0 -32768 32767 FORMAT "%2.0" ECU_ADDRESS 0xFFF9116A /end MEASUREMENT
/begin MEASUREMENT DC_SCHLEPP_KURVE "" SWORD _CNV_R_R_Umr_1_zu_1_2_CM_S2 1 0 -32768 32767 FORMAT "%2.0" ECU_ADDRESS 0xFFF91172 /end MEASUREMENT
/begin MEASUREMENT FUNKINIT_DONE_FT "" UBYTE _CNV_R_R_Umr_1_zu_1_2_CM_S2 1 0 0 255 FORMAT "%2.0" ECU_ADDRESS 0xFFF9174E /end MEASUREMENT
/begin MEASUREMENT GW_FPFILT_MAXKOR "" SWORD _CNV_R_R_Umr_1_zu_1_7_CM_S2 1 0 -32768 32767 FORMAT "%2.0" ECU_ADDRESS 0xFFF9116C /end MEASUREMENT
/begin MEASUREMENT GW_FP_MAX "" SWORD _CNV_R_R_Umr_1_zu_1_7_CM_S2 1 0 -32768 32767 FORMAT "%2.0" ECU_ADDRESS 0xFFF91170 /end MEASUREMENT
/begin MEASUREMENT M_BR_KOR_BRS "" SWORD _CNV_R_R_Umr_1_zu_1_42_CM_S2 1 0 -32678 0 FORMAT "%2.0" ECU_ADDRESS 0xFFF91154 /end MEASUREMENT
/begin MEASUREMENT M_BR_KOR_BRS_ALT "" SWORD _CNV_R_R_Umr_1_zu_1_42_CM_S2 1 0 -32678 0 FORMAT "%2.0" ECU_ADDRESS 0xFFF91156 /end MEASUREMENT
/begin MEASUREMENT OC_CR "" SWORD _CNV_R_R_Umr_1_zu_1_2_CM_S2 1 0 -32768 32767 FORMAT "%2.0" ECU_ADDRESS 0xFFF91166 /end MEASUREMENT
/begin MEASUREMENT SWSP_DONE_FT "" UWORD _CNV_P_2_A_I_68_CM_S2 1 0 0 65535 ECU_ADDRESS 0xFFF91168 /end MEASUREMENT
/begin MEASUREMENT S_BPL_BEW "" UBYTE _CNV_R_R_Umr_1_zu_1_2_CM_S2 1 0 0 2 FORMAT "%2.0" ECU_ADDRESS 0xFFF91754 /end MEASUREMENT
/begin MEASUREMENT S_FT_BPL_HALTEN "" UBYTE _CNV_R_R_Umr_1_zu_1_2_CM_S2 1 0 0 255 FORMAT "%2.0" ECU_ADDRESS 0xFFF91784 /end MEASUREMENT
/begin MEASUREMENT S_FT_CR "" UBYTE _CNV_P_2_A_I_5_CM_S2 1 0 0 255 ECU_ADDRESS 0xFFF91785 /end MEASUREMENT
/begin MEASUREMENT S_FT_E_ERK "" UBYTE _CNV_P_2_A_I_5_CM_S2 1 0 0 255 ECU_ADDRESS 0xFFF91559 /end MEASUREMENT
/begin MEASUREMENT S_FT_S_ERK "" UBYTE _CNV_P_2_A_I_5_CM_S2 1 0 0 255 ECU_ADDRESS 0xFFF9155A /end MEASUREMENT
/begin MEASUREMENT S_FT_XE_ERK "" UBYTE _CNV_P_2_A_I_5_CM_S2 1 0 0 255 ECU_ADDRESS 0xFFF9155B /end MEASUREMENT
/begin MEASUREMENT S_FT_XS_ERK "" UBYTE _CNV_P_2_A_I_5_CM_S2 1 0 0 255 ECU_ADDRESS 0xFFF9155C /end MEASUREMENT
/begin MEASUREMENT S_KFE_BEW "" UBYTE _CNV_R_R_Umr_1_zu_1_2_CM_S2 1 0 0 2 FORMAT "%2.0" ECU_ADDRESS 0xFFF91755 /end MEASUREMENT
/begin MEASUREMENT S_KICKDOWN_FT "" UBYTE _CNV_R_R_Umr_1_zu_1_2_CM_S2 1 0 0 255 FORMAT "%2.0" ECU_ADDRESS 0xFFF9174F /end MEASUREMENT
/begin MEASUREMENT S_KURVE_BEGR "" UBYTE _CNV_P_2_A_I_5_CM_S2 1 0 0 255 ECU_ADDRESS 0xFFF91756 /end MEASUREMENT
/begin MEASUREMENT S_PRUEFTIMER_AKTIV "" UBYTE _CNV_R_R_Umr_1_zu_1_2_CM_S2 1 0 0 255 FORMAT "%2.0" ECU_ADDRESS 0xFFF9174A /end MEASUREMENT
/begin MEASUREMENT T_AQUER_FT "" ULONG _CNV_R_R_Umr_1_zu_1_6_CM_S2 1 0 0 4294967295 FORMAT "%2.0" ECU_ADDRESS 0xFFF908B4 /end MEASUREMENT
/begin MEASUREMENT T_BPL "" SLONG _CNV_R_R_Umr_1_zu_1_6_CM_S2 1 0 -2147483647 2147483647 FORMAT "%2.0" ECU_ADDRESS 0xFFF908AC /end MEASUREMENT
/begin MEASUREMENT T_BUFFER_AQUER_FT "" ULONG _CNV_R_R_Umr_1_zu_1_6_CM_S2 1 0 0 4294967295 FORMAT "%2.0" ECU_ADDRESS 0xFFF908B8 /end MEASUREMENT
/begin MEASUREMENT T_BUFFER_BPL "" ULONG _CNV_R_R_Umr_1_zu_1_6_CM_S2 1 0 0 4294967295 FORMAT "%2.0" ECU_ADDRESS 0xFFF908B0 /end MEASUREMENT
/begin MEASUREMENT T_BUFFER_KURVE "" ULONG _CNV_R_R_Umr_1_zu_1_6_CM_S2 1 0 0 4294967295 FORMAT "%2.0" ECU_ADDRESS 0xFFF9083C /end MEASUREMENT
/begin MEASUREMENT T_BUFFER_SCHLEPP "" ULONG _CNV_R_R_Umr_1_zu_1_6_CM_S2 1 0 0 4294967295 FORMAT "%2.0" ECU_ADDRESS 0xFFF90844 /end MEASUREMENT
/begin MEASUREMENT T_BUFFER_VERBOTSCHLEPP "" ULONG _CNV_R_R_Umr_1_zu_1_6_CM_S2 1 0 0 4294967295 FORMAT "%2.0" ECU_ADDRESS 0xFFF90848 /end MEASUREMENT
/begin MEASUREMENT T_KURVE_BEW "" SLONG _CNV_R_R_Umr_1_zu_1_6_CM_S2 1 0 -2147483647 2147483647 FORMAT "%2.0" ECU_ADDRESS 0xFFF90840 /end MEASUREMENT
/begin MEASUREMENT T_PRUEF_BRFTUP_BRS "" UWORD _CNV_R_R_Umr_1_zu_1_6_CM_S2 1 0 0 65535 FORMAT "%2.0" ECU_ADDRESS 0xFFF91158 /end MEASUREMENT
/begin MEASUREMENT T_SCHLEPP "" SLONG _CNV_R_R_Umr_1_zu_1_6_CM_S2 1 0 -2147483647 2147483647 FORMAT "%2.0" ECU_ADDRESS 0xFFF9084C /end MEASUREMENT
/begin MEASUREMENT T_VERBOT_SCHLEPP "" SLONG _CNV_R_R_Umr_1_zu_1_6_CM_S2 1 0 -2147483647 2147483647 FORMAT "%2.0" ECU_ADDRESS 0xFFF90850 /end MEASUREMENT
/begin MEASUREMENT V_FZG_BRANF "" UWORD _CNV_R_R_Umr_1_zu_1_8_CM_S2 1 0 0 400 FORMAT "%2.0" ECU_ADDRESS 0xFFF9115A /end MEASUREMENT
/begin MEASUREMENT W_DKKD_BPL "" UWORD _CNV_R_R_Umr_10_zu__9_CM_S2 1 0 0 110 FORMAT "%3.1" ECU_ADDRESS 0xFFF911C2 /end MEASUREMENT
/begin MEASUREMENT Z_C_AQUER_FT "" UBYTE _CNV_R_R_Umr_1_zu_1_2_CM_S2 1 0 0 2 FORMAT "%2.0" ECU_ADDRESS 0xFFF91786 /end MEASUREMENT
/begin MEASUREMENT Z_FT "" UBYTE _CNV_S_4_Enum_EFT_29_CM_S2 1 0 0 3 ECU_ADDRESS 0xFFF9155D /end MEASUREMENT
/begin MEASUREMENT Z_FT_AQUER "" UBYTE _CNV_S_4_Enum_EFT_29_CM_S2 1 0 0 3 ECU_ADDRESS 0xFFF91787 /end MEASUREMENT
/begin MEASUREMENT Z_FT_BPL "" UBYTE _CNV_S_4_Enum_EFT_29_CM_S2 1 0 0 3 ECU_ADDRESS 0xFFF9155E /end MEASUREMENT
/begin MEASUREMENT Z_FT_BR "" UBYTE _CNV_S_4_Enum_EFT_29_CM_S2 1 0 0 3 ECU_ADDRESS 0xFFF9174B /end MEASUREMENT
/begin MEASUREMENT Z_FT_KICKFAST "" UBYTE _CNV_S_4_Enum_EFT_29_CM_S2 1 0 0 3 ECU_ADDRESS 0xFFF9155F /end MEASUREMENT
/begin MEASUREMENT Z_FT_MAX "" UBYTE _CNV_S_4_Enum_EFT_29_CM_S2 1 0 0 3 ECU_ADDRESS 0xFFF91750 /end MEASUREMENT
/begin MEASUREMENT Z_FT_MAXOLD "" UBYTE _CNV_S_4_Enum_EFT_29_CM_S2 1 0 0 3 ECU_ADDRESS 0xFFF91751 /end MEASUREMENT
/begin MEASUREMENT Z_FT_MBR "" UBYTE _CNV_S_5_Enum_EFT2_67_CM_S2 1 0 0 4 ECU_ADDRESS 0xFFF9174C /end MEASUREMENT
/begin MEASUREMENT Z_FT_MBR_ZIEL "" UBYTE _CNV_S_5_Enum_EFT2_67_CM_S2 1 0 0 4 ECU_ADDRESS 0xFFF9174D /end MEASUREMENT
/begin MEASUREMENT Z_PROG_FT "" UBYTE _CNV_S_4_Enum_EPROG_70_CM_S2 1 0 0 3 ECU_ADDRESS 0xFFF91752 /end MEASUREMENT
/begin MEASUREMENT Z_PROG_FT_MAX "" UBYTE _CNV_S_4_Enum_EPROG_70_CM_S2 1 0 0 3 ECU_ADDRESS 0xFFF91753 /end MEASUREMENT
/begin MEASUREMENT Z_SCHLEPP_KURVEBEW "" UBYTE _CNV_S_3_Enum_ESCHL_72_CM_S2 1 0 0 2 ECU_ADDRESS 0xFFF91757 /end MEASUREMENT
/begin MEASUREMENT GM_LDM_SOLL "" SWORD _CNV_R_R_Umr_1_zu_1_77_CM_S2 1 0 -68266 68266 FORMAT "%2.0" ECU_ADDRESS 0xFFF9109A /end MEASUREMENT
/begin MEASUREMENT GM_LDM_SOLL_FILT "" SWORD _CNV_R_R_Umr_1_zu_1_77_CM_S2 1 0 -68266 68266 FORMAT "%2.0" ECU_ADDRESS 0xFFF9109C /end MEASUREMENT
/begin MEASUREMENT GM_LDM_SOLL_FILTREST "" SWORD _CNV_R_R_Umr_1_zu_1_77_CM_S2 1 0 -68266 68266 FORMAT "%2.0" ECU_ADDRESS 0xFFF9109E /end MEASUREMENT
/begin MEASUREMENT I_STRANG "" ULONG _CNV_R_R_Umr_8000_z_78_CM_S2 1 0 0.000125 511 FORMAT "%6.4" ECU_ADDRESS 0xFFF90790 /end MEASUREMENT
/begin MEASUREMENT M_LDM_SOLL "" SWORD _CNV_R_R_Umr_1_zu_1_42_CM_S2 1 0 -32768 32767 FORMAT "%2.0" ECU_ADDRESS 0xFFF910A0 /end MEASUREMENT
/begin MEASUREMENT M_LDM_SOLL_ALT "" SWORD _CNV_R_R_Umr_1_zu_1_42_CM_S2 1 0 -1024 1024 FORMAT "%2.0" ECU_ADDRESS 0xFFF910A2 /end MEASUREMENT
/begin MEASUREMENT QGM_LDM_SOLL "" UBYTE _CNV_R_R_Umr_1_zu_1_2_CM_S2 1 0 0 1 FORMAT "%2.0" ECU_ADDRESS 0xFFF91652 /end MEASUREMENT
/begin MEASUREMENT QM_LDM_STATUS "" UBYTE _CNV_S_3_Enum_EQ_79_CM_S2 1 0 0 2 ECU_ADDRESS 0xFFF91653 /end MEASUREMENT
/begin MEASUREMENT S_LDMBAB_ENBL "" UBYTE _CNV_P_2_A_I_5_CM_S2 1 0 0 255 ECU_ADDRESS 0xFFF91655 /end MEASUREMENT
/begin MEASUREMENT S_LDMBAB_ENBL_ALT "" UBYTE _CNV_R_R_Umr_1_zu_1_2_CM_S2 1 0 0 1 ECU_ADDRESS 0xFFF91656 /end MEASUREMENT
/begin MEASUREMENT S_LDMBAB_ERK "" UBYTE _CNV_P_2_A_I_5_CM_S2 1 0 0 255 ECU_ADDRESS 0xFFF91657 /end MEASUREMENT
/begin MEASUREMENT S_LDM_ERK "" UBYTE _CNV_R_R_Umr_1_zu_1_2_CM_S2 1 0 0 1 ECU_ADDRESS 0xFFF91530 /end MEASUREMENT
/begin MEASUREMENT S_LDM_ERK_ALT "" UBYTE _CNV_P_2_A_I_5_CM_S2 1 0 0 255 ECU_ADDRESS 0xFFF91531 /end MEASUREMENT
/begin MEASUREMENT S_LDM_STELLUNSTETIGKEIT "" UBYTE _CNV_R_R_Umr_1_zu_1_2_CM_S2 1 0 0 1 FORMAT "%2.0" ECU_ADDRESS 0xFFF91658 /end MEASUREMENT
/begin MEASUREMENT S_LDM_STELLUNSTETIGKEIT_ALT "" UBYTE _CNV_R_R_Umr_1_zu_1_2_CM_S2 1 0 0 1 FORMAT "%2.0" ECU_ADDRESS 0xFFF91659 /end MEASUREMENT
/begin MEASUREMENT T_BUFFER_LDMBAB_ENBL "" ULONG _CNV_R_R_Umr_1_zu_1_6_CM_S2 1 0 0 4294967295 FORMAT "%2.0" ECU_ADDRESS 0xFFF90794 /end MEASUREMENT
/begin MEASUREMENT T_BUFFER_NACHLLDM_DYNAMIC2 "" ULONG _CNV_R_R_Umr_1_zu_1_6_CM_S2 1 0 0 2147483647 FORMAT "%2.0" ECU_ADDRESS 0xFFF90798 /end MEASUREMENT
/begin MEASUREMENT T_BUFFER_NL_AUSST_LDM_DYNAMIC2 "" ULONG _CNV_R_R_Umr_1_zu_1_6_CM_S2 1 0 0 4294967295 FORMAT "%2.0" ECU_ADDRESS 0xFFF9079C /end MEASUREMENT
/begin MEASUREMENT T_GM_LDM_SOLLALT "" ULONG _CNV_R_R_Umr_1_zu_1_6_CM_S2 1 0 0 4294967295 FORMAT "%2.0" ECU_ADDRESS 0xFFF907A0 /end MEASUREMENT
/begin MEASUREMENT T_LDMBAB_ENBL "" UWORD _CNV_R_R_Umr_1_zu_1_6_CM_S2 1 0 0 65535 FORMAT "%2.0" ECU_ADDRESS 0xFFF910A4 /end MEASUREMENT
/begin MEASUREMENT T_NACHL_AUSSTIEG_LDM_DYNAMIC2 "" ULONG _CNV_R_R_Umr_1_zu_1_6_CM_S2 1 0 0 10000 FORMAT "%2.0" ECU_ADDRESS 0xFFF9078C /end MEASUREMENT
/begin MEASUREMENT T_NACHL_LDM_DYNAMIC2 "" ULONG _CNV_R_R_Umr_1_zu_1_6_CM_S2 1 0 0 2147483647 FORMAT "%2.0" ECU_ADDRESS 0xFFF907A4 /end MEASUREMENT
/begin MEASUREMENT Z_LDMMOD "" UBYTE _CNV_S_7_Enum_ELDMM_80_CM_S2 1 0 0 15 ECU_ADDRESS 0xFFF9165D /end MEASUREMENT
/begin MEASUREMENT Z_LDMMOD_ALT "" UBYTE _CNV_S_7_Enum_ELDMM_80_CM_S2 1 0 0 15 ECU_ADDRESS 0xFFF9165E /end MEASUREMENT
/begin MEASUREMENT Z_LDM_DYNAMIC "" UBYTE _CNV_R_R_Umr_1_zu_1_2_CM_S2 1 0 0 15 FORMAT "%2.0" ECU_ADDRESS 0xFFF9165F /end MEASUREMENT
/begin MEASUREMENT Z_LDM_DYNAMIC2 "" UBYTE _CNV_S_3_Enum_ELDM__81_CM_S2 1 0 0 2 ECU_ADDRESS 0xFFF91660 /end MEASUREMENT
/begin MEASUREMENT Z_LDM_DYNAMIC2_ALT "" UBYTE _CNV_S_3_Enum_ELDM__81_CM_S2 1 0 0 2 ECU_ADDRESS 0xFFF91661 /end MEASUREMENT
/begin MEASUREMENT Z_WDK_UEBERTRETEN "" UBYTE _CNV_P_2_A_I_5_CM_S2 1 0 0 255 ECU_ADDRESS 0xFFF91651 /end MEASUREMENT
/begin MEASUREMENT C_RESYNCANF_FENSTER_ADAS "" UBYTE _CNV_R_R_Umr_1_zu_1_2_CM_S2 1 0 0 255 FORMAT "%2.0" ECU_ADDRESS 0xFFF912C4 /end MEASUREMENT
/begin MEASUREMENT DN_K0_SOLL_SS "" UWORD _CNV_R_R_Umr_1_zu_1_3_CM_S2 1 0 0 10000 FORMAT "%2.0" ECU_ADDRESS 0xFFF90AFC /end MEASUREMENT
/begin MEASUREMENT FAKT_GK0_FDYN_SS "" UBYTE _CNV_R_R_Umr_1_zu_1_53_CM_S2 1 0 0 100 FORMAT "%2.0" ECU_ADDRESS 0xFFF912E2 /end MEASUREMENT
/begin MEASUREMENT M_COMPRISE_SS "" UWORD _CNV_R_R_Umr_1_zu_1_2_CM_S2 1 0 0 65535 ECU_ADDRESS 0xFFF90AFE /end MEASUREMENT
/begin MEASUREMENT N_DYNDZM_SS "" UWORD _CNV_R_R_Umr_1_zu_1_3_CM_S2 1 0 0 10000 FORMAT "%2.0" ECU_ADDRESS 0xFFF90B00 /end MEASUREMENT
/begin MEASUREMENT S_ADAS_ANFRESYNC_SS "" UBYTE _CNV_R_R_Umr_1_zu_1_2_CM_S2 1 0 0 255 FORMAT "%2.0" ECU_ADDRESS 0xFFF912C8 /end MEASUREMENT
/begin MEASUREMENT S_DYNDZM_SS "" UBYTE _CNV_P_2_A_I_5_CM_S2 1 0 0 255 ECU_ADDRESS 0xFFF912CE /end MEASUREMENT
/begin MEASUREMENT S_ERR_RESYNCANF_FENSTER_ADAS "" UBYTE _CNV_R_R_Umr_1_zu_1_2_CM_S2 1 0 0 1 FORMAT "%2.0" ECU_ADDRESS 0xFFF912C5 /end MEASUREMENT
/begin MEASUREMENT S_GK0_FAHRDYNAMIK_SS "" UBYTE _CNV_R_R_Umr_1_zu_1_2_CM_S2 1 0 0 255 FORMAT "%2.0" ECU_ADDRESS 0xFFF912CF /end MEASUREMENT
/begin MEASUREMENT S_MSA_VERBOT_SS "" UBYTE _CNV_S_2_Schalter_A_4_CM_S2 1 0 0 1 ECU_ADDRESS 0xFFF912D1 /end MEASUREMENT
/begin MEASUREMENT S_STAT_SPORT_SS "" UBYTE _CNV_P_2_A_I_5_CM_S2 1 0 0 255 ECU_ADDRESS 0xFFF912D2 /end MEASUREMENT
/begin MEASUREMENT S_STAT_ZHS_SS "" UBYTE _CNV_P_2_A_I_5_CM_S2 1 0 0 255 ECU_ADDRESS 0xFFF912D3 /end MEASUREMENT
/begin MEASUREMENT T_BUFFER_RSU_DSCERR "" ULONG _CNV_R_R_Umr_1_zu_1_6_CM_S2 1 0 0 2147483647 FORMAT "%2.0" ECU_ADDRESS 0xFFF9017C /end MEASUREMENT
/begin MEASUREMENT T_RESYNCANF_FENSTER_ADAS "" UWORD _CNV_R_R_Umr_1_zu_1_6_CM_S2 1 0 0 65535 FORMAT "%2.0" ECU_ADDRESS 0xFFF90B02 /end MEASUREMENT
/begin MEASUREMENT T_RSU_DSCERR "" SLONG _CNV_R_R_Umr_1_zu_1_6_CM_S2 1 0 -2147483647 2147483647 FORMAT "%2.0" ECU_ADDRESS 0xFFF90180 /end MEASUREMENT
/begin MEASUREMENT Z_ADAS_RESYNCSTCOUNT_FREEZED "" UBYTE _CNV_R_R_Umr_1_zu_1_2_CM_S2 1 0 0 255 FORMAT "%2.0" ECU_ADDRESS 0xFFF912C6 /end MEASUREMENT
/begin MEASUREMENT Z_ADAS_RESYNCSTCOUNT_SS "" UBYTE _CNV_R_R_Umr_1_zu_1_2_CM_S2 1 0 0 255 FORMAT "%2.0" ECU_ADDRESS 0xFFF912C9 /end MEASUREMENT
/begin MEASUREMENT Z_ADAS_RESYNCSTERR_FREEZED "" UBYTE _CNV_R_R_Umr_1_zu_1_2_CM_S2 1 0 0 255 FORMAT "%2.0" ECU_ADDRESS 0xFFF912C7 /end MEASUREMENT
/begin MEASUREMENT Z_ADAS_RESYNCSTERR_SS "" UBYTE _CNV_R_R_Umr_1_zu_1_2_CM_S2 1 0 0 255 FORMAT "%2.0" ECU_ADDRESS 0xFFF912CA /end MEASUREMENT
/begin MEASUREMENT Z_ANZAHL_QS3_SS "" UBYTE _CNV_P_2_A_I_5_CM_S2 1 0 0 255 ECU_ADDRESS 0xFFF912D4 /end MEASUREMENT
/begin MEASUREMENT Z_DYNAMIK_SS "" UBYTE _CNV_P_2_A_I_5_CM_S2 1 0 0 255 ECU_ADDRESS 0xFFF912D5 /end MEASUREMENT
/begin MEASUREMENT Z_GANGWHL_AZG_SS "" UBYTE _CNV_S_14_Enum_EGANG_88_CM_S2 1 0 0 13 ECU_ADDRESS 0xFFF912D7 /end MEASUREMENT
/begin MEASUREMENT Z_GANG_SOLL_SS "" UBYTE _CNV_S_11_Enum_EGANG_89_CM_S2 1 0 1 13 ECU_ADDRESS 0xFFF912D8 /end MEASUREMENT
/begin MEASUREMENT Z_GANG_SPA_SS "" UBYTE _CNV_S_10_Enum_EGANG_90_CM_S2 1 0 0 9 ECU_ADDRESS 0xFFF912D9 /end MEASUREMENT
/begin MEASUREMENT Z_IDXGRBDYN_SS "" UBYTE _CNV_R_R_Umr_1_zu_1_2_CM_S2 1 0 0 14 FORMAT "%2.0" ECU_ADDRESS 0xFFF912DA /end MEASUREMENT
/begin MEASUREMENT Z_K0_SOLL_SS "" UBYTE _CNV_S_12_Enum_EK0_S_91_CM_S2 1 0 0 11 ECU_ADDRESS 0xFFF912D0 /end MEASUREMENT
/begin MEASUREMENT Z_MASK_AGS_COS "" ULONG _CNV_R_R_Umr_1_zu_1_2_CM_S2 1 0 0 4294967295 ECU_ADDRESS 0xFFF90184 /end MEASUREMENT
/begin MEASUREMENT Z_M_COMPRISE_SS "" UBYTE _CNV_S_3_Enum_ECOMP_92_CM_S2 1 0 0 2 ECU_ADDRESS 0xFFF912DC /end MEASUREMENT
/begin MEASUREMENT Z_PROGINF_AZG_SS "" UBYTE _CNV_S_4_Enum_EKOMB_93_CM_S2 1 0 0 3 ECU_ADDRESS 0xFFF912DF /end MEASUREMENT
/begin MEASUREMENT Z_PROG_DS2_SS "" UBYTE _CNV_S_16_Enum_EPROG_94_CM_S2 1 0 0 15 ECU_ADDRESS 0xFFF912E0 /end MEASUREMENT
/begin MEASUREMENT Z_ZKA_IDX_SS "" UBYTE _CNV_R_R_Umr_1_zu_1_2_CM_S2 1 0 0 255 ECU_ADDRESS 0xFFF912DD /end MEASUREMENT
/begin MEASUREMENT S_FAS_ERK "" UBYTE _CNV_P_2_A_I_5_CM_S2 1 0 0 255 ECU_ADDRESS 0xFFF9151C /end MEASUREMENT
/begin MEASUREMENT S_HSURE_FFG "" UBYTE _CNV_R_R_Umr_1_zu_1_2_CM_S2 1 0 0 255 ECU_ADDRESS 0xFFF91599 /end MEASUREMENT
/begin MEASUREMENT S_STEIG_TRPMOD "" UBYTE _CNV_R_R_Umr_1_zu_1_2_CM_S2 1 0 0 1 ECU_ADDRESS 0xFFF915AE /end MEASUREMENT
/begin MEASUREMENT T_RS_COS "" SWORD _CNV_R_R_Umr_1_zu_1_6_CM_S2 1 0 0 32000 FORMAT "%2.0" ECU_ADDRESS 0xFFF90E18 /end MEASUREMENT
/begin MEASUREMENT V_FZG_HSGANG_TRPMOD "" UWORD _CNV_R_R_Umr_1_zu_1_8_CM_S2 1 0 0 400 FORMAT "%2.0" ECU_ADDRESS 0xFFF90E56 /end MEASUREMENT
/begin MEASUREMENT V_FZG_RSGANG_TRPMOD "" UWORD _CNV_R_R_Umr_1_zu_1_8_CM_S2 1 0 0 400 FORMAT "%2.0" ECU_ADDRESS 0xFFF90E58 /end MEASUREMENT
/begin MEASUREMENT Z_GANG_ADD "" UBYTE _CNV_S_9_Enum_EGANG_30_CM_S2 1 0 0 8 ECU_ADDRESS 0xFFF9127A /end MEASUREMENT
/begin MEASUREMENT Z_GANG_ASSISTENT "" UBYTE _CNV_S_9_Enum_EGANG_30_CM_S2 1 0 0 8 ECU_ADDRESS 0xFFF91288 /end MEASUREMENT
/begin MEASUREMENT Z_GANG_AUTOMAT "" UBYTE _CNV_S_9_Enum_EGANG_30_CM_S2 1 0 0 8 ECU_ADDRESS 0xFFF91287 /end MEASUREMENT
/begin MEASUREMENT Z_GANG_EXC "" UBYTE _CNV_S_9_Enum_EGANG_30_CM_S2 1 0 0 8 ECU_ADDRESS 0xFFF9127B /end MEASUREMENT
/begin MEASUREMENT Z_GANG_EXC_ALT "" UBYTE _CNV_S_9_Enum_EGANG_30_CM_S2 1 0 0 8 ECU_ADDRESS 0xFFF9127C /end MEASUREMENT
/begin MEASUREMENT Z_GANG_HSURE "" UBYTE _CNV_S_9_Enum_EGANG_30_CM_S2 1 0 0 8 ECU_ADDRESS 0xFFF9159C /end MEASUREMENT
/begin MEASUREMENT Z_GANG_KOOP "" UBYTE _CNV_S_9_Enum_EGANG_30_CM_S2 1 0 0 8 ECU_ADDRESS 0xFFF9127D /end MEASUREMENT
/begin MEASUREMENT Z_GANG_KOOP_DBM "" UBYTE _CNV_S_9_Enum_EGANG_30_CM_S2 1 0 0 8 ECU_ADDRESS 0xFFF9127E /end MEASUREMENT
/begin MEASUREMENT Z_GANG_KOOP_SPA "" UBYTE _CNV_S_9_Enum_EGANG_30_CM_S2 1 0 0 8 ECU_ADDRESS 0xFFF9127F /end MEASUREMENT
/begin MEASUREMENT Z_GANG_PMA "" UBYTE _CNV_S_9_Enum_EGANG_30_CM_S2 1 0 0 8 ECU_ADDRESS 0xFFF91280 /end MEASUREMENT
/begin MEASUREMENT Z_GANG_SKL "" UBYTE _CNV_S_9_Enum_EGANG_30_CM_S2 1 0 0 8 ECU_ADDRESS 0xFFF91320 /end MEASUREMENT
/begin MEASUREMENT Z_GANG_SOLL "" UBYTE _CNV_S_9_Enum_EGANG_30_CM_S2 1 0 0 8 ECU_ADDRESS 0xFFF91321 /end MEASUREMENT
/begin MEASUREMENT Z_GANG_SOLLAGS "" UBYTE _CNV_S_9_Enum_EGANG_30_CM_S2 1 0 0 8 ECU_ADDRESS 0xFFF91281 /end MEASUREMENT
/begin MEASUREMENT Z_GANG_SOLLSTB "" UBYTE _CNV_S_9_Enum_EGANG_30_CM_S2 1 0 0 8 ECU_ADDRESS 0xFFF91282 /end MEASUREMENT
/begin MEASUREMENT Z_GANG_SOLL_TRPMOD "" UBYTE _CNV_S_9_Enum_EGANG_30_CM_S2 1 0 0 8 ECU_ADDRESS 0xFFF91283 /end MEASUREMENT
/begin MEASUREMENT Z_GANG_TEMP_KUP_A "" UBYTE _CNV_S_9_Enum_EGANG_30_CM_S2 1 0 0 8 ECU_ADDRESS 0xFFF91284 /end MEASUREMENT
/begin MEASUREMENT Z_GANG_TGG_SOLLSTB "" UBYTE _CNV_S_9_Enum_EGANG_30_CM_S2 1 0 0 8 ECU_ADDRESS 0xFFF91285 /end MEASUREMENT
/begin MEASUREMENT Z_GANG_ZKA "" UBYTE _CNV_S_9_Enum_EGANG_30_CM_S2 1 0 0 8 ECU_ADDRESS 0xFFF91322 /end MEASUREMENT
/begin MEASUREMENT Z_HSURE_AKTIV_COS "" UBYTE _CNV_R_R_Umr_1_zu_1_2_CM_S2 1 0 0 1 FORMAT "%2.0" ECU_ADDRESS 0xFFF9159D /end MEASUREMENT
/begin MEASUREMENT Z_KOOPVAR_MASK "" ULONG _CNV_R_R_Umr_1_zu_1_2_CM_S2 1 0 0 4294967295 FORMAT "%2.0" ECU_ADDRESS 0xFFF904C4 /end MEASUREMENT
/begin MEASUREMENT Z_KOOP_MASK "" ULONG _CNV_R_R_Umr_1_zu_1_2_CM_S2 1 0 0 4294967295 FORMAT "%2.0" ECU_ADDRESS 0xFFF904C8 /end MEASUREMENT
/begin MEASUREMENT Z_MFRSKS_KUP_A_ERK "" UBYTE _CNV_R_R_Umr_1_zu_1_2_CM_S2 1 0 0 2 FORMAT "%2.0" ECU_ADDRESS 0xFFF91286 /end MEASUREMENT
/begin MEASUREMENT Z_RS_COS "" UBYTE _CNV_R_R_Umr_1_zu_1_2_CM_S2 1 0 0 1 FORMAT "%2.0" ECU_ADDRESS 0xFFF9159A /end MEASUREMENT
/begin MEASUREMENT FUNKINIT_DONE_DKFILT "" UBYTE _CNV_R_R_Umr_1_zu_1_2_CM_S2 1 0 0 255 FORMAT "%2.0" ECU_ADDRESS 0xFFF91560 /end MEASUREMENT
/begin MEASUREMENT FUNKINIT_DONE_FFG "" UBYTE _CNV_R_R_Umr_1_zu_1_2_CM_S2 1 0 0 255 FORMAT "%2.0" ECU_ADDRESS 0xFFF91221 /end MEASUREMENT
/begin MEASUREMENT F_DK_INGEW "" UWORD _CNV_R_R_Umr_1_zu_1_2_CM_S2 1 0 0 1000 FORMAT "%2.0" ECU_ADDRESS 0xFFF90DBC /end MEASUREMENT
/begin MEASUREMENT F_DK_OUTGEW "" UWORD _CNV_R_R_Umr_1_zu_1_2_CM_S2 1 0 0 1000 FORMAT "%2.0" ECU_ADDRESS 0xFFF90DBE /end MEASUREMENT
/begin MEASUREMENT PRISQ_PRIO "" UWORD _CNV_R_R_Umr_1_zu_1_2_CM_S2 1 0 0 65535 FORMAT "%2.0" ARRAY_SIZE 100 ECU_ADDRESS 0xFFF90364 MATRIX_DIM 100 1 1 /end MEASUREMENT
/begin MEASUREMENT S_ADD_FKTENBL "" UBYTE _CNV_P_2_A_I_5_CM_S2 1 0 0 255 ARRAY_SIZE 9 ECU_ADDRESS 0xFFF91222 MATRIX_DIM 9 1 1 /end MEASUREMENT
/begin MEASUREMENT S_BAB_PRIOALT "" UBYTE _CNV_R_R_Umr_1_zu_1_2_CM_S2 1 0 0 2 FORMAT "%2.0" ECU_ADDRESS 0xFFF9122B /end MEASUREMENT
/begin MEASUREMENT S_DERS_PRIOALT "" UBYTE _CNV_R_R_Umr_1_zu_1_2_CM_S2 1 0 0 1 FORMAT "%2.0" ECU_ADDRESS 0xFFF9122C /end MEASUREMENT
/begin MEASUREMENT S_DMRS_PRIOALT "" UBYTE _CNV_R_R_Umr_1_zu_1_2_CM_S2 1 0 0 255 FORMAT "%2.0" ECU_ADDRESS 0xFFF9122D /end MEASUREMENT
/begin MEASUREMENT S_DSPORT "" UBYTE _CNV_R_R_Umr_1_zu_1_2_CM_S2 1 0 0 1 FORMAT "%2.0" ECU_ADDRESS 0xFFF9122E /end MEASUREMENT
/begin MEASUREMENT S_EXCFKT_FFG "" UBYTE _CNV_P_2_A_I_5_CM_S2 1 0 0 255 ARRAY_SIZE 32 ECU_ADDRESS 0xFFF900DC MATRIX_DIM 32 1 1 /end MEASUREMENT
/begin MEASUREMENT S_EXCFKT_FFG_SDYN "" UBYTE _CNV_R_R_Umr_1_zu_1_2_CM_S2 1 0 0 1 FORMAT "%2.0" ARRAY_SIZE 32 ECU_ADDRESS 0xFFF900FC MATRIX_DIM 32 1 1 /end MEASUREMENT
/begin MEASUREMENT S_FGR_FFG "" UBYTE _CNV_R_R_Umr_1_zu_1_2_CM_S2 1 0 0 255 FORMAT "%2.0" ECU_ADDRESS 0xFFF9122F /end MEASUREMENT
/begin MEASUREMENT S_FLANKE_DOWN "" UBYTE _CNV_P_2_A_I_5_CM_S2 1 0 0 255 ECU_ADDRESS 0xFFF91561 /end MEASUREMENT
/begin MEASUREMENT S_HSUREFKT_FFG "" UBYTE _CNV_P_2_A_I_5_CM_S2 1 0 0 1 ARRAY_SIZE 15 ECU_ADDRESS 0xFFF91230 MATRIX_DIM 15 1 1 /end MEASUREMENT
/begin MEASUREMENT S_HSUREFKT_FFG_SPA "" UBYTE _CNV_P_2_A_I_5_CM_S2 1 0 0 5 ARRAY_SIZE 15 ECU_ADDRESS 0xFFF9123F MATRIX_DIM 15 1 1 /end MEASUREMENT
/begin MEASUREMENT S_KOOPFKT_FFG "" UBYTE _CNV_P_2_A_I_5_CM_S2 1 0 0 10 ARRAY_SIZE 15 ECU_ADDRESS 0xFFF9124E MATRIX_DIM 15 1 1 /end MEASUREMENT
/begin MEASUREMENT S_LMODE_PRIOALT "" UBYTE _CNV_R_R_Umr_1_zu_1_2_CM_S2 1 0 0 1 FORMAT "%2.0" ECU_ADDRESS 0xFFF9125D /end MEASUREMENT
/begin MEASUREMENT S_MAB_PRIOALT "" UBYTE _CNV_R_R_Umr_1_zu_1_2_CM_S2 1 0 0 1 FORMAT "%2.0" ECU_ADDRESS 0xFFF9125E /end MEASUREMENT
/begin MEASUREMENT S_RSUMUELOW_PRIOALT "" UBYTE _CNV_P_2_A_I_5_CM_S2 1 0 0 255 ECU_ADDRESS 0xFFF9125F /end MEASUREMENT
/begin MEASUREMENT S_TID_FFG "" UBYTE _CNV_P_2_A_I_5_CM_S2 1 0 0 255 ECU_ADDRESS 0xFFF91260 /end MEASUREMENT
/begin MEASUREMENT S_TID_FFG_ALT "" UBYTE _CNV_P_2_A_I_5_CM_S2 1 0 0 255 ECU_ADDRESS 0xFFF91261 /end MEASUREMENT
/begin MEASUREMENT S_ZHS_VERBOT_PRISQ "" UBYTE _CNV_P_2_A_I_5_CM_S2 1 0 0 255 ECU_ADDRESS 0xFFF91262 /end MEASUREMENT
/begin MEASUREMENT W_DKKD_DYNKOR "" UWORD _CNV_R_R_Umr_10_zu__9_CM_S2 1 0 0 110 FORMAT "%3.1" ECU_ADDRESS 0xFFF9092E /end MEASUREMENT
/begin MEASUREMENT W_DKKD_FFG "" UWORD _CNV_R_R_Umr_10_zu__9_CM_S2 1 0 0 110 FORMAT "%3.1" ECU_ADDRESS 0xFFF90930 /end MEASUREMENT
/begin MEASUREMENT W_DKKD_FILT "" UWORD _CNV_R_R_Umr_10_zu__9_CM_S2 1 0 0 110 FORMAT "%3.1" ECU_ADDRESS 0xFFF90DC0 /end MEASUREMENT
/begin MEASUREMENT W_DKKD_FILTALT "" UWORD _CNV_R_R_Umr_10_zu__9_CM_S2 1 0 0 110 FORMAT "%3.1" ECU_ADDRESS 0xFFF90DC2 /end MEASUREMENT
/begin MEASUREMENT W_DKKD_FILTBUF "" UWORD _CNV_R_R_Umr_10_zu__9_CM_S2 1 0 0 110 FORMAT "%3.1" ARRAY_SIZE 5 ECU_ADDRESS 0xFFF90DC4 MATRIX_DIM 5 1 1 /end MEASUREMENT
/begin MEASUREMENT W_DKKD_ODYNKOR "" UWORD _CNV_R_R_Umr_10_zu__9_CM_S2 1 0 0 110 FORMAT "%3.1" ECU_ADDRESS 0xFFF90DCE /end MEASUREMENT
/begin MEASUREMENT W_DKKD_OPLUFT "" SWORD _CNV_R_R_Umr_10_zu__9_CM_S2 1 0 -110 110 FORMAT "%3.1" ECU_ADDRESS 0xFFF90DD0 /end MEASUREMENT
/begin MEASUREMENT W_DKKD_PLUFT "" UWORD _CNV_R_R_Umr_10_zu__9_CM_S2 1 0 0 110 FORMAT "%3.1" ECU_ADDRESS 0xFFF90932 /end MEASUREMENT
/begin MEASUREMENT W_DKKD_PS "" UWORD _CNV_R_R_Umr_10_zu__9_CM_S2 1 0 0 110 FORMAT "%3.1" ECU_ADDRESS 0xFFF90934 /end MEASUREMENT
/begin MEASUREMENT W_DKKD_SKL "" UWORD _CNV_R_R_Umr_10_zu__9_CM_S2 1 0 0 110 FORMAT "%3.1" ECU_ADDRESS 0xFFF90936 /end MEASUREMENT
/begin MEASUREMENT Z_DK_FFG "" UBYTE _CNV_S_4_Enum_EDKFI_105_CM_S2 1 0 0 3 ECU_ADDRESS 0xFFF91263 /end MEASUREMENT
/begin MEASUREMENT Z_DK_FILT "" UBYTE _CNV_S_4_Enum_EDKFI_106_CM_S2 1 0 0 3 ECU_ADDRESS 0xFFF91264 /end MEASUREMENT
/begin MEASUREMENT Z_DRIVE_PROG_FFG "" UBYTE _CNV_S_5_Enum_ZDRIV_27_CM_S2 1 0 0 4 ECU_ADDRESS 0xFFF91266 /end MEASUREMENT
/begin MEASUREMENT Z_DRIVE_PROG_FFG_ALT "" UBYTE _CNV_S_5_Enum_ZDRIV_27_CM_S2 1 0 0 4 ECU_ADDRESS 0xFFF91267 /end MEASUREMENT
/begin MEASUREMENT Z_EXCFKT_FFG "" UBYTE _CNV_S_4_Enum_EEXCF_101_CM_S2 1 0 0 3 ECU_ADDRESS 0xFFF91268 /end MEASUREMENT
/begin MEASUREMENT Z_EXCFKT_FFGALT "" UBYTE _CNV_S_4_Enum_EEXCF_101_CM_S2 1 0 0 3 ECU_ADDRESS 0xFFF91269 /end MEASUREMENT
/begin MEASUREMENT Z_FKTERW_FFG "" UBYTE _CNV_S_9_Enum_EFKTE_107_CM_S2 1 0 0 8 ECU_ADDRESS 0xFFF9126A /end MEASUREMENT
/begin MEASUREMENT Z_FKTERW_FFGALT "" UBYTE _CNV_S_9_Enum_EFKTE_107_CM_S2 1 0 0 8 ECU_ADDRESS 0xFFF9126B /end MEASUREMENT
/begin MEASUREMENT Z_FKT_EXC_ERK "" ULONG _CNV_R_R_Umr_1_zu_1_2_CM_S2 1 0 0 4294967295 FORMAT "%2.0" ECU_ADDRESS 0xFFF9042C /end MEASUREMENT
/begin MEASUREMENT Z_LDM_FFG "" UBYTE _CNV_S_3_Enum_ELDM_76_CM_S2 1 0 0 2 ECU_ADDRESS 0xFFF9126C /end MEASUREMENT
/begin MEASUREMENT Z_LDM_FFG_ALT "" UBYTE _CNV_S_3_Enum_ELDM_76_CM_S2 1 0 0 2 ECU_ADDRESS 0xFFF9126D /end MEASUREMENT
/begin MEASUREMENT Z_NABHSURERS_FFG "" UBYTE _CNV_S_6_Enum_ENABH_108_CM_S2 1 0 0 5 ECU_ADDRESS 0xFFF9126E /end MEASUREMENT
/begin MEASUREMENT Z_NMOTHSTUPEL_FFG "" UBYTE _CNV_S_5_Enum_ETUPE_32_CM_S2 1 0 0 4 ECU_ADDRESS 0xFFF9126F /end MEASUREMENT
/begin MEASUREMENT Z_POS_BDLENB "" UBYTE _CNV_S_4_Enum_EPOSB_109_CM_S2 1 0 0 3 ECU_ADDRESS 0xFFF91270 /end MEASUREMENT
/begin MEASUREMENT Z_PRISQ_IDX "" UBYTE _CNV_S_100_Enum_EPRIS_34_CM_S2 1 0 0 99 ARRAY_SIZE 100 ECU_ADDRESS 0xFFF90430 MATRIX_DIM 100 1 1 /end MEASUREMENT
/begin MEASUREMENT Z_PRISQ_MOTZKA "" UBYTE _CNV_R_R_Umr_1_zu_1_2_CM_S2 1 0 0 14 FORMAT "%2.0" ECU_ADDRESS 0xFFF91271 /end MEASUREMENT
/begin MEASUREMENT Z_PRISQ_PRIOIDX "" UBYTE _CNV_S_100_Enum_EPRIS_34_CM_S2 1 0 0 99 ECU_ADDRESS 0xFFF91272 /end MEASUREMENT
/begin MEASUREMENT Z_PROG_DS2 "" UBYTE _CNV_S_16_Enum_EPROG_94_CM_S2 1 0 0 15 ECU_ADDRESS 0xFFF91273 /end MEASUREMENT
/begin MEASUREMENT Z_PROG_FFG "" UBYTE _CNV_S_21_Enum_EPROG_40_CM_S2 1 0 0 20 ECU_ADDRESS 0xFFF91274 /end MEASUREMENT
/begin MEASUREMENT Z_PROG_FFGALT "" UBYTE _CNV_S_21_Enum_EPROG_40_CM_S2 1 0 0 20 ECU_ADDRESS 0xFFF91275 /end MEASUREMENT
/begin MEASUREMENT Z_ZKAIDX_MAX_DBM "" UBYTE _CNV_R_R_Umr_1_zu_1_2_CM_S2 1 0 0 9 FORMAT "%2.0" ECU_ADDRESS 0xFFF91276 /end MEASUREMENT
/begin MEASUREMENT Z_ZKAIDX_MIN_DBM "" UBYTE _CNV_R_R_Umr_1_zu_1_2_CM_S2 1 0 0 9 FORMAT "%2.0" ECU_ADDRESS 0xFFF91277 /end MEASUREMENT
/begin MEASUREMENT Z_ZKAIDX_SCHUB_ZKA "" UBYTE _CNV_R_R_Umr_1_zu_1_2_CM_S2 1 0 0 9 FORMAT "%2.0" ECU_ADDRESS 0xFFF91278 /end MEASUREMENT
/begin MEASUREMENT Z_ZKAIDX_ZUG_ZKA "" UBYTE _CNV_R_R_Umr_1_zu_1_2_CM_S2 1 0 0 9 FORMAT "%2.0" ECU_ADDRESS 0xFFF91279 /end MEASUREMENT
/begin MEASUREMENT SSTERG_SKL.anz "" UBYTE _CNV_P_2_A_I_5_CM_S2 1 0 0 255 ECU_ADDRESS 0xFFF904E0 /end MEASUREMENT
/begin MEASUREMENT SSTERG_SKL.index "" UBYTE _CNV_P_2_A_I_5_CM_S2 1 0 0 255 ECU_ADDRESS 0xFFF904E1 /end MEASUREMENT
/begin MEASUREMENT SSTERG_SKL.ratio "" UWORD _CNV_P_2_A_I_68_CM_S2 1 0 0 65535 ECU_ADDRESS 0xFFF904E2 /end MEASUREMENT
/begin MEASUREMENT SSTERG_SKL_KICKDOWN.anz "" UBYTE _CNV_P_2_A_I_5_CM_S2 1 0 0 255 ECU_ADDRESS 0xFFF904E4 /end MEASUREMENT
/begin MEASUREMENT SSTERG_SKL_KICKDOWN.index "" UBYTE _CNV_P_2_A_I_5_CM_S2 1 0 0 255 ECU_ADDRESS 0xFFF904E5 /end MEASUREMENT
/begin MEASUREMENT SSTERG_SKL_KICKDOWN.ratio "" UWORD _CNV_P_2_A_I_68_CM_S2 1 0 0 65535 ECU_ADDRESS 0xFFF904E6 /end MEASUREMENT
/begin MEASUREMENT C_MAX_KL_HS "" UBYTE _CNV_P_2_A_I_5_CM_S2 1 0 0 255 ECU_ADDRESS 0xFFF915A8 /end MEASUREMENT
/begin MEASUREMENT C_MAX_KL_RS "" UWORD _CNV_P_2_A_I_68_CM_S2 1 0 0 65535 ECU_ADDRESS 0xFFF90E28 /end MEASUREMENT
/begin MEASUREMENT N_AB_DELTANMOTHS "" UWORD _CNV_R_R_Umr_1_zu_1_3_CM_S2 1 0 0 20000 FORMAT "%2.0" ECU_ADDRESS 0xFFF90E2A /end MEASUREMENT
/begin MEASUREMENT N_AB_SHIFTNMOTHS "" UWORD _CNV_R_R_Umr_1_zu_1_3_CM_S2 1 0 0 20000 FORMAT "%2.0" ECU_ADDRESS 0xFFF90E2C /end MEASUREMENT
/begin MEASUREMENT N_AB_VIRT "" UWORD _CNV_R_R_Umr_1_zu_1_3_CM_S2 1 0 0 20000 FORMAT "%2.0" ECU_ADDRESS 0xFFF90E2E /end MEASUREMENT
/begin MEASUREMENT ON_AB_HSFWS "" UWORD _CNV_R_R_Umr_1_zu_1_3_CM_S2 1 0 0 20000 FORMAT "%2.0" ECU_ADDRESS 0xFFF90E30 /end MEASUREMENT
/begin MEASUREMENT ON_AB_HSWK "" UWORD _CNV_R_R_Umr_1_zu_1_3_CM_S2 1 0 0 1023 FORMAT "%2.0" ECU_ADDRESS 0xFFF90E32 /end MEASUREMENT
/begin MEASUREMENT ON_AB_MAXWLSPV "" UWORD _CNV_R_R_Umr_1_zu_1_3_CM_S2 1 0 0 20000 FORMAT "%2.0" ECU_ADDRESS 0xFFF90E34 /end MEASUREMENT
/begin MEASUREMENT SCHN_AB_HS "" UWORD _CNV_R_R_Umr_1_zu_1_3_CM_S2 1 0 0 20000 FORMAT "%2.0" ECU_ADDRESS 0xFFF90E36 /end MEASUREMENT
/begin MEASUREMENT SCHN_AB_HSSKL "" UWORD _CNV_R_R_Umr_1_zu_1_3_CM_S2 1 0 0 20000 FORMAT "%2.0" ECU_ADDRESS 0xFFF90E38 /end MEASUREMENT
/begin MEASUREMENT SCHN_AB_HSVOLLAST "" UWORD _CNV_R_R_Umr_1_zu_1_3_CM_S2 1 0 0 20000 FORMAT "%2.0" ECU_ADDRESS 0xFFF90E3A /end MEASUREMENT
/begin MEASUREMENT SCHN_AB_KD "" UWORD _CNV_R_R_Umr_1_zu_1_3_CM_S2 1 0 0 20000 FORMAT "%2.0" ARRAY_SIZE 9 ECU_ADDRESS 0xFFF90E3C MATRIX_DIM 9 1 1 /end MEASUREMENT
/begin MEASUREMENT SCHN_AB_RSFOLLOWHS "" UWORD _CNV_R_R_Umr_1_zu_1_3_CM_S2 1 0 0 20000 FORMAT "%2.0" ECU_ADDRESS 0xFFF90E4E /end MEASUREMENT
/begin MEASUREMENT SCHN_AB_RSFOLLOWHS_NL "" UWORD _CNV_R_R_Umr_1_zu_1_3_CM_S2 1 0 0 20000 FORMAT "%2.0" ECU_ADDRESS 0xFFF90E50 /end MEASUREMENT
/begin MEASUREMENT SCHN_AB_RSSKL "" UWORD _CNV_R_R_Umr_1_zu_1_3_CM_S2 1 0 0 30000 FORMAT "%2.0" ECU_ADDRESS 0xFFF90E52 /end MEASUREMENT
/begin MEASUREMENT SCHN_AB_STD_RSSKL "" UWORD _CNV_R_R_Umr_1_zu_1_3_CM_S2 1 0 0 20000 FORMAT "%2.0" ECU_ADDRESS 0xFFF90E54 /end MEASUREMENT
/begin MEASUREMENT S_NAB_DELTANMOTHS_DECRSTART "" UBYTE _CNV_P_2_A_I_5_CM_S2 1 0 0 1 ECU_ADDRESS 0xFFF915A9 /end MEASUREMENT
/begin MEASUREMENT S_SHIFT_NMOTHS "" UBYTE _CNV_P_2_A_I_5_CM_S2 1 0 0 255 ECU_ADDRESS 0xFFF915AA /end MEASUREMENT
/begin MEASUREMENT S_SHIFT_NMOTHS_ALT "" UBYTE _CNV_P_2_A_I_5_CM_S2 1 0 0 1 ECU_ADDRESS 0xFFF915AB /end MEASUREMENT
/begin MEASUREMENT S_SHIFT_UP "" UBYTE _CNV_P_2_A_I_5_CM_S2 1 0 0 255 ECU_ADDRESS 0xFFF915AC /end MEASUREMENT
/begin MEASUREMENT Z_GANG_DMRSSKL "" UBYTE _CNV_S_9_Enum_EGANG_30_CM_S2 1 0 0 8 ECU_ADDRESS 0xFFF915AD /end MEASUREMENT
/begin MEASUREMENT Z_GANG_SOLLGF "" UBYTE _CNV_S_9_Enum_EGANG_30_CM_S2 1 0 0 8 ECU_ADDRESS 0xFFF9129D /end MEASUREMENT
/begin MEASUREMENT M_RAD_HDC_KOR "" SWORD _CNV_R_R_Umr_1_zu_1_42_CM_S2 1 0 -1024 1024 FORMAT "%2.0" ECU_ADDRESS 0xFFF90DD2 /end MEASUREMENT
/begin MEASUREMENT M_RAD_HDC_KOR_HS "" SWORD _CNV_R_R_Umr_1_zu_1_42_CM_S2 1 0 -1024 1024 FORMAT "%2.0" ECU_ADDRESS 0xFFF90DD4 /end MEASUREMENT
/begin MEASUREMENT M_RAD_NACHRS_HDC "" SWORD _CNV_R_R_Umr_1_zu_1_42_CM_S2 1 0 -1024 1024 FORMAT "%2.0" ECU_ADDRESS 0xFFF90DD6 /end MEASUREMENT
/begin MEASUREMENT N_MOT_NACHHS_HDC "" UWORD _CNV_R_R_Umr_1_zu_1_3_CM_S2 1 0 0 20000 FORMAT "%2.0" ECU_ADDRESS 0xFFF90DD8 /end MEASUREMENT
/begin MEASUREMENT N_MOT_NACHRS_HDC "" UWORD _CNV_R_R_Umr_1_zu_1_3_CM_S2 1 0 0 20000 FORMAT "%2.0" ECU_ADDRESS 0xFFF90DDA /end MEASUREMENT
/begin MEASUREMENT S_HDC_BER "" UBYTE _CNV_S_2_Enum_EHDC__114_CM_S2 1 0 0 1 ECU_ADDRESS 0xFFF91562 /end MEASUREMENT
/begin MEASUREMENT S_HDC_ERK "" UBYTE _CNV_P_2_A_I_5_CM_S2 1 0 0 255 ECU_ADDRESS 0xFFF9151D /end MEASUREMENT
/begin MEASUREMENT S_HDC_INIT "" UBYTE _CNV_P_2_A_I_5_CM_S2 1 0 0 255 ECU_ADDRESS 0xFFF91563 /end MEASUREMENT
/begin MEASUREMENT S_MINUS_HDC "" UBYTE _CNV_P_2_A_I_5_CM_S2 1 0 0 255 ECU_ADDRESS 0xFFF91684 /end MEASUREMENT
/begin MEASUREMENT S_PLUS_HDC "" UBYTE _CNV_P_2_A_I_5_CM_S2 1 0 0 255 ECU_ADDRESS 0xFFF9168C /end MEASUREMENT
/begin MEASUREMENT Z_GANG_HDC "" UBYTE _CNV_S_9_Enum_EGANG_30_CM_S2 1 0 0 8 ECU_ADDRESS 0xFFF91564 /end MEASUREMENT
/begin MEASUREMENT A_Q_KURVE_GEW "" SWORD _CNV_R_R_Umr_10_zu__46_CM_S2 1 0 -3000 3000 FORMAT "%3.1" ECU_ADDRESS 0xFFF91120 /end MEASUREMENT
/begin MEASUREMENT C_HSUKS "" UWORD _CNV_R_R_Umr_1_zu_1_2_CM_S2 1 0 0 65535 FORMAT "%2.0" ECU_ADDRESS 0xFFF90D22 /end MEASUREMENT
/begin MEASUREMENT C_HSURE "" UWORD _CNV_R_R_Umr_1_zu_1_2_CM_S2 1 0 0 65535 FORMAT "%2.0" ARRAY_SIZE 15 ECU_ADDRESS 0xFFF90D24 MATRIX_DIM 15 1 1 /end MEASUREMENT
/begin MEASUREMENT DA_Q_KURVE_GEW "" SWORD _CNV_R_R_Umr_10_zu__46_CM_S2 1 0 -20 20 FORMAT "%3.1" ECU_ADDRESS 0xFFF91124 /end MEASUREMENT
/begin MEASUREMENT DELTA_NT_HSSKL "" SWORD _CNV_R_R_Umr_1_zu_1_3_CM_S2 1 0 -1000 2000 FORMAT "%2.0" ECU_ADDRESS 0xFFF9111A /end MEASUREMENT
/begin MEASUREMENT DELTA_NT_HSSKL_NSC "" SWORD _CNV_R_R_Umr_1_zu_1_3_CM_S2 1 0 -1000 2000 FORMAT "%2.0" ECU_ADDRESS 0xFFF91128 /end MEASUREMENT
/begin MEASUREMENT DVREL_SEGLIM_AAF_FREEZED_COS "" SWORD _CNV_R_R_Umr_1_zu_1_53_CM_S2 1 0 -32767 32767 FORMAT "%2.0" ECU_ADDRESS 0xFFF90D10 /end MEASUREMENT
/begin MEASUREMENT DVREL_SEGLIM_KREIS_FREEZED_COS "" SWORD _CNV_R_R_Umr_1_zu_1_53_CM_S2 1 0 -32767 32767 FORMAT "%2.0" ECU_ADDRESS 0xFFF90D12 /end MEASUREMENT
/begin MEASUREMENT DVREL_SEGLIM_KRZG_FREEZED_COS "" SWORD _CNV_R_R_Umr_1_zu_1_53_CM_S2 1 0 -32767 32767 FORMAT "%2.0" ECU_ADDRESS 0xFFF90D14 /end MEASUREMENT
/begin MEASUREMENT DVREL_SEGLIM_KURVE_FREEZED_COS "" SWORD _CNV_R_R_Umr_1_zu_1_53_CM_S2 1 0 -32767 32767 FORMAT "%2.0" ECU_ADDRESS 0xFFF90D16 /end MEASUREMENT
/begin MEASUREMENT DVREL_SEGPRD_AAF_FREEZED_COS "" SWORD _CNV_R_R_Umr_1_zu_1_53_CM_S2 1 0 -32767 32767 FORMAT "%2.0" ECU_ADDRESS 0xFFF90D18 /end MEASUREMENT
/begin MEASUREMENT DVREL_SEGPRD_KREIS_FREEZED_COS "" SWORD _CNV_R_R_Umr_1_zu_1_53_CM_S2 1 0 -32767 32767 FORMAT "%2.0" ECU_ADDRESS 0xFFF90D1A /end MEASUREMENT
/begin MEASUREMENT DVREL_SEGPRD_KRZG_FREEZED_COS "" SWORD _CNV_R_R_Umr_1_zu_1_53_CM_S2 1 0 -32767 32767 FORMAT "%2.0" ECU_ADDRESS 0xFFF90D1C /end MEASUREMENT
/begin MEASUREMENT DVREL_SEGPRD_KURVE_FREEZED_COS "" SWORD _CNV_R_R_Umr_1_zu_1_53_CM_S2 1 0 -32767 32767 FORMAT "%2.0" ECU_ADDRESS 0xFFF90D1E /end MEASUREMENT
/begin MEASUREMENT FP_DIR_HSURE "" UBYTE _CNV_S_2_Enum_EFP_D_130_CM_S2 1 0 0 1 ECU_ADDRESS 0xFFF91747 /end MEASUREMENT
/begin MEASUREMENT GWFPFILTHSURE_ALT_DECR "" SWORD _CNV_R_R_Umr_1_zu_1_131_CM_S2 1 0 -32768 32767 FORMAT "%2.0" ECU_ADDRESS 0xFFF9114E /end MEASUREMENT
/begin MEASUREMENT GW_FP_FILT_HSUREALT "" SWORD _CNV_R_R_Umr_1_zu_1_7_CM_S2 1 0 -32768 32767 FORMAT "%2.0" ECU_ADDRESS 0xFFF90D42 /end MEASUREMENT
/begin MEASUREMENT GW_FP_FILT_HSUREREF "" SWORD _CNV_R_R_Umr_1_zu_1_7_CM_S2 1 0 -32768 32767 FORMAT "%2.0" ECU_ADDRESS 0xFFF9111C /end MEASUREMENT
/begin MEASUREMENT HSUKS_DECRVAL "" UWORD _CNV_R_R_Umr_1_zu_1_2_CM_S2 1 0 0 65535 FORMAT "%2.0" ECU_ADDRESS 0xFFF90D6C /end MEASUREMENT
/begin MEASUREMENT HSUKS_EIN_FLAG "" UBYTE _CNV_R_R_Umr_1_zu_1_2_CM_S2 1 0 0 255 FORMAT "%2.0" ECU_ADDRESS 0xFFF914EA /end MEASUREMENT
/begin MEASUREMENT N_AB_INIT_HSURESLREG "" UWORD _CNV_R_R_Umr_1_zu_1_3_CM_S2 1 0 0 20000 FORMAT "%2.0" ECU_ADDRESS 0xFFF91130 /end MEASUREMENT
/begin MEASUREMENT N_MOTNACHHS_HSUREHS "" UWORD _CNV_R_R_Umr_1_zu_1_3_CM_S2 1 0 0 20000 FORMAT "%2.0" ECU_ADDRESS 0xFFF9111E /end MEASUREMENT
/begin MEASUREMENT N_MOT_HSURE "" UWORD _CNV_R_R_Umr_1_zu_1_3_CM_S2 1 0 0 65535 FORMAT "%2.0" ECU_ADDRESS 0xFFF90D44 /end MEASUREMENT
/begin MEASUREMENT SCHA_Q_HSURE_KU "" SWORD _CNV_R_R_Umr_10_zu__46_CM_S2 1 0 -3276.8 3276.7 FORMAT "%3.1" ECU_ADDRESS 0xFFF91122 /end MEASUREMENT
/begin MEASUREMENT SCHDA_Q_HSURE_KUVOR "" SWORD _CNV_R_R_Umr_10_zu__46_CM_S2 1 0 -20 20 FORMAT "%3.1" ECU_ADDRESS 0xFFF91126 /end MEASUREMENT
/begin MEASUREMENT SCHLUPF_BUF_SUM_HSURE "" UWORD _CNV_R_R_Umr_1_zu_1_2_CM_S2 1 0 0 65535 FORMAT "%2.0" ECU_ADDRESS 0xFFF90D46 /end MEASUREMENT
/begin MEASUREMENT SCHLUPF_GEW_HSURE_BUF "" UWORD _CNV_R_R_Umr_1_zu_1_2_CM_S2 1 0 0 65535 FORMAT "%2.0" ARRAY_SIZE 16 ECU_ADDRESS 0xFFF90248 MATRIX_DIM 16 1 1 /end MEASUREMENT
/begin MEASUREMENT SCHN_AB_DERS_HSURERS "" UWORD _CNV_R_R_Umr_1_zu_1_3_CM_S2 1 0 0 20000 FORMAT "%2.0" ECU_ADDRESS 0xFFF9112A /end MEASUREMENT
/begin MEASUREMENT SCHN_AB_HSURERS "" UWORD _CNV_R_R_Umr_1_zu_1_3_CM_S2 1 0 0 15000 FORMAT "%2.0" ECU_ADDRESS 0xFFF9112C /end MEASUREMENT
/begin MEASUREMENT SCHN_AB_MAX_HSURESLMUE "" UWORD _CNV_R_R_Umr_1_zu_1_3_CM_S2 1 0 0 20000 FORMAT "%2.0" ECU_ADDRESS 0xFFF91132 /end MEASUREMENT
/begin MEASUREMENT SCHN_AB_MAX_HSURESLREG "" UWORD _CNV_R_R_Umr_1_zu_1_3_CM_S2 1 0 0 20000 FORMAT "%2.0" ECU_ADDRESS 0xFFF91134 /end MEASUREMENT
/begin MEASUREMENT SCHN_AB_MAX_HSURESLSS "" UWORD _CNV_R_R_Umr_1_zu_1_3_CM_S2 1 0 0 20000 FORMAT "%2.0" ECU_ADDRESS 0xFFF91136 /end MEASUREMENT
/begin MEASUREMENT SCHN_AB_MAX_REINI_HSURESLREG "" UWORD _CNV_R_R_Umr_1_zu_1_3_CM_S2 1 0 0 20000 FORMAT "%2.0" ECU_ADDRESS 0xFFF91138 /end MEASUREMENT
/begin MEASUREMENT SCHN_AB_MIN_NACHL_HSURESLMUE "" UWORD _CNV_R_R_Umr_1_zu_1_3_CM_S2 1 0 0 20000 FORMAT "%2.0" ECU_ADDRESS 0xFFF9113A /end MEASUREMENT
/begin MEASUREMENT SCHN_AB_MIN_NACHL_HSURESLREG "" UWORD _CNV_R_R_Umr_1_zu_1_3_CM_S2 1 0 0 20000 FORMAT "%2.0" ECU_ADDRESS 0xFFF9113C /end MEASUREMENT
/begin MEASUREMENT SCHN_AB_MIN_NACHL_HSURESLSS "" UWORD _CNV_R_R_Umr_1_zu_1_3_CM_S2 1 0 0 20000 FORMAT "%2.0" ECU_ADDRESS 0xFFF9113E /end MEASUREMENT
/begin MEASUREMENT SCHN_MOT_DECRSTART_HSURE_COS "" UWORD _CNV_R_R_Umr_1_zu_1_3_CM_S2 1 0 0 20000 FORMAT "%2.0" ECU_ADDRESS 0xFFF90D20 /end MEASUREMENT
/begin MEASUREMENT SCHN_MOT_MAX_HSURESLMUE "" UWORD _CNV_R_R_Umr_1_zu_1_3_CM_S2 1 0 0 20000 FORMAT "%2.0" ECU_ADDRESS 0xFFF91140 /end MEASUREMENT
/begin MEASUREMENT SCHN_MOT_MAX_HSURESLREG "" UWORD _CNV_R_R_Umr_1_zu_1_3_CM_S2 1 0 0 20000 FORMAT "%2.0" ECU_ADDRESS 0xFFF91142 /end MEASUREMENT
/begin MEASUREMENT SCHN_MOT_MAX_HSURESLSS "" UWORD _CNV_R_R_Umr_1_zu_1_3_CM_S2 1 0 0 20000 FORMAT "%2.0" ECU_ADDRESS 0xFFF91144 /end MEASUREMENT
/begin MEASUREMENT SCHW_DKKD_HSURERS "" UWORD _CNV_R_R_Umr_10_zu__9_CM_S2 1 0 0 110 FORMAT "%3.1" ECU_ADDRESS 0xFFF9112E /end MEASUREMENT
/begin MEASUREMENT S_ADAPT_INIT "" UBYTE _CNV_R_R_Umr_1_zu_1_2_CM_S2 1 0 0 1 FORMAT "%2.0" ECU_ADDRESS 0xFFF91727 /end MEASUREMENT
/begin MEASUREMENT S_GWFP_FILTHSURE_DOWN "" UBYTE _CNV_P_2_A_I_5_CM_S2 1 0 0 255 ECU_ADDRESS 0xFFF9172A /end MEASUREMENT
/begin MEASUREMENT S_GWFP_FILTHSURE_NEG "" UBYTE _CNV_P_2_A_I_5_CM_S2 1 0 0 255 ECU_ADDRESS 0xFFF9172B /end MEASUREMENT
/begin MEASUREMENT S_GWFP_FLANKENWECHSEL_VALID "" UBYTE _CNV_P_2_A_I_5_CM_S2 1 0 0 255 ECU_ADDRESS 0xFFF9172C /end MEASUREMENT
/begin MEASUREMENT S_GWFP_HSURE_BRS "" UBYTE _CNV_P_2_A_I_5_CM_S2 1 0 0 255 ECU_ADDRESS 0xFFF9172D /end MEASUREMENT
/begin MEASUREMENT S_HSUKS_ERK "" UBYTE _CNV_R_R_Umr_1_zu_1_2_CM_S2 1 0 0 1 FORMAT "%2.0" ECU_ADDRESS 0xFFF914EB /end MEASUREMENT
/begin MEASUREMENT S_HSUKS_PROG_MODE "" UBYTE _CNV_R_R_Umr_1_zu_1_2_CM_S2 1 0 0 255 FORMAT "%2.0" ECU_ADDRESS 0xFFF914EC /end MEASUREMENT
/begin MEASUREMENT S_HSUKS_TEMP_ERK "" UBYTE _CNV_R_R_Umr_1_zu_1_2_CM_S2 1 0 0 1 FORMAT "%2.0" ECU_ADDRESS 0xFFF914ED /end MEASUREMENT
/begin MEASUREMENT S_HSURE_ADAPT_ERK "" UBYTE _CNV_R_R_Umr_1_zu_1_2_CM_S2 1 0 0 255 ECU_ADDRESS 0xFFF91728 /end MEASUREMENT
/begin MEASUREMENT S_HSURE_BAB_ERK "" UBYTE _CNV_P_2_A_I_5_CM_S2 1 0 0 255 ECU_ADDRESS 0xFFF914E6 /end MEASUREMENT
/begin MEASUREMENT S_HSURE_BAB_HS "" UBYTE _CNV_P_2_A_I_5_CM_S2 1 0 0 255 ECU_ADDRESS 0xFFF91729 /end MEASUREMENT
/begin MEASUREMENT S_HSURE_BRSNACHL "" UBYTE _CNV_P_2_A_I_5_CM_S2 1 0 0 255 FORMAT "%2.0" ECU_ADDRESS 0xFFF9172E /end MEASUREMENT
/begin MEASUREMENT S_HSURE_BRS_ERK "" UBYTE _CNV_P_2_A_I_5_CM_S2 1 0 0 255 ECU_ADDRESS 0xFFF9172F /end MEASUREMENT
/begin MEASUREMENT S_HSURE_COS_ERK "" UBYTE _CNV_P_2_A_I_5_CM_S2 1 0 0 255 ECU_ADDRESS 0xFFF914E0 /end MEASUREMENT
/begin MEASUREMENT S_HSURE_FOF_ERK "" UBYTE _CNV_P_2_A_I_5_CM_S2 1 0 0 255 ECU_ADDRESS 0xFFF91731 /end MEASUREMENT
/begin MEASUREMENT S_HSURE_HS_ERK "" UBYTE _CNV_P_2_A_I_5_CM_S2 1 0 0 255 ECU_ADDRESS 0xFFF91733 /end MEASUREMENT
/begin MEASUREMENT S_HSURE_INSTAT_ERK "" UBYTE _CNV_P_2_A_I_5_CM_S2 1 0 0 255 ECU_ADDRESS 0xFFF91734 /end MEASUREMENT
/begin MEASUREMENT S_HSURE_KUVOR_ERK "" UBYTE _CNV_P_2_A_I_5_CM_S2 1 0 0 255 ECU_ADDRESS 0xFFF91737 /end MEASUREMENT
/begin MEASUREMENT S_HSURE_KU_ERK "" UBYTE _CNV_P_2_A_I_5_CM_S2 1 0 0 255 ECU_ADDRESS 0xFFF91736 /end MEASUREMENT
/begin MEASUREMENT S_HSURE_NABNEGATIV_ERK "" UBYTE _CNV_P_2_A_I_5_CM_S2 1 0 0 255 ECU_ADDRESS 0xFFF91739 /end MEASUREMENT
/begin MEASUREMENT S_HSURE_NL_ERK "" UBYTE _CNV_P_2_A_I_5_CM_S2 1 0 0 255 ECU_ADDRESS 0xFFF9173A /end MEASUREMENT
/begin MEASUREMENT S_HSURE_NSC_ERK "" UBYTE _CNV_R_R_Umr_1_zu_1_2_CM_S2 1 0 0 255 ECU_ADDRESS 0xFFF9173C /end MEASUREMENT
/begin MEASUREMENT S_HSURE_RS_ERK "" UBYTE _CNV_P_2_A_I_5_CM_S2 1 0 0 255 ECU_ADDRESS 0xFFF9173E /end MEASUREMENT
/begin MEASUREMENT S_HSURE_SCHLUPF_ERK "" UBYTE _CNV_P_2_A_I_5_CM_S2 1 0 0 255 ECU_ADDRESS 0xFFF9173F /end MEASUREMENT
/begin MEASUREMENT S_HSURE_VOR_ERK "" UBYTE _CNV_P_2_A_I_5_CM_S2 1 0 0 255 ECU_ADDRESS 0xFFF91748 /end MEASUREMENT
/begin MEASUREMENT S_MUELOWSS "" UBYTE _CNV_R_R_Umr_1_zu_1_2_CM_S2 1 0 0 1 FORMAT "%2.0" ECU_ADDRESS 0xFFF91740 /end MEASUREMENT
/begin MEASUREMENT S_MUELOWSS_ALT "" UBYTE _CNV_R_R_Umr_1_zu_1_2_CM_S2 1 0 0 1 FORMAT "%2.0" ECU_ADDRESS 0xFFF91741 /end MEASUREMENT
/begin MEASUREMENT S_NSC_INIT "" UBYTE _CNV_R_R_Umr_1_zu_1_2_CM_S2 1 0 0 1 FORMAT "%2.0" ECU_ADDRESS 0xFFF9173D /end MEASUREMENT
/begin MEASUREMENT S_V_PROGNOSE1 "" UBYTE _CNV_R_R_Umr_1_zu_1_2_CM_S2 1 0 0 255 FORMAT "%2.0" ECU_ADDRESS 0xFFF914E4 /end MEASUREMENT
/begin MEASUREMENT S_V_PROGNOSE2 "" UBYTE _CNV_R_R_Umr_1_zu_1_2_CM_S2 1 0 0 255 FORMAT "%2.0" ECU_ADDRESS 0xFFF914E5 /end MEASUREMENT
/begin MEASUREMENT T_HSURE_DECPERIOD "" ULONG _CNV_R_R_Umr_1_zu_1_6_CM_S2 1 0 0 4294967295 FORMAT "%2.0" ECU_ADDRESS 0xFFF90268 /end MEASUREMENT
/begin MEASUREMENT T_HSURE_MSCTR "" ULONG _CNV_R_R_Umr_1_zu_1_6_CM_S2 1 0 0 4294967295 FORMAT "%2.0" ECU_ADDRESS 0xFFF9026C /end MEASUREMENT
/begin MEASUREMENT T_HSURE_NEXTDECREMENTTIME "" ULONG _CNV_R_R_Umr_1_zu_1_6_CM_S2 1 0 0 4294967295 FORMAT "%2.0" ARRAY_SIZE 15 ECU_ADDRESS 0xFFF90270 MATRIX_DIM 15 1 1 /end MEASUREMENT
/begin MEASUREMENT T_HSURE_NEXTDECREMENTTIME_KS "" ULONG _CNV_R_R_Umr_1_zu_1_6_CM_S2 1 0 0 4294967295 FORMAT "%2.0" ECU_ADDRESS 0xFFF902AC /end MEASUREMENT
/begin MEASUREMENT T_HSURE_RESET_MODWHYB_NL "" UWORD _CNV_R_R_Umr_1_zu_1_6_CM_S2 1 0 0 65535 FORMAT "%2.0" ECU_ADDRESS 0xFFF90D48 /end MEASUREMENT
/begin MEASUREMENT T_RUNTIME_HSURE "" UWORD _CNV_R_R_Umr_1_zu_1_132_CM_S2 1 0 0 65535 FORMAT "%2.0" ECU_ADDRESS 0xFFF90D4A /end MEASUREMENT
/begin MEASUREMENT T_WAIT_HSURENL "" ULONG _CNV_R_R_Umr_1_zu_1_6_CM_S2 1 0 0 25000 FORMAT "%2.0" ECU_ADDRESS 0xFFF90838 /end MEASUREMENT
/begin MEASUREMENT W_DKKD_HSURE "" UWORD _CNV_R_R_Umr_10_zu__9_CM_S2 1 0 0 110 FORMAT "%3.1" ECU_ADDRESS 0xFFF90D4C /end MEASUREMENT
/begin MEASUREMENT Z_AGS_MODBEDEL_HSU "" UBYTE _CNV_S_2_Enum_EAGS_25_CM_S2 1 0 0 1 ECU_ADDRESS 0xFFF9167E /end MEASUREMENT
/begin MEASUREMENT Z_BEDEL_AUSHSU "" UBYTE _CNV_S_3_Enum_EHSUA_129_CM_S2 1 0 0 2 ECU_ADDRESS 0xFFF914E7 /end MEASUREMENT
/begin MEASUREMENT Z_DECR_HSURE_COS "" UBYTE _CNV_R_R_Umr_1_zu_1_2_CM_S2 1 0 0 2 FORMAT "%2.0" ECU_ADDRESS 0xFFF914E1 /end MEASUREMENT
/begin MEASUREMENT Z_GANG_ZIELALT_HSURE "" UBYTE _CNV_S_9_Enum_EGANG_30_CM_S2 1 0 0 8 ECU_ADDRESS 0xFFF914E8 /end MEASUREMENT
/begin MEASUREMENT Z_HSUBED "" UBYTE _CNV_S_8_Enum_EHSUB_119_CM_S2 1 0 0 7 ECU_ADDRESS 0xFFF914E9 /end MEASUREMENT
/begin MEASUREMENT Z_HSUKS "" UBYTE _CNV_S_3_Enum_EHSU__133_CM_S2 1 0 0 2 ECU_ADDRESS 0xFFF914EE /end MEASUREMENT
/begin MEASUREMENT Z_HSUKS_IDX_KUP_A "" UBYTE _CNV_R_R_Umr_1_zu_1_2_CM_S2 1 0 0 4 FORMAT "%2.0" ECU_ADDRESS 0xFFF914EF /end MEASUREMENT
/begin MEASUREMENT Z_HSUKS_IDX_KUP_B "" UBYTE _CNV_R_R_Umr_1_zu_1_2_CM_S2 1 0 0 4 FORMAT "%2.0" ECU_ADDRESS 0xFFF914F0 /end MEASUREMENT
/begin MEASUREMENT Z_HSUKS_IDX_KUP_C "" UBYTE _CNV_R_R_Umr_1_zu_1_2_CM_S2 1 0 0 4 FORMAT "%2.0" ECU_ADDRESS 0xFFF914F1 /end MEASUREMENT
/begin MEASUREMENT Z_HSUKS_IDX_KUP_D "" UBYTE _CNV_R_R_Umr_1_zu_1_2_CM_S2 1 0 0 4 FORMAT "%2.0" ECU_ADDRESS 0xFFF914F2 /end MEASUREMENT
/begin MEASUREMENT Z_HSUKS_IDX_KUP_E "" UBYTE _CNV_R_R_Umr_1_zu_1_2_CM_S2 1 0 0 4 FORMAT "%2.0" ECU_ADDRESS 0xFFF914F3 /end MEASUREMENT
/begin MEASUREMENT Z_HSURESL "" UBYTE _CNV_S_3_Enum_EHSUR_134_CM_S2 1 0 0 2 ECU_ADDRESS 0xFFF91742 /end MEASUREMENT
/begin MEASUREMENT Z_HSURESLMUE "" UBYTE _CNV_S_3_Enum_EHSUR_134_CM_S2 1 0 0 2 ECU_ADDRESS 0xFFF91743 /end MEASUREMENT
/begin MEASUREMENT Z_HSURESLMUE_DECVAL "" UWORD _CNV_R_R_Umr_1_zu_1_2_CM_S2 1 0 0 65535 FORMAT "%2.0" ECU_ADDRESS 0xFFF91146 /end MEASUREMENT
/begin MEASUREMENT Z_HSURESLREG "" UBYTE _CNV_S_3_Enum_EHSUR_134_CM_S2 1 0 0 2 ECU_ADDRESS 0xFFF91744 /end MEASUREMENT
/begin MEASUREMENT Z_HSURESLREG_DECVAL "" UWORD _CNV_R_R_Umr_1_zu_1_2_CM_S2 1 0 0 65535 FORMAT "%2.0" ECU_ADDRESS 0xFFF91148 /end MEASUREMENT
/begin MEASUREMENT Z_HSURESLSS "" UBYTE _CNV_S_3_Enum_EHSUR_134_CM_S2 1 0 0 2 ECU_ADDRESS 0xFFF91745 /end MEASUREMENT
/begin MEASUREMENT Z_HSURESLSS_DECVAL "" UWORD _CNV_R_R_Umr_1_zu_1_2_CM_S2 1 0 0 65535 FORMAT "%2.0" ECU_ADDRESS 0xFFF9114A /end MEASUREMENT
/begin MEASUREMENT Z_HSURESL_DECVAL "" UWORD _CNV_R_R_Umr_1_zu_1_2_CM_S2 1 0 0 65535 FORMAT "%2.0" ECU_ADDRESS 0xFFF9114C /end MEASUREMENT
/begin MEASUREMENT Z_HSURESL_MASK "" UBYTE _CNV_R_R_Umr_1_zu_1_2_CM_S2 1 0 0 255 FORMAT "%2.0" ECU_ADDRESS 0xFFF91746 /end MEASUREMENT
/begin MEASUREMENT Z_HSURE_BRS "" UBYTE _CNV_S_3_Enum_EHSUR_135_CM_S2 1 0 0 2 ECU_ADDRESS 0xFFF91730 /end MEASUREMENT
/begin MEASUREMENT Z_HSURE_COS "" UBYTE _CNV_R_R_Umr_1_zu_1_2_CM_S2 1 0 0 3 FORMAT "%2.0" ECU_ADDRESS 0xFFF914E2 /end MEASUREMENT
/begin MEASUREMENT Z_HSURE_DECVAL "" UWORD _CNV_R_R_Umr_1_zu_1_2_CM_S2 1 0 0 65535 FORMAT "%2.0" ARRAY_SIZE 15 ECU_ADDRESS 0xFFF90D4E MATRIX_DIM 15 1 1 /end MEASUREMENT
/begin MEASUREMENT Z_HSURE_DECVAL_KS "" UWORD _CNV_R_R_Umr_1_zu_1_2_CM_S2 1 0 0 255 FORMAT "%2.0" ECU_ADDRESS 0xFFF90D6E /end MEASUREMENT
/begin MEASUREMENT Z_HSURE_FOF_STAT "" UBYTE _CNV_S_3_Enum_EHSUR_136_CM_S2 1 0 0 2 ECU_ADDRESS 0xFFF91732 /end MEASUREMENT
/begin MEASUREMENT Z_HSURE_NL_STAT "" UBYTE _CNV_S_3_Enum_EHSUR_137_CM_S2 1 0 0 2 ECU_ADDRESS 0xFFF9173B /end MEASUREMENT
/begin MEASUREMENT Z_HSURE_RESET_MASK "" ULONG _CNV_R_R_Umr_1_zu_1_2_CM_S2 1 0 0 4294967295 FORMAT "%2.0" ECU_ADDRESS 0xFFF902B0 /end MEASUREMENT
/begin MEASUREMENT Z_IDX_FPVOR_HSURE "" UBYTE _CNV_S_5_Enum_EGWFP_128_CM_S2 1 0 0 4 ECU_ADDRESS 0xFFF91749 /end MEASUREMENT
/begin MEASUREMENT Z_LDMBAB_HSURE_IDX "" UBYTE _CNV_S_3_Enum_ELDMA_116_CM_S2 1 0 0 2 ECU_ADDRESS 0xFFF91735 /end MEASUREMENT
/begin MEASUREMENT Z_MASK_HSURE_COS "" UBYTE _CNV_R_R_Umr_1_zu_1_2_CM_S2 1 0 0 255 FORMAT "%2.0" ECU_ADDRESS 0xFFF914E3 /end MEASUREMENT
/begin MEASUREMENT Z_MOD_KURVE_HSURE "" UBYTE _CNV_S_4_Enum_EHSUR_121_CM_S2 1 0 0 3 ECU_ADDRESS 0xFFF91738 /end MEASUREMENT
/begin MEASUREMENT DM_ABFWS_REF_RSUBGH "" SWORD _CNV_R_R_Umr_1_zu_1_42_CM_S2 1 0 -32768 32767 FORMAT "%2.0" ECU_ADDRESS 0xFFF90D7C /end MEASUREMENT
/begin MEASUREMENT S_RSUBGH "" UBYTE _CNV_S_2_Schalter_A_4_CM_S2 1 0 0 1 ECU_ADDRESS 0xFFF91767 /end MEASUREMENT
/begin MEASUREMENT S_RSUBGH_ERK "" UBYTE _CNV_S_2_Schalter_A_4_CM_S2 1 0 0 1 ECU_ADDRESS 0xFFF91500 /end MEASUREMENT
/begin MEASUREMENT W_DKKD_REF_RSUBGH "" UWORD _CNV_R_R_Umr_10_zu__9_CM_S2 1 0 0 110 FORMAT "%3.1" ECU_ADDRESS 0xFFF90D7E /end MEASUREMENT
/begin MEASUREMENT Z_AGS_MODBEDEL_ALT_RSUBGH "" UBYTE _CNV_S_2_Enum_EAGS_25_CM_S2 1 0 0 1 ECU_ADDRESS 0xFFF91501 /end MEASUREMENT
/begin MEASUREMENT Z_BERGANH_ALT_RSUBGH "" UBYTE _CNV_S_6_Enum_EBERG_61_CM_S2 1 0 0 5 ECU_ADDRESS 0xFFF91502 /end MEASUREMENT
/begin MEASUREMENT Z_GANG_RSUBGH "" UBYTE _CNV_S_9_Enum_EGANG_30_CM_S2 1 0 0 8 ECU_ADDRESS 0xFFF91768 /end MEASUREMENT
/begin MEASUREMENT IDX_XTAB6S_EFAHREN_ERK "" SBYTE _CNV_R_R_Umr_1_zu_1_2_CM_S2 1 0 0 127 ECU_ADDRESS 0xFFF9151F /end MEASUREMENT
/begin MEASUREMENT S_EFAHREN_1_ERK "" UBYTE _CNV_R_R_Umr_1_zu_1_2_CM_S2 1 0 0 255 ECU_ADDRESS 0xFFF91520 /end MEASUREMENT
/begin MEASUREMENT S_EFAHREN_2_ERK "" UBYTE _CNV_R_R_Umr_1_zu_1_2_CM_S2 1 0 0 255 FORMAT "%2.0" ECU_ADDRESS 0xFFF91521 /end MEASUREMENT
/begin MEASUREMENT S_EFAHREN_3_ERK "" UBYTE _CNV_R_R_Umr_1_zu_1_2_CM_S2 1 0 0 255 FORMAT "%2.0" ECU_ADDRESS 0xFFF91522 /end MEASUREMENT
/begin MEASUREMENT S_EFAHREN_4_ERK "" UBYTE _CNV_R_R_Umr_1_zu_1_2_CM_S2 1 0 0 255 FORMAT "%2.0" ECU_ADDRESS 0xFFF91523 /end MEASUREMENT
/begin MEASUREMENT S_EFAHREN_ERK "" UBYTE _CNV_P_2_A_I_5_CM_S2 1 0 0 255 ECU_ADDRESS 0xFFF91524 /end MEASUREMENT
/begin MEASUREMENT S_EFAHREN_HYB "" UBYTE _CNV_R_R_Umr_1_zu_1_2_CM_S2 1 0 0 1 FORMAT "%2.0" ECU_ADDRESS 0xFFF91529 /end MEASUREMENT
/begin MEASUREMENT S_HYBRID_HAS_IST_ERK "" UBYTE _CNV_R_R_Umr_1_zu_1_2_CM_S2 1 0 0 255 FORMAT "%2.0" ECU_ADDRESS 0xFFF9152A /end MEASUREMENT
/begin MEASUREMENT S_HYBRID_HAS_ZIEL_ERK "" UBYTE _CNV_R_R_Umr_1_zu_1_2_CM_S2 1 0 0 255 FORMAT "%2.0" ECU_ADDRESS 0xFFF9152B /end MEASUREMENT
/begin MEASUREMENT S_NOTLAUF_AEP_ERK "" UBYTE _CNV_R_R_Umr_1_zu_1_2_CM_S2 1 0 0 255 ECU_ADDRESS 0xFFF91525 /end MEASUREMENT
/begin MEASUREMENT S_NOTLAUF_EM_HIGH_ERK "" UBYTE _CNV_R_R_Umr_1_zu_1_2_CM_S2 1 0 0 255 ECU_ADDRESS 0xFFF91526 /end MEASUREMENT
/begin MEASUREMENT S_NOTLAUF_EM_LOW_ERK "" UBYTE _CNV_R_R_Umr_1_zu_1_2_CM_S2 1 0 0 255 ECU_ADDRESS 0xFFF91527 /end MEASUREMENT
/begin MEASUREMENT S_REKUP_ERK "" UBYTE _CNV_P_2_A_I_5_CM_S2 1 0 0 255 ECU_ADDRESS 0xFFF91528 /end MEASUREMENT
/begin MEASUREMENT T_EFAHR_AUS "" UWORD _CNV_R_R_Umr_1_zu_1_6_CM_S2 1 0 0 5000 FORMAT "%2.0" ECU_ADDRESS 0xFFF90D98 /end MEASUREMENT
/begin MEASUREMENT T_EFAHR_EMISSIONIERUNG "" UWORD _CNV_R_R_Umr_1_zu_1_6_CM_S2 1 0 0 10000 FORMAT "%2.0" ECU_ADDRESS 0xFFF90D9A /end MEASUREMENT
/begin MEASUREMENT T_EFAHR_EMISSIONIERUNG_GESTARTET "" UBYTE _CNV_R_R_Umr_1_zu_1_2_CM_S2 1 0 0 1 FORMAT "%2.0" ECU_ADDRESS 0xFFF9152F /end MEASUREMENT
/begin MEASUREMENT Z_MODUS_HYBRID "" UBYTE _CNV_S_4_Enum_EMODU_144_CM_S2 1 0 0 3 ECU_ADDRESS 0xFFF9152D /end MEASUREMENT
/begin MEASUREMENT Z_MODUS_HYBRID_ALT "" UBYTE _CNV_S_4_Enum_EMODU_144_CM_S2 1 0 0 3 ECU_ADDRESS 0xFFF9152E /end MEASUREMENT
/begin MEASUREMENT C_AUSROLL_RS21 "" UWORD _CNV_R_R_Umr_1_zu_1_2_CM_S2 1 0 0 65535 FORMAT "%2.0" ECU_ADDRESS 0xFFF90D80 /end MEASUREMENT
/begin MEASUREMENT FAKT_HEISSHOCH "" UWORD _CNV_R_R_Umr_1_zu_1_53_CM_S2 1 0 0 250 FORMAT "%2.0" ECU_ADDRESS 0xFFF90D82 /end MEASUREMENT
/begin MEASUREMENT FUNKINIT_DONE_STOPGO "" UBYTE _CNV_R_R_Umr_1_zu_1_2_CM_S2 1 0 0 255 FORMAT "%2.0" ECU_ADDRESS 0xFFF91503 /end MEASUREMENT
/begin MEASUREMENT S_BETRBER_STOPGO "" UBYTE _CNV_P_2_A_I_5_CM_S2 1 0 0 255 ECU_ADDRESS 0xFFF91504 /end MEASUREMENT
/begin MEASUREMENT S_HEISSHOCH_ERK "" UBYTE _CNV_P_2_A_I_5_CM_S2 1 0 0 255 ECU_ADDRESS 0xFFF91505 /end MEASUREMENT
/begin MEASUREMENT S_KOPFKT_STOPGOALT "" UBYTE _CNV_P_2_A_I_5_CM_S2 1 0 0 255 ECU_ADDRESS 0xFFF91506 /end MEASUREMENT
/begin MEASUREMENT S_STOPGO_ERK "" UBYTE _CNV_P_2_A_I_5_CM_S2 1 0 0 255 ECU_ADDRESS 0xFFF91507 /end MEASUREMENT
/begin MEASUREMENT S_STOPGO_NIC_ERK "" UBYTE _CNV_P_2_A_I_5_CM_S2 1 0 0 255 ECU_ADDRESS 0xFFF91508 /end MEASUREMENT
/begin MEASUREMENT S_TSG_LAEUFT "" UBYTE _CNV_P_2_A_I_5_CM_S2 1 0 0 255 ECU_ADDRESS 0xFFF91509 /end MEASUREMENT
/begin MEASUREMENT T_BUFFER_SG "" ULONG _CNV_R_R_Umr_1_zu_1_6_CM_S2 1 0 0 4294967295 FORMAT "%2.0" ECU_ADDRESS 0xFFF902D4 /end MEASUREMENT
/begin MEASUREMENT T_SG "" SLONG _CNV_R_R_Umr_1_zu_1_6_CM_S2 1 0 -2147483647 2147483647 FORMAT "%2.0" ECU_ADDRESS 0xFFF902D8 /end MEASUREMENT
/begin MEASUREMENT Z_GANG_ISTALTSTOPGO "" UBYTE _CNV_S_9_Enum_EGANG_30_CM_S2 1 0 0 8 ECU_ADDRESS 0xFFF9150A /end MEASUREMENT
/begin MEASUREMENT DM_AB_FWSMABINGEW "" SWORD _CNV_R_R_Umr_1_zu_1_42_CM_S2 1 0 -32768 32767 FORMAT "%2.0" ECU_ADDRESS 0xFFF90D70 /end MEASUREMENT
/begin MEASUREMENT DM_AB_FWSMABOUTGEW "" SWORD _CNV_R_R_Umr_1_zu_1_42_CM_S2 1 0 -32768 32767 FORMAT "%2.0" ECU_ADDRESS 0xFFF90D72 /end MEASUREMENT
/begin MEASUREMENT DM_AB_FWS_FILTMAB "" SWORD _CNV_R_R_Umr_1_zu_1_42_CM_S2 1 0 -32768 32767 FORMAT "%2.0" ECU_ADDRESS 0xFFF90D74 /end MEASUREMENT
/begin MEASUREMENT DM_AB_FWS_FILTRESTMAB "" SWORD _CNV_R_R_Umr_1_zu_1_42_CM_S2 1 0 -32768 32767 FORMAT "%2.0" ECU_ADDRESS 0xFFF90D76 /end MEASUREMENT
/begin MEASUREMENT FUNKINIT_DONE_MABERK "" UBYTE _CNV_P_2_A_I_5_CM_S2 1 0 0 255 ECU_ADDRESS 0xFFF914F4 /end MEASUREMENT
/begin MEASUREMENT S_BESCHL_MODAFB "" UBYTE _CNV_P_2_A_I_5_CM_S2 1 0 0 255 ECU_ADDRESS 0xFFF914F5 /end MEASUREMENT
/begin MEASUREMENT S_BETRBER_MODAFB "" UBYTE _CNV_P_2_A_I_5_CM_S2 1 0 0 255 ECU_ADDRESS 0xFFF914F6 /end MEASUREMENT
/begin MEASUREMENT S_FZGSTEHT_MODAFB "" UBYTE _CNV_P_2_A_I_5_CM_S2 1 0 0 255 ECU_ADDRESS 0xFFF914F7 /end MEASUREMENT
/begin MEASUREMENT S_KFINIT_MODAFB "" UBYTE _CNV_P_2_A_I_5_CM_S2 1 0 0 255 ECU_ADDRESS 0xFFF914F8 /end MEASUREMENT
/begin MEASUREMENT S_KFINIT_MODAFB_LAEUFT "" UBYTE _CNV_P_2_A_I_5_CM_S2 1 0 0 255 ECU_ADDRESS 0xFFF914F9 /end MEASUREMENT
/begin MEASUREMENT S_KF_LRN_MODAFB "" UBYTE _CNV_P_2_A_I_5_CM_S2 1 0 0 255 ECU_ADDRESS 0xFFF914FA /end MEASUREMENT
/begin MEASUREMENT S_KF_MODAFB "" UBYTE _CNV_P_2_A_I_5_CM_S2 1 0 0 255 ECU_ADDRESS 0xFFF914FB /end MEASUREMENT
/begin MEASUREMENT S_KF_MODAFB_LAEUFT "" UBYTE _CNV_P_2_A_I_5_CM_S2 1 0 0 255 ECU_ADDRESS 0xFFF914FC /end MEASUREMENT
/begin MEASUREMENT S_KF_RSU_MODAFB "" UBYTE _CNV_P_2_A_I_5_CM_S2 1 0 0 255 ECU_ADDRESS 0xFFF914FD /end MEASUREMENT
/begin MEASUREMENT S_KF_TINLRN_MODAFB "" UBYTE _CNV_P_2_A_I_5_CM_S2 1 0 0 255 ECU_ADDRESS 0xFFF914FE /end MEASUREMENT
/begin MEASUREMENT S_MODAFB_ERK "" UBYTE _CNV_P_2_A_I_5_CM_S2 1 0 0 255 ECU_ADDRESS 0xFFF91758 /end MEASUREMENT
/begin MEASUREMENT S_RSSEQ_AKTIV_MAB "" UBYTE _CNV_P_2_A_I_5_CM_S2 1 0 0 255 ECU_ADDRESS 0xFFF91759 /end MEASUREMENT
/begin MEASUREMENT S_WKV_MAB "" UBYTE _CNV_P_2_A_I_5_CM_S2 1 0 0 255 ECU_ADDRESS 0xFFF9175A /end MEASUREMENT
/begin MEASUREMENT T_BESCHL_MODAFB "" SLONG _CNV_R_R_Umr_1_zu_1_6_CM_S2 1 0 -2147483648 2147483647 FORMAT "%2.0" ECU_ADDRESS 0xFFF902B4 /end MEASUREMENT
/begin MEASUREMENT T_BETRBEREINMODAFB "" SLONG _CNV_R_R_Umr_1_zu_1_6_CM_S2 1 0 -2147483648 2147483647 FORMAT "%2.0" ECU_ADDRESS 0xFFF902B8 /end MEASUREMENT
/begin MEASUREMENT T_BUFFER_BESCHLMODAFB "" ULONG _CNV_R_R_Umr_1_zu_1_6_CM_S2 1 0 0 4294967295 FORMAT "%2.0" ECU_ADDRESS 0xFFF902BC /end MEASUREMENT
/begin MEASUREMENT T_BUFFER_BETRBEREINMODAFB "" ULONG _CNV_R_R_Umr_1_zu_1_6_CM_S2 1 0 0 4294967295 FORMAT "%2.0" ECU_ADDRESS 0xFFF902C0 /end MEASUREMENT
/begin MEASUREMENT T_BUFFER_KFINITMODAFB "" ULONG _CNV_R_R_Umr_1_zu_1_6_CM_S2 1 0 0 4294967295 FORMAT "%2.0" ECU_ADDRESS 0xFFF902C4 /end MEASUREMENT
/begin MEASUREMENT T_BUFFER_KFMODAFB "" ULONG _CNV_R_R_Umr_1_zu_1_6_CM_S2 1 0 0 4294967295 FORMAT "%2.0" ECU_ADDRESS 0xFFF902C8 /end MEASUREMENT
/begin MEASUREMENT T_BUFFER_MAB "" ULONG _CNV_R_R_Umr_1_zu_1_6_CM_S2 1 0 0 4294967295 FORMAT "%2.0" ECU_ADDRESS 0xFFF90854 /end MEASUREMENT
/begin MEASUREMENT T_INIT_DONE "" UWORD _CNV_P_2_A_I_68_CM_S2 1 0 0 65535 ECU_ADDRESS 0xFFF90D78 /end MEASUREMENT
/begin MEASUREMENT T_KFINIT_MODAFB "" SLONG _CNV_R_R_Umr_1_zu_1_6_CM_S2 1 0 -2147483648 2147483647 FORMAT "%2.0" ECU_ADDRESS 0xFFF902CC /end MEASUREMENT
/begin MEASUREMENT T_KF_MODAFB "" SLONG _CNV_R_R_Umr_1_zu_1_6_CM_S2 1 0 -2147483648 2147483647 FORMAT "%2.0" ECU_ADDRESS 0xFFF902D0 /end MEASUREMENT
/begin MEASUREMENT T_MAB "" SLONG _CNV_R_R_Umr_1_zu_1_6_CM_S2 1 0 -2147483647 2147483647 FORMAT "%2.0" ECU_ADDRESS 0xFFF90858 /end MEASUREMENT
/begin MEASUREMENT V_FZG_ALTMODAFB "" UWORD _CNV_R_R_Umr_1_zu_1_8_CM_S2 1 0 0 400 FORMAT "%2.0" ECU_ADDRESS 0xFFF90D7A /end MEASUREMENT
/begin MEASUREMENT Z_GANG_RSU "" UBYTE _CNV_S_9_Enum_EGANG_30_CM_S2 1 0 0 8 ECU_ADDRESS 0xFFF9175B /end MEASUREMENT
/begin MEASUREMENT Z_WK_SOLL "" UBYTE _CNV_S_3_Enum_EWK_153_CM_S2 1 0 0 2 ECU_ADDRESS 0xFFF91216 /end MEASUREMENT
/begin MEASUREMENT FUNKINIT_DONE_DYNDZMEGS "" UBYTE _CNV_R_R_Umr_1_zu_1_2_CM_S2 1 0 0 1 ECU_ADDRESS 0xFFF9145A /end MEASUREMENT
/begin MEASUREMENT N_DYNDZM "" UWORD _CNV_R_R_Umr_1_zu_1_3_CM_S2 1 0 0 10000 FORMAT "%2.0" ECU_ADDRESS 0xFFF90CC4 /end MEASUREMENT
/begin MEASUREMENT S_DYNDZM "" UBYTE _CNV_P_2_A_I_5_CM_S2 1 0 0 255 ECU_ADDRESS 0xFFF9145B /end MEASUREMENT
/begin MEASUREMENT S_DYNDZM_FFG "" UBYTE _CNV_P_2_A_I_5_CM_S2 1 0 0 255 ECU_ADDRESS 0xFFF9145C /end MEASUREMENT
/begin MEASUREMENT Z_GANG_ZIEL_DYNDZM_ALT "" UBYTE _CNV_S_9_Enum_EGANG_30_CM_S2 1 0 0 8 ECU_ADDRESS 0xFFF9145D /end MEASUREMENT
/begin MEASUREMENT DN_WK_DYNDZM "" SWORD _CNV_R_R_Umr_1_zu_1_3_CM_S2 1 0 0 5000 FORMAT "%2.0" ECU_ADDRESS 0xFFF90C9A /end MEASUREMENT
/begin MEASUREMENT GN_DYNDZM_BER "" SWORD _CNV_R_R_Umr_1_zu_1_163_CM_S2 1 0 0 200 FORMAT "%2.0" ECU_ADDRESS 0xFFF90C9E /end MEASUREMENT
/begin MEASUREMENT GN_DYNDZM_SCHALTUNG "" SWORD _CNV_R_R_Umr_1_zu_1_163_CM_S2 1 0 0 200 FORMAT "%2.0" ECU_ADDRESS 0xFFF90CA0 /end MEASUREMENT
/begin MEASUREMENT N_DYNDZMRE_BER "" UWORD _CNV_R_R_Umr_1_zu_1_3_CM_S2 1 0 0 10000 FORMAT "%2.0" ECU_ADDRESS 0xFFF90CC0 /end MEASUREMENT
/begin MEASUREMENT N_DYNDZMRE_MOD "" UWORD _CNV_R_R_Umr_1_zu_1_3_CM_S2 1 0 0 10000 FORMAT "%2.0" ECU_ADDRESS 0xFFF90CC2 /end MEASUREMENT
/begin MEASUREMENT N_DYNDZM_ALT "" UWORD _CNV_R_R_Umr_1_zu_1_3_CM_S2 1 0 0 10000 FORMAT "%2.0" ECU_ADDRESS 0xFFF90CA2 /end MEASUREMENT
/begin MEASUREMENT N_DYNDZM_DEBUG "" UWORD _CNV_R_R_Umr_1_zu_1_3_CM_S2 1 0 0 10000 FORMAT "%2.0" ECU_ADDRESS 0xFFF90CA4 /end MEASUREMENT
/begin MEASUREMENT N_DYNDZM_FILT "" UWORD _CNV_R_R_Umr_1_zu_1_3_CM_S2 1 0 0 10000 FORMAT "%2.0" ECU_ADDRESS 0xFFF90CA6 /end MEASUREMENT
/begin MEASUREMENT N_DYNDZM_FILT_MAX "" UWORD _CNV_R_R_Umr_1_zu_1_3_CM_S2 1 0 0 10000 FORMAT "%2.0" ECU_ADDRESS 0xFFF90CA8 /end MEASUREMENT
/begin MEASUREMENT N_DYNDZM_PT1FILT "" SWORD _CNV_R_R_Umr_1_zu_1_3_CM_S2 1 0 0 10000 FORMAT "%2.0" ECU_ADDRESS 0xFFF90CAA /end MEASUREMENT
/begin MEASUREMENT N_DYNDZM_REKFILT "" ULONG _CNV_R_R_Umr_1_zu_1_3_CM_S2 1 0 0 10000 FORMAT "%2.0" ECU_ADDRESS 0xFFF901F4 /end MEASUREMENT
/begin MEASUREMENT SCHT_WARTE_DYNDZM "" UWORD _CNV_R_R_Umr_1_zu_1_6_CM_S2 1 0 0 2000 FORMAT "%2.0" ECU_ADDRESS 0xFFF90CAC /end MEASUREMENT
/begin MEASUREMENT S_FREEZE_DYNDZM "" UBYTE _CNV_P_2_A_I_5_CM_S2 1 0 0 255 ECU_ADDRESS 0xFFF9143A /end MEASUREMENT
/begin MEASUREMENT S_GN_DYNDZM "" UBYTE _CNV_R_R_Umr_1_zu_1_2_CM_S2 1 0 0 255 ECU_ADDRESS 0xFFF9143B /end MEASUREMENT
/begin MEASUREMENT S_MINUS_DYNDZM "" UBYTE _CNV_P_2_A_I_5_CM_S2 1 0 0 255 ECU_ADDRESS 0xFFF9143C /end MEASUREMENT
/begin MEASUREMENT S_PLUS_DYNDZM "" UBYTE _CNV_P_2_A_I_5_CM_S2 1 0 0 255 ECU_ADDRESS 0xFFF9143D /end MEASUREMENT
/begin MEASUREMENT S_SCHALTUNG_MANUELL_DYNDZM "" UBYTE _CNV_P_2_A_I_5_CM_S2 1 0 0 255 ECU_ADDRESS 0xFFF9143E /end MEASUREMENT
/begin MEASUREMENT T_ANGLEICH_DYNDZM "" UWORD _CNV_R_R_Umr_1_zu_1_6_CM_S2 1 0 0 2000 FORMAT "%2.0" ECU_ADDRESS 0xFFF90CAE /end MEASUREMENT
/begin MEASUREMENT T_DYNDZM_FFG "" UWORD _CNV_R_R_Umr_1_zu_1_6_CM_S2 1 0 0 1000 FORMAT "%2.0" ECU_ADDRESS 0xFFF90CB0 /end MEASUREMENT
/begin MEASUREMENT T_FOLGESCHALTUNG_DYNDZM "" UWORD _CNV_R_R_Umr_1_zu_1_6_CM_S2 1 0 0 10000 FORMAT "%2.0" ECU_ADDRESS 0xFFF90CB2 /end MEASUREMENT
/begin MEASUREMENT T_FREEZE_DYNDZM "" UWORD _CNV_R_R_Umr_1_zu_1_6_CM_S2 1 0 0 65000 FORMAT "%2.0" ECU_ADDRESS 0xFFF90CB4 /end MEASUREMENT
/begin MEASUREMENT T_ND_DYNDZM "" UWORD _CNV_R_R_Umr_1_zu_1_6_CM_S2 1 0 0 10000 FORMAT "%2.0" ECU_ADDRESS 0xFFF90CB6 /end MEASUREMENT
/begin MEASUREMENT T_SEGELN_FOLGE_DYNDZM "" UWORD _CNV_R_R_Umr_1_zu_1_6_CM_S2 1 0 0 10000 FORMAT "%2.0" ECU_ADDRESS 0xFFF90CB8 /end MEASUREMENT
/begin MEASUREMENT T_WARTE_DYNDZM "" UWORD _CNV_R_R_Umr_1_zu_1_6_CM_S2 1 0 0 2000 FORMAT "%2.0" ECU_ADDRESS 0xFFF90CBA /end MEASUREMENT
/begin MEASUREMENT T_WARTE_SEGELN_DYNDZM "" UWORD _CNV_R_R_Umr_1_zu_1_6_CM_S2 1 0 0 1000 FORMAT "%2.0" ECU_ADDRESS 0xFFF90CBC /end MEASUREMENT
/begin MEASUREMENT T_WARTE_SIMULATE_DYNDZM "" UWORD _CNV_R_R_Umr_1_zu_1_6_CM_S2 1 0 0 10000 FORMAT "%2.0" ECU_ADDRESS 0xFFF90CBE /end MEASUREMENT
/begin MEASUREMENT Z_DNWK_DYNDZM "" UBYTE _CNV_S_8_Enum_EDYND_164_CM_S2 1 0 0 7 ECU_ADDRESS 0xFFF9143F /end MEASUREMENT
/begin MEASUREMENT Z_DYNDZM "" UBYTE _CNV_S_8_Enum_EDYND_165_CM_S2 1 0 0 7 ECU_ADDRESS 0xFFF91440 /end MEASUREMENT
/begin MEASUREMENT Z_DYNDZM_ALT "" UBYTE _CNV_R_R_Umr_1_zu_1_2_CM_S2 1 0 0 255 ECU_ADDRESS 0xFFF91441 /end MEASUREMENT
/begin MEASUREMENT Z_DYNDZM_MASK "" ULONG _CNV_R_R_Umr_1_zu_1_2_CM_S2 1 0 0 4294967295 ECU_ADDRESS 0xFFF901F8 /end MEASUREMENT
/begin MEASUREMENT Z_DYNDZM_SCHALTUNG_MASK "" ULONG _CNV_R_R_Umr_1_zu_1_2_CM_S2 1 0 0 4294967295 ECU_ADDRESS 0xFFF901FC /end MEASUREMENT
/begin MEASUREMENT Z_EFAHREN_DYNDZM "" UBYTE _CNV_S_7_Enum_EDYND_166_CM_S2 1 0 0 6 ECU_ADDRESS 0xFFF91442 /end MEASUREMENT
/begin COMPU_METHOD _CNV_R_R_Umr_1_zu_1_1_CM_S2 "" RAT_FUNC "%6.3" "°C" COEFFS 0 1 0 0 0 1 /end COMPU_METHOD
/begin COMPU_METHOD _CNV_R_R_Umr_1_zu_1_2_CM_S2 "" RAT_FUNC "%6.3" "" COEFFS 0 1 0 0 0 1 /end COMPU_METHOD
/begin COMPU_METHOD _CNV_R_R_Umr_1_zu_1_3_CM_S2 "" RAT_FUNC "%6.3" "U/min" COEFFS 0 1 0 0 0 1 /end COMPU_METHOD
/begin COMPU_METHOD _CNV_S_2_Schalter_A_4_CM_S2 "Schalter: 0 = AUS, 1 = EIN" TAB_VERB "%6.3" "" COMPU_TAB_REF _CNV_S_2_Schalter_A_4_S2 /end COMPU_METHOD
/begin COMPU_METHOD _CNV_P_2_A_I_5_CM_S2 "" TAB_INTP "%6.3" "" COMPU_TAB_REF _CNV_P_2_A_I_5_S2 /end COMPU_METHOD
/begin COMPU_METHOD _CNV_R_R_Umr_1_zu_1_6_CM_S2 "" RAT_FUNC "%6.3" "ms" COEFFS 0 1 0 0 0 1 /end COMPU_METHOD
/begin COMPU_METHOD _CNV_R_R_Umr_1_zu_1_7_CM_S2 "" RAT_FUNC "%6.3" "%/s" COEFFS 0 1 0 0 0 1 /end COMPU_METHOD
/begin COMPU_METHOD _CNV_R_R_Umr_1_zu_1_8_CM_S2 "" RAT_FUNC "%6.3" "km/h" COEFFS 0 1 0 0 0 1 /end COMPU_METHOD
/begin COMPU_METHOD _CNV_R_R_Umr_10_zu__9_CM_S2 "" RAT_FUNC "%6.3" "%" COEFFS 0 10 0 0 0 1 /end COMPU_METHOD
/begin COMPU_METHOD _CNV_S_6_Enum_EDL_11_CM_S2 "" TAB_VERB "%6.3" "" COMPU_TAB_REF _CNV_S_6_Enum_EDL_11_S2 /end COMPU_METHOD
/begin COMPU_METHOD _CNV_S_4_Enum_EADAS_13_CM_S2 "" TAB_VERB "%6.3" "" COMPU_TAB_REF _CNV_S_4_Enum_EADAS_13_S2 /end COMPU_METHOD
/begin COMPU_METHOD _CNV_S_4_Enum_EAGS__24_CM_S2 "" TAB_VERB "%6.3" "" COMPU_TAB_REF _CNV_S_4_Enum_EAGS__24_S2 /end COMPU_METHOD
/begin COMPU_METHOD _CNV_S_2_Enum_EAGS_25_CM_S2 "" TAB_VERB "%6.3" "" COMPU_TAB_REF _CNV_S_2_Enum_EAGS_25_S2 /end COMPU_METHOD
/begin COMPU_METHOD _CNV_S_5_Enum_EBRS__26_CM_S2 "" TAB_VERB "%6.3" "" COMPU_TAB_REF _CNV_S_5_Enum_EBRS__26_S2 /end COMPU_METHOD
/begin COMPU_METHOD _CNV_S_5_Enum_ZDRIV_27_CM_S2 "" TAB_VERB "%6.3" "" COMPU_TAB_REF _CNV_S_5_Enum_ZDRIV_27_S2 /end COMPU_METHOD
/begin COMPU_METHOD _CNV_S_3_Enum_EDSCS_28_CM_S2 "" TAB_VERB "%6.3" "" COMPU_TAB_REF _CNV_S_3_Enum_EDSCS_28_S2 /end COMPU_METHOD
/begin COMPU_METHOD _CNV_S_4_Enum_EFT_29_CM_S2 "" TAB_VERB "%6.3" "" COMPU_TAB_REF _CNV_S_4_Enum_EFT_29_S2 /end COMPU_METHOD
/begin COMPU_METHOD _CNV_S_9_Enum_EGANG_30_CM_S2 "" TAB_VERB "%6.3" "" COMPU_TAB_REF _CNV_S_9_Enum_EGANG_30_S2 /end COMPU_METHOD
/begin COMPU_METHOD _CNV_S_10_Enum_EDMRS_31_CM_S2 "" TAB_VERB "%6.3" "" COMPU_TAB_REF _CNV_S_10_Enum_EDMRS_31_S2 /end COMPU_METHOD
/begin COMPU_METHOD _CNV_S_5_Enum_ETUPE_32_CM_S2 "" TAB_VERB "%6.3" "" COMPU_TAB_REF _CNV_S_5_Enum_ETUPE_32_S2 /end COMPU_METHOD
/begin COMPU_METHOD _CNV_S_100_Enum_EPRIS_34_CM_S2 "" TAB_VERB "%6.3" "" COMPU_TAB_REF _CNV_S_100_Enum_EPRIS_34_S2 /end COMPU_METHOD
/begin COMPU_METHOD _CNV_S_3_Enum_EPROG_37_CM_S2 "" TAB_VERB "%6.3" "" COMPU_TAB_REF _CNV_S_3_Enum_EPROG_37_S2 /end COMPU_METHOD
/begin COMPU_METHOD _CNV_S_21_Enum_EPROG_40_CM_S2 "" TAB_VERB "%6.3" "" COMPU_TAB_REF _CNV_S_21_Enum_EPROG_40_S2 /end COMPU_METHOD
/begin COMPU_METHOD _CNV_R_R_Umr_1_zu_1_42_CM_S2 "" RAT_FUNC "%6.3" "Nm" COEFFS 0 1 0 0 0 1 /end COMPU_METHOD
/begin COMPU_METHOD _CNV_R_R_Umr_10_zu__45_CM_S2 "" RAT_FUNC "%6.3" "" COEFFS 0 10 0 0 0 1 /end COMPU_METHOD
/begin COMPU_METHOD _CNV_R_R_Umr_10_zu__46_CM_S2 "" RAT_FUNC "%6.3" "m/s*s" COEFFS 0 10 0 0 0 1 /end COMPU_METHOD
/begin COMPU_METHOD _CNV_R_R_Umr_10_zu__47_CM_S2 "" RAT_FUNC "%6.3" "1/s*s" COEFFS 0 10 0 0 0 1 /end COMPU_METHOD
/begin COMPU_METHOD _CNV_R_R_Umr_1_zu_1_53_CM_S2 "" RAT_FUNC "%6.3" "%" COEFFS 0 1 0 0 0 1 /end COMPU_METHOD
/begin COMPU_METHOD _CNV_R_R_Umr_100_zu_54_CM_S2 "" RAT_FUNC "%6.3" "" COEFFS 0 100 0 0 0 1 /end COMPU_METHOD
/begin COMPU_METHOD _CNV_S_2_Enum_ECONT_55_CM_S2 "" TAB_VERB "%6.3" "" COMPU_TAB_REF _CNV_S_2_Enum_ECONT_55_S2 /end COMPU_METHOD
/begin COMPU_METHOD _CNV_S_3_Enum_ECONT_56_CM_S2 "" TAB_VERB "%6.3" "" COMPU_TAB_REF _CNV_S_3_Enum_ECONT_56_S2 /end COMPU_METHOD
/begin COMPU_METHOD _CNV_R_R_Umr_1000_z_57_CM_S2 "" RAT_FUNC "%6.3" "" COEFFS 0 1000 0 0 0 1 /end COMPU_METHOD
/begin COMPU_METHOD _CNV_S_2_Enum_EBABF_58_CM_S2 "" TAB_VERB "%6.3" "" COMPU_TAB_REF _CNV_S_2_Enum_EBABF_58_S2 /end COMPU_METHOD
/begin COMPU_METHOD _CNV_S_3_Enum_EBAB_59_CM_S2 "" TAB_VERB "%6.3" "" COMPU_TAB_REF _CNV_S_3_Enum_EBAB_59_S2 /end COMPU_METHOD
/begin COMPU_METHOD _CNV_S_6_Enum_EBERG_61_CM_S2 "" TAB_VERB "%6.3" "" COMPU_TAB_REF _CNV_S_6_Enum_EBERG_61_S2 /end COMPU_METHOD
/begin COMPU_METHOD _CNV_S_5_Enum_EFT2_67_CM_S2 "" TAB_VERB "%6.3" "" COMPU_TAB_REF _CNV_S_5_Enum_EFT2_67_S2 /end COMPU_METHOD
/begin COMPU_METHOD _CNV_P_2_A_I_68_CM_S2 "" TAB_INTP "%6.3" "" COMPU_TAB_REF _CNV_P_2_A_I_68_S2 /end COMPU_METHOD
/begin COMPU_METHOD _CNV_S_4_Enum_EPROG_70_CM_S2 "" TAB_VERB "%6.3" "" COMPU_TAB_REF _CNV_S_4_Enum_EPROG_70_S2 /end COMPU_METHOD
/begin COMPU_METHOD _CNV_S_4_Enum_EGB_71_CM_S2 "" TAB_VERB "%6.3" "" COMPU_TAB_REF _CNV_S_4_Enum_EGB_71_S2 /end COMPU_METHOD
/begin COMPU_METHOD _CNV_S_3_Enum_ESCHL_72_CM_S2 "" TAB_VERB "%6.3" "" COMPU_TAB_REF _CNV_S_3_Enum_ESCHL_72_S2 /end COMPU_METHOD
/begin COMPU_METHOD _CNV_S_3_Enum_ELDM_76_CM_S2 "" TAB_VERB "%6.3" "" COMPU_TAB_REF _CNV_S_3_Enum_ELDM_76_S2 /end COMPU_METHOD
/begin COMPU_METHOD _CNV_R_R_Umr_1_zu_1_77_CM_S2 "" RAT_FUNC "%6.3" "Nm/s" COEFFS 0 1 0 0 0 10 /end COMPU_METHOD
/begin COMPU_METHOD _CNV_R_R_Umr_8000_z_78_CM_S2 "" RAT_FUNC "%6.3" "" COEFFS 0 8000 0 0 0 1 /end COMPU_METHOD
/begin COMPU_METHOD _CNV_S_3_Enum_EQ_79_CM_S2 "" TAB_VERB "%6.3" "" COMPU_TAB_REF _CNV_S_3_Enum_EQ_79_S2 /end COMPU_METHOD
/begin COMPU_METHOD _CNV_S_7_Enum_ELDMM_80_CM_S2 "" TAB_VERB "%6.3" "" COMPU_TAB_REF _CNV_S_7_Enum_ELDMM_80_S2 /end COMPU_METHOD
/begin COMPU_METHOD _CNV_S_3_Enum_ELDM__81_CM_S2 "" TAB_VERB "%6.3" "" COMPU_TAB_REF _CNV_S_3_Enum_ELDM__81_S2 /end COMPU_METHOD
/begin COMPU_METHOD _CNV_S_14_Enum_EGANG_88_CM_S2 "Ganganzeige" TAB_VERB "%6.3" "" COMPU_TAB_REF _CNV_S_14_Enum_EGANG_88_S2 /end COMPU_METHOD
/begin COMPU_METHOD _CNV_S_11_Enum_EGANG_89_CM_S2 "" TAB_VERB "%6.3" "" COMPU_TAB_REF _CNV_S_11_Enum_EGANG_89_S2 /end COMPU_METHOD
/begin COMPU_METHOD _CNV_S_10_Enum_EGANG_90_CM_S2 "" TAB_VERB "%6.3" "" COMPU_TAB_REF _CNV_S_10_Enum_EGANG_90_S2 /end COMPU_METHOD
/begin COMPU_METHOD _CNV_S_12_Enum_EK0_S_91_CM_S2 "" TAB_VERB "%6.3" "" COMPU_TAB_REF _CNV_S_12_Enum_EK0_S_91_S2 /end COMPU_METHOD
/begin COMPU_METHOD _CNV_S_3_Enum_ECOMP_92_CM_S2 "Status der Steigungsverlust-Kompensation" TAB_VERB "%6.3" "" COMPU_TAB_REF _CNV_S_3_Enum_ECOMP_92_S2 /end COMPU_METHOD
/begin COMPU_METHOD _CNV_S_4_Enum_EKOMB_93_CM_S2 "" TAB_VERB "%6.3" "" COMPU_TAB_REF _CNV_S_4_Enum_EKOMB_93_S2 /end COMPU_METHOD
/begin COMPU_METHOD _CNV_S_16_Enum_EPROG_94_CM_S2 "" TAB_VERB "%6.3" "" COMPU_TAB_REF _CNV_S_16_Enum_EPROG_94_S2 /end COMPU_METHOD
/begin COMPU_METHOD _CNV_S_4_Enum_EEXCF_101_CM_S2 "" TAB_VERB "%6.3" "" COMPU_TAB_REF _CNV_S_4_Enum_EEXCF_101_S2 /end COMPU_METHOD
/begin COMPU_METHOD _CNV_S_4_Enum_EDKFI_105_CM_S2 "" TAB_VERB "%6.3" "" COMPU_TAB_REF _CNV_S_4_Enum_EDKFI_105_S2 /end COMPU_METHOD
/begin COMPU_METHOD _CNV_S_4_Enum_EDKFI_106_CM_S2 "" TAB_VERB "%6.3" "" COMPU_TAB_REF _CNV_S_4_Enum_EDKFI_106_S2 /end COMPU_METHOD
/begin COMPU_METHOD _CNV_S_9_Enum_EFKTE_107_CM_S2 "" TAB_VERB "%6.3" "" COMPU_TAB_REF _CNV_S_9_Enum_EFKTE_107_S2 /end COMPU_METHOD
/begin COMPU_METHOD _CNV_S_6_Enum_ENABH_108_CM_S2 "" TAB_VERB "%6.3" "" COMPU_TAB_REF _CNV_S_6_Enum_ENABH_108_S2 /end COMPU_METHOD
/begin COMPU_METHOD _CNV_S_4_Enum_EPOSB_109_CM_S2 "" TAB_VERB "%6.3" "" COMPU_TAB_REF _CNV_S_4_Enum_EPOSB_109_S2 /end COMPU_METHOD
/begin COMPU_METHOD _CNV_S_2_Enum_EHDC__114_CM_S2 "" TAB_VERB "%6.3" "" COMPU_TAB_REF _CNV_S_2_Enum_EHDC__114_S2 /end COMPU_METHOD
/begin COMPU_METHOD _CNV_S_3_Enum_ELDMA_116_CM_S2 "" TAB_VERB "%6.3" "" COMPU_TAB_REF _CNV_S_3_Enum_ELDMA_116_S2 /end COMPU_METHOD
/begin COMPU_METHOD _CNV_S_8_Enum_EHSUB_119_CM_S2 "" TAB_VERB "%6.3" "" COMPU_TAB_REF _CNV_S_8_Enum_EHSUB_119_S2 /end COMPU_METHOD
/begin COMPU_METHOD _CNV_S_4_Enum_EHSUR_121_CM_S2 "" TAB_VERB "%6.3" "" COMPU_TAB_REF _CNV_S_4_Enum_EHSUR_121_S2 /end COMPU_METHOD
/begin COMPU_METHOD _CNV_R_R_Umr_1_zu_1_123_CM_S2 "" RAT_FUNC "%6.3" "m" COEFFS 0 1 0 0 0 1 /end COMPU_METHOD
/begin COMPU_METHOD _CNV_S_5_Enum_EGWFP_128_CM_S2 "" TAB_VERB "%6.3" "" COMPU_TAB_REF _CNV_S_5_Enum_EGWFP_128_S2 /end COMPU_METHOD
/begin COMPU_METHOD _CNV_S_3_Enum_EHSUA_129_CM_S2 "" TAB_VERB "%6.3" "" COMPU_TAB_REF _CNV_S_3_Enum_EHSUA_129_S2 /end COMPU_METHOD
/begin COMPU_METHOD _CNV_S_2_Enum_EFP_D_130_CM_S2 "" TAB_VERB "%6.3" "" COMPU_TAB_REF _CNV_S_2_Enum_EFP_D_130_S2 /end COMPU_METHOD
/begin COMPU_METHOD _CNV_R_R_Umr_1_zu_1_131_CM_S2 "" RAT_FUNC "%6.3" "°/s" COEFFS 0 1 0 0 0 1 /end COMPU_METHOD
/begin COMPU_METHOD _CNV_R_R_Umr_1_zu_1_132_CM_S2 "" RAT_FUNC "%6.3" "usec" COEFFS 0 1 0 0 0 1 /end COMPU_METHOD
/begin COMPU_METHOD _CNV_S_3_Enum_EHSU__133_CM_S2 "" TAB_VERB "%6.3" "" COMPU_TAB_REF _CNV_S_3_Enum_EHSU__133_S2 /end COMPU_METHOD
/begin COMPU_METHOD _CNV_S_3_Enum_EHSUR_134_CM_S2 "" TAB_VERB "%6.3" "" COMPU_TAB_REF _CNV_S_3_Enum_EHSUR_134_S2 /end COMPU_METHOD
/begin COMPU_METHOD _CNV_S_3_Enum_EHSUR_135_CM_S2 "" TAB_VERB "%6.3" "" COMPU_TAB_REF _CNV_S_3_Enum_EHSUR_135_S2 /end COMPU_METHOD
/begin COMPU_METHOD _CNV_S_3_Enum_EHSUR_136_CM_S2 "" TAB_VERB "%6.3" "" COMPU_TAB_REF _CNV_S_3_Enum_EHSUR_136_S2 /end COMPU_METHOD
/begin COMPU_METHOD _CNV_S_3_Enum_EHSUR_137_CM_S2 "" TAB_VERB "%6.3" "" COMPU_TAB_REF _CNV_S_3_Enum_EHSUR_137_S2 /end COMPU_METHOD
/begin COMPU_METHOD _CNV_R_R_Umr_1_zu_1_138_CM_S2 "" RAT_FUNC "%6.3" "°" COEFFS 0 1 0 0 0 1 /end COMPU_METHOD
/begin COMPU_METHOD _CNV_S_4_Enum_ESOCM_142_CM_S2 "Status SOC MODE" TAB_VERB "%6.3" "" COMPU_TAB_REF _CNV_S_4_Enum_ESOCM_142_S2 /end COMPU_METHOD
/begin COMPU_METHOD _CNV_S_4_Enum_EMODU_144_CM_S2 "" TAB_VERB "%6.3" "" COMPU_TAB_REF _CNV_S_4_Enum_EMODU_144_S2 /end COMPU_METHOD
/begin COMPU_METHOD _CNV_S_3_Enum_EWK_153_CM_S2 "" TAB_VERB "%6.3" "" COMPU_TAB_REF _CNV_S_3_Enum_EWK_153_S2 /end COMPU_METHOD
/begin COMPU_METHOD _CNV_R_R_Umr_1_zu_1_163_CM_S2 "" RAT_FUNC "%6.3" "1/s²" COEFFS 0 1 0 0 0 1 /end COMPU_METHOD
/begin COMPU_METHOD _CNV_S_8_Enum_EDYND_164_CM_S2 "" TAB_VERB "%6.3" "" COMPU_TAB_REF _CNV_S_8_Enum_EDYND_164_S2 /end COMPU_METHOD
/begin COMPU_METHOD _CNV_S_8_Enum_EDYND_165_CM_S2 "" TAB_VERB "%6.3" "" COMPU_TAB_REF _CNV_S_8_Enum_EDYND_165_S2 /end COMPU_METHOD
/begin COMPU_METHOD _CNV_S_7_Enum_EDYND_166_CM_S2 "" TAB_VERB "%6.3" "" COMPU_TAB_REF _CNV_S_7_Enum_EDYND_166_S2 /end COMPU_METHOD
/begin COMPU_METHOD _CNV_R_R_Umr_10_zu__181_CM_S2 "" RAT_FUNC "%6.3" "1/s²" COEFFS 0 10 0 0 0 1 /end COMPU_METHOD
/begin COMPU_METHOD _CNV_S_3_Enum_EEFAH_251_CM_S2 "" TAB_VERB "%6.3" "" COMPU_TAB_REF _CNV_S_3_Enum_EEFAH_251_S2 /end COMPU_METHOD
/begin COMPU_METHOD _CNV_S_9_Enum_EARSS_315_CM_S2 "" TAB_VERB "%6.3" "" COMPU_TAB_REF _CNV_S_9_Enum_EARSS_315_S2 /end COMPU_METHOD
/begin COMPU_METHOD _CNV_S_10_Enum_EDBMT_317_CM_S2 "" TAB_VERB "%6.3" "" COMPU_TAB_REF _CNV_S_10_Enum_EDBMT_317_S2 /end COMPU_METHOD
/begin COMPU_METHOD _CNV_S_5_Enum_REKUP_320_CM_S2 "" TAB_VERB "%6.3" "" COMPU_TAB_REF _CNV_S_5_Enum_REKUP_320_S2 /end COMPU_METHOD
/begin COMPU_METHOD _CNV_S_2_Enum_ELOWH_321_CM_S2 "" TAB_VERB "%6.3" "" COMPU_TAB_REF _CNV_S_2_Enum_ELOWH_321_S2 /end COMPU_METHOD
/begin COMPU_METHOD _CNV_S_3_Enum_EIDX0_325_CM_S2 "" TAB_VERB "%6.3" "" COMPU_TAB_REF _CNV_S_3_Enum_EIDX0_325_S2 /end COMPU_METHOD
/begin COMPU_METHOD _CNV_S_16_Enum_EMAXR_326_CM_S2 "" TAB_VERB "%6.3" "" COMPU_TAB_REF _CNV_S_16_Enum_EMAXR_326_S2 /end COMPU_METHOD
/begin COMPU_METHOD _CNV_S_16_Enum_EMINR_327_CM_S2 "" TAB_VERB "%6.3" "" COMPU_TAB_REF _CNV_S_16_Enum_EMINR_327_S2 /end COMPU_METHOD
/begin COMPU_METHOD _CNV_S_4_Enum_EIDX_328_CM_S2 "" TAB_VERB "%6.3" "" COMPU_TAB_REF _CNV_S_4_Enum_EIDX_328_S2 /end COMPU_METHOD
/begin COMPU_METHOD _CNV_S_3_Enum_ESOUR_333_CM_S2 "" TAB_VERB "%6.3" "" COMPU_TAB_REF _CNV_S_3_Enum_ESOUR_333_S2 /end COMPU_METHOD
/begin COMPU_METHOD _CNV_S_3_Enum_DLBAS_334_CM_S2 "" TAB_VERB "%6.3" "" COMPU_TAB_REF _CNV_S_3_Enum_DLBAS_334_S2 /end COMPU_METHOD
/begin COMPU_METHOD _CNV_S_4_Enum_EDPSV_335_CM_S2 "" TAB_VERB "%6.3" "" COMPU_TAB_REF _CNV_S_4_Enum_EDPSV_335_S2 /end COMPU_METHOD
/begin COMPU_METHOD _CNV_S_4_Enum_ETIDA_336_CM_S2 "" TAB_VERB "%6.3" "" COMPU_TAB_REF _CNV_S_4_Enum_ETIDA_336_S2 /end COMPU_METHOD
/begin COMPU_METHOD _CNV_S_9_Enum_EDMRS_337_CM_S2 "" TAB_VERB "%6.3" "" COMPU_TAB_REF _CNV_S_9_Enum_EDMRS_337_S2 /end COMPU_METHOD
/begin COMPU_METHOD _CNV_S_5_Enum_EDMRS_338_CM_S2 "" TAB_VERB "%6.3" "" COMPU_TAB_REF _CNV_S_5_Enum_EDMRS_338_S2 /end COMPU_METHOD
/begin COMPU_METHOD _CNV_R_R_Umr_1_zu_1_339_CM_S2 "" RAT_FUNC "%6.3" "% von %" COEFFS 0 1 0 0 0 1 /end COMPU_METHOD
/begin COMPU_METHOD _CNV_S_3_Enum_ETEST_344_CM_S2 "" TAB_VERB "%6.3" "" COMPU_TAB_REF _CNV_S_3_Enum_ETEST_344_S2 /end COMPU_METHOD
/begin COMPU_METHOD _CNV_S_3_Enum_EIDX__345_CM_S2 "" TAB_VERB "%6.3" "" COMPU_TAB_REF _CNV_S_3_Enum_EIDX__345_S2 /end COMPU_METHOD
/begin COMPU_METHOD _CNV_S_2_Enum_EMARS_346_CM_S2 "" TAB_VERB "%6.3" "" COMPU_TAB_REF _CNV_S_2_Enum_EMARS_346_S2 /end COMPU_METHOD
/begin COMPU_METHOD _CNV_S_11_Enum_EFKT__348_CM_S2 "" TAB_VERB "%6.3" "" COMPU_TAB_REF _CNV_S_11_Enum_EFKT__348_S2 /end COMPU_METHOD
/begin COMPU_METHOD _CNV_S_2_Enum_EGW_F_349_CM_S2 "" TAB_VERB "%6.3" "" COMPU_TAB_REF _CNV_S_2_Enum_EGW_F_349_S2 /end COMPU_METHOD
/begin COMPU_METHOD _CNV_S_2_Enum_ERS_S_350_CM_S2 "" TAB_VERB "%6.3" "" COMPU_TAB_REF _CNV_S_2_Enum_ERS_S_350_S2 /end COMPU_METHOD
/begin COMPU_METHOD _CNV_S_15_Enum_EPRIS_351_CM_S2 "" TAB_VERB "%6.3" "" COMPU_TAB_REF _CNV_S_15_Enum_EPRIS_351_S2 /end COMPU_METHOD
/begin COMPU_METHOD _CNV_S_4_Enum_Z_EFA_354_CM_S2 "" TAB_VERB "%6.3" "" COMPU_TAB_REF _CNV_S_4_Enum_Z_EFA_354_S2 /end COMPU_METHOD
/begin COMPU_METHOD SAB2_M_10NM_S3_S3 "int = ((phys * 1) / 10) - (0) Nm" RAT_FUNC "%5.3" "Nm" COEFFS 0 1 -0 0 0 10 /end COMPU_METHOD
/begin COMPU_METHOD SAB2_M_15NM_S3_S3 "int = ((phys * 1) / 15) - (0) Nm" RAT_FUNC "%5.3" "Nm" COEFFS 0 1 -0 0 0 15 /end COMPU_METHOD
/begin COMPU_METHOD SAB2_039063PROZENT_S3_S3 "int = ((phys * 100000) / 39063) - (0) %" RAT_FUNC "%5.3" "%" COEFFS 0 100000 -0 0 0 39063 /end COMPU_METHOD
/begin COMPU_METHOD SAB2_05PROZENT_S3_S3 "int = ((phys * 10) / 5) - (0) %" RAT_FUNC "%5.3" "%" COEFFS 0 10 -0 0 0 5 /end COMPU_METHOD
/begin COMPU_METHOD SAB2_M_2NM_M100_S3_S3 "int = ((phys * 1) / 2) - (-50) Nm" RAT_FUNC "%5.3" "Nm" COEFFS 0 1 100 0 0 2 /end COMPU_METHOD
/begin COMPU_METHOD SAB2_M_NM5_S3_S3 "int = ((phys * 5) / 1) - (0) Nm" RAT_FUNC "%5.3" "Nm" COEFFS 0 5 -0 0 0 1 /end COMPU_METHOD
/begin COMPU_METHOD SAB2_M_NM8_S3_S3 "int = ((phys * 8) / 1) - (0) Nm" RAT_FUNC "%5.3" "Nm" COEFFS 0 8 -0 0 0 1 /end COMPU_METHOD
/begin COMPU_METHOD SAB2_N_5RPM_S3_S3 "int = ((phys * 1) / 5) - (0) 1/min" RAT_FUNC "%5.3" "1/min" COEFFS 0 1 -0 0 0 5 /end COMPU_METHOD
/begin COMPU_METHOD SAB2_V_10KMH_S3_S3 "int = ((phys * 1) / 10) - (0) km/h" RAT_FUNC "%5.3" "km/h" COEFFS 0 1 -0 0 0 10 /end COMPU_METHOD
/begin COMPU_METHOD SAB2_V_10KMH_P1_S3_S3 "int = ((phys * 1) / 10) - (1) km/h" RAT_FUNC "%5.3" "km/h" COEFFS 0 1 -10 0 0 10 /end COMPU_METHOD
/begin COMPU_METHOD SAB2_V_1KMH_S3_S3 "int = ((phys * 1) / 1) - (0) km/h" RAT_FUNC "%2.0" "km/h" COEFFS 0 1 -0 0 0 1 /end COMPU_METHOD
/begin COMPU_METHOD SAB2_V_KMH10_S3_S3 "int = ((phys * 10) / 1) - (0) km/h" RAT_FUNC "%5.3" "km/h" COEFFS 0 10 -0 0 0 1 /end COMPU_METHOD
/begin COMPU_METHOD SAB2_V_KMH64_S3_S3 "int = ((phys * 64) / 1) - (0) km/h" RAT_FUNC "%5.3" "km/h" COEFFS 0 64 -0 0 0 1 /end COMPU_METHOD
/begin COMPU_METHOD SAB2_V_KMH100_S3_S3 "int = ((phys * 100) / 1) - (0) km/h" RAT_FUNC "%5.3" "km/h" COEFFS 0 100 -0 0 0 1 /end COMPU_METHOD
/begin COMPU_METHOD SAB2_V_KMH16_S3_S3 "int = ((phys * 16) / 1) - (0) km/h" RAT_FUNC "%5.3" "km/h" COEFFS 0 16 -0 0 0 1 /end COMPU_METHOD
/begin COMPU_METHOD SAB2_V_KMH50_S3_S3 "int = ((phys * 50) / 1) - (0) km/h" RAT_FUNC "%5.3" "km/h" COEFFS 0 50 -0 0 0 1 /end COMPU_METHOD
/begin COMPU_METHOD SAB2_K1024_S3_S3 "int = ((phys * 1024) / 1) - (0) -" RAT_FUNC "%12.10" "-" COEFFS 0 1024 -0 0 0 1 /end COMPU_METHOD
/begin COMPU_METHOD SAB2_K100_KOMP_S3_S3 "int = ((phys * 100) / 1) - (0) -" RAT_FUNC "%5.3" "-" COEFFS 0 100 -0 0 0 1 /end COMPU_METHOD
/begin COMPU_METHOD SAB2_K10_S3_S3 "int = ((phys * 10) / 1) - (0) -" RAT_FUNC "%5.3" "-" COEFFS 0 10 -0 0 0 1 /end COMPU_METHOD
/begin COMPU_METHOD SAB2_K40_S3_S3 "int = ((phys * 40) / 1) - (0) -" RAT_FUNC "%5.3" "-" COEFFS 0 40 -0 0 0 1 /end COMPU_METHOD
/begin COMPU_METHOD SAB2_K128_S3_S3 "int = ((phys * 128) / 1) - (0) -" RAT_FUNC "%5.3" "-" COEFFS 0 128 -0 0 0 1 /end COMPU_METHOD
/begin COMPU_METHOD SAB2_K_M125_S3_S3 "int = ((phys * 1) / 1) - (-125) -" RAT_FUNC "%2.0" "-" COEFFS 0 1 125 0 0 1 /end COMPU_METHOD
/begin COMPU_METHOD SAB2_K_M128_S3_S3 "int = ((phys * 1) / 1) - (-128) -" RAT_FUNC "%2.0" "-" COEFFS 0 1 128 0 0 1 /end COMPU_METHOD
/begin COMPU_METHOD SAB2_2K5_S3_S3 "int = ((phys * 5) / 2) - (0) -" RAT_FUNC "%5.3" "-" COEFFS 0 5 -0 0 0 2 /end COMPU_METHOD
/begin COMPU_METHOD SAB2_1000K4016_M32_S3_S3 "int = ((phys * 4016) / 1000) - (-127) -" RAT_FUNC "%5.3" "-" COEFFS 0 4016 127000 0 0 1000 /end COMPU_METHOD
/begin COMPU_METHOD SAB2_249PROZENT1000_M32_S3_S3 "int = ((phys * 1000) / 249) - (-127) -" RAT_FUNC "%5.3" "-" COEFFS 0 1000 31623 0 0 249 /end COMPU_METHOD
/begin COMPU_METHOD SAB2_M_1NM_M32000_S3_S3 "int = ((phys * 1) / 1) - (-32000) Nm" RAT_FUNC "%2.0" "Nm" COEFFS 0 1 32000 0 0 1 /end COMPU_METHOD
/begin COMPU_METHOD SAB2_KM_10_S3_S3 "int = ((phys * 1) / 10) - (0) km" RAT_FUNC "%5.3" "km" COEFFS 0 1 -0 0 0 10 /end COMPU_METHOD
/begin COMPU_METHOD SAB2_DISTSENS_S3_S3 "int = ((phys * 256) / 1) - (0) mm" RAT_FUNC "%5.3" "mm" COEFFS 0 256 -0 0 0 1 /end COMPU_METHOD
/begin COMPU_METHOD SAB2_NG_100RPM_S3_S3 "int = ((phys * 1) / 100) - (0) 100rpm/sec" RAT_FUNC "%5.3" "100rpm/sec" COEFFS 0 1 -0 0 0 100 /end COMPU_METHOD
/begin COMPU_METHOD SAB2_A_981G10000_M127_S3_S3 "int = ((phys * 1.0E6) / 981) - (-1295) g" RAT_FUNC "%8.6" "g" COEFFS 0 1000000 1270395 0 0 981 /end COMPU_METHOD
/begin COMPU_METHOD SAB2_P_BAR10_S3_S3 "int = ((phys * 10) / 1) - (0) bar" RAT_FUNC "%5.3" "bar" COEFFS 0 10 -0 0 0 1 /end COMPU_METHOD
/begin COMPU_METHOD SAB2_N_50RPM_S3_S3 "int = ((phys * 1) / 50) - (0) 1/min" RAT_FUNC "%5.3" "1/min" COEFFS 0 1 -0 0 0 50 /end COMPU_METHOD
/begin COMPU_METHOD SAB2_N_64RPM_S3_S3 "int = ((phys * 1) / 64) - (0) 1/min" RAT_FUNC "%5.3" "1/min" COEFFS 0 1 -0 0 0 64 /end COMPU_METHOD
/begin COMPU_METHOD SAB2_I_1A_S3_S3 "int = ((phys * 1) / 1) - (0) A" RAT_FUNC "%2.0" "A" COEFFS 0 1 -0 0 0 1 /end COMPU_METHOD
/begin COMPU_METHOD SAB2_T_10MS_S3_S3 "int = ((phys * 1) / 10) - (0) ms" RAT_FUNC "%5.3" "ms" COEFFS 0 1 -0 0 0 10 /end COMPU_METHOD
/begin COMPU_METHOD SAB2_T_MIN60000_S3_S3 "int = ((phys * 60000) / 1) - (0) min" RAT_FUNC "%23.21" "min" COEFFS 0 60000 -0 0 0 1 /end COMPU_METHOD
/begin COMPU_METHOD SAB2_U_1VOLT1000_S3_S3 "int = ((phys * 1000) / 1) - (0) Volt" RAT_FUNC "%5.3" "Volt" COEFFS 0 1000 -0 0 0 1 /end COMPU_METHOD
/begin COMPU_METHOD SAB2_U_1VOLT_S3_S3 "int = ((phys * 1) / 1) - (0) Volt" RAT_FUNC "%2.0" "Volt" COEFFS 0 1 -0 0 0 1 /end COMPU_METHOD
/begin COMPU_METHOD SAB2_M_37NM100_M12124_S3_S3 "int = ((phys * 100) / 37) - (-32768) Nm" RAT_FUNC "%5.3" "Nm" COEFFS 0 100 1212416 0 0 37 /end COMPU_METHOD
/begin COMPU_METHOD SAB2_M_592NM100_M12124_S3_S3 "int = ((phys * 100) / 592) - (-2048) Nm" RAT_FUNC "%5.3" "Nm" COEFFS 0 100 1212416 0 0 592 /end COMPU_METHOD
/begin COMPU_METHOD SAB2_M_NM2_M800_S3_S3 "int = ((phys * 2) / 1) - (-800) Nm" RAT_FUNC "%5.3" "Nm" COEFFS 0 2 800 0 0 1 /end COMPU_METHOD
/begin COMPU_METHOD SAB2_M_NM4_M2000_S3_S3 "int = ((phys * 4) / 1) - (-2000) Nm" RAT_FUNC "%5.3" "Nm" COEFFS 0 4 2000 0 0 1 /end COMPU_METHOD
/begin COMPU_METHOD SAB2_M_NM_M500_S3_S3 "int = ((phys * 1) / 1) - (-500) Nm" RAT_FUNC "%2.0" "Nm" COEFFS 0 1 500 0 0 1 /end COMPU_METHOD
/begin COMPU_METHOD SAB2_0025PROZENT_S3_S3 "int = ((phys * 1000) / 25) - (0) %" RAT_FUNC "%5.3" "%" COEFFS 0 1000 -0 0 0 25 /end COMPU_METHOD
/begin COMPU_METHOD SAB2_0125PROZENT_S3_S3 "int = ((phys * 1000) / 125) - (0) %" RAT_FUNC "%5.3" "%" COEFFS 0 1000 -0 0 0 125 /end COMPU_METHOD
/begin COMPU_METHOD SAB2_100PROZENT255_S3_S3 "int = ((phys * 255) / 100) - (0) %" RAT_FUNC "%5.3" "%" COEFFS 0 255 -0 0 0 100 /end COMPU_METHOD
/begin COMPU_METHOD SAB2_100PROZENT254_S3_S3 "int = ((phys * 254) / 100) - (0) %" RAT_FUNC "%5.3" "%" COEFFS 0 254 -0 0 0 100 /end COMPU_METHOD
/begin COMPU_METHOD SAB2_I_MA10_S3_S3 "int = ((phys * 10) / 1) - (0) mA" RAT_FUNC "%5.3" "mA" COEFFS 0 10 -0 0 0 1 /end COMPU_METHOD
/begin COMPU_METHOD SAB2_249PROZENT1000_M127_S3_S3 "int = ((phys * 1000) / 249) - (-127) %" RAT_FUNC "%5.3" "%" COEFFS 0 1000 31623 0 0 249 /end COMPU_METHOD
/begin COMPU_METHOD SAB2_M_NM_M1023_S3_S3 "int = ((phys * 1) / 1) - (-1023) Nm" RAT_FUNC "%2.0" "Nm" COEFFS 0 1 1023 0 0 1 /end COMPU_METHOD
/begin COMPU_METHOD SAB2_M_NM_M511_S3_S3 "int = ((phys * 1) / 1) - (-511) Nm" RAT_FUNC "%2.0" "Nm" COEFFS 0 1 511 0 0 1 /end COMPU_METHOD
/begin COMPU_METHOD SAB2_M_NM_M100_S3_S3 "int = ((phys * 1) / 1) - (-100) Nm" RAT_FUNC "%2.0" "Nm" COEFFS 0 1 100 0 0 1 /end COMPU_METHOD
/begin COMPU_METHOD SAB2_1PROZENT_M100_S3_S3 "int = ((phys * 1) / 1) - (-100) %" RAT_FUNC "%2.0" "%" COEFFS 0 1 100 0 0 1 /end COMPU_METHOD
/begin COMPU_METHOD SAB2_14PROZENT100_S3_S3 "int = ((phys * 14) / 100) - (0) %" RAT_FUNC "%5.3" "%" COEFFS 0 14 -0 0 0 100 /end COMPU_METHOD
/begin COMPU_METHOD SAB2_1PROZENT_M125_S3_S3 "int = ((phys * 1) / 1) - (-125) %" RAT_FUNC "%2.0" "%" COEFFS 0 1 125 0 0 1 /end COMPU_METHOD
/begin COMPU_METHOD EH_C_75CEL100_M64_S5_S3 "int = ((phys * 100) / 75) - (-64) Grad Celsius" RAT_FUNC "%4.2" "Grad Celsius" COEFFS 0 100 4800 0 0 75 /end COMPU_METHOD
/begin COMPU_METHOD EH_C_1CEL_M50_S5_S3 "int = ((phys * 1) / 1) - (-50) Grad Celsius" RAT_FUNC "%2.0" "Grad Celsius" COEFFS 0 1 50 0 0 1 /end COMPU_METHOD
/begin COMPU_METHOD EH_N_RPM8_S5_S3 "int = ((phys * 8) / 1) - (0) 1/min" RAT_FUNC "%4.2" "1/min" COEFFS 0 8 -0 0 0 1 /end COMPU_METHOD
/begin COMPU_METHOD EH_V_KMH50_S5_S3 "int = ((phys * 50) / 1) - (0) km/h" RAT_FUNC "%4.2" "km/h" COEFFS 0 50 -0 0 0 1 /end COMPU_METHOD
/begin COMPU_METHOD EH_V_KMH100_S5_S3 "int = ((phys * 100) / 1) - (0) km/h" RAT_FUNC "%4.2" "km/h" COEFFS 0 100 -0 0 0 1 /end COMPU_METHOD
/begin COMPU_METHOD EH_T_2MS_S5_S3 "int = ((phys * 1) / 2) - (0) ms" RAT_FUNC "%2.0" "ms" COEFFS 0 1 -0 0 0 2 /end COMPU_METHOD
/begin COMPU_METHOD EH_T_5MS_S5_S3 "int = ((phys * 1) / 5) - (0) ms" RAT_FUNC "%2.0" "ms" COEFFS 0 1 -0 0 0 5 /end COMPU_METHOD
/begin COMPU_METHOD EH_T_10MS_S5_S3 "int = ((phys * 1) / 10) - (0) ms" RAT_FUNC "%2.0" "ms" COEFFS 0 1 -0 0 0 10 /end COMPU_METHOD
/begin COMPU_METHOD EH_T_100MS_S5_S3 "int = ((phys * 1) / 100) - (0) ms" RAT_FUNC "%2.0" "ms" COEFFS 0 1 -0 0 0 100 /end COMPU_METHOD
/begin COMPU_METHOD EH_T_S100_S5_S3 "int = ((phys * 100) / 1) - (0) s" RAT_FUNC "%4.2" "s" COEFFS 0 100 -0 0 0 1 /end COMPU_METHOD
/begin COMPU_METHOD EH_P_1MBAR_S5_S3 "int = ((phys * 1) / 1) - (0) mbar" RAT_FUNC "%2.0" "mbar" COEFFS 0 1 -0 0 0 1 /end COMPU_METHOD
/begin COMPU_METHOD EH_P_5MBAR_S5_S3 "int = ((phys * 1) / 5) - (0) mbar" RAT_FUNC "%2.0" "mbar" COEFFS 0 1 -0 0 0 5 /end COMPU_METHOD
/begin COMPU_METHOD EH_P_1KPA_S5_S3 "int = ((phys * 1) / 1) - (0) kPa" RAT_FUNC "%2.0" "kPa" COEFFS 0 1 -0 0 0 1 /end COMPU_METHOD
/begin COMPU_METHOD EH_P_1HPA_S5_S3 "int = ((phys * 1) / 1) - (0) hPa" RAT_FUNC "%2.0" "hPa" COEFFS 0 1 -0 0 0 1 /end COMPU_METHOD
/begin COMPU_METHOD EH_U_VOLT100_S5_S3 "int = ((phys * 100) / 1) - (0) V" RAT_FUNC "%4.2" "V" COEFFS 0 100 -0 0 0 1 /end COMPU_METHOD
/begin COMPU_METHOD EH_L_KM100_S5_S3 "int = ((phys * 100) / 1) - (0) km" RAT_FUNC "%4.2" "km" COEFFS 0 100 -0 0 0 1 /end COMPU_METHOD
/begin COMPU_METHOD EH_100PROZENT200_S5_S3 "int = ((phys * 200) / 100) - (0) %" RAT_FUNC "%5.3" "%" COEFFS 0 200 -0 0 0 100 /end COMPU_METHOD
/begin COMPU_METHOD EH_31372PROZENT10000_S5_S3 "int = ((phys * 10000) / 31372) - (0) %" RAT_FUNC "%6.4" "%" COEFFS 0 10000 -0 0 0 31372 /end COMPU_METHOD
/begin COMPU_METHOD UMR___1_10000_0_S6_S3 "int = ((phys * 10000) / 1) - (0) [-]" RAT_FUNC "%6.4" "[-]" COEFFS 0 10000 -0 0 0 1 /end COMPU_METHOD
/begin COMPU_METHOD UMR___1_5_0_S6_S3 "int = ((phys * 5) / 1) - (0) [-]" RAT_FUNC "%3.1" "[-]" COEFFS 0 5 -0 0 0 1 /end COMPU_METHOD
/begin COMPU_METHOD UMR___1_1_0_6_S6_S3 "int = ((phys * 1) / 1) - (0) [-]" RAT_FUNC "%2.0" "[-]" COEFFS 0 1 -0 0 0 1 /end COMPU_METHOD
/begin COMPU_METHOD UMR___100_1_0_S6_S3 "int = ((phys * 1) / 100) - (0) [-]" RAT_FUNC "%2.0" "[-]" COEFFS 0 1 -0 0 0 100 /end COMPU_METHOD
/begin COMPU_METHOD UMR___300_1_0_S6_S3 "int = ((phys * 1) / 300) - (0) [-]" RAT_FUNC "%2.0" "[-]" COEFFS 0 1 -0 0 0 300 /end COMPU_METHOD
/begin COMPU_METHOD UMR_MA__1_100_0_S6_S3 "int = ((phys * 100) / 1) - (0) [mA]" RAT_FUNC "%4.2" "[mA]" COEFFS 0 100 -0 0 0 1 /end COMPU_METHOD
/begin COMPU_METHOD UMR_MA__1_1_0_S6_S3 "int = ((phys * 1) / 1) - (0) [mA]" RAT_FUNC "%2.0" "[mA]" COEFFS 0 1 -0 0 0 1 /end COMPU_METHOD
/begin COMPU_METHOD UMR_MA__1_1_M128_S6_S3 "int = ((phys * 1) / 1) - (-128) [mA]" RAT_FUNC "%2.0" "[mA]" COEFFS 0 1 128 0 0 1 /end COMPU_METHOD
/begin COMPU_METHOD UMR_NM__1_10000_0_S6_S3 "int = ((phys * 10000) / 1) - (0) [Nm]" RAT_FUNC "%6.4" "[Nm]" COEFFS 0 10000 -0 0 0 1 /end COMPU_METHOD
/begin COMPU_METHOD UMR_NM__1_1000_0_S6_S3 "int = ((phys * 1000) / 1) - (0) [Nm]" RAT_FUNC "%5.3" "[Nm]" COEFFS 0 1000 -0 0 0 1 /end COMPU_METHOD
/begin COMPU_METHOD UMR_NM__1_1_0_1_S6_S3 "int = ((phys * 1) / 1) - (0) [Nm]" RAT_FUNC "%2.0" "[Nm]" COEFFS 0 1 -0 0 0 1 /end COMPU_METHOD
/begin COMPU_METHOD UMR_NM__6_1_M34_S6_S3 "int = ((phys * 1) / 6) - (-34) [Nm]" RAT_FUNC "%2.0" "[Nm]" COEFFS 0 1 204 0 0 6 /end COMPU_METHOD
/begin COMPU_METHOD UMR_NM__8_1_0_S6_S3 "int = ((phys * 1) / 8) - (0) [Nm]" RAT_FUNC "%2.0" "[Nm]" COEFFS 0 1 -0 0 0 8 /end COMPU_METHOD
/begin COMPU_METHOD UMR_NM__8_1_M34_S6_S3 "int = ((phys * 1) / 8) - (-34) [Nm]" RAT_FUNC "%2.0" "[Nm]" COEFFS 0 1 272 0 0 8 /end COMPU_METHOD
/begin COMPU_METHOD UMR_NM__8_1_M128_S6_S3 "int = ((phys * 1) / 8) - (-128) [Nm]" RAT_FUNC "%2.0" "[Nm]" COEFFS 0 1 1024 0 0 8 /end COMPU_METHOD
/begin COMPU_METHOD UMR_NM__10_1_0_S6_S3 "int = ((phys * 1) / 10) - (0) [Nm]" RAT_FUNC "%2.0" "[Nm]" COEFFS 0 1 -0 0 0 10 /end COMPU_METHOD
/begin COMPU_METHOD UMR_NM_DC_1_100_0_S6_S3 "int = ((phys * 100) / 1) - (0) [Nm/DC]" RAT_FUNC "%4.2" "[Nm/DC]" COEFFS 0 100 -0 0 0 1 /end COMPU_METHOD
/begin COMPU_METHOD UMR_NM_SEC2_1_1_0_S6_S3 "int = ((phys * 1) / 1) - (0) [Nm/s^2]" RAT_FUNC "%2.0" "[Nm/s^2]" COEFFS 0 1 -0 0 0 1 /end COMPU_METHOD
/begin COMPU_METHOD UMR_NM_SEC_1_10_0_S6_S3 "int = ((phys * 10) / 1) - (0) [Nm/s]" RAT_FUNC "%3.1" "[Nm/s]" COEFFS 0 10 -0 0 0 1 /end COMPU_METHOD
/begin COMPU_METHOD UMR_NM_SECK_1_1_0_S6_S3 "int = ((phys * 1) / 1) - (0) [Nm/(s*K)]" RAT_FUNC "%2.0" "[Nm/(s*K)]" COEFFS 0 1 -0 0 0 1 /end COMPU_METHOD
/begin COMPU_METHOD UMR_NM_SECK_1_1_0_4_S6_S3 "int = ((phys * 1) / 1) - (0) [Nm/(s*K)]" RAT_FUNC "%2.0" "[Nm/(s*K)]" COEFFS 0 1 -0 0 0 1 /end COMPU_METHOD
/begin COMPU_METHOD UMR_NM_BAR_1_10_0_S6_S3 "int = ((phys * 10) / 1) - (0) [Nm/bar]" RAT_FUNC "%3.1" "[Nm/bar]" COEFFS 0 10 -0 0 0 1 /end COMPU_METHOD
/begin COMPU_METHOD UMR_NM_LITERK_1_1_0_S6_S3 "int = ((phys * 1) / 1) - (0) [Nm/(Liter*K)]" RAT_FUNC "%2.0" "[Nm/(Liter*K)]" COEFFS 0 1 -0 0 0 1 /end COMPU_METHOD
/begin COMPU_METHOD UMR_J_LITERK_1_1_0_S6_S3 "int = ((phys * 1) / 1) - (0) [J/(Liter*K)]" RAT_FUNC "%2.0" "[J/(Liter*K)]" COEFFS 0 1 -0 0 0 1 /end COMPU_METHOD
/begin COMPU_METHOD UMR_J_LITERK_1_1_0_2_S6_S3 "int = ((phys * 1) / 1) - (0) [J/(Liter*K)]" RAT_FUNC "%2.0" "[J/(Liter*K)]" COEFFS 0 1 -0 0 0 1 /end COMPU_METHOD
/begin COMPU_METHOD UMR_MBAR__100_1_0_S6_S3 "int = ((phys * 1) / 100) - (0) [mbar]" RAT_FUNC "%2.0" "[mbar]" COEFFS 0 1 -0 0 0 100 /end COMPU_METHOD
/begin COMPU_METHOD UMR_BAR__1_20_0_S6_S3 "int = ((phys * 20) / 1) - (0) [bar]" RAT_FUNC "%4.2" "[bar]" COEFFS 0 20 -0 0 0 1 /end COMPU_METHOD
/begin COMPU_METHOD UMR_BAR__1_10_0_S6_S3 "int = ((phys * 10) / 1) - (0) [bar]" RAT_FUNC "%3.1" "[bar]" COEFFS 0 10 -0 0 0 1 /end COMPU_METHOD
/begin COMPU_METHOD UMR_BAR_SEC_10_1_0_S6_S3 "int = ((phys * 1) / 10) - (0) [bar/s]" RAT_FUNC "%2.0" "[bar/s]" COEFFS 0 1 -0 0 0 10 /end COMPU_METHOD
/begin COMPU_METHOD UMR_MBAR_NM_1_100_0_S6_S3 "int = ((phys * 100) / 1) - (0) [mbar/Nm]" RAT_FUNC "%4.2" "[mbar/Nm]" COEFFS 0 100 -0 0 0 1 /end COMPU_METHOD
/begin COMPU_METHOD UMR_BAR_NM_1_100000_0_S6_S3 "int = ((phys * 100000) / 1) - (0) [bar/Nm]" RAT_FUNC "%7.5" "[bar/Nm]" COEFFS 0 100000 -0 0 0 1 /end COMPU_METHOD
/begin COMPU_METHOD UMR_U_MIN_1_10000_0_S6_S3 "int = ((phys * 10000) / 1) - (0) [U/min]" RAT_FUNC "%6.4" "[U/min]" COEFFS 0 10000 -0 0 0 1 /end COMPU_METHOD
/begin COMPU_METHOD UMR_U_MINMSEC_1000_1_0_S6_S3 "int = ((phys * 1) / 1000) - (0) [U/(min*ms)]" RAT_FUNC "%4.2" "[U/(min*ms)]" COEFFS 0 1 -0 0 0 1000 /end COMPU_METHOD
/begin COMPU_METHOD UMR_U_MINSEC_1_100_0_S6_S3 "int = ((phys * 100) / 1) - (0) [U/(min*s)]" RAT_FUNC "%4.2" "[U/(min*s)]" COEFFS 0 100 -0 0 0 1 /end COMPU_METHOD
/begin COMPU_METHOD UMR_MSEC__1_10_0_S6_S3 "int = ((phys * 10) / 1) - (0) [ms]" RAT_FUNC "%3.1" "[ms]" COEFFS 0 10 -0 0 0 1 /end COMPU_METHOD
/begin COMPU_METHOD UMR_MSEC__2_1_0_S6_S3 "int = ((phys * 1) / 2) - (0) [ms]" RAT_FUNC "%2.0" "[ms]" COEFFS 0 1 -0 0 0 2 /end COMPU_METHOD
/begin COMPU_METHOD UMR_MSEC__20_1_0_S6_S3 "int = ((phys * 1) / 20) - (0) [ms]" RAT_FUNC "%2.0" "[ms]" COEFFS 0 1 -0 0 0 20 /end COMPU_METHOD
/begin COMPU_METHOD UMR_MSEC__50_1_0_S6_S3 "int = ((phys * 1) / 50) - (0) [ms]" RAT_FUNC "%2.0" "[ms]" COEFFS 0 1 -0 0 0 50 /end COMPU_METHOD
/begin COMPU_METHOD UMR_MSEC__100_1_0_S6_S3 "int = ((phys * 1) / 100) - (0) [ms]" RAT_FUNC "%2.0" "[ms]" COEFFS 0 1 -0 0 0 100 /end COMPU_METHOD
/begin COMPU_METHOD UMR_SEC__5_1_0_S6_S3 "int = ((phys * 1) / 5) - (0) [s]" RAT_FUNC "%2.0" "[s]" COEFFS 0 1 -0 0 0 5 /end COMPU_METHOD
/begin COMPU_METHOD UMR_SEC__10_1_0_S6_S3 "int = ((phys * 1) / 10) - (0) [s]" RAT_FUNC "%2.0" "[s]" COEFFS 0 1 -0 0 0 10 /end COMPU_METHOD
/begin COMPU_METHOD UMR_SEC__100_1_0_S6_S3 "int = ((phys * 1) / 100) - (0) [s]" RAT_FUNC "%2.0" "[s]" COEFFS 0 1 -0 0 0 100 /end COMPU_METHOD
/begin COMPU_METHOD UMR_SEC__1000_1_0_S6_S3 "int = ((phys * 1) / 1000) - (0) [s]" RAT_FUNC "%2.0" "[s]" COEFFS 0 1 -0 0 0 1000 /end COMPU_METHOD
/begin COMPU_METHOD UMR_SEC__10000_1_0_S6_S3 "int = ((phys * 1) / 10000) - (0) [s]" RAT_FUNC "%2.0" "[s]" COEFFS 0 1 -0 0 0 10000 /end COMPU_METHOD
/begin COMPU_TAB _CNV_P_2_A_I_5_S2 "" TAB_INTP 2 0 0 255 255 /end COMPU_TAB
/begin COMPU_TAB _CNV_P_2_A_I_68_S2 "" TAB_INTP 2 0 0 65535 65535 /end COMPU_TAB
/begin COMPU_VTAB _CNV_S_2_Schalter_A_4_S2 "Schalter: 0 = AUS, 1 = EIN" TAB_VERB 2 0 "AUS" 1 "EIN" /end COMPU_VTAB
/begin COMPU_VTAB _CNV_S_6_Enum_EDL_11_S2 "" TAB_VERB 6 1 "DL_1" 2 "DL_2" 3 "DL_3" 4 "DL_4" 5 "DL_5" 6 "DL_6" /end COMPU_VTAB
/begin COMPU_VTAB _CNV_S_4_Enum_EADAS_13_S2 "" TAB_VERB 4 0 "ADAS_KURVE" 1 "ADAS_KREIS" 2 "ADAS_KRZG" 3 "ADAS_AAF" /end COMPU_VTAB
/begin COMPU_VTAB _CNV_S_4_Enum_EAGS__24_S2 "" TAB_VERB 4 0 "A_AGS" 1 "S_AGS" 2 "ECO" 3 "E_FAHREN" /end COMPU_VTAB
/begin COMPU_VTAB _CNV_S_2_Enum_EAGS_25_S2 "" TAB_VERB 2 0 "A_AGS" 1 "S_AGS" /end COMPU_VTAB
/begin COMPU_VTAB _CNV_S_5_Enum_EBRS__26_S2 "" TAB_VERB 5 0 "BRS_IDX_1" 1 "BRS_IDX_2" 2 "BRS_IDX_3" 3 "BRS_IDX_4" 4 "BRS_IDX_5" /end COMPU_VTAB
/begin COMPU_VTAB _CNV_S_5_Enum_ZDRIV_27_S2 "" TAB_VERB 5 0 "D_DRIVE" 1 "S_DRIVE" 2 "M_DRIVE" 3 "TID_DRIVE" 4 "LMODE_DRIVE" /end COMPU_VTAB
/begin COMPU_VTAB _CNV_S_3_Enum_EDSCS_28_S2 "" TAB_VERB 3 0 "DSC_ACTIVE" 1 "DSC_PASSIVE" 2 "DTC_ACTIVE" /end COMPU_VTAB
/begin COMPU_VTAB _CNV_S_4_Enum_EFT_29_S2 "" TAB_VERB 4 0 "XE_FT" 1 "E_FT" 2 "S_FT" 3 "XS_FT" /end COMPU_VTAB
/begin COMPU_VTAB _CNV_S_9_Enum_EGANG_30_S2 "" TAB_VERB 9 0 "GANG_1" 1 "GANG_2" 2 "GANG_3" 3 "GANG_4" 4 "GANG_5" 5 "GANG_6" 6 "GANG_7" 7 "GANG_8" 8 "GANG_9" /end COMPU_VTAB
/begin COMPU_VTAB _CNV_S_10_Enum_EDMRS_31_S2 "" TAB_VERB 10 0 "D2RS_A_AGS" 1 "D3RS_A_AGS" 2 "D4RS_A_AGS" 3 "D5RS_A_AGS" 4 "D6RS_A_AGS" 5 "D2RS_S_AGS" 6 "D3RS_S_AGS" 7 "D4RS_S_AGS" 8 "D5RS_S_AGS" 9 "D6RS_S_AGS" /end COMPU_VTAB
/begin COMPU_VTAB _CNV_S_5_Enum_ETUPE_32_S2 "" TAB_VERB 5 0 "NMOTHS_TUPEL_0" 1 "NMOTHS_TUPEL_1" 2 "NMOTHS_TUPEL_2" 3 "NMOTHS_TUPEL_3" 4 "NMOTHS_TUPEL_4" /end COMPU_VTAB
/begin COMPU_VTAB _CNV_S_100_Enum_EPRIS_34_S2 "" TAB_VERB 100 0 "PRISQ_1" 1 "PRISQ_2" 2 "PRISQ_3" 3 "PRISQ_4" 4 "PRISQ_5" 5 "PRISQ_6" 6 "PRISQ_7" 7 "PRISQ_8" 8 "PRISQ_9" 9 "PRISQ_10" 10 "PRISQ_11" 11 "PRISQ_12" 12 "PRISQ_13" 13 "PRISQ_14" 14 "PRISQ_15" 15 "PRISQ_16" 16 "PRISQ_17" 17 "PRISQ_18" 18 "PRISQ_19" 19 "PRISQ_20" 20 "PRISQ_21" 21 "PRISQ_22" 22 "PRISQ_23" 23 "PRISQ_24" 24 "PRISQ_25" 25 "PRISQ_26" 26 "PRISQ_27" 27 "PRISQ_28" 28 "PRISQ_29" 29 "PRISQ_30" 30 "PRISQ_31" 31 "PRISQ_32" 32 "PRISQ_33" 33 "PRISQ_34" 34 "PRISQ_35" 35 "PRISQ_36" 36 "PRISQ_37" 37 "PRISQ_38" 38 "PRISQ_39" 39 "PRISQ_40" 40 "PRISQ_41" 41 "PRISQ_42" 42 "PRISQ_43" 43 "PRISQ_44" 44 "PRISQ_45" 45 "PRISQ_46" 46 "PRISQ_47" 47 "PRISQ_48" 48 "PRISQ_49" 49 "PRISQ_50" 50 "PRISQ_51" 51 "PRISQ_52" 52 "PRISQ_53" 53 "PRISQ_54" 54 "PRISQ_55" 55 "PRISQ_56" 56 "PRISQ_57" 57 "PRISQ_58" 58 "PRISQ_59" 59 "PRISQ_60" 60 "PRISQ_61" 61 "PRISQ_62" 62 "PRISQ_63" 63 "PRISQ_64" 64 "PRISQ_65" 65 "PRISQ_66" 66 "PRISQ_67" 67 "PRISQ_68" 68 "PRISQ_69" 69 "PRISQ_70" 70 "PRISQ_71" 71 "PRISQ_72" 72 "PRISQ_73" 73 "PRISQ_74" 74 "PRISQ_75" 75 "PRISQ_76" 76 "PRISQ_77" 77 "PRISQ_78" 78 "PRISQ_79" 79 "PRISQ_80" 80 "PRISQ_81" 81 "PRISQ_82" 82 "PRISQ_83" 83 "PRISQ_84" 84 "PRISQ_85" 85 "PRISQ_86" 86 "PRISQ_87" 87 "PRISQ_88" 88 "PRISQ_89" 89 "PRISQ_90" 90 "PRISQ_91" 91 "PRISQ_92" 92 "PRISQ_93" 93 "PRISQ_94" 94 "PRISQ_95" 95 "PRISQ_96" 96 "PRISQ_97" 97 "PRISQ_98" 98 "PRISQ_99" 99 "PRISQ_100" /end COMPU_VTAB
/begin COMPU_VTAB _CNV_S_3_Enum_EPROG_37_S2 "" TAB_VERB 3 0 "NORMAL_MODE_BRS" 1 "SPORT_MODE_BRS" 2 "E_FAHREN_BRS" /end COMPU_VTAB
/begin COMPU_VTAB _CNV_S_21_Enum_EPROG_40_S2 "" TAB_VERB 21 0 "EXTREME_ECONOMY_PROG" 1 "ECONOMY_PROG" 2 "SPORT_PROG" 3 "EXTREME_SPORT_PROG" 4 "A1_PROG" 5 "A2_PROG" 6 "A3_PROG" 7 "A4_PROG" 8 "A5_PROG" 9 "SA1_PROG" 10 "SA2_PROG" 11 "SA3_PROG" 12 "SA4_PROG" 13 "WL1_PROG" 14 "WL2_PROG" 15 "ECO_PROG" 16 "ECOA1_PROG" 17 "ECOA2_PROG" 18 "ECOWL2_PROG" 19 "SO1_PROG" 20 "SO2_PROG" /end COMPU_VTAB
/begin COMPU_VTAB _CNV_S_2_Enum_ECONT_55_S2 "" TAB_VERB 2 0 "PRUEFEN_WARTEZEIT" 1 "PRUEFEN_V_ZUNAHME" /end COMPU_VTAB
/begin COMPU_VTAB _CNV_S_3_Enum_ECONT_56_S2 "" TAB_VERB 3 0 "SETZEN_RSZ_FLAG" 1 "WARTEN_SCHALTUNGSENDE" 2 "PRUEFEN_SPERRZEIT" /end COMPU_VTAB
/begin COMPU_VTAB _CNV_S_2_Enum_EBABF_58_S2 "" TAB_VERB 2 0 "BAB_KEINE_FGRKF" 1 "BAB_UND_FGRKF" /end COMPU_VTAB
/begin COMPU_VTAB _CNV_S_3_Enum_EBAB_59_S2 "" TAB_VERB 3 0 "BAB_NICHT_ERKANNT" 1 "BAB_ERKANNT" 2 "BAB_ERKANNT_NACHL" /end COMPU_VTAB
/begin COMPU_VTAB _CNV_S_6_Enum_EBERG_61_S2 "" TAB_VERB 6 0 "BERGANH_OFF" 1 "BERGANH_A1" 2 "BERGANH_A2" 3 "BERGANH_A3" 4 "BERGANH_A4" 5 "BERGANH_A5" /end COMPU_VTAB
/begin COMPU_VTAB _CNV_S_5_Enum_EFT2_67_S2 "" TAB_VERB 5 0 "XXE_FT" 1 "XE_FT" 2 "E_FT" 3 "S_FT" 4 "XS_FT" /end COMPU_VTAB
/begin COMPU_VTAB _CNV_S_4_Enum_EPROG_70_S2 "" TAB_VERB 4 0 "EXTREME_ECONOMY_PROG" 1 "ECONOMY_PROG" 2 "SPORT_PROG" 3 "EXTREME_SPORT_PROG" /end COMPU_VTAB
/begin COMPU_VTAB _CNV_S_4_Enum_EGB_71_S2 "" TAB_VERB 4 0 "TRIGGER_1_KFE" 1 "TRIGGER_2_KFE" 2 "GET_MAX_WERT_KFE" 3 "MAX_WERT_CHECK_KFE" /end COMPU_VTAB
/begin COMPU_VTAB _CNV_S_3_Enum_ESCHL_72_S2 "" TAB_VERB 3 0 "NICHT_BEWERTET" 1 "IN_BEWERTUNG" 2 "BEWERTET" /end COMPU_VTAB
/begin COMPU_VTAB _CNV_S_3_Enum_ELDM_76_S2 "" TAB_VERB 3 0 "KEIN_LDM" 1 "LDM_AAGS" 2 "LDM_SAGS" /end COMPU_VTAB
/begin COMPU_VTAB _CNV_S_3_Enum_EQ_79_S2 "" TAB_VERB 3 0 "SIGNAL_OK" 1 "ERSATZWERT" 2 "FEHLER" /end COMPU_VTAB
/begin COMPU_VTAB _CNV_S_7_Enum_ELDMM_80_S2 "" TAB_VERB 7 0 "LDM_AUS" 1 "LDM_AN_STD" 2 "BN2020_SLD_AKTIV" 3 "BN2020_PMA_AKTIV_ODER_BN2000_LDM_AN_BREMSE" 4 "BN2000_LDM_AN_UEBERTRITT" 5 "BN2000_LDM_AUS_CASYSTEMBREMSUNG" 15 "BN2000_LDM_INIT" /end COMPU_VTAB
/begin COMPU_VTAB _CNV_S_3_Enum_ELDM__81_S2 "" TAB_VERB 3 0 "KEINE_STELLABW" 1 "STELLABW_OK" 2 "SIGNAL_UNGUELTIG" /end COMPU_VTAB
/begin COMPU_VTAB _CNV_S_14_Enum_EGANG_88_S2 "Ganganzeige" TAB_VERB 14 0 "GANG_WHL_AZG_NODISP" 1 "GANG_WHL_AZG_N" 2 "GANG_WHL_AZG_R" 3 "GANG_WHL_AZG_P" 4 "GANG_WHL_AZG_D" 5 "GANG_WHL_AZG_1" 6 "GANG_WHL_AZG_2" 7 "GANG_WHL_AZG_3" 8 "GANG_WHL_AZG_4" 9 "GANG_WHL_AZG_5" 10 "GANG_WHL_AZG_6" 11 "GANG_WHL_AZG_7" 12 "GANG_WHL_AZG_8" 13 "GANG_WHL_AZG_9" /end COMPU_VTAB
/begin COMPU_VTAB _CNV_S_11_Enum_EGANG_89_S2 "" TAB_VERB 11 1 "GANGSS_KEIN_GANG" 2 "GANGSS_R" 5 "GANGSS_1" 6 "GANGSS_2" 7 "GANGSS_3" 8 "GANGSS_4" 9 "GANGSS_5" 10 "GANGSS_6" 11 "GANGSS_7" 12 "GANGSS_8" 13 "GANGSS_9" /end COMPU_VTAB
/begin COMPU_VTAB _CNV_S_10_Enum_EGANG_90_S2 "" TAB_VERB 10 0 "DARK" 1 "GANG_1" 2 "GANG_2" 3 "GANG_3" 4 "GANG_4" 5 "GANG_5" 6 "GANG_6" 7 "GANG_7" 8 "GANG_8" 9 "GANG_9" /end COMPU_VTAB
/begin COMPU_VTAB _CNV_S_12_Enum_EK0_S_91_S2 "" TAB_VERB 12 0 "OFFEN_ASDINAKT" 1 "ANGELEGT_ASDINAKT" 2 "DRUCKSTELLUNG_ASDINAKT" 3 "SCHLUPFGEREGELT_ASDINAKT" 4 "GEREGELTGESCHLOSSEN_ASDINAKT" 5 "GESCHLOSSEN_ASDINAKT" 6 "OFFEN_ASDAKT" 7 "ANGELEGT_ASDAKT" 8 "DRUCKSTELLUNG_ASDAKT" 9 "SCHLUPFGEREGELT_ASDAKT" 10 "GEREGELTGESCHLOSSEN_ASDAKT" 11 "GESCHLOSSEN_ASDAKT" /end COMPU_VTAB
/begin COMPU_VTAB _CNV_S_3_Enum_ECOMP_92_S2 "Status der Steigungsverlust-Kompensation" TAB_VERB 3 0 "GUELTIG" 1 "UNGUELTIG" 2 "EINGESCHRAENKT_GUELTIG" /end COMPU_VTAB
/begin COMPU_VTAB _CNV_S_4_Enum_EKOMB_93_S2 "" TAB_VERB 4 0 "DARK_KOMBI" 1 "SPORT_KOMBI" 2 "STEPTRONIC_KOMBI" 3 "L_KOMBI" /end COMPU_VTAB
/begin COMPU_VTAB _CNV_S_16_Enum_EPROG_94_S2 "" TAB_VERB 16 0 "DS2_XE" 1 "DS2_E" 2 "DS2_S" 3 "DS2_XS" 4 "DS2_A1" 5 "DS2_A2" 6 "DS2_A3" 7 "DS2_A4" 8 "DS2_STEPTR" 9 "DS2_SO" 10 "DS2_B0" 11 "DS2_LM" 12 "DS2_WL" 13 "DS2_LD" 14 "DS2_LDM" 15 "DS2_A5" /end COMPU_VTAB
/begin COMPU_VTAB _CNV_S_4_Enum_EEXCF_101_S2 "" TAB_VERB 4 0 "AUTOMAT" 1 "MANUELL" 2 "FAHRERASSISTENT" 3 "ZUGKRAFTALGO" /end COMPU_VTAB
/begin COMPU_VTAB _CNV_S_4_Enum_EDKFI_105_S2 "" TAB_VERB 4 0 "DKFILT_OFF" 1 "DKFILT_LDM" 2 "DKFILT_DYNKOR" 3 "DKFILT_PLUFT" /end COMPU_VTAB
/begin COMPU_VTAB _CNV_S_4_Enum_EDKFI_106_S2 "" TAB_VERB 4 0 "DKFILT_LEV2_OFF" 1 "DKFILT_LEV2_UP" 2 "DKFILT_LEV2_DOWN" 3 "DKFILT_LEV2_UPDOWN" /end COMPU_VTAB
/begin COMPU_VTAB _CNV_S_9_Enum_EFKTE_107_S2 "" TAB_VERB 9 0 "KEINE" 1 "WL1" 2 "WL2" 3 "ERW_FREI" 4 "TID" 5 "LDM" 6 "FGR" 7 "FAS_LERN" 8 "HDC" /end COMPU_VTAB
/begin COMPU_VTAB _CNV_S_6_Enum_ENABH_108_S2 "" TAB_VERB 6 0 "KEINE_HSURERS" 1 "NABHSURERS_NULLDECRVL_1" 2 "NABHSURERS_NULLDECRVL_2" 3 "NABHSURERS_NULLDECRVL_3" 4 "NABHSURERS_NULLDECRVL_4" 5 "NABHSURERS_NULLDECRVL_5" /end COMPU_VTAB
/begin COMPU_VTAB _CNV_S_4_Enum_EPOSB_109_S2 "" TAB_VERB 4 0 "POSENB_D" 1 "POSENB_N" 2 "POSENB_R" 3 "POSENB_P" /end COMPU_VTAB
/begin COMPU_VTAB _CNV_S_2_Enum_EHDC__114_S2 "" TAB_VERB 2 0 "N_MOT_SCHALTEN" 1 "N_MOT_GANGHALTEN" /end COMPU_VTAB
/begin COMPU_VTAB _CNV_S_3_Enum_ELDMA_116_S2 "" TAB_VERB 3 0 "LDM_ZUG" 1 "LDM_SCHUB_BAB_INAKTIV" 2 "LDM_SCHUB_BAB_AKTIV" /end COMPU_VTAB
/begin COMPU_VTAB _CNV_S_8_Enum_EHSUB_119_S2 "" TAB_VERB 8 0 "HSUBEDAUS_D" 1 "HSUBEDAUS_D_FDC" 2 "HSUBEDAUS_S" 3 "HSUBEDAUS_S_FDC" 4 "HSUBEDAUS_STEP" 5 "HSUBEDAUS_STEP_FDC" 6 "HSUBEDAUS_TID" 7 "HSUBEDAUS_TID_FDC" /end COMPU_VTAB
/begin COMPU_VTAB _CNV_S_4_Enum_EHSUR_121_S2 "" TAB_VERB 4 0 "HSURE_KUVOR_A_AGS" 1 "HSURE_KUVOR_S_AGS" 2 "HSURE_KUVOR_LDMAAGS" 3 "HSURE_KUVOR_LDMSAGS" /end COMPU_VTAB
/begin COMPU_VTAB _CNV_S_5_Enum_EGWFP_128_S2 "" TAB_VERB 5 0 "GWFP_IDX1" 1 "GWFP_IDX2" 2 "GWFP_IDX3" 3 "GWFP_IDX4" 4 "GWFP_IDX5" /end COMPU_VTAB
/begin COMPU_VTAB _CNV_S_3_Enum_EHSUA_129_S2 "" TAB_VERB 3 0 "KEEP_HSU" 1 "OUT_HSU_ONLY" 2 "OUT_HSU_PLUS_BUFF" /end COMPU_VTAB
/begin COMPU_VTAB _CNV_S_2_Enum_EFP_D_130_S2 "" TAB_VERB 2 0 "FP_POS" 1 "FP_NEG" /end COMPU_VTAB
/begin COMPU_VTAB _CNV_S_3_Enum_EHSU__133_S2 "" TAB_VERB 3 0 "HSUKS_AUS" 1 "HSUKS_EIN" 2 "HSUKS_NACHL" /end COMPU_VTAB
/begin COMPU_VTAB _CNV_S_3_Enum_EHSUR_134_S2 "" TAB_VERB 3 0 "HSURE_SCHLUPF_AUS" 1 "HSURE_SCHLUPF_EIN" 2 "HSURE_SCHLUPF_NACHL" /end COMPU_VTAB
/begin COMPU_VTAB _CNV_S_3_Enum_EHSUR_135_S2 "" TAB_VERB 3 0 "HSURE_BRS_AUS" 1 "HSURE_BRS_EIN" 2 "HSURE_BRS_NACHL" /end COMPU_VTAB
/begin COMPU_VTAB _CNV_S_3_Enum_EHSUR_136_S2 "" TAB_VERB 3 0 "HSURE_FOF_AUS" 1 "HSURE_FOF_SCHARF" 2 "HSURE_FOF_EIN" /end COMPU_VTAB
/begin COMPU_VTAB _CNV_S_3_Enum_EHSUR_137_S2 "" TAB_VERB 3 0 "HSURE_NL_AUS" 1 "HSURE_NL_SCHARF" 2 "HSURE_NL_EIN" /end COMPU_VTAB
/begin COMPU_VTAB _CNV_S_4_Enum_ESOCM_142_S2 "Status SOC MODE" TAB_VERB 4 0 "Depleting" 1 "Sustaining" 2 "Hold" 3 "Failure" /end COMPU_VTAB
/begin COMPU_VTAB _CNV_S_4_Enum_EMODU_144_S2 "" TAB_VERB 4 0 "hFahren" 1 "Uebergang_hFahren_eFahren" 2 "eFahren" 3 "Uebergang_eFahren_hFahren" /end COMPU_VTAB
/begin COMPU_VTAB _CNV_S_3_Enum_EWK_153_S2 "" TAB_VERB 3 0 "OFFEN" 1 "GEREGELT" 2 "ZU" /end COMPU_VTAB
/begin COMPU_VTAB _CNV_S_8_Enum_EDYND_164_S2 "" TAB_VERB 8 0 "Init" 1 "Schlupf" 2 "Kein_Schlupf" 3 "Einstieg_Fahrdynamikfunktion" 4 "Fahrdynamikfunktion_aktiv" 5 "Ausstieg_Fahrdynamikfunktion" 6 "Hochrampen zu Schlupf" 7 "Runterrampen zu Kein_Schlupf" /end COMPU_VTAB
/begin COMPU_VTAB _CNV_S_8_Enum_EDYND_165_S2 "" TAB_VERB 8 0 "Init" 1 "Rangieren_PosN" 2 "Fahren" 3 "Schalten" 4 "Segeln" 5 "E_Fahren" 6 "Freilauf_offen" 7 "Kein_Kraftschluss" /end COMPU_VTAB
/begin COMPU_VTAB _CNV_S_7_Enum_EDYND_166_S2 "" TAB_VERB 7 0 "H-Fahren (Init)" 1 "Einstieg E-Fahren" 2 "E-Fahren" 3 "Ausstieg E-Fahren low" 4 "Ausstieg E-Fahren mid" 5 "Ausstieg E-Fahren high" 6 "E-Fahren mit VM ein" /end COMPU_VTAB
/begin COMPU_VTAB _CNV_S_3_Enum_EEFAH_251_S2 "" TAB_VERB 3 0 "KEIN_AUSSTIEG" 1 "AUSSTIEG_EMODE" 2 "AUSSTIEG_AUTOEV" /end COMPU_VTAB
/begin COMPU_VTAB _CNV_S_9_Enum_EARSS_315_S2 "" TAB_VERB 9 0 "MIN_EXC" 1 "MIN_RFWS" 2 "MIN_CMOPLUFT" 3 "MIN_DPFREG" 4 "MIN_AEP" 5 "MIN_HOTMODE" 6 "MIN_MOTSOLLLL" 7 "MIN_CGT" 8 "MIN_REKUPRS" /end COMPU_VTAB
/begin COMPU_VTAB _CNV_S_10_Enum_EDBMT_317_S2 "" TAB_VERB 10 0 "DBMZKA_IDX1" 1 "DBMZKA_IDX2" 2 "DBMZKA_IDX3" 3 "DBMZKA_IDX4" 4 "DBMZKA_IDX5" 5 "DBMZKA_IDX6" 6 "DBMZKA_IDX7" 7 "DBMZKA_IDX8" 8 "DBMZKA_IDX9" 9 "DBMZKA_IDX10" /end COMPU_VTAB
/begin COMPU_VTAB _CNV_S_5_Enum_REKUP_320_S2 "" TAB_VERB 5 0 "REKUP_IDX1" 1 "REKUP_IDX2" 2 "REKUP_IDX3" 3 "REKUP_IDX4" 4 "REKUP_IDX5" /end COMPU_VTAB
/begin COMPU_VTAB _CNV_S_2_Enum_ELOWH_321_S2 "" TAB_VERB 2 0 "LOW" 1 "HIGH" /end COMPU_VTAB
/begin COMPU_VTAB _CNV_S_3_Enum_EIDX0_325_S2 "" TAB_VERB 3 0 "IDX0" 1 "IDX1" 2 "IDX2" /end COMPU_VTAB
/begin COMPU_VTAB _CNV_S_16_Enum_EMAXR_326_S2 "" TAB_VERB 16 0 "MAX_RFWS_IDX0" 1 "MAX_RFWS_IDX1" 2 "MAX_RFWS_IDX2" 3 "MAX_RFWS_IDX3" 4 "MAX_RFWS_IDX4" 5 "MAX_RFWS_IDX5" 6 "MAX_RFWS_IDX6" 7 "MAX_RFWS_IDX7" 8 "MAX_RFWS_IDX8" 9 "MAX_RFWS_IDX9" 10 "MAX_RFWS_IDX10" 11 "MAX_RFWS_IDX11" 12 "MAX_RFWS_IDX12" 13 "MAX_RFWS_IDX13" 14 "MAX_RFWS_IDX14" 15 "MAX_RFWS_IDX15" /end COMPU_VTAB
/begin COMPU_VTAB _CNV_S_16_Enum_EMINR_327_S2 "" TAB_VERB 16 0 "MIN_RFWS_IDX0" 1 "MIN_RFWS_IDX1" 2 "MIN_RFWS_IDX2" 3 "MIN_RFWS_IDX3" 4 "MIN_RFWS_IDX4" 5 "MIN_RFWS_IDX5" 6 "MIN_RFWS_IDX6" 7 "MIN_RFWS_IDX7" 8 "MIN_RFWS_IDX8" 9 "MIN_RFWS_IDX9" 10 "MIN_RFWS_IDX10" 11 "MIN_RFWS_IDX11" 12 "MIN_RFWS_IDX12" 13 "MIN_RFWS_IDX13" 14 "MIN_RFWS_IDX14" 15 "MIN_RFWS_IDX15" /end COMPU_VTAB
/begin COMPU_VTAB _CNV_S_4_Enum_EIDX_328_S2 "" TAB_VERB 4 0 "IDX0" 1 "IDX1" 2 "IDX2" 3 "IDX3" /end COMPU_VTAB
/begin COMPU_VTAB _CNV_S_3_Enum_ESOUR_333_S2 "" TAB_VERB 3 0 "N_AB" 1 "N_AB_FILT" 2 "N_AB_UNFILT" /end COMPU_VTAB
/begin COMPU_VTAB _CNV_S_3_Enum_DLBAS_334_S2 "" TAB_VERB 3 0 "A_AGS" 1 "S_AGS" 2 "A_AGS oder S_AGS" /end COMPU_VTAB
/begin COMPU_VTAB _CNV_S_4_Enum_EDPSV_335_S2 "" TAB_VERB 4 0 "KEIN_HALTEN_ZIELGANG" 1 "NUR_HSEARLIER_AKTIV" 2 "NUR_HSLATER_AKTIV" 3 "HSEARLIER_HSLATER_AKTIV" /end COMPU_VTAB
/begin COMPU_VTAB _CNV_S_4_Enum_ETIDA_336_S2 "" TAB_VERB 4 0 "KUHSURE_TID" 1 "BABHSU_TID" 2 "FPMIN_TID" 3 "FPMAX_TID" /end COMPU_VTAB
/begin COMPU_VTAB _CNV_S_9_Enum_EDMRS_337_S2 "" TAB_VERB 9 0 "DMRS_ZIELGANG" 1 "DMRS_PRUEFGANG" 2 "NAB_RW" 3 "NAB" 4 "NAB_RW_SAGS" 5 "NAB_SAGS" 6 "NAB_RW_ECO" 7 "NAB_ECO" 8 "NAB_STEPTR" /end COMPU_VTAB
/begin COMPU_VTAB _CNV_S_5_Enum_EDMRS_338_S2 "" TAB_VERB 5 0 "T_D2RS" 1 "T_D3RS" 2 "T_D4RS" 3 "T_D5RS" 4 "T_D6RS" /end COMPU_VTAB
/begin COMPU_VTAB _CNV_S_3_Enum_ETEST_344_S2 "" TAB_VERB 3 0 "TESTFALL_1" 1 "TESTFALL_2" 2 "SOLLGANGAGS" /end COMPU_VTAB
/begin COMPU_VTAB _CNV_S_3_Enum_EIDX__345_S2 "" TAB_VERB 3 0 "IDX1" 1 "IDX2" 2 "IDX3" DEFAULT_VALUE "0" /end COMPU_VTAB
/begin COMPU_VTAB _CNV_S_2_Enum_EMARS_346_S2 "" TAB_VERB 2 0 "MARS_RSU_MUELOW" 1 "MARS_NO_RSU_MUELOW" /end COMPU_VTAB
/begin COMPU_VTAB _CNV_S_11_Enum_EFKT__348_S2 "" TAB_VERB 11 0 "XE_FKT" 1 "ECO" 2 "DPF_REG" 3 "WL1" 4 "WL2" 5 "BERG_A1" 6 "BERG_A2" 7 "BERG_A3" 8 "EFAHREN_1" 9 "EFAHREN_2" 10 "REKUP" /end COMPU_VTAB
/begin COMPU_VTAB _CNV_S_2_Enum_EGW_F_349_S2 "" TAB_VERB 2 0 "MIN_SPA" 1 "MAX_SPA" /end COMPU_VTAB
/begin COMPU_VTAB _CNV_S_2_Enum_ERS_S_350_S2 "" TAB_VERB 2 0 "HS_SPA" 1 "RS_SPA" /end COMPU_VTAB
/begin COMPU_VTAB _CNV_S_15_Enum_EPRIS_351_S2 "" TAB_VERB 15 0 "SPA_PRSIQ_1" 1 "SPA_PRSIQ_2" 2 "SPA_PRSIQ_3" 3 "SPA_PRSIQ_4" 4 "SPA_PRSIQ_5" 5 "SPA_PRSIQ_6" 6 "SPA_PRSIQ_7" 7 "SPA_PRSIQ_8" 8 "SPA_PRSIQ_9" 9 "SPA_PRSIQ_10" 10 "SPA_PRSIQ_11" 11 "SPA_PRSIQ_12" 12 "SPA_PRSIQ_13" 13 "SPA_PRSIQ_14" 14 "SPA_PRSIQ_15" /end COMPU_VTAB
/begin COMPU_VTAB _CNV_S_4_Enum_Z_EFA_354_S2 "" TAB_VERB 4 0 "ES_EFAHREN_1_ERK" 1 "ES_EFAHREN_2_ERK" 2 "ES_EFAHREN_3_ERK" 3 "ES_EFAHREN_4_ERK" /end COMPU_VTAB
/begin RECORD_LAYOUT _REC_S7CUR_53_s2_u2_S2 FNC_VALUES 3 SWORD COLUMN_DIR DIRECT AXIS_PTS_X 2 UWORD INDEX_INCR DIRECT NO_AXIS_PTS_X 1 UBYTE /end RECORD_LAYOUT
/begin RECORD_LAYOUT _REC_S1VAL_1_s2_S2 FNC_VALUES 1 SWORD COLUMN_DIR DIRECT /end RECORD_LAYOUT
/begin RECORD_LAYOUT _REC_S1VAL_1_u2_S2 FNC_VALUES 1 UWORD COLUMN_DIR DIRECT /end RECORD_LAYOUT
/begin RECORD_LAYOUT _REC_S1VAL_1_u1_S2 FNC_VALUES 1 UBYTE COLUMN_DIR DIRECT /end RECORD_LAYOUT
/begin RECORD_LAYOUT _REC_S1VAL_1_u4_S2 FNC_VALUES 1 ULONG COLUMN_DIR DIRECT /end RECORD_LAYOUT
/begin RECORD_LAYOUT _REC_S7CUR_53_u2_s2_S2 FNC_VALUES 3 UWORD COLUMN_DIR DIRECT AXIS_PTS_X 2 SWORD INDEX_INCR DIRECT NO_AXIS_PTS_X 1 UBYTE /end RECORD_LAYOUT
/begin RECORD_LAYOUT _REC_A1MAP_9_u2_u1_u1_S2 FNC_VALUES 1 UWORD COLUMN_DIR DIRECT /end RECORD_LAYOUT
/begin RECORD_LAYOUT _REC_S7CUR_53_s2_s2_S2 FNC_VALUES 3 SWORD COLUMN_DIR DIRECT AXIS_PTS_X 2 SWORD INDEX_INCR DIRECT NO_AXIS_PTS_X 1 UBYTE /end RECORD_LAYOUT
/begin RECORD_LAYOUT _REC_A1CUR_30_u1_u1_S2 FNC_VALUES 1 UBYTE COLUMN_DIR DIRECT /end RECORD_LAYOUT
/begin RECORD_LAYOUT _REC_S7CUR_53_u2_u2_S2 FNC_VALUES 3 UWORD COLUMN_DIR DIRECT AXIS_PTS_X 2 UWORD INDEX_INCR DIRECT NO_AXIS_PTS_X 1 UBYTE /end RECORD_LAYOUT
/begin RECORD_LAYOUT _REC_S3MAP_54_u2_s2_u1_S2 FNC_VALUES 3 UWORD ROW_DIR DIRECT AXIS_PTS_X 2 SWORD INDEX_INCR DIRECT NO_AXIS_PTS_X 1 UBYTE /end RECORD_LAYOUT
/begin RECORD_LAYOUT _REC_A1MAP_9_s2_u1_u1_S2 FNC_VALUES 1 SWORD COLUMN_DIR DIRECT /end RECORD_LAYOUT
/begin RECORD_LAYOUT _REC_A1CUR_30_u2_u1_S2 FNC_VALUES 1 UWORD COLUMN_DIR DIRECT /end RECORD_LAYOUT
/begin RECORD_LAYOUT _REC_A1MAP_9_u1_u1_u1_S2 FNC_VALUES 1 UBYTE COLUMN_DIR DIRECT /end RECORD_LAYOUT
/begin RECORD_LAYOUT _REC_A1CUR_30_s2_u1_S2 FNC_VALUES 1 SWORD COLUMN_DIR DIRECT /end RECORD_LAYOUT
/begin RECORD_LAYOUT _REC_S3MAP_54_s2_s2_u1_S2 FNC_VALUES 3 SWORD ROW_DIR DIRECT AXIS_PTS_X 2 SWORD INDEX_INCR DIRECT NO_AXIS_PTS_X 1 UBYTE /end RECORD_LAYOUT
/begin RECORD_LAYOUT _REC_A1MAP_8_u1_u2_u1_S2 FNC_VALUES 1 UBYTE ROW_DIR DIRECT /end RECORD_LAYOUT
/begin RECORD_LAYOUT _REC_A1CUR_30_u1_u2_S2 FNC_VALUES 1 UBYTE COLUMN_DIR DIRECT /end RECORD_LAYOUT
/begin RECORD_LAYOUT _REC_S7MAP_53_u2_u2_u2_S2 FNC_VALUES 5 UWORD COLUMN_DIR DIRECT AXIS_PTS_X 3 UWORD INDEX_INCR DIRECT AXIS_PTS_Y 4 UWORD INDEX_INCR DIRECT NO_AXIS_PTS_X 1 UBYTE NO_AXIS_PTS_Y 2 UBYTE /end RECORD_LAYOUT
/begin RECORD_LAYOUT _REC_A1CUR_30_u2_u2_S2 FNC_VALUES 1 UWORD COLUMN_DIR DIRECT /end RECORD_LAYOUT
/begin RECORD_LAYOUT _REC_A1MAP_9_u2_u2_u1_S2 FNC_VALUES 1 UWORD COLUMN_DIR DIRECT /end RECORD_LAYOUT
/begin RECORD_LAYOUT _REC_S3MAP_54_u2_u2_u1_S2 FNC_VALUES 3 UWORD ROW_DIR DIRECT AXIS_PTS_X 2 UWORD INDEX_INCR DIRECT NO_AXIS_PTS_X 1 UBYTE /end RECORD_LAYOUT
/begin RECORD_LAYOUT _REC_A1MAP_8_u1_u1_u1_S2 FNC_VALUES 1 UBYTE ROW_DIR DIRECT /end RECORD_LAYOUT
/begin RECORD_LAYOUT _REC_S3MAP_54_s2_s2_u2_S2 FNC_VALUES 3 SWORD ROW_DIR DIRECT AXIS_PTS_X 2 SWORD INDEX_INCR DIRECT NO_AXIS_PTS_X 1 UBYTE /end RECORD_LAYOUT
/begin RECORD_LAYOUT _REC_A1CUR_30_s2_s2_S2 FNC_VALUES 1 SWORD COLUMN_DIR DIRECT /end RECORD_LAYOUT
/begin RECORD_LAYOUT _REC_A1CUR_30_s2_u2_S2 FNC_VALUES 1 SWORD COLUMN_DIR DIRECT /end RECORD_LAYOUT
/begin RECORD_LAYOUT _REC_A1MAP_8_s2_u2_u2_S2 FNC_VALUES 1 SWORD ROW_DIR DIRECT /end RECORD_LAYOUT
/begin RECORD_LAYOUT _REC_A1MAP_8_s2_u2_u1_S2 FNC_VALUES 1 SWORD ROW_DIR DIRECT /end RECORD_LAYOUT
/begin RECORD_LAYOUT _REC_A1MAP_9_u1_u1_u2_S2 FNC_VALUES 1 UBYTE COLUMN_DIR DIRECT /end RECORD_LAYOUT
/begin RECORD_LAYOUT _REC_A1MAP_8_s2_u1_u2_S2 FNC_VALUES 1 SWORD ROW_DIR DIRECT /end RECORD_LAYOUT
/begin RECORD_LAYOUT _REC_A1MAP_8_u2_u2_u1_S2 FNC_VALUES 1 UWORD ROW_DIR DIRECT /end RECORD_LAYOUT
/begin RECORD_LAYOUT _REC_A1CUR_30_u4_u2_S2 FNC_VALUES 1 ULONG COLUMN_DIR DIRECT /end RECORD_LAYOUT
/begin RECORD_LAYOUT _REC_A1MAP_9_s1_u1_u1_S2 FNC_VALUES 1 SBYTE COLUMN_DIR DIRECT /end RECORD_LAYOUT
/begin RECORD_LAYOUT _REC_A1CUR_30_s4_u1_S2 FNC_VALUES 1 SLONG COLUMN_DIR DIRECT /end RECORD_LAYOUT
/end MODULE
/end PROJECT
