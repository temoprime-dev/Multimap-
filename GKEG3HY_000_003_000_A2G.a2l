ASAP2_VERSION 1 51
/begin PROJECT _929_929 "Gen2_BMW_System_Supplier_Lib"
/begin HEADER "" VERSION "C_03_03" PROJECT_NO _929_929 /end HEADER
/begin MODULE DIM ""
/begin MOD_COMMON "" BYTE_ORDER MSB_FIRST ALIGNMENT_BYTE 1 ALIGNMENT_WORD 2 ALIGNMENT_LONG 4 ALIGNMENT_FLOAT32_IEEE 4 /end MOD_COMMON
/begin CHARACTERISTIC XTAB5SCHTEMP_MOT_WL "" CURVE 0x276604 _REC_S7CUR_53_s2_u2_S2 200 _CNV_R_R_Umr_1_zu_1_1_CM_S2 -50 150 FORMAT "%2.0"
 /begin AXIS_DESCR STD_AXIS P_LUFT _CNV_R_R_Umr_1_zu_1_0_CM_S2 5 600 1106 FORMAT "%4.2" /end AXIS_DESCR
/end CHARACTERISTIC
/begin CHARACTERISTIC XTAB5SCHTEMP_MOT_WLSPV "" CURVE 0x27661A _REC_S7CUR_53_s2_u2_S2 200 _CNV_R_R_Umr_1_zu_1_1_CM_S2 -50 150 FORMAT "%2.0"
 /begin AXIS_DESCR STD_AXIS P_LUFT _CNV_R_R_Umr_1_zu_1_0_CM_S2 5 600 1106 FORMAT "%4.2" /end AXIS_DESCR
/end CHARACTERISTIC
/begin CHARACTERISTIC XSCHGW_FPWLSPV "" VALUE 0x276630 _REC_S1VAL_1_s2_S2 65535 _CNV_R_R_Umr_1_zu_1_7_CM_S2 -32768 32767 FORMAT "%2.0" /end CHARACTERISTIC
/begin CHARACTERISTIC XSCHTEMP_GETR_WL2_AUS "" VALUE 0x2765EC _REC_S1VAL_1_s2_S2 400 _CNV_R_R_Umr_1_zu_1_1_CM_S2 -200 200 FORMAT "%2.0" /end CHARACTERISTIC
/begin CHARACTERISTIC XSCHTEMP_GETR_WL2_MAX "" VALUE 0x2765EE _REC_S1VAL_1_s2_S2 400 _CNV_R_R_Umr_1_zu_1_1_CM_S2 -200 200 FORMAT "%2.0" /end CHARACTERISTIC
/begin CHARACTERISTIC XSCHTEMP_GETR_WL2_MIN "" VALUE 0x2765F0 _REC_S1VAL_1_s2_S2 400 _CNV_R_R_Umr_1_zu_1_1_CM_S2 -200 200 FORMAT "%2.0" /end CHARACTERISTIC
/begin CHARACTERISTIC XSCHTEMP_GETR_WLSPV "" VALUE 0x276632 _REC_S1VAL_1_s2_S2 400 _CNV_R_R_Umr_1_zu_1_1_CM_S2 -200 200 FORMAT "%2.0" /end CHARACTERISTIC
/begin CHARACTERISTIC XSCHTEMP_MOT_DPF_REG "" VALUE 0x276634 _REC_S1VAL_1_s2_S2 400 _CNV_R_R_Umr_1_zu_1_1_CM_S2 -200 200 FORMAT "%2.0" /end CHARACTERISTIC
/begin CHARACTERISTIC XSCHTEMP_MOT_WL2_AUS "" VALUE 0x2765F2 _REC_S1VAL_1_s2_S2 200 _CNV_R_R_Umr_1_zu_1_1_CM_S2 -50 150 FORMAT "%2.0" /end CHARACTERISTIC
/begin CHARACTERISTIC XSCHTEMP_MOT_WL2_MAX "" VALUE 0x2765F4 _REC_S1VAL_1_s2_S2 200 _CNV_R_R_Umr_1_zu_1_1_CM_S2 -50 150 FORMAT "%2.0" /end CHARACTERISTIC
/begin CHARACTERISTIC XSCHTEMP_WLPRED_AUS "" VALUE 0x2765F6 _REC_S1VAL_1_s2_S2 400 _CNV_R_R_Umr_1_zu_1_1_CM_S2 -200 200 FORMAT "%2.0" /end CHARACTERISTIC
/begin CHARACTERISTIC XSCHTEMP_WLPRED_EIN "" VALUE 0x2765F8 _REC_S1VAL_1_s2_S2 400 _CNV_R_R_Umr_1_zu_1_1_CM_S2 -200 200 FORMAT "%2.0" /end CHARACTERISTIC
/begin CHARACTERISTIC XSCHV_FZG_WL "" VALUE 0x276636 _REC_S1VAL_1_u2_S2 400 _CNV_R_R_Umr_1_zu_1_8_CM_S2 0 400 FORMAT "%2.0" /end CHARACTERISTIC
/begin CHARACTERISTIC XSCHV_FZG_WL2 "" VALUE 0x2765FA _REC_S1VAL_1_u2_S2 400 _CNV_R_R_Umr_1_zu_1_8_CM_S2 0 400 FORMAT "%2.0" /end CHARACTERISTIC
/begin CHARACTERISTIC XSCHV_FZG_WLPRED "" VALUE 0x2765FC _REC_S1VAL_1_u2_S2 300 _CNV_R_R_Umr_1_zu_1_8_CM_S2 0 300 FORMAT "%2.0" /end CHARACTERISTIC
/begin CHARACTERISTIC XSCHW_DKKD_WL2_AUS "" VALUE 0x2765FE _REC_S1VAL_1_u2_S2 120 _CNV_R_R_Umr_10_zu__9_CM_S2 0 120 FORMAT "%3.1" /end CHARACTERISTIC
/begin CHARACTERISTIC XSCHW_LWVA_WL2_AUS "" VALUE 0x276600 _REC_S1VAL_1_u2_S2 90 _CNV_R_R_Umr_10_zu__10_CM_S2 0 90 FORMAT "%3.1" /end CHARACTERISTIC
/begin CHARACTERISTIC XSCHW_STEIGUNG_WL2_AUS "" VALUE 0x276602 _REC_S1VAL_1_u2_S2 200 _CNV_R_R_Umr_10_zu__9_CM_S2 0 200 FORMAT "%3.1" /end CHARACTERISTIC
/begin CHARACTERISTIC XSCH_DRIVELOGIC_WLPRED "" VALUE 0x27B576 _REC_S1VAL_1_u1_S2 5 _CNV_S_6_Enum_EDL_11_CM_S2 1 6 /end CHARACTERISTIC
/begin CHARACTERISTIC XS_USE_GWFPFILT "" VALUE 0x27B577 _REC_S1VAL_1_u1_S2 1 _CNV_R_R_Umr_1_zu_1_2_CM_S2 0 1 FORMAT "%2.0" /end CHARACTERISTIC
/begin CHARACTERISTIC XS_USE_WLSPV "" VALUE 0x27B578 _REC_S1VAL_1_u1_S2 1 _CNV_R_R_Umr_1_zu_1_2_CM_S2 0 1 FORMAT "%2.0" /end CHARACTERISTIC
/begin CHARACTERISTIC XT_MAX_WL "" VALUE 0x271A14 _REC_S1VAL_1_u4_S2 2.14748E+006 _CNV_R_R_Umr_1000_z_12_CM_S2 0 2147483.647 FORMAT "%5.3" /end CHARACTERISTIC
/begin CHARACTERISTIC XT_MAX_WL2 "" VALUE 0x271A0C _REC_S1VAL_1_u4_S2 2.14748E+006 _CNV_R_R_Umr_1000_z_12_CM_S2 0 2147483.647 FORMAT "%5.3" /end CHARACTERISTIC
/begin CHARACTERISTIC XT_MAX_WLPRED "" VALUE 0x271A10 _REC_S1VAL_1_u4_S2 2.14748E+006 _CNV_R_R_Umr_1000_z_12_CM_S2 0 2147483.647 FORMAT "%5.3" /end CHARACTERISTIC
/begin CHARACTERISTIC XTAB2FAKTA_FZG_MUELOW_EIN_GRAD "" CURVE 0x276534 _REC_S7CUR_53_u2_s2_S2 10 _CNV_R_R_Umr_10_zu__45_CM_S2 0 10 FORMAT "%3.1"
 /begin AXIS_DESCR STD_AXIS DM_AB_FWS_FILT _CNV_R_R_Umr_1_zu_1_42_CM_S2 2 -1000 1000 FORMAT "%2.0" /end AXIS_DESCR
/end CHARACTERISTIC
/begin CHARACTERISTIC XTAB2FAKTG2WAB_MUELOW_EIN_GRAD "" CURVE 0x27653E _REC_S7CUR_53_u2_s2_S2 10 _CNV_R_R_Umr_10_zu__45_CM_S2 0 10 FORMAT "%3.1"
 /begin AXIS_DESCR STD_AXIS DM_AB_FWS_FILT _CNV_R_R_Umr_1_zu_1_42_CM_S2 2 -1000 1000 FORMAT "%2.0" /end AXIS_DESCR
/end CHARACTERISTIC
/begin CHARACTERISTIC XTAB2OA_MUELOW_EIN_GRADIENT "" CURVE 0x276548 _REC_S7CUR_53_s2_u2_S2 40 _CNV_R_R_Umr_10_zu__46_CM_S2 -20 20 FORMAT "%3.1"
 /begin AXIS_DESCR STD_AXIS V_FZG _CNV_R_R_Umr_1_zu_1_8_CM_S2 2 0 400 FORMAT "%2.0" /end AXIS_DESCR
/end CHARACTERISTIC
/begin CHARACTERISTIC XTAB3X3OM_RAD_MUELOW_AUS_LAST "" MAP 0x2719B0 _REC_S7MAP_53_u2_s2_u2_S2 10000 _CNV_R_R_Umr_1_zu_1_42_CM_S2 0 10000 FORMAT "%2.0"
 /begin AXIS_DESCR STD_AXIS DM_AB_FWS_FILT _CNV_R_R_Umr_1_zu_1_42_CM_S2 3 -1000 1000 FORMAT "%2.0" /end AXIS_DESCR
 /begin AXIS_DESCR STD_AXIS V_FZG_COG _CNV_R_R_Umr_64_zu__44_CM_S2 3 0 250 FORMAT "%4.2" /end AXIS_DESCR
/end CHARACTERISTIC
/begin CHARACTERISTIC XTAB3X3SMPL_SCHLUPF_GEW "" MAP 0x2765BE _REC_A1MAP_9_u2_u1_u1_S2 65535 _CNV_R_R_Umr_1_zu_1_2_CM_S2 0 65535 FORMAT "%2.0"
 /begin AXIS_DESCR FIX_AXIS Z_SCHLUPF_ANTRIEB_RR _CNV_S_3_Enum_ESCHL_41_CM_S2 3 0 2 FIX_AXIS_PAR_DIST 0 1 3 READ_ONLY /end AXIS_DESCR
 /begin AXIS_DESCR FIX_AXIS Z_SCHLUPF_ANTRIEB_RL _CNV_S_3_Enum_ESCHL_41_CM_S2 3 0 2 FIX_AXIS_PAR_DIST 0 1 3 READ_ONLY /end AXIS_DESCR
/end CHARACTERISTIC
/begin CHARACTERISTIC XTAB4SCHA_MUELOW_EIN_ABS "" CURVE 0x276552 _REC_S7CUR_53_s2_s2_S2 40 _CNV_R_R_Umr_10_zu__46_CM_S2 -20 20 FORMAT "%3.1"
 /begin AXIS_DESCR STD_AXIS DM_AB_FWS_FILT _CNV_R_R_Umr_1_zu_1_42_CM_S2 4 -1000 1000 FORMAT "%2.0" /end AXIS_DESCR
/end CHARACTERISTIC
/begin CHARACTERISTIC XTAB4SCHA_MUELOW_EIN_ZUG "" CURVE 0x276564 _REC_S7CUR_53_s2_s2_S2 40 _CNV_R_R_Umr_10_zu__46_CM_S2 -20 20 FORMAT "%3.1"
 /begin AXIS_DESCR STD_AXIS DM_AB_FWS_FILT _CNV_R_R_Umr_1_zu_1_42_CM_S2 4 -1000 1000 FORMAT "%2.0" /end AXIS_DESCR
/end CHARACTERISTIC
/begin CHARACTERISTIC XTAB4X4SCHA_MUELOW_AUS_BREMS "" MAP 0x27658C _REC_S7MAP_53_s2_s2_s2_S2 40 _CNV_R_R_Umr_10_zu__46_CM_S2 -20 20 FORMAT "%3.1"
 /begin AXIS_DESCR STD_AXIS M_AB_BREMS _CNV_R_R_Umr_1_zu_1_42_CM_S2 4 -10000 0 FORMAT "%2.0" /end AXIS_DESCR
 /begin AXIS_DESCR STD_AXIS DM_AB_FWS_FILT _CNV_R_R_Umr_1_zu_1_42_CM_S2 4 -1000 1000 FORMAT "%2.0" /end AXIS_DESCR
/end CHARACTERISTIC
/begin CHARACTERISTIC XTAB4Z_POS_MUELOW_ERLAUBT "" CURVE 0x271A00 _REC_A1CUR_30_u1_u1_S2 1 _CNV_R_R_Umr_1_zu_1_2_CM_S2 0 1 FORMAT "%2.0"
 /begin AXIS_DESCR FIX_AXIS Z_POS_AGS _CNV_S_4_Enum_EPOSA_43_CM_S2 4 0 3 /begin FIX_AXIS_PAR_LIST 0 1 2 3 /end FIX_AXIS_PAR_LIST READ_ONLY /end AXIS_DESCR
/end CHARACTERISTIC
/begin CHARACTERISTIC XTAB5SCHA_MUELOW_AUS_BESCHL "" CURVE 0x276576 _REC_S7CUR_53_s2_s2_S2 40 _CNV_R_R_Umr_10_zu__46_CM_S2 -20 20 FORMAT "%3.1"
 /begin AXIS_DESCR STD_AXIS DM_AB_FWS_FILT _CNV_R_R_Umr_1_zu_1_42_CM_S2 5 -1000 1000 FORMAT "%2.0" /end AXIS_DESCR
/end CHARACTERISTIC
/begin CHARACTERISTIC XTAB5X3SCHA_MUELOW_AUS_BESCHL "" MAP 0x2719D0 _REC_S7MAP_53_s2_s2_u2_S2 40 _CNV_R_R_Umr_10_zu__46_CM_S2 -20 20 FORMAT "%3.1"
 /begin AXIS_DESCR STD_AXIS DM_AB_FWS_FILT _CNV_R_R_Umr_1_zu_1_42_CM_S2 5 -1000 1000 FORMAT "%2.0" /end AXIS_DESCR
 /begin AXIS_DESCR STD_AXIS V_FZG_COG _CNV_R_R_Umr_64_zu__44_CM_S2 3 0 250 FORMAT "%4.2" /end AXIS_DESCR
/end CHARACTERISTIC
/begin CHARACTERISTIC XC_SCHLUPF_BUFFER "" VALUE 0x2765D0 _REC_S1VAL_1_u2_S2 65534 _CNV_R_R_Umr_1_zu_1_2_CM_S2 1 65535 FORMAT "%2.0" /end CHARACTERISTIC
/begin CHARACTERISTIC XOA_MUELOW_AUS_BREMS "" VALUE 0x2765D2 _REC_S1VAL_1_s2_S2 40 _CNV_R_R_Umr_10_zu__46_CM_S2 -20 20 FORMAT "%3.1" /end CHARACTERISTIC
/begin CHARACTERISTIC XOG2W_MUELOW_EIN_GRADIENT "" VALUE 0x2765D4 _REC_S1VAL_1_u2_S2 256 _CNV_R_R_Umr_10_zu__47_CM_S2 0 256 FORMAT "%3.1" /end CHARACTERISTIC
/begin CHARACTERISTIC XSCHN_ISMPL_MUELOW_EIN_SCHLUPF "" VALUE 0x2765D6 _REC_S1VAL_1_u2_S2 65535 _CNV_R_R_Umr_1_zu_1_2_CM_S2 0 65535 FORMAT "%2.0" /end CHARACTERISTIC
/begin CHARACTERISTIC XSCHN_SCHLUPF_MINGES "" VALUE 0x2765D8 _REC_S1VAL_1_u2_S2 65535 _CNV_R_R_Umr_1_zu_1_2_CM_S2 0 65535 FORMAT "%2.0" /end CHARACTERISTIC
/begin CHARACTERISTIC XSCHN_SCHLUPF_MUELOW_AUS "" VALUE 0x27B56D _REC_S1VAL_1_u1_S2 255 _CNV_R_R_Umr_1_zu_1_2_CM_S2 0 255 FORMAT "%2.0" /end CHARACTERISTIC
/begin CHARACTERISTIC XSCHN_SCHLUPF_NACHL_MAX "" VALUE 0x2765DA _REC_S1VAL_1_u2_S2 65535 _CNV_R_R_Umr_1_zu_1_2_CM_S2 0 65535 FORMAT "%2.0" /end CHARACTERISTIC
/begin CHARACTERISTIC XSCHTEMP_UMG_MUELOW_EIN "" VALUE 0x2765DC _REC_S1VAL_1_s2_S2 130 _CNV_R_R_Umr_1_zu_1_1_CM_S2 -50 80 FORMAT "%2.0" /end CHARACTERISTIC
/begin CHARACTERISTIC XS_DSC_MUELOW_EIN_GRADIENT "" VALUE 0x27B56E _REC_S1VAL_1_u1_S2 1 _CNV_R_R_Umr_1_zu_1_2_CM_S2 0 1 FORMAT "%2.0" /end CHARACTERISTIC
/begin CHARACTERISTIC XS_MUELOW_EIN_DSC "" VALUE 0x27B56F _REC_S1VAL_1_u1_S2 1 _CNV_R_R_Umr_1_zu_1_2_CM_S2 0 1 FORMAT "%2.0" /end CHARACTERISTIC
/begin CHARACTERISTIC XS_MUELOW_EIN_SCHLUPF "" VALUE 0x27B570 _REC_S1VAL_1_u1_S2 1 _CNV_R_R_Umr_1_zu_1_2_CM_S2 0 1 FORMAT "%2.0" /end CHARACTERISTIC
/begin CHARACTERISTIC XS_MUELOW_ROLLE_RESET "" VALUE 0x27B571 _REC_S1VAL_1_u1_S2 1 _CNV_R_R_Umr_1_zu_1_2_CM_S2 0 1 FORMAT "%2.0" /end CHARACTERISTIC
/begin CHARACTERISTIC XT_B_SCHLUPF "" VALUE 0x271A04 _REC_S1VAL_1_u4_S2 2.14748E+009 _CNV_R_R_Umr_1_zu_1_6_CM_S2 0 2147483647 FORMAT "%2.0" /end CHARACTERISTIC
/begin CHARACTERISTIC XT_MUELOW_AUS_BESCHL "" VALUE 0x2765DE _REC_S1VAL_1_u2_S2 5000 _CNV_R_R_Umr_1_zu_1_6_CM_S2 0 5000 FORMAT "%2.0" /end CHARACTERISTIC
/begin CHARACTERISTIC XT_MUELOW_AUS_BREMS "" VALUE 0x2765E0 _REC_S1VAL_1_u2_S2 5000 _CNV_R_R_Umr_1_zu_1_6_CM_S2 0 5000 FORMAT "%2.0" /end CHARACTERISTIC
/begin CHARACTERISTIC XT_MUELOW_AUS_LAST "" VALUE 0x2765E2 _REC_S1VAL_1_u2_S2 5000 _CNV_R_R_Umr_1_zu_1_6_CM_S2 0 5000 FORMAT "%2.0" /end CHARACTERISTIC
/begin CHARACTERISTIC XT_MUELOW_EIN_ABS "" VALUE 0x2765E4 _REC_S1VAL_1_u2_S2 5000 _CNV_R_R_Umr_1_zu_1_6_CM_S2 0 5000 FORMAT "%2.0" /end CHARACTERISTIC
/begin CHARACTERISTIC XT_MUELOW_EIN_DSC "" VALUE 0x2765E6 _REC_S1VAL_1_u2_S2 5000 _CNV_R_R_Umr_1_zu_1_6_CM_S2 0 5000 FORMAT "%2.0" /end CHARACTERISTIC
/begin CHARACTERISTIC XT_MUELOW_EIN_GRADIENT "" VALUE 0x2765E8 _REC_S1VAL_1_u2_S2 5000 _CNV_R_R_Umr_1_zu_1_6_CM_S2 0 5000 FORMAT "%2.0" /end CHARACTERISTIC
/begin CHARACTERISTIC XT_SCHLUPF_NACHL "" VALUE 0x271A08 _REC_S1VAL_1_u4_S2 2.14748E+009 _CNV_R_R_Umr_1_zu_1_6_CM_S2 0 2147483647 FORMAT "%2.0" /end CHARACTERISTIC
/begin CHARACTERISTIC XT_SCHLUPF_NACHLZWEI "" VALUE 0x2765EA _REC_S1VAL_1_u2_S2 65535 _CNV_R_R_Umr_1_zu_1_6_CM_S2 0 65535 FORMAT "%2.0" /end CHARACTERISTIC
/begin CHARACTERISTIC XZ_ALLRAD_MUELOW_EIN_GRADIENT "" VALUE 0x27B572 _REC_S1VAL_1_u1_S2 3 _CNV_S_4_Enum_EANTR_48_CM_S2 0 3 /end CHARACTERISTIC
/begin CHARACTERISTIC XZ_BREMSBED_MUELOW_EIN_DSC "" VALUE 0x27B573 _REC_S1VAL_1_u1_S2 3 _CNV_S_4_Enum_EBREM_49_CM_S2 0 3 /end CHARACTERISTIC
/begin CHARACTERISTIC XZ_DSC_TASTER_MUELOW_AUS "" VALUE 0x27B574 _REC_S1VAL_1_u1_S2 2 _CNV_S_3_Enum_EDSCM_50_CM_S2 0 2 /end CHARACTERISTIC
/begin CHARACTERISTIC XZ_MUELOW_EIN_SS "" VALUE 0x27B575 _REC_S1VAL_1_u1_S2 3 _CNV_S_4_Enum_EET_M_51_CM_S2 0 3 /end CHARACTERISTIC
/begin CHARACTERISTIC XTAB2T_NACHL_BAB "" CURVE 0x2713D0 _REC_A1CUR_30_u4_u1_S2 2.14748E+009 _CNV_R_R_Umr_1_zu_1_6_CM_S2 0 2147483647 FORMAT "%2.0"
 /begin AXIS_DESCR FIX_AXIS Z_AGS_MODBEDEL _CNV_S_2_Enum_EAGS_25_CM_S2 2 0 1 FIX_AXIS_PAR_DIST 0 1 2 READ_ONLY /end AXIS_DESCR
/end CHARACTERISTIC
/begin CHARACTERISTIC XTAB2Z_GANG_MIN_BAB "" CURVE 0x27A6E4 _REC_A1CUR_30_u1_u1_S2 8 _CNV_S_9_Enum_EGANG_30_CM_S2 0 8
 /begin AXIS_DESCR FIX_AXIS Z_AGS_MODBEDEL _CNV_S_2_Enum_EAGS_25_CM_S2 2 0 1 FIX_AXIS_PAR_DIST 0 1 2 READ_ONLY /end AXIS_DESCR
/end CHARACTERISTIC
/begin CHARACTERISTIC XTAB4S_SOC_NMOTMAXRS_BAB "" CURVE 0x273EC4 _REC_A1CUR_30_u1_u1_S2 1 _CNV_R_R_Umr_1_zu_1_2_CM_S2 0 1 FORMAT "%2.0"
 /begin AXIS_DESCR FIX_AXIS Z_AGSMOD_ECO_EFAHREN _CNV_S_4_Enum_EAGS__24_CM_S2 4 0 3 FIX_AXIS_PAR_DIST 0 1 4 READ_ONLY /end AXIS_DESCR
/end CHARACTERISTIC
/begin CHARACTERISTIC XTAB4X9DM_AB_FWSBAB "" MAP 0x27A6FC _REC_S3MAP_54_s2_u2_u1_S2 2000 _CNV_R_R_Umr_1_zu_1_42_CM_S2 -1000 1000 FORMAT "%2.0"
 /begin AXIS_DESCR STD_AXIS V_FZG _CNV_R_R_Umr_1_zu_1_8_CM_S2 4 0 400 FORMAT "%2.0" /end AXIS_DESCR
 /begin AXIS_DESCR FIX_AXIS Z_GANG_ZIEL _CNV_S_9_Enum_EGANG_30_CM_S2 9 0 8 FIX_AXIS_PAR_DIST 0 1 9 READ_ONLY /end AXIS_DESCR
/end CHARACTERISTIC
/begin CHARACTERISTIC XTAB5FAKT_EM_POT_REKUP_BAB "" CURVE 0x27A74E _REC_S7CUR_53_u2_s2_S2 100 _CNV_R_R_Umr_1_zu_1_53_CM_S2 0 100 FORMAT "%3.1"
 /begin AXIS_DESCR STD_AXIS M_AB_REKUP_BAB _CNV_R_R_Umr_1_zu_1_42_CM_S2 5 -1000 0 FORMAT "%3.1" /end AXIS_DESCR
/end CHARACTERISTIC
/begin CHARACTERISTIC XTAB5FAKT_SOC_NMOTMAXRS_BAB "" CURVE 0x27A6E6 _REC_S7CUR_53_u2_u2_S2 1 _CNV_R_R_Umr_100_zu_54_CM_S2 0 1 FORMAT "%4.2"
 /begin AXIS_DESCR STD_AXIS Z_SOC _CNV_R_R_Umr_1_zu_1_53_CM_S2 5 0 100 FORMAT "%2.0" /end AXIS_DESCR
/end CHARACTERISTIC
/begin CHARACTERISTIC XTAB5X2SCHW_STEIGUNG_BAB "" MAP 0x2713D8 _REC_S3MAP_54_s2_u2_u1_S2 400 _CNV_R_R_Umr_10_zu__9_CM_S2 -200 200 FORMAT "%3.1"
 /begin AXIS_DESCR STD_AXIS V_FZG _CNV_R_R_Umr_1_zu_1_8_CM_S2 5 0 400 FORMAT "%2.0" /end AXIS_DESCR
 /begin AXIS_DESCR FIX_AXIS NO_INPUT_QUANTITY _CNV_S_2_Enum_EBABE_52_CM_S2 2 0 1 FIX_AXIS_PAR_DIST 0 1 2 READ_ONLY /end AXIS_DESCR
/end CHARACTERISTIC
/begin CHARACTERISTIC XTAB5X2SCHW_STEIGUNG_BABLDM "" MAP 0x2713F8 _REC_S3MAP_54_s2_u2_u1_S2 400 _CNV_R_R_Umr_10_zu__9_CM_S2 -200 200 FORMAT "%3.1"
 /begin AXIS_DESCR STD_AXIS V_FZG _CNV_R_R_Umr_1_zu_1_8_CM_S2 5 0 400 FORMAT "%2.0" /end AXIS_DESCR
 /begin AXIS_DESCR FIX_AXIS NO_INPUT_QUANTITY _CNV_S_2_Enum_EBABE_52_CM_S2 2 0 1 FIX_AXIS_PAR_DIST 0 1 2 READ_ONLY /end AXIS_DESCR
/end CHARACTERISTIC
/begin CHARACTERISTIC XTAB5X4N_MOTMAX_RSZ_BAB "" MAP 0x273EC8 _REC_S3MAP_54_u2_s2_u1_S2 10000 _CNV_R_R_Umr_1_zu_1_3_CM_S2 0 10000 FORMAT "%2.0"
 /begin AXIS_DESCR STD_AXIS DM_AB_FWS_FILT_BAB _CNV_R_R_Umr_1_zu_1_42_CM_S2 5 -5000 0 /end AXIS_DESCR
 /begin AXIS_DESCR FIX_AXIS Z_AGSMOD_ECO_EFAHREN _CNV_S_4_Enum_EAGS__24_CM_S2 4 0 3 FIX_AXIS_PAR_DIST 0 1 4 READ_ONLY /end AXIS_DESCR
/end CHARACTERISTIC
/begin CHARACTERISTIC XTAB9KORFAKT_FWSBAB_MUELOW "" CURVE 0x27B792 _REC_A1CUR_30_u1_u1_S2 150 _CNV_R_R_Umr_1_zu_1_53_CM_S2 100 250 FORMAT "%2.0"
 /begin AXIS_DESCR FIX_AXIS Z_GANG_RSZFWS _CNV_S_9_Enum_EGANG_30_CM_S2 9 0 8 FIX_AXIS_PAR_DIST 0 1 9 READ_ONLY /end AXIS_DESCR
/end CHARACTERISTIC
/begin CHARACTERISTIC XTAB9Z_GANGMIN_RSSEQ_BAB "" CURVE 0x27B79B _REC_A1CUR_30_u1_u1_S2 8 _CNV_S_9_Enum_EGANG_30_CM_S2 0 8
 /begin AXIS_DESCR FIX_AXIS Z_GANG_ZIEL _CNV_S_9_Enum_EGANG_30_CM_S2 9 0 8 FIX_AXIS_PAR_DIST 0 1 9 READ_ONLY /end AXIS_DESCR
/end CHARACTERISTIC
/begin CHARACTERISTIC XDN_AB_EINBAB "" VALUE 0x2761A0 _REC_S1VAL_1_u2_S2 20000 _CNV_R_R_Umr_1_zu_1_3_CM_S2 0 20000 FORMAT "%2.0" /end CHARACTERISTIC
/begin CHARACTERISTIC XDN_AB_REFBAB "" VALUE 0x2761A2 _REC_S1VAL_1_u2_S2 20000 _CNV_R_R_Umr_1_zu_1_3_CM_S2 0 20000 FORMAT "%2.0" /end CHARACTERISTIC
/begin CHARACTERISTIC XFN_MOTMAX_RSZ_DSPORT_BAB "" VALUE 0x27B7A6 _REC_S1VAL_1_u1_S2 2.4 _CNV_R_R_Umr_100_zu_54_CM_S2 0.1 2.5 FORMAT "%4.2" /end CHARACTERISTIC
/begin CHARACTERISTIC XM_AB_REKUPMAX_FILTINGEW "" VALUE 0x27A764 _REC_S1VAL_1_u2_S2 5000 _CNV_R_R_Umr_1_zu_1_2_CM_S2 0 5000 /end CHARACTERISTIC
/begin CHARACTERISTIC XM_AB_REKUPMAX_FILTOUTGEW "" VALUE 0x27A766 _REC_S1VAL_1_u2_S2 5000 _CNV_R_R_Umr_1_zu_1_2_CM_S2 0 5000 /end CHARACTERISTIC
/begin CHARACTERISTIC XOW_STEIGUNG_BABEIN "" VALUE 0x2761A4 _REC_S1VAL_1_s2_S2 200 _CNV_R_R_Umr_10_zu__9_CM_S2 -200 0 FORMAT "%3.1" /end CHARACTERISTIC
/begin CHARACTERISTIC XSCHDM_AB_FWSBAB_FGR "" VALUE 0x27A768 _REC_S1VAL_1_s2_S2 20000 _CNV_R_R_Umr_1_zu_1_42_CM_S2 -10000 10000 FORMAT "%2.0" /end CHARACTERISTIC
/begin CHARACTERISTIC XSCHM_RAD_AUSNULLAST_BAB "" VALUE 0x2761A6 _REC_S1VAL_1_s2_S2 20000 _CNV_R_R_Umr_1_zu_1_42_CM_S2 -10000 10000 FORMAT "%2.0" /end CHARACTERISTIC
/begin CHARACTERISTIC XSCHW_DKKD_NULLAST_BAB "" VALUE 0x2761A8 _REC_S1VAL_1_u2_S2 110 _CNV_R_R_Umr_10_zu__9_CM_S2 0 110 FORMAT "%3.1" /end CHARACTERISTIC
/begin CHARACTERISTIC XS_NABRAD_NAB "" VALUE 0x27B4D9 _REC_S1VAL_1_u1_S2 1 _CNV_R_R_Umr_1_zu_1_2_CM_S2 0 1 FORMAT "%2.0" /end CHARACTERISTIC
/begin CHARACTERISTIC XS_USE_BABDSCERRAUSSTIEG "" VALUE 0x27B7A7 _REC_S1VAL_1_u1_S2 1 _CNV_R_R_Umr_1_zu_1_2_CM_S2 0 1 FORMAT "%2.0" /end CHARACTERISTIC
/begin CHARACTERISTIC XS_USE_BABSERP "" VALUE 0x27B4DA _REC_S1VAL_1_u1_S2 1 _CNV_S_2_Schalter_A_4_CM_S2 0 1 /end CHARACTERISTIC
/begin CHARACTERISTIC XT_BAB_FGR "" VALUE 0x273EFC _REC_S1VAL_1_u4_S2 2.14748E+009 _CNV_R_R_Umr_1_zu_1_6_CM_S2 0 2147483647 FORMAT "%2.0" /end CHARACTERISTIC
/begin CHARACTERISTIC XT_EIN_BAB "" VALUE 0x271418 _REC_S1VAL_1_u4_S2 2.14748E+009 _CNV_R_R_Umr_1_zu_1_6_CM_S2 0 2147483647 FORMAT "%2.0" /end CHARACTERISTIC
/begin CHARACTERISTIC XT_MFRSZ "" VALUE 0x273F00 _REC_S1VAL_1_u4_S2 2.14748E+009 _CNV_R_R_Umr_1_zu_1_6_CM_S2 0 2147483647 FORMAT "%2.0" /end CHARACTERISTIC
/begin CHARACTERISTIC XT_SPERR_RSZBAB "" VALUE 0x273F04 _REC_S1VAL_1_u4_S2 2.14748E+009 _CNV_R_R_Umr_1_zu_1_6_CM_S2 0 2147483647 FORMAT "%2.0" /end CHARACTERISTIC
/begin CHARACTERISTIC XT_V_RSZBAB "" VALUE 0x273F08 _REC_S1VAL_1_u4_S2 2.14748E+009 _CNV_R_R_Umr_1_zu_1_6_CM_S2 0 2147483647 FORMAT "%2.0" /end CHARACTERISTIC
/begin CHARACTERISTIC XW_STEIGUNG_KORFILT_SLOW_INGEW "" VALUE 0x2761AA _REC_S1VAL_1_s2_S2 32767 _CNV_R_R_Umr_1_zu_1_2_CM_S2 0 32767 FORMAT "%2.0" /end CHARACTERISTIC
/begin CHARACTERISTIC XW_STEIGUNG_KORFILT_SLOW_OUTGEW "" VALUE 0x2761AC _REC_S1VAL_1_s2_S2 32767 _CNV_R_R_Umr_1_zu_1_2_CM_S2 0 32767 FORMAT "%2.0" /end CHARACTERISTIC
/begin CHARACTERISTIC XZ_EM_PRD_REKUP_BAB "" VALUE 0x27B7A4 _REC_S1VAL_1_u1_S2 5 _CNV_R_R_Umr_1_zu_1_2_CM_S2 0 5 FORMAT "%2.0" /end CHARACTERISTIC
/begin CHARACTERISTIC XZ_GANG_MINBABMUELOW "" VALUE 0x27B7A8 _REC_S1VAL_1_u1_S2 8 _CNV_S_9_Enum_EGANG_30_CM_S2 0 8 /end CHARACTERISTIC
/begin CHARACTERISTIC XZ_STATUS_ANTRIEB_FZG_BAB "" VALUE 0x27B7A5 _REC_S1VAL_1_u1_S2 255 _CNV_R_R_Umr_1_zu_1_2_CM_S2 0 255 FORMAT "%2.0" /end CHARACTERISTIC
/begin CHARACTERISTIC XZ_USE_BABAUS_SIGNAL "" VALUE 0x27B4DB _REC_S1VAL_1_u1_S2 1 _CNV_S_2_Enum_EBABA_60_CM_S2 0 1 /end CHARACTERISTIC
/begin CHARACTERISTIC XTAB5T_BGH_NACHL "" CURVE 0x2764CA _REC_S7CUR_53_u2_s2_S2 65535 _CNV_R_R_Umr_1_zu_1_6_CM_S2 0 65535 FORMAT "%2.0"
 /begin AXIS_DESCR STD_AXIS DM_AB_FWSBGHNACHLDELTA _CNV_R_R_Umr_1_zu_1_42_CM_S2 5 -32768 32767 FORMAT "%2.0" /end AXIS_DESCR
/end CHARACTERISTIC
/begin CHARACTERISTIC XTAB5X3SCHDM_AB_FWS "" MAP 0x2764E0 _REC_A1MAP_9_s2_u1_u1_S2 32767 _CNV_R_R_Umr_1_zu_1_42_CM_S2 0 32767 FORMAT "%2.0"
 /begin AXIS_DESCR FIX_AXIS Z_BERGANH _CNV_S_6_Enum_EBERG_61_CM_S2 5 0 5 FIX_AXIS_PAR_DIST 0 1 5 READ_ONLY /end AXIS_DESCR
 /begin AXIS_DESCR FIX_AXIS NO_INPUT_QUANTITY _CNV_S_3_Enum_EHDM__62_CM_S2 3 0 2 FIX_AXIS_PAR_DIST 0 1 3 READ_ONLY /end AXIS_DESCR
/end CHARACTERISTIC
/begin CHARACTERISTIC XTAB9S_EIN_ERKBERGANH "" CURVE 0x2764FE _REC_A1CUR_30_u2_u1_S2 1 _CNV_R_R_Umr_1_zu_1_2_CM_S2 0 1 FORMAT "%2.0"
 /begin AXIS_DESCR FIX_AXIS Z_GANG_IST _CNV_S_9_Enum_EGANG_30_CM_S2 9 0 8 FIX_AXIS_PAR_DIST 0 1 9 READ_ONLY /end AXIS_DESCR
/end CHARACTERISTIC
/begin CHARACTERISTIC XDM_AB_FWSOFFSET "" VALUE 0x276510 _REC_S1VAL_1_s2_S2 65535 _CNV_R_R_Umr_1_zu_1_42_CM_S2 -32768 32767 FORMAT "%2.0" /end CHARACTERISTIC
/begin CHARACTERISTIC XHA_L_BERGANH "" VALUE 0x276512 _REC_S1VAL_1_s2_S2 6553.5 _CNV_R_R_Umr_10_zu__46_CM_S2 -3276.8 3276.7 FORMAT "%3.1" /end CHARACTERISTIC
/begin CHARACTERISTIC XSCHA_L_BERGANH "" VALUE 0x276514 _REC_S1VAL_1_s2_S2 6553.5 _CNV_R_R_Umr_10_zu__46_CM_S2 -3276.8 3276.7 FORMAT "%3.1" /end CHARACTERISTIC
/begin CHARACTERISTIC XSCHBERGANH_SERP "" VALUE 0x27B548 _REC_S1VAL_1_u1_S2 5 _CNV_S_6_Enum_EBERG_61_CM_S2 0 5 /end CHARACTERISTIC
/begin CHARACTERISTIC XSCHTEMP_MOT_BERGANH "" VALUE 0x276516 _REC_S1VAL_1_s2_S2 400 _CNV_R_R_Umr_1_zu_1_1_CM_S2 -200 200 FORMAT "%2.0" /end CHARACTERISTIC
/begin CHARACTERISTIC XSCHV_FZG_BERGANH "" VALUE 0x276518 _REC_S1VAL_1_u2_S2 400 _CNV_R_R_Umr_1_zu_1_8_CM_S2 0 400 FORMAT "%2.0" /end CHARACTERISTIC
/begin CHARACTERISTIC XSCHV_FZG_BGHINAKTIV "" VALUE 0x27651A _REC_S1VAL_1_u2_S2 400 _CNV_R_R_Umr_1_zu_1_8_CM_S2 0 400 FORMAT "%2.0" /end CHARACTERISTIC
/begin CHARACTERISTIC XS_USE_BERGANH_SERP "" VALUE 0x27B549 _REC_S1VAL_1_u1_S2 1 _CNV_S_2_Schalter_A_4_CM_S2 0 1 /end CHARACTERISTIC
/begin CHARACTERISTIC XS_USE_BGHSCHINAKTIV "" VALUE 0x27B54A _REC_S1VAL_1_u1_S2 1 _CNV_R_R_Umr_1_zu_1_2_CM_S2 0 1 FORMAT "%2.0" /end CHARACTERISTIC
/begin CHARACTERISTIC XS_USE_BGH_SCHALTUNG "" VALUE 0x27B54B _REC_S1VAL_1_u1_S2 1 _CNV_S_2_Schalter_A_4_CM_S2 0 1 /end CHARACTERISTIC
/begin CHARACTERISTIC XS_USE_BGH_STAND "" VALUE 0x27B54C _REC_S1VAL_1_u1_S2 1 _CNV_S_2_Schalter_A_4_CM_S2 0 1 /end CHARACTERISTIC
/begin CHARACTERISTIC XTAB3X6_DRIVELOGIC_BRS_IDX "" MAP 0x2766A0 _REC_A1MAP_9_u1_u1_u1_S2 4 _CNV_S_5_Enum_EBRS__26_CM_S2 0 4
 /begin AXIS_DESCR FIX_AXIS Z_PROG_MODE_BRS _CNV_S_3_Enum_EPROG_37_CM_S2 3 0 2 /begin FIX_AXIS_PAR_LIST 0 1 2 /end FIX_AXIS_PAR_LIST READ_ONLY /end AXIS_DESCR
 /begin AXIS_DESCR FIX_AXIS Z_DRIVELOGIC _CNV_S_6_Enum_EDL_11_CM_S2 6 1 6 FIX_AXIS_PAR_DIST 1 1 6 READ_ONLY /end AXIS_DESCR
/end CHARACTERISTIC
/begin CHARACTERISTIC XTAB9X5SCHN_AB_HOCH_BRS "" MAP 0x2766B2 _REC_A1MAP_9_u2_u1_u1_S2 20000 _CNV_R_R_Umr_1_zu_1_3_CM_S2 0 20000 FORMAT "%2.0"
 /begin AXIS_DESCR FIX_AXIS Z_GANG_ZIEL _CNV_S_9_Enum_EGANG_30_CM_S2 9 0 8 FIX_AXIS_PAR_DIST 0 1 9 READ_ONLY /end AXIS_DESCR
 /begin AXIS_DESCR FIX_AXIS Z_BRS_IDX _CNV_S_5_Enum_EBRS__26_CM_S2 5 0 4 /begin FIX_AXIS_PAR_LIST 0 1 2 3 4 /end FIX_AXIS_PAR_LIST READ_ONLY /end AXIS_DESCR
/end CHARACTERISTIC
/begin CHARACTERISTIC XTAB9X5SCHN_AB_HOCH_D2RS_BRS "" MAP 0x27670C _REC_A1MAP_9_u2_u1_u1_S2 20000 _CNV_R_R_Umr_1_zu_1_3_CM_S2 0 20000 FORMAT "%2.0"
 /begin AXIS_DESCR FIX_AXIS Z_GANG_ZIEL _CNV_S_9_Enum_EGANG_30_CM_S2 9 0 8 FIX_AXIS_PAR_DIST 0 1 9 READ_ONLY /end AXIS_DESCR
 /begin AXIS_DESCR FIX_AXIS Z_BRS_IDX _CNV_S_5_Enum_EBRS__26_CM_S2 5 0 4 /begin FIX_AXIS_PAR_LIST 0 1 2 3 4 /end FIX_AXIS_PAR_LIST READ_ONLY /end AXIS_DESCR
/end CHARACTERISTIC
/begin CHARACTERISTIC XTAB9X5SCHN_AB_MITTEL_BRS "" MAP 0x276766 _REC_A1MAP_9_u2_u1_u1_S2 20000 _CNV_R_R_Umr_1_zu_1_3_CM_S2 0 20000 FORMAT "%2.0"
 /begin AXIS_DESCR FIX_AXIS Z_GANG_ZIEL _CNV_S_9_Enum_EGANG_30_CM_S2 9 0 8 FIX_AXIS_PAR_DIST 0 1 9 READ_ONLY /end AXIS_DESCR
 /begin AXIS_DESCR FIX_AXIS Z_BRS_IDX _CNV_S_5_Enum_EBRS__26_CM_S2 5 0 4 /begin FIX_AXIS_PAR_LIST 0 1 2 3 4 /end FIX_AXIS_PAR_LIST READ_ONLY /end AXIS_DESCR
/end CHARACTERISTIC
/begin CHARACTERISTIC XTAB9X5SCHN_AB_MITTEL_D2RS_BRS "" MAP 0x2767C0 _REC_A1MAP_9_u2_u1_u1_S2 20000 _CNV_R_R_Umr_1_zu_1_3_CM_S2 0 20000 FORMAT "%2.0"
 /begin AXIS_DESCR FIX_AXIS Z_GANG_ZIEL _CNV_S_9_Enum_EGANG_30_CM_S2 9 0 8 FIX_AXIS_PAR_DIST 0 1 9 READ_ONLY /end AXIS_DESCR
 /begin AXIS_DESCR FIX_AXIS Z_BRS_IDX _CNV_S_5_Enum_EBRS__26_CM_S2 5 0 4 /begin FIX_AXIS_PAR_LIST 0 1 2 3 4 /end FIX_AXIS_PAR_LIST READ_ONLY /end AXIS_DESCR
/end CHARACTERISTIC
/begin CHARACTERISTIC XTAB9X5SCHN_AB_SCHWACH_BRS "" MAP 0x27681A _REC_A1MAP_9_u2_u1_u1_S2 20000 _CNV_R_R_Umr_1_zu_1_3_CM_S2 0 20000 FORMAT "%2.0"
 /begin AXIS_DESCR FIX_AXIS Z_GANG_ZIEL _CNV_S_9_Enum_EGANG_30_CM_S2 9 0 8 FIX_AXIS_PAR_DIST 0 1 9 READ_ONLY /end AXIS_DESCR
 /begin AXIS_DESCR FIX_AXIS Z_BRS_IDX _CNV_S_5_Enum_EBRS__26_CM_S2 5 0 4 /begin FIX_AXIS_PAR_LIST 0 1 2 3 4 /end FIX_AXIS_PAR_LIST READ_ONLY /end AXIS_DESCR
/end CHARACTERISTIC
/begin CHARACTERISTIC XTAB9X5SCHN_AB_SCHWACH_D2RS_BRS "" MAP 0x276874 _REC_A1MAP_9_u2_u1_u1_S2 20000 _CNV_R_R_Umr_1_zu_1_3_CM_S2 0 20000 FORMAT "%2.0"
 /begin AXIS_DESCR FIX_AXIS Z_GANG_ZIEL _CNV_S_9_Enum_EGANG_30_CM_S2 9 0 8 FIX_AXIS_PAR_DIST 0 1 9 READ_ONLY /end AXIS_DESCR
 /begin AXIS_DESCR FIX_AXIS Z_BRS_IDX _CNV_S_5_Enum_EBRS__26_CM_S2 5 0 4 /begin FIX_AXIS_PAR_LIST 0 1 2 3 4 /end FIX_AXIS_PAR_LIST READ_ONLY /end AXIS_DESCR
/end CHARACTERISTIC
/begin CHARACTERISTIC XTAB9X5SCHN_AB_SMOOTH_BRS "" MAP 0x2768CE _REC_A1MAP_9_u2_u1_u1_S2 20000 _CNV_R_R_Umr_1_zu_1_3_CM_S2 0 20000 FORMAT "%2.0"
 /begin AXIS_DESCR FIX_AXIS Z_GANG_ZIEL _CNV_S_9_Enum_EGANG_30_CM_S2 9 0 8 FIX_AXIS_PAR_DIST 0 1 9 READ_ONLY /end AXIS_DESCR
 /begin AXIS_DESCR FIX_AXIS Z_BRS_IDX _CNV_S_5_Enum_EBRS__26_CM_S2 5 0 4 /begin FIX_AXIS_PAR_LIST 0 1 2 3 4 /end FIX_AXIS_PAR_LIST READ_ONLY /end AXIS_DESCR
/end CHARACTERISTIC
/begin CHARACTERISTIC XTAB9X5SCHN_AB_SMOOTH_D2RS_BRS "" MAP 0x276928 _REC_A1MAP_9_u2_u1_u1_S2 20000 _CNV_R_R_Umr_1_zu_1_3_CM_S2 0 20000 FORMAT "%2.0"
 /begin AXIS_DESCR FIX_AXIS Z_GANG_ZIEL _CNV_S_9_Enum_EGANG_30_CM_S2 9 0 8 FIX_AXIS_PAR_DIST 0 1 9 READ_ONLY /end AXIS_DESCR
 /begin AXIS_DESCR FIX_AXIS Z_BRS_IDX _CNV_S_5_Enum_EBRS__26_CM_S2 5 0 4 /begin FIX_AXIS_PAR_LIST 0 1 2 3 4 /end FIX_AXIS_PAR_LIST READ_ONLY /end AXIS_DESCR
/end CHARACTERISTIC
/begin CHARACTERISTIC XSCHWNL_BRS "" VALUE 0x2761AE _REC_S1VAL_1_u2_S2 110 _CNV_R_R_Umr_10_zu__9_CM_S2 0 110 FORMAT "%3.1" /end CHARACTERISTIC
/begin CHARACTERISTIC XS_BRS_2RSENBL "" VALUE 0x27B5B9 _REC_S1VAL_1_u1_S2 1 _CNV_R_R_Umr_1_zu_1_2_CM_S2 0 1 FORMAT "%2.0" /end CHARACTERISTIC
/begin CHARACTERISTIC XS_BRS_GANG1EIN "" VALUE 0x27B5BA _REC_S1VAL_1_u1_S2 1 _CNV_R_R_Umr_1_zu_1_2_CM_S2 0 1 FORMAT "%2.0" /end CHARACTERISTIC
/begin CHARACTERISTIC XS_USE_BRSMARS "" VALUE 0x27B4DC _REC_S1VAL_1_u1_S2 1 _CNV_S_2_Schalter_A_4_CM_S2 0 1 /end CHARACTERISTIC
/begin CHARACTERISTIC XZ_BRSDSCERRAUSSTIEG "" VALUE 0x27B4DD _REC_S1VAL_1_u1_S2 2 _CNV_R_R_Umr_1_zu_1_2_CM_S2 0 2 FORMAT "%2.0" /end CHARACTERISTIC
/begin CHARACTERISTIC XZ_DSC_TASTER_BRS "" VALUE 0x27B4DE _REC_S1VAL_1_u1_S2 3 _CNV_S_4_Enum_EDSCB_63_CM_S2 0 3 /end CHARACTERISTIC
/begin CHARACTERISTIC XZ_GANG_MINBRSMUELOW "" VALUE 0x27B4DF _REC_S1VAL_1_u1_S2 8 _CNV_S_9_Enum_EGANG_30_CM_S2 0 8 /end CHARACTERISTIC
/begin CHARACTERISTIC XTAB9SCHDM_AB_FWSDUE "" CURVE 0x27A7A8 _REC_A1CUR_30_s2_u1_S2 65535 _CNV_R_R_Umr_1_zu_1_42_CM_S2 -32768 32767 FORMAT "%2.0"
 /begin AXIS_DESCR FIX_AXIS Z_GANG_IST _CNV_S_9_Enum_EGANG_30_CM_S2 9 0 8 FIX_AXIS_PAR_DIST 0 1 9 READ_ONLY /end AXIS_DESCR
/end CHARACTERISTIC
/begin CHARACTERISTIC XGANG_MAX_DUE "" VALUE 0x27B7A9 _REC_S1VAL_1_u1_S2 8 _CNV_S_9_Enum_EGANG_30_CM_S2 0 8 /end CHARACTERISTIC
/begin CHARACTERISTIC XHSCHTEMP_UMG_DUE "" VALUE 0x27B7AA _REC_S1VAL_1_u1_S2 250 _CNV_R_R_Umr_1_zu_1_1_CM_S2 0 250 FORMAT "%2.0" /end CHARACTERISTIC
/begin CHARACTERISTIC XSCHTEMP_UMG_DUE "" VALUE 0x27A7BA _REC_S1VAL_1_s2_S2 400 _CNV_R_R_Umr_1_zu_1_1_CM_S2 -200 200 FORMAT "%2.0" /end CHARACTERISTIC
/begin CHARACTERISTIC XSCHW_DKKD_DUE "" VALUE 0x27A7BC _REC_S1VAL_1_u2_S2 110 _CNV_R_R_Umr_10_zu__9_CM_S2 0 110 FORMAT "%3.1" /end CHARACTERISTIC
/begin CHARACTERISTIC XSCHW_DKKD_DUEAUS "" VALUE 0x27A7BE _REC_S1VAL_1_u2_S2 110 _CNV_R_R_Umr_10_zu__9_CM_S2 0 110 FORMAT "%3.1" /end CHARACTERISTIC
/begin CHARACTERISTIC XS_USE_DUENESSTEP "" VALUE 0x27B7AB _REC_S1VAL_1_u1_S2 1 _CNV_S_2_Schalter_A_4_CM_S2 0 1 /end CHARACTERISTIC
/begin CHARACTERISTIC XT_DUE_AUS "" VALUE 0x27A7C0 _REC_S1VAL_1_u2_S2 65535 _CNV_R_R_Umr_1_zu_1_6_CM_S2 0 65535 FORMAT "%2.0" /end CHARACTERISTIC
/begin CHARACTERISTIC XT_DUE_EIN "" VALUE 0x27A7C2 _REC_S1VAL_1_u2_S2 65535 _CNV_R_R_Umr_1_zu_1_6_CM_S2 0 65535 FORMAT "%2.0" /end CHARACTERISTIC
/begin CHARACTERISTIC XSCH_HOTMODE_AKTIV "" VALUE 0x27651C _REC_S1VAL_1_u2_S2 2 _CNV_R_R_Umr_1_zu_1_2_CM_S2 0 2 FORMAT "%2.0" /end CHARACTERISTIC
/begin CHARACTERISTIC XS_TMS_SIMULATE "" VALUE 0x27AE73 _REC_S1VAL_1_u1_S2 1 _CNV_R_R_Umr_1_zu_1_2_CM_S2 0 1 FORMAT "%2.0" /end CHARACTERISTIC
/begin CHARACTERISTIC XS_ZWANGKPL_DRIVELOGIC_MODE "" VALUE 0x27AE74 _REC_S1VAL_1_u1_S2 1 _CNV_S_2_Schalter_A_4_CM_S2 0 1 /end CHARACTERISTIC
/begin CHARACTERISTIC XTAB4SCHW_DKKD_ANFGANG "" CURVE 0x276174 _REC_S7CUR_53_u2_u2_S2 110 _CNV_R_R_Umr_10_zu__64_CM_S2 0 110 FORMAT "%3.1"
 /begin AXIS_DESCR STD_AXIS N_AB _CNV_R_R_Umr_1_zu_1_3_CM_S2 4 0 9500 FORMAT "%2.0" /end AXIS_DESCR
/end CHARACTERISTIC
/begin CHARACTERISTIC XTAB5S_GANGVBEGR_ENBL "" CURVE 0x27B5C9 _REC_A1CUR_30_u1_u1_S2 1 _CNV_R_R_Umr_1_zu_1_2_CM_S2 0 1 FORMAT "%2.0"
 /begin AXIS_DESCR FIX_AXIS Z_DRIVE_PROG_FFG _CNV_S_5_Enum_ZDRIV_27_CM_S2 5 0 4 /begin FIX_AXIS_PAR_LIST 0 1 2 3 4 /end FIX_AXIS_PAR_LIST READ_ONLY /end AXIS_DESCR
/end CHARACTERISTIC
/begin CHARACTERISTIC XTAB6X4Z_ANFGANG2_ALLRAD "" MAP 0x2713A0 _REC_A1MAP_9_u1_u1_u1_S2 1 _CNV_R_R_Umr_1_zu_1_2_CM_S2 0 1 FORMAT "%2.0"
 /begin AXIS_DESCR FIX_AXIS Z_DRIVELOGIC _CNV_S_6_Enum_EDL_11_CM_S2 6 1 6 FIX_AXIS_PAR_DIST 1 1 6 READ_ONLY /end AXIS_DESCR
 /begin AXIS_DESCR FIX_AXIS Z_PROG_MODE _CNV_S_4_Enum_EPROG_35_CM_S2 4 0 3 FIX_AXIS_PAR_DIST 0 1 4 READ_ONLY /end AXIS_DESCR
/end CHARACTERISTIC
/begin CHARACTERISTIC XTAB6X4Z_ANFGANG2_ERK "" MAP 0x2713B8 _REC_A1MAP_9_u1_u1_u1_S2 1 _CNV_R_R_Umr_1_zu_1_2_CM_S2 0 1 FORMAT "%2.0"
 /begin AXIS_DESCR FIX_AXIS Z_DRIVELOGIC _CNV_S_6_Enum_EDL_11_CM_S2 6 1 6 FIX_AXIS_PAR_DIST 1 1 6 READ_ONLY /end AXIS_DESCR
 /begin AXIS_DESCR FIX_AXIS Z_PROG_MODE _CNV_S_4_Enum_EPROG_35_CM_S2 4 0 3 FIX_AXIS_PAR_DIST 0 1 4 READ_ONLY /end AXIS_DESCR
/end CHARACTERISTIC
/begin CHARACTERISTIC XHTEMP_GETR_ANFAHRENOBEN "" VALUE 0x276186 _REC_S1VAL_1_u2_S2 20 _CNV_R_R_Umr_1_zu_1_1_CM_S2 0 20 FORMAT "%2.0" /end CHARACTERISTIC
/begin CHARACTERISTIC XSCHM_T_AUS_FLM "" VALUE 0x276188 _REC_S1VAL_1_s2_S2 64000 _CNV_R_R_Umr_1_zu_1_42_CM_S2 -32000 32000 FORMAT "%2.0" /end CHARACTERISTIC
/begin CHARACTERISTIC XSCHN_AB_AUS_FLM "" VALUE 0x27618A _REC_S1VAL_1_u2_S2 20000 _CNV_R_R_Umr_1_zu_1_3_CM_S2 0 20000 FORMAT "%2.0" /end CHARACTERISTIC
/begin CHARACTERISTIC XSCHN_AB_AUS_MUELOW_FREISCH "" VALUE 0x27618C _REC_S1VAL_1_u2_S2 10000 _CNV_R_R_Umr_1_zu_1_2_CM_S2 0 10000 FORMAT "%2.0" /end CHARACTERISTIC
/begin CHARACTERISTIC XSCHN_AB_EIN_FLM "" VALUE 0x27618E _REC_S1VAL_1_u2_S2 10000 _CNV_R_R_Umr_1_zu_1_3_CM_S2 0 10000 FORMAT "%2.0" /end CHARACTERISTIC
/begin CHARACTERISTIC XSCHTEMP_GETR_ANFAHRENOBEN "" VALUE 0x276190 _REC_S1VAL_1_s2_S2 400 _CNV_R_R_Umr_1_zu_1_1_CM_S2 -200 200 FORMAT "%2.0" /end CHARACTERISTIC
/begin CHARACTERISTIC XSCHTEMP_GETR_ANFAHRENUNTEN "" VALUE 0x276192 _REC_S1VAL_1_s2_S2 400 _CNV_R_R_Umr_1_zu_1_1_CM_S2 -200 200 FORMAT "%2.0" /end CHARACTERISTIC
/begin CHARACTERISTIC XSCHV_FZG_ANFGANG2 "" VALUE 0x276194 _REC_S1VAL_1_u2_S2 400 _CNV_R_R_Umr_1_zu_1_8_CM_S2 0 400 FORMAT "%2.0" /end CHARACTERISTIC
/begin CHARACTERISTIC XSCHV_FZG_MAX_FLM "" VALUE 0x276196 _REC_S1VAL_1_u2_S2 10000 _CNV_R_R_Umr_1_zu_1_8_CM_S2 0 10000 FORMAT "%2.0" /end CHARACTERISTIC
/begin CHARACTERISTIC XSCHW_DKKD_AUS_FESTBREMS "" VALUE 0x27943C _REC_S1VAL_1_u2_S2 110 _CNV_R_R_Umr_10_zu__9_CM_S2 0 110 FORMAT "%3.1" /end CHARACTERISTIC
/begin CHARACTERISTIC XSCHW_DKKD_FLM_AUS "" VALUE 0x276198 _REC_S1VAL_1_u2_S2 110 _CNV_R_R_Umr_10_zu__9_CM_S2 0 110 FORMAT "%3.1" /end CHARACTERISTIC
/begin CHARACTERISTIC XSCHW_STEIGUNG_ANFGANG2 "" VALUE 0x27619A _REC_S1VAL_1_s2_S2 200 _CNV_R_R_Umr_10_zu__9_CM_S2 0 200 FORMAT "%3.1" /end CHARACTERISTIC
/begin CHARACTERISTIC XSCHW_STEIGUNG_MUELOW_FREISCH "" VALUE 0x27619C _REC_S1VAL_1_s2_S2 400 _CNV_R_R_Umr_10_zu__9_CM_S2 -200 200 FORMAT "%3.1" /end CHARACTERISTIC
/begin CHARACTERISTIC XSCH_HOTMODE_ANFGANG2 "" VALUE 0x27B4D6 _REC_S1VAL_1_u1_S2 4 _CNV_R_R_Umr_1_zu_1_2_CM_S2 0 4 FORMAT "%2.0" /end CHARACTERISTIC
/begin CHARACTERISTIC XT_MUELOW_FREISCH "" VALUE 0x27619E _REC_S1VAL_1_u2_S2 30000 _CNV_R_R_Umr_1_zu_1_6_CM_S2 0 30000 FORMAT "%2.0" /end CHARACTERISTIC
/begin CHARACTERISTIC XZ_ANHAENGER_ANFGANG2 "" VALUE 0x27B4D7 _REC_S1VAL_1_u1_S2 2 _CNV_S_3_Enum_EANH_65_CM_S2 0 2 /end CHARACTERISTIC
/begin CHARACTERISTIC XZ_DSC_FLM "" VALUE 0x27B4D8 _REC_S1VAL_1_u1_S2 3 _CNV_S_4_Enum_EDSCA_66_CM_S2 0 3 /end CHARACTERISTIC
/begin CHARACTERISTIC XGKLY10W_DKKD_BPL5A_0 "" CURVE 0x274D30 _REC_A1CUR_1_u2_u2_S2 110 _CNV_R_R_Umr_10_zu__9_CM_S2 0 110 FORMAT "%3.1"
 /begin AXIS_DESCR COM_AXIS N_AB _CNV_R_R_Umr_1_zu_1_3_CM_S2 10 0 20000 AXIS_PTS_REF SSTW_DKKD_BPL5 FORMAT "%2.0" /end AXIS_DESCR
/end CHARACTERISTIC
/begin CHARACTERISTIC XGKLY10W_DKKD_BPL5A_1 "" CURVE 0x274D44 _REC_A1CUR_1_u2_u2_S2 110 _CNV_R_R_Umr_10_zu__9_CM_S2 0 110 FORMAT "%3.1"
 /begin AXIS_DESCR COM_AXIS N_AB _CNV_R_R_Umr_1_zu_1_3_CM_S2 10 0 20000 AXIS_PTS_REF SSTW_DKKD_BPL5 FORMAT "%2.0" /end AXIS_DESCR
/end CHARACTERISTIC
/begin CHARACTERISTIC XGKLY10W_DKKD_BPL5A_2 "" CURVE 0x274D58 _REC_A1CUR_1_u2_u2_S2 110 _CNV_R_R_Umr_10_zu__9_CM_S2 0 110 FORMAT "%3.1"
 /begin AXIS_DESCR COM_AXIS N_AB _CNV_R_R_Umr_1_zu_1_3_CM_S2 10 0 20000 AXIS_PTS_REF SSTW_DKKD_BPL5 FORMAT "%2.0" /end AXIS_DESCR
/end CHARACTERISTIC
/begin CHARACTERISTIC XGKLY10W_DKKD_BPL5S_0 "" CURVE 0x274D6C _REC_A1CUR_1_u2_u2_S2 110 _CNV_R_R_Umr_10_zu__9_CM_S2 0 110 FORMAT "%3.1"
 /begin AXIS_DESCR COM_AXIS N_AB _CNV_R_R_Umr_1_zu_1_3_CM_S2 10 0 20000 AXIS_PTS_REF SSTW_DKKD_BPL5 FORMAT "%2.0" /end AXIS_DESCR
/end CHARACTERISTIC
/begin CHARACTERISTIC XGKLY10W_DKKD_BPL5S_1 "" CURVE 0x274D80 _REC_A1CUR_1_u2_u2_S2 110 _CNV_R_R_Umr_10_zu__9_CM_S2 0 110 FORMAT "%3.1"
 /begin AXIS_DESCR COM_AXIS N_AB _CNV_R_R_Umr_1_zu_1_3_CM_S2 10 0 20000 AXIS_PTS_REF SSTW_DKKD_BPL5 FORMAT "%2.0" /end AXIS_DESCR
/end CHARACTERISTIC
/begin CHARACTERISTIC XGKLY10W_DKKD_BPL5S_2 "" CURVE 0x274D94 _REC_A1CUR_1_u2_u2_S2 110 _CNV_R_R_Umr_10_zu__9_CM_S2 0 110 FORMAT "%3.1"
 /begin AXIS_DESCR COM_AXIS N_AB _CNV_R_R_Umr_1_zu_1_3_CM_S2 10 0 20000 AXIS_PTS_REF SSTW_DKKD_BPL5 FORMAT "%2.0" /end AXIS_DESCR
/end CHARACTERISTIC
/begin CHARACTERISTIC XGKLY6W_DKKD_BPLOTHERA_0 "" CURVE 0x274DA8 _REC_A1CUR_1_u2_u2_S2 110 _CNV_R_R_Umr_10_zu__9_CM_S2 0 110 FORMAT "%3.1"
 /begin AXIS_DESCR COM_AXIS N_AB _CNV_R_R_Umr_1_zu_1_3_CM_S2 6 0 20000 AXIS_PTS_REF SSTW_DKKD_BPLOTHER FORMAT "%2.0" /end AXIS_DESCR
/end CHARACTERISTIC
/begin CHARACTERISTIC XGKLY6W_DKKD_BPLOTHERA_1 "" CURVE 0x274DB4 _REC_A1CUR_1_u2_u2_S2 110 _CNV_R_R_Umr_10_zu__9_CM_S2 0 110 FORMAT "%3.1"
 /begin AXIS_DESCR COM_AXIS N_AB _CNV_R_R_Umr_1_zu_1_3_CM_S2 6 0 20000 AXIS_PTS_REF SSTW_DKKD_BPLOTHER FORMAT "%2.0" /end AXIS_DESCR
/end CHARACTERISTIC
/begin CHARACTERISTIC XGKLY6W_DKKD_BPLOTHERA_2 "" CURVE 0x274DC0 _REC_A1CUR_1_u2_u2_S2 110 _CNV_R_R_Umr_10_zu__9_CM_S2 0 110 FORMAT "%3.1"
 /begin AXIS_DESCR COM_AXIS N_AB _CNV_R_R_Umr_1_zu_1_3_CM_S2 6 0 20000 AXIS_PTS_REF SSTW_DKKD_BPLOTHER FORMAT "%2.0" /end AXIS_DESCR
/end CHARACTERISTIC
/begin CHARACTERISTIC XGKLY6W_DKKD_BPLOTHERS_0 "" CURVE 0x274DCC _REC_A1CUR_1_u2_u2_S2 110 _CNV_R_R_Umr_10_zu__9_CM_S2 0 110 FORMAT "%3.1"
 /begin AXIS_DESCR COM_AXIS N_AB _CNV_R_R_Umr_1_zu_1_3_CM_S2 6 0 20000 AXIS_PTS_REF SSTW_DKKD_BPLOTHER FORMAT "%2.0" /end AXIS_DESCR
/end CHARACTERISTIC
/begin CHARACTERISTIC XGKLY6W_DKKD_BPLOTHERS_1 "" CURVE 0x274DD8 _REC_A1CUR_1_u2_u2_S2 110 _CNV_R_R_Umr_10_zu__9_CM_S2 0 110 FORMAT "%3.1"
 /begin AXIS_DESCR COM_AXIS N_AB _CNV_R_R_Umr_1_zu_1_3_CM_S2 6 0 20000 AXIS_PTS_REF SSTW_DKKD_BPLOTHER FORMAT "%2.0" /end AXIS_DESCR
/end CHARACTERISTIC
/begin CHARACTERISTIC XGKLY6W_DKKD_BPLOTHERS_2 "" CURVE 0x274DE4 _REC_A1CUR_1_u2_u2_S2 110 _CNV_R_R_Umr_10_zu__9_CM_S2 0 110 FORMAT "%3.1"
 /begin AXIS_DESCR COM_AXIS N_AB _CNV_R_R_Umr_1_zu_1_3_CM_S2 6 0 20000 AXIS_PTS_REF SSTW_DKKD_BPLOTHER FORMAT "%2.0" /end AXIS_DESCR
/end CHARACTERISTIC
/begin CHARACTERISTIC XKLY2X4C_SCHLEPP_FT_0 "" CURVE 0x27A3FE _REC_S7CUR_53_s2_s2_S2 65535 _CNV_R_R_Umr_1_zu_1_2_CM_S2 -32768 32767 FORMAT "%2.0"
 /begin AXIS_DESCR STD_AXIS C_SCHLEPP_FT _CNV_R_R_Umr_1_zu_1_2_CM_S2 4 0 32767 FORMAT "%2.0" /end AXIS_DESCR
/end CHARACTERISTIC
/begin CHARACTERISTIC XKLY2X4C_SCHLEPP_FT_1 "" CURVE 0x27A410 _REC_S7CUR_53_s2_s2_S2 65535 _CNV_R_R_Umr_1_zu_1_2_CM_S2 -32768 32767 FORMAT "%2.0"
 /begin AXIS_DESCR STD_AXIS C_SCHLEPP_FT _CNV_R_R_Umr_1_zu_1_2_CM_S2 4 0 32767 FORMAT "%2.0" /end AXIS_DESCR
/end CHARACTERISTIC
/begin CHARACTERISTIC XKLY5DC_SCHLEPP_KURVEAAGS "" CURVE 0x27A3D2 _REC_S7CUR_53_s2_s2_S2 65535 _CNV_R_R_Umr_1_zu_1_2_CM_S2 -32768 32767 FORMAT "%2.0"
 /begin AXIS_DESCR STD_AXIS A_Q_FILT _CNV_R_R_Umr_10_zu__46_CM_S2 5 -3276.8 3276.7 FORMAT "%3.1" /end AXIS_DESCR
/end CHARACTERISTIC
/begin CHARACTERISTIC XKLY5DC_SCHLEPP_KURVESAGS "" CURVE 0x27A3E8 _REC_S7CUR_53_s2_s2_S2 65535 _CNV_R_R_Umr_1_zu_1_2_CM_S2 -32768 32767 FORMAT "%2.0"
 /begin AXIS_DESCR STD_AXIS A_Q_FILT _CNV_R_R_Umr_10_zu__46_CM_S2 5 -3276.8 3276.7 FORMAT "%3.1" /end AXIS_DESCR
/end CHARACTERISTIC
/begin CHARACTERISTIC XTAB2C_BER_MAX "" CURVE 0x273C18 _REC_A1CUR_30_s2_u1_S2 65535 _CNV_R_R_Umr_1_zu_1_2_CM_S2 -32768 32767 FORMAT "%2.0"
 /begin AXIS_DESCR FIX_AXIS Z_AGS_MODBEDEL _CNV_S_2_Enum_EAGS_25_CM_S2 2 0 1 FIX_AXIS_PAR_DIST 0 1 2 READ_ONLY /end AXIS_DESCR
/end CHARACTERISTIC
/begin CHARACTERISTIC XTAB2C_BER_MIN "" CURVE 0x273C1C _REC_A1CUR_30_s2_u1_S2 65535 _CNV_R_R_Umr_1_zu_1_2_CM_S2 -32768 32767 FORMAT "%2.0"
 /begin AXIS_DESCR FIX_AXIS Z_AGS_MODBEDEL _CNV_S_2_Enum_EAGS_25_CM_S2 2 0 1 FIX_AXIS_PAR_DIST 0 1 2 READ_ONLY /end AXIS_DESCR
/end CHARACTERISTIC
/begin CHARACTERISTIC XTAB2SCHGW_FPFILT_BPL_SCHUB "" CURVE 0x27AC2E _REC_S7CUR_53_s2_u2_S2 65535 _CNV_R_R_Umr_1_zu_1_7_CM_S2 -32768 32767 FORMAT "%2.0"
 /begin AXIS_DESCR STD_AXIS W_DKKD _CNV_R_R_Umr_10_zu__9_CM_S2 2 0 110 FORMAT "%3.1" /end AXIS_DESCR
/end CHARACTERISTIC
/begin CHARACTERISTIC XTAB2SCHGW_FPFILT_OBEN "" CURVE 0x273CB0 _REC_A1CUR_30_s2_u1_S2 65535 _CNV_R_R_Umr_1_zu_1_7_CM_S2 -32768 32767 FORMAT "%2.0"
 /begin AXIS_DESCR FIX_AXIS Z_AGS_MODBEDEL _CNV_S_2_Enum_EAGS_25_CM_S2 2 0 1 FIX_AXIS_PAR_DIST 0 1 2 READ_ONLY /end AXIS_DESCR
/end CHARACTERISTIC
/begin CHARACTERISTIC XTAB2SCHGW_FPFILT_UNTEN "" CURVE 0x273CB4 _REC_A1CUR_30_s2_u1_S2 65535 _CNV_R_R_Umr_1_zu_1_7_CM_S2 -32768 32767 FORMAT "%2.0"
 /begin AXIS_DESCR FIX_AXIS Z_AGS_MODBEDEL _CNV_S_2_Enum_EAGS_25_CM_S2 2 0 1 FIX_AXIS_PAR_DIST 0 1 2 READ_ONLY /end AXIS_DESCR
/end CHARACTERISTIC
/begin CHARACTERISTIC XTAB2T_PRUEF_BRFTUP_ES_BRS "" CURVE 0x273BDC _REC_A1CUR_30_u2_u1_S2 5000 _CNV_R_R_Umr_1_zu_1_6_CM_S2 0 5000 FORMAT "%2.0"
 /begin AXIS_DESCR FIX_AXIS Z_AGS_MODBEDEL _CNV_S_2_Enum_EAGS_25_CM_S2 2 0 1 FIX_AXIS_PAR_DIST 0 1 2 READ_ONLY /end AXIS_DESCR
/end CHARACTERISTIC
/begin CHARACTERISTIC XTAB2T_PRUEF_BRFTUP_SXS_BRS "" CURVE 0x273BE0 _REC_A1CUR_30_u2_u1_S2 5000 _CNV_R_R_Umr_1_zu_1_6_CM_S2 0 5000 FORMAT "%2.0"
 /begin AXIS_DESCR FIX_AXIS Z_AGS_MODBEDEL _CNV_S_2_Enum_EAGS_25_CM_S2 2 0 1 FIX_AXIS_PAR_DIST 0 1 2 READ_ONLY /end AXIS_DESCR
/end CHARACTERISTIC
/begin CHARACTERISTIC XTAB2T_PRUEF_BRFTUP_XEE_BRS "" CURVE 0x273BE4 _REC_A1CUR_30_u2_u1_S2 5000 _CNV_R_R_Umr_1_zu_1_6_CM_S2 0 5000 FORMAT "%2.0"
 /begin AXIS_DESCR FIX_AXIS Z_AGS_MODBEDEL _CNV_S_2_Enum_EAGS_25_CM_S2 2 0 1 FIX_AXIS_PAR_DIST 0 1 2 READ_ONLY /end AXIS_DESCR
/end CHARACTERISTIC
/begin CHARACTERISTIC XTAB2T_SCHLEPP "" CURVE 0x273CBC _REC_A1CUR_30_u4_u1_S2 4.29497E+009 _CNV_R_R_Umr_1_zu_1_6_CM_S2 0 4294967295 FORMAT "%2.0"
 /begin AXIS_DESCR FIX_AXIS Z_AGS_MODBEDEL _CNV_S_2_Enum_EAGS_25_CM_S2 2 0 1 FIX_AXIS_PAR_DIST 0 1 2 READ_ONLY /end AXIS_DESCR
/end CHARACTERISTIC
/begin CHARACTERISTIC XTAB2T_VERBOT_SCHLEPP "" CURVE 0x273CC4 _REC_A1CUR_30_u4_u1_S2 4.29497E+009 _CNV_R_R_Umr_1_zu_1_6_CM_S2 0 4294967295 FORMAT "%2.0"
 /begin AXIS_DESCR FIX_AXIS Z_AGS_MODBEDEL _CNV_S_2_Enum_EAGS_25_CM_S2 2 0 1 FIX_AXIS_PAR_DIST 0 1 2 READ_ONLY /end AXIS_DESCR
/end CHARACTERISTIC
/begin CHARACTERISTIC XTAB3DC_SCHLEPP_KICKFAST "" CURVE 0x27A3CC _REC_A1CUR_30_s2_u1_S2 65535 _CNV_R_R_Umr_1_zu_1_2_CM_S2 -32768 32767 FORMAT "%2.0"
 /begin AXIS_DESCR FIX_AXIS Z_FT _CNV_S_4_Enum_EFT_29_CM_S2 3 0 3 FIX_AXIS_PAR_DIST 0 1 3 READ_ONLY /end AXIS_DESCR
/end CHARACTERISTIC
/begin CHARACTERISTIC XTAB3X3FAKT_HEISSHOCH "" MAP 0x273C78 _REC_S7MAP_53_u2_s2_u2_S2 500 _CNV_R_R_Umr_1_zu_1_69_CM_S2 0 500 FORMAT "%2.0"
 /begin AXIS_DESCR STD_AXIS TEMP_UMG _CNV_R_R_Umr_1_zu_1_1_CM_S2 3 -50 80 FORMAT "%2.0" /end AXIS_DESCR
 /begin AXIS_DESCR STD_AXIS P_LUFT _CNV_R_R_Umr_1_zu_1_0_CM_S2 3 598 1108 FORMAT "%2.0" /end AXIS_DESCR
/end CHARACTERISTIC
/begin CHARACTERISTIC XTAB3X4_KICKFAST "" MAP 0x273C98 _REC_A1MAP_9_s2_u1_u1_S2 65535 _CNV_R_R_Umr_1_zu_1_7_CM_S2 -32768 32767 FORMAT "%2.0"
 /begin AXIS_DESCR FIX_AXIS Z_FT _CNV_S_4_Enum_EFT_29_CM_S2 3 0 3 FIX_AXIS_PAR_DIST 0 1 3 READ_ONLY /end AXIS_DESCR
 /begin AXIS_DESCR FIX_AXIS Z_FT _CNV_S_4_Enum_EFT_29_CM_S2 4 0 3 FIX_AXIS_PAR_DIST 0 1 4 READ_ONLY /end AXIS_DESCR
/end CHARACTERISTIC
/begin CHARACTERISTIC XTAB3Z_FT_AQUER "" CURVE 0x27B7B9 _REC_A1CUR_30_u1_u1_S2 3 _CNV_S_4_Enum_EFT_29_CM_S2 0 3
 /begin AXIS_DESCR FIX_AXIS Z_C_AQUER_FT _CNV_R_R_Umr_1_zu_1_2_CM_S2 3 0 255 /begin FIX_AXIS_PAR_LIST 0 1 2 /end FIX_AXIS_PAR_LIST FORMAT "%2.0" READ_ONLY /end AXIS_DESCR
/end CHARACTERISTIC
/begin CHARACTERISTIC XTAB3Z_FT_KICKFAST "" CURVE 0x27B70C _REC_A1CUR_30_u1_u1_S2 3 _CNV_R_R_Umr_1_zu_1_2_CM_S2 0 3 FORMAT "%2.0"
 /begin AXIS_DESCR FIX_AXIS Z_FT _CNV_S_4_Enum_EFT_29_CM_S2 3 0 3 FIX_AXIS_PAR_DIST 0 1 3 READ_ONLY /end AXIS_DESCR
/end CHARACTERISTIC
/begin CHARACTERISTIC XTAB4C_FT_MAX "" CURVE 0x273C20 _REC_A1CUR_30_s2_u1_S2 65535 _CNV_R_R_Umr_1_zu_1_2_CM_S2 -32768 32767 FORMAT "%2.0"
 /begin AXIS_DESCR FIX_AXIS Z_FT _CNV_S_4_Enum_EFT_29_CM_S2 4 0 3 FIX_AXIS_PAR_DIST 0 1 4 READ_ONLY /end AXIS_DESCR
/end CHARACTERISTIC
/begin CHARACTERISTIC XTAB4C_FT_MIN "" CURVE 0x273C28 _REC_A1CUR_30_s2_u1_S2 65535 _CNV_R_R_Umr_1_zu_1_2_CM_S2 -32768 32767 FORMAT "%2.0"
 /begin AXIS_DESCR FIX_AXIS Z_FT _CNV_S_4_Enum_EFT_29_CM_S2 4 0 3 FIX_AXIS_PAR_DIST 0 1 4 READ_ONLY /end AXIS_DESCR
/end CHARACTERISTIC
/begin CHARACTERISTIC XTAB4C_FT_MIT "" CURVE 0x273C30 _REC_A1CUR_30_s2_u1_S2 65535 _CNV_R_R_Umr_1_zu_1_2_CM_S2 -32768 32767 FORMAT "%2.0"
 /begin AXIS_DESCR FIX_AXIS Z_FT _CNV_S_4_Enum_EFT_29_CM_S2 4 0 3 FIX_AXIS_PAR_DIST 0 1 4 READ_ONLY /end AXIS_DESCR
/end CHARACTERISTIC
/begin CHARACTERISTIC XTAB4HM_BR_BRS "" CURVE 0x273BE8 _REC_A1CUR_30_u2_u1_S2 65535 _CNV_R_R_Umr_1_zu_1_42_CM_S2 0 65535 FORMAT "%2.0"
 /begin AXIS_DESCR FIX_AXIS Z_AGSMOD_ECO_EFAHREN _CNV_S_4_Enum_EAGS__24_CM_S2 4 0 3 FIX_AXIS_PAR_DIST 0 1 4 READ_ONLY /end AXIS_DESCR
/end CHARACTERISTIC
/begin CHARACTERISTIC XTAB4SCH_AQUER_FT "" CURVE 0x274DF8 _REC_A1CUR_30_u2_u1_S2 100 _CNV_R_R_Umr_10_zu__46_CM_S2 0 100 FORMAT "%3.1"
 /begin AXIS_DESCR FIX_AXIS Z_FT _CNV_S_4_Enum_EFT_29_CM_S2 4 0 3 /begin FIX_AXIS_PAR_LIST 0 1 2 3 /end FIX_AXIS_PAR_LIST READ_ONLY /end AXIS_DESCR
/end CHARACTERISTIC
/begin CHARACTERISTIC XTAB4X4_CR "" MAP 0x273C40 _REC_A1MAP_9_s2_u1_u1_S2 65535 _CNV_R_R_Umr_1_zu_1_2_CM_S2 -32768 32767 FORMAT "%2.0"
 /begin AXIS_DESCR FIX_AXIS Z_FT _CNV_S_4_Enum_EFT_29_CM_S2 4 0 3 FIX_AXIS_PAR_DIST 0 1 4 READ_ONLY /end AXIS_DESCR
 /begin AXIS_DESCR FIX_AXIS Z_FT_BPL _CNV_S_4_Enum_EFT_29_CM_S2 4 0 3 FIX_AXIS_PAR_DIST 0 1 4 READ_ONLY /end AXIS_DESCR
/end CHARACTERISTIC
/begin CHARACTERISTIC XTAB4X5DC_SCHLEPP_BRMAX "" MAP 0x273BF0 _REC_A1MAP_9_s2_u1_u1_S2 65535 _CNV_R_R_Umr_1_zu_1_2_CM_S2 -32768 32767 FORMAT "%2.0"
 /begin AXIS_DESCR FIX_AXIS Z_AGSMOD_ECO_EFAHREN _CNV_S_4_Enum_EAGS__24_CM_S2 4 0 3 FIX_AXIS_PAR_DIST 0 1 4 READ_ONLY /end AXIS_DESCR
 /begin AXIS_DESCR FIX_AXIS Z_FT_MBR _CNV_S_5_Enum_EFT2_67_CM_S2 5 0 4 FIX_AXIS_PAR_DIST 0 1 5 READ_ONLY /end AXIS_DESCR
/end CHARACTERISTIC
/begin CHARACTERISTIC XTAB4X6Z_PROG_FT_MAX "" MAP 0x273C60 _REC_A1MAP_9_u1_u1_u1_S2 3 _CNV_S_4_Enum_EPROG_70_CM_S2 0 3
 /begin AXIS_DESCR FIX_AXIS Z_PROG_MODE _CNV_S_4_Enum_EPROG_35_CM_S2 4 0 3 FIX_AXIS_PAR_DIST 0 1 4 READ_ONLY /end AXIS_DESCR
 /begin AXIS_DESCR FIX_AXIS Z_DRIVELOGIC _CNV_S_6_Enum_EDL_11_CM_S2 6 1 6 FIX_AXIS_PAR_DIST 1 1 6 READ_ONLY /end AXIS_DESCR
/end CHARACTERISTIC
/begin CHARACTERISTIC XTAB4Z_FT_KD "" CURVE 0x273C38 _REC_A1CUR_30_u1_u1_S2 3 _CNV_S_4_Enum_EFT_29_CM_S2 0 3
 /begin AXIS_DESCR FIX_AXIS Z_FT _CNV_S_4_Enum_EFT_29_CM_S2 4 0 3 /begin FIX_AXIS_PAR_LIST 0 1 2 3 /end FIX_AXIS_PAR_LIST READ_ONLY /end AXIS_DESCR
/end CHARACTERISTIC
/begin CHARACTERISTIC XTAB4Z_PROG_FT "" CURVE 0x273C3C _REC_A1CUR_30_u1_u1_S2 3 _CNV_S_4_Enum_EPROG_70_CM_S2 0 3
 /begin AXIS_DESCR FIX_AXIS Z_FT _CNV_S_4_Enum_EFT_29_CM_S2 4 0 3 FIX_AXIS_PAR_DIST 0 1 4 READ_ONLY /end AXIS_DESCR
/end CHARACTERISTIC
/begin CHARACTERISTIC XTAB5SCHM_BR_BPL "" CURVE 0x27AC38 _REC_A1CUR_30_s2_u1_S2 32768 _CNV_R_R_Umr_1_zu_1_42_CM_S2 -32768 0 FORMAT "%2.0"
 /begin AXIS_DESCR FIX_AXIS Z_FT_MBR _CNV_S_5_Enum_EFT2_67_CM_S2 5 0 4 /begin FIX_AXIS_PAR_LIST 0 1 2 3 4 /end FIX_AXIS_PAR_LIST READ_ONLY /end AXIS_DESCR
/end CHARACTERISTIC
/begin CHARACTERISTIC XTAB5Z_FT_BR "" CURVE 0x27B704 _REC_A1CUR_30_u1_u1_S2 3 _CNV_S_4_Enum_EFT_29_CM_S2 0 3
 /begin AXIS_DESCR FIX_AXIS Z_FT_MBR _CNV_S_5_Enum_EFT2_67_CM_S2 5 0 4 FIX_AXIS_PAR_DIST 0 1 5 READ_ONLY /end AXIS_DESCR
/end CHARACTERISTIC
/begin CHARACTERISTIC XTAB5_KORFAKT_MBR_BRS "" CURVE 0x27A2B6 _REC_S7CUR_53_u2_s2_S2 500 _CNV_R_R_Umr_1_zu_1_53_CM_S2 0 500 FORMAT "%2.0"
 /begin AXIS_DESCR STD_AXIS M_BR _CNV_R_R_Umr_1_zu_1_42_CM_S2 5 -32768 0 FORMAT "%4.2" /end AXIS_DESCR
/end CHARACTERISTIC
/begin CHARACTERISTIC XTAB6X4_MBR_AAGS_BRS "" MAP 0x27A2CC _REC_S3MAP_54_s2_s2_u1_S2 65535 _CNV_R_R_Umr_1_zu_1_42_CM_S2 -32768 32767 FORMAT "%2.0"
 /begin AXIS_DESCR STD_AXIS DM_AB_FWS_FILT _CNV_R_R_Umr_1_zu_1_42_CM_S2 6 -32768 32767 /end AXIS_DESCR
 /begin AXIS_DESCR FIX_AXIS Z_FT_MBR _CNV_S_5_Enum_EFT2_67_CM_S2 4 0 4 FIX_AXIS_PAR_DIST 0 1 4 READ_ONLY /end AXIS_DESCR
/end CHARACTERISTIC
/begin CHARACTERISTIC XTAB6X4_MBR_ECO_BRS "" MAP 0x27A30A _REC_S3MAP_54_s2_s2_u1_S2 65535 _CNV_R_R_Umr_1_zu_1_42_CM_S2 -32768 32767 FORMAT "%2.0"
 /begin AXIS_DESCR STD_AXIS DM_AB_FWS_FILT _CNV_R_R_Umr_1_zu_1_42_CM_S2 6 -32768 32767 /end AXIS_DESCR
 /begin AXIS_DESCR FIX_AXIS Z_FT_MBR _CNV_S_5_Enum_EFT2_67_CM_S2 4 0 4 FIX_AXIS_PAR_DIST 0 1 4 READ_ONLY /end AXIS_DESCR
/end CHARACTERISTIC
/begin CHARACTERISTIC XTAB6X4_MBR_EFAHREN_BRS "" MAP 0x27A348 _REC_S3MAP_54_s2_s2_u1_S2 65535 _CNV_R_R_Umr_1_zu_1_42_CM_S2 -32768 32767 FORMAT "%2.0"
 /begin AXIS_DESCR STD_AXIS DM_AB_FWS_FILT _CNV_R_R_Umr_1_zu_1_42_CM_S2 6 -32768 32767 /end AXIS_DESCR
 /begin AXIS_DESCR FIX_AXIS Z_FT_MBR _CNV_S_5_Enum_EFT2_67_CM_S2 4 0 4 FIX_AXIS_PAR_DIST 0 1 4 READ_ONLY /end AXIS_DESCR
/end CHARACTERISTIC
/begin CHARACTERISTIC XTAB6X4_MBR_SAGS_BRS "" MAP 0x27A386 _REC_S3MAP_54_s2_s2_u1_S2 65535 _CNV_R_R_Umr_1_zu_1_42_CM_S2 -32768 32767 FORMAT "%2.0"
 /begin AXIS_DESCR STD_AXIS DM_AB_FWS_FILT _CNV_R_R_Umr_1_zu_1_42_CM_S2 6 -32768 32767 /end AXIS_DESCR
 /begin AXIS_DESCR FIX_AXIS Z_FT_MBR _CNV_S_5_Enum_EFT2_67_CM_S2 4 0 4 FIX_AXIS_PAR_DIST 0 1 4 READ_ONLY /end AXIS_DESCR
/end CHARACTERISTIC
/begin CHARACTERISTIC XTAB9S_BPL_MODE "" CURVE 0x27B7AF _REC_A1CUR_30_u1_u1_S2 1 _CNV_R_R_Umr_1_zu_1_2_CM_S2 0 1 FORMAT "%2.0"
 /begin AXIS_DESCR FIX_AXIS Z_GANG_IST _CNV_S_9_Enum_EGANG_30_CM_S2 9 0 8 FIX_AXIS_PAR_DIST 0 1 9 READ_ONLY /end AXIS_DESCR
/end CHARACTERISTIC
/begin CHARACTERISTIC XW_DKKD_BPL "" CURVE 0x274DF0 _REC_A1CUR_30_u2_u1_S2 110 _CNV_R_R_Umr_10_zu__9_CM_S2 0 110 FORMAT "%3.1"
 /begin AXIS_DESCR FIX_AXIS Z_AGS_MODBEDEL _CNV_S_2_Enum_EAGS_25_CM_S2 2 0 1 FIX_AXIS_PAR_DIST 0 1 2 READ_ONLY /end AXIS_DESCR
/end CHARACTERISTIC
/begin CHARACTERISTIC XC_CR_MINUS "" VALUE 0x27A3C4 _REC_S1VAL_1_s2_S2 65535 _CNV_R_R_Umr_1_zu_1_2_CM_S2 -32768 32767 FORMAT "%2.0" /end CHARACTERISTIC
/begin CHARACTERISTIC XC_CR_PLUS "" VALUE 0x27A3C6 _REC_S1VAL_1_s2_S2 65535 _CNV_R_R_Umr_1_zu_1_2_CM_S2 -32768 32767 FORMAT "%2.0" /end CHARACTERISTIC
/begin CHARACTERISTIC XGW_FP_CR "" VALUE 0x27A3C8 _REC_S1VAL_1_s2_S2 65535 _CNV_R_R_Umr_1_zu_1_7_CM_S2 -32768 32767 FORMAT "%2.0" /end CHARACTERISTIC
/begin CHARACTERISTIC XGW_FP_FILTSCHLEPP "" VALUE 0x27A422 _REC_S1VAL_1_s2_S2 65535 _CNV_R_R_Umr_1_zu_1_7_CM_S2 -32768 32767 FORMAT "%2.0" /end CHARACTERISTIC
/begin CHARACTERISTIC XOC_FT_MAX "" VALUE 0x27A3CA _REC_S1VAL_1_s2_S2 65535 _CNV_R_R_Umr_1_zu_1_2_CM_S2 -32768 32767 FORMAT "%2.0" /end CHARACTERISTIC
/begin CHARACTERISTIC XSCHC_SCHLEPP_REFMAX "" VALUE 0x27A424 _REC_S1VAL_1_s2_S2 65535 _CNV_R_R_Umr_1_zu_1_2_CM_S2 -32768 32767 FORMAT "%2.0" /end CHARACTERISTIC
/begin CHARACTERISTIC XSCHGW_FPFILT_BPLBEW "" VALUE 0x27AC42 _REC_S1VAL_1_s2_S2 65535 _CNV_R_R_Umr_1_zu_1_7_CM_S2 -32768 32767 FORMAT "%2.0" /end CHARACTERISTIC
/begin CHARACTERISTIC XSCHGW_FP_MAXFILTBPLBEW "" VALUE 0x27AC44 _REC_S1VAL_1_s2_S2 65535 _CNV_R_R_Umr_1_zu_1_7_CM_S2 -32768 32767 FORMAT "%2.0" /end CHARACTERISTIC
/begin CHARACTERISTIC XSCHV_FZG_AQUER_FT "" VALUE 0x27AC46 _REC_S1VAL_1_u2_S2 500 _CNV_R_R_Umr_1_zu_1_8_CM_S2 0 500 FORMAT "%2.0" /end CHARACTERISTIC
/begin CHARACTERISTIC XS_BPL "" VALUE 0x27B7B8 _REC_S1VAL_1_u1_S2 1 _CNV_R_R_Umr_1_zu_1_2_CM_S2 0 1 FORMAT "%2.0" /end CHARACTERISTIC
/begin CHARACTERISTIC XS_FAHRERTYP "" VALUE 0x27B70A _REC_S1VAL_1_u1_S2 1 _CNV_R_R_Umr_1_zu_1_2_CM_S2 0 1 FORMAT "%2.0" /end CHARACTERISTIC
/begin CHARACTERISTIC XS_KICKFAST "" VALUE 0x27B70F _REC_S1VAL_1_u1_S2 1 _CNV_R_R_Umr_1_zu_1_2_CM_S2 0 1 FORMAT "%2.0" /end CHARACTERISTIC
/begin CHARACTERISTIC XS_KURVE_BEW "" VALUE 0x27B710 _REC_S1VAL_1_u1_S2 1 _CNV_R_R_Umr_1_zu_1_2_CM_S2 0 1 FORMAT "%2.0" /end CHARACTERISTIC
/begin CHARACTERISTIC XS_SCHLEPP "" VALUE 0x27B711 _REC_S1VAL_1_u1_S2 2 _CNV_R_R_Umr_1_zu_1_2_CM_S2 0 2 FORMAT "%2.0" /end CHARACTERISTIC
/begin CHARACTERISTIC XS_USE_AQ_KD_FT "" VALUE 0x27B70B _REC_S1VAL_1_u1_S2 1 _CNV_S_2_Schalter_A_4_CM_S2 0 1 /end CHARACTERISTIC
/begin CHARACTERISTIC XT_AQUER_FT "" VALUE 0x274E00 _REC_S1VAL_1_u4_S2 100000 _CNV_R_R_Umr_1_zu_1_6_CM_S2 0 100000 FORMAT "%3.1" /end CHARACTERISTIC
/begin CHARACTERISTIC XT_BPL "" VALUE 0x274DF4 _REC_S1VAL_1_u4_S2 2.14748E+009 _CNV_R_R_Umr_1_zu_1_6_CM_S2 0 2147483647 FORMAT "%2.0" /end CHARACTERISTIC
/begin CHARACTERISTIC XT_KURVE_BEW "" VALUE 0x273CB8 _REC_S1VAL_1_u4_S2 2.14748E+009 _CNV_R_R_Umr_1_zu_1_6_CM_S2 0 2147483647 FORMAT "%2.0" /end CHARACTERISTIC
/begin CHARACTERISTIC XW_DKKD_SCHUBSCHLEPP "" VALUE 0x27A426 _REC_S1VAL_1_u2_S2 110 _CNV_R_R_Umr_10_zu__9_CM_S2 0 110 FORMAT "%3.1" /end CHARACTERISTIC
/begin CHARACTERISTIC XZ_GANGMAX_TPRUEF_BRFTUP_BRS "" VALUE 0x27B709 _REC_S1VAL_1_u1_S2 8 _CNV_S_9_Enum_EGANG_30_CM_S2 0 8 /end CHARACTERISTIC
/begin CHARACTERISTIC XGM_LDM_SOLLFILT_OUTGEW "" VALUE 0x279838 _REC_S1VAL_1_s2_S2 250 _CNV_R_R_Umr_1_zu_1_2_CM_S2 0 250 FORMAT "%2.0" /end CHARACTERISTIC
/begin CHARACTERISTIC XS_USE_LDMSTATUS "" VALUE 0x27B6C7 _REC_S1VAL_1_u1_S2 1 _CNV_R_R_Umr_1_zu_1_2_CM_S2 0 1 FORMAT "%2.0" /end CHARACTERISTIC
/begin CHARACTERISTIC XS_USE_RESETGWFPLDMMOD "" VALUE 0x27B6C8 _REC_S1VAL_1_u1_S2 1 _CNV_S_2_Schalter_A_4_CM_S2 0 1 /end CHARACTERISTIC
/begin CHARACTERISTIC XT_GM_LDM_SOLL "" VALUE 0x27983A _REC_S1VAL_1_u2_S2 2500 _CNV_R_R_Umr_1_zu_1_82_CM_S2 0 2500 FORMAT "%2.0" /end CHARACTERISTIC
/begin CHARACTERISTIC XT_LDMBAB_ENBL "" VALUE 0x27983C _REC_S1VAL_1_u2_S2 65535 _CNV_R_R_Umr_1_zu_1_6_CM_S2 0 65535 FORMAT "%2.0" /end CHARACTERISTIC
/begin CHARACTERISTIC XT_NACHL_AUSSTIEG_LDM_DYNAMIC2 "" VALUE 0x27983E _REC_S1VAL_1_u2_S2 10000 _CNV_R_R_Umr_1_zu_1_2_CM_S2 0 10000 FORMAT "%2.0" /end CHARACTERISTIC
/begin CHARACTERISTIC XT_NACHL_LDM_DYNAMIC2 "" VALUE 0x2738F8 _REC_S1VAL_1_u4_S2 2.14748E+009 _CNV_R_R_Umr_1_zu_1_6_CM_S2 0 2147483647 FORMAT "%2.0" /end CHARACTERISTIC
/begin CHARACTERISTIC XZ_LDMBAB_ENBLSOURCE "" VALUE 0x27B6C9 _REC_S1VAL_1_u1_S2 3 _CNV_S_4_Enum_ESIGN_83_CM_S2 0 3 /end CHARACTERISTIC
/begin CHARACTERISTIC XZ_LDM_DYNAMIC2_SOURCE "" VALUE 0x27B6CA _REC_S1VAL_1_u1_S2 2 _CNV_S_3_Enum_ESIGN_84_CM_S2 0 2 /end CHARACTERISTIC
/begin CHARACTERISTIC XTAB9X3N_MOTMAX_RS_ABSDSC "" MAP 0x27AEE6 _REC_A1MAP_9_u1_u1_u1_S2 10000 _CNV_R_R_Umr_1_zu_5_87_CM_S2 0 10000 FORMAT "%2.0"
 /begin AXIS_DESCR FIX_AXIS S_ERR_DSC_ROLLECAN _CNV_S_3_Enum_ERRDS_86_CM_S2 3 0 2 /begin FIX_AXIS_PAR_LIST 0 1 2 /end FIX_AXIS_PAR_LIST READ_ONLY /end AXIS_DESCR
 /begin AXIS_DESCR FIX_AXIS Z_GANG_SOLLAGS _CNV_S_9_Enum_EGANG_30_CM_S2 9 0 8 FIX_AXIS_PAR_DIST 0 1 9 READ_ONLY /end AXIS_DESCR
/end CHARACTERISTIC
/begin CHARACTERISTIC XC_RESYNCANF_FENSTER_ADAS "" VALUE 0x27AF03 _REC_S1VAL_1_u1_S2 255 _CNV_R_R_Umr_1_zu_1_2_CM_S2 0 255 FORMAT "%2.0" /end CHARACTERISTIC
/begin CHARACTERISTIC XDGANG_MAX_RSU_DSCERR "" VALUE 0x27AF0B _REC_S1VAL_1_u1_S2 3 _CNV_R_R_Umr_1_zu_1_2_CM_S2 1 4 /end CHARACTERISTIC
/begin CHARACTERISTIC XGANG_DMHSMAX "" VALUE 0x27AF0D _REC_S1VAL_1_u1_S2 5 _CNV_R_R_Umr_1_zu_1_2_CM_S2 1 6 FORMAT "%2.0" /end CHARACTERISTIC
/begin CHARACTERISTIC XGANG_DMHSMAX_ZUSTART "" VALUE 0x27AF0E _REC_S1VAL_1_u1_S2 6 _CNV_R_R_Umr_1_zu_1_2_CM_S2 1 7 FORMAT "%2.0" /end CHARACTERISTIC
/begin CHARACTERISTIC XGANG_DMRSMAX "" VALUE 0x27AF0F _REC_S1VAL_1_u1_S2 5 _CNV_R_R_Umr_1_zu_1_2_CM_S2 1 6 FORMAT "%2.0" /end CHARACTERISTIC
/begin CHARACTERISTIC XGANG_MIN_RSU_DSCERR "" VALUE 0x27AF0C _REC_S1VAL_1_u1_S2 8 _CNV_S_9_Enum_EGANG_30_CM_S2 0 8 /end CHARACTERISTIC
/begin CHARACTERISTIC XLAYEROUT_TRPMOD_DYNDZM "" VALUE 0x27AF16 _REC_S1VAL_1_u1_S2 1 _CNV_R_R_Umr_1_zu_1_2_CM_S2 0 1 FORMAT "%2.0" /end CHARACTERISTIC
/begin CHARACTERISTIC XLAYEROUT_TRPMOD_DYNINDEX "" VALUE 0x27AF18 _REC_S1VAL_1_u1_S2 255 _CNV_R_R_Umr_1_zu_1_2_CM_S2 0 255 FORMAT "%2.0" /end CHARACTERISTIC
/begin CHARACTERISTIC XLAYEROUT_TRPMOD_FORCEHS "" VALUE 0x27AF19 _REC_S1VAL_1_u1_S2 3 _CNV_R_R_Umr_1_zu_1_2_CM_S2 0 3 FORMAT "%2.0" /end CHARACTERISTIC
/begin CHARACTERISTIC XM_COMPRISE_SSINITDEF "" VALUE 0x2757AA _REC_S1VAL_1_u2_S2 4095 _CNV_R_R_Umr_1_zu_1_2_CM_S2 0 4095 /end CHARACTERISTIC
/begin CHARACTERISTIC XN_DYNDZM_SSINITDEF "" VALUE 0x2757B2 _REC_S1VAL_1_u2_S2 4095 _CNV_R_R_Umr_1_zu_1_2_CM_S2 0 4095 /end CHARACTERISTIC
/begin CHARACTERISTIC XSCHW_DKKD_RSU_DSCERR "" VALUE 0x2757AE _REC_S1VAL_1_u2_S2 110 _CNV_R_R_Umr_10_zu__9_CM_S2 0 110 FORMAT "%3.1" /end CHARACTERISTIC
/begin CHARACTERISTIC XS_ADAS_ANFRESYNC_SSINITDEF "" VALUE 0x27AF04 _REC_S1VAL_1_u1_S2 1 _CNV_R_R_Umr_1_zu_1_2_CM_S2 0 1 FORMAT "%2.0" /end CHARACTERISTIC
/begin CHARACTERISTIC XS_DYNDZM_SSINITDEF "" VALUE 0x27AF17 _REC_S1VAL_1_u1_S2 1 _CNV_R_R_Umr_1_zu_1_2_CM_S2 0 1 /end CHARACTERISTIC
/begin CHARACTERISTIC XS_KEINESCHALT_AUFSETZEN_LDM "" VALUE 0x27AF1A _REC_S1VAL_1_u1_S2 1 _CNV_S_2_Schalter_A_4_CM_S2 0 1 /end CHARACTERISTIC
/begin CHARACTERISTIC XS_NURMESSANZ_GANG_SOLLSTB "" VALUE 0x27AF10 _REC_S1VAL_1_u1_S2 1 _CNV_R_R_Umr_1_zu_1_2_CM_S2 0 1 FORMAT "%2.0" /end CHARACTERISTIC
/begin CHARACTERISTIC XS_RESYNCINIT_STDBYCRUISE_ADAS "" VALUE 0x27AF06 _REC_S1VAL_1_u1_S2 1 _CNV_S_2_Schalter_A_4_CM_S2 0 1 /end CHARACTERISTIC
/begin CHARACTERISTIC XS_RESYNCVERBOT_AUFSTART_ADAS "" VALUE 0x27AF07 _REC_S1VAL_1_u1_S2 1 _CNV_S_2_Schalter_A_4_CM_S2 0 1 /end CHARACTERISTIC
/begin CHARACTERISTIC XS_RESYNC_NOCOUNTRYENBL_ADAS "" VALUE 0x27AF08 _REC_S1VAL_1_u1_S2 1 _CNV_R_R_Umr_1_zu_1_2_CM_S2 0 1 FORMAT "%2.0" /end CHARACTERISTIC
/begin CHARACTERISTIC XS_RS_ENBL_SPA "" VALUE 0x27AF11 _REC_S1VAL_1_u1_S2 1 _CNV_S_2_Schalter_A_4_CM_S2 0 1 /end CHARACTERISTIC
/begin CHARACTERISTIC XS_STAT_SPORT_SSINITDEF "" VALUE 0x27AF12 _REC_S1VAL_1_u1_S2 15 _CNV_R_R_Umr_1_zu_1_2_CM_S2 0 15 /end CHARACTERISTIC
/begin CHARACTERISTIC XS_STAT_ZHS_SSINITDEF "" VALUE 0x27AF13 _REC_S1VAL_1_u1_S2 3 _CNV_R_R_Umr_1_zu_1_2_CM_S2 0 3 /end CHARACTERISTIC
/begin CHARACTERISTIC XT_RESYNCANF_FENSTER_ADAS "" VALUE 0x2757AC _REC_S1VAL_1_u2_S2 65535 _CNV_R_R_Umr_1_zu_1_6_CM_S2 0 65535 FORMAT "%2.0" /end CHARACTERISTIC
/begin CHARACTERISTIC XT_SEQ_TIMER_RSU_DSCERR "" VALUE 0x2757B0 _REC_S1VAL_1_u2_S2 1000 _CNV_R_R_Umr_1_zu_1_6_CM_S2 0 1000 FORMAT "%2.0" /end CHARACTERISTIC
/begin CHARACTERISTIC XZ_ADAS_RESYNCSTCOUNT_SSINITDEF "" VALUE 0x27AF09 _REC_S1VAL_1_u1_S2 255 _CNV_R_R_Umr_1_zu_1_2_CM_S2 0 255 FORMAT "%2.0" /end CHARACTERISTIC
/begin CHARACTERISTIC XZ_ADAS_RESYNCSTERR_SSINITDEF "" VALUE 0x27AF0A _REC_S1VAL_1_u1_S2 255 _CNV_R_R_Umr_1_zu_1_2_CM_S2 0 255 FORMAT "%2.0" /end CHARACTERISTIC
/begin CHARACTERISTIC XZ_GANG_POS_PR "" VALUE 0x27AF14 _REC_S1VAL_1_u1_S2 2 _CNV_S_3_ENUM_GANGP_95_CM_S2 0 2 /end CHARACTERISTIC
/begin CHARACTERISTIC XZ_IDXGRBDYN_SSINITDEF "" VALUE 0x27AF15 _REC_S1VAL_1_u1_S2 15 _CNV_R_R_Umr_1_zu_1_2_CM_S2 0 15 /end CHARACTERISTIC
/begin CHARACTERISTIC XZ_M_COMPRISE_SSINITDEF "" VALUE 0x27AF01 _REC_S1VAL_1_u1_S2 3 _CNV_R_R_Umr_1_zu_1_2_CM_S2 0 3 /end CHARACTERISTIC
/begin CHARACTERISTIC XZ_ZKA_IDX_SSINITDEF "" VALUE 0x27AF02 _REC_S1VAL_1_u1_S2 15 _CNV_R_R_Umr_1_zu_1_2_CM_S2 0 15 /end CHARACTERISTIC
/begin CHARACTERISTIC XTAB2X2SCHTEMP_DMRSKS "" MAP 0x26FC88 _REC_A1MAP_8_s2_u1_u1_S2 500 _CNV_R_R_Umr_1_zu_1_1_CM_S2 0 500 FORMAT "%2.0"
 /begin AXIS_DESCR FIX_AXIS NO_INPUT_QUANTITY _CNV_S_2_Enum_MFRSK_96_CM_S2 2 1 2 FIX_AXIS_PAR_DIST 1 1 2 READ_ONLY /end AXIS_DESCR
 /begin AXIS_DESCR FIX_AXIS Z_GANG_ZIEL _CNV_S_9_Enum_EGANG_30_CM_S2 2 0 8 FIX_AXIS_PAR_DIST 6 1 2 READ_ONLY /end AXIS_DESCR
/end CHARACTERISTIC
/begin CHARACTERISTIC XTAB9Z_GANG_HS_TRPMOD "" CURVE 0x278FD6 _REC_A1CUR_30_u2_u1_S2 400 _CNV_R_R_Umr_1_zu_1_8_CM_S2 0 400 FORMAT "%2.0"
 /begin AXIS_DESCR FIX_AXIS Z_GANG_ZIEL_SAS _CNV_S_9_Enum_EGANG_30_CM_S2 9 0 8 FIX_AXIS_PAR_DIST 0 1 9 READ_ONLY /end AXIS_DESCR
/end CHARACTERISTIC
/begin CHARACTERISTIC XTAB9Z_GANG_RS_TRPMOD "" CURVE 0x278FE8 _REC_A1CUR_30_u2_u1_S2 400 _CNV_R_R_Umr_1_zu_1_8_CM_S2 0 400 FORMAT "%2.0"
 /begin AXIS_DESCR FIX_AXIS Z_GANG_ZIEL_SAS _CNV_S_9_Enum_EGANG_30_CM_S2 9 0 8 FIX_AXIS_PAR_DIST 0 1 9 READ_ONLY /end AXIS_DESCR
/end CHARACTERISTIC
/begin CHARACTERISTIC XOV_FZG_HSGANG_STEIG_TRPMOD "" VALUE 0x278FFA _REC_S1VAL_1_u2_S2 400 _CNV_R_R_Umr_1_zu_1_8_CM_S2 0 400 FORMAT "%2.0" /end CHARACTERISTIC
/begin CHARACTERISTIC XOV_FZG_RSGANG_STEIG_TRPMOD "" VALUE 0x278FFC _REC_S1VAL_1_u2_S2 400 _CNV_R_R_Umr_1_zu_1_8_CM_S2 0 400 FORMAT "%2.0" /end CHARACTERISTIC
/begin CHARACTERISTIC XSCHV_FZG_PMA_AUS "" VALUE 0x274F62 _REC_S1VAL_1_u2_S2 255 _CNV_R_R_Umr_64_zu__44_CM_S2 0 255 FORMAT "%4.2" /end CHARACTERISTIC
/begin CHARACTERISTIC XSCHV_FZG_PMA_ERLAUBT "" VALUE 0x274F64 _REC_S1VAL_1_u2_S2 255 _CNV_R_R_Umr_64_zu__44_CM_S2 0 255 FORMAT "%4.2" /end CHARACTERISTIC
/begin CHARACTERISTIC XS_GANG_SOLLSTB_ENBL "" VALUE 0x27AE96 _REC_S1VAL_1_u1_S2 1 _CNV_R_R_Umr_1_zu_1_2_CM_S2 0 1 FORMAT "%2.0" /end CHARACTERISTIC
/begin CHARACTERISTIC XS_KOOP_SPA "" VALUE 0x27AE98 _REC_S1VAL_1_u1_S2 1 _CNV_R_R_Umr_1_zu_1_2_CM_S2 0 1 FORMAT "%2.0" /end CHARACTERISTIC
/begin CHARACTERISTIC XS_TESTFALLGENERATOR_SOLLSTB "" VALUE 0x27AE97 _REC_S1VAL_1_u1_S2 1 _CNV_R_R_Umr_1_zu_1_2_CM_S2 0 1 FORMAT "%2.0" /end CHARACTERISTIC
/begin CHARACTERISTIC XT_RS_COS "" VALUE 0x276B24 _REC_S1VAL_1_u2_S2 31990 _CNV_R_R_Umr_1_zu_1_6_CM_S2 10 32000 FORMAT "%2.0" /end CHARACTERISTIC
/begin CHARACTERISTIC XW_STEIGDOWN_TRPMOD "" VALUE 0x278FFE _REC_S1VAL_1_s2_S2 400 _CNV_R_R_Umr_10_zu__9_CM_S2 -200 200 FORMAT "%3.1" /end CHARACTERISTIC
/begin CHARACTERISTIC XW_STEIGUP_TRPMOD "" VALUE 0x279000 _REC_S1VAL_1_s2_S2 400 _CNV_R_R_Umr_10_zu__9_CM_S2 -200 200 FORMAT "%3.1" /end CHARACTERISTIC
/begin CHARACTERISTIC XZ_ANFAHRGANG_PMA "" VALUE 0x27AE95 _REC_S1VAL_1_u1_S2 2 _CNV_S_3_Enum_EPMA_98_CM_S2 0 2 /end CHARACTERISTIC
/begin CHARACTERISTIC XZ_GANG_MAXR "" VALUE 0x27B5CE _REC_S1VAL_1_u1_S2 8 _CNV_S_9_Enum_EGANG_30_CM_S2 0 8 /end CHARACTERISTIC
/begin CHARACTERISTIC XTAB100S_PRISQ_FIND "" CURVE 0x271A18 _REC_A1CUR_30_u4_u1_S2 4.29497E+009 _CNV_R_R_Umr_1_zu_1_2_CM_S2 0 4294967295 FORMAT "%2.0"
 /begin AXIS_DESCR FIX_AXIS Z_PRISQ_PRIOIDX _CNV_S_100_Enum_EPRIS_34_CM_S2 100 0 99 FIX_AXIS_PAR_DIST 0 1 100 READ_ONLY /end AXIS_DESCR
/end CHARACTERISTIC
/begin CHARACTERISTIC XTAB100X15S_PRISQ_HSURE "" MAP 0x271CB0 _REC_A1MAP_8_u1_u2_u1_S2 5 _CNV_R_R_Umr_1_zu_1_2_CM_S2 0 5 FORMAT "%2.0"
 /begin AXIS_DESCR FIX_AXIS NO_INPUT_QUANTITY _CNV_S_15_Enum_EHSUR_17_CM_S2 15 0 14 FIX_AXIS_PAR_DIST 0 1 15 READ_ONLY /end AXIS_DESCR
 /begin AXIS_DESCR FIX_AXIS Z_PRISQ_PRIOIDX _CNV_S_100_Enum_EPRIS_34_CM_S2 100 0 99 FIX_AXIS_PAR_DIST 0 1 100 READ_ONLY /end AXIS_DESCR
/end CHARACTERISTIC
/begin CHARACTERISTIC XTAB100X15S_PRISQ_KOOPFKT_ENBL "" MAP 0x27228C _REC_A1MAP_8_u1_u2_u1_S2 10 _CNV_R_R_Umr_1_zu_1_2_CM_S2 0 10 FORMAT "%2.0"
 /begin AXIS_DESCR FIX_AXIS NO_INPUT_QUANTITY _CNV_S_15_Enum_EKOPF_102_CM_S2 15 0 14 FIX_AXIS_PAR_DIST 0 1 15 READ_ONLY /end AXIS_DESCR
 /begin AXIS_DESCR FIX_AXIS Z_PRISQ_PRIOIDX _CNV_S_100_Enum_EPRIS_34_CM_S2 100 0 99 FIX_AXIS_PAR_DIST 0 1 100 READ_ONLY /end AXIS_DESCR
/end CHARACTERISTIC
/begin CHARACTERISTIC XTAB100X2Z_PRISQ_ZKAIDX_DBM "" MAP 0x26F3A4 _REC_A1MAP_9_u1_u1_u1_S2 9 _CNV_R_R_Umr_1_zu_1_2_CM_S2 1 10 FORMAT "%2.0"
 /begin AXIS_DESCR FIX_AXIS NO_INPUT_QUANTITY _CNV_S_22_Enum_EGLBE_99_CM_S2 2 0 21 FIX_AXIS_PAR_DIST 0 1 2 READ_ONLY /end AXIS_DESCR
 /begin AXIS_DESCR FIX_AXIS Z_PRISQ_PRIOIDX _CNV_S_100_Enum_EPRIS_34_CM_S2 100 0 99 FIX_AXIS_PAR_DIST 0 1 100 READ_ONLY /end AXIS_DESCR
/end CHARACTERISTIC
/begin CHARACTERISTIC XTAB100X2Z_PRISQ_ZKAIDX_ZKA "" MAP 0x26F46C _REC_A1MAP_9_u1_u1_u1_S2 4 _CNV_R_R_Umr_1_zu_1_2_CM_S2 1 5 FORMAT "%2.0"
 /begin AXIS_DESCR FIX_AXIS Z_SCHUB_ERK_ZKA _CNV_R_R_Umr_1_zu_1_2_CM_S2 2 0 255 FIX_AXIS_PAR_DIST 0 1 2 READ_ONLY /end AXIS_DESCR
 /begin AXIS_DESCR FIX_AXIS Z_PRISQ_PRIOIDX _CNV_S_100_Enum_EPRIS_34_CM_S2 100 0 99 FIX_AXIS_PAR_DIST 0 1 100 READ_ONLY /end AXIS_DESCR
/end CHARACTERISTIC
/begin CHARACTERISTIC XTAB100X9S_ADD_FKTENBL "" MAP 0x26F598 _REC_A1MAP_8_u1_u2_u1_S2 100 _CNV_R_R_Umr_1_zu_1_2_CM_S2 0 100 FORMAT "%2.0"
 /begin AXIS_DESCR FIX_AXIS NO_INPUT_QUANTITY _CNV_S_9_Enum_EADDF_100_CM_S2 9 0 8 FIX_AXIS_PAR_DIST 0 1 9 READ_ONLY /end AXIS_DESCR
 /begin AXIS_DESCR FIX_AXIS Z_PRISQ_PRIOIDX _CNV_S_100_Enum_EPRIS_34_CM_S2 100 0 99 FIX_AXIS_PAR_DIST 0 1 100 READ_ONLY /end AXIS_DESCR
/end CHARACTERISTIC
/begin CHARACTERISTIC XTAB100Z_PRISQ_DKFILT "" CURVE 0x26F91C _REC_A1CUR_30_u1_u1_S2 3 _CNV_R_R_Umr_1_zu_1_2_CM_S2 0 3 FORMAT "%2.0"
 /begin AXIS_DESCR FIX_AXIS Z_PRISQ_PRIOIDX _CNV_S_100_Enum_EPRIS_34_CM_S2 100 0 99 FIX_AXIS_PAR_DIST 0 1 100 READ_ONLY /end AXIS_DESCR
/end CHARACTERISTIC
/begin CHARACTERISTIC XTAB100Z_PRISQ_DKPT1 "" CURVE 0x26F980 _REC_A1CUR_30_u1_u1_S2 3 _CNV_R_R_Umr_1_zu_1_2_CM_S2 0 3 FORMAT "%2.0"
 /begin AXIS_DESCR FIX_AXIS Z_PRISQ_PRIOIDX _CNV_S_100_Enum_EPRIS_34_CM_S2 100 0 99 FIX_AXIS_PAR_DIST 0 1 100 READ_ONLY /end AXIS_DESCR
/end CHARACTERISTIC
/begin CHARACTERISTIC XTAB100Z_PRISQ_FUNK "" CURVE 0x26F9E4 _REC_A1CUR_30_u1_u1_S2 3 _CNV_R_R_Umr_1_zu_1_2_CM_S2 0 3 FORMAT "%2.0"
 /begin AXIS_DESCR FIX_AXIS Z_PRISQ_PRIOIDX _CNV_S_100_Enum_EPRIS_34_CM_S2 100 0 99 FIX_AXIS_PAR_DIST 0 1 100 READ_ONLY /end AXIS_DESCR
/end CHARACTERISTIC
/begin CHARACTERISTIC XTAB100Z_PRISQ_FUNKERW "" CURVE 0x26FA48 _REC_A1CUR_30_u1_u1_S2 8 _CNV_R_R_Umr_1_zu_1_2_CM_S2 0 8 FORMAT "%2.0"
 /begin AXIS_DESCR FIX_AXIS Z_PRISQ_PRIOIDX _CNV_S_100_Enum_EPRIS_34_CM_S2 100 0 99 FIX_AXIS_PAR_DIST 0 1 100 READ_ONLY /end AXIS_DESCR
/end CHARACTERISTIC
/begin CHARACTERISTIC XTAB100Z_PRISQ_MOTZKA "" CURVE 0x26F534 _REC_A1CUR_30_u1_u1_S2 14 _CNV_R_R_Umr_1_zu_1_2_CM_S2 0 14 FORMAT "%2.0"
 /begin AXIS_DESCR FIX_AXIS Z_PRISQ_PRIOIDX _CNV_S_100_Enum_EPRIS_34_CM_S2 100 0 99 FIX_AXIS_PAR_DIST 0 1 100 READ_ONLY /end AXIS_DESCR
/end CHARACTERISTIC
/begin CHARACTERISTIC XTAB100Z_PRISQ_NMOTHSTUPEL "" CURVE 0x26FAAC _REC_A1CUR_30_u1_u1_S2 4 _CNV_R_R_Umr_1_zu_1_2_CM_S2 0 4 FORMAT "%2.0"
 /begin AXIS_DESCR FIX_AXIS Z_PRISQ_PRIOIDX _CNV_S_100_Enum_EPRIS_34_CM_S2 100 0 99 FIX_AXIS_PAR_DIST 0 1 100 READ_ONLY /end AXIS_DESCR
/end CHARACTERISTIC
/begin CHARACTERISTIC XTAB100Z_PRISQ_PROG "" CURVE 0x26FB10 _REC_A1CUR_30_u1_u1_S2 20 _CNV_R_R_Umr_1_zu_1_2_CM_S2 0 20 FORMAT "%2.0"
 /begin AXIS_DESCR FIX_AXIS Z_PRISQ_PRIOIDX _CNV_S_100_Enum_EPRIS_34_CM_S2 100 0 99 FIX_AXIS_PAR_DIST 0 1 100 READ_ONLY /end AXIS_DESCR
/end CHARACTERISTIC
/begin CHARACTERISTIC XTAB100Z_PRISQ_ZHS "" CURVE 0x26FB74 _REC_A1CUR_30_u1_u1_S2 1 _CNV_R_R_Umr_1_zu_1_2_CM_S2 0 1 FORMAT "%2.0"
 /begin AXIS_DESCR FIX_AXIS Z_PRISQ_PRIOIDX _CNV_S_100_Enum_EPRIS_34_CM_S2 100 0 99 FIX_AXIS_PAR_DIST 0 1 100 READ_ONLY /end AXIS_DESCR
/end CHARACTERISTIC
/begin CHARACTERISTIC XTAB100_PRISQ_PRIO "" CURVE 0x271BA8 _REC_A1CUR_30_u2_u1_S2 65535 _CNV_R_R_Umr_1_zu_1_2_CM_S2 0 65535 FORMAT "%2.0"
 /begin AXIS_DESCR FIX_AXIS Z_PRISQ_PRIOIDX _CNV_S_100_Enum_EPRIS_34_CM_S2 100 0 99 FIX_AXIS_PAR_DIST 0 1 100 READ_ONLY /end AXIS_DESCR
/end CHARACTERISTIC
/begin CHARACTERISTIC XTAB15S_KOOPFKT_BDLENB_D "" CURVE 0x27B712 _REC_A1CUR_30_u1_u2_S2 1 _CNV_R_R_Umr_1_zu_1_2_CM_S2 0 1 FORMAT "%2.0"
 /begin AXIS_DESCR FIX_AXIS NO_INPUT_QUANTITY _CNV_S_15_Enum_EKOPF_102_CM_S2 15 0 14 FIX_AXIS_PAR_DIST 0 1 15 READ_ONLY /end AXIS_DESCR
/end CHARACTERISTIC
/begin CHARACTERISTIC XTAB15S_KOOPFKT_BDLENB_N "" CURVE 0x27B721 _REC_A1CUR_30_u1_u2_S2 1 _CNV_R_R_Umr_1_zu_1_2_CM_S2 0 1 FORMAT "%2.0"
 /begin AXIS_DESCR FIX_AXIS NO_INPUT_QUANTITY _CNV_S_15_Enum_EKOPF_102_CM_S2 15 0 14 FIX_AXIS_PAR_DIST 0 1 15 READ_ONLY /end AXIS_DESCR
/end CHARACTERISTIC
/begin CHARACTERISTIC XTAB15S_KOOPFKT_BDLENB_P "" CURVE 0x27B730 _REC_A1CUR_30_u1_u2_S2 1 _CNV_R_R_Umr_1_zu_1_2_CM_S2 0 1 FORMAT "%2.0"
 /begin AXIS_DESCR FIX_AXIS NO_INPUT_QUANTITY _CNV_S_15_Enum_EKOPF_102_CM_S2 15 0 14 FIX_AXIS_PAR_DIST 0 1 15 READ_ONLY /end AXIS_DESCR
/end CHARACTERISTIC
/begin CHARACTERISTIC XTAB15S_KOOPFKT_BDLENB_R "" CURVE 0x27B73F _REC_A1CUR_30_u1_u2_S2 1 _CNV_R_R_Umr_1_zu_1_2_CM_S2 0 1 FORMAT "%2.0"
 /begin AXIS_DESCR FIX_AXIS NO_INPUT_QUANTITY _CNV_S_15_Enum_EKOPF_102_CM_S2 15 0 14 FIX_AXIS_PAR_DIST 0 1 15 READ_ONLY /end AXIS_DESCR
/end CHARACTERISTIC
/begin CHARACTERISTIC XTAB15S_KOOPFKT_GLBENBL "" CURVE 0x27B57A _REC_A1CUR_30_u1_u2_S2 1 _CNV_R_R_Umr_1_zu_1_2_CM_S2 0 1 FORMAT "%2.0"
 /begin AXIS_DESCR FIX_AXIS NO_INPUT_QUANTITY _CNV_S_15_Enum_EKOPF_102_CM_S2 15 0 14 FIX_AXIS_PAR_DIST 0 1 15 READ_ONLY /end AXIS_DESCR
/end CHARACTERISTIC
/begin CHARACTERISTIC XTAB15S_KOOP_HSURE_BDLENB_D "" CURVE 0x27B74E _REC_A1CUR_30_u1_u2_S2 1 _CNV_R_R_Umr_1_zu_1_2_CM_S2 0 1 FORMAT "%2.0"
 /begin AXIS_DESCR FIX_AXIS NO_INPUT_QUANTITY _CNV_S_15_Enum_EHSUR_17_CM_S2 15 0 14 FIX_AXIS_PAR_DIST 0 1 15 READ_ONLY /end AXIS_DESCR
/end CHARACTERISTIC
/begin CHARACTERISTIC XTAB15S_KOOP_HSURE_BDLENB_N "" CURVE 0x27B75D _REC_A1CUR_30_u1_u2_S2 1 _CNV_R_R_Umr_1_zu_1_2_CM_S2 0 1 FORMAT "%2.0"
 /begin AXIS_DESCR FIX_AXIS NO_INPUT_QUANTITY _CNV_S_15_Enum_EHSUR_17_CM_S2 15 0 14 FIX_AXIS_PAR_DIST 0 1 15 READ_ONLY /end AXIS_DESCR
/end CHARACTERISTIC
/begin CHARACTERISTIC XTAB15S_KOOP_HSURE_BDLENB_P "" CURVE 0x27B76C _REC_A1CUR_30_u1_u2_S2 1 _CNV_R_R_Umr_1_zu_1_2_CM_S2 0 1 FORMAT "%2.0"
 /begin AXIS_DESCR FIX_AXIS NO_INPUT_QUANTITY _CNV_S_15_Enum_EHSUR_17_CM_S2 15 0 14 FIX_AXIS_PAR_DIST 0 1 15 READ_ONLY /end AXIS_DESCR
/end CHARACTERISTIC
/begin CHARACTERISTIC XTAB15S_KOOP_HSURE_BDLENB_R "" CURVE 0x27B77B _REC_A1CUR_30_u1_u2_S2 1 _CNV_R_R_Umr_1_zu_1_2_CM_S2 0 1 FORMAT "%2.0"
 /begin AXIS_DESCR FIX_AXIS NO_INPUT_QUANTITY _CNV_S_15_Enum_EHSUR_17_CM_S2 15 0 14 FIX_AXIS_PAR_DIST 0 1 15 READ_ONLY /end AXIS_DESCR
/end CHARACTERISTIC
/begin CHARACTERISTIC XTAB15S_KOOP_HSURE_GLBENBL "" CURVE 0x27B589 _REC_A1CUR_30_u1_u2_S2 1 _CNV_R_R_Umr_1_zu_1_2_CM_S2 0 1 FORMAT "%2.0"
 /begin AXIS_DESCR FIX_AXIS NO_INPUT_QUANTITY _CNV_S_15_Enum_EHSUR_17_CM_S2 15 0 14 FIX_AXIS_PAR_DIST 0 1 15 READ_ONLY /end AXIS_DESCR
/end CHARACTERISTIC
/begin CHARACTERISTIC XTAB21Z_PROG_DS2 "" CURVE 0x27AE75 _REC_A1CUR_30_u1_u1_S2 15 _CNV_S_16_Enum_EPROG_94_CM_S2 0 15
 /begin AXIS_DESCR FIX_AXIS Z_PROG_FFG _CNV_S_21_Enum_EPROG_40_CM_S2 21 0 20 FIX_AXIS_PAR_DIST 0 1 21 READ_ONLY /end AXIS_DESCR
/end CHARACTERISTIC
/begin CHARACTERISTIC XTAB32S_EXCFKT_BDLENB_D "" CURVE 0x273CCC _REC_A1CUR_30_u1_u2_S2 1 _CNV_R_R_Umr_1_zu_1_2_CM_S2 0 1 FORMAT "%2.0"
 /begin AXIS_DESCR FIX_AXIS NO_INPUT_QUANTITY _CNV_S_32_Enum_EEXCF_15_CM_S2 32 0 31 FIX_AXIS_PAR_DIST 0 1 32 READ_ONLY /end AXIS_DESCR
/end CHARACTERISTIC
/begin CHARACTERISTIC XTAB32S_EXCFKT_BDLENB_N "" CURVE 0x273CEC _REC_A1CUR_30_u1_u2_S2 1 _CNV_R_R_Umr_1_zu_1_2_CM_S2 0 1 FORMAT "%2.0"
 /begin AXIS_DESCR FIX_AXIS NO_INPUT_QUANTITY _CNV_S_32_Enum_EEXCF_15_CM_S2 32 0 31 FIX_AXIS_PAR_DIST 0 1 32 READ_ONLY /end AXIS_DESCR
/end CHARACTERISTIC
/begin CHARACTERISTIC XTAB32S_EXCFKT_BDLENB_P "" CURVE 0x273D0C _REC_A1CUR_30_u1_u2_S2 1 _CNV_R_R_Umr_1_zu_1_2_CM_S2 0 1 FORMAT "%2.0"
 /begin AXIS_DESCR FIX_AXIS NO_INPUT_QUANTITY _CNV_S_32_Enum_EEXCF_15_CM_S2 32 0 31 FIX_AXIS_PAR_DIST 0 1 32 READ_ONLY /end AXIS_DESCR
/end CHARACTERISTIC
/begin CHARACTERISTIC XTAB32S_EXCFKT_BDLENB_R "" CURVE 0x273D2C _REC_A1CUR_30_u1_u2_S2 1 _CNV_R_R_Umr_1_zu_1_2_CM_S2 0 1 FORMAT "%2.0"
 /begin AXIS_DESCR FIX_AXIS NO_INPUT_QUANTITY _CNV_S_32_Enum_EEXCF_15_CM_S2 32 0 31 FIX_AXIS_PAR_DIST 0 1 32 READ_ONLY /end AXIS_DESCR
/end CHARACTERISTIC
/begin CHARACTERISTIC XTAB32S_EXCFKT_GLBENBL "" CURVE 0x271C70 _REC_A1CUR_30_u1_u2_S2 1 _CNV_R_R_Umr_1_zu_1_2_CM_S2 0 1 FORMAT "%2.0"
 /begin AXIS_DESCR FIX_AXIS NO_INPUT_QUANTITY _CNV_S_32_Enum_EEXCF_15_CM_S2 32 0 31 FIX_AXIS_PAR_DIST 0 1 32 READ_ONLY /end AXIS_DESCR
/end CHARACTERISTIC
/begin CHARACTERISTIC XTAB32S_SDYNERW_EXCFKTFFG "" CURVE 0x271C90 _REC_A1CUR_30_u1_u2_S2 1 _CNV_R_R_Umr_1_zu_1_2_CM_S2 0 1 FORMAT "%2.0"
 /begin AXIS_DESCR FIX_AXIS NO_INPUT_QUANTITY _CNV_S_32_Enum_EEXCF_15_CM_S2 32 0 31 FIX_AXIS_PAR_DIST 0 1 32 READ_ONLY /end AXIS_DESCR
/end CHARACTERISTIC
/begin CHARACTERISTIC XTAB4X12W_DKKD_PS "" MAP 0x274ECA _REC_S3MAP_54_u2_u2_u2_S2 110 _CNV_R_R_Umr_10_zu__9_CM_S2 0 110 FORMAT "%3.1"
 /begin AXIS_DESCR STD_AXIS W_DKKD _CNV_R_R_Umr_10_zu__9_CM_S2 12 0 110 FORMAT "%3.1" /end AXIS_DESCR
 /begin AXIS_DESCR FIX_AXIS NO_INPUT_QUANTITY _CNV_S_4_Enum_EPOWE_103_CM_S2 4 0 3 FIX_AXIS_PAR_DIST 0 1 4 READ_ONLY /end AXIS_DESCR
/end CHARACTERISTIC
/begin CHARACTERISTIC XTAB7W_DKKD_DYNKOR "" CURVE 0x274F44 _REC_S7CUR_53_u2_u2_S2 120 _CNV_R_R_Umr_10_zu__9_CM_S2 0 120 FORMAT "%3.1"
 /begin AXIS_DESCR STD_AXIS W_DKKD_PS _CNV_R_R_Umr_10_zu__9_CM_S2 7 0 120 FORMAT "%3.1" /end AXIS_DESCR
/end CHARACTERISTIC
/begin CHARACTERISTIC XTAB7X4W_DKKD_PLUFT "" MAP 0x26FBD8 _REC_S7MAP_53_u2_u2_u2_S2 110 _CNV_R_R_Umr_10_zu__9_CM_S2 0 110 FORMAT "%3.1"
 /begin AXIS_DESCR STD_AXIS W_DKKD_PS _CNV_R_R_Umr_10_zu__9_CM_S2 7 0 110 FORMAT "%3.1" /end AXIS_DESCR
 /begin AXIS_DESCR STD_AXIS P_LUFT _CNV_R_R_Umr_1_zu_1_0_CM_S2 4 598 1108 FORMAT "%2.0" /end AXIS_DESCR
/end CHARACTERISTIC
/begin CHARACTERISTIC XTAB7X5FAKTW_DKKD_PLUFT "" MAP 0x26FC28 _REC_S7MAP_53_u2_u2_u2_S2 1000 _CNV_R_R_Umr_1_zu_1_53_CM_S2 0 1000 FORMAT "%2.0"
 /begin AXIS_DESCR STD_AXIS N_MOT _CNV_R_R_Umr_1_zu_1_3_CM_S2 7 0 8000 FORMAT "%2.0" /end AXIS_DESCR
 /begin AXIS_DESCR STD_AXIS VM_MOT_ISTFW_FILT _CNV_R_R_Umr_100_zu_104_CM_S2 5 0 10 FORMAT "%4.2" /end AXIS_DESCR
/end CHARACTERISTIC
/begin CHARACTERISTIC XTAB9S_ADDFKT_GLBENBL "" CURVE 0x27AE8A _REC_A1CUR_30_u1_u2_S2 1 _CNV_R_R_Umr_1_zu_1_2_CM_S2 0 1 FORMAT "%2.0"
 /begin AXIS_DESCR FIX_AXIS NO_INPUT_QUANTITY _CNV_S_9_Enum_EADDF_100_CM_S2 9 0 8 FIX_AXIS_PAR_DIST 0 1 9 READ_ONLY /end AXIS_DESCR
/end CHARACTERISTIC
/begin CHARACTERISTIC XC_W_DKKDFILT "" VALUE 0x276638 _REC_S1VAL_1_u2_S2 4 _CNV_R_R_Umr_1_zu_1_2_CM_S2 1 5 FORMAT "%2.0" /end CHARACTERISTIC
/begin CHARACTERISTIC XDK_FILT_DOWNINGEW "" VALUE 0x27663A _REC_S1VAL_1_u2_S2 999 _CNV_R_R_Umr_1_zu_1_2_CM_S2 1 1000 FORMAT "%2.0" /end CHARACTERISTIC
/begin CHARACTERISTIC XDK_FILT_DOWNOUTGEW "" VALUE 0x27663C _REC_S1VAL_1_u2_S2 1000 _CNV_R_R_Umr_1_zu_1_2_CM_S2 0 1000 FORMAT "%2.0" /end CHARACTERISTIC
/begin CHARACTERISTIC XS_SORTPRIO "" VALUE 0x27B579 _REC_S1VAL_1_u1_S2 1 _CNV_S_2_Schalter_A_4_CM_S2 0 1 /end CHARACTERISTIC
/begin CHARACTERISTIC XS_USE_DKFILT_ECO "" VALUE 0x27AE93 _REC_S1VAL_1_u1_S2 1 _CNV_S_2_Schalter_A_4_CM_S2 0 1 /end CHARACTERISTIC
/begin CHARACTERISTIC XW_DK_LIMITLDMAAGS "" VALUE 0x27663E _REC_S1VAL_1_u2_S2 110 _CNV_R_R_Umr_10_zu__9_CM_S2 0 110 FORMAT "%3.1" /end CHARACTERISTIC
/begin CHARACTERISTIC XW_DK_LIMITLDMSAGS "" VALUE 0x276640 _REC_S1VAL_1_u2_S2 110 _CNV_R_R_Umr_10_zu__9_CM_S2 0 110 FORMAT "%3.1" /end CHARACTERISTIC
/begin CHARACTERISTIC A112 "" CURVE 0x276D62 _REC_A1CUR_1_u2_u2_S2 15000 _CNV_R_R_Umr_1_zu_1_3_CM_S2 0 15000 FORMAT "%2.0"
 /begin AXIS_DESCR COM_AXIS W_DKKD _CNV_R_R_Umr_10_zu__9_CM_S2 13 0 120 AXIS_PTS_REF SSTSKL_HS_A1 FORMAT "%3.1" /end AXIS_DESCR
/end CHARACTERISTIC
/begin CHARACTERISTIC A121 "" CURVE 0x276D7C _REC_A1CUR_1_u2_u2_S2 15000 _CNV_R_R_Umr_1_zu_1_3_CM_S2 0 15000 FORMAT "%2.0"
 /begin AXIS_DESCR COM_AXIS W_DKKD _CNV_R_R_Umr_10_zu__9_CM_S2 17 0 120 AXIS_PTS_REF SSTSKL_RS_A1 FORMAT "%3.1" /end AXIS_DESCR
/end CHARACTERISTIC
/begin CHARACTERISTIC A123 "" CURVE 0x276D9E _REC_A1CUR_1_u2_u2_S2 15000 _CNV_R_R_Umr_1_zu_1_3_CM_S2 0 15000 FORMAT "%2.0"
 /begin AXIS_DESCR COM_AXIS W_DKKD _CNV_R_R_Umr_10_zu__9_CM_S2 13 0 120 AXIS_PTS_REF SSTSKL_HS_A1 FORMAT "%3.1" /end AXIS_DESCR
/end CHARACTERISTIC
/begin CHARACTERISTIC A132 "" CURVE 0x276DB8 _REC_A1CUR_1_u2_u2_S2 15000 _CNV_R_R_Umr_1_zu_1_3_CM_S2 0 15000 FORMAT "%2.0"
 /begin AXIS_DESCR COM_AXIS W_DKKD _CNV_R_R_Umr_10_zu__9_CM_S2 17 0 120 AXIS_PTS_REF SSTSKL_RS_A1 FORMAT "%3.1" /end AXIS_DESCR
/end CHARACTERISTIC
/begin CHARACTERISTIC A134 "" CURVE 0x276DDA _REC_A1CUR_1_u2_u2_S2 15000 _CNV_R_R_Umr_1_zu_1_3_CM_S2 0 15000 FORMAT "%2.0"
 /begin AXIS_DESCR COM_AXIS W_DKKD _CNV_R_R_Umr_10_zu__9_CM_S2 13 0 120 AXIS_PTS_REF SSTSKL_HS_A1 FORMAT "%3.1" /end AXIS_DESCR
/end CHARACTERISTIC
/begin CHARACTERISTIC A143 "" CURVE 0x276DF4 _REC_A1CUR_1_u2_u2_S2 15000 _CNV_R_R_Umr_1_zu_1_3_CM_S2 0 15000 FORMAT "%2.0"
 /begin AXIS_DESCR COM_AXIS W_DKKD _CNV_R_R_Umr_10_zu__9_CM_S2 17 0 120 AXIS_PTS_REF SSTSKL_RS_A1 FORMAT "%3.1" /end AXIS_DESCR
/end CHARACTERISTIC
/begin CHARACTERISTIC A145 "" CURVE 0x276E16 _REC_A1CUR_1_u2_u2_S2 15000 _CNV_R_R_Umr_1_zu_1_3_CM_S2 0 15000 FORMAT "%2.0"
 /begin AXIS_DESCR COM_AXIS W_DKKD _CNV_R_R_Umr_10_zu__9_CM_S2 13 0 120 AXIS_PTS_REF SSTSKL_HS_A1 FORMAT "%3.1" /end AXIS_DESCR
/end CHARACTERISTIC
/begin CHARACTERISTIC A154 "" CURVE 0x276E30 _REC_A1CUR_1_u2_u2_S2 15000 _CNV_R_R_Umr_1_zu_1_3_CM_S2 0 15000 FORMAT "%2.0"
 /begin AXIS_DESCR COM_AXIS W_DKKD _CNV_R_R_Umr_10_zu__9_CM_S2 17 0 120 AXIS_PTS_REF SSTSKL_RS_A1 FORMAT "%3.1" /end AXIS_DESCR
/end CHARACTERISTIC
/begin CHARACTERISTIC A156 "" CURVE 0x276E52 _REC_A1CUR_1_u2_u2_S2 15000 _CNV_R_R_Umr_1_zu_1_3_CM_S2 0 15000 FORMAT "%2.0"
 /begin AXIS_DESCR COM_AXIS W_DKKD _CNV_R_R_Umr_10_zu__9_CM_S2 13 0 120 AXIS_PTS_REF SSTSKL_HS_A1 FORMAT "%3.1" /end AXIS_DESCR
/end CHARACTERISTIC
/begin CHARACTERISTIC A165 "" CURVE 0x276E6C _REC_A1CUR_1_u2_u2_S2 15000 _CNV_R_R_Umr_1_zu_1_3_CM_S2 0 15000 FORMAT "%2.0"
 /begin AXIS_DESCR COM_AXIS W_DKKD _CNV_R_R_Umr_10_zu__9_CM_S2 17 0 120 AXIS_PTS_REF SSTSKL_RS_A1 FORMAT "%3.1" /end AXIS_DESCR
/end CHARACTERISTIC
/begin CHARACTERISTIC A167 "" CURVE 0x2785FE _REC_A1CUR_1_u2_u2_S2 15000 _CNV_R_R_Umr_1_zu_1_3_CM_S2 0 15000 FORMAT "%2.0"
 /begin AXIS_DESCR COM_AXIS W_DKKD _CNV_R_R_Umr_10_zu__9_CM_S2 13 0 120 AXIS_PTS_REF SSTSKL_HS_A1 FORMAT "%3.1" /end AXIS_DESCR
/end CHARACTERISTIC
/begin CHARACTERISTIC A176 "" CURVE 0x278618 _REC_A1CUR_1_u2_u2_S2 15000 _CNV_R_R_Umr_1_zu_1_3_CM_S2 0 15000 FORMAT "%2.0"
 /begin AXIS_DESCR COM_AXIS W_DKKD _CNV_R_R_Umr_10_zu__9_CM_S2 17 0 120 AXIS_PTS_REF SSTSKL_RS_A1 FORMAT "%3.1" /end AXIS_DESCR
/end CHARACTERISTIC
/begin CHARACTERISTIC A178 "" CURVE 0x278AEA _REC_A1CUR_1_u2_u2_S2 15000 _CNV_R_R_Umr_1_zu_1_3_CM_S2 0 15000 FORMAT "%2.0"
 /begin AXIS_DESCR COM_AXIS W_DKKD _CNV_R_R_Umr_10_zu__9_CM_S2 13 0 120 AXIS_PTS_REF SSTSKL_HS_A1 FORMAT "%3.1" /end AXIS_DESCR
/end CHARACTERISTIC
/begin CHARACTERISTIC A187 "" CURVE 0x278B04 _REC_A1CUR_1_u2_u2_S2 15000 _CNV_R_R_Umr_1_zu_1_3_CM_S2 0 15000 FORMAT "%2.0"
 /begin AXIS_DESCR COM_AXIS W_DKKD _CNV_R_R_Umr_10_zu__9_CM_S2 17 0 120 AXIS_PTS_REF SSTSKL_RS_A1 FORMAT "%3.1" /end AXIS_DESCR
/end CHARACTERISTIC
/begin CHARACTERISTIC A212 "" CURVE 0x276E8E _REC_A1CUR_1_u2_u2_S2 15000 _CNV_R_R_Umr_1_zu_1_3_CM_S2 0 15000 FORMAT "%2.0"
 /begin AXIS_DESCR COM_AXIS W_DKKD _CNV_R_R_Umr_10_zu__9_CM_S2 13 0 120 AXIS_PTS_REF SSTSKL_HS_A2 FORMAT "%3.1" /end AXIS_DESCR
/end CHARACTERISTIC
/begin CHARACTERISTIC A221 "" CURVE 0x276EA8 _REC_A1CUR_1_u2_u2_S2 15000 _CNV_R_R_Umr_1_zu_1_3_CM_S2 0 15000 FORMAT "%2.0"
 /begin AXIS_DESCR COM_AXIS W_DKKD _CNV_R_R_Umr_10_zu__9_CM_S2 17 0 120 AXIS_PTS_REF SSTSKL_RS_A2 FORMAT "%3.1" /end AXIS_DESCR
/end CHARACTERISTIC
/begin CHARACTERISTIC A223 "" CURVE 0x276ECA _REC_A1CUR_1_u2_u2_S2 15000 _CNV_R_R_Umr_1_zu_1_3_CM_S2 0 15000 FORMAT "%2.0"
 /begin AXIS_DESCR COM_AXIS W_DKKD _CNV_R_R_Umr_10_zu__9_CM_S2 13 0 120 AXIS_PTS_REF SSTSKL_HS_A2 FORMAT "%3.1" /end AXIS_DESCR
/end CHARACTERISTIC
/begin CHARACTERISTIC A232 "" CURVE 0x276EE4 _REC_A1CUR_1_u2_u2_S2 15000 _CNV_R_R_Umr_1_zu_1_3_CM_S2 0 15000 FORMAT "%2.0"
 /begin AXIS_DESCR COM_AXIS W_DKKD _CNV_R_R_Umr_10_zu__9_CM_S2 17 0 120 AXIS_PTS_REF SSTSKL_RS_A2 FORMAT "%3.1" /end AXIS_DESCR
/end CHARACTERISTIC
/begin CHARACTERISTIC A234 "" CURVE 0x276F06 _REC_A1CUR_1_u2_u2_S2 15000 _CNV_R_R_Umr_1_zu_1_3_CM_S2 0 15000 FORMAT "%2.0"
 /begin AXIS_DESCR COM_AXIS W_DKKD _CNV_R_R_Umr_10_zu__9_CM_S2 13 0 120 AXIS_PTS_REF SSTSKL_HS_A2 FORMAT "%3.1" /end AXIS_DESCR
/end CHARACTERISTIC
/begin CHARACTERISTIC A243 "" CURVE 0x276F20 _REC_A1CUR_1_u2_u2_S2 15000 _CNV_R_R_Umr_1_zu_1_3_CM_S2 0 15000 FORMAT "%2.0"
 /begin AXIS_DESCR COM_AXIS W_DKKD _CNV_R_R_Umr_10_zu__9_CM_S2 17 0 120 AXIS_PTS_REF SSTSKL_RS_A2 FORMAT "%3.1" /end AXIS_DESCR
/end CHARACTERISTIC
/begin CHARACTERISTIC A245 "" CURVE 0x276F42 _REC_A1CUR_1_u2_u2_S2 15000 _CNV_R_R_Umr_1_zu_1_3_CM_S2 0 15000 FORMAT "%2.0"
 /begin AXIS_DESCR COM_AXIS W_DKKD _CNV_R_R_Umr_10_zu__9_CM_S2 13 0 120 AXIS_PTS_REF SSTSKL_HS_A2 FORMAT "%3.1" /end AXIS_DESCR
/end CHARACTERISTIC
/begin CHARACTERISTIC A254 "" CURVE 0x276F5C _REC_A1CUR_1_u2_u2_S2 15000 _CNV_R_R_Umr_1_zu_1_3_CM_S2 0 15000 FORMAT "%2.0"
 /begin AXIS_DESCR COM_AXIS W_DKKD _CNV_R_R_Umr_10_zu__9_CM_S2 17 0 120 AXIS_PTS_REF SSTSKL_RS_A2 FORMAT "%3.1" /end AXIS_DESCR
/end CHARACTERISTIC
/begin CHARACTERISTIC A256 "" CURVE 0x276F7E _REC_A1CUR_1_u2_u2_S2 15000 _CNV_R_R_Umr_1_zu_1_3_CM_S2 0 15000 FORMAT "%2.0"
 /begin AXIS_DESCR COM_AXIS W_DKKD _CNV_R_R_Umr_10_zu__9_CM_S2 13 0 120 AXIS_PTS_REF SSTSKL_HS_A2 FORMAT "%3.1" /end AXIS_DESCR
/end CHARACTERISTIC
/begin CHARACTERISTIC A265 "" CURVE 0x276F98 _REC_A1CUR_1_u2_u2_S2 15000 _CNV_R_R_Umr_1_zu_1_3_CM_S2 0 15000 FORMAT "%2.0"
 /begin AXIS_DESCR COM_AXIS W_DKKD _CNV_R_R_Umr_10_zu__9_CM_S2 17 0 120 AXIS_PTS_REF SSTSKL_RS_A2 FORMAT "%3.1" /end AXIS_DESCR
/end CHARACTERISTIC
/begin CHARACTERISTIC A267 "" CURVE 0x27863A _REC_A1CUR_1_u2_u2_S2 15000 _CNV_R_R_Umr_1_zu_1_3_CM_S2 0 15000 FORMAT "%2.0"
 /begin AXIS_DESCR COM_AXIS W_DKKD _CNV_R_R_Umr_10_zu__9_CM_S2 13 0 120 AXIS_PTS_REF SSTSKL_HS_A2 FORMAT "%3.1" /end AXIS_DESCR
/end CHARACTERISTIC
/begin CHARACTERISTIC A276 "" CURVE 0x278654 _REC_A1CUR_1_u2_u2_S2 15000 _CNV_R_R_Umr_1_zu_1_3_CM_S2 0 15000 FORMAT "%2.0"
 /begin AXIS_DESCR COM_AXIS W_DKKD _CNV_R_R_Umr_10_zu__9_CM_S2 17 0 120 AXIS_PTS_REF SSTSKL_RS_A2 FORMAT "%3.1" /end AXIS_DESCR
/end CHARACTERISTIC
/begin CHARACTERISTIC A278 "" CURVE 0x278B26 _REC_A1CUR_1_u2_u2_S2 15000 _CNV_R_R_Umr_1_zu_1_3_CM_S2 0 15000 FORMAT "%2.0"
 /begin AXIS_DESCR COM_AXIS W_DKKD _CNV_R_R_Umr_10_zu__9_CM_S2 13 0 120 AXIS_PTS_REF SSTSKL_HS_A2 FORMAT "%3.1" /end AXIS_DESCR
/end CHARACTERISTIC
/begin CHARACTERISTIC A287 "" CURVE 0x278B40 _REC_A1CUR_1_u2_u2_S2 15000 _CNV_R_R_Umr_1_zu_1_3_CM_S2 0 15000 FORMAT "%2.0"
 /begin AXIS_DESCR COM_AXIS W_DKKD _CNV_R_R_Umr_10_zu__9_CM_S2 17 0 120 AXIS_PTS_REF SSTSKL_RS_A2 FORMAT "%3.1" /end AXIS_DESCR
/end CHARACTERISTIC
/begin CHARACTERISTIC A312 "" CURVE 0x276FBA _REC_A1CUR_1_u2_u2_S2 15000 _CNV_R_R_Umr_1_zu_1_3_CM_S2 0 15000 FORMAT "%2.0"
 /begin AXIS_DESCR COM_AXIS W_DKKD _CNV_R_R_Umr_10_zu__9_CM_S2 13 0 120 AXIS_PTS_REF SSTSKL_HS_A3 FORMAT "%3.1" /end AXIS_DESCR
/end CHARACTERISTIC
/begin CHARACTERISTIC A321 "" CURVE 0x276FD4 _REC_A1CUR_1_u2_u2_S2 15000 _CNV_R_R_Umr_1_zu_1_3_CM_S2 0 15000 FORMAT "%2.0"
 /begin AXIS_DESCR COM_AXIS W_DKKD _CNV_R_R_Umr_10_zu__9_CM_S2 17 0 120 AXIS_PTS_REF SSTSKL_RS_A3 FORMAT "%3.1" /end AXIS_DESCR
/end CHARACTERISTIC
/begin CHARACTERISTIC A323 "" CURVE 0x276FF6 _REC_A1CUR_1_u2_u2_S2 15000 _CNV_R_R_Umr_1_zu_1_3_CM_S2 0 15000 FORMAT "%2.0"
 /begin AXIS_DESCR COM_AXIS W_DKKD _CNV_R_R_Umr_10_zu__9_CM_S2 13 0 120 AXIS_PTS_REF SSTSKL_HS_A3 FORMAT "%3.1" /end AXIS_DESCR
/end CHARACTERISTIC
/begin CHARACTERISTIC A332 "" CURVE 0x277010 _REC_A1CUR_1_u2_u2_S2 15000 _CNV_R_R_Umr_1_zu_1_3_CM_S2 0 15000 FORMAT "%2.0"
 /begin AXIS_DESCR COM_AXIS W_DKKD _CNV_R_R_Umr_10_zu__9_CM_S2 17 0 120 AXIS_PTS_REF SSTSKL_RS_A3 FORMAT "%3.1" /end AXIS_DESCR
/end CHARACTERISTIC
/begin CHARACTERISTIC A334 "" CURVE 0x277032 _REC_A1CUR_1_u2_u2_S2 15000 _CNV_R_R_Umr_1_zu_1_3_CM_S2 0 15000 FORMAT "%2.0"
 /begin AXIS_DESCR COM_AXIS W_DKKD _CNV_R_R_Umr_10_zu__9_CM_S2 13 0 120 AXIS_PTS_REF SSTSKL_HS_A3 FORMAT "%3.1" /end AXIS_DESCR
/end CHARACTERISTIC
/begin CHARACTERISTIC A343 "" CURVE 0x27704C _REC_A1CUR_1_u2_u2_S2 15000 _CNV_R_R_Umr_1_zu_1_3_CM_S2 0 15000 FORMAT "%2.0"
 /begin AXIS_DESCR COM_AXIS W_DKKD _CNV_R_R_Umr_10_zu__9_CM_S2 17 0 120 AXIS_PTS_REF SSTSKL_RS_A3 FORMAT "%3.1" /end AXIS_DESCR
/end CHARACTERISTIC
/begin CHARACTERISTIC A345 "" CURVE 0x27706E _REC_A1CUR_1_u2_u2_S2 15000 _CNV_R_R_Umr_1_zu_1_3_CM_S2 0 15000 FORMAT "%2.0"
 /begin AXIS_DESCR COM_AXIS W_DKKD _CNV_R_R_Umr_10_zu__9_CM_S2 13 0 120 AXIS_PTS_REF SSTSKL_HS_A3 FORMAT "%3.1" /end AXIS_DESCR
/end CHARACTERISTIC
/begin CHARACTERISTIC A354 "" CURVE 0x277088 _REC_A1CUR_1_u2_u2_S2 15000 _CNV_R_R_Umr_1_zu_1_3_CM_S2 0 15000 FORMAT "%2.0"
 /begin AXIS_DESCR COM_AXIS W_DKKD _CNV_R_R_Umr_10_zu__9_CM_S2 17 0 120 AXIS_PTS_REF SSTSKL_RS_A3 FORMAT "%3.1" /end AXIS_DESCR
/end CHARACTERISTIC
/begin CHARACTERISTIC A356 "" CURVE 0x2770AA _REC_A1CUR_1_u2_u2_S2 15000 _CNV_R_R_Umr_1_zu_1_3_CM_S2 0 15000 FORMAT "%2.0"
 /begin AXIS_DESCR COM_AXIS W_DKKD _CNV_R_R_Umr_10_zu__9_CM_S2 13 0 120 AXIS_PTS_REF SSTSKL_HS_A3 FORMAT "%3.1" /end AXIS_DESCR
/end CHARACTERISTIC
/begin CHARACTERISTIC A365 "" CURVE 0x2770C4 _REC_A1CUR_1_u2_u2_S2 15000 _CNV_R_R_Umr_1_zu_1_3_CM_S2 0 15000 FORMAT "%2.0"
 /begin AXIS_DESCR COM_AXIS W_DKKD _CNV_R_R_Umr_10_zu__9_CM_S2 17 0 120 AXIS_PTS_REF SSTSKL_RS_A3 FORMAT "%3.1" /end AXIS_DESCR
/end CHARACTERISTIC
/begin CHARACTERISTIC A367 "" CURVE 0x278676 _REC_A1CUR_1_u2_u2_S2 15000 _CNV_R_R_Umr_1_zu_1_3_CM_S2 0 15000 FORMAT "%2.0"
 /begin AXIS_DESCR COM_AXIS W_DKKD _CNV_R_R_Umr_10_zu__9_CM_S2 13 0 120 AXIS_PTS_REF SSTSKL_HS_A3 FORMAT "%3.1" /end AXIS_DESCR
/end CHARACTERISTIC
/begin CHARACTERISTIC A376 "" CURVE 0x278690 _REC_A1CUR_1_u2_u2_S2 15000 _CNV_R_R_Umr_1_zu_1_3_CM_S2 0 15000 FORMAT "%2.0"
 /begin AXIS_DESCR COM_AXIS W_DKKD _CNV_R_R_Umr_10_zu__9_CM_S2 17 0 120 AXIS_PTS_REF SSTSKL_RS_A3 FORMAT "%3.1" /end AXIS_DESCR
/end CHARACTERISTIC
/begin CHARACTERISTIC A378 "" CURVE 0x278B62 _REC_A1CUR_1_u2_u2_S2 15000 _CNV_R_R_Umr_1_zu_1_3_CM_S2 0 15000 FORMAT "%2.0"
 /begin AXIS_DESCR COM_AXIS W_DKKD _CNV_R_R_Umr_10_zu__9_CM_S2 13 0 120 AXIS_PTS_REF SSTSKL_HS_A3 FORMAT "%3.1" /end AXIS_DESCR
/end CHARACTERISTIC
/begin CHARACTERISTIC A387 "" CURVE 0x278B7C _REC_A1CUR_1_u2_u2_S2 15000 _CNV_R_R_Umr_1_zu_1_3_CM_S2 0 15000 FORMAT "%2.0"
 /begin AXIS_DESCR COM_AXIS W_DKKD _CNV_R_R_Umr_10_zu__9_CM_S2 17 0 120 AXIS_PTS_REF SSTSKL_RS_A3 FORMAT "%3.1" /end AXIS_DESCR
/end CHARACTERISTIC
/begin CHARACTERISTIC A412 "" CURVE 0x2770E6 _REC_A1CUR_1_u2_u2_S2 15000 _CNV_R_R_Umr_1_zu_1_3_CM_S2 0 15000 FORMAT "%2.0"
 /begin AXIS_DESCR COM_AXIS W_DKKD _CNV_R_R_Umr_10_zu__9_CM_S2 13 0 120 AXIS_PTS_REF SSTSKL_HS_A4 FORMAT "%3.1" /end AXIS_DESCR
/end CHARACTERISTIC
/begin CHARACTERISTIC A421 "" CURVE 0x277100 _REC_A1CUR_1_u2_u2_S2 15000 _CNV_R_R_Umr_1_zu_1_3_CM_S2 0 15000 FORMAT "%2.0"
 /begin AXIS_DESCR COM_AXIS W_DKKD _CNV_R_R_Umr_10_zu__9_CM_S2 17 0 120 AXIS_PTS_REF SSTSKL_RS_A4 FORMAT "%3.1" /end AXIS_DESCR
/end CHARACTERISTIC
/begin CHARACTERISTIC A423 "" CURVE 0x277122 _REC_A1CUR_1_u2_u2_S2 15000 _CNV_R_R_Umr_1_zu_1_3_CM_S2 0 15000 FORMAT "%2.0"
 /begin AXIS_DESCR COM_AXIS W_DKKD _CNV_R_R_Umr_10_zu__9_CM_S2 13 0 120 AXIS_PTS_REF SSTSKL_HS_A4 FORMAT "%3.1" /end AXIS_DESCR
/end CHARACTERISTIC
/begin CHARACTERISTIC A432 "" CURVE 0x27713C _REC_A1CUR_1_u2_u2_S2 15000 _CNV_R_R_Umr_1_zu_1_3_CM_S2 0 15000 FORMAT "%2.0"
 /begin AXIS_DESCR COM_AXIS W_DKKD _CNV_R_R_Umr_10_zu__9_CM_S2 17 0 120 AXIS_PTS_REF SSTSKL_RS_A4 FORMAT "%3.1" /end AXIS_DESCR
/end CHARACTERISTIC
/begin CHARACTERISTIC A434 "" CURVE 0x27715E _REC_A1CUR_1_u2_u2_S2 15000 _CNV_R_R_Umr_1_zu_1_3_CM_S2 0 15000 FORMAT "%2.0"
 /begin AXIS_DESCR COM_AXIS W_DKKD _CNV_R_R_Umr_10_zu__9_CM_S2 13 0 120 AXIS_PTS_REF SSTSKL_HS_A4 FORMAT "%3.1" /end AXIS_DESCR
/end CHARACTERISTIC
/begin CHARACTERISTIC A443 "" CURVE 0x277178 _REC_A1CUR_1_u2_u2_S2 15000 _CNV_R_R_Umr_1_zu_1_3_CM_S2 0 15000 FORMAT "%2.0"
 /begin AXIS_DESCR COM_AXIS W_DKKD _CNV_R_R_Umr_10_zu__9_CM_S2 17 0 120 AXIS_PTS_REF SSTSKL_RS_A4 FORMAT "%3.1" /end AXIS_DESCR
/end CHARACTERISTIC
/begin CHARACTERISTIC A445 "" CURVE 0x27719A _REC_A1CUR_1_u2_u2_S2 15000 _CNV_R_R_Umr_1_zu_1_3_CM_S2 0 15000 FORMAT "%2.0"
 /begin AXIS_DESCR COM_AXIS W_DKKD _CNV_R_R_Umr_10_zu__9_CM_S2 13 0 120 AXIS_PTS_REF SSTSKL_HS_A4 FORMAT "%3.1" /end AXIS_DESCR
/end CHARACTERISTIC
/begin CHARACTERISTIC A454 "" CURVE 0x2771B4 _REC_A1CUR_1_u2_u2_S2 15000 _CNV_R_R_Umr_1_zu_1_3_CM_S2 0 15000 FORMAT "%2.0"
 /begin AXIS_DESCR COM_AXIS W_DKKD _CNV_R_R_Umr_10_zu__9_CM_S2 17 0 120 AXIS_PTS_REF SSTSKL_RS_A4 FORMAT "%3.1" /end AXIS_DESCR
/end CHARACTERISTIC
/begin CHARACTERISTIC A456 "" CURVE 0x2771D6 _REC_A1CUR_1_u2_u2_S2 15000 _CNV_R_R_Umr_1_zu_1_3_CM_S2 0 15000 FORMAT "%2.0"
 /begin AXIS_DESCR COM_AXIS W_DKKD _CNV_R_R_Umr_10_zu__9_CM_S2 13 0 120 AXIS_PTS_REF SSTSKL_HS_A4 FORMAT "%3.1" /end AXIS_DESCR
/end CHARACTERISTIC
/begin CHARACTERISTIC A465 "" CURVE 0x2771F0 _REC_A1CUR_1_u2_u2_S2 15000 _CNV_R_R_Umr_1_zu_1_3_CM_S2 0 15000 FORMAT "%2.0"
 /begin AXIS_DESCR COM_AXIS W_DKKD _CNV_R_R_Umr_10_zu__9_CM_S2 17 0 120 AXIS_PTS_REF SSTSKL_RS_A4 FORMAT "%3.1" /end AXIS_DESCR
/end CHARACTERISTIC
/begin CHARACTERISTIC A467 "" CURVE 0x2786B2 _REC_A1CUR_1_u2_u2_S2 15000 _CNV_R_R_Umr_1_zu_1_3_CM_S2 0 15000 FORMAT "%2.0"
 /begin AXIS_DESCR COM_AXIS W_DKKD _CNV_R_R_Umr_10_zu__9_CM_S2 13 0 120 AXIS_PTS_REF SSTSKL_HS_A4 FORMAT "%3.1" /end AXIS_DESCR
/end CHARACTERISTIC
/begin CHARACTERISTIC A476 "" CURVE 0x2786CC _REC_A1CUR_1_u2_u2_S2 15000 _CNV_R_R_Umr_1_zu_1_3_CM_S2 0 15000 FORMAT "%2.0"
 /begin AXIS_DESCR COM_AXIS W_DKKD _CNV_R_R_Umr_10_zu__9_CM_S2 17 0 120 AXIS_PTS_REF SSTSKL_RS_A4 FORMAT "%3.1" /end AXIS_DESCR
/end CHARACTERISTIC
/begin CHARACTERISTIC A478 "" CURVE 0x278B9E _REC_A1CUR_1_u2_u2_S2 15000 _CNV_R_R_Umr_1_zu_1_3_CM_S2 0 15000 FORMAT "%2.0"
 /begin AXIS_DESCR COM_AXIS W_DKKD _CNV_R_R_Umr_10_zu__9_CM_S2 13 0 120 AXIS_PTS_REF SSTSKL_HS_A4 FORMAT "%3.1" /end AXIS_DESCR
/end CHARACTERISTIC
/begin CHARACTERISTIC A487 "" CURVE 0x278BB8 _REC_A1CUR_1_u2_u2_S2 15000 _CNV_R_R_Umr_1_zu_1_3_CM_S2 0 15000 FORMAT "%2.0"
 /begin AXIS_DESCR COM_AXIS W_DKKD _CNV_R_R_Umr_10_zu__9_CM_S2 17 0 120 AXIS_PTS_REF SSTSKL_RS_A4 FORMAT "%3.1" /end AXIS_DESCR
/end CHARACTERISTIC
/begin CHARACTERISTIC A512 "" CURVE 0x277212 _REC_A1CUR_1_u2_u2_S2 15000 _CNV_R_R_Umr_1_zu_1_3_CM_S2 0 15000 FORMAT "%2.0"
 /begin AXIS_DESCR COM_AXIS W_DKKD _CNV_R_R_Umr_10_zu__9_CM_S2 13 0 120 AXIS_PTS_REF SSTSKL_HS_A5 FORMAT "%3.1" /end AXIS_DESCR
/end CHARACTERISTIC
/begin CHARACTERISTIC A521 "" CURVE 0x27722C _REC_A1CUR_1_u2_u2_S2 15000 _CNV_R_R_Umr_1_zu_1_3_CM_S2 0 15000 FORMAT "%2.0"
 /begin AXIS_DESCR COM_AXIS W_DKKD _CNV_R_R_Umr_10_zu__9_CM_S2 17 0 120 AXIS_PTS_REF SSTSKL_RS_A5 FORMAT "%3.1" /end AXIS_DESCR
/end CHARACTERISTIC
/begin CHARACTERISTIC A523 "" CURVE 0x27724E _REC_A1CUR_1_u2_u2_S2 15000 _CNV_R_R_Umr_1_zu_1_3_CM_S2 0 15000 FORMAT "%2.0"
 /begin AXIS_DESCR COM_AXIS W_DKKD _CNV_R_R_Umr_10_zu__9_CM_S2 13 0 120 AXIS_PTS_REF SSTSKL_HS_A5 FORMAT "%3.1" /end AXIS_DESCR
/end CHARACTERISTIC
/begin CHARACTERISTIC A532 "" CURVE 0x277268 _REC_A1CUR_1_u2_u2_S2 15000 _CNV_R_R_Umr_1_zu_1_3_CM_S2 0 15000 FORMAT "%2.0"
 /begin AXIS_DESCR COM_AXIS W_DKKD _CNV_R_R_Umr_10_zu__9_CM_S2 17 0 120 AXIS_PTS_REF SSTSKL_RS_A5 FORMAT "%3.1" /end AXIS_DESCR
/end CHARACTERISTIC
/begin CHARACTERISTIC A534 "" CURVE 0x27728A _REC_A1CUR_1_u2_u2_S2 15000 _CNV_R_R_Umr_1_zu_1_3_CM_S2 0 15000 FORMAT "%2.0"
 /begin AXIS_DESCR COM_AXIS W_DKKD _CNV_R_R_Umr_10_zu__9_CM_S2 13 0 120 AXIS_PTS_REF SSTSKL_HS_A5 FORMAT "%3.1" /end AXIS_DESCR
/end CHARACTERISTIC
/begin CHARACTERISTIC A543 "" CURVE 0x2772A4 _REC_A1CUR_1_u2_u2_S2 15000 _CNV_R_R_Umr_1_zu_1_3_CM_S2 0 15000 FORMAT "%2.0"
 /begin AXIS_DESCR COM_AXIS W_DKKD _CNV_R_R_Umr_10_zu__9_CM_S2 17 0 120 AXIS_PTS_REF SSTSKL_RS_A5 FORMAT "%3.1" /end AXIS_DESCR
/end CHARACTERISTIC
/begin CHARACTERISTIC A545 "" CURVE 0x2772C6 _REC_A1CUR_1_u2_u2_S2 15000 _CNV_R_R_Umr_1_zu_1_3_CM_S2 0 15000 FORMAT "%2.0"
 /begin AXIS_DESCR COM_AXIS W_DKKD _CNV_R_R_Umr_10_zu__9_CM_S2 13 0 120 AXIS_PTS_REF SSTSKL_HS_A5 FORMAT "%3.1" /end AXIS_DESCR
/end CHARACTERISTIC
/begin CHARACTERISTIC A554 "" CURVE 0x2772E0 _REC_A1CUR_1_u2_u2_S2 15000 _CNV_R_R_Umr_1_zu_1_3_CM_S2 0 15000 FORMAT "%2.0"
 /begin AXIS_DESCR COM_AXIS W_DKKD _CNV_R_R_Umr_10_zu__9_CM_S2 17 0 120 AXIS_PTS_REF SSTSKL_RS_A5 FORMAT "%3.1" /end AXIS_DESCR
/end CHARACTERISTIC
/begin CHARACTERISTIC A556 "" CURVE 0x277302 _REC_A1CUR_1_u2_u2_S2 15000 _CNV_R_R_Umr_1_zu_1_3_CM_S2 0 15000 FORMAT "%2.0"
 /begin AXIS_DESCR COM_AXIS W_DKKD _CNV_R_R_Umr_10_zu__9_CM_S2 13 0 120 AXIS_PTS_REF SSTSKL_HS_A5 FORMAT "%3.1" /end AXIS_DESCR
/end CHARACTERISTIC
/begin CHARACTERISTIC A565 "" CURVE 0x27731C _REC_A1CUR_1_u2_u2_S2 15000 _CNV_R_R_Umr_1_zu_1_3_CM_S2 0 15000 FORMAT "%2.0"
 /begin AXIS_DESCR COM_AXIS W_DKKD _CNV_R_R_Umr_10_zu__9_CM_S2 17 0 120 AXIS_PTS_REF SSTSKL_RS_A5 FORMAT "%3.1" /end AXIS_DESCR
/end CHARACTERISTIC
/begin CHARACTERISTIC A567 "" CURVE 0x2786EE _REC_A1CUR_1_u2_u2_S2 15000 _CNV_R_R_Umr_1_zu_1_3_CM_S2 0 15000 FORMAT "%2.0"
 /begin AXIS_DESCR COM_AXIS W_DKKD _CNV_R_R_Umr_10_zu__9_CM_S2 13 0 120 AXIS_PTS_REF SSTSKL_HS_A5 FORMAT "%3.1" /end AXIS_DESCR
/end CHARACTERISTIC
/begin CHARACTERISTIC A576 "" CURVE 0x278708 _REC_A1CUR_1_u2_u2_S2 15000 _CNV_R_R_Umr_1_zu_1_3_CM_S2 0 15000 FORMAT "%2.0"
 /begin AXIS_DESCR COM_AXIS W_DKKD _CNV_R_R_Umr_10_zu__9_CM_S2 17 0 120 AXIS_PTS_REF SSTSKL_RS_A5 FORMAT "%3.1" /end AXIS_DESCR
/end CHARACTERISTIC
/begin CHARACTERISTIC A578 "" CURVE 0x278BDA _REC_A1CUR_1_u2_u2_S2 15000 _CNV_R_R_Umr_1_zu_1_3_CM_S2 0 15000 FORMAT "%2.0"
 /begin AXIS_DESCR COM_AXIS W_DKKD _CNV_R_R_Umr_10_zu__9_CM_S2 13 0 120 AXIS_PTS_REF SSTSKL_HS_A5 FORMAT "%3.1" /end AXIS_DESCR
/end CHARACTERISTIC
/begin CHARACTERISTIC A587 "" CURVE 0x278BF4 _REC_A1CUR_1_u2_u2_S2 15000 _CNV_R_R_Umr_1_zu_1_3_CM_S2 0 15000 FORMAT "%2.0"
 /begin AXIS_DESCR COM_AXIS W_DKKD _CNV_R_R_Umr_10_zu__9_CM_S2 17 0 120 AXIS_PTS_REF SSTSKL_RS_A5 FORMAT "%3.1" /end AXIS_DESCR
/end CHARACTERISTIC
/begin CHARACTERISTIC E12 "" CURVE 0x27733E _REC_A1CUR_1_u2_u2_S2 15000 _CNV_R_R_Umr_1_zu_1_3_CM_S2 0 15000 FORMAT "%2.0"
 /begin AXIS_DESCR COM_AXIS W_DKKD _CNV_R_R_Umr_10_zu__9_CM_S2 13 0 120 AXIS_PTS_REF SSTSKL_HS_E FORMAT "%3.1" /end AXIS_DESCR
/end CHARACTERISTIC
/begin CHARACTERISTIC E21 "" CURVE 0x277358 _REC_A1CUR_1_u2_u2_S2 15000 _CNV_R_R_Umr_1_zu_1_3_CM_S2 0 15000 FORMAT "%2.0"
 /begin AXIS_DESCR COM_AXIS W_DKKD _CNV_R_R_Umr_10_zu__9_CM_S2 17 0 120 AXIS_PTS_REF SSTSKL_RS_E FORMAT "%3.1" /end AXIS_DESCR
/end CHARACTERISTIC
/begin CHARACTERISTIC E23 "" CURVE 0x27737A _REC_A1CUR_1_u2_u2_S2 15000 _CNV_R_R_Umr_1_zu_1_3_CM_S2 0 15000 FORMAT "%2.0"
 /begin AXIS_DESCR COM_AXIS W_DKKD _CNV_R_R_Umr_10_zu__9_CM_S2 13 0 120 AXIS_PTS_REF SSTSKL_HS_E FORMAT "%3.1" /end AXIS_DESCR
/end CHARACTERISTIC
/begin CHARACTERISTIC E32 "" CURVE 0x277394 _REC_A1CUR_1_u2_u2_S2 15000 _CNV_R_R_Umr_1_zu_1_3_CM_S2 0 15000 FORMAT "%2.0"
 /begin AXIS_DESCR COM_AXIS W_DKKD _CNV_R_R_Umr_10_zu__9_CM_S2 17 0 120 AXIS_PTS_REF SSTSKL_RS_E FORMAT "%3.1" /end AXIS_DESCR
/end CHARACTERISTIC
/begin CHARACTERISTIC E34 "" CURVE 0x2773B6 _REC_A1CUR_1_u2_u2_S2 15000 _CNV_R_R_Umr_1_zu_1_3_CM_S2 0 15000 FORMAT "%2.0"
 /begin AXIS_DESCR COM_AXIS W_DKKD _CNV_R_R_Umr_10_zu__9_CM_S2 13 0 120 AXIS_PTS_REF SSTSKL_HS_E FORMAT "%3.1" /end AXIS_DESCR
/end CHARACTERISTIC
/begin CHARACTERISTIC E43 "" CURVE 0x2773D0 _REC_A1CUR_1_u2_u2_S2 15000 _CNV_R_R_Umr_1_zu_1_3_CM_S2 0 15000 FORMAT "%2.0"
 /begin AXIS_DESCR COM_AXIS W_DKKD _CNV_R_R_Umr_10_zu__9_CM_S2 17 0 120 AXIS_PTS_REF SSTSKL_RS_E FORMAT "%3.1" /end AXIS_DESCR
/end CHARACTERISTIC
/begin CHARACTERISTIC E45 "" CURVE 0x2773F2 _REC_A1CUR_1_u2_u2_S2 15000 _CNV_R_R_Umr_1_zu_1_3_CM_S2 0 15000 FORMAT "%2.0"
 /begin AXIS_DESCR COM_AXIS W_DKKD _CNV_R_R_Umr_10_zu__9_CM_S2 13 0 120 AXIS_PTS_REF SSTSKL_HS_E FORMAT "%3.1" /end AXIS_DESCR
/end CHARACTERISTIC
/begin CHARACTERISTIC E54 "" CURVE 0x27740C _REC_A1CUR_1_u2_u2_S2 15000 _CNV_R_R_Umr_1_zu_1_3_CM_S2 0 15000 FORMAT "%2.0"
 /begin AXIS_DESCR COM_AXIS W_DKKD _CNV_R_R_Umr_10_zu__9_CM_S2 17 0 120 AXIS_PTS_REF SSTSKL_RS_E FORMAT "%3.1" /end AXIS_DESCR
/end CHARACTERISTIC
/begin CHARACTERISTIC E56 "" CURVE 0x27742E _REC_A1CUR_1_u2_u2_S2 15000 _CNV_R_R_Umr_1_zu_1_3_CM_S2 0 15000 FORMAT "%2.0"
 /begin AXIS_DESCR COM_AXIS W_DKKD _CNV_R_R_Umr_10_zu__9_CM_S2 13 0 120 AXIS_PTS_REF SSTSKL_HS_E FORMAT "%3.1" /end AXIS_DESCR
/end CHARACTERISTIC
/begin CHARACTERISTIC E65 "" CURVE 0x277448 _REC_A1CUR_1_u2_u2_S2 15000 _CNV_R_R_Umr_1_zu_1_3_CM_S2 0 15000 FORMAT "%2.0"
 /begin AXIS_DESCR COM_AXIS W_DKKD _CNV_R_R_Umr_10_zu__9_CM_S2 17 0 120 AXIS_PTS_REF SSTSKL_RS_E FORMAT "%3.1" /end AXIS_DESCR
/end CHARACTERISTIC
/begin CHARACTERISTIC E67 "" CURVE 0x27872A _REC_A1CUR_1_u2_u2_S2 15000 _CNV_R_R_Umr_1_zu_1_3_CM_S2 0 15000 FORMAT "%2.0"
 /begin AXIS_DESCR COM_AXIS W_DKKD _CNV_R_R_Umr_10_zu__9_CM_S2 13 0 120 AXIS_PTS_REF SSTSKL_HS_E FORMAT "%3.1" /end AXIS_DESCR
/end CHARACTERISTIC
/begin CHARACTERISTIC E76 "" CURVE 0x278744 _REC_A1CUR_1_u2_u2_S2 15000 _CNV_R_R_Umr_1_zu_1_3_CM_S2 0 15000 FORMAT "%2.0"
 /begin AXIS_DESCR COM_AXIS W_DKKD _CNV_R_R_Umr_10_zu__9_CM_S2 17 0 120 AXIS_PTS_REF SSTSKL_RS_E FORMAT "%3.1" /end AXIS_DESCR
/end CHARACTERISTIC
/begin CHARACTERISTIC E78 "" CURVE 0x278C16 _REC_A1CUR_1_u2_u2_S2 15000 _CNV_R_R_Umr_1_zu_1_3_CM_S2 0 15000 FORMAT "%2.0"
 /begin AXIS_DESCR COM_AXIS W_DKKD _CNV_R_R_Umr_10_zu__9_CM_S2 13 0 120 AXIS_PTS_REF SSTSKL_HS_E FORMAT "%3.1" /end AXIS_DESCR
/end CHARACTERISTIC
/begin CHARACTERISTIC E87 "" CURVE 0x278C30 _REC_A1CUR_1_u2_u2_S2 15000 _CNV_R_R_Umr_1_zu_1_3_CM_S2 0 15000 FORMAT "%2.0"
 /begin AXIS_DESCR COM_AXIS W_DKKD _CNV_R_R_Umr_10_zu__9_CM_S2 17 0 120 AXIS_PTS_REF SSTSKL_RS_E FORMAT "%3.1" /end AXIS_DESCR
/end CHARACTERISTIC
/begin CHARACTERISTIC ECO12 "" CURVE 0x27746A _REC_A1CUR_1_u2_u2_S2 15000 _CNV_R_R_Umr_1_zu_1_3_CM_S2 0 15000 FORMAT "%2.0"
 /begin AXIS_DESCR COM_AXIS W_DKKD _CNV_R_R_Umr_10_zu__9_CM_S2 13 0 120 AXIS_PTS_REF SSTSKL_HS_ECO FORMAT "%3.1" /end AXIS_DESCR
/end CHARACTERISTIC
/begin CHARACTERISTIC ECO21 "" CURVE 0x277484 _REC_A1CUR_1_u2_u2_S2 15000 _CNV_R_R_Umr_1_zu_1_3_CM_S2 0 15000 FORMAT "%2.0"
 /begin AXIS_DESCR COM_AXIS W_DKKD _CNV_R_R_Umr_10_zu__9_CM_S2 17 0 120 AXIS_PTS_REF SSTSKL_RS_ECO FORMAT "%3.1" /end AXIS_DESCR
/end CHARACTERISTIC
/begin CHARACTERISTIC ECO23 "" CURVE 0x2774A6 _REC_A1CUR_1_u2_u2_S2 15000 _CNV_R_R_Umr_1_zu_1_3_CM_S2 0 15000 FORMAT "%2.0"
 /begin AXIS_DESCR COM_AXIS W_DKKD _CNV_R_R_Umr_10_zu__9_CM_S2 13 0 120 AXIS_PTS_REF SSTSKL_HS_ECO FORMAT "%3.1" /end AXIS_DESCR
/end CHARACTERISTIC
/begin CHARACTERISTIC ECO32 "" CURVE 0x2774C0 _REC_A1CUR_1_u2_u2_S2 15000 _CNV_R_R_Umr_1_zu_1_3_CM_S2 0 15000 FORMAT "%2.0"
 /begin AXIS_DESCR COM_AXIS W_DKKD _CNV_R_R_Umr_10_zu__9_CM_S2 17 0 120 AXIS_PTS_REF SSTSKL_RS_ECO FORMAT "%3.1" /end AXIS_DESCR
/end CHARACTERISTIC
/begin CHARACTERISTIC ECO34 "" CURVE 0x2774E2 _REC_A1CUR_1_u2_u2_S2 15000 _CNV_R_R_Umr_1_zu_1_3_CM_S2 0 15000 FORMAT "%2.0"
 /begin AXIS_DESCR COM_AXIS W_DKKD _CNV_R_R_Umr_10_zu__9_CM_S2 13 0 120 AXIS_PTS_REF SSTSKL_HS_ECO FORMAT "%3.1" /end AXIS_DESCR
/end CHARACTERISTIC
/begin CHARACTERISTIC ECO43 "" CURVE 0x2774FC _REC_A1CUR_1_u2_u2_S2 15000 _CNV_R_R_Umr_1_zu_1_3_CM_S2 0 15000 FORMAT "%2.0"
 /begin AXIS_DESCR COM_AXIS W_DKKD _CNV_R_R_Umr_10_zu__9_CM_S2 17 0 120 AXIS_PTS_REF SSTSKL_RS_ECO FORMAT "%3.1" /end AXIS_DESCR
/end CHARACTERISTIC
/begin CHARACTERISTIC ECO45 "" CURVE 0x27751E _REC_A1CUR_1_u2_u2_S2 15000 _CNV_R_R_Umr_1_zu_1_3_CM_S2 0 15000 FORMAT "%2.0"
 /begin AXIS_DESCR COM_AXIS W_DKKD _CNV_R_R_Umr_10_zu__9_CM_S2 13 0 120 AXIS_PTS_REF SSTSKL_HS_ECO FORMAT "%3.1" /end AXIS_DESCR
/end CHARACTERISTIC
/begin CHARACTERISTIC ECO54 "" CURVE 0x277538 _REC_A1CUR_1_u2_u2_S2 15000 _CNV_R_R_Umr_1_zu_1_3_CM_S2 0 15000 FORMAT "%2.0"
 /begin AXIS_DESCR COM_AXIS W_DKKD _CNV_R_R_Umr_10_zu__9_CM_S2 17 0 120 AXIS_PTS_REF SSTSKL_RS_ECO FORMAT "%3.1" /end AXIS_DESCR
/end CHARACTERISTIC
/begin CHARACTERISTIC ECO56 "" CURVE 0x27755A _REC_A1CUR_1_u2_u2_S2 15000 _CNV_R_R_Umr_1_zu_1_3_CM_S2 0 15000 FORMAT "%2.0"
 /begin AXIS_DESCR COM_AXIS W_DKKD _CNV_R_R_Umr_10_zu__9_CM_S2 13 0 120 AXIS_PTS_REF SSTSKL_HS_ECO FORMAT "%3.1" /end AXIS_DESCR
/end CHARACTERISTIC
/begin CHARACTERISTIC ECO65 "" CURVE 0x277574 _REC_A1CUR_1_u2_u2_S2 15000 _CNV_R_R_Umr_1_zu_1_3_CM_S2 0 15000 FORMAT "%2.0"
 /begin AXIS_DESCR COM_AXIS W_DKKD _CNV_R_R_Umr_10_zu__9_CM_S2 17 0 120 AXIS_PTS_REF SSTSKL_RS_ECO FORMAT "%3.1" /end AXIS_DESCR
/end CHARACTERISTIC
/begin CHARACTERISTIC ECO67 "" CURVE 0x278766 _REC_A1CUR_1_u2_u2_S2 15000 _CNV_R_R_Umr_1_zu_1_3_CM_S2 0 15000 FORMAT "%2.0"
 /begin AXIS_DESCR COM_AXIS W_DKKD _CNV_R_R_Umr_10_zu__9_CM_S2 13 0 120 AXIS_PTS_REF SSTSKL_HS_ECO FORMAT "%3.1" /end AXIS_DESCR
/end CHARACTERISTIC
/begin CHARACTERISTIC ECO76 "" CURVE 0x278780 _REC_A1CUR_1_u2_u2_S2 15000 _CNV_R_R_Umr_1_zu_1_3_CM_S2 0 15000 FORMAT "%2.0"
 /begin AXIS_DESCR COM_AXIS W_DKKD _CNV_R_R_Umr_10_zu__9_CM_S2 17 0 120 AXIS_PTS_REF SSTSKL_RS_ECO FORMAT "%3.1" /end AXIS_DESCR
/end CHARACTERISTIC
/begin CHARACTERISTIC ECO78 "" CURVE 0x278C52 _REC_A1CUR_1_u2_u2_S2 15000 _CNV_R_R_Umr_1_zu_1_3_CM_S2 0 15000 FORMAT "%2.0"
 /begin AXIS_DESCR COM_AXIS W_DKKD _CNV_R_R_Umr_10_zu__9_CM_S2 13 0 120 AXIS_PTS_REF SSTSKL_HS_ECO FORMAT "%3.1" /end AXIS_DESCR
/end CHARACTERISTIC
/begin CHARACTERISTIC ECO87 "" CURVE 0x278C6C _REC_A1CUR_1_u2_u2_S2 15000 _CNV_R_R_Umr_1_zu_1_3_CM_S2 0 15000 FORMAT "%2.0"
 /begin AXIS_DESCR COM_AXIS W_DKKD _CNV_R_R_Umr_10_zu__9_CM_S2 17 0 120 AXIS_PTS_REF SSTSKL_RS_ECO FORMAT "%3.1" /end AXIS_DESCR
/end CHARACTERISTIC
/begin CHARACTERISTIC ECOA112 "" CURVE 0x277596 _REC_A1CUR_1_u2_u2_S2 15000 _CNV_R_R_Umr_1_zu_1_3_CM_S2 0 15000 FORMAT "%2.0"
 /begin AXIS_DESCR COM_AXIS W_DKKD _CNV_R_R_Umr_10_zu__9_CM_S2 13 0 120 AXIS_PTS_REF SSTSKL_HS_ECOA1 FORMAT "%3.1" /end AXIS_DESCR
/end CHARACTERISTIC
/begin CHARACTERISTIC ECOA121 "" CURVE 0x2775B0 _REC_A1CUR_1_u2_u2_S2 15000 _CNV_R_R_Umr_1_zu_1_3_CM_S2 0 15000 FORMAT "%2.0"
 /begin AXIS_DESCR COM_AXIS W_DKKD _CNV_R_R_Umr_10_zu__9_CM_S2 17 0 120 AXIS_PTS_REF SSTSKL_RS_ECOA1 FORMAT "%3.1" /end AXIS_DESCR
/end CHARACTERISTIC
/begin CHARACTERISTIC ECOA123 "" CURVE 0x2775D2 _REC_A1CUR_1_u2_u2_S2 15000 _CNV_R_R_Umr_1_zu_1_3_CM_S2 0 15000 FORMAT "%2.0"
 /begin AXIS_DESCR COM_AXIS W_DKKD _CNV_R_R_Umr_10_zu__9_CM_S2 13 0 120 AXIS_PTS_REF SSTSKL_HS_ECOA1 FORMAT "%3.1" /end AXIS_DESCR
/end CHARACTERISTIC
/begin CHARACTERISTIC ECOA132 "" CURVE 0x2775EC _REC_A1CUR_1_u2_u2_S2 15000 _CNV_R_R_Umr_1_zu_1_3_CM_S2 0 15000 FORMAT "%2.0"
 /begin AXIS_DESCR COM_AXIS W_DKKD _CNV_R_R_Umr_10_zu__9_CM_S2 17 0 120 AXIS_PTS_REF SSTSKL_RS_ECOA1 FORMAT "%3.1" /end AXIS_DESCR
/end CHARACTERISTIC
/begin CHARACTERISTIC ECOA134 "" CURVE 0x27760E _REC_A1CUR_1_u2_u2_S2 15000 _CNV_R_R_Umr_1_zu_1_3_CM_S2 0 15000 FORMAT "%2.0"
 /begin AXIS_DESCR COM_AXIS W_DKKD _CNV_R_R_Umr_10_zu__9_CM_S2 13 0 120 AXIS_PTS_REF SSTSKL_HS_ECOA1 FORMAT "%3.1" /end AXIS_DESCR
/end CHARACTERISTIC
/begin CHARACTERISTIC ECOA143 "" CURVE 0x277628 _REC_A1CUR_1_u2_u2_S2 15000 _CNV_R_R_Umr_1_zu_1_3_CM_S2 0 15000 FORMAT "%2.0"
 /begin AXIS_DESCR COM_AXIS W_DKKD _CNV_R_R_Umr_10_zu__9_CM_S2 17 0 120 AXIS_PTS_REF SSTSKL_RS_ECOA1 FORMAT "%3.1" /end AXIS_DESCR
/end CHARACTERISTIC
/begin CHARACTERISTIC ECOA145 "" CURVE 0x27764A _REC_A1CUR_1_u2_u2_S2 15000 _CNV_R_R_Umr_1_zu_1_3_CM_S2 0 15000 FORMAT "%2.0"
 /begin AXIS_DESCR COM_AXIS W_DKKD _CNV_R_R_Umr_10_zu__9_CM_S2 13 0 120 AXIS_PTS_REF SSTSKL_HS_ECOA1 FORMAT "%3.1" /end AXIS_DESCR
/end CHARACTERISTIC
/begin CHARACTERISTIC ECOA154 "" CURVE 0x277664 _REC_A1CUR_1_u2_u2_S2 15000 _CNV_R_R_Umr_1_zu_1_3_CM_S2 0 15000 FORMAT "%2.0"
 /begin AXIS_DESCR COM_AXIS W_DKKD _CNV_R_R_Umr_10_zu__9_CM_S2 17 0 120 AXIS_PTS_REF SSTSKL_RS_ECOA1 FORMAT "%3.1" /end AXIS_DESCR
/end CHARACTERISTIC
/begin CHARACTERISTIC ECOA156 "" CURVE 0x277686 _REC_A1CUR_1_u2_u2_S2 15000 _CNV_R_R_Umr_1_zu_1_3_CM_S2 0 15000 FORMAT "%2.0"
 /begin AXIS_DESCR COM_AXIS W_DKKD _CNV_R_R_Umr_10_zu__9_CM_S2 13 0 120 AXIS_PTS_REF SSTSKL_HS_ECOA1 FORMAT "%3.1" /end AXIS_DESCR
/end CHARACTERISTIC
/begin CHARACTERISTIC ECOA165 "" CURVE 0x2776A0 _REC_A1CUR_1_u2_u2_S2 15000 _CNV_R_R_Umr_1_zu_1_3_CM_S2 0 15000 FORMAT "%2.0"
 /begin AXIS_DESCR COM_AXIS W_DKKD _CNV_R_R_Umr_10_zu__9_CM_S2 17 0 120 AXIS_PTS_REF SSTSKL_RS_ECOA1 FORMAT "%3.1" /end AXIS_DESCR
/end CHARACTERISTIC
/begin CHARACTERISTIC ECOA167 "" CURVE 0x2787A2 _REC_A1CUR_1_u2_u2_S2 15000 _CNV_R_R_Umr_1_zu_1_3_CM_S2 0 15000 FORMAT "%2.0"
 /begin AXIS_DESCR COM_AXIS W_DKKD _CNV_R_R_Umr_10_zu__9_CM_S2 13 0 120 AXIS_PTS_REF SSTSKL_HS_ECOA1 FORMAT "%3.1" /end AXIS_DESCR
/end CHARACTERISTIC
/begin CHARACTERISTIC ECOA176 "" CURVE 0x2787BC _REC_A1CUR_1_u2_u2_S2 15000 _CNV_R_R_Umr_1_zu_1_3_CM_S2 0 15000 FORMAT "%2.0"
 /begin AXIS_DESCR COM_AXIS W_DKKD _CNV_R_R_Umr_10_zu__9_CM_S2 17 0 120 AXIS_PTS_REF SSTSKL_RS_ECOA1 FORMAT "%3.1" /end AXIS_DESCR
/end CHARACTERISTIC
/begin CHARACTERISTIC ECOA178 "" CURVE 0x278C8E _REC_A1CUR_1_u2_u2_S2 15000 _CNV_R_R_Umr_1_zu_1_3_CM_S2 0 15000 FORMAT "%2.0"
 /begin AXIS_DESCR COM_AXIS W_DKKD _CNV_R_R_Umr_10_zu__9_CM_S2 13 0 120 AXIS_PTS_REF SSTSKL_HS_ECOA1 FORMAT "%3.1" /end AXIS_DESCR
/end CHARACTERISTIC
/begin CHARACTERISTIC ECOA187 "" CURVE 0x278CA8 _REC_A1CUR_1_u2_u2_S2 15000 _CNV_R_R_Umr_1_zu_1_3_CM_S2 0 15000 FORMAT "%2.0"
 /begin AXIS_DESCR COM_AXIS W_DKKD _CNV_R_R_Umr_10_zu__9_CM_S2 17 0 120 AXIS_PTS_REF SSTSKL_RS_ECOA1 FORMAT "%3.1" /end AXIS_DESCR
/end CHARACTERISTIC
/begin CHARACTERISTIC ECOA212 "" CURVE 0x2776C2 _REC_A1CUR_1_u2_u2_S2 15000 _CNV_R_R_Umr_1_zu_1_3_CM_S2 0 15000 FORMAT "%2.0"
 /begin AXIS_DESCR COM_AXIS W_DKKD _CNV_R_R_Umr_10_zu__9_CM_S2 13 0 120 AXIS_PTS_REF SSTSKL_HS_ECOA2 FORMAT "%3.1" /end AXIS_DESCR
/end CHARACTERISTIC
/begin CHARACTERISTIC ECOA221 "" CURVE 0x2776DC _REC_A1CUR_1_u2_u2_S2 15000 _CNV_R_R_Umr_1_zu_1_3_CM_S2 0 15000 FORMAT "%2.0"
 /begin AXIS_DESCR COM_AXIS W_DKKD _CNV_R_R_Umr_10_zu__9_CM_S2 17 0 120 AXIS_PTS_REF SSTSKL_RS_ECOA2 FORMAT "%3.1" /end AXIS_DESCR
/end CHARACTERISTIC
/begin CHARACTERISTIC ECOA223 "" CURVE 0x2776FE _REC_A1CUR_1_u2_u2_S2 15000 _CNV_R_R_Umr_1_zu_1_3_CM_S2 0 15000 FORMAT "%2.0"
 /begin AXIS_DESCR COM_AXIS W_DKKD _CNV_R_R_Umr_10_zu__9_CM_S2 13 0 120 AXIS_PTS_REF SSTSKL_HS_ECOA2 FORMAT "%3.1" /end AXIS_DESCR
/end CHARACTERISTIC
/begin CHARACTERISTIC ECOA232 "" CURVE 0x277718 _REC_A1CUR_1_u2_u2_S2 15000 _CNV_R_R_Umr_1_zu_1_3_CM_S2 0 15000 FORMAT "%2.0"
 /begin AXIS_DESCR COM_AXIS W_DKKD _CNV_R_R_Umr_10_zu__9_CM_S2 17 0 120 AXIS_PTS_REF SSTSKL_RS_ECOA2 FORMAT "%3.1" /end AXIS_DESCR
/end CHARACTERISTIC
/begin CHARACTERISTIC ECOA234 "" CURVE 0x27773A _REC_A1CUR_1_u2_u2_S2 15000 _CNV_R_R_Umr_1_zu_1_3_CM_S2 0 15000 FORMAT "%2.0"
 /begin AXIS_DESCR COM_AXIS W_DKKD _CNV_R_R_Umr_10_zu__9_CM_S2 13 0 120 AXIS_PTS_REF SSTSKL_HS_ECOA2 FORMAT "%3.1" /end AXIS_DESCR
/end CHARACTERISTIC
/begin CHARACTERISTIC ECOA243 "" CURVE 0x277754 _REC_A1CUR_1_u2_u2_S2 15000 _CNV_R_R_Umr_1_zu_1_3_CM_S2 0 15000 FORMAT "%2.0"
 /begin AXIS_DESCR COM_AXIS W_DKKD _CNV_R_R_Umr_10_zu__9_CM_S2 17 0 120 AXIS_PTS_REF SSTSKL_RS_ECOA2 FORMAT "%3.1" /end AXIS_DESCR
/end CHARACTERISTIC
/begin CHARACTERISTIC ECOA245 "" CURVE 0x277776 _REC_A1CUR_1_u2_u2_S2 15000 _CNV_R_R_Umr_1_zu_1_3_CM_S2 0 15000 FORMAT "%2.0"
 /begin AXIS_DESCR COM_AXIS W_DKKD _CNV_R_R_Umr_10_zu__9_CM_S2 13 0 120 AXIS_PTS_REF SSTSKL_HS_ECOA2 FORMAT "%3.1" /end AXIS_DESCR
/end CHARACTERISTIC
/begin CHARACTERISTIC ECOA254 "" CURVE 0x277790 _REC_A1CUR_1_u2_u2_S2 15000 _CNV_R_R_Umr_1_zu_1_3_CM_S2 0 15000 FORMAT "%2.0"
 /begin AXIS_DESCR COM_AXIS W_DKKD _CNV_R_R_Umr_10_zu__9_CM_S2 17 0 120 AXIS_PTS_REF SSTSKL_RS_ECOA2 FORMAT "%3.1" /end AXIS_DESCR
/end CHARACTERISTIC
/begin CHARACTERISTIC ECOA256 "" CURVE 0x2777B2 _REC_A1CUR_1_u2_u2_S2 15000 _CNV_R_R_Umr_1_zu_1_3_CM_S2 0 15000 FORMAT "%2.0"
 /begin AXIS_DESCR COM_AXIS W_DKKD _CNV_R_R_Umr_10_zu__9_CM_S2 13 0 120 AXIS_PTS_REF SSTSKL_HS_ECOA2 FORMAT "%3.1" /end AXIS_DESCR
/end CHARACTERISTIC
/begin CHARACTERISTIC ECOA265 "" CURVE 0x2777CC _REC_A1CUR_1_u2_u2_S2 15000 _CNV_R_R_Umr_1_zu_1_3_CM_S2 0 15000 FORMAT "%2.0"
 /begin AXIS_DESCR COM_AXIS W_DKKD _CNV_R_R_Umr_10_zu__9_CM_S2 17 0 120 AXIS_PTS_REF SSTSKL_RS_ECOA2 FORMAT "%3.1" /end AXIS_DESCR
/end CHARACTERISTIC
/begin CHARACTERISTIC ECOA267 "" CURVE 0x2787DE _REC_A1CUR_1_u2_u2_S2 15000 _CNV_R_R_Umr_1_zu_1_3_CM_S2 0 15000 FORMAT "%2.0"
 /begin AXIS_DESCR COM_AXIS W_DKKD _CNV_R_R_Umr_10_zu__9_CM_S2 13 0 120 AXIS_PTS_REF SSTSKL_HS_ECOA2 FORMAT "%3.1" /end AXIS_DESCR
/end CHARACTERISTIC
/begin CHARACTERISTIC ECOA276 "" CURVE 0x2787F8 _REC_A1CUR_1_u2_u2_S2 15000 _CNV_R_R_Umr_1_zu_1_3_CM_S2 0 15000 FORMAT "%2.0"
 /begin AXIS_DESCR COM_AXIS W_DKKD _CNV_R_R_Umr_10_zu__9_CM_S2 17 0 120 AXIS_PTS_REF SSTSKL_RS_ECOA2 FORMAT "%3.1" /end AXIS_DESCR
/end CHARACTERISTIC
/begin CHARACTERISTIC ECOA278 "" CURVE 0x278CCA _REC_A1CUR_1_u2_u2_S2 15000 _CNV_R_R_Umr_1_zu_1_3_CM_S2 0 15000 FORMAT "%2.0"
 /begin AXIS_DESCR COM_AXIS W_DKKD _CNV_R_R_Umr_10_zu__9_CM_S2 13 0 120 AXIS_PTS_REF SSTSKL_HS_ECOA2 FORMAT "%3.1" /end AXIS_DESCR
/end CHARACTERISTIC
/begin CHARACTERISTIC ECOA287 "" CURVE 0x278CE4 _REC_A1CUR_1_u2_u2_S2 15000 _CNV_R_R_Umr_1_zu_1_3_CM_S2 0 15000 FORMAT "%2.0"
 /begin AXIS_DESCR COM_AXIS W_DKKD _CNV_R_R_Umr_10_zu__9_CM_S2 17 0 120 AXIS_PTS_REF SSTSKL_RS_ECOA2 FORMAT "%3.1" /end AXIS_DESCR
/end CHARACTERISTIC
/begin CHARACTERISTIC ECOWL212 "" CURVE 0x2777EE _REC_A1CUR_1_u2_u2_S2 15000 _CNV_R_R_Umr_1_zu_1_3_CM_S2 0 15000 FORMAT "%2.0"
 /begin AXIS_DESCR COM_AXIS W_DKKD _CNV_R_R_Umr_10_zu__9_CM_S2 13 0 120 AXIS_PTS_REF SSTSKL_HS_ECOWL2 FORMAT "%3.1" /end AXIS_DESCR
/end CHARACTERISTIC
/begin CHARACTERISTIC ECOWL221 "" CURVE 0x277808 _REC_A1CUR_1_u2_u2_S2 15000 _CNV_R_R_Umr_1_zu_1_3_CM_S2 0 15000 FORMAT "%2.0"
 /begin AXIS_DESCR COM_AXIS W_DKKD _CNV_R_R_Umr_10_zu__9_CM_S2 17 0 120 AXIS_PTS_REF SSTSKL_RS_ECOWL2 FORMAT "%3.1" /end AXIS_DESCR
/end CHARACTERISTIC
/begin CHARACTERISTIC ECOWL223 "" CURVE 0x27782A _REC_A1CUR_1_u2_u2_S2 15000 _CNV_R_R_Umr_1_zu_1_3_CM_S2 0 15000 FORMAT "%2.0"
 /begin AXIS_DESCR COM_AXIS W_DKKD _CNV_R_R_Umr_10_zu__9_CM_S2 13 0 120 AXIS_PTS_REF SSTSKL_HS_ECOWL2 FORMAT "%3.1" /end AXIS_DESCR
/end CHARACTERISTIC
/begin CHARACTERISTIC ECOWL232 "" CURVE 0x277844 _REC_A1CUR_1_u2_u2_S2 15000 _CNV_R_R_Umr_1_zu_1_3_CM_S2 0 15000 FORMAT "%2.0"
 /begin AXIS_DESCR COM_AXIS W_DKKD _CNV_R_R_Umr_10_zu__9_CM_S2 17 0 120 AXIS_PTS_REF SSTSKL_RS_ECOWL2 FORMAT "%3.1" /end AXIS_DESCR
/end CHARACTERISTIC
/begin CHARACTERISTIC ECOWL234 "" CURVE 0x277866 _REC_A1CUR_1_u2_u2_S2 15000 _CNV_R_R_Umr_1_zu_1_3_CM_S2 0 15000 FORMAT "%2.0"
 /begin AXIS_DESCR COM_AXIS W_DKKD _CNV_R_R_Umr_10_zu__9_CM_S2 13 0 120 AXIS_PTS_REF SSTSKL_HS_ECOWL2 FORMAT "%3.1" /end AXIS_DESCR
/end CHARACTERISTIC
/begin CHARACTERISTIC ECOWL243 "" CURVE 0x277880 _REC_A1CUR_1_u2_u2_S2 15000 _CNV_R_R_Umr_1_zu_1_3_CM_S2 0 15000 FORMAT "%2.0"
 /begin AXIS_DESCR COM_AXIS W_DKKD _CNV_R_R_Umr_10_zu__9_CM_S2 17 0 120 AXIS_PTS_REF SSTSKL_RS_ECOWL2 FORMAT "%3.1" /end AXIS_DESCR
/end CHARACTERISTIC
/begin CHARACTERISTIC ECOWL245 "" CURVE 0x2778A2 _REC_A1CUR_1_u2_u2_S2 15000 _CNV_R_R_Umr_1_zu_1_3_CM_S2 0 15000 FORMAT "%2.0"
 /begin AXIS_DESCR COM_AXIS W_DKKD _CNV_R_R_Umr_10_zu__9_CM_S2 13 0 120 AXIS_PTS_REF SSTSKL_HS_ECOWL2 FORMAT "%3.1" /end AXIS_DESCR
/end CHARACTERISTIC
/begin CHARACTERISTIC ECOWL254 "" CURVE 0x2778BC _REC_A1CUR_1_u2_u2_S2 15000 _CNV_R_R_Umr_1_zu_1_3_CM_S2 0 15000 FORMAT "%2.0"
 /begin AXIS_DESCR COM_AXIS W_DKKD _CNV_R_R_Umr_10_zu__9_CM_S2 17 0 120 AXIS_PTS_REF SSTSKL_RS_ECOWL2 FORMAT "%3.1" /end AXIS_DESCR
/end CHARACTERISTIC
/begin CHARACTERISTIC ECOWL256 "" CURVE 0x2778DE _REC_A1CUR_1_u2_u2_S2 15000 _CNV_R_R_Umr_1_zu_1_3_CM_S2 0 15000 FORMAT "%2.0"
 /begin AXIS_DESCR COM_AXIS W_DKKD _CNV_R_R_Umr_10_zu__9_CM_S2 13 0 120 AXIS_PTS_REF SSTSKL_HS_ECOWL2 FORMAT "%3.1" /end AXIS_DESCR
/end CHARACTERISTIC
/begin CHARACTERISTIC ECOWL265 "" CURVE 0x2778F8 _REC_A1CUR_1_u2_u2_S2 15000 _CNV_R_R_Umr_1_zu_1_3_CM_S2 0 15000 FORMAT "%2.0"
 /begin AXIS_DESCR COM_AXIS W_DKKD _CNV_R_R_Umr_10_zu__9_CM_S2 17 0 120 AXIS_PTS_REF SSTSKL_RS_ECOWL2 FORMAT "%3.1" /end AXIS_DESCR
/end CHARACTERISTIC
/begin CHARACTERISTIC ECOWL267 "" CURVE 0x27881A _REC_A1CUR_1_u2_u2_S2 15000 _CNV_R_R_Umr_1_zu_1_3_CM_S2 0 15000 FORMAT "%2.0"
 /begin AXIS_DESCR COM_AXIS W_DKKD _CNV_R_R_Umr_10_zu__9_CM_S2 13 0 120 AXIS_PTS_REF SSTSKL_HS_ECOWL2 FORMAT "%3.1" /end AXIS_DESCR
/end CHARACTERISTIC
/begin CHARACTERISTIC ECOWL276 "" CURVE 0x278834 _REC_A1CUR_1_u2_u2_S2 15000 _CNV_R_R_Umr_1_zu_1_3_CM_S2 0 15000 FORMAT "%2.0"
 /begin AXIS_DESCR COM_AXIS W_DKKD _CNV_R_R_Umr_10_zu__9_CM_S2 17 0 120 AXIS_PTS_REF SSTSKL_RS_ECOWL2 FORMAT "%3.1" /end AXIS_DESCR
/end CHARACTERISTIC
/begin CHARACTERISTIC ECOWL278 "" CURVE 0x278D06 _REC_A1CUR_1_u2_u2_S2 15000 _CNV_R_R_Umr_1_zu_1_3_CM_S2 0 15000 FORMAT "%2.0"
 /begin AXIS_DESCR COM_AXIS W_DKKD _CNV_R_R_Umr_10_zu__9_CM_S2 13 0 120 AXIS_PTS_REF SSTSKL_HS_ECOWL2 FORMAT "%3.1" /end AXIS_DESCR
/end CHARACTERISTIC
/begin CHARACTERISTIC ECOWL287 "" CURVE 0x278D20 _REC_A1CUR_1_u2_u2_S2 15000 _CNV_R_R_Umr_1_zu_1_3_CM_S2 0 15000 FORMAT "%2.0"
 /begin AXIS_DESCR COM_AXIS W_DKKD _CNV_R_R_Umr_10_zu__9_CM_S2 17 0 120 AXIS_PTS_REF SSTSKL_RS_ECOWL2 FORMAT "%3.1" /end AXIS_DESCR
/end CHARACTERISTIC
/begin CHARACTERISTIC S12 "" CURVE 0x27791A _REC_A1CUR_1_u2_u2_S2 15000 _CNV_R_R_Umr_1_zu_1_3_CM_S2 0 15000 FORMAT "%2.0"
 /begin AXIS_DESCR COM_AXIS W_DKKD _CNV_R_R_Umr_10_zu__9_CM_S2 13 0 120 AXIS_PTS_REF SSTSKL_HS_S FORMAT "%3.1" /end AXIS_DESCR
/end CHARACTERISTIC
/begin CHARACTERISTIC S21 "" CURVE 0x277934 _REC_A1CUR_1_u2_u2_S2 15000 _CNV_R_R_Umr_1_zu_1_3_CM_S2 0 15000 FORMAT "%2.0"
 /begin AXIS_DESCR COM_AXIS W_DKKD _CNV_R_R_Umr_10_zu__9_CM_S2 17 0 120 AXIS_PTS_REF SSTSKL_RS_S FORMAT "%3.1" /end AXIS_DESCR
/end CHARACTERISTIC
/begin CHARACTERISTIC S23 "" CURVE 0x277956 _REC_A1CUR_1_u2_u2_S2 15000 _CNV_R_R_Umr_1_zu_1_3_CM_S2 0 15000 FORMAT "%2.0"
 /begin AXIS_DESCR COM_AXIS W_DKKD _CNV_R_R_Umr_10_zu__9_CM_S2 13 0 120 AXIS_PTS_REF SSTSKL_HS_S FORMAT "%3.1" /end AXIS_DESCR
/end CHARACTERISTIC
/begin CHARACTERISTIC S32 "" CURVE 0x277970 _REC_A1CUR_1_u2_u2_S2 15000 _CNV_R_R_Umr_1_zu_1_3_CM_S2 0 15000 FORMAT "%2.0"
 /begin AXIS_DESCR COM_AXIS W_DKKD _CNV_R_R_Umr_10_zu__9_CM_S2 17 0 120 AXIS_PTS_REF SSTSKL_RS_S FORMAT "%3.1" /end AXIS_DESCR
/end CHARACTERISTIC
/begin CHARACTERISTIC S34 "" CURVE 0x277992 _REC_A1CUR_1_u2_u2_S2 15000 _CNV_R_R_Umr_1_zu_1_3_CM_S2 0 15000 FORMAT "%2.0"
 /begin AXIS_DESCR COM_AXIS W_DKKD _CNV_R_R_Umr_10_zu__9_CM_S2 13 0 120 AXIS_PTS_REF SSTSKL_HS_S FORMAT "%3.1" /end AXIS_DESCR
/end CHARACTERISTIC
/begin CHARACTERISTIC S43 "" CURVE 0x2779AC _REC_A1CUR_1_u2_u2_S2 15000 _CNV_R_R_Umr_1_zu_1_3_CM_S2 0 15000 FORMAT "%2.0"
 /begin AXIS_DESCR COM_AXIS W_DKKD _CNV_R_R_Umr_10_zu__9_CM_S2 17 0 120 AXIS_PTS_REF SSTSKL_RS_S FORMAT "%3.1" /end AXIS_DESCR
/end CHARACTERISTIC
/begin CHARACTERISTIC S45 "" CURVE 0x2779CE _REC_A1CUR_1_u2_u2_S2 15000 _CNV_R_R_Umr_1_zu_1_3_CM_S2 0 15000 FORMAT "%2.0"
 /begin AXIS_DESCR COM_AXIS W_DKKD _CNV_R_R_Umr_10_zu__9_CM_S2 13 0 120 AXIS_PTS_REF SSTSKL_HS_S FORMAT "%3.1" /end AXIS_DESCR
/end CHARACTERISTIC
/begin CHARACTERISTIC S54 "" CURVE 0x2779E8 _REC_A1CUR_1_u2_u2_S2 15000 _CNV_R_R_Umr_1_zu_1_3_CM_S2 0 15000 FORMAT "%2.0"
 /begin AXIS_DESCR COM_AXIS W_DKKD _CNV_R_R_Umr_10_zu__9_CM_S2 17 0 120 AXIS_PTS_REF SSTSKL_RS_S FORMAT "%3.1" /end AXIS_DESCR
/end CHARACTERISTIC
/begin CHARACTERISTIC S56 "" CURVE 0x277A0A _REC_A1CUR_1_u2_u2_S2 15000 _CNV_R_R_Umr_1_zu_1_3_CM_S2 0 15000 FORMAT "%2.0"
 /begin AXIS_DESCR COM_AXIS W_DKKD _CNV_R_R_Umr_10_zu__9_CM_S2 13 0 120 AXIS_PTS_REF SSTSKL_HS_S FORMAT "%3.1" /end AXIS_DESCR
/end CHARACTERISTIC
/begin CHARACTERISTIC S65 "" CURVE 0x277A24 _REC_A1CUR_1_u2_u2_S2 15000 _CNV_R_R_Umr_1_zu_1_3_CM_S2 0 15000 FORMAT "%2.0"
 /begin AXIS_DESCR COM_AXIS W_DKKD _CNV_R_R_Umr_10_zu__9_CM_S2 17 0 120 AXIS_PTS_REF SSTSKL_RS_S FORMAT "%3.1" /end AXIS_DESCR
/end CHARACTERISTIC
/begin CHARACTERISTIC S67 "" CURVE 0x278856 _REC_A1CUR_1_u2_u2_S2 15000 _CNV_R_R_Umr_1_zu_1_3_CM_S2 0 15000 FORMAT "%2.0"
 /begin AXIS_DESCR COM_AXIS W_DKKD _CNV_R_R_Umr_10_zu__9_CM_S2 13 0 120 AXIS_PTS_REF SSTSKL_HS_S FORMAT "%3.1" /end AXIS_DESCR
/end CHARACTERISTIC
/begin CHARACTERISTIC S76 "" CURVE 0x278870 _REC_A1CUR_1_u2_u2_S2 15000 _CNV_R_R_Umr_1_zu_1_3_CM_S2 0 15000 FORMAT "%2.0"
 /begin AXIS_DESCR COM_AXIS W_DKKD _CNV_R_R_Umr_10_zu__9_CM_S2 17 0 120 AXIS_PTS_REF SSTSKL_RS_S FORMAT "%3.1" /end AXIS_DESCR
/end CHARACTERISTIC
/begin CHARACTERISTIC S78 "" CURVE 0x278D42 _REC_A1CUR_1_u2_u2_S2 15000 _CNV_R_R_Umr_1_zu_1_3_CM_S2 0 15000 FORMAT "%2.0"
 /begin AXIS_DESCR COM_AXIS W_DKKD _CNV_R_R_Umr_10_zu__9_CM_S2 13 0 120 AXIS_PTS_REF SSTSKL_HS_S FORMAT "%3.1" /end AXIS_DESCR
/end CHARACTERISTIC
/begin CHARACTERISTIC S87 "" CURVE 0x278D5C _REC_A1CUR_1_u2_u2_S2 15000 _CNV_R_R_Umr_1_zu_1_3_CM_S2 0 15000 FORMAT "%2.0"
 /begin AXIS_DESCR COM_AXIS W_DKKD _CNV_R_R_Umr_10_zu__9_CM_S2 17 0 120 AXIS_PTS_REF SSTSKL_RS_S FORMAT "%3.1" /end AXIS_DESCR
/end CHARACTERISTIC
/begin CHARACTERISTIC SA112 "" CURVE 0x277A46 _REC_A1CUR_1_u2_u2_S2 15000 _CNV_R_R_Umr_1_zu_1_3_CM_S2 0 15000 FORMAT "%2.0"
 /begin AXIS_DESCR COM_AXIS W_DKKD _CNV_R_R_Umr_10_zu__9_CM_S2 13 0 120 AXIS_PTS_REF SSTSKL_HS_SA1 FORMAT "%3.1" /end AXIS_DESCR
/end CHARACTERISTIC
/begin CHARACTERISTIC SA121 "" CURVE 0x277A60 _REC_A1CUR_1_u2_u2_S2 15000 _CNV_R_R_Umr_1_zu_1_3_CM_S2 0 15000 FORMAT "%2.0"
 /begin AXIS_DESCR COM_AXIS W_DKKD _CNV_R_R_Umr_10_zu__9_CM_S2 17 0 120 AXIS_PTS_REF SSTSKL_RS_SA1 FORMAT "%3.1" /end AXIS_DESCR
/end CHARACTERISTIC
/begin CHARACTERISTIC SA123 "" CURVE 0x277A82 _REC_A1CUR_1_u2_u2_S2 15000 _CNV_R_R_Umr_1_zu_1_3_CM_S2 0 15000 FORMAT "%2.0"
 /begin AXIS_DESCR COM_AXIS W_DKKD _CNV_R_R_Umr_10_zu__9_CM_S2 13 0 120 AXIS_PTS_REF SSTSKL_HS_SA1 FORMAT "%3.1" /end AXIS_DESCR
/end CHARACTERISTIC
/begin CHARACTERISTIC SA132 "" CURVE 0x277A9C _REC_A1CUR_1_u2_u2_S2 15000 _CNV_R_R_Umr_1_zu_1_3_CM_S2 0 15000 FORMAT "%2.0"
 /begin AXIS_DESCR COM_AXIS W_DKKD _CNV_R_R_Umr_10_zu__9_CM_S2 17 0 120 AXIS_PTS_REF SSTSKL_RS_SA1 FORMAT "%3.1" /end AXIS_DESCR
/end CHARACTERISTIC
/begin CHARACTERISTIC SA134 "" CURVE 0x277ABE _REC_A1CUR_1_u2_u2_S2 15000 _CNV_R_R_Umr_1_zu_1_3_CM_S2 0 15000 FORMAT "%2.0"
 /begin AXIS_DESCR COM_AXIS W_DKKD _CNV_R_R_Umr_10_zu__9_CM_S2 13 0 120 AXIS_PTS_REF SSTSKL_HS_SA1 FORMAT "%3.1" /end AXIS_DESCR
/end CHARACTERISTIC
/begin CHARACTERISTIC SA143 "" CURVE 0x277AD8 _REC_A1CUR_1_u2_u2_S2 15000 _CNV_R_R_Umr_1_zu_1_3_CM_S2 0 15000 FORMAT "%2.0"
 /begin AXIS_DESCR COM_AXIS W_DKKD _CNV_R_R_Umr_10_zu__9_CM_S2 17 0 120 AXIS_PTS_REF SSTSKL_RS_SA1 FORMAT "%3.1" /end AXIS_DESCR
/end CHARACTERISTIC
/begin CHARACTERISTIC SA145 "" CURVE 0x277AFA _REC_A1CUR_1_u2_u2_S2 15000 _CNV_R_R_Umr_1_zu_1_3_CM_S2 0 15000 FORMAT "%2.0"
 /begin AXIS_DESCR COM_AXIS W_DKKD _CNV_R_R_Umr_10_zu__9_CM_S2 13 0 120 AXIS_PTS_REF SSTSKL_HS_SA1 FORMAT "%3.1" /end AXIS_DESCR
/end CHARACTERISTIC
/begin CHARACTERISTIC SA154 "" CURVE 0x277B14 _REC_A1CUR_1_u2_u2_S2 15000 _CNV_R_R_Umr_1_zu_1_3_CM_S2 0 15000 FORMAT "%2.0"
 /begin AXIS_DESCR COM_AXIS W_DKKD _CNV_R_R_Umr_10_zu__9_CM_S2 17 0 120 AXIS_PTS_REF SSTSKL_RS_SA1 FORMAT "%3.1" /end AXIS_DESCR
/end CHARACTERISTIC
/begin CHARACTERISTIC SA156 "" CURVE 0x277B36 _REC_A1CUR_1_u2_u2_S2 15000 _CNV_R_R_Umr_1_zu_1_3_CM_S2 0 15000 FORMAT "%2.0"
 /begin AXIS_DESCR COM_AXIS W_DKKD _CNV_R_R_Umr_10_zu__9_CM_S2 13 0 120 AXIS_PTS_REF SSTSKL_HS_SA1 FORMAT "%3.1" /end AXIS_DESCR
/end CHARACTERISTIC
/begin CHARACTERISTIC SA165 "" CURVE 0x277B50 _REC_A1CUR_1_u2_u2_S2 15000 _CNV_R_R_Umr_1_zu_1_3_CM_S2 0 15000 FORMAT "%2.0"
 /begin AXIS_DESCR COM_AXIS W_DKKD _CNV_R_R_Umr_10_zu__9_CM_S2 17 0 120 AXIS_PTS_REF SSTSKL_RS_SA1 FORMAT "%3.1" /end AXIS_DESCR
/end CHARACTERISTIC
/begin CHARACTERISTIC SA167 "" CURVE 0x278892 _REC_A1CUR_1_u2_u2_S2 15000 _CNV_R_R_Umr_1_zu_1_3_CM_S2 0 15000 FORMAT "%2.0"
 /begin AXIS_DESCR COM_AXIS W_DKKD _CNV_R_R_Umr_10_zu__9_CM_S2 13 0 120 AXIS_PTS_REF SSTSKL_HS_SA1 FORMAT "%3.1" /end AXIS_DESCR
/end CHARACTERISTIC
/begin CHARACTERISTIC SA176 "" CURVE 0x2788AC _REC_A1CUR_1_u2_u2_S2 15000 _CNV_R_R_Umr_1_zu_1_3_CM_S2 0 15000 FORMAT "%2.0"
 /begin AXIS_DESCR COM_AXIS W_DKKD _CNV_R_R_Umr_10_zu__9_CM_S2 17 0 120 AXIS_PTS_REF SSTSKL_RS_SA1 FORMAT "%3.1" /end AXIS_DESCR
/end CHARACTERISTIC
/begin CHARACTERISTIC SA178 "" CURVE 0x278D7E _REC_A1CUR_1_u2_u2_S2 15000 _CNV_R_R_Umr_1_zu_1_3_CM_S2 0 15000 FORMAT "%2.0"
 /begin AXIS_DESCR COM_AXIS W_DKKD _CNV_R_R_Umr_10_zu__9_CM_S2 13 0 120 AXIS_PTS_REF SSTSKL_HS_SA1 FORMAT "%3.1" /end AXIS_DESCR
/end CHARACTERISTIC
/begin CHARACTERISTIC SA187 "" CURVE 0x278D98 _REC_A1CUR_1_u2_u2_S2 15000 _CNV_R_R_Umr_1_zu_1_3_CM_S2 0 15000 FORMAT "%2.0"
 /begin AXIS_DESCR COM_AXIS W_DKKD _CNV_R_R_Umr_10_zu__9_CM_S2 17 0 120 AXIS_PTS_REF SSTSKL_RS_SA1 FORMAT "%3.1" /end AXIS_DESCR
/end CHARACTERISTIC
/begin CHARACTERISTIC SA212 "" CURVE 0x277B72 _REC_A1CUR_1_u2_u2_S2 15000 _CNV_R_R_Umr_1_zu_1_3_CM_S2 0 15000 FORMAT "%2.0"
 /begin AXIS_DESCR COM_AXIS W_DKKD _CNV_R_R_Umr_10_zu__9_CM_S2 13 0 120 AXIS_PTS_REF SSTSKL_HS_SA2 FORMAT "%3.1" /end AXIS_DESCR
/end CHARACTERISTIC
/begin CHARACTERISTIC SA221 "" CURVE 0x277B8C _REC_A1CUR_1_u2_u2_S2 15000 _CNV_R_R_Umr_1_zu_1_3_CM_S2 0 15000 FORMAT "%2.0"
 /begin AXIS_DESCR COM_AXIS W_DKKD _CNV_R_R_Umr_10_zu__9_CM_S2 17 0 120 AXIS_PTS_REF SSTSKL_RS_SA2 FORMAT "%3.1" /end AXIS_DESCR
/end CHARACTERISTIC
/begin CHARACTERISTIC SA223 "" CURVE 0x277BAE _REC_A1CUR_1_u2_u2_S2 15000 _CNV_R_R_Umr_1_zu_1_3_CM_S2 0 15000 FORMAT "%2.0"
 /begin AXIS_DESCR COM_AXIS W_DKKD _CNV_R_R_Umr_10_zu__9_CM_S2 13 0 120 AXIS_PTS_REF SSTSKL_HS_SA2 FORMAT "%3.1" /end AXIS_DESCR
/end CHARACTERISTIC
/begin CHARACTERISTIC SA232 "" CURVE 0x277BC8 _REC_A1CUR_1_u2_u2_S2 15000 _CNV_R_R_Umr_1_zu_1_3_CM_S2 0 15000 FORMAT "%2.0"
 /begin AXIS_DESCR COM_AXIS W_DKKD _CNV_R_R_Umr_10_zu__9_CM_S2 17 0 120 AXIS_PTS_REF SSTSKL_RS_SA2 FORMAT "%3.1" /end AXIS_DESCR
/end CHARACTERISTIC
/begin CHARACTERISTIC SA234 "" CURVE 0x277BEA _REC_A1CUR_1_u2_u2_S2 15000 _CNV_R_R_Umr_1_zu_1_3_CM_S2 0 15000 FORMAT "%2.0"
 /begin AXIS_DESCR COM_AXIS W_DKKD _CNV_R_R_Umr_10_zu__9_CM_S2 13 0 120 AXIS_PTS_REF SSTSKL_HS_SA2 FORMAT "%3.1" /end AXIS_DESCR
/end CHARACTERISTIC
/begin CHARACTERISTIC SA243 "" CURVE 0x277C04 _REC_A1CUR_1_u2_u2_S2 15000 _CNV_R_R_Umr_1_zu_1_3_CM_S2 0 15000 FORMAT "%2.0"
 /begin AXIS_DESCR COM_AXIS W_DKKD _CNV_R_R_Umr_10_zu__9_CM_S2 17 0 120 AXIS_PTS_REF SSTSKL_RS_SA2 FORMAT "%3.1" /end AXIS_DESCR
/end CHARACTERISTIC
/begin CHARACTERISTIC SA245 "" CURVE 0x277C26 _REC_A1CUR_1_u2_u2_S2 15000 _CNV_R_R_Umr_1_zu_1_3_CM_S2 0 15000 FORMAT "%2.0"
 /begin AXIS_DESCR COM_AXIS W_DKKD _CNV_R_R_Umr_10_zu__9_CM_S2 13 0 120 AXIS_PTS_REF SSTSKL_HS_SA2 FORMAT "%3.1" /end AXIS_DESCR
/end CHARACTERISTIC
/begin CHARACTERISTIC SA254 "" CURVE 0x277C40 _REC_A1CUR_1_u2_u2_S2 15000 _CNV_R_R_Umr_1_zu_1_3_CM_S2 0 15000 FORMAT "%2.0"
 /begin AXIS_DESCR COM_AXIS W_DKKD _CNV_R_R_Umr_10_zu__9_CM_S2 17 0 120 AXIS_PTS_REF SSTSKL_RS_SA2 FORMAT "%3.1" /end AXIS_DESCR
/end CHARACTERISTIC
/begin CHARACTERISTIC SA256 "" CURVE 0x277C62 _REC_A1CUR_1_u2_u2_S2 15000 _CNV_R_R_Umr_1_zu_1_3_CM_S2 0 15000 FORMAT "%2.0"
 /begin AXIS_DESCR COM_AXIS W_DKKD _CNV_R_R_Umr_10_zu__9_CM_S2 13 0 120 AXIS_PTS_REF SSTSKL_HS_SA2 FORMAT "%3.1" /end AXIS_DESCR
/end CHARACTERISTIC
/begin CHARACTERISTIC SA265 "" CURVE 0x277C7C _REC_A1CUR_1_u2_u2_S2 15000 _CNV_R_R_Umr_1_zu_1_3_CM_S2 0 15000 FORMAT "%2.0"
 /begin AXIS_DESCR COM_AXIS W_DKKD _CNV_R_R_Umr_10_zu__9_CM_S2 17 0 120 AXIS_PTS_REF SSTSKL_RS_SA2 FORMAT "%3.1" /end AXIS_DESCR
/end CHARACTERISTIC
/begin CHARACTERISTIC SA267 "" CURVE 0x2788CE _REC_A1CUR_1_u2_u2_S2 15000 _CNV_R_R_Umr_1_zu_1_3_CM_S2 0 15000 FORMAT "%2.0"
 /begin AXIS_DESCR COM_AXIS W_DKKD _CNV_R_R_Umr_10_zu__9_CM_S2 13 0 120 AXIS_PTS_REF SSTSKL_HS_SA2 FORMAT "%3.1" /end AXIS_DESCR
/end CHARACTERISTIC
/begin CHARACTERISTIC SA276 "" CURVE 0x2788E8 _REC_A1CUR_1_u2_u2_S2 15000 _CNV_R_R_Umr_1_zu_1_3_CM_S2 0 15000 FORMAT "%2.0"
 /begin AXIS_DESCR COM_AXIS W_DKKD _CNV_R_R_Umr_10_zu__9_CM_S2 17 0 120 AXIS_PTS_REF SSTSKL_RS_SA2 FORMAT "%3.1" /end AXIS_DESCR
/end CHARACTERISTIC
/begin CHARACTERISTIC SA278 "" CURVE 0x278DBA _REC_A1CUR_1_u2_u2_S2 15000 _CNV_R_R_Umr_1_zu_1_3_CM_S2 0 15000 FORMAT "%2.0"
 /begin AXIS_DESCR COM_AXIS W_DKKD _CNV_R_R_Umr_10_zu__9_CM_S2 13 0 120 AXIS_PTS_REF SSTSKL_HS_SA2 FORMAT "%3.1" /end AXIS_DESCR
/end CHARACTERISTIC
/begin CHARACTERISTIC SA287 "" CURVE 0x278DD4 _REC_A1CUR_1_u2_u2_S2 15000 _CNV_R_R_Umr_1_zu_1_3_CM_S2 0 15000 FORMAT "%2.0"
 /begin AXIS_DESCR COM_AXIS W_DKKD _CNV_R_R_Umr_10_zu__9_CM_S2 17 0 120 AXIS_PTS_REF SSTSKL_RS_SA2 FORMAT "%3.1" /end AXIS_DESCR
/end CHARACTERISTIC
/begin CHARACTERISTIC SA312 "" CURVE 0x277C9E _REC_A1CUR_1_u2_u2_S2 15000 _CNV_R_R_Umr_1_zu_1_3_CM_S2 0 15000 FORMAT "%2.0"
 /begin AXIS_DESCR COM_AXIS W_DKKD _CNV_R_R_Umr_10_zu__9_CM_S2 13 0 120 AXIS_PTS_REF SSTSKL_HS_SA3 FORMAT "%3.1" /end AXIS_DESCR
/end CHARACTERISTIC
/begin CHARACTERISTIC SA321 "" CURVE 0x277CB8 _REC_A1CUR_1_u2_u2_S2 15000 _CNV_R_R_Umr_1_zu_1_3_CM_S2 0 15000 FORMAT "%2.0"
 /begin AXIS_DESCR COM_AXIS W_DKKD _CNV_R_R_Umr_10_zu__9_CM_S2 17 0 120 AXIS_PTS_REF SSTSKL_RS_SA3 FORMAT "%3.1" /end AXIS_DESCR
/end CHARACTERISTIC
/begin CHARACTERISTIC SA323 "" CURVE 0x277CDA _REC_A1CUR_1_u2_u2_S2 15000 _CNV_R_R_Umr_1_zu_1_3_CM_S2 0 15000 FORMAT "%2.0"
 /begin AXIS_DESCR COM_AXIS W_DKKD _CNV_R_R_Umr_10_zu__9_CM_S2 13 0 120 AXIS_PTS_REF SSTSKL_HS_SA3 FORMAT "%3.1" /end AXIS_DESCR
/end CHARACTERISTIC
/begin CHARACTERISTIC SA332 "" CURVE 0x277CF4 _REC_A1CUR_1_u2_u2_S2 15000 _CNV_R_R_Umr_1_zu_1_3_CM_S2 0 15000 FORMAT "%2.0"
 /begin AXIS_DESCR COM_AXIS W_DKKD _CNV_R_R_Umr_10_zu__9_CM_S2 17 0 120 AXIS_PTS_REF SSTSKL_RS_SA3 FORMAT "%3.1" /end AXIS_DESCR
/end CHARACTERISTIC
/begin CHARACTERISTIC SA334 "" CURVE 0x277D16 _REC_A1CUR_1_u2_u2_S2 15000 _CNV_R_R_Umr_1_zu_1_3_CM_S2 0 15000 FORMAT "%2.0"
 /begin AXIS_DESCR COM_AXIS W_DKKD _CNV_R_R_Umr_10_zu__9_CM_S2 13 0 120 AXIS_PTS_REF SSTSKL_HS_SA3 FORMAT "%3.1" /end AXIS_DESCR
/end CHARACTERISTIC
/begin CHARACTERISTIC SA343 "" CURVE 0x277D30 _REC_A1CUR_1_u2_u2_S2 15000 _CNV_R_R_Umr_1_zu_1_3_CM_S2 0 15000 FORMAT "%2.0"
 /begin AXIS_DESCR COM_AXIS W_DKKD _CNV_R_R_Umr_10_zu__9_CM_S2 17 0 120 AXIS_PTS_REF SSTSKL_RS_SA3 FORMAT "%3.1" /end AXIS_DESCR
/end CHARACTERISTIC
/begin CHARACTERISTIC SA345 "" CURVE 0x277D52 _REC_A1CUR_1_u2_u2_S2 15000 _CNV_R_R_Umr_1_zu_1_3_CM_S2 0 15000 FORMAT "%2.0"
 /begin AXIS_DESCR COM_AXIS W_DKKD _CNV_R_R_Umr_10_zu__9_CM_S2 13 0 120 AXIS_PTS_REF SSTSKL_HS_SA3 FORMAT "%3.1" /end AXIS_DESCR
/end CHARACTERISTIC
/begin CHARACTERISTIC SA354 "" CURVE 0x277D6C _REC_A1CUR_1_u2_u2_S2 15000 _CNV_R_R_Umr_1_zu_1_3_CM_S2 0 15000 FORMAT "%2.0"
 /begin AXIS_DESCR COM_AXIS W_DKKD _CNV_R_R_Umr_10_zu__9_CM_S2 17 0 120 AXIS_PTS_REF SSTSKL_RS_SA3 FORMAT "%3.1" /end AXIS_DESCR
/end CHARACTERISTIC
/begin CHARACTERISTIC SA356 "" CURVE 0x277D8E _REC_A1CUR_1_u2_u2_S2 15000 _CNV_R_R_Umr_1_zu_1_3_CM_S2 0 15000 FORMAT "%2.0"
 /begin AXIS_DESCR COM_AXIS W_DKKD _CNV_R_R_Umr_10_zu__9_CM_S2 13 0 120 AXIS_PTS_REF SSTSKL_HS_SA3 FORMAT "%3.1" /end AXIS_DESCR
/end CHARACTERISTIC
/begin CHARACTERISTIC SA365 "" CURVE 0x277DA8 _REC_A1CUR_1_u2_u2_S2 15000 _CNV_R_R_Umr_1_zu_1_3_CM_S2 0 15000 FORMAT "%2.0"
 /begin AXIS_DESCR COM_AXIS W_DKKD _CNV_R_R_Umr_10_zu__9_CM_S2 17 0 120 AXIS_PTS_REF SSTSKL_RS_SA3 FORMAT "%3.1" /end AXIS_DESCR
/end CHARACTERISTIC
/begin CHARACTERISTIC SA367 "" CURVE 0x27890A _REC_A1CUR_1_u2_u2_S2 15000 _CNV_R_R_Umr_1_zu_1_3_CM_S2 0 15000 FORMAT "%2.0"
 /begin AXIS_DESCR COM_AXIS W_DKKD _CNV_R_R_Umr_10_zu__9_CM_S2 13 0 120 AXIS_PTS_REF SSTSKL_HS_SA3 FORMAT "%3.1" /end AXIS_DESCR
/end CHARACTERISTIC
/begin CHARACTERISTIC SA376 "" CURVE 0x278924 _REC_A1CUR_1_u2_u2_S2 15000 _CNV_R_R_Umr_1_zu_1_3_CM_S2 0 15000 FORMAT "%2.0"
 /begin AXIS_DESCR COM_AXIS W_DKKD _CNV_R_R_Umr_10_zu__9_CM_S2 17 0 120 AXIS_PTS_REF SSTSKL_RS_SA3 FORMAT "%3.1" /end AXIS_DESCR
/end CHARACTERISTIC
/begin CHARACTERISTIC SA378 "" CURVE 0x278DF6 _REC_A1CUR_1_u2_u2_S2 15000 _CNV_R_R_Umr_1_zu_1_3_CM_S2 0 15000 FORMAT "%2.0"
 /begin AXIS_DESCR COM_AXIS W_DKKD _CNV_R_R_Umr_10_zu__9_CM_S2 13 0 120 AXIS_PTS_REF SSTSKL_HS_SA3 FORMAT "%3.1" /end AXIS_DESCR
/end CHARACTERISTIC
/begin CHARACTERISTIC SA387 "" CURVE 0x278E10 _REC_A1CUR_1_u2_u2_S2 15000 _CNV_R_R_Umr_1_zu_1_3_CM_S2 0 15000 FORMAT "%2.0"
 /begin AXIS_DESCR COM_AXIS W_DKKD _CNV_R_R_Umr_10_zu__9_CM_S2 17 0 120 AXIS_PTS_REF SSTSKL_RS_SA3 FORMAT "%3.1" /end AXIS_DESCR
/end CHARACTERISTIC
/begin CHARACTERISTIC SA412 "" CURVE 0x277DCA _REC_A1CUR_1_u2_u2_S2 15000 _CNV_R_R_Umr_1_zu_1_3_CM_S2 0 15000 FORMAT "%2.0"
 /begin AXIS_DESCR COM_AXIS W_DKKD _CNV_R_R_Umr_10_zu__9_CM_S2 13 0 120 AXIS_PTS_REF SSTSKL_HS_SA4 FORMAT "%3.1" /end AXIS_DESCR
/end CHARACTERISTIC
/begin CHARACTERISTIC I_FIX_ERSATZ_NVMSOLL_HAS_L2 "Uebersetzungsverhaeltnis zur Verwendung als Ersatzwert bei Ungueltigkeit des Turbinen- oder Abtriebsdrehzahlsignals" VALUE 0x26E39A UWORD_COL_DIRECT_S1_S7_S3 0 ratio_int_S1_S7_S3 0 5 /end CHARACTERISTIC
/begin CHARACTERISTIC KL_MS_NVMSOLL_HAS_L2_Y "Y: Toleranzmomentenschwelle" CURVE 0x26D27C UWORD_COL_DIRECT_S1_S7_S3 0 trq_int_S1_S7_S3 0 500
 /begin AXIS_DESCR COM_AXIS NO_INPUT_QUANTITY ratio_int_S1_S7_S3 10 0 5 AXIS_PTS_REF KL_MS_NVMSOLL_HAS_L2_X /end AXIS_DESCR
/end CHARACTERISTIC
/begin CHARACTERISTIC KL_MS_NVMSOLLLOWRANGE_HAS_L2_Y "Y: Toleranzmomentenschwelle fuer das VM Istmoment" CURVE 0x26D254 UWORD_COL_DIRECT_S1_S7_S3 0 trq_int_S1_S7_S3 0 500
 /begin AXIS_DESCR COM_AXIS NO_INPUT_QUANTITY ratio_int_S1_S7_S3 10 0 5 AXIS_PTS_REF KL_MS_NVMSOLLLOWRANGE_HAS_L2_X /end AXIS_DESCR
/end CHARACTERISTIC
/begin CHARACTERISTIC KL_MS_VM_NVMSOLL_HAS_L2_Y "Y: Toleranzmomentenschwelle fuer das VM Istmoment" CURVE 0x26D2CC UWORD_COL_DIRECT_S1_S7_S3 0 trq_int_S1_S7_S3 0 1000
 /begin AXIS_DESCR COM_AXIS NO_INPUT_QUANTITY ratio_int_S1_S7_S3 10 0 5 AXIS_PTS_REF KL_MS_VM_NVMSOLL_HAS_L2_X /end AXIS_DESCR
/end CHARACTERISTIC
/begin CHARACTERISTIC KL_MS_VM_NVMSOLLLOWRANGE_HAS_L2_Y "Y: Toleranzmomentenschwelle fuer das VM Istmoment" CURVE 0x26D2A4 UWORD_COL_DIRECT_S1_S7_S3 0 trq_int_S1_S7_S3 0 1000
 /begin AXIS_DESCR COM_AXIS NO_INPUT_QUANTITY ratio_int_S1_S7_S3 10 0 5 AXIS_PTS_REF KL_MS_VM_NVMSOLLLOWRANGE_HAS_L2_X /end AXIS_DESCR
/end CHARACTERISTIC
/begin CHARACTERISTIC MG_MMOTSOLLNEG_NVMSOLL_HAS_L2 "Negativer Momentengradient fuer die Filterung des Fahrerwunschmoments" VALUE 0x26E39C SWORD_COL_DIRECT_S1_S7_S3 0 trqg_int_S1_S7_S3 -10000 0 /end CHARACTERISTIC
/begin CHARACTERISTIC MS_MOTSOLL_NVMSOLL_HAS_L2 "Momentenschwelle, die vom Fahrerwunschmoment ueberschritten sein muss, um die Momentenbilanzierung zu modifizieren" VALUE 0x26E39E SWORD_COL_DIRECT_S1_S7_S3 0 trq_int_S1_S7_S3 -200 500 /end CHARACTERISTIC
/begin CHARACTERISTIC NS_EM_ERSATZ_NVMSOLL_HAS_L2 "Toleranzdrehzahlschwelle ueber berechneten EM-Ersatzwert" VALUE 0x26E3A0 UWORD_COL_DIRECT_S1_S7_S3 0 n_int_S1_S7_S3 0 1000 /end CHARACTERISTIC
/begin CHARACTERISTIC NS_EM_NVMSOLL_HAS_L2 "Toleranzdrehzahlschwelle ueber EM-Istdrehzahl bei Signalstoerung" VALUE 0x26E3A2 UWORD_COL_DIRECT_S1_S7_S3 0 n_int_S1_S7_S3 0 1000 /end CHARACTERISTIC
/begin CHARACTERISTIC NS_NVMSOLL_HAS_L2 "Toleranzdrehzahlschwelle" VALUE 0x26E3A4 UWORD_COL_DIRECT_S1_S7_S3 0 n_int_S1_S7_S3 0 1000 /end CHARACTERISTIC
/begin CHARACTERISTIC NS_VMMIN_NVMSOLL_HAS_L2 "Mindest VM-Drehzahlschwelle, ab der eine Momentenbilanzierung durchgefuehrt wird." VALUE 0x26E3A6 UWORD_COL_DIRECT_S1_S7_S3 0 n_int_S1_S7_S3 0 1000 /end CHARACTERISTIC
/begin CHARACTERISTIC SWI_EXTDEAK_NVMSOLL_HAS_L2 "Schalter, ob eine externe (OEM) Deaktivierung der Momentenplausibilisierung erlaubt ist" VALUE 0x26F1EE UBYTE_COL_DIRECT_S1_S7_S3 0 swi_int_b_S1_S7_S3 0 1 /end CHARACTERISTIC
/begin CHARACTERISTIC SWI_KOMP_FEHLER_1_HAS_L2 "Schalter zum provozieren eines Komplementefehlers" VALUE 0x26E3AA UWORD_COL_DIRECT_S1_S7_S3 0 swi_int_S1_S7_S3 0 65535 /end CHARACTERISTIC
/begin CHARACTERISTIC SWI_KOMP_FEHLER_2_HAS_L2 "Schalter zum provozieren eines Komplementfehlers" VALUE 0x26E3AC UWORD_COL_DIRECT_S1_S7_S3 0 swi_int_S1_S7_S3 0 65535 /end CHARACTERISTIC
/begin CHARACTERISTIC SWI_MOD_NVMSOLL_HAS_L2 "Schalter zur De-/Aktivierung der Modifizierung der Momentenbilanzierung" VALUE 0x26F1EF UBYTE_COL_DIRECT_S1_S7_S3 0 swi_int_b_S1_S7_S3 0 1 /end CHARACTERISTIC
/begin CHARACTERISTIC SWI_MOTVERLUST_NVMSOLL_HAS_L2 "Schalter zur Beruecksichtigung des Motorverlustmoments" VALUE 0x26F1F0 UBYTE_COL_DIRECT_S1_S7_S3 0 swi_int_b_S1_S7_S3 0 1 /end CHARACTERISTIC
/begin CHARACTERISTIC SWI_NVMSOLL_HAS_L2 "Schalter zur De-/Aktivierung der Funktion" VALUE 0x26F1F1 UBYTE_COL_DIRECT_S1_S7_S3 0 swi_int_b_S1_S7_S3 0 1 /end CHARACTERISTIC
/begin CHARACTERISTIC SWI_PAK_FEHLER_HAS_L2 "PAK-Testschalter" VALUE 0x26E3AE UWORD_COL_DIRECT_S1_S7_S3 0 swi_int_S1_S7_S3 0 65535 /end CHARACTERISTIC
/begin CHARACTERISTIC SWI_SIGSTS_NVMSOLL_HAS_L2 "(Ueberwachung EM-Stoermoment)" VALUE 0x26F1F2 UBYTE_COL_DIRECT_S1_S7_S3 0 swi_int_b_S1_S7_S3 0 1 /end CHARACTERISTIC
/begin CHARACTERISTIC T_NVMSOLL_HAS_L2 "Fehlerfilterungstimer" VALUE 0x26E3A8 UWORD_COL_DIRECT_S1_S7_S3 0 t_int_S1_S7_S3 0 2.5 /end CHARACTERISTIC
/begin AXIS_PTS SSTW_DKKD_BPL5 "" 0x27AC0A N_AB _REC_S2AXS_51_u2_S2 20000 _CNV_R_R_Umr_1_zu_1_3_CM_S2 10 0 20000 FORMAT "%2.0" /end AXIS_PTS
/begin AXIS_PTS SSTW_DKKD_BPLOTHER "" 0x27AC20 N_AB _REC_S2AXS_51_u2_S2 20000 _CNV_R_R_Umr_1_zu_1_3_CM_S2 6 0 20000 FORMAT "%2.0" /end AXIS_PTS
/begin AXIS_PTS SSTSKL_HS_A1 "" 0x272C28 W_DKKD _REC_A2AXS_31_u2_S2 120 _CNV_R_R_Umr_10_zu__9_CM_S2 13 0 120 FORMAT "%3.1" /end AXIS_PTS
/begin AXIS_PTS SSTSKL_HS_A2 "" 0x272C44 W_DKKD _REC_A2AXS_31_u2_S2 120 _CNV_R_R_Umr_10_zu__9_CM_S2 13 0 120 FORMAT "%3.1" /end AXIS_PTS
/begin AXIS_PTS SSTSKL_HS_A3 "" 0x272C60 W_DKKD _REC_A2AXS_31_u2_S2 120 _CNV_R_R_Umr_10_zu__9_CM_S2 13 0 120 FORMAT "%3.1" /end AXIS_PTS
/begin AXIS_PTS SSTSKL_HS_A4 "" 0x272C7C W_DKKD _REC_A2AXS_31_u2_S2 120 _CNV_R_R_Umr_10_zu__9_CM_S2 13 0 120 FORMAT "%3.1" /end AXIS_PTS
/begin AXIS_PTS SSTSKL_HS_A5 "" 0x272C98 W_DKKD _REC_A2AXS_31_u2_S2 120 _CNV_R_R_Umr_10_zu__9_CM_S2 13 0 120 FORMAT "%3.1" /end AXIS_PTS
/begin AXIS_PTS SSTSKL_HS_E "" 0x272CB4 W_DKKD _REC_A2AXS_31_u2_S2 120 _CNV_R_R_Umr_10_zu__9_CM_S2 13 0 120 FORMAT "%3.1" /end AXIS_PTS
/begin AXIS_PTS SSTSKL_HS_ECO "" 0x272CD0 W_DKKD _REC_A2AXS_31_u2_S2 120 _CNV_R_R_Umr_10_zu__9_CM_S2 13 0 120 FORMAT "%3.1" /end AXIS_PTS
/begin AXIS_PTS SSTSKL_HS_ECOA1 "" 0x272CEC W_DKKD _REC_A2AXS_31_u2_S2 120 _CNV_R_R_Umr_10_zu__9_CM_S2 13 0 120 FORMAT "%3.1" /end AXIS_PTS
/begin AXIS_PTS SSTSKL_HS_ECOA2 "" 0x272D08 W_DKKD _REC_A2AXS_31_u2_S2 120 _CNV_R_R_Umr_10_zu__9_CM_S2 13 0 120 FORMAT "%3.1" /end AXIS_PTS
/begin AXIS_PTS SSTSKL_HS_ECOWL2 "" 0x272D24 W_DKKD _REC_A2AXS_31_u2_S2 120 _CNV_R_R_Umr_10_zu__9_CM_S2 13 0 120 FORMAT "%3.1" /end AXIS_PTS
/begin AXIS_PTS SSTSKL_HS_S "" 0x272D40 W_DKKD _REC_A2AXS_31_u2_S2 120 _CNV_R_R_Umr_10_zu__9_CM_S2 13 0 120 FORMAT "%3.1" /end AXIS_PTS
/begin AXIS_PTS SSTSKL_HS_SA1 "" 0x272D5C W_DKKD _REC_A2AXS_31_u2_S2 120 _CNV_R_R_Umr_10_zu__9_CM_S2 13 0 120 FORMAT "%3.1" /end AXIS_PTS
/begin AXIS_PTS SSTSKL_HS_SA2 "" 0x272D78 W_DKKD _REC_A2AXS_31_u2_S2 120 _CNV_R_R_Umr_10_zu__9_CM_S2 13 0 120 FORMAT "%3.1" /end AXIS_PTS
/begin AXIS_PTS SSTSKL_HS_SA3 "" 0x272D94 W_DKKD _REC_A2AXS_31_u2_S2 120 _CNV_R_R_Umr_10_zu__9_CM_S2 13 0 120 FORMAT "%3.1" /end AXIS_PTS
/begin AXIS_PTS SSTSKL_HS_SA4 "" 0x272DB0 W_DKKD _REC_A2AXS_31_u2_S2 120 _CNV_R_R_Umr_10_zu__9_CM_S2 13 0 120 FORMAT "%3.1" /end AXIS_PTS
/begin AXIS_PTS SSTSKL_RS_A1 "" 0x272E74 W_DKKD _REC_A2AXS_31_u2_S2 120 _CNV_R_R_Umr_10_zu__9_CM_S2 17 0 120 FORMAT "%3.1" /end AXIS_PTS
/begin AXIS_PTS SSTSKL_RS_A2 "" 0x272E98 W_DKKD _REC_A2AXS_31_u2_S2 120 _CNV_R_R_Umr_10_zu__9_CM_S2 17 0 120 FORMAT "%3.1" /end AXIS_PTS
/begin AXIS_PTS SSTSKL_RS_A3 "" 0x272EBC W_DKKD _REC_A2AXS_31_u2_S2 120 _CNV_R_R_Umr_10_zu__9_CM_S2 17 0 120 FORMAT "%3.1" /end AXIS_PTS
/begin AXIS_PTS SSTSKL_RS_A4 "" 0x272EE0 W_DKKD _REC_A2AXS_31_u2_S2 120 _CNV_R_R_Umr_10_zu__9_CM_S2 17 0 120 FORMAT "%3.1" /end AXIS_PTS
/begin AXIS_PTS SSTSKL_RS_A5 "" 0x272F04 W_DKKD _REC_A2AXS_31_u2_S2 120 _CNV_R_R_Umr_10_zu__9_CM_S2 17 0 120 FORMAT "%3.1" /end AXIS_PTS
/begin AXIS_PTS SSTSKL_RS_E "" 0x272F28 W_DKKD _REC_A2AXS_31_u2_S2 120 _CNV_R_R_Umr_10_zu__9_CM_S2 17 0 120 FORMAT "%3.1" /end AXIS_PTS
/begin AXIS_PTS SSTSKL_RS_ECO "" 0x272F4C W_DKKD _REC_A2AXS_31_u2_S2 120 _CNV_R_R_Umr_10_zu__9_CM_S2 17 0 120 FORMAT "%3.1" /end AXIS_PTS
/begin AXIS_PTS SSTSKL_RS_ECOA1 "" 0x272F70 W_DKKD _REC_A2AXS_31_u2_S2 120 _CNV_R_R_Umr_10_zu__9_CM_S2 17 0 120 FORMAT "%3.1" /end AXIS_PTS
/begin AXIS_PTS SSTSKL_RS_ECOA2 "" 0x272F94 W_DKKD _REC_A2AXS_31_u2_S2 120 _CNV_R_R_Umr_10_zu__9_CM_S2 17 0 120 FORMAT "%3.1" /end AXIS_PTS
/begin AXIS_PTS SSTSKL_RS_ECOWL2 "" 0x272FB8 W_DKKD _REC_A2AXS_31_u2_S2 120 _CNV_R_R_Umr_10_zu__9_CM_S2 17 0 120 FORMAT "%3.1" /end AXIS_PTS
/begin AXIS_PTS SSTSKL_RS_S "" 0x272FDC W_DKKD _REC_A2AXS_31_u2_S2 120 _CNV_R_R_Umr_10_zu__9_CM_S2 17 0 120 FORMAT "%3.1" /end AXIS_PTS
/begin AXIS_PTS SSTSKL_RS_SA1 "" 0x273000 W_DKKD _REC_A2AXS_31_u2_S2 120 _CNV_R_R_Umr_10_zu__9_CM_S2 17 0 120 FORMAT "%3.1" /end AXIS_PTS
/begin AXIS_PTS SSTSKL_RS_SA2 "" 0x273024 W_DKKD _REC_A2AXS_31_u2_S2 120 _CNV_R_R_Umr_10_zu__9_CM_S2 17 0 120 FORMAT "%3.1" /end AXIS_PTS
/begin AXIS_PTS SSTSKL_RS_SA3 "" 0x273048 W_DKKD _REC_A2AXS_31_u2_S2 120 _CNV_R_R_Umr_10_zu__9_CM_S2 17 0 120 FORMAT "%3.1" /end AXIS_PTS
/begin AXIS_PTS KL_MS_NVMSOLL_HAS_L2_X "X: i_dyn_nvmsoll_has_l2" 0x26D268 NO_INPUT_QUANTITY UWORD_X_INCR_DIRECT_S1_S7_S3 0 ratio_int_S1_S7_S3 10 0 5 /end AXIS_PTS
/begin AXIS_PTS KL_MS_NVMSOLLLOWRANGE_HAS_L2_X "X: i_dyn_nvmsoll_has_l2" 0x26D240 NO_INPUT_QUANTITY UWORD_X_INCR_DIRECT_S1_S7_S3 0 ratio_int_S1_S7_S3 10 0 5 /end AXIS_PTS
/begin AXIS_PTS KL_MS_VM_NVMSOLL_HAS_L2_X "X: i_dyn_nvmsoll_has_l2" 0x26D2B8 NO_INPUT_QUANTITY UWORD_X_INCR_DIRECT_S1_S7_S3 0 ratio_int_S1_S7_S3 10 0 5 /end AXIS_PTS
/begin AXIS_PTS KL_MS_VM_NVMSOLLLOWRANGE_HAS_L2_X "X: i_dyn_nvmsoll_has_l2" 0x26D290 NO_INPUT_QUANTITY UWORD_X_INCR_DIRECT_S1_S7_S3 0 ratio_int_S1_S7_S3 10 0 5 /end AXIS_PTS
/begin MEASUREMENT f_akt_err_nvmsoll_fl_has_l2 "Flag. ob Fehler aktiv ist (FPU-Pfad)" FLOAT32_IEEE sts_fl_S1_S7_S3 1 100 -3.40282E+038 3.40282E+038 ECU_ADDRESS 0xFFF8633C /end MEASUREMENT
/begin MEASUREMENT f_akt_err_nvmsoll_has_l2 "Flag. ob Fehler aktiv ist" UBYTE sts_int_S1_S7_S3 1 100 0 255 ECU_ADDRESS 0xFFF86CE9 /end MEASUREMENT
/begin MEASUREMENT f_extdeak_fl_has_l2 "Flag, ob Momentenplausiblisierung aufgrunde externer (OEM) Anforderung deaktiviert werden soll" FLOAT32_IEEE b_fl_S1_S7_S3 1 100 -3.40282E+038 3.40282E+038 ECU_ADDRESS 0xFFF8638C /end MEASUREMENT
/begin MEASUREMENT f_extdeak_has_l2 "Flag, ob Momentenplausiblisierung aufgrunde externer (OEM) Anforderung deaktiviert werden soll" UBYTE b_int_S1_S7_S3 1 100 0 255 ECU_ADDRESS 0xFFF86CF4 /end MEASUREMENT
/begin MEASUREMENT f_fallback_next_check_allowed_nvmsoll_fl_has_l2 "Flag, ob naechste Stufe der Drehzahlplausi-Routine durchlaufen werden darf. Bei einem Fehlereintritt, wird die Ueberwachung abgebrochen und entsprechend der Fehler angefiltert." FLOAT32_IEEE sts_fl_S1_S7_S3 1 100 0 1 ECU_ADDRESS 0xFFF86340 /end MEASUREMENT
/begin MEASUREMENT f_fallback_next_check_allowed_nvmsoll_has_l2 "Flag, ob naechste Stufe der Drehzahlplausi-Routine durchlaufen werden darf. Bei einem Fehlereintritt, wird die Ueberwachung abgebrochen und entsprechend der Fehler angefiltert." UBYTE sts_int_S1_S7_S3 1 100 0 1 ECU_ADDRESS 0xFFF86CEA /end MEASUREMENT
/begin MEASUREMENT f_m_akt_err_nvmsoll_fl_has_l2 "Flag, ob Momentenfehler aktiv ist (FPU-Pfad)" FLOAT32_IEEE sts_fl_S1_S7_S3 1 100 -3.40282E+038 3.40282E+038 ECU_ADDRESS 0xFFF86344 /end MEASUREMENT
/begin MEASUREMENT f_m_akt_err_nvmsoll_has_l2 "Flag, ob Momentenfehler aktiv ist" UBYTE sts_int_S1_S7_S3 1 100 0 255 ECU_ADDRESS 0xFFF86CEB /end MEASUREMENT
/begin MEASUREMENT f_m_err_nvmsoll_fl_has_l2 "Flag, ob Fehlerereignis aufgrund Momentenueberschreitung vorliegt (FPU-Pfad)" FLOAT32_IEEE sts_fl_S1_S7_S3 1 100 -3.40282E+038 3.40282E+038 ECU_ADDRESS 0xFFF86348 /end MEASUREMENT
/begin MEASUREMENT f_m_err_nvmsoll_has_l2 "Flag, ob Fehlerereignis aufgrund Momentenueberschreitung vorliegt" UBYTE sts_int_S1_S7_S3 1 100 0 255 ECU_ADDRESS 0xFFF86CEC /end MEASUREMENT
/begin MEASUREMENT f_n_akt_err_nvmsoll_fl_has_l2 "Flag, ob Drehzahlplausifehler aktiv ist" FLOAT32_IEEE sts_fl_S1_S7_S3 1 100 -3.40282E+038 3.40282E+038 ECU_ADDRESS 0xFFF8634C /end MEASUREMENT
/begin MEASUREMENT f_n_akt_err_nvmsoll_has_l2 "Flag, ob Drehzahlplausifehler aktiv ist" UBYTE sts_int_S1_S7_S3 1 100 0 255 ECU_ADDRESS 0xFFF86CED /end MEASUREMENT
/begin MEASUREMENT f_n_err_nvmsoll_fl_has_l2 "Flag, ob Fehlerereignis aufgrund Drehzahlplausifehler vorliegt" FLOAT32_IEEE sts_fl_S1_S7_S3 1 100 -3.40282E+038 3.40282E+038 ECU_ADDRESS 0xFFF86350 /end MEASUREMENT
/begin MEASUREMENT f_n_err_nvmsoll_has_l2 "Flag, ob Fehlerereignis aufgrund Drehzahlplausifehler vorliegt" UBYTE sts_int_S1_S7_S3 1 100 0 255 ECU_ADDRESS 0xFFF86CEE /end MEASUREMENT
/begin MEASUREMENT f_next_check_allowed_nvmsoll_fl_has_l2 "Flag, ob naechste Stufe der Ueberwachung durchlaufen werden darf. Bei einem Fehlereintritt, wird die Ueberwachungabgebrochen und entsprechend der Fehler angefiltert. (FPU-Pfad)" FLOAT32_IEEE sts_fl_S1_S7_S3 1 100 0 1 ECU_ADDRESS 0xFFF86354 /end MEASUREMENT
/begin MEASUREMENT f_next_check_allowed_nvmsoll_has_l2 "Flag, ob naechste Stufe der Ueberwachung durchlaufen werden darf. Bei einem Fehlereintritt, wird die Ueberwachung abgebrochen und entsprechend der Fehler angefiltert." UBYTE sts_int_S1_S7_S3 1 100 0 1 ECU_ADDRESS 0xFFF86CEF /end MEASUREMENT
/begin MEASUREMENT f_sig_akt_err_nvmsoll_fl_has_l2 "Flag, ob Signalfehler aktiv ist (FPU-Pfad)" FLOAT32_IEEE sts_fl_S1_S7_S3 1 100 -3.40282E+038 3.40282E+038 ECU_ADDRESS 0xFFF86358 /end MEASUREMENT
/begin MEASUREMENT f_sig_akt_err_nvmsoll_has_l2 "Flag, ob Signalfehler aktiv ist" UBYTE sts_int_S1_S7_S3 1 100 0 255 ECU_ADDRESS 0xFFF86CF0 /end MEASUREMENT
/begin MEASUREMENT f_sig_err_nvmsoll_fl_has_l2 "Flag, ob Fehlerereignis aufgrund Signalstoerung aktiv ist (FPU-Pfad)" FLOAT32_IEEE sts_fl_S1_S7_S3 1 100 -3.40282E+038 3.40282E+038 ECU_ADDRESS 0xFFF8635C /end MEASUREMENT
/begin MEASUREMENT f_sig_err_nvmsoll_has_l2 "Flag, ob Fehlerereignis aufgrund Signalstoerung aktiv ist" UBYTE sts_int_S1_S7_S3 1 100 0 255 ECU_ADDRESS 0xFFF86CF1 /end MEASUREMENT
/begin MEASUREMENT f_z_akt_err_nvmsoll_fl_has_l2 "Flag, ob Vorgabefehler aktiv ist (FPU-Pfad)" FLOAT32_IEEE sts_fl_S1_S7_S3 1 100 -3.40282E+038 3.40282E+038 ECU_ADDRESS 0xFFF86360 /end MEASUREMENT
/begin MEASUREMENT f_z_akt_err_nvmsoll_has_l2 "Flag, ob Vorgabefehler aktiv ist" UBYTE sts_int_S1_S7_S3 1 100 0 255 ECU_ADDRESS 0xFFF86CF2 /end MEASUREMENT
/begin MEASUREMENT f_z_err_nvmsoll_fl_has_l2 "Flag, ob Fehlerereignis aufgrund Drehzahlvorgabe ohne Anforderung vorliegt (FPU-Pfad)" FLOAT32_IEEE sts_fl_S1_S7_S3 1 100 -3.40282E+038 3.40282E+038 ECU_ADDRESS 0xFFF86364 /end MEASUREMENT
/begin MEASUREMENT f_z_err_nvmsoll_has_l2 "Flag, ob Fehlerereignis aufgrund Drehzahlvorgabe ohne Anforderung vorliegt" UBYTE sts_int_S1_S7_S3 1 100 0 255 ECU_ADDRESS 0xFFF86CF3 /end MEASUREMENT
/begin MEASUREMENT i_dyn_nvmsoll_fl_has_l2 "dynamisches Uebersetzungsverhaeltnis (FPU-Pfad)" FLOAT32_IEEE void_fl_S1_S7_S3 1 100 -3.40282E+038 3.40282E+038 ECU_ADDRESS 0xFFF86368 /end MEASUREMENT
/begin MEASUREMENT i_dyn_nvmsoll_has_l2 "dynamisches Uebersetzungsverhaeltnis" UWORD ratio_int_S1_S7_S3 1 100 0 65.535 ECU_ADDRESS 0xFFF867AA /end MEASUREMENT
/begin MEASUREMENT i_gang_fl_has_l2 "Aktuelle Ganguebersetzung" FLOAT32_IEEE ratio_fl_S1_S7_S3 1 100 -3.40282E+038 3.40282E+038 ECU_ADDRESS 0xFFF86390 /end MEASUREMENT
/begin MEASUREMENT i_gang_has_l2 "Aktuelle Ganguebersetzung" SWORD ratio_int_S1_S7_S3 1 100 -32.768 32.767 ECU_ADDRESS 0xFFF867BC /end MEASUREMENT
/begin MEASUREMENT iv_f_extdeak_fl_has_l2 "Flag, ob Momentenplausiblisierung aufgrunde externer (OEM) Anforderung deaktiviert werden soll" FLOAT32_IEEE b_fl_S1_S7_S3 1 100 -3.40282E+038 3.40282E+038 ECU_ADDRESS 0xFFF86394 /end MEASUREMENT
/begin MEASUREMENT iv_f_extdeak_has_l2 "Flag, ob Momentenplausiblisierung aufgrunde externer (OEM) Anforderung deaktiviert werden soll" UBYTE b_int_S1_S7_S3 1 100 0 255 ECU_ADDRESS 0xFFF86CF5 /end MEASUREMENT
/begin MEASUREMENT iv_i_gang_fl_has_l2 "Aktuelle Ganguebersetzung" FLOAT32_IEEE ratio_fl_S1_S7_S3 1 100 -3.40282E+038 3.40282E+038 ECU_ADDRESS 0xFFF86398 /end MEASUREMENT
/begin MEASUREMENT iv_i_gang_has_l2 "Aktuelle Ganguebersetzung" SWORD ratio_int_S1_S7_S3 1 100 -32.768 32.767 ECU_ADDRESS 0xFFF867BE /end MEASUREMENT
/begin MEASUREMENT iv_m_ist_em_fl_has_l2 "EM-Istmoment" FLOAT32_IEEE trq_fl_S1_S7_S3 1 100 -3.40282E+038 3.40282E+038 ECU_ADDRESS 0xFFF8639C /end MEASUREMENT
/begin MEASUREMENT iv_m_ist_em_has_l2 "EM-Istmoment" SWORD trq_int_S1_S7_S3 1 100 -32768 32767 ECU_ADDRESS 0xFFF867C0 /end MEASUREMENT
/begin MEASUREMENT iv_m_ist_vm_fl_has_l2 "VM-Istmoment" FLOAT32_IEEE trq_fl_S1_S7_S3 1 100 -3.40282E+038 3.40282E+038 ECU_ADDRESS 0xFFF863A0 /end MEASUREMENT
/begin MEASUREMENT iv_m_ist_vm_has_l2 "VM-Istmoment" SWORD trq_int_S1_S7_S3 1 100 -32768 32767 ECU_ADDRESS 0xFFF867C2 /end MEASUREMENT
/begin MEASUREMENT iv_m_me_red_fl_has_l2 "Drehmoment des Motoreingriffs" FLOAT32_IEEE trq_fl_S1_S7_S3 1 100 -3.40282E+038 3.40282E+038 ECU_ADDRESS 0xFFF863A4 /end MEASUREMENT
/begin MEASUREMENT iv_m_me_red_has_l2 "Drehmoment des Motoreingriffs" SWORD trq_int_S1_S7_S3 1 100 -32768 32767 ECU_ADDRESS 0xFFF867C4 /end MEASUREMENT
/begin MEASUREMENT iv_m_motmax_fl_has_l2 "Max. zulaessiges Motormoment fuer Hybridantriebsstrang (gefuehrter Getriebeschutz) (FPU-Pfad)" FLOAT32_IEEE trq_fl_S1_S7_S3 1 100 -3.40282E+038 3.40282E+038 ECU_ADDRESS 0xFFF863A8 /end MEASUREMENT
/begin MEASUREMENT iv_m_motmax_has_l2 "Max. zulaessiges Motormoment fuer Hybridantriebsstrang (gefuehrter Getriebeschutz)" SWORD trq_int_S1_S7_S3 1 100 -32768 32767 ECU_ADDRESS 0xFFF867C6 /end MEASUREMENT
/begin MEASUREMENT iv_m_motsoll_fl_has_l2 "Motorsollmomentensumme (Fahrerwunsch)" FLOAT32_IEEE trq_fl_S1_S7_S3 1 100 -3.40282E+038 3.40282E+038 ECU_ADDRESS 0xFFF863AC /end MEASUREMENT
/begin MEASUREMENT iv_m_motsoll_has_l2 "Motorsollmomentensumme (Fahrerwunsch)" SWORD trq_int_S1_S7_S3 1 100 -32768 32767 ECU_ADDRESS 0xFFF867C8 /end MEASUREMENT
/begin MEASUREMENT iv_m_motverlust_fl_has_l2 "Motorverlustmoment (FPU-Pfad)" FLOAT32_IEEE trq_fl_S1_S7_S3 1 100 -3.40282E+038 3.40282E+038 ECU_ADDRESS 0xFFF863B0 /end MEASUREMENT
/begin MEASUREMENT iv_m_motverlust_has_l2 "Motorverlustmoment" UWORD trq_int_S1_S7_S3 1 100 0 65535 ECU_ADDRESS 0xFFF867CA /end MEASUREMENT
/begin MEASUREMENT iv_n_ist_ab_fl_has_l2 "Abtriebsistdrehzahl (FPU-Pfad)" FLOAT32_IEEE n_fl_S1_S7_S3 1 100 -3.40282E+038 3.40282E+038 ECU_ADDRESS 0xFFF863B4 /end MEASUREMENT
/begin MEASUREMENT iv_n_ist_ab_has_l2 "Abtriebsistdrehzahl" UWORD n_int_S1_S7_S3 1 100 0 65535 ECU_ADDRESS 0xFFF867CC /end MEASUREMENT
/begin MEASUREMENT iv_n_ist_em_fl_has_l2 "EM-Istdrehzahl" FLOAT32_IEEE n_fl_S1_S7_S3 1 100 -3.40282E+038 3.40282E+038 ECU_ADDRESS 0xFFF863B8 /end MEASUREMENT
/begin MEASUREMENT iv_n_ist_em_has_l2 "EM-Istdrehzahl" UWORD n_int_S1_S7_S3 1 100 0 65535 ECU_ADDRESS 0xFFF867CE /end MEASUREMENT
/begin MEASUREMENT iv_n_ist_tu_fl_has_l2 "Turbinendrehzahl (Getriebeeingang nach Entkopplungselement) (FPU-Pfad)" FLOAT32_IEEE n_fl_S1_S7_S3 1 100 -3.40282E+038 3.40282E+038 ECU_ADDRESS 0xFFF863BC /end MEASUREMENT
/begin MEASUREMENT iv_n_ist_tu_has_l2 "Turbinendrehzahl (Getriebeeingang nach Entkopplungselement)" UWORD n_int_S1_S7_S3 1 100 0 65535 ECU_ADDRESS 0xFFF867D0 /end MEASUREMENT
/begin MEASUREMENT iv_n_ist_vm_fl_has_l2 "VM-Istdrehzahl (FPU-Pfad)" FLOAT32_IEEE n_fl_S1_S7_S3 1 100 -3.40282E+038 3.40282E+038 ECU_ADDRESS 0xFFF863C0 /end MEASUREMENT
/begin MEASUREMENT iv_n_ist_vm_has_l2 "VM-Istdrehzahl" UWORD n_int_S1_S7_S3 1 100 0 65535 ECU_ADDRESS 0xFFF867D2 /end MEASUREMENT
/begin MEASUREMENT iv_n_mot_idle_tar_fl_has_l2 "EM-Minimaldrehzahl von der HAS" FLOAT32_IEEE n_fl_S1_S7_S3 1 100 -3.40282E+038 3.40282E+038 ECU_ADDRESS 0xFFF863C4 /end MEASUREMENT
/begin MEASUREMENT iv_n_mot_idle_tar_has_l2 "EM-Minimaldrehzahl von der HAS" UWORD n_int_S1_S7_S3 1 100 0 65535 ECU_ADDRESS 0xFFF867D4 /end MEASUREMENT
/begin MEASUREMENT iv_n_mot_llsoll_8bit_fl_has_l2 "EM-Minimaldrehzahl von der HAS" FLOAT32_IEEE n_fl_S1_S7_S3 1 100 -3.40282E+038 3.40282E+038 ECU_ADDRESS 0xFFF863C8 /end MEASUREMENT
/begin MEASUREMENT iv_n_mot_llsoll_8bit_has_l2 "EM-Minimaldrehzahl von der HAS" UBYTE n_int_a_S1_S7_S3 1 100 0 255 ECU_ADDRESS 0xFFF86CF6 /end MEASUREMENT
/begin MEASUREMENT iv_n_soll_em_fl_has_l2 "EM-Solldrehzahl von der HAS" FLOAT32_IEEE n_fl_S1_S7_S3 1 100 -3.40282E+038 3.40282E+038 ECU_ADDRESS 0xFFF863CC /end MEASUREMENT
/begin MEASUREMENT iv_n_soll_em_has_l2 "EM-Solldrehzahl von der HAS" UWORD n_int_S1_S7_S3 1 100 0 65535 ECU_ADDRESS 0xFFF867D6 /end MEASUREMENT
/begin MEASUREMENT iv_n_soll_vm_fl_has_l2 "VM-Solldrehzahl von der HAS" FLOAT32_IEEE n_fl_S1_S7_S3 1 100 -3.40282E+038 3.40282E+038 ECU_ADDRESS 0xFFF863D0 /end MEASUREMENT
/begin MEASUREMENT iv_n_soll_vm_has_l2 "VM-Solldrehzahl von der HAS" UWORD n_int_S1_S7_S3 1 100 0 65535 ECU_ADDRESS 0xFFF867D8 /end MEASUREMENT
/begin MEASUREMENT iv_st_hilorange_fl_has_l2 "Status fuer High-/Low-Range Betriebsart (FPU-Pfad)" FLOAT32_IEEE sts_fl_S1_S7_S3 1 100 0 1 ECU_ADDRESS 0xFFF863D4 /end MEASUREMENT
/begin MEASUREMENT iv_st_hilorange_has_l2 "Status fuer High-/Low-Range Betriebsart" UBYTE sts_int_S1_S7_S3 1 100 0 1 ECU_ADDRESS 0xFFF86CF7 /end MEASUREMENT
/begin MEASUREMENT iv_st_m_ist_em_fl_has_l2 "Status des EM-Istmomentensignals" FLOAT32_IEEE sts_fl_S1_S7_S3 1 100 -3.40282E+038 3.40282E+038 ECU_ADDRESS 0xFFF863D8 /end MEASUREMENT
/begin MEASUREMENT iv_st_m_ist_em_has_l2 "Status des EM-Istmomentensignals" UBYTE sts_int_S1_S7_S3 1 100 0 255 ECU_ADDRESS 0xFFF86CF8 /end MEASUREMENT
/begin MEASUREMENT iv_st_m_ist_vm_fl_has_l2 "Status des VM-Istmomentensignals" FLOAT32_IEEE sts_fl_S1_S7_S3 1 100 -3.40282E+038 3.40282E+038 ECU_ADDRESS 0xFFF863DC /end MEASUREMENT
/begin MEASUREMENT iv_st_m_ist_vm_has_l2 "Status des VM-Istmomentensignals" UBYTE sts_int_S1_S7_S3 1 100 0 255 ECU_ADDRESS 0xFFF86CF9 /end MEASUREMENT
/begin MEASUREMENT iv_st_m_me_red_fl_has_l2 "Status des Motoreingriffs" FLOAT32_IEEE sts_fl_S1_S7_S3 1 100 -3.40282E+038 3.40282E+038 ECU_ADDRESS 0xFFF863E0 /end MEASUREMENT
/begin MEASUREMENT iv_st_m_me_red_has_l2 "Status des Motoreingriffs" UBYTE sts_int_S1_S7_S3 1 100 0 255 ECU_ADDRESS 0xFFF86CFA /end MEASUREMENT
/begin MEASUREMENT iv_st_m_motsoll_fl_has_l2 "Status des Signals der Motorsollmomentensumme (Fahrerwunsch)" FLOAT32_IEEE sts_fl_S1_S7_S3 1 100 -3.40282E+038 3.40282E+038 ECU_ADDRESS 0xFFF863E4 /end MEASUREMENT
/begin MEASUREMENT iv_st_m_motsoll_has_l2 "Status des Signals der Motorsollmomentensumme (Fahrerwunsch)" UBYTE sts_int_S1_S7_S3 1 100 0 255 ECU_ADDRESS 0xFFF98429 /end MEASUREMENT
/begin MEASUREMENT iv_st_n_ist_ab_fl_has_l2 "Status des Abtriebsdrehzahlsignals (FPU-Pfad)" FLOAT32_IEEE sts_fl_S1_S7_S3 1 100 -3.40282E+038 3.40282E+038 ECU_ADDRESS 0xFFF863E8 /end MEASUREMENT
/begin MEASUREMENT iv_st_n_ist_ab_has_l2 "Status des Abtriebsdrehzahlsignals" UBYTE sts_int_S1_S7_S3 1 100 0 255 ECU_ADDRESS 0xFFF86CFB /end MEASUREMENT
/begin MEASUREMENT iv_st_n_ist_em_fl_has_l2 "Status des EM-Istdrehzahlsignals" FLOAT32_IEEE sts_fl_S1_S7_S3 1 100 -3.40282E+038 3.40282E+038 ECU_ADDRESS 0xFFF863EC /end MEASUREMENT
/begin MEASUREMENT iv_st_n_ist_em_has_l2 "Status des EM-Istdrehzahlsignals" UBYTE sts_int_S1_S7_S3 1 100 0 255 ECU_ADDRESS 0xFFF86CFC /end MEASUREMENT
/begin MEASUREMENT iv_st_n_ist_tu_fl_has_l2 "Status des Turbinendrehzahlsignals (FPU-Pfad)" FLOAT32_IEEE sts_fl_S1_S7_S3 1 100 -3.40282E+038 3.40282E+038 ECU_ADDRESS 0xFFF863F0 /end MEASUREMENT
/begin MEASUREMENT iv_st_n_ist_tu_has_l2 "Status des Turbinendrehzahlsignals" UBYTE sts_int_S1_S7_S3 1 100 0 255 ECU_ADDRESS 0xFFF86CFD /end MEASUREMENT
/begin MEASUREMENT iv_st_n_ist_vm_fl_has_l2 "Status des VM-Istdrehzahlsignals" FLOAT32_IEEE sts_fl_S1_S7_S3 1 100 -3.40282E+038 3.40282E+038 ECU_ADDRESS 0xFFF863F4 /end MEASUREMENT
/begin MEASUREMENT iv_st_n_ist_vm_has_l2 "Status des VM-Istdrehzahlsignals" UBYTE sts_int_S1_S7_S3 1 100 0 255 ECU_ADDRESS 0xFFF86CFE /end MEASUREMENT
/begin MEASUREMENT iv_st_n_soll_em_fl_has_l2 "Status der EM-Solldrehzahlvorgabe von der HAS" FLOAT32_IEEE sts_fl_S1_S7_S3 1 100 -3.40282E+038 3.40282E+038 ECU_ADDRESS 0xFFF863F8 /end MEASUREMENT
/begin MEASUREMENT iv_st_n_soll_em_has_l2 "Status der EM-Solldrehzahlvorgabe von der HAS" UBYTE sts_int_S1_S7_S3 1 100 0 255 ECU_ADDRESS 0xFFF86CFF /end MEASUREMENT
/begin MEASUREMENT iv_st_n_soll_vm_fl_has_l2 "Status der VM-Solldrehzahlvorgabe von der HAS" FLOAT32_IEEE sts_fl_S1_S7_S3 1 100 -3.40282E+038 3.40282E+038 ECU_ADDRESS 0xFFF863FC /end MEASUREMENT
/begin MEASUREMENT iv_st_n_soll_vm_has_l2 "Status der VM-Solldrehzahlvorgabe von der HAS" UBYTE sts_int_S1_S7_S3 1 100 0 255 ECU_ADDRESS 0xFFF86D00 /end MEASUREMENT
/begin MEASUREMENT iv_status_kraftschluss_fl_has_l2 "Status Getriebekraftschluss; 0: kein kraftschluss; 1: kraftschluss" FLOAT32_IEEE b_fl_S1_S7_S3 1 100 -3.40282E+038 3.40282E+038 ECU_ADDRESS 0xFFF86400 /end MEASUREMENT
/begin MEASUREMENT iv_status_kraftschluss_has_l2 "Status Getriebekraftschluss; 0: kein kraftschluss; 1: kraftschluss" UBYTE b_int_S1_S7_S3 1 100 0 255 ECU_ADDRESS 0xFFF86D01 /end MEASUREMENT
/begin MEASUREMENT iv_z_pos_fl_has_l2 "aktuelle Stellung des Positionshebels" FLOAT32_IEEE sts_fl_S1_S7_S3 1 100 -3.40282E+038 3.40282E+038 ECU_ADDRESS 0xFFF86404 /end MEASUREMENT
/begin MEASUREMENT iv_z_pos_has_l2 "aktuelle Stellung des Positionshebels" UBYTE sts_int_S1_S7_S3 1 100 0 255 ECU_ADDRESS 0xFFF86D02 /end MEASUREMENT
/begin MEASUREMENT m_ist_em_fl_has_l2 "EM-Istmoment" FLOAT32_IEEE trq_fl_S1_S7_S3 1 100 -3.40282E+038 3.40282E+038 ECU_ADDRESS 0xFFF86408 /end MEASUREMENT
/begin MEASUREMENT m_ist_em_has_l2 "EM-Istmoment" SWORD trq_int_S1_S7_S3 1 100 -32768 32767 ECU_ADDRESS 0xFFF867DA /end MEASUREMENT
/begin MEASUREMENT m_ist_vm_fl_has_l2 "VM-Istmoment" FLOAT32_IEEE trq_fl_S1_S7_S3 1 100 -3.40282E+038 3.40282E+038 ECU_ADDRESS 0xFFF8640C /end MEASUREMENT
/begin MEASUREMENT m_ist_vm_has_l2 "VM-Istmoment" SWORD trq_int_S1_S7_S3 1 100 -32768 32767 ECU_ADDRESS 0xFFF867DC /end MEASUREMENT
/begin MEASUREMENT m_me_red_fl_has_l2 "Drehmoment des Motoreingriffs" FLOAT32_IEEE trq_fl_S1_S7_S3 1 100 -3.40282E+038 3.40282E+038 ECU_ADDRESS 0xFFF86410 /end MEASUREMENT
/begin MEASUREMENT m_me_red_has_l2 "Drehmoment des Motoreingriffs" SWORD trq_int_S1_S7_S3 1 100 -32768 32767 ECU_ADDRESS 0xFFF867DE /end MEASUREMENT
/begin MEASUREMENT m_motmax_fl_has_l2 "Max. zulaessiges Motormoment fuer Hybridantriebsstrang (gefuehrter Getriebeschutz) (FPU-Pfad)" FLOAT32_IEEE trq_fl_S1_S7_S3 1 100 -3.40282E+038 3.40282E+038 ECU_ADDRESS 0xFFF86414 /end MEASUREMENT
/begin MEASUREMENT m_motmax_has_l2 "Max. zulaessiges Motormoment fuer Hybridantriebsstrang (gefuehrter Getriebeschutz)" SWORD trq_int_S1_S7_S3 1 100 -32768 32767 ECU_ADDRESS 0xFFF867E0 /end MEASUREMENT
/begin MEASUREMENT m_motsoll_filt_nvmsoll_fl_has_l2 "gefiltertes Fahrerwunschmoment" FLOAT32_IEEE trq_fl_S1_S7_S3 1 100 -32767 32768 ECU_ADDRESS 0xFFF8636C /end MEASUREMENT
/begin MEASUREMENT m_motsoll_filt_nvmsoll_has_l2 "gefiltertes Fahrerwunschmoment" SWORD trq_int_S1_S7_S3 1 100 -32767 32767 ECU_ADDRESS 0xFFF867AC /end MEASUREMENT
/begin MEASUREMENT m_motsoll_fl_has_l2 "Motorsollmomentensumme (Fahrerwunsch)" FLOAT32_IEEE trq_fl_S1_S7_S3 1 100 -3.40282E+038 3.40282E+038 ECU_ADDRESS 0xFFF86418 /end MEASUREMENT
/begin MEASUREMENT m_motsoll_has_l2 "Motorsollmomentensumme (Fahrerwunsch)" SWORD trq_int_S1_S7_S3 1 100 -32768 32767 ECU_ADDRESS 0xFFF867E2 /end MEASUREMENT
/begin MEASUREMENT m_motverlust_fl_has_l2 "Motorverlustmoment (FPU-Pfad)" FLOAT32_IEEE trq_fl_S1_S7_S3 1 100 -3.40282E+038 3.40282E+038 ECU_ADDRESS 0xFFF8641C /end MEASUREMENT
/begin MEASUREMENT m_motverlust_has_l2 "Motorverlustmoment" UWORD trq_int_S1_S7_S3 1 100 0 65535 ECU_ADDRESS 0xFFF867E4 /end MEASUREMENT
/begin MEASUREMENT m_verlust_nvmsoll_fl_has_l2 "Motorverlustmoment  (FPU-Pfad)" FLOAT32_IEEE trq_fl_S1_S7_S3 1 100 0 1023 ECU_ADDRESS 0xFFF86370 /end MEASUREMENT
/begin MEASUREMENT m_verlust_nvmsoll_has_l2 "Motorverlustmoment" UWORD trq_int_S1_S7_S3 1 100 0 1023 ECU_ADDRESS 0xFFF867AE /end MEASUREMENT
/begin MEASUREMENT mo_mered_nvmsoll_fl_has_l2 "Drehmoment des Motoreingriffs  (FPU-Pfad)" FLOAT32_IEEE trq_fl_S1_S7_S3 1 100 -3.40282E+038 3.40282E+038 ECU_ADDRESS 0xFFF86374 /end MEASUREMENT
/begin MEASUREMENT mo_mered_nvmsoll_has_l2 "Drehmoment des Motoreingriffs" SWORD trq_int_S1_S7_S3 1 100 -32768 32767 ECU_ADDRESS 0xFFF867B0 /end MEASUREMENT
/begin MEASUREMENT n_ist_ab_fl_has_l2 "Abtriebsistdrehzahl (FPU-Pfad)" FLOAT32_IEEE n_fl_S1_S7_S3 1 100 -3.40282E+038 3.40282E+038 ECU_ADDRESS 0xFFF86420 /end MEASUREMENT
/begin MEASUREMENT n_ist_ab_has_l2 "Abtriebsistdrehzahl" UWORD n_int_S1_S7_S3 1 100 0 65535 ECU_ADDRESS 0xFFF867E6 /end MEASUREMENT
/begin MEASUREMENT n_ist_em_ersatz_nvmsoll_fl_has_l2 "Berechneter EM-Ersatzwert bei EM-Signalfehler (FPU-Pfad)" FLOAT32_IEEE n_fl_S1_S7_S3 1 100 -3.40282E+038 3.40282E+038 ECU_ADDRESS 0xFFF86378 /end MEASUREMENT
/begin MEASUREMENT n_ist_em_ersatz_nvmsoll_has_l2 "Berechneter EM-Ersatzwert bei EM-Signalfehler" UWORD n_int_S1_S7_S3 1 100 0 65535 ECU_ADDRESS 0xFFF867B2 /end MEASUREMENT
/begin MEASUREMENT n_ist_em_fl_has_l2 "EM-Istdrehzahl" FLOAT32_IEEE n_fl_S1_S7_S3 1 100 -3.40282E+038 3.40282E+038 ECU_ADDRESS 0xFFF86424 /end MEASUREMENT
/begin MEASUREMENT n_ist_em_has_l2 "EM-Istdrehzahl" UWORD n_int_S1_S7_S3 1 100 0 65535 ECU_ADDRESS 0xFFF867E8 /end MEASUREMENT
/begin MEASUREMENT n_ist_tu_fl_has_l2 "Turbinendrehzahl (Getriebeeingang nach Entkopplungselement) (FPU-Pfad)" FLOAT32_IEEE n_fl_S1_S7_S3 1 100 -3.40282E+038 3.40282E+038 ECU_ADDRESS 0xFFF86428 /end MEASUREMENT
/begin MEASUREMENT n_ist_tu_has_l2 "Turbinendrehzahl (Getriebeeingang nach Entkopplungselement)" UWORD n_int_S1_S7_S3 1 100 0 65535 ECU_ADDRESS 0xFFF867EA /end MEASUREMENT
/begin MEASUREMENT n_ist_vm_fl_has_l2 "VM-Istdrehzahl (FPU-Pfad)" FLOAT32_IEEE n_fl_S1_S7_S3 1 100 -3.40282E+038 3.40282E+038 ECU_ADDRESS 0xFFF8642C /end MEASUREMENT
/begin MEASUREMENT n_ist_vm_has_l2 "VM-Istdrehzahl" UWORD n_int_S1_S7_S3 1 100 0 65535 ECU_ADDRESS 0xFFF867EC /end MEASUREMENT
/begin MEASUREMENT n_mot_idle_tar_fl_has_l2 "EM-Minimaldrehzahl von der HAS" FLOAT32_IEEE n_fl_S1_S7_S3 1 100 -3.40282E+038 3.40282E+038 ECU_ADDRESS 0xFFF86430 /end MEASUREMENT
/begin MEASUREMENT n_mot_idle_tar_has_l2 "EM-Minimaldrehzahl von der HAS" UWORD n_int_S1_S7_S3 1 100 0 65535 ECU_ADDRESS 0xFFF867EE /end MEASUREMENT
/begin MEASUREMENT n_mot_llsoll_8bit_fl_has_l2 "EM-Minimaldrehzahl von der HAS" FLOAT32_IEEE n_fl_S1_S7_S3 1 100 -3.40282E+038 3.40282E+038 ECU_ADDRESS 0xFFF86434 /end MEASUREMENT
/begin MEASUREMENT n_mot_llsoll_8bit_has_l2 "EM-Minimaldrehzahl von der HAS" UWORD n_int_S1_S7_S3 1 100 0 65535 ECU_ADDRESS 0xFFF867F0 /end MEASUREMENT
/begin MEASUREMENT n_mot_llsoll_fl_has_l2 "EM-Minimaldrehzahl von der HAS" FLOAT32_IEEE n_fl_S1_S7_S3 1 100 -3.40282E+038 3.40282E+038 ECU_ADDRESS 0xFFF86438 /end MEASUREMENT
/begin MEASUREMENT n_mot_llsoll_has_l2 "EM-Minimaldrehzahl von der HAS" UWORD n_int_S1_S7_S3 1 100 0 65535 ECU_ADDRESS 0xFFF867F2 /end MEASUREMENT
/begin MEASUREMENT n_soll_em_fl_has_l2 "EM-Solldrehzahl von der HAS" FLOAT32_IEEE n_fl_S1_S7_S3 1 100 -3.40282E+038 3.40282E+038 ECU_ADDRESS 0xFFF8643C /end MEASUREMENT
/begin MEASUREMENT n_soll_em_has_l2 "EM-Solldrehzahl von der HAS" UWORD n_int_S1_S7_S3 1 100 0 65535 ECU_ADDRESS 0xFFF867F4 /end MEASUREMENT
/begin MEASUREMENT n_soll_vm_fl_has_l2 "VM-Solldrehzahl von der HAS" FLOAT32_IEEE n_fl_S1_S7_S3 1 100 -3.40282E+038 3.40282E+038 ECU_ADDRESS 0xFFF86440 /end MEASUREMENT
/begin MEASUREMENT n_soll_vm_has_l2 "VM-Solldrehzahl von der HAS" UWORD n_int_S1_S7_S3 1 100 0 65535 ECU_ADDRESS 0xFFF867F6 /end MEASUREMENT
/begin MEASUREMENT st_hilorange_fl_has_l2 "Status fuer High-/Low-Range Betriebsart (FPU-Pfad)" FLOAT32_IEEE sts_fl_S1_S7_S3 1 100 0 1 ECU_ADDRESS 0xFFF86444 /end MEASUREMENT
/begin MEASUREMENT st_hilorange_has_l2 "Status fuer High-/Low-Range Betriebsart" UBYTE sts_int_S1_S7_S3 1 100 0 1 ECU_ADDRESS 0xFFF86D03 /end MEASUREMENT
/begin MEASUREMENT st_m_ist_em_fl_has_l2 "Status des EM-Istmomentensignals" FLOAT32_IEEE sts_fl_S1_S7_S3 1 100 -3.40282E+038 3.40282E+038 ECU_ADDRESS 0xFFF86448 /end MEASUREMENT
/begin MEASUREMENT st_m_ist_em_has_l2 "Status des EM-Istmomentensignals" UBYTE sts_int_S1_S7_S3 1 100 0 255 ECU_ADDRESS 0xFFF86D04 /end MEASUREMENT
/begin MEASUREMENT st_m_ist_vm_fl_has_l2 "Status des VM-Istmomentensignals" FLOAT32_IEEE sts_fl_S1_S7_S3 1 100 -3.40282E+038 3.40282E+038 ECU_ADDRESS 0xFFF8644C /end MEASUREMENT
/begin MEASUREMENT st_m_ist_vm_has_l2 "Status des VM-Istmomentensignals" UBYTE sts_int_S1_S7_S3 1 100 0 255 ECU_ADDRESS 0xFFF86D05 /end MEASUREMENT
/begin MEASUREMENT st_m_me_red_fl_has_l2 "Status des Motoreingriffs" FLOAT32_IEEE sts_fl_S1_S7_S3 1 100 -3.40282E+038 3.40282E+038 ECU_ADDRESS 0xFFF86450 /end MEASUREMENT
/begin MEASUREMENT st_m_me_red_has_l2 "Status des Motoreingriffs" UBYTE sts_int_S1_S7_S3 1 100 0 255 ECU_ADDRESS 0xFFF86D06 /end MEASUREMENT
/begin MEASUREMENT st_m_motsoll_fl_has_l2 "Status des Signals der Motorsollmomentensumme (Fahrerwunsch)" FLOAT32_IEEE sts_fl_S1_S7_S3 1 100 -3.40282E+038 3.40282E+038 ECU_ADDRESS 0xFFF86454 /end MEASUREMENT
/begin MEASUREMENT st_m_motsoll_has_l2 "Status des Signals der Motorsollmomentensumme (Fahrerwunsch)" UBYTE sts_int_S1_S7_S3 1 100 0 255 ECU_ADDRESS 0xFFF86D07 /end MEASUREMENT
/begin MEASUREMENT st_n_ist_ab_fl_has_l2 "Status des Abtriebsdrehzahlsignals (FPU-Pfad)" FLOAT32_IEEE sts_fl_S1_S7_S3 1 100 -3.40282E+038 3.40282E+038 ECU_ADDRESS 0xFFF86458 /end MEASUREMENT
/begin MEASUREMENT st_n_ist_ab_has_l2 "Status des Abtriebsdrehzahlsignals" UBYTE sts_int_S1_S7_S3 1 100 0 255 ECU_ADDRESS 0xFFF86D08 /end MEASUREMENT
/begin MEASUREMENT st_n_ist_em_fl_has_l2 "Status des EM-Istdrehzahlsignals" FLOAT32_IEEE sts_fl_S1_S7_S3 1 100 -3.40282E+038 3.40282E+038 ECU_ADDRESS 0xFFF8645C /end MEASUREMENT
/begin MEASUREMENT st_n_ist_em_has_l2 "Status des EM-Istdrehzahlsignals" UBYTE sts_int_S1_S7_S3 1 100 0 255 ECU_ADDRESS 0xFFF86D09 /end MEASUREMENT
/begin MEASUREMENT st_n_ist_tu_fl_has_l2 "Status des Turbinendrehzahlsignals (FPU-Pfad)" FLOAT32_IEEE sts_fl_S1_S7_S3 1 100 -3.40282E+038 3.40282E+038 ECU_ADDRESS 0xFFF86460 /end MEASUREMENT
/begin MEASUREMENT st_n_ist_tu_has_l2 "Status des Turbinendrehzahlsignals" UBYTE sts_int_S1_S7_S3 1 100 0 255 ECU_ADDRESS 0xFFF86D0A /end MEASUREMENT
/begin MEASUREMENT st_n_ist_vm_fl_has_l2 "Status des VM-Istdrehzahlsignals" FLOAT32_IEEE sts_fl_S1_S7_S3 1 100 -3.40282E+038 3.40282E+038 ECU_ADDRESS 0xFFF86464 /end MEASUREMENT
/begin MEASUREMENT st_n_ist_vm_has_l2 "Status des VM-Istdrehzahlsignals" UBYTE sts_int_S1_S7_S3 1 100 0 255 ECU_ADDRESS 0xFFF86D0B /end MEASUREMENT
/begin MEASUREMENT st_n_soll_em_fl_has_l2 "Status der EM-Solldrehzahlvorgabe von der HAS" FLOAT32_IEEE sts_fl_S1_S7_S3 1 100 -3.40282E+038 3.40282E+038 ECU_ADDRESS 0xFFF86468 /end MEASUREMENT
/begin MEASUREMENT st_n_soll_em_has_l2 "Status der EM-Solldrehzahlvorgabe von der HAS" UBYTE sts_int_S1_S7_S3 1 100 0 255 ECU_ADDRESS 0xFFF86D0C /end MEASUREMENT
/begin MEASUREMENT st_n_soll_vm_fl_has_l2 "Status der VM-Solldrehzahlvorgabe von der HAS" FLOAT32_IEEE sts_fl_S1_S7_S3 1 100 -3.40282E+038 3.40282E+038 ECU_ADDRESS 0xFFF8646C /end MEASUREMENT
/begin MEASUREMENT st_n_soll_vm_has_l2 "Status der VM-Solldrehzahlvorgabe von der HAS" UBYTE sts_int_S1_S7_S3 1 100 0 255 ECU_ADDRESS 0xFFF86D0D /end MEASUREMENT
/begin MEASUREMENT status_kraftschluss_fl_has_l2 "Status Getriebekraftschluss; 0: kein kraftschluss; 1: kraftschluss" FLOAT32_IEEE b_fl_S1_S7_S3 1 100 -3.40282E+038 3.40282E+038 ECU_ADDRESS 0xFFF86470 /end MEASUREMENT
/begin MEASUREMENT status_kraftschluss_has_l2 "Status Getriebekraftschluss; 0: kein kraftschluss; 1: kraftschluss" UBYTE b_int_S1_S7_S3 1 100 0 255 ECU_ADDRESS 0xFFF86D0E /end MEASUREMENT
/begin MEASUREMENT swi_komp_fehler_1_has_l2 "Schalter, um einen Komplementfehler zu provozieren" UWORD swi_int_S1_S7_S3 1 100 0 65535 ECU_ADDRESS 0xFFF867F8 /end MEASUREMENT
/begin MEASUREMENT swi_komp_fehler_2_has_l2 "Schalter, um einen Komplementfehler zu provozieren" UWORD swi_int_S1_S7_S3 1 100 0 65535 ECU_ADDRESS 0xFFF867FA /end MEASUREMENT
/begin MEASUREMENT t_m_err_nvmsoll_fl_has_l2 "Fehlerfilterungstimer fuer Momentenfehlerereignis (FPU-Pfad) [10 ms]" FLOAT32_IEEE void_fl_S1_S7_S3 1 100 -3.40282E+038 3.40282E+038 ECU_ADDRESS 0xFFF8637C /end MEASUREMENT
/begin MEASUREMENT t_m_err_nvmsoll_has_l2 "Fehlerfilterungstimer fuer Momentenfehlerereignis" UWORD t_int_S1_S7_S3 1 100 0 655.35 ECU_ADDRESS 0xFFF867B4 /end MEASUREMENT
/begin MEASUREMENT t_n_err_nvmsoll_fl_has_l2 "Fehlerfilterungstimer fuer Drehzahlplausifehlerereignis" FLOAT32_IEEE void_fl_S1_S7_S3 1 100 -3.40282E+038 3.40282E+038 ECU_ADDRESS 0xFFF86380 /end MEASUREMENT
/begin MEASUREMENT t_n_err_nvmsoll_has_l2 "Fehlerfilterungstimer fuer Drehzahlplausifehlerereignis" UWORD t_int_S1_S7_S3 1 100 0 655.35 ECU_ADDRESS 0xFFF867B6 /end MEASUREMENT
/begin MEASUREMENT t_sig_err_nvmsoll_fl_has_l2 "Fehlerfilterungstimer fuer Signalfehlerereignis (FPU-Pfad) [10 ms]" FLOAT32_IEEE void_fl_S1_S7_S3 1 100 -3.40282E+038 3.40282E+038 ECU_ADDRESS 0xFFF86384 /end MEASUREMENT
/begin MEASUREMENT t_sig_err_nvmsoll_has_l2 "Fehlerfilterungstimer fuer Signalfehlerereignis" UWORD t_int_S1_S7_S3 1 100 0 655.35 ECU_ADDRESS 0xFFF867B8 /end MEASUREMENT
/begin MEASUREMENT t_z_err_nvmsoll_fl_has_l2 "Fehlerfilterungstimer fuer Vorgabefehlerereignis (FPU-Pfad) [10 ms]" FLOAT32_IEEE void_fl_S1_S7_S3 1 100 -3.40282E+038 3.40282E+038 ECU_ADDRESS 0xFFF86388 /end MEASUREMENT
/begin MEASUREMENT t_z_err_nvmsoll_has_l2 "Fehlerfilterungstimer fuer Vorgabefehlerereignis" UWORD t_int_S1_S7_S3 1 100 0 655.35 ECU_ADDRESS 0xFFF867BA /end MEASUREMENT
/begin MEASUREMENT z_pos_fl_has_l2 "aktuelle Stellung des Positionshebels" FLOAT32_IEEE sts_fl_S1_S7_S3 1 100 -3.40282E+038 3.40282E+038 ECU_ADDRESS 0xFFF86474 /end MEASUREMENT
/begin MEASUREMENT z_pos_has_l2 "aktuelle Stellung des Positionshebels" UBYTE sts_int_S1_S7_S3 1 100 0 255 ECU_ADDRESS 0xFFF86D0F /end MEASUREMENT
/begin COMPU_METHOD _CNV_R_R_Umr_1_zu_1_0_CM_S2 "" RAT_FUNC "%6.3" "hPa" COEFFS 0 1 0 0 0 1 /end COMPU_METHOD
/begin COMPU_METHOD _CNV_R_R_Umr_1_zu_1_1_CM_S2 "" RAT_FUNC "%6.3" "°C" COEFFS 0 1 0 0 0 1 /end COMPU_METHOD
/begin COMPU_METHOD _CNV_R_R_Umr_1_zu_1_2_CM_S2 "" RAT_FUNC "%6.3" "" COEFFS 0 1 0 0 0 1 /end COMPU_METHOD
/begin COMPU_METHOD _CNV_R_R_Umr_1_zu_1_3_CM_S2 "" RAT_FUNC "%6.3" "U/min" COEFFS 0 1 0 0 0 1 /end COMPU_METHOD
/begin COMPU_METHOD _CNV_S_2_Schalter_A_4_CM_S2 "Schalter: 0 = AUS, 1 = EIN" TAB_VERB "%6.3" "" COMPU_TAB_REF _CNV_S_2_Schalter_A_4_S2 /end COMPU_METHOD
/begin COMPU_METHOD _CNV_R_R_Umr_1_zu_1_6_CM_S2 "" RAT_FUNC "%6.3" "ms" COEFFS 0 1 0 0 0 1 /end COMPU_METHOD
/begin COMPU_METHOD _CNV_R_R_Umr_1_zu_1_7_CM_S2 "" RAT_FUNC "%6.3" "%/s" COEFFS 0 1 0 0 0 1 /end COMPU_METHOD
/begin COMPU_METHOD _CNV_R_R_Umr_1_zu_1_8_CM_S2 "" RAT_FUNC "%6.3" "km/h" COEFFS 0 1 0 0 0 1 /end COMPU_METHOD
/begin COMPU_METHOD _CNV_R_R_Umr_10_zu__9_CM_S2 "" RAT_FUNC "%6.3" "%" COEFFS 0 10 0 0 0 1 /end COMPU_METHOD
/begin COMPU_METHOD _CNV_R_R_Umr_10_zu__10_CM_S2 "" RAT_FUNC "%6.3" "°" COEFFS 0 10 0 0 0 1 /end COMPU_METHOD
/begin COMPU_METHOD _CNV_S_6_Enum_EDL_11_CM_S2 "" TAB_VERB "%6.3" "" COMPU_TAB_REF _CNV_S_6_Enum_EDL_11_S2 /end COMPU_METHOD
/begin COMPU_METHOD _CNV_R_R_Umr_1000_z_12_CM_S2 "" RAT_FUNC "%6.3" "s" COEFFS 0 1000 0 0 0 1 /end COMPU_METHOD
/begin COMPU_METHOD _CNV_S_32_Enum_EEXCF_15_CM_S2 "" TAB_VERB "%6.3" "" COMPU_TAB_REF _CNV_S_32_Enum_EEXCF_15_S2 /end COMPU_METHOD
/begin COMPU_METHOD _CNV_S_15_Enum_EHSUR_17_CM_S2 "" TAB_VERB "%6.3" "" COMPU_TAB_REF _CNV_S_15_Enum_EHSUR_17_S2 /end COMPU_METHOD
/begin COMPU_METHOD _CNV_S_4_Enum_EAGS__24_CM_S2 "" TAB_VERB "%6.3" "" COMPU_TAB_REF _CNV_S_4_Enum_EAGS__24_S2 /end COMPU_METHOD
/begin COMPU_METHOD _CNV_S_2_Enum_EAGS_25_CM_S2 "" TAB_VERB "%6.3" "" COMPU_TAB_REF _CNV_S_2_Enum_EAGS_25_S2 /end COMPU_METHOD
/begin COMPU_METHOD _CNV_S_5_Enum_EBRS__26_CM_S2 "" TAB_VERB "%6.3" "" COMPU_TAB_REF _CNV_S_5_Enum_EBRS__26_S2 /end COMPU_METHOD
/begin COMPU_METHOD _CNV_S_5_Enum_ZDRIV_27_CM_S2 "" TAB_VERB "%6.3" "" COMPU_TAB_REF _CNV_S_5_Enum_ZDRIV_27_S2 /end COMPU_METHOD
/begin COMPU_METHOD _CNV_S_4_Enum_EFT_29_CM_S2 "" TAB_VERB "%6.3" "" COMPU_TAB_REF _CNV_S_4_Enum_EFT_29_S2 /end COMPU_METHOD
/begin COMPU_METHOD _CNV_S_9_Enum_EGANG_30_CM_S2 "" TAB_VERB "%6.3" "" COMPU_TAB_REF _CNV_S_9_Enum_EGANG_30_S2 /end COMPU_METHOD
/begin COMPU_METHOD _CNV_S_100_Enum_EPRIS_34_CM_S2 "" TAB_VERB "%6.3" "" COMPU_TAB_REF _CNV_S_100_Enum_EPRIS_34_S2 /end COMPU_METHOD
/begin COMPU_METHOD _CNV_S_4_Enum_EPROG_35_CM_S2 "" TAB_VERB "%6.3" "" COMPU_TAB_REF _CNV_S_4_Enum_EPROG_35_S2 /end COMPU_METHOD
/begin COMPU_METHOD _CNV_S_3_Enum_EPROG_37_CM_S2 "" TAB_VERB "%6.3" "" COMPU_TAB_REF _CNV_S_3_Enum_EPROG_37_S2 /end COMPU_METHOD
/begin COMPU_METHOD _CNV_S_21_Enum_EPROG_40_CM_S2 "" TAB_VERB "%6.3" "" COMPU_TAB_REF _CNV_S_21_Enum_EPROG_40_S2 /end COMPU_METHOD
/begin COMPU_METHOD _CNV_S_3_Enum_ESCHL_41_CM_S2 "" TAB_VERB "%6.3" "" COMPU_TAB_REF _CNV_S_3_Enum_ESCHL_41_S2 /end COMPU_METHOD
/begin COMPU_METHOD _CNV_R_R_Umr_1_zu_1_42_CM_S2 "" RAT_FUNC "%6.3" "Nm" COEFFS 0 1 0 0 0 1 /end COMPU_METHOD
/begin COMPU_METHOD _CNV_S_4_Enum_EPOSA_43_CM_S2 "" TAB_VERB "%6.3" "" COMPU_TAB_REF _CNV_S_4_Enum_EPOSA_43_S2 /end COMPU_METHOD
/begin COMPU_METHOD _CNV_R_R_Umr_64_zu__44_CM_S2 "" RAT_FUNC "%6.3" "km/h" COEFFS 0 64 0 0 0 1 /end COMPU_METHOD
/begin COMPU_METHOD _CNV_R_R_Umr_10_zu__45_CM_S2 "" RAT_FUNC "%6.3" "" COEFFS 0 10 0 0 0 1 /end COMPU_METHOD
/begin COMPU_METHOD _CNV_R_R_Umr_10_zu__46_CM_S2 "" RAT_FUNC "%6.3" "m/s*s" COEFFS 0 10 0 0 0 1 /end COMPU_METHOD
/begin COMPU_METHOD _CNV_R_R_Umr_10_zu__47_CM_S2 "" RAT_FUNC "%6.3" "1/s*s" COEFFS 0 10 0 0 0 1 /end COMPU_METHOD
/begin COMPU_METHOD _CNV_S_4_Enum_EANTR_48_CM_S2 "" TAB_VERB "%6.3" "" COMPU_TAB_REF _CNV_S_4_Enum_EANTR_48_S2 /end COMPU_METHOD
/begin COMPU_METHOD _CNV_S_4_Enum_EBREM_49_CM_S2 "" TAB_VERB "%6.3" "" COMPU_TAB_REF _CNV_S_4_Enum_EBREM_49_S2 /end COMPU_METHOD
/begin COMPU_METHOD _CNV_S_3_Enum_EDSCM_50_CM_S2 "" TAB_VERB "%6.3" "" COMPU_TAB_REF _CNV_S_3_Enum_EDSCM_50_S2 /end COMPU_METHOD
/begin COMPU_METHOD _CNV_S_4_Enum_EET_M_51_CM_S2 "" TAB_VERB "%6.3" "" COMPU_TAB_REF _CNV_S_4_Enum_EET_M_51_S2 /end COMPU_METHOD
/begin COMPU_METHOD _CNV_S_2_Enum_EBABE_52_CM_S2 "" TAB_VERB "%6.3" "" COMPU_TAB_REF _CNV_S_2_Enum_EBABE_52_S2 /end COMPU_METHOD
/begin COMPU_METHOD _CNV_R_R_Umr_1_zu_1_53_CM_S2 "" RAT_FUNC "%6.3" "%" COEFFS 0 1 0 0 0 1 /end COMPU_METHOD
/begin COMPU_METHOD _CNV_R_R_Umr_100_zu_54_CM_S2 "" RAT_FUNC "%6.3" "" COEFFS 0 100 0 0 0 1 /end COMPU_METHOD
/begin COMPU_METHOD _CNV_S_2_Enum_EBABA_60_CM_S2 "" TAB_VERB "%6.3" "" COMPU_TAB_REF _CNV_S_2_Enum_EBABA_60_S2 /end COMPU_METHOD
/begin COMPU_METHOD _CNV_S_6_Enum_EBERG_61_CM_S2 "" TAB_VERB "%6.3" "" COMPU_TAB_REF _CNV_S_6_Enum_EBERG_61_S2 /end COMPU_METHOD
/begin COMPU_METHOD _CNV_S_3_Enum_EHDM__62_CM_S2 "" TAB_VERB "%6.3" "" COMPU_TAB_REF _CNV_S_3_Enum_EHDM__62_S2 /end COMPU_METHOD
/begin COMPU_METHOD _CNV_S_4_Enum_EDSCB_63_CM_S2 "" TAB_VERB "%6.3" "" COMPU_TAB_REF _CNV_S_4_Enum_EDSCB_63_S2 /end COMPU_METHOD
/begin COMPU_METHOD _CNV_R_R_Umr_10_zu__64_CM_S2 "" RAT_FUNC "%6.3" "U/min" COEFFS 0 10 0 0 0 1 /end COMPU_METHOD
/begin COMPU_METHOD _CNV_S_3_Enum_EANH_65_CM_S2 "" TAB_VERB "%6.3" "" COMPU_TAB_REF _CNV_S_3_Enum_EANH_65_S2 /end COMPU_METHOD
/begin COMPU_METHOD _CNV_S_4_Enum_EDSCA_66_CM_S2 "" TAB_VERB "%6.3" "" COMPU_TAB_REF _CNV_S_4_Enum_EDSCA_66_S2 /end COMPU_METHOD
/begin COMPU_METHOD _CNV_S_5_Enum_EFT2_67_CM_S2 "" TAB_VERB "%6.3" "" COMPU_TAB_REF _CNV_S_5_Enum_EFT2_67_S2 /end COMPU_METHOD
/begin COMPU_METHOD _CNV_R_R_Umr_1_zu_1_69_CM_S2 "" RAT_FUNC "%6.3" "%" COEFFS 0 1 0 0 0 10 /end COMPU_METHOD
/begin COMPU_METHOD _CNV_S_4_Enum_EPROG_70_CM_S2 "" TAB_VERB "%6.3" "" COMPU_TAB_REF _CNV_S_4_Enum_EPROG_70_S2 /end COMPU_METHOD
/begin COMPU_METHOD _CNV_R_R_Umr_1_zu_1_82_CM_S2 "" RAT_FUNC "%6.3" "ms" COEFFS 0 1 0 0 0 10 /end COMPU_METHOD
/begin COMPU_METHOD _CNV_S_4_Enum_ESIGN_83_CM_S2 "" TAB_VERB "%6.3" "" COMPU_TAB_REF _CNV_S_4_Enum_ESIGN_83_S2 /end COMPU_METHOD
/begin COMPU_METHOD _CNV_S_3_Enum_ESIGN_84_CM_S2 "" TAB_VERB "%6.3" "" COMPU_TAB_REF _CNV_S_3_Enum_ESIGN_84_S2 /end COMPU_METHOD
/begin COMPU_METHOD _CNV_S_3_Enum_ERRDS_86_CM_S2 "" TAB_VERB "%6.3" "" COMPU_TAB_REF _CNV_S_3_Enum_ERRDS_86_S2 /end COMPU_METHOD
/begin COMPU_METHOD _CNV_R_R_Umr_1_zu_5_87_CM_S2 "" RAT_FUNC "%6.3" "U/min" COEFFS 0 1 0 0 0 50 /end COMPU_METHOD
/begin COMPU_METHOD _CNV_S_16_Enum_EPROG_94_CM_S2 "" TAB_VERB "%6.3" "" COMPU_TAB_REF _CNV_S_16_Enum_EPROG_94_S2 /end COMPU_METHOD
/begin COMPU_METHOD _CNV_S_3_ENUM_GANGP_95_CM_S2 "String Beschreibung fuer den Schalter XZ_GANG_POS_PR. Der erlaubt feste Gangvorgabe in Waehlhebelposition P und R.\\r\\n0: Uebernahme Z_GANG_SOLL_AGS, 1: GANG1, 2: GANG2," TAB_VERB "%6.3" "" COMPU_TAB_REF _CNV_S_3_ENUM_GANGP_95_S2 /end COMPU_METHOD
/begin COMPU_METHOD _CNV_S_2_Enum_MFRSK_96_CM_S2 "" TAB_VERB "%6.3" "" COMPU_TAB_REF _CNV_S_2_Enum_MFRSK_96_S2 /end COMPU_METHOD
/begin COMPU_METHOD _CNV_S_3_Enum_EPMA_98_CM_S2 "" TAB_VERB "%6.3" "" COMPU_TAB_REF _CNV_S_3_Enum_EPMA_98_S2 /end COMPU_METHOD
/begin COMPU_METHOD _CNV_S_22_Enum_EGLBE_99_CM_S2 "" TAB_VERB "%6.3" "" COMPU_TAB_REF _CNV_S_22_Enum_EGLBE_99_S2 /end COMPU_METHOD
/begin COMPU_METHOD _CNV_S_9_Enum_EADDF_100_CM_S2 "" TAB_VERB "%6.3" "" COMPU_TAB_REF _CNV_S_9_Enum_EADDF_100_S2 /end COMPU_METHOD
/begin COMPU_METHOD _CNV_S_15_Enum_EKOPF_102_CM_S2 "" TAB_VERB "%6.3" "" COMPU_TAB_REF _CNV_S_15_Enum_EKOPF_102_S2 /end COMPU_METHOD
/begin COMPU_METHOD _CNV_S_4_Enum_EPOWE_103_CM_S2 "" TAB_VERB "%6.3" "" COMPU_TAB_REF _CNV_S_4_Enum_EPOWE_103_S2 /end COMPU_METHOD
/begin COMPU_METHOD _CNV_R_R_Umr_100_zu_104_CM_S2 "" RAT_FUNC "%6.3" "%" COEFFS 0 100 0 0 0 1 /end COMPU_METHOD
/begin COMPU_METHOD SAB_V_32KMH25_S2_S3 "int = ((phys * 25) / 32) - (0) km/h" RAT_FUNC "%5.3" "km/h" COEFFS 0 25 -0 0 0 32 /end COMPU_METHOD
/begin COMPU_METHOD SAB_V_KMH256_S2_S3 "int = ((phys * 256) / 1) - (0) km/h" RAT_FUNC "%5.3" "km/h" COEFFS 0 256 -0 0 0 1 /end COMPU_METHOD
/begin COMPU_METHOD SAB_V_KMH128_S2_S3 "int = ((phys * 128) / 1) - (0) km/h" RAT_FUNC "%5.3" "km/h" COEFFS 0 128 -0 0 0 1 /end COMPU_METHOD
/begin COMPU_METHOD SAB_V_KMH2_S2_S3 "int = ((phys * 2) / 1) - (0) km/h" RAT_FUNC "%5.3" "km/h" COEFFS 0 2 -0 0 0 1 /end COMPU_METHOD
/begin COMPU_METHOD SAB_V_KMH50_S2_S3 "int = ((phys * 50) / 1) - (0) km/h" RAT_FUNC "%5.3" "km/h" COEFFS 0 50 -0 0 0 1 /end COMPU_METHOD
/begin COMPU_METHOD SAB_V_32KMH100_S2_S3 "int = ((phys * 100) / 32) - (0) km/h" RAT_FUNC "%5.3" "km/h" COEFFS 0 100 -0 0 0 32 /end COMPU_METHOD
/begin COMPU_METHOD SAB_V_KMH16_M125_S2_S3 "int = ((phys * 16) / 1) - (-125) km/h" RAT_FUNC "%5.3" "km/h" COEFFS 0 16 125 0 0 1 /end COMPU_METHOD
/begin COMPU_METHOD SAB_VG_KMH100_S2_S3 "int = ((phys * 100) / 1) - (0) km/h/Task" RAT_FUNC "%5.3" "km/h/Task" COEFFS 0 100 -0 0 0 1 /end COMPU_METHOD
/begin COMPU_METHOD SAB_V_75KMH10000_S2_S3 "int = ((phys * 10000) / 75) - (0) km/h" RAT_FUNC "%5.3" "km/h" COEFFS 0 10000 -0 0 0 75 /end COMPU_METHOD
/begin COMPU_METHOD SAB_K1_M2000_S2_S3 "int = ((phys * 1) / 1) - (2000) year" RAT_FUNC "%2.0" "year" COEFFS 0 1 -2000 0 0 1 /end COMPU_METHOD
/begin COMPU_METHOD SAB_T_YR_P2000_S2_S3 "int = ((phys * 1) / 1) - (2000) year" RAT_FUNC "%2.0" "year" COEFFS 0 1 -2000 0 0 1 /end COMPU_METHOD
/begin COMPU_METHOD SAB_MONTH_S2_S3 "int = ((phys * 1) / 1) - (0) month" RAT_FUNC "%2.0" "month" COEFFS 0 1 -0 0 0 1 /end COMPU_METHOD
/begin COMPU_METHOD SAB_T_MON_S2_S3 "int = ((phys * 1) / 1) - (0) month" RAT_FUNC "%2.0" "month" COEFFS 0 1 -0 0 0 1 /end COMPU_METHOD
/begin COMPU_METHOD SAB_DAY_S2_S3 "int = ((phys * 1) / 1) - (0) day" RAT_FUNC "%2.0" "day" COEFFS 0 1 -0 0 0 1 /end COMPU_METHOD
/begin COMPU_METHOD SAB_T_DY_S2_S3 "int = ((phys * 1) / 1) - (0) day" RAT_FUNC "%2.0" "day" COEFFS 0 1 -0 0 0 1 /end COMPU_METHOD
/begin COMPU_METHOD SAB_HOUR_S2_S3 "int = ((phys * 1) / 1) - (0) hour" RAT_FUNC "%2.0" "hour" COEFFS 0 1 -0 0 0 1 /end COMPU_METHOD
/begin COMPU_METHOD SAB_T_HR_S2_S3 "int = ((phys * 1) / 1) - (0) hour" RAT_FUNC "%2.0" "hour" COEFFS 0 1 -0 0 0 1 /end COMPU_METHOD
/begin COMPU_METHOD SAB_MINUTE_S2_S3 "int = ((phys * 1) / 1) - (0) minute" RAT_FUNC "%2.0" "minute" COEFFS 0 1 -0 0 0 1 /end COMPU_METHOD
/begin COMPU_METHOD SAB_SECOND_S2_S3 "int = ((phys * 1) / 1) - (0) second" RAT_FUNC "%2.0" "second" COEFFS 0 1 -0 0 0 1 /end COMPU_METHOD
/begin COMPU_METHOD SAB_INC_M2000_S2_S3 "int = ((phys * 1) / 1) - (-2000) -" RAT_FUNC "%2.0" "-" COEFFS 0 1 2000 0 0 1 /end COMPU_METHOD
/begin COMPU_METHOD SAB_K1024_S2_S3 "int = ((phys * 1024) / 1) - (0) -" RAT_FUNC "%7.5" "-" COEFFS 0 1024 -0 0 0 1 /end COMPU_METHOD
/begin COMPU_METHOD SAB_K100000_S2_S3 "int = ((phys * 100000) / 1) - (0) -" RAT_FUNC "%8.6" "-" COEFFS 0 100000 -0 0 0 1 /end COMPU_METHOD
/begin COMPU_METHOD SAB_K1000000_S2_S3 "int = ((phys * 1.0E6) / 1) - (0) -" RAT_FUNC "%8.6" "-" COEFFS 0 1000000 -0 0 0 1 /end COMPU_METHOD
/begin COMPU_METHOD SAB_K10000_S2_S3 "int = ((phys * 10000) / 1) - (0) -" RAT_FUNC "%6.4" "-" COEFFS 0 10000 -0 0 0 1 /end COMPU_METHOD
/begin COMPU_METHOD SAB_245K10000_S2_S3 "int = ((phys * 10000) / 245) - (0) -" RAT_FUNC "%6.4" "-" COEFFS 0 10000 -0 0 0 245 /end COMPU_METHOD
/begin COMPU_METHOD SAB_4K1000_S2_S3 "int = ((phys * 1000) / 4) - (0) -" RAT_FUNC "%5.3" "-" COEFFS 0 1000 -0 0 0 4 /end COMPU_METHOD
/begin COMPU_METHOD SAB_125K1000_S2_S3 "int = ((phys * 1000) / 125) - (0) -" RAT_FUNC "%5.3" "-" COEFFS 0 1000 -0 0 0 125 /end COMPU_METHOD
/begin COMPU_METHOD SAB_K125_S2_S3 "int = ((phys * 125) / 1) - (0) -" RAT_FUNC "%5.3" "-" COEFFS 0 125 -0 0 0 1 /end COMPU_METHOD
/begin COMPU_METHOD SAB_K100_KOMP_S2_S3 "int = ((phys * 100) / 1) - (0) -" RAT_FUNC "%5.3" "-" COEFFS 0 100 -0 0 0 1 /end COMPU_METHOD
/begin COMPU_METHOD SAB_K8_S2_S3 "int = ((phys * 8) / 1) - (0) -" RAT_FUNC "%5.3" "-" COEFFS 0 8 -0 0 0 1 /end COMPU_METHOD
/begin COMPU_METHOD SAB_K5_S2_S3 "int = ((phys * 5) / 1) - (0) -" RAT_FUNC "%5.3" "-" COEFFS 0 5 -0 0 0 1 /end COMPU_METHOD
/begin COMPU_METHOD SAB_K128_S2_S3 "int = ((phys * 128) / 1) - (0) -" RAT_FUNC "%5.3" "-" COEFFS 0 128 -0 0 0 1 /end COMPU_METHOD
/begin COMPU_METHOD SAB_78K10000_S2_S3 "int = ((phys * 10000) / 78) - (0) -" RAT_FUNC "%7.5" "-" COEFFS 0 10000 -0 0 0 78 /end COMPU_METHOD
/begin COMPU_METHOD SAB_3_M40_S2_S3 "int = ((phys * 1) / 3) - (-13.3333333333333) none" RAT_FUNC "%2.0" "none" COEFFS 0 1 40 0 0 3 /end COMPU_METHOD
/begin COMPU_METHOD SAB_KM_10_S2_S3 "int = ((phys * 1) / 10) - (0) km" RAT_FUNC "%5.3" "km" COEFFS 0 1 -0 0 0 10 /end COMPU_METHOD
/begin COMPU_METHOD SAB_S_DISTSENS_256MM_S2_S3 "int = ((phys * 256) / 1) - (0) mm" RAT_FUNC "%5.3" "mm" COEFFS 0 256 -0 0 0 1 /end COMPU_METHOD
/begin COMPU_METHOD SAB_NG_100RPM_S2_S3 "int = ((phys * 1) / 100) - (0) 100rpm/sec" RAT_FUNC "%5.3" "100rpm/sec" COEFFS 0 1 -0 0 0 100 /end COMPU_METHOD
/begin COMPU_METHOD SAB_A_981G10000_M127_S2_S3 "int = ((phys * 1.0E6) / 981) - (-1295) g" RAT_FUNC "%8.6" "g" COEFFS 0 1000000 1270395 0 0 981 /end COMPU_METHOD
/begin COMPU_METHOD SAB_A_1G100_M127_S2_S3 "int = ((phys * 100) / 1) - (-127) g" RAT_FUNC "%5.3" "g" COEFFS 0 100 127 0 0 1 /end COMPU_METHOD
/begin COMPU_METHOD SAB_P_BAR_S2_S3 "int = ((phys * 1) / 1) - (0) bar" RAT_FUNC "%2.0" "bar" COEFFS 0 1 -0 0 0 1 /end COMPU_METHOD
/begin COMPU_METHOD SAB_P_BAR10_S2_S3 "int = ((phys * 10) / 1) - (0) bar" RAT_FUNC "%5.3" "bar" COEFFS 0 10 -0 0 0 1 /end COMPU_METHOD
/begin COMPU_METHOD SAB_P_BAR100_S2_S3 "int = ((phys * 100) / 1) - (0) bar" RAT_FUNC "%8.6" "bar" COEFFS 0 100 -0 0 0 1 /end COMPU_METHOD
/begin COMPU_METHOD SAB_P_BAR1024_S2_S3 "int = ((phys * 1024) / 1) - (0) bar" RAT_FUNC "%8.6" "bar" COEFFS 0 1024 -0 0 0 1 /end COMPU_METHOD
/begin COMPU_METHOD SAB_25PROZENTPS_S2_S3 "int = ((phys * 1) / 25) - (0) %/s" RAT_FUNC "%5.3" "%/s" COEFFS 0 1 -0 0 0 25 /end COMPU_METHOD
/begin COMPU_METHOD SAB_PROZENTPS_S2_S3 "int = ((phys * 1) / 1) - (0) %/s" RAT_FUNC "%2.0" "%/s" COEFFS 0 1 -0 0 0 1 /end COMPU_METHOD
/begin COMPU_METHOD SAB_PROZENTPS2_S2_S3 "int = ((phys * 2) / 1) - (0) %/s" RAT_FUNC "%5.3" "%/s" COEFFS 0 2 -0 0 0 1 /end COMPU_METHOD
/begin COMPU_METHOD SAB_N_25RPM_S2_S3 "int = ((phys * 1) / 25) - (0) 1/min" RAT_FUNC "%5.3" "1/min" COEFFS 0 1 -0 0 0 25 /end COMPU_METHOD
/begin COMPU_METHOD SAB_N_64RPM_S2_S3 "int = ((phys * 1) / 64) - (0) 1/min" RAT_FUNC "%5.3" "1/min" COEFFS 0 1 -0 0 0 64 /end COMPU_METHOD
/begin COMPU_METHOD SAB_N_100RPM_S2_S3 "int = ((phys * 1) / 100) - (0) 1/min" RAT_FUNC "%5.3" "1/min" COEFFS 0 1 -0 0 0 100 /end COMPU_METHOD
/begin COMPU_METHOD SAB_N_25RPM_P2000_S2_S3 "int = ((phys * 1) / 25) - (80) 1/min" RAT_FUNC "%5.3" "1/min" COEFFS 0 1 -2000 0 0 25 /end COMPU_METHOD
/begin COMPU_METHOD SAB_N_25RPM_P750_S2_S3 "int = ((phys * 1) / 25) - (30) 1/min" RAT_FUNC "%5.3" "1/min" COEFFS 0 1 -750 0 0 25 /end COMPU_METHOD
/begin COMPU_METHOD SAB_N_294118RPM10000_S2_S3 "int = ((phys * 10000) / 294118) - (0) 1/min" RAT_FUNC "%5.3" "1/min" COEFFS 0 10000 -0 0 0 294118 /end COMPU_METHOD
/begin COMPU_METHOD SAB_I_1A_S2_S3 "int = ((phys * 1) / 1) - (0) A" RAT_FUNC "%2.0" "A" COEFFS 0 1 -0 0 0 1 /end COMPU_METHOD
/begin COMPU_METHOD SAB_I_A10_S2_S3 "int = ((phys * 10) / 1) - (0) i" RAT_FUNC "%5.3" "i" COEFFS 0 10 -0 0 0 1 /end COMPU_METHOD
/begin COMPU_METHOD SAB_I_10A1000_S2_S3 "int = ((phys * 1000) / 10) - (0) A" RAT_FUNC "%5.3" "A" COEFFS 0 1000 -0 0 0 10 /end COMPU_METHOD
/begin COMPU_METHOD SAB_100APS_S2_S3 "int = ((phys * 100) / 1) - (0) A/s" RAT_FUNC "%5.3" "A/s" COEFFS 0 100 -0 0 0 1 /end COMPU_METHOD
/begin COMPU_METHOD SAB_T_10MS_P440_S2_S3 "int = ((phys * 1) / 10) - (44) ms" RAT_FUNC "%2.0" "ms" COEFFS 0 1 -440 0 0 10 /end COMPU_METHOD
/begin COMPU_METHOD SAB_T_30MS_S2_S3 "int = ((phys * 1) / 30) - (0) ms" RAT_FUNC "%5.3" "ms" COEFFS 0 1 -0 0 0 30 /end COMPU_METHOD
/begin COMPU_METHOD SAB_T_40MS_S2_S3 "int = ((phys * 1) / 40) - (0) ms" RAT_FUNC "%5.3" "ms" COEFFS 0 1 -0 0 0 40 /end COMPU_METHOD
/begin COMPU_METHOD SAB_T_100MS_S2_S3 "int = ((phys * 1) / 100) - (0) ms" RAT_FUNC "%5.3" "ms" COEFFS 0 1 -0 0 0 100 /end COMPU_METHOD
/begin COMPU_METHOD SAB_T_MS10_S2_S3 "int = ((phys * 10) / 1) - (0) ms" RAT_FUNC "%5.3" "ms" COEFFS 0 10 -0 0 0 1 /end COMPU_METHOD
/begin COMPU_METHOD SAB_T_MS1000_S2_S3 "int = ((phys * 1000) / 1) - (0) ms" RAT_FUNC "%5.3" "ms" COEFFS 0 1000 -0 0 0 1 /end COMPU_METHOD
/begin COMPU_METHOD SAB_T_MIN60_S2_S3 "int = ((phys * 60) / 1) - (0) min" RAT_FUNC "%5.3" "min" COEFFS 0 60 -0 0 0 1 /end COMPU_METHOD
/begin COMPU_METHOD SAB_T_MIN600_S2_S3 "int = ((phys * 600) / 1) - (0) min" RAT_FUNC "%5.3" "min" COEFFS 0 600 -0 0 0 1 /end COMPU_METHOD
/begin COMPU_METHOD SAB_T_H4_S2_S3 "int = ((phys * 4) / 1) - (0) h" RAT_FUNC "%5.3" "h" COEFFS 0 4 -0 0 0 1 /end COMPU_METHOD
/begin COMPU_METHOD SAB_T_1Y_S2_S3 "int = ((phys * 1) / 1) - (0) year" RAT_FUNC "%2.0" "year" COEFFS 0 1 -0 0 0 1 /end COMPU_METHOD
/begin COMPU_METHOD SAB_T_1M_S2_S3 "int = ((phys * 1) / 1) - (0) month" RAT_FUNC "%2.0" "month" COEFFS 0 1 -0 0 0 1 /end COMPU_METHOD
/begin COMPU_METHOD SAB_T_1D_S2_S3 "int = ((phys * 1) / 1) - (0) day" RAT_FUNC "%2.0" "day" COEFFS 0 1 -0 0 0 1 /end COMPU_METHOD
/begin COMPU_METHOD b_fl_S1_S7_S3 "Bit Feld" RAT_FUNC "%12.6" "-" COEFFS 0 1 0 0 0 1 /end COMPU_METHOD
/begin COMPU_METHOD b_int_S1_S7_S3 "Bit Feld" RAT_FUNC "%3.0" "-" COEFFS 0 1 0 0 0 1 /end COMPU_METHOD
/begin COMPU_METHOD n_fl_S1_S7_S3 "Drehzahl" RAT_FUNC "%12.6" "1/min" COEFFS 0 1 0 0 0 1 /end COMPU_METHOD
/begin COMPU_METHOD n_int_S1_S7_S3 "Drehzahl" RAT_FUNC "%5.0" "1/min" COEFFS 0 1 0 0 0 1 /end COMPU_METHOD
/begin COMPU_METHOD n_int_a_S1_S7_S3 "Drehzahl" RAT_FUNC "%3.0" "1/min" COEFFS 0 1 0 0 0 1 /end COMPU_METHOD
/begin COMPU_METHOD ratio_fl_S1_S7_S3 "Uebersetzungsverhaeltnis" RAT_FUNC "%12.6" "-" COEFFS 0 1 0 0 0 1 /end COMPU_METHOD
/begin COMPU_METHOD ratio_int_S1_S7_S3 "Uebersetzungsverhaeltnis" RAT_FUNC "%6.3" "-" COEFFS 0 1 0 0 0 0.001 /end COMPU_METHOD
/begin COMPU_METHOD sts_fl_S1_S7_S3 "Status" RAT_FUNC "%12.6" "-" COEFFS 0 1 0 0 0 1 /end COMPU_METHOD
/begin COMPU_METHOD sts_int_S1_S7_S3 "Status" RAT_FUNC "%3.0" "-" COEFFS 0 1 0 0 0 1 /end COMPU_METHOD
/begin COMPU_METHOD swi_int_S1_S7_S3 "Schalter" RAT_FUNC "%5.0" "-" COEFFS 0 1 0 0 0 1 /end COMPU_METHOD
/begin COMPU_METHOD swi_int_b_S1_S7_S3 "Schalter" RAT_FUNC "%3.0" "-" COEFFS 0 1 0 0 0 1 /end COMPU_METHOD
/begin COMPU_METHOD t_int_S1_S7_S3 "Zeit" RAT_FUNC "%6.2" "s" COEFFS 0 1 0 0 0 0.01 /end COMPU_METHOD
/begin COMPU_METHOD trq_fl_S1_S7_S3 "Moment" RAT_FUNC "%12.6" "Nm" COEFFS 0 1 0 0 0 1 /end COMPU_METHOD
/begin COMPU_METHOD trq_int_S1_S7_S3 "Moment" RAT_FUNC "%5.0" "Nm" COEFFS 0 1 0 0 0 1 /end COMPU_METHOD
/begin COMPU_METHOD trqg_int_S1_S7_S3 "Momentengradient" RAT_FUNC "%5.0" "Nm/s" COEFFS 0 1 0 0 0 1 /end COMPU_METHOD
/begin COMPU_METHOD void_fl_S1_S7_S3 "ohne Umrechnung" RAT_FUNC "%12.6" "-" COEFFS 0 1 0 0 0 1 /end COMPU_METHOD
/begin COMPU_VTAB _CNV_S_2_Schalter_A_4_S2 "Schalter: 0 = AUS, 1 = EIN" TAB_VERB 2 0 "AUS" 1 "EIN" /end COMPU_VTAB
/begin COMPU_VTAB _CNV_S_6_Enum_EDL_11_S2 "" TAB_VERB 6 1 "DL_1" 2 "DL_2" 3 "DL_3" 4 "DL_4" 5 "DL_5" 6 "DL_6" /end COMPU_VTAB
/begin COMPU_VTAB _CNV_S_32_Enum_EEXCF_15_S2 "" TAB_VERB 32 0 "XE_FKT" 1 "E_FKT" 2 "S_FKT" 3 "XS_FKT" 4 "STEPTR" 5 "TID" 6 "DL_2" 7 "DL_3" 8 "DL_4" 9 "DL_5" 10 "DL_6" 11 "FAS" 12 "HDC" 13 "DPF_REG" 14 "TMS" 15 "WL1" 16 "WL2" 17 "HOTMODE" 18 "BERG_A1" 19 "BERG_A2" 20 "BERG_A3" 21 "BERG_A4" 22 "BERG_A5" 23 "MUELOW" 24 "LM" 25 "EFAHREN_1" 26 "EFAHREN_2" 27 "EFAHREN_3" 28 "EFAHREN_4" 29 "EFAHREN_HYB" 30 "FREI_1" 31 "FREI_2" /end COMPU_VTAB
/begin COMPU_VTAB _CNV_S_15_Enum_EHSUR_17_S2 "" TAB_VERB 15 0 "HSURE_VOR" 1 "HSURE_FOF" 2 "HSURE_INSTAT" 3 "HSURE_BRS" 4 "HSURE_NL" 5 "HSURE_BAB" 6 "HSURE_KUVORHALT" 7 "HSURE_KU" 8 "HSURE_RS" 9 "HSURE_HS" 10 "HSURE_ADAPT" 11 "HSURE_NABNEGATIV" 12 "HSURE_SCHLUPF" 13 "HSURE_COS" 14 "HSURE_NSC" /end COMPU_VTAB
/begin COMPU_VTAB _CNV_S_4_Enum_EAGS__24_S2 "" TAB_VERB 4 0 "A_AGS" 1 "S_AGS" 2 "ECO" 3 "E_FAHREN" /end COMPU_VTAB
/begin COMPU_VTAB _CNV_S_2_Enum_EAGS_25_S2 "" TAB_VERB 2 0 "A_AGS" 1 "S_AGS" /end COMPU_VTAB
/begin COMPU_VTAB _CNV_S_5_Enum_EBRS__26_S2 "" TAB_VERB 5 0 "BRS_IDX_1" 1 "BRS_IDX_2" 2 "BRS_IDX_3" 3 "BRS_IDX_4" 4 "BRS_IDX_5" /end COMPU_VTAB
/begin COMPU_VTAB _CNV_S_5_Enum_ZDRIV_27_S2 "" TAB_VERB 5 0 "D_DRIVE" 1 "S_DRIVE" 2 "M_DRIVE" 3 "TID_DRIVE" 4 "LMODE_DRIVE" /end COMPU_VTAB
/begin COMPU_VTAB _CNV_S_4_Enum_EFT_29_S2 "" TAB_VERB 4 0 "XE_FT" 1 "E_FT" 2 "S_FT" 3 "XS_FT" /end COMPU_VTAB
/begin COMPU_VTAB _CNV_S_9_Enum_EGANG_30_S2 "" TAB_VERB 9 0 "GANG_1" 1 "GANG_2" 2 "GANG_3" 3 "GANG_4" 4 "GANG_5" 5 "GANG_6" 6 "GANG_7" 7 "GANG_8" 8 "GANG_9" /end COMPU_VTAB
/begin COMPU_VTAB _CNV_S_100_Enum_EPRIS_34_S2 "" TAB_VERB 100 0 "PRISQ_1" 1 "PRISQ_2" 2 "PRISQ_3" 3 "PRISQ_4" 4 "PRISQ_5" 5 "PRISQ_6" 6 "PRISQ_7" 7 "PRISQ_8" 8 "PRISQ_9" 9 "PRISQ_10" 10 "PRISQ_11" 11 "PRISQ_12" 12 "PRISQ_13" 13 "PRISQ_14" 14 "PRISQ_15" 15 "PRISQ_16" 16 "PRISQ_17" 17 "PRISQ_18" 18 "PRISQ_19" 19 "PRISQ_20" 20 "PRISQ_21" 21 "PRISQ_22" 22 "PRISQ_23" 23 "PRISQ_24" 24 "PRISQ_25" 25 "PRISQ_26" 26 "PRISQ_27" 27 "PRISQ_28" 28 "PRISQ_29" 29 "PRISQ_30" 30 "PRISQ_31" 31 "PRISQ_32" 32 "PRISQ_33" 33 "PRISQ_34" 34 "PRISQ_35" 35 "PRISQ_36" 36 "PRISQ_37" 37 "PRISQ_38" 38 "PRISQ_39" 39 "PRISQ_40" 40 "PRISQ_41" 41 "PRISQ_42" 42 "PRISQ_43" 43 "PRISQ_44" 44 "PRISQ_45" 45 "PRISQ_46" 46 "PRISQ_47" 47 "PRISQ_48" 48 "PRISQ_49" 49 "PRISQ_50" 50 "PRISQ_51" 51 "PRISQ_52" 52 "PRISQ_53" 53 "PRISQ_54" 54 "PRISQ_55" 55 "PRISQ_56" 56 "PRISQ_57" 57 "PRISQ_58" 58 "PRISQ_59" 59 "PRISQ_60" 60 "PRISQ_61" 61 "PRISQ_62" 62 "PRISQ_63" 63 "PRISQ_64" 64 "PRISQ_65" 65 "PRISQ_66" 66 "PRISQ_67" 67 "PRISQ_68" 68 "PRISQ_69" 69 "PRISQ_70" 70 "PRISQ_71" 71 "PRISQ_72" 72 "PRISQ_73" 73 "PRISQ_74" 74 "PRISQ_75" 75 "PRISQ_76" 76 "PRISQ_77" 77 "PRISQ_78" 78 "PRISQ_79" 79 "PRISQ_80" 80 "PRISQ_81" 81 "PRISQ_82" 82 "PRISQ_83" 83 "PRISQ_84" 84 "PRISQ_85" 85 "PRISQ_86" 86 "PRISQ_87" 87 "PRISQ_88" 88 "PRISQ_89" 89 "PRISQ_90" 90 "PRISQ_91" 91 "PRISQ_92" 92 "PRISQ_93" 93 "PRISQ_94" 94 "PRISQ_95" 95 "PRISQ_96" 96 "PRISQ_97" 97 "PRISQ_98" 98 "PRISQ_99" 99 "PRISQ_100" /end COMPU_VTAB
/begin COMPU_VTAB _CNV_S_4_Enum_EPROG_35_S2 "" TAB_VERB 4 0 "NORMAL_MODE" 1 "SPORT_MODE" 2 "STEPTRONIC_MODE" 3 "L_MODE" /end COMPU_VTAB
/begin COMPU_VTAB _CNV_S_3_Enum_EPROG_37_S2 "" TAB_VERB 3 0 "NORMAL_MODE_BRS" 1 "SPORT_MODE_BRS" 2 "E_FAHREN_BRS" /end COMPU_VTAB
/begin COMPU_VTAB _CNV_S_21_Enum_EPROG_40_S2 "" TAB_VERB 21 0 "EXTREME_ECONOMY_PROG" 1 "ECONOMY_PROG" 2 "SPORT_PROG" 3 "EXTREME_SPORT_PROG" 4 "A1_PROG" 5 "A2_PROG" 6 "A3_PROG" 7 "A4_PROG" 8 "A5_PROG" 9 "SA1_PROG" 10 "SA2_PROG" 11 "SA3_PROG" 12 "SA4_PROG" 13 "WL1_PROG" 14 "WL2_PROG" 15 "ECO_PROG" 16 "ECOA1_PROG" 17 "ECOA2_PROG" 18 "ECOWL2_PROG" 19 "SO1_PROG" 20 "SO2_PROG" /end COMPU_VTAB
/begin COMPU_VTAB _CNV_S_3_Enum_ESCHL_41_S2 "" TAB_VERB 3 0 "HAFT_REIBUNG" 1 "ZUG_SCHLUPF" 2 "SCHUB_SCHLUPF" /end COMPU_VTAB
/begin COMPU_VTAB _CNV_S_4_Enum_EPOSA_43_S2 "" TAB_VERB 4 0 "POS_D" 1 "POS_N" 2 "POS_R" 3 "POS_P" /end COMPU_VTAB
/begin COMPU_VTAB _CNV_S_4_Enum_EANTR_48_S2 "" TAB_VERB 4 0 "ANTRIEB_KEINE_MUELOW" 1 "ANTRIEB_STANDARD_MUELOW" 2 "ANTRIEB_ALLRAD_MUELOW" 3 "ANTRIEB_BEIDE_MUELOW" /end COMPU_VTAB
/begin COMPU_VTAB _CNV_S_4_Enum_EBREM_49_S2 "" TAB_VERB 4 0 "BREMSBED_KEINE_MUELOW" 1 "BREMSBED_B_MUELOW" 2 "BREMSBED_FML_MUELOW" 3 "BREMSBED_B_FML_MUELOW" /end COMPU_VTAB
/begin COMPU_VTAB _CNV_S_3_Enum_EDSCM_50_S2 "" TAB_VERB 3 0 "DSC_NOT_USED" 1 "BEI_DSC_PASSIV" 2 "BEI_DTC_ODER_DSC_PASSIVE" /end COMPU_VTAB
/begin COMPU_VTAB _CNV_S_4_Enum_EET_M_51_S2 "" TAB_VERB 4 0 "ET_AUS_MUELOW" 1 "ET_NUR_1_MUELOW" 2 "ET_NUR_2_MUELOW" 3 "ET_1_ODER_2_MUELOW" /end COMPU_VTAB
/begin COMPU_VTAB _CNV_S_2_Enum_EBABE_52_S2 "" TAB_VERB 2 0 "Grundschwelle_EINSTIEG" 1 "Grundschwelle_AUSSTIEG" /end COMPU_VTAB
/begin COMPU_VTAB _CNV_S_2_Enum_EBABA_60_S2 "" TAB_VERB 2 0 "W_STEIGUNG_FILT" 1 "W_STEIGUNG_FILT_SLOW" /end COMPU_VTAB
/begin COMPU_VTAB _CNV_S_6_Enum_EBERG_61_S2 "" TAB_VERB 6 0 "BERGANH_OFF" 1 "BERGANH_A1" 2 "BERGANH_A2" 3 "BERGANH_A3" 4 "BERGANH_A4" 5 "BERGANH_A5" /end COMPU_VTAB
/begin COMPU_VTAB _CNV_S_3_Enum_EHDM__62_S2 "" TAB_VERB 3 0 "XHDM_AB_FWSDOWN" 1 "XHDM_AB_FWSZW_HS" 2 "XHDM_AB_FWSUP" /end COMPU_VTAB
/begin COMPU_VTAB _CNV_S_4_Enum_EDSCB_63_S2 "" TAB_VERB 4 0 "ALLE_DSC_STAT" 1 "NUR_DSC_ACTIVE" 2 "DSC_ACTIVE_ODER_DTC_ACTIVE" 3 "DTC_ACTIVE_ODER_DSC_PASSIVE" /end COMPU_VTAB
/begin COMPU_VTAB _CNV_S_3_Enum_EANH_65_S2 "" TAB_VERB 3 0 "KEIN_ANHAENGER" 1 "ANHAENGER" 2 "ANHAENGER_ODER_KEIN_ANHAENGER" /end COMPU_VTAB
/begin COMPU_VTAB _CNV_S_4_Enum_EDSCA_66_S2 "" TAB_VERB 4 0 "DSC_STAT_ALLE" 1 "DSC_PASSIV" 2 "DTC_ACTIV" 3 "DTC_ACTIV_ODER_DSC_PASSIV" /end COMPU_VTAB
/begin COMPU_VTAB _CNV_S_5_Enum_EFT2_67_S2 "" TAB_VERB 5 0 "XXE_FT" 1 "XE_FT" 2 "E_FT" 3 "S_FT" 4 "XS_FT" /end COMPU_VTAB
/begin COMPU_VTAB _CNV_S_4_Enum_EPROG_70_S2 "" TAB_VERB 4 0 "EXTREME_ECONOMY_PROG" 1 "ECONOMY_PROG" 2 "SPORT_PROG" 3 "EXTREME_SPORT_PROG" /end COMPU_VTAB
/begin COMPU_VTAB _CNV_S_4_Enum_ESIGN_83_S2 "" TAB_VERB 4 0 "SIGNAL_AUS" 1 "SIGNAL_EIN" 2 "SIGNAL_UEBERNAHME" 3 "SIGNAL_PLAUSI" /end COMPU_VTAB
/begin COMPU_VTAB _CNV_S_3_Enum_ESIGN_84_S2 "" TAB_VERB 3 0 "SIGNAL_AUS" 1 "SIGNAL_EIN" 2 "SIGNAL_UEBERNAHME" /end COMPU_VTAB
/begin COMPU_VTAB _CNV_S_3_Enum_ERRDS_86_S2 "" TAB_VERB 3 0 "ABS_DSC_Ok" 1 "ABS_DSC_ERR_RolleCAN_False" 2 "ABS_DSC_ERR_RolleCAN_True" /end COMPU_VTAB
/begin COMPU_VTAB _CNV_S_16_Enum_EPROG_94_S2 "" TAB_VERB 16 0 "DS2_XE" 1 "DS2_E" 2 "DS2_S" 3 "DS2_XS" 4 "DS2_A1" 5 "DS2_A2" 6 "DS2_A3" 7 "DS2_A4" 8 "DS2_STEPTR" 9 "DS2_SO" 10 "DS2_B0" 11 "DS2_LM" 12 "DS2_WL" 13 "DS2_LD" 14 "DS2_LDM" 15 "DS2_A5" /end COMPU_VTAB
/begin COMPU_VTAB _CNV_S_3_ENUM_GANGP_95_S2 "String Beschreibung fuer den Schalter XZ_GANG_POS_PR. Der erlaubt feste Gangvorgabe in Waehlhebelposition P und R.\\r\\n0: Uebernahme Z_GANG_SOLL_AGS, 1: GANG1, 2: GANG2," TAB_VERB 3 0 "Uebernahme Z_GANG_SOLL_AGS" 1 "GANG_1" 2 "GANG_2" /end COMPU_VTAB
/begin COMPU_VTAB _CNV_S_2_Enum_MFRSK_96_S2 "" TAB_VERB 2 1 "TEMP_KUP_A (max. 2-fach RS)" 2 "TEMP_KUP_A (keine direkte MRS)" /end COMPU_VTAB
/begin COMPU_VTAB _CNV_S_3_Enum_EPMA_98_S2 "" TAB_VERB 3 0 "KEINE_PMA_VORGABE" 1 "PMA_GANG_1" 2 "PMA_GANG_2" /end COMPU_VTAB
/begin COMPU_VTAB _CNV_S_22_Enum_EGLBE_99_S2 "" TAB_VERB 22 0 "MIN_EXC" 1 "MAX_EXC" 2 "MIN_RFWS" 3 "MAX_RFWS" 4 "MIN_TUMGPLUFT" 5 "MIN_DPFREG" 6 "MIN_AEP" 7 "MIN_HOTMODE" 8 "MIN_MOTSOLLLL" 9 "MIN_CGT" 10 "MAX_EMHIGH" 11 "MAX_EMLOW" 12 "MAX_TMS" 13 "MAX_HOTMODE" 14 "MIN_ARSDYN" 15 "MAX_ECO" 16 "MAX_DYNSPV" 17 "MIN_REKUPRS" 18 "MARS_DBM" 19 "K0_DBM" 20 "MIN_AFU" 21 "MIN_FES" /end COMPU_VTAB
/begin COMPU_VTAB _CNV_S_9_Enum_EADDF_100_S2 "" TAB_VERB 9 0 "QSHIFT" 1 "NIC" 2 "HSEARLIER" 3 "HSLATER" 4 "WKZUSCHALT" 5 "GWK_FDYN" 6 "DYN_WKANB" 7 "WKMAX" 8 "SEGELN" /end COMPU_VTAB
/begin COMPU_VTAB _CNV_S_15_Enum_EKOPF_102_S2 "" TAB_VERB 15 0 "BAB" 1 "BGR_WHL" 2 "MAB" 3 "STOPGO" 4 "BRS" 5 "ANF_GANG2FL" 6 "ANF_GANG2" 7 "ZRS_GANG1" 8 "RSU_BGH" 9 "ZRS_GANG1EXT" 10 "RSU_MUELOW" 11 "DMRS" 12 "DERS" 13 "DERS_COS" 14 "BRS_COS" /end COMPU_VTAB
/begin COMPU_VTAB _CNV_S_4_Enum_EPOWE_103_S2 "" TAB_VERB 4 0 "PS_FREI" 1 "PS_KOMFORT" 2 "PS_SPORT" 3 "PS_SPORT_PLUS" /end COMPU_VTAB
/begin FUNCTION Run_UL2_NVMSOLL ""
 /begin DEF_CHARACTERISTIC KL_MS_NVMSOLLLOWRANGE_HAS_L2_Y KL_MS_NVMSOLLLOWRANGE_HAS_L2_X KL_MS_NVMSOLL_HAS_L2_Y KL_MS_NVMSOLL_HAS_L2_X KL_MS_VM_NVMSOLLLOWRANGE_HAS_L2_Y KL_MS_VM_NVMSOLLLOWRANGE_HAS_L2_X KL_MS_VM_NVMSOLL_HAS_L2_Y KL_MS_VM_NVMSOLL_HAS_L2_X I_FIX_ERSATZ_NVMSOLL_HAS_L2 MG_MMOTSOLLNEG_NVMSOLL_HAS_L2 MS_MOTSOLL_NVMSOLL_HAS_L2 NS_EM_ERSATZ_NVMSOLL_HAS_L2 NS_EM_NVMSOLL_HAS_L2 NS_NVMSOLL_HAS_L2 NS_VMMIN_NVMSOLL_HAS_L2 SWI_EXTDEAK_NVMSOLL_HAS_L2 SWI_MOD_NVMSOLL_HAS_L2 SWI_MOTVERLUST_NVMSOLL_HAS_L2 SWI_NVMSOLL_HAS_L2 SWI_SIGSTS_NVMSOLL_HAS_L2 T_NVMSOLL_HAS_L2 /end DEF_CHARACTERISTIC
 /begin LOC_MEASUREMENT f_akt_err_nvmsoll_fl_has_l2 f_akt_err_nvmsoll_has_l2 f_fallback_next_check_allowed_nvmsoll_fl_has_l2 f_fallback_next_check_allowed_nvmsoll_has_l2 f_m_akt_err_nvmsoll_fl_has_l2 f_m_akt_err_nvmsoll_has_l2 f_m_err_nvmsoll_fl_has_l2 f_m_err_nvmsoll_has_l2 f_n_akt_err_nvmsoll_fl_has_l2 f_n_akt_err_nvmsoll_has_l2 f_n_err_nvmsoll_fl_has_l2 f_n_err_nvmsoll_has_l2 f_next_check_allowed_nvmsoll_fl_has_l2 f_next_check_allowed_nvmsoll_has_l2 f_sig_akt_err_nvmsoll_fl_has_l2 f_sig_akt_err_nvmsoll_has_l2 f_sig_err_nvmsoll_fl_has_l2 f_sig_err_nvmsoll_has_l2 f_z_akt_err_nvmsoll_fl_has_l2 f_z_akt_err_nvmsoll_has_l2 f_z_err_nvmsoll_fl_has_l2 f_z_err_nvmsoll_has_l2 i_dyn_nvmsoll_fl_has_l2 i_dyn_nvmsoll_has_l2 m_motsoll_filt_nvmsoll_fl_has_l2 m_motsoll_filt_nvmsoll_has_l2 m_verlust_nvmsoll_fl_has_l2 m_verlust_nvmsoll_has_l2 mo_mered_nvmsoll_fl_has_l2 mo_mered_nvmsoll_has_l2 n_ist_em_ersatz_nvmsoll_fl_has_l2 n_ist_em_ersatz_nvmsoll_has_l2 t_m_err_nvmsoll_fl_has_l2 t_m_err_nvmsoll_has_l2 t_n_err_nvmsoll_fl_has_l2 t_n_err_nvmsoll_has_l2 t_sig_err_nvmsoll_fl_has_l2 t_sig_err_nvmsoll_has_l2 t_z_err_nvmsoll_fl_has_l2 t_z_err_nvmsoll_has_l2 /end LOC_MEASUREMENT
/end FUNCTION
/begin FUNCTION Run_UL2_UeberwachungL2 ""
 /begin DEF_CHARACTERISTIC SWI_KOMP_FEHLER_1_HAS_L2 SWI_KOMP_FEHLER_2_HAS_L2 SWI_PAK_FEHLER_HAS_L2 /end DEF_CHARACTERISTIC
 /begin LOC_MEASUREMENT iv_f_extdeak_fl_has_l2 iv_f_extdeak_has_l2 iv_i_gang_fl_has_l2 iv_i_gang_has_l2 iv_m_ist_em_fl_has_l2 iv_m_ist_em_has_l2 iv_m_ist_vm_fl_has_l2 iv_m_ist_vm_has_l2 iv_m_me_red_fl_has_l2 iv_m_me_red_has_l2 iv_m_motmax_fl_has_l2 iv_m_motmax_has_l2 iv_m_motsoll_fl_has_l2 iv_m_motsoll_has_l2 iv_m_motverlust_fl_has_l2 iv_m_motverlust_has_l2 iv_n_ist_ab_fl_has_l2 iv_n_ist_ab_has_l2 iv_n_ist_em_fl_has_l2 iv_n_ist_em_has_l2 iv_n_ist_tu_fl_has_l2 iv_n_ist_tu_has_l2 iv_n_ist_vm_fl_has_l2 iv_n_ist_vm_has_l2 iv_n_mot_idle_tar_fl_has_l2 iv_n_mot_idle_tar_has_l2 iv_n_mot_llsoll_8bit_fl_has_l2 iv_n_mot_llsoll_8bit_has_l2 iv_n_soll_em_fl_has_l2 iv_n_soll_em_has_l2 iv_n_soll_vm_fl_has_l2 iv_n_soll_vm_has_l2 iv_st_hilorange_fl_has_l2 iv_st_hilorange_has_l2 iv_st_m_ist_em_fl_has_l2 iv_st_m_ist_em_has_l2 iv_st_m_ist_vm_fl_has_l2 iv_st_m_ist_vm_has_l2 iv_st_m_me_red_fl_has_l2 iv_st_m_me_red_has_l2 iv_st_m_motsoll_fl_has_l2 iv_st_m_motsoll_has_l2 iv_st_n_ist_ab_fl_has_l2 iv_st_n_ist_ab_has_l2 iv_st_n_ist_em_fl_has_l2 iv_st_n_ist_em_has_l2 iv_st_n_ist_tu_fl_has_l2 iv_st_n_ist_tu_has_l2 iv_st_n_ist_vm_fl_has_l2 iv_st_n_ist_vm_has_l2 iv_st_n_soll_em_fl_has_l2 iv_st_n_soll_em_has_l2 iv_st_n_soll_vm_fl_has_l2 iv_st_n_soll_vm_has_l2 iv_status_kraftschluss_fl_has_l2 iv_status_kraftschluss_has_l2 iv_z_pos_fl_has_l2 iv_z_pos_has_l2 f_extdeak_fl_has_l2 f_extdeak_has_l2 i_gang_fl_has_l2 i_gang_has_l2 m_ist_em_fl_has_l2 m_ist_em_has_l2 m_ist_vm_fl_has_l2 m_ist_vm_has_l2 m_me_red_fl_has_l2 m_me_red_has_l2 m_motmax_fl_has_l2 m_motmax_has_l2 m_motsoll_fl_has_l2 m_motsoll_has_l2 m_motverlust_fl_has_l2 m_motverlust_has_l2 n_ist_ab_fl_has_l2 n_ist_ab_has_l2 n_ist_em_fl_has_l2 n_ist_em_has_l2 n_ist_tu_fl_has_l2 n_ist_tu_has_l2 n_ist_vm_fl_has_l2 n_ist_vm_has_l2 n_mot_idle_tar_fl_has_l2 n_mot_idle_tar_has_l2 n_mot_llsoll_fl_has_l2 n_mot_llsoll_has_l2 n_mot_llsoll_8bit_fl_has_l2 n_mot_llsoll_8bit_has_l2 n_soll_em_fl_has_l2 n_soll_em_has_l2 n_soll_vm_fl_has_l2 n_soll_vm_has_l2 st_hilorange_fl_has_l2 st_hilorange_has_l2 st_m_ist_em_fl_has_l2 st_m_ist_em_has_l2 st_m_ist_vm_fl_has_l2 st_m_ist_vm_has_l2 st_m_me_red_fl_has_l2 st_m_me_red_has_l2 st_m_motsoll_fl_has_l2 st_m_motsoll_has_l2 st_n_ist_ab_fl_has_l2 st_n_ist_ab_has_l2 st_n_ist_em_fl_has_l2 st_n_ist_em_has_l2 st_n_ist_tu_fl_has_l2 st_n_ist_tu_has_l2 st_n_ist_vm_fl_has_l2 st_n_ist_vm_has_l2 st_n_soll_em_fl_has_l2 st_n_soll_em_has_l2 st_n_soll_vm_fl_has_l2 st_n_soll_vm_has_l2 status_kraftschluss_fl_has_l2 status_kraftschluss_has_l2 z_pos_fl_has_l2 z_pos_has_l2 swi_komp_fehler_1_has_l2 swi_komp_fehler_2_has_l2 /end LOC_MEASUREMENT
/end FUNCTION
/begin RECORD_LAYOUT _REC_S7CUR_53_s2_u2_S2 FNC_VALUES 3 SWORD COLUMN_DIR DIRECT AXIS_PTS_X 2 UWORD INDEX_INCR DIRECT NO_AXIS_PTS_X 1 UBYTE /end RECORD_LAYOUT
/begin RECORD_LAYOUT _REC_S1VAL_1_s2_S2 FNC_VALUES 1 SWORD COLUMN_DIR DIRECT /end RECORD_LAYOUT
/begin RECORD_LAYOUT _REC_S1VAL_1_u2_S2 FNC_VALUES 1 UWORD COLUMN_DIR DIRECT /end RECORD_LAYOUT
/begin RECORD_LAYOUT _REC_S1VAL_1_u1_S2 FNC_VALUES 1 UBYTE COLUMN_DIR DIRECT /end RECORD_LAYOUT
/begin RECORD_LAYOUT _REC_S1VAL_1_u4_S2 FNC_VALUES 1 ULONG COLUMN_DIR DIRECT /end RECORD_LAYOUT
/begin RECORD_LAYOUT _REC_S7CUR_53_u2_s2_S2 FNC_VALUES 3 UWORD COLUMN_DIR DIRECT AXIS_PTS_X 2 SWORD INDEX_INCR DIRECT NO_AXIS_PTS_X 1 UBYTE /end RECORD_LAYOUT
/begin RECORD_LAYOUT _REC_S7MAP_53_u2_s2_u2_S2 FNC_VALUES 5 UWORD COLUMN_DIR DIRECT AXIS_PTS_X 3 SWORD INDEX_INCR DIRECT AXIS_PTS_Y 4 UWORD INDEX_INCR DIRECT NO_AXIS_PTS_X 1 UBYTE NO_AXIS_PTS_Y 2 UBYTE /end RECORD_LAYOUT
/begin RECORD_LAYOUT _REC_A1MAP_9_u2_u1_u1_S2 FNC_VALUES 1 UWORD COLUMN_DIR DIRECT /end RECORD_LAYOUT
/begin RECORD_LAYOUT _REC_S7CUR_53_s2_s2_S2 FNC_VALUES 3 SWORD COLUMN_DIR DIRECT AXIS_PTS_X 2 SWORD INDEX_INCR DIRECT NO_AXIS_PTS_X 1 UBYTE /end RECORD_LAYOUT
/begin RECORD_LAYOUT _REC_S7MAP_53_s2_s2_s2_S2 FNC_VALUES 5 SWORD COLUMN_DIR DIRECT AXIS_PTS_X 3 SWORD INDEX_INCR DIRECT AXIS_PTS_Y 4 SWORD INDEX_INCR DIRECT NO_AXIS_PTS_X 1 UBYTE NO_AXIS_PTS_Y 2 UBYTE /end RECORD_LAYOUT
/begin RECORD_LAYOUT _REC_A1CUR_30_u1_u1_S2 FNC_VALUES 1 UBYTE COLUMN_DIR DIRECT /end RECORD_LAYOUT
/begin RECORD_LAYOUT _REC_S7MAP_53_s2_s2_u2_S2 FNC_VALUES 5 SWORD COLUMN_DIR DIRECT AXIS_PTS_X 3 SWORD INDEX_INCR DIRECT AXIS_PTS_Y 4 UWORD INDEX_INCR DIRECT NO_AXIS_PTS_X 1 UBYTE NO_AXIS_PTS_Y 2 UBYTE /end RECORD_LAYOUT
/begin RECORD_LAYOUT _REC_A1CUR_30_u4_u1_S2 FNC_VALUES 1 ULONG COLUMN_DIR DIRECT /end RECORD_LAYOUT
/begin RECORD_LAYOUT _REC_S3MAP_54_s2_u2_u1_S2 FNC_VALUES 3 SWORD ROW_DIR DIRECT AXIS_PTS_X 2 UWORD INDEX_INCR DIRECT NO_AXIS_PTS_X 1 UBYTE /end RECORD_LAYOUT
/begin RECORD_LAYOUT _REC_S7CUR_53_u2_u2_S2 FNC_VALUES 3 UWORD COLUMN_DIR DIRECT AXIS_PTS_X 2 UWORD INDEX_INCR DIRECT NO_AXIS_PTS_X 1 UBYTE /end RECORD_LAYOUT
/begin RECORD_LAYOUT _REC_S3MAP_54_u2_s2_u1_S2 FNC_VALUES 3 UWORD ROW_DIR DIRECT AXIS_PTS_X 2 SWORD INDEX_INCR DIRECT NO_AXIS_PTS_X 1 UBYTE /end RECORD_LAYOUT
/begin RECORD_LAYOUT _REC_A1MAP_9_s2_u1_u1_S2 FNC_VALUES 1 SWORD COLUMN_DIR DIRECT /end RECORD_LAYOUT
/begin RECORD_LAYOUT _REC_A1CUR_30_u2_u1_S2 FNC_VALUES 1 UWORD COLUMN_DIR DIRECT /end RECORD_LAYOUT
/begin RECORD_LAYOUT _REC_A1MAP_9_u1_u1_u1_S2 FNC_VALUES 1 UBYTE COLUMN_DIR DIRECT /end RECORD_LAYOUT
/begin RECORD_LAYOUT _REC_A1CUR_30_s2_u1_S2 FNC_VALUES 1 SWORD COLUMN_DIR DIRECT /end RECORD_LAYOUT
/begin RECORD_LAYOUT _REC_S2AXS_51_u2_S2 AXIS_PTS_X 2 UWORD INDEX_INCR DIRECT NO_AXIS_PTS_X 1 UWORD /end RECORD_LAYOUT
/begin RECORD_LAYOUT _REC_A1CUR_1_u2_u2_S2 FNC_VALUES 1 UWORD COLUMN_DIR DIRECT /end RECORD_LAYOUT
/begin RECORD_LAYOUT _REC_S3MAP_54_s2_s2_u1_S2 FNC_VALUES 3 SWORD ROW_DIR DIRECT AXIS_PTS_X 2 SWORD INDEX_INCR DIRECT NO_AXIS_PTS_X 1 UBYTE /end RECORD_LAYOUT
/begin RECORD_LAYOUT _REC_A1MAP_8_s2_u1_u1_S2 FNC_VALUES 1 SWORD ROW_DIR DIRECT /end RECORD_LAYOUT
/begin RECORD_LAYOUT _REC_A1MAP_8_u1_u2_u1_S2 FNC_VALUES 1 UBYTE ROW_DIR DIRECT /end RECORD_LAYOUT
/begin RECORD_LAYOUT _REC_A1CUR_30_u1_u2_S2 FNC_VALUES 1 UBYTE COLUMN_DIR DIRECT /end RECORD_LAYOUT
/begin RECORD_LAYOUT _REC_S3MAP_54_u2_u2_u2_S2 FNC_VALUES 3 UWORD ROW_DIR DIRECT AXIS_PTS_X 2 UWORD INDEX_INCR DIRECT NO_AXIS_PTS_X 1 UBYTE /end RECORD_LAYOUT
/begin RECORD_LAYOUT _REC_S7MAP_53_u2_u2_u2_S2 FNC_VALUES 5 UWORD COLUMN_DIR DIRECT AXIS_PTS_X 3 UWORD INDEX_INCR DIRECT AXIS_PTS_Y 4 UWORD INDEX_INCR DIRECT NO_AXIS_PTS_X 1 UBYTE NO_AXIS_PTS_Y 2 UBYTE /end RECORD_LAYOUT
/begin RECORD_LAYOUT _REC_A2AXS_31_u2_S2 AXIS_PTS_X 2 UWORD INDEX_INCR DIRECT NO_AXIS_PTS_X 1 UWORD /end RECORD_LAYOUT
/begin RECORD_LAYOUT SWORD_COL_DIRECT_S1_S7_S3 FNC_VALUES 1 SWORD COLUMN_DIR DIRECT /end RECORD_LAYOUT
/begin RECORD_LAYOUT UBYTE_COL_DIRECT_S1_S7_S3 FNC_VALUES 1 UBYTE COLUMN_DIR DIRECT /end RECORD_LAYOUT
/begin RECORD_LAYOUT UWORD_COL_DIRECT_S1_S7_S3 FNC_VALUES 1 UWORD COLUMN_DIR DIRECT /end RECORD_LAYOUT
/begin RECORD_LAYOUT UWORD_X_INCR_DIRECT_S1_S7_S3 AXIS_PTS_X 1 UWORD INDEX_INCR DIRECT /end RECORD_LAYOUT
/end MODULE
/end PROJECT
