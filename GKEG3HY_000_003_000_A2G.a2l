ASAP2_VERSION 1 51
/begin PROJECT _929_929 "Gen2_BMW_System_Supplier_Lib"
/begin HEADER "" VERSION "C_03_03" PROJECT_NO _929_929 /end HEADER
/begin MODULE DIM ""
/begin MOD_COMMON "" BYTE_ORDER MSB_FIRST ALIGNMENT_BYTE 1 ALIGNMENT_WORD 2 ALIGNMENT_LONG 4 ALIGNMENT_FLOAT32_IEEE 4 /end MOD_COMMON
/begin CHARACTERISTIC XTAB6X4Z_KF_FP_1 "" MAP 0x26F2B4 _REC_A1MAP_9_u1_u1_u1_S2 2 _CNV_R_R_Umr_1_zu_1_2_CM_S2 0 2 FORMAT "%2.0"
 /begin AXIS_DESCR FIX_AXIS Z_DRIVELOGIC _CNV_S_6_Enum_EDL_11_CM_S2 6 1 6 FIX_AXIS_PAR_DIST 1 1 6 READ_ONLY /end AXIS_DESCR
 /begin AXIS_DESCR FIX_AXIS Z_PROG_MODE _CNV_S_4_Enum_EPROG_35_CM_S2 4 0 3 FIX_AXIS_PAR_DIST 0 1 4 READ_ONLY /end AXIS_DESCR
/end CHARACTERISTIC
/begin CHARACTERISTIC XTAB8X32Z_SDYN_EXCFKTFFG "" MAP 0x271268 _REC_A1MAP_8_u1_u2_u2_S2 1 _CNV_R_R_Umr_1_zu_1_2_CM_S2 0 1 FORMAT "%2.0"
 /begin AXIS_DESCR FIX_AXIS NO_INPUT_QUANTITY _CNV_S_32_Enum_EEXCF_15_CM_S2 32 0 31 FIX_AXIS_PAR_DIST 0 1 32 READ_ONLY /end AXIS_DESCR
 /begin AXIS_DESCR FIX_AXIS NO_INPUT_QUANTITY _CNV_S_8_Enum_EEXCF_223_CM_S2 8 0 7 FIX_AXIS_PAR_DIST 0 1 8 READ_ONLY /end AXIS_DESCR
/end CHARACTERISTIC
/begin CHARACTERISTIC XTAB9X2N_T_WKANBIND_0 "" MAP 0x26F2CC _REC_A1MAP_9_u2_u1_u1_S2 15000 _CNV_R_R_Umr_1_zu_1_3_CM_S2 0 15000 FORMAT "%2.0"
 /begin AXIS_DESCR FIX_AXIS Z_WKSOLL_IDX _CNV_S_2_Enum_EWKAN_217_CM_S2 2 0 1 FIX_AXIS_PAR_DIST 0 1 2 READ_ONLY /end AXIS_DESCR
 /begin AXIS_DESCR FIX_AXIS Z_GANG_IST _CNV_S_9_Enum_EGANG_30_CM_S2 9 0 8 FIX_AXIS_PAR_DIST 0 1 9 READ_ONLY /end AXIS_DESCR
/end CHARACTERISTIC
/begin CHARACTERISTIC XTAB9X2N_T_WKANBIND_1 "" MAP 0x26F2F0 _REC_A1MAP_9_u2_u1_u1_S2 15000 _CNV_R_R_Umr_1_zu_1_3_CM_S2 0 15000 FORMAT "%2.0"
 /begin AXIS_DESCR FIX_AXIS Z_WKSOLL_IDX _CNV_S_2_Enum_EWKAN_217_CM_S2 2 0 1 FIX_AXIS_PAR_DIST 0 1 2 READ_ONLY /end AXIS_DESCR
 /begin AXIS_DESCR FIX_AXIS Z_GANG_IST _CNV_S_9_Enum_EGANG_30_CM_S2 9 0 8 FIX_AXIS_PAR_DIST 0 1 9 READ_ONLY /end AXIS_DESCR
/end CHARACTERISTIC
/begin CHARACTERISTIC XTAB9X2N_T_WKANBIND_2 "" MAP 0x26F314 _REC_A1MAP_9_u2_u1_u1_S2 15000 _CNV_R_R_Umr_1_zu_1_3_CM_S2 0 15000 FORMAT "%2.0"
 /begin AXIS_DESCR FIX_AXIS Z_WKSOLL_IDX _CNV_S_2_Enum_EWKAN_217_CM_S2 2 0 1 FIX_AXIS_PAR_DIST 0 1 2 READ_ONLY /end AXIS_DESCR
 /begin AXIS_DESCR FIX_AXIS Z_GANG_IST _CNV_S_9_Enum_EGANG_30_CM_S2 9 0 8 FIX_AXIS_PAR_DIST 0 1 9 READ_ONLY /end AXIS_DESCR
/end CHARACTERISTIC
/begin CHARACTERISTIC XTAB9X2N_T_WKANBIND_3 "" MAP 0x26F338 _REC_A1MAP_9_u2_u1_u1_S2 15000 _CNV_R_R_Umr_1_zu_1_3_CM_S2 0 15000 FORMAT "%2.0"
 /begin AXIS_DESCR FIX_AXIS Z_WKSOLL_IDX _CNV_S_2_Enum_EWKAN_217_CM_S2 2 0 1 FIX_AXIS_PAR_DIST 0 1 2 READ_ONLY /end AXIS_DESCR
 /begin AXIS_DESCR FIX_AXIS Z_GANG_IST _CNV_S_9_Enum_EGANG_30_CM_S2 9 0 8 FIX_AXIS_PAR_DIST 0 1 9 READ_ONLY /end AXIS_DESCR
/end CHARACTERISTIC
/begin CHARACTERISTIC XTAB9X2N_T_WKANBIND_4 "" MAP 0x26F35C _REC_A1MAP_9_u2_u1_u1_S2 15000 _CNV_R_R_Umr_1_zu_1_3_CM_S2 0 15000 FORMAT "%2.0"
 /begin AXIS_DESCR FIX_AXIS Z_WKSOLL_IDX _CNV_S_2_Enum_EWKAN_217_CM_S2 2 0 1 FIX_AXIS_PAR_DIST 0 1 2 READ_ONLY /end AXIS_DESCR
 /begin AXIS_DESCR FIX_AXIS Z_GANG_IST _CNV_S_9_Enum_EGANG_30_CM_S2 9 0 8 FIX_AXIS_PAR_DIST 0 1 9 READ_ONLY /end AXIS_DESCR
/end CHARACTERISTIC
/begin CHARACTERISTIC XTAB9X2N_T_WKANBIND_5 "" MAP 0x26F380 _REC_A1MAP_9_u2_u1_u1_S2 15000 _CNV_R_R_Umr_1_zu_1_3_CM_S2 0 15000 FORMAT "%2.0"
 /begin AXIS_DESCR FIX_AXIS Z_WKSOLL_IDX _CNV_S_2_Enum_EWKAN_217_CM_S2 2 0 1 FIX_AXIS_PAR_DIST 0 1 2 READ_ONLY /end AXIS_DESCR
 /begin AXIS_DESCR FIX_AXIS Z_GANG_IST _CNV_S_9_Enum_EGANG_30_CM_S2 9 0 8 FIX_AXIS_PAR_DIST 0 1 9 READ_ONLY /end AXIS_DESCR
/end CHARACTERISTIC
/begin CHARACTERISTIC XHN_T_WKANBIND "" VALUE 0x274EC8 _REC_S1VAL_1_u2_S2 8160 _CNV_R_R_Umr_1_zu_1_3_CM_S2 0 8160 FORMAT "%2.0" /end CHARACTERISTIC
/begin CHARACTERISTIC XSCHN_AB_QSHIFT "" VALUE 0x274E84 _REC_S1VAL_1_u2_S2 20000 _CNV_R_R_Umr_1_zu_1_3_CM_S2 0 20000 FORMAT "%2.0" /end CHARACTERISTIC
/begin CHARACTERISTIC XSCHTEMP_GETR_DYNAMIKZYK "" VALUE 0x274E86 _REC_S1VAL_1_s2_S2 400 _CNV_R_R_Umr_1_zu_1_1_CM_S2 -200 200 FORMAT "%2.0" /end CHARACTERISTIC
/begin CHARACTERISTIC XSCHV_FZG_DYNAMIKZYK "" VALUE 0x274E88 _REC_S1VAL_1_u2_S2 400 _CNV_R_R_Umr_1_zu_1_8_CM_S2 0 400 FORMAT "%2.0" /end CHARACTERISTIC
/begin CHARACTERISTIC XSCHW_DKKD_DYNAMIKZYK "" VALUE 0x274E8A _REC_S1VAL_1_u2_S2 110 _CNV_R_R_Umr_10_zu__9_CM_S2 0 110 FORMAT "%3.1" /end CHARACTERISTIC
/begin CHARACTERISTIC XSCHW_DKKD_QSHIFT "" VALUE 0x274E8C _REC_S1VAL_1_u2_S2 110 _CNV_R_R_Umr_10_zu__9_CM_S2 0 110 FORMAT "%3.1" /end CHARACTERISTIC
/begin CHARACTERISTIC XSCHW_DKKD_SDYNNULLAST "" VALUE 0x276172 _REC_S1VAL_1_u2_S2 110 _CNV_R_R_Umr_10_zu__9_CM_S2 0 110 FORMAT "%3.1" /end CHARACTERISTIC
/begin CHARACTERISTIC XS_DYN_RS_PME_ENBL "" VALUE 0x27AE67 _REC_S1VAL_1_u1_S2 1 _CNV_S_2_Schalter_A_4_CM_S2 0 1 /end CHARACTERISTIC
/begin CHARACTERISTIC XS_RS_AUSROLL_EFAHR "" VALUE 0x27AE6E _REC_S1VAL_1_u1_S2 1 _CNV_R_R_Umr_1_zu_1_2_CM_S2 0 1 FORMAT "%2.0" /end CHARACTERISTIC
/begin CHARACTERISTIC XS_SDYN_MINQSMODE_MARS "" VALUE 0x27B4D4 _REC_S1VAL_1_u1_S2 1 _CNV_S_2_Schalter_A_4_CM_S2 0 1 /end CHARACTERISTIC
/begin CHARACTERISTIC XS_USE_DYNAMIKIDX_DKG "" VALUE 0x27B4D5 _REC_S1VAL_1_u1_S2 1 _CNV_S_2_Schalter_A_4_CM_S2 0 1 /end CHARACTERISTIC
/begin CHARACTERISTIC XS_USE_DYNAMIKZYK_WL2 "" VALUE 0x27AE68 _REC_S1VAL_1_u1_S2 1 _CNV_R_R_Umr_1_zu_1_2_CM_S2 0 1 FORMAT "%2.0" /end CHARACTERISTIC
/begin CHARACTERISTIC XS_USE_GANG_GANGWECHSEL_FLM "" VALUE 0x27AE69 _REC_S1VAL_1_u1_S2 1 _CNV_R_R_Umr_1_zu_1_2_CM_S2 0 1 FORMAT "%2.0" /end CHARACTERISTIC
/begin CHARACTERISTIC XS_USE_SCHALTDYN_FREEZE "" VALUE 0x27AE6F _REC_S1VAL_1_u1_S2 1 _CNV_S_2_Schalter_A_4_CM_S2 0 1 /end CHARACTERISTIC
/begin CHARACTERISTIC XS_Z_DYNAMIK_IDXGRBDYN "" VALUE 0x27AE70 _REC_S1VAL_1_u1_S2 1 _CNV_S_2_Schalter_A_4_CM_S2 0 1 /end CHARACTERISTIC
/begin CHARACTERISTIC XT_DYNAMIKZYK "" VALUE 0x274E8E _REC_S1VAL_1_u2_S2 65535 _CNV_R_R_Umr_1_zu_1_146_CM_S2 0 65535 FORMAT "%2.0" /end CHARACTERISTIC
/begin CHARACTERISTIC XT_NACHLAUF_QS3 "" VALUE 0x274E90 _REC_S1VAL_1_u2_S2 1024 _CNV_R_R_Umr_1_zu_1_146_CM_S2 0 1024 FORMAT "%2.0" /end CHARACTERISTIC
/begin CHARACTERISTIC XT_QSHIFTMFRS_WAIT "" VALUE 0x27139C _REC_S1VAL_1_u4_S2 2.14748E+009 _CNV_R_R_Umr_1_zu_1_6_CM_S2 0 2147483647 FORMAT "%2.0" /end CHARACTERISTIC
/begin CHARACTERISTIC XZ_ANZAHL_QS3 "" VALUE 0x276170 _REC_S1VAL_1_u2_S2 1024 _CNV_R_R_Umr_1_zu_1_2_CM_S2 0 1024 FORMAT "%2.0" /end CHARACTERISTIC
/begin CHARACTERISTIC XZ_DYNAMIK_IDXMAX "" VALUE 0x27AE6A _REC_S1VAL_1_u1_S2 200 _CNV_R_R_Umr_1_zu_1_2_CM_S2 0 200 FORMAT "%2.0" /end CHARACTERISTIC
/begin CHARACTERISTIC XZ_DYNAMIK_IDX_DEFAULT "" VALUE 0x27AE6B _REC_S1VAL_1_u1_S2 50 _CNV_R_R_Umr_1_zu_1_2_CM_S2 0 50 FORMAT "%2.0" /end CHARACTERISTIC
/begin CHARACTERISTIC XZ_DYNAMIK_QS3 "" VALUE 0x27AE6C _REC_S1VAL_1_u1_S2 255 _CNV_R_R_Umr_1_zu_1_2_CM_S2 0 255 FORMAT "%2.0" /end CHARACTERISTIC
/begin CHARACTERISTIC XZ_HS_ANZAHL_QS3 "" VALUE 0x27AE6D _REC_S1VAL_1_u1_S2 2 _CNV_R_R_Umr_1_zu_1_2_CM_S2 0 2 FORMAT "%2.0" /end CHARACTERISTIC
/begin CHARACTERISTIC XZ_QSHIFT_RSMAX_MODAFB "" VALUE 0x27AE71 _REC_S1VAL_1_u1_S2 2 _CNV_S_3_Enum_EQSHI_232_CM_S2 0 2 /end CHARACTERISTIC
/begin CHARACTERISTIC XSCHG2W_MARS_AUS "" VALUE 0x279844 _REC_S1VAL_1_s2_S2 3276.8 _CNV_R_R_Umr_10_zu__181_CM_S2 -3276.8 0 FORMAT "%3.1" /end CHARACTERISTIC
/begin CHARACTERISTIC XSCHG2W_MARS_EIN "" VALUE 0x279846 _REC_S1VAL_1_s2_S2 3276.8 _CNV_R_R_Umr_10_zu__181_CM_S2 -3276.8 0 FORMAT "%3.1" /end CHARACTERISTIC
/begin CHARACTERISTIC XSCHM_BR_MARS_AUS "" VALUE 0x279848 _REC_S1VAL_1_s2_S2 10000 _CNV_R_R_Umr_1_zu_1_42_CM_S2 -10000 0 FORMAT "%2.0" /end CHARACTERISTIC
/begin CHARACTERISTIC XSCHM_BR_MARS_EIN "" VALUE 0x27984A _REC_S1VAL_1_s2_S2 10000 _CNV_R_R_Umr_1_zu_1_42_CM_S2 -10000 0 FORMAT "%2.0" /end CHARACTERISTIC
/begin CHARACTERISTIC XSCHN_MOT_MARSBR "" VALUE 0x27984C _REC_S1VAL_1_u2_S2 9000 _CNV_R_R_Umr_1_zu_1_3_CM_S2 0 9000 FORMAT "%2.0" /end CHARACTERISTIC
/begin CHARACTERISTIC XSCHN_MOT_MARSG2W "" VALUE 0x27984E _REC_S1VAL_1_u2_S2 9000 _CNV_R_R_Umr_1_zu_1_3_CM_S2 0 9000 FORMAT "%2.0" /end CHARACTERISTIC
/begin CHARACTERISTIC XSCHP_BR_MARS_AUS "" VALUE 0x279850 _REC_S1VAL_1_u2_S2 200 _CNV_R_R_Umr_2_zu_1_238_CM_S2 0 200 FORMAT "%3.1" /end CHARACTERISTIC
/begin CHARACTERISTIC XSCHP_BR_MARS_EIN "" VALUE 0x279852 _REC_S1VAL_1_u2_S2 200 _CNV_R_R_Umr_2_zu_1_238_CM_S2 0 200 FORMAT "%3.1" /end CHARACTERISTIC
/begin CHARACTERISTIC XSCHW_DKKD_MARS "" VALUE 0x279854 _REC_S1VAL_1_u2_S2 110 _CNV_R_R_Umr_10_zu__9_CM_S2 0 110 FORMAT "%3.1" /end CHARACTERISTIC
/begin CHARACTERISTIC XS_USE_MARS "" VALUE 0x27B6CB _REC_S1VAL_1_u1_S2 1 _CNV_S_2_Schalter_A_4_CM_S2 0 1 /end CHARACTERISTIC
/begin CHARACTERISTIC XSCHTEMP_GETR_ZRSGANG1 "" VALUE 0x2764C8 _REC_S1VAL_1_s2_S2 500 _CNV_R_R_Umr_1_zu_1_1_CM_S2 -100 400 FORMAT "%2.0" /end CHARACTERISTIC
/begin CHARACTERISTIC XSCH_HOTMODE_ZRSGANG1 "" VALUE 0x27B545 _REC_S1VAL_1_u1_S2 2 _CNV_R_R_Umr_1_zu_1_2_CM_S2 0 2 FORMAT "%2.0" /end CHARACTERISTIC
/begin CHARACTERISTIC XS_MUELOW_ZRSGANG1_SS "" VALUE 0x27B546 _REC_S1VAL_1_u1_S2 1 _CNV_R_R_Umr_1_zu_1_2_CM_S2 0 1 FORMAT "%2.0" /end CHARACTERISTIC
/begin CHARACTERISTIC XS_USE_ANHZRS1 "" VALUE 0x27B547 _REC_S1VAL_1_u1_S2 1 _CNV_S_2_Schalter_A_4_CM_S2 0 1 /end CHARACTERISTIC
/begin CHARACTERISTIC XTAB10F_MRESERVE_SCHUB_ZKA "" CURVE 0x27905A _REC_S7CUR_53_u2_u2_S2 500 _CNV_R_R_Umr_1_zu_1_53_CM_S2 0 500 FORMAT "%2.0"
 /begin AXIS_DESCR STD_AXIS N_AB _CNV_R_R_Umr_1_zu_1_3_CM_S2 10 0 65535 FORMAT "%2.0" /end AXIS_DESCR
/end CHARACTERISTIC
/begin CHARACTERISTIC XTAB10F_MRESERVE_ZUG_ZKA "" CURVE 0x279084 _REC_S7CUR_53_u2_u2_S2 500 _CNV_R_R_Umr_1_zu_1_53_CM_S2 0 500 FORMAT "%2.0"
 /begin AXIS_DESCR STD_AXIS N_AB _CNV_R_R_Umr_1_zu_1_3_CM_S2 10 0 65535 FORMAT "%2.0" /end AXIS_DESCR
/end CHARACTERISTIC
/begin CHARACTERISTIC XTAB10M_EM1_POTSCHUB_ZKA "" CURVE 0x279002 _REC_S7CUR_53_u2_u2_S2 300 _CNV_R_R_Umr_1_zu_1_53_CM_S2 0 300 FORMAT "%2.0"
 /begin AXIS_DESCR STD_AXIS DBG_NGE_G_ZKA _CNV_R_R_Umr_1_zu_1_2_CM_S2 10 0 65535 FORMAT "%2.0" /end AXIS_DESCR
/end CHARACTERISTIC
/begin CHARACTERISTIC XTAB10M_EM1_POTZUG_ZKA "" CURVE 0x27902C _REC_S7CUR_53_u2_u2_S2 300 _CNV_R_R_Umr_1_zu_1_53_CM_S2 0 300 FORMAT "%2.0"
 /begin AXIS_DESCR STD_AXIS DBG_NGE_G_ZKA _CNV_R_R_Umr_1_zu_1_2_CM_S2 10 0 65535 FORMAT "%2.0" /end AXIS_DESCR
/end CHARACTERISTIC
/begin CHARACTERISTIC XTAB10M_VM_POTSCHUB_ZKA "" CURVE 0x2790AE _REC_S7CUR_53_u2_u2_S2 300 _CNV_R_R_Umr_1_zu_1_53_CM_S2 0 300 FORMAT "%2.0"
 /begin AXIS_DESCR STD_AXIS DBG_NGE_G_ZKA _CNV_R_R_Umr_1_zu_1_2_CM_S2 10 0 65535 FORMAT "%2.0" /end AXIS_DESCR
/end CHARACTERISTIC
/begin CHARACTERISTIC XTAB10M_VM_POTZUG_ZKA "" CURVE 0x2790D8 _REC_S7CUR_53_u2_u2_S2 300 _CNV_R_R_Umr_1_zu_1_53_CM_S2 0 300 FORMAT "%2.0"
 /begin AXIS_DESCR STD_AXIS DBG_NGE_G_ZKA _CNV_R_R_Umr_1_zu_1_2_CM_S2 10 0 65535 FORMAT "%2.0" /end AXIS_DESCR
/end CHARACTERISTIC
/begin CHARACTERISTIC XTAB10OM_RAD_FWS_ZKA "" CURVE 0x279102 _REC_S7CUR_53_u2_u2_S2 32767 _CNV_R_R_Umr_1_zu_1_53_CM_S2 0 32767 FORMAT "%2.0"
 /begin AXIS_DESCR STD_AXIS N_AB _CNV_R_R_Umr_1_zu_1_3_CM_S2 10 0 65535 FORMAT "%2.0" /end AXIS_DESCR
/end CHARACTERISTIC
/begin CHARACTERISTIC XTAB10X5M_RADOPTS_AKTGANG1_ZKA "" MAP 0x273F1C _REC_A1MAP_8_u2_u2_u2_S2 1000 _CNV_R_R_Umr_1_zu_1_53_CM_S2 0 1000 FORMAT "%2.0"
 /begin AXIS_DESCR COM_AXIS N_AB _CNV_R_R_Umr_1_zu_1_3_CM_S2 10 0 65535 AXIS_PTS_REF SSTTAB_MRADOPTS_GANG1 /end AXIS_DESCR
 /begin AXIS_DESCR FIX_AXIS NO_INPUT_QUANTITY _CNV_S_5_Enum_EZKAT_244_CM_S2 5 0 4 /begin FIX_AXIS_PAR_LIST 0 1 2 3 4 /end FIX_AXIS_PAR_LIST READ_ONLY /end AXIS_DESCR
/end CHARACTERISTIC
/begin CHARACTERISTIC XTAB10X5M_RADOPTS_AKTGANG2_ZKA "" MAP 0x273F80 _REC_A1MAP_8_u2_u2_u2_S2 1000 _CNV_R_R_Umr_1_zu_1_53_CM_S2 0 1000 FORMAT "%2.0"
 /begin AXIS_DESCR COM_AXIS N_AB _CNV_R_R_Umr_1_zu_1_3_CM_S2 10 0 65535 AXIS_PTS_REF SSTTAB_MRADOPTS_GANG2 /end AXIS_DESCR
 /begin AXIS_DESCR FIX_AXIS NO_INPUT_QUANTITY _CNV_S_5_Enum_EZKAT_244_CM_S2 5 0 4 /begin FIX_AXIS_PAR_LIST 0 1 2 3 4 /end FIX_AXIS_PAR_LIST READ_ONLY /end AXIS_DESCR
/end CHARACTERISTIC
/begin CHARACTERISTIC XTAB10X5M_RADOPTS_AKTGANG3_ZKA "" MAP 0x273FE4 _REC_A1MAP_8_u2_u2_u2_S2 1000 _CNV_R_R_Umr_1_zu_1_53_CM_S2 0 1000 FORMAT "%2.0"
 /begin AXIS_DESCR COM_AXIS N_AB _CNV_R_R_Umr_1_zu_1_3_CM_S2 10 0 65535 AXIS_PTS_REF SSTTAB_MRADOPTS_GANG3 /end AXIS_DESCR
 /begin AXIS_DESCR FIX_AXIS NO_INPUT_QUANTITY _CNV_S_5_Enum_EZKAT_244_CM_S2 5 0 4 /begin FIX_AXIS_PAR_LIST 0 1 2 3 4 /end FIX_AXIS_PAR_LIST READ_ONLY /end AXIS_DESCR
/end CHARACTERISTIC
/begin CHARACTERISTIC XTAB10X5M_RADOPTS_AKTGANG4_ZKA "" MAP 0x274048 _REC_A1MAP_8_u2_u2_u2_S2 1000 _CNV_R_R_Umr_1_zu_1_53_CM_S2 0 1000 FORMAT "%2.0"
 /begin AXIS_DESCR COM_AXIS N_AB _CNV_R_R_Umr_1_zu_1_3_CM_S2 10 0 65535 AXIS_PTS_REF SSTTAB_MRADOPTS_GANG4 /end AXIS_DESCR
 /begin AXIS_DESCR FIX_AXIS NO_INPUT_QUANTITY _CNV_S_5_Enum_EZKAT_244_CM_S2 5 0 4 /begin FIX_AXIS_PAR_LIST 0 1 2 3 4 /end FIX_AXIS_PAR_LIST READ_ONLY /end AXIS_DESCR
/end CHARACTERISTIC
/begin CHARACTERISTIC XTAB10X5M_RADOPTS_AKTGANG5_ZKA "" MAP 0x2740AC _REC_A1MAP_8_u2_u2_u2_S2 1000 _CNV_R_R_Umr_1_zu_1_53_CM_S2 0 1000 FORMAT "%2.0"
 /begin AXIS_DESCR COM_AXIS N_AB _CNV_R_R_Umr_1_zu_1_3_CM_S2 10 0 65535 AXIS_PTS_REF SSTTAB_MRADOPTS_GANG5 /end AXIS_DESCR
 /begin AXIS_DESCR FIX_AXIS NO_INPUT_QUANTITY _CNV_S_5_Enum_EZKAT_244_CM_S2 5 0 4 /begin FIX_AXIS_PAR_LIST 0 1 2 3 4 /end FIX_AXIS_PAR_LIST READ_ONLY /end AXIS_DESCR
/end CHARACTERISTIC
/begin CHARACTERISTIC XTAB10X5M_RADOPTS_AKTGANG6_ZKA "" MAP 0x274110 _REC_A1MAP_8_u2_u2_u2_S2 1000 _CNV_R_R_Umr_1_zu_1_53_CM_S2 0 1000 FORMAT "%2.0"
 /begin AXIS_DESCR COM_AXIS N_AB _CNV_R_R_Umr_1_zu_1_3_CM_S2 10 0 65535 AXIS_PTS_REF SSTTAB_MRADOPTS_GANG6 /end AXIS_DESCR
 /begin AXIS_DESCR FIX_AXIS NO_INPUT_QUANTITY _CNV_S_5_Enum_EZKAT_244_CM_S2 5 0 4 /begin FIX_AXIS_PAR_LIST 0 1 2 3 4 /end FIX_AXIS_PAR_LIST READ_ONLY /end AXIS_DESCR
/end CHARACTERISTIC
/begin CHARACTERISTIC XTAB10X5M_RADOPTS_AKTGANG7_ZKA "" MAP 0x274174 _REC_A1MAP_8_u2_u2_u2_S2 1000 _CNV_R_R_Umr_1_zu_1_53_CM_S2 0 1000 FORMAT "%2.0"
 /begin AXIS_DESCR COM_AXIS N_AB _CNV_R_R_Umr_1_zu_1_3_CM_S2 10 0 65535 AXIS_PTS_REF SSTTAB_MRADOPTS_GANG7 /end AXIS_DESCR
 /begin AXIS_DESCR FIX_AXIS NO_INPUT_QUANTITY _CNV_S_5_Enum_EZKAT_244_CM_S2 5 0 4 /begin FIX_AXIS_PAR_LIST 0 1 2 3 4 /end FIX_AXIS_PAR_LIST READ_ONLY /end AXIS_DESCR
/end CHARACTERISTIC
/begin CHARACTERISTIC XTAB10X5M_RADOPTS_AKTGANG8_ZKA "" MAP 0x2741D8 _REC_A1MAP_8_u2_u2_u2_S2 1000 _CNV_R_R_Umr_1_zu_1_53_CM_S2 0 1000 FORMAT "%2.0"
 /begin AXIS_DESCR COM_AXIS N_AB _CNV_R_R_Umr_1_zu_1_3_CM_S2 10 0 65535 AXIS_PTS_REF SSTTAB_MRADOPTS_GANG8 /end AXIS_DESCR
 /begin AXIS_DESCR FIX_AXIS NO_INPUT_QUANTITY _CNV_S_5_Enum_EZKAT_244_CM_S2 5 0 4 /begin FIX_AXIS_PAR_LIST 0 1 2 3 4 /end FIX_AXIS_PAR_LIST READ_ONLY /end AXIS_DESCR
/end CHARACTERISTIC
/begin CHARACTERISTIC XTAB10X5M_RADOPTS_AKTGANG9_ZKA "" MAP 0x27423C _REC_A1MAP_8_u2_u2_u2_S2 1000 _CNV_R_R_Umr_1_zu_1_53_CM_S2 0 1000 FORMAT "%2.0"
 /begin AXIS_DESCR COM_AXIS N_AB _CNV_R_R_Umr_1_zu_1_3_CM_S2 10 0 65535 AXIS_PTS_REF SSTTAB_MRADOPTS_GANG9 /end AXIS_DESCR
 /begin AXIS_DESCR FIX_AXIS NO_INPUT_QUANTITY _CNV_S_5_Enum_EZKAT_244_CM_S2 5 0 4 /begin FIX_AXIS_PAR_LIST 0 1 2 3 4 /end FIX_AXIS_PAR_LIST READ_ONLY /end AXIS_DESCR
/end CHARACTERISTIC
/begin CHARACTERISTIC XTAB10X5M_RADOPTS_LOWGANG1_ZKA "" MAP 0x2742A0 _REC_A1MAP_8_u2_u2_u2_S2 1000 _CNV_R_R_Umr_1_zu_1_53_CM_S2 0 1000 FORMAT "%2.0"
 /begin AXIS_DESCR COM_AXIS N_AB _CNV_R_R_Umr_1_zu_1_3_CM_S2 10 0 65535 AXIS_PTS_REF SSTTAB_MRADOPTS_GANG1 /end AXIS_DESCR
 /begin AXIS_DESCR FIX_AXIS NO_INPUT_QUANTITY _CNV_S_5_Enum_EZKAT_244_CM_S2 5 0 4 /begin FIX_AXIS_PAR_LIST 0 1 2 3 4 /end FIX_AXIS_PAR_LIST READ_ONLY /end AXIS_DESCR
/end CHARACTERISTIC
/begin CHARACTERISTIC XTAB10X5M_RADOPTS_LOWGANG2_ZKA "" MAP 0x274304 _REC_A1MAP_8_u2_u2_u2_S2 1000 _CNV_R_R_Umr_1_zu_1_53_CM_S2 0 1000 FORMAT "%2.0"
 /begin AXIS_DESCR COM_AXIS N_AB _CNV_R_R_Umr_1_zu_1_3_CM_S2 10 0 65535 AXIS_PTS_REF SSTTAB_MRADOPTS_GANG2 /end AXIS_DESCR
 /begin AXIS_DESCR FIX_AXIS NO_INPUT_QUANTITY _CNV_S_5_Enum_EZKAT_244_CM_S2 5 0 4 /begin FIX_AXIS_PAR_LIST 0 1 2 3 4 /end FIX_AXIS_PAR_LIST READ_ONLY /end AXIS_DESCR
/end CHARACTERISTIC
/begin CHARACTERISTIC XTAB10X5M_RADOPTS_LOWGANG3_ZKA "" MAP 0x274368 _REC_A1MAP_8_u2_u2_u2_S2 1000 _CNV_R_R_Umr_1_zu_1_53_CM_S2 0 1000 FORMAT "%2.0"
 /begin AXIS_DESCR COM_AXIS N_AB _CNV_R_R_Umr_1_zu_1_3_CM_S2 10 0 65535 AXIS_PTS_REF SSTTAB_MRADOPTS_GANG3 /end AXIS_DESCR
 /begin AXIS_DESCR FIX_AXIS NO_INPUT_QUANTITY _CNV_S_5_Enum_EZKAT_244_CM_S2 5 0 4 /begin FIX_AXIS_PAR_LIST 0 1 2 3 4 /end FIX_AXIS_PAR_LIST READ_ONLY /end AXIS_DESCR
/end CHARACTERISTIC
/begin CHARACTERISTIC XTAB10X5M_RADOPTS_LOWGANG4_ZKA "" MAP 0x2743CC _REC_A1MAP_8_u2_u2_u2_S2 1000 _CNV_R_R_Umr_1_zu_1_53_CM_S2 0 1000 FORMAT "%2.0"
 /begin AXIS_DESCR COM_AXIS N_AB _CNV_R_R_Umr_1_zu_1_3_CM_S2 10 0 65535 AXIS_PTS_REF SSTTAB_MRADOPTS_GANG4 /end AXIS_DESCR
 /begin AXIS_DESCR FIX_AXIS NO_INPUT_QUANTITY _CNV_S_5_Enum_EZKAT_244_CM_S2 5 0 4 /begin FIX_AXIS_PAR_LIST 0 1 2 3 4 /end FIX_AXIS_PAR_LIST READ_ONLY /end AXIS_DESCR
/end CHARACTERISTIC
/begin CHARACTERISTIC XTAB10X5M_RADOPTS_LOWGANG5_ZKA "" MAP 0x274430 _REC_A1MAP_8_u2_u2_u2_S2 1000 _CNV_R_R_Umr_1_zu_1_53_CM_S2 0 1000 FORMAT "%2.0"
 /begin AXIS_DESCR COM_AXIS N_AB _CNV_R_R_Umr_1_zu_1_3_CM_S2 10 0 65535 AXIS_PTS_REF SSTTAB_MRADOPTS_GANG5 /end AXIS_DESCR
 /begin AXIS_DESCR FIX_AXIS NO_INPUT_QUANTITY _CNV_S_5_Enum_EZKAT_244_CM_S2 5 0 4 /begin FIX_AXIS_PAR_LIST 0 1 2 3 4 /end FIX_AXIS_PAR_LIST READ_ONLY /end AXIS_DESCR
/end CHARACTERISTIC
/begin CHARACTERISTIC XTAB10X5M_RADOPTS_LOWGANG6_ZKA "" MAP 0x274494 _REC_A1MAP_8_u2_u2_u2_S2 1000 _CNV_R_R_Umr_1_zu_1_53_CM_S2 0 1000 FORMAT "%2.0"
 /begin AXIS_DESCR COM_AXIS N_AB _CNV_R_R_Umr_1_zu_1_3_CM_S2 10 0 65535 AXIS_PTS_REF SSTTAB_MRADOPTS_GANG6 /end AXIS_DESCR
 /begin AXIS_DESCR FIX_AXIS NO_INPUT_QUANTITY _CNV_S_5_Enum_EZKAT_244_CM_S2 5 0 4 /begin FIX_AXIS_PAR_LIST 0 1 2 3 4 /end FIX_AXIS_PAR_LIST READ_ONLY /end AXIS_DESCR
/end CHARACTERISTIC
/begin CHARACTERISTIC XTAB10X5M_RADOPTS_LOWGANG7_ZKA "" MAP 0x2744F8 _REC_A1MAP_8_u2_u2_u2_S2 1000 _CNV_R_R_Umr_1_zu_1_53_CM_S2 0 1000 FORMAT "%2.0"
 /begin AXIS_DESCR COM_AXIS N_AB _CNV_R_R_Umr_1_zu_1_3_CM_S2 10 0 65535 AXIS_PTS_REF SSTTAB_MRADOPTS_GANG7 /end AXIS_DESCR
 /begin AXIS_DESCR FIX_AXIS NO_INPUT_QUANTITY _CNV_S_5_Enum_EZKAT_244_CM_S2 5 0 4 /begin FIX_AXIS_PAR_LIST 0 1 2 3 4 /end FIX_AXIS_PAR_LIST READ_ONLY /end AXIS_DESCR
/end CHARACTERISTIC
/begin CHARACTERISTIC XTAB10X5M_RADOPTS_LOWGANG8_ZKA "" MAP 0x27455C _REC_A1MAP_8_u2_u2_u2_S2 1000 _CNV_R_R_Umr_1_zu_1_53_CM_S2 0 1000 FORMAT "%2.0"
 /begin AXIS_DESCR COM_AXIS N_AB _CNV_R_R_Umr_1_zu_1_3_CM_S2 10 0 65535 AXIS_PTS_REF SSTTAB_MRADOPTS_GANG8 /end AXIS_DESCR
 /begin AXIS_DESCR FIX_AXIS NO_INPUT_QUANTITY _CNV_S_5_Enum_EZKAT_244_CM_S2 5 0 4 /begin FIX_AXIS_PAR_LIST 0 1 2 3 4 /end FIX_AXIS_PAR_LIST READ_ONLY /end AXIS_DESCR
/end CHARACTERISTIC
/begin CHARACTERISTIC XTAB10X5M_RADOPTS_LOWGANG9_ZKA "" MAP 0x2745C0 _REC_A1MAP_8_u2_u2_u2_S2 1000 _CNV_R_R_Umr_1_zu_1_53_CM_S2 0 1000 FORMAT "%2.0"
 /begin AXIS_DESCR COM_AXIS N_AB _CNV_R_R_Umr_1_zu_1_3_CM_S2 10 0 65535 AXIS_PTS_REF SSTTAB_MRADOPTS_GANG9 /end AXIS_DESCR
 /begin AXIS_DESCR FIX_AXIS NO_INPUT_QUANTITY _CNV_S_5_Enum_EZKAT_244_CM_S2 5 0 4 /begin FIX_AXIS_PAR_LIST 0 1 2 3 4 /end FIX_AXIS_PAR_LIST READ_ONLY /end AXIS_DESCR
/end CHARACTERISTIC
/begin CHARACTERISTIC XTAB10X5M_RADOPTZ_AKTGANG1_ZKA "" MAP 0x274624 _REC_A1MAP_8_u2_u2_u2_S2 1000 _CNV_R_R_Umr_1_zu_1_53_CM_S2 0 1000 FORMAT "%2.0"
 /begin AXIS_DESCR COM_AXIS N_AB _CNV_R_R_Umr_1_zu_1_3_CM_S2 10 0 65535 AXIS_PTS_REF SSTTAB_MRADOPTZ_GANG1 /end AXIS_DESCR
 /begin AXIS_DESCR FIX_AXIS NO_INPUT_QUANTITY _CNV_S_5_Enum_EZKAT_244_CM_S2 5 0 4 /begin FIX_AXIS_PAR_LIST 0 1 2 3 4 /end FIX_AXIS_PAR_LIST READ_ONLY /end AXIS_DESCR
/end CHARACTERISTIC
/begin CHARACTERISTIC XTAB10X5M_RADOPTZ_AKTGANG2_ZKA "" MAP 0x274688 _REC_A1MAP_8_u2_u2_u2_S2 1000 _CNV_R_R_Umr_1_zu_1_53_CM_S2 0 1000 FORMAT "%2.0"
 /begin AXIS_DESCR COM_AXIS N_AB _CNV_R_R_Umr_1_zu_1_3_CM_S2 10 0 65535 AXIS_PTS_REF SSTTAB_MRADOPTZ_GANG2 /end AXIS_DESCR
 /begin AXIS_DESCR FIX_AXIS NO_INPUT_QUANTITY _CNV_S_5_Enum_EZKAT_244_CM_S2 5 0 4 /begin FIX_AXIS_PAR_LIST 0 1 2 3 4 /end FIX_AXIS_PAR_LIST READ_ONLY /end AXIS_DESCR
/end CHARACTERISTIC
/begin CHARACTERISTIC XTAB10X5M_RADOPTZ_AKTGANG3_ZKA "" MAP 0x2746EC _REC_A1MAP_8_u2_u2_u2_S2 1000 _CNV_R_R_Umr_1_zu_1_53_CM_S2 0 1000 FORMAT "%2.0"
 /begin AXIS_DESCR COM_AXIS N_AB _CNV_R_R_Umr_1_zu_1_3_CM_S2 10 0 65535 AXIS_PTS_REF SSTTAB_MRADOPTZ_GANG3 /end AXIS_DESCR
 /begin AXIS_DESCR FIX_AXIS NO_INPUT_QUANTITY _CNV_S_5_Enum_EZKAT_244_CM_S2 5 0 4 /begin FIX_AXIS_PAR_LIST 0 1 2 3 4 /end FIX_AXIS_PAR_LIST READ_ONLY /end AXIS_DESCR
/end CHARACTERISTIC
/begin CHARACTERISTIC XTAB10X5M_RADOPTZ_AKTGANG4_ZKA "" MAP 0x274750 _REC_A1MAP_8_u2_u2_u2_S2 1000 _CNV_R_R_Umr_1_zu_1_53_CM_S2 0 1000 FORMAT "%2.0"
 /begin AXIS_DESCR COM_AXIS N_AB _CNV_R_R_Umr_1_zu_1_3_CM_S2 10 0 65535 AXIS_PTS_REF SSTTAB_MRADOPTZ_GANG4 /end AXIS_DESCR
 /begin AXIS_DESCR FIX_AXIS NO_INPUT_QUANTITY _CNV_S_5_Enum_EZKAT_244_CM_S2 5 0 4 /begin FIX_AXIS_PAR_LIST 0 1 2 3 4 /end FIX_AXIS_PAR_LIST READ_ONLY /end AXIS_DESCR
/end CHARACTERISTIC
/begin CHARACTERISTIC XTAB10X5M_RADOPTZ_AKTGANG5_ZKA "" MAP 0x2747B4 _REC_A1MAP_8_u2_u2_u2_S2 1000 _CNV_R_R_Umr_1_zu_1_53_CM_S2 0 1000 FORMAT "%2.0"
 /begin AXIS_DESCR COM_AXIS N_AB _CNV_R_R_Umr_1_zu_1_3_CM_S2 10 0 65535 AXIS_PTS_REF SSTTAB_MRADOPTZ_GANG5 /end AXIS_DESCR
 /begin AXIS_DESCR FIX_AXIS NO_INPUT_QUANTITY _CNV_S_5_Enum_EZKAT_244_CM_S2 5 0 4 /begin FIX_AXIS_PAR_LIST 0 1 2 3 4 /end FIX_AXIS_PAR_LIST READ_ONLY /end AXIS_DESCR
/end CHARACTERISTIC
/begin CHARACTERISTIC XTAB10X5M_RADOPTZ_AKTGANG6_ZKA "" MAP 0x274818 _REC_A1MAP_8_u2_u2_u2_S2 1000 _CNV_R_R_Umr_1_zu_1_53_CM_S2 0 1000 FORMAT "%2.0"
 /begin AXIS_DESCR COM_AXIS N_AB _CNV_R_R_Umr_1_zu_1_3_CM_S2 10 0 65535 AXIS_PTS_REF SSTTAB_MRADOPTZ_GANG6 /end AXIS_DESCR
 /begin AXIS_DESCR FIX_AXIS NO_INPUT_QUANTITY _CNV_S_5_Enum_EZKAT_244_CM_S2 5 0 4 /begin FIX_AXIS_PAR_LIST 0 1 2 3 4 /end FIX_AXIS_PAR_LIST READ_ONLY /end AXIS_DESCR
/end CHARACTERISTIC
/begin CHARACTERISTIC XTAB10X5M_RADOPTZ_AKTGANG7_ZKA "" MAP 0x27487C _REC_A1MAP_8_u2_u2_u2_S2 1000 _CNV_R_R_Umr_1_zu_1_53_CM_S2 0 1000 FORMAT "%2.0"
 /begin AXIS_DESCR COM_AXIS N_AB _CNV_R_R_Umr_1_zu_1_3_CM_S2 10 0 65535 AXIS_PTS_REF SSTTAB_MRADOPTZ_GANG7 /end AXIS_DESCR
 /begin AXIS_DESCR FIX_AXIS NO_INPUT_QUANTITY _CNV_S_5_Enum_EZKAT_244_CM_S2 5 0 4 /begin FIX_AXIS_PAR_LIST 0 1 2 3 4 /end FIX_AXIS_PAR_LIST READ_ONLY /end AXIS_DESCR
/end CHARACTERISTIC
/begin CHARACTERISTIC XTAB10X5M_RADOPTZ_AKTGANG8_ZKA "" MAP 0x2748E0 _REC_A1MAP_8_u2_u2_u2_S2 1000 _CNV_R_R_Umr_1_zu_1_53_CM_S2 0 1000 FORMAT "%2.0"
 /begin AXIS_DESCR COM_AXIS N_AB _CNV_R_R_Umr_1_zu_1_3_CM_S2 10 0 65535 AXIS_PTS_REF SSTTAB_MRADOPTZ_GANG8 /end AXIS_DESCR
 /begin AXIS_DESCR FIX_AXIS NO_INPUT_QUANTITY _CNV_S_5_Enum_EZKAT_244_CM_S2 5 0 4 /begin FIX_AXIS_PAR_LIST 0 1 2 3 4 /end FIX_AXIS_PAR_LIST READ_ONLY /end AXIS_DESCR
/end CHARACTERISTIC
/begin CHARACTERISTIC XTAB10X5M_RADOPTZ_AKTGANG9_ZKA "" MAP 0x274944 _REC_A1MAP_8_u2_u2_u2_S2 1000 _CNV_R_R_Umr_1_zu_1_53_CM_S2 0 1000 FORMAT "%2.0"
 /begin AXIS_DESCR COM_AXIS N_AB _CNV_R_R_Umr_1_zu_1_3_CM_S2 10 0 65535 AXIS_PTS_REF SSTTAB_MRADOPTZ_GANG9 /end AXIS_DESCR
 /begin AXIS_DESCR FIX_AXIS NO_INPUT_QUANTITY _CNV_S_5_Enum_EZKAT_244_CM_S2 5 0 4 /begin FIX_AXIS_PAR_LIST 0 1 2 3 4 /end FIX_AXIS_PAR_LIST READ_ONLY /end AXIS_DESCR
/end CHARACTERISTIC
/begin CHARACTERISTIC XTAB10X5M_RADOPTZ_LOWGANG1_ZKA "" MAP 0x2749A8 _REC_A1MAP_8_u2_u2_u2_S2 1000 _CNV_R_R_Umr_1_zu_1_53_CM_S2 0 1000 FORMAT "%2.0"
 /begin AXIS_DESCR COM_AXIS N_AB _CNV_R_R_Umr_1_zu_1_3_CM_S2 10 0 65535 AXIS_PTS_REF SSTTAB_MRADOPTZ_GANG1 /end AXIS_DESCR
 /begin AXIS_DESCR FIX_AXIS NO_INPUT_QUANTITY _CNV_S_5_Enum_EZKAT_244_CM_S2 5 0 4 /begin FIX_AXIS_PAR_LIST 0 1 2 3 4 /end FIX_AXIS_PAR_LIST READ_ONLY /end AXIS_DESCR
/end CHARACTERISTIC
/begin CHARACTERISTIC XTAB10X5M_RADOPTZ_LOWGANG2_ZKA "" MAP 0x274A0C _REC_A1MAP_8_u2_u2_u2_S2 1000 _CNV_R_R_Umr_1_zu_1_53_CM_S2 0 1000 FORMAT "%2.0"
 /begin AXIS_DESCR COM_AXIS N_AB _CNV_R_R_Umr_1_zu_1_3_CM_S2 10 0 65535 AXIS_PTS_REF SSTTAB_MRADOPTZ_GANG2 /end AXIS_DESCR
 /begin AXIS_DESCR FIX_AXIS NO_INPUT_QUANTITY _CNV_S_5_Enum_EZKAT_244_CM_S2 5 0 4 /begin FIX_AXIS_PAR_LIST 0 1 2 3 4 /end FIX_AXIS_PAR_LIST READ_ONLY /end AXIS_DESCR
/end CHARACTERISTIC
/begin CHARACTERISTIC XTAB10X5M_RADOPTZ_LOWGANG3_ZKA "" MAP 0x274A70 _REC_A1MAP_8_u2_u2_u2_S2 1000 _CNV_R_R_Umr_1_zu_1_53_CM_S2 0 1000 FORMAT "%2.0"
 /begin AXIS_DESCR COM_AXIS N_AB _CNV_R_R_Umr_1_zu_1_3_CM_S2 10 0 65535 AXIS_PTS_REF SSTTAB_MRADOPTZ_GANG3 /end AXIS_DESCR
 /begin AXIS_DESCR FIX_AXIS NO_INPUT_QUANTITY _CNV_S_5_Enum_EZKAT_244_CM_S2 5 0 4 /begin FIX_AXIS_PAR_LIST 0 1 2 3 4 /end FIX_AXIS_PAR_LIST READ_ONLY /end AXIS_DESCR
/end CHARACTERISTIC
/begin CHARACTERISTIC XTAB10X5M_RADOPTZ_LOWGANG4_ZKA "" MAP 0x274AD4 _REC_A1MAP_8_u2_u2_u2_S2 1000 _CNV_R_R_Umr_1_zu_1_53_CM_S2 0 1000 FORMAT "%2.0"
 /begin AXIS_DESCR COM_AXIS N_AB _CNV_R_R_Umr_1_zu_1_3_CM_S2 10 0 65535 AXIS_PTS_REF SSTTAB_MRADOPTZ_GANG4 /end AXIS_DESCR
 /begin AXIS_DESCR FIX_AXIS NO_INPUT_QUANTITY _CNV_S_5_Enum_EZKAT_244_CM_S2 5 0 4 /begin FIX_AXIS_PAR_LIST 0 1 2 3 4 /end FIX_AXIS_PAR_LIST READ_ONLY /end AXIS_DESCR
/end CHARACTERISTIC
/begin CHARACTERISTIC XTAB10X5M_RADOPTZ_LOWGANG5_ZKA "" MAP 0x274B38 _REC_A1MAP_8_u2_u2_u2_S2 1000 _CNV_R_R_Umr_1_zu_1_53_CM_S2 0 1000 FORMAT "%2.0"
 /begin AXIS_DESCR COM_AXIS N_AB _CNV_R_R_Umr_1_zu_1_3_CM_S2 10 0 65535 AXIS_PTS_REF SSTTAB_MRADOPTZ_GANG5 /end AXIS_DESCR
 /begin AXIS_DESCR FIX_AXIS NO_INPUT_QUANTITY _CNV_S_5_Enum_EZKAT_244_CM_S2 5 0 4 /begin FIX_AXIS_PAR_LIST 0 1 2 3 4 /end FIX_AXIS_PAR_LIST READ_ONLY /end AXIS_DESCR
/end CHARACTERISTIC
/begin CHARACTERISTIC XTAB10X5M_RADOPTZ_LOWGANG6_ZKA "" MAP 0x274B9C _REC_A1MAP_8_u2_u2_u2_S2 1000 _CNV_R_R_Umr_1_zu_1_53_CM_S2 0 1000 FORMAT "%2.0"
 /begin AXIS_DESCR COM_AXIS N_AB _CNV_R_R_Umr_1_zu_1_3_CM_S2 10 0 65535 AXIS_PTS_REF SSTTAB_MRADOPTZ_GANG6 /end AXIS_DESCR
 /begin AXIS_DESCR FIX_AXIS NO_INPUT_QUANTITY _CNV_S_5_Enum_EZKAT_244_CM_S2 5 0 4 /begin FIX_AXIS_PAR_LIST 0 1 2 3 4 /end FIX_AXIS_PAR_LIST READ_ONLY /end AXIS_DESCR
/end CHARACTERISTIC
/begin CHARACTERISTIC XTAB10X5M_RADOPTZ_LOWGANG7_ZKA "" MAP 0x274C00 _REC_A1MAP_8_u2_u2_u2_S2 1000 _CNV_R_R_Umr_1_zu_1_53_CM_S2 0 1000 FORMAT "%2.0"
 /begin AXIS_DESCR COM_AXIS N_AB _CNV_R_R_Umr_1_zu_1_3_CM_S2 10 0 65535 AXIS_PTS_REF SSTTAB_MRADOPTZ_GANG7 /end AXIS_DESCR
 /begin AXIS_DESCR FIX_AXIS NO_INPUT_QUANTITY _CNV_S_5_Enum_EZKAT_244_CM_S2 5 0 4 /begin FIX_AXIS_PAR_LIST 0 1 2 3 4 /end FIX_AXIS_PAR_LIST READ_ONLY /end AXIS_DESCR
/end CHARACTERISTIC
/begin CHARACTERISTIC XTAB10X5M_RADOPTZ_LOWGANG8_ZKA "" MAP 0x274C64 _REC_A1MAP_8_u2_u2_u2_S2 1000 _CNV_R_R_Umr_1_zu_1_53_CM_S2 0 1000 FORMAT "%2.0"
 /begin AXIS_DESCR COM_AXIS N_AB _CNV_R_R_Umr_1_zu_1_3_CM_S2 10 0 65535 AXIS_PTS_REF SSTTAB_MRADOPTZ_GANG8 /end AXIS_DESCR
 /begin AXIS_DESCR FIX_AXIS NO_INPUT_QUANTITY _CNV_S_5_Enum_EZKAT_244_CM_S2 5 0 4 /begin FIX_AXIS_PAR_LIST 0 1 2 3 4 /end FIX_AXIS_PAR_LIST READ_ONLY /end AXIS_DESCR
/end CHARACTERISTIC
/begin CHARACTERISTIC XTAB10X5M_RADOPTZ_LOWGANG9_ZKA "" MAP 0x274CC8 _REC_A1MAP_8_u2_u2_u2_S2 1000 _CNV_R_R_Umr_1_zu_1_53_CM_S2 0 1000 FORMAT "%2.0"
 /begin AXIS_DESCR COM_AXIS N_AB _CNV_R_R_Umr_1_zu_1_3_CM_S2 10 0 65535 AXIS_PTS_REF SSTTAB_MRADOPTZ_GANG9 /end AXIS_DESCR
 /begin AXIS_DESCR FIX_AXIS NO_INPUT_QUANTITY _CNV_S_5_Enum_EZKAT_244_CM_S2 5 0 4 /begin FIX_AXIS_PAR_LIST 0 1 2 3 4 /end FIX_AXIS_PAR_LIST READ_ONLY /end AXIS_DESCR
/end CHARACTERISTIC
/begin CHARACTERISTIC XTAB10X5M_RADWUNSCH_BRMAX_ZKA "" MAP 0x27912C _REC_S3MAP_54_s2_s2_u2_S2 64000 _CNV_R_R_Umr_1_zu_1_42_CM_S2 -32000 32000 FORMAT "%2.0"
 /begin AXIS_DESCR STD_AXIS NO_INPUT_QUANTITY _CNV_R_R_Umr_1_zu_1_8_CM_S2 10 -32768 32767 FORMAT "%2.0" /end AXIS_DESCR
 /begin AXIS_DESCR FIX_AXIS NO_INPUT_QUANTITY _CNV_S_5_Enum_EZKAT_244_CM_S2 5 0 4 /begin FIX_AXIS_PAR_LIST 0 1 2 3 4 /end FIX_AXIS_PAR_LIST READ_ONLY /end AXIS_DESCR
/end CHARACTERISTIC
/begin CHARACTERISTIC XTAB10X5M_RADWUNSCH_BRMIN_ZKA "" MAP 0x2791A6 _REC_S3MAP_54_s2_s2_u2_S2 64000 _CNV_R_R_Umr_1_zu_1_42_CM_S2 -32000 32000 FORMAT "%2.0"
 /begin AXIS_DESCR STD_AXIS NO_INPUT_QUANTITY _CNV_R_R_Umr_1_zu_1_8_CM_S2 10 -32768 32767 FORMAT "%2.0" /end AXIS_DESCR
 /begin AXIS_DESCR FIX_AXIS NO_INPUT_QUANTITY _CNV_S_5_Enum_EZKAT_244_CM_S2 5 0 4 /begin FIX_AXIS_PAR_LIST 0 1 2 3 4 /end FIX_AXIS_PAR_LIST READ_ONLY /end AXIS_DESCR
/end CHARACTERISTIC
/begin CHARACTERISTIC XTAB2SCHM_MOT_SUMSCHUBMAX_ZKA "" CURVE 0x273168 _REC_A1CUR_30_s2_u1_S2 20000 _CNV_R_R_Umr_1_zu_1_2_CM_S2 -20000 0 FORMAT "%2.0"
 /begin AXIS_DESCR FIX_AXIS S_B_BCA _CNV_P_2_A_I_5_CM_S2 2 0 255 /begin FIX_AXIS_PAR_LIST 0 1 /end FIX_AXIS_PAR_LIST READ_ONLY /end AXIS_DESCR
/end CHARACTERISTIC
/begin CHARACTERISTIC XTAB2T_SPERRHS_LDMMODEW_ZKA "" CURVE 0x27316C _REC_A1CUR_30_s4_u2_S2 5000 _CNV_R_R_Umr_1_zu_1_6_CM_S2 0 5000 FORMAT "%2.0"
 /begin AXIS_DESCR FIX_AXIS NO_INPUT_QUANTITY _CNV_S_2_Enum_ESPER_241_CM_S2 2 0 1 /begin FIX_AXIS_PAR_LIST 0 1 /end FIX_AXIS_PAR_LIST READ_ONLY /end AXIS_DESCR
/end CHARACTERISTIC
/begin CHARACTERISTIC XTAB2X2S_SCHUB_LDMBAB_ZKA "" MAP 0x273174 _REC_A1MAP_8_u1_u1_u1_S2 1 _CNV_R_R_Umr_1_zu_1_2_CM_S2 0 1 FORMAT "%2.0"
 /begin AXIS_DESCR FIX_AXIS S_EFAHREN_ERK _CNV_P_2_A_I_5_CM_S2 2 0 255 /begin FIX_AXIS_PAR_LIST 0 1 /end FIX_AXIS_PAR_LIST READ_ONLY /end AXIS_DESCR
 /begin AXIS_DESCR FIX_AXIS S_LDM_ERK _CNV_R_R_Umr_1_zu_1_2_CM_S2 2 0 255 /begin FIX_AXIS_PAR_LIST 0 1 /end FIX_AXIS_PAR_LIST READ_ONLY /end AXIS_DESCR
/end CHARACTERISTIC
/begin CHARACTERISTIC XTAB2X2T_SEQUENZER_LDMHS_ZKA "" MAP 0x273178 _REC_A1MAP_8_s4_u1_u1_S2 10000 _CNV_R_R_Umr_1_zu_1_82_CM_S2 0 10000 FORMAT "%2.0"
 /begin AXIS_DESCR FIX_AXIS S_LDM_STELLUNSTETIGKEIT _CNV_R_R_Umr_1_zu_1_2_CM_S2 2 0 255 /begin FIX_AXIS_PAR_LIST 0 1 /end FIX_AXIS_PAR_LIST READ_ONLY /end AXIS_DESCR
 /begin AXIS_DESCR FIX_AXIS S_LDMBAB_ENBL _CNV_P_2_A_I_5_CM_S2 2 0 255 /begin FIX_AXIS_PAR_LIST 0 1 /end FIX_AXIS_PAR_LIST READ_ONLY /end AXIS_DESCR
/end CHARACTERISTIC
/begin CHARACTERISTIC XTAB2X2T_SEQUENZER_LDMRS_ZKA "" MAP 0x273188 _REC_A1MAP_8_s4_u1_u1_S2 10000 _CNV_R_R_Umr_1_zu_1_82_CM_S2 0 10000 FORMAT "%2.0"
 /begin AXIS_DESCR FIX_AXIS S_LDM_STELLUNSTETIGKEIT _CNV_R_R_Umr_1_zu_1_2_CM_S2 2 0 255 /begin FIX_AXIS_PAR_LIST 0 1 /end FIX_AXIS_PAR_LIST READ_ONLY /end AXIS_DESCR
 /begin AXIS_DESCR FIX_AXIS S_LDMBAB_ENBL _CNV_P_2_A_I_5_CM_S2 2 0 255 /begin FIX_AXIS_PAR_LIST 0 1 /end FIX_AXIS_PAR_LIST READ_ONLY /end AXIS_DESCR
/end CHARACTERISTIC
/begin CHARACTERISTIC XTAB5S_KRIT_ENBL_ZKA "" CURVE 0x27B5F0 _REC_A1CUR_30_u1_u2_S2 1 _CNV_R_R_Umr_1_zu_1_2_CM_S2 0 1 FORMAT "%2.0"
 /begin AXIS_DESCR FIX_AXIS NO_INPUT_QUANTITY _CNV_S_5_Enum_EZKAK_242_CM_S2 5 0 4 /begin FIX_AXIS_PAR_LIST 0 1 2 3 4 /end FIX_AXIS_PAR_LIST READ_ONLY /end AXIS_DESCR
/end CHARACTERISTIC
/begin CHARACTERISTIC XTAB6X2M_MOT_MAX_ZKA "" MAP 0x273198 _REC_A1MAP_8_s4_u1_u1_S2 1000 _CNV_R_R_Umr_1_zu_1_42_CM_S2 0 1000 FORMAT "%2.0"
 /begin AXIS_DESCR FIX_AXIS Z_DRIVELOGIC _CNV_S_6_Enum_EDL_11_CM_S2 6 1 6 FIX_AXIS_PAR_DIST 1 1 6 READ_ONLY /end AXIS_DESCR
 /begin AXIS_DESCR FIX_AXIS S_LDM_STELLUNSTETIGKEIT _CNV_R_R_Umr_1_zu_1_2_CM_S2 2 0 255 /begin FIX_AXIS_PAR_LIST 0 1 /end FIX_AXIS_PAR_LIST READ_ONLY /end AXIS_DESCR
/end CHARACTERISTIC
/begin CHARACTERISTIC XTAB6X2_PRISQ_LDMAAGS_ZKA "" MAP 0x2731C8 _REC_A1MAP_8_s1_u2_u1_S2 5 _CNV_R_R_Umr_1_zu_1_2_CM_S2 0 5 FORMAT "%2.0"
 /begin AXIS_DESCR FIX_AXIS NO_INPUT_QUANTITY _CNV_S_2_Enum_EZKAT_245_CM_S2 2 0 1 /begin FIX_AXIS_PAR_LIST 0 1 /end FIX_AXIS_PAR_LIST READ_ONLY /end AXIS_DESCR
 /begin AXIS_DESCR FIX_AXIS Z_BERGANH _CNV_S_6_Enum_EBERG_61_CM_S2 6 0 5 /begin FIX_AXIS_PAR_LIST 0 1 2 3 4 5 /end FIX_AXIS_PAR_LIST READ_ONLY /end AXIS_DESCR
/end CHARACTERISTIC
/begin CHARACTERISTIC XTAB6X2_PRISQ_LDMSAGS_ZKA "" MAP 0x2731D4 _REC_A1MAP_8_s1_u2_u1_S2 5 _CNV_R_R_Umr_1_zu_1_2_CM_S2 0 5 FORMAT "%2.0"
 /begin AXIS_DESCR FIX_AXIS NO_INPUT_QUANTITY _CNV_S_2_Enum_EZKAT_245_CM_S2 2 0 1 /begin FIX_AXIS_PAR_LIST 0 1 /end FIX_AXIS_PAR_LIST READ_ONLY /end AXIS_DESCR
 /begin AXIS_DESCR FIX_AXIS Z_BERGANH _CNV_S_6_Enum_EBERG_61_CM_S2 6 0 5 /begin FIX_AXIS_PAR_LIST 0 1 2 3 4 5 /end FIX_AXIS_PAR_LIST READ_ONLY /end AXIS_DESCR
/end CHARACTERISTIC
/begin CHARACTERISTIC XTAB6X3M_MOT_POTSCHUB_ZKA "" MAP 0x279220 _REC_S3MAP_54_u2_u2_u2_S2 200 _CNV_R_R_Umr_1_zu_1_53_CM_S2 0 200 FORMAT "%2.0"
 /begin AXIS_DESCR STD_AXIS N_MOT _CNV_R_R_Umr_1_zu_1_3_CM_S2 6 0 65535 FORMAT "%2.0" /end AXIS_DESCR
 /begin AXIS_DESCR FIX_AXIS NO_INPUT_QUANTITY _CNV_S_3_Enum_EMOT__240_CM_S2 3 0 2 /begin FIX_AXIS_PAR_LIST 0 1 2 /end FIX_AXIS_PAR_LIST READ_ONLY /end AXIS_DESCR
/end CHARACTERISTIC
/begin CHARACTERISTIC XTAB6X5M_MOT_POTZUG_ZKA "" MAP 0x279252 _REC_S3MAP_54_u2_u2_u2_S2 200 _CNV_R_R_Umr_1_zu_1_53_CM_S2 0 200 FORMAT "%2.0"
 /begin AXIS_DESCR STD_AXIS N_MOT _CNV_R_R_Umr_1_zu_1_3_CM_S2 6 0 65535 FORMAT "%2.0" /end AXIS_DESCR
 /begin AXIS_DESCR FIX_AXIS NO_INPUT_QUANTITY _CNV_S_5_Enum_EMOT__239_CM_S2 5 0 4 /begin FIX_AXIS_PAR_LIST 0 1 2 3 4 /end FIX_AXIS_PAR_LIST READ_ONLY /end AXIS_DESCR
/end CHARACTERISTIC
/begin CHARACTERISTIC XTAB9DV_FZG_STABKRI_ZKA "" CURVE 0x27929C _REC_A1CUR_30_u2_u1_S2 25 _CNV_R_R_Umr_10_zu__190_CM_S2 0 25 FORMAT "%3.1"
 /begin AXIS_DESCR FIX_AXIS Z_GANG_ZIEL _CNV_S_9_Enum_EGANG_30_CM_S2 9 0 8 FIX_AXIS_PAR_DIST 0 1 9 READ_ONLY /end AXIS_DESCR
/end CHARACTERISTIC
/begin CHARACTERISTIC XTAB9FAKT_M_MOTDYNHKOR_ZKA "" CURVE 0x2792AE _REC_A1CUR_30_u2_u2_S2 2 _CNV_R_R_Umr_100_zu_54_CM_S2 0 2 FORMAT "%4.2"
 /begin AXIS_DESCR FIX_AXIS NO_INPUT_QUANTITY _CNV_S_9_Enum_EGANG_30_CM_S2 9 0 8 FIX_AXIS_PAR_DIST 0 1 9 READ_ONLY /end AXIS_DESCR
/end CHARACTERISTIC
/begin CHARACTERISTIC XTAB9OM_RADOPTS_HIGHGANG_ZKA "" CURVE 0x27B622 _REC_A1CUR_30_u1_u1_S2 200 _CNV_R_R_Umr_1_zu_1_53_CM_S2 0 200 FORMAT "%2.0"
 /begin AXIS_DESCR FIX_AXIS Z_GANG_ZIEL _CNV_S_9_Enum_EGANG_30_CM_S2 9 0 8 FIX_AXIS_PAR_DIST 0 1 9 READ_ONLY /end AXIS_DESCR
/end CHARACTERISTIC
/begin CHARACTERISTIC XTAB9OM_RADOPTZ_HIGHGANG_ZKA "" CURVE 0x27B62B _REC_A1CUR_30_u1_u1_S2 200 _CNV_R_R_Umr_1_zu_1_53_CM_S2 0 200 FORMAT "%2.0"
 /begin AXIS_DESCR FIX_AXIS Z_GANG_ZIEL _CNV_S_9_Enum_EGANG_30_CM_S2 9 0 8 FIX_AXIS_PAR_DIST 0 1 9 READ_ONLY /end AXIS_DESCR
/end CHARACTERISTIC
/begin CHARACTERISTIC XTAB9X3FAKT_LDMDYNAMIC2_ZKA "" MAP 0x27B607 _REC_A1MAP_8_u1_u1_u2_S2 100 _CNV_R_R_Umr_1_zu_1_53_CM_S2 0 100 FORMAT "%2.0"
 /begin AXIS_DESCR FIX_AXIS Z_GANG_ZIEL_ZKA _CNV_S_9_Enum_EGANG_30_CM_S2 9 0 8 FIX_AXIS_PAR_DIST 0 1 9 READ_ONLY /end AXIS_DESCR
 /begin AXIS_DESCR FIX_AXIS NO_INPUT_QUANTITY _CNV_S_3_Enum_EZKAO_243_CM_S2 3 0 2 /begin FIX_AXIS_PAR_LIST 0 1 2 /end FIX_AXIS_PAR_LIST READ_ONLY /end AXIS_DESCR
/end CHARACTERISTIC
/begin CHARACTERISTIC XTAB9Z_IDX_MMOTPOTSCHUB_ZKA "" CURVE 0x27B5F5 _REC_A1CUR_30_u1_u2_S2 2 _CNV_S_3_Enum_EMOT__240_CM_S2 0 2
 /begin AXIS_DESCR FIX_AXIS NO_INPUT_QUANTITY _CNV_S_9_Enum_EGANG_30_CM_S2 9 0 8 FIX_AXIS_PAR_DIST 0 1 9 READ_ONLY /end AXIS_DESCR
/end CHARACTERISTIC
/begin CHARACTERISTIC XTAB9Z_IDX_MMOTPOTZUG_ZKA "" CURVE 0x27B5FE _REC_A1CUR_30_u1_u2_S2 4 _CNV_S_5_Enum_EMOT__239_CM_S2 0 4
 /begin AXIS_DESCR FIX_AXIS NO_INPUT_QUANTITY _CNV_S_9_Enum_EGANG_30_CM_S2 9 0 8 FIX_AXIS_PAR_DIST 0 1 9 READ_ONLY /end AXIS_DESCR
/end CHARACTERISTIC
/begin CHARACTERISTIC XDM_RADSOLL_STABKRI_ZKA "" VALUE 0x2792C0 _REC_S1VAL_1_u2_S2 30000 _CNV_R_R_Umr_1_zu_1_42_CM_S2 0 30000 FORMAT "%2.0" /end CHARACTERISTIC
/begin CHARACTERISTIC XFAKT_MEM1MAX_AVLPRED_ZKA "" VALUE 0x279056 _REC_S1VAL_1_s2_S2 100 _CNV_R_R_Umr_1_zu_1_53_CM_S2 0 100 FORMAT "%2.0" /end CHARACTERISTIC
/begin CHARACTERISTIC XFAKT_MEM1MIN_AVLPRED_ZKA "" VALUE 0x279058 _REC_S1VAL_1_s2_S2 100 _CNV_R_R_Umr_1_zu_1_53_CM_S2 0 100 FORMAT "%2.0" /end CHARACTERISTIC
/begin CHARACTERISTIC XHM_RAD_WUNSCH_ZKA "" VALUE 0x2792C4 _REC_S1VAL_1_s2_S2 500 _CNV_R_R_Umr_1_zu_1_42_CM_S2 0 500 FORMAT "%2.0" /end CHARACTERISTIC
/begin CHARACTERISTIC XMUE_DYN_MUELOW_SEQUENZER "" VALUE 0x2792C6 _REC_S1VAL_1_u2_S2 10 _CNV_R_R_Umr_1000_z_57_CM_S2 0 10 FORMAT "%5.3" /end CHARACTERISTIC
/begin CHARACTERISTIC XM_MOT_MIN_ZKA "" VALUE 0x2731E0 _REC_S1VAL_1_s4_S2 200 _CNV_R_R_Umr_1_zu_1_2_CM_S2 -200 0 FORMAT "%2.0" /end CHARACTERISTIC
/begin CHARACTERISTIC XOM_RAD_OPTSCHUB_ZKA "" VALUE 0x2792C8 _REC_S1VAL_1_u2_S2 65535 _CNV_R_R_Umr_1_zu_1_42_CM_S2 0 65535 FORMAT "%2.0" /end CHARACTERISTIC
/begin CHARACTERISTIC XOM_RAD_OPT_ZKA "" VALUE 0x2792CA _REC_S1VAL_1_u2_S2 65535 _CNV_R_R_Umr_1_zu_1_42_CM_S2 0 65535 FORMAT "%2.0" /end CHARACTERISTIC
/begin CHARACTERISTIC XSCHA_SCHUBZUG_ZKA "" VALUE 0x2792CC _REC_S1VAL_1_s2_S2 6553.5 _CNV_R_R_Umr_10_zu__46_CM_S2 -3276.8 3276.7 FORMAT "%3.1" /end CHARACTERISTIC
/begin CHARACTERISTIC XSCHA_ZUGSCHUB_ZKA "" VALUE 0x2792CE _REC_S1VAL_1_s2_S2 6553.5 _CNV_R_R_Umr_10_zu__46_CM_S2 -3276.8 3276.7 FORMAT "%3.1" /end CHARACTERISTIC
/begin CHARACTERISTIC XSCHM_RADMIN_LDMDYN_ZKA "" VALUE 0x2792D0 _REC_S1VAL_1_s2_S2 2500 _CNV_R_R_Umr_1_zu_1_248_CM_S2 -2500 0 FORMAT "%2.0" /end CHARACTERISTIC
/begin CHARACTERISTIC XSCHM_RAD_SCHUBZUG_ZKA "" VALUE 0x2792D2 _REC_S1VAL_1_s2_S2 65535 _CNV_R_R_Umr_1_zu_1_42_CM_S2 -32768 32767 FORMAT "%2.0" /end CHARACTERISTIC
/begin CHARACTERISTIC XSCHM_RAD_ZUGSCHUB_ZKA "" VALUE 0x2792D4 _REC_S1VAL_1_s2_S2 65535 _CNV_R_R_Umr_1_zu_1_42_CM_S2 -32768 32767 FORMAT "%2.0" /end CHARACTERISTIC
/begin CHARACTERISTIC XS_FWSRESERVE_ZKA "" VALUE 0x27B638 _REC_S1VAL_1_u1_S2 1 _CNV_R_R_Umr_1_zu_1_2_CM_S2 0 1 FORMAT "%2.0" /end CHARACTERISTIC
/begin CHARACTERISTIC XS_MBR_MRADWUNSCH_ZKA "" VALUE 0x27B639 _REC_S1VAL_1_u1_S2 1 _CNV_R_R_Umr_1_zu_1_2_CM_S2 0 1 FORMAT "%2.0" /end CHARACTERISTIC
/begin CHARACTERISTIC XS_MEM1_MAX_ZKA "" VALUE 0x27B636 _REC_S1VAL_1_u1_S2 1 _CNV_R_R_Umr_1_zu_1_2_CM_S2 0 1 FORMAT "%2.0" /end CHARACTERISTIC
/begin CHARACTERISTIC XS_MMOT_MAX_ZKA "" VALUE 0x27B634 _REC_S1VAL_1_u1_S2 1 _CNV_R_R_Umr_1_zu_1_2_CM_S2 0 1 FORMAT "%2.0" /end CHARACTERISTIC
/begin CHARACTERISTIC XS_MMOT_MIN_ZKA "" VALUE 0x27B635 _REC_S1VAL_1_u1_S2 1 _CNV_R_R_Umr_1_zu_1_2_CM_S2 0 1 FORMAT "%2.0" /end CHARACTERISTIC
/begin CHARACTERISTIC XS_M_RADOPT_BEGRENZT "" VALUE 0x27B63A _REC_S1VAL_1_u1_S2 1 _CNV_R_R_Umr_1_zu_1_2_CM_S2 0 1 FORMAT "%2.0" /end CHARACTERISTIC
/begin CHARACTERISTIC XS_PRUEFMETHODE_HIGHLOW_ZKA "" VALUE 0x27B63B _REC_S1VAL_1_u1_S2 1 _CNV_R_R_Umr_1_zu_1_2_CM_S2 0 1 FORMAT "%2.0" /end CHARACTERISTIC
/begin CHARACTERISTIC XS_RSSEQ_MUELOW_FKT "" VALUE 0x27B63C _REC_S1VAL_1_u1_S2 1 _CNV_R_R_Umr_1_zu_1_2_CM_S2 0 1 FORMAT "%2.0" /end CHARACTERISTIC
/begin CHARACTERISTIC XS_SOURCE_GNT_ZKA "" VALUE 0x27B63D _REC_S1VAL_1_u1_S2 1 _CNV_R_R_Umr_1_zu_1_2_CM_S2 0 1 FORMAT "%2.0" /end CHARACTERISTIC
/begin CHARACTERISTIC XS_SOURCE_KLOPT_GANG_ZKA "" VALUE 0x27B63E _REC_S1VAL_1_u1_S2 1 _CNV_R_R_Umr_1_zu_1_2_CM_S2 0 1 FORMAT "%2.0" /end CHARACTERISTIC
/begin CHARACTERISTIC XS_STABIKRIT_ZKA "" VALUE 0x27B63F _REC_S1VAL_1_u1_S2 1 _CNV_R_R_Umr_1_zu_1_2_CM_S2 0 1 FORMAT "%2.0" /end CHARACTERISTIC
/begin CHARACTERISTIC XS_USE_EM2POT_ZKA "" VALUE 0x27B640 _REC_S1VAL_1_u1_S2 1 _CNV_R_R_Umr_1_zu_1_2_CM_S2 0 1 FORMAT "%2.0" /end CHARACTERISTIC
/begin CHARACTERISTIC XS_USE_KD_ZKA "" VALUE 0x27B641 _REC_S1VAL_1_u1_S2 1 _CNV_R_R_Umr_1_zu_1_2_CM_S2 0 1 FORMAT "%2.0" /end CHARACTERISTIC
/begin CHARACTERISTIC XS_USE_MBR4MRADWUNSCH_ZKA "" VALUE 0x27B642 _REC_S1VAL_1_u1_S2 1 _CNV_R_R_Umr_1_zu_1_2_CM_S2 0 1 FORMAT "%2.0" /end CHARACTERISTIC
/begin CHARACTERISTIC XS_USE_PRISQZKA_LDM_ZKA "" VALUE 0x27B643 _REC_S1VAL_1_u1_S2 1 _CNV_R_R_Umr_1_zu_1_2_CM_S2 0 1 FORMAT "%2.0" /end CHARACTERISTIC
/begin CHARACTERISTIC XS_USE_SEQDDHS_ZKA "" VALUE 0x27B644 _REC_S1VAL_1_u1_S2 1 _CNV_R_R_Umr_1_zu_1_2_CM_S2 0 1 FORMAT "%2.0" /end CHARACTERISTIC
/begin CHARACTERISTIC XS_USE_SEQ_ZKA "" VALUE 0x27B645 _REC_S1VAL_1_u1_S2 1 _CNV_R_R_Umr_1_zu_1_2_CM_S2 0 1 FORMAT "%2.0" /end CHARACTERISTIC
/begin CHARACTERISTIC XT_HSPV_NGE_ZKA "" VALUE 0x2792D6 _REC_S1VAL_1_s2_S2 1000 _CNV_R_R_Umr_1_zu_1_146_CM_S2 0 1000 FORMAT "%2.0" /end CHARACTERISTIC
/begin CHARACTERISTIC XT_SEQUENZER_ZKA "" VALUE 0x2731E4 _REC_S1VAL_1_s4_S2 3000 _CNV_R_R_Umr_1_zu_1_6_CM_S2 0 3000 FORMAT "%2.0" /end CHARACTERISTIC
/begin CHARACTERISTIC XT_STABKRI_ZKA "" VALUE 0x2792C2 _REC_S1VAL_1_u2_S2 30000 _CNV_R_R_Umr_1_zu_1_6_CM_S2 0 30000 FORMAT "%2.0" /end CHARACTERISTIC
/begin CHARACTERISTIC XZ_GANG_MINHKOR_ZKA "" VALUE 0x27B646 _REC_S1VAL_1_u1_S2 8 _CNV_S_9_Enum_EGANG_30_CM_S2 0 8 /end CHARACTERISTIC
/begin CHARACTERISTIC XZ_MEM1_MIN_ZKA "" VALUE 0x27B637 _REC_S1VAL_1_u1_S2 2 _CNV_R_R_Umr_1_zu_1_2_CM_S2 0 2 FORMAT "%2.0" /end CHARACTERISTIC
/begin CHARACTERISTIC XTAB21SCHN_T_MIN_PROG_DDRS "" CURVE 0x27A76A _REC_A1CUR_30_u2_u1_S2 10000 _CNV_R_R_Umr_1_zu_1_3_CM_S2 0 10000 FORMAT "%2.0"
 /begin AXIS_DESCR FIX_AXIS Z_PROG_FFG _CNV_S_21_Enum_EPROG_40_CM_S2 21 0 20 FIX_AXIS_PAR_DIST 0 1 21 READ_ONLY /end AXIS_DESCR
/end CHARACTERISTIC
/begin CHARACTERISTIC XTAB9SCHW_DKKD_NTMIN_DDRS "" CURVE 0x27A794 _REC_A1CUR_30_u2_u1_S2 110 _CNV_R_R_Umr_10_zu__9_CM_S2 0 110 FORMAT "%3.1"
 /begin AXIS_DESCR FIX_AXIS Z_GANG_ZIEL_SKL _CNV_S_9_Enum_EGANG_30_CM_S2 9 0 8 FIX_AXIS_PAR_DIST 0 1 9 READ_ONLY /end AXIS_DESCR
/end CHARACTERISTIC
/begin CHARACTERISTIC XT_WAIT_DDRS "" VALUE 0x27A7A6 _REC_S1VAL_1_u2_S2 1000 _CNV_R_R_Umr_1_zu_1_6_CM_S2 0 1000 FORMAT "%2.0" /end CHARACTERISTIC
/begin CHARACTERISTIC XTAB3SCHW_DKKD_DERS "" CURVE 0x2761B2 _REC_S7CUR_53_u2_s2_S2 120 _CNV_R_R_Umr_10_zu__9_CM_S2 0 120 FORMAT "%3.1"
 /begin AXIS_DESCR STD_AXIS DM_RAD_FWS_FILT _CNV_R_R_Umr_1_zu_1_42_CM_S2 3 -32768 32767 FORMAT "%2.0" /end AXIS_DESCR
/end CHARACTERISTIC
/begin CHARACTERISTIC XTAB3T_DERS_HS "" CURVE 0x2761D6 _REC_A1CUR_30_u2_u1_S2 65535 _CNV_R_R_Umr_1_zu_1_2_CM_S2 0 65535 FORMAT "%2.0"
 /begin AXIS_DESCR FIX_AXIS NO_INPUT_QUANTITY _CNV_S_3_Enum_EDERS_249_CM_S2 3 0 2 FIX_AXIS_PAR_DIST 0 1 3 READ_ONLY /end AXIS_DESCR
/end CHARACTERISTIC
/begin CHARACTERISTIC XTAB5SCHM_BR_LWVA_DERS "" CURVE 0x2761C0 _REC_S7CUR_53_s2_u2_S2 2500 _CNV_R_R_Umr_1_zu_1_42_CM_S2 -2500 0 FORMAT "%2.0"
 /begin AXIS_DESCR STD_AXIS V_FZG _CNV_R_R_Umr_1_zu_1_8_CM_S2 5 0 250 FORMAT "%2.0" /end AXIS_DESCR
/end CHARACTERISTIC
/begin CHARACTERISTIC XTAB5X2SCHW_LWVA_EFF_DERS "" MAP 0x271430 _REC_S3MAP_54_u2_u2_u1_S2 90 _CNV_R_R_Umr_10_zu__10_CM_S2 0 90 FORMAT "%3.1"
 /begin AXIS_DESCR STD_AXIS V_FZG _CNV_R_R_Umr_1_zu_1_8_CM_S2 5 0 250 FORMAT "%2.0" /end AXIS_DESCR
 /begin AXIS_DESCR FIX_AXIS S_B_BCA _CNV_P_2_A_I_5_CM_S2 2 0 255 /begin FIX_AXIS_PAR_LIST 0 1 /end FIX_AXIS_PAR_LIST READ_ONLY /end AXIS_DESCR
/end CHARACTERISTIC
/begin CHARACTERISTIC XTAB9ON_AB_HS_LWVA_DERS "" CURVE 0x276A2E _REC_A1CUR_30_u2_u1_S2 20000 _CNV_R_R_Umr_1_zu_1_3_CM_S2 0 20000 FORMAT "%2.0"
 /begin AXIS_DESCR FIX_AXIS Z_GANG_ZIEL _CNV_S_9_Enum_EGANG_30_CM_S2 9 0 8 FIX_AXIS_PAR_DIST 0 1 9 READ_ONLY /end AXIS_DESCR
/end CHARACTERISTIC
/begin CHARACTERISTIC XTAB9ON_AB_HS_NIC_DERS "" CURVE 0x276A40 _REC_A1CUR_30_u2_u1_S2 2000 _CNV_R_R_Umr_1_zu_1_3_CM_S2 0 2000 FORMAT "%2.0"
 /begin AXIS_DESCR FIX_AXIS Z_GANG_ZIEL _CNV_S_9_Enum_EGANG_30_CM_S2 9 0 8 FIX_AXIS_PAR_DIST 0 1 9 READ_ONLY /end AXIS_DESCR
/end CHARACTERISTIC
/begin CHARACTERISTIC XTAB9SCHN_AB_NIC_DERS "" CURVE 0x2761DC _REC_A1CUR_30_u2_u1_S2 20000 _CNV_R_R_Umr_1_zu_1_3_CM_S2 0 20000 FORMAT "%2.0"
 /begin AXIS_DESCR FIX_AXIS Z_GANG_ZIEL_EXC _CNV_S_9_Enum_EGANG_30_CM_S2 9 0 8 FIX_AXIS_PAR_DIST 0 1 9 READ_ONLY /end AXIS_DESCR
/end CHARACTERISTIC
/begin CHARACTERISTIC XTAB9X2ON_AB_HS_DERS "" MAP 0x272990 _REC_A1MAP_9_u2_u1_u1_S2 20000 _CNV_R_R_Umr_1_zu_1_3_CM_S2 0 20000 FORMAT "%2.0"
 /begin AXIS_DESCR FIX_AXIS Z_GANG_ZIEL _CNV_S_9_Enum_EGANG_30_CM_S2 9 0 8 FIX_AXIS_PAR_DIST 0 1 9 READ_ONLY /end AXIS_DESCR
 /begin AXIS_DESCR FIX_AXIS Z_DERS_YIDX _CNV_R_R_Umr_1_zu_1_2_CM_S2 2 0 1 FIX_AXIS_PAR_DIST 0 1 2 FORMAT "%2.0" READ_ONLY /end AXIS_DESCR
/end CHARACTERISTIC
/begin CHARACTERISTIC XTAB9X2SCHN_AB_DERS "" MAP 0x271450 _REC_A1MAP_9_u2_u1_u1_S2 20000 _CNV_R_R_Umr_1_zu_1_3_CM_S2 0 20000 FORMAT "%2.0"
 /begin AXIS_DESCR FIX_AXIS Z_GANG_ZIEL_EXC _CNV_S_9_Enum_EGANG_30_CM_S2 9 0 8 FIX_AXIS_PAR_DIST 0 1 9 READ_ONLY /end AXIS_DESCR
 /begin AXIS_DESCR FIX_AXIS Z_DERS_YIDX _CNV_R_R_Umr_1_zu_1_2_CM_S2 2 0 1 FIX_AXIS_PAR_DIST 0 1 2 FORMAT "%2.0" READ_ONLY /end AXIS_DESCR
/end CHARACTERISTIC
/begin CHARACTERISTIC XTAB9X2SCHN_AB_LWVA_DERS "" MAP 0x271474 _REC_A1MAP_9_u2_u1_u1_S2 20000 _CNV_R_R_Umr_1_zu_1_3_CM_S2 0 20000 FORMAT "%2.0"
 /begin AXIS_DESCR FIX_AXIS Z_GANG_ZIEL_EXC _CNV_S_9_Enum_EGANG_30_CM_S2 9 0 8 FIX_AXIS_PAR_DIST 0 1 9 READ_ONLY /end AXIS_DESCR
 /begin AXIS_DESCR FIX_AXIS S_B_BCA _CNV_P_2_A_I_5_CM_S2 2 0 255 /begin FIX_AXIS_PAR_LIST 0 1 /end FIX_AXIS_PAR_LIST READ_ONLY /end AXIS_DESCR
/end CHARACTERISTIC
/begin CHARACTERISTIC XSCHGW_FP_DERS "" VALUE 0x2761EE _REC_S1VAL_1_u2_S2 10000 _CNV_R_R_Umr_1_zu_1_7_CM_S2 0 10000 FORMAT "%2.0" /end CHARACTERISTIC
/begin CHARACTERISTIC XS_DERS_BAB_AKTIV "" VALUE 0x27B4E2 _REC_S1VAL_1_u1_S2 1 _CNV_R_R_Umr_1_zu_1_2_CM_S2 0 1 FORMAT "%2.0" /end CHARACTERISTIC
/begin CHARACTERISTIC XS_USE_LWVA_XT_DERS "" VALUE 0x27B4E3 _REC_S1VAL_1_u1_S2 1 _CNV_R_R_Umr_1_zu_1_2_CM_S2 0 1 FORMAT "%2.0" /end CHARACTERISTIC
/begin CHARACTERISTIC XT_DERS "" VALUE 0x2761F0 _REC_S1VAL_1_u2_S2 10000 _CNV_R_R_Umr_1_zu_1_6_CM_S2 0 10000 FORMAT "%2.0" /end CHARACTERISTIC
/begin CHARACTERISTIC XZ_DERS_WAIT "" VALUE 0x27B5BF _REC_S1VAL_1_u1_S2 2 _CNV_R_R_Umr_1_zu_1_2_CM_S2 0 2 FORMAT "%2.0" /end CHARACTERISTIC
/begin CHARACTERISTIC XTAB2FILT_REK_ZUGERK_MMOTDMEE "" CURVE 0x270E70 _REC_A1CUR_30_s2_u1_S2 200 _CNV_R_R_Umr_1_zu_1_2_CM_S2 0 200 FORMAT "%2.0"
 /begin AXIS_DESCR FIX_AXIS NO_INPUT_QUANTITY _CNV_S_2_Enum_EGEW__16_CM_S2 2 0 1 /begin FIX_AXIS_PAR_LIST 0 1 /end FIX_AXIS_PAR_LIST READ_ONLY /end AXIS_DESCR
/end CHARACTERISTIC
/begin CHARACTERISTIC XTAB2Z_SPORT "" CURVE 0x279440 _REC_A1CUR_30_u1_u1_S2 1 _CNV_S_2_Enum_ESPOR_253_CM_S2 0 1
 /begin AXIS_DESCR FIX_AXIS S_COD_GETRTYP _CNV_S_2_Enum_ECOD__23_CM_S2 2 0 1 FIX_AXIS_PAR_DIST 0 1 2 READ_ONLY /end AXIS_DESCR
/end CHARACTERISTIC
/begin CHARACTERISTIC XTAB3SCHGM_MOT_FW_HKOR "" CURVE 0x279688 _REC_S7CUR_53_u2_u2_S2 250 _CNV_R_R_Umr_1_zu_1_2_CM_S2 0 250 FORMAT "%2.0"
 /begin AXIS_DESCR STD_AXIS P_LUFT _CNV_R_R_Umr_1_zu_1_0_CM_S2 3 598 1108 FORMAT "%2.0" /end AXIS_DESCR
/end CHARACTERISTIC
/begin CHARACTERISTIC XTAB3SCHM_MOT_FW_HKOR "" CURVE 0x279696 _REC_S7CUR_53_u2_s2_S2 2500 _CNV_R_R_Umr_1_zu_1_248_CM_S2 0 2500 FORMAT "%2.0"
 /begin AXIS_DESCR STD_AXIS DM_AB_FWSKOR_FILTFAST_BGH _CNV_R_R_Umr_1_zu_1_42_CM_S2 3 -32768 32767 FORMAT "%2.0" /end AXIS_DESCR
/end CHARACTERISTIC
/begin CHARACTERISTIC XTAB3T_EFAHR_AUS "" CURVE 0x27651E _REC_A1CUR_30_u2_u1_S2 5000 _CNV_R_R_Umr_1_zu_1_6_CM_S2 0 5000
 /begin AXIS_DESCR FIX_AXIS Z_EFAHR_AUSSTIEG _CNV_S_3_Enum_EEFAH_251_CM_S2 3 0 2 FIX_AXIS_PAR_DIST 0 1 3 READ_ONLY /end AXIS_DESCR
/end CHARACTERISTIC
/begin CHARACTERISTIC XTAB4FAKT_DN_HSZIEL_HKORTEMP "" CURVE 0x279A6E _REC_S7CUR_53_s2_s2_S2 20 _CNV_R_R_Umr_100_zu_54_CM_S2 -10 10 FORMAT "%4.2" /begin AXIS_DESCR STD_AXIS TEMP_UMG _CNV_R_R_Umr_1_zu_1_1_CM_S2 4 -100 200 /end AXIS_DESCR /end CHARACTERISTIC
/begin CHARACTERISTIC XTAB4FAKT_N_HS_DYN "" CURVE 0x279856 _REC_S7CUR_53_u2_u2_S2 200 _CNV_R_R_Umr_1_zu_1_53_CM_S2 0 200 FORMAT "%3.1"
 /begin AXIS_DESCR STD_AXIS N_MOT_HSVIRT_STAT _CNV_R_R_Umr_1_zu_1_3_CM_S2 4 0 12000 FORMAT "%3.1" /end AXIS_DESCR
/end CHARACTERISTIC
/begin CHARACTERISTIC XTAB4SCH_FAKT_DREHZAHLANGLEICH "" CURVE 0x270E74 _REC_A1CUR_30_u2_u1_S2 1 _CNV_R_R_Umr_100_zu_54_CM_S2 0 1 FORMAT "%4.2"
 /begin AXIS_DESCR FIX_AXIS Z_SCHALTUNGSTYP _CNV_S_6_Enum_ESCHA_152_CM_S2 6 0 5 /begin FIX_AXIS_PAR_LIST 0 1 2 3 4 5 /end FIX_AXIS_PAR_LIST READ_ONLY /end AXIS_DESCR
/end CHARACTERISTIC
/begin CHARACTERISTIC XTAB4X4DN_HSZIEL_HKORPLUFT "" MAP 0x279A80 _REC_S7MAP_53_u2_s2_u2_S2 1000 _CNV_R_R_Umr_1_zu_1_3_CM_S2 0 1000 FORMAT "%2.0"
 /begin AXIS_DESCR STD_AXIS G2W_AB_DYNHSPV _CNV_R_R_Umr_10_zu__181_CM_S2 4 -3276.8 3276.7 FORMAT "%3.1" /end AXIS_DESCR
 /begin AXIS_DESCR STD_AXIS P_LUFT _CNV_R_R_Umr_1_zu_1_0_CM_S2 4 0 65535 FORMAT "%2.0" /end AXIS_DESCR
/end CHARACTERISTIC
/begin CHARACTERISTIC XTAB4X6Z_BEDEL_FT_AGS "" MAP 0x273A28 _REC_A1MAP_9_u1_u1_u1_S2 1 _CNV_S_2_Enum_EAGS_25_CM_S2 0 1
 /begin AXIS_DESCR FIX_AXIS Z_PROG_MODE _CNV_S_4_Enum_EPROG_35_CM_S2 4 0 3 FIX_AXIS_PAR_DIST 0 1 4 READ_ONLY /end AXIS_DESCR
 /begin AXIS_DESCR FIX_AXIS Z_DRIVELOGIC _CNV_S_6_Enum_EDL_11_CM_S2 6 1 6 FIX_AXIS_PAR_DIST 1 1 6 READ_ONLY /end AXIS_DESCR
/end CHARACTERISTIC
/begin CHARACTERISTIC XTAB5GEW_NTNAB_SCHALT_DYNHSPV "" CURVE 0x279868 _REC_S7CUR_53_u2_u2_S2 1000 _CNV_R_R_Umr_1_zu_1_2_CM_S2 0 1000 FORMAT "%2.0"
 /begin AXIS_DESCR STD_AXIS N_RELATION_VAHA _CNV_R_R_Umr_100_zu_54_CM_S2 5 0 2.5 FORMAT "%4.2" /end AXIS_DESCR
/end CHARACTERISTIC
/begin CHARACTERISTIC XTAB5ON_MOT_HSZIEL_HKOR "" CURVE 0x279AB2 _REC_A1CUR_30_u2_u1_S2 2000 _CNV_R_R_Umr_1_zu_1_3_CM_S2 0 2000 FORMAT "%2.0"
 /begin AXIS_DESCR FIX_AXIS Z_NMOTHSTUPEL_FFG _CNV_S_5_Enum_ETUPE_32_CM_S2 5 0 4 FIX_AXIS_PAR_DIST 0 1 5 READ_ONLY /end AXIS_DESCR
/end CHARACTERISTIC
/begin CHARACTERISTIC XTAB5SCHGN_TRAD_MAX "" CURVE 0x27987E _REC_S7CUR_53_s2_u2_S2 100 _CNV_R_R_Umr_100_zu_254_CM_S2 0 100 FORMAT "%4.2"
 /begin AXIS_DESCR STD_AXIS I_STRANG_NMOT_HSVIRT _CNV_R_R_Umr_80_zu__252_CM_S2 5 0 520 FORMAT "%4.2" /end AXIS_DESCR
/end CHARACTERISTIC
/begin CHARACTERISTIC XTAB5S_PROGENBL_HSZIEL_HKOR "" CURVE 0x27B6D4 _REC_A1CUR_30_u1_u1_S2 1 _CNV_R_R_Umr_1_zu_1_2_CM_S2 0 1
 /begin AXIS_DESCR FIX_AXIS Z_DRIVE_PROG_FFG _CNV_S_5_Enum_ZDRIV_27_CM_S2 5 0 4 /begin FIX_AXIS_PAR_LIST 0 1 2 3 4 /end FIX_AXIS_PAR_LIST READ_ONLY /end AXIS_DESCR
/end CHARACTERISTIC
/begin CHARACTERISTIC XTAB5X2FILT_DYNHSPV_0 "" MAP 0x279894 _REC_S3MAP_54_u1_u2_u1_S2 2 _CNV_R_R_Umr_100_zu_54_CM_S2 0 2 FORMAT "%4.2"
 /begin AXIS_DESCR STD_AXIS N_MOT_DYNHSPV _CNV_R_R_Umr_1_zu_1_3_CM_S2 5 0 20000 FORMAT "%2.0" /end AXIS_DESCR
 /begin AXIS_DESCR FIX_AXIS NO_INPUT_QUANTITY _CNV_S_2_Enum_EPT1__21_CM_S2 2 0 1 /begin FIX_AXIS_PAR_LIST 0 1 /end FIX_AXIS_PAR_LIST READ_ONLY /end AXIS_DESCR
/end CHARACTERISTIC
/begin CHARACTERISTIC XTAB5X2FILT_DYNHSPV_1 "" MAP 0x2798AA _REC_S3MAP_54_u1_u2_u1_S2 2 _CNV_R_R_Umr_100_zu_54_CM_S2 0 2 FORMAT "%4.2"
 /begin AXIS_DESCR STD_AXIS N_MOT_DYNHSPV _CNV_R_R_Umr_1_zu_1_3_CM_S2 5 0 20000 FORMAT "%2.0" /end AXIS_DESCR
 /begin AXIS_DESCR FIX_AXIS NO_INPUT_QUANTITY _CNV_S_2_Enum_EPT1__21_CM_S2 2 0 1 /begin FIX_AXIS_PAR_LIST 0 1 /end FIX_AXIS_PAR_LIST READ_ONLY /end AXIS_DESCR
/end CHARACTERISTIC
/begin CHARACTERISTIC XTAB5X2FILT_DYNHSPV_2 "" MAP 0x2798C0 _REC_S3MAP_54_u1_u2_u1_S2 2 _CNV_R_R_Umr_100_zu_54_CM_S2 0 2 FORMAT "%4.2"
 /begin AXIS_DESCR STD_AXIS N_MOT_DYNHSPV _CNV_R_R_Umr_1_zu_1_3_CM_S2 5 0 20000 FORMAT "%2.0" /end AXIS_DESCR
 /begin AXIS_DESCR FIX_AXIS NO_INPUT_QUANTITY _CNV_S_2_Enum_EPT1__21_CM_S2 2 0 1 /begin FIX_AXIS_PAR_LIST 0 1 /end FIX_AXIS_PAR_LIST READ_ONLY /end AXIS_DESCR
/end CHARACTERISTIC
/begin CHARACTERISTIC XTAB5X2FILT_DYNHSPV_3 "" MAP 0x2798D6 _REC_S3MAP_54_u1_u2_u1_S2 2 _CNV_R_R_Umr_100_zu_54_CM_S2 0 2 FORMAT "%4.2"
 /begin AXIS_DESCR STD_AXIS N_MOT_DYNHSPV _CNV_R_R_Umr_1_zu_1_3_CM_S2 5 0 20000 FORMAT "%2.0" /end AXIS_DESCR
 /begin AXIS_DESCR FIX_AXIS NO_INPUT_QUANTITY _CNV_S_2_Enum_EPT1__21_CM_S2 2 0 1 /begin FIX_AXIS_PAR_LIST 0 1 /end FIX_AXIS_PAR_LIST READ_ONLY /end AXIS_DESCR
/end CHARACTERISTIC
/begin CHARACTERISTIC XTAB5X2FILT_DYNHSPV_4 "" MAP 0x2798EC _REC_S3MAP_54_u1_u2_u1_S2 2 _CNV_R_R_Umr_100_zu_54_CM_S2 0 2 FORMAT "%4.2"
 /begin AXIS_DESCR STD_AXIS N_MOT_DYNHSPV _CNV_R_R_Umr_1_zu_1_3_CM_S2 5 0 20000 FORMAT "%2.0" /end AXIS_DESCR
 /begin AXIS_DESCR FIX_AXIS NO_INPUT_QUANTITY _CNV_S_2_Enum_EPT1__21_CM_S2 2 0 1 /begin FIX_AXIS_PAR_LIST 0 1 /end FIX_AXIS_PAR_LIST READ_ONLY /end AXIS_DESCR
/end CHARACTERISTIC
/begin CHARACTERISTIC XTAB5X2FILT_DYNHSPV_5 "" MAP 0x279902 _REC_S3MAP_54_u1_u2_u1_S2 2 _CNV_R_R_Umr_100_zu_54_CM_S2 0 2 FORMAT "%4.2"
 /begin AXIS_DESCR STD_AXIS N_MOT_DYNHSPV _CNV_R_R_Umr_1_zu_1_3_CM_S2 5 0 20000 FORMAT "%2.0" /end AXIS_DESCR
 /begin AXIS_DESCR FIX_AXIS NO_INPUT_QUANTITY _CNV_S_2_Enum_EPT1__21_CM_S2 2 0 1 /begin FIX_AXIS_PAR_LIST 0 1 /end FIX_AXIS_PAR_LIST READ_ONLY /end AXIS_DESCR
/end CHARACTERISTIC
/begin CHARACTERISTIC XTAB5X2FILT_DYNHSPV_6 "" MAP 0x279918 _REC_S3MAP_54_u1_u2_u1_S2 2 _CNV_R_R_Umr_100_zu_54_CM_S2 0 2 FORMAT "%4.2"
 /begin AXIS_DESCR STD_AXIS N_MOT_DYNHSPV _CNV_R_R_Umr_1_zu_1_3_CM_S2 5 0 20000 FORMAT "%2.0" /end AXIS_DESCR
 /begin AXIS_DESCR FIX_AXIS NO_INPUT_QUANTITY _CNV_S_2_Enum_EPT1__21_CM_S2 2 0 1 /begin FIX_AXIS_PAR_LIST 0 1 /end FIX_AXIS_PAR_LIST READ_ONLY /end AXIS_DESCR
/end CHARACTERISTIC
/begin CHARACTERISTIC XTAB5X2FILT_DYNHSPV_7 "" MAP 0x27992E _REC_S3MAP_54_u1_u2_u1_S2 2 _CNV_R_R_Umr_100_zu_54_CM_S2 0 2 FORMAT "%4.2"
 /begin AXIS_DESCR STD_AXIS N_MOT_DYNHSPV _CNV_R_R_Umr_1_zu_1_3_CM_S2 5 0 20000 FORMAT "%2.0" /end AXIS_DESCR
 /begin AXIS_DESCR FIX_AXIS NO_INPUT_QUANTITY _CNV_S_2_Enum_EPT1__21_CM_S2 2 0 1 /begin FIX_AXIS_PAR_LIST 0 1 /end FIX_AXIS_PAR_LIST READ_ONLY /end AXIS_DESCR
/end CHARACTERISTIC
/begin CHARACTERISTIC XTAB5X2FILT_DYNHSPV_8 "" MAP 0x279944 _REC_S3MAP_54_u1_u2_u1_S2 2 _CNV_R_R_Umr_100_zu_54_CM_S2 0 2 FORMAT "%4.2"
 /begin AXIS_DESCR STD_AXIS N_MOT_DYNHSPV _CNV_R_R_Umr_1_zu_1_3_CM_S2 5 0 20000 FORMAT "%2.0" /end AXIS_DESCR
 /begin AXIS_DESCR FIX_AXIS NO_INPUT_QUANTITY _CNV_S_2_Enum_EPT1__21_CM_S2 2 0 1 /begin FIX_AXIS_PAR_LIST 0 1 /end FIX_AXIS_PAR_LIST READ_ONLY /end AXIS_DESCR
/end CHARACTERISTIC
/begin CHARACTERISTIC XTAB5X2FILT_DYNHSPV_9 "" MAP 0x27995A _REC_S3MAP_54_u1_u2_u1_S2 2 _CNV_R_R_Umr_100_zu_54_CM_S2 0 2 FORMAT "%4.2"
 /begin AXIS_DESCR STD_AXIS N_MOT_DYNHSPV _CNV_R_R_Umr_1_zu_1_3_CM_S2 5 0 20000 FORMAT "%2.0" /end AXIS_DESCR
 /begin AXIS_DESCR FIX_AXIS NO_INPUT_QUANTITY _CNV_S_2_Enum_EPT1__21_CM_S2 2 0 1 /begin FIX_AXIS_PAR_LIST 0 1 /end FIX_AXIS_PAR_LIST READ_ONLY /end AXIS_DESCR
/end CHARACTERISTIC
/begin CHARACTERISTIC XTAB5X3FAKT_M_MOTDYNMAX_DYNKOR "" MAP 0x2737D8 _REC_S7MAP_53_u2_u2_s2_S2 100 _CNV_R_R_Umr_1_zu_1_53_CM_S2 0 100 FORMAT "%2.0"
 /begin AXIS_DESCR STD_AXIS I_STRANG_NMOT_HSVIRT _CNV_R_R_Umr_80_zu__252_CM_S2 5 0 520 FORMAT "%4.2" /end AXIS_DESCR
 /begin AXIS_DESCR STD_AXIS M_MOT_STAT _CNV_R_R_Umr_1_zu_1_42_CM_S2 3 0 1000 FORMAT "%2.0" /end AXIS_DESCR
/end CHARACTERISTIC
/begin CHARACTERISTIC XTAB5X5FAKT_HKORROH "" MAP 0x273808 _REC_S7MAP_53_u2_s2_u2_S2 250 _CNV_R_R_Umr_1_zu_1_53_CM_S2 0 250 FORMAT "%2.0"
 /begin AXIS_DESCR STD_AXIS TEMP_UMG _CNV_R_R_Umr_1_zu_1_1_CM_S2 5 -50 80 FORMAT "%2.0" /end AXIS_DESCR
 /begin AXIS_DESCR STD_AXIS P_LUFT _CNV_R_R_Umr_1_zu_1_0_CM_S2 5 598 1108 FORMAT "%2.0" /end AXIS_DESCR
/end CHARACTERISTIC
/begin CHARACTERISTIC XTAB5X5FAKT_M_MOTDYN_HKOR "" MAP 0x273850 _REC_S7MAP_53_u2_u2_u2_S2 200 _CNV_R_R_Umr_1_zu_1_53_CM_S2 0 200 FORMAT "%2.0"
 /begin AXIS_DESCR STD_AXIS N_GE_NAB_ZIELGANG _CNV_R_R_Umr_1_zu_1_3_CM_S2 5 0 10000 FORMAT "%2.0" /end AXIS_DESCR
 /begin AXIS_DESCR STD_AXIS VM_MOT_ISTFW_KOR _CNV_R_R_Umr_100_zu_104_CM_S2 5 0 2 FORMAT "%4.2" /end AXIS_DESCR
/end CHARACTERISTIC
/begin CHARACTERISTIC XTAB5X5VM_MOT_ISTFW_DYNKOR "" MAP 0x273898 _REC_S7MAP_53_u2_s2_u2_S2 3 _CNV_R_R_Umr_100_zu_104_CM_S2 0 3 FORMAT "%4.2"
 /begin AXIS_DESCR STD_AXIS GM_MOT_FW_FILTMAX _CNV_R_R_Umr_1_zu_1_199_CM_S2 5 0 1000 FORMAT "%3.1" /end AXIS_DESCR
 /begin AXIS_DESCR STD_AXIS VM_MOT_ISTFW_FILT _CNV_R_R_Umr_100_zu_104_CM_S2 5 0 2 FORMAT "%4.2" /end AXIS_DESCR
/end CHARACTERISTIC
/begin CHARACTERISTIC XTAB5X9G2W_AB_REFDYNHSPV "" MAP 0x279970 _REC_S3MAP_54_s2_u2_u1_S2 6553.5 _CNV_R_R_Umr_10_zu__181_CM_S2 -3276.8 3276.7 FORMAT "%3.1"
 /begin AXIS_DESCR STD_AXIS N_MOT _CNV_R_R_Umr_1_zu_1_3_CM_S2 5 0 20000 FORMAT "%2.0" /end AXIS_DESCR
 /begin AXIS_DESCR FIX_AXIS Z_GANG_ZIEL _CNV_S_9_Enum_EGANG_30_CM_S2 9 0 8 FIX_AXIS_PAR_DIST 0 1 9 READ_ONLY /end AXIS_DESCR
/end CHARACTERISTIC
/begin CHARACTERISTIC XTAB6X4Z_HSZIEL_FLM_0 "" MAP 0x2739F8 _REC_A1MAP_9_u1_u1_u1_S2 1 _CNV_R_R_Umr_1_zu_1_2_CM_S2 0 1 FORMAT "%2.0"
 /begin AXIS_DESCR FIX_AXIS Z_DRIVELOGIC _CNV_S_6_Enum_EDL_11_CM_S2 6 1 6 FIX_AXIS_PAR_DIST 1 1 6 READ_ONLY /end AXIS_DESCR
 /begin AXIS_DESCR FIX_AXIS Z_PROG_MODE _CNV_S_4_Enum_EPROG_35_CM_S2 4 0 3 FIX_AXIS_PAR_DIST 0 1 4 READ_ONLY /end AXIS_DESCR
/end CHARACTERISTIC
/begin CHARACTERISTIC XTAB6X4Z_HSZIEL_FLM_1 "" MAP 0x273A10 _REC_A1MAP_9_u1_u1_u1_S2 1 _CNV_R_R_Umr_1_zu_1_2_CM_S2 0 1 FORMAT "%2.0"
 /begin AXIS_DESCR FIX_AXIS Z_DRIVELOGIC _CNV_S_6_Enum_EDL_11_CM_S2 6 1 6 FIX_AXIS_PAR_DIST 1 1 6 READ_ONLY /end AXIS_DESCR
 /begin AXIS_DESCR FIX_AXIS Z_PROG_MODE _CNV_S_4_Enum_EPROG_35_CM_S2 4 0 3 FIX_AXIS_PAR_DIST 0 1 4 READ_ONLY /end AXIS_DESCR
/end CHARACTERISTIC
/begin CHARACTERISTIC XTAB8X3FILTKOR_DYNHSPV_DSCOFF "" MAP 0x2738FC _REC_S7MAP_53_u2_s2_u2_S2 50000 _CNV_R_R_Umr_1_zu_1_53_CM_S2 0 50000 FORMAT "%2.0"
 /begin AXIS_DESCR STD_AXIS G2W_AB_DYNHSPV _CNV_R_R_Umr_10_zu__181_CM_S2 8 -3276.8 3276.7 FORMAT "%3.1" /end AXIS_DESCR
 /begin AXIS_DESCR STD_AXIS N_GETR_EINGANG_ZIEL _CNV_R_R_Umr_1_zu_1_3_CM_S2 3 0 10000 FORMAT "%2.0" /end AXIS_DESCR
/end CHARACTERISTIC
/begin CHARACTERISTIC XTAB8X3FILTKOR_DYNHSPV_DSCON "" MAP 0x273944 _REC_S7MAP_53_u2_s2_u2_S2 50000 _CNV_R_R_Umr_1_zu_1_53_CM_S2 0 50000 FORMAT "%2.0"
 /begin AXIS_DESCR STD_AXIS G2W_AB_DYNHSPV _CNV_R_R_Umr_10_zu__181_CM_S2 8 -3276.8 3276.7 FORMAT "%3.1" /end AXIS_DESCR
 /begin AXIS_DESCR STD_AXIS N_GETR_EINGANG_ZIEL _CNV_R_R_Umr_1_zu_1_3_CM_S2 3 0 10000 FORMAT "%2.0" /end AXIS_DESCR
/end CHARACTERISTIC
/begin CHARACTERISTIC XTAB8X3FILTKOR_DYNHSPV_DTC "" MAP 0x27398C _REC_S7MAP_53_u2_s2_u2_S2 50000 _CNV_R_R_Umr_1_zu_1_53_CM_S2 0 50000 FORMAT "%2.0"
 /begin AXIS_DESCR STD_AXIS G2W_AB_DYNHSPV _CNV_R_R_Umr_10_zu__181_CM_S2 8 -3276.8 3276.7 FORMAT "%3.1" /end AXIS_DESCR
 /begin AXIS_DESCR STD_AXIS N_GETR_EINGANG_ZIEL _CNV_R_R_Umr_1_zu_1_3_CM_S2 3 0 10000 FORMAT "%2.0" /end AXIS_DESCR
/end CHARACTERISTIC
/begin CHARACTERISTIC XTAB9N_MOT_DYNHSPV "" CURVE 0x2799D6 _REC_A1CUR_30_u2_u1_S2 20000 _CNV_R_R_Umr_1_zu_1_3_CM_S2 0 20000 FORMAT "%2.0"
 /begin AXIS_DESCR FIX_AXIS Z_GANG_ZIEL _CNV_S_9_Enum_EGANG_30_CM_S2 9 0 8 FIX_AXIS_PAR_DIST 0 1 9 READ_ONLY /end AXIS_DESCR
/end CHARACTERISTIC
/begin CHARACTERISTIC XTAB9SCHN_MOT_HSZIEL_FLM "" CURVE 0x279ABC _REC_A1CUR_30_u2_u1_S2 20000 _CNV_R_R_Umr_1_zu_1_3_CM_S2 0 20000 FORMAT "%2.0"
 /begin AXIS_DESCR FIX_AXIS Z_GANG_ZIEL _CNV_S_9_Enum_EGANG_30_CM_S2 9 0 8 FIX_AXIS_PAR_DIST 0 1 9 READ_ONLY /end AXIS_DESCR
/end CHARACTERISTIC
/begin CHARACTERISTIC XTAB9X4_DYNHSPV_IDX "" MAP 0x2739D4 _REC_A1MAP_9_u1_u1_u1_S2 9 _CNV_R_R_Umr_1_zu_1_2_CM_S2 0 9 FORMAT "%2.0"
 /begin AXIS_DESCR FIX_AXIS Z_GANG_ZIEL _CNV_S_9_Enum_EGANG_30_CM_S2 9 0 8 FIX_AXIS_PAR_DIST 0 1 9 READ_ONLY /end AXIS_DESCR
 /begin AXIS_DESCR FIX_AXIS NO_INPUT_QUANTITY _CNV_S_7_Enum_ESDYN_151_CM_S2 4 0 6 /begin FIX_AXIS_PAR_LIST 0 1 2 3 /end FIX_AXIS_PAR_LIST READ_ONLY /end AXIS_DESCR
/end CHARACTERISTIC
/begin CHARACTERISTIC XTAB9X5SCHN_MOT_HSZIELKD "" MAP 0x279ACE _REC_A1MAP_9_u2_u1_u1_S2 10000 _CNV_R_R_Umr_1_zu_1_3_CM_S2 0 10000 FORMAT "%2.0"
 /begin AXIS_DESCR FIX_AXIS Z_GANG_ZIEL _CNV_S_9_Enum_EGANG_30_CM_S2 9 0 8 FIX_AXIS_PAR_DIST 0 1 9 READ_ONLY /end AXIS_DESCR
 /begin AXIS_DESCR FIX_AXIS Z_NMOTHSTUPEL_FFG _CNV_S_5_Enum_ETUPE_32_CM_S2 5 0 4 FIX_AXIS_PAR_DIST 0 1 5 READ_ONLY /end AXIS_DESCR
/end CHARACTERISTIC
/begin CHARACTERISTIC XTAB9X5SCHN_MOT_HSZIEL_0 "" MAP 0x279B28 _REC_A1MAP_9_u2_u1_u1_S2 10000 _CNV_R_R_Umr_1_zu_1_3_CM_S2 0 10000 FORMAT "%2.0"
 /begin AXIS_DESCR FIX_AXIS Z_GANG_ZIEL _CNV_S_9_Enum_EGANG_30_CM_S2 9 0 8 FIX_AXIS_PAR_DIST 0 1 9 READ_ONLY /end AXIS_DESCR
 /begin AXIS_DESCR FIX_AXIS Z_NMOTHSTUPEL_FFG _CNV_S_5_Enum_ETUPE_32_CM_S2 5 0 4 FIX_AXIS_PAR_DIST 0 1 5 READ_ONLY /end AXIS_DESCR
/end CHARACTERISTIC
/begin CHARACTERISTIC XTAB9X5SCHN_MOT_RSZIELKD "" MAP 0x279B82 _REC_A1MAP_9_u2_u1_u1_S2 10000 _CNV_R_R_Umr_1_zu_1_3_CM_S2 0 10000 FORMAT "%2.0"
 /begin AXIS_DESCR FIX_AXIS Z_GANG_ZIEL _CNV_S_9_Enum_EGANG_30_CM_S2 9 0 8 FIX_AXIS_PAR_DIST 0 1 9 READ_ONLY /end AXIS_DESCR
 /begin AXIS_DESCR FIX_AXIS Z_NMOTHSTUPEL_FFG _CNV_S_5_Enum_ETUPE_32_CM_S2 5 0 4 FIX_AXIS_PAR_DIST 0 1 5 READ_ONLY /end AXIS_DESCR
/end CHARACTERISTIC
/begin CHARACTERISTIC XTAB9X5SCHN_MOT_RSZIEL_0 "" MAP 0x279BDC _REC_A1MAP_9_u2_u1_u1_S2 10000 _CNV_R_R_Umr_1_zu_1_3_CM_S2 0 10000 FORMAT "%2.0"
 /begin AXIS_DESCR FIX_AXIS Z_GANG_ZIEL _CNV_S_9_Enum_EGANG_30_CM_S2 9 0 8 FIX_AXIS_PAR_DIST 0 1 9 READ_ONLY /end AXIS_DESCR
 /begin AXIS_DESCR FIX_AXIS Z_NMOTHSTUPEL_FFG _CNV_S_5_Enum_ETUPE_32_CM_S2 5 0 4 FIX_AXIS_PAR_DIST 0 1 5 READ_ONLY /end AXIS_DESCR
/end CHARACTERISTIC
/begin CHARACTERISTIC XTAB9X7_KORREKTUR_HSZEITNMOTHS "" MAP 0x2799E8 _REC_A1MAP_9_u2_u1_u1_S2 1300 _CNV_R_R_Umr_1_zu_1_53_CM_S2 0 1300 FORMAT "%2.0"
 /begin AXIS_DESCR FIX_AXIS Z_GANG_ZIEL _CNV_S_9_Enum_EGANG_30_CM_S2 9 0 8 FIX_AXIS_PAR_DIST 0 1 9 READ_ONLY /end AXIS_DESCR
 /begin AXIS_DESCR FIX_AXIS Z_SCHALTDYN _CNV_S_7_Enum_ESDYN_151_CM_S2 7 0 6 FIX_AXIS_PAR_DIST 0 1 7 READ_ONLY /end AXIS_DESCR
/end CHARACTERISTIC
/begin CHARACTERISTIC XFAKT_ANGLEICH_M_RAD_RSU "" VALUE 0x27B6A3 _REC_S1VAL_1_u1_S2 1 _CNV_R_R_Umr_100_zu_54_CM_S2 0 1 FORMAT "%4.2" /end CHARACTERISTIC
/begin CHARACTERISTIC XFAKT_FILTKORSCHALT_DYNHSPV "" VALUE 0x279A66 _REC_S1VAL_1_u2_S2 50000 _CNV_R_R_Umr_1_zu_1_53_CM_S2 0 50000 FORMAT "%2.0" /end CHARACTERISTIC
/begin CHARACTERISTIC XFAKT_SCHLUPF_DYNHSPV "" VALUE 0x27B6CC _REC_S1VAL_1_u1_S2 2.5 _CNV_R_R_Umr_100_zu_54_CM_S2 0 2.5 FORMAT "%4.2" /end CHARACTERISTIC
/begin CHARACTERISTIC XGM_BR_SOLL_INGEW "" VALUE 0x279430 _REC_S1VAL_1_u2_S2 20000 _CNV_R_R_Umr_1_zu_1_2_CM_S2 0 20000 FORMAT "%2.0" /end CHARACTERISTIC
/begin CHARACTERISTIC XGM_BR_SOLL_OUTGEW "" VALUE 0x279432 _REC_S1VAL_1_u2_S2 20000 _CNV_R_R_Umr_1_zu_1_2_CM_S2 0 20000 FORMAT "%2.0" /end CHARACTERISTIC
/begin CHARACTERISTIC XGN_T_INGEW "" VALUE 0x279680 _REC_S1VAL_1_s2_S2 10000 _CNV_R_R_Umr_1_zu_1_2_CM_S2 0 10000 FORMAT "%2.0" /end CHARACTERISTIC
/begin CHARACTERISTIC XGN_T_OUTGEW "" VALUE 0x279682 _REC_S1VAL_1_s2_S2 10000 _CNV_R_R_Umr_1_zu_1_2_CM_S2 0 10000 FORMAT "%2.0" /end CHARACTERISTIC
/begin CHARACTERISTIC XHM_BR_SOLL_FESTBREMS "" VALUE 0x279434 _REC_S1VAL_1_u2_S2 10000 _CNV_R_R_Umr_1_zu_1_42_CM_S2 0 10000 FORMAT "%2.0" /end CHARACTERISTIC
/begin CHARACTERISTIC XHM_MOT_FW_HKOR "" VALUE 0x27B6A9 _REC_S1VAL_1_u1_S2 250 _CNV_R_R_Umr_1_zu_1_42_CM_S2 0 250 FORMAT "%2.0" /end CHARACTERISTIC
/begin CHARACTERISTIC XHV_FZG_HKOR "" VALUE 0x2796A4 _REC_S1VAL_1_u2_S2 400 _CNV_R_R_Umr_1_zu_1_8_CM_S2 0 400 FORMAT "%2.0" /end CHARACTERISTIC
/begin CHARACTERISTIC XLAYERIN_TRPMOD_TIPSIGNALE "" VALUE 0x27AF35 _REC_S1VAL_1_u1_S2 1 _CNV_R_R_Umr_1_zu_1_2_CM_S2 0 1 FORMAT "%2.0" /end CHARACTERISTIC
/begin CHARACTERISTIC XM_BR_SOLL_OUTGEW "" VALUE 0x27AF37 _REC_S1VAL_1_u1_S2 255 _CNV_R_R_Umr_1_zu_1_2_CM_S2 0 255 FORMAT "%2.0" /end CHARACTERISTIC
/begin CHARACTERISTIC XM_MOTFW_FILT_INGEW "" VALUE 0x27B6AA _REC_S1VAL_1_u1_S2 250 _CNV_R_R_Umr_1_zu_1_2_CM_S2 0 250 FORMAT "%2.0" /end CHARACTERISTIC
/begin CHARACTERISTIC XM_MOTFW_FILT_OUTGEW "" VALUE 0x27B6AB _REC_S1VAL_1_u1_S2 250 _CNV_R_R_Umr_1_zu_1_2_CM_S2 0 250 FORMAT "%2.0" /end CHARACTERISTIC
/begin CHARACTERISTIC XN_MOTGEW_DYNHSPV "" VALUE 0x27B6CD _REC_S1VAL_1_u1_S2 250 _CNV_R_R_Umr_1_zu_1_2_CM_S2 0 250 FORMAT "%2.0" /end CHARACTERISTIC
/begin CHARACTERISTIC XN_MOTTURGEW_DYNHSPV "" VALUE 0x27B6CE _REC_S1VAL_1_u1_S2 250 _CNV_R_R_Umr_1_zu_1_2_CM_S2 0 250 FORMAT "%2.0" /end CHARACTERISTIC
/begin CHARACTERISTIC XN_TURGEW_DYNHSPV "" VALUE 0x27B6CF _REC_S1VAL_1_u1_S2 250 _CNV_R_R_Umr_1_zu_1_2_CM_S2 0 250 FORMAT "%2.0" /end CHARACTERISTIC
/begin CHARACTERISTIC XN_TURRADGEW_DYNHSPV "" VALUE 0x27B6D0 _REC_S1VAL_1_u1_S2 250 _CNV_R_R_Umr_1_zu_1_2_CM_S2 0 250 FORMAT "%2.0" /end CHARACTERISTIC
/begin CHARACTERISTIC XOM_RAD_REKUP_REKUPRS "" VALUE 0x279C38 _REC_S1VAL_1_s2_S2 100 _CNV_R_R_Umr_1_zu_1_42_CM_S2 0 100 FORMAT "%2.0" /end CHARACTERISTIC
/begin CHARACTERISTIC XOT_HSZEIT "" VALUE 0x279A68 _REC_S1VAL_1_u2_S2 65535 _CNV_R_R_Umr_1_zu_1_6_CM_S2 0 65535 FORMAT "%2.0" /end CHARACTERISTIC
/begin CHARACTERISTIC XP_LUFT_NORM "" VALUE 0x2796A6 _REC_S1VAL_1_u2_S2 510 _CNV_R_R_Umr_1_zu_1_0_CM_S2 598 1108 FORMAT "%2.0" /end CHARACTERISTIC
/begin CHARACTERISTIC XSCHC_FILT_LENGTHGNT "" VALUE 0x279684 _REC_S1VAL_1_u2_S2 15 _CNV_R_R_Umr_1_zu_1_2_CM_S2 1 16 FORMAT "%2.0" /end CHARACTERISTIC
/begin CHARACTERISTIC XSCHC_FILT_LENGTHGNTMED "" VALUE 0x279686 _REC_S1VAL_1_u2_S2 16 _CNV_R_R_Umr_1_zu_1_2_CM_S2 1 17 FORMAT "%2.0" /end CHARACTERISTIC
/begin CHARACTERISTIC XSCHC_QWSTEIGUNG "" VALUE 0x27B6DD _REC_S1VAL_1_u1_S2 255 _CNV_R_R_Umr_1_zu_1_2_CM_S2 0 255 FORMAT "%2.0" /end CHARACTERISTIC
/begin CHARACTERISTIC XSCHGN_MTTRAD_MAX "" VALUE 0x279A6A _REC_S1VAL_1_s2_S2 100 _CNV_R_R_Umr_100_zu_254_CM_S2 0 100 FORMAT "%4.2" /end CHARACTERISTIC
/begin CHARACTERISTIC XSCHGW_FP_EFAHR_AUS "" VALUE 0x276524 _REC_S1VAL_1_u2_S2 32000 _CNV_R_R_Umr_1_zu_1_7_CM_S2 0 32000 FORMAT "%2.0" /end CHARACTERISTIC
/begin CHARACTERISTIC XSCHM_BR_SOLL_FESTBREMS "" VALUE 0x279436 _REC_S1VAL_1_s2_S2 10000 _CNV_R_R_Umr_1_zu_1_42_CM_S2 -10000 0 FORMAT "%2.0" /end CHARACTERISTIC
/begin CHARACTERISTIC XSCHM_BR_SOLL_S_B "" VALUE 0x279438 _REC_S1VAL_1_s2_S2 32000 _CNV_R_R_Umr_1_zu_1_42_CM_S2 -32000 0 FORMAT "%2.0" /end CHARACTERISTIC
/begin CHARACTERISTIC XSCHM_MOT_DMEE_SCHUB "" VALUE 0x2757FC _REC_S1VAL_1_s2_S2 2000 _CNV_R_R_Umr_1_zu_1_42_CM_S2 -1000 1000 FORMAT "%2.0" /end CHARACTERISTIC
/begin CHARACTERISTIC XSCHM_MOT_DMEE_ZUG "" VALUE 0x2757FE _REC_S1VAL_1_s2_S2 2000 _CNV_R_R_Umr_1_zu_1_42_CM_S2 -1000 1000 FORMAT "%2.0" /end CHARACTERISTIC
/begin CHARACTERISTIC XSCHM_MOT_DMEE_ZUGNL "" VALUE 0x275800 _REC_S1VAL_1_s2_S2 2000 _CNV_R_R_Umr_1_zu_1_42_CM_S2 -1000 1000 FORMAT "%2.0" /end CHARACTERISTIC
/begin CHARACTERISTIC XSCHM_RAD_REKUP_REKUPRS "" VALUE 0x279C3A _REC_S1VAL_1_s2_S2 2046 _CNV_R_R_Umr_1_zu_1_42_CM_S2 -1023 1023 FORMAT "%2.0" /end CHARACTERISTIC
/begin CHARACTERISTIC XSCHM_T_FESTBREMS "" VALUE 0x27943A _REC_S1VAL_1_s2_S2 64000 _CNV_R_R_Umr_1_zu_1_42_CM_S2 -32000 32000 FORMAT "%2.0" /end CHARACTERISTIC
/begin CHARACTERISTIC XSCHN_AB_GN_TRAD "" VALUE 0x279A6C _REC_S1VAL_1_u2_S2 1000 _CNV_R_R_Umr_1_zu_1_3_CM_S2 0 1000 FORMAT "%2.0" /end CHARACTERISTIC
/begin CHARACTERISTIC XSCHN_MOT_LAEUFT "" VALUE 0x27652E _REC_S1VAL_1_u2_S2 1400 _CNV_R_R_Umr_1_zu_1_3_CM_S2 100 1500 FORMAT "%2.0" /end CHARACTERISTIC
/begin CHARACTERISTIC XSCHN_MOT_LM "" VALUE 0x276530 _REC_S1VAL_1_u2_S2 5000 _CNV_R_R_Umr_1_zu_1_3_CM_S2 0 5000 FORMAT "%2.0" /end CHARACTERISTIC
/begin CHARACTERISTIC XSCHN_MOT_MAX_TRPMOD "" VALUE 0x2757FA _REC_S1VAL_1_u2_S2 20000 _CNV_R_R_Umr_1_zu_1_3_CM_S2 0 20000 FORMAT "%2.0" /end CHARACTERISTIC
/begin CHARACTERISTIC XSCHV_FZG_EINTRAKTION_OBEN "" VALUE 0x27B653 _REC_S1VAL_1_u1_S2 250 _CNV_R_R_Umr_1_zu_1_8_CM_S2 0 250 FORMAT "%2.0" /end CHARACTERISTIC
/begin CHARACTERISTIC XSCHV_FZG_EINTRAKTION_UNTEN "" VALUE 0x27B654 _REC_S1VAL_1_u1_S2 250 _CNV_R_R_Umr_1_zu_1_8_CM_S2 0 250 FORMAT "%2.0" /end CHARACTERISTIC
/begin CHARACTERISTIC XSCHV_FZG_HKOR "" VALUE 0x2796A8 _REC_S1VAL_1_u2_S2 400 _CNV_R_R_Umr_1_zu_1_8_CM_S2 0 400 FORMAT "%2.0" /end CHARACTERISTIC
/begin CHARACTERISTIC XSCHV_RAD_DSCPLAUSI "" VALUE 0x27B6DF _REC_S1VAL_1_u1_S2 20 _CNV_R_R_Umr_1_zu_1_8_CM_S2 0 20 FORMAT "%2.0" /end CHARACTERISTIC
/begin CHARACTERISTIC XSCHW_DKKD_EIN_FESTBREMS "" VALUE 0x27943E _REC_S1VAL_1_u2_S2 110 _CNV_R_R_Umr_10_zu__9_CM_S2 0 110 FORMAT "%3.1" /end CHARACTERISTIC
/begin CHARACTERISTIC XSCHW_DKKD_ZUGERK "" VALUE 0x275802 _REC_S1VAL_1_u2_S2 110 _CNV_R_R_Umr_10_zu__9_CM_S2 0 110 FORMAT "%3.1" /end CHARACTERISTIC
/begin CHARACTERISTIC XSCHW_STEIGUNG_HKOR "" VALUE 0x2796AA _REC_S1VAL_1_s2_S2 400 _CNV_R_R_Umr_10_zu__9_CM_S2 -200 200 FORMAT "%3.1" /end CHARACTERISTIC
/begin CHARACTERISTIC XS_FILT_ZUGERK "" VALUE 0x27AF38 _REC_S1VAL_1_u1_S2 1 _CNV_R_R_Umr_1_zu_1_2_CM_S2 0 1 FORMAT "%2.0" /end CHARACTERISTIC
/begin CHARACTERISTIC XS_FT_MAXAAGSPOSD_FASLDM "" VALUE 0x27B6DC _REC_S1VAL_1_u1_S2 1 _CNV_R_R_Umr_1_zu_1_2_CM_S2 0 1 FORMAT "%2.0" /end CHARACTERISTIC
/begin CHARACTERISTIC XS_GNMTTRAD_FILTKORSCHALT "" VALUE 0x27B6D1 _REC_S1VAL_1_u1_S2 1 _CNV_S_2_Enum_EGNMT_261_CM_S2 0 1 /end CHARACTERISTIC
/begin CHARACTERISTIC XS_HSZIEL_FLM "" VALUE 0x27B6D9 _REC_S1VAL_1_u1_S2 1 _CNV_S_2_Schalter_A_4_CM_S2 0 1 /end CHARACTERISTIC
/begin CHARACTERISTIC XS_MIN_MMOTFW_MAXDME "" VALUE 0x27B6AC _REC_S1VAL_1_u1_S2 1 _CNV_R_R_Umr_1_zu_1_2_CM_S2 0 1 FORMAT "%2.0" /end CHARACTERISTIC
/begin CHARACTERISTIC XS_NGE_NMOTHSVIRT_HSZIEL_HKOR "" VALUE 0x27B6DA _REC_S1VAL_1_u1_S2 1 _CNV_R_R_Umr_1_zu_1_2_CM_S2 0 1 FORMAT "%2.0" /end CHARACTERISTIC
/begin CHARACTERISTIC XS_QW_STEIGUNG_DSCERR "" VALUE 0x27AF26 _REC_S1VAL_1_u1_S2 1 _CNV_S_2_Schalter_A_4_CM_S2 0 1 /end CHARACTERISTIC
/begin CHARACTERISTIC XS_STEIGUNGSKOR "" VALUE 0x27B6DE _REC_S1VAL_1_u1_S2 1 _CNV_S_2_Schalter_A_4_CM_S2 0 1 /end CHARACTERISTIC
/begin CHARACTERISTIC XS_ST_CON_MSA "" VALUE 0x27AF39 _REC_S1VAL_1_u1_S2 1 _CNV_R_R_Umr_1_zu_1_2_CM_S2 0 1 FORMAT "%2.0" /end CHARACTERISTIC
/begin CHARACTERISTIC XS_USE_AGS_N_POS "" VALUE 0x27AF22 _REC_S1VAL_1_u1_S2 1 _CNV_S_2_Schalter_A_4_CM_S2 0 1 /end CHARACTERISTIC
/begin CHARACTERISTIC XS_USE_BCA "" VALUE 0x27B64D _REC_S1VAL_1_u1_S2 1 _CNV_R_R_Umr_1_zu_1_2_CM_S2 0 1 FORMAT "%2.0" /end CHARACTERISTIC
/begin CHARACTERISTIC XS_USE_DYNHSPVFILT "" VALUE 0x27B6D2 _REC_S1VAL_1_u1_S2 1 _CNV_S_2_Enum_EDYNH_262_CM_S2 0 1 /end CHARACTERISTIC
/begin CHARACTERISTIC XS_USE_HSEARLIERLATERDSC "" VALUE 0x27B6A7 _REC_S1VAL_1_u1_S2 1 _CNV_R_R_Umr_1_zu_1_2_CM_S2 0 1 FORMAT "%2.0" /end CHARACTERISTIC
/begin CHARACTERISTIC XS_USE_MAXGANG_POSR "" VALUE 0x27AF23 _REC_S1VAL_1_u1_S2 1 _CNV_R_R_Umr_1_zu_1_2_CM_S2 0 1 FORMAT "%2.0" /end CHARACTERISTIC
/begin CHARACTERISTIC XS_USE_NMOTHSVIRT_SCHALTNEU "" VALUE 0x27B6D3 _REC_S1VAL_1_u1_S2 1 _CNV_S_2_Schalter_A_4_CM_S2 0 1 /end CHARACTERISTIC
/begin CHARACTERISTIC XS_USE_ROLLE "" VALUE 0x27B6E0 _REC_S1VAL_1_u1_S2 1 _CNV_R_R_Umr_1_zu_1_2_CM_S2 0 1 FORMAT "%2.0" /end CHARACTERISTIC
/begin CHARACTERISTIC XS_USE_ROLLE_CAN "" VALUE 0x27B6E1 _REC_S1VAL_1_u1_S2 1 _CNV_R_R_Umr_1_zu_1_2_CM_S2 0 1 FORMAT "%2.0" /end CHARACTERISTIC
/begin CHARACTERISTIC XS_USE_TRPMOD "" VALUE 0x27AF36 _REC_S1VAL_1_u1_S2 1 _CNV_R_R_Umr_1_zu_1_2_CM_S2 0 1 FORMAT "%2.0" /end CHARACTERISTIC
/begin CHARACTERISTIC XS_WDKKD_SLD_VIRTREAL "" VALUE 0x27B692 _REC_S1VAL_1_u1_S2 1 _CNV_R_R_Umr_1_zu_1_2_CM_S2 0 1 FORMAT "%2.0" /end CHARACTERISTIC
/begin CHARACTERISTIC XT_DELTA_BEW_GMMOTFW "" VALUE 0x27B6AD _REC_S1VAL_1_u1_S2 70 _CNV_R_R_Umr_1_zu_1_82_CM_S2 10 80 FORMAT "%2.0" /end CHARACTERISTIC
/begin CHARACTERISTIC XT_STARTLM "" VALUE 0x2719A4 _REC_S1VAL_1_u4_S2 2.14748E+009 _CNV_R_R_Umr_1_zu_1_6_CM_S2 0 2147483647 FORMAT "%2.0" /end CHARACTERISTIC
/begin CHARACTERISTIC XT_VM_MOTISTFW_HKOR "" VALUE 0x2796AC _REC_S1VAL_1_u2_S2 2500 _CNV_R_R_Umr_1_zu_1_6_CM_S2 0 2500 FORMAT "%2.0" /end CHARACTERISTIC
/begin CHARACTERISTIC XVM_MOTISTFW_FILT_INGEW "" VALUE 0x27B6AE _REC_S1VAL_1_u1_S2 250 _CNV_R_R_Umr_1_zu_1_2_CM_S2 0 250 FORMAT "%2.0" /end CHARACTERISTIC
/begin CHARACTERISTIC XVM_MOTISTFW_FILT_OUTGEW "" VALUE 0x27B6AF _REC_S1VAL_1_u1_S2 250 _CNV_R_R_Umr_1_zu_1_2_CM_S2 0 250 FORMAT "%2.0" /end CHARACTERISTIC
/begin CHARACTERISTIC XVM_MOT_HKORGEW "" VALUE 0x2796AE _REC_S1VAL_1_u2_S2 65535 _CNV_R_R_Umr_1_zu_1_2_CM_S2 0 65535 FORMAT "%2.0" /end CHARACTERISTIC
/begin CHARACTERISTIC XVM_MOT_HKORMAX "" VALUE 0x2796B0 _REC_S1VAL_1_u2_S2 200 _CNV_R_R_Umr_1_zu_1_53_CM_S2 0 200 FORMAT "%2.0" /end CHARACTERISTIC
/begin CHARACTERISTIC XVM_MOT_HKORMIN "" VALUE 0x2796B2 _REC_S1VAL_1_u2_S2 200 _CNV_R_R_Umr_1_zu_1_53_CM_S2 0 200 FORMAT "%2.0" /end CHARACTERISTIC
/begin CHARACTERISTIC XVM_MOT_HKORROHGEW "" VALUE 0x2796B4 _REC_S1VAL_1_u2_S2 65535 _CNV_R_R_Umr_1_zu_1_2_CM_S2 0 65535 FORMAT "%2.0" /end CHARACTERISTIC
/begin CHARACTERISTIC XZ_DYNSPV_GLBENBL "" VALUE 0x27B6A8 _REC_S1VAL_1_u1_S2 2 _CNV_R_R_Umr_1_zu_1_2_CM_S2 0 2 FORMAT "%2.0" /end CHARACTERISTIC
/begin CHARACTERISTIC XZ_GANG_WK "" VALUE 0x27AF3A _REC_S1VAL_1_u1_S2 2 _CNV_R_R_Umr_1_zu_1_2_CM_S2 0 2 FORMAT "%2.0" /end CHARACTERISTIC
/begin CHARACTERISTIC XZ_HKOR_SOURCE "" VALUE 0x27B6B0 _REC_S1VAL_1_u1_S2 2 _CNV_S_3_Enum_EHKOR_263_CM_S2 0 2 /end CHARACTERISTIC
/begin CHARACTERISTIC XZ_QS3_HSZIELKD_FLM "" VALUE 0x27B6DB _REC_S1VAL_1_u1_S2 255 _CNV_R_R_Umr_1_zu_1_2_CM_S2 0 255 /end CHARACTERISTIC
/begin CHARACTERISTIC XKLYSCHDN_SCHLUPF_HA "" CURVE 0x279324 _REC_S7CUR_53_u2_s2_S2 20000 _CNV_R_R_Umr_1_zu_1_3_CM_S2 0 20000 FORMAT "%2.0"
 /begin AXIS_DESCR STD_AXIS DN_RAD_HA _CNV_R_R_Umr_1_zu_1_3_CM_S2 6 0 20000 FORMAT "%2.0" /end AXIS_DESCR
/end CHARACTERISTIC
/begin CHARACTERISTIC XKLYSCHDN_SCHLUPF_VA "" CURVE 0x27933E _REC_S7CUR_53_u2_s2_S2 20000 _CNV_R_R_Umr_1_zu_1_3_CM_S2 0 20000 FORMAT "%2.0"
 /begin AXIS_DESCR STD_AXIS DN_RAD_VA _CNV_R_R_Umr_1_zu_1_3_CM_S2 6 0 20000 FORMAT "%2.0" /end AXIS_DESCR
/end CHARACTERISTIC
/begin CHARACTERISTIC XKLYSCHDN_SCHLUPF_VFZG "" CURVE 0x279358 _REC_S7CUR_53_u2_u2_S2 20000 _CNV_R_R_Umr_1_zu_1_3_CM_S2 0 20000 FORMAT "%2.0"
 /begin AXIS_DESCR STD_AXIS V_FZG _CNV_R_R_Umr_1_zu_1_8_CM_S2 7 0 400 FORMAT "%2.0" /end AXIS_DESCR
/end CHARACTERISTIC
/begin CHARACTERISTIC XTAB2S_USE_COG_N_ABNA "" CURVE 0x279442 _REC_A1CUR_30_u1_u1_S2 1 _CNV_R_R_Umr_1_zu_1_2_CM_S2 0 1 FORMAT "%2.0"
 /begin AXIS_DESCR FIX_AXIS S_ALLRAD _CNV_R_R_Umr_1_zu_1_2_CM_S2 2 0 1 /begin FIX_AXIS_PAR_LIST 0 1 /end FIX_AXIS_PAR_LIST READ_ONLY /end AXIS_DESCR
/end CHARACTERISTIC
/begin CHARACTERISTIC XTAB2X2W_STEIGUNG_KORGEW "" MAP 0x273A40 _REC_A1MAP_9_s2_u1_u1_S2 32767 _CNV_R_R_Umr_1_zu_1_2_CM_S2 0 32767 FORMAT "%2.0"
 /begin AXIS_DESCR FIX_AXIS S_STEIGUNG_FILT_SCHNELL _CNV_S_2_Schalter_A_4_CM_S2 2 0 1 /begin FIX_AXIS_PAR_LIST 0 1 /end FIX_AXIS_PAR_LIST READ_ONLY /end AXIS_DESCR
 /begin AXIS_DESCR FIX_AXIS NO_INPUT_QUANTITY _CNV_S_2_Enum_EGEW__16_CM_S2 2 0 1 /begin FIX_AXIS_PAR_LIST 0 1 /end FIX_AXIS_PAR_LIST READ_ONLY /end AXIS_DESCR
/end CHARACTERISTIC
/begin CHARACTERISTIC XTAB3FAKTA_Q_MUELOW "" CURVE 0x279376 _REC_S7CUR_53_u2_u2_S2 1 _CNV_R_R_Umr_10_zu__45_CM_S2 0 1 FORMAT "%3.1"
 /begin AXIS_DESCR STD_AXIS V_FZG_COG _CNV_R_R_Umr_64_zu__44_CM_S2 5 0 350 FORMAT "%4.2" /end AXIS_DESCR
/end CHARACTERISTIC
/begin CHARACTERISTIC XTAB3N_AB_OUTGEW "" CURVE 0x2792FE _REC_S7CUR_53_u2_s2_S2 250 _CNV_R_R_Umr_1_zu_1_2_CM_S2 0 250 FORMAT "%2.0"
 /begin AXIS_DESCR STD_AXIS GN_T _CNV_R_R_Umr_100_zu_254_CM_S2 3 -327.68 327.67 FORMAT "%4.2" /end AXIS_DESCR
/end CHARACTERISTIC
/begin CHARACTERISTIC XTAB5X2FILT_A_L_MUELOW "" MAP 0x2793F0 _REC_S3MAP_54_u1_u2_u1_S2 2 _CNV_R_R_Umr_100_zu_54_CM_S2 0 2 FORMAT "%4.2"
 /begin AXIS_DESCR STD_AXIS V_FZG_COG _CNV_R_R_Umr_64_zu__44_CM_S2 5 0 350 FORMAT "%4.2" /end AXIS_DESCR
 /begin AXIS_DESCR FIX_AXIS NO_INPUT_QUANTITY _CNV_S_2_Enum_EPT1__21_CM_S2 2 0 1 /begin FIX_AXIS_PAR_LIST 0 1 /end FIX_AXIS_PAR_LIST READ_ONLY /end AXIS_DESCR
/end CHARACTERISTIC
/begin CHARACTERISTIC XTAB5X2FILT_A_Q_MUELOW "" MAP 0x279406 _REC_S3MAP_54_u1_u2_u1_S2 2 _CNV_R_R_Umr_100_zu_54_CM_S2 0 2 FORMAT "%4.2"
 /begin AXIS_DESCR STD_AXIS V_FZG_COG _CNV_R_R_Umr_64_zu__44_CM_S2 5 0 350 FORMAT "%4.2" /end AXIS_DESCR
 /begin AXIS_DESCR FIX_AXIS NO_INPUT_QUANTITY _CNV_S_2_Enum_EPT1__21_CM_S2 2 0 1 /begin FIX_AXIS_PAR_LIST 0 1 /end FIX_AXIS_PAR_LIST READ_ONLY /end AXIS_DESCR
/end CHARACTERISTIC
/begin CHARACTERISTIC XTAB9NAEHRUNG_A_MUELOW "" CURVE 0x27938C _REC_S7CUR_53_u2_u2_S2 20 _CNV_R_R_Umr_10_zu__46_CM_S2 0 20 FORMAT "%3.1"
 /begin AXIS_DESCR STD_AXIS A_MUELOW_RADIKANT _CNV_R_R_Umr_100_zu_264_CM_S2 17 0 655.35 FORMAT "%4.2" /end AXIS_DESCR
/end CHARACTERISTIC
/begin CHARACTERISTIC XW_DK_LINEAR "" CURVE 0x2793D2 _REC_S7CUR_53_u2_u2_S2 110 _CNV_R_R_Umr_10_zu__9_CM_S2 0 110 FORMAT "%3.1"
 /begin AXIS_DESCR STD_AXIS W_DKKD _CNV_R_R_Umr_10_zu__9_CM_S2 7 0 110 FORMAT "%3.1" /end AXIS_DESCR
/end CHARACTERISTIC
/begin CHARACTERISTIC XA_L_INGEW "" VALUE 0x27941C _REC_S1VAL_1_s2_S2 65535 _CNV_R_R_Umr_1_zu_1_2_CM_S2 -32768 32767 FORMAT "%2.0" /end CHARACTERISTIC
/begin CHARACTERISTIC XA_L_OUTGEW "" VALUE 0x27941E _REC_S1VAL_1_s2_S2 65535 _CNV_R_R_Umr_1_zu_1_2_CM_S2 -32768 32767 FORMAT "%2.0" /end CHARACTERISTIC
/begin CHARACTERISTIC XA_L_REFINGEW "" VALUE 0x279420 _REC_S1VAL_1_s2_S2 65535 _CNV_R_R_Umr_1_zu_1_2_CM_S2 -32768 32767 FORMAT "%2.0" /end CHARACTERISTIC
/begin CHARACTERISTIC XA_L_REFOUTGEW "" VALUE 0x279422 _REC_S1VAL_1_s2_S2 65535 _CNV_R_R_Umr_1_zu_1_2_CM_S2 -32768 32767 FORMAT "%2.0" /end CHARACTERISTIC
/begin CHARACTERISTIC XA_QGIER_INGEW "" VALUE 0x279424 _REC_S1VAL_1_s2_S2 65535 _CNV_R_R_Umr_1_zu_1_2_CM_S2 -32768 32767 FORMAT "%2.0" /end CHARACTERISTIC
/begin CHARACTERISTIC XA_QGIER_OUTGEW "" VALUE 0x279426 _REC_S1VAL_1_s2_S2 65535 _CNV_R_R_Umr_1_zu_1_2_CM_S2 -32768 32767 FORMAT "%2.0" /end CHARACTERISTIC
/begin CHARACTERISTIC XA_Q_INGEW "" VALUE 0x279428 _REC_S1VAL_1_s2_S2 65535 _CNV_R_R_Umr_1_zu_1_2_CM_S2 -32768 32767 FORMAT "%2.0" /end CHARACTERISTIC
/begin CHARACTERISTIC XA_Q_OUTGEW "" VALUE 0x27942A _REC_S1VAL_1_s2_S2 65535 _CNV_R_R_Umr_1_zu_1_2_CM_S2 -32768 32767 FORMAT "%2.0" /end CHARACTERISTIC
/begin CHARACTERISTIC XC_G_M_RAD_RSU_BER "" VALUE 0x279666 _REC_S1VAL_1_u2_S2 8 _CNV_R_R_Umr_1_zu_1_2_CM_S2 1 9 FORMAT "%2.0" /end CHARACTERISTIC
/begin CHARACTERISTIC XDN_MOT_INGEW "" VALUE 0x27967C _REC_S1VAL_1_s2_S2 65535 _CNV_R_R_Umr_1_zu_1_2_CM_S2 -32768 32767 FORMAT "%2.0" /end CHARACTERISTIC
/begin CHARACTERISTIC XDN_MOT_OUTGEW "" VALUE 0x27967E _REC_S1VAL_1_s2_S2 65535 _CNV_R_R_Umr_1_zu_1_2_CM_S2 -32768 32767 FORMAT "%2.0" /end CHARACTERISTIC
/begin CHARACTERISTIC XFAKTK1_A_Q_FAKT "" VALUE 0x27B647 _REC_S1VAL_1_u1_S2 1 _CNV_R_R_Umr_100_zu_54_CM_S2 0 1 FORMAT "%4.2" /end CHARACTERISTIC
/begin CHARACTERISTIC XFAKTK2_A_Q_FAKT "" VALUE 0x27B648 _REC_S1VAL_1_u1_S2 1 _CNV_R_R_Umr_100_zu_54_CM_S2 0 1 FORMAT "%4.2" /end CHARACTERISTIC
/begin CHARACTERISTIC XG2W_AB_FILTMARS_INGEW "" VALUE 0x279668 _REC_S1VAL_1_s2_S2 2500 _CNV_R_R_Umr_1_zu_1_2_CM_S2 0 2500 FORMAT "%2.0" /end CHARACTERISTIC
/begin CHARACTERISTIC XG2W_AB_FILTMARS_OUTGEW "" VALUE 0x27966A _REC_S1VAL_1_s2_S2 2500 _CNV_R_R_Umr_1_zu_1_2_CM_S2 0 2500 FORMAT "%2.0" /end CHARACTERISTIC
/begin CHARACTERISTIC XG2W_AB_FWSINGEW "" VALUE 0x27966C _REC_S1VAL_1_s2_S2 65535 _CNV_R_R_Umr_1_zu_1_2_CM_S2 -32768 32767 FORMAT "%2.0" /end CHARACTERISTIC
/begin CHARACTERISTIC XG2W_AB_FWSOUTGEW "" VALUE 0x27966E _REC_S1VAL_1_s2_S2 65535 _CNV_R_R_Umr_1_zu_1_2_CM_S2 -32768 32767 FORMAT "%2.0" /end CHARACTERISTIC
/begin CHARACTERISTIC XG2W_AB_INGEW "" VALUE 0x279670 _REC_S1VAL_1_s2_S2 65535 _CNV_R_R_Umr_1_zu_1_2_CM_S2 -32768 32767 FORMAT "%2.0" /end CHARACTERISTIC
/begin CHARACTERISTIC XG2W_AB_OUTGEW "" VALUE 0x279672 _REC_S1VAL_1_s2_S2 65535 _CNV_R_R_Umr_1_zu_1_2_CM_S2 -32768 32767 FORMAT "%2.0" /end CHARACTERISTIC
/begin CHARACTERISTIC XGWFP_HSURE_GEWFILT "" VALUE 0x279444 _REC_S1VAL_1_s2_S2 65535 _CNV_R_R_Umr_1_zu_1_2_CM_S2 -32768 32767 FORMAT "%2.0" /end CHARACTERISTIC
/begin CHARACTERISTIC XGWFP_HSURE_GEWROH "" VALUE 0x279446 _REC_S1VAL_1_s2_S2 65535 _CNV_R_R_Umr_1_zu_1_2_CM_S2 -32768 32767 FORMAT "%2.0" /end CHARACTERISTIC
/begin CHARACTERISTIC XGW_FP_GEWFILT "" VALUE 0x279448 _REC_S1VAL_1_s2_S2 65535 _CNV_R_R_Umr_1_zu_1_2_CM_S2 -32768 32767 FORMAT "%2.0" /end CHARACTERISTIC
/begin CHARACTERISTIC XGW_FP_GEWROH "" VALUE 0x27944A _REC_S1VAL_1_s2_S2 65535 _CNV_R_R_Umr_1_zu_1_2_CM_S2 -32768 32767 FORMAT "%2.0" /end CHARACTERISTIC
/begin CHARACTERISTIC XHA_MUELOW_VORZEICHEN "" VALUE 0x27942C _REC_S1VAL_1_u2_S2 20 _CNV_R_R_Umr_10_zu__46_CM_S2 0 20 FORMAT "%3.1" /end CHARACTERISTIC
/begin CHARACTERISTIC XHDN_SCHLUPF "" VALUE 0x279C36 _REC_S1VAL_1_u2_S2 20000 _CNV_R_R_Umr_1_zu_1_3_CM_S2 0 20000 FORMAT "%2.0" /end CHARACTERISTIC
/begin CHARACTERISTIC XHM_FZGSCHUB "" VALUE 0x279650 _REC_S1VAL_1_s2_S2 65535 _CNV_R_R_Umr_1_zu_1_42_CM_S2 -32768 32767 FORMAT "%2.0" /end CHARACTERISTIC
/begin CHARACTERISTIC XHM_FZGZUG "" VALUE 0x279652 _REC_S1VAL_1_s2_S2 65535 _CNV_R_R_Umr_1_zu_1_42_CM_S2 -32768 32767 FORMAT "%2.0" /end CHARACTERISTIC
/begin CHARACTERISTIC XHV_FZG_STEHTOBEN "" VALUE 0x279654 _REC_S1VAL_1_u2_S2 400 _CNV_R_R_Umr_1_zu_1_8_CM_S2 0 400 FORMAT "%2.0" /end CHARACTERISTIC
/begin CHARACTERISTIC XHV_FZG_STEHTUNTEN "" VALUE 0x279656 _REC_S1VAL_1_u2_S2 400 _CNV_R_R_Umr_1_zu_1_8_CM_S2 0 400 FORMAT "%2.0" /end CHARACTERISTIC
/begin CHARACTERISTIC XIG_VTHIGH "" VALUE 0x279658 _REC_S1VAL_1_u2_S2 655.35 _CNV_R_R_Umr_100_zu_54_CM_S2 0 655.35 FORMAT "%4.2" /end CHARACTERISTIC
/begin CHARACTERISTIC XL_SPUR_VA "" VALUE 0x27942E _REC_S1VAL_1_u2_S2 65535 _CNV_R_R_Umr_1_zu_1_2_CM_S2 0 65535 FORMAT "%2.0" /end CHARACTERISTIC
/begin CHARACTERISTIC XN_AB_FILT_INGEW "" VALUE 0x279674 _REC_S1VAL_1_u2_S2 250 _CNV_R_R_Umr_1_zu_1_2_CM_S2 0 250 FORMAT "%2.0" /end CHARACTERISTIC
/begin CHARACTERISTIC XN_AB_FILT_OUTGEW "" VALUE 0x279676 _REC_S1VAL_1_u2_S2 250 _CNV_R_R_Umr_1_zu_1_2_CM_S2 0 250 FORMAT "%2.0" /end CHARACTERISTIC
/begin CHARACTERISTIC XN_AB_INGEW "" VALUE 0x27930C _REC_S1VAL_1_u2_S2 250 _CNV_R_R_Umr_1_zu_1_2_CM_S2 0 250 FORMAT "%2.0" /end CHARACTERISTIC
/begin CHARACTERISTIC XSCHA_RAD_ABS "" VALUE 0x27965A _REC_S1VAL_1_s2_S2 65535 _CNV_R_R_Umr_1_zu_1_265_CM_S2 -32768 32767 FORMAT "%3.1" /end CHARACTERISTIC
/begin CHARACTERISTIC XSCHA_STEIGUNG_FILT "" VALUE 0x279C3C _REC_S1VAL_1_s2_S2 2047.97 _CNV_R_R_Umr_32_zu__202_CM_S2 -1024 1023.96875 FORMAT "%4.2" /end CHARACTERISTIC
/begin CHARACTERISTIC XSCHC_FILT_LENGTHG2WAB "" VALUE 0x279678 _REC_S1VAL_1_u2_S2 8 _CNV_R_R_Umr_1_zu_1_2_CM_S2 1 9 FORMAT "%2.0" /end CHARACTERISTIC
/begin CHARACTERISTIC XSCHC_FILT_LENGTHG2WABMED "" VALUE 0x27967A _REC_S1VAL_1_u2_S2 8 _CNV_R_R_Umr_1_zu_1_2_CM_S2 1 9 FORMAT "%2.0" /end CHARACTERISTIC
/begin CHARACTERISTIC XSCHC_FILT_MEDTASK "" VALUE 0x27B6A4 _REC_S1VAL_1_u1_S2 254 _CNV_R_R_Umr_1_zu_1_2_CM_S2 1 255 FORMAT "%2.0" /end CHARACTERISTIC
/begin CHARACTERISTIC XSCHM_BR_STEIGUNG "" VALUE 0x279C3E _REC_S1VAL_1_s2_S2 65535 _CNV_R_R_Umr_1_zu_1_42_CM_S2 -32768 32767 FORMAT "%2.0" /end CHARACTERISTIC
/begin CHARACTERISTIC XSCHP_BR_STEIGUNG "" VALUE 0x279C40 _REC_S1VAL_1_u2_S2 32767 _CNV_R_R_Umr_2_zu_1_238_CM_S2 0 32767 FORMAT "%3.1" /end CHARACTERISTIC
/begin CHARACTERISTIC XSCHW_DKKD_STEIGUNG "" VALUE 0x279C42 _REC_S1VAL_1_u2_S2 110 _CNV_R_R_Umr_10_zu__9_CM_S2 0 110 FORMAT "%3.1" /end CHARACTERISTIC
/begin CHARACTERISTIC XSCHW_DK_KD "" VALUE 0x27944C _REC_S1VAL_1_u2_S2 110 _CNV_R_R_Umr_10_zu__9_CM_S2 0 110 FORMAT "%3.1" /end CHARACTERISTIC
/begin CHARACTERISTIC XS_A_LFILT "" VALUE 0x27B649 _REC_S1VAL_1_u1_S2 1 _CNV_R_R_Umr_1_zu_1_2_CM_S2 0 1 FORMAT "%2.0" /end CHARACTERISTIC
/begin CHARACTERISTIC XS_A_L_MUELOW_FILT "" VALUE 0x27B64A _REC_S1VAL_1_u1_S2 1 _CNV_S_2_Enum_EDYNH_262_CM_S2 0 1 /end CHARACTERISTIC
/begin CHARACTERISTIC XS_A_Q_MUELOW_FILT "" VALUE 0x27B64B _REC_S1VAL_1_u1_S2 1 _CNV_S_2_Enum_EDYNH_262_CM_S2 0 1 /end CHARACTERISTIC
/begin CHARACTERISTIC XS_G2W_ABFILT "" VALUE 0x27B6A5 _REC_S1VAL_1_u1_S2 1 _CNV_R_R_Umr_1_zu_1_2_CM_S2 0 1 FORMAT "%2.0" /end CHARACTERISTIC
/begin CHARACTERISTIC XS_SOURCE_V_FZG_COG "" VALUE 0x27B6A2 _REC_S1VAL_1_u1_S2 1 _CNV_R_R_Umr_1_zu_1_2_CM_S2 0 1 /end CHARACTERISTIC
/begin CHARACTERISTIC XS_USE_G2WABMEDFILT "" VALUE 0x27B6A6 _REC_S1VAL_1_u1_S2 1 _CNV_R_R_Umr_1_zu_1_2_CM_S2 0 1 FORMAT "%2.0" /end CHARACTERISTIC
/begin CHARACTERISTIC XS_USE_KURVENVORL "" VALUE 0x27B64C _REC_S1VAL_1_u1_S2 1 _CNV_R_R_Umr_1_zu_1_2_CM_S2 0 1 FORMAT "%2.0" /end CHARACTERISTIC
/begin CHARACTERISTIC XT_A_RADABSFILT "" VALUE 0x2737D4 _REC_S1VAL_1_u4_S2 2.14748E+009 _CNV_R_R_Umr_1_zu_1_6_CM_S2 0 2147483647 FORMAT "%2.0" /end CHARACTERISTIC
/begin CHARACTERISTIC XT_REG_ABS_NACHL "" VALUE 0x2792FC _REC_S1VAL_1_u2_S2 5000 _CNV_R_R_Umr_1_zu_1_6_CM_S2 0 5000 FORMAT "%2.0" /end CHARACTERISTIC
/begin CHARACTERISTIC XT_REG_ASCNACHL "" VALUE 0x273768 _REC_S1VAL_1_u4_S2 2.14748E+009 _CNV_R_R_Umr_1_zu_1_6_CM_S2 0 2147483647 FORMAT "%2.0" /end CHARACTERISTIC
/begin CHARACTERISTIC XT_STEIGUNG_FILT "" VALUE 0x279C44 _REC_S1VAL_1_u2_S2 3000 _CNV_R_R_Umr_1_zu_1_6_CM_S2 0 3000 FORMAT "%2.0" /end CHARACTERISTIC
/begin CHARACTERISTIC XV_FZGOHNEABS_INGEW "" VALUE 0x27965C _REC_S1VAL_1_u2_S2 65535 _CNV_R_R_Umr_1_zu_1_2_CM_S2 0 65535 FORMAT "%2.0" /end CHARACTERISTIC
/begin CHARACTERISTIC XV_FZGOHNEABS_OUTGEW "" VALUE 0x27965E _REC_S1VAL_1_u2_S2 65535 _CNV_R_R_Umr_1_zu_1_2_CM_S2 0 65535 FORMAT "%2.0" /end CHARACTERISTIC
/begin CHARACTERISTIC XV_FZG_COG_OUTGEW "" VALUE 0x279660 _REC_S1VAL_1_u2_S2 65535 _CNV_R_R_Umr_1_zu_1_2_CM_S2 0 65535 FORMAT "%2.0" /end CHARACTERISTIC
/begin CHARACTERISTIC XV_FZG_INGEW "" VALUE 0x279662 _REC_S1VAL_1_u2_S2 65535 _CNV_R_R_Umr_1_zu_1_2_CM_S2 0 65535 FORMAT "%2.0" /end CHARACTERISTIC
/begin CHARACTERISTIC XV_FZG_OUTGEW "" VALUE 0x279664 _REC_S1VAL_1_u2_S2 65535 _CNV_R_R_Umr_1_zu_1_2_CM_S2 0 65535 FORMAT "%2.0" /end CHARACTERISTIC
/begin CHARACTERISTIC XW_STEIGUNGERROR_INGEW "" VALUE 0x279C46 _REC_S1VAL_1_s2_S2 32767 _CNV_R_R_Umr_1_zu_1_2_CM_S2 0 32767 FORMAT "%2.0" /end CHARACTERISTIC
/begin CHARACTERISTIC XW_STEIGUNGERROR_OUTGEW "" VALUE 0x279C48 _REC_S1VAL_1_s2_S2 32767 _CNV_R_R_Umr_1_zu_1_2_CM_S2 0 32767 FORMAT "%2.0" /end CHARACTERISTIC
/begin CHARACTERISTIC XS_FBIT_RESET "" VALUE 0x27B6A1 _REC_S1VAL_1_u1_S2 1 _CNV_R_R_Umr_1_zu_1_2_CM_S2 0 1 FORMAT "%2.0" /end CHARACTERISTIC
/begin CHARACTERISTIC XTAB3HN_MOT_ABREGEL "" CURVE 0x2757BC _REC_S7CUR_53_u2_u2_S2 2000 _CNV_R_R_Umr_1_zu_1_3_CM_S2 0 2000 FORMAT "%2.0"
 /begin AXIS_DESCR STD_AXIS N_MOT_ABREGEL_ROH _CNV_R_R_Umr_1_zu_1_3_CM_S2 3 0 10000 FORMAT "%2.0" /end AXIS_DESCR
/end CHARACTERISTIC
/begin CHARACTERISTIC XTAB5KORFAKT_MBR_ROLLE "" CURVE 0x2757CA _REC_S7CUR_53_s2_u2_S2 1 _CNV_R_R_Umr_100_zu_54_CM_S2 0 1 FORMAT "%4.2"
 /begin AXIS_DESCR STD_AXIS V_FZG _CNV_R_R_Umr_1_zu_1_8_CM_S2 5 0 400 FORMAT "%2.0" /end AXIS_DESCR
/end CHARACTERISTIC
/begin CHARACTERISTIC XTAB7X3Z_DRIVEDYN_FDC "" MAP 0x27B655 _REC_A1MAP_9_u1_u1_u1_S2 1 _CNV_R_R_Umr_1_zu_1_2_CM_S2 0 1 FORMAT "%2.0"
 /begin AXIS_DESCR FIX_AXIS Z_DRIVEDYN_IDX _CNV_S_7_Enum_EDRIV_207_CM_S2 7 0 6 FIX_AXIS_PAR_DIST 0 1 7 READ_ONLY /end AXIS_DESCR
 /begin AXIS_DESCR FIX_AXIS Z_DSC _CNV_S_3_Enum_EDSCS_28_CM_S2 3 0 2 FIX_AXIS_PAR_DIST 0 1 3 READ_ONLY /end AXIS_DESCR
/end CHARACTERISTIC
/begin CHARACTERISTIC XTAB9SCHN_MOT_ABREGEL_MIN "" CURVE 0x2757E0 _REC_A1CUR_30_u2_u1_S2 20000 _CNV_R_R_Umr_1_zu_1_3_CM_S2 0 20000 FORMAT "%2.0"
 /begin AXIS_DESCR FIX_AXIS Z_GANG_ZIEL _CNV_S_9_Enum_EGANG_30_CM_S2 9 0 8 FIX_AXIS_PAR_DIST 0 1 9 READ_ONLY /end AXIS_DESCR
/end CHARACTERISTIC
/begin CHARACTERISTIC XTAB9X2SCHN_MOTMAX_DSC_ERR "" MAP 0x270E4C _REC_A1MAP_9_u2_u1_u1_S2 10000 _CNV_R_R_Umr_1_zu_1_3_CM_S2 0 10000 FORMAT "%2.0"
 /begin AXIS_DESCR FIX_AXIS Z_GANG_ZIEL _CNV_S_9_Enum_EGANG_30_CM_S2 9 0 8 FIX_AXIS_PAR_DIST 0 1 9 READ_ONLY /end AXIS_DESCR
 /begin AXIS_DESCR FIX_AXIS S_ROLLE_CAN _CNV_S_2_Schalter_A_4_CM_S2 2 0 1 /begin FIX_AXIS_PAR_LIST 0 1 /end FIX_AXIS_PAR_LIST READ_ONLY /end AXIS_DESCR
/end CHARACTERISTIC
/begin CHARACTERISTIC XTAB9X3Z_DRIVELOGIC_MODE "" MAP 0x27B66A _REC_A1MAP_9_u1_u1_u1_S2 5 _CNV_S_6_Enum_EDL_11_CM_S2 1 6
 /begin AXIS_DESCR FIX_AXIS Z_DL_IDX _CNV_S_9_Enum_EMAPD_224_CM_S2 9 0 8 FIX_AXIS_PAR_DIST 0 1 9 READ_ONLY /end AXIS_DESCR
 /begin AXIS_DESCR FIX_AXIS Z_DSC _CNV_S_3_Enum_EDSCS_28_CM_S2 3 0 2 FIX_AXIS_PAR_DIST 0 1 3 READ_ONLY /end AXIS_DESCR
/end CHARACTERISTIC
/begin CHARACTERISTIC XTAB9Z_DRIVELOGICIDX_MAP "" CURVE 0x27B685 _REC_A1CUR_30_u1_u1_S2 8 _CNV_S_9_Enum_EMAPD_269_CM_S2 0 8
 /begin AXIS_DESCR FIX_AXIS Z_DL_IDX _CNV_S_9_Enum_EMAPD_224_CM_S2 9 0 8 FIX_AXIS_PAR_DIST 0 1 9 READ_ONLY /end AXIS_DESCR
/end CHARACTERISTIC
/begin CHARACTERISTIC XM_EM1_MAX "" VALUE 0x2757F2 _REC_S1VAL_1_s2_S2 500 _CNV_R_R_Umr_1_zu_1_42_CM_S2 0 500 FORMAT "%2.0" /end CHARACTERISTIC
/begin CHARACTERISTIC XM_EM1_MIN "" VALUE 0x2757F4 _REC_S1VAL_1_s2_S2 500 _CNV_R_R_Umr_1_zu_1_42_CM_S2 -500 0 FORMAT "%2.0" /end CHARACTERISTIC
/begin CHARACTERISTIC XP_LUFT_SIMULATE "" VALUE 0x279830 _REC_S1VAL_1_u2_S2 700 _CNV_R_R_Umr_1_zu_1_0_CM_S2 500 1200 FORMAT "%2.0" /end CHARACTERISTIC
/begin CHARACTERISTIC XS_DRIVELOGICIDX_SOURCE "" VALUE 0x27B68E _REC_S1VAL_1_u1_S2 1 _CNV_S_2_Enum_ESIGN_288_CM_S2 0 1 /end CHARACTERISTIC
/begin CHARACTERISTIC XS_MBR_PBR "" VALUE 0x27AF24 _REC_S1VAL_1_u1_S2 1 _CNV_S_2_Schalter_A_4_CM_S2 0 1 /end CHARACTERISTIC
/begin CHARACTERISTIC XS_M_MOT_STAT "" VALUE 0x27AF25 _REC_S1VAL_1_u1_S2 1 _CNV_R_R_Umr_1_zu_1_2_CM_S2 0 1 /end CHARACTERISTIC
/begin CHARACTERISTIC XS_PMA_ENBL "" VALUE 0x27AE94 _REC_S1VAL_1_u1_S2 1 _CNV_R_R_Umr_1_zu_1_2_CM_S2 0 1 /end CHARACTERISTIC
/begin CHARACTERISTIC XS_P_LUFT_SOURCE "" VALUE 0x27B6B2 _REC_S1VAL_1_u1_S2 1 _CNV_S_2_Enum_ESIGN_288_CM_S2 0 1 /end CHARACTERISTIC
/begin CHARACTERISTIC XS_SOURCE_KS "" VALUE 0x27B6BD _REC_S1VAL_1_u1_S2 1 _CNV_S_2_Enum_ESIGN_289_CM_S2 0 1 /end CHARACTERISTIC
/begin CHARACTERISTIC XS_SOURCE_ZMOTSTART_TYP "" VALUE 0x27B6BE _REC_S1VAL_1_u1_S2 1 _CNV_R_R_Umr_1_zu_1_2_CM_S2 0 1 FORMAT "%2.0" /end CHARACTERISTIC
/begin CHARACTERISTIC XS_TEMP_UMG_SOURCE "" VALUE 0x27B6B3 _REC_S1VAL_1_u1_S2 1 _CNV_S_2_Enum_ESIGN_288_CM_S2 0 1 /end CHARACTERISTIC
/begin CHARACTERISTIC XS_TRPMOD_SOURCE "" VALUE 0x27B6C0 _REC_S1VAL_1_u1_S2 2 _CNV_S_3_Enum_ETRPM_290_CM_S2 0 2 /end CHARACTERISTIC
/begin CHARACTERISTIC XS_USE_DSC_STATUS_FDS "" VALUE 0x27B691 _REC_S1VAL_1_u1_S2 1 _CNV_R_R_Umr_1_zu_1_2_CM_S2 0 1 FORMAT "%2.0" /end CHARACTERISTIC
/begin CHARACTERISTIC XS_USE_TIPP_PADDLE "" VALUE 0x27B6E2 _REC_S1VAL_1_u1_S2 1 _CNV_R_R_Umr_1_zu_1_2_CM_S2 0 1 FORMAT "%2.0" /end CHARACTERISTIC
/begin CHARACTERISTIC XS_USE_ZIELGANG_AGS_EXC "" VALUE 0x27AF27 _REC_S1VAL_1_u1_S2 1 _CNV_R_R_Umr_1_zu_1_2_CM_S2 0 1 FORMAT "%2.0" /end CHARACTERISTIC
/begin CHARACTERISTIC XS_VERBOT_EFAHREN_TID "" VALUE 0x27AF33 _REC_S1VAL_1_u1_S2 1 _CNV_R_R_Umr_1_zu_1_2_CM_S2 0 1 FORMAT "%2.0" /end CHARACTERISTIC
/begin CHARACTERISTIC XS_W_STEIGUNG_NEGATIV "" VALUE 0x27AF28 _REC_S1VAL_1_u1_S2 1 _CNV_S_2_Schalter_A_4_CM_S2 0 1 /end CHARACTERISTIC
/begin CHARACTERISTIC XS_ZIELGANG_AGS_ANZEIGEGANG "" VALUE 0x27AF29 _REC_S1VAL_1_u1_S2 1 _CNV_R_R_Umr_1_zu_1_2_CM_S2 0 1 FORMAT "%2.0" /end CHARACTERISTIC
/begin CHARACTERISTIC XS_ZIELGANG_AGS_DBM "" VALUE 0x27AF2A _REC_S1VAL_1_u1_S2 1 _CNV_R_R_Umr_1_zu_1_2_CM_S2 0 1 FORMAT "%2.0" /end CHARACTERISTIC
/begin CHARACTERISTIC XS_ZIELGANG_AGS_DMRS "" VALUE 0x27AF2B _REC_S1VAL_1_u1_S2 1 _CNV_R_R_Umr_1_zu_1_2_CM_S2 0 1 FORMAT "%2.0" /end CHARACTERISTIC
/begin CHARACTERISTIC XS_ZIELGANG_AGS_DYNDZM "" VALUE 0x27AF34 _REC_S1VAL_1_u1_S2 1 _CNV_R_R_Umr_1_zu_1_2_CM_S2 0 1 FORMAT "%2.0" /end CHARACTERISTIC
/begin CHARACTERISTIC XS_ZIELGANG_AGS_EXC "" VALUE 0x27AF2C _REC_S1VAL_1_u1_S2 1 _CNV_R_R_Umr_1_zu_1_2_CM_S2 0 1 FORMAT "%2.0" /end CHARACTERISTIC
/begin CHARACTERISTIC XS_ZIELGANG_AGS_HSURE "" VALUE 0x27AF2D _REC_S1VAL_1_u1_S2 1 _CNV_R_R_Umr_1_zu_1_2_CM_S2 0 1 FORMAT "%2.0" /end CHARACTERISTIC
/begin CHARACTERISTIC XS_ZIELGANG_AGS_REST "" VALUE 0x27AF2E _REC_S1VAL_1_u1_S2 1 _CNV_R_R_Umr_1_zu_1_2_CM_S2 0 1 FORMAT "%2.0" /end CHARACTERISTIC
/begin CHARACTERISTIC XS_ZIELGANG_AGS_SKL "" VALUE 0x27AF2F _REC_S1VAL_1_u1_S2 1 _CNV_R_R_Umr_1_zu_1_2_CM_S2 0 1 FORMAT "%2.0" /end CHARACTERISTIC
/begin CHARACTERISTIC XS_ZIELGANG_AGS_SKLDMRS "" VALUE 0x27AF30 _REC_S1VAL_1_u1_S2 1 _CNV_R_R_Umr_1_zu_1_2_CM_S2 0 1 FORMAT "%2.0" /end CHARACTERISTIC
/begin CHARACTERISTIC XS_ZIELGANG_AGS_SSTEP "" VALUE 0x27AF31 _REC_S1VAL_1_u1_S2 1 _CNV_R_R_Umr_1_zu_1_2_CM_S2 0 1 FORMAT "%2.0" /end CHARACTERISTIC
/begin CHARACTERISTIC XS_ZIELGANG_AGS_ZKA "" VALUE 0x27AF32 _REC_S1VAL_1_u1_S2 1 _CNV_R_R_Umr_1_zu_1_2_CM_S2 0 1 FORMAT "%2.0" /end CHARACTERISTIC
/begin CHARACTERISTIC XS_Z_REQUEST_LPA_SOURCE "" VALUE 0x27B6C1 _REC_S1VAL_1_u1_S2 1 _CNV_S_2_Enum_ESIGN_288_CM_S2 0 1 /end CHARACTERISTIC
/begin CHARACTERISTIC XTEMP_APPL_KS "" VALUE 0x279836 _REC_S1VAL_1_s2_S2 500 _CNV_R_R_Umr_1_zu_1_1_CM_S2 0 500 FORMAT "%2.0" /end CHARACTERISTIC
/begin CHARACTERISTIC XTEMP_UMG_SIMULATE "" VALUE 0x279832 _REC_S1VAL_1_s2_S2 400 _CNV_R_R_Umr_1_zu_1_1_CM_S2 -200 200 FORMAT "%2.0" /end CHARACTERISTIC
/begin CHARACTERISTIC XT_OVERRIDE_GANG "" VALUE 0x279834 _REC_S1VAL_1_s2_S2 3000 _CNV_R_R_Umr_1_zu_1_6_CM_S2 0 3000 FORMAT "%2.0" /end CHARACTERISTIC
/begin CHARACTERISTIC XT_PADDLE_AUS "" VALUE 0x273A48 _REC_S1VAL_1_u4_S2 4.29497E+009 _CNV_R_R_Umr_1_zu_1_6_CM_S2 0 4294967295 FORMAT "%2.0" /end CHARACTERISTIC
/begin CHARACTERISTIC XT_SOC_MODE_NL "" VALUE 0x2757F8 _REC_S1VAL_1_u2_S2 500 _CNV_R_R_Umr_1_zu_1_6_CM_S2 0 500 FORMAT "%2.0" /end CHARACTERISTIC
/begin CHARACTERISTIC XT_TID_EFAHREN "" VALUE 0x279C4A _REC_S1VAL_1_u2_S2 200 _CNV_R_R_Umr_1_zu_1_6_CM_S2 0 200 FORMAT "%2.0" /end CHARACTERISTIC
/begin CHARACTERISTIC XT_WARTE_POSWECHSEL "" VALUE 0x2757F6 _REC_S1VAL_1_u2_S2 30000 _CNV_R_R_Umr_1_zu_1_6_CM_S2 0 30000 FORMAT "%2.0" /end CHARACTERISTIC
/begin CHARACTERISTIC XZ_ABS_SOURCE "" VALUE 0x27B6B4 _REC_S1VAL_1_u1_S2 2 _CNV_S_3_Enum_ESIGN_84_CM_S2 0 2 /end CHARACTERISTIC
/begin CHARACTERISTIC XZ_COD_ALLRAD_SOURCE "" VALUE 0x27B64E _REC_S1VAL_1_u1_S2 2 _CNV_S_3_Enum_ECODA_291_CM_S2 0 2 /end CHARACTERISTIC
/begin CHARACTERISTIC XZ_COD_COS_VERBOT "" VALUE 0x27B64F _REC_S1VAL_1_u1_S2 2 _CNV_S_3_Enum_ECODC_292_CM_S2 0 2 /end CHARACTERISTIC
/begin CHARACTERISTIC XZ_COD_GETRTYP_SOURCE "" VALUE 0x27B650 _REC_S1VAL_1_u1_S2 2 _CNV_S_3_Enum_ECODG_293_CM_S2 0 2 /end CHARACTERISTIC
/begin CHARACTERISTIC XZ_COD_MAB_SOURCE "" VALUE 0x27B651 _REC_S1VAL_1_u1_S2 2 _CNV_S_3_Enum_ECODM_294_CM_S2 0 2 /end CHARACTERISTIC
/begin CHARACTERISTIC XZ_COD_STOPGO "" VALUE 0x27B652 _REC_S1VAL_1_u1_S2 2 _CNV_S_3_Enum_ECODS_295_CM_S2 0 2 /end CHARACTERISTIC
/begin CHARACTERISTIC XZ_DRIVELOGIC_SOURCE "" VALUE 0x27B68F _REC_S1VAL_1_u1_S2 2 _CNV_S_3_Enum_EDRIV_296_CM_S2 0 2 /end CHARACTERISTIC
/begin CHARACTERISTIC XZ_DSCERR_SOURCE "" VALUE 0x27B6B5 _REC_S1VAL_1_u1_S2 2 _CNV_S_3_Enum_EABSD_297_CM_S2 0 2 /end CHARACTERISTIC
/begin CHARACTERISTIC XZ_DSC_IST_SOURCE "" VALUE 0x27B6B6 _REC_S1VAL_1_u1_S2 3 _CNV_S_4_Enum_EDSCI_298_CM_S2 0 3 /end CHARACTERISTIC
/begin CHARACTERISTIC XZ_EIN_TRAKTION_SOURCE "" VALUE 0x27B6B7 _REC_S1VAL_1_u1_S2 3 _CNV_S_4_Enum_EEIN__299_CM_S2 0 3 /end CHARACTERISTIC
/begin CHARACTERISTIC XZ_EM_DAEMPFUNG_SOURCE "" VALUE 0x27B6C3 _REC_S1VAL_1_u1_S2 2 _CNV_S_3_Enum_ESIGN_84_CM_S2 0 2 /end CHARACTERISTIC
/begin CHARACTERISTIC XZ_FDC_SOURCE "" VALUE 0x27B690 _REC_S1VAL_1_u1_S2 2 _CNV_S_3_Enum_ESIGN_84_CM_S2 0 2 /end CHARACTERISTIC
/begin CHARACTERISTIC XZ_GEARREDUCTION_SOURCE "" VALUE 0x27B6C4 _REC_S1VAL_1_u1_S2 2 _CNV_S_3_Enum_ESIGN_84_CM_S2 0 2 /end CHARACTERISTIC
/begin CHARACTERISTIC XZ_MOTSTART_TYP_SIMULATE "" VALUE 0x27B6BF _REC_S1VAL_1_u1_S2 4 _CNV_S_5_Enum_EMOTS_282_CM_S2 0 4 /end CHARACTERISTIC
/begin CHARACTERISTIC XZ_NMOMAXRED_SOURCE "" VALUE 0x27B6B8 _REC_S1VAL_1_u1_S2 2 _CNV_S_3_Enum_ESIGN_84_CM_S2 0 2 /end CHARACTERISTIC
/begin CHARACTERISTIC XZ_POWERSWITCH_SOURCE "" VALUE 0x27B6B9 _REC_S1VAL_1_u1_S2 4 _CNV_S_5_Enum_ESIGN_300_CM_S2 0 4 /end CHARACTERISTIC
/begin CHARACTERISTIC XZ_REQUEST_LPA_SIMULATE "" VALUE 0x27B6C2 _REC_S1VAL_1_u1_S2 7 _CNV_S_8_Enum_E_Z_R_286_CM_S2 0 7 /end CHARACTERISTIC
/begin CHARACTERISTIC XZ_ROLLE_SOURCE "" VALUE 0x27B6BA _REC_S1VAL_1_u1_S2 2 _CNV_S_3_Enum_ESIGN_84_CM_S2 0 2 /end CHARACTERISTIC
/begin CHARACTERISTIC XZ_SOURCE_OVERRIDE_GANG "" VALUE 0x27B6BB _REC_S1VAL_1_u1_S2 5 _CNV_R_R_Umr_1_zu_1_2_CM_S2 0 5 FORMAT "%2.0" /end CHARACTERISTIC
/begin CHARACTERISTIC XZ_SPAREGEN_SOURCE "" VALUE 0x27B6C5 _REC_S1VAL_1_u1_S2 4 _CNV_S_5_Enum_ESPAR_301_CM_S2 0 4 /end CHARACTERISTIC
/begin CHARACTERISTIC XZ_VFZG_PLAUSI_SOURCE "" VALUE 0x27B6C6 _REC_S1VAL_1_u1_S2 2 _CNV_S_3_Enum_ESIGN_84_CM_S2 0 2 /end CHARACTERISTIC
/begin CHARACTERISTIC XZ_WDKVIRT_SOURCE "" VALUE 0x27B6BC _REC_S1VAL_1_u1_S2 2 _CNV_S_3_Enum_ESIGN_84_CM_S2 0 2 /end CHARACTERISTIC
/begin CHARACTERISTIC XTAB10X4FAKT_FWSSTEIGUNG_GEW "" MAP 0x27944E _REC_S7MAP_53_s2_u2_s2_S2 1 _CNV_R_R_Umr_100_zu_54_CM_S2 0 1 FORMAT "%4.2"
 /begin AXIS_DESCR STD_AXIS V_FZG _CNV_R_R_Umr_1_zu_1_8_CM_S2 10 0 500 FORMAT "%2.0" /end AXIS_DESCR
 /begin AXIS_DESCR STD_AXIS NO_INPUT_QUANTITY _CNV_S_4_Enum_EFWSS_304_CM_S2 4 0 3 READ_ONLY /end AXIS_DESCR
/end CHARACTERISTIC
/begin CHARACTERISTIC XTAB20M_RAD_FWSREF "" CURVE 0x27AB72 _REC_S7CUR_53_u2_u2_S2 1500 _CNV_R_R_Umr_1_zu_1_42_CM_S2 0 1500 FORMAT "%2.0"
 /begin AXIS_DESCR STD_AXIS V_FZG _CNV_R_R_Umr_1_zu_1_8_CM_S2 20 0 300 FORMAT "%2.0" /end AXIS_DESCR
/end CHARACTERISTIC
/begin CHARACTERISTIC XTAB2MASSE_FZG_EST_MAX "" CURVE 0x274D2C _REC_A1CUR_30_u2_u1_S2 5000 _CNV_R_R_Umr_1_zu_1_270_CM_S2 0 5000 FORMAT "%2.0"
 /begin AXIS_DESCR FIX_AXIS Z_FZG_ANH _CNV_S_3_Enum_EANH_65_CM_S2 2 0 2 FIX_AXIS_PAR_DIST 0 1 2 READ_ONLY /end AXIS_DESCR
/end CHARACTERISTIC
/begin CHARACTERISTIC XTAB2M_FWSMAX_EINLENK "" CURVE 0x2737D0 _REC_A1CUR_30_s2_u1_S2 400 _CNV_R_R_Umr_1_zu_1_42_CM_S2 0 400 FORMAT "%2.0"
 /begin AXIS_DESCR FIX_AXIS Z_FZG_ANH _CNV_S_3_Enum_EANH_65_CM_S2 2 0 2 FIX_AXIS_PAR_DIST 0 1 2 READ_ONLY /end AXIS_DESCR
/end CHARACTERISTIC
/begin CHARACTERISTIC XTAB3ODM_AB_FWS_PLUFT "" CURVE 0x2794CE _REC_S7CUR_53_s2_u2_S2 1000 _CNV_R_R_Umr_1_zu_1_42_CM_S2 0 1000 FORMAT "%2.0"
 /begin AXIS_DESCR STD_AXIS NO_INPUT_QUANTITY _CNV_R_R_Umr_1_zu_1_303_CM_S2 3 500 1100 FORMAT "%2.0" /end AXIS_DESCR
/end CHARACTERISTIC
/begin CHARACTERISTIC XTAB4M_AB_BREMS "" CURVE 0x27ABC4 _REC_S7CUR_53_s2_u2_S2 32768 _CNV_R_R_Umr_1_zu_1_42_CM_S2 -32768 0 FORMAT "%2.0"
 /begin AXIS_DESCR STD_AXIS P_BR _CNV_R_R_Umr_2_zu_1_238_CM_S2 4 0 254 FORMAT "%3.1" /end AXIS_DESCR
/end CHARACTERISTIC
/begin CHARACTERISTIC XTAB4X10DMABFWS_FILT_GEW "" MAP 0x2794F2 _REC_S3MAP_54_s2_s2_u2_S2 10000 _CNV_R_R_Umr_1_zu_1_2_CM_S2 0 10000 FORMAT "%2.0"
 /begin AXIS_DESCR STD_AXIS DM_AB_FWSDELTA _CNV_R_R_Umr_1_zu_1_42_CM_S2 10 -32768 32767 FORMAT "%2.0" /end AXIS_DESCR
 /begin AXIS_DESCR FIX_AXIS NO_INPUT_QUANTITY _CNV_S_4_Enum_EFILT_302_CM_S2 4 0 3 FIX_AXIS_PAR_DIST 0 1 4 READ_ONLY /end AXIS_DESCR
/end CHARACTERISTIC
/begin CHARACTERISTIC XTAB4X10FWSKOR_FAST_GEW "" MAP 0x279558 _REC_S3MAP_54_s2_s2_u2_S2 10000 _CNV_R_R_Umr_1_zu_1_2_CM_S2 0 10000 FORMAT "%2.0"
 /begin AXIS_DESCR STD_AXIS DM_AB_FWSDELTA _CNV_R_R_Umr_1_zu_1_42_CM_S2 10 -32768 32767 FORMAT "%2.0" /end AXIS_DESCR
 /begin AXIS_DESCR FIX_AXIS NO_INPUT_QUANTITY _CNV_S_4_Enum_EFILT_302_CM_S2 4 0 3 FIX_AXIS_PAR_DIST 0 1 4 READ_ONLY /end AXIS_DESCR
/end CHARACTERISTIC
/begin CHARACTERISTIC XTAB4X10FWSKOR_SLOW_GEW "" MAP 0x2795BE _REC_S3MAP_54_s2_s2_u2_S2 10000 _CNV_R_R_Umr_1_zu_1_2_CM_S2 0 10000 FORMAT "%2.0"
 /begin AXIS_DESCR STD_AXIS DM_AB_FWSDELTA _CNV_R_R_Umr_1_zu_1_42_CM_S2 10 -32768 32767 FORMAT "%2.0" /end AXIS_DESCR
 /begin AXIS_DESCR FIX_AXIS NO_INPUT_QUANTITY _CNV_S_4_Enum_EFILT_302_CM_S2 4 0 3 FIX_AXIS_PAR_DIST 0 1 4 READ_ONLY /end AXIS_DESCR
/end CHARACTERISTIC
/begin CHARACTERISTIC XTAB5SCHM_AB_BREMS_FWSBER "" CURVE 0x2794DC _REC_S7CUR_53_s2_u2_S2 10000 _CNV_R_R_Umr_1_zu_1_42_CM_S2 -10000 0 FORMAT "%2.0"
 /begin AXIS_DESCR STD_AXIS V_FZG _CNV_R_R_Umr_1_zu_1_8_CM_S2 5 0 250 FORMAT "%2.0" /end AXIS_DESCR
/end CHARACTERISTIC
/begin CHARACTERISTIC XTAB5X3KORFAKT_FWS_TEMP "" MAP 0x273770 _REC_S7MAP_53_u2_s2_s2_S2 2 _CNV_R_R_Umr_100_zu_54_CM_S2 0 2 FORMAT "%4.2"
 /begin AXIS_DESCR STD_AXIS TEMP_MOT _CNV_R_R_Umr_1_zu_1_1_CM_S2 5 -50 150 FORMAT "%2.0" /end AXIS_DESCR
 /begin AXIS_DESCR STD_AXIS TEMP_GETR _CNV_R_R_Umr_1_zu_1_1_CM_S2 3 -50 150 FORMAT "%2.0" /end AXIS_DESCR
/end CHARACTERISTIC
/begin CHARACTERISTIC XTAB5X3ODM_AB_FWS_TEMP "" MAP 0x2737A0 _REC_S7MAP_53_s2_s2_s2_S2 65535 _CNV_R_R_Umr_1_zu_1_42_CM_S2 -32768 32767 FORMAT "%4.2"
 /begin AXIS_DESCR STD_AXIS TEMP_MOT _CNV_R_R_Umr_1_zu_1_1_CM_S2 5 -50 150 FORMAT "%2.0" /end AXIS_DESCR
 /begin AXIS_DESCR STD_AXIS TEMP_GETR _CNV_R_R_Umr_1_zu_1_1_CM_S2 3 -50 150 FORMAT "%2.0" /end AXIS_DESCR
/end CHARACTERISTIC
/begin CHARACTERISTIC XTAB5_KORFAKT_MBR_FWS "" CURVE 0x27ABD6 _REC_S7CUR_53_u2_s2_S2 500 _CNV_R_R_Umr_1_zu_1_53_CM_S2 0 500 FORMAT "%2.0"
 /begin AXIS_DESCR STD_AXIS M_BR _CNV_R_R_Umr_1_zu_1_42_CM_S2 5 -32768 0 FORMAT "%4.2" /end AXIS_DESCR
/end CHARACTERISTIC
/begin CHARACTERISTIC XTAB9J_KORFAKT "" CURVE 0x27ABEC _REC_A1CUR_30_s2_u1_S2 4999 _CNV_R_R_Umr_1_zu_1_2_CM_S2 1 5000 FORMAT "%2.0"
 /begin AXIS_DESCR FIX_AXIS Z_GANG_ZIEL_SAS _CNV_S_9_Enum_EGANG_30_CM_S2 9 0 8 FIX_AXIS_PAR_DIST 0 1 9 READ_ONLY /end AXIS_DESCR
/end CHARACTERISTIC
/begin CHARACTERISTIC XTAB9SCHG2W_FILT_VALIDFWS "" CURVE 0x2794BC _REC_A1CUR_30_s2_u1_S2 2000 _CNV_R_R_Umr_10_zu__181_CM_S2 0 2000 FORMAT "%3.1"
 /begin AXIS_DESCR FIX_AXIS Z_GANG_ZIEL _CNV_S_9_Enum_EGANG_30_CM_S2 9 0 8 FIX_AXIS_PAR_DIST 0 1 9 READ_ONLY /end AXIS_DESCR
/end CHARACTERISTIC
/begin CHARACTERISTIC XANZTASKS_MRAD_DELAY "" VALUE 0x27B693 _REC_S1VAL_1_u1_S2 20 _CNV_R_R_Umr_1_zu_1_2_CM_S2 0 20 FORMAT "%2.0" /end CHARACTERISTIC
/begin CHARACTERISTIC XC_SUM_G3WAB_FWSFILTBUFFER "" VALUE 0x27B694 _REC_S1VAL_1_s1_S2 2 _CNV_R_R_Umr_1_zu_1_2_CM_S2 3 5 /end CHARACTERISTIC
/begin CHARACTERISTIC XDIFF_MUE_UEBER "" VALUE 0x279624 _REC_S1VAL_1_u2_S2 65.535 _CNV_R_R_Umr_1000_z_57_CM_S2 0 65.535 FORMAT "%5.3" /end CHARACTERISTIC
/begin CHARACTERISTIC XDM_AB_FWSALT_FILTINGEW "" VALUE 0x279626 _REC_S1VAL_1_s2_S2 65535 _CNV_R_R_Umr_1_zu_1_2_CM_S2 -32768 32767 FORMAT "%2.0" /end CHARACTERISTIC
/begin CHARACTERISTIC XDM_AB_FWSALT_FILTOUTGEW "" VALUE 0x279628 _REC_S1VAL_1_s2_S2 65535 _CNV_R_R_Umr_1_zu_1_2_CM_S2 -32768 32767 FORMAT "%2.0" /end CHARACTERISTIC
/begin CHARACTERISTIC XDM_AB_FWSFILTINGEW "" VALUE 0x27962A _REC_S1VAL_1_s2_S2 65535 _CNV_R_R_Umr_1_zu_1_2_CM_S2 -32768 32767 FORMAT "%2.0" /end CHARACTERISTIC
/begin CHARACTERISTIC XDM_AB_FWSFILTOUTGEW "" VALUE 0x27962C _REC_S1VAL_1_s2_S2 65535 _CNV_R_R_Umr_1_zu_1_2_CM_S2 -32768 32767 FORMAT "%2.0" /end CHARACTERISTIC
/begin CHARACTERISTIC XDM_AB_MUEFILTGEW "" VALUE 0x27962E _REC_S1VAL_1_s2_S2 65535 _CNV_R_R_Umr_1_zu_1_2_CM_S2 -32768 32767 FORMAT "%2.0" /end CHARACTERISTIC
/begin CHARACTERISTIC XDM_AB_MUEGEW "" VALUE 0x279630 _REC_S1VAL_1_s2_S2 65535 _CNV_R_R_Umr_1_zu_1_2_CM_S2 -32768 32767 FORMAT "%2.0" /end CHARACTERISTIC
/begin CHARACTERISTIC XFAKT_ACHSLASTVERTEILG "" VALUE 0x279632 _REC_S1VAL_1_u2_S2 100 _CNV_R_R_Umr_1_zu_1_53_CM_S2 0 100 FORMAT "%2.0" /end CHARACTERISTIC
/begin CHARACTERISTIC XMAB_IST_MRAD_INGEW "" VALUE 0x279634 _REC_S1VAL_1_s2_S2 65535 _CNV_R_R_Umr_1_zu_1_2_CM_S2 -32768 32767 FORMAT "%2.0" /end CHARACTERISTIC
/begin CHARACTERISTIC XMAB_IST_MRAD_OUTGEW "" VALUE 0x279636 _REC_S1VAL_1_s2_S2 65535 _CNV_R_R_Umr_1_zu_1_2_CM_S2 -32768 32767 FORMAT "%2.0" /end CHARACTERISTIC
/begin CHARACTERISTIC XMASSE_ANH "" VALUE 0x27ABFE _REC_S1VAL_1_u2_S2 2000 _CNV_R_R_Umr_1_zu_1_270_CM_S2 0 2000 FORMAT "%2.0" /end CHARACTERISTIC
/begin CHARACTERISTIC XMASSE_FZG "" VALUE 0x27AC00 _REC_S1VAL_1_u2_S2 3200 _CNV_R_R_Umr_1_zu_1_270_CM_S2 800 4000 FORMAT "%2.0" /end CHARACTERISTIC
/begin CHARACTERISTIC XMASSE_FZG_EST_MIN "" VALUE 0x27AC02 _REC_S1VAL_1_u2_S2 5000 _CNV_R_R_Umr_1_zu_1_270_CM_S2 0 5000 FORMAT "%2.0" /end CHARACTERISTIC
/begin CHARACTERISTIC XMASSE_FZG_FILTINGEW "" VALUE 0x27AC04 _REC_S1VAL_1_s2_S2 65535 _CNV_R_R_Umr_1_zu_1_2_CM_S2 -32768 32767 FORMAT "%2.0" /end CHARACTERISTIC
/begin CHARACTERISTIC XMASSE_FZG_FILTOUTGEW "" VALUE 0x27AC06 _REC_S1VAL_1_s2_S2 65535 _CNV_R_R_Umr_1_zu_1_2_CM_S2 -32768 32767 FORMAT "%2.0" /end CHARACTERISTIC
/begin CHARACTERISTIC XSCHGW_FP_VALIDFWSNEGATIV "" VALUE 0x279638 _REC_S1VAL_1_s2_S2 10000 _CNV_R_R_Umr_1_zu_1_306_CM_S2 -10000 0 /end CHARACTERISTIC
/begin CHARACTERISTIC XSCHGW_FP_VALIDFWSPOSITIV "" VALUE 0x27963A _REC_S1VAL_1_u2_S2 10000 _CNV_R_R_Umr_1_zu_1_306_CM_S2 0 10000 /end CHARACTERISTIC
/begin CHARACTERISTIC XSCHM_BR_ABS "" VALUE 0x27AC08 _REC_S1VAL_1_s2_S2 65535 _CNV_R_R_Umr_1_zu_1_42_CM_S2 -32768 32767 FORMAT "%3.1" /end CHARACTERISTIC
/begin CHARACTERISTIC XSCHN_AB_FWSVALID_MSAFZGSTOP "" VALUE 0x279646 _REC_S1VAL_1_u2_S2 10000 _CNV_R_R_Umr_1_zu_1_3_CM_S2 0 10000 FORMAT "%2.0" /end CHARACTERISTIC
/begin CHARACTERISTIC XSCHN_AB_FWSVALID_MSASTART "" VALUE 0x279648 _REC_S1VAL_1_u2_S2 10000 _CNV_R_R_Umr_1_zu_1_3_CM_S2 0 10000 FORMAT "%2.0" /end CHARACTERISTIC
/begin CHARACTERISTIC XSCHN_MOT_FWSVALID_MSAFZGSTOP "" VALUE 0x27964A _REC_S1VAL_1_u2_S2 10000 _CNV_R_R_Umr_1_zu_1_3_CM_S2 0 10000 FORMAT "%2.0" /end CHARACTERISTIC
/begin CHARACTERISTIC XSCHN_MOT_FWSVALID_MSASTART "" VALUE 0x27964C _REC_S1VAL_1_u2_S2 10000 _CNV_R_R_Umr_1_zu_1_3_CM_S2 0 10000 FORMAT "%2.0" /end CHARACTERISTIC
/begin CHARACTERISTIC XS_QU_MASSE_FZG_EST "" VALUE 0x27B7AC _REC_S1VAL_1_u1_S2 1 _CNV_R_R_Umr_1_zu_1_2_CM_S2 0 1 FORMAT "%2.0" /end CHARACTERISTIC
/begin CHARACTERISTIC XS_SOURCE_FWSBER_MRADIST "" VALUE 0x27B695 _REC_S1VAL_1_u1_S2 1 _CNV_R_R_Umr_1_zu_1_2_CM_S2 0 1 /end CHARACTERISTIC
/begin CHARACTERISTIC XS_SOURCE_FZGMASSEBESTIMMUNG "" VALUE 0x27B696 _REC_S1VAL_1_u1_S2 1 _CNV_R_R_Umr_1_zu_1_2_CM_S2 0 1 FORMAT "%2.0" /end CHARACTERISTIC
/begin CHARACTERISTIC XS_USE_BREMSENSTATUS_FWSBER "" VALUE 0x27B697 _REC_S1VAL_1_u1_S2 1 _CNV_R_R_Umr_1_zu_1_2_CM_S2 0 1 /end CHARACTERISTIC
/begin CHARACTERISTIC XS_USE_FREEZE_FWS "" VALUE 0x27B698 _REC_S1VAL_1_u1_S2 1 _CNV_R_R_Umr_1_zu_1_2_CM_S2 0 1 FORMAT "%2.0" /end CHARACTERISTIC
/begin CHARACTERISTIC XS_USE_FREEZE_FWSFAST "" VALUE 0x27B699 _REC_S1VAL_1_u1_S2 1 _CNV_R_R_Umr_1_zu_1_2_CM_S2 0 1 FORMAT "%2.0" /end CHARACTERISTIC
/begin CHARACTERISTIC XS_USE_FREEZE_FWSSLOW "" VALUE 0x27B69A _REC_S1VAL_1_u1_S2 1 _CNV_R_R_Umr_1_zu_1_2_CM_S2 0 1 FORMAT "%2.0" /end CHARACTERISTIC
/begin CHARACTERISTIC XS_USE_FWS_EINLENK "" VALUE 0x27B69B _REC_S1VAL_1_u1_S2 1 _CNV_S_2_Schalter_A_4_CM_S2 0 1 /end CHARACTERISTIC
/begin CHARACTERISTIC XS_USE_FWS_STEIGUNG "" VALUE 0x27B69C _REC_S1VAL_1_u1_S2 1 _CNV_S_2_Schalter_A_4_CM_S2 0 1 /end CHARACTERISTIC
/begin CHARACTERISTIC XS_USE_G2W_AB_VALIDFWS "" VALUE 0x27B69D _REC_S1VAL_1_u1_S2 1 _CNV_R_R_Umr_1_zu_1_2_CM_S2 0 1 FORMAT "%2.0" /end CHARACTERISTIC
/begin CHARACTERISTIC XS_USE_MABBREMS "" VALUE 0x27B7AD _REC_S1VAL_1_u1_S2 1 _CNV_R_R_Umr_1_zu_1_2_CM_S2 0 1 FORMAT "%2.0" /end CHARACTERISTIC
/begin CHARACTERISTIC XS_USE_REGELBREMSUNG "" VALUE 0x27B7AE _REC_S1VAL_1_u1_S2 1 _CNV_R_R_Umr_1_zu_1_2_CM_S2 0 1 FORMAT "%2.0" /end CHARACTERISTIC
/begin CHARACTERISTIC XS_USE_SCHLUPF_FWSFREEZE "" VALUE 0x27B69E _REC_S1VAL_1_u1_S2 1 _CNV_R_R_Umr_1_zu_1_2_CM_S2 0 1 FORMAT "%2.0" /end CHARACTERISTIC
/begin CHARACTERISTIC XS_USE_VALIDFWS "" VALUE 0x27B69F _REC_S1VAL_1_u1_S2 1 _CNV_R_R_Umr_1_zu_1_2_CM_S2 0 1 FORMAT "%2.0" /end CHARACTERISTIC
/begin CHARACTERISTIC XT_PRUEF1_VALIDFWS "" VALUE 0x27963C _REC_S1VAL_1_u2_S2 1000 _CNV_R_R_Umr_1_zu_1_82_CM_S2 0 1000 /end CHARACTERISTIC
/begin CHARACTERISTIC XT_PRUEF2_VALIDFWS "" VALUE 0x27963E _REC_S1VAL_1_s2_S2 1000 _CNV_R_R_Umr_1_zu_1_82_CM_S2 0 1000 FORMAT "%2.0" /end CHARACTERISTIC
/begin CHARACTERISTIC XT_SPERR_FWSVALID_MSASTART "" VALUE 0x27964E _REC_S1VAL_1_u2_S2 5000 _CNV_R_R_Umr_1_zu_1_6_CM_S2 0 5000 FORMAT "%2.0" /end CHARACTERISTIC
/begin CHARACTERISTIC XT_VALIDFWS_BREMS "" VALUE 0x279640 _REC_S1VAL_1_u2_S2 65000 _CNV_R_R_Umr_1_zu_1_6_CM_S2 0 65000 FORMAT "%2.0" /end CHARACTERISTIC
/begin CHARACTERISTIC XT_VALIDFWS_BREMS_FLANKE "" VALUE 0x279642 _REC_S1VAL_1_u2_S2 1000 _CNV_R_R_Umr_1_zu_1_6_CM_S2 0 1000 FORMAT "%2.0" /end CHARACTERISTIC
/begin CHARACTERISTIC XT_VALIDFWS_GWFP "" VALUE 0x279644 _REC_S1VAL_1_u2_S2 65535 _CNV_R_R_Umr_1_zu_1_6_CM_S2 0 65535 FORMAT "%2.0" /end CHARACTERISTIC
/begin CHARACTERISTIC XZ_DM_RAD_FWS_FILT "" VALUE 0x27B6A0 _REC_S1VAL_1_u1_S2 2 _CNV_S_3_Enum_EDMRA_307_CM_S2 0 2 /end CHARACTERISTIC
/begin CHARACTERISTIC XTAB10X2DM_FWSKOMP_FILT_GEW "" MAP 0x2796B6 _REC_S3MAP_54_u2_u2_u1_S2 65535 _CNV_R_R_Umr_1_zu_1_53_CM_S2 0 65535 FORMAT "%2.0" /begin AXIS_DESCR STD_AXIS V_FZG _CNV_R_R_Umr_1_zu_1_8_CM_S2 10 0 65535 /end AXIS_DESCR
 /begin AXIS_DESCR FIX_AXIS Z_AGS_MODBEDEL _CNV_S_2_Enum_EAGS_25_CM_S2 2 0 1 FIX_AXIS_PAR_DIST 0 1 2 READ_ONLY /end AXIS_DESCR
/end CHARACTERISTIC
/begin CHARACTERISTIC XTAB4X10DM_RAD_FWSKOMP_GEW "" MAP 0x2796F4 _REC_S3MAP_54_s2_s2_u2_S2 10000 _CNV_R_R_Umr_1_zu_1_2_CM_S2 0 10000 FORMAT "%2.0"
 /begin AXIS_DESCR STD_AXIS DM_AB_FWSDELTA _CNV_R_R_Umr_1_zu_1_42_CM_S2 10 -32768 32767 FORMAT "%2.0" /end AXIS_DESCR
 /begin AXIS_DESCR FIX_AXIS NO_INPUT_QUANTITY _CNV_S_4_Enum_EFILT_302_CM_S2 4 0 3 FIX_AXIS_PAR_DIST 0 1 4 READ_ONLY /end AXIS_DESCR
/end CHARACTERISTIC
/begin CHARACTERISTIC XTAB5DM_RAD_FWSKOMP_MAX "" CURVE 0x27975A _REC_S7CUR_53_s2_s2_S2 10000 _CNV_R_R_Umr_1_zu_1_248_CM_S2 -5000 5000 FORMAT "%2.0"
 /begin AXIS_DESCR STD_AXIS W_STEIGUNG_KORFILT _CNV_R_R_Umr_10_zu__9_CM_S2 5 -200 200 FORMAT "%3.1" /end AXIS_DESCR
/end CHARACTERISTIC
/begin CHARACTERISTIC XTAB5DM_RAD_FWSKOMP_MIN "" CURVE 0x279770 _REC_S7CUR_53_s2_s2_S2 10000 _CNV_R_R_Umr_1_zu_1_248_CM_S2 -5000 5000 FORMAT "%2.0"
 /begin AXIS_DESCR STD_AXIS W_STEIGUNG_KORFILT _CNV_R_R_Umr_10_zu__9_CM_S2 5 -200 200 FORMAT "%3.1" /end AXIS_DESCR
/end CHARACTERISTIC
/begin CHARACTERISTIC XDM_RAD_KOMPGRAD_MAX "" VALUE 0x279786 _REC_S1VAL_1_s2_S2 9900 _CNV_R_R_Umr_1_zu_1_309_CM_S2 100 10000 FORMAT "%2.0" /end CHARACTERISTIC
/begin CHARACTERISTIC XDM_RAD_KOMPGRAD_MIN "" VALUE 0x279788 _REC_S1VAL_1_s2_S2 9900 _CNV_R_R_Umr_1_zu_1_309_CM_S2 -10000 -100 FORMAT "%2.0" /end CHARACTERISTIC
/begin CHARACTERISTIC XS_USE_STEIGUNG_FWSKOMP "" VALUE 0x27B6B1 _REC_S1VAL_1_u1_S2 1 _CNV_S_2_Schalter_A_4_CM_S2 0 1 /end CHARACTERISTIC
/begin CHARACTERISTIC XA_Q_KURVE "" CURVE 0x27978A _REC_A1CUR_30_u2_u2_S2 3276.7 _CNV_R_R_Umr_10_zu__46_CM_S2 0 3276.7 FORMAT "%3.1"
 /begin AXIS_DESCR FIX_AXIS NO_INPUT_QUANTITY _CNV_S_5_Enum_EKURV_310_CM_S2 5 0 4 FIX_AXIS_PAR_DIST 0 1 5 READ_ONLY /end AXIS_DESCR
/end CHARACTERISTIC
/begin CHARACTERISTIC XDA_Q_KURVE "" CURVE 0x2738E0 _REC_A1CUR_30_s2_u1_S2 40 _CNV_R_R_Umr_10_zu__46_CM_S2 -20 20 FORMAT "%3.1"
 /begin AXIS_DESCR FIX_AXIS Z_MOD_KURVE _CNV_S_4_Enum_EKURV_311_CM_S2 4 0 3 FIX_AXIS_PAR_DIST 0 1 4 READ_ONLY /end AXIS_DESCR
/end CHARACTERISTIC
/begin CHARACTERISTIC XHA_Q_KURVE "" CURVE 0x279794 _REC_A1CUR_30_u2_u2_S2 3276.7 _CNV_R_R_Umr_10_zu__46_CM_S2 0 3276.7 FORMAT "%3.1"
 /begin AXIS_DESCR FIX_AXIS NO_INPUT_QUANTITY _CNV_S_5_Enum_EKURV_310_CM_S2 5 0 4 FIX_AXIS_PAR_DIST 0 1 5 READ_ONLY /end AXIS_DESCR
/end CHARACTERISTIC
/begin CHARACTERISTIC XKLY5DN_RAD_HAKURVE "" CURVE 0x27930E _REC_S7CUR_53_u2_u2_S2 20000 _CNV_R_R_Umr_1_zu_1_3_CM_S2 0 20000 FORMAT "%2.0"
 /begin AXIS_DESCR STD_AXIS MN_RAD_HA _CNV_R_R_Umr_1_zu_1_3_CM_S2 5 0 65535 FORMAT "%2.0" /end AXIS_DESCR
/end CHARACTERISTIC
/begin CHARACTERISTIC XTAB3X3T_KURVE_NACHL "" MAP 0x27979E _REC_S3MAP_54_u2_u2_u1_S2 10000 _CNV_R_R_Umr_1_zu_1_6_CM_S2 0 10000 FORMAT "%2.0"
 /begin AXIS_DESCR STD_AXIS V_FZG _CNV_R_R_Umr_1_zu_1_8_CM_S2 3 0 250 FORMAT "%2.0" /end AXIS_DESCR
 /begin AXIS_DESCR FIX_AXIS Z_AGS_TID_MOD _CNV_S_3_Enum_EAGST_312_CM_S2 3 0 2 FIX_AXIS_PAR_DIST 0 1 3 READ_ONLY /end AXIS_DESCR
/end CHARACTERISTIC
/begin CHARACTERISTIC XTAB5SCHA_Q_EINLENK "" CURVE 0x2797B8 _REC_S7CUR_53_u2_u2_S2 6553.5 _CNV_R_R_Umr_10_zu__46_CM_S2 0 6553.5 FORMAT "%3.1"
 /begin AXIS_DESCR STD_AXIS V_FZG _CNV_R_R_Umr_1_zu_1_8_CM_S2 5 0 500 FORMAT "%2.0" /end AXIS_DESCR
/end CHARACTERISTIC
/begin CHARACTERISTIC XTAB5SCHA_Q_SERP "" CURVE 0x2797CE _REC_S7CUR_53_u2_u2_S2 6553.5 _CNV_R_R_Umr_10_zu__46_CM_S2 0 6553.5 FORMAT "%3.1"
 /begin AXIS_DESCR STD_AXIS V_FZG _CNV_R_R_Umr_1_zu_1_8_CM_S2 5 0 65535 FORMAT "%2.0" /end AXIS_DESCR
/end CHARACTERISTIC
/begin CHARACTERISTIC XTAB5SCHW_LWVA_EFF_EINLENK "" CURVE 0x2797E4 _REC_S7CUR_53_u2_u2_S2 50 _CNV_R_R_Umr_10_zu__10_CM_S2 0 50 FORMAT "%3.1"
 /begin AXIS_DESCR STD_AXIS V_FZG _CNV_R_R_Umr_1_zu_1_8_CM_S2 5 0 500 FORMAT "%2.0" /end AXIS_DESCR
/end CHARACTERISTIC
/begin CHARACTERISTIC XTAB5SCHW_LWVA_EFF_KURVE "" CURVE 0x2797FA _REC_S7CUR_53_s2_u2_S2 50 _CNV_R_R_Umr_10_zu__10_CM_S2 0 50 FORMAT "%3.1"
 /begin AXIS_DESCR STD_AXIS V_FZG _CNV_R_R_Umr_1_zu_1_8_CM_S2 5 0 400 FORMAT "%2.0" /end AXIS_DESCR
/end CHARACTERISTIC
/begin CHARACTERISTIC XTAB5SCHW_LWVA_EFF_SERP "" CURVE 0x279810 _REC_S7CUR_53_s2_u2_S2 50 _CNV_R_R_Umr_10_zu__10_CM_S2 0 50 FORMAT "%3.1"
 /begin AXIS_DESCR STD_AXIS V_FZG _CNV_R_R_Umr_1_zu_1_8_CM_S2 5 0 400 FORMAT "%2.0" /end AXIS_DESCR
/end CHARACTERISTIC
/begin CHARACTERISTIC XT_KURVE_LDMNACHL "" CURVE 0x2738E8 _REC_A1CUR_30_u4_u1_S2 4.29497E+009 _CNV_R_R_Umr_1_zu_1_6_CM_S2 0 4294967295 FORMAT "%2.0"
 /begin AXIS_DESCR FIX_AXIS Z_AGS_MODBEDEL _CNV_S_2_Enum_EAGS_25_CM_S2 2 0 1 FIX_AXIS_PAR_DIST 0 1 2 READ_ONLY /end AXIS_DESCR
/end CHARACTERISTIC
/begin CHARACTERISTIC XCA_Q_KURVE "" VALUE 0x279826 _REC_S1VAL_1_u2_S2 19 _CNV_R_R_Umr_1_zu_1_2_CM_S2 1 20 FORMAT "%2.0" /end CHARACTERISTIC
/begin CHARACTERISTIC XHA_Q_EINLENK "" VALUE 0x279828 _REC_S1VAL_1_u2_S2 6553.5 _CNV_R_R_Umr_10_zu__46_CM_S2 0 6553.5 FORMAT "%3.1" /end CHARACTERISTIC
/begin CHARACTERISTIC XHW_LWVA_EFF_EINLENK "" VALUE 0x27982A _REC_S1VAL_1_u2_S2 50 _CNV_R_R_Umr_10_zu__10_CM_S2 0 50 FORMAT "%3.1" /end CHARACTERISTIC
/begin CHARACTERISTIC XHW_LWVA_EFF_KURVE "" VALUE 0x27982C _REC_S1VAL_1_s2_S2 50 _CNV_R_R_Umr_10_zu__10_CM_S2 0 50 FORMAT "%3.1" /end CHARACTERISTIC
/begin CHARACTERISTIC XHW_LWVA_EFF_SERP "" VALUE 0x27982E _REC_S1VAL_1_s2_S2 50 _CNV_R_R_Umr_10_zu__10_CM_S2 0 50 FORMAT "%3.1" /end CHARACTERISTIC
/begin CHARACTERISTIC XT_NACHLAUF_EINLENK "" VALUE 0x2738F0 _REC_S1VAL_1_u4_S2 2.14748E+009 _CNV_R_R_Umr_1_zu_1_6_CM_S2 0 2147483647 FORMAT "%2.0" /end CHARACTERISTIC
/begin CHARACTERISTIC XT_SERP_NACHLAUF "" VALUE 0x2738F4 _REC_S1VAL_1_u4_S2 2.14748E+009 _CNV_R_R_Umr_1_zu_1_6_CM_S2 0 2147483647 FORMAT "%2.0" /end CHARACTERISTIC
/begin CHARACTERISTIC XW_LWVA_EFF_FILTINGEW "" VALUE 0x279840 _REC_S1VAL_1_s2_S2 499 _CNV_R_R_Umr_1_zu_1_2_CM_S2 1 500 FORMAT "%2.0" /end CHARACTERISTIC
/begin CHARACTERISTIC XW_LWVA_EFF_FILTOUTGEW "" VALUE 0x279842 _REC_S1VAL_1_s2_S2 500 _CNV_R_R_Umr_1_zu_1_2_CM_S2 0 500 FORMAT "%2.0" /end CHARACTERISTIC
/begin CHARACTERISTIC XSCHW_STEIGUNG_AUS_MSA "" VALUE 0x2757B4 _REC_S1VAL_1_s2_S2 400 _CNV_R_R_Umr_10_zu__9_CM_S2 -200 200 FORMAT "%3.1" /end CHARACTERISTIC
/begin CHARACTERISTIC XSCHW_STEIGUNG_EIN_MSA "" VALUE 0x2757B6 _REC_S1VAL_1_s2_S2 400 _CNV_R_R_Umr_10_zu__9_CM_S2 -200 200 FORMAT "%3.1" /end CHARACTERISTIC
/begin CHARACTERISTIC XSCHZ_BERGANH_MSA "" VALUE 0x27AF1C _REC_S1VAL_1_u1_S2 5 _CNV_S_6_Enum_EBERG_61_CM_S2 0 5 /end CHARACTERISTIC
/begin CHARACTERISTIC XS_MSA_VERBOT_FAS "" VALUE 0x27AF1B _REC_S1VAL_1_u1_S2 1 _CNV_R_R_Umr_1_zu_1_2_CM_S2 0 1 FORMAT "%2.0" /end CHARACTERISTIC
/begin CHARACTERISTIC XS_MSA_VERBOT_SERP "" VALUE 0x27AF1D _REC_S1VAL_1_u1_S2 1 _CNV_R_R_Umr_1_zu_1_2_CM_S2 0 1 FORMAT "%2.0" /end CHARACTERISTIC
/begin CHARACTERISTIC XT_MSA_VERBOT_STEIGUNGNACHL "" VALUE 0x2757B8 _REC_S1VAL_1_u2_S2 10000 _CNV_R_R_Umr_1_zu_1_2_CM_S2 0 10000 FORMAT "%2.0" /end CHARACTERISTIC
/begin CHARACTERISTIC XTAB8HM_VM_Z_K0 "" CURVE 0x2792D8 _REC_A1CUR_30_s2_u1_S2 100 _CNV_R_R_Umr_1_zu_1_42_CM_S2 0 100 FORMAT "%2.0"
 /begin AXIS_DESCR FIX_AXIS Z_GANG_ZIEL _CNV_S_9_Enum_EGANG_30_CM_S2 9 0 8 FIX_AXIS_PAR_DIST 0 1 9 READ_ONLY /end AXIS_DESCR
/end CHARACTERISTIC
/begin CHARACTERISTIC XTAB8HN_VM_Z_K0 "" CURVE 0x2792EA _REC_A1CUR_30_s2_u1_S2 500 _CNV_R_R_Umr_1_zu_1_3_CM_S2 0 500 FORMAT "%2.0"
 /begin AXIS_DESCR FIX_AXIS Z_GANG_ZIEL _CNV_S_9_Enum_EGANG_30_CM_S2 9 0 8 FIX_AXIS_PAR_DIST 0 1 9 READ_ONLY /end AXIS_DESCR
/end CHARACTERISTIC
/begin CHARACTERISTIC XTAB8X7Z_K0_SOLL_ASDAKT_GANG1 "" MAP 0x2731E8 _REC_S7MAP_53_u1_s2_u2_S2 2 _CNV_S_2_Enum_EK0_S_314_CM_S2 3 5
 /begin AXIS_DESCR STD_AXIS M_MOT_STAT _CNV_R_R_Umr_1_zu_1_42_CM_S2 8 0 500 FORMAT "%2.0" /end AXIS_DESCR
 /begin AXIS_DESCR STD_AXIS N_MOT _CNV_R_R_Umr_1_zu_1_3_CM_S2 7 0 8000 FORMAT "%2.0" /end AXIS_DESCR
/end CHARACTERISTIC
/begin CHARACTERISTIC XTAB8X7Z_K0_SOLL_ASDAKT_GANG2 "" MAP 0x273240 _REC_S7MAP_53_u1_s2_u2_S2 2 _CNV_S_2_Enum_EK0_S_314_CM_S2 3 5
 /begin AXIS_DESCR STD_AXIS M_MOT_STAT _CNV_R_R_Umr_1_zu_1_42_CM_S2 8 0 500 FORMAT "%2.0" /end AXIS_DESCR
 /begin AXIS_DESCR STD_AXIS N_MOT _CNV_R_R_Umr_1_zu_1_3_CM_S2 7 0 8000 FORMAT "%2.0" /end AXIS_DESCR
/end CHARACTERISTIC
/begin CHARACTERISTIC XTAB8X7Z_K0_SOLL_ASDAKT_GANG3 "" MAP 0x273298 _REC_S7MAP_53_u1_s2_u2_S2 2 _CNV_S_2_Enum_EK0_S_314_CM_S2 3 5
 /begin AXIS_DESCR STD_AXIS M_MOT_STAT _CNV_R_R_Umr_1_zu_1_42_CM_S2 8 0 500 FORMAT "%2.0" /end AXIS_DESCR
 /begin AXIS_DESCR STD_AXIS N_MOT _CNV_R_R_Umr_1_zu_1_3_CM_S2 7 0 8000 FORMAT "%2.0" /end AXIS_DESCR
/end CHARACTERISTIC
/begin CHARACTERISTIC XTAB8X7Z_K0_SOLL_ASDAKT_GANG4 "" MAP 0x2732F0 _REC_S7MAP_53_u1_s2_u2_S2 2 _CNV_S_2_Enum_EK0_S_314_CM_S2 3 5
 /begin AXIS_DESCR STD_AXIS M_MOT_STAT _CNV_R_R_Umr_1_zu_1_42_CM_S2 8 0 500 FORMAT "%2.0" /end AXIS_DESCR
 /begin AXIS_DESCR STD_AXIS N_MOT _CNV_R_R_Umr_1_zu_1_3_CM_S2 7 0 8000 FORMAT "%2.0" /end AXIS_DESCR
/end CHARACTERISTIC
/begin CHARACTERISTIC XTAB8X7Z_K0_SOLL_ASDAKT_GANG5 "" MAP 0x273348 _REC_S7MAP_53_u1_s2_u2_S2 2 _CNV_S_2_Enum_EK0_S_314_CM_S2 3 5
 /begin AXIS_DESCR STD_AXIS M_MOT_STAT _CNV_R_R_Umr_1_zu_1_42_CM_S2 8 0 500 FORMAT "%2.0" /end AXIS_DESCR
 /begin AXIS_DESCR STD_AXIS N_MOT _CNV_R_R_Umr_1_zu_1_3_CM_S2 7 0 8000 FORMAT "%2.0" /end AXIS_DESCR
/end CHARACTERISTIC
/begin CHARACTERISTIC XTAB8X7Z_K0_SOLL_ASDAKT_GANG6 "" MAP 0x2733A0 _REC_S7MAP_53_u1_s2_u2_S2 2 _CNV_S_2_Enum_EK0_S_314_CM_S2 3 5
 /begin AXIS_DESCR STD_AXIS M_MOT_STAT _CNV_R_R_Umr_1_zu_1_42_CM_S2 8 0 500 FORMAT "%2.0" /end AXIS_DESCR
 /begin AXIS_DESCR STD_AXIS N_MOT _CNV_R_R_Umr_1_zu_1_3_CM_S2 7 0 8000 FORMAT "%2.0" /end AXIS_DESCR
/end CHARACTERISTIC
/begin CHARACTERISTIC XTAB8X7Z_K0_SOLL_ASDAKT_GANG7 "" MAP 0x273608 _REC_S7MAP_53_u1_s2_u2_S2 2 _CNV_S_2_Enum_EK0_S_314_CM_S2 3 5
 /begin AXIS_DESCR STD_AXIS M_MOT_STAT _CNV_R_R_Umr_1_zu_1_42_CM_S2 8 0 500 FORMAT "%2.0" /end AXIS_DESCR
 /begin AXIS_DESCR STD_AXIS N_MOT _CNV_R_R_Umr_1_zu_1_3_CM_S2 7 0 8000 FORMAT "%2.0" /end AXIS_DESCR
/end CHARACTERISTIC
/begin CHARACTERISTIC XTAB8X7Z_K0_SOLL_ASDAKT_GANG8 "" MAP 0x2736B8 _REC_S7MAP_53_u1_s2_u2_S2 2 _CNV_S_2_Enum_EK0_S_314_CM_S2 3 5
 /begin AXIS_DESCR STD_AXIS M_MOT_STAT _CNV_R_R_Umr_1_zu_1_42_CM_S2 8 0 500 FORMAT "%2.0" /end AXIS_DESCR
 /begin AXIS_DESCR STD_AXIS N_MOT _CNV_R_R_Umr_1_zu_1_3_CM_S2 7 0 8000 FORMAT "%2.0" /end AXIS_DESCR
/end CHARACTERISTIC
/begin CHARACTERISTIC XTAB8X7Z_K0_SOLL_ASDINA_GANG1 "" MAP 0x2733F8 _REC_S7MAP_53_u1_s2_u2_S2 2 _CNV_S_2_Enum_EK0_S_314_CM_S2 3 5
 /begin AXIS_DESCR STD_AXIS M_MOT_STAT _CNV_R_R_Umr_1_zu_1_42_CM_S2 8 0 500 FORMAT "%2.0" /end AXIS_DESCR
 /begin AXIS_DESCR STD_AXIS N_MOT _CNV_R_R_Umr_1_zu_1_3_CM_S2 7 0 8000 FORMAT "%2.0" /end AXIS_DESCR
/end CHARACTERISTIC
/begin CHARACTERISTIC XTAB8X7Z_K0_SOLL_ASDINA_GANG2 "" MAP 0x273450 _REC_S7MAP_53_u1_s2_u2_S2 2 _CNV_S_2_Enum_EK0_S_314_CM_S2 3 5
 /begin AXIS_DESCR STD_AXIS M_MOT_STAT _CNV_R_R_Umr_1_zu_1_42_CM_S2 8 0 500 FORMAT "%2.0" /end AXIS_DESCR
 /begin AXIS_DESCR STD_AXIS N_MOT _CNV_R_R_Umr_1_zu_1_3_CM_S2 7 0 8000 FORMAT "%2.0" /end AXIS_DESCR
/end CHARACTERISTIC
/begin CHARACTERISTIC XTAB8X7Z_K0_SOLL_ASDINA_GANG3 "" MAP 0x2734A8 _REC_S7MAP_53_u1_s2_u2_S2 2 _CNV_S_2_Enum_EK0_S_314_CM_S2 3 5
 /begin AXIS_DESCR STD_AXIS M_MOT_STAT _CNV_R_R_Umr_1_zu_1_42_CM_S2 8 0 500 FORMAT "%2.0" /end AXIS_DESCR
 /begin AXIS_DESCR STD_AXIS N_MOT _CNV_R_R_Umr_1_zu_1_3_CM_S2 7 0 8000 FORMAT "%2.0" /end AXIS_DESCR
/end CHARACTERISTIC
/begin CHARACTERISTIC XTAB8X7Z_K0_SOLL_ASDINA_GANG4 "" MAP 0x273500 _REC_S7MAP_53_u1_s2_u2_S2 2 _CNV_S_2_Enum_EK0_S_314_CM_S2 3 5
 /begin AXIS_DESCR STD_AXIS M_MOT_STAT _CNV_R_R_Umr_1_zu_1_42_CM_S2 8 0 500 FORMAT "%2.0" /end AXIS_DESCR
 /begin AXIS_DESCR STD_AXIS N_MOT _CNV_R_R_Umr_1_zu_1_3_CM_S2 7 0 8000 FORMAT "%2.0" /end AXIS_DESCR
/end CHARACTERISTIC
/begin CHARACTERISTIC XTAB8X7Z_K0_SOLL_ASDINA_GANG5 "" MAP 0x273558 _REC_S7MAP_53_u1_s2_u2_S2 2 _CNV_S_2_Enum_EK0_S_314_CM_S2 3 5
 /begin AXIS_DESCR STD_AXIS M_MOT_STAT _CNV_R_R_Umr_1_zu_1_42_CM_S2 8 0 500 FORMAT "%2.0" /end AXIS_DESCR
 /begin AXIS_DESCR STD_AXIS N_MOT _CNV_R_R_Umr_1_zu_1_3_CM_S2 7 0 8000 FORMAT "%2.0" /end AXIS_DESCR
/end CHARACTERISTIC
/begin CHARACTERISTIC XTAB8X7Z_K0_SOLL_ASDINA_GANG6 "" MAP 0x2735B0 _REC_S7MAP_53_u1_s2_u2_S2 2 _CNV_S_2_Enum_EK0_S_314_CM_S2 3 5
 /begin AXIS_DESCR STD_AXIS M_MOT_STAT _CNV_R_R_Umr_1_zu_1_42_CM_S2 8 0 500 FORMAT "%2.0" /end AXIS_DESCR
 /begin AXIS_DESCR STD_AXIS N_MOT _CNV_R_R_Umr_1_zu_1_3_CM_S2 7 0 8000 FORMAT "%2.0" /end AXIS_DESCR
/end CHARACTERISTIC
/begin CHARACTERISTIC XTAB8X7Z_K0_SOLL_ASDINA_GANG7 "" MAP 0x273660 _REC_S7MAP_53_u1_s2_u2_S2 2 _CNV_S_2_Enum_EK0_S_314_CM_S2 3 5
 /begin AXIS_DESCR STD_AXIS M_MOT_STAT _CNV_R_R_Umr_1_zu_1_42_CM_S2 8 0 500 FORMAT "%2.0" /end AXIS_DESCR
 /begin AXIS_DESCR STD_AXIS N_MOT _CNV_R_R_Umr_1_zu_1_3_CM_S2 7 0 8000 FORMAT "%2.0" /end AXIS_DESCR
/end CHARACTERISTIC
/begin CHARACTERISTIC XTAB8X7Z_K0_SOLL_ASDINA_GANG8 "" MAP 0x273710 _REC_S7MAP_53_u1_s2_u2_S2 2 _CNV_S_2_Enum_EK0_S_314_CM_S2 3 5
 /begin AXIS_DESCR STD_AXIS M_MOT_STAT _CNV_R_R_Umr_1_zu_1_42_CM_S2 8 0 500 FORMAT "%2.0" /end AXIS_DESCR
 /begin AXIS_DESCR STD_AXIS N_MOT _CNV_R_R_Umr_1_zu_1_3_CM_S2 7 0 8000 FORMAT "%2.0" /end AXIS_DESCR
/end CHARACTERISTIC
/begin CHARACTERISTIC XDN_K0_SOLL "" VALUE 0x2757A8 _REC_S1VAL_1_u2_S2 10000 _CNV_R_R_Umr_1_zu_1_3_CM_S2 0 10000 FORMAT "%2.0" /end CHARACTERISTIC
/begin CHARACTERISTIC XFAKT_GK0_FDYN "" VALUE 0x27AEE4 _REC_S1VAL_1_u1_S2 100 _CNV_R_R_Umr_1_zu_1_53_CM_S2 0 100 FORMAT "%2.0" /end CHARACTERISTIC
/begin CHARACTERISTIC XS_GK0_FAHRDYNAMIK "" VALUE 0x27AEE5 _REC_S1VAL_1_u1_S2 1 _CNV_R_R_Umr_1_zu_1_2_CM_S2 0 1 FORMAT "%2.0" /end CHARACTERISTIC
/begin CHARACTERISTIC XTAB18Z_KRIT_PRIO_DBM "" CURVE 0x274F66 _REC_A1CUR_30_s2_s2_S2 255 _CNV_R_R_Umr_1_zu_1_2_CM_S2 0 255 FORMAT "%2.0"
 /begin AXIS_DESCR FIX_AXIS NO_INPUT_QUANTITY _CNV_S_17_Enum_EKRIT_323_CM_S2 17 0 16 /begin FIX_AXIS_PAR_LIST 0 1 2 3 4 5 6 7 8 9 10 11 12 13 14 15 16 /end FIX_AXIS_PAR_LIST READ_ONLY /end AXIS_DESCR
/end CHARACTERISTIC
/begin CHARACTERISTIC XTAB22X4Z_GLBENBL_DBM "" MAP 0x26FC9C _REC_A1MAP_8_s1_s2_u1_S2 1 _CNV_R_R_Umr_1_zu_1_2_CM_S2 0 1 FORMAT "%2.0"
 /begin AXIS_DESCR FIX_AXIS NO_INPUT_QUANTITY _CNV_S_22_Enum_EGLBE_99_CM_S2 22 0 21 /begin FIX_AXIS_PAR_LIST 0 1 2 3 4 5 6 7 8 9 10 11 12 13 14 15 16 17 18 19 20 21 /end FIX_AXIS_PAR_LIST READ_ONLY /end AXIS_DESCR
 /begin AXIS_DESCR FIX_AXIS Z_EXCFKT_DBM _CNV_S_4_Enum_EEXCF_101_CM_S2 4 0 3 /begin FIX_AXIS_PAR_LIST 0 1 2 3 /end FIX_AXIS_PAR_LIST READ_ONLY /end AXIS_DESCR
/end CHARACTERISTIC
/begin CHARACTERISTIC XTAB2N_GE_GANGMAX_MODEW_DBM "" CURVE 0x26FC90 _REC_A1CUR_30_u2_u1_S2 65535 _CNV_R_R_Umr_1_zu_1_2_CM_S2 0 65535
 /begin AXIS_DESCR FIX_AXIS NO_INPUT_QUANTITY _CNV_S_2_Enum_ELOWH_321_CM_S2 2 0 1 FIX_AXIS_PAR_DIST 0 1 2 READ_ONLY /end AXIS_DESCR
/end CHARACTERISTIC
/begin CHARACTERISTIC XTAB2X5ON_T_ARSDYNMAX_DBM "" MAP 0x270328 _REC_S3MAP_54_s2_s2_u1_S2 10000 _CNV_R_R_Umr_1_zu_1_3_CM_S2 0 10000 FORMAT "%2.0"
 /begin AXIS_DESCR STD_AXIS NO_INPUT_QUANTITY _CNV_R_R_Umr_1_zu_1_3_CM_S2 5 -32768 32767 FORMAT "%2.0" /end AXIS_DESCR
 /begin AXIS_DESCR FIX_AXIS Z_AGS_MODBEDEL _CNV_S_2_Enum_EAGS_25_CM_S2 2 0 1 FIX_AXIS_PAR_DIST 0 1 2 READ_ONLY /end AXIS_DESCR
/end CHARACTERISTIC
/begin CHARACTERISTIC XTAB3SCHN_MOTSOLLMAX_DBM "" CURVE 0x2754D8 _REC_S7CUR_53_u2_u2_S2 32000 _CNV_R_R_Umr_1_zu_1_3_CM_S2 0 32000 FORMAT "%2.0"
 /begin AXIS_DESCR STD_AXIS P_LUFT _CNV_R_R_Umr_1_zu_1_0_CM_S2 3 550 1150 FORMAT "%4.2" /end AXIS_DESCR
/end CHARACTERISTIC
/begin CHARACTERISTIC XTAB3X5T_AUSROLLRS_DBM "" MAP 0x2751E0 _REC_S3MAP_54_s2_u2_u1_S2 2500 _CNV_R_R_Umr_1_zu_1_6_CM_S2 0 2500 FORMAT "%2.0"
 /begin AXIS_DESCR STD_AXIS N_T _CNV_R_R_Umr_1_zu_1_3_CM_S2 5 0 65535 FORMAT "%2.0" /end AXIS_DESCR
 /begin AXIS_DESCR FIX_AXIS Z_SCHALTDYN _CNV_S_7_Enum_ESDYN_151_CM_S2 3 0 6 /begin FIX_AXIS_PAR_LIST 0 1 2 /end FIX_AXIS_PAR_LIST READ_ONLY /end AXIS_DESCR
/end CHARACTERISTIC
/begin CHARACTERISTIC XTAB4SCHDM_RFWS_EIN_DBM "" CURVE 0x26FC94 _REC_A1CUR_30_s2_u1_S2 65535 _CNV_R_R_Umr_1_zu_1_42_CM_S2 -32768 32767 FORMAT "%2.0"
 /begin AXIS_DESCR FIX_AXIS Z_AGSMOD_ECO_EFAHREN _CNV_S_4_Enum_EAGS__24_CM_S2 4 0 3 FIX_AXIS_PAR_DIST 0 1 4 READ_ONLY /end AXIS_DESCR
/end CHARACTERISTIC
/begin CHARACTERISTIC XTAB4X2S_EXCFKTFFG_ENBL_DBM "" MAP 0x26FCF4 _REC_A1MAP_8_u1_u1_u1_S2 1 _CNV_R_R_Umr_1_zu_1_2_CM_S2 0 1 FORMAT "%2.0"
 /begin AXIS_DESCR FIX_AXIS Z_EXCFKT_DBM _CNV_S_4_Enum_EEXCF_101_CM_S2 4 0 3 /begin FIX_AXIS_PAR_LIST 0 1 2 3 /end FIX_AXIS_PAR_LIST READ_ONLY /end AXIS_DESCR
 /begin AXIS_DESCR FIX_AXIS NO_INPUT_QUANTITY _CNV_S_2_Enum_PRUEF_319_CM_S2 2 0 1 /begin FIX_AXIS_PAR_LIST 0 1 /end FIX_AXIS_PAR_LIST READ_ONLY /end AXIS_DESCR
/end CHARACTERISTIC
/begin CHARACTERISTIC XTAB4X9N_TMAXERS_MODEW_DBM "" MAP 0x27520A _REC_S3MAP_54_s2_u2_u1_S2 10000 _CNV_R_R_Umr_1_zu_1_3_CM_S2 0 10000 FORMAT "%2.0"
 /begin AXIS_DESCR STD_AXIS W_DKKD _CNV_R_R_Umr_10_zu__9_CM_S2 4 0 120 FORMAT "%3.1" /end AXIS_DESCR
 /begin AXIS_DESCR FIX_AXIS Z_GANG_ZIEL_DBM _CNV_S_9_Enum_EGANG_30_CM_S2 9 0 8 FIX_AXIS_PAR_DIST 0 1 9 READ_ONLY /end AXIS_DESCR
/end CHARACTERISTIC
/begin CHARACTERISTIC XTAB4X9N_TMAXMRS_MODEW_DBM "" MAP 0x27525C _REC_S3MAP_54_s2_u2_u1_S2 10000 _CNV_R_R_Umr_1_zu_1_3_CM_S2 0 10000 FORMAT "%2.0"
 /begin AXIS_DESCR STD_AXIS W_DKKD _CNV_R_R_Umr_10_zu__9_CM_S2 4 0 120 FORMAT "%3.1" /end AXIS_DESCR
 /begin AXIS_DESCR FIX_AXIS Z_GANG_ZIEL_DBM _CNV_S_9_Enum_EGANG_30_CM_S2 9 0 8 FIX_AXIS_PAR_DIST 0 1 9 READ_ONLY /end AXIS_DESCR
/end CHARACTERISTIC
/begin CHARACTERISTIC XTAB4X9SCHN_MAXAKTHOTMODE_DBM "" MAP 0x2752AE _REC_S3MAP_54_s2_s2_u2_S2 32000 _CNV_R_R_Umr_1_zu_1_3_CM_S2 0 32000 FORMAT "%2.0"
 /begin AXIS_DESCR STD_AXIS TEMP_GETR _CNV_R_R_Umr_1_zu_1_1_CM_S2 4 -200 200 MONOTONY MON_INCREASE FORMAT "%2.0" /end AXIS_DESCR
 /begin AXIS_DESCR FIX_AXIS NO_INPUT_QUANTITY _CNV_S_9_Enum_EGANG_30_CM_S2 9 0 8 /begin FIX_AXIS_PAR_LIST 0 1 2 3 4 5 6 7 8 /end FIX_AXIS_PAR_LIST READ_ONLY /end AXIS_DESCR
/end CHARACTERISTIC
/begin CHARACTERISTIC XTAB4X9SCHN_MAXHI_HOTMODE_DBM "" MAP 0x275300 _REC_S3MAP_54_s2_s2_u2_S2 32000 _CNV_R_R_Umr_1_zu_1_3_CM_S2 0 32000 FORMAT "%2.0"
 /begin AXIS_DESCR STD_AXIS TEMP_GETR _CNV_R_R_Umr_1_zu_1_1_CM_S2 4 -200 200 MONOTONY MON_INCREASE FORMAT "%2.0" /end AXIS_DESCR
 /begin AXIS_DESCR FIX_AXIS NO_INPUT_QUANTITY _CNV_S_9_Enum_EGANG_30_CM_S2 9 0 8 /begin FIX_AXIS_PAR_LIST 0 1 2 3 4 5 6 7 8 /end FIX_AXIS_PAR_LIST READ_ONLY /end AXIS_DESCR
/end CHARACTERISTIC
/begin CHARACTERISTIC XTAB4Z_GLBENBL_DBM_LPA "" CURVE 0x27376C _REC_A1CUR_30_u1_u1_S2 255 _CNV_R_R_Umr_1_zu_1_2_CM_S2 0 255
 /begin AXIS_DESCR FIX_AXIS Z_EXCFKT_FFG _CNV_S_4_Enum_EEXCF_101_CM_S2 4 0 3 /begin FIX_AXIS_PAR_LIST 0 1 2 3 /end FIX_AXIS_PAR_LIST READ_ONLY /end AXIS_DESCR
/end CHARACTERISTIC
/begin CHARACTERISTIC XTAB5FAKT_T_AUSROLLRSFWS_DBM "" CURVE 0x2754E6 _REC_S7CUR_53_s2_s2_S2 255 _CNV_R_R_Umr_1_zu_1_53_CM_S2 0 255 FORMAT "%2.0"
 /begin AXIS_DESCR STD_AXIS DM_AB_FWS_FILT_BAB _CNV_R_R_Umr_1_zu_1_42_CM_S2 5 -2500 2500 /end AXIS_DESCR
/end CHARACTERISTIC
/begin CHARACTERISTIC XTAB5SCHM_BR_ARSDYN_AUS_DBM "" CURVE 0x2754FC _REC_S7CUR_53_s2_s2_S2 32768 _CNV_R_R_Umr_1_zu_1_42_CM_S2 -32768 0 FORMAT "%2.0"
 /begin AXIS_DESCR STD_AXIS G2W_AB_FILT _CNV_R_R_Umr_10_zu__181_CM_S2 5 -3276.8 3276.7 FORMAT "%3.1" /end AXIS_DESCR
/end CHARACTERISTIC
/begin CHARACTERISTIC XTAB5SCHM_BR_ARSDYN_EIN_DBM "" CURVE 0x275512 _REC_S7CUR_53_s2_s2_S2 32768 _CNV_R_R_Umr_1_zu_1_42_CM_S2 -32768 0 FORMAT "%2.0"
 /begin AXIS_DESCR STD_AXIS G2W_AB_FILT _CNV_R_R_Umr_10_zu__181_CM_S2 5 -3276.8 3276.7 FORMAT "%3.1" /end AXIS_DESCR
/end CHARACTERISTIC
/begin CHARACTERISTIC XTAB5SCHP_BR_ARSDYN_AUS_DBM "" CURVE 0x275528 _REC_S7CUR_53_u2_s2_S2 32767 _CNV_R_R_Umr_2_zu_1_238_CM_S2 0 32767 FORMAT "%3.1"
 /begin AXIS_DESCR STD_AXIS G2W_AB_FILT _CNV_R_R_Umr_10_zu__181_CM_S2 5 -3276.8 3276.7 FORMAT "%3.1" /end AXIS_DESCR
/end CHARACTERISTIC
/begin CHARACTERISTIC XTAB5SCHP_BR_ARSDYN_EIN_DBM "" CURVE 0x27553E _REC_S7CUR_53_u2_s2_S2 32767 _CNV_R_R_Umr_2_zu_1_238_CM_S2 0 32767 FORMAT "%3.1"
 /begin AXIS_DESCR STD_AXIS G2W_AB_FILT _CNV_R_R_Umr_10_zu__181_CM_S2 5 -3276.8 3276.7 FORMAT "%3.1" /end AXIS_DESCR
/end CHARACTERISTIC
/begin CHARACTERISTIC XTAB5X2SCHM_REKUPRS_DBM "" MAP 0x26FCFC _REC_A1MAP_8_s2_u1_u1_S2 2046 _CNV_R_R_Umr_1_zu_1_42_CM_S2 -1023 1023 FORMAT "%2.0"
 /begin AXIS_DESCR FIX_AXIS NO_INPUT_QUANTITY _CNV_S_2_Enum_REKUP_324_CM_S2 2 0 1 /begin FIX_AXIS_PAR_LIST 0 1 /end FIX_AXIS_PAR_LIST READ_ONLY /end AXIS_DESCR
 /begin AXIS_DESCR FIX_AXIS Z_REKUP_IDX_DBM _CNV_S_5_Enum_REKUP_320_CM_S2 5 0 4 /begin FIX_AXIS_PAR_LIST 0 1 2 3 4 /end FIX_AXIS_PAR_LIST READ_ONLY /end AXIS_DESCR
/end CHARACTERISTIC
/begin CHARACTERISTIC XTAB5X3SCHN_TMIN_CGT_DBM "" MAP 0x275352 _REC_S3MAP_54_s2_s2_u1_S2 10000 _CNV_R_R_Umr_1_zu_1_3_CM_S2 0 10000 FORMAT "%2.0"
 /begin AXIS_DESCR STD_AXIS TEMP_GETR _CNV_R_R_Umr_1_zu_1_1_CM_S2 5 -40 200 FORMAT "%2.0" /end AXIS_DESCR
 /begin AXIS_DESCR FIX_AXIS NO_INPUT_QUANTITY _CNV_S_3_Enum_EIDX0_325_CM_S2 3 0 2 FIX_AXIS_PAR_DIST 0 1 3 READ_ONLY /end AXIS_DESCR
/end CHARACTERISTIC
/begin CHARACTERISTIC XTAB5X3SCHN_TMIN_NMOTSOLL_DBM "" MAP 0x27537C _REC_S3MAP_54_s2_u2_u2_S2 32000 _CNV_R_R_Umr_1_zu_1_3_CM_S2 0 32000 FORMAT "%2.0"
 /begin AXIS_DESCR STD_AXIS N_MOT_SOLLLL _CNV_R_R_Umr_1_zu_1_3_CM_S2 5 0 65535 FORMAT "%2.0" /end AXIS_DESCR
 /begin AXIS_DESCR FIX_AXIS NO_INPUT_QUANTITY _CNV_S_3_Enum_EWL_318_CM_S2 3 0 2 /begin FIX_AXIS_PAR_LIST 0 1 2 /end FIX_AXIS_PAR_LIST READ_ONLY /end AXIS_DESCR
/end CHARACTERISTIC
/begin CHARACTERISTIC XTAB5X4N_TMIN_TUMGPLUFT1_DBM "" MAP 0x270348 _REC_S7MAP_53_s2_s2_u2_S2 10000 _CNV_R_R_Umr_1_zu_1_3_CM_S2 0 10000 FORMAT "%2.0"
 /begin AXIS_DESCR STD_AXIS TEMP_UMG _CNV_R_R_Umr_1_zu_1_1_CM_S2 5 -50 220 FORMAT "%2.0" /end AXIS_DESCR
 /begin AXIS_DESCR STD_AXIS P_LUFT _CNV_R_R_Umr_1_zu_1_0_CM_S2 4 598 1108 FORMAT "%2.0" /end AXIS_DESCR
/end CHARACTERISTIC
/begin CHARACTERISTIC XTAB5X4N_TMIN_TUMGPLUFT2_DBM "" MAP 0x270384 _REC_S7MAP_53_s2_s2_u2_S2 10000 _CNV_R_R_Umr_1_zu_1_3_CM_S2 0 10000 FORMAT "%2.0"
 /begin AXIS_DESCR STD_AXIS TEMP_UMG _CNV_R_R_Umr_1_zu_1_1_CM_S2 5 -50 220 FORMAT "%2.0" /end AXIS_DESCR
 /begin AXIS_DESCR STD_AXIS P_LUFT _CNV_R_R_Umr_1_zu_1_0_CM_S2 4 598 1108 FORMAT "%2.0" /end AXIS_DESCR
/end CHARACTERISTIC
/begin CHARACTERISTIC XTAB5X4N_TMIN_TUMGPLUFT3_DBM "" MAP 0x2703C0 _REC_S7MAP_53_s2_s2_u2_S2 10000 _CNV_R_R_Umr_1_zu_1_3_CM_S2 0 10000 FORMAT "%2.0"
 /begin AXIS_DESCR STD_AXIS TEMP_UMG _CNV_R_R_Umr_1_zu_1_1_CM_S2 5 -50 220 FORMAT "%2.0" /end AXIS_DESCR
 /begin AXIS_DESCR STD_AXIS P_LUFT _CNV_R_R_Umr_1_zu_1_0_CM_S2 4 598 1108 FORMAT "%2.0" /end AXIS_DESCR
/end CHARACTERISTIC
/begin CHARACTERISTIC XTAB5X9ON_T_ARSSTAT_DBM "" MAP 0x2753A6 _REC_S3MAP_54_s2_s2_u2_S2 32000 _CNV_R_R_Umr_1_zu_1_3_CM_S2 0 32000 FORMAT "%2.0"
 /begin AXIS_DESCR STD_AXIS G2W_AB_FILT _CNV_R_R_Umr_10_zu__181_CM_S2 5 -3276.8 3276.7 FORMAT "%3.1" /end AXIS_DESCR
 /begin AXIS_DESCR FIX_AXIS NO_INPUT_QUANTITY _CNV_S_9_Enum_EGANG_30_CM_S2 9 0 8 /begin FIX_AXIS_PAR_LIST 0 1 2 3 4 5 6 7 8 /end FIX_AXIS_PAR_LIST READ_ONLY /end AXIS_DESCR
/end CHARACTERISTIC
/begin CHARACTERISTIC XTAB6X2Z_DYNSPVTUPEL_ECO_DBM "" MAP 0x26FD10 _REC_A1MAP_8_s1_u1_u1_S2 4 _CNV_S_5_Enum_ETUPE_32_CM_S2 0 4
 /begin AXIS_DESCR FIX_AXIS Z_BERGANH _CNV_S_6_Enum_EBERG_61_CM_S2 6 0 5 /begin FIX_AXIS_PAR_LIST 0 1 2 3 4 5 /end FIX_AXIS_PAR_LIST READ_ONLY /end AXIS_DESCR
 /begin AXIS_DESCR FIX_AXIS S_KD _CNV_P_2_A_I_5_CM_S2 2 0 255 /begin FIX_AXIS_PAR_LIST 0 1 /end FIX_AXIS_PAR_LIST READ_ONLY /end AXIS_DESCR
/end CHARACTERISTIC
/begin CHARACTERISTIC XTAB6X2_PRISQ_ZKALDMAAGS_DBM "" MAP 0x26FD1C _REC_A1MAP_8_s1_u2_u1_S2 11 _CNV_R_R_Umr_1_zu_1_2_CM_S2 -1 10 FORMAT "%2.0"
 /begin AXIS_DESCR FIX_AXIS NO_INPUT_QUANTITY _CNV_S_2_Enum_EDBMT_316_CM_S2 2 0 1 /begin FIX_AXIS_PAR_LIST 0 1 /end FIX_AXIS_PAR_LIST READ_ONLY /end AXIS_DESCR
 /begin AXIS_DESCR FIX_AXIS Z_BERGANH _CNV_S_6_Enum_EBERG_61_CM_S2 6 0 5 /begin FIX_AXIS_PAR_LIST 0 1 2 3 4 5 /end FIX_AXIS_PAR_LIST READ_ONLY /end AXIS_DESCR
/end CHARACTERISTIC
/begin CHARACTERISTIC XTAB6X2_PRISQ_ZKALDMECO_DBM "" MAP 0x26FD28 _REC_A1MAP_8_s1_u2_u1_S2 11 _CNV_R_R_Umr_1_zu_1_2_CM_S2 -1 10 FORMAT "%2.0"
 /begin AXIS_DESCR FIX_AXIS NO_INPUT_QUANTITY _CNV_S_2_Enum_EDBMT_316_CM_S2 2 0 1 /begin FIX_AXIS_PAR_LIST 0 1 /end FIX_AXIS_PAR_LIST READ_ONLY /end AXIS_DESCR
 /begin AXIS_DESCR FIX_AXIS Z_BERGANH _CNV_S_6_Enum_EBERG_61_CM_S2 6 0 5 /begin FIX_AXIS_PAR_LIST 0 1 2 3 4 5 /end FIX_AXIS_PAR_LIST READ_ONLY /end AXIS_DESCR
/end CHARACTERISTIC
/begin CHARACTERISTIC XTAB6X2_PRISQ_ZKALDMSAGS_DBM "" MAP 0x26FD34 _REC_A1MAP_8_s1_u2_u1_S2 11 _CNV_R_R_Umr_1_zu_1_2_CM_S2 -1 10 FORMAT "%2.0"
 /begin AXIS_DESCR FIX_AXIS NO_INPUT_QUANTITY _CNV_S_2_Enum_EDBMT_316_CM_S2 2 0 1 /begin FIX_AXIS_PAR_LIST 0 1 /end FIX_AXIS_PAR_LIST READ_ONLY /end AXIS_DESCR
 /begin AXIS_DESCR FIX_AXIS Z_BERGANH _CNV_S_6_Enum_EBERG_61_CM_S2 6 0 5 /begin FIX_AXIS_PAR_LIST 0 1 2 3 4 5 /end FIX_AXIS_PAR_LIST READ_ONLY /end AXIS_DESCR
/end CHARACTERISTIC
/begin CHARACTERISTIC XTAB6X3SCHN_GEMAXAKT_RFWS_10_DBM "" MAP 0x2703FC _REC_S7MAP_53_u2_s2_u2_S2 32000 _CNV_R_R_Umr_1_zu_1_42_CM_S2 0 32000 FORMAT "%2.0"
 /begin AXIS_DESCR STD_AXIS DM_RAD_FWS_FILT _CNV_R_R_Umr_1_zu_1_42_CM_S2 6 0 2500 FORMAT "%2.0" /end AXIS_DESCR
 /begin AXIS_DESCR STD_AXIS W_DKKD_FFG _CNV_R_R_Umr_10_zu__9_CM_S2 3 0 110 FORMAT "%3.1" /end AXIS_DESCR
/end CHARACTERISTIC
/begin CHARACTERISTIC XTAB6X3SCHN_GEMAXAKT_RFWS_11_DBM "" MAP 0x270434 _REC_S7MAP_53_u2_s2_u2_S2 32000 _CNV_R_R_Umr_1_zu_1_42_CM_S2 0 32000 FORMAT "%2.0"
 /begin AXIS_DESCR STD_AXIS DM_RAD_FWS_FILT _CNV_R_R_Umr_1_zu_1_42_CM_S2 6 0 2500 FORMAT "%2.0" /end AXIS_DESCR
 /begin AXIS_DESCR STD_AXIS W_DKKD_FFG _CNV_R_R_Umr_10_zu__9_CM_S2 3 0 110 FORMAT "%3.1" /end AXIS_DESCR
/end CHARACTERISTIC
/begin CHARACTERISTIC XTAB6X3SCHN_GEMAXAKT_RFWS_12_DBM "" MAP 0x27046C _REC_S7MAP_53_u2_s2_u2_S2 32000 _CNV_R_R_Umr_1_zu_1_42_CM_S2 0 32000 FORMAT "%2.0"
 /begin AXIS_DESCR STD_AXIS DM_RAD_FWS_FILT _CNV_R_R_Umr_1_zu_1_42_CM_S2 6 0 2500 FORMAT "%2.0" /end AXIS_DESCR
 /begin AXIS_DESCR STD_AXIS W_DKKD_FFG _CNV_R_R_Umr_10_zu__9_CM_S2 3 0 110 FORMAT "%3.1" /end AXIS_DESCR
/end CHARACTERISTIC
/begin CHARACTERISTIC XTAB6X3SCHN_GEMAXAKT_RFWS_13_DBM "" MAP 0x2704A4 _REC_S7MAP_53_u2_s2_u2_S2 32000 _CNV_R_R_Umr_1_zu_1_42_CM_S2 0 32000 FORMAT "%2.0"
 /begin AXIS_DESCR STD_AXIS DM_RAD_FWS_FILT _CNV_R_R_Umr_1_zu_1_42_CM_S2 6 0 2500 FORMAT "%2.0" /end AXIS_DESCR
 /begin AXIS_DESCR STD_AXIS W_DKKD_FFG _CNV_R_R_Umr_10_zu__9_CM_S2 3 0 110 FORMAT "%3.1" /end AXIS_DESCR
/end CHARACTERISTIC
/begin CHARACTERISTIC XTAB6X3SCHN_GEMAXAKT_RFWS_14_DBM "" MAP 0x2704DC _REC_S7MAP_53_u2_s2_u2_S2 32000 _CNV_R_R_Umr_1_zu_1_42_CM_S2 0 32000 FORMAT "%2.0"
 /begin AXIS_DESCR STD_AXIS DM_RAD_FWS_FILT _CNV_R_R_Umr_1_zu_1_42_CM_S2 6 0 2500 FORMAT "%2.0" /end AXIS_DESCR
 /begin AXIS_DESCR STD_AXIS W_DKKD_FFG _CNV_R_R_Umr_10_zu__9_CM_S2 3 0 110 FORMAT "%3.1" /end AXIS_DESCR
/end CHARACTERISTIC
/begin CHARACTERISTIC XTAB6X3SCHN_GEMAXAKT_RFWS_15_DBM "" MAP 0x270514 _REC_S7MAP_53_u2_s2_u2_S2 32000 _CNV_R_R_Umr_1_zu_1_42_CM_S2 0 32000 FORMAT "%2.0"
 /begin AXIS_DESCR STD_AXIS DM_RAD_FWS_FILT _CNV_R_R_Umr_1_zu_1_42_CM_S2 6 0 2500 FORMAT "%2.0" /end AXIS_DESCR
 /begin AXIS_DESCR STD_AXIS W_DKKD_FFG _CNV_R_R_Umr_10_zu__9_CM_S2 3 0 110 FORMAT "%3.1" /end AXIS_DESCR
/end CHARACTERISTIC
/begin CHARACTERISTIC XTAB6X3SCHN_GEMAXAKT_RFWS_1_DBM "" MAP 0x27054C _REC_S7MAP_53_u2_s2_u2_S2 32000 _CNV_R_R_Umr_1_zu_1_42_CM_S2 0 32000 FORMAT "%2.0"
 /begin AXIS_DESCR STD_AXIS DM_RAD_FWS_FILT _CNV_R_R_Umr_1_zu_1_42_CM_S2 6 0 2500 FORMAT "%2.0" /end AXIS_DESCR
 /begin AXIS_DESCR STD_AXIS W_DKKD_FFG _CNV_R_R_Umr_10_zu__9_CM_S2 3 0 110 FORMAT "%3.1" /end AXIS_DESCR
/end CHARACTERISTIC
/begin CHARACTERISTIC XTAB6X3SCHN_GEMAXAKT_RFWS_2_DBM "" MAP 0x270584 _REC_S7MAP_53_u2_s2_u2_S2 32000 _CNV_R_R_Umr_1_zu_1_42_CM_S2 0 32000 FORMAT "%2.0"
 /begin AXIS_DESCR STD_AXIS DM_RAD_FWS_FILT _CNV_R_R_Umr_1_zu_1_42_CM_S2 6 0 2500 FORMAT "%2.0" /end AXIS_DESCR
 /begin AXIS_DESCR STD_AXIS W_DKKD_FFG _CNV_R_R_Umr_10_zu__9_CM_S2 3 0 110 FORMAT "%3.1" /end AXIS_DESCR
/end CHARACTERISTIC
/begin CHARACTERISTIC XTAB6X3SCHN_GEMAXAKT_RFWS_3_DBM "" MAP 0x2705BC _REC_S7MAP_53_u2_s2_u2_S2 32000 _CNV_R_R_Umr_1_zu_1_42_CM_S2 0 32000 FORMAT "%2.0"
 /begin AXIS_DESCR STD_AXIS DM_RAD_FWS_FILT _CNV_R_R_Umr_1_zu_1_42_CM_S2 6 0 2500 FORMAT "%2.0" /end AXIS_DESCR
 /begin AXIS_DESCR STD_AXIS W_DKKD_FFG _CNV_R_R_Umr_10_zu__9_CM_S2 3 0 110 FORMAT "%3.1" /end AXIS_DESCR
/end CHARACTERISTIC
/begin CHARACTERISTIC XTAB6X3SCHN_GEMAXAKT_RFWS_4_DBM "" MAP 0x2705F4 _REC_S7MAP_53_u2_s2_u2_S2 32000 _CNV_R_R_Umr_1_zu_1_42_CM_S2 0 32000 FORMAT "%2.0"
 /begin AXIS_DESCR STD_AXIS DM_RAD_FWS_FILT _CNV_R_R_Umr_1_zu_1_42_CM_S2 6 0 2500 FORMAT "%2.0" /end AXIS_DESCR
 /begin AXIS_DESCR STD_AXIS W_DKKD_FFG _CNV_R_R_Umr_10_zu__9_CM_S2 3 0 110 FORMAT "%3.1" /end AXIS_DESCR
/end CHARACTERISTIC
/begin CHARACTERISTIC XTAB6X3SCHN_GEMAXAKT_RFWS_5_DBM "" MAP 0x27062C _REC_S7MAP_53_u2_s2_u2_S2 32000 _CNV_R_R_Umr_1_zu_1_42_CM_S2 0 32000 FORMAT "%2.0"
 /begin AXIS_DESCR STD_AXIS DM_RAD_FWS_FILT _CNV_R_R_Umr_1_zu_1_42_CM_S2 6 0 2500 FORMAT "%2.0" /end AXIS_DESCR
 /begin AXIS_DESCR STD_AXIS W_DKKD_FFG _CNV_R_R_Umr_10_zu__9_CM_S2 3 0 110 FORMAT "%3.1" /end AXIS_DESCR
/end CHARACTERISTIC
/begin CHARACTERISTIC XTAB6X3SCHN_GEMAXAKT_RFWS_6_DBM "" MAP 0x270664 _REC_S7MAP_53_u2_s2_u2_S2 32000 _CNV_R_R_Umr_1_zu_1_42_CM_S2 0 32000 FORMAT "%2.0"
 /begin AXIS_DESCR STD_AXIS DM_RAD_FWS_FILT _CNV_R_R_Umr_1_zu_1_42_CM_S2 6 0 2500 FORMAT "%2.0" /end AXIS_DESCR
 /begin AXIS_DESCR STD_AXIS W_DKKD_FFG _CNV_R_R_Umr_10_zu__9_CM_S2 3 0 110 FORMAT "%3.1" /end AXIS_DESCR
/end CHARACTERISTIC
/begin CHARACTERISTIC XTAB6X3SCHN_GEMAXAKT_RFWS_7_DBM "" MAP 0x27069C _REC_S7MAP_53_u2_s2_u2_S2 32000 _CNV_R_R_Umr_1_zu_1_42_CM_S2 0 32000 FORMAT "%2.0"
 /begin AXIS_DESCR STD_AXIS DM_RAD_FWS_FILT _CNV_R_R_Umr_1_zu_1_42_CM_S2 6 0 2500 FORMAT "%2.0" /end AXIS_DESCR
 /begin AXIS_DESCR STD_AXIS W_DKKD_FFG _CNV_R_R_Umr_10_zu__9_CM_S2 3 0 110 FORMAT "%3.1" /end AXIS_DESCR
/end CHARACTERISTIC
/begin CHARACTERISTIC XTAB6X3SCHN_GEMAXAKT_RFWS_8_DBM "" MAP 0x2706D4 _REC_S7MAP_53_u2_s2_u2_S2 32000 _CNV_R_R_Umr_1_zu_1_42_CM_S2 0 32000 FORMAT "%2.0"
 /begin AXIS_DESCR STD_AXIS DM_RAD_FWS_FILT _CNV_R_R_Umr_1_zu_1_42_CM_S2 6 0 2500 FORMAT "%2.0" /end AXIS_DESCR
 /begin AXIS_DESCR STD_AXIS W_DKKD_FFG _CNV_R_R_Umr_10_zu__9_CM_S2 3 0 110 FORMAT "%3.1" /end AXIS_DESCR
/end CHARACTERISTIC
/begin CHARACTERISTIC XTAB6X3SCHN_GEMAXAKT_RFWS_9_DBM "" MAP 0x27070C _REC_S7MAP_53_u2_s2_u2_S2 32000 _CNV_R_R_Umr_1_zu_1_42_CM_S2 0 32000 FORMAT "%2.0"
 /begin AXIS_DESCR STD_AXIS DM_RAD_FWS_FILT _CNV_R_R_Umr_1_zu_1_42_CM_S2 6 0 2500 FORMAT "%2.0" /end AXIS_DESCR
 /begin AXIS_DESCR STD_AXIS W_DKKD_FFG _CNV_R_R_Umr_10_zu__9_CM_S2 3 0 110 FORMAT "%3.1" /end AXIS_DESCR
/end CHARACTERISTIC
/begin CHARACTERISTIC XTAB6X3SCHN_GEMINAKT_RFWS_10_DBM "" MAP 0x270744 _REC_S7MAP_53_u2_s2_u2_S2 10000 _CNV_R_R_Umr_1_zu_1_42_CM_S2 0 10000 FORMAT "%2.0"
 /begin AXIS_DESCR STD_AXIS DM_RAD_FWS_FILT _CNV_R_R_Umr_1_zu_1_42_CM_S2 6 0 2500 FORMAT "%2.0" /end AXIS_DESCR
 /begin AXIS_DESCR STD_AXIS W_DKKD_FFG _CNV_R_R_Umr_10_zu__9_CM_S2 3 0 110 FORMAT "%3.1" /end AXIS_DESCR
/end CHARACTERISTIC
/begin CHARACTERISTIC XTAB6X3SCHN_GEMINAKT_RFWS_11_DBM "" MAP 0x27077C _REC_S7MAP_53_u2_s2_u2_S2 10000 _CNV_R_R_Umr_1_zu_1_42_CM_S2 0 10000 FORMAT "%2.0"
 /begin AXIS_DESCR STD_AXIS DM_RAD_FWS_FILT _CNV_R_R_Umr_1_zu_1_42_CM_S2 6 0 2500 FORMAT "%2.0" /end AXIS_DESCR
 /begin AXIS_DESCR STD_AXIS W_DKKD_FFG _CNV_R_R_Umr_10_zu__9_CM_S2 3 0 110 FORMAT "%3.1" /end AXIS_DESCR
/end CHARACTERISTIC
/begin CHARACTERISTIC XTAB6X3SCHN_GEMINAKT_RFWS_12_DBM "" MAP 0x2707B4 _REC_S7MAP_53_u2_s2_u2_S2 10000 _CNV_R_R_Umr_1_zu_1_42_CM_S2 0 10000 FORMAT "%2.0"
 /begin AXIS_DESCR STD_AXIS DM_RAD_FWS_FILT _CNV_R_R_Umr_1_zu_1_42_CM_S2 6 0 2500 FORMAT "%2.0" /end AXIS_DESCR
 /begin AXIS_DESCR STD_AXIS W_DKKD_FFG _CNV_R_R_Umr_10_zu__9_CM_S2 3 0 110 FORMAT "%3.1" /end AXIS_DESCR
/end CHARACTERISTIC
/begin CHARACTERISTIC XTAB6X3SCHN_GEMINAKT_RFWS_13_DBM "" MAP 0x2707EC _REC_S7MAP_53_u2_s2_u2_S2 10000 _CNV_R_R_Umr_1_zu_1_42_CM_S2 0 10000 FORMAT "%2.0"
 /begin AXIS_DESCR STD_AXIS DM_RAD_FWS_FILT _CNV_R_R_Umr_1_zu_1_42_CM_S2 6 0 2500 FORMAT "%2.0" /end AXIS_DESCR
 /begin AXIS_DESCR STD_AXIS W_DKKD_FFG _CNV_R_R_Umr_10_zu__9_CM_S2 3 0 110 FORMAT "%3.1" /end AXIS_DESCR
/end CHARACTERISTIC
/begin CHARACTERISTIC XTAB6X3SCHN_GEMINAKT_RFWS_14_DBM "" MAP 0x270824 _REC_S7MAP_53_u2_s2_u2_S2 10000 _CNV_R_R_Umr_1_zu_1_42_CM_S2 0 10000 FORMAT "%2.0"
 /begin AXIS_DESCR STD_AXIS DM_RAD_FWS_FILT _CNV_R_R_Umr_1_zu_1_42_CM_S2 6 0 2500 FORMAT "%2.0" /end AXIS_DESCR
 /begin AXIS_DESCR STD_AXIS W_DKKD_FFG _CNV_R_R_Umr_10_zu__9_CM_S2 3 0 110 FORMAT "%3.1" /end AXIS_DESCR
/end CHARACTERISTIC
/begin CHARACTERISTIC XTAB6X3SCHN_GEMINAKT_RFWS_15_DBM "" MAP 0x27085C _REC_S7MAP_53_u2_s2_u2_S2 10000 _CNV_R_R_Umr_1_zu_1_42_CM_S2 0 10000 FORMAT "%2.0"
 /begin AXIS_DESCR STD_AXIS DM_RAD_FWS_FILT _CNV_R_R_Umr_1_zu_1_42_CM_S2 6 0 2500 FORMAT "%2.0" /end AXIS_DESCR
 /begin AXIS_DESCR STD_AXIS W_DKKD_FFG _CNV_R_R_Umr_10_zu__9_CM_S2 3 0 110 FORMAT "%3.1" /end AXIS_DESCR
/end CHARACTERISTIC
/begin CHARACTERISTIC XTAB6X3SCHN_GEMINAKT_RFWS_1_DBM "" MAP 0x270894 _REC_S7MAP_53_u2_s2_u2_S2 10000 _CNV_R_R_Umr_1_zu_1_42_CM_S2 0 10000 FORMAT "%2.0"
 /begin AXIS_DESCR STD_AXIS DM_RAD_FWS_FILT _CNV_R_R_Umr_1_zu_1_42_CM_S2 6 0 2500 FORMAT "%2.0" /end AXIS_DESCR
 /begin AXIS_DESCR STD_AXIS W_DKKD_FFG _CNV_R_R_Umr_10_zu__9_CM_S2 3 0 110 FORMAT "%3.1" /end AXIS_DESCR
/end CHARACTERISTIC
/begin CHARACTERISTIC XTAB6X3SCHN_GEMINAKT_RFWS_2_DBM "" MAP 0x2708CC _REC_S7MAP_53_u2_s2_u2_S2 10000 _CNV_R_R_Umr_1_zu_1_42_CM_S2 0 10000 FORMAT "%2.0"
 /begin AXIS_DESCR STD_AXIS DM_RAD_FWS_FILT _CNV_R_R_Umr_1_zu_1_42_CM_S2 6 0 2500 FORMAT "%2.0" /end AXIS_DESCR
 /begin AXIS_DESCR STD_AXIS W_DKKD_FFG _CNV_R_R_Umr_10_zu__9_CM_S2 3 0 110 FORMAT "%3.1" /end AXIS_DESCR
/end CHARACTERISTIC
/begin CHARACTERISTIC XTAB6X3SCHN_GEMINAKT_RFWS_3_DBM "" MAP 0x270904 _REC_S7MAP_53_u2_s2_u2_S2 10000 _CNV_R_R_Umr_1_zu_1_42_CM_S2 0 10000 FORMAT "%2.0"
 /begin AXIS_DESCR STD_AXIS DM_RAD_FWS_FILT _CNV_R_R_Umr_1_zu_1_42_CM_S2 6 0 2500 FORMAT "%2.0" /end AXIS_DESCR
 /begin AXIS_DESCR STD_AXIS W_DKKD_FFG _CNV_R_R_Umr_10_zu__9_CM_S2 3 0 110 FORMAT "%3.1" /end AXIS_DESCR
/end CHARACTERISTIC
/begin CHARACTERISTIC XTAB6X3SCHN_GEMINAKT_RFWS_4_DBM "" MAP 0x27093C _REC_S7MAP_53_u2_s2_u2_S2 10000 _CNV_R_R_Umr_1_zu_1_42_CM_S2 0 10000 FORMAT "%2.0"
 /begin AXIS_DESCR STD_AXIS DM_RAD_FWS_FILT _CNV_R_R_Umr_1_zu_1_42_CM_S2 6 0 2500 FORMAT "%2.0" /end AXIS_DESCR
 /begin AXIS_DESCR STD_AXIS W_DKKD_FFG _CNV_R_R_Umr_10_zu__9_CM_S2 3 0 110 FORMAT "%3.1" /end AXIS_DESCR
/end CHARACTERISTIC
/begin CHARACTERISTIC XTAB6X3SCHN_GEMINAKT_RFWS_5_DBM "" MAP 0x270974 _REC_S7MAP_53_u2_s2_u2_S2 10000 _CNV_R_R_Umr_1_zu_1_42_CM_S2 0 10000 FORMAT "%2.0"
 /begin AXIS_DESCR STD_AXIS DM_RAD_FWS_FILT _CNV_R_R_Umr_1_zu_1_42_CM_S2 6 0 2500 FORMAT "%2.0" /end AXIS_DESCR
 /begin AXIS_DESCR STD_AXIS W_DKKD_FFG _CNV_R_R_Umr_10_zu__9_CM_S2 3 0 110 FORMAT "%3.1" /end AXIS_DESCR
/end CHARACTERISTIC
/begin CHARACTERISTIC XTAB6X3SCHN_GEMINAKT_RFWS_6_DBM "" MAP 0x2709AC _REC_S7MAP_53_u2_s2_u2_S2 10000 _CNV_R_R_Umr_1_zu_1_42_CM_S2 0 10000 FORMAT "%2.0"
 /begin AXIS_DESCR STD_AXIS DM_RAD_FWS_FILT _CNV_R_R_Umr_1_zu_1_42_CM_S2 6 0 2500 FORMAT "%2.0" /end AXIS_DESCR
 /begin AXIS_DESCR STD_AXIS W_DKKD_FFG _CNV_R_R_Umr_10_zu__9_CM_S2 3 0 110 FORMAT "%3.1" /end AXIS_DESCR
/end CHARACTERISTIC
/begin CHARACTERISTIC XTAB6X3SCHN_GEMINAKT_RFWS_7_DBM "" MAP 0x2709E4 _REC_S7MAP_53_u2_s2_u2_S2 10000 _CNV_R_R_Umr_1_zu_1_42_CM_S2 0 10000 FORMAT "%2.0"
 /begin AXIS_DESCR STD_AXIS DM_RAD_FWS_FILT _CNV_R_R_Umr_1_zu_1_42_CM_S2 6 0 2500 FORMAT "%2.0" /end AXIS_DESCR
 /begin AXIS_DESCR STD_AXIS W_DKKD_FFG _CNV_R_R_Umr_10_zu__9_CM_S2 3 0 110 FORMAT "%3.1" /end AXIS_DESCR
/end CHARACTERISTIC
/begin CHARACTERISTIC XTAB6X3SCHN_GEMINAKT_RFWS_8_DBM "" MAP 0x270A1C _REC_S7MAP_53_u2_s2_u2_S2 10000 _CNV_R_R_Umr_1_zu_1_42_CM_S2 0 10000 FORMAT "%2.0"
 /begin AXIS_DESCR STD_AXIS DM_RAD_FWS_FILT _CNV_R_R_Umr_1_zu_1_42_CM_S2 6 0 2500 FORMAT "%2.0" /end AXIS_DESCR
 /begin AXIS_DESCR STD_AXIS W_DKKD_FFG _CNV_R_R_Umr_10_zu__9_CM_S2 3 0 110 FORMAT "%3.1" /end AXIS_DESCR
/end CHARACTERISTIC
/begin CHARACTERISTIC XTAB6X3SCHN_GEMINAKT_RFWS_9_DBM "" MAP 0x270A54 _REC_S7MAP_53_u2_s2_u2_S2 10000 _CNV_R_R_Umr_1_zu_1_42_CM_S2 0 10000 FORMAT "%2.0"
 /begin AXIS_DESCR STD_AXIS DM_RAD_FWS_FILT _CNV_R_R_Umr_1_zu_1_42_CM_S2 6 0 2500 FORMAT "%2.0" /end AXIS_DESCR
 /begin AXIS_DESCR STD_AXIS W_DKKD_FFG _CNV_R_R_Umr_10_zu__9_CM_S2 3 0 110 FORMAT "%3.1" /end AXIS_DESCR
/end CHARACTERISTIC
/begin CHARACTERISTIC XTAB6X3SCHN_GEMINLO_RFWS_10_DBM "" MAP 0x270A8C _REC_S7MAP_53_u2_s2_u2_S2 10000 _CNV_R_R_Umr_1_zu_1_42_CM_S2 0 10000 FORMAT "%2.0"
 /begin AXIS_DESCR STD_AXIS DM_RAD_FWS_FILT _CNV_R_R_Umr_1_zu_1_42_CM_S2 6 0 2500 FORMAT "%2.0" /end AXIS_DESCR
 /begin AXIS_DESCR STD_AXIS W_DKKD_FFG _CNV_R_R_Umr_10_zu__9_CM_S2 3 0 110 FORMAT "%3.1" /end AXIS_DESCR
/end CHARACTERISTIC
/begin CHARACTERISTIC XTAB6X3SCHN_GEMINLO_RFWS_11_DBM "" MAP 0x270AC4 _REC_S7MAP_53_u2_s2_u2_S2 10000 _CNV_R_R_Umr_1_zu_1_42_CM_S2 0 10000 FORMAT "%2.0"
 /begin AXIS_DESCR STD_AXIS DM_RAD_FWS_FILT _CNV_R_R_Umr_1_zu_1_42_CM_S2 6 0 2500 FORMAT "%2.0" /end AXIS_DESCR
 /begin AXIS_DESCR STD_AXIS W_DKKD_FFG _CNV_R_R_Umr_10_zu__9_CM_S2 3 0 110 FORMAT "%3.1" /end AXIS_DESCR
/end CHARACTERISTIC
/begin CHARACTERISTIC XTAB6X3SCHN_GEMINLO_RFWS_12_DBM "" MAP 0x270AFC _REC_S7MAP_53_u2_s2_u2_S2 10000 _CNV_R_R_Umr_1_zu_1_42_CM_S2 0 10000 FORMAT "%2.0"
 /begin AXIS_DESCR STD_AXIS DM_RAD_FWS_FILT _CNV_R_R_Umr_1_zu_1_42_CM_S2 6 0 2500 FORMAT "%2.0" /end AXIS_DESCR
 /begin AXIS_DESCR STD_AXIS W_DKKD_FFG _CNV_R_R_Umr_10_zu__9_CM_S2 3 0 110 FORMAT "%3.1" /end AXIS_DESCR
/end CHARACTERISTIC
/begin CHARACTERISTIC XTAB6X3SCHN_GEMINLO_RFWS_13_DBM "" MAP 0x270B34 _REC_S7MAP_53_u2_s2_u2_S2 10000 _CNV_R_R_Umr_1_zu_1_42_CM_S2 0 10000 FORMAT "%2.0"
 /begin AXIS_DESCR STD_AXIS DM_RAD_FWS_FILT _CNV_R_R_Umr_1_zu_1_42_CM_S2 6 0 2500 FORMAT "%2.0" /end AXIS_DESCR
 /begin AXIS_DESCR STD_AXIS W_DKKD_FFG _CNV_R_R_Umr_10_zu__9_CM_S2 3 0 110 FORMAT "%3.1" /end AXIS_DESCR
/end CHARACTERISTIC
/begin CHARACTERISTIC XTAB6X3SCHN_GEMINLO_RFWS_14_DBM "" MAP 0x270B6C _REC_S7MAP_53_u2_s2_u2_S2 10000 _CNV_R_R_Umr_1_zu_1_42_CM_S2 0 10000 FORMAT "%2.0"
 /begin AXIS_DESCR STD_AXIS DM_RAD_FWS_FILT _CNV_R_R_Umr_1_zu_1_42_CM_S2 6 0 2500 FORMAT "%2.0" /end AXIS_DESCR
 /begin AXIS_DESCR STD_AXIS W_DKKD_FFG _CNV_R_R_Umr_10_zu__9_CM_S2 3 0 110 FORMAT "%3.1" /end AXIS_DESCR
/end CHARACTERISTIC
/begin CHARACTERISTIC XTAB6X3SCHN_GEMINLO_RFWS_15_DBM "" MAP 0x270BA4 _REC_S7MAP_53_u2_s2_u2_S2 10000 _CNV_R_R_Umr_1_zu_1_42_CM_S2 0 10000 FORMAT "%2.0"
 /begin AXIS_DESCR STD_AXIS DM_RAD_FWS_FILT _CNV_R_R_Umr_1_zu_1_42_CM_S2 6 0 2500 FORMAT "%2.0" /end AXIS_DESCR
 /begin AXIS_DESCR STD_AXIS W_DKKD_FFG _CNV_R_R_Umr_10_zu__9_CM_S2 3 0 110 FORMAT "%3.1" /end AXIS_DESCR
/end CHARACTERISTIC
/begin CHARACTERISTIC XTAB6X3SCHN_GEMINLO_RFWS_1_DBM "" MAP 0x270BDC _REC_S7MAP_53_u2_s2_u2_S2 10000 _CNV_R_R_Umr_1_zu_1_42_CM_S2 0 10000 FORMAT "%2.0"
 /begin AXIS_DESCR STD_AXIS DM_RAD_FWS_FILT _CNV_R_R_Umr_1_zu_1_42_CM_S2 6 0 2500 FORMAT "%2.0" /end AXIS_DESCR
 /begin AXIS_DESCR STD_AXIS W_DKKD_FFG _CNV_R_R_Umr_10_zu__9_CM_S2 3 0 110 FORMAT "%3.1" /end AXIS_DESCR
/end CHARACTERISTIC
/begin CHARACTERISTIC XTAB6X3SCHN_GEMINLO_RFWS_2_DBM "" MAP 0x270C14 _REC_S7MAP_53_u2_s2_u2_S2 10000 _CNV_R_R_Umr_1_zu_1_42_CM_S2 0 10000 FORMAT "%2.0"
 /begin AXIS_DESCR STD_AXIS DM_RAD_FWS_FILT _CNV_R_R_Umr_1_zu_1_42_CM_S2 6 0 2500 FORMAT "%2.0" /end AXIS_DESCR
 /begin AXIS_DESCR STD_AXIS W_DKKD_FFG _CNV_R_R_Umr_10_zu__9_CM_S2 3 0 110 FORMAT "%3.1" /end AXIS_DESCR
/end CHARACTERISTIC
/begin CHARACTERISTIC XTAB6X3SCHN_GEMINLO_RFWS_3_DBM "" MAP 0x270C4C _REC_S7MAP_53_u2_s2_u2_S2 10000 _CNV_R_R_Umr_1_zu_1_42_CM_S2 0 10000 FORMAT "%2.0"
 /begin AXIS_DESCR STD_AXIS DM_RAD_FWS_FILT _CNV_R_R_Umr_1_zu_1_42_CM_S2 6 0 2500 FORMAT "%2.0" /end AXIS_DESCR
 /begin AXIS_DESCR STD_AXIS W_DKKD_FFG _CNV_R_R_Umr_10_zu__9_CM_S2 3 0 110 FORMAT "%3.1" /end AXIS_DESCR
/end CHARACTERISTIC
/begin CHARACTERISTIC XTAB6X3SCHN_GEMINLO_RFWS_4_DBM "" MAP 0x270C84 _REC_S7MAP_53_u2_s2_u2_S2 10000 _CNV_R_R_Umr_1_zu_1_42_CM_S2 0 10000 FORMAT "%2.0"
 /begin AXIS_DESCR STD_AXIS DM_RAD_FWS_FILT _CNV_R_R_Umr_1_zu_1_42_CM_S2 6 0 2500 FORMAT "%2.0" /end AXIS_DESCR
 /begin AXIS_DESCR STD_AXIS W_DKKD_FFG _CNV_R_R_Umr_10_zu__9_CM_S2 3 0 110 FORMAT "%3.1" /end AXIS_DESCR
/end CHARACTERISTIC
/begin CHARACTERISTIC XTAB6X3SCHN_GEMINLO_RFWS_5_DBM "" MAP 0x270CBC _REC_S7MAP_53_u2_s2_u2_S2 10000 _CNV_R_R_Umr_1_zu_1_42_CM_S2 0 10000 FORMAT "%2.0"
 /begin AXIS_DESCR STD_AXIS DM_RAD_FWS_FILT _CNV_R_R_Umr_1_zu_1_42_CM_S2 6 0 2500 FORMAT "%2.0" /end AXIS_DESCR
 /begin AXIS_DESCR STD_AXIS W_DKKD_FFG _CNV_R_R_Umr_10_zu__9_CM_S2 3 0 110 FORMAT "%3.1" /end AXIS_DESCR
/end CHARACTERISTIC
/begin CHARACTERISTIC XTAB6X3SCHN_GEMINLO_RFWS_6_DBM "" MAP 0x270CF4 _REC_S7MAP_53_u2_s2_u2_S2 10000 _CNV_R_R_Umr_1_zu_1_42_CM_S2 0 10000 FORMAT "%2.0"
 /begin AXIS_DESCR STD_AXIS DM_RAD_FWS_FILT _CNV_R_R_Umr_1_zu_1_42_CM_S2 6 0 2500 FORMAT "%2.0" /end AXIS_DESCR
 /begin AXIS_DESCR STD_AXIS W_DKKD_FFG _CNV_R_R_Umr_10_zu__9_CM_S2 3 0 110 FORMAT "%3.1" /end AXIS_DESCR
/end CHARACTERISTIC
/begin CHARACTERISTIC XTAB6X3SCHN_GEMINLO_RFWS_7_DBM "" MAP 0x270D2C _REC_S7MAP_53_u2_s2_u2_S2 10000 _CNV_R_R_Umr_1_zu_1_42_CM_S2 0 10000 FORMAT "%2.0"
 /begin AXIS_DESCR STD_AXIS DM_RAD_FWS_FILT _CNV_R_R_Umr_1_zu_1_42_CM_S2 6 0 2500 FORMAT "%2.0" /end AXIS_DESCR
 /begin AXIS_DESCR STD_AXIS W_DKKD_FFG _CNV_R_R_Umr_10_zu__9_CM_S2 3 0 110 FORMAT "%3.1" /end AXIS_DESCR
/end CHARACTERISTIC
/begin CHARACTERISTIC XTAB6X3SCHN_GEMINLO_RFWS_8_DBM "" MAP 0x270D64 _REC_S7MAP_53_u2_s2_u2_S2 10000 _CNV_R_R_Umr_1_zu_1_42_CM_S2 0 10000 FORMAT "%2.0"
 /begin AXIS_DESCR STD_AXIS DM_RAD_FWS_FILT _CNV_R_R_Umr_1_zu_1_42_CM_S2 6 0 2500 FORMAT "%2.0" /end AXIS_DESCR
 /begin AXIS_DESCR STD_AXIS W_DKKD_FFG _CNV_R_R_Umr_10_zu__9_CM_S2 3 0 110 FORMAT "%3.1" /end AXIS_DESCR
/end CHARACTERISTIC
/begin CHARACTERISTIC XTAB6X3SCHN_GEMINLO_RFWS_9_DBM "" MAP 0x270D9C _REC_S7MAP_53_u2_s2_u2_S2 10000 _CNV_R_R_Umr_1_zu_1_42_CM_S2 0 10000 FORMAT "%2.0"
 /begin AXIS_DESCR STD_AXIS DM_RAD_FWS_FILT _CNV_R_R_Umr_1_zu_1_42_CM_S2 6 0 2500 FORMAT "%2.0" /end AXIS_DESCR
 /begin AXIS_DESCR STD_AXIS W_DKKD_FFG _CNV_R_R_Umr_10_zu__9_CM_S2 3 0 110 FORMAT "%3.1" /end AXIS_DESCR
/end CHARACTERISTIC
/begin CHARACTERISTIC XTAB6Z_K0_BAUTSCHUTZ_DBM "" CURVE 0x274F88 _REC_A1CUR_30_u1_u1_S2 255 _CNV_R_R_Umr_1_zu_1_2_CM_S2 0 255
 /begin AXIS_DESCR FIX_AXIS Z_K0_IST _CNV_S_6_Enum_EK0_280_CM_S2 6 0 5 FIX_AXIS_PAR_DIST 0 1 6 READ_ONLY /end AXIS_DESCR
/end CHARACTERISTIC
/begin CHARACTERISTIC XTAB9FAKT_KOR_HSZEIT_MODWHYB "" CURVE 0x274F8E _REC_A1CUR_30_s2_u1_S2 1000 _CNV_R_R_Umr_1_zu_1_53_CM_S2 0 1000 FORMAT "%2.0"
 /begin AXIS_DESCR FIX_AXIS Z_GANG_ZIEL _CNV_S_9_Enum_EGANG_30_CM_S2 9 0 8 FIX_AXIS_PAR_DIST 0 1 9 READ_ONLY /end AXIS_DESCR
/end CHARACTERISTIC
/begin CHARACTERISTIC XTAB9FAKT_T_AUSROLLRS_DBM "" CURVE 0x274FA0 _REC_A1CUR_30_s2_u2_S2 500 _CNV_R_R_Umr_1_zu_1_53_CM_S2 0 500 FORMAT "%2.0"
 /begin AXIS_DESCR FIX_AXIS NO_INPUT_QUANTITY _CNV_S_9_Enum_EGANG_30_CM_S2 9 0 8 /begin FIX_AXIS_PAR_LIST 0 1 2 3 4 5 6 7 8 /end FIX_AXIS_PAR_LIST READ_ONLY /end AXIS_DESCR
/end CHARACTERISTIC
/begin CHARACTERISTIC XTAB9FN_SCHNGE_DSPORT_RFWS "" CURVE 0x274FB2 _REC_A1CUR_30_s2_u1_S2 2.5 _CNV_R_R_Umr_100_zu_54_CM_S2 0 2.5 FORMAT "%4.2"
 /begin AXIS_DESCR FIX_AXIS Z_GANG_ZIEL _CNV_S_9_Enum_EGANG_30_CM_S2 9 0 8 FIX_AXIS_PAR_DIST 0 1 9 READ_ONLY /end AXIS_DESCR
/end CHARACTERISTIC
/begin CHARACTERISTIC XTAB9HN_GE_MAXHI_DBM "" CURVE 0x274FC4 _REC_A1CUR_30_s2_u2_S2 32767 _CNV_R_R_Umr_1_zu_1_3_CM_S2 0 32767 FORMAT "%2.0"
 /begin AXIS_DESCR FIX_AXIS NO_INPUT_QUANTITY _CNV_S_9_Enum_EGANG_30_CM_S2 9 0 8 /begin FIX_AXIS_PAR_LIST 0 1 2 3 4 5 6 7 8 /end FIX_AXIS_PAR_LIST READ_ONLY /end AXIS_DESCR
/end CHARACTERISTIC
/begin CHARACTERISTIC XTAB9HN_T_TUMGPLUFT_DBM "" CURVE 0x274FD6 _REC_A1CUR_30_s2_u2_S2 32000 _CNV_R_R_Umr_1_zu_1_3_CM_S2 0 32000 FORMAT "%2.0"
 /begin AXIS_DESCR FIX_AXIS NO_INPUT_QUANTITY _CNV_S_9_Enum_EGANG_30_CM_S2 9 0 8 /begin FIX_AXIS_PAR_LIST 0 1 2 3 4 5 6 7 8 /end FIX_AXIS_PAR_LIST READ_ONLY /end AXIS_DESCR
/end CHARACTERISTIC
/begin CHARACTERISTIC XTAB9HSCHN_GEMAXHI_RFWS_DBM "" CURVE 0x274FE8 _REC_A1CUR_30_u2_u2_S2 10000 _CNV_R_R_Umr_1_zu_1_42_CM_S2 0 10000 FORMAT "%2.0"
 /begin AXIS_DESCR FIX_AXIS NO_INPUT_QUANTITY _CNV_S_9_Enum_EGANG_30_CM_S2 9 0 8 /begin FIX_AXIS_PAR_LIST 0 1 2 3 4 5 6 7 8 /end FIX_AXIS_PAR_LIST READ_ONLY /end AXIS_DESCR
/end CHARACTERISTIC
/begin CHARACTERISTIC XTAB9HSCHN_T_CGT_DBM "" CURVE 0x274FFA _REC_A1CUR_30_s2_u2_S2 10000 _CNV_R_R_Umr_1_zu_1_3_CM_S2 0 10000 FORMAT "%2.0"
 /begin AXIS_DESCR FIX_AXIS NO_INPUT_QUANTITY _CNV_S_9_Enum_EGANG_30_CM_S2 9 0 8 /begin FIX_AXIS_PAR_LIST 0 1 2 3 4 5 6 7 8 /end FIX_AXIS_PAR_LIST READ_ONLY /end AXIS_DESCR
/end CHARACTERISTIC
/begin CHARACTERISTIC XTAB9H_NAB_STABI_DBM "" CURVE 0x27500C _REC_A1CUR_30_s2_u2_S2 500 _CNV_R_R_Umr_1_zu_1_3_CM_S2 0 500 FORMAT "%2.0"
 /begin AXIS_DESCR FIX_AXIS NO_INPUT_QUANTITY _CNV_S_9_Enum_EGANG_30_CM_S2 9 0 8 /begin FIX_AXIS_PAR_LIST 0 1 2 3 4 5 6 7 8 /end FIX_AXIS_PAR_LIST READ_ONLY /end AXIS_DESCR
/end CHARACTERISTIC
/begin CHARACTERISTIC XTAB9ON_MAXHI_DBM "" CURVE 0x27501E _REC_A1CUR_30_s2_u2_S2 32000 _CNV_R_R_Umr_1_zu_1_3_CM_S2 -32000 0 FORMAT "%2.0"
 /begin AXIS_DESCR FIX_AXIS NO_INPUT_QUANTITY _CNV_S_9_Enum_EGANG_30_CM_S2 9 0 8 /begin FIX_AXIS_PAR_LIST 0 1 2 3 4 5 6 7 8 /end FIX_AXIS_PAR_LIST READ_ONLY /end AXIS_DESCR
/end CHARACTERISTIC
/begin CHARACTERISTIC XTAB9SCHFAKT_M_RAD_NMOTHS "" CURVE 0x275030 _REC_A1CUR_30_s2_u2_S2 250 _CNV_R_R_Umr_1_zu_1_53_CM_S2 0 250 FORMAT "%2.0"
 /begin AXIS_DESCR FIX_AXIS NO_INPUT_QUANTITY _CNV_S_9_Enum_EGANG_30_CM_S2 9 0 8 /begin FIX_AXIS_PAR_LIST 0 1 2 3 4 5 6 7 8 /end FIX_AXIS_PAR_LIST READ_ONLY /end AXIS_DESCR
/end CHARACTERISTIC
/begin CHARACTERISTIC XTAB9SCHN_ABMINAKT_DSPORT_DBM "" CURVE 0x275042 _REC_A1CUR_30_s2_u2_S2 32000 _CNV_R_R_Umr_1_zu_1_3_CM_S2 0 32000 FORMAT "%2.0"
 /begin AXIS_DESCR FIX_AXIS NO_INPUT_QUANTITY _CNV_S_9_Enum_EGANG_30_CM_S2 9 0 8 /begin FIX_AXIS_PAR_LIST 0 1 2 3 4 5 6 7 8 /end FIX_AXIS_PAR_LIST READ_ONLY /end AXIS_DESCR
/end CHARACTERISTIC
/begin CHARACTERISTIC XTAB9SCHN_ABMINAKT_LPA_DBM "" CURVE 0x275554 _REC_A1CUR_30_s2_u2_S2 32000 _CNV_R_R_Umr_1_zu_1_3_CM_S2 0 32000 FORMAT "%2.0"
 /begin AXIS_DESCR FIX_AXIS NO_INPUT_QUANTITY _CNV_S_9_Enum_EGANG_30_CM_S2 9 0 8 /begin FIX_AXIS_PAR_LIST 0 1 2 3 4 5 6 7 8 /end FIX_AXIS_PAR_LIST READ_ONLY /end AXIS_DESCR
/end CHARACTERISTIC
/begin CHARACTERISTIC XTAB9SCHN_ABMINLO_DSPORT_DBM "" CURVE 0x275054 _REC_A1CUR_30_s2_u2_S2 32000 _CNV_R_R_Umr_1_zu_1_3_CM_S2 0 32000 FORMAT "%2.0"
 /begin AXIS_DESCR FIX_AXIS NO_INPUT_QUANTITY _CNV_S_9_Enum_EGANG_30_CM_S2 9 0 8 /begin FIX_AXIS_PAR_LIST 0 1 2 3 4 5 6 7 8 /end FIX_AXIS_PAR_LIST READ_ONLY /end AXIS_DESCR
/end CHARACTERISTIC
/begin AXIS_PTS SSTTAB_MRADOPTS_GANG1 "" 0x27A9E6 N_AB _REC_A2AXS_31_u2_S2 65535 _CNV_R_R_Umr_1_zu_1_3_CM_S2 10 0 65535 /end AXIS_PTS
/begin AXIS_PTS SSTTAB_MRADOPTS_GANG2 "" 0x27A9FC N_AB _REC_A2AXS_31_u2_S2 65535 _CNV_R_R_Umr_1_zu_1_3_CM_S2 10 0 65535 /end AXIS_PTS
/begin AXIS_PTS SSTTAB_MRADOPTS_GANG3 "" 0x27AA12 N_AB _REC_A2AXS_31_u2_S2 65535 _CNV_R_R_Umr_1_zu_1_3_CM_S2 10 0 65535 /end AXIS_PTS
/begin AXIS_PTS SSTTAB_MRADOPTS_GANG4 "" 0x27AA28 N_AB _REC_A2AXS_31_u2_S2 65535 _CNV_R_R_Umr_1_zu_1_3_CM_S2 10 0 65535 /end AXIS_PTS
/begin AXIS_PTS SSTTAB_MRADOPTS_GANG5 "" 0x27AA3E N_AB _REC_A2AXS_31_u2_S2 65535 _CNV_R_R_Umr_1_zu_1_3_CM_S2 10 0 65535 /end AXIS_PTS
/begin AXIS_PTS SSTTAB_MRADOPTS_GANG6 "" 0x27AA54 N_AB _REC_A2AXS_31_u2_S2 65535 _CNV_R_R_Umr_1_zu_1_3_CM_S2 10 0 65535 /end AXIS_PTS
/begin AXIS_PTS SSTTAB_MRADOPTS_GANG7 "" 0x27AA6A N_AB _REC_A2AXS_31_u2_S2 65535 _CNV_R_R_Umr_1_zu_1_3_CM_S2 10 0 65535 /end AXIS_PTS
/begin AXIS_PTS SSTTAB_MRADOPTS_GANG8 "" 0x27AA80 N_AB _REC_A2AXS_31_u2_S2 65535 _CNV_R_R_Umr_1_zu_1_3_CM_S2 10 0 65535 /end AXIS_PTS
/begin AXIS_PTS SSTTAB_MRADOPTS_GANG9 "" 0x27AA96 N_AB _REC_A2AXS_31_u2_S2 65535 _CNV_R_R_Umr_1_zu_1_3_CM_S2 10 0 65535 /end AXIS_PTS
/begin AXIS_PTS SSTTAB_MRADOPTZ_GANG1 "" 0x27AAAC N_AB _REC_A2AXS_31_u2_S2 65535 _CNV_R_R_Umr_1_zu_1_3_CM_S2 10 0 65535 /end AXIS_PTS
/begin AXIS_PTS SSTTAB_MRADOPTZ_GANG2 "" 0x27AAC2 N_AB _REC_A2AXS_31_u2_S2 65535 _CNV_R_R_Umr_1_zu_1_3_CM_S2 10 0 65535 /end AXIS_PTS
/begin AXIS_PTS SSTTAB_MRADOPTZ_GANG3 "" 0x27AAD8 N_AB _REC_A2AXS_31_u2_S2 65535 _CNV_R_R_Umr_1_zu_1_3_CM_S2 10 0 65535 /end AXIS_PTS
/begin AXIS_PTS SSTTAB_MRADOPTZ_GANG4 "" 0x27AAEE N_AB _REC_A2AXS_31_u2_S2 65535 _CNV_R_R_Umr_1_zu_1_3_CM_S2 10 0 65535 /end AXIS_PTS
/begin AXIS_PTS SSTTAB_MRADOPTZ_GANG5 "" 0x27AB04 N_AB _REC_A2AXS_31_u2_S2 65535 _CNV_R_R_Umr_1_zu_1_3_CM_S2 10 0 65535 /end AXIS_PTS
/begin AXIS_PTS SSTTAB_MRADOPTZ_GANG6 "" 0x27AB1A N_AB _REC_A2AXS_31_u2_S2 65535 _CNV_R_R_Umr_1_zu_1_3_CM_S2 10 0 65535 /end AXIS_PTS
/begin AXIS_PTS SSTTAB_MRADOPTZ_GANG7 "" 0x27AB30 N_AB _REC_A2AXS_31_u2_S2 65535 _CNV_R_R_Umr_1_zu_1_3_CM_S2 10 0 65535 /end AXIS_PTS
/begin AXIS_PTS SSTTAB_MRADOPTZ_GANG8 "" 0x27AB46 N_AB _REC_A2AXS_31_u2_S2 65535 _CNV_R_R_Umr_1_zu_1_3_CM_S2 10 0 65535 /end AXIS_PTS
/begin AXIS_PTS SSTTAB_MRADOPTZ_GANG9 "" 0x27AB5C N_AB _REC_A2AXS_31_u2_S2 65535 _CNV_R_R_Umr_1_zu_1_3_CM_S2 10 0 65535 /end AXIS_PTS
/begin COMPU_METHOD _CNV_R_R_Umr_1_zu_1_0_CM_S2 "" RAT_FUNC "%6.3" "hPa" COEFFS 0 1 0 0 0 1 /end COMPU_METHOD
/begin COMPU_METHOD _CNV_R_R_Umr_1_zu_1_1_CM_S2 "" RAT_FUNC "%6.3" "°C" COEFFS 0 1 0 0 0 1 /end COMPU_METHOD
/begin COMPU_METHOD _CNV_R_R_Umr_1_zu_1_2_CM_S2 "" RAT_FUNC "%6.3" "" COEFFS 0 1 0 0 0 1 /end COMPU_METHOD
/begin COMPU_METHOD _CNV_R_R_Umr_1_zu_1_3_CM_S2 "" RAT_FUNC "%6.3" "U/min" COEFFS 0 1 0 0 0 1 /end COMPU_METHOD
/begin COMPU_METHOD _CNV_S_2_Schalter_A_4_CM_S2 "Schalter: 0 = AUS, 1 = EIN" TAB_VERB "%6.3" "" COMPU_TAB_REF _CNV_S_2_Schalter_A_4_S2 /end COMPU_METHOD
/begin COMPU_METHOD _CNV_P_2_A_I_5_CM_S2 "" TAB_INTP "%6.3" "" COMPU_TAB_REF _CNV_P_2_A_I_5_S2 /end COMPU_METHOD
/begin COMPU_METHOD _CNV_R_R_Umr_1_zu_1_6_CM_S2 "" RAT_FUNC "%6.3" "ms" COEFFS 0 1 0 0 0 1 /end COMPU_METHOD
/begin COMPU_METHOD _CNV_R_R_Umr_1_zu_1_7_CM_S2 "" RAT_FUNC "%6.3" "%/s" COEFFS 0 1 0 0 0 1 /end COMPU_METHOD
/begin COMPU_METHOD _CNV_R_R_Umr_1_zu_1_8_CM_S2 "" RAT_FUNC "%6.3" "km/h" COEFFS 0 1 0 0 0 1 /end COMPU_METHOD
/begin COMPU_METHOD _CNV_R_R_Umr_10_zu__9_CM_S2 "" RAT_FUNC "%6.3" "%" COEFFS 0 10 0 0 0 1 /end COMPU_METHOD
/begin COMPU_METHOD _CNV_R_R_Umr_10_zu__10_CM_S2 "" RAT_FUNC "%6.3" "°" COEFFS 0 10 0 0 0 1 /end COMPU_METHOD
/begin COMPU_METHOD _CNV_S_6_Enum_EDL_11_CM_S2 "" TAB_VERB "%6.3" "" COMPU_TAB_REF _CNV_S_6_Enum_EDL_11_S2 /end COMPU_METHOD
/begin COMPU_METHOD _CNV_S_32_Enum_EEXCF_15_CM_S2 "" TAB_VERB "%6.3" "" COMPU_TAB_REF _CNV_S_32_Enum_EEXCF_15_S2 /end COMPU_METHOD
/begin COMPU_METHOD _CNV_S_2_Enum_EGEW__16_CM_S2 "" TAB_VERB "%6.3" "" COMPU_TAB_REF _CNV_S_2_Enum_EGEW__16_S2 /end COMPU_METHOD
/begin COMPU_METHOD _CNV_S_2_Enum_EPT1__21_CM_S2 "" TAB_VERB "%6.3" "" COMPU_TAB_REF _CNV_S_2_Enum_EPT1__21_S2 /end COMPU_METHOD
/begin COMPU_METHOD _CNV_S_2_Enum_ECOD__23_CM_S2 "" TAB_VERB "%6.3" "" COMPU_TAB_REF _CNV_S_2_Enum_ECOD__23_S2 /end COMPU_METHOD
/begin COMPU_METHOD _CNV_S_4_Enum_EAGS__24_CM_S2 "" TAB_VERB "%6.3" "" COMPU_TAB_REF _CNV_S_4_Enum_EAGS__24_S2 /end COMPU_METHOD
/begin COMPU_METHOD _CNV_S_2_Enum_EAGS_25_CM_S2 "" TAB_VERB "%6.3" "" COMPU_TAB_REF _CNV_S_2_Enum_EAGS_25_S2 /end COMPU_METHOD
/begin COMPU_METHOD _CNV_S_5_Enum_ZDRIV_27_CM_S2 "" TAB_VERB "%6.3" "" COMPU_TAB_REF _CNV_S_5_Enum_ZDRIV_27_S2 /end COMPU_METHOD
/begin COMPU_METHOD _CNV_S_3_Enum_EDSCS_28_CM_S2 "" TAB_VERB "%6.3" "" COMPU_TAB_REF _CNV_S_3_Enum_EDSCS_28_S2 /end COMPU_METHOD
/begin COMPU_METHOD _CNV_S_9_Enum_EGANG_30_CM_S2 "" TAB_VERB "%6.3" "" COMPU_TAB_REF _CNV_S_9_Enum_EGANG_30_S2 /end COMPU_METHOD
/begin COMPU_METHOD _CNV_S_5_Enum_ETUPE_32_CM_S2 "" TAB_VERB "%6.3" "" COMPU_TAB_REF _CNV_S_5_Enum_ETUPE_32_S2 /end COMPU_METHOD
/begin COMPU_METHOD _CNV_S_4_Enum_EPROG_35_CM_S2 "" TAB_VERB "%6.3" "" COMPU_TAB_REF _CNV_S_4_Enum_EPROG_35_S2 /end COMPU_METHOD
/begin COMPU_METHOD _CNV_S_21_Enum_EPROG_40_CM_S2 "" TAB_VERB "%6.3" "" COMPU_TAB_REF _CNV_S_21_Enum_EPROG_40_S2 /end COMPU_METHOD
/begin COMPU_METHOD _CNV_R_R_Umr_1_zu_1_42_CM_S2 "" RAT_FUNC "%6.3" "Nm" COEFFS 0 1 0 0 0 1 /end COMPU_METHOD
/begin COMPU_METHOD _CNV_R_R_Umr_64_zu__44_CM_S2 "" RAT_FUNC "%6.3" "km/h" COEFFS 0 64 0 0 0 1 /end COMPU_METHOD
/begin COMPU_METHOD _CNV_R_R_Umr_10_zu__45_CM_S2 "" RAT_FUNC "%6.3" "" COEFFS 0 10 0 0 0 1 /end COMPU_METHOD
/begin COMPU_METHOD _CNV_R_R_Umr_10_zu__46_CM_S2 "" RAT_FUNC "%6.3" "m/s*s" COEFFS 0 10 0 0 0 1 /end COMPU_METHOD
/begin COMPU_METHOD _CNV_R_R_Umr_1_zu_1_53_CM_S2 "" RAT_FUNC "%6.3" "%" COEFFS 0 1 0 0 0 1 /end COMPU_METHOD
/begin COMPU_METHOD _CNV_R_R_Umr_100_zu_54_CM_S2 "" RAT_FUNC "%6.3" "" COEFFS 0 100 0 0 0 1 /end COMPU_METHOD
/begin COMPU_METHOD _CNV_R_R_Umr_1000_z_57_CM_S2 "" RAT_FUNC "%6.3" "" COEFFS 0 1000 0 0 0 1 /end COMPU_METHOD
/begin COMPU_METHOD _CNV_S_6_Enum_EBERG_61_CM_S2 "" TAB_VERB "%6.3" "" COMPU_TAB_REF _CNV_S_6_Enum_EBERG_61_S2 /end COMPU_METHOD
/begin COMPU_METHOD _CNV_S_3_Enum_EANH_65_CM_S2 "" TAB_VERB "%6.3" "" COMPU_TAB_REF _CNV_S_3_Enum_EANH_65_S2 /end COMPU_METHOD
/begin COMPU_METHOD _CNV_R_R_Umr_1_zu_1_82_CM_S2 "" RAT_FUNC "%6.3" "ms" COEFFS 0 1 0 0 0 10 /end COMPU_METHOD
/begin COMPU_METHOD _CNV_S_3_Enum_ESIGN_84_CM_S2 "" TAB_VERB "%6.3" "" COMPU_TAB_REF _CNV_S_3_Enum_ESIGN_84_S2 /end COMPU_METHOD
/begin COMPU_METHOD _CNV_S_22_Enum_EGLBE_99_CM_S2 "" TAB_VERB "%6.3" "" COMPU_TAB_REF _CNV_S_22_Enum_EGLBE_99_S2 /end COMPU_METHOD
/begin COMPU_METHOD _CNV_S_4_Enum_EEXCF_101_CM_S2 "" TAB_VERB "%6.3" "" COMPU_TAB_REF _CNV_S_4_Enum_EEXCF_101_S2 /end COMPU_METHOD
/begin COMPU_METHOD _CNV_R_R_Umr_100_zu_104_CM_S2 "" RAT_FUNC "%6.3" "%" COEFFS 0 100 0 0 0 1 /end COMPU_METHOD
/begin COMPU_METHOD _CNV_R_R_Umr_1_zu_1_146_CM_S2 "" RAT_FUNC "%6.3" "s" COEFFS 0 1 0 0 0 1 /end COMPU_METHOD
/begin COMPU_METHOD _CNV_S_7_Enum_ESDYN_151_CM_S2 "" TAB_VERB "%6.3" "" COMPU_TAB_REF _CNV_S_7_Enum_ESDYN_151_S2 /end COMPU_METHOD
/begin COMPU_METHOD _CNV_S_6_Enum_ESCHA_152_CM_S2 "" TAB_VERB "%6.3" "" COMPU_TAB_REF _CNV_S_6_Enum_ESCHA_152_S2 /end COMPU_METHOD
/begin COMPU_METHOD _CNV_R_R_Umr_10_zu__181_CM_S2 "" RAT_FUNC "%6.3" "1/s²" COEFFS 0 10 0 0 0 1 /end COMPU_METHOD
/begin COMPU_METHOD _CNV_R_R_Umr_10_zu__190_CM_S2 "" RAT_FUNC "%6.3" "km/h" COEFFS 0 10 0 0 0 1 /end COMPU_METHOD
/begin COMPU_METHOD _CNV_R_R_Umr_1_zu_1_199_CM_S2 "" RAT_FUNC "%6.3" "Nm/s" COEFFS 0 1 0 0 0 1 /end COMPU_METHOD
/begin COMPU_METHOD _CNV_R_R_Umr_32_zu__202_CM_S2 "" RAT_FUNC "%6.3" "m/s*s" COEFFS 0 32 0 0 0 1 /end COMPU_METHOD
/begin COMPU_METHOD _CNV_S_7_Enum_EDRIV_207_CM_S2 "" TAB_VERB "%6.3" "" COMPU_TAB_REF _CNV_S_7_Enum_EDRIV_207_S2 /end COMPU_METHOD
/begin COMPU_METHOD _CNV_S_2_Enum_EWKAN_217_CM_S2 "" TAB_VERB "%6.3" "" COMPU_TAB_REF _CNV_S_2_Enum_EWKAN_217_S2 /end COMPU_METHOD
/begin COMPU_METHOD _CNV_S_8_Enum_EEXCF_223_CM_S2 "" TAB_VERB "%6.3" "" COMPU_TAB_REF _CNV_S_8_Enum_EEXCF_223_S2 /end COMPU_METHOD
/begin COMPU_METHOD _CNV_S_9_Enum_EMAPD_224_CM_S2 "" TAB_VERB "%6.3" "" COMPU_TAB_REF _CNV_S_9_Enum_EMAPD_224_S2 /end COMPU_METHOD
/begin COMPU_METHOD _CNV_S_3_Enum_EQSHI_232_CM_S2 "" TAB_VERB "%6.3" "" COMPU_TAB_REF _CNV_S_3_Enum_EQSHI_232_S2 /end COMPU_METHOD
/begin COMPU_METHOD _CNV_R_R_Umr_2_zu_1_238_CM_S2 "" RAT_FUNC "%6.3" "Bar" COEFFS 0 2 0 0 0 1 /end COMPU_METHOD
/begin COMPU_METHOD _CNV_S_5_Enum_EMOT__239_CM_S2 "" TAB_VERB "%6.3" "" COMPU_TAB_REF _CNV_S_5_Enum_EMOT__239_S2 /end COMPU_METHOD
/begin COMPU_METHOD _CNV_S_3_Enum_EMOT__240_CM_S2 "" TAB_VERB "%6.3" "" COMPU_TAB_REF _CNV_S_3_Enum_EMOT__240_S2 /end COMPU_METHOD
/begin COMPU_METHOD _CNV_S_2_Enum_ESPER_241_CM_S2 "" TAB_VERB "%6.3" "" COMPU_TAB_REF _CNV_S_2_Enum_ESPER_241_S2 /end COMPU_METHOD
/begin COMPU_METHOD _CNV_S_5_Enum_EZKAK_242_CM_S2 "" TAB_VERB "%6.3" "" COMPU_TAB_REF _CNV_S_5_Enum_EZKAK_242_S2 /end COMPU_METHOD
/begin COMPU_METHOD _CNV_S_3_Enum_EZKAO_243_CM_S2 "" TAB_VERB "%6.3" "" COMPU_TAB_REF _CNV_S_3_Enum_EZKAO_243_S2 /end COMPU_METHOD
/begin COMPU_METHOD _CNV_S_5_Enum_EZKAT_244_CM_S2 "" TAB_VERB "%6.3" "" COMPU_TAB_REF _CNV_S_5_Enum_EZKAT_244_S2 /end COMPU_METHOD
/begin COMPU_METHOD _CNV_S_2_Enum_EZKAT_245_CM_S2 "" TAB_VERB "%6.3" "" COMPU_TAB_REF _CNV_S_2_Enum_EZKAT_245_S2 /end COMPU_METHOD
/begin COMPU_METHOD _CNV_R_R_Umr_1_zu_1_248_CM_S2 "" RAT_FUNC "%6.3" "Nm" COEFFS 0 1 0 0 0 10 /end COMPU_METHOD
/begin COMPU_METHOD _CNV_S_3_Enum_EDERS_249_CM_S2 "" TAB_VERB "%6.3" "" COMPU_TAB_REF _CNV_S_3_Enum_EDERS_249_S2 /end COMPU_METHOD
/begin COMPU_METHOD _CNV_S_3_Enum_EEFAH_251_CM_S2 "" TAB_VERB "%6.3" "" COMPU_TAB_REF _CNV_S_3_Enum_EEFAH_251_S2 /end COMPU_METHOD
/begin COMPU_METHOD _CNV_R_R_Umr_80_zu__252_CM_S2 "" RAT_FUNC "%6.3" "" COEFFS 0 80 0 0 0 1 /end COMPU_METHOD
/begin COMPU_METHOD _CNV_S_2_Enum_ESPOR_253_CM_S2 "" TAB_VERB "%6.3" "" COMPU_TAB_REF _CNV_S_2_Enum_ESPOR_253_S2 /end COMPU_METHOD
/begin COMPU_METHOD _CNV_R_R_Umr_100_zu_254_CM_S2 "" RAT_FUNC "%6.3" "U/(min*ms)" COEFFS 0 100 0 0 0 1 /end COMPU_METHOD
/begin COMPU_METHOD _CNV_S_2_Enum_EGNMT_261_CM_S2 "" TAB_VERB "%6.3" "" COMPU_TAB_REF _CNV_S_2_Enum_EGNMT_261_S2 /end COMPU_METHOD
/begin COMPU_METHOD _CNV_S_2_Enum_EDYNH_262_CM_S2 "" TAB_VERB "%6.3" "" COMPU_TAB_REF _CNV_S_2_Enum_EDYNH_262_S2 /end COMPU_METHOD
/begin COMPU_METHOD _CNV_S_3_Enum_EHKOR_263_CM_S2 "" TAB_VERB "%6.3" "" COMPU_TAB_REF _CNV_S_3_Enum_EHKOR_263_S2 /end COMPU_METHOD
/begin COMPU_METHOD _CNV_R_R_Umr_100_zu_264_CM_S2 "" RAT_FUNC "%6.3" "m*m/s*s*s*s" COEFFS 0 100 0 0 0 1 /end COMPU_METHOD
/begin COMPU_METHOD _CNV_R_R_Umr_1_zu_1_265_CM_S2 "" RAT_FUNC "%6.3" "0.1g" COEFFS 0 1 0 0 0 1 /end COMPU_METHOD
/begin COMPU_METHOD _CNV_S_9_Enum_EMAPD_269_CM_S2 "" TAB_VERB "%6.3" "" COMPU_TAB_REF _CNV_S_9_Enum_EMAPD_269_S2 /end COMPU_METHOD
/begin COMPU_METHOD _CNV_R_R_Umr_1_zu_1_270_CM_S2 "" RAT_FUNC "%6.3" "kg" COEFFS 0 1 0 0 0 1 /end COMPU_METHOD
/begin COMPU_METHOD _CNV_S_6_Enum_EK0_280_CM_S2 "" TAB_VERB "%6.3" "" COMPU_TAB_REF _CNV_S_6_Enum_EK0_280_S2 /end COMPU_METHOD
/begin COMPU_METHOD _CNV_S_5_Enum_EMOTS_282_CM_S2 "" TAB_VERB "%6.3" "" COMPU_TAB_REF _CNV_S_5_Enum_EMOTS_282_S2 /end COMPU_METHOD
/begin COMPU_METHOD _CNV_S_8_Enum_E_Z_R_286_CM_S2 "" TAB_VERB "%6.3" "" COMPU_TAB_REF _CNV_S_8_Enum_E_Z_R_286_S2 /end COMPU_METHOD
/begin COMPU_METHOD _CNV_S_2_Enum_ESIGN_288_CM_S2 "" TAB_VERB "%6.3" "" COMPU_TAB_REF _CNV_S_2_Enum_ESIGN_288_S2 /end COMPU_METHOD
/begin COMPU_METHOD _CNV_S_2_Enum_ESIGN_289_CM_S2 "" TAB_VERB "%6.3" "" COMPU_TAB_REF _CNV_S_2_Enum_ESIGN_289_S2 /end COMPU_METHOD
/begin COMPU_METHOD _CNV_S_3_Enum_ETRPM_290_CM_S2 "" TAB_VERB "%6.3" "" COMPU_TAB_REF _CNV_S_3_Enum_ETRPM_290_S2 /end COMPU_METHOD
/begin COMPU_METHOD _CNV_S_3_Enum_ECODA_291_CM_S2 "" TAB_VERB "%6.3" "" COMPU_TAB_REF _CNV_S_3_Enum_ECODA_291_S2 /end COMPU_METHOD
/begin COMPU_METHOD _CNV_S_3_Enum_ECODC_292_CM_S2 "" TAB_VERB "%6.3" "" COMPU_TAB_REF _CNV_S_3_Enum_ECODC_292_S2 /end COMPU_METHOD
/begin COMPU_METHOD _CNV_S_3_Enum_ECODG_293_CM_S2 "" TAB_VERB "%6.3" "" COMPU_TAB_REF _CNV_S_3_Enum_ECODG_293_S2 /end COMPU_METHOD
/begin COMPU_METHOD _CNV_S_3_Enum_ECODM_294_CM_S2 "" TAB_VERB "%6.3" "" COMPU_TAB_REF _CNV_S_3_Enum_ECODM_294_S2 /end COMPU_METHOD
/begin COMPU_METHOD _CNV_S_3_Enum_ECODS_295_CM_S2 "" TAB_VERB "%6.3" "" COMPU_TAB_REF _CNV_S_3_Enum_ECODS_295_S2 /end COMPU_METHOD
/begin COMPU_METHOD _CNV_S_3_Enum_EDRIV_296_CM_S2 "" TAB_VERB "%6.3" "" COMPU_TAB_REF _CNV_S_3_Enum_EDRIV_296_S2 /end COMPU_METHOD
/begin COMPU_METHOD _CNV_S_3_Enum_EABSD_297_CM_S2 "" TAB_VERB "%6.3" "" COMPU_TAB_REF _CNV_S_3_Enum_EABSD_297_S2 /end COMPU_METHOD
/begin COMPU_METHOD _CNV_S_4_Enum_EDSCI_298_CM_S2 "" TAB_VERB "%6.3" "" COMPU_TAB_REF _CNV_S_4_Enum_EDSCI_298_S2 /end COMPU_METHOD
/begin COMPU_METHOD _CNV_S_4_Enum_EEIN__299_CM_S2 "" TAB_VERB "%6.3" "" COMPU_TAB_REF _CNV_S_4_Enum_EEIN__299_S2 /end COMPU_METHOD
/begin COMPU_METHOD _CNV_S_5_Enum_ESIGN_300_CM_S2 "" TAB_VERB "%6.3" "" COMPU_TAB_REF _CNV_S_5_Enum_ESIGN_300_S2 /end COMPU_METHOD
/begin COMPU_METHOD _CNV_S_5_Enum_ESPAR_301_CM_S2 "" TAB_VERB "%6.3" "" COMPU_TAB_REF _CNV_S_5_Enum_ESPAR_301_S2 /end COMPU_METHOD
/begin COMPU_METHOD _CNV_S_4_Enum_EFILT_302_CM_S2 "" TAB_VERB "%6.3" "" COMPU_TAB_REF _CNV_S_4_Enum_EFILT_302_S2 /end COMPU_METHOD
/begin COMPU_METHOD _CNV_R_R_Umr_1_zu_1_303_CM_S2 "" RAT_FUNC "%6.3" "hPa" COEFFS 0 1 0 0 0 10 /end COMPU_METHOD
/begin COMPU_METHOD _CNV_S_4_Enum_EFWSS_304_CM_S2 "" TAB_VERB "%6.3" "" COMPU_TAB_REF _CNV_S_4_Enum_EFWSS_304_S2 /end COMPU_METHOD
/begin COMPU_METHOD _CNV_R_R_Umr_1_zu_1_306_CM_S2 "" RAT_FUNC "%6.3" "%/s" COEFFS 0 1 0 0 0 10 /end COMPU_METHOD
/begin COMPU_METHOD _CNV_S_3_Enum_EDMRA_307_CM_S2 "" TAB_VERB "%6.3" "" COMPU_TAB_REF _CNV_S_3_Enum_EDMRA_307_S2 /end COMPU_METHOD
/begin COMPU_METHOD _CNV_R_R_Umr_1_zu_1_309_CM_S2 "" RAT_FUNC "%6.3" "Nm/s" COEFFS 0 1 0 0 0 100 /end COMPU_METHOD
/begin COMPU_METHOD _CNV_S_5_Enum_EKURV_310_CM_S2 "" TAB_VERB "%6.3" "" COMPU_TAB_REF _CNV_S_5_Enum_EKURV_310_S2 /end COMPU_METHOD
/begin COMPU_METHOD _CNV_S_4_Enum_EKURV_311_CM_S2 "" TAB_VERB "%6.3" "" COMPU_TAB_REF _CNV_S_4_Enum_EKURV_311_S2 /end COMPU_METHOD
/begin COMPU_METHOD _CNV_S_3_Enum_EAGST_312_CM_S2 "" TAB_VERB "%6.3" "" COMPU_TAB_REF _CNV_S_3_Enum_EAGST_312_S2 /end COMPU_METHOD
/begin COMPU_METHOD _CNV_S_2_Enum_EK0_S_314_CM_S2 "" TAB_VERB "%6.3" "" COMPU_TAB_REF _CNV_S_2_Enum_EK0_S_314_S2 /end COMPU_METHOD
/begin COMPU_METHOD _CNV_S_2_Enum_EDBMT_316_CM_S2 "" TAB_VERB "%6.3" "" COMPU_TAB_REF _CNV_S_2_Enum_EDBMT_316_S2 /end COMPU_METHOD
/begin COMPU_METHOD _CNV_S_3_Enum_EWL_318_CM_S2 "" TAB_VERB "%6.3" "" COMPU_TAB_REF _CNV_S_3_Enum_EWL_318_S2 /end COMPU_METHOD
/begin COMPU_METHOD _CNV_S_2_Enum_PRUEF_319_CM_S2 "" TAB_VERB "%6.3" "" COMPU_TAB_REF _CNV_S_2_Enum_PRUEF_319_S2 /end COMPU_METHOD
/begin COMPU_METHOD _CNV_S_5_Enum_REKUP_320_CM_S2 "" TAB_VERB "%6.3" "" COMPU_TAB_REF _CNV_S_5_Enum_REKUP_320_S2 /end COMPU_METHOD
/begin COMPU_METHOD _CNV_S_2_Enum_ELOWH_321_CM_S2 "" TAB_VERB "%6.3" "" COMPU_TAB_REF _CNV_S_2_Enum_ELOWH_321_S2 /end COMPU_METHOD
/begin COMPU_METHOD _CNV_S_17_Enum_EKRIT_323_CM_S2 "" TAB_VERB "%6.3" "" COMPU_TAB_REF _CNV_S_17_Enum_EKRIT_323_S2 /end COMPU_METHOD
/begin COMPU_METHOD _CNV_S_2_Enum_REKUP_324_CM_S2 "" TAB_VERB "%6.3" "" COMPU_TAB_REF _CNV_S_2_Enum_REKUP_324_S2 /end COMPU_METHOD
/begin COMPU_METHOD _CNV_S_3_Enum_EIDX0_325_CM_S2 "" TAB_VERB "%6.3" "" COMPU_TAB_REF _CNV_S_3_Enum_EIDX0_325_S2 /end COMPU_METHOD
/begin COMPU_METHOD SAB_PROZENT_PROZENT_S2_S3 "int = ((phys * 1) / 1) - (0) Unit_PerCent" RAT_FUNC "%2.0" "Unit_PerCent" COEFFS 0 1 -0 0 0 1 /end COMPU_METHOD
/begin COMPU_METHOD SAB_Z_1DIGIT_S2_S3 "int = ((phys * 1) / 1) - (0) Digit" RAT_FUNC "%2.0" "Digit" COEFFS 0 1 -0 0 0 1 /end COMPU_METHOD
/begin COMPU_METHOD SAB_Z_1DIGIT8_S2_S3 "int = ((phys * 8) / 1) - (0) Digit" RAT_FUNC "%5.3" "Digit" COEFFS 0 8 -0 0 0 1 /end COMPU_METHOD
/begin COMPU_METHOD SAB_K_M128_S2_S3 "int = ((phys * 1) / 1) - (-128) (none)" RAT_FUNC "%2.0" "(none)" COEFFS 0 1 128 0 0 1 /end COMPU_METHOD
/begin COMPU_METHOD SAB_PROZENT_M128_S2_S3 "int = ((phys * 1) / 1) - (-128) %" RAT_FUNC "%2.0" "%" COEFFS 0 1 128 0 0 1 /end COMPU_METHOD
/begin COMPU_METHOD SAB_A_3125MPSS100000_M16_S2_S3 "int = ((phys * 100000) / 3125) - (-512) m/s^2" RAT_FUNC "%5.3" "m/s^2" COEFFS 0 100000 1600000 0 0 3125 /end COMPU_METHOD
/begin COMPU_METHOD SAB_KW_KW_S2_S3 "int = ((phys * 1) / 1) - (0) kw" RAT_FUNC "%2.0" "kw" COEFFS 0 1 -0 0 0 1 /end COMPU_METHOD
/begin COMPU_METHOD SAB2_MG_1NMS_S3_S3 "int = ((phys * 1) / 1) - (0) Nm/s" RAT_FUNC "%2.0" "Nm/s" COEFFS 0 1 -0 0 0 1 /end COMPU_METHOD
/begin COMPU_METHOD SAB2_MG_10NMS_S3_S3 "int = ((phys * 1) / 10) - (0) Nm/s" RAT_FUNC "%5.3" "Nm/s" COEFFS 0 1 -0 0 0 10 /end COMPU_METHOD
/begin COMPU_METHOD SAB2_L_1MM_S3_S3 "int = ((phys * 1) / 1) - (0) mm" RAT_FUNC "%2.0" "mm" COEFFS 0 1 -0 0 0 1 /end COMPU_METHOD
/begin COMPU_METHOD SAB2_L_M6554_S3_S3 "int = ((phys * 6554) / 1) - (0) m" RAT_FUNC "%22.20" "m" COEFFS 0 6554 -0 0 0 1 /end COMPU_METHOD
/begin COMPU_METHOD SAB2_L_10M_S3_S3 "int = ((phys * 1) / 10) - (0) m" RAT_FUNC "%5.3" "m" COEFFS 0 1 -0 0 0 10 /end COMPU_METHOD
/begin COMPU_METHOD SAB2_N_RPM10_S3_S3 "int = ((phys * 10) / 1) - (0) 1/min" RAT_FUNC "%5.3" "1/min" COEFFS 0 10 -0 0 0 1 /end COMPU_METHOD
/begin COMPU_METHOD SAB2_N_RPM4_S3_S3 "int = ((phys * 4) / 1) - (0) 1/min" RAT_FUNC "%5.3" "1/min" COEFFS 0 4 -0 0 0 1 /end COMPU_METHOD
/begin COMPU_METHOD SAB2_N_RPM8_S3_S3 "int = ((phys * 8) / 1) - (0) 1/min" RAT_FUNC "%5.3" "1/min" COEFFS 0 8 -0 0 0 1 /end COMPU_METHOD
/begin COMPU_METHOD SAB2_N_RPM32_S3_S3 "int = ((phys * 32) / 1) - (0) 1/min" RAT_FUNC "%5.3" "1/min" COEFFS 0 32 -0 0 0 1 /end COMPU_METHOD
/begin COMPU_METHOD SAB2_PROZENT10_M127_S3_S3 "int = ((phys * 10) / 1) - (-127) %" RAT_FUNC "%5.3" "%" COEFFS 0 10 127 0 0 1 /end COMPU_METHOD
/begin COMPU_METHOD SAB2_PROZENT10_S3_S3 "int = ((phys * 10) / 1) - (0) %" RAT_FUNC "%5.3" "%" COEFFS 0 10 -0 0 0 1 /end COMPU_METHOD
/begin COMPU_METHOD SAB2_39PROZENT100_S3_S3 "int = ((phys * 100) / 39) - (0) %" RAT_FUNC "%5.3" "%" COEFFS 0 100 -0 0 0 39 /end COMPU_METHOD
/begin COMPU_METHOD SAB2_OM_YAWRATE_GRADPS20_S3_S3 "int = ((phys * 20) / 1) - (0) Grad/s" RAT_FUNC "%5.3" "Grad/s" COEFFS 0 20 -0 0 0 1 /end COMPU_METHOD
/begin COMPU_METHOD SAB2_OM_YAWRATE_GRADPS200_M32768_S3_S3 "int = ((phys * 200) / 1) - (-32768) Grad/s" RAT_FUNC "%5.3" "Grad/s" COEFFS 0 200 32768 0 0 1 /end COMPU_METHOD
/begin COMPU_METHOD SAB2_A_MPSS40_S3_S3 "int = ((phys * 40) / 1) - (0) m/s^2" RAT_FUNC "%5.3" "m/s^2" COEFFS 0 40 -0 0 0 1 /end COMPU_METHOD
/begin COMPU_METHOD SAB2_A_2MPSS1000_M32500_S3_S3 "int = ((phys * 1000) / 2) - (-32500) m/s^2" RAT_FUNC "%5.3" "m/s^2" COEFFS 0 1000 65000 0 0 2 /end COMPU_METHOD
/begin COMPU_METHOD SAB2_A_204G100000_M2049_S3_S3 "int = ((phys * 100000) / 204) - (-2049) g" RAT_FUNC "%5.3" "g" COEFFS 0 100000 417996 0 0 204 /end COMPU_METHOD
/begin COMPU_METHOD SAB2_A_15G1000_M120_S3_S3 "int = ((phys * 1000) / 15) - (-120) g" RAT_FUNC "%5.3" "g" COEFFS 0 1000 1800 0 0 15 /end COMPU_METHOD
/begin COMPU_METHOD SAB2_A_MPSS32_S3_S3 "int = ((phys * 32) / 1) - (0) m/s^2" RAT_FUNC "%5.3" "m/s^2" COEFFS 0 32 -0 0 0 1 /end COMPU_METHOD
/begin COMPU_METHOD SAB2_A_1MPSS40_M2048_S3_S3 "int = ((phys * 40) / 1) - (-2048) m/s^2" RAT_FUNC "%5.3" "m/s^2" COEFFS 0 40 2048 0 0 1 /end COMPU_METHOD
/begin COMPU_METHOD SAB2_A_00478MPSS_M24_S3_S3 "int = ((phys * 10000) / 478) - (-512) m/s^2" RAT_FUNC "%5.3" "m/s^2" COEFFS 0 10000 244736 0 0 478 /end COMPU_METHOD
/begin COMPU_METHOD SAB2_PHI_SENS_1GRAD3_M128_S3_S3 "int = ((phys * 3) / 1) - (-128) grad" RAT_FUNC "%5.3" "grad" COEFFS 0 3 128 0 0 1 /end COMPU_METHOD
/begin COMPU_METHOD SAB2_PHI_SENS_1GRAD20_M1280_S3_S3 "int = ((phys * 20) / 1) - (-1280) grad" RAT_FUNC "%5.3" "grad" COEFFS 0 20 1280 0 0 1 /end COMPU_METHOD
/begin COMPU_METHOD SAB2_T_TIMER_50NS_S3_S3 "int = ((phys * 20000) / 1) - (0) ms" RAT_FUNC "%7.5" "ms" COEFFS 0 20000 -0 0 0 1 /end COMPU_METHOD
/begin COMPU_METHOD SAB2_T_TIMER_1US_S3_S3 "int = ((phys * 1) / 1) - (0) us" RAT_FUNC "%2.0" "us" COEFFS 0 1 -0 0 0 1 /end COMPU_METHOD
/begin COMPU_METHOD SAB2_T_TIMER_1MS_S3_S3 "int = ((phys * 1) / 1) - (0) ms" RAT_FUNC "%2.0" "ms" COEFFS 0 1 -0 0 0 1 /end COMPU_METHOD
/begin COMPU_METHOD SAB2_T_TIMER_100MS_S3_S3 "int = ((phys * 1) / 100) - (0) ms" RAT_FUNC "%5.3" "ms" COEFFS 0 1 -0 0 0 100 /end COMPU_METHOD
/begin COMPU_METHOD SAB2_N_RADPS64_M32767_S3_S3 "int = ((phys * 64) / 1) - (-32767) rad/s" RAT_FUNC "%5.3" "rad/s" COEFFS 0 64 32767 0 0 1 /end COMPU_METHOD
/begin COMPU_METHOD SAB2_N_RPM24_S3_S3 "int = ((phys * 24) / 1) - (0) U/min" RAT_FUNC "%5.3" "U/min" COEFFS 0 24 -0 0 0 1 /end COMPU_METHOD
/begin COMPU_METHOD SAB2_T_TIMER_20MS_S3_S3 "int = ((phys * 1) / 20) - (0) ms" RAT_FUNC "%5.3" "ms" COEFFS 0 1 -0 0 0 20 /end COMPU_METHOD
/begin COMPU_METHOD SAB2_T_TIMER_1S_S3_S3 "int = ((phys * 1) / 1) - (0) s" RAT_FUNC "%2.0" "s" COEFFS 0 1 -0 0 0 1 /end COMPU_METHOD
/begin COMPU_METHOD SAB2_T_TIMER_S10_S3_S3 "int = ((phys * 10) / 1) - (0) s" RAT_FUNC "%5.3" "s" COEFFS 0 10 -0 0 0 1 /end COMPU_METHOD
/begin COMPU_METHOD SAB2_N_2RPM_S3_S3 "int = ((phys * 1) / 2) - (0) 1/min" RAT_FUNC "%5.3" "1/min" COEFFS 0 1 -0 0 0 2 /end COMPU_METHOD
/begin COMPU_METHOD SAB2_N_4RPM_S3_S3 "int = ((phys * 1) / 4) - (0) 1/min" RAT_FUNC "%5.3" "1/min" COEFFS 0 1 -0 0 0 4 /end COMPU_METHOD
/begin COMPU_METHOD SAB2_N_4RPM_P125_S3_S3 "int = ((phys * 1) / 4) - (125) 1/min" RAT_FUNC "%5.3" "1/min" COEFFS 0 1 -500 0 0 4 /end COMPU_METHOD
/begin COMPU_METHOD SAB2_N_RPM_M2000_S3_S3 "int = ((phys * 1) / 1) - (-2000) 1/min" RAT_FUNC "%2.0" "1/min" COEFFS 0 1 2000 0 0 1 /end COMPU_METHOD
/begin COMPU_METHOD SAB2_N_25RPM_S3_S3 "int = ((phys * 1) / 25) - (0) 1/min" RAT_FUNC "%5.3" "1/min" COEFFS 0 1 -0 0 0 25 /end COMPU_METHOD
/begin COMPU_METHOD SAB2_N_32RPM_S3_S3 "int = ((phys * 1) / 32) - (0) 1/min" RAT_FUNC "%5.3" "1/min" COEFFS 0 1 -0 0 0 32 /end COMPU_METHOD
/begin COMPU_METHOD SAB2_C_CEL2_M100_S3_S3 "int = ((phys * 2) / 1) - (-100) Grad Celsius" RAT_FUNC "%5.3" "Grad Celsius" COEFFS 0 2 100 0 0 1 /end COMPU_METHOD
/begin COMPU_METHOD SAB2_C_CMO_1CEL_M48_S3_S3 "int = ((phys * 1) / 1) - (-48) Grad Celsius" RAT_FUNC "%2.0" "Grad Celsius" COEFFS 0 1 48 0 0 1 /end COMPU_METHOD
/begin COMPU_METHOD SAB2_C_CMO_3CEL4_M48_S3_S3 "int = ((phys * 4) / 3) - (-48) Grad Celsius" RAT_FUNC "%5.3" "Grad Celsius" COEFFS 0 4 144 0 0 3 /end COMPU_METHOD
/begin COMPU_METHOD SAB2_C_1CEL_S3_S3 "int = ((phys * 1) / 1) - (0) Grad Celsius" RAT_FUNC "%2.0" "Grad Celsius" COEFFS 0 1 -0 0 0 1 /end COMPU_METHOD
/begin COMPU_METHOD SAB2_C_1CEL_M60_S3_S3 "int = ((phys * 1) / 1) - (-60) Grad Celsius" RAT_FUNC "%2.0" "Grad Celsius" COEFFS 0 1 60 0 0 1 /end COMPU_METHOD
/begin COMPU_METHOD SAB2_C_1CEL_M50_S3_S3 "int = ((phys * 1) / 1) - (-50) Grad Celsius" RAT_FUNC "%2.0" "Grad Celsius" COEFFS 0 1 50 0 0 1 /end COMPU_METHOD
/begin COMPU_METHOD SAB2_C_CGT_1CEL_M50_S3_S3 "int = ((phys * 1) / 1) - (-50) Grad Celsius" RAT_FUNC "%2.0" "Grad Celsius" COEFFS 0 1 50 0 0 1 /end COMPU_METHOD
/begin COMPU_METHOD SAB2_C_TEMPEXTERN_CEL2_M40_S3_S3 "int = ((phys * 2) / 1) - (-80) Grad Celsius" RAT_FUNC "%5.3" "Grad Celsius" COEFFS 0 2 80 0 0 1 /end COMPU_METHOD
/begin COMPU_METHOD SAB2_M_1NM_KOMP_S3_S3 "int = ((phys * 1) / 1) - (0) Nm" RAT_FUNC "%2.0" "Nm" COEFFS 0 1 -0 0 0 1 /end COMPU_METHOD
/begin COMPU_METHOD SAB2_M_NM2_S3_S3 "int = ((phys * 2) / 1) - (0) Nm" RAT_FUNC "%5.3" "Nm" COEFFS 0 2 -0 0 0 1 /end COMPU_METHOD
/begin COMPU_METHOD SAB2_M_NM50_S3_S3 "int = ((phys * 50) / 1) - (0) Nm" RAT_FUNC "%5.3" "Nm" COEFFS 0 50 -0 0 0 1 /end COMPU_METHOD
/begin COMPU_METHOD SAB2_M_NM10_S3_S3 "int = ((phys * 10) / 1) - (0) Nm" RAT_FUNC "%5.3" "Nm" COEFFS 0 10 -0 0 0 1 /end COMPU_METHOD
/begin COMPU_METHOD SAB2_INTEGRAL_PROZENT100_S3_S3 "int = ((phys * 100) / 1) - (0) %.sec" RAT_FUNC "%5.3" "%.sec" COEFFS 0 100 -0 0 0 1 /end COMPU_METHOD
/begin COMPU_METHOD SAB2_MINTEGRAL_1NMS_S3_S3 "int = ((phys * 1) / 1) - (0) Nms" RAT_FUNC "%2.0" "Nms" COEFFS 0 1 -0 0 0 1 /end COMPU_METHOD
/begin COMPU_METHOD SAB2_MINTEGRAL_NMS100_S3_S3 "int = ((phys * 100) / 1) - (0) Nms" RAT_FUNC "%5.3" "Nms" COEFFS 0 100 -0 0 0 1 /end COMPU_METHOD
/begin COMPU_METHOD SAB2_P_BARO_2HPA_P598_S3_S3 "int = ((phys * 1) / 2) - (299) hPa" RAT_FUNC "%5.3" "hPa" COEFFS 0 1 -598 0 0 2 /end COMPU_METHOD
/begin COMPU_METHOD SAB2_P_BARO_10HPA_P50_S3_S3 "int = ((phys * 1) / 10) - (50) hPa" RAT_FUNC "%5.3" "hPa" COEFFS 0 1 -500 0 0 10 /end COMPU_METHOD
/begin COMPU_METHOD SAB2_P_BARO_5MBAR_S3_S3 "int = ((phys * 1) / 5) - (0) mbar" RAT_FUNC "%5.3" "mbar" COEFFS 0 1 -0 0 0 5 /end COMPU_METHOD
/begin COMPU_METHOD SAB2_P_BARO_1MBAR_S3_S3 "int = ((phys * 1) / 1) - (0) mbar" RAT_FUNC "%2.0" "mbar" COEFFS 0 1 -0 0 0 1 /end COMPU_METHOD
/begin COMPU_METHOD SAB2_P_1HPA_S3_S3 "int = ((phys * 1) / 1) - (0) hPa" RAT_FUNC "%2.0" "hPa" COEFFS 0 1 -0 0 0 1 /end COMPU_METHOD
/begin COMPU_METHOD SAB2_P_1BAR_S3_S3 "int = ((phys * 1) / 1) - (0) bar" RAT_FUNC "%2.0" "bar" COEFFS 0 1 -0 0 0 1 /end COMPU_METHOD
/begin COMPU_METHOD SAB2_P_BAR2_S3_S3 "int = ((phys * 2) / 1) - (0) bar" RAT_FUNC "%5.3" "bar" COEFFS 0 2 -0 0 0 1 /end COMPU_METHOD
/begin COMPU_METHOD SAB2_P_BAR5_S3_S3 "int = ((phys * 5) / 1) - (0) bar" RAT_FUNC "%5.3" "bar" COEFFS 0 5 -0 0 0 1 /end COMPU_METHOD
/begin COMPU_METHOD SAB2_P_2396KPA100_M2444_S3_S3 "int = ((phys * 100) / 2396) - (-102) kPa" RAT_FUNC "%5.3" "kPa" COEFFS 0 100 244392 0 0 2396 /end COMPU_METHOD
/begin COMPU_METHOD SAB2_P_MMHG10_S3_S3 "int = ((phys * 10) / 1) - (0) mmHg" RAT_FUNC "%5.3" "mmHg" COEFFS 0 10 -0 0 0 1 /end COMPU_METHOD
/begin COMPU_METHOD SAB2_PHI_STEERING_ANGLE_45GRAD1024_S3_S3 "int = ((phys * 1024) / 45) - (0) grad" RAT_FUNC "%5.3" "grad" COEFFS 0 1024 -0 0 0 45 /end COMPU_METHOD
/begin COMPU_METHOD SAB2_PHI_STEERING_ANGLE_7GRAD160_S3_S3 "int = ((phys * 160) / 7) - (0) grad" RAT_FUNC "%5.3" "grad" COEFFS 0 160 -0 0 0 7 /end COMPU_METHOD
/begin COMPU_METHOD SAB2_PHI_STEERING_ANGLE_GRAD10_S3_S3 "int = ((phys * 10) / 1) - (0) grad" RAT_FUNC "%5.3" "grad" COEFFS 0 10 -0 0 0 1 /end COMPU_METHOD
/begin COMPU_METHOD SAB2_L_1KM_S3_S3 "int = ((phys * 1) / 1) - (0) km" RAT_FUNC "%2.0" "km" COEFFS 0 1 -0 0 0 1 /end COMPU_METHOD
/begin COMPU_METHOD SAB2_L_10KM_S3_S3 "int = ((phys * 1) / 10) - (0) km" RAT_FUNC "%5.3" "km" COEFFS 0 1 -0 0 0 10 /end COMPU_METHOD
/begin COMPU_METHOD SAB2_L_KM100_S3_S3 "int = ((phys * 100) / 1) - (0) km" RAT_FUNC "%5.3" "km" COEFFS 0 100 -0 0 0 1 /end COMPU_METHOD
/begin COMPU_METHOD SAB2_T_10S_S3_S3 "int = ((phys * 1) / 10) - (0) s" RAT_FUNC "%5.3" "s" COEFFS 0 1 -0 0 0 10 /end COMPU_METHOD
/begin COMPU_METHOD SAB2_T_20MS_S3_S3 "int = ((phys * 1) / 20) - (0) ms" RAT_FUNC "%5.3" "ms" COEFFS 0 1 -0 0 0 20 /end COMPU_METHOD
/begin COMPU_METHOD SAB2_M_NM16_M2048_S3_S3 "int = ((phys * 16) / 1) - (-32768) Nm" RAT_FUNC "%5.3" "Nm" COEFFS 0 16 32768 0 0 1 /end COMPU_METHOD
/begin COMPU_METHOD SAB2_M_NM_M2048_S3_S3 "int = ((phys * 1) / 1) - (-2048) Nm" RAT_FUNC "%2.0" "Nm" COEFFS 0 1 2048 0 0 1 /end COMPU_METHOD
/begin COMPU_TAB _CNV_P_2_A_I_5_S2 "" TAB_INTP 2 0 0 255 255 /end COMPU_TAB
/begin COMPU_VTAB _CNV_S_2_Schalter_A_4_S2 "Schalter: 0 = AUS, 1 = EIN" TAB_VERB 2 0 "AUS" 1 "EIN" /end COMPU_VTAB
/begin COMPU_VTAB _CNV_S_6_Enum_EDL_11_S2 "" TAB_VERB 6 1 "DL_1" 2 "DL_2" 3 "DL_3" 4 "DL_4" 5 "DL_5" 6 "DL_6" /end COMPU_VTAB
/begin COMPU_VTAB _CNV_S_32_Enum_EEXCF_15_S2 "" TAB_VERB 32 0 "XE_FKT" 1 "E_FKT" 2 "S_FKT" 3 "XS_FKT" 4 "STEPTR" 5 "TID" 6 "DL_2" 7 "DL_3" 8 "DL_4" 9 "DL_5" 10 "DL_6" 11 "FAS" 12 "HDC" 13 "DPF_REG" 14 "TMS" 15 "WL1" 16 "WL2" 17 "HOTMODE" 18 "BERG_A1" 19 "BERG_A2" 20 "BERG_A3" 21 "BERG_A4" 22 "BERG_A5" 23 "MUELOW" 24 "LM" 25 "EFAHREN_1" 26 "EFAHREN_2" 27 "EFAHREN_3" 28 "EFAHREN_4" 29 "EFAHREN_HYB" 30 "FREI_1" 31 "FREI_2" /end COMPU_VTAB
/begin COMPU_VTAB _CNV_S_2_Enum_EGEW__16_S2 "" TAB_VERB 2 0 "IN_GEW" 1 "OUT_GEW" /end COMPU_VTAB
/begin COMPU_VTAB _CNV_S_2_Enum_EPT1__21_S2 "" TAB_VERB 2 0 "PT1_VERST" 1 "PT1_TRAEG" /end COMPU_VTAB
/begin COMPU_VTAB _CNV_S_2_Enum_ECOD__23_S2 "" TAB_VERB 2 0 "KEIN_SPORTSCHALTER" 1 "SPORTSCHALTER" /end COMPU_VTAB
/begin COMPU_VTAB _CNV_S_4_Enum_EAGS__24_S2 "" TAB_VERB 4 0 "A_AGS" 1 "S_AGS" 2 "ECO" 3 "E_FAHREN" /end COMPU_VTAB
/begin COMPU_VTAB _CNV_S_2_Enum_EAGS_25_S2 "" TAB_VERB 2 0 "A_AGS" 1 "S_AGS" /end COMPU_VTAB
/begin COMPU_VTAB _CNV_S_5_Enum_ZDRIV_27_S2 "" TAB_VERB 5 0 "D_DRIVE" 1 "S_DRIVE" 2 "M_DRIVE" 3 "TID_DRIVE" 4 "LMODE_DRIVE" /end COMPU_VTAB
/begin COMPU_VTAB _CNV_S_3_Enum_EDSCS_28_S2 "" TAB_VERB 3 0 "DSC_ACTIVE" 1 "DSC_PASSIVE" 2 "DTC_ACTIVE" /end COMPU_VTAB
/begin COMPU_VTAB _CNV_S_9_Enum_EGANG_30_S2 "" TAB_VERB 9 0 "GANG_1" 1 "GANG_2" 2 "GANG_3" 3 "GANG_4" 4 "GANG_5" 5 "GANG_6" 6 "GANG_7" 7 "GANG_8" 8 "GANG_9" /end COMPU_VTAB
/begin COMPU_VTAB _CNV_S_5_Enum_ETUPE_32_S2 "" TAB_VERB 5 0 "NMOTHS_TUPEL_0" 1 "NMOTHS_TUPEL_1" 2 "NMOTHS_TUPEL_2" 3 "NMOTHS_TUPEL_3" 4 "NMOTHS_TUPEL_4" /end COMPU_VTAB
/begin COMPU_VTAB _CNV_S_4_Enum_EPROG_35_S2 "" TAB_VERB 4 0 "NORMAL_MODE" 1 "SPORT_MODE" 2 "STEPTRONIC_MODE" 3 "L_MODE" /end COMPU_VTAB
/begin COMPU_VTAB _CNV_S_21_Enum_EPROG_40_S2 "" TAB_VERB 21 0 "EXTREME_ECONOMY_PROG" 1 "ECONOMY_PROG" 2 "SPORT_PROG" 3 "EXTREME_SPORT_PROG" 4 "A1_PROG" 5 "A2_PROG" 6 "A3_PROG" 7 "A4_PROG" 8 "A5_PROG" 9 "SA1_PROG" 10 "SA2_PROG" 11 "SA3_PROG" 12 "SA4_PROG" 13 "WL1_PROG" 14 "WL2_PROG" 15 "ECO_PROG" 16 "ECOA1_PROG" 17 "ECOA2_PROG" 18 "ECOWL2_PROG" 19 "SO1_PROG" 20 "SO2_PROG" /end COMPU_VTAB
/begin COMPU_VTAB _CNV_S_6_Enum_EBERG_61_S2 "" TAB_VERB 6 0 "BERGANH_OFF" 1 "BERGANH_A1" 2 "BERGANH_A2" 3 "BERGANH_A3" 4 "BERGANH_A4" 5 "BERGANH_A5" /end COMPU_VTAB
/begin COMPU_VTAB _CNV_S_3_Enum_EANH_65_S2 "" TAB_VERB 3 0 "KEIN_ANHAENGER" 1 "ANHAENGER" 2 "ANHAENGER_ODER_KEIN_ANHAENGER" /end COMPU_VTAB
/begin COMPU_VTAB _CNV_S_3_Enum_ESIGN_84_S2 "" TAB_VERB 3 0 "SIGNAL_AUS" 1 "SIGNAL_EIN" 2 "SIGNAL_UEBERNAHME" /end COMPU_VTAB
/begin COMPU_VTAB _CNV_S_22_Enum_EGLBE_99_S2 "" TAB_VERB 22 0 "MIN_EXC" 1 "MAX_EXC" 2 "MIN_RFWS" 3 "MAX_RFWS" 4 "MIN_TUMGPLUFT" 5 "MIN_DPFREG" 6 "MIN_AEP" 7 "MIN_HOTMODE" 8 "MIN_MOTSOLLLL" 9 "MIN_CGT" 10 "MAX_EMHIGH" 11 "MAX_EMLOW" 12 "MAX_TMS" 13 "MAX_HOTMODE" 14 "MIN_ARSDYN" 15 "MAX_ECO" 16 "MAX_DYNSPV" 17 "MIN_REKUPRS" 18 "MARS_DBM" 19 "K0_DBM" 20 "MIN_AFU" 21 "MIN_FES" /end COMPU_VTAB
/begin COMPU_VTAB _CNV_S_4_Enum_EEXCF_101_S2 "" TAB_VERB 4 0 "AUTOMAT" 1 "MANUELL" 2 "FAHRERASSISTENT" 3 "ZUGKRAFTALGO" /end COMPU_VTAB
/begin COMPU_VTAB _CNV_S_7_Enum_ESDYN_151_S2 "" TAB_VERB 7 0 "KOMFORT_SDYN" 1 "QS1_SDYN" 2 "QS2_SDYN" 3 "QS3_SDYN" 4 "QS4_SDYN" 5 "QS5_SDYN" 6 "QS6_SDYN" /end COMPU_VTAB
/begin COMPU_VTAB _CNV_S_6_Enum_ESCHA_152_S2 "" TAB_VERB 6 0 "ZUG_HOCH" 1 "ZUG_RUECK" 2 "SCHUB_HOCH" 3 "SCHUB_RUECK" 4 "SCHUB_RUECK_POSME" 5 "SCHUB_RUECK_OFFEN" /end COMPU_VTAB
/begin COMPU_VTAB _CNV_S_7_Enum_EDRIV_207_S2 "" TAB_VERB 7 0 "DRIVEDYN_BASIS" 1 "DRIVEDYN_KOMFORT" 2 "DRIVEDYN_TRAKTION" 3 "DRIVEDYN_SPORT" 4 "DRIVEDYN_SPORT_PLUS" 5 "DRIVEDYN_RACE" 6 "DRIVEDYN_ECO" /end COMPU_VTAB
/begin COMPU_VTAB _CNV_S_2_Enum_EWKAN_217_S2 "" TAB_VERB 2 0 "GER_WKSOLL" 1 "ZU_WKSOLL" /end COMPU_VTAB
/begin COMPU_VTAB _CNV_S_8_Enum_EEXCF_223_S2 "" TAB_VERB 8 0 "EXCFKT1_QS" 1 "EXCFKT2_QS" 2 "EXCFKT3_QS" 3 "EXCFKT4_QS" 4 "EXCFKT5_QS" 5 "EXCFKT6_QS" 6 "EXCFKT7_QS" 7 "EXCFKT8_QS" /end COMPU_VTAB
/begin COMPU_VTAB _CNV_S_9_Enum_EMAPD_224_S2 "" TAB_VERB 9 0 "LMODE_DL" 1 "FDC_DL" 2 "FDS_BASIS" 3 "FDS_KOMFORT" 4 "FDS_TRAKTION" 5 "FDS_SPORT" 6 "FDS_SPORT_PLUS" 7 "FDS_RACE" 8 "FDS_ECO" /end COMPU_VTAB
/begin COMPU_VTAB _CNV_S_3_Enum_EQSHI_232_S2 "" TAB_VERB 3 0 "QS0_MODAFB" 1 "QS1_MODAFB" 2 "KEINE_BEEINFLUSSUNG" /end COMPU_VTAB
/begin COMPU_VTAB _CNV_S_5_Enum_EMOT__239_S2 "" TAB_VERB 5 0 "MOT_IDX1" 1 "MOT_IDX2" 2 "MOT_IDX3" 3 "MOT_IDX4" 4 "MOT_IDX5" /end COMPU_VTAB
/begin COMPU_VTAB _CNV_S_3_Enum_EMOT__240_S2 "" TAB_VERB 3 0 "MOT_SCHUB_IDX1" 1 "MOT_SCHUB_IDX2" 2 "MOT_SCHUB_IDX3" /end COMPU_VTAB
/begin COMPU_VTAB _CNV_S_2_Enum_ESPER_241_S2 "" TAB_VERB 2 0 "FLANKE_LDM_ERK" 1 "FLANKE_LDMBAB_ERK" /end COMPU_VTAB
/begin COMPU_VTAB _CNV_S_5_Enum_EZKAK_242_S2 "" TAB_VERB 5 0 "Anford" 1 "Stabi" 2 "leer1" 3 "leer2" 4 "leer3" /end COMPU_VTAB
/begin COMPU_VTAB _CNV_S_3_Enum_EZKAO_243_S2 "" TAB_VERB 3 0 "GANG_AKT" 1 "GANG_HIGH" 2 "GANG_LOW" /end COMPU_VTAB
/begin COMPU_VTAB _CNV_S_5_Enum_EZKAT_244_S2 "" TAB_VERB 5 0 "ZKA_IDX1" 1 "ZKA_IDX2" 2 "ZKA_IDX3" 3 "ZKA_IDX4" 4 "ZKA_IDX5" /end COMPU_VTAB
/begin COMPU_VTAB _CNV_S_2_Enum_EZKAT_245_S2 "" TAB_VERB 2 0 "OPT_ZUG" 1 "OPT_SCHUB" /end COMPU_VTAB
/begin COMPU_VTAB _CNV_S_3_Enum_EDERS_249_S2 "" TAB_VERB 3 0 "DERS_NL" 1 "DERS_LWVA" 2 "DERS_NIC" /end COMPU_VTAB
/begin COMPU_VTAB _CNV_S_3_Enum_EEFAH_251_S2 "" TAB_VERB 3 0 "KEIN_AUSSTIEG" 1 "AUSSTIEG_EMODE" 2 "AUSSTIEG_AUTOEV" /end COMPU_VTAB
/begin COMPU_VTAB _CNV_S_2_Enum_ESPOR_253_S2 "" TAB_VERB 2 0 "AUTOMATC" 1 "SPORT" /end COMPU_VTAB
/begin COMPU_VTAB _CNV_S_2_Enum_EGNMT_261_S2 "" TAB_VERB 2 0 "Korfakt_in_Schaltung_einfrieren" 1 "Korfakt_in_Schaltung_XFAKT_FILTKORSCHALT_DYNHSPV" DEFAULT_VALUE "0" /end COMPU_VTAB
/begin COMPU_VTAB _CNV_S_2_Enum_EDYNH_262_S2 "" TAB_VERB 2 0 "PT1_FILT" 1 "PT2_FILT" /end COMPU_VTAB
/begin COMPU_VTAB _CNV_S_3_Enum_EHKOR_263_S2 "" TAB_VERB 3 0 "KEINE" 1 "HKOR_NORM" 2 "HKOR_KF" /end COMPU_VTAB
/begin COMPU_VTAB _CNV_S_9_Enum_EMAPD_269_S2 "" TAB_VERB 9 0 "LMODE_DL_Simulate" 1 "FDC_DL_Simulate" 2 "FDS_BASIS_Simulate" 3 "FDS_KOMFORT_Simulate" 4 "FDS_TRAKTION_Simulate" 5 "FDS_SPORT_Simulate" 6 "FDS_SPORT_PLUS_Simulate" 7 "FDS_RACE_Simulate" 8 "FDS_ECO_Simulate" /end COMPU_VTAB
/begin COMPU_VTAB _CNV_S_6_Enum_EK0_280_S2 "" TAB_VERB 6 0 "OFFEN" 1 "ANGELEGT" 2 "DRUCKSTELLUNG" 3 "SCHLUPFGEREGELT" 4 "GEREGELTGESCHLOSSEN" 5 "GESCHLOSSEN" /end COMPU_VTAB
/begin COMPU_VTAB _CNV_S_5_Enum_EMOTS_282_S2 "" TAB_VERB 5 0 "KEIN_MOTSTART" 1 "START_SGR" 2 "START_EM" 3 "START_SGR_EM" 4 "START_RS" /end COMPU_VTAB
/begin COMPU_VTAB _CNV_S_8_Enum_E_Z_R_286_S2 "" TAB_VERB 8 0 "keine Anforderung" 1 "Rueckschaltanforderung" 2 "Hochschaltanforderung" 3 "Rueckschaltunterdrueckung" 4 "Hochschaltunterdrueckung" 5 "Funktionsschnittstelle ist nicht verfuegbar" 6 "Funktion meldet Fehler" 7 "Signal unbefuellt" /end COMPU_VTAB
/begin COMPU_VTAB _CNV_S_2_Enum_ESIGN_288_S2 "" TAB_VERB 2 0 "SIGNAL_SCHNITTSTELLE" 1 "SIGNAL_SIMULATE" /end COMPU_VTAB
/begin COMPU_VTAB _CNV_S_2_Enum_ESIGN_289_S2 "" TAB_VERB 2 0 "SIGNAL_SIMULATE" 1 "SIGNAL_SCHNITTSTELLE" /end COMPU_VTAB
/begin COMPU_VTAB _CNV_S_3_Enum_ETRPM_290_S2 "" TAB_VERB 3 0 "TRANSPORTMODUS_INAKTIV" 1 "TRANSPORTMODUS_AKTIV" 2 "SIGNAL_UEBERNAHME" /end COMPU_VTAB
/begin COMPU_VTAB _CNV_S_3_Enum_ECODA_291_S2 "" TAB_VERB 3 0 "SIGNAL_UEBERNAHME" 1 "COD_ALLRAD" 2 "COD_KEIN_ALLRAD" /end COMPU_VTAB
/begin COMPU_VTAB _CNV_S_3_Enum_ECODC_292_S2 "" TAB_VERB 3 0 "SIGNAL UEBERNAHME" 1 "COD_COS_VERBOT_0" 2 "COD_COS_VERBOT_1" DEFAULT_VALUE "2" /end COMPU_VTAB
/begin COMPU_VTAB _CNV_S_3_Enum_ECODG_293_S2 "" TAB_VERB 3 0 "SIGNAL_UEBERNAHME" 1 "COD_SPORTSCHALTER" 2 "COD_KEIN_SPORTSCHALTER" /end COMPU_VTAB
/begin COMPU_VTAB _CNV_S_3_Enum_ECODM_294_S2 "" TAB_VERB 3 0 "SIGNAL_UEBERNAHME" 1 "COD_MAB_0" 2 "COD_MAB_1" /end COMPU_VTAB
/begin COMPU_VTAB _CNV_S_3_Enum_ECODS_295_S2 "" TAB_VERB 3 0 "SIGNAL_UEBERNAHME" 1 "COD_STOPGO_0" 2 "COD_STOPGO_1" /end COMPU_VTAB
/begin COMPU_VTAB _CNV_S_3_Enum_EDRIV_296_S2 "" TAB_VERB 3 0 "SIGNAL_AUS" 1 "DRIVEDYNAMICS" 2 "DRIVELOGIC" /end COMPU_VTAB
/begin COMPU_VTAB _CNV_S_3_Enum_EABSD_297_S2 "" TAB_VERB 3 0 "ABS_DSC_OK" 1 "ABS_DSC_nOK" 2 "SIGNAL_UEBERNAHME" /end COMPU_VTAB
/begin COMPU_VTAB _CNV_S_4_Enum_EDSCI_298_S2 "" TAB_VERB 4 0 "DSC_ACTIVE" 1 "DSC_PASSIVE" 2 "DTC_ACTIVE" 3 "SIGNAL_UEBERNAHME" /end COMPU_VTAB
/begin COMPU_VTAB _CNV_S_4_Enum_EEIN__299_S2 "" TAB_VERB 4 0 "ET_KEINE" 1 "ET_1" 2 "ET_2" 3 "SIGNAL_UEBERNAHME_ET" /end COMPU_VTAB
/begin COMPU_VTAB _CNV_S_5_Enum_ESIGN_300_S2 "" TAB_VERB 5 0 "SIGNAL_PS_FREI" 1 "SIGNAL_PS_KOMFORT" 2 "SIGNAL_PS_SPORT" 3 "SIGNAL_PS_SPORT_PLUS" 4 "SIGNAL_UEBERNAHME" /end COMPU_VTAB
/begin COMPU_VTAB _CNV_S_5_Enum_ESPAR_301_S2 "" TAB_VERB 5 0 "DPFREG_NSC_AUS" 1 "DPFREG_EIN" 2 "NSC_EIN" 3 "DPFREG_NSC_EIN" 4 "SIGNAL_UEBERNAHME" /end COMPU_VTAB
/begin COMPU_VTAB _CNV_S_4_Enum_EFILT_302_S2 "" TAB_VERB 4 0 "DOWN_IN_GEW" 1 "DOWN_OUT_GEW" 2 "UP_IN_GEW" 3 "UP_OUT_GEW" /end COMPU_VTAB
/begin COMPU_VTAB _CNV_S_4_Enum_EFWSS_304_S2 "" TAB_VERB 4 0 "KEIN_BREMSE_KEIN_ANHAENGER" 1 "BREMSE_AN_KEIN_ANHAENGER" 2 "KEIN_BREMSE_MIT_ANHAENGER" 3 "BREMSE_AN_MIT_ANHAENGER" /end COMPU_VTAB
/begin COMPU_VTAB _CNV_S_3_Enum_EDMRA_307_S2 "" TAB_VERB 3 0 "DM_AB_FWS_FILT" 1 "DM_AB_FWSKOR_FILTFAST" 2 "DM_AB_FWSKOR_FILTSLOW" /end COMPU_VTAB
/begin COMPU_VTAB _CNV_S_5_Enum_EKURV_310_S2 "" TAB_VERB 5 0 "KURVETYP_NORMAL" 1 "KURVETYP_NORMAL_S_AGS" 2 "KURVETYP_SERP" 3 "KURVETYP_LDM" 4 "KURVETYP_NORMAL_TID" /end COMPU_VTAB
/begin COMPU_VTAB _CNV_S_4_Enum_EKURV_311_S2 "" TAB_VERB 4 0 "KURVEVORL_A_AGS" 1 "KURVEVORL_S_AGS" 2 "KURVEVORL_LDM" 3 "KURVEVORL_TID" /end COMPU_VTAB
/begin COMPU_VTAB _CNV_S_3_Enum_EAGST_312_S2 "" TAB_VERB 3 0 "A_AGS_KU" 1 "S_AGS_KU" 2 "TID_KU" /end COMPU_VTAB
/begin COMPU_VTAB _CNV_S_2_Enum_EK0_S_314_S2 "" TAB_VERB 2 3 "SCHLUPFGEREGELT" 5 "GESCHLOSSEN" /end COMPU_VTAB
/begin COMPU_VTAB _CNV_S_2_Enum_EDBMT_316_S2 "" TAB_VERB 2 0 "MinDrehzahl" 1 "MaxDrehzahl" /end COMPU_VTAB
/begin COMPU_VTAB _CNV_S_3_Enum_EWL_318_S2 "" TAB_VERB 3 0 "WL_inaktiv" 1 "WL1_aktiv" 2 "WL2_aktiv" /end COMPU_VTAB
/begin COMPU_VTAB _CNV_S_2_Enum_PRUEF_319_S2 "" TAB_VERB 2 0 "ADD_FKT" 1 "KOOP_FKT" /end COMPU_VTAB
/begin COMPU_VTAB _CNV_S_5_Enum_REKUP_320_S2 "" TAB_VERB 5 0 "REKUP_IDX1" 1 "REKUP_IDX2" 2 "REKUP_IDX3" 3 "REKUP_IDX4" 4 "REKUP_IDX5" /end COMPU_VTAB
/begin COMPU_VTAB _CNV_S_2_Enum_ELOWH_321_S2 "" TAB_VERB 2 0 "LOW" 1 "HIGH" /end COMPU_VTAB
/begin COMPU_VTAB _CNV_S_17_Enum_EKRIT_323_S2 "" TAB_VERB 17 0 "MAX_SEGELN" 1 "MIN_SEGELN" 2 "MAX_K0" 3 "MAX_EXC" 4 "MAX_BAUTSCHUTZ" 5 "MAX_RFWS" 6 "MIN_EXC" 7 "MIN_DPFREG" 8 "MIN_AEP" 9 "MIN_HOTMODE" 10 "MIN_RFWS" 11 "MIN_REKUPRS" 12 "MIN_ARSDYN" 13 "MIN_MOTSOLLLL" 14 "MIN_CGT" 15 "MIN_CMOPLUFT" 16 "MIN_K0" /end COMPU_VTAB
/begin COMPU_VTAB _CNV_S_2_Enum_REKUP_324_S2 "" TAB_VERB 2 0 "M_REKUP_DBM" 1 "M_MOT_STAT" /end COMPU_VTAB
/begin COMPU_VTAB _CNV_S_3_Enum_EIDX0_325_S2 "" TAB_VERB 3 0 "IDX0" 1 "IDX1" 2 "IDX2" /end COMPU_VTAB
/begin RECORD_LAYOUT _REC_S7CUR_53_s2_u2_S2 FNC_VALUES 3 SWORD COLUMN_DIR DIRECT AXIS_PTS_X 2 UWORD INDEX_INCR DIRECT NO_AXIS_PTS_X 1 UBYTE /end RECORD_LAYOUT
/begin RECORD_LAYOUT _REC_S1VAL_1_s2_S2 FNC_VALUES 1 SWORD COLUMN_DIR DIRECT /end RECORD_LAYOUT
/begin RECORD_LAYOUT _REC_S1VAL_1_u2_S2 FNC_VALUES 1 UWORD COLUMN_DIR DIRECT /end RECORD_LAYOUT
/begin RECORD_LAYOUT _REC_S1VAL_1_u1_S2 FNC_VALUES 1 UBYTE COLUMN_DIR DIRECT /end RECORD_LAYOUT
/begin RECORD_LAYOUT _REC_S1VAL_1_u4_S2 FNC_VALUES 1 ULONG COLUMN_DIR DIRECT /end RECORD_LAYOUT
/begin RECORD_LAYOUT _REC_S7CUR_53_u2_s2_S2 FNC_VALUES 3 UWORD COLUMN_DIR DIRECT AXIS_PTS_X 2 SWORD INDEX_INCR DIRECT NO_AXIS_PTS_X 1 UBYTE /end RECORD_LAYOUT
/begin RECORD_LAYOUT _REC_S7MAP_53_u2_s2_u2_S2 FNC_VALUES 5 UWORD COLUMN_DIR DIRECT AXIS_PTS_X 3 SWORD INDEX_INCR DIRECT AXIS_PTS_Y 4 UWORD INDEX_INCR DIRECT NO_AXIS_PTS_X 1 UBYTE NO_AXIS_PTS_Y 2 UBYTE /end RECORD_LAYOUT
/begin RECORD_LAYOUT _REC_A1MAP_9_u2_u1_u1_S2 FNC_VALUES 1 UWORD COLUMN_DIR DIRECT /end RECORD_LAYOUT
/begin RECORD_LAYOUT _REC_S7CUR_53_s2_s2_S2 FNC_VALUES 3 SWORD COLUMN_DIR DIRECT AXIS_PTS_X 2 SWORD INDEX_INCR DIRECT NO_AXIS_PTS_X 1 UBYTE /end RECORD_LAYOUT
/begin RECORD_LAYOUT _REC_S7MAP_53_s2_s2_s2_S2 FNC_VALUES 5 SWORD COLUMN_DIR DIRECT AXIS_PTS_X 3 SWORD INDEX_INCR DIRECT AXIS_PTS_Y 4 SWORD INDEX_INCR DIRECT NO_AXIS_PTS_X 1 UBYTE NO_AXIS_PTS_Y 2 UBYTE /end RECORD_LAYOUT
/begin RECORD_LAYOUT _REC_A1CUR_30_u1_u1_S2 FNC_VALUES 1 UBYTE COLUMN_DIR DIRECT /end RECORD_LAYOUT
/begin RECORD_LAYOUT _REC_S7MAP_53_s2_s2_u2_S2 FNC_VALUES 5 SWORD COLUMN_DIR DIRECT AXIS_PTS_X 3 SWORD INDEX_INCR DIRECT AXIS_PTS_Y 4 UWORD INDEX_INCR DIRECT NO_AXIS_PTS_X 1 UBYTE NO_AXIS_PTS_Y 2 UBYTE /end RECORD_LAYOUT
/begin RECORD_LAYOUT _REC_A1CUR_30_u4_u1_S2 FNC_VALUES 1 ULONG COLUMN_DIR DIRECT /end RECORD_LAYOUT
/begin RECORD_LAYOUT _REC_S3MAP_54_s2_u2_u1_S2 FNC_VALUES 3 SWORD ROW_DIR DIRECT AXIS_PTS_X 2 UWORD INDEX_INCR DIRECT NO_AXIS_PTS_X 1 UBYTE /end RECORD_LAYOUT
/begin RECORD_LAYOUT _REC_S7CUR_53_u2_u2_S2 FNC_VALUES 3 UWORD COLUMN_DIR DIRECT AXIS_PTS_X 2 UWORD INDEX_INCR DIRECT NO_AXIS_PTS_X 1 UBYTE /end RECORD_LAYOUT
/begin RECORD_LAYOUT _REC_A1MAP_9_s2_u1_u1_S2 FNC_VALUES 1 SWORD COLUMN_DIR DIRECT /end RECORD_LAYOUT
/begin RECORD_LAYOUT _REC_A1CUR_30_u2_u1_S2 FNC_VALUES 1 UWORD COLUMN_DIR DIRECT /end RECORD_LAYOUT
/begin RECORD_LAYOUT _REC_A1MAP_9_u1_u1_u1_S2 FNC_VALUES 1 UBYTE COLUMN_DIR DIRECT /end RECORD_LAYOUT
/begin RECORD_LAYOUT _REC_A1CUR_30_s2_u1_S2 FNC_VALUES 1 SWORD COLUMN_DIR DIRECT /end RECORD_LAYOUT
/begin RECORD_LAYOUT _REC_S3MAP_54_s2_s2_u1_S2 FNC_VALUES 3 SWORD ROW_DIR DIRECT AXIS_PTS_X 2 SWORD INDEX_INCR DIRECT NO_AXIS_PTS_X 1 UBYTE /end RECORD_LAYOUT
/begin RECORD_LAYOUT _REC_A1MAP_8_s2_u1_u1_S2 FNC_VALUES 1 SWORD ROW_DIR DIRECT /end RECORD_LAYOUT
/begin RECORD_LAYOUT _REC_A1CUR_30_u1_u2_S2 FNC_VALUES 1 UBYTE COLUMN_DIR DIRECT /end RECORD_LAYOUT
/begin RECORD_LAYOUT _REC_S3MAP_54_u2_u2_u2_S2 FNC_VALUES 3 UWORD ROW_DIR DIRECT AXIS_PTS_X 2 UWORD INDEX_INCR DIRECT NO_AXIS_PTS_X 1 UBYTE /end RECORD_LAYOUT
/begin RECORD_LAYOUT _REC_S7MAP_53_u2_u2_u2_S2 FNC_VALUES 5 UWORD COLUMN_DIR DIRECT AXIS_PTS_X 3 UWORD INDEX_INCR DIRECT AXIS_PTS_Y 4 UWORD INDEX_INCR DIRECT NO_AXIS_PTS_X 1 UBYTE NO_AXIS_PTS_Y 2 UBYTE /end RECORD_LAYOUT
/begin RECORD_LAYOUT _REC_A2AXS_31_u2_S2 AXIS_PTS_X 2 UWORD INDEX_INCR DIRECT NO_AXIS_PTS_X 1 UWORD /end RECORD_LAYOUT
/begin RECORD_LAYOUT _REC_S3MAP_54_u1_u2_u1_S2 FNC_VALUES 3 UBYTE ROW_DIR DIRECT AXIS_PTS_X 2 UWORD INDEX_INCR DIRECT NO_AXIS_PTS_X 1 UBYTE /end RECORD_LAYOUT
/begin RECORD_LAYOUT _REC_A1CUR_30_u2_u2_S2 FNC_VALUES 1 UWORD COLUMN_DIR DIRECT /end RECORD_LAYOUT
/begin RECORD_LAYOUT _REC_S7MAP_53_u2_u2_s2_S2 FNC_VALUES 5 UWORD COLUMN_DIR DIRECT AXIS_PTS_X 3 UWORD INDEX_INCR DIRECT AXIS_PTS_Y 4 SWORD INDEX_INCR DIRECT NO_AXIS_PTS_X 1 UBYTE NO_AXIS_PTS_Y 2 UBYTE /end RECORD_LAYOUT
/begin RECORD_LAYOUT _REC_S3MAP_54_u2_u2_u1_S2 FNC_VALUES 3 UWORD ROW_DIR DIRECT AXIS_PTS_X 2 UWORD INDEX_INCR DIRECT NO_AXIS_PTS_X 1 UBYTE /end RECORD_LAYOUT
/begin RECORD_LAYOUT _REC_A1MAP_8_u1_u1_u1_S2 FNC_VALUES 1 UBYTE ROW_DIR DIRECT /end RECORD_LAYOUT
/begin RECORD_LAYOUT _REC_A1MAP_8_u1_u2_u2_S2 FNC_VALUES 1 UBYTE ROW_DIR DIRECT /end RECORD_LAYOUT
/begin RECORD_LAYOUT _REC_A1MAP_8_u2_u2_u2_S2 FNC_VALUES 1 UWORD ROW_DIR DIRECT /end RECORD_LAYOUT
/begin RECORD_LAYOUT _REC_S3MAP_54_s2_s2_u2_S2 FNC_VALUES 3 SWORD ROW_DIR DIRECT AXIS_PTS_X 2 SWORD INDEX_INCR DIRECT NO_AXIS_PTS_X 1 UBYTE /end RECORD_LAYOUT
/begin RECORD_LAYOUT _REC_A1CUR_30_s4_u2_S2 FNC_VALUES 1 SLONG COLUMN_DIR DIRECT /end RECORD_LAYOUT
/begin RECORD_LAYOUT _REC_A1MAP_8_s4_u1_u1_S2 FNC_VALUES 1 SLONG ROW_DIR DIRECT /end RECORD_LAYOUT
/begin RECORD_LAYOUT _REC_A1MAP_8_s1_u2_u1_S2 FNC_VALUES 1 SBYTE ROW_DIR DIRECT /end RECORD_LAYOUT
/begin RECORD_LAYOUT _REC_A1MAP_8_u1_u1_u2_S2 FNC_VALUES 1 UBYTE ROW_DIR DIRECT /end RECORD_LAYOUT
/begin RECORD_LAYOUT _REC_S1VAL_1_s4_S2 FNC_VALUES 1 SLONG COLUMN_DIR DIRECT /end RECORD_LAYOUT
/begin RECORD_LAYOUT _REC_S7MAP_53_s2_u2_s2_S2 FNC_VALUES 5 SWORD COLUMN_DIR DIRECT AXIS_PTS_X 3 UWORD INDEX_INCR DIRECT AXIS_PTS_Y 4 SWORD INDEX_INCR DIRECT NO_AXIS_PTS_X 1 UBYTE NO_AXIS_PTS_Y 2 UBYTE /end RECORD_LAYOUT
/begin RECORD_LAYOUT _REC_S7MAP_53_u2_s2_s2_S2 FNC_VALUES 5 UWORD COLUMN_DIR DIRECT AXIS_PTS_X 3 SWORD INDEX_INCR DIRECT AXIS_PTS_Y 4 SWORD INDEX_INCR DIRECT NO_AXIS_PTS_X 1 UBYTE NO_AXIS_PTS_Y 2 UBYTE /end RECORD_LAYOUT
/begin RECORD_LAYOUT _REC_S1VAL_1_s1_S2 FNC_VALUES 1 SBYTE COLUMN_DIR DIRECT /end RECORD_LAYOUT
/begin RECORD_LAYOUT _REC_S7MAP_53_u1_s2_u2_S2 FNC_VALUES 5 UBYTE COLUMN_DIR DIRECT AXIS_PTS_X 3 SWORD INDEX_INCR DIRECT AXIS_PTS_Y 4 UWORD INDEX_INCR DIRECT NO_AXIS_PTS_X 1 UBYTE NO_AXIS_PTS_Y 2 UBYTE /end RECORD_LAYOUT
/begin RECORD_LAYOUT _REC_A1CUR_30_s2_s2_S2 FNC_VALUES 1 SWORD COLUMN_DIR DIRECT /end RECORD_LAYOUT
/begin RECORD_LAYOUT _REC_A1MAP_8_s1_s2_u1_S2 FNC_VALUES 1 SBYTE ROW_DIR DIRECT /end RECORD_LAYOUT
/begin RECORD_LAYOUT _REC_S3MAP_54_s2_u2_u2_S2 FNC_VALUES 3 SWORD ROW_DIR DIRECT AXIS_PTS_X 2 UWORD INDEX_INCR DIRECT NO_AXIS_PTS_X 1 UBYTE /end RECORD_LAYOUT
/begin RECORD_LAYOUT _REC_A1MAP_8_s1_u1_u1_S2 FNC_VALUES 1 SBYTE ROW_DIR DIRECT /end RECORD_LAYOUT
/begin RECORD_LAYOUT _REC_A1CUR_30_s2_u2_S2 FNC_VALUES 1 SWORD COLUMN_DIR DIRECT /end RECORD_LAYOUT
/end MODULE
/end PROJECT
