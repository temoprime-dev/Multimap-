ASAP2_VERSION 1 51
/begin PROJECT _929_929 "Gen2_BMW_System_Supplier_Lib"
/begin HEADER "" VERSION "C_03_03" PROJECT_NO _929_929 /end HEADER
/begin MODULE DIM ""
/begin MOD_COMMON "" BYTE_ORDER MSB_FIRST ALIGNMENT_BYTE 1 ALIGNMENT_WORD 2 ALIGNMENT_LONG 4 ALIGNMENT_FLOAT32_IEEE 4 /end MOD_COMMON
/begin MEASUREMENT iTciCompu.iPKZuFilter.x "letzter Wert" SLONG UMR___1_1_0_S6_S3 1 100 -2147483648 2147483647 DISPLAY_IDENTIFIER x.iPKZuFilter.iTciCompu ECU_ADDRESS 0xFFF8DAF0 /end MEASUREMENT
/begin MEASUREMENT iTciCompu.iPKZuFilter.letzter_ms_timer "letzter BS-Timer" UWORD UMR_MSEC__1_1_0_S6_S3 1 100 0 65535 DISPLAY_IDENTIFIER letzter_ms_timer.iPKZuFilter.iTciCompu ECU_ADDRESS 0xFFF8DAF4 /end MEASUREMENT
/begin MEASUREMENT iTciCompu.iPKAbFilter.x "letzter Wert" SLONG UMR___1_1_0_S6_S3 1 100 -2147483648 2147483647 DISPLAY_IDENTIFIER x.iPKAbFilter.iTciCompu ECU_ADDRESS 0xFFF8DAF8 /end MEASUREMENT
/begin MEASUREMENT iTciCompu.iPKAbFilter.letzter_ms_timer "letzter BS-Timer" UWORD UMR_MSEC__1_1_0_S6_S3 1 100 0 65535 DISPLAY_IDENTIFIER letzter_ms_timer.iPKAbFilter.iTciCompu ECU_ADDRESS 0xFFF8DAFC /end MEASUREMENT
/begin MEASUREMENT iTciCompu.k_ab "Abschaltende Kupplung" UBYTE Conv.cTciCompu._.k_ab_S6_S3 1 100 0 5 DISPLAY_IDENTIFIER k_ab.iTciCompu ECU_ADDRESS 0xFFF8DA6C /end MEASUREMENT
/begin MEASUREMENT iTciCompu.k_zu "Zuschaltende Kupplung" UBYTE Conv.cTciCompu._.k_zu_S6_S3 1 100 0 5 DISPLAY_IDENTIFIER k_zu.iTciCompu ECU_ADDRESS 0xFFF8DA6D /end MEASUREMENT
/begin MEASUREMENT iTciCompu.z_tci "Zustandszeiger für Berechnung Kupplungsbelastung" UBYTE Conv.cTciCompu._.z_tci_S6_S3 1 100 0 2 DISPLAY_IDENTIFIER z_tci.iTciCompu ECU_ADDRESS 0xFFF8DA6E /end MEASUREMENT
/begin MEASUREMENT iTciCompu.p_kzu_kupbel "gefilteter KZU-Druck fuer Kupplungsbelastung" SWORD UMR_BAR__1_1000_0_S6_S3 1 100 0 20 DISPLAY_IDENTIFIER p_kzu_kupbel.iTciCompu ECU_ADDRESS 0xFFF8DA70 /end MEASUREMENT
/begin MEASUREMENT iTciCompu.p_kab_kupbel "gefilteter KAB-Druck fuer Kupplungsbelastung" SWORD UMR_BAR__1_1000_0_S6_S3 1 100 0 20 DISPLAY_IDENTIFIER p_kab_kupbel.iTciCompu ECU_ADDRESS 0xFFF8DA72 /end MEASUREMENT
/begin MEASUREMENT iTciCompu.m_kzu "Kupplungsmoment an der zuschaltenden Kupplung" SWORD UMR_NM__1_1_0_S6_S3 1 100 0 1000 DISPLAY_IDENTIFIER m_kzu.iTciCompu ECU_ADDRESS 0xFFF8DA74 /end MEASUREMENT
/begin MEASUREMENT iTciCompu.m_kab "Kupplungsmoment an der abschaltenden Kupplung" SWORD UMR_NM__1_1_0_S6_S3 1 100 0 1000 DISPLAY_IDENTIFIER m_kab.iTciCompu ECU_ADDRESS 0xFFF8DA76 /end MEASUREMENT
/begin MEASUREMENT iTciCompu.nd_abs_kzu "Differenzdrehzahl an der zuschaltenden Kupplung" SWORD UMR_U_MIN_1_1_0_S6_S3 1 100 0 24000 DISPLAY_IDENTIFIER nd_abs_kzu.iTciCompu ECU_ADDRESS 0xFFF8DA78 /end MEASUREMENT
/begin MEASUREMENT iTciCompu.nd_abs_kab "Differenzdrehzahl an der abschaltenden Kupplung" SWORD UMR_U_MIN_1_1_0_S6_S3 1 100 0 24000 DISPLAY_IDENTIFIER nd_abs_kab.iTciCompu ECU_ADDRESS 0xFFF8DA7A /end MEASUREMENT
/begin MEASUREMENT iTciCompu.l_kzu "aktuelle Leistung an der zuschaltenden Kupplung" FLOAT32_IEEE UMR_KW__1_1_0_S6_S3 1 100 0 1E+037 FORMAT "%5.3" DISPLAY_IDENTIFIER l_kzu.iTciCompu ECU_ADDRESS 0xFFF8DA7C /end MEASUREMENT
/begin MEASUREMENT iTciCompu.l_kab "aktuelle Leistung an der abschaltenden Kupplung" FLOAT32_IEEE UMR_KW__1_1_0_S6_S3 1 100 0 1E+037 FORMAT "%5.3" DISPLAY_IDENTIFIER l_kab.iTciCompu ECU_ADDRESS 0xFFF8DA80 /end MEASUREMENT
/begin MEASUREMENT iTciCompu.l_kzu_max "maximale Leistung an der zuschaltenden Kupplung" FLOAT32_IEEE UMR_KW__1_1_0_S6_S3 1 100 0 1E+037 FORMAT "%5.3" DISPLAY_IDENTIFIER l_kzu_max.iTciCompu ECU_ADDRESS 0xFFF8DA84 /end MEASUREMENT
/begin MEASUREMENT iTciCompu.l_kab_max "maximale Leistung an der abschaltenden Kupplung" FLOAT32_IEEE UMR_KW__1_1_0_S6_S3 1 100 0 1E+037 FORMAT "%5.3" DISPLAY_IDENTIFIER l_kab_max.iTciCompu ECU_ADDRESS 0xFFF8DA88 /end MEASUREMENT
/begin MEASUREMENT iTciCompu.l_kzu_max_spez "maximale spezifische Reibleistung an der zuschaltenden Kupplung" FLOAT32_IEEE UMR_W_MM2_1_1_0_3_S6_S3 1 100 0 1E+037 FORMAT "%5.3" DISPLAY_IDENTIFIER l_kzu_max_spez.iTciCompu ECU_ADDRESS 0xFFF8DA8C /end MEASUREMENT
/begin MEASUREMENT iTciCompu.l_kab_max_spez "maximale spezifische Reibleistung an der abschaltenden Kupplung" FLOAT32_IEEE UMR_W_MM2_1_1_0_3_S6_S3 1 100 0 1E+037 FORMAT "%5.3" DISPLAY_IDENTIFIER l_kab_max_spez.iTciCompu ECU_ADDRESS 0xFFF8DA90 /end MEASUREMENT
/begin MEASUREMENT iTciCompu.w_kzu "aktuelle Reibarbeit an der zuschaltenden Kupplung" FLOAT32_IEEE UMR_KJ__1_1_0_S6_S3 1 100 0 1E+037 FORMAT "%5.3" DISPLAY_IDENTIFIER w_kzu.iTciCompu ECU_ADDRESS 0xFFF8DA94 /end MEASUREMENT
/begin MEASUREMENT iTciCompu.w_kab "aktuelle Reibarbeit an der abschaltenden Kupplung" FLOAT32_IEEE UMR_KJ__1_1_0_S6_S3 1 100 0 1E+037 FORMAT "%5.3" DISPLAY_IDENTIFIER w_kab.iTciCompu ECU_ADDRESS 0xFFF8DA98 /end MEASUREMENT
/begin MEASUREMENT iTciCompu.w_kzu_spez "Spezifische Reibarbeit an der zuschaltenden Kupplung" FLOAT32_IEEE UMR_J_G_1_1_0_S6_S3 1 100 0 1E+037 FORMAT "%5.3" DISPLAY_IDENTIFIER w_kzu_spez.iTciCompu ECU_ADDRESS 0xFFF8DA9C /end MEASUREMENT
/begin MEASUREMENT iTciCompu.w_kab_spez "Spezifische Reibarbeit an der abschaltenden Kupplung" FLOAT32_IEEE UMR_J_G_1_1_0_S6_S3 1 100 0 1E+037 FORMAT "%5.3" DISPLAY_IDENTIFIER w_kab_spez.iTciCompu ECU_ADDRESS 0xFFF8DAA0 /end MEASUREMENT
/begin MEASUREMENT iTciCompu.w_kzu_speicher "aktuelle Reibarbeit an der zuschaltenden Kupplung" FLOAT32_IEEE UMR_KJ__1_1_0_S6_S3 1 100 0 1E+037 FORMAT "%5.3" DISPLAY_IDENTIFIER w_kzu_speicher.iTciCompu ECU_ADDRESS 0xFFF8DAA4 /end MEASUREMENT
/begin MEASUREMENT iTciCompu.w_kab_speicher "aktuelle Reibarbeit an der abschaltenden Kupplung" FLOAT32_IEEE UMR_KJ__1_1_0_S6_S3 1 100 0 1E+037 FORMAT "%5.3" DISPLAY_IDENTIFIER w_kab_speicher.iTciCompu ECU_ADDRESS 0xFFF8DAA8 /end MEASUREMENT
/begin MEASUREMENT iTciCompu.auslastung_lkzu "Auslastung maximale Reibleistung kzu" FLOAT32_IEEE UMR_PROZENT__1_1_0_2_S6_S3 1 100 0 1E+037 FORMAT "%4.2" DISPLAY_IDENTIFIER auslastung_lkzu.iTciCompu ECU_ADDRESS 0xFFF8DAAC /end MEASUREMENT
/begin MEASUREMENT iTciCompu.auslastung_lkab "Auslastung maximale Reibleistung kab" FLOAT32_IEEE UMR_PROZENT__1_1_0_2_S6_S3 1 100 0 1E+037 FORMAT "%4.2" DISPLAY_IDENTIFIER auslastung_lkab.iTciCompu ECU_ADDRESS 0xFFF8DAB0 /end MEASUREMENT
/begin MEASUREMENT iTciCompu.auslastung_wkzu "Auslastung maximale Reibarbeit kzu" FLOAT32_IEEE UMR_PROZENT__1_1_0_2_S6_S3 1 100 0 1E+037 FORMAT "%4.2" DISPLAY_IDENTIFIER auslastung_wkzu.iTciCompu ECU_ADDRESS 0xFFF8DAB4 /end MEASUREMENT
/begin MEASUREMENT iTciCompu.auslastung_wkab "Auslastung maximale Reibarbeit kab" FLOAT32_IEEE UMR_PROZENT__1_1_0_2_S6_S3 1 100 0 1E+037 FORMAT "%4.2" DISPLAY_IDENTIFIER auslastung_wkab.iTciCompu ECU_ADDRESS 0xFFF8DAB8 /end MEASUREMENT
/begin MEASUREMENT iTciCompu.istgang_idx_merk "Gemerkter Ist-Gang für Berechnung Kupplungsauslastung bei Schaltungsende" UBYTE Conv.cTciCompu._.istgang_idx_merk_S6_S3 1 100 0 10 DISPLAY_IDENTIFIER istgang_idx_merk.iTciCompu ECU_ADDRESS 0xFFF8DABC /end MEASUREMENT
/begin MEASUREMENT iTciCompu.zielgang_sas_idx_merk "Gemerkter Ziel-Gang für Berechnung Kupplungsauslastung bei Schaltungsende" UBYTE Conv.cTciCompu._.zielgang_sas_idx_merk_S6_S3 1 100 0 10 DISPLAY_IDENTIFIER zielgang_sas_idx_merk.iTciCompu ECU_ADDRESS 0xFFF8DABD /end MEASUREMENT
/begin MEASUREMENT iTciCompu.l_kzu_int "aktuelle Leistung an der zuschaltenden Kupplung" SLONG UMR_KW__1_1000_0_S6_S3 1 100 0 2147483.647 DISPLAY_IDENTIFIER l_kzu_int.iTciCompu ECU_ADDRESS 0xFFF8DAC0 /end MEASUREMENT
/begin MEASUREMENT iTciCompu.l_kab_int "aktuelle Leistung an der abschaltenden Kupplung" SLONG UMR_KW__1_1000_0_S6_S3 1 100 0 2147483.647 DISPLAY_IDENTIFIER l_kab_int.iTciCompu ECU_ADDRESS 0xFFF8DAC4 /end MEASUREMENT
/begin MEASUREMENT iTciCompu.l_kzu_max_int "maximale Leistung an der zuschaltenden Kupplung" SLONG UMR_KW__1_1000_0_S6_S3 1 100 0 2147483.647 DISPLAY_IDENTIFIER l_kzu_max_int.iTciCompu ECU_ADDRESS 0xFFF8DAC8 /end MEASUREMENT
/begin MEASUREMENT iTciCompu.l_kab_max_int "maximale Leistung an der abschaltenden Kupplung" SLONG UMR_KW__1_1000_0_S6_S3 1 100 0 2147483.647 DISPLAY_IDENTIFIER l_kab_max_int.iTciCompu ECU_ADDRESS 0xFFF8DACC /end MEASUREMENT
/begin MEASUREMENT iTciCompu.l_kzu_max_spez_int "maximale spezifische Reibleistung an der zuschaltenden Kupplung" SWORD UMR_W_MM2_1_100_0_S6_S3 1 100 0 327.67 DISPLAY_IDENTIFIER l_kzu_max_spez_int.iTciCompu ECU_ADDRESS 0xFFF8DAD0 /end MEASUREMENT
/begin MEASUREMENT iTciCompu.l_kab_max_spez_int "maximale spezifische Reibleistung an der abschaltenden Kupplung" SWORD UMR_W_MM2_1_100_0_S6_S3 1 100 0 327.67 DISPLAY_IDENTIFIER l_kab_max_spez_int.iTciCompu ECU_ADDRESS 0xFFF8DAD2 /end MEASUREMENT
/begin MEASUREMENT iTciCompu.w_kzu_int "aktuelle Reibarbeit an der zuschaltenden Kupplung" SLONG UMR_KJ__1_1000_0_S6_S3 1 100 0 2147483.647 DISPLAY_IDENTIFIER w_kzu_int.iTciCompu ECU_ADDRESS 0xFFF8DAD4 /end MEASUREMENT
/begin MEASUREMENT iTciCompu.w_kab_int "aktuelle Reibarbeit an der abschaltenden Kupplung" SLONG UMR_KJ__1_1000_0_S6_S3 1 100 0 2147483.647 DISPLAY_IDENTIFIER w_kab_int.iTciCompu ECU_ADDRESS 0xFFF8DAD8 /end MEASUREMENT
/begin MEASUREMENT iTciCompu.w_kzu_spez_int "Spezifische Reibarbeit an der zuschaltenden Kupplung" SWORD UMR_J_G_1_100_0_S6_S3 1 100 0 327.67 DISPLAY_IDENTIFIER w_kzu_spez_int.iTciCompu ECU_ADDRESS 0xFFF8DADC /end MEASUREMENT
/begin MEASUREMENT iTciCompu.w_kab_spez_int "Spezifische Reibarbeit an der abschaltenden Kupplung" SWORD UMR_J_G_1_100_0_S6_S3 1 100 0 327.67 DISPLAY_IDENTIFIER w_kab_spez_int.iTciCompu ECU_ADDRESS 0xFFF8DADE /end MEASUREMENT
/begin MEASUREMENT iTciCompu.auslastung_lkzu_int "Auslastung maximale Reibleistung kzu" UWORD UMR_PROZENT__1_100_0_S6_S3 1 100 0 655.35 DISPLAY_IDENTIFIER auslastung_lkzu_int.iTciCompu ECU_ADDRESS 0xFFF8DAE0 /end MEASUREMENT
/begin MEASUREMENT iTciCompu.auslastung_lkab_int "Auslastung maximale Reibleistung kab" UWORD UMR_PROZENT__1_100_0_S6_S3 1 100 0 655.35 DISPLAY_IDENTIFIER auslastung_lkab_int.iTciCompu ECU_ADDRESS 0xFFF8DAE2 /end MEASUREMENT
/begin MEASUREMENT iTciCompu.auslastung_wkzu_int "Auslastung maximale Reibarbeit kzu" UWORD UMR_PROZENT__1_100_0_S6_S3 1 100 0 655.35 DISPLAY_IDENTIFIER auslastung_wkzu_int.iTciCompu ECU_ADDRESS 0xFFF8DAE4 /end MEASUREMENT
/begin MEASUREMENT iTciCompu.auslastung_wkab_int "Auslastung maximale Reibarbeit kab" UWORD UMR_PROZENT__1_100_0_S6_S3 1 100 0 655.35 DISPLAY_IDENTIFIER auslastung_wkab_int.iTciCompu ECU_ADDRESS 0xFFF8DAE6 /end MEASUREMENT
/begin MEASUREMENT iTciCompu.c_kupplung_gestz "Maximale Kupplungstemperatur aller geschlossenen Schaltelementen in [°C]" SWORD UMR_GRADC__1_1_0_S6_S3 1 100 -40 500 DISPLAY_IDENTIFIER c_kupplung_gestz.iTciCompu ECU_ADDRESS 0xFFF8DAE8 /end MEASUREMENT
/begin MEASUREMENT iTciCompu.flag_ende_kab_ber_erreicht "Flag: Ende der Kupplungsbelastungsberechnung für die KAB erreicht" UBYTE Conv.cTciCompu._.flag_ende_kab_ber_erreicht_S6_S3 1 100 0 1 BIT_MASK 0x1 DISPLAY_IDENTIFIER flag_ende_kab_ber_erreicht.iTciCompu ECU_ADDRESS 0xFFF8DAEA /end MEASUREMENT
/begin MEASUREMENT iTciCompu.flag_ende_kzu_ber_erreicht "Flag: Ende der Kupplungsbelastungsberechnung für die KZU erreicht" UBYTE Conv.cTciCompu._.flag_ende_kzu_ber_erreicht_S6_S3 1 100 0 1 BIT_MASK 0x1 DISPLAY_IDENTIFIER flag_ende_kzu_ber_erreicht.iTciCompu ECU_ADDRESS 0xFFF8DAEB /end MEASUREMENT
/begin MEASUREMENT iTciCompu.c_kupplung_max "Maximale Kupplungstemperatur aller Schaltelemente in [°C]" SWORD UMR_GRADC__1_1_0_S6_S3 1 100 -40 500 DISPLAY_IDENTIFIER c_kupplung_max.iTciCompu ECU_ADDRESS 0xFFF8DAEC /end MEASUREMENT
/begin MEASUREMENT iTciCompu.kupplung_max "Kupplung mit maximaler Temperatur" UBYTE Conv.cTciCompu._.kupplung_max_S6_S3 1 100 0 5 DISPLAY_IDENTIFIER kupplung_max.iTciCompu ECU_ADDRESS 0xFFF8DAEE /end MEASUREMENT
/begin MEASUREMENT iTciCompu.schaltart_sas_red_tci "Aktuelle Schaltart nur auf HS, RS, GE reduziert" UBYTE Conv.cTciCompu._.schaltart_sas_red_tci_S6_S3 1 100 1 3 DISPLAY_IDENTIFIER schaltart_sas_red_tci.iTciCompu ECU_ADDRESS 0xFFF8DAEF /end MEASUREMENT
/begin MEASUREMENT iTempMKupA.PT2CKupplung.x "Filterwert" FLOAT32_IEEE UMR___1_1_0_S6_S3 1 100 -2147483648 2147483647 FORMAT "%4.2" DISPLAY_IDENTIFIER x.PT2CKupplung.iTempMKupA ECU_ADDRESS 0xFFF8DB18 /end MEASUREMENT
/begin MEASUREMENT iTempMKupA.PT2CKupplung.xp "Ableitung vom Eingangswert" FLOAT32_IEEE UMR__SEC_1_1_0_S6_S3 1 100 -2147483648 2147483647 FORMAT "%4.2" DISPLAY_IDENTIFIER xp.PT2CKupplung.iTempMKupA ECU_ADDRESS 0xFFF8DB1C /end MEASUREMENT
/begin MEASUREMENT iTempMKupA.c_kupplung "Kupplungstemperatur in [°C]" SWORD UMR_GRADC__1_1_0_S6_S3 1 100 -40 500 DISPLAY_IDENTIFIER c_kupplung.iTempMKupA ECU_ADDRESS 0xFFF8DB08 /end MEASUREMENT
/begin MEASUREMENT iTempMKupA.kupplung "aktive Kupplung" UBYTE Conv.cTciTempM._.kupplung_S6_S3 1 100 0 5 DISPLAY_IDENTIFIER kupplung.iTempMKupA ECU_ADDRESS 0xFFF8DB0A /end MEASUREMENT
/begin MEASUREMENT iTempMKupA.q_ab_kupplung "Von der Kupplung an Kühlöl abgegebener Wärmestrom" FLOAT32_IEEE UMR_K_SEC_1_1_0_S6_S3 1 100 -1E+037 1E+037 FORMAT "%4.2" DISPLAY_IDENTIFIER q_ab_kupplung.iTempMKupA ECU_ADDRESS 0xFFF8DB0C /end MEASUREMENT
/begin MEASUREMENT iTempMKupA.q_zu_kupplung "Zugeführter Wärmestrom an Kupplung" FLOAT32_IEEE UMR_K_SEC_1_1_0_S6_S3 1 100 -1E+037 1E+037 FORMAT "%4.2" DISPLAY_IDENTIFIER q_zu_kupplung.iTempMKupA ECU_ADDRESS 0xFFF8DB10 /end MEASUREMENT
/begin MEASUREMENT iTempMKupA.c_kupplung_roh "Kupplungstemperatur in [°C]" FLOAT32_IEEE UMR_GRADC__1_1_0_S6_S3 1 100 -1E+037 1E+037 DISPLAY_IDENTIFIER c_kupplung_roh.iTempMKupA ECU_ADDRESS 0xFFF8DB14 /end MEASUREMENT
/begin MEASUREMENT iTempMKupC.PT2CKupplung.x "Filterwert" FLOAT32_IEEE UMR___1_1_0_S6_S3 1 100 -2147483648 2147483647 FORMAT "%4.2" DISPLAY_IDENTIFIER x.PT2CKupplung.iTempMKupC ECU_ADDRESS 0xFFF8DB34 /end MEASUREMENT
/begin MEASUREMENT iTempMKupC.PT2CKupplung.xp "Ableitung vom Eingangswert" FLOAT32_IEEE UMR__SEC_1_1_0_S6_S3 1 100 -2147483648 2147483647 FORMAT "%4.2" DISPLAY_IDENTIFIER xp.PT2CKupplung.iTempMKupC ECU_ADDRESS 0xFFF8DB38 /end MEASUREMENT
/begin MEASUREMENT iTempMKupC.c_kupplung "Kupplungstemperatur in [°C]" SWORD UMR_GRADC__1_1_0_S6_S3 1 100 -40 500 DISPLAY_IDENTIFIER c_kupplung.iTempMKupC ECU_ADDRESS 0xFFF8DB24 /end MEASUREMENT
/begin MEASUREMENT iTempMKupC.kupplung "aktive Kupplung" UBYTE Conv.cTciTempM._.kupplung_S6_S3 1 100 0 5 DISPLAY_IDENTIFIER kupplung.iTempMKupC ECU_ADDRESS 0xFFF8DB26 /end MEASUREMENT
/begin MEASUREMENT iTempMKupC.q_ab_kupplung "Von der Kupplung an Kühlöl abgegebener Wärmestrom" FLOAT32_IEEE UMR_K_SEC_1_1_0_S6_S3 1 100 -1E+037 1E+037 FORMAT "%4.2" DISPLAY_IDENTIFIER q_ab_kupplung.iTempMKupC ECU_ADDRESS 0xFFF8DB28 /end MEASUREMENT
/begin MEASUREMENT iTempMKupC.q_zu_kupplung "Zugeführter Wärmestrom an Kupplung" FLOAT32_IEEE UMR_K_SEC_1_1_0_S6_S3 1 100 -1E+037 1E+037 FORMAT "%4.2" DISPLAY_IDENTIFIER q_zu_kupplung.iTempMKupC ECU_ADDRESS 0xFFF8DB2C /end MEASUREMENT
/begin MEASUREMENT iTempMKupC.c_kupplung_roh "Kupplungstemperatur in [°C]" FLOAT32_IEEE UMR_GRADC__1_1_0_S6_S3 1 100 -1E+037 1E+037 DISPLAY_IDENTIFIER c_kupplung_roh.iTempMKupC ECU_ADDRESS 0xFFF8DB30 /end MEASUREMENT
/begin MEASUREMENT iTempMKupD.PT2CKupplung.x "Filterwert" FLOAT32_IEEE UMR___1_1_0_S6_S3 1 100 -2147483648 2147483647 FORMAT "%4.2" DISPLAY_IDENTIFIER x.PT2CKupplung.iTempMKupD ECU_ADDRESS 0xFFF8DB50 /end MEASUREMENT
/begin MEASUREMENT iTempMKupD.PT2CKupplung.xp "Ableitung vom Eingangswert" FLOAT32_IEEE UMR__SEC_1_1_0_S6_S3 1 100 -2147483648 2147483647 FORMAT "%4.2" DISPLAY_IDENTIFIER xp.PT2CKupplung.iTempMKupD ECU_ADDRESS 0xFFF8DB54 /end MEASUREMENT
/begin MEASUREMENT iTempMKupD.c_kupplung "Kupplungstemperatur in [°C]" SWORD UMR_GRADC__1_1_0_S6_S3 1 100 -40 500 DISPLAY_IDENTIFIER c_kupplung.iTempMKupD ECU_ADDRESS 0xFFF8DB40 /end MEASUREMENT
/begin MEASUREMENT iTempMKupD.kupplung "aktive Kupplung" UBYTE Conv.cTciTempM._.kupplung_S6_S3 1 100 0 5 DISPLAY_IDENTIFIER kupplung.iTempMKupD ECU_ADDRESS 0xFFF8DB42 /end MEASUREMENT
/begin MEASUREMENT iTempMKupD.q_ab_kupplung "Von der Kupplung an Kühlöl abgegebener Wärmestrom" FLOAT32_IEEE UMR_K_SEC_1_1_0_S6_S3 1 100 -1E+037 1E+037 FORMAT "%4.2" DISPLAY_IDENTIFIER q_ab_kupplung.iTempMKupD ECU_ADDRESS 0xFFF8DB44 /end MEASUREMENT
/begin MEASUREMENT iTempMKupD.q_zu_kupplung "Zugeführter Wärmestrom an Kupplung" FLOAT32_IEEE UMR_K_SEC_1_1_0_S6_S3 1 100 -1E+037 1E+037 FORMAT "%4.2" DISPLAY_IDENTIFIER q_zu_kupplung.iTempMKupD ECU_ADDRESS 0xFFF8DB48 /end MEASUREMENT
/begin MEASUREMENT iTempMKupD.c_kupplung_roh "Kupplungstemperatur in [°C]" FLOAT32_IEEE UMR_GRADC__1_1_0_S6_S3 1 100 -1E+037 1E+037 DISPLAY_IDENTIFIER c_kupplung_roh.iTempMKupD ECU_ADDRESS 0xFFF8DB4C /end MEASUREMENT
/begin MEASUREMENT iTempMKupE.PT2CKupplung.x "Filterwert" FLOAT32_IEEE UMR___1_1_0_S6_S3 1 100 -2147483648 2147483647 FORMAT "%4.2" DISPLAY_IDENTIFIER x.PT2CKupplung.iTempMKupE ECU_ADDRESS 0xFFF8DB6C /end MEASUREMENT
/begin MEASUREMENT iTempMKupE.PT2CKupplung.xp "Ableitung vom Eingangswert" FLOAT32_IEEE UMR__SEC_1_1_0_S6_S3 1 100 -2147483648 2147483647 FORMAT "%4.2" DISPLAY_IDENTIFIER xp.PT2CKupplung.iTempMKupE ECU_ADDRESS 0xFFF8DB70 /end MEASUREMENT
/begin MEASUREMENT iTempMKupE.c_kupplung "Kupplungstemperatur in [°C]" SWORD UMR_GRADC__1_1_0_S6_S3 1 100 -40 500 DISPLAY_IDENTIFIER c_kupplung.iTempMKupE ECU_ADDRESS 0xFFF8DB5C /end MEASUREMENT
/begin MEASUREMENT iTempMKupE.kupplung "aktive Kupplung" UBYTE Conv.cTciTempM._.kupplung_S6_S3 1 100 0 5 DISPLAY_IDENTIFIER kupplung.iTempMKupE ECU_ADDRESS 0xFFF8DB5E /end MEASUREMENT
/begin MEASUREMENT iTempMKupE.q_ab_kupplung "Von der Kupplung an Kühlöl abgegebener Wärmestrom" FLOAT32_IEEE UMR_K_SEC_1_1_0_S6_S3 1 100 -1E+037 1E+037 FORMAT "%4.2" DISPLAY_IDENTIFIER q_ab_kupplung.iTempMKupE ECU_ADDRESS 0xFFF8DB60 /end MEASUREMENT
/begin MEASUREMENT iTempMKupE.q_zu_kupplung "Zugeführter Wärmestrom an Kupplung" FLOAT32_IEEE UMR_K_SEC_1_1_0_S6_S3 1 100 -1E+037 1E+037 FORMAT "%4.2" DISPLAY_IDENTIFIER q_zu_kupplung.iTempMKupE ECU_ADDRESS 0xFFF8DB64 /end MEASUREMENT
/begin MEASUREMENT iTempMKupE.c_kupplung_roh "Kupplungstemperatur in [°C]" FLOAT32_IEEE UMR_GRADC__1_1_0_S6_S3 1 100 -1E+037 1E+037 DISPLAY_IDENTIFIER c_kupplung_roh.iTempMKupE ECU_ADDRESS 0xFFF8DB68 /end MEASUREMENT
/begin MEASUREMENT iKorSaste.kup_kzu "Kupplungsnr. der zuschaltenden Kupplung" UBYTE Conv.cKorSaste._.kup_kzu_S6_S3 1 100 0 5 DISPLAY_IDENTIFIER kup_kzu.iKorSaste ECU_ADDRESS 0xFFF8A126 /end MEASUREMENT
/begin MEASUREMENT iKorSaste.kup_kab "Kupplungsnr. der abschaltenden Kupplung" UBYTE Conv.cKorSaste._.kup_kab_S6_S3 1 100 0 5 DISPLAY_IDENTIFIER kup_kab.iKorSaste ECU_ADDRESS 0xFFF8A127 /end MEASUREMENT
/begin MEASUREMENT iKorSaste.kup_ge1 "Kupplungsnr. der ersten GE-Kupplung (Kraftschliessende)" UBYTE Conv.cKorSaste._.kup_ge1_S6_S3 1 100 0 5 DISPLAY_IDENTIFIER kup_ge1.iKorSaste ECU_ADDRESS 0xFFF8A128 /end MEASUREMENT
/begin MEASUREMENT iKorSaste.kup_ge2 "Kupplungsnr. der zweiten GE-Kupplung (1. nicht Kraftschliessende)" UBYTE Conv.cKorSaste._.kup_ge2_S6_S3 1 100 0 5 DISPLAY_IDENTIFIER kup_ge2.iKorSaste ECU_ADDRESS 0xFFF8A129 /end MEASUREMENT
/begin MEASUREMENT iKorSaste.kup_ge3 "Kupplungsnr. der dritten GE-Kupplung (2. nicht Kraftschliessende)" UBYTE Conv.cKorSaste._.kup_ge3_S6_S3 1 100 0 5 DISPLAY_IDENTIFIER kup_ge3.iKorSaste ECU_ADDRESS 0xFFF8A12A /end MEASUREMENT
/begin MEASUREMENT iKorSaste.kup_vkzu "Kupplungsnr. der vorbereitenden zuschaltenden Kupplung" UBYTE Conv.cKorSaste._.kup_vkzu_S6_S3 1 100 0 5 DISPLAY_IDENTIFIER kup_vkzu.iKorSaste ECU_ADDRESS 0xFFF8A12B /end MEASUREMENT
/begin MEASUREMENT iKorSaste.kup_vkab "Kupplungsnr. der vorbereitenden abschaltenden Kupplung" UBYTE Conv.cKorSaste._.kup_vkab_S6_S3 1 100 0 5 DISPLAY_IDENTIFIER kup_vkab.iKorSaste ECU_ADDRESS 0xFFF8A12C /end MEASUREMENT
/begin MEASUREMENT iKorSaste.zielgang_vorbereitung "Zielgang der vorbereitenden Schaltung" SBYTE Conv.cKorSaste._.zielgang_vorbereitung_S6_S3 1 100 -1 8 DISPLAY_IDENTIFIER zielgang_vorbereitung.iKorSaste ECU_ADDRESS 0xFFF8A12D /end MEASUREMENT
/begin MEASUREMENT iKorSaste.zielgang_vorb_angefordert "Flag ob vorbereitete Schaltung angefordert ist" UBYTE Conv.cKorSaste._.zielgang_vorb_angefordert_S6_S3 1 100 0 1 BIT_MASK 0x1 DISPLAY_IDENTIFIER zielgang_vorb_angefordert.iKorSaste ECU_ADDRESS 0xFFF8A12E /end MEASUREMENT
/begin MEASUREMENT iKorSaste.n_tmax "maximale Turbinendrehzahl" UWORD UMR_U_MIN_1_1_0_S6_S3 1 100 0 8160 DISPLAY_IDENTIFIER n_tmax.iKorSaste ECU_ADDRESS 0xFFF8A130 /end MEASUREMENT
/begin MEASUREMENT iKorSaste.me_sas_status "Status des Motoreingriffs waehrend Schaltungen" UBYTE Conv.cKorSaste._.me_sas_status_S6_S3 1 100 0 3 DISPLAY_IDENTIFIER me_sas_status.iKorSaste ECU_ADDRESS 0xFFF8A132 /end MEASUREMENT
/begin MEASUREMENT iKorSaste.schaltungsabbruch_durch_ga "Flag ob Schaltungsabbruch durch Gangauslegen vorliegt" UBYTE Conv.cKorSaste._.schaltungsabbruch_durch_ga_S6_S3 1 100 0 1 BIT_MASK 0x1 DISPLAY_IDENTIFIER schaltungsabbruch_durch_ga.iKorSaste ECU_ADDRESS 0xFFF8A133 /end MEASUREMENT
/begin MEASUREMENT iKorSaste.m_t_mepos "Maximalwert von m_mot und m_motist" SWORD UMR_NM__1_1_0_S6_S3 1 100 -400 1640 DISPLAY_IDENTIFIER m_t_mepos.iKorSaste ECU_ADDRESS 0xFFF8A134 /end MEASUREMENT
/begin MEASUREMENT iKorSaste.start_vorbereitung_abgefragt "Flag ob die schaltungsvorbereitung mind.einmal in der Schaltung durchlaufen wurde" UBYTE Conv.cKorSaste._.start_vorbereitung_abgefragt_S6_S3 1 100 0 1 BIT_MASK 0x1 DISPLAY_IDENTIFIER start_vorbereitung_abgefragt.iKorSaste ECU_ADDRESS 0xFFF8A136 /end MEASUREMENT
/begin MEASUREMENT iKorSaste.n_motmax "maximale Motordrehzahl" UWORD UMR_U_MIN_1_1_0_S6_S3 1 100 0 8160 DISPLAY_IDENTIFIER n_motmax.iKorSaste ECU_ADDRESS 0xFFF8A138 /end MEASUREMENT
/begin MEASUREMENT iKorSaste.timer_ende_ga "Timer Ende Gang auslegen" UWORD UMR_MSEC__10_1_0_S6_S3 1 100 0 655350 DISPLAY_IDENTIFIER timer_ende_ga.iKorSaste ECU_ADDRESS 0xFFF8A13A /end MEASUREMENT
/begin MEASUREMENT iKorSaste.z_zielg_vorb "Zustand zielgang_vorbereitung" UBYTE Conv.cKorSaste._.z_zielg_vorb_S6_S3 1 100 0 5 DISPLAY_IDENTIFIER z_zielg_vorb.iKorSaste ECU_ADDRESS 0xFFF8A13C /end MEASUREMENT
/begin MEASUREMENT iKorSaste.timer_zzielgvorb "Zustandstimer zielgang_vorbereitung" UBYTE UMR_MSEC__10_1_0_S6_S3 1 100 0 2550 DISPLAY_IDENTIFIER timer_zzielgvorb.iKorSaste ECU_ADDRESS 0xFFF8A13D /end MEASUREMENT
/begin MEASUREMENT iKorSaste.kup_kabvkzu "Merker fuer KAB die voruebergehend durch VKZU-ABlauf angesteuert wird" UBYTE Conv.cKorSaste._.kup_kabvkzu_S6_S3 1 100 0 5 DISPLAY_IDENTIFIER kup_kabvkzu.iKorSaste ECU_ADDRESS 0xFFF8A13E /end MEASUREMENT
/begin MEASUREMENT iKorSaste.f_start_vorb_mrs_nicht_mehr_erlaubt "Flag ob eine MRS anforderung noch vorbereitet werden darf" UBYTE Conv.cKorSaste._.f_start_vorb_mrs_nicht_mehr_erlaubt_S6_S3 1 100 0 1 BIT_MASK 0x1 DISPLAY_IDENTIFIER f_start_vorb_mrs_nicht_mehr_erlaubt.iKorSaste ECU_ADDRESS 0xFFF8A13F /end MEASUREMENT
/begin MEASUREMENT iKorSaste.zaehler_zzielgvorb "Zustandszaehler zielgang_vorbereitung" UBYTE UMR___1_1_0_S6_S3 1 100 0 255 DISPLAY_IDENTIFIER zaehler_zzielgvorb.iKorSaste ECU_ADDRESS 0xFFF8A140 /end MEASUREMENT
/begin MEASUREMENT iKorSaste.t_zzielgvorb "Zustandszeitdauer zielgang_vorbereitung" SWORD UMR_MSEC__10_1_0_S6_S3 1 100 -327680 327670 DISPLAY_IDENTIFIER t_zzielgvorb.iKorSaste ECU_ADDRESS 0xFFF8A142 /end MEASUREMENT
/begin MEASUREMENT iSasStrat.flag_red_bef_aush_sch_angef "FLAG: Fkt. reduzierte Befuellung ausserh Schaltung angef." UBYTE Conv.cSasStrat._.flag_red_bef_aush_sch_angef_S6_S3 1 100 0 1 BIT_MASK 0x1 DISPLAY_IDENTIFIER flag_red_bef_aush_sch_angef.iSasStrat ECU_ADDRESS 0xFFF8A1AE /end MEASUREMENT
/begin MEASUREMENT iSasStrat.flag_red_bef_inh_sch_angef "FLAG: Fkt. reduzierte Befuellung innerh Schaltung angef." UBYTE Conv.cSasStrat._.flag_red_bef_inh_sch_angef_S6_S3 1 100 0 1 BIT_MASK 0x1 DISPLAY_IDENTIFIER flag_red_bef_inh_sch_angef.iSasStrat ECU_ADDRESS 0xFFF8A1AF /end MEASUREMENT
/begin MEASUREMENT iSasStrat.flag_opt_bef_aush_sch_angef "FLAG: Fkt. optimierte Befuellung ausserh Schaltung angef." UBYTE Conv.cSasStrat._.flag_opt_bef_aush_sch_angef_S6_S3 1 100 0 1 BIT_MASK 0x1 DISPLAY_IDENTIFIER flag_opt_bef_aush_sch_angef.iSasStrat ECU_ADDRESS 0xFFF8A1B0 /end MEASUREMENT
/begin MEASUREMENT iSasStrat.flag_opt_bef_inh_sch_angef "FLAG: Fkt. optimierte Befuellung innerh Schaltung angef." UBYTE Conv.cSasStrat._.flag_opt_bef_inh_sch_angef_S6_S3 1 100 0 1 BIT_MASK 0x1 DISPLAY_IDENTIFIER flag_opt_bef_inh_sch_angef.iSasStrat ECU_ADDRESS 0xFFF8A1B1 /end MEASUREMENT
/begin MEASUREMENT iSasStrat.f_sltsf_estart "FLAG: Sfkt Leerlaufen Kolbenraum nach EStart ist aktiv" UBYTE Conv.cSasStrat._.f_sltsf_estart_S6_S3 1 100 0 1 BIT_MASK 0x1 DISPLAY_IDENTIFIER f_sltsf_estart.iSasStrat ECU_ADDRESS 0xFFF8A1B2 /end MEASUREMENT
/begin MEASUREMENT iSasStrat.timer_sltsf_estart "timer der mit Ende eines GE mit Estart loslaeuft" UWORD UMR_MSEC__10_1_0_S6_S3 1 100 0 655350 DISPLAY_IDENTIFIER timer_sltsf_estart.iSasStrat ECU_ADDRESS 0xFFF8A1B4 /end MEASUREMENT
/begin MEASUREMENT iSasStrat.timer_sltsf_ts_estart "timer der mit n_mot < NS_ESTART loslaueft" UWORD UMR_MSEC__10_1_0_S6_S3 1 100 0 655350 DISPLAY_IDENTIFIER timer_sltsf_ts_estart.iSasStrat ECU_ADDRESS 0xFFF8A1B6 /end MEASUREMENT
/begin MEASUREMENT iSasStrat.f_nmot_ts_estart "Flag n_mot < NS_ESTART fuer TS_ESTART" UBYTE Conv.cSasStrat._.f_nmot_ts_estart_S6_S3 1 100 0 1 BIT_MASK 0x1 DISPLAY_IDENTIFIER f_nmot_ts_estart.iSasStrat ECU_ADDRESS 0xFFF8A1B8 /end MEASUREMENT
/begin MEASUREMENT iSasStrat.q_verfuegbar_rest "verfügbares Restölvolumen" SWORD UMR_LITER_MIN_1_10_0_S6_S3 1 100 -80 20 DISPLAY_IDENTIFIER q_verfuegbar_rest.iSasStrat ECU_ADDRESS 0xFFF8A1BA /end MEASUREMENT
/begin MEASUREMENT iSasStrat.q_fuellred "Grenze des verfügbaren Restölvolumen" SWORD UMR_LITER_MIN_1_10_0_S6_S3 1 100 -80 20 DISPLAY_IDENTIFIER q_fuellred.iSasStrat ECU_ADDRESS 0xFFF8A1BC /end MEASUREMENT
/begin MEASUREMENT iSasStrat.ber_red_durch_sf_notwendig "Berechnung Red Befuellung durch SF notwendig" UBYTE Conv.cSasStrat._.ber_red_durch_sf_notwendig_S6_S3 1 100 0 1 BIT_MASK 0x1 DISPLAY_IDENTIFIER ber_red_durch_sf_notwendig.iSasStrat ECU_ADDRESS 0xFFF8A1BE /end MEASUREMENT
/begin MEASUREMENT iSasKflwe.p_kab_kflw_speicher.letzter_wert "Speichert den letzten Eingangswert" FLOAT32_IEEE UMR___1_1_0_S6_S3 1 100 -1E+037 1E+037 FORMAT "%4.2" DISPLAY_IDENTIFIER letzter_wert.p_kab_kflw_speicher.iSasKflwe ECU_ADDRESS 0xFFF8D590 /end MEASUREMENT
/begin MEASUREMENT iSasKflwe.p_kab_kflw_speicher.letzter_ms_timer "Speichert den letzten BS-Timer" UWORD UMR_MSEC__1_1_0_S6_S3 1 100 0 65535 DISPLAY_IDENTIFIER letzter_ms_timer.p_kab_kflw_speicher.iSasKflwe ECU_ADDRESS 0xFFF8D594 /end MEASUREMENT
/begin MEASUREMENT iSasKflwe.p_kab_kflw_speicher.minimum "Minimum Begrenzung" FLOAT32_IEEE UMR___1_1_0_S6_S3 1 100 -1E+037 1E+037 FORMAT "%4.2" DISPLAY_IDENTIFIER minimum.p_kab_kflw_speicher.iSasKflwe ECU_ADDRESS 0xFFF8D598 /end MEASUREMENT
/begin MEASUREMENT iSasKflwe.p_kab_kflw_speicher.maximum "Maximum Begrenzung" FLOAT32_IEEE UMR___1_1_0_S6_S3 1 100 -1E+037 1E+037 FORMAT "%4.2" DISPLAY_IDENTIFIER maximum.p_kab_kflw_speicher.iSasKflwe ECU_ADDRESS 0xFFF8D59C /end MEASUREMENT
/begin MEASUREMENT iSasKflwe.p_kab_kflw2_speicher.letzter_wert "Speichert den letzten Eingangswert" FLOAT32_IEEE UMR___1_1_0_S6_S3 1 100 -1E+037 1E+037 FORMAT "%4.2" DISPLAY_IDENTIFIER letzter_wert.p_kab_kflw2_speicher.iSasKflwe ECU_ADDRESS 0xFFF8D5A8 /end MEASUREMENT
/begin MEASUREMENT iSasKflwe.p_kab_kflw2_speicher.letzter_ms_timer "Speichert den letzten BS-Timer" UWORD UMR_MSEC__1_1_0_S6_S3 1 100 0 65535 DISPLAY_IDENTIFIER letzter_ms_timer.p_kab_kflw2_speicher.iSasKflwe ECU_ADDRESS 0xFFF8D5AC /end MEASUREMENT
/begin MEASUREMENT iSasKflwe.p_kab_kflw2_speicher.minimum "Minimum Begrenzung" FLOAT32_IEEE UMR___1_1_0_S6_S3 1 100 -1E+037 1E+037 FORMAT "%4.2" DISPLAY_IDENTIFIER minimum.p_kab_kflw2_speicher.iSasKflwe ECU_ADDRESS 0xFFF8D5B0 /end MEASUREMENT
/begin MEASUREMENT iSasKflwe.p_kab_kflw2_speicher.maximum "Maximum Begrenzung" FLOAT32_IEEE UMR___1_1_0_S6_S3 1 100 -1E+037 1E+037 FORMAT "%4.2" DISPLAY_IDENTIFIER maximum.p_kab_kflw2_speicher.iSasKflwe ECU_ADDRESS 0xFFF8D5B4 /end MEASUREMENT
/begin MEASUREMENT iSasKflwe.p_kab1_kflw "Druck 1. abschaltende Kupplung bei schnellem DNR/RND" SWORD UMR_BAR__1_1000_0_S6_S3 1 100 0 20 DISPLAY_IDENTIFIER p_kab1_kflw.iSasKflwe ECU_ADDRESS 0xFFF8D580 /end MEASUREMENT
/begin MEASUREMENT iSasKflwe.p_kab2_kflw "Druck 2. abschaltende Kupplung bei schnellem DNR/RND" SWORD UMR_BAR__1_1000_0_S6_S3 1 100 0 20 DISPLAY_IDENTIFIER p_kab2_kflw.iSasKflwe ECU_ADDRESS 0xFFF8D582 /end MEASUREMENT
/begin MEASUREMENT iSasKflwe.z_reversierfkt "Zustand Reversierfunktion (RND oder DNR aktiv)" UBYTE Conv.cSasKflwe._.z_reversierfkt_S6_S3 1 100 0 2 DISPLAY_IDENTIFIER z_reversierfkt.iSasKflwe ECU_ADDRESS 0xFFF8D584 /end MEASUREMENT
/begin MEASUREMENT iSasKflwe.kup1_kflw "1. abschaltende Kupplung bei schnellem DNR/RND" UBYTE Conv.cSasKflwe._.kup1_kflw_S6_S3 1 100 0 5 DISPLAY_IDENTIFIER kup1_kflw.iSasKflwe ECU_ADDRESS 0xFFF8D585 /end MEASUREMENT
/begin MEASUREMENT iSasKflwe.kup2_kflw "2. abschaltende Kupplung bei schnellem DNR/RND" UBYTE Conv.cSasKflwe._.kup2_kflw_S6_S3 1 100 0 5 DISPLAY_IDENTIFIER kup2_kflw.iSasKflwe ECU_ADDRESS 0xFFF8D586 /end MEASUREMENT
/begin MEASUREMENT iSasKflwe.nd_nmot_nt_skw "Differenzdrehzahl (n_mot - n_t)" SWORD UMR_U_MIN_1_1_0_S6_S3 1 100 -16320 16320 DISPLAY_IDENTIFIER nd_nmot_nt_skw.iSasKflwe ECU_ADDRESS 0xFFF8D588 /end MEASUREMENT
/begin MEASUREMENT iSasKflwe.timer_dnrrnd_max_zeit_rampen "Zustandstimer" UBYTE UMR_MSEC__10_1_0_S6_S3 1 100 0 2550 DISPLAY_IDENTIFIER timer_dnrrnd_max_zeit_rampen.iSasKflwe ECU_ADDRESS 0xFFF8D58A /end MEASUREMENT
/begin MEASUREMENT iMoeMesaf.filter_spez_me.start_wert "Startwert" SWORD UMR___1_1_0_S6_S3 1 100 -32768 32767 DISPLAY_IDENTIFIER start_wert.filter_spez_me.iMoeMesaf ECU_ADDRESS 0xFFF8D55C /end MEASUREMENT
/begin MEASUREMENT iMoeMesaf.filter_spez_me.x "normierter letzter Wert (0 bis 1)" SLONG UMR___1_1_0_S6_S3 1 100 -2147483648 2147483647 DISPLAY_IDENTIFIER x.filter_spez_me.iMoeMesaf ECU_ADDRESS 0xFFF8D560 /end MEASUREMENT
/begin MEASUREMENT iMoeMesaf.filter_spez_me.letzter_ms_timer "letzter Timerwert" UWORD UMR___1_1_0_S6_S3 1 100 0 65535 DISPLAY_IDENTIFIER letzter_ms_timer.filter_spez_me.iMoeMesaf ECU_ADDRESS 0xFFF8D564 /end MEASUREMENT
/begin MEASUREMENT iMoeMesaf.me_sas "Motoreingriff der Schaltablaufsteuerung" SWORD UMR_NM__1_1_0_S6_S3 1 100 -2000 2000 DISPLAY_IDENTIFIER me_sas.iMoeMesaf ECU_ADDRESS 0xFFF8D510 /end MEASUREMENT
/begin MEASUREMENT iMoeMesaf.me_sas_pos_vor "Voreilender Motoreingriff der Schaltablaufsteuerung" SWORD UMR_NM__1_1_0_S6_S3 1 100 -2000 2000 DISPLAY_IDENTIFIER me_sas_pos_vor.iMoeMesaf ECU_ADDRESS 0xFFF8D512 /end MEASUREMENT
/begin MEASUREMENT iMoeMesaf.me_sas_pos_vor_stat "Statussignal zu voreilendem Motoreingriff" UBYTE Conv.cMoeMesaf._.me_sas_pos_vor_stat_S6_S3 1 100 0 1 BIT_MASK 0x1 DISPLAY_IDENTIFIER me_sas_pos_vor_stat.iMoeMesaf ECU_ADDRESS 0xFFF8D514 /end MEASUREMENT
/begin MEASUREMENT iMoeMesaf.flag_me_haupt_aktiv "FLAG: Wert Hauptmotoreingriff wird ausgegeben" UBYTE Conv.cMoeMesaf._.flag_me_haupt_aktiv_S6_S3 1 100 0 1 BIT_MASK 0x1 DISPLAY_IDENTIFIER flag_me_haupt_aktiv.iMoeMesaf ECU_ADDRESS 0xFFF8D515 /end MEASUREMENT
/begin MEASUREMENT iMoeMesaf.zust_haupt_me_gestartet "FLAG: Zustand Hauptmotoreingriff ist gestartet" UBYTE Conv.cMoeMesaf._.zust_haupt_me_gestartet_S6_S3 1 100 0 1 BIT_MASK 0x1 DISPLAY_IDENTIFIER zust_haupt_me_gestartet.iMoeMesaf ECU_ADDRESS 0xFFF8D516 /end MEASUREMENT
/begin MEASUREMENT iMoeMesaf.me_sas_luft "Motoreingriff ueber Luft durch Motoreingriffsklassifizierung" SWORD UMR_NM__1_1_0_S6_S3 1 100 -2000 2000 DISPLAY_IDENTIFIER me_sas_luft.iMoeMesaf ECU_ADDRESS 0xFFF8D518 /end MEASUREMENT
/begin MEASUREMENT iMoeMesaf.stat_me_klass "Status Motoreingriffsklassifizierung" UBYTE Conv.cMoeMesaf._.stat_me_klass_S6_S3 1 100 0 3 DISPLAY_IDENTIFIER stat_me_klass.iMoeMesaf ECU_ADDRESS 0xFFF8D51A /end MEASUREMENT
/begin MEASUREMENT iMoeMesaf.schalttyp_mes "Schalttyp fuer SAS-Motoreingriff" UBYTE Conv.cMoeMesaf._.schalttyp_mes_S6_S3 1 100 0 2 DISPLAY_IDENTIFIER schalttyp_mes.iMoeMesaf ECU_ADDRESS 0xFFF8D51B /end MEASUREMENT
/begin MEASUREMENT iMoeMesaf.me_sas_gesp "Gespeicherter Motoreingriff" SWORD UMR_NM__1_1_0_S6_S3 1 100 -2000 2000 DISPLAY_IDENTIFIER me_sas_gesp.iMoeMesaf ECU_ADDRESS 0xFFF8D51C /end MEASUREMENT
/begin MEASUREMENT iMoeMesaf.me_sas_gesp_kf "Gespeicherter ME letzter Zustand" SWORD UMR_NM__1_1_0_S6_S3 1 100 -2000 2000 DISPLAY_IDENTIFIER me_sas_gesp_kf.iMoeMesaf ECU_ADDRESS 0xFFF8D51E /end MEASUREMENT
/begin MEASUREMENT iMoeMesaf.timer_tsyn_rampe_pos "Timer ueber t_syn fuer Rueckfilterungsrampe pos ME" SWORD UMR_MSEC__10_1_0_S6_S3 1 100 -5000 5000 DISPLAY_IDENTIFIER timer_tsyn_rampe_pos.iMoeMesaf ECU_ADDRESS 0xFFF8D520 /end MEASUREMENT
/begin MEASUREMENT iMoeMesaf.timer_rampe_pos "Timer fuer Rueckfilterungsrampe pos ME" UBYTE UMR_MSEC__10_1_0_S6_S3 1 100 0 2550 DISPLAY_IDENTIFIER timer_rampe_pos.iMoeMesaf ECU_ADDRESS 0xFFF8D522 /end MEASUREMENT
/begin MEASUREMENT iMoeMesaf.f_unterdr_me "FLAG: Unterdrückung red. ME durch Leerlaufdrehzahlunterschr. aktiv" UBYTE Conv.cMoeMesaf._.f_unterdr_me_S6_S3 1 100 0 1 BIT_MASK 0x1 DISPLAY_IDENTIFIER f_unterdr_me.iMoeMesaf ECU_ADDRESS 0xFFF8D523 /end MEASUREMENT
/begin MEASUREMENT iMoeMesaf.offset_n_motsolleer "Verbrennungsmotorgradienten abhängiger Offset auf die Motorleerlaufdrehzahl" SWORD UMR_U_MIN_1_1_0_S6_S3 1 100 0 1000 DISPLAY_IDENTIFIER offset_n_motsolleer.iMoeMesaf ECU_ADDRESS 0xFFF8D524 /end MEASUREMENT
/begin MEASUREMENT iMoeMesaf.z_mes "Zustand Motoreingriff Schaltablauf" UBYTE Conv.cMoeMesaf._.z_mes_S6_S3 1 100 0 12 DISPLAY_IDENTIFIER z_mes.iMoeMesaf ECU_ADDRESS 0xFFF8D526 /end MEASUREMENT
/begin MEASUREMENT iMoeMesaf.timer_zmes "Zustandstimer Motoreingriff Schaltablauf" UBYTE UMR_MSEC__10_1_0_S6_S3 1 100 0 2550 DISPLAY_IDENTIFIER timer_zmes.iMoeMesaf ECU_ADDRESS 0xFFF8D527 /end MEASUREMENT
/begin MEASUREMENT iMoeMesaf.timer_meklass "Timer fur Start Motoreingriffsklassifizierung" UBYTE UMR_MSEC__10_1_0_S6_S3 1 100 0 2550 DISPLAY_IDENTIFIER timer_meklass.iMoeMesaf ECU_ADDRESS 0xFFF8D528 /end MEASUREMENT
/begin MEASUREMENT iMoeMesaf.me_klass "erwarteter Hauptmotoreingriff für Motoreingriffsklassifizierung" SWORD UMR_NM__1_1_0_S6_S3 1 100 -2000 0 DISPLAY_IDENTIFIER me_klass.iMoeMesaf ECU_ADDRESS 0xFFF8D52A /end MEASUREMENT
/begin MEASUREMENT iMoeMesaf.me_abs_neu_sas "erwarteter me_abs-Wert bei aktuellem me_klass (m_mot+ me_klass)" SWORD UMR_NM__1_1_0_S6_S3 1 100 -2000 2000 DISPLAY_IDENTIFIER me_abs_neu_sas.iMoeMesaf ECU_ADDRESS 0xFFF8D52C /end MEASUREMENT
/begin MEASUREMENT iMoeMesaf.me_zuendlimit_klass "Anzeigegroesse Absolutwert des max. moeglichen ME durch Zuendwinkeleingriff (entspricht eng_red_limit)" SWORD UMR_NM__1_1_0_S6_S3 1 100 -2000 2000 DISPLAY_IDENTIFIER me_zuendlimit_klass.iMoeMesaf ECU_ADDRESS 0xFFF8D52E /end MEASUREMENT
/begin MEASUREMENT iMoeMesaf.me_lastruecknahme_hs_aktiv "Status fuer Lastruecknahme aktiv" UBYTE Conv.cMoeMesaf._.me_lastruecknahme_hs_aktiv_S6_S3 1 100 0 1 BIT_MASK 0x1 DISPLAY_IDENTIFIER me_lastruecknahme_hs_aktiv.iMoeMesaf ECU_ADDRESS 0xFFF8D530 /end MEASUREMENT
/begin MEASUREMENT iMoeMesaf.me_lastruecknahme_hs_erlaubt "Status fuer Lastruecknahme erlaubt" UBYTE Conv.cMoeMesaf._.me_lastruecknahme_hs_erlaubt_S6_S3 1 100 0 1 BIT_MASK 0x1 DISPLAY_IDENTIFIER me_lastruecknahme_hs_erlaubt.iMoeMesaf ECU_ADDRESS 0xFFF8D531 /end MEASUREMENT
/begin MEASUREMENT iMoeMesaf.diag_me_sas "Diagnose aktuelle Ausgabefunktion me_sas" UBYTE Conv.cMoeMesaf._.diag_me_sas_S6_S3 1 100 0 17 DISPLAY_IDENTIFIER diag_me_sas.iMoeMesaf ECU_ADDRESS 0xFFF8D532 /end MEASUREMENT
/begin MEASUREMENT iMoeMesaf.f_rueckfilter_aktiv_ausschaltung "FLAG: Rueckfilterung aktiv bei HS ausserhalb Schaltung" UBYTE Conv.cMoeMesaf._.f_rueckfilter_aktiv_ausschaltung_S6_S3 1 100 0 1 BIT_MASK 0x1 DISPLAY_IDENTIFIER f_rueckfilter_aktiv_ausschaltung.iMoeMesaf ECU_ADDRESS 0xFFF8D533 /end MEASUREMENT
/begin MEASUREMENT iMoeMesaf.me_sas_zwme "Eingriffswert Zwangs-ME" SWORD UMR___1_1_0_S6_S3 1 100 -32768 32767 DISPLAY_IDENTIFIER me_sas_zwme.iMoeMesaf ECU_ADDRESS 0xFFF8D534 /end MEASUREMENT
/begin MEASUREMENT iMoeMesaf.f_neuber_startz_hme_hs_angef "FLAG: Neuberechnung der Startzeit des HME ist wird angefordert" UBYTE Conv.cMoeMesaf._.f_neuber_startz_hme_hs_angef_S6_S3 1 100 0 1 BIT_MASK 0x1 DISPLAY_IDENTIFIER f_neuber_startz_hme_hs_angef.iMoeMesaf ECU_ADDRESS 0xFFF8D536 /end MEASUREMENT
/begin MEASUREMENT iMoeMesaf.f_neuber_startz_hme_hs_erfolgt "FLAG: Neuberechnung der Startzeit des HME wurde ausgeführt" UBYTE Conv.cMoeMesaf._.f_neuber_startz_hme_hs_erfolgt_S6_S3 1 100 0 1 BIT_MASK 0x1 DISPLAY_IDENTIFIER f_neuber_startz_hme_hs_erfolgt.iMoeMesaf ECU_ADDRESS 0xFFF8D537 /end MEASUREMENT
/begin MEASUREMENT iMoeMesaf.flag_meklass_erlaubt "FLAG: Motoreingriffsklassifizierung ist erlaubt" UBYTE Conv.cMoeMesaf._.flag_meklass_erlaubt_S6_S3 1 100 0 1 BIT_MASK 0x1 DISPLAY_IDENTIFIER flag_meklass_erlaubt.iMoeMesaf ECU_ADDRESS 0xFFF8D538 /end MEASUREMENT
/begin MEASUREMENT iMoeMesaf.flag_me_klassifizierung_erfolgt "FLAG: Motoreingriffsklassifizierung wurde durchgeführt" UBYTE Conv.cMoeMesaf._.flag_me_klassifizierung_erfolgt_S6_S3 1 100 0 1 BIT_MASK 0x1 DISPLAY_IDENTIFIER flag_me_klassifizierung_erfolgt.iMoeMesaf ECU_ADDRESS 0xFFF8D539 /end MEASUREMENT
/begin MEASUREMENT iMoeMesaf.nachme_rs_losgelaufen "Merker-Variable, das Nach-Me bei RS gestartet wurde" UBYTE Conv.cMoeMesaf._.nachme_rs_losgelaufen_S6_S3 1 100 0 1 BIT_MASK 0x1 DISPLAY_IDENTIFIER nachme_rs_losgelaufen.iMoeMesaf ECU_ADDRESS 0xFFF8D53A /end MEASUREMENT
/begin MEASUREMENT iMoeMesaf.flag_schaltung_mes_aktiv "FLAG: Es ist eine Schaltung/Gangeinlegen aktiv" UBYTE Conv.cMoeMesaf._.flag_schaltung_mes_aktiv_S6_S3 1 100 0 1 BIT_MASK 0x1 DISPLAY_IDENTIFIER flag_schaltung_mes_aktiv.iMoeMesaf ECU_ADDRESS 0xFFF8D53B /end MEASUREMENT
/begin MEASUREMENT iMoeMesaf.f_timer_sperrzeit_hme_gesetzt "FLAG: Die Sperrzeit wurde gesetzt" UBYTE Conv.cMoeMesaf._.f_timer_sperrzeit_hme_gesetzt_S6_S3 1 100 0 1 BIT_MASK 0x1 DISPLAY_IDENTIFIER f_timer_sperrzeit_hme_gesetzt.iMoeMesaf ECU_ADDRESS 0xFFF8D53C /end MEASUREMENT
/begin MEASUREMENT iMoeMesaf.timer_sperrzeit_hme "Timer Sperrzeit fuer Ende HME ab Ende SF KZU" UBYTE UMR___1_1_0_S6_S3 1 100 0 255 DISPLAY_IDENTIFIER timer_sperrzeit_hme.iMoeMesaf ECU_ADDRESS 0xFFF8D53D /end MEASUREMENT
/begin MEASUREMENT iMoeMesaf.timer_schaltung_mes "Timer seit Start Schaltung" UWORD UMR___1_1_0_S6_S3 1 100 0 65535 DISPLAY_IDENTIFIER timer_schaltung_mes.iMoeMesaf ECU_ADDRESS 0xFFF8D53E /end MEASUREMENT
/begin MEASUREMENT iMoeMesaf.timer_maxzeit_mes "Timer Maximalzeit ME" UWORD UMR___1_1_0_S6_S3 1 100 0 65535 DISPLAY_IDENTIFIER timer_maxzeit_mes.iMoeMesaf ECU_ADDRESS 0xFFF8D540 /end MEASUREMENT
/begin MEASUREMENT iMoeMesaf.timer_ramee "Timer Rampe ME bei Schaltungsende" UBYTE UMR___1_1_0_S6_S3 1 100 0 255 DISPLAY_IDENTIFIER timer_ramee.iMoeMesaf ECU_ADDRESS 0xFFF8D542 /end MEASUREMENT
/begin MEASUREMENT iMoeMesaf.t_ramee "Dauer Rampe ME bei Schaltungsende" UBYTE UMR___1_1_0_S6_S3 1 100 0 255 DISPLAY_IDENTIFIER t_ramee.iMoeMesaf ECU_ADDRESS 0xFFF8D543 /end MEASUREMENT
/begin MEASUREMENT iMoeMesaf.me_sas0_mee "gemerkter Wert ME bei Schaltungsende" SWORD UMR___1_1_0_S6_S3 1 100 -32768 32767 DISPLAY_IDENTIFIER me_sas0_mee.iMoeMesaf ECU_ADDRESS 0xFFF8D544 /end MEASUREMENT
/begin MEASUREMENT iMoeMesaf.me_sas_int "interner ME-Wert, wird benoetigt, fuer Filterinitalisierungen" SWORD UMR___1_1_0_S6_S3 1 100 -32768 32767 DISPLAY_IDENTIFIER me_sas_int.iMoeMesaf ECU_ADDRESS 0xFFF8D546 /end MEASUREMENT
/begin MEASUREMENT iMoeMesaf.zaehler_zmes "Zustandszaehler" UBYTE UMR___1_1_0_S6_S3 1 100 0 255 DISPLAY_IDENTIFIER zaehler_zmes.iMoeMesaf ECU_ADDRESS 0xFFF8D548 /end MEASUREMENT
/begin MEASUREMENT iMoeMesaf.t_zmes "Zustandszeitdauer" SWORD UMR___1_1_0_S6_S3 1 100 -32768 32767 DISPLAY_IDENTIFIER t_zmes.iMoeMesaf ECU_ADDRESS 0xFFF8D54A /end MEASUREMENT
/begin MEASUREMENT iMoeMesaf.t_verzstarthme "Verzögerungszeit Start HME bei HS" SWORD UMR___1_1_0_S6_S3 1 100 -32768 32767 DISPLAY_IDENTIFIER t_verzstarthme.iMoeMesaf ECU_ADDRESS 0xFFF8D54C /end MEASUREMENT
/begin MEASUREMENT iMoeMesaf.momentenerhoehung_erlaubt "Flag das Momentenerhoehung aktiv" UBYTE Conv.cMoeMesaf._.momentenerhoehung_erlaubt_S6_S3 1 100 0 1 BIT_MASK 0x1 DISPLAY_IDENTIFIER momentenerhoehung_erlaubt.iMoeMesaf ECU_ADDRESS 0xFFF8D54E /end MEASUREMENT
/begin MEASUREMENT iMoeMesaf.momentenerhoehung_erlaubt_alt "Merker wie Flag momentenerhoehung_erlaubt im letzten Duchlauf gesetzt war (relevant zur Erkennung von LW)" UBYTE Conv.cMoeMesaf._.momentenerhoehung_erlaubt_alt_S6_S3 1 100 0 1 BIT_MASK 0x1 DISPLAY_IDENTIFIER momentenerhoehung_erlaubt_alt.iMoeMesaf ECU_ADDRESS 0xFFF8D54F /end MEASUREMENT
/begin MEASUREMENT iMoeMesaf.t_syn_alt "aus letztem Task gemerkte vorausberechnete Zeit bis Erreichen Synchron zielgang" SWORD UMR_MSEC__10_1_0_S6_S3 1 100 -327680 327670 DISPLAY_IDENTIFIER t_syn_alt.iMoeMesaf ECU_ADDRESS 0xFFF8D550 /end MEASUREMENT
/begin MEASUREMENT iMoeMesaf.me_sas_start_nach_me "gemerkter Wert ME waehrend Nachmotoreingriff" SWORD UMR___1_1_0_S6_S3 1 100 -32768 32767 DISPLAY_IDENTIFIER me_sas_start_nach_me.iMoeMesaf ECU_ADDRESS 0xFFF8D552 /end MEASUREMENT
/begin MEASUREMENT iMoeMesaf.ng_abmesas "Abtriebsdrehzahlgradient fuer Motoreingriff" SWORD UMR_U_MINSEC_1_1_0_S6_S3 1 100 -1000 1000 DISPLAY_IDENTIFIER ng_abmesas.iMoeMesaf ECU_ADDRESS 0xFFF8D554 /end MEASUREMENT
/begin MEASUREMENT iMoeMesaf.flag_kf_mehaupt_abfilter "Flag Abfilterrampe HauptME aktiv" UBYTE Conv.cMoeMesaf._.flag_kf_mehaupt_abfilter_S6_S3 1 100 0 1 BIT_MASK 0x1 DISPLAY_IDENTIFIER flag_kf_mehaupt_abfilter.iMoeMesaf ECU_ADDRESS 0xFFF8D556 /end MEASUREMENT
/begin MEASUREMENT iMoeMesaf.flag_akt_me_sas_gesp_ramp "Flag Aktualisierung Startwert der Abfilterrampe HauptME" UBYTE Conv.cMoeMesaf._.flag_akt_me_sas_gesp_ramp_S6_S3 1 100 0 1 BIT_MASK 0x1 DISPLAY_IDENTIFIER flag_akt_me_sas_gesp_ramp.iMoeMesaf ECU_ADDRESS 0xFFF8D557 /end MEASUREMENT
/begin MEASUREMENT iMoeMesaf.me_sas_gesp_ramp "Gespeicherter Motoreingriff für Abrampfunktion" SWORD UMR_NM__1_1_0_S6_S3 1 100 -2000 2000 DISPLAY_IDENTIFIER me_sas_gesp_ramp.iMoeMesaf ECU_ADDRESS 0xFFF8D558 /end MEASUREMENT
/begin MEASUREMENT iMoeMesaf.me_sas_gesp_kf_mehaupt "Gespeicherter Motoreingriff aus KF_MEHAUPT für Abrampfunktion" SWORD UMR_NM__1_1_0_S6_S3 1 100 -2000 2000 DISPLAY_IDENTIFIER me_sas_gesp_kf_mehaupt.iMoeMesaf ECU_ADDRESS 0xFFF8D55A /end MEASUREMENT
/begin MEASUREMENT iMonMoSig.mon_mst_status "Zustands- Groesse Monitoring Motor Start" UBYTE Conv.cMonMoSig._.mon_mst_status_S6_S3 1 100 0 3 DISPLAY_IDENTIFIER mon_mst_status.iMonMoSig ECU_ADDRESS 0xFFF8D574 /end MEASUREMENT
/begin MEASUREMENT iMonMoSig.mon_mst_klasse "Beobachtungs-Klasse Monitoring Motor Start" UBYTE UMR___1_1_0_S6_S3 1 100 0 8 DISPLAY_IDENTIFIER mon_mst_klasse.iMonMoSig ECU_ADDRESS 0xFFF8D575 /end MEASUREMENT
/begin MEASUREMENT iMonMoSig.mon_mst_timer "Timer (bzw. Zaehler) - erst nach 10s wechselt Motor AN <=> AUS" UWORD UMR___1_1_0_S6_S3 1 100 0 65535 DISPLAY_IDENTIFIER mon_mst_timer.iMonMoSig ECU_ADDRESS 0xFFF8D576 /end MEASUREMENT
/begin MEASUREMENT iKorDiagl.ersatzgang "Ersatzgang" SBYTE Conv.cKorDiagl._.ersatzgang_S6_S3 1 100 -1 8 DISPLAY_IDENTIFIER ersatzgang.iKorDiagl ECU_ADDRESS 0xFFF8D260 /end MEASUREMENT
/begin MEASUREMENT iKorDiagl.ersatzgang_info "Ersatzgang Info" UBYTE UMR___1_1_0_S6_S3 1 100 0 10 DISPLAY_IDENTIFIER ersatzgang_info.iKorDiagl ECU_ADDRESS 0xFFF8D261 /end MEASUREMENT
/begin MEASUREMENT iKorDiagl.symptom_aktiv "FLAG: Symptom UWIG aktiv" UBYTE Conv.cKorDiagl._.symptom_aktiv_S6_S3 1 100 0 1 BIT_MASK 0x1 DISPLAY_IDENTIFIER symptom_aktiv.iKorDiagl ECU_ADDRESS 0xFFF8D262 /end MEASUREMENT
/begin MEASUREMENT iKorDiagl.b_eg_uwig_direkt_getr_notlaufsp "S/W Schaltungsabbrüche mit o. ohne Momentenschutz" UBYTE Conv.cKorDiagl._.b_eg_uwig_direkt_getr_notlaufsp_S6_S3 1 100 0 1 BIT_MASK 0x1 DISPLAY_IDENTIFIER b_eg_uwig_direkt_getr_notlaufsp.iKorDiagl ECU_ADDRESS 0xFFF8D263 /end MEASUREMENT
/begin MEASUREMENT iNotInfoEgDirekt.ersatzgang "Notgang" SBYTE Conv.cNotInfoEgDirekt._.ersatzgang_S6_S3 1 100 -1 8 DISPLAY_IDENTIFIER ersatzgang.iNotInfoEgDirekt ECU_ADDRESS 0xFFF8D26C /end MEASUREMENT
/begin MEASUREMENT iUewIgEinstBed.flag_symptom_pruefen "Globale Einstiegsbedingungen aktiv" UBYTE Conv.cUewIgEinstBed._.flag_symptom_pruefen_S6_S3 1 100 0 1 BIT_MASK 0x1 DISPLAY_IDENTIFIER flag_symptom_pruefen.iUewIgEinstBed ECU_ADDRESS 0xFFF8A693 /end MEASUREMENT
/begin MEASUREMENT iUewIgBerechnung.iMGSollmoment.n_f "letzter Wert" SLONG UMR___1_1_0_S6_S3 1 100 -2147483648 2147483647 DISPLAY_IDENTIFIER n_f.iMGSollmoment.iUewIgBerechnung ECU_ADDRESS 0xFFF8DC1C /end MEASUREMENT
/begin MEASUREMENT iUewIgBerechnung.iMGSollmoment.letzter_ms_timer "letzter Timerwert" UWORD UMR___1_1_0_S6_S3 1 100 0 65535 DISPLAY_IDENTIFIER letzter_ms_timer.iMGSollmoment.iUewIgBerechnung ECU_ADDRESS 0xFFF8DC20 /end MEASUREMENT
/begin MEASUREMENT iUewIgBerechnung.mg_motsolluwig "Gradient des Motorsollmomentes" SWORD UMR_NM_SEC_1_1_0_S6_S3 1 100 -32768 32767 DISPLAY_IDENTIFIER mg_motsolluwig.iUewIgBerechnung ECU_ADDRESS 0xFFF8DC24 /end MEASUREMENT
/begin MEASUREMENT iUewIgetr.timer_uwig_schalt_abbruch "Zeit nach Schaltungsabbruch durch Symptom UWIG" UBYTE UMR_MSEC__10_1_0_S6_S3 1 100 0 2550 DISPLAY_IDENTIFIER timer_uwig_schalt_abbruch.iUewIgetr ECU_ADDRESS 0xFFF8DB78 /end MEASUREMENT
/begin MEASUREMENT iUewIgetr.timer_reg_start "Zeit seid Reglerstart" UBYTE UMR_MSEC__10_1_0_S6_S3 1 100 0 2550 DISPLAY_IDENTIFIER timer_reg_start.iUewIgetr ECU_ADDRESS 0xFFF8DB79 /end MEASUREMENT
/begin MEASUREMENT iUewIgetr.timer_uwig_ge "maximale Ueberwachungzeit GE bei kleinen n_ab" UBYTE UMR_MSEC__10_1_0_S6_S3 1 100 0 2550 DISPLAY_IDENTIFIER timer_uwig_ge.iUewIgetr ECU_ADDRESS 0xFFF8DB7A /end MEASUREMENT
/begin MEASUREMENT iUewIgetr.timer16_uwig_sas "Zeit seit Start Schaltung" UWORD UMR_MSEC__10_1_0_S6_S3 1 100 0 655350 DISPLAY_IDENTIFIER timer16_uwig_sas.iUewIgetr ECU_ADDRESS 0xFFF8DB7C /end MEASUREMENT
/begin MEASUREMENT iUewIgetr.timer16_rznuwig "Timer Rueckkehr zur Normalfunktion UIG-Ueberwachung" UWORD UMR_MSEC__10_1_0_S6_S3 1 100 0 655350 DISPLAY_IDENTIFIER timer16_rznuwig.iUewIgetr ECU_ADDRESS 0xFFF8DB7E /end MEASUREMENT
/begin MEASUREMENT iUewIgetr.timer16_rampe "Timer Rampenzeit UIG-Ueberwachung" UWORD UMR_MSEC__10_1_0_S6_S3 1 100 0 655350 DISPLAY_IDENTIFIER timer16_rampe.iUewIgetr ECU_ADDRESS 0xFFF8DB80 /end MEASUREMENT
/begin MEASUREMENT iUewIgetr.timer16_uwigrnf "Timer Verzoegerungszeit Rueckkehr zur Normalfunktion UIG-Ueberwachung" UWORD UMR_MSEC__10_1_0_S6_S3 1 100 0 655350 DISPLAY_IDENTIFIER timer16_uwigrnf.iUewIgetr ECU_ADDRESS 0xFFF8DB82 /end MEASUREMENT
/begin MEASUREMENT iUewIgetr.timer_vngabuwig "Timer Verzoegerungszeit nach erneutem ueberschreiten der NGS_ABUWIGxy Schwelle" UBYTE UMR_MSEC__10_1_0_S6_S3 1 100 0 2550 DISPLAY_IDENTIFIER timer_vngabuwig.iUewIgetr ECU_ADDRESS 0xFFF8DB84 /end MEASUREMENT
/begin MEASUREMENT iUewIgetr.n_stoer_gang "Stoerungszaehler im Gang" UBYTE UMR___1_1_0_S6_S3 1 100 0 255 DISPLAY_IDENTIFIER n_stoer_gang.iUewIgetr ECU_ADDRESS 0xFFF8DB85 /end MEASUREMENT
/begin MEASUREMENT iUewIgetr.n_stoer_schalt "Stoerungszaehler waehrend Schaltung" UBYTE UMR___1_1_0_S6_S3 1 100 0 255 DISPLAY_IDENTIFIER n_stoer_schalt.iUewIgetr ECU_ADDRESS 0xFFF8DB86 /end MEASUREMENT
/begin MEASUREMENT iUewIgetr.n_stoer_ge "Stoerungszaehler waehrend Gangeinlegen" UBYTE UMR___1_1_0_S6_S3 1 100 0 255 DISPLAY_IDENTIFIER n_stoer_ge.iUewIgetr ECU_ADDRESS 0xFFF8DB87 /end MEASUREMENT
/begin MEASUREMENT iUewIgetr.n_erfolguwig "Erfolgszaehler waehrend Gangeinlegen bei kleiner n_ab" UBYTE UMR___1_1_0_S6_S3 1 100 0 255 DISPLAY_IDENTIFIER n_erfolguwig.iUewIgetr ECU_ADDRESS 0xFFF8DB88 /end MEASUREMENT
/begin MEASUREMENT iUewIgetr.n_sym_uwig_schalt12 "Symptomzaehler waehrend Schaltung 1 - 2" UBYTE UMR___1_1_0_S6_S3 1 100 0 255 DISPLAY_IDENTIFIER n_sym_uwig_schalt12.iUewIgetr ECU_ADDRESS 0xFFF8DB89 /end MEASUREMENT
/begin MEASUREMENT iUewIgetr.n_sym_uwig_schalt13 "Symptomzaehler waehrend Schaltung 1 - 3" UBYTE UMR___1_1_0_S6_S3 1 100 0 255 DISPLAY_IDENTIFIER n_sym_uwig_schalt13.iUewIgetr ECU_ADDRESS 0xFFF8DB8A /end MEASUREMENT
/begin MEASUREMENT iUewIgetr.n_sym_uwig_schalt21 "Symptomzaehler waehrend Schaltung 2 - 1" UBYTE UMR___1_1_0_S6_S3 1 100 0 255 DISPLAY_IDENTIFIER n_sym_uwig_schalt21.iUewIgetr ECU_ADDRESS 0xFFF8DB8B /end MEASUREMENT
/begin MEASUREMENT iUewIgetr.n_sym_uwig_schalt23 "Symptomzaehler waehrend Schaltung 2 - 3" UBYTE UMR___1_1_0_S6_S3 1 100 0 255 DISPLAY_IDENTIFIER n_sym_uwig_schalt23.iUewIgetr ECU_ADDRESS 0xFFF8DB8C /end MEASUREMENT
/begin MEASUREMENT iUewIgetr.n_sym_uwig_schalt24 "Symptomzaehler waehrend Schaltung 2 - 4" UBYTE UMR___1_1_0_S6_S3 1 100 0 255 DISPLAY_IDENTIFIER n_sym_uwig_schalt24.iUewIgetr ECU_ADDRESS 0xFFF8DB8D /end MEASUREMENT
/begin MEASUREMENT iUewIgetr.n_sym_uwig_schalt31 "Symptomzaehler waehrend Schaltung 3 - 1" UBYTE UMR___1_1_0_S6_S3 1 100 0 255 DISPLAY_IDENTIFIER n_sym_uwig_schalt31.iUewIgetr ECU_ADDRESS 0xFFF8DB8E /end MEASUREMENT
/begin MEASUREMENT iUewIgetr.n_sym_uwig_schalt32 "Symptomzaehler waehrend Schaltung 3 - 2" UBYTE UMR___1_1_0_S6_S3 1 100 0 255 DISPLAY_IDENTIFIER n_sym_uwig_schalt32.iUewIgetr ECU_ADDRESS 0xFFF8DB8F /end MEASUREMENT
/begin MEASUREMENT iUewIgetr.n_sym_uwig_schalt34 "Symptomzaehler waehrend Schaltung 3 - 4" UBYTE UMR___1_1_0_S6_S3 1 100 0 255 DISPLAY_IDENTIFIER n_sym_uwig_schalt34.iUewIgetr ECU_ADDRESS 0xFFF8DB90 /end MEASUREMENT
/begin MEASUREMENT iUewIgetr.n_sym_uwig_schalt35 "Symptomzaehler waehrend Schaltung 3 - 5" UBYTE UMR___1_1_0_S6_S3 1 100 0 255 DISPLAY_IDENTIFIER n_sym_uwig_schalt35.iUewIgetr ECU_ADDRESS 0xFFF8DB91 /end MEASUREMENT
/begin MEASUREMENT iUewIgetr.n_sym_uwig_schalt42 "Symptomzaehler waehrend Schaltung 4 - 2" UBYTE UMR___1_1_0_S6_S3 1 100 0 255 DISPLAY_IDENTIFIER n_sym_uwig_schalt42.iUewIgetr ECU_ADDRESS 0xFFF8DB92 /end MEASUREMENT
/begin MEASUREMENT iUewIgetr.n_sym_uwig_schalt43 "Symptomzaehler waehrend Schaltung 4 - 3" UBYTE UMR___1_1_0_S6_S3 1 100 0 255 DISPLAY_IDENTIFIER n_sym_uwig_schalt43.iUewIgetr ECU_ADDRESS 0xFFF8DB93 /end MEASUREMENT
/begin MEASUREMENT iUewIgetr.n_sym_uwig_schalt45 "Symptomzaehler waehrend Schaltung 4 - 5" UBYTE UMR___1_1_0_S6_S3 1 100 0 255 DISPLAY_IDENTIFIER n_sym_uwig_schalt45.iUewIgetr ECU_ADDRESS 0xFFF8DB94 /end MEASUREMENT
/begin MEASUREMENT iUewIgetr.n_sym_uwig_schalt46 "Symptomzaehler waehrend Schaltung 4 - 6" UBYTE UMR___1_1_0_S6_S3 1 100 0 255 DISPLAY_IDENTIFIER n_sym_uwig_schalt46.iUewIgetr ECU_ADDRESS 0xFFF8DB95 /end MEASUREMENT
/begin MEASUREMENT iUewIgetr.n_sym_uwig_schalt51 "Symptomzaehler waehrend Schaltung 5 - 1" UBYTE UMR___1_1_0_S6_S3 1 100 0 255 DISPLAY_IDENTIFIER n_sym_uwig_schalt51.iUewIgetr ECU_ADDRESS 0xFFF8DB96 /end MEASUREMENT
/begin MEASUREMENT iUewIgetr.n_sym_uwig_schalt53 "Symptomzaehler waehrend Schaltung 5 - 3" UBYTE UMR___1_1_0_S6_S3 1 100 0 255 DISPLAY_IDENTIFIER n_sym_uwig_schalt53.iUewIgetr ECU_ADDRESS 0xFFF8DB97 /end MEASUREMENT
/begin MEASUREMENT iUewIgetr.n_sym_uwig_schalt54 "Symptomzaehler waehrend Schaltung 5 - 4" UBYTE UMR___1_1_0_S6_S3 1 100 0 255 DISPLAY_IDENTIFIER n_sym_uwig_schalt54.iUewIgetr ECU_ADDRESS 0xFFF8DB98 /end MEASUREMENT
/begin MEASUREMENT iUewIgetr.n_sym_uwig_schalt56 "Symptomzaehler waehrend Schaltung 5 - 6" UBYTE UMR___1_1_0_S6_S3 1 100 0 255 DISPLAY_IDENTIFIER n_sym_uwig_schalt56.iUewIgetr ECU_ADDRESS 0xFFF8DB99 /end MEASUREMENT
/begin MEASUREMENT iUewIgetr.n_sym_uwig_schalt57 "Symptomzaehler waehrend Schaltung 5 - 7" UBYTE UMR___1_1_0_S6_S3 1 100 0 255 DISPLAY_IDENTIFIER n_sym_uwig_schalt57.iUewIgetr ECU_ADDRESS 0xFFF8DB9A /end MEASUREMENT
/begin MEASUREMENT iUewIgetr.n_sym_uwig_schalt63 "Symptomzaehler waehrend Schaltung 6 - 3" UBYTE UMR___1_1_0_S6_S3 1 100 0 255 DISPLAY_IDENTIFIER n_sym_uwig_schalt63.iUewIgetr ECU_ADDRESS 0xFFF8DB9B /end MEASUREMENT
/begin MEASUREMENT iUewIgetr.n_sym_uwig_schalt64 "Symptomzaehler waehrend Schaltung 6 - 4" UBYTE UMR___1_1_0_S6_S3 1 100 0 255 DISPLAY_IDENTIFIER n_sym_uwig_schalt64.iUewIgetr ECU_ADDRESS 0xFFF8DB9C /end MEASUREMENT
/begin MEASUREMENT iUewIgetr.n_sym_uwig_schalt65 "Symptomzaehler waehrend Schaltung 6 - 5" UBYTE UMR___1_1_0_S6_S3 1 100 0 255 DISPLAY_IDENTIFIER n_sym_uwig_schalt65.iUewIgetr ECU_ADDRESS 0xFFF8DB9D /end MEASUREMENT
/begin MEASUREMENT iUewIgetr.n_sym_uwig_schalt67 "Symptomzaehler waehrend Schaltung 6 - 7" UBYTE UMR___1_1_0_S6_S3 1 100 0 255 DISPLAY_IDENTIFIER n_sym_uwig_schalt67.iUewIgetr ECU_ADDRESS 0xFFF8DB9E /end MEASUREMENT
/begin MEASUREMENT iUewIgetr.n_sym_uwig_schalt68 "Symptomzaehler waehrend Schaltung 6 - 8" UBYTE UMR___1_1_0_S6_S3 1 100 0 255 DISPLAY_IDENTIFIER n_sym_uwig_schalt68.iUewIgetr ECU_ADDRESS 0xFFF8DB9F /end MEASUREMENT
/begin MEASUREMENT iUewIgetr.n_sym_uwig_schalt71 "Symptomzaehler waehrend Schaltung 7 - 1" UBYTE UMR___1_1_0_S6_S3 1 100 0 255 DISPLAY_IDENTIFIER n_sym_uwig_schalt71.iUewIgetr ECU_ADDRESS 0xFFF8DBA0 /end MEASUREMENT
/begin MEASUREMENT iUewIgetr.n_sym_uwig_schalt75 "Symptomzaehler waehrend Schaltung 7 - 5" UBYTE UMR___1_1_0_S6_S3 1 100 0 255 DISPLAY_IDENTIFIER n_sym_uwig_schalt75.iUewIgetr ECU_ADDRESS 0xFFF8DBA1 /end MEASUREMENT
/begin MEASUREMENT iUewIgetr.n_sym_uwig_schalt76 "Symptomzaehler waehrend Schaltung 7 - 6" UBYTE UMR___1_1_0_S6_S3 1 100 0 255 DISPLAY_IDENTIFIER n_sym_uwig_schalt76.iUewIgetr ECU_ADDRESS 0xFFF8DBA2 /end MEASUREMENT
/begin MEASUREMENT iUewIgetr.n_sym_uwig_schalt78 "Symptomzaehler waehrend Schaltung 7 - 8" UBYTE UMR___1_1_0_S6_S3 1 100 0 255 DISPLAY_IDENTIFIER n_sym_uwig_schalt78.iUewIgetr ECU_ADDRESS 0xFFF8DBA3 /end MEASUREMENT
/begin MEASUREMENT iUewIgetr.n_sym_uwig_schalt82 "Symptomzaehler waehrend Schaltung 8 - 2" UBYTE UMR___1_1_0_S6_S3 1 100 0 255 DISPLAY_IDENTIFIER n_sym_uwig_schalt82.iUewIgetr ECU_ADDRESS 0xFFF8DBA4 /end MEASUREMENT
/begin MEASUREMENT iUewIgetr.n_sym_uwig_schalt84 "Symptomzaehler waehrend Schaltung 8 - 4" UBYTE UMR___1_1_0_S6_S3 1 100 0 255 DISPLAY_IDENTIFIER n_sym_uwig_schalt84.iUewIgetr ECU_ADDRESS 0xFFF8DBA5 /end MEASUREMENT
/begin MEASUREMENT iUewIgetr.n_sym_uwig_schalt86 "Symptomzaehler waehrend Schaltung 8 - 6" UBYTE UMR___1_1_0_S6_S3 1 100 0 255 DISPLAY_IDENTIFIER n_sym_uwig_schalt86.iUewIgetr ECU_ADDRESS 0xFFF8DBA6 /end MEASUREMENT
/begin MEASUREMENT iUewIgetr.n_sym_uwig_schalt87 "Symptomzaehler waehrend Schaltung 8 - 7" UBYTE UMR___1_1_0_S6_S3 1 100 0 255 DISPLAY_IDENTIFIER n_sym_uwig_schalt87.iUewIgetr ECU_ADDRESS 0xFFF8DBA7 /end MEASUREMENT
/begin MEASUREMENT iUewIgetr.n_erfolg_symio_a "Erfolgszaehler zur Symptomheilung bei Kupplung A" UBYTE UMR___1_1_0_S6_S3 1 100 0 255 DISPLAY_IDENTIFIER n_erfolg_symio_a.iUewIgetr ECU_ADDRESS 0xFFF8DBA8 /end MEASUREMENT
/begin MEASUREMENT iUewIgetr.n_erfolg_symio_b "Erfolgszaehler zur Symptomheilung bei Kupplung B" UBYTE UMR___1_1_0_S6_S3 1 100 0 255 DISPLAY_IDENTIFIER n_erfolg_symio_b.iUewIgetr ECU_ADDRESS 0xFFF8DBA9 /end MEASUREMENT
/begin MEASUREMENT iUewIgetr.n_erfolg_symio_c "Erfolgszaehler zur Symptomheilung bei Kupplung C" UBYTE UMR___1_1_0_S6_S3 1 100 0 255 DISPLAY_IDENTIFIER n_erfolg_symio_c.iUewIgetr ECU_ADDRESS 0xFFF8DBAA /end MEASUREMENT
/begin MEASUREMENT iUewIgetr.n_erfolg_symio_d "Erfolgszaehler zur Symptomheilung bei Kupplung D" UBYTE UMR___1_1_0_S6_S3 1 100 0 255 DISPLAY_IDENTIFIER n_erfolg_symio_d.iUewIgetr ECU_ADDRESS 0xFFF8DBAB /end MEASUREMENT
/begin MEASUREMENT iUewIgetr.n_erfolg_symio_e "Erfolgszaehler zur Symptomheilung bei Kupplung E" UBYTE UMR___1_1_0_S6_S3 1 100 0 255 DISPLAY_IDENTIFIER n_erfolg_symio_e.iUewIgetr ECU_ADDRESS 0xFFF8DBAC /end MEASUREMENT
/begin MEASUREMENT iUewIgetr.n_sym_uwig_cnt_kup_a "Symptomzaehler Kupplung A" UBYTE UMR___1_1_0_S6_S3 1 100 0 255 DISPLAY_IDENTIFIER n_sym_uwig_cnt_kup_a.iUewIgetr ECU_ADDRESS 0xFFF8DBAD /end MEASUREMENT
/begin MEASUREMENT iUewIgetr.n_sym_uwig_cnt_kup_b "Symptomzaehler Kupplung B" UBYTE UMR___1_1_0_S6_S3 1 100 0 255 DISPLAY_IDENTIFIER n_sym_uwig_cnt_kup_b.iUewIgetr ECU_ADDRESS 0xFFF8DBAE /end MEASUREMENT
/begin MEASUREMENT iUewIgetr.n_sym_uwig_cnt_kup_c "Symptomzaehler Kupplung C" UBYTE UMR___1_1_0_S6_S3 1 100 0 255 DISPLAY_IDENTIFIER n_sym_uwig_cnt_kup_c.iUewIgetr ECU_ADDRESS 0xFFF8DBAF /end MEASUREMENT
/begin MEASUREMENT iUewIgetr.n_sym_uwig_cnt_kup_d "Symptomzaehler Kupplung D" UBYTE UMR___1_1_0_S6_S3 1 100 0 255 DISPLAY_IDENTIFIER n_sym_uwig_cnt_kup_d.iUewIgetr ECU_ADDRESS 0xFFF8DBB0 /end MEASUREMENT
/begin MEASUREMENT iUewIgetr.n_sym_uwig_cnt_kup_e "Symptomzaehler Kupplung E" UBYTE UMR___1_1_0_S6_S3 1 100 0 255 DISPLAY_IDENTIFIER n_sym_uwig_cnt_kup_e.iUewIgetr ECU_ADDRESS 0xFFF8DBB1 /end MEASUREMENT
/begin MEASUREMENT iUewIgetr.uwig_pruefstatus_kup_a "Flag Pruefstatus Kuplung A" UBYTE Conv.cUewIgetr._.uwig_pruefstatus_kup_a_S6_S3 1 100 0 1 BIT_MASK 0x1 DISPLAY_IDENTIFIER uwig_pruefstatus_kup_a.iUewIgetr ECU_ADDRESS 0xFFF8DBB2 /end MEASUREMENT
/begin MEASUREMENT iUewIgetr.uwig_pruefstatus_kup_b "Flag Pruefstatus Kuplung B" UBYTE Conv.cUewIgetr._.uwig_pruefstatus_kup_b_S6_S3 1 100 0 1 BIT_MASK 0x1 DISPLAY_IDENTIFIER uwig_pruefstatus_kup_b.iUewIgetr ECU_ADDRESS 0xFFF8DBB3 /end MEASUREMENT
/begin MEASUREMENT iUewIgetr.uwig_pruefstatus_kup_c "Flag Pruefstatus Kuplung C" UBYTE Conv.cUewIgetr._.uwig_pruefstatus_kup_c_S6_S3 1 100 0 1 BIT_MASK 0x1 DISPLAY_IDENTIFIER uwig_pruefstatus_kup_c.iUewIgetr ECU_ADDRESS 0xFFF8DBB4 /end MEASUREMENT
/begin MEASUREMENT iUewIgetr.uwig_pruefstatus_kup_d "Flag Pruefstatus Kuplung D" UBYTE Conv.cUewIgetr._.uwig_pruefstatus_kup_d_S6_S3 1 100 0 1 BIT_MASK 0x1 DISPLAY_IDENTIFIER uwig_pruefstatus_kup_d.iUewIgetr ECU_ADDRESS 0xFFF8DBB5 /end MEASUREMENT
/begin MEASUREMENT iUewIgetr.uwig_pruefstatus_kup_e "Flag Pruefstatus Kuplung E" UBYTE Conv.cUewIgetr._.uwig_pruefstatus_kup_e_S6_S3 1 100 0 1 BIT_MASK 0x1 DISPLAY_IDENTIFIER uwig_pruefstatus_kup_e.iUewIgetr ECU_ADDRESS 0xFFF8DBB6 /end MEASUREMENT
/begin MEASUREMENT iUewIgetr.m_kupuwigsym_a "minimales Moment bei Symptom an Kupplung A" SWORD UMR_NM__1_1_0_S6_S3 1 100 -32768 32767 DISPLAY_IDENTIFIER m_kupuwigsym_a.iUewIgetr ECU_ADDRESS 0xFFF8DBB8 /end MEASUREMENT
/begin MEASUREMENT iUewIgetr.m_kupuwigsym_b "minimales Moment bei Symptom an Kupplung B" SWORD UMR_NM__1_1_0_S6_S3 1 100 -32768 32767 DISPLAY_IDENTIFIER m_kupuwigsym_b.iUewIgetr ECU_ADDRESS 0xFFF8DBBA /end MEASUREMENT
/begin MEASUREMENT iUewIgetr.m_kupuwigsym_c "minimales Moment bei Symptom an Kupplung C" SWORD UMR_NM__1_1_0_S6_S3 1 100 -32768 32767 DISPLAY_IDENTIFIER m_kupuwigsym_c.iUewIgetr ECU_ADDRESS 0xFFF8DBBC /end MEASUREMENT
/begin MEASUREMENT iUewIgetr.m_kupuwigsym_d "minimales Moment bei Symptom an Kupplung D" SWORD UMR_NM__1_1_0_S6_S3 1 100 -32768 32767 DISPLAY_IDENTIFIER m_kupuwigsym_d.iUewIgetr ECU_ADDRESS 0xFFF8DBBE /end MEASUREMENT
/begin MEASUREMENT iUewIgetr.m_kupuwigsym_e "minimales Moment bei Symptom an Kupplung E" SWORD UMR_NM__1_1_0_S6_S3 1 100 -32768 32767 DISPLAY_IDENTIFIER m_kupuwigsym_e.iUewIgetr ECU_ADDRESS 0xFFF8DBC0 /end MEASUREMENT
/begin MEASUREMENT iUewIgetr.i_gang "Verhaeltniss n_t zu n_ab" SWORD UMR___1_1000_0_S6_S3 1 100 -32.768 32.767 DISPLAY_IDENTIFIER i_gang.iUewIgetr ECU_ADDRESS 0xFFF8DBC2 /end MEASUREMENT
/begin MEASUREMENT iUewIgetr.i_sw_oben "Oberer Schwellwert i_gang" SWORD UMR___1_1000_0_S6_S3 1 100 -32.768 32.767 DISPLAY_IDENTIFIER i_sw_oben.iUewIgetr ECU_ADDRESS 0xFFF8DBC4 /end MEASUREMENT
/begin MEASUREMENT iUewIgetr.i_sw_unten "Unterer Schwellwert i_gang" SWORD UMR___1_1000_0_S6_S3 1 100 -32.768 32.767 DISPLAY_IDENTIFIER i_sw_unten.iUewIgetr ECU_ADDRESS 0xFFF8DBC6 /end MEASUREMENT
/begin MEASUREMENT iUewIgetr.i_gang_ge_start "Verhaeltniss n_t zu n_ab bei Start Gangeinlegen" SWORD UMR___1_1000_0_S6_S3 1 100 -32.768 32.767 DISPLAY_IDENTIFIER i_gang_ge_start.iUewIgetr ECU_ADDRESS 0xFFF8DBC8 /end MEASUREMENT
/begin MEASUREMENT iUewIgetr.zustand_uwig "Zustand Zustandsgraph UWIG" UBYTE Conv.cUewIgetr._.zustand_uwig_S6_S3 1 100 0 8 DISPLAY_IDENTIFIER zustand_uwig.iUewIgetr ECU_ADDRESS 0xFFF8DBCA /end MEASUREMENT
/begin MEASUREMENT iUewIgetr.b_uwig_auf_symptom_pruefen "Flag UWIG auf Symptom pruefen" UBYTE Conv.cUewIgetr._.b_uwig_auf_symptom_pruefen_S6_S3 1 100 0 1 BIT_MASK 0x1 DISPLAY_IDENTIFIER b_uwig_auf_symptom_pruefen.iUewIgetr ECU_ADDRESS 0xFFF8DBCB /end MEASUREMENT
/begin MEASUREMENT iUewIgetr.nd_synzielgang "Differenzdrehzahl zu Synchron bei UWIG-Ueberwachung" SWORD UMR_U_MIN_1_1_0_S6_S3 1 100 -8000 8000 DISPLAY_IDENTIFIER nd_synzielgang.iUewIgetr ECU_ADDRESS 0xFFF8DBCC /end MEASUREMENT
/begin MEASUREMENT iUewIgetr.ng_t_ge_start "Turbinendrehzahlgradient zu Beginn Gangeinlegenueberwachung" SWORD UMR_U_MINSEC_1_1_0_S6_S3 1 100 -10000 10000 DISPLAY_IDENTIFIER ng_t_ge_start.iUewIgetr ECU_ADDRESS 0xFFF8DBCE /end MEASUREMENT
/begin MEASUREMENT iUewIgetr.nd_tuwig_ge "Differenzdrehzahl n_t - n_t0 waehrend GE bei UWIG-Ueberwachung" SWORD UMR_U_MIN_1_1_0_S6_S3 1 100 -8000 8000 DISPLAY_IDENTIFIER nd_tuwig_ge.iUewIgetr ECU_ADDRESS 0xFFF8DBD0 /end MEASUREMENT
/begin MEASUREMENT iUewIgetr.delta_dki "Delta Drosselklappe von Start Gangeinlegen an" UBYTE UMR_PROZENT__20_51_0_S6_S3 1 100 0 100 DISPLAY_IDENTIFIER delta_dki.iUewIgetr ECU_ADDRESS 0xFFF8DBD2 /end MEASUREMENT
/begin MEASUREMENT iUewIgetr.dki_max "maximaler Drosselklappewert von Start Gangeinlegen an" UBYTE UMR_PROZENT__20_51_0_S6_S3 1 100 0 100 DISPLAY_IDENTIFIER dki_max.iUewIgetr ECU_ADDRESS 0xFFF8DBD3 /end MEASUREMENT
/begin MEASUREMENT iUewIgetr.dki_min "minimaler Drosselklappenwert von Start Gangeinlegen an" UBYTE UMR_PROZENT__20_51_0_S6_S3 1 100 0 100 DISPLAY_IDENTIFIER dki_min.iUewIgetr ECU_ADDRESS 0xFFF8DBD4 /end MEASUREMENT
/begin MEASUREMENT iUewIgetr.symptom_uwig_r_gang_aktiv "FLAG: Symptom R-Gang mit Zwangsneutral aktiv" UBYTE Conv.cUewIgetr._.symptom_uwig_r_gang_aktiv_S6_S3 1 100 0 1 BIT_MASK 0x1 DISPLAY_IDENTIFIER symptom_uwig_r_gang_aktiv.iUewIgetr ECU_ADDRESS 0xFFF8DBD5 /end MEASUREMENT
/begin MEASUREMENT iUewIgetr.uwig_abbruchgang "Istgang des Schaltungsabbruch durch UWIG-Ueberwachung!" SBYTE Conv.cUewIgetr._.uwig_abbruchgang_S6_S3 1 100 -1 8 DISPLAY_IDENTIFIER uwig_abbruchgang.iUewIgetr ECU_ADDRESS 0xFFF8DBD6 /end MEASUREMENT
/begin MEASUREMENT iUewIgetr.flg_kuppident "Flag: Die fehlerausloesende Kupplung wurde identifiziert" UBYTE Conv.cUewIgetr._.flg_kuppident_S6_S3 1 100 0 1 BIT_MASK 0x1 DISPLAY_IDENTIFIER flg_kuppident.iUewIgetr ECU_ADDRESS 0xFFF8DBD7 /end MEASUREMENT
/begin MEASUREMENT iUewIgetr.flg_kfc_ratioglobal "Flag: Gibt an das KFC_RATIOGLOBAL eingetragen wurde." UBYTE Conv.cUewIgetr._.flg_kfc_ratioglobal_S6_S3 1 100 0 1 BIT_MASK 0x1 DISPLAY_IDENTIFIER flg_kfc_ratioglobal.iUewIgetr ECU_ADDRESS 0xFFF8DBD8 /end MEASUREMENT
/begin MEASUREMENT iUewIgetr.schaltart_akt_uew_stc "lokale Kopie der Schaltart (HS, RS) fuer die Ueberwachung" UBYTE Conv.cUewIgetr._.schaltart_akt_uew_stc_S6_S3 1 100 0 2 DISPLAY_IDENTIFIER schaltart_akt_uew_stc.iUewIgetr ECU_ADDRESS 0xFFF8DBE0 /end MEASUREMENT
/begin MEASUREMENT iUewIgetr.zielgang_sas_akt_uew_stc "Zielgang zu Beginn der aktuell laufenden ueberwachung" SBYTE Conv.cUewIgetr._.zielgang_sas_akt_uew_stc_S6_S3 1 100 -1 8 DISPLAY_IDENTIFIER zielgang_sas_akt_uew_stc.iUewIgetr ECU_ADDRESS 0xFFF8DBE1 /end MEASUREMENT
/begin MEASUREMENT iUewIgetr.istgang_akt_uew_stc "istgang zu Beginn der aktuell laufenden ueberwachung" SBYTE Conv.cUewIgetr._.istgang_akt_uew_stc_S6_S3 1 100 -1 8 DISPLAY_IDENTIFIER istgang_akt_uew_stc.iUewIgetr ECU_ADDRESS 0xFFF8DBE2 /end MEASUREMENT
/begin MEASUREMENT iUewIgetr.istgang_vorherige_schaltung_stc "istgang vor der Schaltung" SBYTE Conv.cUewIgetr._.istgang_vorherige_schaltung_stc_S6_S3 1 100 -1 8 DISPLAY_IDENTIFIER istgang_vorherige_schaltung_stc.iUewIgetr ECU_ADDRESS 0xFFF8DBE3 /end MEASUREMENT
/begin MEASUREMENT iUewIgetr.eprg_schalt_np_istgang "Istgang der Schaltung für die ein Notprogramm ausgelöst wurde" SBYTE Conv.cUewIgetr._.eprg_schalt_np_istgang_S6_S3 1 100 0 8 DISPLAY_IDENTIFIER eprg_schalt_np_istgang.iUewIgetr ECU_ADDRESS 0xFFF8DBE4 /end MEASUREMENT
/begin MEASUREMENT iUewIgetr.eprg_schalt_np_zielgang_sas "ZielgangSas der Schaltung für die ein Notprogramm ausgelöst wurde" SBYTE Conv.cUewIgetr._.eprg_schalt_np_zielgang_sas_S6_S3 1 100 0 8 DISPLAY_IDENTIFIER eprg_schalt_np_zielgang_sas.iUewIgetr ECU_ADDRESS 0xFFF8DBE5 /end MEASUREMENT
/begin MEASUREMENT iUewIgetr.f_ist_schaltung_stc "Flag: es laeuft eine Schaltung" UBYTE Conv.cUewIgetr._.f_ist_schaltung_stc_S6_S3 1 100 0 1 BIT_MASK 0x1 DISPLAY_IDENTIFIER f_ist_schaltung_stc.iUewIgetr ECU_ADDRESS 0xFFF8DBE6 /end MEASUREMENT
/begin MEASUREMENT iUewIgetr.f_ist_stoerung_stc "Flag: es ist eine Stoerung erkannt worden" UBYTE Conv.cUewIgetr._.f_ist_stoerung_stc_S6_S3 1 100 0 1 BIT_MASK 0x1 DISPLAY_IDENTIFIER f_ist_stoerung_stc.iUewIgetr ECU_ADDRESS 0xFFF8DBE7 /end MEASUREMENT
/begin MEASUREMENT iUewIgetr.f_ist_symptom_gang_stc "Flag: es ist ein Symptom waehrend Ganghalten erkannt worden" UBYTE Conv.cUewIgetr._.f_ist_symptom_gang_stc_S6_S3 1 100 0 1 BIT_MASK 0x1 DISPLAY_IDENTIFIER f_ist_symptom_gang_stc.iUewIgetr ECU_ADDRESS 0xFFF8DBE8 /end MEASUREMENT
/begin MEASUREMENT iUewIgetr.f_ist_symptom_schalt_stc "Flag: es ist ein Symptom waehrend Schaltung erkannt worden" UBYTE Conv.cUewIgetr._.f_ist_symptom_schalt_stc_S6_S3 1 100 0 1 BIT_MASK 0x1 DISPLAY_IDENTIFIER f_ist_symptom_schalt_stc.iUewIgetr ECU_ADDRESS 0xFFF8DBE9 /end MEASUREMENT
/begin MEASUREMENT iUewIgetr.f_ist_symptom_ge_stc "Flag: es ist ein Symptom waehrend Gangeinlegen erkannt worden" UBYTE Conv.cUewIgetr._.f_ist_symptom_ge_stc_S6_S3 1 100 0 1 BIT_MASK 0x1 DISPLAY_IDENTIFIER f_ist_symptom_ge_stc.iUewIgetr ECU_ADDRESS 0xFFF8DBEA /end MEASUREMENT
/begin MEASUREMENT iUewIgetr.f_ist_ersatzgang_schalt_stc "Flag: Ersatzgang gesetzt, weil Symptom waehrend Schaltung erkannt wurde" UBYTE Conv.cUewIgetr._.f_ist_ersatzgang_schalt_stc_S6_S3 1 100 0 1 BIT_MASK 0x1 DISPLAY_IDENTIFIER f_ist_ersatzgang_schalt_stc.iUewIgetr ECU_ADDRESS 0xFFF8DBEB /end MEASUREMENT
/begin MEASUREMENT iUewIgetr.f_ist_ersatzgang_gang_stc "Flag: Ersatzgang gesetzt, weil Symptom waehrend Ganghalten erkannt wurde" UBYTE Conv.cUewIgetr._.f_ist_ersatzgang_gang_stc_S6_S3 1 100 0 1 BIT_MASK 0x1 DISPLAY_IDENTIFIER f_ist_ersatzgang_gang_stc.iUewIgetr ECU_ADDRESS 0xFFF8DBEC /end MEASUREMENT
/begin MEASUREMENT iUewIgetr.f_ist_ersatzgang_ge_stc "Flag: Ersatzgang gesetzt, weil Symptom waehrend Gangeinlegen erkannt wurde" UBYTE Conv.cUewIgetr._.f_ist_ersatzgang_ge_stc_S6_S3 1 100 0 1 BIT_MASK 0x1 DISPLAY_IDENTIFIER f_ist_ersatzgang_ge_stc.iUewIgetr ECU_ADDRESS 0xFFF8DBED /end MEASUREMENT
/begin MEASUREMENT iUewIgetr.f_ist_neue_schaltung_stc "Flag: neue Schaltung begonnen, bevor die alte Schaltung fertig ueberwacht wurde" UBYTE Conv.cUewIgetr._.f_ist_neue_schaltung_stc_S6_S3 1 100 0 1 BIT_MASK 0x1 DISPLAY_IDENTIFIER f_ist_neue_schaltung_stc.iUewIgetr ECU_ADDRESS 0xFFF8DBEE /end MEASUREMENT
/begin MEASUREMENT iUewIgetr.f_ist_neues_ge_stc "Flag: neues Gangeinlegen, bevor das alte Gangeinlegen fertig ueberwacht wurde" UBYTE Conv.cUewIgetr._.f_ist_neues_ge_stc_S6_S3 1 100 0 1 BIT_MASK 0x1 DISPLAY_IDENTIFIER f_ist_neues_ge_stc.iUewIgetr ECU_ADDRESS 0xFFF8DBEF /end MEASUREMENT
/begin MEASUREMENT iUewIgetr.f_schalt_durch_sym_schalt_stc "Flag: laufende Schaltung ist eine Reaktion auf ein erkanntes Schaltungssymptom" UBYTE Conv.cUewIgetr._.f_schalt_durch_sym_schalt_stc_S6_S3 1 100 0 1 BIT_MASK 0x1 DISPLAY_IDENTIFIER f_schalt_durch_sym_schalt_stc.iUewIgetr ECU_ADDRESS 0xFFF8DBF0 /end MEASUREMENT
/begin MEASUREMENT iUewIgetr.f_timer16_rampe_gestartet_stc "Flag: timer16_rampe wurde gestartet" UBYTE Conv.cUewIgetr._.f_timer16_rampe_gestartet_stc_S6_S3 1 100 0 1 BIT_MASK 0x1 DISPLAY_IDENTIFIER f_timer16_rampe_gestartet_stc.iUewIgetr ECU_ADDRESS 0xFFF8DBF1 /end MEASUREMENT
/begin MEASUREMENT iUewIgetr.f_abbruch_akt_ueberwachung "Flag: laufende ueberwachung soll abgebrochen werden" UBYTE Conv.cUewIgetr._.f_abbruch_akt_ueberwachung_S6_S3 1 100 0 1 BIT_MASK 0x1 DISPLAY_IDENTIFIER f_abbruch_akt_ueberwachung.iUewIgetr ECU_ADDRESS 0xFFF8DBF2 /end MEASUREMENT
/begin MEASUREMENT iUewIgetr.f_ist_nab_kleiner_schwelle_stc "Flag: nab kleiner als Schwelle NS_ABUWIG" UBYTE Conv.cUewIgetr._.f_ist_nab_kleiner_schwelle_stc_S6_S3 1 100 0 1 BIT_MASK 0x1 DISPLAY_IDENTIFIER f_ist_nab_kleiner_schwelle_stc.iUewIgetr ECU_ADDRESS 0xFFF8DBF3 /end MEASUREMENT
/begin MEASUREMENT iUewIgetr.f_ist_ge_stc "Flag: es laeuft ein Gangeinlegevorgang" UBYTE Conv.cUewIgetr._.f_ist_ge_stc_S6_S3 1 100 0 1 BIT_MASK 0x1 DISPLAY_IDENTIFIER f_ist_ge_stc.iUewIgetr ECU_ADDRESS 0xFFF8DBF4 /end MEASUREMENT
/begin MEASUREMENT iUewIgetr.f_ueberwache_ge_stc "Flag: Startwerte fuer Gangeinlegeueberwachung sind gesetzt" UBYTE Conv.cUewIgetr._.f_ueberwache_ge_stc_S6_S3 1 100 0 1 BIT_MASK 0x1 DISPLAY_IDENTIFIER f_ueberwache_ge_stc.iUewIgetr ECU_ADDRESS 0xFFF8DBF5 /end MEASUREMENT
/begin MEASUREMENT iUewIgetr.f_pruefbed_im_gang_erreicht_stc "Flag: Pruefbedingung fuer RBM war waehrend Ganghalten mindestens einmal erfuellt" UBYTE Conv.cUewIgetr._.f_pruefbed_im_gang_erreicht_stc_S6_S3 1 100 0 1 BIT_MASK 0x1 DISPLAY_IDENTIFIER f_pruefbed_im_gang_erreicht_stc.iUewIgetr ECU_ADDRESS 0xFFF8DBF6 /end MEASUREMENT
/begin MEASUREMENT iUewIgetr.f_stoer_offset_in_schaltung_stc "Flag: Momentengradient hat die Schwelle MGS_MOTSOLLUWIG waehrend der laufenden Schaltung ueberschritten" UBYTE Conv.cUewIgetr._.f_stoer_offset_in_schaltung_stc_S6_S3 1 100 0 1 BIT_MASK 0x1 DISPLAY_IDENTIFIER f_stoer_offset_in_schaltung_stc.iUewIgetr ECU_ADDRESS 0xFFF8DBF7 /end MEASUREMENT
/begin MEASUREMENT iUewIgetr.f_ersatzwert_stc "Flag: Abtriebsdrehzahl wird aus einem Ersatzwert ermittelt" UBYTE Conv.cUewIgetr._.f_ersatzwert_stc_S6_S3 1 100 0 1 BIT_MASK 0x1 DISPLAY_IDENTIFIER f_ersatzwert_stc.iUewIgetr ECU_ADDRESS 0xFFF8DBF8 /end MEASUREMENT
/begin MEASUREMENT iUewIgetr.f_ersatzprogramm_aktiv "Flag: Ersatzprogramm wurde von UWIG ausgeloest, d.h. Symptomgaenge werden nicht mehr gesetzt" UBYTE Conv.cUewIgetr._.f_ersatzprogramm_aktiv_S6_S3 1 100 0 1 BIT_MASK 0x1 DISPLAY_IDENTIFIER f_ersatzprogramm_aktiv.iUewIgetr ECU_ADDRESS 0xFFF8DBF9 /end MEASUREMENT
/begin MEASUREMENT iUewIgetr.kfc_index_set "Kupplungsfehlercode-Index, der beim letzten endgueltigen Fehler gesetzt wurde" UBYTE UMR___1_1_0_S6_S3 1 100 0 255 DISPLAY_IDENTIFIER kfc_index_set.iUewIgetr ECU_ADDRESS 0xFFF8DBFA /end MEASUREMENT
/begin MEASUREMENT iUewIgetr.n_t_0_stc "Turbinendrehzahl zum Startzeitpunkt der Ueberwachungszeit" UWORD UMR_U_MIN_1_1_0_S6_S3 1 100 0 65535 DISPLAY_IDENTIFIER n_t_0_stc.iUewIgetr ECU_ADDRESS 0xFFF8DBFC /end MEASUREMENT
/begin MEASUREMENT iUewIgetr.kfl_ziel_bei_symptom_stc "Kraftfluss bei Symptom Gangeinlegen" UBYTE Conv.cUewIgetr._.kfl_ziel_bei_symptom_stc_S6_S3 1 100 0 2 DISPLAY_IDENTIFIER kfl_ziel_bei_symptom_stc.iUewIgetr ECU_ADDRESS 0xFFF8DBFE /end MEASUREMENT
/begin MEASUREMENT iUewIgetr.n_t_ge_start_stc "Turbinendrehzahl zu Beginn Gangeinlegen" SWORD UMR_U_MIN_1_1_0_S6_S3 1 100 -32768 32767 DISPLAY_IDENTIFIER n_t_ge_start_stc.iUewIgetr ECU_ADDRESS 0xFFF8DC00 /end MEASUREMENT
/begin MEASUREMENT iUewIgetr.i_oben_rampe_start_stc "gemerkte Obergrenzen bei Reglerstart" SWORD UMR___1_1000_0_S6_S3 1 100 -32.768 32.767 DISPLAY_IDENTIFIER i_oben_rampe_start_stc.iUewIgetr ECU_ADDRESS 0xFFF8DC02 /end MEASUREMENT
/begin MEASUREMENT iUewIgetr.i_unten_rampe_start_stc "gemerkte Untergrenzen bei Reglerstart" SWORD UMR___1_1000_0_S6_S3 1 100 -32.768 32.767 DISPLAY_IDENTIFIER i_unten_rampe_start_stc.iUewIgetr ECU_ADDRESS 0xFFF8DC04 /end MEASUREMENT
/begin MEASUREMENT iUewIgetr.t_maxsas_stc "maximale Schaltzeit ab Zeitpunkt Reglerstart" UWORD UMR_MSEC__10_1_0_S6_S3 1 100 0 655350 DISPLAY_IDENTIFIER t_maxsas_stc.iUewIgetr ECU_ADDRESS 0xFFF8DC06 /end MEASUREMENT
/begin MEASUREMENT iUewIgetr.kup_ge1_stc "die am Istgang-Gang beteiligte Kupplung 1" UBYTE Conv.cUewIgetr._.kup_ge1_stc_S6_S3 1 100 0 5 DISPLAY_IDENTIFIER kup_ge1_stc.iUewIgetr ECU_ADDRESS 0xFFF8DC08 /end MEASUREMENT
/begin MEASUREMENT iUewIgetr.kup_ge2_stc "die am Istgang-Gang beteiligte Kupplung 2" UBYTE Conv.cUewIgetr._.kup_ge2_stc_S6_S3 1 100 0 5 DISPLAY_IDENTIFIER kup_ge2_stc.iUewIgetr ECU_ADDRESS 0xFFF8DC09 /end MEASUREMENT
/begin MEASUREMENT iUewIgetr.kup_ge3_stc "die am Istgang-Gang beteiligte Kupplung 3" UBYTE Conv.cUewIgetr._.kup_ge3_stc_S6_S3 1 100 0 5 DISPLAY_IDENTIFIER kup_ge3_stc.iUewIgetr ECU_ADDRESS 0xFFF8DC0A /end MEASUREMENT
/begin MEASUREMENT iUewIgetr.m_kup_ge1_stc "Momemt an der Kupplung 1 des Istganges" SWORD UMR_NM__1_1_0_S6_S3 1 100 -32768 32767 DISPLAY_IDENTIFIER m_kup_ge1_stc.iUewIgetr ECU_ADDRESS 0xFFF8DC0C /end MEASUREMENT
/begin MEASUREMENT iUewIgetr.m_kup_ge2_stc "Momemt an der Kupplung 2 des Istganges" SWORD UMR_NM__1_1_0_S6_S3 1 100 -32768 32767 DISPLAY_IDENTIFIER m_kup_ge2_stc.iUewIgetr ECU_ADDRESS 0xFFF8DC0E /end MEASUREMENT
/begin MEASUREMENT iUewIgetr.m_kup_ge3_stc "Momemt an der Kupplung 3 des Istganges" SWORD UMR_NM__1_1_0_S6_S3 1 100 -32768 32767 DISPLAY_IDENTIFIER m_kup_ge3_stc.iUewIgetr ECU_ADDRESS 0xFFF8DC10 /end MEASUREMENT
/begin MEASUREMENT iUewIgetr.loop_cnt_stc "Schleifenzaehler um moegliche Endlosschleifen abzufangen" UBYTE UMR___1_1_0_S6_S3 1 100 0 255 DISPLAY_IDENTIFIER loop_cnt_stc.iUewIgetr ECU_ADDRESS 0xFFF8DC12 /end MEASUREMENT
/begin MEASUREMENT iUewIgetr.timer_iepuwig "Timer zum starten des Überwachungszeitraums für einen mgl. IEP-Fehler" UWORD UMR_MSEC__10_1_0_S6_S3 1 100 0 655350 DISPLAY_IDENTIFIER timer_iepuwig.iUewIgetr ECU_ADDRESS 0xFFF8DC14 /end MEASUREMENT
/begin MEASUREMENT iUewIgetr.timer_iepuwig_erfolg "Timer zum Starten der Gutprüfung der IEP-Funktionalität" UWORD UMR_MSEC__10_1_0_S6_S3 1 100 0 655350 DISPLAY_IDENTIFIER timer_iepuwig_erfolg.iUewIgetr ECU_ADDRESS 0xFFF8DC16 /end MEASUREMENT
/begin MEASUREMENT iUewIgetr.fl_sym_iepuwig "Flag: Symptom aufgetreten mit IEP-Einstiegsbedingung" UBYTE Conv.cUewIgetr._.fl_sym_iepuwig_S6_S3 1 100 0 1 BIT_MASK 0x1 DISPLAY_IDENTIFIER fl_sym_iepuwig.iUewIgetr ECU_ADDRESS 0xFFF8DC18 /end MEASUREMENT
/begin MEASUREMENT iUewIgetr.fl_erf_iepuwig "Flag: Erfolgspruefung gestartet" UBYTE Conv.cUewIgetr._.fl_erf_iepuwig_S6_S3 1 100 0 1 BIT_MASK 0x1 DISPLAY_IDENTIFIER fl_erf_iepuwig.iUewIgetr ECU_ADDRESS 0xFFF8DC19 /end MEASUREMENT
/begin MEASUREMENT iUewIgetr.symptom_reaktion "Symptomreaktion ohne endgültige Fehlerbehandlung" UBYTE Conv.cUewIgetr._.symptom_reaktion_S6_S3 1 100 0 6 DISPLAY_IDENTIFIER symptom_reaktion.iUewIgetr ECU_ADDRESS 0xFFF8DC1A /end MEASUREMENT
/begin MEASUREMENT iUewParksperrenmagnet.iTimerVerzpmueb.timer "Der aktuelle Timerwert" UWORD UMR_MSEC__10_1_0_S6_S3 1 100 0 655350 DISPLAY_IDENTIFIER iTimerVerzpmueb.iUewParksperrenmagnet ECU_ADDRESS 0xFFF8DC2E /end MEASUREMENT
/begin MEASUREMENT iUewParksperrenmagnet.iTimerPmdef.timer "Der aktuelle Timerwert" UBYTE UMR_MSEC__10_1_0_S6_S3 1 100 0 2550 DISPLAY_IDENTIFIER iTimerPmdef.iUewParksperrenmagnet ECU_ADDRESS 0xFFF8DC30 /end MEASUREMENT
/begin MEASUREMENT iUewParksperrenmagnet.iTimerPmueb.timer "Der aktuelle Timerwert" ULONG UMR_MSEC__10_1_0_S6_S3 1 100 0 42949672950 DISPLAY_IDENTIFIER iTimerPmueb.iUewParksperrenmagnet ECU_ADDRESS 0xFFF8DC34 /end MEASUREMENT
/begin MEASUREMENT iUewParksperrenmagnet.flag_einstiegsbed "gibt an ob die Einstiegsbedingungen erfuellt sind" UBYTE Conv.cUewParksperrenmagnet._.flag_einstiegsbed_S6_S3 1 100 0 1 BIT_MASK 0x1 DISPLAY_IDENTIFIER flag_einstiegsbed.iUewParksperrenmagnet ECU_ADDRESS 0xFFF8DC28 /end MEASUREMENT
/begin MEASUREMENT iUewParksperrenmagnet.reset_timer_pmueb "Timer auf 0 setzen" UBYTE Conv.cUewParksperrenmagnet._.reset_timer_pmueb_S6_S3 1 100 0 1 BIT_MASK 0x1 DISPLAY_IDENTIFIER reset_timer_pmueb.iUewParksperrenmagnet ECU_ADDRESS 0xFFF8DC29 /end MEASUREMENT
/begin MEASUREMENT iUewParksperrenmagnet.z_pmueb "Gibt an ob in dem aktuellen Fahrzyklus eine Prüfung durchgeführt wurde." UBYTE Conv.cUewParksperrenmagnet._.z_pmueb_S6_S3 1 100 0 2 DISPLAY_IDENTIFIER z_pmueb.iUewParksperrenmagnet ECU_ADDRESS 0xFFF8DC2A /end MEASUREMENT
/begin MEASUREMENT iUewParksperrenmagnet.zustand "Zustand der Ueberwachung" UBYTE Conv.cUewParksperrenmagnet._.zustand_S6_S3 1 100 0 4 DISPLAY_IDENTIFIER zustand.iUewParksperrenmagnet ECU_ADDRESS 0xFFF8DC2B /end MEASUREMENT
/begin MEASUREMENT iUewParksperrenmagnet.n_stoer_pmueb "Störzähler für die Fehlererkennung" UBYTE UMR___1_1_0_S6_S3 1 100 0 255 DISPLAY_IDENTIFIER n_stoer_pmueb.iUewParksperrenmagnet ECU_ADDRESS 0xFFF8DC2C /end MEASUREMENT
/begin MEASUREMENT iDiaRbmif.flag_rbm_zustand_uwigschalt "RBM-Betriebszustand Uebersetzungsueberwachung Schaltung" UBYTE Conv.cDiaRbmif._.flag_rbm_zustand_uwigschalt_S6_S3 1 100 0 1 BIT_MASK 0x1 DISPLAY_IDENTIFIER flag_rbm_zustand_uwigschalt.iDiaRbmif ECU_ADDRESS 0xFFF8A0C4 /end MEASUREMENT
/begin MEASUREMENT iDiaRbmif.flag_rbm_zustand_uwigkup "RBM-Betriebszustand Uebersetzungsueberwachung Kupplung" UBYTE Conv.cDiaRbmif._.flag_rbm_zustand_uwigkup_S6_S3 1 100 0 1 BIT_MASK 0x1 DISPLAY_IDENTIFIER flag_rbm_zustand_uwigkup.iDiaRbmif ECU_ADDRESS 0xFFF8A0C5 /end MEASUREMENT
/begin MEASUREMENT iDiaRbmif.rbm_zielgang_sas_vorw_alt "zielgang_sas (nur positive Werte ansonsten 0) beim letzten Aufruf der RBM-Funktion" UBYTE Conv.cDiaRbmif._.rbm_zielgang_sas_vorw_alt_S6_S3 1 100 0 8 DISPLAY_IDENTIFIER rbm_zielgang_sas_vorw_alt.iDiaRbmif ECU_ADDRESS 0xFFF8A0C6 /end MEASUREMENT
/begin MEASUREMENT iDiaRbmif.rbm_istgang_vorw_alt "istgang (nur positive Werte ansonsten 0) beim letzten Aufruf der RBM-Funktion" UBYTE Conv.cDiaRbmif._.rbm_istgang_vorw_alt_S6_S3 1 100 0 8 DISPLAY_IDENTIFIER rbm_istgang_vorw_alt.iDiaRbmif ECU_ADDRESS 0xFFF8A0C7 /end MEASUREMENT
/begin MEASUREMENT iDiaRbmif.flag_rbm_zust_inaktiv_iae "RBM-Betriebszustand IAE für IAECLOSE und IAENOOPEN" UBYTE Conv.cDiaRbmif._.flag_rbm_zust_inaktiv_iae_S6_S3 1 100 0 1 BIT_MASK 0x1 DISPLAY_IDENTIFIER flag_rbm_zust_inaktiv_iae.iDiaRbmif ECU_ADDRESS 0xFFF8A0C8 /end MEASUREMENT
/begin MEASUREMENT iDiaRbmif.flag_rbm_zust_hanfahr_iae "RBM-Betriebszustand IAE für IAENOCLOSE" UBYTE Conv.cDiaRbmif._.flag_rbm_zust_hanfahr_iae_S6_S3 1 100 0 1 BIT_MASK 0x1 DISPLAY_IDENTIFIER flag_rbm_zust_hanfahr_iae.iDiaRbmif ECU_ADDRESS 0xFFF8A0C9 /end MEASUREMENT
/begin MEASUREMENT iUl2PosMeIntenIGangInt.cBasFehlerErfolgInt._.flag_fehler "Das Flag zeigt an ob die Ueberwachungen einen Fehler entdeckt hat." UBYTE Conv.cBasFehlerErfolgInt._.flag_fehler_S6_S3 1 100 0 1 BIT_MASK 0x1 DISPLAY_IDENTIFIER flag_fehler.iUl2PosMeIntenIGangInt ECU_ADDRESS 0xFFF8ECA0 /end MEASUREMENT
/begin MEASUREMENT iUl2PosMeIntenIGangInt.cBasFehlerErfolgInt._.zaehler_fehler "Fehlerzaehler der Überwachungsfunktion" ULONG UMR___1_1_0_S6_S3 1 100 0 65535 DISPLAY_IDENTIFIER zaehler_fehler.iUl2PosMeIntenIGangInt ECU_ADDRESS 0xFFF8ECA4 /end MEASUREMENT
/begin MEASUREMENT iUl2PosMeIntenIGangInt.cBasFehlerErfolgInt._.zaehler_erfolge "Erfolgszaehler der Überwachungsfunktion" ULONG UMR___1_1_0_S6_S3 1 100 0 65535 DISPLAY_IDENTIFIER zaehler_erfolge.iUl2PosMeIntenIGangInt ECU_ADDRESS 0xFFF8ECA8 /end MEASUREMENT
/begin MEASUREMENT iUl2PosMeIntenIGangFl.cBasFehlerErfolgFl._.flag_fehler "Das Flag zeigt an ob die Ueberwachungen einen Fehler entdeckt hat." FLOAT32_IEEE Conv.cBasFehlerErfolgFl._.flag_fehler_S6_S3 1 100 0 1 FORMAT "%4.2" DISPLAY_IDENTIFIER flag_fehler.iUl2PosMeIntenIGangFl ECU_ADDRESS 0xFFF8ECB4 /end MEASUREMENT
/begin MEASUREMENT iUl2PosMeIntenIGangFl.cBasFehlerErfolgFl._.zaehler_fehler "Fehlerzaehler der Überwachungsfunktion" FLOAT32_IEEE UMR___1_1_0_S6_S3 1 100 0 65535 FORMAT "%4.2" DISPLAY_IDENTIFIER zaehler_fehler.iUl2PosMeIntenIGangFl ECU_ADDRESS 0xFFF8ECB8 /end MEASUREMENT
/begin MEASUREMENT iUl2PosMeIntenIGangFl.cBasFehlerErfolgFl._.zaehler_erfolge "Erfolgszaehler der Überwachungsfunktion" FLOAT32_IEEE UMR___1_1_0_S6_S3 1 100 0 65535 FORMAT "%4.2" DISPLAY_IDENTIFIER zaehler_erfolge.iUl2PosMeIntenIGangFl ECU_ADDRESS 0xFFF8ECBC /end MEASUREMENT
/begin MEASUREMENT iUl2PosMeIntenVar1Int.cBasFehlerErfolgInt._.flag_fehler "Das Flag zeigt an ob die Ueberwachungen einen Fehler entdeckt hat." UBYTE Conv.cBasFehlerErfolgInt._.flag_fehler_S6_S3 1 100 0 1 BIT_MASK 0x1 DISPLAY_IDENTIFIER flag_fehler.iUl2PosMeIntenVar1Int ECU_ADDRESS 0xFFF8ECCC /end MEASUREMENT
/begin MEASUREMENT iUl2PosMeIntenVar1Int.cBasFehlerErfolgInt._.zaehler_fehler "Fehlerzaehler der Überwachungsfunktion" ULONG UMR___1_1_0_S6_S3 1 100 0 65535 DISPLAY_IDENTIFIER zaehler_fehler.iUl2PosMeIntenVar1Int ECU_ADDRESS 0xFFF8ECD0 /end MEASUREMENT
/begin MEASUREMENT iUl2PosMeIntenVar1Int.cBasFehlerErfolgInt._.zaehler_erfolge "Erfolgszaehler der Überwachungsfunktion" ULONG UMR___1_1_0_S6_S3 1 100 0 65535 DISPLAY_IDENTIFIER zaehler_erfolge.iUl2PosMeIntenVar1Int ECU_ADDRESS 0xFFF8ECD4 /end MEASUREMENT
/begin MEASUREMENT iUl2PosMeIntenVar1Fl.cBasFehlerErfolgFl._.flag_fehler "Das Flag zeigt an ob die Ueberwachungen einen Fehler entdeckt hat." FLOAT32_IEEE Conv.cBasFehlerErfolgFl._.flag_fehler_S6_S3 1 100 0 1 FORMAT "%4.2" DISPLAY_IDENTIFIER flag_fehler.iUl2PosMeIntenVar1Fl ECU_ADDRESS 0xFFF8ECE0 /end MEASUREMENT
/begin MEASUREMENT iUl2PosMeIntenVar1Fl.cBasFehlerErfolgFl._.zaehler_fehler "Fehlerzaehler der Überwachungsfunktion" FLOAT32_IEEE UMR___1_1_0_S6_S3 1 100 0 65535 FORMAT "%4.2" DISPLAY_IDENTIFIER zaehler_fehler.iUl2PosMeIntenVar1Fl ECU_ADDRESS 0xFFF8ECE4 /end MEASUREMENT
/begin MEASUREMENT iUl2PosMeIntenVar1Fl.cBasFehlerErfolgFl._.zaehler_erfolge "Erfolgszaehler der Überwachungsfunktion" FLOAT32_IEEE UMR___1_1_0_S6_S3 1 100 0 65535 FORMAT "%4.2" DISPLAY_IDENTIFIER zaehler_erfolge.iUl2PosMeIntenVar1Fl ECU_ADDRESS 0xFFF8ECE8 /end MEASUREMENT
/begin MEASUREMENT iUl2PosMeIntenVar2Int.cBasFehlerErfolgInt._.flag_fehler "Das Flag zeigt an ob die Ueberwachungen einen Fehler entdeckt hat." UBYTE Conv.cBasFehlerErfolgInt._.flag_fehler_S6_S3 1 100 0 1 BIT_MASK 0x1 DISPLAY_IDENTIFIER flag_fehler.iUl2PosMeIntenVar2Int ECU_ADDRESS 0xFFF8ECFC /end MEASUREMENT
/begin MEASUREMENT iUl2PosMeIntenVar2Int.cBasFehlerErfolgInt._.zaehler_fehler "Fehlerzaehler der Überwachungsfunktion" ULONG UMR___1_1_0_S6_S3 1 100 0 65535 DISPLAY_IDENTIFIER zaehler_fehler.iUl2PosMeIntenVar2Int ECU_ADDRESS 0xFFF8ED00 /end MEASUREMENT
/begin MEASUREMENT iUl2PosMeIntenVar2Int.cBasFehlerErfolgInt._.zaehler_erfolge "Erfolgszaehler der Überwachungsfunktion" ULONG UMR___1_1_0_S6_S3 1 100 0 65535 DISPLAY_IDENTIFIER zaehler_erfolge.iUl2PosMeIntenVar2Int ECU_ADDRESS 0xFFF8ED04 /end MEASUREMENT
/begin MEASUREMENT iUl2PosMeIntenVar2Fl.cBasFehlerErfolgFl._.flag_fehler "Das Flag zeigt an ob die Ueberwachungen einen Fehler entdeckt hat." FLOAT32_IEEE Conv.cBasFehlerErfolgFl._.flag_fehler_S6_S3 1 100 0 1 FORMAT "%4.2" DISPLAY_IDENTIFIER flag_fehler.iUl2PosMeIntenVar2Fl ECU_ADDRESS 0xFFF8ED10 /end MEASUREMENT
/begin MEASUREMENT iUl2PosMeIntenVar2Fl.cBasFehlerErfolgFl._.zaehler_fehler "Fehlerzaehler der Überwachungsfunktion" FLOAT32_IEEE UMR___1_1_0_S6_S3 1 100 0 65535 FORMAT "%4.2" DISPLAY_IDENTIFIER zaehler_fehler.iUl2PosMeIntenVar2Fl ECU_ADDRESS 0xFFF8ED14 /end MEASUREMENT
/begin MEASUREMENT iUl2PosMeIntenVar2Fl.cBasFehlerErfolgFl._.zaehler_erfolge "Erfolgszaehler der Überwachungsfunktion" FLOAT32_IEEE UMR___1_1_0_S6_S3 1 100 0 65535 FORMAT "%4.2" DISPLAY_IDENTIFIER zaehler_erfolge.iUl2PosMeIntenVar2Fl ECU_ADDRESS 0xFFF8ED18 /end MEASUREMENT
/begin MEASUREMENT iUl2PosMeSigInt.cBasFehlerErfolgInt._.flag_fehler "Das Flag zeigt an ob die Ueberwachungen einen Fehler entdeckt hat." UBYTE Conv.cBasFehlerErfolgInt._.flag_fehler_S6_S3 1 100 0 1 BIT_MASK 0x1 DISPLAY_IDENTIFIER flag_fehler.iUl2PosMeSigInt ECU_ADDRESS 0xFFF8C44C /end MEASUREMENT
/begin MEASUREMENT iUl2PosMeSigInt.cBasFehlerErfolgInt._.zaehler_fehler "Fehlerzaehler der Überwachungsfunktion" ULONG UMR___1_1_0_S6_S3 1 100 0 65535 DISPLAY_IDENTIFIER zaehler_fehler.iUl2PosMeSigInt ECU_ADDRESS 0xFFF8C450 /end MEASUREMENT
/begin MEASUREMENT iUl2PosMeSigInt.cBasFehlerErfolgInt._.zaehler_erfolge "Erfolgszaehler der Überwachungsfunktion" ULONG UMR___1_1_0_S6_S3 1 100 0 65535 DISPLAY_IDENTIFIER zaehler_erfolge.iUl2PosMeSigInt ECU_ADDRESS 0xFFF8C454 /end MEASUREMENT
/begin MEASUREMENT iUl2PosMeSigFl.cBasFehlerErfolgFl._.flag_fehler "Das Flag zeigt an ob die Ueberwachungen einen Fehler entdeckt hat." FLOAT32_IEEE Conv.cBasFehlerErfolgFl._.flag_fehler_S6_S3 1 100 0 1 FORMAT "%4.2" DISPLAY_IDENTIFIER flag_fehler.iUl2PosMeSigFl ECU_ADDRESS 0xFFF8C460 /end MEASUREMENT
/begin MEASUREMENT iUl2PosMeSigFl.cBasFehlerErfolgFl._.zaehler_fehler "Fehlerzaehler der Überwachungsfunktion" FLOAT32_IEEE UMR___1_1_0_S6_S3 1 100 0 65535 FORMAT "%4.2" DISPLAY_IDENTIFIER zaehler_fehler.iUl2PosMeSigFl ECU_ADDRESS 0xFFF8C464 /end MEASUREMENT
/begin MEASUREMENT iUl2PosMeSigFl.cBasFehlerErfolgFl._.zaehler_erfolge "Erfolgszaehler der Überwachungsfunktion" FLOAT32_IEEE UMR___1_1_0_S6_S3 1 100 0 65535 FORMAT "%4.2" DISPLAY_IDENTIFIER zaehler_erfolge.iUl2PosMeSigFl ECU_ADDRESS 0xFFF8C468 /end MEASUREMENT
/begin MEASUREMENT iUl2PosMeGradientInt.cBasFehlerErfolgInt._.flag_fehler "Das Flag zeigt an ob die Ueberwachungen einen Fehler entdeckt hat." UBYTE Conv.cBasFehlerErfolgInt._.flag_fehler_S6_S3 1 100 0 1 BIT_MASK 0x1 DISPLAY_IDENTIFIER flag_fehler.iUl2PosMeGradientInt ECU_ADDRESS 0xFFF8C484 /end MEASUREMENT
/begin MEASUREMENT iUl2PosMeGradientInt.cBasFehlerErfolgInt._.zaehler_fehler "Fehlerzaehler der Überwachungsfunktion" ULONG UMR___1_1_0_S6_S3 1 100 0 65535 DISPLAY_IDENTIFIER zaehler_fehler.iUl2PosMeGradientInt ECU_ADDRESS 0xFFF8C488 /end MEASUREMENT
/begin MEASUREMENT iUl2PosMeGradientInt.cBasFehlerErfolgInt._.zaehler_erfolge "Erfolgszaehler der Überwachungsfunktion" ULONG UMR___1_1_0_S6_S3 1 100 0 65535 DISPLAY_IDENTIFIER zaehler_erfolge.iUl2PosMeGradientInt ECU_ADDRESS 0xFFF8C48C /end MEASUREMENT
/begin MEASUREMENT iUl2PosMeGradientInt.ng_t_l2.n_f "Filterparameter" SLONG UMR___1_1_0_S6_S3 1 100 -2147483648 2147483647 DISPLAY_IDENTIFIER n_f.ng_t_l2.iUl2PosMeGradientInt ECU_ADDRESS 0xFFF8C49C /end MEASUREMENT
/begin MEASUREMENT iUl2PosMeGradientInt.ng_ab_l2.n_f "Filterparameter" SLONG UMR___1_1_0_S6_S3 1 100 -2147483648 2147483647 DISPLAY_IDENTIFIER n_f.ng_ab_l2.iUl2PosMeGradientInt ECU_ADDRESS 0xFFF8C4A0 /end MEASUREMENT
/begin MEASUREMENT iUl2PosMeGradientFl.cBasFehlerErfolgFl._.flag_fehler "Das Flag zeigt an ob die Ueberwachungen einen Fehler entdeckt hat." FLOAT32_IEEE Conv.cBasFehlerErfolgFl._.flag_fehler_S6_S3 1 100 0 1 FORMAT "%4.2" DISPLAY_IDENTIFIER flag_fehler.iUl2PosMeGradientFl ECU_ADDRESS 0xFFF8C4A4 /end MEASUREMENT
/begin MEASUREMENT iUl2PosMeGradientFl.cBasFehlerErfolgFl._.zaehler_fehler "Fehlerzaehler der Überwachungsfunktion" FLOAT32_IEEE UMR___1_1_0_S6_S3 1 100 0 65535 FORMAT "%4.2" DISPLAY_IDENTIFIER zaehler_fehler.iUl2PosMeGradientFl ECU_ADDRESS 0xFFF8C4A8 /end MEASUREMENT
/begin MEASUREMENT iUl2PosMeGradientFl.cBasFehlerErfolgFl._.zaehler_erfolge "Erfolgszaehler der Überwachungsfunktion" FLOAT32_IEEE UMR___1_1_0_S6_S3 1 100 0 65535 FORMAT "%4.2" DISPLAY_IDENTIFIER zaehler_erfolge.iUl2PosMeGradientFl ECU_ADDRESS 0xFFF8C4AC /end MEASUREMENT
/begin MEASUREMENT iUl2PosMeGradientFl.ng_t_fl.n_f "Filterparameter" FLOAT32_IEEE UMR___1_1_0_S6_S3 1 100 -2147483648 2147483647 FORMAT "%4.2" DISPLAY_IDENTIFIER n_f.ng_t_fl.iUl2PosMeGradientFl ECU_ADDRESS 0xFFF8C4C0 /end MEASUREMENT
/begin MEASUREMENT iUl2PosMeGradientFl.ng_ab_fl.n_f "Filterparameter" FLOAT32_IEEE UMR___1_1_0_S6_S3 1 100 -2147483648 2147483647 FORMAT "%4.2" DISPLAY_IDENTIFIER n_f.ng_ab_fl.iUl2PosMeGradientFl ECU_ADDRESS 0xFFF8C4C4 /end MEASUREMENT
/begin MEASUREMENT iUl2NegMeSigInt.cBasFehlerErfolgInt._.flag_fehler "Das Flag zeigt an ob die Ueberwachungen einen Fehler entdeckt hat." UBYTE Conv.cBasFehlerErfolgInt._.flag_fehler_S6_S3 1 100 0 1 BIT_MASK 0x1 DISPLAY_IDENTIFIER flag_fehler.iUl2NegMeSigInt ECU_ADDRESS 0xFFF8C4C8 /end MEASUREMENT
/begin MEASUREMENT iUl2NegMeSigInt.cBasFehlerErfolgInt._.zaehler_fehler "Fehlerzaehler der Überwachungsfunktion" ULONG UMR___1_1_0_S6_S3 1 100 0 65535 DISPLAY_IDENTIFIER zaehler_fehler.iUl2NegMeSigInt ECU_ADDRESS 0xFFF8C4CC /end MEASUREMENT
/begin MEASUREMENT iUl2NegMeSigInt.cBasFehlerErfolgInt._.zaehler_erfolge "Erfolgszaehler der Überwachungsfunktion" ULONG UMR___1_1_0_S6_S3 1 100 0 65535 DISPLAY_IDENTIFIER zaehler_erfolge.iUl2NegMeSigInt ECU_ADDRESS 0xFFF8C4D0 /end MEASUREMENT
/begin MEASUREMENT iUl2NegMeSigFl.cBasFehlerErfolgFl._.flag_fehler "Das Flag zeigt an ob die Ueberwachungen einen Fehler entdeckt hat." FLOAT32_IEEE Conv.cBasFehlerErfolgFl._.flag_fehler_S6_S3 1 100 0 1 FORMAT "%4.2" DISPLAY_IDENTIFIER flag_fehler.iUl2NegMeSigFl ECU_ADDRESS 0xFFF8C4DC /end MEASUREMENT
/begin MEASUREMENT iUl2NegMeSigFl.cBasFehlerErfolgFl._.zaehler_fehler "Fehlerzaehler der Überwachungsfunktion" FLOAT32_IEEE UMR___1_1_0_S6_S3 1 100 0 65535 FORMAT "%4.2" DISPLAY_IDENTIFIER zaehler_fehler.iUl2NegMeSigFl ECU_ADDRESS 0xFFF8C4E0 /end MEASUREMENT
/begin MEASUREMENT iUl2NegMeSigFl.cBasFehlerErfolgFl._.zaehler_erfolge "Erfolgszaehler der Überwachungsfunktion" FLOAT32_IEEE UMR___1_1_0_S6_S3 1 100 0 65535 FORMAT "%4.2" DISPLAY_IDENTIFIER zaehler_erfolge.iUl2NegMeSigFl ECU_ADDRESS 0xFFF8C4E4 /end MEASUREMENT
/begin MEASUREMENT iUl2NegMeIntenInt.cBasFehlerErfolgInt._.flag_fehler "Das Flag zeigt an ob die Ueberwachungen einen Fehler entdeckt hat." UBYTE Conv.cBasFehlerErfolgInt._.flag_fehler_S6_S3 1 100 0 1 BIT_MASK 0x1 DISPLAY_IDENTIFIER flag_fehler.iUl2NegMeIntenInt ECU_ADDRESS 0xFFF8C4F4 /end MEASUREMENT
/begin MEASUREMENT iUl2NegMeIntenInt.cBasFehlerErfolgInt._.zaehler_fehler "Fehlerzaehler der Überwachungsfunktion" ULONG UMR___1_1_0_S6_S3 1 100 0 65535 DISPLAY_IDENTIFIER zaehler_fehler.iUl2NegMeIntenInt ECU_ADDRESS 0xFFF8C4F8 /end MEASUREMENT
/begin MEASUREMENT iUl2NegMeIntenInt.cBasFehlerErfolgInt._.zaehler_erfolge "Erfolgszaehler der Überwachungsfunktion" ULONG UMR___1_1_0_S6_S3 1 100 0 65535 DISPLAY_IDENTIFIER zaehler_erfolge.iUl2NegMeIntenInt ECU_ADDRESS 0xFFF8C4FC /end MEASUREMENT
/begin MEASUREMENT iUl2NegMeIntenFl.cBasFehlerErfolgFl._.flag_fehler "Das Flag zeigt an ob die Ueberwachungen einen Fehler entdeckt hat." FLOAT32_IEEE Conv.cBasFehlerErfolgFl._.flag_fehler_S6_S3 1 100 0 1 FORMAT "%4.2" DISPLAY_IDENTIFIER flag_fehler.iUl2NegMeIntenFl ECU_ADDRESS 0xFFF8C508 /end MEASUREMENT
/begin MEASUREMENT iUl2NegMeIntenFl.cBasFehlerErfolgFl._.zaehler_fehler "Fehlerzaehler der Überwachungsfunktion" FLOAT32_IEEE UMR___1_1_0_S6_S3 1 100 0 65535 FORMAT "%4.2" DISPLAY_IDENTIFIER zaehler_fehler.iUl2NegMeIntenFl ECU_ADDRESS 0xFFF8C50C /end MEASUREMENT
/begin MEASUREMENT iUl2NegMeIntenFl.cBasFehlerErfolgFl._.zaehler_erfolge "Erfolgszaehler der Überwachungsfunktion" FLOAT32_IEEE UMR___1_1_0_S6_S3 1 100 0 65535 FORMAT "%4.2" DISPLAY_IDENTIFIER zaehler_erfolge.iUl2NegMeIntenFl ECU_ADDRESS 0xFFF8C510 /end MEASUREMENT
/begin MEASUREMENT iUl2GetrMAufInt.cBasFehlerErfolgInt._.flag_fehler "Das Flag zeigt an ob die Ueberwachungen einen Fehler entdeckt hat." UBYTE Conv.cBasFehlerErfolgInt._.flag_fehler_S6_S3 1 100 0 1 BIT_MASK 0x1 DISPLAY_IDENTIFIER flag_fehler.iUl2GetrMAufInt ECU_ADDRESS 0xFFF8E5E4 /end MEASUREMENT
/begin MEASUREMENT iUl2GetrMAufInt.cBasFehlerErfolgInt._.zaehler_fehler "Fehlerzaehler der Überwachungsfunktion" ULONG UMR___1_1_0_S6_S3 1 100 0 65535 DISPLAY_IDENTIFIER zaehler_fehler.iUl2GetrMAufInt ECU_ADDRESS 0xFFF8E5E8 /end MEASUREMENT
/begin MEASUREMENT iUl2GetrMAufInt.cBasFehlerErfolgInt._.zaehler_erfolge "Erfolgszaehler der Überwachungsfunktion" ULONG UMR___1_1_0_S6_S3 1 100 0 65535 DISPLAY_IDENTIFIER zaehler_erfolge.iUl2GetrMAufInt ECU_ADDRESS 0xFFF8E5EC /end MEASUREMENT
/begin MEASUREMENT iUl2GetrMAufFl.cBasFehlerErfolgFl._.flag_fehler "Das Flag zeigt an ob die Ueberwachungen einen Fehler entdeckt hat." FLOAT32_IEEE Conv.cBasFehlerErfolgFl._.flag_fehler_S6_S3 1 100 0 1 FORMAT "%4.2" DISPLAY_IDENTIFIER flag_fehler.iUl2GetrMAufFl ECU_ADDRESS 0xFFF8E5F8 /end MEASUREMENT
/begin MEASUREMENT iUl2GetrMAufFl.cBasFehlerErfolgFl._.zaehler_fehler "Fehlerzaehler der Überwachungsfunktion" FLOAT32_IEEE UMR___1_1_0_S6_S3 1 100 0 65535 FORMAT "%4.2" DISPLAY_IDENTIFIER zaehler_fehler.iUl2GetrMAufFl ECU_ADDRESS 0xFFF8E5FC /end MEASUREMENT
/begin MEASUREMENT iUl2GetrMAufFl.cBasFehlerErfolgFl._.zaehler_erfolge "Erfolgszaehler der Überwachungsfunktion" FLOAT32_IEEE UMR___1_1_0_S6_S3 1 100 0 65535 FORMAT "%4.2" DISPLAY_IDENTIFIER zaehler_erfolge.iUl2GetrMAufFl ECU_ADDRESS 0xFFF8E600 /end MEASUREMENT
/begin COMPU_METHOD SBW_U_STD_S1_S3 "int = ((phys * 1) / 1) - (0) V" RAT_FUNC "%2.0" "V" COEFFS 0 1 -0 0 0 1 /end COMPU_METHOD
/begin COMPU_METHOD SBW_P_BREMSE_2_S1_S3 "int = ((phys * 2) / 1) - (0) bar" RAT_FUNC "%3.1" "bar" COEFFS 0 2 -0 0 0 1 /end COMPU_METHOD
/begin COMPU_METHOD UMR___1_1000_0_S6_S3 "int = ((phys * 1000) / 1) - (0) [-]" RAT_FUNC "%5.3" "[-]" COEFFS 0 1000 -0 0 0 1 /end COMPU_METHOD
/begin COMPU_METHOD UMR___1_1_0_S6_S3 "int = ((phys * 1) / 1) - (0) [-]" RAT_FUNC "%2.0" "[-]" COEFFS 0 1 -0 0 0 1 /end COMPU_METHOD
/begin COMPU_METHOD UMR_NM__1_1_0_S6_S3 "int = ((phys * 1) / 1) - (0) [Nm]" RAT_FUNC "%2.0" "[Nm]" COEFFS 0 1 -0 0 0 1 /end COMPU_METHOD
/begin COMPU_METHOD UMR_NM_SEC_1_1_0_S6_S3 "int = ((phys * 1) / 1) - (0) [Nm/s]" RAT_FUNC "%2.0" "[Nm/s]" COEFFS 0 1 -0 0 0 1 /end COMPU_METHOD
/begin COMPU_METHOD UMR_BAR__1_1000_0_S6_S3 "int = ((phys * 1000) / 1) - (0) [bar]" RAT_FUNC "%5.3" "[bar]" COEFFS 0 1000 -0 0 0 1 /end COMPU_METHOD
/begin COMPU_METHOD UMR_U_MIN_1_1_0_S6_S3 "int = ((phys * 1) / 1) - (0) [U/min]" RAT_FUNC "%2.0" "[U/min]" COEFFS 0 1 -0 0 0 1 /end COMPU_METHOD
/begin COMPU_METHOD UMR_U_MINSEC_1_1_0_S6_S3 "int = ((phys * 1) / 1) - (0) [U/(min*s)]" RAT_FUNC "%2.0" "[U/(min*s)]" COEFFS 0 1 -0 0 0 1 /end COMPU_METHOD
/begin COMPU_METHOD UMR_MSEC__1_1_0_S6_S3 "int = ((phys * 1) / 1) - (0) [ms]" RAT_FUNC "%2.0" "[ms]" COEFFS 0 1 -0 0 0 1 /end COMPU_METHOD
/begin COMPU_METHOD UMR_MSEC__10_1_0_S6_S3 "int = ((phys * 1) / 10) - (0) [ms]" RAT_FUNC "%2.0" "[ms]" COEFFS 0 1 -0 0 0 10 /end COMPU_METHOD
/begin COMPU_METHOD UMR__SEC_1_1_0_S6_S3 "int = ((phys * 1) / 1) - (0) [1/s]" RAT_FUNC "%2.0" "[1/s]" COEFFS 0 1 -0 0 0 1 /end COMPU_METHOD
/begin COMPU_METHOD UMR_GRADC__1_1_0_S6_S3 "int = ((phys * 1) / 1) - (0) [°C]" RAT_FUNC "%2.0" "[°C]" COEFFS 0 1 -0 0 0 1 /end COMPU_METHOD
/begin COMPU_METHOD UMR_K_SEC_1_1_0_S6_S3 "int = ((phys * 1) / 1) - (0) [K/s]" RAT_FUNC "%2.0" "[K/s]" COEFFS 0 1 -0 0 0 1 /end COMPU_METHOD
/begin COMPU_METHOD UMR_PROZENT__1_100_0_S6_S3 "int = ((phys * 100) / 1) - (0) [%]" RAT_FUNC "%4.2" "[%]" COEFFS 0 100 -0 0 0 1 /end COMPU_METHOD
/begin COMPU_METHOD UMR_PROZENT__20_51_0_S6_S3 "int = ((phys * 51) / 20) - (0) [%]" RAT_FUNC "%6.4" "[%]" COEFFS 0 51 -0 0 0 20 /end COMPU_METHOD
/begin COMPU_METHOD UMR_PROZENT__1_1_0_2_S6_S3 "int = ((phys * 1) / 1) - (0) [%]" RAT_FUNC "%2.0" "[%]" COEFFS 0 1 -0 0 0 1 /end COMPU_METHOD
/begin COMPU_METHOD UMR_KW__1_1000_0_S6_S3 "int = ((phys * 1000) / 1) - (0) [KW]" RAT_FUNC "%5.3" "[KW]" COEFFS 0 1000 -0 0 0 1 /end COMPU_METHOD
/begin COMPU_METHOD UMR_KW__1_1_0_S6_S3 "int = ((phys * 1) / 1) - (0) [KW]" RAT_FUNC "%2.0" "[KW]" COEFFS 0 1 -0 0 0 1 /end COMPU_METHOD
/begin COMPU_METHOD UMR_W_MM2_1_1_0_3_S6_S3 "int = ((phys * 1) / 1) - (0) [W/(mm^2)]" RAT_FUNC "%2.0" "[W/(mm^2)]" COEFFS 0 1 -0 0 0 1 /end COMPU_METHOD
/begin COMPU_METHOD UMR_W_MM2_1_100_0_S6_S3 "int = ((phys * 100) / 1) - (0) [W/(mm^2)]" RAT_FUNC "%4.2" "[W/(mm^2)]" COEFFS 0 100 -0 0 0 1 /end COMPU_METHOD
/begin COMPU_METHOD UMR_KJ__1_1_0_S6_S3 "int = ((phys * 1) / 1) - (0) [KJ]" RAT_FUNC "%2.0" "[KJ]" COEFFS 0 1 -0 0 0 1 /end COMPU_METHOD
/begin COMPU_METHOD UMR_KJ__1_1000_0_S6_S3 "int = ((phys * 1000) / 1) - (0) [KJ]" RAT_FUNC "%5.3" "[KJ]" COEFFS 0 1000 -0 0 0 1 /end COMPU_METHOD
/begin COMPU_METHOD UMR_J_G_1_1_0_S6_S3 "int = ((phys * 1) / 1) - (0) [J/(g)]" RAT_FUNC "%2.0" "[J/(g)]" COEFFS 0 1 -0 0 0 1 /end COMPU_METHOD
/begin COMPU_METHOD UMR_J_G_1_100_0_S6_S3 "int = ((phys * 100) / 1) - (0) [J/(g)]" RAT_FUNC "%4.2" "[J/(g)]" COEFFS 0 100 -0 0 0 1 /end COMPU_METHOD
/begin COMPU_METHOD UMR_LITER_MIN_1_10_0_S6_S3 "int = ((phys * 10) / 1) - (0) [Liter/min]" RAT_FUNC "%3.1" "[Liter/min]" COEFFS 0 10 -0 0 0 1 /end COMPU_METHOD
/begin COMPU_METHOD Conv.cTciCompu._.k_ab_S6_S3 "Umrechnung fuer Messgroesse cTciCompu::k_ab" TAB_VERB "%4.0" "" COMPU_TAB_REF Conv.cTciCompu._.k_ab_S6_S3 /end COMPU_METHOD
/begin COMPU_METHOD Conv.cTciCompu._.k_zu_S6_S3 "Umrechnung fuer Messgroesse cTciCompu::k_zu" TAB_VERB "%4.0" "" COMPU_TAB_REF Conv.cTciCompu._.k_zu_S6_S3 /end COMPU_METHOD
/begin COMPU_METHOD Conv.cTciCompu._.z_tci_S6_S3 "Umrechnung fuer Messgroesse cTciCompu::z_tci" TAB_VERB "%4.0" "" COMPU_TAB_REF Conv.cTciCompu._.z_tci_S6_S3 /end COMPU_METHOD
/begin COMPU_METHOD Conv.cTciCompu._.istgang_idx_merk_S6_S3 "Umrechnung fuer Messgroesse cTciCompu::istgang_idx_merk" TAB_VERB "%4.0" "" COMPU_TAB_REF Conv.cTciCompu._.istgang_idx_merk_S6_S3 /end COMPU_METHOD
/begin COMPU_METHOD Conv.cTciCompu._.zielgang_sas_idx_merk_S6_S3 "Umrechnung fuer Messgroesse cTciCompu::zielgang_sas_idx_merk" TAB_VERB "%4.0" "" COMPU_TAB_REF Conv.cTciCompu._.zielgang_sas_idx_merk_S6_S3 /end COMPU_METHOD
/begin COMPU_METHOD Conv.cTciCompu._.flag_ende_kab_ber_erreicht_S6_S3 "Umrechnung fuer Messgroesse cTciCompu::flag_ende_kab_ber_erreicht" TAB_VERB "%4.0" "" COMPU_TAB_REF Conv.cTciCompu._.flag_ende_kab_ber_erreicht_S6_S3 /end COMPU_METHOD
/begin COMPU_METHOD Conv.cTciCompu._.flag_ende_kzu_ber_erreicht_S6_S3 "Umrechnung fuer Messgroesse cTciCompu::flag_ende_kzu_ber_erreicht" TAB_VERB "%4.0" "" COMPU_TAB_REF Conv.cTciCompu._.flag_ende_kzu_ber_erreicht_S6_S3 /end COMPU_METHOD
/begin COMPU_METHOD Conv.cTciCompu._.kupplung_max_S6_S3 "Umrechnung fuer Messgroesse cTciCompu::kupplung_max" TAB_VERB "%4.0" "" COMPU_TAB_REF Conv.cTciCompu._.kupplung_max_S6_S3 /end COMPU_METHOD
/begin COMPU_METHOD Conv.cTciCompu._.schaltart_sas_red_tci_S6_S3 "Umrechnung fuer Messgroesse cTciCompu::schaltart_sas_red_tci" TAB_VERB "%4.0" "" COMPU_TAB_REF Conv.cTciCompu._.schaltart_sas_red_tci_S6_S3 /end COMPU_METHOD
/begin COMPU_METHOD Conv.cTciTempM._.kupplung_S6_S3 "Umrechnung fuer Messgroesse cTciTempM::kupplung" TAB_VERB "%4.0" "" COMPU_TAB_REF Conv.cTciTempM._.kupplung_S6_S3 /end COMPU_METHOD
/begin COMPU_METHOD Conv.cKorSaste._.kup_kzu_S6_S3 "Umrechnung fuer Messgroesse cKorSaste::kup_kzu" TAB_VERB "%4.0" "" COMPU_TAB_REF Conv.cKorSaste._.kup_kzu_S6_S3 /end COMPU_METHOD
/begin COMPU_METHOD Conv.cKorSaste._.kup_kab_S6_S3 "Umrechnung fuer Messgroesse cKorSaste::kup_kab" TAB_VERB "%4.0" "" COMPU_TAB_REF Conv.cKorSaste._.kup_kab_S6_S3 /end COMPU_METHOD
/begin COMPU_METHOD Conv.cKorSaste._.kup_ge1_S6_S3 "Umrechnung fuer Messgroesse cKorSaste::kup_ge1" TAB_VERB "%4.0" "" COMPU_TAB_REF Conv.cKorSaste._.kup_ge1_S6_S3 /end COMPU_METHOD
/begin COMPU_METHOD Conv.cKorSaste._.kup_ge2_S6_S3 "Umrechnung fuer Messgroesse cKorSaste::kup_ge2" TAB_VERB "%4.0" "" COMPU_TAB_REF Conv.cKorSaste._.kup_ge2_S6_S3 /end COMPU_METHOD
/begin COMPU_METHOD Conv.cKorSaste._.kup_ge3_S6_S3 "Umrechnung fuer Messgroesse cKorSaste::kup_ge3" TAB_VERB "%4.0" "" COMPU_TAB_REF Conv.cKorSaste._.kup_ge3_S6_S3 /end COMPU_METHOD
/begin COMPU_METHOD Conv.cKorSaste._.kup_vkzu_S6_S3 "Umrechnung fuer Messgroesse cKorSaste::kup_vkzu" TAB_VERB "%4.0" "" COMPU_TAB_REF Conv.cKorSaste._.kup_vkzu_S6_S3 /end COMPU_METHOD
/begin COMPU_METHOD Conv.cKorSaste._.kup_vkab_S6_S3 "Umrechnung fuer Messgroesse cKorSaste::kup_vkab" TAB_VERB "%4.0" "" COMPU_TAB_REF Conv.cKorSaste._.kup_vkab_S6_S3 /end COMPU_METHOD
/begin COMPU_METHOD Conv.cKorSaste._.zielgang_vorbereitung_S6_S3 "Umrechnung fuer Messgroesse cKorSaste::zielgang_vorbereitung" TAB_VERB "%4.0" "" COMPU_TAB_REF Conv.cKorSaste._.zielgang_vorbereitung_S6_S3 /end COMPU_METHOD
/begin COMPU_METHOD Conv.cKorSaste._.zielgang_vorb_angefordert_S6_S3 "Umrechnung fuer Messgroesse cKorSaste::zielgang_vorb_angefordert" TAB_VERB "%4.0" "" COMPU_TAB_REF Conv.cKorSaste._.zielgang_vorb_angefordert_S6_S3 /end COMPU_METHOD
/begin COMPU_METHOD Conv.cKorSaste._.me_sas_status_S6_S3 "Umrechnung fuer Messgroesse cKorSaste::me_sas_status" TAB_VERB "%4.0" "" COMPU_TAB_REF Conv.cKorSaste._.me_sas_status_S6_S3 /end COMPU_METHOD
/begin COMPU_METHOD Conv.cKorSaste._.schaltungsabbruch_durch_ga_S6_S3 "Umrechnung fuer Messgroesse cKorSaste::schaltungsabbruch_durch_ga" TAB_VERB "%4.0" "" COMPU_TAB_REF Conv.cKorSaste._.schaltungsabbruch_durch_ga_S6_S3 /end COMPU_METHOD
/begin COMPU_METHOD Conv.cKorSaste._.start_vorbereitung_abgefragt_S6_S3 "Umrechnung fuer Messgroesse cKorSaste::start_vorbereitung_abgefragt" TAB_VERB "%4.0" "" COMPU_TAB_REF Conv.cKorSaste._.start_vorbereitung_abgefragt_S6_S3 /end COMPU_METHOD
/begin COMPU_METHOD Conv.cKorSaste._.z_zielg_vorb_S6_S3 "Umrechnung fuer Messgroesse cKorSaste::z_zielg_vorb" TAB_VERB "%4.0" "" COMPU_TAB_REF Conv.cKorSaste._.z_zielg_vorb_S6_S3 /end COMPU_METHOD
/begin COMPU_METHOD Conv.cKorSaste._.kup_kabvkzu_S6_S3 "Umrechnung fuer Messgroesse cKorSaste::kup_kabvkzu" TAB_VERB "%4.0" "" COMPU_TAB_REF Conv.cKorSaste._.kup_kabvkzu_S6_S3 /end COMPU_METHOD
/begin COMPU_METHOD Conv.cKorSaste._.f_start_vorb_mrs_nicht_mehr_erlaubt_S6_S3 "Umrechnung fuer Messgroesse cKorSaste::f_start_vorb_mrs_nicht_mehr_erlaubt" TAB_VERB "%4.0" "" COMPU_TAB_REF Conv.cKorSaste._.f_start_vorb_mrs_nicht_mehr_erlaubt_S6_S3 /end COMPU_METHOD
/begin COMPU_METHOD Conv.cSasStrat._.flag_red_bef_aush_sch_angef_S6_S3 "Umrechnung fuer Messgroesse cSasStrat::flag_red_bef_aush_sch_angef" TAB_VERB "%4.0" "" COMPU_TAB_REF Conv.cSasStrat._.flag_red_bef_aush_sch_angef_S6_S3 /end COMPU_METHOD
/begin COMPU_METHOD Conv.cSasStrat._.flag_red_bef_inh_sch_angef_S6_S3 "Umrechnung fuer Messgroesse cSasStrat::flag_red_bef_inh_sch_angef" TAB_VERB "%4.0" "" COMPU_TAB_REF Conv.cSasStrat._.flag_red_bef_inh_sch_angef_S6_S3 /end COMPU_METHOD
/begin COMPU_METHOD Conv.cSasStrat._.flag_opt_bef_aush_sch_angef_S6_S3 "Umrechnung fuer Messgroesse cSasStrat::flag_opt_bef_aush_sch_angef" TAB_VERB "%4.0" "" COMPU_TAB_REF Conv.cSasStrat._.flag_opt_bef_aush_sch_angef_S6_S3 /end COMPU_METHOD
/begin COMPU_METHOD Conv.cSasStrat._.flag_opt_bef_inh_sch_angef_S6_S3 "Umrechnung fuer Messgroesse cSasStrat::flag_opt_bef_inh_sch_angef" TAB_VERB "%4.0" "" COMPU_TAB_REF Conv.cSasStrat._.flag_opt_bef_inh_sch_angef_S6_S3 /end COMPU_METHOD
/begin COMPU_METHOD Conv.cSasStrat._.f_sltsf_estart_S6_S3 "Umrechnung fuer Messgroesse cSasStrat::f_sltsf_estart" TAB_VERB "%4.0" "" COMPU_TAB_REF Conv.cSasStrat._.f_sltsf_estart_S6_S3 /end COMPU_METHOD
/begin COMPU_METHOD Conv.cSasStrat._.f_nmot_ts_estart_S6_S3 "Umrechnung fuer Messgroesse cSasStrat::f_nmot_ts_estart" TAB_VERB "%4.0" "" COMPU_TAB_REF Conv.cSasStrat._.f_nmot_ts_estart_S6_S3 /end COMPU_METHOD
/begin COMPU_METHOD Conv.cSasStrat._.ber_red_durch_sf_notwendig_S6_S3 "Umrechnung fuer Messgroesse cSasStrat::ber_red_durch_sf_notwendig" TAB_VERB "%4.0" "" COMPU_TAB_REF Conv.cSasStrat._.ber_red_durch_sf_notwendig_S6_S3 /end COMPU_METHOD
/begin COMPU_METHOD Conv.cSasKflwe._.z_reversierfkt_S6_S3 "Umrechnung fuer Messgroesse cSasKflwe::z_reversierfkt" TAB_VERB "%4.0" "" COMPU_TAB_REF Conv.cSasKflwe._.z_reversierfkt_S6_S3 /end COMPU_METHOD
/begin COMPU_METHOD Conv.cSasKflwe._.kup1_kflw_S6_S3 "Umrechnung fuer Messgroesse cSasKflwe::kup1_kflw" TAB_VERB "%4.0" "" COMPU_TAB_REF Conv.cSasKflwe._.kup1_kflw_S6_S3 /end COMPU_METHOD
/begin COMPU_METHOD Conv.cSasKflwe._.kup2_kflw_S6_S3 "Umrechnung fuer Messgroesse cSasKflwe::kup2_kflw" TAB_VERB "%4.0" "" COMPU_TAB_REF Conv.cSasKflwe._.kup2_kflw_S6_S3 /end COMPU_METHOD
/begin COMPU_METHOD Conv.cMoeMesaf._.me_sas_pos_vor_stat_S6_S3 "Umrechnung fuer Messgroesse cMoeMesaf::me_sas_pos_vor_stat" TAB_VERB "%4.0" "" COMPU_TAB_REF Conv.cMoeMesaf._.me_sas_pos_vor_stat_S6_S3 /end COMPU_METHOD
/begin COMPU_METHOD Conv.cMoeMesaf._.flag_me_haupt_aktiv_S6_S3 "Umrechnung fuer Messgroesse cMoeMesaf::flag_me_haupt_aktiv" TAB_VERB "%4.0" "" COMPU_TAB_REF Conv.cMoeMesaf._.flag_me_haupt_aktiv_S6_S3 /end COMPU_METHOD
/begin COMPU_METHOD Conv.cMoeMesaf._.zust_haupt_me_gestartet_S6_S3 "Umrechnung fuer Messgroesse cMoeMesaf::zust_haupt_me_gestartet" TAB_VERB "%4.0" "" COMPU_TAB_REF Conv.cMoeMesaf._.zust_haupt_me_gestartet_S6_S3 /end COMPU_METHOD
/begin COMPU_METHOD Conv.cMoeMesaf._.stat_me_klass_S6_S3 "Umrechnung fuer Messgroesse cMoeMesaf::stat_me_klass" TAB_VERB "%4.0" "" COMPU_TAB_REF Conv.cMoeMesaf._.stat_me_klass_S6_S3 /end COMPU_METHOD
/begin COMPU_METHOD Conv.cMoeMesaf._.schalttyp_mes_S6_S3 "Umrechnung fuer Messgroesse cMoeMesaf::schalttyp_mes" TAB_VERB "%4.0" "" COMPU_TAB_REF Conv.cMoeMesaf._.schalttyp_mes_S6_S3 /end COMPU_METHOD
/begin COMPU_METHOD Conv.cMoeMesaf._.f_unterdr_me_S6_S3 "Umrechnung fuer Messgroesse cMoeMesaf::f_unterdr_me" TAB_VERB "%4.0" "" COMPU_TAB_REF Conv.cMoeMesaf._.f_unterdr_me_S6_S3 /end COMPU_METHOD
/begin COMPU_METHOD Conv.cMoeMesaf._.z_mes_S6_S3 "Umrechnung fuer Messgroesse cMoeMesaf::z_mes" TAB_VERB "%4.0" "" COMPU_TAB_REF Conv.cMoeMesaf._.z_mes_S6_S3 /end COMPU_METHOD
/begin COMPU_METHOD Conv.cMoeMesaf._.me_lastruecknahme_hs_aktiv_S6_S3 "Umrechnung fuer Messgroesse cMoeMesaf::me_lastruecknahme_hs_aktiv" TAB_VERB "%4.0" "" COMPU_TAB_REF Conv.cMoeMesaf._.me_lastruecknahme_hs_aktiv_S6_S3 /end COMPU_METHOD
/begin COMPU_METHOD Conv.cMoeMesaf._.me_lastruecknahme_hs_erlaubt_S6_S3 "Umrechnung fuer Messgroesse cMoeMesaf::me_lastruecknahme_hs_erlaubt" TAB_VERB "%4.0" "" COMPU_TAB_REF Conv.cMoeMesaf._.me_lastruecknahme_hs_erlaubt_S6_S3 /end COMPU_METHOD
/begin COMPU_METHOD Conv.cMoeMesaf._.diag_me_sas_S6_S3 "Umrechnung fuer Messgroesse cMoeMesaf::diag_me_sas" TAB_VERB "%4.0" "" COMPU_TAB_REF Conv.cMoeMesaf._.diag_me_sas_S6_S3 /end COMPU_METHOD
/begin COMPU_METHOD Conv.cMoeMesaf._.f_rueckfilter_aktiv_ausschaltung_S6_S3 "Umrechnung fuer Messgroesse cMoeMesaf::f_rueckfilter_aktiv_ausschaltung" TAB_VERB "%4.0" "" COMPU_TAB_REF Conv.cMoeMesaf._.f_rueckfilter_aktiv_ausschaltung_S6_S3 /end COMPU_METHOD
/begin COMPU_METHOD Conv.cMoeMesaf._.f_neuber_startz_hme_hs_angef_S6_S3 "Umrechnung fuer Messgroesse cMoeMesaf::f_neuber_startz_hme_hs_angef" TAB_VERB "%4.0" "" COMPU_TAB_REF Conv.cMoeMesaf._.f_neuber_startz_hme_hs_angef_S6_S3 /end COMPU_METHOD
/begin COMPU_METHOD Conv.cMoeMesaf._.f_neuber_startz_hme_hs_erfolgt_S6_S3 "Umrechnung fuer Messgroesse cMoeMesaf::f_neuber_startz_hme_hs_erfolgt" TAB_VERB "%4.0" "" COMPU_TAB_REF Conv.cMoeMesaf._.f_neuber_startz_hme_hs_erfolgt_S6_S3 /end COMPU_METHOD
/begin COMPU_METHOD Conv.cMoeMesaf._.flag_meklass_erlaubt_S6_S3 "Umrechnung fuer Messgroesse cMoeMesaf::flag_meklass_erlaubt" TAB_VERB "%4.0" "" COMPU_TAB_REF Conv.cMoeMesaf._.flag_meklass_erlaubt_S6_S3 /end COMPU_METHOD
/begin COMPU_METHOD Conv.cMoeMesaf._.flag_me_klassifizierung_erfolgt_S6_S3 "Umrechnung fuer Messgroesse cMoeMesaf::flag_me_klassifizierung_erfolgt" TAB_VERB "%4.0" "" COMPU_TAB_REF Conv.cMoeMesaf._.flag_me_klassifizierung_erfolgt_S6_S3 /end COMPU_METHOD
/begin COMPU_METHOD Conv.cMoeMesaf._.nachme_rs_losgelaufen_S6_S3 "Umrechnung fuer Messgroesse cMoeMesaf::nachme_rs_losgelaufen" TAB_VERB "%4.0" "" COMPU_TAB_REF Conv.cMoeMesaf._.nachme_rs_losgelaufen_S6_S3 /end COMPU_METHOD
/begin COMPU_METHOD Conv.cMoeMesaf._.flag_schaltung_mes_aktiv_S6_S3 "Umrechnung fuer Messgroesse cMoeMesaf::flag_schaltung_mes_aktiv" TAB_VERB "%4.0" "" COMPU_TAB_REF Conv.cMoeMesaf._.flag_schaltung_mes_aktiv_S6_S3 /end COMPU_METHOD
/begin COMPU_METHOD Conv.cMoeMesaf._.f_timer_sperrzeit_hme_gesetzt_S6_S3 "Umrechnung fuer Messgroesse cMoeMesaf::f_timer_sperrzeit_hme_gesetzt" TAB_VERB "%4.0" "" COMPU_TAB_REF Conv.cMoeMesaf._.f_timer_sperrzeit_hme_gesetzt_S6_S3 /end COMPU_METHOD
/begin COMPU_METHOD Conv.cMoeMesaf._.momentenerhoehung_erlaubt_S6_S3 "Umrechnung fuer Messgroesse cMoeMesaf::momentenerhoehung_erlaubt" TAB_VERB "%4.0" "" COMPU_TAB_REF Conv.cMoeMesaf._.momentenerhoehung_erlaubt_S6_S3 /end COMPU_METHOD
/begin COMPU_METHOD Conv.cMoeMesaf._.momentenerhoehung_erlaubt_alt_S6_S3 "Umrechnung fuer Messgroesse cMoeMesaf::momentenerhoehung_erlaubt_alt" TAB_VERB "%4.0" "" COMPU_TAB_REF Conv.cMoeMesaf._.momentenerhoehung_erlaubt_alt_S6_S3 /end COMPU_METHOD
/begin COMPU_METHOD Conv.cMoeMesaf._.flag_kf_mehaupt_abfilter_S6_S3 "Umrechnung fuer Messgroesse cMoeMesaf::flag_kf_mehaupt_abfilter" TAB_VERB "%4.0" "" COMPU_TAB_REF Conv.cMoeMesaf._.flag_kf_mehaupt_abfilter_S6_S3 /end COMPU_METHOD
/begin COMPU_METHOD Conv.cMoeMesaf._.flag_akt_me_sas_gesp_ramp_S6_S3 "Umrechnung fuer Messgroesse cMoeMesaf::flag_akt_me_sas_gesp_ramp" TAB_VERB "%4.0" "" COMPU_TAB_REF Conv.cMoeMesaf._.flag_akt_me_sas_gesp_ramp_S6_S3 /end COMPU_METHOD
/begin COMPU_METHOD Conv.cMonMoSig._.mon_mst_status_S6_S3 "Umrechnung fuer Messgroesse cMonMoSig::mon_mst_status" TAB_VERB "%4.0" "" COMPU_TAB_REF Conv.cMonMoSig._.mon_mst_status_S6_S3 /end COMPU_METHOD
/begin COMPU_METHOD Conv.cNotInfoEgDirekt._.ersatzgang_S6_S3 "Umrechnung fuer Messgroesse cNotInfoEgDirekt::ersatzgang" TAB_VERB "%4.0" "" COMPU_TAB_REF Conv.cNotInfoEgDirekt._.ersatzgang_S6_S3 /end COMPU_METHOD
/begin COMPU_METHOD Conv.cKorDiagl._.ersatzgang_S6_S3 "Umrechnung fuer Messgroesse cKorDiagl::ersatzgang" TAB_VERB "%4.0" "" COMPU_TAB_REF Conv.cKorDiagl._.ersatzgang_S6_S3 /end COMPU_METHOD
/begin COMPU_METHOD Conv.cKorDiagl._.symptom_aktiv_S6_S3 "Umrechnung fuer Messgroesse cKorDiagl::symptom_aktiv" TAB_VERB "%4.0" "" COMPU_TAB_REF Conv.cKorDiagl._.symptom_aktiv_S6_S3 /end COMPU_METHOD
/begin COMPU_METHOD Conv.cKorDiagl._.b_eg_uwig_direkt_getr_notlaufsp_S6_S3 "Umrechnung fuer Messgroesse cKorDiagl::b_eg_uwig_direkt_getr_notlaufsp" TAB_VERB "%4.0" "" COMPU_TAB_REF Conv.cKorDiagl._.b_eg_uwig_direkt_getr_notlaufsp_S6_S3 /end COMPU_METHOD
/begin COMPU_METHOD Conv.cUewIgEinstBed._.flag_symptom_pruefen_S6_S3 "Umrechnung fuer Messgroesse cUewIgEinstBed::flag_symptom_pruefen" TAB_VERB "%4.0" "" COMPU_TAB_REF Conv.cUewIgEinstBed._.flag_symptom_pruefen_S6_S3 /end COMPU_METHOD
/begin COMPU_METHOD Conv.cUewIgetr._.uwig_pruefstatus_kup_a_S6_S3 "Umrechnung fuer Messgroesse cUewIgetr::uwig_pruefstatus_kup_a" TAB_VERB "%4.0" "" COMPU_TAB_REF Conv.cUewIgetr._.uwig_pruefstatus_kup_a_S6_S3 /end COMPU_METHOD
/begin COMPU_METHOD Conv.cUewIgetr._.uwig_pruefstatus_kup_b_S6_S3 "Umrechnung fuer Messgroesse cUewIgetr::uwig_pruefstatus_kup_b" TAB_VERB "%4.0" "" COMPU_TAB_REF Conv.cUewIgetr._.uwig_pruefstatus_kup_b_S6_S3 /end COMPU_METHOD
/begin COMPU_METHOD Conv.cUewIgetr._.uwig_pruefstatus_kup_c_S6_S3 "Umrechnung fuer Messgroesse cUewIgetr::uwig_pruefstatus_kup_c" TAB_VERB "%4.0" "" COMPU_TAB_REF Conv.cUewIgetr._.uwig_pruefstatus_kup_c_S6_S3 /end COMPU_METHOD
/begin COMPU_METHOD Conv.cUewIgetr._.uwig_pruefstatus_kup_d_S6_S3 "Umrechnung fuer Messgroesse cUewIgetr::uwig_pruefstatus_kup_d" TAB_VERB "%4.0" "" COMPU_TAB_REF Conv.cUewIgetr._.uwig_pruefstatus_kup_d_S6_S3 /end COMPU_METHOD
/begin COMPU_METHOD Conv.cUewIgetr._.uwig_pruefstatus_kup_e_S6_S3 "Umrechnung fuer Messgroesse cUewIgetr::uwig_pruefstatus_kup_e" TAB_VERB "%4.0" "" COMPU_TAB_REF Conv.cUewIgetr._.uwig_pruefstatus_kup_e_S6_S3 /end COMPU_METHOD
/begin COMPU_METHOD Conv.cUewIgetr._.zustand_uwig_S6_S3 "Umrechnung fuer Messgroesse cUewIgetr::zustand_uwig" TAB_VERB "%4.0" "" COMPU_TAB_REF Conv.cUewIgetr._.zustand_uwig_S6_S3 /end COMPU_METHOD
/begin COMPU_METHOD Conv.cUewIgetr._.b_uwig_auf_symptom_pruefen_S6_S3 "Umrechnung fuer Messgroesse cUewIgetr::b_uwig_auf_symptom_pruefen" TAB_VERB "%4.0" "" COMPU_TAB_REF Conv.cUewIgetr._.b_uwig_auf_symptom_pruefen_S6_S3 /end COMPU_METHOD
/begin COMPU_METHOD Conv.cUewIgetr._.symptom_uwig_r_gang_aktiv_S6_S3 "Umrechnung fuer Messgroesse cUewIgetr::symptom_uwig_r_gang_aktiv" TAB_VERB "%4.0" "" COMPU_TAB_REF Conv.cUewIgetr._.symptom_uwig_r_gang_aktiv_S6_S3 /end COMPU_METHOD
/begin COMPU_METHOD Conv.cUewIgetr._.uwig_abbruchgang_S6_S3 "Umrechnung fuer Messgroesse cUewIgetr::uwig_abbruchgang" TAB_VERB "%4.0" "" COMPU_TAB_REF Conv.cUewIgetr._.uwig_abbruchgang_S6_S3 /end COMPU_METHOD
/begin COMPU_METHOD Conv.cUewIgetr._.flg_kuppident_S6_S3 "Umrechnung fuer Messgroesse cUewIgetr::flg_kuppident" TAB_VERB "%4.0" "" COMPU_TAB_REF Conv.cUewIgetr._.flg_kuppident_S6_S3 /end COMPU_METHOD
/begin COMPU_METHOD Conv.cUewIgetr._.flg_kfc_ratioglobal_S6_S3 "Umrechnung fuer Messgroesse cUewIgetr::flg_kfc_ratioglobal" TAB_VERB "%4.0" "" COMPU_TAB_REF Conv.cUewIgetr._.flg_kfc_ratioglobal_S6_S3 /end COMPU_METHOD
/begin COMPU_METHOD Conv.cUewIgetr._.schaltart_akt_uew_stc_S6_S3 "Umrechnung fuer Messgroesse cUewIgetr::schaltart_akt_uew_stc" TAB_VERB "%4.0" "" COMPU_TAB_REF Conv.cUewIgetr._.schaltart_akt_uew_stc_S6_S3 /end COMPU_METHOD
/begin COMPU_METHOD Conv.cUewIgetr._.zielgang_sas_akt_uew_stc_S6_S3 "Umrechnung fuer Messgroesse cUewIgetr::zielgang_sas_akt_uew_stc" TAB_VERB "%4.0" "" COMPU_TAB_REF Conv.cUewIgetr._.zielgang_sas_akt_uew_stc_S6_S3 /end COMPU_METHOD
/begin COMPU_METHOD Conv.cUewIgetr._.istgang_akt_uew_stc_S6_S3 "Umrechnung fuer Messgroesse cUewIgetr::istgang_akt_uew_stc" TAB_VERB "%4.0" "" COMPU_TAB_REF Conv.cUewIgetr._.istgang_akt_uew_stc_S6_S3 /end COMPU_METHOD
/begin COMPU_METHOD Conv.cUewIgetr._.istgang_vorherige_schaltung_stc_S6_S3 "Umrechnung fuer Messgroesse cUewIgetr::istgang_vorherige_schaltung_stc" TAB_VERB "%4.0" "" COMPU_TAB_REF Conv.cUewIgetr._.istgang_vorherige_schaltung_stc_S6_S3 /end COMPU_METHOD
/begin COMPU_METHOD Conv.cUewIgetr._.eprg_schalt_np_istgang_S6_S3 "Umrechnung fuer Messgroesse cUewIgetr::eprg_schalt_np_istgang" TAB_VERB "%4.0" "" COMPU_TAB_REF Conv.cUewIgetr._.eprg_schalt_np_istgang_S6_S3 /end COMPU_METHOD
/begin COMPU_METHOD Conv.cUewIgetr._.eprg_schalt_np_zielgang_sas_S6_S3 "Umrechnung fuer Messgroesse cUewIgetr::eprg_schalt_np_zielgang_sas" TAB_VERB "%4.0" "" COMPU_TAB_REF Conv.cUewIgetr._.eprg_schalt_np_zielgang_sas_S6_S3 /end COMPU_METHOD
/begin COMPU_METHOD Conv.cUewIgetr._.f_ist_schaltung_stc_S6_S3 "Umrechnung fuer Messgroesse cUewIgetr::f_ist_schaltung_stc" TAB_VERB "%4.0" "" COMPU_TAB_REF Conv.cUewIgetr._.f_ist_schaltung_stc_S6_S3 /end COMPU_METHOD
/begin COMPU_METHOD Conv.cUewIgetr._.f_ist_stoerung_stc_S6_S3 "Umrechnung fuer Messgroesse cUewIgetr::f_ist_stoerung_stc" TAB_VERB "%4.0" "" COMPU_TAB_REF Conv.cUewIgetr._.f_ist_stoerung_stc_S6_S3 /end COMPU_METHOD
/begin COMPU_METHOD Conv.cUewIgetr._.f_ist_symptom_gang_stc_S6_S3 "Umrechnung fuer Messgroesse cUewIgetr::f_ist_symptom_gang_stc" TAB_VERB "%4.0" "" COMPU_TAB_REF Conv.cUewIgetr._.f_ist_symptom_gang_stc_S6_S3 /end COMPU_METHOD
/begin COMPU_METHOD Conv.cUewIgetr._.f_ist_symptom_schalt_stc_S6_S3 "Umrechnung fuer Messgroesse cUewIgetr::f_ist_symptom_schalt_stc" TAB_VERB "%4.0" "" COMPU_TAB_REF Conv.cUewIgetr._.f_ist_symptom_schalt_stc_S6_S3 /end COMPU_METHOD
/begin COMPU_METHOD Conv.cUewIgetr._.f_ist_symptom_ge_stc_S6_S3 "Umrechnung fuer Messgroesse cUewIgetr::f_ist_symptom_ge_stc" TAB_VERB "%4.0" "" COMPU_TAB_REF Conv.cUewIgetr._.f_ist_symptom_ge_stc_S6_S3 /end COMPU_METHOD
/begin COMPU_METHOD Conv.cUewIgetr._.f_ist_ersatzgang_schalt_stc_S6_S3 "Umrechnung fuer Messgroesse cUewIgetr::f_ist_ersatzgang_schalt_stc" TAB_VERB "%4.0" "" COMPU_TAB_REF Conv.cUewIgetr._.f_ist_ersatzgang_schalt_stc_S6_S3 /end COMPU_METHOD
/begin COMPU_METHOD Conv.cUewIgetr._.f_ist_ersatzgang_gang_stc_S6_S3 "Umrechnung fuer Messgroesse cUewIgetr::f_ist_ersatzgang_gang_stc" TAB_VERB "%4.0" "" COMPU_TAB_REF Conv.cUewIgetr._.f_ist_ersatzgang_gang_stc_S6_S3 /end COMPU_METHOD
/begin COMPU_METHOD Conv.cUewIgetr._.f_ist_ersatzgang_ge_stc_S6_S3 "Umrechnung fuer Messgroesse cUewIgetr::f_ist_ersatzgang_ge_stc" TAB_VERB "%4.0" "" COMPU_TAB_REF Conv.cUewIgetr._.f_ist_ersatzgang_ge_stc_S6_S3 /end COMPU_METHOD
/begin COMPU_METHOD Conv.cUewIgetr._.f_ist_neue_schaltung_stc_S6_S3 "Umrechnung fuer Messgroesse cUewIgetr::f_ist_neue_schaltung_stc" TAB_VERB "%4.0" "" COMPU_TAB_REF Conv.cUewIgetr._.f_ist_neue_schaltung_stc_S6_S3 /end COMPU_METHOD
/begin COMPU_METHOD Conv.cUewIgetr._.f_ist_neues_ge_stc_S6_S3 "Umrechnung fuer Messgroesse cUewIgetr::f_ist_neues_ge_stc" TAB_VERB "%4.0" "" COMPU_TAB_REF Conv.cUewIgetr._.f_ist_neues_ge_stc_S6_S3 /end COMPU_METHOD
/begin COMPU_METHOD Conv.cUewIgetr._.f_schalt_durch_sym_schalt_stc_S6_S3 "Umrechnung fuer Messgroesse cUewIgetr::f_schalt_durch_sym_schalt_stc" TAB_VERB "%4.0" "" COMPU_TAB_REF Conv.cUewIgetr._.f_schalt_durch_sym_schalt_stc_S6_S3 /end COMPU_METHOD
/begin COMPU_METHOD Conv.cUewIgetr._.f_timer16_rampe_gestartet_stc_S6_S3 "Umrechnung fuer Messgroesse cUewIgetr::f_timer16_rampe_gestartet_stc" TAB_VERB "%4.0" "" COMPU_TAB_REF Conv.cUewIgetr._.f_timer16_rampe_gestartet_stc_S6_S3 /end COMPU_METHOD
/begin COMPU_METHOD Conv.cUewIgetr._.f_abbruch_akt_ueberwachung_S6_S3 "Umrechnung fuer Messgroesse cUewIgetr::f_abbruch_akt_ueberwachung" TAB_VERB "%4.0" "" COMPU_TAB_REF Conv.cUewIgetr._.f_abbruch_akt_ueberwachung_S6_S3 /end COMPU_METHOD
/begin COMPU_METHOD Conv.cUewIgetr._.f_ist_nab_kleiner_schwelle_stc_S6_S3 "Umrechnung fuer Messgroesse cUewIgetr::f_ist_nab_kleiner_schwelle_stc" TAB_VERB "%4.0" "" COMPU_TAB_REF Conv.cUewIgetr._.f_ist_nab_kleiner_schwelle_stc_S6_S3 /end COMPU_METHOD
/begin COMPU_METHOD Conv.cUewIgetr._.f_ist_ge_stc_S6_S3 "Umrechnung fuer Messgroesse cUewIgetr::f_ist_ge_stc" TAB_VERB "%4.0" "" COMPU_TAB_REF Conv.cUewIgetr._.f_ist_ge_stc_S6_S3 /end COMPU_METHOD
/begin COMPU_METHOD Conv.cUewIgetr._.f_ueberwache_ge_stc_S6_S3 "Umrechnung fuer Messgroesse cUewIgetr::f_ueberwache_ge_stc" TAB_VERB "%4.0" "" COMPU_TAB_REF Conv.cUewIgetr._.f_ueberwache_ge_stc_S6_S3 /end COMPU_METHOD
/begin COMPU_METHOD Conv.cUewIgetr._.f_pruefbed_im_gang_erreicht_stc_S6_S3 "Umrechnung fuer Messgroesse cUewIgetr::f_pruefbed_im_gang_erreicht_stc" TAB_VERB "%4.0" "" COMPU_TAB_REF Conv.cUewIgetr._.f_pruefbed_im_gang_erreicht_stc_S6_S3 /end COMPU_METHOD
/begin COMPU_METHOD Conv.cUewIgetr._.f_stoer_offset_in_schaltung_stc_S6_S3 "Umrechnung fuer Messgroesse cUewIgetr::f_stoer_offset_in_schaltung_stc" TAB_VERB "%4.0" "" COMPU_TAB_REF Conv.cUewIgetr._.f_stoer_offset_in_schaltung_stc_S6_S3 /end COMPU_METHOD
/begin COMPU_METHOD Conv.cUewIgetr._.f_ersatzwert_stc_S6_S3 "Umrechnung fuer Messgroesse cUewIgetr::f_ersatzwert_stc" TAB_VERB "%4.0" "" COMPU_TAB_REF Conv.cUewIgetr._.f_ersatzwert_stc_S6_S3 /end COMPU_METHOD
/begin COMPU_METHOD Conv.cUewIgetr._.f_ersatzprogramm_aktiv_S6_S3 "Umrechnung fuer Messgroesse cUewIgetr::f_ersatzprogramm_aktiv" TAB_VERB "%4.0" "" COMPU_TAB_REF Conv.cUewIgetr._.f_ersatzprogramm_aktiv_S6_S3 /end COMPU_METHOD
/begin COMPU_METHOD Conv.cUewIgetr._.kfl_ziel_bei_symptom_stc_S6_S3 "Umrechnung fuer Messgroesse cUewIgetr::kfl_ziel_bei_symptom_stc" TAB_VERB "%4.0" "" COMPU_TAB_REF Conv.cUewIgetr._.kfl_ziel_bei_symptom_stc_S6_S3 /end COMPU_METHOD
/begin COMPU_METHOD Conv.cUewIgetr._.kup_ge1_stc_S6_S3 "Umrechnung fuer Messgroesse cUewIgetr::kup_ge1_stc" TAB_VERB "%4.0" "" COMPU_TAB_REF Conv.cUewIgetr._.kup_ge1_stc_S6_S3 /end COMPU_METHOD
/begin COMPU_METHOD Conv.cUewIgetr._.kup_ge2_stc_S6_S3 "Umrechnung fuer Messgroesse cUewIgetr::kup_ge2_stc" TAB_VERB "%4.0" "" COMPU_TAB_REF Conv.cUewIgetr._.kup_ge2_stc_S6_S3 /end COMPU_METHOD
/begin COMPU_METHOD Conv.cUewIgetr._.kup_ge3_stc_S6_S3 "Umrechnung fuer Messgroesse cUewIgetr::kup_ge3_stc" TAB_VERB "%4.0" "" COMPU_TAB_REF Conv.cUewIgetr._.kup_ge3_stc_S6_S3 /end COMPU_METHOD
/begin COMPU_METHOD Conv.cUewIgetr._.fl_sym_iepuwig_S6_S3 "Umrechnung fuer Messgroesse cUewIgetr::fl_sym_iepuwig" TAB_VERB "%4.0" "" COMPU_TAB_REF Conv.cUewIgetr._.fl_sym_iepuwig_S6_S3 /end COMPU_METHOD
/begin COMPU_METHOD Conv.cUewIgetr._.fl_erf_iepuwig_S6_S3 "Umrechnung fuer Messgroesse cUewIgetr::fl_erf_iepuwig" TAB_VERB "%4.0" "" COMPU_TAB_REF Conv.cUewIgetr._.fl_erf_iepuwig_S6_S3 /end COMPU_METHOD
/begin COMPU_METHOD Conv.cUewIgetr._.symptom_reaktion_S6_S3 "Umrechnung fuer Messgroesse cUewIgetr::symptom_reaktion" TAB_VERB "%4.0" "" COMPU_TAB_REF Conv.cUewIgetr._.symptom_reaktion_S6_S3 /end COMPU_METHOD
/begin COMPU_METHOD Conv.cUewParksperrenmagnet._.flag_einstiegsbed_S6_S3 "Umrechnung fuer Messgroesse cUewParksperrenmagnet::flag_einstiegsbed" TAB_VERB "%4.0" "" COMPU_TAB_REF Conv.cUewParksperrenmagnet._.flag_einstiegsbed_S6_S3 /end COMPU_METHOD
/begin COMPU_METHOD Conv.cUewParksperrenmagnet._.reset_timer_pmueb_S6_S3 "Umrechnung fuer Messgroesse cUewParksperrenmagnet::reset_timer_pmueb" TAB_VERB "%4.0" "" COMPU_TAB_REF Conv.cUewParksperrenmagnet._.reset_timer_pmueb_S6_S3 /end COMPU_METHOD
/begin COMPU_METHOD Conv.cUewParksperrenmagnet._.z_pmueb_S6_S3 "Umrechnung fuer Messgroesse cUewParksperrenmagnet::z_pmueb" TAB_VERB "%4.0" "" COMPU_TAB_REF Conv.cUewParksperrenmagnet._.z_pmueb_S6_S3 /end COMPU_METHOD
/begin COMPU_METHOD Conv.cUewParksperrenmagnet._.zustand_S6_S3 "Umrechnung fuer Messgroesse cUewParksperrenmagnet::zustand" TAB_VERB "%4.0" "" COMPU_TAB_REF Conv.cUewParksperrenmagnet._.zustand_S6_S3 /end COMPU_METHOD
/begin COMPU_METHOD Conv.cDiaRbmif._.flag_rbm_zustand_uwigschalt_S6_S3 "Umrechnung fuer Messgroesse cDiaRbmif::flag_rbm_zustand_uwigschalt" TAB_VERB "%4.0" "" COMPU_TAB_REF Conv.cDiaRbmif._.flag_rbm_zustand_uwigschalt_S6_S3 /end COMPU_METHOD
/begin COMPU_METHOD Conv.cDiaRbmif._.flag_rbm_zustand_uwigkup_S6_S3 "Umrechnung fuer Messgroesse cDiaRbmif::flag_rbm_zustand_uwigkup" TAB_VERB "%4.0" "" COMPU_TAB_REF Conv.cDiaRbmif._.flag_rbm_zustand_uwigkup_S6_S3 /end COMPU_METHOD
/begin COMPU_METHOD Conv.cDiaRbmif._.rbm_zielgang_sas_vorw_alt_S6_S3 "Umrechnung fuer Messgroesse cDiaRbmif::rbm_zielgang_sas_vorw_alt" TAB_VERB "%4.0" "" COMPU_TAB_REF Conv.cDiaRbmif._.rbm_zielgang_sas_vorw_alt_S6_S3 /end COMPU_METHOD
/begin COMPU_METHOD Conv.cDiaRbmif._.rbm_istgang_vorw_alt_S6_S3 "Umrechnung fuer Messgroesse cDiaRbmif::rbm_istgang_vorw_alt" TAB_VERB "%4.0" "" COMPU_TAB_REF Conv.cDiaRbmif._.rbm_istgang_vorw_alt_S6_S3 /end COMPU_METHOD
/begin COMPU_METHOD Conv.cDiaRbmif._.flag_rbm_zust_inaktiv_iae_S6_S3 "Umrechnung fuer Messgroesse cDiaRbmif::flag_rbm_zust_inaktiv_iae" TAB_VERB "%4.0" "" COMPU_TAB_REF Conv.cDiaRbmif._.flag_rbm_zust_inaktiv_iae_S6_S3 /end COMPU_METHOD
/begin COMPU_METHOD Conv.cDiaRbmif._.flag_rbm_zust_hanfahr_iae_S6_S3 "Umrechnung fuer Messgroesse cDiaRbmif::flag_rbm_zust_hanfahr_iae" TAB_VERB "%4.0" "" COMPU_TAB_REF Conv.cDiaRbmif._.flag_rbm_zust_hanfahr_iae_S6_S3 /end COMPU_METHOD
/begin COMPU_METHOD Conv.cBasFehlerErfolgInt._.flag_fehler_S6_S3 "Umrechnung fuer Messgroesse cBasFehlerErfolgInt::flag_fehler" TAB_VERB "%4.0" "" COMPU_TAB_REF Conv.cBasFehlerErfolgInt._.flag_fehler_S6_S3 /end COMPU_METHOD
/begin COMPU_METHOD Conv.cBasFehlerErfolgFl._.flag_fehler_S6_S3 "Umrechnung fuer Messgroesse cBasFehlerErfolgFl::flag_fehler" TAB_VERB "%4.0" "" COMPU_TAB_REF Conv.cBasFehlerErfolgFl._.flag_fehler_S6_S3 /end COMPU_METHOD
/begin COMPU_VTAB Conv.cTciCompu._.k_ab_S6_S3 "Umrechnung fuer Messgroesse cTciCompu::k_ab" TAB_VERB 6 0 "KEINE" 1 "K_A" 2 "K_B" 3 "K_C" 4 "K_D" 5 "K_E" /end COMPU_VTAB
/begin COMPU_VTAB Conv.cTciCompu._.k_zu_S6_S3 "Umrechnung fuer Messgroesse cTciCompu::k_zu" TAB_VERB 6 0 "KEINE" 1 "K_A" 2 "K_B" 3 "K_C" 4 "K_D" 5 "K_E" /end COMPU_VTAB
/begin COMPU_VTAB Conv.cTciCompu._.z_tci_S6_S3 "Umrechnung fuer Messgroesse cTciCompu::z_tci" TAB_VERB 3 0 "Kupplungsbelastung passiv" 1 "Berechnung Kupplungsbelastung Gangeinlegen aktiv" 2 "Berechnung Kupplungsbelastung Schaltung aktiv" /end COMPU_VTAB
/begin COMPU_VTAB Conv.cTciCompu._.istgang_idx_merk_S6_S3 "Umrechnung fuer Messgroesse cTciCompu::istgang_idx_merk" TAB_VERB 10 0 "GR1" 1 "KEIN_GANG" 2 "G1" 3 "G2" 4 "G3" 5 "G4" 6 "G5" 7 "G6" 8 "G7" 9 "G8" /end COMPU_VTAB
/begin COMPU_VTAB Conv.cTciCompu._.zielgang_sas_idx_merk_S6_S3 "Umrechnung fuer Messgroesse cTciCompu::zielgang_sas_idx_merk" TAB_VERB 10 0 "GR1" 1 "KEIN_GANG" 2 "G1" 3 "G2" 4 "G3" 5 "G4" 6 "G5" 7 "G6" 8 "G7" 9 "G8" /end COMPU_VTAB
/begin COMPU_VTAB Conv.cTciCompu._.flag_ende_kab_ber_erreicht_S6_S3 "Umrechnung fuer Messgroesse cTciCompu::flag_ende_kab_ber_erreicht" TAB_VERB 2 0 "FALSE" 1 "TRUE" /end COMPU_VTAB
/begin COMPU_VTAB Conv.cTciCompu._.flag_ende_kzu_ber_erreicht_S6_S3 "Umrechnung fuer Messgroesse cTciCompu::flag_ende_kzu_ber_erreicht" TAB_VERB 2 0 "FALSE" 1 "TRUE" /end COMPU_VTAB
/begin COMPU_VTAB Conv.cTciCompu._.kupplung_max_S6_S3 "Umrechnung fuer Messgroesse cTciCompu::kupplung_max" TAB_VERB 6 0 "KEINE" 1 "K_A" 2 "K_B" 3 "K_C" 4 "K_D" 5 "K_E" /end COMPU_VTAB
/begin COMPU_VTAB Conv.cTciCompu._.schaltart_sas_red_tci_S6_S3 "Umrechnung fuer Messgroesse cTciCompu::schaltart_sas_red_tci" TAB_VERB 3 1 "HS" 2 "RS" 3 "SCHALTART_GEGA_TCI" /end COMPU_VTAB
/begin COMPU_VTAB Conv.cTciTempM._.kupplung_S6_S3 "Umrechnung fuer Messgroesse cTciTempM::kupplung" TAB_VERB 6 0 "KEINE" 1 "K_A" 2 "K_B" 3 "K_C" 4 "K_D" 5 "K_E" /end COMPU_VTAB
/begin COMPU_VTAB Conv.cKorSaste._.kup_kzu_S6_S3 "Umrechnung fuer Messgroesse cKorSaste::kup_kzu" TAB_VERB 6 0 "KEINE" 1 "K_A" 2 "K_B" 3 "K_C" 4 "K_D" 5 "K_E" /end COMPU_VTAB
/begin COMPU_VTAB Conv.cKorSaste._.kup_kab_S6_S3 "Umrechnung fuer Messgroesse cKorSaste::kup_kab" TAB_VERB 6 0 "KEINE" 1 "K_A" 2 "K_B" 3 "K_C" 4 "K_D" 5 "K_E" /end COMPU_VTAB
/begin COMPU_VTAB Conv.cKorSaste._.kup_ge1_S6_S3 "Umrechnung fuer Messgroesse cKorSaste::kup_ge1" TAB_VERB 6 0 "KEINE" 1 "K_A" 2 "K_B" 3 "K_C" 4 "K_D" 5 "K_E" /end COMPU_VTAB
/begin COMPU_VTAB Conv.cKorSaste._.kup_ge2_S6_S3 "Umrechnung fuer Messgroesse cKorSaste::kup_ge2" TAB_VERB 6 0 "KEINE" 1 "K_A" 2 "K_B" 3 "K_C" 4 "K_D" 5 "K_E" /end COMPU_VTAB
/begin COMPU_VTAB Conv.cKorSaste._.kup_ge3_S6_S3 "Umrechnung fuer Messgroesse cKorSaste::kup_ge3" TAB_VERB 6 0 "KEINE" 1 "K_A" 2 "K_B" 3 "K_C" 4 "K_D" 5 "K_E" /end COMPU_VTAB
/begin COMPU_VTAB Conv.cKorSaste._.kup_vkzu_S6_S3 "Umrechnung fuer Messgroesse cKorSaste::kup_vkzu" TAB_VERB 6 0 "KEINE" 1 "K_A" 2 "K_B" 3 "K_C" 4 "K_D" 5 "K_E" /end COMPU_VTAB
/begin COMPU_VTAB Conv.cKorSaste._.kup_vkab_S6_S3 "Umrechnung fuer Messgroesse cKorSaste::kup_vkab" TAB_VERB 6 0 "KEINE" 1 "K_A" 2 "K_B" 3 "K_C" 4 "K_D" 5 "K_E" /end COMPU_VTAB
/begin COMPU_VTAB Conv.cKorSaste._.zielgang_vorbereitung_S6_S3 "Umrechnung fuer Messgroesse cKorSaste::zielgang_vorbereitung" TAB_VERB 10 -1 "GR1" 0 "KEIN_GANG" 1 "G1" 2 "G2" 3 "G3" 4 "G4" 5 "G5" 6 "G6" 7 "G7" 8 "G8" /end COMPU_VTAB
/begin COMPU_VTAB Conv.cKorSaste._.zielgang_vorb_angefordert_S6_S3 "Umrechnung fuer Messgroesse cKorSaste::zielgang_vorb_angefordert" TAB_VERB 2 0 "vorbereitete Schaltung nicht angefordert oder keine Vorbereitung aktiv" 1 "vorbereitete Schaltung ist angefordert" /end COMPU_VTAB
/begin COMPU_VTAB Conv.cKorSaste._.me_sas_status_S6_S3 "Umrechnung fuer Messgroesse cKorSaste::me_sas_status" TAB_VERB 4 0 "keine Momentenanforderung" 1 "Momentenerhoehung" 2 "Momentenerniedrigung" 3 "Signal ungueltig (momentan nicht benutzt)" /end COMPU_VTAB
/begin COMPU_VTAB Conv.cKorSaste._.schaltungsabbruch_durch_ga_S6_S3 "Umrechnung fuer Messgroesse cKorSaste::schaltungsabbruch_durch_ga" TAB_VERB 2 0 "Kein Schaltungsabbruch durch GA" 1 "Schaltungsabbruch durch GA" /end COMPU_VTAB
/begin COMPU_VTAB Conv.cKorSaste._.start_vorbereitung_abgefragt_S6_S3 "Umrechnung fuer Messgroesse cKorSaste::start_vorbereitung_abgefragt" TAB_VERB 2 0 "vorbereitete Schaltung nicht angefordert oder keine Vorbereitung aktiv" 1 "vorbereitete Schaltung ist angefordert" /end COMPU_VTAB
/begin COMPU_VTAB Conv.cKorSaste._.z_zielg_vorb_S6_S3 "Umrechnung fuer Messgroesse cKorSaste::z_zielg_vorb" TAB_VERB 6 0 "Keine Vorbereitung aktiv" 1 "Vorbereitung ist aktiv" 2 "Sperrzeit Vorbereitungsübernahme aktiv" 3 "Entscheidungspunkt Verschachtelung erreicht" 4 "Verschachtelung läuft" 5 "Vorbereitung wurde abgebrochen" /end COMPU_VTAB
/begin COMPU_VTAB Conv.cKorSaste._.kup_kabvkzu_S6_S3 "Umrechnung fuer Messgroesse cKorSaste::kup_kabvkzu" TAB_VERB 6 0 "KEINE" 1 "K_A" 2 "K_B" 3 "K_C" 4 "K_D" 5 "K_E" /end COMPU_VTAB
/begin COMPU_VTAB Conv.cKorSaste._.f_start_vorb_mrs_nicht_mehr_erlaubt_S6_S3 "Umrechnung fuer Messgroesse cKorSaste::f_start_vorb_mrs_nicht_mehr_erlaubt" TAB_VERB 2 0 "FALSE" 1 "TRUE" /end COMPU_VTAB
/begin COMPU_VTAB Conv.cSasStrat._.flag_red_bef_aush_sch_angef_S6_S3 "Umrechnung fuer Messgroesse cSasStrat::flag_red_bef_aush_sch_angef" TAB_VERB 2 0 "FALSE" 1 "TRUE" /end COMPU_VTAB
/begin COMPU_VTAB Conv.cSasStrat._.flag_red_bef_inh_sch_angef_S6_S3 "Umrechnung fuer Messgroesse cSasStrat::flag_red_bef_inh_sch_angef" TAB_VERB 2 0 "FALSE" 1 "TRUE" /end COMPU_VTAB
/begin COMPU_VTAB Conv.cSasStrat._.flag_opt_bef_aush_sch_angef_S6_S3 "Umrechnung fuer Messgroesse cSasStrat::flag_opt_bef_aush_sch_angef" TAB_VERB 2 0 "FALSE" 1 "TRUE" /end COMPU_VTAB
/begin COMPU_VTAB Conv.cSasStrat._.flag_opt_bef_inh_sch_angef_S6_S3 "Umrechnung fuer Messgroesse cSasStrat::flag_opt_bef_inh_sch_angef" TAB_VERB 2 0 "FALSE" 1 "TRUE" /end COMPU_VTAB
/begin COMPU_VTAB Conv.cSasStrat._.f_sltsf_estart_S6_S3 "Umrechnung fuer Messgroesse cSasStrat::f_sltsf_estart" TAB_VERB 2 0 "FALSE" 1 "TRUE" /end COMPU_VTAB
/begin COMPU_VTAB Conv.cSasStrat._.f_nmot_ts_estart_S6_S3 "Umrechnung fuer Messgroesse cSasStrat::f_nmot_ts_estart" TAB_VERB 2 0 "FALSE" 1 "TRUE" /end COMPU_VTAB
/begin COMPU_VTAB Conv.cSasStrat._.ber_red_durch_sf_notwendig_S6_S3 "Umrechnung fuer Messgroesse cSasStrat::ber_red_durch_sf_notwendig" TAB_VERB 2 0 "FALSE" 1 "TRUE" /end COMPU_VTAB
/begin COMPU_VTAB Conv.cSasKflwe._.z_reversierfkt_S6_S3 "Umrechnung fuer Messgroesse cSasKflwe::z_reversierfkt" TAB_VERB 3 0 "Funktion inaktiv" 1 "Reversieren DNR aktiv" 2 "Reversieren RND aktiv" /end COMPU_VTAB
/begin COMPU_VTAB Conv.cSasKflwe._.kup1_kflw_S6_S3 "Umrechnung fuer Messgroesse cSasKflwe::kup1_kflw" TAB_VERB 6 0 "KEINE" 1 "K_A" 2 "K_B" 3 "K_C" 4 "K_D" 5 "K_E" /end COMPU_VTAB
/begin COMPU_VTAB Conv.cSasKflwe._.kup2_kflw_S6_S3 "Umrechnung fuer Messgroesse cSasKflwe::kup2_kflw" TAB_VERB 6 0 "KEINE" 1 "K_A" 2 "K_B" 3 "K_C" 4 "K_D" 5 "K_E" /end COMPU_VTAB
/begin COMPU_VTAB Conv.cMoeMesaf._.me_sas_pos_vor_stat_S6_S3 "Umrechnung fuer Messgroesse cMoeMesaf::me_sas_pos_vor_stat" TAB_VERB 2 0 "Voreilender Motoreingriff inaktiv" 1 "Voreilender Motoreingriff aktiv" /end COMPU_VTAB
/begin COMPU_VTAB Conv.cMoeMesaf._.flag_me_haupt_aktiv_S6_S3 "Umrechnung fuer Messgroesse cMoeMesaf::flag_me_haupt_aktiv" TAB_VERB 2 0 "kein Hauptmotoreingriff" 1 "Haupt- oder Zwangsmotoreingriff wird ausgegeben" /end COMPU_VTAB
/begin COMPU_VTAB Conv.cMoeMesaf._.zust_haupt_me_gestartet_S6_S3 "Umrechnung fuer Messgroesse cMoeMesaf::zust_haupt_me_gestartet" TAB_VERB 2 0 "Hauptmotoreingriff noch nicht gestartet" 1 "Hauptmotoreingriff ist gestartet" /end COMPU_VTAB
/begin COMPU_VTAB Conv.cMoeMesaf._.stat_me_klass_S6_S3 "Umrechnung fuer Messgroesse cMoeMesaf::stat_me_klass" TAB_VERB 4 0 "Keine Anforderung" 1 "ME nur ueber Zuendwinkel" 2 "ME nur ueber Luft" 3 "ME nur ueber EZA" /end COMPU_VTAB
/begin COMPU_VTAB Conv.cMoeMesaf._.schalttyp_mes_S6_S3 "Umrechnung fuer Messgroesse cMoeMesaf::schalttyp_mes" TAB_VERB 3 0 "SCHALTTYP_MES_RS" 1 "SCHALTTYP_MES_HS" 2 "SCHALTTYP_MES_GE" /end COMPU_VTAB
/begin COMPU_VTAB Conv.cMoeMesaf._.f_unterdr_me_S6_S3 "Umrechnung fuer Messgroesse cMoeMesaf::f_unterdr_me" TAB_VERB 2 0 "FALSE" 1 "TRUE" /end COMPU_VTAB
/begin COMPU_VTAB Conv.cMoeMesaf._.z_mes_S6_S3 "Umrechnung fuer Messgroesse cMoeMesaf::z_mes" TAB_VERB 10 2 "Vormotoreingriff Ruecksch." 3 "Hauptmotoreingriff Ruecksch." 4 "Rueckfilterung Hauptmotoreingriff Ruecksch." 5 "Nachmotoreingriff Ruecksch." 6 "Beenden des Nachmotoreingriff Ruecksch" 8 "Vormotoreingriff Hochsch GE" 9 "Zwangsmotoreingriff Hochsch." 10 "Hauptmotoreingriff Hochsch GE" 11 "Nachmotoreingriff Hochsch GE" 12 "kein Motoreingriff" /end COMPU_VTAB
/begin COMPU_VTAB Conv.cMoeMesaf._.me_lastruecknahme_hs_aktiv_S6_S3 "Umrechnung fuer Messgroesse cMoeMesaf::me_lastruecknahme_hs_aktiv" TAB_VERB 2 0 "Lastruecknahme bei HS nicht aktiv" 1 "Lastruecknahme bei HS aktiv" /end COMPU_VTAB
/begin COMPU_VTAB Conv.cMoeMesaf._.me_lastruecknahme_hs_erlaubt_S6_S3 "Umrechnung fuer Messgroesse cMoeMesaf::me_lastruecknahme_hs_erlaubt" TAB_VERB 2 0 "Lastruecknahme bei HS nicht erlaubt" 1 "Lastruecknahme bei HS erlaubt" /end COMPU_VTAB
/begin COMPU_VTAB Conv.cMoeMesaf._.diag_me_sas_S6_S3 "Umrechnung fuer Messgroesse cMoeMesaf::diag_me_sas" TAB_VERB 18 0 "Kein ME" 1 "ME aus Zustandsgraph" 2 "ME Rueckfilterung Nachmotoreingriff auf Null" 3 "ME Rueckfilterung Nachmotoreingriff auf Null Minimalauswahl" 4 "ME Gewichtungsfunktion POS ME bei RS" 5 "ME RAMPE ABBRUCH HS IN SYNC ISTG" 6 "ME Abrampung ausserh. Schaltung HS" 7 "ME Abrampung ausserh. Schaltung RS" 8 "ME Rampe Aufruf Pruefen" 9 "ME aus GEGA Model" 10 "ME Unterdrueckung RED" 11 "ME Reuckfilterung Klauen RS" 12 "ME aus GLS Ersatz" 13 "ME aus Einspurfunktion" 14 "ME bei aktiver Klaue innerhalb Verschachtlung" 15 "ME Teachin Aktiv" 16 "ME aus Getriebeschutz aktiv" 17 "ME Momenterhoehung durch Querbeschleunigung" /end COMPU_VTAB
/begin COMPU_VTAB Conv.cMoeMesaf._.f_rueckfilter_aktiv_ausschaltung_S6_S3 "Umrechnung fuer Messgroesse cMoeMesaf::f_rueckfilter_aktiv_ausschaltung" TAB_VERB 2 0 "FALSE" 1 "TRUE" /end COMPU_VTAB
/begin COMPU_VTAB Conv.cMoeMesaf._.f_neuber_startz_hme_hs_angef_S6_S3 "Umrechnung fuer Messgroesse cMoeMesaf::f_neuber_startz_hme_hs_angef" TAB_VERB 2 0 "FALSE" 1 "TRUE" /end COMPU_VTAB
/begin COMPU_VTAB Conv.cMoeMesaf._.f_neuber_startz_hme_hs_erfolgt_S6_S3 "Umrechnung fuer Messgroesse cMoeMesaf::f_neuber_startz_hme_hs_erfolgt" TAB_VERB 2 0 "FALSE" 1 "TRUE" /end COMPU_VTAB
/begin COMPU_VTAB Conv.cMoeMesaf._.flag_meklass_erlaubt_S6_S3 "Umrechnung fuer Messgroesse cMoeMesaf::flag_meklass_erlaubt" TAB_VERB 2 0 "FALSE" 1 "TRUE" /end COMPU_VTAB
/begin COMPU_VTAB Conv.cMoeMesaf._.flag_me_klassifizierung_erfolgt_S6_S3 "Umrechnung fuer Messgroesse cMoeMesaf::flag_me_klassifizierung_erfolgt" TAB_VERB 2 0 "FALSE" 1 "TRUE" /end COMPU_VTAB
/begin COMPU_VTAB Conv.cMoeMesaf._.nachme_rs_losgelaufen_S6_S3 "Umrechnung fuer Messgroesse cMoeMesaf::nachme_rs_losgelaufen" TAB_VERB 2 0 "Nach-Me bei RS wurde NICHT gestartet" 1 "Nach-Me bei RS wurde gestartet" /end COMPU_VTAB
/begin COMPU_VTAB Conv.cMoeMesaf._.flag_schaltung_mes_aktiv_S6_S3 "Umrechnung fuer Messgroesse cMoeMesaf::flag_schaltung_mes_aktiv" TAB_VERB 2 0 "FALSE" 1 "TRUE" /end COMPU_VTAB
/begin COMPU_VTAB Conv.cMoeMesaf._.f_timer_sperrzeit_hme_gesetzt_S6_S3 "Umrechnung fuer Messgroesse cMoeMesaf::f_timer_sperrzeit_hme_gesetzt" TAB_VERB 2 0 "FALSE" 1 "TRUE" /end COMPU_VTAB
/begin COMPU_VTAB Conv.cMoeMesaf._.momentenerhoehung_erlaubt_S6_S3 "Umrechnung fuer Messgroesse cMoeMesaf::momentenerhoehung_erlaubt" TAB_VERB 2 0 "Momentenerhoehung NICHT aktiv" 1 "Momentenerhoehung aktiv" /end COMPU_VTAB
/begin COMPU_VTAB Conv.cMoeMesaf._.momentenerhoehung_erlaubt_alt_S6_S3 "Umrechnung fuer Messgroesse cMoeMesaf::momentenerhoehung_erlaubt_alt" TAB_VERB 2 0 "Momentenerhoehung im letzten Durchlauf NICHT aktiv" 1 "Momentenerhoehung im letzten Durchlauf aktiv" /end COMPU_VTAB
/begin COMPU_VTAB Conv.cMoeMesaf._.flag_kf_mehaupt_abfilter_S6_S3 "Umrechnung fuer Messgroesse cMoeMesaf::flag_kf_mehaupt_abfilter" TAB_VERB 2 0 "Flag: Abfilterrampe aktiv" 1 "Flag: Abfilterrampe inaktiv" /end COMPU_VTAB
/begin COMPU_VTAB Conv.cMoeMesaf._.flag_akt_me_sas_gesp_ramp_S6_S3 "Umrechnung fuer Messgroesse cMoeMesaf::flag_akt_me_sas_gesp_ramp" TAB_VERB 2 0 "Flag: Aktualisierung aktiv" 1 "Flag: Aktualisierung inaktiv" /end COMPU_VTAB
/begin COMPU_VTAB Conv.cMonMoSig._.mon_mst_status_S6_S3 "Umrechnung fuer Messgroesse cMonMoSig::mon_mst_status" TAB_VERB 4 0 "Motor AUS" 1 "Motor wechselt nach AN" 2 "Motor AN" 3 "Motor wechselt nach AUS" /end COMPU_VTAB
/begin COMPU_VTAB Conv.cNotInfoEgDirekt._.ersatzgang_S6_S3 "Umrechnung fuer Messgroesse cNotInfoEgDirekt::ersatzgang" TAB_VERB 10 -1 "GR1" 0 "KEIN_GANG" 1 "G1" 2 "G2" 3 "G3" 4 "G4" 5 "G5" 6 "G6" 7 "G7" 8 "G8" /end COMPU_VTAB
/begin COMPU_VTAB Conv.cKorDiagl._.ersatzgang_S6_S3 "Umrechnung fuer Messgroesse cKorDiagl::ersatzgang" TAB_VERB 10 -1 "GR1" 0 "KEIN_GANG" 1 "G1" 2 "G2" 3 "G3" 4 "G4" 5 "G5" 6 "G6" 7 "G7" 8 "G8" /end COMPU_VTAB
/begin COMPU_VTAB Conv.cKorDiagl._.symptom_aktiv_S6_S3 "Umrechnung fuer Messgroesse cKorDiagl::symptom_aktiv" TAB_VERB 2 0 "symptom nicht active" 1 "ssymptom active" /end COMPU_VTAB
/begin COMPU_VTAB Conv.cKorDiagl._.b_eg_uwig_direkt_getr_notlaufsp_S6_S3 "Umrechnung fuer Messgroesse cKorDiagl::b_eg_uwig_direkt_getr_notlaufsp" TAB_VERB 2 0 "FALSE" 1 "TRUE" /end COMPU_VTAB
/begin COMPU_VTAB Conv.cUewIgEinstBed._.flag_symptom_pruefen_S6_S3 "Umrechnung fuer Messgroesse cUewIgEinstBed::flag_symptom_pruefen" TAB_VERB 2 0 "FALSE" 1 "TRUE" /end COMPU_VTAB
/begin COMPU_VTAB Conv.cUewIgetr._.uwig_pruefstatus_kup_a_S6_S3 "Umrechnung fuer Messgroesse cUewIgetr::uwig_pruefstatus_kup_a" TAB_VERB 2 0 "nicht geprueft" 1 "i.o. geprueft" /end COMPU_VTAB
/begin COMPU_VTAB Conv.cUewIgetr._.uwig_pruefstatus_kup_b_S6_S3 "Umrechnung fuer Messgroesse cUewIgetr::uwig_pruefstatus_kup_b" TAB_VERB 2 0 "nicht geprueft" 1 "i.o. geprueft" /end COMPU_VTAB
/begin COMPU_VTAB Conv.cUewIgetr._.uwig_pruefstatus_kup_c_S6_S3 "Umrechnung fuer Messgroesse cUewIgetr::uwig_pruefstatus_kup_c" TAB_VERB 2 0 "nicht geprueft" 1 "i.o. geprueft" /end COMPU_VTAB
/begin COMPU_VTAB Conv.cUewIgetr._.uwig_pruefstatus_kup_d_S6_S3 "Umrechnung fuer Messgroesse cUewIgetr::uwig_pruefstatus_kup_d" TAB_VERB 2 0 "nicht geprueft" 1 "i.o. geprueft" /end COMPU_VTAB
/begin COMPU_VTAB Conv.cUewIgetr._.uwig_pruefstatus_kup_e_S6_S3 "Umrechnung fuer Messgroesse cUewIgetr::uwig_pruefstatus_kup_e" TAB_VERB 2 0 "nicht geprueft" 1 "i.o. geprueft" /end COMPU_VTAB
/begin COMPU_VTAB Conv.cUewIgetr._.zustand_uwig_S6_S3 "Umrechnung fuer Messgroesse cUewIgetr::zustand_uwig" TAB_VERB 9 0 "init" 1 "default" 2 "keine Schaltung" 3 "Start Schaltung" 4 "warte auf Reglerstart" 5 "warte Verzoegerungszeit" 6 "Rampe" 7 "Nachlauf" 8 "Schaltungsende" /end COMPU_VTAB
/begin COMPU_VTAB Conv.cUewIgetr._.b_uwig_auf_symptom_pruefen_S6_S3 "Umrechnung fuer Messgroesse cUewIgetr::b_uwig_auf_symptom_pruefen" TAB_VERB 2 0 "kein pruefen auf Symptom" 1 "pruefen auf Symptom" /end COMPU_VTAB
/begin COMPU_VTAB Conv.cUewIgetr._.symptom_uwig_r_gang_aktiv_S6_S3 "Umrechnung fuer Messgroesse cUewIgetr::symptom_uwig_r_gang_aktiv" TAB_VERB 2 0 "Kein Symptom R-Gang mit Zwangsneutral aktiv" 1 "Symptom R-Gang mit Zwangsneutral aktiv" /end COMPU_VTAB
/begin COMPU_VTAB Conv.cUewIgetr._.uwig_abbruchgang_S6_S3 "Umrechnung fuer Messgroesse cUewIgetr::uwig_abbruchgang" TAB_VERB 10 -1 "GR1" 0 "KEIN_GANG" 1 "G1" 2 "G2" 3 "G3" 4 "G4" 5 "G5" 6 "G6" 7 "G7" 8 "G8" /end COMPU_VTAB
/begin COMPU_VTAB Conv.cUewIgetr._.flg_kuppident_S6_S3 "Umrechnung fuer Messgroesse cUewIgetr::flg_kuppident" TAB_VERB 2 0 "Die fehlerausloesende Kupplung wurde noch nicht identifiziert" 1 "Die fehlerausloesende Kupplung wurde identifiziert" /end COMPU_VTAB
/begin COMPU_VTAB Conv.cUewIgetr._.flg_kfc_ratioglobal_S6_S3 "Umrechnung fuer Messgroesse cUewIgetr::flg_kfc_ratioglobal" TAB_VERB 2 0 "KFC_RATIOGLOBAL nicht eingetragen" 1 "KFC_RATIOGLOBAL eingetragen" /end COMPU_VTAB
/begin COMPU_VTAB Conv.cUewIgetr._.schaltart_akt_uew_stc_S6_S3 "Umrechnung fuer Messgroesse cUewIgetr::schaltart_akt_uew_stc" TAB_VERB 3 0 "nicht definiert" 1 "Hochschaltung (Wert fuer schaltart)" 2 "Rueckschaltung (Wert fuer schaltart)" /end COMPU_VTAB
/begin COMPU_VTAB Conv.cUewIgetr._.zielgang_sas_akt_uew_stc_S6_S3 "Umrechnung fuer Messgroesse cUewIgetr::zielgang_sas_akt_uew_stc" TAB_VERB 10 -1 "GR1" 0 "KEIN_GANG" 1 "G1" 2 "G2" 3 "G3" 4 "G4" 5 "G5" 6 "G6" 7 "G7" 8 "G8" /end COMPU_VTAB
/begin COMPU_VTAB Conv.cUewIgetr._.istgang_akt_uew_stc_S6_S3 "Umrechnung fuer Messgroesse cUewIgetr::istgang_akt_uew_stc" TAB_VERB 10 -1 "GR1" 0 "KEIN_GANG" 1 "G1" 2 "G2" 3 "G3" 4 "G4" 5 "G5" 6 "G6" 7 "G7" 8 "G8" /end COMPU_VTAB
/begin COMPU_VTAB Conv.cUewIgetr._.istgang_vorherige_schaltung_stc_S6_S3 "Umrechnung fuer Messgroesse cUewIgetr::istgang_vorherige_schaltung_stc" TAB_VERB 10 -1 "GR1" 0 "KEIN_GANG" 1 "G1" 2 "G2" 3 "G3" 4 "G4" 5 "G5" 6 "G6" 7 "G7" 8 "G8" /end COMPU_VTAB
/begin COMPU_VTAB Conv.cUewIgetr._.eprg_schalt_np_istgang_S6_S3 "Umrechnung fuer Messgroesse cUewIgetr::eprg_schalt_np_istgang" TAB_VERB 9 0 "KEIN_GANG" 1 "G1" 2 "G2" 3 "G3" 4 "G4" 5 "G5" 6 "G6" 7 "G7" 8 "G8" /end COMPU_VTAB
/begin COMPU_VTAB Conv.cUewIgetr._.eprg_schalt_np_zielgang_sas_S6_S3 "Umrechnung fuer Messgroesse cUewIgetr::eprg_schalt_np_zielgang_sas" TAB_VERB 9 0 "KEIN_GANG" 1 "G1" 2 "G2" 3 "G3" 4 "G4" 5 "G5" 6 "G6" 7 "G7" 8 "G8" /end COMPU_VTAB
/begin COMPU_VTAB Conv.cUewIgetr._.f_ist_schaltung_stc_S6_S3 "Umrechnung fuer Messgroesse cUewIgetr::f_ist_schaltung_stc" TAB_VERB 2 0 "keine Schaltung laeuft" 1 "Schaltung laeuft" /end COMPU_VTAB
/begin COMPU_VTAB Conv.cUewIgetr._.f_ist_stoerung_stc_S6_S3 "Umrechnung fuer Messgroesse cUewIgetr::f_ist_stoerung_stc" TAB_VERB 2 0 "keine Stoerung erkannt" 1 "Stoerung erkannt" /end COMPU_VTAB
/begin COMPU_VTAB Conv.cUewIgetr._.f_ist_symptom_gang_stc_S6_S3 "Umrechnung fuer Messgroesse cUewIgetr::f_ist_symptom_gang_stc" TAB_VERB 2 0 "kein Symptom erkannt" 1 "Symptom erkannt" /end COMPU_VTAB
/begin COMPU_VTAB Conv.cUewIgetr._.f_ist_symptom_schalt_stc_S6_S3 "Umrechnung fuer Messgroesse cUewIgetr::f_ist_symptom_schalt_stc" TAB_VERB 2 0 "kein Symptom erkannt" 1 "Symptom erkannt" /end COMPU_VTAB
/begin COMPU_VTAB Conv.cUewIgetr._.f_ist_symptom_ge_stc_S6_S3 "Umrechnung fuer Messgroesse cUewIgetr::f_ist_symptom_ge_stc" TAB_VERB 2 0 "kein Symptom erkannt" 1 "Symptom erkannt" /end COMPU_VTAB
/begin COMPU_VTAB Conv.cUewIgetr._.f_ist_ersatzgang_schalt_stc_S6_S3 "Umrechnung fuer Messgroesse cUewIgetr::f_ist_ersatzgang_schalt_stc" TAB_VERB 2 0 "kein Ersatzgang gesetzt" 1 "Ersatzgang gesetzt" /end COMPU_VTAB
/begin COMPU_VTAB Conv.cUewIgetr._.f_ist_ersatzgang_gang_stc_S6_S3 "Umrechnung fuer Messgroesse cUewIgetr::f_ist_ersatzgang_gang_stc" TAB_VERB 2 0 "kein Ersatzgang gesetzt" 1 "Ersatzgang gesetzt" /end COMPU_VTAB
/begin COMPU_VTAB Conv.cUewIgetr._.f_ist_ersatzgang_ge_stc_S6_S3 "Umrechnung fuer Messgroesse cUewIgetr::f_ist_ersatzgang_ge_stc" TAB_VERB 2 0 "kein Ersatzgang gesetzt" 1 "Ersatzgang gesetzt" /end COMPU_VTAB
/begin COMPU_VTAB Conv.cUewIgetr._.f_ist_neue_schaltung_stc_S6_S3 "Umrechnung fuer Messgroesse cUewIgetr::f_ist_neue_schaltung_stc" TAB_VERB 2 0 "keine neue Schaltung" 1 "neue Schaltung" /end COMPU_VTAB
/begin COMPU_VTAB Conv.cUewIgetr._.f_ist_neues_ge_stc_S6_S3 "Umrechnung fuer Messgroesse cUewIgetr::f_ist_neues_ge_stc" TAB_VERB 2 0 "kein neues Gangeinlegen" 1 "neues Gangeinlegen" /end COMPU_VTAB
/begin COMPU_VTAB Conv.cUewIgetr._.f_schalt_durch_sym_schalt_stc_S6_S3 "Umrechnung fuer Messgroesse cUewIgetr::f_schalt_durch_sym_schalt_stc" TAB_VERB 2 0 "Schaltung ist keine Reaktion auf ein Schaltungssymptom" 1 "Schaltung ist Reaktion auf ein Schaltungssymptom" /end COMPU_VTAB
/begin COMPU_VTAB Conv.cUewIgetr._.f_timer16_rampe_gestartet_stc_S6_S3 "Umrechnung fuer Messgroesse cUewIgetr::f_timer16_rampe_gestartet_stc" TAB_VERB 2 0 "timer16_rampe noch nicht gestartet" 1 "timer16_rampe ist gestartet" /end COMPU_VTAB
/begin COMPU_VTAB Conv.cUewIgetr._.f_abbruch_akt_ueberwachung_S6_S3 "Umrechnung fuer Messgroesse cUewIgetr::f_abbruch_akt_ueberwachung" TAB_VERB 2 0 "laufende ueberwachung nicht abbrechen" 1 "laufende ueberwachung abbrechen" /end COMPU_VTAB
/begin COMPU_VTAB Conv.cUewIgetr._.f_ist_nab_kleiner_schwelle_stc_S6_S3 "Umrechnung fuer Messgroesse cUewIgetr::f_ist_nab_kleiner_schwelle_stc" TAB_VERB 2 0 "nab ist groesser/gleich der Schwelle NS_ABUWIG" 1 "nab ist kleiner als Schwelle NS_ABUWIG" /end COMPU_VTAB
/begin COMPU_VTAB Conv.cUewIgetr._.f_ist_ge_stc_S6_S3 "Umrechnung fuer Messgroesse cUewIgetr::f_ist_ge_stc" TAB_VERB 2 0 "kein Gangeinlegevorgang" 1 "Gangeinlegevorgang laeuft" /end COMPU_VTAB
/begin COMPU_VTAB Conv.cUewIgetr._.f_ueberwache_ge_stc_S6_S3 "Umrechnung fuer Messgroesse cUewIgetr::f_ueberwache_ge_stc" TAB_VERB 2 0 "Startwerte fuer GE noch nicht gesetzt" 1 "Startwerte fuer GE sind gesetzt" /end COMPU_VTAB
/begin COMPU_VTAB Conv.cUewIgetr._.f_pruefbed_im_gang_erreicht_stc_S6_S3 "Umrechnung fuer Messgroesse cUewIgetr::f_pruefbed_im_gang_erreicht_stc" TAB_VERB 2 0 "Pruefbedingung nicht erfuellt" 1 "Pruefbedingung erfuellt" /end COMPU_VTAB
/begin COMPU_VTAB Conv.cUewIgetr._.f_stoer_offset_in_schaltung_stc_S6_S3 "Umrechnung fuer Messgroesse cUewIgetr::f_stoer_offset_in_schaltung_stc" TAB_VERB 2 0 "Momentengradiententenschwelle nicht ueberschritten" 1 "Momentengradiententenschwelle ueberschritten" /end COMPU_VTAB
/begin COMPU_VTAB Conv.cUewIgetr._.f_ersatzwert_stc_S6_S3 "Umrechnung fuer Messgroesse cUewIgetr::f_ersatzwert_stc" TAB_VERB 2 0 "Originalwert fuer Abtriebsdrehzahl" 1 "Ersatzwert fuer Abtriebsdrehzahl" /end COMPU_VTAB
/begin COMPU_VTAB Conv.cUewIgetr._.f_ersatzprogramm_aktiv_S6_S3 "Umrechnung fuer Messgroesse cUewIgetr::f_ersatzprogramm_aktiv" TAB_VERB 2 0 "Ersatzprogramm von UWIG noch nicht ausgeloest" 1 "Ersatzprogramm von UWIG ausgeloest" /end COMPU_VTAB
/begin COMPU_VTAB Conv.cUewIgetr._.kfl_ziel_bei_symptom_stc_S6_S3 "Umrechnung fuer Messgroesse cUewIgetr::kfl_ziel_bei_symptom_stc" TAB_VERB 3 0 "KEIN_KFL" 1 "KFL_VORWAERTS" 2 "KFL_RUECKWAERTS" /end COMPU_VTAB
/begin COMPU_VTAB Conv.cUewIgetr._.kup_ge1_stc_S6_S3 "Umrechnung fuer Messgroesse cUewIgetr::kup_ge1_stc" TAB_VERB 6 0 "KEINE" 1 "K_A" 2 "K_B" 3 "K_C" 4 "K_D" 5 "K_E" /end COMPU_VTAB
/begin COMPU_VTAB Conv.cUewIgetr._.kup_ge2_stc_S6_S3 "Umrechnung fuer Messgroesse cUewIgetr::kup_ge2_stc" TAB_VERB 6 0 "KEINE" 1 "K_A" 2 "K_B" 3 "K_C" 4 "K_D" 5 "K_E" /end COMPU_VTAB
/begin COMPU_VTAB Conv.cUewIgetr._.kup_ge3_stc_S6_S3 "Umrechnung fuer Messgroesse cUewIgetr::kup_ge3_stc" TAB_VERB 6 0 "KEINE" 1 "K_A" 2 "K_B" 3 "K_C" 4 "K_D" 5 "K_E" /end COMPU_VTAB
/begin COMPU_VTAB Conv.cUewIgetr._.fl_sym_iepuwig_S6_S3 "Umrechnung fuer Messgroesse cUewIgetr::fl_sym_iepuwig" TAB_VERB 2 0 "keine Symptom aufgetreten" 1 "Symptom aufgetreten" /end COMPU_VTAB
/begin COMPU_VTAB Conv.cUewIgetr._.fl_erf_iepuwig_S6_S3 "Umrechnung fuer Messgroesse cUewIgetr::fl_erf_iepuwig" TAB_VERB 2 0 "keine Gutpruefung aktiv" 1 "Gutpruefugn aktiv" /end COMPU_VTAB
/begin COMPU_VTAB Conv.cUewIgetr._.symptom_reaktion_S6_S3 "Umrechnung fuer Messgroesse cUewIgetr::symptom_reaktion" TAB_VERB 7 0 "KEIN_SYMPTOM_AKTIV" 1 "SYMPTOM_GANG_R" 2 "SYMPTOM_SCHALT_D" 3 "SYMPTOM_GE" 4 "SYMPTOM_NEUTRAL_G4" 5 "SYMPTOM_NEUTRAL" 6 "SYMPTOM_GANG_D" /end COMPU_VTAB
/begin COMPU_VTAB Conv.cUewParksperrenmagnet._.flag_einstiegsbed_S6_S3 "Umrechnung fuer Messgroesse cUewParksperrenmagnet::flag_einstiegsbed" TAB_VERB 2 0 "Einstiegsbedingungen nicht erfuellt" 1 "Einstiegsbedingungen erfuellt" /end COMPU_VTAB
/begin COMPU_VTAB Conv.cUewParksperrenmagnet._.reset_timer_pmueb_S6_S3 "Umrechnung fuer Messgroesse cUewParksperrenmagnet::reset_timer_pmueb" TAB_VERB 2 0 "Einstiegsbedingungen nicht erfuellt" 1 "Einstiegsbedingungen erfuellt" /end COMPU_VTAB
/begin COMPU_VTAB Conv.cUewParksperrenmagnet._.z_pmueb_S6_S3 "Umrechnung fuer Messgroesse cUewParksperrenmagnet::z_pmueb" TAB_VERB 3 0 "Init" 1 "Erfolg" 2 "Fehler" /end COMPU_VTAB
/begin COMPU_VTAB Conv.cUewParksperrenmagnet._.zustand_S6_S3 "Umrechnung fuer Messgroesse cUewParksperrenmagnet::zustand" TAB_VERB 5 0 "Initphase" 1 "Verzoegerung vor Prüfung" 2 "Prüfen des Ventil" 3 "Fehler am Ventil" 4 "keine Fehler am Ventil detektiert" /end COMPU_VTAB
/begin COMPU_VTAB Conv.cDiaRbmif._.flag_rbm_zustand_uwigschalt_S6_S3 "Umrechnung fuer Messgroesse cDiaRbmif::flag_rbm_zustand_uwigschalt" TAB_VERB 2 0 "Betriebszustand nicht erfuellt" 1 "Betriebszustand erfuellt" /end COMPU_VTAB
/begin COMPU_VTAB Conv.cDiaRbmif._.flag_rbm_zustand_uwigkup_S6_S3 "Umrechnung fuer Messgroesse cDiaRbmif::flag_rbm_zustand_uwigkup" TAB_VERB 2 0 "Betriebszustand nicht erfuellt" 1 "Betriebszustand erfuellt" /end COMPU_VTAB
/begin COMPU_VTAB Conv.cDiaRbmif._.rbm_zielgang_sas_vorw_alt_S6_S3 "Umrechnung fuer Messgroesse cDiaRbmif::rbm_zielgang_sas_vorw_alt" TAB_VERB 9 0 "KEIN_GANG" 1 "G1" 2 "G2" 3 "G3" 4 "G4" 5 "G5" 6 "G6" 7 "G7" 8 "G8" /end COMPU_VTAB
/begin COMPU_VTAB Conv.cDiaRbmif._.rbm_istgang_vorw_alt_S6_S3 "Umrechnung fuer Messgroesse cDiaRbmif::rbm_istgang_vorw_alt" TAB_VERB 9 0 "KEIN_GANG" 1 "G1" 2 "G2" 3 "G3" 4 "G4" 5 "G5" 6 "G6" 7 "G7" 8 "G8" /end COMPU_VTAB
/begin COMPU_VTAB Conv.cDiaRbmif._.flag_rbm_zust_inaktiv_iae_S6_S3 "Umrechnung fuer Messgroesse cDiaRbmif::flag_rbm_zust_inaktiv_iae" TAB_VERB 2 0 "Betriebszustand nicht erfuellt" 1 "Betriebszustand erfuellt" /end COMPU_VTAB
/begin COMPU_VTAB Conv.cDiaRbmif._.flag_rbm_zust_hanfahr_iae_S6_S3 "Umrechnung fuer Messgroesse cDiaRbmif::flag_rbm_zust_hanfahr_iae" TAB_VERB 2 0 "Betriebszustand nicht erfuellt" 1 "Betriebszustand erfuellt" /end COMPU_VTAB
/begin COMPU_VTAB Conv.cBasFehlerErfolgInt._.flag_fehler_S6_S3 "Umrechnung fuer Messgroesse cBasFehlerErfolgInt::flag_fehler" TAB_VERB 2 0 "keine Fehler vorhanden" 1 "Fehler vorhanden" /end COMPU_VTAB
/begin COMPU_VTAB Conv.cBasFehlerErfolgFl._.flag_fehler_S6_S3 "Umrechnung fuer Messgroesse cBasFehlerErfolgFl::flag_fehler" TAB_VERB 2 0 "keine Fehler vorhanden" 1 "Fehler vorhanden" /end COMPU_VTAB
/begin FUNCTION SAS_TCI "In TCI sind Funktionen zur Bestimmung der thermischen Kupplungsbelastung und der Kupplungstemperatur enthalten"
 /begin LOC_MEASUREMENT iTciCompu.auslastung_lkab iTciCompu.auslastung_lkab_int iTciCompu.auslastung_lkzu iTciCompu.auslastung_lkzu_int iTciCompu.auslastung_wkab iTciCompu.auslastung_wkab_int iTciCompu.auslastung_wkzu iTciCompu.auslastung_wkzu_int iTciCompu.c_kupplung_gestz iTciCompu.c_kupplung_max iTciCompu.flag_ende_kab_ber_erreicht iTciCompu.flag_ende_kzu_ber_erreicht iTciCompu.iPKAbFilter.letzter_ms_timer iTciCompu.iPKAbFilter.x iTciCompu.iPKZuFilter.letzter_ms_timer iTciCompu.iPKZuFilter.x iTciCompu.istgang_idx_merk iTciCompu.k_ab iTciCompu.k_zu iTciCompu.kupplung_max iTciCompu.l_kab iTciCompu.l_kab_int iTciCompu.l_kab_max iTciCompu.l_kab_max_int iTciCompu.l_kab_max_spez iTciCompu.l_kab_max_spez_int iTciCompu.l_kzu iTciCompu.l_kzu_int iTciCompu.l_kzu_max iTciCompu.l_kzu_max_int iTciCompu.l_kzu_max_spez iTciCompu.l_kzu_max_spez_int iTciCompu.m_kab iTciCompu.m_kzu iTciCompu.nd_abs_kab iTciCompu.nd_abs_kzu iTciCompu.p_kab_kupbel iTciCompu.p_kzu_kupbel iTciCompu.schaltart_sas_red_tci iTciCompu.w_kab iTciCompu.w_kab_int iTciCompu.w_kab_speicher iTciCompu.w_kab_spez iTciCompu.w_kab_spez_int iTciCompu.w_kzu iTciCompu.w_kzu_int iTciCompu.w_kzu_speicher iTciCompu.w_kzu_spez iTciCompu.w_kzu_spez_int iTciCompu.z_tci iTciCompu.zielgang_sas_idx_merk iTempMKupA.PT2CKupplung.x iTempMKupA.PT2CKupplung.xp iTempMKupA.c_kupplung iTempMKupA.c_kupplung_roh iTempMKupA.kupplung iTempMKupA.q_ab_kupplung iTempMKupA.q_zu_kupplung iTempMKupC.PT2CKupplung.x iTempMKupC.PT2CKupplung.xp iTempMKupC.c_kupplung iTempMKupC.c_kupplung_roh iTempMKupC.kupplung iTempMKupC.q_ab_kupplung iTempMKupC.q_zu_kupplung iTempMKupD.PT2CKupplung.x iTempMKupD.PT2CKupplung.xp iTempMKupD.c_kupplung iTempMKupD.c_kupplung_roh iTempMKupD.kupplung iTempMKupD.q_ab_kupplung iTempMKupD.q_zu_kupplung iTempMKupE.PT2CKupplung.x iTempMKupE.PT2CKupplung.xp iTempMKupE.c_kupplung iTempMKupE.c_kupplung_roh iTempMKupE.kupplung iTempMKupE.q_ab_kupplung iTempMKupE.q_zu_kupplung /end LOC_MEASUREMENT
/end FUNCTION
/begin FUNCTION SAS_KOORDINATOR "In SAS_KOORDINATOR sind die Koordinationsfunktionen des Schaltablaufs enthalten"
 /begin LOC_MEASUREMENT iKorSaste.f_start_vorb_mrs_nicht_mehr_erlaubt iKorSaste.kup_ge1 iKorSaste.kup_ge2 iKorSaste.kup_ge3 iKorSaste.kup_kab iKorSaste.kup_kabvkzu iKorSaste.kup_kzu iKorSaste.kup_vkab iKorSaste.kup_vkzu iKorSaste.m_t_mepos iKorSaste.me_sas_status iKorSaste.n_motmax iKorSaste.n_tmax iKorSaste.schaltungsabbruch_durch_ga iKorSaste.start_vorbereitung_abgefragt iKorSaste.t_zzielgvorb iKorSaste.timer_ende_ga iKorSaste.timer_zzielgvorb iKorSaste.z_zielg_vorb iKorSaste.zaehler_zzielgvorb iKorSaste.zielgang_vorb_angefordert iKorSaste.zielgang_vorbereitung /end LOC_MEASUREMENT
/end FUNCTION
/begin FUNCTION SAS_SONDERFKT "In SAS_SONDERFKT sind Sonderfunktionen zum Schaltablauf enthalten"
 /begin LOC_MEASUREMENT iSasKflwe.kup1_kflw iSasKflwe.kup2_kflw iSasKflwe.nd_nmot_nt_skw iSasKflwe.p_kab1_kflw iSasKflwe.p_kab2_kflw iSasKflwe.p_kab_kflw2_speicher.letzter_ms_timer iSasKflwe.p_kab_kflw2_speicher.letzter_wert iSasKflwe.p_kab_kflw2_speicher.maximum iSasKflwe.p_kab_kflw2_speicher.minimum iSasKflwe.p_kab_kflw_speicher.letzter_ms_timer iSasKflwe.p_kab_kflw_speicher.letzter_wert iSasKflwe.p_kab_kflw_speicher.maximum iSasKflwe.p_kab_kflw_speicher.minimum iSasKflwe.timer_dnrrnd_max_zeit_rampen iSasKflwe.z_reversierfkt iSasStrat.ber_red_durch_sf_notwendig iSasStrat.f_nmot_ts_estart iSasStrat.f_sltsf_estart iSasStrat.flag_opt_bef_aush_sch_angef iSasStrat.flag_opt_bef_inh_sch_angef iSasStrat.flag_red_bef_aush_sch_angef iSasStrat.flag_red_bef_inh_sch_angef iSasStrat.q_fuellred iSasStrat.q_verfuegbar_rest iSasStrat.timer_sltsf_estart iSasStrat.timer_sltsf_ts_estart /end LOC_MEASUREMENT
/end FUNCTION
/begin FUNCTION SAS_MOTOREINGRIFF "In SAS_MOTOREINGRIFF sind die Klassen zur Steuerung des Motoreingriffs während Schaltablauf enthalten"
 /begin LOC_MEASUREMENT iMoeMesaf.diag_me_sas iMoeMesaf.f_neuber_startz_hme_hs_angef iMoeMesaf.f_neuber_startz_hme_hs_erfolgt iMoeMesaf.f_rueckfilter_aktiv_ausschaltung iMoeMesaf.f_timer_sperrzeit_hme_gesetzt iMoeMesaf.f_unterdr_me iMoeMesaf.filter_spez_me.letzter_ms_timer iMoeMesaf.filter_spez_me.start_wert iMoeMesaf.filter_spez_me.x iMoeMesaf.flag_akt_me_sas_gesp_ramp iMoeMesaf.flag_kf_mehaupt_abfilter iMoeMesaf.flag_me_haupt_aktiv iMoeMesaf.flag_me_klassifizierung_erfolgt iMoeMesaf.flag_meklass_erlaubt iMoeMesaf.flag_schaltung_mes_aktiv iMoeMesaf.me_abs_neu_sas iMoeMesaf.me_klass iMoeMesaf.me_lastruecknahme_hs_aktiv iMoeMesaf.me_lastruecknahme_hs_erlaubt iMoeMesaf.me_sas iMoeMesaf.me_sas0_mee iMoeMesaf.me_sas_gesp iMoeMesaf.me_sas_gesp_kf iMoeMesaf.me_sas_gesp_kf_mehaupt iMoeMesaf.me_sas_gesp_ramp iMoeMesaf.me_sas_int iMoeMesaf.me_sas_luft iMoeMesaf.me_sas_pos_vor iMoeMesaf.me_sas_pos_vor_stat iMoeMesaf.me_sas_start_nach_me iMoeMesaf.me_sas_zwme iMoeMesaf.me_zuendlimit_klass iMoeMesaf.momentenerhoehung_erlaubt iMoeMesaf.momentenerhoehung_erlaubt_alt iMoeMesaf.nachme_rs_losgelaufen iMoeMesaf.ng_abmesas iMoeMesaf.offset_n_motsolleer iMoeMesaf.schalttyp_mes iMoeMesaf.stat_me_klass iMoeMesaf.t_ramee iMoeMesaf.t_syn_alt iMoeMesaf.t_verzstarthme iMoeMesaf.t_zmes iMoeMesaf.timer_maxzeit_mes iMoeMesaf.timer_meklass iMoeMesaf.timer_ramee iMoeMesaf.timer_rampe_pos iMoeMesaf.timer_schaltung_mes iMoeMesaf.timer_sperrzeit_hme iMoeMesaf.timer_tsyn_rampe_pos iMoeMesaf.timer_zmes iMoeMesaf.z_mes iMoeMesaf.zaehler_zmes iMoeMesaf.zust_haupt_me_gestartet /end LOC_MEASUREMENT
/end FUNCTION
/begin FUNCTION MON "Das Paket MON enthält alle Klassen und Funktionalitäten, welche zur Beobachtung (keine Reaktionsgenerierung und damit keine Überwachung) des Getriebes notwendig sind."
 /begin LOC_MEASUREMENT iMonMoSig.mon_mst_klasse iMonMoSig.mon_mst_status iMonMoSig.mon_mst_timer /end LOC_MEASUREMENT
/end FUNCTION
/begin FUNCTION UEW "Das Paket UEW enthält alle Klassen und Funktionalitäten, welche zur Überwachung des Getriebes notwendig sind."
 /begin SUB_FUNCTION UEW_KOORDINATOR UEW_UWIG UEW_UWIG_ALT UEW_PARKSPERRENMAGNET UEW_RBM /end SUB_FUNCTION
/end FUNCTION
/begin FUNCTION UEW_KOORDINATOR "Die Unterstruktur UEW_KOORDINATOR enthält Klassen, die für die Koordination verschiedener Überwachungsfunktionen notwendig sind."
 /begin LOC_MEASUREMENT iKorDiagl.b_eg_uwig_direkt_getr_notlaufsp iKorDiagl.ersatzgang iKorDiagl.ersatzgang_info iKorDiagl.symptom_aktiv iNotInfoEgDirekt.ersatzgang /end LOC_MEASUREMENT
/end FUNCTION
/begin FUNCTION UEW_UWIG "Übersetzungsüberwachung" /begin SUB_FUNCTION ALLGEMEIN /end SUB_FUNCTION /end FUNCTION
/begin FUNCTION ALLGEMEIN "Allgemein"
 /begin LOC_MEASUREMENT iUewIgBerechnung.iMGSollmoment.letzter_ms_timer iUewIgBerechnung.iMGSollmoment.n_f iUewIgBerechnung.mg_motsolluwig iUewIgEinstBed.flag_symptom_pruefen /end LOC_MEASUREMENT
/end FUNCTION
/begin FUNCTION UEW_UWIG_ALT "Übersetzungsüberwachung vor dem ReDesign"
 /begin LOC_MEASUREMENT iUewIgetr.b_uwig_auf_symptom_pruefen iUewIgetr.delta_dki iUewIgetr.dki_max iUewIgetr.dki_min iUewIgetr.eprg_schalt_np_istgang iUewIgetr.eprg_schalt_np_zielgang_sas iUewIgetr.f_abbruch_akt_ueberwachung iUewIgetr.f_ersatzprogramm_aktiv iUewIgetr.f_ersatzwert_stc iUewIgetr.f_ist_ersatzgang_gang_stc iUewIgetr.f_ist_ersatzgang_ge_stc iUewIgetr.f_ist_ersatzgang_schalt_stc iUewIgetr.f_ist_ge_stc iUewIgetr.f_ist_nab_kleiner_schwelle_stc iUewIgetr.f_ist_neue_schaltung_stc iUewIgetr.f_ist_neues_ge_stc iUewIgetr.f_ist_schaltung_stc iUewIgetr.f_ist_stoerung_stc iUewIgetr.f_ist_symptom_gang_stc iUewIgetr.f_ist_symptom_ge_stc iUewIgetr.f_ist_symptom_schalt_stc iUewIgetr.f_pruefbed_im_gang_erreicht_stc iUewIgetr.f_schalt_durch_sym_schalt_stc iUewIgetr.f_stoer_offset_in_schaltung_stc iUewIgetr.f_timer16_rampe_gestartet_stc iUewIgetr.f_ueberwache_ge_stc iUewIgetr.fl_erf_iepuwig iUewIgetr.fl_sym_iepuwig iUewIgetr.flg_kfc_ratioglobal iUewIgetr.flg_kuppident iUewIgetr.i_gang iUewIgetr.i_gang_ge_start iUewIgetr.i_oben_rampe_start_stc iUewIgetr.i_sw_oben iUewIgetr.i_sw_unten iUewIgetr.i_unten_rampe_start_stc iUewIgetr.istgang_akt_uew_stc iUewIgetr.istgang_vorherige_schaltung_stc iUewIgetr.kfc_index_set iUewIgetr.kfl_ziel_bei_symptom_stc iUewIgetr.kup_ge1_stc iUewIgetr.kup_ge2_stc iUewIgetr.kup_ge3_stc iUewIgetr.loop_cnt_stc iUewIgetr.m_kup_ge1_stc iUewIgetr.m_kup_ge2_stc iUewIgetr.m_kup_ge3_stc iUewIgetr.m_kupuwigsym_a iUewIgetr.m_kupuwigsym_b iUewIgetr.m_kupuwigsym_c iUewIgetr.m_kupuwigsym_d iUewIgetr.m_kupuwigsym_e iUewIgetr.n_erfolg_symio_a iUewIgetr.n_erfolg_symio_b iUewIgetr.n_erfolg_symio_c iUewIgetr.n_erfolg_symio_d iUewIgetr.n_erfolg_symio_e iUewIgetr.n_erfolguwig iUewIgetr.n_stoer_gang iUewIgetr.n_stoer_ge iUewIgetr.n_stoer_schalt iUewIgetr.n_sym_uwig_cnt_kup_a iUewIgetr.n_sym_uwig_cnt_kup_b iUewIgetr.n_sym_uwig_cnt_kup_c iUewIgetr.n_sym_uwig_cnt_kup_d iUewIgetr.n_sym_uwig_cnt_kup_e iUewIgetr.n_sym_uwig_schalt12 iUewIgetr.n_sym_uwig_schalt13 iUewIgetr.n_sym_uwig_schalt21 iUewIgetr.n_sym_uwig_schalt23 iUewIgetr.n_sym_uwig_schalt24 iUewIgetr.n_sym_uwig_schalt31 iUewIgetr.n_sym_uwig_schalt32 iUewIgetr.n_sym_uwig_schalt34 iUewIgetr.n_sym_uwig_schalt35 iUewIgetr.n_sym_uwig_schalt42 iUewIgetr.n_sym_uwig_schalt43 iUewIgetr.n_sym_uwig_schalt45 iUewIgetr.n_sym_uwig_schalt46 iUewIgetr.n_sym_uwig_schalt51 iUewIgetr.n_sym_uwig_schalt53 iUewIgetr.n_sym_uwig_schalt54 iUewIgetr.n_sym_uwig_schalt56 iUewIgetr.n_sym_uwig_schalt57 iUewIgetr.n_sym_uwig_schalt63 iUewIgetr.n_sym_uwig_schalt64 iUewIgetr.n_sym_uwig_schalt65 iUewIgetr.n_sym_uwig_schalt67 iUewIgetr.n_sym_uwig_schalt68 iUewIgetr.n_sym_uwig_schalt71 iUewIgetr.n_sym_uwig_schalt75 iUewIgetr.n_sym_uwig_schalt76 iUewIgetr.n_sym_uwig_schalt78 iUewIgetr.n_sym_uwig_schalt82 iUewIgetr.n_sym_uwig_schalt84 iUewIgetr.n_sym_uwig_schalt86 iUewIgetr.n_sym_uwig_schalt87 iUewIgetr.n_t_0_stc iUewIgetr.n_t_ge_start_stc iUewIgetr.nd_synzielgang iUewIgetr.nd_tuwig_ge iUewIgetr.ng_t_ge_start iUewIgetr.schaltart_akt_uew_stc iUewIgetr.symptom_reaktion iUewIgetr.symptom_uwig_r_gang_aktiv iUewIgetr.t_maxsas_stc iUewIgetr.timer16_rampe iUewIgetr.timer16_rznuwig iUewIgetr.timer16_uwig_sas iUewIgetr.timer16_uwigrnf iUewIgetr.timer_iepuwig iUewIgetr.timer_iepuwig_erfolg iUewIgetr.timer_reg_start iUewIgetr.timer_uwig_ge iUewIgetr.timer_uwig_schalt_abbruch iUewIgetr.timer_vngabuwig iUewIgetr.uwig_abbruchgang iUewIgetr.uwig_pruefstatus_kup_a iUewIgetr.uwig_pruefstatus_kup_b iUewIgetr.uwig_pruefstatus_kup_c iUewIgetr.uwig_pruefstatus_kup_d iUewIgetr.uwig_pruefstatus_kup_e iUewIgetr.zielgang_sas_akt_uew_stc iUewIgetr.zustand_uwig /end LOC_MEASUREMENT
/end FUNCTION
/begin FUNCTION UEW_PARKSPERRENMAGNET "Überwachung der Korrekten Funktion des Parksperrenmagnets"
 /begin LOC_MEASUREMENT iUewParksperrenmagnet.flag_einstiegsbed iUewParksperrenmagnet.iTimerPmdef.timer iUewParksperrenmagnet.iTimerPmueb.timer iUewParksperrenmagnet.iTimerVerzpmueb.timer iUewParksperrenmagnet.n_stoer_pmueb iUewParksperrenmagnet.reset_timer_pmueb iUewParksperrenmagnet.z_pmueb iUewParksperrenmagnet.zustand /end LOC_MEASUREMENT
/end FUNCTION
/begin FUNCTION UEW_RBM "Die Unterstruktur UEW_RBM enthält Prüfmethoden zur Überwachung von abgasrelevanten Überwachungsfunktionen."
 /begin LOC_MEASUREMENT iDiaRbmif.flag_rbm_zust_hanfahr_iae iDiaRbmif.flag_rbm_zust_inaktiv_iae iDiaRbmif.flag_rbm_zustand_uwigkup iDiaRbmif.flag_rbm_zustand_uwigschalt iDiaRbmif.rbm_istgang_vorw_alt iDiaRbmif.rbm_zielgang_sas_vorw_alt /end LOC_MEASUREMENT
/end FUNCTION
/begin FUNCTION UL2 "Das Paket UL2 enthält alle Klassen und Funktionalitäten, welche zur Level 2 Absicherung des Getriebes notwendig sind."
 /begin SUB_FUNCTION UL2_BIB_SICHERHEIT UL2_BIB_ALLGEMEIN UL2_UEBERWACHUNGEN UL2_SIGNALE /end SUB_FUNCTION
/end FUNCTION
/begin FUNCTION UL2_BIB_SICHERHEIT "Das Paket enhält die Sicherheitsfunktionen zum Beispiel Komplementprüfung, RAM-Prüfungen für die Level2-Funktionen."
 /begin LOC_MEASUREMENT iUl2PosMeGradientFl.ng_ab_fl.n_f iUl2PosMeGradientFl.ng_t_fl.n_f iUl2PosMeGradientInt.ng_ab_l2.n_f iUl2PosMeGradientInt.ng_t_l2.n_f /end LOC_MEASUREMENT
/end FUNCTION
/begin FUNCTION UL2_BIB_ALLGEMEIN "allgemeine Bibliotheken"
 /begin LOC_MEASUREMENT iUl2GetrMAufFl.cBasFehlerErfolgFl._.flag_fehler iUl2GetrMAufFl.cBasFehlerErfolgFl._.zaehler_erfolge iUl2GetrMAufFl.cBasFehlerErfolgFl._.zaehler_fehler iUl2GetrMAufInt.cBasFehlerErfolgInt._.flag_fehler iUl2GetrMAufInt.cBasFehlerErfolgInt._.zaehler_erfolge iUl2GetrMAufInt.cBasFehlerErfolgInt._.zaehler_fehler iUl2NegMeIntenFl.cBasFehlerErfolgFl._.flag_fehler iUl2NegMeIntenFl.cBasFehlerErfolgFl._.zaehler_erfolge iUl2NegMeIntenFl.cBasFehlerErfolgFl._.zaehler_fehler iUl2NegMeIntenInt.cBasFehlerErfolgInt._.flag_fehler iUl2NegMeIntenInt.cBasFehlerErfolgInt._.zaehler_erfolge iUl2NegMeIntenInt.cBasFehlerErfolgInt._.zaehler_fehler iUl2NegMeSigFl.cBasFehlerErfolgFl._.flag_fehler iUl2NegMeSigFl.cBasFehlerErfolgFl._.zaehler_erfolge iUl2NegMeSigFl.cBasFehlerErfolgFl._.zaehler_fehler iUl2NegMeSigInt.cBasFehlerErfolgInt._.flag_fehler iUl2NegMeSigInt.cBasFehlerErfolgInt._.zaehler_erfolge iUl2NegMeSigInt.cBasFehlerErfolgInt._.zaehler_fehler iUl2PosMeGradientFl.cBasFehlerErfolgFl._.flag_fehler iUl2PosMeGradientFl.cBasFehlerErfolgFl._.zaehler_erfolge iUl2PosMeGradientFl.cBasFehlerErfolgFl._.zaehler_fehler iUl2PosMeGradientInt.cBasFehlerErfolgInt._.flag_fehler iUl2PosMeGradientInt.cBasFehlerErfolgInt._.zaehler_erfolge iUl2PosMeGradientInt.cBasFehlerErfolgInt._.zaehler_fehler iUl2PosMeIntenIGangFl.cBasFehlerErfolgFl._.flag_fehler iUl2PosMeIntenIGangFl.cBasFehlerErfolgFl._.zaehler_erfolge iUl2PosMeIntenIGangFl.cBasFehlerErfolgFl._.zaehler_fehler iUl2PosMeIntenIGangInt.cBasFehlerErfolgInt._.flag_fehler iUl2PosMeIntenIGangInt.cBasFehlerErfolgInt._.zaehler_erfolge iUl2PosMeIntenIGangInt.cBasFehlerErfolgInt._.zaehler_fehler iUl2PosMeIntenVar1Fl.cBasFehlerErfolgFl._.flag_fehler iUl2PosMeIntenVar1Fl.cBasFehlerErfolgFl._.zaehler_erfolge iUl2PosMeIntenVar1Fl.cBasFehlerErfolgFl._.zaehler_fehler iUl2PosMeIntenVar1Int.cBasFehlerErfolgInt._.flag_fehler iUl2PosMeIntenVar1Int.cBasFehlerErfolgInt._.zaehler_erfolge iUl2PosMeIntenVar1Int.cBasFehlerErfolgInt._.zaehler_fehler iUl2PosMeIntenVar2Fl.cBasFehlerErfolgFl._.flag_fehler iUl2PosMeIntenVar2Fl.cBasFehlerErfolgFl._.zaehler_erfolge iUl2PosMeIntenVar2Fl.cBasFehlerErfolgFl._.zaehler_fehler iUl2PosMeIntenVar2Int.cBasFehlerErfolgInt._.flag_fehler iUl2PosMeIntenVar2Int.cBasFehlerErfolgInt._.zaehler_erfolge iUl2PosMeIntenVar2Int.cBasFehlerErfolgInt._.zaehler_fehler iUl2PosMeSigFl.cBasFehlerErfolgFl._.flag_fehler iUl2PosMeSigFl.cBasFehlerErfolgFl._.zaehler_erfolge iUl2PosMeSigFl.cBasFehlerErfolgFl._.zaehler_fehler iUl2PosMeSigInt.cBasFehlerErfolgInt._.flag_fehler iUl2PosMeSigInt.cBasFehlerErfolgInt._.zaehler_erfolge iUl2PosMeSigInt.cBasFehlerErfolgInt._.zaehler_fehler /end LOC_MEASUREMENT
/end FUNCTION
/begin FUNCTION UL2_UEBERWACHUNGEN "klassische Überwachung nach ASIL-Standard"
 /begin SUB_FUNCTION UL2_ITF_REQ_UEW UL2_SYSTEMZUSTAENDE UL2_UEW_EDSLOGIK_KUPPL UL2_UEW_EDSLOGIK UL2_UEW_KFLPL UL2_I_GETR_PLAUSI UL2_UEW_MOTOREINGRIFF UL2_UEW_GETR_M_AUF UL2_UEW_NMOT UL2_UEW_MAX_VERZ /end SUB_FUNCTION
/end FUNCTION
/end MODULE
/end PROJECT
