ASAP2_VERSION 1 51
/begin PROJECT _929_929 "Gen2_BMW_System_Supplier_Lib"
/begin HEADER "" VERSION "C_03_03" PROJECT_NO _929_929 /end HEADER
/begin MODULE DIM ""
/begin MOD_COMMON "" BYTE_ORDER MSB_FIRST ALIGNMENT_BYTE 1 ALIGNMENT_WORD 2 ALIGNMENT_LONG 4 ALIGNMENT_FLOAT32_IEEE 4 /end MOD_COMMON
/begin CHARACTERISTIC ABLAUFVAR_RESPONSE_ANS "HAS - interne Ablaufvariante fuer Ablauf Schleppstart Response" VALUE 0x26F118 UBYTE_COL_DIRECT_M_S7_S3 0 void_int_M_S7_S3 0 15 /end CHARACTERISTIC
/begin CHARACTERISTIC BM_BEFMOD_ANFIAE_KON_ANS "Kodierung fuer die Bestimmung der Befuellung der K0 im Falle IAE Anfahren" VALUE 0x26F119 UBYTE_COL_DIRECT_M_S7_S3 0 void_int_M_S7_S3 0 4 /end CHARACTERISTIC
/begin CHARACTERISTIC BM_BEFMOD_NORM_KON_ANS "Kodierung fuer die Bestimmung der normalen Befuellung der K0 " VALUE 0x26F11A UBYTE_COL_DIRECT_M_S7_S3 0 void_int_M_S7_S3 0 4 /end CHARACTERISTIC
/begin CHARACTERISTIC BM_BEFMOD_OPT_KON_ANS "Kodierung fuer die Bestimmung der optimierten Befuellung der K0" VALUE 0x26F11B UBYTE_COL_DIRECT_M_S7_S3 0 void_int_M_S7_S3 0 4 /end CHARACTERISTIC
/begin CHARACTERISTIC BM_BEFMOD_RED_KON_ANS "Kodierung fuer die Bestimmung der reduzierten Befuellung der K0" VALUE 0x26F11C UBYTE_COL_DIRECT_M_S7_S3 0 void_int_M_S7_S3 0 4 /end CHARACTERISTIC
/begin CHARACTERISTIC BM_BEFMOD_RESP_SCHALT_KON_ANS "Kodierung fuer die Bestimmung der Befuellung der K0 im Falle Response SLST" VALUE 0x26F11D UBYTE_COL_DIRECT_M_S7_S3 0 void_int_M_S7_S3 0 4 /end CHARACTERISTIC
/begin CHARACTERISTIC BM_SCHALTARTNEMMODRS_SYN_ZUS "Bitmaske zur Festlegung der Schaltart der RS zur Anhebung der modifizierten EM- Drehzahl als Basisdrehzahl zur Bestimmung der VM Solldrehzahl bei RS beim K0 Synchronisieren beim Zustart" VALUE 0x26F1B0 UBYTE_COL_DIRECT_M_S7_S3 0 void_int_M_S7_S3 0 255 /end CHARACTERISTIC
/begin CHARACTERISTIC CS_BEFUELLOPTCGETRIEBE_KON_ANS "Temperaturschwelle fuer die Anforderung opt. K0-Befuellung" VALUE 0x26AA78 FLOAT32_IEEE_COL_DIRECT_M_S7_S3 0 c_fl_M_S7_S3 -40 150 /end CHARACTERISTIC
/begin CHARACTERISTIC F_NDSOLLIAESTAT_KON_ANS "Gewichtungsfaktor fuer nd_ziel_iae_stat im Zustand KON -> SYN" VALUE 0x26AA98 FLOAT32_IEEE_COL_DIRECT_M_S7_S3 0 void_fl_M_S7_S3 0 5 /end CHARACTERISTIC
/begin CHARACTERISTIC FK_NGEM_ANS "Filterkonstante zur Berechnung des EM-Drehzahlgradienten beim Schleppstart" VALUE 0x26AA80 FLOAT32_IEEE_COL_DIRECT_M_S7_S3 0 void_fl_M_S7_S3 0 1 /end CHARACTERISTIC
/begin CHARACTERISTIC FK_NSOLLVM_SAK_ANS "Filterung der VM-Solldrehzahl im Zustand Schaltung aktiv beim Schleppstart" VALUE 0x26AA88 FLOAT32_IEEE_COL_DIRECT_M_S7_S3 0 t_fl_M_S7_S3 0 1 /end CHARACTERISTIC
/begin CHARACTERISTIC FK_NSOLLVM_ZND_ANS "Filterung der VM-Solldrehzahl im Zustand VM Zuenden beim Schleppstart" VALUE 0x26AA94 FLOAT32_IEEE_COL_DIRECT_M_S7_S3 0 t_fl_M_S7_S3 0 1 /end CHARACTERISTIC
/begin CHARACTERISTIC K_MSTOERKPL_ABB_ANS "Gewichtungsfaktor auf das Kupplungsmoment zur Berechnung des Stoermoments im Zustand ABB" VALUE 0x26AAA0 FLOAT32_IEEE_COL_DIRECT_M_S7_S3 0 void_fl_M_S7_S3 0 5 /end CHARACTERISTIC
/begin CHARACTERISTIC K_MSTOERKPL_ZND_ANS "Gewichtungsfaktor auf das Kupplungsmoment zur Berechnung des Stoermoments im Zustand ZND" VALUE 0x26AAB0 FLOAT32_IEEE_COL_DIRECT_M_S7_S3 0 void_fl_M_S7_S3 0 5 /end CHARACTERISTIC
/begin CHARACTERISTIC K_MZIELNOEMNSOLLVM_KON_ANS "Faktor zur Gewichtung des VM-Zielmoment der HAS aus der Fahrpedal-Interpretation zur  Bestimmung der VM-Solldrehzahl ab dem Zustand Konditionieren und in dem Zustanden Schaltung aktiv beim Schleppstart" VALUE 0x26AAB4 FLOAT32_IEEE_COL_DIRECT_M_S7_S3 0 void_fl_M_S7_S3 0 5 /end CHARACTERISTIC
/begin CHARACTERISTIC K_NOEMNSOLLVMOKS_KON_ANS "Faktor fuer Gewichtung des Drehzahloffsets bei der Bestimmung der VM-Solldrehzahl ohne Kraftschluss ab dem Zustand Konditionieren und in dem Zustand Schaltung aktiv beim Schleppstart." VALUE 0x26AAB8 FLOAT32_IEEE_COL_DIRECT_M_S7_S3 0 void_fl_M_S7_S3 0 1 /end CHARACTERISTIC
/begin CHARACTERISTIC K_SVH_RESET_AST_VMA "Bedingtes Ruecksetzen einer Schaltverhinderung im Zustand VM-Abstellen der Hybridfunktion VM aus (255 = alle Arten von Schaltungen zuruecksetzen, 0 = keine Schal-tung zuruecksetzen)  Bit-Codierung siehe Handbuch" VALUE 0x26F18A UBYTE_COL_DIRECT_M_S7_S3 0 sts_int_M_S7_S3 0 255 /end CHARACTERISTIC
/begin CHARACTERISTIC K_SVH_RESET_RESPPARAL_KON_ANS "Bedingtes Ruecksetzen einer Schaltverhinderung waehrend VM-Schleppstart im Zustand Konditionieren und SLST SCHLTG (255=alle Arten von Schaltungen zuruecksetzen, 0= keine Schltg. zuruecksetzen) -> Bit Codierung siehe Handbuch" VALUE 0x26F11F UBYTE_COL_DIRECT_M_S7_S3 0 void_int_M_S7_S3 0 255 /end CHARACTERISTIC
/begin CHARACTERISTIC K_SVH_RESET_RESPPARAL_ZND_ANS "Bedingtes Ruecksetzen einer Schaltverhinderung waehrend VM-Schleppstart im Zustand Konditionieren und SLST SCHLTG (255=alle Arten von Schaltungen zuruecksetzen, 0= keine Schltg. zuruecksetzen) -> Bit Codierung siehe Handbuch" VALUE 0x26F124 UBYTE_COL_DIRECT_M_S7_S3 0 void_int_M_S7_S3 0 255 /end CHARACTERISTIC
/begin CHARACTERISTIC K_SVH_RESET_RESPTEILPAR_ZND_ANS "Bedingtes Ruecksetzen einer Schaltverhinderung waehrend VM-Schleppstart im Zustand Zuenden (255=alle Arten von Schaltugne zuruecksetzen, 0= keine Schltg. zuruecksetzen) -> Bit Codierung siehe Handbuch" VALUE 0x26F127 UBYTE_COL_DIRECT_M_S7_S3 0 void_int_M_S7_S3 0 255 /end CHARACTERISTIC
/begin CHARACTERISTIC K_SVH_RESET_SRT_VMA "Bedingtes Ruecksetzen einer Schaltverhinderung im Zustand Start der Hybridfunktion VM aus (255 = alle Arten von Schaltungen zuruecksetzen, 0 = keine Schaltung zuruecksetzen) Bit-Codierung siehe Handbuch" VALUE 0x26F18B UBYTE_COL_DIRECT_M_S7_S3 0 sts_int_M_S7_S3 0 255 /end CHARACTERISTIC
/begin CHARACTERISTIC K_SVH_RESET_SRT_VME "Bedingtes Ruecksetzen einer Schaltverhinderung im Zustand Start der Hybridfunk-tion VM ein (255 = alle Arten von Schaltungen zuruecksetzen, 0 = keine Schaltung zuruecksetzen) Bit-Codierung siehe Handbuch" VALUE 0x26F18E UBYTE_COL_DIRECT_M_S7_S3 0 sts_int_M_S7_S3 0 255 /end CHARACTERISTIC
/begin CHARACTERISTIC K_SVH_RESET_ZST_VME "Bedingtes Ruecksetzen einer Schaltverhinderung im Zustand Zustarten der Hybrid-funktion VM ein (255 = alle Arten von Schaltungen zuruecksetzen, 0 = keine Schaltung zuruecksetzen) Bit-Codierung siehe Handbuch" VALUE 0x26F18F UBYTE_COL_DIRECT_M_S7_S3 0 sts_int_M_S7_S3 0 255 /end CHARACTERISTIC
/begin CHARACTERISTIC K_SVH_RESETLAUS_SRT_ZUS "Ruecksetzen Schaltverhinderung bei bereits laufender Schaltung im Zustand Start beim Zustart (255 = alle Arten von Schaltungen zuruecksetzen, 0 = keine Schaltung zuruecksetzen)  Bit-Codierung siehe Handbuch" VALUE 0x26F1B3 UBYTE_COL_DIRECT_M_S7_S3 0 b_int_b_M_S7_S3 0 255 /end CHARACTERISTIC
/begin CHARACTERISTIC K_SVH_RESETLAUSABLABBR_SRT_ZUS "Ruecksetzen Schaltverhinderung bei bereits laufender Schaltung und vorherigem Ablauf-Abbruch im Zustand Start beim Zustart (255 = alle Arten von Schaltungen zuruecksetzen, 0 = keine Schaltung zuruecksetzen)  Bit-Codierung siehe Handbuch" VALUE 0x26F1B2 UBYTE_COL_DIRECT_M_S7_S3 0 b_int_b_M_S7_S3 0 255 /end CHARACTERISTIC
/begin CHARACTERISTIC KF_FMSTOERND_VMS_ANS_W "Bestimmung k_mtoer" MAP 0x265270 FLOAT32_IEEE_COL_DIRECT_M_S7_S3 0 void_fl_M_S7_S3 -3.40282E+038 3.40282E+038
 /begin AXIS_DESCR COM_AXIS nd_k0_in n_fl_M_S7_S3 10 -3.40282E+038 3.40282E+038 AXIS_PTS_REF KF_FMSTOERND_VMS_ANS_X /end AXIS_DESCR
 /begin AXIS_DESCR COM_AXIS n_em_in n_fl_M_S7_S3 8 -3.40282E+038 3.40282E+038 AXIS_PTS_REF KF_FMSTOERND_VMS_ANS_Y /end AXIS_DESCR
/end CHARACTERISTIC
/begin CHARACTERISTIC KF_IAEENTK_STIAEKRAFTFL_ANS_W "Teil der Bestimmung z_iae_entkoppelt" MAP 0x26EDEF UBYTE_COL_DIRECT_M_S7_S3 0 void_int_M_S7_S3 0 1
 /begin AXIS_DESCR COM_AXIS status_iae_in sts_int_M_S7_S3 9 0 8 AXIS_PTS_REF KF_IAEENTK_STIAEKRAFTFL_ANS_X /end AXIS_DESCR
 /begin AXIS_DESCR COM_AXIS status_kraftfluss_egs_in void_int_M_S7_S3 7 0 6 AXIS_PTS_REF KF_IAEENTK_STIAEKRAFTFL_ANS_Y /end AXIS_DESCR
/end CHARACTERISTIC
/begin CHARACTERISTIC KF_MGK0BEFANFIAE_KON_ANS_W "mg_soll_k0_has fuer IAE Anfahren" MAP 0x265800 FLOAT32_IEEE_COL_DIRECT_M_S7_S3 0 trqg_fl_k_M_S7_S3 -10000 10000
 /begin AXIS_DESCR COM_AXIS NO_INPUT_QUANTITY ng_fl_M_S7_S3 8 -10000 10000 AXIS_PTS_REF KF_MGK0BEFANFIAE_KON_ANS_X /end AXIS_DESCR
 /begin AXIS_DESCR COM_AXIS NO_INPUT_QUANTITY n_fl_M_S7_S3 8 -10000 10000 AXIS_PTS_REF KF_MGK0BEFANFIAE_KON_ANS_Y /end AXIS_DESCR
/end CHARACTERISTIC
/begin CHARACTERISTIC KF_MGK0BEFNORM_KON_ANS_W "m_soll_k0_has fuer normale Befuellung" MAP 0x265940 FLOAT32_IEEE_COL_DIRECT_M_S7_S3 0 trq_fl_a_M_S7_S3 -10000 10000
 /begin AXIS_DESCR COM_AXIS NO_INPUT_QUANTITY c_fl_M_S7_S3 8 -40 150 AXIS_PTS_REF KF_MGK0BEFNORM_KON_ANS_X /end AXIS_DESCR
 /begin AXIS_DESCR COM_AXIS NO_INPUT_QUANTITY phi_fl_M_S7_S3 8 0 360 AXIS_PTS_REF KF_MGK0BEFNORM_KON_ANS_Y /end AXIS_DESCR
/end CHARACTERISTIC
/begin CHARACTERISTIC KF_MGK0BEFOPT_KON_ANS_W "mg_soll_k0_has fuer opt. Befuellung" MAP 0x265A80 FLOAT32_IEEE_COL_DIRECT_M_S7_S3 0 trqg_fl_k_M_S7_S3 -10000 10000
 /begin AXIS_DESCR COM_AXIS NO_INPUT_QUANTITY c_fl_M_S7_S3 8 -40 150 AXIS_PTS_REF KF_MGK0BEFOPT_KON_ANS_X /end AXIS_DESCR
 /begin AXIS_DESCR COM_AXIS NO_INPUT_QUANTITY phi_fl_M_S7_S3 8 0 360 AXIS_PTS_REF KF_MGK0BEFOPT_KON_ANS_Y /end AXIS_DESCR
/end CHARACTERISTIC
/begin CHARACTERISTIC KF_MGK0BEFRED_KON_ANS_W "mg_soll_k0_has fuer reduzierte Befuellung" MAP 0x265BC0 FLOAT32_IEEE_COL_DIRECT_M_S7_S3 0 trqg_fl_k_M_S7_S3 -10000 10000
 /begin AXIS_DESCR COM_AXIS NO_INPUT_QUANTITY c_fl_M_S7_S3 8 -40 150 AXIS_PTS_REF KF_MGK0BEFRED_KON_ANS_X /end AXIS_DESCR
 /begin AXIS_DESCR COM_AXIS NO_INPUT_QUANTITY phi_fl_M_S7_S3 8 0 360 AXIS_PTS_REF KF_MGK0BEFRED_KON_ANS_Y /end AXIS_DESCR
/end CHARACTERISTIC
/begin CHARACTERISTIC KF_MGK0BEFRESP_SCHALT_KON_ANS_W "mg_soll_k0_has Response SLST V2" MAP 0x265D00 FLOAT32_IEEE_COL_DIRECT_M_S7_S3 0 trq_fl_a_M_S7_S3 -10000 10000
 /begin AXIS_DESCR COM_AXIS NO_INPUT_QUANTITY c_fl_M_S7_S3 8 -40 150 AXIS_PTS_REF KF_MGK0BEFRESP_SCHALT_KON_ANS_X /end AXIS_DESCR
 /begin AXIS_DESCR COM_AXIS NO_INPUT_QUANTITY phi_fl_M_S7_S3 8 0 360 AXIS_PTS_REF KF_MGK0BEFRESP_SCHALT_KON_ANS_Y /end AXIS_DESCR
/end CHARACTERISTIC
/begin CHARACTERISTIC KF_MGK0VMANDREH_KON_ANS_W "mg_soll_k0_has fuer VM Andrehen" MAP 0x26628C FLOAT32_IEEE_COL_DIRECT_M_S7_S3 0 trqg_fl_k_M_S7_S3 -10000 10000
 /begin AXIS_DESCR COM_AXIS NO_INPUT_QUANTITY c_fl_M_S7_S3 8 -40 150 AXIS_PTS_REF KF_MGK0VMANDREH_KON_ANS_X /end AXIS_DESCR
 /begin AXIS_DESCR COM_AXIS NO_INPUT_QUANTITY phi_fl_M_S7_S3 8 0 360 AXIS_PTS_REF KF_MGK0VMANDREH_KON_ANS_Y /end AXIS_DESCR
/end CHARACTERISTIC
/begin CHARACTERISTIC KF_MGZIELMAXEM_KON_ANS_W "Gradient des Maximalmoments des EM-Drehzahlreglers" MAP 0x266804 FLOAT32_IEEE_COL_DIRECT_M_S7_S3 0 trqg_fl_k_M_S7_S3 0 50000
 /begin AXIS_DESCR COM_AXIS NO_INPUT_QUANTITY trq_fl_a_M_S7_S3 8 -1000 1000 AXIS_PTS_REF KF_MGZIELMAXEM_KON_ANS_X /end AXIS_DESCR
 /begin AXIS_DESCR COM_AXIS nd_iae_ans n_fl_M_S7_S3 7 -10000 10000 AXIS_PTS_REF KF_MGZIELMAXEM_KON_ANS_Y /end AXIS_DESCR
/end CHARACTERISTIC
/begin CHARACTERISTIC KF_MGZIELMINEM_KON_ANS_W "Gradient des Minimalmoments des EM-Drehzahlreglers" MAP 0x266920 FLOAT32_IEEE_COL_DIRECT_M_S7_S3 0 trqg_fl_k_M_S7_S3 0 50000
 /begin AXIS_DESCR COM_AXIS NO_INPUT_QUANTITY trq_fl_a_M_S7_S3 8 -1000 1000 AXIS_PTS_REF KF_MGZIELMINEM_KON_ANS_X /end AXIS_DESCR
 /begin AXIS_DESCR COM_AXIS nd_iae_ans n_fl_M_S7_S3 7 -10000 10000 AXIS_PTS_REF KF_MGZIELMINEM_KON_ANS_Y /end AXIS_DESCR
/end CHARACTERISTIC
/begin CHARACTERISTIC KF_MK0CGETRMMOT_SCHUB_ZND_ANS_W "K0-Zielmoment fuer Schub in der Phase ZND" MAP 0x266A3C FLOAT32_IEEE_COL_DIRECT_M_S7_S3 0 trq_fl_a_M_S7_S3 -1000 1000
 /begin AXIS_DESCR COM_AXIS NO_INPUT_QUANTITY c_fl_M_S7_S3 8 -40 150 AXIS_PTS_REF KF_MK0CGETRMMOT_SCHUB_ZND_ANS_X /end AXIS_DESCR
 /begin AXIS_DESCR COM_AXIS NO_INPUT_QUANTITY trq_fl_a_M_S7_S3 8 -1000 1000 AXIS_PTS_REF KF_MK0CGETRMMOT_SCHUB_ZND_ANS_Y /end AXIS_DESCR
/end CHARACTERISTIC
/begin CHARACTERISTIC KF_MK0CGETRMMOT_ZND_ANS_W "K0-Zielmoment in der Phase ZND" MAP 0x266B7C FLOAT32_IEEE_COL_DIRECT_M_S7_S3 0 trq_fl_a_M_S7_S3 -3.40282E+038 3.40282E+038
 /begin AXIS_DESCR COM_AXIS NO_INPUT_QUANTITY c_fl_M_S7_S3 8 -40 150 AXIS_PTS_REF KF_MK0CGETRMMOT_ZND_ANS_X /end AXIS_DESCR
 /begin AXIS_DESCR COM_AXIS NO_INPUT_QUANTITY trq_fl_a_M_S7_S3 8 -1000 1000 AXIS_PTS_REF KF_MK0CGETRMMOT_ZND_ANS_Y /end AXIS_DESCR
/end CHARACTERISTIC
/begin CHARACTERISTIC KF_MK0MMOTNVM_SCHUB_ZND_ANS_W "K0-Zielmoment im Schub  in der Phase ZND" MAP 0x2671BC FLOAT32_IEEE_COL_DIRECT_M_S7_S3 0 trq_fl_a_M_S7_S3 -1000 1000
 /begin AXIS_DESCR COM_AXIS NO_INPUT_QUANTITY trq_fl_a_M_S7_S3 8 -10000 10000 AXIS_PTS_REF KF_MK0MMOTNVM_SCHUB_ZND_ANS_X /end AXIS_DESCR
 /begin AXIS_DESCR COM_AXIS NO_INPUT_QUANTITY n_fl_M_S7_S3 8 -10000 10000 AXIS_PTS_REF KF_MK0MMOTNVM_SCHUB_ZND_ANS_Y /end AXIS_DESCR
/end CHARACTERISTIC
/begin CHARACTERISTIC KF_MK0MMOTNVM_ZND_ANS_W "K0-Zielmoment in der Phase ZND" MAP 0x2672FC FLOAT32_IEEE_COL_DIRECT_M_S7_S3 0 trq_fl_a_M_S7_S3 -1000 1000
 /begin AXIS_DESCR COM_AXIS NO_INPUT_QUANTITY trq_fl_a_M_S7_S3 8 -10000 10000 AXIS_PTS_REF KF_MK0MMOTNVM_ZND_ANS_X /end AXIS_DESCR
 /begin AXIS_DESCR COM_AXIS NO_INPUT_QUANTITY n_fl_M_S7_S3 8 -10000 10000 AXIS_PTS_REF KF_MK0MMOTNVM_ZND_ANS_Y /end AXIS_DESCR
/end CHARACTERISTIC
/begin CHARACTERISTIC KF_MOIAEENTKERK1_ANS_W "1. Momentenoffset fuer die Erkennung IAE entkoppelt (status_iae_in = 8) " MAP 0x2677EC FLOAT32_IEEE_COL_DIRECT_M_S7_S3 0 trq_fl_a_M_S7_S3 -1000 1000
 /begin AXIS_DESCR COM_AXIS m_mot_in trq_fl_a_M_S7_S3 8 -1000 1000 AXIS_PTS_REF KF_MOIAEENTKERK1_ANS_X /end AXIS_DESCR
 /begin AXIS_DESCR COM_AXIS NO_INPUT_QUANTITY void_int_q_M_S7_S3 10 -1 8 AXIS_PTS_REF KF_MOIAEENTKERK1_ANS_Y /end AXIS_DESCR
/end CHARACTERISTIC
/begin CHARACTERISTIC KF_MOIAEENTKERK2_ANS_W "2. Momentenoffset fuer die Erkennung IAE entkoppelt (status_iae_in = 8) " MAP 0x267974 FLOAT32_IEEE_COL_DIRECT_M_S7_S3 0 void_fl_M_S7_S3 -1000 1000
 /begin AXIS_DESCR COM_AXIS m_mot_in trq_fl_a_M_S7_S3 8 -1000 1000 AXIS_PTS_REF KF_MOIAEENTKERK2_ANS_X /end AXIS_DESCR
 /begin AXIS_DESCR COM_AXIS NO_INPUT_QUANTITY void_int_q_M_S7_S3 10 -1 8 AXIS_PTS_REF KF_MOIAEENTKERK2_ANS_Y /end AXIS_DESCR
/end CHARACTERISTIC
/begin CHARACTERISTIC KF_MZIELK0ANFIAE_KON_ANS_W "m_soll_k0_has waehrend IAE Anfahren" MAP 0x268548 FLOAT32_IEEE_COL_DIRECT_M_S7_S3 0 trq_fl_a_M_S7_S3 -1000 1000
 /begin AXIS_DESCR COM_AXIS NO_INPUT_QUANTITY ng_fl_M_S7_S3 8 -10000 10000 AXIS_PTS_REF KF_MZIELK0ANFIAE_KON_ANS_X /end AXIS_DESCR
 /begin AXIS_DESCR COM_AXIS NO_INPUT_QUANTITY n_fl_M_S7_S3 8 -10000 10000 AXIS_PTS_REF KF_MZIELK0ANFIAE_KON_ANS_Y /end AXIS_DESCR
/end CHARACTERISTIC
/begin CHARACTERISTIC KF_MZIELK0BEFMODUS_SST_ANS_W "m_ziel_k0_ans, wenn status_k0befuellung_ans = FALSE im ab Anschleppen" MAP 0x268688 FLOAT32_IEEE_COL_DIRECT_M_S7_S3 0 trq_fl_a_M_S7_S3 -1000 1000
 /begin AXIS_DESCR COM_AXIS NO_INPUT_QUANTITY c_fl_M_S7_S3 8 -3.40282E+038 3.40282E+038 AXIS_PTS_REF KF_MZIELK0BEFMODUS_SST_ANS_X /end AXIS_DESCR
 /begin AXIS_DESCR COM_AXIS NO_INPUT_QUANTITY sts_int_r_M_S7_S3 3 0 2 AXIS_PTS_REF KF_MZIELK0BEFMODUS_SST_ANS_Y /end AXIS_DESCR
/end CHARACTERISTIC
/begin CHARACTERISTIC KF_MZIELK0BEFNORM_KON_ANS_W "m_soll_k0_has fuer normale Befuellung" MAP 0x268714 FLOAT32_IEEE_COL_DIRECT_M_S7_S3 0 trq_fl_a_M_S7_S3 -1000 1000
 /begin AXIS_DESCR COM_AXIS NO_INPUT_QUANTITY c_fl_M_S7_S3 8 -40 150 AXIS_PTS_REF KF_MZIELK0BEFNORM_KON_ANS_X /end AXIS_DESCR
 /begin AXIS_DESCR COM_AXIS NO_INPUT_QUANTITY phi_fl_M_S7_S3 8 0 360 AXIS_PTS_REF KF_MZIELK0BEFNORM_KON_ANS_Y /end AXIS_DESCR
/end CHARACTERISTIC
/begin CHARACTERISTIC KF_MZIELK0BEFOPT_KON_ANS_W "m_soll_k0_has fuer opt. Befuellung" MAP 0x268854 FLOAT32_IEEE_COL_DIRECT_M_S7_S3 0 trq_fl_a_M_S7_S3 -1000 1000
 /begin AXIS_DESCR COM_AXIS NO_INPUT_QUANTITY c_fl_M_S7_S3 8 -40 150 AXIS_PTS_REF KF_MZIELK0BEFOPT_KON_ANS_X /end AXIS_DESCR
 /begin AXIS_DESCR COM_AXIS NO_INPUT_QUANTITY phi_fl_M_S7_S3 8 0 360 AXIS_PTS_REF KF_MZIELK0BEFOPT_KON_ANS_Y /end AXIS_DESCR
/end CHARACTERISTIC
/begin CHARACTERISTIC KF_MZIELK0BEFRED_KON_ANS_W "m_soll_k0_has fuer reduzierte Befuellung" MAP 0x268994 FLOAT32_IEEE_COL_DIRECT_M_S7_S3 0 VOID_SCALING_M_S7_S3 -1000 1000
 /begin AXIS_DESCR COM_AXIS NO_INPUT_QUANTITY c_fl_M_S7_S3 8 -40 150 AXIS_PTS_REF KF_MZIELK0BEFRED_KON_ANS_X /end AXIS_DESCR
 /begin AXIS_DESCR COM_AXIS NO_INPUT_QUANTITY phi_fl_M_S7_S3 8 0 360 AXIS_PTS_REF KF_MZIELK0BEFRED_KON_ANS_Y /end AXIS_DESCR
/end CHARACTERISTIC
/begin CHARACTERISTIC KF_MZIELK0BEFRESP_SCHALT_KON_ANS_W "m_soll_k0_has Response SLST V2" MAP 0x268AD4 FLOAT32_IEEE_COL_DIRECT_M_S7_S3 0 trq_fl_a_M_S7_S3 -1000 1000
 /begin AXIS_DESCR COM_AXIS NO_INPUT_QUANTITY c_fl_M_S7_S3 8 -40 150 AXIS_PTS_REF KF_MZIELK0BEFRESP_SCHALT_KON_ANS_X /end AXIS_DESCR
 /begin AXIS_DESCR COM_AXIS NO_INPUT_QUANTITY phi_fl_M_S7_S3 8 0 360 AXIS_PTS_REF KF_MZIELK0BEFRESP_SCHALT_KON_ANS_Y /end AXIS_DESCR
/end CHARACTERISTIC
/begin CHARACTERISTIC KF_MZIELK0VMANDREH_KON_ANS_W "m_soll_k0_has fuer Verbrenner dreht bereits " MAP 0x268C14 FLOAT32_IEEE_COL_DIRECT_M_S7_S3 0 trq_fl_a_M_S7_S3 -3.40282E+038 3.40282E+038
 /begin AXIS_DESCR COM_AXIS NO_INPUT_QUANTITY ng_fl_M_S7_S3 8 -3.40282E+038 3.40282E+038 AXIS_PTS_REF KF_MZIELK0VMANDREH_KON_ANS_X /end AXIS_DESCR
 /begin AXIS_DESCR COM_AXIS NO_INPUT_QUANTITY n_fl_M_S7_S3 8 -3.40282E+038 3.40282E+038 AXIS_PTS_REF KF_MZIELK0VMANDREH_KON_ANS_Y /end AXIS_DESCR
/end CHARACTERISTIC
/begin CHARACTERISTIC KF_NDEMNSOLLVM_ZND_ANS_W "Differenzdrehzahl zum Abbau des Drehzahloffset auf die Basis-Drehzahl zur Berechnung des Zielwerts der VM Solldrehzahl ab dem Zustand Zuenden beim Schleppstart" MAP 0x268F8C FLOAT32_IEEE_COL_DIRECT_M_S7_S3 0 n_fl_M_S7_S3 0 10000
 /begin AXIS_DESCR COM_AXIS NO_INPUT_QUANTITY n_fl_M_S7_S3 10 0 10000 AXIS_PTS_REF KF_NDEMNSOLLVM_ZND_ANS_X /end AXIS_DESCR
 /begin AXIS_DESCR COM_AXIS NO_INPUT_QUANTITY trq_fl_a_M_S7_S3 7 -1000 1000 AXIS_PTS_REF KF_NDEMNSOLLVM_ZND_ANS_Y /end AXIS_DESCR
/end CHARACTERISTIC
/begin CHARACTERISTIC KF_NOEMNSOLLVM_KON_ANS_W "Drehzahloffset auf die Basis-Drehzahl zur Berechnung des Zielwerts der VM Solldrehzahl ab dem Zustand Konditionieren und in dem Zustand Schaltung aktiv beim Schleppstart" MAP 0x269494 FLOAT32_IEEE_COL_DIRECT_M_S7_S3 0 n_fl_M_S7_S3 0 10000
 /begin AXIS_DESCR COM_AXIS NO_INPUT_QUANTITY n_fl_M_S7_S3 10 0 10000 AXIS_PTS_REF KF_NOEMNSOLLVM_KON_ANS_X /end AXIS_DESCR
 /begin AXIS_DESCR COM_AXIS NO_INPUT_QUANTITY trq_fl_a_M_S7_S3 7 -1000 1000 AXIS_PTS_REF KF_NOEMNSOLLVM_KON_ANS_Y /end AXIS_DESCR
/end CHARACTERISTIC
/begin CHARACTERISTIC KF_SLT_GANGWE_RESPPARAL_ZND_ANS_W "Beruecksichtigung des gangwechsel_egs_in beim Uebergang nach Synchronisieren bei der entsprechenden Schaltung" MAP 0x26A930 UBYTE_COL_DIRECT_M_S7_S3 0 void_int_M_S7_S3 0 1
 /begin AXIS_DESCR COM_AXIS NO_INPUT_QUANTITY void_int_M_S7_S3 10 -128 127 AXIS_PTS_REF KF_SLT_GANGWE_RESPPARAL_ZND_ANS_X /end AXIS_DESCR
 /begin AXIS_DESCR COM_AXIS NO_INPUT_QUANTITY void_int_M_S7_S3 10 -128 127 AXIS_PTS_REF KF_SLT_GANGWE_RESPPARAL_ZND_ANS_Y /end AXIS_DESCR
/end CHARACTERISTIC
/begin CHARACTERISTIC KF_STATUS_IAE_PLAUS_ANS_W "Bestimmung Umschaltkriterium status_iae_plausi" MAP 0x26EEDC UBYTE_COL_DIRECT_M_S7_S3 0 st_int_M_S7_S3 0 1
 /begin AXIS_DESCR COM_AXIS status_iae_in sts_int_M_S7_S3 9 0 255 AXIS_PTS_REF KF_STATUS_IAE_PLAUS_ANS_X /end AXIS_DESCR
 /begin AXIS_DESCR COM_AXIS status_kraftfluss_egs_in sts_int_M_S7_S3 7 0 255 AXIS_PTS_REF KF_STATUS_IAE_PLAUS_ANS_Y /end AXIS_DESCR
/end CHARACTERISTIC
/begin CHARACTERISTIC KF_VMISTVMSOLL_ZND_ANS_W "Drehzahlschwelle VM zum Zuruecksetzen der SVH" MAP 0x2699D0 FLOAT32_IEEE_COL_DIRECT_M_S7_S3 0 n_fl_M_S7_S3 -10000 10000
 /begin AXIS_DESCR COM_AXIS NO_INPUT_QUANTITY c_fl_M_S7_S3 8 -40 150 AXIS_PTS_REF KF_VMISTVMSOLL_ZND_ANS_X /end AXIS_DESCR
 /begin AXIS_DESCR COM_AXIS NO_INPUT_QUANTITY void_int_q_M_S7_S3 8 1 8 AXIS_PTS_REF KF_VMISTVMSOLL_ZND_ANS_Y /end AXIS_DESCR
/end CHARACTERISTIC
/begin CHARACTERISTIC KF_Z_MOMAXIAE_ANS_W "Wird keine Beeinflussung der IAE gewuenscht, dann muss fuer den 
entsprechenden Zustand eine 1 eingetragen werden " MAP 0x26F067 UBYTE_COL_DIRECT_M_S7_S3 0 st_int_M_S7_S3 0 1
 /begin AXIS_DESCR COM_AXIS status_iae_in sts_int_M_S7_S3 9 0 8 AXIS_PTS_REF KF_Z_MOMAXIAE_ANS_X /end AXIS_DESCR
 /begin AXIS_DESCR COM_AXIS status_kraftfluss_egs_in st_int_M_S7_S3 7 0 6 AXIS_PTS_REF KF_Z_MOMAXIAE_ANS_Y /end AXIS_DESCR
/end CHARACTERISTIC
/begin CHARACTERISTIC KF_ZMMAXABLVARNLLVM_ANS_W "Aktivierung z_mmaxiaeaktiv = f(istgang, ablaufvar)" MAP 0x26A994 UBYTE_COL_DIRECT_M_S7_S3 0 void_int_M_S7_S3 0 1
 /begin AXIS_DESCR COM_AXIS istgang_egs_in void_int_M_S7_S3 10 -1 8 AXIS_PTS_REF KF_ZMMAXABLVARNLLVM_ANS_X /end AXIS_DESCR
 /begin AXIS_DESCR COM_AXIS NO_INPUT_QUANTITY void_int_M_S7_S3 6 0 15 AXIS_PTS_REF KF_ZMMAXABLVARNLLVM_ANS_Y /end AXIS_DESCR
/end CHARACTERISTIC
/begin CHARACTERISTIC KF_ZMMAXIAEISTGANGABLVAR_ANS_W "Ansteuerung IAE in Abhaengigkeit der Ablaufvariante" MAP 0x26A9D0 UBYTE_COL_DIRECT_M_S7_S3 0 void_int_M_S7_S3 0 1
 /begin AXIS_DESCR COM_AXIS istgang_egs_in void_int_M_S7_S3 10 -1 8 AXIS_PTS_REF KF_ZMMAXIAEISTGANGABLVAR_ANS_X /end AXIS_DESCR
 /begin AXIS_DESCR COM_AXIS NO_INPUT_QUANTITY void_int_M_S7_S3 6 0 15 AXIS_PTS_REF KF_ZMMAXIAEISTGANGABLVAR_ANS_Y /end AXIS_DESCR
/end CHARACTERISTIC
/begin CHARACTERISTIC KF_ZMMAXSTSIAE_ANS_W "Anforderung Entkopplung der IAE als f=(status_iae_in, status_kraftfluss_egs_in)" MAP 0x26EFC9 UBYTE_COL_DIRECT_M_S7_S3 0 st_int_M_S7_S3 0 1
 /begin AXIS_DESCR COM_AXIS status_iae_in sts_int_M_S7_S3 9 0 8 AXIS_PTS_REF KF_ZMMAXSTSIAE_ANS_X /end AXIS_DESCR
 /begin AXIS_DESCR COM_AXIS status_kraftfluss_egs_in st_int_M_S7_S3 7 0 6 AXIS_PTS_REF KF_ZMMAXSTSIAE_ANS_Y /end AXIS_DESCR
/end CHARACTERISTIC
/begin CHARACTERISTIC KF_ZNSOLLEM_STIAEKRAFTFL_ANS_W "Teil der Bestimmung z_n_soll_em_aktiv_has" MAP 0x26F018 UBYTE_COL_DIRECT_M_S7_S3 0 void_int_M_S7_S3 0 1
 /begin AXIS_DESCR COM_AXIS status_iae_in void_int_M_S7_S3 9 0 8 AXIS_PTS_REF KF_ZNSOLLEM_STIAEKRAFTFL_ANS_X /end AXIS_DESCR
 /begin AXIS_DESCR COM_AXIS status_kraftfluss_egs_in void_int_M_S7_S3 7 0 6 AXIS_PTS_REF KF_ZNSOLLEM_STIAEKRAFTFL_ANS_Y /end AXIS_DESCR
/end CHARACTERISTIC
/begin CHARACTERISTIC KL_ENTKMOEGLIAESTIAEKRAFT_ANS_Y "Flag zur Aktivierung IAE Entkopplung moeglich" CURVE 0x26F0BD UBYTE_COL_DIRECT_M_S7_S3 0 sts_int_M_S7_S3 0 1
 /begin AXIS_DESCR COM_AXIS status_kraftfluss_egs_in sts_int_M_S7_S3 7 0 6 AXIS_PTS_REF KL_ENTKMOEGLIAESTIAEKRAFT_ANS_X /end AXIS_DESCR
/end CHARACTERISTIC
/begin CHARACTERISTIC KL_FMK0CGETRMMOT_SCHUB_ZND_ANS_Y "Gewichtungsfaktor K0-Moment im Schub in ZND" CURVE 0x269B88 FLOAT32_IEEE_COL_DIRECT_M_S7_S3 0 void_fl_M_S7_S3 0 5
 /begin AXIS_DESCR COM_AXIS NO_INPUT_QUANTITY void_int_q_M_S7_S3 10 -1 8 AXIS_PTS_REF KL_FMK0CGETRMMOT_SCHUB_ZND_ANS_X /end AXIS_DESCR
/end CHARACTERISTIC
/begin CHARACTERISTIC KL_FMK0CGETRMMOT_ZND_ANS_Y "Y-Achse: Gewichtungsfaktor K0-Moment in ZND" CURVE 0x269BD8 FLOAT32_IEEE_COL_DIRECT_M_S7_S3 0 void_fl_M_S7_S3 0 5
 /begin AXIS_DESCR COM_AXIS NO_INPUT_QUANTITY void_fl_M_S7_S3 10 -3.40282346639E+038 3.40282346639E+038 AXIS_PTS_REF KL_FMK0CGETRMMOT_ZND_ANS_X /end AXIS_DESCR
/end CHARACTERISTIC
/begin CHARACTERISTIC KL_FMK0MMOTNVM_SCHUB_ZND_ANS_Y "Gewichtungsfaktor K0-Moment in Phase 3 im Schub" CURVE 0x269D68 FLOAT32_IEEE_COL_DIRECT_M_S7_S3 0 void_fl_M_S7_S3 0 5
 /begin AXIS_DESCR COM_AXIS NO_INPUT_QUANTITY void_fl_M_S7_S3 10 -1 8 AXIS_PTS_REF KL_FMK0MMOTNVM_SCHUB_ZND_ANS_X /end AXIS_DESCR
/end CHARACTERISTIC
/begin CHARACTERISTIC KL_FMK0MMOTNVM_ZND_ANS_Y "Gewichtungsfaktor K0-Moment in Phase 3" CURVE 0x269DB8 FLOAT32_IEEE_COL_DIRECT_M_S7_S3 0 void_fl_M_S7_S3 0 5
 /begin AXIS_DESCR COM_AXIS NO_INPUT_QUANTITY void_fl_M_S7_S3 10 -1 8 AXIS_PTS_REF KL_FMK0MMOTNVM_ZND_ANS_X /end AXIS_DESCR
/end CHARACTERISTIC
/begin CHARACTERISTIC KL_FMSTOERNDZABLVAR_ANS_Y "Faktor auf das KF_FMSTOERND_VMS_ANS in Abhaengigkeit der Ablaufvariante" CURVE 0x269E00 FLOAT32_IEEE_COL_DIRECT_M_S7_S3 0 void_fl_M_S7_S3 0 8
 /begin AXIS_DESCR COM_AXIS NO_INPUT_QUANTITY void_fl_M_S7_S3 8 0 15 AXIS_PTS_REF KL_FMSTOERNDZABLVAR_ANS_X /end AXIS_DESCR
/end CHARACTERISTIC
/begin CHARACTERISTIC KL_IAEENTK_ISTGANG_ANS_Y "Teil der Bestimmung z_iae_entkoppelt" CURVE 0x26E200 UBYTE_COL_DIRECT_M_S7_S3 0 void_int_M_S7_S3 0 1
 /begin AXIS_DESCR COM_AXIS istgang_egs_in void_int_M_S7_S3 10 -1 8 AXIS_PTS_REF KL_IAEENTK_ISTGANG_ANS_X /end AXIS_DESCR
/end CHARACTERISTIC
/begin CHARACTERISTIC KL_KSVH_RESET_KON_ANS_Y "Bedingtes Ruecksetzen einer Schaltverhinderung waehrend VM-Schleppstart im Zustand Schaltung aktiv (255=alle Arten von Schaltungen zuruecksetzen, 0= keine Schltg. zuruecksetzen) -> Bit Codierung siehe Handbuch" CURVE 0x26E214 UBYTE_COL_DIRECT_M_S7_S3 0 void_int_M_S7_S3 0 255
 /begin AXIS_DESCR COM_AXIS NO_INPUT_QUANTITY void_int_M_S7_S3 10 -1 8 AXIS_PTS_REF KL_KSVH_RESET_KON_ANS_X /end AXIS_DESCR
/end CHARACTERISTIC
/begin CHARACTERISTIC KL_KSVH_RESET_NSRS_SAK_ANS_Y "Bedingtes Ruecksetzen einer Schaltverhinderung waehrend VM-Schleppstart im Zustand SAK, ausser SRS (255=alle Arten von Schaltungen zuruecksetzen, 0= keine Schltg. zuruecksetzen) Bit Codierung siehe Handbuch" CURVE 0x26E228 UBYTE_COL_DIRECT_M_S7_S3 0 void_int_M_S7_S3 0 255
 /begin AXIS_DESCR COM_AXIS NO_INPUT_QUANTITY void_int_M_S7_S3 10 -1 8 AXIS_PTS_REF KL_KSVH_RESET_NSRS_SAK_ANS_X /end AXIS_DESCR
/end CHARACTERISTIC
/begin CHARACTERISTIC KL_KSVH_RESET_SAK_ANS_Y "Bedingtes Ruecksetzen einer Schaltverhinderung waehrend VM-Schleppstart im Zustand Schaltung aktiv (255=alle Arten von Schaltungen zuruecksetzen, 0= keine Schltg. zuruecksetzen) -> Bit Codierung siehe Handbuch" CURVE 0x26E23C UBYTE_COL_DIRECT_M_S7_S3 0 void_int_M_S7_S3 0 255
 /begin AXIS_DESCR COM_AXIS NO_INPUT_QUANTITY void_int_M_S7_S3 10 -1 8 AXIS_PTS_REF KL_KSVH_RESET_SAK_ANS_X /end AXIS_DESCR
/end CHARACTERISTIC
/begin CHARACTERISTIC KL_KSVH_RESET_SLTMODE_SAK_ANS_Y "Bedingtes Ruecksetzen einer Schaltverhinderung waehrend VM-Schleppstart im Zustand SAK, fuer SRS (255=alle Arten von Schaltugen zuruecksetzen, 0= keine Schltg. zuruecksetzen) Bit Codierung siehe Handbuch" CURVE 0x26E264 UBYTE_COL_DIRECT_M_S7_S3 0 void_int_M_S7_S3 0 255
 /begin AXIS_DESCR COM_AXIS NO_INPUT_QUANTITY void_int_M_S7_S3 10 -1 8 AXIS_PTS_REF KL_KSVH_RESET_SLTMODE_SAK_ANS_X /end AXIS_DESCR
/end CHARACTERISTIC
/begin CHARACTERISTIC KL_KSVH_RESET_SRS_SAK_ANS_Y "Bedingtes Ruecksetzen einer Schaltverhinderung waehrend VM-Schleppstart im Zustand Start (255=alle Arten von Schaltugne zuruecksetzen, 0= keine Schltg. zuruecksetzen) -> Bit Codierung siehe Handbuch" CURVE 0x26E278 UBYTE_COL_DIRECT_M_S7_S3 0 void_int_M_S7_S3 0 255
 /begin AXIS_DESCR COM_AXIS NO_INPUT_QUANTITY void_int_M_S7_S3 10 -1 8 AXIS_PTS_REF KL_KSVH_RESET_SRS_SAK_ANS_X /end AXIS_DESCR
/end CHARACTERISTIC
/begin CHARACTERISTIC KL_KSVH_RESET_ZND_ANS_Y "Bedingtes Ruecksetzen einer Schaltverhinderung waehrend VM-Schleppstart im Zustand Anschleppen (255=alle Arten von Schaltugne zuruecksetzen, 0= keine Schltg. zuruecksetzen) -> Bit Codierung siehe Handbuch" CURVE 0x26E2C8 UBYTE_COL_DIRECT_M_S7_S3 0 void_int_M_S7_S3 0 255
 /begin AXIS_DESCR COM_AXIS NO_INPUT_QUANTITY void_int_M_S7_S3 10 -1 8 AXIS_PTS_REF KL_KSVH_RESET_ZND_ANS_X /end AXIS_DESCR
/end CHARACTERISTIC
/begin CHARACTERISTIC KL_KSVHRESET_SCL_ZUS_Y "Ruecksetzen einer Schaltverhinderung in Abhaengigkeit des Istgangs im Zustand K0-Schliessen beim Zustart (255 = alle Arten von Schaltungen zuruecksetzen, 0 = keine Schaltung zuruecksetzen) -> Bit-Codierung siehe Handbuch" CURVE 0x26D004 UBYTE_COL_DIRECT_M_S7_S3 0 b_int_b_M_S7_S3 0 255
 /begin AXIS_DESCR COM_AXIS istgang_egs_in void_int_M_S7_S3 8 -1 8 AXIS_PTS_REF KL_KSVHRESET_SCL_ZUS_X /end AXIS_DESCR
/end CHARACTERISTIC
/begin CHARACTERISTIC KL_MGK0MODHASMAX_SCL_ZUS_Y "Maximaler Gradienten des modifizierten K0-Moments der HAS in Anhaengigkeit des VM-Zielmoments im Zustand K0-Schliessen beim Zustart" CURVE 0x26C7DC FLOAT32_IEEE_COL_DIRECT_M_S7_S3 0 trqg_fl_k_M_S7_S3 0 50000
 /begin AXIS_DESCR COM_AXIS m_ziel_vm_has_zus trq_fl_a_M_S7_S3 6 -3.40282E+038 3.40282E+038 AXIS_PTS_REF KL_MGK0MODHASMAX_SCL_ZUS_X /end AXIS_DESCR
/end CHARACTERISTIC
/begin CHARACTERISTIC KL_MGSOLLK0_SCHUB_ZND_ANS_Y "K0-Sollgradient in der Phase VM zuenden" CURVE 0x26A214 FLOAT32_IEEE_COL_DIRECT_M_S7_S3 0 trqg_fl_k_M_S7_S3 -10000 10000
 /begin AXIS_DESCR COM_AXIS NO_INPUT_QUANTITY trq_fl_a_M_S7_S3 5 -1000 1000 AXIS_PTS_REF KL_MGSOLLK0_SCHUB_ZND_ANS_X /end AXIS_DESCR
/end CHARACTERISTIC
/begin CHARACTERISTIC KL_MGSOLLK0_ZND_ANS_Y "K0-Sollgradient in der Phase VM zuenden" CURVE 0x26A264 FLOAT32_IEEE_COL_DIRECT_M_S7_S3 0 trqg_fl_k_M_S7_S3 -10000 10000
 /begin AXIS_DESCR COM_AXIS NO_INPUT_QUANTITY trq_fl_a_M_S7_S3 5 -1000 1000 AXIS_PTS_REF KL_MGSOLLK0_ZND_ANS_X /end AXIS_DESCR
/end CHARACTERISTIC
/begin CHARACTERISTIC KL_MGSOLLK0HASMAX_SCL_ZUS_Y "Maximaler Gradienten des K0-Sollmoments der HAS in Anhaengigkeit des VM-Zielmoments im Zustand K0-Schliessen beim Zustart" CURVE 0x26C83C FLOAT32_IEEE_COL_DIRECT_M_S7_S3 0 trqg_fl_k_M_S7_S3 0 50000
 /begin AXIS_DESCR COM_AXIS m_ziel_vm_has_zus trq_fl_a_M_S7_S3 6 -3.40282E+038 3.40282E+038 AXIS_PTS_REF KL_MGSOLLK0HASMAX_SCL_ZUS_X /end AXIS_DESCR
/end CHARACTERISTIC
/begin CHARACTERISTIC KL_MK0MVMSTART_ZND_ANS_Y "Anteil des K0-Zielmoments beim VM Zuenden in Abhaengigkeit des VM Startmoments beim VM Anschleppen" CURVE 0x26A358 FLOAT32_IEEE_COL_DIRECT_M_S7_S3 0 trq_fl_a_M_S7_S3 -1000 1000
 /begin AXIS_DESCR COM_AXIS NO_INPUT_QUANTITY trq_fl_a_M_S7_S3 8 -1000 1000 AXIS_PTS_REF KL_MK0MVMSTART_ZND_ANS_X /end AXIS_DESCR
/end CHARACTERISTIC
/begin CHARACTERISTIC KL_MSK0STATUSK0BEFUELLUNG_ANS_Y "K0-Momentenschwelle fuer das Integral (Nms) aus dem m_k0_in im Anschleppen" CURVE 0x26A384 FLOAT32_IEEE_COL_DIRECT_M_S7_S3 0 trq_fl_a_M_S7_S3 -1000 1000
 /begin AXIS_DESCR COM_AXIS NO_INPUT_QUANTITY sts_fl_M_S7_S3 3 0 2 AXIS_PTS_REF KL_MSK0STATUSK0BEFUELLUNG_ANS_X /end AXIS_DESCR
/end CHARACTERISTIC
/begin CHARACTERISTIC KL_NDIAEEMMAXIAE_ZND_ANS_Y "Momentoffset auf m_max_iae_has =  f(nd_iae-nd_soll_iae_stat)" CURVE 0x26A670 FLOAT32_IEEE_COL_DIRECT_M_S7_S3 0 trq_fl_a_M_S7_S3 -1000 1000
 /begin AXIS_DESCR COM_AXIS NO_INPUT_QUANTITY n_fl_M_S7_S3 8 -10000 10000 AXIS_PTS_REF KL_NDIAEEMMAXIAE_ZND_ANS_X /end AXIS_DESCR
/end CHARACTERISTIC
/begin CHARACTERISTIC KL_TMAXIAEOEFCGETR_ANS_Y "Max-Timer in SLST-Input fuer IAE oeffnen" CURVE 0x26A8A8 FLOAT32_IEEE_COL_DIRECT_M_S7_S3 0 t_fl_M_S7_S3 0 5
 /begin AXIS_DESCR COM_AXIS c_getriebe_egs_in c_fl_M_S7_S3 8 -50 200 AXIS_PTS_REF KL_TMAXIAEOEFCGETR_ANS_X /end AXIS_DESCR
/end CHARACTERISTIC
/begin CHARACTERISTIC KL_TMINABLVAR_ZND_ANS_Y "Mintimer im Zustand Zuenden = f(z_ablaufvariante_has_ans)" CURVE 0x26A8C8 UWORD_COL_DIRECT_M_S7_S3 0 t_int_n_M_S7_S3 0 10
 /begin AXIS_DESCR COM_AXIS NO_INPUT_QUANTITY void_int_M_S7_S3 8 0 15 AXIS_PTS_REF KL_TMINABLVAR_ZND_ANS_X /end AXIS_DESCR
/end CHARACTERISTIC
/begin CHARACTERISTIC KL_UMSCHZMMAXIAE_STKRAFT_ANS_Y "Umschaltung fuer Bestimmung z_m_may_iae_has in Abh. vom Kraftfluss" CURVE 0x26F107 UBYTE_COL_DIRECT_M_S7_S3 0 sts_int_M_S7_S3 0 1
 /begin AXIS_DESCR COM_AXIS status_kraftfluss_egs_in sts_int_M_S7_S3 7 0 6 AXIS_PTS_REF KL_UMSCHZMMAXIAE_STKRAFT_ANS_X /end AXIS_DESCR
/end CHARACTERISTIC
/begin CHARACTERISTIC KL_ZK0ENTKAKTIVABLVAR_ANS_Y "Y-Achse: z_k0entkaktiv_ans" CURVE 0x26E2D8 UBYTE_COL_DIRECT_M_S7_S3 0 void_int_M_S7_S3 0 1
 /begin AXIS_DESCR COM_AXIS NO_INPUT_QUANTITY void_int_M_S7_S3 6 0 15 AXIS_PTS_REF KL_ZK0ENTKAKTIVABLVAR_ANS_X /end AXIS_DESCR
/end CHARACTERISTIC
/begin CHARACTERISTIC KL_ZNSOLLEM_ISTGANG_ANS_Y "Teil der Bestimmung z_n_soll_em_aktiv" CURVE 0x26E2E8 UBYTE_COL_DIRECT_M_S7_S3 0 void_int_M_S7_S3 0 1
 /begin AXIS_DESCR COM_AXIS istgang_egs_in void_int_M_S7_S3 10 -1 8 AXIS_PTS_REF KL_ZNSOLLEM_ISTGANG_ANS_X /end AXIS_DESCR
/end CHARACTERISTIC
/begin CHARACTERISTIC KL_ZNSOLLVMAKTIVABLVAR_ANS_Y "Y-Achse: z_nsollvmaktiv_ans" CURVE 0x26E2F8 UBYTE_COL_DIRECT_M_S7_S3 0 void_int_M_S7_S3 0 1
 /begin AXIS_DESCR COM_AXIS NO_INPUT_QUANTITY void_int_M_S7_S3 6 0 15 AXIS_PTS_REF KL_ZNSOLLVMAKTIVABLVAR_ANS_X /end AXIS_DESCR
/end CHARACTERISTIC
/begin CHARACTERISTIC M_ZIELMAXEM_SST_ANS "Zielmoment des Maximalmoments des EM-Drehzahlreglers" VALUE 0x26AB4C FLOAT32_IEEE_COL_DIRECT_M_S7_S3 0 trq_fl_a_M_S7_S3 0 1000 /end CHARACTERISTIC
/begin CHARACTERISTIC M_ZIELMINEM_SST_ANS "Zielmoment des Minimalmoments des EM-Drehzahlreglers" VALUE 0x26AB50 FLOAT32_IEEE_COL_DIRECT_M_S7_S3 0 trq_fl_a_M_S7_S3 -1000 0 /end CHARACTERISTIC
/begin CHARACTERISTIC MG_K0MODHASMAXABBR_SCL_ZUS "Maximaler Gradienten des modifizierten K0-Moments der HAS bei einem direkten uebergang STR nach SCL im Zustand K0-Schliessen beim Zustart" VALUE 0x26D078 FLOAT32_IEEE_COL_DIRECT_M_S7_S3 0 trqg_fl_k_M_S7_S3 0 50000 /end CHARACTERISTIC
/begin CHARACTERISTIC MG_K0MODHASMAXFUWKALT_SCL_ZUS "Maximaler Gradienten des modifizierten K0-Moments der HAS bei aktiver FUW oder bei Kaltstart mit abgesenkter EM-Drehzahl im Zustand K0-Schliessen beim Zustart" VALUE 0x26D07C FLOAT32_IEEE_COL_DIRECT_M_S7_S3 0 trqg_fl_k_M_S7_S3 0 50000 /end CHARACTERISTIC
/begin CHARACTERISTIC MG_K0MODHASMAXK0SREG_SCL_ZUS "Maximaler Gradienten des modifizierten K0-Moments der HAS bei aktiver K0 Schlupfregelung im Zustand K0-Schliessen beim Zustart" VALUE 0x26D080 FLOAT32_IEEE_COL_DIRECT_M_S7_S3 0 trqg_fl_k_M_S7_S3 0 50000 /end CHARACTERISTIC
/begin CHARACTERISTIC MG_MOMAXIAE1_ZND_ANS "Drehmomentgradient 1 zur Beeinflussung des IAE-Begrenzungsmoment" VALUE 0x26AAD4 FLOAT32_IEEE_COL_DIRECT_M_S7_S3 0 trqg_fl_k_M_S7_S3 -10000 10000 /end CHARACTERISTIC
/begin CHARACTERISTIC MG_MOMAXIAE2_ZND_ANS "Drehmomentgradient 2 zur Beeinflussung des IAE-Begrenzungsmoment" VALUE 0x26AAE4 FLOAT32_IEEE_COL_DIRECT_M_S7_S3 0 trqg_fl_k_M_S7_S3 -10000 10000 /end CHARACTERISTIC
/begin CHARACTERISTIC MG_SOLLK0_ABB_ANS "Momentgradient fuer m_soll_k0_has" VALUE 0x26AAE8 FLOAT32_IEEE_COL_DIRECT_M_S7_S3 0 trqg_fl_k_M_S7_S3 0 10000 /end CHARACTERISTIC
/begin CHARACTERISTIC MG_SOLLK0HASMAXABBR_SCL_ZUS "Maximaler Gradienten des K0-Sollmoments der HAS bei einem direkten uebergang STR nach SCL im Zustand K0-Schliessen beim Zustart" VALUE 0x26D090 FLOAT32_IEEE_COL_DIRECT_M_S7_S3 0 trqg_fl_k_M_S7_S3 0 50000 /end CHARACTERISTIC
/begin CHARACTERISTIC MG_SOLLK0HASMAXFUWKALT_SCL_ZUS "Maximaler Gradienten des K0-Sollmoments der HAS bei aktiver FUW oder bei Kaltstart mit abgesenkter EM-Drehzahl im Zustand K0-Schliessen beim Zustart" VALUE 0x26D094 FLOAT32_IEEE_COL_DIRECT_M_S7_S3 0 trqg_fl_k_M_S7_S3 0 50000 /end CHARACTERISTIC
/begin CHARACTERISTIC MGS_WUNSCHFPW_ZND_ANS "Gradientenschwelle zur Initialisierung der VM Solldrehzahl im Zustand Zuenden beim Schleppstart" VALUE 0x26AAC0 FLOAT32_IEEE_COL_DIRECT_M_S7_S3 0 trqg_fl_k_M_S7_S3 -25000 25000 /end CHARACTERISTIC
/begin CHARACTERISTIC MO_MEM_KON_ANS "Drehmoment-Offset auf das max. dynamische EM-Moment im Zustand KON -> SYN" VALUE 0x26AAF8 FLOAT32_IEEE_COL_DIRECT_M_S7_S3 0 trq_fl_a_M_S7_S3 0 1000 /end CHARACTERISTIC
/begin CHARACTERISTIC MO_SOLLVMHSTMSOLLK0_SCL_ZUS "Offset auf das VM-Sollmoment der HST zum Vergleich mit dem K0-Sollmoment der HAS als Aktivierungsbedingung der Ansteuerung K0 Schliessen im Zustand K0 Schliessen beim Zustart" VALUE 0x26D0E0 FLOAT32_IEEE_COL_DIRECT_M_S7_S3 0 trq_fl_a_M_S7_S3 -1000 1000 /end CHARACTERISTIC
/begin CHARACTERISTIC MO_SOLLVMLHSTMSOLLK0_SCL_ZUS "Offset auf das VM-Luftpfadsollmoment der HST zum Vergleich mit dem K0-Sollmoment der HAS als Aktivierungsbedingung der Ansteuerung K0 Schliessen im Zustand K0 Schliessen beim Zustart" VALUE 0x26D0E8 FLOAT32_IEEE_COL_DIRECT_M_S7_S3 0 trq_fl_a_M_S7_S3 -1000 1000 /end CHARACTERISTIC
/begin CHARACTERISTIC MS_MMAXIAEINAKTIV_ANS "Maxmoment der IAE" VALUE 0x26AB10 FLOAT32_IEEE_COL_DIRECT_M_S7_S3 0 trq_fl_a_M_S7_S3 -1000 1000 /end CHARACTERISTIC
/begin CHARACTERISTIC MS_MVM_SAK_ANS "Momentschwelle des Verbrenners fuer Aktivierung CoM in SAK" VALUE 0x26AB18 FLOAT32_IEEE_COL_DIRECT_M_S7_S3 0 trq_fl_a_M_S7_S3 -100 1000 /end CHARACTERISTIC
/begin CHARACTERISTIC MS_MWUNSCHIAEANFAHRENTK_ANS "Momentschwelle fuer die Bestimmung der K0 Befuellung im Falle IAE Anfahren" VALUE 0x26AB1C FLOAT32_IEEE_COL_DIRECT_M_S7_S3 0 trq_fl_a_M_S7_S3 -100 1000 /end CHARACTERISTIC
/begin CHARACTERISTIC MS_RESEM_SAK_ANS "Minmalwert fuer m_soll_res_em im Zustand SAK" VALUE 0x26AB24 FLOAT32_IEEE_COL_DIRECT_M_S7_S3 0 trq_fl_a_M_S7_S3 0 200 /end CHARACTERISTIC
/begin CHARACTERISTIC MS_RESEM_SRT_ANS "Minmalwert fuer m_soll_res_em im Zustand SRT" VALUE 0x26AB28 FLOAT32_IEEE_COL_DIRECT_M_S7_S3 0 trq_fl_a_M_S7_S3 0 200 /end CHARACTERISTIC
/begin CHARACTERISTIC MS_RESEM_ZND_ANS "Minmalwert fuer m_soll_res_em im Zustand ZND" VALUE 0x26AB30 FLOAT32_IEEE_COL_DIRECT_M_S7_S3 0 trq_fl_a_M_S7_S3 0 200 /end CHARACTERISTIC
/begin CHARACTERISTIC MS_ZIELK0HSTMZIELVM_ANS "Momentenschwelle des K0-Zielmoments der HST zur Verwendung des K0-Zielmoments als VM-Zielmoment beim Schleppstart" VALUE 0x26AB3C FLOAT32_IEEE_COL_DIRECT_M_S7_S3 0 trq_fl_a_M_S7_S3 -1000 1000 /end CHARACTERISTIC
/begin CHARACTERISTIC MS_ZIELPHYSK0_SST_ANS "Schwellwert fuer Aktivierung Hysteresekompensation" VALUE 0x26AB40 FLOAT32_IEEE_COL_DIRECT_M_S7_S3 0 trq_fl_a_M_S7_S3 -1000 1000 /end CHARACTERISTIC
/begin CHARACTERISTIC MS_ZMSOLLEMAKTIV_KON_ANS "Momentenschwelle fuer die Aktivierung z_m_soll_em_has (Eingangsgroesse m_soll_em_has) Im Zustand KON -> SCL" VALUE 0x26AB48 FLOAT32_IEEE_COL_DIRECT_M_S7_S3 0 trq_fl_a_M_S7_S3 0 1000 /end CHARACTERISTIC
/begin CHARACTERISTIC N_MINEMNSOLLVM_KON_ANS "Minimale EM-Drehzahl als Basis fuer die Bestimmung der VM-Solldrehzahl ab dem Zustand Konditionieren und in dem Zustand Schaltung aktiv beim Schleppstart" VALUE 0x26AC2C FLOAT32_IEEE_COL_DIRECT_M_S7_S3 0 n_fl_M_S7_S3 0 2000 /end CHARACTERISTIC
/begin CHARACTERISTIC ND_IAEANFAHRENTK_ANS "Differenzdrehzahlschwelle ab der im Konditionieren (IAE Anfahren) ein anderes K0 Moment vorgegeben wird" VALUE 0x26AB90 FLOAT32_IEEE_COL_DIRECT_M_S7_S3 0 n_fl_M_S7_S3 0 10000 /end CHARACTERISTIC
/begin CHARACTERISTIC NDG_K0_SAK_ANS "Differenzdrehzahlgradientschwelle der K0 fuer Erkennung CoM in SAK" VALUE 0x26AB5C FLOAT32_IEEE_COL_DIRECT_M_S7_S3 0 ng_fl_M_S7_S3 -3.40282E+038 3.40282E+038 /end CHARACTERISTIC
/begin CHARACTERISTIC NDS_IAE_PLAUS_ANS "Drehzahldifferenzschwelle fuer Aktivierung nd_iae Plausi" VALUE 0x26AB64 FLOAT32_IEEE_COL_DIRECT_M_S7_S3 0 n_fl_M_S7_S3 -10000 10000 /end CHARACTERISTIC
/begin CHARACTERISTIC NDS_K0_SAK_ANS "Differenzdrehzahlschwelle der K0 fuer Erkennung CoM in SAK" VALUE 0x26AB74 FLOAT32_IEEE_COL_DIRECT_M_S7_S3 0 n_fl_M_S7_S3 -10000 10000 /end CHARACTERISTIC
/begin CHARACTERISTIC NDS_K0GESCHL_SCL_ZUS "Differenzdrehzahlschwelle Kupplung K0 zur ueberpruefung K0-Geschlossen als Aktivierungsbedingung der Ansteuerung K0 Schliessen im Zustand K0 Schliessen beim Zustart" VALUE 0x26D134 FLOAT32_IEEE_COL_DIRECT_M_S7_S3 0 n_fl_M_S7_S3 -10000 10000 /end CHARACTERISTIC
/begin CHARACTERISTIC NDS_SOLLIAE_PLAUS_ANS "Drehzahldifferenzschwelle fuer Aktivierung nd_soll_iae Plausi" VALUE 0x26AB7C FLOAT32_IEEE_COL_DIRECT_M_S7_S3 0 n_fl_M_S7_S3 -10000 10000 /end CHARACTERISTIC
/begin CHARACTERISTIC NO_EMNSOLLVMRESPPARALRS_KON_ANS "Negativer Offset bei paralleem Schleppstart mit Rueckschaltung " VALUE 0x26ABBC FLOAT32_IEEE_COL_DIRECT_M_S7_S3 0 n_fl_M_S7_S3 -1000 0 /end CHARACTERISTIC
/begin CHARACTERISTIC NO_NEMZMMAXIAEABLVAR_KON_ANS "Drehzahloffset auf n_soll_ll_vm_in zur Bestimmung flag_vm_restart" VALUE 0x26ABC4 FLOAT32_IEEE_COL_DIRECT_M_S7_S3 0 n_fl_M_S7_S3 -10000 10000 /end CHARACTERISTIC
/begin CHARACTERISTIC NS_BEFUELLOPTNEM_KON_ANS "Drehzahlschwelle fuer die Anforderung opt. K0- Befuellung" VALUE 0x26ABE0 FLOAT32_IEEE_COL_DIRECT_M_S7_S3 0 n_fl_M_S7_S3 -10000 10000 /end CHARACTERISTIC
/begin CHARACTERISTIC NS_EMIAEANFAHRENTK_ANS "Drehzahlschwelle ab der im Konditionieren (IAE Anfahren) ein anderes K0 Moment vorgegeben wird" VALUE 0x26ABE4 FLOAT32_IEEE_COL_DIRECT_M_S7_S3 0 n_fl_M_S7_S3 -10000 10000 /end CHARACTERISTIC
/begin CHARACTERISTIC NS_NEMSTATUSWECHSELIAE_ANS "Drehzahlschwelle ab der Entkopplung der IAE moeglich ist" VALUE 0x26AC00 FLOAT32_IEEE_COL_DIRECT_M_S7_S3 0 n_fl_M_S7_S3 -10000 10000 /end CHARACTERISTIC
/begin CHARACTERISTIC NS_NVM_SAK_ANS "Drehzahlschwelle n_vm fuer Erkennung CoM in SAK" VALUE 0x26AC10 FLOAT32_IEEE_COL_DIRECT_M_S7_S3 0 n_fl_M_S7_S3 -10000 10000 /end CHARACTERISTIC
/begin CHARACTERISTIC NS_NVMZMMAXIAEABLVAR_KON_ANS "Drehzahlschwelle zur Erkennung VM-Wiederstart (CoM)" VALUE 0x26AC0C FLOAT32_IEEE_COL_DIRECT_M_S7_S3 0 n_fl_M_S7_S3 -10000 10000 /end CHARACTERISTIC
/begin CHARACTERISTIC NS_VMANDREHK0_ERK_KON_ANS "Drehzahlschwelle n_vm fuer das Erkennen VM laeuft, fuer Umschaltung m_ziel in KON" VALUE 0x26AC14 FLOAT32_IEEE_COL_DIRECT_M_S7_S3 0 n_fl_M_S7_S3 -10000 10000 /end CHARACTERISTIC
/begin CHARACTERISTIC NS_VMAUS_ERK_KON_ANS "Drehzahlschwelle n_vm beim Eintritt in KON zur Aktivierung m_ziel_k0 beim VM andrehen" VALUE 0x26AC18 FLOAT32_IEEE_COL_DIRECT_M_S7_S3 0 n_fl_M_S7_S3 -10000 10000 /end CHARACTERISTIC
/begin CHARACTERISTIC NS_VMAUSERK_AST_VMA "VM-Drehzahlschwelle zur Erkennung VM aus im Zustand VM-Abstellen der Hybridfunktion VM aus" VALUE 0x26AC70 FLOAT32_IEEE_COL_DIRECT_M_S7_S3 0 n_fl_M_S7_S3 0 10000 /end CHARACTERISTIC
/begin CHARACTERISTIC NS_VMEINERK_ZST_VME "VM-Drehzahlschwelle zur Erkennung VM laeuft im Zustand Zustarten der Hybridfunkti-on VM ein" VALUE 0x26AC78 FLOAT32_IEEE_COL_DIRECT_M_S7_S3 0 n_fl_M_S7_S3 0 10000 /end CHARACTERISTIC
/begin CHARACTERISTIC STATUS_ABL_ABBRFKT_SRT_ZUS "Projektspezifische Statusrueckmeldung an HST beim Aufruf als Abbruchfunktion im Zustand Start beim Zustart" VALUE 0x26F1B9 UBYTE_COL_DIRECT_M_S7_S3 0 sts_int_M_S7_S3 0 255 /end CHARACTERISTIC
/begin CHARACTERISTIC STATUS_ABL_AST_VMA "Projektspezifische Statusrueckmeldung an HST im Zustand VM-Abstellen der Hybridfunktion VM aus" VALUE 0x26F18C UBYTE_COL_DIRECT_M_S7_S3 0 sts_int_M_S7_S3 0 255 /end CHARACTERISTIC
/begin CHARACTERISTIC STATUS_ABL_SAK_ANS "Projektspezifische Vorgabe des Zahlenwerts fuer den Ablaufstatus status_ablauf_has in den einzelnen Zustaenden eines Hybridablaufs" VALUE 0x26F131 UBYTE_COL_DIRECT_M_S7_S3 0 void_int_M_S7_S3 0 15 /end CHARACTERISTIC
/begin CHARACTERISTIC STATUS_ABL_SAK_ZUS "Projektspezifische Statusrueckmeldung an HST im Zustand Schaltung aktiv beim Zustart" VALUE 0x26F1BC UBYTE_COL_DIRECT_M_S7_S3 0 sts_int_M_S7_S3 0 255 /end CHARACTERISTIC
/begin CHARACTERISTIC STATUS_ABL_SRT_ANS "Projektspezifische Vorgabe des Zahlenwerts fuer den Ablaufstatus status_ablauf_has in dem Zustand St_Start" VALUE 0x26F133 UBYTE_COL_DIRECT_M_S7_S3 0 void_int_M_S7_S3 0 15 /end CHARACTERISTIC
/begin CHARACTERISTIC STATUS_ABL_SYN_ZUS "Projektspezifische Statusrueckmeldung an HST im Zustand K0-Synchronisieren beim Zustart" VALUE 0x26F1BE UBYTE_COL_DIRECT_M_S7_S3 0 sts_int_M_S7_S3 0 255 /end CHARACTERISTIC
/begin CHARACTERISTIC STATUS_ABL_ZIAEENTK_HST_KON_ANS "Projektspezifische Vorgabe des Zahlenwerts fuer den Ablaufstatus status_ablauf_has in den einzelnen Zustaenden eines Hybridablaufs" VALUE 0x26F136 UBYTE_COL_DIRECT_M_S7_S3 0 void_int_M_S7_S3 0 15 /end CHARACTERISTIC
/begin CHARACTERISTIC STATUS_ABL_ZND_ANS "Projektspezifische Vorgabe des Zahlenwerts fuer den Ablaufstatus status_ablauf_has in den einzelnen Zustaenden eines Hybridablaufs" VALUE 0x26F137 UBYTE_COL_DIRECT_M_S7_S3 0 void_int_M_S7_S3 0 15 /end CHARACTERISTIC
/begin CHARACTERISTIC STATUS_ABL_ZST_VME "Projektspezifische Statusrueckmeldung an HST im Zustand Zustarten der Hybridfunkti-on VM ein" VALUE 0x26F190 UBYTE_COL_DIRECT_M_S7_S3 0 sts_int_M_S7_S3 0 255 /end CHARACTERISTIC
/begin CHARACTERISTIC STATUS_ABLVMDREHT_HST_ZND_ANS "Anzeige der Strategie fuer VM dreht" VALUE 0x26F129 UBYTE_COL_DIRECT_M_S7_S3 0 void_int_M_S7_S3 0 8 /end CHARACTERISTIC
/begin CHARACTERISTIC STATUS_ABLVMFEHLER_HST_ZND_ANS "Status Ablauf von HST VM startet fehlerhaft" VALUE 0x26F12B UBYTE_COL_DIRECT_M_S7_S3 0 void_int_M_S7_S3 0 8 /end CHARACTERISTIC
/begin CHARACTERISTIC STATUS_ABLVMLAEUFT_HST_ZND_ANS "Anzeige der Strategie fuer VM laeuft" VALUE 0x26F12D UBYTE_COL_DIRECT_M_S7_S3 0 void_int_M_S7_S3 0 8 /end CHARACTERISTIC
/begin CHARACTERISTIC STATUS_K0ZMSOLLEMAKTIV_SST_ANS "Status K0 fuer die Aktivierung z_m_soll_em_has im Zustand SST -> SYN, ABB" VALUE 0x26F13B UBYTE_COL_DIRECT_M_S7_S3 0 void_int_M_S7_S3 0 8 /end CHARACTERISTIC
/begin CHARACTERISTIC SWI_ABFZMMAXIAEHAS_ANS "Einschalten der Abfrage z_m_max_iae_has == 1 fuer Bestimmung z_iaeoeffnen_ans" VALUE 0x26F13D UBYTE_COL_DIRECT_M_S7_S3 0 swi_int_M_S7_S3 0 1 /end CHARACTERISTIC
/begin CHARACTERISTIC SWI_BEFUELLRED_AKTIV_KON_ANS "SWI zur Aktivierung der Ausgabe einer reduzierten K0-Befuellung als f(z_m_max_iae_ablvar_has_in)" VALUE 0x26F13F UBYTE_COL_DIRECT_M_S7_S3 0 swi_int_M_S7_S3 0 1 /end CHARACTERISTIC
/begin CHARACTERISTIC SWI_MK0MOD_HAS_ANS "Schalter zur Umschaltung zwischen  m_stoer_k0_em_verz_fil und m_k0_mod_has_ablauf zur Ausgabe auf m_k0_mod. 0: m_k0_mod = m_k0_mod_has_ablauf 1: m_k0_mod = m_stoer_k0_em_verz_fil
" VALUE 0x26F142 UBYTE_COL_DIRECT_M_S7_S3 0 swi_int_M_S7_S3 0 1 /end CHARACTERISTIC
/begin CHARACTERISTIC SWI_MSTOERK0EMMK0_SST_ANS "Umschaltung der Einganggroessen m_stoer_k0_em_verz_fil (SWI = 1) nach m_k0_in (SWI = 0) im Zustand SST -> SYN" VALUE 0x26F145 UBYTE_COL_DIRECT_M_S7_S3 0 swi_int_M_S7_S3 0 1 /end CHARACTERISTIC
/begin CHARACTERISTIC SWI_MZIELK0HST_ANS "Aktivierung der Verwendung des K0-Zielmoments der HST beim Schleppstart" VALUE 0x26F146 UBYTE_COL_DIRECT_M_S7_S3 0 swi_int_M_S7_S3 0 1 /end CHARACTERISTIC
/begin CHARACTERISTIC SWI_NSOLLEMENTKIAE_KON_ANS "Umschaltung auf die Einganggroessen n_soll_em_has fuer Berechnung n_soll_vm_has bei einem IAE-Entkoppelten SLST" VALUE 0x26F148 UBYTE_COL_DIRECT_M_S7_S3 0 swi_int_M_S7_S3 0 1 /end CHARACTERISTIC
/begin CHARACTERISTIC SWI_NSOLLVMENTKIAE_KON_ANS "Aktivierung der Bestimmung n_soll_vm_has bei einem IAE-Entkoppelten SLST" VALUE 0x26F149 UBYTE_COL_DIRECT_M_S7_S3 0 swi_int_M_S7_S3 0 1 /end CHARACTERISTIC
/begin CHARACTERISTIC SWI_SAF_ANS "Vorgabe SAF ein- oder ausschalten" VALUE 0x26F14E UBYTE_COL_DIRECT_M_S7_S3 0 swi_int_M_S7_S3 0 1 /end CHARACTERISTIC
/begin CHARACTERISTIC SWI_SAS_ANS "Schalter zur Akivierung der Befuellreihenfolge bei RespSchleSchalt V2" VALUE 0x26F150 UBYTE_COL_DIRECT_M_S7_S3 0 swi_int_M_S7_S3 0 1 /end CHARACTERISTIC
/begin CHARACTERISTIC SWI_ST_GANGWE_RESP_ZND_ANS "Schalter zum aktivieren der Abfrage des Gangwechsel im Uebergang nach Synchronisieren bei parallelen Schleppstart mit Schaltung" VALUE 0x26F153 UBYTE_COL_DIRECT_M_S7_S3 0 swi_int_M_S7_S3 0 1 /end CHARACTERISTIC
/begin CHARACTERISTIC SWI_STATUSIAE_PLAUS_ANS "SWI zur Aktiverung der IAE-Schlupfueberwachung 
bei status_iae_in = 4 (IAE entkoppelt)" VALUE 0x26F151 UBYTE_COL_DIRECT_M_S7_S3 0 swi_int_M_S7_S3 0 1 /end CHARACTERISTIC
/begin CHARACTERISTIC SWI_UMSCH_ZVMSTARTFEHLER_ANS "Swi zur Deaktivierung der K0 und VM Vorgaben wenn VM nicht zuendet" VALUE 0x26F15D UBYTE_COL_DIRECT_M_S7_S3 0 swi_int_M_S7_S3 0 1 /end CHARACTERISTIC
/begin CHARACTERISTIC SWI_UMSCHMSOLLK0MZIELK0_KON_ANS "Umschaltung m_soll_k0_has von Gradientenbegrenzt auf m_ziel_k0_has" VALUE 0x26F157 UBYTE_COL_DIRECT_M_S7_S3 0 swi_int_M_S7_S3 0 1 /end CHARACTERISTIC
/begin CHARACTERISTIC SWI_UMSCHNVMNDK0_KON_ANS "Umschaltung der Eingangsgroesse fuer KF_MZIELK0VMANDREH_KON_ANS = f(n_vm_in oder nd_k0_in)" VALUE 0x26F159 UBYTE_COL_DIRECT_M_S7_S3 0 swi_int_M_S7_S3 0 1 /end CHARACTERISTIC
/begin CHARACTERISTIC SWI_ZMODUSVMN_SAK_ANS "Aktivierung der VM-Solldrehzahlregelung bei Schaltung aktiv beim Schleppstart" VALUE 0x26F162 UBYTE_COL_DIRECT_M_S7_S3 0 swi_int_M_S7_S3 0 1 /end CHARACTERISTIC
/begin CHARACTERISTIC SWI_ZMSOLLEM_ABB_ANS "SWI Vorgabe Sollmoment EM im Zustand ABB" VALUE 0x26F163 UBYTE_COL_DIRECT_M_S7_S3 0 swi_int_M_S7_S3 0 1 /end CHARACTERISTIC
/begin CHARACTERISTIC SWI_ZMSOLLEM_ZND_ANS "SWI Vorgabe Sollmoment EM" VALUE 0x26F169 UBYTE_COL_DIRECT_M_S7_S3 0 swi_int_M_S7_S3 0 1 /end CHARACTERISTIC
/begin CHARACTERISTIC SWI_ZNSOLLEM_ZND_ANS "SWI Vorgabe Solldrehzahl EM" VALUE 0x26F171 UBYTE_COL_DIRECT_M_S7_S3 0 swi_int_M_S7_S3 0 1 /end CHARACTERISTIC
/begin CHARACTERISTIC SWI_ZNSOLLEMANF_SYN_ANS "Deaktivierung der Ruecknahme der EM-Solldrehzahlvorgabe bei Eintritt in den Zustand K0-Synchronisieren im Schleppstart" VALUE 0x26F16A UBYTE_COL_DIRECT_M_S7_S3 0 swi_int_M_S7_S3 0 1 /end CHARACTERISTIC
/begin CHARACTERISTIC SWI_ZPHYSK0_ABB_ANS "SWI fuer die Hysteresekompensation K0 im Zustand SLST Abbruch: 0 : Druckanteil p_hys_k0_has inaktiv 1 : Druckanteil p_hys_k0_has aktiv" VALUE 0x26F172 UBYTE_COL_DIRECT_M_S7_S3 0 swi_int_M_S7_S3 0 1 /end CHARACTERISTIC
/begin CHARACTERISTIC SWI_ZPHYSK0_SAK_ANS "SWI fuer die Hysteresekompensation K0 im Zustand Schaltung aktiv: 0 : Druckanteil p_hys_k0_has inaktiv 1 : Druckanteil p_hys_k0_has aktiv" VALUE 0x26F174 UBYTE_COL_DIRECT_M_S7_S3 0 swi_int_M_S7_S3 0 1 /end CHARACTERISTIC
/begin CHARACTERISTIC SWI_ZPHYSK0_SRT_ANS "SWI fuer die Hysteresekompensation K0 im Zustand Start: 0 : Druckanteil p_hys_k0_has inaktiv 1 : Druckanteil p_hys_k0_has aktiv" VALUE 0x26F176 UBYTE_COL_DIRECT_M_S7_S3 0 swi_int_M_S7_S3 0 1 /end CHARACTERISTIC
/begin CHARACTERISTIC SWI_ZPHYSK0_SRT_ZUS "SWI fuer die Hysteresekompensation K0 im Zustand Start beim Zustart: 0 : Druckanteil p_hys_k0_has inaktiv 1 : Druckanteil p_hys_k0_has aktiv" VALUE 0x26F1DB UBYTE_COL_DIRECT_M_S7_S3 0 swi_int_M_S7_S3 0 1 /end CHARACTERISTIC
/begin CHARACTERISTIC SWI_ZPHYSK0_UAB_ZUS "SWI fuer die Hysteresekompensation K0 im Zustand Zustarten bei Abbruch uebergabe: 0 = Druckanteil p_hys_k0_has inaktiv, 1 = Druckanteil p_hys_k0_has aktiv" VALUE 0x26F1DD UBYTE_COL_DIRECT_M_S7_S3 0 swi_int_M_S7_S3 0 1 /end CHARACTERISTIC
/begin CHARACTERISTIC SWI_ZPHYSK0_UEA_ANS "SWI fuer die Hysteresekompensation K0 im Zustand Uebergabe Abbruch: 0 : Druckanteil p_hys_k0_has inaktiv 1 : Druckanteil p_hys_k0_has aktiv" VALUE 0x26F179 UBYTE_COL_DIRECT_M_S7_S3 0 swi_int_M_S7_S3 0 1 /end CHARACTERISTIC
/begin CHARACTERISTIC SWI_ZPHYSK0_UEB_ANS "SWI fuer die Hysteresekompensation K0 im Zustand Uebergabe: 0 : Druckanteil p_hys_k0_has inaktiv 1 : Druckanteil p_hys_k0_has aktiv" VALUE 0x26F17A UBYTE_COL_DIRECT_M_S7_S3 0 swi_int_M_S7_S3 0 1 /end CHARACTERISTIC
/begin CHARACTERISTIC SWI_ZPHYSK0_UEB_ZUS "SWI fuer die Hysteresekompensation K0 im Zustand uebergabe beim Zustart: 0 : Druckanteil p_hys_k0_has inaktiv 1 : Druckanteil p_hys_k0_has aktiv " VALUE 0x26F1DE UBYTE_COL_DIRECT_M_S7_S3 0 swi_int_M_S7_S3 0 1 /end CHARACTERISTIC
/begin CHARACTERISTIC SWI_ZPHYSK0_ZND_ANS "SWI fuer die Hysteresekompensation K0 im Zustand VM zuenden: 0 : Druckanteil p_hys_k0_has inaktiv 1 : Druckanteil p_hys_k0_has aktiv" VALUE 0x26F17B UBYTE_COL_DIRECT_M_S7_S3 0 swi_int_M_S7_S3 0 1 /end CHARACTERISTIC
/begin CHARACTERISTIC T_MAX_ABB_ANS "Max. Verweilzeit in der Phase SLST Abbruch ABB" VALUE 0x26E306 UWORD_COL_DIRECT_M_S7_S3 0 t_int_n_M_S7_S3 0 10 /end CHARACTERISTIC
/begin CHARACTERISTIC T_MAX_SAK_ANS "Max. Verweilzeit in der Phase Schaltung aktiv SAK" VALUE 0x26E30A UWORD_COL_DIRECT_M_S7_S3 0 t_int_n_M_S7_S3 0 10 /end CHARACTERISTIC
/begin CHARACTERISTIC T_MAX_SCL_ZUS "Maximale Verweildauer im Zustand K0 Schliessen im Zustand Zustart" VALUE 0x26D1DC FLOAT32_IEEE_COL_DIRECT_M_S7_S3 0 t_fl_M_S7_S3 0 10 /end CHARACTERISTIC
/begin CHARACTERISTIC T_MAX_ZND_ANS "Max. Verweilzeit in der Phase VM Zuenden ZND" VALUE 0x26E312 UWORD_COL_DIRECT_M_S7_S3 0 t_int_n_M_S7_S3 0 10 /end CHARACTERISTIC
/begin CHARACTERISTIC T_MK0MODZIEL_SCL_ZUS "Dauer der Beruecksichtigung des K0-Istmoments als Zielmoment fuer das modifizierte K0-Sollmoment beim K0-Schliessen beim Zustart" VALUE 0x26D1E0 FLOAT32_IEEE_COL_DIRECT_M_S7_S3 0 t_fl_M_S7_S3 0 10 /end CHARACTERISTIC
/begin CHARACTERISTIC T_MSOLLK0ANSTMAX_SCL_ZUS "Maximale Dauer der K0-Ansteuerung HAS beim K0-Schliessen im Zustand K0 Schliessen beim Zustart" VALUE 0x26D1E8 FLOAT32_IEEE_COL_DIRECT_M_S7_S3 0 t_fl_M_S7_S3 0 10 /end CHARACTERISTIC
/begin CHARACTERISTIC T_NVMAUSERK_AST_VMA "Dauer zur Abfrage der VM-Drehzahlschwelle zur Erkennung VM aus im Zustand VM-Abstellen der Hybridfunktion VM aus" VALUE 0x26AC74 FLOAT32_IEEE_COL_DIRECT_M_S7_S3 0 t_fl_M_S7_S3 0 10 /end CHARACTERISTIC
/begin CHARACTERISTIC T_NVMEINERK_ZST_VME "Dauer zur Abfrage der VM-Drehzahlschwelle zur Erkennung VM laeuft im Zustand Zustarten der Hybridfunktion VM ein" VALUE 0x26AC7C FLOAT32_IEEE_COL_DIRECT_M_S7_S3 0 t_fl_M_S7_S3 0 10 /end CHARACTERISTIC
/begin CHARACTERISTIC T_SCHALT_MODE_MAX_SAK_ANS "Maximalzeit zur Absicherung, dass im Tipmode nur eine Schaltung im SAK ausgefuehrt wird" VALUE 0x26E31E UWORD_COL_DIRECT_M_S7_S3 0 t_int_n_M_S7_S3 0 2 /end CHARACTERISTIC
/begin CHARACTERISTIC T_STATUSIAE_PLAUS_ANS "Zeit zur Anfilterung fuer nicht erreichten 
IAE-Schlupf nd_iae bei 
status_iae_in = 4 (IAE entkoppelt)" VALUE 0x26E324 UWORD_COL_DIRECT_M_S7_S3 0 t_int_n_M_S7_S3 0 2 /end CHARACTERISTIC
/begin CHARACTERISTIC T_STATUSWECHSELIAEMAX_ANS "Max. Wartezeit, in der ein Statuswechsel der IAE von OFFNEN nach ENTKOPPELT erwartet wird." VALUE 0x26E326 UWORD_COL_DIRECT_M_S7_S3 0 t_int_n_M_S7_S3 0 5 /end CHARACTERISTIC
/begin CHARACTERISTIC TAB_MK0BEFUELLMODUS_KON_ANS "Bestimmung z_mk0_befuellmodus fuer die Umschaltung m_ziel_k0 und mg_ziel im Falle einer Befuellvariante" VAL_BLK 0x26F10E UBYTE_COL_DIRECT_M_S7_S3 0 void_int_M_S7_S3 0 4 NUMBER 5 /end CHARACTERISTIC
/begin CHARACTERISTIC TAB_ZK0BEFUELLMODUS_KON_ANS "Bestimmung z_k0_befuellmodus im Falle, wenn Befuellung geaendert werden soll" VAL_BLK 0x26F113 UBYTE_COL_DIRECT_M_S7_S3 0 void_int_M_S7_S3 0 4 NUMBER 5 /end CHARACTERISTIC
/begin CHARACTERISTIC TAB_ZK0BEFUELLMODUSSTK0BEF_KON_ANS "Aktualisierung z_k0_befuellmodus_ans ueber den status_k0_befuellung_in (Vom Befuellmodell rueckgemeldete K0-Befuellung)" VAL_BLK 0x26AA74 UBYTE_COL_DIRECT_M_S7_S3 0 void_int_M_S7_S3 0 2 NUMBER 4 /end CHARACTERISTIC
/begin CHARACTERISTIC Z_ABLAUF_ABBRUCH_ZUS "Anzeigen eines Abbruchs durch die HAS-Zustandssteuerung (OML) beim Zustart" VALUE 0x26F1E3 UBYTE_COL_DIRECT_M_S7_S3 0 void_int_M_S7_S3 0 255 /end CHARACTERISTIC
/begin CHARACTERISTIC Z_ABLAUFHASHST_VMAUSERK_VMA "Wert zur Anzeige VM aus durch die Hybridstrategie als Uebergangsbedingung nach Uebergabe im Zustand VM-Abstellen der Hybridfunktion VM aus" VALUE 0x26F18D UBYTE_COL_DIRECT_M_S7_S3 0 st_int_M_S7_S3 0 255 /end CHARACTERISTIC
/begin CHARACTERISTIC Z_ABLAUFHASHST_VMEINERK_VME "Wert zur Anzeige VM laeuft durch die Hybrid-strategie als Uebergangsbedingung nach Uebergabe im Zustand Zustarten der Hybrid-funktion VM ein" VALUE 0x26F191 UBYTE_COL_DIRECT_M_S7_S3 0 st_int_M_S7_S3 0 255 /end CHARACTERISTIC
/begin CHARACTERISTIC Z_ABLVAR_UNGUELTIG_ANS "Modifizierte Ablaufvariante, kommt eine ungueltige Ablaufvariante, dann wird der Altwert gehalten." VALUE 0x26F17C UBYTE_COL_DIRECT_M_S7_S3 0 sts_int_M_S7_S3 0 255 /end CHARACTERISTIC
/begin CHARACTERISTIC Z_MMAXIAEZMODUSIAE_ANS "Erkennung gebruecktes Anfahren (keine IAE Entkopplung)" VALUE 0x26F17D UBYTE_COL_DIRECT_M_S7_S3 0 void_int_M_S7_S3 0 1 /end CHARACTERISTIC
/begin AXIS_PTS KF_FMSTOERND_VMS_ANS_X "X-Achse: nd_k0_in" 0x2653B0 nd_k0_in FLOAT32_IEEE_X_INCR_DIRECT_M_S7_S3 0 n_fl_M_S7_S3 10 -3.40282E+038 3.40282E+038 /end AXIS_PTS
/begin AXIS_PTS KF_FMSTOERND_VMS_ANS_Y "Y-Achse: n_em_in" 0x2653D8 n_em_in FLOAT32_IEEE_X_INCR_DIRECT_M_S7_S3 0 n_fl_M_S7_S3 8 -3.40282E+038 3.40282E+038 /end AXIS_PTS
/begin AXIS_PTS KF_IAEENTK_STIAEKRAFTFL_ANS_X "X-Achse: stauts_iae_in" 0x26EE2E status_iae_in UBYTE_X_INCR_DIRECT_M_S7_S3 0 sts_int_M_S7_S3 9 0 8 /end AXIS_PTS
/begin AXIS_PTS KF_IAEENTK_STIAEKRAFTFL_ANS_Y "Y-Achse: status_kraftfluss_egs_in" 0x26EE37 status_kraftfluss_egs_in UBYTE_X_INCR_DIRECT_M_S7_S3 0 void_int_M_S7_S3 7 0 6 /end AXIS_PTS
/begin AXIS_PTS KF_MGK0BEFANFIAE_KON_ANS_X "X-Achse ng_vm_in" 0x265900 NO_INPUT_QUANTITY FLOAT32_IEEE_X_INCR_DIRECT_M_S7_S3 0 ng_fl_M_S7_S3 8 -10000 10000 /end AXIS_PTS
/begin AXIS_PTS KF_MGK0BEFANFIAE_KON_ANS_Y "Y-Achse n_vm_in" 0x265920 NO_INPUT_QUANTITY FLOAT32_IEEE_X_INCR_DIRECT_M_S7_S3 0 n_fl_M_S7_S3 8 -10000 10000 /end AXIS_PTS
/begin AXIS_PTS KF_MGK0BEFNORM_KON_ANS_X "X-Achse c_getriebe_egs_in" 0x265A40 NO_INPUT_QUANTITY FLOAT32_IEEE_X_INCR_DIRECT_M_S7_S3 0 c_fl_M_S7_S3 8 -40 150 /end AXIS_PTS
/begin AXIS_PTS KF_MGK0BEFNORM_KON_ANS_Y "Y-Achse: abstellpos_vm_on" 0x265A60 NO_INPUT_QUANTITY FLOAT32_IEEE_X_INCR_DIRECT_M_S7_S3 0 phi_fl_M_S7_S3 8 0 360 /end AXIS_PTS
/begin AXIS_PTS KF_MGK0BEFOPT_KON_ANS_X "X-Achse c_getriebe_egs_in" 0x265B80 NO_INPUT_QUANTITY FLOAT32_IEEE_X_INCR_DIRECT_M_S7_S3 0 c_fl_M_S7_S3 8 -40 150 /end AXIS_PTS
/begin AXIS_PTS KF_MGK0BEFOPT_KON_ANS_Y "Y-Achse abstellpos_vm_in" 0x265BA0 NO_INPUT_QUANTITY FLOAT32_IEEE_X_INCR_DIRECT_M_S7_S3 0 phi_fl_M_S7_S3 8 0 360 /end AXIS_PTS
/begin AXIS_PTS KF_MGK0BEFRED_KON_ANS_X "X-Achse c_getriebe_egs_in" 0x265CC0 NO_INPUT_QUANTITY FLOAT32_IEEE_X_INCR_DIRECT_M_S7_S3 0 c_fl_M_S7_S3 8 -40 150 /end AXIS_PTS
/begin AXIS_PTS KF_MGK0BEFRED_KON_ANS_Y "Y-Achse abstellpos_vm_in" 0x265CE0 NO_INPUT_QUANTITY FLOAT32_IEEE_X_INCR_DIRECT_M_S7_S3 0 phi_fl_M_S7_S3 8 0 360 /end AXIS_PTS
/begin AXIS_PTS KF_MGK0BEFRESP_SCHALT_KON_ANS_X "X-Achse c_getriebe_egs_in" 0x265E00 NO_INPUT_QUANTITY FLOAT32_IEEE_X_INCR_DIRECT_M_S7_S3 0 c_fl_M_S7_S3 8 -40 150 /end AXIS_PTS
/begin AXIS_PTS KF_MGK0BEFRESP_SCHALT_KON_ANS_Y "Y-Achse: abstellpos_vm_in" 0x265E20 NO_INPUT_QUANTITY FLOAT32_IEEE_X_INCR_DIRECT_M_S7_S3 0 phi_fl_M_S7_S3 8 0 360 /end AXIS_PTS
/begin AXIS_PTS KF_MGK0VMANDREH_KON_ANS_X "X-Achse c_getriebe_egs_in" 0x26638C NO_INPUT_QUANTITY FLOAT32_IEEE_X_INCR_DIRECT_M_S7_S3 0 c_fl_M_S7_S3 8 -40 150 /end AXIS_PTS
/begin AXIS_PTS KF_MGK0VMANDREH_KON_ANS_Y "Y-Achse abstellpos_vm_in" 0x2663AC NO_INPUT_QUANTITY FLOAT32_IEEE_X_INCR_DIRECT_M_S7_S3 0 phi_fl_M_S7_S3 8 0 360 /end AXIS_PTS
/begin AXIS_PTS KF_MGZIELMAXEM_KON_ANS_X "X-Achse: m_mot_in" 0x2668E4 NO_INPUT_QUANTITY FLOAT32_IEEE_X_INCR_DIRECT_M_S7_S3 0 trq_fl_a_M_S7_S3 8 -1000 1000 /end AXIS_PTS
/begin AXIS_PTS KF_MGZIELMAXEM_KON_ANS_Y "Y-Achse: nd_iae_ans" 0x266904 nd_iae_ans FLOAT32_IEEE_X_INCR_DIRECT_M_S7_S3 0 n_fl_M_S7_S3 7 -10000 10000 /end AXIS_PTS
/begin AXIS_PTS KF_MGZIELMINEM_KON_ANS_X "X-Achse: m_mot_in" 0x266A00 NO_INPUT_QUANTITY FLOAT32_IEEE_X_INCR_DIRECT_M_S7_S3 0 trq_fl_a_M_S7_S3 8 -1000 1000 /end AXIS_PTS
/begin AXIS_PTS KF_MGZIELMINEM_KON_ANS_Y "Y-Achse: nd_iae_ans" 0x266A20 nd_iae_ans FLOAT32_IEEE_X_INCR_DIRECT_M_S7_S3 0 n_fl_M_S7_S3 7 -10000 10000 /end AXIS_PTS
/begin AXIS_PTS KF_MK0CGETRMMOT_SCHUB_ZND_ANS_X "X-Achse: c_getriebe_egs_in" 0x266B3C NO_INPUT_QUANTITY FLOAT32_IEEE_X_INCR_DIRECT_M_S7_S3 0 c_fl_M_S7_S3 8 -40 150 /end AXIS_PTS
/begin AXIS_PTS KF_MK0CGETRMMOT_SCHUB_ZND_ANS_Y "Y-Achse: m_mot_in" 0x266B5C NO_INPUT_QUANTITY FLOAT32_IEEE_X_INCR_DIRECT_M_S7_S3 0 trq_fl_a_M_S7_S3 8 -1000 1000 /end AXIS_PTS
/begin AXIS_PTS KF_MK0CGETRMMOT_ZND_ANS_X "X-Achse: c_getriebe_egs_in" 0x266C7C NO_INPUT_QUANTITY FLOAT32_IEEE_X_INCR_DIRECT_M_S7_S3 0 c_fl_M_S7_S3 8 -40 150 /end AXIS_PTS
/begin AXIS_PTS KF_MK0CGETRMMOT_ZND_ANS_Y "Y-Achse: m_mot_in" 0x266C9C NO_INPUT_QUANTITY FLOAT32_IEEE_X_INCR_DIRECT_M_S7_S3 0 trq_fl_a_M_S7_S3 8 -1000 1000 /end AXIS_PTS
/begin AXIS_PTS KF_MK0MMOTNVM_SCHUB_ZND_ANS_X "X-Achse: ng_vm_in " 0x2672BC NO_INPUT_QUANTITY FLOAT32_IEEE_X_INCR_DIRECT_M_S7_S3 0 trq_fl_a_M_S7_S3 8 -10000 10000 /end AXIS_PTS
/begin AXIS_PTS KF_MK0MMOTNVM_SCHUB_ZND_ANS_Y "Y-Achse: nd_k0_in" 0x2672DC NO_INPUT_QUANTITY FLOAT32_IEEE_X_INCR_DIRECT_M_S7_S3 0 n_fl_M_S7_S3 8 -10000 10000 /end AXIS_PTS
/begin AXIS_PTS KF_MK0MMOTNVM_ZND_ANS_X "X-Achse: ng_vm_in" 0x2673FC NO_INPUT_QUANTITY FLOAT32_IEEE_X_INCR_DIRECT_M_S7_S3 0 trq_fl_a_M_S7_S3 8 -10000 10000 /end AXIS_PTS
/begin AXIS_PTS KF_MK0MMOTNVM_ZND_ANS_Y "Y-Achse: nd_k0_in" 0x26741C NO_INPUT_QUANTITY FLOAT32_IEEE_X_INCR_DIRECT_M_S7_S3 0 n_fl_M_S7_S3 8 -10000 10000 /end AXIS_PTS
/begin AXIS_PTS KF_MOIAEENTKERK1_ANS_X "X-Achse: m_mot_in" 0x26792C m_mot_in FLOAT32_IEEE_X_INCR_DIRECT_M_S7_S3 0 trq_fl_a_M_S7_S3 8 -1000 1000 /end AXIS_PTS
/begin AXIS_PTS KF_MOIAEENTKERK1_ANS_Y "Y-Achse: istgang_egs_in" 0x26794C NO_INPUT_QUANTITY FLOAT32_IEEE_X_INCR_DIRECT_M_S7_S3 0 void_int_q_M_S7_S3 10 -1 8 /end AXIS_PTS
/begin AXIS_PTS KF_MOIAEENTKERK2_ANS_X "X-Achse: m_mot_in" 0x267AB4 m_mot_in FLOAT32_IEEE_X_INCR_DIRECT_M_S7_S3 0 trq_fl_a_M_S7_S3 8 -1000 1000 /end AXIS_PTS
/begin AXIS_PTS KF_MOIAEENTKERK2_ANS_Y "Y-Achse: istgang_egs_in" 0x267AD4 NO_INPUT_QUANTITY FLOAT32_IEEE_X_INCR_DIRECT_M_S7_S3 0 void_int_q_M_S7_S3 10 -1 8 /end AXIS_PTS
/begin AXIS_PTS KF_MZIELK0ANFIAE_KON_ANS_X "X-Achse ng_vm_in" 0x268648 NO_INPUT_QUANTITY FLOAT32_IEEE_X_INCR_DIRECT_M_S7_S3 0 ng_fl_M_S7_S3 8 -10000 10000 /end AXIS_PTS
/begin AXIS_PTS KF_MZIELK0ANFIAE_KON_ANS_Y "Y-Achse: n_vm_in" 0x268668 NO_INPUT_QUANTITY FLOAT32_IEEE_X_INCR_DIRECT_M_S7_S3 0 n_fl_M_S7_S3 8 -10000 10000 /end AXIS_PTS
/begin AXIS_PTS KF_MZIELK0BEFMODUS_SST_ANS_X "X-Achse: c_getriebe_egs_in" 0x2686E8 NO_INPUT_QUANTITY FLOAT32_IEEE_X_INCR_DIRECT_M_S7_S3 0 c_fl_M_S7_S3 8 -3.40282E+038 3.40282E+038 /end AXIS_PTS
/begin AXIS_PTS KF_MZIELK0BEFMODUS_SST_ANS_Y "Y-Achse: z_k0_befuellopt_has" 0x268708 NO_INPUT_QUANTITY FLOAT32_IEEE_X_INCR_DIRECT_M_S7_S3 0 sts_int_r_M_S7_S3 3 0 2 /end AXIS_PTS
/begin AXIS_PTS KF_MZIELK0BEFNORM_KON_ANS_X "X-Achse c_getriebe_egs_in" 0x268814 NO_INPUT_QUANTITY FLOAT32_IEEE_X_INCR_DIRECT_M_S7_S3 0 c_fl_M_S7_S3 8 -40 150 /end AXIS_PTS
/begin AXIS_PTS KF_MZIELK0BEFNORM_KON_ANS_Y "Y-Achse: abstellpos_vm_in" 0x268834 NO_INPUT_QUANTITY FLOAT32_IEEE_X_INCR_DIRECT_M_S7_S3 0 phi_fl_M_S7_S3 8 0 360 /end AXIS_PTS
/begin AXIS_PTS KF_MZIELK0BEFOPT_KON_ANS_X "X-Achse c_getriebe_egs_in" 0x268954 NO_INPUT_QUANTITY FLOAT32_IEEE_X_INCR_DIRECT_M_S7_S3 0 c_fl_M_S7_S3 8 -40 150 /end AXIS_PTS
/begin AXIS_PTS KF_MZIELK0BEFOPT_KON_ANS_Y "Y-Achse abstellpos_vm_in" 0x268974 NO_INPUT_QUANTITY FLOAT32_IEEE_X_INCR_DIRECT_M_S7_S3 0 phi_fl_M_S7_S3 8 0 360 /end AXIS_PTS
/begin AXIS_PTS KF_MZIELK0BEFRED_KON_ANS_X "X-Achse c_getriebe_egs_in" 0x268A94 NO_INPUT_QUANTITY FLOAT32_IEEE_X_INCR_DIRECT_M_S7_S3 0 c_fl_M_S7_S3 8 -40 150 /end AXIS_PTS
/begin AXIS_PTS KF_MZIELK0BEFRED_KON_ANS_Y "Y-Achse: abstellpos_vm_on" 0x268AB4 NO_INPUT_QUANTITY FLOAT32_IEEE_X_INCR_DIRECT_M_S7_S3 0 phi_fl_M_S7_S3 8 0 360 /end AXIS_PTS
/begin AXIS_PTS KF_MZIELK0BEFRESP_SCHALT_KON_ANS_X "X-Achse c_getriebe_egs_in" 0x268BD4 NO_INPUT_QUANTITY FLOAT32_IEEE_X_INCR_DIRECT_M_S7_S3 0 c_fl_M_S7_S3 8 -40 150 /end AXIS_PTS
/begin AXIS_PTS KF_MZIELK0BEFRESP_SCHALT_KON_ANS_Y "Y-Achse: abstellpos_vm_in" 0x268BF4 NO_INPUT_QUANTITY FLOAT32_IEEE_X_INCR_DIRECT_M_S7_S3 0 phi_fl_M_S7_S3 8 0 360 /end AXIS_PTS
/begin AXIS_PTS KF_MZIELK0VMANDREH_KON_ANS_X "X-Achse ng_vm_in" 0x268D14 NO_INPUT_QUANTITY FLOAT32_IEEE_X_INCR_DIRECT_M_S7_S3 0 ng_fl_M_S7_S3 8 -3.40282E+038 3.40282E+038 /end AXIS_PTS
/begin AXIS_PTS KF_MZIELK0VMANDREH_KON_ANS_Y "Y-Achse: n_vm_in" 0x268D34 NO_INPUT_QUANTITY FLOAT32_IEEE_X_INCR_DIRECT_M_S7_S3 0 n_fl_M_S7_S3 8 -3.40282E+038 3.40282E+038 /end AXIS_PTS
/begin AXIS_PTS KF_NDEMNSOLLVM_ZND_ANS_X "X-Achse: n_em_in" 0x2690A4 NO_INPUT_QUANTITY FLOAT32_IEEE_X_INCR_DIRECT_M_S7_S3 0 n_fl_M_S7_S3 10 0 10000 /end AXIS_PTS
/begin AXIS_PTS KF_NDEMNSOLLVM_ZND_ANS_Y "Y-Achse: m_ziel_vm_has_ans" 0x2690CC NO_INPUT_QUANTITY FLOAT32_IEEE_X_INCR_DIRECT_M_S7_S3 0 trq_fl_a_M_S7_S3 7 -1000 1000 /end AXIS_PTS
/begin AXIS_PTS KF_NOEMNSOLLVM_KON_ANS_X "X-Achse: Phase SAK n_em_in; Phase KON n_em_in" 0x2695AC NO_INPUT_QUANTITY FLOAT32_IEEE_X_INCR_DIRECT_M_S7_S3 0 n_fl_M_S7_S3 10 0 10000 /end AXIS_PTS
/begin AXIS_PTS KF_NOEMNSOLLVM_KON_ANS_Y "Y-Achse: m_ziel_vm_has_ans" 0x2695D4 NO_INPUT_QUANTITY FLOAT32_IEEE_X_INCR_DIRECT_M_S7_S3 0 trq_fl_a_M_S7_S3 7 -1000 1000 /end AXIS_PTS
/begin AXIS_PTS KF_SLT_GANGWE_RESPPARAL_ZND_ANS_X "X-Achse: zielgang_egs_in" 0x26E1B2 NO_INPUT_QUANTITY SBYTE_X_INCR_DIRECT_M_S7_S3 0 void_int_M_S7_S3 10 -128 127 /end AXIS_PTS
/begin AXIS_PTS KF_SLT_GANGWE_RESPPARAL_ZND_ANS_Y "Y-Achse: istgang_egs_in" 0x26E1BC NO_INPUT_QUANTITY SBYTE_X_INCR_DIRECT_M_S7_S3 0 void_int_M_S7_S3 10 -128 127 /end AXIS_PTS
/begin AXIS_PTS KF_STATUS_IAE_PLAUS_ANS_X "X-Achse: status_iae_in" 0x26EF1B status_iae_in UBYTE_X_INCR_DIRECT_M_S7_S3 0 sts_int_M_S7_S3 9 0 255 /end AXIS_PTS
/begin AXIS_PTS KF_STATUS_IAE_PLAUS_ANS_Y "Y-Achse: status_kraftfluss_egs_in" 0x26EF24 status_kraftfluss_egs_in UBYTE_X_INCR_DIRECT_M_S7_S3 0 sts_int_M_S7_S3 7 0 255 /end AXIS_PTS
/begin AXIS_PTS KF_VMISTVMSOLL_ZND_ANS_X "X-Achse c_getriebe_egs_in" 0x269AD0 NO_INPUT_QUANTITY FLOAT32_IEEE_X_INCR_DIRECT_M_S7_S3 0 c_fl_M_S7_S3 8 -40 150 /end AXIS_PTS
/begin AXIS_PTS KF_VMISTVMSOLL_ZND_ANS_Y "Y-Achse: sollgang_egs_in" 0x269AF0 NO_INPUT_QUANTITY FLOAT32_IEEE_X_INCR_DIRECT_M_S7_S3 0 void_int_q_M_S7_S3 8 1 8 /end AXIS_PTS
/begin AXIS_PTS KF_Z_MOMAXIAE_ANS_X "X-Achse: status_iae_in" 0x26F0A6 status_iae_in UBYTE_X_INCR_DIRECT_M_S7_S3 0 sts_int_M_S7_S3 9 0 8 /end AXIS_PTS
/begin AXIS_PTS KF_Z_MOMAXIAE_ANS_Y "Y-Achse: status_kraftfluss_egs_in" 0x26F0AF status_kraftfluss_egs_in UBYTE_X_INCR_DIRECT_M_S7_S3 0 st_int_M_S7_S3 7 0 6 /end AXIS_PTS
/begin AXIS_PTS KF_ZMMAXABLVARNLLVM_ANS_X "X: istgang_egs_in" 0x26E1C6 istgang_egs_in SBYTE_X_INCR_DIRECT_M_S7_S3 0 void_int_M_S7_S3 10 -1 8 /end AXIS_PTS
/begin AXIS_PTS KF_ZMMAXABLVARNLLVM_ANS_Y "Y: z_ablaufvariante_has_ans" 0x26E1D0 NO_INPUT_QUANTITY UBYTE_X_INCR_DIRECT_M_S7_S3 0 void_int_M_S7_S3 6 0 15 /end AXIS_PTS
/begin AXIS_PTS KF_ZMMAXIAEISTGANGABLVAR_ANS_X "X: Ansteuerung IAE in Abhaengigkeit der Ablaufvariante(istgang_egs_in)" 0x26E1D6 istgang_egs_in SBYTE_X_INCR_DIRECT_M_S7_S3 0 void_int_M_S7_S3 10 -1 8 /end AXIS_PTS
/begin AXIS_PTS KF_ZMMAXIAEISTGANGABLVAR_ANS_Y "Y: Ansteuerung IAE in Abhaengigkeit der Ablaufvariante(z_ablaufvariante_has_ans)" 0x26E1E0 NO_INPUT_QUANTITY UBYTE_X_INCR_DIRECT_M_S7_S3 0 void_int_M_S7_S3 6 0 15 /end AXIS_PTS
/begin AXIS_PTS KF_ZMMAXSTSIAE_ANS_X "X-Achse: status_iae_in" 0x26F008 status_iae_in UBYTE_X_INCR_DIRECT_M_S7_S3 0 sts_int_M_S7_S3 9 0 8 /end AXIS_PTS
/begin AXIS_PTS KF_ZMMAXSTSIAE_ANS_Y "Y-Achse: status_kraftfluss_egs_in" 0x26F011 status_kraftfluss_egs_in UBYTE_X_INCR_DIRECT_M_S7_S3 0 st_int_M_S7_S3 7 0 6 /end AXIS_PTS
/begin AXIS_PTS KF_ZNSOLLEM_STIAEKRAFTFL_ANS_X "X-Achse: stauts_iae_in" 0x26F057 status_iae_in UBYTE_X_INCR_DIRECT_M_S7_S3 0 void_int_M_S7_S3 9 0 8 /end AXIS_PTS
/begin AXIS_PTS KF_ZNSOLLEM_STIAEKRAFTFL_ANS_Y "Y-Achse: status_kraftfluss_egs_in" 0x26F060 status_kraftfluss_egs_in UBYTE_X_INCR_DIRECT_M_S7_S3 0 void_int_M_S7_S3 7 0 6 /end AXIS_PTS
/begin AXIS_PTS KL_ENTKMOEGLIAESTIAEKRAFT_ANS_X "X-Achse: status_kraftfluss_egs_in" 0x26F0B6 status_kraftfluss_egs_in UBYTE_X_INCR_DIRECT_M_S7_S3 0 sts_int_M_S7_S3 7 0 6 /end AXIS_PTS
/begin AXIS_PTS KL_FMK0CGETRMMOT_SCHUB_ZND_ANS_X "X-Achse: istgang_egs_in" 0x269B60 NO_INPUT_QUANTITY FLOAT32_IEEE_X_INCR_DIRECT_M_S7_S3 0 void_int_q_M_S7_S3 10 -1 8 /end AXIS_PTS
/begin AXIS_PTS KL_FMK0CGETRMMOT_ZND_ANS_X "X-Achse: istgang_egs_in" 0x269BB0 NO_INPUT_QUANTITY FLOAT32_IEEE_X_INCR_DIRECT_M_S7_S3 0 void_fl_M_S7_S3 10 -3.40282346639E+038 3.40282346639E+038 /end AXIS_PTS
/begin AXIS_PTS KL_FMK0MMOTNVM_SCHUB_ZND_ANS_X "X-Achse: istgang_egs_in" 0x269D40 NO_INPUT_QUANTITY FLOAT32_IEEE_X_INCR_DIRECT_M_S7_S3 0 void_fl_M_S7_S3 10 -1 8 /end AXIS_PTS
/begin AXIS_PTS KL_FMK0MMOTNVM_ZND_ANS_X "X-Achse: istgang_egs_in" 0x269D90 NO_INPUT_QUANTITY FLOAT32_IEEE_X_INCR_DIRECT_M_S7_S3 0 void_fl_M_S7_S3 10 -1 8 /end AXIS_PTS
/begin AXIS_PTS KL_FMSTOERNDZABLVAR_ANS_X "X-Achse: z_ablaufvariante_has_ans" 0x269DE0 NO_INPUT_QUANTITY FLOAT32_IEEE_X_INCR_DIRECT_M_S7_S3 0 void_fl_M_S7_S3 8 0 15 /end AXIS_PTS
/begin AXIS_PTS KL_IAEENTK_ISTGANG_ANS_X "X-Achse: istgang_egs_in" 0x26E1F6 istgang_egs_in SBYTE_X_INCR_DIRECT_M_S7_S3 0 void_int_M_S7_S3 10 -1 8 /end AXIS_PTS
/begin AXIS_PTS KL_KSVH_RESET_KON_ANS_X "X-Achse: istgang_egs_in" 0x26E20A NO_INPUT_QUANTITY SBYTE_X_INCR_DIRECT_M_S7_S3 0 void_int_M_S7_S3 10 -1 8 /end AXIS_PTS
/begin AXIS_PTS KL_KSVH_RESET_NSRS_SAK_ANS_X "X-Achse: istgang_egs_in" 0x26E21E NO_INPUT_QUANTITY SBYTE_X_INCR_DIRECT_M_S7_S3 0 void_int_M_S7_S3 10 -1 8 /end AXIS_PTS
/begin AXIS_PTS KL_KSVH_RESET_SAK_ANS_X "X-Achse: istgang_egs_in" 0x26E232 NO_INPUT_QUANTITY SBYTE_X_INCR_DIRECT_M_S7_S3 0 void_int_M_S7_S3 10 -1 8 /end AXIS_PTS
/begin AXIS_PTS KL_KSVH_RESET_SLTMODE_SAK_ANS_X "X-Achse: istgang_egs_in" 0x26E25A NO_INPUT_QUANTITY SBYTE_X_INCR_DIRECT_M_S7_S3 0 void_int_M_S7_S3 10 -1 8 /end AXIS_PTS
/begin AXIS_PTS KL_KSVH_RESET_SRS_SAK_ANS_X "X-Achse: istgang_egs_in" 0x26E26E NO_INPUT_QUANTITY SBYTE_X_INCR_DIRECT_M_S7_S3 0 void_int_M_S7_S3 10 -1 8 /end AXIS_PTS
/begin AXIS_PTS KL_KSVH_RESET_ZND_ANS_X "X-Achse: istgang_egs_in" 0x26E2BE NO_INPUT_QUANTITY SBYTE_X_INCR_DIRECT_M_S7_S3 0 void_int_M_S7_S3 10 -1 8 /end AXIS_PTS
/begin AXIS_PTS KL_KSVHRESET_SCL_ZUS_X "Ruecksetzen einer Schaltverhinderung in Abhaengigkeit des Istgangs im Zustand K0-Schliessen beim Zustart (255 = alle Arten von Schaltungen zuruecksetzen, 0 = keine Schaltung zuruecksetzen) -> Bit-Codierung siehe Handbuch" 0x26CFFC istgang_egs_in SBYTE_X_INCR_DIRECT_M_S7_S3 0 void_int_M_S7_S3 8 -1 8 /end AXIS_PTS
/begin AXIS_PTS KL_MGK0MODHASMAX_SCL_ZUS_X "Maximaler Gradienten des modifizierten K0-Moments der HAS in Anhaengigkeit des VM-Zielmoments im Zustand K0-Schliessen beim Zustart" 0x26C7C4 m_ziel_vm_has_zus FLOAT32_IEEE_X_INCR_DIRECT_M_S7_S3 0 trq_fl_a_M_S7_S3 6 -3.40282E+038 3.40282E+038 /end AXIS_PTS
/begin AXIS_PTS KL_MGSOLLK0_SCHUB_ZND_ANS_X "X-Achse: f(m_ziel_k0-m_soll_k0)" 0x26A200 NO_INPUT_QUANTITY FLOAT32_IEEE_X_INCR_DIRECT_M_S7_S3 0 trq_fl_a_M_S7_S3 5 -1000 1000 /end AXIS_PTS
/begin AXIS_PTS KL_MGSOLLK0_ZND_ANS_X "X-Achse: f(m_ziel_k0-m_soll_k0)" 0x26A250 NO_INPUT_QUANTITY FLOAT32_IEEE_X_INCR_DIRECT_M_S7_S3 0 trq_fl_a_M_S7_S3 5 -1000 1000 /end AXIS_PTS
/begin AXIS_PTS KL_MGSOLLK0HASMAX_SCL_ZUS_X "Maximaler Gradienten des K0-Sollmoments der HAS in Anhaengigkeit des VM-Zielmoments im Zustand K0-Schliessen beim Zustart" 0x26C824 m_ziel_vm_has_zus FLOAT32_IEEE_X_INCR_DIRECT_M_S7_S3 0 trq_fl_a_M_S7_S3 6 -3.40282E+038 3.40282E+038 /end AXIS_PTS
/begin AXIS_PTS KL_MK0MVMSTART_ZND_ANS_X "Anteil des K0-Zielmoments beim VM Zuenden in Abhaengigkeit des VM Startmoments beim VM Anschleppen" 0x26A338 NO_INPUT_QUANTITY FLOAT32_IEEE_X_INCR_DIRECT_M_S7_S3 0 trq_fl_a_M_S7_S3 8 -1000 1000 /end AXIS_PTS
/begin AXIS_PTS KL_MSK0STATUSK0BEFUELLUNG_ANS_X "X-Achse: z_k0_befuellopt_has" 0x26A378 NO_INPUT_QUANTITY FLOAT32_IEEE_X_INCR_DIRECT_M_S7_S3 0 sts_fl_M_S7_S3 3 0 2 /end AXIS_PTS
/begin AXIS_PTS KL_NDIAEEMMAXIAE_ZND_ANS_X "X-Achse: (nd_iae-nd_soll_iae_stat)" 0x26A650 NO_INPUT_QUANTITY FLOAT32_IEEE_X_INCR_DIRECT_M_S7_S3 0 n_fl_M_S7_S3 8 -10000 10000 /end AXIS_PTS
/begin AXIS_PTS KL_TMAXIAEOEFCGETR_ANS_X "X-Achse: c_getriebe_egs_in" 0x26A888 c_getriebe_egs_in FLOAT32_IEEE_X_INCR_DIRECT_M_S7_S3 0 c_fl_M_S7_S3 8 -50 200 /end AXIS_PTS
/begin AXIS_PTS KL_TMINABLVAR_ZND_ANS_X "X-Achse: z_ablaufvariante_has_ans" 0x26AA48 NO_INPUT_QUANTITY UBYTE_X_INCR_DIRECT_M_S7_S3 0 void_int_M_S7_S3 8 0 15 /end AXIS_PTS
/begin AXIS_PTS KL_UMSCHZMMAXIAE_STKRAFT_ANS_X "X-Achse: status_kraftfluss_egs_in" 0x26F100 status_kraftfluss_egs_in UBYTE_X_INCR_DIRECT_M_S7_S3 0 sts_int_M_S7_S3 7 0 6 /end AXIS_PTS
/begin AXIS_PTS KL_ZK0ENTKAKTIVABLVAR_ANS_X "X-Achse: z_ablaufvariante_has_ans" 0x26E2D2 NO_INPUT_QUANTITY UBYTE_X_INCR_DIRECT_M_S7_S3 0 void_int_M_S7_S3 6 0 15 /end AXIS_PTS
/begin AXIS_PTS KL_ZNSOLLEM_ISTGANG_ANS_X "X-Achse: istgang_egs_in" 0x26E2DE istgang_egs_in SBYTE_X_INCR_DIRECT_M_S7_S3 0 void_int_M_S7_S3 10 -1 8 /end AXIS_PTS
/begin AXIS_PTS KL_ZNSOLLVMAKTIVABLVAR_ANS_X "X-Achse: z_ablaufvariante_has_ans" 0x26E2F2 NO_INPUT_QUANTITY UBYTE_X_INCR_DIRECT_M_S7_S3 0 void_int_M_S7_S3 6 0 15 /end AXIS_PTS
/begin MEASUREMENT abstellpos_vm_in "Abstellposition VM vor naechstem ZOT" UWORD void_int_c_M_S7_S3 1 100 0 360 ECU_ADDRESS 0xFFF86784 /end MEASUREMENT
/begin MEASUREMENT abstellpos_vm_status_in "Status Abstellposition VM" UBYTE void_int_M_S7_S3 1 100 0 2 ECU_ADDRESS 0xFFF86CC5 /end MEASUREMENT
/begin MEASUREMENT analyse_has_sbe "Bestimmung der Monitoring-Variante fuer die MVG VM-Start " UBYTE void_int_M_S7_S3 1 100 0 8 ECU_ADDRESS 0xFFF86C73 /end MEASUREMENT
/begin MEASUREMENT bErrorHybrid "Anforderung der Strategieanpassung, die Zustandssteuerung (OML) im Error-Modus zu betreiben" UBYTE sts_int_M_S7_S3 1 100 0 1 ECU_ADDRESS 0xFFF86C80 /end MEASUREMENT
/begin MEASUREMENT bExceptionHybrid "Anforderung der Strategieanpassung, die Zustandssteuerung (OML) im Exception-Modus zu betreiben" UBYTE sts_int_M_S7_S3 1 100 0 1 ECU_ADDRESS 0xFFF86C81 /end MEASUREMENT
/begin MEASUREMENT bremspedal_in "Signal Bremsschalter" UBYTE E_BREMSPED_M_S7_S3 1 100 0 1 ECU_ADDRESS 0xFFF86C9B /end MEASUREMENT
/begin MEASUREMENT c_getriebe_egs_in "" FLOAT32_IEEE c_int_M_S7_S3 1 100 -40 215 ECU_ADDRESS 0xFFF86214 /end MEASUREMENT
/begin MEASUREMENT c_umgebung_in "Aussentemperatur gefiltert" FLOAT32_IEEE c_fl_M_S7_S3 1 100 -40 85 ECU_ADDRESS 0xFFF86284 /end MEASUREMENT
/begin MEASUREMENT c_vm_in "" FLOAT32_IEEE c_fl_M_S7_S3 1 100 -3.40282E+038 3.40282E+038 ECU_ADDRESS 0xFFF86288 /end MEASUREMENT
/begin MEASUREMENT drehrichtung_nab_in "Drehrichtung Abtriebsdrehzahl" UBYTE E_DREHRICH_M_S7_S3 1 100 0 2 ECU_ADDRESS 0xFFF86C9C /end MEASUREMENT
/begin MEASUREMENT drehrichtung_nem_in "Drehrichtung der E-Maschine" UBYTE E_DREHRICH_M_S7_S3 1 100 0 2 ECU_ADDRESS 0xFFF86C9D /end MEASUREMENT
/begin MEASUREMENT fpw_in "Prozent Fahrpedalstellung" UBYTE rel_int_M_S7_S3 1 100 0 255 ECU_ADDRESS 0xFFF86C9E /end MEASUREMENT
/begin MEASUREMENT gangwechsel_egs_in "Flag waehrend laufender Schaltung, bei synchron verlassen bis synchron erreicht" UBYTE void_int_M_S7_S3 1 100 0 1 ECU_ADDRESS 0xFFF86C9F /end MEASUREMENT
/begin MEASUREMENT i_gang_lev2_egs_in "Uebergabe der aktuellen Ganguebersetzung i_gang nach ASILB ermittelt aus den Kupplungsstroemen" FLOAT32_IEEE void_fl_M_S7_S3 1 100 -3.40282E+038 3.40282E+038 ECU_ADDRESS 0xFFF86218 /end MEASUREMENT
/begin MEASUREMENT i_istgang_egs "Uebersetzung des aktuellen Gangs" FLOAT32_IEEE ratio_fl_M_S7_S3 1 100 0 8 ECU_ADDRESS 0xFFF861B4 /end MEASUREMENT
/begin MEASUREMENT i_zielgang_egs "Uebersetzung des Zielgangs" FLOAT32_IEEE ratio_fl_M_S7_S3 1 100 0 8 ECU_ADDRESS 0xFFF861B8 /end MEASUREMENT
/begin MEASUREMENT istgang_egs_in "" SBYTE void_int_M_S7_S3 1 100 -128 127 ECU_ADDRESS 0xFFF86CA0 /end MEASUREMENT
/begin MEASUREMENT k_mstoerk0em_zus "Faktor zur Modifikation des K0-Stoermoments zur Bestimmung des EM-Vorsteuermoments beim Zustart" FLOAT32_IEEE void_fl_M_S7_S3 1 100 0 2 ECU_ADDRESS 0xFFF86084 /end MEASUREMENT
/begin MEASUREMENT kolbenpos_k0_in "" FLOAT32_IEEE sts_fl_M_S7_S3 1 100 -3.40282E+038 3.40282E+038 ECU_ADDRESS 0xFFF8621C /end MEASUREMENT
/begin MEASUREMENT m_em_in "" FLOAT32_IEEE trq_fl_a_M_S7_S3 1 100 -1024 1024 ECU_ADDRESS 0xFFF86220 /end MEASUREMENT
/begin MEASUREMENT m_iae_in "" FLOAT32_IEEE trq_fl_a_M_S7_S3 1 100 -32768 32767 ECU_ADDRESS 0xFFF86224 /end MEASUREMENT
/begin MEASUREMENT m_k0_has_sbe "K0 Istmoment der Funktion Bestimmung des K0 Istmoments der HAS" FLOAT32_IEEE trq_fl_a_M_S7_S3 1 100 -1000 1000 ECU_ADDRESS 0xFFF861EC /end MEASUREMENT
/begin MEASUREMENT m_k0_in "" FLOAT32_IEEE trq_fl_a_M_S7_S3 1 100 -32768 32767 ECU_ADDRESS 0xFFF86228 /end MEASUREMENT
/begin MEASUREMENT m_k0_mber_has_sbe "K0-Moment der HAS zur Motormomentbegrenzung in der SAB" FLOAT32_IEEE trq_fl_a_M_S7_S3 1 100 -3.40282E+038 3.40282E+038 ECU_ADDRESS 0xFFF861F0 /end MEASUREMENT
/begin MEASUREMENT m_k0_mod_has_fkt "" FLOAT32_IEEE trq_fl_a_M_S7_S3 1 100 -1200 1200 ECU_ADDRESS 0xFFF86184 /end MEASUREMENT
/begin MEASUREMENT m_max_dyn_em_in "" FLOAT32_IEEE trq_fl_a_M_S7_S3 1 100 -3.40282E+038 3.40282E+038 ECU_ADDRESS 0xFFF8622C /end MEASUREMENT
/begin MEASUREMENT m_max_em_has_fkt "" FLOAT32_IEEE trq_fl_a_M_S7_S3 1 100 -1200 1200 ECU_ADDRESS 0xFFF86188 /end MEASUREMENT
/begin MEASUREMENT m_max_iae_has_fkt "" FLOAT32_IEEE trq_fl_a_M_S7_S3 1 100 -1200 1200 ECU_ADDRESS 0xFFF8618C /end MEASUREMENT
/begin MEASUREMENT m_min_dyn_em_in "" FLOAT32_IEEE trq_fl_a_M_S7_S3 1 100 -3.40282E+038 3.40282E+038 ECU_ADDRESS 0xFFF86230 /end MEASUREMENT
/begin MEASUREMENT m_min_em_has_fkt "" FLOAT32_IEEE trq_fl_a_M_S7_S3 1 100 -1200 1200 ECU_ADDRESS 0xFFF86190 /end MEASUREMENT
/begin MEASUREMENT m_min_vm_in "" FLOAT32_IEEE trq_fl_a_M_S7_S3 1 100 -3.40282E+038 3.40282E+038 ECU_ADDRESS 0xFFF8628C /end MEASUREMENT
/begin MEASUREMENT m_mot_in "" FLOAT32_IEEE trq_fl_a_M_S7_S3 1 100 -1024 1024 ECU_ADDRESS 0xFFF86234 /end MEASUREMENT
/begin MEASUREMENT m_motmax_has_sbe "Maximal zulaessiges Motormoment des Gefuehrten Getriebeschutz der HAS" FLOAT32_IEEE trq_fl_a_M_S7_S3 1 100 -5000 5000 ECU_ADDRESS 0xFFF861F4 /end MEASUREMENT
/begin MEASUREMENT m_soll_em_has_fkt "" FLOAT32_IEEE trq_fl_a_M_S7_S3 1 100 -1200 1200 ECU_ADDRESS 0xFFF86194 /end MEASUREMENT
/begin MEASUREMENT m_soll_em_hst_in "" FLOAT32_IEEE trq_fl_a_M_S7_S3 1 100 -32768 32767 ECU_ADDRESS 0xFFF86238 /end MEASUREMENT
/begin MEASUREMENT m_soll_k0_has_fkt "" FLOAT32_IEEE trq_fl_a_M_S7_S3 1 100 -1200 1200 ECU_ADDRESS 0xFFF86198 /end MEASUREMENT
/begin MEASUREMENT m_soll_k0_has_sbe "K0 Sollmoment der Bestimmung des K0 Sollmoments der HAS" FLOAT32_IEEE trq_fl_a_M_S7_S3 1 100 -1000 1000 ECU_ADDRESS 0xFFF861F8 /end MEASUREMENT
/begin MEASUREMENT m_soll_k0_min_uvs_zus "Minimalwert des K0 Sollmoment bei Anforderung einer K0-Unterstuetzung des VM Startsystems durch die HAS Zustandssteuerung (OML) beim VM Zustart" FLOAT32_IEEE trq_fl_a_M_S7_S3 1 100 -1000 1000 ECU_ADDRESS 0xFFF8608C /end MEASUREMENT
/begin MEASUREMENT m_soll_res_em_bas_sbe "Basis-Reservemoment fuer den VM-Start" FLOAT32_IEEE trq_fl_a_M_S7_S3 1 100 -3.40282E+038 3.40282E+038 ECU_ADDRESS 0xFFF861FC /end MEASUREMENT
/begin MEASUREMENT m_soll_res_em_has_fkt "" FLOAT32_IEEE trq_fl_a_M_S7_S3 1 100 -1200 1200 ECU_ADDRESS 0xFFF8619C /end MEASUREMENT
/begin MEASUREMENT m_soll_res_em_has_sbe "Reservemoment fuer den VM-Start" FLOAT32_IEEE trq_fl_a_M_S7_S3 1 100 -3.40282E+038 3.40282E+038 ECU_ADDRESS 0xFFF86200 /end MEASUREMENT
/begin MEASUREMENT m_soll_vm_hst_in "" FLOAT32_IEEE trq_fl_a_M_S7_S3 1 100 -32768 32767 ECU_ADDRESS 0xFFF8623C /end MEASUREMENT
/begin MEASUREMENT m_soll_vm_l_hst_in "" FLOAT32_IEEE trq_fl_a_M_S7_S3 1 100 -3.40282E+038 3.40282E+038 ECU_ADDRESS 0xFFF86290 /end MEASUREMENT
/begin MEASUREMENT m_stoerk0em_fil_zus "Gefiltertes K0-Stoermoment zur Bestimmung des EM-Vorsteuermoments beim Zustart" FLOAT32_IEEE trq_fl_a_M_S7_S3 1 100 -1000 1000 ECU_ADDRESS 0xFFF86090 /end MEASUREMENT
/begin MEASUREMENT m_stoerk0em_zus "Ungefiltertes K0-Stoermoments zur Bestimmung des EM-Vorsteuermoments beim Zustart" FLOAT32_IEEE trq_fl_a_M_S7_S3 1 100 -1000 1000 ECU_ADDRESS 0xFFF86094 /end MEASUREMENT
/begin MEASUREMENT m_vm_in "" FLOAT32_IEEE trq_fl_a_M_S7_S3 1 100 -1024 1023.5 ECU_ADDRESS 0xFFF86240 /end MEASUREMENT
/begin MEASUREMENT m_vm_start_in "" FLOAT32_IEEE trq_fl_a_M_S7_S3 1 100 -1024 1023.5 ECU_ADDRESS 0xFFF86244 /end MEASUREMENT
/begin MEASUREMENT m_wunsch_fpw_begr_ans "" FLOAT32_IEEE trq_fl_a_M_S7_S3 1 100 -3.40282E+038 3.40282E+038 ECU_ADDRESS 0xFFF85E44 /end MEASUREMENT
/begin MEASUREMENT m_wunsch_fpw_hst_fil "Gefiltertes Wunschmoment" FLOAT32_IEEE trqg_fl_k_M_S7_S3 1 100 -2000 2000 ECU_ADDRESS 0xFFF861BC /end MEASUREMENT
/begin MEASUREMENT m_wunsch_fpw_hst_in "" FLOAT32_IEEE trq_fl_a_M_S7_S3 1 100 -3.40282E+038 3.40282E+038 ECU_ADDRESS 0xFFF86294 /end MEASUREMENT
/begin MEASUREMENT m_wunsch_fpw_in "" FLOAT32_IEEE trq_fl_a_M_S7_S3 1 100 -32768 32767 ECU_ADDRESS 0xFFF86248 /end MEASUREMENT
/begin MEASUREMENT m_ziel_k0_hst_in "Target torque of K0 sent by ECU" FLOAT32_IEEE trq_fl_a_M_S7_S3 1 100 -1000 2000 ECU_ADDRESS 0xFFF8624C /end MEASUREMENT
/begin MEASUREMENT m_ziel_k0_min_syn_zus "Minimalwert des  Zielmoment der Trennkupplung K0 zur Realisierung des Fahrerwunschmoments beim K0 Synchronisieren beim Zustart" FLOAT32_IEEE trq_fl_a_M_S7_S3 1 100 -1000 1000 ECU_ADDRESS 0xFFF86098 /end MEASUREMENT
/begin MEASUREMENT m_ziel_k0_zus "Zielmoment der Trennkupplung K0 beim Zustart" FLOAT32_IEEE trq_fl_a_M_S7_S3 1 100 -1000 1000 ECU_ADDRESS 0xFFF8609C /end MEASUREMENT
/begin MEASUREMENT m_ziel_vm_has_ans "Zielmoment des VM beim Schleppstart" FLOAT32_IEEE trq_fl_a_M_S7_S3 1 100 -1000 1000 ECU_ADDRESS 0xFFF85E4C /end MEASUREMENT
/begin MEASUREMENT m_ziel_vm_has_zus "Zielmoment des VM bei Zustart" FLOAT32_IEEE trq_fl_a_M_S7_S3 1 100 -1000 1000 ECU_ADDRESS 0xFFF860A0 /end MEASUREMENT
/begin MEASUREMENT mg_k0_mod_max_zus "Maximaler Gradient des modifizierten K0-Moments der HAS im K0 Schliessen beim Zustart" FLOAT32_IEEE trqg_fl_k_M_S7_S3 1 100 0 50000 ECU_ADDRESS 0xFFF860A4 /end MEASUREMENT
/begin MEASUREMENT mg_mot_in "Gradient des Getriebeeingangsmoment" FLOAT32_IEEE trqg_fl_k_M_S7_S3 1 100 -2000 2000 ECU_ADDRESS 0xFFF861C0 /end MEASUREMENT
/begin MEASUREMENT mg_soll_k0_has_fkt "" FLOAT32_IEEE trqg_fl_k_M_S7_S3 1 100 -3000 3000 ECU_ADDRESS 0xFFF861A0 /end MEASUREMENT
/begin MEASUREMENT mg_soll_k0_max_zus "Maximaler Gradient des K0-Soll-Moments der HAS im K0 Schliessen beim Zustart" FLOAT32_IEEE trqg_fl_k_M_S7_S3 1 100 0 50000 ECU_ADDRESS 0xFFF860A8 /end MEASUREMENT
/begin MEASUREMENT mg_wunsch_fpw_hst_in "Gradient des gefilterten oder koordinierten Fahrerwunschmoments aus Fahrpedalinterpretation" FLOAT32_IEEE trqg_fl_k_M_S7_S3 1 100 -2000 2000 ECU_ADDRESS 0xFFF861C4 /end MEASUREMENT
/begin MEASUREMENT mg_wunsch_fpw_in "Gradient des Fahrerwunschmoments aus Fahrpedalinterpretation" FLOAT32_IEEE trqg_fl_k_M_S7_S3 1 100 -2000 2000 ECU_ADDRESS 0xFFF861C8 /end MEASUREMENT
/begin MEASUREMENT mo_k0befuell_zus "Momentoffset aus der K0-Erfuellung" FLOAT32_IEEE trq_fl_a_M_S7_S3 1 100 -1000 1000 ECU_ADDRESS 0xFFF860B0 /end MEASUREMENT
/begin MEASUREMENT modus_e_fahren_hst_in "Electric driving mode concerning state of charging mode of high voltage battery" UBYTE E_MODUSEFAH_M_S7_S3 1 100 0 1 ECU_ADDRESS 0xFFF86CC6 /end MEASUREMENT
/begin MEASUREMENT modus_e_fahren_zus "Anzeige des E-Fahr-Modus des Hybridsystems beim Zustart" UBYTE E_MODUSEFAH_M_S7_S3 1 100 0 1 ECU_ADDRESS 0xFFF86B68 /end MEASUREMENT
/begin MEASUREMENT n_ab_egs_in "" FLOAT32_IEEE n_fl_M_S7_S3 1 100 0 65535 ECU_ADDRESS 0xFFF86250 /end MEASUREMENT
/begin MEASUREMENT n_em_in "" FLOAT32_IEEE n_fl_M_S7_S3 1 100 -3.40282E+038 3.40282E+038 ECU_ADDRESS 0xFFF86254 /end MEASUREMENT
/begin MEASUREMENT n_min_em_has_sbe "Minimale EM Drehzahl der Leerlaufsimulation der HAS (LLS)" FLOAT32_IEEE n_fl_M_S7_S3 1 100 -32767 32767 ECU_ADDRESS 0xFFF86204 /end MEASUREMENT
/begin MEASUREMENT n_min_em_psys_lp3_has_sbe "Mindestdrehzahl der EM zur Sicherstellung des Leistungspunkt 3 der Bestimmung des Status Systemdruck der HAS" FLOAT32_IEEE n_fl_M_S7_S3 1 100 0 10000 ECU_ADDRESS 0xFFF861CC /end MEASUREMENT
/begin MEASUREMENT n_mot_soll_iae_in "" FLOAT32_IEEE n_fl_M_S7_S3 1 100 -3.40282E+038 3.40282E+038 ECU_ADDRESS 0xFFF86258 /end MEASUREMENT
/begin MEASUREMENT n_sec_iae "Sekundaere IAE-Drehzahl" FLOAT32_IEEE n_fl_M_S7_S3 1 100 -10000 10000 ECU_ADDRESS 0xFFF861D0 /end MEASUREMENT
/begin MEASUREMENT n_sec_iae_ist_ans "Abtriebsseitige IAE-Drehzahl bezogen auf den Getriebeeeingang und den aktuellen  Istgang waehrend einer Schaltung beim Schleppstart" FLOAT32_IEEE n_fl_M_S7_S3 1 100 -10000 10000 ECU_ADDRESS 0xFFF85E74 /end MEASUREMENT
/begin MEASUREMENT n_sec_iae_ist_zus "Abtriebsseitige IAE-Drehzahl bezogen auf den Getriebeeeingang und den aktuellen  Istgang waehrend einer Schaltung beim Zustart" FLOAT32_IEEE n_fl_M_S7_S3 1 100 0 10000 ECU_ADDRESS 0xFFF860C0 /end MEASUREMENT
/begin MEASUREMENT n_sec_iae_ziel_ans "Abtriebsseitige IAE Zieldrehzahl bezogen auf den Getriebeeingang waehrend einer Schaltung beim SLST" FLOAT32_IEEE n_fl_M_S7_S3 1 100 -10000 10000 ECU_ADDRESS 0xFFF85E78 /end MEASUREMENT
/begin MEASUREMENT n_sec_iae_ziel_zus "Abtriebsseitige IAE Zieldrehzahl bezogen auf den Getriebeeingang waehrend einer Schaltung beim Zustart" FLOAT32_IEEE n_fl_M_S7_S3 1 100 0 10000 ECU_ADDRESS 0xFFF860C4 /end MEASUREMENT
/begin MEASUREMENT n_soll_em_has_fkt "" FLOAT32_IEEE n_fl_M_S7_S3 1 100 0 8000 ECU_ADDRESS 0xFFF861A4 /end MEASUREMENT
/begin MEASUREMENT n_soll_em_hst_in "" FLOAT32_IEEE n_fl_M_S7_S3 1 100 -3.40282E+038 3.40282E+038 ECU_ADDRESS 0xFFF86298 /end MEASUREMENT
/begin MEASUREMENT n_soll_ll_vm_in "" FLOAT32_IEEE n_fl_M_S7_S3 1 100 0 2540 ECU_ADDRESS 0xFFF8625C /end MEASUREMENT
/begin MEASUREMENT n_soll_vm_has_fkt "" FLOAT32_IEEE n_fl_M_S7_S3 1 100 0 8000 ECU_ADDRESS 0xFFF861A8 /end MEASUREMENT
/begin MEASUREMENT n_t_egs_in "" FLOAT32_IEEE n_fl_M_S7_S3 1 100 0 65535 ECU_ADDRESS 0xFFF86260 /end MEASUREMENT
/begin MEASUREMENT n_vm_in "" FLOAT32_IEEE n_fl_M_S7_S3 1 100 0 65535 ECU_ADDRESS 0xFFF86264 /end MEASUREMENT
/begin MEASUREMENT nd_iae_ans "Differenzdrehzahl der IAE bezogen auf den Getriebeeingang  (n_em_in - n_sec_iae_fil)" FLOAT32_IEEE n_fl_M_S7_S3 1 100 -10000 10000 ECU_ADDRESS 0xFFF85E8C /end MEASUREMENT
/begin MEASUREMENT nd_k0_in "Differenzdrehzahl der Trennkupplung" FLOAT32_IEEE n_fl_M_S7_S3 1 100 -10000 10000 ECU_ADDRESS 0xFFF861D4 /end MEASUREMENT
/begin MEASUREMENT nd_min_saf_has_fkt "Anforderung min. Drehzahlsprung an ASIS" FLOAT32_IEEE n_fl_M_S7_S3 1 100 0 8000 ECU_ADDRESS 0xFFF861AC /end MEASUREMENT
/begin MEASUREMENT nd_soll_iae_ans "Gemessen in solldrehzahl_em/konditionieren" FLOAT32_IEEE n_fl_M_S7_S3 1 100 -10000 10000 ECU_ADDRESS 0xFFF85E9C /end MEASUREMENT
/begin MEASUREMENT nd_soll_iae_fkt "Differenzdrehzahl der Anfahrkupplung" FLOAT32_IEEE ng_fl_M_S7_S3 1 100 -8000 8000 ECU_ADDRESS 0xFFF861B0 /end MEASUREMENT
/begin MEASUREMENT nd_soll_iae_stat_ans "Statischer Sollschlupf (Zielwert) bezogen auf den Getriebeeingang" FLOAT32_IEEE n_fl_M_S7_S3 1 100 -10000 10000 ECU_ADDRESS 0xFFF85EA4 /end MEASUREMENT
/begin MEASUREMENT ndg_k0_in "Gradienten der Differenzdrehzahl der Trennkupplung" FLOAT32_IEEE ng_fl_M_S7_S3 1 100 -10000 10000 ECU_ADDRESS 0xFFF861D8 /end MEASUREMENT
/begin MEASUREMENT ng_em_ans "Drehzahlgradient der EM-Ist-Drehzahl" FLOAT32_IEEE ng_fl_M_S7_S3 1 100 -10000 10000 ECU_ADDRESS 0xFFF85EAC /end MEASUREMENT
/begin MEASUREMENT ng_em_zus "EM-Drehzahlgradient beim Zustart" FLOAT32_IEEE ng_fl_M_S7_S3 1 100 -10000 10000 ECU_ADDRESS 0xFFF860D0 /end MEASUREMENT
/begin MEASUREMENT ng_vm_in "Gradient der VM Drehzahl" FLOAT32_IEEE ng_fl_M_S7_S3 1 100 -10000 10000 ECU_ADDRESS 0xFFF861DC /end MEASUREMENT
/begin MEASUREMENT osmode_next_in "" UBYTE sts_int_M_S7_S3 1 100 0 255 ECU_ADDRESS 0xFFF86CA1 /end MEASUREMENT
/begin MEASUREMENT p_bremse_fzg_in "" FLOAT32_IEEE p_fl_M_S7_S3 1 100 0 127 ECU_ADDRESS 0xFFF86268 /end MEASUREMENT
/begin MEASUREMENT phi_neigung_in "" FLOAT32_IEEE phigrad_fl_M_S7_S3 1 100 -3.40282E+038 3.40282E+038 ECU_ADDRESS 0xFFF8626C /end MEASUREMENT
/begin MEASUREMENT pos_egs_in "Waehlhebelposition" UBYTE E_POS_M_S7_S3 1 100 0 8 ECU_ADDRESS 0xFFF86CA2 /end MEASUREMENT
/begin MEASUREMENT schalt_mode_egs_in "" UWORD void_int_c_M_S7_S3 1 100 0 65535 ECU_ADDRESS 0xFFF86780 /end MEASUREMENT
/begin MEASUREMENT soc_in "Interface provides state of charge of high-voltage battery" UBYTE rel_int_M_S7_S3 1 100 0 100 ECU_ADDRESS 0xFFF86CC7 /end MEASUREMENT
/begin MEASUREMENT sollgang_egs_in "" SBYTE void_int_M_S7_S3 1 100 -128 127 ECU_ADDRESS 0xFFF86CA3 /end MEASUREMENT
/begin MEASUREMENT st_ablauf_fkt "Phase des Ablauf" UWORD st_int_g_M_S7_S3 1 100 0 65535 ECU_ADDRESS 0xFFF86774 /end MEASUREMENT
/begin MEASUREMENT st_ist_bz_has_stg "Istzustand OML" UBYTE E_STBZHAS_M_S7_S3 1 100 0 15 ECU_ADDRESS 0xFFF86C55 /end MEASUREMENT
/begin MEASUREMENT st_ist_bz_hst_sta "Ist-Betriebszustand aus der Startegieanpassung als Eingangsgroesse der Hybridzustandssteuerung (OML)" UBYTE E_STBZHAS_M_S7_S3 1 100 0 15 ECU_ADDRESS 0xFFF86C82 /end MEASUREMENT
/begin MEASUREMENT st_ist_hcomd_has_stg "Innere Zustaende der OML" UWORD st_int_g_M_S7_S3 1 100 0 4999 ECU_ADDRESS 0xFFF86772 /end MEASUREMENT
/begin MEASUREMENT st_soll_bz_has_hst "interner HST Soll-Betriebszustand der Strategieanpassung (variantenunabhaengig)" UBYTE sts_int_M_S7_S3 1 100 0 15 ECU_ADDRESS 0xFFF86C83 /end MEASUREMENT
/begin MEASUREMENT st_soll_bz_hst_sta "Soll-Betriebszustand aus der Strategieanpassung als Eingangsgroesse der Hybrid-Zustandssteuerung (OML)" UBYTE E_STBZHAS_M_S7_S3 1 100 0 15 ECU_ADDRESS 0xFFF86C84 /end MEASUREMENT
/begin MEASUREMENT st_ziel_bz_has_stg "Zielzustand OML" UBYTE E_STBZHAS_M_S7_S3 1 100 0 15 ECU_ADDRESS 0xFFF86C56 /end MEASUREMENT
/begin MEASUREMENT status_ablauf_has_fkt "" UBYTE sts_int_M_S7_S3 1 100 0 50 ECU_ADDRESS 0xFFF86C5A /end MEASUREMENT
/begin MEASUREMENT status_abs_in "Information, ob aktuell ein Eingriff durch das ABS System vorgenommen wird" UBYTE E_STATUSABS_M_S7_S3 1 100 0 2 ECU_ADDRESS 0xFFF86CC8 /end MEASUREMENT
/begin MEASUREMENT status_alaengs_adaoff_in "Information, ob die Adaptionen aufgrund erkannter Laengsbeschleunigung deaktiviert wird. 0 = Adaption aktiv aufgrund erkannter Laengsbeschleunigung
1 = Adaption inaktiv aufgrund nicht erkannter Laengsbeschleunigung" UBYTE sts_int_M_S7_S3 1 100 0 1 ECU_ADDRESS 0xFFF86CA4 /end MEASUREMENT
/begin MEASUREMENT status_asr_in "Information, ob ein Regeleingriff durch ein Assistenzsystem (ESP, ASR) vorliegt" UBYTE E_STATUSASR_M_S7_S3 1 100 0 1 ECU_ADDRESS 0xFFF86CC9 /end MEASUREMENT
/begin MEASUREMENT status_autohold_in "Status der Systeme zur Fahrzeug- Rollverhinderung" UBYTE E_STATUSNAA_M_S7_S3 1 100 0 1 ECU_ADDRESS 0xFFF86CA5 /end MEASUREMENT
/begin MEASUREMENT status_betriebsbereit_hst_in "" UBYTE sts_int_M_S7_S3 1 100 0 1 ECU_ADDRESS 0xFFF86CCA /end MEASUREMENT
/begin MEASUREMENT status_c_k0_in "Interface returns information concerning energy balance of clutch 0" UBYTE E_STATUSCK0_M_S7_S3 1 100 0 2 ECU_ADDRESS 0xFFF86CA6 /end MEASUREMENT
/begin MEASUREMENT status_cumgebung_in "Statusinformation in GET_CKB_TOUT" UBYTE E_SIGSTATUS_M_S7_S3 1 100 0 2 ECU_ADDRESS 0xFFF86CCB /end MEASUREMENT
/begin MEASUREMENT status_efahren_has_sbe "Status E-Fahren der HAS zur Festlegung der entsprechenden Portout-Groesse in der HAS Signalaufbereitung_Out" UBYTE sts_int_M_S7_S3 1 100 0 1 ECU_ADDRESS 0xFFF86C74 /end MEASUREMENT
/begin MEASUREMENT status_fehler_iep_in "" UBYTE E_FEHLERIEP_M_S7_S3 1 100 0 1 ECU_ADDRESS 0xFFF86CA7 /end MEASUREMENT
/begin MEASUREMENT status_getrbereit_in "Status des hydraulischen Drucks des Getriebes" UBYTE sts_int_M_S7_S3 1 100 0 255 ECU_ADDRESS 0xFFF86CCC /end MEASUREMENT
/begin MEASUREMENT status_hillhold_in "Status der Systeme zur Fahrzeug- Rollverhinderung" UBYTE E_STATUSNAA_M_S7_S3 1 100 0 1 ECU_ADDRESS 0xFFF86CA8 /end MEASUREMENT
/begin MEASUREMENT status_iae_adap_in "Status der Adaption des Integrierten Anfahrelements IAE" UBYTE E_STATUSADA_M_S7_S3 1 100 0 2 ECU_ADDRESS 0xFFF86CA9 /end MEASUREMENT
/begin MEASUREMENT status_iae_in "" UBYTE E_STATUSIAE_M_S7_S3 1 100 0 8 ECU_ADDRESS 0xFFF86CAA /end MEASUREMENT
/begin MEASUREMENT status_iae_plaus_ans "Plausibilisierung status_iae fuer Berechnung z_m_max_iae" UBYTE sts_int_e_M_S7_S3 1 100 0 1 ECU_ADDRESS 0xFFF86A83 /end MEASUREMENT
/begin MEASUREMENT status_iep_in "" UBYTE E_STATUSIEP_M_S7_S3 1 100 0 4 ECU_ADDRESS 0xFFF86CAB /end MEASUREMENT
/begin MEASUREMENT status_k0_adap_in "" UBYTE E_STATUSADA_M_S7_S3 1 100 0 2 ECU_ADDRESS 0xFFF86CAC /end MEASUREMENT
/begin MEASUREMENT status_k0_adap_zaehler_in "Zaehler k0 adaption" UBYTE void_int_M_S7_S3 1 100 0 255 ECU_ADDRESS 0xFFF86CAD /end MEASUREMENT
/begin MEASUREMENT status_k0_befuellung_in "Interface provides the current filling mode of clutch 0" UBYTE E_STAK0BEF_M_S7_S3 1 100 0 3 ECU_ADDRESS 0xFFF86CAE /end MEASUREMENT
/begin MEASUREMENT status_k0_in "" UBYTE E_STATUSK0_M_S7_S3 1 100 0 5 ECU_ADDRESS 0xFFF86CAF /end MEASUREMENT
/begin MEASUREMENT status_k0befuellung_ans "Der Status zeigt an, ob das K-0Momentintegral > als der Wert aus dem KL_MSK0STATUSK0BEFUELLUNG_ANS ist" UBYTE sts_int_e_M_S7_S3 1 100 0 1 ECU_ADDRESS 0xFFF86A84 /end MEASUREMENT
/begin MEASUREMENT status_kl15_in "" UBYTE sts_int_M_S7_S3 1 100 0 1 ECU_ADDRESS 0xFFF86CCD /end MEASUREMENT
/begin MEASUREMENT status_kraftfluss_egs_in "" UBYTE E_STATUSKSL_M_S7_S3 1 100 0 6 ECU_ADDRESS 0xFFF86CB0 /end MEASUREMENT
/begin MEASUREMENT status_kraftfluss_lev2_egs_in "Power flow (controled) information concerning ASIL B" UBYTE sts_int_M_S7_S3 1 100 0 2 ECU_ADDRESS 0xFFF86CB1 /end MEASUREMENT
/begin MEASUREMENT status_ll_vm_in "" UBYTE sts_int_M_S7_S3 1 100 0 255 ECU_ADDRESS 0xFFF86CB2 /end MEASUREMENT
/begin MEASUREMENT status_nem_in "Status zur Drehzahl E-Motor" UBYTE E_SIGSTATUS_M_S7_S3 1 100 0 2 ECU_ADDRESS 0xFFF86CB3 /end MEASUREMENT
/begin MEASUREMENT status_nreg_em_hst_in "" UBYTE sts_int_M_S7_S3 1 100 0 255 ECU_ADDRESS 0xFFF86CCE /end MEASUREMENT
/begin MEASUREMENT status_nvm_in "Status zur Drehzahl VM-Motor" UBYTE E_SIGSTATUS_M_S7_S3 1 100 0 2 ECU_ADDRESS 0xFFF86CB4 /end MEASUREMENT
/begin MEASUREMENT status_posvueb_in "Erkennung PosV Diagnose" UBYTE sts_int_M_S7_S3 1 100 0 255 ECU_ADDRESS 0xFFF86CCF /end MEASUREMENT
/begin MEASUREMENT status_psys_has_sbe "Anzeige des Status Pumpendruck der HAS" UBYTE E_STATUSPSY_M_S7_S3 1 100 0 4 ECU_ADDRESS 0xFFF86C6C /end MEASUREMENT
/begin MEASUREMENT status_radschlupf_rse_has_sbe "Anzeige des Status der Radschlupferkennung (RSE) der HAS" UBYTE E_STATUSRSE_M_S7_S3 1 100 0 1 ECU_ADDRESS 0xFFF86C6D /end MEASUREMENT
/begin MEASUREMENT status_sa_vm_in "00 Keine Beeinflussung; 01 Schubabschaltung aktiv; 10 Nicht stellbarer Bereich; 11 Signal ungueltig" UBYTE sts_int_e_M_S7_S3 1 100 0 1 ECU_ADDRESS 0xFFF86CD0 /end MEASUREMENT
/begin MEASUREMENT status_schaltart_svh_has_sbe "Schaltart der angeforderten Schaltung der Schaltverhinderung der HAS (0 = keine Schaltung angefordert) - Bit-Codierung (m/oL = mit/ohne Lastanh.) =  bit0=ZRSmL, 1=ZHSmL, 2=SRSmL, 3=SHSmL, 4=ZRSoL, 5=ZHSoL, 6=SRSoL, 7=SHSoL" UBYTE sts_int_M_S7_S3 1 100 0 255 ECU_ADDRESS 0xFFF86C6E /end MEASUREMENT
/begin MEASUREMENT status_schaltung_egs_in "Anzeige ob Schaltung des Getriebes aktiv ist" SBYTE sts_int_M_S7_S3 1 100 -9 9 ECU_ADDRESS 0xFFF86C6F /end MEASUREMENT
/begin MEASUREMENT status_soc_in "Interface provides status information of soc_in" UBYTE E_SIGSTATUS_M_S7_S3 1 100 0 2 ECU_ADDRESS 0xFFF86CD1 /end MEASUREMENT
/begin MEASUREMENT status_sync_schaltung_sbe "Anzeige der Synchronerkennung der aktuellen Schaltung innerhalb der HAS" UBYTE sts_int_M_S7_S3 1 100 0 1 ECU_ADDRESS 0xFFF86C70 /end MEASUREMENT
/begin MEASUREMENT status_vf_in "Signalstatus fuer die Fahrzeugistgeschwindigkeit  gebildet aus der Getriebe-Abtriebsdrehzahl" UBYTE E_SIGSTATUS_M_S7_S3 1 100 0 2 ECU_ADDRESS 0xFFF86CB5 /end MEASUREMENT
/begin MEASUREMENT status_vfref_in "Signalstatus fuer die Fahrzeuggeschwindigkeit ueber Grund" UBYTE E_SIGSTATUS_M_S7_S3 1 100 0 2 ECU_ADDRESS 0xFFF86CB6 /end MEASUREMENT
/begin MEASUREMENT status_waschstr_in "" UBYTE sts_int_M_S7_S3 1 100 0 255 ECU_ADDRESS 0xFFF86CB7 /end MEASUREMENT
/begin MEASUREMENT t_betrieb_pvu_has_ee_in "" ULONG t_int_M_S7_S3 1 100 0 10000 ECU_ADDRESS 0xFFF86270 /end MEASUREMENT
/begin MEASUREMENT t_betrieb_pvu_has_sbe "Betriebsdauer seit dem letzten Ablauf der Diagnosefunktion \"Positionsventil-Ueberwachung\" der Funktion zur Unterstuet-zung der Positionsventil-Ueberwachung der HAS" ULONG t_int_M_S7_S3 1 100 0 1000000 ECU_ADDRESS 0xFFF861E0 /end MEASUREMENT
/begin MEASUREMENT t_m_k0_mod_ziel_zus "Timer zur Beruecksichtigung des K0-Istmoments als Zielmoment fuer das modifizierte K0-Sollmoment beim K0-Schliessen beim VM-Zustart" UWORD t_int_n_M_S7_S3 1 100 0 10 ECU_ADDRESS 0xFFF8670C /end MEASUREMENT
/begin MEASUREMENT t_m_soll_k0_anst_zus "Timer zur Erkennung Synchron beim K0 Synchronisieren beim Zustart" UWORD t_int_n_M_S7_S3 1 100 0 10 ECU_ADDRESS 0xFFF8670E /end MEASUREMENT
/begin MEASUREMENT t_maxbed_abb_ans "Verweilzeit in der Phase SLST Abbruch ABB" UWORD t_int_n_M_S7_S3 1 100 0 10 ECU_ADDRESS 0xFFF8665E /end MEASUREMENT
/begin MEASUREMENT t_maxbed_sak_ans "Verweilzeit in der Phase Schaltung aktiv SAK" UWORD t_int_n_M_S7_S3 1 100 0 10 ECU_ADDRESS 0xFFF86664 /end MEASUREMENT
/begin MEASUREMENT t_maxbed_scl_zus "Timer zur ueberwachung der maximalen Verweildauer im Zustand Schaltung aktiv im Zustart" UWORD t_int_n_M_S7_S3 1 100 0 10 ECU_ADDRESS 0xFFF86714 /end MEASUREMENT
/begin MEASUREMENT t_maxbed_znd_ans "Verweilzeit in der Phase VM Zuenden ZND" UWORD t_int_n_M_S7_S3 1 100 0 10 ECU_ADDRESS 0xFFF8666C /end MEASUREMENT
/begin MEASUREMENT t_maxiaeoeffnen_ans "Restzeit, bis zu der von einer IAE-Entkopplung bei status_iae_in = OEFFNEN ausgegengen wird." UWORD t_int_n_M_S7_S3 1 100 0 10 ECU_ADDRESS 0xFFF86670 /end MEASUREMENT
/begin MEASUREMENT t_minablvar_znd_ans "Gemessener Applikationswert fuer KL_TMINABLVAR_ZND_ANS" UWORD t_int_n_M_S7_S3 1 100 0 10 ECU_ADDRESS 0xFFF86672 /end MEASUREMENT
/begin MEASUREMENT t_minbed_znd_ans "Min. Verweilzeit in der Phase VM Zuenden ZND" UWORD t_int_n_M_S7_S3 1 100 0 10 ECU_ADDRESS 0xFFF86676 /end MEASUREMENT
/begin MEASUREMENT t_nvmausbed_ast_vma "Timer zur Erkennung VM aus als Uebergangsbedingung nach Uebergabe im Zustand Zustarten der Hybridfunktion VM aus" ULONG t_int_M_S7_S3 1 100 0 10 ECU_ADDRESS 0xFFF86074 /end MEASUREMENT
/begin MEASUREMENT t_nvmeinbed_zst_vme "Timer zur Erkennung VM laeuft als Uebergangsbedingung nach Uebergabe im Zustand Zustarten der Hybridfunktion VM ein" ULONG t_int_M_S7_S3 1 100 0 10 ECU_ADDRESS 0xFFF8607C /end MEASUREMENT
/begin MEASUREMENT t_schalt_mode_sak_ans "Maximale Wartezeit waehrend einer laufenden Schaltung zur Umschaltung der Schaltverhinderung" UWORD t_int_n_M_S7_S3 1 100 0 5 ECU_ADDRESS 0xFFF86682 /end MEASUREMENT
/begin MEASUREMENT t_statusiaeplaus_ans "Zeit zur Anfilterung fuer nicht erreichten 
IAE-Schlupf nd_iae bei 
status_iae_in = 4 (IAE entkoppelt)" UWORD t_int_n_M_S7_S3 1 100 0 5 ECU_ADDRESS 0xFFF86686 /end MEASUREMENT
/begin MEASUREMENT t_statuswechseliae_ans "Zeit, in der der der status_iae von OEFFNEN nach ENTKOPPELTwechseln muss." UWORD t_int_n_M_S7_S3 1 100 0 5 ECU_ADDRESS 0xFFF86688 /end MEASUREMENT
/begin MEASUREMENT v_f_in "" FLOAT32_IEEE v_fl_M_S7_S3 1 100 0 500 ECU_ADDRESS 0xFFF86274 /end MEASUREMENT
/begin MEASUREMENT v_f_ref_in "Fahrzeuggeschwindigkeit ueber Grund" UWORD v_int_M_S7_S3 1 100 0 511 ECU_ADDRESS 0xFFF86782 /end MEASUREMENT
/begin MEASUREMENT v_f_sbe "Fahrzeuggeschwindigkeit auf Basis der Getriebeabtriebsdrehzahl in der  Hybridablaufsteuerung" FLOAT32_IEEE v_fl_M_S7_S3 1 100 0 500 ECU_ADDRESS 0xFFF861E4 /end MEASUREMENT
/begin MEASUREMENT vg_f_sbe "Fahrzeuggeschwindigkeitsgradient auf Basis der Getriebeabtriebsdrehzahl in der  Hybridablaufsteuerung" FLOAT32_IEEE vg_fl_M_S7_S3 1 100 -100 100 ECU_ADDRESS 0xFFF861E8 /end MEASUREMENT
/begin MEASUREMENT z_ablauf_has_hst_in "" UBYTE sts_int_M_S7_S3 1 100 0 15 ECU_ADDRESS 0xFFF86CB8 /end MEASUREMENT
/begin MEASUREMENT z_ablauf_has_stg "Zusaetzliche Steuergroesse zur Ablaufsteuerung" UBYTE ctrl_int_M_S7_S3 1 100 0 15 ECU_ADDRESS 0xFFF86C57 /end MEASUREMENT
/begin MEASUREMENT z_ablauf_svh_reset_has_fkt "" UBYTE sts_int_M_S7_S3 1 100 0 255 ECU_ADDRESS 0xFFF86C5B /end MEASUREMENT
/begin MEASUREMENT z_ablaufreinit_frk_dihi "Zeigt an, dass der aktuelle HAS-Ablauf erneut begonnen werden soll" UBYTE sts_int_e_M_S7_S3 1 100 0 1 ECU_ADDRESS 0xFFF86C40 /end MEASUREMENT
/begin MEASUREMENT z_ablaufvariante_has_ans "Modifizierte Ablaufvariante, kommt eine ungueltige Ablaufvariante, dann wird der Altwert gehalten." UBYTE sts_int_M_S7_S3 1 100 0 255 ECU_ADDRESS 0xFFF86A8A /end MEASUREMENT
/begin MEASUREMENT z_ablaufvariante_has_hst_in "" UBYTE sts_int_M_S7_S3 1 100 0 99 ECU_ADDRESS 0xFFF86CB9 /end MEASUREMENT
/begin MEASUREMENT z_ablaufvariante_has_stg "Ablaufvariante, die  die OML ausgibt" UBYTE sts_int_M_S7_S3 1 100 0 99 ECU_ADDRESS 0xFFF86C58 /end MEASUREMENT
/begin MEASUREMENT z_ablaufvariante_kalt_zus "Anzeige der aktiven Ablaufvariante Kaltstart beim Zustart - 0 = kein Kaltstart, 1 = Kaltstart mit abgesenkter EM-Drehzahl" UBYTE st_int_M_S7_S3 1 100 0 255 ECU_ADDRESS 0xFFF86C5C /end MEASUREMENT
/begin MEASUREMENT z_ablaufvariante_sza_zus "Anzeige der aktiven Ablaufvariante Schneller Zustartablauf (SZA) beim Zustart" UBYTE sts_int_e_M_S7_S3 1 100 0 1 ECU_ADDRESS 0xFFF86B69 /end MEASUREMENT
/begin MEASUREMENT z_ala_frk_dihi "Zeigt an, dass die Anlasserstartanforderung der HAS aktiviert werden soll" UBYTE sts_int_e_M_S7_S3 1 100 0 1 ECU_ADDRESS 0xFFF86C41 /end MEASUREMENT
/begin MEASUREMENT z_ba_has_k0_hst_in "" UBYTE st_int_M_S7_S3 1 100 0 1 ECU_ADDRESS 0xFFF86CD2 /end MEASUREMENT
/begin MEASUREMENT z_ba_has_vm_hst_in "" UBYTE st_int_M_S7_S3 1 100 0 1 ECU_ADDRESS 0xFFF86CD3 /end MEASUREMENT
/begin MEASUREMENT z_deaktiv_abo_frk_dihi "Zeigt an, dass die ABO Funktion verlassen werden soll." UBYTE sts_int_e_M_S7_S3 1 100 0 1 ECU_ADDRESS 0xFFF86C42 /end MEASUREMENT
/begin MEASUREMENT z_diag_ersfkt_has_in "Funktionsschnittstelle zur Ermittlung ob irgendeine Ersatzmassnahme in der Diagnoseverwaltung aktiv ist" ULONG b_int_M_S7_S3 1 100 0 4294967295 ECU_ADDRESS 0xFFF86278 /end MEASUREMENT
/begin MEASUREMENT z_diag_ersfkt_hi_96_has_in "Anzeige ob Ersatzmassnahme in der Diagnoseverwaltung aktiv ist bit 64...95" ULONG b_int_M_S7_S3 1 100 0 4294967295 ECU_ADDRESS 0xFFF8627C /end MEASUREMENT
/begin MEASUREMENT z_diag_ersfkt_hi_has_in "Funktionsschnittstelle zur Ermittlung ob irgendeine Ersatzmassnahme in der Diagnoseverwaltung aktiv ist" ULONG b_int_M_S7_S3 1 100 0 4294967295 ECU_ADDRESS 0xFFF86280 /end MEASUREMENT
/begin MEASUREMENT z_diag_notgang_has_in "Notganginformation" UBYTE b_int_b_M_S7_S3 1 100 0 255 ECU_ADDRESS 0xFFF86CBA /end MEASUREMENT
/begin MEASUREMENT z_emaktiv_fuw_zus_fkt "Anzeige der EM Fehlfuntion der Funktionsueberwachung der EM beim Zustart" UBYTE b_int_h_M_S7_S3 1 100 0 1 ECU_ADDRESS 0xFFF86C5D /end MEASUREMENT
/begin MEASUREMENT z_emaktiv_nemfehler_fuw_zus "Anzeige des Ablaufs bei fehlerhafter oder ersetzter EM-Drehzahl der Funktionsueberwachung der EM-Funktion beim Zustart" UBYTE sts_int_e_M_S7_S3 1 100 0 1 ECU_ADDRESS 0xFFF86B6A /end MEASUREMENT
/begin MEASUREMENT z_emfehler_frk_dihi "Zeigt an, dass eine EM Fehlfunktion erkannt wurde, die in der HAS ausgewertet werden soll" UBYTE sts_int_e_M_S7_S3 1 100 0 1 ECU_ADDRESS 0xFFF86C43 /end MEASUREMENT
/begin MEASUREMENT z_fehler15_eh_fkt "" UBYTE st_int_M_S7_S3 1 100 0 1 ECU_ADDRESS 0xFFF86C5E /end MEASUREMENT
/begin MEASUREMENT z_freigabe_pvu_has_sbe "Freigabe zur Aktivierung der Diagnosefunktion \"Positionsventil-Ueberwachung\" der Funktion zur Unterstuetzung der Positi-onsventil-Ueberwachung der HAS" UBYTE st_int_M_S7_S3 1 100 0 1 ECU_ADDRESS 0xFFF86C71 /end MEASUREMENT
/begin MEASUREMENT z_fuwdeakt_frk_dihi "Zeigt an, dass die FUW-Funktion nicht aktiviert werden darf" UBYTE sts_int_e_M_S7_S3 1 100 0 1 ECU_ADDRESS 0xFFF86C44 /end MEASUREMENT
/begin MEASUREMENT z_gebruefahrenaus_frk_dihi "Erkennung Aufheben gebruecktes E Fahren" UBYTE sts_int_e_M_S7_S3 1 100 0 1 ECU_ADDRESS 0xFFF86C45 /end MEASUREMENT
/begin MEASUREMENT z_hybfkt_stg "Anforderung der Aktivierung einer Hybridfunktion durch die Hyrid-Zustandssteuerung" UBYTE E_HYBFKT_M_S7_S3 1 100 0 15 ECU_ADDRESS 0xFFF86C59 /end MEASUREMENT
/begin MEASUREMENT z_iae_entkmoeglich_ans "Zeigt an, ob eine Entkopplung bei status_iae_in = OEFFNEN moeglich ist" UBYTE void_int_d_M_S7_S3 1 100 0 1 ECU_ADDRESS 0xFFF86A8B /end MEASUREMENT
/begin MEASUREMENT z_iae_entkoppelt_ans "Zeigt an, ob eine Entkopplung fuer die Ausgabe der EM-Solldrehzahl vorliegt." UBYTE void_int_d_M_S7_S3 1 100 0 1 ECU_ADDRESS 0xFFF86A8C /end MEASUREMENT
/begin MEASUREMENT z_iae_entkstatusiaeoeffnen_ans "Zeigt an, ob eine Entkopplung bei status_iae in = 8 fuer die Ausgabe der EM-Solldrehzahl vorliegt." UBYTE void_int_d_M_S7_S3 1 100 0 1 ECU_ADDRESS 0xFFF86A8D /end MEASUREMENT
/begin MEASUREMENT z_iaeoeffnen_ans "Gemessen in Input-Steuersignale-status_iae_oeffnen" UBYTE void_int_d_M_S7_S3 1 100 0 1 ECU_ADDRESS 0xFFF86A8E /end MEASUREMENT
/begin MEASUREMENT z_iep_in "" UBYTE E_ZIEP_M_S7_S3 1 100 0 4 ECU_ADDRESS 0xFFF86CBB /end MEASUREMENT
/begin MEASUREMENT z_iepein_frk_dihi "Zeigt an, dass die IEP aktiviert werden soll, wenn ein EM-Drehzahl Signalfehler vorliegt, um die Oelversorgung weiterhin sicher zu stellen." UBYTE sts_int_e_M_S7_S3 1 100 0 1 ECU_ADDRESS 0xFFF86C46 /end MEASUREMENT
/begin MEASUREMENT z_init_sta "Anforderung der Initialisierung der Zustandssteuerung (OML) durch die Strategieanpassung" UBYTE sts_int_M_S7_S3 1 100 0 1 ECU_ADDRESS 0xFFF86C85 /end MEASUREMENT
/begin MEASUREMENT z_init_vma "" UBYTE st_int_M_S7_S3 1 100 0 1 ECU_ADDRESS 0xFFF86B5A /end MEASUREMENT
/begin MEASUREMENT z_init_vme "Initialisierung VME" UBYTE st_int_M_S7_S3 1 100 0 1 ECU_ADDRESS 0xFFF86B61 /end MEASUREMENT
/begin MEASUREMENT z_k0_befuellopt_has "Gemessen in Zustart/Output" UBYTE void_int_M_S7_S3 1 100 0 255 ECU_ADDRESS 0xFFF98424 /end MEASUREMENT
/begin MEASUREMENT z_k0_befuellopt_has_fkt "" UBYTE st_int_M_S7_S3 1 100 0 1 ECU_ADDRESS 0xFFF86C5F /end MEASUREMENT
/begin MEASUREMENT z_k0_befuellvariante_ans "Zeigt die angeforderte K0-Befuellvariante an" UBYTE void_int_M_S7_S3 1 100 0 255 ECU_ADDRESS 0xFFF86A8F /end MEASUREMENT
/begin MEASUREMENT z_k0_erk_ans "Erkennung K0-Befuellung zur Bestimmung der K0-Befuellvariante" UBYTE void_int_d_M_S7_S3 1 100 0 1 ECU_ADDRESS 0xFFF86A90 /end MEASUREMENT
/begin MEASUREMENT z_k0_fst_in "" UBYTE E_ZK0FSTIN_M_S7_S3 1 100 0 3 ECU_ADDRESS 0xFFF86CBC /end MEASUREMENT
/begin MEASUREMENT z_k0_has_fkt "" UBYTE E_ZK0_M_S7_S3 1 100 0 5 ECU_ADDRESS 0xFFF86C60 /end MEASUREMENT
/begin MEASUREMENT z_k0_has_sbe "K0 Sollzustand der Priorisierung der K0-Ansteuerung der HAS" UBYTE E_ZK0_M_S7_S3 1 100 0 5 ECU_ADDRESS 0xFFF86C75 /end MEASUREMENT
/begin MEASUREMENT z_k0entkaktiv_ans "Anzeige an, ob aus dem Ablauf heraus eine K0-Momentenabsenkung (K0-Entkoppelung) angefordert wird" UBYTE sts_int_e_M_S7_S3 1 100 0 1 ECU_ADDRESS 0xFFF86A91 /end MEASUREMENT
/begin MEASUREMENT z_k0sregaktiv_zus "Anforderung der Aktivierung der K0 Schlupfregelung beim Zustart" UBYTE sts_int_e_M_S7_S3 1 100 0 1 ECU_ADDRESS 0xFFF86B6B /end MEASUREMENT
/begin MEASUREMENT z_k0sregbasis_zus "Anzeige der Basisbedingung fuer die Anforderung der Aktivierung der K0 Schlupfregelung beim Zustart" UBYTE sts_int_e_M_S7_S3 1 100 0 1 ECU_ADDRESS 0xFFF86B6C /end MEASUREMENT
/begin MEASUREMENT z_k0syncmk0erh_frk_dihi "Zeigt an, dass eine K0-Zwangsynchronisation mittels Erhoehung des K0-Moments erfolgen soll" UBYTE sts_int_e_M_S7_S3 1 100 0 1 ECU_ADDRESS 0xFFF86C47 /end MEASUREMENT
/begin MEASUREMENT z_k0zuheiss_zus "Anzeige K0 zu heiss - Aktivierung der Massnahmen zur Verhinderung der K0-Ueberhitzung beim Zustart" UBYTE sts_int_e_M_S7_S3 1 100 0 1 ECU_ADDRESS 0xFFF86B6E /end MEASUREMENT
/begin MEASUREMENT z_kps_stada_in "Sollvorgabe fuer die Trennkupplung K0 durch die Stillstandsadaption" UBYTE sts_int_M_S7_S3 1 100 0 255 ECU_ADDRESS 0xFFF86CBD /end MEASUREMENT
/begin MEASUREMENT z_lls_fktaktiv_has_sbe "Aktive LLS-Funktion - Codierung bit0=STAT,1=IEP,2=CGETR,3=BEFFZP,4=GE,5=KFL,6=PAUS,7=PARKSP,8=RANG,9=MANH,10=IAE,11=SAS,12=KRI,13=DAT,14=IAEADA,15=K0ADA,16=STADA,17-18=frei,19=FKT,20=BZ,21-22=frei,23=VGF,24=ALAE,25-26=frei,27=PVU,28-30=frei,31=DIAG" ULONG sts_int_m_M_S7_S3 1 100 0 4294967295 ECU_ADDRESS 0xFFF86208 /end MEASUREMENT
/begin MEASUREMENT z_m_max_iae_ablvar_ans "Gemessen in St_Konditionieren_En_St" UBYTE void_int_d_M_S7_S3 1 100 0 1 ECU_ADDRESS 0xFFF86A94 /end MEASUREMENT
/begin MEASUREMENT z_m_max_iae_has_fkt "" UBYTE st_int_M_S7_S3 1 100 0 50 ECU_ADDRESS 0xFFF86C61 /end MEASUREMENT
/begin MEASUREMENT z_m_max_iae_has_in "Gemessen in St_Konditionieren_En_St" UBYTE void_int_d_M_S7_S3 1 100 0 1 ECU_ADDRESS 0xFFF86A95 /end MEASUREMENT
/begin MEASUREMENT z_m_max_stiae_has "Gemessen in St_Konditionieren_En_St" UBYTE void_int_d_M_S7_S3 1 100 0 1 ECU_ADDRESS 0xFFF86A96 /end MEASUREMENT
/begin MEASUREMENT z_m_soll_em_has_fkt "" UBYTE st_int_l_M_S7_S3 1 100 0 1 ECU_ADDRESS 0xFFF86C62 /end MEASUREMENT
/begin MEASUREMENT z_mmaxiaeoeffnen_ans "Zeigt an, ob die Momentenbedingung bei der Entkopplung mit dem status_iae_in = OEFFNEN erfuellt ist." UBYTE void_int_d_M_S7_S3 1 100 0 1 ECU_ADDRESS 0xFFF86A97 /end MEASUREMENT
/begin MEASUREMENT z_modus_em_hst_in "" UBYTE sts_int_M_S7_S3 1 100 0 255 ECU_ADDRESS 0xFFF86CBE /end MEASUREMENT
/begin MEASUREMENT z_modus_iae_has_sbe "" UBYTE E_ZMODUSIAE_M_S7_S3 1 100 0 2 ECU_ADDRESS 0xFFF86C76 /end MEASUREMENT
/begin MEASUREMENT z_modus_iep_has_sbe "Vorgabe des Betriebsmodus der IEP durch die HAS" UBYTE E_ZMODUSIEP_M_S7_S3 1 100 0 4 ECU_ADDRESS 0xFFF86C77 /end MEASUREMENT
/begin MEASUREMENT z_msa_avh_moni_has_sbe "Anforderung einer Schaltverhinderung der HAS" UBYTE st_int_M_S7_S3 1 100 0 255 ECU_ADDRESS 0xFFF86C78 /end MEASUREMENT
/begin MEASUREMENT z_msa_eaf_moni_has_sbe "Anforderung einer Schaltverhinderung der HAS" UBYTE st_int_M_S7_S3 1 100 0 255 ECU_ADDRESS 0xFFF86C79 /end MEASUREMENT
/begin MEASUREMENT z_msa_fst_in "Anforderung einer Abschaltverhinderung durch die Fahrstrategie ASIS" UBYTE sts_int_M_S7_S3 1 100 0 255 ECU_ADDRESS 0xFFF86CBF /end MEASUREMENT
/begin MEASUREMENT z_msa_has_sbe "Anforderung der Beeinflussung der MSA-Funktionalitaet durch die Hybridablaufsteuerung - Codierung: bit0 = AVZ, bit1 = AVH, bit2 = EAF, bit3 = EVH, bit4 = Deaktivierung, bit7 = Stoerungsbedingt" UBYTE sts_int_M_S7_S3 1 100 0 255 ECU_ADDRESS 0xFFF86C7A /end MEASUREMENT
/begin MEASUREMENT z_msa_stada_in "Anforderung einer Abschaltverhinderung durch die Stillstandadaption" UBYTE sts_int_M_S7_S3 1 100 0 6 ECU_ADDRESS 0xFFF86CD4 /end MEASUREMENT
/begin MEASUREMENT z_n_min_em_parksp_has_in "Anforderung einer EM-Drehzahlanhebung beim Auslegen der Parksperre infolge unzureichender Oelversorgung" UBYTE b_int_b_M_S7_S3 1 100 0 1 ECU_ADDRESS 0xFFF86CC0 /end MEASUREMENT
/begin MEASUREMENT z_n_soll_em_anf_ans "Flag, ueber das die EM-Solldrehzahl angefordert wird." UBYTE void_int_d_M_S7_S3 1 100 0 1 ECU_ADDRESS 0xFFF86A99 /end MEASUREMENT
/begin MEASUREMENT z_n_soll_em_has_fkt "" UBYTE st_int_M_S7_S3 1 100 0 50 ECU_ADDRESS 0xFFF86C63 /end MEASUREMENT
/begin MEASUREMENT z_n_soll_vm_has_fkt "" UBYTE st_int_M_S7_S3 1 100 0 50 ECU_ADDRESS 0xFFF86C64 /end MEASUREMENT
/begin MEASUREMENT z_nemmin_frk_dihi "Zeigt an, dass die EM Leerlauf angehoben werden soll." UBYTE sts_int_e_M_S7_S3 1 100 0 1 ECU_ADDRESS 0xFFF86C48 /end MEASUREMENT
/begin MEASUREMENT z_nllsoll_iae_in "Anforderung der IAE, dass eine definierte LL-Drehzahl durch den Motor eingestellt werden soll" UBYTE E_ZNLLSOLL_M_S7_S3 1 100 0 3 ECU_ADDRESS 0xFFF86CC1 /end MEASUREMENT
/begin MEASUREMENT z_nllsoll_iep_in "" UBYTE void_int_d_M_S7_S3 1 100 0 1 ECU_ADDRESS 0xFFF86CC2 /end MEASUREMENT
/begin MEASUREMENT z_nminemmodus_has_sbe "Modus der Vorgabe der minimalen EM-Drehzahl der HAS" UBYTE E_ZNMODUS_M_S7_S3 1 100 0 4 ECU_ADDRESS 0xFFF86C7B /end MEASUREMENT
/begin MEASUREMENT z_nminemnull_frk_dihi "Zeigt an, dass die Ausgabe der minimalen EM Drehzahl der HAS unterdrueckt werden soll." UBYTE sts_int_e_M_S7_S3 1 100 0 1 ECU_ADDRESS 0xFFF86C49 /end MEASUREMENT
/begin MEASUREMENT z_nsollvmaktiv_ans "Anzeige an, ob aus dem Ablauf heraus eine VM-Solldrehzahl angefordert wird" UBYTE sts_int_e_M_S7_S3 1 100 0 1 ECU_ADDRESS 0xFFF86A9C /end MEASUREMENT
/begin MEASUREMENT z_nsollvmanh_frk_dihi "Zeigt an, dass die VM-Solldrehzahl waehrend eines Start-Ablaufs angehoben werden soll" UBYTE sts_int_e_M_S7_S3 1 100 0 1 ECU_ADDRESS 0xFFF86C4A /end MEASUREMENT
/begin MEASUREMENT z_nsollvmnull_frk_dihi "Zeigt an, dass die VM-Solldrehzahl Vorgabe unterbunden werden soll" UBYTE sts_int_e_M_S7_S3 1 100 0 1 ECU_ADDRESS 0xFFF86C4B /end MEASUREMENT
/begin MEASUREMENT z_nvmsollbegr_frk_dihi "Zeigt an, dass die VM-Solldrehzahl auf die EM-Istdrehzahl be-grenzt werden soll" UBYTE sts_int_e_M_S7_S3 1 100 0 1 ECU_ADDRESS 0xFFF86C4C /end MEASUREMENT
/begin MEASUREMENT z_oea_hst_in "Anforderung fuer das gebrueckte E-Anfahren der HST" UBYTE sts_int_M_S7_S3 1 100 0 1 ECU_ADDRESS 0xFFF86CC3 /end MEASUREMENT
/begin MEASUREMENT z_p_hys_k0_has_fkt "Hysteresekompensation" UBYTE st_int_M_S7_S3 1 100 0 1 ECU_ADDRESS 0xFFF86C65 /end MEASUREMENT
/begin MEASUREMENT z_ponr_fkt "point of no return" UBYTE st_int_M_S7_S3 1 100 0 1 ECU_ADDRESS 0xFFF86C66 /end MEASUREMENT
/begin MEASUREMENT z_pvu_has_sbe "Beeinflussung des Hybridsystems zur Unterstuetzung der Positionsventil- Ueberwachung der HAS-Codierung: 0 = keine Beeinflussung, 1 = Beeinflussung Stufe 1, 2 = Beeinflussung Stufe 2" UBYTE st_int_M_S7_S3 1 100 0 2 ECU_ADDRESS 0xFFF86C72 /end MEASUREMENT
/begin MEASUREMENT z_respschlepp_sas_fkt "" UBYTE st_int_M_S7_S3 1 100 0 1 ECU_ADDRESS 0xFFF86C67 /end MEASUREMENT
/begin MEASUREMENT z_saf_has_fkt "Schaltanforderung 1...aktiv" UBYTE st_int_M_S7_S3 1 100 0 1 ECU_ADDRESS 0xFFF86C68 /end MEASUREMENT
/begin MEASUREMENT z_sas_has_sbe "Aendert im Wahrheitsfall die KupplungsBefuellreihenfolge" UBYTE st_int_M_S7_S3 1 100 0 1 ECU_ADDRESS 0xFFF86C7C /end MEASUREMENT
/begin MEASUREMENT z_sbe_has_fkt "Schaltbeeinflussung  1...aktiv" UBYTE st_int_M_S7_S3 1 100 0 1 ECU_ADDRESS 0xFFF86C69 /end MEASUREMENT
/begin MEASUREMENT z_schaltprioverh_frk_dihi "Zeigt an, dass die Schaltungspriorisierung bei einem Zustart-Ablauf  uterbunden werden soll" UBYTE sts_int_e_M_S7_S3 1 100 0 1 ECU_ADDRESS 0xFFF86C4D /end MEASUREMENT
/begin MEASUREMENT z_schwingungsyncerk_syn_zus "Anzeige einer Antriebsstrangschwingung bei geschlossener K0 zur Erkennung Synchron beim K0-Synchronisieren beim Zustart" UBYTE sts_int_e_M_S7_S3 1 100 0 1 ECU_ADDRESS 0xFFF86B71 /end MEASUREMENT
/begin MEASUREMENT z_start_modus_has_sbe "Anforderung eines Anlasserstarts" UBYTE st_int_M_S7_S3 1 100 0 3 ECU_ADDRESS 0xFFF86C7D /end MEASUREMENT
/begin MEASUREMENT z_status_psys_mps_sbe "Anforderung der Modifikation des Pumpendruckstatus durch die Hybrid Ablaufsteuerung (MPS)" UBYTE sts_int_M_S7_S3 1 100 0 1 ECU_ADDRESS 0xFFF86C7E /end MEASUREMENT
/begin MEASUREMENT z_statuspsysmps_frk_dihi "Zeigt an, dass der Pumpendruck-Status der ATSYS modifiziert werden soll" UBYTE sts_int_e_M_S7_S3 1 100 0 1 ECU_ADDRESS 0xFFF86C4E /end MEASUREMENT
/begin MEASUREMENT z_svh_frk_dihi "Zeigt an, dass die Schaltverhinderung (SVH) aktiviert werden soll" UBYTE sts_int_e_M_S7_S3 1 100 0 1 ECU_ADDRESS 0xFFF86C4F /end MEASUREMENT
/begin MEASUREMENT z_svh_has_sbe "Anforderung einer Schaltverhinderung der HAS" UBYTE st_int_M_S7_S3 1 100 0 1 ECU_ADDRESS 0xFFF86C7F /end MEASUREMENT
/begin MEASUREMENT z_svh_palaus_sak_zus "Anzeige der Schaltart der zum Rest des Zustart-Ablaufs parallel laufenden Schaltungen im Zustand Schaltung aktiv beim Zustart -> Bit-Codierung wie z_ablauf_shv_reset_has" UBYTE b_int_b_M_S7_S3 1 100 0 255 ECU_ADDRESS 0xFFF86B73 /end MEASUREMENT
/begin MEASUREMENT z_svh_reset_zustand_zus "Anzeige der Schaltart der in den einzelnen Zustaenden des Zustart-Ablaufs freigegebenen Schaltungen beim Zustart -> Bit-Codierung wie z_ablauf_shv_reset_has" UBYTE b_int_b_M_S7_S3 1 100 0 255 ECU_ADDRESS 0xFFF86B75 /end MEASUREMENT
/begin MEASUREMENT z_syncdda_zus "Anzeige der Aktivierung der Beeinflussung der K0-Synchronisation bei durchdrehenden Antriebsraedern beim Zustart" UBYTE sts_int_e_M_S7_S3 1 100 0 1 ECU_ADDRESS 0xFFF86B76 /end MEASUREMENT
/begin MEASUREMENT z_t_iaeentkstatusiaeoeffnen_ans "Status Timer fuer Wartezeit - status_iae 8 in Verbindung mit Entkopplungsversuch" UBYTE void_int_d_M_S7_S3 1 100 0 1 ECU_ADDRESS 0xFFF86A7E /end MEASUREMENT
/begin MEASUREMENT z_t_maxiaeoeffnen_ans "Zustand Maxtimer IAE oeffnen" UBYTE void_int_d_M_S7_S3 1 100 0 1 ECU_ADDRESS 0xFFF86AA4 /end MEASUREMENT
/begin MEASUREMENT z_t_nvmausbed_ast_vma "Timerflag zur Erkennung VM aus als Uebergangsbedingung nach Uebergabe im Zustand Zustarten der Hybridfunktion VM aus" UBYTE st_int_l_M_S7_S3 1 100 0 1 ECU_ADDRESS 0xFFF86B5B /end MEASUREMENT
/begin MEASUREMENT z_t_nvmeinbed_zst_vme "Timerflag zur Erkennung VM leauft als Uebergangsbedingung nach Uebergabe im Zustand Zustarten der Hybridfunktion VM ein" UBYTE st_int_l_M_S7_S3 1 100 0 1 ECU_ADDRESS 0xFFF86B62 /end MEASUREMENT
/begin MEASUREMENT z_uvs_zus "Anzeige der Phase der K0-Unterstuetzung des VM Startsystems (UVS) beim Zustart" UBYTE E_ZUVSZUS_M_S7_S3 1 100 0 3 ECU_ADDRESS 0xFFF86B77 /end MEASUREMENT
/begin MEASUREMENT z_vmstartanf_frk_dihi "Zeigt an, dass der VM gestartet werden soll." UBYTE sts_int_e_M_S7_S3 1 100 0 1 ECU_ADDRESS 0xFFF86C50 /end MEASUREMENT
/begin MEASUREMENT z_vmstartverbot_frk_dihi "Zeigt an, dass der VM nicht gestartet werden darf." UBYTE sts_int_e_M_S7_S3 1 100 0 1 ECU_ADDRESS 0xFFF86C51 /end MEASUREMENT
/begin MEASUREMENT z_vmstopverbot_frk_dihi "Zeigt an, dass der VM nicht gestoppt werden darf." UBYTE sts_int_e_M_S7_S3 1 100 0 1 ECU_ADDRESS 0xFFF86C52 /end MEASUREMENT
/begin MEASUREMENT z_zuendfreigabe_vm_fkt "" UBYTE st_int_M_S7_S3 1 100 0 1 ECU_ADDRESS 0xFFF86C6A /end MEASUREMENT
/begin MEASUREMENT z_zuendfreigabe_vm_has_fkt "" UBYTE st_int_M_S7_S3 1 100 0 1 ECU_ADDRESS 0xFFF86C6B /end MEASUREMENT
/begin MEASUREMENT z_zust_halten_frk_dihi "Zeigt an, ob der Betriebszustand \"HAS Zustand halten\" aktiv sein soll." UBYTE sts_int_e_M_S7_S3 1 100 0 1 ECU_ADDRESS 0xFFF86C53 /end MEASUREMENT
/begin MEASUREMENT z_zust_init_frk_dihi "Zeigt an, ob der Betriebszustand \"HAS Zustand Init\" aktiv sein soll." UBYTE sts_int_e_M_S7_S3 1 100 0 1 ECU_ADDRESS 0xFFF86C54 /end MEASUREMENT
/begin MEASUREMENT zielgang_egs_in "" SBYTE sts_int_M_S7_S3 1 100 -128 127 ECU_ADDRESS 0xFFF86CC4 /end MEASUREMENT
/begin COMPU_METHOD SAB_L_KM10_S2_S3 "int = ((phys * 10) / 1) - (0) km" RAT_FUNC "%5.3" "km" COEFFS 0 10 -0 0 0 1 /end COMPU_METHOD
/begin COMPU_METHOD SAB_L_M512_S2_S3 "int = ((phys * 512) / 1) - (0) km" RAT_FUNC "%5.3" "km" COEFFS 0 512 -0 0 0 1 /end COMPU_METHOD
/begin COMPU_METHOD SAB_T_1MS_S2_S3 "int = ((phys * 1) / 1) - (0) ms" RAT_FUNC "%2.0" "ms" COEFFS 0 1 -0 0 0 1 /end COMPU_METHOD
/begin COMPU_METHOD SAB_T_14S_S2_S3 "int = ((phys * 1) / 14) - (0) s" RAT_FUNC "%5.3" "s" COEFFS 0 1 -0 0 0 14 /end COMPU_METHOD
/begin COMPU_METHOD SAB_T_15S_S2_S3 "int = ((phys * 1) / 15) - (0) s" RAT_FUNC "%5.3" "s" COEFFS 0 1 -0 0 0 15 /end COMPU_METHOD
/begin COMPU_METHOD SAB_T_4S_S2_S3 "int = ((phys * 1) / 4) - (0) s" RAT_FUNC "%5.3" "s" COEFFS 0 1 -0 0 0 4 /end COMPU_METHOD
/begin COMPU_METHOD SAB_T_US10_S2_S3 "int = ((phys * 10) / 1) - (0) us" RAT_FUNC "%5.3" "us" COEFFS 0 10 -0 0 0 1 /end COMPU_METHOD
/begin COMPU_METHOD SAB_T_US_S2_S3 "int = ((phys * 1) / 1) - (0) us" RAT_FUNC "%2.0" "us" COEFFS 0 1 -0 0 0 1 /end COMPU_METHOD
/begin COMPU_METHOD SAB_M_NM16_M2048_S2_S3 "int = ((phys * 16) / 1) - (-32768) Nm" RAT_FUNC "%5.3" "Nm" COEFFS 0 16 32768 0 0 1 /end COMPU_METHOD
/begin COMPU_METHOD SAB_M_NM16_S2_S3 "int = ((phys * 16) / 1) - (0) Nm" RAT_FUNC "%5.3" "Nm" COEFFS 0 16 -0 0 0 1 /end COMPU_METHOD
/begin COMPU_METHOD b_int_M_S7_S3 "Bit Feld" RAT_FUNC "%10.0" "-" COEFFS 0 1 0 0 0 1 /end COMPU_METHOD
/begin COMPU_METHOD b_int_b_M_S7_S3 "Bit Feld" RAT_FUNC "%3.0" "-" COEFFS 0 1 0 0 0 1 /end COMPU_METHOD
/begin COMPU_METHOD b_int_h_M_S7_S3 "Bit Feld" RAT_FUNC "%1.0" "-" COEFFS 0 1 0 0 0 1 /end COMPU_METHOD
/begin COMPU_METHOD c_fl_M_S7_S3 "Temperatur" RAT_FUNC "%12.6" "°C" COEFFS 0 1 0 0 0 1 /end COMPU_METHOD
/begin COMPU_METHOD c_int_M_S7_S3 "Temperatur" RAT_FUNC "%12.6" "°C" COEFFS 0 1 0 0 0 1 /end COMPU_METHOD
/begin COMPU_METHOD ctrl_int_M_S7_S3 "Steuerwort" RAT_FUNC "%3.0" "-" COEFFS 0 1 0 0 0 1 /end COMPU_METHOD
/begin COMPU_METHOD E_BREMSPED_M_S7_S3 "" TAB_VERB "%12.6" "" COMPU_TAB_REF CONV_TAB_E_BREMSPED_M_S7_S3 /end COMPU_METHOD
/begin COMPU_METHOD E_DREHRICH_M_S7_S3 "" TAB_VERB "%12.6" "" COMPU_TAB_REF CONV_TAB_E_DREHRICH_M_S7_S3 /end COMPU_METHOD
/begin COMPU_METHOD E_FEHLERIEP_M_S7_S3 "" TAB_VERB "%12.6" "" COMPU_TAB_REF CONV_TAB_E_FEHLERIEP_M_S7_S3 /end COMPU_METHOD
/begin COMPU_METHOD E_HYBFKT_M_S7_S3 "" TAB_VERB "%12.6" "" COMPU_TAB_REF CONV_TAB_E_HYBFKT_M_S7_S3 /end COMPU_METHOD
/begin COMPU_METHOD E_MODUSEFAH_M_S7_S3 "" TAB_VERB "%12.6" "" COMPU_TAB_REF CONV_TAB_E_MODUSEFAH_M_S7_S3 /end COMPU_METHOD
/begin COMPU_METHOD E_POS_M_S7_S3 "" TAB_VERB "%12.6" "" COMPU_TAB_REF CONV_TAB_E_POS_M_S7_S3 /end COMPU_METHOD
/begin COMPU_METHOD E_SIGSTATUS_M_S7_S3 "" TAB_VERB "%12.6" "" COMPU_TAB_REF CONV_TAB_E_SIGSTATUS_M_S7_S3 /end COMPU_METHOD
/begin COMPU_METHOD E_STAK0BEF_M_S7_S3 "" TAB_VERB "%12.6" "" COMPU_TAB_REF CONV_TAB_E_STAK0BEF_M_S7_S3 /end COMPU_METHOD
/begin COMPU_METHOD E_STATUSABS_M_S7_S3 "" TAB_VERB "%12.6" "" COMPU_TAB_REF CONV_TAB_E_STATUSABS_M_S7_S3 /end COMPU_METHOD
/begin COMPU_METHOD E_STATUSADA_M_S7_S3 "" TAB_VERB "%12.6" "" COMPU_TAB_REF CONV_TAB_E_STATUSADA_M_S7_S3 /end COMPU_METHOD
/begin COMPU_METHOD E_STATUSASR_M_S7_S3 "" TAB_VERB "%12.6" "" COMPU_TAB_REF CONV_TAB_E_STATUSASR_M_S7_S3 /end COMPU_METHOD
/begin COMPU_METHOD E_STATUSCK0_M_S7_S3 "" TAB_VERB "%12.6" "" COMPU_TAB_REF CONV_TAB_E_STATUSCK0_M_S7_S3 /end COMPU_METHOD
/begin COMPU_METHOD E_STATUSIAE_M_S7_S3 "" TAB_VERB "%12.6" "" COMPU_TAB_REF CONV_TAB_E_STATUSIAE_M_S7_S3 /end COMPU_METHOD
/begin COMPU_METHOD E_STATUSIEP_M_S7_S3 "" TAB_VERB "%12.6" "" COMPU_TAB_REF CONV_TAB_E_STATUSIEP_M_S7_S3 /end COMPU_METHOD
/begin COMPU_METHOD E_STATUSK0_M_S7_S3 "" TAB_VERB "%12.6" "" COMPU_TAB_REF CONV_TAB_E_STATUSK0_M_S7_S3 /end COMPU_METHOD
/begin COMPU_METHOD E_STATUSKSL_M_S7_S3 "" TAB_VERB "%12.6" "" COMPU_TAB_REF CONV_TAB_E_STATUSKSL_M_S7_S3 /end COMPU_METHOD
/begin COMPU_METHOD E_STATUSNAA_M_S7_S3 "" TAB_VERB "%12.6" "" COMPU_TAB_REF CONV_TAB_E_STATUSNAA_M_S7_S3 /end COMPU_METHOD
/begin COMPU_METHOD E_STATUSPSY_M_S7_S3 "" TAB_VERB "%12.6" "" COMPU_TAB_REF CONV_TAB_E_STATUSPSY_M_S7_S3 /end COMPU_METHOD
/begin COMPU_METHOD E_STATUSRSE_M_S7_S3 "" TAB_VERB "%12.6" "" COMPU_TAB_REF CONV_TAB_E_STATUSRSE_M_S7_S3 /end COMPU_METHOD
/begin COMPU_METHOD E_STBZHAS_M_S7_S3 "" TAB_VERB "%12.6" "" COMPU_TAB_REF CONV_TAB_E_STBZHAS_M_S7_S3 /end COMPU_METHOD
/begin COMPU_METHOD E_ZIEP_M_S7_S3 "" TAB_VERB "%12.6" "" COMPU_TAB_REF CONV_TAB_E_ZIEP_M_S7_S3 /end COMPU_METHOD
/begin COMPU_METHOD E_ZK0_M_S7_S3 "" TAB_VERB "%12.6" "" COMPU_TAB_REF CONV_TAB_E_ZK0_M_S7_S3 /end COMPU_METHOD
/begin COMPU_METHOD E_ZK0FSTIN_M_S7_S3 "" TAB_VERB "%12.6" "" COMPU_TAB_REF CONV_TAB_E_ZK0FSTIN_M_S7_S3 /end COMPU_METHOD
/begin COMPU_METHOD E_ZMODUSIAE_M_S7_S3 "" TAB_VERB "%12.6" "" COMPU_TAB_REF CONV_TAB_E_ZMODUSIAE_M_S7_S3 /end COMPU_METHOD
/begin COMPU_METHOD E_ZMODUSIEP_M_S7_S3 "" TAB_VERB "%12.6" "" COMPU_TAB_REF CONV_TAB_E_ZMODUSIEP_M_S7_S3 /end COMPU_METHOD
/begin COMPU_METHOD E_ZNLLSOLL_M_S7_S3 "" TAB_VERB "%12.6" "" COMPU_TAB_REF CONV_TAB_E_ZNLLSOLL_M_S7_S3 /end COMPU_METHOD
/begin COMPU_METHOD E_ZNMODUS_M_S7_S3 "" TAB_VERB "%12.6" "" COMPU_TAB_REF CONV_TAB_E_ZNMODUS_M_S7_S3 /end COMPU_METHOD
/begin COMPU_METHOD E_ZUVSZUS_M_S7_S3 "" TAB_VERB "%12.6" "" COMPU_TAB_REF CONV_TAB_E_ZUVSZUS_M_S7_S3 /end COMPU_METHOD
/begin COMPU_METHOD n_fl_M_S7_S3 "Drehzahl" RAT_FUNC "%12.6" "1/min" COEFFS 0 1 0 0 0 1 /end COMPU_METHOD
/begin COMPU_METHOD ng_fl_M_S7_S3 "Drehzahlgradient" RAT_FUNC "%12.6" "1/min/s" COEFFS 0 1 0 0 0 1 /end COMPU_METHOD
/begin COMPU_METHOD p_fl_M_S7_S3 "Druck" RAT_FUNC "%12.6" "bar" COEFFS 0 1 0 0 0 1 /end COMPU_METHOD
/begin COMPU_METHOD phi_fl_M_S7_S3 "Winkel in rad" RAT_FUNC "%12.6" "rad" COEFFS 0 1 0 0 0 1 /end COMPU_METHOD
/begin COMPU_METHOD phigrad_fl_M_S7_S3 "Winkel in grad" RAT_FUNC "%12.6" "grad" COEFFS 0 1 0 0 0 1 /end COMPU_METHOD
/begin COMPU_METHOD ratio_fl_M_S7_S3 "Uebersetzungsverhaeltnis" RAT_FUNC "%12.6" "-" COEFFS 0 1 0 0 0 1 /end COMPU_METHOD
/begin COMPU_METHOD rel_int_M_S7_S3 "Relative Groesse" RAT_FUNC "%3.0" "%" COEFFS 0 1 0 0 0 1 /end COMPU_METHOD
/begin COMPU_METHOD st_int_M_S7_S3 "Zustandsgroesse" RAT_FUNC "%3.0" "-" COEFFS 0 1 0 0 0 1 /end COMPU_METHOD
/begin COMPU_METHOD st_int_g_M_S7_S3 "Zustandsgroesse" RAT_FUNC "%5.0" "-" COEFFS 0 1 0 0 0 1 /end COMPU_METHOD
/begin COMPU_METHOD st_int_l_M_S7_S3 "Zustandsgroesse" RAT_FUNC "%1.0" "-" COEFFS 0 1 0 0 0 1 /end COMPU_METHOD
/begin COMPU_METHOD sts_fl_M_S7_S3 "Status" RAT_FUNC "%12.6" "-" COEFFS 0 1 0 0 0 1 /end COMPU_METHOD
/begin COMPU_METHOD sts_int_M_S7_S3 "Status" RAT_FUNC "%3.0" "-" COEFFS 0 1 0 0 0 1 /end COMPU_METHOD
/begin COMPU_METHOD sts_int_e_M_S7_S3 "Status" RAT_FUNC "%1.0" "-" COEFFS 0 1 0 0 0 1 /end COMPU_METHOD
/begin COMPU_METHOD sts_int_m_M_S7_S3 "Status" RAT_FUNC "%10.0" "-" COEFFS 0 1 0 0 0 1 /end COMPU_METHOD
/begin COMPU_METHOD sts_int_r_M_S7_S3 "Status" RAT_FUNC "%12.6" "-" COEFFS 0 1 0 0 0 1 /end COMPU_METHOD
/begin COMPU_METHOD swi_int_M_S7_S3 "Schalter" RAT_FUNC "%1.0" "-" COEFFS 0 1 0 0 0 1 /end COMPU_METHOD
/begin COMPU_METHOD t_fl_M_S7_S3 "Zeit" RAT_FUNC "%12.6" "s" COEFFS 0 1 0 0 0 1 /end COMPU_METHOD
/begin COMPU_METHOD t_int_M_S7_S3 "Zeit" RAT_FUNC "%11.2" "s" COEFFS 0 1 0 0 0 0.01 /end COMPU_METHOD
/begin COMPU_METHOD t_int_n_M_S7_S3 "Zeit" RAT_FUNC "%6.2" "s" COEFFS 0 1 0 0 0 0.01 /end COMPU_METHOD
/begin COMPU_METHOD trq_fl_a_M_S7_S3 "Moment" RAT_FUNC "%12.6" "Nm" COEFFS 0 1 0 0 0 1 /end COMPU_METHOD
/begin COMPU_METHOD trqg_fl_k_M_S7_S3 "Momentengradient" RAT_FUNC "%12.6" "Nm/s" COEFFS 0 1 0 0 0 1 /end COMPU_METHOD
/begin COMPU_METHOD v_fl_M_S7_S3 "Geschwindigkeit" RAT_FUNC "%12.6" "km/h" COEFFS 0 1 0 0 0 1 /end COMPU_METHOD
/begin COMPU_METHOD v_int_M_S7_S3 "Geschwindigkeit" RAT_FUNC "%5.0" "km/h" COEFFS 0 1 0 0 0 1 /end COMPU_METHOD
/begin COMPU_METHOD vg_fl_M_S7_S3 "Geschwindigkeitsgradient" RAT_FUNC "%12.6" "km/h/s" COEFFS 0 1 0 0 0 1 /end COMPU_METHOD
/begin COMPU_METHOD void_fl_M_S7_S3 "ohne Umrechnung" RAT_FUNC "%12.6" "-" COEFFS 0 1 0 0 0 1 /end COMPU_METHOD
/begin COMPU_METHOD void_int_M_S7_S3 "ohne Umrechnung" RAT_FUNC "%3.0" "-" COEFFS 0 1 0 0 0 1 /end COMPU_METHOD
/begin COMPU_METHOD void_int_c_M_S7_S3 "ohne Umrechnung" RAT_FUNC "%5.0" "-" COEFFS 0 1 0 0 0 1 /end COMPU_METHOD
/begin COMPU_METHOD void_int_d_M_S7_S3 "ohne Umrechnung" RAT_FUNC "%1.0" "-" COEFFS 0 1 0 0 0 1 /end COMPU_METHOD
/begin COMPU_METHOD void_int_q_M_S7_S3 "ohne Umrechnung" RAT_FUNC "%12.6" "-" COEFFS 0 1 0 0 0 1 /end COMPU_METHOD
/begin COMPU_METHOD VOID_SCALING_M_S7_S3 "Void scaling for unscaled variables" RAT_FUNC "%12.6" "" COEFFS 0 1 0 0 0 1 /end COMPU_METHOD
/begin COMPU_VTAB CONV_TAB_E_BREMSPED_M_S7_S3 "Conversion table" TAB_VERB 2 0 "NICHT_GETRETEN" 1 "GETRETEN" /end COMPU_VTAB
/begin COMPU_VTAB CONV_TAB_E_DREHRICH_M_S7_S3 "Conversion table" TAB_VERB 3 0 "UNBESTIMMT" 1 "VORWAERTS" 2 "RUECKWAERTS" /end COMPU_VTAB
/begin COMPU_VTAB CONV_TAB_E_FEHLERIEP_M_S7_S3 "Conversion table" TAB_VERB 2 0 "NORMALBETRIEB" 1 "FEHLER" /end COMPU_VTAB
/begin COMPU_VTAB CONV_TAB_E_HYBFKT_M_S7_S3 "Conversion table" TAB_VERB 14 0 "PASSIV" 1 "ANKOPPELN_VM" 3 "GANGEINLEGEN" 4 "GANGAUSLEGEN" 5 "OHNABLAUFFKT" 7 "VM_ZUSTART" 8 "ABSTELLEN_VM" 9 "NICHTDEFINIERT_4" 10 "VM_SCHLEPPSTART" 11 "VM_NOTSTART" 12 "VM_EIN" 13 "VM_AUS" 14 "ABSTELLPOSOPT_VM" 15 "FEHLER" /end COMPU_VTAB
/begin COMPU_VTAB CONV_TAB_E_MODUSEFAH_M_S7_S3 "Conversion table" TAB_VERB 2 0 "LADUNG_ABBAUEN" 1 "LADUNG_ERHALTEN" /end COMPU_VTAB
/begin COMPU_VTAB CONV_TAB_E_POS_M_S7_S3 "Conversion table" TAB_VERB 9 0 "D1" 1 "D2" 2 "D3" 3 "D4" 4 "D5" 5 "D" 6 "N" 7 "R" 8 "P" /end COMPU_VTAB
/begin COMPU_VTAB CONV_TAB_E_SIGSTATUS_M_S7_S3 "Conversion table" TAB_VERB 3 0 "SIGNAL_OK" 1 "ERSATZWERT" 2 "SIGNAL_FEHLER" /end COMPU_VTAB
/begin COMPU_VTAB CONV_TAB_E_STAK0BEF_M_S7_S3 "Conversion table" TAB_VERB 4 0 "NICHT_AKTIV" 1 "STANDARD_BEF" 2 "OPTIMIERTBEF" 3 "REDUZIERTBEF" /end COMPU_VTAB
/begin COMPU_VTAB CONV_TAB_E_STATUSABS_M_S7_S3 "Conversion table" TAB_VERB 3 1 "AKTIV" 0 "NICHT_AKTIV" 2 "FEHLER" /end COMPU_VTAB
/begin COMPU_VTAB CONV_TAB_E_STATUSADA_M_S7_S3 "Conversion table" TAB_VERB 3 0 "KEINADAPTION" 1 "TOUCHPOINT_ADAPTION" 2 "REIBWERT_ADAPTION" /end COMPU_VTAB
/begin COMPU_VTAB CONV_TAB_E_STATUSASR_M_S7_S3 "Conversion table" TAB_VERB 2 0 "NICHT_AKTIV" 1 "AKTIV" /end COMPU_VTAB
/begin COMPU_VTAB CONV_TAB_E_STATUSCK0_M_S7_S3 "Conversion table" TAB_VERB 3 0 "NORMAL" 1 "ZU_HEISS" 2 "UEBERHITZT" /end COMPU_VTAB
/begin COMPU_VTAB CONV_TAB_E_STATUSIAE_M_S7_S3 "Conversion table" TAB_VERB 9 0 "NICHTDEFINIERT" 1 "OFFEN" 2 "ANGELEGT" 3 "ANFAHREN" 4 "ENTKOPPELT" 5 "ENTKOPPELT_ANFAHREN" 6 "SYNCHRONISIEREN" 7 "GESCHLOSSEN" 8 "OEFFNEN" /end COMPU_VTAB
/begin COMPU_VTAB CONV_TAB_E_STATUSIEP_M_S7_S3 "Conversion table" TAB_VERB 5 0 "AUS" 1 "SLEEP" 2 "LP1" 3 "LP2" 4 "LP3" /end COMPU_VTAB
/begin COMPU_VTAB CONV_TAB_E_STATUSK0_M_S7_S3 "Conversion table" TAB_VERB 6 0 "OFFEN" 1 "ANGELEGT" 2 "DRUCKSTELLUNG" 3 "SCHLUPFGEREGELT" 4 "GEREGELTGESCHL" 5 "GESCHLOSSEN" /end COMPU_VTAB
/begin COMPU_VTAB CONV_TAB_E_STATUSKSL_M_S7_S3 "Conversion table" TAB_VERB 7 0 "KEIN_KRAFTSCHLUSS" 1 "VORW_AUF_ABBAUEND" 2 "VORWAERTS" 3 "RUECKW_AUF_ABBAUEND" 4 "RUECKWAERTS" 5 "VORWAERTS_SCHLUPF" 6 "RUECKWAERTS_SCHLUPF" /end COMPU_VTAB
/begin COMPU_VTAB CONV_TAB_E_STATUSNAA_M_S7_S3 "Conversion table" TAB_VERB 2 0 "NICHT_AKTIV" 1 "AKTIV" /end COMPU_VTAB
/begin COMPU_VTAB CONV_TAB_E_STATUSPSY_M_S7_S3 "Conversion table" TAB_VERB 5 0 "AUS" 1 "NICHTDEFINIERT" 2 "LP1" 3 "LP2" 4 "LP3" /end COMPU_VTAB
/begin COMPU_VTAB CONV_TAB_E_STATUSRSE_M_S7_S3 "Conversion table" TAB_VERB 2 0 "KEIN_RADSCHLUPF" 1 "DURCHDREHEN_ERKANNT" /end COMPU_VTAB
/begin COMPU_VTAB CONV_TAB_E_STBZHAS_M_S7_S3 "Conversion table" TAB_VERB 16 0 "INIT_INAKTIV" 1 "ANGEKOPPELT" 2 "ENTKOPPELT" 3 "EFAHREN" 4 "STOP" 5 "LADEN" 6 "ENTK_VMEIN" 7 "EFAHREN_VMEIN" 8 "HYBRID" 9 "NICHTDEFINIERT_1" 10 "NICHTDEFINIERT_2" 11 "NICHTDEFINIERT_3" 12 "NICHTDEFINIERT_4" 13 "NICHTDEFINIERT_5" 14 "INIT_KL15" 15 "FEHLER" /end COMPU_VTAB
/begin COMPU_VTAB CONV_TAB_E_ZIEP_M_S7_S3 "Conversion table" TAB_VERB 5 0 "AUS" 1 "SLEEP" 2 "LP1" 3 "LP2" 4 "LP3" /end COMPU_VTAB
/begin COMPU_VTAB CONV_TAB_E_ZK0_M_S7_S3 "Conversion table" TAB_VERB 6 0 "OEFFNENSW" 1 "BEFUELLEN" 2 "DRUCKSTELLUNG" 3 "SCHLUPFREGELUNG" 4 "GEREGELTGESCHL" 5 "GESCHLOSSEN" /end COMPU_VTAB
/begin COMPU_VTAB CONV_TAB_E_ZK0FSTIN_M_S7_S3 "Conversion table" TAB_VERB 4 0 "OFFEN" 1 "SCHLUPFGEREGELT" 2 "GEREGELTGESCHL" 3 "GESCHLOSSEN" /end COMPU_VTAB
/begin COMPU_VTAB CONV_TAB_E_ZMODUSIAE_M_S7_S3 "Conversion table" TAB_VERB 3 0 "EFAHREN_SCHLUPF" 1 "EFAHREN_KRAFTSCHL" 2 "HYBRIDFAHREN" /end COMPU_VTAB
/begin COMPU_VTAB CONV_TAB_E_ZMODUSIEP_M_S7_S3 "Conversion table" TAB_VERB 5 0 "KEINVORGABE" 1 "AUS" 2 "LP1" 3 "LP2" 4 "LP3" /end COMPU_VTAB
/begin COMPU_VTAB CONV_TAB_E_ZNLLSOLL_M_S7_S3 "Conversion table" TAB_VERB 4 0 "KEINANF" 1 "ANF_ADAP" 2 "ANF_ALLG" 3 "ANF_ADAP_IEP" /end COMPU_VTAB
/begin COMPU_VTAB CONV_TAB_E_ZNMODUS_M_S7_S3 "Conversion table" TAB_VERB 5 0 "KEIN_AUFBAU" 1 "SCHNELL" 2 "ZUEGIG" 3 "KOMFORTABEL" 4 "UNTERDRUECKT" /end COMPU_VTAB
/begin COMPU_VTAB CONV_TAB_E_ZUVSZUS_M_S7_S3 "Conversion table" TAB_VERB 4 0 "KEINANFORDERUNG" 1 "ANGEFORDERT" 2 "AKTIVIERT" 3 "RUECKNAHME" /end COMPU_VTAB
/begin FUNCTION SFOp_SLST505_Vorgaben_LP3 ""
 /begin DEF_CHARACTERISTIC KF_MGK0BEFANFIAE_KON_ANS_W KF_MGK0BEFANFIAE_KON_ANS_X KF_MGK0BEFANFIAE_KON_ANS_Y KF_MGK0BEFNORM_KON_ANS_W KF_MGK0BEFNORM_KON_ANS_X KF_MGK0BEFNORM_KON_ANS_Y KF_MGK0BEFOPT_KON_ANS_W KF_MGK0BEFOPT_KON_ANS_X KF_MGK0BEFOPT_KON_ANS_Y KF_MGK0BEFRED_KON_ANS_W KF_MGK0BEFRED_KON_ANS_X KF_MGK0BEFRED_KON_ANS_Y KF_MGK0BEFRESP_SCHALT_KON_ANS_W KF_MGK0BEFRESP_SCHALT_KON_ANS_X KF_MGK0BEFRESP_SCHALT_KON_ANS_Y KF_MGK0VMANDREH_KON_ANS_W KF_MGK0VMANDREH_KON_ANS_X KF_MGK0VMANDREH_KON_ANS_Y KF_MZIELK0ANFIAE_KON_ANS_W KF_MZIELK0ANFIAE_KON_ANS_X KF_MZIELK0ANFIAE_KON_ANS_Y KF_MZIELK0BEFNORM_KON_ANS_W KF_MZIELK0BEFNORM_KON_ANS_X KF_MZIELK0BEFNORM_KON_ANS_Y KF_MZIELK0BEFOPT_KON_ANS_W KF_MZIELK0BEFOPT_KON_ANS_X KF_MZIELK0BEFOPT_KON_ANS_Y KF_MZIELK0BEFRED_KON_ANS_W KF_MZIELK0BEFRED_KON_ANS_X KF_MZIELK0BEFRED_KON_ANS_Y KF_MZIELK0BEFRESP_SCHALT_KON_ANS_W KF_MZIELK0BEFRESP_SCHALT_KON_ANS_X KF_MZIELK0BEFRESP_SCHALT_KON_ANS_Y KF_MZIELK0VMANDREH_KON_ANS_W KF_MZIELK0VMANDREH_KON_ANS_X KF_MZIELK0VMANDREH_KON_ANS_Y ND_IAEANFAHRENTK_ANS NS_EMIAEANFAHRENTK_ANS BM_BEFMOD_ANFIAE_KON_ANS BM_BEFMOD_NORM_KON_ANS BM_BEFMOD_OPT_KON_ANS BM_BEFMOD_RED_KON_ANS BM_BEFMOD_RESP_SCHALT_KON_ANS MS_MWUNSCHIAEANFAHRENTK_ANS ABLAUFVAR_RESPONSE_ANS CS_BEFUELLOPTCGETRIEBE_KON_ANS NS_BEFUELLOPTNEM_KON_ANS SWI_BEFUELLRED_AKTIV_KON_ANS NS_VMANDREHK0_ERK_KON_ANS NS_VMAUS_ERK_KON_ANS SWI_UMSCHMSOLLK0MZIELK0_KON_ANS SWI_UMSCHNVMNDK0_KON_ANS TAB_MK0BEFUELLMODUS_KON_ANS TAB_ZK0BEFUELLMODUSSTK0BEF_KON_ANS TAB_ZK0BEFUELLMODUS_KON_ANS /end DEF_CHARACTERISTIC
 /begin LOC_MEASUREMENT nd_iae_ans z_k0entkaktiv_ans z_m_max_iae_has_in z_m_max_stiae_has z_nsollvmaktiv_ans z_iae_entkoppelt_ans m_ziel_vm_has_ans n_sec_iae_ist_ans z_k0_erk_ans z_k0_befuellvariante_ans z_ablauf_has_stg i_istgang_egs i_zielgang_egs m_wunsch_fpw_hst_fil mg_wunsch_fpw_hst_in n_sec_iae nd_k0_in ndg_k0_in ng_vm_in status_schaltung_egs_in status_psys_has_sbe status_sync_schaltung_sbe mg_mot_in status_schaltart_svh_has_sbe z_svh_has_sbe n_min_em_has_sbe z_modus_em_hst_in c_getriebe_egs_in istgang_egs_in m_em_in m_iae_in m_k0_in m_max_dyn_em_in m_soll_em_hst_in m_soll_vm_hst_in m_vm_in m_vm_start_in m_wunsch_fpw_in n_ab_egs_in n_em_in n_soll_ll_vm_in n_vm_in sollgang_egs_in status_iae_in status_k0_in z_ablauf_has_hst_in zielgang_egs_in z_k0_fst_in m_mot_in status_kraftfluss_egs_in n_mot_soll_iae_in gangwechsel_egs_in kolbenpos_k0_in status_ll_vm_in m_min_dyn_em_in schalt_mode_egs_in status_k0_befuellung_in c_vm_in abstellpos_vm_in abstellpos_vm_status_in status_nreg_em_hst_in m_min_vm_in m_soll_vm_l_hst_in m_wunsch_fpw_hst_in /end LOC_MEASUREMENT
/end FUNCTION
/begin FUNCTION SFOp_SLST51_Bestimmung_Ablaufvariante ""
 /begin DEF_CHARACTERISTIC KF_Z_MOMAXIAE_ANS_W KF_Z_MOMAXIAE_ANS_X KF_Z_MOMAXIAE_ANS_Y KL_ZK0ENTKAKTIVABLVAR_ANS_Y KL_ZK0ENTKAKTIVABLVAR_ANS_X KL_ZNSOLLVMAKTIVABLVAR_ANS_Y KL_ZNSOLLVMAKTIVABLVAR_ANS_X KF_ZMMAXABLVARNLLVM_ANS_W KF_ZMMAXABLVARNLLVM_ANS_X KF_ZMMAXABLVARNLLVM_ANS_Y KF_ZMMAXIAEISTGANGABLVAR_ANS_W KF_ZMMAXIAEISTGANGABLVAR_ANS_X KF_ZMMAXIAEISTGANGABLVAR_ANS_Y KF_ZMMAXSTSIAE_ANS_W KF_ZMMAXSTSIAE_ANS_X KF_ZMMAXSTSIAE_ANS_Y KL_UMSCHZMMAXIAE_STKRAFT_ANS_Y KL_UMSCHZMMAXIAE_STKRAFT_ANS_X KF_STATUS_IAE_PLAUS_ANS_W KF_STATUS_IAE_PLAUS_ANS_X KF_STATUS_IAE_PLAUS_ANS_Y NDS_IAE_PLAUS_ANS NDS_SOLLIAE_PLAUS_ANS SWI_STATUSIAE_PLAUS_ANS T_STATUSIAE_PLAUS_ANS STATUS_ABL_ZIAEENTK_HST_KON_ANS Z_MMAXIAEZMODUSIAE_ANS /end DEF_CHARACTERISTIC
 /begin LOC_MEASUREMENT nd_iae_ans status_iae_plaus_ans t_statusiaeplaus_ans z_m_max_iae_ablvar_ans z_k0entkaktiv_ans z_m_max_iae_has_in z_m_max_stiae_has z_nsollvmaktiv_ans z_iae_entkoppelt_ans n_sec_iae z_modus_iae_has_sbe istgang_egs_in n_em_in n_soll_ll_vm_in status_iae_in z_ablauf_has_hst_in status_kraftfluss_egs_in /end LOC_MEASUREMENT
 /begin SUB_FUNCTION Run_SFOp_SLST99_abs_fl1 /end SUB_FUNCTION
/end FUNCTION
/begin FUNCTION SFOp_SLST52_Bestimmung_Getriebe_entkoppelt ""
 /begin DEF_CHARACTERISTIC KF_ZNSOLLEM_STIAEKRAFTFL_ANS_W KF_ZNSOLLEM_STIAEKRAFTFL_ANS_X KF_ZNSOLLEM_STIAEKRAFTFL_ANS_Y KL_ZNSOLLEM_ISTGANG_ANS_Y KL_ZNSOLLEM_ISTGANG_ANS_X KF_IAEENTK_STIAEKRAFTFL_ANS_W KF_IAEENTK_STIAEKRAFTFL_ANS_X KF_IAEENTK_STIAEKRAFTFL_ANS_Y KL_IAEENTK_ISTGANG_ANS_Y KL_IAEENTK_ISTGANG_ANS_X KL_ENTKMOEGLIAESTIAEKRAFT_ANS_Y KL_ENTKMOEGLIAESTIAEKRAFT_ANS_X KF_MOIAEENTKERK1_ANS_W KF_MOIAEENTKERK1_ANS_X KF_MOIAEENTKERK1_ANS_Y KF_MOIAEENTKERK2_ANS_W KF_MOIAEENTKERK2_ANS_X KF_MOIAEENTKERK2_ANS_Y KL_TMAXIAEOEFCGETR_ANS_Y KL_TMAXIAEOEFCGETR_ANS_X NS_NEMSTATUSWECHSELIAE_ANS SWI_ABFZMMAXIAEHAS_ANS T_STATUSWECHSELIAEMAX_ANS SWI_ZNSOLLEMANF_SYN_ANS /end DEF_CHARACTERISTIC
 /begin LOC_MEASUREMENT t_maxiaeoeffnen_ans z_iaeoeffnen_ans z_mmaxiaeoeffnen_ans z_t_maxiaeoeffnen_ans t_statuswechseliae_ans z_iae_entkmoeglich_ans z_iae_entkoppelt_ans z_iae_entkstatusiaeoeffnen_ans z_n_soll_em_anf_ans z_t_iaeentkstatusiaeoeffnen_ans c_getriebe_egs_in istgang_egs_in m_iae_in n_em_in status_iae_in m_mot_in status_kraftfluss_egs_in /end LOC_MEASUREMENT
/end FUNCTION
/begin FUNCTION SFOp_SLST53_Fahrsollmoment ""
 /begin LOC_MEASUREMENT m_wunsch_fpw_begr_ans m_soll_res_em_bas_sbe m_max_dyn_em_in m_wunsch_fpw_in m_min_dyn_em_in /end LOC_MEASUREMENT
/end FUNCTION
/begin FUNCTION SFOp_SLST54_Gradientenberechnung_ng_em "" /begin DEF_CHARACTERISTIC FK_NGEM_ANS /end DEF_CHARACTERISTIC /begin LOC_MEASUREMENT ng_em_ans n_em_in /end LOC_MEASUREMENT /begin SUB_FUNCTION Run_SFOp_SLST124_cDT1_ngem /end SUB_FUNCTION /end FUNCTION
/begin FUNCTION SFOp_SLST545_Initialisierung ""
 /begin DEF_CHARACTERISTIC KL_KSVH_RESET_KON_ANS_Y KL_KSVH_RESET_KON_ANS_X K_SVH_RESET_RESPPARAL_KON_ANS /end DEF_CHARACTERISTIC
 /begin LOC_MEASUREMENT nd_iae_ans z_k0entkaktiv_ans z_m_max_iae_has_in z_m_max_stiae_has z_nsollvmaktiv_ans z_iae_entkoppelt_ans m_ziel_vm_has_ans n_sec_iae_ist_ans z_ablauf_has_stg i_istgang_egs i_zielgang_egs m_wunsch_fpw_hst_fil mg_wunsch_fpw_hst_in n_sec_iae nd_k0_in ndg_k0_in ng_vm_in status_schaltung_egs_in status_psys_has_sbe status_sync_schaltung_sbe mg_mot_in status_schaltart_svh_has_sbe z_svh_has_sbe n_min_em_has_sbe z_modus_em_hst_in c_getriebe_egs_in istgang_egs_in m_em_in m_iae_in m_k0_in m_max_dyn_em_in m_soll_em_hst_in m_soll_vm_hst_in m_vm_in m_vm_start_in m_wunsch_fpw_in n_ab_egs_in n_em_in n_soll_ll_vm_in n_vm_in sollgang_egs_in status_iae_in status_k0_in z_ablauf_has_hst_in zielgang_egs_in z_k0_fst_in m_mot_in status_kraftfluss_egs_in n_mot_soll_iae_in gangwechsel_egs_in kolbenpos_k0_in status_ll_vm_in m_min_dyn_em_in schalt_mode_egs_in status_k0_befuellung_in c_vm_in abstellpos_vm_in abstellpos_vm_status_in status_nreg_em_hst_in m_min_vm_in m_soll_vm_l_hst_in m_wunsch_fpw_hst_in /end LOC_MEASUREMENT
/end FUNCTION
/begin FUNCTION SFOp_SLST55_Modifikation_Ablaufvariante "" /begin DEF_CHARACTERISTIC Z_ABLVAR_UNGUELTIG_ANS /end DEF_CHARACTERISTIC /begin LOC_MEASUREMENT z_ablaufvariante_has_ans z_ablaufvariante_has_stg /end LOC_MEASUREMENT /end FUNCTION
/begin FUNCTION SFOp_SLST556_Initialisierung "" /begin DEF_CHARACTERISTIC NO_NEMZMMAXIAEABLVAR_KON_ANS NS_NVMZMMAXIAEABLVAR_KON_ANS /end DEF_CHARACTERISTIC
 /begin LOC_MEASUREMENT nd_iae_ans z_k0entkaktiv_ans z_m_max_iae_has_in z_m_max_stiae_has z_nsollvmaktiv_ans z_iae_entkoppelt_ans m_ziel_vm_has_ans n_sec_iae_ist_ans z_ablauf_has_stg i_istgang_egs i_zielgang_egs m_wunsch_fpw_hst_fil mg_wunsch_fpw_hst_in n_sec_iae nd_k0_in ndg_k0_in ng_vm_in status_schaltung_egs_in status_psys_has_sbe status_sync_schaltung_sbe mg_mot_in status_schaltart_svh_has_sbe z_svh_has_sbe n_min_em_has_sbe z_modus_em_hst_in c_getriebe_egs_in istgang_egs_in m_em_in m_iae_in m_k0_in m_max_dyn_em_in m_soll_em_hst_in m_soll_vm_hst_in m_vm_in m_vm_start_in m_wunsch_fpw_in n_ab_egs_in n_vm_in sollgang_egs_in status_iae_in status_k0_in z_ablauf_has_hst_in zielgang_egs_in z_k0_fst_in m_mot_in status_kraftfluss_egs_in n_mot_soll_iae_in gangwechsel_egs_in kolbenpos_k0_in status_ll_vm_in m_min_dyn_em_in schalt_mode_egs_in status_k0_befuellung_in c_vm_in abstellpos_vm_in abstellpos_vm_status_in status_nreg_em_hst_in m_min_vm_in m_soll_vm_l_hst_in m_wunsch_fpw_hst_in /end LOC_MEASUREMENT
/end FUNCTION
/begin FUNCTION SFOp_SLST567_st_slst_abbruch_ans ""
 /begin DEF_CHARACTERISTIC MS_ZMSOLLEMAKTIV_KON_ANS STATUS_K0ZMSOLLEMAKTIV_SST_ANS SWI_MSTOERK0EMMK0_SST_ANS MS_MMAXIAEINAKTIV_ANS SWI_MK0MOD_HAS_ANS K_MSTOERKPL_ABB_ANS SWI_ZMSOLLEM_ABB_ANS MG_SOLLK0_ABB_ANS T_MAX_ABB_ANS /end DEF_CHARACTERISTIC
 /begin LOC_MEASUREMENT nd_iae_ans z_k0entkaktiv_ans z_m_max_iae_has_in z_m_max_stiae_has z_nsollvmaktiv_ans z_iae_entkoppelt_ans m_ziel_vm_has_ans n_sec_iae_ist_ans t_maxbed_abb_ans z_ablauf_has_stg i_istgang_egs i_zielgang_egs m_wunsch_fpw_hst_fil mg_wunsch_fpw_hst_in n_sec_iae nd_k0_in ndg_k0_in ng_vm_in status_schaltung_egs_in status_psys_has_sbe status_sync_schaltung_sbe mg_mot_in status_schaltart_svh_has_sbe z_svh_has_sbe n_min_em_has_sbe z_modus_em_hst_in c_getriebe_egs_in istgang_egs_in m_em_in m_iae_in m_k0_in m_max_dyn_em_in m_soll_em_hst_in m_soll_vm_hst_in m_vm_in m_vm_start_in m_wunsch_fpw_in n_ab_egs_in n_em_in n_soll_ll_vm_in n_vm_in sollgang_egs_in status_iae_in status_k0_in z_ablauf_has_hst_in zielgang_egs_in z_k0_fst_in m_mot_in status_kraftfluss_egs_in n_mot_soll_iae_in gangwechsel_egs_in kolbenpos_k0_in status_ll_vm_in m_min_dyn_em_in schalt_mode_egs_in status_k0_befuellung_in c_vm_in abstellpos_vm_in abstellpos_vm_status_in status_nreg_em_hst_in m_min_vm_in m_soll_vm_l_hst_in m_wunsch_fpw_hst_in /end LOC_MEASUREMENT
 /begin SUB_FUNCTION SFOp_SLST579_Initialisierung SFOp_SLST580_Initialisierung Run_SFOp_SLST582_cLimiter_Gradient_MSollK0 /end SUB_FUNCTION
/end FUNCTION
/begin FUNCTION SFOp_SLST57_k_mstoer ""
 /begin DEF_CHARACTERISTIC KF_FMSTOERND_VMS_ANS_W KF_FMSTOERND_VMS_ANS_X KF_FMSTOERND_VMS_ANS_Y KL_FMSTOERNDZABLVAR_ANS_Y KL_FMSTOERNDZABLVAR_ANS_X /end DEF_CHARACTERISTIC
 /begin LOC_MEASUREMENT nd_k0_in n_em_in /end LOC_MEASUREMENT
/end FUNCTION
/begin FUNCTION SFOp_SLST579_Initialisierung "" /begin DEF_CHARACTERISTIC MS_MMAXIAEINAKTIV_ANS /end DEF_CHARACTERISTIC /end FUNCTION
/begin FUNCTION SFOp_SLST58_m_ziel_vm_has_ans "" /begin DEF_CHARACTERISTIC MS_ZIELK0HSTMZIELVM_ANS SWI_MZIELK0HST_ANS /end DEF_CHARACTERISTIC
 /begin LOC_MEASUREMENT m_ziel_vm_has_ans m_max_dyn_em_in m_ziel_k0_hst_in m_wunsch_fpw_hst_in /end LOC_MEASUREMENT
/end FUNCTION
/begin FUNCTION SFOp_SLST580_Initialisierung "" /begin DEF_CHARACTERISTIC SWI_ZPHYSK0_ABB_ANS /end DEF_CHARACTERISTIC /end FUNCTION
/begin FUNCTION SFOp_SLST59_n_sec_iae ""
 /begin LOC_MEASUREMENT n_sec_iae_ist_ans n_sec_iae_ziel_ans i_istgang_egs i_zielgang_egs n_ab_egs_in /end LOC_MEASUREMENT
/end FUNCTION
/begin FUNCTION SFOp_SLST595_st_schaltung_aktiv ""
 /begin DEF_CHARACTERISTIC KF_NOEMNSOLLVM_KON_ANS_W KF_NOEMNSOLLVM_KON_ANS_X KF_NOEMNSOLLVM_KON_ANS_Y KL_KSVH_RESET_NSRS_SAK_ANS_Y KL_KSVH_RESET_NSRS_SAK_ANS_X KL_KSVH_RESET_SAK_ANS_Y KL_KSVH_RESET_SAK_ANS_X KL_KSVH_RESET_SLTMODE_SAK_ANS_Y KL_KSVH_RESET_SLTMODE_SAK_ANS_X KL_KSVH_RESET_SRS_SAK_ANS_Y KL_KSVH_RESET_SRS_SAK_ANS_X K_MZIELNOEMNSOLLVM_KON_ANS K_NOEMNSOLLVMOKS_KON_ANS N_MINEMNSOLLVM_KON_ANS STATUS_ABL_SAK_ANS T_MAX_SAK_ANS MS_MVM_SAK_ANS NDG_K0_SAK_ANS NDS_K0_SAK_ANS NS_NVM_SAK_ANS T_SCHALT_MODE_MAX_SAK_ANS FK_NSOLLVM_SAK_ANS SWI_ZMODUSVMN_SAK_ANS /end DEF_CHARACTERISTIC
 /begin LOC_MEASUREMENT nd_iae_ans z_k0entkaktiv_ans z_m_max_iae_has_in z_m_max_stiae_has z_nsollvmaktiv_ans z_iae_entkoppelt_ans m_ziel_vm_has_ans n_sec_iae_ist_ans t_maxbed_sak_ans t_schalt_mode_sak_ans z_ablauf_has_stg i_istgang_egs i_zielgang_egs m_wunsch_fpw_hst_fil mg_wunsch_fpw_hst_in n_sec_iae nd_k0_in ndg_k0_in ng_vm_in status_schaltung_egs_in status_psys_has_sbe status_sync_schaltung_sbe mg_mot_in status_schaltart_svh_has_sbe z_svh_has_sbe n_min_em_has_sbe z_modus_em_hst_in c_getriebe_egs_in istgang_egs_in m_em_in m_iae_in m_k0_in m_max_dyn_em_in m_soll_em_hst_in m_soll_vm_hst_in m_vm_in m_vm_start_in m_wunsch_fpw_in n_ab_egs_in n_em_in n_soll_ll_vm_in n_vm_in sollgang_egs_in status_iae_in status_k0_in z_ablauf_has_hst_in zielgang_egs_in z_k0_fst_in m_mot_in status_kraftfluss_egs_in n_mot_soll_iae_in gangwechsel_egs_in kolbenpos_k0_in status_ll_vm_in m_min_dyn_em_in schalt_mode_egs_in status_k0_befuellung_in c_vm_in abstellpos_vm_in abstellpos_vm_status_in status_nreg_em_hst_in m_min_vm_in m_soll_vm_l_hst_in m_wunsch_fpw_hst_in /end LOC_MEASUREMENT
 /begin SUB_FUNCTION SFOp_SLST602_Initialisierung SFOp_SLST604_Initialisierung SFOp_SLST605_Initialisierung Run_SFOp_SLST625_CL_PT1_14nsollvm /end SUB_FUNCTION
/end FUNCTION
/begin FUNCTION SFOp_SLST6_Input ""
 /begin LOC_MEASUREMENT nd_iae_ans ng_em_ans m_ziel_vm_has_ans n_sec_iae_ist_ans z_nvmsollbegr_frk_dihi z_statuspsysmps_frk_dihi z_nminemnull_frk_dihi z_emfehler_frk_dihi z_ablaufreinit_frk_dihi z_k0syncmk0erh_frk_dihi z_fuwdeakt_frk_dihi z_nemmin_frk_dihi z_vmstopverbot_frk_dihi z_vmstartverbot_frk_dihi z_zust_halten_frk_dihi z_zust_init_frk_dihi z_deaktiv_abo_frk_dihi z_vmstartanf_frk_dihi z_svh_frk_dihi z_iepein_frk_dihi z_nsollvmnull_frk_dihi z_ala_frk_dihi z_schaltprioverh_frk_dihi z_nsollvmanh_frk_dihi z_gebruefahrenaus_frk_dihi z_hybfkt_stg st_ziel_bz_has_stg st_ist_bz_has_stg st_ist_hcomd_has_stg z_ablauf_has_stg z_ablaufvariante_has_stg i_istgang_egs i_zielgang_egs m_wunsch_fpw_hst_fil mg_wunsch_fpw_in mg_wunsch_fpw_hst_in n_sec_iae nd_k0_in ndg_k0_in ng_vm_in status_schaltung_egs_in n_min_em_psys_lp3_has_sbe status_psys_has_sbe vg_f_sbe v_f_sbe status_sync_schaltung_sbe z_pvu_has_sbe z_freigabe_pvu_has_sbe t_betrieb_pvu_has_sbe mg_mot_in status_radschlupf_rse_has_sbe status_schaltart_svh_has_sbe m_motmax_has_sbe z_k0_has_sbe z_svh_has_sbe m_soll_res_em_has_sbe m_soll_res_em_bas_sbe z_modus_iae_has_sbe z_sas_has_sbe z_modus_iep_has_sbe z_msa_has_sbe status_efahren_has_sbe n_min_em_has_sbe z_msa_avh_moni_has_sbe z_msa_eaf_moni_has_sbe z_start_modus_has_sbe m_k0_mber_has_sbe z_lls_fktaktiv_has_sbe z_status_psys_mps_sbe m_k0_has_sbe m_soll_k0_has_sbe analyse_has_sbe z_nminemmodus_has_sbe st_soll_bz_has_hst z_init_sta st_soll_bz_hst_sta st_ist_bz_hst_sta bExceptionHybrid bErrorHybrid z_modus_em_hst_in c_getriebe_egs_in istgang_egs_in m_em_in m_iae_in m_k0_in m_max_dyn_em_in m_soll_em_hst_in m_soll_vm_hst_in m_vm_in m_vm_start_in m_wunsch_fpw_in n_ab_egs_in n_em_in n_soll_ll_vm_in n_t_egs_in n_vm_in osmode_next_in p_bremse_fzg_in sollgang_egs_in status_fehler_iep_in status_iae_in status_iep_in status_k0_in pos_egs_in z_ablauf_has_hst_in z_ablaufvariante_has_hst_in zielgang_egs_in z_k0_fst_in m_mot_in status_iae_adap_in z_diag_ersfkt_has_in z_diag_ersfkt_hi_has_in z_diag_notgang_has_in status_k0_adap_in status_waschstr_in status_kraftfluss_egs_in z_n_min_em_parksp_has_in n_mot_soll_iae_in status_alaengs_adaoff_in gangwechsel_egs_in z_nllsoll_iae_in status_nem_in status_nvm_in kolbenpos_k0_in z_kps_stada_in t_betrieb_pvu_has_ee_in status_ll_vm_in z_msa_fst_in m_min_dyn_em_in phi_neigung_in v_f_in drehrichtung_nem_in fpw_in drehrichtung_nab_in schalt_mode_egs_in m_ziel_k0_hst_in status_kraftfluss_lev2_egs_in i_gang_lev2_egs_in status_c_k0_in bremspedal_in status_autohold_in status_hillhold_in status_vf_in v_f_ref_in status_vfref_in z_diag_ersfkt_hi_96_has_in status_k0_adap_zaehler_in status_k0_befuellung_in z_oea_hst_in z_iep_in z_nllsoll_iep_in c_vm_in n_soll_em_hst_in abstellpos_vm_in abstellpos_vm_status_in status_nreg_em_hst_in m_min_vm_in m_soll_vm_l_hst_in z_msa_stada_in m_wunsch_fpw_hst_in status_getrbereit_in status_betriebsbereit_hst_in status_sa_vm_in z_ba_has_vm_hst_in z_ba_has_k0_hst_in status_abs_in status_asr_in modus_e_fahren_hst_in status_kl15_in status_posvueb_in soc_in status_soc_in c_umgebung_in status_cumgebung_in /end LOC_MEASUREMENT
 /begin SUB_FUNCTION SFOp_SLST60_status_befuellung_k0 SFOp_SLST57_k_mstoer SFOp_SLST52_Bestimmung_Getriebe_entkoppelt SFOp_SLST51_Bestimmung_Ablaufvariante SFOp_SLST49_Berechnung_Stoermoment SFOp_SLST45_Ablauf_in_Fahrzustaenden_mit_schlupfenden_Antriebsraedern SFOp_SLST47_Ber_Reservemoment SFOp_SLST48_Berechnung_Sollflag_nem SFOp_SLST50_Berechnung_nd_iae_ans SFOp_SLST53_Fahrsollmoment SFOp_SLST54_Gradientenberechnung_ng_em SFOp_SLST55_Modifikation_Ablaufvariante SFOp_SLST58_m_ziel_vm_has_ans SFOp_SLST59_n_sec_iae /end SUB_FUNCTION
/end FUNCTION
/begin FUNCTION SFOp_SLST60_status_befuellung_k0 ""
 /begin DEF_CHARACTERISTIC KL_MSK0STATUSK0BEFUELLUNG_ANS_Y KL_MSK0STATUSK0BEFUELLUNG_ANS_X /end DEF_CHARACTERISTIC
 /begin LOC_MEASUREMENT status_k0befuellung_ans m_k0_in /end LOC_MEASUREMENT
 /begin SUB_FUNCTION SFOp_SLST128_Integral /end SUB_FUNCTION
/end FUNCTION
/begin FUNCTION SFOp_SLST602_Initialisierung "" /begin DEF_CHARACTERISTIC MS_RESEM_SAK_ANS /end DEF_CHARACTERISTIC /end FUNCTION
/begin FUNCTION SFOp_SLST604_Initialisierung "" /begin DEF_CHARACTERISTIC SWI_ZPHYSK0_SAK_ANS /end DEF_CHARACTERISTIC /end FUNCTION
/begin FUNCTION SFOp_SLST605_Initialisierung "" /begin DEF_CHARACTERISTIC STATUS_ABL_SAK_ANS /end DEF_CHARACTERISTIC /end FUNCTION
/begin FUNCTION SFOp_SLST62_Triggered_Subsystem "" /begin LOC_MEASUREMENT m_soll_res_em_bas_sbe /end LOC_MEASUREMENT /end FUNCTION
/begin FUNCTION SFOp_SLST637_Initialisierung "" /begin DEF_CHARACTERISTIC MS_RESEM_SRT_ANS /end DEF_CHARACTERISTIC /end FUNCTION
/begin FUNCTION SFOp_SLST638_Initialisierung "" /begin DEF_CHARACTERISTIC SWI_SAS_ANS SWI_ZPHYSK0_SRT_ANS /end DEF_CHARACTERISTIC /end FUNCTION
/begin FUNCTION SFOp_SLST640_Initialisierung "" /begin DEF_CHARACTERISTIC STATUS_ABL_SRT_ANS /end DEF_CHARACTERISTIC /end FUNCTION
/begin FUNCTION SFOp_SLST645_Initialisierung "" /begin DEF_CHARACTERISTIC SWI_SAF_ANS /end DEF_CHARACTERISTIC /end FUNCTION
/begin FUNCTION SFOp_SLST664_st_uebergabe "" /begin DEF_CHARACTERISTIC MS_MMAXIAEINAKTIV_ANS /end DEF_CHARACTERISTIC /begin SUB_FUNCTION SFOp_SLST672_Initialisierung SFOp_SLST673_Initialisierung /end SUB_FUNCTION /end FUNCTION
/begin FUNCTION SFOp_SLST672_Initialisierung "" /begin DEF_CHARACTERISTIC MS_MMAXIAEINAKTIV_ANS /end DEF_CHARACTERISTIC /end FUNCTION
/begin FUNCTION SFOp_SLST673_Initialisierung "" /begin DEF_CHARACTERISTIC SWI_ZPHYSK0_UEB_ANS /end DEF_CHARACTERISTIC /end FUNCTION
/begin FUNCTION SFOp_SLST679_st_slstabbr_uebergabe_ans "" /begin SUB_FUNCTION SFOp_SLST688_Initialisierung /end SUB_FUNCTION /end FUNCTION
/begin FUNCTION SFOp_SLST688_Initialisierung "" /begin DEF_CHARACTERISTIC SWI_ZPHYSK0_UEA_ANS /end DEF_CHARACTERISTIC /end FUNCTION
/begin FUNCTION SFOp_SLST695_st_vm_zuenden_ans ""
 /begin DEF_CHARACTERISTIC KF_NDEMNSOLLVM_ZND_ANS_W KF_NDEMNSOLLVM_ZND_ANS_X KF_NDEMNSOLLVM_ZND_ANS_Y KF_NOEMNSOLLVM_KON_ANS_W KF_NOEMNSOLLVM_KON_ANS_X KF_NOEMNSOLLVM_KON_ANS_Y KF_SLT_GANGWE_RESPPARAL_ZND_ANS_W KF_SLT_GANGWE_RESPPARAL_ZND_ANS_X KF_SLT_GANGWE_RESPPARAL_ZND_ANS_Y KF_VMISTVMSOLL_ZND_ANS_W KF_VMISTVMSOLL_ZND_ANS_X KF_VMISTVMSOLL_ZND_ANS_Y KL_KSVH_RESET_ZND_ANS_Y KL_KSVH_RESET_ZND_ANS_X KL_TMINABLVAR_ZND_ANS_Y KL_TMINABLVAR_ZND_ANS_X KL_MGSOLLK0_SCHUB_ZND_ANS_Y KL_MGSOLLK0_SCHUB_ZND_ANS_X KL_MGSOLLK0_ZND_ANS_Y KL_MGSOLLK0_ZND_ANS_X KF_MK0CGETRMMOT_SCHUB_ZND_ANS_W KF_MK0CGETRMMOT_SCHUB_ZND_ANS_X KF_MK0CGETRMMOT_SCHUB_ZND_ANS_Y KF_MK0CGETRMMOT_ZND_ANS_W KF_MK0CGETRMMOT_ZND_ANS_X KF_MK0CGETRMMOT_ZND_ANS_Y KF_MK0MMOTNVM_SCHUB_ZND_ANS_W KF_MK0MMOTNVM_SCHUB_ZND_ANS_X KF_MK0MMOTNVM_SCHUB_ZND_ANS_Y KF_MK0MMOTNVM_ZND_ANS_W KF_MK0MMOTNVM_ZND_ANS_X KF_MK0MMOTNVM_ZND_ANS_Y KF_MZIELK0BEFMODUS_SST_ANS_W KF_MZIELK0BEFMODUS_SST_ANS_X KF_MZIELK0BEFMODUS_SST_ANS_Y KL_FMK0CGETRMMOT_SCHUB_ZND_ANS_Y KL_FMK0CGETRMMOT_SCHUB_ZND_ANS_X KL_FMK0CGETRMMOT_ZND_ANS_Y KL_FMK0CGETRMMOT_ZND_ANS_X KL_FMK0MMOTNVM_SCHUB_ZND_ANS_Y KL_FMK0MMOTNVM_SCHUB_ZND_ANS_X KL_FMK0MMOTNVM_ZND_ANS_Y KL_FMK0MMOTNVM_ZND_ANS_X KL_MK0MVMSTART_ZND_ANS_Y KL_MK0MVMSTART_ZND_ANS_X KL_NDIAEEMMAXIAE_ZND_ANS_Y KL_NDIAEEMMAXIAE_ZND_ANS_X KF_MGZIELMAXEM_KON_ANS_W KF_MGZIELMAXEM_KON_ANS_X KF_MGZIELMAXEM_KON_ANS_Y KF_MGZIELMINEM_KON_ANS_W KF_MGZIELMINEM_KON_ANS_X KF_MGZIELMINEM_KON_ANS_Y STATUS_ABLVMDREHT_HST_ZND_ANS STATUS_ABLVMFEHLER_HST_ZND_ANS STATUS_ABLVMLAEUFT_HST_ZND_ANS M_ZIELMAXEM_SST_ANS M_ZIELMINEM_SST_ANS MS_ZMSOLLEMAKTIV_KON_ANS STATUS_K0ZMSOLLEMAKTIV_SST_ANS SWI_MSTOERK0EMMK0_SST_ANS F_NDSOLLIAESTAT_KON_ANS MO_MEM_KON_ANS MS_MMAXIAEINAKTIV_ANS MS_ZIELPHYSK0_SST_ANS SWI_MK0MOD_HAS_ANS SWI_UMSCH_ZVMSTARTFEHLER_ANS K_MZIELNOEMNSOLLVM_KON_ANS K_NOEMNSOLLVMOKS_KON_ANS NO_EMNSOLLVMRESPPARALRS_KON_ANS N_MINEMNSOLLVM_KON_ANS SWI_NSOLLEMENTKIAE_KON_ANS SWI_NSOLLVMENTKIAE_KON_ANS K_MSTOERKPL_ZND_ANS MS_RESEM_ZND_ANS SWI_ZMSOLLEM_ZND_ANS SWI_ZNSOLLEM_ZND_ANS MG_MOMAXIAE1_ZND_ANS MG_MOMAXIAE2_ZND_ANS SWI_ZPHYSK0_ZND_ANS STATUS_ABL_ZND_ANS T_MAX_ZND_ANS K_SVH_RESET_RESPPARAL_ZND_ANS K_SVH_RESET_RESPTEILPAR_ZND_ANS SWI_ST_GANGWE_RESP_ZND_ANS MGS_WUNSCHFPW_ZND_ANS FK_NSOLLVM_ZND_ANS /end DEF_CHARACTERISTIC
 /begin LOC_MEASUREMENT nd_iae_ans z_k0entkaktiv_ans z_m_max_iae_has_in z_m_max_stiae_has z_nsollvmaktiv_ans z_iae_entkoppelt_ans m_ziel_vm_has_ans n_sec_iae_ist_ans t_maxbed_znd_ans t_minablvar_znd_ans t_minbed_znd_ans z_ablauf_has_stg i_istgang_egs i_zielgang_egs m_wunsch_fpw_hst_fil mg_wunsch_fpw_hst_in n_sec_iae nd_k0_in ndg_k0_in ng_vm_in status_schaltung_egs_in status_psys_has_sbe status_sync_schaltung_sbe mg_mot_in status_schaltart_svh_has_sbe z_svh_has_sbe n_min_em_has_sbe z_modus_em_hst_in c_getriebe_egs_in istgang_egs_in m_em_in m_iae_in m_k0_in m_max_dyn_em_in m_soll_em_hst_in m_soll_vm_hst_in m_vm_in m_vm_start_in m_wunsch_fpw_in n_ab_egs_in n_em_in n_soll_ll_vm_in n_vm_in sollgang_egs_in status_iae_in status_k0_in z_ablauf_has_hst_in zielgang_egs_in z_k0_fst_in m_mot_in status_kraftfluss_egs_in n_mot_soll_iae_in gangwechsel_egs_in kolbenpos_k0_in status_ll_vm_in m_min_dyn_em_in schalt_mode_egs_in status_k0_befuellung_in c_vm_in abstellpos_vm_in abstellpos_vm_status_in status_nreg_em_hst_in m_min_vm_in m_soll_vm_l_hst_in m_wunsch_fpw_hst_in /end LOC_MEASUREMENT
 /begin SUB_FUNCTION SFOp_SLST738_Initialisierung Run_SFOp_SLST758_CL_PT1_14nsollvm /end SUB_FUNCTION
/end FUNCTION
/begin FUNCTION SFOp_SLST7_Output ""
 /begin LOC_MEASUREMENT nd_iae_ans z_k0entkaktiv_ans z_m_max_iae_has_in z_m_max_stiae_has z_nsollvmaktiv_ans z_iae_entkoppelt_ans m_ziel_vm_has_ans n_sec_iae_ist_ans z_k0_befuellopt_has z_ablauf_has_stg i_istgang_egs i_zielgang_egs m_wunsch_fpw_hst_fil mg_wunsch_fpw_hst_in n_sec_iae nd_k0_in ndg_k0_in ng_vm_in status_schaltung_egs_in status_psys_has_sbe status_sync_schaltung_sbe mg_mot_in status_schaltart_svh_has_sbe z_svh_has_sbe n_min_em_has_sbe z_modus_em_hst_in c_getriebe_egs_in m_em_in m_iae_in m_k0_in m_max_dyn_em_in m_soll_em_hst_in m_soll_vm_hst_in m_vm_in m_vm_start_in m_wunsch_fpw_in n_ab_egs_in n_em_in n_soll_ll_vm_in n_vm_in sollgang_egs_in status_iae_in status_k0_in z_ablauf_has_hst_in zielgang_egs_in z_k0_fst_in m_mot_in n_mot_soll_iae_in gangwechsel_egs_in kolbenpos_k0_in status_ll_vm_in m_min_dyn_em_in schalt_mode_egs_in status_k0_befuellung_in c_vm_in abstellpos_vm_in abstellpos_vm_status_in status_nreg_em_hst_in m_min_vm_in m_soll_vm_l_hst_in m_wunsch_fpw_hst_in /end LOC_MEASUREMENT
 /begin SUB_FUNCTION SFOp_SLST130_Modifikation_Schaltverhinderung SFOp_SLST129_Begrenzung_m_soll_em_has /end SUB_FUNCTION
/end FUNCTION
/begin FUNCTION SFOp_SLST738_Initialisierung "" /begin DEF_CHARACTERISTIC STATUS_ABL_ZND_ANS /end DEF_CHARACTERISTIC /end FUNCTION
/begin FUNCTION SFOp_SLST9_St_Ablauf ""
 /begin LOC_MEASUREMENT nd_iae_ans z_k0entkaktiv_ans z_m_max_iae_has_in z_m_max_stiae_has z_nsollvmaktiv_ans z_iae_entkoppelt_ans ng_em_ans m_ziel_vm_has_ans n_sec_iae_ist_ans nd_soll_iae_ans nd_soll_iae_stat_ans z_ablauf_has_stg i_istgang_egs i_zielgang_egs m_wunsch_fpw_hst_fil mg_wunsch_fpw_hst_in n_sec_iae nd_k0_in ndg_k0_in ng_vm_in status_schaltung_egs_in status_psys_has_sbe status_sync_schaltung_sbe mg_mot_in status_schaltart_svh_has_sbe z_svh_has_sbe n_min_em_has_sbe z_modus_em_hst_in c_getriebe_egs_in istgang_egs_in m_em_in m_iae_in m_k0_in m_max_dyn_em_in m_soll_em_hst_in m_soll_vm_hst_in m_vm_in m_vm_start_in m_wunsch_fpw_in n_ab_egs_in n_em_in n_soll_ll_vm_in n_vm_in sollgang_egs_in status_iae_in status_k0_in z_ablauf_has_hst_in zielgang_egs_in z_k0_fst_in m_mot_in status_kraftfluss_egs_in n_mot_soll_iae_in gangwechsel_egs_in kolbenpos_k0_in status_ll_vm_in m_min_dyn_em_in schalt_mode_egs_in status_k0_befuellung_in c_vm_in abstellpos_vm_in abstellpos_vm_status_in status_nreg_em_hst_in m_min_vm_in m_soll_vm_l_hst_in m_wunsch_fpw_hst_in /end LOC_MEASUREMENT
 /begin SUB_FUNCTION SFOp_SLST167_St_VM_zuenden_Ans SFOp_SLST164_St_Start SFOp_SLST163_St_Schaltung_aktiv SFOp_SLST161_St_Konditionieren_Ans SFOp_SLST160_St_K0_Synchronisieren_Ans SFOp_SLST159_St_K0_Schliessen_Ans SFOp_SLST158_St_Anschleppen_Ans SFOp_SLST178_zuenden SFOp_SLST177_synchronisieren SFOp_SLST176_konditionieren SFOp_SLST175_k0_schliessen SFOp_SLST172_anschleppen SFOp_SLST169_Gradient SFOp_SLST162_St_SLST_Abbruch_Ans SFOp_SLST165_St_Uebergabe SFOp_SLST166_St_Uebergabe_SLSTAbbruch_Ans SFOp_SLST170_Out /end SUB_FUNCTION
/end FUNCTION
/begin FUNCTION SFOp_VMA14_st_abstellen_vma "" /begin DEF_CHARACTERISTIC NS_VMAUSERK_AST_VMA T_NVMAUSERK_AST_VMA /end DEF_CHARACTERISTIC
 /begin LOC_MEASUREMENT z_t_nvmausbed_ast_vma z_init_vma t_nvmausbed_ast_vma st_ablauf_fkt status_ablauf_has_fkt z_ablauf_svh_reset_has_fkt z_zuendfreigabe_vm_has_fkt z_k0_has_fkt m_soll_k0_has_fkt z_p_hys_k0_has_fkt m_k0_mod_has_fkt z_ablauf_has_hst_in n_vm_in m_k0_in /end LOC_MEASUREMENT
 /begin SUB_FUNCTION SFOp_VMA24_Initialisierung_AST SFOp_VMA25_Initialisierung_AST SFOp_VMA26_Initialisierung_AST /end SUB_FUNCTION
/end FUNCTION
/begin FUNCTION SFOp_VMA15_st_start_vma ""
 /begin LOC_MEASUREMENT z_t_nvmausbed_ast_vma z_init_vma st_ablauf_fkt status_ablauf_has_fkt z_ablauf_svh_reset_has_fkt z_zuendfreigabe_vm_has_fkt z_k0_has_fkt m_soll_k0_has_fkt z_p_hys_k0_has_fkt m_k0_mod_has_fkt z_ablauf_has_hst_in n_vm_in m_k0_in /end LOC_MEASUREMENT
 /begin SUB_FUNCTION SFOp_VMA31_st_start_vma /end SUB_FUNCTION
/end FUNCTION
/begin FUNCTION SFOp_VMA16_st_uebergabe_vma ""
 /begin LOC_MEASUREMENT z_t_nvmausbed_ast_vma z_init_vma st_ablauf_fkt status_ablauf_has_fkt z_ablauf_svh_reset_has_fkt z_zuendfreigabe_vm_has_fkt z_k0_has_fkt m_soll_k0_has_fkt z_p_hys_k0_has_fkt m_k0_mod_has_fkt /end LOC_MEASUREMENT
 /begin SUB_FUNCTION SFOp_VMA40_Initialisierung /end SUB_FUNCTION
/end FUNCTION
/begin FUNCTION SFOp_VMA2_FOp_VMaus ""
 /begin LOC_MEASUREMENT st_ablauf_fkt status_ablauf_has_fkt z_ablauf_svh_reset_has_fkt z_zuendfreigabe_vm_has_fkt z_k0_has_fkt m_soll_k0_has_fkt z_p_hys_k0_has_fkt m_k0_mod_has_fkt z_ablauf_has_hst_in n_vm_in m_k0_in z_modus_em_hst_in c_getriebe_egs_in istgang_egs_in m_em_in m_iae_in m_max_dyn_em_in m_soll_em_hst_in m_soll_vm_hst_in m_vm_in m_vm_start_in m_wunsch_fpw_in n_ab_egs_in n_em_in n_soll_ll_vm_in n_t_egs_in osmode_next_in p_bremse_fzg_in sollgang_egs_in status_fehler_iep_in status_iae_in status_iep_in status_k0_in pos_egs_in z_ablaufvariante_has_hst_in zielgang_egs_in z_k0_fst_in m_mot_in status_iae_adap_in z_diag_ersfkt_has_in z_diag_ersfkt_hi_has_in z_diag_notgang_has_in status_k0_adap_in status_waschstr_in status_kraftfluss_egs_in z_n_min_em_parksp_has_in n_mot_soll_iae_in status_alaengs_adaoff_in gangwechsel_egs_in z_nllsoll_iae_in status_nem_in status_nvm_in kolbenpos_k0_in z_kps_stada_in t_betrieb_pvu_has_ee_in status_ll_vm_in z_msa_fst_in m_min_dyn_em_in phi_neigung_in v_f_in drehrichtung_nem_in fpw_in drehrichtung_nab_in schalt_mode_egs_in m_ziel_k0_hst_in status_kraftfluss_lev2_egs_in i_gang_lev2_egs_in status_c_k0_in bremspedal_in status_autohold_in status_hillhold_in status_vf_in v_f_ref_in status_vfref_in z_diag_ersfkt_hi_96_has_in status_k0_adap_zaehler_in status_k0_befuellung_in z_oea_hst_in z_iep_in z_nllsoll_iep_in c_vm_in n_soll_em_hst_in abstellpos_vm_in abstellpos_vm_status_in status_nreg_em_hst_in m_min_vm_in m_soll_vm_l_hst_in z_msa_stada_in m_wunsch_fpw_hst_in status_getrbereit_in /end LOC_MEASUREMENT
 /begin SUB_FUNCTION SFOp_VMA4_CalcFcn SFOp_VMA5_Input SFOp_VMA7_Output SFOp_VMA8_PhaseControl /end SUB_FUNCTION
/end FUNCTION
/begin FUNCTION SFOp_VMA24_Initialisierung_AST "" /begin DEF_CHARACTERISTIC STATUS_ABL_AST_VMA /end DEF_CHARACTERISTIC /begin LOC_MEASUREMENT st_ablauf_fkt status_ablauf_has_fkt /end LOC_MEASUREMENT /end FUNCTION
/begin FUNCTION SFOp_VMA25_Initialisierung_AST "" /begin DEF_CHARACTERISTIC K_SVH_RESET_AST_VMA /end DEF_CHARACTERISTIC /begin LOC_MEASUREMENT z_ablauf_svh_reset_has_fkt /end LOC_MEASUREMENT /end FUNCTION
/begin FUNCTION SFOp_VMA26_Initialisierung_AST "" /begin LOC_MEASUREMENT z_zuendfreigabe_vm_has_fkt /end LOC_MEASUREMENT /end FUNCTION
/begin FUNCTION SFOp_VMA31_st_start_vma "" /begin DEF_CHARACTERISTIC K_SVH_RESET_SRT_VMA /end DEF_CHARACTERISTIC
 /begin LOC_MEASUREMENT z_init_vma st_ablauf_fkt status_ablauf_has_fkt z_ablauf_svh_reset_has_fkt z_zuendfreigabe_vm_has_fkt z_k0_has_fkt m_soll_k0_has_fkt z_p_hys_k0_has_fkt m_k0_mod_has_fkt z_ablauf_has_hst_in n_vm_in m_k0_in /end LOC_MEASUREMENT
/end FUNCTION
/begin FUNCTION SFOp_VMA4_CalcFcn ""
 /begin LOC_MEASUREMENT z_t_nvmausbed_ast_vma z_init_vma st_ablauf_fkt status_ablauf_has_fkt z_ablauf_svh_reset_has_fkt z_zuendfreigabe_vm_has_fkt z_k0_has_fkt m_soll_k0_has_fkt z_p_hys_k0_has_fkt m_k0_mod_has_fkt z_ablauf_has_hst_in n_vm_in m_k0_in /end LOC_MEASUREMENT
 /begin SUB_FUNCTION SFOp_VMA14_st_abstellen_vma SFOp_VMA15_st_start_vma SFOp_VMA16_st_uebergabe_vma /end SUB_FUNCTION
/end FUNCTION
/begin FUNCTION SFOp_VMA40_Initialisierung "" /begin LOC_MEASUREMENT st_ablauf_fkt status_ablauf_has_fkt /end LOC_MEASUREMENT /end FUNCTION
/begin FUNCTION SFOp_VMA5_Input ""
 /begin LOC_MEASUREMENT z_t_nvmausbed_ast_vma z_init_vma st_ablauf_fkt status_ablauf_has_fkt z_ablauf_svh_reset_has_fkt z_zuendfreigabe_vm_has_fkt z_k0_has_fkt m_soll_k0_has_fkt z_p_hys_k0_has_fkt m_k0_mod_has_fkt z_ablauf_has_hst_in n_vm_in m_k0_in z_modus_em_hst_in c_getriebe_egs_in istgang_egs_in m_em_in m_iae_in m_max_dyn_em_in m_soll_em_hst_in m_soll_vm_hst_in m_vm_in m_vm_start_in m_wunsch_fpw_in n_ab_egs_in n_em_in n_soll_ll_vm_in n_t_egs_in osmode_next_in p_bremse_fzg_in sollgang_egs_in status_fehler_iep_in status_iae_in status_iep_in status_k0_in pos_egs_in z_ablaufvariante_has_hst_in zielgang_egs_in z_k0_fst_in m_mot_in status_iae_adap_in z_diag_ersfkt_has_in z_diag_ersfkt_hi_has_in z_diag_notgang_has_in status_k0_adap_in status_waschstr_in status_kraftfluss_egs_in z_n_min_em_parksp_has_in n_mot_soll_iae_in status_alaengs_adaoff_in gangwechsel_egs_in z_nllsoll_iae_in status_nem_in status_nvm_in kolbenpos_k0_in z_kps_stada_in t_betrieb_pvu_has_ee_in status_ll_vm_in z_msa_fst_in m_min_dyn_em_in phi_neigung_in v_f_in drehrichtung_nem_in fpw_in drehrichtung_nab_in schalt_mode_egs_in m_ziel_k0_hst_in status_kraftfluss_lev2_egs_in i_gang_lev2_egs_in status_c_k0_in bremspedal_in status_autohold_in status_hillhold_in status_vf_in v_f_ref_in status_vfref_in z_diag_ersfkt_hi_96_has_in status_k0_adap_zaehler_in status_k0_befuellung_in z_oea_hst_in z_iep_in z_nllsoll_iep_in c_vm_in n_soll_em_hst_in abstellpos_vm_in abstellpos_vm_status_in status_nreg_em_hst_in m_min_vm_in m_soll_vm_l_hst_in z_msa_stada_in m_wunsch_fpw_hst_in status_getrbereit_in /end LOC_MEASUREMENT
/end FUNCTION
/begin FUNCTION SFOp_VMA7_Output ""
 /begin LOC_MEASUREMENT z_t_nvmausbed_ast_vma z_init_vma st_ablauf_fkt status_ablauf_has_fkt z_ablauf_svh_reset_has_fkt z_zuendfreigabe_vm_has_fkt z_k0_has_fkt m_soll_k0_has_fkt z_p_hys_k0_has_fkt m_k0_mod_has_fkt /end LOC_MEASUREMENT
/end FUNCTION
/begin FUNCTION SFOp_VMA8_PhaseControl "" /begin DEF_CHARACTERISTIC Z_ABLAUFHASHST_VMAUSERK_VMA /end DEF_CHARACTERISTIC
 /begin LOC_MEASUREMENT z_t_nvmausbed_ast_vma z_init_vma z_ablauf_svh_reset_has_fkt z_zuendfreigabe_vm_has_fkt z_k0_has_fkt m_soll_k0_has_fkt z_p_hys_k0_has_fkt m_k0_mod_has_fkt z_ablauf_has_hst_in n_vm_in m_k0_in /end LOC_MEASUREMENT
/end FUNCTION
/begin FUNCTION SFOp_VME14_st_start_vme ""
 /begin LOC_MEASUREMENT z_t_nvmeinbed_zst_vme z_init_vme st_ablauf_fkt status_ablauf_has_fkt z_ablauf_svh_reset_has_fkt z_zuendfreigabe_vm_has_fkt z_k0_has_fkt m_soll_k0_has_fkt z_p_hys_k0_has_fkt m_k0_mod_has_fkt z_ablauf_has_hst_in n_vm_in m_k0_in /end LOC_MEASUREMENT
 /begin SUB_FUNCTION SFOp_VME18_st_start_vme /end SUB_FUNCTION
/end FUNCTION
/begin FUNCTION SFOp_VME15_st_uebergabe_vme ""
 /begin LOC_MEASUREMENT z_t_nvmeinbed_zst_vme z_init_vme st_ablauf_fkt status_ablauf_has_fkt z_ablauf_svh_reset_has_fkt z_zuendfreigabe_vm_has_fkt z_k0_has_fkt m_soll_k0_has_fkt z_p_hys_k0_has_fkt m_k0_mod_has_fkt /end LOC_MEASUREMENT
 /begin SUB_FUNCTION SFOp_VME27_Initialisierung /end SUB_FUNCTION
/end FUNCTION
/begin FUNCTION SFOp_VME16_st_zustarten_vme "" /begin DEF_CHARACTERISTIC NS_VMEINERK_ZST_VME T_NVMEINERK_ZST_VME /end DEF_CHARACTERISTIC
 /begin LOC_MEASUREMENT z_t_nvmeinbed_zst_vme z_init_vme t_nvmeinbed_zst_vme st_ablauf_fkt status_ablauf_has_fkt z_ablauf_svh_reset_has_fkt z_zuendfreigabe_vm_has_fkt z_k0_has_fkt m_soll_k0_has_fkt z_p_hys_k0_has_fkt m_k0_mod_has_fkt z_ablauf_has_hst_in n_vm_in m_k0_in /end LOC_MEASUREMENT
 /begin SUB_FUNCTION SFOp_VME35_Initialisierung SFOp_VME36_Initialisierung SFOp_VME37_Initialisierung /end SUB_FUNCTION
/end FUNCTION
/begin FUNCTION SFOp_VME18_st_start_vme "" /begin DEF_CHARACTERISTIC K_SVH_RESET_SRT_VME /end DEF_CHARACTERISTIC
 /begin LOC_MEASUREMENT z_init_vme st_ablauf_fkt status_ablauf_has_fkt z_ablauf_svh_reset_has_fkt z_zuendfreigabe_vm_has_fkt z_k0_has_fkt m_soll_k0_has_fkt z_p_hys_k0_has_fkt m_k0_mod_has_fkt z_ablauf_has_hst_in n_vm_in m_k0_in /end LOC_MEASUREMENT
/end FUNCTION
/begin FUNCTION SFOp_VME2_FOp_VMein ""
 /begin LOC_MEASUREMENT st_ablauf_fkt status_ablauf_has_fkt z_ablauf_svh_reset_has_fkt z_zuendfreigabe_vm_has_fkt z_k0_has_fkt m_soll_k0_has_fkt z_p_hys_k0_has_fkt m_k0_mod_has_fkt z_ablauf_has_hst_in n_vm_in m_k0_in z_modus_em_hst_in c_getriebe_egs_in istgang_egs_in m_em_in m_iae_in m_max_dyn_em_in m_soll_em_hst_in m_soll_vm_hst_in m_vm_in m_vm_start_in m_wunsch_fpw_in n_ab_egs_in n_em_in n_soll_ll_vm_in n_t_egs_in osmode_next_in p_bremse_fzg_in sollgang_egs_in status_fehler_iep_in status_iae_in status_iep_in status_k0_in pos_egs_in z_ablaufvariante_has_hst_in zielgang_egs_in z_k0_fst_in m_mot_in status_iae_adap_in z_diag_ersfkt_has_in z_diag_ersfkt_hi_has_in z_diag_notgang_has_in status_k0_adap_in status_waschstr_in status_kraftfluss_egs_in z_n_min_em_parksp_has_in n_mot_soll_iae_in status_alaengs_adaoff_in gangwechsel_egs_in z_nllsoll_iae_in status_nem_in status_nvm_in kolbenpos_k0_in z_kps_stada_in t_betrieb_pvu_has_ee_in status_ll_vm_in z_msa_fst_in m_min_dyn_em_in phi_neigung_in v_f_in drehrichtung_nem_in fpw_in drehrichtung_nab_in schalt_mode_egs_in m_ziel_k0_hst_in status_kraftfluss_lev2_egs_in i_gang_lev2_egs_in status_c_k0_in bremspedal_in status_autohold_in status_hillhold_in status_vf_in v_f_ref_in status_vfref_in z_diag_ersfkt_hi_96_has_in status_k0_adap_zaehler_in status_k0_befuellung_in z_oea_hst_in z_iep_in z_nllsoll_iep_in c_vm_in n_soll_em_hst_in abstellpos_vm_in abstellpos_vm_status_in status_nreg_em_hst_in m_min_vm_in m_soll_vm_l_hst_in z_msa_stada_in m_wunsch_fpw_hst_in status_getrbereit_in /end LOC_MEASUREMENT
 /begin SUB_FUNCTION SFOp_VME4_CalcFcn SFOp_VME5_Input SFOp_VME7_Output SFOp_VME8_PhaseControl /end SUB_FUNCTION
/end FUNCTION
/begin FUNCTION SFOp_VME27_Initialisierung "" /begin LOC_MEASUREMENT st_ablauf_fkt status_ablauf_has_fkt /end LOC_MEASUREMENT /end FUNCTION
/begin FUNCTION SFOp_VME35_Initialisierung "" /begin DEF_CHARACTERISTIC STATUS_ABL_ZST_VME /end DEF_CHARACTERISTIC /begin LOC_MEASUREMENT st_ablauf_fkt status_ablauf_has_fkt /end LOC_MEASUREMENT /end FUNCTION
/begin FUNCTION SFOp_VME36_Initialisierung "" /begin DEF_CHARACTERISTIC K_SVH_RESET_ZST_VME /end DEF_CHARACTERISTIC /begin LOC_MEASUREMENT z_ablauf_svh_reset_has_fkt /end LOC_MEASUREMENT /end FUNCTION
/begin FUNCTION SFOp_VME37_Initialisierung "" /begin LOC_MEASUREMENT z_zuendfreigabe_vm_has_fkt /end LOC_MEASUREMENT /end FUNCTION
/begin FUNCTION SFOp_VME4_CalcFcn ""
 /begin LOC_MEASUREMENT z_t_nvmeinbed_zst_vme z_init_vme st_ablauf_fkt status_ablauf_has_fkt z_ablauf_svh_reset_has_fkt z_zuendfreigabe_vm_has_fkt z_k0_has_fkt m_soll_k0_has_fkt z_p_hys_k0_has_fkt m_k0_mod_has_fkt z_ablauf_has_hst_in n_vm_in m_k0_in /end LOC_MEASUREMENT
 /begin SUB_FUNCTION SFOp_VME14_st_start_vme SFOp_VME15_st_uebergabe_vme SFOp_VME16_st_zustarten_vme /end SUB_FUNCTION
/end FUNCTION
/begin FUNCTION SFOp_VME5_Input ""
 /begin LOC_MEASUREMENT z_t_nvmeinbed_zst_vme z_init_vme st_ablauf_fkt status_ablauf_has_fkt z_ablauf_svh_reset_has_fkt z_zuendfreigabe_vm_has_fkt z_k0_has_fkt m_soll_k0_has_fkt z_p_hys_k0_has_fkt m_k0_mod_has_fkt z_ablauf_has_hst_in n_vm_in m_k0_in z_modus_em_hst_in c_getriebe_egs_in istgang_egs_in m_em_in m_iae_in m_max_dyn_em_in m_soll_em_hst_in m_soll_vm_hst_in m_vm_in m_vm_start_in m_wunsch_fpw_in n_ab_egs_in n_em_in n_soll_ll_vm_in n_t_egs_in osmode_next_in p_bremse_fzg_in sollgang_egs_in status_fehler_iep_in status_iae_in status_iep_in status_k0_in pos_egs_in z_ablaufvariante_has_hst_in zielgang_egs_in z_k0_fst_in m_mot_in status_iae_adap_in z_diag_ersfkt_has_in z_diag_ersfkt_hi_has_in z_diag_notgang_has_in status_k0_adap_in status_waschstr_in status_kraftfluss_egs_in z_n_min_em_parksp_has_in n_mot_soll_iae_in status_alaengs_adaoff_in gangwechsel_egs_in z_nllsoll_iae_in status_nem_in status_nvm_in kolbenpos_k0_in z_kps_stada_in t_betrieb_pvu_has_ee_in status_ll_vm_in z_msa_fst_in m_min_dyn_em_in phi_neigung_in v_f_in drehrichtung_nem_in fpw_in drehrichtung_nab_in schalt_mode_egs_in m_ziel_k0_hst_in status_kraftfluss_lev2_egs_in i_gang_lev2_egs_in status_c_k0_in bremspedal_in status_autohold_in status_hillhold_in status_vf_in v_f_ref_in status_vfref_in z_diag_ersfkt_hi_96_has_in status_k0_adap_zaehler_in status_k0_befuellung_in z_oea_hst_in z_iep_in z_nllsoll_iep_in c_vm_in n_soll_em_hst_in abstellpos_vm_in abstellpos_vm_status_in status_nreg_em_hst_in m_min_vm_in m_soll_vm_l_hst_in z_msa_stada_in m_wunsch_fpw_hst_in status_getrbereit_in /end LOC_MEASUREMENT
/end FUNCTION
/begin FUNCTION SFOp_VME7_Output ""
 /begin LOC_MEASUREMENT z_t_nvmeinbed_zst_vme z_init_vme st_ablauf_fkt status_ablauf_has_fkt z_ablauf_svh_reset_has_fkt z_zuendfreigabe_vm_has_fkt z_k0_has_fkt m_soll_k0_has_fkt z_p_hys_k0_has_fkt m_k0_mod_has_fkt /end LOC_MEASUREMENT
/end FUNCTION
/begin FUNCTION SFOp_VME8_PhaseControl "" /begin DEF_CHARACTERISTIC Z_ABLAUFHASHST_VMEINERK_VME /end DEF_CHARACTERISTIC
 /begin LOC_MEASUREMENT z_t_nvmeinbed_zst_vme z_init_vme z_ablauf_svh_reset_has_fkt z_zuendfreigabe_vm_has_fkt z_k0_has_fkt m_soll_k0_has_fkt z_p_hys_k0_has_fkt m_k0_mod_has_fkt z_ablauf_has_hst_in n_vm_in m_k0_in /end LOC_MEASUREMENT
/end FUNCTION
/begin FUNCTION SFOp_Zus105_Initialisierung "" /begin LOC_MEASUREMENT z_k0_has_fkt /end LOC_MEASUREMENT /end FUNCTION
/begin FUNCTION SFOp_Zus135_Initialisierung "" /begin DEF_CHARACTERISTIC STATUS_ABL_SYN_ZUS /end DEF_CHARACTERISTIC /begin LOC_MEASUREMENT st_ablauf_fkt status_ablauf_has_fkt /end LOC_MEASUREMENT /end FUNCTION
/begin FUNCTION SFOp_Zus141_Bitwise_AND_ui8 "" /begin DEF_CHARACTERISTIC BM_SCHALTARTNEMMODRS_SYN_ZUS /end DEF_CHARACTERISTIC /begin LOC_MEASUREMENT status_schaltart_svh_has_sbe /end LOC_MEASUREMENT /end FUNCTION
/begin FUNCTION SFOp_Zus165_Bitwise_AND_ui8 "" /begin LOC_MEASUREMENT status_schaltart_svh_has_sbe /end LOC_MEASUREMENT /end FUNCTION
/begin FUNCTION SFOp_Zus171_Initialisierung "" /begin DEF_CHARACTERISTIC STATUS_ABL_SAK_ZUS /end DEF_CHARACTERISTIC /begin LOC_MEASUREMENT st_ablauf_fkt status_ablauf_has_fkt /end LOC_MEASUREMENT /end FUNCTION
/begin FUNCTION SFOp_Zus178_Bitwise_AND_ui8 "" /begin LOC_MEASUREMENT status_schaltart_svh_has_sbe /end LOC_MEASUREMENT /end FUNCTION
/begin FUNCTION SFOp_Zus179_Initialisierung "" /begin LOC_MEASUREMENT z_zuendfreigabe_vm_has_fkt /end LOC_MEASUREMENT /end FUNCTION
/begin FUNCTION SFOp_Zus184_st_start_zus ""
 /begin DEF_CHARACTERISTIC Z_ABLAUF_ABBRUCH_ZUS SWI_ZPHYSK0_SRT_ZUS STATUS_ABL_ABBRFKT_SRT_ZUS K_SVH_RESETLAUSABLABBR_SRT_ZUS K_SVH_RESETLAUS_SRT_ZUS /end DEF_CHARACTERISTIC
 /begin LOC_MEASUREMENT z_svh_reset_zustand_zus z_k0sregbasis_zus z_k0sregaktiv_zus z_emaktiv_nemfehler_fuw_zus z_svh_palaus_sak_zus z_syncdda_zus z_ablaufvariante_sza_zus k_mstoerk0em_zus m_ziel_vm_has_zus ng_em_zus n_sec_iae_ziel_zus n_sec_iae_ist_zus m_stoerk0em_fil_zus modus_e_fahren_zus z_k0zuheiss_zus m_soll_k0_min_uvs_zus z_uvs_zus mo_k0befuell_zus m_k0_mod_has_fkt m_soll_em_has_fkt m_soll_k0_has_fkt n_soll_em_has_fkt n_soll_vm_has_fkt st_ablauf_fkt status_ablauf_has_fkt z_k0_has_fkt z_m_soll_em_has_fkt z_n_soll_em_has_fkt z_n_soll_vm_has_fkt z_zuendfreigabe_vm_has_fkt z_p_hys_k0_has_fkt m_soll_res_em_has_fkt z_emaktiv_fuw_zus_fkt z_saf_has_fkt z_m_max_iae_has_fkt m_max_iae_has_fkt z_ablaufvariante_kalt_zus z_emfehler_frk_dihi z_k0syncmk0erh_frk_dihi z_fuwdeakt_frk_dihi z_nsollvmnull_frk_dihi z_schaltprioverh_frk_dihi z_nsollvmanh_frk_dihi z_ablauf_has_stg z_ablaufvariante_has_stg c_getriebe_egs_in m_em_in m_k0_in m_max_dyn_em_in m_soll_vm_hst_in m_vm_in m_wunsch_fpw_in n_ab_egs_in n_em_in n_vm_in status_k0_in n_soll_ll_vm_in m_vm_start_in status_iae_in z_k0_fst_in istgang_egs_in status_kraftfluss_egs_in gangwechsel_egs_in sollgang_egs_in status_nem_in pos_egs_in z_ablauf_has_hst_in m_min_dyn_em_in m_ziel_k0_hst_in zielgang_egs_in kolbenpos_k0_in status_k0_befuellung_in m_soll_vm_l_hst_in status_nreg_em_hst_in m_min_vm_in m_wunsch_fpw_hst_in n_soll_em_hst_in abstellpos_vm_in nd_k0_in ndg_k0_in ng_vm_in status_schaltung_egs_in status_psys_has_sbe mg_wunsch_fpw_hst_in i_zielgang_egs status_schaltart_svh_has_sbe status_sync_schaltung_sbe z_pvu_has_sbe status_radschlupf_rse_has_sbe z_svh_has_sbe /end LOC_MEASUREMENT
/end FUNCTION
/begin FUNCTION SFOp_Zus2_FOp_ZUStart ""
 /begin LOC_MEASUREMENT m_k0_mod_has_fkt m_soll_em_has_fkt m_soll_k0_has_fkt n_soll_em_has_fkt n_soll_vm_has_fkt st_ablauf_fkt status_ablauf_has_fkt z_k0_has_fkt z_m_soll_em_has_fkt z_n_soll_em_has_fkt z_n_soll_vm_has_fkt z_zuendfreigabe_vm_has_fkt z_p_hys_k0_has_fkt m_soll_res_em_has_fkt z_emaktiv_fuw_zus_fkt z_saf_has_fkt z_m_max_iae_has_fkt m_max_iae_has_fkt z_ablauf_svh_reset_has_fkt z_ablaufvariante_kalt_zus z_ponr_fkt m_max_em_has_fkt m_min_em_has_fkt mg_soll_k0_has_fkt nd_min_saf_has_fkt nd_soll_iae_fkt z_fehler15_eh_fkt z_k0_befuellopt_has_fkt z_respschlepp_sas_fkt z_sbe_has_fkt z_zuendfreigabe_vm_fkt z_nvmsollbegr_frk_dihi z_statuspsysmps_frk_dihi z_nminemnull_frk_dihi z_emfehler_frk_dihi z_ablaufreinit_frk_dihi z_k0syncmk0erh_frk_dihi z_fuwdeakt_frk_dihi z_nemmin_frk_dihi z_vmstopverbot_frk_dihi z_vmstartverbot_frk_dihi z_zust_halten_frk_dihi z_zust_init_frk_dihi z_deaktiv_abo_frk_dihi z_vmstartanf_frk_dihi z_svh_frk_dihi z_iepein_frk_dihi z_nsollvmnull_frk_dihi z_ala_frk_dihi z_schaltprioverh_frk_dihi z_nsollvmanh_frk_dihi z_gebruefahrenaus_frk_dihi z_hybfkt_stg st_ziel_bz_has_stg st_ist_bz_has_stg st_ist_hcomd_has_stg z_ablauf_has_stg z_ablaufvariante_has_stg c_getriebe_egs_in m_em_in m_k0_in m_max_dyn_em_in m_soll_vm_hst_in m_vm_in m_wunsch_fpw_in n_ab_egs_in n_em_in n_vm_in status_k0_in n_soll_ll_vm_in m_vm_start_in status_iae_in z_k0_fst_in istgang_egs_in status_kraftfluss_egs_in gangwechsel_egs_in sollgang_egs_in status_nem_in pos_egs_in z_ablauf_has_hst_in m_min_dyn_em_in m_ziel_k0_hst_in zielgang_egs_in kolbenpos_k0_in status_k0_befuellung_in z_modus_em_hst_in m_iae_in m_soll_em_hst_in n_t_egs_in osmode_next_in p_bremse_fzg_in status_fehler_iep_in status_iep_in z_ablaufvariante_has_hst_in m_mot_in status_iae_adap_in z_diag_ersfkt_has_in z_diag_ersfkt_hi_has_in z_diag_notgang_has_in status_k0_adap_in status_waschstr_in z_n_min_em_parksp_has_in n_mot_soll_iae_in status_alaengs_adaoff_in z_nllsoll_iae_in status_nvm_in z_kps_stada_in t_betrieb_pvu_has_ee_in status_ll_vm_in z_msa_fst_in phi_neigung_in v_f_in drehrichtung_nem_in fpw_in drehrichtung_nab_in schalt_mode_egs_in status_kraftfluss_lev2_egs_in i_gang_lev2_egs_in status_c_k0_in bremspedal_in status_autohold_in status_hillhold_in status_vf_in v_f_ref_in status_vfref_in z_diag_ersfkt_hi_96_has_in status_k0_adap_zaehler_in z_oea_hst_in z_iep_in z_nllsoll_iep_in m_soll_vm_l_hst_in status_nreg_em_hst_in m_min_vm_in m_wunsch_fpw_hst_in n_soll_em_hst_in abstellpos_vm_in c_vm_in abstellpos_vm_status_in z_msa_stada_in status_getrbereit_in status_betriebsbereit_hst_in status_sa_vm_in z_ba_has_vm_hst_in z_ba_has_k0_hst_in status_abs_in status_asr_in modus_e_fahren_hst_in status_kl15_in status_posvueb_in soc_in status_soc_in c_umgebung_in status_cumgebung_in nd_k0_in ndg_k0_in ng_vm_in status_schaltung_egs_in status_psys_has_sbe mg_wunsch_fpw_hst_in i_zielgang_egs status_schaltart_svh_has_sbe status_sync_schaltung_sbe z_pvu_has_sbe status_radschlupf_rse_has_sbe i_istgang_egs m_wunsch_fpw_hst_fil mg_wunsch_fpw_in n_sec_iae n_min_em_psys_lp3_has_sbe vg_f_sbe v_f_sbe z_freigabe_pvu_has_sbe t_betrieb_pvu_has_sbe mg_mot_in z_svh_has_sbe m_motmax_has_sbe z_k0_has_sbe m_soll_res_em_has_sbe m_soll_res_em_bas_sbe z_modus_iae_has_sbe z_sas_has_sbe z_modus_iep_has_sbe z_msa_has_sbe status_efahren_has_sbe n_min_em_has_sbe z_msa_avh_moni_has_sbe z_msa_eaf_moni_has_sbe z_start_modus_has_sbe m_k0_mber_has_sbe z_lls_fktaktiv_has_sbe z_status_psys_mps_sbe m_k0_has_sbe m_soll_k0_has_sbe analyse_has_sbe z_nminemmodus_has_sbe /end LOC_MEASUREMENT
 /begin SUB_FUNCTION SFOp_Zus8_PhaseControl SFOp_Zus7_Output SFOp_Zus6_Input SFOp_Zus4_CalcFcn /end SUB_FUNCTION
/end FUNCTION
/begin FUNCTION SFOp_Zus204_Initialisierung ""
 /begin LOC_MEASUREMENT m_soll_em_has_fkt n_soll_em_has_fkt z_m_soll_em_has_fkt z_n_soll_em_has_fkt m_soll_res_em_has_fkt /end LOC_MEASUREMENT
/end FUNCTION
/begin FUNCTION SFOp_Zus205_Initialisierung "" /begin DEF_CHARACTERISTIC SWI_ZPHYSK0_UEB_ZUS /end DEF_CHARACTERISTIC
 /begin LOC_MEASUREMENT z_emaktiv_nemfehler_fuw_zus m_soll_k0_has_fkt z_k0_has_fkt z_p_hys_k0_has_fkt z_emaktiv_fuw_zus_fkt /end LOC_MEASUREMENT
/end FUNCTION
/begin FUNCTION SFOp_Zus207_Initialisierung "" /begin LOC_MEASUREMENT st_ablauf_fkt status_ablauf_has_fkt /end LOC_MEASUREMENT /end FUNCTION
/begin FUNCTION SFOp_Zus208_Initialisierung "" /begin LOC_MEASUREMENT z_saf_has_fkt /end LOC_MEASUREMENT /end FUNCTION
/begin FUNCTION SFOp_Zus209_Initialisierung ""
 /begin LOC_MEASUREMENT n_soll_vm_has_fkt z_n_soll_vm_has_fkt z_zuendfreigabe_vm_has_fkt /end LOC_MEASUREMENT
/end FUNCTION
/begin FUNCTION SFOp_Zus21_st_k0_schliessen_zus ""
 /begin DEF_CHARACTERISTIC KL_KSVHRESET_SCL_ZUS_Y KL_KSVHRESET_SCL_ZUS_X KL_MGK0MODHASMAX_SCL_ZUS_Y KL_MGK0MODHASMAX_SCL_ZUS_X KL_MGSOLLK0HASMAX_SCL_ZUS_Y KL_MGSOLLK0HASMAX_SCL_ZUS_X MG_K0MODHASMAXABBR_SCL_ZUS MG_K0MODHASMAXFUWKALT_SCL_ZUS MG_K0MODHASMAXK0SREG_SCL_ZUS MG_SOLLK0HASMAXABBR_SCL_ZUS MG_SOLLK0HASMAXFUWKALT_SCL_ZUS MO_SOLLVMHSTMSOLLK0_SCL_ZUS MO_SOLLVMLHSTMSOLLK0_SCL_ZUS NDS_K0GESCHL_SCL_ZUS T_MSOLLK0ANSTMAX_SCL_ZUS T_MK0MODZIEL_SCL_ZUS T_MAX_SCL_ZUS /end DEF_CHARACTERISTIC
 /begin LOC_MEASUREMENT m_ziel_k0_zus z_svh_reset_zustand_zus z_k0sregbasis_zus z_k0sregaktiv_zus z_emaktiv_nemfehler_fuw_zus m_stoerk0em_zus z_svh_palaus_sak_zus m_ziel_k0_min_syn_zus z_schwingungsyncerk_syn_zus mg_k0_mod_max_zus mg_soll_k0_max_zus t_m_soll_k0_anst_zus t_m_k0_mod_ziel_zus t_maxbed_scl_zus z_syncdda_zus z_ablaufvariante_sza_zus k_mstoerk0em_zus m_ziel_vm_has_zus ng_em_zus n_sec_iae_ziel_zus n_sec_iae_ist_zus m_stoerk0em_fil_zus modus_e_fahren_zus z_k0zuheiss_zus m_soll_k0_min_uvs_zus z_uvs_zus mo_k0befuell_zus m_k0_mod_has_fkt m_soll_em_has_fkt m_soll_k0_has_fkt n_soll_em_has_fkt n_soll_vm_has_fkt st_ablauf_fkt status_ablauf_has_fkt z_k0_has_fkt z_m_soll_em_has_fkt z_n_soll_em_has_fkt z_n_soll_vm_has_fkt z_zuendfreigabe_vm_has_fkt z_p_hys_k0_has_fkt m_soll_res_em_has_fkt z_emaktiv_fuw_zus_fkt z_saf_has_fkt z_m_max_iae_has_fkt m_max_iae_has_fkt z_ablaufvariante_kalt_zus z_emfehler_frk_dihi z_k0syncmk0erh_frk_dihi z_fuwdeakt_frk_dihi z_nsollvmnull_frk_dihi z_schaltprioverh_frk_dihi z_nsollvmanh_frk_dihi z_ablauf_has_stg z_ablaufvariante_has_stg c_getriebe_egs_in m_em_in m_k0_in m_max_dyn_em_in m_soll_vm_hst_in m_vm_in m_wunsch_fpw_in n_ab_egs_in n_em_in n_vm_in status_k0_in n_soll_ll_vm_in m_vm_start_in status_iae_in z_k0_fst_in istgang_egs_in status_kraftfluss_egs_in gangwechsel_egs_in sollgang_egs_in status_nem_in pos_egs_in z_ablauf_has_hst_in m_min_dyn_em_in m_ziel_k0_hst_in zielgang_egs_in kolbenpos_k0_in status_k0_befuellung_in m_soll_vm_l_hst_in status_nreg_em_hst_in m_min_vm_in m_wunsch_fpw_hst_in n_soll_em_hst_in abstellpos_vm_in nd_k0_in ndg_k0_in ng_vm_in status_schaltung_egs_in status_psys_has_sbe mg_wunsch_fpw_hst_in i_zielgang_egs status_schaltart_svh_has_sbe status_sync_schaltung_sbe z_pvu_has_sbe status_radschlupf_rse_has_sbe z_svh_has_sbe /end LOC_MEASUREMENT
 /begin SUB_FUNCTION Run_SFOp_Zus43_cLimiter_Gradient_m_mod_has Run_SFOp_Zus44_cLimiter_Gradient_m_soll_k0_has SFOp_Zus38_Initialisierung SFOp_Zus63_Initialisierung SFOp_Zus59_Initialisierung SFOp_Zus40_Initialisierung Run_SFOp_Zus42_abs_fl32 /end SUB_FUNCTION
/end FUNCTION
/begin FUNCTION SFOp_Zus216_Initialisierung "" /begin DEF_CHARACTERISTIC SWI_ZPHYSK0_UAB_ZUS /end DEF_CHARACTERISTIC /begin LOC_MEASUREMENT m_soll_k0_has_fkt z_k0_has_fkt z_p_hys_k0_has_fkt /end LOC_MEASUREMENT /end FUNCTION
/begin FUNCTION SFOp_Zus217_Initialisierung "" /begin LOC_MEASUREMENT st_ablauf_fkt status_ablauf_has_fkt /end LOC_MEASUREMENT /end FUNCTION
/begin FUNCTION SFOp_Zus218_Initialisierung "" /begin LOC_MEASUREMENT z_saf_has_fkt /end LOC_MEASUREMENT /end FUNCTION
/begin FUNCTION SFOp_Zus219_Initialisierung "" /begin LOC_MEASUREMENT n_soll_vm_has_fkt z_n_soll_vm_has_fkt /end LOC_MEASUREMENT /end FUNCTION
/begin RECORD_LAYOUT FLOAT32_IEEE_COL_DIRECT_M_S7_S3 FNC_VALUES 1 FLOAT32_IEEE COLUMN_DIR DIRECT /end RECORD_LAYOUT
/begin RECORD_LAYOUT FLOAT32_IEEE_X_INCR_DIRECT_M_S7_S3 AXIS_PTS_X 1 FLOAT32_IEEE INDEX_INCR DIRECT /end RECORD_LAYOUT
/begin RECORD_LAYOUT SBYTE_X_INCR_DIRECT_M_S7_S3 AXIS_PTS_X 1 SBYTE INDEX_INCR DIRECT /end RECORD_LAYOUT
/begin RECORD_LAYOUT UBYTE_COL_DIRECT_M_S7_S3 FNC_VALUES 1 UBYTE COLUMN_DIR DIRECT /end RECORD_LAYOUT
/begin RECORD_LAYOUT UBYTE_X_INCR_DIRECT_M_S7_S3 AXIS_PTS_X 1 UBYTE INDEX_INCR DIRECT /end RECORD_LAYOUT
/begin RECORD_LAYOUT UWORD_COL_DIRECT_M_S7_S3 FNC_VALUES 1 UWORD COLUMN_DIR DIRECT /end RECORD_LAYOUT
/end MODULE
/end PROJECT
