ASAP2_VERSION 1 51
/begin PROJECT _929_929 "Gen2_BMW_System_Supplier_Lib"
/begin HEADER "" VERSION "C_03_03" PROJECT_NO _929_929 /end HEADER
/begin MODULE DIM ""
/begin MOD_COMMON "" BYTE_ORDER MSB_FIRST ALIGNMENT_BYTE 1 ALIGNMENT_WORD 2 ALIGNMENT_LONG 4 ALIGNMENT_FLOAT32_IEEE 4 /end MOD_COMMON
/begin CHARACTERISTIC SWI_AutoPos "Enable Auto Position (0=OFF 1=ON_but_no_HoldN 2=ON)" VALUE 0x2182D2 ZF_Parameter.ui8_S1_S3 2 UMR___1_1_0_S1_S3 0 2 /end CHARACTERISTIC
/begin CHARACTERISTIC SWI_AutoP_EMF_Help "Enable Auto Postion P for EMF Help Message" VALUE 0x2182D1 ZF_Parameter.ui8_S1_S3 1 UMR___1_1_0_S1_S3 0 1 /end CHARACTERISTIC
/begin CHARACTERISTIC D_v_EnableAutoPHelp "Upper Speed Threshold for Enable Auto P by EMF Help Message" VALUE 0x2182CA ZF_Parameter.ui16_S1_S3 4095 UMR_VKMH__1_16_0_S1_S3 0 4095 /end CHARACTERISTIC
/begin CHARACTERISTIC SWI_AutoP_DrvLeavesCar "Enable Auto Postion P for driver leaves car" VALUE 0x2182D0 ZF_Parameter.ui8_S1_S3 1 UMR___1_1_0_S1_S3 0 1 /end CHARACTERISTIC
/begin CHARACTERISTIC D_v_AutoP_DrvLeavesCar "Auto P Upper Speed Threshold to enable P when driver leaves car" VALUE 0x2182C4 ZF_Parameter.ui16_S1_S3 4095 UMR_VKMH__1_16_0_S1_S3 0 4095 /end CHARACTERISTIC
/begin CHARACTERISTIC D_v_AutoP_Uth "Auto P Upper Speed Threshold for xxx" VALUE 0x2182C8 ZF_Parameter.ui16_S1_S3 4095 UMR_VKMH__1_16_0_S1_S3 0 4095 /end CHARACTERISTIC
/begin CHARACTERISTIC SWI_AutoP_DriverPresenceUnknown "Switch to activate Auto-P function if driver presence is unknown" VALUE 0x2182CF ZF_Parameter.ui8_S1_S3 1 UMR___1_1_0_S1_S3 0 1 /end CHARACTERISTIC
/begin CHARACTERISTIC D_v_AutoP_DrvPresenceUnknown_Uth "Speed threshold to engage Auto-P due to unknown driver presence" VALUE 0x2182C6 ZF_Parameter.ui16_S1_S3 4095 UMR_VKMH__1_16_0_S1_S3 0 4095 /end CHARACTERISTIC
/begin CHARACTERISTIC D_st_VehDrvRdy "State from vehicle readiness" VALUE 0x2182CC ZF_Parameter.ui8_S1_S3 255 UMR___1_1_0_S1_S3 0 255 /end CHARACTERISTIC
/begin CHARACTERISTIC SWI_AutoPosP_ByChargingPlug "Selection of Auto P condition for charging plug.: 0=inactive 1=detected 2=detected OR unknown" VALUE 0x2182D3 ZF_Parameter.ui8_S1_S3 2 UMR___1_1_0_S1_S3 0 2 /end CHARACTERISTIC
/begin CHARACTERISTIC SWI_AutoN_EngineRot_Depend "Switch to activate AutoN by Engine revolution" VALUE 0x2182CD ZF_Parameter.ui8_S1_S3 7 UMR___1_1_0_S1_S3 0 7 /end CHARACTERISTIC
/begin CHARACTERISTIC D_v_AutoN_Engine_Off_Uth "Speed threshold to engage Auto-N due to Engine off" VALUE 0x2182C2 ZF_Parameter.ui16_S1_S3 4095 UMR_VKMH__1_16_0_S1_S3 0 4095 /end CHARACTERISTIC
/begin CHARACTERISTIC SWI_AutoP_Auto_N_but_P_Engaged "0: Normal AutoN functionality 1: If P is engaged in AutoN situations, an auto position P will be executed." VALUE 0x2182CE ZF_Parameter.ui8_S1_S3 1 UMR___1_1_0_S1_S3 0 1 /end CHARACTERISTIC
/begin CHARACTERISTIC D_v_HoldN "speed threshold for detection of N-Hold period" VALUE 0x2182D4 ZF_Parameter.ui16_S1_S3 4095 UMR_VKMH__1_16_0_S1_S3 0 4095 /end CHARACTERISTIC
/begin CHARACTERISTIC D_t_DebounceRD2N "Debounce Time for driver request RD2N" VALUE 0x207A57 ZF_Parameter.ui8_S1_S3 2550 UMR_MBSE_MSEC__10_1_0_S1_S3 0 2550 /end CHARACTERISTIC
/begin CHARACTERISTIC D_v_DebounceNA2NUth "Upper Speed Threshold for Debounce of NA to N" VALUE 0x207A54 ZF_Parameter.ui16_S1_S3 4095 UMR_VKMH__1_16_0_S1_S3 0 4095 /end CHARACTERISTIC
/begin CHARACTERISTIC D_t_DebounceNA2N "Debounce Time for driver request NA2N" VALUE 0x207A56 ZF_Parameter.ui8_S1_S3 2550 UMR_MBSE_MSEC__10_1_0_S1_S3 0 2550 /end CHARACTERISTIC
/begin CHARACTERISTIC SWI_CC_DrvLeavesCarBeltLocked "switch for message mode" VALUE 0x207A5A ZF_Parameter.ui8_S1_S3 1 UMR___1_1_0_S1_S3 0 1 /end CHARACTERISTIC
/begin CHARACTERISTIC D_t_DrvLeavesCarInN "start value for debounce timer for nr. of events driver leaves car in pos.N" VALUE 0x207A58 ZF_Parameter.ui16_S1_S3 65535 UMR_MBSE_MSEC__10_1_0_S1_S3 0 65535 /end CHARACTERISTIC
/begin CHARACTERISTIC SWI_DriverPresenceDetectionByTCU "If activated the TCU internal determination for hybrid variants Driver Presence Detection is used" VALUE 0x207A5B ZF_Parameter.ui8_S1_S3 1 UMR___1_1_0_S1_S3 0 1 /end CHARACTERISTIC
/begin CHARACTERISTIC D_t_DebounceGearboxReady "time-delay for DebounceGearboxReady" VALUE 0x2182D6 ZF_Parameter.ui8_S1_S3 2550 UMR_MBSE_MSEC__10_1_0_S1_S3 0 2550 /end CHARACTERISTIC
/begin CHARACTERISTIC D_t_DebounceGearboxReadySts "time-delay for DebounceGearboxReadySts" VALUE 0x2182D7 ZF_Parameter.ui8_S1_S3 2550 UMR_MBSE_MSEC__10_1_0_S1_S3 0 2550 /end CHARACTERISTIC
/begin CHARACTERISTIC SWI_FAS_Active "activation-switch for PMA/RCP-functionality" VALUE 0x20229D ZF_Parameter.ui8_S1_S3 1 UMR___1_1_0_S1_S3 0 1 /end CHARACTERISTIC
/begin CHARACTERISTIC SWI_NoDrvAssist_ViaSubstFunct "activated influence of subst-actions in DI_GET_ALL_SUBST_FUNCT for PMA/RCP-functionality" VALUE 0x202294 ZF_Parameter.ui32_S1_S3 4.29497E+009 UMR___1_1_0_S1_S3 0 4294967295 /end CHARACTERISTIC
/begin CHARACTERISTIC SWI_NoDrvAssist_ViaSubstFunct_Hi "activated influence of subst-actions in DI_GET_ALL_SUBST_FUNCT_HI for PMA/RCP-functionality" VALUE 0x202298 ZF_Parameter.ui32_S1_S3 4.29497E+009 UMR___1_1_0_S1_S3 0 4294967295 /end CHARACTERISTIC
/begin CHARACTERISTIC SWI_DAS_StoreP "activation-switch for PMA/RCP-P-storing-functionality" VALUE 0x20229C ZF_Parameter.ui8_S1_S3 1 UMR___1_1_0_S1_S3 0 1 /end CHARACTERISTIC
/begin CHARACTERISTIC D_t_PosDrvAssistFilt "table to calibrate filter-time for delaying external PMA-request [PRND]: x=actualPos y=posRequest" MAP 0x20229E ZF_Matrix.ui8_S1_S3 2550 UMR_MBSE_MSEC__10_1_0_S1_S3 0 2550
 /begin AXIS_DESCR FIX_AXIS NO_INPUT_QUANTITY ePosPRND_S1_S3 4 0 3 FIX_AXIS_PAR_DIST 0 1 4 /end AXIS_DESCR
 /begin AXIS_DESCR FIX_AXIS NO_INPUT_QUANTITY ePosPRND_S1_S3 4 0 3 FIX_AXIS_PAR_DIST 0 1 4 /end AXIS_DESCR
/end CHARACTERISTIC
/begin CHARACTERISTIC SWI_InitPosByBistableParklock "Select if RzN initial position D for bistable parklock is activated" VALUE 0x2182E2 ZF_Parameter.ui8_S1_S3 1 UMR___1_1_0_S1_S3 0 1 /end CHARACTERISTIC
/begin CHARACTERISTIC SWI_InitPosN_RzN_SbwShifter "Select if initial position N for monostable parklock is activated" VALUE 0x2182E5 ZF_Parameter.ui8_S1_S3 1 UMR___1_1_0_S1_S3 0 1 /end CHARACTERISTIC
/begin CHARACTERISTIC SWI_InitPosD_RzN_SbwShifter "Select if Initpos RD after RzN is possible" VALUE 0x2182E4 ZF_Parameter.ui8_S1_S3 1 UMR___1_1_0_S1_S3 0 1 /end CHARACTERISTIC
/begin CHARACTERISTIC SWI_InitPosP_PrioByPSensor "0 - by the gearbox output speed, \\ 1 - by the Parklock Sensor, \\ 2 - first by the Parklock Sensor or second by gearbox output speed, \\ 3 - first by gearbox output speed or second the by Parklock Sensor, 4 - recommended calculation of initpos for all SB..." VALUE 0x2182E6 ZF_Parameter.ui8_S1_S3 4 UMR___1_1_0_S1_S3 0 4
 /begin ANNOTATION ANNOTATION_LABEL "Description"
  /begin ANNOTATION_TEXT "0 - by the gearbox output speed, \\ 1 - by the Parklock Sensor, \\ 2 - first by the Parklock Sensor or second by gearbox output speed, \\ 3 - first by gearbox output speed or second the by Parklock Sensor, 4 - recommended calculation of initpos for all SBW g" "earboxes" /end ANNOTATION_TEXT
 /end ANNOTATION
/end CHARACTERISTIC
/begin CHARACTERISTIC SWI_InitPosD "Select if inital position D is possible" VALUE 0x2182E3 ZF_Parameter.ui8_S1_S3 1 UMR___1_1_0_S1_S3 0 1 /end CHARACTERISTIC
/begin CHARACTERISTIC D_n_Ab_Init_PosP "threshold drive/output rev.s for recognition of P" VALUE 0x2182D8 ZF_Parameter.ui16_S1_S3 65535 UMR_RPM_1_1_0_S1_S3 0 65535 /end CHARACTERISTIC
/begin CHARACTERISTIC D_v_DrvDir_Lth "speed threshold for releasing driving direction" VALUE 0x2182DA ZF_Parameter.ui16_S1_S3 4095 UMR_VKMH__1_16_0_S1_S3 0 4095 /end CHARACTERISTIC
/begin CHARACTERISTIC D_v_VehSpd_Init_PosD "speed threshold for initpos D" VALUE 0x2182DE ZF_Parameter.ui16_S1_S3 4095 UMR_VKMH__1_16_0_S1_S3 0 4095 /end CHARACTERISTIC
/begin CHARACTERISTIC D_v_VehSpd_InitPosD_RzN "speed threshold for initpos D" VALUE 0x2182DC ZF_Parameter.ui16_S1_S3 4095 UMR_VKMH__1_16_0_S1_S3 0 4095 /end CHARACTERISTIC
/begin CHARACTERISTIC SWI_DrvDirBackupAccepted "Select if signal status of DrivingDirection is used" VALUE 0x2182E0 ZF_Parameter.ui8_S1_S3 1 UMR___1_1_0_S1_S3 0 1 /end CHARACTERISTIC
/begin CHARACTERISTIC SWI_DrvDirPosPRNDAccepted "Select if PosPRND is used for evaluatong DirBuf" VALUE 0x2182E1 ZF_Parameter.ui8_S1_S3 1 UMR___1_1_0_S1_S3 0 1 /end CHARACTERISTIC
/begin CHARACTERISTIC SWI_RESUB_PathMechLimp "Switches on the MechLimp-Path of the computation of KFC_RESUB" VALUE 0x2182E7 ZF_Parameter.ui8_S1_S3 1 UMR___1_1_0_S1_S3 0 1 /end CHARACTERISTIC
/begin CHARACTERISTIC SWI_RESUB_PathResUBatt "Switches on the ResUBatt-Path of the computation of KFC_RESUB" VALUE 0x2182E8 ZF_Parameter.ui8_S1_S3 1 UMR___1_1_0_S1_S3 0 1 /end CHARACTERISTIC
/begin CHARACTERISTIC D_GearSourceAtFlashOffEngRunning "Array for Gear Source Choice for every DisplayMode from 0-3, Gear Sources:0-None 1-Current 2-Destination 3-Shiftstrat 4-Computed" CURVE 0x207A5C ZF_Table.ui8_S1_S3 3 UMR___1_1_0_S1_S3 0 3
 /begin AXIS_DESCR FIX_AXIS NO_INPUT_QUANTITY UMR___1_1_0_S1_S3 4 0 3 FIX_AXIS_PAR_DIST 0 1 4 /end AXIS_DESCR
/end CHARACTERISTIC
/begin CHARACTERISTIC D_GearSourceAtFlashOnEngRunning "Array for Gear Source Choice for every DisplayMode from 0-3, Gear Sources:0-None 1-Current 2-Destination 3-Shiftstrat 4-Computed" CURVE 0x207A60 ZF_Table.ui8_S1_S3 3 UMR___1_1_0_S1_S3 0 3
 /begin AXIS_DESCR FIX_AXIS NO_INPUT_QUANTITY UMR___1_1_0_S1_S3 4 0 3 FIX_AXIS_PAR_DIST 0 1 4 /end AXIS_DESCR
/end CHARACTERISTIC
/begin CHARACTERISTIC SWI_DispMode "Select Display Mode 0=NoMode 1=SBW 2=FS-driving strategy" VALUE 0x218047 ZF_Parameter.ui8_S1_S3 2 UMR___1_1_0_S1_S3 0 2 /end CHARACTERISTIC
/begin CHARACTERISTIC SWI_DispPosInStandby "Select if position displayed or dark in State Standby before Cruise" VALUE 0x2182EB ZF_Parameter.ui8_S1_S3 1 UMR___1_1_0_S1_S3 0 1 /end CHARACTERISTIC
/begin CHARACTERISTIC SWI_DispExtension "Switch to determine behaviour of display-pos. in overshoot state: 0=disp.pos immediately dark / 1=not dark after EGS sleep-ready" VALUE 0x2182EA ZF_Parameter.ui8_S1_S3 1 UMR___1_1_0_S1_S3 0 1 /end CHARACTERISTIC
/begin CHARACTERISTIC D_t_Lev2DispError "L2 filter time to suspend KFC3_LEV2" VALUE 0x26F21E ZF_Parameter.ui8_S1_S3 100 UMR_MBSE_MSEC__10_1_0_S1_S3 0 100 /end CHARACTERISTIC
/begin CHARACTERISTIC SWI_RelToAbsUsesDisplayPosIfNotDark_L2 "Attention: Same value as SWI_RelToAbsUsesDisplayPosIfNotDark otherwise KFC3_LEV2" VALUE 0x26F230 ZF_Parameter.ui8_S1_S3 1 UMR___1_1_0_S1_S3 0 1 /end CHARACTERISTIC
/begin CHARACTERISTIC D_v_P_Lth_L2 "Attention: Same value as D_v_P_Lth otherwise KFC3_LEV2" VALUE 0x26F20C ZF_Parameter.ui16_S1_S3 4095 UMR_VKMH__1_16_0_S1_S3 0 4095 /end CHARACTERISTIC
/begin CHARACTERISTIC D_t_StoreR_L2 "Attention: Same value as D_t_StoreR otherwise KFC3_LEV2" VALUE 0x26F1FE ZF_Parameter.ui16_S1_S3 655350 UMR_MBSE_MSEC__10_1_0_S1_S3 0 655350 /end CHARACTERISTIC
/begin CHARACTERISTIC D_t_StoreD_L2 "Attention: Same value as D_t_StoreD otherwise KFC3_LEV2" VALUE 0x26F1F6 ZF_Parameter.ui16_S1_S3 655350 UMR_MBSE_MSEC__10_1_0_S1_S3 0 655350 /end CHARACTERISTIC
/begin CHARACTERISTIC D_t_StoreRD_EngStart_L2 "Attention: Same value as D_t_StoreRD_EngStart otherwise KFC3_LEV2" VALUE 0x26F1FC ZF_Parameter.ui16_S1_S3 3000 UMR_MBSE_MSEC__10_1_0_S1_S3 0 3000 /end CHARACTERISTIC
/begin CHARACTERISTIC SWI_StoreRD_RestartTimerWhileShifterInRD_L2 "Attention: Same value as SWI_StoreRD_RestartTimerWhileShifterInRD otherwise KFC3_LEV2" VALUE 0x26F231 ZF_Parameter.ui8_S1_S3 1 UMR___1_1_0_S1_S3 0 1 /end CHARACTERISTIC
/begin CHARACTERISTIC D_v_AutoP_Uth_L2 "Attention: Same value as D_v_AutoP_Uth otherwise KFC3_LEV2" VALUE 0x26F206 ZF_Parameter.ui16_S1_S3 4095 UMR_VKMH__1_16_0_S1_S3 0 4095 /end CHARACTERISTIC
/begin CHARACTERISTIC D_t_DebounceGearboxReady_L2 "time-delay for DebounceGearboxReady_L2" VALUE 0x26F21A ZF_Parameter.ui8_S1_S3 2550 UMR_MBSE_MSEC__10_1_0_S1_S3 0 2550 /end CHARACTERISTIC
/begin CHARACTERISTIC D_t_DebounceGearboxReadySts_L2 "ime-delay for DebounceGearboxReadySts_L2" VALUE 0x26F219 ZF_Parameter.ui8_S1_S3 2550 UMR_MBSE_MSEC__10_1_0_S1_S3 0 2550 /end CHARACTERISTIC
/begin CHARACTERISTIC D_v_AutoN_Uth_L2 "level 2 speed threshold of autom. engagement of N in case of error n_Eng" VALUE 0x26F202 ZF_Parameter.ui16_S1_S3 4095 UMR_VKMH__1_16_0_S1_S3 0 4095 /end CHARACTERISTIC
/begin CHARACTERISTIC SWI_InitPosByBistableParklock_L2 "elect if RzN initial position D for bistable parklock is activated" VALUE 0x26F228 ZF_Parameter.ui8_S1_S3 1 UMR___1_1_0_S1_S3 0 1 /end CHARACTERISTIC
/begin CHARACTERISTIC SWI_InitPosN_RzN_SbwShifter_L2 "Select if initial position N for monostable parklock is activated" VALUE 0x26F22B ZF_Parameter.ui8_S1_S3 1 UMR___1_1_0_S1_S3 0 1 /end CHARACTERISTIC
/begin CHARACTERISTIC SWI_InitPosD_RzN_SbwShifter_L2 "Select if Initpos RD after RzN is possible" VALUE 0x26F22A ZF_Parameter.ui8_S1_S3 1 UMR___1_1_0_S1_S3 0 1 /end CHARACTERISTIC
/begin CHARACTERISTIC SWI_InitPosP_PrioByPSensor_L2 "0 - by the gearbox output speed \\ 1 - by the Parklock Sensor \\ 2 - first by the Parklock Sensor or second by gearbox output speed \\ 3 - first by gearbox output speed or second the by Parklock Sensor \\ 4 - recommended calculation of initpos for all SBW ..." VALUE 0x26F22C ZF_Parameter.ui8_S1_S3 4 UMR___1_1_0_S1_S3 0 4
 /begin ANNOTATION ANNOTATION_LABEL "Description"
  /begin ANNOTATION_TEXT "0 - by the gearbox output speed \\ 1 - by the Parklock Sensor \\ 2 - first by the Parklock Sensor or second by gearbox output speed \\ 3 - first by gearbox output speed or second the by Parklock Sensor \\ 4 - recommended calculation of initpos for all SBW gea" "rboxes" /end ANNOTATION_TEXT
 /end ANNOTATION
/end CHARACTERISTIC
/begin CHARACTERISTIC SWI_InitPosD_L2 "Select if inital position D is possible" VALUE 0x26F229 ZF_Parameter.ui8_S1_S3 1 UMR___1_1_0_S1_S3 0 1 /end CHARACTERISTIC
/begin CHARACTERISTIC SWI_RESUB_PathMechLimp_L2 "uses mechanical limphome to compute initial position" VALUE 0x26F22E ZF_Parameter.ui8_S1_S3 1 UMR___1_1_0_S1_S3 0 1 /end CHARACTERISTIC
/begin CHARACTERISTIC SWI_RESUB_PathResUBatt_L2 "uses KFC_RESUB to compute initial position" VALUE 0x26F22F ZF_Parameter.ui8_S1_S3 1 UMR___1_1_0_S1_S3 0 1 /end CHARACTERISTIC
/begin CHARACTERISTIC D_v_VehSpd_Init_PosD_L2 "speed threshold for initpos D" VALUE 0x26F216 ZF_Parameter.ui16_S1_S3 4095 UMR_VKMH__1_16_0_S1_S3 0 4095 /end CHARACTERISTIC
/begin CHARACTERISTIC D_v_VehSpd_InitPosD_RzN_L2 "speed threshold for initpos D" VALUE 0x26F214 ZF_Parameter.ui16_S1_S3 4095 UMR_VKMH__1_16_0_S1_S3 0 4095 /end CHARACTERISTIC
/begin CHARACTERISTIC D_n_Ab_Init_PosP_L2 "L2 threshold drive/output rev.s for recognition of P" VALUE 0x26F1F4 ZF_Parameter.ui16_S1_S3 65535 UMR_RPM_1_1_0_S1_S3 0 65535 /end CHARACTERISTIC
/begin CHARACTERISTIC D_t_StoreN_L2 "L2 Storage Time for driver request N" VALUE 0x26F1FA ZF_Parameter.ui16_S1_S3 655350 UMR_MBSE_MSEC__10_1_0_S1_S3 0 655350 /end CHARACTERISTIC
/begin CHARACTERISTIC D_t_StoreN_EGNER_L2 "L2 Storage Time for driver request N e-GNER" VALUE 0x26F1F8 ZF_Parameter.ui16_S1_S3 655350 UMR_MBSE_MSEC__10_1_0_S1_S3 0 655350 /end CHARACTERISTIC
/begin CHARACTERISTIC D_v_N_Uth_L2 "L2 POS N upper speed threshold" VALUE 0x26F20A ZF_Parameter.ui16_S1_S3 4095 UMR_VKMH__1_16_0_S1_S3 0 4095 /end CHARACTERISTIC
/begin CHARACTERISTIC D_t_Lev2PosError_L2 "description" VALUE 0x26F220 ZF_Parameter.ui8_S1_S3 100 UMR_MBSE_MSEC__10_1_0_S1_S3 0 100 /end CHARACTERISTIC
/begin CHARACTERISTIC SWI_AutoPos_L2 "L2 Enable Auto Position (0=OFF 1=ON_but_no_HoldN 2=ON)" VALUE 0x26F224 ZF_Parameter.ui8_S1_S3 2 UMR___1_1_0_S1_S3 0 2 /end CHARACTERISTIC
/begin CHARACTERISTIC D_t_DebounceNA2N_L2 "L2 Debounce Time for driver request NA2N" VALUE 0x26F21B ZF_Parameter.ui8_S1_S3 2550 UMR_MBSE_MSEC__10_1_0_S1_S3 0 2550 /end CHARACTERISTIC
/begin CHARACTERISTIC D_t_DebounceRD2N_L2 "L2 Debounce Time for driver request RD2N" VALUE 0x26F21C ZF_Parameter.ui8_S1_S3 2550 UMR_MBSE_MSEC__10_1_0_S1_S3 0 2550 /end CHARACTERISTIC
/begin CHARACTERISTIC D_AcceleratorPedalAngleTh_L2 "Level2 Angle threshold for Accelerator Pedal" VALUE 0x26F218 ZF_Parameter.ui8_S1_S3 100.4 UMR_HDK_M_1004_2550_S1_S3 0 100.4 /end CHARACTERISTIC
/begin CHARACTERISTIC SWI_AutoP_DrvLeavesCar_L2 "Enable Auto Postion P for driver leaves car" VALUE 0x26F223 ZF_Parameter.ui8_S1_S3 1 UMR___1_1_0_S1_S3 0 1 /end CHARACTERISTIC
/begin CHARACTERISTIC D_v_AutoP_DrvLeavesCar_L2 "Auto P Upper Speed Threshold to enable P when driver leaves car" VALUE 0x26F204 ZF_Parameter.ui16_S1_S3 4095 UMR_VKMH__1_16_0_S1_S3 0 4095 /end CHARACTERISTIC
/begin CHARACTERISTIC D_v_Shiftlock_Uth_L2 "speed threshold for deactivation shiftlock [PN-lock]" VALUE 0x26F212 ZF_Parameter.ui16_S1_S3 4095 UMR_VKMH__1_16_0_S1_S3 0 4095 /end CHARACTERISTIC
/begin CHARACTERISTIC D_t_Lev2DispError_L2 "L2 filter time to suspend KFC3_LEV2" VALUE 0x26F21F ZF_Parameter.ui8_S1_S3 100 UMR_MBSE_MSEC__10_1_0_S1_S3 0 100 /end CHARACTERISTIC
/begin CHARACTERISTIC D_v_D_Lth_L2 "L2 Lower speed threshold for driver request D" VALUE 0x26F208 ZF_Parameter.ui16_S1_S3 4095 UMR_VKMH__1_16_0_S1_S3 0 4095 /end CHARACTERISTIC
/begin CHARACTERISTIC D_v_R_Lth_L2 "L2 Lower speed threshold for driver request R" VALUE 0x26F20E ZF_Parameter.ui16_S1_S3 4095 UMR_VKMH__1_16_0_S1_S3 0 4095 /end CHARACTERISTIC
/begin CHARACTERISTIC D_v_R_Uth_L2 "L2 Upper speed threshold for driver request R" VALUE 0x26F210 ZF_Parameter.ui16_S1_S3 4095 UMR_VKMH__1_16_0_S1_S3 0 4095 /end CHARACTERISTIC
/begin CHARACTERISTIC D_t_FlashN_L2 "L2 Timer reload value for flash pos N if park lock not inserted in P" VALUE 0x26F21D ZF_Parameter.ui8_S1_S3 2550 UMR_MBSE_MSEC__10_1_0_S1_S3 0 2550 /end CHARACTERISTIC
/begin CHARACTERISTIC SWI_FAS_Active_L2 "L2 activation-switch for PMA/RCP-functionality" VALUE 0x26F226 ZF_Parameter.ui8_S1_S3 1 UMR___1_1_0_S1_S3 0 1 /end CHARACTERISTIC
/begin CHARACTERISTIC SWI_KL15_PinPlausiOn_L2 "Switch for ignition on substitute signal because of SAB plausibilisation" VALUE 0x26F22D ZF_Parameter.ui8_S1_S3 1 UMR___1_1_0_S1_S3 0 1 /end CHARACTERISTIC
/begin CHARACTERISTIC SWI_IgnoreLeverActionAfterPPressed_L2 "ignore R/N/D lever actions while P button is pressed until button is released" VALUE 0x26F227 ZF_Parameter.ui8_S1_S3 1 UMR___1_1_0_S1_S3 0 1 /end CHARACTERISTIC
/begin CHARACTERISTIC SWI_DiagPosByVimplausible_L2 "L2-Switch to activate Diag-N due to implausible veh spd: 0 - OFF, 1 - in R, 2 - in R/D" VALUE 0x26F225 ZF_Parameter.ui8_S1_S3 2 UMR___1_1_0_S1_S3 0 2 /end CHARACTERISTIC
/begin CHARACTERISTIC D_t_PosDrvAssistReject_L2 "Time within a FAS-requests p to R/N/D is Rejected" VALUE 0x26F221 ZF_Parameter.ui8_S1_S3 2550 UMR_MBSE_MSEC__10_1_0_S1_S3 0 2550 /end CHARACTERISTIC
/begin CHARACTERISTIC D_v_AutoN_Engine_Off_Uth_L2 "Speed threshold to engage Auto-N due to Engine off" VALUE 0x26F200 ZF_Parameter.ui16_S1_S3 4095 UMR_VKMH__1_16_0_S1_S3 0 4095 /end CHARACTERISTIC
/begin CHARACTERISTIC SWI_AutoN_EngineRot_Depend_L2 "Switch to activate AutoN by Engine revolution" VALUE 0x26F222 ZF_Parameter.ui8_S1_S3 7 UMR___1_1_0_S1_S3 0 7 /end CHARACTERISTIC
/begin CHARACTERISTIC D_Tab_RelToAbsConversion_L2 "Attention: Same value as D_Tab_RelToAbsConversion otherwise KFC3_LEV2" MAP 0x26F232 ZF_Matrix.ui8_S1_S3 8 UMR___1_1_0_S1_S3 0 8
 /begin AXIS_DESCR FIX_AXIS NO_INPUT_QUANTITY ePosDNRP_S1_S3 4 0 3 FIX_AXIS_PAR_DIST 0 1 4 /end AXIS_DESCR
 /begin AXIS_DESCR FIX_AXIS NO_INPUT_QUANTITY eLeverRel_S1_S3 7 0 6 FIX_AXIS_PAR_DIST 0 1 7 /end AXIS_DESCR
/end CHARACTERISTIC
/begin CHARACTERISTIC D_t_PosDrvAssistReject_L1 "Time within a FAS-requests p to R/N/D is Rejected" VALUE 0x218048 ZF_Parameter.ui8_S1_S3 2550 UMR_MBSE_MSEC__10_1_0_S1_S3 0 2550 /end CHARACTERISTIC
/begin CHARACTERISTIC D_ModeIfMGateOff "table for mode change at MGate inactive (f_MGateOff == 1) \\ the array index is the entering mode and the value the resulting mode \\ 0=Adaptive 1=Sport 2=Manual 3=ManualSport 4=ModeReturn" CURVE 0x207A78 ZF_Table.ui8_S1_S3 4 UMR___1_1_0_S1_S3 0 4
 /begin AXIS_DESCR FIX_AXIS NO_INPUT_QUANTITY UMR___1_1_0_S1_S3 4 0 3 FIX_AXIS_PAR_DIST 0 1 4 /end AXIS_DESCR
/end CHARACTERISTIC
/begin CHARACTERISTIC D_ModeIfMGateAndTempMan "table for mode change after active f_MGateOn and f_TempMan without tip1 event \\ the array index is the entering mode and the value the resulting mode \\ 0=Adaptive 1=Sport 2=Manual 3=ManualSport 4=ModeReturn" CURVE 0x207A74 ZF_Table.ui8_S1_S3 4 UMR___1_1_0_S1_S3 0 4
 /begin AXIS_DESCR FIX_AXIS NO_INPUT_QUANTITY UMR___1_1_0_S1_S3 4 0 3 FIX_AXIS_PAR_DIST 0 1 4 /end AXIS_DESCR
/end CHARACTERISTIC
/begin CHARACTERISTIC D_ModeIfMGateOn "table for mode change after MGate active \\ the array index is the entering mode and the value the resulting mode \\ 0=Adaptive 1=Sport 2=Manual 3=ManualSport 4=ModeReturn" CURVE 0x207A7C ZF_Table.ui8_S1_S3 4 UMR___1_1_0_S1_S3 0 4
 /begin AXIS_DESCR FIX_AXIS NO_INPUT_QUANTITY UMR___1_1_0_S1_S3 4 0 3 FIX_AXIS_PAR_DIST 0 1 4 /end AXIS_DESCR
/end CHARACTERISTIC
/begin CHARACTERISTIC D_ModeIfTip1 "table for mode change after Tip1 \\ the array index is the entering mode and the value the resulting mode \\ 0=Adaptive 1=Sport 2=Manual 3=ManualSport 4=ModeReturn" CURVE 0x207A8C ZF_Table.ui8_S1_S3 4 UMR___1_1_0_S1_S3 0 4
 /begin AXIS_DESCR FIX_AXIS NO_INPUT_QUANTITY UMR___1_1_0_S1_S3 4 0 3 FIX_AXIS_PAR_DIST 0 1 4 /end AXIS_DESCR
/end CHARACTERISTIC
/begin CHARACTERISTIC D_ModeIfTip2 "table for mode change after Tip2 \\ the array index is the entering mode and the value the resulting mode \\ 0=Adaptive 1=Sport 2=Manual 3=ManualSport 4=ModeReturn" CURVE 0x207A90 ZF_Table.ui8_S1_S3 4 UMR___1_1_0_S1_S3 0 4
 /begin AXIS_DESCR FIX_AXIS NO_INPUT_QUANTITY UMR___1_1_0_S1_S3 4 0 3 FIX_AXIS_PAR_DIST 0 1 4 /end AXIS_DESCR
/end CHARACTERISTIC
/begin CHARACTERISTIC D_ModeIfTimerExpiredTip1 "table for mode change after ModeReturnTimer of Tip1 expires (f_TimerModeReturnTip1Expired == 1) \\ the array index is the entering mode and the value the resulting mode \\ 0=Adaptive 1=Sport 2=Manual 3=ManualSport 4=ModeReturn" CURVE 0x207A84 ZF_Table.ui8_S1_S3 4 UMR___1_1_0_S1_S3 0 4
 /begin AXIS_DESCR FIX_AXIS NO_INPUT_QUANTITY UMR___1_1_0_S1_S3 4 0 3 FIX_AXIS_PAR_DIST 0 1 4 /end AXIS_DESCR
/end CHARACTERISTIC
/begin CHARACTERISTIC D_ModeIfTimerExpiredTip2 "table for mode change after ModeReturnTimer of Tip2 expires (f_TimerModeReturnTip2Expired == 1) \\ the array index is the entering mode and the value the resulting mode \\ 0=Adaptive 1=Sport 2=Manual 3=ManualSport 4=ModeReturn" CURVE 0x207A88 ZF_Table.ui8_S1_S3 4 UMR___1_1_0_S1_S3 0 4
 /begin AXIS_DESCR FIX_AXIS NO_INPUT_QUANTITY UMR___1_1_0_S1_S3 4 0 3 FIX_AXIS_PAR_DIST 0 1 4 /end AXIS_DESCR
/end CHARACTERISTIC
/begin CHARACTERISTIC D_ModeIfDrvReqD "table for mode change when driver request is D (StoreDrvReq.DrvReqPRND = D) \\ the array index is the entering mode and the value the resulting mode \\ 0=Adaptive 1=Sport 2=Manual 3=ManualSport 4=ModeReturn" CURVE 0x207A68 ZF_Table.ui8_S1_S3 4 UMR___1_1_0_S1_S3 0 4
 /begin AXIS_DESCR FIX_AXIS NO_INPUT_QUANTITY UMR___1_1_0_S1_S3 4 0 3 FIX_AXIS_PAR_DIST 0 1 4 /end AXIS_DESCR
/end CHARACTERISTIC
/begin CHARACTERISTIC D_ModeIfSportButton "table for mode change at pressing Sport Button \\ the array index is the entering mode and the value the resulting mode \\ 0=Adaptive 1=Sport 2=Manual 3=ManualSport 4=ModeReturn" CURVE 0x207A80 ZF_Table.ui8_S1_S3 4 UMR___1_1_0_S1_S3 0 4
 /begin AXIS_DESCR FIX_AXIS NO_INPUT_QUANTITY UMR___1_1_0_S1_S3 4 0 3 FIX_AXIS_PAR_DIST 0 1 4 /end AXIS_DESCR
/end CHARACTERISTIC
/begin CHARACTERISTIC D_ModeIfDriveLogic "mode change table used at activation of drive logic (MultAccess.DriveLogic != 0) \\ the array index is the entering mode and the value the resulting mode \\ 0=Adaptive 1=Sport 2=Manual 3=ManualSport 4=ModeReturn" CURVE 0x207A64 ZF_Table.ui8_S1_S3 4 UMR___1_1_0_S1_S3 0 4
 /begin AXIS_DESCR FIX_AXIS NO_INPUT_QUANTITY UMR___1_1_0_S1_S3 4 0 3 FIX_AXIS_PAR_DIST 0 1 4 /end AXIS_DESCR
/end CHARACTERISTIC
/begin CHARACTERISTIC D_ModeIfLowMode "mode change table used at activation of the LowMode button (f_LowModeButton == 1) \\ the array index is the entering mode and the value the resulting mode \\ 0=Adaptive 1=Sport 2=Manual 3=ManualSport 4=ModeReturn" CURVE 0x207A6C ZF_Table.ui8_S1_S3 4 UMR___1_1_0_S1_S3 0 4
 /begin AXIS_DESCR FIX_AXIS NO_INPUT_QUANTITY UMR___1_1_0_S1_S3 4 0 3 FIX_AXIS_PAR_DIST 0 1 4 /end AXIS_DESCR
/end CHARACTERISTIC
/begin CHARACTERISTIC D_ModeIfLowModeInvalid "mode change table used at invalid LowMode button state (f_LowModeInvalid == 1) \\ the array index is the entering mode and the value the resulting mode \\ 0=Adaptive 1=Sport 2=Manual 3=ManualSport 4=ModeReturn" CURVE 0x207A70 ZF_Table.ui8_S1_S3 4 UMR___1_1_0_S1_S3 0 4
 /begin AXIS_DESCR FIX_AXIS NO_INPUT_QUANTITY UMR___1_1_0_S1_S3 4 0 3 FIX_AXIS_PAR_DIST 0 1 4 /end AXIS_DESCR
/end CHARACTERISTIC
/begin CHARACTERISTIC D_t_DelayAdaptiveToManual "Time for hold Adaptiv after MGate active - 0 deactivate function" VALUE 0x207A94 ZF_Parameter.ui16_S1_S3 655350 UMR_MBSE_MSEC__10_1_0_S1_S3 0 655350 /end CHARACTERISTIC
/begin CHARACTERISTIC D_t_DelayManualToAdaptive "Time for hold Manual after MGate inactive - 0 deactivate function" VALUE 0x207A96 ZF_Parameter.ui16_S1_S3 655350 UMR_MBSE_MSEC__10_1_0_S1_S3 0 655350 /end CHARACTERISTIC
/begin CHARACTERISTIC SWI_RelToAbsUsesDisplayPosIfNotDark "switch to activate usage of display position instead of gearbox position if DisplayPos is not dark" VALUE 0x218049 ZF_Parameter.ui8_S1_S3 1 UMR___1_1_0_S1_S3 0 1 /end CHARACTERISTIC
/begin CHARACTERISTIC D_Tab_RelToAbsConversion "Conversion relative to absolute lever position \\ X-axis: actual gearbox or display position (D=0 - N=1 - R=2 - P=3) \\ / Y-axis: lever position (FFF=0 - FF=1 - F=2 - NA=3 - B=4 - BB=5 - BBB=6)" MAP 0x21804A ZF_Matrix.ui8_S1_S3 8 UMR___1_1_0_S1_S3 0 8
 /begin AXIS_DESCR FIX_AXIS NO_INPUT_QUANTITY ePosDNRP_S1_S3 4 0 3 FIX_AXIS_PAR_DIST 0 1 4 /end AXIS_DESCR
 /begin AXIS_DESCR FIX_AXIS NO_INPUT_QUANTITY eLeverRel_S1_S3 7 0 6 FIX_AXIS_PAR_DIST 0 1 7 /end AXIS_DESCR
/end CHARACTERISTIC
/begin CHARACTERISTIC D_v_PSAbuse "speed threshold for detecting parklock-abuse" VALUE 0x207AA0 ZF_Parameter.ui16_S1_S3 15.93 UMR_VKMH__1_16_0_S1_S3 0 15.93 /end CHARACTERISTIC
/begin CHARACTERISTIC D_u_UMV3_KFC_PSINOUT_Th "Threshold for voltage u_drmv for KFC_PSIN and KFC_PSOUT" VALUE 0x207A9E ZF_Parameter.ui16_S1_S3 16 UMR_U_1_1000_0_S1_S3 0 16 /end CHARACTERISTIC
/begin CHARACTERISTIC D_t_DiagSysPressureHIS "tmr_DiagSysPressureHIS: diagnosis is active while timer is running" VALUE 0x207A9C ZF_Parameter.ui16_S1_S3 655350 UMR_MBSE_MSEC__10_1_0_S1_S3 0 655350 /end CHARACTERISTIC
/begin CHARACTERISTIC D_t_DiagSysPressureEng "tmr_DiagSysPressureEng: diagnosis is active while timer is running" VALUE 0x207A98 ZF_Parameter.ui16_S1_S3 655350 UMR_MBSE_MSEC__10_1_0_S1_S3 0 655350 /end CHARACTERISTIC
/begin CHARACTERISTIC D_t_DiagSysPressureEngStart "tmr_DiagSysPressureEngStart: diagnosis is active while timer is running" VALUE 0x207A9A ZF_Parameter.ui16_S1_S3 655350 UMR_MBSE_MSEC__10_1_0_S1_S3 0 655350 /end CHARACTERISTIC
/begin CHARACTERISTIC D_t_PEngaged "Time D_t_PEngaged" VALUE 0x207AA2 ZF_Parameter.ui8_S1_S3 2550 UMR_MBSE_MSEC__10_1_0_S1_S3 0 2550 /end CHARACTERISTIC
/begin CHARACTERISTIC D_t_PEngagedAfterEngStart "Time D_t_PEngagedAfterEngStart" VALUE 0x207AA3 ZF_Parameter.ui8_S1_S3 2550 UMR_MBSE_MSEC__10_1_0_S1_S3 0 2550 /end CHARACTERISTIC
/begin CHARACTERISTIC SWI_SrvcMsg_Enable "en-/disable srvc. CAN-messages" VALUE 0x218068 ZF_Parameter.ui8_S1_S3 1 UMR___1_1_0_S1_S3 0 1 /end CHARACTERISTIC
/begin CHARACTERISTIC D_ident_snr_rsyncn_navi "Identification of sender of resynchronisation message" VALUE 0x218067 ZF_Parameter.ui8_S1_S3 255 UMR___1_1_0_S1_S3 0 255 /end CHARACTERISTIC
/begin CHARACTERISTIC D_MSA_ID_Byte4 "Fix Value for Byte4 in MSA Msg ID2=19" VALUE 0x218066 ZF_Parameter.ui8_S1_S3 255 UMR___1_1_0_S1_S3 0 255 /end CHARACTERISTIC
/begin CHARACTERISTIC D_Tab_StrtRlsPosPRND "Calibration table Gearbox position of Starter Release" CURVE 0x207ADC ZF_Table.ui8_S1_S3 255 UMR___1_1_0_S1_S3 0 255
 /begin AXIS_DESCR FIX_AXIS NO_INPUT_QUANTITY UMR___1_1_0_S1_S3 8 0 7 FIX_AXIS_PAR_DIST 0 1 8 /end AXIS_DESCR
/end CHARACTERISTIC
/begin CHARACTERISTIC D_Tab_StrtRlsShifterPos "Calibration table Lever position of Starter Release" CURVE 0x207AEC ZF_Table.ui8_S1_S3 255 UMR___1_1_0_S1_S3 0 255
 /begin AXIS_DESCR FIX_AXIS NO_INPUT_QUANTITY UMR___1_1_0_S1_S3 8 0 7 FIX_AXIS_PAR_DIST 0 1 8 /end AXIS_DESCR
/end CHARACTERISTIC
/begin CHARACTERISTIC D_Tab_StrtRlsDisplayPos "Calibration table Display position of Starter Release" CURVE 0x207AB4 ZF_Table.ui8_S1_S3 255 UMR___1_1_0_S1_S3 0 255
 /begin AXIS_DESCR FIX_AXIS NO_INPUT_QUANTITY UMR___1_1_0_S1_S3 8 0 7 FIX_AXIS_PAR_DIST 0 1 8 /end AXIS_DESCR
/end CHARACTERISTIC
/begin CHARACTERISTIC D_Tab_StrtRlsPowerDown "Calibration table Display position of Starter Release" CURVE 0x207AE4 ZF_Table.ui8_S1_S3 255 UMR___1_1_0_S1_S3 0 255
 /begin AXIS_DESCR FIX_AXIS NO_INPUT_QUANTITY UMR___1_1_0_S1_S3 8 0 7 FIX_AXIS_PAR_DIST 0 1 8 /end AXIS_DESCR
/end CHARACTERISTIC
/begin CHARACTERISTIC D_Tab_StrtRlsEngine "Calibration table Engine of Starter Release" CURVE 0x207ABC ZF_Table.ui8_S1_S3 255 UMR___1_1_0_S1_S3 0 255
 /begin AXIS_DESCR FIX_AXIS NO_INPUT_QUANTITY UMR___1_1_0_S1_S3 8 0 7 FIX_AXIS_PAR_DIST 0 1 8 /end AXIS_DESCR
/end CHARACTERISTIC
/begin CHARACTERISTIC D_Tab_StrtRlsIgnition "Calibration table Ignition of Starter Release" CURVE 0x207ACC ZF_Table.ui8_S1_S3 255 UMR___1_1_0_S1_S3 0 255
 /begin AXIS_DESCR FIX_AXIS NO_INPUT_QUANTITY UMR___1_1_0_S1_S3 8 0 7 FIX_AXIS_PAR_DIST 0 1 8 /end AXIS_DESCR
/end CHARACTERISTIC
/begin CHARACTERISTIC D_Tab_StrtRlsBrake "Calibration table Brake of Starter Release" CURVE 0x207AA4 ZF_Table.ui8_S1_S3 255 UMR___1_1_0_S1_S3 0 255
 /begin AXIS_DESCR FIX_AXIS NO_INPUT_QUANTITY UMR___1_1_0_S1_S3 8 0 7 FIX_AXIS_PAR_DIST 0 1 8 /end AXIS_DESCR
/end CHARACTERISTIC
/begin CHARACTERISTIC D_Tab_StrtRlsParklockState "Calibration table Parklock state of Starter Release" CURVE 0x207AD4 ZF_Table.ui8_S1_S3 255 UMR___1_1_0_S1_S3 0 255
 /begin AXIS_DESCR FIX_AXIS NO_INPUT_QUANTITY UMR___1_1_0_S1_S3 8 0 7 FIX_AXIS_PAR_DIST 0 1 8 /end AXIS_DESCR
/end CHARACTERISTIC
/begin CHARACTERISTIC D_Tab_StrtRlsDelayTmr "Calibration table Parklock state of Starter Release" CURVE 0x207AAC ZF_Table.ui8_S1_S3 255 UMR___1_1_0_S1_S3 0 255
 /begin AXIS_DESCR FIX_AXIS NO_INPUT_QUANTITY UMR___1_1_0_S1_S3 8 0 7 FIX_AXIS_PAR_DIST 0 1 8 /end AXIS_DESCR
/end CHARACTERISTIC
/begin CHARACTERISTIC D_Tab_StrtRlsGbxFault "Calibration table Gearbox fault of Starter Release" CURVE 0x207AC4 ZF_Table.ui8_S1_S3 255 UMR___1_1_0_S1_S3 0 255
 /begin AXIS_DESCR FIX_AXIS NO_INPUT_QUANTITY UMR___1_1_0_S1_S3 8 0 7 FIX_AXIS_PAR_DIST 0 1 8 /end AXIS_DESCR
/end CHARACTERISTIC
/begin CHARACTERISTIC D_Tab_StrtRlsStarterRelease "Calibration table Starter Release" CURVE 0x207AF4 ZF_Table.ui8_S1_S3 255 UMR___1_1_0_S1_S3 0 255
 /begin AXIS_DESCR FIX_AXIS NO_INPUT_QUANTITY UMR___1_1_0_S1_S3 8 0 7 FIX_AXIS_PAR_DIST 0 1 8 /end AXIS_DESCR
/end CHARACTERISTIC
/begin MEASUREMENT cCC_ID._.f_CC_DrvExpectsP "Additional flag for ID_ParkLockFault_IEP_On" UBYTE SBW_STANDARD_S1_S3 1 100 0 1 BIT_MASK 0x1 DISPLAY_IDENTIFIER f_CC_DrvExpectsP._.cCC_ID ECU_ADDRESS 0xFFF85954 /end MEASUREMENT
/begin MEASUREMENT cID_ParkLockFault_IEP_On._.f_IgnOn_Old "Igniiton Old Value in 50ms Cycle" UBYTE SBW_STANDARD_S1_S3 1 100 0 1 BIT_MASK 0x1 DISPLAY_IDENTIFIER f_IgnOn_Old._.cID_ParkLockFault_IEP_On ECU_ADDRESS 0xFFF85955 /end MEASUREMENT
/begin MEASUREMENT IntOsCallsRAM.f_sbwInitialized "Interfo.sbw_init 0:not yet called / 1: already called" UBYTE SBW_STANDARD_S1_S3 1 100 0 1 BIT_MASK 0x1 DISPLAY_IDENTIFIER f_sbwInitialized.IntOsCallsRAM ECU_ADDRESS 0xFFF89FCC /end MEASUREMENT
/begin MEASUREMENT IntOsCallsRAM.f_erase_infomemory "if set the internal info memory will be erased" UBYTE SBW_STANDARD_S1_S3 1 100 0 1 BIT_MASK 0x1 DISPLAY_IDENTIFIER f_erase_infomemory.IntOsCallsRAM ECU_ADDRESS 0xFFF89FCD /end MEASUREMENT
/begin MEASUREMENT TesterAccess.DiagTestSteptronic "DiagTester value current steptronic: b7=RL b6=n.c. b5=P b4=S b3=Tip2- b2=Tip2+ b1=Tip1- b0=Tip1+" UBYTE SBW_STANDARD_S1_S3 1 100 0 255 DISPLAY_IDENTIFIER DiagTestSteptronic.TesterAccess ECU_ADDRESS 0xFFF8A6B1 /end MEASUREMENT
/begin MEASUREMENT TesterAccess.DiagTestLever "DiagTester value current Lever: 0=Mid 5=D 6=N 7=R 21=V 22=VV 23=H 23=HH 31=SD 32=M- 33=M+ 128=undef" UBYTE SBW_STANDARD_S1_S3 1 100 0 255 DISPLAY_IDENTIFIER DiagTestLever.TesterAccess ECU_ADDRESS 0xFFF8A6B2 /end MEASUREMENT
/begin MEASUREMENT TesterAccess.DiagTestSBW "DiagTester value current SBW: b15=free b14=Brake b13=Door b12=Belt b11=Seat b10=Key b9=Ign b8=HoldN b7 to 4=PosDrvReq b3=DiagP b2=DiagN b1=AutoP b0=AutoN" UWORD SBW_STANDARD_S1_S3 1 100 0 65535 DISPLAY_IDENTIFIER DiagTestSBW.TesterAccess ECU_ADDRESS 0xFFF8A6B4 /end MEASUREMENT
/begin MEASUREMENT TesterAccess.st_VehicleAutoP "DiagTester value current SBW: b4=Seat b3=Door b2=Belt b1=Brake b0=AcceleratorPedal" UBYTE SBW_STANDARD_S1_S3 1 100 0 1 DISPLAY_IDENTIFIER st_VehicleAutoP.TesterAccess ECU_ADDRESS 0xFFF8A6B6 /end MEASUREMENT
/begin MEASUREMENT TesterAccess.Faulttype "Faulttype of an Faultcode" UBYTE SBW_STANDARD_S1_S3 1 100 0 255 DISPLAY_IDENTIFIER Faulttype.TesterAccess ECU_ADDRESS 0xFFF8A6B7 /end MEASUREMENT
/begin MEASUREMENT EepromBPRAM.f_ForceEEPROM_Update "Force EEPROM Update if set" UBYTE SBW_STANDARD_S1_S3 1 100 0 1 BIT_MASK 0x1 DISPLAY_IDENTIFIER f_ForceEEPROM_Update.EepromBPRAM ECU_ADDRESS 0xFFF83B51 /end MEASUREMENT
/begin MEASUREMENT EepromBPRAM.f_ForceEEPROM_Update_ "Complement of Force EEPROM Update" UBYTE SBW_STANDARD_S1_S3 1 100 0 255 DISPLAY_IDENTIFIER f_ForceEEPROM_Update_.EepromBPRAM ECU_ADDRESS 0xFFF83B52 /end MEASUREMENT
/begin MEASUREMENT EepromEws4ImmedWrap.EepromEws4Immediate.f_ews4_locked "flag telling that EWS4 has locked its SK" UBYTE SBW_STANDARD_S1_S3 1 100 0 1 BIT_MASK 0x1 DISPLAY_IDENTIFIER f_ews4_locked.EepromEws4Immediate.EepromEws4ImmedWrap ECU_ADDRESS 0xFFF8103C /end MEASUREMENT
/begin MEASUREMENT EepromEws4ImmedWrap.EepromEws4Immediate.f_ews4_locked_ "bit-compl. of flag telling that EWS4 has locked its SK" UBYTE SBW_STANDARD_S1_S3 1 100 0 255 DISPLAY_IDENTIFIER f_ews4_locked_.EepromEws4Immediate.EepromEws4ImmedWrap ECU_ADDRESS 0xFFF8103D /end MEASUREMENT
/begin MEASUREMENT EepromEws4ImmedWrap.EepromEws4Immediate.fsc_status "status of FSC: tells if FSC is not available or was accepted and stored into EEPROM: C_FscStateNotAvailable:0 C_FscStateAccepted:2" UBYTE SBW_STANDARD_S1_S3 1 100 0 2 DISPLAY_IDENTIFIER fsc_status.EepromEws4Immediate.EepromEws4ImmedWrap ECU_ADDRESS 0xFFF8103E /end MEASUREMENT
/begin MEASUREMENT EepromEws4ImmedWrap.EepromEws4Immediate.fsc_status_ "bit-compl. of status of FSC" UBYTE SBW_STANDARD_S1_S3 1 100 0 255 DISPLAY_IDENTIFIER fsc_status_.EepromEws4Immediate.EepromEws4ImmedWrap ECU_ADDRESS 0xFFF8103F /end MEASUREMENT
/begin MEASUREMENT EepromEws4ImmedWrap.EepromEws4Immediate.fsc_old_date "saved date of last accepted FSC: measured in minutes since 1-1-2000" ULONG SBW_STANDARD_S1_S3 1 100 0 4294967295 DISPLAY_IDENTIFIER fsc_old_date.EepromEws4Immediate.EepromEws4ImmedWrap ECU_ADDRESS 0xFFF81040 /end MEASUREMENT
/begin MEASUREMENT EepromEws4ImmedWrap.EepromEws4Immediate.fsc_old_date_ "bit-compl. of saved date of last accepted FSC" ULONG SBW_STANDARD_S1_S3 1 100 0 4294967295 DISPLAY_IDENTIFIER fsc_old_date_.EepromEws4Immediate.EepromEws4ImmedWrap ECU_ADDRESS 0xFFF81044 /end MEASUREMENT
/begin MEASUREMENT EepromWrap.Eeprom.EgnerEnabledCnt.cEepromValue_ui8._.Value "Value of measurement variable" UBYTE SBW_STANDARD_S1_S3 1 100 0 255 DISPLAY_IDENTIFIER Value._.cEepromValue_ui8.EgnerEnabledCnt.Eeprom.EepromWrap ECU_ADDRESS 0xFFF82310 /end MEASUREMENT
/begin MEASUREMENT EepromWrap.Eeprom.EgnerEnabledCnt.cEepromValue_ui8._.Complement "Complement of measurement variable" UBYTE SBW_STANDARD_S1_S3 1 100 0 255 DISPLAY_IDENTIFIER Complement._.cEepromValue_ui8.EgnerEnabledCnt.Eeprom.EepromWrap ECU_ADDRESS 0xFFF82311 /end MEASUREMENT
/begin MEASUREMENT EepromWrap.Eeprom.EgnerFailedCnt.cEepromValue_ui8._.Value "Value of measurement variable" UBYTE SBW_STANDARD_S1_S3 1 100 0 255 DISPLAY_IDENTIFIER Value._.cEepromValue_ui8.EgnerFailedCnt.Eeprom.EepromWrap ECU_ADDRESS 0xFFF82314 /end MEASUREMENT
/begin MEASUREMENT EepromWrap.Eeprom.EgnerFailedCnt.cEepromValue_ui8._.Complement "Complement of measurement variable" UBYTE SBW_STANDARD_S1_S3 1 100 0 255 DISPLAY_IDENTIFIER Complement._.cEepromValue_ui8.EgnerFailedCnt.Eeprom.EepromWrap ECU_ADDRESS 0xFFF82315 /end MEASUREMENT
/begin MEASUREMENT EepromWrap.Eeprom.EgnerMisuseCnt.cEepromValue_ui8._.Value "Value of measurement variable" UBYTE SBW_STANDARD_S1_S3 1 100 0 255 DISPLAY_IDENTIFIER Value._.cEepromValue_ui8.EgnerMisuseCnt.Eeprom.EepromWrap ECU_ADDRESS 0xFFF82318 /end MEASUREMENT
/begin MEASUREMENT EepromWrap.Eeprom.EgnerMisuseCnt.cEepromValue_ui8._.Complement "Complement of measurement variable" UBYTE SBW_STANDARD_S1_S3 1 100 0 255 DISPLAY_IDENTIFIER Complement._.cEepromValue_ui8.EgnerMisuseCnt.Eeprom.EepromWrap ECU_ADDRESS 0xFFF82319 /end MEASUREMENT
/begin MEASUREMENT EepromWrap.Eeprom.info_memory[0].moduleID "ID of the calling module" UBYTE SBW_STANDARD_S1_S3 1 100 0 255 DISPLAY_IDENTIFIER moduleID.info_memory[0].Eeprom.EepromWrap ECU_ADDRESS 0xFFF8231C /end MEASUREMENT
/begin MEASUREMENT EepromWrap.Eeprom.info_memory[0].errorID "error code - specified in calling module" UBYTE SBW_STANDARD_S1_S3 1 100 0 255 DISPLAY_IDENTIFIER errorID.info_memory[0].Eeprom.EepromWrap ECU_ADDRESS 0xFFF8231D /end MEASUREMENT
/begin MEASUREMENT EepromWrap.Eeprom.info_memory[1].moduleID "ID of the calling module" UBYTE SBW_STANDARD_S1_S3 1 100 0 255 DISPLAY_IDENTIFIER moduleID.info_memory[1].Eeprom.EepromWrap ECU_ADDRESS 0xFFF8231E /end MEASUREMENT
/begin MEASUREMENT EepromWrap.Eeprom.info_memory[1].errorID "error code - specified in calling module" UBYTE SBW_STANDARD_S1_S3 1 100 0 255 DISPLAY_IDENTIFIER errorID.info_memory[1].Eeprom.EepromWrap ECU_ADDRESS 0xFFF8231F /end MEASUREMENT
/begin MEASUREMENT EepromWrap.Eeprom.info_memory[2].moduleID "ID of the calling module" UBYTE SBW_STANDARD_S1_S3 1 100 0 255 DISPLAY_IDENTIFIER moduleID.info_memory[2].Eeprom.EepromWrap ECU_ADDRESS 0xFFF82320 /end MEASUREMENT
/begin MEASUREMENT EepromWrap.Eeprom.info_memory[2].errorID "error code - specified in calling module" UBYTE SBW_STANDARD_S1_S3 1 100 0 255 DISPLAY_IDENTIFIER errorID.info_memory[2].Eeprom.EepromWrap ECU_ADDRESS 0xFFF82321 /end MEASUREMENT
/begin MEASUREMENT EepromWrap.Eeprom.info_memory[3].moduleID "ID of the calling module" UBYTE SBW_STANDARD_S1_S3 1 100 0 255 DISPLAY_IDENTIFIER moduleID.info_memory[3].Eeprom.EepromWrap ECU_ADDRESS 0xFFF82322 /end MEASUREMENT
/begin MEASUREMENT EepromWrap.Eeprom.info_memory[3].errorID "error code - specified in calling module" UBYTE SBW_STANDARD_S1_S3 1 100 0 255 DISPLAY_IDENTIFIER errorID.info_memory[3].Eeprom.EepromWrap ECU_ADDRESS 0xFFF82323 /end MEASUREMENT
/begin MEASUREMENT EepromWrap.Eeprom.info_memory[4].moduleID "ID of the calling module" UBYTE SBW_STANDARD_S1_S3 1 100 0 255 DISPLAY_IDENTIFIER moduleID.info_memory[4].Eeprom.EepromWrap ECU_ADDRESS 0xFFF82324 /end MEASUREMENT
/begin MEASUREMENT EepromWrap.Eeprom.info_memory[4].errorID "error code - specified in calling module" UBYTE SBW_STANDARD_S1_S3 1 100 0 255 DISPLAY_IDENTIFIER errorID.info_memory[4].Eeprom.EepromWrap ECU_ADDRESS 0xFFF82325 /end MEASUREMENT
/begin MEASUREMENT EepromWrap.Eeprom.info_memory[5].moduleID "ID of the calling module" UBYTE SBW_STANDARD_S1_S3 1 100 0 255 DISPLAY_IDENTIFIER moduleID.info_memory[5].Eeprom.EepromWrap ECU_ADDRESS 0xFFF82326 /end MEASUREMENT
/begin MEASUREMENT EepromWrap.Eeprom.info_memory[5].errorID "error code - specified in calling module" UBYTE SBW_STANDARD_S1_S3 1 100 0 255 DISPLAY_IDENTIFIER errorID.info_memory[5].Eeprom.EepromWrap ECU_ADDRESS 0xFFF82327 /end MEASUREMENT
/begin MEASUREMENT EepromWrap.Eeprom.info_memory[6].moduleID "ID of the calling module" UBYTE SBW_STANDARD_S1_S3 1 100 0 255 DISPLAY_IDENTIFIER moduleID.info_memory[6].Eeprom.EepromWrap ECU_ADDRESS 0xFFF82328 /end MEASUREMENT
/begin MEASUREMENT EepromWrap.Eeprom.info_memory[6].errorID "error code - specified in calling module" UBYTE SBW_STANDARD_S1_S3 1 100 0 255 DISPLAY_IDENTIFIER errorID.info_memory[6].Eeprom.EepromWrap ECU_ADDRESS 0xFFF82329 /end MEASUREMENT
/begin MEASUREMENT EepromWrap.Eeprom.info_memory[7].moduleID "ID of the calling module" UBYTE SBW_STANDARD_S1_S3 1 100 0 255 DISPLAY_IDENTIFIER moduleID.info_memory[7].Eeprom.EepromWrap ECU_ADDRESS 0xFFF8232A /end MEASUREMENT
/begin MEASUREMENT EepromWrap.Eeprom.info_memory[7].errorID "error code - specified in calling module" UBYTE SBW_STANDARD_S1_S3 1 100 0 255 DISPLAY_IDENTIFIER errorID.info_memory[7].Eeprom.EepromWrap ECU_ADDRESS 0xFFF8232B /end MEASUREMENT
/begin MEASUREMENT EepromWrap.Eeprom.cnt_ID828.Value "Value of measurement variable" UBYTE SBW_STANDARD_S1_S3 1 100 0 255 DISPLAY_IDENTIFIER Value.cnt_ID828.Eeprom.EepromWrap ECU_ADDRESS 0xFFF8232C /end MEASUREMENT
/begin MEASUREMENT EepromWrap.Eeprom.cnt_ID828.Complement "Complement of measurement variable" UBYTE SBW_STANDARD_S1_S3 1 100 0 255 DISPLAY_IDENTIFIER Complement.cnt_ID828.Eeprom.EepromWrap ECU_ADDRESS 0xFFF8232D /end MEASUREMENT
/begin MEASUREMENT EepromWrap.Eeprom.cnt_DiagPosInWrongDrvDir.Value "Value of measurement variable" UBYTE SBW_STANDARD_S1_S3 1 100 0 255 DISPLAY_IDENTIFIER Value.cnt_DiagPosInWrongDrvDir.Eeprom.EepromWrap ECU_ADDRESS 0xFFF8232E /end MEASUREMENT
/begin MEASUREMENT EepromWrap.Eeprom.cnt_DiagPosInWrongDrvDir.Complement "Complement of measurement variable" UBYTE SBW_STANDARD_S1_S3 1 100 0 255 DISPLAY_IDENTIFIER Complement.cnt_DiagPosInWrongDrvDir.Eeprom.EepromWrap ECU_ADDRESS 0xFFF8232F /end MEASUREMENT
/begin MEASUREMENT EepromWrap.Eeprom.cnt_AutoP_DrvPresenceUnknown.Value "Value of measurement variable" UBYTE SBW_STANDARD_S1_S3 1 100 0 255 DISPLAY_IDENTIFIER Value.cnt_AutoP_DrvPresenceUnknown.Eeprom.EepromWrap ECU_ADDRESS 0xFFF82330 /end MEASUREMENT
/begin MEASUREMENT EepromWrap.Eeprom.cnt_AutoP_DrvPresenceUnknown.Complement "Complement of measurement variable" UBYTE SBW_STANDARD_S1_S3 1 100 0 255 DISPLAY_IDENTIFIER Complement.cnt_AutoP_DrvPresenceUnknown.Eeprom.EepromWrap ECU_ADDRESS 0xFFF82331 /end MEASUREMENT
/begin MEASUREMENT EepromWrap.Eeprom.cnt_InfoDAS_StoreP.Value "Value of measurement variable" UBYTE SBW_STANDARD_S1_S3 1 100 0 255 DISPLAY_IDENTIFIER Value.cnt_InfoDAS_StoreP.Eeprom.EepromWrap ECU_ADDRESS 0xFFF82384 /end MEASUREMENT
/begin MEASUREMENT EepromWrap.Eeprom.cnt_InfoDAS_StoreP.Complement "Complement of measurement variable" UBYTE SBW_STANDARD_S1_S3 1 100 0 255 DISPLAY_IDENTIFIER Complement.cnt_InfoDAS_StoreP.Eeprom.EepromWrap ECU_ADDRESS 0xFFF82385 /end MEASUREMENT
/begin MEASUREMENT EepromWrap.Eeprom.cnt_info_memory_entries "counter for internal information memory entries" UBYTE SBW_STANDARD_S1_S3 1 100 0 255 DISPLAY_IDENTIFIER cnt_info_memory_entries.Eeprom.EepromWrap ECU_ADDRESS 0xFFF82332 /end MEASUREMENT
/begin MEASUREMENT EepromWrap.Eeprom.info_memory_checksum "checksum for internal information memory" UWORD SBW_STANDARD_S1_S3 1 100 0 65535 DISPLAY_IDENTIFIER info_memory_checksum.Eeprom.EepromWrap ECU_ADDRESS 0xFFF82334 /end MEASUREMENT
/begin MEASUREMENT EepromWrap.Eeprom.cnt_Init_Calls "eeprom-based init cycles counter" UWORD SBW_STANDARD_S1_S3 1 100 0 65535 DISPLAY_IDENTIFIER cnt_Init_Calls.Eeprom.EepromWrap ECU_ADDRESS 0xFFF82336 /end MEASUREMENT
/begin MEASUREMENT EepromWrap.Eeprom.cnt_Init_Calls_ "bit-complement of eeprom-based init cycles counter" UWORD SBW_STANDARD_S1_S3 1 100 0 65535 DISPLAY_IDENTIFIER cnt_Init_Calls_.Eeprom.EepromWrap ECU_ADDRESS 0xFFF82338 /end MEASUREMENT
/begin MEASUREMENT EepromWrap.Eeprom.cnt_AutoPEmf3 "eeprom-based counter for AutoPEmf3" UBYTE SBW_STANDARD_S1_S3 1 100 0 255 DISPLAY_IDENTIFIER cnt_AutoPEmf3.Eeprom.EepromWrap ECU_ADDRESS 0xFFF8233A /end MEASUREMENT
/begin MEASUREMENT EepromWrap.Eeprom.cnt_AutoPEmf2 "eeprom-based counter for AutoPEmf2" UBYTE SBW_STANDARD_S1_S3 1 100 0 255 DISPLAY_IDENTIFIER cnt_AutoPEmf2.Eeprom.EepromWrap ECU_ADDRESS 0xFFF8233B /end MEASUREMENT
/begin MEASUREMENT EepromWrap.Eeprom.cnt_AutoPEmf1 "eeprom-based counter for AutoPEmf1" UBYTE SBW_STANDARD_S1_S3 1 100 0 255 DISPLAY_IDENTIFIER cnt_AutoPEmf1.Eeprom.EepromWrap ECU_ADDRESS 0xFFF8233C /end MEASUREMENT
/begin MEASUREMENT EepromWrap.Eeprom.cnt_AdaptivMode "eeprom-based operating-second counter for AdaptivMode" ULONG SBW_STANDARD_S1_S3 1 100 0 4294967295 DISPLAY_IDENTIFIER cnt_AdaptivMode.Eeprom.EepromWrap ECU_ADDRESS 0xFFF82340 /end MEASUREMENT
/begin MEASUREMENT EepromWrap.Eeprom.cnt_SportMode "eeprom-based operating-second counter for SportMode" ULONG SBW_STANDARD_S1_S3 1 100 0 4294967295 DISPLAY_IDENTIFIER cnt_SportMode.Eeprom.EepromWrap ECU_ADDRESS 0xFFF82344 /end MEASUREMENT
/begin MEASUREMENT EepromWrap.Eeprom.cnt_ManualMode "eeprom-based operating-second counter for ManualMode" ULONG SBW_STANDARD_S1_S3 1 100 0 4294967295 DISPLAY_IDENTIFIER cnt_ManualMode.Eeprom.EepromWrap ECU_ADDRESS 0xFFF82348 /end MEASUREMENT
/begin MEASUREMENT EepromWrap.Eeprom.cnt_AutoPEmf3_ "bit-complement of eeprom-based counter for AutoPEmf3" UBYTE SBW_STANDARD_S1_S3 1 100 0 255 DISPLAY_IDENTIFIER cnt_AutoPEmf3_.Eeprom.EepromWrap ECU_ADDRESS 0xFFF8234C /end MEASUREMENT
/begin MEASUREMENT EepromWrap.Eeprom.cnt_AutoPEmf2_ "bit-complement of eeprom-based counter for AutoPEmf2" UBYTE SBW_STANDARD_S1_S3 1 100 0 255 DISPLAY_IDENTIFIER cnt_AutoPEmf2_.Eeprom.EepromWrap ECU_ADDRESS 0xFFF8234D /end MEASUREMENT
/begin MEASUREMENT EepromWrap.Eeprom.cnt_AutoPEmf1_ "bit-complement of eeprom-based counter for AutoPEmf1" UBYTE SBW_STANDARD_S1_S3 1 100 0 255 DISPLAY_IDENTIFIER cnt_AutoPEmf1_.Eeprom.EepromWrap ECU_ADDRESS 0xFFF8234E /end MEASUREMENT
/begin MEASUREMENT EepromWrap.Eeprom.cnt_AdaptivMode_ "bit-complement of eeprom-based operating-second counter for AdaptivMode" ULONG SBW_STANDARD_S1_S3 1 100 0 4294967295 DISPLAY_IDENTIFIER cnt_AdaptivMode_.Eeprom.EepromWrap ECU_ADDRESS 0xFFF82350 /end MEASUREMENT
/begin MEASUREMENT EepromWrap.Eeprom.cnt_SportMode_ "bit-complement of eeprom-based operating-second counter for SportMode" ULONG SBW_STANDARD_S1_S3 1 100 0 4294967295 DISPLAY_IDENTIFIER cnt_SportMode_.Eeprom.EepromWrap ECU_ADDRESS 0xFFF82354 /end MEASUREMENT
/begin MEASUREMENT EepromWrap.Eeprom.cnt_ManualMode_ "bit-complement of eeprom-based operating-second counter for ManualMode" ULONG SBW_STANDARD_S1_S3 1 100 0 4294967295 DISPLAY_IDENTIFIER cnt_ManualMode_.Eeprom.EepromWrap ECU_ADDRESS 0xFFF82358 /end MEASUREMENT
/begin MEASUREMENT EepromWrap.Eeprom.idx_last_drvLeavesCarInN_mem_entry "index of last registered DrvLeavesCarInN_Memory array-dataset entry" UBYTE SBW_STANDARD_S1_S3 1 100 0 2 DISPLAY_IDENTIFIER idx_last_drvLeavesCarInN_mem_entry.Eeprom.EepromWrap ECU_ADDRESS 0xFFF8235C /end MEASUREMENT
/begin MEASUREMENT EepromWrap.Eeprom.idx_last_drvLeavesCarInN_mem_entry_ "bit-complement of index of last registered DrvLeavesCarInN_Memory array-dataset entry" UBYTE SBW_STANDARD_S1_S3 1 100 0 255 DISPLAY_IDENTIFIER idx_last_drvLeavesCarInN_mem_entry_.Eeprom.EepromWrap ECU_ADDRESS 0xFFF8235D /end MEASUREMENT
/begin MEASUREMENT GearboxState.st_Gearbox "status of gearbox for transmission to other ECUs" UBYTE SBW_STANDARD_S1_S3 1 100 0 15 DISPLAY_IDENTIFIER st_Gearbox.GearboxState ECU_ADDRESS 0xFFF8A295 /end MEASUREMENT
/begin MEASUREMENT CarwashMode.st_HoldN "Status of N-Hold function" UBYTE SBW_STANDARD_S1_S3 1 100 0 7 DISPLAY_IDENTIFIER st_HoldN.CarwashMode ECU_ADDRESS 0xFFF8A296 /end MEASUREMENT
/begin MEASUREMENT Mode.ModeNext "mode computed by SBW 0=Adaptive 1=Sport 2=Manual 3= ManualSport" UBYTE SBW_STANDARD_S1_S3 1 100 0 3 DISPLAY_IDENTIFIER ModeNext.Mode ECU_ADDRESS 0xFFF89FFC /end MEASUREMENT
/begin MEASUREMENT Mode.st_TipP "Forwarded tip plus signal for shifting strategy 0=noTip 1=singleTip 2=doubleTip" UBYTE SBW_STANDARD_S1_S3 1 100 0 2 DISPLAY_IDENTIFIER st_TipP.Mode ECU_ADDRESS 0xFFF89FFD /end MEASUREMENT
/begin MEASUREMENT Mode.st_TipM "Forwarded tip minus signal for shifting strategy 0=noTip 1=singleTip 2=doubleTip" UBYTE SBW_STANDARD_S1_S3 1 100 0 2 DISPLAY_IDENTIFIER st_TipM.Mode ECU_ADDRESS 0xFFF89FFE /end MEASUREMENT
/begin MEASUREMENT Mode.st_StoreModePosChange "stored mode after change of position to PRN from D" UBYTE SBW_STANDARD_S1_S3 1 100 0 255 DISPLAY_IDENTIFIER st_StoreModePosChange.Mode ECU_ADDRESS 0xFFF89FFF /end MEASUREMENT
/begin MEASUREMENT Mode.st_StoreMode "stored mode as default mode" UBYTE SBW_STANDARD_S1_S3 1 100 0 255 DISPLAY_IDENTIFIER st_StoreMode.Mode ECU_ADDRESS 0xFFF8A000 /end MEASUREMENT
/begin MEASUREMENT Mode.st_ModeChangeEvent "reason for last mode change" UBYTE SBW_STANDARD_S1_S3 1 100 0 18 DISPLAY_IDENTIFIER st_ModeChangeEvent.Mode ECU_ADDRESS 0xFFF8A001 /end MEASUREMENT
/begin MEASUREMENT DrvReq2Pos.f_CC_Spd2HighP "Flag for CC-Message: Position P only in standstill" UBYTE SBW_STANDARD_S1_S3 1 100 0 1 BIT_MASK 0x1 DISPLAY_IDENTIFIER f_CC_Spd2HighP.DrvReq2Pos ECU_ADDRESS 0xFFF8A002 /end MEASUREMENT
/begin MEASUREMENT DrvReq2Pos.PosDrvReq "Position calculated from Driver Request" UBYTE SBW_STANDARD_S1_S3 1 100 0 8 DISPLAY_IDENTIFIER PosDrvReq.DrvReq2Pos ECU_ADDRESS 0xFFF8A003 /end MEASUREMENT
/begin MEASUREMENT FASReq2Pos.f_NoDrvAssist_ViaSubstFunct "flag signaling deactivation of EH-subst.fctn signals [DI_ GET_ALL_SUBST_FUNCT DI_ GET_ALL_SUBST_FUNCT_HI] via appl.switch SWI_NoDrvAssist_ViaSubstFunct or SWI_NoDrvAssist_ViaSubstFunct_Hi" UBYTE SBW_STANDARD_S1_S3 1 100 0 1 BIT_MASK 0x1 DISPLAY_IDENTIFIER f_NoDrvAssist_ViaSubstFunct.FASReq2Pos ECU_ADDRESS 0xFFF8A006 /end MEASUREMENT
/begin MEASUREMENT FASReq2Pos.f_NoDrvAssist "FAS-mode deactivation-flag" UBYTE SBW_STANDARD_S1_S3 1 100 0 1 BIT_MASK 0x1 DISPLAY_IDENTIFIER f_NoDrvAssist.FASReq2Pos ECU_ADDRESS 0xFFF8A007 /end MEASUREMENT
/begin MEASUREMENT FASReq2Pos.f_DrvAssistPosModeErr "FAS- pos-/mode-sig.status error-flag" UBYTE SBW_STANDARD_S1_S3 1 100 0 1 BIT_MASK 0x1 DISPLAY_IDENTIFIER f_DrvAssistPosModeErr.FASReq2Pos ECU_ADDRESS 0xFFF8A008 /end MEASUREMENT
/begin MEASUREMENT FASReq2Pos.st_ModeDrvAssistTrans "status for EGS-FAS-mode [1=PMA/RCP-requests allowed and possible]" UBYTE SBW_STANDARD_S1_S3 1 100 0 2 DISPLAY_IDENTIFIER st_ModeDrvAssistTrans.FASReq2Pos ECU_ADDRESS 0xFFF8A009 /end MEASUREMENT
/begin MEASUREMENT FASReq2Pos.st_ModeDrvAssistTrans_ "bit complement of status st_ModeDrvAssistTrans for EGS-FAS-mode" UBYTE SBW_STANDARD_S1_S3 1 100 0 255 DISPLAY_IDENTIFIER st_ModeDrvAssistTrans_.FASReq2Pos ECU_ADDRESS 0xFFF8A00A /end MEASUREMENT
/begin MEASUREMENT FASReq2Pos.PosDrvAssistRaw_Trig "trigger signal [default=0 / =8:PosP 7:PosR 6:PosN 5:PosD if signal-edge] of PosDrvAssistRaw" UBYTE SBW_STANDARD_S1_S3 1 100 0 8 DISPLAY_IDENTIFIER PosDrvAssistRaw_Trig.FASReq2Pos ECU_ADDRESS 0xFFF8A00B /end MEASUREMENT
/begin MEASUREMENT FASReq2Pos.PosFASReq "EGS-computed Position request from FAS: PMA or RCP from ICM-ECU via CAN" UBYTE SBW_STANDARD_S1_S3 1 100 0 8 DISPLAY_IDENTIFIER PosFASReq.FASReq2Pos ECU_ADDRESS 0xFFF8A00C /end MEASUREMENT
/begin MEASUREMENT FASReq2Pos.f_DAS_StoreP "flag f. activation of FAS-Store-P-function" UBYTE SBW_STANDARD_S1_S3 1 100 0 1 BIT_MASK 0x1 DISPLAY_IDENTIFIER f_DAS_StoreP.FASReq2Pos ECU_ADDRESS 0xFFF8A00D /end MEASUREMENT
/begin MEASUREMENT FASReq2Pos.PosDrvAssistRaw_Old "FAS/DAS request of last 10ms-cyclic for driving-direction: 0=NA 5=D 6=N 7=R 8=P" UBYTE SBW_STANDARD_S1_S3 1 100 0 8 DISPLAY_IDENTIFIER PosDrvAssistRaw_Old.FASReq2Pos ECU_ADDRESS 0xFFF8A00E /end MEASUREMENT
/begin MEASUREMENT FASReq2Pos.PosDrvAssist_Gate "value-checked and FAS-mode-enabled FAS/DAS request for driving-direction: 0=NA 5=D 6=N 7=R 8=P" UBYTE SBW_STANDARD_S1_S3 1 100 0 8 DISPLAY_IDENTIFIER PosDrvAssist_Gate.FASReq2Pos ECU_ADDRESS 0xFFF8A00F /end MEASUREMENT
/begin MEASUREMENT FASReq2Pos.PosDrvAssist_Gate_Old "value of last cycle of value-checked and FAS-mode-enabled FAS/DAS request for driving-direction: 0=NA 5=D 6=N 7=R 8=P" UBYTE SBW_STANDARD_S1_S3 1 100 0 8 DISPLAY_IDENTIFIER PosDrvAssist_Gate_Old.FASReq2Pos ECU_ADDRESS 0xFFF8A010 /end MEASUREMENT
/begin MEASUREMENT FASReq2Pos.PosDrvAssist_Filt "time-filtered FAS/DAS request for driving-direction: 0=NA 5=D 6=N 7=R 8=P" UBYTE SBW_STANDARD_S1_S3 1 100 0 8 DISPLAY_IDENTIFIER PosDrvAssist_Filt.FASReq2Pos ECU_ADDRESS 0xFFF8A011 /end MEASUREMENT
/begin MEASUREMENT DiagPos.PosPRND "Final Position by sequential computation" UBYTE SBW_STANDARD_S1_S3 1 100 0 8 DISPLAY_IDENTIFIER PosPRND.DiagPos ECU_ADDRESS 0xFFF8A016 /end MEASUREMENT
/begin MEASUREMENT DiagPos.PosPRND_ "Complement of Position PosPRND" UBYTE SBW_STANDARD_S1_S3 1 100 247 255 DISPLAY_IDENTIFIER PosPRND_.DiagPos ECU_ADDRESS 0xFFF8A017 /end MEASUREMENT
/begin MEASUREMENT DiagPos.PosPRND_Old "Position from Diagnosis Position from prior cycle" UBYTE SBW_STANDARD_S1_S3 1 100 0 8 DISPLAY_IDENTIFIER PosPRND_Old.DiagPos ECU_ADDRESS 0xFFF8A018 /end MEASUREMENT
/begin MEASUREMENT DiagPos.st_DiagPosEvent "Indicates which diag pos event has changed autoposition" UBYTE SBW_STANDARD_S1_S3 1 100 0 255 DISPLAY_IDENTIFIER st_DiagPosEvent.DiagPos ECU_ADDRESS 0xFFF8A019 /end MEASUREMENT
/begin MEASUREMENT DiagPos.PosStatus "Status of position of SBW/SBL" UBYTE SBW_STANDARD_S1_S3 1 100 0 2 DISPLAY_IDENTIFIER PosStatus.DiagPos ECU_ADDRESS 0xFFF8A01A /end MEASUREMENT
/begin MEASUREMENT DiagPos.PosAuto_Old "Position from Auto Position from prior cycle" UBYTE SBW_STANDARD_S1_S3 1 100 0 8 DISPLAY_IDENTIFIER PosAuto_Old.DiagPos ECU_ADDRESS 0xFFF8A01B /end MEASUREMENT
/begin MEASUREMENT DiagPos.f_PreAdaptationFailed "Flag to indicate that pre adaptation failed" UBYTE SBW_STANDARD_S1_S3 1 100 0 1 BIT_MASK 0x1 DISPLAY_IDENTIFIER f_PreAdaptationFailed.DiagPos ECU_ADDRESS 0xFFF8A01C /end MEASUREMENT
/begin MEASUREMENT DiagPos.f_DrvAssistPosModeErr_Old "last-cycle value of FAS- pos-/mode-sig.status error-flag" UBYTE SBW_STANDARD_S1_S3 1 100 0 1 BIT_MASK 0x1 DISPLAY_IDENTIFIER f_DrvAssistPosModeErr_Old.DiagPos ECU_ADDRESS 0xFFF8A01D /end MEASUREMENT
/begin MEASUREMENT DiagPos.f_CC_DiagPosInWrongDrvDirTrig "Flag for activation of cc message ID_DiagPosInWrongDrvDir" UBYTE SBW_STANDARD_S1_S3 1 100 0 1 BIT_MASK 0x1 DISPLAY_IDENTIFIER f_CC_DiagPosInWrongDrvDirTrig.DiagPos ECU_ADDRESS 0xFFF8A01E /end MEASUREMENT
/begin MEASUREMENT DiagPos.f_RequestDiagP "store request for DiagPos P until speed lower than threshold" UBYTE SBW_STANDARD_S1_S3 1 100 0 1 BIT_MASK 0x1 DISPLAY_IDENTIFIER f_RequestDiagP.DiagPos ECU_ADDRESS 0xFFF8A01F /end MEASUREMENT
/begin MEASUREMENT InitPosBPRAM.f_RzN_LimphomeBuf "indicate that SAB caused a reset to heal limphome" UBYTE SBW_STANDARD_S1_S3 1 100 0 1 BIT_MASK 0x1 DISPLAY_IDENTIFIER f_RzN_LimphomeBuf.InitPosBPRAM ECU_ADDRESS 0xFFF83AF2 /end MEASUREMENT
/begin MEASUREMENT InitPosBPRAM.f_RzN_LimphomeBuf_ "complement to f_RzN_LimphomeBuf" UBYTE SBW_STANDARD_S1_S3 1 100 0 255 DISPLAY_IDENTIFIER f_RzN_LimphomeBuf_.InitPosBPRAM ECU_ADDRESS 0xFFF83AF3 /end MEASUREMENT
/begin MEASUREMENT InitPos.PosPRND_Init "position of selection-lever after reset [without intermediate positions]; buffered in PosPRNDBuf" UBYTE SBW_STANDARD_S1_S3 1 100 0 255 DISPLAY_IDENTIFIER PosPRND_Init.InitPos ECU_ADDRESS 0xFFF8A2BE /end MEASUREMENT
/begin MEASUREMENT InitPos.st_InitPosChangeEvent "indicates which condition lead to initial position" UBYTE SBW_STANDARD_S1_S3 1 100 0 255 DISPLAY_IDENTIFIER st_InitPosChangeEvent.InitPos ECU_ADDRESS 0xFFF8A2BF /end MEASUREMENT
/begin MEASUREMENT AutoPos.PosAuto "Auto Position P or N" UBYTE SBW_STANDARD_S1_S3 1 100 0 8 DISPLAY_IDENTIFIER PosAuto.AutoPos ECU_ADDRESS 0xFFF8A2C0 /end MEASUREMENT
/begin MEASUREMENT AutoPos.st_AutoPosEvent "Indicates which auto pos event has changed autoposition" UBYTE SBW_STANDARD_S1_S3 1 100 0 255 DISPLAY_IDENTIFIER st_AutoPosEvent.AutoPos ECU_ADDRESS 0xFFF8A2C1 /end MEASUREMENT
/begin MEASUREMENT AutoPos.f_NoAutoPEMFHelp "Indicates that AutoP for EMF help message is ignored" UBYTE SBW_STANDARD_S1_S3 1 100 0 1 BIT_MASK 0x1 DISPLAY_IDENTIFIER f_NoAutoPEMFHelp.AutoPos ECU_ADDRESS 0xFFF8A2C2 /end MEASUREMENT
/begin MEASUREMENT AutoPos.f_CC_AutoPosPByDriverLeaveCar "CCMessage by AutoPosP caused by Driver leave Car Flag for driver warning" UBYTE SBW_STANDARD_S1_S3 1 100 0 1 BIT_MASK 0x1 DISPLAY_IDENTIFIER f_CC_AutoPosPByDriverLeaveCar.AutoPos ECU_ADDRESS 0xFFF8A2C3 /end MEASUREMENT
/begin MEASUREMENT AutoPos.f_SpdBelowOrEqP_Th "indicates that v_Vehspd is below D_v_AutoP_Uth" UBYTE SBW_STANDARD_S1_S3 1 100 0 1 BIT_MASK 0x1 DISPLAY_IDENTIFIER f_SpdBelowOrEqP_Th.AutoPos ECU_ADDRESS 0xFFF8A2C4 /end MEASUREMENT
/begin MEASUREMENT ShiftLock.Shiftlock_Brake.cShiftlock_SubModule._.f_Active "Shiftlock is active" UBYTE SBW_STANDARD_S1_S3 1 100 0 1 BIT_MASK 0x1 DISPLAY_IDENTIFIER f_Active._.cShiftlock_SubModule.Shiftlock_Brake.ShiftLock ECU_ADDRESS 0xFFF8A7B8 /end MEASUREMENT
/begin MEASUREMENT ShiftLock.Shiftlock_Engine.cShiftlock_SubModule._.f_Active "Shiftlock is active" UBYTE SBW_STANDARD_S1_S3 1 100 0 1 BIT_MASK 0x1 DISPLAY_IDENTIFIER f_Active._.cShiftlock_SubModule.Shiftlock_Engine.ShiftLock ECU_ADDRESS 0xFFF8A7C4 /end MEASUREMENT
/begin MEASUREMENT ShiftLock.Shiftlock_RemoteStart.cShiftlock_SubModule._.f_Active "Shiftlock is active" UBYTE SBW_STANDARD_S1_S3 1 100 0 1 BIT_MASK 0x1 DISPLAY_IDENTIFIER f_Active._.cShiftlock_SubModule.Shiftlock_RemoteStart.ShiftLock ECU_ADDRESS 0xFFF8A7D0 /end MEASUREMENT
/begin MEASUREMENT ShiftLock.Shiftlock_CAN.cShiftlock_SubModule._.f_Active "Shiftlock is active" UBYTE SBW_STANDARD_S1_S3 1 100 0 1 BIT_MASK 0x1 DISPLAY_IDENTIFIER f_Active._.cShiftlock_SubModule.Shiftlock_CAN.ShiftLock ECU_ADDRESS 0xFFF8A7DC /end MEASUREMENT
/begin MEASUREMENT ShiftLock.f_Shiftlock_Brake "Shiftlock brake active" UBYTE SBW_STANDARD_S1_S3 1 100 0 1 BIT_MASK 0x1 DISPLAY_IDENTIFIER f_Shiftlock_Brake.ShiftLock ECU_ADDRESS 0xFFF8A7E4 /end MEASUREMENT
/begin MEASUREMENT ShiftLock.f_Shiftlock_Engine "Shiftlock engine active" UBYTE SBW_STANDARD_S1_S3 1 100 0 1 BIT_MASK 0x1 DISPLAY_IDENTIFIER f_Shiftlock_Engine.ShiftLock ECU_ADDRESS 0xFFF8A7E5 /end MEASUREMENT
/begin MEASUREMENT ShiftLock.f_Shiftlock_RemoteStart "Shiftlock RemoteStart active" UBYTE SBW_STANDARD_S1_S3 1 100 0 1 BIT_MASK 0x1 DISPLAY_IDENTIFIER f_Shiftlock_RemoteStart.ShiftLock ECU_ADDRESS 0xFFF8A7E6 /end MEASUREMENT
/begin MEASUREMENT ShiftLock.f_Shiftlock_CAN "Shiftlock CAN active" UBYTE SBW_STANDARD_S1_S3 1 100 0 1 BIT_MASK 0x1 DISPLAY_IDENTIFIER f_Shiftlock_CAN.ShiftLock ECU_ADDRESS 0xFFF8A7E7 /end MEASUREMENT
/begin MEASUREMENT ShiftLock.DrvReqPRND_SL "Shiftlock filtered PosPRND signal" UBYTE SBW_STANDARD_S1_S3 1 100 0 8 DISPLAY_IDENTIFIER DrvReqPRND_SL.ShiftLock ECU_ADDRESS 0xFFF8A7E8 /end MEASUREMENT
/begin MEASUREMENT ShiftLock.f_CC_ShiftlockActive "Flag for CC-Message: Push Break to insert Gear" UBYTE SBW_STANDARD_S1_S3 1 100 0 1 BIT_MASK 0x1 DISPLAY_IDENTIFIER f_CC_ShiftlockActive.ShiftLock ECU_ADDRESS 0xFFF8A7E9 /end MEASUREMENT
/begin MEASUREMENT ShiftLock.f_DeactBySpeed "Speed dependent shiftlock modules are deactivated" UBYTE SBW_STANDARD_S1_S3 1 100 0 1 BIT_MASK 0x1 DISPLAY_IDENTIFIER f_DeactBySpeed.ShiftLock ECU_ADDRESS 0xFFF8A7EA /end MEASUREMENT
/begin MEASUREMENT Ews4Measure.st_Ews4 "state of immobilizer EWS4: 0 = blocked 1 = free 2 = init" UBYTE SBW_STANDARD_S1_S3 1 100 0 2 DISPLAY_IDENTIFIER st_Ews4.Ews4Measure ECU_ADDRESS 0xFFF8A7EC /end MEASUREMENT
/begin MEASUREMENT Ews4Measure.st_Ews4_ChRspKf_TYP_ST "type- and state-infos in challenge/response/keyfactor" UBYTE SBW_STANDARD_S1_S3 1 100 0 255 DISPLAY_IDENTIFIER st_Ews4_ChRspKf_TYP_ST.Ews4Measure ECU_ADDRESS 0xFFF8A7ED /end MEASUREMENT
/begin MEASUREMENT Ews4Measure.st_Ews4Internal "internal EWS4-state in state-machine" UBYTE SBW_STANDARD_S1_S3 1 100 0 255 DISPLAY_IDENTIFIER st_Ews4Internal.Ews4Measure ECU_ADDRESS 0xFFF8A7EE /end MEASUREMENT
/begin MEASUREMENT Ews4Measure.st_Ews4IntSub "internal EWS4-sub-state in state-machine -exists only once for all substates-" UBYTE SBW_STANDARD_S1_S3 1 100 0 255 DISPLAY_IDENTIFIER st_Ews4IntSub.Ews4Measure ECU_ADDRESS 0xFFF8A7EF /end MEASUREMENT
/begin MEASUREMENT Ews4Measure.st_actual_CAN_ch "actual CAN-bus selected by EWS4: 1:A-CAN 2:FA-CAN 0xff:no CAN avail" UBYTE SBW_STANDARD_S1_S3 1 100 0 255 DISPLAY_IDENTIFIER st_actual_CAN_ch.Ews4Measure ECU_ADDRESS 0xFFF8A7F0 /end MEASUREMENT
/begin MEASUREMENT Ews4Measure.f_client_enabled "flag f. ST of chall./KF - relates directly to st_Ews4!=0: true=CLIENT ENABLED false=CLIENT BLOCKED" UBYTE SBW_STANDARD_S1_S3 1 100 0 1 BIT_MASK 0x1 DISPLAY_IDENTIFIER f_client_enabled.Ews4Measure ECU_ADDRESS 0xFFF8A7F1 /end MEASUREMENT
/begin MEASUREMENT Ews4Measure.f_rsp_nonauthentic "flag for checking on authentical response" UBYTE SBW_STANDARD_S1_S3 1 100 0 1 BIT_MASK 0x1 DISPLAY_IDENTIFIER f_rsp_nonauthentic.Ews4Measure ECU_ADDRESS 0xFFF8A7F2 /end MEASUREMENT
/begin MEASUREMENT Ews4Measure.rsp_err_cnt_C "error-counter for counting DH-server-responses without SK available" UBYTE SBW_STANDARD_S1_S3 1 100 0 255 DISPLAY_IDENTIFIER rsp_err_cnt_C.Ews4Measure ECU_ADDRESS 0xFFF8A7F3 /end MEASUREMENT
/begin MEASUREMENT Ews4Measure.rsp_err_cnt_A "error-counter for counting NON-authentical DH-server-responses with SK available" UBYTE SBW_STANDARD_S1_S3 1 100 0 255 DISPLAY_IDENTIFIER rsp_err_cnt_A.Ews4Measure ECU_ADDRESS 0xFFF8A7F4 /end MEASUREMENT
/begin MEASUREMENT Ews4Measure.rsp_err_cnt_B "error-counter for counting NON-authentical DH-server-responses with SK available / after calc. SK" UBYTE SBW_STANDARD_S1_S3 1 100 0 255 DISPLAY_IDENTIFIER rsp_err_cnt_B.Ews4Measure ECU_ADDRESS 0xFFF8A7F5 /end MEASUREMENT
/begin MEASUREMENT Ews4Measure.rsp_ok_cnt "ok-counter for counting rxd authentical DH-server-responses with SK available / after calc. SK" UBYTE SBW_STANDARD_S1_S3 1 100 0 255 DISPLAY_IDENTIFIER rsp_ok_cnt.Ews4Measure ECU_ADDRESS 0xFFF8A7F6 /end MEASUREMENT
/begin MEASUREMENT Ews4Measure.cnt_saved_eewrite_update_val "saved eeprom-based counter value for successful eeprom-writing-events" ULONG SBW_STANDARD_S1_S3 1 100 0 4294967295 DISPLAY_IDENTIFIER cnt_saved_eewrite_update_val.Ews4Measure ECU_ADDRESS 0xFFF8A7F8 /end MEASUREMENT
/begin MEASUREMENT Ews4Measure.st_Ews4StoreEE "internal state of storing EWS4 EEPROM-values" UBYTE SBW_STANDARD_S1_S3 1 100 0 255 DISPLAY_IDENTIFIER st_Ews4StoreEE.Ews4Measure ECU_ADDRESS 0xFFF8A7FC /end MEASUREMENT
/begin MEASUREMENT Ews4Measure.st_crypto_fctn_call "function-call-status for calling DH-exp.- and MD5-crypto-fctn: 0:start fctn. 1: poll result" UBYTE SBW_STANDARD_S1_S3 1 100 0 1 DISPLAY_IDENTIFIER st_crypto_fctn_call.Ews4Measure ECU_ADDRESS 0xFFF8A7FD /end MEASUREMENT
/begin MEASUREMENT Ews4Measure.cnt_NrOfMissingResponses "counter for missing responses - timeouts - after sending a TCU challenge / used for switching CAN-path" UBYTE SBW_STANDARD_S1_S3 1 100 0 1 DISPLAY_IDENTIFIER cnt_NrOfMissingResponses.Ews4Measure ECU_ADDRESS 0xFFF8A7FE /end MEASUREMENT
/begin MEASUREMENT Ews4Measure.f_switchedCANpath_wait_fIgnOn "flag signalling a can path switch without a following f_IgnOn - step" UBYTE SBW_STANDARD_S1_S3 1 100 0 1 BIT_MASK 0x1 DISPLAY_IDENTIFIER f_switchedCANpath_wait_fIgnOn.Ews4Measure ECU_ADDRESS 0xFFF8A7FF /end MEASUREMENT
/begin MEASUREMENT Ews4Measure.f_at_least_one_nonauth_rsp_rxd "flag signalling that at least one non-authentical response was receveid from DME" UBYTE SBW_STANDARD_S1_S3 1 100 0 1 BIT_MASK 0x1 DISPLAY_IDENTIFIER f_at_least_one_nonauth_rsp_rxd.Ews4Measure ECU_ADDRESS 0xFFF8A800 /end MEASUREMENT
/begin MEASUREMENT Ews4Measure.cnt_TASCASReq "counter for TAS-CAS requests transmitted by EGS" UBYTE SBW_STANDARD_S1_S3 1 100 0 255 DISPLAY_IDENTIFIER cnt_TASCASReq.Ews4Measure ECU_ADDRESS 0xFFF8A801 /end MEASUREMENT
/begin MEASUREMENT Ews4Measure.fsc_ews4_status "FSC-status: C_FscStateNotAvailable:0 C_FscStateVStored:1 C_FscStateAccepted:2 C_FscStateRejected:3" UBYTE SBW_STANDARD_S1_S3 1 100 0 3 DISPLAY_IDENTIFIER fsc_ews4_status.Ews4Measure ECU_ADDRESS 0xFFF8A802 /end MEASUREMENT
/begin MEASUREMENT Ews4Measure.f_FSCSignature_NonAuthentical "flag telling if check of FSC signature returned non-authentical or not" UBYTE SBW_STANDARD_S1_S3 1 100 0 1 BIT_MASK 0x1 DISPLAY_IDENTIFIER f_FSCSignature_NonAuthentical.Ews4Measure ECU_ADDRESS 0xFFF8A803 /end MEASUREMENT
/begin MEASUREMENT Ews4Measure.fsc_ews4_old_date "saved 'old' FSC-date of last authentical FSC in MINUTES since 1st Jan 2000" ULONG SBW_STANDARD_S1_S3 1 100 0 4294967295 DISPLAY_IDENTIFIER fsc_ews4_old_date.Ews4Measure ECU_ADDRESS 0xFFF8A804 /end MEASUREMENT
/begin MEASUREMENT Ews4Measure.fsc_ews4_actual_date "date of actual checked FSC in MINUTES since 1st Jan 2000" ULONG SBW_STANDARD_S1_S3 1 100 0 4294967295 DISPLAY_IDENTIFIER fsc_ews4_actual_date.Ews4Measure ECU_ADDRESS 0xFFF8A808 /end MEASUREMENT
/begin MEASUREMENT Ews4Measure.st_FSC_Active "FSC-activity-status for FSC-UDS-jobs in EWS4-internal state-machine: 0:passive 1:store 2:check" UBYTE SBW_STANDARD_S1_S3 1 100 0 2 DISPLAY_IDENTIFIER st_FSC_Active.Ews4Measure ECU_ADDRESS 0xFFF8A80C /end MEASUREMENT
/begin MEASUREMENT Ews4Measure.fsc_check_routine_result "FSC-check-process routine-result for returning back UDS-data" UBYTE SBW_STANDARD_S1_S3 1 100 0 255 DISPLAY_IDENTIFIER fsc_check_routine_result.Ews4Measure ECU_ADDRESS 0xFFF8A80D /end MEASUREMENT
/begin MEASUREMENT Ews4Measure.uwb_ews4 "byte for ambient-conditions UWB concerning EWS4 error-entry" UBYTE SBW_STANDARD_S1_S3 1 100 0 255 DISPLAY_IDENTIFIER uwb_ews4.Ews4Measure ECU_ADDRESS 0xFFF8A80E /end MEASUREMENT
/begin MEASUREMENT KombiMsgOutOEM.CtlDispGear "displayed gear on kombi" UBYTE SBW_STANDARD_S1_S3 1 100 0 255 DISPLAY_IDENTIFIER CtlDispGear.KombiMsgOutOEM ECU_ADDRESS 0xFFF8A2C7 /end MEASUREMENT
/begin MEASUREMENT KombiMsgOutOEM.CtlDispPos "displayed pos on kombi" UBYTE SBW_STANDARD_S1_S3 1 100 0 15 DISPLAY_IDENTIFIER CtlDispPos.KombiMsgOutOEM ECU_ADDRESS 0xFFF8A2C8 /end MEASUREMENT
/begin MEASUREMENT KombiMsgOutOEM.CtlDispPos_ "bit complement of displayed pos on kombi" UBYTE SBW_STANDARD_S1_S3 1 100 0 255 DISPLAY_IDENTIFIER CtlDispPos_.KombiMsgOutOEM ECU_ADDRESS 0xFFF8A2C9 /end MEASUREMENT
/begin MEASUREMENT KombiMsgOutOEM.CtlDispPosFlash "flag for flashing position on kombi" UBYTE SBW_STANDARD_S1_S3 1 100 0 15 DISPLAY_IDENTIFIER CtlDispPosFlash.KombiMsgOutOEM ECU_ADDRESS 0xFFF8A2CA /end MEASUREMENT
/begin MEASUREMENT KombiMsgOutOEM.CtlDispMode "displayed mode on kombi" UBYTE SBW_STANDARD_S1_S3 1 100 0 15 DISPLAY_IDENTIFIER CtlDispMode.KombiMsgOutOEM ECU_ADDRESS 0xFFF8A2CB /end MEASUREMENT
/begin MEASUREMENT L2_KombiMsgOutOEM.L2_DisplayPos.Value "Level2-Value of CtlDisplay" UBYTE SBW_STANDARD_S1_S3 1 100 0 15 DISPLAY_IDENTIFIER Value.L2_DisplayPos.L2_KombiMsgOutOEM ECU_ADDRESS 0xFFF8A814 /end MEASUREMENT
/begin MEASUREMENT L2_KombiMsgOutOEM.L2_DisplayPos.Complement "Level2-Value of CtlDisplay" UBYTE SBW_STANDARD_S1_S3 1 100 0 15 DISPLAY_IDENTIFIER Complement.L2_DisplayPos.L2_KombiMsgOutOEM ECU_ADDRESS 0xFFF8A815 /end MEASUREMENT
/begin MEASUREMENT L2_KombiMsgOutOEM.L2_DisplayPosFlash.Value "Level2-Value of CtlDispPosFlash" UBYTE SBW_STANDARD_S1_S3 1 100 0 1 DISPLAY_IDENTIFIER Value.L2_DisplayPosFlash.L2_KombiMsgOutOEM ECU_ADDRESS 0xFFF8A816 /end MEASUREMENT
/begin MEASUREMENT L2_KombiMsgOutOEM.L2_DisplayPosFlash.Complement "Level2-Value of CtlDispPosFlash" UBYTE SBW_STANDARD_S1_S3 1 100 0 1 DISPLAY_IDENTIFIER Complement.L2_DisplayPosFlash.L2_KombiMsgOutOEM ECU_ADDRESS 0xFFF8A817 /end MEASUREMENT
/begin MEASUREMENT PAK_SBWOUT.PAK_SBWOUT_TEST "Only a TestValue" UBYTE SBW_STANDARD_S1_S3 1 100 1 7 DISPLAY_IDENTIFIER PAK_SBWOUT_TEST.PAK_SBWOUT ECU_ADDRESS 0xFFF8A2CC /end MEASUREMENT
/begin MEASUREMENT PowerDown.st_PowerDownDelay "status for timer tmr_PowDownDelay counts active for P R N D" UBYTE SBW_STANDARD_S1_S3 1 100 0 1 DISPLAY_IDENTIFIER st_PowerDownDelay.PowerDown ECU_ADDRESS 0xFFF8A036 /end MEASUREMENT
/begin MEASUREMENT PowerDown.f_PowDownEnable "flag to notify RB-SW powering down is permitted in overshoot-state" UBYTE SBW_STANDARD_S1_S3 1 100 0 1 BIT_MASK 0x1 DISPLAY_IDENTIFIER f_PowDownEnable.PowerDown ECU_ADDRESS 0xFFF8A037 /end MEASUREMENT
/begin MEASUREMENT SrvcMsgHandler.cnt_NrOfOverdueMsgs "count number of sendings" UBYTE SBW_STANDARD_S1_S3 1 100 0 255 DISPLAY_IDENTIFIER cnt_NrOfOverdueMsgs.SrvcMsgHandler ECU_ADDRESS 0xFFF8A82C /end MEASUREMENT
/begin MEASUREMENT SrvcMsgHandler.LastSemaphore "value of the semaphore of previous cycle" UBYTE SBW_STANDARD_S1_S3 1 100 0 1 BIT_MASK 0x1 DISPLAY_IDENTIFIER LastSemaphore.SrvcMsgHandler ECU_ADDRESS 0xFFF8A82D /end MEASUREMENT
/begin MEASUREMENT SrvcMsgHandler.st_SendMSA_MSg "state of statemachine for sending the MSA Msg" UBYTE SBW_STANDARD_S1_S3 1 100 0 3 DISPLAY_IDENTIFIER st_SendMSA_MSg.SrvcMsgHandler ECU_ADDRESS 0xFFF8A82E /end MEASUREMENT
/begin MEASUREMENT SrvcMsgHandler.cnt_Send_Counter "Number of times same msg is resent" UBYTE SBW_STANDARD_S1_S3 1 100 0 3 DISPLAY_IDENTIFIER cnt_Send_Counter.SrvcMsgHandler ECU_ADDRESS 0xFFF8A82F /end MEASUREMENT
/begin MEASUREMENT SrvcMsgHandler.MSA_Msg_Function_Selection "saving RQ_MSA_FN_SLCTN 6Bit" UBYTE SBW_STANDARD_S1_S3 1 100 0 255 DISPLAY_IDENTIFIER MSA_Msg_Function_Selection.SrvcMsgHandler ECU_ADDRESS 0xFFF8A830 /end MEASUREMENT
/begin MEASUREMENT SrvcMsgHandler.MSA_Msg_Function_Requester "saving ID_FN_RQ_MSA 8Bit" UBYTE SBW_STANDARD_S1_S3 1 100 0 255 DISPLAY_IDENTIFIER MSA_Msg_Function_Requester.SrvcMsgHandler ECU_ADDRESS 0xFFF8A831 /end MEASUREMENT
/begin MEASUREMENT CCMsgBPRAM.Bitmask_MsgSendLow_Buf "Lower bitmask of cc message send (0-31)" ULONG SBW_STANDARD_S1_S3 1 100 0 4294967295 DISPLAY_IDENTIFIER Bitmask_MsgSendLow_Buf.CCMsgBPRAM ECU_ADDRESS 0xFFF83AF4 /end MEASUREMENT
/begin MEASUREMENT CCMsgBPRAM.Bitmask_MsgSendLow_Buf_ "Complement of lower bitmask of cc message send (0-31)" ULONG SBW_STANDARD_S1_S3 1 100 0 4294967295 DISPLAY_IDENTIFIER Bitmask_MsgSendLow_Buf_.CCMsgBPRAM ECU_ADDRESS 0xFFF83AF8 /end MEASUREMENT
/begin MEASUREMENT CCMsgBPRAM.Bitmask_MsgSendHigh_Buf "Higher bitmask of cc message send (32-39)" UBYTE SBW_STANDARD_S1_S3 1 100 0 255 DISPLAY_IDENTIFIER Bitmask_MsgSendHigh_Buf.CCMsgBPRAM ECU_ADDRESS 0xFFF83AFC /end MEASUREMENT
/begin MEASUREMENT CCMsgBPRAM.Bitmask_MsgSendHigh_Buf_ "Complement of higher bitmask of cc message send (32-39)" UBYTE SBW_STANDARD_S1_S3 1 100 0 255 DISPLAY_IDENTIFIER Bitmask_MsgSendHigh_Buf_.CCMsgBPRAM ECU_ADDRESS 0xFFF83AFD /end MEASUREMENT
/begin MEASUREMENT CCMsg.ID_Hotmode1.cCC_ID._.MyIdx "Sequential Index of the CC-ID to access tables" UBYTE SBW_STANDARD_S1_S3 1 100 1 255 DISPLAY_IDENTIFIER MyIdx._.cCC_ID.ID_Hotmode1.CCMsg ECU_ADDRESS 0xFFF8A834 /end MEASUREMENT
/begin MEASUREMENT CCMsg.ID_Hotmode1.cCC_ID._.f_ID_Locked "Flag: Interlocked by other ID" UBYTE SBW_STANDARD_S1_S3 1 100 0 1 BIT_MASK 0x1 DISPLAY_IDENTIFIER f_ID_Locked._.cCC_ID.ID_Hotmode1.CCMsg ECU_ADDRESS 0xFFF8A835 /end MEASUREMENT
/begin MEASUREMENT CCMsg.ID_Hotmode1.cCC_ID._.f_ID_Reset "Flag: Premature Reset" UBYTE SBW_STANDARD_S1_S3 1 100 0 1 BIT_MASK 0x1 DISPLAY_IDENTIFIER f_ID_Reset._.cCC_ID.ID_Hotmode1.CCMsg ECU_ADDRESS 0xFFF8A836 /end MEASUREMENT
/begin MEASUREMENT CCMsg.ID_Hotmode1.cCC_ID._.st_ID "State of CC-ID Operating Sequence" UBYTE SBW_STANDARD_S1_S3 1 100 1 255 DISPLAY_IDENTIFIER st_ID._.cCC_ID.ID_Hotmode1.CCMsg ECU_ADDRESS 0xFFF8A837 /end MEASUREMENT
/begin MEASUREMENT CCMsg.ID_Hotmode1.cCC_ID._.MsgOnceSent "State of CC-ID Operating Sequence" UBYTE SBW_STANDARD_S1_S3 1 100 0 1 BIT_MASK 0x1 DISPLAY_IDENTIFIER MsgOnceSent._.cCC_ID.ID_Hotmode1.CCMsg ECU_ADDRESS 0xFFF8A838 /end MEASUREMENT
/begin MEASUREMENT CCMsg.ID_Hotmode1.f_ID_Hotmode1 "Flag for CC-Msgs" UBYTE SBW_STANDARD_S1_S3 1 100 0 1 BIT_MASK 0x1 DISPLAY_IDENTIFIER f_ID_Hotmode1.ID_Hotmode1.CCMsg ECU_ADDRESS 0xFFF8A850 /end MEASUREMENT
/begin MEASUREMENT CCMsg.ID_Hotmode3.cCC_ID._.MyIdx "Sequential Index of the CC-ID to access tables" UBYTE SBW_STANDARD_S1_S3 1 100 1 255 DISPLAY_IDENTIFIER MyIdx._.cCC_ID.ID_Hotmode3.CCMsg ECU_ADDRESS 0xFFF8A854 /end MEASUREMENT
/begin MEASUREMENT CCMsg.ID_Hotmode3.cCC_ID._.f_ID_Locked "Flag: Interlocked by other ID" UBYTE SBW_STANDARD_S1_S3 1 100 0 1 BIT_MASK 0x1 DISPLAY_IDENTIFIER f_ID_Locked._.cCC_ID.ID_Hotmode3.CCMsg ECU_ADDRESS 0xFFF8A855 /end MEASUREMENT
/begin MEASUREMENT CCMsg.ID_Hotmode3.cCC_ID._.f_ID_Reset "Flag: Premature Reset" UBYTE SBW_STANDARD_S1_S3 1 100 0 1 BIT_MASK 0x1 DISPLAY_IDENTIFIER f_ID_Reset._.cCC_ID.ID_Hotmode3.CCMsg ECU_ADDRESS 0xFFF8A856 /end MEASUREMENT
/begin MEASUREMENT CCMsg.ID_Hotmode3.cCC_ID._.st_ID "State of CC-ID Operating Sequence" UBYTE SBW_STANDARD_S1_S3 1 100 1 255 DISPLAY_IDENTIFIER st_ID._.cCC_ID.ID_Hotmode3.CCMsg ECU_ADDRESS 0xFFF8A857 /end MEASUREMENT
/begin MEASUREMENT CCMsg.ID_Hotmode3.cCC_ID._.MsgOnceSent "State of CC-ID Operating Sequence" UBYTE SBW_STANDARD_S1_S3 1 100 0 1 BIT_MASK 0x1 DISPLAY_IDENTIFIER MsgOnceSent._.cCC_ID.ID_Hotmode3.CCMsg ECU_ADDRESS 0xFFF8A858 /end MEASUREMENT
/begin MEASUREMENT CCMsg.ID_Hotmode3.f_ID_Hotmode3 "Flag for CC-Msgs" UBYTE SBW_STANDARD_S1_S3 1 100 0 1 BIT_MASK 0x1 DISPLAY_IDENTIFIER f_ID_Hotmode3.ID_Hotmode3.CCMsg ECU_ADDRESS 0xFFF8A870 /end MEASUREMENT
/begin MEASUREMENT CCMsg.ID_MechLimpInP.cCC_ID._.MyIdx "Sequential Index of the CC-ID to access tables" UBYTE SBW_STANDARD_S1_S3 1 100 1 255 DISPLAY_IDENTIFIER MyIdx._.cCC_ID.ID_MechLimpInP.CCMsg ECU_ADDRESS 0xFFF8A874 /end MEASUREMENT
/begin MEASUREMENT CCMsg.ID_MechLimpInP.cCC_ID._.f_ID_Locked "Flag: Interlocked by other ID" UBYTE SBW_STANDARD_S1_S3 1 100 0 1 BIT_MASK 0x1 DISPLAY_IDENTIFIER f_ID_Locked._.cCC_ID.ID_MechLimpInP.CCMsg ECU_ADDRESS 0xFFF8A875 /end MEASUREMENT
/begin MEASUREMENT CCMsg.ID_MechLimpInP.cCC_ID._.f_ID_Reset "Flag: Premature Reset" UBYTE SBW_STANDARD_S1_S3 1 100 0 1 BIT_MASK 0x1 DISPLAY_IDENTIFIER f_ID_Reset._.cCC_ID.ID_MechLimpInP.CCMsg ECU_ADDRESS 0xFFF8A876 /end MEASUREMENT
/begin MEASUREMENT CCMsg.ID_MechLimpInP.cCC_ID._.st_ID "State of CC-ID Operating Sequence" UBYTE SBW_STANDARD_S1_S3 1 100 1 255 DISPLAY_IDENTIFIER st_ID._.cCC_ID.ID_MechLimpInP.CCMsg ECU_ADDRESS 0xFFF8A877 /end MEASUREMENT
/begin MEASUREMENT CCMsg.ID_MechLimpInP.cCC_ID._.MsgOnceSent "State of CC-ID Operating Sequence" UBYTE SBW_STANDARD_S1_S3 1 100 0 1 BIT_MASK 0x1 DISPLAY_IDENTIFIER MsgOnceSent._.cCC_ID.ID_MechLimpInP.CCMsg ECU_ADDRESS 0xFFF8A878 /end MEASUREMENT
/begin MEASUREMENT CCMsg.ID_MechLimpInP.f_ID_MechLimpInP "Flag for CC-Msgs" UBYTE SBW_STANDARD_S1_S3 1 100 0 1 BIT_MASK 0x1 DISPLAY_IDENTIFIER f_ID_MechLimpInP.ID_MechLimpInP.CCMsg ECU_ADDRESS 0xFFF8A890 /end MEASUREMENT
/begin MEASUREMENT CCMsg.ID_MechLimpInPNoRD.cCC_ID._.MyIdx "Sequential Index of the CC-ID to access tables" UBYTE SBW_STANDARD_S1_S3 1 100 1 255 DISPLAY_IDENTIFIER MyIdx._.cCC_ID.ID_MechLimpInPNoRD.CCMsg ECU_ADDRESS 0xFFF8A894 /end MEASUREMENT
/begin MEASUREMENT CCMsg.ID_MechLimpInPNoRD.cCC_ID._.f_ID_Locked "Flag: Interlocked by other ID" UBYTE SBW_STANDARD_S1_S3 1 100 0 1 BIT_MASK 0x1 DISPLAY_IDENTIFIER f_ID_Locked._.cCC_ID.ID_MechLimpInPNoRD.CCMsg ECU_ADDRESS 0xFFF8A895 /end MEASUREMENT
/begin MEASUREMENT CCMsg.ID_MechLimpInPNoRD.cCC_ID._.f_ID_Reset "Flag: Premature Reset" UBYTE SBW_STANDARD_S1_S3 1 100 0 1 BIT_MASK 0x1 DISPLAY_IDENTIFIER f_ID_Reset._.cCC_ID.ID_MechLimpInPNoRD.CCMsg ECU_ADDRESS 0xFFF8A896 /end MEASUREMENT
/begin MEASUREMENT CCMsg.ID_MechLimpInPNoRD.cCC_ID._.st_ID "State of CC-ID Operating Sequence" UBYTE SBW_STANDARD_S1_S3 1 100 1 255 DISPLAY_IDENTIFIER st_ID._.cCC_ID.ID_MechLimpInPNoRD.CCMsg ECU_ADDRESS 0xFFF8A897 /end MEASUREMENT
/begin MEASUREMENT CCMsg.ID_MechLimpInPNoRD.cCC_ID._.MsgOnceSent "State of CC-ID Operating Sequence" UBYTE SBW_STANDARD_S1_S3 1 100 0 1 BIT_MASK 0x1 DISPLAY_IDENTIFIER MsgOnceSent._.cCC_ID.ID_MechLimpInPNoRD.CCMsg ECU_ADDRESS 0xFFF8A898 /end MEASUREMENT
/begin MEASUREMENT CCMsg.ID_MechLimpInPNoRD.f_ID_MechLimpInPNoRD "Flag for CC-Msgs" UBYTE SBW_STANDARD_S1_S3 1 100 0 1 BIT_MASK 0x1 DISPLAY_IDENTIFIER f_ID_MechLimpInPNoRD.ID_MechLimpInPNoRD.CCMsg ECU_ADDRESS 0xFFF8A8B0 /end MEASUREMENT
/begin MEASUREMENT CCMsg.ID_MechLimpInD.cCC_ID._.MyIdx "Sequential Index of the CC-ID to access tables" UBYTE SBW_STANDARD_S1_S3 1 100 1 255 DISPLAY_IDENTIFIER MyIdx._.cCC_ID.ID_MechLimpInD.CCMsg ECU_ADDRESS 0xFFF8A8B4 /end MEASUREMENT
/begin MEASUREMENT CCMsg.ID_MechLimpInD.cCC_ID._.f_ID_Locked "Flag: Interlocked by other ID" UBYTE SBW_STANDARD_S1_S3 1 100 0 1 BIT_MASK 0x1 DISPLAY_IDENTIFIER f_ID_Locked._.cCC_ID.ID_MechLimpInD.CCMsg ECU_ADDRESS 0xFFF8A8B5 /end MEASUREMENT
/begin MEASUREMENT CCMsg.ID_MechLimpInD.cCC_ID._.f_ID_Reset "Flag: Premature Reset" UBYTE SBW_STANDARD_S1_S3 1 100 0 1 BIT_MASK 0x1 DISPLAY_IDENTIFIER f_ID_Reset._.cCC_ID.ID_MechLimpInD.CCMsg ECU_ADDRESS 0xFFF8A8B6 /end MEASUREMENT
/begin MEASUREMENT CCMsg.ID_MechLimpInD.cCC_ID._.st_ID "State of CC-ID Operating Sequence" UBYTE SBW_STANDARD_S1_S3 1 100 1 255 DISPLAY_IDENTIFIER st_ID._.cCC_ID.ID_MechLimpInD.CCMsg ECU_ADDRESS 0xFFF8A8B7 /end MEASUREMENT
/begin MEASUREMENT CCMsg.ID_MechLimpInD.cCC_ID._.MsgOnceSent "State of CC-ID Operating Sequence" UBYTE SBW_STANDARD_S1_S3 1 100 0 1 BIT_MASK 0x1 DISPLAY_IDENTIFIER MsgOnceSent._.cCC_ID.ID_MechLimpInD.CCMsg ECU_ADDRESS 0xFFF8A8B8 /end MEASUREMENT
/begin MEASUREMENT CCMsg.ID_MechLimpInD.f_ID_MechLimpInD "Flag for CC-Msgs" UBYTE SBW_STANDARD_S1_S3 1 100 0 1 BIT_MASK 0x1 DISPLAY_IDENTIFIER f_ID_MechLimpInD.ID_MechLimpInD.CCMsg ECU_ADDRESS 0xFFF8A8D0 /end MEASUREMENT
/begin MEASUREMENT CCMsg.ID_Speed2HighForDrvReqP.cCC_ID._.MyIdx "Sequential Index of the CC-ID to access tables" UBYTE SBW_STANDARD_S1_S3 1 100 1 255 DISPLAY_IDENTIFIER MyIdx._.cCC_ID.ID_Speed2HighForDrvReqP.CCMsg ECU_ADDRESS 0xFFF8A8D4 /end MEASUREMENT
/begin MEASUREMENT CCMsg.ID_Speed2HighForDrvReqP.cCC_ID._.f_ID_Locked "Flag: Interlocked by other ID" UBYTE SBW_STANDARD_S1_S3 1 100 0 1 BIT_MASK 0x1 DISPLAY_IDENTIFIER f_ID_Locked._.cCC_ID.ID_Speed2HighForDrvReqP.CCMsg ECU_ADDRESS 0xFFF8A8D5 /end MEASUREMENT
/begin MEASUREMENT CCMsg.ID_Speed2HighForDrvReqP.cCC_ID._.f_ID_Reset "Flag: Premature Reset" UBYTE SBW_STANDARD_S1_S3 1 100 0 1 BIT_MASK 0x1 DISPLAY_IDENTIFIER f_ID_Reset._.cCC_ID.ID_Speed2HighForDrvReqP.CCMsg ECU_ADDRESS 0xFFF8A8D6 /end MEASUREMENT
/begin MEASUREMENT CCMsg.ID_Speed2HighForDrvReqP.cCC_ID._.st_ID "State of CC-ID Operating Sequence" UBYTE SBW_STANDARD_S1_S3 1 100 1 255 DISPLAY_IDENTIFIER st_ID._.cCC_ID.ID_Speed2HighForDrvReqP.CCMsg ECU_ADDRESS 0xFFF8A8D7 /end MEASUREMENT
/begin MEASUREMENT CCMsg.ID_Speed2HighForDrvReqP.cCC_ID._.MsgOnceSent "State of CC-ID Operating Sequence" UBYTE SBW_STANDARD_S1_S3 1 100 0 1 BIT_MASK 0x1 DISPLAY_IDENTIFIER MsgOnceSent._.cCC_ID.ID_Speed2HighForDrvReqP.CCMsg ECU_ADDRESS 0xFFF8A8D8 /end MEASUREMENT
/begin MEASUREMENT CCMsg.ID_Speed2HighForDrvReqP.f_ID_Speed2HighForDrvReqP "Flag for CC-Msgs" UBYTE SBW_STANDARD_S1_S3 1 100 0 1 BIT_MASK 0x1 DISPLAY_IDENTIFIER f_ID_Speed2HighForDrvReqP.ID_Speed2HighForDrvReqP.CCMsg ECU_ADDRESS 0xFFF8A8F0 /end MEASUREMENT
/begin MEASUREMENT CCMsg.ID_Speed2HighInPosP.cCC_ID._.MyIdx "Sequential Index of the CC-ID to access tables" UBYTE SBW_STANDARD_S1_S3 1 100 1 255 DISPLAY_IDENTIFIER MyIdx._.cCC_ID.ID_Speed2HighInPosP.CCMsg ECU_ADDRESS 0xFFF8A8F4 /end MEASUREMENT
/begin MEASUREMENT CCMsg.ID_Speed2HighInPosP.cCC_ID._.f_ID_Locked "Flag: Interlocked by other ID" UBYTE SBW_STANDARD_S1_S3 1 100 0 1 BIT_MASK 0x1 DISPLAY_IDENTIFIER f_ID_Locked._.cCC_ID.ID_Speed2HighInPosP.CCMsg ECU_ADDRESS 0xFFF8A8F5 /end MEASUREMENT
/begin MEASUREMENT CCMsg.ID_Speed2HighInPosP.cCC_ID._.f_ID_Reset "Flag: Premature Reset" UBYTE SBW_STANDARD_S1_S3 1 100 0 1 BIT_MASK 0x1 DISPLAY_IDENTIFIER f_ID_Reset._.cCC_ID.ID_Speed2HighInPosP.CCMsg ECU_ADDRESS 0xFFF8A8F6 /end MEASUREMENT
/begin MEASUREMENT CCMsg.ID_Speed2HighInPosP.cCC_ID._.st_ID "State of CC-ID Operating Sequence" UBYTE SBW_STANDARD_S1_S3 1 100 1 255 DISPLAY_IDENTIFIER st_ID._.cCC_ID.ID_Speed2HighInPosP.CCMsg ECU_ADDRESS 0xFFF8A8F7 /end MEASUREMENT
/begin MEASUREMENT CCMsg.ID_Speed2HighInPosP.cCC_ID._.MsgOnceSent "State of CC-ID Operating Sequence" UBYTE SBW_STANDARD_S1_S3 1 100 0 1 BIT_MASK 0x1 DISPLAY_IDENTIFIER MsgOnceSent._.cCC_ID.ID_Speed2HighInPosP.CCMsg ECU_ADDRESS 0xFFF8A8F8 /end MEASUREMENT
/begin MEASUREMENT CCMsg.ID_Speed2HighInPosP.f_ID_Speed2HighInPosP "Flag for CC-Msgs" UBYTE SBW_STANDARD_S1_S3 1 100 0 1 BIT_MASK 0x1 DISPLAY_IDENTIFIER f_ID_Speed2HighInPosP.ID_Speed2HighInPosP.CCMsg ECU_ADDRESS 0xFFF8A910 /end MEASUREMENT
/begin MEASUREMENT CCMsg.ID_ParkLockFault.cCC_ID._.MyIdx "Sequential Index of the CC-ID to access tables" UBYTE SBW_STANDARD_S1_S3 1 100 1 255 DISPLAY_IDENTIFIER MyIdx._.cCC_ID.ID_ParkLockFault.CCMsg ECU_ADDRESS 0xFFF8A914 /end MEASUREMENT
/begin MEASUREMENT CCMsg.ID_ParkLockFault.cCC_ID._.f_ID_Locked "Flag: Interlocked by other ID" UBYTE SBW_STANDARD_S1_S3 1 100 0 1 BIT_MASK 0x1 DISPLAY_IDENTIFIER f_ID_Locked._.cCC_ID.ID_ParkLockFault.CCMsg ECU_ADDRESS 0xFFF8A915 /end MEASUREMENT
/begin MEASUREMENT CCMsg.ID_ParkLockFault.cCC_ID._.f_ID_Reset "Flag: Premature Reset" UBYTE SBW_STANDARD_S1_S3 1 100 0 1 BIT_MASK 0x1 DISPLAY_IDENTIFIER f_ID_Reset._.cCC_ID.ID_ParkLockFault.CCMsg ECU_ADDRESS 0xFFF8A916 /end MEASUREMENT
/begin MEASUREMENT CCMsg.ID_ParkLockFault.cCC_ID._.st_ID "State of CC-ID Operating Sequence" UBYTE SBW_STANDARD_S1_S3 1 100 1 255 DISPLAY_IDENTIFIER st_ID._.cCC_ID.ID_ParkLockFault.CCMsg ECU_ADDRESS 0xFFF8A917 /end MEASUREMENT
/begin MEASUREMENT CCMsg.ID_ParkLockFault.cCC_ID._.MsgOnceSent "State of CC-ID Operating Sequence" UBYTE SBW_STANDARD_S1_S3 1 100 0 1 BIT_MASK 0x1 DISPLAY_IDENTIFIER MsgOnceSent._.cCC_ID.ID_ParkLockFault.CCMsg ECU_ADDRESS 0xFFF8A918 /end MEASUREMENT
/begin MEASUREMENT CCMsg.ID_ParkLockFault.f_ID_ParkLockFault "Flag for CC-Msgs" UBYTE SBW_STANDARD_S1_S3 1 100 0 1 BIT_MASK 0x1 DISPLAY_IDENTIFIER f_ID_ParkLockFault.ID_ParkLockFault.CCMsg ECU_ADDRESS 0xFFF8A930 /end MEASUREMENT
/begin MEASUREMENT CCMsg.ID_ParkLockFault_InMechLimp.cCC_ID._.MyIdx "Sequential Index of the CC-ID to access tables" UBYTE SBW_STANDARD_S1_S3 1 100 1 255 DISPLAY_IDENTIFIER MyIdx._.cCC_ID.ID_ParkLockFault_InMechLimp.CCMsg ECU_ADDRESS 0xFFF8A934 /end MEASUREMENT
/begin MEASUREMENT CCMsg.ID_ParkLockFault_InMechLimp.cCC_ID._.f_ID_Locked "Flag: Interlocked by other ID" UBYTE SBW_STANDARD_S1_S3 1 100 0 1 BIT_MASK 0x1 DISPLAY_IDENTIFIER f_ID_Locked._.cCC_ID.ID_ParkLockFault_InMechLimp.CCMsg ECU_ADDRESS 0xFFF8A935 /end MEASUREMENT
/begin MEASUREMENT CCMsg.ID_ParkLockFault_InMechLimp.cCC_ID._.f_ID_Reset "Flag: Premature Reset" UBYTE SBW_STANDARD_S1_S3 1 100 0 1 BIT_MASK 0x1 DISPLAY_IDENTIFIER f_ID_Reset._.cCC_ID.ID_ParkLockFault_InMechLimp.CCMsg ECU_ADDRESS 0xFFF8A936 /end MEASUREMENT
/begin MEASUREMENT CCMsg.ID_ParkLockFault_InMechLimp.cCC_ID._.st_ID "State of CC-ID Operating Sequence" UBYTE SBW_STANDARD_S1_S3 1 100 1 255 DISPLAY_IDENTIFIER st_ID._.cCC_ID.ID_ParkLockFault_InMechLimp.CCMsg ECU_ADDRESS 0xFFF8A937 /end MEASUREMENT
/begin MEASUREMENT CCMsg.ID_ParkLockFault_InMechLimp.cCC_ID._.MsgOnceSent "State of CC-ID Operating Sequence" UBYTE SBW_STANDARD_S1_S3 1 100 0 1 BIT_MASK 0x1 DISPLAY_IDENTIFIER MsgOnceSent._.cCC_ID.ID_ParkLockFault_InMechLimp.CCMsg ECU_ADDRESS 0xFFF8A938 /end MEASUREMENT
/begin MEASUREMENT CCMsg.ID_ParkLockFault_InMechLimp.f_ID_ParkLockFault_InMechLimp "Flag for CC-Msgs" UBYTE SBW_STANDARD_S1_S3 1 100 0 1 BIT_MASK 0x1 DISPLAY_IDENTIFIER f_ID_ParkLockFault_InMechLimp.ID_ParkLockFault_InMechLimp.CCMsg ECU_ADDRESS 0xFFF8A950 /end MEASUREMENT
/begin MEASUREMENT CCMsg.ID_ParkLockFault_IEP_On.cCC_ID._.MyIdx "Sequential Index of the CC-ID to access tables" UBYTE SBW_STANDARD_S1_S3 1 100 1 255 DISPLAY_IDENTIFIER MyIdx._.cCC_ID.ID_ParkLockFault_IEP_On.CCMsg ECU_ADDRESS 0xFFF8A954 /end MEASUREMENT
/begin MEASUREMENT CCMsg.ID_ParkLockFault_IEP_On.cCC_ID._.f_ID_Locked "Flag: Interlocked by other ID" UBYTE SBW_STANDARD_S1_S3 1 100 0 1 BIT_MASK 0x1 DISPLAY_IDENTIFIER f_ID_Locked._.cCC_ID.ID_ParkLockFault_IEP_On.CCMsg ECU_ADDRESS 0xFFF8A955 /end MEASUREMENT
/begin MEASUREMENT CCMsg.ID_ParkLockFault_IEP_On.cCC_ID._.f_ID_Reset "Flag: Premature Reset" UBYTE SBW_STANDARD_S1_S3 1 100 0 1 BIT_MASK 0x1 DISPLAY_IDENTIFIER f_ID_Reset._.cCC_ID.ID_ParkLockFault_IEP_On.CCMsg ECU_ADDRESS 0xFFF8A956 /end MEASUREMENT
/begin MEASUREMENT CCMsg.ID_ParkLockFault_IEP_On.cCC_ID._.st_ID "State of CC-ID Operating Sequence" UBYTE SBW_STANDARD_S1_S3 1 100 1 255 DISPLAY_IDENTIFIER st_ID._.cCC_ID.ID_ParkLockFault_IEP_On.CCMsg ECU_ADDRESS 0xFFF8A957 /end MEASUREMENT
/begin MEASUREMENT CCMsg.ID_ParkLockFault_IEP_On.cCC_ID._.MsgOnceSent "State of CC-ID Operating Sequence" UBYTE SBW_STANDARD_S1_S3 1 100 0 1 BIT_MASK 0x1 DISPLAY_IDENTIFIER MsgOnceSent._.cCC_ID.ID_ParkLockFault_IEP_On.CCMsg ECU_ADDRESS 0xFFF8A958 /end MEASUREMENT
/begin MEASUREMENT CCMsg.ID_ParkLockFault_IEP_On.f_ID_ParkLockFault_IEP_On "Flag for CC-Msgs" UBYTE SBW_STANDARD_S1_S3 1 100 0 1 BIT_MASK 0x1 DISPLAY_IDENTIFIER f_ID_ParkLockFault_IEP_On.ID_ParkLockFault_IEP_On.CCMsg ECU_ADDRESS 0xFFF8A970 /end MEASUREMENT
/begin MEASUREMENT CCMsg.ID_E_GNERActive.cCC_ID._.MyIdx "Sequential Index of the CC-ID to access tables" UBYTE SBW_STANDARD_S1_S3 1 100 1 255 DISPLAY_IDENTIFIER MyIdx._.cCC_ID.ID_E_GNERActive.CCMsg ECU_ADDRESS 0xFFF8A974 /end MEASUREMENT
/begin MEASUREMENT CCMsg.ID_E_GNERActive.cCC_ID._.f_ID_Locked "Flag: Interlocked by other ID" UBYTE SBW_STANDARD_S1_S3 1 100 0 1 BIT_MASK 0x1 DISPLAY_IDENTIFIER f_ID_Locked._.cCC_ID.ID_E_GNERActive.CCMsg ECU_ADDRESS 0xFFF8A975 /end MEASUREMENT
/begin MEASUREMENT CCMsg.ID_E_GNERActive.cCC_ID._.f_ID_Reset "Flag: Premature Reset" UBYTE SBW_STANDARD_S1_S3 1 100 0 1 BIT_MASK 0x1 DISPLAY_IDENTIFIER f_ID_Reset._.cCC_ID.ID_E_GNERActive.CCMsg ECU_ADDRESS 0xFFF8A976 /end MEASUREMENT
/begin MEASUREMENT CCMsg.ID_E_GNERActive.cCC_ID._.st_ID "State of CC-ID Operating Sequence" UBYTE SBW_STANDARD_S1_S3 1 100 1 255 DISPLAY_IDENTIFIER st_ID._.cCC_ID.ID_E_GNERActive.CCMsg ECU_ADDRESS 0xFFF8A977 /end MEASUREMENT
/begin MEASUREMENT CCMsg.ID_E_GNERActive.cCC_ID._.MsgOnceSent "State of CC-ID Operating Sequence" UBYTE SBW_STANDARD_S1_S3 1 100 0 1 BIT_MASK 0x1 DISPLAY_IDENTIFIER MsgOnceSent._.cCC_ID.ID_E_GNERActive.CCMsg ECU_ADDRESS 0xFFF8A978 /end MEASUREMENT
/begin MEASUREMENT CCMsg.ID_E_GNERActive.f_ID_E_GNERActive "Flag for CC-Msgs" UBYTE SBW_STANDARD_S1_S3 1 100 0 1 BIT_MASK 0x1 DISPLAY_IDENTIFIER f_ID_E_GNERActive.ID_E_GNERActive.CCMsg ECU_ADDRESS 0xFFF8A990 /end MEASUREMENT
/begin MEASUREMENT CCMsg.ID_PosN_Warning.cCC_ID._.MyIdx "Sequential Index of the CC-ID to access tables" UBYTE SBW_STANDARD_S1_S3 1 100 1 255 DISPLAY_IDENTIFIER MyIdx._.cCC_ID.ID_PosN_Warning.CCMsg ECU_ADDRESS 0xFFF8A994 /end MEASUREMENT
/begin MEASUREMENT CCMsg.ID_PosN_Warning.cCC_ID._.f_ID_Locked "Flag: Interlocked by other ID" UBYTE SBW_STANDARD_S1_S3 1 100 0 1 BIT_MASK 0x1 DISPLAY_IDENTIFIER f_ID_Locked._.cCC_ID.ID_PosN_Warning.CCMsg ECU_ADDRESS 0xFFF8A995 /end MEASUREMENT
/begin MEASUREMENT CCMsg.ID_PosN_Warning.cCC_ID._.f_ID_Reset "Flag: Premature Reset" UBYTE SBW_STANDARD_S1_S3 1 100 0 1 BIT_MASK 0x1 DISPLAY_IDENTIFIER f_ID_Reset._.cCC_ID.ID_PosN_Warning.CCMsg ECU_ADDRESS 0xFFF8A996 /end MEASUREMENT
/begin MEASUREMENT CCMsg.ID_PosN_Warning.cCC_ID._.st_ID "State of CC-ID Operating Sequence" UBYTE SBW_STANDARD_S1_S3 1 100 1 255 DISPLAY_IDENTIFIER st_ID._.cCC_ID.ID_PosN_Warning.CCMsg ECU_ADDRESS 0xFFF8A997 /end MEASUREMENT
/begin MEASUREMENT CCMsg.ID_PosN_Warning.cCC_ID._.MsgOnceSent "State of CC-ID Operating Sequence" UBYTE SBW_STANDARD_S1_S3 1 100 0 1 BIT_MASK 0x1 DISPLAY_IDENTIFIER MsgOnceSent._.cCC_ID.ID_PosN_Warning.CCMsg ECU_ADDRESS 0xFFF8A998 /end MEASUREMENT
/begin MEASUREMENT CCMsg.ID_PosN_Warning.f_ID_PosN_Warning "Flag for CC-Msgs" UBYTE SBW_STANDARD_S1_S3 1 100 0 1 BIT_MASK 0x1 DISPLAY_IDENTIFIER f_ID_PosN_Warning.ID_PosN_Warning.CCMsg ECU_ADDRESS 0xFFF8A9B0 /end MEASUREMENT
/begin MEASUREMENT CCMsg.ID_ShiftlockBrakeWarning.cCC_ID._.MyIdx "Sequential Index of the CC-ID to access tables" UBYTE SBW_STANDARD_S1_S3 1 100 1 255 DISPLAY_IDENTIFIER MyIdx._.cCC_ID.ID_ShiftlockBrakeWarning.CCMsg ECU_ADDRESS 0xFFF8A9B4 /end MEASUREMENT
/begin MEASUREMENT CCMsg.ID_ShiftlockBrakeWarning.cCC_ID._.f_ID_Locked "Flag: Interlocked by other ID" UBYTE SBW_STANDARD_S1_S3 1 100 0 1 BIT_MASK 0x1 DISPLAY_IDENTIFIER f_ID_Locked._.cCC_ID.ID_ShiftlockBrakeWarning.CCMsg ECU_ADDRESS 0xFFF8A9B5 /end MEASUREMENT
/begin MEASUREMENT CCMsg.ID_ShiftlockBrakeWarning.cCC_ID._.f_ID_Reset "Flag: Premature Reset" UBYTE SBW_STANDARD_S1_S3 1 100 0 1 BIT_MASK 0x1 DISPLAY_IDENTIFIER f_ID_Reset._.cCC_ID.ID_ShiftlockBrakeWarning.CCMsg ECU_ADDRESS 0xFFF8A9B6 /end MEASUREMENT
/begin MEASUREMENT CCMsg.ID_ShiftlockBrakeWarning.cCC_ID._.st_ID "State of CC-ID Operating Sequence" UBYTE SBW_STANDARD_S1_S3 1 100 1 255 DISPLAY_IDENTIFIER st_ID._.cCC_ID.ID_ShiftlockBrakeWarning.CCMsg ECU_ADDRESS 0xFFF8A9B7 /end MEASUREMENT
/begin MEASUREMENT CCMsg.ID_ShiftlockBrakeWarning.cCC_ID._.MsgOnceSent "State of CC-ID Operating Sequence" UBYTE SBW_STANDARD_S1_S3 1 100 0 1 BIT_MASK 0x1 DISPLAY_IDENTIFIER MsgOnceSent._.cCC_ID.ID_ShiftlockBrakeWarning.CCMsg ECU_ADDRESS 0xFFF8A9B8 /end MEASUREMENT
/begin MEASUREMENT CCMsg.ID_ShiftlockBrakeWarning.f_ID_ShiftlockBrakeWarning "Flag for CC-Msgs" UBYTE SBW_STANDARD_S1_S3 1 100 0 1 BIT_MASK 0x1 DISPLAY_IDENTIFIER f_ID_ShiftlockBrakeWarning.ID_ShiftlockBrakeWarning.CCMsg ECU_ADDRESS 0xFFF8A9D0 /end MEASUREMENT
/begin MEASUREMENT CCMsg.ID_ShiftWithoutBrakeWarning.cCC_ID._.MyIdx "Sequential Index of the CC-ID to access tables" UBYTE SBW_STANDARD_S1_S3 1 100 1 255 DISPLAY_IDENTIFIER MyIdx._.cCC_ID.ID_ShiftWithoutBrakeWarning.CCMsg ECU_ADDRESS 0xFFF8A9D4 /end MEASUREMENT
/begin MEASUREMENT CCMsg.ID_ShiftWithoutBrakeWarning.cCC_ID._.f_ID_Locked "Flag: Interlocked by other ID" UBYTE SBW_STANDARD_S1_S3 1 100 0 1 BIT_MASK 0x1 DISPLAY_IDENTIFIER f_ID_Locked._.cCC_ID.ID_ShiftWithoutBrakeWarning.CCMsg ECU_ADDRESS 0xFFF8A9D5 /end MEASUREMENT
/begin MEASUREMENT CCMsg.ID_ShiftWithoutBrakeWarning.cCC_ID._.f_ID_Reset "Flag: Premature Reset" UBYTE SBW_STANDARD_S1_S3 1 100 0 1 BIT_MASK 0x1 DISPLAY_IDENTIFIER f_ID_Reset._.cCC_ID.ID_ShiftWithoutBrakeWarning.CCMsg ECU_ADDRESS 0xFFF8A9D6 /end MEASUREMENT
/begin MEASUREMENT CCMsg.ID_ShiftWithoutBrakeWarning.cCC_ID._.st_ID "State of CC-ID Operating Sequence" UBYTE SBW_STANDARD_S1_S3 1 100 1 255 DISPLAY_IDENTIFIER st_ID._.cCC_ID.ID_ShiftWithoutBrakeWarning.CCMsg ECU_ADDRESS 0xFFF8A9D7 /end MEASUREMENT
/begin MEASUREMENT CCMsg.ID_ShiftWithoutBrakeWarning.cCC_ID._.MsgOnceSent "State of CC-ID Operating Sequence" UBYTE SBW_STANDARD_S1_S3 1 100 0 1 BIT_MASK 0x1 DISPLAY_IDENTIFIER MsgOnceSent._.cCC_ID.ID_ShiftWithoutBrakeWarning.CCMsg ECU_ADDRESS 0xFFF8A9D8 /end MEASUREMENT
/begin MEASUREMENT CCMsg.ID_ShiftWithoutBrakeWarning.f_ID_ShiftWithoutBrakeWarning "Flag for CC-Msgs" UBYTE SBW_STANDARD_S1_S3 1 100 0 1 BIT_MASK 0x1 DISPLAY_IDENTIFIER f_ID_ShiftWithoutBrakeWarning.ID_ShiftWithoutBrakeWarning.CCMsg ECU_ADDRESS 0xFFF8A9F0 /end MEASUREMENT
/begin MEASUREMENT CCMsg.ID_GongWrongDrvDir.cCC_ID._.MyIdx "Sequential Index of the CC-ID to access tables" UBYTE SBW_STANDARD_S1_S3 1 100 1 255 DISPLAY_IDENTIFIER MyIdx._.cCC_ID.ID_GongWrongDrvDir.CCMsg ECU_ADDRESS 0xFFF8A9F4 /end MEASUREMENT
/begin MEASUREMENT CCMsg.ID_GongWrongDrvDir.cCC_ID._.f_ID_Locked "Flag: Interlocked by other ID" UBYTE SBW_STANDARD_S1_S3 1 100 0 1 BIT_MASK 0x1 DISPLAY_IDENTIFIER f_ID_Locked._.cCC_ID.ID_GongWrongDrvDir.CCMsg ECU_ADDRESS 0xFFF8A9F5 /end MEASUREMENT
/begin MEASUREMENT CCMsg.ID_GongWrongDrvDir.cCC_ID._.f_ID_Reset "Flag: Premature Reset" UBYTE SBW_STANDARD_S1_S3 1 100 0 1 BIT_MASK 0x1 DISPLAY_IDENTIFIER f_ID_Reset._.cCC_ID.ID_GongWrongDrvDir.CCMsg ECU_ADDRESS 0xFFF8A9F6 /end MEASUREMENT
/begin MEASUREMENT CCMsg.ID_GongWrongDrvDir.cCC_ID._.st_ID "State of CC-ID Operating Sequence" UBYTE SBW_STANDARD_S1_S3 1 100 1 255 DISPLAY_IDENTIFIER st_ID._.cCC_ID.ID_GongWrongDrvDir.CCMsg ECU_ADDRESS 0xFFF8A9F7 /end MEASUREMENT
/begin MEASUREMENT CCMsg.ID_GongWrongDrvDir.cCC_ID._.MsgOnceSent "State of CC-ID Operating Sequence" UBYTE SBW_STANDARD_S1_S3 1 100 0 1 BIT_MASK 0x1 DISPLAY_IDENTIFIER MsgOnceSent._.cCC_ID.ID_GongWrongDrvDir.CCMsg ECU_ADDRESS 0xFFF8A9F8 /end MEASUREMENT
/begin MEASUREMENT CCMsg.ID_GongWrongDrvDir.f_ID_GongWrongDrvDir "Flag for CC-Msgs" UBYTE SBW_STANDARD_S1_S3 1 100 0 1 BIT_MASK 0x1 DISPLAY_IDENTIFIER f_ID_GongWrongDrvDir.ID_GongWrongDrvDir.CCMsg ECU_ADDRESS 0xFFF8AA10 /end MEASUREMENT
/begin MEASUREMENT CCMsg.ID_GongInMechLimp.cCC_ID._.MyIdx "Sequential Index of the CC-ID to access tables" UBYTE SBW_STANDARD_S1_S3 1 100 1 255 DISPLAY_IDENTIFIER MyIdx._.cCC_ID.ID_GongInMechLimp.CCMsg ECU_ADDRESS 0xFFF8AA14 /end MEASUREMENT
/begin MEASUREMENT CCMsg.ID_GongInMechLimp.cCC_ID._.f_ID_Locked "Flag: Interlocked by other ID" UBYTE SBW_STANDARD_S1_S3 1 100 0 1 BIT_MASK 0x1 DISPLAY_IDENTIFIER f_ID_Locked._.cCC_ID.ID_GongInMechLimp.CCMsg ECU_ADDRESS 0xFFF8AA15 /end MEASUREMENT
/begin MEASUREMENT CCMsg.ID_GongInMechLimp.cCC_ID._.f_ID_Reset "Flag: Premature Reset" UBYTE SBW_STANDARD_S1_S3 1 100 0 1 BIT_MASK 0x1 DISPLAY_IDENTIFIER f_ID_Reset._.cCC_ID.ID_GongInMechLimp.CCMsg ECU_ADDRESS 0xFFF8AA16 /end MEASUREMENT
/begin MEASUREMENT CCMsg.ID_GongInMechLimp.cCC_ID._.st_ID "State of CC-ID Operating Sequence" UBYTE SBW_STANDARD_S1_S3 1 100 1 255 DISPLAY_IDENTIFIER st_ID._.cCC_ID.ID_GongInMechLimp.CCMsg ECU_ADDRESS 0xFFF8AA17 /end MEASUREMENT
/begin MEASUREMENT CCMsg.ID_GongInMechLimp.cCC_ID._.MsgOnceSent "State of CC-ID Operating Sequence" UBYTE SBW_STANDARD_S1_S3 1 100 0 1 BIT_MASK 0x1 DISPLAY_IDENTIFIER MsgOnceSent._.cCC_ID.ID_GongInMechLimp.CCMsg ECU_ADDRESS 0xFFF8AA18 /end MEASUREMENT
/begin MEASUREMENT CCMsg.ID_GongInMechLimp.f_ID_GongInMechLimp "Flag for CC-Msgs" UBYTE SBW_STANDARD_S1_S3 1 100 0 1 BIT_MASK 0x1 DISPLAY_IDENTIFIER f_ID_GongInMechLimp.ID_GongInMechLimp.CCMsg ECU_ADDRESS 0xFFF8AA30 /end MEASUREMENT
/begin MEASUREMENT CCMsg.ID_GongBadOp.cCC_ID._.MyIdx "Sequential Index of the CC-ID to access tables" UBYTE SBW_STANDARD_S1_S3 1 100 1 255 DISPLAY_IDENTIFIER MyIdx._.cCC_ID.ID_GongBadOp.CCMsg ECU_ADDRESS 0xFFF8AA34 /end MEASUREMENT
/begin MEASUREMENT CCMsg.ID_GongBadOp.cCC_ID._.f_ID_Locked "Flag: Interlocked by other ID" UBYTE SBW_STANDARD_S1_S3 1 100 0 1 BIT_MASK 0x1 DISPLAY_IDENTIFIER f_ID_Locked._.cCC_ID.ID_GongBadOp.CCMsg ECU_ADDRESS 0xFFF8AA35 /end MEASUREMENT
/begin MEASUREMENT CCMsg.ID_GongBadOp.cCC_ID._.f_ID_Reset "Flag: Premature Reset" UBYTE SBW_STANDARD_S1_S3 1 100 0 1 BIT_MASK 0x1 DISPLAY_IDENTIFIER f_ID_Reset._.cCC_ID.ID_GongBadOp.CCMsg ECU_ADDRESS 0xFFF8AA36 /end MEASUREMENT
/begin MEASUREMENT CCMsg.ID_GongBadOp.cCC_ID._.st_ID "State of CC-ID Operating Sequence" UBYTE SBW_STANDARD_S1_S3 1 100 1 255 DISPLAY_IDENTIFIER st_ID._.cCC_ID.ID_GongBadOp.CCMsg ECU_ADDRESS 0xFFF8AA37 /end MEASUREMENT
/begin MEASUREMENT CCMsg.ID_GongBadOp.cCC_ID._.MsgOnceSent "State of CC-ID Operating Sequence" UBYTE SBW_STANDARD_S1_S3 1 100 0 1 BIT_MASK 0x1 DISPLAY_IDENTIFIER MsgOnceSent._.cCC_ID.ID_GongBadOp.CCMsg ECU_ADDRESS 0xFFF8AA38 /end MEASUREMENT
/begin MEASUREMENT CCMsg.ID_GongBadOp.f_ID_GongBadOp "Flag for CC-Msgs" UBYTE SBW_STANDARD_S1_S3 1 100 0 1 BIT_MASK 0x1 DISPLAY_IDENTIFIER f_ID_GongBadOp.ID_GongBadOp.CCMsg ECU_ADDRESS 0xFFF8AA50 /end MEASUREMENT
/begin MEASUREMENT CCMsg.ID_Hotmode2.cCC_ID._.MyIdx "Sequential Index of the CC-ID to access tables" UBYTE SBW_STANDARD_S1_S3 1 100 1 255 DISPLAY_IDENTIFIER MyIdx._.cCC_ID.ID_Hotmode2.CCMsg ECU_ADDRESS 0xFFF8AA54 /end MEASUREMENT
/begin MEASUREMENT CCMsg.ID_Hotmode2.cCC_ID._.f_ID_Locked "Flag: Interlocked by other ID" UBYTE SBW_STANDARD_S1_S3 1 100 0 1 BIT_MASK 0x1 DISPLAY_IDENTIFIER f_ID_Locked._.cCC_ID.ID_Hotmode2.CCMsg ECU_ADDRESS 0xFFF8AA55 /end MEASUREMENT
/begin MEASUREMENT CCMsg.ID_Hotmode2.cCC_ID._.f_ID_Reset "Flag: Premature Reset" UBYTE SBW_STANDARD_S1_S3 1 100 0 1 BIT_MASK 0x1 DISPLAY_IDENTIFIER f_ID_Reset._.cCC_ID.ID_Hotmode2.CCMsg ECU_ADDRESS 0xFFF8AA56 /end MEASUREMENT
/begin MEASUREMENT CCMsg.ID_Hotmode2.cCC_ID._.st_ID "State of CC-ID Operating Sequence" UBYTE SBW_STANDARD_S1_S3 1 100 1 255 DISPLAY_IDENTIFIER st_ID._.cCC_ID.ID_Hotmode2.CCMsg ECU_ADDRESS 0xFFF8AA57 /end MEASUREMENT
/begin MEASUREMENT CCMsg.ID_Hotmode2.cCC_ID._.MsgOnceSent "State of CC-ID Operating Sequence" UBYTE SBW_STANDARD_S1_S3 1 100 0 1 BIT_MASK 0x1 DISPLAY_IDENTIFIER MsgOnceSent._.cCC_ID.ID_Hotmode2.CCMsg ECU_ADDRESS 0xFFF8AA58 /end MEASUREMENT
/begin MEASUREMENT CCMsg.ID_Hotmode2.f_ID_Hotmode2 "Flag for CC-Msgs" UBYTE SBW_STANDARD_S1_S3 1 100 0 1 BIT_MASK 0x1 DISPLAY_IDENTIFIER f_ID_Hotmode2.ID_Hotmode2.CCMsg ECU_ADDRESS 0xFFF8AA70 /end MEASUREMENT
/begin MEASUREMENT CCMsg.ID_DrvLeavesCar.cCC_ID._.MyIdx "Sequential Index of the CC-ID to access tables" UBYTE SBW_STANDARD_S1_S3 1 100 1 255 DISPLAY_IDENTIFIER MyIdx._.cCC_ID.ID_DrvLeavesCar.CCMsg ECU_ADDRESS 0xFFF8AA74 /end MEASUREMENT
/begin MEASUREMENT CCMsg.ID_DrvLeavesCar.cCC_ID._.f_ID_Locked "Flag: Interlocked by other ID" UBYTE SBW_STANDARD_S1_S3 1 100 0 1 BIT_MASK 0x1 DISPLAY_IDENTIFIER f_ID_Locked._.cCC_ID.ID_DrvLeavesCar.CCMsg ECU_ADDRESS 0xFFF8AA75 /end MEASUREMENT
/begin MEASUREMENT CCMsg.ID_DrvLeavesCar.cCC_ID._.f_ID_Reset "Flag: Premature Reset" UBYTE SBW_STANDARD_S1_S3 1 100 0 1 BIT_MASK 0x1 DISPLAY_IDENTIFIER f_ID_Reset._.cCC_ID.ID_DrvLeavesCar.CCMsg ECU_ADDRESS 0xFFF8AA76 /end MEASUREMENT
/begin MEASUREMENT CCMsg.ID_DrvLeavesCar.cCC_ID._.st_ID "State of CC-ID Operating Sequence" UBYTE SBW_STANDARD_S1_S3 1 100 1 255 DISPLAY_IDENTIFIER st_ID._.cCC_ID.ID_DrvLeavesCar.CCMsg ECU_ADDRESS 0xFFF8AA77 /end MEASUREMENT
/begin MEASUREMENT CCMsg.ID_DrvLeavesCar.cCC_ID._.MsgOnceSent "State of CC-ID Operating Sequence" UBYTE SBW_STANDARD_S1_S3 1 100 0 1 BIT_MASK 0x1 DISPLAY_IDENTIFIER MsgOnceSent._.cCC_ID.ID_DrvLeavesCar.CCMsg ECU_ADDRESS 0xFFF8AA78 /end MEASUREMENT
/begin MEASUREMENT CCMsg.ID_DrvLeavesCar.f_ID_DrvLeavesCar "Flag for CC-Msgs" UBYTE SBW_STANDARD_S1_S3 1 100 0 1 BIT_MASK 0x1 DISPLAY_IDENTIFIER f_ID_DrvLeavesCar.ID_DrvLeavesCar.CCMsg ECU_ADDRESS 0xFFF8AA90 /end MEASUREMENT
/begin MEASUREMENT CCMsg.ID_DrvLeavesCar.f_PrematureReset "Indicates that premature Reset may be possible" UBYTE SBW_STANDARD_S1_S3 1 100 0 1 BIT_MASK 0x1 DISPLAY_IDENTIFIER f_PrematureReset.ID_DrvLeavesCar.CCMsg ECU_ADDRESS 0xFFF8AA91 /end MEASUREMENT
/begin MEASUREMENT CCMsg.ID_ShifterError.cCC_ID._.MyIdx "Sequential Index of the CC-ID to access tables" UBYTE SBW_STANDARD_S1_S3 1 100 1 255 DISPLAY_IDENTIFIER MyIdx._.cCC_ID.ID_ShifterError.CCMsg ECU_ADDRESS 0xFFF8AA94 /end MEASUREMENT
/begin MEASUREMENT CCMsg.ID_ShifterError.cCC_ID._.f_ID_Locked "Flag: Interlocked by other ID" UBYTE SBW_STANDARD_S1_S3 1 100 0 1 BIT_MASK 0x1 DISPLAY_IDENTIFIER f_ID_Locked._.cCC_ID.ID_ShifterError.CCMsg ECU_ADDRESS 0xFFF8AA95 /end MEASUREMENT
/begin MEASUREMENT CCMsg.ID_ShifterError.cCC_ID._.f_ID_Reset "Flag: Premature Reset" UBYTE SBW_STANDARD_S1_S3 1 100 0 1 BIT_MASK 0x1 DISPLAY_IDENTIFIER f_ID_Reset._.cCC_ID.ID_ShifterError.CCMsg ECU_ADDRESS 0xFFF8AA96 /end MEASUREMENT
/begin MEASUREMENT CCMsg.ID_ShifterError.cCC_ID._.st_ID "State of CC-ID Operating Sequence" UBYTE SBW_STANDARD_S1_S3 1 100 1 255 DISPLAY_IDENTIFIER st_ID._.cCC_ID.ID_ShifterError.CCMsg ECU_ADDRESS 0xFFF8AA97 /end MEASUREMENT
/begin MEASUREMENT CCMsg.ID_ShifterError.cCC_ID._.MsgOnceSent "State of CC-ID Operating Sequence" UBYTE SBW_STANDARD_S1_S3 1 100 0 1 BIT_MASK 0x1 DISPLAY_IDENTIFIER MsgOnceSent._.cCC_ID.ID_ShifterError.CCMsg ECU_ADDRESS 0xFFF8AA98 /end MEASUREMENT
/begin MEASUREMENT CCMsg.ID_ShifterError.f_ID_ShifterError "Flag for CC-Msgs" UBYTE SBW_STANDARD_S1_S3 1 100 0 1 BIT_MASK 0x1 DISPLAY_IDENTIFIER f_ID_ShifterError.ID_ShifterError.CCMsg ECU_ADDRESS 0xFFF8AAB0 /end MEASUREMENT
/begin MEASUREMENT CCMsg.ID_P_ButtonError.cCC_ID._.MyIdx "Sequential Index of the CC-ID to access tables" UBYTE SBW_STANDARD_S1_S3 1 100 1 255 DISPLAY_IDENTIFIER MyIdx._.cCC_ID.ID_P_ButtonError.CCMsg ECU_ADDRESS 0xFFF8AAB4 /end MEASUREMENT
/begin MEASUREMENT CCMsg.ID_P_ButtonError.cCC_ID._.f_ID_Locked "Flag: Interlocked by other ID" UBYTE SBW_STANDARD_S1_S3 1 100 0 1 BIT_MASK 0x1 DISPLAY_IDENTIFIER f_ID_Locked._.cCC_ID.ID_P_ButtonError.CCMsg ECU_ADDRESS 0xFFF8AAB5 /end MEASUREMENT
/begin MEASUREMENT CCMsg.ID_P_ButtonError.cCC_ID._.f_ID_Reset "Flag: Premature Reset" UBYTE SBW_STANDARD_S1_S3 1 100 0 1 BIT_MASK 0x1 DISPLAY_IDENTIFIER f_ID_Reset._.cCC_ID.ID_P_ButtonError.CCMsg ECU_ADDRESS 0xFFF8AAB6 /end MEASUREMENT
/begin MEASUREMENT CCMsg.ID_P_ButtonError.cCC_ID._.st_ID "State of CC-ID Operating Sequence" UBYTE SBW_STANDARD_S1_S3 1 100 1 255 DISPLAY_IDENTIFIER st_ID._.cCC_ID.ID_P_ButtonError.CCMsg ECU_ADDRESS 0xFFF8AAB7 /end MEASUREMENT
/begin MEASUREMENT CCMsg.ID_P_ButtonError.cCC_ID._.MsgOnceSent "State of CC-ID Operating Sequence" UBYTE SBW_STANDARD_S1_S3 1 100 0 1 BIT_MASK 0x1 DISPLAY_IDENTIFIER MsgOnceSent._.cCC_ID.ID_P_ButtonError.CCMsg ECU_ADDRESS 0xFFF8AAB8 /end MEASUREMENT
/begin MEASUREMENT CCMsg.ID_P_ButtonError.f_ID_P_ButtonError "Flag for CC-Msgs" UBYTE SBW_STANDARD_S1_S3 1 100 0 1 BIT_MASK 0x1 DISPLAY_IDENTIFIER f_ID_P_ButtonError.ID_P_ButtonError.CCMsg ECU_ADDRESS 0xFFF8AAD0 /end MEASUREMENT
/begin MEASUREMENT CCMsg.ID_GearboxWarning2.cCC_ID._.MyIdx "Sequential Index of the CC-ID to access tables" UBYTE SBW_STANDARD_S1_S3 1 100 1 255 DISPLAY_IDENTIFIER MyIdx._.cCC_ID.ID_GearboxWarning2.CCMsg ECU_ADDRESS 0xFFF8AAD4 /end MEASUREMENT
/begin MEASUREMENT CCMsg.ID_GearboxWarning2.cCC_ID._.f_ID_Locked "Flag: Interlocked by other ID" UBYTE SBW_STANDARD_S1_S3 1 100 0 1 BIT_MASK 0x1 DISPLAY_IDENTIFIER f_ID_Locked._.cCC_ID.ID_GearboxWarning2.CCMsg ECU_ADDRESS 0xFFF8AAD5 /end MEASUREMENT
/begin MEASUREMENT CCMsg.ID_GearboxWarning2.cCC_ID._.f_ID_Reset "Flag: Premature Reset" UBYTE SBW_STANDARD_S1_S3 1 100 0 1 BIT_MASK 0x1 DISPLAY_IDENTIFIER f_ID_Reset._.cCC_ID.ID_GearboxWarning2.CCMsg ECU_ADDRESS 0xFFF8AAD6 /end MEASUREMENT
/begin MEASUREMENT CCMsg.ID_GearboxWarning2.cCC_ID._.st_ID "State of CC-ID Operating Sequence" UBYTE SBW_STANDARD_S1_S3 1 100 1 255 DISPLAY_IDENTIFIER st_ID._.cCC_ID.ID_GearboxWarning2.CCMsg ECU_ADDRESS 0xFFF8AAD7 /end MEASUREMENT
/begin MEASUREMENT CCMsg.ID_GearboxWarning2.cCC_ID._.MsgOnceSent "State of CC-ID Operating Sequence" UBYTE SBW_STANDARD_S1_S3 1 100 0 1 BIT_MASK 0x1 DISPLAY_IDENTIFIER MsgOnceSent._.cCC_ID.ID_GearboxWarning2.CCMsg ECU_ADDRESS 0xFFF8AAD8 /end MEASUREMENT
/begin MEASUREMENT CCMsg.ID_GearboxWarning2.f_ID_GearboxWarning2 "Flag for CC-Msgs" UBYTE SBW_STANDARD_S1_S3 1 100 0 1 BIT_MASK 0x1 DISPLAY_IDENTIFIER f_ID_GearboxWarning2.ID_GearboxWarning2.CCMsg ECU_ADDRESS 0xFFF8AAF0 /end MEASUREMENT
/begin MEASUREMENT CCMsg.ID_GearboxWarning1.cCC_ID._.MyIdx "Sequential Index of the CC-ID to access tables" UBYTE SBW_STANDARD_S1_S3 1 100 1 255 DISPLAY_IDENTIFIER MyIdx._.cCC_ID.ID_GearboxWarning1.CCMsg ECU_ADDRESS 0xFFF8AAF4 /end MEASUREMENT
/begin MEASUREMENT CCMsg.ID_GearboxWarning1.cCC_ID._.f_ID_Locked "Flag: Interlocked by other ID" UBYTE SBW_STANDARD_S1_S3 1 100 0 1 BIT_MASK 0x1 DISPLAY_IDENTIFIER f_ID_Locked._.cCC_ID.ID_GearboxWarning1.CCMsg ECU_ADDRESS 0xFFF8AAF5 /end MEASUREMENT
/begin MEASUREMENT CCMsg.ID_GearboxWarning1.cCC_ID._.f_ID_Reset "Flag: Premature Reset" UBYTE SBW_STANDARD_S1_S3 1 100 0 1 BIT_MASK 0x1 DISPLAY_IDENTIFIER f_ID_Reset._.cCC_ID.ID_GearboxWarning1.CCMsg ECU_ADDRESS 0xFFF8AAF6 /end MEASUREMENT
/begin MEASUREMENT CCMsg.ID_GearboxWarning1.cCC_ID._.st_ID "State of CC-ID Operating Sequence" UBYTE SBW_STANDARD_S1_S3 1 100 1 255 DISPLAY_IDENTIFIER st_ID._.cCC_ID.ID_GearboxWarning1.CCMsg ECU_ADDRESS 0xFFF8AAF7 /end MEASUREMENT
/begin MEASUREMENT CCMsg.ID_GearboxWarning1.cCC_ID._.MsgOnceSent "State of CC-ID Operating Sequence" UBYTE SBW_STANDARD_S1_S3 1 100 0 1 BIT_MASK 0x1 DISPLAY_IDENTIFIER MsgOnceSent._.cCC_ID.ID_GearboxWarning1.CCMsg ECU_ADDRESS 0xFFF8AAF8 /end MEASUREMENT
/begin MEASUREMENT CCMsg.ID_GearboxWarning1.f_ID_GearboxWarning1 "Flag for CC-Msgs" UBYTE SBW_STANDARD_S1_S3 1 100 0 1 BIT_MASK 0x1 DISPLAY_IDENTIFIER f_ID_GearboxWarning1.ID_GearboxWarning1.CCMsg ECU_ADDRESS 0xFFF8AB10 /end MEASUREMENT
/begin MEASUREMENT CCMsg.ID_PS_Abuse.cCC_ID._.MyIdx "Sequential Index of the CC-ID to access tables" UBYTE SBW_STANDARD_S1_S3 1 100 1 255 DISPLAY_IDENTIFIER MyIdx._.cCC_ID.ID_PS_Abuse.CCMsg ECU_ADDRESS 0xFFF8AB14 /end MEASUREMENT
/begin MEASUREMENT CCMsg.ID_PS_Abuse.cCC_ID._.f_ID_Locked "Flag: Interlocked by other ID" UBYTE SBW_STANDARD_S1_S3 1 100 0 1 BIT_MASK 0x1 DISPLAY_IDENTIFIER f_ID_Locked._.cCC_ID.ID_PS_Abuse.CCMsg ECU_ADDRESS 0xFFF8AB15 /end MEASUREMENT
/begin MEASUREMENT CCMsg.ID_PS_Abuse.cCC_ID._.f_ID_Reset "Flag: Premature Reset" UBYTE SBW_STANDARD_S1_S3 1 100 0 1 BIT_MASK 0x1 DISPLAY_IDENTIFIER f_ID_Reset._.cCC_ID.ID_PS_Abuse.CCMsg ECU_ADDRESS 0xFFF8AB16 /end MEASUREMENT
/begin MEASUREMENT CCMsg.ID_PS_Abuse.cCC_ID._.st_ID "State of CC-ID Operating Sequence" UBYTE SBW_STANDARD_S1_S3 1 100 1 255 DISPLAY_IDENTIFIER st_ID._.cCC_ID.ID_PS_Abuse.CCMsg ECU_ADDRESS 0xFFF8AB17 /end MEASUREMENT
/begin MEASUREMENT CCMsg.ID_PS_Abuse.cCC_ID._.MsgOnceSent "State of CC-ID Operating Sequence" UBYTE SBW_STANDARD_S1_S3 1 100 0 1 BIT_MASK 0x1 DISPLAY_IDENTIFIER MsgOnceSent._.cCC_ID.ID_PS_Abuse.CCMsg ECU_ADDRESS 0xFFF8AB18 /end MEASUREMENT
/begin MEASUREMENT CCMsg.ID_PS_Abuse.f_ID_PS_Abuse "Flag for CC-Msgs" UBYTE SBW_STANDARD_S1_S3 1 100 0 1 BIT_MASK 0x1 DISPLAY_IDENTIFIER f_ID_PS_Abuse.ID_PS_Abuse.CCMsg ECU_ADDRESS 0xFFF8AB30 /end MEASUREMENT
/begin MEASUREMENT CCMsg.ID_V_ImplausibleInPosP.cCC_ID._.MyIdx "Sequential Index of the CC-ID to access tables" UBYTE SBW_STANDARD_S1_S3 1 100 1 255 DISPLAY_IDENTIFIER MyIdx._.cCC_ID.ID_V_ImplausibleInPosP.CCMsg ECU_ADDRESS 0xFFF8AB34 /end MEASUREMENT
/begin MEASUREMENT CCMsg.ID_V_ImplausibleInPosP.cCC_ID._.f_ID_Locked "Flag: Interlocked by other ID" UBYTE SBW_STANDARD_S1_S3 1 100 0 1 BIT_MASK 0x1 DISPLAY_IDENTIFIER f_ID_Locked._.cCC_ID.ID_V_ImplausibleInPosP.CCMsg ECU_ADDRESS 0xFFF8AB35 /end MEASUREMENT
/begin MEASUREMENT CCMsg.ID_V_ImplausibleInPosP.cCC_ID._.f_ID_Reset "Flag: Premature Reset" UBYTE SBW_STANDARD_S1_S3 1 100 0 1 BIT_MASK 0x1 DISPLAY_IDENTIFIER f_ID_Reset._.cCC_ID.ID_V_ImplausibleInPosP.CCMsg ECU_ADDRESS 0xFFF8AB36 /end MEASUREMENT
/begin MEASUREMENT CCMsg.ID_V_ImplausibleInPosP.cCC_ID._.st_ID "State of CC-ID Operating Sequence" UBYTE SBW_STANDARD_S1_S3 1 100 1 255 DISPLAY_IDENTIFIER st_ID._.cCC_ID.ID_V_ImplausibleInPosP.CCMsg ECU_ADDRESS 0xFFF8AB37 /end MEASUREMENT
/begin MEASUREMENT CCMsg.ID_V_ImplausibleInPosP.cCC_ID._.MsgOnceSent "State of CC-ID Operating Sequence" UBYTE SBW_STANDARD_S1_S3 1 100 0 1 BIT_MASK 0x1 DISPLAY_IDENTIFIER MsgOnceSent._.cCC_ID.ID_V_ImplausibleInPosP.CCMsg ECU_ADDRESS 0xFFF8AB38 /end MEASUREMENT
/begin MEASUREMENT CCMsg.ID_V_ImplausibleInPosP.f_ID_V_ImplausibleInPosP "Flag for CC-Msgs" UBYTE SBW_STANDARD_S1_S3 1 100 0 1 BIT_MASK 0x1 DISPLAY_IDENTIFIER f_ID_V_ImplausibleInPosP.ID_V_ImplausibleInPosP.CCMsg ECU_ADDRESS 0xFFF8AB50 /end MEASUREMENT
/begin MEASUREMENT CCMsg.ID_IgnitionError.cCC_ID._.MyIdx "Sequential Index of the CC-ID to access tables" UBYTE SBW_STANDARD_S1_S3 1 100 1 255 DISPLAY_IDENTIFIER MyIdx._.cCC_ID.ID_IgnitionError.CCMsg ECU_ADDRESS 0xFFF8AB54 /end MEASUREMENT
/begin MEASUREMENT CCMsg.ID_IgnitionError.cCC_ID._.f_ID_Locked "Flag: Interlocked by other ID" UBYTE SBW_STANDARD_S1_S3 1 100 0 1 BIT_MASK 0x1 DISPLAY_IDENTIFIER f_ID_Locked._.cCC_ID.ID_IgnitionError.CCMsg ECU_ADDRESS 0xFFF8AB55 /end MEASUREMENT
/begin MEASUREMENT CCMsg.ID_IgnitionError.cCC_ID._.f_ID_Reset "Flag: Premature Reset" UBYTE SBW_STANDARD_S1_S3 1 100 0 1 BIT_MASK 0x1 DISPLAY_IDENTIFIER f_ID_Reset._.cCC_ID.ID_IgnitionError.CCMsg ECU_ADDRESS 0xFFF8AB56 /end MEASUREMENT
/begin MEASUREMENT CCMsg.ID_IgnitionError.cCC_ID._.st_ID "State of CC-ID Operating Sequence" UBYTE SBW_STANDARD_S1_S3 1 100 1 255 DISPLAY_IDENTIFIER st_ID._.cCC_ID.ID_IgnitionError.CCMsg ECU_ADDRESS 0xFFF8AB57 /end MEASUREMENT
/begin MEASUREMENT CCMsg.ID_IgnitionError.cCC_ID._.MsgOnceSent "State of CC-ID Operating Sequence" UBYTE SBW_STANDARD_S1_S3 1 100 0 1 BIT_MASK 0x1 DISPLAY_IDENTIFIER MsgOnceSent._.cCC_ID.ID_IgnitionError.CCMsg ECU_ADDRESS 0xFFF8AB58 /end MEASUREMENT
/begin MEASUREMENT CCMsg.ID_IgnitionError.f_ID_IgnitionError "Flag for CC-Msgs" UBYTE SBW_STANDARD_S1_S3 1 100 0 1 BIT_MASK 0x1 DISPLAY_IDENTIFIER f_ID_IgnitionError.ID_IgnitionError.CCMsg ECU_ADDRESS 0xFFF8AB70 /end MEASUREMENT
/begin MEASUREMENT CCMsg.ID_DrvLeavesCar_BeltLocked.cCC_ID._.MyIdx "Sequential Index of the CC-ID to access tables" UBYTE SBW_STANDARD_S1_S3 1 100 1 255 DISPLAY_IDENTIFIER MyIdx._.cCC_ID.ID_DrvLeavesCar_BeltLocked.CCMsg ECU_ADDRESS 0xFFF8AB74 /end MEASUREMENT
/begin MEASUREMENT CCMsg.ID_DrvLeavesCar_BeltLocked.cCC_ID._.f_ID_Locked "Flag: Interlocked by other ID" UBYTE SBW_STANDARD_S1_S3 1 100 0 1 BIT_MASK 0x1 DISPLAY_IDENTIFIER f_ID_Locked._.cCC_ID.ID_DrvLeavesCar_BeltLocked.CCMsg ECU_ADDRESS 0xFFF8AB75 /end MEASUREMENT
/begin MEASUREMENT CCMsg.ID_DrvLeavesCar_BeltLocked.cCC_ID._.f_ID_Reset "Flag: Premature Reset" UBYTE SBW_STANDARD_S1_S3 1 100 0 1 BIT_MASK 0x1 DISPLAY_IDENTIFIER f_ID_Reset._.cCC_ID.ID_DrvLeavesCar_BeltLocked.CCMsg ECU_ADDRESS 0xFFF8AB76 /end MEASUREMENT
/begin MEASUREMENT CCMsg.ID_DrvLeavesCar_BeltLocked.cCC_ID._.st_ID "State of CC-ID Operating Sequence" UBYTE SBW_STANDARD_S1_S3 1 100 1 255 DISPLAY_IDENTIFIER st_ID._.cCC_ID.ID_DrvLeavesCar_BeltLocked.CCMsg ECU_ADDRESS 0xFFF8AB77 /end MEASUREMENT
/begin MEASUREMENT CCMsg.ID_DrvLeavesCar_BeltLocked.cCC_ID._.MsgOnceSent "State of CC-ID Operating Sequence" UBYTE SBW_STANDARD_S1_S3 1 100 0 1 BIT_MASK 0x1 DISPLAY_IDENTIFIER MsgOnceSent._.cCC_ID.ID_DrvLeavesCar_BeltLocked.CCMsg ECU_ADDRESS 0xFFF8AB78 /end MEASUREMENT
/begin MEASUREMENT CCMsg.ID_DrvLeavesCar_BeltLocked.f_ID_DrvLeavesCar_BeltLocked "Flag for CC-Msgs" UBYTE SBW_STANDARD_S1_S3 1 100 0 1 BIT_MASK 0x1 DISPLAY_IDENTIFIER f_ID_DrvLeavesCar_BeltLocked.ID_DrvLeavesCar_BeltLocked.CCMsg ECU_ADDRESS 0xFFF8AB90 /end MEASUREMENT
/begin MEASUREMENT CCMsg.IDEmpty.cCC_ID._.MyIdx "Sequential Index of the CC-ID to access tables" UBYTE SBW_STANDARD_S1_S3 1 100 1 255 DISPLAY_IDENTIFIER MyIdx._.cCC_ID.IDEmpty.CCMsg ECU_ADDRESS 0xFFF8AB94 /end MEASUREMENT
/begin MEASUREMENT CCMsg.IDEmpty.cCC_ID._.f_ID_Locked "Flag: Interlocked by other ID" UBYTE SBW_STANDARD_S1_S3 1 100 0 1 BIT_MASK 0x1 DISPLAY_IDENTIFIER f_ID_Locked._.cCC_ID.IDEmpty.CCMsg ECU_ADDRESS 0xFFF8AB95 /end MEASUREMENT
/begin MEASUREMENT CCMsg.IDEmpty.cCC_ID._.f_ID_Reset "Flag: Premature Reset" UBYTE SBW_STANDARD_S1_S3 1 100 0 1 BIT_MASK 0x1 DISPLAY_IDENTIFIER f_ID_Reset._.cCC_ID.IDEmpty.CCMsg ECU_ADDRESS 0xFFF8AB96 /end MEASUREMENT
/begin MEASUREMENT CCMsg.IDEmpty.cCC_ID._.st_ID "State of CC-ID Operating Sequence" UBYTE SBW_STANDARD_S1_S3 1 100 1 255 DISPLAY_IDENTIFIER st_ID._.cCC_ID.IDEmpty.CCMsg ECU_ADDRESS 0xFFF8AB97 /end MEASUREMENT
/begin MEASUREMENT CCMsg.IDEmpty.cCC_ID._.MsgOnceSent "State of CC-ID Operating Sequence" UBYTE SBW_STANDARD_S1_S3 1 100 0 1 BIT_MASK 0x1 DISPLAY_IDENTIFIER MsgOnceSent._.cCC_ID.IDEmpty.CCMsg ECU_ADDRESS 0xFFF8AB98 /end MEASUREMENT
/begin MEASUREMENT StarterRelease.st_StarterRelease "state of starter release [0=no eng.start; 1=trnsmsn. in pos N - enable eng.start; 2=trnsmsn. in pos P - enable eng.start; 3=init-val. - signal invalid]" UBYTE SBW_STANDARD_S1_S3 1 100 0 3 DISPLAY_IDENTIFIER st_StarterRelease.StarterRelease ECU_ADDRESS 0xFFF8A2CD /end MEASUREMENT
/begin MEASUREMENT StarterRelease.st_StarterRelease_ "Complement of state of starter release [255=no eng.start; 254=trnsmsn. in pos N - enable eng.start; 253=trnsmsn. in pos P - enable eng.start; 252=init-val. - signal invalid]" UBYTE SBW_STANDARD_S1_S3 1 100 252 255 DISPLAY_IDENTIFIER st_StarterRelease_.StarterRelease ECU_ADDRESS 0xFFF8A2CE /end MEASUREMENT
/begin MEASUREMENT StarterRelease.f_StrtRlsPosPRND "0 = No valid PosPRND to release start / 1 = valid PosPRND to release start" UBYTE SBW_STANDARD_S1_S3 1 100 0 1 BIT_MASK 0x1 DISPLAY_IDENTIFIER f_StrtRlsPosPRND.StarterRelease ECU_ADDRESS 0xFFF8A2CF /end MEASUREMENT
/begin MEASUREMENT StarterRelease.StrtRlsPosPRND "0 = No valid PosPRND to release start / 1 = valid PosPRND to release start" UBYTE SBW_STANDARD_S1_S3 1 100 0 1 DISPLAY_IDENTIFIER StrtRlsPosPRND.StarterRelease ECU_ADDRESS 0xFFF8A2D0 /end MEASUREMENT
/begin MEASUREMENT StarterRelease.f_StrtRlsShifterPos "0 = No valid Shifter Position to release start / 1 = valid Shifter Position to release start" UBYTE SBW_STANDARD_S1_S3 1 100 0 1 BIT_MASK 0x1 DISPLAY_IDENTIFIER f_StrtRlsShifterPos.StarterRelease ECU_ADDRESS 0xFFF8A2D1 /end MEASUREMENT
/begin MEASUREMENT StarterRelease.StrtRlsShifterPos "0 = No valid Shifter Position to release start / 1 = valid Shifter Position to release start" UBYTE SBW_STANDARD_S1_S3 1 100 0 1 DISPLAY_IDENTIFIER StrtRlsShifterPos.StarterRelease ECU_ADDRESS 0xFFF8A2D2 /end MEASUREMENT
/begin MEASUREMENT StarterRelease.f_StrtRlsDisplayPos "0 = No valid DisplayPos to release start / 1 = valid DisplayPos to release start" UBYTE SBW_STANDARD_S1_S3 1 100 0 1 BIT_MASK 0x1 DISPLAY_IDENTIFIER f_StrtRlsDisplayPos.StarterRelease ECU_ADDRESS 0xFFF8A2D3 /end MEASUREMENT
/begin MEASUREMENT StarterRelease.StrtRlsDisplayPos "0 = No valid DisplayPos to release start / 1 = valid DisplayPos to release start" UBYTE SBW_STANDARD_S1_S3 1 100 0 1 DISPLAY_IDENTIFIER StrtRlsDisplayPos.StarterRelease ECU_ADDRESS 0xFFF8A2D4 /end MEASUREMENT
/begin MEASUREMENT StarterRelease.f_StrtRlsPowerDown "0 = No valid PowerDown state to release start / 1 = valid PowerDown state to release start" UBYTE SBW_STANDARD_S1_S3 1 100 0 1 BIT_MASK 0x1 DISPLAY_IDENTIFIER f_StrtRlsPowerDown.StarterRelease ECU_ADDRESS 0xFFF8A2D5 /end MEASUREMENT
/begin MEASUREMENT StarterRelease.StrtRlsPowerDown "0 = No valid PowerDown state to release start / 1 = valid PowerDown state to release start" UBYTE SBW_STANDARD_S1_S3 1 100 0 1 DISPLAY_IDENTIFIER StrtRlsPowerDown.StarterRelease ECU_ADDRESS 0xFFF8A2D6 /end MEASUREMENT
/begin MEASUREMENT StarterRelease.f_StrtRlsEngine "0 = No valid Engine state to release start / 1 = valid Engine state to release start" UBYTE SBW_STANDARD_S1_S3 1 100 0 1 BIT_MASK 0x1 DISPLAY_IDENTIFIER f_StrtRlsEngine.StarterRelease ECU_ADDRESS 0xFFF8A2D7 /end MEASUREMENT
/begin MEASUREMENT StarterRelease.StrtRlsEngine "0 = No valid Engine state to release start / 1 = valid Engine state to release start" UBYTE SBW_STANDARD_S1_S3 1 100 0 1 DISPLAY_IDENTIFIER StrtRlsEngine.StarterRelease ECU_ADDRESS 0xFFF8A2D8 /end MEASUREMENT
/begin MEASUREMENT StarterRelease.f_StrtRlsIgnition "0 = No valid Ignition state to release start / 1 = valid Ignition state to release start" UBYTE SBW_STANDARD_S1_S3 1 100 0 1 BIT_MASK 0x1 DISPLAY_IDENTIFIER f_StrtRlsIgnition.StarterRelease ECU_ADDRESS 0xFFF8A2D9 /end MEASUREMENT
/begin MEASUREMENT StarterRelease.StrtRlsIgnition "0 = No valid Ignition state to release start / 1 = valid Ignition state to release start" UBYTE SBW_STANDARD_S1_S3 1 100 0 1 DISPLAY_IDENTIFIER StrtRlsIgnition.StarterRelease ECU_ADDRESS 0xFFF8A2DA /end MEASUREMENT
/begin MEASUREMENT StarterRelease.f_StrtRlsBrake "0 = No valid Brake to release start / 1 = valid Brake to release start" UBYTE SBW_STANDARD_S1_S3 1 100 0 1 BIT_MASK 0x1 DISPLAY_IDENTIFIER f_StrtRlsBrake.StarterRelease ECU_ADDRESS 0xFFF8A2DB /end MEASUREMENT
/begin MEASUREMENT StarterRelease.StrtRlsBrake "0 = No valid Brake to release start / 1 = valid Brake to release start" UBYTE SBW_STANDARD_S1_S3 1 100 0 1 DISPLAY_IDENTIFIER StrtRlsBrake.StarterRelease ECU_ADDRESS 0xFFF8A2DC /end MEASUREMENT
/begin MEASUREMENT StarterRelease.f_StrtRlsParklockState "0 = No valid ParklockState to release start / 1 = valid ParklockState to release start" UBYTE SBW_STANDARD_S1_S3 1 100 0 1 BIT_MASK 0x1 DISPLAY_IDENTIFIER f_StrtRlsParklockState.StarterRelease ECU_ADDRESS 0xFFF8A2DD /end MEASUREMENT
/begin MEASUREMENT StarterRelease.StrtRlsParklockState "0 = No valid ParklockState to release start / 1 = valid ParklockState to release start" UBYTE SBW_STANDARD_S1_S3 1 100 0 1 DISPLAY_IDENTIFIER StrtRlsParklockState.StarterRelease ECU_ADDRESS 0xFFF8A2DE /end MEASUREMENT
/begin MEASUREMENT StarterRelease.f_StrtRlsDelayTmr "0 = No valid Delay Timer to release start / 1 = valid Delay Timer to release start" UBYTE SBW_STANDARD_S1_S3 1 100 0 1 BIT_MASK 0x1 DISPLAY_IDENTIFIER f_StrtRlsDelayTmr.StarterRelease ECU_ADDRESS 0xFFF8A2DF /end MEASUREMENT
/begin MEASUREMENT StarterRelease.StrtRlsDelayTmr "0 = No valid Delay Timer to release start / 1 = valid Delay Timer to release start" UBYTE SBW_STANDARD_S1_S3 1 100 0 1 DISPLAY_IDENTIFIER StrtRlsDelayTmr.StarterRelease ECU_ADDRESS 0xFFF8A2E0 /end MEASUREMENT
/begin MEASUREMENT StarterRelease.f_StrtRlsGbxFault "0 = No valid GbxFault to release start / 1 = valid GbxFault to release start" UBYTE SBW_STANDARD_S1_S3 1 100 0 1 BIT_MASK 0x1 DISPLAY_IDENTIFIER f_StrtRlsGbxFault.StarterRelease ECU_ADDRESS 0xFFF8A2E1 /end MEASUREMENT
/begin MEASUREMENT StarterRelease.StrtRlsGbxFault "0 = No valid GbxFault to release start / 1 = valid GbxFault to release start" UBYTE SBW_STANDARD_S1_S3 1 100 0 1 DISPLAY_IDENTIFIER StrtRlsGbxFault.StarterRelease ECU_ADDRESS 0xFFF8A2E2 /end MEASUREMENT
/begin MEASUREMENT StarterRelease.st_Index_Tab_StrtRls "calculated Index of calibration tables Tab_StrtRlsxxxx" UBYTE SBW_STANDARD_S1_S3 1 100 0 7 DISPLAY_IDENTIFIER st_Index_Tab_StrtRls.StarterRelease ECU_ADDRESS 0xFFF8A2E3 /end MEASUREMENT
/begin MEASUREMENT StarterReleaseBPRam.f_DelayCrankInMechLimpBPRam "buffered flag f_DelayCrankInMechLimpBPRam" UBYTE SBW_STANDARD_S1_S3 1 100 0 255 DISPLAY_IDENTIFIER f_DelayCrankInMechLimpBPRam.StarterReleaseBPRam ECU_ADDRESS 0xFFF83B4C /end MEASUREMENT
/begin MEASUREMENT StarterReleaseBPRam.f_DelayCrankInMechLimpBPRam_ "Complement of buffered flag f_DelayCrankInMechLimpBPRam" UBYTE SBW_STANDARD_S1_S3 1 100 0 255 DISPLAY_IDENTIFIER f_DelayCrankInMechLimpBPRam_.StarterReleaseBPRam ECU_ADDRESS 0xFFF83B4D /end MEASUREMENT
/begin MEASUREMENT StatisticCounter.cnt_SportLevel "current sport level" UBYTE SBW_STANDARD_S1_S3 1 100 0 255 DISPLAY_IDENTIFIER cnt_SportLevel.StatisticCounter ECU_ADDRESS 0xFFF8ABB0 /end MEASUREMENT
/begin MEASUREMENT StatisticCounter.cnt_AdaptiveMode "counter to ensure that eeprom counter for adaptive mode is icreased every second" UBYTE SBW_STANDARD_S1_S3 1 100 0 255 DISPLAY_IDENTIFIER cnt_AdaptiveMode.StatisticCounter ECU_ADDRESS 0xFFF8ABB1 /end MEASUREMENT
/begin MEASUREMENT StatisticCounter.cnt_SportMode "counter to ensure that eeprom counter for sport mode is icreased every second" UBYTE SBW_STANDARD_S1_S3 1 100 0 255 DISPLAY_IDENTIFIER cnt_SportMode.StatisticCounter ECU_ADDRESS 0xFFF8ABB2 /end MEASUREMENT
/begin MEASUREMENT StatisticCounter.cnt_ManualMode "counter to ensure that eeprom counter for manual mode is icreased every second" UBYTE SBW_STANDARD_S1_S3 1 100 0 255 DISPLAY_IDENTIFIER cnt_ManualMode.StatisticCounter ECU_ADDRESS 0xFFF8ABB3 /end MEASUREMENT
/begin MEASUREMENT Level2Signals.L2_PosPRND_Old.Value "remind old position for triggered Position" UBYTE SBW_STANDARD_S1_S3 1 100 0 7 DISPLAY_IDENTIFIER Value.L2_PosPRND_Old.Level2Signals ECU_ADDRESS 0xFFF9992C /end MEASUREMENT
/begin MEASUREMENT Level2Signals.L2_PosPRND_Old.Complement "remind old position for triggered Position" UBYTE SBW_STANDARD_S1_S3 1 100 0 7 DISPLAY_IDENTIFIER Complement.L2_PosPRND_Old.Level2Signals ECU_ADDRESS 0xFFF9992D /end MEASUREMENT
/begin MEASUREMENT Level2Signals.L2_PosPRND_PreviousOld.Value "remind previos old position for functions that use old values in level1" UBYTE SBW_STANDARD_S1_S3 1 100 0 7 DISPLAY_IDENTIFIER Value.L2_PosPRND_PreviousOld.Level2Signals ECU_ADDRESS 0xFFF9992E /end MEASUREMENT
/begin MEASUREMENT Level2Signals.L2_PosPRND_PreviousOld.Complement "remind previos old position for functions that use old values in level1" UBYTE SBW_STANDARD_S1_S3 1 100 0 7 DISPLAY_IDENTIFIER Complement.L2_PosPRND_PreviousOld.Level2Signals ECU_ADDRESS 0xFFF9992F /end MEASUREMENT
/begin MEASUREMENT Level2Signals.L2_PosPRND_Trig.Value "triggered Position Level2" UBYTE SBW_STANDARD_S1_S3 1 100 0 8 DISPLAY_IDENTIFIER Value.L2_PosPRND_Trig.Level2Signals ECU_ADDRESS 0xFFF99930 /end MEASUREMENT
/begin MEASUREMENT Level2Signals.L2_PosPRND_Trig.Complement "triggered Position Level2" UBYTE SBW_STANDARD_S1_S3 1 100 0 8 DISPLAY_IDENTIFIER Complement.L2_PosPRND_Trig.Level2Signals ECU_ADDRESS 0xFFF99931 /end MEASUREMENT
/begin MEASUREMENT L2_EngineSignals.L2_st_EngOn.Value "status engine on for SBW [shift by wire] 0=off 1=on 2=standby 3=starter running for Level2" UBYTE SBW_STANDARD_S1_S3 1 100 0 3 DISPLAY_IDENTIFIER Value.L2_st_EngOn.L2_EngineSignals ECU_ADDRESS 0xFFF9993A /end MEASUREMENT
/begin MEASUREMENT L2_EngineSignals.L2_st_EngOn.Complement "status engine on for SBW [shift by wire] 0=off 1=on 2=standby 3=starter running for Level2" UBYTE SBW_STANDARD_S1_S3 1 100 0 3 DISPLAY_IDENTIFIER Complement.L2_st_EngOn.L2_EngineSignals ECU_ADDRESS 0xFFF9993B /end MEASUREMENT
/begin MEASUREMENT L2_EngineSignals.L2_st_EngOnOld.Value "previous status engine on for SBW [shift by wire] 0=off 1=on 2=standby 3=starter running for Level2" UBYTE SBW_STANDARD_S1_S3 1 100 0 3 DISPLAY_IDENTIFIER Value.L2_st_EngOnOld.L2_EngineSignals ECU_ADDRESS 0xFFF9993C /end MEASUREMENT
/begin MEASUREMENT L2_EngineSignals.L2_st_EngOnOld.Complement "previous status engine on for SBW [shift by wire] 0=off 1=on 2=standby 3=starter running for Level2" UBYTE SBW_STANDARD_S1_S3 1 100 0 3 DISPLAY_IDENTIFIER Complement.L2_st_EngOnOld.L2_EngineSignals ECU_ADDRESS 0xFFF9993D /end MEASUREMENT
/begin MEASUREMENT L2_EngineSignals.L2_f_Starter_IEP.Value "state starter IEP on/off for Level2" UBYTE SBW_STANDARD_S1_S3 1 100 0 1 BIT_MASK 0x1 DISPLAY_IDENTIFIER Value.L2_f_Starter_IEP.L2_EngineSignals ECU_ADDRESS 0xFFF9993E /end MEASUREMENT
/begin MEASUREMENT L2_EngineSignals.L2_f_Starter_IEP.Complement "state starter IEP on/off for Level2" UBYTE SBW_STANDARD_S1_S3 1 100 0 1 BIT_MASK 0x1 DISPLAY_IDENTIFIER Complement.L2_f_Starter_IEP.L2_EngineSignals ECU_ADDRESS 0xFFF9993F /end MEASUREMENT
/begin MEASUREMENT L2_EngineSignals.L2_f_EngOn.Value "flag engine on for SBW [shift by wire] for Level2" UBYTE SBW_STANDARD_S1_S3 1 100 0 1 BIT_MASK 0x1 DISPLAY_IDENTIFIER Value.L2_f_EngOn.L2_EngineSignals ECU_ADDRESS 0xFFF99940 /end MEASUREMENT
/begin MEASUREMENT L2_EngineSignals.L2_f_EngOn.Complement "flag engine on for SBW [shift by wire] for Level2" UBYTE SBW_STANDARD_S1_S3 1 100 0 1 BIT_MASK 0x1 DISPLAY_IDENTIFIER Complement.L2_f_EngOn.L2_EngineSignals ECU_ADDRESS 0xFFF99941 /end MEASUREMENT
/begin MEASUREMENT L2_EngineSignals.L2_f_GearboxReady_Old.Value "gearbox ready for Level2 from last cycle 0=off 1=on" UBYTE SBW_STANDARD_S1_S3 1 100 0 1 BIT_MASK 0x1 DISPLAY_IDENTIFIER Value.L2_f_GearboxReady_Old.L2_EngineSignals ECU_ADDRESS 0xFFF99942 /end MEASUREMENT
/begin MEASUREMENT L2_EngineSignals.L2_f_GearboxReady_Old.Complement "gearbox ready for Level2 from last cycle 0=off 1=on" UBYTE SBW_STANDARD_S1_S3 1 100 0 1 BIT_MASK 0x1 DISPLAY_IDENTIFIER Complement.L2_f_GearboxReady_Old.L2_EngineSignals ECU_ADDRESS 0xFFF99943 /end MEASUREMENT
/begin MEASUREMENT L2_EngineSignals.L2_f_GearboxReadySts_Old.Value "gearbox status ready for Level2 from last cycle 0=off 1=on" UBYTE SBW_STANDARD_S1_S3 1 100 0 1 BIT_MASK 0x1 DISPLAY_IDENTIFIER Value.L2_f_GearboxReadySts_Old.L2_EngineSignals ECU_ADDRESS 0xFFF99944 /end MEASUREMENT
/begin MEASUREMENT L2_EngineSignals.L2_f_GearboxReadySts_Old.Complement "gearbox status ready for Level2 from last cycle 0=off 1=on" UBYTE SBW_STANDARD_S1_S3 1 100 0 1 BIT_MASK 0x1 DISPLAY_IDENTIFIER Complement.L2_f_GearboxReadySts_Old.L2_EngineSignals ECU_ADDRESS 0xFFF99945 /end MEASUREMENT
/begin MEASUREMENT L2_EngineSignals.L2_f_GearboxDrvRdy.Value "flag signalling gearbox readiness for Level2 from last cycle 0=off 1=on" UBYTE SBW_STANDARD_S1_S3 1 100 0 1 BIT_MASK 0x1 DISPLAY_IDENTIFIER Value.L2_f_GearboxDrvRdy.L2_EngineSignals ECU_ADDRESS 0xFFF99946 /end MEASUREMENT
/begin MEASUREMENT L2_EngineSignals.L2_f_GearboxDrvRdy.Complement "flag signalling gearbox readiness for Level2 from last cycle 0=off 1=on" UBYTE SBW_STANDARD_S1_S3 1 100 0 1 BIT_MASK 0x1 DISPLAY_IDENTIFIER Complement.L2_f_GearboxDrvRdy.L2_EngineSignals ECU_ADDRESS 0xFFF99947 /end MEASUREMENT
/begin MEASUREMENT L2_GlobalSignals.L2_f_IgnOn.Value "Ignition flag for Level2" UBYTE SBW_STANDARD_S1_S3 1 100 0 1 BIT_MASK 0x1 DISPLAY_IDENTIFIER Value.L2_f_IgnOn.L2_GlobalSignals ECU_ADDRESS 0xFFF984FC /end MEASUREMENT
/begin MEASUREMENT L2_GlobalSignals.L2_f_IgnOn.Complement "Ignition flag for Level2" UBYTE SBW_STANDARD_S1_S3 1 100 0 1 BIT_MASK 0x1 DISPLAY_IDENTIFIER Complement.L2_f_IgnOn.L2_GlobalSignals ECU_ADDRESS 0xFFF984FD /end MEASUREMENT
/begin MEASUREMENT L2_GlobalSignals.L2_IgnOnSts.Value "Ignition status for Level2" UBYTE SBW_STANDARD_S1_S3 1 100 0 2 DISPLAY_IDENTIFIER Value.L2_IgnOnSts.L2_GlobalSignals ECU_ADDRESS 0xFFF984FE /end MEASUREMENT
/begin MEASUREMENT L2_GlobalSignals.L2_IgnOnSts.Complement "Ignition status for Level2" UBYTE SBW_STANDARD_S1_S3 1 100 0 2 DISPLAY_IDENTIFIER Complement.L2_IgnOnSts.L2_GlobalSignals ECU_ADDRESS 0xFFF984FF /end MEASUREMENT
/begin MEASUREMENT L2_GlobalSignals.L2_f_ResyncNeeded.Value "Flag for accepting first driver request RND principially after engine on for Level2" UBYTE SBW_STANDARD_S1_S3 1 100 0 1 BIT_MASK 0x1 DISPLAY_IDENTIFIER Value.L2_f_ResyncNeeded.L2_GlobalSignals ECU_ADDRESS 0xFFF98500 /end MEASUREMENT
/begin MEASUREMENT L2_GlobalSignals.L2_f_ResyncNeeded.Complement "Flag for accepting first driver request RND principially after engine on for Level2" UBYTE SBW_STANDARD_S1_S3 1 100 0 1 BIT_MASK 0x1 DISPLAY_IDENTIFIER Complement.L2_f_ResyncNeeded.L2_GlobalSignals ECU_ADDRESS 0xFFF98501 /end MEASUREMENT
/begin MEASUREMENT L2_GlobalSignals.L2_v_VehSpdMin.Value "vehicle speed [minimal selection Level2]" UWORD SBW_VKMH_16_S1_S3 1 100 0 21.875 DISPLAY_IDENTIFIER Value.L2_v_VehSpdMin.L2_GlobalSignals ECU_ADDRESS 0xFFF98502 /end MEASUREMENT
/begin MEASUREMENT L2_GlobalSignals.L2_v_VehSpdMin.Complement "vehicle speed [minimal selection Level2]" UWORD SBW_STANDARD_S1_S3 1 100 0 350 DISPLAY_IDENTIFIER Complement.L2_v_VehSpdMin.L2_GlobalSignals ECU_ADDRESS 0xFFF98504 /end MEASUREMENT
/begin MEASUREMENT L2_GlobalSignals.L2_f_MechLimp.Value "Mech. limphome flag for Level2" UBYTE SBW_STANDARD_S1_S3 1 100 0 1 BIT_MASK 0x1 DISPLAY_IDENTIFIER Value.L2_f_MechLimp.L2_GlobalSignals ECU_ADDRESS 0xFFF98506 /end MEASUREMENT
/begin MEASUREMENT L2_GlobalSignals.L2_f_MechLimp.Complement "Mech. limphome flag for Level2" UBYTE SBW_STANDARD_S1_S3 1 100 0 1 BIT_MASK 0x1 DISPLAY_IDENTIFIER Complement.L2_f_MechLimp.L2_GlobalSignals ECU_ADDRESS 0xFFF98507 /end MEASUREMENT
/begin MEASUREMENT L2_GlobalSignals.L2_f_BrakePedalSL.Value "if lever is moved in opposite direction lever movements are ignored until NA" UBYTE SBW_STANDARD_S1_S3 1 100 0 1 BIT_MASK 0x1 DISPLAY_IDENTIFIER Value.L2_f_BrakePedalSL.L2_GlobalSignals ECU_ADDRESS 0xFFF98508 /end MEASUREMENT
/begin MEASUREMENT L2_GlobalSignals.L2_f_BrakePedalSL.Complement "if lever is moved in opposite direction lever movements are ignored until NA" UBYTE SBW_STANDARD_S1_S3 1 100 0 1 BIT_MASK 0x1 DISPLAY_IDENTIFIER Complement.L2_f_BrakePedalSL.L2_GlobalSignals ECU_ADDRESS 0xFFF98509 /end MEASUREMENT
/begin MEASUREMENT L2_GlobalSignals.L2_f_ParkLock.Value "flag parking lock for Level2" UBYTE SBW_STANDARD_S1_S3 1 100 0 1 BIT_MASK 0x1 DISPLAY_IDENTIFIER Value.L2_f_ParkLock.L2_GlobalSignals ECU_ADDRESS 0xFFF9850A /end MEASUREMENT
/begin MEASUREMENT L2_GlobalSignals.L2_f_ParkLock.Complement "flag parking lock for Level2" UBYTE SBW_STANDARD_S1_S3 1 100 0 1 BIT_MASK 0x1 DISPLAY_IDENTIFIER Complement.L2_f_ParkLock.L2_GlobalSignals ECU_ADDRESS 0xFFF9850B /end MEASUREMENT
/begin MEASUREMENT L2_GlobalSignals.L2_st_ModeDrvAssistTrans_PosChDep.Value "level 2 status - DAS pos-change dependent - for EGS-FAS-/DAS-mode [0:off 2:rejected 1: permitted/activated]" UBYTE SBW_STANDARD_S1_S3 1 100 0 2 DISPLAY_IDENTIFIER Value.L2_st_ModeDrvAssistTrans_PosChDep.L2_GlobalSignals ECU_ADDRESS 0xFFF9850C /end MEASUREMENT
/begin MEASUREMENT L2_GlobalSignals.L2_st_ModeDrvAssistTrans_PosChDep.Complement "level 2 status - DAS pos-change dependent - for EGS-FAS-/DAS-mode [0:off 2:rejected 1: permitted/activated]" UBYTE SBW_STANDARD_S1_S3 1 100 0 2 DISPLAY_IDENTIFIER Complement.L2_st_ModeDrvAssistTrans_PosChDep.L2_GlobalSignals ECU_ADDRESS 0xFFF9850D /end MEASUREMENT
/begin MEASUREMENT L2_GlobalSignals.L2_st_E_GNER.Value "state E-GNER for Level2" UBYTE SBW_STANDARD_S1_S3 1 100 0 2 DISPLAY_IDENTIFIER Value.L2_st_E_GNER.L2_GlobalSignals ECU_ADDRESS 0xFFF9850E /end MEASUREMENT
/begin MEASUREMENT L2_GlobalSignals.L2_st_E_GNER.Complement "state E-GNER for Level2" UBYTE SBW_STANDARD_S1_S3 1 100 0 2 DISPLAY_IDENTIFIER Complement.L2_st_E_GNER.L2_GlobalSignals ECU_ADDRESS 0xFFF9850F /end MEASUREMENT
/begin MEASUREMENT L2_GlobalSignals.L2_st_E_GNEROld.Value "state E-GNER old cycle for Level2" UBYTE SBW_STANDARD_S1_S3 1 100 0 2 DISPLAY_IDENTIFIER Value.L2_st_E_GNEROld.L2_GlobalSignals ECU_ADDRESS 0xFFF98510 /end MEASUREMENT
/begin MEASUREMENT L2_GlobalSignals.L2_st_E_GNEROld.Complement "state E-GNER old cycle for Level2" UBYTE SBW_STANDARD_S1_S3 1 100 0 2 DISPLAY_IDENTIFIER Complement.L2_st_E_GNEROld.L2_GlobalSignals ECU_ADDRESS 0xFFF98511 /end MEASUREMENT
/begin MEASUREMENT L2_GlobalSignals.L2_f_LeverInValidPos.Value "Indicates valid position for L2_f_ResyncNeeded" UBYTE SBW_STANDARD_S1_S3 1 100 0 1 BIT_MASK 0x1 DISPLAY_IDENTIFIER Value.L2_f_LeverInValidPos.L2_GlobalSignals ECU_ADDRESS 0xFFF98512 /end MEASUREMENT
/begin MEASUREMENT L2_GlobalSignals.L2_f_LeverInValidPos.Complement "Indicates valid position for L2_f_ResyncNeeded" UBYTE SBW_STANDARD_S1_S3 1 100 0 1 BIT_MASK 0x1 DISPLAY_IDENTIFIER Complement.L2_f_LeverInValidPos.L2_GlobalSignals ECU_ADDRESS 0xFFF98513 /end MEASUREMENT
/begin MEASUREMENT L2_GlobalSignals.L2_f_CtrlSignalSourceSts_Err.Value "Indicates valid position for L2_f_ResyncNeeded" UBYTE SBW_STANDARD_S1_S3 1 100 0 1 BIT_MASK 0x1 DISPLAY_IDENTIFIER Value.L2_f_CtrlSignalSourceSts_Err.L2_GlobalSignals ECU_ADDRESS 0xFFF98514 /end MEASUREMENT
/begin MEASUREMENT L2_GlobalSignals.L2_f_CtrlSignalSourceSts_Err.Complement "Indicates valid position for L2_f_ResyncNeeded" UBYTE SBW_STANDARD_S1_S3 1 100 0 1 BIT_MASK 0x1 DISPLAY_IDENTIFIER Complement.L2_f_CtrlSignalSourceSts_Err.L2_GlobalSignals ECU_ADDRESS 0xFFF98515 /end MEASUREMENT
/begin MEASUREMENT L2_GlobalSignals.L2_PosDrvAssistRawOld.Value "mem. value of L2_PosDrvAssistRaw for next cycle" UBYTE SBW_STANDARD_S1_S3 1 100 0 8 DISPLAY_IDENTIFIER Value.L2_PosDrvAssistRawOld.L2_GlobalSignals ECU_ADDRESS 0xFFF98516 /end MEASUREMENT
/begin MEASUREMENT L2_GlobalSignals.L2_PosDrvAssistRawOld.Complement "mem. value of L2_PosDrvAssistRaw for next cycle" UBYTE SBW_STANDARD_S1_S3 1 100 0 8 DISPLAY_IDENTIFIER Complement.L2_PosDrvAssistRawOld.L2_GlobalSignals ECU_ADDRESS 0xFFF98517 /end MEASUREMENT
/begin MEASUREMENT L2_DrvLeavesCar.L2_f_DrvLeavesCarDoorSeatb.Value "Flag for combined Door Seatbelt status" UBYTE SBW_STANDARD_S1_S3 1 100 0 1 BIT_MASK 0x1 DISPLAY_IDENTIFIER Value.L2_f_DrvLeavesCarDoorSeatb.L2_DrvLeavesCar ECU_ADDRESS 0xFFF99948 /end MEASUREMENT
/begin MEASUREMENT L2_DrvLeavesCar.L2_f_DrvLeavesCarDoorSeatb.Complement "Flag for combined Door Seatbelt status" UBYTE SBW_STANDARD_S1_S3 1 100 0 1 BIT_MASK 0x1 DISPLAY_IDENTIFIER Complement.L2_f_DrvLeavesCarDoorSeatb.L2_DrvLeavesCar ECU_ADDRESS 0xFFF99949 /end MEASUREMENT
/begin MEASUREMENT L2_DrvLeavesCar.L2_f_DrvLeavesCarBrakeAccPed.Value "Flag for combined Door Seatbelt status" UBYTE SBW_STANDARD_S1_S3 1 100 0 1 BIT_MASK 0x1 DISPLAY_IDENTIFIER Value.L2_f_DrvLeavesCarBrakeAccPed.L2_DrvLeavesCar ECU_ADDRESS 0xFFF9994A /end MEASUREMENT
/begin MEASUREMENT L2_DrvLeavesCar.L2_f_DrvLeavesCarBrakeAccPed.Complement "Flag for combined Door Seatbelt status" UBYTE SBW_STANDARD_S1_S3 1 100 0 1 BIT_MASK 0x1 DISPLAY_IDENTIFIER Complement.L2_f_DrvLeavesCarBrakeAccPed.L2_DrvLeavesCar ECU_ADDRESS 0xFFF9994B /end MEASUREMENT
/begin MEASUREMENT L2_DrvLeavesCar.L2_f_DrvLeavesCar.Value "Indicates that the driver leaves the car" UBYTE SBW_STANDARD_S1_S3 1 100 0 1 BIT_MASK 0x1 DISPLAY_IDENTIFIER Value.L2_f_DrvLeavesCar.L2_DrvLeavesCar ECU_ADDRESS 0xFFF9994C /end MEASUREMENT
/begin MEASUREMENT L2_DrvLeavesCar.L2_f_DrvLeavesCar.Complement "Indicates that the driver leaves the car" UBYTE SBW_STANDARD_S1_S3 1 100 0 1 BIT_MASK 0x1 DISPLAY_IDENTIFIER Complement.L2_f_DrvLeavesCar.L2_DrvLeavesCar ECU_ADDRESS 0xFFF9994D /end MEASUREMENT
/begin MEASUREMENT L2_Interfi.L2_f_ModeDrvAssistVeh.Value "level 2 FAS-signal [PMA/RCP] from ICM-ECU: 0=PMA/RCP-mode inactive 1=PMA/RCP-mode active" UBYTE SBW_STANDARD_S1_S3 1 100 0 1 DISPLAY_IDENTIFIER Value.L2_f_ModeDrvAssistVeh.L2_Interfi ECU_ADDRESS 0xFFF98518 /end MEASUREMENT
/begin MEASUREMENT L2_Interfi.L2_f_ModeDrvAssistVeh.Complement "level 2 FAS-signal [PMA/RCP] from ICM-ECU: 0=PMA/RCP-mode inactive 1=PMA/RCP-mode active" UBYTE SBW_STANDARD_S1_S3 1 100 0 1 DISPLAY_IDENTIFIER Complement.L2_f_ModeDrvAssistVeh.L2_Interfi ECU_ADDRESS 0xFFF98519 /end MEASUREMENT
/begin MEASUREMENT L2_Interfi.L2_ModeDrvAssistVehSts.Value "level 2 signal status of _GET_MODE_DRV_ASSIST_VEH: 0=signal o.k. 1=signal subst.value 2=signal n.o.k./err." UBYTE SBW_STANDARD_S1_S3 1 100 0 2 DISPLAY_IDENTIFIER Value.L2_ModeDrvAssistVehSts.L2_Interfi ECU_ADDRESS 0xFFF9851A /end MEASUREMENT
/begin MEASUREMENT L2_Interfi.L2_ModeDrvAssistVehSts.Complement "level 2 signal status of _GET_MODE_DRV_ASSIST_VEH: 0=signal o.k. 1=signal subst.value 2=signal n.o.k./err." UBYTE SBW_STANDARD_S1_S3 1 100 0 2 DISPLAY_IDENTIFIER Complement.L2_ModeDrvAssistVehSts.L2_Interfi ECU_ADDRESS 0xFFF9851B /end MEASUREMENT
/begin MEASUREMENT L2_Interfi.L2_PosDrvAssistRaw.Value "level 2 FAS [PMA/RCP] request for driving-direction: 0=NA 5=D 6=N 7=R 8=P" UBYTE SBW_STANDARD_S1_S3 1 100 0 8 DISPLAY_IDENTIFIER Value.L2_PosDrvAssistRaw.L2_Interfi ECU_ADDRESS 0xFFF9851C /end MEASUREMENT
/begin MEASUREMENT L2_Interfi.L2_PosDrvAssistRaw.Complement "level 2 FAS [PMA/RCP] request for driving-direction: 0=NA 5=D 6=N 7=R 8=P" UBYTE SBW_STANDARD_S1_S3 1 100 0 8 DISPLAY_IDENTIFIER Complement.L2_PosDrvAssistRaw.L2_Interfi ECU_ADDRESS 0xFFF9851D /end MEASUREMENT
/begin MEASUREMENT L2_Interfi.L2_PosDrvAssistRawSts.Value "level 2 signal status of _GET_POS_DRV_ASSIST_RAW: 0=signal o.k. 1=signal subst.value 2=signal n.o.k./err." UBYTE SBW_STANDARD_S1_S3 1 100 0 2 DISPLAY_IDENTIFIER Value.L2_PosDrvAssistRawSts.L2_Interfi ECU_ADDRESS 0xFFF9851E /end MEASUREMENT
/begin MEASUREMENT L2_Interfi.L2_PosDrvAssistRawSts.Complement "level 2 signal status of _GET_POS_DRV_ASSIST_RAW: 0=signal o.k. 1=signal subst.value 2=signal n.o.k./err." UBYTE SBW_STANDARD_S1_S3 1 100 0 2 DISPLAY_IDENTIFIER Complement.L2_PosDrvAssistRawSts.L2_Interfi ECU_ADDRESS 0xFFF9851F /end MEASUREMENT
/begin MEASUREMENT L2_Interfi.L2_f_BrakePedalDrvAssist.Value "level 2 brake-activation flag by FAS [PMA/RCP] from ICM-ECU: 0=brake by FAS inactive 1=brake by FAS active" UBYTE SBW_STANDARD_S1_S3 1 100 0 1 DISPLAY_IDENTIFIER Value.L2_f_BrakePedalDrvAssist.L2_Interfi ECU_ADDRESS 0xFFF98520 /end MEASUREMENT
/begin MEASUREMENT L2_Interfi.L2_f_BrakePedalDrvAssist.Complement "level 2 brake-activation flag by FAS [PMA/RCP] from ICM-ECU: 0=brake by FAS inactive 1=brake by FAS active" UBYTE SBW_STANDARD_S1_S3 1 100 0 1 DISPLAY_IDENTIFIER Complement.L2_f_BrakePedalDrvAssist.L2_Interfi ECU_ADDRESS 0xFFF98521 /end MEASUREMENT
/begin MEASUREMENT L2_Interfi.L2_BrakePedalDrvAssistSts.Value "level 2 signal status of _GET_FBR_DRV_ASSIST: 0=signal o.k. 1=signal subst.value 2=signal n.o.k./err." UBYTE SBW_STANDARD_S1_S3 1 100 0 2 DISPLAY_IDENTIFIER Value.L2_BrakePedalDrvAssistSts.L2_Interfi ECU_ADDRESS 0xFFF98522 /end MEASUREMENT
/begin MEASUREMENT L2_Interfi.L2_BrakePedalDrvAssistSts.Complement "level 2 signal status of _GET_FBR_DRV_ASSIST: 0=signal o.k. 1=signal subst.value 2=signal n.o.k./err." UBYTE SBW_STANDARD_S1_S3 1 100 0 2 DISPLAY_IDENTIFIER Complement.L2_BrakePedalDrvAssistSts.L2_Interfi ECU_ADDRESS 0xFFF98523 /end MEASUREMENT
/begin MEASUREMENT L2_Interfi.L2_st_GearboxDrvRdy.Value "state of gear-change-pressure for Level2: 0x00=sys.press. not avail. - 0x04set: sys.press.incr. - 0x20set: sys.press.decr. - 0x80 set:sys.press. avail." UBYTE SBW_STANDARD_S1_S3 1 100 0 255 DISPLAY_IDENTIFIER Value.L2_st_GearboxDrvRdy.L2_Interfi ECU_ADDRESS 0xFFF98524 /end MEASUREMENT
/begin MEASUREMENT L2_Interfi.L2_st_GearboxDrvRdy.Complement "state of gear-change-pressure for Level2: 0x00=sys.press. not avail. - 0x04set: sys.press.incr. - 0x20set: sys.press.decr. - 0x80 set:sys.press. avail." UBYTE SBW_STANDARD_S1_S3 1 100 0 255 DISPLAY_IDENTIFIER Complement.L2_st_GearboxDrvRdy.L2_Interfi ECU_ADDRESS 0xFFF98525 /end MEASUREMENT
/begin MEASUREMENT L2_Interfi.L2_GearboxDrvRdySts.Value "state of signal L2_st_GearboxDrvRdy" UBYTE SBW_STANDARD_S1_S3 1 100 0 2 DISPLAY_IDENTIFIER Value.L2_GearboxDrvRdySts.L2_Interfi ECU_ADDRESS 0xFFF98526 /end MEASUREMENT
/begin MEASUREMENT L2_Interfi.L2_GearboxDrvRdySts.Complement "state of signal L2_st_GearboxDrvRdy" UBYTE SBW_STANDARD_S1_S3 1 100 0 2 DISPLAY_IDENTIFIER Complement.L2_GearboxDrvRdySts.L2_Interfi ECU_ADDRESS 0xFFF98527 /end MEASUREMENT
/begin MEASUREMENT L2_Interfi.L2_VehicleDrvRdy.Value "signal VehicleDrvRdy for level 2" UBYTE SBW_STANDARD_S1_S3 1 100 0 255 DISPLAY_IDENTIFIER Value.L2_VehicleDrvRdy.L2_Interfi ECU_ADDRESS 0xFFF98528 /end MEASUREMENT
/begin MEASUREMENT L2_Interfi.L2_VehicleDrvRdy.Complement "signal VehicleDrvRdy for level 2" UBYTE SBW_STANDARD_S1_S3 1 100 0 255 DISPLAY_IDENTIFIER Complement.L2_VehicleDrvRdy.L2_Interfi ECU_ADDRESS 0xFFF98529 /end MEASUREMENT
/begin MEASUREMENT L2_Interfi.L2_VehicleDrvRdySts.Value "state of signal VehicleDrvRdy for level 2" UBYTE SBW_STANDARD_S1_S3 1 100 0 255 DISPLAY_IDENTIFIER Value.L2_VehicleDrvRdySts.L2_Interfi ECU_ADDRESS 0xFFF9852A /end MEASUREMENT
/begin MEASUREMENT L2_Interfi.L2_VehicleDrvRdySts.Complement "state of signal VehicleDrvRdy for level 2" UBYTE SBW_STANDARD_S1_S3 1 100 0 255 DISPLAY_IDENTIFIER Complement.L2_VehicleDrvRdySts.L2_Interfi ECU_ADDRESS 0xFFF9852B /end MEASUREMENT
/begin MEASUREMENT L2_Interfi.L2_st_IgnOnRaw.Value "state ignition on/off (raw-value) for level 2" UBYTE SBW_STANDARD_S1_S3 1 100 0 4 DISPLAY_IDENTIFIER Value.L2_st_IgnOnRaw.L2_Interfi ECU_ADDRESS 0xFFF9852C /end MEASUREMENT
/begin MEASUREMENT L2_Interfi.L2_st_IgnOnRaw.Complement "state ignition on/off (raw-value) for level 2" UBYTE SBW_STANDARD_S1_S3 1 100 0 4 DISPLAY_IDENTIFIER Complement.L2_st_IgnOnRaw.L2_Interfi ECU_ADDRESS 0xFFF9852D /end MEASUREMENT
/begin MEASUREMENT L2_Interfi.L2_IgnOnRawSts.Value "state ignition (raw-value)" UBYTE SBW_STANDARD_S1_S3 1 100 0 2 DISPLAY_IDENTIFIER Value.L2_IgnOnRawSts.L2_Interfi ECU_ADDRESS 0xFFF9852E /end MEASUREMENT
/begin MEASUREMENT L2_Interfi.L2_IgnOnRawSts.Complement "state ignition (raw-value)" UBYTE SBW_STANDARD_S1_S3 1 100 0 2 DISPLAY_IDENTIFIER Complement.L2_IgnOnRawSts.L2_Interfi ECU_ADDRESS 0xFFF9852F /end MEASUREMENT
/begin MEASUREMENT L2_Interfi.L2_n_AbRaw.Value "drive/output rev.s (raw- or subst.value) for level 2" UWORD SBW_N_1_M_S1_S3 1 100 0 20000 DISPLAY_IDENTIFIER Value.L2_n_AbRaw.L2_Interfi ECU_ADDRESS 0xFFF98530 /end MEASUREMENT
/begin MEASUREMENT L2_Interfi.L2_n_AbRaw.Complement "drive/output rev.s (raw- or subst.value) for level 2" UWORD SBW_STANDARD_S1_S3 1 100 0 20000 DISPLAY_IDENTIFIER Complement.L2_n_AbRaw.L2_Interfi ECU_ADDRESS 0xFFF98532 /end MEASUREMENT
/begin MEASUREMENT L2_Interfi.L2_st_Limphome.Value "L2_st_Limphome: xxxx xxx1: lowside switch opened xxxx xx1x: highside switch [FET] opened" UBYTE SBW_STANDARD_S1_S3 1 100 0 255 DISPLAY_IDENTIFIER Value.L2_st_Limphome.L2_Interfi ECU_ADDRESS 0xFFF98534 /end MEASUREMENT
/begin MEASUREMENT L2_Interfi.L2_st_Limphome.Complement "L2_st_Limphome: xxxx xxx1: lowside switch opened xxxx xx1x: highside switch [FET] opened" UBYTE SBW_STANDARD_S1_S3 1 100 0 255 DISPLAY_IDENTIFIER Complement.L2_st_Limphome.L2_Interfi ECU_ADDRESS 0xFFF98535 /end MEASUREMENT
/begin MEASUREMENT L2_Interfi.L2_v_VehSpd_nab.Value "vehicle speed for level 2 with complement" UWORD SBW_VKMH_16_S1_S3 1 100 0 21.875 DISPLAY_IDENTIFIER Value.L2_v_VehSpd_nab.L2_Interfi ECU_ADDRESS 0xFFF98536 /end MEASUREMENT
/begin MEASUREMENT L2_Interfi.L2_v_VehSpd_nab.Complement "vehicle speed for level 2 with complement" UWORD SBW_STANDARD_S1_S3 1 100 0 350 DISPLAY_IDENTIFIER Complement.L2_v_VehSpd_nab.L2_Interfi ECU_ADDRESS 0xFFF98538 /end MEASUREMENT
/begin MEASUREMENT L2_Interfi.L2_PSensorSts.Value "state P-sensor signal (0: ok 1: subst 2: err) for level 2" UBYTE SBW_STANDARD_S1_S3 1 100 0 2 DISPLAY_IDENTIFIER Value.L2_PSensorSts.L2_Interfi ECU_ADDRESS 0xFFF9853A /end MEASUREMENT
/begin MEASUREMENT L2_Interfi.L2_PSensorSts.Complement "state P-sensor signal (0: ok 1: subst 2: err) for level 2" UBYTE SBW_STANDARD_S1_S3 1 100 0 2 DISPLAY_IDENTIFIER Complement.L2_PSensorSts.L2_Interfi ECU_ADDRESS 0xFFF9853B /end MEASUREMENT
/begin MEASUREMENT L2_Interfi.L2_PSensor.Value "state of the parking lock (0=not engaged; 1=engaged; 2=intermediate pos.; 3=unknown) for level 2" UBYTE SBW_STANDARD_S1_S3 1 100 0 255 DISPLAY_IDENTIFIER Value.L2_PSensor.L2_Interfi ECU_ADDRESS 0xFFF9853C /end MEASUREMENT
/begin MEASUREMENT L2_Interfi.L2_PSensor.Complement "state of the parking lock (0=not engaged; 1=engaged; 2=intermediate pos.; 3=unknown) for level 2" UBYTE SBW_STANDARD_S1_S3 1 100 0 255 DISPLAY_IDENTIFIER Complement.L2_PSensor.L2_Interfi ECU_ADDRESS 0xFFF9853D /end MEASUREMENT
/begin MEASUREMENT L2_Interfi.L2_PosRaw.Value "raw val. of driver request (absolute or relative position) for level 2" UBYTE SBW_STANDARD_S1_S3 1 100 0 24 DISPLAY_IDENTIFIER Value.L2_PosRaw.L2_Interfi ECU_ADDRESS 0xFFF98544 /end MEASUREMENT
/begin MEASUREMENT L2_Interfi.L2_PosRaw.Complement "raw val. of driver request (absolute or relative position) for level 2" UBYTE SBW_STANDARD_S1_S3 1 100 0 24 DISPLAY_IDENTIFIER Complement.L2_PosRaw.L2_Interfi ECU_ADDRESS 0xFFF98545 /end MEASUREMENT
/begin MEASUREMENT L2_Interfi.L2_CtrlSignalSourceSts.Value "Status of signal L2_PosRaw" UBYTE SBW_STANDARD_S1_S3 1 100 0 2 DISPLAY_IDENTIFIER Value.L2_CtrlSignalSourceSts.L2_Interfi ECU_ADDRESS 0xFFF98546 /end MEASUREMENT
/begin MEASUREMENT L2_Interfi.L2_CtrlSignalSourceSts.Complement "Status of signal L2_PosRaw" UBYTE SBW_STANDARD_S1_S3 1 100 0 2 DISPLAY_IDENTIFIER Complement.L2_CtrlSignalSourceSts.L2_Interfi ECU_ADDRESS 0xFFF98547 /end MEASUREMENT
/begin MEASUREMENT L2_Interfi.L2_st_LeverType.Value "state of application lable 'GET_SWI_LEVER_TYPE' 0=auto 1=sport 2=IEX for level 2" UBYTE SBW_STANDARD_S1_S3 1 100 0 2 DISPLAY_IDENTIFIER Value.L2_st_LeverType.L2_Interfi ECU_ADDRESS 0xFFF98548 /end MEASUREMENT
/begin MEASUREMENT L2_Interfi.L2_st_LeverType.Complement "state of application lable 'GET_SWI_LEVER_TYPE' 0=auto 1=sport 2=IEX for level 2" UBYTE SBW_STANDARD_S1_S3 1 100 0 2 DISPLAY_IDENTIFIER Complement.L2_st_LeverType.L2_Interfi ECU_ADDRESS 0xFFF98549 /end MEASUREMENT
/begin MEASUREMENT L2_Interfi.L2_GatePosRaw.Value "raw val. of gate position - left-right-noaction for level 2" UBYTE SBW_STANDARD_S1_S3 1 100 0 255 DISPLAY_IDENTIFIER Value.L2_GatePosRaw.L2_Interfi ECU_ADDRESS 0xFFF9854A /end MEASUREMENT
/begin MEASUREMENT L2_Interfi.L2_GatePosRaw.Complement "raw val. of gate position - left-right-noaction for level 2" UBYTE SBW_STANDARD_S1_S3 1 100 0 255 DISPLAY_IDENTIFIER Complement.L2_GatePosRaw.L2_Interfi ECU_ADDRESS 0xFFF9854B /end MEASUREMENT
/begin MEASUREMENT L2_Interfi.L2_f_P12Button.Value "flag park-button pressed for level 2" UBYTE SBW_STANDARD_S1_S3 1 100 0 1 BIT_MASK 0x1 DISPLAY_IDENTIFIER Value.L2_f_P12Button.L2_Interfi ECU_ADDRESS 0xFFF9854C /end MEASUREMENT
/begin MEASUREMENT L2_Interfi.L2_f_P12Button.Complement "flag park-button pressed for level 2" UBYTE SBW_STANDARD_S1_S3 1 100 0 1 BIT_MASK 0x1 DISPLAY_IDENTIFIER Complement.L2_f_P12Button.L2_Interfi ECU_ADDRESS 0xFFF9854D /end MEASUREMENT
/begin MEASUREMENT L2_Interfi.L2_f_DoorD.Value "driver side door open" UBYTE SBW_STANDARD_S1_S3 1 100 0 1 BIT_MASK 0x1 DISPLAY_IDENTIFIER Value.L2_f_DoorD.L2_Interfi ECU_ADDRESS 0xFFF9854E /end MEASUREMENT
/begin MEASUREMENT L2_Interfi.L2_f_DoorD.Complement "driver side door open" UBYTE SBW_STANDARD_S1_S3 1 100 0 1 BIT_MASK 0x1 DISPLAY_IDENTIFIER Complement.L2_f_DoorD.L2_Interfi ECU_ADDRESS 0xFFF9854F /end MEASUREMENT
/begin MEASUREMENT L2_Interfi.L2_DoorDSts.Value "status of signal 'door open'" UBYTE SBW_STANDARD_S1_S3 1 100 0 2 DISPLAY_IDENTIFIER Value.L2_DoorDSts.L2_Interfi ECU_ADDRESS 0xFFF98550 /end MEASUREMENT
/begin MEASUREMENT L2_Interfi.L2_DoorDSts.Complement "status of signal 'door open'" UBYTE SBW_STANDARD_S1_S3 1 100 0 2 DISPLAY_IDENTIFIER Complement.L2_DoorDSts.L2_Interfi ECU_ADDRESS 0xFFF98551 /end MEASUREMENT
/begin MEASUREMENT L2_Interfi.L2_f_SeatBelt.Value "driver seat belt 0=open 1=closed" UBYTE SBW_STANDARD_S1_S3 1 100 0 1 BIT_MASK 0x1 DISPLAY_IDENTIFIER Value.L2_f_SeatBelt.L2_Interfi ECU_ADDRESS 0xFFF98552 /end MEASUREMENT
/begin MEASUREMENT L2_Interfi.L2_f_SeatBelt.Complement "driver seat belt 0=open 1=closed" UBYTE SBW_STANDARD_S1_S3 1 100 0 1 BIT_MASK 0x1 DISPLAY_IDENTIFIER Complement.L2_f_SeatBelt.L2_Interfi ECU_ADDRESS 0xFFF98553 /end MEASUREMENT
/begin MEASUREMENT L2_Interfi.L2_SeatBeltSts.Value "status of signal f_SeatBelt" UBYTE SBW_STANDARD_S1_S3 1 100 0 2 DISPLAY_IDENTIFIER Value.L2_SeatBeltSts.L2_Interfi ECU_ADDRESS 0xFFF98554 /end MEASUREMENT
/begin MEASUREMENT L2_Interfi.L2_SeatBeltSts.Complement "status of signal f_SeatBelt" UBYTE SBW_STANDARD_S1_S3 1 100 0 2 DISPLAY_IDENTIFIER Complement.L2_SeatBeltSts.L2_Interfi ECU_ADDRESS 0xFFF98555 /end MEASUREMENT
/begin MEASUREMENT L2_Interfi.L2_AcceleratorPedalAngle.Value "Accelerator Pedal Angle" UBYTE SBW_HDK_M_S1_S3 1 100 0 100.4 DISPLAY_IDENTIFIER Value.L2_AcceleratorPedalAngle.L2_Interfi ECU_ADDRESS 0xFFF98556 /end MEASUREMENT
/begin MEASUREMENT L2_Interfi.L2_AcceleratorPedalAngle.Complement "Accelerator Pedal Angle" UBYTE SBW_STANDARD_S1_S3 1 100 0 255 DISPLAY_IDENTIFIER Complement.L2_AcceleratorPedalAngle.L2_Interfi ECU_ADDRESS 0xFFF98557 /end MEASUREMENT
/begin MEASUREMENT L2_Interfi.L2_AcceleratorPedalAngleSts.Value "Signal status of Accelerator Pedal Angle" UBYTE SBW_STANDARD_S1_S3 1 100 0 2 DISPLAY_IDENTIFIER Value.L2_AcceleratorPedalAngleSts.L2_Interfi ECU_ADDRESS 0xFFF98558 /end MEASUREMENT
/begin MEASUREMENT L2_Interfi.L2_AcceleratorPedalAngleSts.Complement "Signal status of Accelerator Pedal Angle" UBYTE SBW_STANDARD_S1_S3 1 100 0 2 DISPLAY_IDENTIFIER Complement.L2_AcceleratorPedalAngleSts.L2_Interfi ECU_ADDRESS 0xFFF98559 /end MEASUREMENT
/begin MEASUREMENT L2_Interfi.L2_f_V_Implausible.Value "flag implausible speed" UBYTE SBW_STANDARD_S1_S3 1 100 0 1 BIT_MASK 0x1 DISPLAY_IDENTIFIER Value.L2_f_V_Implausible.L2_Interfi ECU_ADDRESS 0xFFF9855A /end MEASUREMENT
/begin MEASUREMENT L2_Interfi.L2_f_V_Implausible.Complement "flag implausible speed" UBYTE SBW_STANDARD_S1_S3 1 100 0 1 BIT_MASK 0x1 DISPLAY_IDENTIFIER Complement.L2_f_V_Implausible.L2_Interfi ECU_ADDRESS 0xFFF9855B /end MEASUREMENT
/begin MEASUREMENT Level2Diag.L2_f_D_Tab_RelToAbsConversion_differs.Value "D_Tab_RelToAbsConversion(_L2) differs" UBYTE SBW_STANDARD_S1_S3 1 100 0 1 DISPLAY_IDENTIFIER Value.L2_f_D_Tab_RelToAbsConversion_differs.Level2Diag ECU_ADDRESS 0xFFF9994E /end MEASUREMENT
/begin MEASUREMENT Level2Diag.L2_f_D_Tab_RelToAbsConversion_differs.Complement "D_Tab_RelToAbsConversion(_L2) differs" UBYTE SBW_STANDARD_S1_S3 1 100 0 1 DISPLAY_IDENTIFIER Complement.L2_f_D_Tab_RelToAbsConversion_differs.Level2Diag ECU_ADDRESS 0xFFF9994F /end MEASUREMENT
/begin MEASUREMENT PosMonitoring.L2_Max_D_t_StoreN.Value "Set value of L2_tmr_N_Request depending on driver request storage" UWORD SBW_TIMER_10MS_S1_S3 1 100 0 655350 DISPLAY_IDENTIFIER Value.L2_Max_D_t_StoreN.PosMonitoring ECU_ADDRESS 0xFFF98568 /end MEASUREMENT
/begin MEASUREMENT PosMonitoring.L2_Max_D_t_StoreN.Complement "Set value of L2_tmr_N_Request depending on driver request storage" UWORD SBW_STANDARD_S1_S3 1 100 0 65535 DISPLAY_IDENTIFIER Complement.L2_Max_D_t_StoreN.PosMonitoring ECU_ADDRESS 0xFFF9856A /end MEASUREMENT
/begin MEASUREMENT DebounceMonitoring.L2_f_WaitDrvReqRD2N.Value "indicates that timer L2_tmr_WaitForDebouncedDrvReq was preloaded / running" UBYTE SBW_STANDARD_S1_S3 1 100 0 1 BIT_MASK 0x1 DISPLAY_IDENTIFIER Value.L2_f_WaitDrvReqRD2N.DebounceMonitoring ECU_ADDRESS 0xFFF99956 /end MEASUREMENT
/begin MEASUREMENT DebounceMonitoring.L2_f_WaitDrvReqRD2N.Complement "indicates that timer L2_tmr_WaitForDebouncedDrvReq was preloaded / running" UBYTE SBW_STANDARD_S1_S3 1 100 0 1 BIT_MASK 0x1 DISPLAY_IDENTIFIER Complement.L2_f_WaitDrvReqRD2N.DebounceMonitoring ECU_ADDRESS 0xFFF99957 /end MEASUREMENT
/begin MEASUREMENT DebounceMonitoring.L2_f_DiagposAutoposDetectedLastCycle.Value "detction of diagpos or autopos during last cycle Level2" UBYTE SBW_STANDARD_S1_S3 1 100 0 1 BIT_MASK 0x1 DISPLAY_IDENTIFIER Value.L2_f_DiagposAutoposDetectedLastCycle.DebounceMonitoring ECU_ADDRESS 0xFFF99958 /end MEASUREMENT
/begin MEASUREMENT DebounceMonitoring.L2_f_DiagposAutoposDetectedLastCycle.Complement "detction of diagpos or autopos during last cycle Level2" UBYTE SBW_STANDARD_S1_S3 1 100 0 1 BIT_MASK 0x1 DISPLAY_IDENTIFIER Complement.L2_f_DiagposAutoposDetectedLastCycle.DebounceMonitoring ECU_ADDRESS 0xFFF99959 /end MEASUREMENT
/begin MEASUREMENT UnintendedTraction.L2_f_Allow_tmr_R_Request_Compute.Value "indicates that L2_tmr_R_Request_Timer may be computed" UBYTE SBW_STANDARD_S1_S3 1 100 0 1 BIT_MASK 0x1 DISPLAY_IDENTIFIER Value.L2_f_Allow_tmr_R_Request_Compute.UnintendedTraction ECU_ADDRESS 0xFFF98584 /end MEASUREMENT
/begin MEASUREMENT UnintendedTraction.L2_f_Allow_tmr_R_Request_Compute.Complement "indicates that L2_tmr_R_Request_Timer may be computed" UBYTE SBW_STANDARD_S1_S3 1 100 0 1 BIT_MASK 0x1 DISPLAY_IDENTIFIER Complement.L2_f_Allow_tmr_R_Request_Compute.UnintendedTraction ECU_ADDRESS 0xFFF98585 /end MEASUREMENT
/begin MEASUREMENT UnintendedTraction.L2_f_Allow_tmr_D_Request_Compute.Value "indicates that L2_tmr_D_Request_Timer may be computed" UBYTE SBW_STANDARD_S1_S3 1 100 0 1 BIT_MASK 0x1 DISPLAY_IDENTIFIER Value.L2_f_Allow_tmr_D_Request_Compute.UnintendedTraction ECU_ADDRESS 0xFFF98586 /end MEASUREMENT
/begin MEASUREMENT UnintendedTraction.L2_f_Allow_tmr_D_Request_Compute.Complement "indicates that L2_tmr_D_Request_Timer may be computed" UBYTE SBW_STANDARD_S1_S3 1 100 0 1 BIT_MASK 0x1 DISPLAY_IDENTIFIER Complement.L2_f_Allow_tmr_D_Request_Compute.UnintendedTraction ECU_ADDRESS 0xFFF98587 /end MEASUREMENT
/begin MEASUREMENT UnintendedTraction.L2_f_Shiftlock_Brake.Value "f_Shiftlock_Brake value for level2" UBYTE SBW_STANDARD_S1_S3 1 100 0 1 BIT_MASK 0x1 DISPLAY_IDENTIFIER Value.L2_f_Shiftlock_Brake.UnintendedTraction ECU_ADDRESS 0xFFF98588 /end MEASUREMENT
/begin MEASUREMENT UnintendedTraction.L2_f_Shiftlock_Brake.Complement "f_Shiftlock_Brake value for level2" UBYTE SBW_STANDARD_S1_S3 1 100 0 1 BIT_MASK 0x1 DISPLAY_IDENTIFIER Complement.L2_f_Shiftlock_Brake.UnintendedTraction ECU_ADDRESS 0xFFF98589 /end MEASUREMENT
/begin MEASUREMENT UnintendedTraction.L2_f_ShiftlockDeactBySpeed.Value "Vehicle speed in shiflock hysteresis range" UBYTE SBW_STANDARD_S1_S3 1 100 0 1 BIT_MASK 0x1 DISPLAY_IDENTIFIER Value.L2_f_ShiftlockDeactBySpeed.UnintendedTraction ECU_ADDRESS 0xFFF9858A /end MEASUREMENT
/begin MEASUREMENT UnintendedTraction.L2_f_ShiftlockDeactBySpeed.Complement "Vehicle speed in shiflock hysteresis range" UBYTE SBW_STANDARD_S1_S3 1 100 0 1 BIT_MASK 0x1 DISPLAY_IDENTIFIER Complement.L2_f_ShiftlockDeactBySpeed.UnintendedTraction ECU_ADDRESS 0xFFF9858B /end MEASUREMENT
/begin MEASUREMENT UnintendedTraction.L2_Max_D_t_StoreR_WithoutLatencyPeriod.Value "Set value of L2_tmr_R_Request depending on driver request storage" UWORD SBW_TIMER_10MS_S1_S3 1 100 0 655350 DISPLAY_IDENTIFIER Value.L2_Max_D_t_StoreR_WithoutLatencyPeriod.UnintendedTraction ECU_ADDRESS 0xFFF9858C /end MEASUREMENT
/begin MEASUREMENT UnintendedTraction.L2_Max_D_t_StoreR_WithoutLatencyPeriod.Complement "Set value of L2_tmr_R_Request depending on driver request storage" UWORD SBW_STANDARD_S1_S3 1 100 0 65535 DISPLAY_IDENTIFIER Complement.L2_Max_D_t_StoreR_WithoutLatencyPeriod.UnintendedTraction ECU_ADDRESS 0xFFF9858E /end MEASUREMENT
/begin MEASUREMENT UnintendedTraction.L2_Max_D_t_StoreR.Value "Set value of L2_tmr_R_Request depending on driver request storage + latency time" ULONG SBW_TIMER_10MS_S1_S3 1 100 0 655350 DISPLAY_IDENTIFIER Value.L2_Max_D_t_StoreR.UnintendedTraction ECU_ADDRESS 0xFFF98590 /end MEASUREMENT
/begin MEASUREMENT UnintendedTraction.L2_Max_D_t_StoreR.Complement "Set value of L2_tmr_R_Request depending on driver request storage + latency time" ULONG SBW_STANDARD_S1_S3 1 100 0 65535 DISPLAY_IDENTIFIER Complement.L2_Max_D_t_StoreR.UnintendedTraction ECU_ADDRESS 0xFFF98594 /end MEASUREMENT
/begin MEASUREMENT UnintendedTraction.L2_Max_D_t_StoreD_WithoutLatencyPeriod.Value "Set value of L2_tmr_D_Request depending on driver request storage" UWORD SBW_TIMER_10MS_S1_S3 1 100 0 655350 DISPLAY_IDENTIFIER Value.L2_Max_D_t_StoreD_WithoutLatencyPeriod.UnintendedTraction ECU_ADDRESS 0xFFF98598 /end MEASUREMENT
/begin MEASUREMENT UnintendedTraction.L2_Max_D_t_StoreD_WithoutLatencyPeriod.Complement "Set value of L2_tmr_D_Request depending on driver request storage" UWORD SBW_STANDARD_S1_S3 1 100 0 65535 DISPLAY_IDENTIFIER Complement.L2_Max_D_t_StoreD_WithoutLatencyPeriod.UnintendedTraction ECU_ADDRESS 0xFFF9859A /end MEASUREMENT
/begin MEASUREMENT UnintendedTraction.L2_Max_D_t_StoreD.Value "Set value of L2_tmr_D_Request depending on driver request storage + latency time" ULONG SBW_TIMER_10MS_S1_S3 1 100 0 655350 DISPLAY_IDENTIFIER Value.L2_Max_D_t_StoreD.UnintendedTraction ECU_ADDRESS 0xFFF9859C /end MEASUREMENT
/begin MEASUREMENT UnintendedTraction.L2_Max_D_t_StoreD.Complement "Set value of L2_tmr_D_Request depending on driver request storage + latency time" ULONG SBW_STANDARD_S1_S3 1 100 0 65535 DISPLAY_IDENTIFIER Complement.L2_Max_D_t_StoreD.UnintendedTraction ECU_ADDRESS 0xFFF985A0 /end MEASUREMENT
/begin MEASUREMENT L2_DrvReq.L2_DrvReq_Raw.Value "Driver request by Level2" UBYTE SBW_STANDARD_S1_S3 1 100 0 8 DISPLAY_IDENTIFIER Value.L2_DrvReq_Raw.L2_DrvReq ECU_ADDRESS 0xFFF9995E /end MEASUREMENT
/begin MEASUREMENT L2_DrvReq.L2_DrvReq_Raw.Complement "Driver request by Level2" UBYTE SBW_STANDARD_S1_S3 1 100 0 8 DISPLAY_IDENTIFIER Complement.L2_DrvReq_Raw.L2_DrvReq ECU_ADDRESS 0xFFF9995F /end MEASUREMENT
/begin MEASUREMENT L2_DrvReq.L2_DrvReq_Raw_ByRelativelever.Value "Driver request by relative lever for Level2" UBYTE SBW_STANDARD_S1_S3 1 100 0 8 DISPLAY_IDENTIFIER Value.L2_DrvReq_Raw_ByRelativelever.L2_DrvReq ECU_ADDRESS 0xFFF99960 /end MEASUREMENT
/begin MEASUREMENT L2_DrvReq.L2_DrvReq_Raw_ByRelativelever.Complement "Driver request by relative lever for Level2" UBYTE SBW_STANDARD_S1_S3 1 100 0 8 DISPLAY_IDENTIFIER Complement.L2_DrvReq_Raw_ByRelativelever.L2_DrvReq ECU_ADDRESS 0xFFF99961 /end MEASUREMENT
/begin MEASUREMENT L2_DrvReq.L2_PosRawRelOld.Value "raw val. of previous driver request complement (absolute or relative position) for level 2" UBYTE SBW_STANDARD_S1_S3 1 100 0 8 DISPLAY_IDENTIFIER Value.L2_PosRawRelOld.L2_DrvReq ECU_ADDRESS 0xFFF99962 /end MEASUREMENT
/begin MEASUREMENT L2_DrvReq.L2_PosRawRelOld.Complement "raw val. of previous driver request complement (absolute or relative position) for level 2" UBYTE SBW_STANDARD_S1_S3 1 100 0 8 DISPLAY_IDENTIFIER Complement.L2_PosRawRelOld.L2_DrvReq ECU_ADDRESS 0xFFF99963 /end MEASUREMENT
/begin MEASUREMENT L2_DrvReq.L2_st_RelToAbs_Stm.Value "state to detect correct action after lever movement" UBYTE SBW_STANDARD_S1_S3 1 100 0 5 DISPLAY_IDENTIFIER Value.L2_st_RelToAbs_Stm.L2_DrvReq ECU_ADDRESS 0xFFF99964 /end MEASUREMENT
/begin MEASUREMENT L2_DrvReq.L2_st_RelToAbs_Stm.Complement "state to detect correct action after lever movement" UBYTE SBW_STANDARD_S1_S3 1 100 0 5 DISPLAY_IDENTIFIER Complement.L2_st_RelToAbs_Stm.L2_DrvReq ECU_ADDRESS 0xFFF99965 /end MEASUREMENT
/begin MEASUREMENT L2_DrvReq.L2_MaxLeverpos.Value "maximum lever position until lever is back in NA for Level2" UBYTE SBW_STANDARD_S1_S3 1 100 0 32 DISPLAY_IDENTIFIER Value.L2_MaxLeverpos.L2_DrvReq ECU_ADDRESS 0xFFF99966 /end MEASUREMENT
/begin MEASUREMENT L2_DrvReq.L2_MaxLeverpos.Complement "maximum lever position until lever is back in NA for Level2" UBYTE SBW_STANDARD_S1_S3 1 100 0 32 DISPLAY_IDENTIFIER Complement.L2_MaxLeverpos.L2_DrvReq ECU_ADDRESS 0xFFF99967 /end MEASUREMENT
/begin MEASUREMENT L2_DrvReq.L2_MaxLeverposIdx.Value "index of x-axis in table D_Tab_RelToAbsConversion corresponding to actual MaxLeverpos for Level2" UBYTE SBW_STANDARD_S1_S3 1 100 0 3 DISPLAY_IDENTIFIER Value.L2_MaxLeverposIdx.L2_DrvReq ECU_ADDRESS 0xFFF99968 /end MEASUREMENT
/begin MEASUREMENT L2_DrvReq.L2_MaxLeverposIdx.Complement "index of x-axis in table D_Tab_RelToAbsConversion corresponding to actual MaxLeverpos for Level2" UBYTE SBW_STANDARD_S1_S3 1 100 0 3 DISPLAY_IDENTIFIER Complement.L2_MaxLeverposIdx.L2_DrvReq ECU_ADDRESS 0xFFF99969 /end MEASUREMENT
/begin MEASUREMENT L2_DrvReq.L2_StartPosPRND.Value "position needed as start position for conversion relative to absolute lever position for Level2" UBYTE SBW_STANDARD_S1_S3 1 100 0 8 DISPLAY_IDENTIFIER Value.L2_StartPosPRND.L2_DrvReq ECU_ADDRESS 0xFFF9996A /end MEASUREMENT
/begin MEASUREMENT L2_DrvReq.L2_StartPosPRND.Complement "position needed as start position for conversion relative to absolute lever position for Level2" UBYTE SBW_STANDARD_S1_S3 1 100 0 8 DISPLAY_IDENTIFIER Complement.L2_StartPosPRND.L2_DrvReq ECU_ADDRESS 0xFFF9996B /end MEASUREMENT
/begin MEASUREMENT L2_DrvReq.L2_StartPosPRNDIdx.Value "index of y-axis in table D_Tab_RelToAbsConversion corresponding to StartPosPRND for Level2" UBYTE SBW_STANDARD_S1_S3 1 100 0 6 DISPLAY_IDENTIFIER Value.L2_StartPosPRNDIdx.L2_DrvReq ECU_ADDRESS 0xFFF9996C /end MEASUREMENT
/begin MEASUREMENT L2_DrvReq.L2_StartPosPRNDIdx.Complement "index of y-axis in table D_Tab_RelToAbsConversion corresponding to StartPosPRND for Level2" UBYTE SBW_STANDARD_S1_S3 1 100 0 6 DISPLAY_IDENTIFIER Complement.L2_StartPosPRNDIdx.L2_DrvReq ECU_ADDRESS 0xFFF9996D /end MEASUREMENT
/begin MEASUREMENT L2_DrvReq.L2_DrvReq_Trig.Value "triggered Driver request by Level2" UBYTE SBW_STANDARD_S1_S3 1 100 0 8 DISPLAY_IDENTIFIER Value.L2_DrvReq_Trig.L2_DrvReq ECU_ADDRESS 0xFFF9996E /end MEASUREMENT
/begin MEASUREMENT L2_DrvReq.L2_DrvReq_Trig.Complement "triggered Driver request by Level2" UBYTE SBW_STANDARD_S1_S3 1 100 0 8 DISPLAY_IDENTIFIER Complement.L2_DrvReq_Trig.L2_DrvReq ECU_ADDRESS 0xFFF9996F /end MEASUREMENT
/begin MEASUREMENT L2_DrvReq.L2_DrvReq_Old.Value "remind Driver request by Level2" UBYTE SBW_STANDARD_S1_S3 1 100 0 8 DISPLAY_IDENTIFIER Value.L2_DrvReq_Old.L2_DrvReq ECU_ADDRESS 0xFFF99970 /end MEASUREMENT
/begin MEASUREMENT L2_DrvReq.L2_DrvReq_Old.Complement "remind Driver request by Level2" UBYTE SBW_STANDARD_S1_S3 1 100 0 8 DISPLAY_IDENTIFIER Complement.L2_DrvReq_Old.L2_DrvReq ECU_ADDRESS 0xFFF99971 /end MEASUREMENT
/begin MEASUREMENT L2_DrvReq.L2_DrvReqPRND_Raw.Value "raw value of L2 driver request" UBYTE SBW_STANDARD_S1_S3 1 100 0 8 DISPLAY_IDENTIFIER Value.L2_DrvReqPRND_Raw.L2_DrvReq ECU_ADDRESS 0xFFF99972 /end MEASUREMENT
/begin MEASUREMENT L2_DrvReq.L2_DrvReqPRND_Raw.Complement "raw value of L2 driver request" UBYTE SBW_STANDARD_S1_S3 1 100 0 8 DISPLAY_IDENTIFIER Complement.L2_DrvReqPRND_Raw.L2_DrvReq ECU_ADDRESS 0xFFF99973 /end MEASUREMENT
/begin MEASUREMENT L2_DrvReq.L2_DrvReqPRND_Filt.Value "Copy of L1 DrvReqPRND_Filt after monitoring of debounce" UBYTE SBW_STANDARD_S1_S3 1 100 0 8 DISPLAY_IDENTIFIER Value.L2_DrvReqPRND_Filt.L2_DrvReq ECU_ADDRESS 0xFFF99974 /end MEASUREMENT
/begin MEASUREMENT L2_DrvReq.L2_DrvReqPRND_Filt.Complement "Copy of L1 DrvReqPRND_Filt after monitoring of debounce" UBYTE SBW_STANDARD_S1_S3 1 100 0 8 DISPLAY_IDENTIFIER Complement.L2_DrvReqPRND_Filt.L2_DrvReq ECU_ADDRESS 0xFFF99975 /end MEASUREMENT
/begin MEASUREMENT L2_DrvReq.L2_DrvReqP_Trig.Value "triggerd driver request P" UBYTE SBW_STANDARD_S1_S3 1 100 0 1 BIT_MASK 0x1 DISPLAY_IDENTIFIER Value.L2_DrvReqP_Trig.L2_DrvReq ECU_ADDRESS 0xFFF99976 /end MEASUREMENT
/begin MEASUREMENT L2_DrvReq.L2_DrvReqP_Trig.Complement "triggerd driver request P" UBYTE SBW_STANDARD_S1_S3 1 100 0 1 BIT_MASK 0x1 DISPLAY_IDENTIFIER Complement.L2_DrvReqP_Trig.L2_DrvReq ECU_ADDRESS 0xFFF99977 /end MEASUREMENT
/begin MEASUREMENT L2_DrvReq.L2_DrvReqP_old.Value "remind old driver request P" UBYTE SBW_STANDARD_S1_S3 1 100 0 1 BIT_MASK 0x1 DISPLAY_IDENTIFIER Value.L2_DrvReqP_old.L2_DrvReq ECU_ADDRESS 0xFFF99978 /end MEASUREMENT
/begin MEASUREMENT L2_DrvReq.L2_DrvReqP_old.Complement "remind old driver request P" UBYTE SBW_STANDARD_S1_S3 1 100 0 1 BIT_MASK 0x1 DISPLAY_IDENTIFIER Complement.L2_DrvReqP_old.L2_DrvReq ECU_ADDRESS 0xFFF99979 /end MEASUREMENT
/begin MEASUREMENT L2_DrvReq.L2_GatePos_Trig.Value "triggerd Gate Position" UBYTE SBW_STANDARD_S1_S3 1 100 0 7 DISPLAY_IDENTIFIER Value.L2_GatePos_Trig.L2_DrvReq ECU_ADDRESS 0xFFF9997A /end MEASUREMENT
/begin MEASUREMENT L2_DrvReq.L2_GatePos_Trig.Complement "triggerd Gate Position" UBYTE SBW_STANDARD_S1_S3 1 100 0 7 DISPLAY_IDENTIFIER Complement.L2_GatePos_Trig.L2_DrvReq ECU_ADDRESS 0xFFF9997B /end MEASUREMENT
/begin MEASUREMENT L2_DrvReq.L2_GatePos_Old.Value "reminder of old Gate Position" UBYTE SBW_STANDARD_S1_S3 1 100 0 7 DISPLAY_IDENTIFIER Value.L2_GatePos_Old.L2_DrvReq ECU_ADDRESS 0xFFF9997C /end MEASUREMENT
/begin MEASUREMENT L2_DrvReq.L2_GatePos_Old.Complement "reminder of old Gate Position" UBYTE SBW_STANDARD_S1_S3 1 100 0 7 DISPLAY_IDENTIFIER Complement.L2_GatePos_Old.L2_DrvReq ECU_ADDRESS 0xFFF9997D /end MEASUREMENT
/begin MEASUREMENT L2_DrvReq.L2_PosDrvAssistRaw_Old.Value "mem. value of L2_PosDrvAssistRaw for next cycle" UBYTE SBW_STANDARD_S1_S3 1 100 0 8 DISPLAY_IDENTIFIER Value.L2_PosDrvAssistRaw_Old.L2_DrvReq ECU_ADDRESS 0xFFF9997E /end MEASUREMENT
/begin MEASUREMENT L2_DrvReq.L2_PosDrvAssistRaw_Old.Complement "mem. value of L2_PosDrvAssistRaw for next cycle" UBYTE SBW_STANDARD_S1_S3 1 100 0 8 DISPLAY_IDENTIFIER Complement.L2_PosDrvAssistRaw_Old.L2_DrvReq ECU_ADDRESS 0xFFF9997F /end MEASUREMENT
/begin MEASUREMENT L2_InitPos.L2_PosPRND_Init.Value "position of selection-lever after reset [without intermediate positions]; buffered in PosPRNDBuf for level 2" UBYTE SBW_STANDARD_S1_S3 1 100 0 255 DISPLAY_IDENTIFIER Value.L2_PosPRND_Init.L2_InitPos ECU_ADDRESS 0xFFF99980 /end MEASUREMENT
/begin MEASUREMENT L2_InitPos.L2_PosPRND_Init.Complement "position of selection-lever after reset [without intermediate positions]; buffered in PosPRNDBuf for level 2" UBYTE SBW_STANDARD_S1_S3 1 100 0 255 DISPLAY_IDENTIFIER Complement.L2_PosPRND_Init.L2_InitPos ECU_ADDRESS 0xFFF99981 /end MEASUREMENT
/begin MEASUREMENT DisplayMonitoring.L2_st_SetDispPosDark.Value "Level2-flag for setting displayed position dark in kombi" UBYTE SBW_STANDARD_S1_S3 1 100 0 15 DISPLAY_IDENTIFIER Value.L2_st_SetDispPosDark.DisplayMonitoring ECU_ADDRESS 0xFFF99996 /end MEASUREMENT
/begin MEASUREMENT DisplayMonitoring.L2_st_SetDispPosDark.Complement "Level2-flag for setting displayed position dark in kombi" UBYTE SBW_STANDARD_S1_S3 1 100 0 15 DISPLAY_IDENTIFIER Complement.L2_st_SetDispPosDark.DisplayMonitoring ECU_ADDRESS 0xFFF99997 /end MEASUREMENT
/begin MEASUREMENT DisplayMonitoring.L2_DisplayPos.Value "Variant independent Dispay Position" UBYTE SBW_STANDARD_S1_S3 1 100 0 15 DISPLAY_IDENTIFIER Value.L2_DisplayPos.DisplayMonitoring ECU_ADDRESS 0xFFF99998 /end MEASUREMENT
/begin MEASUREMENT DisplayMonitoring.L2_DisplayPos.Complement "Variant independent Dispay Position" UBYTE SBW_STANDARD_S1_S3 1 100 0 15 DISPLAY_IDENTIFIER Complement.L2_DisplayPos.DisplayMonitoring ECU_ADDRESS 0xFFF99999 /end MEASUREMENT
/begin MEASUREMENT DisplayMonitoring.L2_DisplayPosFlash.Value "Variant independent flashing Display Position" UBYTE SBW_STANDARD_S1_S3 1 100 0 15 DISPLAY_IDENTIFIER Value.L2_DisplayPosFlash.DisplayMonitoring ECU_ADDRESS 0xFFF9999A /end MEASUREMENT
/begin MEASUREMENT DisplayMonitoring.L2_DisplayPosFlash.Complement "Variant independent flashing Display Position" UBYTE SBW_STANDARD_S1_S3 1 100 0 15 DISPLAY_IDENTIFIER Complement.L2_DisplayPosFlash.DisplayMonitoring ECU_ADDRESS 0xFFF9999B /end MEASUREMENT
/begin COMPU_METHOD _CNV_S_7_Enum_EPOSM_211_CM_S2 "" TAB_VERB "%6.3" "" COMPU_TAB_REF _CNV_S_7_Enum_EPOSM_211_S2 /end COMPU_METHOD
/begin COMPU_METHOD _CNV_S_6_Enum_EFWSI_233_CM_S2 "" TAB_VERB "%6.3" "" COMPU_TAB_REF _CNV_S_6_Enum_EFWSI_233_S2 /end COMPU_METHOD
/begin COMPU_METHOD _CNV_S_4_Enum_EGANG_234_CM_S2 "" TAB_VERB "%6.3" "" COMPU_TAB_REF _CNV_S_4_Enum_EGANG_234_S2 /end COMPU_METHOD
/begin COMPU_METHOD _CNV_S_9_Enum_ENICU_235_CM_S2 "" TAB_VERB "%6.3" "" COMPU_TAB_REF _CNV_S_9_Enum_ENICU_235_S2 /end COMPU_METHOD
/begin COMPU_METHOD _CNV_S_2_Enum_ENICS_236_CM_S2 "" TAB_VERB "%6.3" "" COMPU_TAB_REF _CNV_S_2_Enum_ENICS_236_S2 /end COMPU_METHOD
/begin COMPU_METHOD UMR_HDK_M_1004_2550_S1_S3 "int = ((phys * 2550) / 1004) - (0) %" RAT_FUNC "%5.3" "%" COEFFS 0 2550 -0 0 0 1004 /end COMPU_METHOD
/begin COMPU_METHOD UMR_MBSE_MSEC__10_1_0_S1_S3 "Umrechnung von 10 msec in msec\\nint = ((phys * 1) / 10) - (0) msec" RAT_FUNC "%5.3" "msec" COEFFS 0 1 -0 0 0 10 /end COMPU_METHOD
/begin COMPU_METHOD UMR_U_1_1000_0_S1_S3 "int = ((phys * 1000) / 1) - (0) [V]" RAT_FUNC "%5.3" "[V]" COEFFS 0 1000 -0 0 0 1 /end COMPU_METHOD
/begin COMPU_METHOD UMR_VKMH__1_16_0_S1_S3 "Umrechnung von 1/16 km/h in km/h\\nint = ((phys * 16) / 1) - (0) km/h" RAT_FUNC "%5.3" "km/h" COEFFS 0 16 -0 0 0 1 /end COMPU_METHOD
/begin COMPU_METHOD UMR_RPM_1_1_0_S1_S3 "Umdrehung pro Minute\\nint = ((phys * 1) / 1) - (0) rpm" RAT_FUNC "%2.0" "rpm" COEFFS 0 1 -0 0 0 1 /end COMPU_METHOD
/begin COMPU_METHOD UMR___1_1_0_S1_S3 "Ohne Umskalierung\\nint = ((phys * 1) / 1) - (0) " RAT_FUNC "%2.0" "" COEFFS 0 1 -0 0 0 1 /end COMPU_METHOD
/begin COMPU_METHOD ePosDNRP_S1_S3 "" TAB_VERB "%2.0" "" COMPU_TAB_REF ePosDNRP_S1_S3 /end COMPU_METHOD
/begin COMPU_METHOD ePosPRND_S1_S3 "" TAB_VERB "%2.0" "" COMPU_TAB_REF ePosPRND_S1_S3 /end COMPU_METHOD
/begin COMPU_METHOD eLeverRel_S1_S3 "" TAB_VERB "%2.0" "" COMPU_TAB_REF eLeverRel_S1_S3 /end COMPU_METHOD
/begin COMPU_METHOD SBW_STANDARD_S1_S3 "int = ((phys * 1) / 1) - (0) -" RAT_FUNC "%2.0" "-" COEFFS 0 1 -0 0 0 1 /end COMPU_METHOD
/begin COMPU_METHOD SBW_TIMER_10MS_S1_S3 "int = ((phys * 1) / 10) - (0) ms" RAT_FUNC "%2.0" "ms" COEFFS 0 1 -0 0 0 10 /end COMPU_METHOD
/begin COMPU_METHOD SBW_HDK_M_S1_S3 "int = ((phys * 2550) / 1004) - (0) %" RAT_FUNC "%4.2" "%" COEFFS 0 2550 -0 0 0 1004 /end COMPU_METHOD
/begin COMPU_METHOD SBW_N_1_M_S1_S3 "int = ((phys * 1) / 1) - (0) 1/min" RAT_FUNC "%2.0" "1/min" COEFFS 0 1 -0 0 0 1 /end COMPU_METHOD
/begin COMPU_METHOD SBW_VKMH_16_S1_S3 "int = ((phys * 16) / 1) - (0) km/h" RAT_FUNC "%4.2" "km/h" COEFFS 0 16 -0 0 0 1 /end COMPU_METHOD
/begin COMPU_VTAB _CNV_S_7_Enum_EPOSM_211_S2 "" TAB_VERB 7 0 "WL" 1 "ZYK" 2 "STRAT" 3 "FWS1" 4 "FWS2" 5 "HH" 6 "WK" /end COMPU_VTAB
/begin COMPU_VTAB _CNV_S_6_Enum_EFWSI_233_S2 "" TAB_VERB 6 0 "KeinBerg" 1 "A1" 2 "A2" 3 "A3" 4 "A4" 5 "A5" /end COMPU_VTAB
/begin COMPU_VTAB _CNV_S_4_Enum_EGANG_234_S2 "" TAB_VERB 4 0 "POS_R" 1 "GANG_1" 2 "GANG_2" 3 "GANG_3" /end COMPU_VTAB
/begin COMPU_VTAB _CNV_S_9_Enum_ENICU_235_S2 "" TAB_VERB 9 0 "NIC_FFG" 1 "NIC_SOLLLL" 2 "NIC_DPFREG" 3 "NIC_STEIGUNG" 4 "NIC_TEMP" 5 "NIC_POSWECHSEL" 6 "NIC_MOTORDREHZAHL" 7 "NIC_KS" 8 "NIC_DRIVELOGIC" /end COMPU_VTAB
/begin COMPU_VTAB _CNV_S_2_Enum_ENICS_236_S2 "" TAB_VERB 2 0 "BERGAUF" 1 "BERGAB" /end COMPU_VTAB
/begin COMPU_VTAB ePosDNRP_S1_S3 "" TAB_VERB 4 0 "E_DNRP_D" 1 "E_DNRP_N" 2 "E_DNRP_R" 3 "E_DNRP_P" /end COMPU_VTAB
/begin COMPU_VTAB ePosPRND_S1_S3 "" TAB_VERB 4 0 "E_PRND_P" 1 "E_PRND_R" 2 "E_PRND_N" 3 "E_PRND_D" /end COMPU_VTAB
/begin COMPU_VTAB eLeverRel_S1_S3 "" TAB_VERB 7 0 "E_FFF" 1 "E_FF" 2 "E_F" 3 "E_NA" 4 "E_B" 5 "E_BB" 6 "E_BBB" /end COMPU_VTAB
/begin FUNCTION zff_ABK_SHIFTLOCK "desc_en"
 /begin LOC_MEASUREMENT ShiftLock.DrvReqPRND_SL ShiftLock.Shiftlock_Brake.cShiftlock_SubModule._.f_Active ShiftLock.Shiftlock_CAN.cShiftlock_SubModule._.f_Active ShiftLock.Shiftlock_Engine.cShiftlock_SubModule._.f_Active ShiftLock.Shiftlock_RemoteStart.cShiftlock_SubModule._.f_Active ShiftLock.f_CC_ShiftlockActive ShiftLock.f_DeactBySpeed ShiftLock.f_Shiftlock_Brake ShiftLock.f_Shiftlock_CAN ShiftLock.f_Shiftlock_Engine ShiftLock.f_Shiftlock_RemoteStart /end LOC_MEASUREMENT
/end FUNCTION
/begin FUNCTION zff_ABK_FASREQ2POS "desc_en"
 /begin LOC_MEASUREMENT FASReq2Pos.PosDrvAssistRaw_Old FASReq2Pos.PosDrvAssistRaw_Trig FASReq2Pos.PosDrvAssist_Filt FASReq2Pos.PosDrvAssist_Gate FASReq2Pos.PosDrvAssist_Gate_Old FASReq2Pos.PosFASReq FASReq2Pos.f_DAS_StoreP FASReq2Pos.f_DrvAssistPosModeErr FASReq2Pos.f_NoDrvAssist FASReq2Pos.f_NoDrvAssist_ViaSubstFunct FASReq2Pos.st_ModeDrvAssistTrans FASReq2Pos.st_ModeDrvAssistTrans_ /end LOC_MEASUREMENT
/end FUNCTION
/begin FUNCTION zff_ABK_DRVREQ2POS "desc_en" /begin LOC_MEASUREMENT DrvReq2Pos.PosDrvReq DrvReq2Pos.f_CC_Spd2HighP /end LOC_MEASUREMENT /end FUNCTION
/begin FUNCTION zff_ABK_DIAGPOS "desc_en"
 /begin LOC_MEASUREMENT DiagPos.PosAuto_Old DiagPos.PosPRND DiagPos.PosPRND_ DiagPos.PosPRND_Old DiagPos.PosStatus DiagPos.f_CC_DiagPosInWrongDrvDirTrig DiagPos.f_DrvAssistPosModeErr_Old DiagPos.f_PreAdaptationFailed DiagPos.f_RequestDiagP DiagPos.st_DiagPosEvent /end LOC_MEASUREMENT
/end FUNCTION
/begin FUNCTION zff_ABK_AUTOPOS "desc_en"
 /begin LOC_MEASUREMENT AutoPos.PosAuto AutoPos.f_CC_AutoPosPByDriverLeaveCar AutoPos.f_NoAutoPEMFHelp AutoPos.f_SpdBelowOrEqP_Th AutoPos.st_AutoPosEvent /end LOC_MEASUREMENT
/end FUNCTION
/begin FUNCTION zff_ABK_POS_INITPOS "desc_en"
 /begin LOC_MEASUREMENT InitPos.PosPRND_Init InitPos.st_InitPosChangeEvent InitPosBPRAM.f_RzN_LimphomeBuf InitPosBPRAM.f_RzN_LimphomeBuf_ /end LOC_MEASUREMENT
/end FUNCTION
/begin FUNCTION zff_ABK_PAK_SBWOUT "desc_en" /begin LOC_MEASUREMENT PAK_SBWOUT.PAK_SBWOUT_TEST /end LOC_MEASUREMENT /end FUNCTION
/begin FUNCTION zff_ABK_EWS4 "desc_en"
 /begin LOC_MEASUREMENT Ews4Measure.cnt_NrOfMissingResponses Ews4Measure.cnt_TASCASReq Ews4Measure.cnt_saved_eewrite_update_val Ews4Measure.f_FSCSignature_NonAuthentical Ews4Measure.f_at_least_one_nonauth_rsp_rxd Ews4Measure.f_client_enabled Ews4Measure.f_rsp_nonauthentic Ews4Measure.f_switchedCANpath_wait_fIgnOn Ews4Measure.fsc_check_routine_result Ews4Measure.fsc_ews4_actual_date Ews4Measure.fsc_ews4_old_date Ews4Measure.fsc_ews4_status Ews4Measure.rsp_err_cnt_A Ews4Measure.rsp_err_cnt_B Ews4Measure.rsp_err_cnt_C Ews4Measure.rsp_ok_cnt Ews4Measure.st_Ews4 Ews4Measure.st_Ews4IntSub Ews4Measure.st_Ews4Internal Ews4Measure.st_Ews4StoreEE Ews4Measure.st_Ews4_ChRspKf_TYP_ST Ews4Measure.st_FSC_Active Ews4Measure.st_actual_CAN_ch Ews4Measure.st_crypto_fctn_call Ews4Measure.uwb_ews4 /end LOC_MEASUREMENT
/end FUNCTION
/begin FUNCTION zff_ABK_EEPROM "desc_en"
 /begin LOC_MEASUREMENT EepromBPRAM.f_ForceEEPROM_Update EepromBPRAM.f_ForceEEPROM_Update_ EepromEws4ImmedWrap.EepromEws4Immediate.f_ews4_locked EepromEws4ImmedWrap.EepromEws4Immediate.f_ews4_locked_ EepromEws4ImmedWrap.EepromEws4Immediate.fsc_old_date EepromEws4ImmedWrap.EepromEws4Immediate.fsc_old_date_ EepromEws4ImmedWrap.EepromEws4Immediate.fsc_status EepromEws4ImmedWrap.EepromEws4Immediate.fsc_status_ EepromWrap.Eeprom.EgnerEnabledCnt.cEepromValue_ui8._.Complement EepromWrap.Eeprom.EgnerEnabledCnt.cEepromValue_ui8._.Value EepromWrap.Eeprom.EgnerFailedCnt.cEepromValue_ui8._.Complement EepromWrap.Eeprom.EgnerFailedCnt.cEepromValue_ui8._.Value EepromWrap.Eeprom.EgnerMisuseCnt.cEepromValue_ui8._.Complement EepromWrap.Eeprom.EgnerMisuseCnt.cEepromValue_ui8._.Value EepromWrap.Eeprom.cnt_AdaptivMode EepromWrap.Eeprom.cnt_AdaptivMode_ EepromWrap.Eeprom.cnt_AutoPEmf1 EepromWrap.Eeprom.cnt_AutoPEmf1_ EepromWrap.Eeprom.cnt_AutoPEmf2 EepromWrap.Eeprom.cnt_AutoPEmf2_ EepromWrap.Eeprom.cnt_AutoPEmf3 EepromWrap.Eeprom.cnt_AutoPEmf3_ EepromWrap.Eeprom.cnt_AutoP_DrvPresenceUnknown.Complement EepromWrap.Eeprom.cnt_AutoP_DrvPresenceUnknown.Value EepromWrap.Eeprom.cnt_DiagPosInWrongDrvDir.Complement EepromWrap.Eeprom.cnt_DiagPosInWrongDrvDir.Value EepromWrap.Eeprom.cnt_ID828.Complement EepromWrap.Eeprom.cnt_ID828.Value EepromWrap.Eeprom.cnt_InfoDAS_StoreP.Complement EepromWrap.Eeprom.cnt_InfoDAS_StoreP.Value EepromWrap.Eeprom.cnt_Init_Calls EepromWrap.Eeprom.cnt_Init_Calls_ EepromWrap.Eeprom.cnt_ManualMode EepromWrap.Eeprom.cnt_ManualMode_ EepromWrap.Eeprom.cnt_SportMode EepromWrap.Eeprom.cnt_SportMode_ EepromWrap.Eeprom.cnt_info_memory_entries EepromWrap.Eeprom.idx_last_drvLeavesCarInN_mem_entry EepromWrap.Eeprom.idx_last_drvLeavesCarInN_mem_entry_ EepromWrap.Eeprom.info_memory[0].errorID EepromWrap.Eeprom.info_memory[0].moduleID EepromWrap.Eeprom.info_memory[1].errorID EepromWrap.Eeprom.info_memory[1].moduleID EepromWrap.Eeprom.info_memory[2].errorID EepromWrap.Eeprom.info_memory[2].moduleID EepromWrap.Eeprom.info_memory[3].errorID EepromWrap.Eeprom.info_memory[3].moduleID EepromWrap.Eeprom.info_memory[4].errorID EepromWrap.Eeprom.info_memory[4].moduleID EepromWrap.Eeprom.info_memory[5].errorID EepromWrap.Eeprom.info_memory[5].moduleID EepromWrap.Eeprom.info_memory[6].errorID EepromWrap.Eeprom.info_memory[6].moduleID EepromWrap.Eeprom.info_memory[7].errorID EepromWrap.Eeprom.info_memory[7].moduleID EepromWrap.Eeprom.info_memory_checksum /end LOC_MEASUREMENT
/end FUNCTION
/begin FUNCTION zff_ABK_CARWASHMODE "desc_en" /begin LOC_MEASUREMENT CarwashMode.st_HoldN /end LOC_MEASUREMENT /end FUNCTION
/begin FUNCTION zff_ABK_MODE "desc_en"
 /begin LOC_MEASUREMENT Mode.ModeNext Mode.st_ModeChangeEvent Mode.st_StoreMode Mode.st_StoreModePosChange Mode.st_TipM Mode.st_TipP /end LOC_MEASUREMENT
/end FUNCTION
/begin FUNCTION zff_ABK_KOMBIMSGOUTBMW "desc_en"
 /begin LOC_MEASUREMENT KombiMsgOutOEM.CtlDispGear KombiMsgOutOEM.CtlDispMode KombiMsgOutOEM.CtlDispPos KombiMsgOutOEM.CtlDispPosFlash KombiMsgOutOEM.CtlDispPos_ /end LOC_MEASUREMENT
/end FUNCTION
/begin FUNCTION zff_ABK_L2_KOMBIMSGOUTOEM "desc_en"
 /begin LOC_MEASUREMENT L2_KombiMsgOutOEM.L2_DisplayPos.Complement L2_KombiMsgOutOEM.L2_DisplayPos.Value L2_KombiMsgOutOEM.L2_DisplayPosFlash.Complement L2_KombiMsgOutOEM.L2_DisplayPosFlash.Value /end LOC_MEASUREMENT
/end FUNCTION
/begin FUNCTION zff_ABK_POWERDOWN "desc_en" /begin LOC_MEASUREMENT PowerDown.f_PowDownEnable PowerDown.st_PowerDownDelay /end LOC_MEASUREMENT /end FUNCTION
/begin FUNCTION zff_ABK_SRVCMSGHANDLER "desc_en"
 /begin LOC_MEASUREMENT SrvcMsgHandler.LastSemaphore SrvcMsgHandler.MSA_Msg_Function_Requester SrvcMsgHandler.MSA_Msg_Function_Selection SrvcMsgHandler.cnt_NrOfOverdueMsgs SrvcMsgHandler.cnt_Send_Counter SrvcMsgHandler.st_SendMSA_MSg /end LOC_MEASUREMENT
/end FUNCTION
/begin FUNCTION zff_ABK_CC_MSG "desc_en"
 /begin LOC_MEASUREMENT CCMsg.IDEmpty.cCC_ID._.MsgOnceSent CCMsg.IDEmpty.cCC_ID._.MyIdx CCMsg.IDEmpty.cCC_ID._.f_ID_Locked CCMsg.IDEmpty.cCC_ID._.f_ID_Reset CCMsg.IDEmpty.cCC_ID._.st_ID CCMsg.ID_DrvLeavesCar.cCC_ID._.MsgOnceSent CCMsg.ID_DrvLeavesCar.cCC_ID._.MyIdx CCMsg.ID_DrvLeavesCar.cCC_ID._.f_ID_Locked CCMsg.ID_DrvLeavesCar.cCC_ID._.f_ID_Reset CCMsg.ID_DrvLeavesCar.cCC_ID._.st_ID CCMsg.ID_DrvLeavesCar.f_ID_DrvLeavesCar CCMsg.ID_DrvLeavesCar.f_PrematureReset CCMsg.ID_DrvLeavesCar_BeltLocked.cCC_ID._.MsgOnceSent CCMsg.ID_DrvLeavesCar_BeltLocked.cCC_ID._.MyIdx CCMsg.ID_DrvLeavesCar_BeltLocked.cCC_ID._.f_ID_Locked CCMsg.ID_DrvLeavesCar_BeltLocked.cCC_ID._.f_ID_Reset CCMsg.ID_DrvLeavesCar_BeltLocked.cCC_ID._.st_ID CCMsg.ID_DrvLeavesCar_BeltLocked.f_ID_DrvLeavesCar_BeltLocked CCMsg.ID_E_GNERActive.cCC_ID._.MsgOnceSent CCMsg.ID_E_GNERActive.cCC_ID._.MyIdx CCMsg.ID_E_GNERActive.cCC_ID._.f_ID_Locked CCMsg.ID_E_GNERActive.cCC_ID._.f_ID_Reset CCMsg.ID_E_GNERActive.cCC_ID._.st_ID CCMsg.ID_E_GNERActive.f_ID_E_GNERActive CCMsg.ID_GearboxWarning1.cCC_ID._.MsgOnceSent CCMsg.ID_GearboxWarning1.cCC_ID._.MyIdx CCMsg.ID_GearboxWarning1.cCC_ID._.f_ID_Locked CCMsg.ID_GearboxWarning1.cCC_ID._.f_ID_Reset CCMsg.ID_GearboxWarning1.cCC_ID._.st_ID CCMsg.ID_GearboxWarning1.f_ID_GearboxWarning1 CCMsg.ID_GearboxWarning2.cCC_ID._.MsgOnceSent CCMsg.ID_GearboxWarning2.cCC_ID._.MyIdx CCMsg.ID_GearboxWarning2.cCC_ID._.f_ID_Locked CCMsg.ID_GearboxWarning2.cCC_ID._.f_ID_Reset CCMsg.ID_GearboxWarning2.cCC_ID._.st_ID CCMsg.ID_GearboxWarning2.f_ID_GearboxWarning2 CCMsg.ID_GongBadOp.cCC_ID._.MsgOnceSent CCMsg.ID_GongBadOp.cCC_ID._.MyIdx CCMsg.ID_GongBadOp.cCC_ID._.f_ID_Locked CCMsg.ID_GongBadOp.cCC_ID._.f_ID_Reset CCMsg.ID_GongBadOp.cCC_ID._.st_ID CCMsg.ID_GongBadOp.f_ID_GongBadOp CCMsg.ID_GongInMechLimp.cCC_ID._.MsgOnceSent CCMsg.ID_GongInMechLimp.cCC_ID._.MyIdx CCMsg.ID_GongInMechLimp.cCC_ID._.f_ID_Locked CCMsg.ID_GongInMechLimp.cCC_ID._.f_ID_Reset CCMsg.ID_GongInMechLimp.cCC_ID._.st_ID CCMsg.ID_GongInMechLimp.f_ID_GongInMechLimp CCMsg.ID_GongWrongDrvDir.cCC_ID._.MsgOnceSent CCMsg.ID_GongWrongDrvDir.cCC_ID._.MyIdx CCMsg.ID_GongWrongDrvDir.cCC_ID._.f_ID_Locked CCMsg.ID_GongWrongDrvDir.cCC_ID._.f_ID_Reset CCMsg.ID_GongWrongDrvDir.cCC_ID._.st_ID CCMsg.ID_GongWrongDrvDir.f_ID_GongWrongDrvDir CCMsg.ID_Hotmode1.cCC_ID._.MsgOnceSent CCMsg.ID_Hotmode1.cCC_ID._.MyIdx CCMsg.ID_Hotmode1.cCC_ID._.f_ID_Locked CCMsg.ID_Hotmode1.cCC_ID._.f_ID_Reset CCMsg.ID_Hotmode1.cCC_ID._.st_ID CCMsg.ID_Hotmode1.f_ID_Hotmode1 CCMsg.ID_Hotmode2.cCC_ID._.MsgOnceSent CCMsg.ID_Hotmode2.cCC_ID._.MyIdx CCMsg.ID_Hotmode2.cCC_ID._.f_ID_Locked CCMsg.ID_Hotmode2.cCC_ID._.f_ID_Reset CCMsg.ID_Hotmode2.cCC_ID._.st_ID CCMsg.ID_Hotmode2.f_ID_Hotmode2 CCMsg.ID_Hotmode3.cCC_ID._.MsgOnceSent CCMsg.ID_Hotmode3.cCC_ID._.MyIdx CCMsg.ID_Hotmode3.cCC_ID._.f_ID_Locked CCMsg.ID_Hotmode3.cCC_ID._.f_ID_Reset CCMsg.ID_Hotmode3.cCC_ID._.st_ID CCMsg.ID_Hotmode3.f_ID_Hotmode3 CCMsg.ID_IgnitionError.cCC_ID._.MsgOnceSent CCMsg.ID_IgnitionError.cCC_ID._.MyIdx CCMsg.ID_IgnitionError.cCC_ID._.f_ID_Locked CCMsg.ID_IgnitionError.cCC_ID._.f_ID_Reset CCMsg.ID_IgnitionError.cCC_ID._.st_ID CCMsg.ID_IgnitionError.f_ID_IgnitionError CCMsg.ID_MechLimpInD.cCC_ID._.MsgOnceSent CCMsg.ID_MechLimpInD.cCC_ID._.MyIdx CCMsg.ID_MechLimpInD.cCC_ID._.f_ID_Locked CCMsg.ID_MechLimpInD.cCC_ID._.f_ID_Reset CCMsg.ID_MechLimpInD.cCC_ID._.st_ID CCMsg.ID_MechLimpInD.f_ID_MechLimpInD CCMsg.ID_MechLimpInP.cCC_ID._.MsgOnceSent CCMsg.ID_MechLimpInP.cCC_ID._.MyIdx CCMsg.ID_MechLimpInP.cCC_ID._.f_ID_Locked CCMsg.ID_MechLimpInP.cCC_ID._.f_ID_Reset CCMsg.ID_MechLimpInP.cCC_ID._.st_ID CCMsg.ID_MechLimpInP.f_ID_MechLimpInP CCMsg.ID_MechLimpInPNoRD.cCC_ID._.MsgOnceSent CCMsg.ID_MechLimpInPNoRD.cCC_ID._.MyIdx CCMsg.ID_MechLimpInPNoRD.cCC_ID._.f_ID_Locked CCMsg.ID_MechLimpInPNoRD.cCC_ID._.f_ID_Reset CCMsg.ID_MechLimpInPNoRD.cCC_ID._.st_ID CCMsg.ID_MechLimpInPNoRD.f_ID_MechLimpInPNoRD CCMsg.ID_PS_Abuse.cCC_ID._.MsgOnceSent CCMsg.ID_PS_Abuse.cCC_ID._.MyIdx CCMsg.ID_PS_Abuse.cCC_ID._.f_ID_Locked CCMsg.ID_PS_Abuse.cCC_ID._.f_ID_Reset CCMsg.ID_PS_Abuse.cCC_ID._.st_ID CCMsg.ID_PS_Abuse.f_ID_PS_Abuse CCMsg.ID_P_ButtonError.cCC_ID._.MsgOnceSent CCMsg.ID_P_ButtonError.cCC_ID._.MyIdx CCMsg.ID_P_ButtonError.cCC_ID._.f_ID_Locked CCMsg.ID_P_ButtonError.cCC_ID._.f_ID_Reset CCMsg.ID_P_ButtonError.cCC_ID._.st_ID CCMsg.ID_P_ButtonError.f_ID_P_ButtonError CCMsg.ID_ParkLockFault.cCC_ID._.MsgOnceSent CCMsg.ID_ParkLockFault.cCC_ID._.MyIdx CCMsg.ID_ParkLockFault.cCC_ID._.f_ID_Locked CCMsg.ID_ParkLockFault.cCC_ID._.f_ID_Reset CCMsg.ID_ParkLockFault.cCC_ID._.st_ID CCMsg.ID_ParkLockFault.f_ID_ParkLockFault CCMsg.ID_ParkLockFault_IEP_On.cCC_ID._.MsgOnceSent CCMsg.ID_ParkLockFault_IEP_On.cCC_ID._.MyIdx CCMsg.ID_ParkLockFault_IEP_On.cCC_ID._.f_ID_Locked CCMsg.ID_ParkLockFault_IEP_On.cCC_ID._.f_ID_Reset CCMsg.ID_ParkLockFault_IEP_On.cCC_ID._.st_ID CCMsg.ID_ParkLockFault_IEP_On.f_ID_ParkLockFault_IEP_On CCMsg.ID_ParkLockFault_InMechLimp.cCC_ID._.MsgOnceSent CCMsg.ID_ParkLockFault_InMechLimp.cCC_ID._.MyIdx CCMsg.ID_ParkLockFault_InMechLimp.cCC_ID._.f_ID_Locked CCMsg.ID_ParkLockFault_InMechLimp.cCC_ID._.f_ID_Reset CCMsg.ID_ParkLockFault_InMechLimp.cCC_ID._.st_ID CCMsg.ID_ParkLockFault_InMechLimp.f_ID_ParkLockFault_InMechLimp CCMsg.ID_PosN_Warning.cCC_ID._.MsgOnceSent CCMsg.ID_PosN_Warning.cCC_ID._.MyIdx CCMsg.ID_PosN_Warning.cCC_ID._.f_ID_Locked CCMsg.ID_PosN_Warning.cCC_ID._.f_ID_Reset CCMsg.ID_PosN_Warning.cCC_ID._.st_ID CCMsg.ID_PosN_Warning.f_ID_PosN_Warning CCMsg.ID_ShiftWithoutBrakeWarning.cCC_ID._.MsgOnceSent CCMsg.ID_ShiftWithoutBrakeWarning.cCC_ID._.MyIdx CCMsg.ID_ShiftWithoutBrakeWarning.cCC_ID._.f_ID_Locked CCMsg.ID_ShiftWithoutBrakeWarning.cCC_ID._.f_ID_Reset CCMsg.ID_ShiftWithoutBrakeWarning.cCC_ID._.st_ID CCMsg.ID_ShiftWithoutBrakeWarning.f_ID_ShiftWithoutBrakeWarning CCMsg.ID_ShifterError.cCC_ID._.MsgOnceSent CCMsg.ID_ShifterError.cCC_ID._.MyIdx CCMsg.ID_ShifterError.cCC_ID._.f_ID_Locked CCMsg.ID_ShifterError.cCC_ID._.f_ID_Reset CCMsg.ID_ShifterError.cCC_ID._.st_ID CCMsg.ID_ShifterError.f_ID_ShifterError CCMsg.ID_ShiftlockBrakeWarning.cCC_ID._.MsgOnceSent CCMsg.ID_ShiftlockBrakeWarning.cCC_ID._.MyIdx CCMsg.ID_ShiftlockBrakeWarning.cCC_ID._.f_ID_Locked CCMsg.ID_ShiftlockBrakeWarning.cCC_ID._.f_ID_Reset CCMsg.ID_ShiftlockBrakeWarning.cCC_ID._.st_ID CCMsg.ID_ShiftlockBrakeWarning.f_ID_ShiftlockBrakeWarning CCMsg.ID_Speed2HighForDrvReqP.cCC_ID._.MsgOnceSent CCMsg.ID_Speed2HighForDrvReqP.cCC_ID._.MyIdx CCMsg.ID_Speed2HighForDrvReqP.cCC_ID._.f_ID_Locked CCMsg.ID_Speed2HighForDrvReqP.cCC_ID._.f_ID_Reset CCMsg.ID_Speed2HighForDrvReqP.cCC_ID._.st_ID CCMsg.ID_Speed2HighForDrvReqP.f_ID_Speed2HighForDrvReqP CCMsg.ID_Speed2HighInPosP.cCC_ID._.MsgOnceSent CCMsg.ID_Speed2HighInPosP.cCC_ID._.MyIdx CCMsg.ID_Speed2HighInPosP.cCC_ID._.f_ID_Locked CCMsg.ID_Speed2HighInPosP.cCC_ID._.f_ID_Reset CCMsg.ID_Speed2HighInPosP.cCC_ID._.st_ID CCMsg.ID_Speed2HighInPosP.f_ID_Speed2HighInPosP CCMsg.ID_V_ImplausibleInPosP.cCC_ID._.MsgOnceSent CCMsg.ID_V_ImplausibleInPosP.cCC_ID._.MyIdx CCMsg.ID_V_ImplausibleInPosP.cCC_ID._.f_ID_Locked CCMsg.ID_V_ImplausibleInPosP.cCC_ID._.f_ID_Reset CCMsg.ID_V_ImplausibleInPosP.cCC_ID._.st_ID CCMsg.ID_V_ImplausibleInPosP.f_ID_V_ImplausibleInPosP CCMsgBPRAM.Bitmask_MsgSendHigh_Buf CCMsgBPRAM.Bitmask_MsgSendHigh_Buf_ CCMsgBPRAM.Bitmask_MsgSendLow_Buf CCMsgBPRAM.Bitmask_MsgSendLow_Buf_ cCC_ID._.f_CC_DrvExpectsP cID_ParkLockFault_IEP_On._.f_IgnOn_Old /end LOC_MEASUREMENT
/end FUNCTION
/begin FUNCTION zff_ABK_LEVEL2DIAG "desc_en"
 /begin LOC_MEASUREMENT DebounceMonitoring.L2_f_DiagposAutoposDetectedLastCycle.Complement DebounceMonitoring.L2_f_DiagposAutoposDetectedLastCycle.Value DebounceMonitoring.L2_f_WaitDrvReqRD2N.Complement DebounceMonitoring.L2_f_WaitDrvReqRD2N.Value DisplayMonitoring.L2_DisplayPos.Complement DisplayMonitoring.L2_DisplayPos.Value DisplayMonitoring.L2_DisplayPosFlash.Complement DisplayMonitoring.L2_DisplayPosFlash.Value DisplayMonitoring.L2_st_SetDispPosDark.Complement DisplayMonitoring.L2_st_SetDispPosDark.Value L2_DrvLeavesCar.L2_f_DrvLeavesCar.Complement L2_DrvLeavesCar.L2_f_DrvLeavesCar.Value L2_DrvLeavesCar.L2_f_DrvLeavesCarBrakeAccPed.Complement L2_DrvLeavesCar.L2_f_DrvLeavesCarBrakeAccPed.Value L2_DrvLeavesCar.L2_f_DrvLeavesCarDoorSeatb.Complement L2_DrvLeavesCar.L2_f_DrvLeavesCarDoorSeatb.Value L2_DrvReq.L2_DrvReqPRND_Filt.Complement L2_DrvReq.L2_DrvReqPRND_Filt.Value L2_DrvReq.L2_DrvReqPRND_Raw.Complement L2_DrvReq.L2_DrvReqPRND_Raw.Value L2_DrvReq.L2_DrvReqP_Trig.Complement L2_DrvReq.L2_DrvReqP_Trig.Value L2_DrvReq.L2_DrvReqP_old.Complement L2_DrvReq.L2_DrvReqP_old.Value L2_DrvReq.L2_DrvReq_Old.Complement L2_DrvReq.L2_DrvReq_Old.Value L2_DrvReq.L2_DrvReq_Raw.Complement L2_DrvReq.L2_DrvReq_Raw.Value L2_DrvReq.L2_DrvReq_Raw_ByRelativelever.Complement L2_DrvReq.L2_DrvReq_Raw_ByRelativelever.Value L2_DrvReq.L2_DrvReq_Trig.Complement L2_DrvReq.L2_DrvReq_Trig.Value L2_DrvReq.L2_GatePos_Old.Complement L2_DrvReq.L2_GatePos_Old.Value L2_DrvReq.L2_GatePos_Trig.Complement L2_DrvReq.L2_GatePos_Trig.Value L2_DrvReq.L2_MaxLeverpos.Complement L2_DrvReq.L2_MaxLeverpos.Value L2_DrvReq.L2_MaxLeverposIdx.Complement L2_DrvReq.L2_MaxLeverposIdx.Value L2_DrvReq.L2_PosDrvAssistRaw_Old.Complement L2_DrvReq.L2_PosDrvAssistRaw_Old.Value L2_DrvReq.L2_PosRawRelOld.Complement L2_DrvReq.L2_PosRawRelOld.Value L2_DrvReq.L2_StartPosPRND.Complement L2_DrvReq.L2_StartPosPRND.Value L2_DrvReq.L2_StartPosPRNDIdx.Complement L2_DrvReq.L2_StartPosPRNDIdx.Value L2_DrvReq.L2_st_RelToAbs_Stm.Complement L2_DrvReq.L2_st_RelToAbs_Stm.Value L2_EngineSignals.L2_f_EngOn.Complement L2_EngineSignals.L2_f_EngOn.Value L2_EngineSignals.L2_f_GearboxDrvRdy.Complement L2_EngineSignals.L2_f_GearboxDrvRdy.Value L2_EngineSignals.L2_f_GearboxReadySts_Old.Complement L2_EngineSignals.L2_f_GearboxReadySts_Old.Value L2_EngineSignals.L2_f_GearboxReady_Old.Complement L2_EngineSignals.L2_f_GearboxReady_Old.Value L2_EngineSignals.L2_f_Starter_IEP.Complement L2_EngineSignals.L2_f_Starter_IEP.Value L2_EngineSignals.L2_st_EngOn.Complement L2_EngineSignals.L2_st_EngOn.Value L2_EngineSignals.L2_st_EngOnOld.Complement L2_EngineSignals.L2_st_EngOnOld.Value L2_GlobalSignals.L2_IgnOnSts.Complement L2_GlobalSignals.L2_IgnOnSts.Value L2_GlobalSignals.L2_PosDrvAssistRawOld.Complement L2_GlobalSignals.L2_PosDrvAssistRawOld.Value L2_GlobalSignals.L2_f_BrakePedalSL.Complement L2_GlobalSignals.L2_f_BrakePedalSL.Value L2_GlobalSignals.L2_f_CtrlSignalSourceSts_Err.Complement L2_GlobalSignals.L2_f_CtrlSignalSourceSts_Err.Value L2_GlobalSignals.L2_f_IgnOn.Complement L2_GlobalSignals.L2_f_IgnOn.Value L2_GlobalSignals.L2_f_LeverInValidPos.Complement L2_GlobalSignals.L2_f_LeverInValidPos.Value L2_GlobalSignals.L2_f_MechLimp.Complement L2_GlobalSignals.L2_f_MechLimp.Value L2_GlobalSignals.L2_f_ParkLock.Complement L2_GlobalSignals.L2_f_ParkLock.Value L2_GlobalSignals.L2_f_ResyncNeeded.Complement L2_GlobalSignals.L2_f_ResyncNeeded.Value L2_GlobalSignals.L2_st_E_GNER.Complement L2_GlobalSignals.L2_st_E_GNER.Value L2_GlobalSignals.L2_st_E_GNEROld.Complement L2_GlobalSignals.L2_st_E_GNEROld.Value L2_GlobalSignals.L2_st_ModeDrvAssistTrans_PosChDep.Complement L2_GlobalSignals.L2_st_ModeDrvAssistTrans_PosChDep.Value L2_GlobalSignals.L2_v_VehSpdMin.Complement L2_GlobalSignals.L2_v_VehSpdMin.Value L2_InitPos.L2_PosPRND_Init.Complement L2_InitPos.L2_PosPRND_Init.Value L2_Interfi.L2_AcceleratorPedalAngle.Complement L2_Interfi.L2_AcceleratorPedalAngle.Value L2_Interfi.L2_AcceleratorPedalAngleSts.Complement L2_Interfi.L2_AcceleratorPedalAngleSts.Value L2_Interfi.L2_BrakePedalDrvAssistSts.Complement L2_Interfi.L2_BrakePedalDrvAssistSts.Value L2_Interfi.L2_CtrlSignalSourceSts.Complement L2_Interfi.L2_CtrlSignalSourceSts.Value L2_Interfi.L2_DoorDSts.Complement L2_Interfi.L2_DoorDSts.Value L2_Interfi.L2_GatePosRaw.Complement L2_Interfi.L2_GatePosRaw.Value L2_Interfi.L2_GearboxDrvRdySts.Complement L2_Interfi.L2_GearboxDrvRdySts.Value L2_Interfi.L2_IgnOnRawSts.Complement L2_Interfi.L2_IgnOnRawSts.Value L2_Interfi.L2_ModeDrvAssistVehSts.Complement L2_Interfi.L2_ModeDrvAssistVehSts.Value L2_Interfi.L2_PSensor.Complement L2_Interfi.L2_PSensor.Value L2_Interfi.L2_PSensorSts.Complement L2_Interfi.L2_PSensorSts.Value L2_Interfi.L2_PosDrvAssistRaw.Complement L2_Interfi.L2_PosDrvAssistRaw.Value L2_Interfi.L2_PosDrvAssistRawSts.Complement L2_Interfi.L2_PosDrvAssistRawSts.Value L2_Interfi.L2_PosRaw.Complement L2_Interfi.L2_PosRaw.Value L2_Interfi.L2_SeatBeltSts.Complement L2_Interfi.L2_SeatBeltSts.Value L2_Interfi.L2_VehicleDrvRdy.Complement L2_Interfi.L2_VehicleDrvRdy.Value L2_Interfi.L2_VehicleDrvRdySts.Complement L2_Interfi.L2_VehicleDrvRdySts.Value L2_Interfi.L2_f_BrakePedalDrvAssist.Complement L2_Interfi.L2_f_BrakePedalDrvAssist.Value L2_Interfi.L2_f_DoorD.Complement L2_Interfi.L2_f_DoorD.Value L2_Interfi.L2_f_ModeDrvAssistVeh.Complement L2_Interfi.L2_f_ModeDrvAssistVeh.Value L2_Interfi.L2_f_P12Button.Complement L2_Interfi.L2_f_P12Button.Value L2_Interfi.L2_f_SeatBelt.Complement L2_Interfi.L2_f_SeatBelt.Value L2_Interfi.L2_f_V_Implausible.Complement L2_Interfi.L2_f_V_Implausible.Value L2_Interfi.L2_n_AbRaw.Complement L2_Interfi.L2_n_AbRaw.Value L2_Interfi.L2_st_GearboxDrvRdy.Complement L2_Interfi.L2_st_GearboxDrvRdy.Value L2_Interfi.L2_st_IgnOnRaw.Complement L2_Interfi.L2_st_IgnOnRaw.Value L2_Interfi.L2_st_LeverType.Complement L2_Interfi.L2_st_LeverType.Value L2_Interfi.L2_st_Limphome.Complement L2_Interfi.L2_st_Limphome.Value L2_Interfi.L2_v_VehSpd_nab.Complement L2_Interfi.L2_v_VehSpd_nab.Value Level2Diag.L2_f_D_Tab_RelToAbsConversion_differs.Complement Level2Diag.L2_f_D_Tab_RelToAbsConversion_differs.Value Level2Signals.L2_PosPRND_Old.Complement Level2Signals.L2_PosPRND_Old.Value Level2Signals.L2_PosPRND_PreviousOld.Complement Level2Signals.L2_PosPRND_PreviousOld.Value Level2Signals.L2_PosPRND_Trig.Complement Level2Signals.L2_PosPRND_Trig.Value PosMonitoring.L2_Max_D_t_StoreN.Complement PosMonitoring.L2_Max_D_t_StoreN.Value UnintendedTraction.L2_Max_D_t_StoreD.Complement UnintendedTraction.L2_Max_D_t_StoreD.Value UnintendedTraction.L2_Max_D_t_StoreD_WithoutLatencyPeriod.Complement UnintendedTraction.L2_Max_D_t_StoreD_WithoutLatencyPeriod.Value UnintendedTraction.L2_Max_D_t_StoreR.Complement UnintendedTraction.L2_Max_D_t_StoreR.Value UnintendedTraction.L2_Max_D_t_StoreR_WithoutLatencyPeriod.Complement UnintendedTraction.L2_Max_D_t_StoreR_WithoutLatencyPeriod.Value UnintendedTraction.L2_f_Allow_tmr_D_Request_Compute.Complement UnintendedTraction.L2_f_Allow_tmr_D_Request_Compute.Value UnintendedTraction.L2_f_Allow_tmr_R_Request_Compute.Complement UnintendedTraction.L2_f_Allow_tmr_R_Request_Compute.Value UnintendedTraction.L2_f_ShiftlockDeactBySpeed.Complement UnintendedTraction.L2_f_ShiftlockDeactBySpeed.Value UnintendedTraction.L2_f_Shiftlock_Brake.Complement UnintendedTraction.L2_f_Shiftlock_Brake.Value /end LOC_MEASUREMENT
/end FUNCTION
/begin FUNCTION zff_ABK_TESTERACCESS "desc_en"
 /begin LOC_MEASUREMENT TesterAccess.DiagTestLever TesterAccess.DiagTestSBW TesterAccess.DiagTestSteptronic TesterAccess.Faulttype TesterAccess.st_VehicleAutoP /end LOC_MEASUREMENT
/end FUNCTION
/begin FUNCTION zff_ABK_INTOSCALLSRAM "desc_en"
 /begin LOC_MEASUREMENT IntOsCallsRAM.f_erase_infomemory IntOsCallsRAM.f_sbwInitialized /end LOC_MEASUREMENT
/end FUNCTION
/begin FUNCTION zff_ABK_STARTERRELEASE "desc_en"
 /begin LOC_MEASUREMENT StarterRelease.StrtRlsBrake StarterRelease.StrtRlsDelayTmr StarterRelease.StrtRlsDisplayPos StarterRelease.StrtRlsEngine StarterRelease.StrtRlsGbxFault StarterRelease.StrtRlsIgnition StarterRelease.StrtRlsParklockState StarterRelease.StrtRlsPosPRND StarterRelease.StrtRlsPowerDown StarterRelease.StrtRlsShifterPos StarterRelease.f_StrtRlsBrake StarterRelease.f_StrtRlsDelayTmr StarterRelease.f_StrtRlsDisplayPos StarterRelease.f_StrtRlsEngine StarterRelease.f_StrtRlsGbxFault StarterRelease.f_StrtRlsIgnition StarterRelease.f_StrtRlsParklockState StarterRelease.f_StrtRlsPosPRND StarterRelease.f_StrtRlsPowerDown StarterRelease.f_StrtRlsShifterPos StarterRelease.st_Index_Tab_StrtRls StarterRelease.st_StarterRelease StarterRelease.st_StarterRelease_ /end LOC_MEASUREMENT
/end FUNCTION
/begin FUNCTION zff_ABK_STARTERRELEASEBPRAM "desc_en"
 /begin LOC_MEASUREMENT StarterReleaseBPRam.f_DelayCrankInMechLimpBPRam StarterReleaseBPRam.f_DelayCrankInMechLimpBPRam_ /end LOC_MEASUREMENT
/end FUNCTION
/begin FUNCTION zff_ABK_STATISTICCOUNTER "desc_en"
 /begin LOC_MEASUREMENT StatisticCounter.cnt_AdaptiveMode StatisticCounter.cnt_ManualMode StatisticCounter.cnt_SportLevel StatisticCounter.cnt_SportMode /end LOC_MEASUREMENT
/end FUNCTION
/begin FUNCTION zff_ABK_GEARBOXSTATE "desc_en" /begin LOC_MEASUREMENT GearboxState.st_Gearbox /end LOC_MEASUREMENT /end FUNCTION
/begin FUNCTION zff_SBW_Applikationsgroessen "all calibration values of E/M-Schaltung"
 /begin SUB_FUNCTION AutoPos CarwashMode DebounceDrvReq DrvPresenceDetector EngineSignals FASReq2Pos InitPos KombiMsgGear KombiMsgMode KombiMsgPos Level2Diag Level2DiagLev1Section ModeChTable ModeIn RelToAbs SigCond SrvcMsgHandler StarterRelease StarterReleaseDelay StoreDrvReq cc_msg diagpos ews4 kombi_msg mode powerdown shiftlock signals /end SUB_FUNCTION
/end FUNCTION
/begin FUNCTION AutoPos ""
 /begin DEF_CHARACTERISTIC D_st_VehDrvRdy D_v_AutoN_Engine_Off_Uth D_v_AutoP_DrvLeavesCar D_v_AutoP_DrvPresenceUnknown_Uth D_v_AutoP_Uth D_v_EnableAutoPHelp SWI_AutoN_EngineRot_Depend SWI_AutoP_Auto_N_but_P_Engaged SWI_AutoP_DriverPresenceUnknown SWI_AutoP_DrvLeavesCar SWI_AutoP_EMF_Help SWI_AutoPos SWI_AutoPosP_ByChargingPlug /end DEF_CHARACTERISTIC
/end FUNCTION
/begin FUNCTION CarwashMode "" /begin DEF_CHARACTERISTIC D_v_HoldN /end DEF_CHARACTERISTIC /end FUNCTION
/begin FUNCTION DebounceDrvReq "" /begin DEF_CHARACTERISTIC D_t_DebounceNA2N D_t_DebounceRD2N D_v_DebounceNA2NUth /end DEF_CHARACTERISTIC /end FUNCTION
/begin FUNCTION DrvPresenceDetector ""
 /begin DEF_CHARACTERISTIC D_t_DrvLeavesCarInN SWI_CC_DrvLeavesCarBeltLocked SWI_DriverPresenceDetectionByTCU /end DEF_CHARACTERISTIC
/end FUNCTION
/begin FUNCTION EngineSignals "" /begin DEF_CHARACTERISTIC D_t_DebounceGearboxReady D_t_DebounceGearboxReadySts /end DEF_CHARACTERISTIC /end FUNCTION
/begin FUNCTION FASReq2Pos ""
 /begin DEF_CHARACTERISTIC D_t_PosDrvAssistFilt SWI_DAS_StoreP SWI_FAS_Active SWI_NoDrvAssist_ViaSubstFunct SWI_NoDrvAssist_ViaSubstFunct_Hi /end DEF_CHARACTERISTIC
/end FUNCTION
/begin FUNCTION InitPos ""
 /begin DEF_CHARACTERISTIC D_n_Ab_Init_PosP D_v_DrvDir_Lth D_v_VehSpd_InitPosD_RzN D_v_VehSpd_Init_PosD SWI_DrvDirBackupAccepted SWI_DrvDirPosPRNDAccepted SWI_InitPosByBistableParklock SWI_InitPosD SWI_InitPosD_RzN_SbwShifter SWI_InitPosN_RzN_SbwShifter SWI_InitPosP_PrioByPSensor SWI_RESUB_PathMechLimp SWI_RESUB_PathResUBatt /end DEF_CHARACTERISTIC
/end FUNCTION
/begin FUNCTION KombiMsgGear ""
 /begin DEF_CHARACTERISTIC D_GearSourceAtFlashOffEngRunning D_GearSourceAtFlashOnEngRunning /end DEF_CHARACTERISTIC
/end FUNCTION
/begin FUNCTION KombiMsgMode "" /begin DEF_CHARACTERISTIC SWI_DispMode /end DEF_CHARACTERISTIC /end FUNCTION
/begin FUNCTION KombiMsgPos "" /begin DEF_CHARACTERISTIC SWI_DispExtension SWI_DispPosInStandby /end DEF_CHARACTERISTIC /end FUNCTION
/begin FUNCTION Level2Diag ""
 /begin DEF_CHARACTERISTIC D_AcceleratorPedalAngleTh_L2 D_Tab_RelToAbsConversion_L2 D_n_Ab_Init_PosP_L2 D_t_DebounceGearboxReadySts_L2 D_t_DebounceGearboxReady_L2 D_t_DebounceNA2N_L2 D_t_DebounceRD2N_L2 D_t_FlashN_L2 D_t_Lev2DispError D_t_Lev2DispError_L2 D_t_Lev2PosError_L2 D_t_PosDrvAssistReject_L2 D_t_StoreD_L2 D_t_StoreN_EGNER_L2 D_t_StoreN_L2 D_t_StoreRD_EngStart_L2 D_t_StoreR_L2 D_v_AutoN_Engine_Off_Uth_L2 D_v_AutoN_Uth_L2 D_v_AutoP_DrvLeavesCar_L2 D_v_AutoP_Uth_L2 D_v_D_Lth_L2 D_v_N_Uth_L2 D_v_P_Lth_L2 D_v_R_Lth_L2 D_v_R_Uth_L2 D_v_Shiftlock_Uth_L2 D_v_VehSpd_InitPosD_RzN_L2 D_v_VehSpd_Init_PosD_L2 SWI_AutoN_EngineRot_Depend_L2 SWI_AutoP_DrvLeavesCar_L2 SWI_AutoPos_L2 SWI_DiagPosByVimplausible_L2 SWI_FAS_Active_L2 SWI_IgnoreLeverActionAfterPPressed_L2 SWI_InitPosByBistableParklock_L2 SWI_InitPosD_L2 SWI_InitPosD_RzN_SbwShifter_L2 SWI_InitPosN_RzN_SbwShifter_L2 SWI_InitPosP_PrioByPSensor_L2 SWI_KL15_PinPlausiOn_L2 SWI_RESUB_PathMechLimp_L2 SWI_RESUB_PathResUBatt_L2 SWI_RelToAbsUsesDisplayPosIfNotDark_L2 SWI_StoreRD_RestartTimerWhileShifterInRD_L2 /end DEF_CHARACTERISTIC
/end FUNCTION
/begin FUNCTION Level2DiagLev1Section "" /begin DEF_CHARACTERISTIC D_t_PosDrvAssistReject_L1 /end DEF_CHARACTERISTIC /end FUNCTION
/begin FUNCTION ModeChTable ""
 /begin DEF_CHARACTERISTIC D_ModeIfDriveLogic D_ModeIfDrvReqD D_ModeIfLowMode D_ModeIfLowModeInvalid D_ModeIfMGateAndTempMan D_ModeIfMGateOff D_ModeIfMGateOn D_ModeIfSportButton D_ModeIfTimerExpiredTip1 D_ModeIfTimerExpiredTip2 D_ModeIfTip1 D_ModeIfTip2 /end DEF_CHARACTERISTIC
/end FUNCTION
/begin FUNCTION ModeIn "" /begin DEF_CHARACTERISTIC D_t_DelayAdaptiveToManual D_t_DelayManualToAdaptive /end DEF_CHARACTERISTIC /end FUNCTION
/begin FUNCTION RelToAbs ""
 /begin DEF_CHARACTERISTIC D_Tab_RelToAbsConversion SWI_RelToAbsUsesDisplayPosIfNotDark /end DEF_CHARACTERISTIC
/end FUNCTION
/begin FUNCTION SigCond ""
 /begin DEF_CHARACTERISTIC D_t_DiagSysPressureEng D_t_DiagSysPressureEngStart D_t_DiagSysPressureHIS D_t_PEngaged D_t_PEngagedAfterEngStart D_u_UMV3_KFC_PSINOUT_Th D_v_PSAbuse /end DEF_CHARACTERISTIC
/end FUNCTION
/begin FUNCTION SrvcMsgHandler "" /begin DEF_CHARACTERISTIC D_MSA_ID_Byte4 D_ident_snr_rsyncn_navi SWI_SrvcMsg_Enable /end DEF_CHARACTERISTIC /end FUNCTION
/begin FUNCTION StarterRelease ""
 /begin DEF_CHARACTERISTIC D_Tab_StrtRlsBrake D_Tab_StrtRlsDelayTmr D_Tab_StrtRlsDisplayPos D_Tab_StrtRlsEngine D_Tab_StrtRlsGbxFault D_Tab_StrtRlsIgnition D_Tab_StrtRlsParklockState D_Tab_StrtRlsPosPRND D_Tab_StrtRlsPowerDown D_Tab_StrtRlsShifterPos D_Tab_StrtRlsStarterRelease /end DEF_CHARACTERISTIC
/end FUNCTION
/begin RECORD_LAYOUT ZF_Parameter.ui8_S1_S3 FNC_VALUES 1 UBYTE ROW_DIR DIRECT /end RECORD_LAYOUT
/begin RECORD_LAYOUT ZF_Parameter.ui16_S1_S3 FNC_VALUES 1 UWORD ROW_DIR DIRECT /end RECORD_LAYOUT
/begin RECORD_LAYOUT ZF_Parameter.ui32_S1_S3 FNC_VALUES 1 ULONG ROW_DIR DIRECT /end RECORD_LAYOUT
/begin RECORD_LAYOUT ZF_Matrix.ui8_S1_S3 FNC_VALUES 1 UBYTE ROW_DIR DIRECT /end RECORD_LAYOUT
/begin RECORD_LAYOUT ZF_Table.ui8_S1_S3 FNC_VALUES 1 UBYTE ROW_DIR DIRECT /end RECORD_LAYOUT
/end MODULE
/end PROJECT
