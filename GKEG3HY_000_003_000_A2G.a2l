ASAP2_VERSION 1 51
/begin PROJECT _929_929 "Gen2_BMW_System_Supplier_Lib"
/begin HEADER "" VERSION "C_03_03" PROJECT_NO _929_929 /end HEADER
/begin MODULE DIM ""
/begin MOD_COMMON "" BYTE_ORDER MSB_FIRST ALIGNMENT_BYTE 1 ALIGNMENT_WORD 2 ALIGNMENT_LONG 4 ALIGNMENT_FLOAT32_IEEE 4 /end MOD_COMMON
/begin CHARACTERISTIC T_RAMEESP64 "Dauer Rampe ME bei Schaltungsende" VALUE 0x26E5CD kw_ui8_S6_S3 2540 UMR_MSEC__10_1_0_S6_S3 0 2540 /end CHARACTERISTIC
/begin CHARACTERISTIC T_RAMEESP64_EL "Dauer Rampe ME bei Schaltungsende" VALUE 0x26E5CE kw_ui8_S6_S3 2540 UMR_MSEC__10_1_0_S6_S3 0 2540 /end CHARACTERISTIC
/begin CHARACTERISTIC KL_FMENACHESP64 "Faktor fuer Rampe Ende Nach-ME bei RS" CURVE 0x231C34 kl_ui8_S6_S3 1 UMR___1_100_0_S6_S3 0 1
 /begin AXIS_DESCR STD_AXIS iMoeMesaf.timer_zmes UMR_MSEC__10_1_0_S6_S3 4 0 2550 DEPOSIT ABSOLUTE MONOTONY MON_INCREASE /end AXIS_DESCR
/end CHARACTERISTIC
/begin CHARACTERISTIC T_SYNMENACHESP64 "Zeit vor/nach Erkennen synchron fuer Ende Nach-ME" VALUE 0x26E5CF kw_ui8_S6_S3 2550 UMR_MSEC__10_1_M128_S6_S3 -1280 1270 /end CHARACTERISTIC
/begin CHARACTERISTIC T_SYNMENACHESP64_EL "Zeit vor/nach Erkennen synchron fuer Ende Nach-ME" VALUE 0x26E5D0 kw_ui8_S6_S3 2550 UMR_MSEC__10_1_M128_S6_S3 -1280 1270 /end CHARACTERISTIC
/begin CHARACTERISTIC KF_TSYNMENACHASP64 "Zeit vor Erkennen synchron fuer Ende Haupt-ME und Start Nach-ME" MAP 0x231C40 kf_ui8_S6_S3 1280 UMR_MSEC__10_1_M128_S6_S3 -1280 0
 /begin AXIS_DESCR STD_AXIS zff_atsys._.iSignale._.obj.sig_n_mot8 UMR_U_MIN_32_1_0_S6_S3 4 0 8160 DEPOSIT ABSOLUTE MONOTONY MON_INCREASE /end AXIS_DESCR
 /begin AXIS_DESCR STD_AXIS zff_atsys._.iSignale._.obj.sig_m_t8 UMR_NM__8_1_M50_S6_S3 3 -400 1640 DEPOSIT ABSOLUTE MONOTONY MON_INCREASE /end AXIS_DESCR
/end CHARACTERISTIC
/begin CHARACTERISTIC KF_TSYNMENACHASP64_EL "Zeit vor Erkennen synchron fuer Ende Haupt-ME und Start Nach-ME" MAP 0x231C5C kf_ui8_S6_S3 1280 UMR_MSEC__10_1_M128_S6_S3 -1280 0
 /begin AXIS_DESCR STD_AXIS zff_atsys._.iSignale._.obj.sig_n_mot8 UMR_U_MIN_32_1_0_S6_S3 4 0 8160 DEPOSIT ABSOLUTE MONOTONY MON_INCREASE /end AXIS_DESCR
 /begin AXIS_DESCR STD_AXIS zff_atsys._.iSignale._.obj.sig_m_t8 UMR_NM__8_1_M50_S6_S3 3 -400 1640 DEPOSIT ABSOLUTE MONOTONY MON_INCREASE /end AXIS_DESCR
/end CHARACTERISTIC
/begin CHARACTERISTIC KF_MENACHSP64 "Nachmotoreingriff Schaltablauf" MAP 0x231C78 kf_ui8_S6_S3 870 UMR_NM__6_1_M145_S6_S3 -870 0
 /begin AXIS_DESCR STD_AXIS iSasZentr.iSchaltend.n_tkf UMR_U_MIN_32_1_0_S6_S3 6 0 8160 DEPOSIT ABSOLUTE MONOTONY MON_INCREASE /end AXIS_DESCR
 /begin AXIS_DESCR STD_AXIS zff_atsys._.iSignale._.obj.sig_m_t8 UMR_NM__8_1_M50_S6_S3 6 -400 1640 DEPOSIT ABSOLUTE MONOTONY MON_INCREASE /end AXIS_DESCR
/end CHARACTERISTIC
/begin CHARACTERISTIC KF_MENACHSP64_EL "Nachmotoreingriff Schaltablauf" MAP 0x231CB0 kf_ui8_S6_S3 870 UMR_NM__6_1_M145_S6_S3 -870 0
 /begin AXIS_DESCR STD_AXIS iSasZentr.iSchaltend.n_tkf UMR_U_MIN_32_1_0_S6_S3 6 0 8160 DEPOSIT ABSOLUTE MONOTONY MON_INCREASE /end AXIS_DESCR
 /begin AXIS_DESCR STD_AXIS zff_atsys._.iSignale._.obj.sig_m_t8 UMR_NM__8_1_M50_S6_S3 6 -400 1640 DEPOSIT ABSOLUTE MONOTONY MON_INCREASE /end AXIS_DESCR
/end CHARACTERISTIC
/begin CHARACTERISTIC KF_FMTMEHAUPTASP64 "Faktor fuer Rampe auf HME bei RS" MAP 0x231CE8 kf_ui8_S6_S3 1 UMR___1_100_0_S6_S3 0 1
 /begin AXIS_DESCR STD_AXIS iMoeMesaf.timer_zmes UMR_MSEC__10_1_0_S6_S3 4 0 2550 DEPOSIT ABSOLUTE MONOTONY MON_INCREASE /end AXIS_DESCR
 /begin AXIS_DESCR STD_AXIS zff_atsys._.iSignale._.obj.sig_m_t8 UMR_NM__8_1_M50_S6_S3 4 -400 1640 DEPOSIT ABSOLUTE MONOTONY MON_INCREASE /end AXIS_DESCR
/end CHARACTERISTIC
/begin CHARACTERISTIC KF_MEHAUPTSP64 "Wert Hauptmotoreingriff" MAP 0x231D08 kf_ui8_S6_S3 1530 UMR_NM__6_1_M145_S6_S3 -870 660
 /begin AXIS_DESCR STD_AXIS NO_INPUT_QUANTITY UMR_U_MIN_32_1_0_S6_S3 6 0 8160 DEPOSIT ABSOLUTE MONOTONY MON_INCREASE /end AXIS_DESCR
 /begin AXIS_DESCR STD_AXIS zff_atsys._.iSignale._.obj.sig_m_t8 UMR_NM__8_1_M50_S6_S3 10 -400 1640 DEPOSIT ABSOLUTE MONOTONY MON_INCREASE /end AXIS_DESCR
/end CHARACTERISTIC
/begin CHARACTERISTIC KF_MEHAUPTSP64_EL "Wert Hauptmotoreingriff" MAP 0x231D5C kf_ui8_S6_S3 1530 UMR_NM__6_1_M145_S6_S3 -870 660
 /begin AXIS_DESCR STD_AXIS NO_INPUT_QUANTITY UMR_U_MIN_32_1_0_S6_S3 6 0 8160 DEPOSIT ABSOLUTE MONOTONY MON_INCREASE /end AXIS_DESCR
 /begin AXIS_DESCR STD_AXIS zff_atsys._.iSignale._.obj.sig_m_t8 UMR_NM__8_1_M50_S6_S3 10 -400 1640 DEPOSIT ABSOLUTE MONOTONY MON_INCREASE /end AXIS_DESCR
/end CHARACTERISTIC
/begin CHARACTERISTIC KF_TVMTNMOTMEHAUPTSP64 "Verzoegerungszeit Start Haupt-ME bei Momentenerhoehung" MAP 0x231DB0 kf_ui8_S6_S3 2540 UMR_MSEC__10_1_0_S6_S3 0 2540
 /begin AXIS_DESCR STD_AXIS zff_atsys._.iSignale._.obj.sig_m_t8 UMR_NM__8_1_M50_S6_S3 4 -400 1640 DEPOSIT ABSOLUTE MONOTONY MON_INCREASE /end AXIS_DESCR
 /begin AXIS_DESCR STD_AXIS zff_atsys._.iSignale._.obj.sig_n_mot8 UMR_U_MIN_32_1_0_S6_S3 4 0 8160 DEPOSIT ABSOLUTE MONOTONY MON_INCREASE /end AXIS_DESCR
/end CHARACTERISTIC
/begin CHARACTERISTIC KL_FMEPOSNGABSP64 "Faktor zur Gewichtung pos. ME" CURVE 0x231DD0 kl_si16_S6_S3 1 UMR___1_100_0_S6_S3 0 1
 /begin AXIS_DESCR STD_AXIS iMoeMesaf.ng_abmesas UMR_U_MINSEC_1_1_0_S6_S3 6 -1000 1000 DEPOSIT ABSOLUTE MONOTONY MON_INCREASE /end AXIS_DESCR
/end CHARACTERISTIC
/begin CHARACTERISTIC KF_TSYNNTKFMTMEHAUPTESP64 "Zeitkriterium Ende Haupt-ME bei Momentenerhoehung" MAP 0x231DEC kf_ui8_S6_S3 1280 UMR_MSEC__10_1_M128_S6_S3 -1280 0
 /begin AXIS_DESCR STD_AXIS iSasZentr.iSchaltend.n_tkf UMR_U_MIN_32_1_0_S6_S3 4 0 8160 DEPOSIT ABSOLUTE MONOTONY MON_INCREASE /end AXIS_DESCR
 /begin AXIS_DESCR STD_AXIS zff_atsys._.iSignale._.obj.sig_m_t8 UMR_NM__8_1_M50_S6_S3 4 -400 1640 DEPOSIT ABSOLUTE MONOTONY MON_INCREASE /end AXIS_DESCR
/end CHARACTERISTIC
/begin CHARACTERISTIC KF_FMESASMEHAUPTPOSESP64 "Faktor fuer Reduzierung pos ME bei RS" MAP 0x231E0C kf_si16_S6_S3 1 UMR___1_100_0_S6_S3 0 1
 /begin AXIS_DESCR STD_AXIS iSasZentr.iSchaltend.t_syn UMR_MSEC__10_1_0_S6_S3 4 -327680 327670 DEPOSIT ABSOLUTE MONOTONY MON_INCREASE /end AXIS_DESCR
 /begin AXIS_DESCR STD_AXIS iMoeMesaf.me_sas_gesp UMR_NM__1_1_0_S6_S3 4 0 2000 DEPOSIT ABSOLUTE MONOTONY MON_INCREASE /end AXIS_DESCR
/end CHARACTERISTIC
/begin CHARACTERISTIC KF_FMENACHPOSESP64 "Faktor fuer Reduzierung pos ME bei RS" MAP 0x231E44 kf_si16_S6_S3 1 UMR___1_100_0_S6_S3 0 1
 /begin AXIS_DESCR STD_AXIS iMoeMesaf.timer_tsyn_rampe_pos UMR_MSEC__10_1_0_S6_S3 4 -50000 50000 DEPOSIT ABSOLUTE MONOTONY MON_INCREASE /end AXIS_DESCR
 /begin AXIS_DESCR STD_AXIS iMoeMesaf.me_sas_gesp UMR_NM__1_1_0_S6_S3 4 0 2000 DEPOSIT ABSOLUTE MONOTONY MON_INCREASE /end AXIS_DESCR
/end CHARACTERISTIC
/begin CHARACTERISTIC T_RAMEESP71 "Dauer Rampe ME bei Schaltungsende" VALUE 0x26E5D1 kw_ui8_S6_S3 2540 UMR_MSEC__10_1_0_S6_S3 0 2540 /end CHARACTERISTIC
/begin CHARACTERISTIC KL_FMENACHESP71 "Faktor fuer Rampe Ende Nach-ME bei RS" CURVE 0x231E7C kl_ui8_S6_S3 1 UMR___1_100_0_S6_S3 0 1
 /begin AXIS_DESCR STD_AXIS iMoeMesaf.timer_zmes UMR_MSEC__10_1_0_S6_S3 4 0 2550 DEPOSIT ABSOLUTE MONOTONY MON_INCREASE /end AXIS_DESCR
/end CHARACTERISTIC
/begin CHARACTERISTIC T_SYNMENACHESP71 "Zeit vor/nach Erkennen synchron fuer Ende Nach-ME" VALUE 0x26E5D2 kw_ui8_S6_S3 2550 UMR_MSEC__10_1_M128_S6_S3 -1280 1270 /end CHARACTERISTIC
/begin CHARACTERISTIC KF_TSYNMENACHASP71 "Zeit vor Erkennen synchron fuer Ende Haupt-ME und Start Nach-ME" MAP 0x231E88 kf_ui8_S6_S3 1280 UMR_MSEC__10_1_M128_S6_S3 -1280 0
 /begin AXIS_DESCR STD_AXIS zff_atsys._.iSignale._.obj.sig_n_mot8 UMR_U_MIN_32_1_0_S6_S3 4 0 8160 DEPOSIT ABSOLUTE MONOTONY MON_INCREASE /end AXIS_DESCR
 /begin AXIS_DESCR STD_AXIS zff_atsys._.iSignale._.obj.sig_m_t8 UMR_NM__8_1_M50_S6_S3 3 -400 1640 DEPOSIT ABSOLUTE MONOTONY MON_INCREASE /end AXIS_DESCR
/end CHARACTERISTIC
/begin CHARACTERISTIC KF_MENACHSP71 "Nachmotoreingriff Schaltablauf" MAP 0x231EA4 kf_ui8_S6_S3 870 UMR_NM__6_1_M145_S6_S3 -870 0
 /begin AXIS_DESCR STD_AXIS iSasZentr.iSchaltend.n_tkf UMR_U_MIN_32_1_0_S6_S3 6 0 8160 DEPOSIT ABSOLUTE MONOTONY MON_INCREASE /end AXIS_DESCR
 /begin AXIS_DESCR STD_AXIS zff_atsys._.iSignale._.obj.sig_m_t8 UMR_NM__8_1_M50_S6_S3 6 -400 1640 DEPOSIT ABSOLUTE MONOTONY MON_INCREASE /end AXIS_DESCR
/end CHARACTERISTIC
/begin CHARACTERISTIC KF_FMTMEHAUPTASP71 "Faktor fuer Rampe auf HME bei RS" MAP 0x231EDC kf_ui8_S6_S3 1 UMR___1_100_0_S6_S3 0 1
 /begin AXIS_DESCR STD_AXIS iMoeMesaf.timer_zmes UMR_MSEC__10_1_0_S6_S3 4 0 2550 DEPOSIT ABSOLUTE MONOTONY MON_INCREASE /end AXIS_DESCR
 /begin AXIS_DESCR STD_AXIS zff_atsys._.iSignale._.obj.sig_m_t8 UMR_NM__8_1_M50_S6_S3 4 -400 1640 DEPOSIT ABSOLUTE MONOTONY MON_INCREASE /end AXIS_DESCR
/end CHARACTERISTIC
/begin CHARACTERISTIC KF_MEHAUPTSP71 "Wert Hauptmotoreingriff" MAP 0x231EFC kf_ui8_S6_S3 1530 UMR_NM__6_1_M145_S6_S3 -870 660
 /begin AXIS_DESCR STD_AXIS NO_INPUT_QUANTITY UMR_U_MIN_32_1_0_S6_S3 6 0 8160 DEPOSIT ABSOLUTE MONOTONY MON_INCREASE /end AXIS_DESCR
 /begin AXIS_DESCR STD_AXIS zff_atsys._.iSignale._.obj.sig_m_t8 UMR_NM__8_1_M50_S6_S3 10 -400 1640 DEPOSIT ABSOLUTE MONOTONY MON_INCREASE /end AXIS_DESCR
/end CHARACTERISTIC
/begin CHARACTERISTIC KF_TVMTNMOTMEHAUPTSP71 "Verzoegerungszeit Start Haupt-ME bei Momentenerhoehung" MAP 0x231F50 kf_ui8_S6_S3 2540 UMR_MSEC__10_1_0_S6_S3 0 2540
 /begin AXIS_DESCR STD_AXIS zff_atsys._.iSignale._.obj.sig_m_t8 UMR_NM__8_1_M50_S6_S3 4 -400 1640 DEPOSIT ABSOLUTE MONOTONY MON_INCREASE /end AXIS_DESCR
 /begin AXIS_DESCR STD_AXIS zff_atsys._.iSignale._.obj.sig_n_mot8 UMR_U_MIN_32_1_0_S6_S3 4 0 8160 DEPOSIT ABSOLUTE MONOTONY MON_INCREASE /end AXIS_DESCR
/end CHARACTERISTIC
/begin CHARACTERISTIC KL_FMEPOSNGABSP71 "Faktor zur Gewichtung pos. ME" CURVE 0x231F70 kl_si16_S6_S3 1 UMR___1_100_0_S6_S3 0 1
 /begin AXIS_DESCR STD_AXIS iMoeMesaf.ng_abmesas UMR_U_MINSEC_1_1_0_S6_S3 6 -1000 1000 DEPOSIT ABSOLUTE MONOTONY MON_INCREASE /end AXIS_DESCR
/end CHARACTERISTIC
/begin CHARACTERISTIC KF_TSYNNTKFMTMEHAUPTESP71 "Zeitkriterium Ende Haupt-ME bei Momentenerhoehung" MAP 0x231F8C kf_ui8_S6_S3 1280 UMR_MSEC__10_1_M128_S6_S3 -1280 0
 /begin AXIS_DESCR STD_AXIS iSasZentr.iSchaltend.n_tkf UMR_U_MIN_32_1_0_S6_S3 4 0 8160 DEPOSIT ABSOLUTE MONOTONY MON_INCREASE /end AXIS_DESCR
 /begin AXIS_DESCR STD_AXIS zff_atsys._.iSignale._.obj.sig_m_t8 UMR_NM__8_1_M50_S6_S3 4 -400 1640 DEPOSIT ABSOLUTE MONOTONY MON_INCREASE /end AXIS_DESCR
/end CHARACTERISTIC
/begin CHARACTERISTIC KF_FMESASMEHAUPTPOSESP71 "Faktor fuer Reduzierung pos ME bei RS" MAP 0x231FAC kf_si16_S6_S3 1 UMR___1_100_0_S6_S3 0 1
 /begin AXIS_DESCR STD_AXIS iSasZentr.iSchaltend.t_syn UMR_MSEC__10_1_0_S6_S3 4 -327680 327670 DEPOSIT ABSOLUTE MONOTONY MON_INCREASE /end AXIS_DESCR
 /begin AXIS_DESCR STD_AXIS iMoeMesaf.me_sas_gesp UMR_NM__1_1_0_S6_S3 4 0 2000 DEPOSIT ABSOLUTE MONOTONY MON_INCREASE /end AXIS_DESCR
/end CHARACTERISTIC
/begin CHARACTERISTIC KF_FMENACHPOSESP71 "Faktor fuer Reduzierung pos ME bei RS" MAP 0x231FE4 kf_si16_S6_S3 1 UMR___1_100_0_S6_S3 0 1
 /begin AXIS_DESCR STD_AXIS iMoeMesaf.timer_tsyn_rampe_pos UMR_MSEC__10_1_0_S6_S3 4 -50000 50000 DEPOSIT ABSOLUTE MONOTONY MON_INCREASE /end AXIS_DESCR
 /begin AXIS_DESCR STD_AXIS iMoeMesaf.me_sas_gesp UMR_NM__1_1_0_S6_S3 4 0 2000 DEPOSIT ABSOLUTE MONOTONY MON_INCREASE /end AXIS_DESCR
/end CHARACTERISTIC
/begin CHARACTERISTIC T_RAMEESP75 "Dauer Rampe ME bei Schaltungsende" VALUE 0x26E5D3 kw_ui8_S6_S3 2540 UMR_MSEC__10_1_0_S6_S3 0 2540 /end CHARACTERISTIC
/begin CHARACTERISTIC T_RAMEESP75_EL "Dauer Rampe ME bei Schaltungsende" VALUE 0x26E5D4 kw_ui8_S6_S3 2540 UMR_MSEC__10_1_0_S6_S3 0 2540 /end CHARACTERISTIC
/begin CHARACTERISTIC KL_FMENACHESP75 "Faktor fuer Rampe Ende Nach-ME bei RS" CURVE 0x23201C kl_ui8_S6_S3 1 UMR___1_100_0_S6_S3 0 1
 /begin AXIS_DESCR STD_AXIS iMoeMesaf.timer_zmes UMR_MSEC__10_1_0_S6_S3 4 0 2550 DEPOSIT ABSOLUTE MONOTONY MON_INCREASE /end AXIS_DESCR
/end CHARACTERISTIC
/begin CHARACTERISTIC T_SYNMENACHESP75 "Zeit vor/nach Erkennen synchron fuer Ende Nach-ME" VALUE 0x26E5D5 kw_ui8_S6_S3 2550 UMR_MSEC__10_1_M128_S6_S3 -1280 1270 /end CHARACTERISTIC
/begin CHARACTERISTIC T_SYNMENACHESP75_EL "Zeit vor/nach Erkennen synchron fuer Ende Nach-ME" VALUE 0x26E5D6 kw_ui8_S6_S3 2550 UMR_MSEC__10_1_M128_S6_S3 -1280 1270 /end CHARACTERISTIC
/begin CHARACTERISTIC KF_TSYNMENACHASP75 "Zeit vor Erkennen synchron fuer Ende Haupt-ME und Start Nach-ME" MAP 0x232028 kf_ui8_S6_S3 1280 UMR_MSEC__10_1_M128_S6_S3 -1280 0
 /begin AXIS_DESCR STD_AXIS zff_atsys._.iSignale._.obj.sig_n_mot8 UMR_U_MIN_32_1_0_S6_S3 4 0 8160 DEPOSIT ABSOLUTE MONOTONY MON_INCREASE /end AXIS_DESCR
 /begin AXIS_DESCR STD_AXIS zff_atsys._.iSignale._.obj.sig_m_t8 UMR_NM__8_1_M50_S6_S3 3 -400 1640 DEPOSIT ABSOLUTE MONOTONY MON_INCREASE /end AXIS_DESCR
/end CHARACTERISTIC
/begin CHARACTERISTIC KF_TSYNMENACHASP75_EL "Zeit vor Erkennen synchron fuer Ende Haupt-ME und Start Nach-ME" MAP 0x232044 kf_ui8_S6_S3 1280 UMR_MSEC__10_1_M128_S6_S3 -1280 0
 /begin AXIS_DESCR STD_AXIS zff_atsys._.iSignale._.obj.sig_n_mot8 UMR_U_MIN_32_1_0_S6_S3 4 0 8160 DEPOSIT ABSOLUTE MONOTONY MON_INCREASE /end AXIS_DESCR
 /begin AXIS_DESCR STD_AXIS zff_atsys._.iSignale._.obj.sig_m_t8 UMR_NM__8_1_M50_S6_S3 3 -400 1640 DEPOSIT ABSOLUTE MONOTONY MON_INCREASE /end AXIS_DESCR
/end CHARACTERISTIC
/begin CHARACTERISTIC KF_MENACHSP75 "Nachmotoreingriff Schaltablauf" MAP 0x232060 kf_ui8_S6_S3 870 UMR_NM__6_1_M145_S6_S3 -870 0
 /begin AXIS_DESCR STD_AXIS iSasZentr.iSchaltend.n_tkf UMR_U_MIN_32_1_0_S6_S3 6 0 8160 DEPOSIT ABSOLUTE MONOTONY MON_INCREASE /end AXIS_DESCR
 /begin AXIS_DESCR STD_AXIS zff_atsys._.iSignale._.obj.sig_m_t8 UMR_NM__8_1_M50_S6_S3 6 -400 1640 DEPOSIT ABSOLUTE MONOTONY MON_INCREASE /end AXIS_DESCR
/end CHARACTERISTIC
/begin CHARACTERISTIC KF_MENACHSP75_EL "Nachmotoreingriff Schaltablauf" MAP 0x232098 kf_ui8_S6_S3 870 UMR_NM__6_1_M145_S6_S3 -870 0
 /begin AXIS_DESCR STD_AXIS iSasZentr.iSchaltend.n_tkf UMR_U_MIN_32_1_0_S6_S3 6 0 8160 DEPOSIT ABSOLUTE MONOTONY MON_INCREASE /end AXIS_DESCR
 /begin AXIS_DESCR STD_AXIS zff_atsys._.iSignale._.obj.sig_m_t8 UMR_NM__8_1_M50_S6_S3 6 -400 1640 DEPOSIT ABSOLUTE MONOTONY MON_INCREASE /end AXIS_DESCR
/end CHARACTERISTIC
/begin CHARACTERISTIC KF_FMTMEHAUPTASP75 "Faktor fuer Rampe auf HME bei RS" MAP 0x2320D0 kf_ui8_S6_S3 1 UMR___1_100_0_S6_S3 0 1
 /begin AXIS_DESCR STD_AXIS iMoeMesaf.timer_zmes UMR_MSEC__10_1_0_S6_S3 4 0 2550 DEPOSIT ABSOLUTE MONOTONY MON_INCREASE /end AXIS_DESCR
 /begin AXIS_DESCR STD_AXIS zff_atsys._.iSignale._.obj.sig_m_t8 UMR_NM__8_1_M50_S6_S3 4 -400 1640 DEPOSIT ABSOLUTE MONOTONY MON_INCREASE /end AXIS_DESCR
/end CHARACTERISTIC
/begin CHARACTERISTIC KF_MEHAUPTSP75 "Wert Hauptmotoreingriff" MAP 0x2320F0 kf_ui8_S6_S3 1530 UMR_NM__6_1_M145_S6_S3 -870 660
 /begin AXIS_DESCR STD_AXIS NO_INPUT_QUANTITY UMR_U_MIN_32_1_0_S6_S3 6 0 8160 DEPOSIT ABSOLUTE MONOTONY MON_INCREASE /end AXIS_DESCR
 /begin AXIS_DESCR STD_AXIS zff_atsys._.iSignale._.obj.sig_m_t8 UMR_NM__8_1_M50_S6_S3 10 -400 1640 DEPOSIT ABSOLUTE MONOTONY MON_INCREASE /end AXIS_DESCR
/end CHARACTERISTIC
/begin CHARACTERISTIC KF_MEHAUPTSP75_EL "Wert Hauptmotoreingriff" MAP 0x232144 kf_ui8_S6_S3 1530 UMR_NM__6_1_M145_S6_S3 -870 660
 /begin AXIS_DESCR STD_AXIS NO_INPUT_QUANTITY UMR_U_MIN_32_1_0_S6_S3 6 0 8160 DEPOSIT ABSOLUTE MONOTONY MON_INCREASE /end AXIS_DESCR
 /begin AXIS_DESCR STD_AXIS zff_atsys._.iSignale._.obj.sig_m_t8 UMR_NM__8_1_M50_S6_S3 10 -400 1640 DEPOSIT ABSOLUTE MONOTONY MON_INCREASE /end AXIS_DESCR
/end CHARACTERISTIC
/begin CHARACTERISTIC KF_TVMTNMOTMEHAUPTSP75 "Verzoegerungszeit Start Haupt-ME bei Momentenerhoehung" MAP 0x232198 kf_ui8_S6_S3 2540 UMR_MSEC__10_1_0_S6_S3 0 2540
 /begin AXIS_DESCR STD_AXIS zff_atsys._.iSignale._.obj.sig_m_t8 UMR_NM__8_1_M50_S6_S3 4 -400 1640 DEPOSIT ABSOLUTE MONOTONY MON_INCREASE /end AXIS_DESCR
 /begin AXIS_DESCR STD_AXIS zff_atsys._.iSignale._.obj.sig_n_mot8 UMR_U_MIN_32_1_0_S6_S3 4 0 8160 DEPOSIT ABSOLUTE MONOTONY MON_INCREASE /end AXIS_DESCR
/end CHARACTERISTIC
/begin CHARACTERISTIC KL_FMEPOSNGABSP75 "Faktor zur Gewichtung pos. ME" CURVE 0x2321B8 kl_si16_S6_S3 1 UMR___1_100_0_S6_S3 0 1
 /begin AXIS_DESCR STD_AXIS iMoeMesaf.ng_abmesas UMR_U_MINSEC_1_1_0_S6_S3 6 -1000 1000 DEPOSIT ABSOLUTE MONOTONY MON_INCREASE /end AXIS_DESCR
/end CHARACTERISTIC
/begin CHARACTERISTIC KF_TSYNNTKFMTMEHAUPTESP75 "Zeitkriterium Ende Haupt-ME bei Momentenerhoehung" MAP 0x2321D4 kf_ui8_S6_S3 1280 UMR_MSEC__10_1_M128_S6_S3 -1280 0
 /begin AXIS_DESCR STD_AXIS iSasZentr.iSchaltend.n_tkf UMR_U_MIN_32_1_0_S6_S3 4 0 8160 DEPOSIT ABSOLUTE MONOTONY MON_INCREASE /end AXIS_DESCR
 /begin AXIS_DESCR STD_AXIS zff_atsys._.iSignale._.obj.sig_m_t8 UMR_NM__8_1_M50_S6_S3 4 -400 1640 DEPOSIT ABSOLUTE MONOTONY MON_INCREASE /end AXIS_DESCR
/end CHARACTERISTIC
/begin CHARACTERISTIC KF_FMESASMEHAUPTPOSESP75 "Faktor fuer Reduzierung pos ME bei RS" MAP 0x2321F4 kf_si16_S6_S3 1 UMR___1_100_0_S6_S3 0 1
 /begin AXIS_DESCR STD_AXIS iSasZentr.iSchaltend.t_syn UMR_MSEC__10_1_0_S6_S3 4 -327680 327670 DEPOSIT ABSOLUTE MONOTONY MON_INCREASE /end AXIS_DESCR
 /begin AXIS_DESCR STD_AXIS iMoeMesaf.me_sas_gesp UMR_NM__1_1_0_S6_S3 4 0 2000 DEPOSIT ABSOLUTE MONOTONY MON_INCREASE /end AXIS_DESCR
/end CHARACTERISTIC
/begin CHARACTERISTIC KF_FMENACHPOSESP75 "Faktor fuer Reduzierung pos ME bei RS" MAP 0x23222C kf_si16_S6_S3 1 UMR___1_100_0_S6_S3 0 1
 /begin AXIS_DESCR STD_AXIS iMoeMesaf.timer_tsyn_rampe_pos UMR_MSEC__10_1_0_S6_S3 4 -50000 50000 DEPOSIT ABSOLUTE MONOTONY MON_INCREASE /end AXIS_DESCR
 /begin AXIS_DESCR STD_AXIS iMoeMesaf.me_sas_gesp UMR_NM__1_1_0_S6_S3 4 0 2000 DEPOSIT ABSOLUTE MONOTONY MON_INCREASE /end AXIS_DESCR
/end CHARACTERISTIC
/begin CHARACTERISTIC T_RAMEESP82 "Dauer Rampe ME bei Schaltungsende" VALUE 0x26E5D7 kw_ui8_S6_S3 2540 UMR_MSEC__10_1_0_S6_S3 0 2540 /end CHARACTERISTIC
/begin CHARACTERISTIC T_RAMEESP82_EL "Dauer Rampe ME bei Schaltungsende" VALUE 0x26E5D8 kw_ui8_S6_S3 2540 UMR_MSEC__10_1_0_S6_S3 0 2540 /end CHARACTERISTIC
/begin CHARACTERISTIC KL_FMENACHESP82 "Faktor fuer Rampe Ende Nach-ME bei RS" CURVE 0x232264 kl_ui8_S6_S3 1 UMR___1_100_0_S6_S3 0 1
 /begin AXIS_DESCR STD_AXIS iMoeMesaf.timer_zmes UMR_MSEC__10_1_0_S6_S3 4 0 2550 DEPOSIT ABSOLUTE MONOTONY MON_INCREASE /end AXIS_DESCR
/end CHARACTERISTIC
/begin CHARACTERISTIC T_SYNMENACHESP82 "Zeit vor/nach Erkennen synchron fuer Ende Nach-ME" VALUE 0x26E5D9 kw_ui8_S6_S3 2550 UMR_MSEC__10_1_M128_S6_S3 -1280 1270 /end CHARACTERISTIC
/begin CHARACTERISTIC T_SYNMENACHESP82_EL "Zeit vor/nach Erkennen synchron fuer Ende Nach-ME" VALUE 0x26E5DA kw_ui8_S6_S3 2550 UMR_MSEC__10_1_M128_S6_S3 -1280 1270 /end CHARACTERISTIC
/begin CHARACTERISTIC KF_TSYNMENACHASP82 "Zeit vor Erkennen synchron fuer Ende Haupt-ME und Start Nach-ME" MAP 0x232270 kf_ui8_S6_S3 1280 UMR_MSEC__10_1_M128_S6_S3 -1280 0
 /begin AXIS_DESCR STD_AXIS zff_atsys._.iSignale._.obj.sig_n_mot8 UMR_U_MIN_32_1_0_S6_S3 4 0 8160 DEPOSIT ABSOLUTE MONOTONY MON_INCREASE /end AXIS_DESCR
 /begin AXIS_DESCR STD_AXIS zff_atsys._.iSignale._.obj.sig_m_t8 UMR_NM__8_1_M50_S6_S3 3 -400 1640 DEPOSIT ABSOLUTE MONOTONY MON_INCREASE /end AXIS_DESCR
/end CHARACTERISTIC
/begin CHARACTERISTIC KF_TSYNMENACHASP82_EL "Zeit vor Erkennen synchron fuer Ende Haupt-ME und Start Nach-ME" MAP 0x23228C kf_ui8_S6_S3 1280 UMR_MSEC__10_1_M128_S6_S3 -1280 0
 /begin AXIS_DESCR STD_AXIS zff_atsys._.iSignale._.obj.sig_n_mot8 UMR_U_MIN_32_1_0_S6_S3 4 0 8160 DEPOSIT ABSOLUTE MONOTONY MON_INCREASE /end AXIS_DESCR
 /begin AXIS_DESCR STD_AXIS zff_atsys._.iSignale._.obj.sig_m_t8 UMR_NM__8_1_M50_S6_S3 3 -400 1640 DEPOSIT ABSOLUTE MONOTONY MON_INCREASE /end AXIS_DESCR
/end CHARACTERISTIC
/begin CHARACTERISTIC KF_MENACHSP82 "Nachmotoreingriff Schaltablauf" MAP 0x2322A8 kf_ui8_S6_S3 870 UMR_NM__6_1_M145_S6_S3 -870 0
 /begin AXIS_DESCR STD_AXIS iSasZentr.iSchaltend.n_tkf UMR_U_MIN_32_1_0_S6_S3 6 0 8160 DEPOSIT ABSOLUTE MONOTONY MON_INCREASE /end AXIS_DESCR
 /begin AXIS_DESCR STD_AXIS zff_atsys._.iSignale._.obj.sig_m_t8 UMR_NM__8_1_M50_S6_S3 6 -400 1640 DEPOSIT ABSOLUTE MONOTONY MON_INCREASE /end AXIS_DESCR
/end CHARACTERISTIC
/begin CHARACTERISTIC KF_MENACHSP82_EL "Nachmotoreingriff Schaltablauf" MAP 0x2322E0 kf_ui8_S6_S3 870 UMR_NM__6_1_M145_S6_S3 -870 0
 /begin AXIS_DESCR STD_AXIS iSasZentr.iSchaltend.n_tkf UMR_U_MIN_32_1_0_S6_S3 6 0 8160 DEPOSIT ABSOLUTE MONOTONY MON_INCREASE /end AXIS_DESCR
 /begin AXIS_DESCR STD_AXIS zff_atsys._.iSignale._.obj.sig_m_t8 UMR_NM__8_1_M50_S6_S3 6 -400 1640 DEPOSIT ABSOLUTE MONOTONY MON_INCREASE /end AXIS_DESCR
/end CHARACTERISTIC
/begin CHARACTERISTIC KF_FMTMEHAUPTASP82 "Faktor fuer Rampe auf HME bei RS" MAP 0x232318 kf_ui8_S6_S3 1 UMR___1_100_0_S6_S3 0 1
 /begin AXIS_DESCR STD_AXIS iMoeMesaf.timer_zmes UMR_MSEC__10_1_0_S6_S3 4 0 2550 DEPOSIT ABSOLUTE MONOTONY MON_INCREASE /end AXIS_DESCR
 /begin AXIS_DESCR STD_AXIS zff_atsys._.iSignale._.obj.sig_m_t8 UMR_NM__8_1_M50_S6_S3 4 -400 1640 DEPOSIT ABSOLUTE MONOTONY MON_INCREASE /end AXIS_DESCR
/end CHARACTERISTIC
/begin CHARACTERISTIC KF_MEHAUPTSP82 "Wert Hauptmotoreingriff" MAP 0x232338 kf_ui8_S6_S3 1530 UMR_NM__6_1_M145_S6_S3 -870 660
 /begin AXIS_DESCR STD_AXIS NO_INPUT_QUANTITY UMR_U_MIN_32_1_0_S6_S3 6 0 8160 DEPOSIT ABSOLUTE MONOTONY MON_INCREASE /end AXIS_DESCR
 /begin AXIS_DESCR STD_AXIS zff_atsys._.iSignale._.obj.sig_m_t8 UMR_NM__8_1_M50_S6_S3 10 -400 1640 DEPOSIT ABSOLUTE MONOTONY MON_INCREASE /end AXIS_DESCR
/end CHARACTERISTIC
/begin CHARACTERISTIC KF_MEHAUPTSP82_EL "Wert Hauptmotoreingriff" MAP 0x23238C kf_ui8_S6_S3 1530 UMR_NM__6_1_M145_S6_S3 -870 660
 /begin AXIS_DESCR STD_AXIS NO_INPUT_QUANTITY UMR_U_MIN_32_1_0_S6_S3 6 0 8160 DEPOSIT ABSOLUTE MONOTONY MON_INCREASE /end AXIS_DESCR
 /begin AXIS_DESCR STD_AXIS zff_atsys._.iSignale._.obj.sig_m_t8 UMR_NM__8_1_M50_S6_S3 10 -400 1640 DEPOSIT ABSOLUTE MONOTONY MON_INCREASE /end AXIS_DESCR
/end CHARACTERISTIC
/begin CHARACTERISTIC KF_TVMTNMOTMEHAUPTSP82 "Verzoegerungszeit Start Haupt-ME bei Momentenerhoehung" MAP 0x2323E0 kf_ui8_S6_S3 2540 UMR_MSEC__10_1_0_S6_S3 0 2540
 /begin AXIS_DESCR STD_AXIS zff_atsys._.iSignale._.obj.sig_m_t8 UMR_NM__8_1_M50_S6_S3 4 -400 1640 DEPOSIT ABSOLUTE MONOTONY MON_INCREASE /end AXIS_DESCR
 /begin AXIS_DESCR STD_AXIS zff_atsys._.iSignale._.obj.sig_n_mot8 UMR_U_MIN_32_1_0_S6_S3 4 0 8160 DEPOSIT ABSOLUTE MONOTONY MON_INCREASE /end AXIS_DESCR
/end CHARACTERISTIC
/begin CHARACTERISTIC KL_FMEPOSNGABSP82 "Faktor zur Gewichtung pos. ME" CURVE 0x232400 kl_si16_S6_S3 1 UMR___1_100_0_S6_S3 0 1
 /begin AXIS_DESCR STD_AXIS iMoeMesaf.ng_abmesas UMR_U_MINSEC_1_1_0_S6_S3 6 -1000 1000 DEPOSIT ABSOLUTE MONOTONY MON_INCREASE /end AXIS_DESCR
/end CHARACTERISTIC
/begin CHARACTERISTIC KF_TSYNNTKFMTMEHAUPTESP82 "Zeitkriterium Ende Haupt-ME bei Momentenerhoehung" MAP 0x23241C kf_ui8_S6_S3 1280 UMR_MSEC__10_1_M128_S6_S3 -1280 0
 /begin AXIS_DESCR STD_AXIS iSasZentr.iSchaltend.n_tkf UMR_U_MIN_32_1_0_S6_S3 4 0 8160 DEPOSIT ABSOLUTE MONOTONY MON_INCREASE /end AXIS_DESCR
 /begin AXIS_DESCR STD_AXIS zff_atsys._.iSignale._.obj.sig_m_t8 UMR_NM__8_1_M50_S6_S3 4 -400 1640 DEPOSIT ABSOLUTE MONOTONY MON_INCREASE /end AXIS_DESCR
/end CHARACTERISTIC
/begin CHARACTERISTIC KF_FMESASMEHAUPTPOSESP82 "Faktor fuer Reduzierung pos ME bei RS" MAP 0x23243C kf_si16_S6_S3 1 UMR___1_100_0_S6_S3 0 1
 /begin AXIS_DESCR STD_AXIS iSasZentr.iSchaltend.t_syn UMR_MSEC__10_1_0_S6_S3 4 -327680 327670 DEPOSIT ABSOLUTE MONOTONY MON_INCREASE /end AXIS_DESCR
 /begin AXIS_DESCR STD_AXIS iMoeMesaf.me_sas_gesp UMR_NM__1_1_0_S6_S3 4 0 2000 DEPOSIT ABSOLUTE MONOTONY MON_INCREASE /end AXIS_DESCR
/end CHARACTERISTIC
/begin CHARACTERISTIC KF_FMENACHPOSESP82 "Faktor fuer Reduzierung pos ME bei RS" MAP 0x232474 kf_si16_S6_S3 1 UMR___1_100_0_S6_S3 0 1
 /begin AXIS_DESCR STD_AXIS iMoeMesaf.timer_tsyn_rampe_pos UMR_MSEC__10_1_0_S6_S3 4 -50000 50000 DEPOSIT ABSOLUTE MONOTONY MON_INCREASE /end AXIS_DESCR
 /begin AXIS_DESCR STD_AXIS iMoeMesaf.me_sas_gesp UMR_NM__1_1_0_S6_S3 4 0 2000 DEPOSIT ABSOLUTE MONOTONY MON_INCREASE /end AXIS_DESCR
/end CHARACTERISTIC
/begin CHARACTERISTIC T_RAMEESP84 "Dauer Rampe ME bei Schaltungsende" VALUE 0x26E5DB kw_ui8_S6_S3 2540 UMR_MSEC__10_1_0_S6_S3 0 2540 /end CHARACTERISTIC
/begin CHARACTERISTIC T_RAMEESP84_EL "Dauer Rampe ME bei Schaltungsende" VALUE 0x26E5DC kw_ui8_S6_S3 2540 UMR_MSEC__10_1_0_S6_S3 0 2540 /end CHARACTERISTIC
/begin CHARACTERISTIC KL_FMENACHESP84 "Faktor fuer Rampe Ende Nach-ME bei RS" CURVE 0x2324AC kl_ui8_S6_S3 1 UMR___1_100_0_S6_S3 0 1
 /begin AXIS_DESCR STD_AXIS iMoeMesaf.timer_zmes UMR_MSEC__10_1_0_S6_S3 4 0 2550 DEPOSIT ABSOLUTE MONOTONY MON_INCREASE /end AXIS_DESCR
/end CHARACTERISTIC
/begin CHARACTERISTIC T_SYNMENACHESP84 "Zeit vor/nach Erkennen synchron fuer Ende Nach-ME" VALUE 0x26E5DD kw_ui8_S6_S3 2550 UMR_MSEC__10_1_M128_S6_S3 -1280 1270 /end CHARACTERISTIC
/begin CHARACTERISTIC T_SYNMENACHESP84_EL "Zeit vor/nach Erkennen synchron fuer Ende Nach-ME" VALUE 0x26E5DE kw_ui8_S6_S3 2550 UMR_MSEC__10_1_M128_S6_S3 -1280 1270 /end CHARACTERISTIC
/begin CHARACTERISTIC KF_TSYNMENACHASP84 "Zeit vor Erkennen synchron fuer Ende Haupt-ME und Start Nach-ME" MAP 0x2324B8 kf_ui8_S6_S3 1280 UMR_MSEC__10_1_M128_S6_S3 -1280 0
 /begin AXIS_DESCR STD_AXIS zff_atsys._.iSignale._.obj.sig_n_mot8 UMR_U_MIN_32_1_0_S6_S3 4 0 8160 DEPOSIT ABSOLUTE MONOTONY MON_INCREASE /end AXIS_DESCR
 /begin AXIS_DESCR STD_AXIS zff_atsys._.iSignale._.obj.sig_m_t8 UMR_NM__8_1_M50_S6_S3 3 -400 1640 DEPOSIT ABSOLUTE MONOTONY MON_INCREASE /end AXIS_DESCR
/end CHARACTERISTIC
/begin CHARACTERISTIC KF_TSYNMENACHASP84_EL "Zeit vor Erkennen synchron fuer Ende Haupt-ME und Start Nach-ME" MAP 0x2324D4 kf_ui8_S6_S3 1280 UMR_MSEC__10_1_M128_S6_S3 -1280 0
 /begin AXIS_DESCR STD_AXIS zff_atsys._.iSignale._.obj.sig_n_mot8 UMR_U_MIN_32_1_0_S6_S3 4 0 8160 DEPOSIT ABSOLUTE MONOTONY MON_INCREASE /end AXIS_DESCR
 /begin AXIS_DESCR STD_AXIS zff_atsys._.iSignale._.obj.sig_m_t8 UMR_NM__8_1_M50_S6_S3 3 -400 1640 DEPOSIT ABSOLUTE MONOTONY MON_INCREASE /end AXIS_DESCR
/end CHARACTERISTIC
/begin CHARACTERISTIC KF_MENACHSP84 "Nachmotoreingriff Schaltablauf" MAP 0x2324F0 kf_ui8_S6_S3 870 UMR_NM__6_1_M145_S6_S3 -870 0
 /begin AXIS_DESCR STD_AXIS iSasZentr.iSchaltend.n_tkf UMR_U_MIN_32_1_0_S6_S3 6 0 8160 DEPOSIT ABSOLUTE MONOTONY MON_INCREASE /end AXIS_DESCR
 /begin AXIS_DESCR STD_AXIS zff_atsys._.iSignale._.obj.sig_m_t8 UMR_NM__8_1_M50_S6_S3 6 -400 1640 DEPOSIT ABSOLUTE MONOTONY MON_INCREASE /end AXIS_DESCR
/end CHARACTERISTIC
/begin CHARACTERISTIC KF_MENACHSP84_EL "Nachmotoreingriff Schaltablauf" MAP 0x232528 kf_ui8_S6_S3 870 UMR_NM__6_1_M145_S6_S3 -870 0
 /begin AXIS_DESCR STD_AXIS iSasZentr.iSchaltend.n_tkf UMR_U_MIN_32_1_0_S6_S3 6 0 8160 DEPOSIT ABSOLUTE MONOTONY MON_INCREASE /end AXIS_DESCR
 /begin AXIS_DESCR STD_AXIS zff_atsys._.iSignale._.obj.sig_m_t8 UMR_NM__8_1_M50_S6_S3 6 -400 1640 DEPOSIT ABSOLUTE MONOTONY MON_INCREASE /end AXIS_DESCR
/end CHARACTERISTIC
/begin CHARACTERISTIC KF_FMTMEHAUPTASP84 "Faktor fuer Rampe auf HME bei RS" MAP 0x232560 kf_ui8_S6_S3 1 UMR___1_100_0_S6_S3 0 1
 /begin AXIS_DESCR STD_AXIS iMoeMesaf.timer_zmes UMR_MSEC__10_1_0_S6_S3 4 0 2550 DEPOSIT ABSOLUTE MONOTONY MON_INCREASE /end AXIS_DESCR
 /begin AXIS_DESCR STD_AXIS zff_atsys._.iSignale._.obj.sig_m_t8 UMR_NM__8_1_M50_S6_S3 4 -400 1640 DEPOSIT ABSOLUTE MONOTONY MON_INCREASE /end AXIS_DESCR
/end CHARACTERISTIC
/begin CHARACTERISTIC KF_MEHAUPTSP84 "Wert Hauptmotoreingriff" MAP 0x232580 kf_ui8_S6_S3 1530 UMR_NM__6_1_M145_S6_S3 -870 660
 /begin AXIS_DESCR STD_AXIS NO_INPUT_QUANTITY UMR_U_MIN_32_1_0_S6_S3 6 0 8160 DEPOSIT ABSOLUTE MONOTONY MON_INCREASE /end AXIS_DESCR
 /begin AXIS_DESCR STD_AXIS zff_atsys._.iSignale._.obj.sig_m_t8 UMR_NM__8_1_M50_S6_S3 10 -400 1640 DEPOSIT ABSOLUTE MONOTONY MON_INCREASE /end AXIS_DESCR
/end CHARACTERISTIC
/begin CHARACTERISTIC KF_MEHAUPTSP84_EL "Wert Hauptmotoreingriff" MAP 0x2325D4 kf_ui8_S6_S3 1530 UMR_NM__6_1_M145_S6_S3 -870 660
 /begin AXIS_DESCR STD_AXIS NO_INPUT_QUANTITY UMR_U_MIN_32_1_0_S6_S3 6 0 8160 DEPOSIT ABSOLUTE MONOTONY MON_INCREASE /end AXIS_DESCR
 /begin AXIS_DESCR STD_AXIS zff_atsys._.iSignale._.obj.sig_m_t8 UMR_NM__8_1_M50_S6_S3 10 -400 1640 DEPOSIT ABSOLUTE MONOTONY MON_INCREASE /end AXIS_DESCR
/end CHARACTERISTIC
/begin CHARACTERISTIC KF_TVMTNMOTMEHAUPTSP84 "Verzoegerungszeit Start Haupt-ME bei Momentenerhoehung" MAP 0x232628 kf_ui8_S6_S3 2540 UMR_MSEC__10_1_0_S6_S3 0 2540
 /begin AXIS_DESCR STD_AXIS zff_atsys._.iSignale._.obj.sig_m_t8 UMR_NM__8_1_M50_S6_S3 4 -400 1640 DEPOSIT ABSOLUTE MONOTONY MON_INCREASE /end AXIS_DESCR
 /begin AXIS_DESCR STD_AXIS zff_atsys._.iSignale._.obj.sig_n_mot8 UMR_U_MIN_32_1_0_S6_S3 4 0 8160 DEPOSIT ABSOLUTE MONOTONY MON_INCREASE /end AXIS_DESCR
/end CHARACTERISTIC
/begin CHARACTERISTIC KL_FMEPOSNGABSP84 "Faktor zur Gewichtung pos. ME" CURVE 0x232648 kl_si16_S6_S3 1 UMR___1_100_0_S6_S3 0 1
 /begin AXIS_DESCR STD_AXIS iMoeMesaf.ng_abmesas UMR_U_MINSEC_1_1_0_S6_S3 6 -1000 1000 DEPOSIT ABSOLUTE MONOTONY MON_INCREASE /end AXIS_DESCR
/end CHARACTERISTIC
/begin CHARACTERISTIC KF_TSYNNTKFMTMEHAUPTESP84 "Zeitkriterium Ende Haupt-ME bei Momentenerhoehung" MAP 0x232664 kf_ui8_S6_S3 1280 UMR_MSEC__10_1_M128_S6_S3 -1280 0
 /begin AXIS_DESCR STD_AXIS iSasZentr.iSchaltend.n_tkf UMR_U_MIN_32_1_0_S6_S3 4 0 8160 DEPOSIT ABSOLUTE MONOTONY MON_INCREASE /end AXIS_DESCR
 /begin AXIS_DESCR STD_AXIS zff_atsys._.iSignale._.obj.sig_m_t8 UMR_NM__8_1_M50_S6_S3 4 -400 1640 DEPOSIT ABSOLUTE MONOTONY MON_INCREASE /end AXIS_DESCR
/end CHARACTERISTIC
/begin CHARACTERISTIC KF_FMESASMEHAUPTPOSESP84 "Faktor fuer Reduzierung pos ME bei RS" MAP 0x232684 kf_si16_S6_S3 1 UMR___1_100_0_S6_S3 0 1
 /begin AXIS_DESCR STD_AXIS iSasZentr.iSchaltend.t_syn UMR_MSEC__10_1_0_S6_S3 4 -327680 327670 DEPOSIT ABSOLUTE MONOTONY MON_INCREASE /end AXIS_DESCR
 /begin AXIS_DESCR STD_AXIS iMoeMesaf.me_sas_gesp UMR_NM__1_1_0_S6_S3 4 0 2000 DEPOSIT ABSOLUTE MONOTONY MON_INCREASE /end AXIS_DESCR
/end CHARACTERISTIC
/begin CHARACTERISTIC KF_FMENACHPOSESP84 "Faktor fuer Reduzierung pos ME bei RS" MAP 0x2326BC kf_si16_S6_S3 1 UMR___1_100_0_S6_S3 0 1
 /begin AXIS_DESCR STD_AXIS iMoeMesaf.timer_tsyn_rampe_pos UMR_MSEC__10_1_0_S6_S3 4 -50000 50000 DEPOSIT ABSOLUTE MONOTONY MON_INCREASE /end AXIS_DESCR
 /begin AXIS_DESCR STD_AXIS iMoeMesaf.me_sas_gesp UMR_NM__1_1_0_S6_S3 4 0 2000 DEPOSIT ABSOLUTE MONOTONY MON_INCREASE /end AXIS_DESCR
/end CHARACTERISTIC
/begin CHARACTERISTIC T_RAMEESP86 "Dauer Rampe ME bei Schaltungsende" VALUE 0x26E5DF kw_ui8_S6_S3 2540 UMR_MSEC__10_1_0_S6_S3 0 2540 /end CHARACTERISTIC
/begin CHARACTERISTIC T_RAMEESP86_EL "Dauer Rampe ME bei Schaltungsende" VALUE 0x26E5E0 kw_ui8_S6_S3 2540 UMR_MSEC__10_1_0_S6_S3 0 2540 /end CHARACTERISTIC
/begin CHARACTERISTIC KL_FMENACHESP86 "Faktor fuer Rampe Ende Nach-ME bei RS" CURVE 0x2326F4 kl_ui8_S6_S3 1 UMR___1_100_0_S6_S3 0 1
 /begin AXIS_DESCR STD_AXIS iMoeMesaf.timer_zmes UMR_MSEC__10_1_0_S6_S3 4 0 2550 DEPOSIT ABSOLUTE MONOTONY MON_INCREASE /end AXIS_DESCR
/end CHARACTERISTIC
/begin CHARACTERISTIC T_SYNMENACHESP86 "Zeit vor/nach Erkennen synchron fuer Ende Nach-ME" VALUE 0x26E5E1 kw_ui8_S6_S3 2550 UMR_MSEC__10_1_M128_S6_S3 -1280 1270 /end CHARACTERISTIC
/begin CHARACTERISTIC T_SYNMENACHESP86_EL "Zeit vor/nach Erkennen synchron fuer Ende Nach-ME" VALUE 0x26E5E2 kw_ui8_S6_S3 2550 UMR_MSEC__10_1_M128_S6_S3 -1280 1270 /end CHARACTERISTIC
/begin CHARACTERISTIC KF_TSYNMENACHASP86 "Zeit vor Erkennen synchron fuer Ende Haupt-ME und Start Nach-ME" MAP 0x232700 kf_ui8_S6_S3 1280 UMR_MSEC__10_1_M128_S6_S3 -1280 0
 /begin AXIS_DESCR STD_AXIS zff_atsys._.iSignale._.obj.sig_n_mot8 UMR_U_MIN_32_1_0_S6_S3 4 0 8160 DEPOSIT ABSOLUTE MONOTONY MON_INCREASE /end AXIS_DESCR
 /begin AXIS_DESCR STD_AXIS zff_atsys._.iSignale._.obj.sig_m_t8 UMR_NM__8_1_M50_S6_S3 3 -400 1640 DEPOSIT ABSOLUTE MONOTONY MON_INCREASE /end AXIS_DESCR
/end CHARACTERISTIC
/begin CHARACTERISTIC KF_TSYNMENACHASP86_EL "Zeit vor Erkennen synchron fuer Ende Haupt-ME und Start Nach-ME" MAP 0x23271C kf_ui8_S6_S3 1280 UMR_MSEC__10_1_M128_S6_S3 -1280 0
 /begin AXIS_DESCR STD_AXIS zff_atsys._.iSignale._.obj.sig_n_mot8 UMR_U_MIN_32_1_0_S6_S3 4 0 8160 DEPOSIT ABSOLUTE MONOTONY MON_INCREASE /end AXIS_DESCR
 /begin AXIS_DESCR STD_AXIS zff_atsys._.iSignale._.obj.sig_m_t8 UMR_NM__8_1_M50_S6_S3 3 -400 1640 DEPOSIT ABSOLUTE MONOTONY MON_INCREASE /end AXIS_DESCR
/end CHARACTERISTIC
/begin CHARACTERISTIC KF_MENACHSP86 "Nachmotoreingriff Schaltablauf" MAP 0x232738 kf_ui8_S6_S3 870 UMR_NM__6_1_M145_S6_S3 -870 0
 /begin AXIS_DESCR STD_AXIS iSasZentr.iSchaltend.n_tkf UMR_U_MIN_32_1_0_S6_S3 6 0 8160 DEPOSIT ABSOLUTE MONOTONY MON_INCREASE /end AXIS_DESCR
 /begin AXIS_DESCR STD_AXIS zff_atsys._.iSignale._.obj.sig_m_t8 UMR_NM__8_1_M50_S6_S3 6 -400 1640 DEPOSIT ABSOLUTE MONOTONY MON_INCREASE /end AXIS_DESCR
/end CHARACTERISTIC
/begin CHARACTERISTIC KF_MENACHSP86_EL "Nachmotoreingriff Schaltablauf" MAP 0x232770 kf_ui8_S6_S3 870 UMR_NM__6_1_M145_S6_S3 -870 0
 /begin AXIS_DESCR STD_AXIS iSasZentr.iSchaltend.n_tkf UMR_U_MIN_32_1_0_S6_S3 6 0 8160 DEPOSIT ABSOLUTE MONOTONY MON_INCREASE /end AXIS_DESCR
 /begin AXIS_DESCR STD_AXIS zff_atsys._.iSignale._.obj.sig_m_t8 UMR_NM__8_1_M50_S6_S3 6 -400 1640 DEPOSIT ABSOLUTE MONOTONY MON_INCREASE /end AXIS_DESCR
/end CHARACTERISTIC
/begin CHARACTERISTIC KF_FMTMEHAUPTASP86 "Faktor fuer Rampe auf HME bei RS" MAP 0x2327A8 kf_ui8_S6_S3 1 UMR___1_100_0_S6_S3 0 1
 /begin AXIS_DESCR STD_AXIS iMoeMesaf.timer_zmes UMR_MSEC__10_1_0_S6_S3 4 0 2550 DEPOSIT ABSOLUTE MONOTONY MON_INCREASE /end AXIS_DESCR
 /begin AXIS_DESCR STD_AXIS zff_atsys._.iSignale._.obj.sig_m_t8 UMR_NM__8_1_M50_S6_S3 4 -400 1640 DEPOSIT ABSOLUTE MONOTONY MON_INCREASE /end AXIS_DESCR
/end CHARACTERISTIC
/begin CHARACTERISTIC KF_MEHAUPTSP86 "Wert Hauptmotoreingriff" MAP 0x2327C8 kf_ui8_S6_S3 1530 UMR_NM__6_1_M145_S6_S3 -870 660
 /begin AXIS_DESCR STD_AXIS NO_INPUT_QUANTITY UMR_U_MIN_32_1_0_S6_S3 6 0 8160 DEPOSIT ABSOLUTE MONOTONY MON_INCREASE /end AXIS_DESCR
 /begin AXIS_DESCR STD_AXIS zff_atsys._.iSignale._.obj.sig_m_t8 UMR_NM__8_1_M50_S6_S3 10 -400 1640 DEPOSIT ABSOLUTE MONOTONY MON_INCREASE /end AXIS_DESCR
/end CHARACTERISTIC
/begin CHARACTERISTIC KF_MEHAUPTSP86_EL "Wert Hauptmotoreingriff" MAP 0x23281C kf_ui8_S6_S3 1530 UMR_NM__6_1_M145_S6_S3 -870 660
 /begin AXIS_DESCR STD_AXIS NO_INPUT_QUANTITY UMR_U_MIN_32_1_0_S6_S3 6 0 8160 DEPOSIT ABSOLUTE MONOTONY MON_INCREASE /end AXIS_DESCR
 /begin AXIS_DESCR STD_AXIS zff_atsys._.iSignale._.obj.sig_m_t8 UMR_NM__8_1_M50_S6_S3 10 -400 1640 DEPOSIT ABSOLUTE MONOTONY MON_INCREASE /end AXIS_DESCR
/end CHARACTERISTIC
/begin CHARACTERISTIC KF_TVMTNMOTMEHAUPTSP86 "Verzoegerungszeit Start Haupt-ME bei Momentenerhoehung" MAP 0x232870 kf_ui8_S6_S3 2540 UMR_MSEC__10_1_0_S6_S3 0 2540
 /begin AXIS_DESCR STD_AXIS zff_atsys._.iSignale._.obj.sig_m_t8 UMR_NM__8_1_M50_S6_S3 4 -400 1640 DEPOSIT ABSOLUTE MONOTONY MON_INCREASE /end AXIS_DESCR
 /begin AXIS_DESCR STD_AXIS zff_atsys._.iSignale._.obj.sig_n_mot8 UMR_U_MIN_32_1_0_S6_S3 4 0 8160 DEPOSIT ABSOLUTE MONOTONY MON_INCREASE /end AXIS_DESCR
/end CHARACTERISTIC
/begin CHARACTERISTIC KL_FMEPOSNGABSP86 "Faktor zur Gewichtung pos. ME" CURVE 0x232890 kl_si16_S6_S3 1 UMR___1_100_0_S6_S3 0 1
 /begin AXIS_DESCR STD_AXIS iMoeMesaf.ng_abmesas UMR_U_MINSEC_1_1_0_S6_S3 6 -1000 1000 DEPOSIT ABSOLUTE MONOTONY MON_INCREASE /end AXIS_DESCR
/end CHARACTERISTIC
/begin CHARACTERISTIC KF_TSYNNTKFMTMEHAUPTESP86 "Zeitkriterium Ende Haupt-ME bei Momentenerhoehung" MAP 0x2328AC kf_ui8_S6_S3 1280 UMR_MSEC__10_1_M128_S6_S3 -1280 0
 /begin AXIS_DESCR STD_AXIS iSasZentr.iSchaltend.n_tkf UMR_U_MIN_32_1_0_S6_S3 4 0 8160 DEPOSIT ABSOLUTE MONOTONY MON_INCREASE /end AXIS_DESCR
 /begin AXIS_DESCR STD_AXIS zff_atsys._.iSignale._.obj.sig_m_t8 UMR_NM__8_1_M50_S6_S3 4 -400 1640 DEPOSIT ABSOLUTE MONOTONY MON_INCREASE /end AXIS_DESCR
/end CHARACTERISTIC
/begin CHARACTERISTIC KF_FMESASMEHAUPTPOSESP86 "Faktor fuer Reduzierung pos ME bei RS" MAP 0x2328CC kf_si16_S6_S3 1 UMR___1_100_0_S6_S3 0 1
 /begin AXIS_DESCR STD_AXIS iSasZentr.iSchaltend.t_syn UMR_MSEC__10_1_0_S6_S3 4 -327680 327670 DEPOSIT ABSOLUTE MONOTONY MON_INCREASE /end AXIS_DESCR
 /begin AXIS_DESCR STD_AXIS iMoeMesaf.me_sas_gesp UMR_NM__1_1_0_S6_S3 4 0 2000 DEPOSIT ABSOLUTE MONOTONY MON_INCREASE /end AXIS_DESCR
/end CHARACTERISTIC
/begin CHARACTERISTIC KF_FMENACHPOSESP86 "Faktor fuer Reduzierung pos ME bei RS" MAP 0x232904 kf_si16_S6_S3 1 UMR___1_100_0_S6_S3 0 1
 /begin AXIS_DESCR STD_AXIS iMoeMesaf.timer_tsyn_rampe_pos UMR_MSEC__10_1_0_S6_S3 4 -50000 50000 DEPOSIT ABSOLUTE MONOTONY MON_INCREASE /end AXIS_DESCR
 /begin AXIS_DESCR STD_AXIS iMoeMesaf.me_sas_gesp UMR_NM__1_1_0_S6_S3 4 0 2000 DEPOSIT ABSOLUTE MONOTONY MON_INCREASE /end AXIS_DESCR
/end CHARACTERISTIC
/begin CHARACTERISTIC T_RAMEESPORT21 "Dauer Rampe ME bei Schaltungsende" VALUE 0x26E5E3 kw_ui8_S6_S3 2540 UMR_MSEC__10_1_0_S6_S3 0 2540 /end CHARACTERISTIC
/begin CHARACTERISTIC KL_FMENACHESPORT21 "Faktor fuer Rampe Ende Nach-ME bei RS" CURVE 0x23293C kl_ui8_S6_S3 1 UMR___1_100_0_S6_S3 0 1
 /begin AXIS_DESCR STD_AXIS iMoeMesaf.timer_zmes UMR_MSEC__10_1_0_S6_S3 4 0 2550 DEPOSIT ABSOLUTE MONOTONY MON_INCREASE /end AXIS_DESCR
/end CHARACTERISTIC
/begin CHARACTERISTIC T_SYNMENACHESPORT21 "Zeit vor/nach Erkennen synchron fuer Ende Nach-ME" VALUE 0x26E5E4 kw_ui8_S6_S3 2550 UMR_MSEC__10_1_M128_S6_S3 -1280 1270 /end CHARACTERISTIC
/begin CHARACTERISTIC KF_TSYNMENACHASPORT21 "Zeit vor Erkennen synchron fuer Ende Haupt-ME und Start Nach-ME" MAP 0x232948 kf_ui8_S6_S3 1280 UMR_MSEC__10_1_M128_S6_S3 -1280 0
 /begin AXIS_DESCR STD_AXIS zff_atsys._.iSignale._.obj.sig_n_mot8 UMR_U_MIN_32_1_0_S6_S3 4 0 8160 DEPOSIT ABSOLUTE MONOTONY MON_INCREASE /end AXIS_DESCR
 /begin AXIS_DESCR STD_AXIS zff_atsys._.iSignale._.obj.sig_m_t8 UMR_NM__8_1_M50_S6_S3 3 -400 1640 DEPOSIT ABSOLUTE MONOTONY MON_INCREASE /end AXIS_DESCR
/end CHARACTERISTIC
/begin CHARACTERISTIC KF_MENACHSPORT21 "Nachmotoreingriff Schaltablauf" MAP 0x232964 kf_ui8_S6_S3 870 UMR_NM__6_1_M145_S6_S3 -870 0
 /begin AXIS_DESCR STD_AXIS iSasZentr.iSchaltend.n_tkf UMR_U_MIN_32_1_0_S6_S3 6 0 8160 DEPOSIT ABSOLUTE MONOTONY MON_INCREASE /end AXIS_DESCR
 /begin AXIS_DESCR STD_AXIS zff_atsys._.iSignale._.obj.sig_m_t8 UMR_NM__8_1_M50_S6_S3 6 -400 1640 DEPOSIT ABSOLUTE MONOTONY MON_INCREASE /end AXIS_DESCR
/end CHARACTERISTIC
/begin CHARACTERISTIC KF_FMTMEHAUPTASPORT21 "Faktor fuer Rampe auf HME bei RS" MAP 0x23299C kf_ui8_S6_S3 1 UMR___1_100_0_S6_S3 0 1
 /begin AXIS_DESCR STD_AXIS iMoeMesaf.timer_zmes UMR_MSEC__10_1_0_S6_S3 4 0 2550 DEPOSIT ABSOLUTE MONOTONY MON_INCREASE /end AXIS_DESCR
 /begin AXIS_DESCR STD_AXIS zff_atsys._.iSignale._.obj.sig_m_t8 UMR_NM__8_1_M50_S6_S3 4 -400 1640 DEPOSIT ABSOLUTE MONOTONY MON_INCREASE /end AXIS_DESCR
/end CHARACTERISTIC
/begin CHARACTERISTIC KF_MEHAUPTSPORT21 "Wert Hauptmotoreingriff" MAP 0x2329BC kf_ui8_S6_S3 1530 UMR_NM__6_1_M145_S6_S3 -870 660
 /begin AXIS_DESCR STD_AXIS NO_INPUT_QUANTITY UMR_U_MIN_32_1_0_S6_S3 6 0 8160 DEPOSIT ABSOLUTE MONOTONY MON_INCREASE /end AXIS_DESCR
 /begin AXIS_DESCR STD_AXIS zff_atsys._.iSignale._.obj.sig_m_t8 UMR_NM__8_1_M50_S6_S3 10 -400 1640 DEPOSIT ABSOLUTE MONOTONY MON_INCREASE /end AXIS_DESCR
/end CHARACTERISTIC
/begin CHARACTERISTIC KF_TVMTNMOTMEHAUPTSPORT21 "Verzoegerungszeit Start Haupt-ME bei Momentenerhoehung" MAP 0x232A10 kf_ui8_S6_S3 2540 UMR_MSEC__10_1_0_S6_S3 0 2540
 /begin AXIS_DESCR STD_AXIS zff_atsys._.iSignale._.obj.sig_m_t8 UMR_NM__8_1_M50_S6_S3 4 -400 1640 DEPOSIT ABSOLUTE MONOTONY MON_INCREASE /end AXIS_DESCR
 /begin AXIS_DESCR STD_AXIS zff_atsys._.iSignale._.obj.sig_n_mot8 UMR_U_MIN_32_1_0_S6_S3 4 0 8160 DEPOSIT ABSOLUTE MONOTONY MON_INCREASE /end AXIS_DESCR
/end CHARACTERISTIC
/begin CHARACTERISTIC KL_FMEPOSNGABSPORT21 "Faktor zur Gewichtung pos. ME" CURVE 0x232A30 kl_si16_S6_S3 1 UMR___1_100_0_S6_S3 0 1
 /begin AXIS_DESCR STD_AXIS iMoeMesaf.ng_abmesas UMR_U_MINSEC_1_1_0_S6_S3 6 -1000 1000 DEPOSIT ABSOLUTE MONOTONY MON_INCREASE /end AXIS_DESCR
/end CHARACTERISTIC
/begin CHARACTERISTIC KF_TSYNNTKFMTMEHAUPTESPORT21 "Zeitkriterium Ende Haupt-ME bei Momentenerhoehung" MAP 0x232A4C kf_ui8_S6_S3 1280 UMR_MSEC__10_1_M128_S6_S3 -1280 0
 /begin AXIS_DESCR STD_AXIS iSasZentr.iSchaltend.n_tkf UMR_U_MIN_32_1_0_S6_S3 4 0 8160 DEPOSIT ABSOLUTE MONOTONY MON_INCREASE /end AXIS_DESCR
 /begin AXIS_DESCR STD_AXIS zff_atsys._.iSignale._.obj.sig_m_t8 UMR_NM__8_1_M50_S6_S3 4 -400 1640 DEPOSIT ABSOLUTE MONOTONY MON_INCREASE /end AXIS_DESCR
/end CHARACTERISTIC
/begin CHARACTERISTIC KF_FMESASMEHAUPTPOSESPORT21 "Faktor fuer Reduzierung pos ME bei RS" MAP 0x232A6C kf_si16_S6_S3 1 UMR___1_100_0_S6_S3 0 1
 /begin AXIS_DESCR STD_AXIS iSasZentr.iSchaltend.t_syn UMR_MSEC__10_1_0_S6_S3 4 -327680 327670 DEPOSIT ABSOLUTE MONOTONY MON_INCREASE /end AXIS_DESCR
 /begin AXIS_DESCR STD_AXIS iMoeMesaf.me_sas_gesp UMR_NM__1_1_0_S6_S3 4 0 2000 DEPOSIT ABSOLUTE MONOTONY MON_INCREASE /end AXIS_DESCR
/end CHARACTERISTIC
/begin CHARACTERISTIC KF_FMENACHPOSESPORT21 "Faktor fuer Reduzierung pos ME bei RS" MAP 0x232AA4 kf_si16_S6_S3 1 UMR___1_100_0_S6_S3 0 1
 /begin AXIS_DESCR STD_AXIS iMoeMesaf.timer_tsyn_rampe_pos UMR_MSEC__10_1_0_S6_S3 4 -50000 50000 DEPOSIT ABSOLUTE MONOTONY MON_INCREASE /end AXIS_DESCR
 /begin AXIS_DESCR STD_AXIS iMoeMesaf.me_sas_gesp UMR_NM__1_1_0_S6_S3 4 0 2000 DEPOSIT ABSOLUTE MONOTONY MON_INCREASE /end AXIS_DESCR
/end CHARACTERISTIC
/begin CHARACTERISTIC T_RAMEESPORT32 "Dauer Rampe ME bei Schaltungsende" VALUE 0x26E5E5 kw_ui8_S6_S3 2540 UMR_MSEC__10_1_0_S6_S3 0 2540 /end CHARACTERISTIC
/begin CHARACTERISTIC KL_FMENACHESPORT32 "Faktor fuer Rampe Ende Nach-ME bei RS" CURVE 0x232ADC kl_ui8_S6_S3 1 UMR___1_100_0_S6_S3 0 1
 /begin AXIS_DESCR STD_AXIS iMoeMesaf.timer_zmes UMR_MSEC__10_1_0_S6_S3 4 0 2550 DEPOSIT ABSOLUTE MONOTONY MON_INCREASE /end AXIS_DESCR
/end CHARACTERISTIC
/begin CHARACTERISTIC T_SYNMENACHESPORT32 "Zeit vor/nach Erkennen synchron fuer Ende Nach-ME" VALUE 0x26E5E6 kw_ui8_S6_S3 2550 UMR_MSEC__10_1_M128_S6_S3 -1280 1270 /end CHARACTERISTIC
/begin CHARACTERISTIC KF_TSYNMENACHASPORT32 "Zeit vor Erkennen synchron fuer Ende Haupt-ME und Start Nach-ME" MAP 0x232AE8 kf_ui8_S6_S3 1280 UMR_MSEC__10_1_M128_S6_S3 -1280 0
 /begin AXIS_DESCR STD_AXIS zff_atsys._.iSignale._.obj.sig_n_mot8 UMR_U_MIN_32_1_0_S6_S3 4 0 8160 DEPOSIT ABSOLUTE MONOTONY MON_INCREASE /end AXIS_DESCR
 /begin AXIS_DESCR STD_AXIS zff_atsys._.iSignale._.obj.sig_m_t8 UMR_NM__8_1_M50_S6_S3 3 -400 1640 DEPOSIT ABSOLUTE MONOTONY MON_INCREASE /end AXIS_DESCR
/end CHARACTERISTIC
/begin CHARACTERISTIC KF_MENACHSPORT32 "Nachmotoreingriff Schaltablauf" MAP 0x232B04 kf_ui8_S6_S3 870 UMR_NM__6_1_M145_S6_S3 -870 0
 /begin AXIS_DESCR STD_AXIS iSasZentr.iSchaltend.n_tkf UMR_U_MIN_32_1_0_S6_S3 6 0 8160 DEPOSIT ABSOLUTE MONOTONY MON_INCREASE /end AXIS_DESCR
 /begin AXIS_DESCR STD_AXIS zff_atsys._.iSignale._.obj.sig_m_t8 UMR_NM__8_1_M50_S6_S3 6 -400 1640 DEPOSIT ABSOLUTE MONOTONY MON_INCREASE /end AXIS_DESCR
/end CHARACTERISTIC
/begin CHARACTERISTIC KF_FMTMEHAUPTASPORT32 "Faktor fuer Rampe auf HME bei RS" MAP 0x232B3C kf_ui8_S6_S3 1 UMR___1_100_0_S6_S3 0 1
 /begin AXIS_DESCR STD_AXIS iMoeMesaf.timer_zmes UMR_MSEC__10_1_0_S6_S3 4 0 2550 DEPOSIT ABSOLUTE MONOTONY MON_INCREASE /end AXIS_DESCR
 /begin AXIS_DESCR STD_AXIS zff_atsys._.iSignale._.obj.sig_m_t8 UMR_NM__8_1_M50_S6_S3 4 -400 1640 DEPOSIT ABSOLUTE MONOTONY MON_INCREASE /end AXIS_DESCR
/end CHARACTERISTIC
/begin CHARACTERISTIC KF_MEHAUPTSPORT32 "Wert Hauptmotoreingriff" MAP 0x232B5C kf_ui8_S6_S3 1530 UMR_NM__6_1_M145_S6_S3 -870 660
 /begin AXIS_DESCR STD_AXIS NO_INPUT_QUANTITY UMR_U_MIN_32_1_0_S6_S3 6 0 8160 DEPOSIT ABSOLUTE MONOTONY MON_INCREASE /end AXIS_DESCR
 /begin AXIS_DESCR STD_AXIS zff_atsys._.iSignale._.obj.sig_m_t8 UMR_NM__8_1_M50_S6_S3 10 -400 1640 DEPOSIT ABSOLUTE MONOTONY MON_INCREASE /end AXIS_DESCR
/end CHARACTERISTIC
/begin CHARACTERISTIC KF_TVMTNMOTMEHAUPTSPORT32 "Verzoegerungszeit Start Haupt-ME bei Momentenerhoehung" MAP 0x232BB0 kf_ui8_S6_S3 2540 UMR_MSEC__10_1_0_S6_S3 0 2540
 /begin AXIS_DESCR STD_AXIS zff_atsys._.iSignale._.obj.sig_m_t8 UMR_NM__8_1_M50_S6_S3 4 -400 1640 DEPOSIT ABSOLUTE MONOTONY MON_INCREASE /end AXIS_DESCR
 /begin AXIS_DESCR STD_AXIS zff_atsys._.iSignale._.obj.sig_n_mot8 UMR_U_MIN_32_1_0_S6_S3 4 0 8160 DEPOSIT ABSOLUTE MONOTONY MON_INCREASE /end AXIS_DESCR
/end CHARACTERISTIC
/begin CHARACTERISTIC KL_FMEPOSNGABSPORT32 "Faktor zur Gewichtung pos. ME" CURVE 0x232BD0 kl_si16_S6_S3 1 UMR___1_100_0_S6_S3 0 1
 /begin AXIS_DESCR STD_AXIS iMoeMesaf.ng_abmesas UMR_U_MINSEC_1_1_0_S6_S3 6 -1000 1000 DEPOSIT ABSOLUTE MONOTONY MON_INCREASE /end AXIS_DESCR
/end CHARACTERISTIC
/begin CHARACTERISTIC KF_TSYNNTKFMTMEHAUPTESPORT32 "Zeitkriterium Ende Haupt-ME bei Momentenerhoehung" MAP 0x232BEC kf_ui8_S6_S3 1280 UMR_MSEC__10_1_M128_S6_S3 -1280 0
 /begin AXIS_DESCR STD_AXIS iSasZentr.iSchaltend.n_tkf UMR_U_MIN_32_1_0_S6_S3 4 0 8160 DEPOSIT ABSOLUTE MONOTONY MON_INCREASE /end AXIS_DESCR
 /begin AXIS_DESCR STD_AXIS zff_atsys._.iSignale._.obj.sig_m_t8 UMR_NM__8_1_M50_S6_S3 4 -400 1640 DEPOSIT ABSOLUTE MONOTONY MON_INCREASE /end AXIS_DESCR
/end CHARACTERISTIC
/begin CHARACTERISTIC KF_FMESASMEHAUPTPOSESPORT32 "Faktor fuer Reduzierung pos ME bei RS" MAP 0x232C0C kf_si16_S6_S3 1 UMR___1_100_0_S6_S3 0 1
 /begin AXIS_DESCR STD_AXIS iSasZentr.iSchaltend.t_syn UMR_MSEC__10_1_0_S6_S3 4 -327680 327670 DEPOSIT ABSOLUTE MONOTONY MON_INCREASE /end AXIS_DESCR
 /begin AXIS_DESCR STD_AXIS iMoeMesaf.me_sas_gesp UMR_NM__1_1_0_S6_S3 4 0 2000 DEPOSIT ABSOLUTE MONOTONY MON_INCREASE /end AXIS_DESCR
/end CHARACTERISTIC
/begin CHARACTERISTIC KF_FMENACHPOSESPORT32 "Faktor fuer Reduzierung pos ME bei RS" MAP 0x232C44 kf_si16_S6_S3 1 UMR___1_100_0_S6_S3 0 1
 /begin AXIS_DESCR STD_AXIS iMoeMesaf.timer_tsyn_rampe_pos UMR_MSEC__10_1_0_S6_S3 4 -50000 50000 DEPOSIT ABSOLUTE MONOTONY MON_INCREASE /end AXIS_DESCR
 /begin AXIS_DESCR STD_AXIS iMoeMesaf.me_sas_gesp UMR_NM__1_1_0_S6_S3 4 0 2000 DEPOSIT ABSOLUTE MONOTONY MON_INCREASE /end AXIS_DESCR
/end CHARACTERISTIC
/begin CHARACTERISTIC T_RAMEESPORT43 "Dauer Rampe ME bei Schaltungsende" VALUE 0x26E5E7 kw_ui8_S6_S3 2540 UMR_MSEC__10_1_0_S6_S3 0 2540 /end CHARACTERISTIC
/begin CHARACTERISTIC KL_FMENACHESPORT43 "Faktor fuer Rampe Ende Nach-ME bei RS" CURVE 0x232C7C kl_ui8_S6_S3 1 UMR___1_100_0_S6_S3 0 1
 /begin AXIS_DESCR STD_AXIS iMoeMesaf.timer_zmes UMR_MSEC__10_1_0_S6_S3 4 0 2550 DEPOSIT ABSOLUTE MONOTONY MON_INCREASE /end AXIS_DESCR
/end CHARACTERISTIC
/begin CHARACTERISTIC T_SYNMENACHESPORT43 "Zeit vor/nach Erkennen synchron fuer Ende Nach-ME" VALUE 0x26E5E8 kw_ui8_S6_S3 2550 UMR_MSEC__10_1_M128_S6_S3 -1280 1270 /end CHARACTERISTIC
/begin CHARACTERISTIC KF_TSYNMENACHASPORT43 "Zeit vor Erkennen synchron fuer Ende Haupt-ME und Start Nach-ME" MAP 0x232C88 kf_ui8_S6_S3 1280 UMR_MSEC__10_1_M128_S6_S3 -1280 0
 /begin AXIS_DESCR STD_AXIS zff_atsys._.iSignale._.obj.sig_n_mot8 UMR_U_MIN_32_1_0_S6_S3 4 0 8160 DEPOSIT ABSOLUTE MONOTONY MON_INCREASE /end AXIS_DESCR
 /begin AXIS_DESCR STD_AXIS zff_atsys._.iSignale._.obj.sig_m_t8 UMR_NM__8_1_M50_S6_S3 3 -400 1640 DEPOSIT ABSOLUTE MONOTONY MON_INCREASE /end AXIS_DESCR
/end CHARACTERISTIC
/begin CHARACTERISTIC KF_MENACHSPORT43 "Nachmotoreingriff Schaltablauf" MAP 0x232CA4 kf_ui8_S6_S3 870 UMR_NM__6_1_M145_S6_S3 -870 0
 /begin AXIS_DESCR STD_AXIS iSasZentr.iSchaltend.n_tkf UMR_U_MIN_32_1_0_S6_S3 6 0 8160 DEPOSIT ABSOLUTE MONOTONY MON_INCREASE /end AXIS_DESCR
 /begin AXIS_DESCR STD_AXIS zff_atsys._.iSignale._.obj.sig_m_t8 UMR_NM__8_1_M50_S6_S3 6 -400 1640 DEPOSIT ABSOLUTE MONOTONY MON_INCREASE /end AXIS_DESCR
/end CHARACTERISTIC
/begin CHARACTERISTIC KF_FMTMEHAUPTASPORT43 "Faktor fuer Rampe auf HME bei RS" MAP 0x232CDC kf_ui8_S6_S3 1 UMR___1_100_0_S6_S3 0 1
 /begin AXIS_DESCR STD_AXIS iMoeMesaf.timer_zmes UMR_MSEC__10_1_0_S6_S3 4 0 2550 DEPOSIT ABSOLUTE MONOTONY MON_INCREASE /end AXIS_DESCR
 /begin AXIS_DESCR STD_AXIS zff_atsys._.iSignale._.obj.sig_m_t8 UMR_NM__8_1_M50_S6_S3 4 -400 1640 DEPOSIT ABSOLUTE MONOTONY MON_INCREASE /end AXIS_DESCR
/end CHARACTERISTIC
/begin CHARACTERISTIC KF_MEHAUPTSPORT43 "Wert Hauptmotoreingriff" MAP 0x232CFC kf_ui8_S6_S3 1530 UMR_NM__6_1_M145_S6_S3 -870 660
 /begin AXIS_DESCR STD_AXIS NO_INPUT_QUANTITY UMR_U_MIN_32_1_0_S6_S3 6 0 8160 DEPOSIT ABSOLUTE MONOTONY MON_INCREASE /end AXIS_DESCR
 /begin AXIS_DESCR STD_AXIS zff_atsys._.iSignale._.obj.sig_m_t8 UMR_NM__8_1_M50_S6_S3 10 -400 1640 DEPOSIT ABSOLUTE MONOTONY MON_INCREASE /end AXIS_DESCR
/end CHARACTERISTIC
/begin CHARACTERISTIC KF_TVMTNMOTMEHAUPTSPORT43 "Verzoegerungszeit Start Haupt-ME bei Momentenerhoehung" MAP 0x232D50 kf_ui8_S6_S3 2540 UMR_MSEC__10_1_0_S6_S3 0 2540
 /begin AXIS_DESCR STD_AXIS zff_atsys._.iSignale._.obj.sig_m_t8 UMR_NM__8_1_M50_S6_S3 4 -400 1640 DEPOSIT ABSOLUTE MONOTONY MON_INCREASE /end AXIS_DESCR
 /begin AXIS_DESCR STD_AXIS zff_atsys._.iSignale._.obj.sig_n_mot8 UMR_U_MIN_32_1_0_S6_S3 4 0 8160 DEPOSIT ABSOLUTE MONOTONY MON_INCREASE /end AXIS_DESCR
/end CHARACTERISTIC
/begin CHARACTERISTIC KL_FMEPOSNGABSPORT43 "Faktor zur Gewichtung pos. ME" CURVE 0x232D70 kl_si16_S6_S3 1 UMR___1_100_0_S6_S3 0 1
 /begin AXIS_DESCR STD_AXIS iMoeMesaf.ng_abmesas UMR_U_MINSEC_1_1_0_S6_S3 6 -1000 1000 DEPOSIT ABSOLUTE MONOTONY MON_INCREASE /end AXIS_DESCR
/end CHARACTERISTIC
/begin CHARACTERISTIC KF_TSYNNTKFMTMEHAUPTESPORT43 "Zeitkriterium Ende Haupt-ME bei Momentenerhoehung" MAP 0x232D8C kf_ui8_S6_S3 1280 UMR_MSEC__10_1_M128_S6_S3 -1280 0
 /begin AXIS_DESCR STD_AXIS iSasZentr.iSchaltend.n_tkf UMR_U_MIN_32_1_0_S6_S3 4 0 8160 DEPOSIT ABSOLUTE MONOTONY MON_INCREASE /end AXIS_DESCR
 /begin AXIS_DESCR STD_AXIS zff_atsys._.iSignale._.obj.sig_m_t8 UMR_NM__8_1_M50_S6_S3 4 -400 1640 DEPOSIT ABSOLUTE MONOTONY MON_INCREASE /end AXIS_DESCR
/end CHARACTERISTIC
/begin CHARACTERISTIC KF_FMESASMEHAUPTPOSESPORT43 "Faktor fuer Reduzierung pos ME bei RS" MAP 0x232DAC kf_si16_S6_S3 1 UMR___1_100_0_S6_S3 0 1
 /begin AXIS_DESCR STD_AXIS iSasZentr.iSchaltend.t_syn UMR_MSEC__10_1_0_S6_S3 4 -327680 327670 DEPOSIT ABSOLUTE MONOTONY MON_INCREASE /end AXIS_DESCR
 /begin AXIS_DESCR STD_AXIS iMoeMesaf.me_sas_gesp UMR_NM__1_1_0_S6_S3 4 0 2000 DEPOSIT ABSOLUTE MONOTONY MON_INCREASE /end AXIS_DESCR
/end CHARACTERISTIC
/begin CHARACTERISTIC KF_FMENACHPOSESPORT43 "Faktor fuer Reduzierung pos ME bei RS" MAP 0x232DE4 kf_si16_S6_S3 1 UMR___1_100_0_S6_S3 0 1
 /begin AXIS_DESCR STD_AXIS iMoeMesaf.timer_tsyn_rampe_pos UMR_MSEC__10_1_0_S6_S3 4 -50000 50000 DEPOSIT ABSOLUTE MONOTONY MON_INCREASE /end AXIS_DESCR
 /begin AXIS_DESCR STD_AXIS iMoeMesaf.me_sas_gesp UMR_NM__1_1_0_S6_S3 4 0 2000 DEPOSIT ABSOLUTE MONOTONY MON_INCREASE /end AXIS_DESCR
/end CHARACTERISTIC
/begin CHARACTERISTIC T_RAMEESPORT54 "Dauer Rampe ME bei Schaltungsende" VALUE 0x26E5E9 kw_ui8_S6_S3 2540 UMR_MSEC__10_1_0_S6_S3 0 2540 /end CHARACTERISTIC
/begin CHARACTERISTIC KL_FMENACHESPORT54 "Faktor fuer Rampe Ende Nach-ME bei RS" CURVE 0x232E1C kl_ui8_S6_S3 1 UMR___1_100_0_S6_S3 0 1
 /begin AXIS_DESCR STD_AXIS iMoeMesaf.timer_zmes UMR_MSEC__10_1_0_S6_S3 4 0 2550 DEPOSIT ABSOLUTE MONOTONY MON_INCREASE /end AXIS_DESCR
/end CHARACTERISTIC
/begin CHARACTERISTIC T_SYNMENACHESPORT54 "Zeit vor/nach Erkennen synchron fuer Ende Nach-ME" VALUE 0x26E5EA kw_ui8_S6_S3 2550 UMR_MSEC__10_1_M128_S6_S3 -1280 1270 /end CHARACTERISTIC
/begin CHARACTERISTIC KF_TSYNMENACHASPORT54 "Zeit vor Erkennen synchron fuer Ende Haupt-ME und Start Nach-ME" MAP 0x232E28 kf_ui8_S6_S3 1280 UMR_MSEC__10_1_M128_S6_S3 -1280 0
 /begin AXIS_DESCR STD_AXIS zff_atsys._.iSignale._.obj.sig_n_mot8 UMR_U_MIN_32_1_0_S6_S3 4 0 8160 DEPOSIT ABSOLUTE MONOTONY MON_INCREASE /end AXIS_DESCR
 /begin AXIS_DESCR STD_AXIS zff_atsys._.iSignale._.obj.sig_m_t8 UMR_NM__8_1_M50_S6_S3 3 -400 1640 DEPOSIT ABSOLUTE MONOTONY MON_INCREASE /end AXIS_DESCR
/end CHARACTERISTIC
/begin CHARACTERISTIC KF_MENACHSPORT54 "Nachmotoreingriff Schaltablauf" MAP 0x232E44 kf_ui8_S6_S3 870 UMR_NM__6_1_M145_S6_S3 -870 0
 /begin AXIS_DESCR STD_AXIS iSasZentr.iSchaltend.n_tkf UMR_U_MIN_32_1_0_S6_S3 6 0 8160 DEPOSIT ABSOLUTE MONOTONY MON_INCREASE /end AXIS_DESCR
 /begin AXIS_DESCR STD_AXIS zff_atsys._.iSignale._.obj.sig_m_t8 UMR_NM__8_1_M50_S6_S3 6 -400 1640 DEPOSIT ABSOLUTE MONOTONY MON_INCREASE /end AXIS_DESCR
/end CHARACTERISTIC
/begin CHARACTERISTIC KF_FMTMEHAUPTASPORT54 "Faktor fuer Rampe auf HME bei RS" MAP 0x232E7C kf_ui8_S6_S3 1 UMR___1_100_0_S6_S3 0 1
 /begin AXIS_DESCR STD_AXIS iMoeMesaf.timer_zmes UMR_MSEC__10_1_0_S6_S3 4 0 2550 DEPOSIT ABSOLUTE MONOTONY MON_INCREASE /end AXIS_DESCR
 /begin AXIS_DESCR STD_AXIS zff_atsys._.iSignale._.obj.sig_m_t8 UMR_NM__8_1_M50_S6_S3 4 -400 1640 DEPOSIT ABSOLUTE MONOTONY MON_INCREASE /end AXIS_DESCR
/end CHARACTERISTIC
/begin CHARACTERISTIC KF_MEHAUPTSPORT54 "Wert Hauptmotoreingriff" MAP 0x232E9C kf_ui8_S6_S3 1530 UMR_NM__6_1_M145_S6_S3 -870 660
 /begin AXIS_DESCR STD_AXIS NO_INPUT_QUANTITY UMR_U_MIN_32_1_0_S6_S3 6 0 8160 DEPOSIT ABSOLUTE MONOTONY MON_INCREASE /end AXIS_DESCR
 /begin AXIS_DESCR STD_AXIS zff_atsys._.iSignale._.obj.sig_m_t8 UMR_NM__8_1_M50_S6_S3 10 -400 1640 DEPOSIT ABSOLUTE MONOTONY MON_INCREASE /end AXIS_DESCR
/end CHARACTERISTIC
/begin CHARACTERISTIC KF_TVMTNMOTMEHAUPTSPORT54 "Verzoegerungszeit Start Haupt-ME bei Momentenerhoehung" MAP 0x232EF0 kf_ui8_S6_S3 2540 UMR_MSEC__10_1_0_S6_S3 0 2540
 /begin AXIS_DESCR STD_AXIS zff_atsys._.iSignale._.obj.sig_m_t8 UMR_NM__8_1_M50_S6_S3 4 -400 1640 DEPOSIT ABSOLUTE MONOTONY MON_INCREASE /end AXIS_DESCR
 /begin AXIS_DESCR STD_AXIS zff_atsys._.iSignale._.obj.sig_n_mot8 UMR_U_MIN_32_1_0_S6_S3 4 0 8160 DEPOSIT ABSOLUTE MONOTONY MON_INCREASE /end AXIS_DESCR
/end CHARACTERISTIC
/begin CHARACTERISTIC KL_FMEPOSNGABSPORT54 "Faktor zur Gewichtung pos. ME" CURVE 0x232F10 kl_si16_S6_S3 1 UMR___1_100_0_S6_S3 0 1
 /begin AXIS_DESCR STD_AXIS iMoeMesaf.ng_abmesas UMR_U_MINSEC_1_1_0_S6_S3 6 -1000 1000 DEPOSIT ABSOLUTE MONOTONY MON_INCREASE /end AXIS_DESCR
/end CHARACTERISTIC
/begin CHARACTERISTIC KF_TSYNNTKFMTMEHAUPTESPORT54 "Zeitkriterium Ende Haupt-ME bei Momentenerhoehung" MAP 0x232F2C kf_ui8_S6_S3 1280 UMR_MSEC__10_1_M128_S6_S3 -1280 0
 /begin AXIS_DESCR STD_AXIS iSasZentr.iSchaltend.n_tkf UMR_U_MIN_32_1_0_S6_S3 4 0 8160 DEPOSIT ABSOLUTE MONOTONY MON_INCREASE /end AXIS_DESCR
 /begin AXIS_DESCR STD_AXIS zff_atsys._.iSignale._.obj.sig_m_t8 UMR_NM__8_1_M50_S6_S3 4 -400 1640 DEPOSIT ABSOLUTE MONOTONY MON_INCREASE /end AXIS_DESCR
/end CHARACTERISTIC
/begin CHARACTERISTIC KF_FMESASMEHAUPTPOSESPORT54 "Faktor fuer Reduzierung pos ME bei RS" MAP 0x232F4C kf_si16_S6_S3 1 UMR___1_100_0_S6_S3 0 1
 /begin AXIS_DESCR STD_AXIS iSasZentr.iSchaltend.t_syn UMR_MSEC__10_1_0_S6_S3 4 -327680 327670 DEPOSIT ABSOLUTE MONOTONY MON_INCREASE /end AXIS_DESCR
 /begin AXIS_DESCR STD_AXIS iMoeMesaf.me_sas_gesp UMR_NM__1_1_0_S6_S3 4 0 2000 DEPOSIT ABSOLUTE MONOTONY MON_INCREASE /end AXIS_DESCR
/end CHARACTERISTIC
/begin CHARACTERISTIC KF_FMENACHPOSESPORT54 "Faktor fuer Reduzierung pos ME bei RS" MAP 0x232F84 kf_si16_S6_S3 1 UMR___1_100_0_S6_S3 0 1
 /begin AXIS_DESCR STD_AXIS iMoeMesaf.timer_tsyn_rampe_pos UMR_MSEC__10_1_0_S6_S3 4 -50000 50000 DEPOSIT ABSOLUTE MONOTONY MON_INCREASE /end AXIS_DESCR
 /begin AXIS_DESCR STD_AXIS iMoeMesaf.me_sas_gesp UMR_NM__1_1_0_S6_S3 4 0 2000 DEPOSIT ABSOLUTE MONOTONY MON_INCREASE /end AXIS_DESCR
/end CHARACTERISTIC
/begin CHARACTERISTIC T_RAMEESPORT65 "Dauer Rampe ME bei Schaltungsende" VALUE 0x26E5EB kw_ui8_S6_S3 2540 UMR_MSEC__10_1_0_S6_S3 0 2540 /end CHARACTERISTIC
/begin CHARACTERISTIC KL_FMENACHESPORT65 "Faktor fuer Rampe Ende Nach-ME bei RS" CURVE 0x232FBC kl_ui8_S6_S3 1 UMR___1_100_0_S6_S3 0 1
 /begin AXIS_DESCR STD_AXIS iMoeMesaf.timer_zmes UMR_MSEC__10_1_0_S6_S3 4 0 2550 DEPOSIT ABSOLUTE MONOTONY MON_INCREASE /end AXIS_DESCR
/end CHARACTERISTIC
/begin CHARACTERISTIC T_SYNMENACHESPORT65 "Zeit vor/nach Erkennen synchron fuer Ende Nach-ME" VALUE 0x26E5EC kw_ui8_S6_S3 2550 UMR_MSEC__10_1_M128_S6_S3 -1280 1270 /end CHARACTERISTIC
/begin CHARACTERISTIC KF_TSYNMENACHASPORT65 "Zeit vor Erkennen synchron fuer Ende Haupt-ME und Start Nach-ME" MAP 0x232FC8 kf_ui8_S6_S3 1280 UMR_MSEC__10_1_M128_S6_S3 -1280 0
 /begin AXIS_DESCR STD_AXIS zff_atsys._.iSignale._.obj.sig_n_mot8 UMR_U_MIN_32_1_0_S6_S3 4 0 8160 DEPOSIT ABSOLUTE MONOTONY MON_INCREASE /end AXIS_DESCR
 /begin AXIS_DESCR STD_AXIS zff_atsys._.iSignale._.obj.sig_m_t8 UMR_NM__8_1_M50_S6_S3 3 -400 1640 DEPOSIT ABSOLUTE MONOTONY MON_INCREASE /end AXIS_DESCR
/end CHARACTERISTIC
/begin CHARACTERISTIC KF_MENACHSPORT65 "Nachmotoreingriff Schaltablauf" MAP 0x232FE4 kf_ui8_S6_S3 870 UMR_NM__6_1_M145_S6_S3 -870 0
 /begin AXIS_DESCR STD_AXIS iSasZentr.iSchaltend.n_tkf UMR_U_MIN_32_1_0_S6_S3 6 0 8160 DEPOSIT ABSOLUTE MONOTONY MON_INCREASE /end AXIS_DESCR
 /begin AXIS_DESCR STD_AXIS zff_atsys._.iSignale._.obj.sig_m_t8 UMR_NM__8_1_M50_S6_S3 6 -400 1640 DEPOSIT ABSOLUTE MONOTONY MON_INCREASE /end AXIS_DESCR
/end CHARACTERISTIC
/begin CHARACTERISTIC KF_FMTMEHAUPTASPORT65 "Faktor fuer Rampe auf HME bei RS" MAP 0x23301C kf_ui8_S6_S3 1 UMR___1_100_0_S6_S3 0 1
 /begin AXIS_DESCR STD_AXIS iMoeMesaf.timer_zmes UMR_MSEC__10_1_0_S6_S3 4 0 2550 DEPOSIT ABSOLUTE MONOTONY MON_INCREASE /end AXIS_DESCR
 /begin AXIS_DESCR STD_AXIS zff_atsys._.iSignale._.obj.sig_m_t8 UMR_NM__8_1_M50_S6_S3 4 -400 1640 DEPOSIT ABSOLUTE MONOTONY MON_INCREASE /end AXIS_DESCR
/end CHARACTERISTIC
/begin CHARACTERISTIC KF_MEHAUPTSPORT65 "Wert Hauptmotoreingriff" MAP 0x23303C kf_ui8_S6_S3 1530 UMR_NM__6_1_M145_S6_S3 -870 660
 /begin AXIS_DESCR STD_AXIS NO_INPUT_QUANTITY UMR_U_MIN_32_1_0_S6_S3 6 0 8160 DEPOSIT ABSOLUTE MONOTONY MON_INCREASE /end AXIS_DESCR
 /begin AXIS_DESCR STD_AXIS zff_atsys._.iSignale._.obj.sig_m_t8 UMR_NM__8_1_M50_S6_S3 10 -400 1640 DEPOSIT ABSOLUTE MONOTONY MON_INCREASE /end AXIS_DESCR
/end CHARACTERISTIC
/begin CHARACTERISTIC KF_TVMTNMOTMEHAUPTSPORT65 "Verzoegerungszeit Start Haupt-ME bei Momentenerhoehung" MAP 0x233090 kf_ui8_S6_S3 2540 UMR_MSEC__10_1_0_S6_S3 0 2540
 /begin AXIS_DESCR STD_AXIS zff_atsys._.iSignale._.obj.sig_m_t8 UMR_NM__8_1_M50_S6_S3 4 -400 1640 DEPOSIT ABSOLUTE MONOTONY MON_INCREASE /end AXIS_DESCR
 /begin AXIS_DESCR STD_AXIS zff_atsys._.iSignale._.obj.sig_n_mot8 UMR_U_MIN_32_1_0_S6_S3 4 0 8160 DEPOSIT ABSOLUTE MONOTONY MON_INCREASE /end AXIS_DESCR
/end CHARACTERISTIC
/begin CHARACTERISTIC KL_FMEPOSNGABSPORT65 "Faktor zur Gewichtung pos. ME" CURVE 0x2330B0 kl_si16_S6_S3 1 UMR___1_100_0_S6_S3 0 1
 /begin AXIS_DESCR STD_AXIS iMoeMesaf.ng_abmesas UMR_U_MINSEC_1_1_0_S6_S3 6 -1000 1000 DEPOSIT ABSOLUTE MONOTONY MON_INCREASE /end AXIS_DESCR
/end CHARACTERISTIC
/begin CHARACTERISTIC KF_TSYNNTKFMTMEHAUPTESPORT65 "Zeitkriterium Ende Haupt-ME bei Momentenerhoehung" MAP 0x2330CC kf_ui8_S6_S3 1280 UMR_MSEC__10_1_M128_S6_S3 -1280 0
 /begin AXIS_DESCR STD_AXIS iSasZentr.iSchaltend.n_tkf UMR_U_MIN_32_1_0_S6_S3 4 0 8160 DEPOSIT ABSOLUTE MONOTONY MON_INCREASE /end AXIS_DESCR
 /begin AXIS_DESCR STD_AXIS zff_atsys._.iSignale._.obj.sig_m_t8 UMR_NM__8_1_M50_S6_S3 4 -400 1640 DEPOSIT ABSOLUTE MONOTONY MON_INCREASE /end AXIS_DESCR
/end CHARACTERISTIC
/begin CHARACTERISTIC KF_FMESASMEHAUPTPOSESPORT65 "Faktor fuer Reduzierung pos ME bei RS" MAP 0x2330EC kf_si16_S6_S3 1 UMR___1_100_0_S6_S3 0 1
 /begin AXIS_DESCR STD_AXIS iSasZentr.iSchaltend.t_syn UMR_MSEC__10_1_0_S6_S3 4 -327680 327670 DEPOSIT ABSOLUTE MONOTONY MON_INCREASE /end AXIS_DESCR
 /begin AXIS_DESCR STD_AXIS iMoeMesaf.me_sas_gesp UMR_NM__1_1_0_S6_S3 4 0 2000 DEPOSIT ABSOLUTE MONOTONY MON_INCREASE /end AXIS_DESCR
/end CHARACTERISTIC
/begin CHARACTERISTIC KF_FMENACHPOSESPORT65 "Faktor fuer Reduzierung pos ME bei RS" MAP 0x233124 kf_si16_S6_S3 1 UMR___1_100_0_S6_S3 0 1
 /begin AXIS_DESCR STD_AXIS iMoeMesaf.timer_tsyn_rampe_pos UMR_MSEC__10_1_0_S6_S3 4 -50000 50000 DEPOSIT ABSOLUTE MONOTONY MON_INCREASE /end AXIS_DESCR
 /begin AXIS_DESCR STD_AXIS iMoeMesaf.me_sas_gesp UMR_NM__1_1_0_S6_S3 4 0 2000 DEPOSIT ABSOLUTE MONOTONY MON_INCREASE /end AXIS_DESCR
/end CHARACTERISTIC
/begin CHARACTERISTIC T_RAMEESPORT76 "Dauer Rampe ME bei Schaltungsende" VALUE 0x26E5ED kw_ui8_S6_S3 2540 UMR_MSEC__10_1_0_S6_S3 0 2540 /end CHARACTERISTIC
/begin CHARACTERISTIC KL_FMENACHESPORT76 "Faktor fuer Rampe Ende Nach-ME bei RS" CURVE 0x23315C kl_ui8_S6_S3 1 UMR___1_100_0_S6_S3 0 1
 /begin AXIS_DESCR STD_AXIS iMoeMesaf.timer_zmes UMR_MSEC__10_1_0_S6_S3 4 0 2550 DEPOSIT ABSOLUTE MONOTONY MON_INCREASE /end AXIS_DESCR
/end CHARACTERISTIC
/begin CHARACTERISTIC T_SYNMENACHESPORT76 "Zeit vor/nach Erkennen synchron fuer Ende Nach-ME" VALUE 0x26E5EE kw_ui8_S6_S3 2550 UMR_MSEC__10_1_M128_S6_S3 -1280 1270 /end CHARACTERISTIC
/begin CHARACTERISTIC KF_TSYNMENACHASPORT76 "Zeit vor Erkennen synchron fuer Ende Haupt-ME und Start Nach-ME" MAP 0x233168 kf_ui8_S6_S3 1280 UMR_MSEC__10_1_M128_S6_S3 -1280 0
 /begin AXIS_DESCR STD_AXIS zff_atsys._.iSignale._.obj.sig_n_mot8 UMR_U_MIN_32_1_0_S6_S3 4 0 8160 DEPOSIT ABSOLUTE MONOTONY MON_INCREASE /end AXIS_DESCR
 /begin AXIS_DESCR STD_AXIS zff_atsys._.iSignale._.obj.sig_m_t8 UMR_NM__8_1_M50_S6_S3 3 -400 1640 DEPOSIT ABSOLUTE MONOTONY MON_INCREASE /end AXIS_DESCR
/end CHARACTERISTIC
/begin CHARACTERISTIC KF_MENACHSPORT76 "Nachmotoreingriff Schaltablauf" MAP 0x233184 kf_ui8_S6_S3 870 UMR_NM__6_1_M145_S6_S3 -870 0
 /begin AXIS_DESCR STD_AXIS iSasZentr.iSchaltend.n_tkf UMR_U_MIN_32_1_0_S6_S3 6 0 8160 DEPOSIT ABSOLUTE MONOTONY MON_INCREASE /end AXIS_DESCR
 /begin AXIS_DESCR STD_AXIS zff_atsys._.iSignale._.obj.sig_m_t8 UMR_NM__8_1_M50_S6_S3 6 -400 1640 DEPOSIT ABSOLUTE MONOTONY MON_INCREASE /end AXIS_DESCR
/end CHARACTERISTIC
/begin CHARACTERISTIC KF_FMTMEHAUPTASPORT76 "Faktor fuer Rampe auf HME bei RS" MAP 0x2331BC kf_ui8_S6_S3 1 UMR___1_100_0_S6_S3 0 1
 /begin AXIS_DESCR STD_AXIS iMoeMesaf.timer_zmes UMR_MSEC__10_1_0_S6_S3 4 0 2550 DEPOSIT ABSOLUTE MONOTONY MON_INCREASE /end AXIS_DESCR
 /begin AXIS_DESCR STD_AXIS zff_atsys._.iSignale._.obj.sig_m_t8 UMR_NM__8_1_M50_S6_S3 4 -400 1640 DEPOSIT ABSOLUTE MONOTONY MON_INCREASE /end AXIS_DESCR
/end CHARACTERISTIC
/begin CHARACTERISTIC KF_MEHAUPTSPORT76 "Wert Hauptmotoreingriff" MAP 0x2331DC kf_ui8_S6_S3 1530 UMR_NM__6_1_M145_S6_S3 -870 660
 /begin AXIS_DESCR STD_AXIS NO_INPUT_QUANTITY UMR_U_MIN_32_1_0_S6_S3 6 0 8160 DEPOSIT ABSOLUTE MONOTONY MON_INCREASE /end AXIS_DESCR
 /begin AXIS_DESCR STD_AXIS zff_atsys._.iSignale._.obj.sig_m_t8 UMR_NM__8_1_M50_S6_S3 10 -400 1640 DEPOSIT ABSOLUTE MONOTONY MON_INCREASE /end AXIS_DESCR
/end CHARACTERISTIC
/begin CHARACTERISTIC KF_TVMTNMOTMEHAUPTSPORT76 "Verzoegerungszeit Start Haupt-ME bei Momentenerhoehung" MAP 0x233230 kf_ui8_S6_S3 2540 UMR_MSEC__10_1_0_S6_S3 0 2540
 /begin AXIS_DESCR STD_AXIS zff_atsys._.iSignale._.obj.sig_m_t8 UMR_NM__8_1_M50_S6_S3 4 -400 1640 DEPOSIT ABSOLUTE MONOTONY MON_INCREASE /end AXIS_DESCR
 /begin AXIS_DESCR STD_AXIS zff_atsys._.iSignale._.obj.sig_n_mot8 UMR_U_MIN_32_1_0_S6_S3 4 0 8160 DEPOSIT ABSOLUTE MONOTONY MON_INCREASE /end AXIS_DESCR
/end CHARACTERISTIC
/begin CHARACTERISTIC KL_FMEPOSNGABSPORT76 "Faktor zur Gewichtung pos. ME" CURVE 0x233250 kl_si16_S6_S3 1 UMR___1_100_0_S6_S3 0 1
 /begin AXIS_DESCR STD_AXIS iMoeMesaf.ng_abmesas UMR_U_MINSEC_1_1_0_S6_S3 6 -1000 1000 DEPOSIT ABSOLUTE MONOTONY MON_INCREASE /end AXIS_DESCR
/end CHARACTERISTIC
/begin CHARACTERISTIC KF_TSYNNTKFMTMEHAUPTESPORT76 "Zeitkriterium Ende Haupt-ME bei Momentenerhoehung" MAP 0x23326C kf_ui8_S6_S3 1280 UMR_MSEC__10_1_M128_S6_S3 -1280 0
 /begin AXIS_DESCR STD_AXIS iSasZentr.iSchaltend.n_tkf UMR_U_MIN_32_1_0_S6_S3 4 0 8160 DEPOSIT ABSOLUTE MONOTONY MON_INCREASE /end AXIS_DESCR
 /begin AXIS_DESCR STD_AXIS zff_atsys._.iSignale._.obj.sig_m_t8 UMR_NM__8_1_M50_S6_S3 4 -400 1640 DEPOSIT ABSOLUTE MONOTONY MON_INCREASE /end AXIS_DESCR
/end CHARACTERISTIC
/begin CHARACTERISTIC KF_FMESASMEHAUPTPOSESPORT76 "Faktor fuer Reduzierung pos ME bei RS" MAP 0x23328C kf_si16_S6_S3 1 UMR___1_100_0_S6_S3 0 1
 /begin AXIS_DESCR STD_AXIS iSasZentr.iSchaltend.t_syn UMR_MSEC__10_1_0_S6_S3 4 -327680 327670 DEPOSIT ABSOLUTE MONOTONY MON_INCREASE /end AXIS_DESCR
 /begin AXIS_DESCR STD_AXIS iMoeMesaf.me_sas_gesp UMR_NM__1_1_0_S6_S3 4 0 2000 DEPOSIT ABSOLUTE MONOTONY MON_INCREASE /end AXIS_DESCR
/end CHARACTERISTIC
/begin CHARACTERISTIC KF_FMENACHPOSESPORT76 "Faktor fuer Reduzierung pos ME bei RS" MAP 0x2332C4 kf_si16_S6_S3 1 UMR___1_100_0_S6_S3 0 1
 /begin AXIS_DESCR STD_AXIS iMoeMesaf.timer_tsyn_rampe_pos UMR_MSEC__10_1_0_S6_S3 4 -50000 50000 DEPOSIT ABSOLUTE MONOTONY MON_INCREASE /end AXIS_DESCR
 /begin AXIS_DESCR STD_AXIS iMoeMesaf.me_sas_gesp UMR_NM__1_1_0_S6_S3 4 0 2000 DEPOSIT ABSOLUTE MONOTONY MON_INCREASE /end AXIS_DESCR
/end CHARACTERISTIC
/begin CHARACTERISTIC T_RAMEESPORT87 "Dauer Rampe ME bei Schaltungsende" VALUE 0x26E5EF kw_ui8_S6_S3 2540 UMR_MSEC__10_1_0_S6_S3 0 2540 /end CHARACTERISTIC
/begin CHARACTERISTIC KL_FMENACHESPORT87 "Faktor fuer Rampe Ende Nach-ME bei RS" CURVE 0x2332FC kl_ui8_S6_S3 1 UMR___1_100_0_S6_S3 0 1
 /begin AXIS_DESCR STD_AXIS iMoeMesaf.timer_zmes UMR_MSEC__10_1_0_S6_S3 4 0 2550 DEPOSIT ABSOLUTE MONOTONY MON_INCREASE /end AXIS_DESCR
/end CHARACTERISTIC
/begin CHARACTERISTIC T_SYNMENACHESPORT87 "Zeit vor/nach Erkennen synchron fuer Ende Nach-ME" VALUE 0x26E5F0 kw_ui8_S6_S3 2550 UMR_MSEC__10_1_M128_S6_S3 -1280 1270 /end CHARACTERISTIC
/begin CHARACTERISTIC KF_TSYNMENACHASPORT87 "Zeit vor Erkennen synchron fuer Ende Haupt-ME und Start Nach-ME" MAP 0x233308 kf_ui8_S6_S3 1280 UMR_MSEC__10_1_M128_S6_S3 -1280 0
 /begin AXIS_DESCR STD_AXIS zff_atsys._.iSignale._.obj.sig_n_mot8 UMR_U_MIN_32_1_0_S6_S3 4 0 8160 DEPOSIT ABSOLUTE MONOTONY MON_INCREASE /end AXIS_DESCR
 /begin AXIS_DESCR STD_AXIS zff_atsys._.iSignale._.obj.sig_m_t8 UMR_NM__8_1_M50_S6_S3 3 -400 1640 DEPOSIT ABSOLUTE MONOTONY MON_INCREASE /end AXIS_DESCR
/end CHARACTERISTIC
/begin CHARACTERISTIC KF_MENACHSPORT87 "Nachmotoreingriff Schaltablauf" MAP 0x233324 kf_ui8_S6_S3 870 UMR_NM__6_1_M145_S6_S3 -870 0
 /begin AXIS_DESCR STD_AXIS iSasZentr.iSchaltend.n_tkf UMR_U_MIN_32_1_0_S6_S3 6 0 8160 DEPOSIT ABSOLUTE MONOTONY MON_INCREASE /end AXIS_DESCR
 /begin AXIS_DESCR STD_AXIS zff_atsys._.iSignale._.obj.sig_m_t8 UMR_NM__8_1_M50_S6_S3 6 -400 1640 DEPOSIT ABSOLUTE MONOTONY MON_INCREASE /end AXIS_DESCR
/end CHARACTERISTIC
/begin CHARACTERISTIC KF_FMTMEHAUPTASPORT87 "Faktor fuer Rampe auf HME bei RS" MAP 0x23335C kf_ui8_S6_S3 1 UMR___1_100_0_S6_S3 0 1
 /begin AXIS_DESCR STD_AXIS iMoeMesaf.timer_zmes UMR_MSEC__10_1_0_S6_S3 4 0 2550 DEPOSIT ABSOLUTE MONOTONY MON_INCREASE /end AXIS_DESCR
 /begin AXIS_DESCR STD_AXIS zff_atsys._.iSignale._.obj.sig_m_t8 UMR_NM__8_1_M50_S6_S3 4 -400 1640 DEPOSIT ABSOLUTE MONOTONY MON_INCREASE /end AXIS_DESCR
/end CHARACTERISTIC
/begin CHARACTERISTIC KF_MEHAUPTSPORT87 "Wert Hauptmotoreingriff" MAP 0x23337C kf_ui8_S6_S3 1530 UMR_NM__6_1_M145_S6_S3 -870 660
 /begin AXIS_DESCR STD_AXIS NO_INPUT_QUANTITY UMR_U_MIN_32_1_0_S6_S3 6 0 8160 DEPOSIT ABSOLUTE MONOTONY MON_INCREASE /end AXIS_DESCR
 /begin AXIS_DESCR STD_AXIS zff_atsys._.iSignale._.obj.sig_m_t8 UMR_NM__8_1_M50_S6_S3 10 -400 1640 DEPOSIT ABSOLUTE MONOTONY MON_INCREASE /end AXIS_DESCR
/end CHARACTERISTIC
/begin CHARACTERISTIC KF_TVMTNMOTMEHAUPTSPORT87 "Verzoegerungszeit Start Haupt-ME bei Momentenerhoehung" MAP 0x2333D0 kf_ui8_S6_S3 2540 UMR_MSEC__10_1_0_S6_S3 0 2540
 /begin AXIS_DESCR STD_AXIS zff_atsys._.iSignale._.obj.sig_m_t8 UMR_NM__8_1_M50_S6_S3 4 -400 1640 DEPOSIT ABSOLUTE MONOTONY MON_INCREASE /end AXIS_DESCR
 /begin AXIS_DESCR STD_AXIS zff_atsys._.iSignale._.obj.sig_n_mot8 UMR_U_MIN_32_1_0_S6_S3 4 0 8160 DEPOSIT ABSOLUTE MONOTONY MON_INCREASE /end AXIS_DESCR
/end CHARACTERISTIC
/begin CHARACTERISTIC KL_FMEPOSNGABSPORT87 "Faktor zur Gewichtung pos. ME" CURVE 0x2333F0 kl_si16_S6_S3 1 UMR___1_100_0_S6_S3 0 1
 /begin AXIS_DESCR STD_AXIS iMoeMesaf.ng_abmesas UMR_U_MINSEC_1_1_0_S6_S3 6 -1000 1000 DEPOSIT ABSOLUTE MONOTONY MON_INCREASE /end AXIS_DESCR
/end CHARACTERISTIC
/begin CHARACTERISTIC KF_TSYNNTKFMTMEHAUPTESPORT87 "Zeitkriterium Ende Haupt-ME bei Momentenerhoehung" MAP 0x23340C kf_ui8_S6_S3 1280 UMR_MSEC__10_1_M128_S6_S3 -1280 0
 /begin AXIS_DESCR STD_AXIS iSasZentr.iSchaltend.n_tkf UMR_U_MIN_32_1_0_S6_S3 4 0 8160 DEPOSIT ABSOLUTE MONOTONY MON_INCREASE /end AXIS_DESCR
 /begin AXIS_DESCR STD_AXIS zff_atsys._.iSignale._.obj.sig_m_t8 UMR_NM__8_1_M50_S6_S3 4 -400 1640 DEPOSIT ABSOLUTE MONOTONY MON_INCREASE /end AXIS_DESCR
/end CHARACTERISTIC
/begin CHARACTERISTIC KF_FMESASMEHAUPTPOSESPORT87 "Faktor fuer Reduzierung pos ME bei RS" MAP 0x23342C kf_si16_S6_S3 1 UMR___1_100_0_S6_S3 0 1
 /begin AXIS_DESCR STD_AXIS iSasZentr.iSchaltend.t_syn UMR_MSEC__10_1_0_S6_S3 4 -327680 327670 DEPOSIT ABSOLUTE MONOTONY MON_INCREASE /end AXIS_DESCR
 /begin AXIS_DESCR STD_AXIS iMoeMesaf.me_sas_gesp UMR_NM__1_1_0_S6_S3 4 0 2000 DEPOSIT ABSOLUTE MONOTONY MON_INCREASE /end AXIS_DESCR
/end CHARACTERISTIC
/begin CHARACTERISTIC KF_FMENACHPOSESPORT87 "Faktor fuer Reduzierung pos ME bei RS" MAP 0x233464 kf_si16_S6_S3 1 UMR___1_100_0_S6_S3 0 1
 /begin AXIS_DESCR STD_AXIS iMoeMesaf.timer_tsyn_rampe_pos UMR_MSEC__10_1_0_S6_S3 4 -50000 50000 DEPOSIT ABSOLUTE MONOTONY MON_INCREASE /end AXIS_DESCR
 /begin AXIS_DESCR STD_AXIS iMoeMesaf.me_sas_gesp UMR_NM__1_1_0_S6_S3 4 0 2000 DEPOSIT ABSOLUTE MONOTONY MON_INCREASE /end AXIS_DESCR
/end CHARACTERISTIC
/begin CHARACTERISTIC T_RAMEESPORT31 "Dauer Rampe ME bei Schaltungsende" VALUE 0x26E5F1 kw_ui8_S6_S3 2540 UMR_MSEC__10_1_0_S6_S3 0 2540 /end CHARACTERISTIC
/begin CHARACTERISTIC KL_FMENACHESPORT31 "Faktor fuer Rampe Ende Nach-ME bei RS" CURVE 0x23349C kl_ui8_S6_S3 1 UMR___1_100_0_S6_S3 0 1
 /begin AXIS_DESCR STD_AXIS iMoeMesaf.timer_zmes UMR_MSEC__10_1_0_S6_S3 4 0 2550 DEPOSIT ABSOLUTE MONOTONY MON_INCREASE /end AXIS_DESCR
/end CHARACTERISTIC
/begin CHARACTERISTIC T_SYNMENACHESPORT31 "Zeit vor/nach Erkennen synchron fuer Ende Nach-ME" VALUE 0x26E5F2 kw_ui8_S6_S3 2550 UMR_MSEC__10_1_M128_S6_S3 -1280 1270 /end CHARACTERISTIC
/begin CHARACTERISTIC KF_TSYNMENACHASPORT31 "Zeit vor Erkennen synchron fuer Ende Haupt-ME und Start Nach-ME" MAP 0x2334A8 kf_ui8_S6_S3 1280 UMR_MSEC__10_1_M128_S6_S3 -1280 0
 /begin AXIS_DESCR STD_AXIS zff_atsys._.iSignale._.obj.sig_n_mot8 UMR_U_MIN_32_1_0_S6_S3 4 0 8160 DEPOSIT ABSOLUTE MONOTONY MON_INCREASE /end AXIS_DESCR
 /begin AXIS_DESCR STD_AXIS zff_atsys._.iSignale._.obj.sig_m_t8 UMR_NM__8_1_M50_S6_S3 3 -400 1640 DEPOSIT ABSOLUTE MONOTONY MON_INCREASE /end AXIS_DESCR
/end CHARACTERISTIC
/begin CHARACTERISTIC KF_MENACHSPORT31 "Nachmotoreingriff Schaltablauf" MAP 0x2334C4 kf_ui8_S6_S3 870 UMR_NM__6_1_M145_S6_S3 -870 0
 /begin AXIS_DESCR STD_AXIS iSasZentr.iSchaltend.n_tkf UMR_U_MIN_32_1_0_S6_S3 6 0 8160 DEPOSIT ABSOLUTE MONOTONY MON_INCREASE /end AXIS_DESCR
 /begin AXIS_DESCR STD_AXIS zff_atsys._.iSignale._.obj.sig_m_t8 UMR_NM__8_1_M50_S6_S3 6 -400 1640 DEPOSIT ABSOLUTE MONOTONY MON_INCREASE /end AXIS_DESCR
/end CHARACTERISTIC
/begin CHARACTERISTIC KF_FMTMEHAUPTASPORT31 "Faktor fuer Rampe auf HME bei RS" MAP 0x2334FC kf_ui8_S6_S3 1 UMR___1_100_0_S6_S3 0 1
 /begin AXIS_DESCR STD_AXIS iMoeMesaf.timer_zmes UMR_MSEC__10_1_0_S6_S3 4 0 2550 DEPOSIT ABSOLUTE MONOTONY MON_INCREASE /end AXIS_DESCR
 /begin AXIS_DESCR STD_AXIS zff_atsys._.iSignale._.obj.sig_m_t8 UMR_NM__8_1_M50_S6_S3 4 -400 1640 DEPOSIT ABSOLUTE MONOTONY MON_INCREASE /end AXIS_DESCR
/end CHARACTERISTIC
/begin CHARACTERISTIC KF_MEHAUPTSPORT31 "Wert Hauptmotoreingriff" MAP 0x23351C kf_ui8_S6_S3 1530 UMR_NM__6_1_M145_S6_S3 -870 660
 /begin AXIS_DESCR STD_AXIS NO_INPUT_QUANTITY UMR_U_MIN_32_1_0_S6_S3 6 0 8160 DEPOSIT ABSOLUTE MONOTONY MON_INCREASE /end AXIS_DESCR
 /begin AXIS_DESCR STD_AXIS zff_atsys._.iSignale._.obj.sig_m_t8 UMR_NM__8_1_M50_S6_S3 10 -400 1640 DEPOSIT ABSOLUTE MONOTONY MON_INCREASE /end AXIS_DESCR
/end CHARACTERISTIC
/begin CHARACTERISTIC KF_TVMTNMOTMEHAUPTSPORT31 "Verzoegerungszeit Start Haupt-ME bei Momentenerhoehung" MAP 0x233570 kf_ui8_S6_S3 2540 UMR_MSEC__10_1_0_S6_S3 0 2540
 /begin AXIS_DESCR STD_AXIS zff_atsys._.iSignale._.obj.sig_m_t8 UMR_NM__8_1_M50_S6_S3 4 -400 1640 DEPOSIT ABSOLUTE MONOTONY MON_INCREASE /end AXIS_DESCR
 /begin AXIS_DESCR STD_AXIS zff_atsys._.iSignale._.obj.sig_n_mot8 UMR_U_MIN_32_1_0_S6_S3 4 0 8160 DEPOSIT ABSOLUTE MONOTONY MON_INCREASE /end AXIS_DESCR
/end CHARACTERISTIC
/begin CHARACTERISTIC KL_FMEPOSNGABSPORT31 "Faktor zur Gewichtung pos. ME" CURVE 0x233590 kl_si16_S6_S3 1 UMR___1_100_0_S6_S3 0 1
 /begin AXIS_DESCR STD_AXIS iMoeMesaf.ng_abmesas UMR_U_MINSEC_1_1_0_S6_S3 6 -1000 1000 DEPOSIT ABSOLUTE MONOTONY MON_INCREASE /end AXIS_DESCR
/end CHARACTERISTIC
/begin CHARACTERISTIC KF_TSYNNTKFMTMEHAUPTESPORT31 "Zeitkriterium Ende Haupt-ME bei Momentenerhoehung" MAP 0x2335AC kf_ui8_S6_S3 1280 UMR_MSEC__10_1_M128_S6_S3 -1280 0
 /begin AXIS_DESCR STD_AXIS iSasZentr.iSchaltend.n_tkf UMR_U_MIN_32_1_0_S6_S3 4 0 8160 DEPOSIT ABSOLUTE MONOTONY MON_INCREASE /end AXIS_DESCR
 /begin AXIS_DESCR STD_AXIS zff_atsys._.iSignale._.obj.sig_m_t8 UMR_NM__8_1_M50_S6_S3 4 -400 1640 DEPOSIT ABSOLUTE MONOTONY MON_INCREASE /end AXIS_DESCR
/end CHARACTERISTIC
/begin CHARACTERISTIC KF_FMESASMEHAUPTPOSESPORT31 "Faktor fuer Reduzierung pos ME bei RS" MAP 0x2335CC kf_si16_S6_S3 1 UMR___1_100_0_S6_S3 0 1
 /begin AXIS_DESCR STD_AXIS iSasZentr.iSchaltend.t_syn UMR_MSEC__10_1_0_S6_S3 4 -327680 327670 DEPOSIT ABSOLUTE MONOTONY MON_INCREASE /end AXIS_DESCR
 /begin AXIS_DESCR STD_AXIS iMoeMesaf.me_sas_gesp UMR_NM__1_1_0_S6_S3 4 0 2000 DEPOSIT ABSOLUTE MONOTONY MON_INCREASE /end AXIS_DESCR
/end CHARACTERISTIC
/begin CHARACTERISTIC KF_FMENACHPOSESPORT31 "Faktor fuer Reduzierung pos ME bei RS" MAP 0x233604 kf_si16_S6_S3 1 UMR___1_100_0_S6_S3 0 1
 /begin AXIS_DESCR STD_AXIS iMoeMesaf.timer_tsyn_rampe_pos UMR_MSEC__10_1_0_S6_S3 4 -50000 50000 DEPOSIT ABSOLUTE MONOTONY MON_INCREASE /end AXIS_DESCR
 /begin AXIS_DESCR STD_AXIS iMoeMesaf.me_sas_gesp UMR_NM__1_1_0_S6_S3 4 0 2000 DEPOSIT ABSOLUTE MONOTONY MON_INCREASE /end AXIS_DESCR
/end CHARACTERISTIC
/begin CHARACTERISTIC T_RAMEESPORT42 "Dauer Rampe ME bei Schaltungsende" VALUE 0x26E5F3 kw_ui8_S6_S3 2540 UMR_MSEC__10_1_0_S6_S3 0 2540 /end CHARACTERISTIC
/begin CHARACTERISTIC KL_FMENACHESPORT42 "Faktor fuer Rampe Ende Nach-ME bei RS" CURVE 0x23363C kl_ui8_S6_S3 1 UMR___1_100_0_S6_S3 0 1
 /begin AXIS_DESCR STD_AXIS iMoeMesaf.timer_zmes UMR_MSEC__10_1_0_S6_S3 4 0 2550 DEPOSIT ABSOLUTE MONOTONY MON_INCREASE /end AXIS_DESCR
/end CHARACTERISTIC
/begin CHARACTERISTIC T_SYNMENACHESPORT42 "Zeit vor/nach Erkennen synchron fuer Ende Nach-ME" VALUE 0x26E5F4 kw_ui8_S6_S3 2550 UMR_MSEC__10_1_M128_S6_S3 -1280 1270 /end CHARACTERISTIC
/begin CHARACTERISTIC KF_TSYNMENACHASPORT42 "Zeit vor Erkennen synchron fuer Ende Haupt-ME und Start Nach-ME" MAP 0x233648 kf_ui8_S6_S3 1280 UMR_MSEC__10_1_M128_S6_S3 -1280 0
 /begin AXIS_DESCR STD_AXIS zff_atsys._.iSignale._.obj.sig_n_mot8 UMR_U_MIN_32_1_0_S6_S3 4 0 8160 DEPOSIT ABSOLUTE MONOTONY MON_INCREASE /end AXIS_DESCR
 /begin AXIS_DESCR STD_AXIS zff_atsys._.iSignale._.obj.sig_m_t8 UMR_NM__8_1_M50_S6_S3 3 -400 1640 DEPOSIT ABSOLUTE MONOTONY MON_INCREASE /end AXIS_DESCR
/end CHARACTERISTIC
/begin CHARACTERISTIC KF_MENACHSPORT42 "Nachmotoreingriff Schaltablauf" MAP 0x233664 kf_ui8_S6_S3 870 UMR_NM__6_1_M145_S6_S3 -870 0
 /begin AXIS_DESCR STD_AXIS iSasZentr.iSchaltend.n_tkf UMR_U_MIN_32_1_0_S6_S3 6 0 8160 DEPOSIT ABSOLUTE MONOTONY MON_INCREASE /end AXIS_DESCR
 /begin AXIS_DESCR STD_AXIS zff_atsys._.iSignale._.obj.sig_m_t8 UMR_NM__8_1_M50_S6_S3 6 -400 1640 DEPOSIT ABSOLUTE MONOTONY MON_INCREASE /end AXIS_DESCR
/end CHARACTERISTIC
/begin CHARACTERISTIC KF_FMTMEHAUPTASPORT42 "Faktor fuer Rampe auf HME bei RS" MAP 0x23369C kf_ui8_S6_S3 1 UMR___1_100_0_S6_S3 0 1
 /begin AXIS_DESCR STD_AXIS iMoeMesaf.timer_zmes UMR_MSEC__10_1_0_S6_S3 4 0 2550 DEPOSIT ABSOLUTE MONOTONY MON_INCREASE /end AXIS_DESCR
 /begin AXIS_DESCR STD_AXIS zff_atsys._.iSignale._.obj.sig_m_t8 UMR_NM__8_1_M50_S6_S3 4 -400 1640 DEPOSIT ABSOLUTE MONOTONY MON_INCREASE /end AXIS_DESCR
/end CHARACTERISTIC
/begin CHARACTERISTIC KF_MEHAUPTSPORT42 "Wert Hauptmotoreingriff" MAP 0x2336BC kf_ui8_S6_S3 1530 UMR_NM__6_1_M145_S6_S3 -870 660
 /begin AXIS_DESCR STD_AXIS NO_INPUT_QUANTITY UMR_U_MIN_32_1_0_S6_S3 6 0 8160 DEPOSIT ABSOLUTE MONOTONY MON_INCREASE /end AXIS_DESCR
 /begin AXIS_DESCR STD_AXIS zff_atsys._.iSignale._.obj.sig_m_t8 UMR_NM__8_1_M50_S6_S3 10 -400 1640 DEPOSIT ABSOLUTE MONOTONY MON_INCREASE /end AXIS_DESCR
/end CHARACTERISTIC
/begin CHARACTERISTIC KF_TVMTNMOTMEHAUPTSPORT42 "Verzoegerungszeit Start Haupt-ME bei Momentenerhoehung" MAP 0x233710 kf_ui8_S6_S3 2540 UMR_MSEC__10_1_0_S6_S3 0 2540
 /begin AXIS_DESCR STD_AXIS zff_atsys._.iSignale._.obj.sig_m_t8 UMR_NM__8_1_M50_S6_S3 4 -400 1640 DEPOSIT ABSOLUTE MONOTONY MON_INCREASE /end AXIS_DESCR
 /begin AXIS_DESCR STD_AXIS zff_atsys._.iSignale._.obj.sig_n_mot8 UMR_U_MIN_32_1_0_S6_S3 4 0 8160 DEPOSIT ABSOLUTE MONOTONY MON_INCREASE /end AXIS_DESCR
/end CHARACTERISTIC
/begin CHARACTERISTIC KL_FMEPOSNGABSPORT42 "Faktor zur Gewichtung pos. ME" CURVE 0x233730 kl_si16_S6_S3 1 UMR___1_100_0_S6_S3 0 1
 /begin AXIS_DESCR STD_AXIS iMoeMesaf.ng_abmesas UMR_U_MINSEC_1_1_0_S6_S3 6 -1000 1000 DEPOSIT ABSOLUTE MONOTONY MON_INCREASE /end AXIS_DESCR
/end CHARACTERISTIC
/begin CHARACTERISTIC KF_TSYNNTKFMTMEHAUPTESPORT42 "Zeitkriterium Ende Haupt-ME bei Momentenerhoehung" MAP 0x23374C kf_ui8_S6_S3 1280 UMR_MSEC__10_1_M128_S6_S3 -1280 0
 /begin AXIS_DESCR STD_AXIS iSasZentr.iSchaltend.n_tkf UMR_U_MIN_32_1_0_S6_S3 4 0 8160 DEPOSIT ABSOLUTE MONOTONY MON_INCREASE /end AXIS_DESCR
 /begin AXIS_DESCR STD_AXIS zff_atsys._.iSignale._.obj.sig_m_t8 UMR_NM__8_1_M50_S6_S3 4 -400 1640 DEPOSIT ABSOLUTE MONOTONY MON_INCREASE /end AXIS_DESCR
/end CHARACTERISTIC
/begin CHARACTERISTIC KF_FMESASMEHAUPTPOSESPORT42 "Faktor fuer Reduzierung pos ME bei RS" MAP 0x23376C kf_si16_S6_S3 1 UMR___1_100_0_S6_S3 0 1
 /begin AXIS_DESCR STD_AXIS iSasZentr.iSchaltend.t_syn UMR_MSEC__10_1_0_S6_S3 4 -327680 327670 DEPOSIT ABSOLUTE MONOTONY MON_INCREASE /end AXIS_DESCR
 /begin AXIS_DESCR STD_AXIS iMoeMesaf.me_sas_gesp UMR_NM__1_1_0_S6_S3 4 0 2000 DEPOSIT ABSOLUTE MONOTONY MON_INCREASE /end AXIS_DESCR
/end CHARACTERISTIC
/begin CHARACTERISTIC KF_FMENACHPOSESPORT42 "Faktor fuer Reduzierung pos ME bei RS" MAP 0x2337A4 kf_si16_S6_S3 1 UMR___1_100_0_S6_S3 0 1
 /begin AXIS_DESCR STD_AXIS iMoeMesaf.timer_tsyn_rampe_pos UMR_MSEC__10_1_0_S6_S3 4 -50000 50000 DEPOSIT ABSOLUTE MONOTONY MON_INCREASE /end AXIS_DESCR
 /begin AXIS_DESCR STD_AXIS iMoeMesaf.me_sas_gesp UMR_NM__1_1_0_S6_S3 4 0 2000 DEPOSIT ABSOLUTE MONOTONY MON_INCREASE /end AXIS_DESCR
/end CHARACTERISTIC
/begin CHARACTERISTIC T_RAMEESPORT51 "Dauer Rampe ME bei Schaltungsende" VALUE 0x26E5F5 kw_ui8_S6_S3 2540 UMR_MSEC__10_1_0_S6_S3 0 2540 /end CHARACTERISTIC
/begin CHARACTERISTIC KL_FMENACHESPORT51 "Faktor fuer Rampe Ende Nach-ME bei RS" CURVE 0x2337DC kl_ui8_S6_S3 1 UMR___1_100_0_S6_S3 0 1
 /begin AXIS_DESCR STD_AXIS iMoeMesaf.timer_zmes UMR_MSEC__10_1_0_S6_S3 4 0 2550 DEPOSIT ABSOLUTE MONOTONY MON_INCREASE /end AXIS_DESCR
/end CHARACTERISTIC
/begin CHARACTERISTIC T_SYNMENACHESPORT51 "Zeit vor/nach Erkennen synchron fuer Ende Nach-ME" VALUE 0x26E5F6 kw_ui8_S6_S3 2550 UMR_MSEC__10_1_M128_S6_S3 -1280 1270 /end CHARACTERISTIC
/begin CHARACTERISTIC KF_TSYNMENACHASPORT51 "Zeit vor Erkennen synchron fuer Ende Haupt-ME und Start Nach-ME" MAP 0x2337E8 kf_ui8_S6_S3 1280 UMR_MSEC__10_1_M128_S6_S3 -1280 0
 /begin AXIS_DESCR STD_AXIS zff_atsys._.iSignale._.obj.sig_n_mot8 UMR_U_MIN_32_1_0_S6_S3 4 0 8160 DEPOSIT ABSOLUTE MONOTONY MON_INCREASE /end AXIS_DESCR
 /begin AXIS_DESCR STD_AXIS zff_atsys._.iSignale._.obj.sig_m_t8 UMR_NM__8_1_M50_S6_S3 3 -400 1640 DEPOSIT ABSOLUTE MONOTONY MON_INCREASE /end AXIS_DESCR
/end CHARACTERISTIC
/begin CHARACTERISTIC KF_MENACHSPORT51 "Nachmotoreingriff Schaltablauf" MAP 0x233804 kf_ui8_S6_S3 870 UMR_NM__6_1_M145_S6_S3 -870 0
 /begin AXIS_DESCR STD_AXIS iSasZentr.iSchaltend.n_tkf UMR_U_MIN_32_1_0_S6_S3 6 0 8160 DEPOSIT ABSOLUTE MONOTONY MON_INCREASE /end AXIS_DESCR
 /begin AXIS_DESCR STD_AXIS zff_atsys._.iSignale._.obj.sig_m_t8 UMR_NM__8_1_M50_S6_S3 6 -400 1640 DEPOSIT ABSOLUTE MONOTONY MON_INCREASE /end AXIS_DESCR
/end CHARACTERISTIC
/begin CHARACTERISTIC KF_FMTMEHAUPTASPORT51 "Faktor fuer Rampe auf HME bei RS" MAP 0x23383C kf_ui8_S6_S3 1 UMR___1_100_0_S6_S3 0 1
 /begin AXIS_DESCR STD_AXIS iMoeMesaf.timer_zmes UMR_MSEC__10_1_0_S6_S3 4 0 2550 DEPOSIT ABSOLUTE MONOTONY MON_INCREASE /end AXIS_DESCR
 /begin AXIS_DESCR STD_AXIS zff_atsys._.iSignale._.obj.sig_m_t8 UMR_NM__8_1_M50_S6_S3 4 -400 1640 DEPOSIT ABSOLUTE MONOTONY MON_INCREASE /end AXIS_DESCR
/end CHARACTERISTIC
/begin CHARACTERISTIC KF_MEHAUPTSPORT51 "Wert Hauptmotoreingriff" MAP 0x23385C kf_ui8_S6_S3 1530 UMR_NM__6_1_M145_S6_S3 -870 660
 /begin AXIS_DESCR STD_AXIS NO_INPUT_QUANTITY UMR_U_MIN_32_1_0_S6_S3 6 0 8160 DEPOSIT ABSOLUTE MONOTONY MON_INCREASE /end AXIS_DESCR
 /begin AXIS_DESCR STD_AXIS zff_atsys._.iSignale._.obj.sig_m_t8 UMR_NM__8_1_M50_S6_S3 10 -400 1640 DEPOSIT ABSOLUTE MONOTONY MON_INCREASE /end AXIS_DESCR
/end CHARACTERISTIC
/begin CHARACTERISTIC KF_TVMTNMOTMEHAUPTSPORT51 "Verzoegerungszeit Start Haupt-ME bei Momentenerhoehung" MAP 0x2338B0 kf_ui8_S6_S3 2540 UMR_MSEC__10_1_0_S6_S3 0 2540
 /begin AXIS_DESCR STD_AXIS zff_atsys._.iSignale._.obj.sig_m_t8 UMR_NM__8_1_M50_S6_S3 4 -400 1640 DEPOSIT ABSOLUTE MONOTONY MON_INCREASE /end AXIS_DESCR
 /begin AXIS_DESCR STD_AXIS zff_atsys._.iSignale._.obj.sig_n_mot8 UMR_U_MIN_32_1_0_S6_S3 4 0 8160 DEPOSIT ABSOLUTE MONOTONY MON_INCREASE /end AXIS_DESCR
/end CHARACTERISTIC
/begin CHARACTERISTIC KL_FMEPOSNGABSPORT51 "Faktor zur Gewichtung pos. ME" CURVE 0x2338D0 kl_si16_S6_S3 1 UMR___1_100_0_S6_S3 0 1
 /begin AXIS_DESCR STD_AXIS iMoeMesaf.ng_abmesas UMR_U_MINSEC_1_1_0_S6_S3 6 -1000 1000 DEPOSIT ABSOLUTE MONOTONY MON_INCREASE /end AXIS_DESCR
/end CHARACTERISTIC
/begin CHARACTERISTIC KF_TSYNNTKFMTMEHAUPTESPORT51 "Zeitkriterium Ende Haupt-ME bei Momentenerhoehung" MAP 0x2338EC kf_ui8_S6_S3 1280 UMR_MSEC__10_1_M128_S6_S3 -1280 0
 /begin AXIS_DESCR STD_AXIS iSasZentr.iSchaltend.n_tkf UMR_U_MIN_32_1_0_S6_S3 4 0 8160 DEPOSIT ABSOLUTE MONOTONY MON_INCREASE /end AXIS_DESCR
 /begin AXIS_DESCR STD_AXIS zff_atsys._.iSignale._.obj.sig_m_t8 UMR_NM__8_1_M50_S6_S3 4 -400 1640 DEPOSIT ABSOLUTE MONOTONY MON_INCREASE /end AXIS_DESCR
/end CHARACTERISTIC
/begin CHARACTERISTIC KF_FMESASMEHAUPTPOSESPORT51 "Faktor fuer Reduzierung pos ME bei RS" MAP 0x23390C kf_si16_S6_S3 1 UMR___1_100_0_S6_S3 0 1
 /begin AXIS_DESCR STD_AXIS iSasZentr.iSchaltend.t_syn UMR_MSEC__10_1_0_S6_S3 4 -327680 327670 DEPOSIT ABSOLUTE MONOTONY MON_INCREASE /end AXIS_DESCR
 /begin AXIS_DESCR STD_AXIS iMoeMesaf.me_sas_gesp UMR_NM__1_1_0_S6_S3 4 0 2000 DEPOSIT ABSOLUTE MONOTONY MON_INCREASE /end AXIS_DESCR
/end CHARACTERISTIC
/begin CHARACTERISTIC KF_FMENACHPOSESPORT51 "Faktor fuer Reduzierung pos ME bei RS" MAP 0x233944 kf_si16_S6_S3 1 UMR___1_100_0_S6_S3 0 1
 /begin AXIS_DESCR STD_AXIS iMoeMesaf.timer_tsyn_rampe_pos UMR_MSEC__10_1_0_S6_S3 4 -50000 50000 DEPOSIT ABSOLUTE MONOTONY MON_INCREASE /end AXIS_DESCR
 /begin AXIS_DESCR STD_AXIS iMoeMesaf.me_sas_gesp UMR_NM__1_1_0_S6_S3 4 0 2000 DEPOSIT ABSOLUTE MONOTONY MON_INCREASE /end AXIS_DESCR
/end CHARACTERISTIC
/begin CHARACTERISTIC T_RAMEESPORT53 "Dauer Rampe ME bei Schaltungsende" VALUE 0x26E5F7 kw_ui8_S6_S3 2540 UMR_MSEC__10_1_0_S6_S3 0 2540 /end CHARACTERISTIC
/begin CHARACTERISTIC KL_FMENACHESPORT53 "Faktor fuer Rampe Ende Nach-ME bei RS" CURVE 0x23397C kl_ui8_S6_S3 1 UMR___1_100_0_S6_S3 0 1
 /begin AXIS_DESCR STD_AXIS iMoeMesaf.timer_zmes UMR_MSEC__10_1_0_S6_S3 4 0 2550 DEPOSIT ABSOLUTE MONOTONY MON_INCREASE /end AXIS_DESCR
/end CHARACTERISTIC
/begin CHARACTERISTIC T_SYNMENACHESPORT53 "Zeit vor/nach Erkennen synchron fuer Ende Nach-ME" VALUE 0x26E5F8 kw_ui8_S6_S3 2550 UMR_MSEC__10_1_M128_S6_S3 -1280 1270 /end CHARACTERISTIC
/begin CHARACTERISTIC KF_TSYNMENACHASPORT53 "Zeit vor Erkennen synchron fuer Ende Haupt-ME und Start Nach-ME" MAP 0x233988 kf_ui8_S6_S3 1280 UMR_MSEC__10_1_M128_S6_S3 -1280 0
 /begin AXIS_DESCR STD_AXIS zff_atsys._.iSignale._.obj.sig_n_mot8 UMR_U_MIN_32_1_0_S6_S3 4 0 8160 DEPOSIT ABSOLUTE MONOTONY MON_INCREASE /end AXIS_DESCR
 /begin AXIS_DESCR STD_AXIS zff_atsys._.iSignale._.obj.sig_m_t8 UMR_NM__8_1_M50_S6_S3 3 -400 1640 DEPOSIT ABSOLUTE MONOTONY MON_INCREASE /end AXIS_DESCR
/end CHARACTERISTIC
/begin CHARACTERISTIC KF_MENACHSPORT53 "Nachmotoreingriff Schaltablauf" MAP 0x2339A4 kf_ui8_S6_S3 870 UMR_NM__6_1_M145_S6_S3 -870 0
 /begin AXIS_DESCR STD_AXIS iSasZentr.iSchaltend.n_tkf UMR_U_MIN_32_1_0_S6_S3 6 0 8160 DEPOSIT ABSOLUTE MONOTONY MON_INCREASE /end AXIS_DESCR
 /begin AXIS_DESCR STD_AXIS zff_atsys._.iSignale._.obj.sig_m_t8 UMR_NM__8_1_M50_S6_S3 6 -400 1640 DEPOSIT ABSOLUTE MONOTONY MON_INCREASE /end AXIS_DESCR
/end CHARACTERISTIC
/begin CHARACTERISTIC KF_FMTMEHAUPTASPORT53 "Faktor fuer Rampe auf HME bei RS" MAP 0x2339DC kf_ui8_S6_S3 1 UMR___1_100_0_S6_S3 0 1
 /begin AXIS_DESCR STD_AXIS iMoeMesaf.timer_zmes UMR_MSEC__10_1_0_S6_S3 4 0 2550 DEPOSIT ABSOLUTE MONOTONY MON_INCREASE /end AXIS_DESCR
 /begin AXIS_DESCR STD_AXIS zff_atsys._.iSignale._.obj.sig_m_t8 UMR_NM__8_1_M50_S6_S3 4 -400 1640 DEPOSIT ABSOLUTE MONOTONY MON_INCREASE /end AXIS_DESCR
/end CHARACTERISTIC
/begin CHARACTERISTIC KF_MEHAUPTSPORT53 "Wert Hauptmotoreingriff" MAP 0x2339FC kf_ui8_S6_S3 1530 UMR_NM__6_1_M145_S6_S3 -870 660
 /begin AXIS_DESCR STD_AXIS NO_INPUT_QUANTITY UMR_U_MIN_32_1_0_S6_S3 6 0 8160 DEPOSIT ABSOLUTE MONOTONY MON_INCREASE /end AXIS_DESCR
 /begin AXIS_DESCR STD_AXIS zff_atsys._.iSignale._.obj.sig_m_t8 UMR_NM__8_1_M50_S6_S3 10 -400 1640 DEPOSIT ABSOLUTE MONOTONY MON_INCREASE /end AXIS_DESCR
/end CHARACTERISTIC
/begin CHARACTERISTIC KF_TVMTNMOTMEHAUPTSPORT53 "Verzoegerungszeit Start Haupt-ME bei Momentenerhoehung" MAP 0x233A50 kf_ui8_S6_S3 2540 UMR_MSEC__10_1_0_S6_S3 0 2540
 /begin AXIS_DESCR STD_AXIS zff_atsys._.iSignale._.obj.sig_m_t8 UMR_NM__8_1_M50_S6_S3 4 -400 1640 DEPOSIT ABSOLUTE MONOTONY MON_INCREASE /end AXIS_DESCR
 /begin AXIS_DESCR STD_AXIS zff_atsys._.iSignale._.obj.sig_n_mot8 UMR_U_MIN_32_1_0_S6_S3 4 0 8160 DEPOSIT ABSOLUTE MONOTONY MON_INCREASE /end AXIS_DESCR
/end CHARACTERISTIC
/begin CHARACTERISTIC KL_FMEPOSNGABSPORT53 "Faktor zur Gewichtung pos. ME" CURVE 0x233A70 kl_si16_S6_S3 1 UMR___1_100_0_S6_S3 0 1
 /begin AXIS_DESCR STD_AXIS iMoeMesaf.ng_abmesas UMR_U_MINSEC_1_1_0_S6_S3 6 -1000 1000 DEPOSIT ABSOLUTE MONOTONY MON_INCREASE /end AXIS_DESCR
/end CHARACTERISTIC
/begin CHARACTERISTIC KF_TSYNNTKFMTMEHAUPTESPORT53 "Zeitkriterium Ende Haupt-ME bei Momentenerhoehung" MAP 0x233A8C kf_ui8_S6_S3 1280 UMR_MSEC__10_1_M128_S6_S3 -1280 0
 /begin AXIS_DESCR STD_AXIS iSasZentr.iSchaltend.n_tkf UMR_U_MIN_32_1_0_S6_S3 4 0 8160 DEPOSIT ABSOLUTE MONOTONY MON_INCREASE /end AXIS_DESCR
 /begin AXIS_DESCR STD_AXIS zff_atsys._.iSignale._.obj.sig_m_t8 UMR_NM__8_1_M50_S6_S3 4 -400 1640 DEPOSIT ABSOLUTE MONOTONY MON_INCREASE /end AXIS_DESCR
/end CHARACTERISTIC
/begin CHARACTERISTIC KF_FMESASMEHAUPTPOSESPORT53 "Faktor fuer Reduzierung pos ME bei RS" MAP 0x233AAC kf_si16_S6_S3 1 UMR___1_100_0_S6_S3 0 1
 /begin AXIS_DESCR STD_AXIS iSasZentr.iSchaltend.t_syn UMR_MSEC__10_1_0_S6_S3 4 -327680 327670 DEPOSIT ABSOLUTE MONOTONY MON_INCREASE /end AXIS_DESCR
 /begin AXIS_DESCR STD_AXIS iMoeMesaf.me_sas_gesp UMR_NM__1_1_0_S6_S3 4 0 2000 DEPOSIT ABSOLUTE MONOTONY MON_INCREASE /end AXIS_DESCR
/end CHARACTERISTIC
/begin CHARACTERISTIC KF_FMENACHPOSESPORT53 "Faktor fuer Reduzierung pos ME bei RS" MAP 0x233AE4 kf_si16_S6_S3 1 UMR___1_100_0_S6_S3 0 1
 /begin AXIS_DESCR STD_AXIS iMoeMesaf.timer_tsyn_rampe_pos UMR_MSEC__10_1_0_S6_S3 4 -50000 50000 DEPOSIT ABSOLUTE MONOTONY MON_INCREASE /end AXIS_DESCR
 /begin AXIS_DESCR STD_AXIS iMoeMesaf.me_sas_gesp UMR_NM__1_1_0_S6_S3 4 0 2000 DEPOSIT ABSOLUTE MONOTONY MON_INCREASE /end AXIS_DESCR
/end CHARACTERISTIC
/begin CHARACTERISTIC T_RAMEESPORT63 "Dauer Rampe ME bei Schaltungsende" VALUE 0x26E5F9 kw_ui8_S6_S3 2540 UMR_MSEC__10_1_0_S6_S3 0 2540 /end CHARACTERISTIC
/begin CHARACTERISTIC KL_FMENACHESPORT63 "Faktor fuer Rampe Ende Nach-ME bei RS" CURVE 0x233B1C kl_ui8_S6_S3 1 UMR___1_100_0_S6_S3 0 1
 /begin AXIS_DESCR STD_AXIS iMoeMesaf.timer_zmes UMR_MSEC__10_1_0_S6_S3 4 0 2550 DEPOSIT ABSOLUTE MONOTONY MON_INCREASE /end AXIS_DESCR
/end CHARACTERISTIC
/begin CHARACTERISTIC T_SYNMENACHESPORT63 "Zeit vor/nach Erkennen synchron fuer Ende Nach-ME" VALUE 0x26E5FA kw_ui8_S6_S3 2550 UMR_MSEC__10_1_M128_S6_S3 -1280 1270 /end CHARACTERISTIC
/begin CHARACTERISTIC KF_TSYNMENACHASPORT63 "Zeit vor Erkennen synchron fuer Ende Haupt-ME und Start Nach-ME" MAP 0x233B28 kf_ui8_S6_S3 1280 UMR_MSEC__10_1_M128_S6_S3 -1280 0
 /begin AXIS_DESCR STD_AXIS zff_atsys._.iSignale._.obj.sig_n_mot8 UMR_U_MIN_32_1_0_S6_S3 4 0 8160 DEPOSIT ABSOLUTE MONOTONY MON_INCREASE /end AXIS_DESCR
 /begin AXIS_DESCR STD_AXIS zff_atsys._.iSignale._.obj.sig_m_t8 UMR_NM__8_1_M50_S6_S3 3 -400 1640 DEPOSIT ABSOLUTE MONOTONY MON_INCREASE /end AXIS_DESCR
/end CHARACTERISTIC
/begin CHARACTERISTIC KF_MENACHSPORT63 "Nachmotoreingriff Schaltablauf" MAP 0x233B44 kf_ui8_S6_S3 870 UMR_NM__6_1_M145_S6_S3 -870 0
 /begin AXIS_DESCR STD_AXIS iSasZentr.iSchaltend.n_tkf UMR_U_MIN_32_1_0_S6_S3 6 0 8160 DEPOSIT ABSOLUTE MONOTONY MON_INCREASE /end AXIS_DESCR
 /begin AXIS_DESCR STD_AXIS zff_atsys._.iSignale._.obj.sig_m_t8 UMR_NM__8_1_M50_S6_S3 6 -400 1640 DEPOSIT ABSOLUTE MONOTONY MON_INCREASE /end AXIS_DESCR
/end CHARACTERISTIC
/begin CHARACTERISTIC KF_FMTMEHAUPTASPORT63 "Faktor fuer Rampe auf HME bei RS" MAP 0x233B7C kf_ui8_S6_S3 1 UMR___1_100_0_S6_S3 0 1
 /begin AXIS_DESCR STD_AXIS iMoeMesaf.timer_zmes UMR_MSEC__10_1_0_S6_S3 4 0 2550 DEPOSIT ABSOLUTE MONOTONY MON_INCREASE /end AXIS_DESCR
 /begin AXIS_DESCR STD_AXIS zff_atsys._.iSignale._.obj.sig_m_t8 UMR_NM__8_1_M50_S6_S3 4 -400 1640 DEPOSIT ABSOLUTE MONOTONY MON_INCREASE /end AXIS_DESCR
/end CHARACTERISTIC
/begin CHARACTERISTIC KF_MEHAUPTSPORT63 "Wert Hauptmotoreingriff" MAP 0x233B9C kf_ui8_S6_S3 1530 UMR_NM__6_1_M145_S6_S3 -870 660
 /begin AXIS_DESCR STD_AXIS NO_INPUT_QUANTITY UMR_U_MIN_32_1_0_S6_S3 6 0 8160 DEPOSIT ABSOLUTE MONOTONY MON_INCREASE /end AXIS_DESCR
 /begin AXIS_DESCR STD_AXIS zff_atsys._.iSignale._.obj.sig_m_t8 UMR_NM__8_1_M50_S6_S3 10 -400 1640 DEPOSIT ABSOLUTE MONOTONY MON_INCREASE /end AXIS_DESCR
/end CHARACTERISTIC
/begin CHARACTERISTIC KF_TVMTNMOTMEHAUPTSPORT63 "Verzoegerungszeit Start Haupt-ME bei Momentenerhoehung" MAP 0x233BF0 kf_ui8_S6_S3 2540 UMR_MSEC__10_1_0_S6_S3 0 2540
 /begin AXIS_DESCR STD_AXIS zff_atsys._.iSignale._.obj.sig_m_t8 UMR_NM__8_1_M50_S6_S3 4 -400 1640 DEPOSIT ABSOLUTE MONOTONY MON_INCREASE /end AXIS_DESCR
 /begin AXIS_DESCR STD_AXIS zff_atsys._.iSignale._.obj.sig_n_mot8 UMR_U_MIN_32_1_0_S6_S3 4 0 8160 DEPOSIT ABSOLUTE MONOTONY MON_INCREASE /end AXIS_DESCR
/end CHARACTERISTIC
/begin CHARACTERISTIC KL_FMEPOSNGABSPORT63 "Faktor zur Gewichtung pos. ME" CURVE 0x233C10 kl_si16_S6_S3 1 UMR___1_100_0_S6_S3 0 1
 /begin AXIS_DESCR STD_AXIS iMoeMesaf.ng_abmesas UMR_U_MINSEC_1_1_0_S6_S3 6 -1000 1000 DEPOSIT ABSOLUTE MONOTONY MON_INCREASE /end AXIS_DESCR
/end CHARACTERISTIC
/begin CHARACTERISTIC KF_TSYNNTKFMTMEHAUPTESPORT63 "Zeitkriterium Ende Haupt-ME bei Momentenerhoehung" MAP 0x233C2C kf_ui8_S6_S3 1280 UMR_MSEC__10_1_M128_S6_S3 -1280 0
 /begin AXIS_DESCR STD_AXIS iSasZentr.iSchaltend.n_tkf UMR_U_MIN_32_1_0_S6_S3 4 0 8160 DEPOSIT ABSOLUTE MONOTONY MON_INCREASE /end AXIS_DESCR
 /begin AXIS_DESCR STD_AXIS zff_atsys._.iSignale._.obj.sig_m_t8 UMR_NM__8_1_M50_S6_S3 4 -400 1640 DEPOSIT ABSOLUTE MONOTONY MON_INCREASE /end AXIS_DESCR
/end CHARACTERISTIC
/begin CHARACTERISTIC KF_FMESASMEHAUPTPOSESPORT63 "Faktor fuer Reduzierung pos ME bei RS" MAP 0x233C4C kf_si16_S6_S3 1 UMR___1_100_0_S6_S3 0 1
 /begin AXIS_DESCR STD_AXIS iSasZentr.iSchaltend.t_syn UMR_MSEC__10_1_0_S6_S3 4 -327680 327670 DEPOSIT ABSOLUTE MONOTONY MON_INCREASE /end AXIS_DESCR
 /begin AXIS_DESCR STD_AXIS iMoeMesaf.me_sas_gesp UMR_NM__1_1_0_S6_S3 4 0 2000 DEPOSIT ABSOLUTE MONOTONY MON_INCREASE /end AXIS_DESCR
/end CHARACTERISTIC
/begin CHARACTERISTIC KF_FMENACHPOSESPORT63 "Faktor fuer Reduzierung pos ME bei RS" MAP 0x233C84 kf_si16_S6_S3 1 UMR___1_100_0_S6_S3 0 1
 /begin AXIS_DESCR STD_AXIS iMoeMesaf.timer_tsyn_rampe_pos UMR_MSEC__10_1_0_S6_S3 4 -50000 50000 DEPOSIT ABSOLUTE MONOTONY MON_INCREASE /end AXIS_DESCR
 /begin AXIS_DESCR STD_AXIS iMoeMesaf.me_sas_gesp UMR_NM__1_1_0_S6_S3 4 0 2000 DEPOSIT ABSOLUTE MONOTONY MON_INCREASE /end AXIS_DESCR
/end CHARACTERISTIC
/begin CHARACTERISTIC T_RAMEESPORT64 "Dauer Rampe ME bei Schaltungsende" VALUE 0x26E5FB kw_ui8_S6_S3 2540 UMR_MSEC__10_1_0_S6_S3 0 2540 /end CHARACTERISTIC
/begin CHARACTERISTIC KL_FMENACHESPORT64 "Faktor fuer Rampe Ende Nach-ME bei RS" CURVE 0x233CBC kl_ui8_S6_S3 1 UMR___1_100_0_S6_S3 0 1
 /begin AXIS_DESCR STD_AXIS iMoeMesaf.timer_zmes UMR_MSEC__10_1_0_S6_S3 4 0 2550 DEPOSIT ABSOLUTE MONOTONY MON_INCREASE /end AXIS_DESCR
/end CHARACTERISTIC
/begin CHARACTERISTIC T_SYNMENACHESPORT64 "Zeit vor/nach Erkennen synchron fuer Ende Nach-ME" VALUE 0x26E5FC kw_ui8_S6_S3 2550 UMR_MSEC__10_1_M128_S6_S3 -1280 1270 /end CHARACTERISTIC
/begin CHARACTERISTIC KF_TSYNMENACHASPORT64 "Zeit vor Erkennen synchron fuer Ende Haupt-ME und Start Nach-ME" MAP 0x233CC8 kf_ui8_S6_S3 1280 UMR_MSEC__10_1_M128_S6_S3 -1280 0
 /begin AXIS_DESCR STD_AXIS zff_atsys._.iSignale._.obj.sig_n_mot8 UMR_U_MIN_32_1_0_S6_S3 4 0 8160 DEPOSIT ABSOLUTE MONOTONY MON_INCREASE /end AXIS_DESCR
 /begin AXIS_DESCR STD_AXIS zff_atsys._.iSignale._.obj.sig_m_t8 UMR_NM__8_1_M50_S6_S3 3 -400 1640 DEPOSIT ABSOLUTE MONOTONY MON_INCREASE /end AXIS_DESCR
/end CHARACTERISTIC
/begin CHARACTERISTIC KF_MENACHSPORT64 "Nachmotoreingriff Schaltablauf" MAP 0x233CE4 kf_ui8_S6_S3 870 UMR_NM__6_1_M145_S6_S3 -870 0
 /begin AXIS_DESCR STD_AXIS iSasZentr.iSchaltend.n_tkf UMR_U_MIN_32_1_0_S6_S3 6 0 8160 DEPOSIT ABSOLUTE MONOTONY MON_INCREASE /end AXIS_DESCR
 /begin AXIS_DESCR STD_AXIS zff_atsys._.iSignale._.obj.sig_m_t8 UMR_NM__8_1_M50_S6_S3 6 -400 1640 DEPOSIT ABSOLUTE MONOTONY MON_INCREASE /end AXIS_DESCR
/end CHARACTERISTIC
/begin CHARACTERISTIC KF_FMTMEHAUPTASPORT64 "Faktor fuer Rampe auf HME bei RS" MAP 0x233D1C kf_ui8_S6_S3 1 UMR___1_100_0_S6_S3 0 1
 /begin AXIS_DESCR STD_AXIS iMoeMesaf.timer_zmes UMR_MSEC__10_1_0_S6_S3 4 0 2550 DEPOSIT ABSOLUTE MONOTONY MON_INCREASE /end AXIS_DESCR
 /begin AXIS_DESCR STD_AXIS zff_atsys._.iSignale._.obj.sig_m_t8 UMR_NM__8_1_M50_S6_S3 4 -400 1640 DEPOSIT ABSOLUTE MONOTONY MON_INCREASE /end AXIS_DESCR
/end CHARACTERISTIC
/begin CHARACTERISTIC KF_MEHAUPTSPORT64 "Wert Hauptmotoreingriff" MAP 0x233D3C kf_ui8_S6_S3 1530 UMR_NM__6_1_M145_S6_S3 -870 660
 /begin AXIS_DESCR STD_AXIS NO_INPUT_QUANTITY UMR_U_MIN_32_1_0_S6_S3 6 0 8160 DEPOSIT ABSOLUTE MONOTONY MON_INCREASE /end AXIS_DESCR
 /begin AXIS_DESCR STD_AXIS zff_atsys._.iSignale._.obj.sig_m_t8 UMR_NM__8_1_M50_S6_S3 10 -400 1640 DEPOSIT ABSOLUTE MONOTONY MON_INCREASE /end AXIS_DESCR
/end CHARACTERISTIC
/begin CHARACTERISTIC KF_TVMTNMOTMEHAUPTSPORT64 "Verzoegerungszeit Start Haupt-ME bei Momentenerhoehung" MAP 0x233D90 kf_ui8_S6_S3 2540 UMR_MSEC__10_1_0_S6_S3 0 2540
 /begin AXIS_DESCR STD_AXIS zff_atsys._.iSignale._.obj.sig_m_t8 UMR_NM__8_1_M50_S6_S3 4 -400 1640 DEPOSIT ABSOLUTE MONOTONY MON_INCREASE /end AXIS_DESCR
 /begin AXIS_DESCR STD_AXIS zff_atsys._.iSignale._.obj.sig_n_mot8 UMR_U_MIN_32_1_0_S6_S3 4 0 8160 DEPOSIT ABSOLUTE MONOTONY MON_INCREASE /end AXIS_DESCR
/end CHARACTERISTIC
/begin CHARACTERISTIC KL_FMEPOSNGABSPORT64 "Faktor zur Gewichtung pos. ME" CURVE 0x233DB0 kl_si16_S6_S3 1 UMR___1_100_0_S6_S3 0 1
 /begin AXIS_DESCR STD_AXIS iMoeMesaf.ng_abmesas UMR_U_MINSEC_1_1_0_S6_S3 6 -1000 1000 DEPOSIT ABSOLUTE MONOTONY MON_INCREASE /end AXIS_DESCR
/end CHARACTERISTIC
/begin CHARACTERISTIC KF_TSYNNTKFMTMEHAUPTESPORT64 "Zeitkriterium Ende Haupt-ME bei Momentenerhoehung" MAP 0x233DCC kf_ui8_S6_S3 1280 UMR_MSEC__10_1_M128_S6_S3 -1280 0
 /begin AXIS_DESCR STD_AXIS iSasZentr.iSchaltend.n_tkf UMR_U_MIN_32_1_0_S6_S3 4 0 8160 DEPOSIT ABSOLUTE MONOTONY MON_INCREASE /end AXIS_DESCR
 /begin AXIS_DESCR STD_AXIS zff_atsys._.iSignale._.obj.sig_m_t8 UMR_NM__8_1_M50_S6_S3 4 -400 1640 DEPOSIT ABSOLUTE MONOTONY MON_INCREASE /end AXIS_DESCR
/end CHARACTERISTIC
/begin CHARACTERISTIC KF_FMESASMEHAUPTPOSESPORT64 "Faktor fuer Reduzierung pos ME bei RS" MAP 0x233DEC kf_si16_S6_S3 1 UMR___1_100_0_S6_S3 0 1
 /begin AXIS_DESCR STD_AXIS iSasZentr.iSchaltend.t_syn UMR_MSEC__10_1_0_S6_S3 4 -327680 327670 DEPOSIT ABSOLUTE MONOTONY MON_INCREASE /end AXIS_DESCR
 /begin AXIS_DESCR STD_AXIS iMoeMesaf.me_sas_gesp UMR_NM__1_1_0_S6_S3 4 0 2000 DEPOSIT ABSOLUTE MONOTONY MON_INCREASE /end AXIS_DESCR
/end CHARACTERISTIC
/begin CHARACTERISTIC KF_FMENACHPOSESPORT64 "Faktor fuer Reduzierung pos ME bei RS" MAP 0x233E24 kf_si16_S6_S3 1 UMR___1_100_0_S6_S3 0 1
 /begin AXIS_DESCR STD_AXIS iMoeMesaf.timer_tsyn_rampe_pos UMR_MSEC__10_1_0_S6_S3 4 -50000 50000 DEPOSIT ABSOLUTE MONOTONY MON_INCREASE /end AXIS_DESCR
 /begin AXIS_DESCR STD_AXIS iMoeMesaf.me_sas_gesp UMR_NM__1_1_0_S6_S3 4 0 2000 DEPOSIT ABSOLUTE MONOTONY MON_INCREASE /end AXIS_DESCR
/end CHARACTERISTIC
/begin CHARACTERISTIC T_RAMEESPORT71 "Dauer Rampe ME bei Schaltungsende" VALUE 0x26E5FD kw_ui8_S6_S3 2540 UMR_MSEC__10_1_0_S6_S3 0 2540 /end CHARACTERISTIC
/begin CHARACTERISTIC KL_FMENACHESPORT71 "Faktor fuer Rampe Ende Nach-ME bei RS" CURVE 0x233E5C kl_ui8_S6_S3 1 UMR___1_100_0_S6_S3 0 1
 /begin AXIS_DESCR STD_AXIS iMoeMesaf.timer_zmes UMR_MSEC__10_1_0_S6_S3 4 0 2550 DEPOSIT ABSOLUTE MONOTONY MON_INCREASE /end AXIS_DESCR
/end CHARACTERISTIC
/begin CHARACTERISTIC T_SYNMENACHESPORT71 "Zeit vor/nach Erkennen synchron fuer Ende Nach-ME" VALUE 0x26E5FE kw_ui8_S6_S3 2550 UMR_MSEC__10_1_M128_S6_S3 -1280 1270 /end CHARACTERISTIC
/begin CHARACTERISTIC KF_TSYNMENACHASPORT71 "Zeit vor Erkennen synchron fuer Ende Haupt-ME und Start Nach-ME" MAP 0x233E68 kf_ui8_S6_S3 1280 UMR_MSEC__10_1_M128_S6_S3 -1280 0
 /begin AXIS_DESCR STD_AXIS zff_atsys._.iSignale._.obj.sig_n_mot8 UMR_U_MIN_32_1_0_S6_S3 4 0 8160 DEPOSIT ABSOLUTE MONOTONY MON_INCREASE /end AXIS_DESCR
 /begin AXIS_DESCR STD_AXIS zff_atsys._.iSignale._.obj.sig_m_t8 UMR_NM__8_1_M50_S6_S3 3 -400 1640 DEPOSIT ABSOLUTE MONOTONY MON_INCREASE /end AXIS_DESCR
/end CHARACTERISTIC
/begin CHARACTERISTIC KF_MENACHSPORT71 "Nachmotoreingriff Schaltablauf" MAP 0x233E84 kf_ui8_S6_S3 870 UMR_NM__6_1_M145_S6_S3 -870 0
 /begin AXIS_DESCR STD_AXIS iSasZentr.iSchaltend.n_tkf UMR_U_MIN_32_1_0_S6_S3 6 0 8160 DEPOSIT ABSOLUTE MONOTONY MON_INCREASE /end AXIS_DESCR
 /begin AXIS_DESCR STD_AXIS zff_atsys._.iSignale._.obj.sig_m_t8 UMR_NM__8_1_M50_S6_S3 6 -400 1640 DEPOSIT ABSOLUTE MONOTONY MON_INCREASE /end AXIS_DESCR
/end CHARACTERISTIC
/begin CHARACTERISTIC KF_FMTMEHAUPTASPORT71 "Faktor fuer Rampe auf HME bei RS" MAP 0x233EBC kf_ui8_S6_S3 1 UMR___1_100_0_S6_S3 0 1
 /begin AXIS_DESCR STD_AXIS iMoeMesaf.timer_zmes UMR_MSEC__10_1_0_S6_S3 4 0 2550 DEPOSIT ABSOLUTE MONOTONY MON_INCREASE /end AXIS_DESCR
 /begin AXIS_DESCR STD_AXIS zff_atsys._.iSignale._.obj.sig_m_t8 UMR_NM__8_1_M50_S6_S3 4 -400 1640 DEPOSIT ABSOLUTE MONOTONY MON_INCREASE /end AXIS_DESCR
/end CHARACTERISTIC
/begin CHARACTERISTIC KF_MEHAUPTSPORT71 "Wert Hauptmotoreingriff" MAP 0x233EDC kf_ui8_S6_S3 1530 UMR_NM__6_1_M145_S6_S3 -870 660
 /begin AXIS_DESCR STD_AXIS NO_INPUT_QUANTITY UMR_U_MIN_32_1_0_S6_S3 6 0 8160 DEPOSIT ABSOLUTE MONOTONY MON_INCREASE /end AXIS_DESCR
 /begin AXIS_DESCR STD_AXIS zff_atsys._.iSignale._.obj.sig_m_t8 UMR_NM__8_1_M50_S6_S3 10 -400 1640 DEPOSIT ABSOLUTE MONOTONY MON_INCREASE /end AXIS_DESCR
/end CHARACTERISTIC
/begin CHARACTERISTIC KF_TVMTNMOTMEHAUPTSPORT71 "Verzoegerungszeit Start Haupt-ME bei Momentenerhoehung" MAP 0x233F30 kf_ui8_S6_S3 2540 UMR_MSEC__10_1_0_S6_S3 0 2540
 /begin AXIS_DESCR STD_AXIS zff_atsys._.iSignale._.obj.sig_m_t8 UMR_NM__8_1_M50_S6_S3 4 -400 1640 DEPOSIT ABSOLUTE MONOTONY MON_INCREASE /end AXIS_DESCR
 /begin AXIS_DESCR STD_AXIS zff_atsys._.iSignale._.obj.sig_n_mot8 UMR_U_MIN_32_1_0_S6_S3 4 0 8160 DEPOSIT ABSOLUTE MONOTONY MON_INCREASE /end AXIS_DESCR
/end CHARACTERISTIC
/begin CHARACTERISTIC KL_FMEPOSNGABSPORT71 "Faktor zur Gewichtung pos. ME" CURVE 0x233F50 kl_si16_S6_S3 1 UMR___1_100_0_S6_S3 0 1
 /begin AXIS_DESCR STD_AXIS iMoeMesaf.ng_abmesas UMR_U_MINSEC_1_1_0_S6_S3 6 -1000 1000 DEPOSIT ABSOLUTE MONOTONY MON_INCREASE /end AXIS_DESCR
/end CHARACTERISTIC
/begin CHARACTERISTIC KF_TSYNNTKFMTMEHAUPTESPORT71 "Zeitkriterium Ende Haupt-ME bei Momentenerhoehung" MAP 0x233F6C kf_ui8_S6_S3 1280 UMR_MSEC__10_1_M128_S6_S3 -1280 0
 /begin AXIS_DESCR STD_AXIS iSasZentr.iSchaltend.n_tkf UMR_U_MIN_32_1_0_S6_S3 4 0 8160 DEPOSIT ABSOLUTE MONOTONY MON_INCREASE /end AXIS_DESCR
 /begin AXIS_DESCR STD_AXIS zff_atsys._.iSignale._.obj.sig_m_t8 UMR_NM__8_1_M50_S6_S3 4 -400 1640 DEPOSIT ABSOLUTE MONOTONY MON_INCREASE /end AXIS_DESCR
/end CHARACTERISTIC
/begin CHARACTERISTIC KF_FMESASMEHAUPTPOSESPORT71 "Faktor fuer Reduzierung pos ME bei RS" MAP 0x233F8C kf_si16_S6_S3 1 UMR___1_100_0_S6_S3 0 1
 /begin AXIS_DESCR STD_AXIS iSasZentr.iSchaltend.t_syn UMR_MSEC__10_1_0_S6_S3 4 -327680 327670 DEPOSIT ABSOLUTE MONOTONY MON_INCREASE /end AXIS_DESCR
 /begin AXIS_DESCR STD_AXIS iMoeMesaf.me_sas_gesp UMR_NM__1_1_0_S6_S3 4 0 2000 DEPOSIT ABSOLUTE MONOTONY MON_INCREASE /end AXIS_DESCR
/end CHARACTERISTIC
/begin CHARACTERISTIC KF_FMENACHPOSESPORT71 "Faktor fuer Reduzierung pos ME bei RS" MAP 0x233FC4 kf_si16_S6_S3 1 UMR___1_100_0_S6_S3 0 1
 /begin AXIS_DESCR STD_AXIS iMoeMesaf.timer_tsyn_rampe_pos UMR_MSEC__10_1_0_S6_S3 4 -50000 50000 DEPOSIT ABSOLUTE MONOTONY MON_INCREASE /end AXIS_DESCR
 /begin AXIS_DESCR STD_AXIS iMoeMesaf.me_sas_gesp UMR_NM__1_1_0_S6_S3 4 0 2000 DEPOSIT ABSOLUTE MONOTONY MON_INCREASE /end AXIS_DESCR
/end CHARACTERISTIC
/begin CHARACTERISTIC T_RAMEESPORT75 "Dauer Rampe ME bei Schaltungsende" VALUE 0x26E5FF kw_ui8_S6_S3 2540 UMR_MSEC__10_1_0_S6_S3 0 2540 /end CHARACTERISTIC
/begin CHARACTERISTIC KL_FMENACHESPORT75 "Faktor fuer Rampe Ende Nach-ME bei RS" CURVE 0x233FFC kl_ui8_S6_S3 1 UMR___1_100_0_S6_S3 0 1
 /begin AXIS_DESCR STD_AXIS iMoeMesaf.timer_zmes UMR_MSEC__10_1_0_S6_S3 4 0 2550 DEPOSIT ABSOLUTE MONOTONY MON_INCREASE /end AXIS_DESCR
/end CHARACTERISTIC
/begin CHARACTERISTIC T_SYNMENACHESPORT75 "Zeit vor/nach Erkennen synchron fuer Ende Nach-ME" VALUE 0x26E600 kw_ui8_S6_S3 2550 UMR_MSEC__10_1_M128_S6_S3 -1280 1270 /end CHARACTERISTIC
/begin CHARACTERISTIC KF_TSYNMENACHASPORT75 "Zeit vor Erkennen synchron fuer Ende Haupt-ME und Start Nach-ME" MAP 0x234008 kf_ui8_S6_S3 1280 UMR_MSEC__10_1_M128_S6_S3 -1280 0
 /begin AXIS_DESCR STD_AXIS zff_atsys._.iSignale._.obj.sig_n_mot8 UMR_U_MIN_32_1_0_S6_S3 4 0 8160 DEPOSIT ABSOLUTE MONOTONY MON_INCREASE /end AXIS_DESCR
 /begin AXIS_DESCR STD_AXIS zff_atsys._.iSignale._.obj.sig_m_t8 UMR_NM__8_1_M50_S6_S3 3 -400 1640 DEPOSIT ABSOLUTE MONOTONY MON_INCREASE /end AXIS_DESCR
/end CHARACTERISTIC
/begin CHARACTERISTIC KF_MENACHSPORT75 "Nachmotoreingriff Schaltablauf" MAP 0x234024 kf_ui8_S6_S3 870 UMR_NM__6_1_M145_S6_S3 -870 0
 /begin AXIS_DESCR STD_AXIS iSasZentr.iSchaltend.n_tkf UMR_U_MIN_32_1_0_S6_S3 6 0 8160 DEPOSIT ABSOLUTE MONOTONY MON_INCREASE /end AXIS_DESCR
 /begin AXIS_DESCR STD_AXIS zff_atsys._.iSignale._.obj.sig_m_t8 UMR_NM__8_1_M50_S6_S3 6 -400 1640 DEPOSIT ABSOLUTE MONOTONY MON_INCREASE /end AXIS_DESCR
/end CHARACTERISTIC
/begin CHARACTERISTIC KF_FMTMEHAUPTASPORT75 "Faktor fuer Rampe auf HME bei RS" MAP 0x23405C kf_ui8_S6_S3 1 UMR___1_100_0_S6_S3 0 1
 /begin AXIS_DESCR STD_AXIS iMoeMesaf.timer_zmes UMR_MSEC__10_1_0_S6_S3 4 0 2550 DEPOSIT ABSOLUTE MONOTONY MON_INCREASE /end AXIS_DESCR
 /begin AXIS_DESCR STD_AXIS zff_atsys._.iSignale._.obj.sig_m_t8 UMR_NM__8_1_M50_S6_S3 4 -400 1640 DEPOSIT ABSOLUTE MONOTONY MON_INCREASE /end AXIS_DESCR
/end CHARACTERISTIC
/begin CHARACTERISTIC KF_MEHAUPTSPORT75 "Wert Hauptmotoreingriff" MAP 0x23407C kf_ui8_S6_S3 1530 UMR_NM__6_1_M145_S6_S3 -870 660
 /begin AXIS_DESCR STD_AXIS NO_INPUT_QUANTITY UMR_U_MIN_32_1_0_S6_S3 6 0 8160 DEPOSIT ABSOLUTE MONOTONY MON_INCREASE /end AXIS_DESCR
 /begin AXIS_DESCR STD_AXIS zff_atsys._.iSignale._.obj.sig_m_t8 UMR_NM__8_1_M50_S6_S3 10 -400 1640 DEPOSIT ABSOLUTE MONOTONY MON_INCREASE /end AXIS_DESCR
/end CHARACTERISTIC
/begin CHARACTERISTIC KF_TVMTNMOTMEHAUPTSPORT75 "Verzoegerungszeit Start Haupt-ME bei Momentenerhoehung" MAP 0x2340D0 kf_ui8_S6_S3 2540 UMR_MSEC__10_1_0_S6_S3 0 2540
 /begin AXIS_DESCR STD_AXIS zff_atsys._.iSignale._.obj.sig_m_t8 UMR_NM__8_1_M50_S6_S3 4 -400 1640 DEPOSIT ABSOLUTE MONOTONY MON_INCREASE /end AXIS_DESCR
 /begin AXIS_DESCR STD_AXIS zff_atsys._.iSignale._.obj.sig_n_mot8 UMR_U_MIN_32_1_0_S6_S3 4 0 8160 DEPOSIT ABSOLUTE MONOTONY MON_INCREASE /end AXIS_DESCR
/end CHARACTERISTIC
/begin CHARACTERISTIC KL_FMEPOSNGABSPORT75 "Faktor zur Gewichtung pos. ME" CURVE 0x2340F0 kl_si16_S6_S3 1 UMR___1_100_0_S6_S3 0 1
 /begin AXIS_DESCR STD_AXIS iMoeMesaf.ng_abmesas UMR_U_MINSEC_1_1_0_S6_S3 6 -1000 1000 DEPOSIT ABSOLUTE MONOTONY MON_INCREASE /end AXIS_DESCR
/end CHARACTERISTIC
/begin CHARACTERISTIC KF_TSYNNTKFMTMEHAUPTESPORT75 "Zeitkriterium Ende Haupt-ME bei Momentenerhoehung" MAP 0x23410C kf_ui8_S6_S3 1280 UMR_MSEC__10_1_M128_S6_S3 -1280 0
 /begin AXIS_DESCR STD_AXIS iSasZentr.iSchaltend.n_tkf UMR_U_MIN_32_1_0_S6_S3 4 0 8160 DEPOSIT ABSOLUTE MONOTONY MON_INCREASE /end AXIS_DESCR
 /begin AXIS_DESCR STD_AXIS zff_atsys._.iSignale._.obj.sig_m_t8 UMR_NM__8_1_M50_S6_S3 4 -400 1640 DEPOSIT ABSOLUTE MONOTONY MON_INCREASE /end AXIS_DESCR
/end CHARACTERISTIC
/begin CHARACTERISTIC KF_FMESASMEHAUPTPOSESPORT75 "Faktor fuer Reduzierung pos ME bei RS" MAP 0x23412C kf_si16_S6_S3 1 UMR___1_100_0_S6_S3 0 1
 /begin AXIS_DESCR STD_AXIS iSasZentr.iSchaltend.t_syn UMR_MSEC__10_1_0_S6_S3 4 -327680 327670 DEPOSIT ABSOLUTE MONOTONY MON_INCREASE /end AXIS_DESCR
 /begin AXIS_DESCR STD_AXIS iMoeMesaf.me_sas_gesp UMR_NM__1_1_0_S6_S3 4 0 2000 DEPOSIT ABSOLUTE MONOTONY MON_INCREASE /end AXIS_DESCR
/end CHARACTERISTIC
/begin CHARACTERISTIC KF_FMENACHPOSESPORT75 "Faktor fuer Reduzierung pos ME bei RS" MAP 0x234164 kf_si16_S6_S3 1 UMR___1_100_0_S6_S3 0 1
 /begin AXIS_DESCR STD_AXIS iMoeMesaf.timer_tsyn_rampe_pos UMR_MSEC__10_1_0_S6_S3 4 -50000 50000 DEPOSIT ABSOLUTE MONOTONY MON_INCREASE /end AXIS_DESCR
 /begin AXIS_DESCR STD_AXIS iMoeMesaf.me_sas_gesp UMR_NM__1_1_0_S6_S3 4 0 2000 DEPOSIT ABSOLUTE MONOTONY MON_INCREASE /end AXIS_DESCR
/end CHARACTERISTIC
/begin CHARACTERISTIC T_RAMEESPORT82 "Dauer Rampe ME bei Schaltungsende" VALUE 0x26E601 kw_ui8_S6_S3 2540 UMR_MSEC__10_1_0_S6_S3 0 2540 /end CHARACTERISTIC
/begin CHARACTERISTIC KL_FMENACHESPORT82 "Faktor fuer Rampe Ende Nach-ME bei RS" CURVE 0x23419C kl_ui8_S6_S3 1 UMR___1_100_0_S6_S3 0 1
 /begin AXIS_DESCR STD_AXIS iMoeMesaf.timer_zmes UMR_MSEC__10_1_0_S6_S3 4 0 2550 DEPOSIT ABSOLUTE MONOTONY MON_INCREASE /end AXIS_DESCR
/end CHARACTERISTIC
/begin CHARACTERISTIC T_SYNMENACHESPORT82 "Zeit vor/nach Erkennen synchron fuer Ende Nach-ME" VALUE 0x26E602 kw_ui8_S6_S3 2550 UMR_MSEC__10_1_M128_S6_S3 -1280 1270 /end CHARACTERISTIC
/begin CHARACTERISTIC KF_TSYNMENACHASPORT82 "Zeit vor Erkennen synchron fuer Ende Haupt-ME und Start Nach-ME" MAP 0x2341A8 kf_ui8_S6_S3 1280 UMR_MSEC__10_1_M128_S6_S3 -1280 0
 /begin AXIS_DESCR STD_AXIS zff_atsys._.iSignale._.obj.sig_n_mot8 UMR_U_MIN_32_1_0_S6_S3 4 0 8160 DEPOSIT ABSOLUTE MONOTONY MON_INCREASE /end AXIS_DESCR
 /begin AXIS_DESCR STD_AXIS zff_atsys._.iSignale._.obj.sig_m_t8 UMR_NM__8_1_M50_S6_S3 3 -400 1640 DEPOSIT ABSOLUTE MONOTONY MON_INCREASE /end AXIS_DESCR
/end CHARACTERISTIC
/begin CHARACTERISTIC KF_MENACHSPORT82 "Nachmotoreingriff Schaltablauf" MAP 0x2341C4 kf_ui8_S6_S3 870 UMR_NM__6_1_M145_S6_S3 -870 0
 /begin AXIS_DESCR STD_AXIS iSasZentr.iSchaltend.n_tkf UMR_U_MIN_32_1_0_S6_S3 6 0 8160 DEPOSIT ABSOLUTE MONOTONY MON_INCREASE /end AXIS_DESCR
 /begin AXIS_DESCR STD_AXIS zff_atsys._.iSignale._.obj.sig_m_t8 UMR_NM__8_1_M50_S6_S3 6 -400 1640 DEPOSIT ABSOLUTE MONOTONY MON_INCREASE /end AXIS_DESCR
/end CHARACTERISTIC
/begin CHARACTERISTIC KF_FMTMEHAUPTASPORT82 "Faktor fuer Rampe auf HME bei RS" MAP 0x2341FC kf_ui8_S6_S3 1 UMR___1_100_0_S6_S3 0 1
 /begin AXIS_DESCR STD_AXIS iMoeMesaf.timer_zmes UMR_MSEC__10_1_0_S6_S3 4 0 2550 DEPOSIT ABSOLUTE MONOTONY MON_INCREASE /end AXIS_DESCR
 /begin AXIS_DESCR STD_AXIS zff_atsys._.iSignale._.obj.sig_m_t8 UMR_NM__8_1_M50_S6_S3 4 -400 1640 DEPOSIT ABSOLUTE MONOTONY MON_INCREASE /end AXIS_DESCR
/end CHARACTERISTIC
/begin CHARACTERISTIC KF_MEHAUPTSPORT82 "Wert Hauptmotoreingriff" MAP 0x23421C kf_ui8_S6_S3 1530 UMR_NM__6_1_M145_S6_S3 -870 660
 /begin AXIS_DESCR STD_AXIS NO_INPUT_QUANTITY UMR_U_MIN_32_1_0_S6_S3 6 0 8160 DEPOSIT ABSOLUTE MONOTONY MON_INCREASE /end AXIS_DESCR
 /begin AXIS_DESCR STD_AXIS zff_atsys._.iSignale._.obj.sig_m_t8 UMR_NM__8_1_M50_S6_S3 10 -400 1640 DEPOSIT ABSOLUTE MONOTONY MON_INCREASE /end AXIS_DESCR
/end CHARACTERISTIC
/begin CHARACTERISTIC KF_TVMTNMOTMEHAUPTSPORT82 "Verzoegerungszeit Start Haupt-ME bei Momentenerhoehung" MAP 0x234270 kf_ui8_S6_S3 2540 UMR_MSEC__10_1_0_S6_S3 0 2540
 /begin AXIS_DESCR STD_AXIS zff_atsys._.iSignale._.obj.sig_m_t8 UMR_NM__8_1_M50_S6_S3 4 -400 1640 DEPOSIT ABSOLUTE MONOTONY MON_INCREASE /end AXIS_DESCR
 /begin AXIS_DESCR STD_AXIS zff_atsys._.iSignale._.obj.sig_n_mot8 UMR_U_MIN_32_1_0_S6_S3 4 0 8160 DEPOSIT ABSOLUTE MONOTONY MON_INCREASE /end AXIS_DESCR
/end CHARACTERISTIC
/begin CHARACTERISTIC KL_FMEPOSNGABSPORT82 "Faktor zur Gewichtung pos. ME" CURVE 0x234290 kl_si16_S6_S3 1 UMR___1_100_0_S6_S3 0 1
 /begin AXIS_DESCR STD_AXIS iMoeMesaf.ng_abmesas UMR_U_MINSEC_1_1_0_S6_S3 6 -1000 1000 DEPOSIT ABSOLUTE MONOTONY MON_INCREASE /end AXIS_DESCR
/end CHARACTERISTIC
/begin CHARACTERISTIC KF_TSYNNTKFMTMEHAUPTESPORT82 "Zeitkriterium Ende Haupt-ME bei Momentenerhoehung" MAP 0x2342AC kf_ui8_S6_S3 1280 UMR_MSEC__10_1_M128_S6_S3 -1280 0
 /begin AXIS_DESCR STD_AXIS iSasZentr.iSchaltend.n_tkf UMR_U_MIN_32_1_0_S6_S3 4 0 8160 DEPOSIT ABSOLUTE MONOTONY MON_INCREASE /end AXIS_DESCR
 /begin AXIS_DESCR STD_AXIS zff_atsys._.iSignale._.obj.sig_m_t8 UMR_NM__8_1_M50_S6_S3 4 -400 1640 DEPOSIT ABSOLUTE MONOTONY MON_INCREASE /end AXIS_DESCR
/end CHARACTERISTIC
/begin CHARACTERISTIC KF_FMESASMEHAUPTPOSESPORT82 "Faktor fuer Reduzierung pos ME bei RS" MAP 0x2342CC kf_si16_S6_S3 1 UMR___1_100_0_S6_S3 0 1
 /begin AXIS_DESCR STD_AXIS iSasZentr.iSchaltend.t_syn UMR_MSEC__10_1_0_S6_S3 4 -327680 327670 DEPOSIT ABSOLUTE MONOTONY MON_INCREASE /end AXIS_DESCR
 /begin AXIS_DESCR STD_AXIS iMoeMesaf.me_sas_gesp UMR_NM__1_1_0_S6_S3 4 0 2000 DEPOSIT ABSOLUTE MONOTONY MON_INCREASE /end AXIS_DESCR
/end CHARACTERISTIC
/begin CHARACTERISTIC KF_FMENACHPOSESPORT82 "Faktor fuer Reduzierung pos ME bei RS" MAP 0x234304 kf_si16_S6_S3 1 UMR___1_100_0_S6_S3 0 1
 /begin AXIS_DESCR STD_AXIS iMoeMesaf.timer_tsyn_rampe_pos UMR_MSEC__10_1_0_S6_S3 4 -50000 50000 DEPOSIT ABSOLUTE MONOTONY MON_INCREASE /end AXIS_DESCR
 /begin AXIS_DESCR STD_AXIS iMoeMesaf.me_sas_gesp UMR_NM__1_1_0_S6_S3 4 0 2000 DEPOSIT ABSOLUTE MONOTONY MON_INCREASE /end AXIS_DESCR
/end CHARACTERISTIC
/begin CHARACTERISTIC T_RAMEESPORT84 "Dauer Rampe ME bei Schaltungsende" VALUE 0x26E603 kw_ui8_S6_S3 2540 UMR_MSEC__10_1_0_S6_S3 0 2540 /end CHARACTERISTIC
/begin CHARACTERISTIC KL_FMENACHESPORT84 "Faktor fuer Rampe Ende Nach-ME bei RS" CURVE 0x23433C kl_ui8_S6_S3 1 UMR___1_100_0_S6_S3 0 1
 /begin AXIS_DESCR STD_AXIS iMoeMesaf.timer_zmes UMR_MSEC__10_1_0_S6_S3 4 0 2550 DEPOSIT ABSOLUTE MONOTONY MON_INCREASE /end AXIS_DESCR
/end CHARACTERISTIC
/begin CHARACTERISTIC T_SYNMENACHESPORT84 "Zeit vor/nach Erkennen synchron fuer Ende Nach-ME" VALUE 0x26E604 kw_ui8_S6_S3 2550 UMR_MSEC__10_1_M128_S6_S3 -1280 1270 /end CHARACTERISTIC
/begin CHARACTERISTIC KF_TSYNMENACHASPORT84 "Zeit vor Erkennen synchron fuer Ende Haupt-ME und Start Nach-ME" MAP 0x234348 kf_ui8_S6_S3 1280 UMR_MSEC__10_1_M128_S6_S3 -1280 0
 /begin AXIS_DESCR STD_AXIS zff_atsys._.iSignale._.obj.sig_n_mot8 UMR_U_MIN_32_1_0_S6_S3 4 0 8160 DEPOSIT ABSOLUTE MONOTONY MON_INCREASE /end AXIS_DESCR
 /begin AXIS_DESCR STD_AXIS zff_atsys._.iSignale._.obj.sig_m_t8 UMR_NM__8_1_M50_S6_S3 3 -400 1640 DEPOSIT ABSOLUTE MONOTONY MON_INCREASE /end AXIS_DESCR
/end CHARACTERISTIC
/begin CHARACTERISTIC KF_MENACHSPORT84 "Nachmotoreingriff Schaltablauf" MAP 0x234364 kf_ui8_S6_S3 870 UMR_NM__6_1_M145_S6_S3 -870 0
 /begin AXIS_DESCR STD_AXIS iSasZentr.iSchaltend.n_tkf UMR_U_MIN_32_1_0_S6_S3 6 0 8160 DEPOSIT ABSOLUTE MONOTONY MON_INCREASE /end AXIS_DESCR
 /begin AXIS_DESCR STD_AXIS zff_atsys._.iSignale._.obj.sig_m_t8 UMR_NM__8_1_M50_S6_S3 6 -400 1640 DEPOSIT ABSOLUTE MONOTONY MON_INCREASE /end AXIS_DESCR
/end CHARACTERISTIC
/begin CHARACTERISTIC KF_FMTMEHAUPTASPORT84 "Faktor fuer Rampe auf HME bei RS" MAP 0x23439C kf_ui8_S6_S3 1 UMR___1_100_0_S6_S3 0 1
 /begin AXIS_DESCR STD_AXIS iMoeMesaf.timer_zmes UMR_MSEC__10_1_0_S6_S3 4 0 2550 DEPOSIT ABSOLUTE MONOTONY MON_INCREASE /end AXIS_DESCR
 /begin AXIS_DESCR STD_AXIS zff_atsys._.iSignale._.obj.sig_m_t8 UMR_NM__8_1_M50_S6_S3 4 -400 1640 DEPOSIT ABSOLUTE MONOTONY MON_INCREASE /end AXIS_DESCR
/end CHARACTERISTIC
/begin CHARACTERISTIC KF_MEHAUPTSPORT84 "Wert Hauptmotoreingriff" MAP 0x2343BC kf_ui8_S6_S3 1530 UMR_NM__6_1_M145_S6_S3 -870 660
 /begin AXIS_DESCR STD_AXIS NO_INPUT_QUANTITY UMR_U_MIN_32_1_0_S6_S3 6 0 8160 DEPOSIT ABSOLUTE MONOTONY MON_INCREASE /end AXIS_DESCR
 /begin AXIS_DESCR STD_AXIS zff_atsys._.iSignale._.obj.sig_m_t8 UMR_NM__8_1_M50_S6_S3 10 -400 1640 DEPOSIT ABSOLUTE MONOTONY MON_INCREASE /end AXIS_DESCR
/end CHARACTERISTIC
/begin CHARACTERISTIC KF_TVMTNMOTMEHAUPTSPORT84 "Verzoegerungszeit Start Haupt-ME bei Momentenerhoehung" MAP 0x234410 kf_ui8_S6_S3 2540 UMR_MSEC__10_1_0_S6_S3 0 2540
 /begin AXIS_DESCR STD_AXIS zff_atsys._.iSignale._.obj.sig_m_t8 UMR_NM__8_1_M50_S6_S3 4 -400 1640 DEPOSIT ABSOLUTE MONOTONY MON_INCREASE /end AXIS_DESCR
 /begin AXIS_DESCR STD_AXIS zff_atsys._.iSignale._.obj.sig_n_mot8 UMR_U_MIN_32_1_0_S6_S3 4 0 8160 DEPOSIT ABSOLUTE MONOTONY MON_INCREASE /end AXIS_DESCR
/end CHARACTERISTIC
/begin CHARACTERISTIC KL_FMEPOSNGABSPORT84 "Faktor zur Gewichtung pos. ME" CURVE 0x234430 kl_si16_S6_S3 1 UMR___1_100_0_S6_S3 0 1
 /begin AXIS_DESCR STD_AXIS iMoeMesaf.ng_abmesas UMR_U_MINSEC_1_1_0_S6_S3 6 -1000 1000 DEPOSIT ABSOLUTE MONOTONY MON_INCREASE /end AXIS_DESCR
/end CHARACTERISTIC
/begin CHARACTERISTIC KF_TSYNNTKFMTMEHAUPTESPORT84 "Zeitkriterium Ende Haupt-ME bei Momentenerhoehung" MAP 0x23444C kf_ui8_S6_S3 1280 UMR_MSEC__10_1_M128_S6_S3 -1280 0
 /begin AXIS_DESCR STD_AXIS iSasZentr.iSchaltend.n_tkf UMR_U_MIN_32_1_0_S6_S3 4 0 8160 DEPOSIT ABSOLUTE MONOTONY MON_INCREASE /end AXIS_DESCR
 /begin AXIS_DESCR STD_AXIS zff_atsys._.iSignale._.obj.sig_m_t8 UMR_NM__8_1_M50_S6_S3 4 -400 1640 DEPOSIT ABSOLUTE MONOTONY MON_INCREASE /end AXIS_DESCR
/end CHARACTERISTIC
/begin CHARACTERISTIC KF_FMESASMEHAUPTPOSESPORT84 "Faktor fuer Reduzierung pos ME bei RS" MAP 0x23446C kf_si16_S6_S3 1 UMR___1_100_0_S6_S3 0 1
 /begin AXIS_DESCR STD_AXIS iSasZentr.iSchaltend.t_syn UMR_MSEC__10_1_0_S6_S3 4 -327680 327670 DEPOSIT ABSOLUTE MONOTONY MON_INCREASE /end AXIS_DESCR
 /begin AXIS_DESCR STD_AXIS iMoeMesaf.me_sas_gesp UMR_NM__1_1_0_S6_S3 4 0 2000 DEPOSIT ABSOLUTE MONOTONY MON_INCREASE /end AXIS_DESCR
/end CHARACTERISTIC
/begin CHARACTERISTIC KF_FMENACHPOSESPORT84 "Faktor fuer Reduzierung pos ME bei RS" MAP 0x2344A4 kf_si16_S6_S3 1 UMR___1_100_0_S6_S3 0 1
 /begin AXIS_DESCR STD_AXIS iMoeMesaf.timer_tsyn_rampe_pos UMR_MSEC__10_1_0_S6_S3 4 -50000 50000 DEPOSIT ABSOLUTE MONOTONY MON_INCREASE /end AXIS_DESCR
 /begin AXIS_DESCR STD_AXIS iMoeMesaf.me_sas_gesp UMR_NM__1_1_0_S6_S3 4 0 2000 DEPOSIT ABSOLUTE MONOTONY MON_INCREASE /end AXIS_DESCR
/end CHARACTERISTIC
/begin CHARACTERISTIC T_RAMEESPORT86 "Dauer Rampe ME bei Schaltungsende" VALUE 0x26E605 kw_ui8_S6_S3 2540 UMR_MSEC__10_1_0_S6_S3 0 2540 /end CHARACTERISTIC
/begin CHARACTERISTIC KL_FMENACHESPORT86 "Faktor fuer Rampe Ende Nach-ME bei RS" CURVE 0x2344DC kl_ui8_S6_S3 1 UMR___1_100_0_S6_S3 0 1
 /begin AXIS_DESCR STD_AXIS iMoeMesaf.timer_zmes UMR_MSEC__10_1_0_S6_S3 4 0 2550 DEPOSIT ABSOLUTE MONOTONY MON_INCREASE /end AXIS_DESCR
/end CHARACTERISTIC
/begin CHARACTERISTIC T_SYNMENACHESPORT86 "Zeit vor/nach Erkennen synchron fuer Ende Nach-ME" VALUE 0x26E606 kw_ui8_S6_S3 2550 UMR_MSEC__10_1_M128_S6_S3 -1280 1270 /end CHARACTERISTIC
/begin CHARACTERISTIC KF_TSYNMENACHASPORT86 "Zeit vor Erkennen synchron fuer Ende Haupt-ME und Start Nach-ME" MAP 0x2344E8 kf_ui8_S6_S3 1280 UMR_MSEC__10_1_M128_S6_S3 -1280 0
 /begin AXIS_DESCR STD_AXIS zff_atsys._.iSignale._.obj.sig_n_mot8 UMR_U_MIN_32_1_0_S6_S3 4 0 8160 DEPOSIT ABSOLUTE MONOTONY MON_INCREASE /end AXIS_DESCR
 /begin AXIS_DESCR STD_AXIS zff_atsys._.iSignale._.obj.sig_m_t8 UMR_NM__8_1_M50_S6_S3 3 -400 1640 DEPOSIT ABSOLUTE MONOTONY MON_INCREASE /end AXIS_DESCR
/end CHARACTERISTIC
/begin CHARACTERISTIC KF_MENACHSPORT86 "Nachmotoreingriff Schaltablauf" MAP 0x234504 kf_ui8_S6_S3 870 UMR_NM__6_1_M145_S6_S3 -870 0
 /begin AXIS_DESCR STD_AXIS iSasZentr.iSchaltend.n_tkf UMR_U_MIN_32_1_0_S6_S3 6 0 8160 DEPOSIT ABSOLUTE MONOTONY MON_INCREASE /end AXIS_DESCR
 /begin AXIS_DESCR STD_AXIS zff_atsys._.iSignale._.obj.sig_m_t8 UMR_NM__8_1_M50_S6_S3 6 -400 1640 DEPOSIT ABSOLUTE MONOTONY MON_INCREASE /end AXIS_DESCR
/end CHARACTERISTIC
/begin CHARACTERISTIC KF_FMTMEHAUPTASPORT86 "Faktor fuer Rampe auf HME bei RS" MAP 0x23453C kf_ui8_S6_S3 1 UMR___1_100_0_S6_S3 0 1
 /begin AXIS_DESCR STD_AXIS iMoeMesaf.timer_zmes UMR_MSEC__10_1_0_S6_S3 4 0 2550 DEPOSIT ABSOLUTE MONOTONY MON_INCREASE /end AXIS_DESCR
 /begin AXIS_DESCR STD_AXIS zff_atsys._.iSignale._.obj.sig_m_t8 UMR_NM__8_1_M50_S6_S3 4 -400 1640 DEPOSIT ABSOLUTE MONOTONY MON_INCREASE /end AXIS_DESCR
/end CHARACTERISTIC
/begin CHARACTERISTIC KF_MEHAUPTSPORT86 "Wert Hauptmotoreingriff" MAP 0x23455C kf_ui8_S6_S3 1530 UMR_NM__6_1_M145_S6_S3 -870 660
 /begin AXIS_DESCR STD_AXIS NO_INPUT_QUANTITY UMR_U_MIN_32_1_0_S6_S3 6 0 8160 DEPOSIT ABSOLUTE MONOTONY MON_INCREASE /end AXIS_DESCR
 /begin AXIS_DESCR STD_AXIS zff_atsys._.iSignale._.obj.sig_m_t8 UMR_NM__8_1_M50_S6_S3 10 -400 1640 DEPOSIT ABSOLUTE MONOTONY MON_INCREASE /end AXIS_DESCR
/end CHARACTERISTIC
/begin CHARACTERISTIC KF_TVMTNMOTMEHAUPTSPORT86 "Verzoegerungszeit Start Haupt-ME bei Momentenerhoehung" MAP 0x2345B0 kf_ui8_S6_S3 2540 UMR_MSEC__10_1_0_S6_S3 0 2540
 /begin AXIS_DESCR STD_AXIS zff_atsys._.iSignale._.obj.sig_m_t8 UMR_NM__8_1_M50_S6_S3 4 -400 1640 DEPOSIT ABSOLUTE MONOTONY MON_INCREASE /end AXIS_DESCR
 /begin AXIS_DESCR STD_AXIS zff_atsys._.iSignale._.obj.sig_n_mot8 UMR_U_MIN_32_1_0_S6_S3 4 0 8160 DEPOSIT ABSOLUTE MONOTONY MON_INCREASE /end AXIS_DESCR
/end CHARACTERISTIC
/begin CHARACTERISTIC KL_FMEPOSNGABSPORT86 "Faktor zur Gewichtung pos. ME" CURVE 0x2345D0 kl_si16_S6_S3 1 UMR___1_100_0_S6_S3 0 1
 /begin AXIS_DESCR STD_AXIS iMoeMesaf.ng_abmesas UMR_U_MINSEC_1_1_0_S6_S3 6 -1000 1000 DEPOSIT ABSOLUTE MONOTONY MON_INCREASE /end AXIS_DESCR
/end CHARACTERISTIC
/begin CHARACTERISTIC KF_TSYNNTKFMTMEHAUPTESPORT86 "Zeitkriterium Ende Haupt-ME bei Momentenerhoehung" MAP 0x2345EC kf_ui8_S6_S3 1280 UMR_MSEC__10_1_M128_S6_S3 -1280 0
 /begin AXIS_DESCR STD_AXIS iSasZentr.iSchaltend.n_tkf UMR_U_MIN_32_1_0_S6_S3 4 0 8160 DEPOSIT ABSOLUTE MONOTONY MON_INCREASE /end AXIS_DESCR
 /begin AXIS_DESCR STD_AXIS zff_atsys._.iSignale._.obj.sig_m_t8 UMR_NM__8_1_M50_S6_S3 4 -400 1640 DEPOSIT ABSOLUTE MONOTONY MON_INCREASE /end AXIS_DESCR
/end CHARACTERISTIC
/begin CHARACTERISTIC KF_FMESASMEHAUPTPOSESPORT86 "Faktor fuer Reduzierung pos ME bei RS" MAP 0x23460C kf_si16_S6_S3 1 UMR___1_100_0_S6_S3 0 1
 /begin AXIS_DESCR STD_AXIS iSasZentr.iSchaltend.t_syn UMR_MSEC__10_1_0_S6_S3 4 -327680 327670 DEPOSIT ABSOLUTE MONOTONY MON_INCREASE /end AXIS_DESCR
 /begin AXIS_DESCR STD_AXIS iMoeMesaf.me_sas_gesp UMR_NM__1_1_0_S6_S3 4 0 2000 DEPOSIT ABSOLUTE MONOTONY MON_INCREASE /end AXIS_DESCR
/end CHARACTERISTIC
/begin CHARACTERISTIC KF_FMENACHPOSESPORT86 "Faktor fuer Reduzierung pos ME bei RS" MAP 0x234644 kf_si16_S6_S3 1 UMR___1_100_0_S6_S3 0 1
 /begin AXIS_DESCR STD_AXIS iMoeMesaf.timer_tsyn_rampe_pos UMR_MSEC__10_1_0_S6_S3 4 -50000 50000 DEPOSIT ABSOLUTE MONOTONY MON_INCREASE /end AXIS_DESCR
 /begin AXIS_DESCR STD_AXIS iMoeMesaf.me_sas_gesp UMR_NM__1_1_0_S6_S3 4 0 2000 DEPOSIT ABSOLUTE MONOTONY MON_INCREASE /end AXIS_DESCR
/end CHARACTERISTIC
/begin CHARACTERISTIC F_MEKLASS12 "Faktor zur Timerbeendigung" VALUE 0x26D7D8 kw_si16_S6_S3 2 UMR___1_100_0_S6_S3 -1 1 /end CHARACTERISTIC
/begin CHARACTERISTIC F_MEKLASS23 "Faktor zur Timerbeendigung" VALUE 0x26D7DA kw_si16_S6_S3 2 UMR___1_100_0_S6_S3 -1 1 /end CHARACTERISTIC
/begin CHARACTERISTIC F_MEKLASS34 "Faktor zur Timerbeendigung" VALUE 0x26D7DC kw_si16_S6_S3 2 UMR___1_100_0_S6_S3 -1 1 /end CHARACTERISTIC
/begin CHARACTERISTIC F_MEKLASS45 "Faktor zur Timerbeendigung" VALUE 0x26D7DE kw_si16_S6_S3 2 UMR___1_100_0_S6_S3 -1 1 /end CHARACTERISTIC
/begin CHARACTERISTIC F_MEKLASS56 "Faktor zur Timerbeendigung" VALUE 0x26D7E0 kw_si16_S6_S3 2 UMR___1_100_0_S6_S3 -1 1 /end CHARACTERISTIC
/begin CHARACTERISTIC F_MEKLASS67 "Faktor zur Timerbeendigung" VALUE 0x26D7E2 kw_si16_S6_S3 2 UMR___1_100_0_S6_S3 -1 1 /end CHARACTERISTIC
/begin CHARACTERISTIC F_MEKLASS78 "Faktor zur Timerbeendigung" VALUE 0x26D7E4 kw_si16_S6_S3 2 UMR___1_100_0_S6_S3 -1 1 /end CHARACTERISTIC
/begin CHARACTERISTIC KF_MEKREDCMMT21 "Reduzierfaktor ME f(Mot.temp)" MAP 0x23467C kf_ui8_S6_S3 100 UMR_PROZENT__20_51_0_S6_S3 0 100
 /begin AXIS_DESCR STD_AXIS zff_atsys._.iSignale._.obj.sig_c_mot UMR_GRADC__1_1_M48_S6_S3 4 -48 144 DEPOSIT ABSOLUTE MONOTONY MON_INCREASE /end AXIS_DESCR
 /begin AXIS_DESCR STD_AXIS zff_atsys._.iSignale._.obj.sig_m_t8 UMR_NM__8_1_M50_S6_S3 4 -400 1640 DEPOSIT ABSOLUTE MONOTONY MON_INCREASE /end AXIS_DESCR
/end CHARACTERISTIC
/begin CHARACTERISTIC KF_MEKREDCMMT21_EL "Reduzierfaktor ME f(Mot.temp)" MAP 0x23469C kf_ui8_S6_S3 100 UMR_PROZENT__20_51_0_S6_S3 0 100
 /begin AXIS_DESCR STD_AXIS zff_atsys._.iSignale._.obj.sig_c_mot UMR_GRADC__1_1_M48_S6_S3 4 -48 144 DEPOSIT ABSOLUTE MONOTONY MON_INCREASE /end AXIS_DESCR
 /begin AXIS_DESCR STD_AXIS zff_atsys._.iSignale._.obj.sig_m_t8 UMR_NM__8_1_M50_S6_S3 4 -400 1640 DEPOSIT ABSOLUTE MONOTONY MON_INCREASE /end AXIS_DESCR
/end CHARACTERISTIC
/begin CHARACTERISTIC KL_MEKPOSCM21 "Erhoehungsfaktor ME f(Mot.temp)" CURVE 0x2346BC kl_ui8_S6_S3 100 UMR_PROZENT__20_51_0_S6_S3 0 100
 /begin AXIS_DESCR STD_AXIS zff_atsys._.iSignale._.obj.sig_c_mot UMR_GRADC__1_1_M48_S6_S3 4 -48 144 DEPOSIT ABSOLUTE MONOTONY MON_INCREASE /end AXIS_DESCR
/end CHARACTERISTIC
/begin CHARACTERISTIC T_SYNMERUECKFILTERE21 "Zeit fuer Ende Rueckfilterung pos. ME" VALUE 0x26E607 kw_ui8_S6_S3 2550 UMR_MSEC__10_1_M128_S6_S3 -1280 1270 /end CHARACTERISTIC
/begin CHARACTERISTIC KF_MEKREDCMMT32 "Reduzierfaktor ME f(Mot.temp)" MAP 0x2346C8 kf_ui8_S6_S3 100 UMR_PROZENT__20_51_0_S6_S3 0 100
 /begin AXIS_DESCR STD_AXIS zff_atsys._.iSignale._.obj.sig_c_mot UMR_GRADC__1_1_M48_S6_S3 4 -48 144 DEPOSIT ABSOLUTE MONOTONY MON_INCREASE /end AXIS_DESCR
 /begin AXIS_DESCR STD_AXIS zff_atsys._.iSignale._.obj.sig_m_t8 UMR_NM__8_1_M50_S6_S3 4 -400 1640 DEPOSIT ABSOLUTE MONOTONY MON_INCREASE /end AXIS_DESCR
/end CHARACTERISTIC
/begin CHARACTERISTIC KF_MEKREDCMMT32_EL "Reduzierfaktor ME f(Mot.temp)" MAP 0x2346E8 kf_ui8_S6_S3 100 UMR_PROZENT__20_51_0_S6_S3 0 100
 /begin AXIS_DESCR STD_AXIS zff_atsys._.iSignale._.obj.sig_c_mot UMR_GRADC__1_1_M48_S6_S3 4 -48 144 DEPOSIT ABSOLUTE MONOTONY MON_INCREASE /end AXIS_DESCR
 /begin AXIS_DESCR STD_AXIS zff_atsys._.iSignale._.obj.sig_m_t8 UMR_NM__8_1_M50_S6_S3 4 -400 1640 DEPOSIT ABSOLUTE MONOTONY MON_INCREASE /end AXIS_DESCR
/end CHARACTERISTIC
/begin CHARACTERISTIC KL_MEKPOSCM32 "Erhoehungsfaktor ME f(Mot.temp)" CURVE 0x234708 kl_ui8_S6_S3 100 UMR_PROZENT__20_51_0_S6_S3 0 100
 /begin AXIS_DESCR STD_AXIS zff_atsys._.iSignale._.obj.sig_c_mot UMR_GRADC__1_1_M48_S6_S3 4 -48 144 DEPOSIT ABSOLUTE MONOTONY MON_INCREASE /end AXIS_DESCR
/end CHARACTERISTIC
/begin CHARACTERISTIC T_SYNMERUECKFILTERE32 "Zeit fuer Ende Rueckfilterung pos. ME" VALUE 0x26E608 kw_ui8_S6_S3 2550 UMR_MSEC__10_1_M128_S6_S3 -1280 1270 /end CHARACTERISTIC
/begin CHARACTERISTIC KF_MEKREDCMMT43 "Reduzierfaktor ME f(Mot.temp)" MAP 0x234714 kf_ui8_S6_S3 100 UMR_PROZENT__20_51_0_S6_S3 0 100
 /begin AXIS_DESCR STD_AXIS zff_atsys._.iSignale._.obj.sig_c_mot UMR_GRADC__1_1_M48_S6_S3 4 -48 144 DEPOSIT ABSOLUTE MONOTONY MON_INCREASE /end AXIS_DESCR
 /begin AXIS_DESCR STD_AXIS zff_atsys._.iSignale._.obj.sig_m_t8 UMR_NM__8_1_M50_S6_S3 4 -400 1640 DEPOSIT ABSOLUTE MONOTONY MON_INCREASE /end AXIS_DESCR
/end CHARACTERISTIC
/begin CHARACTERISTIC KF_MEKREDCMMT43_EL "Reduzierfaktor ME f(Mot.temp)" MAP 0x234734 kf_ui8_S6_S3 100 UMR_PROZENT__20_51_0_S6_S3 0 100
 /begin AXIS_DESCR STD_AXIS zff_atsys._.iSignale._.obj.sig_c_mot UMR_GRADC__1_1_M48_S6_S3 4 -48 144 DEPOSIT ABSOLUTE MONOTONY MON_INCREASE /end AXIS_DESCR
 /begin AXIS_DESCR STD_AXIS zff_atsys._.iSignale._.obj.sig_m_t8 UMR_NM__8_1_M50_S6_S3 4 -400 1640 DEPOSIT ABSOLUTE MONOTONY MON_INCREASE /end AXIS_DESCR
/end CHARACTERISTIC
/begin CHARACTERISTIC KL_MEKPOSCM43 "Erhoehungsfaktor ME f(Mot.temp)" CURVE 0x234754 kl_ui8_S6_S3 100 UMR_PROZENT__20_51_0_S6_S3 0 100
 /begin AXIS_DESCR STD_AXIS zff_atsys._.iSignale._.obj.sig_c_mot UMR_GRADC__1_1_M48_S6_S3 4 -48 144 DEPOSIT ABSOLUTE MONOTONY MON_INCREASE /end AXIS_DESCR
/end CHARACTERISTIC
/begin CHARACTERISTIC T_SYNMERUECKFILTERE43 "Zeit fuer Ende Rueckfilterung pos. ME" VALUE 0x26E609 kw_ui8_S6_S3 2550 UMR_MSEC__10_1_M128_S6_S3 -1280 1270 /end CHARACTERISTIC
/begin CHARACTERISTIC KF_MEKREDCMMT54 "Reduzierfaktor ME f(Mot.temp)" MAP 0x234760 kf_ui8_S6_S3 100 UMR_PROZENT__20_51_0_S6_S3 0 100
 /begin AXIS_DESCR STD_AXIS zff_atsys._.iSignale._.obj.sig_c_mot UMR_GRADC__1_1_M48_S6_S3 4 -48 144 DEPOSIT ABSOLUTE MONOTONY MON_INCREASE /end AXIS_DESCR
 /begin AXIS_DESCR STD_AXIS zff_atsys._.iSignale._.obj.sig_m_t8 UMR_NM__8_1_M50_S6_S3 4 -400 1640 DEPOSIT ABSOLUTE MONOTONY MON_INCREASE /end AXIS_DESCR
/end CHARACTERISTIC
/begin CHARACTERISTIC KF_MEKREDCMMT54_EL "Reduzierfaktor ME f(Mot.temp)" MAP 0x234780 kf_ui8_S6_S3 100 UMR_PROZENT__20_51_0_S6_S3 0 100
 /begin AXIS_DESCR STD_AXIS zff_atsys._.iSignale._.obj.sig_c_mot UMR_GRADC__1_1_M48_S6_S3 4 -48 144 DEPOSIT ABSOLUTE MONOTONY MON_INCREASE /end AXIS_DESCR
 /begin AXIS_DESCR STD_AXIS zff_atsys._.iSignale._.obj.sig_m_t8 UMR_NM__8_1_M50_S6_S3 4 -400 1640 DEPOSIT ABSOLUTE MONOTONY MON_INCREASE /end AXIS_DESCR
/end CHARACTERISTIC
/begin CHARACTERISTIC KL_MEKPOSCM54 "Erhoehungsfaktor ME f(Mot.temp)" CURVE 0x2347A0 kl_ui8_S6_S3 100 UMR_PROZENT__20_51_0_S6_S3 0 100
 /begin AXIS_DESCR STD_AXIS zff_atsys._.iSignale._.obj.sig_c_mot UMR_GRADC__1_1_M48_S6_S3 4 -48 144 DEPOSIT ABSOLUTE MONOTONY MON_INCREASE /end AXIS_DESCR
/end CHARACTERISTIC
/begin CHARACTERISTIC T_SYNMERUECKFILTERE54 "Zeit fuer Ende Rueckfilterung pos. ME" VALUE 0x26E60A kw_ui8_S6_S3 2550 UMR_MSEC__10_1_M128_S6_S3 -1280 1270 /end CHARACTERISTIC
/begin CHARACTERISTIC KF_MEKREDCMMT65 "Reduzierfaktor ME f(Mot.temp)" MAP 0x2347AC kf_ui8_S6_S3 100 UMR_PROZENT__20_51_0_S6_S3 0 100
 /begin AXIS_DESCR STD_AXIS zff_atsys._.iSignale._.obj.sig_c_mot UMR_GRADC__1_1_M48_S6_S3 4 -48 144 DEPOSIT ABSOLUTE MONOTONY MON_INCREASE /end AXIS_DESCR
 /begin AXIS_DESCR STD_AXIS zff_atsys._.iSignale._.obj.sig_m_t8 UMR_NM__8_1_M50_S6_S3 4 -400 1640 DEPOSIT ABSOLUTE MONOTONY MON_INCREASE /end AXIS_DESCR
/end CHARACTERISTIC
/begin CHARACTERISTIC KF_MEKREDCMMT65_EL "Reduzierfaktor ME f(Mot.temp)" MAP 0x2347CC kf_ui8_S6_S3 100 UMR_PROZENT__20_51_0_S6_S3 0 100
 /begin AXIS_DESCR STD_AXIS zff_atsys._.iSignale._.obj.sig_c_mot UMR_GRADC__1_1_M48_S6_S3 4 -48 144 DEPOSIT ABSOLUTE MONOTONY MON_INCREASE /end AXIS_DESCR
 /begin AXIS_DESCR STD_AXIS zff_atsys._.iSignale._.obj.sig_m_t8 UMR_NM__8_1_M50_S6_S3 4 -400 1640 DEPOSIT ABSOLUTE MONOTONY MON_INCREASE /end AXIS_DESCR
/end CHARACTERISTIC
/begin CHARACTERISTIC KL_MEKPOSCM65 "Erhoehungsfaktor ME f(Mot.temp)" CURVE 0x2347EC kl_ui8_S6_S3 100 UMR_PROZENT__20_51_0_S6_S3 0 100
 /begin AXIS_DESCR STD_AXIS zff_atsys._.iSignale._.obj.sig_c_mot UMR_GRADC__1_1_M48_S6_S3 4 -48 144 DEPOSIT ABSOLUTE MONOTONY MON_INCREASE /end AXIS_DESCR
/end CHARACTERISTIC
/begin CHARACTERISTIC T_SYNMERUECKFILTERE65 "Zeit fuer Ende Rueckfilterung pos. ME" VALUE 0x26E60B kw_ui8_S6_S3 2550 UMR_MSEC__10_1_M128_S6_S3 -1280 1270 /end CHARACTERISTIC
/begin CHARACTERISTIC KF_MEKREDCMMT76 "Reduzierfaktor ME f(Mot.temp)" MAP 0x2347F8 kf_ui8_S6_S3 100 UMR_PROZENT__20_51_0_S6_S3 0 100
 /begin AXIS_DESCR STD_AXIS zff_atsys._.iSignale._.obj.sig_c_mot UMR_GRADC__1_1_M48_S6_S3 4 -48 144 DEPOSIT ABSOLUTE MONOTONY MON_INCREASE /end AXIS_DESCR
 /begin AXIS_DESCR STD_AXIS zff_atsys._.iSignale._.obj.sig_m_t8 UMR_NM__8_1_M50_S6_S3 4 -400 1640 DEPOSIT ABSOLUTE MONOTONY MON_INCREASE /end AXIS_DESCR
/end CHARACTERISTIC
/begin CHARACTERISTIC KF_MEKREDCMMT76_EL "Reduzierfaktor ME f(Mot.temp)" MAP 0x234818 kf_ui8_S6_S3 100 UMR_PROZENT__20_51_0_S6_S3 0 100
 /begin AXIS_DESCR STD_AXIS zff_atsys._.iSignale._.obj.sig_c_mot UMR_GRADC__1_1_M48_S6_S3 4 -48 144 DEPOSIT ABSOLUTE MONOTONY MON_INCREASE /end AXIS_DESCR
 /begin AXIS_DESCR STD_AXIS zff_atsys._.iSignale._.obj.sig_m_t8 UMR_NM__8_1_M50_S6_S3 4 -400 1640 DEPOSIT ABSOLUTE MONOTONY MON_INCREASE /end AXIS_DESCR
/end CHARACTERISTIC
/begin CHARACTERISTIC KL_MEKPOSCM76 "Erhoehungsfaktor ME f(Mot.temp)" CURVE 0x234838 kl_ui8_S6_S3 100 UMR_PROZENT__20_51_0_S6_S3 0 100
 /begin AXIS_DESCR STD_AXIS zff_atsys._.iSignale._.obj.sig_c_mot UMR_GRADC__1_1_M48_S6_S3 4 -48 144 DEPOSIT ABSOLUTE MONOTONY MON_INCREASE /end AXIS_DESCR
/end CHARACTERISTIC
/begin CHARACTERISTIC T_SYNMERUECKFILTERE76 "Zeit fuer Ende Rueckfilterung pos. ME" VALUE 0x26E60C kw_ui8_S6_S3 2550 UMR_MSEC__10_1_M128_S6_S3 -1280 1270 /end CHARACTERISTIC
/begin CHARACTERISTIC KF_MEKREDCMMT87 "Reduzierfaktor ME f(Mot.temp)" MAP 0x234844 kf_ui8_S6_S3 100 UMR_PROZENT__20_51_0_S6_S3 0 100
 /begin AXIS_DESCR STD_AXIS zff_atsys._.iSignale._.obj.sig_c_mot UMR_GRADC__1_1_M48_S6_S3 4 -48 144 DEPOSIT ABSOLUTE MONOTONY MON_INCREASE /end AXIS_DESCR
 /begin AXIS_DESCR STD_AXIS zff_atsys._.iSignale._.obj.sig_m_t8 UMR_NM__8_1_M50_S6_S3 4 -400 1640 DEPOSIT ABSOLUTE MONOTONY MON_INCREASE /end AXIS_DESCR
/end CHARACTERISTIC
/begin CHARACTERISTIC KF_MEKREDCMMT87_EL "Reduzierfaktor ME f(Mot.temp)" MAP 0x234864 kf_ui8_S6_S3 100 UMR_PROZENT__20_51_0_S6_S3 0 100
 /begin AXIS_DESCR STD_AXIS zff_atsys._.iSignale._.obj.sig_c_mot UMR_GRADC__1_1_M48_S6_S3 4 -48 144 DEPOSIT ABSOLUTE MONOTONY MON_INCREASE /end AXIS_DESCR
 /begin AXIS_DESCR STD_AXIS zff_atsys._.iSignale._.obj.sig_m_t8 UMR_NM__8_1_M50_S6_S3 4 -400 1640 DEPOSIT ABSOLUTE MONOTONY MON_INCREASE /end AXIS_DESCR
/end CHARACTERISTIC
/begin CHARACTERISTIC KL_MEKPOSCM87 "Erhoehungsfaktor ME f(Mot.temp)" CURVE 0x234884 kl_ui8_S6_S3 100 UMR_PROZENT__20_51_0_S6_S3 0 100
 /begin AXIS_DESCR STD_AXIS zff_atsys._.iSignale._.obj.sig_c_mot UMR_GRADC__1_1_M48_S6_S3 4 -48 144 DEPOSIT ABSOLUTE MONOTONY MON_INCREASE /end AXIS_DESCR
/end CHARACTERISTIC
/begin CHARACTERISTIC T_SYNMERUECKFILTERE87 "Zeit fuer Ende Rueckfilterung pos. ME" VALUE 0x26E60D kw_ui8_S6_S3 2550 UMR_MSEC__10_1_M128_S6_S3 -1280 1270 /end CHARACTERISTIC
/begin CHARACTERISTIC KF_MEKREDCMMTSP31 "Reduzierfaktor ME f(Mot.temp)" MAP 0x234890 kf_ui8_S6_S3 100 UMR_PROZENT__20_51_0_S6_S3 0 100
 /begin AXIS_DESCR STD_AXIS zff_atsys._.iSignale._.obj.sig_c_mot UMR_GRADC__1_1_M48_S6_S3 4 -48 144 DEPOSIT ABSOLUTE MONOTONY MON_INCREASE /end AXIS_DESCR
 /begin AXIS_DESCR STD_AXIS zff_atsys._.iSignale._.obj.sig_m_t8 UMR_NM__8_1_M50_S6_S3 4 -400 1640 DEPOSIT ABSOLUTE MONOTONY MON_INCREASE /end AXIS_DESCR
/end CHARACTERISTIC
/begin CHARACTERISTIC KF_MEKREDCMMTSP31_EL "Reduzierfaktor ME f(Mot.temp)" MAP 0x2348B0 kf_ui8_S6_S3 100 UMR_PROZENT__20_51_0_S6_S3 0 100
 /begin AXIS_DESCR STD_AXIS zff_atsys._.iSignale._.obj.sig_c_mot UMR_GRADC__1_1_M48_S6_S3 4 -48 144 DEPOSIT ABSOLUTE MONOTONY MON_INCREASE /end AXIS_DESCR
 /begin AXIS_DESCR STD_AXIS zff_atsys._.iSignale._.obj.sig_m_t8 UMR_NM__8_1_M50_S6_S3 4 -400 1640 DEPOSIT ABSOLUTE MONOTONY MON_INCREASE /end AXIS_DESCR
/end CHARACTERISTIC
/begin CHARACTERISTIC KL_MEKPOSCMSP31 "Erhoehungsfaktor ME f(Mot.temp)" CURVE 0x2348D0 kl_ui8_S6_S3 100 UMR_PROZENT__20_51_0_S6_S3 0 100
 /begin AXIS_DESCR STD_AXIS zff_atsys._.iSignale._.obj.sig_c_mot UMR_GRADC__1_1_M48_S6_S3 4 -48 144 DEPOSIT ABSOLUTE MONOTONY MON_INCREASE /end AXIS_DESCR
/end CHARACTERISTIC
/begin CHARACTERISTIC T_SYNMERUECKFILTERESP31 "Zeit fuer Ende Rueckfilterung pos. ME" VALUE 0x26E60E kw_ui8_S6_S3 2550 UMR_MSEC__10_1_M128_S6_S3 -1280 1270 /end CHARACTERISTIC
/begin CHARACTERISTIC KF_MEKREDCMMTSP42 "Reduzierfaktor ME f(Mot.temp)" MAP 0x2348DC kf_ui8_S6_S3 100 UMR_PROZENT__20_51_0_S6_S3 0 100
 /begin AXIS_DESCR STD_AXIS zff_atsys._.iSignale._.obj.sig_c_mot UMR_GRADC__1_1_M48_S6_S3 4 -48 144 DEPOSIT ABSOLUTE MONOTONY MON_INCREASE /end AXIS_DESCR
 /begin AXIS_DESCR STD_AXIS zff_atsys._.iSignale._.obj.sig_m_t8 UMR_NM__8_1_M50_S6_S3 4 -400 1640 DEPOSIT ABSOLUTE MONOTONY MON_INCREASE /end AXIS_DESCR
/end CHARACTERISTIC
/begin CHARACTERISTIC KF_MEKREDCMMTSP42_EL "Reduzierfaktor ME f(Mot.temp)" MAP 0x2348FC kf_ui8_S6_S3 100 UMR_PROZENT__20_51_0_S6_S3 0 100
 /begin AXIS_DESCR STD_AXIS zff_atsys._.iSignale._.obj.sig_c_mot UMR_GRADC__1_1_M48_S6_S3 4 -48 144 DEPOSIT ABSOLUTE MONOTONY MON_INCREASE /end AXIS_DESCR
 /begin AXIS_DESCR STD_AXIS zff_atsys._.iSignale._.obj.sig_m_t8 UMR_NM__8_1_M50_S6_S3 4 -400 1640 DEPOSIT ABSOLUTE MONOTONY MON_INCREASE /end AXIS_DESCR
/end CHARACTERISTIC
/begin CHARACTERISTIC KL_MEKPOSCMSP42 "Erhoehungsfaktor ME f(Mot.temp)" CURVE 0x23491C kl_ui8_S6_S3 100 UMR_PROZENT__20_51_0_S6_S3 0 100
 /begin AXIS_DESCR STD_AXIS zff_atsys._.iSignale._.obj.sig_c_mot UMR_GRADC__1_1_M48_S6_S3 4 -48 144 DEPOSIT ABSOLUTE MONOTONY MON_INCREASE /end AXIS_DESCR
/end CHARACTERISTIC
/begin CHARACTERISTIC T_SYNMERUECKFILTERESP42 "Zeit fuer Ende Rueckfilterung pos. ME" VALUE 0x26E60F kw_ui8_S6_S3 2550 UMR_MSEC__10_1_M128_S6_S3 -1280 1270 /end CHARACTERISTIC
/begin CHARACTERISTIC KF_MEKREDCMMTSP51 "Reduzierfaktor ME f(Mot.temp)" MAP 0x234928 kf_ui8_S6_S3 100 UMR_PROZENT__20_51_0_S6_S3 0 100
 /begin AXIS_DESCR STD_AXIS zff_atsys._.iSignale._.obj.sig_c_mot UMR_GRADC__1_1_M48_S6_S3 4 -48 144 DEPOSIT ABSOLUTE MONOTONY MON_INCREASE /end AXIS_DESCR
 /begin AXIS_DESCR STD_AXIS zff_atsys._.iSignale._.obj.sig_m_t8 UMR_NM__8_1_M50_S6_S3 4 -400 1640 DEPOSIT ABSOLUTE MONOTONY MON_INCREASE /end AXIS_DESCR
/end CHARACTERISTIC
/begin CHARACTERISTIC KF_MEKREDCMMTSP51_EL "Reduzierfaktor ME f(Mot.temp)" MAP 0x234948 kf_ui8_S6_S3 100 UMR_PROZENT__20_51_0_S6_S3 0 100
 /begin AXIS_DESCR STD_AXIS zff_atsys._.iSignale._.obj.sig_c_mot UMR_GRADC__1_1_M48_S6_S3 4 -48 144 DEPOSIT ABSOLUTE MONOTONY MON_INCREASE /end AXIS_DESCR
 /begin AXIS_DESCR STD_AXIS zff_atsys._.iSignale._.obj.sig_m_t8 UMR_NM__8_1_M50_S6_S3 4 -400 1640 DEPOSIT ABSOLUTE MONOTONY MON_INCREASE /end AXIS_DESCR
/end CHARACTERISTIC
/begin CHARACTERISTIC KL_MEKPOSCMSP51 "Erhoehungsfaktor ME f(Mot.temp)" CURVE 0x234968 kl_ui8_S6_S3 100 UMR_PROZENT__20_51_0_S6_S3 0 100
 /begin AXIS_DESCR STD_AXIS zff_atsys._.iSignale._.obj.sig_c_mot UMR_GRADC__1_1_M48_S6_S3 4 -48 144 DEPOSIT ABSOLUTE MONOTONY MON_INCREASE /end AXIS_DESCR
/end CHARACTERISTIC
/begin CHARACTERISTIC T_SYNMERUECKFILTERESP51 "Zeit fuer Ende Rueckfilterung pos. ME" VALUE 0x26E610 kw_ui8_S6_S3 2550 UMR_MSEC__10_1_M128_S6_S3 -1280 1270 /end CHARACTERISTIC
/begin CHARACTERISTIC KF_MEKREDCMMTSP53 "Reduzierfaktor ME f(Mot.temp)" MAP 0x234974 kf_ui8_S6_S3 100 UMR_PROZENT__20_51_0_S6_S3 0 100
 /begin AXIS_DESCR STD_AXIS zff_atsys._.iSignale._.obj.sig_c_mot UMR_GRADC__1_1_M48_S6_S3 4 -48 144 DEPOSIT ABSOLUTE MONOTONY MON_INCREASE /end AXIS_DESCR
 /begin AXIS_DESCR STD_AXIS zff_atsys._.iSignale._.obj.sig_m_t8 UMR_NM__8_1_M50_S6_S3 4 -400 1640 DEPOSIT ABSOLUTE MONOTONY MON_INCREASE /end AXIS_DESCR
/end CHARACTERISTIC
/begin CHARACTERISTIC KF_MEKREDCMMTSP53_EL "Reduzierfaktor ME f(Mot.temp)" MAP 0x234994 kf_ui8_S6_S3 100 UMR_PROZENT__20_51_0_S6_S3 0 100
 /begin AXIS_DESCR STD_AXIS zff_atsys._.iSignale._.obj.sig_c_mot UMR_GRADC__1_1_M48_S6_S3 4 -48 144 DEPOSIT ABSOLUTE MONOTONY MON_INCREASE /end AXIS_DESCR
 /begin AXIS_DESCR STD_AXIS zff_atsys._.iSignale._.obj.sig_m_t8 UMR_NM__8_1_M50_S6_S3 4 -400 1640 DEPOSIT ABSOLUTE MONOTONY MON_INCREASE /end AXIS_DESCR
/end CHARACTERISTIC
/begin CHARACTERISTIC KL_MEKPOSCMSP53 "Erhoehungsfaktor ME f(Mot.temp)" CURVE 0x2349B4 kl_ui8_S6_S3 100 UMR_PROZENT__20_51_0_S6_S3 0 100
 /begin AXIS_DESCR STD_AXIS zff_atsys._.iSignale._.obj.sig_c_mot UMR_GRADC__1_1_M48_S6_S3 4 -48 144 DEPOSIT ABSOLUTE MONOTONY MON_INCREASE /end AXIS_DESCR
/end CHARACTERISTIC
/begin CHARACTERISTIC T_SYNMERUECKFILTERESP53 "Zeit fuer Ende Rueckfilterung pos. ME" VALUE 0x26E611 kw_ui8_S6_S3 2550 UMR_MSEC__10_1_M128_S6_S3 -1280 1270 /end CHARACTERISTIC
/begin CHARACTERISTIC KF_MEKREDCMMTSP63 "Reduzierfaktor ME f(Mot.temp)" MAP 0x2349C0 kf_ui8_S6_S3 100 UMR_PROZENT__20_51_0_S6_S3 0 100
 /begin AXIS_DESCR STD_AXIS zff_atsys._.iSignale._.obj.sig_c_mot UMR_GRADC__1_1_M48_S6_S3 4 -48 144 DEPOSIT ABSOLUTE MONOTONY MON_INCREASE /end AXIS_DESCR
 /begin AXIS_DESCR STD_AXIS zff_atsys._.iSignale._.obj.sig_m_t8 UMR_NM__8_1_M50_S6_S3 4 -400 1640 DEPOSIT ABSOLUTE MONOTONY MON_INCREASE /end AXIS_DESCR
/end CHARACTERISTIC
/begin CHARACTERISTIC KF_MEKREDCMMTSP63_EL "Reduzierfaktor ME f(Mot.temp)" MAP 0x2349E0 kf_ui8_S6_S3 100 UMR_PROZENT__20_51_0_S6_S3 0 100
 /begin AXIS_DESCR STD_AXIS zff_atsys._.iSignale._.obj.sig_c_mot UMR_GRADC__1_1_M48_S6_S3 4 -48 144 DEPOSIT ABSOLUTE MONOTONY MON_INCREASE /end AXIS_DESCR
 /begin AXIS_DESCR STD_AXIS zff_atsys._.iSignale._.obj.sig_m_t8 UMR_NM__8_1_M50_S6_S3 4 -400 1640 DEPOSIT ABSOLUTE MONOTONY MON_INCREASE /end AXIS_DESCR
/end CHARACTERISTIC
/begin CHARACTERISTIC KL_MEKPOSCMSP63 "Erhoehungsfaktor ME f(Mot.temp)" CURVE 0x234A00 kl_ui8_S6_S3 100 UMR_PROZENT__20_51_0_S6_S3 0 100
 /begin AXIS_DESCR STD_AXIS zff_atsys._.iSignale._.obj.sig_c_mot UMR_GRADC__1_1_M48_S6_S3 4 -48 144 DEPOSIT ABSOLUTE MONOTONY MON_INCREASE /end AXIS_DESCR
/end CHARACTERISTIC
/begin CHARACTERISTIC T_SYNMERUECKFILTERESP63 "Zeit fuer Ende Rueckfilterung pos. ME" VALUE 0x26E612 kw_ui8_S6_S3 2550 UMR_MSEC__10_1_M128_S6_S3 -1280 1270 /end CHARACTERISTIC
/begin CHARACTERISTIC KF_MEKREDCMMTSP64 "Reduzierfaktor ME f(Mot.temp)" MAP 0x234A0C kf_ui8_S6_S3 100 UMR_PROZENT__20_51_0_S6_S3 0 100
 /begin AXIS_DESCR STD_AXIS zff_atsys._.iSignale._.obj.sig_c_mot UMR_GRADC__1_1_M48_S6_S3 4 -48 144 DEPOSIT ABSOLUTE MONOTONY MON_INCREASE /end AXIS_DESCR
 /begin AXIS_DESCR STD_AXIS zff_atsys._.iSignale._.obj.sig_m_t8 UMR_NM__8_1_M50_S6_S3 4 -400 1640 DEPOSIT ABSOLUTE MONOTONY MON_INCREASE /end AXIS_DESCR
/end CHARACTERISTIC
/begin CHARACTERISTIC KF_MEKREDCMMTSP64_EL "Reduzierfaktor ME f(Mot.temp)" MAP 0x234A2C kf_ui8_S6_S3 100 UMR_PROZENT__20_51_0_S6_S3 0 100
 /begin AXIS_DESCR STD_AXIS zff_atsys._.iSignale._.obj.sig_c_mot UMR_GRADC__1_1_M48_S6_S3 4 -48 144 DEPOSIT ABSOLUTE MONOTONY MON_INCREASE /end AXIS_DESCR
 /begin AXIS_DESCR STD_AXIS zff_atsys._.iSignale._.obj.sig_m_t8 UMR_NM__8_1_M50_S6_S3 4 -400 1640 DEPOSIT ABSOLUTE MONOTONY MON_INCREASE /end AXIS_DESCR
/end CHARACTERISTIC
/begin CHARACTERISTIC KL_MEKPOSCMSP64 "Erhoehungsfaktor ME f(Mot.temp)" CURVE 0x234A4C kl_ui8_S6_S3 100 UMR_PROZENT__20_51_0_S6_S3 0 100
 /begin AXIS_DESCR STD_AXIS zff_atsys._.iSignale._.obj.sig_c_mot UMR_GRADC__1_1_M48_S6_S3 4 -48 144 DEPOSIT ABSOLUTE MONOTONY MON_INCREASE /end AXIS_DESCR
/end CHARACTERISTIC
/begin CHARACTERISTIC T_SYNMERUECKFILTERESP64 "Zeit fuer Ende Rueckfilterung pos. ME" VALUE 0x26E613 kw_ui8_S6_S3 2550 UMR_MSEC__10_1_M128_S6_S3 -1280 1270 /end CHARACTERISTIC
/begin CHARACTERISTIC KF_MEKREDCMMTSP71 "Reduzierfaktor ME f(Mot.temp)" MAP 0x234A58 kf_ui8_S6_S3 100 UMR_PROZENT__20_51_0_S6_S3 0 100
 /begin AXIS_DESCR STD_AXIS zff_atsys._.iSignale._.obj.sig_c_mot UMR_GRADC__1_1_M48_S6_S3 4 -48 144 DEPOSIT ABSOLUTE MONOTONY MON_INCREASE /end AXIS_DESCR
 /begin AXIS_DESCR STD_AXIS zff_atsys._.iSignale._.obj.sig_m_t8 UMR_NM__8_1_M50_S6_S3 4 -400 1640 DEPOSIT ABSOLUTE MONOTONY MON_INCREASE /end AXIS_DESCR
/end CHARACTERISTIC
/begin CHARACTERISTIC KF_MEKREDCMMTSP71_EL "Reduzierfaktor ME f(Mot.temp)" MAP 0x234A78 kf_ui8_S6_S3 100 UMR_PROZENT__20_51_0_S6_S3 0 100
 /begin AXIS_DESCR STD_AXIS zff_atsys._.iSignale._.obj.sig_c_mot UMR_GRADC__1_1_M48_S6_S3 4 -48 144 DEPOSIT ABSOLUTE MONOTONY MON_INCREASE /end AXIS_DESCR
 /begin AXIS_DESCR STD_AXIS zff_atsys._.iSignale._.obj.sig_m_t8 UMR_NM__8_1_M50_S6_S3 4 -400 1640 DEPOSIT ABSOLUTE MONOTONY MON_INCREASE /end AXIS_DESCR
/end CHARACTERISTIC
/begin CHARACTERISTIC KL_MEKPOSCMSP71 "Erhoehungsfaktor ME f(Mot.temp)" CURVE 0x234A98 kl_ui8_S6_S3 100 UMR_PROZENT__20_51_0_S6_S3 0 100
 /begin AXIS_DESCR STD_AXIS zff_atsys._.iSignale._.obj.sig_c_mot UMR_GRADC__1_1_M48_S6_S3 4 -48 144 DEPOSIT ABSOLUTE MONOTONY MON_INCREASE /end AXIS_DESCR
/end CHARACTERISTIC
/begin CHARACTERISTIC T_SYNMERUECKFILTERESP71 "Zeit fuer Ende Rueckfilterung pos. ME" VALUE 0x26E614 kw_ui8_S6_S3 2550 UMR_MSEC__10_1_M128_S6_S3 -1280 1270 /end CHARACTERISTIC
/begin CHARACTERISTIC KF_MEKREDCMMTSP75 "Reduzierfaktor ME f(Mot.temp)" MAP 0x234AA4 kf_ui8_S6_S3 100 UMR_PROZENT__20_51_0_S6_S3 0 100
 /begin AXIS_DESCR STD_AXIS zff_atsys._.iSignale._.obj.sig_c_mot UMR_GRADC__1_1_M48_S6_S3 4 -48 144 DEPOSIT ABSOLUTE MONOTONY MON_INCREASE /end AXIS_DESCR
 /begin AXIS_DESCR STD_AXIS zff_atsys._.iSignale._.obj.sig_m_t8 UMR_NM__8_1_M50_S6_S3 4 -400 1640 DEPOSIT ABSOLUTE MONOTONY MON_INCREASE /end AXIS_DESCR
/end CHARACTERISTIC
/begin CHARACTERISTIC KF_MEKREDCMMTSP75_EL "Reduzierfaktor ME f(Mot.temp)" MAP 0x234AC4 kf_ui8_S6_S3 100 UMR_PROZENT__20_51_0_S6_S3 0 100
 /begin AXIS_DESCR STD_AXIS zff_atsys._.iSignale._.obj.sig_c_mot UMR_GRADC__1_1_M48_S6_S3 4 -48 144 DEPOSIT ABSOLUTE MONOTONY MON_INCREASE /end AXIS_DESCR
 /begin AXIS_DESCR STD_AXIS zff_atsys._.iSignale._.obj.sig_m_t8 UMR_NM__8_1_M50_S6_S3 4 -400 1640 DEPOSIT ABSOLUTE MONOTONY MON_INCREASE /end AXIS_DESCR
/end CHARACTERISTIC
/begin CHARACTERISTIC KL_MEKPOSCMSP75 "Erhoehungsfaktor ME f(Mot.temp)" CURVE 0x234AE4 kl_ui8_S6_S3 100 UMR_PROZENT__20_51_0_S6_S3 0 100
 /begin AXIS_DESCR STD_AXIS zff_atsys._.iSignale._.obj.sig_c_mot UMR_GRADC__1_1_M48_S6_S3 4 -48 144 DEPOSIT ABSOLUTE MONOTONY MON_INCREASE /end AXIS_DESCR
/end CHARACTERISTIC
/begin CHARACTERISTIC T_SYNMERUECKFILTERESP75 "Zeit fuer Ende Rueckfilterung pos. ME" VALUE 0x26E615 kw_ui8_S6_S3 2550 UMR_MSEC__10_1_M128_S6_S3 -1280 1270 /end CHARACTERISTIC
/begin CHARACTERISTIC KF_MEKREDCMMTSP82 "Reduzierfaktor ME f(Mot.temp)" MAP 0x234AF0 kf_ui8_S6_S3 100 UMR_PROZENT__20_51_0_S6_S3 0 100
 /begin AXIS_DESCR STD_AXIS zff_atsys._.iSignale._.obj.sig_c_mot UMR_GRADC__1_1_M48_S6_S3 4 -48 144 DEPOSIT ABSOLUTE MONOTONY MON_INCREASE /end AXIS_DESCR
 /begin AXIS_DESCR STD_AXIS zff_atsys._.iSignale._.obj.sig_m_t8 UMR_NM__8_1_M50_S6_S3 4 -400 1640 DEPOSIT ABSOLUTE MONOTONY MON_INCREASE /end AXIS_DESCR
/end CHARACTERISTIC
/begin CHARACTERISTIC KF_MEKREDCMMTSP82_EL "Reduzierfaktor ME f(Mot.temp)" MAP 0x234B10 kf_ui8_S6_S3 100 UMR_PROZENT__20_51_0_S6_S3 0 100
 /begin AXIS_DESCR STD_AXIS zff_atsys._.iSignale._.obj.sig_c_mot UMR_GRADC__1_1_M48_S6_S3 4 -48 144 DEPOSIT ABSOLUTE MONOTONY MON_INCREASE /end AXIS_DESCR
 /begin AXIS_DESCR STD_AXIS zff_atsys._.iSignale._.obj.sig_m_t8 UMR_NM__8_1_M50_S6_S3 4 -400 1640 DEPOSIT ABSOLUTE MONOTONY MON_INCREASE /end AXIS_DESCR
/end CHARACTERISTIC
/begin CHARACTERISTIC KL_MEKPOSCMSP82 "Erhoehungsfaktor ME f(Mot.temp)" CURVE 0x234B30 kl_ui8_S6_S3 100 UMR_PROZENT__20_51_0_S6_S3 0 100
 /begin AXIS_DESCR STD_AXIS zff_atsys._.iSignale._.obj.sig_c_mot UMR_GRADC__1_1_M48_S6_S3 4 -48 144 DEPOSIT ABSOLUTE MONOTONY MON_INCREASE /end AXIS_DESCR
/end CHARACTERISTIC
/begin CHARACTERISTIC T_SYNMERUECKFILTERESP82 "Zeit fuer Ende Rueckfilterung pos. ME" VALUE 0x26E616 kw_ui8_S6_S3 2550 UMR_MSEC__10_1_M128_S6_S3 -1280 1270 /end CHARACTERISTIC
/begin CHARACTERISTIC KF_MEKREDCMMTSP84 "Reduzierfaktor ME f(Mot.temp)" MAP 0x234B3C kf_ui8_S6_S3 100 UMR_PROZENT__20_51_0_S6_S3 0 100
 /begin AXIS_DESCR STD_AXIS zff_atsys._.iSignale._.obj.sig_c_mot UMR_GRADC__1_1_M48_S6_S3 4 -48 144 DEPOSIT ABSOLUTE MONOTONY MON_INCREASE /end AXIS_DESCR
 /begin AXIS_DESCR STD_AXIS zff_atsys._.iSignale._.obj.sig_m_t8 UMR_NM__8_1_M50_S6_S3 4 -400 1640 DEPOSIT ABSOLUTE MONOTONY MON_INCREASE /end AXIS_DESCR
/end CHARACTERISTIC
/begin CHARACTERISTIC KF_MEKREDCMMTSP84_EL "Reduzierfaktor ME f(Mot.temp)" MAP 0x234B5C kf_ui8_S6_S3 100 UMR_PROZENT__20_51_0_S6_S3 0 100
 /begin AXIS_DESCR STD_AXIS zff_atsys._.iSignale._.obj.sig_c_mot UMR_GRADC__1_1_M48_S6_S3 4 -48 144 DEPOSIT ABSOLUTE MONOTONY MON_INCREASE /end AXIS_DESCR
 /begin AXIS_DESCR STD_AXIS zff_atsys._.iSignale._.obj.sig_m_t8 UMR_NM__8_1_M50_S6_S3 4 -400 1640 DEPOSIT ABSOLUTE MONOTONY MON_INCREASE /end AXIS_DESCR
/end CHARACTERISTIC
/begin CHARACTERISTIC KL_MEKPOSCMSP84 "Erhoehungsfaktor ME f(Mot.temp)" CURVE 0x234B7C kl_ui8_S6_S3 100 UMR_PROZENT__20_51_0_S6_S3 0 100
 /begin AXIS_DESCR STD_AXIS zff_atsys._.iSignale._.obj.sig_c_mot UMR_GRADC__1_1_M48_S6_S3 4 -48 144 DEPOSIT ABSOLUTE MONOTONY MON_INCREASE /end AXIS_DESCR
/end CHARACTERISTIC
/begin CHARACTERISTIC T_SYNMERUECKFILTERESP84 "Zeit fuer Ende Rueckfilterung pos. ME" VALUE 0x26E617 kw_ui8_S6_S3 2550 UMR_MSEC__10_1_M128_S6_S3 -1280 1270 /end CHARACTERISTIC
/begin CHARACTERISTIC KF_MEKREDCMMTSP86 "Reduzierfaktor ME f(Mot.temp)" MAP 0x234B88 kf_ui8_S6_S3 100 UMR_PROZENT__20_51_0_S6_S3 0 100
 /begin AXIS_DESCR STD_AXIS zff_atsys._.iSignale._.obj.sig_c_mot UMR_GRADC__1_1_M48_S6_S3 4 -48 144 DEPOSIT ABSOLUTE MONOTONY MON_INCREASE /end AXIS_DESCR
 /begin AXIS_DESCR STD_AXIS zff_atsys._.iSignale._.obj.sig_m_t8 UMR_NM__8_1_M50_S6_S3 4 -400 1640 DEPOSIT ABSOLUTE MONOTONY MON_INCREASE /end AXIS_DESCR
/end CHARACTERISTIC
/begin CHARACTERISTIC KF_MEKREDCMMTSP86_EL "Reduzierfaktor ME f(Mot.temp)" MAP 0x234BA8 kf_ui8_S6_S3 100 UMR_PROZENT__20_51_0_S6_S3 0 100
 /begin AXIS_DESCR STD_AXIS zff_atsys._.iSignale._.obj.sig_c_mot UMR_GRADC__1_1_M48_S6_S3 4 -48 144 DEPOSIT ABSOLUTE MONOTONY MON_INCREASE /end AXIS_DESCR
 /begin AXIS_DESCR STD_AXIS zff_atsys._.iSignale._.obj.sig_m_t8 UMR_NM__8_1_M50_S6_S3 4 -400 1640 DEPOSIT ABSOLUTE MONOTONY MON_INCREASE /end AXIS_DESCR
/end CHARACTERISTIC
/begin CHARACTERISTIC KL_MEKPOSCMSP86 "Erhoehungsfaktor ME f(Mot.temp)" CURVE 0x234BC8 kl_ui8_S6_S3 100 UMR_PROZENT__20_51_0_S6_S3 0 100
 /begin AXIS_DESCR STD_AXIS zff_atsys._.iSignale._.obj.sig_c_mot UMR_GRADC__1_1_M48_S6_S3 4 -48 144 DEPOSIT ABSOLUTE MONOTONY MON_INCREASE /end AXIS_DESCR
/end CHARACTERISTIC
/begin CHARACTERISTIC T_SYNMERUECKFILTERESP86 "Zeit fuer Ende Rueckfilterung pos. ME" VALUE 0x26E618 kw_ui8_S6_S3 2550 UMR_MSEC__10_1_M128_S6_S3 -1280 1270 /end CHARACTERISTIC
/begin CHARACTERISTIC KF_MENACHFOLNACHRS21 "Nachmotoreingriff fuer Folgeschaltung nach RS" MAP 0x22B15C kf_ui8_S6_S3 870 UMR_NM__6_1_M145_S6_S3 -870 0
 /begin AXIS_DESCR STD_AXIS NO_INPUT_QUANTITY UMR_U_MIN_32_1_0_S6_S3 4 0 8160 DEPOSIT ABSOLUTE MONOTONY MON_INCREASE /end AXIS_DESCR
 /begin AXIS_DESCR STD_AXIS zff_atsys._.iSignale._.obj.sig_m_t8 UMR_NM__8_1_M50_S6_S3 6 -400 1640 DEPOSIT ABSOLUTE MONOTONY MON_INCREASE /end AXIS_DESCR
/end CHARACTERISTIC
/begin CHARACTERISTIC KF_MENACHFOLNACHRS21_EL "Nachmotoreingriff fuer Folgeschaltung nach RS" MAP 0x22B188 kf_ui8_S6_S3 870 UMR_NM__6_1_M145_S6_S3 -870 0
 /begin AXIS_DESCR STD_AXIS NO_INPUT_QUANTITY UMR_U_MIN_32_1_0_S6_S3 4 0 8160 DEPOSIT ABSOLUTE MONOTONY MON_INCREASE /end AXIS_DESCR
 /begin AXIS_DESCR STD_AXIS zff_atsys._.iSignale._.obj.sig_m_t8 UMR_NM__8_1_M50_S6_S3 6 -400 1640 DEPOSIT ABSOLUTE MONOTONY MON_INCREASE /end AXIS_DESCR
/end CHARACTERISTIC
/begin CHARACTERISTIC KF_MENACHFOLNACHMRS21 "Nachmotoreingriff fuer Folgeschaltung nach DRS" MAP 0x22B1B4 kf_ui8_S6_S3 870 UMR_NM__6_1_M145_S6_S3 -870 0
 /begin AXIS_DESCR STD_AXIS NO_INPUT_QUANTITY UMR_U_MIN_32_1_0_S6_S3 4 0 8160 DEPOSIT ABSOLUTE MONOTONY MON_INCREASE /end AXIS_DESCR
 /begin AXIS_DESCR STD_AXIS zff_atsys._.iSignale._.obj.sig_m_t8 UMR_NM__8_1_M50_S6_S3 6 -400 1640 DEPOSIT ABSOLUTE MONOTONY MON_INCREASE /end AXIS_DESCR
/end CHARACTERISTIC
/begin CHARACTERISTIC KF_MENACHFOLNACHMRS21_EL "Nachmotoreingriff fuer Folgeschaltung nach DRS" MAP 0x22B1E0 kf_ui8_S6_S3 870 UMR_NM__6_1_M145_S6_S3 -870 0
 /begin AXIS_DESCR STD_AXIS NO_INPUT_QUANTITY UMR_U_MIN_32_1_0_S6_S3 4 0 8160 DEPOSIT ABSOLUTE MONOTONY MON_INCREASE /end AXIS_DESCR
 /begin AXIS_DESCR STD_AXIS zff_atsys._.iSignale._.obj.sig_m_t8 UMR_NM__8_1_M50_S6_S3 6 -400 1640 DEPOSIT ABSOLUTE MONOTONY MON_INCREASE /end AXIS_DESCR
/end CHARACTERISTIC
/begin CHARACTERISTIC KF_MENACHFOLNACHRSSP21 "Nachmotoreingriff fuer Folgeschaltung nach RS" MAP 0x22B20C kf_ui8_S6_S3 870 UMR_NM__6_1_M145_S6_S3 -870 0
 /begin AXIS_DESCR STD_AXIS NO_INPUT_QUANTITY UMR_U_MIN_32_1_0_S6_S3 4 0 8160 DEPOSIT ABSOLUTE MONOTONY MON_INCREASE /end AXIS_DESCR
 /begin AXIS_DESCR STD_AXIS zff_atsys._.iSignale._.obj.sig_m_t8 UMR_NM__8_1_M50_S6_S3 6 -400 1640 DEPOSIT ABSOLUTE MONOTONY MON_INCREASE /end AXIS_DESCR
/end CHARACTERISTIC
/begin CHARACTERISTIC KF_MENACHFOLNACHMRSSP21 "Nachmotoreingriff fuer Folgeschaltung nach DRS" MAP 0x22B238 kf_ui8_S6_S3 870 UMR_NM__6_1_M145_S6_S3 -870 0
 /begin AXIS_DESCR STD_AXIS NO_INPUT_QUANTITY UMR_U_MIN_32_1_0_S6_S3 4 0 8160 DEPOSIT ABSOLUTE MONOTONY MON_INCREASE /end AXIS_DESCR
 /begin AXIS_DESCR STD_AXIS zff_atsys._.iSignale._.obj.sig_m_t8 UMR_NM__8_1_M50_S6_S3 6 -400 1640 DEPOSIT ABSOLUTE MONOTONY MON_INCREASE /end AXIS_DESCR
/end CHARACTERISTIC
/begin CHARACTERISTIC KF_MENACHFOLNACHRSSPORT21 "Nachmotoreingriff fuer Folgeschaltung nach RS" MAP 0x22B264 kf_ui8_S6_S3 870 UMR_NM__6_1_M145_S6_S3 -870 0
 /begin AXIS_DESCR STD_AXIS NO_INPUT_QUANTITY UMR_U_MIN_32_1_0_S6_S3 4 0 8160 DEPOSIT ABSOLUTE MONOTONY MON_INCREASE /end AXIS_DESCR
 /begin AXIS_DESCR STD_AXIS zff_atsys._.iSignale._.obj.sig_m_t8 UMR_NM__8_1_M50_S6_S3 6 -400 1640 DEPOSIT ABSOLUTE MONOTONY MON_INCREASE /end AXIS_DESCR
/end CHARACTERISTIC
/begin CHARACTERISTIC KF_MENACHFOLNACHMRSSPORT21 "Nachmotoreingriff fuer Folgeschaltung nach DRS" MAP 0x22B290 kf_ui8_S6_S3 870 UMR_NM__6_1_M145_S6_S3 -870 0
 /begin AXIS_DESCR STD_AXIS NO_INPUT_QUANTITY UMR_U_MIN_32_1_0_S6_S3 4 0 8160 DEPOSIT ABSOLUTE MONOTONY MON_INCREASE /end AXIS_DESCR
 /begin AXIS_DESCR STD_AXIS zff_atsys._.iSignale._.obj.sig_m_t8 UMR_NM__8_1_M50_S6_S3 6 -400 1640 DEPOSIT ABSOLUTE MONOTONY MON_INCREASE /end AXIS_DESCR
/end CHARACTERISTIC
/begin CHARACTERISTIC KF_MENACHFOLNACHRS32 "Nachmotoreingriff fuer Folgeschaltung nach RS" MAP 0x22B2BC kf_ui8_S6_S3 870 UMR_NM__6_1_M145_S6_S3 -870 0
 /begin AXIS_DESCR STD_AXIS NO_INPUT_QUANTITY UMR_U_MIN_32_1_0_S6_S3 4 0 8160 DEPOSIT ABSOLUTE MONOTONY MON_INCREASE /end AXIS_DESCR
 /begin AXIS_DESCR STD_AXIS zff_atsys._.iSignale._.obj.sig_m_t8 UMR_NM__8_1_M50_S6_S3 6 -400 1640 DEPOSIT ABSOLUTE MONOTONY MON_INCREASE /end AXIS_DESCR
/end CHARACTERISTIC
/begin CHARACTERISTIC KF_MENACHFOLNACHRS32_EL "Nachmotoreingriff fuer Folgeschaltung nach RS" MAP 0x22B2E8 kf_ui8_S6_S3 870 UMR_NM__6_1_M145_S6_S3 -870 0
 /begin AXIS_DESCR STD_AXIS NO_INPUT_QUANTITY UMR_U_MIN_32_1_0_S6_S3 4 0 8160 DEPOSIT ABSOLUTE MONOTONY MON_INCREASE /end AXIS_DESCR
 /begin AXIS_DESCR STD_AXIS zff_atsys._.iSignale._.obj.sig_m_t8 UMR_NM__8_1_M50_S6_S3 6 -400 1640 DEPOSIT ABSOLUTE MONOTONY MON_INCREASE /end AXIS_DESCR
/end CHARACTERISTIC
/begin CHARACTERISTIC KF_MENACHFOLNACHMRS32 "Nachmotoreingriff fuer Folgeschaltung nach DRS" MAP 0x22B314 kf_ui8_S6_S3 870 UMR_NM__6_1_M145_S6_S3 -870 0
 /begin AXIS_DESCR STD_AXIS NO_INPUT_QUANTITY UMR_U_MIN_32_1_0_S6_S3 4 0 8160 DEPOSIT ABSOLUTE MONOTONY MON_INCREASE /end AXIS_DESCR
 /begin AXIS_DESCR STD_AXIS zff_atsys._.iSignale._.obj.sig_m_t8 UMR_NM__8_1_M50_S6_S3 6 -400 1640 DEPOSIT ABSOLUTE MONOTONY MON_INCREASE /end AXIS_DESCR
/end CHARACTERISTIC
/begin CHARACTERISTIC KF_MENACHFOLNACHMRS32_EL "Nachmotoreingriff fuer Folgeschaltung nach DRS" MAP 0x22B340 kf_ui8_S6_S3 870 UMR_NM__6_1_M145_S6_S3 -870 0
 /begin AXIS_DESCR STD_AXIS NO_INPUT_QUANTITY UMR_U_MIN_32_1_0_S6_S3 4 0 8160 DEPOSIT ABSOLUTE MONOTONY MON_INCREASE /end AXIS_DESCR
 /begin AXIS_DESCR STD_AXIS zff_atsys._.iSignale._.obj.sig_m_t8 UMR_NM__8_1_M50_S6_S3 6 -400 1640 DEPOSIT ABSOLUTE MONOTONY MON_INCREASE /end AXIS_DESCR
/end CHARACTERISTIC
/begin CHARACTERISTIC KF_MENACHFOLNACHRSSP32 "Nachmotoreingriff fuer Folgeschaltung nach RS" MAP 0x22B36C kf_ui8_S6_S3 870 UMR_NM__6_1_M145_S6_S3 -870 0
 /begin AXIS_DESCR STD_AXIS NO_INPUT_QUANTITY UMR_U_MIN_32_1_0_S6_S3 4 0 8160 DEPOSIT ABSOLUTE MONOTONY MON_INCREASE /end AXIS_DESCR
 /begin AXIS_DESCR STD_AXIS zff_atsys._.iSignale._.obj.sig_m_t8 UMR_NM__8_1_M50_S6_S3 6 -400 1640 DEPOSIT ABSOLUTE MONOTONY MON_INCREASE /end AXIS_DESCR
/end CHARACTERISTIC
/begin CHARACTERISTIC KF_MENACHFOLNACHMRSSP32 "Nachmotoreingriff fuer Folgeschaltung nach DRS" MAP 0x22B398 kf_ui8_S6_S3 870 UMR_NM__6_1_M145_S6_S3 -870 0
 /begin AXIS_DESCR STD_AXIS NO_INPUT_QUANTITY UMR_U_MIN_32_1_0_S6_S3 4 0 8160 DEPOSIT ABSOLUTE MONOTONY MON_INCREASE /end AXIS_DESCR
 /begin AXIS_DESCR STD_AXIS zff_atsys._.iSignale._.obj.sig_m_t8 UMR_NM__8_1_M50_S6_S3 6 -400 1640 DEPOSIT ABSOLUTE MONOTONY MON_INCREASE /end AXIS_DESCR
/end CHARACTERISTIC
/begin CHARACTERISTIC KF_MENACHFOLNACHRSSPORT32 "Nachmotoreingriff fuer Folgeschaltung nach RS" MAP 0x22B3C4 kf_ui8_S6_S3 870 UMR_NM__6_1_M145_S6_S3 -870 0
 /begin AXIS_DESCR STD_AXIS NO_INPUT_QUANTITY UMR_U_MIN_32_1_0_S6_S3 4 0 8160 DEPOSIT ABSOLUTE MONOTONY MON_INCREASE /end AXIS_DESCR
 /begin AXIS_DESCR STD_AXIS zff_atsys._.iSignale._.obj.sig_m_t8 UMR_NM__8_1_M50_S6_S3 6 -400 1640 DEPOSIT ABSOLUTE MONOTONY MON_INCREASE /end AXIS_DESCR
/end CHARACTERISTIC
/begin CHARACTERISTIC KF_MENACHFOLNACHMRSSPORT32 "Nachmotoreingriff fuer Folgeschaltung nach DRS" MAP 0x22B3F0 kf_ui8_S6_S3 870 UMR_NM__6_1_M145_S6_S3 -870 0
 /begin AXIS_DESCR STD_AXIS NO_INPUT_QUANTITY UMR_U_MIN_32_1_0_S6_S3 4 0 8160 DEPOSIT ABSOLUTE MONOTONY MON_INCREASE /end AXIS_DESCR
 /begin AXIS_DESCR STD_AXIS zff_atsys._.iSignale._.obj.sig_m_t8 UMR_NM__8_1_M50_S6_S3 6 -400 1640 DEPOSIT ABSOLUTE MONOTONY MON_INCREASE /end AXIS_DESCR
/end CHARACTERISTIC
/begin CHARACTERISTIC KF_MENACHFOLNACHRS43 "Nachmotoreingriff fuer Folgeschaltung nach RS" MAP 0x22B41C kf_ui8_S6_S3 870 UMR_NM__6_1_M145_S6_S3 -870 0
 /begin AXIS_DESCR STD_AXIS NO_INPUT_QUANTITY UMR_U_MIN_32_1_0_S6_S3 4 0 8160 DEPOSIT ABSOLUTE MONOTONY MON_INCREASE /end AXIS_DESCR
 /begin AXIS_DESCR STD_AXIS zff_atsys._.iSignale._.obj.sig_m_t8 UMR_NM__8_1_M50_S6_S3 6 -400 1640 DEPOSIT ABSOLUTE MONOTONY MON_INCREASE /end AXIS_DESCR
/end CHARACTERISTIC
/begin CHARACTERISTIC KF_MENACHFOLNACHRS43_EL "Nachmotoreingriff fuer Folgeschaltung nach RS" MAP 0x22B448 kf_ui8_S6_S3 870 UMR_NM__6_1_M145_S6_S3 -870 0
 /begin AXIS_DESCR STD_AXIS NO_INPUT_QUANTITY UMR_U_MIN_32_1_0_S6_S3 4 0 8160 DEPOSIT ABSOLUTE MONOTONY MON_INCREASE /end AXIS_DESCR
 /begin AXIS_DESCR STD_AXIS zff_atsys._.iSignale._.obj.sig_m_t8 UMR_NM__8_1_M50_S6_S3 6 -400 1640 DEPOSIT ABSOLUTE MONOTONY MON_INCREASE /end AXIS_DESCR
/end CHARACTERISTIC
/begin CHARACTERISTIC KF_MENACHFOLNACHMRS43 "Nachmotoreingriff fuer Folgeschaltung nach DRS" MAP 0x22B474 kf_ui8_S6_S3 870 UMR_NM__6_1_M145_S6_S3 -870 0
 /begin AXIS_DESCR STD_AXIS NO_INPUT_QUANTITY UMR_U_MIN_32_1_0_S6_S3 4 0 8160 DEPOSIT ABSOLUTE MONOTONY MON_INCREASE /end AXIS_DESCR
 /begin AXIS_DESCR STD_AXIS zff_atsys._.iSignale._.obj.sig_m_t8 UMR_NM__8_1_M50_S6_S3 6 -400 1640 DEPOSIT ABSOLUTE MONOTONY MON_INCREASE /end AXIS_DESCR
/end CHARACTERISTIC
/begin CHARACTERISTIC KF_MENACHFOLNACHMRS43_EL "Nachmotoreingriff fuer Folgeschaltung nach DRS" MAP 0x22B4A0 kf_ui8_S6_S3 870 UMR_NM__6_1_M145_S6_S3 -870 0
 /begin AXIS_DESCR STD_AXIS NO_INPUT_QUANTITY UMR_U_MIN_32_1_0_S6_S3 4 0 8160 DEPOSIT ABSOLUTE MONOTONY MON_INCREASE /end AXIS_DESCR
 /begin AXIS_DESCR STD_AXIS zff_atsys._.iSignale._.obj.sig_m_t8 UMR_NM__8_1_M50_S6_S3 6 -400 1640 DEPOSIT ABSOLUTE MONOTONY MON_INCREASE /end AXIS_DESCR
/end CHARACTERISTIC
/begin CHARACTERISTIC KF_MENACHFOLNACHRSSP43 "Nachmotoreingriff fuer Folgeschaltung nach RS" MAP 0x22B4CC kf_ui8_S6_S3 870 UMR_NM__6_1_M145_S6_S3 -870 0
 /begin AXIS_DESCR STD_AXIS NO_INPUT_QUANTITY UMR_U_MIN_32_1_0_S6_S3 4 0 8160 DEPOSIT ABSOLUTE MONOTONY MON_INCREASE /end AXIS_DESCR
 /begin AXIS_DESCR STD_AXIS zff_atsys._.iSignale._.obj.sig_m_t8 UMR_NM__8_1_M50_S6_S3 6 -400 1640 DEPOSIT ABSOLUTE MONOTONY MON_INCREASE /end AXIS_DESCR
/end CHARACTERISTIC
/begin CHARACTERISTIC KF_MENACHFOLNACHMRSSP43 "Nachmotoreingriff fuer Folgeschaltung nach DRS" MAP 0x22B4F8 kf_ui8_S6_S3 870 UMR_NM__6_1_M145_S6_S3 -870 0
 /begin AXIS_DESCR STD_AXIS NO_INPUT_QUANTITY UMR_U_MIN_32_1_0_S6_S3 4 0 8160 DEPOSIT ABSOLUTE MONOTONY MON_INCREASE /end AXIS_DESCR
 /begin AXIS_DESCR STD_AXIS zff_atsys._.iSignale._.obj.sig_m_t8 UMR_NM__8_1_M50_S6_S3 6 -400 1640 DEPOSIT ABSOLUTE MONOTONY MON_INCREASE /end AXIS_DESCR
/end CHARACTERISTIC
/begin CHARACTERISTIC KF_MENACHFOLNACHRSSPORT43 "Nachmotoreingriff fuer Folgeschaltung nach RS" MAP 0x22B524 kf_ui8_S6_S3 870 UMR_NM__6_1_M145_S6_S3 -870 0
 /begin AXIS_DESCR STD_AXIS NO_INPUT_QUANTITY UMR_U_MIN_32_1_0_S6_S3 4 0 8160 DEPOSIT ABSOLUTE MONOTONY MON_INCREASE /end AXIS_DESCR
 /begin AXIS_DESCR STD_AXIS zff_atsys._.iSignale._.obj.sig_m_t8 UMR_NM__8_1_M50_S6_S3 6 -400 1640 DEPOSIT ABSOLUTE MONOTONY MON_INCREASE /end AXIS_DESCR
/end CHARACTERISTIC
/begin CHARACTERISTIC KF_MENACHFOLNACHMRSSPORT43 "Nachmotoreingriff fuer Folgeschaltung nach DRS" MAP 0x22B550 kf_ui8_S6_S3 870 UMR_NM__6_1_M145_S6_S3 -870 0
 /begin AXIS_DESCR STD_AXIS NO_INPUT_QUANTITY UMR_U_MIN_32_1_0_S6_S3 4 0 8160 DEPOSIT ABSOLUTE MONOTONY MON_INCREASE /end AXIS_DESCR
 /begin AXIS_DESCR STD_AXIS zff_atsys._.iSignale._.obj.sig_m_t8 UMR_NM__8_1_M50_S6_S3 6 -400 1640 DEPOSIT ABSOLUTE MONOTONY MON_INCREASE /end AXIS_DESCR
/end CHARACTERISTIC
/begin CHARACTERISTIC KF_MENACHFOLNACHRS54 "Nachmotoreingriff fuer Folgeschaltung nach RS" MAP 0x22B57C kf_ui8_S6_S3 870 UMR_NM__6_1_M145_S6_S3 -870 0
 /begin AXIS_DESCR STD_AXIS NO_INPUT_QUANTITY UMR_U_MIN_32_1_0_S6_S3 4 0 8160 DEPOSIT ABSOLUTE MONOTONY MON_INCREASE /end AXIS_DESCR
 /begin AXIS_DESCR STD_AXIS zff_atsys._.iSignale._.obj.sig_m_t8 UMR_NM__8_1_M50_S6_S3 6 -400 1640 DEPOSIT ABSOLUTE MONOTONY MON_INCREASE /end AXIS_DESCR
/end CHARACTERISTIC
/begin CHARACTERISTIC KF_MENACHFOLNACHRS54_EL "Nachmotoreingriff fuer Folgeschaltung nach RS" MAP 0x22B5A8 kf_ui8_S6_S3 870 UMR_NM__6_1_M145_S6_S3 -870 0
 /begin AXIS_DESCR STD_AXIS NO_INPUT_QUANTITY UMR_U_MIN_32_1_0_S6_S3 4 0 8160 DEPOSIT ABSOLUTE MONOTONY MON_INCREASE /end AXIS_DESCR
 /begin AXIS_DESCR STD_AXIS zff_atsys._.iSignale._.obj.sig_m_t8 UMR_NM__8_1_M50_S6_S3 6 -400 1640 DEPOSIT ABSOLUTE MONOTONY MON_INCREASE /end AXIS_DESCR
/end CHARACTERISTIC
/begin CHARACTERISTIC KF_MENACHFOLNACHMRS54 "Nachmotoreingriff fuer Folgeschaltung nach DRS" MAP 0x22B5D4 kf_ui8_S6_S3 870 UMR_NM__6_1_M145_S6_S3 -870 0
 /begin AXIS_DESCR STD_AXIS NO_INPUT_QUANTITY UMR_U_MIN_32_1_0_S6_S3 4 0 8160 DEPOSIT ABSOLUTE MONOTONY MON_INCREASE /end AXIS_DESCR
 /begin AXIS_DESCR STD_AXIS zff_atsys._.iSignale._.obj.sig_m_t8 UMR_NM__8_1_M50_S6_S3 6 -400 1640 DEPOSIT ABSOLUTE MONOTONY MON_INCREASE /end AXIS_DESCR
/end CHARACTERISTIC
/begin CHARACTERISTIC KF_MENACHFOLNACHMRS54_EL "Nachmotoreingriff fuer Folgeschaltung nach DRS" MAP 0x22B600 kf_ui8_S6_S3 870 UMR_NM__6_1_M145_S6_S3 -870 0
 /begin AXIS_DESCR STD_AXIS NO_INPUT_QUANTITY UMR_U_MIN_32_1_0_S6_S3 4 0 8160 DEPOSIT ABSOLUTE MONOTONY MON_INCREASE /end AXIS_DESCR
 /begin AXIS_DESCR STD_AXIS zff_atsys._.iSignale._.obj.sig_m_t8 UMR_NM__8_1_M50_S6_S3 6 -400 1640 DEPOSIT ABSOLUTE MONOTONY MON_INCREASE /end AXIS_DESCR
/end CHARACTERISTIC
/begin CHARACTERISTIC KF_MENACHFOLNACHRSSP54 "Nachmotoreingriff fuer Folgeschaltung nach RS" MAP 0x22B62C kf_ui8_S6_S3 870 UMR_NM__6_1_M145_S6_S3 -870 0
 /begin AXIS_DESCR STD_AXIS NO_INPUT_QUANTITY UMR_U_MIN_32_1_0_S6_S3 4 0 8160 DEPOSIT ABSOLUTE MONOTONY MON_INCREASE /end AXIS_DESCR
 /begin AXIS_DESCR STD_AXIS zff_atsys._.iSignale._.obj.sig_m_t8 UMR_NM__8_1_M50_S6_S3 6 -400 1640 DEPOSIT ABSOLUTE MONOTONY MON_INCREASE /end AXIS_DESCR
/end CHARACTERISTIC
/begin CHARACTERISTIC KF_MENACHFOLNACHMRSSP54 "Nachmotoreingriff fuer Folgeschaltung nach DRS" MAP 0x22B658 kf_ui8_S6_S3 870 UMR_NM__6_1_M145_S6_S3 -870 0
 /begin AXIS_DESCR STD_AXIS NO_INPUT_QUANTITY UMR_U_MIN_32_1_0_S6_S3 4 0 8160 DEPOSIT ABSOLUTE MONOTONY MON_INCREASE /end AXIS_DESCR
 /begin AXIS_DESCR STD_AXIS zff_atsys._.iSignale._.obj.sig_m_t8 UMR_NM__8_1_M50_S6_S3 6 -400 1640 DEPOSIT ABSOLUTE MONOTONY MON_INCREASE /end AXIS_DESCR
/end CHARACTERISTIC
/begin CHARACTERISTIC KF_MENACHFOLNACHRSSPORT54 "Nachmotoreingriff fuer Folgeschaltung nach RS" MAP 0x22B684 kf_ui8_S6_S3 870 UMR_NM__6_1_M145_S6_S3 -870 0
 /begin AXIS_DESCR STD_AXIS NO_INPUT_QUANTITY UMR_U_MIN_32_1_0_S6_S3 4 0 8160 DEPOSIT ABSOLUTE MONOTONY MON_INCREASE /end AXIS_DESCR
 /begin AXIS_DESCR STD_AXIS zff_atsys._.iSignale._.obj.sig_m_t8 UMR_NM__8_1_M50_S6_S3 6 -400 1640 DEPOSIT ABSOLUTE MONOTONY MON_INCREASE /end AXIS_DESCR
/end CHARACTERISTIC
/begin CHARACTERISTIC KF_MENACHFOLNACHMRSSPORT54 "Nachmotoreingriff fuer Folgeschaltung nach DRS" MAP 0x22B6B0 kf_ui8_S6_S3 870 UMR_NM__6_1_M145_S6_S3 -870 0
 /begin AXIS_DESCR STD_AXIS NO_INPUT_QUANTITY UMR_U_MIN_32_1_0_S6_S3 4 0 8160 DEPOSIT ABSOLUTE MONOTONY MON_INCREASE /end AXIS_DESCR
 /begin AXIS_DESCR STD_AXIS zff_atsys._.iSignale._.obj.sig_m_t8 UMR_NM__8_1_M50_S6_S3 6 -400 1640 DEPOSIT ABSOLUTE MONOTONY MON_INCREASE /end AXIS_DESCR
/end CHARACTERISTIC
/begin CHARACTERISTIC KF_MENACHFOLNACHRS65 "Nachmotoreingriff fuer Folgeschaltung nach RS" MAP 0x22B6DC kf_ui8_S6_S3 870 UMR_NM__6_1_M145_S6_S3 -870 0
 /begin AXIS_DESCR STD_AXIS NO_INPUT_QUANTITY UMR_U_MIN_32_1_0_S6_S3 4 0 8160 DEPOSIT ABSOLUTE MONOTONY MON_INCREASE /end AXIS_DESCR
 /begin AXIS_DESCR STD_AXIS zff_atsys._.iSignale._.obj.sig_m_t8 UMR_NM__8_1_M50_S6_S3 6 -400 1640 DEPOSIT ABSOLUTE MONOTONY MON_INCREASE /end AXIS_DESCR
/end CHARACTERISTIC
/begin CHARACTERISTIC KF_MENACHFOLNACHRS65_EL "Nachmotoreingriff fuer Folgeschaltung nach RS" MAP 0x22B708 kf_ui8_S6_S3 870 UMR_NM__6_1_M145_S6_S3 -870 0
 /begin AXIS_DESCR STD_AXIS NO_INPUT_QUANTITY UMR_U_MIN_32_1_0_S6_S3 4 0 8160 DEPOSIT ABSOLUTE MONOTONY MON_INCREASE /end AXIS_DESCR
 /begin AXIS_DESCR STD_AXIS zff_atsys._.iSignale._.obj.sig_m_t8 UMR_NM__8_1_M50_S6_S3 6 -400 1640 DEPOSIT ABSOLUTE MONOTONY MON_INCREASE /end AXIS_DESCR
/end CHARACTERISTIC
/begin CHARACTERISTIC KF_MENACHFOLNACHMRS65 "Nachmotoreingriff fuer Folgeschaltung nach DRS" MAP 0x22B734 kf_ui8_S6_S3 870 UMR_NM__6_1_M145_S6_S3 -870 0
 /begin AXIS_DESCR STD_AXIS NO_INPUT_QUANTITY UMR_U_MIN_32_1_0_S6_S3 4 0 8160 DEPOSIT ABSOLUTE MONOTONY MON_INCREASE /end AXIS_DESCR
 /begin AXIS_DESCR STD_AXIS zff_atsys._.iSignale._.obj.sig_m_t8 UMR_NM__8_1_M50_S6_S3 6 -400 1640 DEPOSIT ABSOLUTE MONOTONY MON_INCREASE /end AXIS_DESCR
/end CHARACTERISTIC
/begin CHARACTERISTIC KF_MENACHFOLNACHMRS65_EL "Nachmotoreingriff fuer Folgeschaltung nach DRS" MAP 0x22B760 kf_ui8_S6_S3 870 UMR_NM__6_1_M145_S6_S3 -870 0
 /begin AXIS_DESCR STD_AXIS NO_INPUT_QUANTITY UMR_U_MIN_32_1_0_S6_S3 4 0 8160 DEPOSIT ABSOLUTE MONOTONY MON_INCREASE /end AXIS_DESCR
 /begin AXIS_DESCR STD_AXIS zff_atsys._.iSignale._.obj.sig_m_t8 UMR_NM__8_1_M50_S6_S3 6 -400 1640 DEPOSIT ABSOLUTE MONOTONY MON_INCREASE /end AXIS_DESCR
/end CHARACTERISTIC
/begin CHARACTERISTIC KF_MENACHFOLNACHRSSP65 "Nachmotoreingriff fuer Folgeschaltung nach RS" MAP 0x22B78C kf_ui8_S6_S3 870 UMR_NM__6_1_M145_S6_S3 -870 0
 /begin AXIS_DESCR STD_AXIS NO_INPUT_QUANTITY UMR_U_MIN_32_1_0_S6_S3 4 0 8160 DEPOSIT ABSOLUTE MONOTONY MON_INCREASE /end AXIS_DESCR
 /begin AXIS_DESCR STD_AXIS zff_atsys._.iSignale._.obj.sig_m_t8 UMR_NM__8_1_M50_S6_S3 6 -400 1640 DEPOSIT ABSOLUTE MONOTONY MON_INCREASE /end AXIS_DESCR
/end CHARACTERISTIC
/begin CHARACTERISTIC KF_MENACHFOLNACHMRSSP65 "Nachmotoreingriff fuer Folgeschaltung nach DRS" MAP 0x22B7B8 kf_ui8_S6_S3 870 UMR_NM__6_1_M145_S6_S3 -870 0
 /begin AXIS_DESCR STD_AXIS NO_INPUT_QUANTITY UMR_U_MIN_32_1_0_S6_S3 4 0 8160 DEPOSIT ABSOLUTE MONOTONY MON_INCREASE /end AXIS_DESCR
 /begin AXIS_DESCR STD_AXIS zff_atsys._.iSignale._.obj.sig_m_t8 UMR_NM__8_1_M50_S6_S3 6 -400 1640 DEPOSIT ABSOLUTE MONOTONY MON_INCREASE /end AXIS_DESCR
/end CHARACTERISTIC
/begin CHARACTERISTIC KF_MENACHFOLNACHRSSPORT65 "Nachmotoreingriff fuer Folgeschaltung nach RS" MAP 0x22B7E4 kf_ui8_S6_S3 870 UMR_NM__6_1_M145_S6_S3 -870 0
 /begin AXIS_DESCR STD_AXIS NO_INPUT_QUANTITY UMR_U_MIN_32_1_0_S6_S3 4 0 8160 DEPOSIT ABSOLUTE MONOTONY MON_INCREASE /end AXIS_DESCR
 /begin AXIS_DESCR STD_AXIS zff_atsys._.iSignale._.obj.sig_m_t8 UMR_NM__8_1_M50_S6_S3 6 -400 1640 DEPOSIT ABSOLUTE MONOTONY MON_INCREASE /end AXIS_DESCR
/end CHARACTERISTIC
/begin CHARACTERISTIC KF_MENACHFOLNACHMRSSPORT65 "Nachmotoreingriff fuer Folgeschaltung nach DRS" MAP 0x22B810 kf_ui8_S6_S3 870 UMR_NM__6_1_M145_S6_S3 -870 0
 /begin AXIS_DESCR STD_AXIS NO_INPUT_QUANTITY UMR_U_MIN_32_1_0_S6_S3 4 0 8160 DEPOSIT ABSOLUTE MONOTONY MON_INCREASE /end AXIS_DESCR
 /begin AXIS_DESCR STD_AXIS zff_atsys._.iSignale._.obj.sig_m_t8 UMR_NM__8_1_M50_S6_S3 6 -400 1640 DEPOSIT ABSOLUTE MONOTONY MON_INCREASE /end AXIS_DESCR
/end CHARACTERISTIC
/begin CHARACTERISTIC KF_MENACHFOLNACHRS76 "Nachmotoreingriff fuer Folgeschaltung nach RS" MAP 0x22B83C kf_ui8_S6_S3 870 UMR_NM__6_1_M145_S6_S3 -870 0
 /begin AXIS_DESCR STD_AXIS NO_INPUT_QUANTITY UMR_U_MIN_32_1_0_S6_S3 4 0 8160 DEPOSIT ABSOLUTE MONOTONY MON_INCREASE /end AXIS_DESCR
 /begin AXIS_DESCR STD_AXIS zff_atsys._.iSignale._.obj.sig_m_t8 UMR_NM__8_1_M50_S6_S3 6 -400 1640 DEPOSIT ABSOLUTE MONOTONY MON_INCREASE /end AXIS_DESCR
/end CHARACTERISTIC
/begin CHARACTERISTIC KF_MENACHFOLNACHRS76_EL "Nachmotoreingriff fuer Folgeschaltung nach RS" MAP 0x22B868 kf_ui8_S6_S3 870 UMR_NM__6_1_M145_S6_S3 -870 0
 /begin AXIS_DESCR STD_AXIS NO_INPUT_QUANTITY UMR_U_MIN_32_1_0_S6_S3 4 0 8160 DEPOSIT ABSOLUTE MONOTONY MON_INCREASE /end AXIS_DESCR
 /begin AXIS_DESCR STD_AXIS zff_atsys._.iSignale._.obj.sig_m_t8 UMR_NM__8_1_M50_S6_S3 6 -400 1640 DEPOSIT ABSOLUTE MONOTONY MON_INCREASE /end AXIS_DESCR
/end CHARACTERISTIC
/begin CHARACTERISTIC KF_MENACHFOLNACHMRS76 "Nachmotoreingriff fuer Folgeschaltung nach DRS" MAP 0x22B894 kf_ui8_S6_S3 870 UMR_NM__6_1_M145_S6_S3 -870 0
 /begin AXIS_DESCR STD_AXIS NO_INPUT_QUANTITY UMR_U_MIN_32_1_0_S6_S3 4 0 8160 DEPOSIT ABSOLUTE MONOTONY MON_INCREASE /end AXIS_DESCR
 /begin AXIS_DESCR STD_AXIS zff_atsys._.iSignale._.obj.sig_m_t8 UMR_NM__8_1_M50_S6_S3 6 -400 1640 DEPOSIT ABSOLUTE MONOTONY MON_INCREASE /end AXIS_DESCR
/end CHARACTERISTIC
/begin CHARACTERISTIC KF_MENACHFOLNACHMRS76_EL "Nachmotoreingriff fuer Folgeschaltung nach DRS" MAP 0x22B8C0 kf_ui8_S6_S3 870 UMR_NM__6_1_M145_S6_S3 -870 0
 /begin AXIS_DESCR STD_AXIS NO_INPUT_QUANTITY UMR_U_MIN_32_1_0_S6_S3 4 0 8160 DEPOSIT ABSOLUTE MONOTONY MON_INCREASE /end AXIS_DESCR
 /begin AXIS_DESCR STD_AXIS zff_atsys._.iSignale._.obj.sig_m_t8 UMR_NM__8_1_M50_S6_S3 6 -400 1640 DEPOSIT ABSOLUTE MONOTONY MON_INCREASE /end AXIS_DESCR
/end CHARACTERISTIC
/begin CHARACTERISTIC KF_MENACHFOLNACHRSSP76 "Nachmotoreingriff fuer Folgeschaltung nach RS" MAP 0x22B8EC kf_ui8_S6_S3 870 UMR_NM__6_1_M145_S6_S3 -870 0
 /begin AXIS_DESCR STD_AXIS NO_INPUT_QUANTITY UMR_U_MIN_32_1_0_S6_S3 4 0 8160 DEPOSIT ABSOLUTE MONOTONY MON_INCREASE /end AXIS_DESCR
 /begin AXIS_DESCR STD_AXIS zff_atsys._.iSignale._.obj.sig_m_t8 UMR_NM__8_1_M50_S6_S3 6 -400 1640 DEPOSIT ABSOLUTE MONOTONY MON_INCREASE /end AXIS_DESCR
/end CHARACTERISTIC
/begin CHARACTERISTIC KF_MENACHFOLNACHMRSSP76 "Nachmotoreingriff fuer Folgeschaltung nach DRS" MAP 0x22B918 kf_ui8_S6_S3 870 UMR_NM__6_1_M145_S6_S3 -870 0
 /begin AXIS_DESCR STD_AXIS NO_INPUT_QUANTITY UMR_U_MIN_32_1_0_S6_S3 4 0 8160 DEPOSIT ABSOLUTE MONOTONY MON_INCREASE /end AXIS_DESCR
 /begin AXIS_DESCR STD_AXIS zff_atsys._.iSignale._.obj.sig_m_t8 UMR_NM__8_1_M50_S6_S3 6 -400 1640 DEPOSIT ABSOLUTE MONOTONY MON_INCREASE /end AXIS_DESCR
/end CHARACTERISTIC
/begin CHARACTERISTIC KF_MENACHFOLNACHRSSPORT76 "Nachmotoreingriff fuer Folgeschaltung nach RS" MAP 0x22B944 kf_ui8_S6_S3 870 UMR_NM__6_1_M145_S6_S3 -870 0
 /begin AXIS_DESCR STD_AXIS NO_INPUT_QUANTITY UMR_U_MIN_32_1_0_S6_S3 4 0 8160 DEPOSIT ABSOLUTE MONOTONY MON_INCREASE /end AXIS_DESCR
 /begin AXIS_DESCR STD_AXIS zff_atsys._.iSignale._.obj.sig_m_t8 UMR_NM__8_1_M50_S6_S3 6 -400 1640 DEPOSIT ABSOLUTE MONOTONY MON_INCREASE /end AXIS_DESCR
/end CHARACTERISTIC
/begin CHARACTERISTIC KF_MENACHFOLNACHMRSSPORT76 "Nachmotoreingriff fuer Folgeschaltung nach DRS" MAP 0x22B970 kf_ui8_S6_S3 870 UMR_NM__6_1_M145_S6_S3 -870 0
 /begin AXIS_DESCR STD_AXIS NO_INPUT_QUANTITY UMR_U_MIN_32_1_0_S6_S3 4 0 8160 DEPOSIT ABSOLUTE MONOTONY MON_INCREASE /end AXIS_DESCR
 /begin AXIS_DESCR STD_AXIS zff_atsys._.iSignale._.obj.sig_m_t8 UMR_NM__8_1_M50_S6_S3 6 -400 1640 DEPOSIT ABSOLUTE MONOTONY MON_INCREASE /end AXIS_DESCR
/end CHARACTERISTIC
/begin CHARACTERISTIC KF_MENACHFOLNACHRS87 "Nachmotoreingriff fuer Folgeschaltung nach RS" MAP 0x22B99C kf_ui8_S6_S3 870 UMR_NM__6_1_M145_S6_S3 -870 0
 /begin AXIS_DESCR STD_AXIS NO_INPUT_QUANTITY UMR_U_MIN_32_1_0_S6_S3 4 0 8160 DEPOSIT ABSOLUTE MONOTONY MON_INCREASE /end AXIS_DESCR
 /begin AXIS_DESCR STD_AXIS zff_atsys._.iSignale._.obj.sig_m_t8 UMR_NM__8_1_M50_S6_S3 6 -400 1640 DEPOSIT ABSOLUTE MONOTONY MON_INCREASE /end AXIS_DESCR
/end CHARACTERISTIC
/begin CHARACTERISTIC KF_MENACHFOLNACHRS87_EL "Nachmotoreingriff fuer Folgeschaltung nach RS" MAP 0x22B9C8 kf_ui8_S6_S3 870 UMR_NM__6_1_M145_S6_S3 -870 0
 /begin AXIS_DESCR STD_AXIS NO_INPUT_QUANTITY UMR_U_MIN_32_1_0_S6_S3 4 0 8160 DEPOSIT ABSOLUTE MONOTONY MON_INCREASE /end AXIS_DESCR
 /begin AXIS_DESCR STD_AXIS zff_atsys._.iSignale._.obj.sig_m_t8 UMR_NM__8_1_M50_S6_S3 6 -400 1640 DEPOSIT ABSOLUTE MONOTONY MON_INCREASE /end AXIS_DESCR
/end CHARACTERISTIC
/begin CHARACTERISTIC KF_MENACHFOLNACHMRS87 "Nachmotoreingriff fuer Folgeschaltung nach DRS" MAP 0x22B9F4 kf_ui8_S6_S3 870 UMR_NM__6_1_M145_S6_S3 -870 0
 /begin AXIS_DESCR STD_AXIS NO_INPUT_QUANTITY UMR_U_MIN_32_1_0_S6_S3 4 0 8160 DEPOSIT ABSOLUTE MONOTONY MON_INCREASE /end AXIS_DESCR
 /begin AXIS_DESCR STD_AXIS zff_atsys._.iSignale._.obj.sig_m_t8 UMR_NM__8_1_M50_S6_S3 6 -400 1640 DEPOSIT ABSOLUTE MONOTONY MON_INCREASE /end AXIS_DESCR
/end CHARACTERISTIC
/begin CHARACTERISTIC KF_MENACHFOLNACHMRS87_EL "Nachmotoreingriff fuer Folgeschaltung nach DRS" MAP 0x22BA20 kf_ui8_S6_S3 870 UMR_NM__6_1_M145_S6_S3 -870 0
 /begin AXIS_DESCR STD_AXIS NO_INPUT_QUANTITY UMR_U_MIN_32_1_0_S6_S3 4 0 8160 DEPOSIT ABSOLUTE MONOTONY MON_INCREASE /end AXIS_DESCR
 /begin AXIS_DESCR STD_AXIS zff_atsys._.iSignale._.obj.sig_m_t8 UMR_NM__8_1_M50_S6_S3 6 -400 1640 DEPOSIT ABSOLUTE MONOTONY MON_INCREASE /end AXIS_DESCR
/end CHARACTERISTIC
/begin CHARACTERISTIC KF_MENACHFOLNACHRSSP87 "Nachmotoreingriff fuer Folgeschaltung nach RS" MAP 0x22BA4C kf_ui8_S6_S3 870 UMR_NM__6_1_M145_S6_S3 -870 0
 /begin AXIS_DESCR STD_AXIS NO_INPUT_QUANTITY UMR_U_MIN_32_1_0_S6_S3 4 0 8160 DEPOSIT ABSOLUTE MONOTONY MON_INCREASE /end AXIS_DESCR
 /begin AXIS_DESCR STD_AXIS zff_atsys._.iSignale._.obj.sig_m_t8 UMR_NM__8_1_M50_S6_S3 6 -400 1640 DEPOSIT ABSOLUTE MONOTONY MON_INCREASE /end AXIS_DESCR
/end CHARACTERISTIC
/begin CHARACTERISTIC KF_MENACHFOLNACHMRSSP87 "Nachmotoreingriff fuer Folgeschaltung nach DRS" MAP 0x22BA78 kf_ui8_S6_S3 870 UMR_NM__6_1_M145_S6_S3 -870 0
 /begin AXIS_DESCR STD_AXIS NO_INPUT_QUANTITY UMR_U_MIN_32_1_0_S6_S3 4 0 8160 DEPOSIT ABSOLUTE MONOTONY MON_INCREASE /end AXIS_DESCR
 /begin AXIS_DESCR STD_AXIS zff_atsys._.iSignale._.obj.sig_m_t8 UMR_NM__8_1_M50_S6_S3 6 -400 1640 DEPOSIT ABSOLUTE MONOTONY MON_INCREASE /end AXIS_DESCR
/end CHARACTERISTIC
/begin CHARACTERISTIC KF_MENACHFOLNACHRSSPORT87 "Nachmotoreingriff fuer Folgeschaltung nach RS" MAP 0x22BAA4 kf_ui8_S6_S3 870 UMR_NM__6_1_M145_S6_S3 -870 0
 /begin AXIS_DESCR STD_AXIS NO_INPUT_QUANTITY UMR_U_MIN_32_1_0_S6_S3 4 0 8160 DEPOSIT ABSOLUTE MONOTONY MON_INCREASE /end AXIS_DESCR
 /begin AXIS_DESCR STD_AXIS zff_atsys._.iSignale._.obj.sig_m_t8 UMR_NM__8_1_M50_S6_S3 6 -400 1640 DEPOSIT ABSOLUTE MONOTONY MON_INCREASE /end AXIS_DESCR
/end CHARACTERISTIC
/begin CHARACTERISTIC KF_MENACHFOLNACHMRSSPORT87 "Nachmotoreingriff fuer Folgeschaltung nach DRS" MAP 0x22BAD0 kf_ui8_S6_S3 870 UMR_NM__6_1_M145_S6_S3 -870 0
 /begin AXIS_DESCR STD_AXIS NO_INPUT_QUANTITY UMR_U_MIN_32_1_0_S6_S3 4 0 8160 DEPOSIT ABSOLUTE MONOTONY MON_INCREASE /end AXIS_DESCR
 /begin AXIS_DESCR STD_AXIS zff_atsys._.iSignale._.obj.sig_m_t8 UMR_NM__8_1_M50_S6_S3 6 -400 1640 DEPOSIT ABSOLUTE MONOTONY MON_INCREASE /end AXIS_DESCR
/end CHARACTERISTIC
/begin COMPU_METHOD SAB_N_25GRADPS_S2_S3 "int = ((phys * 1) / 25) - (0) Grad/s" RAT_FUNC "%5.3" "Grad/s" COEFFS 0 1 -0 0 0 25 /end COMPU_METHOD
/begin COMPU_METHOD SAB_N_GRADPS_S2_S3 "int = ((phys * 1) / 1) - (0) Grad/s" RAT_FUNC "%2.0" "Grad/s" COEFFS 0 1 -0 0 0 1 /end COMPU_METHOD
/begin COMPU_METHOD SAB_N_GRADPS10_S2_S3 "int = ((phys * 10) / 1) - (0) Grad/s" RAT_FUNC "%5.3" "Grad/s" COEFFS 0 10 -0 0 0 1 /end COMPU_METHOD
/begin COMPU_METHOD SAB_PROZENT_GRADP10MS10_S2_S3 "int = ((phys * 10) / 1) - (0) Grad/10ms" RAT_FUNC "%5.3" "Grad/10ms" COEFFS 0 10 -0 0 0 1 /end COMPU_METHOD
/begin COMPU_METHOD SAB_OM_YAWRATE_GRADPS100_S2_S3 "int = ((phys * 100) / 1) - (0) Grad/s" RAT_FUNC "%4.2" "Grad/s" COEFFS 0 100 -0 0 0 1 /end COMPU_METHOD
/begin COMPU_METHOD SAB_OM_YAWRATE_1GRADPS10_M126_S2_S3 "int = ((phys * 10) / 1) - (-126) Grad/s" RAT_FUNC "%4.2" "Grad/s" COEFFS 0 10 126 0 0 1 /end COMPU_METHOD
/begin COMPU_METHOD SAB_A_0024MPSS_M124_S2_S3 "int = ((phys * 1000) / 24) - (-124) m/s^2" RAT_FUNC "%5.3" "m/s^2" COEFFS 0 1000 2976 0 0 24 /end COMPU_METHOD
/begin COMPU_METHOD SAB_A_24MPSS1000_M2016_S2_S3 "int = ((phys * 1000) / 24) - (-84) m/s^2" RAT_FUNC "%5.3" "m/s^2" COEFFS 0 1000 2016 0 0 24 /end COMPU_METHOD
/begin COMPU_METHOD UMR___1_100_0_S6_S3 "int = ((phys * 100) / 1) - (0) [-]" RAT_FUNC "%4.2" "[-]" COEFFS 0 100 -0 0 0 1 /end COMPU_METHOD
/begin COMPU_METHOD UMR_NM__1_1_0_S6_S3 "int = ((phys * 1) / 1) - (0) [Nm]" RAT_FUNC "%2.0" "[Nm]" COEFFS 0 1 -0 0 0 1 /end COMPU_METHOD
/begin COMPU_METHOD UMR_NM__6_1_M145_S6_S3 "int = ((phys * 1) / 6) - (-145) [Nm]" RAT_FUNC "%2.0" "[Nm]" COEFFS 0 1 870 0 0 6 /end COMPU_METHOD
/begin COMPU_METHOD UMR_NM__8_1_M50_S6_S3 "int = ((phys * 1) / 8) - (-50) [Nm]" RAT_FUNC "%2.0" "[Nm]" COEFFS 0 1 400 0 0 8 /end COMPU_METHOD
/begin COMPU_METHOD UMR_U_MIN_32_1_0_S6_S3 "int = ((phys * 1) / 32) - (0) [U/min]" RAT_FUNC "%2.0" "[U/min]" COEFFS 0 1 -0 0 0 32 /end COMPU_METHOD
/begin COMPU_METHOD UMR_U_MINSEC_1_1_0_S6_S3 "int = ((phys * 1) / 1) - (0) [U/(min*s)]" RAT_FUNC "%2.0" "[U/(min*s)]" COEFFS 0 1 -0 0 0 1 /end COMPU_METHOD
/begin COMPU_METHOD UMR_MSEC__10_1_0_S6_S3 "int = ((phys * 1) / 10) - (0) [ms]" RAT_FUNC "%2.0" "[ms]" COEFFS 0 1 -0 0 0 10 /end COMPU_METHOD
/begin COMPU_METHOD UMR_MSEC__10_1_M128_S6_S3 "int = ((phys * 1) / 10) - (-128) [ms]" RAT_FUNC "%2.0" "[ms]" COEFFS 0 1 1280 0 0 10 /end COMPU_METHOD
/begin COMPU_METHOD UMR_GRADC__1_1_M48_S6_S3 "int = ((phys * 1) / 1) - (-48) [°C]" RAT_FUNC "%2.0" "[°C]" COEFFS 0 1 48 0 0 1 /end COMPU_METHOD
/begin COMPU_METHOD UMR_PROZENT__20_51_0_S6_S3 "int = ((phys * 51) / 20) - (0) [%]" RAT_FUNC "%6.4" "[%]" COEFFS 0 51 -0 0 0 20 /end COMPU_METHOD
/begin FUNCTION jMoeSasRSP264_Fktn "Applikationesgroessen Instanz jMoeSasRSP264"
 /begin DEF_CHARACTERISTIC KF_FMENACHPOSESP64 KF_FMESASMEHAUPTPOSESP64 KF_FMTMEHAUPTASP64 KF_MEHAUPTSP64 KF_MEHAUPTSP64_EL KF_MENACHSP64 KF_MENACHSP64_EL KF_TSYNMENACHASP64 KF_TSYNMENACHASP64_EL KF_TSYNNTKFMTMEHAUPTESP64 KF_TVMTNMOTMEHAUPTSP64 KL_FMENACHESP64 KL_FMEPOSNGABSP64 T_RAMEESP64 T_RAMEESP64_EL T_SYNMENACHESP64 T_SYNMENACHESP64_EL /end DEF_CHARACTERISTIC
/end FUNCTION
/begin FUNCTION jMoeSasRSP271_Fktn "Applikationesgroessen Instanz jMoeSasRSP271"
 /begin DEF_CHARACTERISTIC KF_FMENACHPOSESP71 KF_FMESASMEHAUPTPOSESP71 KF_FMTMEHAUPTASP71 KF_MEHAUPTSP71 KF_MENACHSP71 KF_TSYNMENACHASP71 KF_TSYNNTKFMTMEHAUPTESP71 KF_TVMTNMOTMEHAUPTSP71 KL_FMENACHESP71 KL_FMEPOSNGABSP71 T_RAMEESP71 T_SYNMENACHESP71 /end DEF_CHARACTERISTIC
/end FUNCTION
/begin FUNCTION jMoeSasRSP275_Fktn "Applikationesgroessen Instanz jMoeSasRSP275"
 /begin DEF_CHARACTERISTIC KF_FMENACHPOSESP75 KF_FMESASMEHAUPTPOSESP75 KF_FMTMEHAUPTASP75 KF_MEHAUPTSP75 KF_MEHAUPTSP75_EL KF_MENACHSP75 KF_MENACHSP75_EL KF_TSYNMENACHASP75 KF_TSYNMENACHASP75_EL KF_TSYNNTKFMTMEHAUPTESP75 KF_TVMTNMOTMEHAUPTSP75 KL_FMENACHESP75 KL_FMEPOSNGABSP75 T_RAMEESP75 T_RAMEESP75_EL T_SYNMENACHESP75 T_SYNMENACHESP75_EL /end DEF_CHARACTERISTIC
/end FUNCTION
/begin FUNCTION jMoeSasRSP282_Fktn "Applikationesgroessen Instanz jMoeSasRSP282"
 /begin DEF_CHARACTERISTIC KF_FMENACHPOSESP82 KF_FMESASMEHAUPTPOSESP82 KF_FMTMEHAUPTASP82 KF_MEHAUPTSP82 KF_MEHAUPTSP82_EL KF_MENACHSP82 KF_MENACHSP82_EL KF_TSYNMENACHASP82 KF_TSYNMENACHASP82_EL KF_TSYNNTKFMTMEHAUPTESP82 KF_TVMTNMOTMEHAUPTSP82 KL_FMENACHESP82 KL_FMEPOSNGABSP82 T_RAMEESP82 T_RAMEESP82_EL T_SYNMENACHESP82 T_SYNMENACHESP82_EL /end DEF_CHARACTERISTIC
/end FUNCTION
/begin FUNCTION jMoeSasRSP284_Fktn "Applikationesgroessen Instanz jMoeSasRSP284"
 /begin DEF_CHARACTERISTIC KF_FMENACHPOSESP84 KF_FMESASMEHAUPTPOSESP84 KF_FMTMEHAUPTASP84 KF_MEHAUPTSP84 KF_MEHAUPTSP84_EL KF_MENACHSP84 KF_MENACHSP84_EL KF_TSYNMENACHASP84 KF_TSYNMENACHASP84_EL KF_TSYNNTKFMTMEHAUPTESP84 KF_TVMTNMOTMEHAUPTSP84 KL_FMENACHESP84 KL_FMEPOSNGABSP84 T_RAMEESP84 T_RAMEESP84_EL T_SYNMENACHESP84 T_SYNMENACHESP84_EL /end DEF_CHARACTERISTIC
/end FUNCTION
/begin FUNCTION jMoeSasRSP286_Fktn "Applikationesgroessen Instanz jMoeSasRSP286"
 /begin DEF_CHARACTERISTIC KF_FMENACHPOSESP86 KF_FMESASMEHAUPTPOSESP86 KF_FMTMEHAUPTASP86 KF_MEHAUPTSP86 KF_MEHAUPTSP86_EL KF_MENACHSP86 KF_MENACHSP86_EL KF_TSYNMENACHASP86 KF_TSYNMENACHASP86_EL KF_TSYNNTKFMTMEHAUPTESP86 KF_TVMTNMOTMEHAUPTSP86 KL_FMENACHESP86 KL_FMEPOSNGABSP86 T_RAMEESP86 T_RAMEESP86_EL T_SYNMENACHESP86 T_SYNMENACHESP86_EL /end DEF_CHARACTERISTIC
/end FUNCTION
/begin FUNCTION jMoeSasRSP321_Fktn "Applikationesgroessen Instanz jMoeSasRSP321"
 /begin DEF_CHARACTERISTIC KF_FMENACHPOSESPORT21 KF_FMESASMEHAUPTPOSESPORT21 KF_FMTMEHAUPTASPORT21 KF_MEHAUPTSPORT21 KF_MENACHSPORT21 KF_TSYNMENACHASPORT21 KF_TSYNNTKFMTMEHAUPTESPORT21 KF_TVMTNMOTMEHAUPTSPORT21 KL_FMENACHESPORT21 KL_FMEPOSNGABSPORT21 T_RAMEESPORT21 T_SYNMENACHESPORT21 /end DEF_CHARACTERISTIC
/end FUNCTION
/begin FUNCTION jMoeSasRSP332_Fktn "Applikationesgroessen Instanz jMoeSasRSP332"
 /begin DEF_CHARACTERISTIC KF_FMENACHPOSESPORT32 KF_FMESASMEHAUPTPOSESPORT32 KF_FMTMEHAUPTASPORT32 KF_MEHAUPTSPORT32 KF_MENACHSPORT32 KF_TSYNMENACHASPORT32 KF_TSYNNTKFMTMEHAUPTESPORT32 KF_TVMTNMOTMEHAUPTSPORT32 KL_FMENACHESPORT32 KL_FMEPOSNGABSPORT32 T_RAMEESPORT32 T_SYNMENACHESPORT32 /end DEF_CHARACTERISTIC
/end FUNCTION
/begin FUNCTION jMoeSasRSP343_Fktn "Applikationesgroessen Instanz jMoeSasRSP343"
 /begin DEF_CHARACTERISTIC KF_FMENACHPOSESPORT43 KF_FMESASMEHAUPTPOSESPORT43 KF_FMTMEHAUPTASPORT43 KF_MEHAUPTSPORT43 KF_MENACHSPORT43 KF_TSYNMENACHASPORT43 KF_TSYNNTKFMTMEHAUPTESPORT43 KF_TVMTNMOTMEHAUPTSPORT43 KL_FMENACHESPORT43 KL_FMEPOSNGABSPORT43 T_RAMEESPORT43 T_SYNMENACHESPORT43 /end DEF_CHARACTERISTIC
/end FUNCTION
/begin FUNCTION jMoeSasRSP354_Fktn "Applikationesgroessen Instanz jMoeSasRSP354"
 /begin DEF_CHARACTERISTIC KF_FMENACHPOSESPORT54 KF_FMESASMEHAUPTPOSESPORT54 KF_FMTMEHAUPTASPORT54 KF_MEHAUPTSPORT54 KF_MENACHSPORT54 KF_TSYNMENACHASPORT54 KF_TSYNNTKFMTMEHAUPTESPORT54 KF_TVMTNMOTMEHAUPTSPORT54 KL_FMENACHESPORT54 KL_FMEPOSNGABSPORT54 T_RAMEESPORT54 T_SYNMENACHESPORT54 /end DEF_CHARACTERISTIC
/end FUNCTION
/begin FUNCTION jMoeSasRSP365_Fktn "Applikationesgroessen Instanz jMoeSasRSP365"
 /begin DEF_CHARACTERISTIC KF_FMENACHPOSESPORT65 KF_FMESASMEHAUPTPOSESPORT65 KF_FMTMEHAUPTASPORT65 KF_MEHAUPTSPORT65 KF_MENACHSPORT65 KF_TSYNMENACHASPORT65 KF_TSYNNTKFMTMEHAUPTESPORT65 KF_TVMTNMOTMEHAUPTSPORT65 KL_FMENACHESPORT65 KL_FMEPOSNGABSPORT65 T_RAMEESPORT65 T_SYNMENACHESPORT65 /end DEF_CHARACTERISTIC
/end FUNCTION
/begin FUNCTION jMoeSasRSP376_Fktn "Applikationesgroessen Instanz jMoeSasRSP376"
 /begin DEF_CHARACTERISTIC KF_FMENACHPOSESPORT76 KF_FMESASMEHAUPTPOSESPORT76 KF_FMTMEHAUPTASPORT76 KF_MEHAUPTSPORT76 KF_MENACHSPORT76 KF_TSYNMENACHASPORT76 KF_TSYNNTKFMTMEHAUPTESPORT76 KF_TVMTNMOTMEHAUPTSPORT76 KL_FMENACHESPORT76 KL_FMEPOSNGABSPORT76 T_RAMEESPORT76 T_SYNMENACHESPORT76 /end DEF_CHARACTERISTIC
/end FUNCTION
/begin FUNCTION jMoeSasRSP387_Fktn "Applikationesgroessen Instanz jMoeSasRSP387"
 /begin DEF_CHARACTERISTIC KF_FMENACHPOSESPORT87 KF_FMESASMEHAUPTPOSESPORT87 KF_FMTMEHAUPTASPORT87 KF_MEHAUPTSPORT87 KF_MENACHSPORT87 KF_TSYNMENACHASPORT87 KF_TSYNNTKFMTMEHAUPTESPORT87 KF_TVMTNMOTMEHAUPTSPORT87 KL_FMENACHESPORT87 KL_FMEPOSNGABSPORT87 T_RAMEESPORT87 T_SYNMENACHESPORT87 /end DEF_CHARACTERISTIC
/end FUNCTION
/begin FUNCTION jMoeSasRSP331_Fktn "Applikationesgroessen Instanz jMoeSasRSP331"
 /begin DEF_CHARACTERISTIC KF_FMENACHPOSESPORT31 KF_FMESASMEHAUPTPOSESPORT31 KF_FMTMEHAUPTASPORT31 KF_MEHAUPTSPORT31 KF_MENACHSPORT31 KF_TSYNMENACHASPORT31 KF_TSYNNTKFMTMEHAUPTESPORT31 KF_TVMTNMOTMEHAUPTSPORT31 KL_FMENACHESPORT31 KL_FMEPOSNGABSPORT31 T_RAMEESPORT31 T_SYNMENACHESPORT31 /end DEF_CHARACTERISTIC
/end FUNCTION
/begin FUNCTION jMoeSasRSP342_Fktn "Applikationesgroessen Instanz jMoeSasRSP342"
 /begin DEF_CHARACTERISTIC KF_FMENACHPOSESPORT42 KF_FMESASMEHAUPTPOSESPORT42 KF_FMTMEHAUPTASPORT42 KF_MEHAUPTSPORT42 KF_MENACHSPORT42 KF_TSYNMENACHASPORT42 KF_TSYNNTKFMTMEHAUPTESPORT42 KF_TVMTNMOTMEHAUPTSPORT42 KL_FMENACHESPORT42 KL_FMEPOSNGABSPORT42 T_RAMEESPORT42 T_SYNMENACHESPORT42 /end DEF_CHARACTERISTIC
/end FUNCTION
/begin FUNCTION jMoeSasRSP351_Fktn "Applikationesgroessen Instanz jMoeSasRSP351"
 /begin DEF_CHARACTERISTIC KF_FMENACHPOSESPORT51 KF_FMESASMEHAUPTPOSESPORT51 KF_FMTMEHAUPTASPORT51 KF_MEHAUPTSPORT51 KF_MENACHSPORT51 KF_TSYNMENACHASPORT51 KF_TSYNNTKFMTMEHAUPTESPORT51 KF_TVMTNMOTMEHAUPTSPORT51 KL_FMENACHESPORT51 KL_FMEPOSNGABSPORT51 T_RAMEESPORT51 T_SYNMENACHESPORT51 /end DEF_CHARACTERISTIC
/end FUNCTION
/begin FUNCTION jMoeSasRSP353_Fktn "Applikationesgroessen Instanz jMoeSasRSP353"
 /begin DEF_CHARACTERISTIC KF_FMENACHPOSESPORT53 KF_FMESASMEHAUPTPOSESPORT53 KF_FMTMEHAUPTASPORT53 KF_MEHAUPTSPORT53 KF_MENACHSPORT53 KF_TSYNMENACHASPORT53 KF_TSYNNTKFMTMEHAUPTESPORT53 KF_TVMTNMOTMEHAUPTSPORT53 KL_FMENACHESPORT53 KL_FMEPOSNGABSPORT53 T_RAMEESPORT53 T_SYNMENACHESPORT53 /end DEF_CHARACTERISTIC
/end FUNCTION
/begin FUNCTION jMoeSasRSP363_Fktn "Applikationesgroessen Instanz jMoeSasRSP363"
 /begin DEF_CHARACTERISTIC KF_FMENACHPOSESPORT63 KF_FMESASMEHAUPTPOSESPORT63 KF_FMTMEHAUPTASPORT63 KF_MEHAUPTSPORT63 KF_MENACHSPORT63 KF_TSYNMENACHASPORT63 KF_TSYNNTKFMTMEHAUPTESPORT63 KF_TVMTNMOTMEHAUPTSPORT63 KL_FMENACHESPORT63 KL_FMEPOSNGABSPORT63 T_RAMEESPORT63 T_SYNMENACHESPORT63 /end DEF_CHARACTERISTIC
/end FUNCTION
/begin FUNCTION jMoeSasRSP364_Fktn "Applikationesgroessen Instanz jMoeSasRSP364"
 /begin DEF_CHARACTERISTIC KF_FMENACHPOSESPORT64 KF_FMESASMEHAUPTPOSESPORT64 KF_FMTMEHAUPTASPORT64 KF_MEHAUPTSPORT64 KF_MENACHSPORT64 KF_TSYNMENACHASPORT64 KF_TSYNNTKFMTMEHAUPTESPORT64 KF_TVMTNMOTMEHAUPTSPORT64 KL_FMENACHESPORT64 KL_FMEPOSNGABSPORT64 T_RAMEESPORT64 T_SYNMENACHESPORT64 /end DEF_CHARACTERISTIC
/end FUNCTION
/begin FUNCTION jMoeSasRSP371_Fktn "Applikationesgroessen Instanz jMoeSasRSP371"
 /begin DEF_CHARACTERISTIC KF_FMENACHPOSESPORT71 KF_FMESASMEHAUPTPOSESPORT71 KF_FMTMEHAUPTASPORT71 KF_MEHAUPTSPORT71 KF_MENACHSPORT71 KF_TSYNMENACHASPORT71 KF_TSYNNTKFMTMEHAUPTESPORT71 KF_TVMTNMOTMEHAUPTSPORT71 KL_FMENACHESPORT71 KL_FMEPOSNGABSPORT71 T_RAMEESPORT71 T_SYNMENACHESPORT71 /end DEF_CHARACTERISTIC
/end FUNCTION
/begin FUNCTION jMoeSasRSP375_Fktn "Applikationesgroessen Instanz jMoeSasRSP375"
 /begin DEF_CHARACTERISTIC KF_FMENACHPOSESPORT75 KF_FMESASMEHAUPTPOSESPORT75 KF_FMTMEHAUPTASPORT75 KF_MEHAUPTSPORT75 KF_MENACHSPORT75 KF_TSYNMENACHASPORT75 KF_TSYNNTKFMTMEHAUPTESPORT75 KF_TVMTNMOTMEHAUPTSPORT75 KL_FMENACHESPORT75 KL_FMEPOSNGABSPORT75 T_RAMEESPORT75 T_SYNMENACHESPORT75 /end DEF_CHARACTERISTIC
/end FUNCTION
/begin FUNCTION jMoeSasRSP382_Fktn "Applikationesgroessen Instanz jMoeSasRSP382"
 /begin DEF_CHARACTERISTIC KF_FMENACHPOSESPORT82 KF_FMESASMEHAUPTPOSESPORT82 KF_FMTMEHAUPTASPORT82 KF_MEHAUPTSPORT82 KF_MENACHSPORT82 KF_TSYNMENACHASPORT82 KF_TSYNNTKFMTMEHAUPTESPORT82 KF_TVMTNMOTMEHAUPTSPORT82 KL_FMENACHESPORT82 KL_FMEPOSNGABSPORT82 T_RAMEESPORT82 T_SYNMENACHESPORT82 /end DEF_CHARACTERISTIC
/end FUNCTION
/begin FUNCTION jMoeSasRSP384_Fktn "Applikationesgroessen Instanz jMoeSasRSP384"
 /begin DEF_CHARACTERISTIC KF_FMENACHPOSESPORT84 KF_FMESASMEHAUPTPOSESPORT84 KF_FMTMEHAUPTASPORT84 KF_MEHAUPTSPORT84 KF_MENACHSPORT84 KF_TSYNMENACHASPORT84 KF_TSYNNTKFMTMEHAUPTESPORT84 KF_TVMTNMOTMEHAUPTSPORT84 KL_FMENACHESPORT84 KL_FMEPOSNGABSPORT84 T_RAMEESPORT84 T_SYNMENACHESPORT84 /end DEF_CHARACTERISTIC
/end FUNCTION
/begin FUNCTION jMoeSasRSP386_Fktn "Applikationesgroessen Instanz jMoeSasRSP386"
 /begin DEF_CHARACTERISTIC KF_FMENACHPOSESPORT86 KF_FMESASMEHAUPTPOSESPORT86 KF_FMTMEHAUPTASPORT86 KF_MEHAUPTSPORT86 KF_MENACHSPORT86 KF_TSYNMENACHASPORT86 KF_TSYNNTKFMTMEHAUPTESPORT86 KF_TVMTNMOTMEHAUPTSPORT86 KL_FMENACHESPORT86 KL_FMEPOSNGABSPORT86 T_RAMEESPORT86 T_SYNMENACHESPORT86 /end DEF_CHARACTERISTIC
/end FUNCTION
/begin FUNCTION dMoeSasEHS_Fktn "Applikationesgroessen der Komponente dMoeSasEHS"
 /begin SUB_FUNCTION jMoeSasEHS12_Fktn jMoeSasEHS23_Fktn jMoeSasEHS34_Fktn jMoeSasEHS45_Fktn jMoeSasEHS56_Fktn jMoeSasEHS67_Fktn jMoeSasEHS78_Fktn /end SUB_FUNCTION
/end FUNCTION
/begin FUNCTION jMoeSasEHS12_Fktn "Applikationesgroessen Instanz jMoeSasEHS12" /begin DEF_CHARACTERISTIC F_MEKLASS12 /end DEF_CHARACTERISTIC /end FUNCTION
/begin FUNCTION jMoeSasEHS23_Fktn "Applikationesgroessen Instanz jMoeSasEHS23" /begin DEF_CHARACTERISTIC F_MEKLASS23 /end DEF_CHARACTERISTIC /end FUNCTION
/begin FUNCTION jMoeSasEHS34_Fktn "Applikationesgroessen Instanz jMoeSasEHS34" /begin DEF_CHARACTERISTIC F_MEKLASS34 /end DEF_CHARACTERISTIC /end FUNCTION
/begin FUNCTION jMoeSasEHS45_Fktn "Applikationesgroessen Instanz jMoeSasEHS45" /begin DEF_CHARACTERISTIC F_MEKLASS45 /end DEF_CHARACTERISTIC /end FUNCTION
/begin FUNCTION jMoeSasEHS56_Fktn "Applikationesgroessen Instanz jMoeSasEHS56" /begin DEF_CHARACTERISTIC F_MEKLASS56 /end DEF_CHARACTERISTIC /end FUNCTION
/begin FUNCTION jMoeSasEHS67_Fktn "Applikationesgroessen Instanz jMoeSasEHS67" /begin DEF_CHARACTERISTIC F_MEKLASS67 /end DEF_CHARACTERISTIC /end FUNCTION
/begin FUNCTION jMoeSasEHS78_Fktn "Applikationesgroessen Instanz jMoeSasEHS78" /begin DEF_CHARACTERISTIC F_MEKLASS78 /end DEF_CHARACTERISTIC /end FUNCTION
/begin FUNCTION dMoeSasRSS_Fktn "Applikationesgroessen der Komponente dMoeSasRSS"
 /begin SUB_FUNCTION jMoeSasRSS21_Fktn jMoeSasRSS32_Fktn jMoeSasRSS43_Fktn jMoeSasRSS54_Fktn jMoeSasRSS65_Fktn jMoeSasRSS76_Fktn jMoeSasRSS87_Fktn jMoeSasRSS31_Fktn jMoeSasRSS42_Fktn jMoeSasRSS51_Fktn jMoeSasRSS53_Fktn jMoeSasRSS63_Fktn jMoeSasRSS64_Fktn jMoeSasRSS71_Fktn jMoeSasRSS75_Fktn jMoeSasRSS82_Fktn jMoeSasRSS84_Fktn jMoeSasRSS86_Fktn /end SUB_FUNCTION
/end FUNCTION
/begin FUNCTION jMoeSasRSS21_Fktn "Applikationesgroessen Instanz jMoeSasRSS21"
 /begin DEF_CHARACTERISTIC KF_MEKREDCMMT21 KF_MEKREDCMMT21_EL KL_MEKPOSCM21 T_SYNMERUECKFILTERE21 /end DEF_CHARACTERISTIC
/end FUNCTION
/begin FUNCTION jMoeSasRSS32_Fktn "Applikationesgroessen Instanz jMoeSasRSS32"
 /begin DEF_CHARACTERISTIC KF_MEKREDCMMT32 KF_MEKREDCMMT32_EL KL_MEKPOSCM32 T_SYNMERUECKFILTERE32 /end DEF_CHARACTERISTIC
/end FUNCTION
/begin FUNCTION jMoeSasRSS43_Fktn "Applikationesgroessen Instanz jMoeSasRSS43"
 /begin DEF_CHARACTERISTIC KF_MEKREDCMMT43 KF_MEKREDCMMT43_EL KL_MEKPOSCM43 T_SYNMERUECKFILTERE43 /end DEF_CHARACTERISTIC
/end FUNCTION
/begin FUNCTION jMoeSasRSS54_Fktn "Applikationesgroessen Instanz jMoeSasRSS54"
 /begin DEF_CHARACTERISTIC KF_MEKREDCMMT54 KF_MEKREDCMMT54_EL KL_MEKPOSCM54 T_SYNMERUECKFILTERE54 /end DEF_CHARACTERISTIC
/end FUNCTION
/begin FUNCTION jMoeSasRSS65_Fktn "Applikationesgroessen Instanz jMoeSasRSS65"
 /begin DEF_CHARACTERISTIC KF_MEKREDCMMT65 KF_MEKREDCMMT65_EL KL_MEKPOSCM65 T_SYNMERUECKFILTERE65 /end DEF_CHARACTERISTIC
/end FUNCTION
/begin FUNCTION jMoeSasRSS76_Fktn "Applikationesgroessen Instanz jMoeSasRSS76"
 /begin DEF_CHARACTERISTIC KF_MEKREDCMMT76 KF_MEKREDCMMT76_EL KL_MEKPOSCM76 T_SYNMERUECKFILTERE76 /end DEF_CHARACTERISTIC
/end FUNCTION
/begin FUNCTION jMoeSasRSS87_Fktn "Applikationesgroessen Instanz jMoeSasRSS87"
 /begin DEF_CHARACTERISTIC KF_MEKREDCMMT87 KF_MEKREDCMMT87_EL KL_MEKPOSCM87 T_SYNMERUECKFILTERE87 /end DEF_CHARACTERISTIC
/end FUNCTION
/begin FUNCTION jMoeSasRSS31_Fktn "Applikationesgroessen Instanz jMoeSasRSS31"
 /begin DEF_CHARACTERISTIC KF_MEKREDCMMTSP31 KF_MEKREDCMMTSP31_EL KL_MEKPOSCMSP31 T_SYNMERUECKFILTERESP31 /end DEF_CHARACTERISTIC
/end FUNCTION
/begin FUNCTION jMoeSasRSS42_Fktn "Applikationesgroessen Instanz jMoeSasRSS42"
 /begin DEF_CHARACTERISTIC KF_MEKREDCMMTSP42 KF_MEKREDCMMTSP42_EL KL_MEKPOSCMSP42 T_SYNMERUECKFILTERESP42 /end DEF_CHARACTERISTIC
/end FUNCTION
/begin FUNCTION jMoeSasRSS51_Fktn "Applikationesgroessen Instanz jMoeSasRSS51"
 /begin DEF_CHARACTERISTIC KF_MEKREDCMMTSP51 KF_MEKREDCMMTSP51_EL KL_MEKPOSCMSP51 T_SYNMERUECKFILTERESP51 /end DEF_CHARACTERISTIC
/end FUNCTION
/begin FUNCTION jMoeSasRSS53_Fktn "Applikationesgroessen Instanz jMoeSasRSS53"
 /begin DEF_CHARACTERISTIC KF_MEKREDCMMTSP53 KF_MEKREDCMMTSP53_EL KL_MEKPOSCMSP53 T_SYNMERUECKFILTERESP53 /end DEF_CHARACTERISTIC
/end FUNCTION
/begin FUNCTION jMoeSasRSS63_Fktn "Applikationesgroessen Instanz jMoeSasRSS63"
 /begin DEF_CHARACTERISTIC KF_MEKREDCMMTSP63 KF_MEKREDCMMTSP63_EL KL_MEKPOSCMSP63 T_SYNMERUECKFILTERESP63 /end DEF_CHARACTERISTIC
/end FUNCTION
/begin FUNCTION jMoeSasRSS64_Fktn "Applikationesgroessen Instanz jMoeSasRSS64"
 /begin DEF_CHARACTERISTIC KF_MEKREDCMMTSP64 KF_MEKREDCMMTSP64_EL KL_MEKPOSCMSP64 T_SYNMERUECKFILTERESP64 /end DEF_CHARACTERISTIC
/end FUNCTION
/begin FUNCTION jMoeSasRSS71_Fktn "Applikationesgroessen Instanz jMoeSasRSS71"
 /begin DEF_CHARACTERISTIC KF_MEKREDCMMTSP71 KF_MEKREDCMMTSP71_EL KL_MEKPOSCMSP71 T_SYNMERUECKFILTERESP71 /end DEF_CHARACTERISTIC
/end FUNCTION
/begin FUNCTION jMoeSasRSS75_Fktn "Applikationesgroessen Instanz jMoeSasRSS75"
 /begin DEF_CHARACTERISTIC KF_MEKREDCMMTSP75 KF_MEKREDCMMTSP75_EL KL_MEKPOSCMSP75 T_SYNMERUECKFILTERESP75 /end DEF_CHARACTERISTIC
/end FUNCTION
/begin FUNCTION jMoeSasRSS82_Fktn "Applikationesgroessen Instanz jMoeSasRSS82"
 /begin DEF_CHARACTERISTIC KF_MEKREDCMMTSP82 KF_MEKREDCMMTSP82_EL KL_MEKPOSCMSP82 T_SYNMERUECKFILTERESP82 /end DEF_CHARACTERISTIC
/end FUNCTION
/begin FUNCTION jMoeSasRSS84_Fktn "Applikationesgroessen Instanz jMoeSasRSS84"
 /begin DEF_CHARACTERISTIC KF_MEKREDCMMTSP84 KF_MEKREDCMMTSP84_EL KL_MEKPOSCMSP84 T_SYNMERUECKFILTERESP84 /end DEF_CHARACTERISTIC
/end FUNCTION
/begin FUNCTION jMoeSasRSS86_Fktn "Applikationesgroessen Instanz jMoeSasRSS86"
 /begin DEF_CHARACTERISTIC KF_MEKREDCMMTSP86 KF_MEKREDCMMTSP86_EL KL_MEKPOSCMSP86 T_SYNMERUECKFILTERESP86 /end DEF_CHARACTERISTIC
/end FUNCTION
/begin FUNCTION dMoeSasERS_Fktn "Applikationesgroessen der Komponente dMoeSasERS"
 /begin SUB_FUNCTION jMoeSasERS21_Fktn jMoeSasERS32_Fktn jMoeSasERS43_Fktn jMoeSasERS54_Fktn jMoeSasERS65_Fktn jMoeSasERS76_Fktn jMoeSasERS87_Fktn /end SUB_FUNCTION
/end FUNCTION
/begin FUNCTION jMoeSasERS21_Fktn "Applikationesgroessen Instanz jMoeSasERS21"
 /begin DEF_CHARACTERISTIC KF_MENACHFOLNACHMRS21 KF_MENACHFOLNACHMRS21_EL KF_MENACHFOLNACHMRSSP21 KF_MENACHFOLNACHMRSSPORT21 KF_MENACHFOLNACHRS21 KF_MENACHFOLNACHRS21_EL KF_MENACHFOLNACHRSSP21 KF_MENACHFOLNACHRSSPORT21 /end DEF_CHARACTERISTIC
/end FUNCTION
/begin FUNCTION jMoeSasERS32_Fktn "Applikationesgroessen Instanz jMoeSasERS32"
 /begin DEF_CHARACTERISTIC KF_MENACHFOLNACHMRS32 KF_MENACHFOLNACHMRS32_EL KF_MENACHFOLNACHMRSSP32 KF_MENACHFOLNACHMRSSPORT32 KF_MENACHFOLNACHRS32 KF_MENACHFOLNACHRS32_EL KF_MENACHFOLNACHRSSP32 KF_MENACHFOLNACHRSSPORT32 /end DEF_CHARACTERISTIC
/end FUNCTION
/begin FUNCTION jMoeSasERS43_Fktn "Applikationesgroessen Instanz jMoeSasERS43"
 /begin DEF_CHARACTERISTIC KF_MENACHFOLNACHMRS43 KF_MENACHFOLNACHMRS43_EL KF_MENACHFOLNACHMRSSP43 KF_MENACHFOLNACHMRSSPORT43 KF_MENACHFOLNACHRS43 KF_MENACHFOLNACHRS43_EL KF_MENACHFOLNACHRSSP43 KF_MENACHFOLNACHRSSPORT43 /end DEF_CHARACTERISTIC
/end FUNCTION
/begin FUNCTION jMoeSasERS54_Fktn "Applikationesgroessen Instanz jMoeSasERS54"
 /begin DEF_CHARACTERISTIC KF_MENACHFOLNACHMRS54 KF_MENACHFOLNACHMRS54_EL KF_MENACHFOLNACHMRSSP54 KF_MENACHFOLNACHMRSSPORT54 KF_MENACHFOLNACHRS54 KF_MENACHFOLNACHRS54_EL KF_MENACHFOLNACHRSSP54 KF_MENACHFOLNACHRSSPORT54 /end DEF_CHARACTERISTIC
/end FUNCTION
/begin FUNCTION jMoeSasERS65_Fktn "Applikationesgroessen Instanz jMoeSasERS65"
 /begin DEF_CHARACTERISTIC KF_MENACHFOLNACHMRS65 KF_MENACHFOLNACHMRS65_EL KF_MENACHFOLNACHMRSSP65 KF_MENACHFOLNACHMRSSPORT65 KF_MENACHFOLNACHRS65 KF_MENACHFOLNACHRS65_EL KF_MENACHFOLNACHRSSP65 KF_MENACHFOLNACHRSSPORT65 /end DEF_CHARACTERISTIC
/end FUNCTION
/begin FUNCTION jMoeSasERS76_Fktn "Applikationesgroessen Instanz jMoeSasERS76"
 /begin DEF_CHARACTERISTIC KF_MENACHFOLNACHMRS76 KF_MENACHFOLNACHMRS76_EL KF_MENACHFOLNACHMRSSP76 KF_MENACHFOLNACHMRSSPORT76 KF_MENACHFOLNACHRS76 KF_MENACHFOLNACHRS76_EL KF_MENACHFOLNACHRSSP76 KF_MENACHFOLNACHRSSPORT76 /end DEF_CHARACTERISTIC
/end FUNCTION
/begin FUNCTION jMoeSasERS87_Fktn "Applikationesgroessen Instanz jMoeSasERS87"
 /begin DEF_CHARACTERISTIC KF_MENACHFOLNACHMRS87 KF_MENACHFOLNACHMRS87_EL KF_MENACHFOLNACHMRSSP87 KF_MENACHFOLNACHMRSSPORT87 KF_MENACHFOLNACHRS87 KF_MENACHFOLNACHRS87_EL KF_MENACHFOLNACHRSSP87 KF_MENACHFOLNACHRSSPORT87 /end DEF_CHARACTERISTIC
/end FUNCTION
/begin FUNCTION dMoeSasAl_Fktn "Applikationesgroessen der Komponente dMoeSasAl" /begin SUB_FUNCTION jMoeSasAl_Fktn /end SUB_FUNCTION /end FUNCTION
/begin RECORD_LAYOUT kw_ui8_S6_S3 FNC_VALUES 1 UBYTE COLUMN_DIR DIRECT /end RECORD_LAYOUT
/begin RECORD_LAYOUT kw_si16_S6_S3 FNC_VALUES 1 SWORD COLUMN_DIR DIRECT /end RECORD_LAYOUT
/begin RECORD_LAYOUT kl_ui8_S6_S3 FNC_VALUES 3 UBYTE COLUMN_DIR DIRECT AXIS_PTS_X 2 UBYTE INDEX_INCR DIRECT NO_AXIS_PTS_X 1 ULONG /end RECORD_LAYOUT
/begin RECORD_LAYOUT kl_si16_S6_S3 FNC_VALUES 3 SWORD COLUMN_DIR DIRECT AXIS_PTS_X 2 SWORD INDEX_INCR DIRECT NO_AXIS_PTS_X 1 ULONG /end RECORD_LAYOUT
/begin RECORD_LAYOUT kf_ui8_S6_S3 FNC_VALUES 5 UBYTE ROW_DIR DIRECT AXIS_PTS_X 3 UBYTE INDEX_INCR DIRECT AXIS_PTS_Y 4 UBYTE INDEX_INCR DIRECT NO_AXIS_PTS_X 1 ULONG NO_AXIS_PTS_Y 2 ULONG /end RECORD_LAYOUT
/begin RECORD_LAYOUT kf_si16_S6_S3 FNC_VALUES 5 SWORD ROW_DIR DIRECT AXIS_PTS_X 3 SWORD INDEX_INCR DIRECT AXIS_PTS_Y 4 SWORD INDEX_INCR DIRECT NO_AXIS_PTS_X 1 ULONG NO_AXIS_PTS_Y 2 ULONG /end RECORD_LAYOUT
/end MODULE
/end PROJECT
