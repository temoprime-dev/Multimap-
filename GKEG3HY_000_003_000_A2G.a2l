ASAP2_VERSION 1 51
/begin PROJECT _929_929 "Gen2_BMW_System_Supplier_Lib"
/begin HEADER "" VERSION "C_03_03" PROJECT_NO _929_929 /end HEADER
/begin MODULE DIM ""
/begin MOD_COMMON "" BYTE_ORDER MSB_FIRST ALIGNMENT_BYTE 1 ALIGNMENT_WORD 2 ALIGNMENT_LONG 4 ALIGNMENT_FLOAT32_IEEE 4 /end MOD_COMMON
/begin CHARACTERISTIC DSM_ERR_bClrIni "F3500: Switch to clear fault buffer in initialization (TRUE: clear buffer) (no SERAP)" VALUE 0x2019C9 AblGLKWub_S1 1 B_TRUE_S1 0 1 FORMAT "%13.11" /end CHARACTERISTIC
/begin CHARACTERISTIC GmoHot_qtChp1Min_C "F3010: Minimum quality for CG temperature (no SERAP)" VALUE 0x201A41 AblGLKWub_S1 8 Q_SIG_S1 0 8 FORMAT "%13.11" /end CHARACTERISTIC
/begin CHARACTERISTIC GmoHot_qtChp2Min_C "F3010: Minimum quality for LM7x temperature (no SERAP)" VALUE 0x201A42 AblGLKWub_S1 8 Q_SIG_S1 0 8 FORMAT "%13.11" /end CHARACTERISTIC
/begin CHARACTERISTIC GmoHot_tBattDepSdnTempINI_C "F3010: Battery-voltage dependent Shutdown temperature in INI" CURVE 0x201792 AblGLKLsw_S1 255 T0_0625_S1 -40 215 FORMAT "%8.4"
 /begin AXIS_DESCR STD_AXIS GmoHot_uBatt U0_001_S1 4 0 32 DEPOSIT ABSOLUTE FORMAT "%8.5" /end AXIS_DESCR
/end CHARACTERISTIC
/begin CHARACTERISTIC GmoHot_tBattDepSdnTemp_C "F3010: Battery-voltage dependent Shutdown temperature" CURVE 0x2017A4 AblGLKLsw_S1 255 T0_0625_S1 -40 215 FORMAT "%8.4"
 /begin AXIS_DESCR STD_AXIS GmoHot_uBatt U0_001_S1 4 0 32 DEPOSIT ABSOLUTE FORMAT "%8.5" /end AXIS_DESCR
/end CHARACTERISTIC
/begin CHARACTERISTIC GmoHot_tChp1SensTolc_C "F3010: CG sensor tolerance" VALUE 0x2017B6 AblGLKWsw_S1 40 T0_0625_S1 -20 20 FORMAT "%8.5" /end CHARACTERISTIC
/begin CHARACTERISTIC GmoHot_tChp2SensTolc_C "F3010: LM7x sensor tolerance" VALUE 0x2017B8 AblGLKWsw_S1 40 T0_0625_S1 -20 20 FORMAT "%8.5" /end CHARACTERISTIC
/begin CHARACTERISTIC GmoHot_tiGenDlyDSM_C "F3010: Delay time for DSM reaction" VALUE 0x2017BA AblGLKWuw_S1 100 TI1_M_CYCLE_S1 0 100 FORMAT "%8.4" /end CHARACTERISTIC
/begin CHARACTERISTIC GmoHot_tiGenDlyEE_C "F3010: Delay time for EEPROM update" VALUE 0x2017BC AblGLKWuw_S1 20000 TI1_M_CYCLE_S1 0 20000 FORMAT "%8.2" /end CHARACTERISTIC
/begin CHARACTERISTIC GmoHot_tiGenDlyHot_C "F3010: Filter time for hot state" VALUE 0x2017BE AblGLKWuw_S1 5000 TI1_M_CYCLE_S1 0 5000 FORMAT "%8.3" /end CHARACTERISTIC
/begin CHARACTERISTIC GmoHot_tiGenDlyInit_C "F3010: Delay time for sensor initialization" VALUE 0x2017C0 AblGLKWuw_S1 5000 TI1_M_CYCLE_S1 0 5000 FORMAT "%8.3" /end CHARACTERISTIC
/begin CHARACTERISTIC GmoHot_tM3DepSdnTemp_C "F3010: M3-voltage dependent shutdown temperature" CURVE 0x2017C2 AblGLKLsw_S1 255 T0_0625_S1 -40 215 FORMAT "%8.4"
 /begin AXIS_DESCR STD_AXIS GmoHot_uM3 U0_001_S1 3 0 32 DEPOSIT ABSOLUTE FORMAT "%8.5" /end AXIS_DESCR
/end CHARACTERISTIC
/begin CHARACTERISTIC GmoHot_uUpLimHotCond_C "F3010: Upper limit for overvoltage detection in hot mode" VALUE 0x2017D0 AblGLKWuw_S1 32 U0_001_S1 0 32 FORMAT "%8.5" /end CHARACTERISTIC
/begin CHARACTERISTIC MCorAdc_ctErrDb_C "F6020: Error debounce time (multiples of SAF task invokations) (no SERAP)" VALUE 0x201A34 AblGLKWub_S1 2 X1_S1 1 3 FORMAT "%5.3" /end CHARACTERISTIC
/begin CHARACTERISTIC MCorAdc_uDiagDiffMax_C "F6020: Max. voltage difference of the Diag. ch. whereas no error will report to SAF (no SERAP)" VALUE 0x20176E AblGLKWuw_S1 60 X1_S1 0 60 FORMAT "%8.5" /end CHARACTERISTIC
/begin CHARACTERISTIC MCorAdc_uM3Min_C "F6020: Threshold voltage of M3 under which MCor diagnostic is disabled for old cg124 (no SERAP)" VALUE 0x201770 AblGLKWuw_S1 0.9 U0_001_S1 5.6 6.5 FORMAT "%8.6" /end CHARACTERISTIC
/begin CHARACTERISTIC MCorAdc_uVasicMax_C "F6020: Upper threshold voltage whereas an error will report to SAF when Vasic exceeds this voltage (no SERAP)" VALUE 0x201772 AblGLKWuw_S1 0.7 U0_001_S1 5.3 6 FORMAT "%8.6" /end CHARACTERISTIC
/begin CHARACTERISTIC MCorAdc_uVasicMin_C "F6020: Lower threshold voltage whereas an error will report to SAF when Vasic remain under this voltage (no SERAP)" VALUE 0x201774 AblGLKWuw_S1 0.2 U0_001_S1 4.5 4.7 FORMAT "%8.6" /end CHARACTERISTIC
/begin CHARACTERISTIC MCorAdc_uVdd3DiffMax_C "F6020: Max. Difference voltage whereas an error will report to SAF when difference voltage between VDD3 and VDD3 alternative exceeds this value (no SERAP)" VALUE 0x201776 AblGLKWuw_S1 0.39 U0_001_S1 0.01 0.4 FORMAT "%9.7" /end CHARACTERISTIC
/begin CHARACTERISTIC MCorAdc_uVdd3Max_C "F6020: Upper threshold voltage whereas an error will report to SAF when Vdd3 exceeds this voltage (no SERAP)" VALUE 0x201778 AblGLKWuw_S1 0.37 U0_001_S1 3.43 3.8 FORMAT "%8.6" /end CHARACTERISTIC
/begin CHARACTERISTIC MCorAdc_uVdd3Min_C "F6020: Min. voltage of VDD3 whereas no error will report to SAF (no SERAP)" VALUE 0x20177A AblGLKWuw_S1 0.32 U0_001_S1 2.8 3.12 FORMAT "%8.6" /end CHARACTERISTIC
/begin CHARACTERISTIC MCorMmm_ctErrDbEcc_C "F6040: Error debounce time for the MCOR ECC error (multiple of main task time) (no SERAP)" VALUE 0x201A35 AblGLKWub_S1 2 X1_S1 1 3 FORMAT "%5.3" /end CHARACTERISTIC
/begin CHARACTERISTIC MCorMmm_ctErrDbReg_C "F6040: Error debounce time for the MCOR REG error (multiple of main task time) (no SERAP)" VALUE 0x201A36 AblGLKWub_S1 2 X1_S1 1 3 FORMAT "%5.3" /end CHARACTERISTIC
/begin CHARACTERISTIC MCorSpi_ctErrDb_C "F6030: Error debounce time for the MCOR SPI error (multiple of main task time) (no SERAP)" VALUE 0x201A37 AblGLKWub_S1 2 X1_S1 1 3 FORMAT "%5.3" /end CHARACTERISTIC
/begin CHARACTERISTIC MCor_swtFaultEntryReq_C "F6010: Enable/disable Core Monitor fault reports to error handler (bitcoded, TRUE=report disabled, FALSE=report enabled) (no SERAP)" VALUE 0x201A33 AblGLKWub_S1 255 X1_S1 0 255 FORMAT "%5.1" /end CHARACTERISTIC
/begin CHARACTERISTIC OutMCrntFdbk_facCor_C[0] "F2864: Correction factor per actuator dependent on oil temperature" CURVE 0x20101C AblGLKLsw_S1 20 R0_1_P_S1 90 110 FORMAT "%8.4"
 /begin AXIS_DESCR STD_AXIS OutMRstn_tAtfRef T0_0625_S1 2 -40 215 DEPOSIT ABSOLUTE FORMAT "%8.4" /end AXIS_DESCR
/end CHARACTERISTIC
/begin CHARACTERISTIC OutMCrntFdbk_facCor_C[1] "F2864: Correction factor per actuator dependent on oil temperature" CURVE 0x201026 AblGLKLsw_S1 20 R0_1_P_S1 90 110 FORMAT "%8.4"
 /begin AXIS_DESCR STD_AXIS OutMRstn_tAtfRef T0_0625_S1 2 -40 215 DEPOSIT ABSOLUTE FORMAT "%8.4" /end AXIS_DESCR
/end CHARACTERISTIC
/begin CHARACTERISTIC OutMCrntFdbk_facCor_C[2] "F2864: Correction factor per actuator dependent on oil temperature" CURVE 0x201030 AblGLKLsw_S1 20 R0_1_P_S1 90 110 FORMAT "%8.4"
 /begin AXIS_DESCR STD_AXIS OutMRstn_tAtfRef T0_0625_S1 2 -40 215 DEPOSIT ABSOLUTE FORMAT "%8.4" /end AXIS_DESCR
/end CHARACTERISTIC
/begin CHARACTERISTIC OutMCrntFdbk_facCor_C[3] "F2864: Correction factor per actuator dependent on oil temperature" CURVE 0x20103A AblGLKLsw_S1 20 R0_1_P_S1 90 110 FORMAT "%8.4"
 /begin AXIS_DESCR STD_AXIS OutMRstn_tAtfRef T0_0625_S1 2 -40 215 DEPOSIT ABSOLUTE FORMAT "%8.4" /end AXIS_DESCR
/end CHARACTERISTIC
/begin CHARACTERISTIC OutMCrntFdbk_facCor_C[4] "F2864: Correction factor per actuator dependent on oil temperature" CURVE 0x201044 AblGLKLsw_S1 20 R0_1_P_S1 90 110 FORMAT "%8.4"
 /begin AXIS_DESCR STD_AXIS OutMRstn_tAtfRef T0_0625_S1 2 -40 215 DEPOSIT ABSOLUTE FORMAT "%8.4" /end AXIS_DESCR
/end CHARACTERISTIC
/begin CHARACTERISTIC OutMCrntFdbk_facCor_C[5] "F2864: Correction factor per actuator dependent on oil temperature" CURVE 0x20104E AblGLKLsw_S1 20 R0_1_P_S1 90 110 FORMAT "%8.4"
 /begin AXIS_DESCR STD_AXIS OutMRstn_tAtfRef T0_0625_S1 2 -40 215 DEPOSIT ABSOLUTE FORMAT "%8.4" /end AXIS_DESCR
/end CHARACTERISTIC
/begin CHARACTERISTIC OutMCrntFdbk_facCor_C[6] "F2864: Correction factor per actuator dependent on oil temperature" CURVE 0x201058 AblGLKLsw_S1 20 R0_1_P_S1 90 110 FORMAT "%8.4"
 /begin AXIS_DESCR STD_AXIS OutMRstn_tAtfRef T0_0625_S1 2 -40 215 DEPOSIT ABSOLUTE FORMAT "%8.4" /end AXIS_DESCR
/end CHARACTERISTIC
/begin CHARACTERISTIC OutMCrntFdbk_facCor_C[7] "F2864: Correction factor per actuator dependent on oil temperature" CURVE 0x201062 AblGLKLsw_S1 20 R0_1_P_S1 90 110 FORMAT "%8.4"
 /begin AXIS_DESCR STD_AXIS OutMRstn_tAtfRef T0_0625_S1 2 -40 215 DEPOSIT ABSOLUTE FORMAT "%8.4" /end AXIS_DESCR
/end CHARACTERISTIC
/begin CHARACTERISTIC OutMCrntFdbk_facCor_C[8] "F2864: Correction factor per actuator dependent on oil temperature" CURVE 0x20106C AblGLKLsw_S1 20 R0_1_P_S1 90 110 FORMAT "%8.4"
 /begin AXIS_DESCR STD_AXIS OutMRstn_tAtfRef T0_0625_S1 2 -40 215 DEPOSIT ABSOLUTE FORMAT "%8.4" /end AXIS_DESCR
/end CHARACTERISTIC
/begin CHARACTERISTIC OutMCrntFdbk_facCor_C[9] "F2864: Correction factor per actuator dependent on oil temperature" CURVE 0x201076 AblGLKLsw_S1 20 R0_1_P_S1 90 110 FORMAT "%8.4"
 /begin AXIS_DESCR STD_AXIS OutMRstn_tAtfRef T0_0625_S1 2 -40 215 DEPOSIT ABSOLUTE FORMAT "%8.4" /end AXIS_DESCR
/end CHARACTERISTIC
/begin CHARACTERISTIC OutMCrntFdbk_uDio_C[0] "F2864: Forward voltage of freewheeling diode dependent on chip temperature" CURVE 0x201080 AblGLKLsw_S1 0.7 U0_001_S1 0.3 1 FORMAT "%8.6"
 /begin AXIS_DESCR STD_AXIS OutMRstn_tChpRef T0_0625_S1 4 -40 215 DEPOSIT ABSOLUTE FORMAT "%8.4" /end AXIS_DESCR
/end CHARACTERISTIC
/begin CHARACTERISTIC OutMCrntFdbk_uDio_C[1] "F2864: Forward voltage of freewheeling diode dependent on chip temperature" CURVE 0x201092 AblGLKLsw_S1 0.7 U0_001_S1 0.3 1 FORMAT "%8.6"
 /begin AXIS_DESCR STD_AXIS OutMRstn_tChpRef T0_0625_S1 4 -40 215 DEPOSIT ABSOLUTE FORMAT "%8.4" /end AXIS_DESCR
/end CHARACTERISTIC
/begin CHARACTERISTIC OutMCrntFdbk_uDio_C[2] "F2864: Forward voltage of freewheeling diode dependent on chip temperature" CURVE 0x2010A4 AblGLKLsw_S1 0.7 U0_001_S1 0.3 1 FORMAT "%8.6"
 /begin AXIS_DESCR STD_AXIS OutMRstn_tChpRef T0_0625_S1 4 -40 215 DEPOSIT ABSOLUTE FORMAT "%8.4" /end AXIS_DESCR
/end CHARACTERISTIC
/begin CHARACTERISTIC OutMCrntFdbk_uDio_C[3] "F2864: Forward voltage of freewheeling diode dependent on chip temperature" CURVE 0x2010B6 AblGLKLsw_S1 0.7 U0_001_S1 0.3 1 FORMAT "%8.6"
 /begin AXIS_DESCR STD_AXIS OutMRstn_tChpRef T0_0625_S1 4 -40 215 DEPOSIT ABSOLUTE FORMAT "%8.4" /end AXIS_DESCR
/end CHARACTERISTIC
/begin CHARACTERISTIC OutMCrntFdbk_uDio_C[4] "F2864: Forward voltage of freewheeling diode dependent on chip temperature" CURVE 0x2010C8 AblGLKLsw_S1 0.7 U0_001_S1 0.3 1 FORMAT "%8.6"
 /begin AXIS_DESCR STD_AXIS OutMRstn_tChpRef T0_0625_S1 4 -40 215 DEPOSIT ABSOLUTE FORMAT "%8.4" /end AXIS_DESCR
/end CHARACTERISTIC
/begin CHARACTERISTIC OutMCrntFdbk_uDio_C[5] "F2864: Forward voltage of freewheeling diode dependent on chip temperature" CURVE 0x2010DA AblGLKLsw_S1 0.7 U0_001_S1 0.3 1 FORMAT "%8.6"
 /begin AXIS_DESCR STD_AXIS OutMRstn_tChpRef T0_0625_S1 4 -40 215 DEPOSIT ABSOLUTE FORMAT "%8.4" /end AXIS_DESCR
/end CHARACTERISTIC
/begin CHARACTERISTIC OutMCrntFdbk_uDio_C[6] "F2864: Forward voltage of freewheeling diode dependent on chip temperature" CURVE 0x2010EC AblGLKLsw_S1 0.7 U0_001_S1 0.3 1 FORMAT "%8.6"
 /begin AXIS_DESCR STD_AXIS OutMRstn_tChpRef T0_0625_S1 4 -40 215 DEPOSIT ABSOLUTE FORMAT "%8.4" /end AXIS_DESCR
/end CHARACTERISTIC
/begin CHARACTERISTIC OutMCrntFdbk_uDio_C[7] "F2864: Forward voltage of freewheeling diode dependent on chip temperature" CURVE 0x2010FE AblGLKLsw_S1 0.7 U0_001_S1 0.3 1 FORMAT "%8.6"
 /begin AXIS_DESCR STD_AXIS OutMRstn_tChpRef T0_0625_S1 4 -40 215 DEPOSIT ABSOLUTE FORMAT "%8.4" /end AXIS_DESCR
/end CHARACTERISTIC
/begin CHARACTERISTIC OutMCrntFdbk_uDio_C[8] "F2864: Forward voltage of freewheeling diode dependent on chip temperature" CURVE 0x201110 AblGLKLsw_S1 0.7 U0_001_S1 0.3 1 FORMAT "%8.6"
 /begin AXIS_DESCR STD_AXIS OutMRstn_tChpRef T0_0625_S1 4 -40 215 DEPOSIT ABSOLUTE FORMAT "%8.4" /end AXIS_DESCR
/end CHARACTERISTIC
/begin CHARACTERISTIC OutMCrntFdbk_uDio_C[9] "F2864: Forward voltage of freewheeling diode dependent on chip temperature" CURVE 0x201122 AblGLKLsw_S1 0.7 U0_001_S1 0.3 1 FORMAT "%8.6"
 /begin AXIS_DESCR STD_AXIS OutMRstn_tChpRef T0_0625_S1 4 -40 215 DEPOSIT ABSOLUTE FORMAT "%8.4" /end AXIS_DESCR
/end CHARACTERISTIC
/begin CHARACTERISTIC OutMDth_facAtfFlt_C "F2861: Filter constant for Atf-temperature" VALUE 0x20161E AblGLKWsw_S1 1 R0_0001_S1 0 1 FORMAT "%8.6" /end CHARACTERISTIC
/begin CHARACTERISTIC OutMDth_iDthAmpChngThres_C "F2861: Threshold to detect change in dither amplitude" VAL_BLK 0x2005CC AblGLKWBuw_S1 6.5535 I0_0001_S1 0 6.5535 NUMBER 10 FORMAT "%8.6" /end CHARACTERISTIC
/begin CHARACTERISTIC OutMDth_iDthAmpGrad_C "F2861: gradient for dither amplitude limitation" VAL_BLK 0x2005E0 AblGLKWBuw_S1 3.2 I0_0001_S1 0 3.2 NUMBER 10 FORMAT "%8.6" /end CHARACTERISTIC
/begin CHARACTERISTIC OutMDth_iDthAmpLimSply_C "F2861: Dither amplitude limitation depending on supply voltage and Atf temperature" MAP 0x20162C AblGLKFsw_S1 6.5535 I0_0001_S1 -3.2768 3.2767 FORMAT "%8.6"
 /begin AXIS_DESCR STD_AXIS OutMDth_tAtfFlt T0_0625_S1 5 -2048 2047.938 DEPOSIT ABSOLUTE FORMAT "%8.3" /end AXIS_DESCR
 /begin AXIS_DESCR STD_AXIS OutMDth_uSplyDmy U0_001_S1 5 -32.768 32.767 DEPOSIT ABSOLUTE FORMAT "%8.5" /end AXIS_DESCR
/end CHARACTERISTIC
/begin CHARACTERISTIC OutMDth_iDthAmpOnThres_C "F2861: Threshold for the dither On/Off recognition" VAL_BLK 0x2005F4 AblGLKWBuw_S1 6.5535 I0_0001_S1 0 6.5535 NUMBER 10 FORMAT "%8.6" /end CHARACTERISTIC
/begin CHARACTERISTIC OutMDth_iDthAmp_C[0] "F2861: Dither amplitude settings depending on output current and tAtf" MAP 0x200630 AblGLKFsw_S1 6.5535 I0_0001_S1 -3.2768 3.2767 FORMAT "%8.6"
 /begin AXIS_DESCR STD_AXIS OutMDth_tAtfFlt T0_0625_S1 5 -2048 2047.938 DEPOSIT ABSOLUTE FORMAT "%8.3" /end AXIS_DESCR
 /begin AXIS_DESCR STD_AXIS OutMDth_iInDmy I0_0001_S1 20 -3.2768 3.2767 DEPOSIT ABSOLUTE FORMAT "%8.6" /end AXIS_DESCR
/end CHARACTERISTIC
/begin CHARACTERISTIC OutMDth_iDthAmp_C[1] "F2861: Dither amplitude settings depending on output current and tAtf" MAP 0x20072E AblGLKFsw_S1 6.5535 I0_0001_S1 -3.2768 3.2767 FORMAT "%8.6"
 /begin AXIS_DESCR STD_AXIS OutMDth_tAtfFlt T0_0625_S1 5 -2048 2047.938 DEPOSIT ABSOLUTE FORMAT "%8.3" /end AXIS_DESCR
 /begin AXIS_DESCR STD_AXIS OutMDth_iInDmy I0_0001_S1 20 -3.2768 3.2767 DEPOSIT ABSOLUTE FORMAT "%8.6" /end AXIS_DESCR
/end CHARACTERISTIC
/begin CHARACTERISTIC OutMDth_iDthAmp_C[2] "F2861: Dither amplitude settings depending on output current and tAtf" MAP 0x20082C AblGLKFsw_S1 6.5535 I0_0001_S1 -3.2768 3.2767 FORMAT "%8.6"
 /begin AXIS_DESCR STD_AXIS OutMDth_tAtfFlt T0_0625_S1 5 -2048 2047.938 DEPOSIT ABSOLUTE FORMAT "%8.3" /end AXIS_DESCR
 /begin AXIS_DESCR STD_AXIS OutMDth_iInDmy I0_0001_S1 20 -3.2768 3.2767 DEPOSIT ABSOLUTE FORMAT "%8.6" /end AXIS_DESCR
/end CHARACTERISTIC
/begin CHARACTERISTIC OutMDth_iDthAmp_C[3] "F2861: Dither amplitude settings depending on output current and tAtf" MAP 0x20092A AblGLKFsw_S1 6.5535 I0_0001_S1 -3.2768 3.2767 FORMAT "%8.6"
 /begin AXIS_DESCR STD_AXIS OutMDth_tAtfFlt T0_0625_S1 5 -2048 2047.938 DEPOSIT ABSOLUTE FORMAT "%8.3" /end AXIS_DESCR
 /begin AXIS_DESCR STD_AXIS OutMDth_iInDmy I0_0001_S1 20 -3.2768 3.2767 DEPOSIT ABSOLUTE FORMAT "%8.6" /end AXIS_DESCR
/end CHARACTERISTIC
/begin CHARACTERISTIC OutMDth_iDthAmp_C[4] "F2861: Dither amplitude settings depending on output current and tAtf" MAP 0x200A28 AblGLKFsw_S1 6.5535 I0_0001_S1 -3.2768 3.2767 FORMAT "%8.6"
 /begin AXIS_DESCR STD_AXIS OutMDth_tAtfFlt T0_0625_S1 5 -2048 2047.938 DEPOSIT ABSOLUTE FORMAT "%8.3" /end AXIS_DESCR
 /begin AXIS_DESCR STD_AXIS OutMDth_iInDmy I0_0001_S1 20 -3.2768 3.2767 DEPOSIT ABSOLUTE FORMAT "%8.6" /end AXIS_DESCR
/end CHARACTERISTIC
/begin CHARACTERISTIC OutMDth_iDthAmp_C[5] "F2861: Dither amplitude settings depending on output current and tAtf" MAP 0x200B26 AblGLKFsw_S1 6.5535 I0_0001_S1 -3.2768 3.2767 FORMAT "%8.6"
 /begin AXIS_DESCR STD_AXIS OutMDth_tAtfFlt T0_0625_S1 5 -2048 2047.938 DEPOSIT ABSOLUTE FORMAT "%8.3" /end AXIS_DESCR
 /begin AXIS_DESCR STD_AXIS OutMDth_iInDmy I0_0001_S1 20 -3.2768 3.2767 DEPOSIT ABSOLUTE FORMAT "%8.6" /end AXIS_DESCR
/end CHARACTERISTIC
/begin CHARACTERISTIC OutMDth_iDthAmp_C[6] "F2861: Dither amplitude settings depending on output current and tAtf" MAP 0x200C24 AblGLKFsw_S1 6.5535 I0_0001_S1 -3.2768 3.2767 FORMAT "%8.6"
 /begin AXIS_DESCR STD_AXIS OutMDth_tAtfFlt T0_0625_S1 5 -2048 2047.938 DEPOSIT ABSOLUTE FORMAT "%8.3" /end AXIS_DESCR
 /begin AXIS_DESCR STD_AXIS OutMDth_iInDmy I0_0001_S1 20 -3.2768 3.2767 DEPOSIT ABSOLUTE FORMAT "%8.6" /end AXIS_DESCR
/end CHARACTERISTIC
/begin CHARACTERISTIC OutMDth_iDthAmp_C[7] "F2861: Dither amplitude settings depending on output current and tAtf" MAP 0x200D22 AblGLKFsw_S1 6.5535 I0_0001_S1 -3.2768 3.2767 FORMAT "%8.6"
 /begin AXIS_DESCR STD_AXIS OutMDth_tAtfFlt T0_0625_S1 5 -2048 2047.938 DEPOSIT ABSOLUTE FORMAT "%8.3" /end AXIS_DESCR
 /begin AXIS_DESCR STD_AXIS OutMDth_iInDmy I0_0001_S1 20 -3.2768 3.2767 DEPOSIT ABSOLUTE FORMAT "%8.6" /end AXIS_DESCR
/end CHARACTERISTIC
/begin CHARACTERISTIC OutMDth_iDthAmp_C[8] "F2861: Dither amplitude settings depending on output current and tAtf" MAP 0x200E20 AblGLKFsw_S1 6.5535 I0_0001_S1 -3.2768 3.2767 FORMAT "%8.6"
 /begin AXIS_DESCR STD_AXIS OutMDth_tAtfFlt T0_0625_S1 5 -2048 2047.938 DEPOSIT ABSOLUTE FORMAT "%8.3" /end AXIS_DESCR
 /begin AXIS_DESCR STD_AXIS OutMDth_iInDmy I0_0001_S1 20 -3.2768 3.2767 DEPOSIT ABSOLUTE FORMAT "%8.6" /end AXIS_DESCR
/end CHARACTERISTIC
/begin CHARACTERISTIC OutMDth_iDthAmp_C[9] "F2861: Dither amplitude settings depending on output current and tAtf" MAP 0x200F1E AblGLKFsw_S1 6.5535 I0_0001_S1 -3.2768 3.2767 FORMAT "%8.6"
 /begin AXIS_DESCR STD_AXIS OutMDth_tAtfFlt T0_0625_S1 5 -2048 2047.938 DEPOSIT ABSOLUTE FORMAT "%8.3" /end AXIS_DESCR
 /begin AXIS_DESCR STD_AXIS OutMDth_iInDmy I0_0001_S1 20 -3.2768 3.2767 DEPOSIT ABSOLUTE FORMAT "%8.6" /end AXIS_DESCR
/end CHARACTERISTIC
/begin CHARACTERISTIC OutMDth_iInGradMax_C "F2861: max. current value gradient" VAL_BLK 0x200608 AblGLKWBuw_S1 3.2 I0_0001_S1 0 3.2 NUMBER 10 FORMAT "%8.6" /end CHARACTERISTIC
/begin CHARACTERISTIC OutMDth_iOutOfsConst_C "F2861: Constant offset to outgoing current control value for characteristic field (dummy value only)" VAL_BLK 0x20061C AblGLKWBsw_S1 6.4 I0_0001_S1 -3.2 3.2 NUMBER 10 FORMAT "%8.6" /end CHARACTERISTIC
/begin CHARACTERISTIC OutMDth_stDthAmpLimAvl_C "F2861: Activate Dither amplitude limitation [B0: Chn0, B1: Chn1, ...; 0=not active, 1=active]" VALUE 0x201620 AblGLKWuw_S1 65535 X1_S1 0 65535 FORMAT "%8.2" /end CHARACTERISTIC
/begin CHARACTERISTIC OutMDth_tiMinSwtOff_C "F2861: Timer reload value for the min. switch off duration" VAL_BLK 0x201622 AblGLKWBub_S1 1275 TI1_M_CYCLE_S1 0 1275 NUMBER 10 FORMAT "%5.0" /end CHARACTERISTIC
/begin CHARACTERISTIC OutMDth_tiPerTempHi_C "F2861: Dither period for high temperatures (no SERAP)" VAL_BLK 0x201606 AblGLKWBuw_S1 65.535 TI0_001_M_S1 0 65.535 NUMBER 3 FORMAT "%8.5" /end CHARACTERISTIC
/begin CHARACTERISTIC OutMDth_tiPerTempLo_C "F2861: Dither period for low temperatures (no SERAP)" VAL_BLK 0x20160C AblGLKWBuw_S1 65.535 TI0_001_M_S1 0 65.535 NUMBER 3 FORMAT "%8.5" /end CHARACTERISTIC
/begin CHARACTERISTIC OutMDth_tPerTempHi_C "F2861: Threshold for the high temperature periode (no SERAP)" VAL_BLK 0x201612 AblGLKWBsw_S1 255 T0_0625_S1 -40 215 NUMBER 3 FORMAT "%8.4" /end CHARACTERISTIC
/begin CHARACTERISTIC OutMDth_tPerTempLo_C "F2861: Threshold for the low temperature periode (no SERAP)" VAL_BLK 0x201618 AblGLKWBsw_S1 255 T0_0625_S1 -40 215 NUMBER 3 FORMAT "%8.4" /end CHARACTERISTIC
/begin CHARACTERISTIC OutMRstn_facActrWuFlt1_C "F2863: 1.PT1-filter constant for self-heating of actuator" VAL_BLK 0x201134 AblGLKWBuw_S1 1 R0_0001_S1 0 1 NUMBER 10 FORMAT "%8.6" /end CHARACTERISTIC
/begin CHARACTERISTIC OutMRstn_facActrWuFlt2_C "F2863: 2.PT1-filter constant for self-heating of actuator" VAL_BLK 0x201148 AblGLKWBuw_S1 1 R0_0001_S1 0 1 NUMBER 10 FORMAT "%8.6" /end CHARACTERISTIC
/begin CHARACTERISTIC OutMRstn_facActrWuFlt_C "F2863: Rating factor of PT1-filters for actuator self-heating" VAL_BLK 0x20115C AblGLKWBuw_S1 1 R0_0001_S1 0 1 NUMBER 10 FORMAT "%8.6" /end CHARACTERISTIC
/begin CHARACTERISTIC OutMRstn_facAtfFlt_C "F2863: PT1-filter constant for oil temperature of actuator" VALUE 0x201676 AblGLKWuw_S1 1 R0_0001_S1 0 1 FORMAT "%8.6" /end CHARACTERISTIC
/begin CHARACTERISTIC OutMRstn_iActrWuRef_C "F2863: Reference current value for calculation of self-heating" VALUE 0x201678 AblGLKWuw_S1 3.17 I0_0001_S1 0.03 3.2 FORMAT "%8.6" /end CHARACTERISTIC
/begin CHARACTERISTIC OutMRstn_resActr20_C "F2863: Internal resistance of actuator for reference temperature 20°C" VAL_BLK 0x201170 AblGLKWBuw_S1 32 RES0_001_S1 0 32 NUMBER 10 FORMAT "%8.5" /end CHARACTERISTIC
/begin CHARACTERISTIC OutMRstn_resRmn_C "F2863: Remaining resistances on the measuring path (wire + contact)" VAL_BLK 0x201184 AblGLKWBuw_S1 3 RES0_001_S1 0 3 NUMBER 10 FORMAT "%8.6" /end CHARACTERISTIC
/begin CHARACTERISTIC OutMRstn_resSht_C[0] "F2863: Measured shunt dependent on chip temperature" CURVE 0x201198 AblGLKLsw_S1 1 RES0_001_S1 0 1 FORMAT "%8.6"
 /begin AXIS_DESCR STD_AXIS OutMRstn_tChpRef T0_0625_S1 4 -40 215 DEPOSIT ABSOLUTE FORMAT "%8.4" /end AXIS_DESCR
/end CHARACTERISTIC
/begin CHARACTERISTIC OutMRstn_resSht_C[1] "F2863: Measured shunt dependent on chip temperature" CURVE 0x2011AA AblGLKLsw_S1 1 RES0_001_S1 0 1 FORMAT "%8.6"
 /begin AXIS_DESCR STD_AXIS OutMRstn_tChpRef T0_0625_S1 4 -40 215 DEPOSIT ABSOLUTE FORMAT "%8.4" /end AXIS_DESCR
/end CHARACTERISTIC
/begin CHARACTERISTIC OutMRstn_resSht_C[2] "F2863: Measured shunt dependent on chip temperature" CURVE 0x2011BC AblGLKLsw_S1 1 RES0_001_S1 0 1 FORMAT "%8.6"
 /begin AXIS_DESCR STD_AXIS OutMRstn_tChpRef T0_0625_S1 4 -40 215 DEPOSIT ABSOLUTE FORMAT "%8.4" /end AXIS_DESCR
/end CHARACTERISTIC
/begin CHARACTERISTIC OutMRstn_resSht_C[3] "F2863: Measured shunt dependent on chip temperature" CURVE 0x2011CE AblGLKLsw_S1 1 RES0_001_S1 0 1 FORMAT "%8.6"
 /begin AXIS_DESCR STD_AXIS OutMRstn_tChpRef T0_0625_S1 4 -40 215 DEPOSIT ABSOLUTE FORMAT "%8.4" /end AXIS_DESCR
/end CHARACTERISTIC
/begin CHARACTERISTIC OutMRstn_resSht_C[4] "F2863: Measured shunt dependent on chip temperature" CURVE 0x2011E0 AblGLKLsw_S1 1 RES0_001_S1 0 1 FORMAT "%8.6"
 /begin AXIS_DESCR STD_AXIS OutMRstn_tChpRef T0_0625_S1 4 -40 215 DEPOSIT ABSOLUTE FORMAT "%8.4" /end AXIS_DESCR
/end CHARACTERISTIC
/begin CHARACTERISTIC OutMRstn_resSht_C[5] "F2863: Measured shunt dependent on chip temperature" CURVE 0x2011F2 AblGLKLsw_S1 1 RES0_001_S1 0 1 FORMAT "%8.6"
 /begin AXIS_DESCR STD_AXIS OutMRstn_tChpRef T0_0625_S1 4 -40 215 DEPOSIT ABSOLUTE FORMAT "%8.4" /end AXIS_DESCR
/end CHARACTERISTIC
/begin CHARACTERISTIC OutMRstn_resSht_C[6] "F2863: Measured shunt dependent on chip temperature" CURVE 0x201204 AblGLKLsw_S1 1 RES0_001_S1 0 1 FORMAT "%8.6"
 /begin AXIS_DESCR STD_AXIS OutMRstn_tChpRef T0_0625_S1 4 -40 215 DEPOSIT ABSOLUTE FORMAT "%8.4" /end AXIS_DESCR
/end CHARACTERISTIC
/begin CHARACTERISTIC OutMRstn_resSht_C[7] "F2863: Measured shunt dependent on chip temperature" CURVE 0x201216 AblGLKLsw_S1 1 RES0_001_S1 0 1 FORMAT "%8.6"
 /begin AXIS_DESCR STD_AXIS OutMRstn_tChpRef T0_0625_S1 4 -40 215 DEPOSIT ABSOLUTE FORMAT "%8.4" /end AXIS_DESCR
/end CHARACTERISTIC
/begin CHARACTERISTIC OutMRstn_resSht_C[8] "F2863: Measured shunt dependent on chip temperature" CURVE 0x201228 AblGLKLsw_S1 1 RES0_001_S1 0 1 FORMAT "%8.6"
 /begin AXIS_DESCR STD_AXIS OutMRstn_tChpRef T0_0625_S1 4 -40 215 DEPOSIT ABSOLUTE FORMAT "%8.4" /end AXIS_DESCR
/end CHARACTERISTIC
/begin CHARACTERISTIC OutMRstn_resSht_C[9] "F2863: Measured shunt dependent on chip temperature" CURVE 0x20123A AblGLKLsw_S1 1 RES0_001_S1 0 1 FORMAT "%8.6"
 /begin AXIS_DESCR STD_AXIS OutMRstn_tChpRef T0_0625_S1 4 -40 215 DEPOSIT ABSOLUTE FORMAT "%8.4" /end AXIS_DESCR
/end CHARACTERISTIC
/begin CHARACTERISTIC OutMRstn_tActrWu_C[0] "F2863: Self-heating of actuator because of electric power dissipation at 850mA" CURVE 0x20124C AblGLKLsw_S1 511.992 T0_0078125_S1 -256 255.9922 FORMAT "%8.4"
 /begin AXIS_DESCR STD_AXIS OutMRstn_tAtfRef T0_0625_S1 3 -40 215 DEPOSIT ABSOLUTE FORMAT "%8.4" /end AXIS_DESCR
/end CHARACTERISTIC
/begin CHARACTERISTIC OutMRstn_tActrWu_C[1] "F2863: Self-heating of actuator because of electric power dissipation at 850mA" CURVE 0x20125A AblGLKLsw_S1 511.992 T0_0078125_S1 -256 255.9922 FORMAT "%8.4"
 /begin AXIS_DESCR STD_AXIS OutMRstn_tAtfRef T0_0625_S1 3 -40 215 DEPOSIT ABSOLUTE FORMAT "%8.4" /end AXIS_DESCR
/end CHARACTERISTIC
/begin CHARACTERISTIC OutMRstn_tActrWu_C[2] "F2863: Self-heating of actuator because of electric power dissipation at 850mA" CURVE 0x201268 AblGLKLsw_S1 511.992 T0_0078125_S1 -256 255.9922 FORMAT "%8.4"
 /begin AXIS_DESCR STD_AXIS OutMRstn_tAtfRef T0_0625_S1 3 -40 215 DEPOSIT ABSOLUTE FORMAT "%8.4" /end AXIS_DESCR
/end CHARACTERISTIC
/begin CHARACTERISTIC OutMRstn_tActrWu_C[3] "F2863: Self-heating of actuator because of electric power dissipation at 850mA" CURVE 0x201276 AblGLKLsw_S1 511.992 T0_0078125_S1 -256 255.9922 FORMAT "%8.4"
 /begin AXIS_DESCR STD_AXIS OutMRstn_tAtfRef T0_0625_S1 3 -40 215 DEPOSIT ABSOLUTE FORMAT "%8.4" /end AXIS_DESCR
/end CHARACTERISTIC
/begin CHARACTERISTIC OutMRstn_tActrWu_C[4] "F2863: Self-heating of actuator because of electric power dissipation at 850mA" CURVE 0x201284 AblGLKLsw_S1 511.992 T0_0078125_S1 -256 255.9922 FORMAT "%8.4"
 /begin AXIS_DESCR STD_AXIS OutMRstn_tAtfRef T0_0625_S1 3 -40 215 DEPOSIT ABSOLUTE FORMAT "%8.4" /end AXIS_DESCR
/end CHARACTERISTIC
/begin CHARACTERISTIC OutMRstn_tActrWu_C[5] "F2863: Self-heating of actuator because of electric power dissipation at 850mA" CURVE 0x201292 AblGLKLsw_S1 511.992 T0_0078125_S1 -256 255.9922 FORMAT "%8.4"
 /begin AXIS_DESCR STD_AXIS OutMRstn_tAtfRef T0_0625_S1 3 -40 215 DEPOSIT ABSOLUTE FORMAT "%8.4" /end AXIS_DESCR
/end CHARACTERISTIC
/begin CHARACTERISTIC OutMRstn_tActrWu_C[6] "F2863: Self-heating of actuator because of electric power dissipation at 850mA" CURVE 0x2012A0 AblGLKLsw_S1 511.992 T0_0078125_S1 -256 255.9922 FORMAT "%8.4"
 /begin AXIS_DESCR STD_AXIS OutMRstn_tAtfRef T0_0625_S1 3 -40 215 DEPOSIT ABSOLUTE FORMAT "%8.4" /end AXIS_DESCR
/end CHARACTERISTIC
/begin CHARACTERISTIC OutMRstn_tActrWu_C[7] "F2863: Self-heating of actuator because of electric power dissipation at 850mA" CURVE 0x2012AE AblGLKLsw_S1 511.992 T0_0078125_S1 -256 255.9922 FORMAT "%8.4"
 /begin AXIS_DESCR STD_AXIS OutMRstn_tAtfRef T0_0625_S1 3 -40 215 DEPOSIT ABSOLUTE FORMAT "%8.4" /end AXIS_DESCR
/end CHARACTERISTIC
/begin CHARACTERISTIC OutMRstn_tActrWu_C[8] "F2863: Self-heating of actuator because of electric power dissipation at 850mA" CURVE 0x2012BC AblGLKLsw_S1 511.992 T0_0078125_S1 -256 255.9922 FORMAT "%8.4"
 /begin AXIS_DESCR STD_AXIS OutMRstn_tAtfRef T0_0625_S1 3 -40 215 DEPOSIT ABSOLUTE FORMAT "%8.4" /end AXIS_DESCR
/end CHARACTERISTIC
/begin CHARACTERISTIC OutMRstn_tActrWu_C[9] "F2863: Self-heating of actuator because of electric power dissipation at 850mA" CURVE 0x2012CA AblGLKLsw_S1 511.992 T0_0078125_S1 -256 255.9922 FORMAT "%8.4"
 /begin AXIS_DESCR STD_AXIS OutMRstn_tAtfRef T0_0625_S1 3 -40 215 DEPOSIT ABSOLUTE FORMAT "%8.4" /end AXIS_DESCR
/end CHARACTERISTIC
/begin CHARACTERISTIC OutPCc08Cfg_stCc08Mode_C "F2531: Status of current control mode [0=VFS not available, 1=Regulator Mode, 2=Switch Mode, 3=Mode is set by IFC]" VAL_BLK 0x20167A AblGLKWBub_S1 2 X1_S1 0 2 NUMBER 10 FORMAT "%5.3" /end CHARACTERISTIC
/begin CHARACTERISTIC OutPCc08Crnt_iCc08CrntHys_C "F2531: Current tolerance value for current control changes" VALUE 0x20183A AblGLKWuw_S1 1 I0_0001_S1 0 1 FORMAT "%8.6" /end CHARACTERISTIC
/begin CHARACTERISTIC OutPCc08Crnt_stCc08CrntEval_C "F2531: Relevance of VFS for current monitoring evaluation [B0=VFS0, B1=VFS1,... ; 0=not relevant, 1=relevant]" VALUE 0x20183C AblGLKWuw_S1 1023 X1_S1 0 1023 FORMAT "%8.3" /end CHARACTERISTIC
/begin CHARACTERISTIC OutPCc08Crnt_tiCc08CrntChng_C "F2531: Start value lag counter for current evaluation while current control changes" VAL_BLK 0x20183E AblGLKWBub_S1 100 TI1_M_CYCLE_S1 0 100 NUMBER 10 FORMAT "%5.1" /end CHARACTERISTIC
/begin CHARACTERISTIC OutPCc08Crnt_tiCc08CrntGen_C "F2531: Start value of lag counter for current tolerance expansion if other VFS change their current control" VAL_BLK 0x201848 AblGLKWBub_S1 100 TI1_M_CYCLE_S1 0 100 NUMBER 10 FORMAT "%5.1" /end CHARACTERISTIC
/begin CHARACTERISTIC OutPCc08Ctl_facCc08PSplyFlt_C "F2531: Filter constant for filtered power supply voltage" VAL_BLK 0x2012D8 AblGLKWBsw_S1 1 R0_0001_S1 0 1 NUMBER 2 FORMAT "%8.6" /end CHARACTERISTIC
/begin CHARACTERISTIC OutPCc08Ctl_iCc08LoBatt_C "F2531: Current threshold for differentiation to switch On/Off in case of under voltage" VALUE 0x201684 AblGLKWuw_S1 0.4 I0_0001_S1 0 0.4 FORMAT "%9.7" /end CHARACTERISTIC
/begin CHARACTERISTIC OutPCc08Ctl_iCc08LoCrnt_C "F2531: Threshold for under current deactivation" VALUE 0x201686 AblGLKWuw_S1 0.05 I0_0001_S1 0 0.05 FORMAT "%10.8" /end CHARACTERISTIC
/begin CHARACTERISTIC OutPCc08Ctl_stCc08Avl_C "F2531: Current regulator available [B0=CG208 channel 0, B1=CG208 channel 1,...; 0=not available, 1=available]" VALUE 0x201688 AblGLKWuw_S1 1023 X1_S1 0 1023 FORMAT "%8.3" /end CHARACTERISTIC
/begin CHARACTERISTIC OutPCc08Ctl_stCc08DnConn_C "F2531: Connection between VFS and DN [B0: CG208 channel 0, ..; 0=Not connected, 1=Connected]" VALUE 0x20168A AblGLKWuw_S1 1023 X1_S1 0 1023 FORMAT "%8.3" /end CHARACTERISTIC
/begin CHARACTERISTIC OutPCc08Ctl_stCc08LoBatt_C "F2531: Status for switch on/off in case of under voltage [bit0=switch off, bit1=switch on; 0=deaktivate, 1=active]" VAL_BLK 0x2012DC AblGLKWBuw_S1 3 X1_S1 0 3 NUMBER 10 FORMAT "%8.6" /end CHARACTERISTIC
/begin CHARACTERISTIC OutPCc08Ctl_stCc08ReqPSply_C "F2531: Active channel for request ON demand from PSply [B0=VFS0, B1=VFS1,...]" VALUE 0x20168C AblGLKWuw_S1 1023 X1_S1 0 1023 FORMAT "%8.3" /end CHARACTERISTIC
/begin CHARACTERISTIC OutPCc08Ctl_tiCc08HwFault_C "F2531: Start value of timer for hardware fault detection of current comparing" VALUE 0x2019E7 AblGLKWub_S1 1275 TI1_M_CYCLE_S1 0 1275 FORMAT "%5.0" /end CHARACTERISTIC
/begin CHARACTERISTIC OutPCc08Ctl_tiCc08ModeChng_C "F2531: Start value of timer for fault detection after PSply mode changes" VALUE 0x2019E8 AblGLKWub_S1 1275 TI1_M_CYCLE_S1 0 1275 FORMAT "%5.0" /end CHARACTERISTIC
/begin CHARACTERISTIC OutPCc08Ctl_uCc08LoBattHys_C "F2531: Hysteresisvoltage for LoadOnOff function" VALUE 0x20168E AblGLKWuw_S1 5 U0_001_S1 0 5 FORMAT "%8.6" /end CHARACTERISTIC
/begin CHARACTERISTIC OutPCc08Ctl_uCc08LoBatt_C "F2531: Actuator voltage below which LoadOnOff function is activated" VALUE 0x201690 AblGLKWuw_S1 9 U0_001_S1 0 9 FORMAT "%8.6" /end CHARACTERISTIC
/begin CHARACTERISTIC OutPCc08Fdbk_ctCc08FdbkErr_C "F2531: Limit for errorcounter for feedback signal" VALUE 0x2019E9 AblGLKWub_S1 100 X1_S1 0 100 FORMAT "%5.1" /end CHARACTERISTIC
/begin CHARACTERISTIC OutPCc08Fdbk_facCc08FdbkFlt_C "F2531: Filter constant for filtered ratio of feedback signal" VAL_BLK 0x2012F0 AblGLKWBsw_S1 1 R0_0001_S1 0 1 NUMBER 10 FORMAT "%8.6" /end CHARACTERISTIC
/begin CHARACTERISTIC OutPCc08Fdbk_rCc08FdbkLim_C "F2531: Ratio limit to recognize short circuits" VALUE 0x201692 AblGLKWuw_S1 100 R0_1_P_S1 0 100 FORMAT "%8.4" /end CHARACTERISTIC
/begin CHARACTERISTIC OutPCc08Mon_stCc08SfrmLss_C "F2531: Fault bit mask for SFRM check: only VFS should switch off [B0=Gen, B1=Plaus, B2=SB, B3=SG, B4=SGOP, B5=SBDFE, B6=SGDFE, B7=OPDFE, B8=Low, B9=High, B0=NSSTA, B11=NSDYN, B12=PRESGOP, B13=TEMPINCOR]" VAL_BLK 0x201304 AblGLKWBuw_S1 65535 X1_S1 0 65535 NUMBER 10 FORMAT "%8.2" /end CHARACTERISTIC
/begin CHARACTERISTIC OutPCc08Mon_stCc08SfrmPSply_C "F2531: Fault bit mask for SFRM check: PSply and VFS should switch off [B0=Gen, B1=Plaus, B2=SB, B3=SG, B4=SGOP, B5=SBDFE, B6=SGDFE, B7=OPDFE, B8=Low, B9=High, B10=NSSTA, B11=NSDYN, B12=PRESGOP, B13=TEMPINCOR]" VAL_BLK 0x201318 AblGLKWBuw_S1 65535 X1_S1 0 65535 NUMBER 10 FORMAT "%8.2" /end CHARACTERISTIC
/begin CHARACTERISTIC OutPCc08Mon_stCc08TstCond_C "F2531: Enable test condition [0=off, 1=on; B0=Gen, B1=Plaus, B2=SB, B3=SG, B4=SGOP, B5=SBDFE, B6=SGDFE, B7=OPDFE, B8=Low, B9=High, B10=NSSTA, B11=NSDYN, B12=PRESGOP, B13=TEMPINCOR]" VAL_BLK 0x20132C AblGLKWBuw_S1 65535 X1_S1 0 65535 NUMBER 10 FORMAT "%8.2" /end CHARACTERISTIC
/begin CHARACTERISTIC OutPCc08Mon_stPSplyErrOP_C "F2531: Relevance of VFS for PSply OP monitoring [B0=VFS0, B1=VFS1,.. ; 0=not relevant, 1=relevant]" VALUE 0x201694 AblGLKWuw_S1 1023 X1_S1 0 1023 FORMAT "%8.3" /end CHARACTERISTIC
/begin CHARACTERISTIC OutPCc08Mon_tiCc08NsDynErr_C "F2531: Start value of fault filter timer for dynamical current flow" VALUE 0x2019EA AblGLKWub_S1 1275 TI1_M_CYCLE_S1 0 1275 FORMAT "%5.0" /end CHARACTERISTIC
/begin CHARACTERISTIC OutPCc08Mon_tiCc08TstFdbk_C "F2531: Start value of Filter for test condition if feedback signal is changing from 100%" VALUE 0x2019EB AblGLKWub_S1 1275 TI1_M_CYCLE_S1 0 1275 FORMAT "%5.0" /end CHARACTERISTIC
/begin CHARACTERISTIC OutPCc08Mon_uCc08TstCrntHi_C "F2531: Voltage threshold for test condition of current monitoring at high battery voltage" VALUE 0x201696 AblGLKWuw_S1 40 U0_001_S1 0 40 FORMAT "%8.5" /end CHARACTERISTIC
/begin CHARACTERISTIC OutPCc08Mon_uCc08TstCrntLo_C "F2531: Voltage threshold for test condition of current monitoring at low battery voltage" VALUE 0x201698 AblGLKWuw_S1 9 U0_001_S1 0 9 FORMAT "%8.6" /end CHARACTERISTIC
/begin CHARACTERISTIC OutPCc08Mon_uCc08TstSCHi_C "F2531: Voltage threshold for test condition to detect short circuit at high battery voltage" VALUE 0x20169A AblGLKWuw_S1 40 U0_001_S1 0 40 FORMAT "%8.5" /end CHARACTERISTIC
/begin CHARACTERISTIC OutPCc08Mon_uCc08TstSCLo_C "F2531: Voltage threshold for test condition to detect short circuit at low battery voltage" VALUE 0x20169C AblGLKWuw_S1 9 U0_001_S1 0 9 FORMAT "%8.6" /end CHARACTERISTIC
/begin CHARACTERISTIC OutPCc08Rat_rCc08RatFdbk_C "F2531: Ratio limit of feedback signal to recognize 100% current mode" VALUE 0x201852 AblGLKWuw_S1 100 R0_1_P_S1 0 100 FORMAT "%8.4" /end CHARACTERISTIC
/begin CHARACTERISTIC OutPCc08Rat_rCc08RatHys_C "F2531: Hysteresis for Ratio RI/U at VFS to recognize 100% or 0% current mode" VALUE 0x201854 AblGLKWuw_S1 1 R0_0001_S1 0 1 FORMAT "%8.6" /end CHARACTERISTIC
/begin CHARACTERISTIC OutPCc08Rat_rCc08Rat_C "F2531: Ratio RI/U at VFS to recognize 100% current mode (Limit) [0=deactive]" VAL_BLK 0x201484 AblGLKWBuw_S1 2 R0_0001_S1 0 2 NUMBER 10 FORMAT "%8.6" /end CHARACTERISTIC
/begin CHARACTERISTIC OutPCc08Rat_uCc08RatActv_C "F2531: Voltage threshold to recognize 100% current mode" VAL_BLK 0x201498 AblGLKWBuw_S1 32 U0_001_S1 0 32 NUMBER 10 FORMAT "%8.5" /end CHARACTERISTIC
/begin CHARACTERISTIC OutPCc08Rat_uCc08RatSplyHys_C "F2531: Hysteresis to recognize constant power supply voltage" VALUE 0x201856 AblGLKWuw_S1 5 U0_001_S1 0 5 FORMAT "%8.6" /end CHARACTERISTIC
/begin CHARACTERISTIC OutPCc08SGOP_stCc08DiffSC_C "F2531: Selection switch for short circuit detection [0=without NsDyn, 1=with NsDyn, 2=distinguishing between SG or OP]" VAL_BLK 0x20169E AblGLKWBub_S1 2 X1_S1 0 2 NUMBER 10 FORMAT "%5.3" /end CHARACTERISTIC
/begin CHARACTERISTIC OutPCc08SGOP_tiCc08DiffDly_C[0] "F2531: Start value for internal delay timer of short to ground and open load detection" CURVE 0x201340 AblGLKLuw_S1 50 TI1_M_CYCLE_S1 0 50 FORMAT "%8.5"
 /begin AXIS_DESCR STD_AXIS OutPCc08SGOP_uCc08DiffPSply U0_001_S1 3 0 32 DEPOSIT ABSOLUTE FORMAT "%8.5" /end AXIS_DESCR
/end CHARACTERISTIC
/begin CHARACTERISTIC OutPCc08SGOP_tiCc08DiffDly_C[1] "F2531: Start value for internal delay timer of short to ground and open load detection" CURVE 0x20134E AblGLKLuw_S1 50 TI1_M_CYCLE_S1 0 50 FORMAT "%8.5"
 /begin AXIS_DESCR STD_AXIS OutPCc08SGOP_uCc08DiffPSply U0_001_S1 3 0 32 DEPOSIT ABSOLUTE FORMAT "%8.5" /end AXIS_DESCR
/end CHARACTERISTIC
/begin CHARACTERISTIC OutPCc08SGOP_tiCc08DiffSGOP_C "F2531: Start value for fault filter timer of short to ground and open load detection" VAL_BLK 0x2016A8 AblGLKWBub_S1 250 TI1_M_CYCLE_S1 0 250 NUMBER 10 FORMAT "%5.1" /end CHARACTERISTIC
/begin CHARACTERISTIC OutPCc08SGOP_tiCc08HldFault_C "F2531: Start value for timer for keeping faults" VALUE 0x2019EC AblGLKWub_S1 1275 TI1_M_CYCLE_S1 0 1275 FORMAT "%5.0" /end CHARACTERISTIC
/begin CHARACTERISTIC OutPCc08SGOP_uCc08DiffSGOP_C "F2531: Voltage threshold to activate short to ground and open load detection" VALUE 0x2016B2 AblGLKWuw_S1 25 U0_001_S1 0 25 FORMAT "%8.5" /end CHARACTERISTIC
/begin CHARACTERISTIC OutPCc08Tolc_facCc08GradLimHi_C "F2531: Factor of the current gradient monitoring (upper limit)" CURVE 0x201858 AblGLKLsw_S1 10 R0_001_S1 0 10 FORMAT "%8.5"
 /begin AXIS_DESCR STD_AXIS OutPCc08Tolc_iCc08GradDmy I0_0001_S1 9 -3.2 3.2 DEPOSIT ABSOLUTE FORMAT "%8.6" /end AXIS_DESCR
/end CHARACTERISTIC
/begin CHARACTERISTIC OutPCc08Tolc_facCc08GradLimLo_C "F2531: Factor of the current gradient monitoring (lower limit)" CURVE 0x20187E AblGLKLsw_S1 10 R0_001_S1 0 10 FORMAT "%8.5"
 /begin AXIS_DESCR STD_AXIS OutPCc08Tolc_iCc08GradDmy I0_0001_S1 9 -3.2 3.2 DEPOSIT ABSOLUTE FORMAT "%8.6" /end AXIS_DESCR
/end CHARACTERISTIC
/begin CHARACTERISTIC OutPCc08Tolc_iCc08CrntGen_C "F2531: Current tolerance expansion if other VFS change their current control" VALUE 0x2018A4 AblGLKWuw_S1 0.3 I0_0001_S1 0 0.3 FORMAT "%9.7" /end CHARACTERISTIC
/begin CHARACTERISTIC OutPCc08Tolc_iCc08DthAmpOn_C "F2531: Current tolerance expansion with dither active" VAL_BLK 0x2014AC AblGLKWBuw_S1 1 I0_0001_S1 0 1 NUMBER 10 FORMAT "%8.6" /end CHARACTERISTIC
/begin CHARACTERISTIC OutPCc08Tolc_iCc08GradAbsHi_C "F2531: Current limit  for gradient diagnosis (high range)" VAL_BLK 0x2014C0 AblGLKWBuw_S1 3.2 I0_0001_S1 0 3.2 NUMBER 10 FORMAT "%8.6" /end CHARACTERISTIC
/begin CHARACTERISTIC OutPCc08Tolc_iCc08GradAbsLo_C "F2531: Current limit  for gradient diagnosis (low range)" VAL_BLK 0x2014D4 AblGLKWBuw_S1 3.2 I0_0001_S1 0 3.2 NUMBER 10 FORMAT "%8.6" /end CHARACTERISTIC
/begin CHARACTERISTIC OutPCc08Tolc_iCc08GradLimMax_C "F2531: Maximally possible current gradient for the diagnosis" VAL_BLK 0x2014E8 AblGLKWBuw_S1 1 I0_0001_S1 0 1 NUMBER 10 FORMAT "%8.6" /end CHARACTERISTIC
/begin CHARACTERISTIC OutPCc08Tolc_iCc08Noi_C "F2531: Current tolerance expansion if noise was detected on battery supply" VALUE 0x2018A6 AblGLKWuw_S1 0.3 I0_0001_S1 0 0.3 FORMAT "%9.7" /end CHARACTERISTIC
/begin CHARACTERISTIC OutPCc08Tolc_iCc08RngLim_C "F2531: Band edge for high / low current distinction" VALUE 0x2018A8 AblGLKWuw_S1 1 I0_0001_S1 0 1 FORMAT "%8.6" /end CHARACTERISTIC
/begin CHARACTERISTIC OutPCc08Tolc_iCc08TempIncor_C "F2531: Current tolerance expansion if temperature sensor deliver incorrect values" VALUE 0x2018AA AblGLKWuw_S1 0.3 I0_0001_S1 0 0.3 FORMAT "%9.7" /end CHARACTERISTIC
/begin CHARACTERISTIC OutPCc08Tolc_iCc08TolcRngHi_C "F2531: Current deviation to detect an error while high current range" VALUE 0x2018AC AblGLKWuw_S1 0.5 I0_0001_S1 0 0.5 FORMAT "%9.7" /end CHARACTERISTIC
/begin CHARACTERISTIC OutPCc08Tolc_iCc08TolcRngLo_C "F2531: Current deviation to detect an error while low current range" VALUE 0x2018AE AblGLKWuw_S1 0.5 I0_0001_S1 0 0.5 FORMAT "%9.7" /end CHARACTERISTIC
/begin CHARACTERISTIC OutPCc08Tolc_stCc08GradRng_C "F2531: Selection switch of current gradient diagnosis: 0=off, 1=low range only, 2=high range only, 3=low and high range" VAL_BLK 0x2018B0 AblGLKWBub_S1 3 X1_S1 0 3 NUMBER 10 FORMAT "%5.3" /end CHARACTERISTIC
/begin CHARACTERISTIC OutPCc08Tolc_stCc08TolcRng_C "F2531: Selection switch of current monitoring range: 0=off, 1=low range only, 2=high range only, 3=low and high range" VAL_BLK 0x2018BA AblGLKWBub_S1 3 X1_S1 0 3 NUMBER 10 FORMAT "%5.3" /end CHARACTERISTIC
/begin CHARACTERISTIC OutPCc08Tolc_tiCc08DthAmpOn_C "F2531: dither active lengthening time for current tolerance expansion" VAL_BLK 0x2018C4 AblGLKWBub_S1 1275 TI1_M_CYCLE_S1 0 1275 NUMBER 10 FORMAT "%5.0" /end CHARACTERISTIC
/begin CHARACTERISTIC OutPCc08Tolc_tiCc08DthChng_C "F2531: lag time for dither frequence or amplitude change" VAL_BLK 0x2018CE AblGLKWBub_S1 1275 TI1_M_CYCLE_S1 0 1275 NUMBER 10 FORMAT "%5.0" /end CHARACTERISTIC
/begin CHARACTERISTIC OutPCc08Tolc_tiCc08GradHi_C "F2531: Start value lag counter for current gradient diagnosis (high range)" CURVE 0x2018D8 AblGLKLsw_S1 200 TI1_M_CYCLE_S1 0 200 FORMAT "%8.4"
 /begin AXIS_DESCR STD_AXIS OutPCc08Tolc_iCc08GradDmy I0_0001_S1 9 -3.2 3.2 DEPOSIT ABSOLUTE FORMAT "%8.6" /end AXIS_DESCR
/end CHARACTERISTIC
/begin CHARACTERISTIC OutPCc08Tolc_tiCc08GradLo_C "F2531: Start value lag counter for current gradient diagnosis (low range)" CURVE 0x2018FE AblGLKLsw_S1 200 TI1_M_CYCLE_S1 0 200 FORMAT "%8.4"
 /begin AXIS_DESCR STD_AXIS OutPCc08Tolc_iCc08GradDmy I0_0001_S1 9 -3.2 3.2 DEPOSIT ABSOLUTE FORMAT "%8.6" /end AXIS_DESCR
/end CHARACTERISTIC
/begin CHARACTERISTIC OutPCc08Tolc_tiCc08Noi_C "F2531: Start value of lag counter for current tolerance expansion if noise was detected on battery supply" VALUE 0x201B06 AblGLKWub_S1 255 TI1_M_CYCLE_S1 0 255 FORMAT "%5.1" /end CHARACTERISTIC
/begin CHARACTERISTIC OutPLssCtl_stLssAvl_C "F2525: Solenoid active [B0: Lss channel 0, B1: ...; 0=Deactivate, 1=Active]" VALUE 0x2019ED AblGLKWub_S1 31 X1_S1 0 31 FORMAT "%5.2" /end CHARACTERISTIC
/begin CHARACTERISTIC OutPLssCtl_stLssDnConn_C "F2525: Connection between Lss and DN [B0: Lss channel 0, B1: ...; 0=Not connected, 1=Connected]" VALUE 0x2019EE AblGLKWub_S1 31 X1_S1 0 31 FORMAT "%5.2" /end CHARACTERISTIC
/begin CHARACTERISTIC OutPLssCtl_stLssReqPSply_C "F2525: Active channels for request on demand from PSply [B0: Lss channel 0, B1: ...; 0=Off, 1=On]" VALUE 0x2019EF AblGLKWub_S1 31 X1_S1 0 31 FORMAT "%5.2" /end CHARACTERISTIC
/begin CHARACTERISTIC OutPLssCtl_uLssThresT15Hys_C "F2525: Hysteresisvoltage for Terminal 15 supply" VALUE 0x2016B4 AblGLKWuw_S1 10 U0_001_S1 0 10 FORMAT "%8.5" /end CHARACTERISTIC
/begin CHARACTERISTIC OutPLssCtl_uLssThresT15_C "F2525: Voltage threshold for Terminal 15 supply" VALUE 0x2016B6 AblGLKWuw_S1 32 U0_001_S1 0 32 FORMAT "%8.5" /end CHARACTERISTIC
/begin CHARACTERISTIC OutPLssCtl_uLssThresT30Hys_C "F2525: Hysteresisvoltage for Terminal 30 supply" VALUE 0x2016B8 AblGLKWuw_S1 10 U0_001_S1 0 10 FORMAT "%8.5" /end CHARACTERISTIC
/begin CHARACTERISTIC OutPLssCtl_uLssThresT30_C "F2525: Voltage threshold for Terminal 30 supply" VALUE 0x2016BA AblGLKWuw_S1 32 U0_001_S1 0 32 FORMAT "%8.5" /end CHARACTERISTIC
/begin CHARACTERISTIC OutPLssDuty_facLssCrnt_C "F2525: Correction factor of PWM calculation from current value" VAL_BLK 0x2016BC AblGLKWBuw_S1 40 R0_1_P_S1 80 120 NUMBER 5 FORMAT "%8.4" /end CHARACTERISTIC
/begin CHARACTERISTIC OutPLssDuty_stLssDutyLtdMax_C "F2525: Increase solenoid control above max. duty [B0: Lss channel 0, B1: ...; 0=No change, 1=Jump to 100%]" VALUE 0x2019F0 AblGLKWub_S1 31 X1_S1 0 31 FORMAT "%5.2" /end CHARACTERISTIC
/begin CHARACTERISTIC OutPLssDuty_stLssDutyLtdMin_C "F2525: Increase solenoid control below min. duty [B0: Lss channel 0, B1: ...; 0=No change, 1=Jump to min. duty]" VALUE 0x2019F1 AblGLKWub_S1 31 X1_S1 0 31 FORMAT "%5.2" /end CHARACTERISTIC
/begin CHARACTERISTIC OutPLssDuty_stLssMode_C "F2525:Operation mode solenoid [0=Switch on/off, 1=PWM dependent on voltage, 2=PWM, 3=By current]" VAL_BLK 0x2019F2 AblGLKWBub_S1 3 X1_S1 0 3 NUMBER 5 FORMAT "%5.3" /end CHARACTERISTIC
/begin CHARACTERISTIC OutPLssDuty_stLssSelSply_C "F2525: Selection for solenoid supply [-2=T30, -1=T15, 0=PSply channel 0, 1=PSply channel 1, ...]" VAL_BLK 0x2019F7 AblGLKWBsb_S1 3 X1_S1 -2 1 NUMBER 5 FORMAT "%5.3" /end CHARACTERISTIC
/begin CHARACTERISTIC OutPLssDuty_tiLssPk_C "F2525: Solenoid duration of peak [0=No peak function active]" VAL_BLK 0x2019FC AblGLKWBub_S1 1275 TI1_M_CYCLE_S1 0 1275 NUMBER 5 FORMAT "%5.0" /end CHARACTERISTIC
/begin CHARACTERISTIC OutPLssDuty_uLssDutyRef_C[0] "F2525: Reference voltage for solenoids (characteristic curve is dependent on oil temperature)" CURVE 0x2016C6 AblGLKLsw_S1 31.5 U0_001_S1 0.5 32 FORMAT "%8.5"
 /begin AXIS_DESCR STD_AXIS OutPLssDuty_tAtf T0_0625_S1 2 -40 215 DEPOSIT ABSOLUTE FORMAT "%8.4" /end AXIS_DESCR
/end CHARACTERISTIC
/begin CHARACTERISTIC OutPLssDuty_uLssDutyRef_C[1] "F2525: Reference voltage for solenoids (characteristic curve is dependent on oil temperature)" CURVE 0x2016D0 AblGLKLsw_S1 31.5 U0_001_S1 0.5 32 FORMAT "%8.5"
 /begin AXIS_DESCR STD_AXIS OutPLssDuty_tAtf T0_0625_S1 2 -40 215 DEPOSIT ABSOLUTE FORMAT "%8.4" /end AXIS_DESCR
/end CHARACTERISTIC
/begin CHARACTERISTIC OutPLssDuty_uLssDutyRef_C[2] "F2525: Reference voltage for solenoids (characteristic curve is dependent on oil temperature)" CURVE 0x2016DA AblGLKLsw_S1 31.5 U0_001_S1 0.5 32 FORMAT "%8.5"
 /begin AXIS_DESCR STD_AXIS OutPLssDuty_tAtf T0_0625_S1 2 -40 215 DEPOSIT ABSOLUTE FORMAT "%8.4" /end AXIS_DESCR
/end CHARACTERISTIC
/begin CHARACTERISTIC OutPLssDuty_uLssDutyRef_C[3] "F2525: Reference voltage for solenoids (characteristic curve is dependent on oil temperature)" CURVE 0x2016E4 AblGLKLsw_S1 31.5 U0_001_S1 0.5 32 FORMAT "%8.5"
 /begin AXIS_DESCR STD_AXIS OutPLssDuty_tAtf T0_0625_S1 2 -40 215 DEPOSIT ABSOLUTE FORMAT "%8.4" /end AXIS_DESCR
/end CHARACTERISTIC
/begin CHARACTERISTIC OutPLssDuty_uLssDutyRef_C[4] "F2525: Reference voltage for solenoids (characteristic curve is dependent on oil temperature)" CURVE 0x2016EE AblGLKLsw_S1 31.5 U0_001_S1 0.5 32 FORMAT "%8.5"
 /begin AXIS_DESCR STD_AXIS OutPLssDuty_tAtf T0_0625_S1 2 -40 215 DEPOSIT ABSOLUTE FORMAT "%8.4" /end AXIS_DESCR
/end CHARACTERISTIC
/begin CHARACTERISTIC OutPLssMon_stLssChkHw_C "F2525: Hardware status evaluation at 100% PWM active [B0: Lss channel 0, B1: ...; 0=Deactivate, 1=Active]" VALUE 0x201A01 AblGLKWub_S1 31 X1_S1 0 31 FORMAT "%5.2" /end CHARACTERISTIC
/begin CHARACTERISTIC OutPLssMon_stLssDetSGOP_C "F2525: Detection of SGOP if a SG or OP fault cannot be distinguished [B0: Lss channel 0, ...]" VALUE 0x201A02 AblGLKWub_S1 31 X1_S1 0 31 FORMAT "%5.2" /end CHARACTERISTIC
/begin CHARACTERISTIC OutPLssMon_stLssSfrmLss_C "F2525: Fault bit mask for SFRM check: only Lss should switch off [B2: SB, B3: SG, B4: OP, B5: SGOP, B6: SGDFE, B7: SBDFE]" VAL_BLK 0x2016F8 AblGLKWBuw_S1 65535 X1_S1 0 65535 NUMBER 5 FORMAT "%8.2" /end CHARACTERISTIC
/begin CHARACTERISTIC OutPLssMon_stLssSfrmPSply_C "F2525: Fault bit mask for SFRM check: PSply and Lss should switch off [B2: SB, B3: SG, B4: OP, B5: SGOP, B6: SGDFE, B7: SBDFE]" VAL_BLK 0x201702 AblGLKWBuw_S1 65535 X1_S1 0 65535 NUMBER 5 FORMAT "%8.2" /end CHARACTERISTIC
/begin CHARACTERISTIC OutPLssMon_stLssTstCond_C "F2525: Enable test condition [B2: SB, B3: SG, B4: OP, B5: SGOP, B6: SGDFE, B7: SBDFE; 0=Off, 1=On]" VAL_BLK 0x20170C AblGLKWBuw_S1 65535 X1_S1 0 65535 NUMBER 5 FORMAT "%8.2" /end CHARACTERISTIC
/begin CHARACTERISTIC OutPLssMon_stPSplyErrOP_C "F2525: Relevance of LSS for PSply OP monitoring [B0=LSS0, B1=LSS1,.. ; 0=not relevant, 1=relevant]" VALUE 0x201A03 AblGLKWub_S1 31 X1_S1 0 31 FORMAT "%5.2" /end CHARACTERISTIC
/begin CHARACTERISTIC OutPLssMon_stSwtOnPrt_C "F2525: Activate to inhibit control to protect hardware circuit at SB fault [0=Not active, 1=Use features; channel wise bit-coded]" VALUE 0x201716 AblGLKWuw_S1 31 X1_S1 0 31 FORMAT "%8.5" /end CHARACTERISTIC
/begin CHARACTERISTIC OutPLssMon_tiFltSB_C "F2525: Start value of lag counter for SB fault prefiltering" VAL_BLK 0x201A04 AblGLKWBub_S1 1275 TI1_M_CYCLE_S1 0 1275 NUMBER 5 FORMAT "%5.0" /end CHARACTERISTIC
/begin CHARACTERISTIC OutPLssMon_tiLssChng_C "F2525: Start value for monitoring delay at control value change" VAL_BLK 0x201A09 AblGLKWBub_S1 1275 TI1_M_CYCLE_S1 0 1275 NUMBER 5 FORMAT "%5.0" /end CHARACTERISTIC
/begin CHARACTERISTIC OutPLssMon_tiLssSplyOn_C "F2525: Start value for monitoring delay, if T15 or T30 is used" VAL_BLK 0x201A0E AblGLKWBub_S1 1275 TI1_M_CYCLE_S1 0 1275 NUMBER 5 FORMAT "%5.0" /end CHARACTERISTIC
/begin CHARACTERISTIC OutPLssMon_tiSwtOnPrt_C "F2525: Start value of lag counter to inhibit control to protect hardware circuit at SB fault" VAL_BLK 0x201A13 AblGLKWBub_S1 1275 TI1_M_CYCLE_S1 0 1275 NUMBER 5 FORMAT "%5.0" /end CHARACTERISTIC
/begin CHARACTERISTIC OutPLssMon_uLssTstHi_C "F2525: Upper voltage threshold of test condition" VAL_BLK 0x201718 AblGLKWBuw_S1 40 U0_001_S1 0 40 NUMBER 5 FORMAT "%8.5" /end CHARACTERISTIC
/begin CHARACTERISTIC OutPLssMon_uLssTstLo_C "F2525: Lower voltage threshold of test condition" VAL_BLK 0x201722 AblGLKWBuw_S1 32 U0_001_S1 0 32 NUMBER 5 FORMAT "%8.5" /end CHARACTERISTIC
/begin CHARACTERISTIC OutPLssMon_uLssTstOP_C "F2525: Voltage threshold for open pin detection" VAL_BLK 0x20172C AblGLKWBuw_S1 10 U0_001_S1 0 10 NUMBER 5 FORMAT "%8.5" /end CHARACTERISTIC
/begin CHARACTERISTIC OutPLssMon_uLssTstSB_C "F2525: Voltage threshold for short to battery detection" VAL_BLK 0x201736 AblGLKWBuw_S1 31 U0_001_S1 1 32 NUMBER 5 FORMAT "%8.5" /end CHARACTERISTIC
/begin CHARACTERISTIC OutPLssMon_uLssTstSG_C "F2525: Voltage threshold for short to ground detection" VAL_BLK 0x201740 AblGLKWBuw_S1 3 U0_001_S1 0 3 NUMBER 5 FORMAT "%8.6" /end CHARACTERISTIC
/begin CHARACTERISTIC OutPOpsCtl_numRepIpt_C "F2520: number of IPT repetitions if IPT fails" VALUE 0x201A18 AblGLKWub_S1 255 X1_S1 0 255 FORMAT "%5.1" /end CHARACTERISTIC
/begin CHARACTERISTIC OutPOpsCtl_swtBypIpt_C "F2520: Disable / Bypass Inhibit Path Test (Key 0xC3)" VALUE 0x201A19 AblGLKWub_S1 195 X1_S1 0 195 FORMAT "%5.1" /end CHARACTERISTIC
/begin CHARACTERISTIC OutPOpsCtl_uUndrBatt_C "F2520: Voltage threshold to enable DN Reset faultreport" VALUE 0x20174A AblGLKWuw_S1 32.767 U0_001_S1 0 32.767 FORMAT "%8.5" /end CHARACTERISTIC
/begin CHARACTERISTIC OutPOpsTst_swtDbgEnbl_C "F2520: Enable debug-mode of Inhibit-Path-Test" VALUE 0x20174C AblGLKWuw_S1 165 X1_S1 0 165 FORMAT "%8.4" /end CHARACTERISTIC
/begin CHARACTERISTIC OutPOpsTst_tiDnTOut_C "F2520: Timeout-value for DN-Reset-Line" VALUE 0x201A1A AblGLKWub_S1 1275 TI1_M_CYCLE_S1 0 1275 FORMAT "%5.0" /end CHARACTERISTIC
/begin CHARACTERISTIC OutPOpsTst_tiIptTOut_C "F2520: Time for Test-Timeout" VALUE 0x201A1B AblGLKWub_S1 1275 TI1_M_CYCLE_S1 0 1275 FORMAT "%5.0" /end CHARACTERISTIC
/begin CHARACTERISTIC OutPOpsTst_tiPSplyTOut_C "F2520: Hss Timeout" VALUE 0x201A1C AblGLKWub_S1 500 TI1_M_CYCLE_S1 0 500 FORMAT "%5.1" /end CHARACTERISTIC
/begin CHARACTERISTIC OutPOpsTst_uBattIptMax_C "F2520: maximal battery voltage limit for inhibit-path-test (IPT)" VALUE 0x20174E AblGLKWuw_S1 65.535 U0_001_S1 0 65.535 FORMAT "%8.5" /end CHARACTERISTIC
/begin CHARACTERISTIC OutPOpsTst_uBattIptMin_C "F2520: minimal battery voltage limit for inhibit-path-test (IPT)" VALUE 0x201750 AblGLKWuw_S1 10 U0_001_S1 0 10 FORMAT "%8.5" /end CHARACTERISTIC
/begin CHARACTERISTIC OutPPSplyCtl_stPSplyAvl_C "F2523: Power supply available [[B0=PSply0, B1=PSply1,...; 0=not available, 1=available]" VALUE 0x201A1D AblGLKWub_S1 3 X1_S1 0 3 FORMAT "%5.3" /end CHARACTERISTIC
/begin CHARACTERISTIC OutPPSplyCtl_stPSplySaf_C "F2523: PSply safety status: 0=not connected, 1=connected, 2=connected and relevant" VAL_BLK 0x201752 AblGLKWBub_S1 2 X1_S1 0 2 NUMBER 2 FORMAT "%5.3" /end CHARACTERISTIC
/begin CHARACTERISTIC OutPPSplyCtl_tiPSplyBattLoStrt_C "F2523: Start value for timer for PSply switch off during low battery voltage after system start" VAL_BLK 0x201754 AblGLKWBub_S1 1275 TI1_M_CYCLE_S1 0 1275 NUMBER 2 FORMAT "%5.0" /end CHARACTERISTIC
/begin CHARACTERISTIC OutPPSplyCtl_tiPSplyBattLo_C "F2523: Start value for PSply switch off timer during low battery voltage" VAL_BLK 0x201756 AblGLKWBub_S1 1275 TI1_M_CYCLE_S1 0 1275 NUMBER 2 FORMAT "%5.0" /end CHARACTERISTIC
/begin CHARACTERISTIC OutPPSplyCtl_tiPSplyChngOff_C "F2523: Power supply switch off stabilization time" VAL_BLK 0x201758 AblGLKWBub_S1 100 TI1_M_CYCLE_S1 0 100 NUMBER 2 FORMAT "%5.1" /end CHARACTERISTIC
/begin CHARACTERISTIC OutPPSplyCtl_tiPSplyChngOn_C "F2523: Power supply switch on stabilization time" VAL_BLK 0x20175A AblGLKWBub_S1 100 TI1_M_CYCLE_S1 0 100 NUMBER 2 FORMAT "%5.1" /end CHARACTERISTIC
/begin CHARACTERISTIC OutPPSplyCtl_tiPSplyPrtSG_C "F2523: Timer start value for HW protection in case of SG" VAL_BLK 0x20175C AblGLKWBub_S1 1250 TI1_M_CYCLE_S1 0 1250 NUMBER 2 FORMAT "%5.0" /end CHARACTERISTIC
/begin CHARACTERISTIC OutPPSplyCtl_uPSplyBattLoHys_C "F2523: Hysteresis for PSply switch off during low battery voltage" VALUE 0x20175E AblGLKWuw_S1 5 U0_001_S1 0 5 FORMAT "%8.6" /end CHARACTERISTIC
/begin CHARACTERISTIC OutPPSplyCtl_uPSplyBattLo_C "F2523: Voltage threshold for PSply switch off during low battery voltage" VALUE 0x201760 AblGLKWuw_S1 25 U0_001_S1 0 25 FORMAT "%8.5" /end CHARACTERISTIC
/begin CHARACTERISTIC OutPPSplyMon_ctPSplyErrOP_C "F2523: threshold for number of low sides with detected error" VAL_BLK 0x201762 AblGLKWBub_S1 255 X1_S1 0 255 NUMBER 2 FORMAT "%5.1" /end CHARACTERISTIC
/begin CHARACTERISTIC OutPPSplyMon_ctPSplyOPEvt_C "F2523: Counter threshold of consecutive PSply OP faults" VAL_BLK 0x201764 AblGLKWBub_S1 255 X1_S1 0 255 NUMBER 2 FORMAT "%5.1" /end CHARACTERISTIC
/begin CHARACTERISTIC OutPPSplyMon_stPSplyErrOP_C "F2523: activation of OP monitoring (B0=OP in mode OP, B1=OP in mode ACTIVE_ON)" VAL_BLK 0x201766 AblGLKWBub_S1 255 X1_S1 0 255 NUMBER 2 FORMAT "%5.1" /end CHARACTERISTIC
/begin CHARACTERISTIC OutPPSplyMon_stPSplyHldDfe_C "F2523: Mask for holding of direct fault entry  [B5=SBDFE, B6=SGDFE, B7=OPDFE, B8=SCDFE]" VALUE 0x201768 AblGLKWuw_S1 65535 X1_S1 0 65535 FORMAT "%8.2" /end CHARACTERISTIC
/begin CHARACTERISTIC OutPPSplyMon_stPSplyOffSG_C "F2523: Monitoring of SG in mode ACTIVE_OFF active (TRUE: active)" VAL_BLK 0x20176A AblGLKWBub_S1 1 B_TRUE_S1 0 1 NUMBER 2 FORMAT "%13.11" /end CHARACTERISTIC
/begin CHARACTERISTIC OutPPSplyMon_stPSplyOpMSC_C "F2523: Monitoring of short circuits between PSply [0=off, 1=on]" VALUE 0x201A1E AblGLKWub_S1 1 X1_S1 0 1 FORMAT "%5.3" /end CHARACTERISTIC
/begin CHARACTERISTIC OutPPSplyMon_stPSplySfrmPSply_C "F2523: Fault bit mask for SFRM check: PSply should switch off [B0=GEN, B1=PLAUS, B2=SB, B3=SG, B4=OP, B5=SBDFE, B6=SGDFE, B7=OPDFE, B8=SCDFE, B9=SC]" VAL_BLK 0x20135C AblGLKWBuw_S1 65535 X1_S1 0 65535 NUMBER 2 FORMAT "%8.2" /end CHARACTERISTIC
/begin CHARACTERISTIC OutPPSplyMon_stPSplyTstCond_C "F2523: Enable test condition [0=off, 1=on; B0=GEN, B1=PLAUS, B2=SB, B3=SG, B4=OP, B5=SBDFE, B6=SGDFE, B7=OPDFE, B8=SCDFE, B9=SC]" VAL_BLK 0x201360 AblGLKWBuw_S1 65535 X1_S1 0 65535 NUMBER 2 FORMAT "%8.2" /end CHARACTERISTIC
/begin CHARACTERISTIC OutPPSplyMon_tiPSplyRngDly_C "F2523: Delay timer for fault detection during mode operation" MAP 0x201A1F AblGLFKFub_S1 100 TI1_M_CYCLE_S1 0 100 FORMAT "%5.1"
 /begin AXIS_DESCR FIX_AXIS OutPPSplyMon_xPSplyDmy X1_S1 3 0 2 FIX_AXIS_PAR 0 0 3 FORMAT "%5.3" /end AXIS_DESCR
 /begin AXIS_DESCR FIX_AXIS OutPPSplyMon_yPSplyDmy X1_S1 3 0 2 FIX_AXIS_PAR 0 0 3 FORMAT "%5.3" /end AXIS_DESCR
/end CHARACTERISTIC
/begin CHARACTERISTIC OutPPSplyMon_tiPSplyRngWait_C "F2523: Wait timer for fault detection during mode operation" MAP 0x201A28 AblGLFKFub_S1 100 TI1_M_CYCLE_S1 0 100 FORMAT "%5.1"
 /begin AXIS_DESCR FIX_AXIS OutPPSplyMon_xPSplyDmy X1_S1 3 0 2 FIX_AXIS_PAR 0 0 3 FORMAT "%5.3" /end AXIS_DESCR
 /begin AXIS_DESCR FIX_AXIS OutPPSplyMon_yPSplyDmy X1_S1 3 0 2 FIX_AXIS_PAR 0 0 3 FORMAT "%5.3" /end AXIS_DESCR
/end CHARACTERISTIC
/begin CHARACTERISTIC OutPPSplyMon_uPSplyDiff_C "F2523: Difference voltage for fault detection" VAL_BLK 0x201364 AblGLKWBuw_S1 5 U0_001_S1 0 5 NUMBER 2 FORMAT "%8.6" /end CHARACTERISTIC
/begin CHARACTERISTIC OutPPSplyMon_uPSplyLimSG_C "F2523: Threshold for SG detection in case of incorrect uBatt" VAL_BLK 0x201368 AblGLKWBuw_S1 5 U0_001_S1 0 5 NUMBER 2 FORMAT "%8.6" /end CHARACTERISTIC
/begin CHARACTERISTIC OutPPSplyMon_uPSplyTstHi_C "F2523: Higher voltage threshold of test condition" VAL_BLK 0x20136C AblGLKWBuw_S1 40 U0_001_S1 0 40 NUMBER 2 FORMAT "%8.5" /end CHARACTERISTIC
/begin CHARACTERISTIC OutPPSplyMon_uPSplyTstLo_C "F2523: Lower voltage threshold of test condition" VAL_BLK 0x201370 AblGLKWBuw_S1 25 U0_001_S1 0 25 NUMBER 2 FORMAT "%8.5" /end CHARACTERISTIC
/begin CHARACTERISTIC OutPPSplyOn_rPSplySB_C "F2523: Threshold for short to battery detection" VAL_BLK 0x201374 AblGLKWBuw_S1 100 R0_1_P_S1 0 100 NUMBER 2 FORMAT "%8.4" /end CHARACTERISTIC
/begin CHARACTERISTIC OutPPSplyOn_uPSplyClsdThres_C "F2523: Difference threshold between uBatt and uPSply" VALUE 0x20176C AblGLKWuw_S1 65.535 U0_001_S1 0 65.535 FORMAT "%8.5" /end CHARACTERISTIC
/begin CHARACTERISTIC OutPPSplyOn_uPSplyOPHi_C "F2523: Voltage threshold for open load detection (High)" VAL_BLK 0x201378 AblGLKWBuw_S1 10 U0_001_S1 0 10 NUMBER 2 FORMAT "%8.5" /end CHARACTERISTIC
/begin CHARACTERISTIC OutPPSplyOn_uPSplyOPLo_C "F2523: Voltage threshold for open load detection (low)" VAL_BLK 0x20137C AblGLKWBuw_S1 10 U0_001_S1 0 10 NUMBER 2 FORMAT "%8.5" /end CHARACTERISTIC
/begin CHARACTERISTIC OutPPSplyOn_uPSplySG_C "F2523: Voltage threshold for short to ground detection" VAL_BLK 0x201380 AblGLKWBuw_S1 3 U0_001_S1 0 3 NUMBER 2 FORMAT "%8.6" /end CHARACTERISTIC
/begin CHARACTERISTIC OutPShCirL3_stSSplyTstCond_C "F2510: Enable test condition [Bit2: SB, Bit3: SG, Bit4: SBRst; 0=Off, 1=On] " VALUE 0x201924 AblGLKWuw_S1 65535 X1_S1 0 65535 FORMAT "%8.2" /end CHARACTERISTIC
/begin CHARACTERISTIC OutPShCirL3_tiLoBatt_C "F2523: Start value of lag counter while battery voltage is too low (used at SSply supplied by low uM2 only)" VALUE 0x201B07 AblGLKWub_S1 300 TI1_M_CYCLE_S1 0 300 FORMAT "%5.1" /end CHARACTERISTIC
/begin CHARACTERISTIC OutPShCirL3_tiMonDly_C "F2510: Adjustable time for the monitoring delay" VALUE 0x201B08 AblGLKWub_S1 100 TI1_M_CYCLE_S1 0 100 FORMAT "%5.1" /end CHARACTERISTIC
/begin CHARACTERISTIC OutPShCirL3_uSSplyAsicLos_C "F2510: Represents the loss of the ASIC which controlled the sensor supply voltage" VALUE 0x201926 AblGLKWuw_S1 0.5 U0_001_S1 0 0.5 FORMAT "%9.7" /end CHARACTERISTIC
/begin CHARACTERISTIC OutPShCirL3_uSSplyDiffSply_C "F2510: Describes how much higher the uSSply needs to detected a short to battery. The data relates to the supply voltage of this voltage." VALUE 0x201928 AblGLKWuw_S1 1 U0_001_S1 0 1 FORMAT "%8.6" /end CHARACTERISTIC
/begin CHARACTERISTIC OutPShCirL3_uSSplySBLoLim_C "F2510: Represents the limit to delete the short circuit plus" VALUE 0x20192A AblGLKWuw_S1 2 U0_001_S1 9.5 11.5 FORMAT "%8.5" /end CHARACTERISTIC
/begin CHARACTERISTIC OutPShCirL3_uSSplySBUpLim_C "F2510: Represents the limit to set the short circuit plus" VALUE 0x20192C AblGLKWuw_S1 6.5 U0_001_S1 9.5 16 FORMAT "%8.5" /end CHARACTERISTIC
/begin CHARACTERISTIC OutPShCirL3_uSSplySGLoLim_C "F2510: Represents the limit to set the short circuit flag" VALUE 0x20192E AblGLKWuw_S1 8.5 U0_001_S1 0 8.5 FORMAT "%8.6" /end CHARACTERISTIC
/begin CHARACTERISTIC OutPShCirL3_uSSplySGUpLim_C "F2510: Represents the limit to delete the short circuit flag" VALUE 0x201930 AblGLKWuw_S1 2 U0_001_S1 7.5 9.5 FORMAT "%8.6" /end CHARACTERISTIC
/begin CHARACTERISTIC OutPShCirL3_uSSplySwtOffLim_C "F2510: If the SSply is off and the voltage is above that limit an error will be detected" VALUE 0x201932 AblGLKWuw_S1 2 U0_001_S1 0 2 FORMAT "%8.6" /end CHARACTERISTIC
/begin CHARACTERISTIC OutPShCirL3_uTstLoBatt_C "F2510: Low battery voltage threshold for general monitoring condition (used at SSply supplied by low uM2 only)" VALUE 0x201934 AblGLKWuw_S1 32 U0_001_S1 0 32 FORMAT "%8.5" /end CHARACTERISTIC
/begin CHARACTERISTIC OutPSSply5Mon_stSSply5TstCond_C "F2511: Enable test condition [B2: SB, B3: SG; 0=Off, 1=On]" VALUE 0x201936 AblGLKWuw_S1 65535 X1_S1 0 65535 FORMAT "%8.2" /end CHARACTERISTIC
/begin CHARACTERISTIC OutPSSply5Mon_uSSply5TstHi_C "F2511: Upper voltage threshold of test condition" VALUE 0x201938 AblGLKWuw_S1 32 U0_001_S1 0 32 FORMAT "%8.5" /end CHARACTERISTIC
/begin CHARACTERISTIC OutPSSply5Mon_uSSply5TstLo_C "F2511: Lower voltage threshold of test condition" VALUE 0x20193A AblGLKWuw_S1 32 U0_001_S1 0 32 FORMAT "%8.5" /end CHARACTERISTIC
/begin CHARACTERISTIC OutPSSply5Mon_uSSply5TstSB_C "F2511: Voltage threshold for short to battery detection" VALUE 0x20193C AblGLKWuw_S1 10 U0_001_S1 5 15 FORMAT "%8.5" /end CHARACTERISTIC
/begin CHARACTERISTIC OutPSSply5Mon_uSSply5TstSG_C "F2511: Voltage threshold for short to ground detection" VALUE 0x20193E AblGLKWuw_S1 5 U0_001_S1 0 5 FORMAT "%8.6" /end CHARACTERISTIC
/begin CHARACTERISTIC OutPStlkIn_stStlkSelSply_C "F2550: Selection for Stlk supply [-2=T30, -1=T15]" VALUE 0x201B09 AblGLKWsb_S1 1 X1_S1 -2 -1 FORMAT "%5.3" /end CHARACTERISTIC
/begin CHARACTERISTIC OutPStlkIn_tiStlkOff_C "F2550: Monitoring delay if the starter lock state changes from on to off" VALUE 0x201940 AblGLKWuw_S1 327675 TI1_M_CYCLE_S1 0 327675 FORMAT "%8.1" /end CHARACTERISTIC
/begin CHARACTERISTIC OutPStlkIn_tiStlkOn_C "F2550: Monitoring delay if the starter lock state changes from off to on" VALUE 0x201B0A AblGLKWub_S1 1275 TI1_M_CYCLE_S1 0 1275 FORMAT "%5.0" /end CHARACTERISTIC
/begin CHARACTERISTIC OutPStlkIn_uStlkStrtJmp_C "F2550: Read back voltage jump of the starter lock signal" VALUE 0x201942 AblGLKWuw_S1 32 U0_001_S1 0 32 FORMAT "%8.5" /end CHARACTERISTIC
/begin CHARACTERISTIC OutPStlkMon_stStlkSelSwt_C "F2550: Selection status to use Stlk as low or high side switch [0=Lss, 1=Hss]" VALUE 0x201B0B AblGLKWub_S1 1 X1_S1 0 1 FORMAT "%5.3" /end CHARACTERISTIC
/begin CHARACTERISTIC OutPStlkMon_stStlkTstCond_C "F2550: Enable test condition [B2: SB, B3: SG, B8: LO, B9: HI; 0=Off, 1=On]" VALUE 0x201944 AblGLKWuw_S1 65535 X1_S1 0 65535 FORMAT "%8.2" /end CHARACTERISTIC
/begin CHARACTERISTIC OutPStlkMon_uStlkTstLo_C "F2550: Lower voltage threshold of test condition" VALUE 0x201946 AblGLKWuw_S1 14 U0_001_S1 0 14 FORMAT "%8.5" /end CHARACTERISTIC
/begin CHARACTERISTIC OutPStlkMon_uStlkTstSB_C "F2550: Voltage threshold for short to battery detection" VALUE 0x201948 AblGLKWuw_S1 13 U0_001_S1 1 14 FORMAT "%8.5" /end CHARACTERISTIC
/begin CHARACTERISTIC OutPStlkMon_uStlkTstSG_C "F2550: Voltage threshold for short to ground detection" VALUE 0x20194A AblGLKWuw_S1 5 U0_001_S1 0 5 FORMAT "%8.6" /end CHARACTERISTIC
/begin CHARACTERISTIC OutPStlkOut_bStlkCtl_C "F2550: Enable starter lock control via interface [0=Off, 1=On]" VALUE 0x20199D AblGLKWub_S1 1 X1_S1 0 1 FORMAT "%5.3" /end CHARACTERISTIC
/begin CHARACTERISTIC OutPStlkOut_tiStlkCtl_C "F2550: Start value of timer in which the starter lock signal is hold on its value" VALUE 0x201576 AblGLKWuw_S1 327675 TI1_M_CYCLE_S1 0 327675 FORMAT "%8.1" /end CHARACTERISTIC
/begin CHARACTERISTIC OutPStlkOut_tiStlkHwAck_C "F2550: Start value for delay timer untill the HW has acknowledged the control signal" VALUE 0x201578 AblGLKWuw_S1 327675 TI1_M_CYCLE_S1 0 327675 FORMAT "%8.1" /end CHARACTERISTIC
/begin CHARACTERISTIC PFCIni_stChkPntEnd_C "F6100: definition of the last check point" VALUE 0x201953 AblGLKWub_S1 255 X1_S1 0 255 FORMAT "%5.1" /end CHARACTERISTIC
/begin CHARACTERISTIC RLim_numLimThres_C "F6260: Threshold for the reset counter to limit the system functionality (no SERAP)" VALUE 0x200580 AblGLKWul_S1 11 X1_S1 4 15 FORMAT "%13.10" /end CHARACTERISTIC
/begin CHARACTERISTIC RLim_swtClrMode_C "F6260: Switch to change the clearing behaviour of the reset counter (0=reset to 0, otherwise=decrement by 1) (no SERAP)" VALUE 0x2019CB AblGLKWub_S1 255 X1_S1 0 255 FORMAT "%5.1" /end CHARACTERISTIC
/begin CHARACTERISTIC RLim_swtClrShOffEnbl_C "F6260: Switch to enable the clearing of the reset counter before system shutdown (0=hold counter, otherwise=clear counter) (no SERAP)" VALUE 0x2019CC AblGLKWub_S1 255 X1_S1 0 255 FORMAT "%5.1" /end CHARACTERISTIC
/begin CHARACTERISTIC RLim_swtLimFeatDisbl_C "F6260: Switch to disable the feature to limit the system functionality (0xA5=limitation feature disable, otherwise=limitation feature enabled) (no SERAP)" VALUE 0x2019CD AblGLKWub_S1 255 X1_S1 0 255 FORMAT "%5.1" /end CHARACTERISTIC
/begin CHARACTERISTIC SFRM_CC08_bTolSprdcFault_C "F6250: SFRM configuration bitfield for tolerate sporadic faults (no SERAP)" VALUE 0x20177C AblGLKWuw_S1 65535 X1_S1 0 65535 FORMAT "%8.2" /end CHARACTERISTIC
/begin CHARACTERISTIC SFRM_GMO_bTolSprdcFault_C "F6250: SFRM configuration bitfield for tolerate sporadic faults (no SERAP)" VALUE 0x20177E AblGLKWuw_S1 65535 X1_S1 0 65535 FORMAT "%8.2" /end CHARACTERISTIC
/begin CHARACTERISTIC SFRM_LSS_bTolSprdcFault_C "F6250: SFRM configuration bitfield for tolerate sporadic faults (no SERAP)" VALUE 0x201780 AblGLKWuw_S1 65535 X1_S1 0 65535 FORMAT "%8.2" /end CHARACTERISTIC
/begin CHARACTERISTIC SFRM_PSPLY_bTolSprdcFault_C "F6250: SFRM configuration bitfield for tolerate sporadic faults (no SERAP)" VALUE 0x201782 AblGLKWuw_S1 65535 X1_S1 0 65535 FORMAT "%8.2" /end CHARACTERISTIC
/begin CHARACTERISTIC SFRM_SAF_bTolSprdcFault_C "F6250: SFRM configuration bitfield for tolerate sporadic faults (no SERAP)" VALUE 0x201784 AblGLKWuw_S1 65535 X1_S1 0 65535 FORMAT "%8.2" /end CHARACTERISTIC
/begin CHARACTERISTIC SFRM_swtSrv_C "F6250: SFRM service switch (0x5A = not active, all other values = active)" VALUE 0x201A3E AblGLKWub_S1 255 X1_S1 0 255 FORMAT "%5.1" /end CHARACTERISTIC
/begin CHARACTERISTIC SFRM_tiFailLtcyTCC08_C "F6250: SFRM configuration failure latency time for CC08 in ms (no SERAP)" VAL_BLK 0x201786 AblGLKWBub_S1 1275 TI1_M_CYCLE_S1 0 1275 NUMBER 10 FORMAT "%5.0" /end CHARACTERISTIC
/begin CHARACTERISTIC SFRM_tiFailLtcyTDFE_C "F6250: SFRM configuration failure latency time for direct-fault-entry in ms" VALUE 0x201A3F AblGLKWub_S1 50 TI1_M_CYCLE_S1 0 50 FORMAT "%5.2" /end CHARACTERISTIC
/begin CHARACTERISTIC SFRM_tiFailLtcyTGMO_C "F6250: SFRM configuration failure latency time for GMO in ms (no SERAP)" VAL_BLK 0x201A38 AblGLKWBub_S1 1275 TI1_M_CYCLE_S1 0 1275 NUMBER 1 FORMAT "%5.0" /end CHARACTERISTIC
/begin CHARACTERISTIC SFRM_tiFailLtcyTLSS_C "F6250: SFRM configuration failure latency time for LSS in ms (no SERAP)" VAL_BLK 0x201A39 AblGLKWBub_S1 1275 TI1_M_CYCLE_S1 0 1275 NUMBER 5 FORMAT "%5.0" /end CHARACTERISTIC
/begin CHARACTERISTIC SFRM_tiFailLtcyTPSPLY_C "F6250: SFRM configuration failure latency time for power supply in ms (no SERAP)" VAL_BLK 0x201790 AblGLKWBub_S1 1275 TI1_M_CYCLE_S1 0 1275 NUMBER 2 FORMAT "%5.0" /end CHARACTERISTIC
/begin CHARACTERISTIC SFRM_tiFailLtcyTSAF_C "F6250: SFRM configuration failure latency time for SAF in ms (no SERAP)" VAL_BLK 0x201384 AblGLKWBub_S1 1275 TI1_M_CYCLE_S1 0 1275 NUMBER 4 FORMAT "%5.0" /end CHARACTERISTIC
/begin CHARACTERISTIC ShrCal_ActvIC2OnFcc_C "F9110: Activate InCircuit2 on FCC-Devices [0xAA: IC2 active; others: IC2 inactive;] (no SERAP)" VALUE 0x2019E3 AblGLKWub_S1 255 X1_S1 0 255 FORMAT "%5.1" /end CHARACTERISTIC
/begin CHARACTERISTIC ShrCal_SlctSeramMth_C "F9110: Select SERAM calibration method [0x2: CCP; 0x4: XCP; other values not allowed!] (no SERAP)" VALUE 0x2019E4 AblGLKWub_S1 4 X1_S1 0 4 FORMAT "%5.3" /end CHARACTERISTIC
/begin CHARACTERISTIC ShrSrv_bDsmRdyByp_C "F9110: Ignore customer DSM ready status [0=no, others=DSM permanently ready] (no SERAP)" VALUE 0x201998 AblGLKWub_S1 1 B_TRUE_S1 0 1 FORMAT "%13.11" /end CHARACTERISTIC
/begin CHARACTERISTIC SrvShr_facTipInfoHigh_C "F9120: signal is considered plausible if 1/threshold <= Thigh_new/Thigh_old <= threshold (no SERAP)" VALUE 0x200450 AblGLKWr32_S1 0.2 X1_S1 0.9 1.1 FORMAT "%10.8" /end CHARACTERISTIC
/begin CHARACTERISTIC SrvShr_facTipInfoMul_C "F9120: signal is considered plausible if 1/threshold <= Tlow_new/Thigh*num <= threshold (no SERAP)" VALUE 0x200454 AblGLKWr32_S1 0.2 X1_S1 0.9 1.1 FORMAT "%10.8" /end CHARACTERISTIC
/begin CHARACTERISTIC SrvShr_rTrqMax_C "F9120: maximum value for PWM ratio" VALUE 0x2015A0 AblGLKWuw_S1 100 R0_1_P_S1 0 100 FORMAT "%8.4" /end CHARACTERISTIC
/begin CHARACTERISTIC SrvShr_rTrqMin_C "F9120: minimum value for PWM ratio" VALUE 0x2015A2 AblGLKWuw_S1 100 R0_1_P_S1 0 100 FORMAT "%8.4" /end CHARACTERISTIC
/begin CHARACTERISTIC SrvShr_rTrqOff_C "F9120: reported value in case PWM ratio measurement is deactivated (no SERAP)" VALUE 0x20159E AblGLKWuw_S1 100 R0_1_P_S1 0 100 FORMAT "%8.4" /end CHARACTERISTIC
/begin CHARACTERISTIC SrvShr_stSdnWakFilt_C "F9140: bitmask for Wake=low detection (number of program cycles) (valid-values=0x1,0x3,0x7,0xF,0x1F,0x3F,0x7F,0xFF,0x1FF,0x3FF,0x7FF,0xFFF,0x1FFF,0x3FFF,0x7FFF,0xFFFF)" VALUE 0x201574 AblGLKWuw_S1 65535 X1_S1 0 65535 FORMAT "%8.2" /end CHARACTERISTIC
/begin CHARACTERISTIC SrvShr_stTapAnaEval_C "F9120: TapAnalog status assignment for each voltage area (B0:SG,B1:SB,B2:OP,B3:PLAUS,B8:TapPlus,B9:TapMinus,B10:unchanged) (no SERAP)" VAL_BLK 0x2005AC AblGLKWBuw_S1 65535 X1_S1 0 65535 NUMBER 16 FORMAT "%8.2" /end CHARACTERISTIC
/begin CHARACTERISTIC SrvShr_swtTrqOn_C "F9120: activation switch for (FALSE=off, TRUE=on)" VALUE 0x2015A4 AblGLKWuw_S1 1 B_TRUE_S1 0 1 FORMAT "%13.11" /end CHARACTERISTIC
/begin CHARACTERISTIC SrvShr_tiSSplyExtChk_C "F9120: timer to detect simultaneous fault in connected sensors" VALUE 0x2019E2 AblGLKWub_S1 1275 TI1_M_CYCLE_S1 0 1275 FORMAT "%5.0" /end CHARACTERISTIC
/begin CHARACTERISTIC SrvShr_tiTapAnaRngStb_C "F9120: Reload value for analog Tap range not changed timer: SrvShr_tiTapAnaRngStb. If reached: SrvShr_idxTapAnaRngUse = SrvShr_idxTapAnaRng (no SERAP)" VALUE 0x2019E1 AblGLKWub_S1 1275 TI1_M_CYCLE_S1 0 1275 FORMAT "%5.0" /end CHARACTERISTIC
/begin CHARACTERISTIC SrvShr_tiTipInfoHigh_C "F9120: Timing limits for Tip-Info-High Duration (idx0=low-limit, idx1=high-limit) (no SERAP)" VAL_BLK 0x200458 AblGLKWBuw_S1 10000 TI1_U_S1 1000 11000 NUMBER 2 FORMAT "%8.2" /end CHARACTERISTIC
/begin CHARACTERISTIC SrvShr_tiTipInfoMeas_C "F9120: Measurement period for MIN/MAX value (0=infinite) (no SERAP)" VALUE 0x201572 AblGLKWuw_S1 6553.5 TI1_CYCLE_S1 0 6553.5 FORMAT "%8.3" /end CHARACTERISTIC
/begin CHARACTERISTIC SrvShr_tiTrqPerMax_C "F9120: maximum period acceptable for PWM ratio measurement" VALUE 0x2015A6 AblGLKWuw_S1 16.3828 TI0_00025_M_S1 0.001 16.38375 FORMAT "%8.5" /end CHARACTERISTIC
/begin CHARACTERISTIC SrvShr_tiTrqPerMin_C "F9120: minimum period acceptable for PWM ratio measurement" VALUE 0x2015A8 AblGLKWuw_S1 16.3828 TI0_00025_M_S1 0.001 16.38375 FORMAT "%8.5" /end CHARACTERISTIC
/begin CHARACTERISTIC SrvShr_tSubsChpOfs_C "F9120: Temperature offset for the ATF substitution by CHP - MUST have the same value as InpPAtfL3_tSubsChpOfs_C!" VALUE 0x20194C AblGLKWsw_S1 100 T0_0625_S1 -50 50 FORMAT "%8.5" /end CHARACTERISTIC
/begin CHARACTERISTIC SrvShr_uIn0ThresHigh_C "F9120: Digitalization threshold of IN0 line (higher voltage ->off) (no SERAP)" VALUE 0x2017D2 AblGLKWuw_S1 25 U0_001_S1 0 25 FORMAT "%8.5" /end CHARACTERISTIC
/begin CHARACTERISTIC SrvShr_uIn0ThresLow_C "F9120: Digitalization threshold of IN0 line (lower voltage ->on) (no SERAP)" VALUE 0x2017D4 AblGLKWuw_S1 25 U0_001_S1 0 25 FORMAT "%8.5" /end CHARACTERISTIC
/begin CHARACTERISTIC SrvShr_uTapAnaEval_C "F9120: TapAnalog threshold for status area evaluation (compared to SrvShr_uTapAna) -> status bytes in SrvShr_stTapAnaEval_C (no SERAP)" VAL_BLK 0x2015BC AblGLKWBuw_S1 25 U0_001_S1 0 25 NUMBER 15 FORMAT "%8.5" /end CHARACTERISTIC
/begin CHARACTERISTIC SrvShr_uTapMinusThresHigh_C "F9120: Digitalization threshold of TapMinus line (higher voltage ->off) (no SERAP)" VALUE 0x2017D6 AblGLKWuw_S1 25 U0_001_S1 0 25 FORMAT "%8.5" /end CHARACTERISTIC
/begin CHARACTERISTIC SrvShr_uTapMinusThresLow_C "F9120: Digitalization threshold of TapMinus line (lower voltage ->on) (no SERAP)" VALUE 0x2017D8 AblGLKWuw_S1 25 U0_001_S1 0 25 FORMAT "%8.5" /end CHARACTERISTIC
/begin CHARACTERISTIC SrvShr_uTapPlusThresHigh_C "F9120: Digitalization threshold of TapPlus line (higher voltage ->off) (no SERAP)" VALUE 0x2017DA AblGLKWuw_S1 25 U0_001_S1 0 25 FORMAT "%8.5" /end CHARACTERISTIC
/begin CHARACTERISTIC SrvShr_uTapPlusThresLow_C "F9120: Digitalization threshold of TapPlus line (lower voltage ->on) (no SERAP)" VALUE 0x2017DC AblGLKWuw_S1 25 U0_001_S1 0 25 FORMAT "%8.5" /end CHARACTERISTIC
/begin CHARACTERISTIC SWI_SET_PIN "F9140: selection which SW partner has access to the debug pins (1=HWL,2=SYS,3-8=ZF,9=OEM)" VALUE 0x201999 AblGLKWub_S1 255 X1_S1 0 255 FORMAT "%5.1" /end CHARACTERISTIC
/begin CHARACTERISTIC WdIpt_numTOutTolc_C "F6200: Timeout tolerance value (measured in active process execution cycles)" VALUE 0x201B0E AblGLKWub_S1 5 X1_S1 0 5 FORMAT "%5.3" /end CHARACTERISTIC
/begin CHARACTERISTIC WdMnExtd_stWdStatsClr_C "F6200: Switch to clear the statistic watchdog (IWD and WDT) data (value has to change from 1 to 2 to initiate the clearing up)" VALUE 0x201A40 AblGLKWub_S1 2 X1_S1 0 2 FORMAT "%5.3" /end CHARACTERISTIC
/begin CHARACTERISTIC WdTskMon_numTskExe_C "F6200: Number of base task executions during the monitoring time (no SERAP)" VALUE 0x201B0F AblGLKWub_S1 49 X1_S1 1 50 FORMAT "%5.2" /end CHARACTERISTIC
/begin CHARACTERISTIC WdTskMon_tiTskMonT_C "F6200: Monitoring time of the base task monitoring (no SERAP)" VALUE 0x2014FC AblGLKWul_S1 4.29497E+009 TI1_U_S1 0 4294967295 FORMAT "%13.2" /end CHARACTERISTIC
/begin MEASUREMENT CPUID_stChip "F2635: CPU info: B0:emul,B23:0=150nm,1=90nm, B5:old-EE, B7:missing-ID" UBYTE X1_S1 1 100 0 255 FORMAT "%5.1" ECU_ADDRESS 0xFFF95C29 /end MEASUREMENT
/begin MEASUREMENT CPUID_stSize "F2635: CPU size info: B01:RAM 0=64k,1=128k,2=176k,3=256k, B23:0=CAN-AB,1=ABC,2=ABCD, B45:ROM 0=1-2MB,1=2-3MB,2=3-4MB, B6:Flexr B7:EE 0=4*8k,1=16*8k" UBYTE X1_S1 1 100 0 255 FORMAT "%5.1" ECU_ADDRESS 0xFFF95C2A /end MEASUREMENT
/begin MEASUREMENT CPU_bPbusClk "F2635: P-Bus Clock setting (0=20MHz, 1=40MHz)" UBYTE X1_S1 1 100 0 255 FORMAT "%5.1" ECU_ADDRESS 0xFFF95C2C /end MEASUREMENT
/begin MEASUREMENT CPU_numSel "F2635: CPU variant information: 0=undef 1=SH7251x (150nm), 2=SH7254x (90nm)" UBYTE X1_S1 1 100 0 255 FORMAT "%5.1" ECU_ADDRESS 0xFFF95C2B /end MEASUREMENT
/begin MEASUREMENT Cpu_stChkCfgReg "F2655: CPU register configuration check status (B0=performed, B1-B31:error bits)" ULONG X1_S1 1 100 0 4294967295 FORMAT "%13.2" ECU_ADDRESS 0xFFF95BFC /end MEASUREMENT
/begin MEASUREMENT DSM_ERR_ctEntry "F3500: Number of entries in buffer" UBYTE X1_S1 1 100 0 20 FORMAT "%5.2" ECU_ADDRESS 0xFFF9548A /end MEASUREMENT
/begin MEASUREMENT DSM_ERR_ctErr "F3500: Error counter" UWORD X1_S1 1 100 0 65535 FORMAT "%8.2" ARRAY_SIZE 20 ECU_ADDRESS 0xFFF95DB8 /end MEASUREMENT
/begin MEASUREMENT DSM_ERR_numFctId "F3500: Function identification number" ULONG X1_S1 1 100 0 4294967295 FORMAT "%13.2" ARRAY_SIZE 20 ECU_ADDRESS 0xFFF95DE0 /end MEASUREMENT
/begin MEASUREMENT DSM_ERR_stErr "F3500: Error indication bits" UWORD X1_S1 1 100 0 65535 FORMAT "%8.2" ARRAY_SIZE 20 ECU_ADDRESS 0xFFF95E30 /end MEASUREMENT
/begin MEASUREMENT ECC_RAM_adEccErr "F2755: Last ECC-RAM error address which has reported an error (32bit aligned)" ULONG X1_S1 1 100 0 4294967295 FORMAT "%13.2" ECU_ADDRESS 0xFFF95A50 /end MEASUREMENT
/begin MEASUREMENT ECC_RAM_numEccErr "F2755: number of registered bit ECC-error corrections per observation period - if this number exceeds threshold a resed occurs" ULONG X1_S1 1 100 0 4294967295 FORMAT "%13.2" ECU_ADDRESS 0xFFF80C80 /end MEASUREMENT
/begin MEASUREMENT ECC_RAM_stEccTst "F2755: last memorized ECC-Test status B0-3: (2 = Test was not executed, 1 = Test was passed,0=Test was executed and failed) B4-7: alive counter " UBYTE X1_S1 1 100 0 255 FORMAT "%5.1" ECU_ADDRESS 0xFFF95C3F /end MEASUREMENT
/begin MEASUREMENT ECC_ROM_stEccTst "F2755: last memorized ECC-Test status B0-3: (2 = Test was not executed, 1 = Test was passed,0=Test was executed and failed) B4-7: alive counter " UBYTE X1_S1 1 100 0 255 FORMAT "%5.1" ECU_ADDRESS 0xFFF95C40 /end MEASUREMENT
/begin MEASUREMENT EELLD_Status_s.stMode_u8 "F2741: EELLD status details / " UBYTE X1_S1 1 100 0 255 FORMAT "%5.1" ECU_ADDRESS 0xFFF95B6C /end MEASUREMENT
/begin MEASUREMENT EELLD_Status_s.stOp_u8 "F2741: EELLD status details / " UBYTE X1_S1 1 100 0 255 FORMAT "%5.1" ECU_ADDRESS 0xFFF95B6D /end MEASUREMENT
/begin MEASUREMENT EELLD_Status_s.stReq_u8 "F2741: EELLD status details / " UBYTE X1_S1 1 100 0 255 FORMAT "%5.1" ECU_ADDRESS 0xFFF95B6E /end MEASUREMENT
/begin MEASUREMENT EELLD_Status_s.stSuspReq_u8 "F2741: EELLD status details / " UBYTE X1_S1 1 100 0 255 FORMAT "%5.1" ECU_ADDRESS 0xFFF95B6F /end MEASUREMENT
/begin MEASUREMENT EELLD_Status_s.numSec_u8 "F2741: EELLD status details / " UBYTE X1_S1 1 100 0 255 FORMAT "%5.1" ECU_ADDRESS 0xFFF95B70 /end MEASUREMENT
/begin MEASUREMENT EELLD_Status_s.numSize_u8 "F2741: EELLD status details / " UBYTE X1_S1 1 100 0 255 FORMAT "%5.1" ECU_ADDRESS 0xFFF95B71 /end MEASUREMENT
/begin MEASUREMENT EELLD_Status_s.numOffs_u16 "F2741: EELLD status details / " UWORD X1_S1 1 100 0 65535 FORMAT "%8.2" ECU_ADDRESS 0xFFF95B72 /end MEASUREMENT
/begin MEASUREMENT EELLD_Status_s.ctErr_u16 "F2741: EELLD status details / " UWORD X1_S1 1 100 0 65535 FORMAT "%8.2" ECU_ADDRESS 0xFFF95B74 /end MEASUREMENT
/begin MEASUREMENT EELLD_Status_s.reserved "F2741: EELLD status details / " UWORD X1_S1 1 100 0 65535 FORMAT "%8.2" ECU_ADDRESS 0xFFF95B76 /end MEASUREMENT
/begin MEASUREMENT EELLD_Status_s.adOp_u32 "F2741: EELLD status details / " ULONG X1_S1 1 100 0 4294967295 FORMAT "%13.2" ECU_ADDRESS 0xFFF95B78 /end MEASUREMENT
/begin MEASUREMENT FCU_numFirmware "F2742: Firmware version information - ASCII-representation (3 digit)" ULONG X1_S1 1 100 0 4294967295 FORMAT "%13.2" ECU_ADDRESS 0xFFF95B50 /end MEASUREMENT
/begin MEASUREMENT FCU_s.state "F2742: FCU status details / " UBYTE X1_S1 1 100 0 255 FORMAT "%5.1" ECU_ADDRESS 0xFFF95B3C /end MEASUREMENT
/begin MEASUREMENT FCU_s.stReq "F2742: FCU status details / " UBYTE X1_S1 1 100 0 255 FORMAT "%5.1" ECU_ADDRESS 0xFFF95B3D /end MEASUREMENT
/begin MEASUREMENT FCU_s.ctOff "F2742: FCU status details / " UBYTE X1_S1 1 100 0 255 FORMAT "%5.1" ECU_ADDRESS 0xFFF95B3E /end MEASUREMENT
/begin MEASUREMENT FCU_s.stInit "F2742: FCU status details / " UBYTE X1_S1 1 100 0 255 FORMAT "%5.1" ECU_ADDRESS 0xFFF95B3F /end MEASUREMENT
/begin MEASUREMENT FCU_s.ctCpy "F2742: FCU status details / " UWORD X1_S1 1 100 0 65535 FORMAT "%8.2" ECU_ADDRESS 0xFFF95B40 /end MEASUREMENT
/begin MEASUREMENT FCU_s.stErrDetail "F2742: FCU status details / " UBYTE X1_S1 1 100 0 255 FORMAT "%5.1" ECU_ADDRESS 0xFFF95B42 /end MEASUREMENT
/begin MEASUREMENT FCU_s.reserved "F2742: FCU status details / " UBYTE X1_S1 1 100 0 255 FORMAT "%5.1" ECU_ADDRESS 0xFFF95B43 /end MEASUREMENT
/begin MEASUREMENT GmoHot_qtAct "F3010: Status of temperature sensors (0:INI,1:OK,2:ERROR)" UBYTE X1_S1 1 100 0 255 FORMAT "%5.1" ECU_ADDRESS 0xFFF955FC /end MEASUREMENT
/begin MEASUREMENT GmoHot_stFault "F3010: Errortypes of hot shutdown function" UWORD X1_S1 1 100 0 65535 FORMAT "%8.2" ECU_ADDRESS 0xFFF95008 /end MEASUREMENT
/begin MEASUREMENT GmoHot_stHot "F3010: Internal state of hot shutdown function" UBYTE X1_S1 1 100 0 255 FORMAT "%5.1" ECU_ADDRESS 0xFFF955FD /end MEASUREMENT
/begin MEASUREMENT GmoHot_stHotExt "F3010: Current state of hot shutdown function (0:INI,1:NORMAL,2:HOT)" UBYTE X1_S1 1 100 0 255 FORMAT "%5.1" ECU_ADDRESS 0xFFF955FE /end MEASUREMENT
/begin MEASUREMENT GmoHot_stTstCond "F3010: Testconditions of hot shutdown function" UWORD X1_S1 1 100 0 65535 FORMAT "%8.2" ECU_ADDRESS 0xFFF9500A /end MEASUREMENT
/begin MEASUREMENT GmoHot_tAct "F3010: Actual temperature with tolerance" SWORD T0_0625_S1 1 100 -2048 2047.938 FORMAT "%8.3" ECU_ADDRESS 0xFFF9500C /end MEASUREMENT
/begin MEASUREMENT GmoHot_tiAtfDly "F3010: Delay timer for ATF sensor initialization" UWORD TI1_M_CYCLE_S1 1 100 0 65535 FORMAT "%8.2" ECU_ADDRESS 0xFFF95C8E /end MEASUREMENT
/begin MEASUREMENT GmoHot_tiGenDly "F3010: General timer for hot shutdown functionality" UWORD TI1_M_CYCLE_S1 1 100 0 65535 FORMAT "%8.2" ECU_ADDRESS 0xFFF95C90 /end MEASUREMENT
/begin MEASUREMENT GmoHot_tLim "F3010: Shutdown temperature limit" SWORD T0_0625_S1 1 100 -2048 2047.938 FORMAT "%8.3" ECU_ADDRESS 0xFFF9500E /end MEASUREMENT
/begin MEASUREMENT GmoHot_uBatt "F3010: Battery voltage used for calc. hot shutdown limit" SWORD U0_001_S1 1 100 0 32 FORMAT "%8.5" ECU_ADDRESS 0xFFF95010 /end MEASUREMENT
/begin MEASUREMENT GmoHot_uM3 "F3010: M3 voltage used for calc. hot shutdown limit" SWORD U0_001_S1 1 100 0 32 FORMAT "%8.5" ECU_ADDRESS 0xFFF95012 /end MEASUREMENT
/begin MEASUREMENT GmoHot_xReqSwtOffPs "F3010: Request switch-off power stages (0xA5 = switch-off request enabled, 0x5A = switch-off request disabled)" UBYTE X1_S1 1 100 0 255 FORMAT "%5.1" ECU_ADDRESS 0xFFF84D20 /end MEASUREMENT
/begin MEASUREMENT Gmo_Rst_st "F3040: Status of information collecting about reset" UBYTE X1_S1 1 100 0 255 FORMAT "%5.1" ECU_ADDRESS 0xFFF955FF /end MEASUREMENT
/begin MEASUREMENT Gmo_Rst_stFaultSup "F3040: Fault status of supplier error" UWORD X1_S1 1 100 0 65535 FORMAT "%8.2" ECU_ADDRESS 0xFFF95014 /end MEASUREMENT
/begin MEASUREMENT Gmo_Rst_stRstMrkStrtUp "F3040: Status of reset marker during start-up (TRUE = Reset marker was set during last start-up)" UBYTE B_TRUE_S1 1 100 0 1 FORMAT "%13.11" ECU_ADDRESS 0xFFF95600 /end MEASUREMENT
/begin MEASUREMENT Gmo_Rst_stTstCondSup "F3040: Test conditions of supplier fault" UWORD X1_S1 1 100 0 65535 FORMAT "%8.2" ECU_ADDRESS 0xFFF95016 /end MEASUREMENT
/begin MEASUREMENT Lvl2Mon_idxFaultBuf "F6050: Pointer to the next free element of the level 2 fault ring buffer" UBYTE X1_S1 1 100 0 255 FORMAT "%5.1" ECU_ADDRESS 0xFFF95EC9 /end MEASUREMENT
/begin MEASUREMENT Lvl2Mon_stLvl2Fault "F6050: Display of level 2 faults (bitcoded)" ULONG X1_S1 1 100 0 4294967295 FORMAT "%13.2" ECU_ADDRESS 0xFFF96338 /end MEASUREMENT
/begin MEASUREMENT Lvl2Mon_xFaultBufLvl2Id_a "F6050: ID of the fault reporting level 2 function" ULONG X1_S1 1 100 0 4294967295 FORMAT "%13.2" ARRAY_SIZE 5 ECU_ADDRESS 0xFFF95E90 /end MEASUREMENT
/begin MEASUREMENT Lvl2Mon_xFaultBufLvl2Info_a "F6050: Internal additional information about the level 2 fault (optional)" UBYTE X1_S1 1 100 0 255 FORMAT "%5.1" ARRAY_SIZE 5 ECU_ADDRESS 0xFFF95ECA /end MEASUREMENT
/begin MEASUREMENT MCorAdc_ctErr "F6020: Error counter" UBYTE X1_S1 1 100 0 255 FORMAT "%5.1" ECU_ADDRESS 0xFFF9642F /end MEASUREMENT
/begin MEASUREMENT MCorAdc_efADCTst "F6020: Indicate a current error is present" UBYTE B_TRUE_S1 1 100 0 1 FORMAT "%13.11" ECU_ADDRESS 0xFFF954B1 /end MEASUREMENT
/begin MEASUREMENT MCorAdc_stAdcFault "F6020: status MCor ADC test (Bit0=Vasic out of range, Bit1=VDD3 difference out of range, Bit2=VDD3 out of range, Bit3=diagnostic channel out of range)" UBYTE X1_S1 1 100 0 255 FORMAT "%5.1" ECU_ADDRESS 0xFFF955FA /end MEASUREMENT
/begin MEASUREMENT MCorMmm_ctErrEcc "F6040: Error counter Ecc Core Monitor" UBYTE X1_S1 1 100 0 255 FORMAT "%5.1" ECU_ADDRESS 0xFFF96430 /end MEASUREMENT
/begin MEASUREMENT MCorMmm_ctErrReg "F6040: Error counter register Core Monitor" UBYTE X1_S1 1 100 0 255 FORMAT "%5.1" ECU_ADDRESS 0xFFF96431 /end MEASUREMENT
/begin MEASUREMENT MCorMmm_stEccFault "F6040: status Ecc test (BIT0: test completed after last call;BIT1: RAM-ECC-Test failed;BIT2: RAM-ECC-Interrupt-Test failed; BIT4: ROM-ECC-Test failed)" UBYTE X1_S1 1 100 0 255 FORMAT "%5.1" ECU_ADDRESS 0xFFF80D2A /end MEASUREMENT
/begin MEASUREMENT MCorMmm_stRegFault "F6040: status register test (0:test not yet performed;1:test passed successfully; others: error information available in Bits 1 to 31)" ULONG X1_S1 1 100 0 4294967295 FORMAT "%13.2" ECU_ADDRESS 0xFFF80D00 /end MEASUREMENT
/begin MEASUREMENT MCorSpi_bErrFlg "F6030: Indicator for current SPI error" UBYTE B_TRUE_S1 1 100 0 1 FORMAT "%13.11" ECU_ADDRESS 0xFFF80D2B /end MEASUREMENT
/begin MEASUREMENT MCorSpi_ctErr "F6030: Error counter SPI Core Monitor" UBYTE X1_S1 1 100 0 255 FORMAT "%5.1" ECU_ADDRESS 0xFFF96432 /end MEASUREMENT
/begin MEASUREMENT MCor_ctCorTst "F6010: Choice counter for core test part (0-15)" UBYTE X1_S1 1 100 0 255 FORMAT "%5.1" ECU_ADDRESS 0xFFF9642E /end MEASUREMENT
/begin MEASUREMENT MCor_stIntMCorFault "F6010: Internal fault at WD partial response (Bit0=coretest, Bit1=ECC Test, Bit2=MISR test)" UBYTE X1_S1 1 100 0 255 FORMAT "%5.1" ECU_ADDRESS 0xFFF80D29 /end MEASUREMENT
/begin MEASUREMENT MCor_stMCorFault "F6010: Core monitor faults (Bit0=ADC test, Bit1=Level 2 monitor, Bit2=SPI test, Bit3=ECC test, Bit4=configuration register check, Bit5=switch battery voltage)" UWORD X1_S1 1 100 0 65535 FORMAT "%8.2" ECU_ADDRESS 0xFFF96406 /end MEASUREMENT
/begin MEASUREMENT MCor_xWdPartResp "F6010: WD partial response core monitor module" ULONG X1_S1 1 100 0 4294967295 FORMAT "%13.2" ECU_ADDRESS 0xFFF94A08 /end MEASUREMENT
/begin MEASUREMENT OutMCrntFdbk_iCalc "F2864: Calculated current value of PWM feedback signal" UWORD I0_0001_S1 1 100 0 3.2 FORMAT "%8.6" ARRAY_SIZE 10 ECU_ADDRESS 0xFFF948B0 /end MEASUREMENT
/begin MEASUREMENT OutMDth_bDthEnblReq "F2861: Enable the dither output" UBYTE B_TRUE_S1 1 100 0 1 FORMAT "%13.11" ARRAY_SIZE 10 ECU_ADDRESS 0xFFF94F26 /end MEASUREMENT
/begin MEASUREMENT OutMDth_bPerChngPrvnt "F2861: Prevent the period change in current situation" UBYTE B_TRUE_S1 1 100 0 1 FORMAT "%13.11" ECU_ADDRESS 0xFFF955D0 /end MEASUREMENT
/begin MEASUREMENT OutMDth_iDthAmp "F2861: Dither amplitude (0.1mA resolution)" UWORD I0_0001_S1 1 100 0 6.5535 FORMAT "%8.6" ARRAY_SIZE 10 ECU_ADDRESS 0xFFF94854 /end MEASUREMENT
/begin MEASUREMENT OutMDth_iDthAmpLimSply "F2861: Dither amplitude limitation dependent on supply voltage and Atf temperature" UWORD I0_0001_S1 1 100 0 6.5535 FORMAT "%8.6" ECU_ADDRESS 0xFFF94F30 /end MEASUREMENT
/begin MEASUREMENT OutMDth_iDthAmpReq "F2861: Dither amplitude request (>1000mA:no request) (0.1mA resolution)" UWORD I0_0001_S1 1 100 0 6.5535 FORMAT "%8.6" ARRAY_SIZE 10 ECU_ADDRESS 0xFFF94868 /end MEASUREMENT
/begin MEASUREMENT OutMDth_iInDmy "F2861: Current value which is used for dither calculation (dummy for characteristic field)" SWORD I0_0001_S1 1 100 -3.2768 3.2767 FORMAT "%8.6" ECU_ADDRESS 0xFFF94F32 /end MEASUREMENT
/begin MEASUREMENT OutMDth_iOutOfs "F2861: Offset to outgoing current control value for characteristic field (dummy value only)" SWORD I0_0001_S1 1 100 -3.2 3.2 FORMAT "%8.6" ARRAY_SIZE 10 ECU_ADDRESS 0xFFF9487C /end MEASUREMENT
/begin MEASUREMENT OutMDth_stDthAmpChng "F2861: Bit Array indicating dither amplitude change per dither channel" ULONG X1_S1 1 100 0 4294967295 FORMAT "%13.2" ECU_ADDRESS 0xFFF94890 /end MEASUREMENT
/begin MEASUREMENT OutMDth_stDthAmpOn "F2861: Bit Array indicating dither amplitude On/Off per dither channel" ULONG X1_S1 1 100 0 4294967295 FORMAT "%13.2" ECU_ADDRESS 0xFFF94894 /end MEASUREMENT
/begin MEASUREMENT OutMDth_stDthPerChng "F2861: Bit Array indicating Dither period change per dither group" UWORD X1_S1 1 100 0 65535 FORMAT "%8.2" ECU_ADDRESS 0xFFF94F34 /end MEASUREMENT
/begin MEASUREMENT OutMDth_tAtfFlt "F2861: Current Atf-temperature as reference value (Filtered)" SWORD T0_0625_S1 1 100 -2048 2047.938 FORMAT "%8.3" ECU_ADDRESS 0xFFF94F36 /end MEASUREMENT
/begin MEASUREMENT OutMDth_tiDthPer "F2861: Dither period" UWORD TI0_001_M_S1 1 100 0 0.032 FORMAT "%10.8" ARRAY_SIZE 3 ECU_ADDRESS 0xFFF94F38 /end MEASUREMENT
/begin MEASUREMENT OutMDth_tiMinSwtOff "F2861: Timer for the min. switch off duration of the dither amplitude at a large current change" UBYTE TI1_M_CYCLE_S1 1 100 0 1275 FORMAT "%5.0" ARRAY_SIZE 10 ECU_ADDRESS 0xFFF95CB2 /end MEASUREMENT
/begin MEASUREMENT OutMDth_uSplyDmy "F2861: Supply voltage for a selected channel (dummy value is only for characteristic curve; not saved for each channel)" SWORD U0_001_S1 1 100 -32.768 32.767 FORMAT "%8.5" ECU_ADDRESS 0xFFF94F3E /end MEASUREMENT
/begin MEASUREMENT OutMEe_iCc08Comp "F2862: Current compensation value from EEPROM" SWORD I0_0001_S1 1 100 -3.2768 3.2767 FORMAT "%8.6" ARRAY_SIZE 10 ECU_ADDRESS 0xFFF94898 /end MEASUREMENT
/begin MEASUREMENT OutMEe_stCc08Avl "F2862: Flag to signal that EEPROM current values are valid" ULONG X1_S1 1 100 0 4294967295 FORMAT "%13.2" ECU_ADDRESS 0xFFF948AC /end MEASUREMENT
/begin MEASUREMENT OutMRstn_resActrMod "F2863: Calculated resistance for current feedback calculation" UWORD RES0_001_S1 1 100 0 32 FORMAT "%8.5" ARRAY_SIZE 10 ECU_ADDRESS 0xFFF948C4 /end MEASUREMENT
/begin MEASUREMENT OutMRstn_tActrWuFlt "F2863: Actuator temperature filtered" UWORD T0_0078125_S1 1 100 0 215 FORMAT "%8.4" ARRAY_SIZE 10 ECU_ADDRESS 0xFFF948D8 /end MEASUREMENT
/begin MEASUREMENT OutMRstn_tActrWuFlt1 "F2863: First interim value of PT1-filter of the actuator temperature" UWORD T0_0078125_S1 1 100 0 215 FORMAT "%8.4" ARRAY_SIZE 10 ECU_ADDRESS 0xFFF948EC /end MEASUREMENT
/begin MEASUREMENT OutMRstn_tActrWuFlt2 "F2863: Second interim value of PT1-filter of the actuator temperature" UWORD T0_0078125_S1 1 100 0 215 FORMAT "%8.4" ARRAY_SIZE 10 ECU_ADDRESS 0xFFF94900 /end MEASUREMENT
/begin MEASUREMENT OutMRstn_tAtfFlt "F2863: Oil temperature filtered" SWORD T0_0078125_S1 1 100 -40 215 FORMAT "%8.4" ECU_ADDRESS 0xFFF963C4 /end MEASUREMENT
/begin MEASUREMENT OutMRstn_tAtfRef "F2863: Oil temperature" SWORD T0_0625_S1 1 100 -40 215 FORMAT "%8.4" ECU_ADDRESS 0xFFF963C6 /end MEASUREMENT
/begin MEASUREMENT OutMRstn_tChpRef "F2863: Chip temperature" SWORD T0_0625_S1 1 100 -40 215 FORMAT "%8.4" ECU_ADDRESS 0xFFF94F40 /end MEASUREMENT
/begin MEASUREMENT OutMRstn_tiCalcRate "F2863: Timer for resistance task rate" UWORD TI1_M_CYCLE_S1 1 100 0 255 FORMAT "%8.4" ECU_ADDRESS 0xFFF95C8C /end MEASUREMENT
/begin MEASUREMENT OutPCc08Cfg_iCc08EeChn "F2531: Current compensation value of EE for a selected channel (only internal)" SWORD I0_0001_S1 1 100 -0.026 0.026 FORMAT "%10.8" ECU_ADDRESS 0xFFF94F42 /end MEASUREMENT
/begin MEASUREMENT OutPCc08Cfg_iCc08Out "F2531: Current output value for current control of VFS" UWORD I0_0001_S1 1 100 0 1.2282 FORMAT "%8.6" ARRAY_SIZE 10 ECU_ADDRESS 0xFFF962F4 /end MEASUREMENT
/begin MEASUREMENT OutPCc08Cfg_stCc08Actv "F2531: Current mode at VFS [0=switch mode off, 1=Curr mode off, 2=Curr mode 0mA, 3=Curr mode, 4=switch mode on]" UBYTE X1_S1 1 100 0 3 FORMAT "%5.3" ARRAY_SIZE 10 ECU_ADDRESS 0xFFF963C8 /end MEASUREMENT
/begin MEASUREMENT OutPCc08Crnt_stCc08CrntNom "F2531: Status of current control transitions [0=undef, 0x10=AllOff, 0x11=Off, 0x20=Trans, 0x30=AllConst, 0x31=Const, 0x32=Chng, 0x35=Dth, 0x36=AllSync, 0x40=DIFFSGOP_OFF; 0x41=DIFFSGOP_PWM, 0x50=SWM_OFF, 0x51=SWM_ON, 0x60=MINCRNT, 0x61=MAXCRNT]" UBYTE X1_S1 1 100 0 97 FORMAT "%5.2" ARRAY_SIZE 10 ECU_ADDRESS 0xFFF95096 /end MEASUREMENT
/begin MEASUREMENT OutPCc08Crnt_tiCc08CrntChng "F2531: Lag counter for current evaluation of this VFS while current control changes" UBYTE TI1_M_CYCLE_S1 1 100 0 100 FORMAT "%5.1" ARRAY_SIZE 10 ECU_ADDRESS 0xFFF95D0E /end MEASUREMENT
/begin MEASUREMENT OutPCc08Crnt_tiCc08CrntGen "F2531: Lag counter for current tolerance expansion if other VFS change their current control" UBYTE TI1_M_CYCLE_S1 1 100 0 100 FORMAT "%5.1" ECU_ADDRESS 0xFFF95D63 /end MEASUREMENT
/begin MEASUREMENT OutPCc08Ctl_iCc08Crnt "F2531: Current output value from layer 3 to layer 2" UWORD I0_0001_S1 1 100 0 1.2282 FORMAT "%8.6" ARRAY_SIZE 10 ECU_ADDRESS 0xFFF96308 /end MEASUREMENT
/begin MEASUREMENT OutPCc08Ctl_iCc08In "F2531: Nominal current value" UWORD I0_0001_S1 1 100 0 1.2282 FORMAT "%8.6" ARRAY_SIZE 10 ECU_ADDRESS 0xFFF9631C /end MEASUREMENT
/begin MEASUREMENT OutPCc08Ctl_stCc08Out "F2531: Output value for SFRM, if current control is active" UBYTE X1_S1 1 100 0 255 FORMAT "%5.1" ARRAY_SIZE 10 ECU_ADDRESS 0xFFF963D2 /end MEASUREMENT
/begin MEASUREMENT OutPCc08Ctl_stCc08ReqOff "F2531: Request to switch VFS off [B0=CG208 channel 0, B1=CG208 channel 1, ...; 0=Off, 1=On]" UWORD X1_S1 1 100 0 1023 FORMAT "%8.3" ECU_ADDRESS 0xFFF94F52 /end MEASUREMENT
/begin MEASUREMENT OutPCc08Ctl_stCc08ReqOn "F2531: Status of request to switch current control on [B0:CG208 channel 0, ..; value 0=Off, 1=On]" UWORD X1_S1 1 100 0 1023 FORMAT "%8.3" ECU_ADDRESS 0xFFF94F54 /end MEASUREMENT
/begin MEASUREMENT OutPCc08Ctl_tiCc08HwFault "F2531: Timer for hardware fault detection of current comparing" UBYTE TI1_M_CYCLE_S1 1 100 0 1275 FORMAT "%5.0" ARRAY_SIZE 10 ECU_ADDRESS 0xFFF95CBC /end MEASUREMENT
/begin MEASUREMENT OutPCc08Ctl_uCc08PSplyFlt "F2531: Filtered power supply voltage" UWORD U0_001_S1 1 100 0 32 FORMAT "%8.5" ARRAY_SIZE 2 ECU_ADDRESS 0xFFF94928 /end MEASUREMENT
/begin MEASUREMENT OutPCc08Fdbk_ctCc08FdbkErr "F2531: Errorcounter for feedback signal" UBYTE X1_S1 1 100 0 10 FORMAT "%5.2" ARRAY_SIZE 10 ECU_ADDRESS 0xFFF94F58 /end MEASUREMENT
/begin MEASUREMENT OutPCc08Fdbk_rCc08FdbkAvrg "F2531: Ratio of feedback signal (average of high and low value)" UWORD R0_1_P_S1 1 100 0 100 FORMAT "%8.4" ARRAY_SIZE 10 ECU_ADDRESS 0xFFF9492C /end MEASUREMENT
/begin MEASUREMENT OutPCc08Fdbk_rCc08FdbkFlt "F2531: Filtered ratio of feedback signal" UWORD R0_1_P_S1 1 100 0 100 FORMAT "%8.4" ARRAY_SIZE 10 ECU_ADDRESS 0xFFF94940 /end MEASUREMENT
/begin MEASUREMENT OutPCc08Fdbk_rCc08FdbkFlt32 "F2531: Internal filter value for feedback signal" SLONG R0_0001_S1 1 100 0 100 FORMAT "%13.9" ARRAY_SIZE 10 ECU_ADDRESS 0xFFF94954 /end MEASUREMENT
/begin MEASUREMENT OutPCc08Fdbk_rCc08FdbkHi "F2531: Ratio of feedback signal (high sample value)" UWORD R0_1_P_S1 1 100 0 100 FORMAT "%8.4" ARRAY_SIZE 10 ECU_ADDRESS 0xFFF9497C /end MEASUREMENT
/begin MEASUREMENT OutPCc08Fdbk_rCc08FdbkLo "F2531: Ratio of feedback signal (low sample value)" UWORD R0_1_P_S1 1 100 0 100 FORMAT "%8.4" ARRAY_SIZE 10 ECU_ADDRESS 0xFFF94990 /end MEASUREMENT
/begin MEASUREMENT OutPCc08Fdbk_stCc08Fdbk "F2531: Status of feedback signal [0=undef, 1=0%, 2=100%, 3=PWM, 4=PWMLo, 5=PWMHi, 6=NoInfo, 7=Err]" UBYTE X1_S1 1 100 0 7 FORMAT "%5.3" ARRAY_SIZE 10 ECU_ADDRESS 0xFFF94F62 /end MEASUREMENT
/begin MEASUREMENT OutPCc08Mon_iCc08Meas "F2531: Measured current value, which is calculated from feedback switch on and period time" UWORD I0_0001_S1 1 100 0 2 FORMAT "%8.6" ARRAY_SIZE 10 ECU_ADDRESS 0xFFF949A4 /end MEASUREMENT
/begin MEASUREMENT OutPCc08Mon_stCc08Fault "F2531: Status of fault for diagnosis purpose [B0=Gen, B1=Plaus, B2=SB, B3=SG, B4=SGOP, B5=SBDFE, B6=SGDFE, B7=OPDFE, B8=Low, B9=High, B10=NSSTA, B11=NSDYN, B12=PRESGOP, B13=TEMPINCOR]" UWORD X1_S1 1 100 0 65535 FORMAT "%8.2" ARRAY_SIZE 10 ECU_ADDRESS 0xFFF95E60 /end MEASUREMENT
/begin MEASUREMENT OutPCc08Mon_stCc08Sfrm "F2531: Fault status for Sfrm [0=no fault, 1= switch off lowsides, 2=switch off lowsides and PSply,  Bit7 = DFE fault]" UBYTE X1_S1 1 100 0 2 FORMAT "%5.3" ARRAY_SIZE 10 ECU_ADDRESS 0xFFF94F6C /end MEASUREMENT
/begin MEASUREMENT OutPCc08Mon_stCc08TstCond "F2531: Status of test condition for diagnosis purpose [B0=Gen, B1=Plaus, B2=SB, B3=SG, B4=SGOP, B5=SBDFE, B6=SGDFE, B7=OPDFE, B8=Low, B9=High, B10=NSSTA, B11=NSDYN, B12=PRESGOP, B13=TEMPINCOR]" UWORD X1_S1 1 100 0 65535 FORMAT "%8.2" ARRAY_SIZE 10 ECU_ADDRESS 0xFFF95E74 /end MEASUREMENT
/begin MEASUREMENT OutPCc08Mon_stCc08TstGen "F2531: Status of general test condition [0=undef, 1=Off, 2=Wait, 3=Sc, 4=ScCrnt]" UBYTE X1_S1 1 100 0 4 FORMAT "%5.3" ARRAY_SIZE 10 ECU_ADDRESS 0xFFF94F76 /end MEASUREMENT
/begin MEASUREMENT OutPCc08Mon_stHealSfrmFault "F2531: Status: SFRM report, no fault is present[0=Off, 1=On]" UWORD X1_S1 1 100 0 65535 FORMAT "%8.2" ECU_ADDRESS 0xFFF94F80 /end MEASUREMENT
/begin MEASUREMENT OutPCc08Mon_tiCc08NsDynErr "F2531: Fault filter timer for dynamical current flow" UBYTE TI1_M_CYCLE_S1 1 100 0 1275 FORMAT "%5.0" ARRAY_SIZE 10 ECU_ADDRESS 0xFFF95CC6 /end MEASUREMENT
/begin MEASUREMENT OutPCc08Mon_tiCc08TstFdbk "F2531: Filter for test condition if feedback signal is changing from 100%" UBYTE TI1_M_CYCLE_S1 1 100 0 1275 FORMAT "%5.0" ARRAY_SIZE 10 ECU_ADDRESS 0xFFF95CD0 /end MEASUREMENT
/begin MEASUREMENT OutPCc08Rat_rCc08Rat "F2531: Ratio RI/U at VFS to recognize 100% or 0% current mode" UWORD R0_0001_S1 1 100 0 2 FORMAT "%8.6" ARRAY_SIZE 10 ECU_ADDRESS 0xFFF94AC0 /end MEASUREMENT
/begin MEASUREMENT OutPCc08Rat_stCc08RatMode "F2531: Status RI/U at VFS to recognize 100% current mode [0=off, 1=PSply high, 2=constant, 3=change, 4=high ratio]" UBYTE X1_S1 1 100 0 4 FORMAT "%5.3" ARRAY_SIZE 10 ECU_ADDRESS 0xFFF950A0 /end MEASUREMENT
/begin MEASUREMENT OutPCc08SGOP_sCc08DiffSGOP "F2531: Statemachine counter for short to ground and open load detection" UBYTE X1_S1 1 100 0 10 FORMAT "%5.2" ARRAY_SIZE 10 ECU_ADDRESS 0xFFF94F82 /end MEASUREMENT
/begin MEASUREMENT OutPCc08SGOP_stCc08DiffReq "F2531: Mode request for current control [0 = normal, 1 = filtering, 2 = Curr mode 0mA, 3 = switch mode off, 4 = fault entry]" UBYTE X1_S1 1 100 0 4 FORMAT "%5.3" ARRAY_SIZE 10 ECU_ADDRESS 0xFFF94F8C /end MEASUREMENT
/begin MEASUREMENT OutPCc08SGOP_stCc08DiffSGOP "F2531: Result of short to ground and open pin differentiation [see documentation]" UBYTE X1_S1 1 100 0 48 FORMAT "%5.2" ARRAY_SIZE 10 ECU_ADDRESS 0xFFF94F96 /end MEASUREMENT
/begin MEASUREMENT OutPCc08SGOP_stCc08HldFault "F2531: Status for keeping faults [0= no fault, 32=SB, 36= SG,OP,NsDyn]" UBYTE X1_S1 1 100 0 255 FORMAT "%5.1" ARRAY_SIZE 10 ECU_ADDRESS 0xFFF94FA0 /end MEASUREMENT
/begin MEASUREMENT OutPCc08SGOP_tiCc08DiffDly "F2531: Internal delay timer of short to ground and open load detection" UBYTE TI1_M_CYCLE_S1 1 100 0 1275 FORMAT "%5.0" ARRAY_SIZE 10 ECU_ADDRESS 0xFFF95CDA /end MEASUREMENT
/begin MEASUREMENT OutPCc08SGOP_tiCc08DiffSGOP "F2531: Fault filter timer of short to ground and open load detection" UBYTE TI1_M_CYCLE_S1 1 100 0 250 FORMAT "%5.1" ARRAY_SIZE 10 ECU_ADDRESS 0xFFF95CE4 /end MEASUREMENT
/begin MEASUREMENT OutPCc08SGOP_tiCc08HldFault "F2531: Timer for keeping faults" UBYTE TI1_M_CYCLE_S1 1 100 0 1275 FORMAT "%5.0" ARRAY_SIZE 10 ECU_ADDRESS 0xFFF95CEE /end MEASUREMENT
/begin MEASUREMENT OutPCc08SGOP_uCc08DiffPSply "F2531: PSply voltage for a selected channel (only internal)" UWORD U0_001_S1 1 100 0 32 FORMAT "%8.5" ECU_ADDRESS 0xFFF94FAA /end MEASUREMENT
/begin MEASUREMENT OutPCc08Tolc_iCc08Grad "F2531: Current gradient (absolute)" SWORD I0_0001_S1 1 100 -3.2 3.2 FORMAT "%8.6" ARRAY_SIZE 10 ECU_ADDRESS 0xFFF94AD4 /end MEASUREMENT
/begin MEASUREMENT OutPCc08Tolc_iCc08GradDmy "F2531: Current gradient (dummy for charcteristic line)" SWORD I0_0001_S1 1 100 -3.2 3.2 FORMAT "%8.6" ECU_ADDRESS 0xFFF950AA /end MEASUREMENT
/begin MEASUREMENT OutPCc08Tolc_iCc08TolcLimHi "F2531: High limit of tolerance deviation of current input" UWORD I0_0001_S1 1 100 0 3.2 FORMAT "%8.6" ARRAY_SIZE 10 ECU_ADDRESS 0xFFF94AE8 /end MEASUREMENT
/begin MEASUREMENT OutPCc08Tolc_iCc08TolcLimLo "F2531: Low limit of tolerance deviation of current input" UWORD I0_0001_S1 1 100 0 3.2 FORMAT "%8.6" ARRAY_SIZE 10 ECU_ADDRESS 0xFFF94AFC /end MEASUREMENT
/begin MEASUREMENT OutPCc08Tolc_tiCc08DthAmpOn "F2531: timer for dither active lengthening time" UBYTE TI1_M_CYCLE_S1 1 100 0 1275 FORMAT "%5.0" ARRAY_SIZE 10 ECU_ADDRESS 0xFFF95D18 /end MEASUREMENT
/begin MEASUREMENT OutPCc08Tolc_tiCc08DthChng "F2531: Lag timer for dither frequence or amplitude change" UBYTE TI1_M_CYCLE_S1 1 100 0 1275 FORMAT "%5.0" ARRAY_SIZE 10 ECU_ADDRESS 0xFFF95D22 /end MEASUREMENT
/begin MEASUREMENT OutPCc08Tolc_tiCc08GradHi "F2531: Lag counter for current gradient diagnosis (high range)" UWORD TI1_M_CYCLE_S1 1 100 0 327675 FORMAT "%8.1" ARRAY_SIZE 10 ECU_ADDRESS 0xFFF95C58 /end MEASUREMENT
/begin MEASUREMENT OutPCc08Tolc_tiCc08GradLo "F2531: Lag counter for current gradient diagnosis (low range)" UWORD TI1_M_CYCLE_S1 1 100 0 327675 FORMAT "%8.1" ARRAY_SIZE 10 ECU_ADDRESS 0xFFF95C6C /end MEASUREMENT
/begin MEASUREMENT OutPCc08Tolc_tiCc08Noi "F2531: Lag counter for current tolerance expansion if noise was detected on battery supply" UBYTE TI1_M_CYCLE_S1 1 100 0 255 FORMAT "%5.1" ECU_ADDRESS 0xFFF95D64 /end MEASUREMENT
/begin MEASUREMENT OutPLssCtl_iLssIn "F2525: Current input value for low side control" UWORD I0_0001_S1 1 100 0 3.2 FORMAT "%8.6" ARRAY_SIZE 5 ECU_ADDRESS 0xFFF94FB0 /end MEASUREMENT
/begin MEASUREMENT OutPLssCtl_rLssIn "F2525: PWM or binary input value for low side control [0=Off, >1=On]" UWORD R0_1_P_S1 1 100 0 100 FORMAT "%8.4" ARRAY_SIZE 5 ECU_ADDRESS 0xFFF963DC /end MEASUREMENT
/begin MEASUREMENT OutPLssCtl_stLssOut "F2525: Output status of low side control for SFRM [0=Off, 1=On/PWM, 2=On with 100%]" UBYTE X1_S1 1 100 0 2 FORMAT "%5.3" ARRAY_SIZE 5 ECU_ADDRESS 0xFFF9641C /end MEASUREMENT
/begin MEASUREMENT OutPLssCtl_stLssOutL3 "F2525: Output status of low side control [0=Off, 1=On/PWM, 2=On with 100%]" UBYTE X1_S1 1 100 0 2 FORMAT "%5.3" ARRAY_SIZE 5 ECU_ADDRESS 0xFFF96421 /end MEASUREMENT
/begin MEASUREMENT OutPLssCtl_stLssReqOff "F2525: Request to switch Lss off [B0: Lss channel 0, B1: ...; 0=Off, 1=On]" UBYTE X1_S1 1 100 0 31 FORMAT "%5.2" ECU_ADDRESS 0xFFF955D3 /end MEASUREMENT
/begin MEASUREMENT OutPLssCtl_stLssReqOn "F2525: Request to switch Lss on [B0: Lss channel 0, B1: ...; 0=Off, 1=On]" UBYTE X1_S1 1 100 0 31 FORMAT "%5.2" ECU_ADDRESS 0xFFF955D4 /end MEASUREMENT
/begin MEASUREMENT OutPLssDuty_rLssDuty "F2525: Duty cycle of solenoid" UWORD R0_1_P_S1 1 100 0 100 FORMAT "%8.4" ARRAY_SIZE 5 ECU_ADDRESS 0xFFF963E6 /end MEASUREMENT
/begin MEASUREMENT OutPLssDuty_stLssActv "F2525: Solenoid active [0=Off, 1=On/PWM, 2=On with 100%]" UBYTE X1_S1 1 100 0 2 FORMAT "%5.3" ARRAY_SIZE 5 ECU_ADDRESS 0xFFF96426 /end MEASUREMENT
/begin MEASUREMENT OutPLssDuty_tAtf "F2525: Oil temperature" SWORD T0_0625_S1 1 100 -40 215 FORMAT "%8.4" ECU_ADDRESS 0xFFF963F0 /end MEASUREMENT
/begin MEASUREMENT OutPLssDuty_tiLssPk "F2525: Time of switch on peak" UBYTE TI1_M_CYCLE_S1 1 100 0 1275 FORMAT "%5.0" ARRAY_SIZE 5 ECU_ADDRESS 0xFFF95D38 /end MEASUREMENT
/begin MEASUREMENT OutPLssDuty_tiLssPkCpl "F2525: Time of switch on peak (2nd timer)" UBYTE TI1_M_CYCLE_S1 1 100 0 1275 FORMAT "%5.0" ARRAY_SIZE 5 ECU_ADDRESS 0xFFF95D3D /end MEASUREMENT
/begin MEASUREMENT OutPLssDuty_xLssIn "F2525: Duty cycle or current signal of solenoid" UWORD X1_S1 1 100 0 32000 FORMAT "%8.2" ARRAY_SIZE 5 ECU_ADDRESS 0xFFF963F2 /end MEASUREMENT
/begin MEASUREMENT OutPLssMon_stLssFault "F2525: Status of fault [B2: SB, B3: SG, B4: OP, B5: SGOP, B6: SGDFE, B7: SBDFE]" UWORD X1_S1 1 100 0 65535 FORMAT "%8.2" ARRAY_SIZE 5 ECU_ADDRESS 0xFFF95EAA /end MEASUREMENT
/begin MEASUREMENT OutPLssMon_stLssSfrm "F2525: Fault status for SFRM [0=No fault, 1=Switch off low sides, 2=Switch off low sides and PSply]" UBYTE X1_S1 1 100 0 2 FORMAT "%5.3" ARRAY_SIZE 5 ECU_ADDRESS 0xFFF955E0 /end MEASUREMENT
/begin MEASUREMENT OutPLssMon_stLssTstCond "F2525: Status of test condition [B2: SB, B3: SG, B4: OP, B5: SGOP, B6: SGDFE, B7: SBDFE]" UWORD X1_S1 1 100 0 65535 FORMAT "%8.2" ARRAY_SIZE 5 ECU_ADDRESS 0xFFF95EB4 /end MEASUREMENT
/begin MEASUREMENT OutPLssMon_stSwtOnPrt "F2525: Inhibit control to protect hardware circuit at SB fault [0=Do nothing, 1=Inhibit control; channel wise bit-coded]" UWORD X1_S1 1 100 0 31 FORMAT "%8.5" ECU_ADDRESS 0xFFF94FDA /end MEASUREMENT
/begin MEASUREMENT OutPLssMon_tiFltSB "F2525: Lag counter for SB fault prefiltering" UBYTE TI1_M_CYCLE_S1 1 100 0 1275 FORMAT "%5.0" ARRAY_SIZE 5 ECU_ADDRESS 0xFFF95D42 /end MEASUREMENT
/begin MEASUREMENT OutPLssMon_tiLssChng "F2525: Time since input signal has changed" UBYTE TI1_M_CYCLE_S1 1 100 0 1275 FORMAT "%5.0" ARRAY_SIZE 5 ECU_ADDRESS 0xFFF95D47 /end MEASUREMENT
/begin MEASUREMENT OutPLssMon_tiLssSplyOn "F2525: Lag counter at T15 or T30 on" UBYTE TI1_M_CYCLE_S1 1 100 0 1275 FORMAT "%5.0" ARRAY_SIZE 5 ECU_ADDRESS 0xFFF95D4C /end MEASUREMENT
/begin MEASUREMENT OutPLssMon_tiSwtOnPrt "F2525: Lag counter to inhibit control to protect hardware circuit at SB fault" UBYTE TI1_M_CYCLE_S1 1 100 0 1275 FORMAT "%5.0" ARRAY_SIZE 5 ECU_ADDRESS 0xFFF95D51 /end MEASUREMENT
/begin MEASUREMENT OutPOpsCtl_cntRepIpt "F2520: left number of possible IPT repetitions" UBYTE X1_S1 1 100 0 255 FORMAT "%5.1" ECU_ADDRESS 0xFFF955E5 /end MEASUREMENT
/begin MEASUREMENT OutPOpsCtl_sOpsMode "F2520: Mode of the OPS: 0x00: OPS_INIT; 0x1F:OPS_NONOP;  0x2E:OPS_OP; 0x3D:OPS_ACTIVE_OFF;0x4C: OPS_ACTIVE_ON" UBYTE X1_S1 1 100 0 76 FORMAT "%5.2" ECU_ADDRESS 0xFFF9642B /end MEASUREMENT
/begin MEASUREMENT OutPOpsCtl_stOpsFault "F2520: DSM fault condition; B9: unexpected DN-Reset, B8: IPT Final Evaluation,B7:Hss IWD deact-test, B6:Hss actv-test, B5:PClk-test, B4:Lss actv. prev.-test, B3:Hss actv. prev.-test, B2:Hss short-test, B1:DN-test, B0:Tst-prep" UWORD X1_S1 1 100 0 65535 FORMAT "%8.2" ECU_ADDRESS 0xFFF94FDC /end MEASUREMENT
/begin MEASUREMENT OutPOpsCtl_stOpsTstCond "F2520: DSM test condition; B9: unexpected DN-Reset, B8: IPT Final Evaluation,B7:Hss IWD deact-test, B6:Hss actv-test, B5:PClk-test, B4:Lss actv. prev.-test, B3:Hss actv. prev.-test, B2:Hss short-test, B1:DN-test, B0:Tst-prep" UWORD X1_S1 1 100 0 65535 FORMAT "%8.2" ECU_ADDRESS 0xFFF94FDE /end MEASUREMENT
/begin MEASUREMENT OutPOpsCtl_xPSplySafRlvnt "F2520: safety relevance of PSply channels, array over safety relevance; bitcoded channels" UWORD X1_S1 1 100 0 65535 FORMAT "%8.2" ARRAY_SIZE 4 ECU_ADDRESS 0xFFF96330 /end MEASUREMENT
/begin MEASUREMENT OutPOpsTst_sIpt "F2520: Status of IPT: B09:hold (low uBatt), B8:final eval., B7:Hss IWD deact-test, B6:Hss actv-test, B5:PClk-test, B4:Lss actv. prev.-test, B3:Hss actv. prev.-test, B2:Hss short-test, B1:DN-test, B0:Tst-prep" UWORD X1_S1 1 100 0 65535 FORMAT "%8.2" ECU_ADDRESS 0xFFF963FC /end MEASUREMENT
/begin MEASUREMENT OutPOpsTst_sIptPreHld "F2520: Ipt test state" UWORD X1_S1 1 100 0 65535 FORMAT "%8.2" ECU_ADDRESS 0xFFF94FE0 /end MEASUREMENT
/begin MEASUREMENT OutPOpsTst_stPSplyRngFault "F2520: PSply fault range; array over ECE_PSPLY_PUB_NUM_SY; 0x11=SG, 0x22=OP, 0x33=SB, 0x44=Undef_Lo, 0x55=Undef_Hi" UBYTE X1_S1 1 100 0 255 FORMAT "%5.1" ARRAY_SIZE 2 ECU_ADDRESS 0xFFF94FE2 /end MEASUREMENT
/begin MEASUREMENT OutPOpsTst_stSucTstMsk "F2520: Bitwise marking of successfully passed tests B8: Final Evaluation, B7: Hss IWD deact-test, B6: Hss actv-test, B5: PClk-test, B4: Lss actv. prevent.-test, B3: Hss actv. prevent.-test, B2: Hss pinline-test, B1: DN-test, B0: preparation" UWORD X1_S1 1 100 0 16 FORMAT "%8.5" ECU_ADDRESS 0xFFF94FE4 /end MEASUREMENT
/begin MEASUREMENT OutPOpsTst_stTst "F2520: IPT-Status 00 Idle;40 Hold; 55 NEXT_STEP; AA SUCCESS; F0 ERR_GEN;F1 ERR_IWD;F2 ERR_PSPLY;F3 ERR_LSS;F4 ERR_DN;F5 ERR UBAT;F6 ERR_TOUT;30 WAIT_PCLK;31 WAIT_IWD;32 WAIT_PCLK;33 WAIT_DN;34 WAIT_PSPLY" UBYTE X1_S1 1 100 0 255 FORMAT "%5.1" ECU_ADDRESS 0xFFF9642C /end MEASUREMENT
/begin MEASUREMENT OutPOpsTst_stTstPreHld "F2520: Ipt test state" UBYTE X1_S1 1 100 0 255 FORMAT "%5.1" ECU_ADDRESS 0xFFF955E6 /end MEASUREMENT
/begin MEASUREMENT OutPOpsTst_tiDnTOut "F2520: Timeout for DN-Reset-Line" UBYTE TI1_M_CYCLE_S1 1 100 0 1275 FORMAT "%5.0" ECU_ADDRESS 0xFFF95D56 /end MEASUREMENT
/begin MEASUREMENT OutPOpsTst_tiIptTOut "F2520: DwnCnt for Test-Timeout" UBYTE TI1_M_CYCLE_S1 1 100 0 1275 FORMAT "%5.0" ECU_ADDRESS 0xFFF95D57 /end MEASUREMENT
/begin MEASUREMENT OutPOpsTst_tiIptTOutPreHld "F2520: Internal value down counter for ipt test timeout" UBYTE X1_S1 1 100 0 255 FORMAT "%5.1" ECU_ADDRESS 0xFFF955E7 /end MEASUREMENT
/begin MEASUREMENT OutPOpsTst_tiPSplyTOut "F2520: DwnCnt for Hss-Timeout" UBYTE TI1_M_CYCLE_S1 1 100 0 150 FORMAT "%5.1" ECU_ADDRESS 0xFFF95D58 /end MEASUREMENT
/begin MEASUREMENT OutPOpsTst_tiPSplyTOutPreHld "F2520: Internal value down counter for psply test timeout" UBYTE X1_S1 1 100 0 255 FORMAT "%5.1" ECU_ADDRESS 0xFFF955E8 /end MEASUREMENT
/begin MEASUREMENT OutPPclkCtl_stPclk "F2545: Internal status of the Pclk [B0: Hi, B1: Lo, B2: OnOff, B3: OnAftOff, B4: Pclk was OFF, B5: Monitoring locked]" UBYTE X1_S1 1 100 0 255 FORMAT "%5.1" ECU_ADDRESS 0xFFF955E9 /end MEASUREMENT
/begin MEASUREMENT OutPPclkCtl_stPclkCtl "F2545: Request to switch ON or OFF the Pclk [0x0=Default, 0x55=ON, 0xAA=OFF]" UBYTE X1_S1 1 100 0 255 FORMAT "%5.1" ECU_ADDRESS 0xFFF955EA /end MEASUREMENT
/begin MEASUREMENT OutPPclkCtl_stPclkOpsOn "F2545: Request of Pclk mode [0x11=INIT, 0x33=ACTIVE_ON]" UBYTE X1_S1 1 100 0 255 FORMAT "%5.1" ECU_ADDRESS 0xFFF955EB /end MEASUREMENT
/begin MEASUREMENT OutPPclkCtl_stPclkTst "F2545: Request to set the test status [0x0=Test done, 0xAA=Test request, 0x55=Test locked]" UBYTE X1_S1 1 100 0 255 FORMAT "%5.1" ECU_ADDRESS 0xFFF955EC /end MEASUREMENT
/begin MEASUREMENT OutPPclkMon_stPclkFault "F2545: Variable to measure the faults of the Pclk monitoring system. This variable is bit coded for further information take a look in the docu!" UWORD X1_S1 1 100 0 65535 FORMAT "%8.2" ECU_ADDRESS 0xFFF950AC /end MEASUREMENT
/begin MEASUREMENT OutPPclkMon_stPclkTstCond "F2545: Variable to measure the test conditions of the Pclk monitoring system. This variable is bit coded for further information take a look in the docu!" UWORD X1_S1 1 100 0 65535 FORMAT "%8.2" ECU_ADDRESS 0xFFF950AE /end MEASUREMENT
/begin MEASUREMENT OutPPSplyCtl_bOpsDn "F2523: Information from the OPS about the  DN-Status (0= no reset; 1= reset)" UBYTE B_TRUE_S1 1 100 0 1 FORMAT "%13.11" ECU_ADDRESS 0xFFF9642D /end MEASUREMENT
/begin MEASUREMENT OutPPSplyCtl_bPSplyIn "F2523: Request to activate PSply [0=off, 1=on]" UBYTE B_TRUE_S1 1 100 0 1 FORMAT "%13.11" ARRAY_SIZE 2 ECU_ADDRESS 0xFFF963FE /end MEASUREMENT
/begin MEASUREMENT OutPPSplyCtl_bPSplyOut "F2523: Control value of PSply for SFRM [0=off, 1=on]" UBYTE B_TRUE_S1 1 100 0 1 FORMAT "%13.11" ARRAY_SIZE 2 ECU_ADDRESS 0xFFF96400 /end MEASUREMENT
/begin MEASUREMENT OutPPSplyCtl_bPSplyOutL3 "F2523: Control value of PSply [0=off, 1=on]" UBYTE B_TRUE_S1 1 100 0 1 FORMAT "%13.11" ARRAY_SIZE 2 ECU_ADDRESS 0xFFF96402 /end MEASUREMENT
/begin MEASUREMENT OutPPSplyCtl_sPSplyMode "F2523: Status of PSply [11h=INIT,16h=INIT_END,22h=NONOP,33h=OP,34h=ERROR_OFF,38h=UBATT_OFF,3Fh=DSM_OFF,44h=ACTIVE_ON,55h=ACTIVE_OFF]" UBYTE X1_S1 1 100 0 85 FORMAT "%5.2" ARRAY_SIZE 2 ECU_ADDRESS 0xFFF96404 /end MEASUREMENT
/begin MEASUREMENT OutPPSplyCtl_stLdOpsOn "F2523: Request from OPS to activate all load of a PSply (ini test) [B0=Loads of PSply0, B1=Loads of PSply1,...]" UBYTE X1_S1 1 100 0 3 FORMAT "%5.3" ECU_ADDRESS 0xFFF955ED /end MEASUREMENT
/begin MEASUREMENT OutPPSplyCtl_stLdPSplyOn "F2523: Request to activate all loads of a PSply (ini test) [B0=Loads of PSply0, B1=Loads of PSply1,...]" UBYTE X1_S1 1 100 0 3 FORMAT "%5.3" ECU_ADDRESS 0xFFF955EE /end MEASUREMENT
/begin MEASUREMENT OutPPSplyCtl_stOpsFault "F2523: OPS delivers wrong detected PSPLY_RNG" UBYTE X1_S1 1 100 0 3 FORMAT "%5.3" ARRAY_SIZE 2 ECU_ADDRESS 0xFFF94FE6 /end MEASUREMENT
/begin MEASUREMENT OutPPSplyCtl_stPSplyBattLo "F2523: Status switch off of PSply at low battery voltage [B0=PSply0, B1=PSply1...]" UBYTE X1_S1 1 100 0 3 FORMAT "%5.3" ECU_ADDRESS 0xFFF955EF /end MEASUREMENT
/begin MEASUREMENT OutPPSplyCtl_stPSplyBattLoCpl "F2523: Status (for complement) switch off of PSply at low battery voltage [B0=PSply0, B1=PSply1...]" UBYTE X1_S1 1 100 0 3 FORMAT "%5.3" ECU_ADDRESS 0xFFF955F0 /end MEASUREMENT
/begin MEASUREMENT OutPPSplyCtl_stPSplyIni "F2523: Ini-state of PSply (bit coded)" UBYTE X1_S1 1 100 0 255 FORMAT "%5.1" ECU_ADDRESS 0xFFF955F1 /end MEASUREMENT
/begin MEASUREMENT OutPPSplyCtl_stPSplyOpsOn "F2523: Request to activate PSply during ini test [0=off, 1=on]" UBYTE X1_S1 1 100 0 1 FORMAT "%5.3" ARRAY_SIZE 2 ECU_ADDRESS 0xFFF94FE8 /end MEASUREMENT
/begin MEASUREMENT OutPPSplyCtl_stPSplySt "F2523: Status of PSply mode secure on/off [1=off, 2=InitOn, 3=DrvChg, 4=DrvOn]" UBYTE X1_S1 1 100 0 4 FORMAT "%5.3" ARRAY_SIZE 2 ECU_ADDRESS 0xFFF94FEA /end MEASUREMENT
/begin MEASUREMENT OutPPSplyCtl_tiPSplyBattLo "F2523: Timer for PSply switch off during low battery voltage" UBYTE TI1_M_CYCLE_S1 1 100 0 1275 FORMAT "%5.0" ARRAY_SIZE 2 ECU_ADDRESS 0xFFF95CF8 /end MEASUREMENT
/begin MEASUREMENT OutPPSplyCtl_tiPSplyBattLoCpl "F2523: Timer (for complement) for PSply switch off during low battery voltage" UBYTE TI1_M_CYCLE_S1 1 100 0 1275 FORMAT "%5.0" ARRAY_SIZE 2 ECU_ADDRESS 0xFFF95CFA /end MEASUREMENT
/begin MEASUREMENT OutPPSplyCtl_tiPSplyChng "F2523: Counter for control value changing" UBYTE TI1_M_CYCLE_S1 1 100 0 1275 FORMAT "%5.0" ARRAY_SIZE 2 ECU_ADDRESS 0xFFF95CFC /end MEASUREMENT
/begin MEASUREMENT OutPPSplyCtl_tiPSplyPrtSG "F2523: Timer for HW protection in case of SG" UBYTE TI1_M_CYCLE_S1 1 100 0 255 FORMAT "%5.1" ARRAY_SIZE 2 ECU_ADDRESS 0xFFF95CFE /end MEASUREMENT
/begin MEASUREMENT OutPPSplyMon_ctPSplyErrOP "F2523: Faultcounter of OP diagnosis for different low sides" UBYTE X1_S1 1 100 0 255 FORMAT "%5.1" ARRAY_SIZE 2 ECU_ADDRESS 0xFFF94FEC /end MEASUREMENT
/begin MEASUREMENT OutPPSplyMon_ctPSplyOPEvt "F2523: Counter of consecutive PSply OP faults" UBYTE X1_S1 1 100 0 255 FORMAT "%5.1" ARRAY_SIZE 2 ECU_ADDRESS 0xFFF94FEE /end MEASUREMENT
/begin MEASUREMENT OutPPSplyMon_sPSplyOpM "F2523: State machine for the short circuit test during mode OP" UBYTE X1_S1 1 100 0 255 FORMAT "%5.1" ARRAY_SIZE 2 ECU_ADDRESS 0xFFF94FF0 /end MEASUREMENT
/begin MEASUREMENT OutPPSplyMon_stPSplyFault "F2523: Fault status [B0=GEN, B1=PLAUS, B2=SB, B3=SG, B4=OP, B5=SBDFE, B6=SGDFE, B7=OPDFE, B8=SCDFE, B9=SC]" UWORD X1_S1 1 100 0 65535 FORMAT "%8.2" ARRAY_SIZE 2 ECU_ADDRESS 0xFFF95E88 /end MEASUREMENT
/begin MEASUREMENT OutPPSplyMon_stPSplyFaultOP "F2523: PSply Open Pin fault condition [B0=PSply0, B1=PSply1,...; 0=no OP fault, 1= OP fault]" UBYTE X1_S1 1 100 0 255 FORMAT "%5.1" ECU_ADDRESS 0xFFF955F2 /end MEASUREMENT
/begin MEASUREMENT OutPPSplyMon_stPSplyHldDfe "F2523: Status for holding of direct fault entry" UWORD X1_S1 1 100 0 65535 FORMAT "%8.2" ARRAY_SIZE 2 ECU_ADDRESS 0xFFF949F4 /end MEASUREMENT
/begin MEASUREMENT OutPPSplyMon_stPSplyOffSGErr "F2523: SG error in case of reinit PSply" UBYTE B_TRUE_S1 1 100 0 1 FORMAT "%13.11" ARRAY_SIZE 2 ECU_ADDRESS 0xFFF94FF2 /end MEASUREMENT
/begin MEASUREMENT OutPPSplyMon_stPSplyOpMRng "F2523: Status of delay timer for fault detection during mode operation" UBYTE X1_S1 1 100 0 255 FORMAT "%5.1" ARRAY_SIZE 2 ECU_ADDRESS 0xFFF94FF4 /end MEASUREMENT
/begin MEASUREMENT OutPPSplyMon_stPSplySfrm "F2523: Fault status for Sfrm [0=no fault, 2=switch off PSply, Bit7=DFE fault]" UBYTE X1_S1 1 100 0 255 FORMAT "%5.1" ARRAY_SIZE 2 ECU_ADDRESS 0xFFF94FF6 /end MEASUREMENT
/begin MEASUREMENT OutPPSplyMon_stPSplyTstCond "F2523: Test condition status [B0=GEN, B1=PLAUS, B2=SB, B3=SG, B4=OP, B5=SBDFE, B6=SGDFE, B7=OPDFE, B8=SCDFE, B9=SC]" UWORD X1_S1 1 100 0 65535 FORMAT "%8.2" ARRAY_SIZE 2 ECU_ADDRESS 0xFFF95E8C /end MEASUREMENT
/begin MEASUREMENT OutPPSplyMon_stPSplyTstCondOP "F2523: PSply OP test condition [B0=PSply0, B1=PSply1,...; 0= no test cond, 1= OP test cond. fullfilled]" UBYTE X1_S1 1 100 0 255 FORMAT "%5.1" ECU_ADDRESS 0xFFF955F3 /end MEASUREMENT
/begin MEASUREMENT OutPPSplyMon_tiPSplyOpMRng "F2523: Delay timer for fault detection during mode operation" UBYTE TI1_M_CYCLE_S1 1 100 0 1275 FORMAT "%5.0" ARRAY_SIZE 2 ECU_ADDRESS 0xFFF95D00 /end MEASUREMENT
/begin MEASUREMENT OutPPSplyMon_xPSplyDmy "F2523: X Dummy for characteristic field" UBYTE X1_S1 1 100 0 2 FORMAT "%5.3" ECU_ADDRESS 0xFFF955F4 /end MEASUREMENT
/begin MEASUREMENT OutPPSplyMon_yPSplyDmy "F2523: Y Dummy for characteristic field" UBYTE X1_S1 1 100 0 3 FORMAT "%5.3" ECU_ADDRESS 0xFFF955F5 /end MEASUREMENT
/begin MEASUREMENT OutPPSplyOn_bPSplyActv "F2523: Power supply active [0=off, 1=on]" UBYTE X1_S1 1 100 0 1 FORMAT "%5.3" ARRAY_SIZE 2 ECU_ADDRESS 0xFFF94FFA /end MEASUREMENT
/begin MEASUREMENT OutPPSplyOn_stPSplyRng "F2523: Power supply voltage range [0=INIT,0x11=SG,0x22=OP,0x33=SB,0x44=UNDEF_LO,0x55=UNDEF_HI,0x66=CLSD]" UBYTE X1_S1 1 100 0 102 FORMAT "%5.1" ARRAY_SIZE 2 ECU_ADDRESS 0xFFF94FFC /end MEASUREMENT
/begin MEASUREMENT OutPShCirL3_sSSplyShCir "F2510: Represents the short circuit of the sensor supply voltage" UBYTE X1_S1 1 100 0 4 FORMAT "%5.3" ECU_ADDRESS 0xFFF95637 /end MEASUREMENT
/begin MEASUREMENT OutPShCirL3_stSSplyFault "F2510: Variable to measure the faults of the SSply monitoring system. " UWORD X1_S1 1 100 0 65535 FORMAT "%8.2" ECU_ADDRESS 0xFFF95EC2 /end MEASUREMENT
/begin MEASUREMENT OutPShCirL3_stSSplyTstCond "F2510: Variable to measure the test conditions of the SSply monitoring system." UWORD X1_S1 1 100 0 65535 FORMAT "%8.2" ECU_ADDRESS 0xFFF95EC4 /end MEASUREMENT
/begin MEASUREMENT OutPShCirL3_tiLoBatt "F2523: Lag counter while battery voltage is too low (used at SSply supplied by low uM2 only)" UBYTE TI1_M_CYCLE_S1 1 100 0 1275 FORMAT "%5.0" ECU_ADDRESS 0xFFF95D65 /end MEASUREMENT
/begin MEASUREMENT OutPShCirL3_tiMonDly "F2510: Remaining time for the monitoring delay" UBYTE TI1_M_CYCLE_S1 1 100 0 1275 FORMAT "%5.0" ECU_ADDRESS 0xFFF95D66 /end MEASUREMENT
/begin MEASUREMENT OutPSSply5Mon_stSSply5Fault "F2511: Status of fault [B2: SB, B3: SG]" UWORD X1_S1 1 100 0 65535 FORMAT "%8.2" ECU_ADDRESS 0xFFF950B0 /end MEASUREMENT
/begin MEASUREMENT OutPSSply5Mon_stSSply5TstCond "F2511: Status of test condition [B2: SB, B3: SG]" UWORD X1_S1 1 100 0 65535 FORMAT "%8.2" ECU_ADDRESS 0xFFF950B2 /end MEASUREMENT
/begin MEASUREMENT OutPStlkIn_stStlkChpLine "F2550: Stores the position lever info. Needed to verify if it is allowed to activate the starter lock" UBYTE X1_S1 1 100 0 63 FORMAT "%5.2" ECU_ADDRESS 0xFFF95638 /end MEASUREMENT
/begin MEASUREMENT OutPStlkIn_stStlkPlrInfo "F2550: Status of current and last program cycle, if the starter lock should be off or on" UBYTE X1_S1 1 100 0 15 FORMAT "%5.2" ECU_ADDRESS 0xFFF95639 /end MEASUREMENT
/begin MEASUREMENT OutPStlkIn_tiStlkOff "F2550: Remaining monitoring delay from the starter lock state on to off" UWORD TI1_M_CYCLE_S1 1 100 0 327675 FORMAT "%8.1" ECU_ADDRESS 0xFFF95CA6 /end MEASUREMENT
/begin MEASUREMENT OutPStlkIn_tiStlkOn "F2550: Remaining monitoring delay from the starter lock state off to on" UBYTE TI1_M_CYCLE_S1 1 100 0 1275 FORMAT "%5.0" ECU_ADDRESS 0xFFF95D67 /end MEASUREMENT
/begin MEASUREMENT OutPStlkIn_uStlkStrtRly "F2550: Read back voltage of the starter lock signal" UWORD U0_001_S1 1 100 0 32 FORMAT "%8.5" ECU_ADDRESS 0xFFF950B4 /end MEASUREMENT
/begin MEASUREMENT OutPStlkMon_stStlkFault "F2525: Status of fault [B2: SB, B3: SG, B8: LO, B9: HI]" UWORD X1_S1 1 100 0 65535 FORMAT "%8.2" ECU_ADDRESS 0xFFF950B6 /end MEASUREMENT
/begin MEASUREMENT OutPStlkMon_stStlkTstCond "F2550: Status of test condition [B2: SB, B3: SG, B8: LO, B9: HI]" UWORD X1_S1 1 100 0 65535 FORMAT "%8.2" ECU_ADDRESS 0xFFF950B8 /end MEASUREMENT
/begin MEASUREMENT OutPStlkOut_bStlkOut "F2550: Status of starter lock control [0=Off, 1=On]" UBYTE B_TRUE_S1 1 100 0 1 FORMAT "%13.11" ECU_ADDRESS 0xFFF95135 /end MEASUREMENT
/begin MEASUREMENT OutPStlkOut_bStlkSpiOff "F2550: Switch off starter lock signal via SPI [0=Off, 1=On]" UBYTE B_TRUE_S1 1 100 0 1 FORMAT "%13.11" ECU_ADDRESS 0xFFF95136 /end MEASUREMENT
/begin MEASUREMENT OutPStlkOut_stStlk "F2550: Input status of starter lock control" UBYTE X1_S1 1 100 0 3 FORMAT "%5.3" ECU_ADDRESS 0xFFF95137 /end MEASUREMENT
/begin MEASUREMENT OutPStlkOut_tiStlkCtl "F2550: Timer in which the starter lock signal is hold on its value" UWORD TI1_M_CYCLE_S1 1 100 0 327675 FORMAT "%8.1" ECU_ADDRESS 0xFFF95C80 /end MEASUREMENT
/begin MEASUREMENT OutPStlkOut_tiStlkHwAck "F2550: Delay timer untill the HW has acknowledged the control signal" UWORD TI1_M_CYCLE_S1 1 100 0 327675 FORMAT "%8.1" ECU_ADDRESS 0xFFF95C82 /end MEASUREMENT
/begin MEASUREMENT PFCCtl_numMemArSizeUsd "F6100: Size of used memory space for PFC configuration (activation phase) [4byte]" UWORD X1_S1 1 100 0 65535 FORMAT "%8.2" ECU_ADDRESS 0xFFF94E6E /end MEASUREMENT
/begin MEASUREMENT PFCIni_ctChkPntCnt "F6100: PFC initialization check point counter" UBYTE X1_S1 1 100 0 255 FORMAT "%5.1" ECU_ADDRESS 0xFFF96409 /end MEASUREMENT
/begin MEASUREMENT PFCMn_bVldInfoPerm_a "F6100: Valid flag of stored fault information (non-volatile)" UBYTE X1_S1 1 100 0 255 FORMAT "%5.1" ARRAY_SIZE 2 ECU_ADDRESS 0xFFF95EA4 /end MEASUREMENT
/begin MEASUREMENT PFCMn_bVldInfo_a "F6100: Valid flag of stored fault information" UBYTE X1_S1 1 100 0 255 FORMAT "%5.1" ARRAY_SIZE 2 ECU_ADDRESS 0xFFF80D06 /end MEASUREMENT
/begin MEASUREMENT PFCMn_ctMdul "F6100: Number of currently activated program flow monitors" UWORD X1_S1 1 100 0 65535 FORMAT "%8.2" ECU_ADDRESS 0xFFF94C1A /end MEASUREMENT
/begin MEASUREMENT PFCMn_idxInfoNxt "F6100: Index for next fault information storage" UBYTE X1_S1 1 100 0 1 FORMAT "%5.3" ECU_ADDRESS 0xFFF80D1F /end MEASUREMENT
/begin MEASUREMENT PFCMn_idxInfoNxtPerm "F6100: Index for next fault information storage (non-volatile)" UBYTE X1_S1 1 100 0 1 FORMAT "%5.3" ECU_ADDRESS 0xFFF95EC7 /end MEASUREMENT
/begin MEASUREMENT PFCMn_numFlwIdInfoPerm_a "F6100: Program flow ID which has caused the fault (non-volatile)" UBYTE X1_S1 1 100 0 255 FORMAT "%5.1" ARRAY_SIZE 2 ECU_ADDRESS 0xFFF95EA6 /end MEASUREMENT
/begin MEASUREMENT PFCMn_numFlwIdInfo_a "F6100: Program flow ID which has caused the fault" UBYTE X1_S1 1 100 0 255 FORMAT "%5.1" ARRAY_SIZE 2 ECU_ADDRESS 0xFFF80D08 /end MEASUREMENT
/begin MEASUREMENT PFCMn_numId1InfoPerm_a "F6100: Check point ID which has caused the fault (non-volatile)" ULONG X1_S1 1 100 0 4294967295 FORMAT "%13.2" ARRAY_SIZE 2 ECU_ADDRESS 0xFFF95D94 /end MEASUREMENT
/begin MEASUREMENT PFCMn_numId1Info_a "F6100: Check point ID which has caused the fault" ULONG X1_S1 1 100 0 4294967295 FORMAT "%13.2" ARRAY_SIZE 2 ECU_ADDRESS 0xFFF80CD4 /end MEASUREMENT
/begin MEASUREMENT PFCMn_numId2InfoPerm_a "F6100: ID of check point which was reached directly before the fault (non-volatile)" ULONG X1_S1 1 100 0 4294967295 FORMAT "%13.2" ARRAY_SIZE 2 ECU_ADDRESS 0xFFF95D9C /end MEASUREMENT
/begin MEASUREMENT PFCMn_numId2Info_a "F6100: ID of check point which was reached directly before the fault" ULONG X1_S1 1 100 0 4294967295 FORMAT "%13.2" ARRAY_SIZE 2 ECU_ADDRESS 0xFFF80CDC /end MEASUREMENT
/begin MEASUREMENT RLim_cntRstCnt "F6260: Current value of reset counter" ULONG X1_S1 1 100 0 4294967295 FORMAT "%13.2" ECU_ADDRESS 0xFFF9467C /end MEASUREMENT
/begin MEASUREMENT SafRam_adDbgCpl "F6060: Address of failing complement" ULONG X1_S1 1 100 0 4294967295 FORMAT "%13.2" ARRAY_SIZE 5 ECU_ADDRESS 0xFFF80C84 /end MEASUREMENT
/begin MEASUREMENT SafRam_adDbgOrig "F6060: Address of failing original" ULONG X1_S1 1 100 0 4294967295 FORMAT "%13.2" ARRAY_SIZE 5 ECU_ADDRESS 0xFFF80C98 /end MEASUREMENT
/begin MEASUREMENT SafRam_datDbgCpl "F6060: failing complement" ULONG X1_S1 1 100 0 4294967295 FORMAT "%13.2" ARRAY_SIZE 5 ECU_ADDRESS 0xFFF80CAC /end MEASUREMENT
/begin MEASUREMENT SafRam_datDbgOrig "F6060: Failing original" ULONG X1_S1 1 100 0 4294967295 FORMAT "%13.2" ARRAY_SIZE 5 ECU_ADDRESS 0xFFF80CC0 /end MEASUREMENT
/begin MEASUREMENT SafRam_idxDbg "F6060: Index of latest failure information" UBYTE X1_S1 1 100 0 255 FORMAT "%5.1" ECU_ADDRESS 0xFFF80D18 /end MEASUREMENT
/begin MEASUREMENT SafRam_Tst16 "F6060: SAF RAM test variable 16 bit" UWORD X1_S1 1 100 0 65535 FORMAT "%8.2" ECU_ADDRESS 0xFFF96398 /end MEASUREMENT
/begin MEASUREMENT SafRam_Tst32 "F6060: SAF RAM test variable 32 bit" ULONG X1_S1 1 100 0 4294967295 FORMAT "%13.2" ECU_ADDRESS 0xFFF962AC /end MEASUREMENT
/begin MEASUREMENT SafRam_Tst8 "F6060: SAF RAM test variable 8 bit" UBYTE X1_S1 1 100 0 255 FORMAT "%5.1" ECU_ADDRESS 0xFFF96408 /end MEASUREMENT
/begin MEASUREMENT SafRam_xDbgInfo "F6060: Failure info" UBYTE X1_S1 1 100 0 255 FORMAT "%5.1" ARRAY_SIZE 5 ECU_ADDRESS 0xFFF80D19 /end MEASUREMENT
/begin MEASUREMENT Saf_stFaultInfo_A "F6000: SAF environmental condition A" UWORD X1_S1 1 100 0 65535 FORMAT "%8.2" ECU_ADDRESS 0xFFF94DA4 /end MEASUREMENT
/begin MEASUREMENT Saf_stFaultInfo_B "F6000: SAF environmental condition B" UWORD X1_S1 1 100 0 65535 FORMAT "%8.2" ECU_ADDRESS 0xFFF94DA6 /end MEASUREMENT
/begin MEASUREMENT Saf_stFaultInfo_C "F6000: SAF environmental condition C" UBYTE X1_S1 1 100 0 255 FORMAT "%5.1" ECU_ADDRESS 0xFFF95167 /end MEASUREMENT
/begin MEASUREMENT Saf_stFaultInfo_D "F6000: SAF environmental condition D" ULONG X1_S1 1 100 0 4294967295 FORMAT "%13.2" ECU_ADDRESS 0xFFF93C40 /end MEASUREMENT
/begin MEASUREMENT Sfrm_bErrHndlr "F6250: Status error handler at SFRM fault (FALSE = error handler ready, TRUE = error handler not ready)" UBYTE B_TRUE_S1 1 100 0 1 FORMAT "%13.11" ECU_ADDRESS 0xFFF95ECF /end MEASUREMENT
/begin MEASUREMENT Sfrm_idFaultSrcChn "F6250: Faulty channel of SFRM User" UBYTE X1_S1 1 100 0 255 FORMAT "%5.1" ECU_ADDRESS 0xFFF95ED0 /end MEASUREMENT
/begin MEASUREMENT Sfrm_idFaultSrcUsr "F6250: ID of the faulty SFRM user" UBYTE X1_S1 1 100 0 255 FORMAT "%5.1" ECU_ADDRESS 0xFFF95ED1 /end MEASUREMENT
/begin MEASUREMENT SFRM_stInfoCC08_a "F6250: SFRM timer information for CC08 per channel" ULONG X1_S1 1 100 0 4294967295 FORMAT "%13.2" ARRAY_SIZE 10 ECU_ADDRESS 0xFFF9633C /end MEASUREMENT
/begin MEASUREMENT SFRM_stInfoGMO_a "F6250: SFRM timer information for GMO per channel" ULONG X1_S1 1 100 0 4294967295 FORMAT "%13.2" ARRAY_SIZE 1 ECU_ADDRESS 0xFFF96364 /end MEASUREMENT
/begin MEASUREMENT SFRM_stInfoLSS_a "F6250: SFRM timer information for LSS per channel" ULONG X1_S1 1 100 0 4294967295 FORMAT "%13.2" ARRAY_SIZE 5 ECU_ADDRESS 0xFFF96368 /end MEASUREMENT
/begin MEASUREMENT SFRM_stInfoPSPLY_a "F6250: SFRM timer information for power supply per channel" ULONG X1_S1 1 100 0 4294967295 FORMAT "%13.2" ARRAY_SIZE 2 ECU_ADDRESS 0xFFF9637C /end MEASUREMENT
/begin MEASUREMENT SFRM_stInfoSAF_a "F6250:  SFRM timer information for SAF per channel" ULONG X1_S1 1 100 0 4294967295 FORMAT "%13.2" ARRAY_SIZE 4 ECU_ADDRESS 0xFFF96384 /end MEASUREMENT
/begin MEASUREMENT SFRM_tiDwnTmrCC08_a "F6250: SFRM Down-Timer for CC08 per channel" UBYTE TI1_M_CYCLE_S1 1 100 0 1275 FORMAT "%5.0" ARRAY_SIZE 10 ECU_ADDRESS 0xFFF95D02 /end MEASUREMENT
/begin MEASUREMENT SFRM_tiDwnTmrGMO_a "F6250: SFRM Down-Timer for GMO per channel" UBYTE TI1_M_CYCLE_S1 1 100 0 1275 FORMAT "%5.0" ARRAY_SIZE 1 ECU_ADDRESS 0xFFF95D59 /end MEASUREMENT
/begin MEASUREMENT SFRM_tiDwnTmrLSS_a "F6250: SFRM Down-Timer for LSS per channel" UBYTE TI1_M_CYCLE_S1 1 100 0 1275 FORMAT "%5.0" ARRAY_SIZE 5 ECU_ADDRESS 0xFFF95D5A /end MEASUREMENT
/begin MEASUREMENT SFRM_tiDwnTmrPSPLY_a "F6250: SFRM Down-Timer for power supply per channel" UBYTE TI1_M_CYCLE_S1 1 100 0 1275 FORMAT "%5.0" ARRAY_SIZE 2 ECU_ADDRESS 0xFFF95D0C /end MEASUREMENT
/begin MEASUREMENT SFRM_tiDwnTmrSAF_a "F6250: SFRM Down-Timer for SAF per channel" UBYTE TI1_M_CYCLE_S1 1 100 0 1275 FORMAT "%5.0" ARRAY_SIZE 4 ECU_ADDRESS 0xFFF95CA8 /end MEASUREMENT
/begin MEASUREMENT SFRM_tiUpTmrCC08_a "F6250: SFRM Up-Timer for CC08 per channel" UWORD TI1_M_CYCLE_S1 1 100 0 327675 FORMAT "%8.1" ARRAY_SIZE 10 ECU_ADDRESS 0xFFF95D68 /end MEASUREMENT
/begin MEASUREMENT SFRM_tiUpTmrGMO_a "F6250: SFRM Up-Timer for GMO per channel" UWORD TI1_M_CYCLE_S1 1 100 0 327675 FORMAT "%8.1" ARRAY_SIZE 1 ECU_ADDRESS 0xFFF95D88 /end MEASUREMENT
/begin MEASUREMENT SFRM_tiUpTmrLSS_a "F6250: SFRM Up-Timer for LSS per channel" UWORD TI1_M_CYCLE_S1 1 100 0 327675 FORMAT "%8.1" ARRAY_SIZE 5 ECU_ADDRESS 0xFFF95D8A /end MEASUREMENT
/begin MEASUREMENT SFRM_tiUpTmrPSPLY_a "F6250: SFRM Up-Timer for power supply per channel" UWORD TI1_M_CYCLE_S1 1 100 0 327675 FORMAT "%8.1" ARRAY_SIZE 2 ECU_ADDRESS 0xFFF95D7C /end MEASUREMENT
/begin MEASUREMENT SFRM_tiUpTmrSAF_a "F6250: SFRM Up-Timer for SAF per channel" UWORD TI1_M_CYCLE_S1 1 100 0 327675 FORMAT "%8.1" ARRAY_SIZE 4 ECU_ADDRESS 0xFFF95D80 /end MEASUREMENT
/begin MEASUREMENT Sfrm_xReqSwtOffPs "F6250: Request switch-off power stages (0xA5 = switch-off request enabled, 0x5A = switch-off request disabled)" UBYTE X1_S1 1 100 0 255 FORMAT "%5.1" ECU_ADDRESS 0xFFF96433 /end MEASUREMENT
/begin MEASUREMENT Sfrm_xReqSwtOffPsInt "F6250: Status internal SFRM fault reaction (0xA5 = SFRM fault reaction active, 0x5A = SFRM fault reaction not active)" UBYTE X1_S1 1 100 0 255 FORMAT "%5.1" ECU_ADDRESS 0xFFF955FB /end MEASUREMENT
/begin MEASUREMENT ShrOut_stFaultInfo_A "F9140: Environment condition for KFC_WDOG" UWORD X1_S1 1 100 0 65535 FORMAT "%8.2" ECU_ADDRESS 0xFFF94D7C /end MEASUREMENT
/begin MEASUREMENT ShrOut_stFaultInfo_B "F9140: Environment condition for KFC_WDOG" UWORD X1_S1 1 100 0 65535 FORMAT "%8.2" ECU_ADDRESS 0xFFF94D7E /end MEASUREMENT
/begin MEASUREMENT ShrSaf_stFaultInfo_A "F9110: Environment condition for KFC_MCCOMP" UBYTE X1_S1 1 100 0 255 FORMAT "%5.1" ECU_ADDRESS 0xFFF95575 /end MEASUREMENT
/begin MEASUREMENT ShrSaf_stFaultInfo_B "F9110: Environment condition for KFC_MCCOMP" ULONG X1_S1 1 100 0 4294967295 FORMAT "%13.2" ECU_ADDRESS 0xFFF9476C /end MEASUREMENT
/begin MEASUREMENT ShrSrv_bDsmRdy "F9110: Ready status of DSM" UBYTE B_TRUE_S1 1 100 0 1 FORMAT "%13.11" ECU_ADDRESS 0xFFF9512B /end MEASUREMENT
/begin MEASUREMENT ShrSrv_bDsmRdyCus "F9110: Ready status of customer DSM" UBYTE B_TRUE_S1 1 100 0 1 FORMAT "%13.11" ECU_ADDRESS 0xFFF9512C /end MEASUREMENT
/begin MEASUREMENT SpiHa_ctErrUnit "F2641: Error counter of the SPI-bus systems (index=bus-number) (wrap-around!) (Attention: index can be greater than the actual number of SPI channels available in the system)" UWORD X1_S1 1 100 0 65535 FORMAT "%8.2" ARRAY_SIZE 3 ECU_ADDRESS 0xFFF956D4 /end MEASUREMENT
/begin MEASUREMENT SrvShr_BETRSTD "F9110: operation duration in CRU operating state" ULONG TI1_MIN_S1 1 100 0 4294967295 FORMAT "%13.2" ECU_ADDRESS 0xFFF947D8 /end MEASUREMENT
/begin MEASUREMENT SrvShr_BETRSTD_INCL_STDBY "F9110: operation duration in CRU/LPH/SBY operating state" ULONG TI0_1_H_S1 1 100 0 429496729.5 FORMAT "%13.3" ECU_ADDRESS 0xFFF947DC /end MEASUREMENT
/begin MEASUREMENT SrvShr_bSSplyExtFault "F9120: flag for additional fault status (SSply external detection)" UBYTE B_TRUE_S1 1 100 0 1 FORMAT "%13.11" ECU_ADDRESS 0xFFF955B9 /end MEASUREMENT
/begin MEASUREMENT SrvShr_bSSplyExtTest "F9120: flag for additional test condition (SSply external detection)" UBYTE B_TRUE_S1 1 100 0 1 FORMAT "%13.11" ECU_ADDRESS 0xFFF955BA /end MEASUREMENT
/begin MEASUREMENT SrvShr_bSSplyReq "F9140: current sensor supply request (has to be toggled before a new one is accepted)" UBYTE X1_S1 1 100 0 255 FORMAT "%5.1" ECU_ADDRESS 0xFFF9512D /end MEASUREMENT
/begin MEASUREMENT SrvShr_CAN_ERROR_PIN "F9120: CAN current error status via pin info (0=no error, 1=error)" UBYTE X1_S1 1 100 0 255 FORMAT "%5.1" ECU_ADDRESS 0xFFF9557A /end MEASUREMENT
/begin MEASUREMENT SrvShr_CAN_WAKE_UP "F9120: CAN wakeup detected (only if available) (0=no, 1=yes)" UBYTE X1_S1 1 100 0 255 FORMAT "%5.1" ECU_ADDRESS 0xFFF9557B /end MEASUREMENT
/begin MEASUREMENT SrvShr_CCHIP1_RAW "F9120: measured CHIP1-temperature" UBYTE T1_OFFS_40_S1 1 100 -40 215 FORMAT "%5.1" ECU_ADDRESS 0xFFF955A8 /end MEASUREMENT
/begin MEASUREMENT SrvShr_CCHIP1_RAW_DI_RDY "F9120: CHIP1-sensor diagnosis status valid" UBYTE X1_S1 1 100 0 255 FORMAT "%5.1" ECU_ADDRESS 0xFFF955A9 /end MEASUREMENT
/begin MEASUREMENT SrvShr_CCHIP1_RAW_ESTATUS "F9120: CHIP1-sensor electrical status (0=ok, B3:PLAUS,B5:LOW,B6:HIGH)" UBYTE X1_S1 1 100 0 255 FORMAT "%5.1" ECU_ADDRESS 0xFFF955AA /end MEASUREMENT
/begin MEASUREMENT SrvShr_CCHIP2_RAW "F9120: measured CHIP2-temperature" UBYTE T1_OFFS_40_S1 1 100 -40 215 FORMAT "%5.1" ECU_ADDRESS 0xFFF955AB /end MEASUREMENT
/begin MEASUREMENT SrvShr_CCHIP2_RAW_DI_RDY "F9120: CHIP2-sensor diagnosis status valid" UBYTE X1_S1 1 100 0 255 FORMAT "%5.1" ECU_ADDRESS 0xFFF955AC /end MEASUREMENT
/begin MEASUREMENT SrvShr_CCHIP2_RAW_ESTATUS "F9120: CHIP2-sensor electrical status (0=ok, B5:LOW,B6:HIGH,B7:INITO)" UBYTE X1_S1 1 100 0 255 FORMAT "%5.1" ECU_ADDRESS 0xFFF955AD /end MEASUREMENT
/begin MEASUREMENT SrvShr_CGT_RAW "F9120: measured ATF-temperature" UBYTE T1_OFFS_40_S1 1 100 -40 215 FORMAT "%5.1" ECU_ADDRESS 0xFFF955AE /end MEASUREMENT
/begin MEASUREMENT SrvShr_CGT_RAW_DI_RDY "F9120: Atf-sensor diagnosis status valid" UBYTE X1_S1 1 100 0 255 FORMAT "%5.1" ECU_ADDRESS 0xFFF955AF /end MEASUREMENT
/begin MEASUREMENT SrvShr_CGT_RAW_ESTATUS "F9120: Atf-sensor electrical status (0=ok, B0:SG,B1:SB,B2:OP,B7:others)" UBYTE X1_S1 1 100 0 255 FORMAT "%5.1" ECU_ADDRESS 0xFFF955B0 /end MEASUREMENT
/begin MEASUREMENT SrvShr_ctPFCCfg_a "F9110: Number of currently configured check points (idx. 0=10ms tasks, 1=20ms tasks, 2=30ms tasks)" UWORD X1_S1 1 100 0 65535 FORMAT "%8.2" ARRAY_SIZE 3 ECU_ADDRESS 0xFFF94E02 /end MEASUREMENT
/begin MEASUREMENT SrvShr_ctSdnFast "F9140: free running counter for fast shutdown requests" UWORD X1_S1 1 100 0 65535 FORMAT "%8.2" ECU_ADDRESS 0xFFF95EA8 /end MEASUREMENT
/begin MEASUREMENT SrvShr_DC_TRQ "F9120: PWM duty of torque input" UWORD R0_1_P_S1 1 100 0 6553.5 FORMAT "%8.3" ECU_ADDRESS 0xFFF94E9A /end MEASUREMENT
/begin MEASUREMENT SrvShr_DC_TRQ_ESTATUS "F9120: diagnosis information of PWM torque input (B0:SG,B1:SB,B2:OP, B3:wrong period)" UBYTE X1_S1 1 100 0 255 FORMAT "%5.1" ECU_ADDRESS 0xFFF9557C /end MEASUREMENT
/begin MEASUREMENT SrvShr_idxTapAnaRng "F9120: Current analog range of tap input line" UBYTE X1_S1 1 100 0 15 FORMAT "%5.2" ECU_ADDRESS 0xFFF955A1 /end MEASUREMENT
/begin MEASUREMENT SrvShr_idxTapAnaRngOld "F9120: Analog range of tap input line from last cycle" UBYTE X1_S1 1 100 0 15 FORMAT "%5.2" ECU_ADDRESS 0xFFF955A2 /end MEASUREMENT
/begin MEASUREMENT SrvShr_idxTapAnaRngUse "F9120: Used analog tap range for setting interface signals" UBYTE X1_S1 1 100 0 15 FORMAT "%5.2" ECU_ADDRESS 0xFFF955A3 /end MEASUREMENT
/begin MEASUREMENT SrvShr_IN0 "F9120: Digital status of IN0 line" UBYTE X1_S1 1 100 0 255 FORMAT "%5.1" ECU_ADDRESS 0xFFF9560E /end MEASUREMENT
/begin MEASUREMENT SrvShr_IN0_ESTATUS "F9120: bitcoded diagnosis status of IN0 line (0=no error)" UBYTE X1_S1 1 100 0 255 FORMAT "%5.1" ECU_ADDRESS 0xFFF9560F /end MEASUREMENT
/begin MEASUREMENT SrvShr_LX "F9120: measured position information (idx=2/3=park information)" UBYTE X1_S1 1 100 0 255 FORMAT "%5.1" ARRAY_SIZE 4 ECU_ADDRESS 0xFFF84B78 /end MEASUREMENT
/begin MEASUREMENT SrvShr_LX_DI_RDY "F9120: position information diagnosis status valid" UBYTE X1_S1 1 100 0 255 FORMAT "%5.1" ARRAY_SIZE 4 ECU_ADDRESS 0xFFF94770 /end MEASUREMENT
/begin MEASUREMENT SrvShr_LX_ESTATUS "F9120: position information electrical status (0=ok, B0:SG,B1:SB,B2:OP,B3:undef)" UBYTE X1_S1 1 100 0 255 FORMAT "%5.1" ARRAY_SIZE 4 ECU_ADDRESS 0xFFF84B7C /end MEASUREMENT
/begin MEASUREMENT SrvShr_LX_ESTATUS_KOMP "F9120: complementary position information electrical status" UBYTE X1_S1 1 100 0 255 FORMAT "%5.1" ARRAY_SIZE 4 ECU_ADDRESS 0xFFF84B80 /end MEASUREMENT
/begin MEASUREMENT SrvShr_LX_KOMP "F9120: complementary position information" UBYTE X1_S1 1 100 0 255 FORMAT "%5.1" ARRAY_SIZE 4 ECU_ADDRESS 0xFFF84B84 /end MEASUREMENT
/begin MEASUREMENT SrvShr_NAB_DI_RDY "F9120: transmission output speed diagnosis status valid" UBYTE X1_S1 1 100 0 255 FORMAT "%5.1" ECU_ADDRESS 0xFFF955B5 /end MEASUREMENT
/begin MEASUREMENT SrvShr_NAB_ESTATUS "F9120: transmission output speed electrical status (0=ok, B0:SG,B1:SB,B2:OP)" UBYTE X1_S1 1 100 0 255 FORMAT "%5.1" ECU_ADDRESS 0xFFF955B6 /end MEASUREMENT
/begin MEASUREMENT SrvShr_NAB_PULSE_WIDTH "F9120: transmission output speed direction pulse width" UBYTE TI1_U_S1 1 100 0 255 FORMAT "%5.1" ECU_ADDRESS 0xFFF955B7 /end MEASUREMENT
/begin MEASUREMENT SrvShr_NAB_SUM_PULSES "F9120: transmission output speed pulse counter since last detected signal edge" UBYTE X1_S1 1 100 0 255 FORMAT "%5.1" ECU_ADDRESS 0xFFF955B8 /end MEASUREMENT
/begin MEASUREMENT SrvShr_NAB_SUM_PULSE_TIME "F9120: transmission output speed time difference to last detected signal edge" ULONG TI1_U_S1 1 100 0 4294967295 FORMAT "%13.2" ECU_ADDRESS 0xFFF947C4 /end MEASUREMENT
/begin MEASUREMENT SrvShr_NT_DI_RDY "F9120: transmission input speed diagnosis status valid" UBYTE X1_S1 1 100 0 255 FORMAT "%5.1" ECU_ADDRESS 0xFFF955B1 /end MEASUREMENT
/begin MEASUREMENT SrvShr_NT_ESTATUS "F9120: transmission input speed electrical status (0=ok, B0:SG,B1:SB,B2:OP)" UBYTE X1_S1 1 100 0 255 FORMAT "%5.1" ECU_ADDRESS 0xFFF955B2 /end MEASUREMENT
/begin MEASUREMENT SrvShr_NT_PULSE_WIDTH "F9120: transmission input speed direction pulse width" UBYTE TI1_U_S1 1 100 0 255 FORMAT "%5.1" ECU_ADDRESS 0xFFF955B3 /end MEASUREMENT
/begin MEASUREMENT SrvShr_NT_SUM_PULSES "F9120: transmission input speed pulse counter since last detected signal edge" UBYTE X1_S1 1 100 0 255 FORMAT "%5.1" ECU_ADDRESS 0xFFF955B4 /end MEASUREMENT
/begin MEASUREMENT SrvShr_NT_SUM_PULSE_TIME "F9120: transmission input speed time difference to last detected signal edge" ULONG TI1_U_S1 1 100 0 4294967295 FORMAT "%13.2" ECU_ADDRESS 0xFFF947C0 /end MEASUREMENT
/begin MEASUREMENT SrvShr_numMemArSizeUsd_a "F9110: Size of used memory space for PFC configuration (activation phase) (idx. 0=10ms tasks, 1=20ms tasks, 2=30ms tasks) [4byte]" UWORD X1_S1 1 100 0 65535 FORMAT "%8.2" ARRAY_SIZE 3 ECU_ADDRESS 0xFFF94E08 /end MEASUREMENT
/begin MEASUREMENT SrvShr_numMemArSize_a "F9110: Size of passed memory space for PFC configuration (activation phase) (idx. 0=10ms tasks, 1=20ms tasks, 2=30ms tasks) [4byte]" UWORD X1_S1 1 100 0 65535 FORMAT "%8.2" ARRAY_SIZE 3 ECU_ADDRESS 0xFFF94E0E /end MEASUREMENT
/begin MEASUREMENT SrvShr_numPFCCfgMax_a "F9110: Maximal number of configurable check points (idx. 0=10ms tasks, 1=20ms tasks, 2=30ms tasks)" UWORD X1_S1 1 100 0 65535 FORMAT "%8.2" ARRAY_SIZE 3 ECU_ADDRESS 0xFFF94E14 /end MEASUREMENT
/begin MEASUREMENT SrvShr_POSINFO_MULTIPLICATOR "F9140: position information multiplier" UBYTE X1_S1 1 100 0 255 FORMAT "%5.1" ECU_ADDRESS 0xFFF9512A /end MEASUREMENT
/begin MEASUREMENT SrvShr_RND32_EWS4 "F9110: seed for random number" ULONG X1_S1 1 100 0 4294967295 FORMAT "%13.2" ARRAY_SIZE 4 ECU_ADDRESS 0xFFF947C8 /end MEASUREMENT
/begin MEASUREMENT SrvShr_SENSORINIT_DONE "F9140: sensor supply initialization done (B0=yes,B4=temp.reinit requested)" UBYTE X1_S1 1 100 0 255 FORMAT "%5.1" ECU_ADDRESS 0xFFF9512E /end MEASUREMENT
/begin MEASUREMENT SrvShr_SHUTDOWN "F9140: requested shutdown info (0=no request,1=normal shutdown,2=fast shutdown)" UBYTE X1_S1 1 100 0 255 FORMAT "%5.1" ECU_ADDRESS 0xFFF9512F /end MEASUREMENT
/begin MEASUREMENT SrvShr_START_INHIBITOR_STATUS "F9140: starter lock control (0=lock,1=N,2=P,3=init)" UBYTE X1_S1 1 100 0 255 FORMAT "%5.1" ECU_ADDRESS 0xFFF95130 /end MEASUREMENT
/begin MEASUREMENT SrvShr_stAtf_Fault "F9120: bitcoded Atf/CGT fault status (memorized information)" UWORD X1_S1 1 100 0 65535 FORMAT "%8.2" ECU_ADDRESS 0xFFF94EF4 /end MEASUREMENT
/begin MEASUREMENT SrvShr_stChp1_Fault "F9120: bitcoded Chp1/CCHIP1 fault status (memorized information)" UWORD X1_S1 1 100 0 65535 FORMAT "%8.2" ECU_ADDRESS 0xFFF94EF6 /end MEASUREMENT
/begin MEASUREMENT SrvShr_stFaultMCCOMP "F9110: Faults of fault code KFC_MCCOMP" UBYTE X1_S1 1 100 0 255 FORMAT "%5.1" ECU_ADDRESS 0xFFF95576 /end MEASUREMENT
/begin MEASUREMENT SrvShr_stFaultSFRM "F9110: Faults of fault code KFC_SFRM" UBYTE X1_S1 1 100 0 255 FORMAT "%5.1" ECU_ADDRESS 0xFFF95577 /end MEASUREMENT
/begin MEASUREMENT SrvShr_stPsns_Fault "F9120: bit coded Psns/Lx fault status (memorized information)" UWORD X1_S1 1 100 0 65535 FORMAT "%8.2" ARRAY_SIZE 4 ECU_ADDRESS 0xFFF94774 /end MEASUREMENT
/begin MEASUREMENT SrvShr_stRomFault "F9110: Bit map for detected checksum faults" UWORD X1_S1 1 100 0 65535 FORMAT "%8.2" ECU_ADDRESS 0xFFF94E00 /end MEASUREMENT
/begin MEASUREMENT SrvShr_stSdnWakFilt "F9140: wake filter" UWORD X1_S1 1 100 0 65535 FORMAT "%8.2" ECU_ADDRESS 0xFFF94D80 /end MEASUREMENT
/begin MEASUREMENT SrvShr_stSSplyExtFault "F9120: bit coded fault status of connected sensors (0:NT 1:NAB)" UBYTE X1_S1 1 100 0 255 FORMAT "%5.1" ECU_ADDRESS 0xFFF955BB /end MEASUREMENT
/begin MEASUREMENT SrvShr_stSSplyExtFaultOld "F9120: last state of SrvShr_stSSplyExtFault" UBYTE X1_S1 1 100 0 255 FORMAT "%5.1" ECU_ADDRESS 0xFFF955BC /end MEASUREMENT
/begin MEASUREMENT SrvShr_stSSply_Fault "F9120: bit coded SSply fault status" UWORD X1_S1 1 100 0 65535 FORMAT "%8.2" ARRAY_SIZE 1 ECU_ADDRESS 0xFFF94EFC /end MEASUREMENT
/begin MEASUREMENT SrvShr_stSSply_KFA "F9120: fault type reported to DI_FILTER (B0-B3:KFA, B4=OK)" UBYTE X1_S1 1 100 0 255 FORMAT "%5.1" ARRAY_SIZE 1 ECU_ADDRESS 0xFFF955BD /end MEASUREMENT
/begin MEASUREMENT SrvShr_stSSply_Test "F9120: SSply test condition bitmask" UWORD X1_S1 1 100 0 65535 FORMAT "%8.2" ARRAY_SIZE 1 ECU_ADDRESS 0xFFF94EFE /end MEASUREMENT
/begin MEASUREMENT SrvShr_stTipInfo "F9120: Bit coded status info (B0=no timeout/init,B1=new signal,B2=multiplier-error,B3=comparison-error,B4=Th-error)" UBYTE X1_S1 1 100 0 255 FORMAT "%5.1" ECU_ADDRESS 0xFFF95128 /end MEASUREMENT
/begin MEASUREMENT SrvShr_stTis_Fault "F9120: bitcoded Tis/NT fault status (memorized information)" UWORD X1_S1 1 100 0 65535 FORMAT "%8.2" ECU_ADDRESS 0xFFF94EF8 /end MEASUREMENT
/begin MEASUREMENT SrvShr_stTos_Fault "F9120: bitcoded Tos/NAB fault status (memorized information)" UWORD X1_S1 1 100 0 65535 FORMAT "%8.2" ECU_ADDRESS 0xFFF94EFA /end MEASUREMENT
/begin MEASUREMENT SrvShr_stTstMCCOMP "F9110: Test conditions of fault code KFC_MCCOMP" UBYTE X1_S1 1 100 0 255 FORMAT "%5.1" ECU_ADDRESS 0xFFF95578 /end MEASUREMENT
/begin MEASUREMENT SrvShr_stTstSFRM "F9110: Test conditions of fault code KFC_SFRM" UBYTE X1_S1 1 100 0 255 FORMAT "%5.1" ECU_ADDRESS 0xFFF95579 /end MEASUREMENT
/begin MEASUREMENT SrvShr_tiOpCruTemp "F9110: time measurement of CRU operation" ULONG TI0_001_S1 1 100 0 4294967.295 FORMAT "%13.5" ECU_ADDRESS 0xFFF947E0 /end MEASUREMENT
/begin MEASUREMENT SrvShr_tiOpTemp "F9110: time measurement of SBY/CRU/LPH operation" ULONG TI0_001_S1 1 100 0 4294967.295 FORMAT "%13.5" ECU_ADDRESS 0xFFF947E4 /end MEASUREMENT
/begin MEASUREMENT SrvShr_TIPINFO_HIGHIMPULS_MAX "F9120: high pulse maximum timing (limited to 65.5ms)" UWORD TI1_U_S1 1 100 0 65535 FORMAT "%8.2" ECU_ADDRESS 0xFFF94D74 /end MEASUREMENT
/begin MEASUREMENT SrvShr_TIPINFO_HIGHIMPULS_MIN "F9120: high pulse minimum timing (limited to 65.5ms)" UWORD TI1_U_S1 1 100 0 65535 FORMAT "%8.2" ECU_ADDRESS 0xFFF94D76 /end MEASUREMENT
/begin MEASUREMENT SrvShr_TIPINFO_LOWIMPULS_MAX "F9120: low pulse maximum timing (limited to 65.5ms)" UWORD TI1_U_S1 1 100 0 65535 FORMAT "%8.2" ECU_ADDRESS 0xFFF94D78 /end MEASUREMENT
/begin MEASUREMENT SrvShr_TIPINFO_LOWIMPULS_MIN "F9120: low pulse minimum timing (limited to 65.5ms)" UWORD TI1_U_S1 1 100 0 65535 FORMAT "%8.2" ECU_ADDRESS 0xFFF94D7A /end MEASUREMENT
/begin MEASUREMENT SrvShr_TIPINFO_MULTIPLICATOR "F9120: tip information multiplier (0=no info, 255=timing error, 1-15:multipl.)" UBYTE X1_S1 1 100 0 255 FORMAT "%5.1" ECU_ADDRESS 0xFFF95129 /end MEASUREMENT
/begin MEASUREMENT SrvShr_TIP_ANALOG_DI_RDY "F9120: test condition for analog Tap diagnosis" UBYTE X1_S1 1 100 0 255 FORMAT "%5.1" ECU_ADDRESS 0xFFF955A4 /end MEASUREMENT
/begin MEASUREMENT SrvShr_TIP_ANALOG_ESTATUS "F9120: bitcoded diagnosis status of analog Tap-line (B0:SG,B1:SB,B2:OP,B3:PLAUSI)" UBYTE X1_S1 1 100 0 255 FORMAT "%5.1" ECU_ADDRESS 0xFFF955A5 /end MEASUREMENT
/begin MEASUREMENT SrvShr_TIP_MINUS_ANALOG "F9120: Status of analog Tap (FALSE=off, TRUE=on)" UBYTE X1_S1 1 100 0 255 FORMAT "%5.1" ECU_ADDRESS 0xFFF955A6 /end MEASUREMENT
/begin MEASUREMENT SrvShr_TIP_MINUS_PIN "F9120: Digital status of TapMinus line" UBYTE X1_S1 1 100 0 255 FORMAT "%5.1" ECU_ADDRESS 0xFFF95610 /end MEASUREMENT
/begin MEASUREMENT SrvShr_TIP_MINUS_PIN_ESTATUS "F9120: bitcoded diagnosis status of TapMinus line (0=no error)" UBYTE X1_S1 1 100 0 255 FORMAT "%5.1" ECU_ADDRESS 0xFFF95611 /end MEASUREMENT
/begin MEASUREMENT SrvShr_TIP_PIN_DI_RDY "F9120: test condition for TabPlus/Minus diagnosis" UBYTE X1_S1 1 100 0 255 FORMAT "%5.1" ECU_ADDRESS 0xFFF95612 /end MEASUREMENT
/begin MEASUREMENT SrvShr_TIP_PLUS_ANALOG "F9120: Status of analog Tap (FALSE=off, TRUE=on)" UBYTE X1_S1 1 100 0 255 FORMAT "%5.1" ECU_ADDRESS 0xFFF955A7 /end MEASUREMENT
/begin MEASUREMENT SrvShr_TIP_PLUS_PIN "F9120: Digital status of TapPlus line" UBYTE X1_S1 1 100 0 255 FORMAT "%5.1" ECU_ADDRESS 0xFFF95613 /end MEASUREMENT
/begin MEASUREMENT SrvShr_TIP_PLUS_PIN_ESTATUS "F9120: bitcoded diagnosis status of TapPlus line (0=no error)" UBYTE X1_S1 1 100 0 255 FORMAT "%5.1" ECU_ADDRESS 0xFFF95614 /end MEASUREMENT
/begin MEASUREMENT SrvShr_tiSSplyExtChk "F9120: timer to detect simultaneous fault in connected sensors" UBYTE TI1_M_CYCLE_S1 1 100 0 1275 FORMAT "%5.0" ECU_ADDRESS 0xFFF95D37 /end MEASUREMENT
/begin MEASUREMENT SrvShr_tiTapAnaRngStb "F9120: Analog Tap input: Timer for not changed analog range" UBYTE TI1_M_CYCLE_S1 1 100 0 1275 FORMAT "%5.0" ECU_ADDRESS 0xFFF95D36 /end MEASUREMENT
/begin MEASUREMENT SrvShr_tiTipInfoHigh "F9120: currently registered high-time (raw info)" ULONG TI1_U_S1 1 100 0 4294967295 FORMAT "%13.2" ECU_ADDRESS 0xFFF93104 /end MEASUREMENT
/begin MEASUREMENT SrvShr_tiTipInfoHighLast "F9120: previously registered high-time (raw info)" ULONG TI1_U_S1 1 100 0 4294967295 FORMAT "%13.2" ECU_ADDRESS 0xFFF93108 /end MEASUREMENT
/begin MEASUREMENT SrvShr_tiTipInfoLow "F9120: currently registered low-time (raw info)" ULONG TI1_U_S1 1 100 0 4294967295 FORMAT "%13.2" ECU_ADDRESS 0xFFF9310C /end MEASUREMENT
/begin MEASUREMENT SrvShr_tiTipInfoMeas "F9120: Measurement counter to reinitialize the MIN/MAX measurement" UWORD TI1_CYCLE_S1 1 100 0 6553.5 FORMAT "%8.3" ECU_ADDRESS 0xFFF95C46 /end MEASUREMENT
/begin MEASUREMENT SrvShr_UBATT_FILT "F9120: measured battery voltage" UWORD U0_001_S1 1 100 0 65.535 FORMAT "%8.5" ECU_ADDRESS 0xFFF94F00 /end MEASUREMENT
/begin MEASUREMENT SrvShr_UDRMV1 "F9120: measured actuator-power-supply 1" UWORD U0_001_S1 1 100 0 65.535 FORMAT "%8.5" ECU_ADDRESS 0xFFF94F02 /end MEASUREMENT
/begin MEASUREMENT SrvShr_UDRMV2 "F9120: measured actuator-power-supply 2" UWORD U0_001_S1 1 100 0 65.535 FORMAT "%8.5" ECU_ADDRESS 0xFFF94F04 /end MEASUREMENT
/begin MEASUREMENT SrvShr_USENSOR "F9120: measured sensor-power-supply" UWORD U0_001_S1 1 100 0 65.535 FORMAT "%8.5" ARRAY_SIZE 1 ECU_ADDRESS 0xFFF94F06 /end MEASUREMENT
/begin MEASUREMENT SrvShr_USENSOR_DI_RDY "F9120: sensor supply diagnosis status valid" UBYTE X1_S1 1 100 0 255 FORMAT "%5.1" ARRAY_SIZE 1 ECU_ADDRESS 0xFFF955BE /end MEASUREMENT
/begin MEASUREMENT SrvShr_USENSOR_ESTATUS "F9120: sensor supply electrical status (B2:OP via connected sensors,B5:ZUKL/SG,B6:ZUGR/SB)" UBYTE X1_S1 1 100 0 255 FORMAT "%5.1" ARRAY_SIZE 1 ECU_ADDRESS 0xFFF84D1B /end MEASUREMENT
/begin MEASUREMENT SrvShr_USENSOR_ESTATUS_KOMP "F9120: complementary sensor supply electrical status" UBYTE X1_S1 1 100 0 255 FORMAT "%5.1" ARRAY_SIZE 1 ECU_ADDRESS 0xFFF84D1C /end MEASUREMENT
/begin MEASUREMENT SrvShr_uTapAna "F9120: Voltage of analog tap line" UWORD U0_001_S1 1 100 0 65.535 FORMAT "%8.5" ECU_ADDRESS 0xFFF94EF0 /end MEASUREMENT
/begin MEASUREMENT SrvShr_U_IN0 "F9120: Voltage of IN0" UWORD U0_001_S1 1 100 0 25 FORMAT "%8.5" ECU_ADDRESS 0xFFF9501C /end MEASUREMENT
/begin MEASUREMENT SrvShr_U_IN1 "F9120: Voltage of IN1" UWORD U0_001_S1 1 100 0 25 FORMAT "%8.5" ECU_ADDRESS 0xFFF9501E /end MEASUREMENT
/begin MEASUREMENT SrvShr_U_IN2 "F9120: Voltage of IN2" UWORD U0_001_S1 1 100 0 25 FORMAT "%8.5" ECU_ADDRESS 0xFFF95020 /end MEASUREMENT
/begin MEASUREMENT SrvShr_U_IN3 "F9120: Voltage of IN3" UWORD U0_001_S1 1 100 0 5 FORMAT "%8.6" ECU_ADDRESS 0xFFF94EF2 /end MEASUREMENT
/begin MEASUREMENT SrvShr_U_KL15_PIN "F9120: analog KL15 pin information" UWORD U0_001_S1 1 100 0 65.535 FORMAT "%8.5" ECU_ADDRESS 0xFFF94E9C /end MEASUREMENT
/begin MEASUREMENT SrvShr_U_PN_RAW "F9120: measured PN-pin voltage" UWORD U0_001_S1 1 100 0 65.535 FORMAT "%8.5" ECU_ADDRESS 0xFFF94F08 /end MEASUREMENT
/begin MEASUREMENT SrvShr_WDOG_DI_RDY "F9140: test condition related to the safety system" UBYTE X1_S1 1 100 0 255 FORMAT "%5.1" ECU_ADDRESS 0xFFF95131 /end MEASUREMENT
/begin MEASUREMENT SrvShr_WDOG_ESTATUS "F9140: error status information related to the safety system (B0:INIT,B1:DN,B2:PCLK,B3:WD-HW,B4:WD-SW)" UBYTE X1_S1 1 100 0 255 FORMAT "%5.1" ECU_ADDRESS 0xFFF95132 /end MEASUREMENT
/begin MEASUREMENT WdCtlStd_sComMode "F6200: IWD communication mode - standard mode (0x0=valid response + timing too early, 0x7=valid response + timing too late, 0x19=invalid response + correct timing, 0x1E=valid response + correct timing, 0x2A=synchronization request)" UBYTE X1_S1 1 100 0 42 FORMAT "%5.2" ECU_ADDRESS 0xFFF96436 /end MEASUREMENT
/begin MEASUREMENT WdDia_stFaultBuf "F6200: The fault bit vector buffer (faults that shall be delivered to the error handler)" UWORD X1_S1 1 100 0 65535 FORMAT "%8.2" ECU_ADDRESS 0xFFF950BA /end MEASUREMENT
/begin MEASUREMENT WdDia_stFaultDebActv "F6200: The actively debouncing fault bit vector (debounce counter of appropriate fault > 0)" UWORD X1_S1 1 100 0 65535 FORMAT "%8.2" ECU_ADDRESS 0xFFF950BC /end MEASUREMENT
/begin MEASUREMENT WdDia_stTstBuf "F6200: The test condition bit vector buffer (test conditions for the faults that shall be delivered to the error handler)" UWORD X1_S1 1 100 0 65535 FORMAT "%8.2" ECU_ADDRESS 0xFFF950BE /end MEASUREMENT
/begin MEASUREMENT WdIpt_ctTOut "F6200: Timeout counter / status (0=counter is disabled, 1=timeout has occured, otherwise counter is running (current value = value - 1))" UBYTE X1_S1 1 100 0 255 FORMAT "%5.1" ECU_ADDRESS 0xFFF9563A /end MEASUREMENT
/begin MEASUREMENT WdIpt_sComMode "F6200: IWD communication mode during IPT mode (0x0=SYNC, 0x7=DECR and 0x19=INCR)" UBYTE X1_S1 1 100 0 25 FORMAT "%5.2" ECU_ADDRESS 0xFFF9563B /end MEASUREMENT
/begin MEASUREMENT WdIpt_sTgtLvlReq "F6200: Requested IWD target level (0x0=Level C, 0x3=Level B, 0x5=Level A)" UBYTE X1_S1 1 100 0 5 FORMAT "%5.3" ECU_ADDRESS 0xFFF96437 /end MEASUREMENT
/begin MEASUREMENT WdMnExtd_bFrstT "F6200: Flag for current run mode active the first time (TRUE=run mode active the first time, FALSE=otherwise)" UBYTE B_TRUE_S1 1 100 0 1 FORMAT "%13.11" ECU_ADDRESS 0xFFF96434 /end MEASUREMENT
/begin MEASUREMENT WdMnExtd_sRunMode "F6200: Current IWD handling mode (0x0=STRT, 0x8=INIT, 0x12=NONOP, 0x23=OP, 0x34=ACTIVE_OFF, 0x45=ACTIVE_ON)" UBYTE X1_S1 1 100 0 69 FORMAT "%5.2" ECU_ADDRESS 0xFFF96435 /end MEASUREMENT
/begin MEASUREMENT WdResp_adMdulMonFault_ps "F6200: Address of monitored module which at last has cause the checksum fault" ULONG X1_S1 1 100 0 4294967295 FORMAT "%13.2" ECU_ADDRESS 0xFFF93C48 /end MEASUREMENT
/begin MEASUREMENT WdResp_ctCyclCnt "F6200: Number of process execution cycles since last update of the monitored module data structures" UBYTE X1_S1 1 100 0 127 FORMAT "%5.1" ECU_ADDRESS 0xFFF95173 /end MEASUREMENT
/begin MEASUREMENT WdResp_ctCyclCntRmn "F6200: Number of remaining process execution cycles until next update of the monitored module data structures" UBYTE X1_S1 1 100 0 127 FORMAT "%5.1" ECU_ADDRESS 0xFFF95174 /end MEASUREMENT
/begin MEASUREMENT WdResp_ctMdulMonCnt "F6200: Number of currently monitored modules" UBYTE X1_S1 1 100 0 127 FORMAT "%5.1" ECU_ADDRESS 0xFFF95175 /end MEASUREMENT
/begin MEASUREMENT WdResp_numCyclCntUpd "F6200: Buffered number of process execution cycles until next update of the monitored module data structures" UBYTE X1_S1 1 100 0 127 FORMAT "%5.1" ECU_ADDRESS 0xFFF95176 /end MEASUREMENT
/begin MEASUREMENT WdResp_xKey "F6200: Encryption key for an encrypted response references" ULONG X1_S1 1 100 0 4294967295 FORMAT "%13.2" ECU_ADDRESS 0xFFF93C4C /end MEASUREMENT
/begin MEASUREMENT WdResp_xListKey "F6200: Current global list key" UBYTE X1_S1 1 100 0 255 FORMAT "%5.1" ECU_ADDRESS 0xFFF95177 /end MEASUREMENT
/begin MEASUREMENT WdSrv_ctIdl "F6200: Counter for idle time" UBYTE X1_S1 1 100 0 255 FORMAT "%5.1" ECU_ADDRESS 0xFFF9640C /end MEASUREMENT
/begin MEASUREMENT WdSrv_ctNoDatErrCnt "F6200: Fault counter for missing (SPI) data from the ECE respectively IWD (counter will be healed down if the fault condition(s) will disappear)" UBYTE X1_S1 1 100 0 255 FORMAT "%5.1" ECU_ADDRESS 0xFFF95178 /end MEASUREMENT
/begin MEASUREMENT WdSrv_ctSPIErrCnt "F6200: Fault counter for failed SPI communication (counter will be healed down if the fault condition(s) will disappear)" UBYTE X1_S1 1 100 0 255 FORMAT "%5.1" ECU_ADDRESS 0xFFF95179 /end MEASUREMENT
/begin MEASUREMENT WdSrv_ctSyncErrCnt "F6200: Fault counter for unexpected communication faults between IWD and CPU (counter will be healed down if the fault condition(s) will disappear)" UBYTE X1_S1 1 100 0 255 FORMAT "%5.1" ECU_ADDRESS 0xFFF9517A /end MEASUREMENT
/begin MEASUREMENT WdSrv_ctSyncErrCntStats "F6200: Statistic fault counter for unexpected communication faults between IWD and CPU" UWORD X1_S1 1 100 0 65535 FORMAT "%8.2" ECU_ADDRESS 0xFFF94DBE /end MEASUREMENT
/begin MEASUREMENT WdSrv_ctWdErrCnt "F6200: CPU side copy of the IWD internal error counter" UBYTE X1_S1 1 100 0 7 FORMAT "%5.3" ECU_ADDRESS 0xFFF9517B /end MEASUREMENT
/begin MEASUREMENT WdSrv_ctWdErrCntMax "F6200: Maximal reached value of the CPU side copy of the IWD internal error counter" UBYTE X1_S1 1 100 0 7 FORMAT "%5.3" ECU_ADDRESS 0xFFF95EC8 /end MEASUREMENT
/begin MEASUREMENT WdSrv_ctWdErrCntRef "F6200: Reference error counter for comparison with IWD internal error counter" UBYTE X1_S1 1 100 0 7 FORMAT "%5.3" ECU_ADDRESS 0xFFF9517C /end MEASUREMENT
/begin MEASUREMENT WdSrv_sRespMdfyMode "F6200: Response manipulation mode (0x0=too early + correct response, 0x7=too late + correct response, 0x19=correct in time + incorrect response, 0x1E=correct in time + correct response)" UBYTE X1_S1 1 100 0 30 FORMAT "%5.2" ECU_ADDRESS 0xFFF9640D /end MEASUREMENT
/begin MEASUREMENT WdSrv_sSrvSt "F6200: State of communication between CPU and IWD (0x0=communication is ready, 0x7=communication is active, 0x19=communication is active with an additional waiting cycle)" UBYTE X1_S1 1 100 0 25 FORMAT "%5.2" ECU_ADDRESS 0xFFF9517D /end MEASUREMENT
/begin MEASUREMENT WdSrv_sSyncSt "F6200: Synchronization state (derived from difference between counter WdSrv_ctWdErrCnt and WdSrv_ctWdErrCntRef) (0x0=counters show the same values, 0x7=counters show (possibly) different values, 0x19=synchronization request is currently in progress)" UBYTE X1_S1 1 100 0 25 FORMAT "%5.2" ECU_ADDRESS 0xFFF9517E /end MEASUREMENT
/begin MEASUREMENT WdSrv_stWdStRef "F6200: Reference status for comparison with the IWD status (subset of the SPI register REQUHI)" UBYTE X1_S1 1 100 0 255 FORMAT "%5.1" ECU_ADDRESS 0xFFF9517F /end MEASUREMENT
/begin MEASUREMENT WdSrv_tiConst "F6200: Timing constants" UWORD TI1_U_S1 1 100 0 65535 FORMAT "%8.2" ARRAY_SIZE 5 ECU_ADDRESS 0xFFF94DC0 /end MEASUREMENT
/begin MEASUREMENT WdSrv_tiSyncTCurr "F6200: Timestamp of last (current) IWD synchronization event [tick]" ULONG X1_S1 1 100 0 4294967295 FORMAT "%13.2" ECU_ADDRESS 0xFFF93C50 /end MEASUREMENT
/begin MEASUREMENT WdSrv_tiTmr "F6200: Timer till communication to IWD must be finish [tick]" ULONG X1_S1 1 100 0 4294967295 FORMAT "%13.2" ECU_ADDRESS 0xFFF93C54 /end MEASUREMENT
/begin MEASUREMENT WdSrv_tiWdRespT "F6200: CPU side copy of the IWD response time" UWORD TI0_001_M_S1 1 100 0 65.535 FORMAT "%8.5" ECU_ADDRESS 0xFFF94DCA /end MEASUREMENT
/begin MEASUREMENT WdSrv_tiWdRespTReq "F6200: Requested IWD response time. If a response time change is completely done (successful or erroneous), the value of this attribute will be equivalent to attribute value of WdSrv_tiWdRespT (after unit conversion) [200us]" UBYTE X1_S1 1 100 0 63 FORMAT "%5.2" ECU_ADDRESS 0xFFF9640E /end MEASUREMENT
/begin MEASUREMENT WdSrv_tiWdRespTReqQue "F6200: Queued requested IWD response time [200us]" UBYTE X1_S1 1 100 0 63 FORMAT "%5.2" ECU_ADDRESS 0xFFF9640F /end MEASUREMENT
/begin MEASUREMENT WdSrv_xWdReq "F6200: CPU side copy of the IWD request" UBYTE X1_S1 1 100 0 15 FORMAT "%5.2" ECU_ADDRESS 0xFFF95180 /end MEASUREMENT
/begin MEASUREMENT WdSrv_xWdResp "F6200: Current total response to IWD" ULONG X1_S1 1 100 0 4294967295 FORMAT "%13.2" ECU_ADDRESS 0xFFF93C58 /end MEASUREMENT
/begin MEASUREMENT WdTskMon_ctTskExe "F6200: Base task execution counter" UBYTE X1_S1 1 100 0 255 FORMAT "%5.1" ECU_ADDRESS 0xFFF96438 /end MEASUREMENT
/begin MEASUREMENT WdTskMon_tiTskMonDiffT "F6200: Difference between base task monitoring reference time and current system time [tick]" ULONG X1_S1 1 100 0 4294967295 FORMAT "%13.2" ECU_ADDRESS 0xFFF94B60 /end MEASUREMENT
/begin MEASUREMENT WdTskMon_tiTskMonRefT "F6200: Reference time of the base task monitoring [tick]" ULONG X1_S1 1 100 0 4294967295 FORMAT "%13.2" ECU_ADDRESS 0xFFF96394 /end MEASUREMENT
/begin MEASUREMENT WdUtl_sLstECURstSrc_a "F6200: Possible source of last ECU reset (idx. 0 for communication SW, idx. 1 for response calculation SW)(0x0=unknown,0x1=CPU-WD synchronization,0x2=PFC checksum,0x3=MCor checksum,0x4=other checksum,0x5= cust WD com fault,0x05>undefined)" UBYTE X1_S1 1 100 0 255 FORMAT "%5.1" ARRAY_SIZE 2 ECU_ADDRESS 0xFFF94DCC /end MEASUREMENT
/begin MEASUREMENT WdUtl_stDbgFlgStats "F6200: Statistic debug flag vector" UWORD X1_S1 1 100 0 65535 FORMAT "%8.2" ECU_ADDRESS 0xFFF94DCE /end MEASUREMENT
/begin MEASUREMENT WdUtl_stFault "F6200: The fault bit vector (only shows the currently occurred faults)" UWORD X1_S1 1 100 0 65535 FORMAT "%8.2" ECU_ADDRESS 0xFFF963A4 /end MEASUREMENT
/begin MEASUREMENT WdUtl_stTst "F6200: The test condition bit vector for the faults (only shows the currently condition)" UWORD X1_S1 1 100 0 65535 FORMAT "%8.2" ECU_ADDRESS 0xFFF94DD0 /end MEASUREMENT
/begin COMPU_METHOD B_TRUE_S1 "boolean states, positive logic" TAB_VERB "%6.3" "" COMPU_TAB_REF B_TRUE_S1 /end COMPU_METHOD
/begin COMPU_METHOD I0_0001_S1 "[0.0001A] current" RAT_FUNC "%7.6" "A" COEFFS 0 10000 0 0 0 1 /end COMPU_METHOD
/begin COMPU_METHOD Q_SIG_S1 "signal quality information" TAB_VERB "%6.3" "" COMPU_TAB_REF Q_SIG_S1 /end COMPU_METHOD
/begin COMPU_METHOD R0_0001_S1 "[0.0001]" RAT_FUNC "%7.6" "" COEFFS 0 10000 0 0 0 1 /end COMPU_METHOD
/begin COMPU_METHOD R0_001_S1 "[0.001]" RAT_FUNC "%6.5" "" COEFFS 0 1000 0 0 0 1 /end COMPU_METHOD
/begin COMPU_METHOD R0_1_P_S1 "[0.1%]" RAT_FUNC "%6.3" "%" COEFFS 0 10 0 0 0 1 /end COMPU_METHOD
/begin COMPU_METHOD RES0_001_S1 "[0.001ohm] resistance" RAT_FUNC "%6.5" "Ohm" COEFFS 0 1000 0 0 0 1 /end COMPU_METHOD
/begin COMPU_METHOD T0_0078125_S1 "[0.0078125°C] temperature" RAT_FUNC "%6.4" "°C" COEFFS 0 128 0 0 0 1 /end COMPU_METHOD
/begin COMPU_METHOD T0_0625_S1 "[0.0625°C] temperature" RAT_FUNC "%6.4" "°C" COEFFS 0 16 0 0 0 1 /end COMPU_METHOD
/begin COMPU_METHOD T1_OFFS_40_S1 "[1°C -40°C] temperature" RAT_FUNC "%6.2" "°C" COEFFS 0 1 40 0 0 1 /end COMPU_METHOD
/begin COMPU_METHOD TI0_00025_M_S1 "[0.00025ms] time" RAT_FUNC "%6.5" "ms" COEFFS 0 4000 0 0 0 1 /end COMPU_METHOD
/begin COMPU_METHOD TI0_001_S1 "[0.001s] time" RAT_FUNC "%6.5" "s" COEFFS 0 1000 0 0 0 1 /end COMPU_METHOD
/begin COMPU_METHOD TI0_001_M_S1 "[0.001ms] time" RAT_FUNC "%6.5" "ms" COEFFS 0 1000 0 0 0 1 /end COMPU_METHOD
/begin COMPU_METHOD TI0_1_H_S1 "[0.1h] time" RAT_FUNC "%6.3" "h" COEFFS 0 10 0 0 0 1 /end COMPU_METHOD
/begin COMPU_METHOD TI1_CYCLE_S1 "[0.1s] resolution in multiples of 100ms task" RAT_FUNC "%6.3" "s" COEFFS 0 10 0 0 0 1 /end COMPU_METHOD
/begin COMPU_METHOD TI1_MIN_S1 "[min] time" RAT_FUNC "%6.2" "min" COEFFS 0 1 0 0 0 1 /end COMPU_METHOD
/begin COMPU_METHOD TI1_M_CYCLE_S1 "[ms] resolution in multiples of main task (time*ROS_NUM_MNTSK_100MS_SY/100.0ms)" RAT_FUNC "%6.2" "ms" COEFFS 0 0.2 0 0 0 1 /end COMPU_METHOD
/begin COMPU_METHOD TI1_U_S1 "[1µs] time" RAT_FUNC "%6.2" "µs" COEFFS 0 1 0 0 0 1 /end COMPU_METHOD
/begin COMPU_METHOD U0_001_S1 "[0.001V] voltage" RAT_FUNC "%6.5" "V" COEFFS 0 1000 0 0 0 1 /end COMPU_METHOD
/begin COMPU_METHOD X1_S1 "[1] no unit" RAT_FUNC "%6.2" "" COEFFS 0 1 0 0 0 1 /end COMPU_METHOD
/begin COMPU_METHOD _CNV_S_7_Enum_KRAFT_139_CM_S2 "" TAB_VERB "%6.3" "" COMPU_TAB_REF _CNV_S_7_Enum_KRAFT_139_S2 /end COMPU_METHOD
/begin COMPU_METHOD _CNV_S_6_Enum_EWKSQ_148_CM_S2 "" TAB_VERB "%6.3" "" COMPU_TAB_REF _CNV_S_6_Enum_EWKSQ_148_S2 /end COMPU_METHOD
/begin COMPU_METHOD _CNV_S_3_Enum_EWKZ__149_CM_S2 "" TAB_VERB "%6.3" "" COMPU_TAB_REF _CNV_S_3_Enum_EWKZ__149_S2 /end COMPU_METHOD
/begin COMPU_METHOD _CNV_S_2_Enum_EWKMA_150_CM_S2 "" TAB_VERB "%6.3" "" COMPU_TAB_REF _CNV_S_2_Enum_EWKMA_150_S2 /end COMPU_METHOD
/begin COMPU_METHOD _CNV_S_3_Enum_EDYND_154_CM_S2 "" TAB_VERB "%6.3" "" COMPU_TAB_REF _CNV_S_3_Enum_EDYND_154_S2 /end COMPU_METHOD
/begin COMPU_METHOD _CNV_S_3_Enum_EDYND_155_CM_S2 "" TAB_VERB "%6.3" "" COMPU_TAB_REF _CNV_S_3_Enum_EDYND_155_S2 /end COMPU_METHOD
/begin COMPU_METHOD _CNV_S_13_Enum_EDYND_156_CM_S2 "" TAB_VERB "%6.3" "" COMPU_TAB_REF _CNV_S_13_Enum_EDYND_156_S2 /end COMPU_METHOD
/begin COMPU_METHOD _CNV_S_2_Enum_ERSP__178_CM_S2 "" TAB_VERB "%6.3" "" COMPU_TAB_REF _CNV_S_2_Enum_ERSP__178_S2 /end COMPU_METHOD
/begin COMPU_METHOD _CNV_R_R_Umr_100_zu_187_CM_S2 "" RAT_FUNC "%6.3" "s" COEFFS 0 100 0 0 0 1 /end COMPU_METHOD
/begin COMPU_METHOD _CNV_R_R_Umr_freq_198_CM_S2 "" RAT_FUNC "%6.3" "Hz" COEFFS 0 1 0 0 0 1 /end COMPU_METHOD
/begin COMPU_VTAB B_TRUE_S1 "boolean states, positive logic" TAB_VERB 2 0 "FALSE" 1 "TRUE" DEFAULT_VALUE "xxxxx" /end COMPU_VTAB
/begin COMPU_VTAB Q_SIG_S1 "signal quality information" TAB_VERB 9 0 "init" 1 "not_available" 2 "no_source" 3 "fix" 4 "fix_source" 5 "model_based" 6 "diff_source" 7 "ok_disturbed" 8 "ok" DEFAULT_VALUE "xxxxx" /end COMPU_VTAB
/begin COMPU_VTAB _CNV_S_7_Enum_KRAFT_139_S2 "" TAB_VERB 7 0 "KEIN_KRAFTSCHLUSS" 1 "KRAFTSCHLUSS_VORHANDEN_ODER_AFU" 2 "UEBERGANGSPHASE_KRAFTSCHLUSS_WIRD_AUFGEHOBEN" 3 "UEBERGANGSPHASE_KRAFTSCHLUSS_WIRD_HERGESTELLT" 4 "KEINE_KRAFTSCHLUSSAENDERUNG_MOEGLICH" 5 "NIC" 6 "SIGNAL_UNGUELTIG" /end COMPU_VTAB
/begin COMPU_VTAB _CNV_S_6_Enum_EWKSQ_148_S2 "" TAB_VERB 6 0 "IDX0" 1 "IDX1" 2 "IDX2" 3 "IDX3" 4 "IDX4" 5 "IDX5" /end COMPU_VTAB
/begin COMPU_VTAB _CNV_S_3_Enum_EWKZ__149_S2 "" TAB_VERB 3 0 "WKZ" 1 "WKZNT" 2 "WKZFENSTER" /end COMPU_VTAB
/begin COMPU_VTAB _CNV_S_2_Enum_EWKMA_150_S2 "" TAB_VERB 2 0 "WKMAX_AUF" 1 "WKMAX_GER" /end COMPU_VTAB
/begin COMPU_VTAB _CNV_S_3_Enum_EDYND_154_S2 "" TAB_VERB 3 -1 "KEINE_PHASE6_7_DYNDZM" 0 "SEGELN_DYNDZM" 1 "EFAHREN_DYNDZM" /end COMPU_VTAB
/begin COMPU_VTAB _CNV_S_3_Enum_EDYND_155_S2 "" TAB_VERB 3 0 "QS0" 1 "QS1" 2 "QS2" /end COMPU_VTAB
/begin COMPU_VTAB _CNV_S_13_Enum_EDYND_156_S2 "" TAB_VERB 13 0 "QS0" 1 "QS1" 2 "QS2" 3 "M_MOT1" 4 "M_MOT2" 5 "WK_AUF" 6 "WK_GER" 7 "WK_ZU" 8 "SCHALTUNG" 9 "WARTEZEIT" 10 "GRADIENT" 11 "FILTER_WK" 12 "FILTER_DAEMPF" /end COMPU_VTAB
/begin COMPU_VTAB _CNV_S_2_Enum_ERSP__178_S2 "" TAB_VERB 2 0 "RSP_NOT_STEPTR" 1 "RSP_STEPTR" /end COMPU_VTAB
/begin FUNCTION F2510_OutPShCirL3 "F2510: This will detect a short circuit in the sensor supply voltage "
 /begin DEF_CHARACTERISTIC OutPShCirL3_stSSplyTstCond_C OutPShCirL3_tiLoBatt_C OutPShCirL3_tiMonDly_C OutPShCirL3_uSSplyAsicLos_C OutPShCirL3_uSSplyDiffSply_C OutPShCirL3_uSSplySBLoLim_C OutPShCirL3_uSSplySBUpLim_C OutPShCirL3_uSSplySGLoLim_C OutPShCirL3_uSSplySGUpLim_C OutPShCirL3_uSSplySwtOffLim_C OutPShCirL3_uTstLoBatt_C /end DEF_CHARACTERISTIC
 /begin OUT_MEASUREMENT OutPShCirL3_sSSplyShCir OutPShCirL3_stSSplyFault OutPShCirL3_stSSplyTstCond OutPShCirL3_tiLoBatt OutPShCirL3_tiMonDly /end OUT_MEASUREMENT
/end FUNCTION
/begin FUNCTION F2511_OutPSSply5Mon "F2511: Sensor supply 5V monitoring"
 /begin DEF_CHARACTERISTIC OutPSSply5Mon_stSSply5TstCond_C OutPSSply5Mon_uSSply5TstHi_C OutPSSply5Mon_uSSply5TstLo_C OutPSSply5Mon_uSSply5TstSB_C OutPSSply5Mon_uSSply5TstSG_C /end DEF_CHARACTERISTIC
 /begin OUT_MEASUREMENT OutPSSply5Mon_stSSply5Fault OutPSSply5Mon_stSSply5TstCond /end OUT_MEASUREMENT
/end FUNCTION
/begin FUNCTION F2520_OutPOpsCtl "F2520: Output Safety System Control"
 /begin DEF_CHARACTERISTIC OutPOpsCtl_numRepIpt_C OutPOpsCtl_swtBypIpt_C OutPOpsCtl_uUndrBatt_C /end DEF_CHARACTERISTIC
 /begin OUT_MEASUREMENT OutPOpsCtl_cntRepIpt OutPOpsCtl_sOpsMode OutPOpsCtl_stOpsFault OutPOpsCtl_stOpsTstCond OutPOpsCtl_xPSplySafRlvnt /end OUT_MEASUREMENT
/end FUNCTION
/begin FUNCTION F2520_OutPOpsTst "F2520: Inhibit-Path-Test"
 /begin DEF_CHARACTERISTIC OutPOpsTst_swtDbgEnbl_C OutPOpsTst_tiDnTOut_C OutPOpsTst_tiIptTOut_C OutPOpsTst_tiPSplyTOut_C OutPOpsTst_uBattIptMax_C OutPOpsTst_uBattIptMin_C /end DEF_CHARACTERISTIC
 /begin OUT_MEASUREMENT OutPOpsTst_sIpt OutPOpsTst_sIptPreHld OutPOpsTst_stPSplyRngFault OutPOpsTst_stSucTstMsk OutPOpsTst_stTst OutPOpsTst_stTstPreHld OutPOpsTst_tiDnTOut OutPOpsTst_tiIptTOut OutPOpsTst_tiIptTOutPreHld OutPOpsTst_tiPSplyTOut OutPOpsTst_tiPSplyTOutPreHld /end OUT_MEASUREMENT
/end FUNCTION
/begin FUNCTION F2523_OutPPSplyCtl "F2523: Power supply control"
 /begin DEF_CHARACTERISTIC OutPPSplyCtl_stPSplyAvl_C OutPPSplyCtl_stPSplySaf_C OutPPSplyCtl_tiPSplyBattLoStrt_C OutPPSplyCtl_tiPSplyBattLo_C OutPPSplyCtl_tiPSplyChngOff_C OutPPSplyCtl_tiPSplyChngOn_C OutPPSplyCtl_tiPSplyPrtSG_C OutPPSplyCtl_uPSplyBattLoHys_C OutPPSplyCtl_uPSplyBattLo_C /end DEF_CHARACTERISTIC
 /begin OUT_MEASUREMENT OutPPSplyCtl_bOpsDn OutPPSplyCtl_bPSplyIn OutPPSplyCtl_bPSplyOut OutPPSplyCtl_bPSplyOutL3 OutPPSplyCtl_sPSplyMode OutPPSplyCtl_stLdOpsOn OutPPSplyCtl_stLdPSplyOn OutPPSplyCtl_stOpsFault OutPPSplyCtl_stPSplyBattLo OutPPSplyCtl_stPSplyBattLoCpl OutPPSplyCtl_stPSplyIni OutPPSplyCtl_stPSplyOpsOn OutPPSplyCtl_stPSplySt OutPPSplyCtl_tiPSplyBattLo OutPPSplyCtl_tiPSplyBattLoCpl OutPPSplyCtl_tiPSplyChng OutPPSplyCtl_tiPSplyPrtSG /end OUT_MEASUREMENT
/end FUNCTION
/begin FUNCTION F2523_OutPPSplyMon "F2523: Power supply monitoring"
 /begin DEF_CHARACTERISTIC OutPPSplyMon_ctPSplyErrOP_C OutPPSplyMon_ctPSplyOPEvt_C OutPPSplyMon_stPSplyErrOP_C OutPPSplyMon_stPSplyHldDfe_C OutPPSplyMon_stPSplyOffSG_C OutPPSplyMon_stPSplyOpMSC_C OutPPSplyMon_stPSplySfrmPSply_C OutPPSplyMon_stPSplyTstCond_C OutPPSplyMon_tiPSplyRngDly_C OutPPSplyMon_tiPSplyRngWait_C OutPPSplyMon_uPSplyDiff_C OutPPSplyMon_uPSplyLimSG_C OutPPSplyMon_uPSplyTstHi_C OutPPSplyMon_uPSplyTstLo_C /end DEF_CHARACTERISTIC
 /begin OUT_MEASUREMENT OutPPSplyMon_ctPSplyErrOP OutPPSplyMon_ctPSplyOPEvt OutPPSplyMon_sPSplyOpM OutPPSplyMon_stPSplyFault OutPPSplyMon_stPSplyFaultOP OutPPSplyMon_stPSplyHldDfe OutPPSplyMon_stPSplyOffSGErr OutPPSplyMon_stPSplyOpMRng OutPPSplyMon_stPSplySfrm OutPPSplyMon_stPSplyTstCond OutPPSplyMon_stPSplyTstCondOP OutPPSplyMon_tiPSplyOpMRng OutPPSplyMon_xPSplyDmy OutPPSplyMon_yPSplyDmy /end OUT_MEASUREMENT
/end FUNCTION
/begin FUNCTION F2523_OutPPSplyOn "F2523: Power supply activation"
 /begin DEF_CHARACTERISTIC OutPPSplyOn_rPSplySB_C OutPPSplyOn_uPSplyClsdThres_C OutPPSplyOn_uPSplyOPHi_C OutPPSplyOn_uPSplyOPLo_C OutPPSplyOn_uPSplySG_C /end DEF_CHARACTERISTIC
 /begin OUT_MEASUREMENT OutPPSplyOn_bPSplyActv OutPPSplyOn_stPSplyRng /end OUT_MEASUREMENT
/end FUNCTION
/begin FUNCTION F2525_OutPLssCtl "F2525: Low side control (complement calculation)"
 /begin DEF_CHARACTERISTIC OutPLssCtl_stLssAvl_C OutPLssCtl_stLssDnConn_C OutPLssCtl_stLssReqPSply_C OutPLssCtl_uLssThresT15Hys_C OutPLssCtl_uLssThresT15_C OutPLssCtl_uLssThresT30Hys_C OutPLssCtl_uLssThresT30_C /end DEF_CHARACTERISTIC
 /begin OUT_MEASUREMENT OutPLssCtl_iLssIn OutPLssCtl_rLssIn OutPLssCtl_stLssOut OutPLssCtl_stLssOutL3 OutPLssCtl_stLssReqOff OutPLssCtl_stLssReqOn /end OUT_MEASUREMENT
/end FUNCTION
/begin FUNCTION F2525_OutPLssDuty "F2525: Low side duty output"
 /begin DEF_CHARACTERISTIC OutPLssDuty_facLssCrnt_C OutPLssDuty_stLssDutyLtdMax_C OutPLssDuty_stLssDutyLtdMin_C OutPLssDuty_stLssMode_C OutPLssDuty_stLssSelSply_C OutPLssDuty_tiLssPk_C OutPLssDuty_uLssDutyRef_C[0] OutPLssDuty_uLssDutyRef_C[1] OutPLssDuty_uLssDutyRef_C[2] OutPLssDuty_uLssDutyRef_C[3] OutPLssDuty_uLssDutyRef_C[4] /end DEF_CHARACTERISTIC
 /begin OUT_MEASUREMENT OutPLssDuty_rLssDuty OutPLssDuty_stLssActv OutPLssDuty_tAtf OutPLssDuty_tiLssPk OutPLssDuty_tiLssPkCpl OutPLssDuty_xLssIn /end OUT_MEASUREMENT
/end FUNCTION
/begin FUNCTION F2525_OutPLssMon "F2525: Low Side monitoring"
 /begin DEF_CHARACTERISTIC OutPLssMon_stLssChkHw_C OutPLssMon_stLssDetSGOP_C OutPLssMon_stLssSfrmLss_C OutPLssMon_stLssSfrmPSply_C OutPLssMon_stLssTstCond_C OutPLssMon_stPSplyErrOP_C OutPLssMon_stSwtOnPrt_C OutPLssMon_tiFltSB_C OutPLssMon_tiLssChng_C OutPLssMon_tiLssSplyOn_C OutPLssMon_tiSwtOnPrt_C OutPLssMon_uLssTstHi_C OutPLssMon_uLssTstLo_C OutPLssMon_uLssTstOP_C OutPLssMon_uLssTstSB_C OutPLssMon_uLssTstSG_C /end DEF_CHARACTERISTIC
 /begin OUT_MEASUREMENT OutPLssMon_stLssFault OutPLssMon_stLssSfrm OutPLssMon_stLssTstCond OutPLssMon_stSwtOnPrt OutPLssMon_tiFltSB OutPLssMon_tiLssChng OutPLssMon_tiLssSplyOn OutPLssMon_tiSwtOnPrt /end OUT_MEASUREMENT
/end FUNCTION
/begin FUNCTION F2531_OutPCc08Cfg "F2531: Current control configuration (Complement)" /begin DEF_CHARACTERISTIC OutPCc08Cfg_stCc08Mode_C /end DEF_CHARACTERISTIC
 /begin OUT_MEASUREMENT OutPCc08Cfg_iCc08EeChn OutPCc08Cfg_iCc08Out OutPCc08Cfg_stCc08Actv /end OUT_MEASUREMENT
/end FUNCTION
/begin FUNCTION F2531_OutPCc08Crnt "F2531: Evaluation of incoming current"
 /begin DEF_CHARACTERISTIC OutPCc08Crnt_iCc08CrntHys_C OutPCc08Crnt_stCc08CrntEval_C OutPCc08Crnt_tiCc08CrntChng_C OutPCc08Crnt_tiCc08CrntGen_C /end DEF_CHARACTERISTIC
 /begin OUT_MEASUREMENT OutPCc08Crnt_stCc08CrntNom OutPCc08Crnt_tiCc08CrntChng OutPCc08Crnt_tiCc08CrntGen /end OUT_MEASUREMENT
/end FUNCTION
/begin FUNCTION F2531_OutPCc08Ctl "F2531: Current control (Complement)"
 /begin DEF_CHARACTERISTIC OutPCc08Ctl_facCc08PSplyFlt_C OutPCc08Ctl_iCc08LoBatt_C OutPCc08Ctl_iCc08LoCrnt_C OutPCc08Ctl_stCc08Avl_C OutPCc08Ctl_stCc08DnConn_C OutPCc08Ctl_stCc08LoBatt_C OutPCc08Ctl_stCc08ReqPSply_C OutPCc08Ctl_tiCc08HwFault_C OutPCc08Ctl_tiCc08ModeChng_C OutPCc08Ctl_uCc08LoBattHys_C OutPCc08Ctl_uCc08LoBatt_C /end DEF_CHARACTERISTIC
 /begin OUT_MEASUREMENT OutPCc08Ctl_iCc08Crnt OutPCc08Ctl_iCc08In OutPCc08Ctl_stCc08Out OutPCc08Ctl_stCc08ReqOff OutPCc08Ctl_stCc08ReqOn OutPCc08Ctl_tiCc08HwFault OutPCc08Ctl_uCc08PSplyFlt /end OUT_MEASUREMENT
/end FUNCTION
/begin FUNCTION F2531_OutPCc08Fdbk "F2531: Calculation duty cycle of feedback signal"
 /begin DEF_CHARACTERISTIC OutPCc08Fdbk_ctCc08FdbkErr_C OutPCc08Fdbk_facCc08FdbkFlt_C OutPCc08Fdbk_rCc08FdbkLim_C /end DEF_CHARACTERISTIC
 /begin OUT_MEASUREMENT OutPCc08Fdbk_ctCc08FdbkErr OutPCc08Fdbk_rCc08FdbkAvrg OutPCc08Fdbk_rCc08FdbkFlt OutPCc08Fdbk_rCc08FdbkFlt32 OutPCc08Fdbk_rCc08FdbkHi OutPCc08Fdbk_rCc08FdbkLo OutPCc08Fdbk_stCc08Fdbk /end OUT_MEASUREMENT
/end FUNCTION
/begin FUNCTION F2531_OutPCc08Mon "F2531: Current control monitoring"
 /begin DEF_CHARACTERISTIC OutPCc08Mon_stCc08SfrmLss_C OutPCc08Mon_stCc08SfrmPSply_C OutPCc08Mon_stCc08TstCond_C OutPCc08Mon_stPSplyErrOP_C OutPCc08Mon_tiCc08NsDynErr_C OutPCc08Mon_tiCc08TstFdbk_C OutPCc08Mon_uCc08TstCrntHi_C OutPCc08Mon_uCc08TstCrntLo_C OutPCc08Mon_uCc08TstSCHi_C OutPCc08Mon_uCc08TstSCLo_C /end DEF_CHARACTERISTIC
 /begin OUT_MEASUREMENT OutPCc08Mon_iCc08Meas OutPCc08Mon_stCc08Fault OutPCc08Mon_stCc08Sfrm OutPCc08Mon_stCc08TstCond OutPCc08Mon_stCc08TstGen OutPCc08Mon_stHealSfrmFault OutPCc08Mon_tiCc08NsDynErr OutPCc08Mon_tiCc08TstFdbk /end OUT_MEASUREMENT
/end FUNCTION
/begin FUNCTION F2531_OutPCc08Rat "F2531: Calculation of ratio R*I/U"
 /begin DEF_CHARACTERISTIC OutPCc08Rat_rCc08RatFdbk_C OutPCc08Rat_rCc08RatHys_C OutPCc08Rat_rCc08Rat_C OutPCc08Rat_uCc08RatActv_C OutPCc08Rat_uCc08RatSplyHys_C /end DEF_CHARACTERISTIC
 /begin OUT_MEASUREMENT OutPCc08Rat_rCc08Rat OutPCc08Rat_stCc08RatMode /end OUT_MEASUREMENT
/end FUNCTION
/begin FUNCTION F2531_OutPCc08SGOP "F2531: Differentiation between SG or OP"
 /begin DEF_CHARACTERISTIC OutPCc08SGOP_stCc08DiffSC_C OutPCc08SGOP_tiCc08DiffDly_C[0] OutPCc08SGOP_tiCc08DiffDly_C[1] OutPCc08SGOP_tiCc08DiffSGOP_C OutPCc08SGOP_tiCc08HldFault_C OutPCc08SGOP_uCc08DiffSGOP_C /end DEF_CHARACTERISTIC
 /begin OUT_MEASUREMENT OutPCc08SGOP_sCc08DiffSGOP OutPCc08SGOP_stCc08DiffReq OutPCc08SGOP_stCc08DiffSGOP OutPCc08SGOP_stCc08HldFault OutPCc08SGOP_tiCc08DiffDly OutPCc08SGOP_tiCc08DiffSGOP OutPCc08SGOP_tiCc08HldFault OutPCc08SGOP_uCc08DiffPSply /end OUT_MEASUREMENT
/end FUNCTION
/begin FUNCTION F2531_OutPCc08Tolc "F2531: Current tolerance calculation"
 /begin DEF_CHARACTERISTIC OutPCc08Tolc_facCc08GradLimHi_C OutPCc08Tolc_facCc08GradLimLo_C OutPCc08Tolc_iCc08CrntGen_C OutPCc08Tolc_iCc08DthAmpOn_C OutPCc08Tolc_iCc08GradAbsHi_C OutPCc08Tolc_iCc08GradAbsLo_C OutPCc08Tolc_iCc08GradLimMax_C OutPCc08Tolc_iCc08Noi_C OutPCc08Tolc_iCc08RngLim_C OutPCc08Tolc_iCc08TempIncor_C OutPCc08Tolc_iCc08TolcRngHi_C OutPCc08Tolc_iCc08TolcRngLo_C OutPCc08Tolc_stCc08GradRng_C OutPCc08Tolc_stCc08TolcRng_C OutPCc08Tolc_tiCc08DthAmpOn_C OutPCc08Tolc_tiCc08DthChng_C OutPCc08Tolc_tiCc08GradHi_C OutPCc08Tolc_tiCc08GradLo_C OutPCc08Tolc_tiCc08Noi_C /end DEF_CHARACTERISTIC
 /begin OUT_MEASUREMENT OutPCc08Tolc_iCc08Grad OutPCc08Tolc_iCc08GradDmy OutPCc08Tolc_iCc08TolcLimHi OutPCc08Tolc_iCc08TolcLimLo OutPCc08Tolc_tiCc08DthAmpOn OutPCc08Tolc_tiCc08DthChng OutPCc08Tolc_tiCc08GradHi OutPCc08Tolc_tiCc08GradLo OutPCc08Tolc_tiCc08Noi /end OUT_MEASUREMENT
/end FUNCTION
/begin FUNCTION F2545_OutPPclkCtl "F2545: Main Pclk class. It is the entrance point from the interfaces"
 /begin OUT_MEASUREMENT OutPPclkCtl_stPclk OutPPclkCtl_stPclkCtl OutPPclkCtl_stPclkOpsOn OutPPclkCtl_stPclkTst /end OUT_MEASUREMENT
/end FUNCTION
/begin FUNCTION F2545_OutPPclkMon "F2545: This is the monitoring functionality of the Pclk" /begin OUT_MEASUREMENT OutPPclkMon_stPclkFault OutPPclkMon_stPclkTstCond /end OUT_MEASUREMENT /end FUNCTION
/begin FUNCTION F2550_OutPStlkIn "F2550: This class provides the possibility to get the position of the transmission selector lever."
 /begin DEF_CHARACTERISTIC OutPStlkIn_stStlkSelSply_C OutPStlkIn_tiStlkOff_C OutPStlkIn_tiStlkOn_C OutPStlkIn_uStlkStrtJmp_C /end DEF_CHARACTERISTIC
 /begin OUT_MEASUREMENT OutPStlkIn_stStlkChpLine OutPStlkIn_stStlkPlrInfo OutPStlkIn_tiStlkOff OutPStlkIn_tiStlkOn OutPStlkIn_uStlkStrtRly /end OUT_MEASUREMENT
/end FUNCTION
/begin FUNCTION F2550_OutPStlkMon "F2550: This is the monitoring functionality of the Stlk"
 /begin DEF_CHARACTERISTIC OutPStlkMon_stStlkSelSwt_C OutPStlkMon_stStlkTstCond_C OutPStlkMon_uStlkTstLo_C OutPStlkMon_uStlkTstSB_C OutPStlkMon_uStlkTstSG_C /end DEF_CHARACTERISTIC
 /begin OUT_MEASUREMENT OutPStlkMon_stStlkFault OutPStlkMon_stStlkTstCond /end OUT_MEASUREMENT
/end FUNCTION
/begin FUNCTION F2550_OutPStlkOut "F2550: Control functionality to calculate the starter lock signal"
 /begin DEF_CHARACTERISTIC OutPStlkOut_bStlkCtl_C OutPStlkOut_tiStlkCtl_C OutPStlkOut_tiStlkHwAck_C /end DEF_CHARACTERISTIC
 /begin OUT_MEASUREMENT OutPStlkOut_bStlkOut OutPStlkOut_bStlkSpiOff OutPStlkOut_stStlk OutPStlkOut_tiStlkCtl OutPStlkOut_tiStlkHwAck /end OUT_MEASUREMENT
/end FUNCTION
/begin FUNCTION F2635_CPUID_M "F2635: CPU Identification" /begin OUT_MEASUREMENT CPUID_stChip CPUID_stSize CPU_bPbusClk CPU_numSel /end OUT_MEASUREMENT /end FUNCTION
/begin FUNCTION F2641_SPIHA "F2641: SPI handler status variable" /begin OUT_MEASUREMENT SpiHa_ctErrUnit /end OUT_MEASUREMENT /end FUNCTION
/begin FUNCTION F2655_CPU_CHKCFG_M "F2655: CPU Configuration Verification" /begin OUT_MEASUREMENT Cpu_stChkCfgReg /end OUT_MEASUREMENT /end FUNCTION
/begin FUNCTION F2741_EELLD_M "F2741: EELLD measurement variables"
 /begin OUT_MEASUREMENT EELLD_Status_s.stMode_u8 EELLD_Status_s.stOp_u8 EELLD_Status_s.stReq_u8 EELLD_Status_s.stSuspReq_u8 EELLD_Status_s.numSec_u8 EELLD_Status_s.numSize_u8 EELLD_Status_s.numOffs_u16 EELLD_Status_s.ctErr_u16 EELLD_Status_s.reserved EELLD_Status_s.adOp_u32 /end OUT_MEASUREMENT
/end FUNCTION
/begin FUNCTION F2742_FCU_M "F2742: FCU measurement variables"
 /begin OUT_MEASUREMENT FCU_numFirmware FCU_s.state FCU_s.stReq FCU_s.ctOff FCU_s.stInit FCU_s.ctCpy FCU_s.stErrDetail FCU_s.reserved /end OUT_MEASUREMENT
/end FUNCTION
/begin FUNCTION F2755_ECC_M "F2755: ECC-ROM/RAM handling (measurement only)"
 /begin OUT_MEASUREMENT ECC_RAM_adEccErr ECC_RAM_numEccErr ECC_RAM_stEccTst ECC_ROM_stEccTst /end OUT_MEASUREMENT
/end FUNCTION
/begin FUNCTION F2861_OutMDth "F2861: Dither Control and related Matching Functions"
 /begin DEF_CHARACTERISTIC OutMDth_facAtfFlt_C OutMDth_iDthAmpChngThres_C OutMDth_iDthAmpGrad_C OutMDth_iDthAmpLimSply_C OutMDth_iDthAmpOnThres_C OutMDth_iDthAmp_C[0] OutMDth_iDthAmp_C[1] OutMDth_iDthAmp_C[2] OutMDth_iDthAmp_C[3] OutMDth_iDthAmp_C[4] OutMDth_iDthAmp_C[5] OutMDth_iDthAmp_C[6] OutMDth_iDthAmp_C[7] OutMDth_iDthAmp_C[8] OutMDth_iDthAmp_C[9] OutMDth_iInGradMax_C OutMDth_iOutOfsConst_C OutMDth_stDthAmpLimAvl_C OutMDth_tiMinSwtOff_C OutMDth_tiPerTempHi_C OutMDth_tiPerTempLo_C OutMDth_tPerTempHi_C OutMDth_tPerTempLo_C /end DEF_CHARACTERISTIC
 /begin OUT_MEASUREMENT OutMDth_bDthEnblReq OutMDth_bPerChngPrvnt OutMDth_iDthAmp OutMDth_iDthAmpLimSply OutMDth_iDthAmpReq OutMDth_iInDmy OutMDth_iOutOfs OutMDth_stDthAmpChng OutMDth_stDthAmpOn OutMDth_stDthPerChng OutMDth_tAtfFlt OutMDth_tiDthPer OutMDth_tiMinSwtOff OutMDth_uSplyDmy /end OUT_MEASUREMENT
/end FUNCTION
/begin FUNCTION F2862_OutMEe "F2862: Read the adjustment current value from EEPROM" /begin OUT_MEASUREMENT OutMEe_iCc08Comp OutMEe_stCc08Avl /end OUT_MEASUREMENT /end FUNCTION
/begin FUNCTION F2863_OutMRstn "F2863: Resistance calculation for current control"
 /begin DEF_CHARACTERISTIC OutMRstn_facActrWuFlt1_C OutMRstn_facActrWuFlt2_C OutMRstn_facActrWuFlt_C OutMRstn_facAtfFlt_C OutMRstn_iActrWuRef_C OutMRstn_resActr20_C OutMRstn_resRmn_C OutMRstn_resSht_C[0] OutMRstn_resSht_C[1] OutMRstn_resSht_C[2] OutMRstn_resSht_C[3] OutMRstn_resSht_C[4] OutMRstn_resSht_C[5] OutMRstn_resSht_C[6] OutMRstn_resSht_C[7] OutMRstn_resSht_C[8] OutMRstn_resSht_C[9] OutMRstn_tActrWu_C[0] OutMRstn_tActrWu_C[1] OutMRstn_tActrWu_C[2] OutMRstn_tActrWu_C[3] OutMRstn_tActrWu_C[4] OutMRstn_tActrWu_C[5] OutMRstn_tActrWu_C[6] OutMRstn_tActrWu_C[7] OutMRstn_tActrWu_C[8] OutMRstn_tActrWu_C[9] /end DEF_CHARACTERISTIC
 /begin OUT_MEASUREMENT OutMRstn_resActrMod OutMRstn_tActrWuFlt OutMRstn_tActrWuFlt1 OutMRstn_tActrWuFlt2 OutMRstn_tAtfFlt OutMRstn_tAtfRef OutMRstn_tChpRef OutMRstn_tiCalcRate /end OUT_MEASUREMENT
/end FUNCTION
/begin FUNCTION F2864_OutMCrntFdbk "F2864: Calculation of measured current"
 /begin DEF_CHARACTERISTIC OutMCrntFdbk_facCor_C[0] OutMCrntFdbk_facCor_C[1] OutMCrntFdbk_facCor_C[2] OutMCrntFdbk_facCor_C[3] OutMCrntFdbk_facCor_C[4] OutMCrntFdbk_facCor_C[5] OutMCrntFdbk_facCor_C[6] OutMCrntFdbk_facCor_C[7] OutMCrntFdbk_facCor_C[8] OutMCrntFdbk_facCor_C[9] OutMCrntFdbk_uDio_C[0] OutMCrntFdbk_uDio_C[1] OutMCrntFdbk_uDio_C[2] OutMCrntFdbk_uDio_C[3] OutMCrntFdbk_uDio_C[4] OutMCrntFdbk_uDio_C[5] OutMCrntFdbk_uDio_C[6] OutMCrntFdbk_uDio_C[7] OutMCrntFdbk_uDio_C[8] OutMCrntFdbk_uDio_C[9] /end DEF_CHARACTERISTIC
 /begin IN_MEASUREMENT OutMRstn_resActrMod OutMRstn_tAtfRef OutMRstn_tChpRef /end IN_MEASUREMENT
 /begin OUT_MEASUREMENT OutMCrntFdbk_iCalc /end OUT_MEASUREMENT
/end FUNCTION
/begin FUNCTION F3010_GMOHOT "F3010 : Configuration of hot shutdown"
 /begin DEF_CHARACTERISTIC GmoHot_qtChp1Min_C GmoHot_qtChp2Min_C GmoHot_tBattDepSdnTempINI_C GmoHot_tBattDepSdnTemp_C GmoHot_tChp1SensTolc_C GmoHot_tChp2SensTolc_C GmoHot_tiGenDlyDSM_C GmoHot_tiGenDlyEE_C GmoHot_tiGenDlyHot_C GmoHot_tiGenDlyInit_C GmoHot_tM3DepSdnTemp_C GmoHot_uUpLimHotCond_C /end DEF_CHARACTERISTIC
 /begin OUT_MEASUREMENT GmoHot_qtAct GmoHot_stFault GmoHot_stHot GmoHot_stHotExt GmoHot_stTstCond GmoHot_tAct GmoHot_tiAtfDly GmoHot_tiGenDly GmoHot_tLim GmoHot_uBatt GmoHot_uM3 GmoHot_xReqSwtOffPs /end OUT_MEASUREMENT
/end FUNCTION
/begin FUNCTION F3040_Gmo_Rst "F3040: Reset Monitoring"
 /begin OUT_MEASUREMENT Gmo_Rst_st Gmo_Rst_stFaultSup Gmo_Rst_stRstMrkStrtUp Gmo_Rst_stTstCondSup /end OUT_MEASUREMENT
/end FUNCTION
/begin FUNCTION F3500_DSMERRLOG "F3500: Error logger " /begin DEF_CHARACTERISTIC DSM_ERR_bClrIni /end DEF_CHARACTERISTIC
 /begin OUT_MEASUREMENT DSM_ERR_ctEntry DSM_ERR_ctErr DSM_ERR_numFctId DSM_ERR_stErr /end OUT_MEASUREMENT
/end FUNCTION
/begin FUNCTION F6000_SAF "F6000: SAF General"
 /begin OUT_MEASUREMENT Saf_stFaultInfo_A Saf_stFaultInfo_B Saf_stFaultInfo_C Saf_stFaultInfo_D /end OUT_MEASUREMENT
/end FUNCTION
/begin FUNCTION F6010_MCOR "F6010: Core monitoring" /begin DEF_CHARACTERISTIC MCor_swtFaultEntryReq_C /end DEF_CHARACTERISTIC
 /begin OUT_MEASUREMENT MCor_ctCorTst MCor_stIntMCorFault MCor_stMCorFault MCor_xWdPartResp /end OUT_MEASUREMENT
/end FUNCTION
/begin FUNCTION F6020_MCOR_ADC "F6020: ADC Core Monitor"
 /begin DEF_CHARACTERISTIC MCorAdc_ctErrDb_C MCorAdc_uDiagDiffMax_C MCorAdc_uM3Min_C MCorAdc_uVasicMax_C MCorAdc_uVasicMin_C MCorAdc_uVdd3DiffMax_C MCorAdc_uVdd3Max_C MCorAdc_uVdd3Min_C /end DEF_CHARACTERISTIC
 /begin OUT_MEASUREMENT MCorAdc_ctErr MCorAdc_efADCTst MCorAdc_stAdcFault /end OUT_MEASUREMENT
/end FUNCTION
/begin FUNCTION F6030_MCOR_SPI "F6030: SPI Core Monitor" /begin DEF_CHARACTERISTIC MCorSpi_ctErrDb_C /end DEF_CHARACTERISTIC /begin OUT_MEASUREMENT MCorSpi_bErrFlg MCorSpi_ctErr /end OUT_MEASUREMENT /end FUNCTION
/begin FUNCTION F6040_MCOR_MMM "F6040: MMM Core Monitor" /begin DEF_CHARACTERISTIC MCorMmm_ctErrDbEcc_C MCorMmm_ctErrDbReg_C /end DEF_CHARACTERISTIC
 /begin OUT_MEASUREMENT MCorMmm_ctErrEcc MCorMmm_ctErrReg MCorMmm_stEccFault MCorMmm_stRegFault /end OUT_MEASUREMENT
/end FUNCTION
/begin FUNCTION F6050_LVL2MON "F6050: Level 2 monitoring"
 /begin OUT_MEASUREMENT Lvl2Mon_idxFaultBuf Lvl2Mon_stLvl2Fault Lvl2Mon_xFaultBufLvl2Id_a Lvl2Mon_xFaultBufLvl2Info_a /end OUT_MEASUREMENT
/end FUNCTION
/begin FUNCTION F6060_SafRam "F6060: SAF RAM monitoring"
 /begin OUT_MEASUREMENT SafRam_adDbgCpl SafRam_adDbgOrig SafRam_datDbgCpl SafRam_datDbgOrig SafRam_idxDbg SafRam_Tst16 SafRam_Tst32 SafRam_Tst8 SafRam_xDbgInfo /end OUT_MEASUREMENT
/end FUNCTION
/begin FUNCTION F6100_PFCCtl "F6100: Controller of the Program Flow Control (variant b)" /begin OUT_MEASUREMENT PFCCtl_numMemArSizeUsd /end OUT_MEASUREMENT /end FUNCTION
/begin FUNCTION F6100_PFCIni "F6100: PFC monitoring during the initialization" /begin DEF_CHARACTERISTIC PFCIni_stChkPntEnd_C /end DEF_CHARACTERISTIC /begin OUT_MEASUREMENT PFCIni_ctChkPntCnt /end OUT_MEASUREMENT /end FUNCTION
/begin FUNCTION F6100_PFCMn "F6100: Monitoring of program flows (variant b)"
 /begin OUT_MEASUREMENT PFCMn_bVldInfoPerm_a PFCMn_bVldInfo_a PFCMn_ctMdul PFCMn_idxInfoNxt PFCMn_idxInfoNxtPerm PFCMn_numFlwIdInfoPerm_a PFCMn_numFlwIdInfo_a PFCMn_numId1InfoPerm_a PFCMn_numId1Info_a PFCMn_numId2InfoPerm_a PFCMn_numId2Info_a /end OUT_MEASUREMENT
/end FUNCTION
/begin FUNCTION F6200_WdCtlStd "F6200: WD Communication Controller - Standard" /begin OUT_MEASUREMENT WdCtlStd_sComMode /end OUT_MEASUREMENT /end FUNCTION
/begin FUNCTION F6200_WdDia "F6200: WD Diagnosis Handler (variant a)" /begin OUT_MEASUREMENT WdDia_stFaultBuf WdDia_stFaultDebActv WdDia_stTstBuf /end OUT_MEASUREMENT /end FUNCTION
/begin FUNCTION F6200_WdIpt "F6200: WD Communication Controller - IPT" /begin DEF_CHARACTERISTIC WdIpt_numTOutTolc_C /end DEF_CHARACTERISTIC /begin OUT_MEASUREMENT WdIpt_ctTOut WdIpt_sComMode WdIpt_sTgtLvlReq /end OUT_MEASUREMENT /end FUNCTION
/begin FUNCTION F6200_WdMnExtd "F6200: WD Handling Mode Controller - Extended" /begin DEF_CHARACTERISTIC WdMnExtd_stWdStatsClr_C /end DEF_CHARACTERISTIC /begin OUT_MEASUREMENT WdMnExtd_bFrstT WdMnExtd_sRunMode /end OUT_MEASUREMENT /end FUNCTION
/begin FUNCTION F6200_WdResp "F6200: WD Response Calculator (variant a with fix process activation interval)"
 /begin OUT_MEASUREMENT WdResp_adMdulMonFault_ps WdResp_ctCyclCnt WdResp_ctCyclCntRmn WdResp_ctMdulMonCnt WdResp_numCyclCntUpd WdResp_xKey WdResp_xListKey /end OUT_MEASUREMENT
/end FUNCTION
/begin FUNCTION F6200_WdSrv "F6200: IWD communication service (extended functionality)"
 /begin OUT_MEASUREMENT WdSrv_ctIdl WdSrv_ctNoDatErrCnt WdSrv_ctSPIErrCnt WdSrv_ctSyncErrCnt WdSrv_ctSyncErrCntStats WdSrv_ctWdErrCnt WdSrv_ctWdErrCntMax WdSrv_ctWdErrCntRef WdSrv_sRespMdfyMode WdSrv_sSrvSt WdSrv_sSyncSt WdSrv_stWdStRef WdSrv_tiConst WdSrv_tiSyncTCurr WdSrv_tiTmr WdSrv_tiWdRespT WdSrv_tiWdRespTReq WdSrv_tiWdRespTReqQue WdSrv_xWdReq WdSrv_xWdResp /end OUT_MEASUREMENT
/end FUNCTION
/begin FUNCTION F6200_WdTskMon "F6200: WD Task Monitor" /begin DEF_CHARACTERISTIC WdTskMon_numTskExe_C WdTskMon_tiTskMonT_C /end DEF_CHARACTERISTIC
 /begin OUT_MEASUREMENT WdTskMon_ctTskExe WdTskMon_tiTskMonDiffT WdTskMon_tiTskMonRefT /end OUT_MEASUREMENT
/end FUNCTION
/begin FUNCTION F6200_WdUtl "F6200: Utilities and helper functions (variant a)"
 /begin OUT_MEASUREMENT WdUtl_sLstECURstSrc_a WdUtl_stDbgFlgStats WdUtl_stFault WdUtl_stTst /end OUT_MEASUREMENT
/end FUNCTION
/begin FUNCTION F6250_SFRM "F6250: SFRM configuration"
 /begin DEF_CHARACTERISTIC SFRM_CC08_bTolSprdcFault_C SFRM_GMO_bTolSprdcFault_C SFRM_LSS_bTolSprdcFault_C SFRM_PSPLY_bTolSprdcFault_C SFRM_SAF_bTolSprdcFault_C SFRM_swtSrv_C SFRM_tiFailLtcyTCC08_C SFRM_tiFailLtcyTDFE_C SFRM_tiFailLtcyTGMO_C SFRM_tiFailLtcyTLSS_C SFRM_tiFailLtcyTPSPLY_C SFRM_tiFailLtcyTSAF_C /end DEF_CHARACTERISTIC
 /begin OUT_MEASUREMENT Sfrm_bErrHndlr Sfrm_idFaultSrcChn Sfrm_idFaultSrcUsr SFRM_stInfoCC08_a SFRM_stInfoGMO_a SFRM_stInfoLSS_a SFRM_stInfoPSPLY_a SFRM_stInfoSAF_a SFRM_tiDwnTmrCC08_a SFRM_tiDwnTmrGMO_a SFRM_tiDwnTmrLSS_a SFRM_tiDwnTmrPSPLY_a SFRM_tiDwnTmrSAF_a SFRM_tiUpTmrCC08_a SFRM_tiUpTmrGMO_a SFRM_tiUpTmrLSS_a SFRM_tiUpTmrPSPLY_a SFRM_tiUpTmrSAF_a Sfrm_xReqSwtOffPs Sfrm_xReqSwtOffPsInt /end OUT_MEASUREMENT
/end FUNCTION
/begin FUNCTION F6260_RLIM "F6260: Reset Limitation"
 /begin DEF_CHARACTERISTIC RLim_numLimThres_C RLim_swtClrMode_C RLim_swtClrShOffEnbl_C RLim_swtLimFeatDisbl_C /end DEF_CHARACTERISTIC
 /begin OUT_MEASUREMENT RLim_cntRstCnt /end OUT_MEASUREMENT
/end FUNCTION
/begin FUNCTION F9110_ShrCal "F9110: Application values for ZF SW calibration sharing inteface" /begin DEF_CHARACTERISTIC ShrCal_ActvIC2OnFcc_C ShrCal_SlctSeramMth_C /end DEF_CHARACTERISTIC /end FUNCTION
/begin FUNCTION F9110_SHRDSM "F9110: Interface for customer DSM" /begin DEF_CHARACTERISTIC ShrSrv_bDsmRdyByp_C /end DEF_CHARACTERISTIC /begin OUT_MEASUREMENT ShrSrv_bDsmRdy ShrSrv_bDsmRdyCus /end OUT_MEASUREMENT /end FUNCTION
/begin FUNCTION F9110_SHRINTERN "F9110: Internal Signals SW sharing" /begin OUT_MEASUREMENT SrvShr_RND32_EWS4 /end OUT_MEASUREMENT /end FUNCTION
/begin FUNCTION F9110_SHRPFC "F9110: Software sharing interface for main function PFC"
 /begin OUT_MEASUREMENT SrvShr_ctPFCCfg_a SrvShr_numMemArSizeUsd_a SrvShr_numMemArSize_a SrvShr_numPFCCfgMax_a /end OUT_MEASUREMENT
/end FUNCTION
/begin FUNCTION F9110_SHRROM "F9110: Rom Checksum Test Function" /begin OUT_MEASUREMENT SrvShr_stRomFault /end OUT_MEASUREMENT /end FUNCTION
/begin FUNCTION F9110_SHRSAF "F9110: Software sharing interface for subsystem SAF"
 /begin OUT_MEASUREMENT ShrSaf_stFaultInfo_A ShrSaf_stFaultInfo_B SrvShr_stFaultMCCOMP SrvShr_stFaultSFRM SrvShr_stTstMCCOMP SrvShr_stTstSFRM /end OUT_MEASUREMENT
/end FUNCTION
/begin FUNCTION F9110_SHRTIME "F9110: Timing Handling within SW sharing"
 /begin OUT_MEASUREMENT SrvShr_BETRSTD SrvShr_BETRSTD_INCL_STDBY SrvShr_tiOpCruTemp SrvShr_tiOpTemp /end OUT_MEASUREMENT
/end FUNCTION
/begin FUNCTION F9120_INPPEXT "F9120: Temperature Measurement SW sharing" /begin DEF_CHARACTERISTIC SrvShr_tSubsChpOfs_C /end DEF_CHARACTERISTIC /end FUNCTION
/begin FUNCTION F9120_SHRBYPINP "F9120: Input 2 Wire Interface as Bypass"
 /begin DEF_CHARACTERISTIC SrvShr_facTipInfoHigh_C SrvShr_facTipInfoMul_C SrvShr_tiTipInfoHigh_C SrvShr_tiTipInfoMeas_C /end DEF_CHARACTERISTIC
 /begin OUT_MEASUREMENT SrvShr_stTipInfo SrvShr_TIPINFO_HIGHIMPULS_MAX SrvShr_TIPINFO_HIGHIMPULS_MIN SrvShr_TIPINFO_LOWIMPULS_MAX SrvShr_TIPINFO_LOWIMPULS_MIN SrvShr_TIPINFO_MULTIPLICATOR SrvShr_tiTipInfoHigh SrvShr_tiTipInfoHighLast SrvShr_tiTipInfoLow SrvShr_tiTipInfoMeas /end OUT_MEASUREMENT
/end FUNCTION
/begin FUNCTION F9120_SHRINP "F9120: General Input Signals SW sharing"
 /begin DEF_CHARACTERISTIC SrvShr_rTrqMax_C SrvShr_rTrqMin_C SrvShr_rTrqOff_C SrvShr_swtTrqOn_C SrvShr_tiTrqPerMax_C SrvShr_tiTrqPerMin_C /end DEF_CHARACTERISTIC
 /begin OUT_MEASUREMENT SrvShr_CAN_ERROR_PIN SrvShr_CAN_WAKE_UP SrvShr_DC_TRQ SrvShr_DC_TRQ_ESTATUS SrvShr_U_KL15_PIN /end OUT_MEASUREMENT
/end FUNCTION
/begin FUNCTION F9120_SHRPSNS "F9120: Position Lines SW sharing"
 /begin OUT_MEASUREMENT SrvShr_LX SrvShr_LX_DI_RDY SrvShr_LX_ESTATUS SrvShr_LX_ESTATUS_KOMP SrvShr_LX_KOMP SrvShr_stPsns_Fault /end OUT_MEASUREMENT
/end FUNCTION
/begin FUNCTION F9120_SHRTAP "F9120: Input Signals available via Software Sharing Interface"
 /begin DEF_CHARACTERISTIC SrvShr_uIn0ThresHigh_C SrvShr_uIn0ThresLow_C SrvShr_uTapMinusThresHigh_C SrvShr_uTapMinusThresLow_C SrvShr_uTapPlusThresHigh_C SrvShr_uTapPlusThresLow_C /end DEF_CHARACTERISTIC
 /begin OUT_MEASUREMENT SrvShr_IN0 SrvShr_IN0_ESTATUS SrvShr_TIP_MINUS_PIN SrvShr_TIP_MINUS_PIN_ESTATUS SrvShr_TIP_PIN_DI_RDY SrvShr_TIP_PLUS_PIN SrvShr_TIP_PLUS_PIN_ESTATUS SrvShr_U_IN0 SrvShr_U_IN1 SrvShr_U_IN2 /end OUT_MEASUREMENT
/end FUNCTION
/begin FUNCTION F9120_SHRTAPA "F9120: Input Signals available via Software Sharing Interface"
 /begin DEF_CHARACTERISTIC SrvShr_stTapAnaEval_C SrvShr_tiTapAnaRngStb_C SrvShr_uTapAnaEval_C /end DEF_CHARACTERISTIC
 /begin REF_CHARACTERISTIC ECE_idxAdcOpt_C /end REF_CHARACTERISTIC
 /begin IN_MEASUREMENT ECE_uAdcA /end IN_MEASUREMENT
 /begin OUT_MEASUREMENT SrvShr_idxTapAnaRng SrvShr_idxTapAnaRngOld SrvShr_idxTapAnaRngUse SrvShr_TIP_ANALOG_DI_RDY SrvShr_TIP_ANALOG_ESTATUS SrvShr_TIP_MINUS_ANALOG SrvShr_TIP_PLUS_ANALOG SrvShr_tiTapAnaRngStb SrvShr_uTapAna SrvShr_U_IN3 /end OUT_MEASUREMENT
/end FUNCTION
/begin FUNCTION F9120_SHRTEMP "F9120: Temperature Measurement SW sharing"
 /begin OUT_MEASUREMENT SrvShr_CCHIP1_RAW SrvShr_CCHIP1_RAW_DI_RDY SrvShr_CCHIP1_RAW_ESTATUS SrvShr_CCHIP2_RAW SrvShr_CCHIP2_RAW_DI_RDY SrvShr_CCHIP2_RAW_ESTATUS SrvShr_CGT_RAW SrvShr_CGT_RAW_DI_RDY SrvShr_CGT_RAW_ESTATUS SrvShr_stAtf_Fault SrvShr_stChp1_Fault /end OUT_MEASUREMENT
/end FUNCTION
/begin FUNCTION F9120_SHRTIS "F9120: Transmission Input Speed SW sharing"
 /begin OUT_MEASUREMENT SrvShr_NT_DI_RDY SrvShr_NT_ESTATUS SrvShr_NT_PULSE_WIDTH SrvShr_NT_SUM_PULSES SrvShr_NT_SUM_PULSE_TIME SrvShr_stTis_Fault /end OUT_MEASUREMENT
/end FUNCTION
/begin FUNCTION F9120_SHRTOS "F9120: Transmission Output Speed SW sharing"
 /begin OUT_MEASUREMENT SrvShr_NAB_DI_RDY SrvShr_NAB_ESTATUS SrvShr_NAB_PULSE_WIDTH SrvShr_NAB_SUM_PULSES SrvShr_NAB_SUM_PULSE_TIME SrvShr_stTos_Fault /end OUT_MEASUREMENT
/end FUNCTION
/begin FUNCTION F9120_SHRVOLT "F9120: Voltage Measurement SW sharing" /begin DEF_CHARACTERISTIC SrvShr_tiSSplyExtChk_C /end DEF_CHARACTERISTIC
 /begin OUT_MEASUREMENT SrvShr_bSSplyExtFault SrvShr_bSSplyExtTest SrvShr_stSSplyExtFault SrvShr_stSSplyExtFaultOld SrvShr_stSSply_Fault SrvShr_stSSply_KFA SrvShr_stSSply_Test SrvShr_tiSSplyExtChk SrvShr_UBATT_FILT SrvShr_UDRMV1 SrvShr_UDRMV2 SrvShr_USENSOR SrvShr_USENSOR_DI_RDY SrvShr_USENSOR_ESTATUS SrvShr_USENSOR_ESTATUS_KOMP SrvShr_U_PN_RAW /end OUT_MEASUREMENT
/end FUNCTION
/begin FUNCTION F9140_SHRBYPOUT "F9140: Output 2 Wire Interface as Bypass" /begin OUT_MEASUREMENT SrvShr_POSINFO_MULTIPLICATOR /end OUT_MEASUREMENT /end FUNCTION
/begin FUNCTION F9140_SHROUT "F9140: Output Signals available via Software Sharing Interface" /begin DEF_CHARACTERISTIC SrvShr_stSdnWakFilt_C SWI_SET_PIN /end DEF_CHARACTERISTIC
 /begin OUT_MEASUREMENT ShrOut_stFaultInfo_A ShrOut_stFaultInfo_B SrvShr_bSSplyReq SrvShr_ctSdnFast SrvShr_SENSORINIT_DONE SrvShr_SHUTDOWN SrvShr_START_INHIBITOR_STATUS SrvShr_stSdnWakFilt SrvShr_WDOG_DI_RDY SrvShr_WDOG_ESTATUS /end OUT_MEASUREMENT
/end FUNCTION
/begin RECORD_LAYOUT AblGLFKFub_S1 FNC_VALUES 1 UBYTE ROW_DIR DIRECT /end RECORD_LAYOUT
/begin RECORD_LAYOUT AblGLKFsw_S1 FNC_VALUES 5 SWORD ROW_DIR DIRECT AXIS_PTS_X 2 SWORD INDEX_INCR DIRECT AXIS_PTS_Y 4 SWORD INDEX_INCR DIRECT NO_AXIS_PTS_X 1 SWORD NO_AXIS_PTS_Y 3 SWORD /end RECORD_LAYOUT
/begin RECORD_LAYOUT AblGLKLsw_S1 FNC_VALUES 3 SWORD COLUMN_DIR DIRECT AXIS_PTS_X 2 SWORD INDEX_INCR DIRECT NO_AXIS_PTS_X 1 SWORD /end RECORD_LAYOUT
/begin RECORD_LAYOUT AblGLKLuw_S1 FNC_VALUES 3 UWORD COLUMN_DIR DIRECT AXIS_PTS_X 2 UWORD INDEX_INCR DIRECT NO_AXIS_PTS_X 1 UWORD /end RECORD_LAYOUT
/begin RECORD_LAYOUT AblGLKWBsb_S1 FNC_VALUES 1 SBYTE COLUMN_DIR DIRECT /end RECORD_LAYOUT
/begin RECORD_LAYOUT AblGLKWBsw_S1 FNC_VALUES 1 SWORD COLUMN_DIR DIRECT /end RECORD_LAYOUT
/begin RECORD_LAYOUT AblGLKWBub_S1 FNC_VALUES 1 UBYTE COLUMN_DIR DIRECT /end RECORD_LAYOUT
/begin RECORD_LAYOUT AblGLKWBuw_S1 FNC_VALUES 1 UWORD COLUMN_DIR DIRECT /end RECORD_LAYOUT
/begin RECORD_LAYOUT AblGLKWr32_S1 FNC_VALUES 1 FLOAT32_IEEE COLUMN_DIR DIRECT /end RECORD_LAYOUT
/begin RECORD_LAYOUT AblGLKWsb_S1 FNC_VALUES 1 SBYTE COLUMN_DIR DIRECT /end RECORD_LAYOUT
/begin RECORD_LAYOUT AblGLKWsw_S1 FNC_VALUES 1 SWORD COLUMN_DIR DIRECT /end RECORD_LAYOUT
/begin RECORD_LAYOUT AblGLKWub_S1 FNC_VALUES 1 UBYTE COLUMN_DIR DIRECT /end RECORD_LAYOUT
/begin RECORD_LAYOUT AblGLKWul_S1 FNC_VALUES 1 ULONG COLUMN_DIR DIRECT /end RECORD_LAYOUT
/begin RECORD_LAYOUT AblGLKWuw_S1 FNC_VALUES 1 UWORD COLUMN_DIR DIRECT /end RECORD_LAYOUT
/end MODULE
/end PROJECT
