ASAP2_VERSION 1 51
/begin PROJECT _929_929 "Gen2_BMW_System_Supplier_Lib"
/begin HEADER "" VERSION "C_03_03" PROJECT_NO _929_929 /end HEADER
/begin MODULE DIM ""
/begin MOD_COMMON "" BYTE_ORDER MSB_FIRST ALIGNMENT_BYTE 1 ALIGNMENT_WORD 2 ALIGNMENT_LONG 4 ALIGNMENT_FLOAT32_IEEE 4 /end MOD_COMMON
/begin CHARACTERISTIC T_VKABHSSP34 "Verzögerungszeit abschaltende Kupplung bei HS" VALUE 0x26E71C kw_ui8_S6_S3 2000 UMR_MSEC__10_1_0_S6_S3 0 2000 /end CHARACTERISTIC
/begin CHARACTERISTIC KF_TPKABMTCGSP34 "Zeitoffset Ende Rampe auf Schaltdruck KAB fuer HS" MAP 0x240CF4 kf_ui8_S6_S3 2000 UMR_MSEC__10_1_M128_S6_S3 -1000 1000
 /begin AXIS_DESCR STD_AXIS zff_atsys._.iSignale._.obj.sig_m_t8 UMR_NM__8_1_M50_S6_S3 8 -400 1640 DEPOSIT ABSOLUTE MONOTONY MON_INCREASE /end AXIS_DESCR
 /begin AXIS_DESCR STD_AXIS zff_atsys._.iSignale._.obj.sig_c_getr UMR_GRADC__1_1_M40_S6_S3 8 -40 150 DEPOSIT ABSOLUTE MONOTONY MON_INCREASE /end AXIS_DESCR
/end CHARACTERISTIC
/begin CHARACTERISTIC KL_TOPKABNDSP34 "Zeitoffset f(nd_synistgang) Ende Rampe auf Schaltdruck KAB fuer HS" CURVE 0x240D4C kl_si16_S6_S3 1000 UMR_MSEC__10_1_0_S6_S3 0 1000
 /begin AXIS_DESCR STD_AXIS iSasZentr.iSchaltend.nd_synistgang UMR_U_MIN_1_1_0_S6_S3 4 -8000 8000 DEPOSIT ABSOLUTE MONOTONY MON_INCREASE /end AXIS_DESCR
/end CHARACTERISTIC
/begin CHARACTERISTIC KL_PHKABMTSP34 "Haltedruck abschaltende Kupplung bei HS" CURVE 0x240D60 kl_si16_S6_S3 22 UMR_BAR__1_1000_0_S6_S3 0 22
 /begin AXIS_DESCR STD_AXIS zff_atsys._.iSignale._.obj.sig_m_t UMR_NM__1_1_0_S6_S3 8 -400 1640 DEPOSIT ABSOLUTE MONOTONY MON_INCREASE /end AXIS_DESCR
/end CHARACTERISTIC
/begin CHARACTERISTIC KF_THKABMTCGSP34 "Zeitoffset Ende Haltephase KAB fuer HS" MAP 0x240D84 kf_ui8_S6_S3 2000 UMR_MSEC__10_1_M128_S6_S3 -1000 1000
 /begin AXIS_DESCR STD_AXIS zff_atsys._.iSignale._.obj.sig_m_t8 UMR_NM__8_1_M50_S6_S3 8 -400 1640 DEPOSIT ABSOLUTE MONOTONY MON_INCREASE /end AXIS_DESCR
 /begin AXIS_DESCR STD_AXIS zff_atsys._.iSignale._.obj.sig_c_getr UMR_GRADC__1_1_M40_S6_S3 8 -40 150 DEPOSIT ABSOLUTE MONOTONY MON_INCREASE /end AXIS_DESCR
/end CHARACTERISTIC
/begin CHARACTERISTIC KL_POKABCGSP34 "Temp. abhängiger Druckoffset auf Schaltdruck KAB fuer HS" CURVE 0x240DDC kl_si16_S6_S3 2.5 UMR_BAR__1_1000_0_S6_S3 -1.25 1.25
 /begin AXIS_DESCR STD_AXIS zff_atsys._.iSignale._.obj.sig_c_getr UMR_GRADC__1_1_M40_S6_S3 3 -40 150 DEPOSIT ABSOLUTE MONOTONY MON_INCREASE /end AXIS_DESCR
/end CHARACTERISTIC
/begin CHARACTERISTIC T_VKABHSSP45 "Verzögerungszeit abschaltende Kupplung bei HS" VALUE 0x26E71D kw_ui8_S6_S3 2000 UMR_MSEC__10_1_0_S6_S3 0 2000 /end CHARACTERISTIC
/begin CHARACTERISTIC KF_TPKABMTCGSP45 "Zeitoffset Ende Rampe auf Schaltdruck KAB fuer HS" MAP 0x240DEC kf_ui8_S6_S3 2000 UMR_MSEC__10_1_M128_S6_S3 -1000 1000
 /begin AXIS_DESCR STD_AXIS zff_atsys._.iSignale._.obj.sig_m_t8 UMR_NM__8_1_M50_S6_S3 8 -400 1640 DEPOSIT ABSOLUTE MONOTONY MON_INCREASE /end AXIS_DESCR
 /begin AXIS_DESCR STD_AXIS zff_atsys._.iSignale._.obj.sig_c_getr UMR_GRADC__1_1_M40_S6_S3 8 -40 150 DEPOSIT ABSOLUTE MONOTONY MON_INCREASE /end AXIS_DESCR
/end CHARACTERISTIC
/begin CHARACTERISTIC KL_TOPKABNDSP45 "Zeitoffset f(nd_synistgang) Ende Rampe auf Schaltdruck KAB fuer HS" CURVE 0x240E44 kl_si16_S6_S3 1000 UMR_MSEC__10_1_0_S6_S3 0 1000
 /begin AXIS_DESCR STD_AXIS iSasZentr.iSchaltend.nd_synistgang UMR_U_MIN_1_1_0_S6_S3 4 -8000 8000 DEPOSIT ABSOLUTE MONOTONY MON_INCREASE /end AXIS_DESCR
/end CHARACTERISTIC
/begin CHARACTERISTIC KL_PHKABMTSP45 "Haltedruck abschaltende Kupplung bei HS" CURVE 0x240E58 kl_si16_S6_S3 22 UMR_BAR__1_1000_0_S6_S3 0 22
 /begin AXIS_DESCR STD_AXIS zff_atsys._.iSignale._.obj.sig_m_t UMR_NM__1_1_0_S6_S3 8 -400 1640 DEPOSIT ABSOLUTE MONOTONY MON_INCREASE /end AXIS_DESCR
/end CHARACTERISTIC
/begin CHARACTERISTIC KF_THKABMTCGSP45 "Zeitoffset Ende Haltephase KAB fuer HS" MAP 0x240E7C kf_ui8_S6_S3 2000 UMR_MSEC__10_1_M128_S6_S3 -1000 1000
 /begin AXIS_DESCR STD_AXIS zff_atsys._.iSignale._.obj.sig_m_t8 UMR_NM__8_1_M50_S6_S3 8 -400 1640 DEPOSIT ABSOLUTE MONOTONY MON_INCREASE /end AXIS_DESCR
 /begin AXIS_DESCR STD_AXIS zff_atsys._.iSignale._.obj.sig_c_getr UMR_GRADC__1_1_M40_S6_S3 8 -40 150 DEPOSIT ABSOLUTE MONOTONY MON_INCREASE /end AXIS_DESCR
/end CHARACTERISTIC
/begin CHARACTERISTIC KL_POKABCGSP45 "Temp. abhängiger Druckoffset auf Schaltdruck KAB fuer HS" CURVE 0x240ED4 kl_si16_S6_S3 2.5 UMR_BAR__1_1000_0_S6_S3 -1.25 1.25
 /begin AXIS_DESCR STD_AXIS zff_atsys._.iSignale._.obj.sig_c_getr UMR_GRADC__1_1_M40_S6_S3 3 -40 150 DEPOSIT ABSOLUTE MONOTONY MON_INCREASE /end AXIS_DESCR
/end CHARACTERISTIC
/begin CHARACTERISTIC T_VKABHSSP56 "Verzögerungszeit abschaltende Kupplung bei HS" VALUE 0x26E71E kw_ui8_S6_S3 2000 UMR_MSEC__10_1_0_S6_S3 0 2000 /end CHARACTERISTIC
/begin CHARACTERISTIC KF_TPKABMTCGSP56 "Zeitoffset Ende Rampe auf Schaltdruck KAB fuer HS" MAP 0x240EE4 kf_ui8_S6_S3 2000 UMR_MSEC__10_1_M128_S6_S3 -1000 1000
 /begin AXIS_DESCR STD_AXIS zff_atsys._.iSignale._.obj.sig_m_t8 UMR_NM__8_1_M50_S6_S3 8 -400 1640 DEPOSIT ABSOLUTE MONOTONY MON_INCREASE /end AXIS_DESCR
 /begin AXIS_DESCR STD_AXIS zff_atsys._.iSignale._.obj.sig_c_getr UMR_GRADC__1_1_M40_S6_S3 8 -40 150 DEPOSIT ABSOLUTE MONOTONY MON_INCREASE /end AXIS_DESCR
/end CHARACTERISTIC
/begin CHARACTERISTIC KL_TOPKABNDSP56 "Zeitoffset f(nd_synistgang) Ende Rampe auf Schaltdruck KAB fuer HS" CURVE 0x240F3C kl_si16_S6_S3 1000 UMR_MSEC__10_1_0_S6_S3 0 1000
 /begin AXIS_DESCR STD_AXIS iSasZentr.iSchaltend.nd_synistgang UMR_U_MIN_1_1_0_S6_S3 4 -8000 8000 DEPOSIT ABSOLUTE MONOTONY MON_INCREASE /end AXIS_DESCR
/end CHARACTERISTIC
/begin CHARACTERISTIC KL_PHKABMTSP56 "Haltedruck abschaltende Kupplung bei HS" CURVE 0x240F50 kl_si16_S6_S3 22 UMR_BAR__1_1000_0_S6_S3 0 22
 /begin AXIS_DESCR STD_AXIS zff_atsys._.iSignale._.obj.sig_m_t UMR_NM__1_1_0_S6_S3 8 -400 1640 DEPOSIT ABSOLUTE MONOTONY MON_INCREASE /end AXIS_DESCR
/end CHARACTERISTIC
/begin CHARACTERISTIC KF_THKABMTCGSP56 "Zeitoffset Ende Haltephase KAB fuer HS" MAP 0x240F74 kf_ui8_S6_S3 2000 UMR_MSEC__10_1_M128_S6_S3 -1000 1000
 /begin AXIS_DESCR STD_AXIS zff_atsys._.iSignale._.obj.sig_m_t8 UMR_NM__8_1_M50_S6_S3 8 -400 1640 DEPOSIT ABSOLUTE MONOTONY MON_INCREASE /end AXIS_DESCR
 /begin AXIS_DESCR STD_AXIS zff_atsys._.iSignale._.obj.sig_c_getr UMR_GRADC__1_1_M40_S6_S3 8 -40 150 DEPOSIT ABSOLUTE MONOTONY MON_INCREASE /end AXIS_DESCR
/end CHARACTERISTIC
/begin CHARACTERISTIC KL_POKABCGSP56 "Temp. abhängiger Druckoffset auf Schaltdruck KAB fuer HS" CURVE 0x240FCC kl_si16_S6_S3 2.5 UMR_BAR__1_1000_0_S6_S3 -1.25 1.25
 /begin AXIS_DESCR STD_AXIS zff_atsys._.iSignale._.obj.sig_c_getr UMR_GRADC__1_1_M40_S6_S3 3 -40 150 DEPOSIT ABSOLUTE MONOTONY MON_INCREASE /end AXIS_DESCR
/end CHARACTERISTIC
/begin CHARACTERISTIC T_VKABHSSP67 "Verzögerungszeit abschaltende Kupplung bei HS" VALUE 0x26E71F kw_ui8_S6_S3 2000 UMR_MSEC__10_1_0_S6_S3 0 2000 /end CHARACTERISTIC
/begin CHARACTERISTIC KF_TPKABMTCGSP67 "Zeitoffset Ende Rampe auf Schaltdruck KAB fuer HS" MAP 0x240FDC kf_ui8_S6_S3 2000 UMR_MSEC__10_1_M128_S6_S3 -1000 1000
 /begin AXIS_DESCR STD_AXIS zff_atsys._.iSignale._.obj.sig_m_t8 UMR_NM__8_1_M50_S6_S3 8 -400 1640 DEPOSIT ABSOLUTE MONOTONY MON_INCREASE /end AXIS_DESCR
 /begin AXIS_DESCR STD_AXIS zff_atsys._.iSignale._.obj.sig_c_getr UMR_GRADC__1_1_M40_S6_S3 8 -40 150 DEPOSIT ABSOLUTE MONOTONY MON_INCREASE /end AXIS_DESCR
/end CHARACTERISTIC
/begin CHARACTERISTIC KL_TOPKABNDSP67 "Zeitoffset f(nd_synistgang) Ende Rampe auf Schaltdruck KAB fuer HS" CURVE 0x241034 kl_si16_S6_S3 1000 UMR_MSEC__10_1_0_S6_S3 0 1000
 /begin AXIS_DESCR STD_AXIS iSasZentr.iSchaltend.nd_synistgang UMR_U_MIN_1_1_0_S6_S3 4 -8000 8000 DEPOSIT ABSOLUTE MONOTONY MON_INCREASE /end AXIS_DESCR
/end CHARACTERISTIC
/begin CHARACTERISTIC KL_PHKABMTSP67 "Haltedruck abschaltende Kupplung bei HS" CURVE 0x241048 kl_si16_S6_S3 22 UMR_BAR__1_1000_0_S6_S3 0 22
 /begin AXIS_DESCR STD_AXIS zff_atsys._.iSignale._.obj.sig_m_t UMR_NM__1_1_0_S6_S3 8 -400 1640 DEPOSIT ABSOLUTE MONOTONY MON_INCREASE /end AXIS_DESCR
/end CHARACTERISTIC
/begin CHARACTERISTIC KF_THKABMTCGSP67 "Zeitoffset Ende Haltephase KAB fuer HS" MAP 0x24106C kf_ui8_S6_S3 2000 UMR_MSEC__10_1_M128_S6_S3 -1000 1000
 /begin AXIS_DESCR STD_AXIS zff_atsys._.iSignale._.obj.sig_m_t8 UMR_NM__8_1_M50_S6_S3 8 -400 1640 DEPOSIT ABSOLUTE MONOTONY MON_INCREASE /end AXIS_DESCR
 /begin AXIS_DESCR STD_AXIS zff_atsys._.iSignale._.obj.sig_c_getr UMR_GRADC__1_1_M40_S6_S3 8 -40 150 DEPOSIT ABSOLUTE MONOTONY MON_INCREASE /end AXIS_DESCR
/end CHARACTERISTIC
/begin CHARACTERISTIC KL_POKABCGSP67 "Temp. abhängiger Druckoffset auf Schaltdruck KAB fuer HS" CURVE 0x2410C4 kl_si16_S6_S3 2.5 UMR_BAR__1_1000_0_S6_S3 -1.25 1.25
 /begin AXIS_DESCR STD_AXIS zff_atsys._.iSignale._.obj.sig_c_getr UMR_GRADC__1_1_M40_S6_S3 3 -40 150 DEPOSIT ABSOLUTE MONOTONY MON_INCREASE /end AXIS_DESCR
/end CHARACTERISTIC
/begin CHARACTERISTIC T_VKABHSSP78 "Verzögerungszeit abschaltende Kupplung bei HS" VALUE 0x26E720 kw_ui8_S6_S3 2000 UMR_MSEC__10_1_0_S6_S3 0 2000 /end CHARACTERISTIC
/begin CHARACTERISTIC KF_TPKABMTCGSP78 "Zeitoffset Ende Rampe auf Schaltdruck KAB fuer HS" MAP 0x2410D4 kf_ui8_S6_S3 2000 UMR_MSEC__10_1_M128_S6_S3 -1000 1000
 /begin AXIS_DESCR STD_AXIS zff_atsys._.iSignale._.obj.sig_m_t8 UMR_NM__8_1_M50_S6_S3 8 -400 1640 DEPOSIT ABSOLUTE MONOTONY MON_INCREASE /end AXIS_DESCR
 /begin AXIS_DESCR STD_AXIS zff_atsys._.iSignale._.obj.sig_c_getr UMR_GRADC__1_1_M40_S6_S3 8 -40 150 DEPOSIT ABSOLUTE MONOTONY MON_INCREASE /end AXIS_DESCR
/end CHARACTERISTIC
/begin CHARACTERISTIC KL_TOPKABNDSP78 "Zeitoffset f(nd_synistgang) Ende Rampe auf Schaltdruck KAB fuer HS" CURVE 0x24112C kl_si16_S6_S3 1000 UMR_MSEC__10_1_0_S6_S3 0 1000
 /begin AXIS_DESCR STD_AXIS iSasZentr.iSchaltend.nd_synistgang UMR_U_MIN_1_1_0_S6_S3 4 -8000 8000 DEPOSIT ABSOLUTE MONOTONY MON_INCREASE /end AXIS_DESCR
/end CHARACTERISTIC
/begin CHARACTERISTIC KL_PHKABMTSP78 "Haltedruck abschaltende Kupplung bei HS" CURVE 0x241140 kl_si16_S6_S3 22 UMR_BAR__1_1000_0_S6_S3 0 22
 /begin AXIS_DESCR STD_AXIS zff_atsys._.iSignale._.obj.sig_m_t UMR_NM__1_1_0_S6_S3 8 -400 1640 DEPOSIT ABSOLUTE MONOTONY MON_INCREASE /end AXIS_DESCR
/end CHARACTERISTIC
/begin CHARACTERISTIC KF_THKABMTCGSP78 "Zeitoffset Ende Haltephase KAB fuer HS" MAP 0x241164 kf_ui8_S6_S3 2000 UMR_MSEC__10_1_M128_S6_S3 -1000 1000
 /begin AXIS_DESCR STD_AXIS zff_atsys._.iSignale._.obj.sig_m_t8 UMR_NM__8_1_M50_S6_S3 8 -400 1640 DEPOSIT ABSOLUTE MONOTONY MON_INCREASE /end AXIS_DESCR
 /begin AXIS_DESCR STD_AXIS zff_atsys._.iSignale._.obj.sig_c_getr UMR_GRADC__1_1_M40_S6_S3 8 -40 150 DEPOSIT ABSOLUTE MONOTONY MON_INCREASE /end AXIS_DESCR
/end CHARACTERISTIC
/begin CHARACTERISTIC KL_POKABCGSP78 "Temp. abhängiger Druckoffset auf Schaltdruck KAB fuer HS" CURVE 0x2411BC kl_si16_S6_S3 2.5 UMR_BAR__1_1000_0_S6_S3 -1.25 1.25
 /begin AXIS_DESCR STD_AXIS zff_atsys._.iSignale._.obj.sig_c_getr UMR_GRADC__1_1_M40_S6_S3 3 -40 150 DEPOSIT ABSOLUTE MONOTONY MON_INCREASE /end AXIS_DESCR
/end CHARACTERISTIC
/begin CHARACTERISTIC T_VKABHSSP13 "Verzögerungszeit abschaltende Kupplung bei HS" VALUE 0x26E721 kw_ui8_S6_S3 2000 UMR_MSEC__10_1_0_S6_S3 0 2000 /end CHARACTERISTIC
/begin CHARACTERISTIC KF_TPKABMTCGSP13 "Zeitoffset Ende Rampe auf Schaltdruck KAB fuer HS" MAP 0x2411CC kf_ui8_S6_S3 2000 UMR_MSEC__10_1_M128_S6_S3 -1000 1000
 /begin AXIS_DESCR STD_AXIS zff_atsys._.iSignale._.obj.sig_m_t8 UMR_NM__8_1_M50_S6_S3 8 -400 1640 DEPOSIT ABSOLUTE MONOTONY MON_INCREASE /end AXIS_DESCR
 /begin AXIS_DESCR STD_AXIS zff_atsys._.iSignale._.obj.sig_c_getr UMR_GRADC__1_1_M40_S6_S3 8 -40 150 DEPOSIT ABSOLUTE MONOTONY MON_INCREASE /end AXIS_DESCR
/end CHARACTERISTIC
/begin CHARACTERISTIC KL_TOPKABNDSP13 "Zeitoffset f(nd_synistgang) Ende Rampe auf Schaltdruck KAB fuer HS" CURVE 0x241224 kl_si16_S6_S3 1000 UMR_MSEC__10_1_0_S6_S3 0 1000
 /begin AXIS_DESCR STD_AXIS iSasZentr.iSchaltend.nd_synistgang UMR_U_MIN_1_1_0_S6_S3 4 -8000 8000 DEPOSIT ABSOLUTE MONOTONY MON_INCREASE /end AXIS_DESCR
/end CHARACTERISTIC
/begin CHARACTERISTIC KL_PHKABMTSP13 "Haltedruck abschaltende Kupplung bei HS" CURVE 0x241238 kl_si16_S6_S3 22 UMR_BAR__1_1000_0_S6_S3 0 22
 /begin AXIS_DESCR STD_AXIS zff_atsys._.iSignale._.obj.sig_m_t UMR_NM__1_1_0_S6_S3 8 -400 1640 DEPOSIT ABSOLUTE MONOTONY MON_INCREASE /end AXIS_DESCR
/end CHARACTERISTIC
/begin CHARACTERISTIC KF_THKABMTCGSP13 "Zeitoffset Ende Haltephase KAB fuer HS" MAP 0x24125C kf_ui8_S6_S3 2000 UMR_MSEC__10_1_M128_S6_S3 -1000 1000
 /begin AXIS_DESCR STD_AXIS zff_atsys._.iSignale._.obj.sig_m_t8 UMR_NM__8_1_M50_S6_S3 8 -400 1640 DEPOSIT ABSOLUTE MONOTONY MON_INCREASE /end AXIS_DESCR
 /begin AXIS_DESCR STD_AXIS zff_atsys._.iSignale._.obj.sig_c_getr UMR_GRADC__1_1_M40_S6_S3 8 -40 150 DEPOSIT ABSOLUTE MONOTONY MON_INCREASE /end AXIS_DESCR
/end CHARACTERISTIC
/begin CHARACTERISTIC KL_POKABCGSP13 "Temp. abhängiger Druckoffset auf Schaltdruck KAB fuer HS" CURVE 0x2412B4 kl_si16_S6_S3 2.5 UMR_BAR__1_1000_0_S6_S3 -1.25 1.25
 /begin AXIS_DESCR STD_AXIS zff_atsys._.iSignale._.obj.sig_c_getr UMR_GRADC__1_1_M40_S6_S3 3 -40 150 DEPOSIT ABSOLUTE MONOTONY MON_INCREASE /end AXIS_DESCR
/end CHARACTERISTIC
/begin CHARACTERISTIC T_VKABHSSP24 "Verzögerungszeit abschaltende Kupplung bei HS" VALUE 0x26E722 kw_ui8_S6_S3 2000 UMR_MSEC__10_1_0_S6_S3 0 2000 /end CHARACTERISTIC
/begin CHARACTERISTIC KF_TPKABMTCGSP24 "Zeitoffset Ende Rampe auf Schaltdruck KAB fuer HS" MAP 0x2412C4 kf_ui8_S6_S3 2000 UMR_MSEC__10_1_M128_S6_S3 -1000 1000
 /begin AXIS_DESCR STD_AXIS zff_atsys._.iSignale._.obj.sig_m_t8 UMR_NM__8_1_M50_S6_S3 8 -400 1640 DEPOSIT ABSOLUTE MONOTONY MON_INCREASE /end AXIS_DESCR
 /begin AXIS_DESCR STD_AXIS zff_atsys._.iSignale._.obj.sig_c_getr UMR_GRADC__1_1_M40_S6_S3 8 -40 150 DEPOSIT ABSOLUTE MONOTONY MON_INCREASE /end AXIS_DESCR
/end CHARACTERISTIC
/begin CHARACTERISTIC KL_TOPKABNDSP24 "Zeitoffset f(nd_synistgang) Ende Rampe auf Schaltdruck KAB fuer HS" CURVE 0x24131C kl_si16_S6_S3 1000 UMR_MSEC__10_1_0_S6_S3 0 1000
 /begin AXIS_DESCR STD_AXIS iSasZentr.iSchaltend.nd_synistgang UMR_U_MIN_1_1_0_S6_S3 4 -8000 8000 DEPOSIT ABSOLUTE MONOTONY MON_INCREASE /end AXIS_DESCR
/end CHARACTERISTIC
/begin CHARACTERISTIC KL_PHKABMTSP24 "Haltedruck abschaltende Kupplung bei HS" CURVE 0x241330 kl_si16_S6_S3 22 UMR_BAR__1_1000_0_S6_S3 0 22
 /begin AXIS_DESCR STD_AXIS zff_atsys._.iSignale._.obj.sig_m_t UMR_NM__1_1_0_S6_S3 8 -400 1640 DEPOSIT ABSOLUTE MONOTONY MON_INCREASE /end AXIS_DESCR
/end CHARACTERISTIC
/begin CHARACTERISTIC KF_THKABMTCGSP24 "Zeitoffset Ende Haltephase KAB fuer HS" MAP 0x241354 kf_ui8_S6_S3 2000 UMR_MSEC__10_1_M128_S6_S3 -1000 1000
 /begin AXIS_DESCR STD_AXIS zff_atsys._.iSignale._.obj.sig_m_t8 UMR_NM__8_1_M50_S6_S3 8 -400 1640 DEPOSIT ABSOLUTE MONOTONY MON_INCREASE /end AXIS_DESCR
 /begin AXIS_DESCR STD_AXIS zff_atsys._.iSignale._.obj.sig_c_getr UMR_GRADC__1_1_M40_S6_S3 8 -40 150 DEPOSIT ABSOLUTE MONOTONY MON_INCREASE /end AXIS_DESCR
/end CHARACTERISTIC
/begin CHARACTERISTIC KL_POKABCGSP24 "Temp. abhängiger Druckoffset auf Schaltdruck KAB fuer HS" CURVE 0x2413AC kl_si16_S6_S3 2.5 UMR_BAR__1_1000_0_S6_S3 -1.25 1.25
 /begin AXIS_DESCR STD_AXIS zff_atsys._.iSignale._.obj.sig_c_getr UMR_GRADC__1_1_M40_S6_S3 3 -40 150 DEPOSIT ABSOLUTE MONOTONY MON_INCREASE /end AXIS_DESCR
/end CHARACTERISTIC
/begin CHARACTERISTIC T_VKABHSSP35 "Verzögerungszeit abschaltende Kupplung bei HS" VALUE 0x26E723 kw_ui8_S6_S3 2000 UMR_MSEC__10_1_0_S6_S3 0 2000 /end CHARACTERISTIC
/begin CHARACTERISTIC KF_TPKABMTCGSP35 "Zeitoffset Ende Rampe auf Schaltdruck KAB fuer HS" MAP 0x2413BC kf_ui8_S6_S3 2000 UMR_MSEC__10_1_M128_S6_S3 -1000 1000
 /begin AXIS_DESCR STD_AXIS zff_atsys._.iSignale._.obj.sig_m_t8 UMR_NM__8_1_M50_S6_S3 8 -400 1640 DEPOSIT ABSOLUTE MONOTONY MON_INCREASE /end AXIS_DESCR
 /begin AXIS_DESCR STD_AXIS zff_atsys._.iSignale._.obj.sig_c_getr UMR_GRADC__1_1_M40_S6_S3 8 -40 150 DEPOSIT ABSOLUTE MONOTONY MON_INCREASE /end AXIS_DESCR
/end CHARACTERISTIC
/begin CHARACTERISTIC KL_TOPKABNDSP35 "Zeitoffset f(nd_synistgang) Ende Rampe auf Schaltdruck KAB fuer HS" CURVE 0x241414 kl_si16_S6_S3 1000 UMR_MSEC__10_1_0_S6_S3 0 1000
 /begin AXIS_DESCR STD_AXIS iSasZentr.iSchaltend.nd_synistgang UMR_U_MIN_1_1_0_S6_S3 4 -8000 8000 DEPOSIT ABSOLUTE MONOTONY MON_INCREASE /end AXIS_DESCR
/end CHARACTERISTIC
/begin CHARACTERISTIC KL_PHKABMTSP35 "Haltedruck abschaltende Kupplung bei HS" CURVE 0x241428 kl_si16_S6_S3 22 UMR_BAR__1_1000_0_S6_S3 0 22
 /begin AXIS_DESCR STD_AXIS zff_atsys._.iSignale._.obj.sig_m_t UMR_NM__1_1_0_S6_S3 8 -400 1640 DEPOSIT ABSOLUTE MONOTONY MON_INCREASE /end AXIS_DESCR
/end CHARACTERISTIC
/begin CHARACTERISTIC KF_THKABMTCGSP35 "Zeitoffset Ende Haltephase KAB fuer HS" MAP 0x24144C kf_ui8_S6_S3 2000 UMR_MSEC__10_1_M128_S6_S3 -1000 1000
 /begin AXIS_DESCR STD_AXIS zff_atsys._.iSignale._.obj.sig_m_t8 UMR_NM__8_1_M50_S6_S3 8 -400 1640 DEPOSIT ABSOLUTE MONOTONY MON_INCREASE /end AXIS_DESCR
 /begin AXIS_DESCR STD_AXIS zff_atsys._.iSignale._.obj.sig_c_getr UMR_GRADC__1_1_M40_S6_S3 8 -40 150 DEPOSIT ABSOLUTE MONOTONY MON_INCREASE /end AXIS_DESCR
/end CHARACTERISTIC
/begin CHARACTERISTIC KL_POKABCGSP35 "Temp. abhängiger Druckoffset auf Schaltdruck KAB fuer HS" CURVE 0x2414A4 kl_si16_S6_S3 2.5 UMR_BAR__1_1000_0_S6_S3 -1.25 1.25
 /begin AXIS_DESCR STD_AXIS zff_atsys._.iSignale._.obj.sig_c_getr UMR_GRADC__1_1_M40_S6_S3 3 -40 150 DEPOSIT ABSOLUTE MONOTONY MON_INCREASE /end AXIS_DESCR
/end CHARACTERISTIC
/begin CHARACTERISTIC T_VKABHSSP46 "Verzögerungszeit abschaltende Kupplung bei HS" VALUE 0x26E724 kw_ui8_S6_S3 2000 UMR_MSEC__10_1_0_S6_S3 0 2000 /end CHARACTERISTIC
/begin CHARACTERISTIC KF_TPKABMTCGSP46 "Zeitoffset Ende Rampe auf Schaltdruck KAB fuer HS" MAP 0x2414B4 kf_ui8_S6_S3 2000 UMR_MSEC__10_1_M128_S6_S3 -1000 1000
 /begin AXIS_DESCR STD_AXIS zff_atsys._.iSignale._.obj.sig_m_t8 UMR_NM__8_1_M50_S6_S3 8 -400 1640 DEPOSIT ABSOLUTE MONOTONY MON_INCREASE /end AXIS_DESCR
 /begin AXIS_DESCR STD_AXIS zff_atsys._.iSignale._.obj.sig_c_getr UMR_GRADC__1_1_M40_S6_S3 8 -40 150 DEPOSIT ABSOLUTE MONOTONY MON_INCREASE /end AXIS_DESCR
/end CHARACTERISTIC
/begin CHARACTERISTIC KL_TOPKABNDSP46 "Zeitoffset f(nd_synistgang) Ende Rampe auf Schaltdruck KAB fuer HS" CURVE 0x24150C kl_si16_S6_S3 1000 UMR_MSEC__10_1_0_S6_S3 0 1000
 /begin AXIS_DESCR STD_AXIS iSasZentr.iSchaltend.nd_synistgang UMR_U_MIN_1_1_0_S6_S3 4 -8000 8000 DEPOSIT ABSOLUTE MONOTONY MON_INCREASE /end AXIS_DESCR
/end CHARACTERISTIC
/begin CHARACTERISTIC KL_PHKABMTSP46 "Haltedruck abschaltende Kupplung bei HS" CURVE 0x241520 kl_si16_S6_S3 22 UMR_BAR__1_1000_0_S6_S3 0 22
 /begin AXIS_DESCR STD_AXIS zff_atsys._.iSignale._.obj.sig_m_t UMR_NM__1_1_0_S6_S3 8 -400 1640 DEPOSIT ABSOLUTE MONOTONY MON_INCREASE /end AXIS_DESCR
/end CHARACTERISTIC
/begin CHARACTERISTIC KF_THKABMTCGSP46 "Zeitoffset Ende Haltephase KAB fuer HS" MAP 0x241544 kf_ui8_S6_S3 2000 UMR_MSEC__10_1_M128_S6_S3 -1000 1000
 /begin AXIS_DESCR STD_AXIS zff_atsys._.iSignale._.obj.sig_m_t8 UMR_NM__8_1_M50_S6_S3 8 -400 1640 DEPOSIT ABSOLUTE MONOTONY MON_INCREASE /end AXIS_DESCR
 /begin AXIS_DESCR STD_AXIS zff_atsys._.iSignale._.obj.sig_c_getr UMR_GRADC__1_1_M40_S6_S3 8 -40 150 DEPOSIT ABSOLUTE MONOTONY MON_INCREASE /end AXIS_DESCR
/end CHARACTERISTIC
/begin CHARACTERISTIC KL_POKABCGSP46 "Temp. abhängiger Druckoffset auf Schaltdruck KAB fuer HS" CURVE 0x24159C kl_si16_S6_S3 2.5 UMR_BAR__1_1000_0_S6_S3 -1.25 1.25
 /begin AXIS_DESCR STD_AXIS zff_atsys._.iSignale._.obj.sig_c_getr UMR_GRADC__1_1_M40_S6_S3 3 -40 150 DEPOSIT ABSOLUTE MONOTONY MON_INCREASE /end AXIS_DESCR
/end CHARACTERISTIC
/begin CHARACTERISTIC T_VKABHSSP57 "Verzögerungszeit abschaltende Kupplung bei HS" VALUE 0x26E725 kw_ui8_S6_S3 2000 UMR_MSEC__10_1_0_S6_S3 0 2000 /end CHARACTERISTIC
/begin CHARACTERISTIC KF_TPKABMTCGSP57 "Zeitoffset Ende Rampe auf Schaltdruck KAB fuer HS" MAP 0x2415AC kf_ui8_S6_S3 2000 UMR_MSEC__10_1_M128_S6_S3 -1000 1000
 /begin AXIS_DESCR STD_AXIS zff_atsys._.iSignale._.obj.sig_m_t8 UMR_NM__8_1_M50_S6_S3 8 -400 1640 DEPOSIT ABSOLUTE MONOTONY MON_INCREASE /end AXIS_DESCR
 /begin AXIS_DESCR STD_AXIS zff_atsys._.iSignale._.obj.sig_c_getr UMR_GRADC__1_1_M40_S6_S3 8 -40 150 DEPOSIT ABSOLUTE MONOTONY MON_INCREASE /end AXIS_DESCR
/end CHARACTERISTIC
/begin CHARACTERISTIC KL_TOPKABNDSP57 "Zeitoffset f(nd_synistgang) Ende Rampe auf Schaltdruck KAB fuer HS" CURVE 0x241604 kl_si16_S6_S3 1000 UMR_MSEC__10_1_0_S6_S3 0 1000
 /begin AXIS_DESCR STD_AXIS iSasZentr.iSchaltend.nd_synistgang UMR_U_MIN_1_1_0_S6_S3 4 -8000 8000 DEPOSIT ABSOLUTE MONOTONY MON_INCREASE /end AXIS_DESCR
/end CHARACTERISTIC
/begin CHARACTERISTIC KL_PHKABMTSP57 "Haltedruck abschaltende Kupplung bei HS" CURVE 0x241618 kl_si16_S6_S3 22 UMR_BAR__1_1000_0_S6_S3 0 22
 /begin AXIS_DESCR STD_AXIS zff_atsys._.iSignale._.obj.sig_m_t UMR_NM__1_1_0_S6_S3 8 -400 1640 DEPOSIT ABSOLUTE MONOTONY MON_INCREASE /end AXIS_DESCR
/end CHARACTERISTIC
/begin CHARACTERISTIC KF_THKABMTCGSP57 "Zeitoffset Ende Haltephase KAB fuer HS" MAP 0x24163C kf_ui8_S6_S3 2000 UMR_MSEC__10_1_M128_S6_S3 -1000 1000
 /begin AXIS_DESCR STD_AXIS zff_atsys._.iSignale._.obj.sig_m_t8 UMR_NM__8_1_M50_S6_S3 8 -400 1640 DEPOSIT ABSOLUTE MONOTONY MON_INCREASE /end AXIS_DESCR
 /begin AXIS_DESCR STD_AXIS zff_atsys._.iSignale._.obj.sig_c_getr UMR_GRADC__1_1_M40_S6_S3 8 -40 150 DEPOSIT ABSOLUTE MONOTONY MON_INCREASE /end AXIS_DESCR
/end CHARACTERISTIC
/begin CHARACTERISTIC KL_POKABCGSP57 "Temp. abhängiger Druckoffset auf Schaltdruck KAB fuer HS" CURVE 0x241694 kl_si16_S6_S3 2.5 UMR_BAR__1_1000_0_S6_S3 -1.25 1.25
 /begin AXIS_DESCR STD_AXIS zff_atsys._.iSignale._.obj.sig_c_getr UMR_GRADC__1_1_M40_S6_S3 3 -40 150 DEPOSIT ABSOLUTE MONOTONY MON_INCREASE /end AXIS_DESCR
/end CHARACTERISTIC
/begin CHARACTERISTIC T_VKABHSSP68 "Verzögerungszeit abschaltende Kupplung bei HS" VALUE 0x26E726 kw_ui8_S6_S3 2000 UMR_MSEC__10_1_0_S6_S3 0 2000 /end CHARACTERISTIC
/begin CHARACTERISTIC KF_TPKABMTCGSP68 "Zeitoffset Ende Rampe auf Schaltdruck KAB fuer HS" MAP 0x2416A4 kf_ui8_S6_S3 2000 UMR_MSEC__10_1_M128_S6_S3 -1000 1000
 /begin AXIS_DESCR STD_AXIS zff_atsys._.iSignale._.obj.sig_m_t8 UMR_NM__8_1_M50_S6_S3 8 -400 1640 DEPOSIT ABSOLUTE MONOTONY MON_INCREASE /end AXIS_DESCR
 /begin AXIS_DESCR STD_AXIS zff_atsys._.iSignale._.obj.sig_c_getr UMR_GRADC__1_1_M40_S6_S3 8 -40 150 DEPOSIT ABSOLUTE MONOTONY MON_INCREASE /end AXIS_DESCR
/end CHARACTERISTIC
/begin CHARACTERISTIC KL_TOPKABNDSP68 "Zeitoffset f(nd_synistgang) Ende Rampe auf Schaltdruck KAB fuer HS" CURVE 0x2416FC kl_si16_S6_S3 1000 UMR_MSEC__10_1_0_S6_S3 0 1000
 /begin AXIS_DESCR STD_AXIS iSasZentr.iSchaltend.nd_synistgang UMR_U_MIN_1_1_0_S6_S3 4 -8000 8000 DEPOSIT ABSOLUTE MONOTONY MON_INCREASE /end AXIS_DESCR
/end CHARACTERISTIC
/begin CHARACTERISTIC KL_PHKABMTSP68 "Haltedruck abschaltende Kupplung bei HS" CURVE 0x241710 kl_si16_S6_S3 22 UMR_BAR__1_1000_0_S6_S3 0 22
 /begin AXIS_DESCR STD_AXIS zff_atsys._.iSignale._.obj.sig_m_t UMR_NM__1_1_0_S6_S3 8 -400 1640 DEPOSIT ABSOLUTE MONOTONY MON_INCREASE /end AXIS_DESCR
/end CHARACTERISTIC
/begin CHARACTERISTIC KF_THKABMTCGSP68 "Zeitoffset Ende Haltephase KAB fuer HS" MAP 0x241734 kf_ui8_S6_S3 2000 UMR_MSEC__10_1_M128_S6_S3 -1000 1000
 /begin AXIS_DESCR STD_AXIS zff_atsys._.iSignale._.obj.sig_m_t8 UMR_NM__8_1_M50_S6_S3 8 -400 1640 DEPOSIT ABSOLUTE MONOTONY MON_INCREASE /end AXIS_DESCR
 /begin AXIS_DESCR STD_AXIS zff_atsys._.iSignale._.obj.sig_c_getr UMR_GRADC__1_1_M40_S6_S3 8 -40 150 DEPOSIT ABSOLUTE MONOTONY MON_INCREASE /end AXIS_DESCR
/end CHARACTERISTIC
/begin CHARACTERISTIC KL_POKABCGSP68 "Temp. abhängiger Druckoffset auf Schaltdruck KAB fuer HS" CURVE 0x24178C kl_si16_S6_S3 2.5 UMR_BAR__1_1000_0_S6_S3 -1.25 1.25
 /begin AXIS_DESCR STD_AXIS zff_atsys._.iSignale._.obj.sig_c_getr UMR_GRADC__1_1_M40_S6_S3 3 -40 150 DEPOSIT ABSOLUTE MONOTONY MON_INCREASE /end AXIS_DESCR
/end CHARACTERISTIC
/begin CHARACTERISTIC T_VKABHSSPORT12 "Verzögerungszeit abschaltende Kupplung bei HS" VALUE 0x26E727 kw_ui8_S6_S3 2000 UMR_MSEC__10_1_0_S6_S3 0 2000 /end CHARACTERISTIC
/begin CHARACTERISTIC KF_TPKABMTCGSPORT12 "Zeitoffset Ende Rampe auf Schaltdruck KAB fuer HS" MAP 0x24179C kf_ui8_S6_S3 2000 UMR_MSEC__10_1_M128_S6_S3 -1000 1000
 /begin AXIS_DESCR STD_AXIS zff_atsys._.iSignale._.obj.sig_m_t8 UMR_NM__8_1_M50_S6_S3 8 -400 1640 DEPOSIT ABSOLUTE MONOTONY MON_INCREASE /end AXIS_DESCR
 /begin AXIS_DESCR STD_AXIS zff_atsys._.iSignale._.obj.sig_c_getr UMR_GRADC__1_1_M40_S6_S3 8 -40 150 DEPOSIT ABSOLUTE MONOTONY MON_INCREASE /end AXIS_DESCR
/end CHARACTERISTIC
/begin CHARACTERISTIC KL_TOPKABNDSPORT12 "Zeitoffset f(nd_synistgang) Ende Rampe auf Schaltdruck KAB fuer HS" CURVE 0x2417F4 kl_si16_S6_S3 1000 UMR_MSEC__10_1_0_S6_S3 0 1000
 /begin AXIS_DESCR STD_AXIS iSasZentr.iSchaltend.nd_synistgang UMR_U_MIN_1_1_0_S6_S3 4 -8000 8000 DEPOSIT ABSOLUTE MONOTONY MON_INCREASE /end AXIS_DESCR
/end CHARACTERISTIC
/begin CHARACTERISTIC KL_PHKABMTSPORT12 "Haltedruck abschaltende Kupplung bei HS" CURVE 0x241808 kl_si16_S6_S3 22 UMR_BAR__1_1000_0_S6_S3 0 22
 /begin AXIS_DESCR STD_AXIS zff_atsys._.iSignale._.obj.sig_m_t UMR_NM__1_1_0_S6_S3 8 -400 1640 DEPOSIT ABSOLUTE MONOTONY MON_INCREASE /end AXIS_DESCR
/end CHARACTERISTIC
/begin CHARACTERISTIC KF_THKABMTCGSPORT12 "Zeitoffset Ende Haltephase KAB fuer HS" MAP 0x24182C kf_ui8_S6_S3 2000 UMR_MSEC__10_1_M128_S6_S3 -1000 1000
 /begin AXIS_DESCR STD_AXIS zff_atsys._.iSignale._.obj.sig_m_t8 UMR_NM__8_1_M50_S6_S3 8 -400 1640 DEPOSIT ABSOLUTE MONOTONY MON_INCREASE /end AXIS_DESCR
 /begin AXIS_DESCR STD_AXIS zff_atsys._.iSignale._.obj.sig_c_getr UMR_GRADC__1_1_M40_S6_S3 8 -40 150 DEPOSIT ABSOLUTE MONOTONY MON_INCREASE /end AXIS_DESCR
/end CHARACTERISTIC
/begin CHARACTERISTIC KL_POKABCGSPORT12 "Temp. abhängiger Druckoffset auf Schaltdruck KAB fuer HS" CURVE 0x241884 kl_si16_S6_S3 2.5 UMR_BAR__1_1000_0_S6_S3 -1.25 1.25
 /begin AXIS_DESCR STD_AXIS zff_atsys._.iSignale._.obj.sig_c_getr UMR_GRADC__1_1_M40_S6_S3 3 -40 150 DEPOSIT ABSOLUTE MONOTONY MON_INCREASE /end AXIS_DESCR
/end CHARACTERISTIC
/begin CHARACTERISTIC T_VKABHSSPORT23 "Verzögerungszeit abschaltende Kupplung bei HS" VALUE 0x26E728 kw_ui8_S6_S3 2000 UMR_MSEC__10_1_0_S6_S3 0 2000 /end CHARACTERISTIC
/begin CHARACTERISTIC KF_TPKABMTCGSPORT23 "Zeitoffset Ende Rampe auf Schaltdruck KAB fuer HS" MAP 0x241894 kf_ui8_S6_S3 2000 UMR_MSEC__10_1_M128_S6_S3 -1000 1000
 /begin AXIS_DESCR STD_AXIS zff_atsys._.iSignale._.obj.sig_m_t8 UMR_NM__8_1_M50_S6_S3 8 -400 1640 DEPOSIT ABSOLUTE MONOTONY MON_INCREASE /end AXIS_DESCR
 /begin AXIS_DESCR STD_AXIS zff_atsys._.iSignale._.obj.sig_c_getr UMR_GRADC__1_1_M40_S6_S3 8 -40 150 DEPOSIT ABSOLUTE MONOTONY MON_INCREASE /end AXIS_DESCR
/end CHARACTERISTIC
/begin CHARACTERISTIC KL_TOPKABNDSPORT23 "Zeitoffset f(nd_synistgang) Ende Rampe auf Schaltdruck KAB fuer HS" CURVE 0x2418EC kl_si16_S6_S3 1000 UMR_MSEC__10_1_0_S6_S3 0 1000
 /begin AXIS_DESCR STD_AXIS iSasZentr.iSchaltend.nd_synistgang UMR_U_MIN_1_1_0_S6_S3 4 -8000 8000 DEPOSIT ABSOLUTE MONOTONY MON_INCREASE /end AXIS_DESCR
/end CHARACTERISTIC
/begin CHARACTERISTIC KL_PHKABMTSPORT23 "Haltedruck abschaltende Kupplung bei HS" CURVE 0x241900 kl_si16_S6_S3 22 UMR_BAR__1_1000_0_S6_S3 0 22
 /begin AXIS_DESCR STD_AXIS zff_atsys._.iSignale._.obj.sig_m_t UMR_NM__1_1_0_S6_S3 8 -400 1640 DEPOSIT ABSOLUTE MONOTONY MON_INCREASE /end AXIS_DESCR
/end CHARACTERISTIC
/begin CHARACTERISTIC KF_THKABMTCGSPORT23 "Zeitoffset Ende Haltephase KAB fuer HS" MAP 0x241924 kf_ui8_S6_S3 2000 UMR_MSEC__10_1_M128_S6_S3 -1000 1000
 /begin AXIS_DESCR STD_AXIS zff_atsys._.iSignale._.obj.sig_m_t8 UMR_NM__8_1_M50_S6_S3 8 -400 1640 DEPOSIT ABSOLUTE MONOTONY MON_INCREASE /end AXIS_DESCR
 /begin AXIS_DESCR STD_AXIS zff_atsys._.iSignale._.obj.sig_c_getr UMR_GRADC__1_1_M40_S6_S3 8 -40 150 DEPOSIT ABSOLUTE MONOTONY MON_INCREASE /end AXIS_DESCR
/end CHARACTERISTIC
/begin CHARACTERISTIC KL_POKABCGSPORT23 "Temp. abhängiger Druckoffset auf Schaltdruck KAB fuer HS" CURVE 0x24197C kl_si16_S6_S3 2.5 UMR_BAR__1_1000_0_S6_S3 -1.25 1.25
 /begin AXIS_DESCR STD_AXIS zff_atsys._.iSignale._.obj.sig_c_getr UMR_GRADC__1_1_M40_S6_S3 3 -40 150 DEPOSIT ABSOLUTE MONOTONY MON_INCREASE /end AXIS_DESCR
/end CHARACTERISTIC
/begin CHARACTERISTIC T_VKABHSSPORT34 "Verzögerungszeit abschaltende Kupplung bei HS" VALUE 0x26E729 kw_ui8_S6_S3 2000 UMR_MSEC__10_1_0_S6_S3 0 2000 /end CHARACTERISTIC
/begin CHARACTERISTIC KF_TPKABMTCGSPORT34 "Zeitoffset Ende Rampe auf Schaltdruck KAB fuer HS" MAP 0x24198C kf_ui8_S6_S3 2000 UMR_MSEC__10_1_M128_S6_S3 -1000 1000
 /begin AXIS_DESCR STD_AXIS zff_atsys._.iSignale._.obj.sig_m_t8 UMR_NM__8_1_M50_S6_S3 8 -400 1640 DEPOSIT ABSOLUTE MONOTONY MON_INCREASE /end AXIS_DESCR
 /begin AXIS_DESCR STD_AXIS zff_atsys._.iSignale._.obj.sig_c_getr UMR_GRADC__1_1_M40_S6_S3 8 -40 150 DEPOSIT ABSOLUTE MONOTONY MON_INCREASE /end AXIS_DESCR
/end CHARACTERISTIC
/begin CHARACTERISTIC KL_TOPKABNDSPORT34 "Zeitoffset f(nd_synistgang) Ende Rampe auf Schaltdruck KAB fuer HS" CURVE 0x2419E4 kl_si16_S6_S3 1000 UMR_MSEC__10_1_0_S6_S3 0 1000
 /begin AXIS_DESCR STD_AXIS iSasZentr.iSchaltend.nd_synistgang UMR_U_MIN_1_1_0_S6_S3 4 -8000 8000 DEPOSIT ABSOLUTE MONOTONY MON_INCREASE /end AXIS_DESCR
/end CHARACTERISTIC
/begin CHARACTERISTIC KL_PHKABMTSPORT34 "Haltedruck abschaltende Kupplung bei HS" CURVE 0x2419F8 kl_si16_S6_S3 22 UMR_BAR__1_1000_0_S6_S3 0 22
 /begin AXIS_DESCR STD_AXIS zff_atsys._.iSignale._.obj.sig_m_t UMR_NM__1_1_0_S6_S3 8 -400 1640 DEPOSIT ABSOLUTE MONOTONY MON_INCREASE /end AXIS_DESCR
/end CHARACTERISTIC
/begin CHARACTERISTIC KF_THKABMTCGSPORT34 "Zeitoffset Ende Haltephase KAB fuer HS" MAP 0x241A1C kf_ui8_S6_S3 2000 UMR_MSEC__10_1_M128_S6_S3 -1000 1000
 /begin AXIS_DESCR STD_AXIS zff_atsys._.iSignale._.obj.sig_m_t8 UMR_NM__8_1_M50_S6_S3 8 -400 1640 DEPOSIT ABSOLUTE MONOTONY MON_INCREASE /end AXIS_DESCR
 /begin AXIS_DESCR STD_AXIS zff_atsys._.iSignale._.obj.sig_c_getr UMR_GRADC__1_1_M40_S6_S3 8 -40 150 DEPOSIT ABSOLUTE MONOTONY MON_INCREASE /end AXIS_DESCR
/end CHARACTERISTIC
/begin CHARACTERISTIC KL_POKABCGSPORT34 "Temp. abhängiger Druckoffset auf Schaltdruck KAB fuer HS" CURVE 0x241A74 kl_si16_S6_S3 2.5 UMR_BAR__1_1000_0_S6_S3 -1.25 1.25
 /begin AXIS_DESCR STD_AXIS zff_atsys._.iSignale._.obj.sig_c_getr UMR_GRADC__1_1_M40_S6_S3 3 -40 150 DEPOSIT ABSOLUTE MONOTONY MON_INCREASE /end AXIS_DESCR
/end CHARACTERISTIC
/begin CHARACTERISTIC T_VKABHSSPORT45 "Verzögerungszeit abschaltende Kupplung bei HS" VALUE 0x26E72A kw_ui8_S6_S3 2000 UMR_MSEC__10_1_0_S6_S3 0 2000 /end CHARACTERISTIC
/begin CHARACTERISTIC KF_TPKABMTCGSPORT45 "Zeitoffset Ende Rampe auf Schaltdruck KAB fuer HS" MAP 0x241A84 kf_ui8_S6_S3 2000 UMR_MSEC__10_1_M128_S6_S3 -1000 1000
 /begin AXIS_DESCR STD_AXIS zff_atsys._.iSignale._.obj.sig_m_t8 UMR_NM__8_1_M50_S6_S3 8 -400 1640 DEPOSIT ABSOLUTE MONOTONY MON_INCREASE /end AXIS_DESCR
 /begin AXIS_DESCR STD_AXIS zff_atsys._.iSignale._.obj.sig_c_getr UMR_GRADC__1_1_M40_S6_S3 8 -40 150 DEPOSIT ABSOLUTE MONOTONY MON_INCREASE /end AXIS_DESCR
/end CHARACTERISTIC
/begin CHARACTERISTIC KL_TOPKABNDSPORT45 "Zeitoffset f(nd_synistgang) Ende Rampe auf Schaltdruck KAB fuer HS" CURVE 0x241ADC kl_si16_S6_S3 1000 UMR_MSEC__10_1_0_S6_S3 0 1000
 /begin AXIS_DESCR STD_AXIS iSasZentr.iSchaltend.nd_synistgang UMR_U_MIN_1_1_0_S6_S3 4 -8000 8000 DEPOSIT ABSOLUTE MONOTONY MON_INCREASE /end AXIS_DESCR
/end CHARACTERISTIC
/begin CHARACTERISTIC KL_PHKABMTSPORT45 "Haltedruck abschaltende Kupplung bei HS" CURVE 0x241AF0 kl_si16_S6_S3 22 UMR_BAR__1_1000_0_S6_S3 0 22
 /begin AXIS_DESCR STD_AXIS zff_atsys._.iSignale._.obj.sig_m_t UMR_NM__1_1_0_S6_S3 8 -400 1640 DEPOSIT ABSOLUTE MONOTONY MON_INCREASE /end AXIS_DESCR
/end CHARACTERISTIC
/begin CHARACTERISTIC KF_THKABMTCGSPORT45 "Zeitoffset Ende Haltephase KAB fuer HS" MAP 0x241B14 kf_ui8_S6_S3 2000 UMR_MSEC__10_1_M128_S6_S3 -1000 1000
 /begin AXIS_DESCR STD_AXIS zff_atsys._.iSignale._.obj.sig_m_t8 UMR_NM__8_1_M50_S6_S3 8 -400 1640 DEPOSIT ABSOLUTE MONOTONY MON_INCREASE /end AXIS_DESCR
 /begin AXIS_DESCR STD_AXIS zff_atsys._.iSignale._.obj.sig_c_getr UMR_GRADC__1_1_M40_S6_S3 8 -40 150 DEPOSIT ABSOLUTE MONOTONY MON_INCREASE /end AXIS_DESCR
/end CHARACTERISTIC
/begin CHARACTERISTIC KL_POKABCGSPORT45 "Temp. abhängiger Druckoffset auf Schaltdruck KAB fuer HS" CURVE 0x241B6C kl_si16_S6_S3 2.5 UMR_BAR__1_1000_0_S6_S3 -1.25 1.25
 /begin AXIS_DESCR STD_AXIS zff_atsys._.iSignale._.obj.sig_c_getr UMR_GRADC__1_1_M40_S6_S3 3 -40 150 DEPOSIT ABSOLUTE MONOTONY MON_INCREASE /end AXIS_DESCR
/end CHARACTERISTIC
/begin CHARACTERISTIC T_VKABHSSPORT56 "Verzögerungszeit abschaltende Kupplung bei HS" VALUE 0x26E72B kw_ui8_S6_S3 2000 UMR_MSEC__10_1_0_S6_S3 0 2000 /end CHARACTERISTIC
/begin CHARACTERISTIC KF_TPKABMTCGSPORT56 "Zeitoffset Ende Rampe auf Schaltdruck KAB fuer HS" MAP 0x241B7C kf_ui8_S6_S3 2000 UMR_MSEC__10_1_M128_S6_S3 -1000 1000
 /begin AXIS_DESCR STD_AXIS zff_atsys._.iSignale._.obj.sig_m_t8 UMR_NM__8_1_M50_S6_S3 8 -400 1640 DEPOSIT ABSOLUTE MONOTONY MON_INCREASE /end AXIS_DESCR
 /begin AXIS_DESCR STD_AXIS zff_atsys._.iSignale._.obj.sig_c_getr UMR_GRADC__1_1_M40_S6_S3 8 -40 150 DEPOSIT ABSOLUTE MONOTONY MON_INCREASE /end AXIS_DESCR
/end CHARACTERISTIC
/begin CHARACTERISTIC KL_TOPKABNDSPORT56 "Zeitoffset f(nd_synistgang) Ende Rampe auf Schaltdruck KAB fuer HS" CURVE 0x241BD4 kl_si16_S6_S3 1000 UMR_MSEC__10_1_0_S6_S3 0 1000
 /begin AXIS_DESCR STD_AXIS iSasZentr.iSchaltend.nd_synistgang UMR_U_MIN_1_1_0_S6_S3 4 -8000 8000 DEPOSIT ABSOLUTE MONOTONY MON_INCREASE /end AXIS_DESCR
/end CHARACTERISTIC
/begin CHARACTERISTIC KL_PHKABMTSPORT56 "Haltedruck abschaltende Kupplung bei HS" CURVE 0x241BE8 kl_si16_S6_S3 22 UMR_BAR__1_1000_0_S6_S3 0 22
 /begin AXIS_DESCR STD_AXIS zff_atsys._.iSignale._.obj.sig_m_t UMR_NM__1_1_0_S6_S3 8 -400 1640 DEPOSIT ABSOLUTE MONOTONY MON_INCREASE /end AXIS_DESCR
/end CHARACTERISTIC
/begin CHARACTERISTIC KF_THKABMTCGSPORT56 "Zeitoffset Ende Haltephase KAB fuer HS" MAP 0x241C0C kf_ui8_S6_S3 2000 UMR_MSEC__10_1_M128_S6_S3 -1000 1000
 /begin AXIS_DESCR STD_AXIS zff_atsys._.iSignale._.obj.sig_m_t8 UMR_NM__8_1_M50_S6_S3 8 -400 1640 DEPOSIT ABSOLUTE MONOTONY MON_INCREASE /end AXIS_DESCR
 /begin AXIS_DESCR STD_AXIS zff_atsys._.iSignale._.obj.sig_c_getr UMR_GRADC__1_1_M40_S6_S3 8 -40 150 DEPOSIT ABSOLUTE MONOTONY MON_INCREASE /end AXIS_DESCR
/end CHARACTERISTIC
/begin CHARACTERISTIC KL_POKABCGSPORT56 "Temp. abhängiger Druckoffset auf Schaltdruck KAB fuer HS" CURVE 0x241C64 kl_si16_S6_S3 2.5 UMR_BAR__1_1000_0_S6_S3 -1.25 1.25
 /begin AXIS_DESCR STD_AXIS zff_atsys._.iSignale._.obj.sig_c_getr UMR_GRADC__1_1_M40_S6_S3 3 -40 150 DEPOSIT ABSOLUTE MONOTONY MON_INCREASE /end AXIS_DESCR
/end CHARACTERISTIC
/begin CHARACTERISTIC T_VKABHSSPORT67 "Verzögerungszeit abschaltende Kupplung bei HS" VALUE 0x26E72C kw_ui8_S6_S3 2000 UMR_MSEC__10_1_0_S6_S3 0 2000 /end CHARACTERISTIC
/begin CHARACTERISTIC KF_TPKABMTCGSPORT67 "Zeitoffset Ende Rampe auf Schaltdruck KAB fuer HS" MAP 0x241C74 kf_ui8_S6_S3 2000 UMR_MSEC__10_1_M128_S6_S3 -1000 1000
 /begin AXIS_DESCR STD_AXIS zff_atsys._.iSignale._.obj.sig_m_t8 UMR_NM__8_1_M50_S6_S3 8 -400 1640 DEPOSIT ABSOLUTE MONOTONY MON_INCREASE /end AXIS_DESCR
 /begin AXIS_DESCR STD_AXIS zff_atsys._.iSignale._.obj.sig_c_getr UMR_GRADC__1_1_M40_S6_S3 8 -40 150 DEPOSIT ABSOLUTE MONOTONY MON_INCREASE /end AXIS_DESCR
/end CHARACTERISTIC
/begin CHARACTERISTIC KL_TOPKABNDSPORT67 "Zeitoffset f(nd_synistgang) Ende Rampe auf Schaltdruck KAB fuer HS" CURVE 0x241CCC kl_si16_S6_S3 1000 UMR_MSEC__10_1_0_S6_S3 0 1000
 /begin AXIS_DESCR STD_AXIS iSasZentr.iSchaltend.nd_synistgang UMR_U_MIN_1_1_0_S6_S3 4 -8000 8000 DEPOSIT ABSOLUTE MONOTONY MON_INCREASE /end AXIS_DESCR
/end CHARACTERISTIC
/begin CHARACTERISTIC KL_PHKABMTSPORT67 "Haltedruck abschaltende Kupplung bei HS" CURVE 0x241CE0 kl_si16_S6_S3 22 UMR_BAR__1_1000_0_S6_S3 0 22
 /begin AXIS_DESCR STD_AXIS zff_atsys._.iSignale._.obj.sig_m_t UMR_NM__1_1_0_S6_S3 8 -400 1640 DEPOSIT ABSOLUTE MONOTONY MON_INCREASE /end AXIS_DESCR
/end CHARACTERISTIC
/begin CHARACTERISTIC KF_THKABMTCGSPORT67 "Zeitoffset Ende Haltephase KAB fuer HS" MAP 0x241D04 kf_ui8_S6_S3 2000 UMR_MSEC__10_1_M128_S6_S3 -1000 1000
 /begin AXIS_DESCR STD_AXIS zff_atsys._.iSignale._.obj.sig_m_t8 UMR_NM__8_1_M50_S6_S3 8 -400 1640 DEPOSIT ABSOLUTE MONOTONY MON_INCREASE /end AXIS_DESCR
 /begin AXIS_DESCR STD_AXIS zff_atsys._.iSignale._.obj.sig_c_getr UMR_GRADC__1_1_M40_S6_S3 8 -40 150 DEPOSIT ABSOLUTE MONOTONY MON_INCREASE /end AXIS_DESCR
/end CHARACTERISTIC
/begin CHARACTERISTIC KL_POKABCGSPORT67 "Temp. abhängiger Druckoffset auf Schaltdruck KAB fuer HS" CURVE 0x241D5C kl_si16_S6_S3 2.5 UMR_BAR__1_1000_0_S6_S3 -1.25 1.25
 /begin AXIS_DESCR STD_AXIS zff_atsys._.iSignale._.obj.sig_c_getr UMR_GRADC__1_1_M40_S6_S3 3 -40 150 DEPOSIT ABSOLUTE MONOTONY MON_INCREASE /end AXIS_DESCR
/end CHARACTERISTIC
/begin CHARACTERISTIC T_VKABHSSPORT78 "Verzögerungszeit abschaltende Kupplung bei HS" VALUE 0x26E72D kw_ui8_S6_S3 2000 UMR_MSEC__10_1_0_S6_S3 0 2000 /end CHARACTERISTIC
/begin CHARACTERISTIC KF_TPKABMTCGSPORT78 "Zeitoffset Ende Rampe auf Schaltdruck KAB fuer HS" MAP 0x241D6C kf_ui8_S6_S3 2000 UMR_MSEC__10_1_M128_S6_S3 -1000 1000
 /begin AXIS_DESCR STD_AXIS zff_atsys._.iSignale._.obj.sig_m_t8 UMR_NM__8_1_M50_S6_S3 8 -400 1640 DEPOSIT ABSOLUTE MONOTONY MON_INCREASE /end AXIS_DESCR
 /begin AXIS_DESCR STD_AXIS zff_atsys._.iSignale._.obj.sig_c_getr UMR_GRADC__1_1_M40_S6_S3 8 -40 150 DEPOSIT ABSOLUTE MONOTONY MON_INCREASE /end AXIS_DESCR
/end CHARACTERISTIC
/begin CHARACTERISTIC KL_TOPKABNDSPORT78 "Zeitoffset f(nd_synistgang) Ende Rampe auf Schaltdruck KAB fuer HS" CURVE 0x241DC4 kl_si16_S6_S3 1000 UMR_MSEC__10_1_0_S6_S3 0 1000
 /begin AXIS_DESCR STD_AXIS iSasZentr.iSchaltend.nd_synistgang UMR_U_MIN_1_1_0_S6_S3 4 -8000 8000 DEPOSIT ABSOLUTE MONOTONY MON_INCREASE /end AXIS_DESCR
/end CHARACTERISTIC
/begin CHARACTERISTIC KL_PHKABMTSPORT78 "Haltedruck abschaltende Kupplung bei HS" CURVE 0x241DD8 kl_si16_S6_S3 22 UMR_BAR__1_1000_0_S6_S3 0 22
 /begin AXIS_DESCR STD_AXIS zff_atsys._.iSignale._.obj.sig_m_t UMR_NM__1_1_0_S6_S3 8 -400 1640 DEPOSIT ABSOLUTE MONOTONY MON_INCREASE /end AXIS_DESCR
/end CHARACTERISTIC
/begin CHARACTERISTIC KF_THKABMTCGSPORT78 "Zeitoffset Ende Haltephase KAB fuer HS" MAP 0x241DFC kf_ui8_S6_S3 2000 UMR_MSEC__10_1_M128_S6_S3 -1000 1000
 /begin AXIS_DESCR STD_AXIS zff_atsys._.iSignale._.obj.sig_m_t8 UMR_NM__8_1_M50_S6_S3 8 -400 1640 DEPOSIT ABSOLUTE MONOTONY MON_INCREASE /end AXIS_DESCR
 /begin AXIS_DESCR STD_AXIS zff_atsys._.iSignale._.obj.sig_c_getr UMR_GRADC__1_1_M40_S6_S3 8 -40 150 DEPOSIT ABSOLUTE MONOTONY MON_INCREASE /end AXIS_DESCR
/end CHARACTERISTIC
/begin CHARACTERISTIC KL_POKABCGSPORT78 "Temp. abhängiger Druckoffset auf Schaltdruck KAB fuer HS" CURVE 0x241E54 kl_si16_S6_S3 2.5 UMR_BAR__1_1000_0_S6_S3 -1.25 1.25
 /begin AXIS_DESCR STD_AXIS zff_atsys._.iSignale._.obj.sig_c_getr UMR_GRADC__1_1_M40_S6_S3 3 -40 150 DEPOSIT ABSOLUTE MONOTONY MON_INCREASE /end AXIS_DESCR
/end CHARACTERISTIC
/begin CHARACTERISTIC T_VKABHSSPORT13 "Verzögerungszeit abschaltende Kupplung bei HS" VALUE 0x26E72E kw_ui8_S6_S3 2000 UMR_MSEC__10_1_0_S6_S3 0 2000 /end CHARACTERISTIC
/begin CHARACTERISTIC KF_TPKABMTCGSPORT13 "Zeitoffset Ende Rampe auf Schaltdruck KAB fuer HS" MAP 0x241E64 kf_ui8_S6_S3 2000 UMR_MSEC__10_1_M128_S6_S3 -1000 1000
 /begin AXIS_DESCR STD_AXIS zff_atsys._.iSignale._.obj.sig_m_t8 UMR_NM__8_1_M50_S6_S3 8 -400 1640 DEPOSIT ABSOLUTE MONOTONY MON_INCREASE /end AXIS_DESCR
 /begin AXIS_DESCR STD_AXIS zff_atsys._.iSignale._.obj.sig_c_getr UMR_GRADC__1_1_M40_S6_S3 8 -40 150 DEPOSIT ABSOLUTE MONOTONY MON_INCREASE /end AXIS_DESCR
/end CHARACTERISTIC
/begin CHARACTERISTIC KL_TOPKABNDSPORT13 "Zeitoffset f(nd_synistgang) Ende Rampe auf Schaltdruck KAB fuer HS" CURVE 0x241EBC kl_si16_S6_S3 1000 UMR_MSEC__10_1_0_S6_S3 0 1000
 /begin AXIS_DESCR STD_AXIS iSasZentr.iSchaltend.nd_synistgang UMR_U_MIN_1_1_0_S6_S3 4 -8000 8000 DEPOSIT ABSOLUTE MONOTONY MON_INCREASE /end AXIS_DESCR
/end CHARACTERISTIC
/begin CHARACTERISTIC KL_PHKABMTSPORT13 "Haltedruck abschaltende Kupplung bei HS" CURVE 0x241ED0 kl_si16_S6_S3 22 UMR_BAR__1_1000_0_S6_S3 0 22
 /begin AXIS_DESCR STD_AXIS zff_atsys._.iSignale._.obj.sig_m_t UMR_NM__1_1_0_S6_S3 8 -400 1640 DEPOSIT ABSOLUTE MONOTONY MON_INCREASE /end AXIS_DESCR
/end CHARACTERISTIC
/begin CHARACTERISTIC KF_THKABMTCGSPORT13 "Zeitoffset Ende Haltephase KAB fuer HS" MAP 0x241EF4 kf_ui8_S6_S3 2000 UMR_MSEC__10_1_M128_S6_S3 -1000 1000
 /begin AXIS_DESCR STD_AXIS zff_atsys._.iSignale._.obj.sig_m_t8 UMR_NM__8_1_M50_S6_S3 8 -400 1640 DEPOSIT ABSOLUTE MONOTONY MON_INCREASE /end AXIS_DESCR
 /begin AXIS_DESCR STD_AXIS zff_atsys._.iSignale._.obj.sig_c_getr UMR_GRADC__1_1_M40_S6_S3 8 -40 150 DEPOSIT ABSOLUTE MONOTONY MON_INCREASE /end AXIS_DESCR
/end CHARACTERISTIC
/begin CHARACTERISTIC KL_POKABCGSPORT13 "Temp. abhängiger Druckoffset auf Schaltdruck KAB fuer HS" CURVE 0x241F4C kl_si16_S6_S3 2.5 UMR_BAR__1_1000_0_S6_S3 -1.25 1.25
 /begin AXIS_DESCR STD_AXIS zff_atsys._.iSignale._.obj.sig_c_getr UMR_GRADC__1_1_M40_S6_S3 3 -40 150 DEPOSIT ABSOLUTE MONOTONY MON_INCREASE /end AXIS_DESCR
/end CHARACTERISTIC
/begin CHARACTERISTIC T_VKABHSSPORT24 "Verzögerungszeit abschaltende Kupplung bei HS" VALUE 0x26E72F kw_ui8_S6_S3 2000 UMR_MSEC__10_1_0_S6_S3 0 2000 /end CHARACTERISTIC
/begin CHARACTERISTIC KF_TPKABMTCGSPORT24 "Zeitoffset Ende Rampe auf Schaltdruck KAB fuer HS" MAP 0x241F5C kf_ui8_S6_S3 2000 UMR_MSEC__10_1_M128_S6_S3 -1000 1000
 /begin AXIS_DESCR STD_AXIS zff_atsys._.iSignale._.obj.sig_m_t8 UMR_NM__8_1_M50_S6_S3 8 -400 1640 DEPOSIT ABSOLUTE MONOTONY MON_INCREASE /end AXIS_DESCR
 /begin AXIS_DESCR STD_AXIS zff_atsys._.iSignale._.obj.sig_c_getr UMR_GRADC__1_1_M40_S6_S3 8 -40 150 DEPOSIT ABSOLUTE MONOTONY MON_INCREASE /end AXIS_DESCR
/end CHARACTERISTIC
/begin CHARACTERISTIC KL_TOPKABNDSPORT24 "Zeitoffset f(nd_synistgang) Ende Rampe auf Schaltdruck KAB fuer HS" CURVE 0x241FB4 kl_si16_S6_S3 1000 UMR_MSEC__10_1_0_S6_S3 0 1000
 /begin AXIS_DESCR STD_AXIS iSasZentr.iSchaltend.nd_synistgang UMR_U_MIN_1_1_0_S6_S3 4 -8000 8000 DEPOSIT ABSOLUTE MONOTONY MON_INCREASE /end AXIS_DESCR
/end CHARACTERISTIC
/begin CHARACTERISTIC KL_PHKABMTSPORT24 "Haltedruck abschaltende Kupplung bei HS" CURVE 0x241FC8 kl_si16_S6_S3 22 UMR_BAR__1_1000_0_S6_S3 0 22
 /begin AXIS_DESCR STD_AXIS zff_atsys._.iSignale._.obj.sig_m_t UMR_NM__1_1_0_S6_S3 8 -400 1640 DEPOSIT ABSOLUTE MONOTONY MON_INCREASE /end AXIS_DESCR
/end CHARACTERISTIC
/begin CHARACTERISTIC KF_THKABMTCGSPORT24 "Zeitoffset Ende Haltephase KAB fuer HS" MAP 0x241FEC kf_ui8_S6_S3 2000 UMR_MSEC__10_1_M128_S6_S3 -1000 1000
 /begin AXIS_DESCR STD_AXIS zff_atsys._.iSignale._.obj.sig_m_t8 UMR_NM__8_1_M50_S6_S3 8 -400 1640 DEPOSIT ABSOLUTE MONOTONY MON_INCREASE /end AXIS_DESCR
 /begin AXIS_DESCR STD_AXIS zff_atsys._.iSignale._.obj.sig_c_getr UMR_GRADC__1_1_M40_S6_S3 8 -40 150 DEPOSIT ABSOLUTE MONOTONY MON_INCREASE /end AXIS_DESCR
/end CHARACTERISTIC
/begin CHARACTERISTIC KL_POKABCGSPORT24 "Temp. abhängiger Druckoffset auf Schaltdruck KAB fuer HS" CURVE 0x242044 kl_si16_S6_S3 2.5 UMR_BAR__1_1000_0_S6_S3 -1.25 1.25
 /begin AXIS_DESCR STD_AXIS zff_atsys._.iSignale._.obj.sig_c_getr UMR_GRADC__1_1_M40_S6_S3 3 -40 150 DEPOSIT ABSOLUTE MONOTONY MON_INCREASE /end AXIS_DESCR
/end CHARACTERISTIC
/begin CHARACTERISTIC T_VKABHSSPORT35 "Verzögerungszeit abschaltende Kupplung bei HS" VALUE 0x26E730 kw_ui8_S6_S3 2000 UMR_MSEC__10_1_0_S6_S3 0 2000 /end CHARACTERISTIC
/begin CHARACTERISTIC KF_TPKABMTCGSPORT35 "Zeitoffset Ende Rampe auf Schaltdruck KAB fuer HS" MAP 0x242054 kf_ui8_S6_S3 2000 UMR_MSEC__10_1_M128_S6_S3 -1000 1000
 /begin AXIS_DESCR STD_AXIS zff_atsys._.iSignale._.obj.sig_m_t8 UMR_NM__8_1_M50_S6_S3 8 -400 1640 DEPOSIT ABSOLUTE MONOTONY MON_INCREASE /end AXIS_DESCR
 /begin AXIS_DESCR STD_AXIS zff_atsys._.iSignale._.obj.sig_c_getr UMR_GRADC__1_1_M40_S6_S3 8 -40 150 DEPOSIT ABSOLUTE MONOTONY MON_INCREASE /end AXIS_DESCR
/end CHARACTERISTIC
/begin CHARACTERISTIC KL_TOPKABNDSPORT35 "Zeitoffset f(nd_synistgang) Ende Rampe auf Schaltdruck KAB fuer HS" CURVE 0x2420AC kl_si16_S6_S3 1000 UMR_MSEC__10_1_0_S6_S3 0 1000
 /begin AXIS_DESCR STD_AXIS iSasZentr.iSchaltend.nd_synistgang UMR_U_MIN_1_1_0_S6_S3 4 -8000 8000 DEPOSIT ABSOLUTE MONOTONY MON_INCREASE /end AXIS_DESCR
/end CHARACTERISTIC
/begin CHARACTERISTIC KL_PHKABMTSPORT35 "Haltedruck abschaltende Kupplung bei HS" CURVE 0x2420C0 kl_si16_S6_S3 22 UMR_BAR__1_1000_0_S6_S3 0 22
 /begin AXIS_DESCR STD_AXIS zff_atsys._.iSignale._.obj.sig_m_t UMR_NM__1_1_0_S6_S3 8 -400 1640 DEPOSIT ABSOLUTE MONOTONY MON_INCREASE /end AXIS_DESCR
/end CHARACTERISTIC
/begin CHARACTERISTIC KF_THKABMTCGSPORT35 "Zeitoffset Ende Haltephase KAB fuer HS" MAP 0x2420E4 kf_ui8_S6_S3 2000 UMR_MSEC__10_1_M128_S6_S3 -1000 1000
 /begin AXIS_DESCR STD_AXIS zff_atsys._.iSignale._.obj.sig_m_t8 UMR_NM__8_1_M50_S6_S3 8 -400 1640 DEPOSIT ABSOLUTE MONOTONY MON_INCREASE /end AXIS_DESCR
 /begin AXIS_DESCR STD_AXIS zff_atsys._.iSignale._.obj.sig_c_getr UMR_GRADC__1_1_M40_S6_S3 8 -40 150 DEPOSIT ABSOLUTE MONOTONY MON_INCREASE /end AXIS_DESCR
/end CHARACTERISTIC
/begin CHARACTERISTIC KL_POKABCGSPORT35 "Temp. abhängiger Druckoffset auf Schaltdruck KAB fuer HS" CURVE 0x24213C kl_si16_S6_S3 2.5 UMR_BAR__1_1000_0_S6_S3 -1.25 1.25
 /begin AXIS_DESCR STD_AXIS zff_atsys._.iSignale._.obj.sig_c_getr UMR_GRADC__1_1_M40_S6_S3 3 -40 150 DEPOSIT ABSOLUTE MONOTONY MON_INCREASE /end AXIS_DESCR
/end CHARACTERISTIC
/begin CHARACTERISTIC T_VKABHSSPORT46 "Verzögerungszeit abschaltende Kupplung bei HS" VALUE 0x26E731 kw_ui8_S6_S3 2000 UMR_MSEC__10_1_0_S6_S3 0 2000 /end CHARACTERISTIC
/begin CHARACTERISTIC KF_TPKABMTCGSPORT46 "Zeitoffset Ende Rampe auf Schaltdruck KAB fuer HS" MAP 0x24214C kf_ui8_S6_S3 2000 UMR_MSEC__10_1_M128_S6_S3 -1000 1000
 /begin AXIS_DESCR STD_AXIS zff_atsys._.iSignale._.obj.sig_m_t8 UMR_NM__8_1_M50_S6_S3 8 -400 1640 DEPOSIT ABSOLUTE MONOTONY MON_INCREASE /end AXIS_DESCR
 /begin AXIS_DESCR STD_AXIS zff_atsys._.iSignale._.obj.sig_c_getr UMR_GRADC__1_1_M40_S6_S3 8 -40 150 DEPOSIT ABSOLUTE MONOTONY MON_INCREASE /end AXIS_DESCR
/end CHARACTERISTIC
/begin CHARACTERISTIC KL_TOPKABNDSPORT46 "Zeitoffset f(nd_synistgang) Ende Rampe auf Schaltdruck KAB fuer HS" CURVE 0x2421A4 kl_si16_S6_S3 1000 UMR_MSEC__10_1_0_S6_S3 0 1000
 /begin AXIS_DESCR STD_AXIS iSasZentr.iSchaltend.nd_synistgang UMR_U_MIN_1_1_0_S6_S3 4 -8000 8000 DEPOSIT ABSOLUTE MONOTONY MON_INCREASE /end AXIS_DESCR
/end CHARACTERISTIC
/begin CHARACTERISTIC KL_PHKABMTSPORT46 "Haltedruck abschaltende Kupplung bei HS" CURVE 0x2421B8 kl_si16_S6_S3 22 UMR_BAR__1_1000_0_S6_S3 0 22
 /begin AXIS_DESCR STD_AXIS zff_atsys._.iSignale._.obj.sig_m_t UMR_NM__1_1_0_S6_S3 8 -400 1640 DEPOSIT ABSOLUTE MONOTONY MON_INCREASE /end AXIS_DESCR
/end CHARACTERISTIC
/begin CHARACTERISTIC KF_THKABMTCGSPORT46 "Zeitoffset Ende Haltephase KAB fuer HS" MAP 0x2421DC kf_ui8_S6_S3 2000 UMR_MSEC__10_1_M128_S6_S3 -1000 1000
 /begin AXIS_DESCR STD_AXIS zff_atsys._.iSignale._.obj.sig_m_t8 UMR_NM__8_1_M50_S6_S3 8 -400 1640 DEPOSIT ABSOLUTE MONOTONY MON_INCREASE /end AXIS_DESCR
 /begin AXIS_DESCR STD_AXIS zff_atsys._.iSignale._.obj.sig_c_getr UMR_GRADC__1_1_M40_S6_S3 8 -40 150 DEPOSIT ABSOLUTE MONOTONY MON_INCREASE /end AXIS_DESCR
/end CHARACTERISTIC
/begin CHARACTERISTIC KL_POKABCGSPORT46 "Temp. abhängiger Druckoffset auf Schaltdruck KAB fuer HS" CURVE 0x242234 kl_si16_S6_S3 2.5 UMR_BAR__1_1000_0_S6_S3 -1.25 1.25
 /begin AXIS_DESCR STD_AXIS zff_atsys._.iSignale._.obj.sig_c_getr UMR_GRADC__1_1_M40_S6_S3 3 -40 150 DEPOSIT ABSOLUTE MONOTONY MON_INCREASE /end AXIS_DESCR
/end CHARACTERISTIC
/begin CHARACTERISTIC T_VKABHSSPORT57 "Verzögerungszeit abschaltende Kupplung bei HS" VALUE 0x26E732 kw_ui8_S6_S3 2000 UMR_MSEC__10_1_0_S6_S3 0 2000 /end CHARACTERISTIC
/begin CHARACTERISTIC KF_TPKABMTCGSPORT57 "Zeitoffset Ende Rampe auf Schaltdruck KAB fuer HS" MAP 0x242244 kf_ui8_S6_S3 2000 UMR_MSEC__10_1_M128_S6_S3 -1000 1000
 /begin AXIS_DESCR STD_AXIS zff_atsys._.iSignale._.obj.sig_m_t8 UMR_NM__8_1_M50_S6_S3 8 -400 1640 DEPOSIT ABSOLUTE MONOTONY MON_INCREASE /end AXIS_DESCR
 /begin AXIS_DESCR STD_AXIS zff_atsys._.iSignale._.obj.sig_c_getr UMR_GRADC__1_1_M40_S6_S3 8 -40 150 DEPOSIT ABSOLUTE MONOTONY MON_INCREASE /end AXIS_DESCR
/end CHARACTERISTIC
/begin CHARACTERISTIC KL_TOPKABNDSPORT57 "Zeitoffset f(nd_synistgang) Ende Rampe auf Schaltdruck KAB fuer HS" CURVE 0x24229C kl_si16_S6_S3 1000 UMR_MSEC__10_1_0_S6_S3 0 1000
 /begin AXIS_DESCR STD_AXIS iSasZentr.iSchaltend.nd_synistgang UMR_U_MIN_1_1_0_S6_S3 4 -8000 8000 DEPOSIT ABSOLUTE MONOTONY MON_INCREASE /end AXIS_DESCR
/end CHARACTERISTIC
/begin CHARACTERISTIC KL_PHKABMTSPORT57 "Haltedruck abschaltende Kupplung bei HS" CURVE 0x2422B0 kl_si16_S6_S3 22 UMR_BAR__1_1000_0_S6_S3 0 22
 /begin AXIS_DESCR STD_AXIS zff_atsys._.iSignale._.obj.sig_m_t UMR_NM__1_1_0_S6_S3 8 -400 1640 DEPOSIT ABSOLUTE MONOTONY MON_INCREASE /end AXIS_DESCR
/end CHARACTERISTIC
/begin CHARACTERISTIC KF_THKABMTCGSPORT57 "Zeitoffset Ende Haltephase KAB fuer HS" MAP 0x2422D4 kf_ui8_S6_S3 2000 UMR_MSEC__10_1_M128_S6_S3 -1000 1000
 /begin AXIS_DESCR STD_AXIS zff_atsys._.iSignale._.obj.sig_m_t8 UMR_NM__8_1_M50_S6_S3 8 -400 1640 DEPOSIT ABSOLUTE MONOTONY MON_INCREASE /end AXIS_DESCR
 /begin AXIS_DESCR STD_AXIS zff_atsys._.iSignale._.obj.sig_c_getr UMR_GRADC__1_1_M40_S6_S3 8 -40 150 DEPOSIT ABSOLUTE MONOTONY MON_INCREASE /end AXIS_DESCR
/end CHARACTERISTIC
/begin CHARACTERISTIC KL_POKABCGSPORT57 "Temp. abhängiger Druckoffset auf Schaltdruck KAB fuer HS" CURVE 0x24232C kl_si16_S6_S3 2.5 UMR_BAR__1_1000_0_S6_S3 -1.25 1.25
 /begin AXIS_DESCR STD_AXIS zff_atsys._.iSignale._.obj.sig_c_getr UMR_GRADC__1_1_M40_S6_S3 3 -40 150 DEPOSIT ABSOLUTE MONOTONY MON_INCREASE /end AXIS_DESCR
/end CHARACTERISTIC
/begin CHARACTERISTIC T_VKABHSSPORT68 "Verzögerungszeit abschaltende Kupplung bei HS" VALUE 0x26E733 kw_ui8_S6_S3 2000 UMR_MSEC__10_1_0_S6_S3 0 2000 /end CHARACTERISTIC
/begin CHARACTERISTIC KF_TPKABMTCGSPORT68 "Zeitoffset Ende Rampe auf Schaltdruck KAB fuer HS" MAP 0x24233C kf_ui8_S6_S3 2000 UMR_MSEC__10_1_M128_S6_S3 -1000 1000
 /begin AXIS_DESCR STD_AXIS zff_atsys._.iSignale._.obj.sig_m_t8 UMR_NM__8_1_M50_S6_S3 8 -400 1640 DEPOSIT ABSOLUTE MONOTONY MON_INCREASE /end AXIS_DESCR
 /begin AXIS_DESCR STD_AXIS zff_atsys._.iSignale._.obj.sig_c_getr UMR_GRADC__1_1_M40_S6_S3 8 -40 150 DEPOSIT ABSOLUTE MONOTONY MON_INCREASE /end AXIS_DESCR
/end CHARACTERISTIC
/begin CHARACTERISTIC KL_TOPKABNDSPORT68 "Zeitoffset f(nd_synistgang) Ende Rampe auf Schaltdruck KAB fuer HS" CURVE 0x242394 kl_si16_S6_S3 1000 UMR_MSEC__10_1_0_S6_S3 0 1000
 /begin AXIS_DESCR STD_AXIS iSasZentr.iSchaltend.nd_synistgang UMR_U_MIN_1_1_0_S6_S3 4 -8000 8000 DEPOSIT ABSOLUTE MONOTONY MON_INCREASE /end AXIS_DESCR
/end CHARACTERISTIC
/begin CHARACTERISTIC KL_PHKABMTSPORT68 "Haltedruck abschaltende Kupplung bei HS" CURVE 0x2423A8 kl_si16_S6_S3 22 UMR_BAR__1_1000_0_S6_S3 0 22
 /begin AXIS_DESCR STD_AXIS zff_atsys._.iSignale._.obj.sig_m_t UMR_NM__1_1_0_S6_S3 8 -400 1640 DEPOSIT ABSOLUTE MONOTONY MON_INCREASE /end AXIS_DESCR
/end CHARACTERISTIC
/begin CHARACTERISTIC KF_THKABMTCGSPORT68 "Zeitoffset Ende Haltephase KAB fuer HS" MAP 0x2423CC kf_ui8_S6_S3 2000 UMR_MSEC__10_1_M128_S6_S3 -1000 1000
 /begin AXIS_DESCR STD_AXIS zff_atsys._.iSignale._.obj.sig_m_t8 UMR_NM__8_1_M50_S6_S3 8 -400 1640 DEPOSIT ABSOLUTE MONOTONY MON_INCREASE /end AXIS_DESCR
 /begin AXIS_DESCR STD_AXIS zff_atsys._.iSignale._.obj.sig_c_getr UMR_GRADC__1_1_M40_S6_S3 8 -40 150 DEPOSIT ABSOLUTE MONOTONY MON_INCREASE /end AXIS_DESCR
/end CHARACTERISTIC
/begin CHARACTERISTIC KL_POKABCGSPORT68 "Temp. abhängiger Druckoffset auf Schaltdruck KAB fuer HS" CURVE 0x242424 kl_si16_S6_S3 2.5 UMR_BAR__1_1000_0_S6_S3 -1.25 1.25
 /begin AXIS_DESCR STD_AXIS zff_atsys._.iSignale._.obj.sig_c_getr UMR_GRADC__1_1_M40_S6_S3 3 -40 150 DEPOSIT ABSOLUTE MONOTONY MON_INCREASE /end AXIS_DESCR
/end CHARACTERISTIC
/begin CHARACTERISTIC TO_VKZUSLST12 "Zeitoffset auf Verzögerung Schnellfüllung bei Schleppstart" VALUE 0x26E8D1 kw_ui8_S6_S3 90 UMR_MSEC__10_1_0_S6_S3 10 100 /end CHARACTERISTIC
/begin CHARACTERISTIC KL_POKZUNGAB12 "Druckoffset in Abhaengigkeit von ng_ab" CURVE 0x2577A4 kl_si16_S6_S3 12.75 UMR_BAR__1_1000_0_S6_S3 -6.4 6.35
 /begin AXIS_DESCR STD_AXIS iItfInput.ng_ab UMR_U_MINSEC_1_1_0_S6_S3 4 -5000 1000 DEPOSIT ABSOLUTE MONOTONY MON_INCREASE /end AXIS_DESCR
/end CHARACTERISTIC
/begin CHARACTERISTIC KL_PGOFMT12 "Gradient Druckoffset Fuellphase" CURVE 0x2577B8 kl_si16_S6_S3 200 UMR_BAR_SEC_1_10_0_S6_S3 -100 100
 /begin AXIS_DESCR STD_AXIS zff_atsys._.iSignale._.obj.sig_m_t UMR_NM__1_1_0_S6_S3 4 -400 1640 DEPOSIT ABSOLUTE MONOTONY MON_INCREASE /end AXIS_DESCR
/end CHARACTERISTIC
/begin CHARACTERISTIC KL_POFMDMOTSOLL12 "Fuelldruckoffset f(Erhoehung Motorsollmoment)" CURVE 0x2577CC kl_si16_S6_S3 12.75 UMR_BAR__1_1000_0_S6_S3 -6.4 6.35
 /begin AXIS_DESCR STD_AXIS NO_INPUT_QUANTITY UMR_NM__1_1_0_S6_S3 6 -2000 2000 DEPOSIT ABSOLUTE MONOTONY MON_INCREASE /end AXIS_DESCR
/end CHARACTERISTIC
/begin CHARACTERISTIC KL_POFMDMOTSOLL12_EL "Fuelldruckoffset f(Erhoehung Motorsollmoment)" CURVE 0x2577E8 kl_si16_S6_S3 12.75 UMR_BAR__1_1000_0_S6_S3 -6.4 6.35
 /begin AXIS_DESCR STD_AXIS NO_INPUT_QUANTITY UMR_NM__1_1_0_S6_S3 6 -2000 2000 DEPOSIT ABSOLUTE MONOTONY MON_INCREASE /end AXIS_DESCR
/end CHARACTERISTIC
/begin CHARACTERISTIC KL_FTRACG12 "Faktor auf Zeit für Rampe auf Schaltdruck" CURVE 0x257804 kl_ui8_S6_S3 1 UMR_PROZENT__1_100_0_S6_S3 1 2
 /begin AXIS_DESCR STD_AXIS zff_atsys._.iSignale._.obj.sig_c_getr UMR_GRADC__1_1_M40_S6_S3 4 -40 150 DEPOSIT ABSOLUTE MONOTONY MON_INCREASE /end AXIS_DESCR
/end CHARACTERISTIC
/begin CHARACTERISTIC T_RA2SSCHR12 "Zeit 2.Rampe bei Schrittschaltung" VALUE 0x26E8D2 kw_ui8_S6_S3 2540 UMR_MSEC__10_1_0_S6_S3 0 2540 /end CHARACTERISTIC
/begin CHARACTERISTIC T_SYN12 "Verweilzeit in Synchron zum Start Max.Rampe" VALUE 0x26E8D3 kw_ui8_S6_S3 2540 UMR_MSEC__10_1_0_S6_S3 0 2540 /end CHARACTERISTIC
/begin CHARACTERISTIC T_KORHSZEIT12 "Korrekturwert fur Schaltverzugberechnung" VALUE 0x26E8D4 kw_ui8_S6_S3 2000 UMR_MSEC__10_1_M128_S6_S3 -1000 1000 /end CHARACTERISTIC
/begin CHARACTERISTIC KF_POFMTCG12 "Fülldruckoffset" MAP 0x257810 kf_si16_S6_S3 12.75 UMR_BAR__1_1000_0_S6_S3 -6.4 6.35
 /begin AXIS_DESCR STD_AXIS zff_atsys._.iSignale._.obj.sig_m_t UMR_NM__1_1_0_S6_S3 2 -400 1640 DEPOSIT ABSOLUTE MONOTONY MON_INCREASE /end AXIS_DESCR
 /begin AXIS_DESCR STD_AXIS zff_atsys._.iSignale._.obj.sig_c_getr UMR_GRADC__1_1_M40_S6_S3 10 -40 150 DEPOSIT ABSOLUTE MONOTONY MON_INCREASE /end AXIS_DESCR
/end CHARACTERISTIC
/begin CHARACTERISTIC KF_POFMTCG12_EL "Fülldruckoffset" MAP 0x257858 kf_si16_S6_S3 12.75 UMR_BAR__1_1000_0_S6_S3 -6.4 6.35
 /begin AXIS_DESCR STD_AXIS zff_atsys._.iSignale._.obj.sig_m_t UMR_NM__1_1_0_S6_S3 2 -400 1640 DEPOSIT ABSOLUTE MONOTONY MON_INCREASE /end AXIS_DESCR
 /begin AXIS_DESCR STD_AXIS zff_atsys._.iSignale._.obj.sig_c_getr UMR_GRADC__1_1_M40_S6_S3 10 -40 150 DEPOSIT ABSOLUTE MONOTONY MON_INCREASE /end AXIS_DESCR
/end CHARACTERISTIC
/begin CHARACTERISTIC KL_POKZUMEPOS12 "Schaltdruckoffset f(Momentenerhoehung)" CURVE 0x2578A0 kl_si16_S6_S3 12.75 UMR_BAR__1_1000_0_S6_S3 0 12.75
 /begin AXIS_DESCR STD_AXIS iMoeMesaf.me_sas UMR_NM__1_1_0_S6_S3 5 -2000 2000 DEPOSIT ABSOLUTE MONOTONY MON_INCREASE /end AXIS_DESCR
/end CHARACTERISTIC
/begin CHARACTERISTIC T_SYNPOMEPOS12 "Zeitkriterium fuer Schaltdruckoffset" VALUE 0x26DE44 kw_si16_S6_S3 5000 UMR_MSEC__10_1_0_S6_S3 -5000 0 /end CHARACTERISTIC
/begin CHARACTERISTIC KL_PORAKZU12 "Schaltdruckoffset" CURVE 0x2578B8 kl_si16_S6_S3 12.75 UMR_BAR__1_1000_0_S6_S3 -6.4 6.35
 /begin AXIS_DESCR STD_AXIS iSasZentr.iSchaltend.iKzu.timer_zkzu UMR_MSEC__10_1_0_S6_S3 3 0 2540 DEPOSIT ABSOLUTE MONOTONY MON_INCREASE /end AXIS_DESCR
/end CHARACTERISTIC
/begin CHARACTERISTIC KL_PORASYN12 "Rampe n.Syn.->letz.Stuetz.y PMAX" CURVE 0x2578C8 kl_si16_S6_S3 23 UMR_BAR__1_1000_0_S6_S3 0 23
 /begin AXIS_DESCR STD_AXIS iSasZentr.iSchaltend.iKzu.timer_zkzu UMR_MSEC__10_1_0_S6_S3 3 0 2540 DEPOSIT ABSOLUTE MONOTONY MON_INCREASE /end AXIS_DESCR
/end CHARACTERISTIC
/begin CHARACTERISTIC KL_POKZUMDMOTSOLL12 "Schaltdruckoffset in Abhaengigkeit von md_motsoll_sas" CURVE 0x2578D8 kl_si16_S6_S3 12.75 UMR_BAR__1_1000_0_S6_S3 -6.4 6.35
 /begin AXIS_DESCR STD_AXIS NO_INPUT_QUANTITY UMR_NM__1_1_0_S6_S3 6 -2000 2000 DEPOSIT ABSOLUTE MONOTONY MON_INCREASE /end AXIS_DESCR
/end CHARACTERISTIC
/begin CHARACTERISTIC KL_POKZUMDMOTSOLL12_EL "Schaltdruckoffset in Abhaengigkeit von md_motsoll_sas" CURVE 0x2578F4 kl_si16_S6_S3 12.75 UMR_BAR__1_1000_0_S6_S3 -6.4 6.35
 /begin AXIS_DESCR STD_AXIS NO_INPUT_QUANTITY UMR_NM__1_1_0_S6_S3 6 -2000 2000 DEPOSIT ABSOLUTE MONOTONY MON_INCREASE /end AXIS_DESCR
/end CHARACTERISTIC
/begin CHARACTERISTIC KL_PGRASYN12 "Schliessrampenradient" CURVE 0x257910 kl_si16_S6_S3 6553.4 UMR_BAR_SEC_1_10_0_S6_S3 -3276.7 3276.7
 /begin AXIS_DESCR STD_AXIS zff_atsys._.iSignale._.obj.sig_m_t UMR_NM__1_1_0_S6_S3 6 -400 1640 DEPOSIT ABSOLUTE MONOTONY MON_INCREASE /end AXIS_DESCR
/end CHARACTERISTIC
/begin CHARACTERISTIC KL_FPGRASYN12 "Faktor Schließrampengradient" CURVE 0x25792C kl_si16_S6_S3 50 UMR___1_10_0_S6_S3 0 50
 /begin AXIS_DESCR STD_AXIS iItfInput.ng_ab UMR_U_MINSEC_1_1_0_S6_S3 4 -5000 1000 DEPOSIT ABSOLUTE MONOTONY MON_INCREASE /end AXIS_DESCR
/end CHARACTERISTIC
/begin CHARACTERISTIC NGS_ABFLARE12 "Abtriebsdrehzahlgradientenschwelle" VALUE 0x26DE46 kw_si16_S6_S3 13200 UMR_U_MINSEC_1_1_0_S6_S3 -5000 8200 /end CHARACTERISTIC
/begin CHARACTERISTIC KL_POKZUFLARE12 "Sollschlupf abhaengiger Druckoffset zur Vermeidung von Flare" CURVE 0x257940 kl_si16_S6_S3 3 UMR_BAR__1_1000_0_S6_S3 0 3
 /begin AXIS_DESCR STD_AXIS iSasZentr.iSchaltend.nd_synistgang UMR_U_MIN_1_1_0_S6_S3 5 -8000 8000 DEPOSIT ABSOLUTE MONOTONY MON_INCREASE /end AXIS_DESCR
/end CHARACTERISTIC
/begin CHARACTERISTIC TO_VKZUSLST23 "Zeitoffset auf Verzögerung Schnellfüllung bei Schleppstart" VALUE 0x26E8D5 kw_ui8_S6_S3 90 UMR_MSEC__10_1_0_S6_S3 10 100 /end CHARACTERISTIC
/begin CHARACTERISTIC KL_POKZUNGAB23 "Druckoffset in Abhaengigkeit von ng_ab" CURVE 0x257958 kl_si16_S6_S3 12.75 UMR_BAR__1_1000_0_S6_S3 -6.4 6.35
 /begin AXIS_DESCR STD_AXIS iItfInput.ng_ab UMR_U_MINSEC_1_1_0_S6_S3 4 -5000 1000 DEPOSIT ABSOLUTE MONOTONY MON_INCREASE /end AXIS_DESCR
/end CHARACTERISTIC
/begin CHARACTERISTIC KL_PGOFMT23 "Gradient Druckoffset Fuellphase" CURVE 0x25796C kl_si16_S6_S3 200 UMR_BAR_SEC_1_10_0_S6_S3 -100 100
 /begin AXIS_DESCR STD_AXIS zff_atsys._.iSignale._.obj.sig_m_t UMR_NM__1_1_0_S6_S3 4 -400 1640 DEPOSIT ABSOLUTE MONOTONY MON_INCREASE /end AXIS_DESCR
/end CHARACTERISTIC
/begin CHARACTERISTIC KL_POFMDMOTSOLL23 "Fuelldruckoffset f(Erhoehung Motorsollmoment)" CURVE 0x257980 kl_si16_S6_S3 12.75 UMR_BAR__1_1000_0_S6_S3 -6.4 6.35
 /begin AXIS_DESCR STD_AXIS NO_INPUT_QUANTITY UMR_NM__1_1_0_S6_S3 6 -2000 2000 DEPOSIT ABSOLUTE MONOTONY MON_INCREASE /end AXIS_DESCR
/end CHARACTERISTIC
/begin CHARACTERISTIC KL_POFMDMOTSOLL23_EL "Fuelldruckoffset f(Erhoehung Motorsollmoment)" CURVE 0x25799C kl_si16_S6_S3 12.75 UMR_BAR__1_1000_0_S6_S3 -6.4 6.35
 /begin AXIS_DESCR STD_AXIS NO_INPUT_QUANTITY UMR_NM__1_1_0_S6_S3 6 -2000 2000 DEPOSIT ABSOLUTE MONOTONY MON_INCREASE /end AXIS_DESCR
/end CHARACTERISTIC
/begin CHARACTERISTIC KL_FTRACG23 "Faktor auf Zeit für Rampe auf Schaltdruck" CURVE 0x2579B8 kl_ui8_S6_S3 1 UMR_PROZENT__1_100_0_S6_S3 1 2
 /begin AXIS_DESCR STD_AXIS zff_atsys._.iSignale._.obj.sig_c_getr UMR_GRADC__1_1_M40_S6_S3 4 -40 150 DEPOSIT ABSOLUTE MONOTONY MON_INCREASE /end AXIS_DESCR
/end CHARACTERISTIC
/begin CHARACTERISTIC T_RA2SSCHR23 "Zeit 2.Rampe bei Schrittschaltung" VALUE 0x26E8D6 kw_ui8_S6_S3 2540 UMR_MSEC__10_1_0_S6_S3 0 2540 /end CHARACTERISTIC
/begin CHARACTERISTIC T_SYN23 "Verweilzeit in Synchron zum Start Max.Rampe" VALUE 0x26E8D7 kw_ui8_S6_S3 2540 UMR_MSEC__10_1_0_S6_S3 0 2540 /end CHARACTERISTIC
/begin CHARACTERISTIC T_KORHSZEIT23 "Korrekturwert fur Schaltverzugberechnung" VALUE 0x26E8D8 kw_ui8_S6_S3 2000 UMR_MSEC__10_1_M128_S6_S3 -1000 1000 /end CHARACTERISTIC
/begin CHARACTERISTIC KF_POFMTCG23 "Fülldruckoffset" MAP 0x2579C4 kf_si16_S6_S3 12.75 UMR_BAR__1_1000_0_S6_S3 -6.4 6.35
 /begin AXIS_DESCR STD_AXIS zff_atsys._.iSignale._.obj.sig_m_t UMR_NM__1_1_0_S6_S3 2 -400 1640 DEPOSIT ABSOLUTE MONOTONY MON_INCREASE /end AXIS_DESCR
 /begin AXIS_DESCR STD_AXIS zff_atsys._.iSignale._.obj.sig_c_getr UMR_GRADC__1_1_M40_S6_S3 10 -40 150 DEPOSIT ABSOLUTE MONOTONY MON_INCREASE /end AXIS_DESCR
/end CHARACTERISTIC
/begin CHARACTERISTIC KF_POFMTCG23_EL "Fülldruckoffset" MAP 0x257A0C kf_si16_S6_S3 12.75 UMR_BAR__1_1000_0_S6_S3 -6.4 6.35
 /begin AXIS_DESCR STD_AXIS zff_atsys._.iSignale._.obj.sig_m_t UMR_NM__1_1_0_S6_S3 2 -400 1640 DEPOSIT ABSOLUTE MONOTONY MON_INCREASE /end AXIS_DESCR
 /begin AXIS_DESCR STD_AXIS zff_atsys._.iSignale._.obj.sig_c_getr UMR_GRADC__1_1_M40_S6_S3 10 -40 150 DEPOSIT ABSOLUTE MONOTONY MON_INCREASE /end AXIS_DESCR
/end CHARACTERISTIC
/begin CHARACTERISTIC KL_POKZUMEPOS23 "Schaltdruckoffset f(Momentenerhoehung)" CURVE 0x257A54 kl_si16_S6_S3 12.75 UMR_BAR__1_1000_0_S6_S3 0 12.75
 /begin AXIS_DESCR STD_AXIS iMoeMesaf.me_sas UMR_NM__1_1_0_S6_S3 5 -2000 2000 DEPOSIT ABSOLUTE MONOTONY MON_INCREASE /end AXIS_DESCR
/end CHARACTERISTIC
/begin CHARACTERISTIC T_SYNPOMEPOS23 "Zeitkriterium fuer Schaltdruckoffset" VALUE 0x26DE48 kw_si16_S6_S3 5000 UMR_MSEC__10_1_0_S6_S3 -5000 0 /end CHARACTERISTIC
/begin CHARACTERISTIC KL_PORAKZU23 "Schaltdruckoffset" CURVE 0x257A6C kl_si16_S6_S3 12.75 UMR_BAR__1_1000_0_S6_S3 -6.4 6.35
 /begin AXIS_DESCR STD_AXIS iSasZentr.iSchaltend.iKzu.timer_zkzu UMR_MSEC__10_1_0_S6_S3 3 0 2540 DEPOSIT ABSOLUTE MONOTONY MON_INCREASE /end AXIS_DESCR
/end CHARACTERISTIC
/begin CHARACTERISTIC KL_PORASYN23 "Rampe n.Syn.->letz.Stuetz.y PMAX" CURVE 0x257A7C kl_si16_S6_S3 23 UMR_BAR__1_1000_0_S6_S3 0 23
 /begin AXIS_DESCR STD_AXIS iSasZentr.iSchaltend.iKzu.timer_zkzu UMR_MSEC__10_1_0_S6_S3 3 0 2540 DEPOSIT ABSOLUTE MONOTONY MON_INCREASE /end AXIS_DESCR
/end CHARACTERISTIC
/begin CHARACTERISTIC KL_POKZUMDMOTSOLL23 "Schaltdruckoffset in Abhaengigkeit von md_motsoll_sas" CURVE 0x257A8C kl_si16_S6_S3 12.75 UMR_BAR__1_1000_0_S6_S3 -6.4 6.35
 /begin AXIS_DESCR STD_AXIS NO_INPUT_QUANTITY UMR_NM__1_1_0_S6_S3 6 -2000 2000 DEPOSIT ABSOLUTE MONOTONY MON_INCREASE /end AXIS_DESCR
/end CHARACTERISTIC
/begin CHARACTERISTIC KL_POKZUMDMOTSOLL23_EL "Schaltdruckoffset in Abhaengigkeit von md_motsoll_sas" CURVE 0x257AA8 kl_si16_S6_S3 12.75 UMR_BAR__1_1000_0_S6_S3 -6.4 6.35
 /begin AXIS_DESCR STD_AXIS NO_INPUT_QUANTITY UMR_NM__1_1_0_S6_S3 6 -2000 2000 DEPOSIT ABSOLUTE MONOTONY MON_INCREASE /end AXIS_DESCR
/end CHARACTERISTIC
/begin CHARACTERISTIC KL_PGRASYN23 "Schliessrampenradient" CURVE 0x257AC4 kl_si16_S6_S3 6553.4 UMR_BAR_SEC_1_10_0_S6_S3 -3276.7 3276.7
 /begin AXIS_DESCR STD_AXIS zff_atsys._.iSignale._.obj.sig_m_t UMR_NM__1_1_0_S6_S3 6 -400 1640 DEPOSIT ABSOLUTE MONOTONY MON_INCREASE /end AXIS_DESCR
/end CHARACTERISTIC
/begin CHARACTERISTIC KL_FPGRASYN23 "Faktor Schließrampengradient" CURVE 0x257AE0 kl_si16_S6_S3 50 UMR___1_10_0_S6_S3 0 50
 /begin AXIS_DESCR STD_AXIS iItfInput.ng_ab UMR_U_MINSEC_1_1_0_S6_S3 4 -5000 1000 DEPOSIT ABSOLUTE MONOTONY MON_INCREASE /end AXIS_DESCR
/end CHARACTERISTIC
/begin CHARACTERISTIC NGS_ABFLARE23 "Abtriebsdrehzahlgradientenschwelle" VALUE 0x26DE4A kw_si16_S6_S3 13200 UMR_U_MINSEC_1_1_0_S6_S3 -5000 8200 /end CHARACTERISTIC
/begin CHARACTERISTIC KL_POKZUFLARE23 "Sollschlupf abhaengiger Druckoffset zur Vermeidung von Flare" CURVE 0x257AF4 kl_si16_S6_S3 3 UMR_BAR__1_1000_0_S6_S3 0 3
 /begin AXIS_DESCR STD_AXIS iSasZentr.iSchaltend.nd_synistgang UMR_U_MIN_1_1_0_S6_S3 5 -8000 8000 DEPOSIT ABSOLUTE MONOTONY MON_INCREASE /end AXIS_DESCR
/end CHARACTERISTIC
/begin CHARACTERISTIC TO_VKZUSLST34 "Zeitoffset auf Verzögerung Schnellfüllung bei Schleppstart" VALUE 0x26E8D9 kw_ui8_S6_S3 90 UMR_MSEC__10_1_0_S6_S3 10 100 /end CHARACTERISTIC
/begin CHARACTERISTIC KL_POKZUNGAB34 "Druckoffset in Abhaengigkeit von ng_ab" CURVE 0x257B0C kl_si16_S6_S3 12.75 UMR_BAR__1_1000_0_S6_S3 -6.4 6.35
 /begin AXIS_DESCR STD_AXIS iItfInput.ng_ab UMR_U_MINSEC_1_1_0_S6_S3 4 -5000 1000 DEPOSIT ABSOLUTE MONOTONY MON_INCREASE /end AXIS_DESCR
/end CHARACTERISTIC
/begin CHARACTERISTIC KL_PGOFMT34 "Gradient Druckoffset Fuellphase" CURVE 0x257B20 kl_si16_S6_S3 200 UMR_BAR_SEC_1_10_0_S6_S3 -100 100
 /begin AXIS_DESCR STD_AXIS zff_atsys._.iSignale._.obj.sig_m_t UMR_NM__1_1_0_S6_S3 4 -400 1640 DEPOSIT ABSOLUTE MONOTONY MON_INCREASE /end AXIS_DESCR
/end CHARACTERISTIC
/begin CHARACTERISTIC KL_POFMDMOTSOLL34 "Fuelldruckoffset f(Erhoehung Motorsollmoment)" CURVE 0x257B34 kl_si16_S6_S3 12.75 UMR_BAR__1_1000_0_S6_S3 -6.4 6.35
 /begin AXIS_DESCR STD_AXIS NO_INPUT_QUANTITY UMR_NM__1_1_0_S6_S3 6 -2000 2000 DEPOSIT ABSOLUTE MONOTONY MON_INCREASE /end AXIS_DESCR
/end CHARACTERISTIC
/begin CHARACTERISTIC KL_POFMDMOTSOLL34_EL "Fuelldruckoffset f(Erhoehung Motorsollmoment)" CURVE 0x257B50 kl_si16_S6_S3 12.75 UMR_BAR__1_1000_0_S6_S3 -6.4 6.35
 /begin AXIS_DESCR STD_AXIS NO_INPUT_QUANTITY UMR_NM__1_1_0_S6_S3 6 -2000 2000 DEPOSIT ABSOLUTE MONOTONY MON_INCREASE /end AXIS_DESCR
/end CHARACTERISTIC
/begin CHARACTERISTIC KL_FTRACG34 "Faktor auf Zeit für Rampe auf Schaltdruck" CURVE 0x257B6C kl_ui8_S6_S3 1 UMR_PROZENT__1_100_0_S6_S3 1 2
 /begin AXIS_DESCR STD_AXIS zff_atsys._.iSignale._.obj.sig_c_getr UMR_GRADC__1_1_M40_S6_S3 4 -40 150 DEPOSIT ABSOLUTE MONOTONY MON_INCREASE /end AXIS_DESCR
/end CHARACTERISTIC
/begin CHARACTERISTIC T_RA2SSCHR34 "Zeit 2.Rampe bei Schrittschaltung" VALUE 0x26E8DA kw_ui8_S6_S3 2540 UMR_MSEC__10_1_0_S6_S3 0 2540 /end CHARACTERISTIC
/begin CHARACTERISTIC T_SYN34 "Verweilzeit in Synchron zum Start Max.Rampe" VALUE 0x26E8DB kw_ui8_S6_S3 2540 UMR_MSEC__10_1_0_S6_S3 0 2540 /end CHARACTERISTIC
/begin CHARACTERISTIC T_KORHSZEIT34 "Korrekturwert fur Schaltverzugberechnung" VALUE 0x26E8DC kw_ui8_S6_S3 2000 UMR_MSEC__10_1_M128_S6_S3 -1000 1000 /end CHARACTERISTIC
/begin CHARACTERISTIC KF_POFMTCG34 "Fülldruckoffset" MAP 0x257B78 kf_si16_S6_S3 12.75 UMR_BAR__1_1000_0_S6_S3 -6.4 6.35
 /begin AXIS_DESCR STD_AXIS zff_atsys._.iSignale._.obj.sig_m_t UMR_NM__1_1_0_S6_S3 2 -400 1640 DEPOSIT ABSOLUTE MONOTONY MON_INCREASE /end AXIS_DESCR
 /begin AXIS_DESCR STD_AXIS zff_atsys._.iSignale._.obj.sig_c_getr UMR_GRADC__1_1_M40_S6_S3 10 -40 150 DEPOSIT ABSOLUTE MONOTONY MON_INCREASE /end AXIS_DESCR
/end CHARACTERISTIC
/begin CHARACTERISTIC KF_POFMTCG34_EL "Fülldruckoffset" MAP 0x257BC0 kf_si16_S6_S3 12.75 UMR_BAR__1_1000_0_S6_S3 -6.4 6.35
 /begin AXIS_DESCR STD_AXIS zff_atsys._.iSignale._.obj.sig_m_t UMR_NM__1_1_0_S6_S3 2 -400 1640 DEPOSIT ABSOLUTE MONOTONY MON_INCREASE /end AXIS_DESCR
 /begin AXIS_DESCR STD_AXIS zff_atsys._.iSignale._.obj.sig_c_getr UMR_GRADC__1_1_M40_S6_S3 10 -40 150 DEPOSIT ABSOLUTE MONOTONY MON_INCREASE /end AXIS_DESCR
/end CHARACTERISTIC
/begin CHARACTERISTIC KL_POKZUMEPOS34 "Schaltdruckoffset f(Momentenerhoehung)" CURVE 0x257C08 kl_si16_S6_S3 12.75 UMR_BAR__1_1000_0_S6_S3 0 12.75
 /begin AXIS_DESCR STD_AXIS iMoeMesaf.me_sas UMR_NM__1_1_0_S6_S3 5 -2000 2000 DEPOSIT ABSOLUTE MONOTONY MON_INCREASE /end AXIS_DESCR
/end CHARACTERISTIC
/begin CHARACTERISTIC T_SYNPOMEPOS34 "Zeitkriterium fuer Schaltdruckoffset" VALUE 0x26DE4C kw_si16_S6_S3 5000 UMR_MSEC__10_1_0_S6_S3 -5000 0 /end CHARACTERISTIC
/begin CHARACTERISTIC KL_PORAKZU34 "Schaltdruckoffset" CURVE 0x257C20 kl_si16_S6_S3 12.75 UMR_BAR__1_1000_0_S6_S3 -6.4 6.35
 /begin AXIS_DESCR STD_AXIS iSasZentr.iSchaltend.iKzu.timer_zkzu UMR_MSEC__10_1_0_S6_S3 3 0 2540 DEPOSIT ABSOLUTE MONOTONY MON_INCREASE /end AXIS_DESCR
/end CHARACTERISTIC
/begin CHARACTERISTIC KL_PORASYN34 "Rampe n.Syn.->letz.Stuetz.y PMAX" CURVE 0x257C30 kl_si16_S6_S3 23 UMR_BAR__1_1000_0_S6_S3 0 23
 /begin AXIS_DESCR STD_AXIS iSasZentr.iSchaltend.iKzu.timer_zkzu UMR_MSEC__10_1_0_S6_S3 3 0 2540 DEPOSIT ABSOLUTE MONOTONY MON_INCREASE /end AXIS_DESCR
/end CHARACTERISTIC
/begin CHARACTERISTIC KL_POKZUMDMOTSOLL34 "Schaltdruckoffset in Abhaengigkeit von md_motsoll_sas" CURVE 0x257C40 kl_si16_S6_S3 12.75 UMR_BAR__1_1000_0_S6_S3 -6.4 6.35
 /begin AXIS_DESCR STD_AXIS NO_INPUT_QUANTITY UMR_NM__1_1_0_S6_S3 6 -2000 2000 DEPOSIT ABSOLUTE MONOTONY MON_INCREASE /end AXIS_DESCR
/end CHARACTERISTIC
/begin CHARACTERISTIC KL_POKZUMDMOTSOLL34_EL "Schaltdruckoffset in Abhaengigkeit von md_motsoll_sas" CURVE 0x257C5C kl_si16_S6_S3 12.75 UMR_BAR__1_1000_0_S6_S3 -6.4 6.35
 /begin AXIS_DESCR STD_AXIS NO_INPUT_QUANTITY UMR_NM__1_1_0_S6_S3 6 -2000 2000 DEPOSIT ABSOLUTE MONOTONY MON_INCREASE /end AXIS_DESCR
/end CHARACTERISTIC
/begin CHARACTERISTIC KL_PGRASYN34 "Schliessrampenradient" CURVE 0x257C78 kl_si16_S6_S3 6553.4 UMR_BAR_SEC_1_10_0_S6_S3 -3276.7 3276.7
 /begin AXIS_DESCR STD_AXIS zff_atsys._.iSignale._.obj.sig_m_t UMR_NM__1_1_0_S6_S3 6 -400 1640 DEPOSIT ABSOLUTE MONOTONY MON_INCREASE /end AXIS_DESCR
/end CHARACTERISTIC
/begin CHARACTERISTIC KL_FPGRASYN34 "Faktor Schließrampengradient" CURVE 0x257C94 kl_si16_S6_S3 50 UMR___1_10_0_S6_S3 0 50
 /begin AXIS_DESCR STD_AXIS iItfInput.ng_ab UMR_U_MINSEC_1_1_0_S6_S3 4 -5000 1000 DEPOSIT ABSOLUTE MONOTONY MON_INCREASE /end AXIS_DESCR
/end CHARACTERISTIC
/begin CHARACTERISTIC NGS_ABFLARE34 "Abtriebsdrehzahlgradientenschwelle" VALUE 0x26DE4E kw_si16_S6_S3 13200 UMR_U_MINSEC_1_1_0_S6_S3 -5000 8200 /end CHARACTERISTIC
/begin CHARACTERISTIC KL_POKZUFLARE34 "Sollschlupf abhaengiger Druckoffset zur Vermeidung von Flare" CURVE 0x257CA8 kl_si16_S6_S3 3 UMR_BAR__1_1000_0_S6_S3 0 3
 /begin AXIS_DESCR STD_AXIS iSasZentr.iSchaltend.nd_synistgang UMR_U_MIN_1_1_0_S6_S3 5 -8000 8000 DEPOSIT ABSOLUTE MONOTONY MON_INCREASE /end AXIS_DESCR
/end CHARACTERISTIC
/begin CHARACTERISTIC TO_VKZUSLST45 "Zeitoffset auf Verzögerung Schnellfüllung bei Schleppstart" VALUE 0x26E8DD kw_ui8_S6_S3 90 UMR_MSEC__10_1_0_S6_S3 10 100 /end CHARACTERISTIC
/begin CHARACTERISTIC KL_POKZUNGAB45 "Druckoffset in Abhaengigkeit von ng_ab" CURVE 0x257CC0 kl_si16_S6_S3 12.75 UMR_BAR__1_1000_0_S6_S3 -6.4 6.35
 /begin AXIS_DESCR STD_AXIS iItfInput.ng_ab UMR_U_MINSEC_1_1_0_S6_S3 4 -5000 1000 DEPOSIT ABSOLUTE MONOTONY MON_INCREASE /end AXIS_DESCR
/end CHARACTERISTIC
/begin CHARACTERISTIC KL_PGOFMT45 "Gradient Druckoffset Fuellphase" CURVE 0x257CD4 kl_si16_S6_S3 200 UMR_BAR_SEC_1_10_0_S6_S3 -100 100
 /begin AXIS_DESCR STD_AXIS zff_atsys._.iSignale._.obj.sig_m_t UMR_NM__1_1_0_S6_S3 4 -400 1640 DEPOSIT ABSOLUTE MONOTONY MON_INCREASE /end AXIS_DESCR
/end CHARACTERISTIC
/begin CHARACTERISTIC KL_POFMDMOTSOLL45 "Fuelldruckoffset f(Erhoehung Motorsollmoment)" CURVE 0x257CE8 kl_si16_S6_S3 12.75 UMR_BAR__1_1000_0_S6_S3 -6.4 6.35
 /begin AXIS_DESCR STD_AXIS NO_INPUT_QUANTITY UMR_NM__1_1_0_S6_S3 6 -2000 2000 DEPOSIT ABSOLUTE MONOTONY MON_INCREASE /end AXIS_DESCR
/end CHARACTERISTIC
/begin CHARACTERISTIC KL_POFMDMOTSOLL45_EL "Fuelldruckoffset f(Erhoehung Motorsollmoment)" CURVE 0x257D04 kl_si16_S6_S3 12.75 UMR_BAR__1_1000_0_S6_S3 -6.4 6.35
 /begin AXIS_DESCR STD_AXIS NO_INPUT_QUANTITY UMR_NM__1_1_0_S6_S3 6 -2000 2000 DEPOSIT ABSOLUTE MONOTONY MON_INCREASE /end AXIS_DESCR
/end CHARACTERISTIC
/begin CHARACTERISTIC KL_FTRACG45 "Faktor auf Zeit für Rampe auf Schaltdruck" CURVE 0x257D20 kl_ui8_S6_S3 1 UMR_PROZENT__1_100_0_S6_S3 1 2
 /begin AXIS_DESCR STD_AXIS zff_atsys._.iSignale._.obj.sig_c_getr UMR_GRADC__1_1_M40_S6_S3 4 -40 150 DEPOSIT ABSOLUTE MONOTONY MON_INCREASE /end AXIS_DESCR
/end CHARACTERISTIC
/begin CHARACTERISTIC T_RA2SSCHR45 "Zeit 2.Rampe bei Schrittschaltung" VALUE 0x26E8DE kw_ui8_S6_S3 2540 UMR_MSEC__10_1_0_S6_S3 0 2540 /end CHARACTERISTIC
/begin CHARACTERISTIC T_SYN45 "Verweilzeit in Synchron zum Start Max.Rampe" VALUE 0x26E8DF kw_ui8_S6_S3 2540 UMR_MSEC__10_1_0_S6_S3 0 2540 /end CHARACTERISTIC
/begin CHARACTERISTIC T_KORHSZEIT45 "Korrekturwert fur Schaltverzugberechnung" VALUE 0x26E8E0 kw_ui8_S6_S3 2000 UMR_MSEC__10_1_M128_S6_S3 -1000 1000 /end CHARACTERISTIC
/begin CHARACTERISTIC KF_POFMTCG45 "Fülldruckoffset" MAP 0x257D2C kf_si16_S6_S3 12.75 UMR_BAR__1_1000_0_S6_S3 -6.4 6.35
 /begin AXIS_DESCR STD_AXIS zff_atsys._.iSignale._.obj.sig_m_t UMR_NM__1_1_0_S6_S3 2 -400 1640 DEPOSIT ABSOLUTE MONOTONY MON_INCREASE /end AXIS_DESCR
 /begin AXIS_DESCR STD_AXIS zff_atsys._.iSignale._.obj.sig_c_getr UMR_GRADC__1_1_M40_S6_S3 10 -40 150 DEPOSIT ABSOLUTE MONOTONY MON_INCREASE /end AXIS_DESCR
/end CHARACTERISTIC
/begin CHARACTERISTIC KF_POFMTCG45_EL "Fülldruckoffset" MAP 0x257D74 kf_si16_S6_S3 12.75 UMR_BAR__1_1000_0_S6_S3 -6.4 6.35
 /begin AXIS_DESCR STD_AXIS zff_atsys._.iSignale._.obj.sig_m_t UMR_NM__1_1_0_S6_S3 2 -400 1640 DEPOSIT ABSOLUTE MONOTONY MON_INCREASE /end AXIS_DESCR
 /begin AXIS_DESCR STD_AXIS zff_atsys._.iSignale._.obj.sig_c_getr UMR_GRADC__1_1_M40_S6_S3 10 -40 150 DEPOSIT ABSOLUTE MONOTONY MON_INCREASE /end AXIS_DESCR
/end CHARACTERISTIC
/begin CHARACTERISTIC KL_POKZUMEPOS45 "Schaltdruckoffset f(Momentenerhoehung)" CURVE 0x257DBC kl_si16_S6_S3 12.75 UMR_BAR__1_1000_0_S6_S3 0 12.75
 /begin AXIS_DESCR STD_AXIS iMoeMesaf.me_sas UMR_NM__1_1_0_S6_S3 5 -2000 2000 DEPOSIT ABSOLUTE MONOTONY MON_INCREASE /end AXIS_DESCR
/end CHARACTERISTIC
/begin CHARACTERISTIC T_SYNPOMEPOS45 "Zeitkriterium fuer Schaltdruckoffset" VALUE 0x26DE50 kw_si16_S6_S3 5000 UMR_MSEC__10_1_0_S6_S3 -5000 0 /end CHARACTERISTIC
/begin CHARACTERISTIC KL_PORAKZU45 "Schaltdruckoffset" CURVE 0x257DD4 kl_si16_S6_S3 12.75 UMR_BAR__1_1000_0_S6_S3 -6.4 6.35
 /begin AXIS_DESCR STD_AXIS iSasZentr.iSchaltend.iKzu.timer_zkzu UMR_MSEC__10_1_0_S6_S3 3 0 2540 DEPOSIT ABSOLUTE MONOTONY MON_INCREASE /end AXIS_DESCR
/end CHARACTERISTIC
/begin CHARACTERISTIC KL_PORASYN45 "Rampe n.Syn.->letz.Stuetz.y PMAX" CURVE 0x257DE4 kl_si16_S6_S3 23 UMR_BAR__1_1000_0_S6_S3 0 23
 /begin AXIS_DESCR STD_AXIS iSasZentr.iSchaltend.iKzu.timer_zkzu UMR_MSEC__10_1_0_S6_S3 3 0 2540 DEPOSIT ABSOLUTE MONOTONY MON_INCREASE /end AXIS_DESCR
/end CHARACTERISTIC
/begin CHARACTERISTIC KL_POKZUMDMOTSOLL45 "Schaltdruckoffset in Abhaengigkeit von md_motsoll_sas" CURVE 0x257DF4 kl_si16_S6_S3 12.75 UMR_BAR__1_1000_0_S6_S3 -6.4 6.35
 /begin AXIS_DESCR STD_AXIS NO_INPUT_QUANTITY UMR_NM__1_1_0_S6_S3 6 -2000 2000 DEPOSIT ABSOLUTE MONOTONY MON_INCREASE /end AXIS_DESCR
/end CHARACTERISTIC
/begin CHARACTERISTIC KL_POKZUMDMOTSOLL45_EL "Schaltdruckoffset in Abhaengigkeit von md_motsoll_sas" CURVE 0x257E10 kl_si16_S6_S3 12.75 UMR_BAR__1_1000_0_S6_S3 -6.4 6.35
 /begin AXIS_DESCR STD_AXIS NO_INPUT_QUANTITY UMR_NM__1_1_0_S6_S3 6 -2000 2000 DEPOSIT ABSOLUTE MONOTONY MON_INCREASE /end AXIS_DESCR
/end CHARACTERISTIC
/begin CHARACTERISTIC KL_PGRASYN45 "Schliessrampenradient" CURVE 0x257E2C kl_si16_S6_S3 6553.4 UMR_BAR_SEC_1_10_0_S6_S3 -3276.7 3276.7
 /begin AXIS_DESCR STD_AXIS zff_atsys._.iSignale._.obj.sig_m_t UMR_NM__1_1_0_S6_S3 6 -400 1640 DEPOSIT ABSOLUTE MONOTONY MON_INCREASE /end AXIS_DESCR
/end CHARACTERISTIC
/begin CHARACTERISTIC KL_FPGRASYN45 "Faktor Schließrampengradient" CURVE 0x257E48 kl_si16_S6_S3 50 UMR___1_10_0_S6_S3 0 50
 /begin AXIS_DESCR STD_AXIS iItfInput.ng_ab UMR_U_MINSEC_1_1_0_S6_S3 4 -5000 1000 DEPOSIT ABSOLUTE MONOTONY MON_INCREASE /end AXIS_DESCR
/end CHARACTERISTIC
/begin CHARACTERISTIC NGS_ABFLARE45 "Abtriebsdrehzahlgradientenschwelle" VALUE 0x26DE52 kw_si16_S6_S3 13200 UMR_U_MINSEC_1_1_0_S6_S3 -5000 8200 /end CHARACTERISTIC
/begin CHARACTERISTIC KL_POKZUFLARE45 "Sollschlupf abhaengiger Druckoffset zur Vermeidung von Flare" CURVE 0x257E5C kl_si16_S6_S3 3 UMR_BAR__1_1000_0_S6_S3 0 3
 /begin AXIS_DESCR STD_AXIS iSasZentr.iSchaltend.nd_synistgang UMR_U_MIN_1_1_0_S6_S3 5 -8000 8000 DEPOSIT ABSOLUTE MONOTONY MON_INCREASE /end AXIS_DESCR
/end CHARACTERISTIC
/begin CHARACTERISTIC TO_VKZUSLST56 "Zeitoffset auf Verzögerung Schnellfüllung bei Schleppstart" VALUE 0x26E8E1 kw_ui8_S6_S3 90 UMR_MSEC__10_1_0_S6_S3 10 100 /end CHARACTERISTIC
/begin CHARACTERISTIC KL_POKZUNGAB56 "Druckoffset in Abhaengigkeit von ng_ab" CURVE 0x257E74 kl_si16_S6_S3 12.75 UMR_BAR__1_1000_0_S6_S3 -6.4 6.35
 /begin AXIS_DESCR STD_AXIS iItfInput.ng_ab UMR_U_MINSEC_1_1_0_S6_S3 4 -5000 1000 DEPOSIT ABSOLUTE MONOTONY MON_INCREASE /end AXIS_DESCR
/end CHARACTERISTIC
/begin CHARACTERISTIC KL_PGOFMT56 "Gradient Druckoffset Fuellphase" CURVE 0x257E88 kl_si16_S6_S3 200 UMR_BAR_SEC_1_10_0_S6_S3 -100 100
 /begin AXIS_DESCR STD_AXIS zff_atsys._.iSignale._.obj.sig_m_t UMR_NM__1_1_0_S6_S3 4 -400 1640 DEPOSIT ABSOLUTE MONOTONY MON_INCREASE /end AXIS_DESCR
/end CHARACTERISTIC
/begin CHARACTERISTIC KL_POFMDMOTSOLL56 "Fuelldruckoffset f(Erhoehung Motorsollmoment)" CURVE 0x257E9C kl_si16_S6_S3 12.75 UMR_BAR__1_1000_0_S6_S3 -6.4 6.35
 /begin AXIS_DESCR STD_AXIS NO_INPUT_QUANTITY UMR_NM__1_1_0_S6_S3 6 -2000 2000 DEPOSIT ABSOLUTE MONOTONY MON_INCREASE /end AXIS_DESCR
/end CHARACTERISTIC
/begin CHARACTERISTIC KL_POFMDMOTSOLL56_EL "Fuelldruckoffset f(Erhoehung Motorsollmoment)" CURVE 0x257EB8 kl_si16_S6_S3 12.75 UMR_BAR__1_1000_0_S6_S3 -6.4 6.35
 /begin AXIS_DESCR STD_AXIS NO_INPUT_QUANTITY UMR_NM__1_1_0_S6_S3 6 -2000 2000 DEPOSIT ABSOLUTE MONOTONY MON_INCREASE /end AXIS_DESCR
/end CHARACTERISTIC
/begin CHARACTERISTIC KL_FTRACG56 "Faktor auf Zeit für Rampe auf Schaltdruck" CURVE 0x257ED4 kl_ui8_S6_S3 1 UMR_PROZENT__1_100_0_S6_S3 1 2
 /begin AXIS_DESCR STD_AXIS zff_atsys._.iSignale._.obj.sig_c_getr UMR_GRADC__1_1_M40_S6_S3 4 -40 150 DEPOSIT ABSOLUTE MONOTONY MON_INCREASE /end AXIS_DESCR
/end CHARACTERISTIC
/begin CHARACTERISTIC T_RA2SSCHR56 "Zeit 2.Rampe bei Schrittschaltung" VALUE 0x26E8E2 kw_ui8_S6_S3 2540 UMR_MSEC__10_1_0_S6_S3 0 2540 /end CHARACTERISTIC
/begin CHARACTERISTIC T_SYN56 "Verweilzeit in Synchron zum Start Max.Rampe" VALUE 0x26E8E3 kw_ui8_S6_S3 2540 UMR_MSEC__10_1_0_S6_S3 0 2540 /end CHARACTERISTIC
/begin CHARACTERISTIC T_KORHSZEIT56 "Korrekturwert fur Schaltverzugberechnung" VALUE 0x26E8E4 kw_ui8_S6_S3 2000 UMR_MSEC__10_1_M128_S6_S3 -1000 1000 /end CHARACTERISTIC
/begin CHARACTERISTIC KF_POFMTCG56 "Fülldruckoffset" MAP 0x257EE0 kf_si16_S6_S3 12.75 UMR_BAR__1_1000_0_S6_S3 -6.4 6.35
 /begin AXIS_DESCR STD_AXIS zff_atsys._.iSignale._.obj.sig_m_t UMR_NM__1_1_0_S6_S3 2 -400 1640 DEPOSIT ABSOLUTE MONOTONY MON_INCREASE /end AXIS_DESCR
 /begin AXIS_DESCR STD_AXIS zff_atsys._.iSignale._.obj.sig_c_getr UMR_GRADC__1_1_M40_S6_S3 10 -40 150 DEPOSIT ABSOLUTE MONOTONY MON_INCREASE /end AXIS_DESCR
/end CHARACTERISTIC
/begin CHARACTERISTIC KF_POFMTCG56_EL "Fülldruckoffset" MAP 0x257F28 kf_si16_S6_S3 12.75 UMR_BAR__1_1000_0_S6_S3 -6.4 6.35
 /begin AXIS_DESCR STD_AXIS zff_atsys._.iSignale._.obj.sig_m_t UMR_NM__1_1_0_S6_S3 2 -400 1640 DEPOSIT ABSOLUTE MONOTONY MON_INCREASE /end AXIS_DESCR
 /begin AXIS_DESCR STD_AXIS zff_atsys._.iSignale._.obj.sig_c_getr UMR_GRADC__1_1_M40_S6_S3 10 -40 150 DEPOSIT ABSOLUTE MONOTONY MON_INCREASE /end AXIS_DESCR
/end CHARACTERISTIC
/begin CHARACTERISTIC KL_POKZUMEPOS56 "Schaltdruckoffset f(Momentenerhoehung)" CURVE 0x257F70 kl_si16_S6_S3 12.75 UMR_BAR__1_1000_0_S6_S3 0 12.75
 /begin AXIS_DESCR STD_AXIS iMoeMesaf.me_sas UMR_NM__1_1_0_S6_S3 5 -2000 2000 DEPOSIT ABSOLUTE MONOTONY MON_INCREASE /end AXIS_DESCR
/end CHARACTERISTIC
/begin CHARACTERISTIC T_SYNPOMEPOS56 "Zeitkriterium fuer Schaltdruckoffset" VALUE 0x26DE54 kw_si16_S6_S3 5000 UMR_MSEC__10_1_0_S6_S3 -5000 0 /end CHARACTERISTIC
/begin CHARACTERISTIC KL_PORAKZU56 "Schaltdruckoffset" CURVE 0x257F88 kl_si16_S6_S3 12.75 UMR_BAR__1_1000_0_S6_S3 -6.4 6.35
 /begin AXIS_DESCR STD_AXIS iSasZentr.iSchaltend.iKzu.timer_zkzu UMR_MSEC__10_1_0_S6_S3 3 0 2540 DEPOSIT ABSOLUTE MONOTONY MON_INCREASE /end AXIS_DESCR
/end CHARACTERISTIC
/begin CHARACTERISTIC KL_PORASYN56 "Rampe n.Syn.->letz.Stuetz.y PMAX" CURVE 0x257F98 kl_si16_S6_S3 23 UMR_BAR__1_1000_0_S6_S3 0 23
 /begin AXIS_DESCR STD_AXIS iSasZentr.iSchaltend.iKzu.timer_zkzu UMR_MSEC__10_1_0_S6_S3 3 0 2540 DEPOSIT ABSOLUTE MONOTONY MON_INCREASE /end AXIS_DESCR
/end CHARACTERISTIC
/begin CHARACTERISTIC KL_POKZUMDMOTSOLL56 "Schaltdruckoffset in Abhaengigkeit von md_motsoll_sas" CURVE 0x257FA8 kl_si16_S6_S3 12.75 UMR_BAR__1_1000_0_S6_S3 -6.4 6.35
 /begin AXIS_DESCR STD_AXIS NO_INPUT_QUANTITY UMR_NM__1_1_0_S6_S3 6 -2000 2000 DEPOSIT ABSOLUTE MONOTONY MON_INCREASE /end AXIS_DESCR
/end CHARACTERISTIC
/begin CHARACTERISTIC KL_POKZUMDMOTSOLL56_EL "Schaltdruckoffset in Abhaengigkeit von md_motsoll_sas" CURVE 0x257FC4 kl_si16_S6_S3 12.75 UMR_BAR__1_1000_0_S6_S3 -6.4 6.35
 /begin AXIS_DESCR STD_AXIS NO_INPUT_QUANTITY UMR_NM__1_1_0_S6_S3 6 -2000 2000 DEPOSIT ABSOLUTE MONOTONY MON_INCREASE /end AXIS_DESCR
/end CHARACTERISTIC
/begin CHARACTERISTIC KL_PGRASYN56 "Schliessrampenradient" CURVE 0x257FE0 kl_si16_S6_S3 6553.4 UMR_BAR_SEC_1_10_0_S6_S3 -3276.7 3276.7
 /begin AXIS_DESCR STD_AXIS zff_atsys._.iSignale._.obj.sig_m_t UMR_NM__1_1_0_S6_S3 6 -400 1640 DEPOSIT ABSOLUTE MONOTONY MON_INCREASE /end AXIS_DESCR
/end CHARACTERISTIC
/begin CHARACTERISTIC KL_FPGRASYN56 "Faktor Schließrampengradient" CURVE 0x257FFC kl_si16_S6_S3 50 UMR___1_10_0_S6_S3 0 50
 /begin AXIS_DESCR STD_AXIS iItfInput.ng_ab UMR_U_MINSEC_1_1_0_S6_S3 4 -5000 1000 DEPOSIT ABSOLUTE MONOTONY MON_INCREASE /end AXIS_DESCR
/end CHARACTERISTIC
/begin CHARACTERISTIC NGS_ABFLARE56 "Abtriebsdrehzahlgradientenschwelle" VALUE 0x26DE56 kw_si16_S6_S3 13200 UMR_U_MINSEC_1_1_0_S6_S3 -5000 8200 /end CHARACTERISTIC
/begin CHARACTERISTIC KL_POKZUFLARE56 "Sollschlupf abhaengiger Druckoffset zur Vermeidung von Flare" CURVE 0x258010 kl_si16_S6_S3 3 UMR_BAR__1_1000_0_S6_S3 0 3
 /begin AXIS_DESCR STD_AXIS iSasZentr.iSchaltend.nd_synistgang UMR_U_MIN_1_1_0_S6_S3 5 -8000 8000 DEPOSIT ABSOLUTE MONOTONY MON_INCREASE /end AXIS_DESCR
/end CHARACTERISTIC
/begin CHARACTERISTIC TO_VKZUSLST67 "Zeitoffset auf Verzögerung Schnellfüllung bei Schleppstart" VALUE 0x26E8E5 kw_ui8_S6_S3 90 UMR_MSEC__10_1_0_S6_S3 10 100 /end CHARACTERISTIC
/begin CHARACTERISTIC KL_POKZUNGAB67 "Druckoffset in Abhaengigkeit von ng_ab" CURVE 0x258028 kl_si16_S6_S3 12.75 UMR_BAR__1_1000_0_S6_S3 -6.4 6.35
 /begin AXIS_DESCR STD_AXIS iItfInput.ng_ab UMR_U_MINSEC_1_1_0_S6_S3 4 -5000 1000 DEPOSIT ABSOLUTE MONOTONY MON_INCREASE /end AXIS_DESCR
/end CHARACTERISTIC
/begin CHARACTERISTIC KL_PGOFMT67 "Gradient Druckoffset Fuellphase" CURVE 0x25803C kl_si16_S6_S3 200 UMR_BAR_SEC_1_10_0_S6_S3 -100 100
 /begin AXIS_DESCR STD_AXIS zff_atsys._.iSignale._.obj.sig_m_t UMR_NM__1_1_0_S6_S3 4 -400 1640 DEPOSIT ABSOLUTE MONOTONY MON_INCREASE /end AXIS_DESCR
/end CHARACTERISTIC
/begin CHARACTERISTIC KL_POFMDMOTSOLL67 "Fuelldruckoffset f(Erhoehung Motorsollmoment)" CURVE 0x258050 kl_si16_S6_S3 12.75 UMR_BAR__1_1000_0_S6_S3 -6.4 6.35
 /begin AXIS_DESCR STD_AXIS NO_INPUT_QUANTITY UMR_NM__1_1_0_S6_S3 6 -2000 2000 DEPOSIT ABSOLUTE MONOTONY MON_INCREASE /end AXIS_DESCR
/end CHARACTERISTIC
/begin CHARACTERISTIC KL_POFMDMOTSOLL67_EL "Fuelldruckoffset f(Erhoehung Motorsollmoment)" CURVE 0x25806C kl_si16_S6_S3 12.75 UMR_BAR__1_1000_0_S6_S3 -6.4 6.35
 /begin AXIS_DESCR STD_AXIS NO_INPUT_QUANTITY UMR_NM__1_1_0_S6_S3 6 -2000 2000 DEPOSIT ABSOLUTE MONOTONY MON_INCREASE /end AXIS_DESCR
/end CHARACTERISTIC
/begin CHARACTERISTIC KL_FTRACG67 "Faktor auf Zeit für Rampe auf Schaltdruck" CURVE 0x258088 kl_ui8_S6_S3 1 UMR_PROZENT__1_100_0_S6_S3 1 2
 /begin AXIS_DESCR STD_AXIS zff_atsys._.iSignale._.obj.sig_c_getr UMR_GRADC__1_1_M40_S6_S3 4 -40 150 DEPOSIT ABSOLUTE MONOTONY MON_INCREASE /end AXIS_DESCR
/end CHARACTERISTIC
/begin CHARACTERISTIC T_RA2SSCHR67 "Zeit 2.Rampe bei Schrittschaltung" VALUE 0x26E8E6 kw_ui8_S6_S3 2540 UMR_MSEC__10_1_0_S6_S3 0 2540 /end CHARACTERISTIC
/begin CHARACTERISTIC T_SYN67 "Verweilzeit in Synchron zum Start Max.Rampe" VALUE 0x26E8E7 kw_ui8_S6_S3 2540 UMR_MSEC__10_1_0_S6_S3 0 2540 /end CHARACTERISTIC
/begin CHARACTERISTIC T_KORHSZEIT67 "Korrekturwert fur Schaltverzugberechnung" VALUE 0x26E8E8 kw_ui8_S6_S3 2000 UMR_MSEC__10_1_M128_S6_S3 -1000 1000 /end CHARACTERISTIC
/begin CHARACTERISTIC KF_POFMTCG67 "Fülldruckoffset" MAP 0x258094 kf_si16_S6_S3 12.75 UMR_BAR__1_1000_0_S6_S3 -6.4 6.35
 /begin AXIS_DESCR STD_AXIS zff_atsys._.iSignale._.obj.sig_m_t UMR_NM__1_1_0_S6_S3 2 -400 1640 DEPOSIT ABSOLUTE MONOTONY MON_INCREASE /end AXIS_DESCR
 /begin AXIS_DESCR STD_AXIS zff_atsys._.iSignale._.obj.sig_c_getr UMR_GRADC__1_1_M40_S6_S3 10 -40 150 DEPOSIT ABSOLUTE MONOTONY MON_INCREASE /end AXIS_DESCR
/end CHARACTERISTIC
/begin CHARACTERISTIC KF_POFMTCG67_EL "Fülldruckoffset" MAP 0x2580DC kf_si16_S6_S3 12.75 UMR_BAR__1_1000_0_S6_S3 -6.4 6.35
 /begin AXIS_DESCR STD_AXIS zff_atsys._.iSignale._.obj.sig_m_t UMR_NM__1_1_0_S6_S3 2 -400 1640 DEPOSIT ABSOLUTE MONOTONY MON_INCREASE /end AXIS_DESCR
 /begin AXIS_DESCR STD_AXIS zff_atsys._.iSignale._.obj.sig_c_getr UMR_GRADC__1_1_M40_S6_S3 10 -40 150 DEPOSIT ABSOLUTE MONOTONY MON_INCREASE /end AXIS_DESCR
/end CHARACTERISTIC
/begin CHARACTERISTIC KL_POKZUMEPOS67 "Schaltdruckoffset f(Momentenerhoehung)" CURVE 0x258124 kl_si16_S6_S3 12.75 UMR_BAR__1_1000_0_S6_S3 0 12.75
 /begin AXIS_DESCR STD_AXIS iMoeMesaf.me_sas UMR_NM__1_1_0_S6_S3 5 -2000 2000 DEPOSIT ABSOLUTE MONOTONY MON_INCREASE /end AXIS_DESCR
/end CHARACTERISTIC
/begin CHARACTERISTIC T_SYNPOMEPOS67 "Zeitkriterium fuer Schaltdruckoffset" VALUE 0x26DE58 kw_si16_S6_S3 5000 UMR_MSEC__10_1_0_S6_S3 -5000 0 /end CHARACTERISTIC
/begin CHARACTERISTIC KL_PORAKZU67 "Schaltdruckoffset" CURVE 0x25813C kl_si16_S6_S3 12.75 UMR_BAR__1_1000_0_S6_S3 -6.4 6.35
 /begin AXIS_DESCR STD_AXIS iSasZentr.iSchaltend.iKzu.timer_zkzu UMR_MSEC__10_1_0_S6_S3 3 0 2540 DEPOSIT ABSOLUTE MONOTONY MON_INCREASE /end AXIS_DESCR
/end CHARACTERISTIC
/begin CHARACTERISTIC KL_PORASYN67 "Rampe n.Syn.->letz.Stuetz.y PMAX" CURVE 0x25814C kl_si16_S6_S3 23 UMR_BAR__1_1000_0_S6_S3 0 23
 /begin AXIS_DESCR STD_AXIS iSasZentr.iSchaltend.iKzu.timer_zkzu UMR_MSEC__10_1_0_S6_S3 3 0 2540 DEPOSIT ABSOLUTE MONOTONY MON_INCREASE /end AXIS_DESCR
/end CHARACTERISTIC
/begin CHARACTERISTIC KL_POKZUMDMOTSOLL67 "Schaltdruckoffset in Abhaengigkeit von md_motsoll_sas" CURVE 0x25815C kl_si16_S6_S3 12.75 UMR_BAR__1_1000_0_S6_S3 -6.4 6.35
 /begin AXIS_DESCR STD_AXIS NO_INPUT_QUANTITY UMR_NM__1_1_0_S6_S3 6 -2000 2000 DEPOSIT ABSOLUTE MONOTONY MON_INCREASE /end AXIS_DESCR
/end CHARACTERISTIC
/begin CHARACTERISTIC KL_POKZUMDMOTSOLL67_EL "Schaltdruckoffset in Abhaengigkeit von md_motsoll_sas" CURVE 0x258178 kl_si16_S6_S3 12.75 UMR_BAR__1_1000_0_S6_S3 -6.4 6.35
 /begin AXIS_DESCR STD_AXIS NO_INPUT_QUANTITY UMR_NM__1_1_0_S6_S3 6 -2000 2000 DEPOSIT ABSOLUTE MONOTONY MON_INCREASE /end AXIS_DESCR
/end CHARACTERISTIC
/begin CHARACTERISTIC KL_PGRASYN67 "Schliessrampenradient" CURVE 0x258194 kl_si16_S6_S3 6553.4 UMR_BAR_SEC_1_10_0_S6_S3 -3276.7 3276.7
 /begin AXIS_DESCR STD_AXIS zff_atsys._.iSignale._.obj.sig_m_t UMR_NM__1_1_0_S6_S3 6 -400 1640 DEPOSIT ABSOLUTE MONOTONY MON_INCREASE /end AXIS_DESCR
/end CHARACTERISTIC
/begin CHARACTERISTIC KL_FPGRASYN67 "Faktor Schließrampengradient" CURVE 0x2581B0 kl_si16_S6_S3 50 UMR___1_10_0_S6_S3 0 50
 /begin AXIS_DESCR STD_AXIS iItfInput.ng_ab UMR_U_MINSEC_1_1_0_S6_S3 4 -5000 1000 DEPOSIT ABSOLUTE MONOTONY MON_INCREASE /end AXIS_DESCR
/end CHARACTERISTIC
/begin CHARACTERISTIC NGS_ABFLARE67 "Abtriebsdrehzahlgradientenschwelle" VALUE 0x26DE5A kw_si16_S6_S3 13200 UMR_U_MINSEC_1_1_0_S6_S3 -5000 8200 /end CHARACTERISTIC
/begin CHARACTERISTIC KL_POKZUFLARE67 "Sollschlupf abhaengiger Druckoffset zur Vermeidung von Flare" CURVE 0x2581C4 kl_si16_S6_S3 3 UMR_BAR__1_1000_0_S6_S3 0 3
 /begin AXIS_DESCR STD_AXIS iSasZentr.iSchaltend.nd_synistgang UMR_U_MIN_1_1_0_S6_S3 5 -8000 8000 DEPOSIT ABSOLUTE MONOTONY MON_INCREASE /end AXIS_DESCR
/end CHARACTERISTIC
/begin CHARACTERISTIC TO_VKZUSLST78 "Zeitoffset auf Verzögerung Schnellfüllung bei Schleppstart" VALUE 0x26E8E9 kw_ui8_S6_S3 90 UMR_MSEC__10_1_0_S6_S3 10 100 /end CHARACTERISTIC
/begin CHARACTERISTIC KL_POKZUNGAB78 "Druckoffset in Abhaengigkeit von ng_ab" CURVE 0x2581DC kl_si16_S6_S3 12.75 UMR_BAR__1_1000_0_S6_S3 -6.4 6.35
 /begin AXIS_DESCR STD_AXIS iItfInput.ng_ab UMR_U_MINSEC_1_1_0_S6_S3 4 -5000 1000 DEPOSIT ABSOLUTE MONOTONY MON_INCREASE /end AXIS_DESCR
/end CHARACTERISTIC
/begin CHARACTERISTIC KL_PGOFMT78 "Gradient Druckoffset Fuellphase" CURVE 0x2581F0 kl_si16_S6_S3 200 UMR_BAR_SEC_1_10_0_S6_S3 -100 100
 /begin AXIS_DESCR STD_AXIS zff_atsys._.iSignale._.obj.sig_m_t UMR_NM__1_1_0_S6_S3 4 -400 1640 DEPOSIT ABSOLUTE MONOTONY MON_INCREASE /end AXIS_DESCR
/end CHARACTERISTIC
/begin CHARACTERISTIC KL_POFMDMOTSOLL78 "Fuelldruckoffset f(Erhoehung Motorsollmoment)" CURVE 0x258204 kl_si16_S6_S3 12.75 UMR_BAR__1_1000_0_S6_S3 -6.4 6.35
 /begin AXIS_DESCR STD_AXIS NO_INPUT_QUANTITY UMR_NM__1_1_0_S6_S3 6 -2000 2000 DEPOSIT ABSOLUTE MONOTONY MON_INCREASE /end AXIS_DESCR
/end CHARACTERISTIC
/begin CHARACTERISTIC KL_POFMDMOTSOLL78_EL "Fuelldruckoffset f(Erhoehung Motorsollmoment)" CURVE 0x258220 kl_si16_S6_S3 12.75 UMR_BAR__1_1000_0_S6_S3 -6.4 6.35
 /begin AXIS_DESCR STD_AXIS NO_INPUT_QUANTITY UMR_NM__1_1_0_S6_S3 6 -2000 2000 DEPOSIT ABSOLUTE MONOTONY MON_INCREASE /end AXIS_DESCR
/end CHARACTERISTIC
/begin CHARACTERISTIC KL_FTRACG78 "Faktor auf Zeit für Rampe auf Schaltdruck" CURVE 0x25823C kl_ui8_S6_S3 1 UMR_PROZENT__1_100_0_S6_S3 1 2
 /begin AXIS_DESCR STD_AXIS zff_atsys._.iSignale._.obj.sig_c_getr UMR_GRADC__1_1_M40_S6_S3 4 -40 150 DEPOSIT ABSOLUTE MONOTONY MON_INCREASE /end AXIS_DESCR
/end CHARACTERISTIC
/begin CHARACTERISTIC T_RA2SSCHR78 "Zeit 2.Rampe bei Schrittschaltung" VALUE 0x26E8EA kw_ui8_S6_S3 2540 UMR_MSEC__10_1_0_S6_S3 0 2540 /end CHARACTERISTIC
/begin CHARACTERISTIC T_SYN78 "Verweilzeit in Synchron zum Start Max.Rampe" VALUE 0x26E8EB kw_ui8_S6_S3 2540 UMR_MSEC__10_1_0_S6_S3 0 2540 /end CHARACTERISTIC
/begin CHARACTERISTIC T_KORHSZEIT78 "Korrekturwert fur Schaltverzugberechnung" VALUE 0x26E8EC kw_ui8_S6_S3 2000 UMR_MSEC__10_1_M128_S6_S3 -1000 1000 /end CHARACTERISTIC
/begin CHARACTERISTIC KF_POFMTCG78 "Fülldruckoffset" MAP 0x258248 kf_si16_S6_S3 12.75 UMR_BAR__1_1000_0_S6_S3 -6.4 6.35
 /begin AXIS_DESCR STD_AXIS zff_atsys._.iSignale._.obj.sig_m_t UMR_NM__1_1_0_S6_S3 2 -400 1640 DEPOSIT ABSOLUTE MONOTONY MON_INCREASE /end AXIS_DESCR
 /begin AXIS_DESCR STD_AXIS zff_atsys._.iSignale._.obj.sig_c_getr UMR_GRADC__1_1_M40_S6_S3 10 -40 150 DEPOSIT ABSOLUTE MONOTONY MON_INCREASE /end AXIS_DESCR
/end CHARACTERISTIC
/begin CHARACTERISTIC KF_POFMTCG78_EL "Fülldruckoffset" MAP 0x258290 kf_si16_S6_S3 12.75 UMR_BAR__1_1000_0_S6_S3 -6.4 6.35
 /begin AXIS_DESCR STD_AXIS zff_atsys._.iSignale._.obj.sig_m_t UMR_NM__1_1_0_S6_S3 2 -400 1640 DEPOSIT ABSOLUTE MONOTONY MON_INCREASE /end AXIS_DESCR
 /begin AXIS_DESCR STD_AXIS zff_atsys._.iSignale._.obj.sig_c_getr UMR_GRADC__1_1_M40_S6_S3 10 -40 150 DEPOSIT ABSOLUTE MONOTONY MON_INCREASE /end AXIS_DESCR
/end CHARACTERISTIC
/begin CHARACTERISTIC KL_POKZUMEPOS78 "Schaltdruckoffset f(Momentenerhoehung)" CURVE 0x2582D8 kl_si16_S6_S3 12.75 UMR_BAR__1_1000_0_S6_S3 0 12.75
 /begin AXIS_DESCR STD_AXIS iMoeMesaf.me_sas UMR_NM__1_1_0_S6_S3 5 -2000 2000 DEPOSIT ABSOLUTE MONOTONY MON_INCREASE /end AXIS_DESCR
/end CHARACTERISTIC
/begin CHARACTERISTIC T_SYNPOMEPOS78 "Zeitkriterium fuer Schaltdruckoffset" VALUE 0x26DE5C kw_si16_S6_S3 5000 UMR_MSEC__10_1_0_S6_S3 -5000 0 /end CHARACTERISTIC
/begin CHARACTERISTIC KL_PORAKZU78 "Schaltdruckoffset" CURVE 0x2582F0 kl_si16_S6_S3 12.75 UMR_BAR__1_1000_0_S6_S3 -6.4 6.35
 /begin AXIS_DESCR STD_AXIS iSasZentr.iSchaltend.iKzu.timer_zkzu UMR_MSEC__10_1_0_S6_S3 3 0 2540 DEPOSIT ABSOLUTE MONOTONY MON_INCREASE /end AXIS_DESCR
/end CHARACTERISTIC
/begin CHARACTERISTIC KL_PORASYN78 "Rampe n.Syn.->letz.Stuetz.y PMAX" CURVE 0x258300 kl_si16_S6_S3 23 UMR_BAR__1_1000_0_S6_S3 0 23
 /begin AXIS_DESCR STD_AXIS iSasZentr.iSchaltend.iKzu.timer_zkzu UMR_MSEC__10_1_0_S6_S3 3 0 2540 DEPOSIT ABSOLUTE MONOTONY MON_INCREASE /end AXIS_DESCR
/end CHARACTERISTIC
/begin CHARACTERISTIC KL_POKZUMDMOTSOLL78 "Schaltdruckoffset in Abhaengigkeit von md_motsoll_sas" CURVE 0x258310 kl_si16_S6_S3 12.75 UMR_BAR__1_1000_0_S6_S3 -6.4 6.35
 /begin AXIS_DESCR STD_AXIS NO_INPUT_QUANTITY UMR_NM__1_1_0_S6_S3 6 -2000 2000 DEPOSIT ABSOLUTE MONOTONY MON_INCREASE /end AXIS_DESCR
/end CHARACTERISTIC
/begin CHARACTERISTIC KL_POKZUMDMOTSOLL78_EL "Schaltdruckoffset in Abhaengigkeit von md_motsoll_sas" CURVE 0x25832C kl_si16_S6_S3 12.75 UMR_BAR__1_1000_0_S6_S3 -6.4 6.35
 /begin AXIS_DESCR STD_AXIS NO_INPUT_QUANTITY UMR_NM__1_1_0_S6_S3 6 -2000 2000 DEPOSIT ABSOLUTE MONOTONY MON_INCREASE /end AXIS_DESCR
/end CHARACTERISTIC
/begin CHARACTERISTIC KL_PGRASYN78 "Schliessrampenradient" CURVE 0x258348 kl_si16_S6_S3 6553.4 UMR_BAR_SEC_1_10_0_S6_S3 -3276.7 3276.7
 /begin AXIS_DESCR STD_AXIS zff_atsys._.iSignale._.obj.sig_m_t UMR_NM__1_1_0_S6_S3 6 -400 1640 DEPOSIT ABSOLUTE MONOTONY MON_INCREASE /end AXIS_DESCR
/end CHARACTERISTIC
/begin CHARACTERISTIC KL_FPGRASYN78 "Faktor Schließrampengradient" CURVE 0x258364 kl_si16_S6_S3 50 UMR___1_10_0_S6_S3 0 50
 /begin AXIS_DESCR STD_AXIS iItfInput.ng_ab UMR_U_MINSEC_1_1_0_S6_S3 4 -5000 1000 DEPOSIT ABSOLUTE MONOTONY MON_INCREASE /end AXIS_DESCR
/end CHARACTERISTIC
/begin CHARACTERISTIC NGS_ABFLARE78 "Abtriebsdrehzahlgradientenschwelle" VALUE 0x26DE5E kw_si16_S6_S3 13200 UMR_U_MINSEC_1_1_0_S6_S3 -5000 8200 /end CHARACTERISTIC
/begin CHARACTERISTIC KL_POKZUFLARE78 "Sollschlupf abhaengiger Druckoffset zur Vermeidung von Flare" CURVE 0x258378 kl_si16_S6_S3 3 UMR_BAR__1_1000_0_S6_S3 0 3
 /begin AXIS_DESCR STD_AXIS iSasZentr.iSchaltend.nd_synistgang UMR_U_MIN_1_1_0_S6_S3 5 -8000 8000 DEPOSIT ABSOLUTE MONOTONY MON_INCREASE /end AXIS_DESCR
/end CHARACTERISTIC
/begin CHARACTERISTIC TO_VKZUSLST13 "Zeitoffset auf Verzögerung Schnellfüllung bei Schleppstart" VALUE 0x26E8ED kw_ui8_S6_S3 90 UMR_MSEC__10_1_0_S6_S3 10 100 /end CHARACTERISTIC
/begin CHARACTERISTIC KL_POKZUNGAB13 "Druckoffset in Abhaengigkeit von ng_ab" CURVE 0x258390 kl_si16_S6_S3 12.75 UMR_BAR__1_1000_0_S6_S3 -6.4 6.35
 /begin AXIS_DESCR STD_AXIS iItfInput.ng_ab UMR_U_MINSEC_1_1_0_S6_S3 4 -5000 1000 DEPOSIT ABSOLUTE MONOTONY MON_INCREASE /end AXIS_DESCR
/end CHARACTERISTIC
/begin CHARACTERISTIC KL_PGOFMT13 "Gradient Druckoffset Fuellphase" CURVE 0x2583A4 kl_si16_S6_S3 200 UMR_BAR_SEC_1_10_0_S6_S3 -100 100
 /begin AXIS_DESCR STD_AXIS zff_atsys._.iSignale._.obj.sig_m_t UMR_NM__1_1_0_S6_S3 4 -400 1640 DEPOSIT ABSOLUTE MONOTONY MON_INCREASE /end AXIS_DESCR
/end CHARACTERISTIC
/begin CHARACTERISTIC KL_POFMDMOTSOLL13 "Fuelldruckoffset f(Erhoehung Motorsollmoment)" CURVE 0x2583B8 kl_si16_S6_S3 12.75 UMR_BAR__1_1000_0_S6_S3 -6.4 6.35
 /begin AXIS_DESCR STD_AXIS NO_INPUT_QUANTITY UMR_NM__1_1_0_S6_S3 6 -2000 2000 DEPOSIT ABSOLUTE MONOTONY MON_INCREASE /end AXIS_DESCR
/end CHARACTERISTIC
/begin CHARACTERISTIC KL_FTRACG13 "Faktor auf Zeit für Rampe auf Schaltdruck" CURVE 0x2583D4 kl_ui8_S6_S3 1 UMR_PROZENT__1_100_0_S6_S3 1 2
 /begin AXIS_DESCR STD_AXIS zff_atsys._.iSignale._.obj.sig_c_getr UMR_GRADC__1_1_M40_S6_S3 4 -40 150 DEPOSIT ABSOLUTE MONOTONY MON_INCREASE /end AXIS_DESCR
/end CHARACTERISTIC
/begin CHARACTERISTIC T_RA2SSCHR13 "Zeit 2.Rampe bei Schrittschaltung" VALUE 0x26E8EE kw_ui8_S6_S3 2540 UMR_MSEC__10_1_0_S6_S3 0 2540 /end CHARACTERISTIC
/begin CHARACTERISTIC T_SYN13 "Verweilzeit in Synchron zum Start Max.Rampe" VALUE 0x26E8EF kw_ui8_S6_S3 2540 UMR_MSEC__10_1_0_S6_S3 0 2540 /end CHARACTERISTIC
/begin CHARACTERISTIC T_KORHSZEIT13 "Korrekturwert fur Schaltverzugberechnung" VALUE 0x26E8F0 kw_ui8_S6_S3 2000 UMR_MSEC__10_1_M128_S6_S3 -1000 1000 /end CHARACTERISTIC
/begin CHARACTERISTIC KF_POFMTCG13 "Fülldruckoffset" MAP 0x2583E0 kf_si16_S6_S3 12.75 UMR_BAR__1_1000_0_S6_S3 -6.4 6.35
 /begin AXIS_DESCR STD_AXIS zff_atsys._.iSignale._.obj.sig_m_t UMR_NM__1_1_0_S6_S3 2 -400 1640 DEPOSIT ABSOLUTE MONOTONY MON_INCREASE /end AXIS_DESCR
 /begin AXIS_DESCR STD_AXIS zff_atsys._.iSignale._.obj.sig_c_getr UMR_GRADC__1_1_M40_S6_S3 10 -40 150 DEPOSIT ABSOLUTE MONOTONY MON_INCREASE /end AXIS_DESCR
/end CHARACTERISTIC
/begin CHARACTERISTIC KL_POKZUMEPOS13 "Schaltdruckoffset f(Momentenerhoehung)" CURVE 0x258428 kl_si16_S6_S3 12.75 UMR_BAR__1_1000_0_S6_S3 0 12.75
 /begin AXIS_DESCR STD_AXIS iMoeMesaf.me_sas UMR_NM__1_1_0_S6_S3 5 -2000 2000 DEPOSIT ABSOLUTE MONOTONY MON_INCREASE /end AXIS_DESCR
/end CHARACTERISTIC
/begin CHARACTERISTIC T_SYNPOMEPOS13 "Zeitkriterium fuer Schaltdruckoffset" VALUE 0x26DE60 kw_si16_S6_S3 5000 UMR_MSEC__10_1_0_S6_S3 -5000 0 /end CHARACTERISTIC
/begin CHARACTERISTIC KL_PORAKZU13 "Schaltdruckoffset" CURVE 0x258440 kl_si16_S6_S3 12.75 UMR_BAR__1_1000_0_S6_S3 -6.4 6.35
 /begin AXIS_DESCR STD_AXIS iSasZentr.iSchaltend.iKzu.timer_zkzu UMR_MSEC__10_1_0_S6_S3 3 0 2540 DEPOSIT ABSOLUTE MONOTONY MON_INCREASE /end AXIS_DESCR
/end CHARACTERISTIC
/begin CHARACTERISTIC KL_PORASYN13 "Rampe n.Syn.->letz.Stuetz.y PMAX" CURVE 0x258450 kl_si16_S6_S3 23 UMR_BAR__1_1000_0_S6_S3 0 23
 /begin AXIS_DESCR STD_AXIS iSasZentr.iSchaltend.iKzu.timer_zkzu UMR_MSEC__10_1_0_S6_S3 3 0 2540 DEPOSIT ABSOLUTE MONOTONY MON_INCREASE /end AXIS_DESCR
/end CHARACTERISTIC
/begin CHARACTERISTIC KL_POKZUMDMOTSOLL13 "Schaltdruckoffset in Abhaengigkeit von md_motsoll_sas" CURVE 0x258460 kl_si16_S6_S3 12.75 UMR_BAR__1_1000_0_S6_S3 -6.4 6.35
 /begin AXIS_DESCR STD_AXIS NO_INPUT_QUANTITY UMR_NM__1_1_0_S6_S3 6 -2000 2000 DEPOSIT ABSOLUTE MONOTONY MON_INCREASE /end AXIS_DESCR
/end CHARACTERISTIC
/begin CHARACTERISTIC KL_PGRASYN13 "Schliessrampenradient" CURVE 0x25847C kl_si16_S6_S3 6553.4 UMR_BAR_SEC_1_10_0_S6_S3 -3276.7 3276.7
 /begin AXIS_DESCR STD_AXIS zff_atsys._.iSignale._.obj.sig_m_t UMR_NM__1_1_0_S6_S3 6 -400 1640 DEPOSIT ABSOLUTE MONOTONY MON_INCREASE /end AXIS_DESCR
/end CHARACTERISTIC
/begin CHARACTERISTIC KL_FPGRASYN13 "Faktor Schließrampengradient" CURVE 0x258498 kl_si16_S6_S3 50 UMR___1_10_0_S6_S3 0 50
 /begin AXIS_DESCR STD_AXIS iItfInput.ng_ab UMR_U_MINSEC_1_1_0_S6_S3 4 -5000 1000 DEPOSIT ABSOLUTE MONOTONY MON_INCREASE /end AXIS_DESCR
/end CHARACTERISTIC
/begin CHARACTERISTIC NGS_ABFLARE13 "Abtriebsdrehzahlgradientenschwelle" VALUE 0x26DE62 kw_si16_S6_S3 13200 UMR_U_MINSEC_1_1_0_S6_S3 -5000 8200 /end CHARACTERISTIC
/begin CHARACTERISTIC KL_POKZUFLARE13 "Sollschlupf abhaengiger Druckoffset zur Vermeidung von Flare" CURVE 0x2584AC kl_si16_S6_S3 3 UMR_BAR__1_1000_0_S6_S3 0 3
 /begin AXIS_DESCR STD_AXIS iSasZentr.iSchaltend.nd_synistgang UMR_U_MIN_1_1_0_S6_S3 5 -8000 8000 DEPOSIT ABSOLUTE MONOTONY MON_INCREASE /end AXIS_DESCR
/end CHARACTERISTIC
/begin CHARACTERISTIC TO_VKZUSLST24 "Zeitoffset auf Verzögerung Schnellfüllung bei Schleppstart" VALUE 0x26E8F1 kw_ui8_S6_S3 90 UMR_MSEC__10_1_0_S6_S3 10 100 /end CHARACTERISTIC
/begin CHARACTERISTIC KL_POKZUNGAB24 "Druckoffset in Abhaengigkeit von ng_ab" CURVE 0x2584C4 kl_si16_S6_S3 12.75 UMR_BAR__1_1000_0_S6_S3 -6.4 6.35
 /begin AXIS_DESCR STD_AXIS iItfInput.ng_ab UMR_U_MINSEC_1_1_0_S6_S3 4 -5000 1000 DEPOSIT ABSOLUTE MONOTONY MON_INCREASE /end AXIS_DESCR
/end CHARACTERISTIC
/begin CHARACTERISTIC KL_PGOFMT24 "Gradient Druckoffset Fuellphase" CURVE 0x2584D8 kl_si16_S6_S3 200 UMR_BAR_SEC_1_10_0_S6_S3 -100 100
 /begin AXIS_DESCR STD_AXIS zff_atsys._.iSignale._.obj.sig_m_t UMR_NM__1_1_0_S6_S3 4 -400 1640 DEPOSIT ABSOLUTE MONOTONY MON_INCREASE /end AXIS_DESCR
/end CHARACTERISTIC
/begin CHARACTERISTIC KL_POFMDMOTSOLL24 "Fuelldruckoffset f(Erhoehung Motorsollmoment)" CURVE 0x2584EC kl_si16_S6_S3 12.75 UMR_BAR__1_1000_0_S6_S3 -6.4 6.35
 /begin AXIS_DESCR STD_AXIS NO_INPUT_QUANTITY UMR_NM__1_1_0_S6_S3 6 -2000 2000 DEPOSIT ABSOLUTE MONOTONY MON_INCREASE /end AXIS_DESCR
/end CHARACTERISTIC
/begin CHARACTERISTIC KL_FTRACG24 "Faktor auf Zeit für Rampe auf Schaltdruck" CURVE 0x258508 kl_ui8_S6_S3 1 UMR_PROZENT__1_100_0_S6_S3 1 2
 /begin AXIS_DESCR STD_AXIS zff_atsys._.iSignale._.obj.sig_c_getr UMR_GRADC__1_1_M40_S6_S3 4 -40 150 DEPOSIT ABSOLUTE MONOTONY MON_INCREASE /end AXIS_DESCR
/end CHARACTERISTIC
/begin CHARACTERISTIC T_RA2SSCHR24 "Zeit 2.Rampe bei Schrittschaltung" VALUE 0x26E8F2 kw_ui8_S6_S3 2540 UMR_MSEC__10_1_0_S6_S3 0 2540 /end CHARACTERISTIC
/begin CHARACTERISTIC T_SYN24 "Verweilzeit in Synchron zum Start Max.Rampe" VALUE 0x26E8F3 kw_ui8_S6_S3 2540 UMR_MSEC__10_1_0_S6_S3 0 2540 /end CHARACTERISTIC
/begin CHARACTERISTIC T_KORHSZEIT24 "Korrekturwert fur Schaltverzugberechnung" VALUE 0x26E8F4 kw_ui8_S6_S3 2000 UMR_MSEC__10_1_M128_S6_S3 -1000 1000 /end CHARACTERISTIC
/begin CHARACTERISTIC KF_POFMTCG24 "Fülldruckoffset" MAP 0x258514 kf_si16_S6_S3 12.75 UMR_BAR__1_1000_0_S6_S3 -6.4 6.35
 /begin AXIS_DESCR STD_AXIS zff_atsys._.iSignale._.obj.sig_m_t UMR_NM__1_1_0_S6_S3 2 -400 1640 DEPOSIT ABSOLUTE MONOTONY MON_INCREASE /end AXIS_DESCR
 /begin AXIS_DESCR STD_AXIS zff_atsys._.iSignale._.obj.sig_c_getr UMR_GRADC__1_1_M40_S6_S3 10 -40 150 DEPOSIT ABSOLUTE MONOTONY MON_INCREASE /end AXIS_DESCR
/end CHARACTERISTIC
/begin CHARACTERISTIC KL_POKZUMEPOS24 "Schaltdruckoffset f(Momentenerhoehung)" CURVE 0x25855C kl_si16_S6_S3 12.75 UMR_BAR__1_1000_0_S6_S3 0 12.75
 /begin AXIS_DESCR STD_AXIS iMoeMesaf.me_sas UMR_NM__1_1_0_S6_S3 5 -2000 2000 DEPOSIT ABSOLUTE MONOTONY MON_INCREASE /end AXIS_DESCR
/end CHARACTERISTIC
/begin CHARACTERISTIC T_SYNPOMEPOS24 "Zeitkriterium fuer Schaltdruckoffset" VALUE 0x26DE64 kw_si16_S6_S3 5000 UMR_MSEC__10_1_0_S6_S3 -5000 0 /end CHARACTERISTIC
/begin CHARACTERISTIC KL_PORAKZU24 "Schaltdruckoffset" CURVE 0x258574 kl_si16_S6_S3 12.75 UMR_BAR__1_1000_0_S6_S3 -6.4 6.35
 /begin AXIS_DESCR STD_AXIS iSasZentr.iSchaltend.iKzu.timer_zkzu UMR_MSEC__10_1_0_S6_S3 3 0 2540 DEPOSIT ABSOLUTE MONOTONY MON_INCREASE /end AXIS_DESCR
/end CHARACTERISTIC
/begin CHARACTERISTIC KL_PORASYN24 "Rampe n.Syn.->letz.Stuetz.y PMAX" CURVE 0x258584 kl_si16_S6_S3 23 UMR_BAR__1_1000_0_S6_S3 0 23
 /begin AXIS_DESCR STD_AXIS iSasZentr.iSchaltend.iKzu.timer_zkzu UMR_MSEC__10_1_0_S6_S3 3 0 2540 DEPOSIT ABSOLUTE MONOTONY MON_INCREASE /end AXIS_DESCR
/end CHARACTERISTIC
/begin CHARACTERISTIC KL_POKZUMDMOTSOLL24 "Schaltdruckoffset in Abhaengigkeit von md_motsoll_sas" CURVE 0x258594 kl_si16_S6_S3 12.75 UMR_BAR__1_1000_0_S6_S3 -6.4 6.35
 /begin AXIS_DESCR STD_AXIS NO_INPUT_QUANTITY UMR_NM__1_1_0_S6_S3 6 -2000 2000 DEPOSIT ABSOLUTE MONOTONY MON_INCREASE /end AXIS_DESCR
/end CHARACTERISTIC
/begin CHARACTERISTIC KL_PGRASYN24 "Schliessrampenradient" CURVE 0x2585B0 kl_si16_S6_S3 6553.4 UMR_BAR_SEC_1_10_0_S6_S3 -3276.7 3276.7
 /begin AXIS_DESCR STD_AXIS zff_atsys._.iSignale._.obj.sig_m_t UMR_NM__1_1_0_S6_S3 6 -400 1640 DEPOSIT ABSOLUTE MONOTONY MON_INCREASE /end AXIS_DESCR
/end CHARACTERISTIC
/begin CHARACTERISTIC KL_FPGRASYN24 "Faktor Schließrampengradient" CURVE 0x2585CC kl_si16_S6_S3 50 UMR___1_10_0_S6_S3 0 50
 /begin AXIS_DESCR STD_AXIS iItfInput.ng_ab UMR_U_MINSEC_1_1_0_S6_S3 4 -5000 1000 DEPOSIT ABSOLUTE MONOTONY MON_INCREASE /end AXIS_DESCR
/end CHARACTERISTIC
/begin CHARACTERISTIC NGS_ABFLARE24 "Abtriebsdrehzahlgradientenschwelle" VALUE 0x26DE66 kw_si16_S6_S3 13200 UMR_U_MINSEC_1_1_0_S6_S3 -5000 8200 /end CHARACTERISTIC
/begin CHARACTERISTIC KL_POKZUFLARE24 "Sollschlupf abhaengiger Druckoffset zur Vermeidung von Flare" CURVE 0x2585E0 kl_si16_S6_S3 3 UMR_BAR__1_1000_0_S6_S3 0 3
 /begin AXIS_DESCR STD_AXIS iSasZentr.iSchaltend.nd_synistgang UMR_U_MIN_1_1_0_S6_S3 5 -8000 8000 DEPOSIT ABSOLUTE MONOTONY MON_INCREASE /end AXIS_DESCR
/end CHARACTERISTIC
/begin CHARACTERISTIC TO_VKZUSLST35 "Zeitoffset auf Verzögerung Schnellfüllung bei Schleppstart" VALUE 0x26E8F5 kw_ui8_S6_S3 90 UMR_MSEC__10_1_0_S6_S3 10 100 /end CHARACTERISTIC
/begin CHARACTERISTIC KL_POKZUNGAB35 "Druckoffset in Abhaengigkeit von ng_ab" CURVE 0x2585F8 kl_si16_S6_S3 12.75 UMR_BAR__1_1000_0_S6_S3 -6.4 6.35
 /begin AXIS_DESCR STD_AXIS iItfInput.ng_ab UMR_U_MINSEC_1_1_0_S6_S3 4 -5000 1000 DEPOSIT ABSOLUTE MONOTONY MON_INCREASE /end AXIS_DESCR
/end CHARACTERISTIC
/begin CHARACTERISTIC KL_PGOFMT35 "Gradient Druckoffset Fuellphase" CURVE 0x25860C kl_si16_S6_S3 200 UMR_BAR_SEC_1_10_0_S6_S3 -100 100
 /begin AXIS_DESCR STD_AXIS zff_atsys._.iSignale._.obj.sig_m_t UMR_NM__1_1_0_S6_S3 4 -400 1640 DEPOSIT ABSOLUTE MONOTONY MON_INCREASE /end AXIS_DESCR
/end CHARACTERISTIC
/begin CHARACTERISTIC KL_POFMDMOTSOLL35 "Fuelldruckoffset f(Erhoehung Motorsollmoment)" CURVE 0x258620 kl_si16_S6_S3 12.75 UMR_BAR__1_1000_0_S6_S3 -6.4 6.35
 /begin AXIS_DESCR STD_AXIS NO_INPUT_QUANTITY UMR_NM__1_1_0_S6_S3 6 -2000 2000 DEPOSIT ABSOLUTE MONOTONY MON_INCREASE /end AXIS_DESCR
/end CHARACTERISTIC
/begin CHARACTERISTIC KL_FTRACG35 "Faktor auf Zeit für Rampe auf Schaltdruck" CURVE 0x25863C kl_ui8_S6_S3 1 UMR_PROZENT__1_100_0_S6_S3 1 2
 /begin AXIS_DESCR STD_AXIS zff_atsys._.iSignale._.obj.sig_c_getr UMR_GRADC__1_1_M40_S6_S3 4 -40 150 DEPOSIT ABSOLUTE MONOTONY MON_INCREASE /end AXIS_DESCR
/end CHARACTERISTIC
/begin CHARACTERISTIC T_RA2SSCHR35 "Zeit 2.Rampe bei Schrittschaltung" VALUE 0x26E8F6 kw_ui8_S6_S3 2540 UMR_MSEC__10_1_0_S6_S3 0 2540 /end CHARACTERISTIC
/begin CHARACTERISTIC T_SYN35 "Verweilzeit in Synchron zum Start Max.Rampe" VALUE 0x26E8F7 kw_ui8_S6_S3 2540 UMR_MSEC__10_1_0_S6_S3 0 2540 /end CHARACTERISTIC
/begin CHARACTERISTIC T_KORHSZEIT35 "Korrekturwert fur Schaltverzugberechnung" VALUE 0x26E8F8 kw_ui8_S6_S3 2000 UMR_MSEC__10_1_M128_S6_S3 -1000 1000 /end CHARACTERISTIC
/begin CHARACTERISTIC KF_POFMTCG35 "Fülldruckoffset" MAP 0x258648 kf_si16_S6_S3 12.75 UMR_BAR__1_1000_0_S6_S3 -6.4 6.35
 /begin AXIS_DESCR STD_AXIS zff_atsys._.iSignale._.obj.sig_m_t UMR_NM__1_1_0_S6_S3 2 -400 1640 DEPOSIT ABSOLUTE MONOTONY MON_INCREASE /end AXIS_DESCR
 /begin AXIS_DESCR STD_AXIS zff_atsys._.iSignale._.obj.sig_c_getr UMR_GRADC__1_1_M40_S6_S3 10 -40 150 DEPOSIT ABSOLUTE MONOTONY MON_INCREASE /end AXIS_DESCR
/end CHARACTERISTIC
/begin CHARACTERISTIC KL_POKZUMEPOS35 "Schaltdruckoffset f(Momentenerhoehung)" CURVE 0x258690 kl_si16_S6_S3 12.75 UMR_BAR__1_1000_0_S6_S3 0 12.75
 /begin AXIS_DESCR STD_AXIS iMoeMesaf.me_sas UMR_NM__1_1_0_S6_S3 5 -2000 2000 DEPOSIT ABSOLUTE MONOTONY MON_INCREASE /end AXIS_DESCR
/end CHARACTERISTIC
/begin CHARACTERISTIC T_SYNPOMEPOS35 "Zeitkriterium fuer Schaltdruckoffset" VALUE 0x26DE68 kw_si16_S6_S3 5000 UMR_MSEC__10_1_0_S6_S3 -5000 0 /end CHARACTERISTIC
/begin CHARACTERISTIC KL_PORAKZU35 "Schaltdruckoffset" CURVE 0x2586A8 kl_si16_S6_S3 12.75 UMR_BAR__1_1000_0_S6_S3 -6.4 6.35
 /begin AXIS_DESCR STD_AXIS iSasZentr.iSchaltend.iKzu.timer_zkzu UMR_MSEC__10_1_0_S6_S3 3 0 2540 DEPOSIT ABSOLUTE MONOTONY MON_INCREASE /end AXIS_DESCR
/end CHARACTERISTIC
/begin CHARACTERISTIC KL_PORASYN35 "Rampe n.Syn.->letz.Stuetz.y PMAX" CURVE 0x2586B8 kl_si16_S6_S3 23 UMR_BAR__1_1000_0_S6_S3 0 23
 /begin AXIS_DESCR STD_AXIS iSasZentr.iSchaltend.iKzu.timer_zkzu UMR_MSEC__10_1_0_S6_S3 3 0 2540 DEPOSIT ABSOLUTE MONOTONY MON_INCREASE /end AXIS_DESCR
/end CHARACTERISTIC
/begin CHARACTERISTIC KL_POKZUMDMOTSOLL35 "Schaltdruckoffset in Abhaengigkeit von md_motsoll_sas" CURVE 0x2586C8 kl_si16_S6_S3 12.75 UMR_BAR__1_1000_0_S6_S3 -6.4 6.35
 /begin AXIS_DESCR STD_AXIS NO_INPUT_QUANTITY UMR_NM__1_1_0_S6_S3 6 -2000 2000 DEPOSIT ABSOLUTE MONOTONY MON_INCREASE /end AXIS_DESCR
/end CHARACTERISTIC
/begin CHARACTERISTIC KL_PGRASYN35 "Schliessrampenradient" CURVE 0x2586E4 kl_si16_S6_S3 6553.4 UMR_BAR_SEC_1_10_0_S6_S3 -3276.7 3276.7
 /begin AXIS_DESCR STD_AXIS zff_atsys._.iSignale._.obj.sig_m_t UMR_NM__1_1_0_S6_S3 6 -400 1640 DEPOSIT ABSOLUTE MONOTONY MON_INCREASE /end AXIS_DESCR
/end CHARACTERISTIC
/begin CHARACTERISTIC KL_FPGRASYN35 "Faktor Schließrampengradient" CURVE 0x258700 kl_si16_S6_S3 50 UMR___1_10_0_S6_S3 0 50
 /begin AXIS_DESCR STD_AXIS iItfInput.ng_ab UMR_U_MINSEC_1_1_0_S6_S3 4 -5000 1000 DEPOSIT ABSOLUTE MONOTONY MON_INCREASE /end AXIS_DESCR
/end CHARACTERISTIC
/begin CHARACTERISTIC NGS_ABFLARE35 "Abtriebsdrehzahlgradientenschwelle" VALUE 0x26DE6A kw_si16_S6_S3 13200 UMR_U_MINSEC_1_1_0_S6_S3 -5000 8200 /end CHARACTERISTIC
/begin CHARACTERISTIC KL_POKZUFLARE35 "Sollschlupf abhaengiger Druckoffset zur Vermeidung von Flare" CURVE 0x258714 kl_si16_S6_S3 3 UMR_BAR__1_1000_0_S6_S3 0 3
 /begin AXIS_DESCR STD_AXIS iSasZentr.iSchaltend.nd_synistgang UMR_U_MIN_1_1_0_S6_S3 5 -8000 8000 DEPOSIT ABSOLUTE MONOTONY MON_INCREASE /end AXIS_DESCR
/end CHARACTERISTIC
/begin CHARACTERISTIC TO_VKZUSLST46 "Zeitoffset auf Verzögerung Schnellfüllung bei Schleppstart" VALUE 0x26E8F9 kw_ui8_S6_S3 90 UMR_MSEC__10_1_0_S6_S3 10 100 /end CHARACTERISTIC
/begin CHARACTERISTIC KL_POKZUNGAB46 "Druckoffset in Abhaengigkeit von ng_ab" CURVE 0x25872C kl_si16_S6_S3 12.75 UMR_BAR__1_1000_0_S6_S3 -6.4 6.35
 /begin AXIS_DESCR STD_AXIS iItfInput.ng_ab UMR_U_MINSEC_1_1_0_S6_S3 4 -5000 1000 DEPOSIT ABSOLUTE MONOTONY MON_INCREASE /end AXIS_DESCR
/end CHARACTERISTIC
/begin CHARACTERISTIC KL_PGOFMT46 "Gradient Druckoffset Fuellphase" CURVE 0x258740 kl_si16_S6_S3 200 UMR_BAR_SEC_1_10_0_S6_S3 -100 100
 /begin AXIS_DESCR STD_AXIS zff_atsys._.iSignale._.obj.sig_m_t UMR_NM__1_1_0_S6_S3 4 -400 1640 DEPOSIT ABSOLUTE MONOTONY MON_INCREASE /end AXIS_DESCR
/end CHARACTERISTIC
/begin CHARACTERISTIC KL_POFMDMOTSOLL46 "Fuelldruckoffset f(Erhoehung Motorsollmoment)" CURVE 0x258754 kl_si16_S6_S3 12.75 UMR_BAR__1_1000_0_S6_S3 -6.4 6.35
 /begin AXIS_DESCR STD_AXIS NO_INPUT_QUANTITY UMR_NM__1_1_0_S6_S3 6 -2000 2000 DEPOSIT ABSOLUTE MONOTONY MON_INCREASE /end AXIS_DESCR
/end CHARACTERISTIC
/begin CHARACTERISTIC KL_FTRACG46 "Faktor auf Zeit für Rampe auf Schaltdruck" CURVE 0x258770 kl_ui8_S6_S3 1 UMR_PROZENT__1_100_0_S6_S3 1 2
 /begin AXIS_DESCR STD_AXIS zff_atsys._.iSignale._.obj.sig_c_getr UMR_GRADC__1_1_M40_S6_S3 4 -40 150 DEPOSIT ABSOLUTE MONOTONY MON_INCREASE /end AXIS_DESCR
/end CHARACTERISTIC
/begin CHARACTERISTIC T_RA2SSCHR46 "Zeit 2.Rampe bei Schrittschaltung" VALUE 0x26E8FA kw_ui8_S6_S3 2540 UMR_MSEC__10_1_0_S6_S3 0 2540 /end CHARACTERISTIC
/begin CHARACTERISTIC T_SYN46 "Verweilzeit in Synchron zum Start Max.Rampe" VALUE 0x26E8FB kw_ui8_S6_S3 2540 UMR_MSEC__10_1_0_S6_S3 0 2540 /end CHARACTERISTIC
/begin CHARACTERISTIC T_KORHSZEIT46 "Korrekturwert fur Schaltverzugberechnung" VALUE 0x26E8FC kw_ui8_S6_S3 2000 UMR_MSEC__10_1_M128_S6_S3 -1000 1000 /end CHARACTERISTIC
/begin CHARACTERISTIC KF_POFMTCG46 "Fülldruckoffset" MAP 0x25877C kf_si16_S6_S3 12.75 UMR_BAR__1_1000_0_S6_S3 -6.4 6.35
 /begin AXIS_DESCR STD_AXIS zff_atsys._.iSignale._.obj.sig_m_t UMR_NM__1_1_0_S6_S3 2 -400 1640 DEPOSIT ABSOLUTE MONOTONY MON_INCREASE /end AXIS_DESCR
 /begin AXIS_DESCR STD_AXIS zff_atsys._.iSignale._.obj.sig_c_getr UMR_GRADC__1_1_M40_S6_S3 10 -40 150 DEPOSIT ABSOLUTE MONOTONY MON_INCREASE /end AXIS_DESCR
/end CHARACTERISTIC
/begin CHARACTERISTIC KL_POKZUMEPOS46 "Schaltdruckoffset f(Momentenerhoehung)" CURVE 0x2587C4 kl_si16_S6_S3 12.75 UMR_BAR__1_1000_0_S6_S3 0 12.75
 /begin AXIS_DESCR STD_AXIS iMoeMesaf.me_sas UMR_NM__1_1_0_S6_S3 5 -2000 2000 DEPOSIT ABSOLUTE MONOTONY MON_INCREASE /end AXIS_DESCR
/end CHARACTERISTIC
/begin CHARACTERISTIC T_SYNPOMEPOS46 "Zeitkriterium fuer Schaltdruckoffset" VALUE 0x26DE6C kw_si16_S6_S3 5000 UMR_MSEC__10_1_0_S6_S3 -5000 0 /end CHARACTERISTIC
/begin CHARACTERISTIC KL_PORAKZU46 "Schaltdruckoffset" CURVE 0x2587DC kl_si16_S6_S3 12.75 UMR_BAR__1_1000_0_S6_S3 -6.4 6.35
 /begin AXIS_DESCR STD_AXIS iSasZentr.iSchaltend.iKzu.timer_zkzu UMR_MSEC__10_1_0_S6_S3 3 0 2540 DEPOSIT ABSOLUTE MONOTONY MON_INCREASE /end AXIS_DESCR
/end CHARACTERISTIC
/begin CHARACTERISTIC KL_PORASYN46 "Rampe n.Syn.->letz.Stuetz.y PMAX" CURVE 0x2587EC kl_si16_S6_S3 23 UMR_BAR__1_1000_0_S6_S3 0 23
 /begin AXIS_DESCR STD_AXIS iSasZentr.iSchaltend.iKzu.timer_zkzu UMR_MSEC__10_1_0_S6_S3 3 0 2540 DEPOSIT ABSOLUTE MONOTONY MON_INCREASE /end AXIS_DESCR
/end CHARACTERISTIC
/begin CHARACTERISTIC KL_POKZUMDMOTSOLL46 "Schaltdruckoffset in Abhaengigkeit von md_motsoll_sas" CURVE 0x2587FC kl_si16_S6_S3 12.75 UMR_BAR__1_1000_0_S6_S3 -6.4 6.35
 /begin AXIS_DESCR STD_AXIS NO_INPUT_QUANTITY UMR_NM__1_1_0_S6_S3 6 -2000 2000 DEPOSIT ABSOLUTE MONOTONY MON_INCREASE /end AXIS_DESCR
/end CHARACTERISTIC
/begin CHARACTERISTIC KL_PGRASYN46 "Schliessrampenradient" CURVE 0x258818 kl_si16_S6_S3 6553.4 UMR_BAR_SEC_1_10_0_S6_S3 -3276.7 3276.7
 /begin AXIS_DESCR STD_AXIS zff_atsys._.iSignale._.obj.sig_m_t UMR_NM__1_1_0_S6_S3 6 -400 1640 DEPOSIT ABSOLUTE MONOTONY MON_INCREASE /end AXIS_DESCR
/end CHARACTERISTIC
/begin CHARACTERISTIC KL_FPGRASYN46 "Faktor Schließrampengradient" CURVE 0x258834 kl_si16_S6_S3 50 UMR___1_10_0_S6_S3 0 50
 /begin AXIS_DESCR STD_AXIS iItfInput.ng_ab UMR_U_MINSEC_1_1_0_S6_S3 4 -5000 1000 DEPOSIT ABSOLUTE MONOTONY MON_INCREASE /end AXIS_DESCR
/end CHARACTERISTIC
/begin CHARACTERISTIC NGS_ABFLARE46 "Abtriebsdrehzahlgradientenschwelle" VALUE 0x26DE6E kw_si16_S6_S3 13200 UMR_U_MINSEC_1_1_0_S6_S3 -5000 8200 /end CHARACTERISTIC
/begin CHARACTERISTIC KL_POKZUFLARE46 "Sollschlupf abhaengiger Druckoffset zur Vermeidung von Flare" CURVE 0x258848 kl_si16_S6_S3 3 UMR_BAR__1_1000_0_S6_S3 0 3
 /begin AXIS_DESCR STD_AXIS iSasZentr.iSchaltend.nd_synistgang UMR_U_MIN_1_1_0_S6_S3 5 -8000 8000 DEPOSIT ABSOLUTE MONOTONY MON_INCREASE /end AXIS_DESCR
/end CHARACTERISTIC
/begin CHARACTERISTIC TO_VKZUSLST57 "Zeitoffset auf Verzögerung Schnellfüllung bei Schleppstart" VALUE 0x26E8FD kw_ui8_S6_S3 90 UMR_MSEC__10_1_0_S6_S3 10 100 /end CHARACTERISTIC
/begin CHARACTERISTIC KL_POKZUNGAB57 "Druckoffset in Abhaengigkeit von ng_ab" CURVE 0x258860 kl_si16_S6_S3 12.75 UMR_BAR__1_1000_0_S6_S3 -6.4 6.35
 /begin AXIS_DESCR STD_AXIS iItfInput.ng_ab UMR_U_MINSEC_1_1_0_S6_S3 4 -5000 1000 DEPOSIT ABSOLUTE MONOTONY MON_INCREASE /end AXIS_DESCR
/end CHARACTERISTIC
/begin CHARACTERISTIC KL_PGOFMT57 "Gradient Druckoffset Fuellphase" CURVE 0x258874 kl_si16_S6_S3 200 UMR_BAR_SEC_1_10_0_S6_S3 -100 100
 /begin AXIS_DESCR STD_AXIS zff_atsys._.iSignale._.obj.sig_m_t UMR_NM__1_1_0_S6_S3 4 -400 1640 DEPOSIT ABSOLUTE MONOTONY MON_INCREASE /end AXIS_DESCR
/end CHARACTERISTIC
/begin CHARACTERISTIC KL_POFMDMOTSOLL57 "Fuelldruckoffset f(Erhoehung Motorsollmoment)" CURVE 0x258888 kl_si16_S6_S3 12.75 UMR_BAR__1_1000_0_S6_S3 -6.4 6.35
 /begin AXIS_DESCR STD_AXIS NO_INPUT_QUANTITY UMR_NM__1_1_0_S6_S3 6 -2000 2000 DEPOSIT ABSOLUTE MONOTONY MON_INCREASE /end AXIS_DESCR
/end CHARACTERISTIC
/begin CHARACTERISTIC KL_FTRACG57 "Faktor auf Zeit für Rampe auf Schaltdruck" CURVE 0x2588A4 kl_ui8_S6_S3 1 UMR_PROZENT__1_100_0_S6_S3 1 2
 /begin AXIS_DESCR STD_AXIS zff_atsys._.iSignale._.obj.sig_c_getr UMR_GRADC__1_1_M40_S6_S3 4 -40 150 DEPOSIT ABSOLUTE MONOTONY MON_INCREASE /end AXIS_DESCR
/end CHARACTERISTIC
/begin CHARACTERISTIC T_RA2SSCHR57 "Zeit 2.Rampe bei Schrittschaltung" VALUE 0x26E8FE kw_ui8_S6_S3 2540 UMR_MSEC__10_1_0_S6_S3 0 2540 /end CHARACTERISTIC
/begin CHARACTERISTIC T_SYN57 "Verweilzeit in Synchron zum Start Max.Rampe" VALUE 0x26E8FF kw_ui8_S6_S3 2540 UMR_MSEC__10_1_0_S6_S3 0 2540 /end CHARACTERISTIC
/begin CHARACTERISTIC T_KORHSZEIT57 "Korrekturwert fur Schaltverzugberechnung" VALUE 0x26E900 kw_ui8_S6_S3 2000 UMR_MSEC__10_1_M128_S6_S3 -1000 1000 /end CHARACTERISTIC
/begin CHARACTERISTIC KF_POFMTCG57 "Fülldruckoffset" MAP 0x2588B0 kf_si16_S6_S3 12.75 UMR_BAR__1_1000_0_S6_S3 -6.4 6.35
 /begin AXIS_DESCR STD_AXIS zff_atsys._.iSignale._.obj.sig_m_t UMR_NM__1_1_0_S6_S3 2 -400 1640 DEPOSIT ABSOLUTE MONOTONY MON_INCREASE /end AXIS_DESCR
 /begin AXIS_DESCR STD_AXIS zff_atsys._.iSignale._.obj.sig_c_getr UMR_GRADC__1_1_M40_S6_S3 10 -40 150 DEPOSIT ABSOLUTE MONOTONY MON_INCREASE /end AXIS_DESCR
/end CHARACTERISTIC
/begin CHARACTERISTIC KL_POKZUMEPOS57 "Schaltdruckoffset f(Momentenerhoehung)" CURVE 0x2588F8 kl_si16_S6_S3 12.75 UMR_BAR__1_1000_0_S6_S3 0 12.75
 /begin AXIS_DESCR STD_AXIS iMoeMesaf.me_sas UMR_NM__1_1_0_S6_S3 5 -2000 2000 DEPOSIT ABSOLUTE MONOTONY MON_INCREASE /end AXIS_DESCR
/end CHARACTERISTIC
/begin CHARACTERISTIC T_SYNPOMEPOS57 "Zeitkriterium fuer Schaltdruckoffset" VALUE 0x26DE70 kw_si16_S6_S3 5000 UMR_MSEC__10_1_0_S6_S3 -5000 0 /end CHARACTERISTIC
/begin CHARACTERISTIC KL_PORAKZU57 "Schaltdruckoffset" CURVE 0x258910 kl_si16_S6_S3 12.75 UMR_BAR__1_1000_0_S6_S3 -6.4 6.35
 /begin AXIS_DESCR STD_AXIS iSasZentr.iSchaltend.iKzu.timer_zkzu UMR_MSEC__10_1_0_S6_S3 3 0 2540 DEPOSIT ABSOLUTE MONOTONY MON_INCREASE /end AXIS_DESCR
/end CHARACTERISTIC
/begin CHARACTERISTIC KL_PORASYN57 "Rampe n.Syn.->letz.Stuetz.y PMAX" CURVE 0x258920 kl_si16_S6_S3 23 UMR_BAR__1_1000_0_S6_S3 0 23
 /begin AXIS_DESCR STD_AXIS iSasZentr.iSchaltend.iKzu.timer_zkzu UMR_MSEC__10_1_0_S6_S3 3 0 2540 DEPOSIT ABSOLUTE MONOTONY MON_INCREASE /end AXIS_DESCR
/end CHARACTERISTIC
/begin CHARACTERISTIC KL_POKZUMDMOTSOLL57 "Schaltdruckoffset in Abhaengigkeit von md_motsoll_sas" CURVE 0x258930 kl_si16_S6_S3 12.75 UMR_BAR__1_1000_0_S6_S3 -6.4 6.35
 /begin AXIS_DESCR STD_AXIS NO_INPUT_QUANTITY UMR_NM__1_1_0_S6_S3 6 -2000 2000 DEPOSIT ABSOLUTE MONOTONY MON_INCREASE /end AXIS_DESCR
/end CHARACTERISTIC
/begin CHARACTERISTIC KL_PGRASYN57 "Schliessrampenradient" CURVE 0x25894C kl_si16_S6_S3 6553.4 UMR_BAR_SEC_1_10_0_S6_S3 -3276.7 3276.7
 /begin AXIS_DESCR STD_AXIS zff_atsys._.iSignale._.obj.sig_m_t UMR_NM__1_1_0_S6_S3 6 -400 1640 DEPOSIT ABSOLUTE MONOTONY MON_INCREASE /end AXIS_DESCR
/end CHARACTERISTIC
/begin CHARACTERISTIC KL_FPGRASYN57 "Faktor Schließrampengradient" CURVE 0x258968 kl_si16_S6_S3 50 UMR___1_10_0_S6_S3 0 50
 /begin AXIS_DESCR STD_AXIS iItfInput.ng_ab UMR_U_MINSEC_1_1_0_S6_S3 4 -5000 1000 DEPOSIT ABSOLUTE MONOTONY MON_INCREASE /end AXIS_DESCR
/end CHARACTERISTIC
/begin CHARACTERISTIC NGS_ABFLARE57 "Abtriebsdrehzahlgradientenschwelle" VALUE 0x26DE72 kw_si16_S6_S3 13200 UMR_U_MINSEC_1_1_0_S6_S3 -5000 8200 /end CHARACTERISTIC
/begin CHARACTERISTIC KL_POKZUFLARE57 "Sollschlupf abhaengiger Druckoffset zur Vermeidung von Flare" CURVE 0x25897C kl_si16_S6_S3 3 UMR_BAR__1_1000_0_S6_S3 0 3
 /begin AXIS_DESCR STD_AXIS iSasZentr.iSchaltend.nd_synistgang UMR_U_MIN_1_1_0_S6_S3 5 -8000 8000 DEPOSIT ABSOLUTE MONOTONY MON_INCREASE /end AXIS_DESCR
/end CHARACTERISTIC
/begin CHARACTERISTIC TO_VKZUSLST68 "Zeitoffset auf Verzögerung Schnellfüllung bei Schleppstart" VALUE 0x26E901 kw_ui8_S6_S3 90 UMR_MSEC__10_1_0_S6_S3 10 100 /end CHARACTERISTIC
/begin CHARACTERISTIC KL_POKZUNGAB68 "Druckoffset in Abhaengigkeit von ng_ab" CURVE 0x258994 kl_si16_S6_S3 12.75 UMR_BAR__1_1000_0_S6_S3 -6.4 6.35
 /begin AXIS_DESCR STD_AXIS iItfInput.ng_ab UMR_U_MINSEC_1_1_0_S6_S3 4 -5000 1000 DEPOSIT ABSOLUTE MONOTONY MON_INCREASE /end AXIS_DESCR
/end CHARACTERISTIC
/begin CHARACTERISTIC KL_PGOFMT68 "Gradient Druckoffset Fuellphase" CURVE 0x2589A8 kl_si16_S6_S3 200 UMR_BAR_SEC_1_10_0_S6_S3 -100 100
 /begin AXIS_DESCR STD_AXIS zff_atsys._.iSignale._.obj.sig_m_t UMR_NM__1_1_0_S6_S3 4 -400 1640 DEPOSIT ABSOLUTE MONOTONY MON_INCREASE /end AXIS_DESCR
/end CHARACTERISTIC
/begin CHARACTERISTIC KL_POFMDMOTSOLL68 "Fuelldruckoffset f(Erhoehung Motorsollmoment)" CURVE 0x2589BC kl_si16_S6_S3 12.75 UMR_BAR__1_1000_0_S6_S3 -6.4 6.35
 /begin AXIS_DESCR STD_AXIS NO_INPUT_QUANTITY UMR_NM__1_1_0_S6_S3 6 -2000 2000 DEPOSIT ABSOLUTE MONOTONY MON_INCREASE /end AXIS_DESCR
/end CHARACTERISTIC
/begin CHARACTERISTIC KL_FTRACG68 "Faktor auf Zeit für Rampe auf Schaltdruck" CURVE 0x2589D8 kl_ui8_S6_S3 1 UMR_PROZENT__1_100_0_S6_S3 1 2
 /begin AXIS_DESCR STD_AXIS zff_atsys._.iSignale._.obj.sig_c_getr UMR_GRADC__1_1_M40_S6_S3 4 -40 150 DEPOSIT ABSOLUTE MONOTONY MON_INCREASE /end AXIS_DESCR
/end CHARACTERISTIC
/begin CHARACTERISTIC T_RA2SSCHR68 "Zeit 2.Rampe bei Schrittschaltung" VALUE 0x26E902 kw_ui8_S6_S3 2540 UMR_MSEC__10_1_0_S6_S3 0 2540 /end CHARACTERISTIC
/begin CHARACTERISTIC T_SYN68 "Verweilzeit in Synchron zum Start Max.Rampe" VALUE 0x26E903 kw_ui8_S6_S3 2540 UMR_MSEC__10_1_0_S6_S3 0 2540 /end CHARACTERISTIC
/begin CHARACTERISTIC T_KORHSZEIT68 "Korrekturwert fur Schaltverzugberechnung" VALUE 0x26E904 kw_ui8_S6_S3 2000 UMR_MSEC__10_1_M128_S6_S3 -1000 1000 /end CHARACTERISTIC
/begin CHARACTERISTIC KF_POFMTCG68 "Fülldruckoffset" MAP 0x2589E4 kf_si16_S6_S3 12.75 UMR_BAR__1_1000_0_S6_S3 -6.4 6.35
 /begin AXIS_DESCR STD_AXIS zff_atsys._.iSignale._.obj.sig_m_t UMR_NM__1_1_0_S6_S3 2 -400 1640 DEPOSIT ABSOLUTE MONOTONY MON_INCREASE /end AXIS_DESCR
 /begin AXIS_DESCR STD_AXIS zff_atsys._.iSignale._.obj.sig_c_getr UMR_GRADC__1_1_M40_S6_S3 10 -40 150 DEPOSIT ABSOLUTE MONOTONY MON_INCREASE /end AXIS_DESCR
/end CHARACTERISTIC
/begin CHARACTERISTIC KL_POKZUMEPOS68 "Schaltdruckoffset f(Momentenerhoehung)" CURVE 0x258A2C kl_si16_S6_S3 12.75 UMR_BAR__1_1000_0_S6_S3 0 12.75
 /begin AXIS_DESCR STD_AXIS iMoeMesaf.me_sas UMR_NM__1_1_0_S6_S3 5 -2000 2000 DEPOSIT ABSOLUTE MONOTONY MON_INCREASE /end AXIS_DESCR
/end CHARACTERISTIC
/begin CHARACTERISTIC T_SYNPOMEPOS68 "Zeitkriterium fuer Schaltdruckoffset" VALUE 0x26DE74 kw_si16_S6_S3 5000 UMR_MSEC__10_1_0_S6_S3 -5000 0 /end CHARACTERISTIC
/begin CHARACTERISTIC KL_PORAKZU68 "Schaltdruckoffset" CURVE 0x258A44 kl_si16_S6_S3 12.75 UMR_BAR__1_1000_0_S6_S3 -6.4 6.35
 /begin AXIS_DESCR STD_AXIS iSasZentr.iSchaltend.iKzu.timer_zkzu UMR_MSEC__10_1_0_S6_S3 3 0 2540 DEPOSIT ABSOLUTE MONOTONY MON_INCREASE /end AXIS_DESCR
/end CHARACTERISTIC
/begin CHARACTERISTIC KL_PORASYN68 "Rampe n.Syn.->letz.Stuetz.y PMAX" CURVE 0x258A54 kl_si16_S6_S3 23 UMR_BAR__1_1000_0_S6_S3 0 23
 /begin AXIS_DESCR STD_AXIS iSasZentr.iSchaltend.iKzu.timer_zkzu UMR_MSEC__10_1_0_S6_S3 3 0 2540 DEPOSIT ABSOLUTE MONOTONY MON_INCREASE /end AXIS_DESCR
/end CHARACTERISTIC
/begin CHARACTERISTIC KL_POKZUMDMOTSOLL68 "Schaltdruckoffset in Abhaengigkeit von md_motsoll_sas" CURVE 0x258A64 kl_si16_S6_S3 12.75 UMR_BAR__1_1000_0_S6_S3 -6.4 6.35
 /begin AXIS_DESCR STD_AXIS NO_INPUT_QUANTITY UMR_NM__1_1_0_S6_S3 6 -2000 2000 DEPOSIT ABSOLUTE MONOTONY MON_INCREASE /end AXIS_DESCR
/end CHARACTERISTIC
/begin CHARACTERISTIC KL_PGRASYN68 "Schliessrampenradient" CURVE 0x258A80 kl_si16_S6_S3 6553.4 UMR_BAR_SEC_1_10_0_S6_S3 -3276.7 3276.7
 /begin AXIS_DESCR STD_AXIS zff_atsys._.iSignale._.obj.sig_m_t UMR_NM__1_1_0_S6_S3 6 -400 1640 DEPOSIT ABSOLUTE MONOTONY MON_INCREASE /end AXIS_DESCR
/end CHARACTERISTIC
/begin CHARACTERISTIC KL_FPGRASYN68 "Faktor Schließrampengradient" CURVE 0x258A9C kl_si16_S6_S3 50 UMR___1_10_0_S6_S3 0 50
 /begin AXIS_DESCR STD_AXIS iItfInput.ng_ab UMR_U_MINSEC_1_1_0_S6_S3 4 -5000 1000 DEPOSIT ABSOLUTE MONOTONY MON_INCREASE /end AXIS_DESCR
/end CHARACTERISTIC
/begin CHARACTERISTIC NGS_ABFLARE68 "Abtriebsdrehzahlgradientenschwelle" VALUE 0x26DE76 kw_si16_S6_S3 13200 UMR_U_MINSEC_1_1_0_S6_S3 -5000 8200 /end CHARACTERISTIC
/begin CHARACTERISTIC KL_POKZUFLARE68 "Sollschlupf abhaengiger Druckoffset zur Vermeidung von Flare" CURVE 0x258AB0 kl_si16_S6_S3 3 UMR_BAR__1_1000_0_S6_S3 0 3
 /begin AXIS_DESCR STD_AXIS iSasZentr.iSchaltend.nd_synistgang UMR_U_MIN_1_1_0_S6_S3 5 -8000 8000 DEPOSIT ABSOLUTE MONOTONY MON_INCREASE /end AXIS_DESCR
/end CHARACTERISTIC
/begin CHARACTERISTIC NS_SYNISTE21 "Turbinendifferenzdrehzahlschwelle zur Erkennung Synchron istgang verlassen" VALUE 0x26D93C kw_si16_S6_S3 1000 UMR_U_MIN_1_1_0_S6_S3 0 1000 /end CHARACTERISTIC
/begin CHARACTERISTIC KL_TMAXCG21 "Maximaldauer Schaltung" CURVE 0x2378E4 kl_ui16_S6_S3 10000 UMR_MSEC__10_1_0_S6_S3 0 10000
 /begin AXIS_DESCR STD_AXIS zff_atsys._.iSignale._.obj.sig_c_getr UMR_GRADC__1_1_M40_S6_S3 2 -40 150 DEPOSIT ABSOLUTE MONOTONY MON_INCREASE /end AXIS_DESCR
/end CHARACTERISTIC
/begin CHARACTERISTIC T_RAMAX21 "Rampe bei Timeout" VALUE 0x26E662 kw_ui8_S6_S3 2540 UMR_MSEC__10_1_0_S6_S3 0 2540 /end CHARACTERISTIC
/begin CHARACTERISTIC NS_VERSIAE21 "Drehzahlschwelle auf Leerlaufdrehzahl zur Verhinderung der Verschachtelung bei IAE" VALUE 0x26D93E kw_si16_S6_S3 8200 UMR_U_MIN_1_1_0_S6_S3 0 8200 /end CHARACTERISTIC
/begin CHARACTERISTIC NGS_VERIAE21 "Abtriebsdrehzahlgradientenschwelle für ausführen der verschachtelten Schaltung mit IAE" VALUE 0x26D940 kw_si16_S6_S3 20000 UMR_U_MINSEC_1_1_0_S6_S3 -10000 10000 /end CHARACTERISTIC
/begin CHARACTERISTIC HYS_NGS_VERIAE21 "Hysterese für Gradientenschwelle bei IAE" VALUE 0x26D942 kw_si16_S6_S3 20000 UMR_U_MINSEC_1_1_0_S6_S3 -10000 10000 /end CHARACTERISTIC
/begin CHARACTERISTIC NS_DKIRSS21 "DKI Schwelle zum Start der Funktion" VALUE 0x26E663 kw_ui8_S6_S3 100 UMR_PROZENT__20_51_0_S6_S3 0 100 /end CHARACTERISTIC
/begin CHARACTERISTIC KL_TSYNCGRSS21 "Start der Sonderfunktion mit Zeit vor/nach Synchron" CURVE 0x2378F0 kl_si16_S6_S3 6000 UMR_MSEC__10_1_0_S6_S3 -5000 1000
 /begin AXIS_DESCR STD_AXIS zff_atsys._.iSignale._.obj.sig_c_getr UMR_GRADC__1_1_M40_S6_S3 4 -80 150 DEPOSIT ABSOLUTE MONOTONY MON_INCREASE /end AXIS_DESCR
/end CHARACTERISTIC
/begin CHARACTERISTIC KL_MGMOTMAXAUFRSS21 "Momentengradient bei Ruecknahme Sonderfunktion, RSS mit formschluessigen Element, Momentenbegrenzung" CURVE 0x237904 kl_si16_S6_S3 25500 UMR_NM_SEC_10_1_0_S6_S3 0 25500
 /begin AXIS_DESCR STD_AXIS iSasZentr.timer_z_m_motmax_rss UMR_MSEC__10_1_0_S6_S3 6 0 2550 DEPOSIT ABSOLUTE MONOTONY MON_INCREASE /end AXIS_DESCR
/end CHARACTERISTIC
/begin CHARACTERISTIC KF_MOMOTMAXNDCG21 "Sicherheitsmomenten bei Sonderfunktion Phase 2, RSS mit formschluessigen Element, Momentenbegrenzung" MAP 0x237920 kf_si16_S6_S3 1400 UMR_NM__1_1_0_S6_S3 -100 1300
 /begin AXIS_DESCR STD_AXIS iSasZentr.nd_nmot_nt UMR_U_MIN_1_1_0_S6_S3 6 -16320 16320 DEPOSIT ABSOLUTE MONOTONY MON_INCREASE /end AXIS_DESCR
 /begin AXIS_DESCR STD_AXIS zff_atsys._.iSignale._.obj.sig_c_getr UMR_GRADC__1_1_M40_S6_S3 4 -80 150 DEPOSIT ABSOLUTE MONOTONY MON_INCREASE /end AXIS_DESCR
/end CHARACTERISTIC
/begin CHARACTERISTIC KL_MOMOTMAXNDRSS21 "Sicherheitsmomentenoffset bei Ruecknahme Sonderfunktion, RSS mit formschluessigen Element, Momentenbegrenzung" CURVE 0x23796C kl_si16_S6_S3 1000 UMR_NM__1_1_0_S6_S3 0 1000
 /begin AXIS_DESCR STD_AXIS iSasZentr.nd_nmot_nt UMR_U_MIN_1_1_0_S6_S3 6 -16320 16320 DEPOSIT ABSOLUTE MONOTONY MON_INCREASE /end AXIS_DESCR
/end CHARACTERISTIC
/begin CHARACTERISTIC T_RAMOTMAXRSS21 "Ueberfuehrung der Momentenbegrenzungen" VALUE 0x26E664 kw_ui8_S6_S3 1000 UMR_MSEC__10_1_0_S6_S3 0 1000 /end CHARACTERISTIC
/begin CHARACTERISTIC KL_TSYNCGNSYNRSS21 "Start Phase 2 der Sonderfunktion mit Zeit um Synchron" CURVE 0x237988 kl_si16_S6_S3 6000 UMR_MSEC__10_1_0_S6_S3 -5000 1000
 /begin AXIS_DESCR STD_AXIS zff_atsys._.iSignale._.obj.sig_c_getr UMR_GRADC__1_1_M40_S6_S3 4 -80 150 DEPOSIT ABSOLUTE MONOTONY MON_INCREASE /end AXIS_DESCR
/end CHARACTERISTIC
/begin CHARACTERISTIC ND_NTNMOTRSS21 "Ausstieg der Sonderfunktion bei Differenzdrehzahl" VALUE 0x26D944 kw_si16_S6_S3 6000 UMR___1_1_0_S6_S3 -3000 3000 /end CHARACTERISTIC
/begin CHARACTERISTIC KL_TSYNAUSCGRSS21 "Ausstieg der Sonderfunktion mit Zeit vor bzw. nach Synchron" CURVE 0x23799C kl_si16_S6_S3 6000 UMR_MSEC__10_1_0_S6_S3 -5000 1000
 /begin AXIS_DESCR STD_AXIS zff_atsys._.iSignale._.obj.sig_c_getr UMR_GRADC__1_1_M40_S6_S3 4 -80 150 DEPOSIT ABSOLUTE MONOTONY MON_INCREASE /end AXIS_DESCR
/end CHARACTERISTIC
/begin CHARACTERISTIC T_OTSYNKABV21 "Rampe bei Timeout" VALUE 0x26E665 kw_ui8_S6_S3 2550 UMR_MSEC__10_1_M255_S6_S3 -2550 0 /end CHARACTERISTIC
/begin CHARACTERISTIC NS_SYNISTE32 "Turbinendifferenzdrehzahlschwelle zur Erkennung Synchron istgang verlassen" VALUE 0x26D946 kw_si16_S6_S3 1000 UMR_U_MIN_1_1_0_S6_S3 0 1000 /end CHARACTERISTIC
/begin CHARACTERISTIC KL_TMAXCG32 "Maximaldauer Schaltung" CURVE 0x2379B0 kl_ui16_S6_S3 10000 UMR_MSEC__10_1_0_S6_S3 0 10000
 /begin AXIS_DESCR STD_AXIS zff_atsys._.iSignale._.obj.sig_c_getr UMR_GRADC__1_1_M40_S6_S3 2 -40 150 DEPOSIT ABSOLUTE MONOTONY MON_INCREASE /end AXIS_DESCR
/end CHARACTERISTIC
/begin CHARACTERISTIC T_RAMAX32 "Rampe bei Timeout" VALUE 0x26E666 kw_ui8_S6_S3 2540 UMR_MSEC__10_1_0_S6_S3 0 2540 /end CHARACTERISTIC
/begin CHARACTERISTIC NS_VERSIAE32 "Drehzahlschwelle auf Leerlaufdrehzahl zur Verhinderung der Verschachtelung bei IAE" VALUE 0x26D948 kw_si16_S6_S3 8200 UMR_U_MIN_1_1_0_S6_S3 0 8200 /end CHARACTERISTIC
/begin CHARACTERISTIC NGS_VERIAE32 "Abtriebsdrehzahlgradientenschwelle für ausführen der verschachtelten Schaltung mit IAE" VALUE 0x26D94A kw_si16_S6_S3 20000 UMR_U_MINSEC_1_1_0_S6_S3 -10000 10000 /end CHARACTERISTIC
/begin CHARACTERISTIC HYS_NGS_VERIAE32 "Hysterese für Gradientenschwelle bei IAE" VALUE 0x26D94C kw_si16_S6_S3 20000 UMR_U_MINSEC_1_1_0_S6_S3 -10000 10000 /end CHARACTERISTIC
/begin CHARACTERISTIC NS_DKIRSS32 "DKI Schwelle zum Start der Funktion" VALUE 0x26E667 kw_ui8_S6_S3 100 UMR_PROZENT__20_51_0_S6_S3 0 100 /end CHARACTERISTIC
/begin CHARACTERISTIC KL_TSYNCGRSS32 "Start der Sonderfunktion mit Zeit vor/nach Synchron" CURVE 0x2379BC kl_si16_S6_S3 6000 UMR_MSEC__10_1_0_S6_S3 -5000 1000
 /begin AXIS_DESCR STD_AXIS zff_atsys._.iSignale._.obj.sig_c_getr UMR_GRADC__1_1_M40_S6_S3 4 -80 150 DEPOSIT ABSOLUTE MONOTONY MON_INCREASE /end AXIS_DESCR
/end CHARACTERISTIC
/begin CHARACTERISTIC KL_MGMOTMAXAUFRSS32 "Momentengradient bei Ruecknahme Sonderfunktion, RSS mit formschluessigen Element, Momentenbegrenzung" CURVE 0x2379D0 kl_si16_S6_S3 25500 UMR_NM_SEC_10_1_0_S6_S3 0 25500
 /begin AXIS_DESCR STD_AXIS iSasZentr.timer_z_m_motmax_rss UMR_MSEC__10_1_0_S6_S3 6 0 2550 DEPOSIT ABSOLUTE MONOTONY MON_INCREASE /end AXIS_DESCR
/end CHARACTERISTIC
/begin CHARACTERISTIC KF_MOMOTMAXNDCG32 "Sicherheitsmomenten bei Sonderfunktion Phase 2, RSS mit formschluessigen Element, Momentenbegrenzung" MAP 0x2379EC kf_si16_S6_S3 1400 UMR_NM__1_1_0_S6_S3 -100 1300
 /begin AXIS_DESCR STD_AXIS iSasZentr.nd_nmot_nt UMR_U_MIN_1_1_0_S6_S3 6 -16320 16320 DEPOSIT ABSOLUTE MONOTONY MON_INCREASE /end AXIS_DESCR
 /begin AXIS_DESCR STD_AXIS zff_atsys._.iSignale._.obj.sig_c_getr UMR_GRADC__1_1_M40_S6_S3 4 -80 150 DEPOSIT ABSOLUTE MONOTONY MON_INCREASE /end AXIS_DESCR
/end CHARACTERISTIC
/begin CHARACTERISTIC KL_MOMOTMAXNDRSS32 "Sicherheitsmomentenoffset bei Ruecknahme Sonderfunktion, RSS mit formschluessigen Element, Momentenbegrenzung" CURVE 0x237A38 kl_si16_S6_S3 1000 UMR_NM__1_1_0_S6_S3 0 1000
 /begin AXIS_DESCR STD_AXIS iSasZentr.nd_nmot_nt UMR_U_MIN_1_1_0_S6_S3 6 -16320 16320 DEPOSIT ABSOLUTE MONOTONY MON_INCREASE /end AXIS_DESCR
/end CHARACTERISTIC
/begin CHARACTERISTIC T_RAMOTMAXRSS32 "Ueberfuehrung der Momentenbegrenzungen" VALUE 0x26E668 kw_ui8_S6_S3 1000 UMR_MSEC__10_1_0_S6_S3 0 1000 /end CHARACTERISTIC
/begin CHARACTERISTIC KL_TSYNCGNSYNRSS32 "Start Phase 2 der Sonderfunktion mit Zeit um Synchron" CURVE 0x237A54 kl_si16_S6_S3 6000 UMR_MSEC__10_1_0_S6_S3 -5000 1000
 /begin AXIS_DESCR STD_AXIS zff_atsys._.iSignale._.obj.sig_c_getr UMR_GRADC__1_1_M40_S6_S3 4 -80 150 DEPOSIT ABSOLUTE MONOTONY MON_INCREASE /end AXIS_DESCR
/end CHARACTERISTIC
/begin CHARACTERISTIC ND_NTNMOTRSS32 "Ausstieg der Sonderfunktion bei Differenzdrehzahl" VALUE 0x26D94E kw_si16_S6_S3 6000 UMR___1_1_0_S6_S3 -3000 3000 /end CHARACTERISTIC
/begin CHARACTERISTIC KL_TSYNAUSCGRSS32 "Ausstieg der Sonderfunktion mit Zeit vor bzw. nach Synchron" CURVE 0x237A68 kl_si16_S6_S3 6000 UMR_MSEC__10_1_0_S6_S3 -5000 1000
 /begin AXIS_DESCR STD_AXIS zff_atsys._.iSignale._.obj.sig_c_getr UMR_GRADC__1_1_M40_S6_S3 4 -80 150 DEPOSIT ABSOLUTE MONOTONY MON_INCREASE /end AXIS_DESCR
/end CHARACTERISTIC
/begin CHARACTERISTIC T_OTSYNKABV32 "Rampe bei Timeout" VALUE 0x26E669 kw_ui8_S6_S3 2550 UMR_MSEC__10_1_M255_S6_S3 -2550 0 /end CHARACTERISTIC
/begin CHARACTERISTIC NS_SYNISTE43 "Turbinendifferenzdrehzahlschwelle zur Erkennung Synchron istgang verlassen" VALUE 0x26D950 kw_si16_S6_S3 1000 UMR_U_MIN_1_1_0_S6_S3 0 1000 /end CHARACTERISTIC
/begin CHARACTERISTIC KL_TMAXCG43 "Maximaldauer Schaltung" CURVE 0x237A7C kl_ui16_S6_S3 10000 UMR_MSEC__10_1_0_S6_S3 0 10000
 /begin AXIS_DESCR STD_AXIS zff_atsys._.iSignale._.obj.sig_c_getr UMR_GRADC__1_1_M40_S6_S3 2 -40 150 DEPOSIT ABSOLUTE MONOTONY MON_INCREASE /end AXIS_DESCR
/end CHARACTERISTIC
/begin CHARACTERISTIC T_RAMAX43 "Rampe bei Timeout" VALUE 0x26E66A kw_ui8_S6_S3 2540 UMR_MSEC__10_1_0_S6_S3 0 2540 /end CHARACTERISTIC
/begin CHARACTERISTIC NS_VERSIAE43 "Drehzahlschwelle auf Leerlaufdrehzahl zur Verhinderung der Verschachtelung bei IAE" VALUE 0x26D952 kw_si16_S6_S3 8200 UMR_U_MIN_1_1_0_S6_S3 0 8200 /end CHARACTERISTIC
/begin CHARACTERISTIC NGS_VERIAE43 "Abtriebsdrehzahlgradientenschwelle für ausführen der verschachtelten Schaltung mit IAE" VALUE 0x26D954 kw_si16_S6_S3 20000 UMR_U_MINSEC_1_1_0_S6_S3 -10000 10000 /end CHARACTERISTIC
/begin CHARACTERISTIC HYS_NGS_VERIAE43 "Hysterese für Gradientenschwelle bei IAE" VALUE 0x26D956 kw_si16_S6_S3 20000 UMR_U_MINSEC_1_1_0_S6_S3 -10000 10000 /end CHARACTERISTIC
/begin CHARACTERISTIC NS_DKIRSS43 "DKI Schwelle zum Start der Funktion" VALUE 0x26E66B kw_ui8_S6_S3 100 UMR_PROZENT__20_51_0_S6_S3 0 100 /end CHARACTERISTIC
/begin CHARACTERISTIC KL_TSYNCGRSS43 "Start der Sonderfunktion mit Zeit vor/nach Synchron" CURVE 0x237A88 kl_si16_S6_S3 6000 UMR_MSEC__10_1_0_S6_S3 -5000 1000
 /begin AXIS_DESCR STD_AXIS zff_atsys._.iSignale._.obj.sig_c_getr UMR_GRADC__1_1_M40_S6_S3 4 -80 150 DEPOSIT ABSOLUTE MONOTONY MON_INCREASE /end AXIS_DESCR
/end CHARACTERISTIC
/begin CHARACTERISTIC KL_MGMOTMAXAUFRSS43 "Momentengradient bei Ruecknahme Sonderfunktion, RSS mit formschluessigen Element, Momentenbegrenzung" CURVE 0x237A9C kl_si16_S6_S3 25500 UMR_NM_SEC_10_1_0_S6_S3 0 25500
 /begin AXIS_DESCR STD_AXIS iSasZentr.timer_z_m_motmax_rss UMR_MSEC__10_1_0_S6_S3 6 0 2550 DEPOSIT ABSOLUTE MONOTONY MON_INCREASE /end AXIS_DESCR
/end CHARACTERISTIC
/begin CHARACTERISTIC KF_MOMOTMAXNDCG43 "Sicherheitsmomenten bei Sonderfunktion Phase 2, RSS mit formschluessigen Element, Momentenbegrenzung" MAP 0x237AB8 kf_si16_S6_S3 1400 UMR_NM__1_1_0_S6_S3 -100 1300
 /begin AXIS_DESCR STD_AXIS iSasZentr.nd_nmot_nt UMR_U_MIN_1_1_0_S6_S3 6 -16320 16320 DEPOSIT ABSOLUTE MONOTONY MON_INCREASE /end AXIS_DESCR
 /begin AXIS_DESCR STD_AXIS zff_atsys._.iSignale._.obj.sig_c_getr UMR_GRADC__1_1_M40_S6_S3 4 -80 150 DEPOSIT ABSOLUTE MONOTONY MON_INCREASE /end AXIS_DESCR
/end CHARACTERISTIC
/begin CHARACTERISTIC KL_MOMOTMAXNDRSS43 "Sicherheitsmomentenoffset bei Ruecknahme Sonderfunktion, RSS mit formschluessigen Element, Momentenbegrenzung" CURVE 0x237B04 kl_si16_S6_S3 1000 UMR_NM__1_1_0_S6_S3 0 1000
 /begin AXIS_DESCR STD_AXIS iSasZentr.nd_nmot_nt UMR_U_MIN_1_1_0_S6_S3 6 -16320 16320 DEPOSIT ABSOLUTE MONOTONY MON_INCREASE /end AXIS_DESCR
/end CHARACTERISTIC
/begin CHARACTERISTIC T_RAMOTMAXRSS43 "Ueberfuehrung der Momentenbegrenzungen" VALUE 0x26E66C kw_ui8_S6_S3 1000 UMR_MSEC__10_1_0_S6_S3 0 1000 /end CHARACTERISTIC
/begin CHARACTERISTIC KL_TSYNCGNSYNRSS43 "Start Phase 2 der Sonderfunktion mit Zeit um Synchron" CURVE 0x237B20 kl_si16_S6_S3 6000 UMR_MSEC__10_1_0_S6_S3 -5000 1000
 /begin AXIS_DESCR STD_AXIS zff_atsys._.iSignale._.obj.sig_c_getr UMR_GRADC__1_1_M40_S6_S3 4 -80 150 DEPOSIT ABSOLUTE MONOTONY MON_INCREASE /end AXIS_DESCR
/end CHARACTERISTIC
/begin CHARACTERISTIC ND_NTNMOTRSS43 "Ausstieg der Sonderfunktion bei Differenzdrehzahl" VALUE 0x26D958 kw_si16_S6_S3 6000 UMR___1_1_0_S6_S3 -3000 3000 /end CHARACTERISTIC
/begin CHARACTERISTIC KL_TSYNAUSCGRSS43 "Ausstieg der Sonderfunktion mit Zeit vor bzw. nach Synchron" CURVE 0x237B34 kl_si16_S6_S3 6000 UMR_MSEC__10_1_0_S6_S3 -5000 1000
 /begin AXIS_DESCR STD_AXIS zff_atsys._.iSignale._.obj.sig_c_getr UMR_GRADC__1_1_M40_S6_S3 4 -80 150 DEPOSIT ABSOLUTE MONOTONY MON_INCREASE /end AXIS_DESCR
/end CHARACTERISTIC
/begin CHARACTERISTIC T_OTSYNKABV43 "Rampe bei Timeout" VALUE 0x26E66D kw_ui8_S6_S3 2550 UMR_MSEC__10_1_M255_S6_S3 -2550 0 /end CHARACTERISTIC
/begin CHARACTERISTIC NS_SYNISTE54 "Turbinendifferenzdrehzahlschwelle zur Erkennung Synchron istgang verlassen" VALUE 0x26D95A kw_si16_S6_S3 1000 UMR_U_MIN_1_1_0_S6_S3 0 1000 /end CHARACTERISTIC
/begin CHARACTERISTIC KL_TMAXCG54 "Maximaldauer Schaltung" CURVE 0x237B48 kl_ui16_S6_S3 10000 UMR_MSEC__10_1_0_S6_S3 0 10000
 /begin AXIS_DESCR STD_AXIS zff_atsys._.iSignale._.obj.sig_c_getr UMR_GRADC__1_1_M40_S6_S3 2 -40 150 DEPOSIT ABSOLUTE MONOTONY MON_INCREASE /end AXIS_DESCR
/end CHARACTERISTIC
/begin CHARACTERISTIC T_RAMAX54 "Rampe bei Timeout" VALUE 0x26E66E kw_ui8_S6_S3 2540 UMR_MSEC__10_1_0_S6_S3 0 2540 /end CHARACTERISTIC
/begin CHARACTERISTIC NS_VERSIAE54 "Drehzahlschwelle auf Leerlaufdrehzahl zur Verhinderung der Verschachtelung bei IAE" VALUE 0x26D95C kw_si16_S6_S3 8200 UMR_U_MIN_1_1_0_S6_S3 0 8200 /end CHARACTERISTIC
/begin CHARACTERISTIC NGS_VERIAE54 "Abtriebsdrehzahlgradientenschwelle für ausführen der verschachtelten Schaltung mit IAE" VALUE 0x26D95E kw_si16_S6_S3 20000 UMR_U_MINSEC_1_1_0_S6_S3 -10000 10000 /end CHARACTERISTIC
/begin CHARACTERISTIC HYS_NGS_VERIAE54 "Hysterese für Gradientenschwelle bei IAE" VALUE 0x26D960 kw_si16_S6_S3 20000 UMR_U_MINSEC_1_1_0_S6_S3 -10000 10000 /end CHARACTERISTIC
/begin CHARACTERISTIC NS_DKIRSS54 "DKI Schwelle zum Start der Funktion" VALUE 0x26E66F kw_ui8_S6_S3 100 UMR_PROZENT__20_51_0_S6_S3 0 100 /end CHARACTERISTIC
/begin CHARACTERISTIC KL_TSYNCGRSS54 "Start der Sonderfunktion mit Zeit vor/nach Synchron" CURVE 0x237B54 kl_si16_S6_S3 6000 UMR_MSEC__10_1_0_S6_S3 -5000 1000
 /begin AXIS_DESCR STD_AXIS zff_atsys._.iSignale._.obj.sig_c_getr UMR_GRADC__1_1_M40_S6_S3 4 -80 150 DEPOSIT ABSOLUTE MONOTONY MON_INCREASE /end AXIS_DESCR
/end CHARACTERISTIC
/begin CHARACTERISTIC KL_MGMOTMAXAUFRSS54 "Momentengradient bei Ruecknahme Sonderfunktion, RSS mit formschluessigen Element, Momentenbegrenzung" CURVE 0x237B68 kl_si16_S6_S3 25500 UMR_NM_SEC_10_1_0_S6_S3 0 25500
 /begin AXIS_DESCR STD_AXIS iSasZentr.timer_z_m_motmax_rss UMR_MSEC__10_1_0_S6_S3 6 0 2550 DEPOSIT ABSOLUTE MONOTONY MON_INCREASE /end AXIS_DESCR
/end CHARACTERISTIC
/begin CHARACTERISTIC KF_MOMOTMAXNDCG54 "Sicherheitsmomenten bei Sonderfunktion Phase 2, RSS mit formschluessigen Element, Momentenbegrenzung" MAP 0x237B84 kf_si16_S6_S3 1400 UMR_NM__1_1_0_S6_S3 -100 1300
 /begin AXIS_DESCR STD_AXIS iSasZentr.nd_nmot_nt UMR_U_MIN_1_1_0_S6_S3 6 -16320 16320 DEPOSIT ABSOLUTE MONOTONY MON_INCREASE /end AXIS_DESCR
 /begin AXIS_DESCR STD_AXIS zff_atsys._.iSignale._.obj.sig_c_getr UMR_GRADC__1_1_M40_S6_S3 4 -80 150 DEPOSIT ABSOLUTE MONOTONY MON_INCREASE /end AXIS_DESCR
/end CHARACTERISTIC
/begin CHARACTERISTIC KL_MOMOTMAXNDRSS54 "Sicherheitsmomentenoffset bei Ruecknahme Sonderfunktion, RSS mit formschluessigen Element, Momentenbegrenzung" CURVE 0x237BD0 kl_si16_S6_S3 1000 UMR_NM__1_1_0_S6_S3 0 1000
 /begin AXIS_DESCR STD_AXIS iSasZentr.nd_nmot_nt UMR_U_MIN_1_1_0_S6_S3 6 -16320 16320 DEPOSIT ABSOLUTE MONOTONY MON_INCREASE /end AXIS_DESCR
/end CHARACTERISTIC
/begin CHARACTERISTIC T_RAMOTMAXRSS54 "Ueberfuehrung der Momentenbegrenzungen" VALUE 0x26E670 kw_ui8_S6_S3 1000 UMR_MSEC__10_1_0_S6_S3 0 1000 /end CHARACTERISTIC
/begin CHARACTERISTIC KL_TSYNCGNSYNRSS54 "Start Phase 2 der Sonderfunktion mit Zeit um Synchron" CURVE 0x237BEC kl_si16_S6_S3 6000 UMR_MSEC__10_1_0_S6_S3 -5000 1000
 /begin AXIS_DESCR STD_AXIS zff_atsys._.iSignale._.obj.sig_c_getr UMR_GRADC__1_1_M40_S6_S3 4 -80 150 DEPOSIT ABSOLUTE MONOTONY MON_INCREASE /end AXIS_DESCR
/end CHARACTERISTIC
/begin CHARACTERISTIC ND_NTNMOTRSS54 "Ausstieg der Sonderfunktion bei Differenzdrehzahl" VALUE 0x26D962 kw_si16_S6_S3 6000 UMR___1_1_0_S6_S3 -3000 3000 /end CHARACTERISTIC
/begin CHARACTERISTIC KL_TSYNAUSCGRSS54 "Ausstieg der Sonderfunktion mit Zeit vor bzw. nach Synchron" CURVE 0x237C00 kl_si16_S6_S3 6000 UMR_MSEC__10_1_0_S6_S3 -5000 1000
 /begin AXIS_DESCR STD_AXIS zff_atsys._.iSignale._.obj.sig_c_getr UMR_GRADC__1_1_M40_S6_S3 4 -80 150 DEPOSIT ABSOLUTE MONOTONY MON_INCREASE /end AXIS_DESCR
/end CHARACTERISTIC
/begin CHARACTERISTIC T_OTSYNKABV54 "Rampe bei Timeout" VALUE 0x26E671 kw_ui8_S6_S3 2550 UMR_MSEC__10_1_M255_S6_S3 -2550 0 /end CHARACTERISTIC
/begin CHARACTERISTIC NS_SYNISTE65 "Turbinendifferenzdrehzahlschwelle zur Erkennung Synchron istgang verlassen" VALUE 0x26D964 kw_si16_S6_S3 1000 UMR_U_MIN_1_1_0_S6_S3 0 1000 /end CHARACTERISTIC
/begin CHARACTERISTIC KL_TMAXCG65 "Maximaldauer Schaltung" CURVE 0x237C14 kl_ui16_S6_S3 10000 UMR_MSEC__10_1_0_S6_S3 0 10000
 /begin AXIS_DESCR STD_AXIS zff_atsys._.iSignale._.obj.sig_c_getr UMR_GRADC__1_1_M40_S6_S3 2 -40 150 DEPOSIT ABSOLUTE MONOTONY MON_INCREASE /end AXIS_DESCR
/end CHARACTERISTIC
/begin CHARACTERISTIC T_RAMAX65 "Rampe bei Timeout" VALUE 0x26E672 kw_ui8_S6_S3 2540 UMR_MSEC__10_1_0_S6_S3 0 2540 /end CHARACTERISTIC
/begin CHARACTERISTIC NS_VERSIAE65 "Drehzahlschwelle auf Leerlaufdrehzahl zur Verhinderung der Verschachtelung bei IAE" VALUE 0x26D966 kw_si16_S6_S3 8200 UMR_U_MIN_1_1_0_S6_S3 0 8200 /end CHARACTERISTIC
/begin CHARACTERISTIC NGS_VERIAE65 "Abtriebsdrehzahlgradientenschwelle für ausführen der verschachtelten Schaltung mit IAE" VALUE 0x26D968 kw_si16_S6_S3 20000 UMR_U_MINSEC_1_1_0_S6_S3 -10000 10000 /end CHARACTERISTIC
/begin CHARACTERISTIC HYS_NGS_VERIAE65 "Hysterese für Gradientenschwelle bei IAE" VALUE 0x26D96A kw_si16_S6_S3 20000 UMR_U_MINSEC_1_1_0_S6_S3 -10000 10000 /end CHARACTERISTIC
/begin CHARACTERISTIC NS_DKIRSS65 "DKI Schwelle zum Start der Funktion" VALUE 0x26E673 kw_ui8_S6_S3 100 UMR_PROZENT__20_51_0_S6_S3 0 100 /end CHARACTERISTIC
/begin CHARACTERISTIC KL_TSYNCGRSS65 "Start der Sonderfunktion mit Zeit vor/nach Synchron" CURVE 0x237C20 kl_si16_S6_S3 6000 UMR_MSEC__10_1_0_S6_S3 -5000 1000
 /begin AXIS_DESCR STD_AXIS zff_atsys._.iSignale._.obj.sig_c_getr UMR_GRADC__1_1_M40_S6_S3 4 -80 150 DEPOSIT ABSOLUTE MONOTONY MON_INCREASE /end AXIS_DESCR
/end CHARACTERISTIC
/begin CHARACTERISTIC KL_MGMOTMAXAUFRSS65 "Momentengradient bei Ruecknahme Sonderfunktion, RSS mit formschluessigen Element, Momentenbegrenzung" CURVE 0x237C34 kl_si16_S6_S3 25500 UMR_NM_SEC_10_1_0_S6_S3 0 25500
 /begin AXIS_DESCR STD_AXIS iSasZentr.timer_z_m_motmax_rss UMR_MSEC__10_1_0_S6_S3 6 0 2550 DEPOSIT ABSOLUTE MONOTONY MON_INCREASE /end AXIS_DESCR
/end CHARACTERISTIC
/begin CHARACTERISTIC KF_MOMOTMAXNDCG65 "Sicherheitsmomenten bei Sonderfunktion Phase 2, RSS mit formschluessigen Element, Momentenbegrenzung" MAP 0x237C50 kf_si16_S6_S3 1400 UMR_NM__1_1_0_S6_S3 -100 1300
 /begin AXIS_DESCR STD_AXIS iSasZentr.nd_nmot_nt UMR_U_MIN_1_1_0_S6_S3 6 -16320 16320 DEPOSIT ABSOLUTE MONOTONY MON_INCREASE /end AXIS_DESCR
 /begin AXIS_DESCR STD_AXIS zff_atsys._.iSignale._.obj.sig_c_getr UMR_GRADC__1_1_M40_S6_S3 4 -80 150 DEPOSIT ABSOLUTE MONOTONY MON_INCREASE /end AXIS_DESCR
/end CHARACTERISTIC
/begin CHARACTERISTIC KL_MOMOTMAXNDRSS65 "Sicherheitsmomentenoffset bei Ruecknahme Sonderfunktion, RSS mit formschluessigen Element, Momentenbegrenzung" CURVE 0x237C9C kl_si16_S6_S3 1000 UMR_NM__1_1_0_S6_S3 0 1000
 /begin AXIS_DESCR STD_AXIS iSasZentr.nd_nmot_nt UMR_U_MIN_1_1_0_S6_S3 6 -16320 16320 DEPOSIT ABSOLUTE MONOTONY MON_INCREASE /end AXIS_DESCR
/end CHARACTERISTIC
/begin CHARACTERISTIC T_RAMOTMAXRSS65 "Ueberfuehrung der Momentenbegrenzungen" VALUE 0x26E674 kw_ui8_S6_S3 1000 UMR_MSEC__10_1_0_S6_S3 0 1000 /end CHARACTERISTIC
/begin CHARACTERISTIC KL_TSYNCGNSYNRSS65 "Start Phase 2 der Sonderfunktion mit Zeit um Synchron" CURVE 0x237CB8 kl_si16_S6_S3 6000 UMR_MSEC__10_1_0_S6_S3 -5000 1000
 /begin AXIS_DESCR STD_AXIS zff_atsys._.iSignale._.obj.sig_c_getr UMR_GRADC__1_1_M40_S6_S3 4 -80 150 DEPOSIT ABSOLUTE MONOTONY MON_INCREASE /end AXIS_DESCR
/end CHARACTERISTIC
/begin CHARACTERISTIC ND_NTNMOTRSS65 "Ausstieg der Sonderfunktion bei Differenzdrehzahl" VALUE 0x26D96C kw_si16_S6_S3 6000 UMR___1_1_0_S6_S3 -3000 3000 /end CHARACTERISTIC
/begin CHARACTERISTIC KL_TSYNAUSCGRSS65 "Ausstieg der Sonderfunktion mit Zeit vor bzw. nach Synchron" CURVE 0x237CCC kl_si16_S6_S3 6000 UMR_MSEC__10_1_0_S6_S3 -5000 1000
 /begin AXIS_DESCR STD_AXIS zff_atsys._.iSignale._.obj.sig_c_getr UMR_GRADC__1_1_M40_S6_S3 4 -80 150 DEPOSIT ABSOLUTE MONOTONY MON_INCREASE /end AXIS_DESCR
/end CHARACTERISTIC
/begin CHARACTERISTIC T_OTSYNKABV65 "Rampe bei Timeout" VALUE 0x26E675 kw_ui8_S6_S3 2550 UMR_MSEC__10_1_M255_S6_S3 -2550 0 /end CHARACTERISTIC
/begin CHARACTERISTIC NS_SYNISTE76 "Turbinendifferenzdrehzahlschwelle zur Erkennung Synchron istgang verlassen" VALUE 0x26D96E kw_si16_S6_S3 1000 UMR_U_MIN_1_1_0_S6_S3 0 1000 /end CHARACTERISTIC
/begin CHARACTERISTIC KL_TMAXCG76 "Maximaldauer Schaltung" CURVE 0x237CE0 kl_ui16_S6_S3 10000 UMR_MSEC__10_1_0_S6_S3 0 10000
 /begin AXIS_DESCR STD_AXIS zff_atsys._.iSignale._.obj.sig_c_getr UMR_GRADC__1_1_M40_S6_S3 2 -40 150 DEPOSIT ABSOLUTE MONOTONY MON_INCREASE /end AXIS_DESCR
/end CHARACTERISTIC
/begin CHARACTERISTIC T_RAMAX76 "Rampe bei Timeout" VALUE 0x26E676 kw_ui8_S6_S3 2540 UMR_MSEC__10_1_0_S6_S3 0 2540 /end CHARACTERISTIC
/begin CHARACTERISTIC NS_VERSIAE76 "Drehzahlschwelle auf Leerlaufdrehzahl zur Verhinderung der Verschachtelung bei IAE" VALUE 0x26D970 kw_si16_S6_S3 8200 UMR_U_MIN_1_1_0_S6_S3 0 8200 /end CHARACTERISTIC
/begin CHARACTERISTIC NGS_VERIAE76 "Abtriebsdrehzahlgradientenschwelle für ausführen der verschachtelten Schaltung mit IAE" VALUE 0x26D972 kw_si16_S6_S3 20000 UMR_U_MINSEC_1_1_0_S6_S3 -10000 10000 /end CHARACTERISTIC
/begin CHARACTERISTIC HYS_NGS_VERIAE76 "Hysterese für Gradientenschwelle bei IAE" VALUE 0x26D974 kw_si16_S6_S3 20000 UMR_U_MINSEC_1_1_0_S6_S3 -10000 10000 /end CHARACTERISTIC
/begin CHARACTERISTIC NS_DKIRSS76 "DKI Schwelle zum Start der Funktion" VALUE 0x26E677 kw_ui8_S6_S3 100 UMR_PROZENT__20_51_0_S6_S3 0 100 /end CHARACTERISTIC
/begin CHARACTERISTIC KL_TSYNCGRSS76 "Start der Sonderfunktion mit Zeit vor/nach Synchron" CURVE 0x237CEC kl_si16_S6_S3 6000 UMR_MSEC__10_1_0_S6_S3 -5000 1000
 /begin AXIS_DESCR STD_AXIS zff_atsys._.iSignale._.obj.sig_c_getr UMR_GRADC__1_1_M40_S6_S3 4 -80 150 DEPOSIT ABSOLUTE MONOTONY MON_INCREASE /end AXIS_DESCR
/end CHARACTERISTIC
/begin CHARACTERISTIC KL_MGMOTMAXAUFRSS76 "Momentengradient bei Ruecknahme Sonderfunktion, RSS mit formschluessigen Element, Momentenbegrenzung" CURVE 0x237D00 kl_si16_S6_S3 25500 UMR_NM_SEC_10_1_0_S6_S3 0 25500
 /begin AXIS_DESCR STD_AXIS iSasZentr.timer_z_m_motmax_rss UMR_MSEC__10_1_0_S6_S3 6 0 2550 DEPOSIT ABSOLUTE MONOTONY MON_INCREASE /end AXIS_DESCR
/end CHARACTERISTIC
/begin CHARACTERISTIC KF_MOMOTMAXNDCG76 "Sicherheitsmomenten bei Sonderfunktion Phase 2, RSS mit formschluessigen Element, Momentenbegrenzung" MAP 0x237D1C kf_si16_S6_S3 1400 UMR_NM__1_1_0_S6_S3 -100 1300
 /begin AXIS_DESCR STD_AXIS iSasZentr.nd_nmot_nt UMR_U_MIN_1_1_0_S6_S3 6 -16320 16320 DEPOSIT ABSOLUTE MONOTONY MON_INCREASE /end AXIS_DESCR
 /begin AXIS_DESCR STD_AXIS zff_atsys._.iSignale._.obj.sig_c_getr UMR_GRADC__1_1_M40_S6_S3 4 -80 150 DEPOSIT ABSOLUTE MONOTONY MON_INCREASE /end AXIS_DESCR
/end CHARACTERISTIC
/begin CHARACTERISTIC KL_MOMOTMAXNDRSS76 "Sicherheitsmomentenoffset bei Ruecknahme Sonderfunktion, RSS mit formschluessigen Element, Momentenbegrenzung" CURVE 0x237D68 kl_si16_S6_S3 1000 UMR_NM__1_1_0_S6_S3 0 1000
 /begin AXIS_DESCR STD_AXIS iSasZentr.nd_nmot_nt UMR_U_MIN_1_1_0_S6_S3 6 -16320 16320 DEPOSIT ABSOLUTE MONOTONY MON_INCREASE /end AXIS_DESCR
/end CHARACTERISTIC
/begin CHARACTERISTIC T_RAMOTMAXRSS76 "Ueberfuehrung der Momentenbegrenzungen" VALUE 0x26E678 kw_ui8_S6_S3 1000 UMR_MSEC__10_1_0_S6_S3 0 1000 /end CHARACTERISTIC
/begin CHARACTERISTIC KL_TSYNCGNSYNRSS76 "Start Phase 2 der Sonderfunktion mit Zeit um Synchron" CURVE 0x237D84 kl_si16_S6_S3 6000 UMR_MSEC__10_1_0_S6_S3 -5000 1000
 /begin AXIS_DESCR STD_AXIS zff_atsys._.iSignale._.obj.sig_c_getr UMR_GRADC__1_1_M40_S6_S3 4 -80 150 DEPOSIT ABSOLUTE MONOTONY MON_INCREASE /end AXIS_DESCR
/end CHARACTERISTIC
/begin CHARACTERISTIC ND_NTNMOTRSS76 "Ausstieg der Sonderfunktion bei Differenzdrehzahl" VALUE 0x26D976 kw_si16_S6_S3 6000 UMR___1_1_0_S6_S3 -3000 3000 /end CHARACTERISTIC
/begin CHARACTERISTIC KL_TSYNAUSCGRSS76 "Ausstieg der Sonderfunktion mit Zeit vor bzw. nach Synchron" CURVE 0x237D98 kl_si16_S6_S3 6000 UMR_MSEC__10_1_0_S6_S3 -5000 1000
 /begin AXIS_DESCR STD_AXIS zff_atsys._.iSignale._.obj.sig_c_getr UMR_GRADC__1_1_M40_S6_S3 4 -80 150 DEPOSIT ABSOLUTE MONOTONY MON_INCREASE /end AXIS_DESCR
/end CHARACTERISTIC
/begin CHARACTERISTIC T_OTSYNKABV76 "Rampe bei Timeout" VALUE 0x26E679 kw_ui8_S6_S3 2550 UMR_MSEC__10_1_M255_S6_S3 -2550 0 /end CHARACTERISTIC
/begin CHARACTERISTIC NS_SYNISTE87 "Turbinendifferenzdrehzahlschwelle zur Erkennung Synchron istgang verlassen" VALUE 0x26D978 kw_si16_S6_S3 1000 UMR_U_MIN_1_1_0_S6_S3 0 1000 /end CHARACTERISTIC
/begin CHARACTERISTIC KL_TMAXCG87 "Maximaldauer Schaltung" CURVE 0x237DAC kl_ui16_S6_S3 10000 UMR_MSEC__10_1_0_S6_S3 0 10000
 /begin AXIS_DESCR STD_AXIS zff_atsys._.iSignale._.obj.sig_c_getr UMR_GRADC__1_1_M40_S6_S3 2 -40 150 DEPOSIT ABSOLUTE MONOTONY MON_INCREASE /end AXIS_DESCR
/end CHARACTERISTIC
/begin CHARACTERISTIC T_RAMAX87 "Rampe bei Timeout" VALUE 0x26E67A kw_ui8_S6_S3 2540 UMR_MSEC__10_1_0_S6_S3 0 2540 /end CHARACTERISTIC
/begin CHARACTERISTIC NS_VERSIAE87 "Drehzahlschwelle auf Leerlaufdrehzahl zur Verhinderung der Verschachtelung bei IAE" VALUE 0x26D97A kw_si16_S6_S3 8200 UMR_U_MIN_1_1_0_S6_S3 0 8200 /end CHARACTERISTIC
/begin CHARACTERISTIC NGS_VERIAE87 "Abtriebsdrehzahlgradientenschwelle für ausführen der verschachtelten Schaltung mit IAE" VALUE 0x26D97C kw_si16_S6_S3 20000 UMR_U_MINSEC_1_1_0_S6_S3 -10000 10000 /end CHARACTERISTIC
/begin CHARACTERISTIC HYS_NGS_VERIAE87 "Hysterese für Gradientenschwelle bei IAE" VALUE 0x26D97E kw_si16_S6_S3 20000 UMR_U_MINSEC_1_1_0_S6_S3 -10000 10000 /end CHARACTERISTIC
/begin CHARACTERISTIC NS_DKIRSS87 "DKI Schwelle zum Start der Funktion" VALUE 0x26E67B kw_ui8_S6_S3 100 UMR_PROZENT__20_51_0_S6_S3 0 100 /end CHARACTERISTIC
/begin CHARACTERISTIC KL_TSYNCGRSS87 "Start der Sonderfunktion mit Zeit vor/nach Synchron" CURVE 0x237DB8 kl_si16_S6_S3 6000 UMR_MSEC__10_1_0_S6_S3 -5000 1000
 /begin AXIS_DESCR STD_AXIS zff_atsys._.iSignale._.obj.sig_c_getr UMR_GRADC__1_1_M40_S6_S3 4 -80 150 DEPOSIT ABSOLUTE MONOTONY MON_INCREASE /end AXIS_DESCR
/end CHARACTERISTIC
/begin CHARACTERISTIC KL_MGMOTMAXAUFRSS87 "Momentengradient bei Ruecknahme Sonderfunktion, RSS mit formschluessigen Element, Momentenbegrenzung" CURVE 0x237DCC kl_si16_S6_S3 25500 UMR_NM_SEC_10_1_0_S6_S3 0 25500
 /begin AXIS_DESCR STD_AXIS iSasZentr.timer_z_m_motmax_rss UMR_MSEC__10_1_0_S6_S3 6 0 2550 DEPOSIT ABSOLUTE MONOTONY MON_INCREASE /end AXIS_DESCR
/end CHARACTERISTIC
/begin CHARACTERISTIC KF_MOMOTMAXNDCG87 "Sicherheitsmomenten bei Sonderfunktion Phase 2, RSS mit formschluessigen Element, Momentenbegrenzung" MAP 0x237DE8 kf_si16_S6_S3 1400 UMR_NM__1_1_0_S6_S3 -100 1300
 /begin AXIS_DESCR STD_AXIS iSasZentr.nd_nmot_nt UMR_U_MIN_1_1_0_S6_S3 6 -16320 16320 DEPOSIT ABSOLUTE MONOTONY MON_INCREASE /end AXIS_DESCR
 /begin AXIS_DESCR STD_AXIS zff_atsys._.iSignale._.obj.sig_c_getr UMR_GRADC__1_1_M40_S6_S3 4 -80 150 DEPOSIT ABSOLUTE MONOTONY MON_INCREASE /end AXIS_DESCR
/end CHARACTERISTIC
/begin CHARACTERISTIC KL_MOMOTMAXNDRSS87 "Sicherheitsmomentenoffset bei Ruecknahme Sonderfunktion, RSS mit formschluessigen Element, Momentenbegrenzung" CURVE 0x237E34 kl_si16_S6_S3 1000 UMR_NM__1_1_0_S6_S3 0 1000
 /begin AXIS_DESCR STD_AXIS iSasZentr.nd_nmot_nt UMR_U_MIN_1_1_0_S6_S3 6 -16320 16320 DEPOSIT ABSOLUTE MONOTONY MON_INCREASE /end AXIS_DESCR
/end CHARACTERISTIC
/begin CHARACTERISTIC T_RAMOTMAXRSS87 "Ueberfuehrung der Momentenbegrenzungen" VALUE 0x26E67C kw_ui8_S6_S3 1000 UMR_MSEC__10_1_0_S6_S3 0 1000 /end CHARACTERISTIC
/begin CHARACTERISTIC KL_TSYNCGNSYNRSS87 "Start Phase 2 der Sonderfunktion mit Zeit um Synchron" CURVE 0x237E50 kl_si16_S6_S3 6000 UMR_MSEC__10_1_0_S6_S3 -5000 1000
 /begin AXIS_DESCR STD_AXIS zff_atsys._.iSignale._.obj.sig_c_getr UMR_GRADC__1_1_M40_S6_S3 4 -80 150 DEPOSIT ABSOLUTE MONOTONY MON_INCREASE /end AXIS_DESCR
/end CHARACTERISTIC
/begin CHARACTERISTIC ND_NTNMOTRSS87 "Ausstieg der Sonderfunktion bei Differenzdrehzahl" VALUE 0x26D980 kw_si16_S6_S3 6000 UMR___1_1_0_S6_S3 -3000 3000 /end CHARACTERISTIC
/begin CHARACTERISTIC KL_TSYNAUSCGRSS87 "Ausstieg der Sonderfunktion mit Zeit vor bzw. nach Synchron" CURVE 0x237E64 kl_si16_S6_S3 6000 UMR_MSEC__10_1_0_S6_S3 -5000 1000
 /begin AXIS_DESCR STD_AXIS zff_atsys._.iSignale._.obj.sig_c_getr UMR_GRADC__1_1_M40_S6_S3 4 -80 150 DEPOSIT ABSOLUTE MONOTONY MON_INCREASE /end AXIS_DESCR
/end CHARACTERISTIC
/begin CHARACTERISTIC T_OTSYNKABV87 "Rampe bei Timeout" VALUE 0x26E67D kw_ui8_S6_S3 2550 UMR_MSEC__10_1_M255_S6_S3 -2550 0 /end CHARACTERISTIC
/begin CHARACTERISTIC NS_SYNISTESP31 "Turbinendifferenzdrehzahlschwelle zur Erkennung Synchron istgang verlassen" VALUE 0x26D982 kw_si16_S6_S3 1000 UMR_U_MIN_1_1_0_S6_S3 0 1000 /end CHARACTERISTIC
/begin CHARACTERISTIC KL_TMAXCGSP31 "Maximaldauer Schaltung" CURVE 0x237E78 kl_ui16_S6_S3 10000 UMR_MSEC__10_1_0_S6_S3 0 10000
 /begin AXIS_DESCR STD_AXIS zff_atsys._.iSignale._.obj.sig_c_getr UMR_GRADC__1_1_M40_S6_S3 2 -40 150 DEPOSIT ABSOLUTE MONOTONY MON_INCREASE /end AXIS_DESCR
/end CHARACTERISTIC
/begin CHARACTERISTIC T_RAMAXSP31 "Rampe bei Timeout" VALUE 0x26E67E kw_ui8_S6_S3 2540 UMR_MSEC__10_1_0_S6_S3 0 2540 /end CHARACTERISTIC
/begin CHARACTERISTIC NS_VERSIAESP31 "Drehzahlschwelle auf Leerlaufdrehzahl zur Verhinderung der Verschachtelung bei IAE" VALUE 0x26D984 kw_si16_S6_S3 8200 UMR_U_MIN_1_1_0_S6_S3 0 8200 /end CHARACTERISTIC
/begin CHARACTERISTIC NGS_VERIAESP31 "Abtriebsdrehzahlgradientenschwelle für ausführen der verschachtelten Schaltung mit IAE" VALUE 0x26D986 kw_si16_S6_S3 20000 UMR_U_MINSEC_1_1_0_S6_S3 -10000 10000 /end CHARACTERISTIC
/begin CHARACTERISTIC HYS_NGS_VERIAESP31 "Hysterese für Gradientenschwelle bei IAE" VALUE 0x26D988 kw_si16_S6_S3 20000 UMR_U_MINSEC_1_1_0_S6_S3 -10000 10000 /end CHARACTERISTIC
/begin CHARACTERISTIC NS_DKIRSSSP31 "DKI Schwelle zum Start der Funktion" VALUE 0x26E67F kw_ui8_S6_S3 100 UMR_PROZENT__20_51_0_S6_S3 0 100 /end CHARACTERISTIC
/begin CHARACTERISTIC KL_TSYNCGRSSSP31 "Start der Sonderfunktion mit Zeit vor/nach Synchron" CURVE 0x237E84 kl_si16_S6_S3 6000 UMR_MSEC__10_1_0_S6_S3 -5000 1000
 /begin AXIS_DESCR STD_AXIS zff_atsys._.iSignale._.obj.sig_c_getr UMR_GRADC__1_1_M40_S6_S3 4 -80 150 DEPOSIT ABSOLUTE MONOTONY MON_INCREASE /end AXIS_DESCR
/end CHARACTERISTIC
/begin CHARACTERISTIC KL_MGMOTMAXAUFRSSSP31 "Momentengradient bei Ruecknahme Sonderfunktion, RSS mit formschluessigen Element, Momentenbegrenzung" CURVE 0x237E98 kl_si16_S6_S3 25500 UMR_NM_SEC_10_1_0_S6_S3 0 25500
 /begin AXIS_DESCR STD_AXIS iSasZentr.timer_z_m_motmax_rss UMR_MSEC__10_1_0_S6_S3 6 0 2550 DEPOSIT ABSOLUTE MONOTONY MON_INCREASE /end AXIS_DESCR
/end CHARACTERISTIC
/begin CHARACTERISTIC KF_MOMOTMAXNDCGSP31 "Sicherheitsmomenten bei Sonderfunktion Phase 2, RSS mit formschluessigen Element, Momentenbegrenzung" MAP 0x237EB4 kf_si16_S6_S3 1400 UMR_NM__1_1_0_S6_S3 -100 1300
 /begin AXIS_DESCR STD_AXIS iSasZentr.nd_nmot_nt UMR_U_MIN_1_1_0_S6_S3 6 -16320 16320 DEPOSIT ABSOLUTE MONOTONY MON_INCREASE /end AXIS_DESCR
 /begin AXIS_DESCR STD_AXIS zff_atsys._.iSignale._.obj.sig_c_getr UMR_GRADC__1_1_M40_S6_S3 4 -80 150 DEPOSIT ABSOLUTE MONOTONY MON_INCREASE /end AXIS_DESCR
/end CHARACTERISTIC
/begin CHARACTERISTIC KL_MOMOTMAXNDRSSSP31 "Sicherheitsmomentenoffset bei Ruecknahme Sonderfunktion, RSS mit formschluessigen Element, Momentenbegrenzung" CURVE 0x237F00 kl_si16_S6_S3 1000 UMR_NM__1_1_0_S6_S3 0 1000
 /begin AXIS_DESCR STD_AXIS iSasZentr.nd_nmot_nt UMR_U_MIN_1_1_0_S6_S3 6 -16320 16320 DEPOSIT ABSOLUTE MONOTONY MON_INCREASE /end AXIS_DESCR
/end CHARACTERISTIC
/begin CHARACTERISTIC T_RAMOTMAXRSSSP31 "Ueberfuehrung der Momentenbegrenzungen" VALUE 0x26E680 kw_ui8_S6_S3 1000 UMR_MSEC__10_1_0_S6_S3 0 1000 /end CHARACTERISTIC
/begin CHARACTERISTIC KL_TSYNCGNSYNRSSSP31 "Start Phase 2 der Sonderfunktion mit Zeit um Synchron" CURVE 0x237F1C kl_si16_S6_S3 6000 UMR_MSEC__10_1_0_S6_S3 -5000 1000
 /begin AXIS_DESCR STD_AXIS zff_atsys._.iSignale._.obj.sig_c_getr UMR_GRADC__1_1_M40_S6_S3 4 -80 150 DEPOSIT ABSOLUTE MONOTONY MON_INCREASE /end AXIS_DESCR
/end CHARACTERISTIC
/begin CHARACTERISTIC ND_NTNMOTRSSSP31 "Ausstieg der Sonderfunktion bei Differenzdrehzahl" VALUE 0x26D98A kw_si16_S6_S3 6000 UMR___1_1_0_S6_S3 -3000 3000 /end CHARACTERISTIC
/begin CHARACTERISTIC KL_TSYNAUSCGRSSSP31 "Ausstieg der Sonderfunktion mit Zeit vor bzw. nach Synchron" CURVE 0x237F30 kl_si16_S6_S3 6000 UMR_MSEC__10_1_0_S6_S3 -5000 1000
 /begin AXIS_DESCR STD_AXIS zff_atsys._.iSignale._.obj.sig_c_getr UMR_GRADC__1_1_M40_S6_S3 4 -80 150 DEPOSIT ABSOLUTE MONOTONY MON_INCREASE /end AXIS_DESCR
/end CHARACTERISTIC
/begin CHARACTERISTIC T_OTSYNKABVSP31 "Rampe bei Timeout" VALUE 0x26E681 kw_ui8_S6_S3 2550 UMR_MSEC__10_1_M255_S6_S3 -2550 0 /end CHARACTERISTIC
/begin CHARACTERISTIC NS_SYNISTESP42 "Turbinendifferenzdrehzahlschwelle zur Erkennung Synchron istgang verlassen" VALUE 0x26D98C kw_si16_S6_S3 1000 UMR_U_MIN_1_1_0_S6_S3 0 1000 /end CHARACTERISTIC
/begin CHARACTERISTIC KL_TMAXCGSP42 "Maximaldauer Schaltung" CURVE 0x237F44 kl_ui16_S6_S3 10000 UMR_MSEC__10_1_0_S6_S3 0 10000
 /begin AXIS_DESCR STD_AXIS zff_atsys._.iSignale._.obj.sig_c_getr UMR_GRADC__1_1_M40_S6_S3 2 -40 150 DEPOSIT ABSOLUTE MONOTONY MON_INCREASE /end AXIS_DESCR
/end CHARACTERISTIC
/begin CHARACTERISTIC T_RAMAXSP42 "Rampe bei Timeout" VALUE 0x26E682 kw_ui8_S6_S3 2540 UMR_MSEC__10_1_0_S6_S3 0 2540 /end CHARACTERISTIC
/begin CHARACTERISTIC NS_VERSIAESP42 "Drehzahlschwelle auf Leerlaufdrehzahl zur Verhinderung der Verschachtelung bei IAE" VALUE 0x26D98E kw_si16_S6_S3 8200 UMR_U_MIN_1_1_0_S6_S3 0 8200 /end CHARACTERISTIC
/begin CHARACTERISTIC NGS_VERIAESP42 "Abtriebsdrehzahlgradientenschwelle für ausführen der verschachtelten Schaltung mit IAE" VALUE 0x26D990 kw_si16_S6_S3 20000 UMR_U_MINSEC_1_1_0_S6_S3 -10000 10000 /end CHARACTERISTIC
/begin CHARACTERISTIC HYS_NGS_VERIAESP42 "Hysterese für Gradientenschwelle bei IAE" VALUE 0x26D992 kw_si16_S6_S3 20000 UMR_U_MINSEC_1_1_0_S6_S3 -10000 10000 /end CHARACTERISTIC
/begin CHARACTERISTIC NS_DKIRSSSP42 "DKI Schwelle zum Start der Funktion" VALUE 0x26E683 kw_ui8_S6_S3 100 UMR_PROZENT__20_51_0_S6_S3 0 100 /end CHARACTERISTIC
/begin CHARACTERISTIC KL_TSYNCGRSSSP42 "Start der Sonderfunktion mit Zeit vor/nach Synchron" CURVE 0x237F50 kl_si16_S6_S3 6000 UMR_MSEC__10_1_0_S6_S3 -5000 1000
 /begin AXIS_DESCR STD_AXIS zff_atsys._.iSignale._.obj.sig_c_getr UMR_GRADC__1_1_M40_S6_S3 4 -80 150 DEPOSIT ABSOLUTE MONOTONY MON_INCREASE /end AXIS_DESCR
/end CHARACTERISTIC
/begin CHARACTERISTIC KL_MGMOTMAXAUFRSSSP42 "Momentengradient bei Ruecknahme Sonderfunktion, RSS mit formschluessigen Element, Momentenbegrenzung" CURVE 0x237F64 kl_si16_S6_S3 25500 UMR_NM_SEC_10_1_0_S6_S3 0 25500
 /begin AXIS_DESCR STD_AXIS iSasZentr.timer_z_m_motmax_rss UMR_MSEC__10_1_0_S6_S3 6 0 2550 DEPOSIT ABSOLUTE MONOTONY MON_INCREASE /end AXIS_DESCR
/end CHARACTERISTIC
/begin CHARACTERISTIC KF_MOMOTMAXNDCGSP42 "Sicherheitsmomenten bei Sonderfunktion Phase 2, RSS mit formschluessigen Element, Momentenbegrenzung" MAP 0x237F80 kf_si16_S6_S3 1400 UMR_NM__1_1_0_S6_S3 -100 1300
 /begin AXIS_DESCR STD_AXIS iSasZentr.nd_nmot_nt UMR_U_MIN_1_1_0_S6_S3 6 -16320 16320 DEPOSIT ABSOLUTE MONOTONY MON_INCREASE /end AXIS_DESCR
 /begin AXIS_DESCR STD_AXIS zff_atsys._.iSignale._.obj.sig_c_getr UMR_GRADC__1_1_M40_S6_S3 4 -80 150 DEPOSIT ABSOLUTE MONOTONY MON_INCREASE /end AXIS_DESCR
/end CHARACTERISTIC
/begin CHARACTERISTIC KL_MOMOTMAXNDRSSSP42 "Sicherheitsmomentenoffset bei Ruecknahme Sonderfunktion, RSS mit formschluessigen Element, Momentenbegrenzung" CURVE 0x237FCC kl_si16_S6_S3 1000 UMR_NM__1_1_0_S6_S3 0 1000
 /begin AXIS_DESCR STD_AXIS iSasZentr.nd_nmot_nt UMR_U_MIN_1_1_0_S6_S3 6 -16320 16320 DEPOSIT ABSOLUTE MONOTONY MON_INCREASE /end AXIS_DESCR
/end CHARACTERISTIC
/begin CHARACTERISTIC T_RAMOTMAXRSSSP42 "Ueberfuehrung der Momentenbegrenzungen" VALUE 0x26E684 kw_ui8_S6_S3 1000 UMR_MSEC__10_1_0_S6_S3 0 1000 /end CHARACTERISTIC
/begin CHARACTERISTIC KL_TSYNCGNSYNRSSSP42 "Start Phase 2 der Sonderfunktion mit Zeit um Synchron" CURVE 0x237FE8 kl_si16_S6_S3 6000 UMR_MSEC__10_1_0_S6_S3 -5000 1000
 /begin AXIS_DESCR STD_AXIS zff_atsys._.iSignale._.obj.sig_c_getr UMR_GRADC__1_1_M40_S6_S3 4 -80 150 DEPOSIT ABSOLUTE MONOTONY MON_INCREASE /end AXIS_DESCR
/end CHARACTERISTIC
/begin CHARACTERISTIC ND_NTNMOTRSSSP42 "Ausstieg der Sonderfunktion bei Differenzdrehzahl" VALUE 0x26D994 kw_si16_S6_S3 6000 UMR___1_1_0_S6_S3 -3000 3000 /end CHARACTERISTIC
/begin CHARACTERISTIC KL_TSYNAUSCGRSSSP42 "Ausstieg der Sonderfunktion mit Zeit vor bzw. nach Synchron" CURVE 0x237FFC kl_si16_S6_S3 6000 UMR_MSEC__10_1_0_S6_S3 -5000 1000
 /begin AXIS_DESCR STD_AXIS zff_atsys._.iSignale._.obj.sig_c_getr UMR_GRADC__1_1_M40_S6_S3 4 -80 150 DEPOSIT ABSOLUTE MONOTONY MON_INCREASE /end AXIS_DESCR
/end CHARACTERISTIC
/begin CHARACTERISTIC T_OTSYNKABVSP42 "Rampe bei Timeout" VALUE 0x26E685 kw_ui8_S6_S3 2550 UMR_MSEC__10_1_M255_S6_S3 -2550 0 /end CHARACTERISTIC
/begin CHARACTERISTIC NS_SYNISTESP51 "Turbinendifferenzdrehzahlschwelle zur Erkennung Synchron istgang verlassen" VALUE 0x26D996 kw_si16_S6_S3 1000 UMR_U_MIN_1_1_0_S6_S3 0 1000 /end CHARACTERISTIC
/begin CHARACTERISTIC KL_TMAXCGSP51 "Maximaldauer Schaltung" CURVE 0x238010 kl_ui16_S6_S3 10000 UMR_MSEC__10_1_0_S6_S3 0 10000
 /begin AXIS_DESCR STD_AXIS zff_atsys._.iSignale._.obj.sig_c_getr UMR_GRADC__1_1_M40_S6_S3 2 -40 150 DEPOSIT ABSOLUTE MONOTONY MON_INCREASE /end AXIS_DESCR
/end CHARACTERISTIC
/begin CHARACTERISTIC T_RAMAXSP51 "Rampe bei Timeout" VALUE 0x26E686 kw_ui8_S6_S3 2540 UMR_MSEC__10_1_0_S6_S3 0 2540 /end CHARACTERISTIC
/begin CHARACTERISTIC NS_VERSIAESP51 "Drehzahlschwelle auf Leerlaufdrehzahl zur Verhinderung der Verschachtelung bei IAE" VALUE 0x26D998 kw_si16_S6_S3 8200 UMR_U_MIN_1_1_0_S6_S3 0 8200 /end CHARACTERISTIC
/begin CHARACTERISTIC NGS_VERIAESP51 "Abtriebsdrehzahlgradientenschwelle für ausführen der verschachtelten Schaltung mit IAE" VALUE 0x26D99A kw_si16_S6_S3 20000 UMR_U_MINSEC_1_1_0_S6_S3 -10000 10000 /end CHARACTERISTIC
/begin CHARACTERISTIC HYS_NGS_VERIAESP51 "Hysterese für Gradientenschwelle bei IAE" VALUE 0x26D99C kw_si16_S6_S3 20000 UMR_U_MINSEC_1_1_0_S6_S3 -10000 10000 /end CHARACTERISTIC
/begin CHARACTERISTIC NS_DKIRSSSP51 "DKI Schwelle zum Start der Funktion" VALUE 0x26E687 kw_ui8_S6_S3 100 UMR_PROZENT__20_51_0_S6_S3 0 100 /end CHARACTERISTIC
/begin CHARACTERISTIC KL_TSYNCGRSSSP51 "Start der Sonderfunktion mit Zeit vor/nach Synchron" CURVE 0x23801C kl_si16_S6_S3 6000 UMR_MSEC__10_1_0_S6_S3 -5000 1000
 /begin AXIS_DESCR STD_AXIS zff_atsys._.iSignale._.obj.sig_c_getr UMR_GRADC__1_1_M40_S6_S3 4 -80 150 DEPOSIT ABSOLUTE MONOTONY MON_INCREASE /end AXIS_DESCR
/end CHARACTERISTIC
/begin CHARACTERISTIC KL_MGMOTMAXAUFRSSSP51 "Momentengradient bei Ruecknahme Sonderfunktion, RSS mit formschluessigen Element, Momentenbegrenzung" CURVE 0x238030 kl_si16_S6_S3 25500 UMR_NM_SEC_10_1_0_S6_S3 0 25500
 /begin AXIS_DESCR STD_AXIS iSasZentr.timer_z_m_motmax_rss UMR_MSEC__10_1_0_S6_S3 6 0 2550 DEPOSIT ABSOLUTE MONOTONY MON_INCREASE /end AXIS_DESCR
/end CHARACTERISTIC
/begin CHARACTERISTIC KF_MOMOTMAXNDCGSP51 "Sicherheitsmomenten bei Sonderfunktion Phase 2, RSS mit formschluessigen Element, Momentenbegrenzung" MAP 0x23804C kf_si16_S6_S3 1400 UMR_NM__1_1_0_S6_S3 -100 1300
 /begin AXIS_DESCR STD_AXIS iSasZentr.nd_nmot_nt UMR_U_MIN_1_1_0_S6_S3 6 -16320 16320 DEPOSIT ABSOLUTE MONOTONY MON_INCREASE /end AXIS_DESCR
 /begin AXIS_DESCR STD_AXIS zff_atsys._.iSignale._.obj.sig_c_getr UMR_GRADC__1_1_M40_S6_S3 4 -80 150 DEPOSIT ABSOLUTE MONOTONY MON_INCREASE /end AXIS_DESCR
/end CHARACTERISTIC
/begin CHARACTERISTIC KL_MOMOTMAXNDRSSSP51 "Sicherheitsmomentenoffset bei Ruecknahme Sonderfunktion, RSS mit formschluessigen Element, Momentenbegrenzung" CURVE 0x238098 kl_si16_S6_S3 1000 UMR_NM__1_1_0_S6_S3 0 1000
 /begin AXIS_DESCR STD_AXIS iSasZentr.nd_nmot_nt UMR_U_MIN_1_1_0_S6_S3 6 -16320 16320 DEPOSIT ABSOLUTE MONOTONY MON_INCREASE /end AXIS_DESCR
/end CHARACTERISTIC
/begin CHARACTERISTIC T_RAMOTMAXRSSSP51 "Ueberfuehrung der Momentenbegrenzungen" VALUE 0x26E688 kw_ui8_S6_S3 1000 UMR_MSEC__10_1_0_S6_S3 0 1000 /end CHARACTERISTIC
/begin CHARACTERISTIC KL_TSYNCGNSYNRSSSP51 "Start Phase 2 der Sonderfunktion mit Zeit um Synchron" CURVE 0x2380B4 kl_si16_S6_S3 6000 UMR_MSEC__10_1_0_S6_S3 -5000 1000
 /begin AXIS_DESCR STD_AXIS zff_atsys._.iSignale._.obj.sig_c_getr UMR_GRADC__1_1_M40_S6_S3 4 -80 150 DEPOSIT ABSOLUTE MONOTONY MON_INCREASE /end AXIS_DESCR
/end CHARACTERISTIC
/begin CHARACTERISTIC ND_NTNMOTRSSSP51 "Ausstieg der Sonderfunktion bei Differenzdrehzahl" VALUE 0x26D99E kw_si16_S6_S3 6000 UMR___1_1_0_S6_S3 -3000 3000 /end CHARACTERISTIC
/begin CHARACTERISTIC KL_TSYNAUSCGRSSSP51 "Ausstieg der Sonderfunktion mit Zeit vor bzw. nach Synchron" CURVE 0x2380C8 kl_si16_S6_S3 6000 UMR_MSEC__10_1_0_S6_S3 -5000 1000
 /begin AXIS_DESCR STD_AXIS zff_atsys._.iSignale._.obj.sig_c_getr UMR_GRADC__1_1_M40_S6_S3 4 -80 150 DEPOSIT ABSOLUTE MONOTONY MON_INCREASE /end AXIS_DESCR
/end CHARACTERISTIC
/begin CHARACTERISTIC T_OTSYNKABVSP51 "Rampe bei Timeout" VALUE 0x26E689 kw_ui8_S6_S3 2550 UMR_MSEC__10_1_M255_S6_S3 -2550 0 /end CHARACTERISTIC
/begin CHARACTERISTIC NS_SYNISTESP53 "Turbinendifferenzdrehzahlschwelle zur Erkennung Synchron istgang verlassen" VALUE 0x26D9A0 kw_si16_S6_S3 1000 UMR_U_MIN_1_1_0_S6_S3 0 1000 /end CHARACTERISTIC
/begin CHARACTERISTIC KL_TMAXCGSP53 "Maximaldauer Schaltung" CURVE 0x2380DC kl_ui16_S6_S3 10000 UMR_MSEC__10_1_0_S6_S3 0 10000
 /begin AXIS_DESCR STD_AXIS zff_atsys._.iSignale._.obj.sig_c_getr UMR_GRADC__1_1_M40_S6_S3 2 -40 150 DEPOSIT ABSOLUTE MONOTONY MON_INCREASE /end AXIS_DESCR
/end CHARACTERISTIC
/begin CHARACTERISTIC T_RAMAXSP53 "Rampe bei Timeout" VALUE 0x26E68A kw_ui8_S6_S3 2540 UMR_MSEC__10_1_0_S6_S3 0 2540 /end CHARACTERISTIC
/begin CHARACTERISTIC NS_VERSIAESP53 "Drehzahlschwelle auf Leerlaufdrehzahl zur Verhinderung der Verschachtelung bei IAE" VALUE 0x26D9A2 kw_si16_S6_S3 8200 UMR_U_MIN_1_1_0_S6_S3 0 8200 /end CHARACTERISTIC
/begin CHARACTERISTIC NGS_VERIAESP53 "Abtriebsdrehzahlgradientenschwelle für ausführen der verschachtelten Schaltung mit IAE" VALUE 0x26D9A4 kw_si16_S6_S3 20000 UMR_U_MINSEC_1_1_0_S6_S3 -10000 10000 /end CHARACTERISTIC
/begin CHARACTERISTIC HYS_NGS_VERIAESP53 "Hysterese für Gradientenschwelle bei IAE" VALUE 0x26D9A6 kw_si16_S6_S3 20000 UMR_U_MINSEC_1_1_0_S6_S3 -10000 10000 /end CHARACTERISTIC
/begin CHARACTERISTIC NS_DKIRSSSP53 "DKI Schwelle zum Start der Funktion" VALUE 0x26E68B kw_ui8_S6_S3 100 UMR_PROZENT__20_51_0_S6_S3 0 100 /end CHARACTERISTIC
/begin CHARACTERISTIC KL_TSYNCGRSSSP53 "Start der Sonderfunktion mit Zeit vor/nach Synchron" CURVE 0x2380E8 kl_si16_S6_S3 6000 UMR_MSEC__10_1_0_S6_S3 -5000 1000
 /begin AXIS_DESCR STD_AXIS zff_atsys._.iSignale._.obj.sig_c_getr UMR_GRADC__1_1_M40_S6_S3 4 -80 150 DEPOSIT ABSOLUTE MONOTONY MON_INCREASE /end AXIS_DESCR
/end CHARACTERISTIC
/begin CHARACTERISTIC KL_MGMOTMAXAUFRSSSP53 "Momentengradient bei Ruecknahme Sonderfunktion, RSS mit formschluessigen Element, Momentenbegrenzung" CURVE 0x2380FC kl_si16_S6_S3 25500 UMR_NM_SEC_10_1_0_S6_S3 0 25500
 /begin AXIS_DESCR STD_AXIS iSasZentr.timer_z_m_motmax_rss UMR_MSEC__10_1_0_S6_S3 6 0 2550 DEPOSIT ABSOLUTE MONOTONY MON_INCREASE /end AXIS_DESCR
/end CHARACTERISTIC
/begin CHARACTERISTIC KF_MOMOTMAXNDCGSP53 "Sicherheitsmomenten bei Sonderfunktion Phase 2, RSS mit formschluessigen Element, Momentenbegrenzung" MAP 0x238118 kf_si16_S6_S3 1400 UMR_NM__1_1_0_S6_S3 -100 1300
 /begin AXIS_DESCR STD_AXIS iSasZentr.nd_nmot_nt UMR_U_MIN_1_1_0_S6_S3 6 -16320 16320 DEPOSIT ABSOLUTE MONOTONY MON_INCREASE /end AXIS_DESCR
 /begin AXIS_DESCR STD_AXIS zff_atsys._.iSignale._.obj.sig_c_getr UMR_GRADC__1_1_M40_S6_S3 4 -80 150 DEPOSIT ABSOLUTE MONOTONY MON_INCREASE /end AXIS_DESCR
/end CHARACTERISTIC
/begin CHARACTERISTIC KL_MOMOTMAXNDRSSSP53 "Sicherheitsmomentenoffset bei Ruecknahme Sonderfunktion, RSS mit formschluessigen Element, Momentenbegrenzung" CURVE 0x238164 kl_si16_S6_S3 1000 UMR_NM__1_1_0_S6_S3 0 1000
 /begin AXIS_DESCR STD_AXIS iSasZentr.nd_nmot_nt UMR_U_MIN_1_1_0_S6_S3 6 -16320 16320 DEPOSIT ABSOLUTE MONOTONY MON_INCREASE /end AXIS_DESCR
/end CHARACTERISTIC
/begin CHARACTERISTIC T_RAMOTMAXRSSSP53 "Ueberfuehrung der Momentenbegrenzungen" VALUE 0x26E68C kw_ui8_S6_S3 1000 UMR_MSEC__10_1_0_S6_S3 0 1000 /end CHARACTERISTIC
/begin CHARACTERISTIC KL_TSYNCGNSYNRSSSP53 "Start Phase 2 der Sonderfunktion mit Zeit um Synchron" CURVE 0x238180 kl_si16_S6_S3 6000 UMR_MSEC__10_1_0_S6_S3 -5000 1000
 /begin AXIS_DESCR STD_AXIS zff_atsys._.iSignale._.obj.sig_c_getr UMR_GRADC__1_1_M40_S6_S3 4 -80 150 DEPOSIT ABSOLUTE MONOTONY MON_INCREASE /end AXIS_DESCR
/end CHARACTERISTIC
/begin CHARACTERISTIC ND_NTNMOTRSSSP53 "Ausstieg der Sonderfunktion bei Differenzdrehzahl" VALUE 0x26D9A8 kw_si16_S6_S3 6000 UMR___1_1_0_S6_S3 -3000 3000 /end CHARACTERISTIC
/begin CHARACTERISTIC KL_TSYNAUSCGRSSSP53 "Ausstieg der Sonderfunktion mit Zeit vor bzw. nach Synchron" CURVE 0x238194 kl_si16_S6_S3 6000 UMR_MSEC__10_1_0_S6_S3 -5000 1000
 /begin AXIS_DESCR STD_AXIS zff_atsys._.iSignale._.obj.sig_c_getr UMR_GRADC__1_1_M40_S6_S3 4 -80 150 DEPOSIT ABSOLUTE MONOTONY MON_INCREASE /end AXIS_DESCR
/end CHARACTERISTIC
/begin CHARACTERISTIC T_OTSYNKABVSP53 "Rampe bei Timeout" VALUE 0x26E68D kw_ui8_S6_S3 2550 UMR_MSEC__10_1_M255_S6_S3 -2550 0 /end CHARACTERISTIC
/begin CHARACTERISTIC NS_SYNISTESP63 "Turbinendifferenzdrehzahlschwelle zur Erkennung Synchron istgang verlassen" VALUE 0x26D9AA kw_si16_S6_S3 1000 UMR_U_MIN_1_1_0_S6_S3 0 1000 /end CHARACTERISTIC
/begin CHARACTERISTIC KL_TMAXCGSP63 "Maximaldauer Schaltung" CURVE 0x2381A8 kl_ui16_S6_S3 10000 UMR_MSEC__10_1_0_S6_S3 0 10000
 /begin AXIS_DESCR STD_AXIS zff_atsys._.iSignale._.obj.sig_c_getr UMR_GRADC__1_1_M40_S6_S3 2 -40 150 DEPOSIT ABSOLUTE MONOTONY MON_INCREASE /end AXIS_DESCR
/end CHARACTERISTIC
/begin CHARACTERISTIC T_RAMAXSP63 "Rampe bei Timeout" VALUE 0x26E68E kw_ui8_S6_S3 2540 UMR_MSEC__10_1_0_S6_S3 0 2540 /end CHARACTERISTIC
/begin CHARACTERISTIC NS_VERSIAESP63 "Drehzahlschwelle auf Leerlaufdrehzahl zur Verhinderung der Verschachtelung bei IAE" VALUE 0x26D9AC kw_si16_S6_S3 8200 UMR_U_MIN_1_1_0_S6_S3 0 8200 /end CHARACTERISTIC
/begin CHARACTERISTIC NGS_VERIAESP63 "Abtriebsdrehzahlgradientenschwelle für ausführen der verschachtelten Schaltung mit IAE" VALUE 0x26D9AE kw_si16_S6_S3 20000 UMR_U_MINSEC_1_1_0_S6_S3 -10000 10000 /end CHARACTERISTIC
/begin CHARACTERISTIC HYS_NGS_VERIAESP63 "Hysterese für Gradientenschwelle bei IAE" VALUE 0x26D9B0 kw_si16_S6_S3 20000 UMR_U_MINSEC_1_1_0_S6_S3 -10000 10000 /end CHARACTERISTIC
/begin CHARACTERISTIC NS_DKIRSSSP63 "DKI Schwelle zum Start der Funktion" VALUE 0x26E68F kw_ui8_S6_S3 100 UMR_PROZENT__20_51_0_S6_S3 0 100 /end CHARACTERISTIC
/begin CHARACTERISTIC KL_TSYNCGRSSSP63 "Start der Sonderfunktion mit Zeit vor/nach Synchron" CURVE 0x2381B4 kl_si16_S6_S3 6000 UMR_MSEC__10_1_0_S6_S3 -5000 1000
 /begin AXIS_DESCR STD_AXIS zff_atsys._.iSignale._.obj.sig_c_getr UMR_GRADC__1_1_M40_S6_S3 4 -80 150 DEPOSIT ABSOLUTE MONOTONY MON_INCREASE /end AXIS_DESCR
/end CHARACTERISTIC
/begin CHARACTERISTIC KL_MGMOTMAXAUFRSSSP63 "Momentengradient bei Ruecknahme Sonderfunktion, RSS mit formschluessigen Element, Momentenbegrenzung" CURVE 0x2381C8 kl_si16_S6_S3 25500 UMR_NM_SEC_10_1_0_S6_S3 0 25500
 /begin AXIS_DESCR STD_AXIS iSasZentr.timer_z_m_motmax_rss UMR_MSEC__10_1_0_S6_S3 6 0 2550 DEPOSIT ABSOLUTE MONOTONY MON_INCREASE /end AXIS_DESCR
/end CHARACTERISTIC
/begin CHARACTERISTIC KF_MOMOTMAXNDCGSP63 "Sicherheitsmomenten bei Sonderfunktion Phase 2, RSS mit formschluessigen Element, Momentenbegrenzung" MAP 0x2381E4 kf_si16_S6_S3 1400 UMR_NM__1_1_0_S6_S3 -100 1300
 /begin AXIS_DESCR STD_AXIS iSasZentr.nd_nmot_nt UMR_U_MIN_1_1_0_S6_S3 6 -16320 16320 DEPOSIT ABSOLUTE MONOTONY MON_INCREASE /end AXIS_DESCR
 /begin AXIS_DESCR STD_AXIS zff_atsys._.iSignale._.obj.sig_c_getr UMR_GRADC__1_1_M40_S6_S3 4 -80 150 DEPOSIT ABSOLUTE MONOTONY MON_INCREASE /end AXIS_DESCR
/end CHARACTERISTIC
/begin CHARACTERISTIC KL_MOMOTMAXNDRSSSP63 "Sicherheitsmomentenoffset bei Ruecknahme Sonderfunktion, RSS mit formschluessigen Element, Momentenbegrenzung" CURVE 0x238230 kl_si16_S6_S3 1000 UMR_NM__1_1_0_S6_S3 0 1000
 /begin AXIS_DESCR STD_AXIS iSasZentr.nd_nmot_nt UMR_U_MIN_1_1_0_S6_S3 6 -16320 16320 DEPOSIT ABSOLUTE MONOTONY MON_INCREASE /end AXIS_DESCR
/end CHARACTERISTIC
/begin CHARACTERISTIC T_RAMOTMAXRSSSP63 "Ueberfuehrung der Momentenbegrenzungen" VALUE 0x26E690 kw_ui8_S6_S3 1000 UMR_MSEC__10_1_0_S6_S3 0 1000 /end CHARACTERISTIC
/begin CHARACTERISTIC KL_TSYNCGNSYNRSSSP63 "Start Phase 2 der Sonderfunktion mit Zeit um Synchron" CURVE 0x23824C kl_si16_S6_S3 6000 UMR_MSEC__10_1_0_S6_S3 -5000 1000
 /begin AXIS_DESCR STD_AXIS zff_atsys._.iSignale._.obj.sig_c_getr UMR_GRADC__1_1_M40_S6_S3 4 -80 150 DEPOSIT ABSOLUTE MONOTONY MON_INCREASE /end AXIS_DESCR
/end CHARACTERISTIC
/begin CHARACTERISTIC ND_NTNMOTRSSSP63 "Ausstieg der Sonderfunktion bei Differenzdrehzahl" VALUE 0x26D9B2 kw_si16_S6_S3 6000 UMR___1_1_0_S6_S3 -3000 3000 /end CHARACTERISTIC
/begin CHARACTERISTIC KL_TSYNAUSCGRSSSP63 "Ausstieg der Sonderfunktion mit Zeit vor bzw. nach Synchron" CURVE 0x238260 kl_si16_S6_S3 6000 UMR_MSEC__10_1_0_S6_S3 -5000 1000
 /begin AXIS_DESCR STD_AXIS zff_atsys._.iSignale._.obj.sig_c_getr UMR_GRADC__1_1_M40_S6_S3 4 -80 150 DEPOSIT ABSOLUTE MONOTONY MON_INCREASE /end AXIS_DESCR
/end CHARACTERISTIC
/begin CHARACTERISTIC T_OTSYNKABVSP63 "Rampe bei Timeout" VALUE 0x26E691 kw_ui8_S6_S3 2550 UMR_MSEC__10_1_M255_S6_S3 -2550 0 /end CHARACTERISTIC
/begin COMPU_METHOD SAB_T_TIMER_2MS_S2_S3 "int = ((phys * 1) / 2) - (0) ms" RAT_FUNC "%5.3" "ms" COEFFS 0 1 -0 0 0 2 /end COMPU_METHOD
/begin COMPU_METHOD SAB_T_20MS_S2_S3 "int = ((phys * 1) / 20) - (0) ms" RAT_FUNC "%5.3" "ms" COEFFS 0 1 -0 0 0 20 /end COMPU_METHOD
/begin COMPU_METHOD SAB_T_TIMER_40MS_S2_S3 "int = ((phys * 1) / 40) - (0) ms" RAT_FUNC "%5.3" "ms" COEFFS 0 1 -0 0 0 40 /end COMPU_METHOD
/begin COMPU_METHOD SAB_T_TIMER_50MS_S2_S3 "int = ((phys * 1) / 50) - (0) ms" RAT_FUNC "%5.3" "ms" COEFFS 0 1 -0 0 0 50 /end COMPU_METHOD
/begin COMPU_METHOD SAB_N_RPM24_S2_S3 "int = ((phys * 24) / 1) - (0) U/min" RAT_FUNC "%5.3" "U/min" COEFFS 0 24 -0 0 0 1 /end COMPU_METHOD
/begin COMPU_METHOD SAB_N_4RPM_P500_S2_S3 "int = ((phys * 1) / 4) - (-500) U/min" RAT_FUNC "%5.3" "U/min" COEFFS 0 1 2000 0 0 4 /end COMPU_METHOD
/begin COMPU_METHOD UMR___1_10_0_S6_S3 "int = ((phys * 10) / 1) - (0) [-]" RAT_FUNC "%3.1" "[-]" COEFFS 0 10 -0 0 0 1 /end COMPU_METHOD
/begin COMPU_METHOD UMR___1_1_0_S6_S3 "int = ((phys * 1) / 1) - (0) [-]" RAT_FUNC "%2.0" "[-]" COEFFS 0 1 -0 0 0 1 /end COMPU_METHOD
/begin COMPU_METHOD UMR_NM__1_1_0_S6_S3 "int = ((phys * 1) / 1) - (0) [Nm]" RAT_FUNC "%2.0" "[Nm]" COEFFS 0 1 -0 0 0 1 /end COMPU_METHOD
/begin COMPU_METHOD UMR_NM__8_1_M50_S6_S3 "int = ((phys * 1) / 8) - (-50) [Nm]" RAT_FUNC "%2.0" "[Nm]" COEFFS 0 1 400 0 0 8 /end COMPU_METHOD
/begin COMPU_METHOD UMR_NM_SEC_10_1_0_S6_S3 "int = ((phys * 1) / 10) - (0) [Nm/s]" RAT_FUNC "%3.1" "[Nm/s]" COEFFS 0 1 -0 0 0 10 /end COMPU_METHOD
/begin COMPU_METHOD UMR_BAR__1_1000_0_S6_S3 "int = ((phys * 1000) / 1) - (0) [bar]" RAT_FUNC "%5.3" "[bar]" COEFFS 0 1000 -0 0 0 1 /end COMPU_METHOD
/begin COMPU_METHOD UMR_BAR_SEC_1_10_0_S6_S3 "int = ((phys * 10) / 1) - (0) [bar/s]" RAT_FUNC "%3.1" "[bar/s]" COEFFS 0 10 -0 0 0 1 /end COMPU_METHOD
/begin COMPU_METHOD UMR_U_MIN_1_1_0_S6_S3 "int = ((phys * 1) / 1) - (0) [U/min]" RAT_FUNC "%2.0" "[U/min]" COEFFS 0 1 -0 0 0 1 /end COMPU_METHOD
/begin COMPU_METHOD UMR_U_MINSEC_1_1_0_S6_S3 "int = ((phys * 1) / 1) - (0) [U/(min*s)]" RAT_FUNC "%2.0" "[U/(min*s)]" COEFFS 0 1 -0 0 0 1 /end COMPU_METHOD
/begin COMPU_METHOD UMR_MSEC__10_1_0_S6_S3 "int = ((phys * 1) / 10) - (0) [ms]" RAT_FUNC "%2.0" "[ms]" COEFFS 0 1 -0 0 0 10 /end COMPU_METHOD
/begin COMPU_METHOD UMR_MSEC__10_1_M128_S6_S3 "int = ((phys * 1) / 10) - (-128) [ms]" RAT_FUNC "%2.0" "[ms]" COEFFS 0 1 1280 0 0 10 /end COMPU_METHOD
/begin COMPU_METHOD UMR_MSEC__10_1_M255_S6_S3 "int = ((phys * 1) / 10) - (-255) [ms]" RAT_FUNC "%2.0" "[ms]" COEFFS 0 1 2550 0 0 10 /end COMPU_METHOD
/begin COMPU_METHOD UMR_GRADC__1_1_M40_S6_S3 "int = ((phys * 1) / 1) - (-40) [°C]" RAT_FUNC "%2.0" "[°C]" COEFFS 0 1 40 0 0 1 /end COMPU_METHOD
/begin COMPU_METHOD UMR_PROZENT__1_100_0_S6_S3 "int = ((phys * 100) / 1) - (0) [%]" RAT_FUNC "%4.2" "[%]" COEFFS 0 100 -0 0 0 1 /end COMPU_METHOD
/begin COMPU_METHOD UMR_PROZENT__20_51_0_S6_S3 "int = ((phys * 51) / 20) - (0) [%]" RAT_FUNC "%6.4" "[%]" COEFFS 0 51 -0 0 0 20 /end COMPU_METHOD
/begin FUNCTION jSasKabHSP234_Fktn "Applikationesgroessen Instanz jSasKabHSP234"
 /begin DEF_CHARACTERISTIC KF_THKABMTCGSP34 KF_TPKABMTCGSP34 KL_PHKABMTSP34 KL_POKABCGSP34 KL_TOPKABNDSP34 T_VKABHSSP34 /end DEF_CHARACTERISTIC
/end FUNCTION
/begin FUNCTION jSasKabHSP245_Fktn "Applikationesgroessen Instanz jSasKabHSP245"
 /begin DEF_CHARACTERISTIC KF_THKABMTCGSP45 KF_TPKABMTCGSP45 KL_PHKABMTSP45 KL_POKABCGSP45 KL_TOPKABNDSP45 T_VKABHSSP45 /end DEF_CHARACTERISTIC
/end FUNCTION
/begin FUNCTION jSasKabHSP256_Fktn "Applikationesgroessen Instanz jSasKabHSP256"
 /begin DEF_CHARACTERISTIC KF_THKABMTCGSP56 KF_TPKABMTCGSP56 KL_PHKABMTSP56 KL_POKABCGSP56 KL_TOPKABNDSP56 T_VKABHSSP56 /end DEF_CHARACTERISTIC
/end FUNCTION
/begin FUNCTION jSasKabHSP267_Fktn "Applikationesgroessen Instanz jSasKabHSP267"
 /begin DEF_CHARACTERISTIC KF_THKABMTCGSP67 KF_TPKABMTCGSP67 KL_PHKABMTSP67 KL_POKABCGSP67 KL_TOPKABNDSP67 T_VKABHSSP67 /end DEF_CHARACTERISTIC
/end FUNCTION
/begin FUNCTION jSasKabHSP278_Fktn "Applikationesgroessen Instanz jSasKabHSP278"
 /begin DEF_CHARACTERISTIC KF_THKABMTCGSP78 KF_TPKABMTCGSP78 KL_PHKABMTSP78 KL_POKABCGSP78 KL_TOPKABNDSP78 T_VKABHSSP78 /end DEF_CHARACTERISTIC
/end FUNCTION
/begin FUNCTION jSasKabHSP213_Fktn "Applikationesgroessen Instanz jSasKabHSP213"
 /begin DEF_CHARACTERISTIC KF_THKABMTCGSP13 KF_TPKABMTCGSP13 KL_PHKABMTSP13 KL_POKABCGSP13 KL_TOPKABNDSP13 T_VKABHSSP13 /end DEF_CHARACTERISTIC
/end FUNCTION
/begin FUNCTION jSasKabHSP224_Fktn "Applikationesgroessen Instanz jSasKabHSP224"
 /begin DEF_CHARACTERISTIC KF_THKABMTCGSP24 KF_TPKABMTCGSP24 KL_PHKABMTSP24 KL_POKABCGSP24 KL_TOPKABNDSP24 T_VKABHSSP24 /end DEF_CHARACTERISTIC
/end FUNCTION
/begin FUNCTION jSasKabHSP235_Fktn "Applikationesgroessen Instanz jSasKabHSP235"
 /begin DEF_CHARACTERISTIC KF_THKABMTCGSP35 KF_TPKABMTCGSP35 KL_PHKABMTSP35 KL_POKABCGSP35 KL_TOPKABNDSP35 T_VKABHSSP35 /end DEF_CHARACTERISTIC
/end FUNCTION
/begin FUNCTION jSasKabHSP246_Fktn "Applikationesgroessen Instanz jSasKabHSP246"
 /begin DEF_CHARACTERISTIC KF_THKABMTCGSP46 KF_TPKABMTCGSP46 KL_PHKABMTSP46 KL_POKABCGSP46 KL_TOPKABNDSP46 T_VKABHSSP46 /end DEF_CHARACTERISTIC
/end FUNCTION
/begin FUNCTION jSasKabHSP257_Fktn "Applikationesgroessen Instanz jSasKabHSP257"
 /begin DEF_CHARACTERISTIC KF_THKABMTCGSP57 KF_TPKABMTCGSP57 KL_PHKABMTSP57 KL_POKABCGSP57 KL_TOPKABNDSP57 T_VKABHSSP57 /end DEF_CHARACTERISTIC
/end FUNCTION
/begin FUNCTION jSasKabHSP268_Fktn "Applikationesgroessen Instanz jSasKabHSP268"
 /begin DEF_CHARACTERISTIC KF_THKABMTCGSP68 KF_TPKABMTCGSP68 KL_PHKABMTSP68 KL_POKABCGSP68 KL_TOPKABNDSP68 T_VKABHSSP68 /end DEF_CHARACTERISTIC
/end FUNCTION
/begin FUNCTION jSasKabHSP312_Fktn "Applikationesgroessen Instanz jSasKabHSP312"
 /begin DEF_CHARACTERISTIC KF_THKABMTCGSPORT12 KF_TPKABMTCGSPORT12 KL_PHKABMTSPORT12 KL_POKABCGSPORT12 KL_TOPKABNDSPORT12 T_VKABHSSPORT12 /end DEF_CHARACTERISTIC
/end FUNCTION
/begin FUNCTION jSasKabHSP323_Fktn "Applikationesgroessen Instanz jSasKabHSP323"
 /begin DEF_CHARACTERISTIC KF_THKABMTCGSPORT23 KF_TPKABMTCGSPORT23 KL_PHKABMTSPORT23 KL_POKABCGSPORT23 KL_TOPKABNDSPORT23 T_VKABHSSPORT23 /end DEF_CHARACTERISTIC
/end FUNCTION
/begin FUNCTION jSasKabHSP334_Fktn "Applikationesgroessen Instanz jSasKabHSP334"
 /begin DEF_CHARACTERISTIC KF_THKABMTCGSPORT34 KF_TPKABMTCGSPORT34 KL_PHKABMTSPORT34 KL_POKABCGSPORT34 KL_TOPKABNDSPORT34 T_VKABHSSPORT34 /end DEF_CHARACTERISTIC
/end FUNCTION
/begin FUNCTION jSasKabHSP345_Fktn "Applikationesgroessen Instanz jSasKabHSP345"
 /begin DEF_CHARACTERISTIC KF_THKABMTCGSPORT45 KF_TPKABMTCGSPORT45 KL_PHKABMTSPORT45 KL_POKABCGSPORT45 KL_TOPKABNDSPORT45 T_VKABHSSPORT45 /end DEF_CHARACTERISTIC
/end FUNCTION
/begin FUNCTION jSasKabHSP356_Fktn "Applikationesgroessen Instanz jSasKabHSP356"
 /begin DEF_CHARACTERISTIC KF_THKABMTCGSPORT56 KF_TPKABMTCGSPORT56 KL_PHKABMTSPORT56 KL_POKABCGSPORT56 KL_TOPKABNDSPORT56 T_VKABHSSPORT56 /end DEF_CHARACTERISTIC
/end FUNCTION
/begin FUNCTION jSasKabHSP367_Fktn "Applikationesgroessen Instanz jSasKabHSP367"
 /begin DEF_CHARACTERISTIC KF_THKABMTCGSPORT67 KF_TPKABMTCGSPORT67 KL_PHKABMTSPORT67 KL_POKABCGSPORT67 KL_TOPKABNDSPORT67 T_VKABHSSPORT67 /end DEF_CHARACTERISTIC
/end FUNCTION
/begin FUNCTION jSasKabHSP378_Fktn "Applikationesgroessen Instanz jSasKabHSP378"
 /begin DEF_CHARACTERISTIC KF_THKABMTCGSPORT78 KF_TPKABMTCGSPORT78 KL_PHKABMTSPORT78 KL_POKABCGSPORT78 KL_TOPKABNDSPORT78 T_VKABHSSPORT78 /end DEF_CHARACTERISTIC
/end FUNCTION
/begin FUNCTION jSasKabHSP313_Fktn "Applikationesgroessen Instanz jSasKabHSP313"
 /begin DEF_CHARACTERISTIC KF_THKABMTCGSPORT13 KF_TPKABMTCGSPORT13 KL_PHKABMTSPORT13 KL_POKABCGSPORT13 KL_TOPKABNDSPORT13 T_VKABHSSPORT13 /end DEF_CHARACTERISTIC
/end FUNCTION
/begin FUNCTION jSasKabHSP324_Fktn "Applikationesgroessen Instanz jSasKabHSP324"
 /begin DEF_CHARACTERISTIC KF_THKABMTCGSPORT24 KF_TPKABMTCGSPORT24 KL_PHKABMTSPORT24 KL_POKABCGSPORT24 KL_TOPKABNDSPORT24 T_VKABHSSPORT24 /end DEF_CHARACTERISTIC
/end FUNCTION
/begin FUNCTION jSasKabHSP335_Fktn "Applikationesgroessen Instanz jSasKabHSP335"
 /begin DEF_CHARACTERISTIC KF_THKABMTCGSPORT35 KF_TPKABMTCGSPORT35 KL_PHKABMTSPORT35 KL_POKABCGSPORT35 KL_TOPKABNDSPORT35 T_VKABHSSPORT35 /end DEF_CHARACTERISTIC
/end FUNCTION
/begin FUNCTION jSasKabHSP346_Fktn "Applikationesgroessen Instanz jSasKabHSP346"
 /begin DEF_CHARACTERISTIC KF_THKABMTCGSPORT46 KF_TPKABMTCGSPORT46 KL_PHKABMTSPORT46 KL_POKABCGSPORT46 KL_TOPKABNDSPORT46 T_VKABHSSPORT46 /end DEF_CHARACTERISTIC
/end FUNCTION
/begin FUNCTION jSasKabHSP357_Fktn "Applikationesgroessen Instanz jSasKabHSP357"
 /begin DEF_CHARACTERISTIC KF_THKABMTCGSPORT57 KF_TPKABMTCGSPORT57 KL_PHKABMTSPORT57 KL_POKABCGSPORT57 KL_TOPKABNDSPORT57 T_VKABHSSPORT57 /end DEF_CHARACTERISTIC
/end FUNCTION
/begin FUNCTION jSasKabHSP368_Fktn "Applikationesgroessen Instanz jSasKabHSP368"
 /begin DEF_CHARACTERISTIC KF_THKABMTCGSPORT68 KF_TPKABMTCGSPORT68 KL_PHKABMTSPORT68 KL_POKABCGSPORT68 KL_TOPKABNDSPORT68 T_VKABHSSPORT68 /end DEF_CHARACTERISTIC
/end FUNCTION
/begin FUNCTION dSasKzuHSS_Fktn "Applikationesgroessen der Komponente dSasKzuHSS"
 /begin SUB_FUNCTION jSasKzuHSS12_Fktn jSasKzuHSS23_Fktn jSasKzuHSS34_Fktn jSasKzuHSS45_Fktn jSasKzuHSS56_Fktn jSasKzuHSS67_Fktn jSasKzuHSS78_Fktn jSasKzuHSS13_Fktn jSasKzuHSS24_Fktn jSasKzuHSS35_Fktn jSasKzuHSS46_Fktn jSasKzuHSS57_Fktn jSasKzuHSS68_Fktn /end SUB_FUNCTION
/end FUNCTION
/begin FUNCTION jSasKzuHSS12_Fktn "Applikationesgroessen Instanz jSasKzuHSS12"
 /begin DEF_CHARACTERISTIC KF_POFMTCG12 KF_POFMTCG12_EL KL_FPGRASYN12 KL_FTRACG12 KL_PGOFMT12 KL_PGRASYN12 KL_POFMDMOTSOLL12 KL_POFMDMOTSOLL12_EL KL_POKZUFLARE12 KL_POKZUMDMOTSOLL12 KL_POKZUMDMOTSOLL12_EL KL_POKZUMEPOS12 KL_POKZUNGAB12 KL_PORAKZU12 KL_PORASYN12 NGS_ABFLARE12 TO_VKZUSLST12 T_KORHSZEIT12 T_RA2SSCHR12 T_SYN12 T_SYNPOMEPOS12 /end DEF_CHARACTERISTIC
/end FUNCTION
/begin FUNCTION jSasKzuHSS23_Fktn "Applikationesgroessen Instanz jSasKzuHSS23"
 /begin DEF_CHARACTERISTIC KF_POFMTCG23 KF_POFMTCG23_EL KL_FPGRASYN23 KL_FTRACG23 KL_PGOFMT23 KL_PGRASYN23 KL_POFMDMOTSOLL23 KL_POFMDMOTSOLL23_EL KL_POKZUFLARE23 KL_POKZUMDMOTSOLL23 KL_POKZUMDMOTSOLL23_EL KL_POKZUMEPOS23 KL_POKZUNGAB23 KL_PORAKZU23 KL_PORASYN23 NGS_ABFLARE23 TO_VKZUSLST23 T_KORHSZEIT23 T_RA2SSCHR23 T_SYN23 T_SYNPOMEPOS23 /end DEF_CHARACTERISTIC
/end FUNCTION
/begin FUNCTION jSasKzuHSS34_Fktn "Applikationesgroessen Instanz jSasKzuHSS34"
 /begin DEF_CHARACTERISTIC KF_POFMTCG34 KF_POFMTCG34_EL KL_FPGRASYN34 KL_FTRACG34 KL_PGOFMT34 KL_PGRASYN34 KL_POFMDMOTSOLL34 KL_POFMDMOTSOLL34_EL KL_POKZUFLARE34 KL_POKZUMDMOTSOLL34 KL_POKZUMDMOTSOLL34_EL KL_POKZUMEPOS34 KL_POKZUNGAB34 KL_PORAKZU34 KL_PORASYN34 NGS_ABFLARE34 TO_VKZUSLST34 T_KORHSZEIT34 T_RA2SSCHR34 T_SYN34 T_SYNPOMEPOS34 /end DEF_CHARACTERISTIC
/end FUNCTION
/begin FUNCTION jSasKzuHSS45_Fktn "Applikationesgroessen Instanz jSasKzuHSS45"
 /begin DEF_CHARACTERISTIC KF_POFMTCG45 KF_POFMTCG45_EL KL_FPGRASYN45 KL_FTRACG45 KL_PGOFMT45 KL_PGRASYN45 KL_POFMDMOTSOLL45 KL_POFMDMOTSOLL45_EL KL_POKZUFLARE45 KL_POKZUMDMOTSOLL45 KL_POKZUMDMOTSOLL45_EL KL_POKZUMEPOS45 KL_POKZUNGAB45 KL_PORAKZU45 KL_PORASYN45 NGS_ABFLARE45 TO_VKZUSLST45 T_KORHSZEIT45 T_RA2SSCHR45 T_SYN45 T_SYNPOMEPOS45 /end DEF_CHARACTERISTIC
/end FUNCTION
/begin FUNCTION jSasKzuHSS56_Fktn "Applikationesgroessen Instanz jSasKzuHSS56"
 /begin DEF_CHARACTERISTIC KF_POFMTCG56 KF_POFMTCG56_EL KL_FPGRASYN56 KL_FTRACG56 KL_PGOFMT56 KL_PGRASYN56 KL_POFMDMOTSOLL56 KL_POFMDMOTSOLL56_EL KL_POKZUFLARE56 KL_POKZUMDMOTSOLL56 KL_POKZUMDMOTSOLL56_EL KL_POKZUMEPOS56 KL_POKZUNGAB56 KL_PORAKZU56 KL_PORASYN56 NGS_ABFLARE56 TO_VKZUSLST56 T_KORHSZEIT56 T_RA2SSCHR56 T_SYN56 T_SYNPOMEPOS56 /end DEF_CHARACTERISTIC
/end FUNCTION
/begin FUNCTION jSasKzuHSS67_Fktn "Applikationesgroessen Instanz jSasKzuHSS67"
 /begin DEF_CHARACTERISTIC KF_POFMTCG67 KF_POFMTCG67_EL KL_FPGRASYN67 KL_FTRACG67 KL_PGOFMT67 KL_PGRASYN67 KL_POFMDMOTSOLL67 KL_POFMDMOTSOLL67_EL KL_POKZUFLARE67 KL_POKZUMDMOTSOLL67 KL_POKZUMDMOTSOLL67_EL KL_POKZUMEPOS67 KL_POKZUNGAB67 KL_PORAKZU67 KL_PORASYN67 NGS_ABFLARE67 TO_VKZUSLST67 T_KORHSZEIT67 T_RA2SSCHR67 T_SYN67 T_SYNPOMEPOS67 /end DEF_CHARACTERISTIC
/end FUNCTION
/begin FUNCTION jSasKzuHSS78_Fktn "Applikationesgroessen Instanz jSasKzuHSS78"
 /begin DEF_CHARACTERISTIC KF_POFMTCG78 KF_POFMTCG78_EL KL_FPGRASYN78 KL_FTRACG78 KL_PGOFMT78 KL_PGRASYN78 KL_POFMDMOTSOLL78 KL_POFMDMOTSOLL78_EL KL_POKZUFLARE78 KL_POKZUMDMOTSOLL78 KL_POKZUMDMOTSOLL78_EL KL_POKZUMEPOS78 KL_POKZUNGAB78 KL_PORAKZU78 KL_PORASYN78 NGS_ABFLARE78 TO_VKZUSLST78 T_KORHSZEIT78 T_RA2SSCHR78 T_SYN78 T_SYNPOMEPOS78 /end DEF_CHARACTERISTIC
/end FUNCTION
/begin FUNCTION jSasKzuHSS13_Fktn "Applikationesgroessen Instanz jSasKzuHSS13"
 /begin DEF_CHARACTERISTIC KF_POFMTCG13 KL_FPGRASYN13 KL_FTRACG13 KL_PGOFMT13 KL_PGRASYN13 KL_POFMDMOTSOLL13 KL_POKZUFLARE13 KL_POKZUMDMOTSOLL13 KL_POKZUMEPOS13 KL_POKZUNGAB13 KL_PORAKZU13 KL_PORASYN13 NGS_ABFLARE13 TO_VKZUSLST13 T_KORHSZEIT13 T_RA2SSCHR13 T_SYN13 T_SYNPOMEPOS13 /end DEF_CHARACTERISTIC
/end FUNCTION
/begin FUNCTION jSasKzuHSS24_Fktn "Applikationesgroessen Instanz jSasKzuHSS24"
 /begin DEF_CHARACTERISTIC KF_POFMTCG24 KL_FPGRASYN24 KL_FTRACG24 KL_PGOFMT24 KL_PGRASYN24 KL_POFMDMOTSOLL24 KL_POKZUFLARE24 KL_POKZUMDMOTSOLL24 KL_POKZUMEPOS24 KL_POKZUNGAB24 KL_PORAKZU24 KL_PORASYN24 NGS_ABFLARE24 TO_VKZUSLST24 T_KORHSZEIT24 T_RA2SSCHR24 T_SYN24 T_SYNPOMEPOS24 /end DEF_CHARACTERISTIC
/end FUNCTION
/begin FUNCTION jSasKzuHSS35_Fktn "Applikationesgroessen Instanz jSasKzuHSS35"
 /begin DEF_CHARACTERISTIC KF_POFMTCG35 KL_FPGRASYN35 KL_FTRACG35 KL_PGOFMT35 KL_PGRASYN35 KL_POFMDMOTSOLL35 KL_POKZUFLARE35 KL_POKZUMDMOTSOLL35 KL_POKZUMEPOS35 KL_POKZUNGAB35 KL_PORAKZU35 KL_PORASYN35 NGS_ABFLARE35 TO_VKZUSLST35 T_KORHSZEIT35 T_RA2SSCHR35 T_SYN35 T_SYNPOMEPOS35 /end DEF_CHARACTERISTIC
/end FUNCTION
/begin FUNCTION jSasKzuHSS46_Fktn "Applikationesgroessen Instanz jSasKzuHSS46"
 /begin DEF_CHARACTERISTIC KF_POFMTCG46 KL_FPGRASYN46 KL_FTRACG46 KL_PGOFMT46 KL_PGRASYN46 KL_POFMDMOTSOLL46 KL_POKZUFLARE46 KL_POKZUMDMOTSOLL46 KL_POKZUMEPOS46 KL_POKZUNGAB46 KL_PORAKZU46 KL_PORASYN46 NGS_ABFLARE46 TO_VKZUSLST46 T_KORHSZEIT46 T_RA2SSCHR46 T_SYN46 T_SYNPOMEPOS46 /end DEF_CHARACTERISTIC
/end FUNCTION
/begin FUNCTION jSasKzuHSS57_Fktn "Applikationesgroessen Instanz jSasKzuHSS57"
 /begin DEF_CHARACTERISTIC KF_POFMTCG57 KL_FPGRASYN57 KL_FTRACG57 KL_PGOFMT57 KL_PGRASYN57 KL_POFMDMOTSOLL57 KL_POKZUFLARE57 KL_POKZUMDMOTSOLL57 KL_POKZUMEPOS57 KL_POKZUNGAB57 KL_PORAKZU57 KL_PORASYN57 NGS_ABFLARE57 TO_VKZUSLST57 T_KORHSZEIT57 T_RA2SSCHR57 T_SYN57 T_SYNPOMEPOS57 /end DEF_CHARACTERISTIC
/end FUNCTION
/begin FUNCTION jSasKzuHSS68_Fktn "Applikationesgroessen Instanz jSasKzuHSS68"
 /begin DEF_CHARACTERISTIC KF_POFMTCG68 KL_FPGRASYN68 KL_FTRACG68 KL_PGOFMT68 KL_PGRASYN68 KL_POFMDMOTSOLL68 KL_POKZUFLARE68 KL_POKZUMDMOTSOLL68 KL_POKZUMEPOS68 KL_POKZUNGAB68 KL_PORAKZU68 KL_PORASYN68 NGS_ABFLARE68 TO_VKZUSLST68 T_KORHSZEIT68 T_RA2SSCHR68 T_SYN68 T_SYNPOMEPOS68 /end DEF_CHARACTERISTIC
/end FUNCTION
/begin FUNCTION dSasGloRSS_Fktn "Applikationesgroessen der Komponente dSasGloRSS"
 /begin SUB_FUNCTION jSasGloRSS21_Fktn jSasGloRSS32_Fktn jSasGloRSS43_Fktn jSasGloRSS54_Fktn jSasGloRSS65_Fktn jSasGloRSS76_Fktn jSasGloRSS87_Fktn jSasGloRSS31_Fktn jSasGloRSS42_Fktn jSasGloRSS51_Fktn jSasGloRSS53_Fktn jSasGloRSS63_Fktn jSasGloRSS64_Fktn jSasGloRSS71_Fktn jSasGloRSS75_Fktn jSasGloRSS82_Fktn jSasGloRSS84_Fktn jSasGloRSS86_Fktn /end SUB_FUNCTION
/end FUNCTION
/begin FUNCTION jSasGloRSS21_Fktn "Applikationesgroessen Instanz jSasGloRSS21"
 /begin DEF_CHARACTERISTIC HYS_NGS_VERIAE21 KF_MOMOTMAXNDCG21 KL_MGMOTMAXAUFRSS21 KL_MOMOTMAXNDRSS21 KL_TMAXCG21 KL_TSYNAUSCGRSS21 KL_TSYNCGNSYNRSS21 KL_TSYNCGRSS21 ND_NTNMOTRSS21 NGS_VERIAE21 NS_DKIRSS21 NS_SYNISTE21 NS_VERSIAE21 T_OTSYNKABV21 T_RAMAX21 T_RAMOTMAXRSS21 /end DEF_CHARACTERISTIC
/end FUNCTION
/begin FUNCTION jSasGloRSS32_Fktn "Applikationesgroessen Instanz jSasGloRSS32"
 /begin DEF_CHARACTERISTIC HYS_NGS_VERIAE32 KF_MOMOTMAXNDCG32 KL_MGMOTMAXAUFRSS32 KL_MOMOTMAXNDRSS32 KL_TMAXCG32 KL_TSYNAUSCGRSS32 KL_TSYNCGNSYNRSS32 KL_TSYNCGRSS32 ND_NTNMOTRSS32 NGS_VERIAE32 NS_DKIRSS32 NS_SYNISTE32 NS_VERSIAE32 T_OTSYNKABV32 T_RAMAX32 T_RAMOTMAXRSS32 /end DEF_CHARACTERISTIC
/end FUNCTION
/begin FUNCTION jSasGloRSS43_Fktn "Applikationesgroessen Instanz jSasGloRSS43"
 /begin DEF_CHARACTERISTIC HYS_NGS_VERIAE43 KF_MOMOTMAXNDCG43 KL_MGMOTMAXAUFRSS43 KL_MOMOTMAXNDRSS43 KL_TMAXCG43 KL_TSYNAUSCGRSS43 KL_TSYNCGNSYNRSS43 KL_TSYNCGRSS43 ND_NTNMOTRSS43 NGS_VERIAE43 NS_DKIRSS43 NS_SYNISTE43 NS_VERSIAE43 T_OTSYNKABV43 T_RAMAX43 T_RAMOTMAXRSS43 /end DEF_CHARACTERISTIC
/end FUNCTION
/begin FUNCTION jSasGloRSS54_Fktn "Applikationesgroessen Instanz jSasGloRSS54"
 /begin DEF_CHARACTERISTIC HYS_NGS_VERIAE54 KF_MOMOTMAXNDCG54 KL_MGMOTMAXAUFRSS54 KL_MOMOTMAXNDRSS54 KL_TMAXCG54 KL_TSYNAUSCGRSS54 KL_TSYNCGNSYNRSS54 KL_TSYNCGRSS54 ND_NTNMOTRSS54 NGS_VERIAE54 NS_DKIRSS54 NS_SYNISTE54 NS_VERSIAE54 T_OTSYNKABV54 T_RAMAX54 T_RAMOTMAXRSS54 /end DEF_CHARACTERISTIC
/end FUNCTION
/begin FUNCTION jSasGloRSS65_Fktn "Applikationesgroessen Instanz jSasGloRSS65"
 /begin DEF_CHARACTERISTIC HYS_NGS_VERIAE65 KF_MOMOTMAXNDCG65 KL_MGMOTMAXAUFRSS65 KL_MOMOTMAXNDRSS65 KL_TMAXCG65 KL_TSYNAUSCGRSS65 KL_TSYNCGNSYNRSS65 KL_TSYNCGRSS65 ND_NTNMOTRSS65 NGS_VERIAE65 NS_DKIRSS65 NS_SYNISTE65 NS_VERSIAE65 T_OTSYNKABV65 T_RAMAX65 T_RAMOTMAXRSS65 /end DEF_CHARACTERISTIC
/end FUNCTION
/begin FUNCTION jSasGloRSS76_Fktn "Applikationesgroessen Instanz jSasGloRSS76"
 /begin DEF_CHARACTERISTIC HYS_NGS_VERIAE76 KF_MOMOTMAXNDCG76 KL_MGMOTMAXAUFRSS76 KL_MOMOTMAXNDRSS76 KL_TMAXCG76 KL_TSYNAUSCGRSS76 KL_TSYNCGNSYNRSS76 KL_TSYNCGRSS76 ND_NTNMOTRSS76 NGS_VERIAE76 NS_DKIRSS76 NS_SYNISTE76 NS_VERSIAE76 T_OTSYNKABV76 T_RAMAX76 T_RAMOTMAXRSS76 /end DEF_CHARACTERISTIC
/end FUNCTION
/begin FUNCTION jSasGloRSS87_Fktn "Applikationesgroessen Instanz jSasGloRSS87"
 /begin DEF_CHARACTERISTIC HYS_NGS_VERIAE87 KF_MOMOTMAXNDCG87 KL_MGMOTMAXAUFRSS87 KL_MOMOTMAXNDRSS87 KL_TMAXCG87 KL_TSYNAUSCGRSS87 KL_TSYNCGNSYNRSS87 KL_TSYNCGRSS87 ND_NTNMOTRSS87 NGS_VERIAE87 NS_DKIRSS87 NS_SYNISTE87 NS_VERSIAE87 T_OTSYNKABV87 T_RAMAX87 T_RAMOTMAXRSS87 /end DEF_CHARACTERISTIC
/end FUNCTION
/begin FUNCTION jSasGloRSS31_Fktn "Applikationesgroessen Instanz jSasGloRSS31"
 /begin DEF_CHARACTERISTIC HYS_NGS_VERIAESP31 KF_MOMOTMAXNDCGSP31 KL_MGMOTMAXAUFRSSSP31 KL_MOMOTMAXNDRSSSP31 KL_TMAXCGSP31 KL_TSYNAUSCGRSSSP31 KL_TSYNCGNSYNRSSSP31 KL_TSYNCGRSSSP31 ND_NTNMOTRSSSP31 NGS_VERIAESP31 NS_DKIRSSSP31 NS_SYNISTESP31 NS_VERSIAESP31 T_OTSYNKABVSP31 T_RAMAXSP31 T_RAMOTMAXRSSSP31 /end DEF_CHARACTERISTIC
/end FUNCTION
/begin FUNCTION jSasGloRSS42_Fktn "Applikationesgroessen Instanz jSasGloRSS42"
 /begin DEF_CHARACTERISTIC HYS_NGS_VERIAESP42 KF_MOMOTMAXNDCGSP42 KL_MGMOTMAXAUFRSSSP42 KL_MOMOTMAXNDRSSSP42 KL_TMAXCGSP42 KL_TSYNAUSCGRSSSP42 KL_TSYNCGNSYNRSSSP42 KL_TSYNCGRSSSP42 ND_NTNMOTRSSSP42 NGS_VERIAESP42 NS_DKIRSSSP42 NS_SYNISTESP42 NS_VERSIAESP42 T_OTSYNKABVSP42 T_RAMAXSP42 T_RAMOTMAXRSSSP42 /end DEF_CHARACTERISTIC
/end FUNCTION
/begin FUNCTION jSasGloRSS51_Fktn "Applikationesgroessen Instanz jSasGloRSS51"
 /begin DEF_CHARACTERISTIC HYS_NGS_VERIAESP51 KF_MOMOTMAXNDCGSP51 KL_MGMOTMAXAUFRSSSP51 KL_MOMOTMAXNDRSSSP51 KL_TMAXCGSP51 KL_TSYNAUSCGRSSSP51 KL_TSYNCGNSYNRSSSP51 KL_TSYNCGRSSSP51 ND_NTNMOTRSSSP51 NGS_VERIAESP51 NS_DKIRSSSP51 NS_SYNISTESP51 NS_VERSIAESP51 T_OTSYNKABVSP51 T_RAMAXSP51 T_RAMOTMAXRSSSP51 /end DEF_CHARACTERISTIC
/end FUNCTION
/begin FUNCTION jSasGloRSS53_Fktn "Applikationesgroessen Instanz jSasGloRSS53"
 /begin DEF_CHARACTERISTIC HYS_NGS_VERIAESP53 KF_MOMOTMAXNDCGSP53 KL_MGMOTMAXAUFRSSSP53 KL_MOMOTMAXNDRSSSP53 KL_TMAXCGSP53 KL_TSYNAUSCGRSSSP53 KL_TSYNCGNSYNRSSSP53 KL_TSYNCGRSSSP53 ND_NTNMOTRSSSP53 NGS_VERIAESP53 NS_DKIRSSSP53 NS_SYNISTESP53 NS_VERSIAESP53 T_OTSYNKABVSP53 T_RAMAXSP53 T_RAMOTMAXRSSSP53 /end DEF_CHARACTERISTIC
/end FUNCTION
/begin FUNCTION jSasGloRSS63_Fktn "Applikationesgroessen Instanz jSasGloRSS63"
 /begin DEF_CHARACTERISTIC HYS_NGS_VERIAESP63 KF_MOMOTMAXNDCGSP63 KL_MGMOTMAXAUFRSSSP63 KL_MOMOTMAXNDRSSSP63 KL_TMAXCGSP63 KL_TSYNAUSCGRSSSP63 KL_TSYNCGNSYNRSSSP63 KL_TSYNCGRSSSP63 ND_NTNMOTRSSSP63 NGS_VERIAESP63 NS_DKIRSSSP63 NS_SYNISTESP63 NS_VERSIAESP63 T_OTSYNKABVSP63 T_RAMAXSP63 T_RAMOTMAXRSSSP63 /end DEF_CHARACTERISTIC
/end FUNCTION
/begin RECORD_LAYOUT kw_ui8_S6_S3 FNC_VALUES 1 UBYTE COLUMN_DIR DIRECT /end RECORD_LAYOUT
/begin RECORD_LAYOUT kw_si16_S6_S3 FNC_VALUES 1 SWORD COLUMN_DIR DIRECT /end RECORD_LAYOUT
/begin RECORD_LAYOUT kl_ui8_S6_S3 FNC_VALUES 3 UBYTE COLUMN_DIR DIRECT AXIS_PTS_X 2 UBYTE INDEX_INCR DIRECT NO_AXIS_PTS_X 1 ULONG /end RECORD_LAYOUT
/begin RECORD_LAYOUT kl_ui16_S6_S3 FNC_VALUES 3 UWORD COLUMN_DIR DIRECT AXIS_PTS_X 2 UWORD INDEX_INCR DIRECT NO_AXIS_PTS_X 1 ULONG /end RECORD_LAYOUT
/begin RECORD_LAYOUT kl_si16_S6_S3 FNC_VALUES 3 SWORD COLUMN_DIR DIRECT AXIS_PTS_X 2 SWORD INDEX_INCR DIRECT NO_AXIS_PTS_X 1 ULONG /end RECORD_LAYOUT
/begin RECORD_LAYOUT kf_ui8_S6_S3 FNC_VALUES 5 UBYTE ROW_DIR DIRECT AXIS_PTS_X 3 UBYTE INDEX_INCR DIRECT AXIS_PTS_Y 4 UBYTE INDEX_INCR DIRECT NO_AXIS_PTS_X 1 ULONG NO_AXIS_PTS_Y 2 ULONG /end RECORD_LAYOUT
/begin RECORD_LAYOUT kf_si16_S6_S3 FNC_VALUES 5 SWORD ROW_DIR DIRECT AXIS_PTS_X 3 SWORD INDEX_INCR DIRECT AXIS_PTS_Y 4 SWORD INDEX_INCR DIRECT NO_AXIS_PTS_X 1 ULONG NO_AXIS_PTS_Y 2 ULONG /end RECORD_LAYOUT
/end MODULE
/end PROJECT
