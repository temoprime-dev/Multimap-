ASAP2_VERSION 1 51
/begin PROJECT _929_929 "Gen2_BMW_System_Supplier_Lib"
/begin HEADER "" VERSION "C_03_03" PROJECT_NO _929_929 /end HEADER
/begin MODULE DIM ""
/begin MOD_COMMON "" BYTE_ORDER MSB_FIRST ALIGNMENT_BYTE 1 ALIGNMENT_WORD 2 ALIGNMENT_LONG 4 ALIGNMENT_FLOAT32_IEEE 4 /end MOD_COMMON
/begin CHARACTERISTIC sIepLeckage.PUMPENVOLPROUMDR_IEP "Pumpenvolumen der FZP pro Umdrehung in Liter" VALUE 0x217E1C Parameter.ui16_S6_S3 0.9962 UMRM___1_10000_0_S6_S3 0.0038 1 /end CHARACTERISTIC
/begin CHARACTERISTIC sIepLeckage.MPT_NSMOTANKORR_IEP "PT1- Filterzeitkonstante ns_mot_an_korr_iep" VALUE 0x217F1E Parameter.ui8_S6_S3 0.99 UMRM___1_100_0_S6_S3 0.01 1 /end CHARACTERISTIC
/begin CHARACTERISTIC sIepLeckage.TAB_KORRANISTGANG_IEP "Tabelle zur Bestimmung der korrigierten Motordrehzahlschwelle zum Einschalten der elektrischen Zusatzpumpe" CURVE 0x217E1E Table.si16_S6_S3 200 UMRM_U_MIN_1_1_0_S6_S3 -100 100
 /begin AXIS_DESCR FIX_AXIS NO_INPUT_QUANTITY eGangIdx_S6_S3 10 0 9 FIX_AXIS_PAR_DIST 0 1 10 /end AXIS_DESCR
/end CHARACTERISTIC
/begin CHARACTERISTIC sIepLeckage.TAB_KORRAUSISTGANG_IEP "Hysterese zum Ausschalten der el. Zusatzpumpe" CURVE 0x217E32 Table.si16_S6_S3 200 UMRM_U_MIN_1_1_0_S6_S3 -100 100
 /begin AXIS_DESCR FIX_AXIS NO_INPUT_QUANTITY eGangIdx_S6_S3 10 0 9 FIX_AXIS_PAR_DIST 0 1 10 /end AXIS_DESCR
/end CHARACTERISTIC
/begin CHARACTERISTIC sIepLeckage.TAB_LECKAGEHSG_IEP "Leckagebestimmung des HSG" CURVE 0x217A58 Table.fl32_S6_S3 9.9 UMRM___1_1_0_S6_S3 0.1 10 FORMAT "%5.3"
 /begin AXIS_DESCR FIX_AXIS NO_INPUT_QUANTITY eGangIdx_S6_S3 10 0 9 FIX_AXIS_PAR_DIST 0 1 10 /end AXIS_DESCR
/end CHARACTERISTIC
/begin CHARACTERISTIC sIepLeckage.KL_KORRANDKP_IEP "Korrekturkennlinie zur Bestimmung der korrigierten Motordrehzahlschwelle zum Einschalten der elektrischen Zusatzpumpe" CURVE 0x217E46 Curve.ui8.si16_S6_S3 200 UMRM_U_MIN_1_1_0_S6_S3 -100 100
 /begin AXIS_DESCR STD_AXIS NO_INPUT_QUANTITY UMRM_PROZENT__20_51_0_S6_S3 6 0 100 DEPOSIT ABSOLUTE MONOTONY STRICT_INCREASE /end AXIS_DESCR
/end CHARACTERISTIC
/begin CHARACTERISTIC sIepLeckage.KL_NGMOT_IEP "Korrekturkennlinie zur Bestimmung der kor. Motordrehzahlschwelle zum Einschal. der Iep" CURVE 0x217E58 Curve.si16.si16_S6_S3 400 UMRM_U_MIN_1_1_0_S6_S3 -200 200
 /begin AXIS_DESCR STD_AXIS NO_INPUT_QUANTITY UMRM_U_MINSEC_1_1_0_S6_S3 10 -10000 10000 DEPOSIT ABSOLUTE MONOTONY STRICT_INCREASE /end AXIS_DESCR
/end CHARACTERISTIC
/begin CHARACTERISTIC sIepLeckage.KF_LECKAGEFZP_IEP "Leckagebestimmung der FZP" MAP 0x217CDC Map.fl32.fl32.fl32_S6_S3 20 UMRM_LITER_MIN_1_1_0_S6_S3 0 20 FORMAT "%5.3"
 /begin AXIS_DESCR STD_AXIS NO_INPUT_QUANTITY UMRM_BAR__1_1_0_S6_S3 7 0 30 DEPOSIT ABSOLUTE MONOTONY STRICT_INCREASE FORMAT "%5.3" /end AXIS_DESCR
 /begin AXIS_DESCR STD_AXIS NO_INPUT_QUANTITY UMRM_GRADC__1_1_0_S6_S3 4 -40 215 DEPOSIT ABSOLUTE MONOTONY STRICT_INCREASE FORMAT "%5.3" /end AXIS_DESCR
/end CHARACTERISTIC
/begin CHARACTERISTIC sIepLeckage.KF_LECKAGEHSG_IEP "Leckagebestimmung der HSG" MAP 0x217D78 Map.fl32.fl32.fl32_S6_S3 20 UMRM_LITER_MIN_1_1_0_S6_S3 0 20 FORMAT "%5.3"
 /begin AXIS_DESCR STD_AXIS NO_INPUT_QUANTITY UMRM_BAR__1_1_0_S6_S3 5 0 30 DEPOSIT ABSOLUTE MONOTONY STRICT_INCREASE FORMAT "%5.3" /end AXIS_DESCR
 /begin AXIS_DESCR STD_AXIS NO_INPUT_QUANTITY UMRM_GRADC__1_1_0_S6_S3 6 -40 215 DEPOSIT ABSOLUTE MONOTONY STRICT_INCREASE FORMAT "%5.3" /end AXIS_DESCR
/end CHARACTERISTIC
/begin CHARACTERISTIC sIepLeckage.KF_ADDONLP_IEP "Leistungsabhängiger Offset auf Gesamtleckage" MAP 0x217E80 Map.si16.ui8.si16_S6_S3 60 UMRM_LITER_MIN_1_100_0_S6_S3 -10 50
 /begin AXIS_DESCR STD_AXIS NO_INPUT_QUANTITY UMRM_LITER_MIN_1_100_0_S6_S3 6 0 20 DEPOSIT ABSOLUTE MONOTONY STRICT_INCREASE /end AXIS_DESCR
 /begin AXIS_DESCR STD_AXIS NO_INPUT_QUANTITY UMRM___1_1_0_S6_S3 4 0 4 DEPOSIT ABSOLUTE MONOTONY STRICT_INCREASE /end AXIS_DESCR
/end CHARACTERISTIC
/begin CHARACTERISTIC sIepLeckage.KF_KORRANCGETRDKP_IEP "Korrekturkennfeld zur Bestimmung der korrigierten Motordrehzahlschwelle zum Einschalten der elektrischen Zusatzpumpe" MAP 0x217EC0 Map.ui8.ui8.si16_S6_S3 200 UMRM_U_MIN_1_1_0_S6_S3 -100 100
 /begin AXIS_DESCR STD_AXIS NO_INPUT_QUANTITY UMRM_GRADC__1_1_M40_S6_S3 8 -40 215 DEPOSIT ABSOLUTE MONOTONY STRICT_INCREASE /end AXIS_DESCR
 /begin AXIS_DESCR STD_AXIS NO_INPUT_QUANTITY UMRM_PROZENT__20_51_0_S6_S3 5 0 100 DEPOSIT ABSOLUTE MONOTONY STRICT_INCREASE /end AXIS_DESCR
/end CHARACTERISTIC
/begin CHARACTERISTIC sIepLeckage.KF_KORRANCGETRPBREMSE_IEP "Korrekturkennfeld zur Bestimmung der korrigierten Motordrehzahlschwelle zum Einschalten der elektrischen Zusatzpumpe" MAP 0x217A80 Map.fl32.fl32.fl32_S6_S3 200 UMRM_U_MIN_1_1_0_S6_S3 -100 100 FORMAT "%5.3"
 /begin AXIS_DESCR STD_AXIS NO_INPUT_QUANTITY UMRM_GRADC__1_1_0_S6_S3 6 -40 215 DEPOSIT ABSOLUTE MONOTONY STRICT_INCREASE FORMAT "%5.3" /end AXIS_DESCR
 /begin AXIS_DESCR STD_AXIS NO_INPUT_QUANTITY UMRM_BAR__1_1_0_S6_S3 7 -100 1000 DEPOSIT ABSOLUTE MONOTONY STRICT_INCREASE FORMAT "%5.3" /end AXIS_DESCR
/end CHARACTERISTIC
/begin CHARACTERISTIC sIepLeckage.KF_KORRAUSPSYSCGETR_IEP "Korrekturkennfeld zur Bestimmung der Hysterese zum Ausschalten der elektrischen Zusatzpumpe" MAP 0x217B5C Map.fl32.fl32.fl32_S6_S3 5 UMRM___1_1_0_S6_S3 0 5 FORMAT "%5.3"
 /begin AXIS_DESCR STD_AXIS NO_INPUT_QUANTITY UMRM_BAR__1_1_0_S6_S3 6 0 40 DEPOSIT ABSOLUTE MONOTONY STRICT_INCREASE FORMAT "%5.3" /end AXIS_DESCR
 /begin AXIS_DESCR STD_AXIS NO_INPUT_QUANTITY UMRM_GRADC__1_1_0_S6_S3 5 -40 215 DEPOSIT ABSOLUTE MONOTONY STRICT_INCREASE FORMAT "%5.3" /end AXIS_DESCR
/end CHARACTERISTIC
/begin CHARACTERISTIC sIepLeckage.KF_KORRAUSPSYSDKP_IEP "Korrekturkennfeld zur Bestimmung der Hysterese zum Ausschalten der elektrischen Zusatzpumpe" MAP 0x217C00 Map.fl32.fl32.fl32_S6_S3 200 UMRM_U_MIN_1_1_0_S6_S3 -100 100 FORMAT "%5.3"
 /begin AXIS_DESCR STD_AXIS NO_INPUT_QUANTITY UMRM_BAR__1_1_0_S6_S3 7 0 40 DEPOSIT ABSOLUTE MONOTONY STRICT_INCREASE FORMAT "%5.3" /end AXIS_DESCR
 /begin AXIS_DESCR STD_AXIS NO_INPUT_QUANTITY UMRM___1_1_0_S6_S3 6 0 100 DEPOSIT ABSOLUTE MONOTONY STRICT_INCREASE FORMAT "%5.3" /end AXIS_DESCR
/end CHARACTERISTIC
/begin CHARACTERISTIC sIepSigna.MPT_NEIGUNG_IEP "PT1- Filterzeitkonstante fuer Fahrzeugneigung" VALUE 0x21859E Parameter.ui8_S6_S3 0.99 UMRM___1_100_0_S6_S3 0.01 1 /end CHARACTERISTIC
/begin CHARACTERISTIC sIepSigna.MPT_AYREFAFAHRZEUGQUER_IEP "PT1- Filterzeitkonstante fuer Querbeschleunigung Fahrzeug" VALUE 0x21859D Parameter.ui8_S6_S3 0.99 UMRM___1_100_0_S6_S3 0.01 1 /end CHARACTERISTIC
/begin CHARACTERISTIC sIepSigna.MDT_NG_MOT_IEP "PT1- Filterzeitkonstante fuer ng_mot_iep" VALUE 0x21859C Parameter.ui8_S6_S3 0.99 UMRM___1_100_0_S6_S3 0.01 1 /end CHARACTERISTIC
/begin CHARACTERISTIC sIepSigna.SWI_M_MAXEMIAE_IEP "Schalter zur Auswahl des Eingangsmoments" VALUE 0x21859F Parameter.ui8_S6_S3 255 UMRM___1_1_0_S6_S3 0 255 /end CHARACTERISTIC
/begin CHARACTERISTIC sIepSigna.SWI_NOTLAUF_ABFRAGE_IEP "Schalter zum Einschalten der Abfrage des Notlaufkonzepts" VALUE 0x2185A0 Parameter.ui8_S6_S3 1 eBool_on_off_S6_S3 0 1 /end CHARACTERISTIC
/begin CHARACTERISTIC sIepSigna.NS_NMOT_IEP "EM Drehzahlschwelle, ab der m_mot und m_soll_iae beruecksichtigt werden bei der LP Bestimmung" VALUE 0x21859A Parameter.ui16_S6_S3 500 UMRM_U_MIN_1_1_0_S6_S3 0 500 /end CHARACTERISTIC
/begin CHARACTERISTIC sIepSigna.NS_MOT_HYS_IEP "Hysterese zu NS_MOT_IEP" VALUE 0x218598 Parameter.ui16_S6_S3 150 UMRM_U_MIN_1_1_0_S6_S3 0 150 /end CHARACTERISTIC
/begin CHARACTERISTIC sIepSignachber.K_TIST_START_IEP "Faktor zur Verlaengerung des Ist-Wertes von Lp2 nach Lp3 beim Erststart" VALUE 0x218520 Parameter.ui8_S6_S3 50 UMRM___1_1_0_S6_S3 0 50 /end CHARACTERISTIC
/begin CHARACTERISTIC sIepSignachber.KF_TIST_LP1LP2_IEP "Kennfeld zur Eingabe der Zeit die die IEP zum Erreichen des Leistungspunktes benoetigt" MAP 0x218380 Map.ui16.ui8.ui16_S6_S3 1000 UMRM_MSEC__10_1_0_S6_S3 0 1000
 /begin AXIS_DESCR STD_AXIS NO_INPUT_QUANTITY UMRM_BAR__1_1000_0_S6_S3 7 0 30 DEPOSIT ABSOLUTE MONOTONY STRICT_INCREASE /end AXIS_DESCR
 /begin AXIS_DESCR STD_AXIS NO_INPUT_QUANTITY UMRM_GRADC__1_1_M40_S6_S3 6 -40 215 DEPOSIT ABSOLUTE MONOTONY STRICT_INCREASE /end AXIS_DESCR
/end CHARACTERISTIC
/begin CHARACTERISTIC sIepSignachber.KF_TIST_LP2LP3_IEP "Kennfeld zur Eingabe der Zeit die die IEP zum Erreichen des Leistungspunktes benoetigt" MAP 0x218450 Map.ui16.ui8.ui16_S6_S3 1000 UMRM_MSEC__10_1_0_S6_S3 0 1000
 /begin AXIS_DESCR STD_AXIS NO_INPUT_QUANTITY UMRM_BAR__1_1000_0_S6_S3 7 0 30 DEPOSIT ABSOLUTE MONOTONY STRICT_INCREASE /end AXIS_DESCR
 /begin AXIS_DESCR STD_AXIS NO_INPUT_QUANTITY UMRM_GRADC__1_1_M40_S6_S3 6 -40 215 DEPOSIT ABSOLUTE MONOTONY STRICT_INCREASE /end AXIS_DESCR
/end CHARACTERISTIC
/begin CHARACTERISTIC sIepSignachber.KF_TIST_LP3LP2_IEP "Kennfeld zur Eingabe der Zeit die die IEP zum Erreichen des Leistungspunktes benoetigt" MAP 0x2184B8 Map.ui16.ui8.ui16_S6_S3 1000 UMRM_MSEC__10_1_0_S6_S3 0 1000
 /begin AXIS_DESCR STD_AXIS NO_INPUT_QUANTITY UMRM_BAR__1_1000_0_S6_S3 7 0 30 DEPOSIT ABSOLUTE MONOTONY STRICT_INCREASE /end AXIS_DESCR
 /begin AXIS_DESCR STD_AXIS NO_INPUT_QUANTITY UMRM_GRADC__1_1_M40_S6_S3 6 -40 215 DEPOSIT ABSOLUTE MONOTONY STRICT_INCREASE /end AXIS_DESCR
/end CHARACTERISTIC
/begin CHARACTERISTIC sIepSignachber.KF_TIST_LP2LP1_IEP "Kennfeld zur Eingabe der Zeit die die IEP zum Erreichen des Leistungspunktes benoetigt" MAP 0x2183E8 Map.ui16.ui8.ui16_S6_S3 1000 UMRM_MSEC__10_1_0_S6_S3 0 1000
 /begin AXIS_DESCR STD_AXIS NO_INPUT_QUANTITY UMRM_BAR__1_1000_0_S6_S3 7 0 30 DEPOSIT ABSOLUTE MONOTONY STRICT_INCREASE /end AXIS_DESCR
 /begin AXIS_DESCR STD_AXIS NO_INPUT_QUANTITY UMRM_GRADC__1_1_M40_S6_S3 6 -40 215 DEPOSIT ABSOLUTE MONOTONY STRICT_INCREASE /end AXIS_DESCR
/end CHARACTERISTIC
/begin CHARACTERISTIC sIepSoll.BM_ZFKTAKTIV_LPBER_IEP "Bitmaske zum Aktivieren der Einzelfunktionen der Leistungspunktberechnung" VALUE 0x217F30 Parameter.ui16_S6_S3 32767 UMRM___1_1_0_S6_S3 0 32767 /end CHARACTERISTIC
/begin CHARACTERISTIC sIepSoll.TEMP_SCHWELLE_LP_IEP "Temperaturschwelle bis zu der die IEP in einem hoeheren LP laeuft als LP1" VALUE 0x217F2C Parameter.fl32_S6_S3 190 UMRM_GRADC__1_1_0_S6_S3 -40 150 FORMAT "%5.3" /end CHARACTERISTIC
/begin CHARACTERISTIC sIepSoll.TEMP_SCHWELLE_LP_HYS_IEP "Hysterese zu TEMP_LP_IEP" VALUE 0x217F28 Parameter.fl32_S6_S3 10 UMRM_GRADC__1_1_0_S6_S3 0 10 FORMAT "%5.3" /end CHARACTERISTIC
/begin CHARACTERISTIC sIepSoll.LP_VORGABE_TEMP_IEP "Leistungspunktvorgabe fuer Temperaturleistungspunktanhebung" VALUE 0x217F36 Parameter.ui8_S6_S3 1 eIepSoll_S6_S3 2 3 /end CHARACTERISTIC
/begin CHARACTERISTIC sIepSoll.MMOT_SCHWELLE_LP2_IEP "Momentenschwelle, ab der der LP2 der el. Zusatzpumpe notwendig ist" VALUE 0x217F32 Parameter.ui16_S6_S3 200 UMRM_NM__1_1_0_S6_S3 0 200 /end CHARACTERISTIC
/begin CHARACTERISTIC sIepSoll.MMOT_SCHWELLE_LP3_IEP "Momentenschwelle, ab der der LP3 der el. Zusatzpumpe notwendig ist" VALUE 0x217F34 Parameter.ui16_S6_S3 600 UMRM_NM__1_1_0_S6_S3 0 600 /end CHARACTERISTIC
/begin CHARACTERISTIC sIepSoll.TAB_VORGABELP_IEP "Vorgabe Leistungspunkt der el. Zusatzpumpe" MAP 0x217F37 Matrix.ui8_S6_S3 3 eIepSoll_S6_S3 0 3
 /begin AXIS_DESCR FIX_AXIS NO_INPUT_QUANTITY ePosition_S6_S3 9 0 8 FIX_AXIS_PAR_DIST 0 1 9 /end AXIS_DESCR
 /begin AXIS_DESCR FIX_AXIS NO_INPUT_QUANTITY eBool_true_false_S6_S3 2 0 1 FIX_AXIS_PAR_DIST 0 1 2 /end AXIS_DESCR
/end CHARACTERISTIC
/begin CHARACTERISTIC sIepSonderfkt.T_WASH_FKT_IEP "Timer fuer Waschstrassen, ab wann Iep abschalten muss notwendig ist" VALUE 0x213362 Parameter.ui8_S6_S3 20 UMRM_SEC__1_1_0_S6_S3 0 20 /end CHARACTERISTIC
/begin CHARACTERISTIC sIepSonderfkt.T_MAXCGETRTIEF_NOTLAUF_IEP "Timer wie lange die IEPmaximal im Tieftemperaturbereich betrieben werden darf" VALUE 0x213360 Parameter.ui8_S6_S3 10 UMRM_SEC__1_1_0_S6_S3 0 10 /end CHARACTERISTIC
/begin CHARACTERISTIC sIepSonderfkt.NS_F_EINMAL_AUS_IEP "Drehzhalschwelle wann f_einmal_aus_iep TRUE wird" VALUE 0x213308 Parameter.ui16_S6_S3 1500 UMRM_U_MIN_1_1_0_S6_S3 0 1500 /end CHARACTERISTIC
/begin CHARACTERISTIC sIepSonderfkt.P_SYS_SCHWELLE_IEP "Schwelle des Systemsdrucks ueber der die IEP nicht betrieben werden darf" VALUE 0x213314 Parameter.ui16_S6_S3 20 UMRM_BAR__1_1000_0_S6_S3 0 20 /end CHARACTERISTIC
/begin CHARACTERISTIC sIepSonderfkt.TEMP_MAX_IEP "Maximale Getriebesumpftemperatur, bei der die Pumpebetrieben werden darf" VALUE 0x2132F8 Parameter.fl32_S6_S3 190 UMRM_GRADC__1_1_0_S6_S3 -40 150 FORMAT "%5.3" /end CHARACTERISTIC
/begin CHARACTERISTIC sIepSonderfkt.TEMP_MIN_IEP "Minimale Getriebesumpftemperatur, bei der die Pumpebetrieben werden darf" VALUE 0x2132FC Parameter.fl32_S6_S3 190 UMRM_GRADC__1_1_0_S6_S3 -40 150 FORMAT "%5.3" /end CHARACTERISTIC
/begin CHARACTERISTIC sIepSonderfkt.TEMP_TIEF_NOTLAUF_IEP "Minimale Getriebesumpftemperatur, bei der die Pumpe in Sondersituationen betrieben werden darf" VALUE 0x213304 Parameter.fl32_S6_S3 190 UMRM_GRADC__1_1_0_S6_S3 -40 150 FORMAT "%5.3" /end CHARACTERISTIC
/begin CHARACTERISTIC sIepSonderfkt.TEMP_HYS_IEP "Hysterese fuer die Schwellen der Getriebesumpftemperatur" VALUE 0x2132F4 Parameter.fl32_S6_S3 150 UMRM_GRADC__1_1_0_S6_S3 0 150 FORMAT "%5.3" /end CHARACTERISTIC
/begin CHARACTERISTIC sIepSonderfkt.TEMP_HYS_FEHLER_IEP "Hysterese fuer die Schwellen der Getriebesumpftemperatur" VALUE 0x2132F0 Parameter.fl32_S6_S3 150 UMRM_GRADC__1_1_0_S6_S3 0 150 FORMAT "%5.3" /end CHARACTERISTIC
/begin CHARACTERISTIC sIepSonderfkt.TEMP_AUFWAERM_IEP "Temperatur bis zu welcher die Aufwaermfunktion aktiv werden kann" VALUE 0x2132EC Parameter.fl32_S6_S3 190 UMRM_GRADC__1_1_0_S6_S3 -40 150 FORMAT "%5.3" /end CHARACTERISTIC
/begin CHARACTERISTIC sIepSonderfkt.TEMP_TIEF_AUFWAERM_IEP "Temperatur ab welcher Temperatur die IEP angesteuert werden darf" VALUE 0x213300 Parameter.fl32_S6_S3 190 UMRM_GRADC__1_1_0_S6_S3 -40 150 FORMAT "%5.3" /end CHARACTERISTIC
/begin CHARACTERISTIC sIepSonderfkt.P_SYS_AUFWAERM_IEP "Systemdruck bis der IEP bei der Aufwaermfunktion angesteuert werden darf" VALUE 0x213312 Parameter.ui16_S6_S3 20 UMRM_BAR__1_1000_0_S6_S3 0 20 /end CHARACTERISTIC
/begin CHARACTERISTIC sIepSonderfkt.P_SYS_AUFWAERM_HYS_IEP "Systemdruck bis der IEP bei der Aufwaermfunktion angesteuert werden darf" VALUE 0x213310 Parameter.ui16_S6_S3 20 UMRM_BAR__1_1000_0_S6_S3 0 20 /end CHARACTERISTIC
/begin CHARACTERISTIC sIepSonderfkt.SWI_ABFR_HAS_PSS_IEP "Schalter zur Auswahl, ob die K0 Befuellung beim Stuetzen des Systemdrucks mit beruecksichtigt werden soll:0 = K0 Befuellung beim Stuetzen nicht eruecksichtigt 1 = K0 Befuellung beim Stuetzen wird bruecksichtigt" VALUE 0x21335B Parameter.ui8_S6_S3 255 UMRM___1_1_0_S6_S3 0 255 /end CHARACTERISTIC
/begin CHARACTERISTIC sIepSonderfkt.P_SYSMIN_PSS_IEP "Schwelle des Systemdruck, ab der die IEP den Systemdruck stuetzen kann" VALUE 0x21330E Parameter.ui16_S6_S3 20 UMRM_BAR__1_1000_0_S6_S3 0 20 /end CHARACTERISTIC
/begin CHARACTERISTIC sIepSonderfkt.T_PSYS_PSS_IEP "Zeit, die die IEP beim Systemeinbruch unterstuetzen soll" VALUE 0x213361 Parameter.ui8_S6_S3 2 UMRM_SEC__1_100_0_S6_S3 0 2 /end CHARACTERISTIC
/begin CHARACTERISTIC sIepSonderfkt.SWI_NAB_LUFT_AKTIV_IEP "Einschalten des Erkennens Luft im Ansaugstutzen aufgrund langer Hochgeschwindigkeitsfahrt" VALUE 0x21335E Parameter.ui8_S6_S3 1 eBool_on_off_S6_S3 0 1 /end CHARACTERISTIC
/begin CHARACTERISTIC sIepSonderfkt.SWI_GEFAEL_LUFT_AKTIV_IEP "Einschalten des Erkennens Luft im Ansaugstutzen aufgrund Gefaelle" VALUE 0x21335D Parameter.ui8_S6_S3 1 eBool_on_off_S6_S3 0 1 /end CHARACTERISTIC
/begin CHARACTERISTIC sIepSonderfkt.SWI_SCHRAEG_LUFT_AKTIV_IEP "Einschalten des Erkennens Luft im Ansaugstutzen aufgrund Schraegstellung" VALUE 0x21335F Parameter.ui8_S6_S3 1 eBool_on_off_S6_S3 0 1 /end CHARACTERISTIC
/begin CHARACTERISTIC sIepSonderfkt.SWI_AUFWAERM_AKTIV_IEP "Schalter zum Einschalten der Aufwaermfkt:0 = Aufwaermfkt deaktiviert 1 = Aufwaermfkt aktiviert" VALUE 0x21335C Parameter.ui8_S6_S3 255 UMRM___1_1_0_S6_S3 0 255 /end CHARACTERISTIC
/begin CHARACTERISTIC sIepSonderfkt.T_GEFAELLE_IEP "Zeit, wie lange man in der Gefaellestrecke sein muss damit die Gefahr der Luftansaugung besteht" VALUE 0x213316 Parameter.ui16_S6_S3 600 UMRM_SEC__1_1_0_S6_S3 0 600 /end CHARACTERISTIC
/begin CHARACTERISTIC sIepSonderfkt.T_NAB_IEP "Zeit, wie lange man in der Phase der Hochgeschwindigkeit sein muss damit die Gefahr der Luftansaugung besteht" VALUE 0x21331C Parameter.ui16_S6_S3 600 UMRM_SEC__1_1_0_S6_S3 0 600 /end CHARACTERISTIC
/begin CHARACTERISTIC sIepSonderfkt.T_LUFT_AKTIV_IEP "Zeit, wie lange die IEP laufen muss, bis die Gefahr der Luftansaugen aufgehoben ist" VALUE 0x213318 Parameter.ui16_S6_S3 600 UMRM_SEC__1_1_0_S6_S3 0 600 /end CHARACTERISTIC
/begin CHARACTERISTIC sIepSonderfkt.T_LUFT_SPERR_IEP "Zeit, wie lange die IEP nicht laufen darf, wenn die Gefahr der Luftansaugen aufgehoben ist" VALUE 0x21331A Parameter.ui16_S6_S3 600 UMRM_SEC__1_1_0_S6_S3 0 600 /end CHARACTERISTIC
/begin CHARACTERISTIC sIepSonderfkt.GS_GEFAELLE_IEP "Schwelle fuer Gefaellestrecke" VALUE 0x21335A Parameter.ui8_S6_S3 84 UMRM_GRAD__1_3_M42_S6_S3 -42 42 /end CHARACTERISTIC
/begin CHARACTERISTIC sIepSonderfkt.NS_NAB_IEP "Schwelle fuer Abtriebsdrehzahl" VALUE 0x21330C Parameter.ui16_S6_S3 5000 UMRM_U_MIN_1_1_0_S6_S3 0 5000 /end CHARACTERISTIC
/begin CHARACTERISTIC sIepSonderfkt.NS_NAB_ERF_IEP "Drehzahl unterhalb der die IEP wegen der Gefahr des Oelverschaumens (Hochgeschwindigkeit) angeschalten wird" VALUE 0x21330A Parameter.ui16_S6_S3 5000 UMRM_U_MIN_1_1_0_S6_S3 0 5000 /end CHARACTERISTIC
/begin CHARACTERISTIC sIepSonderfkt.TEMP_AUFWAERMENDE_IEP "Sumpftemperatur, ab der die Aufwaermfunktion deaktiviert wird" VALUE 0x2132E8 Parameter.fl32_S6_S3 190 UMRM_GRADC__1_1_0_S6_S3 -40 150 FORMAT "%5.3" /end CHARACTERISTIC
/begin CHARACTERISTIC sIepSonderfkt.VS_FZGAUFWAERMSTOP_IEP "Unterhalb dieser Fahrzeugeschwindigkeit wird die Aufwaermfunktion eingeschaltet" VALUE 0x213320 Parameter.ui16_S6_S3 400 UMRM_KM_H_1_1_0_S6_S3 0 400 /end CHARACTERISTIC
/begin CHARACTERISTIC sIepSonderfkt.VS_FZGAUFWAERMSTOP_HYS_IEP "Fahrzeuggeschwindigkeitshysterse zum Ausschalten der Aufwaermfunktion" VALUE 0x21331E Parameter.ui16_S6_S3 400 UMRM_KM_H_1_1_0_S6_S3 0 400 /end CHARACTERISTIC
/begin CHARACTERISTIC sIepSonderfkt.AS_LUFT_SCHRAEGRECHTS_IEP "Querbeschleunigsungsschwelle zum Erkennen Schraeglage Fahrzeug" VALUE 0x2132E4 Parameter.fl32_S6_S3 200 UMRM_M_S2_1_1_0_S6_S3 -100 100 FORMAT "%5.3" /end CHARACTERISTIC
/begin CHARACTERISTIC sIepSonderfkt.AS_LUFT_SCHRAEGLINKS_IEP "Querbeschleunigsungsschwelle zum Erkennen Schraeglage Fahrzeug" VALUE 0x2132E0 Parameter.fl32_S6_S3 200 UMRM_M_S2_1_1_0_S6_S3 -100 100 FORMAT "%5.3" /end CHARACTERISTIC
/begin CHARACTERISTIC sIepSonderfkt.VS_LUFTSCHRAEG_IEP "Maximale Fahrzeuggeschwindigkeit in der die Schraeglage des Fahrzeugs erkannt werden kann (Luftansaugfunktion)" VALUE 0x213322 Parameter.ui16_S6_S3 400 UMRM_KM_H_1_1_0_S6_S3 0 400 /end CHARACTERISTIC
/begin CHARACTERISTIC sIepSonderfkt.TAB_STATUSIAE_PSS_IEP "Tabelle zur Vorgabe bei welchem IAE Status die IEP den Systemdruck stuetzen soll" CURVE 0x213363 Table.bool8_S6_S3 1 UMRM___1_1_0_S6_S3 0 1
 /begin AXIS_DESCR FIX_AXIS NO_INPUT_QUANTITY eKupStatusIae_S6_S3 9 0 8 FIX_AXIS_PAR_DIST 0 1 9 /end AXIS_DESCR
/end CHARACTERISTIC
/begin CHARACTERISTIC sIepSonderfkt.TAB_SCHALTUNG_PSS_IEP "Tabelle zur Vorgabe bei welcher Schaltung die IEP denSystemdruck stuetzen soll" MAP 0x21336C Matrix.bool8_S6_S3 1 UMRM___1_1_0_S6_S3 0 1
 /begin AXIS_DESCR FIX_AXIS NO_INPUT_QUANTITY eGangIdx_S6_S3 10 0 9 FIX_AXIS_PAR_DIST 0 1 10 /end AXIS_DESCR
 /begin AXIS_DESCR FIX_AXIS NO_INPUT_QUANTITY eGangIdx_S6_S3 10 0 9 FIX_AXIS_PAR_DIST 0 1 10 /end AXIS_DESCR
/end CHARACTERISTIC
/begin CHARACTERISTIC sIepSonderfkt.KL_T_AUFWAERM_IEP "Zeit, die die Aufwaermfunktion aktiv ist und die IEP laeuft" CURVE 0x213348 Curve.ui8.ui16_S6_S3 180 UMRM_SEC__1_1_0_S6_S3 0 180
 /begin AXIS_DESCR STD_AXIS NO_INPUT_QUANTITY UMRM_GRADC__1_1_M40_S6_S3 6 -40 215 DEPOSIT ABSOLUTE MONOTONY STRICT_INCREASE /end AXIS_DESCR
/end CHARACTERISTIC
/begin CHARACTERISTIC sIepSonderfkt.KL_NS_MOT_PUMPE_IEP "Drehzahlschwelle zur Einschaltverhinderung bei zu hohem Systemdruck" CURVE 0x213336 Curve.ui8.ui16_S6_S3 500 UMRM_U_MIN_1_1_0_S6_S3 0 500
 /begin AXIS_DESCR STD_AXIS NO_INPUT_QUANTITY UMRM_GRADC__1_1_M40_S6_S3 6 -40 215 DEPOSIT ABSOLUTE MONOTONY STRICT_INCREASE /end AXIS_DESCR
/end CHARACTERISTIC
/begin CHARACTERISTIC sIepSonderfkt.KL_NSMOT_PSS_IEP "Kennline zur Vorgabe bis zu welcher Getriebeeingangsdrehzahl die IEP den Systemdruck stuetzen soll" CURVE 0x213324 Curve.ui8.ui16_S6_S3 1600 UMRM_U_MIN_1_1_0_S6_S3 0 1600
 /begin AXIS_DESCR STD_AXIS NO_INPUT_QUANTITY UMRM_GRADC__1_1_M40_S6_S3 6 -40 215 DEPOSIT ABSOLUTE MONOTONY STRICT_INCREASE /end AXIS_DESCR
/end CHARACTERISTIC
/begin CHARACTERISTIC sK0Druck.SWI_NDWNDMUE_K0 "Umschalten zwischen IST-Drehzahl und Sollwertgenerierungswert fuer die Druckberechnung: SWI = 1: IST-Wert, SWI = 0: Sollwertgenerierung" VALUE 0x2136F6 Parameter.ui8_S6_S3 1 eBool_on_off_S6_S3 0 1 /end CHARACTERISTIC
/begin CHARACTERISTIC sK0Druck.P_MANUELL_K0 "Manuelle Druckvorgabe" VALUE 0x2133E4 Parameter.fl32_S6_S3 30 UMRM_BAR__1_1_0_S6_S3 0 30 FORMAT "%5.3" /end CHARACTERISTIC
/begin CHARACTERISTIC sK0Druck.PG_MANUELL_K0 "Manuelle Druckvorgabe" VALUE 0x2133D4 Parameter.fl32_S6_S3 1000 UMRM_BAR_SEC_1_1_0_S6_S3 0 1000 FORMAT "%5.3" /end CHARACTERISTIC
/begin CHARACTERISTIC sK0Druck.P_MAXDRUCK_K0 "Maximaler Ansteuerdruck der K0" VALUE 0x2133E8 Parameter.fl32_S6_S3 30 UMRM_BAR__1_1_0_S6_S3 0 30 FORMAT "%5.3" /end CHARACTERISTIC
/begin CHARACTERISTIC sK0Druck.PG_MAXDRUCK_K0 "Rampengradient fuer P_SYSMAX Ansteuerung" VALUE 0x2133D8 Parameter.fl32_S6_S3 2000 UMRM_BAR_SEC_1_1_0_S6_S3 0 2000 FORMAT "%5.3" /end CHARACTERISTIC
/begin CHARACTERISTIC sK0Druck.P_VENTILABLAG_K0 "Druckerhoehung zum weiteren Ausfahren des K0-Ventils zwecks Reinigung" VALUE 0x21359E Parameter.si16_S6_S3 20 UMRM_BAR__1_1000_0_S6_S3 0 20 /end CHARACTERISTIC
/begin CHARACTERISTIC sK0Druck.PS_VENTILABLAG_K0 "Systemdruckschwelle fuer K0-Ventilreinigungsfunktion" VALUE 0x21359C Parameter.si16_S6_S3 30 UMRM_BAR__1_1000_0_S6_S3 0 30 /end CHARACTERISTIC
/begin CHARACTERISTIC sK0Druck.PG_VENTILABLAG_AUF_K0 "Gradient der Aufbaurampe fuer K0-Ventilreinigungsfunktion" VALUE 0x2133E0 Parameter.fl32_S6_S3 2000 UMRM_BAR_SEC_1_1_0_S6_S3 0 2000 FORMAT "%5.3" /end CHARACTERISTIC
/begin CHARACTERISTIC sK0Druck.PG_VENTILABLAG_AB_K0 "Gradient der Abbaurampe fuer K0-Ventilreinigungsfunktion" VALUE 0x2133DC Parameter.fl32_S6_S3 2000 UMRM_BAR_SEC_1_1_0_S6_S3 -2000 0 FORMAT "%5.3" /end CHARACTERISTIC
/begin CHARACTERISTIC sK0Druck.MPT_MOMENTENABBAU_K0 "PT1-Filterkonstante zum Abfiltern von po_soll_k0" VALUE 0x2136F5 Parameter.ui8_S6_S3 0.99 UMRM___1_100_0_S6_S3 0.01 1 /end CHARACTERISTIC
/begin CHARACTERISTIC sK0Druck.PG_HYSABREG_K0 "Gradient fuer Rampe po_reg_k0" VALUE 0x2133D0 Parameter.fl32_S6_S3 1000 UMRM_BAR_SEC_1_1_0_S6_S3 0 1000 FORMAT "%5.3" /end CHARACTERISTIC
/begin CHARACTERISTIC sK0Druck.MPT_HYSAUF_K0 "PT1-Filterkonstante zum Auffiltern von p_hys_k0" VALUE 0x2136F4 Parameter.ui8_S6_S3 0.99 UMRM___1_100_0_S6_S3 0.01 1 /end CHARACTERISTIC
/begin CHARACTERISTIC sK0Druck.MPT_HYSAB_K0 "PT1-Filterkonstante zum Abfiltern von p_hys_k0" VALUE 0x2136F3 Parameter.ui8_S6_S3 0.99 UMRM___1_100_0_S6_S3 0.01 1 /end CHARACTERISTIC
/begin CHARACTERISTIC sK0Druck.SWI_POSOLLMUE_K0 "Umschalten zwischen Druckkennfeld (SWI=1) und MUE-Berechnung (SWI=0)" VALUE 0x2136F7 Parameter.ui8_S6_S3 1 eBool_on_off_S6_S3 0 1 /end CHARACTERISTIC
/begin CHARACTERISTIC sK0Druck.MPT_HYSABREG_K0 "PT1-Filterkonstante zum Abfiltern von p_hys_k0" VALUE 0x2136F2 Parameter.ui8_S6_S3 0.99 UMRM___1_100_0_S6_S3 0.01 1 /end CHARACTERISTIC
/begin CHARACTERISTIC sK0Druck.KL_FMUEC_K0 "KL6 f(sK0TempM.c_belag_k0): Korrekturoffset fuer mue" CURVE 0x2133EC Curve.fl32.fl32_S6_S3 400 UMRM___1_1_0_S6_S3 0 400 FORMAT "%5.3"
 /begin AXIS_DESCR STD_AXIS sK0TempM.c_belag_k0 UMRM_GRADC__1_1_0_S6_S3 6 -270 5000 DEPOSIT ABSOLUTE MONOTONY STRICT_INCREASE FORMAT "%5.3" /end AXIS_DESCR
/end CHARACTERISTIC
/begin CHARACTERISTIC sK0Druck.KL_P_K0STELLMAX "KL4 f(sK0Signa.n_vm_sync_k0): Maximale Druckvorgabe fuer po_soll_k0" CURVE 0x21341C Curve.fl32.fl32_S6_S3 30 UMRM_BAR__1_1_0_S6_S3 0 30 FORMAT "%5.3"
 /begin AXIS_DESCR STD_AXIS sK0Signa.n_vm_sync_k0_fl32 UMRM_U_MIN_1_1_0_S6_S3 4 -1E+037 1E+037 DEPOSIT ABSOLUTE MONOTONY STRICT_INCREASE FORMAT "%5.3" /end AXIS_DESCR
/end CHARACTERISTIC
/begin CHARACTERISTIC sK0Druck.KF_POFCGETRMSOLL_K0 "KF10x6 f(c_getr, sK0Mom.m_soll_k0_abs): Von der HAS aktivierbarer Hystereseanteil (in der Pulsadaption nicht beruecksichtigt)" MAP 0x213602 Map.ui8.si16.si16_S6_S3 30 UMRM_BAR__1_1000_0_S6_S3 0 30
 /begin AXIS_DESCR STD_AXIS NO_INPUT_QUANTITY UMRM_GRADC__1_1_M40_S6_S3 10 -40 215 DEPOSIT ABSOLUTE MONOTONY STRICT_INCREASE /end AXIS_DESCR
 /begin AXIS_DESCR STD_AXIS sK0Mom.m_soll_k0_abs UMRM_NM__1_1_0_S6_S3 6 -200 1300 DEPOSIT ABSOLUTE MONOTONY STRICT_INCREASE /end AXIS_DESCR
/end CHARACTERISTIC
/begin CHARACTERISTIC sK0Druck.KF_PHYSCGETRNMOT_K0 "KF10x4 f(c_getr, n_mot): Von der HAS aktivierbarer Hystereseanteil (in der Pulsadaption beruecksichtigt)" MAP 0x2135A0 Map.ui8.si16.si16_S6_S3 30 UMRM_BAR__1_1000_0_S6_S3 0 30
 /begin AXIS_DESCR STD_AXIS NO_INPUT_QUANTITY UMRM_GRADC__1_1_M40_S6_S3 10 -40 215 DEPOSIT ABSOLUTE MONOTONY STRICT_INCREASE /end AXIS_DESCR
 /begin AXIS_DESCR STD_AXIS NO_INPUT_QUANTITY UMRM_U_MIN_1_1_0_S6_S3 4 0 10000 DEPOSIT ABSOLUTE MONOTONY STRICT_INCREASE /end AXIS_DESCR
/end CHARACTERISTIC
/begin CHARACTERISTIC sK0Druck.KF_POREGCGETRNMOT_K0 "KF10x4 f(c_getr, n_mot): Druckoffset in der Regelung und in Geschlossen" MAP 0x213690 Map.ui8.si16.si16_S6_S3 10.5 UMRM_BAR__1_1000_0_S6_S3 -0.5 10
 /begin AXIS_DESCR STD_AXIS NO_INPUT_QUANTITY UMRM_GRADC__1_1_M40_S6_S3 10 -40 215 DEPOSIT ABSOLUTE MONOTONY STRICT_INCREASE /end AXIS_DESCR
 /begin AXIS_DESCR STD_AXIS NO_INPUT_QUANTITY UMRM_U_MIN_1_1_0_S6_S3 4 0 10000 DEPOSIT ABSOLUTE MONOTONY STRICT_INCREASE /end AXIS_DESCR
/end CHARACTERISTIC
/begin CHARACTERISTIC sK0Druck.KF_MUE_K0 "KF7x5 f(sK0Signa.nd_k0/sK0Sollw.wnd_k0, sK0Mom.m_soll_k0): Reibwertkennfeld der K0" MAP 0x2134E0 Map.fl32.fl32.fl32_S6_S3 400 UMRM_NM_BAR_1_1_0_S6_S3 0 400 FORMAT "%5.3"
 /begin AXIS_DESCR STD_AXIS NO_INPUT_QUANTITY UMRM_U_MIN_1_1_0_S6_S3 7 0 10000 DEPOSIT ABSOLUTE MONOTONY STRICT_INCREASE FORMAT "%5.3" /end AXIS_DESCR
 /begin AXIS_DESCR STD_AXIS NO_INPUT_QUANTITY UMRM_NM__1_1_0_S6_S3 5 0 1000 DEPOSIT ABSOLUTE MONOTONY STRICT_INCREASE FORMAT "%5.3" /end AXIS_DESCR
/end CHARACTERISTIC
/begin CHARACTERISTIC sK0Druck.KF_MUEKORR_K0 "KF6x5 f(c_getr, sK0Mom.m_soll_k0): Korrekturkenfeld Reibwert der K0" MAP 0x21343C Map.fl32.fl32.fl32_S6_S3 3000 UMRM_NM_BAR_1_1_0_S6_S3 -1500 1500 FORMAT "%5.3"
 /begin AXIS_DESCR STD_AXIS NO_INPUT_QUANTITY UMRM_GRADC__1_1_0_S6_S3 6 -270 5000 DEPOSIT ABSOLUTE MONOTONY STRICT_INCREASE FORMAT "%5.3" /end AXIS_DESCR
 /begin AXIS_DESCR STD_AXIS NO_INPUT_QUANTITY UMRM_NM__1_1_0_S6_S3 5 0 1000 DEPOSIT ABSOLUTE MONOTONY STRICT_INCREASE FORMAT "%5.3" /end AXIS_DESCR
/end CHARACTERISTIC
/begin CHARACTERISTIC sK0Mom.MPT_INIT_REGLER_K0 "PT1-Filterkonstante zum Abfiltern von m_init_filter_regler_k0" VALUE 0x213E50 Parameter.ui8_S6_S3 0.99 UMRM___1_100_0_S6_S3 0.01 1 /end CHARACTERISTIC
/begin CHARACTERISTIC sK0Mom.MPT_MOMABBAU_K0 "PT1-Filterkonstante zum Abfiltern des K0-Sollmoments auf 0 Nm im Zustand MOMENTENABBAU" VALUE 0x213E51 Parameter.ui8_S6_S3 0.99 UMRM___1_100_0_S6_S3 0.01 1 /end CHARACTERISTIC
/begin CHARACTERISTIC sK0Mom.MPT_MO_HILFSREGLER_MAX_K0 "PT1-Filterkonstante zum Filtern des maximal zulässigen Hilfsreglerwerts" VALUE 0x213E52 Parameter.ui8_S6_S3 0.99 UMRM___1_100_0_S6_S3 0.01 1 /end CHARACTERISTIC
/begin CHARACTERISTIC sK0Mom.SWI_INITVORSCHALT_K0 "Verwendung von mo_lastwechsel_k0 während Schaltungen: SWI = 1: ja, SWI = 0: nein" VALUE 0x213E54 Parameter.ui8_S6_S3 255 UMRM___1_1_0_S6_S3 0 255 /end CHARACTERISTIC
/begin CHARACTERISTIC sK0Mom.D_PT2_MSCHALTAB_K0 "Dämpfung des PT2-Filter zum Abfiltern des Schaltmoments m_schalt_k0" VALUE 0x213E4E Parameter.ui8_S6_S3 2.49 UMRM___1_100_0_S6_S3 0.01 2.5 /end CHARACTERISTIC
/begin CHARACTERISTIC sK0Mom.SWI_MSCHALTK0_SP "SWI = 0: m_schalt_k0 wird aufgebaut, sobald schaltung_k0_aktiv -- 0 (Schaltung physikalisch aktiv), SWI = 1: m_schalt_k0 wird aufgebaut, sobald schaltung_k0 -- 0 (Schaltung softwaretechnisch aktiv)" VALUE 0x213E55 Parameter.ui8_S6_S3 255 UMRM___1_1_0_S6_S3 0 255 /end CHARACTERISTIC
/begin CHARACTERISTIC sK0Mom.KI_HILFSREGLER_K0 "Parameter des I-Hilfsreglers in der Überanpressung" VALUE 0x2136F8 Parameter.fl32_S6_S3 10 UMRM___1_1_0_S6_S3 0 10 FORMAT "%5.3" /end CHARACTERISTIC
/begin CHARACTERISTIC sK0Mom.SWI_REGINITFILTER_K0 "Initialisierungsmethode K0-I-Regelanteil: SWI = 0: Initialisierung mit 0 , SWI = 1: sprungfreie Initialisierung" VALUE 0x213E57 Parameter.ui8_S6_S3 1 eBool_on_off_S6_S3 0 1 /end CHARACTERISTIC
/begin CHARACTERISTIC sK0Mom.MDT_D_ANTEIL_K0 "DT1-Filterkonstante K0-D-Regelanteil" VALUE 0x213E4F Parameter.ui8_S6_S3 0.99 UMRM___1_100_0_S6_S3 0.01 1 /end CHARACTERISTIC
/begin CHARACTERISTIC sK0Mom.T_REGRAMPSCHALT_K0 "Rampenzeit zum Umschalten der Gewichtung der P-, I-, D-Anteile des K0-Schlupfreglers während Schaltungen" VALUE 0x213E59 Parameter.ui8_S6_S3 2000 UMRM_MSEC__10_1_0_S6_S3 0 2000 /end CHARACTERISTIC
/begin CHARACTERISTIC sK0Mom.SWI_REGRAMPSCHALT_K0 "Umschalten der Gewichtung der P-, I-, D-Anteile des K0-Schlupfreglers während Schaltungen: SWI = 0: sprungförmige Umschaltung , SWI = 1: rampenförmige Überführung" VALUE 0x213E58 Parameter.ui8_S6_S3 1 eBool_on_off_S6_S3 0 1 /end CHARACTERISTIC
/begin CHARACTERISTIC sK0Mom.MPT_ZUNACHSYNCHRON_K0 "PT1-Filterkonstante zum Abfiltern von mo_k0zu" VALUE 0x213E53 Parameter.ui8_S6_S3 0.99 UMRM___1_100_0_S6_S3 0.01 1 /end CHARACTERISTIC
/begin CHARACTERISTIC sK0Mom.XDS_HILFSREGLER_K0 "Regelabweichung in der Überanpressung, ab der der I-Regler die Regelabweichung erkennt = Mindestregelabweichung in GESCHLOSSEN ab welcher der I-Überanpressungsregler aktiv ist (außerhalb Schaltungen)" VALUE 0x213AE0 Parameter.ui16_S6_S3 8000 UMRM_U_MIN_1_1_0_S6_S3 0 8000 /end CHARACTERISTIC
/begin CHARACTERISTIC sK0Mom.XDS_HILFSREGLERSCHALT_K0 "Regelabweichung in der Überanpressung während Schaltungen, ab der der I-Regler die Regelabweichung erkennt = Mindestregelabweichung in GESCHLOSSEN ab welcher der I-Überanpressungsregler aktiv ist (innerhalb Schaltungen)" VALUE 0x213ADE Parameter.ui16_S6_S3 8000 UMRM_U_MIN_1_1_0_S6_S3 0 8000 /end CHARACTERISTIC
/begin CHARACTERISTIC sK0Mom.WND_HILFSREGLER_K0 "Bei aktiviertem Hilfsregler anzufahrender Sollschlupf (nur Schlupfreduzierung)" VALUE 0x213ADC Parameter.ui16_S6_S3 8000 UMRM_U_MIN_1_1_0_S6_S3 0 8000 /end CHARACTERISTIC
/begin CHARACTERISTIC sK0Mom.SWI_REGELABWBETRAEGE_K0 "Verwendung der Betraege der Istdifferenzdrehzahl und der Solldifferenzdrehzahl zur Berechnung der Regelabweichung: SWI = 1: ja, SWI = 0: nein" VALUE 0x213E56 Parameter.ui8_S6_S3 1 eBool_on_off_S6_S3 0 1 /end CHARACTERISTIC
/begin CHARACTERISTIC sK0Mom.TAB_T_MOLWSPFGER_K0[_NORM] "TAB2 f(sK0Signa.zs_zug_k0): Dauer des Momentenoffsets beim Zug/Schub-Wechsel in SCHLUPFGEREGELT" CURVE 0x213E6B Table.ui8_S6_S3 2000 UMRM_MSEC__10_1_0_S6_S3 0 2000
 /begin AXIS_DESCR FIX_AXIS sK0Signa.zs_zug_k0 eBool_true_false_S6_S3 2 0 1 FIX_AXIS_PAR_DIST 0 1 2 /end AXIS_DESCR
/end CHARACTERISTIC
/begin CHARACTERISTIC sK0Mom.TAB_T_MOLWSPFGER_K0[_SPORT] "TAB2 f(sK0Signa.zs_zug_k0): Dauer des Momentenoffsets beim Zug/Schub-Wechsel in SCHLUPFGEREGELT" CURVE 0x213E6D Table.ui8_S6_S3 2000 UMRM_MSEC__10_1_0_S6_S3 0 2000
 /begin AXIS_DESCR FIX_AXIS sK0Signa.zs_zug_k0 eBool_true_false_S6_S3 2 0 1 FIX_AXIS_PAR_DIST 0 1 2 /end AXIS_DESCR
/end CHARACTERISTIC
/begin CHARACTERISTIC sK0Mom.TAB_MPT_MOLWSPFGER_K0[_NORM] "TAB2 f(sK0Signa.zs_zug_k0): Filterkonstante zum Abfiltern des Lastwechsel-Momentenoffsets in SCHLUPFGEREGELT" CURVE 0x213E5E Table.ui8_S6_S3 0.99 UMRM___1_100_0_S6_S3 0.01 1
 /begin AXIS_DESCR FIX_AXIS NO_INPUT_QUANTITY eBool_true_false_S6_S3 2 0 1 FIX_AXIS_PAR_DIST 0 1 2 /end AXIS_DESCR
/end CHARACTERISTIC
/begin CHARACTERISTIC sK0Mom.TAB_MPT_MOLWSPFGER_K0[_SPORT] "TAB2 f(sK0Signa.zs_zug_k0): Filterkonstante zum Abfiltern des Lastwechsel-Momentenoffsets in SCHLUPFGEREGELT" CURVE 0x213E60 Table.ui8_S6_S3 0.99 UMRM___1_100_0_S6_S3 0.01 1
 /begin AXIS_DESCR FIX_AXIS NO_INPUT_QUANTITY eBool_true_false_S6_S3 2 0 1 FIX_AXIS_PAR_DIST 0 1 2 /end AXIS_DESCR
/end CHARACTERISTIC
/begin CHARACTERISTIC sK0Mom.TAB_T_MOLWGERGES_K0[_NORM] "TAB2 f(sK0Signa.zs_zug_k0): Dauer des Momentenoffsets beim Zug/Schub-Wechsel in GEREGELTGESCHLOSSEN" CURVE 0x213E67 Table.ui8_S6_S3 2000 UMRM_MSEC__10_1_0_S6_S3 0 2000
 /begin AXIS_DESCR FIX_AXIS sK0Signa.zs_zug_k0 eBool_true_false_S6_S3 2 0 1 FIX_AXIS_PAR_DIST 0 1 2 /end AXIS_DESCR
/end CHARACTERISTIC
/begin CHARACTERISTIC sK0Mom.TAB_T_MOLWGERGES_K0[_SPORT] "TAB2 f(sK0Signa.zs_zug_k0): Dauer des Momentenoffsets beim Zug/Schub-Wechsel in GEREGELTGESCHLOSSEN" CURVE 0x213E69 Table.ui8_S6_S3 2000 UMRM_MSEC__10_1_0_S6_S3 0 2000
 /begin AXIS_DESCR FIX_AXIS sK0Signa.zs_zug_k0 eBool_true_false_S6_S3 2 0 1 FIX_AXIS_PAR_DIST 0 1 2 /end AXIS_DESCR
/end CHARACTERISTIC
/begin CHARACTERISTIC sK0Mom.TAB_MPT_MOLWGERGES_K0[_NORM] "TAB2 f(sK0Signa.zs_zug_k0): Filterkonstante zum Abfiltern des Lastwechsel-Momentenoffsets in GEREGELTGESCHLOSSEN" CURVE 0x213E5A Table.ui8_S6_S3 0.99 UMRM___1_100_0_S6_S3 0.01 1
 /begin AXIS_DESCR FIX_AXIS NO_INPUT_QUANTITY eBool_true_false_S6_S3 2 0 1 FIX_AXIS_PAR_DIST 0 1 2 /end AXIS_DESCR
/end CHARACTERISTIC
/begin CHARACTERISTIC sK0Mom.TAB_MPT_MOLWGERGES_K0[_SPORT] "TAB2 f(sK0Signa.zs_zug_k0): Filterkonstante zum Abfiltern des Lastwechsel-Momentenoffsets in GEREGELTGESCHLOSSEN" CURVE 0x213E5C Table.ui8_S6_S3 0.99 UMRM___1_100_0_S6_S3 0.01 1
 /begin AXIS_DESCR FIX_AXIS NO_INPUT_QUANTITY eBool_true_false_S6_S3 2 0 1 FIX_AXIS_PAR_DIST 0 1 2 /end AXIS_DESCR
/end CHARACTERISTIC
/begin CHARACTERISTIC sK0Mom.TAB_SWI_F_KI_K0 "TAB5 f(schaltung_anfahren_idx): Schalter zur Aktivierung der Gewichtung des Regler-I-Anteils" CURVE 0x213E62 Table.bool8_S6_S3 1 UMRM___1_1_0_S6_S3 0 1
 /begin AXIS_DESCR FIX_AXIS NO_INPUT_QUANTITY eSchaltungsIdx_S6_S3 5 0 4 FIX_AXIS_PAR_DIST 0 1 5 /end AXIS_DESCR
/end CHARACTERISTIC
/begin CHARACTERISTIC sK0Mom.TAB_MPT_MSCHALTAUF_K0 "TAB2x5 f(sK0Signa.zs_zug_k0, schaltung_anfahren_idx): Filterkonstante zum Auffiltern des Schaltmoments mo_schalt_k0" MAP 0x213E8D Matrix.ui8_S6_S3 0.99 UMRM___1_100_0_S6_S3 0.01 1
 /begin AXIS_DESCR FIX_AXIS sK0Signa.zs_zug_k0 eBool_true_false_S6_S3 2 0 1 FIX_AXIS_PAR_DIST 0 1 2 /end AXIS_DESCR
 /begin AXIS_DESCR FIX_AXIS NO_INPUT_QUANTITY eSchaltungsIdx_S6_S3 5 0 4 FIX_AXIS_PAR_DIST 0 1 5 /end AXIS_DESCR
/end CHARACTERISTIC
/begin CHARACTERISTIC sK0Mom.TAB_T_PT2_MSCHALTAB_K0 "TAB2x5 f(sK0Signa.zs_zug_k0, schaltung_anfahren_idx): Zeitkonstante des PT2-Filter zum Abfiltern des Schaltmoments mo_schalt_k0" MAP 0x213EA1 Matrix.ui8_S6_S3 2.49 UMRM___1_100_0_S6_S3 0.01 2.5
 /begin AXIS_DESCR FIX_AXIS sK0Signa.zs_zug_k0 eBool_true_false_S6_S3 2 0 1 FIX_AXIS_PAR_DIST 0 1 2 /end AXIS_DESCR
 /begin AXIS_DESCR FIX_AXIS NO_INPUT_QUANTITY eSchaltungsIdx_S6_S3 5 0 4 FIX_AXIS_PAR_DIST 0 1 5 /end AXIS_DESCR
/end CHARACTERISTIC
/begin CHARACTERISTIC sK0Mom.TAB_F_KPSCHALT_K0 "TAB2x5 f(sK0Signa.zs_zug_k0, schaltung_anfahren_idx): Gewichtung P-Anteil K0-Schlupfregler während Schaltungen" MAP 0x213E83 Matrix.ui8_S6_S3 2 UMRM___1_100_0_S6_S3 0 2
 /begin AXIS_DESCR FIX_AXIS sK0Signa.zs_zug_k0 eBool_true_false_S6_S3 2 0 1 FIX_AXIS_PAR_DIST 0 1 2 /end AXIS_DESCR
 /begin AXIS_DESCR FIX_AXIS NO_INPUT_QUANTITY eSchaltungsIdx_S6_S3 5 0 4 FIX_AXIS_PAR_DIST 0 1 5 /end AXIS_DESCR
/end CHARACTERISTIC
/begin CHARACTERISTIC sK0Mom.TAB_F_KISCHALT_K0 "TAB2x5 f(sK0Signa.zs_zug_k0, schaltung_anfahren_idx): Gewichtung I-Anteil K0-Schlupfregler während Schaltungen" MAP 0x213E79 Matrix.ui8_S6_S3 2 UMRM___1_100_0_S6_S3 0 2
 /begin AXIS_DESCR FIX_AXIS sK0Signa.zs_zug_k0 eBool_true_false_S6_S3 2 0 1 FIX_AXIS_PAR_DIST 0 1 2 /end AXIS_DESCR
 /begin AXIS_DESCR FIX_AXIS NO_INPUT_QUANTITY eSchaltungsIdx_S6_S3 5 0 4 FIX_AXIS_PAR_DIST 0 1 5 /end AXIS_DESCR
/end CHARACTERISTIC
/begin CHARACTERISTIC sK0Mom.TAB_F_KDSCHALT_K0 "TAB2x5 f(sK0Signa.zs_zug_k0, schaltung_anfahren_idx): Gewichtung D-Anteil K0-Schlupfregler während Schaltungen" MAP 0x213E6F Matrix.ui8_S6_S3 2 UMRM___1_100_0_S6_S3 0 2
 /begin AXIS_DESCR FIX_AXIS sK0Signa.zs_zug_k0 eBool_true_false_S6_S3 2 0 1 FIX_AXIS_PAR_DIST 0 1 2 /end AXIS_DESCR
 /begin AXIS_DESCR FIX_AXIS NO_INPUT_QUANTITY eSchaltungsIdx_S6_S3 5 0 4 FIX_AXIS_PAR_DIST 0 1 5 /end AXIS_DESCR
/end CHARACTERISTIC
/begin CHARACTERISTIC sK0Mom.TAB_MPT_ZUNACHREGELN_K0 "TAB2x5 f(sK0Signa.zs_zug_k0, schaltung_anfahren_idx): PT1-Filterkonstante zum Abfiltern von mo_k0zu" MAP 0x213E97 Matrix.ui8_S6_S3 0.99 UMRM___1_100_0_S6_S3 0.01 1
 /begin AXIS_DESCR FIX_AXIS sK0Signa.zs_zug_k0 eBool_true_false_S6_S3 2 0 1 FIX_AXIS_PAR_DIST 0 1 2 /end AXIS_DESCR
 /begin AXIS_DESCR FIX_AXIS NO_INPUT_QUANTITY eSchaltungsIdx_S6_S3 5 0 4 FIX_AXIS_PAR_DIST 0 1 5 /end AXIS_DESCR
/end CHARACTERISTIC
/begin CHARACTERISTIC sK0Mom.KL_MOK0ZU "KL6 f(sK0Signa.m_vmist_sync_k0): Minimaler Überanpressungsoffset der K0 im Zustand GESCHLOSSEN" CURVE 0x213B2A Curve.si16.si16_S6_S3 2000 UMRM_NM__1_1_0_S6_S3 -1000 1000
 /begin AXIS_DESCR STD_AXIS sK0Signa.m_vmist_sync_k0 UMRM_NM__1_1_0_S6_S3 6 -200 1300 DEPOSIT ABSOLUTE MONOTONY STRICT_INCREASE /end AXIS_DESCR
/end CHARACTERISTIC
/begin CHARACTERISTIC sK0Mom.KL_MGK0ZU "KL6 f(sK0Signa.m_vmist_sync_k0): Maximaler Gradient für den Aufbau des minimalen Überanpressungsoffsets der K0 im Zustand GESCHLOSSEN" CURVE 0x213AFA Curve.si16.ui16_S6_S3 10000 UMRM_NM_SEC_1_1_0_S6_S3 0 10000
 /begin AXIS_DESCR STD_AXIS sK0Signa.m_vmist_sync_k0 UMRM_NM__1_1_0_S6_S3 6 -200 1300 DEPOSIT ABSOLUTE MONOTONY STRICT_INCREASE /end AXIS_DESCR
/end CHARACTERISTIC
/begin CHARACTERISTIC sK0Mom.KL_MOK0SYNC "KL6 f(sK0Signa.m_vmist_sync_k0): Minimaler Überanpressungsoffset der K0 im Zustand Synchronisieren" CURVE 0x213B12 Curve.si16.si16_S6_S3 2000 UMRM_NM__1_1_0_S6_S3 -1000 1000
 /begin AXIS_DESCR STD_AXIS sK0Signa.m_vmist_sync_k0 UMRM_NM__1_1_0_S6_S3 6 -200 1300 DEPOSIT ABSOLUTE MONOTONY STRICT_INCREASE /end AXIS_DESCR
/end CHARACTERISTIC
/begin CHARACTERISTIC sK0Mom.KL_MGK0SYNC "KL6 f(sK0Signa.m_vmist_sync_k0): Maximaler Gradient für den Aufbau des minimalen Überanpressungsoffsets der K0 im Zustand Synchronisieren" CURVE 0x213AE2 Curve.si16.ui16_S6_S3 10000 UMRM_NM_SEC_1_1_0_S6_S3 0 10000
 /begin AXIS_DESCR STD_AXIS sK0Signa.m_vmist_sync_k0 UMRM_NM__1_1_0_S6_S3 6 -200 1300 DEPOSIT ABSOLUTE MONOTONY STRICT_INCREASE /end AXIS_DESCR
/end CHARACTERISTIC
/begin CHARACTERISTIC sK0Mom.KL_MS_MINREGD_K0 "KL5 f(sK0Signa.n_vm_sync_k0): Untere Stellgrenze bei Position D" CURVE 0x2136FC Curve.fl32.fl32_S6_S3 100 UMRM_BAR__1_1_0_S6_S3 0 100 FORMAT "%5.3"
 /begin AXIS_DESCR STD_AXIS sK0Signa.n_vm_sync_k0_fl32 UMRM_U_MIN_1_1_0_S6_S3 5 0 10000 DEPOSIT ABSOLUTE MONOTONY STRICT_INCREASE FORMAT "%5.3" /end AXIS_DESCR
/end CHARACTERISTIC
/begin CHARACTERISTIC sK0Mom.KL_MS_MINREGPN_K0 "KL5 f(sK0Signa.n_vm_sync_k0): Untere Stellgrenze bei Position P und N" CURVE 0x213724 Curve.fl32.fl32_S6_S3 100 UMRM_BAR__1_1_0_S6_S3 0 100 FORMAT "%5.3"
 /begin AXIS_DESCR STD_AXIS sK0Signa.n_vm_sync_k0_fl32 UMRM_U_MIN_1_1_0_S6_S3 5 0 10000 DEPOSIT ABSOLUTE MONOTONY STRICT_INCREASE FORMAT "%5.3" /end AXIS_DESCR
/end CHARACTERISTIC
/begin CHARACTERISTIC sK0Mom.KF_MOLWSPFGERK0S[_NORM] "KF4x4 f(sK0Signa.n_em_sync_k0, sK0Signa.m_vmsollgemvor_sync_k0): Momentenoffset bei Lastwechsel nach Schub in SCHLUPFGEREGELT" MAP 0x213D8E Map.si16.si16.si16_S6_S3 3000 UMRM_NM__1_1_0_S6_S3 -1500 1500
 /begin AXIS_DESCR STD_AXIS sK0Signa.n_em_sync_k0 UMRM_U_MIN_1_1_0_S6_S3 4 -10000 10000 DEPOSIT ABSOLUTE MONOTONY STRICT_INCREASE /end AXIS_DESCR
 /begin AXIS_DESCR STD_AXIS sK0Signa.m_vmsollgemvor_sync_k0 UMRM_NM__1_1_0_S6_S3 4 -1500 1500 DEPOSIT ABSOLUTE MONOTONY STRICT_INCREASE /end AXIS_DESCR
/end CHARACTERISTIC
/begin CHARACTERISTIC sK0Mom.KF_MOLWSPFGERK0S[_SPORT] "KF4x4 f(sK0Signa.n_em_sync_k0, sK0Signa.m_vmsollgemvor_sync_k0): Momentenoffset bei Lastwechsel nach Schub in SCHLUPFGEREGELT" MAP 0x213DBE Map.si16.si16.si16_S6_S3 3000 UMRM_NM__1_1_0_S6_S3 -1500 1500
 /begin AXIS_DESCR STD_AXIS sK0Signa.n_em_sync_k0 UMRM_U_MIN_1_1_0_S6_S3 4 -10000 10000 DEPOSIT ABSOLUTE MONOTONY STRICT_INCREASE /end AXIS_DESCR
 /begin AXIS_DESCR STD_AXIS sK0Signa.m_vmsollgemvor_sync_k0 UMRM_NM__1_1_0_S6_S3 4 -1500 1500 DEPOSIT ABSOLUTE MONOTONY STRICT_INCREASE /end AXIS_DESCR
/end CHARACTERISTIC
/begin CHARACTERISTIC sK0Mom.KF_MOLWSPFGERK0Z[_NORM] "KF4x4 f(sK0Signa.n_em_sync_k0, sK0Signa.m_vmsollgemvor_sync_k0): Momentenoffset bei Lastwechsel nach Zug in SCHLUPFGEREGELT" MAP 0x213DEE Map.si16.si16.si16_S6_S3 3000 UMRM_NM__1_1_0_S6_S3 -1500 1500
 /begin AXIS_DESCR STD_AXIS sK0Signa.n_em_sync_k0 UMRM_U_MIN_1_1_0_S6_S3 4 -10000 10000 DEPOSIT ABSOLUTE MONOTONY STRICT_INCREASE /end AXIS_DESCR
 /begin AXIS_DESCR STD_AXIS sK0Signa.m_vmsollgemvor_sync_k0 UMRM_NM__1_1_0_S6_S3 4 -1500 1500 DEPOSIT ABSOLUTE MONOTONY STRICT_INCREASE /end AXIS_DESCR
/end CHARACTERISTIC
/begin CHARACTERISTIC sK0Mom.KF_MOLWSPFGERK0Z[_SPORT] "KF4x4 f(sK0Signa.n_em_sync_k0, sK0Signa.m_vmsollgemvor_sync_k0): Momentenoffset bei Lastwechsel nach Zug in SCHLUPFGEREGELT" MAP 0x213E1E Map.si16.si16.si16_S6_S3 3000 UMRM_NM__1_1_0_S6_S3 -1500 1500
 /begin AXIS_DESCR STD_AXIS sK0Signa.n_em_sync_k0 UMRM_U_MIN_1_1_0_S6_S3 4 -10000 10000 DEPOSIT ABSOLUTE MONOTONY STRICT_INCREASE /end AXIS_DESCR
 /begin AXIS_DESCR STD_AXIS sK0Signa.m_vmsollgemvor_sync_k0 UMRM_NM__1_1_0_S6_S3 4 -1500 1500 DEPOSIT ABSOLUTE MONOTONY STRICT_INCREASE /end AXIS_DESCR
/end CHARACTERISTIC
/begin CHARACTERISTIC sK0Mom.KF_MOLWGERGESK0S[_NORM] "KF4x4 f(sK0Signa.n_em_sync_k0, sK0Signa.m_vmsollgemvor_sync_k0): Momentenoffset bei Lastwechsel nach Schub in GEREGELTGESCHLOSSEN" MAP 0x213CCE Map.si16.si16.si16_S6_S3 3000 UMRM_NM__1_1_0_S6_S3 -1500 1500
 /begin AXIS_DESCR STD_AXIS sK0Signa.n_em_sync_k0 UMRM_U_MIN_1_1_0_S6_S3 4 -10000 10000 DEPOSIT ABSOLUTE MONOTONY STRICT_INCREASE /end AXIS_DESCR
 /begin AXIS_DESCR STD_AXIS sK0Signa.m_vmsollgemvor_sync_k0 UMRM_NM__1_1_0_S6_S3 4 -1500 1500 DEPOSIT ABSOLUTE MONOTONY STRICT_INCREASE /end AXIS_DESCR
/end CHARACTERISTIC
/begin CHARACTERISTIC sK0Mom.KF_MOLWGERGESK0S[_SPORT] "KF4x4 f(sK0Signa.n_em_sync_k0, sK0Signa.m_vmsollgemvor_sync_k0): Momentenoffset bei Lastwechsel nach Schub in GEREGELTGESCHLOSSEN" MAP 0x213CFE Map.si16.si16.si16_S6_S3 3000 UMRM_NM__1_1_0_S6_S3 -1500 1500
 /begin AXIS_DESCR STD_AXIS sK0Signa.n_em_sync_k0 UMRM_U_MIN_1_1_0_S6_S3 4 -10000 10000 DEPOSIT ABSOLUTE MONOTONY STRICT_INCREASE /end AXIS_DESCR
 /begin AXIS_DESCR STD_AXIS sK0Signa.m_vmsollgemvor_sync_k0 UMRM_NM__1_1_0_S6_S3 4 -1500 1500 DEPOSIT ABSOLUTE MONOTONY STRICT_INCREASE /end AXIS_DESCR
/end CHARACTERISTIC
/begin CHARACTERISTIC sK0Mom.KF_MOLWGERGESK0Z[_NORM] "KF4x4 f(sK0Signa.n_em_sync_k0, sK0Signa.m_vmsollgemvor_sync_k0): Momentenoffset bei Lastwechsel nach Zug in GEREGELTGESCHLOSSEN" MAP 0x213D2E Map.si16.si16.si16_S6_S3 3000 UMRM_NM__1_1_0_S6_S3 -1500 1500
 /begin AXIS_DESCR STD_AXIS sK0Signa.n_em_sync_k0 UMRM_U_MIN_1_1_0_S6_S3 4 -10000 10000 DEPOSIT ABSOLUTE MONOTONY STRICT_INCREASE /end AXIS_DESCR
 /begin AXIS_DESCR STD_AXIS sK0Signa.m_vmsollgemvor_sync_k0 UMRM_NM__1_1_0_S6_S3 4 -1500 1500 DEPOSIT ABSOLUTE MONOTONY STRICT_INCREASE /end AXIS_DESCR
/end CHARACTERISTIC
/begin CHARACTERISTIC sK0Mom.KF_MOLWGERGESK0Z[_SPORT] "KF4x4 f(sK0Signa.n_em_sync_k0, sK0Signa.m_vmsollgemvor_sync_k0): Momentenoffset bei Lastwechsel nach Zug in GEREGELTGESCHLOSSEN" MAP 0x213D5E Map.si16.si16.si16_S6_S3 3000 UMRM_NM__1_1_0_S6_S3 -1500 1500
 /begin AXIS_DESCR STD_AXIS sK0Signa.n_em_sync_k0 UMRM_U_MIN_1_1_0_S6_S3 4 -10000 10000 DEPOSIT ABSOLUTE MONOTONY STRICT_INCREASE /end AXIS_DESCR
 /begin AXIS_DESCR STD_AXIS sK0Signa.m_vmsollgemvor_sync_k0 UMRM_NM__1_1_0_S6_S3 4 -1500 1500 DEPOSIT ABSOLUTE MONOTONY STRICT_INCREASE /end AXIS_DESCR
/end CHARACTERISTIC
/begin CHARACTERISTIC sK0Mom.KF_F_MOLW_K0[_NORM] "KF4x10 f(c_getr, istgang_sync_idx): Korrekturfaktor für den Momentenoffset bei Lastwechsel" MAP 0x213EAB Map.ui8.ui8.ui8_S6_S3 1 UMRM_PROZENT__1_100_0_S6_S3 0 1
 /begin AXIS_DESCR STD_AXIS NO_INPUT_QUANTITY UMRM_GRADC__1_1_M40_S6_S3 4 -40 140 DEPOSIT ABSOLUTE MONOTONY STRICT_INCREASE /end AXIS_DESCR
 /begin AXIS_DESCR STD_AXIS NO_INPUT_QUANTITY eGangIdx_S6_S3 10 0 9 DEPOSIT ABSOLUTE MONOTONY STRICT_INCREASE /end AXIS_DESCR
/end CHARACTERISTIC
/begin CHARACTERISTIC sK0Mom.KF_F_MOLW_K0[_SPORT] "KF4x10 f(c_getr, istgang_sync_idx): Korrekturfaktor für den Momentenoffset bei Lastwechsel" MAP 0x213EE1 Map.ui8.ui8.ui8_S6_S3 1 UMRM_PROZENT__1_100_0_S6_S3 0 1
 /begin AXIS_DESCR STD_AXIS NO_INPUT_QUANTITY UMRM_GRADC__1_1_M40_S6_S3 4 -40 140 DEPOSIT ABSOLUTE MONOTONY STRICT_INCREASE /end AXIS_DESCR
 /begin AXIS_DESCR STD_AXIS NO_INPUT_QUANTITY eGangIdx_S6_S3 10 0 9 DEPOSIT ABSOLUTE MONOTONY STRICT_INCREASE /end AXIS_DESCR
/end CHARACTERISTIC
/begin CHARACTERISTIC sK0Mom.KF_KPREGK0S "KF6x4 f(sK0Signa.n_vm_sync_k0, c_getr): P-Anteil K0-Schlupfregler im Schub" MAP 0x2139CC Map.fl32.fl32.fl32_S6_S3 10 UMRM___1_1_0_S6_S3 0 10 FORMAT "%5.3"
 /begin AXIS_DESCR STD_AXIS sK0Signa.n_vm_sync_k0_fl32 UMRM_U_MIN_1_1_0_S6_S3 6 0 10000 DEPOSIT ABSOLUTE MONOTONY STRICT_INCREASE FORMAT "%5.3" /end AXIS_DESCR
 /begin AXIS_DESCR STD_AXIS NO_INPUT_QUANTITY UMRM_GRADC__1_1_0_S6_S3 4 -40 215 DEPOSIT ABSOLUTE MONOTONY STRICT_INCREASE FORMAT "%5.3" /end AXIS_DESCR
/end CHARACTERISTIC
/begin CHARACTERISTIC sK0Mom.KF_KPREGK0Z "KF6x4 f(sK0Signa.n_vm_sync_k0, c_getr): P-Anteil K0-Schlupfregler im Zug" MAP 0x213A54 Map.fl32.fl32.fl32_S6_S3 10 UMRM___1_1_0_S6_S3 0 10 FORMAT "%5.3"
 /begin AXIS_DESCR STD_AXIS sK0Signa.n_vm_sync_k0_fl32 UMRM_U_MIN_1_1_0_S6_S3 6 0 10000 DEPOSIT ABSOLUTE MONOTONY STRICT_INCREASE FORMAT "%5.3" /end AXIS_DESCR
 /begin AXIS_DESCR STD_AXIS NO_INPUT_QUANTITY UMRM_GRADC__1_1_0_S6_S3 4 -40 215 DEPOSIT ABSOLUTE MONOTONY STRICT_INCREASE FORMAT "%5.3" /end AXIS_DESCR
/end CHARACTERISTIC
/begin CHARACTERISTIC sK0Mom.KF_KIREGK0S "KF6x4 f(sK0Signa.n_vm_sync_k0, c_getr): I-Anteil K0-Schlupfregler im Schub" MAP 0x2138BC Map.fl32.fl32.fl32_S6_S3 10 UMRM___1_1_0_S6_S3 0 10 FORMAT "%5.3"
 /begin AXIS_DESCR STD_AXIS sK0Signa.n_vm_sync_k0_fl32 UMRM_U_MIN_1_1_0_S6_S3 6 0 10000 DEPOSIT ABSOLUTE MONOTONY STRICT_INCREASE FORMAT "%5.3" /end AXIS_DESCR
 /begin AXIS_DESCR STD_AXIS NO_INPUT_QUANTITY UMRM_GRADC__1_1_0_S6_S3 4 -40 215 DEPOSIT ABSOLUTE MONOTONY STRICT_INCREASE FORMAT "%5.3" /end AXIS_DESCR
/end CHARACTERISTIC
/begin CHARACTERISTIC sK0Mom.KF_KIREGK0Z "KF6x4 f(sK0Signa.n_vm_sync_k0, c_getr): I-Anteil K0-Schlupfregler im Zug" MAP 0x213944 Map.fl32.fl32.fl32_S6_S3 10 UMRM___1_1_0_S6_S3 0 10 FORMAT "%5.3"
 /begin AXIS_DESCR STD_AXIS sK0Signa.n_vm_sync_k0_fl32 UMRM_U_MIN_1_1_0_S6_S3 6 0 10000 DEPOSIT ABSOLUTE MONOTONY STRICT_INCREASE FORMAT "%5.3" /end AXIS_DESCR
 /begin AXIS_DESCR STD_AXIS NO_INPUT_QUANTITY UMRM_GRADC__1_1_0_S6_S3 4 -40 215 DEPOSIT ABSOLUTE MONOTONY STRICT_INCREASE FORMAT "%5.3" /end AXIS_DESCR
/end CHARACTERISTIC
/begin CHARACTERISTIC sK0Mom.KF_KDREGK0S "KF6x4 f(sK0Signa.n_vm_sync_k0, c_getr): D-Anteil K0-Schlupfregler im Schub" MAP 0x2137AC Map.fl32.fl32.fl32_S6_S3 10 UMRM___1_1_0_S6_S3 0 10 FORMAT "%5.3"
 /begin AXIS_DESCR STD_AXIS sK0Signa.n_vm_sync_k0_fl32 UMRM_U_MIN_1_1_0_S6_S3 6 0 10000 DEPOSIT ABSOLUTE MONOTONY STRICT_INCREASE FORMAT "%5.3" /end AXIS_DESCR
 /begin AXIS_DESCR STD_AXIS NO_INPUT_QUANTITY UMRM_GRADC__1_1_0_S6_S3 4 -40 215 DEPOSIT ABSOLUTE MONOTONY STRICT_INCREASE FORMAT "%5.3" /end AXIS_DESCR
/end CHARACTERISTIC
/begin CHARACTERISTIC sK0Mom.KF_KDREGK0Z "KF6x4 f(sK0Signa.n_vm_sync_k0, c_getr): D-Anteil K0-Schlupfregler im Zug" MAP 0x213834 Map.fl32.fl32.fl32_S6_S3 10 UMRM___1_1_0_S6_S3 0 10 FORMAT "%5.3"
 /begin AXIS_DESCR STD_AXIS sK0Signa.n_vm_sync_k0_fl32 UMRM_U_MIN_1_1_0_S6_S3 6 0 10000 DEPOSIT ABSOLUTE MONOTONY STRICT_INCREASE FORMAT "%5.3" /end AXIS_DESCR
 /begin AXIS_DESCR STD_AXIS NO_INPUT_QUANTITY UMRM_GRADC__1_1_0_S6_S3 4 -40 215 DEPOSIT ABSOLUTE MONOTONY STRICT_INCREASE FORMAT "%5.3" /end AXIS_DESCR
/end CHARACTERISTIC
/begin CHARACTERISTIC STD.KF_MOSCHALTK0[_00] "KF4x6 f(sK0Signa.n_em_sync_k0, sK0Signa.m_motist_sync_k0): Schaltmomentenoffset in Schaltungen" MAP 0x213F18 Map.si16.si16.si16_S6_S3 3000 UMRM_NM__1_1_0_S6_S3 -1500 1500
 /begin AXIS_DESCR STD_AXIS sK0Signa.n_em_sync_k0 UMRM_U_MIN_1_1_0_S6_S3 4 0 10000 DEPOSIT ABSOLUTE MONOTONY STRICT_INCREASE /end AXIS_DESCR
 /begin AXIS_DESCR STD_AXIS sK0Signa.m_motist_sync_k0 UMRM_NM__1_1_0_S6_S3 6 -200 1300 DEPOSIT ABSOLUTE MONOTONY STRICT_INCREASE /end AXIS_DESCR
/end CHARACTERISTIC
/begin CHARACTERISTIC STD.KF_MOSCHALTK0[_12] "KF4x6 f(sK0Signa.n_em_sync_k0, sK0Signa.m_motist_sync_k0): Schaltmomentenoffset in Schaltungen" MAP 0x213F5C Map.si16.si16.si16_S6_S3 3000 UMRM_NM__1_1_0_S6_S3 -1500 1500
 /begin AXIS_DESCR STD_AXIS sK0Signa.n_em_sync_k0 UMRM_U_MIN_1_1_0_S6_S3 4 0 10000 DEPOSIT ABSOLUTE MONOTONY STRICT_INCREASE /end AXIS_DESCR
 /begin AXIS_DESCR STD_AXIS sK0Signa.m_motist_sync_k0 UMRM_NM__1_1_0_S6_S3 6 -200 1300 DEPOSIT ABSOLUTE MONOTONY STRICT_INCREASE /end AXIS_DESCR
/end CHARACTERISTIC
/begin CHARACTERISTIC STD.KF_MOSCHALTK0[_23] "KF4x6 f(sK0Signa.n_em_sync_k0, sK0Signa.m_motist_sync_k0): Schaltmomentenoffset in Schaltungen" MAP 0x213FA0 Map.si16.si16.si16_S6_S3 3000 UMRM_NM__1_1_0_S6_S3 -1500 1500
 /begin AXIS_DESCR STD_AXIS sK0Signa.n_em_sync_k0 UMRM_U_MIN_1_1_0_S6_S3 4 0 10000 DEPOSIT ABSOLUTE MONOTONY STRICT_INCREASE /end AXIS_DESCR
 /begin AXIS_DESCR STD_AXIS sK0Signa.m_motist_sync_k0 UMRM_NM__1_1_0_S6_S3 6 -200 1300 DEPOSIT ABSOLUTE MONOTONY STRICT_INCREASE /end AXIS_DESCR
/end CHARACTERISTIC
/begin CHARACTERISTIC STD.KF_MOSCHALTK0[_34] "KF4x6 f(sK0Signa.n_em_sync_k0, sK0Signa.m_motist_sync_k0): Schaltmomentenoffset in Schaltungen" MAP 0x213FE4 Map.si16.si16.si16_S6_S3 3000 UMRM_NM__1_1_0_S6_S3 -1500 1500
 /begin AXIS_DESCR STD_AXIS sK0Signa.n_em_sync_k0 UMRM_U_MIN_1_1_0_S6_S3 4 0 10000 DEPOSIT ABSOLUTE MONOTONY STRICT_INCREASE /end AXIS_DESCR
 /begin AXIS_DESCR STD_AXIS sK0Signa.m_motist_sync_k0 UMRM_NM__1_1_0_S6_S3 6 -200 1300 DEPOSIT ABSOLUTE MONOTONY STRICT_INCREASE /end AXIS_DESCR
/end CHARACTERISTIC
/begin CHARACTERISTIC STD.KF_MOSCHALTK0[_45] "KF4x6 f(sK0Signa.n_em_sync_k0, sK0Signa.m_motist_sync_k0): Schaltmomentenoffset in Schaltungen" MAP 0x214028 Map.si16.si16.si16_S6_S3 3000 UMRM_NM__1_1_0_S6_S3 -1500 1500
 /begin AXIS_DESCR STD_AXIS sK0Signa.n_em_sync_k0 UMRM_U_MIN_1_1_0_S6_S3 4 0 10000 DEPOSIT ABSOLUTE MONOTONY STRICT_INCREASE /end AXIS_DESCR
 /begin AXIS_DESCR STD_AXIS sK0Signa.m_motist_sync_k0 UMRM_NM__1_1_0_S6_S3 6 -200 1300 DEPOSIT ABSOLUTE MONOTONY STRICT_INCREASE /end AXIS_DESCR
/end CHARACTERISTIC
/begin CHARACTERISTIC STD.KF_MOSCHALTK0[_56] "KF4x6 f(sK0Signa.n_em_sync_k0, sK0Signa.m_motist_sync_k0): Schaltmomentenoffset in Schaltungen" MAP 0x21406C Map.si16.si16.si16_S6_S3 3000 UMRM_NM__1_1_0_S6_S3 -1500 1500
 /begin AXIS_DESCR STD_AXIS sK0Signa.n_em_sync_k0 UMRM_U_MIN_1_1_0_S6_S3 4 0 10000 DEPOSIT ABSOLUTE MONOTONY STRICT_INCREASE /end AXIS_DESCR
 /begin AXIS_DESCR STD_AXIS sK0Signa.m_motist_sync_k0 UMRM_NM__1_1_0_S6_S3 6 -200 1300 DEPOSIT ABSOLUTE MONOTONY STRICT_INCREASE /end AXIS_DESCR
/end CHARACTERISTIC
/begin CHARACTERISTIC STD.KF_MOSCHALTK0[_67] "KF4x6 f(sK0Signa.n_em_sync_k0, sK0Signa.m_motist_sync_k0): Schaltmomentenoffset in Schaltungen" MAP 0x2140B0 Map.si16.si16.si16_S6_S3 3000 UMRM_NM__1_1_0_S6_S3 -1500 1500
 /begin AXIS_DESCR STD_AXIS sK0Signa.n_em_sync_k0 UMRM_U_MIN_1_1_0_S6_S3 4 0 10000 DEPOSIT ABSOLUTE MONOTONY STRICT_INCREASE /end AXIS_DESCR
 /begin AXIS_DESCR STD_AXIS sK0Signa.m_motist_sync_k0 UMRM_NM__1_1_0_S6_S3 6 -200 1300 DEPOSIT ABSOLUTE MONOTONY STRICT_INCREASE /end AXIS_DESCR
/end CHARACTERISTIC
/begin CHARACTERISTIC STD.KF_MOSCHALTK0[_78] "KF4x6 f(sK0Signa.n_em_sync_k0, sK0Signa.m_motist_sync_k0): Schaltmomentenoffset in Schaltungen" MAP 0x2140F4 Map.si16.si16.si16_S6_S3 3000 UMRM_NM__1_1_0_S6_S3 -1500 1500
 /begin AXIS_DESCR STD_AXIS sK0Signa.n_em_sync_k0 UMRM_U_MIN_1_1_0_S6_S3 4 0 10000 DEPOSIT ABSOLUTE MONOTONY STRICT_INCREASE /end AXIS_DESCR
 /begin AXIS_DESCR STD_AXIS sK0Signa.m_motist_sync_k0 UMRM_NM__1_1_0_S6_S3 6 -200 1300 DEPOSIT ABSOLUTE MONOTONY STRICT_INCREASE /end AXIS_DESCR
/end CHARACTERISTIC
/begin CHARACTERISTIC STD.KF_MOSCHALTK0[_21] "KF4x6 f(sK0Signa.n_em_sync_k0, sK0Signa.m_motist_sync_k0): Schaltmomentenoffset in Schaltungen" MAP 0x214138 Map.si16.si16.si16_S6_S3 3000 UMRM_NM__1_1_0_S6_S3 -1500 1500
 /begin AXIS_DESCR STD_AXIS sK0Signa.n_em_sync_k0 UMRM_U_MIN_1_1_0_S6_S3 4 0 10000 DEPOSIT ABSOLUTE MONOTONY STRICT_INCREASE /end AXIS_DESCR
 /begin AXIS_DESCR STD_AXIS sK0Signa.m_motist_sync_k0 UMRM_NM__1_1_0_S6_S3 6 -200 1300 DEPOSIT ABSOLUTE MONOTONY STRICT_INCREASE /end AXIS_DESCR
/end CHARACTERISTIC
/begin CHARACTERISTIC STD.KF_MOSCHALTK0[_32] "KF4x6 f(sK0Signa.n_em_sync_k0, sK0Signa.m_motist_sync_k0): Schaltmomentenoffset in Schaltungen" MAP 0x21417C Map.si16.si16.si16_S6_S3 3000 UMRM_NM__1_1_0_S6_S3 -1500 1500
 /begin AXIS_DESCR STD_AXIS sK0Signa.n_em_sync_k0 UMRM_U_MIN_1_1_0_S6_S3 4 0 10000 DEPOSIT ABSOLUTE MONOTONY STRICT_INCREASE /end AXIS_DESCR
 /begin AXIS_DESCR STD_AXIS sK0Signa.m_motist_sync_k0 UMRM_NM__1_1_0_S6_S3 6 -200 1300 DEPOSIT ABSOLUTE MONOTONY STRICT_INCREASE /end AXIS_DESCR
/end CHARACTERISTIC
/begin CHARACTERISTIC STD.KF_MOSCHALTK0[_43] "KF4x6 f(sK0Signa.n_em_sync_k0, sK0Signa.m_motist_sync_k0): Schaltmomentenoffset in Schaltungen" MAP 0x2141C0 Map.si16.si16.si16_S6_S3 3000 UMRM_NM__1_1_0_S6_S3 -1500 1500
 /begin AXIS_DESCR STD_AXIS sK0Signa.n_em_sync_k0 UMRM_U_MIN_1_1_0_S6_S3 4 0 10000 DEPOSIT ABSOLUTE MONOTONY STRICT_INCREASE /end AXIS_DESCR
 /begin AXIS_DESCR STD_AXIS sK0Signa.m_motist_sync_k0 UMRM_NM__1_1_0_S6_S3 6 -200 1300 DEPOSIT ABSOLUTE MONOTONY STRICT_INCREASE /end AXIS_DESCR
/end CHARACTERISTIC
/begin CHARACTERISTIC STD.KF_MOSCHALTK0[_54] "KF4x6 f(sK0Signa.n_em_sync_k0, sK0Signa.m_motist_sync_k0): Schaltmomentenoffset in Schaltungen" MAP 0x214204 Map.si16.si16.si16_S6_S3 3000 UMRM_NM__1_1_0_S6_S3 -1500 1500
 /begin AXIS_DESCR STD_AXIS sK0Signa.n_em_sync_k0 UMRM_U_MIN_1_1_0_S6_S3 4 0 10000 DEPOSIT ABSOLUTE MONOTONY STRICT_INCREASE /end AXIS_DESCR
 /begin AXIS_DESCR STD_AXIS sK0Signa.m_motist_sync_k0 UMRM_NM__1_1_0_S6_S3 6 -200 1300 DEPOSIT ABSOLUTE MONOTONY STRICT_INCREASE /end AXIS_DESCR
/end CHARACTERISTIC
/begin CHARACTERISTIC STD.KF_MOSCHALTK0[_65] "KF4x6 f(sK0Signa.n_em_sync_k0, sK0Signa.m_motist_sync_k0): Schaltmomentenoffset in Schaltungen" MAP 0x214248 Map.si16.si16.si16_S6_S3 3000 UMRM_NM__1_1_0_S6_S3 -1500 1500
 /begin AXIS_DESCR STD_AXIS sK0Signa.n_em_sync_k0 UMRM_U_MIN_1_1_0_S6_S3 4 0 10000 DEPOSIT ABSOLUTE MONOTONY STRICT_INCREASE /end AXIS_DESCR
 /begin AXIS_DESCR STD_AXIS sK0Signa.m_motist_sync_k0 UMRM_NM__1_1_0_S6_S3 6 -200 1300 DEPOSIT ABSOLUTE MONOTONY STRICT_INCREASE /end AXIS_DESCR
/end CHARACTERISTIC
/begin CHARACTERISTIC STD.KF_MOSCHALTK0[_76] "KF4x6 f(sK0Signa.n_em_sync_k0, sK0Signa.m_motist_sync_k0): Schaltmomentenoffset in Schaltungen" MAP 0x21428C Map.si16.si16.si16_S6_S3 3000 UMRM_NM__1_1_0_S6_S3 -1500 1500
 /begin AXIS_DESCR STD_AXIS sK0Signa.n_em_sync_k0 UMRM_U_MIN_1_1_0_S6_S3 4 0 10000 DEPOSIT ABSOLUTE MONOTONY STRICT_INCREASE /end AXIS_DESCR
 /begin AXIS_DESCR STD_AXIS sK0Signa.m_motist_sync_k0 UMRM_NM__1_1_0_S6_S3 6 -200 1300 DEPOSIT ABSOLUTE MONOTONY STRICT_INCREASE /end AXIS_DESCR
/end CHARACTERISTIC
/begin CHARACTERISTIC STD.KF_MOSCHALTK0[_87] "KF4x6 f(sK0Signa.n_em_sync_k0, sK0Signa.m_motist_sync_k0): Schaltmomentenoffset in Schaltungen" MAP 0x2142D0 Map.si16.si16.si16_S6_S3 3000 UMRM_NM__1_1_0_S6_S3 -1500 1500
 /begin AXIS_DESCR STD_AXIS sK0Signa.n_em_sync_k0 UMRM_U_MIN_1_1_0_S6_S3 4 0 10000 DEPOSIT ABSOLUTE MONOTONY STRICT_INCREASE /end AXIS_DESCR
 /begin AXIS_DESCR STD_AXIS sK0Signa.m_motist_sync_k0 UMRM_NM__1_1_0_S6_S3 6 -200 1300 DEPOSIT ABSOLUTE MONOTONY STRICT_INCREASE /end AXIS_DESCR
/end CHARACTERISTIC
/begin CHARACTERISTIC STD.KF_MOSCHALTK0[_31] "KF4x6 f(sK0Signa.n_em_sync_k0, sK0Signa.m_motist_sync_k0): Schaltmomentenoffset in Schaltungen" MAP 0x214314 Map.si16.si16.si16_S6_S3 3000 UMRM_NM__1_1_0_S6_S3 -1500 1500
 /begin AXIS_DESCR STD_AXIS sK0Signa.n_em_sync_k0 UMRM_U_MIN_1_1_0_S6_S3 4 0 10000 DEPOSIT ABSOLUTE MONOTONY STRICT_INCREASE /end AXIS_DESCR
 /begin AXIS_DESCR STD_AXIS sK0Signa.m_motist_sync_k0 UMRM_NM__1_1_0_S6_S3 6 -200 1300 DEPOSIT ABSOLUTE MONOTONY STRICT_INCREASE /end AXIS_DESCR
/end CHARACTERISTIC
/begin CHARACTERISTIC STD.KF_MOSCHALTK0[_42] "KF4x6 f(sK0Signa.n_em_sync_k0, sK0Signa.m_motist_sync_k0): Schaltmomentenoffset in Schaltungen" MAP 0x214358 Map.si16.si16.si16_S6_S3 3000 UMRM_NM__1_1_0_S6_S3 -1500 1500
 /begin AXIS_DESCR STD_AXIS sK0Signa.n_em_sync_k0 UMRM_U_MIN_1_1_0_S6_S3 4 0 10000 DEPOSIT ABSOLUTE MONOTONY STRICT_INCREASE /end AXIS_DESCR
 /begin AXIS_DESCR STD_AXIS sK0Signa.m_motist_sync_k0 UMRM_NM__1_1_0_S6_S3 6 -200 1300 DEPOSIT ABSOLUTE MONOTONY STRICT_INCREASE /end AXIS_DESCR
/end CHARACTERISTIC
/begin CHARACTERISTIC STD.KF_MOSCHALTK0[_53] "KF4x6 f(sK0Signa.n_em_sync_k0, sK0Signa.m_motist_sync_k0): Schaltmomentenoffset in Schaltungen" MAP 0x21439C Map.si16.si16.si16_S6_S3 3000 UMRM_NM__1_1_0_S6_S3 -1500 1500
 /begin AXIS_DESCR STD_AXIS sK0Signa.n_em_sync_k0 UMRM_U_MIN_1_1_0_S6_S3 4 0 10000 DEPOSIT ABSOLUTE MONOTONY STRICT_INCREASE /end AXIS_DESCR
 /begin AXIS_DESCR STD_AXIS sK0Signa.m_motist_sync_k0 UMRM_NM__1_1_0_S6_S3 6 -200 1300 DEPOSIT ABSOLUTE MONOTONY STRICT_INCREASE /end AXIS_DESCR
/end CHARACTERISTIC
/begin CHARACTERISTIC STD.KF_MOSCHALTK0[_51] "KF4x6 f(sK0Signa.n_em_sync_k0, sK0Signa.m_motist_sync_k0): Schaltmomentenoffset in Schaltungen" MAP 0x2143E0 Map.si16.si16.si16_S6_S3 3000 UMRM_NM__1_1_0_S6_S3 -1500 1500
 /begin AXIS_DESCR STD_AXIS sK0Signa.n_em_sync_k0 UMRM_U_MIN_1_1_0_S6_S3 4 0 10000 DEPOSIT ABSOLUTE MONOTONY STRICT_INCREASE /end AXIS_DESCR
 /begin AXIS_DESCR STD_AXIS sK0Signa.m_motist_sync_k0 UMRM_NM__1_1_0_S6_S3 6 -200 1300 DEPOSIT ABSOLUTE MONOTONY STRICT_INCREASE /end AXIS_DESCR
/end CHARACTERISTIC
/begin CHARACTERISTIC STD.KF_MOSCHALTK0[_64] "KF4x6 f(sK0Signa.n_em_sync_k0, sK0Signa.m_motist_sync_k0): Schaltmomentenoffset in Schaltungen" MAP 0x214424 Map.si16.si16.si16_S6_S3 3000 UMRM_NM__1_1_0_S6_S3 -1500 1500
 /begin AXIS_DESCR STD_AXIS sK0Signa.n_em_sync_k0 UMRM_U_MIN_1_1_0_S6_S3 4 0 10000 DEPOSIT ABSOLUTE MONOTONY STRICT_INCREASE /end AXIS_DESCR
 /begin AXIS_DESCR STD_AXIS sK0Signa.m_motist_sync_k0 UMRM_NM__1_1_0_S6_S3 6 -200 1300 DEPOSIT ABSOLUTE MONOTONY STRICT_INCREASE /end AXIS_DESCR
/end CHARACTERISTIC
/begin CHARACTERISTIC STD.KF_MOSCHALTK0[_63] "KF4x6 f(sK0Signa.n_em_sync_k0, sK0Signa.m_motist_sync_k0): Schaltmomentenoffset in Schaltungen" MAP 0x214468 Map.si16.si16.si16_S6_S3 3000 UMRM_NM__1_1_0_S6_S3 -1500 1500
 /begin AXIS_DESCR STD_AXIS sK0Signa.n_em_sync_k0 UMRM_U_MIN_1_1_0_S6_S3 4 0 10000 DEPOSIT ABSOLUTE MONOTONY STRICT_INCREASE /end AXIS_DESCR
 /begin AXIS_DESCR STD_AXIS sK0Signa.m_motist_sync_k0 UMRM_NM__1_1_0_S6_S3 6 -200 1300 DEPOSIT ABSOLUTE MONOTONY STRICT_INCREASE /end AXIS_DESCR
/end CHARACTERISTIC
/begin CHARACTERISTIC STD.KF_MOSCHALTK0[_75] "KF4x6 f(sK0Signa.n_em_sync_k0, sK0Signa.m_motist_sync_k0): Schaltmomentenoffset in Schaltungen" MAP 0x2144AC Map.si16.si16.si16_S6_S3 3000 UMRM_NM__1_1_0_S6_S3 -1500 1500
 /begin AXIS_DESCR STD_AXIS sK0Signa.n_em_sync_k0 UMRM_U_MIN_1_1_0_S6_S3 4 0 10000 DEPOSIT ABSOLUTE MONOTONY STRICT_INCREASE /end AXIS_DESCR
 /begin AXIS_DESCR STD_AXIS sK0Signa.m_motist_sync_k0 UMRM_NM__1_1_0_S6_S3 6 -200 1300 DEPOSIT ABSOLUTE MONOTONY STRICT_INCREASE /end AXIS_DESCR
/end CHARACTERISTIC
/begin CHARACTERISTIC STD.KF_MOSCHALTK0[_71] "KF4x6 f(sK0Signa.n_em_sync_k0, sK0Signa.m_motist_sync_k0): Schaltmomentenoffset in Schaltungen" MAP 0x2144F0 Map.si16.si16.si16_S6_S3 3000 UMRM_NM__1_1_0_S6_S3 -1500 1500
 /begin AXIS_DESCR STD_AXIS sK0Signa.n_em_sync_k0 UMRM_U_MIN_1_1_0_S6_S3 4 0 10000 DEPOSIT ABSOLUTE MONOTONY STRICT_INCREASE /end AXIS_DESCR
 /begin AXIS_DESCR STD_AXIS sK0Signa.m_motist_sync_k0 UMRM_NM__1_1_0_S6_S3 6 -200 1300 DEPOSIT ABSOLUTE MONOTONY STRICT_INCREASE /end AXIS_DESCR
/end CHARACTERISTIC
/begin CHARACTERISTIC STD.KF_MOSCHALTK0[_86] "KF4x6 f(sK0Signa.n_em_sync_k0, sK0Signa.m_motist_sync_k0): Schaltmomentenoffset in Schaltungen" MAP 0x214534 Map.si16.si16.si16_S6_S3 3000 UMRM_NM__1_1_0_S6_S3 -1500 1500
 /begin AXIS_DESCR STD_AXIS sK0Signa.n_em_sync_k0 UMRM_U_MIN_1_1_0_S6_S3 4 0 10000 DEPOSIT ABSOLUTE MONOTONY STRICT_INCREASE /end AXIS_DESCR
 /begin AXIS_DESCR STD_AXIS sK0Signa.m_motist_sync_k0 UMRM_NM__1_1_0_S6_S3 6 -200 1300 DEPOSIT ABSOLUTE MONOTONY STRICT_INCREASE /end AXIS_DESCR
/end CHARACTERISTIC
/begin CHARACTERISTIC STD.KF_MOSCHALTK0[_84] "KF4x6 f(sK0Signa.n_em_sync_k0, sK0Signa.m_motist_sync_k0): Schaltmomentenoffset in Schaltungen" MAP 0x214578 Map.si16.si16.si16_S6_S3 3000 UMRM_NM__1_1_0_S6_S3 -1500 1500
 /begin AXIS_DESCR STD_AXIS sK0Signa.n_em_sync_k0 UMRM_U_MIN_1_1_0_S6_S3 4 0 10000 DEPOSIT ABSOLUTE MONOTONY STRICT_INCREASE /end AXIS_DESCR
 /begin AXIS_DESCR STD_AXIS sK0Signa.m_motist_sync_k0 UMRM_NM__1_1_0_S6_S3 6 -200 1300 DEPOSIT ABSOLUTE MONOTONY STRICT_INCREASE /end AXIS_DESCR
/end CHARACTERISTIC
/begin CHARACTERISTIC STD.KF_MOSCHALTK0[_82] "KF4x6 f(sK0Signa.n_em_sync_k0, sK0Signa.m_motist_sync_k0): Schaltmomentenoffset in Schaltungen" MAP 0x2145BC Map.si16.si16.si16_S6_S3 3000 UMRM_NM__1_1_0_S6_S3 -1500 1500
 /begin AXIS_DESCR STD_AXIS sK0Signa.n_em_sync_k0 UMRM_U_MIN_1_1_0_S6_S3 4 0 10000 DEPOSIT ABSOLUTE MONOTONY STRICT_INCREASE /end AXIS_DESCR
 /begin AXIS_DESCR STD_AXIS sK0Signa.m_motist_sync_k0 UMRM_NM__1_1_0_S6_S3 6 -200 1300 DEPOSIT ABSOLUTE MONOTONY STRICT_INCREASE /end AXIS_DESCR
/end CHARACTERISTIC
/begin CHARACTERISTIC SPONTAN.KF_MOSCHALTK0[_00] "KF4x6 f(sK0Signa.n_em_sync_k0, sK0Signa.m_motist_sync_k0): Schaltmomentenoffset in Schaltungen" MAP 0x214600 Map.si16.si16.si16_S6_S3 3000 UMRM_NM__1_1_0_S6_S3 -1500 1500
 /begin AXIS_DESCR STD_AXIS sK0Signa.n_em_sync_k0 UMRM_U_MIN_1_1_0_S6_S3 4 0 10000 DEPOSIT ABSOLUTE MONOTONY STRICT_INCREASE /end AXIS_DESCR
 /begin AXIS_DESCR STD_AXIS sK0Signa.m_motist_sync_k0 UMRM_NM__1_1_0_S6_S3 6 -200 1300 DEPOSIT ABSOLUTE MONOTONY STRICT_INCREASE /end AXIS_DESCR
/end CHARACTERISTIC
/begin CHARACTERISTIC SPONTAN.KF_MOSCHALTK0[_12] "KF4x6 f(sK0Signa.n_em_sync_k0, sK0Signa.m_motist_sync_k0): Schaltmomentenoffset in Schaltungen" MAP 0x214644 Map.si16.si16.si16_S6_S3 3000 UMRM_NM__1_1_0_S6_S3 -1500 1500
 /begin AXIS_DESCR STD_AXIS sK0Signa.n_em_sync_k0 UMRM_U_MIN_1_1_0_S6_S3 4 0 10000 DEPOSIT ABSOLUTE MONOTONY STRICT_INCREASE /end AXIS_DESCR
 /begin AXIS_DESCR STD_AXIS sK0Signa.m_motist_sync_k0 UMRM_NM__1_1_0_S6_S3 6 -200 1300 DEPOSIT ABSOLUTE MONOTONY STRICT_INCREASE /end AXIS_DESCR
/end CHARACTERISTIC
/begin CHARACTERISTIC SPONTAN.KF_MOSCHALTK0[_23] "KF4x6 f(sK0Signa.n_em_sync_k0, sK0Signa.m_motist_sync_k0): Schaltmomentenoffset in Schaltungen" MAP 0x214688 Map.si16.si16.si16_S6_S3 3000 UMRM_NM__1_1_0_S6_S3 -1500 1500
 /begin AXIS_DESCR STD_AXIS sK0Signa.n_em_sync_k0 UMRM_U_MIN_1_1_0_S6_S3 4 0 10000 DEPOSIT ABSOLUTE MONOTONY STRICT_INCREASE /end AXIS_DESCR
 /begin AXIS_DESCR STD_AXIS sK0Signa.m_motist_sync_k0 UMRM_NM__1_1_0_S6_S3 6 -200 1300 DEPOSIT ABSOLUTE MONOTONY STRICT_INCREASE /end AXIS_DESCR
/end CHARACTERISTIC
/begin CHARACTERISTIC SPONTAN.KF_MOSCHALTK0[_34] "KF4x6 f(sK0Signa.n_em_sync_k0, sK0Signa.m_motist_sync_k0): Schaltmomentenoffset in Schaltungen" MAP 0x2146CC Map.si16.si16.si16_S6_S3 3000 UMRM_NM__1_1_0_S6_S3 -1500 1500
 /begin AXIS_DESCR STD_AXIS sK0Signa.n_em_sync_k0 UMRM_U_MIN_1_1_0_S6_S3 4 0 10000 DEPOSIT ABSOLUTE MONOTONY STRICT_INCREASE /end AXIS_DESCR
 /begin AXIS_DESCR STD_AXIS sK0Signa.m_motist_sync_k0 UMRM_NM__1_1_0_S6_S3 6 -200 1300 DEPOSIT ABSOLUTE MONOTONY STRICT_INCREASE /end AXIS_DESCR
/end CHARACTERISTIC
/begin CHARACTERISTIC SPONTAN.KF_MOSCHALTK0[_45] "KF4x6 f(sK0Signa.n_em_sync_k0, sK0Signa.m_motist_sync_k0): Schaltmomentenoffset in Schaltungen" MAP 0x214710 Map.si16.si16.si16_S6_S3 3000 UMRM_NM__1_1_0_S6_S3 -1500 1500
 /begin AXIS_DESCR STD_AXIS sK0Signa.n_em_sync_k0 UMRM_U_MIN_1_1_0_S6_S3 4 0 10000 DEPOSIT ABSOLUTE MONOTONY STRICT_INCREASE /end AXIS_DESCR
 /begin AXIS_DESCR STD_AXIS sK0Signa.m_motist_sync_k0 UMRM_NM__1_1_0_S6_S3 6 -200 1300 DEPOSIT ABSOLUTE MONOTONY STRICT_INCREASE /end AXIS_DESCR
/end CHARACTERISTIC
/begin CHARACTERISTIC SPONTAN.KF_MOSCHALTK0[_56] "KF4x6 f(sK0Signa.n_em_sync_k0, sK0Signa.m_motist_sync_k0): Schaltmomentenoffset in Schaltungen" MAP 0x214754 Map.si16.si16.si16_S6_S3 3000 UMRM_NM__1_1_0_S6_S3 -1500 1500
 /begin AXIS_DESCR STD_AXIS sK0Signa.n_em_sync_k0 UMRM_U_MIN_1_1_0_S6_S3 4 0 10000 DEPOSIT ABSOLUTE MONOTONY STRICT_INCREASE /end AXIS_DESCR
 /begin AXIS_DESCR STD_AXIS sK0Signa.m_motist_sync_k0 UMRM_NM__1_1_0_S6_S3 6 -200 1300 DEPOSIT ABSOLUTE MONOTONY STRICT_INCREASE /end AXIS_DESCR
/end CHARACTERISTIC
/begin CHARACTERISTIC SPONTAN.KF_MOSCHALTK0[_67] "KF4x6 f(sK0Signa.n_em_sync_k0, sK0Signa.m_motist_sync_k0): Schaltmomentenoffset in Schaltungen" MAP 0x214798 Map.si16.si16.si16_S6_S3 3000 UMRM_NM__1_1_0_S6_S3 -1500 1500
 /begin AXIS_DESCR STD_AXIS sK0Signa.n_em_sync_k0 UMRM_U_MIN_1_1_0_S6_S3 4 0 10000 DEPOSIT ABSOLUTE MONOTONY STRICT_INCREASE /end AXIS_DESCR
 /begin AXIS_DESCR STD_AXIS sK0Signa.m_motist_sync_k0 UMRM_NM__1_1_0_S6_S3 6 -200 1300 DEPOSIT ABSOLUTE MONOTONY STRICT_INCREASE /end AXIS_DESCR
/end CHARACTERISTIC
/begin CHARACTERISTIC SPONTAN.KF_MOSCHALTK0[_78] "KF4x6 f(sK0Signa.n_em_sync_k0, sK0Signa.m_motist_sync_k0): Schaltmomentenoffset in Schaltungen" MAP 0x2147DC Map.si16.si16.si16_S6_S3 3000 UMRM_NM__1_1_0_S6_S3 -1500 1500
 /begin AXIS_DESCR STD_AXIS sK0Signa.n_em_sync_k0 UMRM_U_MIN_1_1_0_S6_S3 4 0 10000 DEPOSIT ABSOLUTE MONOTONY STRICT_INCREASE /end AXIS_DESCR
 /begin AXIS_DESCR STD_AXIS sK0Signa.m_motist_sync_k0 UMRM_NM__1_1_0_S6_S3 6 -200 1300 DEPOSIT ABSOLUTE MONOTONY STRICT_INCREASE /end AXIS_DESCR
/end CHARACTERISTIC
/begin CHARACTERISTIC SPONTAN.KF_MOSCHALTK0[_21] "KF4x6 f(sK0Signa.n_em_sync_k0, sK0Signa.m_motist_sync_k0): Schaltmomentenoffset in Schaltungen" MAP 0x214820 Map.si16.si16.si16_S6_S3 3000 UMRM_NM__1_1_0_S6_S3 -1500 1500
 /begin AXIS_DESCR STD_AXIS sK0Signa.n_em_sync_k0 UMRM_U_MIN_1_1_0_S6_S3 4 0 10000 DEPOSIT ABSOLUTE MONOTONY STRICT_INCREASE /end AXIS_DESCR
 /begin AXIS_DESCR STD_AXIS sK0Signa.m_motist_sync_k0 UMRM_NM__1_1_0_S6_S3 6 -200 1300 DEPOSIT ABSOLUTE MONOTONY STRICT_INCREASE /end AXIS_DESCR
/end CHARACTERISTIC
/begin CHARACTERISTIC SPONTAN.KF_MOSCHALTK0[_32] "KF4x6 f(sK0Signa.n_em_sync_k0, sK0Signa.m_motist_sync_k0): Schaltmomentenoffset in Schaltungen" MAP 0x214864 Map.si16.si16.si16_S6_S3 3000 UMRM_NM__1_1_0_S6_S3 -1500 1500
 /begin AXIS_DESCR STD_AXIS sK0Signa.n_em_sync_k0 UMRM_U_MIN_1_1_0_S6_S3 4 0 10000 DEPOSIT ABSOLUTE MONOTONY STRICT_INCREASE /end AXIS_DESCR
 /begin AXIS_DESCR STD_AXIS sK0Signa.m_motist_sync_k0 UMRM_NM__1_1_0_S6_S3 6 -200 1300 DEPOSIT ABSOLUTE MONOTONY STRICT_INCREASE /end AXIS_DESCR
/end CHARACTERISTIC
/begin CHARACTERISTIC SPONTAN.KF_MOSCHALTK0[_43] "KF4x6 f(sK0Signa.n_em_sync_k0, sK0Signa.m_motist_sync_k0): Schaltmomentenoffset in Schaltungen" MAP 0x2148A8 Map.si16.si16.si16_S6_S3 3000 UMRM_NM__1_1_0_S6_S3 -1500 1500
 /begin AXIS_DESCR STD_AXIS sK0Signa.n_em_sync_k0 UMRM_U_MIN_1_1_0_S6_S3 4 0 10000 DEPOSIT ABSOLUTE MONOTONY STRICT_INCREASE /end AXIS_DESCR
 /begin AXIS_DESCR STD_AXIS sK0Signa.m_motist_sync_k0 UMRM_NM__1_1_0_S6_S3 6 -200 1300 DEPOSIT ABSOLUTE MONOTONY STRICT_INCREASE /end AXIS_DESCR
/end CHARACTERISTIC
/begin CHARACTERISTIC SPONTAN.KF_MOSCHALTK0[_54] "KF4x6 f(sK0Signa.n_em_sync_k0, sK0Signa.m_motist_sync_k0): Schaltmomentenoffset in Schaltungen" MAP 0x2148EC Map.si16.si16.si16_S6_S3 3000 UMRM_NM__1_1_0_S6_S3 -1500 1500
 /begin AXIS_DESCR STD_AXIS sK0Signa.n_em_sync_k0 UMRM_U_MIN_1_1_0_S6_S3 4 0 10000 DEPOSIT ABSOLUTE MONOTONY STRICT_INCREASE /end AXIS_DESCR
 /begin AXIS_DESCR STD_AXIS sK0Signa.m_motist_sync_k0 UMRM_NM__1_1_0_S6_S3 6 -200 1300 DEPOSIT ABSOLUTE MONOTONY STRICT_INCREASE /end AXIS_DESCR
/end CHARACTERISTIC
/begin CHARACTERISTIC SPONTAN.KF_MOSCHALTK0[_65] "KF4x6 f(sK0Signa.n_em_sync_k0, sK0Signa.m_motist_sync_k0): Schaltmomentenoffset in Schaltungen" MAP 0x214930 Map.si16.si16.si16_S6_S3 3000 UMRM_NM__1_1_0_S6_S3 -1500 1500
 /begin AXIS_DESCR STD_AXIS sK0Signa.n_em_sync_k0 UMRM_U_MIN_1_1_0_S6_S3 4 0 10000 DEPOSIT ABSOLUTE MONOTONY STRICT_INCREASE /end AXIS_DESCR
 /begin AXIS_DESCR STD_AXIS sK0Signa.m_motist_sync_k0 UMRM_NM__1_1_0_S6_S3 6 -200 1300 DEPOSIT ABSOLUTE MONOTONY STRICT_INCREASE /end AXIS_DESCR
/end CHARACTERISTIC
/begin CHARACTERISTIC SPONTAN.KF_MOSCHALTK0[_76] "KF4x6 f(sK0Signa.n_em_sync_k0, sK0Signa.m_motist_sync_k0): Schaltmomentenoffset in Schaltungen" MAP 0x214974 Map.si16.si16.si16_S6_S3 3000 UMRM_NM__1_1_0_S6_S3 -1500 1500
 /begin AXIS_DESCR STD_AXIS sK0Signa.n_em_sync_k0 UMRM_U_MIN_1_1_0_S6_S3 4 0 10000 DEPOSIT ABSOLUTE MONOTONY STRICT_INCREASE /end AXIS_DESCR
 /begin AXIS_DESCR STD_AXIS sK0Signa.m_motist_sync_k0 UMRM_NM__1_1_0_S6_S3 6 -200 1300 DEPOSIT ABSOLUTE MONOTONY STRICT_INCREASE /end AXIS_DESCR
/end CHARACTERISTIC
/begin CHARACTERISTIC SPONTAN.KF_MOSCHALTK0[_87] "KF4x6 f(sK0Signa.n_em_sync_k0, sK0Signa.m_motist_sync_k0): Schaltmomentenoffset in Schaltungen" MAP 0x2149B8 Map.si16.si16.si16_S6_S3 3000 UMRM_NM__1_1_0_S6_S3 -1500 1500
 /begin AXIS_DESCR STD_AXIS sK0Signa.n_em_sync_k0 UMRM_U_MIN_1_1_0_S6_S3 4 0 10000 DEPOSIT ABSOLUTE MONOTONY STRICT_INCREASE /end AXIS_DESCR
 /begin AXIS_DESCR STD_AXIS sK0Signa.m_motist_sync_k0 UMRM_NM__1_1_0_S6_S3 6 -200 1300 DEPOSIT ABSOLUTE MONOTONY STRICT_INCREASE /end AXIS_DESCR
/end CHARACTERISTIC
/begin CHARACTERISTIC SPONTAN.KF_MOSCHALTK0[_31] "KF4x6 f(sK0Signa.n_em_sync_k0, sK0Signa.m_motist_sync_k0): Schaltmomentenoffset in Schaltungen" MAP 0x2149FC Map.si16.si16.si16_S6_S3 3000 UMRM_NM__1_1_0_S6_S3 -1500 1500
 /begin AXIS_DESCR STD_AXIS sK0Signa.n_em_sync_k0 UMRM_U_MIN_1_1_0_S6_S3 4 0 10000 DEPOSIT ABSOLUTE MONOTONY STRICT_INCREASE /end AXIS_DESCR
 /begin AXIS_DESCR STD_AXIS sK0Signa.m_motist_sync_k0 UMRM_NM__1_1_0_S6_S3 6 -200 1300 DEPOSIT ABSOLUTE MONOTONY STRICT_INCREASE /end AXIS_DESCR
/end CHARACTERISTIC
/begin CHARACTERISTIC SPONTAN.KF_MOSCHALTK0[_42] "KF4x6 f(sK0Signa.n_em_sync_k0, sK0Signa.m_motist_sync_k0): Schaltmomentenoffset in Schaltungen" MAP 0x214A40 Map.si16.si16.si16_S6_S3 3000 UMRM_NM__1_1_0_S6_S3 -1500 1500
 /begin AXIS_DESCR STD_AXIS sK0Signa.n_em_sync_k0 UMRM_U_MIN_1_1_0_S6_S3 4 0 10000 DEPOSIT ABSOLUTE MONOTONY STRICT_INCREASE /end AXIS_DESCR
 /begin AXIS_DESCR STD_AXIS sK0Signa.m_motist_sync_k0 UMRM_NM__1_1_0_S6_S3 6 -200 1300 DEPOSIT ABSOLUTE MONOTONY STRICT_INCREASE /end AXIS_DESCR
/end CHARACTERISTIC
/begin CHARACTERISTIC SPONTAN.KF_MOSCHALTK0[_53] "KF4x6 f(sK0Signa.n_em_sync_k0, sK0Signa.m_motist_sync_k0): Schaltmomentenoffset in Schaltungen" MAP 0x214A84 Map.si16.si16.si16_S6_S3 3000 UMRM_NM__1_1_0_S6_S3 -1500 1500
 /begin AXIS_DESCR STD_AXIS sK0Signa.n_em_sync_k0 UMRM_U_MIN_1_1_0_S6_S3 4 0 10000 DEPOSIT ABSOLUTE MONOTONY STRICT_INCREASE /end AXIS_DESCR
 /begin AXIS_DESCR STD_AXIS sK0Signa.m_motist_sync_k0 UMRM_NM__1_1_0_S6_S3 6 -200 1300 DEPOSIT ABSOLUTE MONOTONY STRICT_INCREASE /end AXIS_DESCR
/end CHARACTERISTIC
/begin CHARACTERISTIC SPONTAN.KF_MOSCHALTK0[_51] "KF4x6 f(sK0Signa.n_em_sync_k0, sK0Signa.m_motist_sync_k0): Schaltmomentenoffset in Schaltungen" MAP 0x214AC8 Map.si16.si16.si16_S6_S3 3000 UMRM_NM__1_1_0_S6_S3 -1500 1500
 /begin AXIS_DESCR STD_AXIS sK0Signa.n_em_sync_k0 UMRM_U_MIN_1_1_0_S6_S3 4 0 10000 DEPOSIT ABSOLUTE MONOTONY STRICT_INCREASE /end AXIS_DESCR
 /begin AXIS_DESCR STD_AXIS sK0Signa.m_motist_sync_k0 UMRM_NM__1_1_0_S6_S3 6 -200 1300 DEPOSIT ABSOLUTE MONOTONY STRICT_INCREASE /end AXIS_DESCR
/end CHARACTERISTIC
/begin CHARACTERISTIC SPONTAN.KF_MOSCHALTK0[_64] "KF4x6 f(sK0Signa.n_em_sync_k0, sK0Signa.m_motist_sync_k0): Schaltmomentenoffset in Schaltungen" MAP 0x214B0C Map.si16.si16.si16_S6_S3 3000 UMRM_NM__1_1_0_S6_S3 -1500 1500
 /begin AXIS_DESCR STD_AXIS sK0Signa.n_em_sync_k0 UMRM_U_MIN_1_1_0_S6_S3 4 0 10000 DEPOSIT ABSOLUTE MONOTONY STRICT_INCREASE /end AXIS_DESCR
 /begin AXIS_DESCR STD_AXIS sK0Signa.m_motist_sync_k0 UMRM_NM__1_1_0_S6_S3 6 -200 1300 DEPOSIT ABSOLUTE MONOTONY STRICT_INCREASE /end AXIS_DESCR
/end CHARACTERISTIC
/begin CHARACTERISTIC SPONTAN.KF_MOSCHALTK0[_63] "KF4x6 f(sK0Signa.n_em_sync_k0, sK0Signa.m_motist_sync_k0): Schaltmomentenoffset in Schaltungen" MAP 0x214B50 Map.si16.si16.si16_S6_S3 3000 UMRM_NM__1_1_0_S6_S3 -1500 1500
 /begin AXIS_DESCR STD_AXIS sK0Signa.n_em_sync_k0 UMRM_U_MIN_1_1_0_S6_S3 4 0 10000 DEPOSIT ABSOLUTE MONOTONY STRICT_INCREASE /end AXIS_DESCR
 /begin AXIS_DESCR STD_AXIS sK0Signa.m_motist_sync_k0 UMRM_NM__1_1_0_S6_S3 6 -200 1300 DEPOSIT ABSOLUTE MONOTONY STRICT_INCREASE /end AXIS_DESCR
/end CHARACTERISTIC
/begin CHARACTERISTIC SPONTAN.KF_MOSCHALTK0[_75] "KF4x6 f(sK0Signa.n_em_sync_k0, sK0Signa.m_motist_sync_k0): Schaltmomentenoffset in Schaltungen" MAP 0x214B94 Map.si16.si16.si16_S6_S3 3000 UMRM_NM__1_1_0_S6_S3 -1500 1500
 /begin AXIS_DESCR STD_AXIS sK0Signa.n_em_sync_k0 UMRM_U_MIN_1_1_0_S6_S3 4 0 10000 DEPOSIT ABSOLUTE MONOTONY STRICT_INCREASE /end AXIS_DESCR
 /begin AXIS_DESCR STD_AXIS sK0Signa.m_motist_sync_k0 UMRM_NM__1_1_0_S6_S3 6 -200 1300 DEPOSIT ABSOLUTE MONOTONY STRICT_INCREASE /end AXIS_DESCR
/end CHARACTERISTIC
/begin CHARACTERISTIC SPONTAN.KF_MOSCHALTK0[_71] "KF4x6 f(sK0Signa.n_em_sync_k0, sK0Signa.m_motist_sync_k0): Schaltmomentenoffset in Schaltungen" MAP 0x214BD8 Map.si16.si16.si16_S6_S3 3000 UMRM_NM__1_1_0_S6_S3 -1500 1500
 /begin AXIS_DESCR STD_AXIS sK0Signa.n_em_sync_k0 UMRM_U_MIN_1_1_0_S6_S3 4 0 10000 DEPOSIT ABSOLUTE MONOTONY STRICT_INCREASE /end AXIS_DESCR
 /begin AXIS_DESCR STD_AXIS sK0Signa.m_motist_sync_k0 UMRM_NM__1_1_0_S6_S3 6 -200 1300 DEPOSIT ABSOLUTE MONOTONY STRICT_INCREASE /end AXIS_DESCR
/end CHARACTERISTIC
/begin CHARACTERISTIC SPONTAN.KF_MOSCHALTK0[_86] "KF4x6 f(sK0Signa.n_em_sync_k0, sK0Signa.m_motist_sync_k0): Schaltmomentenoffset in Schaltungen" MAP 0x214C1C Map.si16.si16.si16_S6_S3 3000 UMRM_NM__1_1_0_S6_S3 -1500 1500
 /begin AXIS_DESCR STD_AXIS sK0Signa.n_em_sync_k0 UMRM_U_MIN_1_1_0_S6_S3 4 0 10000 DEPOSIT ABSOLUTE MONOTONY STRICT_INCREASE /end AXIS_DESCR
 /begin AXIS_DESCR STD_AXIS sK0Signa.m_motist_sync_k0 UMRM_NM__1_1_0_S6_S3 6 -200 1300 DEPOSIT ABSOLUTE MONOTONY STRICT_INCREASE /end AXIS_DESCR
/end CHARACTERISTIC
/begin CHARACTERISTIC SPONTAN.KF_MOSCHALTK0[_84] "KF4x6 f(sK0Signa.n_em_sync_k0, sK0Signa.m_motist_sync_k0): Schaltmomentenoffset in Schaltungen" MAP 0x214C60 Map.si16.si16.si16_S6_S3 3000 UMRM_NM__1_1_0_S6_S3 -1500 1500
 /begin AXIS_DESCR STD_AXIS sK0Signa.n_em_sync_k0 UMRM_U_MIN_1_1_0_S6_S3 4 0 10000 DEPOSIT ABSOLUTE MONOTONY STRICT_INCREASE /end AXIS_DESCR
 /begin AXIS_DESCR STD_AXIS sK0Signa.m_motist_sync_k0 UMRM_NM__1_1_0_S6_S3 6 -200 1300 DEPOSIT ABSOLUTE MONOTONY STRICT_INCREASE /end AXIS_DESCR
/end CHARACTERISTIC
/begin CHARACTERISTIC SPONTAN.KF_MOSCHALTK0[_82] "KF4x6 f(sK0Signa.n_em_sync_k0, sK0Signa.m_motist_sync_k0): Schaltmomentenoffset in Schaltungen" MAP 0x214CA4 Map.si16.si16.si16_S6_S3 3000 UMRM_NM__1_1_0_S6_S3 -1500 1500
 /begin AXIS_DESCR STD_AXIS sK0Signa.n_em_sync_k0 UMRM_U_MIN_1_1_0_S6_S3 4 0 10000 DEPOSIT ABSOLUTE MONOTONY STRICT_INCREASE /end AXIS_DESCR
 /begin AXIS_DESCR STD_AXIS sK0Signa.m_motist_sync_k0 UMRM_NM__1_1_0_S6_S3 6 -200 1300 DEPOSIT ABSOLUTE MONOTONY STRICT_INCREASE /end AXIS_DESCR
/end CHARACTERISTIC
/begin CHARACTERISTIC SP.KF_MOSCHALTK0[_00] "KF4x6 f(sK0Signa.n_em_sync_k0, sK0Signa.m_motist_sync_k0): Schaltmomentenoffset in Schaltungen" MAP 0x214CE8 Map.si16.si16.si16_S6_S3 3000 UMRM_NM__1_1_0_S6_S3 -1500 1500
 /begin AXIS_DESCR STD_AXIS sK0Signa.n_em_sync_k0 UMRM_U_MIN_1_1_0_S6_S3 4 0 10000 DEPOSIT ABSOLUTE MONOTONY STRICT_INCREASE /end AXIS_DESCR
 /begin AXIS_DESCR STD_AXIS sK0Signa.m_motist_sync_k0 UMRM_NM__1_1_0_S6_S3 6 -200 1300 DEPOSIT ABSOLUTE MONOTONY STRICT_INCREASE /end AXIS_DESCR
/end CHARACTERISTIC
/begin CHARACTERISTIC SP.KF_MOSCHALTK0[_12] "KF4x6 f(sK0Signa.n_em_sync_k0, sK0Signa.m_motist_sync_k0): Schaltmomentenoffset in Schaltungen" MAP 0x214D2C Map.si16.si16.si16_S6_S3 3000 UMRM_NM__1_1_0_S6_S3 -1500 1500
 /begin AXIS_DESCR STD_AXIS sK0Signa.n_em_sync_k0 UMRM_U_MIN_1_1_0_S6_S3 4 0 10000 DEPOSIT ABSOLUTE MONOTONY STRICT_INCREASE /end AXIS_DESCR
 /begin AXIS_DESCR STD_AXIS sK0Signa.m_motist_sync_k0 UMRM_NM__1_1_0_S6_S3 6 -200 1300 DEPOSIT ABSOLUTE MONOTONY STRICT_INCREASE /end AXIS_DESCR
/end CHARACTERISTIC
/begin CHARACTERISTIC SP.KF_MOSCHALTK0[_23] "KF4x6 f(sK0Signa.n_em_sync_k0, sK0Signa.m_motist_sync_k0): Schaltmomentenoffset in Schaltungen" MAP 0x214D70 Map.si16.si16.si16_S6_S3 3000 UMRM_NM__1_1_0_S6_S3 -1500 1500
 /begin AXIS_DESCR STD_AXIS sK0Signa.n_em_sync_k0 UMRM_U_MIN_1_1_0_S6_S3 4 0 10000 DEPOSIT ABSOLUTE MONOTONY STRICT_INCREASE /end AXIS_DESCR
 /begin AXIS_DESCR STD_AXIS sK0Signa.m_motist_sync_k0 UMRM_NM__1_1_0_S6_S3 6 -200 1300 DEPOSIT ABSOLUTE MONOTONY STRICT_INCREASE /end AXIS_DESCR
/end CHARACTERISTIC
/begin CHARACTERISTIC SP.KF_MOSCHALTK0[_34] "KF4x6 f(sK0Signa.n_em_sync_k0, sK0Signa.m_motist_sync_k0): Schaltmomentenoffset in Schaltungen" MAP 0x214DB4 Map.si16.si16.si16_S6_S3 3000 UMRM_NM__1_1_0_S6_S3 -1500 1500
 /begin AXIS_DESCR STD_AXIS sK0Signa.n_em_sync_k0 UMRM_U_MIN_1_1_0_S6_S3 4 0 10000 DEPOSIT ABSOLUTE MONOTONY STRICT_INCREASE /end AXIS_DESCR
 /begin AXIS_DESCR STD_AXIS sK0Signa.m_motist_sync_k0 UMRM_NM__1_1_0_S6_S3 6 -200 1300 DEPOSIT ABSOLUTE MONOTONY STRICT_INCREASE /end AXIS_DESCR
/end CHARACTERISTIC
/begin CHARACTERISTIC SP.KF_MOSCHALTK0[_45] "KF4x6 f(sK0Signa.n_em_sync_k0, sK0Signa.m_motist_sync_k0): Schaltmomentenoffset in Schaltungen" MAP 0x214DF8 Map.si16.si16.si16_S6_S3 3000 UMRM_NM__1_1_0_S6_S3 -1500 1500
 /begin AXIS_DESCR STD_AXIS sK0Signa.n_em_sync_k0 UMRM_U_MIN_1_1_0_S6_S3 4 0 10000 DEPOSIT ABSOLUTE MONOTONY STRICT_INCREASE /end AXIS_DESCR
 /begin AXIS_DESCR STD_AXIS sK0Signa.m_motist_sync_k0 UMRM_NM__1_1_0_S6_S3 6 -200 1300 DEPOSIT ABSOLUTE MONOTONY STRICT_INCREASE /end AXIS_DESCR
/end CHARACTERISTIC
/begin CHARACTERISTIC SP.KF_MOSCHALTK0[_56] "KF4x6 f(sK0Signa.n_em_sync_k0, sK0Signa.m_motist_sync_k0): Schaltmomentenoffset in Schaltungen" MAP 0x214E3C Map.si16.si16.si16_S6_S3 3000 UMRM_NM__1_1_0_S6_S3 -1500 1500
 /begin AXIS_DESCR STD_AXIS sK0Signa.n_em_sync_k0 UMRM_U_MIN_1_1_0_S6_S3 4 0 10000 DEPOSIT ABSOLUTE MONOTONY STRICT_INCREASE /end AXIS_DESCR
 /begin AXIS_DESCR STD_AXIS sK0Signa.m_motist_sync_k0 UMRM_NM__1_1_0_S6_S3 6 -200 1300 DEPOSIT ABSOLUTE MONOTONY STRICT_INCREASE /end AXIS_DESCR
/end CHARACTERISTIC
/begin CHARACTERISTIC SP.KF_MOSCHALTK0[_67] "KF4x6 f(sK0Signa.n_em_sync_k0, sK0Signa.m_motist_sync_k0): Schaltmomentenoffset in Schaltungen" MAP 0x214E80 Map.si16.si16.si16_S6_S3 3000 UMRM_NM__1_1_0_S6_S3 -1500 1500
 /begin AXIS_DESCR STD_AXIS sK0Signa.n_em_sync_k0 UMRM_U_MIN_1_1_0_S6_S3 4 0 10000 DEPOSIT ABSOLUTE MONOTONY STRICT_INCREASE /end AXIS_DESCR
 /begin AXIS_DESCR STD_AXIS sK0Signa.m_motist_sync_k0 UMRM_NM__1_1_0_S6_S3 6 -200 1300 DEPOSIT ABSOLUTE MONOTONY STRICT_INCREASE /end AXIS_DESCR
/end CHARACTERISTIC
/begin CHARACTERISTIC SP.KF_MOSCHALTK0[_78] "KF4x6 f(sK0Signa.n_em_sync_k0, sK0Signa.m_motist_sync_k0): Schaltmomentenoffset in Schaltungen" MAP 0x214EC4 Map.si16.si16.si16_S6_S3 3000 UMRM_NM__1_1_0_S6_S3 -1500 1500
 /begin AXIS_DESCR STD_AXIS sK0Signa.n_em_sync_k0 UMRM_U_MIN_1_1_0_S6_S3 4 0 10000 DEPOSIT ABSOLUTE MONOTONY STRICT_INCREASE /end AXIS_DESCR
 /begin AXIS_DESCR STD_AXIS sK0Signa.m_motist_sync_k0 UMRM_NM__1_1_0_S6_S3 6 -200 1300 DEPOSIT ABSOLUTE MONOTONY STRICT_INCREASE /end AXIS_DESCR
/end CHARACTERISTIC
/begin CHARACTERISTIC SP.KF_MOSCHALTK0[_21] "KF4x6 f(sK0Signa.n_em_sync_k0, sK0Signa.m_motist_sync_k0): Schaltmomentenoffset in Schaltungen" MAP 0x214F08 Map.si16.si16.si16_S6_S3 3000 UMRM_NM__1_1_0_S6_S3 -1500 1500
 /begin AXIS_DESCR STD_AXIS sK0Signa.n_em_sync_k0 UMRM_U_MIN_1_1_0_S6_S3 4 0 10000 DEPOSIT ABSOLUTE MONOTONY STRICT_INCREASE /end AXIS_DESCR
 /begin AXIS_DESCR STD_AXIS sK0Signa.m_motist_sync_k0 UMRM_NM__1_1_0_S6_S3 6 -200 1300 DEPOSIT ABSOLUTE MONOTONY STRICT_INCREASE /end AXIS_DESCR
/end CHARACTERISTIC
/begin CHARACTERISTIC SP.KF_MOSCHALTK0[_32] "KF4x6 f(sK0Signa.n_em_sync_k0, sK0Signa.m_motist_sync_k0): Schaltmomentenoffset in Schaltungen" MAP 0x214F4C Map.si16.si16.si16_S6_S3 3000 UMRM_NM__1_1_0_S6_S3 -1500 1500
 /begin AXIS_DESCR STD_AXIS sK0Signa.n_em_sync_k0 UMRM_U_MIN_1_1_0_S6_S3 4 0 10000 DEPOSIT ABSOLUTE MONOTONY STRICT_INCREASE /end AXIS_DESCR
 /begin AXIS_DESCR STD_AXIS sK0Signa.m_motist_sync_k0 UMRM_NM__1_1_0_S6_S3 6 -200 1300 DEPOSIT ABSOLUTE MONOTONY STRICT_INCREASE /end AXIS_DESCR
/end CHARACTERISTIC
/begin CHARACTERISTIC SP.KF_MOSCHALTK0[_43] "KF4x6 f(sK0Signa.n_em_sync_k0, sK0Signa.m_motist_sync_k0): Schaltmomentenoffset in Schaltungen" MAP 0x214F90 Map.si16.si16.si16_S6_S3 3000 UMRM_NM__1_1_0_S6_S3 -1500 1500
 /begin AXIS_DESCR STD_AXIS sK0Signa.n_em_sync_k0 UMRM_U_MIN_1_1_0_S6_S3 4 0 10000 DEPOSIT ABSOLUTE MONOTONY STRICT_INCREASE /end AXIS_DESCR
 /begin AXIS_DESCR STD_AXIS sK0Signa.m_motist_sync_k0 UMRM_NM__1_1_0_S6_S3 6 -200 1300 DEPOSIT ABSOLUTE MONOTONY STRICT_INCREASE /end AXIS_DESCR
/end CHARACTERISTIC
/begin CHARACTERISTIC SP.KF_MOSCHALTK0[_54] "KF4x6 f(sK0Signa.n_em_sync_k0, sK0Signa.m_motist_sync_k0): Schaltmomentenoffset in Schaltungen" MAP 0x214FD4 Map.si16.si16.si16_S6_S3 3000 UMRM_NM__1_1_0_S6_S3 -1500 1500
 /begin AXIS_DESCR STD_AXIS sK0Signa.n_em_sync_k0 UMRM_U_MIN_1_1_0_S6_S3 4 0 10000 DEPOSIT ABSOLUTE MONOTONY STRICT_INCREASE /end AXIS_DESCR
 /begin AXIS_DESCR STD_AXIS sK0Signa.m_motist_sync_k0 UMRM_NM__1_1_0_S6_S3 6 -200 1300 DEPOSIT ABSOLUTE MONOTONY STRICT_INCREASE /end AXIS_DESCR
/end CHARACTERISTIC
/begin CHARACTERISTIC SP.KF_MOSCHALTK0[_65] "KF4x6 f(sK0Signa.n_em_sync_k0, sK0Signa.m_motist_sync_k0): Schaltmomentenoffset in Schaltungen" MAP 0x215018 Map.si16.si16.si16_S6_S3 3000 UMRM_NM__1_1_0_S6_S3 -1500 1500
 /begin AXIS_DESCR STD_AXIS sK0Signa.n_em_sync_k0 UMRM_U_MIN_1_1_0_S6_S3 4 0 10000 DEPOSIT ABSOLUTE MONOTONY STRICT_INCREASE /end AXIS_DESCR
 /begin AXIS_DESCR STD_AXIS sK0Signa.m_motist_sync_k0 UMRM_NM__1_1_0_S6_S3 6 -200 1300 DEPOSIT ABSOLUTE MONOTONY STRICT_INCREASE /end AXIS_DESCR
/end CHARACTERISTIC
/begin CHARACTERISTIC SP.KF_MOSCHALTK0[_76] "KF4x6 f(sK0Signa.n_em_sync_k0, sK0Signa.m_motist_sync_k0): Schaltmomentenoffset in Schaltungen" MAP 0x21505C Map.si16.si16.si16_S6_S3 3000 UMRM_NM__1_1_0_S6_S3 -1500 1500
 /begin AXIS_DESCR STD_AXIS sK0Signa.n_em_sync_k0 UMRM_U_MIN_1_1_0_S6_S3 4 0 10000 DEPOSIT ABSOLUTE MONOTONY STRICT_INCREASE /end AXIS_DESCR
 /begin AXIS_DESCR STD_AXIS sK0Signa.m_motist_sync_k0 UMRM_NM__1_1_0_S6_S3 6 -200 1300 DEPOSIT ABSOLUTE MONOTONY STRICT_INCREASE /end AXIS_DESCR
/end CHARACTERISTIC
/begin CHARACTERISTIC SP.KF_MOSCHALTK0[_87] "KF4x6 f(sK0Signa.n_em_sync_k0, sK0Signa.m_motist_sync_k0): Schaltmomentenoffset in Schaltungen" MAP 0x2150A0 Map.si16.si16.si16_S6_S3 3000 UMRM_NM__1_1_0_S6_S3 -1500 1500
 /begin AXIS_DESCR STD_AXIS sK0Signa.n_em_sync_k0 UMRM_U_MIN_1_1_0_S6_S3 4 0 10000 DEPOSIT ABSOLUTE MONOTONY STRICT_INCREASE /end AXIS_DESCR
 /begin AXIS_DESCR STD_AXIS sK0Signa.m_motist_sync_k0 UMRM_NM__1_1_0_S6_S3 6 -200 1300 DEPOSIT ABSOLUTE MONOTONY STRICT_INCREASE /end AXIS_DESCR
/end CHARACTERISTIC
/begin CHARACTERISTIC SP.KF_MOSCHALTK0[_31] "KF4x6 f(sK0Signa.n_em_sync_k0, sK0Signa.m_motist_sync_k0): Schaltmomentenoffset in Schaltungen" MAP 0x2150E4 Map.si16.si16.si16_S6_S3 3000 UMRM_NM__1_1_0_S6_S3 -1500 1500
 /begin AXIS_DESCR STD_AXIS sK0Signa.n_em_sync_k0 UMRM_U_MIN_1_1_0_S6_S3 4 0 10000 DEPOSIT ABSOLUTE MONOTONY STRICT_INCREASE /end AXIS_DESCR
 /begin AXIS_DESCR STD_AXIS sK0Signa.m_motist_sync_k0 UMRM_NM__1_1_0_S6_S3 6 -200 1300 DEPOSIT ABSOLUTE MONOTONY STRICT_INCREASE /end AXIS_DESCR
/end CHARACTERISTIC
/begin CHARACTERISTIC SP.KF_MOSCHALTK0[_42] "KF4x6 f(sK0Signa.n_em_sync_k0, sK0Signa.m_motist_sync_k0): Schaltmomentenoffset in Schaltungen" MAP 0x215128 Map.si16.si16.si16_S6_S3 3000 UMRM_NM__1_1_0_S6_S3 -1500 1500
 /begin AXIS_DESCR STD_AXIS sK0Signa.n_em_sync_k0 UMRM_U_MIN_1_1_0_S6_S3 4 0 10000 DEPOSIT ABSOLUTE MONOTONY STRICT_INCREASE /end AXIS_DESCR
 /begin AXIS_DESCR STD_AXIS sK0Signa.m_motist_sync_k0 UMRM_NM__1_1_0_S6_S3 6 -200 1300 DEPOSIT ABSOLUTE MONOTONY STRICT_INCREASE /end AXIS_DESCR
/end CHARACTERISTIC
/begin CHARACTERISTIC SP.KF_MOSCHALTK0[_53] "KF4x6 f(sK0Signa.n_em_sync_k0, sK0Signa.m_motist_sync_k0): Schaltmomentenoffset in Schaltungen" MAP 0x21516C Map.si16.si16.si16_S6_S3 3000 UMRM_NM__1_1_0_S6_S3 -1500 1500
 /begin AXIS_DESCR STD_AXIS sK0Signa.n_em_sync_k0 UMRM_U_MIN_1_1_0_S6_S3 4 0 10000 DEPOSIT ABSOLUTE MONOTONY STRICT_INCREASE /end AXIS_DESCR
 /begin AXIS_DESCR STD_AXIS sK0Signa.m_motist_sync_k0 UMRM_NM__1_1_0_S6_S3 6 -200 1300 DEPOSIT ABSOLUTE MONOTONY STRICT_INCREASE /end AXIS_DESCR
/end CHARACTERISTIC
/begin CHARACTERISTIC SP.KF_MOSCHALTK0[_51] "KF4x6 f(sK0Signa.n_em_sync_k0, sK0Signa.m_motist_sync_k0): Schaltmomentenoffset in Schaltungen" MAP 0x2151B0 Map.si16.si16.si16_S6_S3 3000 UMRM_NM__1_1_0_S6_S3 -1500 1500
 /begin AXIS_DESCR STD_AXIS sK0Signa.n_em_sync_k0 UMRM_U_MIN_1_1_0_S6_S3 4 0 10000 DEPOSIT ABSOLUTE MONOTONY STRICT_INCREASE /end AXIS_DESCR
 /begin AXIS_DESCR STD_AXIS sK0Signa.m_motist_sync_k0 UMRM_NM__1_1_0_S6_S3 6 -200 1300 DEPOSIT ABSOLUTE MONOTONY STRICT_INCREASE /end AXIS_DESCR
/end CHARACTERISTIC
/begin CHARACTERISTIC SP.KF_MOSCHALTK0[_64] "KF4x6 f(sK0Signa.n_em_sync_k0, sK0Signa.m_motist_sync_k0): Schaltmomentenoffset in Schaltungen" MAP 0x2151F4 Map.si16.si16.si16_S6_S3 3000 UMRM_NM__1_1_0_S6_S3 -1500 1500
 /begin AXIS_DESCR STD_AXIS sK0Signa.n_em_sync_k0 UMRM_U_MIN_1_1_0_S6_S3 4 0 10000 DEPOSIT ABSOLUTE MONOTONY STRICT_INCREASE /end AXIS_DESCR
 /begin AXIS_DESCR STD_AXIS sK0Signa.m_motist_sync_k0 UMRM_NM__1_1_0_S6_S3 6 -200 1300 DEPOSIT ABSOLUTE MONOTONY STRICT_INCREASE /end AXIS_DESCR
/end CHARACTERISTIC
/begin CHARACTERISTIC SP.KF_MOSCHALTK0[_63] "KF4x6 f(sK0Signa.n_em_sync_k0, sK0Signa.m_motist_sync_k0): Schaltmomentenoffset in Schaltungen" MAP 0x215238 Map.si16.si16.si16_S6_S3 3000 UMRM_NM__1_1_0_S6_S3 -1500 1500
 /begin AXIS_DESCR STD_AXIS sK0Signa.n_em_sync_k0 UMRM_U_MIN_1_1_0_S6_S3 4 0 10000 DEPOSIT ABSOLUTE MONOTONY STRICT_INCREASE /end AXIS_DESCR
 /begin AXIS_DESCR STD_AXIS sK0Signa.m_motist_sync_k0 UMRM_NM__1_1_0_S6_S3 6 -200 1300 DEPOSIT ABSOLUTE MONOTONY STRICT_INCREASE /end AXIS_DESCR
/end CHARACTERISTIC
/begin CHARACTERISTIC SP.KF_MOSCHALTK0[_75] "KF4x6 f(sK0Signa.n_em_sync_k0, sK0Signa.m_motist_sync_k0): Schaltmomentenoffset in Schaltungen" MAP 0x21527C Map.si16.si16.si16_S6_S3 3000 UMRM_NM__1_1_0_S6_S3 -1500 1500
 /begin AXIS_DESCR STD_AXIS sK0Signa.n_em_sync_k0 UMRM_U_MIN_1_1_0_S6_S3 4 0 10000 DEPOSIT ABSOLUTE MONOTONY STRICT_INCREASE /end AXIS_DESCR
 /begin AXIS_DESCR STD_AXIS sK0Signa.m_motist_sync_k0 UMRM_NM__1_1_0_S6_S3 6 -200 1300 DEPOSIT ABSOLUTE MONOTONY STRICT_INCREASE /end AXIS_DESCR
/end CHARACTERISTIC
/begin CHARACTERISTIC SP.KF_MOSCHALTK0[_71] "KF4x6 f(sK0Signa.n_em_sync_k0, sK0Signa.m_motist_sync_k0): Schaltmomentenoffset in Schaltungen" MAP 0x2152C0 Map.si16.si16.si16_S6_S3 3000 UMRM_NM__1_1_0_S6_S3 -1500 1500
 /begin AXIS_DESCR STD_AXIS sK0Signa.n_em_sync_k0 UMRM_U_MIN_1_1_0_S6_S3 4 0 10000 DEPOSIT ABSOLUTE MONOTONY STRICT_INCREASE /end AXIS_DESCR
 /begin AXIS_DESCR STD_AXIS sK0Signa.m_motist_sync_k0 UMRM_NM__1_1_0_S6_S3 6 -200 1300 DEPOSIT ABSOLUTE MONOTONY STRICT_INCREASE /end AXIS_DESCR
/end CHARACTERISTIC
/begin CHARACTERISTIC SP.KF_MOSCHALTK0[_86] "KF4x6 f(sK0Signa.n_em_sync_k0, sK0Signa.m_motist_sync_k0): Schaltmomentenoffset in Schaltungen" MAP 0x215304 Map.si16.si16.si16_S6_S3 3000 UMRM_NM__1_1_0_S6_S3 -1500 1500
 /begin AXIS_DESCR STD_AXIS sK0Signa.n_em_sync_k0 UMRM_U_MIN_1_1_0_S6_S3 4 0 10000 DEPOSIT ABSOLUTE MONOTONY STRICT_INCREASE /end AXIS_DESCR
 /begin AXIS_DESCR STD_AXIS sK0Signa.m_motist_sync_k0 UMRM_NM__1_1_0_S6_S3 6 -200 1300 DEPOSIT ABSOLUTE MONOTONY STRICT_INCREASE /end AXIS_DESCR
/end CHARACTERISTIC
/begin CHARACTERISTIC SP.KF_MOSCHALTK0[_84] "KF4x6 f(sK0Signa.n_em_sync_k0, sK0Signa.m_motist_sync_k0): Schaltmomentenoffset in Schaltungen" MAP 0x215348 Map.si16.si16.si16_S6_S3 3000 UMRM_NM__1_1_0_S6_S3 -1500 1500
 /begin AXIS_DESCR STD_AXIS sK0Signa.n_em_sync_k0 UMRM_U_MIN_1_1_0_S6_S3 4 0 10000 DEPOSIT ABSOLUTE MONOTONY STRICT_INCREASE /end AXIS_DESCR
 /begin AXIS_DESCR STD_AXIS sK0Signa.m_motist_sync_k0 UMRM_NM__1_1_0_S6_S3 6 -200 1300 DEPOSIT ABSOLUTE MONOTONY STRICT_INCREASE /end AXIS_DESCR
/end CHARACTERISTIC
/begin CHARACTERISTIC SP.KF_MOSCHALTK0[_82] "KF4x6 f(sK0Signa.n_em_sync_k0, sK0Signa.m_motist_sync_k0): Schaltmomentenoffset in Schaltungen" MAP 0x21538C Map.si16.si16.si16_S6_S3 3000 UMRM_NM__1_1_0_S6_S3 -1500 1500
 /begin AXIS_DESCR STD_AXIS sK0Signa.n_em_sync_k0 UMRM_U_MIN_1_1_0_S6_S3 4 0 10000 DEPOSIT ABSOLUTE MONOTONY STRICT_INCREASE /end AXIS_DESCR
 /begin AXIS_DESCR STD_AXIS sK0Signa.m_motist_sync_k0 UMRM_NM__1_1_0_S6_S3 6 -200 1300 DEPOSIT ABSOLUTE MONOTONY STRICT_INCREASE /end AXIS_DESCR
/end CHARACTERISTIC
/begin CHARACTERISTIC AMAX.KF_MOSCHALTK0[_00] "KF4x6 f(sK0Signa.n_em_sync_k0, sK0Signa.m_motist_sync_k0): Schaltmomentenoffset in Schaltungen" MAP 0x2153D0 Map.si16.si16.si16_S6_S3 3000 UMRM_NM__1_1_0_S6_S3 -1500 1500
 /begin AXIS_DESCR STD_AXIS sK0Signa.n_em_sync_k0 UMRM_U_MIN_1_1_0_S6_S3 4 0 10000 DEPOSIT ABSOLUTE MONOTONY STRICT_INCREASE /end AXIS_DESCR
 /begin AXIS_DESCR STD_AXIS sK0Signa.m_motist_sync_k0 UMRM_NM__1_1_0_S6_S3 6 -200 1300 DEPOSIT ABSOLUTE MONOTONY STRICT_INCREASE /end AXIS_DESCR
/end CHARACTERISTIC
/begin CHARACTERISTIC AMAX.KF_MOSCHALTK0[_12] "KF4x6 f(sK0Signa.n_em_sync_k0, sK0Signa.m_motist_sync_k0): Schaltmomentenoffset in Schaltungen" MAP 0x215414 Map.si16.si16.si16_S6_S3 3000 UMRM_NM__1_1_0_S6_S3 -1500 1500
 /begin AXIS_DESCR STD_AXIS sK0Signa.n_em_sync_k0 UMRM_U_MIN_1_1_0_S6_S3 4 0 10000 DEPOSIT ABSOLUTE MONOTONY STRICT_INCREASE /end AXIS_DESCR
 /begin AXIS_DESCR STD_AXIS sK0Signa.m_motist_sync_k0 UMRM_NM__1_1_0_S6_S3 6 -200 1300 DEPOSIT ABSOLUTE MONOTONY STRICT_INCREASE /end AXIS_DESCR
/end CHARACTERISTIC
/begin CHARACTERISTIC AMAX.KF_MOSCHALTK0[_23] "KF4x6 f(sK0Signa.n_em_sync_k0, sK0Signa.m_motist_sync_k0): Schaltmomentenoffset in Schaltungen" MAP 0x215458 Map.si16.si16.si16_S6_S3 3000 UMRM_NM__1_1_0_S6_S3 -1500 1500
 /begin AXIS_DESCR STD_AXIS sK0Signa.n_em_sync_k0 UMRM_U_MIN_1_1_0_S6_S3 4 0 10000 DEPOSIT ABSOLUTE MONOTONY STRICT_INCREASE /end AXIS_DESCR
 /begin AXIS_DESCR STD_AXIS sK0Signa.m_motist_sync_k0 UMRM_NM__1_1_0_S6_S3 6 -200 1300 DEPOSIT ABSOLUTE MONOTONY STRICT_INCREASE /end AXIS_DESCR
/end CHARACTERISTIC
/begin CHARACTERISTIC AMAX.KF_MOSCHALTK0[_34] "KF4x6 f(sK0Signa.n_em_sync_k0, sK0Signa.m_motist_sync_k0): Schaltmomentenoffset in Schaltungen" MAP 0x21549C Map.si16.si16.si16_S6_S3 3000 UMRM_NM__1_1_0_S6_S3 -1500 1500
 /begin AXIS_DESCR STD_AXIS sK0Signa.n_em_sync_k0 UMRM_U_MIN_1_1_0_S6_S3 4 0 10000 DEPOSIT ABSOLUTE MONOTONY STRICT_INCREASE /end AXIS_DESCR
 /begin AXIS_DESCR STD_AXIS sK0Signa.m_motist_sync_k0 UMRM_NM__1_1_0_S6_S3 6 -200 1300 DEPOSIT ABSOLUTE MONOTONY STRICT_INCREASE /end AXIS_DESCR
/end CHARACTERISTIC
/begin CHARACTERISTIC AMAX.KF_MOSCHALTK0[_45] "KF4x6 f(sK0Signa.n_em_sync_k0, sK0Signa.m_motist_sync_k0): Schaltmomentenoffset in Schaltungen" MAP 0x2154E0 Map.si16.si16.si16_S6_S3 3000 UMRM_NM__1_1_0_S6_S3 -1500 1500
 /begin AXIS_DESCR STD_AXIS sK0Signa.n_em_sync_k0 UMRM_U_MIN_1_1_0_S6_S3 4 0 10000 DEPOSIT ABSOLUTE MONOTONY STRICT_INCREASE /end AXIS_DESCR
 /begin AXIS_DESCR STD_AXIS sK0Signa.m_motist_sync_k0 UMRM_NM__1_1_0_S6_S3 6 -200 1300 DEPOSIT ABSOLUTE MONOTONY STRICT_INCREASE /end AXIS_DESCR
/end CHARACTERISTIC
/begin CHARACTERISTIC AMAX.KF_MOSCHALTK0[_56] "KF4x6 f(sK0Signa.n_em_sync_k0, sK0Signa.m_motist_sync_k0): Schaltmomentenoffset in Schaltungen" MAP 0x215524 Map.si16.si16.si16_S6_S3 3000 UMRM_NM__1_1_0_S6_S3 -1500 1500
 /begin AXIS_DESCR STD_AXIS sK0Signa.n_em_sync_k0 UMRM_U_MIN_1_1_0_S6_S3 4 0 10000 DEPOSIT ABSOLUTE MONOTONY STRICT_INCREASE /end AXIS_DESCR
 /begin AXIS_DESCR STD_AXIS sK0Signa.m_motist_sync_k0 UMRM_NM__1_1_0_S6_S3 6 -200 1300 DEPOSIT ABSOLUTE MONOTONY STRICT_INCREASE /end AXIS_DESCR
/end CHARACTERISTIC
/begin CHARACTERISTIC AMAX.KF_MOSCHALTK0[_67] "KF4x6 f(sK0Signa.n_em_sync_k0, sK0Signa.m_motist_sync_k0): Schaltmomentenoffset in Schaltungen" MAP 0x215568 Map.si16.si16.si16_S6_S3 3000 UMRM_NM__1_1_0_S6_S3 -1500 1500
 /begin AXIS_DESCR STD_AXIS sK0Signa.n_em_sync_k0 UMRM_U_MIN_1_1_0_S6_S3 4 0 10000 DEPOSIT ABSOLUTE MONOTONY STRICT_INCREASE /end AXIS_DESCR
 /begin AXIS_DESCR STD_AXIS sK0Signa.m_motist_sync_k0 UMRM_NM__1_1_0_S6_S3 6 -200 1300 DEPOSIT ABSOLUTE MONOTONY STRICT_INCREASE /end AXIS_DESCR
/end CHARACTERISTIC
/begin CHARACTERISTIC AMAX.KF_MOSCHALTK0[_78] "KF4x6 f(sK0Signa.n_em_sync_k0, sK0Signa.m_motist_sync_k0): Schaltmomentenoffset in Schaltungen" MAP 0x2155AC Map.si16.si16.si16_S6_S3 3000 UMRM_NM__1_1_0_S6_S3 -1500 1500
 /begin AXIS_DESCR STD_AXIS sK0Signa.n_em_sync_k0 UMRM_U_MIN_1_1_0_S6_S3 4 0 10000 DEPOSIT ABSOLUTE MONOTONY STRICT_INCREASE /end AXIS_DESCR
 /begin AXIS_DESCR STD_AXIS sK0Signa.m_motist_sync_k0 UMRM_NM__1_1_0_S6_S3 6 -200 1300 DEPOSIT ABSOLUTE MONOTONY STRICT_INCREASE /end AXIS_DESCR
/end CHARACTERISTIC
/begin CHARACTERISTIC AMAX.KF_MOSCHALTK0[_21] "KF4x6 f(sK0Signa.n_em_sync_k0, sK0Signa.m_motist_sync_k0): Schaltmomentenoffset in Schaltungen" MAP 0x2155F0 Map.si16.si16.si16_S6_S3 3000 UMRM_NM__1_1_0_S6_S3 -1500 1500
 /begin AXIS_DESCR STD_AXIS sK0Signa.n_em_sync_k0 UMRM_U_MIN_1_1_0_S6_S3 4 0 10000 DEPOSIT ABSOLUTE MONOTONY STRICT_INCREASE /end AXIS_DESCR
 /begin AXIS_DESCR STD_AXIS sK0Signa.m_motist_sync_k0 UMRM_NM__1_1_0_S6_S3 6 -200 1300 DEPOSIT ABSOLUTE MONOTONY STRICT_INCREASE /end AXIS_DESCR
/end CHARACTERISTIC
/begin CHARACTERISTIC AMAX.KF_MOSCHALTK0[_32] "KF4x6 f(sK0Signa.n_em_sync_k0, sK0Signa.m_motist_sync_k0): Schaltmomentenoffset in Schaltungen" MAP 0x215634 Map.si16.si16.si16_S6_S3 3000 UMRM_NM__1_1_0_S6_S3 -1500 1500
 /begin AXIS_DESCR STD_AXIS sK0Signa.n_em_sync_k0 UMRM_U_MIN_1_1_0_S6_S3 4 0 10000 DEPOSIT ABSOLUTE MONOTONY STRICT_INCREASE /end AXIS_DESCR
 /begin AXIS_DESCR STD_AXIS sK0Signa.m_motist_sync_k0 UMRM_NM__1_1_0_S6_S3 6 -200 1300 DEPOSIT ABSOLUTE MONOTONY STRICT_INCREASE /end AXIS_DESCR
/end CHARACTERISTIC
/begin CHARACTERISTIC AMAX.KF_MOSCHALTK0[_43] "KF4x6 f(sK0Signa.n_em_sync_k0, sK0Signa.m_motist_sync_k0): Schaltmomentenoffset in Schaltungen" MAP 0x215678 Map.si16.si16.si16_S6_S3 3000 UMRM_NM__1_1_0_S6_S3 -1500 1500
 /begin AXIS_DESCR STD_AXIS sK0Signa.n_em_sync_k0 UMRM_U_MIN_1_1_0_S6_S3 4 0 10000 DEPOSIT ABSOLUTE MONOTONY STRICT_INCREASE /end AXIS_DESCR
 /begin AXIS_DESCR STD_AXIS sK0Signa.m_motist_sync_k0 UMRM_NM__1_1_0_S6_S3 6 -200 1300 DEPOSIT ABSOLUTE MONOTONY STRICT_INCREASE /end AXIS_DESCR
/end CHARACTERISTIC
/begin CHARACTERISTIC AMAX.KF_MOSCHALTK0[_54] "KF4x6 f(sK0Signa.n_em_sync_k0, sK0Signa.m_motist_sync_k0): Schaltmomentenoffset in Schaltungen" MAP 0x2156BC Map.si16.si16.si16_S6_S3 3000 UMRM_NM__1_1_0_S6_S3 -1500 1500
 /begin AXIS_DESCR STD_AXIS sK0Signa.n_em_sync_k0 UMRM_U_MIN_1_1_0_S6_S3 4 0 10000 DEPOSIT ABSOLUTE MONOTONY STRICT_INCREASE /end AXIS_DESCR
 /begin AXIS_DESCR STD_AXIS sK0Signa.m_motist_sync_k0 UMRM_NM__1_1_0_S6_S3 6 -200 1300 DEPOSIT ABSOLUTE MONOTONY STRICT_INCREASE /end AXIS_DESCR
/end CHARACTERISTIC
/begin CHARACTERISTIC AMAX.KF_MOSCHALTK0[_65] "KF4x6 f(sK0Signa.n_em_sync_k0, sK0Signa.m_motist_sync_k0): Schaltmomentenoffset in Schaltungen" MAP 0x215700 Map.si16.si16.si16_S6_S3 3000 UMRM_NM__1_1_0_S6_S3 -1500 1500
 /begin AXIS_DESCR STD_AXIS sK0Signa.n_em_sync_k0 UMRM_U_MIN_1_1_0_S6_S3 4 0 10000 DEPOSIT ABSOLUTE MONOTONY STRICT_INCREASE /end AXIS_DESCR
 /begin AXIS_DESCR STD_AXIS sK0Signa.m_motist_sync_k0 UMRM_NM__1_1_0_S6_S3 6 -200 1300 DEPOSIT ABSOLUTE MONOTONY STRICT_INCREASE /end AXIS_DESCR
/end CHARACTERISTIC
/begin CHARACTERISTIC AMAX.KF_MOSCHALTK0[_76] "KF4x6 f(sK0Signa.n_em_sync_k0, sK0Signa.m_motist_sync_k0): Schaltmomentenoffset in Schaltungen" MAP 0x215744 Map.si16.si16.si16_S6_S3 3000 UMRM_NM__1_1_0_S6_S3 -1500 1500
 /begin AXIS_DESCR STD_AXIS sK0Signa.n_em_sync_k0 UMRM_U_MIN_1_1_0_S6_S3 4 0 10000 DEPOSIT ABSOLUTE MONOTONY STRICT_INCREASE /end AXIS_DESCR
 /begin AXIS_DESCR STD_AXIS sK0Signa.m_motist_sync_k0 UMRM_NM__1_1_0_S6_S3 6 -200 1300 DEPOSIT ABSOLUTE MONOTONY STRICT_INCREASE /end AXIS_DESCR
/end CHARACTERISTIC
/begin CHARACTERISTIC AMAX.KF_MOSCHALTK0[_87] "KF4x6 f(sK0Signa.n_em_sync_k0, sK0Signa.m_motist_sync_k0): Schaltmomentenoffset in Schaltungen" MAP 0x215788 Map.si16.si16.si16_S6_S3 3000 UMRM_NM__1_1_0_S6_S3 -1500 1500
 /begin AXIS_DESCR STD_AXIS sK0Signa.n_em_sync_k0 UMRM_U_MIN_1_1_0_S6_S3 4 0 10000 DEPOSIT ABSOLUTE MONOTONY STRICT_INCREASE /end AXIS_DESCR
 /begin AXIS_DESCR STD_AXIS sK0Signa.m_motist_sync_k0 UMRM_NM__1_1_0_S6_S3 6 -200 1300 DEPOSIT ABSOLUTE MONOTONY STRICT_INCREASE /end AXIS_DESCR
/end CHARACTERISTIC
/begin CHARACTERISTIC AMAX.KF_MOSCHALTK0[_31] "KF4x6 f(sK0Signa.n_em_sync_k0, sK0Signa.m_motist_sync_k0): Schaltmomentenoffset in Schaltungen" MAP 0x2157CC Map.si16.si16.si16_S6_S3 3000 UMRM_NM__1_1_0_S6_S3 -1500 1500
 /begin AXIS_DESCR STD_AXIS sK0Signa.n_em_sync_k0 UMRM_U_MIN_1_1_0_S6_S3 4 0 10000 DEPOSIT ABSOLUTE MONOTONY STRICT_INCREASE /end AXIS_DESCR
 /begin AXIS_DESCR STD_AXIS sK0Signa.m_motist_sync_k0 UMRM_NM__1_1_0_S6_S3 6 -200 1300 DEPOSIT ABSOLUTE MONOTONY STRICT_INCREASE /end AXIS_DESCR
/end CHARACTERISTIC
/begin CHARACTERISTIC AMAX.KF_MOSCHALTK0[_42] "KF4x6 f(sK0Signa.n_em_sync_k0, sK0Signa.m_motist_sync_k0): Schaltmomentenoffset in Schaltungen" MAP 0x215810 Map.si16.si16.si16_S6_S3 3000 UMRM_NM__1_1_0_S6_S3 -1500 1500
 /begin AXIS_DESCR STD_AXIS sK0Signa.n_em_sync_k0 UMRM_U_MIN_1_1_0_S6_S3 4 0 10000 DEPOSIT ABSOLUTE MONOTONY STRICT_INCREASE /end AXIS_DESCR
 /begin AXIS_DESCR STD_AXIS sK0Signa.m_motist_sync_k0 UMRM_NM__1_1_0_S6_S3 6 -200 1300 DEPOSIT ABSOLUTE MONOTONY STRICT_INCREASE /end AXIS_DESCR
/end CHARACTERISTIC
/begin CHARACTERISTIC AMAX.KF_MOSCHALTK0[_53] "KF4x6 f(sK0Signa.n_em_sync_k0, sK0Signa.m_motist_sync_k0): Schaltmomentenoffset in Schaltungen" MAP 0x215854 Map.si16.si16.si16_S6_S3 3000 UMRM_NM__1_1_0_S6_S3 -1500 1500
 /begin AXIS_DESCR STD_AXIS sK0Signa.n_em_sync_k0 UMRM_U_MIN_1_1_0_S6_S3 4 0 10000 DEPOSIT ABSOLUTE MONOTONY STRICT_INCREASE /end AXIS_DESCR
 /begin AXIS_DESCR STD_AXIS sK0Signa.m_motist_sync_k0 UMRM_NM__1_1_0_S6_S3 6 -200 1300 DEPOSIT ABSOLUTE MONOTONY STRICT_INCREASE /end AXIS_DESCR
/end CHARACTERISTIC
/begin CHARACTERISTIC AMAX.KF_MOSCHALTK0[_51] "KF4x6 f(sK0Signa.n_em_sync_k0, sK0Signa.m_motist_sync_k0): Schaltmomentenoffset in Schaltungen" MAP 0x215898 Map.si16.si16.si16_S6_S3 3000 UMRM_NM__1_1_0_S6_S3 -1500 1500
 /begin AXIS_DESCR STD_AXIS sK0Signa.n_em_sync_k0 UMRM_U_MIN_1_1_0_S6_S3 4 0 10000 DEPOSIT ABSOLUTE MONOTONY STRICT_INCREASE /end AXIS_DESCR
 /begin AXIS_DESCR STD_AXIS sK0Signa.m_motist_sync_k0 UMRM_NM__1_1_0_S6_S3 6 -200 1300 DEPOSIT ABSOLUTE MONOTONY STRICT_INCREASE /end AXIS_DESCR
/end CHARACTERISTIC
/begin CHARACTERISTIC AMAX.KF_MOSCHALTK0[_64] "KF4x6 f(sK0Signa.n_em_sync_k0, sK0Signa.m_motist_sync_k0): Schaltmomentenoffset in Schaltungen" MAP 0x2158DC Map.si16.si16.si16_S6_S3 3000 UMRM_NM__1_1_0_S6_S3 -1500 1500
 /begin AXIS_DESCR STD_AXIS sK0Signa.n_em_sync_k0 UMRM_U_MIN_1_1_0_S6_S3 4 0 10000 DEPOSIT ABSOLUTE MONOTONY STRICT_INCREASE /end AXIS_DESCR
 /begin AXIS_DESCR STD_AXIS sK0Signa.m_motist_sync_k0 UMRM_NM__1_1_0_S6_S3 6 -200 1300 DEPOSIT ABSOLUTE MONOTONY STRICT_INCREASE /end AXIS_DESCR
/end CHARACTERISTIC
/begin CHARACTERISTIC AMAX.KF_MOSCHALTK0[_63] "KF4x6 f(sK0Signa.n_em_sync_k0, sK0Signa.m_motist_sync_k0): Schaltmomentenoffset in Schaltungen" MAP 0x215920 Map.si16.si16.si16_S6_S3 3000 UMRM_NM__1_1_0_S6_S3 -1500 1500
 /begin AXIS_DESCR STD_AXIS sK0Signa.n_em_sync_k0 UMRM_U_MIN_1_1_0_S6_S3 4 0 10000 DEPOSIT ABSOLUTE MONOTONY STRICT_INCREASE /end AXIS_DESCR
 /begin AXIS_DESCR STD_AXIS sK0Signa.m_motist_sync_k0 UMRM_NM__1_1_0_S6_S3 6 -200 1300 DEPOSIT ABSOLUTE MONOTONY STRICT_INCREASE /end AXIS_DESCR
/end CHARACTERISTIC
/begin CHARACTERISTIC AMAX.KF_MOSCHALTK0[_75] "KF4x6 f(sK0Signa.n_em_sync_k0, sK0Signa.m_motist_sync_k0): Schaltmomentenoffset in Schaltungen" MAP 0x215964 Map.si16.si16.si16_S6_S3 3000 UMRM_NM__1_1_0_S6_S3 -1500 1500
 /begin AXIS_DESCR STD_AXIS sK0Signa.n_em_sync_k0 UMRM_U_MIN_1_1_0_S6_S3 4 0 10000 DEPOSIT ABSOLUTE MONOTONY STRICT_INCREASE /end AXIS_DESCR
 /begin AXIS_DESCR STD_AXIS sK0Signa.m_motist_sync_k0 UMRM_NM__1_1_0_S6_S3 6 -200 1300 DEPOSIT ABSOLUTE MONOTONY STRICT_INCREASE /end AXIS_DESCR
/end CHARACTERISTIC
/begin CHARACTERISTIC AMAX.KF_MOSCHALTK0[_71] "KF4x6 f(sK0Signa.n_em_sync_k0, sK0Signa.m_motist_sync_k0): Schaltmomentenoffset in Schaltungen" MAP 0x2159A8 Map.si16.si16.si16_S6_S3 3000 UMRM_NM__1_1_0_S6_S3 -1500 1500
 /begin AXIS_DESCR STD_AXIS sK0Signa.n_em_sync_k0 UMRM_U_MIN_1_1_0_S6_S3 4 0 10000 DEPOSIT ABSOLUTE MONOTONY STRICT_INCREASE /end AXIS_DESCR
 /begin AXIS_DESCR STD_AXIS sK0Signa.m_motist_sync_k0 UMRM_NM__1_1_0_S6_S3 6 -200 1300 DEPOSIT ABSOLUTE MONOTONY STRICT_INCREASE /end AXIS_DESCR
/end CHARACTERISTIC
/begin CHARACTERISTIC AMAX.KF_MOSCHALTK0[_86] "KF4x6 f(sK0Signa.n_em_sync_k0, sK0Signa.m_motist_sync_k0): Schaltmomentenoffset in Schaltungen" MAP 0x2159EC Map.si16.si16.si16_S6_S3 3000 UMRM_NM__1_1_0_S6_S3 -1500 1500
 /begin AXIS_DESCR STD_AXIS sK0Signa.n_em_sync_k0 UMRM_U_MIN_1_1_0_S6_S3 4 0 10000 DEPOSIT ABSOLUTE MONOTONY STRICT_INCREASE /end AXIS_DESCR
 /begin AXIS_DESCR STD_AXIS sK0Signa.m_motist_sync_k0 UMRM_NM__1_1_0_S6_S3 6 -200 1300 DEPOSIT ABSOLUTE MONOTONY STRICT_INCREASE /end AXIS_DESCR
/end CHARACTERISTIC
/begin CHARACTERISTIC AMAX.KF_MOSCHALTK0[_84] "KF4x6 f(sK0Signa.n_em_sync_k0, sK0Signa.m_motist_sync_k0): Schaltmomentenoffset in Schaltungen" MAP 0x215A30 Map.si16.si16.si16_S6_S3 3000 UMRM_NM__1_1_0_S6_S3 -1500 1500
 /begin AXIS_DESCR STD_AXIS sK0Signa.n_em_sync_k0 UMRM_U_MIN_1_1_0_S6_S3 4 0 10000 DEPOSIT ABSOLUTE MONOTONY STRICT_INCREASE /end AXIS_DESCR
 /begin AXIS_DESCR STD_AXIS sK0Signa.m_motist_sync_k0 UMRM_NM__1_1_0_S6_S3 6 -200 1300 DEPOSIT ABSOLUTE MONOTONY STRICT_INCREASE /end AXIS_DESCR
/end CHARACTERISTIC
/begin CHARACTERISTIC AMAX.KF_MOSCHALTK0[_82] "KF4x6 f(sK0Signa.n_em_sync_k0, sK0Signa.m_motist_sync_k0): Schaltmomentenoffset in Schaltungen" MAP 0x215A74 Map.si16.si16.si16_S6_S3 3000 UMRM_NM__1_1_0_S6_S3 -1500 1500
 /begin AXIS_DESCR STD_AXIS sK0Signa.n_em_sync_k0 UMRM_U_MIN_1_1_0_S6_S3 4 0 10000 DEPOSIT ABSOLUTE MONOTONY STRICT_INCREASE /end AXIS_DESCR
 /begin AXIS_DESCR STD_AXIS sK0Signa.m_motist_sync_k0 UMRM_NM__1_1_0_S6_S3 6 -200 1300 DEPOSIT ABSOLUTE MONOTONY STRICT_INCREASE /end AXIS_DESCR
/end CHARACTERISTIC
/begin CHARACTERISTIC sK0Mom.KF_F_KI_K0 "KF4x4 f(sK0Signa.nd_k0_abs, c_getr): Gewichtungsfaktor fuer I-Anteil im Regler" MAP 0x21374C Map.fl32.fl32.fl32_S6_S3 30 UMRM___1_1_0_S6_S3 0 30 FORMAT "%5.3"
 /begin AXIS_DESCR STD_AXIS sK0Signa.nd_k0_abs_fl32 UMRM_U_MIN_1_1_0_S6_S3 4 0 8128 DEPOSIT ABSOLUTE MONOTONY STRICT_INCREASE FORMAT "%5.3" /end AXIS_DESCR
 /begin AXIS_DESCR STD_AXIS NO_INPUT_QUANTITY UMRM_GRADC__1_1_0_S6_S3 4 -40 215 DEPOSIT ABSOLUTE MONOTONY STRICT_INCREASE FORMAT "%5.3" /end AXIS_DESCR
/end CHARACTERISTIC
/begin CHARACTERISTIC sK0Mom.KF_F_MOMVMISTMVMSOLL_K0 "KF9x9 f(sK0Signa.m_vmist_sync_k0, sK0Signa.m_vmsollgemvor_sync_k0): Anteil Faktor auf mg_vmsollgemvor_sync_k0" MAP 0x213C08 Map.si16.si16.si16_S6_S3 20 UMRM___1_100_0_S6_S3 -10 10
 /begin AXIS_DESCR STD_AXIS sK0Signa.m_vmist_sync_k0 UMRM_NM__1_1_0_S6_S3 9 -200 1300 DEPOSIT ABSOLUTE MONOTONY STRICT_INCREASE /end AXIS_DESCR
 /begin AXIS_DESCR STD_AXIS sK0Signa.m_vmsollgemvor_sync_k0 UMRM_NM__1_1_0_S6_S3 9 -200 1300 DEPOSIT ABSOLUTE MONOTONY STRICT_INCREASE /end AXIS_DESCR
/end CHARACTERISTIC
/begin CHARACTERISTIC sK0Mom.KF_F_MOMMGVMSOLL_K0 "KF9x9 f(sK0Signa.delta_mvmistmvmsoll_k0, sK0Signa.mg_vmsollgemvor_sync_k0): Anteil Faktor auf mg_vmsollgemvor_sync_k0" MAP 0x213B42 Map.si16.si16.si16_S6_S3 20 UMRM___1_100_0_S6_S3 -10 10
 /begin AXIS_DESCR STD_AXIS sK0Signa.delta_mvmistmvmsoll_k0 UMRM_NM__1_1_0_S6_S3 9 -1300 1300 DEPOSIT ABSOLUTE MONOTONY STRICT_INCREASE /end AXIS_DESCR
 /begin AXIS_DESCR STD_AXIS sK0Signa.mg_vmsollgemvor_sync_k0 UMRM_NM_SEC_1_1_0_S6_S3 9 -32768 32767 DEPOSIT ABSOLUTE MONOTONY STRICT_INCREASE /end AXIS_DESCR
/end CHARACTERISTIC
/begin CHARACTERISTIC sK0Signa.I_KEINKRAFTSCHLUSS_K0 "Fester Ersatzwert fuer i_getriebe_virt_k0_roh bei fehlendem Kraftschluss" VALUE 0x215B94 Parameter.ui16_S6_S3 65.535 UMRM___1_1000_0_S6_S3 0 65.535 /end CHARACTERISTIC
/begin CHARACTERISTIC sK0Signa.MPT_MINIT_REST_K0 "PT1-Filterkonstante zum Abfiltern von m_init_rest_k0" VALUE 0x215BAD Parameter.ui8_S6_S3 0.99 UMRM___1_100_0_S6_S3 0.01 1 /end CHARACTERISTIC
/begin CHARACTERISTIC sK0Signa.MPT_NDZSZUG_K0 "PT1-Filterkonstante zum Filtern der Solldifferenzdrehzahl nd_k0" VALUE 0x215BB2 Parameter.ui8_S6_S3 0.99 UMRM___1_100_0_S6_S3 0.01 1 /end CHARACTERISTIC
/begin CHARACTERISTIC sK0Signa.NDS_LWREGK0Z "Differenzdrehzahlschwelle fuer wechsel nach Schub" VALUE 0x215B9C Parameter.si16_S6_S3 3000 UMRM_U_MIN_1_1_0_S6_S3 -1500 1500 /end CHARACTERISTIC
/begin CHARACTERISTIC sK0Signa.NDS_LWREGK0S "Differenzdrehzahlschwelle fuer wechsel nach Zug" VALUE 0x215B9A Parameter.si16_S6_S3 3000 UMRM_U_MIN_1_1_0_S6_S3 -1500 1500 /end CHARACTERISTIC
/begin CHARACTERISTIC sK0Signa.NDS_NEMAUSVRA_PLAUSI_K0 "Differenzdrehzahlschwelle fuer Plausibilisierung n_em_nabauvra_sync_k0 gegenueber n_em_sync_k0" VALUE 0x215B9E Parameter.ui16_S6_S3 1500 UMRM_U_MIN_1_1_0_S6_S3 0 1500 /end CHARACTERISTIC
/begin CHARACTERISTIC sK0Signa.NDS_IAEEMAUSVRA_K0 "Differenzdrehzahlschwelle IAE fuer Berechnung n_em_nabauvra_sync_k0" VALUE 0x215BB4 Parameter.ui8_S6_S3 255 UMRM_U_MIN_1_1_0_S6_S3 0 255 /end CHARACTERISTIC
/begin CHARACTERISTIC sK0Signa.NDS_SYNCNTNAB_K0 "Differenzdrehzahlschwelle Synchron Gang zum Umschalten auf nd_mod_k0" VALUE 0x215BB5 Parameter.ui8_S6_S3 255 UMRM_U_MIN_1_1_0_S6_S3 0 255 /end CHARACTERISTIC
/begin CHARACTERISTIC sK0Signa.MDS_LWREGK0Z "Momentenschwelle fuer Zug erkennung" VALUE 0x215B98 Parameter.si16_S6_S3 3000 UMRM_NM__1_1_0_S6_S3 -1500 1500 /end CHARACTERISTIC
/begin CHARACTERISTIC sK0Signa.MDS_LWREGK0S "Momentenschwelle fuer Schuberkennung" VALUE 0x215B96 Parameter.si16_S6_S3 3000 UMRM_NM__1_1_0_S6_S3 -1500 1500 /end CHARACTERISTIC
/begin CHARACTERISTIC sK0Signa.MPT_NT_K0 "Filterzeitkonstante des PT1-Filter fuer Turbinendrehzahl" VALUE 0x215BB3 Parameter.ui8_S6_S3 0.99 UMRM___1_100_0_S6_S3 0.01 1 /end CHARACTERISTIC
/begin CHARACTERISTIC sK0Signa.MPT_NAB_K0 "Filterzeitkonstante des PT1-Filter fuer Abtriebsdrehzahl" VALUE 0x215BB1 Parameter.ui8_S6_S3 0.99 UMRM___1_100_0_S6_S3 0.01 1 /end CHARACTERISTIC
/begin CHARACTERISTIC sK0Signa.MPT_NABAUSVRA_K0 "Filterzeitkonstante des PT1-Filter fuer aus Raddrehzahl berechnete Abtriebsdrehzahl" VALUE 0x215BB0 Parameter.ui8_S6_S3 0.99 UMRM___1_100_0_S6_S3 0.01 1 /end CHARACTERISTIC
/begin CHARACTERISTIC sK0Signa.MPT_MMOTIST_K0 "Filterzeitkonstante fuer Motoristmoment" VALUE 0x215BAE Parameter.ui8_S6_S3 0.99 UMRM___1_100_0_S6_S3 0.01 1 /end CHARACTERISTIC
/begin CHARACTERISTIC sK0Signa.MPT_MEMIST_K0 "Filterzeitkonstante fuer E-Maschinenistmoment" VALUE 0x215BAC Parameter.ui8_S6_S3 0.99 UMRM___1_100_0_S6_S3 0.01 1 /end CHARACTERISTIC
/begin CHARACTERISTIC sK0Signa.MPT_MVMIST_K0 "Filterzeitkonstante fuer Verbrennungsmotoristmoment" VALUE 0x215BAF Parameter.ui8_S6_S3 0.99 UMRM___1_100_0_S6_S3 0.01 1 /end CHARACTERISTIC
/begin CHARACTERISTIC sK0Signa.MPT_I_GETRIEBE_VIRT_K0 "Filterzeitkonstante fuer Verbrennungsmotoristmoment" VALUE 0x215BAB Parameter.ui8_S6_S3 0.99 UMRM___1_100_0_S6_S3 0.01 1 /end CHARACTERISTIC
/begin CHARACTERISTIC sK0Signa.MDT_DKGPEDAL_K0 "Filterkonstante fuer DT1-Filter fuer dk_pedal" VALUE 0x215BA2 Parameter.ui8_S6_S3 0.95 UMRM___1_100_0_S6_S3 0.05 1 /end CHARACTERISTIC
/begin CHARACTERISTIC sK0Signa.MDT_MGVMSOLLGEMVOR_K0 "Koeffizient fuer DT1-Filter fuer mg_vmsollgemvor_sync" VALUE 0x215BA3 Parameter.ui8_S6_S3 0.99 UMRM___1_100_0_S6_S3 0.01 1 /end CHARACTERISTIC
/begin CHARACTERISTIC sK0Signa.MDT_NGAB_K0 "Filterkonstante fuer DT1-Filter fuer Gradient der Abtriebsdrehzahl" VALUE 0x215BA5 Parameter.ui8_S6_S3 0.9 UMRM___1_100_0_S6_S3 0.1 1 /end CHARACTERISTIC
/begin CHARACTERISTIC sK0Signa.MDT_NDG_K0 "Filterkonstante fuer DT1-Filter fuer Gradient der Istdifferenzdrehzahl" VALUE 0x215BA4 Parameter.ui8_S6_S3 0.9 UMRM___1_100_0_S6_S3 0.1 1 /end CHARACTERISTIC
/begin CHARACTERISTIC sK0Signa.MDT_NG_EM_K0 "Koeffizient fuer DT1-Filter fuer Em Drehzahlgradient" VALUE 0x215BA6 Parameter.ui8_S6_S3 0.95 UMRM___1_100_0_S6_S3 0.05 1 /end CHARACTERISTIC
/begin CHARACTERISTIC sK0Signa.MO_VMIST_K0 "Momentenoffset zur Nullpunktanpassung Verbrennungsmotor Istmoment" VALUE 0x215BA9 Parameter.si8_S6_S3 200 UMRM_NM__1_1_0_S6_S3 -100 100 /end CHARACTERISTIC
/begin CHARACTERISTIC sK0Signa.MO_EMIST_K0 "Momentenoffset zur Nullpunktanpassung E-Maschinen Istmoment" VALUE 0x215BA7 Parameter.si8_S6_S3 200 UMRM_NM__1_1_0_S6_S3 -100 100 /end CHARACTERISTIC
/begin CHARACTERISTIC sK0Signa.MO_VMSOLL_K0 "Momentenoffset zur Nullpunktanpassung Verbrennungsmotorsollmoment ohne Getriebeeingriff" VALUE 0x215BAA Parameter.si8_S6_S3 200 UMRM_NM__1_1_0_S6_S3 -100 100 /end CHARACTERISTIC
/begin CHARACTERISTIC sK0Signa.MO_MMOTIST_K0 "Momentenoffset" VALUE 0x215BA8 Parameter.si8_S6_S3 200 UMRM_NM__1_1_0_S6_S3 -100 100 /end CHARACTERISTIC
/begin CHARACTERISTIC sK0Signa.NMOT_ADDKORR_K0 "Additiver Korrekturwert fuer Motordrehzahl" VALUE 0x215BB6 Parameter.si8_S6_S3 200 UMRM_U_MIN_1_1_0_S6_S3 -100 100 /end CHARACTERISTIC
/begin CHARACTERISTIC sK0Signa.VZ_MMOTIST_K0 "Verzögerungszeit Motoristmoment" VALUE 0x215BBD Parameter.ui8_S6_S3 90 UMRM_MSEC__10_1_0_S6_S3 0 90 /end CHARACTERISTIC
/begin CHARACTERISTIC sK0Signa.VZ_MEMIST_K0 "Verzögerungszeit fuer E-AMschinenistmoment" VALUE 0x215BBC Parameter.ui8_S6_S3 90 UMRM_MSEC__10_1_0_S6_S3 0 90 /end CHARACTERISTIC
/begin CHARACTERISTIC sK0Signa.VZ_MVMIST_K0 "Verzögerungszeit Verbrennungsmotoristmoment" VALUE 0x215BBE Parameter.ui8_S6_S3 90 UMRM_MSEC__10_1_0_S6_S3 0 90 /end CHARACTERISTIC
/begin CHARACTERISTIC sK0Signa.VZ_NABNT_K0 "Verzögerungszeit Abtriebsdrehzahl und Turbinendrehzahl" VALUE 0x215BC0 Parameter.ui8_S6_S3 90 UMRM_MSEC__10_1_0_S6_S3 0 90 /end CHARACTERISTIC
/begin CHARACTERISTIC sK0Signa.VZ_NABAUSVRA_K0 "Verzögerungszeit aus Raddrehzahl berechnete Abtriebsdrehzahl" VALUE 0x215BBF Parameter.ui8_S6_S3 90 UMRM_MSEC__10_1_0_S6_S3 0 90 /end CHARACTERISTIC
/begin CHARACTERISTIC sK0Signa.VZ_NVM_K0 "Verzögerungszeit Verbrennungsmotormoment" VALUE 0x215BC2 Parameter.ui8_S6_S3 90 UMRM_MSEC__10_1_0_S6_S3 0 90 /end CHARACTERISTIC
/begin CHARACTERISTIC sK0Signa.VZ_NMOT_K0 "Verzögerungszeit Motormoment" VALUE 0x215BC1 Parameter.ui8_S6_S3 90 UMRM_MSEC__10_1_0_S6_S3 0 90 /end CHARACTERISTIC
/begin CHARACTERISTIC sK0Signa.J_MOTOR_K0 "Traegheitsmoment Motorseite" VALUE 0x215AC0 Parameter.fl32_S6_S3 5 UMRM_KGM2__1_1_0_S6_S3 0 5 FORMAT "%5.3" /end CHARACTERISTIC
/begin CHARACTERISTIC sK0Signa.J_FAHRZEUG_K0 "Fahrzeug Traegheit" VALUE 0x215ABC Parameter.fl32_S6_S3 47 UMRM_KGM2__1_1_0_S6_S3 3 50 FORMAT "%5.3" /end CHARACTERISTIC
/begin CHARACTERISTIC sK0Signa.J_PRI_K0 "Traegheitsmoment Trennkupplung K0 Primaerseite" VALUE 0x215AC4 Parameter.fl32_S6_S3 5 UMRM_KGM2__1_1_0_S6_S3 0 5 FORMAT "%5.3" /end CHARACTERISTIC
/begin CHARACTERISTIC sK0Signa.J_SEK_K0 "Traegheitsmoment Secundaerseite K0" VALUE 0x215AC8 Parameter.fl32_S6_S3 5 UMRM_KGM2__1_1_0_S6_S3 0 5 FORMAT "%5.3" /end CHARACTERISTIC
/begin CHARACTERISTIC sK0Signa.J_EM_K0 "Traegheitsmoment E-Maschine" VALUE 0x215AB8 Parameter.fl32_S6_S3 5 UMRM_KGM2__1_1_0_S6_S3 0 5 FORMAT "%5.3" /end CHARACTERISTIC
/begin CHARACTERISTIC sK0Signa.SWI_JFZGSCHALTAKTIV_K0 "Schalter zur Umschaltung der Traegheitsberechnung" VALUE 0x215BB7 Parameter.ui8_S6_S3 3 UMRM___1_1_0_S6_S3 0 3 /end CHARACTERISTIC
/begin CHARACTERISTIC sK0Signa.SWI_KEINKRAFTSCHLUSS_K0 "Schalter zum Umschalten zwischen den Berechnungsarten des sek Traegheitmoment 0 normal 1 erweitert" VALUE 0x215BB8 Parameter.ui8_S6_S3 3 UMRM___1_1_0_S6_S3 0 3 /end CHARACTERISTIC
/begin CHARACTERISTIC sK0Signa.SWI_ZUGSCHUBERKENNUNG_K0 "Zug-Schub Erkennung 0: Momentenbasiert 1: Drehzahl" VALUE 0x215BBB Parameter.ui8_S6_S3 1 UMRM___1_1_0_S6_S3 0 1 /end CHARACTERISTIC
/begin CHARACTERISTIC sK0Signa.SWI_MSOLL_K0 "Schalter zur Umschaltung der Sollmoment Größe" VALUE 0x215BB9 Parameter.ui8_S6_S3 1 UMRM___1_1_0_S6_S3 0 1 /end CHARACTERISTIC
/begin CHARACTERISTIC sK0Signa.SWI_NDNABAUSVRA_K0 "Aktivierung von Berechnung modifizierter Differenzdrehzahl" VALUE 0x215BBA Parameter.ui8_S6_S3 1 eBool_on_off_S6_S3 0 1 /end CHARACTERISTIC
/begin CHARACTERISTIC sK0Signa.T_CHANGE_ND_K0 "Zeit zum Umschalten der Differnzdrehzahl zwischen nd_k0 und nd_nabausvra_k0" VALUE 0x215BA0 Parameter.ui16_S6_S3 655350 UMRM_MSEC__10_1_0_S6_S3 0 655350 /end CHARACTERISTIC
/begin CHARACTERISTIC sK0Signa.TAB_F_MVMSOLLGEMVOR "TAB2 f(zs_zug_k0): Gewichtungsfunktion fuer gem. Verbrennungsmotormoment" CURVE 0x215BC3 Table.ui8_S6_S3 2.55 UMRM___1_100_0_S6_S3 0 2.55
 /begin AXIS_DESCR FIX_AXIS sK0Signa.zs_zug_k0 eBool_true_false_S6_S3 2 0 1 FIX_AXIS_PAR_DIST 0 1 2 /end AXIS_DESCR
/end CHARACTERISTIC
/begin CHARACTERISTIC sK0Signa.TAB_VZMVMSOLLGEMVOR "TAB2 f(sign(m_vmsollgemvor): Verzögerungszeit fuer gem. Verbrennungsmotormoment fuer die Vorsteuerung" CURVE 0x215C2B Table.ui8_S6_S3 90 UMRM_MSEC__10_1_0_S6_S3 0 90
 /begin AXIS_DESCR FIX_AXIS NO_INPUT_QUANTITY eSteigung_S6_S3 2 0 1 FIX_AXIS_PAR_DIST 0 1 2 /end AXIS_DESCR
/end CHARACTERISTIC
/begin CHARACTERISTIC sK0Signa.TAB_MPT_MVMSOLLGEMVOR_K0 "TAB2 f(Monotonie (m_vmsoll): Filterzeitkonstante fuer PT1-Filter fuer gem. Verbrennungsmotormoment fuer die Vorsteuerung" CURVE 0x215BC5 Table.ui8_S6_S3 0.99 UMRM___1_100_0_S6_S3 0.01 1
 /begin AXIS_DESCR FIX_AXIS NO_INPUT_QUANTITY eSteigung_S6_S3 2 0 1 FIX_AXIS_PAR_DIST 0 1 2 /end AXIS_DESCR
/end CHARACTERISTIC
/begin CHARACTERISTIC sK0Signa.TAB_SWILASTWECHSEL_K0_SP "TAB99 f(index_sp_sps): Label fuer Spontanitaetsindex zur Umschaltung Lastwechselparameter" CURVE 0x215BC7 Table.ui8_S6_S3 1 eSport_S6_S3 0 1
 /begin AXIS_DESCR FIX_AXIS NO_INPUT_QUANTITY eIndexSpSps_S6_S3 100 0 99 FIX_AXIS_PAR_DIST 0 1 100 /end AXIS_DESCR
/end CHARACTERISTIC
/begin CHARACTERISTIC sK0Signa.TAB_JGETRIEBE_K0 "TAB10x5 f(schaltung_anfahren_idx, istgang_sync_idx): Ersatztraegheitsmoment Sekundaerseite fuer alle Gaenge" MAP 0x215ACC Matrix.fl32_S6_S3 5 UMRM___1_1_0_S6_S3 0 5 FORMAT "%5.3"
 /begin AXIS_DESCR FIX_AXIS NO_INPUT_QUANTITY eGangIdx_S6_S3 10 0 9 FIX_AXIS_PAR_DIST 0 1 10 /end AXIS_DESCR
 /begin AXIS_DESCR FIX_AXIS NO_INPUT_QUANTITY eSchaltungsIdx_S6_S3 5 0 4 FIX_AXIS_PAR_DIST 0 1 5 /end AXIS_DESCR
/end CHARACTERISTIC
/begin CHARACTERISTIC sK0Signa.TAB_MPT_NMOT_K0 "TAB5x2 f(schaltungs_anfahren_idx, zs_zug_k0): Filterzeitkonstante fuer Motordrehzahl" MAP 0x215C2D Matrix.ui8_S6_S3 0.99 UMRM___1_100_0_S6_S3 0.01 1
 /begin AXIS_DESCR FIX_AXIS NO_INPUT_QUANTITY eSchaltungsIdx_S6_S3 5 0 4 FIX_AXIS_PAR_DIST 0 1 5 /end AXIS_DESCR
 /begin AXIS_DESCR FIX_AXIS sK0Signa.zs_zug_k0_alt eBool_true_false_S6_S3 2 0 1 FIX_AXIS_PAR_DIST 0 1 2 /end AXIS_DESCR
/end CHARACTERISTIC
/begin CHARACTERISTIC sK0Signa.TAB_MPT_NVM_K0 "TAB5x2 f(schaltungs_anfahren_idx, zs_zug_k0): Filterzeitkonstante fuer Verbrennungsmotordrehzahl" MAP 0x215C37 Matrix.ui8_S6_S3 0.99 UMRM___1_100_0_S6_S3 0.01 1
 /begin AXIS_DESCR FIX_AXIS NO_INPUT_QUANTITY eSchaltungsIdx_S6_S3 5 0 4 FIX_AXIS_PAR_DIST 0 1 5 /end AXIS_DESCR
 /begin AXIS_DESCR FIX_AXIS sK0Signa.zs_zug_k0_alt eBool_true_false_S6_S3 2 0 1 FIX_AXIS_PAR_DIST 0 1 2 /end AXIS_DESCR
/end CHARACTERISTIC
/begin CHARACTERISTIC sK0Sollw.WNDLIMIT_EXT_K0 "Grenzwert fuer externe Standardsollschlupfanforderung" VALUE 0x215CE0 Parameter.ui8_S6_S3 255 UMRM_U_MIN_1_1_0_S6_S3 0 255 /end CHARACTERISTIC
/begin CHARACTERISTIC sK0Sollw.D_WNDSTD_K0 "Daempfungskonstante fuer Standardsollwertfilter" VALUE 0x215CDB Parameter.ui8_S6_S3 2.49 UMRM___1_100_0_S6_S3 0.01 2.5 /end CHARACTERISTIC
/begin CHARACTERISTIC sK0Sollw.WND_GRENZMIN_K0 "Unterer Grenzwert fuer temperarturabhaengige Reduzierung Standardsollschlupf" VALUE 0x215CE3 Parameter.ui8_S6_S3 255 UMRM_U_MIN_1_1_0_S6_S3 0 255 /end CHARACTERISTIC
/begin CHARACTERISTIC sK0Sollw.WND_GRENZMAX_K0 "Oberer Grenzwert fuer Summe Standardsollschlupf und Fahrdynamikoffset" VALUE 0x215C84 Parameter.ui16_S6_S3 10000 UMRM_U_MIN_1_1_0_S6_S3 0 10000 /end CHARACTERISTIC
/begin CHARACTERISTIC sK0Sollw.T_WNDOSCHALT_HSS_K0 "Filterzeitkonstante zum Filtern des Schaltoffsets waehrend der Gleitphase bei HSS" VALUE 0x215CDE Parameter.ui8_S6_S3 2.49 UMRM___1_100_0_S6_S3 0.01 2.5 /end CHARACTERISTIC
/begin CHARACTERISTIC sK0Sollw.T_WNDOSCHALT_RSZ_K0 "Filterzeitkonstante zum Filtern des Schaltoffsets waehrend der Gleitphase bei RSZ" VALUE 0x215CDF Parameter.ui8_S6_S3 2.49 UMRM___1_100_0_S6_S3 0.01 2.5 /end CHARACTERISTIC
/begin CHARACTERISTIC sK0Sollw.T_WNDOSCHALTAB_HSZ_K0 "Filterzeitkonstante zum Abfiltern des Schaltoffsets waehrend Schaltungsende bei HSZ" VALUE 0x215CDC Parameter.ui8_S6_S3 2.49 UMRM___1_100_0_S6_S3 0.01 2.5 /end CHARACTERISTIC
/begin CHARACTERISTIC sK0Sollw.T_WNDOSCHALTAB_RSS_K0 "Filterzeitkonstante zum Abfiltern des Schaltoffsets waehrend Schaltungsende bei RSS" VALUE 0x215CDD Parameter.ui8_S6_S3 2.49 UMRM___1_100_0_S6_S3 0.01 2.5 /end CHARACTERISTIC
/begin CHARACTERISTIC sK0Sollw.WNDOSCHALT_HSS_K0 "Endwert des Sollwertfilters waehrend der Gleitphase bei HSS" VALUE 0x215CE1 Parameter.ui8_S6_S3 255 UMRM_U_MIN_1_1_0_S6_S3 0 255 /end CHARACTERISTIC
/begin CHARACTERISTIC sK0Sollw.WNDOSCHALT_RSZ_K0 "Endwert des Sollwertfilters waehrend der Gleitphase bei RSZ" VALUE 0x215CE2 Parameter.ui8_S6_S3 255 UMRM_U_MIN_1_1_0_S6_S3 0 255 /end CHARACTERISTIC
/begin CHARACTERISTIC sK0Sollw.D_WNDOSCHALT_K0 "Daempfungskonstante fuer Solldifferenzdrehzahl-Offset waehrend Schaltungen" VALUE 0x215CDA Parameter.ui8_S6_S3 2.49 UMRM___1_100_0_S6_S3 0.01 2.5 /end CHARACTERISTIC
/begin CHARACTERISTIC sK0Sollw.TAB_WND_K0ZU "Standardsolldifferenzdrehzahl in GEREGELTGESCHLOSSEN" CURVE 0x215CE4 Table.si8_S6_S3 255 UMRM_U_MIN_1_1_0_S6_S3 -128 127
 /begin AXIS_DESCR FIX_AXIS sK0Signa.zs_zug_k0 eBool_true_false_S6_S3 2 0 1 FIX_AXIS_PAR_DIST 0 1 2 /end AXIS_DESCR
/end CHARACTERISTIC
/begin CHARACTERISTIC sK0Sollw.TAB_T_WNDSTD_K0 "Zeitkonstante fuer Standardsollwertfilter waehrend Normalbetrieb / Warmlauf" MAP 0x215CF0 Matrix.ui8_S6_S3 2.49 UMRM___1_100_0_S6_S3 0.01 2.5
 /begin AXIS_DESCR FIX_AXIS NO_INPUT_QUANTITY eSchaltungsIdx_S6_S3 5 0 4 FIX_AXIS_PAR_DIST 0 1 5 /end AXIS_DESCR
 /begin AXIS_DESCR FIX_AXIS NO_INPUT_QUANTITY eBool_true_false_S6_S3 2 0 1 FIX_AXIS_PAR_DIST 0 1 2 /end AXIS_DESCR
/end CHARACTERISTIC
/begin CHARACTERISTIC sK0Sollw.TAB_WNDOSCHALT_K0 "Sollwertoffset waehrend Schaltungen" MAP 0x215CFA Matrix.ui8_S6_S3 255 UMRM_U_MIN_1_1_0_S6_S3 0 255
 /begin AXIS_DESCR FIX_AXIS NO_INPUT_QUANTITY eSchaltungsIdx_S6_S3 5 0 4 FIX_AXIS_PAR_DIST 0 1 5 /end AXIS_DESCR
 /begin AXIS_DESCR FIX_AXIS NO_INPUT_QUANTITY eBool_true_false_S6_S3 2 0 1 FIX_AXIS_PAR_DIST 0 1 2 /end AXIS_DESCR
/end CHARACTERISTIC
/begin CHARACTERISTIC sK0Sollw.TAB_T_WNDOSCHALTAUF_K0 "Aufregelzeitkonstante des Schaltsollwertoffset" MAP 0x215CE6 Matrix.ui8_S6_S3 2.49 UMRM___1_100_0_S6_S3 0.01 2.5
 /begin AXIS_DESCR FIX_AXIS NO_INPUT_QUANTITY eSchaltungsIdx_S6_S3 5 0 4 FIX_AXIS_PAR_DIST 0 1 5 /end AXIS_DESCR
 /begin AXIS_DESCR FIX_AXIS NO_INPUT_QUANTITY eBool_true_false_S6_S3 2 0 1 FIX_AXIS_PAR_DIST 0 1 2 /end AXIS_DESCR
/end CHARACTERISTIC
/begin CHARACTERISTIC sK0Sollw.KL_F_WNDSTD_CGETR_K0 "Temperatur Faktor auf Standardsollwert" CURVE 0x215C44 Curve.fl32.fl32_S6_S3 2E+037 UMRM___1_1_0_S6_S3 -1E+037 1E+037 FORMAT "%5.3"
 /begin AXIS_DESCR STD_AXIS NO_INPUT_QUANTITY UMRM_GRADC__1_1_0_S6_S3 6 -270 5000 DEPOSIT ABSOLUTE MONOTONY STRICT_INCREASE FORMAT "%5.3" /end AXIS_DESCR
/end CHARACTERISTIC
/begin CHARACTERISTIC sK0Sollw.KL_F_WND_K0 "Faktor zur Reduzierung des K0 Schlupfs bei heissen Belaegen" CURVE 0x215C74 Curve.fl32.fl32_S6_S3 2E+037 UMRM___1_1_0_S6_S3 -1E+037 1E+037 FORMAT "%5.3"
 /begin AXIS_DESCR STD_AXIS sK0TempM.c_belag_k0_alt UMRM_GRADC__1_1_0_S6_S3 2 -270 5000 DEPOSIT ABSOLUTE MONOTONY STRICT_INCREASE FORMAT "%5.3" /end AXIS_DESCR
/end CHARACTERISTIC
/begin CHARACTERISTIC sK0Sollw.KL_T_WNDOSCHALTAB_K0_HSS "Filterzeitkonstante zum Abfiltern des Schaltoffsets waehrend Schaltungsende bei HSS" CURVE 0x215C86 Curve.si16.ui8_S6_S3 2.49 UMRM___1_100_0_S6_S3 0.01 2.5
 /begin AXIS_DESCR STD_AXIS NO_INPUT_QUANTITY UMRM_U_MINSEC_1_1_0_S6_S3 4 -32768 32767 DEPOSIT ABSOLUTE MONOTONY STRICT_INCREASE /end AXIS_DESCR
/end CHARACTERISTIC
/begin CHARACTERISTIC sK0Sollw.KL_T_WNDOSCHALTAB_K0_RSZ "Filterzeitkonstante zum Abfiltern des Schaltoffsets waehrend Schaltungsende bei RSZ" CURVE 0x215C92 Curve.si16.ui8_S6_S3 2.49 UMRM___1_100_0_S6_S3 0.01 2.5
 /begin AXIS_DESCR STD_AXIS NO_INPUT_QUANTITY UMRM_U_MINSEC_1_1_0_S6_S3 4 -32768 32767 DEPOSIT ABSOLUTE MONOTONY STRICT_INCREASE /end AXIS_DESCR
/end CHARACTERISTIC
/begin CHARACTERISTIC G_R.KF_WND_STD[K0] "" MAP 0x215D04 Map.si16.si16.ui8_S6_S3 255 UMRM_U_MIN_1_1_0_S6_S3 0 255
 /begin AXIS_DESCR STD_AXIS sK0Signa.n_em_sync_k0 UMRM_U_MIN_1_1_0_S6_S3 6 -32768 32767 DEPOSIT ABSOLUTE MONOTONY STRICT_INCREASE /end AXIS_DESCR
 /begin AXIS_DESCR STD_AXIS sK0Signa.m_vmist_sync_k0 UMRM_NM__1_1_0_S6_S3 6 -32768 32767 DEPOSIT ABSOLUTE MONOTONY STRICT_INCREASE /end AXIS_DESCR
/end CHARACTERISTIC
/begin CHARACTERISTIC G_R.KF_WND_STD[K0ASD] "" MAP 0x215D40 Map.si16.si16.ui8_S6_S3 255 UMRM_U_MIN_1_1_0_S6_S3 0 255
 /begin AXIS_DESCR STD_AXIS sK0Signa.n_em_sync_k0 UMRM_U_MIN_1_1_0_S6_S3 6 -32768 32767 DEPOSIT ABSOLUTE MONOTONY STRICT_INCREASE /end AXIS_DESCR
 /begin AXIS_DESCR STD_AXIS sK0Signa.m_vmist_sync_k0 UMRM_NM__1_1_0_S6_S3 6 -32768 32767 DEPOSIT ABSOLUTE MONOTONY STRICT_INCREASE /end AXIS_DESCR
/end CHARACTERISTIC
/begin CHARACTERISTIC G_PN.KF_WND_STD[K0] "" MAP 0x215D7C Map.si16.si16.ui8_S6_S3 255 UMRM_U_MIN_1_1_0_S6_S3 0 255
 /begin AXIS_DESCR STD_AXIS sK0Signa.n_em_sync_k0 UMRM_U_MIN_1_1_0_S6_S3 6 -32768 32767 DEPOSIT ABSOLUTE MONOTONY STRICT_INCREASE /end AXIS_DESCR
 /begin AXIS_DESCR STD_AXIS sK0Signa.m_vmist_sync_k0 UMRM_NM__1_1_0_S6_S3 6 -32768 32767 DEPOSIT ABSOLUTE MONOTONY STRICT_INCREASE /end AXIS_DESCR
/end CHARACTERISTIC
/begin CHARACTERISTIC G_PN.KF_WND_STD[K0ASD] "" MAP 0x215DB8 Map.si16.si16.ui8_S6_S3 255 UMRM_U_MIN_1_1_0_S6_S3 0 255
 /begin AXIS_DESCR STD_AXIS sK0Signa.n_em_sync_k0 UMRM_U_MIN_1_1_0_S6_S3 6 -32768 32767 DEPOSIT ABSOLUTE MONOTONY STRICT_INCREASE /end AXIS_DESCR
 /begin AXIS_DESCR STD_AXIS sK0Signa.m_vmist_sync_k0 UMRM_NM__1_1_0_S6_S3 6 -32768 32767 DEPOSIT ABSOLUTE MONOTONY STRICT_INCREASE /end AXIS_DESCR
/end CHARACTERISTIC
/begin CHARACTERISTIC G_1.KF_WND_STD[K0] "" MAP 0x215DF4 Map.si16.si16.ui8_S6_S3 255 UMRM_U_MIN_1_1_0_S6_S3 0 255
 /begin AXIS_DESCR STD_AXIS sK0Signa.n_em_sync_k0 UMRM_U_MIN_1_1_0_S6_S3 6 -32768 32767 DEPOSIT ABSOLUTE MONOTONY STRICT_INCREASE /end AXIS_DESCR
 /begin AXIS_DESCR STD_AXIS sK0Signa.m_vmist_sync_k0 UMRM_NM__1_1_0_S6_S3 6 -32768 32767 DEPOSIT ABSOLUTE MONOTONY STRICT_INCREASE /end AXIS_DESCR
/end CHARACTERISTIC
/begin CHARACTERISTIC G_1.KF_WND_STD[K0ASD] "" MAP 0x215E30 Map.si16.si16.ui8_S6_S3 255 UMRM_U_MIN_1_1_0_S6_S3 0 255
 /begin AXIS_DESCR STD_AXIS sK0Signa.n_em_sync_k0 UMRM_U_MIN_1_1_0_S6_S3 6 -32768 32767 DEPOSIT ABSOLUTE MONOTONY STRICT_INCREASE /end AXIS_DESCR
 /begin AXIS_DESCR STD_AXIS sK0Signa.m_vmist_sync_k0 UMRM_NM__1_1_0_S6_S3 6 -32768 32767 DEPOSIT ABSOLUTE MONOTONY STRICT_INCREASE /end AXIS_DESCR
/end CHARACTERISTIC
/begin CHARACTERISTIC G_2.KF_WND_STD[K0] "" MAP 0x215E6C Map.si16.si16.ui8_S6_S3 255 UMRM_U_MIN_1_1_0_S6_S3 0 255
 /begin AXIS_DESCR STD_AXIS sK0Signa.n_em_sync_k0 UMRM_U_MIN_1_1_0_S6_S3 6 -32768 32767 DEPOSIT ABSOLUTE MONOTONY STRICT_INCREASE /end AXIS_DESCR
 /begin AXIS_DESCR STD_AXIS sK0Signa.m_vmist_sync_k0 UMRM_NM__1_1_0_S6_S3 6 -32768 32767 DEPOSIT ABSOLUTE MONOTONY STRICT_INCREASE /end AXIS_DESCR
/end CHARACTERISTIC
/begin CHARACTERISTIC G_2.KF_WND_STD[K0ASD] "" MAP 0x215EA8 Map.si16.si16.ui8_S6_S3 255 UMRM_U_MIN_1_1_0_S6_S3 0 255
 /begin AXIS_DESCR STD_AXIS sK0Signa.n_em_sync_k0 UMRM_U_MIN_1_1_0_S6_S3 6 -32768 32767 DEPOSIT ABSOLUTE MONOTONY STRICT_INCREASE /end AXIS_DESCR
 /begin AXIS_DESCR STD_AXIS sK0Signa.m_vmist_sync_k0 UMRM_NM__1_1_0_S6_S3 6 -32768 32767 DEPOSIT ABSOLUTE MONOTONY STRICT_INCREASE /end AXIS_DESCR
/end CHARACTERISTIC
/begin CHARACTERISTIC G_3.KF_WND_STD[K0] "" MAP 0x215EE4 Map.si16.si16.ui8_S6_S3 255 UMRM_U_MIN_1_1_0_S6_S3 0 255
 /begin AXIS_DESCR STD_AXIS sK0Signa.n_em_sync_k0 UMRM_U_MIN_1_1_0_S6_S3 6 -32768 32767 DEPOSIT ABSOLUTE MONOTONY STRICT_INCREASE /end AXIS_DESCR
 /begin AXIS_DESCR STD_AXIS sK0Signa.m_vmist_sync_k0 UMRM_NM__1_1_0_S6_S3 6 -32768 32767 DEPOSIT ABSOLUTE MONOTONY STRICT_INCREASE /end AXIS_DESCR
/end CHARACTERISTIC
/begin CHARACTERISTIC G_3.KF_WND_STD[K0ASD] "" MAP 0x215F20 Map.si16.si16.ui8_S6_S3 255 UMRM_U_MIN_1_1_0_S6_S3 0 255
 /begin AXIS_DESCR STD_AXIS sK0Signa.n_em_sync_k0 UMRM_U_MIN_1_1_0_S6_S3 6 -32768 32767 DEPOSIT ABSOLUTE MONOTONY STRICT_INCREASE /end AXIS_DESCR
 /begin AXIS_DESCR STD_AXIS sK0Signa.m_vmist_sync_k0 UMRM_NM__1_1_0_S6_S3 6 -32768 32767 DEPOSIT ABSOLUTE MONOTONY STRICT_INCREASE /end AXIS_DESCR
/end CHARACTERISTIC
/begin CHARACTERISTIC G_4.KF_WND_STD[K0] "" MAP 0x215F5C Map.si16.si16.ui8_S6_S3 255 UMRM_U_MIN_1_1_0_S6_S3 0 255
 /begin AXIS_DESCR STD_AXIS sK0Signa.n_em_sync_k0 UMRM_U_MIN_1_1_0_S6_S3 6 -32768 32767 DEPOSIT ABSOLUTE MONOTONY STRICT_INCREASE /end AXIS_DESCR
 /begin AXIS_DESCR STD_AXIS sK0Signa.m_vmist_sync_k0 UMRM_NM__1_1_0_S6_S3 6 -32768 32767 DEPOSIT ABSOLUTE MONOTONY STRICT_INCREASE /end AXIS_DESCR
/end CHARACTERISTIC
/begin CHARACTERISTIC G_4.KF_WND_STD[K0ASD] "" MAP 0x215F98 Map.si16.si16.ui8_S6_S3 255 UMRM_U_MIN_1_1_0_S6_S3 0 255
 /begin AXIS_DESCR STD_AXIS sK0Signa.n_em_sync_k0 UMRM_U_MIN_1_1_0_S6_S3 6 -32768 32767 DEPOSIT ABSOLUTE MONOTONY STRICT_INCREASE /end AXIS_DESCR
 /begin AXIS_DESCR STD_AXIS sK0Signa.m_vmist_sync_k0 UMRM_NM__1_1_0_S6_S3 6 -32768 32767 DEPOSIT ABSOLUTE MONOTONY STRICT_INCREASE /end AXIS_DESCR
/end CHARACTERISTIC
/begin CHARACTERISTIC G_5.KF_WND_STD[K0] "" MAP 0x215FD4 Map.si16.si16.ui8_S6_S3 255 UMRM_U_MIN_1_1_0_S6_S3 0 255
 /begin AXIS_DESCR STD_AXIS sK0Signa.n_em_sync_k0 UMRM_U_MIN_1_1_0_S6_S3 6 -32768 32767 DEPOSIT ABSOLUTE MONOTONY STRICT_INCREASE /end AXIS_DESCR
 /begin AXIS_DESCR STD_AXIS sK0Signa.m_vmist_sync_k0 UMRM_NM__1_1_0_S6_S3 6 -32768 32767 DEPOSIT ABSOLUTE MONOTONY STRICT_INCREASE /end AXIS_DESCR
/end CHARACTERISTIC
/begin CHARACTERISTIC G_5.KF_WND_STD[K0ASD] "" MAP 0x216010 Map.si16.si16.ui8_S6_S3 255 UMRM_U_MIN_1_1_0_S6_S3 0 255
 /begin AXIS_DESCR STD_AXIS sK0Signa.n_em_sync_k0 UMRM_U_MIN_1_1_0_S6_S3 6 -32768 32767 DEPOSIT ABSOLUTE MONOTONY STRICT_INCREASE /end AXIS_DESCR
 /begin AXIS_DESCR STD_AXIS sK0Signa.m_vmist_sync_k0 UMRM_NM__1_1_0_S6_S3 6 -32768 32767 DEPOSIT ABSOLUTE MONOTONY STRICT_INCREASE /end AXIS_DESCR
/end CHARACTERISTIC
/begin CHARACTERISTIC G_6.KF_WND_STD[K0] "" MAP 0x21604C Map.si16.si16.ui8_S6_S3 255 UMRM_U_MIN_1_1_0_S6_S3 0 255
 /begin AXIS_DESCR STD_AXIS sK0Signa.n_em_sync_k0 UMRM_U_MIN_1_1_0_S6_S3 6 -32768 32767 DEPOSIT ABSOLUTE MONOTONY STRICT_INCREASE /end AXIS_DESCR
 /begin AXIS_DESCR STD_AXIS sK0Signa.m_vmist_sync_k0 UMRM_NM__1_1_0_S6_S3 6 -32768 32767 DEPOSIT ABSOLUTE MONOTONY STRICT_INCREASE /end AXIS_DESCR
/end CHARACTERISTIC
/begin CHARACTERISTIC G_6.KF_WND_STD[K0ASD] "" MAP 0x216088 Map.si16.si16.ui8_S6_S3 255 UMRM_U_MIN_1_1_0_S6_S3 0 255
 /begin AXIS_DESCR STD_AXIS sK0Signa.n_em_sync_k0 UMRM_U_MIN_1_1_0_S6_S3 6 -32768 32767 DEPOSIT ABSOLUTE MONOTONY STRICT_INCREASE /end AXIS_DESCR
 /begin AXIS_DESCR STD_AXIS sK0Signa.m_vmist_sync_k0 UMRM_NM__1_1_0_S6_S3 6 -32768 32767 DEPOSIT ABSOLUTE MONOTONY STRICT_INCREASE /end AXIS_DESCR
/end CHARACTERISTIC
/begin CHARACTERISTIC G_7.KF_WND_STD[K0] "" MAP 0x2160C4 Map.si16.si16.ui8_S6_S3 255 UMRM_U_MIN_1_1_0_S6_S3 0 255
 /begin AXIS_DESCR STD_AXIS sK0Signa.n_em_sync_k0 UMRM_U_MIN_1_1_0_S6_S3 6 -32768 32767 DEPOSIT ABSOLUTE MONOTONY STRICT_INCREASE /end AXIS_DESCR
 /begin AXIS_DESCR STD_AXIS sK0Signa.m_vmist_sync_k0 UMRM_NM__1_1_0_S6_S3 6 -32768 32767 DEPOSIT ABSOLUTE MONOTONY STRICT_INCREASE /end AXIS_DESCR
/end CHARACTERISTIC
/begin CHARACTERISTIC G_7.KF_WND_STD[K0ASD] "" MAP 0x216100 Map.si16.si16.ui8_S6_S3 255 UMRM_U_MIN_1_1_0_S6_S3 0 255
 /begin AXIS_DESCR STD_AXIS sK0Signa.n_em_sync_k0 UMRM_U_MIN_1_1_0_S6_S3 6 -32768 32767 DEPOSIT ABSOLUTE MONOTONY STRICT_INCREASE /end AXIS_DESCR
 /begin AXIS_DESCR STD_AXIS sK0Signa.m_vmist_sync_k0 UMRM_NM__1_1_0_S6_S3 6 -32768 32767 DEPOSIT ABSOLUTE MONOTONY STRICT_INCREASE /end AXIS_DESCR
/end CHARACTERISTIC
/begin CHARACTERISTIC G_8.KF_WND_STD[K0] "" MAP 0x21613C Map.si16.si16.ui8_S6_S3 255 UMRM_U_MIN_1_1_0_S6_S3 0 255
 /begin AXIS_DESCR STD_AXIS sK0Signa.n_em_sync_k0 UMRM_U_MIN_1_1_0_S6_S3 6 -32768 32767 DEPOSIT ABSOLUTE MONOTONY STRICT_INCREASE /end AXIS_DESCR
 /begin AXIS_DESCR STD_AXIS sK0Signa.m_vmist_sync_k0 UMRM_NM__1_1_0_S6_S3 6 -32768 32767 DEPOSIT ABSOLUTE MONOTONY STRICT_INCREASE /end AXIS_DESCR
/end CHARACTERISTIC
/begin CHARACTERISTIC G_8.KF_WND_STD[K0ASD] "" MAP 0x216178 Map.si16.si16.ui8_S6_S3 255 UMRM_U_MIN_1_1_0_S6_S3 0 255
 /begin AXIS_DESCR STD_AXIS sK0Signa.n_em_sync_k0 UMRM_U_MIN_1_1_0_S6_S3 6 -32768 32767 DEPOSIT ABSOLUTE MONOTONY STRICT_INCREASE /end AXIS_DESCR
 /begin AXIS_DESCR STD_AXIS sK0Signa.m_vmist_sync_k0 UMRM_NM__1_1_0_S6_S3 6 -32768 32767 DEPOSIT ABSOLUTE MONOTONY STRICT_INCREASE /end AXIS_DESCR
/end CHARACTERISTIC
/begin CHARACTERISTIC sK0Sollw.KF_WND_STD_PN "" MAP 0x215C9E Map.si16.si16.ui8_S6_S3 255 UMRM_U_MIN_1_1_0_S6_S3 0 255
 /begin AXIS_DESCR STD_AXIS sK0Signa.n_em_sync_k0 UMRM_U_MIN_1_1_0_S6_S3 6 -32768 32767 DEPOSIT ABSOLUTE MONOTONY STRICT_INCREASE /end AXIS_DESCR
 /begin AXIS_DESCR STD_AXIS sK0Signa.m_vmist_sync_k0 UMRM_NM__1_1_0_S6_S3 6 -32768 32767 DEPOSIT ABSOLUTE MONOTONY STRICT_INCREASE /end AXIS_DESCR
/end CHARACTERISTIC
/begin MEASUREMENT sIepLeckage.q_leckage_fzp_iep "Leckage der FZP" FLOAT32_IEEE UMRM_LITER_MIN_1_1_0_S6_S3 1 100 0 20 FORMAT "%5.3" ECU_ADDRESS 0xFFF85724 /end MEASUREMENT
/begin MEASUREMENT sIepLeckage.q_leckage_hsg_iep "Leckage der EGS" FLOAT32_IEEE UMRM_LITER_MIN_1_1_0_S6_S3 1 100 0 20 FORMAT "%5.3" ECU_ADDRESS 0xFFF8572C /end MEASUREMENT
/begin MEASUREMENT sIepLeckage.q_leckage_ges_iep "Gesamtleckage" FLOAT32_IEEE UMRM_LITER_MIN_1_1_0_S6_S3 1 100 0 20 FORMAT "%5.3" ECU_ADDRESS 0xFFF85728 /end MEASUREMENT
/begin MEASUREMENT sIepLeckage.q_bedarf_iep "Oelvolumenbedarf" FLOAT32_IEEE UMRM_LITER_MIN_1_1_0_S6_S3 1 100 0 30 FORMAT "%5.3" ECU_ADDRESS 0xFFF85720 /end MEASUREMENT
/begin MEASUREMENT sIepLeckage.q_ueberschuss_iep "Ueberschuss auf Gesamtleckage" FLOAT32_IEEE UMRM_LITER_MIN_1_1_0_S6_S3 1 100 0 30 FORMAT "%5.3" ECU_ADDRESS 0xFFF85730 /end MEASUREMENT
/begin MEASUREMENT sIepLeckage.ns_mot_an_iep "Berechnete Einschaltschwelle" UWORD UMRM_U_MIN_1_1_0_S6_S3 1 100 0 8160 ECU_ADDRESS 0xFFF85734 /end MEASUREMENT
/begin MEASUREMENT sIepLeckage.ns_mot_an_korr_roh_iep "Korrigierte, berechnete Einschaltschwelle" SWORD UMRM_U_MIN_1_1_0_S6_S3 1 100 -8160 8160 ECU_ADDRESS 0xFFF85738 /end MEASUREMENT
/begin MEASUREMENT sIepLeckage.ns_mot_an_korr_iep "Korrigierte, gefilterte berechnete Einschaltschwelle" SWORD UMRM_U_MIN_1_1_0_S6_S3 1 100 -8160 8160 ECU_ADDRESS 0xFFF85736 /end MEASUREMENT
/begin MEASUREMENT sIepLeckage.ns_mot_hys_iep "Motordrehzahlschwelle korrigiert zum Ausschalten der elektrischen Zusatzpumpe" SWORD UMRM_U_MIN_1_1_0_S6_S3 1 100 -8160 8160 ECU_ADDRESS 0xFFF8573A /end MEASUREMENT
/begin MEASUREMENT sIepSigna.ng_mot_iep "Drehzahlgradient von n_mot" SWORD UMRM_U_MINSEC_1_1_0_S6_S3 1 100 -10000 10000 ECU_ADDRESS 0xFFF85748 /end MEASUREMENT
/begin MEASUREMENT sIepSigna.f_schaltung_iep "Flag zur Anzeige, ob eine Schaltung ablaeuft oder Gangeinlegen aktiv ist" UBYTE eBool_true_false_S6_S3 1 100 0 1 ECU_ADDRESS 0xFFF85751 /end MEASUREMENT
/begin MEASUREMENT sIepSigna.neigung_gef_iep "Gefiltertes Neigungssignal des Fahrzeugs in Grad" UBYTE UMRM_GRAD__1_3_M42_S6_S3 1 100 -42 42 ECU_ADDRESS 0xFFF85754 /end MEASUREMENT
/begin MEASUREMENT sIepSigna.f_notlauf_aktiv_iep "Anzeige ob ein elektrischer bzw. mechanischer Notlauf aktiv ist" UBYTE eBool_true_false_S6_S3 1 100 0 1 ECU_ADDRESS 0xFFF85750 /end MEASUREMENT
/begin MEASUREMENT sIepSigna.f_aufwaerm_erlaubt_iep "Aufwaermfunktion ist erlaubt, wenn entsprechende IEP verbaut ist" UWORD UMRM___1_1_0_S6_S3 1 100 0 65535 ECU_ADDRESS 0xFFF85744 /end MEASUREMENT
/begin MEASUREMENT sIepSigna.f_ansteuerung_iep "Ansteuerung der IEP ist moeglich, da das Fahrzeug in Betriebsbereitschaft ist" UBYTE eBool_true_false_S6_S3 1 100 0 1 ECU_ADDRESS 0xFFF8574C /end MEASUREMENT
/begin MEASUREMENT sIepSigna.f_efahren_aktiv_iep "Flag zur Anzeige, ob das elektrisches Fahren aktiv ist" UBYTE eBool_true_false_S6_S3 1 100 0 1 ECU_ADDRESS 0xFFF8574E /end MEASUREMENT
/begin MEASUREMENT sIepSigna.f_has_aktiv_iep "Anzeige das ein HAS Ablauf aktiv ist und die K0 befuellt werden soll" UBYTE eBool_true_false_S6_S3 1 100 0 1 ECU_ADDRESS 0xFFF8574F /end MEASUREMENT
/begin MEASUREMENT sIepSigna.f_shutdown_iep "Anforderung an die IEP in den Zustand AUS ohne Nachlauf zu wechseln" UBYTE eBool_true_false_S6_S3 1 100 0 1 ECU_ADDRESS 0xFFF85752 /end MEASUREMENT
/begin MEASUREMENT sIepSigna.fahr_bereit_iep "Fahrbereitschaft" UBYTE UMRM___1_1_0_S6_S3 1 100 0 255 ECU_ADDRESS 0xFFF85753 /end MEASUREMENT
/begin MEASUREMENT sIepSigna.m_getr_iep "Eingangsmoment zu Berechnung des Leistungspunkts" SWORD UMRM_NM__1_1_0_S6_S3 1 100 -1024 1024 ECU_ADDRESS 0xFFF85746 /end MEASUREMENT
/begin MEASUREMENT sIepSigna.soll_ext_has_iep "Sollwertvorgabe der IEP durch die HAS" UBYTE eIepSollExt_S6_S3 1 100 0 4 ECU_ADDRESS 0xFFF85757 /end MEASUREMENT
/begin MEASUREMENT sIepSigna.soll_ext_sab_iep "Sollwertvorgabe der IEP durch die SAB" UBYTE eIepSollExt_S6_S3 1 100 0 4 ECU_ADDRESS 0xFFF85758 /end MEASUREMENT
/begin MEASUREMENT sIepSigna.soll_ext_abk_iep "Sollwertvorgabe der IEP durch die ABK" UBYTE eIepSollExt_S6_S3 1 100 0 4 ECU_ADDRESS 0xFFF85756 /end MEASUREMENT
/begin MEASUREMENT sIepSigna.soll_ext_tes_iep "Sollwertvorgabe der IEP durch den Tester" UBYTE eIepSignaTes_S6_S3 1 100 0 3 ECU_ADDRESS 0xFFF85759 /end MEASUREMENT
/begin MEASUREMENT sIepSigna.pumpenist_iep "Statusmeldung der elektrischen Pumpe" UBYTE eIepStatus_S6_S3 1 100 0 4 ECU_ADDRESS 0xFFF85755 /end MEASUREMENT
/begin MEASUREMENT sIepSigna.v_fahrzeug_iep "Fahrzeuggeschwindigkeit" UWORD UMRM_KM_H_1_1_0_S6_S3 1 100 0 400 ECU_ADDRESS 0xFFF8574A /end MEASUREMENT
/begin MEASUREMENT sIepSigna.a_fahrzeugquer_iep "Querbeschleunigung des Fahrzeugs" FLOAT32_IEEE UMRM_M_S2_1_1_0_S6_S3 1 100 -100 100 FORMAT "%5.3" ECU_ADDRESS 0xFFF85740 /end MEASUREMENT
/begin MEASUREMENT sIepSignachber.f_pumpe_angefordert_iep "Abfrage ob die IEP- Pumpe angefordert wird (iep_ist groesser 1)" UBYTE UMRM___1_1_0_S6_S3 1 100 0 1 BIT_MASK 0x1 ECU_ADDRESS 0xFFF858DE /end MEASUREMENT
/begin MEASUREMENT sIepSignachber.f_elektrische_pumpe_lauft_iep "Abfrage ob die IEP- Pumpe laeuft wird (iep_status groesser 1)" UBYTE UMRM___1_1_0_S6_S3 1 100 0 1 BIT_MASK 0x1 ECU_ADDRESS 0xFFF858DC /end MEASUREMENT
/begin MEASUREMENT sIepSignachber.status_iep "Tatsaechlicher Status der IEP" UBYTE eIepStatus_S6_S3 1 100 0 4 ECU_ADDRESS 0xFFF858E0 /end MEASUREMENT
/begin MEASUREMENT sIepSignachber.fehler_iep "Fehler der IEP" UBYTE eBool_true_false_S6_S3 1 100 0 1 ECU_ADDRESS 0xFFF858DF /end MEASUREMENT
/begin MEASUREMENT sIepSignachber.t_verz_ist_iep "Verzoegerungszeit fuer den Ist-Wert der IEP" UWORD UMRM_MSEC__10_1_0_S6_S3 1 100 0 655350 ECU_ADDRESS 0xFFF858DA /end MEASUREMENT
/begin MEASUREMENT sIepSignachber.t_last_iep_activated "Letzte Einschaltdauer der IEP" UWORD UMRM_SEC__1_1_0_S6_S3 1 100 0 65535 ECU_ADDRESS 0xFFF858D8 /end MEASUREMENT
/begin MEASUREMENT sIepSignachber.f_erststart_iep "Flag zur Anzeige, ob ein Erststart vorliegt" UBYTE eBool_true_false_S6_S3 1 100 0 1 ECU_ADDRESS 0xFFF858DD /end MEASUREMENT
/begin MEASUREMENT sIepSignachber.req_iep "Bitcodierte Anforderung an die IEP: Leistungspunkte und Sonderfunktionen" UWORD UMRM___1_1_0_S6_S3 1 100 0 65535 ECU_ADDRESS 0xFFF858D6 /end MEASUREMENT
/begin MEASUREMENT sIepSollext.soll_ext_iep "Berechneter Sollwert der IEP" UBYTE eIepSollExt_S6_S3 1 100 0 4 ECU_ADDRESS 0xFFF85A1F /end MEASUREMENT
/begin MEASUREMENT sIepSollext.f_ext_iep "Aktivierungsflag fuer die externen Sollvorgaben" UBYTE eBool_true_false_S6_S3 1 100 0 1 ECU_ADDRESS 0xFFF85A1C /end MEASUREMENT
/begin MEASUREMENT sIepSollext.f_ext_has_iep "Aktivierungsflag der HAS, gebildet aus soll_ext_has_iep" UBYTE eBool_true_false_S6_S3 1 100 0 1 ECU_ADDRESS 0xFFF85A1B /end MEASUREMENT
/begin MEASUREMENT sIepSollext.f_ext_tes_iep "Aktivierungsflag des Testers, gebildet aus soll_ext_tes_iep" UBYTE eBool_true_false_S6_S3 1 100 0 1 ECU_ADDRESS 0xFFF85A1E /end MEASUREMENT
/begin MEASUREMENT sIepSollext.f_ext_sab_iep "Aktivierungsflag der SAB, gebildet aus soll_ext_sab_iep" UBYTE eBool_true_false_S6_S3 1 100 0 1 ECU_ADDRESS 0xFFF85A1D /end MEASUREMENT
/begin MEASUREMENT sIepSollext.f_ext_abk_iep "Aktivierungsflag der SAB, gebildet aus soll_ext_sab_iep" UBYTE eBool_true_false_S6_S3 1 100 0 1 ECU_ADDRESS 0xFFF85A1A /end MEASUREMENT
/begin MEASUREMENT sIepSoll.soll_iep "Berechneter Sollwert der IEP" UBYTE eIepSoll_S6_S3 1 100 0 3 ECU_ADDRESS 0xFFF85765 /end MEASUREMENT
/begin MEASUREMENT sIepSonderfkt.bed_in_fehler_iep "Anzeige ob in den Fehlerzustand ueber die Ersatzmassnahme eingestiegen wurde" UBYTE eBool_true_false_S6_S3 1 100 0 1 ECU_ADDRESS 0xFFF858F6 /end MEASUREMENT
/begin MEASUREMENT sIepSonderfkt.f_psys_max_iep "Flag zur Anzeige, ob der Systemdruck zum Einschalten der Pumpe niedrig genug ist" UBYTE eBool_true_false_S6_S3 1 100 0 1 ECU_ADDRESS 0xFFF85904 /end MEASUREMENT
/begin MEASUREMENT sIepSonderfkt.f_cgetr_aus_iep "Flag zur Anzeige, ob die Getriebetemperatur ausserhalb der Einschalttemperatur der Pumpe ist" UBYTE eBool_true_false_S6_S3 1 100 0 1 ECU_ADDRESS 0xFFF858F7 /end MEASUREMENT
/begin MEASUREMENT sIepSonderfkt.f_cgetr_fehler_iep "Flag zur Anzeige, ob die Getriebetemperatur ausserhalb der Einschalttemperatur der Pumpe ist" UBYTE eBool_true_false_S6_S3 1 100 0 1 ECU_ADDRESS 0xFFF858F8 /end MEASUREMENT
/begin MEASUREMENT sIepSonderfkt.f_gefaelle_erfuellt_iep "Flag das Luft im Ansaugruessel auf Grund des Gefaelles sein koennte" UBYTE eBool_true_false_S6_S3 1 100 0 1 ECU_ADDRESS 0xFFF858FF /end MEASUREMENT
/begin MEASUREMENT sIepSonderfkt.f_nab_erfuellt_iep "Flag das Luft im Ansaugruessel auf Grund der Geschwindigkeit sein koennte und die IEP angeschaltet wird" UBYTE eBool_true_false_S6_S3 1 100 0 1 ECU_ADDRESS 0xFFF85902 /end MEASUREMENT
/begin MEASUREMENT sIepSonderfkt.f_nab_gegeben_iep "Flag das Luft im Ansaugruessel auf Grund der Geschwindigkeit sein koennte." UBYTE eBool_true_false_S6_S3 1 100 0 1 ECU_ADDRESS 0xFFF85903 /end MEASUREMENT
/begin MEASUREMENT sIepSonderfkt.f_schraeg_fehler_iep "IEP im Fehler da wegen Schraeglage des Fahrzeugs der Ansaugruessel nicht mehr im Oel liegt" UBYTE eBool_true_false_S6_S3 1 100 0 1 ECU_ADDRESS 0xFFF85907 /end MEASUREMENT
/begin MEASUREMENT sIepSonderfkt.f_schraeg_erfuellt_iep "Luft im Ansaugruessel der IEP da Fahrzeug in Schraeglage war" UBYTE eBool_true_false_S6_S3 1 100 0 1 ECU_ADDRESS 0xFFF85906 /end MEASUREMENT
/begin MEASUREMENT sIepSonderfkt.f_luft_erfuellt_iep "Flag das Luft im Ansaugruessel sein koennte" UBYTE eBool_true_false_S6_S3 1 100 0 1 ECU_ADDRESS 0xFFF85900 /end MEASUREMENT
/begin MEASUREMENT sIepSonderfkt.f_psys_stuetzen_iep "Flag zur Anzeige, das die IEP den Systemdruck stuetzt" UBYTE eBool_true_false_S6_S3 1 100 0 1 ECU_ADDRESS 0xFFF85905 /end MEASUREMENT
/begin MEASUREMENT sIepSonderfkt.f_einmal_aus_iep "Flag zur Anzeige, wenn die IEP in den Fehler geht, dass sie einmal bei der Berechnung durch AUS gegangen ist" UBYTE eBool_true_false_S6_S3 1 100 0 1 ECU_ADDRESS 0xFFF858FE /end MEASUREMENT
/begin MEASUREMENT sIepSonderfkt.f_wash_fkt_aktiv_iep "Waschstrassenfunktion ist aktiv und Timer zum Ausschalten der IEP ist abgelaufen" UBYTE eBool_true_false_S6_S3 1 100 0 1 ECU_ADDRESS 0xFFF85908 /end MEASUREMENT
/begin MEASUREMENT sIepSonderfkt.t_gefaelle_iep "Timerzeit Gefaelle" UWORD UMRM_MSEC__10_1_0_S6_S3 1 100 0 655350 ECU_ADDRESS 0xFFF858E8 /end MEASUREMENT
/begin MEASUREMENT sIepSonderfkt.t_nab_iep "Timerzeit N_AB" UWORD UMRM_MSEC__10_1_0_S6_S3 1 100 0 655350 ECU_ADDRESS 0xFFF858F0 /end MEASUREMENT
/begin MEASUREMENT sIepSonderfkt.t_luft_aktiv_iep "Timerzeit Luft aktiv" UWORD UMRM_MSEC__10_1_0_S6_S3 1 100 0 655350 ECU_ADDRESS 0xFFF858EA /end MEASUREMENT
/begin MEASUREMENT sIepSonderfkt.t_luft_sperr_iep "Timerzeit Luft Sperr" UWORD UMRM_MSEC__10_1_0_S6_S3 1 100 0 655350 ECU_ADDRESS 0xFFF858EC /end MEASUREMENT
/begin MEASUREMENT sIepSonderfkt.t_psys_pss_iep "Timerzeit p_stuetzen" UWORD UMRM_MSEC__10_1_0_S6_S3 1 100 0 655350 ECU_ADDRESS 0xFFF858F2 /end MEASUREMENT
/begin MEASUREMENT sIepSonderfkt.t_wash_fkt_iep "Timerzeit Waschstrassenfunktion" UWORD UMRM_MSEC__10_1_0_S6_S3 1 100 0 655350 ECU_ADDRESS 0xFFF858F4 /end MEASUREMENT
/begin MEASUREMENT sIepSonderfkt.t_aufwaerm_iep "Aktivzeit der Aufwaermfkt" UWORD UMRM_MSEC__10_1_0_S6_S3 1 100 0 655350 ECU_ADDRESS 0xFFF858E4 /end MEASUREMENT
/begin MEASUREMENT sIepSonderfkt.t_maxcgetrtief_notlauf_iep "Maxzeit fuer Tieftemperaturansteuerung" UWORD UMRM_MSEC__10_1_0_S6_S3 1 100 0 655350 ECU_ADDRESS 0xFFF858EE /end MEASUREMENT
/begin MEASUREMENT sIepSonderfkt.f_cgtrtief_notlauf_iep "Anzeige, dass die IEP auch unter Null Grad angesteuert werden darf" UBYTE eBool_true_false_S6_S3 1 100 0 1 ECU_ADDRESS 0xFFF858FA /end MEASUREMENT
/begin MEASUREMENT sIepSonderfkt.f_cgtrtief_aufwaerm_iep "Anzeige, dass die IEP auch unter Null Grad angesteuert werden darf bei der Aufwaermfunktion" UBYTE eBool_true_false_S6_S3 1 100 0 1 ECU_ADDRESS 0xFFF858F9 /end MEASUREMENT
/begin MEASUREMENT sIepSonderfkt.z_aufwaerm_iep "Status der Aufwaermfunktion" UBYTE eIepAufwaerm_S6_S3 1 100 0 3 ECU_ADDRESS 0xFFF8590C /end MEASUREMENT
/begin MEASUREMENT sK0AltSigna.wnd_std_roh_abs_k0_alt "Betrag der ungefilterte Standardsolldifferenzdrehzahl(Wert aus letztem Rechenschritt)" SWORD UMRM_U_MIN_1_1_0_S6_S3 1 100 -10000 10000 ECU_ADDRESS 0xFFF85792 /end MEASUREMENT
/begin MEASUREMENT sK0AltSigna.z_k0_alt "Istzustand der K0 (Wert aus letztem Rechenschritt)" UBYTE eK0Zust_S6_S3 1 100 0 12 ECU_ADDRESS 0xFFF85798 /end MEASUREMENT
/begin MEASUREMENT sK0AltSigna.z_init_zustand_k0_alt "Flag fuer Zustandsinitialisierung (Wert aus letztem Rechenschritt)" UBYTE eBool_true_false_S6_S3 1 100 0 1 ECU_ADDRESS 0xFFF85797 /end MEASUREMENT
/begin MEASUREMENT sK0AltSigna.m_vorsteuer_fehler_k0_alt "Korrekturwert durch fehlerhaftes Motormoment bei abgeschalteten Regler (Wert aus letztem Rechenschritt)" FLOAT32_IEEE UMRM_NM__1_1_0_S6_S3 1 100 -1500 1500 FORMAT "%5.3" ECU_ADDRESS 0xFFF85770 /end MEASUREMENT
/begin MEASUREMENT sK0AltSigna.m_regler_k0_alt "Gesamtes Reglermoment K0-Schlupfregler (Wert aus letztem Rechenschritt)" SWORD UMRM_NM__1_1_0_S6_S3 1 100 -1000 1000 ECU_ADDRESS 0xFFF85788 /end MEASUREMENT
/begin MEASUREMENT sK0AltSigna.m_steuerung_k0_alt "gesteuerte K0-Momentenanteile = Vorsteuermoment + Offsets (Wert aus letztem Rechenschritt)" SWORD UMRM_NM__1_1_0_S6_S3 1 100 -1000 1000 ECU_ADDRESS 0xFFF8578C /end MEASUREMENT
/begin MEASUREMENT sK0AltSigna.mo_sync_k0_alt "Momentenoffset in z_k0 = SYNCRONISIEREN (Wert aus letztem Rechenschritt)" FLOAT32_IEEE UMRM_NM__1_1_0_S6_S3 1 100 -1500 1500 FORMAT "%5.3" ECU_ADDRESS 0xFFF85778 /end MEASUREMENT
/begin MEASUREMENT sK0AltSigna.mo_k0zu_alt "Momentenoffset fuer die Ueberanpressung in z_k0 = GESCHLOSSEN (Wert aus letztem Rechenschritt)" FLOAT32_IEEE UMRM_NM__1_1_0_S6_S3 1 100 -1500 1500 FORMAT "%5.3" ECU_ADDRESS 0xFFF85774 /end MEASUREMENT
/begin MEASUREMENT sK0AltSigna.m_soll_k0_alt "Sollmoment K0 (Wert aus letztem Rechenschritt)" SWORD UMRM_NM__1_1_0_S6_S3 1 100 -1000 1000 ECU_ADDRESS 0xFFF8578A /end MEASUREMENT
/begin MEASUREMENT sK0AltSigna.fl_ueberanp_rampe_ende_alt "Flag ob Ueberanpressungs Rampe beendet ist. (Wert aus letztem Rechenschritt)" UBYTE eBool_true_false_S6_S3 1 100 0 1 ECU_ADDRESS 0xFFF85795 /end MEASUREMENT
/begin MEASUREMENT sK0AltSigna.fl_synchron_rampe_ende_alt "Flag ob Synchron Rampe beendet ist. (Wert aus letztem Rechenschritt)" UBYTE eBool_true_false_S6_S3 1 100 0 1 ECU_ADDRESS 0xFFF85794 /end MEASUREMENT
/begin MEASUREMENT sK0AltSigna.m_init_filter_regler_k0_alt "Filter zur sprungfreien Initialisierung des Reglers (Wert aus letztem Rechenschritt)" FLOAT32_IEEE UMRM_NM__1_1_0_S6_S3 1 100 -1000 1000 FORMAT "%5.3" ECU_ADDRESS 0xFFF8576C /end MEASUREMENT
/begin MEASUREMENT sK0AltSigna.po_soll_k0_alt "Berechneter Kupplungsdruck(Wert aus letztem Rechenschritt)" SWORD UMRM_BAR__1_1000_0_S6_S3 1 100 0 30 ECU_ADDRESS 0xFFF8578E /end MEASUREMENT
/begin MEASUREMENT sK0AltSigna.mue_k0_alt "Uebertragungsbeiwert(Wert aus letztem Rechenschritt)" FLOAT32_IEEE UMRM_NM_BAR_1_1_0_S6_S3 1 100 -200 200 FORMAT "%5.3" ECU_ADDRESS 0xFFF85780 /end MEASUREMENT
/begin MEASUREMENT sK0AltSigna.mue_abs_k0_alt "Absoluter Uebertragungsbeiwert(Wert aus letztem Rechenschritt)" FLOAT32_IEEE UMRM_NM_BAR_1_1_0_S6_S3 1 100 1 200 FORMAT "%5.3" ECU_ADDRESS 0xFFF8577C /end MEASUREMENT
/begin MEASUREMENT sK0AltSigna.po_soll_stell_k0_alt "Endgueltiger Stelldruck ohne pfmin(Wert aus letztem Rechenschritt)" SWORD UMRM_BAR__1_1000_0_S6_S3 1 100 0 30 ECU_ADDRESS 0xFFF85790 /end MEASUREMENT
/begin MEASUREMENT sK0AltSigna.po_sollstellkorr_k0_alt "Rampe zum Auf- oder Abschalten korrigierten Stelldrucks (Wert aus letztem Rechenschritt)" FLOAT32_IEEE UMRM_BAR__1_1_0_S6_S3 1 100 0 30 FORMAT "%5.3" ECU_ADDRESS 0xFFF85784 /end MEASUREMENT
/begin MEASUREMENT sK0AltSigna.monotonie_mvmsoll_k0_alt "Anzeige ob Momentzunahme oder -abnahme (Wert aus letztem Rechenschritt)" UBYTE eSteigung_S6_S3 1 100 0 1 ECU_ADDRESS 0xFFF85796 /end MEASUREMENT
/begin MEASUREMENT sK0Druck.p_hys_k0 "Hysterese fuer HAS-Ablaeufe sowie p_fmin-Offset fuer Regelung und Ueberanpressung" SWORD UMRM_BAR__1_1000_0_S6_S3 1 100 -30 30 ECU_ADDRESS 0xFFF85320 /end MEASUREMENT
/begin MEASUREMENT sK0Druck.po_soll_k0 "Berechneter Kupplungsdruck" SWORD UMRM_BAR__1_1000_0_S6_S3 1 100 0 30 ECU_ADDRESS 0xFFF85322 /end MEASUREMENT
/begin MEASUREMENT sK0Druck.po_sollstellkorr_k0 "Korrigierter Stelldruck der K0 bei Sonderfunktionen" FLOAT32_IEEE UMRM_BAR__1_1_0_S6_S3 1 100 0 20 FORMAT "%5.3" ECU_ADDRESS 0xFFF8531C /end MEASUREMENT
/begin MEASUREMENT sK0Druck.mue_k0 "Uebertragungsbeiwert" FLOAT32_IEEE UMRM_NM_BAR_1_1_0_S6_S3 1 100 -200 200 FORMAT "%5.3" ECU_ADDRESS 0xFFF85304 /end MEASUREMENT
/begin MEASUREMENT sK0Druck.mue_abs_k0 "Uebertragungsbeiwert" FLOAT32_IEEE UMRM_NM_BAR_1_1_0_S6_S3 1 100 1 200 FORMAT "%5.3" ECU_ADDRESS 0xFFF85300 /end MEASUREMENT
/begin MEASUREMENT sK0Druck.po_soll_k0_roh "Ungefiltertes Rohsignal des Solldrucks" FLOAT32_IEEE UMRM_BAR__1_1_0_S6_S3 1 100 0 30 FORMAT "%5.3" ECU_ADDRESS 0xFFF85318 /end MEASUREMENT
/begin MEASUREMENT sK0Druck.po_soll_stell_k0 "Summe Fuelldruck Torusdruck und Solldruck" SWORD UMRM_BAR__1_1000_0_S6_S3 1 100 0 30 ECU_ADDRESS 0xFFF85324 /end MEASUREMENT
/begin MEASUREMENT sK0Druck.p_regler_k0 "Regleranteil der Solldruckvorgabe" FLOAT32_IEEE UMRM_BAR__1_1_0_S6_S3 1 100 0 30 FORMAT "%5.3" ECU_ADDRESS 0xFFF85308 /end MEASUREMENT
/begin MEASUREMENT sK0Druck.p_vorsteuer_k0 "Anteil aus der Steuerung fuer den Solldruck" FLOAT32_IEEE UMRM_BAR__1_1_0_S6_S3 1 100 0 30 FORMAT "%5.3" ECU_ADDRESS 0xFFF8530C /end MEASUREMENT
/begin MEASUREMENT sK0Druck.po_msoll_k0 "Berechnung Solldruck aus Drehmoment und Uebertragungsbeiwert" FLOAT32_IEEE UMRM_BAR__1_1_0_S6_S3 1 100 0 30 FORMAT "%5.3" ECU_ADDRESS 0xFFF85310 /end MEASUREMENT
/begin MEASUREMENT sK0Druck.po_reg_k0 "In der Regelung aktiver Offset zur Hysteresekompensation" FLOAT32_IEEE UMRM_BAR__1_1_0_S6_S3 1 100 -30 30 FORMAT "%5.3" ECU_ADDRESS 0xFFF85314 /end MEASUREMENT
/begin MEASUREMENT sK0Druck.z_posollstell_k0 "Zustand Stelldruck der K0" UBYTE eK0Stelldruck_S6_S3 1 100 0 2 ECU_ADDRESS 0xFFF85326 /end MEASUREMENT
/begin MEASUREMENT sK0Mom.z_mo_sync_k0zu "Zustand Syncronrampe und Ueberanpressungsrampe" UBYTE UMRM___1_1_0_S6_S3 1 100 0 255 ECU_ADDRESS 0xFFF85382 /end MEASUREMENT
/begin MEASUREMENT sK0Mom.f_mmgvmsoll_k0 "Faktor auf Sollmomentgradient fuer dynamischen Vorsteueranteil" SWORD UMRM___1_100_0_S6_S3 1 100 -327.68 327.67 ECU_ADDRESS 0xFFF85370 /end MEASUREMENT
/begin MEASUREMENT sK0Mom.mo_k0zu "Offset Momentenrampe im Zustand z_k0 = Z_K0_GESCHLOSSEN" FLOAT32_IEEE UMRM_NM__1_1_0_S6_S3 1 100 -1500 1500 FORMAT "%5.3" ECU_ADDRESS 0xFFF85360 /end MEASUREMENT
/begin MEASUREMENT sK0Mom.m_vorsteuer_fehler_k0 "Korrekturwert durch fehlerhaftes Motormoment bei abgeschalteten Regler" FLOAT32_IEEE UMRM_NM__1_1_0_S6_S3 1 100 -1500 1500 FORMAT "%5.3" ECU_ADDRESS 0xFFF85354 /end MEASUREMENT
/begin MEASUREMENT sK0Mom.mo_sync_k0 "Offset Momentenrampe im Zustand Z_K0_SYNCHRONISIEREN" FLOAT32_IEEE UMRM_NM__1_1_0_S6_S3 1 100 -1500 1500 FORMAT "%5.3" ECU_ADDRESS 0xFFF8536C /end MEASUREMENT
/begin MEASUREMENT sK0Mom.mo_lastwechsel_k0 "Momentenoffset bei Lastwechsel" SWORD UMRM_NM__1_1_0_S6_S3 1 100 -1500 1500 ECU_ADDRESS 0xFFF8537A /end MEASUREMENT
/begin MEASUREMENT sK0Mom.xd_k0 "Regelabweichung K0-Schlupfregler" SWORD UMRM_U_MIN_1_1_0_S6_S3 1 100 -10000 10000 ECU_ADDRESS 0xFFF8537E /end MEASUREMENT
/begin MEASUREMENT sK0Mom.m_regler_k0 "Gesamtes Reglermoment K0-Schlupfregler" SWORD UMRM_NM__1_1_0_S6_S3 1 100 -1000 1000 ECU_ADDRESS 0xFFF85372 /end MEASUREMENT
/begin MEASUREMENT sK0Mom.m_regler_k0_p "P-Anteil K0-Schlupfregler" FLOAT32_IEEE UMRM_NM__1_1_0_S6_S3 1 100 -1000 1000 FORMAT "%5.3" ECU_ADDRESS 0xFFF85344 /end MEASUREMENT
/begin MEASUREMENT sK0Mom.m_regler_k0_i "I-Anteil K0-Schlupfregler" FLOAT32_IEEE UMRM_NM__1_1_0_S6_S3 1 100 -1000 1000 FORMAT "%5.3" ECU_ADDRESS 0xFFF85340 /end MEASUREMENT
/begin MEASUREMENT sK0Mom.m_regler_k0_d "D-Anteil K0-Schlupfregler" FLOAT32_IEEE UMRM_NM__1_1_0_S6_S3 1 100 -1000 1000 FORMAT "%5.3" ECU_ADDRESS 0xFFF8533C /end MEASUREMENT
/begin MEASUREMENT sK0Mom.kp_regler_k0 "Reglerparameter für P-Anteil" FLOAT32_IEEE UMRM___1_1_0_S6_S3 1 100 0 100 FORMAT "%5.3" ECU_ADDRESS 0xFFF85334 /end MEASUREMENT
/begin MEASUREMENT sK0Mom.ki_regler_k0 "Reglerparameter für I-Anteil" FLOAT32_IEEE UMRM___1_1_0_S6_S3 1 100 0 100 FORMAT "%5.3" ECU_ADDRESS 0xFFF85330 /end MEASUREMENT
/begin MEASUREMENT sK0Mom.kd_regler_k0 "Reglerparameter für D-Anteil" FLOAT32_IEEE UMRM___1_1_0_S6_S3 1 100 0 100 FORMAT "%5.3" ECU_ADDRESS 0xFFF8532C /end MEASUREMENT
/begin MEASUREMENT sK0Mom.m_init_filter_regler_k0 "Filter zur sprungfreien Initialisierung des Reglers" FLOAT32_IEEE UMRM_NM__1_1_0_S6_S3 1 100 -1000 1000 FORMAT "%5.3" ECU_ADDRESS 0xFFF85338 /end MEASUREMENT
/begin MEASUREMENT sK0Mom.m_soll_k0 "Sollmoment K0" FLOAT32_IEEE UMRM_NM__1_1_0_S6_S3 1 100 -1000 1000 FORMAT "%5.3" ECU_ADDRESS 0xFFF85348 /end MEASUREMENT
/begin MEASUREMENT sK0Mom.m_soll_k0_abs "Absolutwert des Sollmoment K0" SWORD UMRM_NM__1_1_0_S6_S3 1 100 0 1000 ECU_ADDRESS 0xFFF85374 /end MEASUREMENT
/begin MEASUREMENT sK0Mom.m_vorsteuer_k0 "K0-Vorsteuermoment" SWORD UMRM_NM__1_1_0_S6_S3 1 100 -1000 1000 ECU_ADDRESS 0xFFF85378 /end MEASUREMENT
/begin MEASUREMENT sK0Mom.mo_mvmdynamic_k0 "Drehmomentvorhalt aufgrund VM-Sollmoment und VM-Sollmomentgradient" FLOAT32_IEEE UMRM_NM__1_1_0_S6_S3 1 100 -1000 1000 FORMAT "%5.3" ECU_ADDRESS 0xFFF85364 /end MEASUREMENT
/begin MEASUREMENT sK0Mom.mo_schalt_k0 "aus Schaltmomentkennfeldern ausgelesenes Schaltmoment" SWORD UMRM_NM__1_1_0_S6_S3 1 100 -1000 1000 ECU_ADDRESS 0xFFF8537C /end MEASUREMENT
/begin MEASUREMENT sK0Mom.m_steuerung_k0 "gesteuerte K0-Momentenanteile = Vorsteuermoment + Offsets" SWORD UMRM_NM__1_1_0_S6_S3 1 100 -1000 1000 ECU_ADDRESS 0xFFF85376 /end MEASUREMENT
/begin MEASUREMENT sK0Mom.fl_ueberanp_rampe_ende "Flag ob Ueberanpressungs Rampe beendet ist." UBYTE eBool_true_false_S6_S3 1 100 0 1 ECU_ADDRESS 0xFFF85381 /end MEASUREMENT
/begin MEASUREMENT sK0Mom.fl_synchron_rampe_ende "Flag ob Synchron Rampe beendet ist." UBYTE eBool_true_false_S6_S3 1 100 0 1 ECU_ADDRESS 0xFFF85380 /end MEASUREMENT
/begin MEASUREMENT sK0Mom.m_soll_max_k0 "Max Sollmoment" FLOAT32_IEEE UMRM_NM__1_1_0_S6_S3 1 100 -1500 1500 FORMAT "%5.3" ECU_ADDRESS 0xFFF8534C /end MEASUREMENT
/begin MEASUREMENT sK0Mom.m_soll_min_k0 "Min Sollmoment" FLOAT32_IEEE UMRM_NM__1_1_0_S6_S3 1 100 -1500 1500 FORMAT "%5.3" ECU_ADDRESS 0xFFF85350 /end MEASUREMENT
/begin MEASUREMENT sK0Mom.mo_hilfsregler_k0 "Hilfsregler bei ungewolltem Schlupf in der Überanpressung" FLOAT32_IEEE UMRM_NM__1_1_0_S6_S3 1 100 -1000 1000 FORMAT "%5.3" ECU_ADDRESS 0xFFF85358 /end MEASUREMENT
/begin MEASUREMENT sK0Mom.mo_hilfsregler_max_k0 "Maximalwert des Hilfsregler bei ungewolltem Schlupf in der Überanpressung" FLOAT32_IEEE UMRM_NM__1_1_0_S6_S3 1 100 -1000 1000 FORMAT "%5.3" ECU_ADDRESS 0xFFF8535C /end MEASUREMENT
/begin MEASUREMENT sK0Signa.n_vm_sync_k0 "Verbrennungsmotordrehzahl gefiltert und verzögert" SWORD UMRM_U_MIN_1_1_0_S6_S3 1 100 0 10000 ECU_ADDRESS 0xFFF853DE /end MEASUREMENT
/begin MEASUREMENT sK0Signa.n_vm_sync_k0_fl32 "Verbrennungsmotordrehzahl gefiltert und verzögert" FLOAT32_IEEE UMRM_U_MIN_1_1_0_S6_S3 1 100 0 10000 FORMAT "%5.3" ECU_ADDRESS 0xFFF853B0 /end MEASUREMENT
/begin MEASUREMENT sK0Signa.n_em_sync_k0 "Elektromaschinenistdrehzahl gefiltert, verzögert und korrigiert" SWORD UMRM_U_MIN_1_1_0_S6_S3 1 100 -10000 10000 ECU_ADDRESS 0xFFF853D8 /end MEASUREMENT
/begin MEASUREMENT sK0Signa.n_em_nabausvra_sync_k0 "Elektromaschinenistdrehzahl berechnet aus Raddrehzahl gefiltert, verzögert und korrigiert" SWORD UMRM_U_MIN_1_1_0_S6_S3 1 100 -10000 10000 ECU_ADDRESS 0xFFF853D6 /end MEASUREMENT
/begin MEASUREMENT sK0Signa.ng_em_sync_k0 "Elektromaschinen- Drehzahlgradient" SWORD UMRM_U_MINSEC_1_1_0_S6_S3 1 100 -8128 8128 ECU_ADDRESS 0xFFF853F4 /end MEASUREMENT
/begin MEASUREMENT sK0Signa.ng_em_syncziel_k0 "Abtriebsdrehzahlgradient aus n_ab" SWORD UMRM_U_MINSEC_1_1_0_S6_S3 1 100 -8128 8128 ECU_ADDRESS 0xFFF853F6 /end MEASUREMENT
/begin MEASUREMENT sK0Signa.ng_ab_sync_k0 "Abtriebsdrehzahlgradient" SWORD UMRM_U_MINSEC_1_1_0_S6_S3 1 100 -8128 8128 ECU_ADDRESS 0xFFF853F0 /end MEASUREMENT
/begin MEASUREMENT sK0Signa.ng_em_aus_nab_k0 "Abtriebsdrehzahlgradient" SWORD UMRM_U_MINSEC_1_1_0_S6_S3 1 100 -8128 8128 ECU_ADDRESS 0xFFF853F2 /end MEASUREMENT
/begin MEASUREMENT sK0Signa.ndg_k0 "Istdifferenzdrehzahl" SWORD UMRM_U_MINSEC_1_1_0_S6_S3 1 100 -8128 8128 ECU_ADDRESS 0xFFF853EE /end MEASUREMENT
/begin MEASUREMENT sK0Signa.n_mot_korr_k0 "Korrigierte Motordrehzahl" SWORD UMRM_U_MIN_1_1_0_S6_S3 1 100 0 8128 ECU_ADDRESS 0xFFF853DA /end MEASUREMENT
/begin MEASUREMENT sK0Signa.nd_k0 "Differenzdrehzahl K0" SWORD UMRM_U_MIN_1_1_0_S6_S3 1 100 -8128 8128 ECU_ADDRESS 0xFFF853E0 /end MEASUREMENT
/begin MEASUREMENT sK0Signa.nd_zszug_k0 "Gefilterte Differenzdrehzahl K0" SWORD UMRM_U_MIN_1_1_0_S6_S3 1 100 -8128 8128 ECU_ADDRESS 0xFFF853EC /end MEASUREMENT
/begin MEASUREMENT sK0Signa.nd_k0_abs "Absolutwert der Differenzdrehzahl K0" UWORD UMRM_U_MIN_1_1_0_S6_S3 1 100 0 8128 ECU_ADDRESS 0xFFF853E2 /end MEASUREMENT
/begin MEASUREMENT sK0Signa.nd_k0_abs_fl32 "Absolutwert der Differenzdrehzahl K0" FLOAT32_IEEE UMRM_U_MIN_1_1_0_S6_S3 1 100 0 8128 FORMAT "%5.3" ECU_ADDRESS 0xFFF853B4 /end MEASUREMENT
/begin MEASUREMENT sK0Signa.nd_nabausvra_k0 "Differenzdrehzahl K0 aus VM- und Raddrehzahl" SWORD UMRM_U_MIN_1_1_0_S6_S3 1 100 -8128 8128 ECU_ADDRESS 0xFFF853E8 /end MEASUREMENT
/begin MEASUREMENT sK0Signa.nd_nabausvra_k0_abs "Differenzdrehzahl K0 aus VM- und Raddrehzahl (Absolutwert)" UWORD UMRM_U_MIN_1_1_0_S6_S3 1 100 0 8128 ECU_ADDRESS 0xFFF853EA /end MEASUREMENT
/begin MEASUREMENT sK0Signa.nd_mod_k0 "Modifizierte Differenzdrehzahl K0 aus nd_k0 und nd_nabausvra_k0" SWORD UMRM_U_MIN_1_1_0_S6_S3 1 100 -8128 8128 ECU_ADDRESS 0xFFF853E4 /end MEASUREMENT
/begin MEASUREMENT sK0Signa.nd_mod_k0_abs "Modifizierte Differenzdrehzahl K0 aus nd_k0 und nd_nabausvra_k0(Absolutwert)" UWORD UMRM_U_MIN_1_1_0_S6_S3 1 100 0 8128 ECU_ADDRESS 0xFFF853E6 /end MEASUREMENT
/begin MEASUREMENT sK0Signa.n_t_sync_k0 "Turbinendrehzahl gefiltert und verzögert" SWORD UMRM_U_MIN_1_1_0_S6_S3 1 100 0 8128 ECU_ADDRESS 0xFFF853DC /end MEASUREMENT
/begin MEASUREMENT sK0Signa.n_ab_sync_k0 "Abtriebsdrehzahl gefiltert und verzögert" SWORD UMRM_U_MIN_1_1_0_S6_S3 1 100 0 8128 ECU_ADDRESS 0xFFF853D2 /end MEASUREMENT
/begin MEASUREMENT sK0Signa.n_abausvra_sync_k0 "Abtriebsdrehzahl aus Raddrehzahl gefiltert und verzögert (keine Drehrichtung)" UWORD UMRM_U_MIN_1_1_0_S6_S3 1 100 0 8128 ECU_ADDRESS 0xFFF853D4 /end MEASUREMENT
/begin MEASUREMENT sK0Signa.m_vmist_sync_k0 "Gefiltertes und verzögertes Verbrennungsmotor Istmoment" SWORD UMRM_NM__1_1_0_S6_S3 1 100 -200 1300 ECU_ADDRESS 0xFFF853CA /end MEASUREMENT
/begin MEASUREMENT sK0Signa.m_emist_sync_k0 "Gefiltertes und verzögertes E-Maschinen Istmoment" SWORD UMRM_NM__1_1_0_S6_S3 1 100 -200 1300 ECU_ADDRESS 0xFFF853C0 /end MEASUREMENT
/begin MEASUREMENT sK0Signa.m_vmsollgemvor_sync_k0 "Gefiltertes, gemitteltes und verzögertes VM-Sollmoment" SWORD UMRM_NM__1_1_0_S6_S3 1 100 -200 1300 ECU_ADDRESS 0xFFF853CE /end MEASUREMENT
/begin MEASUREMENT sK0Signa.mg_vmsollgemvor_sync_k0 "Gradient des gefilterten, gemittelten und verzögerten VM-Sollmoments" SWORD UMRM_NM_SEC_1_1_0_S6_S3 1 100 -32768 32767 ECU_ADDRESS 0xFFF853D0 /end MEASUREMENT
/begin MEASUREMENT sK0Signa.delta_mvmistmvmsoll_k0 "Differenz zwischen m_vmist_sync_k0 und m_vmsollgemvor_sync_k0" SWORD UMRM_NM__1_1_0_S6_S3 1 100 -1500 1500 ECU_ADDRESS 0xFFF853B8 /end MEASUREMENT
/begin MEASUREMENT sK0Signa.m_vmist_roh "Rohwert Verbrennungsmotor Istmoment ohne Eingriff" SWORD UMRM_NM__1_1_0_S6_S3 1 100 -200 1300 ECU_ADDRESS 0xFFF853C8 /end MEASUREMENT
/begin MEASUREMENT sK0Signa.m_vmsoll_roh "Rohwert Verbrennungsmotor Sollmoment mit Eingriff" SWORD UMRM_NM__1_1_0_S6_S3 1 100 -200 1300 ECU_ADDRESS 0xFFF853CC /end MEASUREMENT
/begin MEASUREMENT sK0Signa.m_emsoll_roh "Rohwert E-Maschinen Sollmoment mit Eingriff" SWORD UMRM_NM__1_1_0_S6_S3 1 100 -200 1300 ECU_ADDRESS 0xFFF853C2 /end MEASUREMENT
/begin MEASUREMENT sK0Signa.m_emist_roh "Rohwert E-Maschinen Istmoment ohne Eingriff" SWORD UMRM_NM__1_1_0_S6_S3 1 100 -200 1300 ECU_ADDRESS 0xFFF853BE /end MEASUREMENT
/begin MEASUREMENT sK0Signa.m_diff_k0 "Differenzmoment an der Kupplung K0" SWORD UMRM_NM__1_1_0_S6_S3 1 100 -1500 1500 ECU_ADDRESS 0xFFF853BC /end MEASUREMENT
/begin MEASUREMENT sK0Signa.m_motist_offs_k0 "Summenmoment aus EM und VM ohne Getriebeeingriff" SWORD UMRM_NM__1_1_0_S6_S3 1 100 -200 1300 ECU_ADDRESS 0xFFF853C4 /end MEASUREMENT
/begin MEASUREMENT sK0Signa.m_motist_sync_k0 "IST Motormoment in Syncro" SWORD UMRM_NM__1_1_0_S6_S3 1 100 -200 1300 ECU_ADDRESS 0xFFF853C6 /end MEASUREMENT
/begin MEASUREMENT sK0Signa.zs_zug_k0 "Zug/Schub-Bestimmung" UBYTE eBool_true_false_S6_S3 1 100 0 1 ECU_ADDRESS 0xFFF85401 /end MEASUREMENT
/begin MEASUREMENT sK0Signa.zs_zug_k0_alt "Altwert vonZug/Schub-Bestimmung" UBYTE eBool_true_false_S6_S3 1 100 0 1 ECU_ADDRESS 0xFFF85402 /end MEASUREMENT
/begin MEASUREMENT sK0Signa.wechsel_zs_zug_k0 "Wechsel Zug/Schub" UBYTE eBool_true_false_S6_S3 1 100 0 1 ECU_ADDRESS 0xFFF85400 /end MEASUREMENT
/begin MEASUREMENT sK0Signa.vorzeichen_zs_zug_k0 "Vorzeichen Zug/Schub" SBYTE UMRM___1_1_0_S6_S3 1 100 -128 127 ECU_ADDRESS 0xFFF853FF /end MEASUREMENT
/begin MEASUREMENT sK0Signa.idx_zs_zug_k0 "Index Zug/Schub-Bestimmung" UBYTE UMRM___1_1_0_S6_S3 1 100 0 255 ECU_ADDRESS 0xFFF853FB /end MEASUREMENT
/begin MEASUREMENT sK0Signa.dkg_pedal_k0 "Gradient vom Fahrpedalistwert" SWORD UMRM_PROZENT_SEC_20_51_0_S6_S3 1 100 -8128 8128 ECU_ADDRESS 0xFFF853BA /end MEASUREMENT
/begin MEASUREMENT sK0Signa.i_getriebe_virt_k0 "Aktuell wirksamen virtuellen Getriebeübersetzung" FLOAT32_IEEE UMRM___1_1_0_S6_S3 1 100 0 5 FORMAT "%5.3" ECU_ADDRESS 0xFFF85388 /end MEASUREMENT
/begin MEASUREMENT sK0Signa.i_istgang_k0 "Istgang Getriebeuebersetzung" FLOAT32_IEEE UMRM___1_1_0_S6_S3 1 100 0 5 FORMAT "%5.3" ECU_ADDRESS 0xFFF85394 /end MEASUREMENT
/begin MEASUREMENT sK0Signa.i_zielgang_k0 "Zielgang Getriebeuebersetzung" FLOAT32_IEEE UMRM___1_1_0_S6_S3 1 100 0 5 FORMAT "%5.3" ECU_ADDRESS 0xFFF85398 /end MEASUREMENT
/begin MEASUREMENT sK0Signa.i_getriebe_virt_k0_roh "Rohwert der aktuell wirksamen virtuellen Getriebeuebersetzung" FLOAT32_IEEE UMRM___1_1_0_S6_S3 1 100 0 5 FORMAT "%5.3" ECU_ADDRESS 0xFFF8538C /end MEASUREMENT
/begin MEASUREMENT sK0Signa.i_getriebe_virt_k0_roh_filt "Gefilteter Rohwert der aktuell wirksamen virtuellen Getriebeuebersetzung" FLOAT32_IEEE UMRM___1_1_0_S6_S3 1 100 0 5 FORMAT "%5.3" ECU_ADDRESS 0xFFF85390 /end MEASUREMENT
/begin MEASUREMENT sK0Signa.j_sek_k0 "Sekundaertraegheit" FLOAT32_IEEE UMRM_KGM2__1_1_0_S6_S3 1 100 0 100 FORMAT "%5.3" ECU_ADDRESS 0xFFF853A4 /end MEASUREMENT
/begin MEASUREMENT sK0Signa.j_pri_k0 "Primaertraegheit" FLOAT32_IEEE UMRM_KGM2__1_1_0_S6_S3 1 100 0 100 FORMAT "%5.3" ECU_ADDRESS 0xFFF853A0 /end MEASUREMENT
/begin MEASUREMENT sK0Signa.j_ersatz_k0 "Ersatztraegheit" FLOAT32_IEEE UMRM_KGM2__1_1_0_S6_S3 1 100 0 100 FORMAT "%5.3" ECU_ADDRESS 0xFFF8539C /end MEASUREMENT
/begin MEASUREMENT sK0Signa.f_schaltung_k0 "Flag zur anzeige ob eine Schaltung laeuft." UBYTE eBool_true_false_S6_S3 1 100 0 1 ECU_ADDRESS 0xFFF853F9 /end MEASUREMENT
/begin MEASUREMENT sK0Signa.schalttyp_k0 "Signal zur anzeige welche Schaltung gerade ausgefuehrt wird" UBYTE UMRM___1_1_0_S6_S3 1 100 0 255 ECU_ADDRESS 0xFFF853FE /end MEASUREMENT
/begin MEASUREMENT sK0Signa.schaltcode_k0 "Signal zur Anzeige von Istgang zu Zielgang" UBYTE eSchaltcode_S6_S3 1 100 0 25 ECU_ADDRESS 0xFFF853FD /end MEASUREMENT
/begin MEASUREMENT sK0Signa.indexschaltmodus_k0 "Signal zur Umschaltung von KF_MOSCHALT in die verschiedenen Modi" UBYTE eIndexModus_S6_S3 1 100 0 3 ECU_ADDRESS 0xFFF853FC /end MEASUREMENT
/begin MEASUREMENT sK0Signa.flag_swi_lastwechsel_sp "Flag zur Umschaltung der Lastwechselparameter" UBYTE eSport_S6_S3 1 100 0 1 ECU_ADDRESS 0xFFF853FA /end MEASUREMENT
/begin MEASUREMENT sK0Signa.f_ndnemnabausvra_aktiv_k0 "Berechnung EM-Drehzahl aus Raddrehzahl fuer nd_mod_k0 verwendet" UBYTE eBool_true_false_S6_S3 1 100 0 1 ECU_ADDRESS 0xFFF853F8 /end MEASUREMENT
/begin MEASUREMENT sK0Sollw.f_wnd_init_k0 "Initialisierungsflag fuer die Sollwertgenerierung" UBYTE eBool_true_false_S6_S3 1 100 0 1 ECU_ADDRESS 0xFFF8542B /end MEASUREMENT
/begin MEASUREMENT sK0Sollw.f_reg_init_k0 "Einstieg in die Regelung" UBYTE eBool_true_false_S6_S3 1 100 0 1 ECU_ADDRESS 0xFFF8542A /end MEASUREMENT
/begin MEASUREMENT sK0Sollw.schaltart_zs "Schaltart" UBYTE eSchaltart_S6_S3 1 100 0 4 ECU_ADDRESS 0xFFF8542C /end MEASUREMENT
/begin MEASUREMENT sK0Sollw.wnd_std_k0 "Standardsolldifferenzdrehzahl" FLOAT32_IEEE UMRM_U_MIN_1_1_0_S6_S3 1 100 -10000 10000 FORMAT "%5.3" ECU_ADDRESS 0xFFF85414 /end MEASUREMENT
/begin MEASUREMENT sK0Sollw.wnd_std_roh_k0 "ungefilterte Standardsolldifferenzdrehzahl" SWORD UMRM_U_MIN_1_1_0_S6_S3 1 100 -10000 10000 ECU_ADDRESS 0xFFF85426 /end MEASUREMENT
/begin MEASUREMENT sK0Sollw.wnd_k0 "gefilterte Standardsolldifferenzdrehzahl inklusive aller Offsets" FLOAT32_IEEE UMRM_U_MIN_1_1_0_S6_S3 1 100 -10000 10000 FORMAT "%5.3" ECU_ADDRESS 0xFFF8540C /end MEASUREMENT
/begin MEASUREMENT sK0Sollw.wnd_k0_int "gefilterte Standardsolldifferenzdrehzahl inklusive aller Offsets Integer" SWORD UMRM_U_MIN_1_1_0_S6_S3 1 100 -10000 10000 ECU_ADDRESS 0xFFF85424 /end MEASUREMENT
/begin MEASUREMENT sK0Sollw.wnd_k0_abs "Absolutwert von der gefilterten Standardsolldifferenzdrehzahl inklusive aller Offsets" FLOAT32_IEEE UMRM_U_MIN_1_1_0_S6_S3 1 100 0 10000 FORMAT "%5.3" ECU_ADDRESS 0xFFF85410 /end MEASUREMENT
/begin MEASUREMENT sK0Sollw.wndo_schalt_k0 "Schaltoffset auf Standardsolldifferenzdrehzahl" FLOAT32_IEEE UMRM_U_MIN_1_1_0_S6_S3 1 100 -10000 10000 FORMAT "%5.3" ECU_ADDRESS 0xFFF8541C /end MEASUREMENT
/begin MEASUREMENT sK0Sollw.wndo_schalt_zeitkonstante_pt2_k0 "Zeitkonstante fuer Schaltoffset auf Standardsolldifferenzdrehzahl" UBYTE UMRM___1_100_0_S6_S3 1 100 0.01 2.5 ECU_ADDRESS 0xFFF8542D /end MEASUREMENT
/begin MEASUREMENT sK0Sollw.delta_ngem "EM Drehzahlgradientendifferenz von Gradient waehrend Schaltung und Zielgang" FLOAT32_IEEE UMRM_U_MINSEC_1_1_0_S6_S3 1 100 -1000 1000 FORMAT "%5.3" ECU_ADDRESS 0xFFF85408 /end MEASUREMENT
/begin MEASUREMENT sK0Sollw.wndg_k0 "Sollgradient der Solldifferenzdrehzahl" FLOAT32_IEEE UMRM_U_MINSEC_1_1_0_S6_S3 1 100 -1000 1000 FORMAT "%5.3" ECU_ADDRESS 0xFFF85418 /end MEASUREMENT
/begin MEASUREMENT sK0Sollw.wndog_schalt_k0 "Sollgradientenoffset waehrend Schaltung" FLOAT32_IEEE UMRM_U_MINSEC_1_1_0_S6_S3 1 100 -1000 1000 FORMAT "%5.3" ECU_ADDRESS 0xFFF85420 /end MEASUREMENT
/begin MEASUREMENT sK0Sollw.wndo_schalt_roh_k0 "Ungefilteter Schaltoffset auf Standardsolldifferenzdrehzahl" SWORD UMRM_U_MIN_1_1_0_S6_S3 1 100 -10000 10000 ECU_ADDRESS 0xFFF85428 /end MEASUREMENT
/begin COMPU_METHOD SAB_152587890625K10000000000000000_S2_S3 "int = ((phys * 1.0E16) / 1.52587890625E11) - (0) -" RAT_FUNC "%18.16" "-" COEFFS 0 1E+016 -0 0 0 152587890625 /end COMPU_METHOD
/begin COMPU_METHOD eIepStatus_S6_S3 "" TAB_VERB "%2.0" "" COMPU_TAB_REF eIepStatus_S6_S3 /end COMPU_METHOD
/begin COMPU_METHOD eIepSoll_S6_S3 "" TAB_VERB "%2.0" "" COMPU_TAB_REF eIepSoll_S6_S3 /end COMPU_METHOD
/begin COMPU_METHOD eIepSollExt_S6_S3 "" TAB_VERB "%2.0" "" COMPU_TAB_REF eIepSollExt_S6_S3 /end COMPU_METHOD
/begin COMPU_METHOD eIepSignaTes_S6_S3 "" TAB_VERB "%2.0" "" COMPU_TAB_REF eIepSignaTes_S6_S3 /end COMPU_METHOD
/begin COMPU_METHOD eIepAufwaerm_S6_S3 "" TAB_VERB "%2.0" "" COMPU_TAB_REF eIepAufwaerm_S6_S3 /end COMPU_METHOD
/begin COMPU_METHOD eK0Zust_S6_S3 "" TAB_VERB "%2.0" "" COMPU_TAB_REF eK0Zust_S6_S3 /end COMPU_METHOD
/begin COMPU_METHOD eK0Stelldruck_S6_S3 "" TAB_VERB "%2.0" "" COMPU_TAB_REF eK0Stelldruck_S6_S3 /end COMPU_METHOD
/begin COMPU_METHOD UMRM___1_1000_0_S6_S3 "Umskalierung um Faktor 1000\\nint = ((phys * 1000) / 1) - (0) [-]" RAT_FUNC "%5.3" "[-]" COEFFS 0 1000 -0 0 0 1 /end COMPU_METHOD
/begin COMPU_METHOD UMRM___1_10000_0_S6_S3 "Umskalierung um Faktor 10000\\nint = ((phys * 10000) / 1) - (0) [-]" RAT_FUNC "%6.4" "[-]" COEFFS 0 10000 -0 0 0 1 /end COMPU_METHOD
/begin COMPU_METHOD UMRM___1_100_0_S6_S3 "Umskalierung um Faktor 100\\nint = ((phys * 100) / 1) - (0) [-]" RAT_FUNC "%5.3" "[-]" COEFFS 0 100 -0 0 0 1 /end COMPU_METHOD
/begin COMPU_METHOD UMRM___1_1_0_S6_S3 "Ohne Umskalierung\\nint = ((phys * 1) / 1) - (0) [-]" RAT_FUNC "%2.0" "[-]" COEFFS 0 1 -0 0 0 1 /end COMPU_METHOD
/begin COMPU_METHOD UMRM_NM_BAR_1_1_0_S6_S3 "Darstellung in Nm/bar\\nint = ((phys * 1) / 1) - (0) [Nm/Bar]" RAT_FUNC "%2.0" "[Nm/Bar]" COEFFS 0 1 -0 0 0 1 /end COMPU_METHOD
/begin COMPU_METHOD UMRM_NM_SEC_1_1_0_S6_S3 "Momentengradient\\nint = ((phys * 1) / 1) - (0) [Nm/s]" RAT_FUNC "%2.0" "[Nm/s]" COEFFS 0 1 -0 0 0 1 /end COMPU_METHOD
/begin COMPU_METHOD UMRM_NM__1_1_0_S6_S3 "Moment\\nint = ((phys * 1) / 1) - (0) [Nm]" RAT_FUNC "%2.0" "[Nm]" COEFFS 0 1 -0 0 0 1 /end COMPU_METHOD
/begin COMPU_METHOD UMRM_BAR__1_1000_0_S6_S3 "Umrechnung von Mbar in bar\\nint = ((phys * 1000) / 1) - (0) [Bar]" RAT_FUNC "%5.3" "[Bar]" COEFFS 0 1000 -0 0 0 1 /end COMPU_METHOD
/begin COMPU_METHOD UMRM_BAR__1_1_0_S6_S3 "Darstellung in bar\\nint = ((phys * 1) / 1) - (0) [Bar]" RAT_FUNC "%2.0" "[Bar]" COEFFS 0 1 -0 0 0 1 /end COMPU_METHOD
/begin COMPU_METHOD UMRM_BAR_SEC_1_1_0_S6_S3 "Darstellung in bar/sec\\nint = ((phys * 1) / 1) - (0) [bar/s]" RAT_FUNC "%2.0" "[bar/s]" COEFFS 0 1 -0 0 0 1 /end COMPU_METHOD
/begin COMPU_METHOD UMRM_U_MIN_1_1_0_S6_S3 "Darstellung in U/min\\nint = ((phys * 1) / 1) - (0) [U/min]" RAT_FUNC "%2.0" "[U/min]" COEFFS 0 1 -0 0 0 1 /end COMPU_METHOD
/begin COMPU_METHOD UMRM_U_MINSEC_1_1_0_S6_S3 "Darstellung in U/(min*sec)\\nint = ((phys * 1) / 1) - (0) [U/(min*s)]" RAT_FUNC "%2.0" "[U/(min*s)]" COEFFS 0 1 -0 0 0 1 /end COMPU_METHOD
/begin COMPU_METHOD UMRM_MSEC__10_1_0_S6_S3 "Umrechnung von 10 msec in msec\\nint = ((phys * 1) / 10) - (0) [ms]" RAT_FUNC "%5.3" "[ms]" COEFFS 0 1 -0 0 0 10 /end COMPU_METHOD
/begin COMPU_METHOD UMRM_SEC__1_100_0_S6_S3 "Umrechnung von sec in 1/100sec\\nint = ((phys * 100) / 1) - (0) [s]" RAT_FUNC "%5.3" "[s]" COEFFS 0 100 -0 0 0 1 /end COMPU_METHOD
/begin COMPU_METHOD UMRM_SEC__1_1_0_S6_S3 "Umrechnung Sekunde\\nint = ((phys * 1) / 1) - (0) [s]" RAT_FUNC "%2.0" "[s]" COEFFS 0 1 -0 0 0 1 /end COMPU_METHOD
/begin COMPU_METHOD UMRM_GRADC__1_1_M40_S6_S3 "Temperatur Skaling\\nint = ((phys * 1) / 1) - (-40) [°C]" RAT_FUNC "%2.0" "[°C]" COEFFS 0 1 40 0 0 1 /end COMPU_METHOD
/begin COMPU_METHOD UMRM_GRADC__1_1_0_S6_S3 "Temperatur\\nint = ((phys * 1) / 1) - (0) [°C]" RAT_FUNC "%2.0" "[°C]" COEFFS 0 1 -0 0 0 1 /end COMPU_METHOD
/begin COMPU_METHOD UMRM_PROZENT__1_100_0_S6_S3 "Umrechnung auf 1 %\\nint = ((phys * 100) / 1) - (0) [%]" RAT_FUNC "%5.3" "[%]" COEFFS 0 100 -0 0 0 1 /end COMPU_METHOD
/begin COMPU_METHOD UMRM_PROZENT__20_51_0_S6_S3 "Umrechnung von ui8 auf 100%\\nint = ((phys * 51) / 20) - (0) [%]" RAT_FUNC "%5.3" "[%]" COEFFS 0 51 -0 0 0 20 /end COMPU_METHOD
/begin COMPU_METHOD UMRM_LITER_MIN_1_1_0_S6_S3 "Darstellung in Liter/min\\nint = ((phys * 1) / 1) - (0) [liter/min]" RAT_FUNC "%2.0" "[liter/min]" COEFFS 0 1 -0 0 0 1 /end COMPU_METHOD
/begin COMPU_METHOD UMRM_LITER_MIN_1_100_0_S6_S3 "Darstellung in Liter/min\\nint = ((phys * 100) / 1) - (0) [liter/min]" RAT_FUNC "%5.3" "[liter/min]" COEFFS 0 100 -0 0 0 1 /end COMPU_METHOD
/begin COMPU_METHOD UMRM_PROZENT_SEC_20_51_0_S6_S3 "Darstellung in %/sec\\nint = ((phys * 51) / 20) - (0) [%/s]" RAT_FUNC "%5.3" "[%/s]" COEFFS 0 51 -0 0 0 20 /end COMPU_METHOD
/begin COMPU_METHOD UMRM_KGM2__1_1_0_S6_S3 "Darstellung in kg*m^2\\nint = ((phys * 1) / 1) - (0) [kg*m^2]" RAT_FUNC "%2.0" "[kg*m^2]" COEFFS 0 1 -0 0 0 1 /end COMPU_METHOD
/begin COMPU_METHOD UMRM_GRAD__1_3_M42_S6_S3 "Quantisierung in 1/3 Grad\\nint = ((phys * 3) / 1) - (-126) [Grad]" RAT_FUNC "%5.3" "[Grad]" COEFFS 0 3 126 0 0 1 /end COMPU_METHOD
/begin COMPU_METHOD UMRM_KM_H_1_1_0_S6_S3 "Umrechnung km/h\\nint = ((phys * 1) / 1) - (0) [km/h]" RAT_FUNC "%2.0" "[km/h]" COEFFS 0 1 -0 0 0 1 /end COMPU_METHOD
/begin COMPU_METHOD UMRM_M_S2_1_1_0_S6_S3 "Umrechnung m/s2\\nint = ((phys * 1) / 1) - (0) [m/s2]" RAT_FUNC "%2.0" "[m/s2]" COEFFS 0 1 -0 0 0 1 /end COMPU_METHOD
/begin COMPU_METHOD eBool_on_off_S6_S3 "" TAB_VERB "%2.0" "" COMPU_TAB_REF eBool_on_off_S6_S3 /end COMPU_METHOD
/begin COMPU_METHOD eSteigung_S6_S3 "" TAB_VERB "%2.0" "" COMPU_TAB_REF eSteigung_S6_S3 /end COMPU_METHOD
/begin COMPU_METHOD eSport_S6_S3 "" TAB_VERB "%2.0" "" COMPU_TAB_REF eSport_S6_S3 /end COMPU_METHOD
/begin COMPU_METHOD eBool_true_false_S6_S3 "" TAB_VERB "%2.0" "" COMPU_TAB_REF eBool_true_false_S6_S3 /end COMPU_METHOD
/begin COMPU_METHOD ePosition_S6_S3 "" TAB_VERB "%2.0" "" COMPU_TAB_REF ePosition_S6_S3 /end COMPU_METHOD
/begin COMPU_METHOD eGangIdx_S6_S3 "" TAB_VERB "%2.0" "" COMPU_TAB_REF eGangIdx_S6_S3 /end COMPU_METHOD
/begin COMPU_METHOD eSchaltart_S6_S3 "" TAB_VERB "%2.0" "" COMPU_TAB_REF eSchaltart_S6_S3 /end COMPU_METHOD
/begin COMPU_METHOD eSchaltungsIdx_S6_S3 "" TAB_VERB "%2.0" "" COMPU_TAB_REF eSchaltungsIdx_S6_S3 /end COMPU_METHOD
/begin COMPU_METHOD eSchaltcode_S6_S3 "" TAB_VERB "%2.0" "" COMPU_TAB_REF eSchaltcode_S6_S3 /end COMPU_METHOD
/begin COMPU_METHOD eIndexModus_S6_S3 "" TAB_VERB "%2.0" "" COMPU_TAB_REF eIndexModus_S6_S3 /end COMPU_METHOD
/begin COMPU_METHOD eKupStatusIae_S6_S3 "" TAB_VERB "%2.0" "" COMPU_TAB_REF eKupStatusIae_S6_S3 /end COMPU_METHOD
/begin COMPU_METHOD eIndexSpSps_S6_S3 "" TAB_VERB "%2.0" "" COMPU_TAB_REF eIndexSpSps_S6_S3 /end COMPU_METHOD
/begin COMPU_VTAB eIepStatus_S6_S3 "" TAB_VERB 5 0 "AUS" 1 "SLEEP" 2 "LP1" 3 "LP2" 4 "LP3" /end COMPU_VTAB
/begin COMPU_VTAB eIepSoll_S6_S3 "" TAB_VERB 4 0 "AUS" 1 "LP1" 2 "LP2" 3 "LP3" /end COMPU_VTAB
/begin COMPU_VTAB eIepSollExt_S6_S3 "" TAB_VERB 5 0 "KEINE_VORGABE" 1 "AUS" 2 "LP1" 3 "LP2" 4 "LP3" /end COMPU_VTAB
/begin COMPU_VTAB eIepSignaTes_S6_S3 "" TAB_VERB 4 0 "KEINE_VORGABE" 1 "LP1" 2 "LP2" 3 "LP3" /end COMPU_VTAB
/begin COMPU_VTAB eIepAufwaerm_S6_S3 "" TAB_VERB 4 0 "INAKTIV" 1 "BEREIT" 2 "AKTIV" 3 "STOP" /end COMPU_VTAB
/begin COMPU_VTAB eK0Zust_S6_S3 "" TAB_VERB 13 0 "OFFEN" 1 "SF" 2 "FA" 3 "ANGELEGT" 4 "MOMENTENSTELLUNG" 5 "SYNCRO" 6 "SCHLIESS" 7 "ZU" 8 "ZUREG" 9 "REGELN" 10 "GER_ZU" 11 "MOM_ABBAU" 12 "MANUELL" /end COMPU_VTAB
/begin COMPU_VTAB eK0Stelldruck_S6_S3 "" TAB_VERB 3 0 "STANDARD" 1 "V_REIN" 2 "MAX" /end COMPU_VTAB
/begin COMPU_VTAB eBool_on_off_S6_S3 "" TAB_VERB 2 0 "E_off" 1 "E_on" /end COMPU_VTAB
/begin COMPU_VTAB eSteigung_S6_S3 "" TAB_VERB 2 0 "E_fallend" 1 "E_steigend" /end COMPU_VTAB
/begin COMPU_VTAB eSport_S6_S3 "" TAB_VERB 2 0 "E__NORM" 1 "E__SPORT" /end COMPU_VTAB
/begin COMPU_VTAB eBool_true_false_S6_S3 "" TAB_VERB 2 0 "FALSE" 1 "TRUE" /end COMPU_VTAB
/begin COMPU_VTAB ePosition_S6_S3 "" TAB_VERB 9 0 "E_Pos1" 1 "E_Pos2" 2 "E_Pos3" 3 "E_Pos4" 4 "E_Pos5" 5 "E_PosD" 6 "E_PosN" 7 "E_PosR" 8 "E_PosP" /end COMPU_VTAB
/begin COMPU_VTAB eGangIdx_S6_S3 "" TAB_VERB 10 0 "E_G_R" 1 "E_G_PN" 2 "E_G_1" 3 "E_G_2" 4 "E_G_3" 5 "E_G_4" 6 "E_G_5" 7 "E_G_6" 8 "E_G_7" 9 "E_G_8" /end COMPU_VTAB
/begin COMPU_VTAB eSchaltart_S6_S3 "" TAB_VERB 5 0 "E_keineSchaltung" 1 "E_ZugRueckschaltung" 2 "E_ZugHochschaltung" 3 "E_SchubRueckschaltung" 4 "E_SchubHochschaltung" /end COMPU_VTAB
/begin COMPU_VTAB eSchaltungsIdx_S6_S3 "" TAB_VERB 5 0 "E_MehrfachrueckschaltungIdx" 1 "E_RueckschaltungIdx" 2 "E_KeineSchaltung_k0Idx" 3 "E_HochschaltungIdx" 4 "E_MehrfachochschaltungIdx" /end COMPU_VTAB
/begin COMPU_VTAB eSchaltcode_S6_S3 "" TAB_VERB 26 0 "E__00" 1 "E__12" 2 "E__23" 3 "E__34" 4 "E__45" 5 "E__56" 6 "E__67" 7 "E__78" 8 "E__21" 9 "E__32" 10 "E__43" 11 "E__54" 12 "E__65" 13 "E__76" 14 "E__87" 15 "E__31" 16 "E__42" 17 "E__53" 18 "E__51" 19 "E__64" 20 "E__63" 21 "E__75" 22 "E__71" 23 "E__86" 24 "E__84" 25 "E__82" /end COMPU_VTAB
/begin COMPU_VTAB eIndexModus_S6_S3 "" TAB_VERB 4 0 "E_STD" 1 "E_SPONTAN" 2 "E_SP" 3 "E_AMAX" /end COMPU_VTAB
/begin COMPU_VTAB eKupStatusIae_S6_S3 "" TAB_VERB 9 0 "E_IAEINAKTIV" 1 "E_IAEANGELEGT" 2 "E_IAEKRIECHEN" 3 "E_IAEHANFAHREN" 4 "E_IAEEANFAHREN" 5 "E_IAEEANFAHRENENTKOPPELT" 6 "E_IAESYNCHRONISIEREN" 7 "E_IAEZU" 8 "E_IAEENTKOPPELT" /end COMPU_VTAB
/begin COMPU_VTAB eIndexSpSps_S6_S3 "" TAB_VERB 100 0 "E_SpIndex00" 1 "E_SpIndex01" 2 "E_SpIndex02" 3 "E_SpIndex03" 4 "E_SpIndex04" 5 "E_SpIndex05" 6 "E_SpIndex06" 7 "E_SpIndex07" 8 "E_SpIndex08" 9 "E_SpIndex09" 10 "E_SpIndex10" 11 "E_SpIndex11" 12 "E_SpIndex12" 13 "E_SpIndex13" 14 "E_SpIndex14" 15 "E_SpIndex15" 16 "E_SpIndex16" 17 "E_SpIndex17" 18 "E_SpIndex18" 19 "E_SpIndex19" 20 "E_SpIndex20" 21 "E_SpIndex21" 22 "E_SpIndex22" 23 "E_SpIndex23" 24 "E_SpIndex24" 25 "E_SpIndex25" 26 "E_SpIndex26" 27 "E_SpIndex27" 28 "E_SpIndex28" 29 "E_SpIndex29" 30 "E_SpIndex30" 31 "E_SpIndex31" 32 "E_SpIndex32" 33 "E_SpIndex33" 34 "E_SpIndex34" 35 "E_SpIndex35" 36 "E_SpIndex36" 37 "E_SpIndex37" 38 "E_SpIndex38" 39 "E_SpIndex39" 40 "E_SpIndex40" 41 "E_SpIndex41" 42 "E_SpIndex42" 43 "E_SpIndex43" 44 "E_SpIndex44" 45 "E_SpIndex45" 46 "E_SpIndex46" 47 "E_SpIndex47" 48 "E_SpIndex48" 49 "E_SpIndex49" 50 "E_SpIndex50" 51 "E_SpIndex51" 52 "E_SpIndex52" 53 "E_SpIndex53" 54 "E_SpIndex54" 55 "E_SpIndex55" 56 "E_SpIndex56" 57 "E_SpIndex57" 58 "E_SpIndex58" 59 "E_SpIndex59" 60 "E_SpIndex60" 61 "E_SpIndex61" 62 "E_SpIndex62" 63 "E_SpIndex63" 64 "E_SpIndex64" 65 "E_SpIndex65" 66 "E_SpIndex66" 67 "E_SpIndex67" 68 "E_SpIndex68" 69 "E_SpIndex69" 70 "E_SpIndex70" 71 "E_SpIndex71" 72 "E_SpIndex72" 73 "E_SpIndex73" 74 "E_SpIndex74" 75 "E_SpIndex75" 76 "E_SpIndex76" 77 "E_SpIndex77" 78 "E_SpIndex78" 79 "E_SpIndex79" 80 "E_SpIndex80" 81 "E_SpIndex81" 82 "E_SpIndex82" 83 "E_SpIndex83" 84 "E_SpIndex84" 85 "E_SpIndex85" 86 "E_SpIndex86" 87 "E_SpIndex87" 88 "E_SpIndex88" 89 "E_SpIndex89" 90 "E_SpIndex90" 91 "E_SpIndex91" 92 "E_SpIndex92" 93 "E_SpIndex93" 94 "E_SpIndex94" 95 "E_SpIndex95" 96 "E_SpIndex96" 97 "E_SpIndex97" 98 "E_SpIndex98" 99 "E_SpIndex99" /end COMPU_VTAB
/begin FUNCTION PAR_IEP_LECKAGE ""
 /begin DEF_CHARACTERISTIC sIepLeckage.KF_ADDONLP_IEP sIepLeckage.KF_KORRANCGETRDKP_IEP sIepLeckage.KF_KORRANCGETRPBREMSE_IEP sIepLeckage.KF_KORRAUSPSYSCGETR_IEP sIepLeckage.KF_KORRAUSPSYSDKP_IEP sIepLeckage.KF_LECKAGEFZP_IEP sIepLeckage.KF_LECKAGEHSG_IEP sIepLeckage.KL_KORRANDKP_IEP sIepLeckage.KL_NGMOT_IEP sIepLeckage.MPT_NSMOTANKORR_IEP sIepLeckage.PUMPENVOLPROUMDR_IEP sIepLeckage.TAB_KORRANISTGANG_IEP sIepLeckage.TAB_KORRAUSISTGANG_IEP sIepLeckage.TAB_LECKAGEHSG_IEP /end DEF_CHARACTERISTIC
 /begin LOC_MEASUREMENT sIepLeckage.ns_mot_an_iep sIepLeckage.ns_mot_an_korr_iep sIepLeckage.ns_mot_an_korr_roh_iep sIepLeckage.ns_mot_hys_iep sIepLeckage.q_bedarf_iep sIepLeckage.q_leckage_fzp_iep sIepLeckage.q_leckage_ges_iep sIepLeckage.q_leckage_hsg_iep sIepLeckage.q_ueberschuss_iep /end LOC_MEASUREMENT
/end FUNCTION
/begin FUNCTION PAR_IEP_SIGAUFB ""
 /begin DEF_CHARACTERISTIC sIepSigna.MDT_NG_MOT_IEP sIepSigna.MPT_AYREFAFAHRZEUGQUER_IEP sIepSigna.MPT_NEIGUNG_IEP sIepSigna.NS_MOT_HYS_IEP sIepSigna.NS_NMOT_IEP sIepSigna.SWI_M_MAXEMIAE_IEP sIepSigna.SWI_NOTLAUF_ABFRAGE_IEP /end DEF_CHARACTERISTIC
 /begin LOC_MEASUREMENT sIepSigna.a_fahrzeugquer_iep sIepSigna.f_ansteuerung_iep sIepSigna.f_aufwaerm_erlaubt_iep sIepSigna.f_efahren_aktiv_iep sIepSigna.f_has_aktiv_iep sIepSigna.f_notlauf_aktiv_iep sIepSigna.f_schaltung_iep sIepSigna.f_shutdown_iep sIepSigna.fahr_bereit_iep sIepSigna.m_getr_iep sIepSigna.neigung_gef_iep sIepSigna.ng_mot_iep sIepSigna.pumpenist_iep sIepSigna.soll_ext_abk_iep sIepSigna.soll_ext_has_iep sIepSigna.soll_ext_sab_iep sIepSigna.soll_ext_tes_iep sIepSigna.v_fahrzeug_iep /end LOC_MEASUREMENT
/end FUNCTION
/begin FUNCTION PAR_IEP_SIGNACHBER ""
 /begin DEF_CHARACTERISTIC sIepSignachber.KF_TIST_LP1LP2_IEP sIepSignachber.KF_TIST_LP2LP1_IEP sIepSignachber.KF_TIST_LP2LP3_IEP sIepSignachber.KF_TIST_LP3LP2_IEP sIepSignachber.K_TIST_START_IEP /end DEF_CHARACTERISTIC
 /begin LOC_MEASUREMENT sIepSignachber.f_elektrische_pumpe_lauft_iep sIepSignachber.f_erststart_iep sIepSignachber.f_pumpe_angefordert_iep sIepSignachber.fehler_iep sIepSignachber.req_iep sIepSignachber.status_iep sIepSignachber.t_last_iep_activated sIepSignachber.t_verz_ist_iep /end LOC_MEASUREMENT
/end FUNCTION
/begin FUNCTION PAR_IEP_SOLLEXT ""
 /begin LOC_MEASUREMENT sIepSollext.f_ext_abk_iep sIepSollext.f_ext_has_iep sIepSollext.f_ext_iep sIepSollext.f_ext_sab_iep sIepSollext.f_ext_tes_iep sIepSollext.soll_ext_iep /end LOC_MEASUREMENT
/end FUNCTION
/begin FUNCTION PAR_IEP_SOLLVORG ""
 /begin DEF_CHARACTERISTIC sIepSoll.BM_ZFKTAKTIV_LPBER_IEP sIepSoll.LP_VORGABE_TEMP_IEP sIepSoll.MMOT_SCHWELLE_LP2_IEP sIepSoll.MMOT_SCHWELLE_LP3_IEP sIepSoll.TAB_VORGABELP_IEP sIepSoll.TEMP_SCHWELLE_LP_HYS_IEP sIepSoll.TEMP_SCHWELLE_LP_IEP /end DEF_CHARACTERISTIC
 /begin LOC_MEASUREMENT sIepSoll.soll_iep /end LOC_MEASUREMENT
/end FUNCTION
/begin FUNCTION PAR_IEP_SONDERFKT ""
 /begin DEF_CHARACTERISTIC sIepSonderfkt.AS_LUFT_SCHRAEGLINKS_IEP sIepSonderfkt.AS_LUFT_SCHRAEGRECHTS_IEP sIepSonderfkt.GS_GEFAELLE_IEP sIepSonderfkt.KL_NSMOT_PSS_IEP sIepSonderfkt.KL_NS_MOT_PUMPE_IEP sIepSonderfkt.KL_T_AUFWAERM_IEP sIepSonderfkt.NS_F_EINMAL_AUS_IEP sIepSonderfkt.NS_NAB_ERF_IEP sIepSonderfkt.NS_NAB_IEP sIepSonderfkt.P_SYSMIN_PSS_IEP sIepSonderfkt.P_SYS_AUFWAERM_HYS_IEP sIepSonderfkt.P_SYS_AUFWAERM_IEP sIepSonderfkt.P_SYS_SCHWELLE_IEP sIepSonderfkt.SWI_ABFR_HAS_PSS_IEP sIepSonderfkt.SWI_AUFWAERM_AKTIV_IEP sIepSonderfkt.SWI_GEFAEL_LUFT_AKTIV_IEP sIepSonderfkt.SWI_NAB_LUFT_AKTIV_IEP sIepSonderfkt.SWI_SCHRAEG_LUFT_AKTIV_IEP sIepSonderfkt.TAB_SCHALTUNG_PSS_IEP sIepSonderfkt.TAB_STATUSIAE_PSS_IEP sIepSonderfkt.TEMP_AUFWAERMENDE_IEP sIepSonderfkt.TEMP_AUFWAERM_IEP sIepSonderfkt.TEMP_HYS_FEHLER_IEP sIepSonderfkt.TEMP_HYS_IEP sIepSonderfkt.TEMP_MAX_IEP sIepSonderfkt.TEMP_MIN_IEP sIepSonderfkt.TEMP_TIEF_AUFWAERM_IEP sIepSonderfkt.TEMP_TIEF_NOTLAUF_IEP sIepSonderfkt.T_GEFAELLE_IEP sIepSonderfkt.T_LUFT_AKTIV_IEP sIepSonderfkt.T_LUFT_SPERR_IEP sIepSonderfkt.T_MAXCGETRTIEF_NOTLAUF_IEP sIepSonderfkt.T_NAB_IEP sIepSonderfkt.T_PSYS_PSS_IEP sIepSonderfkt.T_WASH_FKT_IEP sIepSonderfkt.VS_FZGAUFWAERMSTOP_HYS_IEP sIepSonderfkt.VS_FZGAUFWAERMSTOP_IEP sIepSonderfkt.VS_LUFTSCHRAEG_IEP /end DEF_CHARACTERISTIC
 /begin LOC_MEASUREMENT sIepSonderfkt.bed_in_fehler_iep sIepSonderfkt.f_cgetr_aus_iep sIepSonderfkt.f_cgetr_fehler_iep sIepSonderfkt.f_cgtrtief_aufwaerm_iep sIepSonderfkt.f_cgtrtief_notlauf_iep sIepSonderfkt.f_einmal_aus_iep sIepSonderfkt.f_gefaelle_erfuellt_iep sIepSonderfkt.f_luft_erfuellt_iep sIepSonderfkt.f_nab_erfuellt_iep sIepSonderfkt.f_nab_gegeben_iep sIepSonderfkt.f_psys_max_iep sIepSonderfkt.f_psys_stuetzen_iep sIepSonderfkt.f_schraeg_erfuellt_iep sIepSonderfkt.f_schraeg_fehler_iep sIepSonderfkt.f_wash_fkt_aktiv_iep sIepSonderfkt.t_aufwaerm_iep sIepSonderfkt.t_gefaelle_iep sIepSonderfkt.t_luft_aktiv_iep sIepSonderfkt.t_luft_sperr_iep sIepSonderfkt.t_maxcgetrtief_notlauf_iep sIepSonderfkt.t_nab_iep sIepSonderfkt.t_psys_pss_iep sIepSonderfkt.t_wash_fkt_iep sIepSonderfkt.z_aufwaerm_iep /end LOC_MEASUREMENT
/end FUNCTION
/begin FUNCTION PAR_K0S_ALTSIGNALE ""
 /begin LOC_MEASUREMENT sK0AltSigna.fl_synchron_rampe_ende_alt sK0AltSigna.fl_ueberanp_rampe_ende_alt sK0AltSigna.m_init_filter_regler_k0_alt sK0AltSigna.m_regler_k0_alt sK0AltSigna.m_soll_k0_alt sK0AltSigna.m_steuerung_k0_alt sK0AltSigna.m_vorsteuer_fehler_k0_alt sK0AltSigna.mo_k0zu_alt sK0AltSigna.mo_sync_k0_alt sK0AltSigna.monotonie_mvmsoll_k0_alt sK0AltSigna.mue_abs_k0_alt sK0AltSigna.mue_k0_alt sK0AltSigna.po_soll_k0_alt sK0AltSigna.po_soll_stell_k0_alt sK0AltSigna.po_sollstellkorr_k0_alt sK0AltSigna.wnd_std_roh_abs_k0_alt sK0AltSigna.z_init_zustand_k0_alt sK0AltSigna.z_k0_alt /end LOC_MEASUREMENT
/end FUNCTION
/begin FUNCTION PAR_K0S_DRUCKBER ""
 /begin DEF_CHARACTERISTIC sK0Druck.KF_MUEKORR_K0 sK0Druck.KF_MUE_K0 sK0Druck.KF_PHYSCGETRNMOT_K0 sK0Druck.KF_POFCGETRMSOLL_K0 sK0Druck.KF_POREGCGETRNMOT_K0 sK0Druck.KL_FMUEC_K0 sK0Druck.KL_P_K0STELLMAX sK0Druck.MPT_HYSABREG_K0 sK0Druck.MPT_HYSAB_K0 sK0Druck.MPT_HYSAUF_K0 sK0Druck.MPT_MOMENTENABBAU_K0 sK0Druck.PG_HYSABREG_K0 sK0Druck.PG_MANUELL_K0 sK0Druck.PG_MAXDRUCK_K0 sK0Druck.PG_VENTILABLAG_AB_K0 sK0Druck.PG_VENTILABLAG_AUF_K0 sK0Druck.PS_VENTILABLAG_K0 sK0Druck.P_MANUELL_K0 sK0Druck.P_MAXDRUCK_K0 sK0Druck.P_VENTILABLAG_K0 sK0Druck.SWI_NDWNDMUE_K0 sK0Druck.SWI_POSOLLMUE_K0 /end DEF_CHARACTERISTIC
 /begin LOC_MEASUREMENT sK0Druck.mue_abs_k0 sK0Druck.mue_k0 sK0Druck.p_hys_k0 sK0Druck.p_regler_k0 sK0Druck.p_vorsteuer_k0 sK0Druck.po_msoll_k0 sK0Druck.po_reg_k0 sK0Druck.po_soll_k0 sK0Druck.po_soll_k0_roh sK0Druck.po_soll_stell_k0 sK0Druck.po_sollstellkorr_k0 sK0Druck.z_posollstell_k0 /end LOC_MEASUREMENT
/end FUNCTION
/begin FUNCTION PAR_K0S_MOMENTEN ""
 /begin DEF_CHARACTERISTIC AMAX.KF_MOSCHALTK0[_00] AMAX.KF_MOSCHALTK0[_12] AMAX.KF_MOSCHALTK0[_21] AMAX.KF_MOSCHALTK0[_23] AMAX.KF_MOSCHALTK0[_31] AMAX.KF_MOSCHALTK0[_32] AMAX.KF_MOSCHALTK0[_34] AMAX.KF_MOSCHALTK0[_42] AMAX.KF_MOSCHALTK0[_43] AMAX.KF_MOSCHALTK0[_45] AMAX.KF_MOSCHALTK0[_51] AMAX.KF_MOSCHALTK0[_53] AMAX.KF_MOSCHALTK0[_54] AMAX.KF_MOSCHALTK0[_56] AMAX.KF_MOSCHALTK0[_63] AMAX.KF_MOSCHALTK0[_64] AMAX.KF_MOSCHALTK0[_65] AMAX.KF_MOSCHALTK0[_67] AMAX.KF_MOSCHALTK0[_71] AMAX.KF_MOSCHALTK0[_75] AMAX.KF_MOSCHALTK0[_76] AMAX.KF_MOSCHALTK0[_78] AMAX.KF_MOSCHALTK0[_82] AMAX.KF_MOSCHALTK0[_84] AMAX.KF_MOSCHALTK0[_86] AMAX.KF_MOSCHALTK0[_87] SP.KF_MOSCHALTK0[_00] SP.KF_MOSCHALTK0[_12] SP.KF_MOSCHALTK0[_21] SP.KF_MOSCHALTK0[_23] SP.KF_MOSCHALTK0[_31] SP.KF_MOSCHALTK0[_32] SP.KF_MOSCHALTK0[_34] SP.KF_MOSCHALTK0[_42] SP.KF_MOSCHALTK0[_43] SP.KF_MOSCHALTK0[_45] SP.KF_MOSCHALTK0[_51] SP.KF_MOSCHALTK0[_53] SP.KF_MOSCHALTK0[_54] SP.KF_MOSCHALTK0[_56] SP.KF_MOSCHALTK0[_63] SP.KF_MOSCHALTK0[_64] SP.KF_MOSCHALTK0[_65] SP.KF_MOSCHALTK0[_67] SP.KF_MOSCHALTK0[_71] SP.KF_MOSCHALTK0[_75] SP.KF_MOSCHALTK0[_76] SP.KF_MOSCHALTK0[_78] SP.KF_MOSCHALTK0[_82] SP.KF_MOSCHALTK0[_84] SP.KF_MOSCHALTK0[_86] SP.KF_MOSCHALTK0[_87] SPONTAN.KF_MOSCHALTK0[_00] SPONTAN.KF_MOSCHALTK0[_12] SPONTAN.KF_MOSCHALTK0[_21] SPONTAN.KF_MOSCHALTK0[_23] SPONTAN.KF_MOSCHALTK0[_31] SPONTAN.KF_MOSCHALTK0[_32] SPONTAN.KF_MOSCHALTK0[_34] SPONTAN.KF_MOSCHALTK0[_42] SPONTAN.KF_MOSCHALTK0[_43] SPONTAN.KF_MOSCHALTK0[_45] SPONTAN.KF_MOSCHALTK0[_51] SPONTAN.KF_MOSCHALTK0[_53] SPONTAN.KF_MOSCHALTK0[_54] SPONTAN.KF_MOSCHALTK0[_56] SPONTAN.KF_MOSCHALTK0[_63] SPONTAN.KF_MOSCHALTK0[_64] SPONTAN.KF_MOSCHALTK0[_65] SPONTAN.KF_MOSCHALTK0[_67] SPONTAN.KF_MOSCHALTK0[_71] SPONTAN.KF_MOSCHALTK0[_75] SPONTAN.KF_MOSCHALTK0[_76] SPONTAN.KF_MOSCHALTK0[_78] SPONTAN.KF_MOSCHALTK0[_82] SPONTAN.KF_MOSCHALTK0[_84] SPONTAN.KF_MOSCHALTK0[_86] SPONTAN.KF_MOSCHALTK0[_87] STD.KF_MOSCHALTK0[_00] STD.KF_MOSCHALTK0[_12] STD.KF_MOSCHALTK0[_21] STD.KF_MOSCHALTK0[_23] STD.KF_MOSCHALTK0[_31] STD.KF_MOSCHALTK0[_32] STD.KF_MOSCHALTK0[_34] STD.KF_MOSCHALTK0[_42] STD.KF_MOSCHALTK0[_43] STD.KF_MOSCHALTK0[_45] STD.KF_MOSCHALTK0[_51] STD.KF_MOSCHALTK0[_53] STD.KF_MOSCHALTK0[_54] STD.KF_MOSCHALTK0[_56] STD.KF_MOSCHALTK0[_63] STD.KF_MOSCHALTK0[_64] STD.KF_MOSCHALTK0[_65] STD.KF_MOSCHALTK0[_67] STD.KF_MOSCHALTK0[_71] STD.KF_MOSCHALTK0[_75] STD.KF_MOSCHALTK0[_76] STD.KF_MOSCHALTK0[_78] STD.KF_MOSCHALTK0[_82] STD.KF_MOSCHALTK0[_84] STD.KF_MOSCHALTK0[_86] STD.KF_MOSCHALTK0[_87] sK0Mom.D_PT2_MSCHALTAB_K0 sK0Mom.KF_F_KI_K0 sK0Mom.KF_F_MOLW_K0[_NORM] sK0Mom.KF_F_MOLW_K0[_SPORT] sK0Mom.KF_F_MOMMGVMSOLL_K0 sK0Mom.KF_F_MOMVMISTMVMSOLL_K0 sK0Mom.KF_KDREGK0S sK0Mom.KF_KDREGK0Z sK0Mom.KF_KIREGK0S sK0Mom.KF_KIREGK0Z sK0Mom.KF_KPREGK0S sK0Mom.KF_KPREGK0Z sK0Mom.KF_MOLWGERGESK0S[_NORM] sK0Mom.KF_MOLWGERGESK0S[_SPORT] sK0Mom.KF_MOLWGERGESK0Z[_NORM] sK0Mom.KF_MOLWGERGESK0Z[_SPORT] sK0Mom.KF_MOLWSPFGERK0S[_NORM] sK0Mom.KF_MOLWSPFGERK0S[_SPORT] sK0Mom.KF_MOLWSPFGERK0Z[_NORM] sK0Mom.KF_MOLWSPFGERK0Z[_SPORT] sK0Mom.KI_HILFSREGLER_K0 sK0Mom.KL_MGK0SYNC sK0Mom.KL_MGK0ZU sK0Mom.KL_MOK0SYNC sK0Mom.KL_MOK0ZU sK0Mom.KL_MS_MINREGD_K0 sK0Mom.KL_MS_MINREGPN_K0 sK0Mom.MDT_D_ANTEIL_K0 sK0Mom.MPT_INIT_REGLER_K0 sK0Mom.MPT_MOMABBAU_K0 sK0Mom.MPT_MO_HILFSREGLER_MAX_K0 sK0Mom.MPT_ZUNACHSYNCHRON_K0 sK0Mom.SWI_INITVORSCHALT_K0 sK0Mom.SWI_MSCHALTK0_SP sK0Mom.SWI_REGELABWBETRAEGE_K0 sK0Mom.SWI_REGINITFILTER_K0 sK0Mom.SWI_REGRAMPSCHALT_K0 sK0Mom.TAB_F_KDSCHALT_K0 sK0Mom.TAB_F_KISCHALT_K0 sK0Mom.TAB_F_KPSCHALT_K0 sK0Mom.TAB_MPT_MOLWGERGES_K0[_NORM] sK0Mom.TAB_MPT_MOLWGERGES_K0[_SPORT] sK0Mom.TAB_MPT_MOLWSPFGER_K0[_NORM] sK0Mom.TAB_MPT_MOLWSPFGER_K0[_SPORT] sK0Mom.TAB_MPT_MSCHALTAUF_K0 sK0Mom.TAB_MPT_ZUNACHREGELN_K0 sK0Mom.TAB_SWI_F_KI_K0 sK0Mom.TAB_T_MOLWGERGES_K0[_NORM] sK0Mom.TAB_T_MOLWGERGES_K0[_SPORT] sK0Mom.TAB_T_MOLWSPFGER_K0[_NORM] sK0Mom.TAB_T_MOLWSPFGER_K0[_SPORT] sK0Mom.TAB_T_PT2_MSCHALTAB_K0 sK0Mom.T_REGRAMPSCHALT_K0 sK0Mom.WND_HILFSREGLER_K0 sK0Mom.XDS_HILFSREGLERSCHALT_K0 sK0Mom.XDS_HILFSREGLER_K0 /end DEF_CHARACTERISTIC
 /begin LOC_MEASUREMENT sK0Mom.f_mmgvmsoll_k0 sK0Mom.fl_synchron_rampe_ende sK0Mom.fl_ueberanp_rampe_ende sK0Mom.kd_regler_k0 sK0Mom.ki_regler_k0 sK0Mom.kp_regler_k0 sK0Mom.m_init_filter_regler_k0 sK0Mom.m_regler_k0 sK0Mom.m_regler_k0_d sK0Mom.m_regler_k0_i sK0Mom.m_regler_k0_p sK0Mom.m_soll_k0 sK0Mom.m_soll_k0_abs sK0Mom.m_soll_max_k0 sK0Mom.m_soll_min_k0 sK0Mom.m_steuerung_k0 sK0Mom.m_vorsteuer_fehler_k0 sK0Mom.m_vorsteuer_k0 sK0Mom.mo_hilfsregler_k0 sK0Mom.mo_hilfsregler_max_k0 sK0Mom.mo_k0zu sK0Mom.mo_lastwechsel_k0 sK0Mom.mo_mvmdynamic_k0 sK0Mom.mo_schalt_k0 sK0Mom.mo_sync_k0 sK0Mom.xd_k0 sK0Mom.z_mo_sync_k0zu /end LOC_MEASUREMENT
/end FUNCTION
/begin FUNCTION PAR_K0S_SIGNA ""
 /begin DEF_CHARACTERISTIC sK0Signa.I_KEINKRAFTSCHLUSS_K0 sK0Signa.J_EM_K0 sK0Signa.J_FAHRZEUG_K0 sK0Signa.J_MOTOR_K0 sK0Signa.J_PRI_K0 sK0Signa.J_SEK_K0 sK0Signa.MDS_LWREGK0S sK0Signa.MDS_LWREGK0Z sK0Signa.MDT_DKGPEDAL_K0 sK0Signa.MDT_MGVMSOLLGEMVOR_K0 sK0Signa.MDT_NDG_K0 sK0Signa.MDT_NGAB_K0 sK0Signa.MDT_NG_EM_K0 sK0Signa.MO_EMIST_K0 sK0Signa.MO_MMOTIST_K0 sK0Signa.MO_VMIST_K0 sK0Signa.MO_VMSOLL_K0 sK0Signa.MPT_I_GETRIEBE_VIRT_K0 sK0Signa.MPT_MEMIST_K0 sK0Signa.MPT_MINIT_REST_K0 sK0Signa.MPT_MMOTIST_K0 sK0Signa.MPT_MVMIST_K0 sK0Signa.MPT_NABAUSVRA_K0 sK0Signa.MPT_NAB_K0 sK0Signa.MPT_NDZSZUG_K0 sK0Signa.MPT_NT_K0 sK0Signa.NDS_IAEEMAUSVRA_K0 sK0Signa.NDS_LWREGK0S sK0Signa.NDS_LWREGK0Z sK0Signa.NDS_NEMAUSVRA_PLAUSI_K0 sK0Signa.NDS_SYNCNTNAB_K0 sK0Signa.NMOT_ADDKORR_K0 sK0Signa.SWI_JFZGSCHALTAKTIV_K0 sK0Signa.SWI_KEINKRAFTSCHLUSS_K0 sK0Signa.SWI_MSOLL_K0 sK0Signa.SWI_NDNABAUSVRA_K0 sK0Signa.SWI_ZUGSCHUBERKENNUNG_K0 sK0Signa.TAB_F_MVMSOLLGEMVOR sK0Signa.TAB_JGETRIEBE_K0 sK0Signa.TAB_MPT_MVMSOLLGEMVOR_K0 sK0Signa.TAB_MPT_NMOT_K0 sK0Signa.TAB_MPT_NVM_K0 sK0Signa.TAB_SWILASTWECHSEL_K0_SP sK0Signa.TAB_VZMVMSOLLGEMVOR sK0Signa.T_CHANGE_ND_K0 sK0Signa.VZ_MEMIST_K0 sK0Signa.VZ_MMOTIST_K0 sK0Signa.VZ_MVMIST_K0 sK0Signa.VZ_NABAUSVRA_K0 sK0Signa.VZ_NABNT_K0 sK0Signa.VZ_NMOT_K0 sK0Signa.VZ_NVM_K0 /end DEF_CHARACTERISTIC
 /begin LOC_MEASUREMENT sK0Signa.delta_mvmistmvmsoll_k0 sK0Signa.dkg_pedal_k0 sK0Signa.f_ndnemnabausvra_aktiv_k0 sK0Signa.f_schaltung_k0 sK0Signa.flag_swi_lastwechsel_sp sK0Signa.i_getriebe_virt_k0 sK0Signa.i_getriebe_virt_k0_roh sK0Signa.i_getriebe_virt_k0_roh_filt sK0Signa.i_istgang_k0 sK0Signa.i_zielgang_k0 sK0Signa.idx_zs_zug_k0 sK0Signa.indexschaltmodus_k0 sK0Signa.j_ersatz_k0 sK0Signa.j_pri_k0 sK0Signa.j_sek_k0 sK0Signa.m_diff_k0 sK0Signa.m_emist_roh sK0Signa.m_emist_sync_k0 sK0Signa.m_emsoll_roh sK0Signa.m_motist_offs_k0 sK0Signa.m_motist_sync_k0 sK0Signa.m_vmist_roh sK0Signa.m_vmist_sync_k0 sK0Signa.m_vmsoll_roh sK0Signa.m_vmsollgemvor_sync_k0 sK0Signa.mg_vmsollgemvor_sync_k0 sK0Signa.n_ab_sync_k0 sK0Signa.n_abausvra_sync_k0 sK0Signa.n_em_nabausvra_sync_k0 sK0Signa.n_em_sync_k0 sK0Signa.n_mot_korr_k0 sK0Signa.n_t_sync_k0 sK0Signa.n_vm_sync_k0 sK0Signa.n_vm_sync_k0_fl32 sK0Signa.nd_k0 sK0Signa.nd_k0_abs sK0Signa.nd_k0_abs_fl32 sK0Signa.nd_mod_k0 sK0Signa.nd_mod_k0_abs sK0Signa.nd_nabausvra_k0 sK0Signa.nd_nabausvra_k0_abs sK0Signa.nd_zszug_k0 sK0Signa.ndg_k0 sK0Signa.ng_ab_sync_k0 sK0Signa.ng_em_aus_nab_k0 sK0Signa.ng_em_sync_k0 sK0Signa.ng_em_syncziel_k0 sK0Signa.schaltcode_k0 sK0Signa.schalttyp_k0 sK0Signa.vorzeichen_zs_zug_k0 sK0Signa.wechsel_zs_zug_k0 sK0Signa.zs_zug_k0 sK0Signa.zs_zug_k0_alt /end LOC_MEASUREMENT
/end FUNCTION
/begin FUNCTION PAR_K0S_SOLLW ""
 /begin DEF_CHARACTERISTIC G_1.KF_WND_STD[K0ASD] G_1.KF_WND_STD[K0] G_2.KF_WND_STD[K0ASD] G_2.KF_WND_STD[K0] G_3.KF_WND_STD[K0ASD] G_3.KF_WND_STD[K0] G_4.KF_WND_STD[K0ASD] G_4.KF_WND_STD[K0] G_5.KF_WND_STD[K0ASD] G_5.KF_WND_STD[K0] G_6.KF_WND_STD[K0ASD] G_6.KF_WND_STD[K0] G_7.KF_WND_STD[K0ASD] G_7.KF_WND_STD[K0] G_8.KF_WND_STD[K0ASD] G_8.KF_WND_STD[K0] G_PN.KF_WND_STD[K0ASD] G_PN.KF_WND_STD[K0] G_R.KF_WND_STD[K0ASD] G_R.KF_WND_STD[K0] sK0Sollw.D_WNDOSCHALT_K0 sK0Sollw.D_WNDSTD_K0 sK0Sollw.KF_WND_STD_PN sK0Sollw.KL_F_WNDSTD_CGETR_K0 sK0Sollw.KL_F_WND_K0 sK0Sollw.KL_T_WNDOSCHALTAB_K0_HSS sK0Sollw.KL_T_WNDOSCHALTAB_K0_RSZ sK0Sollw.TAB_T_WNDOSCHALTAUF_K0 sK0Sollw.TAB_T_WNDSTD_K0 sK0Sollw.TAB_WNDOSCHALT_K0 sK0Sollw.TAB_WND_K0ZU sK0Sollw.T_WNDOSCHALTAB_HSZ_K0 sK0Sollw.T_WNDOSCHALTAB_RSS_K0 sK0Sollw.T_WNDOSCHALT_HSS_K0 sK0Sollw.T_WNDOSCHALT_RSZ_K0 sK0Sollw.WNDLIMIT_EXT_K0 sK0Sollw.WNDOSCHALT_HSS_K0 sK0Sollw.WNDOSCHALT_RSZ_K0 sK0Sollw.WND_GRENZMAX_K0 sK0Sollw.WND_GRENZMIN_K0 /end DEF_CHARACTERISTIC
 /begin LOC_MEASUREMENT sK0Sollw.delta_ngem sK0Sollw.f_reg_init_k0 sK0Sollw.f_wnd_init_k0 sK0Sollw.schaltart_zs sK0Sollw.wnd_k0 sK0Sollw.wnd_k0_abs sK0Sollw.wnd_k0_int sK0Sollw.wnd_std_k0 sK0Sollw.wnd_std_roh_k0 sK0Sollw.wndg_k0 sK0Sollw.wndo_schalt_k0 sK0Sollw.wndo_schalt_roh_k0 sK0Sollw.wndo_schalt_zeitkonstante_pt2_k0 sK0Sollw.wndog_schalt_k0 /end LOC_MEASUREMENT
/end FUNCTION
/begin RECORD_LAYOUT Parameter.ui16_S6_S3 FNC_VALUES 1 UWORD ROW_DIR DIRECT /end RECORD_LAYOUT
/begin RECORD_LAYOUT Parameter.ui8_S6_S3 FNC_VALUES 1 UBYTE ROW_DIR DIRECT /end RECORD_LAYOUT
/begin RECORD_LAYOUT Matrix.ui8_S6_S3 FNC_VALUES 1 UBYTE ROW_DIR DIRECT /end RECORD_LAYOUT
/begin RECORD_LAYOUT Table.si16_S6_S3 FNC_VALUES 1 SWORD ROW_DIR DIRECT /end RECORD_LAYOUT
/begin RECORD_LAYOUT Table.fl32_S6_S3 FNC_VALUES 1 FLOAT32_IEEE ROW_DIR DIRECT /end RECORD_LAYOUT
/begin RECORD_LAYOUT Curve.ui8.si16_S6_S3 FNC_VALUES 2 SWORD ROW_DIR DIRECT AXIS_PTS_X 1 UBYTE INDEX_INCR DIRECT /end RECORD_LAYOUT
/begin RECORD_LAYOUT Curve.si16.si16_S6_S3 FNC_VALUES 2 SWORD ROW_DIR DIRECT AXIS_PTS_X 1 SWORD INDEX_INCR DIRECT /end RECORD_LAYOUT
/begin RECORD_LAYOUT Map.fl32.fl32.fl32_S6_S3 FNC_VALUES 3 FLOAT32_IEEE ROW_DIR DIRECT AXIS_PTS_X 1 FLOAT32_IEEE INDEX_INCR DIRECT AXIS_PTS_Y 2 FLOAT32_IEEE INDEX_INCR DIRECT /end RECORD_LAYOUT
/begin RECORD_LAYOUT Map.si16.ui8.si16_S6_S3 FNC_VALUES 3 SWORD ROW_DIR DIRECT AXIS_PTS_X 1 SWORD INDEX_INCR DIRECT AXIS_PTS_Y 2 UBYTE INDEX_INCR DIRECT /end RECORD_LAYOUT
/begin RECORD_LAYOUT Map.ui8.ui8.si16_S6_S3 FNC_VALUES 3 SWORD ROW_DIR DIRECT AXIS_PTS_X 1 UBYTE INDEX_INCR DIRECT AXIS_PTS_Y 2 UBYTE INDEX_INCR DIRECT /end RECORD_LAYOUT
/begin RECORD_LAYOUT Map.ui16.ui8.ui16_S6_S3 FNC_VALUES 3 UWORD ROW_DIR DIRECT AXIS_PTS_X 1 UWORD INDEX_INCR DIRECT AXIS_PTS_Y 2 UBYTE INDEX_INCR DIRECT /end RECORD_LAYOUT
/begin RECORD_LAYOUT Parameter.fl32_S6_S3 FNC_VALUES 1 FLOAT32_IEEE ROW_DIR DIRECT /end RECORD_LAYOUT
/begin RECORD_LAYOUT Table.bool8_S6_S3 FNC_VALUES 1 UBYTE ROW_DIR DIRECT /end RECORD_LAYOUT
/begin RECORD_LAYOUT Matrix.bool8_S6_S3 FNC_VALUES 1 UBYTE ROW_DIR DIRECT /end RECORD_LAYOUT
/begin RECORD_LAYOUT Curve.ui8.ui16_S6_S3 FNC_VALUES 2 UWORD ROW_DIR DIRECT AXIS_PTS_X 1 UBYTE INDEX_INCR DIRECT /end RECORD_LAYOUT
/begin RECORD_LAYOUT Parameter.si16_S6_S3 FNC_VALUES 1 SWORD ROW_DIR DIRECT /end RECORD_LAYOUT
/begin RECORD_LAYOUT Curve.fl32.fl32_S6_S3 FNC_VALUES 2 FLOAT32_IEEE ROW_DIR DIRECT AXIS_PTS_X 1 FLOAT32_IEEE INDEX_INCR DIRECT /end RECORD_LAYOUT
/begin RECORD_LAYOUT Map.ui8.si16.si16_S6_S3 FNC_VALUES 3 SWORD ROW_DIR DIRECT AXIS_PTS_X 1 UBYTE INDEX_INCR DIRECT AXIS_PTS_Y 2 SWORD INDEX_INCR DIRECT /end RECORD_LAYOUT
/begin RECORD_LAYOUT Table.ui8_S6_S3 FNC_VALUES 1 UBYTE ROW_DIR DIRECT /end RECORD_LAYOUT
/begin RECORD_LAYOUT Curve.si16.ui16_S6_S3 FNC_VALUES 2 UWORD ROW_DIR DIRECT AXIS_PTS_X 1 SWORD INDEX_INCR DIRECT /end RECORD_LAYOUT
/begin RECORD_LAYOUT Map.si16.si16.si16_S6_S3 FNC_VALUES 3 SWORD ROW_DIR DIRECT AXIS_PTS_X 1 SWORD INDEX_INCR DIRECT AXIS_PTS_Y 2 SWORD INDEX_INCR DIRECT /end RECORD_LAYOUT
/begin RECORD_LAYOUT Map.ui8.ui8.ui8_S6_S3 FNC_VALUES 3 UBYTE ROW_DIR DIRECT AXIS_PTS_X 1 UBYTE INDEX_INCR DIRECT AXIS_PTS_Y 2 UBYTE INDEX_INCR DIRECT /end RECORD_LAYOUT
/begin RECORD_LAYOUT Parameter.si8_S6_S3 FNC_VALUES 1 SBYTE ROW_DIR DIRECT /end RECORD_LAYOUT
/begin RECORD_LAYOUT Matrix.fl32_S6_S3 FNC_VALUES 1 FLOAT32_IEEE ROW_DIR DIRECT /end RECORD_LAYOUT
/begin RECORD_LAYOUT Table.si8_S6_S3 FNC_VALUES 1 SBYTE ROW_DIR DIRECT /end RECORD_LAYOUT
/begin RECORD_LAYOUT Curve.si16.ui8_S6_S3 FNC_VALUES 2 UBYTE ROW_DIR DIRECT AXIS_PTS_X 1 SWORD INDEX_INCR DIRECT /end RECORD_LAYOUT
/begin RECORD_LAYOUT Map.si16.si16.ui8_S6_S3 FNC_VALUES 3 UBYTE ROW_DIR DIRECT AXIS_PTS_X 1 SWORD INDEX_INCR DIRECT AXIS_PTS_Y 2 SWORD INDEX_INCR DIRECT /end RECORD_LAYOUT
/end MODULE
/end PROJECT
