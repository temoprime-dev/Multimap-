ASAP2_VERSION 1 51
/begin PROJECT _929_929 "Gen2_BMW_System_Supplier_Lib"
/begin HEADER "" VERSION "C_03_03" PROJECT_NO _929_929 /end HEADER
/begin MODULE DIM ""
/begin MOD_COMMON "" BYTE_ORDER MSB_FIRST ALIGNMENT_BYTE 1 ALIGNMENT_WORD 2 ALIGNMENT_LONG 4 ALIGNMENT_FLOAT32_IEEE 4 /end MOD_COMMON
/begin MEASUREMENT me_red_abs "ausgegebene Momentenreduzierung als Absolutmoment" SWORD UMR_NM__1_1_0_S6_S3 1 100 -2000 2000 ECU_ADDRESS 0xFFF857E2 /end MEASUREMENT
/begin MEASUREMENT me_red_abs_luft "ausgegebene ME über Luftals Absolutmoment" SWORD UMR_NM__1_1_0_S6_S3 1 100 -2000 2000 ECU_ADDRESS 0xFFF857E4 /end MEASUREMENT
/begin MEASUREMENT me_rel "ausgegebene relativer ME" SWORD UMR_NM__1_1_0_S6_S3 1 100 -2000 2000 ECU_ADDRESS 0xFFF857E6 /end MEASUREMENT
/begin MEASUREMENT me_red_abs_pos_vor_rel "relativer Motoreingriffvorhalt(Gesamt)" SWORD UMR_NM__1_1_0_S6_S3 1 100 -2000 2000 ECU_ADDRESS 0xFFF857E8 /end MEASUREMENT
/begin MEASUREMENT me_rel_komp "Komplementsiganl zu me_rel (Bitweise invertiert)" SWORD UMR_NM__1_1_0_S6_S3 1 100 -2000 2000 ECU_ADDRESS 0xFFF857EA /end MEASUREMENT
/begin MEASUREMENT me_rel_luft "ausgegebene rel. ME über Luft als rel. Moment" SWORD UMR_NM__1_1_0_S6_S3 1 100 -2000 2000 ECU_ADDRESS 0xFFF857EC /end MEASUREMENT
/begin MEASUREMENT z_mmotmax "Anzeigegroeße für die aktieve m_motmax-Funktion" UBYTE UMR___1_1_0_S6_S3 1 100 0 29 ECU_ADDRESS 0xFFF8A319 /end MEASUREMENT
/begin MEASUREMENT me_red_abs_pos_vor "Motoreingriffvorhalt als Absolutwert(Gesamt)" SWORD UMR_NM__1_1_0_S6_S3 1 100 -2000 2000 ECU_ADDRESS 0xFFF857EE /end MEASUREMENT
/begin MEASUREMENT me_red_abs_pos_vor_status "Status Motoreingriffvorhalt als Absolutwert(Gesamt)" UBYTE UMR___1_1_0_S6_S3 1 100 0 2 ECU_ADDRESS 0xFFF8594A /end MEASUREMENT
/begin MEASUREMENT me_red_status "Status Momentenvorgabe" UBYTE UMR___1_1_0_S6_S3 1 100 0 3 ECU_ADDRESS 0xFFF8594B /end MEASUREMENT
/begin MEASUREMENT me_komp "Komplementsiganl zu me_red_abs (Bitweise invertiert)" SWORD UMR_NM__1_1_0_S6_S3 1 100 -2000 2000 ECU_ADDRESS 0xFFF857F0 /end MEASUREMENT
/begin MEASUREMENT me_status_komp "Komplementsiganl zu me_red_status (Bitweise invertiert)" UBYTE UMR___1_1_0_S6_S3 1 100 252 255 ECU_ADDRESS 0xFFF8594C /end MEASUREMENT
/begin MEASUREMENT defaultgang "Defaultgang" SBYTE UMR___1_1_0_S6_S3 1 100 -1 8 ECU_ADDRESS 0xFFF8594D /end MEASUREMENT
/begin MEASUREMENT kraftschluss "Zustandssignal Kraftschluss des Getriebes" UBYTE UMR___1_1_0_S6_S3 1 100 0 6 ECU_ADDRESS 0xFFF8A31A /end MEASUREMENT
/begin MEASUREMENT sollgang_pruefung "FLAG: Sollgang akzeptiert" UBYTE UMR___1_1_0_S6_S3 1 100 0 1 BIT_MASK 0x1 ECU_ADDRESS 0xFFF8A31B /end MEASUREMENT
/begin MEASUREMENT reihenschaltung_moeglich "FLAG: Reihenschaltung moeglich" UBYTE UMR___1_1_0_S6_S3 1 100 0 1 BIT_MASK 0x1 ECU_ADDRESS 0xFFF8A31C /end MEASUREMENT
/begin MEASUREMENT max_kuehlung_anfordern "max. Kuehlung anfordern" UBYTE UMR___1_1_0_S6_S3 1 100 0 3 ECU_ADDRESS 0xFFF8A31D /end MEASUREMENT
/begin MEASUREMENT hochtemp_betrieb_sps "Hochtemperaturbetieb Schaltpunktsteuerung anfordern" UBYTE UMR___1_1_0_S6_S3 1 100 0 2 ECU_ADDRESS 0xFFF8A31E /end MEASUREMENT
/begin MEASUREMENT m_motmax "maximal zulaessiges Motormoment" SWORD UMR_NM__1_1_0_S6_S3 1 100 -400 1640 ECU_ADDRESS 0xFFF857F2 /end MEASUREMENT
/begin MEASUREMENT m_hotmodemax "maximal zulaessiges Motormoment aus Hot-Mode Funktion" SWORD UMR_NM__1_1_0_S6_S3 1 100 -400 1640 ECU_ADDRESS 0xFFF857F4 /end MEASUREMENT
/begin MEASUREMENT f_deakt_dither0 "Flag Steuerflag zur Deaktivierung der Ditherung i_eds0" UBYTE UMR___1_1_0_S6_S3 1 100 0 1 BIT_MASK 0x1 ECU_ADDRESS 0xFFF8A31F /end MEASUREMENT
/begin MEASUREMENT f_deakt_dither1 "Flag Steuerflag zur Deaktivierung der Ditherung i_eds1" UBYTE UMR___1_1_0_S6_S3 1 100 0 1 BIT_MASK 0x1 ECU_ADDRESS 0xFFF8A320 /end MEASUREMENT
/begin MEASUREMENT f_deakt_dither2 "Flag Steuerflag zur Deaktivierung der Ditherung i_eds2" UBYTE UMR___1_1_0_S6_S3 1 100 0 1 BIT_MASK 0x1 ECU_ADDRESS 0xFFF8A321 /end MEASUREMENT
/begin MEASUREMENT f_deakt_dither3 "Flag Steuerflag zur Deaktivierung der Ditherung i_eds3" UBYTE UMR___1_1_0_S6_S3 1 100 0 1 BIT_MASK 0x1 ECU_ADDRESS 0xFFF8A322 /end MEASUREMENT
/begin MEASUREMENT f_deakt_dither4 "Flag Steuerflag zur Deaktivierung der Ditherung i_eds4" UBYTE UMR___1_1_0_S6_S3 1 100 0 1 BIT_MASK 0x1 ECU_ADDRESS 0xFFF8A323 /end MEASUREMENT
/begin MEASUREMENT f_deakt_dither5 "Flag Steuerflag zur Deaktivierung der Ditherung i_eds5" UBYTE UMR___1_1_0_S6_S3 1 100 0 1 BIT_MASK 0x1 ECU_ADDRESS 0xFFF8A324 /end MEASUREMENT
/begin MEASUREMENT f_deakt_dither6 "Flag Steuerflag zur Deaktivierung der Ditherung i_eds6" UBYTE UMR___1_1_0_S6_S3 1 100 0 1 BIT_MASK 0x1 ECU_ADDRESS 0xFFF8A325 /end MEASUREMENT
/begin MEASUREMENT f_deakt_dither7 "Flag Steuerflag zur Deaktivierung der Ditherung i_eds7" UBYTE UMR___1_1_0_S6_S3 1 100 0 1 BIT_MASK 0x1 ECU_ADDRESS 0xFFF8A326 /end MEASUREMENT
/begin MEASUREMENT drehz_anhebung_has "Flags zur Aktivierung der Drehzahlanhebung HAS" UBYTE UMR___1_1_0_S6_S3 1 100 0 1 BIT_MASK 0x1 ECU_ADDRESS 0xFFF8A327 /end MEASUREMENT
/begin MEASUREMENT z_n_mot_llsoll_iae "Ausgabe min. EM-Drehzahl" UBYTE UMR___1_1_0_S6_S3 1 100 0 3 ECU_ADDRESS 0xFFF8A328 /end MEASUREMENT
/begin MEASUREMENT f_min_emdrehzahl_iae "Flags zur Aktivierung der EM-Drehzahlanhebung IAE" UBYTE UMR___1_1_0_S6_S3 1 100 0 1 BIT_MASK 0x1 ECU_ADDRESS 0xFFF8A329 /end MEASUREMENT
/begin MEASUREMENT i_eds1 "EDS 1 Strom" UWORD UMR_MA__1_10_0_S6_S3 1 100 0 1200 ECU_ADDRESS 0xFFF857F6 /end MEASUREMENT
/begin MEASUREMENT i_eds2 "EDS 2 Strom" UWORD UMR_MA__1_10_0_S6_S3 1 100 0 1200 ECU_ADDRESS 0xFFF857F8 /end MEASUREMENT
/begin MEASUREMENT i_eds3 "EDS 3 Strom" UWORD UMR_MA__1_10_0_S6_S3 1 100 0 1200 ECU_ADDRESS 0xFFF857FA /end MEASUREMENT
/begin MEASUREMENT i_eds4 "EDS 4 Strom" UWORD UMR_MA__1_10_0_S6_S3 1 100 0 1200 ECU_ADDRESS 0xFFF857FC /end MEASUREMENT
/begin MEASUREMENT i_eds5 "EDS 5 Strom" UWORD UMR_MA__1_10_0_S6_S3 1 100 0 1200 ECU_ADDRESS 0xFFF857FE /end MEASUREMENT
/begin MEASUREMENT i_eds6 "EDS 6 Strom" UWORD UMR_MA__1_10_0_S6_S3 1 100 0 1200 ECU_ADDRESS 0xFFF85800 /end MEASUREMENT
/begin MEASUREMENT i_eds7 "EDS 7 Strom" UWORD UMR_MA__1_10_0_S6_S3 1 100 0 1200 ECU_ADDRESS 0xFFF85802 /end MEASUREMENT
/begin MEASUREMENT mv_1 "Zustand Magntventil 1" UBYTE Conv.mv_1_S6_S3 1 100 0 1 BIT_MASK 0x1 ECU_ADDRESS 0xFFF8A32A /end MEASUREMENT
/begin MEASUREMENT mv_2 "Zustand Magntventil 2" UBYTE Conv.mv_2_S6_S3 1 100 0 1 BIT_MASK 0x1 ECU_ADDRESS 0xFFF8A32B /end MEASUREMENT
/begin MEASUREMENT mv_3 "Zustand Magntventil 3" UBYTE Conv.mv_3_S6_S3 1 100 0 1 BIT_MASK 0x1 ECU_ADDRESS 0xFFF8A32C /end MEASUREMENT
/begin MEASUREMENT sbc_info "Zustandsgroesse SBC fuer Softwarepartner" UBYTE UMR___1_1_0_S6_S3 1 100 0 2 ECU_ADDRESS 0xFFF8A32D /end MEASUREMENT
/begin MEASUREMENT i_eds1_komp "Komplementsignal zu EDS 1 Strom" UWORD UMR_MA__1_10_0_S6_S3 1 100 0 6553.5 ECU_ADDRESS 0xFFF85804 /end MEASUREMENT
/begin MEASUREMENT i_eds2_komp "Komplementsignal zu EDS 2 Strom" UWORD UMR_MA__1_10_0_S6_S3 1 100 0 6553.5 ECU_ADDRESS 0xFFF85806 /end MEASUREMENT
/begin MEASUREMENT i_eds3_komp "Komplementsignal zu EDS 3 Strom" UWORD UMR_MA__1_10_0_S6_S3 1 100 0 6553.5 ECU_ADDRESS 0xFFF85808 /end MEASUREMENT
/begin MEASUREMENT i_eds4_komp "Komplementsignal zu EDS 4 Strom" UWORD UMR_MA__1_10_0_S6_S3 1 100 0 6553.5 ECU_ADDRESS 0xFFF8580A /end MEASUREMENT
/begin MEASUREMENT i_eds5_komp "Komplementsignal zu EDS 5 Strom" UWORD UMR_MA__1_10_0_S6_S3 1 100 0 6553.5 ECU_ADDRESS 0xFFF8580C /end MEASUREMENT
/begin MEASUREMENT i_eds6_komp "Komplementsignal zu EDS 6 Strom" UWORD UMR_MA__1_10_0_S6_S3 1 100 0 6553.5 ECU_ADDRESS 0xFFF8580E /end MEASUREMENT
/begin MEASUREMENT i_eds7_komp "Komplementsignal zu EDS 7 Strom" UWORD UMR_MA__1_10_0_S6_S3 1 100 0 6553.5 ECU_ADDRESS 0xFFF85810 /end MEASUREMENT
/begin MEASUREMENT i_eds0 "EDS 0 Strom" UWORD UMR_MA__1_10_0_S6_S3 1 100 0 1200 ECU_ADDRESS 0xFFF85812 /end MEASUREMENT
/begin MEASUREMENT i_eds0_komp "Komplementsignal zu EDS 0 Strom" UWORD UMR_MA__1_10_0_S6_S3 1 100 0 6553.5 ECU_ADDRESS 0xFFF85814 /end MEASUREMENT
/begin MEASUREMENT i_eds8 "EDS 8 Strom" UWORD UMR_MA__1_10_0_S6_S3 1 100 0 1200 ECU_ADDRESS 0xFFF85816 /end MEASUREMENT
/begin MEASUREMENT i_eds8_komp "Komplementsignal zu EDS 8 Strom" UWORD UMR_MA__1_10_0_S6_S3 1 100 0 6553.5 ECU_ADDRESS 0xFFF85818 /end MEASUREMENT
/begin MEASUREMENT i_eds9 "EDS 9 Strom" UWORD UMR_MA__1_10_0_S6_S3 1 100 0 1200 ECU_ADDRESS 0xFFF8581A /end MEASUREMENT
/begin MEASUREMENT i_eds9_komp "Komplementsignal zu EDS 9 Strom" UWORD UMR_MA__1_10_0_S6_S3 1 100 0 6553.5 ECU_ADDRESS 0xFFF8581C /end MEASUREMENT
/begin MEASUREMENT i_eds10 "EDS 10 Strom" UWORD UMR_MA__1_10_0_S6_S3 1 100 0 1200 ECU_ADDRESS 0xFFF8581E /end MEASUREMENT
/begin MEASUREMENT i_eds10_komp "Komplementsignal zu EDS 10 Strom" UWORD UMR_MA__1_10_0_S6_S3 1 100 0 6553.5 ECU_ADDRESS 0xFFF85820 /end MEASUREMENT
/begin MEASUREMENT i_eds11 "EDS 11 Strom" UWORD UMR_MA__1_10_0_S6_S3 1 100 0 1200 ECU_ADDRESS 0xFFF85822 /end MEASUREMENT
/begin MEASUREMENT i_eds11_komp "Komplementsignal zu EDS 11 Strom" UWORD UMR_MA__1_10_0_S6_S3 1 100 0 6553.5 ECU_ADDRESS 0xFFF85824 /end MEASUREMENT
/begin MEASUREMENT i_eds_kupa "EDS Strom für Kupplung A" UWORD UMR_MA__1_10_0_S6_S3 1 100 0 1200 ECU_ADDRESS 0xFFF85826 /end MEASUREMENT
/begin MEASUREMENT i_eds_kupb "EDS Strom für Kupplung B" UWORD UMR_MA__1_10_0_S6_S3 1 100 0 1200 ECU_ADDRESS 0xFFF85828 /end MEASUREMENT
/begin MEASUREMENT i_eds_kupc "EDS Strom für Kupplung C" UWORD UMR_MA__1_10_0_S6_S3 1 100 0 1200 ECU_ADDRESS 0xFFF8582A /end MEASUREMENT
/begin MEASUREMENT i_eds_kupd "EDS Strom für Kupplung D" UWORD UMR_MA__1_10_0_S6_S3 1 100 0 1200 ECU_ADDRESS 0xFFF8582C /end MEASUREMENT
/begin MEASUREMENT i_eds_kupe "EDS Strom für Kupplung E" UWORD UMR_MA__1_10_0_S6_S3 1 100 0 1200 ECU_ADDRESS 0xFFF8582E /end MEASUREMENT
/begin MEASUREMENT i_eds_k0 "EDS Strom für K0-Trennkupplung" UWORD UMR_MA__1_10_0_S6_S3 1 100 0 1200 ECU_ADDRESS 0xFFF85830 /end MEASUREMENT
/begin MEASUREMENT i_eds_psys "EDS Strom für Systemdruck" UWORD UMR_MA__1_10_0_S6_S3 1 100 0 1200 ECU_ADDRESS 0xFFF85832 /end MEASUREMENT
/begin MEASUREMENT iItfInput.notlauf "FLAG: Notlauftask aktiv" UBYTE Conv.cItfInput._.notlauf_S6_S3 1 100 0 1 BIT_MASK 0x1 DISPLAY_IDENTIFIER notlauf.iItfInput ECU_ADDRESS 0xFFF8BC68 /end MEASUREMENT
/begin MEASUREMENT iItfInput.standby "FLAG: Standbytask aktiv" UBYTE Conv.cItfInput._.standby_S6_S3 1 100 0 1 BIT_MASK 0x1 DISPLAY_IDENTIFIER standby.iItfInput ECU_ADDRESS 0xFFF8BC69 /end MEASUREMENT
/begin MEASUREMENT iItfInput.fahrbetrieb "FLAG: Fahrbetriebstask aktiv" UBYTE Conv.cItfInput._.fahrbetrieb_S6_S3 1 100 0 1 BIT_MASK 0x1 DISPLAY_IDENTIFIER fahrbetrieb.iItfInput ECU_ADDRESS 0xFFF8BC6A /end MEASUREMENT
/begin MEASUREMENT iItfInput.iv_gnotinfo "Eingangsgroesse Notgang Info" UBYTE Conv.cItfInput._.iv_gnotinfo_S6_S3 1 100 0 50 DISPLAY_IDENTIFIER iv_gnotinfo.iItfInput ECU_ADDRESS 0xFFF8BC6B /end MEASUREMENT
/begin MEASUREMENT iItfInput.notgang_info "Notgang Info" UBYTE Conv.cItfInput._.notgang_info_S6_S3 1 100 0 50 DISPLAY_IDENTIFIER notgang_info.iItfInput ECU_ADDRESS 0xFFF8BC6C /end MEASUREMENT
/begin MEASUREMENT iItfInput.notgang "Notgang" SBYTE Conv.cItfInput._.notgang_S6_S3 1 100 -1 8 DISPLAY_IDENTIFIER notgang.iItfInput ECU_ADDRESS 0xFFF8BC6D /end MEASUREMENT
/begin MEASUREMENT iItfInput.iv_edsmversatzinfo "Eingangsgroesse EDSMS-ErsatzInfo" UBYTE Conv.cItfInput._.iv_edsmversatzinfo_S6_S3 1 100 0 7 DISPLAY_IDENTIFIER iv_edsmversatzinfo.iItfInput ECU_ADDRESS 0xFFF8BC6E /end MEASUREMENT
/begin MEASUREMENT iItfInput.iv_fahrbet_task "FLAG: Eingangsgroesse Fahrbetriebstask aktiv" UBYTE Conv.cItfInput._.iv_fahrbet_task_S6_S3 1 100 0 1 BIT_MASK 0x1 DISPLAY_IDENTIFIER iv_fahrbet_task.iItfInput ECU_ADDRESS 0xFFF8BC6F /end MEASUREMENT
/begin MEASUREMENT iItfInput.iv_notltask "FLAG: Eingangsgroesse Notlauftask aktiv" UBYTE Conv.cItfInput._.iv_notltask_S6_S3 1 100 0 1 BIT_MASK 0x1 DISPLAY_IDENTIFIER iv_notltask.iItfInput ECU_ADDRESS 0xFFF8BC70 /end MEASUREMENT
/begin MEASUREMENT iItfInput.iv_sbytask "FLAG: Eingangsgroesse Standbytask aktiv" UBYTE Conv.cItfInput._.iv_sbytask_S6_S3 1 100 0 1 BIT_MASK 0x1 DISPLAY_IDENTIFIER iv_sbytask.iItfInput ECU_ADDRESS 0xFFF8BC71 /end MEASUREMENT
/begin MEASUREMENT iItfInput.iv_cgetr "Getriebetemperatur" UBYTE UMR_GRADC__1_1_M40_S6_S3 1 100 -40 215 DISPLAY_IDENTIFIER iv_cgetr.iItfInput ECU_ADDRESS 0xFFF8BC72 /end MEASUREMENT
/begin MEASUREMENT iItfInput.iv_cmot "Motortemperatur" UBYTE UMR_GRADC__1_1_M48_S6_S3 1 100 -48 207 DISPLAY_IDENTIFIER iv_cmot.iItfInput ECU_ADDRESS 0xFFF8BC73 /end MEASUREMENT
/begin MEASUREMENT iItfInput.iv_cchip "Chiptemperatur" UBYTE UMR_GRADC__1_1_M40_S6_S3 1 100 -40 215 DISPLAY_IDENTIFIER iv_cchip.iItfInput ECU_ADDRESS 0xFFF8BC74 /end MEASUREMENT
/begin MEASUREMENT iItfInput.iv_udrmv "Eingangsgroesse ungefilterte EDS/MV Versorgungsspannung" UWORD UMR_VOLT__1_1000_0_S6_S3 1 100 0 25 DISPLAY_IDENTIFIER iv_udrmv.iItfInput ECU_ADDRESS 0xFFF8BC76 /end MEASUREMENT
/begin MEASUREMENT iItfInput.iv_mmot "Motormoment das von der DME gesendet wird" SWORD UMR_NM__1_1_0_S6_S3 1 100 -400 1640 DISPLAY_IDENTIFIER iv_mmot.iItfInput ECU_ADDRESS 0xFFF8BC78 /end MEASUREMENT
/begin MEASUREMENT iItfInput.iv_mmotist "Eingangsgroesse Kurbelwellenistmoment" SWORD UMR_NM__1_1_0_S6_S3 1 100 -400 1640 DISPLAY_IDENTIFIER iv_mmotist.iItfInput ECU_ADDRESS 0xFFF8BC7A /end MEASUREMENT
/begin MEASUREMENT iItfInput.iv_mmotsoll_in "Eingangsgroesse Motorsollmoment" SWORD UMR_NM__1_1_0_S6_S3 1 100 -400 1640 DISPLAY_IDENTIFIER iv_mmotsoll_in.iItfInput ECU_ADDRESS 0xFFF8BC7C /end MEASUREMENT
/begin MEASUREMENT iItfInput.iv_dki "Eingangsgroesse fuer dki, wenn dki Ersatzgroesse" UBYTE UMR_PROZENT__20_51_0_S6_S3 1 100 0 100 DISPLAY_IDENTIFIER iv_dki.iItfInput ECU_ADDRESS 0xFFF8BC7E /end MEASUREMENT
/begin MEASUREMENT iItfInput.iv_n6 "Drehzahl an der Baugruppe 6" UWORD UMR_U_MIN_1_1_0_S6_S3 1 100 0 65535 DISPLAY_IDENTIFIER iv_n6.iItfInput ECU_ADDRESS 0xFFF8BC80 /end MEASUREMENT
/begin MEASUREMENT iItfInput.iv_nabneu "Abtriebsdrehzahl ungefiltert" UWORD UMR_U_MIN_1_1_0_S6_S3 1 100 0 8160 DISPLAY_IDENTIFIER iv_nabneu.iItfInput ECU_ADDRESS 0xFFF8BC82 /end MEASUREMENT
/begin MEASUREMENT iItfInput.iv_nab_ausvra "Abtriebsdrehzahl gefiltert" UWORD UMR_U_MIN_1_1_0_S6_S3 1 100 0 8160 DISPLAY_IDENTIFIER iv_nab_ausvra.iItfInput ECU_ADDRESS 0xFFF8BC84 /end MEASUREMENT
/begin MEASUREMENT iItfInput.iv_nmot "Motordrehzahl" UWORD UMR_U_MIN_1_1_0_S6_S3 1 100 0 8160 DISPLAY_IDENTIFIER iv_nmot.iItfInput ECU_ADDRESS 0xFFF8BC86 /end MEASUREMENT
/begin MEASUREMENT iItfInput.iv_ntneu "Turbinendrehzahl ungefiltert" UWORD UMR_U_MIN_1_1_0_S6_S3 1 100 0 8160 DISPLAY_IDENTIFIER iv_ntneu.iItfInput ECU_ADDRESS 0xFFF8BC88 /end MEASUREMENT
/begin MEASUREMENT iItfInput.iv_ndiaeneu "Differenzdrehzahl Anfahrelement" SWORD UMR_U_MIN_1_1_0_S6_S3 1 100 -32767 32767 DISPLAY_IDENTIFIER iv_ndiaeneu.iItfInput ECU_ADDRESS 0xFFF8BC8A /end MEASUREMENT
/begin MEASUREMENT iItfInput.verbot_sas_fkt "Verbot SAS Funktionen" UBYTE Conv.cItfInput._.verbot_sas_fkt_S6_S3 1 100 0 1 DISPLAY_IDENTIFIER verbot_sas_fkt.iItfInput ECU_ADDRESS 0xFFF8BC8C /end MEASUREMENT
/begin MEASUREMENT iItfInput.saf_has_aktiv "Schaltanforderung HAS" UBYTE Conv.cItfInput._.saf_has_aktiv_S6_S3 1 100 0 1 DISPLAY_IDENTIFIER saf_has_aktiv.iItfInput ECU_ADDRESS 0xFFF8BC8D /end MEASUREMENT
/begin MEASUREMENT iItfInput.schluesselstart_aktiv "Beeinflussung Befüllreihenfolge der Kupplungen" UBYTE Conv.cItfInput._.schluesselstart_aktiv_S6_S3 1 100 0 1 DISPLAY_IDENTIFIER schluesselstart_aktiv.iItfInput ECU_ADDRESS 0xFFF8BC8E /end MEASUREMENT
/begin MEASUREMENT iItfInput.svh_aktiv_has "Schaltverhinderung bei Schleppstart durch Hybridablaufsteuerung" UBYTE Conv.cItfInput._.svh_aktiv_has_S6_S3 1 100 0 1 DISPLAY_IDENTIFIER svh_aktiv_has.iItfInput ECU_ADDRESS 0xFFF8BC8F /end MEASUREMENT
/begin MEASUREMENT iItfInput.iv_has_aktiv "Flag Ablauf der Ablaufsteuerung Hybrid faeft HAS shift interaction" UBYTE Conv.cItfInput._.iv_has_aktiv_S6_S3 1 100 0 1 DISPLAY_IDENTIFIER iv_has_aktiv.iItfInput ECU_ADDRESS 0xFFF8BC90 /end MEASUREMENT
/begin MEASUREMENT iItfInput.has_aktiv "Flag Ablauf der Ablaufsteuerung Hybrid faeft HAS shift interaction" UBYTE Conv.cItfInput._.has_aktiv_S6_S3 1 100 0 1 DISPLAY_IDENTIFIER has_aktiv.iItfInput ECU_ADDRESS 0xFFF8BC91 /end MEASUREMENT
/begin MEASUREMENT iItfInput.iv_pos "Waehlhebelposition" UBYTE Conv.cItfInput._.iv_pos_S6_S3 1 100 0 8 DISPLAY_IDENTIFIER iv_pos.iItfInput ECU_ADDRESS 0xFFF8BC92 /end MEASUREMENT
/begin MEASUREMENT iItfInput.iv_gsoll "Sollgang" SBYTE Conv.cItfInput._.iv_gsoll_S6_S3 1 100 -1 8 DISPLAY_IDENTIFIER iv_gsoll.iItfInput ECU_ADDRESS 0xFFF8BC93 /end MEASUREMENT
/begin MEASUREMENT iItfInput.iv_blsdefakt "FLAG: Bremslichtschalter aktiv (Default aktiv)" UBYTE Conv.cItfInput._.iv_blsdefakt_S6_S3 1 100 0 1 BIT_MASK 0x1 DISPLAY_IDENTIFIER iv_blsdefakt.iItfInput ECU_ADDRESS 0xFFF8BC94 /end MEASUREMENT
/begin MEASUREMENT iItfInput.iv_blsdefpas "FLAG: Bremslichtschalter aktiv (Default passiv)" UBYTE Conv.cItfInput._.iv_blsdefpas_S6_S3 1 100 0 1 BIT_MASK 0x1 DISPLAY_IDENTIFIER iv_blsdefpas.iItfInput ECU_ADDRESS 0xFFF8BC95 /end MEASUREMENT
/begin MEASUREMENT iItfInput.iv_pbremse "Eingangsgroesse Bremsdruckinformation" SWORD UMR_BAR__1_1_0_S6_S3 1 100 -100 1000 DISPLAY_IDENTIFIER iv_pbremse.iItfInput ECU_ADDRESS 0xFFF8BC96 /end MEASUREMENT
/begin MEASUREMENT iItfInput.iv_feststellbremseaktiv "FLAG: Feststellbremse aktiv (Default passiv)" UBYTE Conv.cItfInput._.iv_feststellbremseaktiv_S6_S3 1 100 0 1 BIT_MASK 0x1 DISPLAY_IDENTIFIER iv_feststellbremseaktiv.iItfInput ECU_ADDRESS 0xFFF8BC98 /end MEASUREMENT
/begin MEASUREMENT iItfInput.iv_el_not_entr "Elektrische Notentriegelung" UBYTE Conv.cItfInput._.iv_el_not_entr_S6_S3 1 100 0 1 BIT_MASK 0x1 DISPLAY_IDENTIFIER iv_el_not_entr.iItfInput ECU_ADDRESS 0xFFF8BC99 /end MEASUREMENT
/begin MEASUREMENT iItfInput.iv_druck_vorhanden_mod "Anforderung Kupplungsbefüllung zu starten, obwohl lt. Modellierung kein Pumpendruck vorhanden ist" UBYTE Conv.cItfInput._.iv_druck_vorhanden_mod_S6_S3 1 100 0 1 BIT_MASK 0x1 DISPLAY_IDENTIFIER iv_druck_vorhanden_mod.iItfInput ECU_ADDRESS 0xFFF8BC9A /end MEASUREMENT
/begin MEASUREMENT iItfInput.iv_anhaengeraktiv "FLAG: Anhaengerbetrieb aktiv" UBYTE Conv.cItfInput._.iv_anhaengeraktiv_S6_S3 1 100 0 1 BIT_MASK 0x1 DISPLAY_IDENTIFIER iv_anhaengeraktiv.iItfInput ECU_ADDRESS 0xFFF8BC9B /end MEASUREMENT
/begin MEASUREMENT iItfInput.iv_transportmode_aktiv "Transportmode nicht aktiv oder aktiv" UBYTE Conv.cItfInput._.iv_transportmode_aktiv_S6_S3 1 100 0 1 BIT_MASK 0x1 DISPLAY_IDENTIFIER iv_transportmode_aktiv.iItfInput ECU_ADDRESS 0xFFF8BC9C /end MEASUREMENT
/begin MEASUREMENT iItfInput.iv_dkpedal "Drosselklappe Pedalstellung" UBYTE UMR_PROZENT__20_51_0_S6_S3 1 100 0 100 DISPLAY_IDENTIFIER iv_dkpedal.iItfInput ECU_ADDRESS 0xFFF8BC9D /end MEASUREMENT
/begin MEASUREMENT iItfInput.iv_indexspsps "Index Spontanitaet Schaltpunktsteuerung aktiv" UBYTE UMR___1_1_0_S6_S3 1 100 0 255 DISPLAY_IDENTIFIER iv_indexspsps.iItfInput ECU_ADDRESS 0xFFF8BC9E /end MEASUREMENT
/begin MEASUREMENT iItfInput.iv_nmotsolleer "Motorleerlaufsolldrehzahl" UWORD UMR_U_MIN_1_1_0_S6_S3 1 100 0 8160 DISPLAY_IDENTIFIER iv_nmotsolleer.iItfInput ECU_ADDRESS 0xFFF8BCA0 /end MEASUREMENT
/begin MEASUREMENT iItfInput.iv_nmotabregel "Eingangsgroesse Motorabregeldrehzahl" UWORD UMR_U_MIN_1_1_0_S6_S3 1 100 0 10000 DISPLAY_IDENTIFIER iv_nmotabregel.iItfInput ECU_ADDRESS 0xFFF8BCA2 /end MEASUREMENT
/begin MEASUREMENT iItfInput.iv_ascreg "FLAG: ASC regelt" UBYTE Conv.cItfInput._.iv_ascreg_S6_S3 1 100 0 1 BIT_MASK 0x1 DISPLAY_IDENTIFIER iv_ascreg.iItfInput ECU_ADDRESS 0xFFF8BCA4 /end MEASUREMENT
/begin MEASUREMENT iItfInput.iv_ascpas "FLAG: Eingangsgroesse ASC funktional abgeschaltet" UBYTE Conv.cItfInput._.iv_ascpas_S6_S3 1 100 0 1 BIT_MASK 0x1 DISPLAY_IDENTIFIER iv_ascpas.iItfInput ECU_ADDRESS 0xFFF8BCA5 /end MEASUREMENT
/begin MEASUREMENT iItfInput.iv_pssensorsignal "Erfasstes Sensorsignal der Parksperre" UBYTE Conv.cItfInput._.iv_pssensorsignal_S6_S3 1 100 0 3 DISPLAY_IDENTIFIER iv_pssensorsignal.iItfInput ECU_ADDRESS 0xFFF8BCA6 /end MEASUREMENT
/begin MEASUREMENT iItfInput.iv_pssensorsignal_status "Status, Erfasstes Sensorsignal der Parksperre" UBYTE Conv.cItfInput._.iv_pssensorsignal_status_S6_S3 1 100 0 2 DISPLAY_IDENTIFIER iv_pssensorsignal_status.iItfInput ECU_ADDRESS 0xFFF8BCA7 /end MEASUREMENT
/begin MEASUREMENT iItfInput.iv_atsys_ee_busy "EEPROM Atsys Adaptionsdaten schreiben laeuft" UBYTE UMR___1_1_0_S6_S3 1 100 0 255 DISPLAY_IDENTIFIER iv_atsys_ee_busy.iItfInput ECU_ADDRESS 0xFFF8BCA8 /end MEASUREMENT
/begin MEASUREMENT iItfInput.iv_statistics_ee_busy "EEPROM Atsys Getriebemonitoringdaten schreiben laeuft" UBYTE UMR___1_1_0_S6_S3 1 100 0 255 DISPLAY_IDENTIFIER iv_statistics_ee_busy.iItfInput ECU_ADDRESS 0xFFF8BCA9 /end MEASUREMENT
/begin MEASUREMENT iItfInput.iv_progauswahl "Programmauswahl Sport/Manuell/Tipp/L-Programm" UBYTE UMR___1_1_0_S6_S3 1 100 0 8 DISPLAY_IDENTIFIER iv_progauswahl.iItfInput ECU_ADDRESS 0xFFF8BCAA /end MEASUREMENT
/begin MEASUREMENT iItfInput.manuell "FLAG: Steptronicbetrieb" UBYTE Conv.cItfInput._.manuell_S6_S3 1 100 0 1 BIT_MASK 0x1 DISPLAY_IDENTIFIER manuell.iItfInput ECU_ADDRESS 0xFFF8BCAB /end MEASUREMENT
/begin MEASUREMENT iItfInput.iv_zzuendung "Zustand der Zuendung (KL15!)" UBYTE Conv.cItfInput._.iv_zzuendung_S6_S3 1 100 0 4 DISPLAY_IDENTIFIER iv_zzuendung.iItfInput ECU_ADDRESS 0xFFF8BCAC /end MEASUREMENT
/begin MEASUREMENT iItfInput.z_zuendung "Zustand der Zuendung (KL15!)" UBYTE Conv.cItfInput._.z_zuendung_S6_S3 1 100 0 4 DISPLAY_IDENTIFIER z_zuendung.iItfInput ECU_ADDRESS 0xFFF8BCAD /end MEASUREMENT
/begin MEASUREMENT iItfInput.iv_neigung "Eingangsgroesse Neigungssensor-Signal" UBYTE UMR_GRAD__1_3_M128_S6_S3 1 100 -42.6666666667 42 DISPLAY_IDENTIFIER iv_neigung.iItfInput ECU_ADDRESS 0xFFF8BCAE /end MEASUREMENT
/begin MEASUREMENT iItfInput.iv_getrbetriebszeit "Betriebsstundenzaehler Getriebebetriebszeit (Cruisetask) in 1 min" ULONG UMR_MIN__1_1_0_S6_S3 1 100 0 65535 DISPLAY_IDENTIFIER iv_getrbetriebszeit.iItfInput ECU_ADDRESS 0xFFF8BCB0 /end MEASUREMENT
/begin MEASUREMENT iItfInput.iv_fzggeschwindigkeit "Eingangssignal Fahrzeuggeschwindigkeit (aus Abtrieb berechnet)" UWORD UMR_KM_H_1_1_0_S6_S3 1 100 0 400 DISPLAY_IDENTIFIER iv_fzggeschwindigkeit.iItfInput ECU_ADDRESS 0xFFF8BCB4 /end MEASUREMENT
/begin MEASUREMENT iItfInput.iv_rad_geschw_vorne_links "Eingangssignal Radgeschwindigkeit links vorne" UWORD UMR_KM_H_1_16_0_S6_S3 1 100 0 4095.9375 DISPLAY_IDENTIFIER iv_rad_geschw_vorne_links.iItfInput ECU_ADDRESS 0xFFF8BCB6 /end MEASUREMENT
/begin MEASUREMENT iItfInput.iv_rad_geschw_vorne_rechts "Eingangssignal Radgeschwindigkeit rechts vorne" UWORD UMR_KM_H_1_16_0_S6_S3 1 100 0 4095.9375 DISPLAY_IDENTIFIER iv_rad_geschw_vorne_rechts.iItfInput ECU_ADDRESS 0xFFF8BCB8 /end MEASUREMENT
/begin MEASUREMENT iItfInput.iv_rad_geschw_hinten_links "Eingangssignal Radgeschwindigkeit links hinten" UWORD UMR_KM_H_1_16_0_S6_S3 1 100 0 4095.9375 DISPLAY_IDENTIFIER iv_rad_geschw_hinten_links.iItfInput ECU_ADDRESS 0xFFF8BCBA /end MEASUREMENT
/begin MEASUREMENT iItfInput.iv_rad_geschw_hinten_rechts "Eingangssignal Radgeschwindigkeit rechts hinten" UWORD UMR_KM_H_1_16_0_S6_S3 1 100 0 4095.9375 DISPLAY_IDENTIFIER iv_rad_geschw_hinten_rechts.iItfInput ECU_ADDRESS 0xFFF8BCBC /end MEASUREMENT
/begin MEASUREMENT iItfInput.freigabe_posvdiag "Flag fuer die Freigabe von der position ventil Ueberwachung" UBYTE Conv.cItfInput._.freigabe_posvdiag_S6_S3 1 100 0 1 BIT_MASK 0x1 DISPLAY_IDENTIFIER freigabe_posvdiag.iItfInput ECU_ADDRESS 0xFFF8BCBE /end MEASUREMENT
/begin MEASUREMENT iItfInput.iv_freigabe_posvdiag "Flag fuer die Freigabe von der position ventil Ueberwachung" UBYTE Conv.cItfInput._.iv_freigabe_posvdiag_S6_S3 1 100 0 1 BIT_MASK 0x1 DISPLAY_IDENTIFIER iv_freigabe_posvdiag.iItfInput ECU_ADDRESS 0xFFF8BCBF /end MEASUREMENT
/begin MEASUREMENT iItfInput.iv_codierungnic "NIC Codierungssignal" UBYTE UMR___1_1_0_S6_S3 1 100 0 255 DISPLAY_IDENTIFIER iv_codierungnic.iItfInput ECU_ADDRESS 0xFFF8BCC0 /end MEASUREMENT
/begin MEASUREMENT iItfInput.iv_posstatus "Eingangsgroesse Statussignal zum Positionshebel pos" UBYTE Conv.cItfInput._.iv_posstatus_S6_S3 1 100 0 2 DISPLAY_IDENTIFIER iv_posstatus.iItfInput ECU_ADDRESS 0xFFF8BCC1 /end MEASUREMENT
/begin MEASUREMENT iItfInput.iv_nabstatus "Eingangsgroesse Statussignal Abtriebdrehzahl" UBYTE Conv.cItfInput._.iv_nabstatus_S6_S3 1 100 0 2 DISPLAY_IDENTIFIER iv_nabstatus.iItfInput ECU_ADDRESS 0xFFF8BCC2 /end MEASUREMENT
/begin MEASUREMENT iItfInput.iv_ntstatus "Eingangsgroesse Statussignal Turbinendrehzahl" UBYTE Conv.cItfInput._.iv_ntstatus_S6_S3 1 100 0 2 DISPLAY_IDENTIFIER iv_ntstatus.iItfInput ECU_ADDRESS 0xFFF8BCC3 /end MEASUREMENT
/begin MEASUREMENT iItfInput.iv_nmotstatus "Eingangsgroesse Statussignal Motordrehzahl" UBYTE Conv.cItfInput._.iv_nmotstatus_S6_S3 1 100 0 2 DISPLAY_IDENTIFIER iv_nmotstatus.iItfInput ECU_ADDRESS 0xFFF8BCC4 /end MEASUREMENT
/begin MEASUREMENT iItfInput.iv_mmotstatus "Eingangsgroesse Statussignal Motormoment" UBYTE Conv.cItfInput._.iv_mmotstatus_S6_S3 1 100 0 2 DISPLAY_IDENTIFIER iv_mmotstatus.iItfInput ECU_ADDRESS 0xFFF8BCC5 /end MEASUREMENT
/begin MEASUREMENT iItfInput.iv_cgetrstatus "Eingangsgroesse Statussignal Getriebetemperatur" UBYTE Conv.cItfInput._.iv_cgetrstatus_S6_S3 1 100 0 2 DISPLAY_IDENTIFIER iv_cgetrstatus.iItfInput ECU_ADDRESS 0xFFF8BCC6 /end MEASUREMENT
/begin MEASUREMENT iItfInput.iv_neigungstatus "Eingangsgroesse Statussignal zu Neigungssensorsignal" UBYTE Conv.cItfInput._.iv_neigungstatus_S6_S3 1 100 0 2 DISPLAY_IDENTIFIER iv_neigungstatus.iItfInput ECU_ADDRESS 0xFFF8BCC7 /end MEASUREMENT
/begin MEASUREMENT iItfInput.iv_bstimer "Betriebssystemtimer im 1ms Raster" UWORD UMR___1_1_0_S6_S3 1 100 0 65535 DISPLAY_IDENTIFIER iv_bstimer.iItfInput ECU_ADDRESS 0xFFF8BCC8 /end MEASUREMENT
/begin MEASUREMENT iItfInput.m_t "Turbinenmoment" SWORD UMR_NM__1_1_0_S6_S3 1 100 -400 1640 DISPLAY_IDENTIFIER m_t.iItfInput ECU_ADDRESS 0xFFF8BCCA /end MEASUREMENT
/begin MEASUREMENT iItfInput.m_mot "Motormoment entweder aus von DME oder Sensor" SWORD UMR_NM__1_1_0_S6_S3 1 100 -400 1640 DISPLAY_IDENTIFIER m_mot.iItfInput ECU_ADDRESS 0xFFF8BCCC /end MEASUREMENT
/begin MEASUREMENT iItfInput.m_motist "Kurbelwellenistmoment" SWORD UMR_NM__1_1_0_S6_S3 1 100 -400 1640 DISPLAY_IDENTIFIER m_motist.iItfInput ECU_ADDRESS 0xFFF8BCCE /end MEASUREMENT
/begin MEASUREMENT iItfInput.m_motsoll "Motor Sollmoment" SWORD UMR_NM__1_1_0_S6_S3 1 100 -400 1640 DISPLAY_IDENTIFIER m_motsoll.iItfInput ECU_ADDRESS 0xFFF8BCD0 /end MEASUREMENT
/begin MEASUREMENT iItfInput.m_t8 "Turbinenmoment (8-Bit)" UBYTE UMR_NM__8_1_M50_S6_S3 1 100 -400 1640 DISPLAY_IDENTIFIER m_t8.iItfInput ECU_ADDRESS 0xFFF8BCD2 /end MEASUREMENT
/begin MEASUREMENT iItfInput.m_motkor "korrigiertes Motormoment" SWORD UMR_NM__1_1_0_S6_S3 1 100 -400 1640 DISPLAY_IDENTIFIER m_motkor.iItfInput ECU_ADDRESS 0xFFF8BCD4 /end MEASUREMENT
/begin MEASUREMENT iItfInput.m_motkor_in "korrigiertes Motormoment Zwischengroesse" SWORD UMR_NM__1_1_0_S6_S3 1 100 -400 1640 DISPLAY_IDENTIFIER m_motkor_in.iItfInput ECU_ADDRESS 0xFFF8BCD6 /end MEASUREMENT
/begin MEASUREMENT iItfInput.m_motsoll_in "Motor Sollmoment Eingangsgroesse" SWORD UMR_NM__1_1_0_S6_S3 1 100 -400 1640 DISPLAY_IDENTIFIER m_motsoll_in.iItfInput ECU_ADDRESS 0xFFF8BCD8 /end MEASUREMENT
/begin MEASUREMENT iItfInput.n_ab "Abtriebsdrehzahl gefiltert" UWORD UMR_U_MIN_1_1_0_S6_S3 1 100 0 8160 DISPLAY_IDENTIFIER n_ab.iItfInput ECU_ADDRESS 0xFFF8BCDA /end MEASUREMENT
/begin MEASUREMENT iItfInput.n_t "Turbinendrehzahl gefiltert" UWORD UMR_U_MIN_1_1_0_S6_S3 1 100 0 8160 DISPLAY_IDENTIFIER n_t.iItfInput ECU_ADDRESS 0xFFF8BCDC /end MEASUREMENT
/begin MEASUREMENT iItfInput.init_n_t "Init Merker von Turbinendrehzahl gefiltert" UBYTE Conv.cItfInput._.init_n_t_S6_S3 1 100 0 1 BIT_MASK 0x1 DISPLAY_IDENTIFIER init_n_t.iItfInput ECU_ADDRESS 0xFFF8BCDE /end MEASUREMENT
/begin MEASUREMENT iItfInput.init_n_abneu_gef "Init Merker von Abtriebsdrehzahl gefiltert" UBYTE Conv.cItfInput._.init_n_abneu_gef_S6_S3 1 100 0 1 BIT_MASK 0x1 DISPLAY_IDENTIFIER init_n_abneu_gef.iItfInput ECU_ADDRESS 0xFFF8BCDF /end MEASUREMENT
/begin MEASUREMENT iItfInput.n_t8 "Turbinendrehzahl (8-Bit)" UBYTE UMR_U_MIN_32_1_0_S6_S3 1 100 0 8160 DISPLAY_IDENTIFIER n_t8.iItfInput ECU_ADDRESS 0xFFF8BCE0 /end MEASUREMENT
/begin MEASUREMENT iItfInput.n_mot8 "Motordrehzahl (8-Bit)" UBYTE UMR_U_MIN_32_1_0_S6_S3 1 100 0 8160 DISPLAY_IDENTIFIER n_mot8.iItfInput ECU_ADDRESS 0xFFF8BCE1 /end MEASUREMENT
/begin MEASUREMENT iItfInput.n_ab8 "Abtriebsdrehzahl (8-Bit)" UBYTE UMR_U_MIN_32_1_0_S6_S3 1 100 0 8160 DISPLAY_IDENTIFIER n_ab8.iItfInput ECU_ADDRESS 0xFFF8BCE2 /end MEASUREMENT
/begin MEASUREMENT iItfInput.nd_iaeneu "Differenzdrehzahl Anfahrelement" SWORD UMR_U_MIN_1_1_0_S6_S3 1 100 -32767 32767 DISPLAY_IDENTIFIER nd_iaeneu.iItfInput ECU_ADDRESS 0xFFF8BCE4 /end MEASUREMENT
/begin MEASUREMENT iItfInput.ng_ab "Gradient Abtriebsdrehzahl" SWORD UMR_U_MINSEC_1_1_0_S6_S3 1 100 -1000 1000 DISPLAY_IDENTIFIER ng_ab.iItfInput ECU_ADDRESS 0xFFF8BCE6 /end MEASUREMENT
/begin MEASUREMENT iItfInput.ng_t "Gradient Turbinendrehzahl" SWORD UMR_U_MINSEC_1_1_0_S6_S3 1 100 -1000 1000 DISPLAY_IDENTIFIER ng_t.iItfInput ECU_ADDRESS 0xFFF8BCE8 /end MEASUREMENT
/begin MEASUREMENT iItfInput.ng_mot "Gradient Motordrehzahl" SWORD UMR_U_MINSEC_1_1_0_S6_S3 1 100 -10000 10000 DISPLAY_IDENTIFIER ng_mot.iItfInput ECU_ADDRESS 0xFFF8BCEA /end MEASUREMENT
/begin MEASUREMENT iItfInput.nue "Drehzahlverhaeltins n_t zu n_mot" SWORD UMR___1_1000_0_S6_S3 1 100 0 10 DISPLAY_IDENTIFIER nue.iItfInput ECU_ADDRESS 0xFFF8BCEC /end MEASUREMENT
/begin MEASUREMENT iItfInput.nueg "Gradient von nue" SWORD UMR__SEC_1_1000_0_S6_S3 1 100 -1 1 DISPLAY_IDENTIFIER nueg.iItfInput ECU_ADDRESS 0xFFF8BCEE /end MEASUREMENT
/begin MEASUREMENT iItfInput.n6 "Drehzahl an der Baugruppe 6" UWORD UMR_U_MIN_1_1_0_S6_S3 1 100 0 65535 DISPLAY_IDENTIFIER n6.iItfInput ECU_ADDRESS 0xFFF8BCF0 /end MEASUREMENT
/begin MEASUREMENT iItfInput.n_abneu "Abtriebsdrehzahl ungefiltert" UWORD UMR_U_MIN_1_1_0_S6_S3 1 100 0 8160 DISPLAY_IDENTIFIER n_abneu.iItfInput ECU_ADDRESS 0xFFF8BCF2 /end MEASUREMENT
/begin MEASUREMENT iItfInput.nab_ausvra "Abtriebsdrehzahl gefiltert" UWORD UMR_U_MIN_1_1_0_S6_S3 1 100 0 8160 DISPLAY_IDENTIFIER nab_ausvra.iItfInput ECU_ADDRESS 0xFFF8BCF4 /end MEASUREMENT
/begin MEASUREMENT iItfInput.n_tneu "Turbinendrehzahl ungefiltert" UWORD UMR_U_MIN_1_1_0_S6_S3 1 100 0 8160 DISPLAY_IDENTIFIER n_tneu.iItfInput ECU_ADDRESS 0xFFF8BCF6 /end MEASUREMENT
/begin MEASUREMENT iItfInput.n_mot "Motordrehzahl" UWORD UMR_U_MIN_1_1_0_S6_S3 1 100 0 8160 DISPLAY_IDENTIFIER n_mot.iItfInput ECU_ADDRESS 0xFFF8BCF8 /end MEASUREMENT
/begin MEASUREMENT iItfInput.n_motabregel "Motorabregeldrehzahl" UWORD UMR_U_MIN_1_1_0_S6_S3 1 100 0 10000 DISPLAY_IDENTIFIER n_motabregel.iItfInput ECU_ADDRESS 0xFFF8BCFA /end MEASUREMENT
/begin MEASUREMENT iItfInput.c_getr "Getriebetemperatur" UBYTE UMR_GRADC__1_1_M40_S6_S3 1 100 -40 215 DISPLAY_IDENTIFIER c_getr.iItfInput ECU_ADDRESS 0xFFF8BCFC /end MEASUREMENT
/begin MEASUREMENT iItfInput.c_mot "Motortemperatur" UBYTE UMR_GRADC__1_1_M48_S6_S3 1 100 -48 207 DISPLAY_IDENTIFIER c_mot.iItfInput ECU_ADDRESS 0xFFF8BCFD /end MEASUREMENT
/begin MEASUREMENT iItfInput.c_chip "Chiptemperatur" UBYTE UMR_GRADC__1_1_M40_S6_S3 1 100 -40 215 DISPLAY_IDENTIFIER c_chip.iItfInput ECU_ADDRESS 0xFFF8BCFE /end MEASUREMENT
/begin MEASUREMENT iItfInput.u_drmv "ungefilterte EDS/MV Versorgungsspannung" UWORD UMR_VOLT__1_1000_0_S6_S3 1 100 0 25 DISPLAY_IDENTIFIER u_drmv.iItfInput ECU_ADDRESS 0xFFF8BD00 /end MEASUREMENT
/begin MEASUREMENT iItfInput.dki "Drosselklappenistwert" UBYTE UMR_PROZENT__20_51_0_S6_S3 1 100 0 100 DISPLAY_IDENTIFIER dki.iItfInput ECU_ADDRESS 0xFFF8BD02 /end MEASUREMENT
/begin MEASUREMENT iItfInput.dk_pedal "Drosselklappe Pedalstellung" UBYTE UMR_PROZENT__20_51_0_S6_S3 1 100 0 100 DISPLAY_IDENTIFIER dk_pedal.iItfInput ECU_ADDRESS 0xFFF8BD03 /end MEASUREMENT
/begin MEASUREMENT iItfInput.dkig "Gradient Drosselklappenistwert" SWORD UMR_PROZENT_SEC_20_51_0_S6_S3 1 100 -12849.8039216 12849.8039216 DISPLAY_IDENTIFIER dkig.iItfInput ECU_ADDRESS 0xFFF8BD04 /end MEASUREMENT
/begin MEASUREMENT iItfInput.pos "Waehlhebelposition" UBYTE Conv.cItfInput._.pos_S6_S3 1 100 0 8 DISPLAY_IDENTIFIER pos.iItfInput ECU_ADDRESS 0xFFF8BD06 /end MEASUREMENT
/begin MEASUREMENT iItfInput.pos_wunsch "Waehlhebelposition Fahrerwunsch (ohne Manipulation)" UBYTE Conv.cItfInput._.pos_wunsch_S6_S3 1 100 0 8 DISPLAY_IDENTIFIER pos_wunsch.iItfInput ECU_ADDRESS 0xFFF8BD07 /end MEASUREMENT
/begin MEASUREMENT iItfInput.ps_sensor_signal "Erfasstes Sensorsignal der Parksperre" UBYTE UMR___1_1_0_S6_S3 1 100 0 3 DISPLAY_IDENTIFIER ps_sensor_signal.iItfInput ECU_ADDRESS 0xFFF8BD08 /end MEASUREMENT
/begin MEASUREMENT iItfInput.pssensorsignal_status "Status, Erfasstes Sensorsignal der Parksperre" UBYTE Conv.cItfInput._.pssensorsignal_status_S6_S3 1 100 0 2 DISPLAY_IDENTIFIER pssensorsignal_status.iItfInput ECU_ADDRESS 0xFFF8BD09 /end MEASUREMENT
/begin MEASUREMENT iItfInput.iv_eng_red_limit "Eingang: Maximal moeglicher Me von DME auf Zuendwinkel von Moteingriffklassifizierung" SWORD UMR_NM__1_1_0_S6_S3 1 100 -32768 32767 DISPLAY_IDENTIFIER iv_eng_red_limit.iItfInput ECU_ADDRESS 0xFFF8BD0A /end MEASUREMENT
/begin MEASUREMENT iItfInput.eng_red_limit "Maximal moeglicher Me von DME auf Zuendwinkel von Moteingriffklassifizierung" SWORD UMR_NM__1_1_0_S6_S3 1 100 -32768 32767 DISPLAY_IDENTIFIER eng_red_limit.iItfInput ECU_ADDRESS 0xFFF8BD0C /end MEASUREMENT
/begin MEASUREMENT iItfInput.iv_abs_reg_status "Status des ABS" UBYTE Conv.cItfInput._.iv_abs_reg_status_S6_S3 1 100 0 2 DISPLAY_IDENTIFIER iv_abs_reg_status.iItfInput ECU_ADDRESS 0xFFF8BD0E /end MEASUREMENT
/begin MEASUREMENT iItfInput.abs_reg_status "Status des ABS" UBYTE Conv.cItfInput._.abs_reg_status_S6_S3 1 100 0 2 DISPLAY_IDENTIFIER abs_reg_status.iItfInput ECU_ADDRESS 0xFFF8BD0F /end MEASUREMENT
/begin MEASUREMENT iItfInput.sollgang "Sollgang" SBYTE Conv.cItfInput._.sollgang_S6_S3 1 100 -1 8 DISPLAY_IDENTIFIER sollgang.iItfInput ECU_ADDRESS 0xFFF8BD10 /end MEASUREMENT
/begin MEASUREMENT iItfInput.n_mot_solleer "Motorleerlaufsolldrehzahl" UWORD UMR_U_MIN_1_1_0_S6_S3 1 100 0 8160 DISPLAY_IDENTIFIER n_mot_solleer.iItfInput ECU_ADDRESS 0xFFF8BD12 /end MEASUREMENT
/begin MEASUREMENT iItfInput.m_max_dyn_em "Maximales kurzzeitig mögliches EM Moment" SWORD UMR_NM__1_1_0_S6_S3 1 100 -1024 1024 DISPLAY_IDENTIFIER m_max_dyn_em.iItfInput ECU_ADDRESS 0xFFF8BD14 /end MEASUREMENT
/begin MEASUREMENT iItfInput.m_min_dyn_em "Minimal kurzzeitig mögliches EM Moment" SWORD UMR_NM__1_1_0_S6_S3 1 100 -1024 1024 DISPLAY_IDENTIFIER m_min_dyn_em.iItfInput ECU_ADDRESS 0xFFF8BD16 /end MEASUREMENT
/begin MEASUREMENT iItfInput.m_emist "E-Maschinenistmoment mit Getriebeeingriff" SWORD UMR_NM__1_1_0_S6_S3 1 100 -1024 1024 DISPLAY_IDENTIFIER m_emist.iItfInput ECU_ADDRESS 0xFFF8BD18 /end MEASUREMENT
/begin MEASUREMENT iItfInput.m_emsoll "E-Maschinensollmoment mit Getriebeeingriff" SWORD UMR_NM__1_1_0_S6_S3 1 100 -1024 1024 DISPLAY_IDENTIFIER m_emsoll.iItfInput ECU_ADDRESS 0xFFF8BD1A /end MEASUREMENT
/begin MEASUREMENT iItfInput.modus_em "E-Maschienenmoment Betriebszustand 0...15" UBYTE UMR___1_1_0_S6_S3 1 100 0 15 DISPLAY_IDENTIFIER modus_em.iItfInput ECU_ADDRESS 0xFFF8BD1C /end MEASUREMENT
/begin MEASUREMENT iItfInput.m_vmist "Verbrennungsmotoristmoment mit Getriebeeingriff" SWORD UMR_NM__1_1_0_S6_S3 1 100 -2000 2000 DISPLAY_IDENTIFIER m_vmist.iItfInput ECU_ADDRESS 0xFFF8BD1E /end MEASUREMENT
/begin MEASUREMENT iItfInput.m_vmsoll "Verbrennungsmotorsollmoment mit Getriebeeingriff" SWORD UMR_NM__1_1_0_S6_S3 1 100 -2000 2000 DISPLAY_IDENTIFIER m_vmsoll.iItfInput ECU_ADDRESS 0xFFF8BD20 /end MEASUREMENT
/begin MEASUREMENT iItfInput.n_vm "Verbrennungsmotoristdrehzahl" UWORD UMR_U_MIN_1_1_0_S6_S3 1 100 0 8000 DISPLAY_IDENTIFIER n_vm.iItfInput ECU_ADDRESS 0xFFF8BD22 /end MEASUREMENT
/begin MEASUREMENT iItfInput.k0_soll "K0 Sollzustand von der Hybrid-Ablauf-Steuerung" UBYTE Conv.cItfInput._.k0_soll_S6_S3 1 100 0 5 DISPLAY_IDENTIFIER k0_soll.iItfInput ECU_ADDRESS 0xFFF8BD24 /end MEASUREMENT
/begin MEASUREMENT iItfInput.n_vm_status "Status Drehzahl VM" UBYTE Conv.cItfInput._.n_vm_status_S6_S3 1 100 0 2 DISPLAY_IDENTIFIER n_vm_status.iItfInput ECU_ADDRESS 0xFFF8BD25 /end MEASUREMENT
/begin MEASUREMENT iItfInput.z_k0_soll_subst "K0- Sollzustand für Notprogramm aus der Hybrid-Ablauf-Steuerung" UBYTE Conv.cItfInput._.z_k0_soll_subst_S6_S3 1 100 0 3 DISPLAY_IDENTIFIER z_k0_soll_subst.iItfInput ECU_ADDRESS 0xFFF8BD26 /end MEASUREMENT
/begin MEASUREMENT iItfInput.z_k0_befuellopt "Anforderung an die Art der Kupplungsbefüllung der K0" UBYTE Conv.cItfInput._.z_k0_befuellopt_S6_S3 1 100 0 2 DISPLAY_IDENTIFIER z_k0_befuellopt.iItfInput ECU_ADDRESS 0xFFF8BD27 /end MEASUREMENT
/begin MEASUREMENT iItfInput.m_soll_k0_has "HAS Momentenvorgabe" SWORD UMR_NM__1_1_0_S6_S3 1 100 0 800 DISPLAY_IDENTIFIER m_soll_k0_has.iItfInput ECU_ADDRESS 0xFFF8BD28 /end MEASUREMENT
/begin MEASUREMENT iItfInput.mg_soll_k0_neg_has "Negative Drehmomentänderungen K0" SWORD UMR_NM_SEC_1_1_0_S6_S3 1 100 -10000 0 DISPLAY_IDENTIFIER mg_soll_k0_neg_has.iItfInput ECU_ADDRESS 0xFFF8BD2A /end MEASUREMENT
/begin MEASUREMENT iItfInput.mg_soll_k0_pos_has "Positive Drehmomentänderungen" SWORD UMR_NM_SEC_1_1_0_S6_S3 1 100 0 10000 DISPLAY_IDENTIFIER mg_soll_k0_pos_has.iItfInput ECU_ADDRESS 0xFFF8BD2C /end MEASUREMENT
/begin MEASUREMENT iItfInput.flag_p_hys_k0_has "Flag zur Aktivierung/Deaktivierung des Druckanteils p_hys_k0 zur Hysteresekompensation" UBYTE Conv.cItfInput._.flag_p_hys_k0_has_S6_S3 1 100 0 1 BIT_MASK 0x1 DISPLAY_IDENTIFIER flag_p_hys_k0_has.iItfInput ECU_ADDRESS 0xFFF8BD2E /end MEASUREMENT
/begin MEASUREMENT iItfInput.mvg_vm_start "Startart der VM" UBYTE Conv.cItfInput._.mvg_vm_start_S6_S3 1 100 0 8 DISPLAY_IDENTIFIER mvg_vm_start.iItfInput ECU_ADDRESS 0xFFF8BD2F /end MEASUREMENT
/begin MEASUREMENT iItfInput.iv_mvg_vm_start "Startart der VM" UBYTE Conv.cItfInput._.iv_mvg_vm_start_S6_S3 1 100 0 8 DISPLAY_IDENTIFIER iv_mvg_vm_start.iItfInput ECU_ADDRESS 0xFFF8BD30 /end MEASUREMENT
/begin MEASUREMENT iItfInput.pt_damping_active "Information, if the power train damping is active or not active" UBYTE Conv.cItfInput._.pt_damping_active_S6_S3 1 100 0 1 DISPLAY_IDENTIFIER pt_damping_active.iItfInput ECU_ADDRESS 0xFFF8BD31 /end MEASUREMENT
/begin MEASUREMENT iItfInput.iv_pt_damping_active "Information, if the power train damping is active or not active" UBYTE Conv.cItfInput._.iv_pt_damping_active_S6_S3 1 100 0 1 DISPLAY_IDENTIFIER iv_pt_damping_active.iItfInput ECU_ADDRESS 0xFFF8BD32 /end MEASUREMENT
/begin MEASUREMENT iItfInput.iv_m_emist "E-Maschinen Istmoment" SWORD UMR_NM__1_1_0_S6_S3 1 100 -1024 1024 DISPLAY_IDENTIFIER iv_m_emist.iItfInput ECU_ADDRESS 0xFFF8BD34 /end MEASUREMENT
/begin MEASUREMENT iItfInput.iv_m_emsoll "E-Maschinensollmoment mit Getriebeeingriff" SWORD UMR_NM__1_1_0_S6_S3 1 100 -1024 1024 DISPLAY_IDENTIFIER iv_m_emsoll.iItfInput ECU_ADDRESS 0xFFF8BD36 /end MEASUREMENT
/begin MEASUREMENT iItfInput.iv_m_max_dyn_em "Maximales kurzzeitig mögliches EM Moment" SWORD UMR_NM__1_1_0_S6_S3 1 100 -1024 1024 DISPLAY_IDENTIFIER iv_m_max_dyn_em.iItfInput ECU_ADDRESS 0xFFF8BD38 /end MEASUREMENT
/begin MEASUREMENT iItfInput.iv_m_min_dyn_em "Minimal kurzzeitig mögliches EM Moment" SWORD UMR_NM__1_1_0_S6_S3 1 100 -1024 1024 DISPLAY_IDENTIFIER iv_m_min_dyn_em.iItfInput ECU_ADDRESS 0xFFF8BD3A /end MEASUREMENT
/begin MEASUREMENT iItfInput.iv_modus_em "E-Maschienenmoment Betriebszustand 0...15" UBYTE UMR___1_1_0_S6_S3 1 100 0 15 DISPLAY_IDENTIFIER iv_modus_em.iItfInput ECU_ADDRESS 0xFFF8BD3C /end MEASUREMENT
/begin MEASUREMENT iItfInput.iv_m_vmist "Verbrennungsmotoristmoment mit Getriebeeingriff" SWORD UMR_NM__1_1_0_S6_S3 1 100 -2000 2000 DISPLAY_IDENTIFIER iv_m_vmist.iItfInput ECU_ADDRESS 0xFFF8BD3E /end MEASUREMENT
/begin MEASUREMENT iItfInput.iv_m_vmsoll "Verbrennungsmotorsollmoment mit Getriebeeingriff" SWORD UMR_NM__1_1_0_S6_S3 1 100 -2000 2000 DISPLAY_IDENTIFIER iv_m_vmsoll.iItfInput ECU_ADDRESS 0xFFF8BD40 /end MEASUREMENT
/begin MEASUREMENT iItfInput.iv_n_vm "Verbrennungsmotoristdrehzahl" UWORD UMR_U_MIN_1_1_0_S6_S3 1 100 0 8000 DISPLAY_IDENTIFIER iv_n_vm.iItfInput ECU_ADDRESS 0xFFF8BD42 /end MEASUREMENT
/begin MEASUREMENT iItfInput.iv_svh_aktiv_has "Schaltverhinderung bei Schleppstart durch Hybridablaufsteuerung saf_aktiv_has zur Schaltverhinderung durch HAS" UBYTE Conv.cItfInput._.iv_svh_aktiv_has_S6_S3 1 100 0 1 DISPLAY_IDENTIFIER iv_svh_aktiv_has.iItfInput ECU_ADDRESS 0xFFF8BD44 /end MEASUREMENT
/begin MEASUREMENT iItfInput.iv_n_vm_status "Status Drehzahl VM" UBYTE Conv.cItfInput._.iv_n_vm_status_S6_S3 1 100 0 2 DISPLAY_IDENTIFIER iv_n_vm_status.iItfInput ECU_ADDRESS 0xFFF8BD45 /end MEASUREMENT
/begin MEASUREMENT iItfInput.iv_k0_soll "K0- Sollzustand aus der Hybrid-Ablauf-Steuerung" UBYTE Conv.cItfInput._.iv_k0_soll_S6_S3 1 100 0 5 DISPLAY_IDENTIFIER iv_k0_soll.iItfInput ECU_ADDRESS 0xFFF8BD46 /end MEASUREMENT
/begin MEASUREMENT iItfInput.iv_z_k0_soll_subst "K0- Sollzustand für Notprogramm aus der Hybrid-Ablauf-Steuerung" UBYTE Conv.cItfInput._.iv_z_k0_soll_subst_S6_S3 1 100 0 3 DISPLAY_IDENTIFIER iv_z_k0_soll_subst.iItfInput ECU_ADDRESS 0xFFF8BD47 /end MEASUREMENT
/begin MEASUREMENT iItfInput.iv_z_k0_befuellopt "Anforderung an die Art der Kupplungsbefüllung der K0" UBYTE Conv.cItfInput._.iv_z_k0_befuellopt_S6_S3 1 100 0 2 DISPLAY_IDENTIFIER iv_z_k0_befuellopt.iItfInput ECU_ADDRESS 0xFFF8BD48 /end MEASUREMENT
/begin MEASUREMENT iItfInput.iv_m_soll_k0_has "HAS Momentenvorgabe" SWORD UMR_NM__1_1_0_S6_S3 1 100 0 800 DISPLAY_IDENTIFIER iv_m_soll_k0_has.iItfInput ECU_ADDRESS 0xFFF8BD4A /end MEASUREMENT
/begin MEASUREMENT iItfInput.iv_mg_soll_k0_neg_has "Negative Drehmomentänderung K0" SWORD UMR_NM_SEC_1_1_0_S6_S3 1 100 -10000 0 DISPLAY_IDENTIFIER iv_mg_soll_k0_neg_has.iItfInput ECU_ADDRESS 0xFFF8BD4C /end MEASUREMENT
/begin MEASUREMENT iItfInput.iv_mg_soll_k0_pos_has "Positive Drehmomentänderungen" SWORD UMR_NM_SEC_1_1_0_S6_S3 1 100 0 10000 DISPLAY_IDENTIFIER iv_mg_soll_k0_pos_has.iItfInput ECU_ADDRESS 0xFFF8BD4E /end MEASUREMENT
/begin MEASUREMENT iItfInput.iv_flag_p_hys_k0_has "Flag zur Aktivierung/Deaktivierung des Druckanteils p_hys_k0 zur Hysteresekompensation" UBYTE Conv.cItfInput._.iv_flag_p_hys_k0_has_S6_S3 1 100 0 1 DISPLAY_IDENTIFIER iv_flag_p_hys_k0_has.iItfInput ECU_ADDRESS 0xFFF8BD50 /end MEASUREMENT
/begin MEASUREMENT iItfInput.iv_saf_has_aktiv "Schaltanforderung saf_aktiv_has zur Schaltanforderung" UBYTE Conv.cItfInput._.iv_saf_has_aktiv_S6_S3 1 100 0 1 DISPLAY_IDENTIFIER iv_saf_has_aktiv.iItfInput ECU_ADDRESS 0xFFF8BD51 /end MEASUREMENT
/begin MEASUREMENT iItfInput.iv_verbot_sas_fkt "Verbot GLS verbot_sas_fkt zum Verbot GLS" UBYTE Conv.cItfInput._.iv_verbot_sas_fkt_S6_S3 1 100 0 1 DISPLAY_IDENTIFIER iv_verbot_sas_fkt.iItfInput ECU_ADDRESS 0xFFF8BD52 /end MEASUREMENT
/begin MEASUREMENT iItfInput.iv_schluesselstart_aktiv "Beeinflussung Befüllreihenfolge der Kupplungen schluesselstart_aktiv" UBYTE Conv.cItfInput._.iv_schluesselstart_aktiv_S6_S3 1 100 0 1 DISPLAY_IDENTIFIER iv_schluesselstart_aktiv.iItfInput ECU_ADDRESS 0xFFF8BD53 /end MEASUREMENT
/begin MEASUREMENT iItfInput.iv_status_has "Aktueller Status des HAS Ablaufs" UBYTE Conv.cItfInput._.iv_status_has_S6_S3 1 100 0 15 DISPLAY_IDENTIFIER iv_status_has.iItfInput ECU_ADDRESS 0xFFF8BD54 /end MEASUREMENT
/begin MEASUREMENT iItfInput.status_has "Aktueller Status des HAS Ablaufs" UBYTE Conv.cItfInput._.status_has_S6_S3 1 100 0 15 DISPLAY_IDENTIFIER status_has.iItfInput ECU_ADDRESS 0xFFF8BD55 /end MEASUREMENT
/begin MEASUREMENT iItfInput.k0_req_schlupf_rel "Faktor zur Sollschlupfreduzierung zwischen 0 und 1" UBYTE UMR___1_1_0_S6_S3 1 100 0 100 DISPLAY_IDENTIFIER k0_req_schlupf_rel.iItfInput ECU_ADDRESS 0xFFF8BD56 /end MEASUREMENT
/begin MEASUREMENT iItfInput.iv_k0_req_schlupf_rel "Faktor zur Sollschlupfreduzierung zwischen 0 und 1" UBYTE UMR___1_100_0_S6_S3 1 100 0 1 DISPLAY_IDENTIFIER iv_k0_req_schlupf_rel.iItfInput ECU_ADDRESS 0xFFF8BD57 /end MEASUREMENT
/begin MEASUREMENT iItfInput.edsmv_ersatzinfo "Eingangsgroesse EDSMS-ErsatzInfo" UBYTE Conv.cItfInput._.edsmv_ersatzinfo_S6_S3 1 100 0 7 DISPLAY_IDENTIFIER edsmv_ersatzinfo.iItfInput ECU_ADDRESS 0xFFF8BD58 /end MEASUREMENT
/begin MEASUREMENT iItfInput.stromlos_ausser_ps "Zustand der Endstufen Stromlos (ausser ps)" UBYTE Conv.cItfInput._.stromlos_ausser_ps_S6_S3 1 100 0 1 BIT_MASK 0x1 DISPLAY_IDENTIFIER stromlos_ausser_ps.iItfInput ECU_ADDRESS 0xFFF8BD59 /end MEASUREMENT
/begin MEASUREMENT iItfInput.stromlos_ausser_ps_und_i_min "Zustand der Endstufen Stromlos (ausser ps und Minimalbestromung)" UBYTE Conv.cItfInput._.stromlos_ausser_ps_und_i_min_S6_S3 1 100 0 1 BIT_MASK 0x1 DISPLAY_IDENTIFIER stromlos_ausser_ps_und_i_min.iItfInput ECU_ADDRESS 0xFFF8BD5A /end MEASUREMENT
/begin MEASUREMENT iItfInput.stromlos_ges "Zustand der Endstufen Stromlos gesamt" UBYTE Conv.cItfInput._.stromlos_ges_S6_S3 1 100 0 1 BIT_MASK 0x1 DISPLAY_IDENTIFIER stromlos_ges.iItfInput ECU_ADDRESS 0xFFF8BD5B /end MEASUREMENT
/begin MEASUREMENT iItfInput.hyd_notlauf "Zustand dhydraulischer Notlauf" UBYTE Conv.cItfInput._.hyd_notlauf_S6_S3 1 100 0 1 BIT_MASK 0x1 DISPLAY_IDENTIFIER hyd_notlauf.iItfInput ECU_ADDRESS 0xFFF8BD5C /end MEASUREMENT
/begin MEASUREMENT iItfInput.stromlos_ps "Zustand der Parksperrenendstufen Stromlos" UBYTE Conv.cItfInput._.stromlos_ps_S6_S3 1 100 0 1 BIT_MASK 0x1 DISPLAY_IDENTIFIER stromlos_ps.iItfInput ECU_ADDRESS 0xFFF8BD5D /end MEASUREMENT
/begin MEASUREMENT iItfInput.index_sp_sps "Index Spontanitaet Schaltpunktsteuerung aktiv" UBYTE UMR___1_1_0_S6_S3 1 100 0 99 DISPLAY_IDENTIFIER index_sp_sps.iItfInput ECU_ADDRESS 0xFFF8BD5E /end MEASUREMENT
/begin MEASUREMENT iItfInput.max_p_haupt "FLAG: Max. Hauptdruck aktiv" UBYTE Conv.cItfInput._.max_p_haupt_S6_S3 1 100 0 1 BIT_MASK 0x1 DISPLAY_IDENTIFIER max_p_haupt.iItfInput ECU_ADDRESS 0xFFF8BD5F /end MEASUREMENT
/begin MEASUREMENT iItfInput.ersf_k0auf "FLAG: Eingangsgroesse Ersatzfkt. K0 Oeffnen" UBYTE Conv.cItfInput._.ersf_k0auf_S6_S3 1 100 0 1 BIT_MASK 0x1 DISPLAY_IDENTIFIER ersf_k0auf.iItfInput ECU_ADDRESS 0xFFF8BD60 /end MEASUREMENT
/begin MEASUREMENT iItfInput.bs_timer "Betriebssystemtimer im 1ms Raster" UWORD UMR___1_1_0_S6_S3 1 100 0 65535 DISPLAY_IDENTIFIER bs_timer.iItfInput ECU_ADDRESS 0xFFF8BD62 /end MEASUREMENT
/begin MEASUREMENT iItfInput.zug_schub "FLAG: Zug oder Schub" UBYTE Conv.cItfInput._.zug_schub_S6_S3 1 100 0 1 DISPLAY_IDENTIFIER zug_schub.iItfInput ECU_ADDRESS 0xFFF8BD64 /end MEASUREMENT
/begin MEASUREMENT iItfInput.bls_defakt "FLAG: Bremslichtschalter aktiv (Default aktiv)" UBYTE Conv.cItfInput._.bls_defakt_S6_S3 1 100 0 1 BIT_MASK 0x1 DISPLAY_IDENTIFIER bls_defakt.iItfInput ECU_ADDRESS 0xFFF8BD65 /end MEASUREMENT
/begin MEASUREMENT iItfInput.bls_defpas "FLAG: Bremslichtschalter aktiv (Default passiv)" UBYTE Conv.cItfInput._.bls_defpas_S6_S3 1 100 0 1 BIT_MASK 0x1 DISPLAY_IDENTIFIER bls_defpas.iItfInput ECU_ADDRESS 0xFFF8BD66 /end MEASUREMENT
/begin MEASUREMENT iItfInput.p_bremse "Bremsdruck des Fahrzeugs" SWORD UMR_BAR__1_1_0_S6_S3 1 100 -100 1000 DISPLAY_IDENTIFIER p_bremse.iItfInput ECU_ADDRESS 0xFFF8BD68 /end MEASUREMENT
/begin MEASUREMENT iItfInput.p_bremse_halbe "Bremsdruck des Fahrzeugs, quant: 0,5 bar" SWORD UMR_BAR__1_2_0_S6_S3 1 100 -100 1000 DISPLAY_IDENTIFIER p_bremse_halbe.iItfInput ECU_ADDRESS 0xFFF8BD6A /end MEASUREMENT
/begin MEASUREMENT iItfInput.iv_p_bremse_halbe "iv-Größe für Bremsdruck des Fahrzeugs, quant: 0,5 bar" SWORD UMR_BAR__1_2_0_S6_S3 1 100 -100 1000 DISPLAY_IDENTIFIER iv_p_bremse_halbe.iItfInput ECU_ADDRESS 0xFFF8BD6C /end MEASUREMENT
/begin MEASUREMENT iItfInput.feststellbremse_aktiv "FLAG: Feststellbremse aktiv (Default passiv)" UBYTE Conv.cItfInput._.feststellbremse_aktiv_S6_S3 1 100 0 1 BIT_MASK 0x1 DISPLAY_IDENTIFIER feststellbremse_aktiv.iItfInput ECU_ADDRESS 0xFFF8BD6E /end MEASUREMENT
/begin MEASUREMENT iItfInput.el_not_entr "Elektrische Notentriegelung" UBYTE Conv.cItfInput._.el_not_entr_S6_S3 1 100 0 1 BIT_MASK 0x1 DISPLAY_IDENTIFIER el_not_entr.iItfInput ECU_ADDRESS 0xFFF8BD6F /end MEASUREMENT
/begin MEASUREMENT iItfInput.druck_vorhanden_mod "Anforderung Kupplungsbefüllung zu starten, obwohl lt Modellierung kein Pumpendruck vorhanden ist" UBYTE Conv.cItfInput._.druck_vorhanden_mod_S6_S3 1 100 0 1 BIT_MASK 0x1 DISPLAY_IDENTIFIER druck_vorhanden_mod.iItfInput ECU_ADDRESS 0xFFF8BD70 /end MEASUREMENT
/begin MEASUREMENT iItfInput.anhaenger_aktiv "FLAG: Anhaengerbetrieb aktiv" UBYTE Conv.cItfInput._.anhaenger_aktiv_S6_S3 1 100 0 1 BIT_MASK 0x1 DISPLAY_IDENTIFIER anhaenger_aktiv.iItfInput ECU_ADDRESS 0xFFF8BD71 /end MEASUREMENT
/begin MEASUREMENT iItfInput.transportmode_aktiv "Transportmode nicht aktiv oder aktiv" UBYTE Conv.cItfInput._.transportmode_aktiv_S6_S3 1 100 0 1 BIT_MASK 0x1 DISPLAY_IDENTIFIER transportmode_aktiv.iItfInput ECU_ADDRESS 0xFFF8BD72 /end MEASUREMENT
/begin MEASUREMENT iItfInput.asc_regelt "FLAG: ASC regelt" UBYTE Conv.cItfInput._.asc_regelt_S6_S3 1 100 0 1 BIT_MASK 0x1 DISPLAY_IDENTIFIER asc_regelt.iItfInput ECU_ADDRESS 0xFFF8BD73 /end MEASUREMENT
/begin MEASUREMENT iItfInput.asc_passiv "FLAG: ASC funktional abgeschaltet" UBYTE Conv.cItfInput._.asc_passiv_S6_S3 1 100 0 1 BIT_MASK 0x1 DISPLAY_IDENTIFIER asc_passiv.iItfInput ECU_ADDRESS 0xFFF8BD74 /end MEASUREMENT
/begin MEASUREMENT iItfInput.c_getrabst "Getriebeabstelltemperatur" UBYTE UMR_GRADC__1_1_M40_S6_S3 1 100 -40 150 DISPLAY_IDENTIFIER c_getrabst.iItfInput ECU_ADDRESS 0xFFF8BD75 /end MEASUREMENT
/begin MEASUREMENT iItfInput.iv_blsstatus "Eingangsgroesse Statussignal Bremslichtschalter aktiv" UBYTE Conv.cItfInput._.iv_blsstatus_S6_S3 1 100 0 2 DISPLAY_IDENTIFIER iv_blsstatus.iItfInput ECU_ADDRESS 0xFFF8BD76 /end MEASUREMENT
/begin MEASUREMENT iItfInput.n_mot_status "Statussignal Motordrehzahl" UBYTE Conv.cItfInput._.n_mot_status_S6_S3 1 100 0 2 DISPLAY_IDENTIFIER n_mot_status.iItfInput ECU_ADDRESS 0xFFF8BD77 /end MEASUREMENT
/begin MEASUREMENT iItfInput.pos_status "Statussignal zum Positionshebel pos" UBYTE Conv.cItfInput._.pos_status_S6_S3 1 100 0 2 DISPLAY_IDENTIFIER pos_status.iItfInput ECU_ADDRESS 0xFFF8BD78 /end MEASUREMENT
/begin MEASUREMENT iItfInput.n_ab_status "Statussignal Abtriebdrehzahl" UBYTE Conv.cItfInput._.n_ab_status_S6_S3 1 100 0 2 DISPLAY_IDENTIFIER n_ab_status.iItfInput ECU_ADDRESS 0xFFF8BD79 /end MEASUREMENT
/begin MEASUREMENT iItfInput.n_t_status "Statussignal Turbinendrehzahl" UBYTE Conv.cItfInput._.n_t_status_S6_S3 1 100 0 2 DISPLAY_IDENTIFIER n_t_status.iItfInput ECU_ADDRESS 0xFFF8BD7A /end MEASUREMENT
/begin MEASUREMENT iItfInput.m_mot_status "Statussignal Motormoment" UBYTE Conv.cItfInput._.m_mot_status_S6_S3 1 100 0 2 DISPLAY_IDENTIFIER m_mot_status.iItfInput ECU_ADDRESS 0xFFF8BD7B /end MEASUREMENT
/begin MEASUREMENT iItfInput.c_getr_status "Statussignal Getriebetemperatur" UBYTE Conv.cItfInput._.c_getr_status_S6_S3 1 100 0 2 DISPLAY_IDENTIFIER c_getr_status.iItfInput ECU_ADDRESS 0xFFF8BD7C /end MEASUREMENT
/begin MEASUREMENT iItfInput.bls_status "Statussignal Bremslichtschalter aktiv" UBYTE Conv.cItfInput._.bls_status_S6_S3 1 100 0 2 DISPLAY_IDENTIFIER bls_status.iItfInput ECU_ADDRESS 0xFFF8BD7D /end MEASUREMENT
/begin MEASUREMENT iItfInput.neigung_status "Statussignal zu Neigungssensorsignal" UBYTE Conv.cItfInput._.neigung_status_S6_S3 1 100 0 2 DISPLAY_IDENTIFIER neigung_status.iItfInput ECU_ADDRESS 0xFFF8BD7E /end MEASUREMENT
/begin MEASUREMENT iItfInput.k0_diag_moeglich "Status n_em + m_vm Signale i.O." UBYTE Conv.cItfInput._.k0_diag_moeglich_S6_S3 1 100 0 1 BIT_MASK 0x1 DISPLAY_IDENTIFIER k0_diag_moeglich.iItfInput ECU_ADDRESS 0xFFF8BD7F /end MEASUREMENT
/begin MEASUREMENT iItfInput.pumpendruck_vorhanden "FLAG: Pumpendruck sicher vorhanden" UBYTE Conv.cItfInput._.pumpendruck_vorhanden_S6_S3 1 100 0 1 BIT_MASK 0x1 DISPLAY_IDENTIFIER pumpendruck_vorhanden.iItfInput ECU_ADDRESS 0xFFF8BD80 /end MEASUREMENT
/begin MEASUREMENT iItfInput.pumpendruck_nicht_vorhanden "FLAG: Pumpendruck sicher nicht vorhanden" UBYTE Conv.cItfInput._.pumpendruck_nicht_vorhanden_S6_S3 1 100 0 1 BIT_MASK 0x1 DISPLAY_IDENTIFIER pumpendruck_nicht_vorhanden.iItfInput ECU_ADDRESS 0xFFF8BD81 /end MEASUREMENT
/begin MEASUREMENT iItfInput.i_min_ausser_parksperre "FLAG: Minimalbestromung (N-Haltefkt)" UBYTE Conv.cItfInput._.i_min_ausser_parksperre_S6_S3 1 100 0 1 BIT_MASK 0x1 DISPLAY_IDENTIFIER i_min_ausser_parksperre.iItfInput ECU_ADDRESS 0xFFF8BD82 /end MEASUREMENT
/begin MEASUREMENT iItfInput.f_minimaldruck_ausgabe "FLAG: Minimaldruck auf zumindest allen Reibkupplungen angefordert" UBYTE Conv.cItfInput._.f_minimaldruck_ausgabe_S6_S3 1 100 0 1 BIT_MASK 0x1 DISPLAY_IDENTIFIER f_minimaldruck_ausgabe.iItfInput ECU_ADDRESS 0xFFF8BD83 /end MEASUREMENT
/begin MEASUREMENT iItfInput.nullbestromung_aktiv "FLAG: Nullbestromung aktiv" UBYTE Conv.cItfInput._.nullbestromung_aktiv_S6_S3 1 100 0 1 BIT_MASK 0x1 DISPLAY_IDENTIFIER nullbestromung_aktiv.iItfInput ECU_ADDRESS 0xFFF8BD84 /end MEASUREMENT
/begin MEASUREMENT iItfInput.atsys_ee_busy "EEPROM Atsys Adaptionsdaten schreiben laeuft" UBYTE UMR___1_1_0_S6_S3 1 100 0 255 DISPLAY_IDENTIFIER atsys_ee_busy.iItfInput ECU_ADDRESS 0xFFF8BD85 /end MEASUREMENT
/begin MEASUREMENT iItfInput.statistics_ee_busy "EEPROM Atsys Getriebmonitoringdaten schreiben laeuft" UBYTE UMR___1_1_0_S6_S3 1 100 0 255 DISPLAY_IDENTIFIER statistics_ee_busy.iItfInput ECU_ADDRESS 0xFFF8BD86 /end MEASUREMENT
/begin MEASUREMENT iItfInput.prog_auswahl "Programmauswahl Sport/Manuell/Tipp/L-Programm" UBYTE UMR___1_1_0_S6_S3 1 100 0 8 DISPLAY_IDENTIFIER prog_auswahl.iItfInput ECU_ADDRESS 0xFFF8BD87 /end MEASUREMENT
/begin MEASUREMENT iItfInput.neigung "Neigungssensor-Signal" UBYTE UMR_GRAD__1_3_M128_S6_S3 1 100 -42.6666666667 42 DISPLAY_IDENTIFIER neigung.iItfInput ECU_ADDRESS 0xFFF8BD88 /end MEASUREMENT
/begin MEASUREMENT iItfInput.neigung_si8 "Neigungssensor-Signal" SBYTE UMR_GRAD__1_3_0_S6_S3 1 100 -42.6666666667 42.3333333333 DISPLAY_IDENTIFIER neigung_si8.iItfInput ECU_ADDRESS 0xFFF8BD89 /end MEASUREMENT
/begin MEASUREMENT iItfInput.neigung_gef "gefiltertes Neigungssensor-Signal" UBYTE UMR_GRAD__1_3_M128_S6_S3 1 100 -42.6666666667 42 DISPLAY_IDENTIFIER neigung_gef.iItfInput ECU_ADDRESS 0xFFF8BD8A /end MEASUREMENT
/begin MEASUREMENT iItfInput.getr_betriebszeit "Betriebsstundenzaehler Getriebebetriebszeit (Cruisetask) in 1 min" ULONG UMR_MIN__1_1_0_S6_S3 1 100 0 65535 DISPLAY_IDENTIFIER getr_betriebszeit.iItfInput ECU_ADDRESS 0xFFF8BD8C /end MEASUREMENT
/begin MEASUREMENT iItfInput.codierung_nic "NIC Codierungssignal" UBYTE UMR___1_1_0_S6_S3 1 100 0 255 DISPLAY_IDENTIFIER codierung_nic.iItfInput ECU_ADDRESS 0xFFF8BD90 /end MEASUREMENT
/begin MEASUREMENT iItfInput.fzg_geschwindigkeit "Eingangssignal Fahrzeuggeschwindigkeit (aus Abtrieb berechnet)" UWORD UMR_KM_H_1_1_0_S6_S3 1 100 0 400 DISPLAY_IDENTIFIER fzg_geschwindigkeit.iItfInput ECU_ADDRESS 0xFFF8BD92 /end MEASUREMENT
/begin MEASUREMENT iItfInput.rad_geschw_vorne_links "Eingangssignal Radgeschwindigkeit links vorne" UWORD UMR_KM_H_1_16_0_S6_S3 1 100 0 4095.9375 DISPLAY_IDENTIFIER rad_geschw_vorne_links.iItfInput ECU_ADDRESS 0xFFF8BD94 /end MEASUREMENT
/begin MEASUREMENT iItfInput.rad_geschw_vorne_rechts "Eingangssignal Radgeschwindigkeit rechts vorne" UWORD UMR_KM_H_1_16_0_S6_S3 1 100 0 4095.9375 DISPLAY_IDENTIFIER rad_geschw_vorne_rechts.iItfInput ECU_ADDRESS 0xFFF8BD96 /end MEASUREMENT
/begin MEASUREMENT iItfInput.rad_geschw_hinten_links "Eingangssignal Radgeschwindigkeit links hinten" UWORD UMR_KM_H_1_16_0_S6_S3 1 100 0 4095.9375 DISPLAY_IDENTIFIER rad_geschw_hinten_links.iItfInput ECU_ADDRESS 0xFFF8BD98 /end MEASUREMENT
/begin MEASUREMENT iItfInput.rad_geschw_hinten_rechts "Eingangssignal Radgeschwindigkeit rechts hinten" UWORD UMR_KM_H_1_16_0_S6_S3 1 100 0 4095.9375 DISPLAY_IDENTIFIER rad_geschw_hinten_rechts.iItfInput ECU_ADDRESS 0xFFF8BD9A /end MEASUREMENT
/begin MEASUREMENT iItfInput.hdc "HDC" UBYTE Conv.cItfInput._.hdc_S6_S3 1 100 0 7 DISPLAY_IDENTIFIER hdc.iItfInput ECU_ADDRESS 0xFFF8BD9C /end MEASUREMENT
/begin MEASUREMENT iItfInput.iv_hdc "Iv-Grösse Hdc" UBYTE Conv.cItfInput._.iv_hdc_S6_S3 1 100 0 7 DISPLAY_IDENTIFIER iv_hdc.iItfInput ECU_ADDRESS 0xFFF8BD9D /end MEASUREMENT
/begin MEASUREMENT iItfInput.fl_brake_inter "Externer Bremseingriff" UBYTE UMR___1_1_0_S6_S3 1 100 0 1 BIT_MASK 0x1 DISPLAY_IDENTIFIER fl_brake_inter.iItfInput ECU_ADDRESS 0xFFF8BD9E /end MEASUREMENT
/begin MEASUREMENT iItfInput.iv_fl_brake_inter "Externer Bremseingriff" UBYTE UMR___1_1_0_S6_S3 1 100 0 1 DISPLAY_IDENTIFIER iv_fl_brake_inter.iItfInput ECU_ADDRESS 0xFFF8BD9F /end MEASUREMENT
/begin MEASUREMENT iItfInput.fl_brake_inter_status "Status Externer Bremseingriff" UBYTE Conv.cItfInput._.fl_brake_inter_status_S6_S3 1 100 0 2 DISPLAY_IDENTIFIER fl_brake_inter_status.iItfInput ECU_ADDRESS 0xFFF8BDA0 /end MEASUREMENT
/begin MEASUREMENT iItfInput.iv_fl_brake_inter_status "Status Externer Bremseingriff" UBYTE Conv.cItfInput._.iv_fl_brake_inter_status_S6_S3 1 100 0 2 DISPLAY_IDENTIFIER iv_fl_brake_inter_status.iItfInput ECU_ADDRESS 0xFFF8BDA1 /end MEASUREMENT
/begin MEASUREMENT iItfInput.ldm "Status Externer Bremseingriff" UBYTE Conv.cItfInput._.ldm_S6_S3 1 100 0 4 DISPLAY_IDENTIFIER ldm.iItfInput ECU_ADDRESS 0xFFF8BDA2 /end MEASUREMENT
/begin MEASUREMENT iItfInput.iv_ldm "Status Externer Bremseingriff" UBYTE Conv.cItfInput._.iv_ldm_S6_S3 1 100 0 4 DISPLAY_IDENTIFIER iv_ldm.iItfInput ECU_ADDRESS 0xFFF8BDA3 /end MEASUREMENT
/begin MEASUREMENT iItfInput.ldm_status "Signalstatus des Staus desLängsdynamikmanagements" UBYTE Conv.cItfInput._.ldm_status_S6_S3 1 100 0 2 DISPLAY_IDENTIFIER ldm_status.iItfInput ECU_ADDRESS 0xFFF8BDA4 /end MEASUREMENT
/begin MEASUREMENT iItfInput.iv_ldm_status "Signalstatus des Staus desLängsdynamikmanagements" UBYTE Conv.cItfInput._.iv_ldm_status_S6_S3 1 100 0 2 DISPLAY_IDENTIFIER iv_ldm_status.iItfInput ECU_ADDRESS 0xFFF8BDA5 /end MEASUREMENT
/begin MEASUREMENT iItfInput.c_getr_fl32 "Getriebetemperatur" FLOAT32_IEEE UMR_GRADC__1_1_0_S6_S3 1 100 -40 215 DISPLAY_IDENTIFIER c_getr_fl32.iItfInput ECU_ADDRESS 0xFFF8BDA8 /end MEASUREMENT
/begin MEASUREMENT iItfInput.m_mot_fl32 "Motormoment" FLOAT32_IEEE UMR_NM__1_1_0_S6_S3 1 100 -400 1640 DISPLAY_IDENTIFIER m_mot_fl32.iItfInput ECU_ADDRESS 0xFFF8BDAC /end MEASUREMENT
/begin MEASUREMENT iItfInput.n_abneu_int16 "Abtriebsdrehzahl ungefiltert" SWORD UMR_U_MIN_1_1_0_S6_S3 1 100 0 8160 DISPLAY_IDENTIFIER n_abneu_int16.iItfInput ECU_ADDRESS 0xFFF8BDB0 /end MEASUREMENT
/begin MEASUREMENT iItfInput.n_tneu_int16 "Turbinendrehzahl ungefiltert" SWORD UMR_U_MIN_1_1_0_S6_S3 1 100 0 8160 DISPLAY_IDENTIFIER n_tneu_int16.iItfInput ECU_ADDRESS 0xFFF8BDB2 /end MEASUREMENT
/begin MEASUREMENT iItfInput.n_mot_int16 "Motordrehzahl" SWORD UMR_U_MIN_1_1_0_S6_S3 1 100 0 8160 DISPLAY_IDENTIFIER n_mot_int16.iItfInput ECU_ADDRESS 0xFFF8BDB4 /end MEASUREMENT
/begin MEASUREMENT iItfInput.m_mot_faktor10 "Motormoment mahl 10" SWORD UMR_NM__1_10_0_S6_S3 1 100 -400 1640 DISPLAY_IDENTIFIER m_mot_faktor10.iItfInput ECU_ADDRESS 0xFFF8BDB6 /end MEASUREMENT
/begin MEASUREMENT iItfInput.dki_fl32 "Drosselklappenistwert in Prozent" FLOAT32_IEEE UMR_PROZENT__1_1_0_2_S6_S3 1 100 0 100 FORMAT "%4.2" DISPLAY_IDENTIFIER dki_fl32.iItfInput ECU_ADDRESS 0xFFF8BDB8 /end MEASUREMENT
/begin MEASUREMENT iItfInput.m_motist_faktor10 "Kurbelwellenistmoment mahl 10" SWORD UMR_NM__1_10_0_S6_S3 1 100 -400 1640 DISPLAY_IDENTIFIER m_motist_faktor10.iItfInput ECU_ADDRESS 0xFFF8BDBC /end MEASUREMENT
/begin MEASUREMENT iItfInput.m_motsoll_faktor10 "Motor Sollmoment mahl 10" SWORD UMR_NM__1_10_0_S6_S3 1 100 -400 1640 DISPLAY_IDENTIFIER m_motsoll_faktor10.iItfInput ECU_ADDRESS 0xFFF8BDBE /end MEASUREMENT
/begin MEASUREMENT iItfInput.iv_fl_schubabschaltung_aktiv "Zustand Schubabschaltung" UBYTE UMR___1_1_0_S6_S3 1 100 0 1 DISPLAY_IDENTIFIER iv_fl_schubabschaltung_aktiv.iItfInput ECU_ADDRESS 0xFFF8BDC0 /end MEASUREMENT
/begin MEASUREMENT iItfInput.fl_schubabschaltung_aktiv "Zustand Schubabschaltung" UBYTE UMR___1_1_0_S6_S3 1 100 0 1 BIT_MASK 0x1 DISPLAY_IDENTIFIER fl_schubabschaltung_aktiv.iItfInput ECU_ADDRESS 0xFFF8BDC1 /end MEASUREMENT
/begin MEASUREMENT iItfInput.iv_fzg_anfahrassistent_aktiv "Anfahrassistenzfunktion meldet Zustand der fahrzeugseitigen Rollverhinderung" UBYTE UMR___1_1_0_S6_S3 1 100 0 3 DISPLAY_IDENTIFIER iv_fzg_anfahrassistent_aktiv.iItfInput ECU_ADDRESS 0xFFF8BDC2 /end MEASUREMENT
/begin MEASUREMENT iItfInput.fzg_anfahrassistent_aktiv "Anfahrassistenzfunktion meldet Zustand der fahrzeugseitigen Rollverhinderung" UBYTE UMR___1_1_0_S6_S3 1 100 0 3 DISPLAY_IDENTIFIER fzg_anfahrassistent_aktiv.iItfInput ECU_ADDRESS 0xFFF8BDC3 /end MEASUREMENT
/begin MEASUREMENT iItfInput.km_stand_aus_nab "berechneter Kilometerstand der Getriebe" ULONG UMR_KM__1_1_0_S6_S3 1 100 0 4294967295 DISPLAY_IDENTIFIER km_stand_aus_nab.iItfInput ECU_ADDRESS 0xFFF8BDC4 /end MEASUREMENT
/begin MEASUREMENT iItfInput.iv_km_stand_aus_nab "berechneter Kilometerstand der Getriebe" ULONG UMR_KM__1_1_0_S6_S3 1 100 0 4294967295 DISPLAY_IDENTIFIER iv_km_stand_aus_nab.iItfInput ECU_ADDRESS 0xFFF8BDC8 /end MEASUREMENT
/begin MEASUREMENT iItfInput.autohold_aktiv "Autohold aktiv" UBYTE Conv.cItfInput._.autohold_aktiv_S6_S3 1 100 0 1 BIT_MASK 0x1 DISPLAY_IDENTIFIER autohold_aktiv.iItfInput ECU_ADDRESS 0xFFF8BDCC /end MEASUREMENT
/begin MEASUREMENT iItfInput.hillhold_aktiv "Hillhold aktiv" UBYTE Conv.cItfInput._.hillhold_aktiv_S6_S3 1 100 0 1 BIT_MASK 0x1 DISPLAY_IDENTIFIER hillhold_aktiv.iItfInput ECU_ADDRESS 0xFFF8BDCD /end MEASUREMENT
/begin MEASUREMENT iItfInput.iv_fzg_rollverh_aktiv_stat "Status von fzg_anfahrassistent_aktiv" UBYTE Conv.cItfInput._.iv_fzg_rollverh_aktiv_stat_S6_S3 1 100 0 2 DISPLAY_IDENTIFIER iv_fzg_rollverh_aktiv_stat.iItfInput ECU_ADDRESS 0xFFF8BDCE /end MEASUREMENT
/begin MEASUREMENT iItfInput.fzg_rollverh_aktiv_stat "Status von fzg_anfahrassistent_aktiv" UBYTE Conv.cItfInput._.fzg_rollverh_aktiv_stat_S6_S3 1 100 0 2 DISPLAY_IDENTIFIER fzg_rollverh_aktiv_stat.iItfInput ECU_ADDRESS 0xFFF8BDCF /end MEASUREMENT
/begin MEASUREMENT iItfInput.ax_ref "Laengsbeschleunigung" SWORD UMR_M_SEC2_1_32_0_S6_S3 1 100 -1024 1023.96875 DISPLAY_IDENTIFIER ax_ref.iItfInput ECU_ADDRESS 0xFFF8BDD0 /end MEASUREMENT
/begin MEASUREMENT iItfInput.iv_ax_ref "Laengsbeschleunigung" SWORD UMR_M_SEC2_1_32_0_S6_S3 1 100 -1024 1023.96875 DISPLAY_IDENTIFIER iv_ax_ref.iItfInput ECU_ADDRESS 0xFFF8BDD2 /end MEASUREMENT
/begin MEASUREMENT iItfInput.ax_ref_status "Status der Laengsbeschleunigung" UBYTE Conv.cItfInput._.ax_ref_status_S6_S3 1 100 0 2 DISPLAY_IDENTIFIER ax_ref_status.iItfInput ECU_ADDRESS 0xFFF8BDD4 /end MEASUREMENT
/begin MEASUREMENT iItfInput.iv_ax_ref_status "Status der Laengsbeschleunigung" UBYTE Conv.cItfInput._.iv_ax_ref_status_S6_S3 1 100 0 2 DISPLAY_IDENTIFIER iv_ax_ref_status.iItfInput ECU_ADDRESS 0xFFF8BDD5 /end MEASUREMENT
/begin MEASUREMENT iItfInput.ay_ref "Querbeschleunigung" SWORD UMR_M_SEC2_1_32_0_S6_S3 1 100 -1024 1023.96875 DISPLAY_IDENTIFIER ay_ref.iItfInput ECU_ADDRESS 0xFFF8BDD6 /end MEASUREMENT
/begin MEASUREMENT iItfInput.iv_ay_ref "Querbeschleunigung" SWORD UMR_M_SEC2_1_32_0_S6_S3 1 100 -1024 1023.96875 DISPLAY_IDENTIFIER iv_ay_ref.iItfInput ECU_ADDRESS 0xFFF8BDD8 /end MEASUREMENT
/begin MEASUREMENT iItfInput.ay_ref_status "Status der Querbeschleunigung" UBYTE Conv.cItfInput._.ay_ref_status_S6_S3 1 100 0 2 DISPLAY_IDENTIFIER ay_ref_status.iItfInput ECU_ADDRESS 0xFFF8BDDA /end MEASUREMENT
/begin MEASUREMENT iItfInput.iv_ay_ref_status "Status der Querbeschleunigung" UBYTE Conv.cItfInput._.iv_ay_ref_status_S6_S3 1 100 0 2 DISPLAY_IDENTIFIER iv_ay_ref_status.iItfInput ECU_ADDRESS 0xFFF8BDDB /end MEASUREMENT
/begin MEASUREMENT iItfInput.n_ab_dir "Drehrichtung Abtrieb intern" SBYTE Conv.cItfInput._.n_ab_dir_S6_S3 1 100 -1 1 DISPLAY_IDENTIFIER n_ab_dir.iItfInput ECU_ADDRESS 0xFFF8BDDC /end MEASUREMENT
/begin MEASUREMENT iItfInput.iv_n_ab_dir "Drehrichtung Abtrieb Schnittstelle" UBYTE Conv.cItfInput._.iv_n_ab_dir_S6_S3 1 100 0 2 DISPLAY_IDENTIFIER iv_n_ab_dir.iItfInput ECU_ADDRESS 0xFFF8BDDD /end MEASUREMENT
/begin MEASUREMENT iItfInput.n_t_dir "Drehrichtung Turbine intern" SBYTE Conv.cItfInput._.n_t_dir_S6_S3 1 100 -1 1 DISPLAY_IDENTIFIER n_t_dir.iItfInput ECU_ADDRESS 0xFFF8BDDE /end MEASUREMENT
/begin MEASUREMENT iItfInput.iv_n_t_dir "Drehrichtung Turbine Schnittstelle" UBYTE Conv.cItfInput._.iv_n_t_dir_S6_S3 1 100 0 2 DISPLAY_IDENTIFIER iv_n_t_dir.iItfInput ECU_ADDRESS 0xFFF8BDDF /end MEASUREMENT
/begin MEASUREMENT iItfInput.iv_n_ab_dir_status "Drehrichtung Abtieb Status" UBYTE Conv.cItfInput._.iv_n_ab_dir_status_S6_S3 1 100 0 2 DISPLAY_IDENTIFIER iv_n_ab_dir_status.iItfInput ECU_ADDRESS 0xFFF8BDE0 /end MEASUREMENT
/begin MEASUREMENT iItfInput.n_ab_dir_status "Drehrichtung Abtieb Status" UBYTE Conv.cItfInput._.n_ab_dir_status_S6_S3 1 100 0 2 DISPLAY_IDENTIFIER n_ab_dir_status.iItfInput ECU_ADDRESS 0xFFF8BDE1 /end MEASUREMENT
/begin MEASUREMENT iItfInput.iv_n_t_dir_status "Drehrichtung Turbine Status" UBYTE Conv.cItfInput._.iv_n_t_dir_status_S6_S3 1 100 0 2 DISPLAY_IDENTIFIER iv_n_t_dir_status.iItfInput ECU_ADDRESS 0xFFF8BDE2 /end MEASUREMENT
/begin MEASUREMENT iItfInput.n_t_dir_status "Drehrichtung Turbine Status" UBYTE Conv.cItfInput._.n_t_dir_status_S6_S3 1 100 0 2 DISPLAY_IDENTIFIER n_t_dir_status.iItfInput ECU_ADDRESS 0xFFF8BDE3 /end MEASUREMENT
/begin MEASUREMENT iItfInput.iv_ntu_virt_dir "virtuelle Drehrichtung Turbine Schnittstelle" UBYTE Conv.cItfInput._.iv_ntu_virt_dir_S6_S3 1 100 0 2 DISPLAY_IDENTIFIER iv_ntu_virt_dir.iItfInput ECU_ADDRESS 0xFFF8BDE4 /end MEASUREMENT
/begin MEASUREMENT iItfInput.ntu_virt_dir "virtuelle Drehrichtung Turbine Schnittstelle" SBYTE Conv.cItfInput._.ntu_virt_dir_S6_S3 1 100 -1 1 DISPLAY_IDENTIFIER ntu_virt_dir.iItfInput ECU_ADDRESS 0xFFF8BDE5 /end MEASUREMENT
/begin MEASUREMENT iItfInput.iv_ntu_virt_dir_status "virtuelle Drehrichtung Turbine Status" UBYTE Conv.cItfInput._.iv_ntu_virt_dir_status_S6_S3 1 100 0 2 DISPLAY_IDENTIFIER iv_ntu_virt_dir_status.iItfInput ECU_ADDRESS 0xFFF8BDE6 /end MEASUREMENT
/begin MEASUREMENT iItfInput.ntu_virt_dir_status "virtuelle Drehrichtung Turbine Status" UBYTE Conv.cItfInput._.ntu_virt_dir_status_S6_S3 1 100 0 2 DISPLAY_IDENTIFIER ntu_virt_dir_status.iItfInput ECU_ADDRESS 0xFFF8BDE7 /end MEASUREMENT
/begin MEASUREMENT iItfInput.iv_ntu_virt "virtuelle Turbinendrehzahl ungefiltert" UWORD UMR_U_MIN_1_1_0_S6_S3 1 100 0 8160 DISPLAY_IDENTIFIER iv_ntu_virt.iItfInput ECU_ADDRESS 0xFFF8BDE8 /end MEASUREMENT
/begin MEASUREMENT iItfInput.ntu_virt "virtuelle Turbinendrehzahl ungefiltert" UWORD UMR_U_MIN_1_1_0_S6_S3 1 100 0 8160 DISPLAY_IDENTIFIER ntu_virt.iItfInput ECU_ADDRESS 0xFFF8BDEA /end MEASUREMENT
/begin MEASUREMENT iItfInput.iv_n_dif_iae_virt "reeller Bauteilschlupf von Kupplung B (auf Getriebeeingang bezogen)" SWORD UMR_U_MIN_1_1_0_S6_S3 1 100 -32768 32767 DISPLAY_IDENTIFIER iv_n_dif_iae_virt.iItfInput ECU_ADDRESS 0xFFF8BDEC /end MEASUREMENT
/begin MEASUREMENT iItfInput.n_dif_iae_virt "reeller Bauteilschlupf von Kupplung B (auf Getriebeeingang bezogen)" SWORD UMR_U_MIN_1_1_0_S6_S3 1 100 -32768 32767 DISPLAY_IDENTIFIER n_dif_iae_virt.iItfInput ECU_ADDRESS 0xFFF8BDEE /end MEASUREMENT
/begin MEASUREMENT iItfInput.m_motsoll_mod "Wert m_motsoll ohne Begrenzung auf das Reservemoment" SWORD UMR_NM__1_1_0_S6_S3 1 100 -400 1640 DISPLAY_IDENTIFIER m_motsoll_mod.iItfInput ECU_ADDRESS 0xFFF8BDF0 /end MEASUREMENT
/begin MEASUREMENT iItfInput.iv_m_motsoll_mod "iv-Wert m_motsoll ohne Begrenzung auf das Reservemoment" SWORD UMR_NM__1_1_0_S6_S3 1 100 -400 1640 DISPLAY_IDENTIFIER iv_m_motsoll_mod.iItfInput ECU_ADDRESS 0xFFF8BDF2 /end MEASUREMENT
/begin MEASUREMENT iItfInput.iv_m_motsoll_mod_status "iv-Messgröße Statussignal zu m_motsoll_mod" UBYTE Conv.cItfInput._.iv_m_motsoll_mod_status_S6_S3 1 100 0 2 DISPLAY_IDENTIFIER iv_m_motsoll_mod_status.iItfInput ECU_ADDRESS 0xFFF8BDF4 /end MEASUREMENT
/begin MEASUREMENT iItfInput.m_motsoll_mod_status "Statussignal zu m_motsoll_mod" UBYTE Conv.cItfInput._.m_motsoll_mod_status_S6_S3 1 100 0 2 DISPLAY_IDENTIFIER m_motsoll_mod_status.iItfInput ECU_ADDRESS 0xFFF8BDF5 /end MEASUREMENT
/begin MEASUREMENT iItfInput.dki_mmotsoll "dki oder mmotsoll_mod je nach SWI_UMSCHALTDKI" SWORD UMR___1_1_0_S6_S3 1 100 -400 1640 DISPLAY_IDENTIFIER dki_mmotsoll.iItfInput ECU_ADDRESS 0xFFF8BDF6 /end MEASUREMENT
/begin MEASUREMENT iItfInput.f_iep_shutdown "Anforderung den Zustand AUS ohne Nachlauf einzustellen" UBYTE Conv.cItfInput._.f_iep_shutdown_S6_S3 1 100 0 1 DISPLAY_IDENTIFIER f_iep_shutdown.iItfInput ECU_ADDRESS 0xFFF8BDF8 /end MEASUREMENT
/begin MEASUREMENT iItfInput.iv_f_iep_shutdown "Anforderung den Zustand AUS ohne Nachlauf einzustellen" UBYTE Conv.cItfInput._.iv_f_iep_shutdown_S6_S3 1 100 0 1 DISPLAY_IDENTIFIER iv_f_iep_shutdown.iItfInput ECU_ADDRESS 0xFFF8BDF9 /end MEASUREMENT
/begin MEASUREMENT iItfInput.iv_pumpenstatus_iep "Physikalischer Zustand der elektrischen Zusatzpumpe IEP" UBYTE Conv.cItfInput._.iv_pumpenstatus_iep_S6_S3 1 100 0 4 DISPLAY_IDENTIFIER iv_pumpenstatus_iep.iItfInput ECU_ADDRESS 0xFFF8BDFA /end MEASUREMENT
/begin MEASUREMENT iItfInput.pumpenstatus_iep "Physikalischer Zustand der elektrischen Zusatzpumpe IEP" UBYTE Conv.cItfInput._.pumpenstatus_iep_S6_S3 1 100 0 4 DISPLAY_IDENTIFIER pumpenstatus_iep.iItfInput ECU_ADDRESS 0xFFF8BDFB /end MEASUREMENT
/begin MEASUREMENT iItfInput.iv_iep_soll_has "Vorgabe Istzustand der IEP durch die HAS" UBYTE Conv.cItfInput._.iv_iep_soll_has_S6_S3 1 100 0 4 DISPLAY_IDENTIFIER iv_iep_soll_has.iItfInput ECU_ADDRESS 0xFFF8BDFC /end MEASUREMENT
/begin MEASUREMENT iItfInput.iep_soll_has "Vorgabe Istzustand der IEP durch die HAS" UBYTE Conv.cItfInput._.iep_soll_has_S6_S3 1 100 0 4 DISPLAY_IDENTIFIER iep_soll_has.iItfInput ECU_ADDRESS 0xFFF8BDFD /end MEASUREMENT
/begin MEASUREMENT iItfInput.iv_iep_soll_abk "Vorgabe Istzustand der IEP durch die ABK" UBYTE Conv.cItfInput._.iv_iep_soll_abk_S6_S3 1 100 0 4 DISPLAY_IDENTIFIER iv_iep_soll_abk.iItfInput ECU_ADDRESS 0xFFF8BDFE /end MEASUREMENT
/begin MEASUREMENT iItfInput.iep_soll_abk "Vorgabe Istzustand der IEP durch die ABK" UBYTE Conv.cItfInput._.iep_soll_abk_S6_S3 1 100 0 4 DISPLAY_IDENTIFIER iep_soll_abk.iItfInput ECU_ADDRESS 0xFFF8BDFF /end MEASUREMENT
/begin MEASUREMENT iItfInput.iv_iep_soll_sab "Vorgabe Istzustand der IEP durch SAB" UBYTE Conv.cItfInput._.iv_iep_soll_sab_S6_S3 1 100 0 4 DISPLAY_IDENTIFIER iv_iep_soll_sab.iItfInput ECU_ADDRESS 0xFFF8BE00 /end MEASUREMENT
/begin MEASUREMENT iItfInput.iep_soll_sab "Vorgabe Istzustand der IEP durch SAB" UBYTE Conv.cItfInput._.iep_soll_sab_S6_S3 1 100 0 4 DISPLAY_IDENTIFIER iep_soll_sab.iItfInput ECU_ADDRESS 0xFFF8BE01 /end MEASUREMENT
/begin MEASUREMENT iItfInput.iv_iep_soll_tes "Vorgabe Istzustand der IEP durch die SAB" UBYTE Conv.cItfInput._.iv_iep_soll_tes_S6_S3 1 100 0 3 DISPLAY_IDENTIFIER iv_iep_soll_tes.iItfInput ECU_ADDRESS 0xFFF8BE02 /end MEASUREMENT
/begin MEASUREMENT iItfInput.iep_soll_tes "Vorgabe Istzustand der IEP durch die SAB" UBYTE Conv.cItfInput._.iep_soll_tes_S6_S3 1 100 0 3 DISPLAY_IDENTIFIER iep_soll_tes.iItfInput ECU_ADDRESS 0xFFF8BE03 /end MEASUREMENT
/begin MEASUREMENT iItfInput.iv_fahr_bereit "Fahrbereitschaftsinformation vom Hybridmaster" UBYTE UMR___1_1_0_S6_S3 1 100 0 128 DISPLAY_IDENTIFIER iv_fahr_bereit.iItfInput ECU_ADDRESS 0xFFF8BE04 /end MEASUREMENT
/begin MEASUREMENT iItfInput.fahr_bereit "Fahrbereitschaftsinformation vom Hybridmaster" UBYTE UMR___1_1_0_S6_S3 1 100 0 128 DISPLAY_IDENTIFIER fahr_bereit.iItfInput ECU_ADDRESS 0xFFF8BE05 /end MEASUREMENT
/begin MEASUREMENT iItfInput.iv_f_aufwaerm_erlaubt_iep "Information if the IEP is configured for warm up function" UWORD UMR___1_1_0_S6_S3 1 100 0 1 DISPLAY_IDENTIFIER iv_f_aufwaerm_erlaubt_iep.iItfInput ECU_ADDRESS 0xFFF8BE06 /end MEASUREMENT
/begin MEASUREMENT iItfInput.f_aufwaerm_erlaubt_iep "Information if the IEP is configured for warm up function" UWORD UMR___1_1_0_S6_S3 1 100 0 1 DISPLAY_IDENTIFIER f_aufwaerm_erlaubt_iep.iItfInput ECU_ADDRESS 0xFFF8BE08 /end MEASUREMENT
/begin MEASUREMENT iItfInput.iv_cdd_u_supply_iep "Interface returns voltage of IEP." UWORD UMR_VOLT__1_10_0_S6_S3 1 100 0 6553.5 DISPLAY_IDENTIFIER iv_cdd_u_supply_iep.iItfInput ECU_ADDRESS 0xFFF8BE0A /end MEASUREMENT
/begin MEASUREMENT iItfInput.cdd_u_supply_iep "Interface returns voltage of IEP." UWORD UMR_VOLT__1_10_0_S6_S3 1 100 0 6553.5 DISPLAY_IDENTIFIER cdd_u_supply_iep.iItfInput ECU_ADDRESS 0xFFF8BE0C /end MEASUREMENT
/begin MEASUREMENT iItfInput.iv_gbx_rdy_to_drv "iv-Größe Status des hydraulischen Drucks des Getriebes" UBYTE UMR___1_1_0_S6_S3 1 100 0 255 DISPLAY_IDENTIFIER iv_gbx_rdy_to_drv.iItfInput ECU_ADDRESS 0xFFF8BE0E /end MEASUREMENT
/begin MEASUREMENT iItfInput.gbx_rdy_to_drv "Status des hydraulischen Drucks des Getriebes" UBYTE UMR___1_1_0_S6_S3 1 100 0 255 DISPLAY_IDENTIFIER gbx_rdy_to_drv.iItfInput ECU_ADDRESS 0xFFF8BE0F /end MEASUREMENT
/begin MEASUREMENT iItfInput.iv_gbx_rdy_to_drv_status "Vorgabe Istzustand der IEP durch die SAB" UBYTE UMR___1_1_0_S6_S3 1 100 0 255 DISPLAY_IDENTIFIER iv_gbx_rdy_to_drv_status.iItfInput ECU_ADDRESS 0xFFF8BE10 /end MEASUREMENT
/begin MEASUREMENT iItfInput.gbx_rdy_to_drv_status "Vorgabe Istzustand der IEP durch die SAB" UBYTE UMR___1_1_0_S6_S3 1 100 0 255 DISPLAY_IDENTIFIER gbx_rdy_to_drv_status.iItfInput ECU_ADDRESS 0xFFF8BE11 /end MEASUREMENT
/begin MEASUREMENT iItfInput.iv_p_air "iv-Größe Luftdruck" UWORD UMR_MBAR__1_1_0_S6_S3 1 100 0 2026 DISPLAY_IDENTIFIER iv_p_air.iItfInput ECU_ADDRESS 0xFFF8BE12 /end MEASUREMENT
/begin MEASUREMENT iItfInput.p_air "Luftdruck" UWORD UMR_MBAR__1_1_0_S6_S3 1 100 0 2026 DISPLAY_IDENTIFIER p_air.iItfInput ECU_ADDRESS 0xFFF8BE14 /end MEASUREMENT
/begin MEASUREMENT iItfInput.iv_flag_m_max_has_iae "Eingang: Flag zur Aktivierung des max. zul. IAE_Moments aus der HAS-Funktion" UBYTE Conv.cItfInput._.iv_flag_m_max_has_iae_S6_S3 1 100 0 1 BIT_MASK 0x1 DISPLAY_IDENTIFIER iv_flag_m_max_has_iae.iItfInput ECU_ADDRESS 0xFFF8BE16 /end MEASUREMENT
/begin MEASUREMENT iItfInput.flag_m_max_has_iae "Flag zur Aktivierung des max. zul. IAE_Moments aus der HAS-Funktion" UBYTE Conv.cItfInput._.flag_m_max_has_iae_S6_S3 1 100 0 1 BIT_MASK 0x1 DISPLAY_IDENTIFIER flag_m_max_has_iae.iItfInput ECU_ADDRESS 0xFFF8BE17 /end MEASUREMENT
/begin MEASUREMENT iItfInput.iv_iae_req_subst "iv-Größe: Überanpressung für IAE angefordert" UBYTE Conv.cItfInput._.iv_iae_req_subst_S6_S3 1 100 0 1 BIT_MASK 0x1 DISPLAY_IDENTIFIER iv_iae_req_subst.iItfInput ECU_ADDRESS 0xFFF8BE18 /end MEASUREMENT
/begin MEASUREMENT iItfInput.iae_req_subst "Eingang: Überanpressung für IAE angefordert" UBYTE Conv.cItfInput._.iae_req_subst_S6_S3 1 100 0 1 BIT_MASK 0x1 DISPLAY_IDENTIFIER iae_req_subst.iItfInput ECU_ADDRESS 0xFFF8BE19 /end MEASUREMENT
/begin MEASUREMENT iItfInput.z_modus_iae "Betriebsmodus für IAE" UBYTE Conv.cItfInput._.z_modus_iae_S6_S3 1 100 0 2 DISPLAY_IDENTIFIER z_modus_iae.iItfInput ECU_ADDRESS 0xFFF8BE1A /end MEASUREMENT
/begin MEASUREMENT iItfInput.iv_z_modus_iae "iv-Größe Betriebsmodus für IAE" UBYTE Conv.cItfInput._.iv_z_modus_iae_S6_S3 1 100 0 2 DISPLAY_IDENTIFIER iv_z_modus_iae.iItfInput ECU_ADDRESS 0xFFF8BE1B /end MEASUREMENT
/begin MEASUREMENT iItfInput.iv_m_max_has_iae "Eingang: maximal zulässiges IAE-Moment aus der HAS-Funktion" SWORD UMR_NM__1_1_0_S6_S3 1 100 -400 1640 DISPLAY_IDENTIFIER iv_m_max_has_iae.iItfInput ECU_ADDRESS 0xFFF8BE1C /end MEASUREMENT
/begin MEASUREMENT iItfInput.m_max_has_iae "maximal zulässiges IAE-Moment aus der HAS-Funktion" SWORD UMR_NM__1_1_0_S6_S3 1 100 -400 1640 DISPLAY_IDENTIFIER m_max_has_iae.iItfInput ECU_ADDRESS 0xFFF8BE1E /end MEASUREMENT
/begin MEASUREMENT iItfInput.iv_n_mot_llsoll_has "Eingang: Minimale Drehzahl E-Motor (Betrieb ohne externe Ölpumpe)" UBYTE UMR_U_MIN_10_1_0_S6_S3 1 100 0 2550 DISPLAY_IDENTIFIER iv_n_mot_llsoll_has.iItfInput ECU_ADDRESS 0xFFF8BE20 /end MEASUREMENT
/begin MEASUREMENT iItfInput.n_mot_llsoll_has "Minimale Drehzahl E-Motor (Betrieb ohne externe Ölpumpe)" UBYTE UMR_U_MIN_10_1_0_S6_S3 1 100 0 2550 DISPLAY_IDENTIFIER n_mot_llsoll_has.iItfInput ECU_ADDRESS 0xFFF8BE21 /end MEASUREMENT
/begin MEASUREMENT iItfInput.iv_ll_mot_aktiv "iv-Groesse Leerlaufregler aktiv" UBYTE UMR___1_1_0_S6_S3 1 100 0 255 DISPLAY_IDENTIFIER iv_ll_mot_aktiv.iItfInput ECU_ADDRESS 0xFFF8BE22 /end MEASUREMENT
/begin MEASUREMENT iItfInput.ll_mot_aktiv "Leerlaufregler aktiv" UBYTE UMR___1_1_0_S6_S3 1 100 0 255 DISPLAY_IDENTIFIER ll_mot_aktiv.iItfInput ECU_ADDRESS 0xFFF8BE23 /end MEASUREMENT
/begin MEASUREMENT iItfInput.iv_ll_mot_aktiv_status "iv-Groesse Status zu GET_LL_MOT_AKTIV" UBYTE Conv.cItfInput._.iv_ll_mot_aktiv_status_S6_S3 1 100 0 2 DISPLAY_IDENTIFIER iv_ll_mot_aktiv_status.iItfInput ECU_ADDRESS 0xFFF8BE24 /end MEASUREMENT
/begin MEASUREMENT iItfInput.ll_mot_aktiv_status "Status zu GET_LL_MOT_AKTIV" UBYTE Conv.cItfInput._.ll_mot_aktiv_status_S6_S3 1 100 0 2 DISPLAY_IDENTIFIER ll_mot_aktiv_status.iItfInput ECU_ADDRESS 0xFFF8BE25 /end MEASUREMENT
/begin MEASUREMENT iItfInput.flag_partfilt_aktiv "Zustand Dieselpartikelfilterregeneration" UBYTE Conv.cItfInput._.flag_partfilt_aktiv_S6_S3 1 100 0 1 BIT_MASK 0x1 DISPLAY_IDENTIFIER flag_partfilt_aktiv.iItfInput ECU_ADDRESS 0xFFF8BE26 /end MEASUREMENT
/begin MEASUREMENT iItfInput.iv_flag_partfilt_aktiv "Zustand Dieselpartikelfilterregeneration" UBYTE Conv.cItfInput._.iv_flag_partfilt_aktiv_S6_S3 1 100 0 1 BIT_MASK 0x1 DISPLAY_IDENTIFIER iv_flag_partfilt_aktiv.iItfInput ECU_ADDRESS 0xFFF8BE27 /end MEASUREMENT
/begin MEASUREMENT iItfInput.status_n_haltephase "Zustand der N-Halte-Phase" UBYTE Conv.cItfInput._.status_n_haltephase_S6_S3 1 100 0 7 DISPLAY_IDENTIFIER status_n_haltephase.iItfInput ECU_ADDRESS 0xFFF8BE28 /end MEASUREMENT
/begin MEASUREMENT iItfInput.iv_status_n_haltephase "Zustand der N-Halte-Phase" UBYTE Conv.cItfInput._.iv_status_n_haltephase_S6_S3 1 100 0 7 DISPLAY_IDENTIFIER iv_status_n_haltephase.iItfInput ECU_ADDRESS 0xFFF8BE29 /end MEASUREMENT
/begin MEASUREMENT iItfInput.fet0_active "Ist-Zustand des Highside Switches" UBYTE Conv.cItfInput._.fet0_active_S6_S3 1 100 0 4 DISPLAY_IDENTIFIER fet0_active.iItfInput ECU_ADDRESS 0xFFF8BE2A /end MEASUREMENT
/begin MEASUREMENT iItfInput.iv_fet0_active "Ist-Zustand des Highside Switches" UBYTE Conv.cItfInput._.iv_fet0_active_S6_S3 1 100 0 4 DISPLAY_IDENTIFIER iv_fet0_active.iItfInput ECU_ADDRESS 0xFFF8BE2B /end MEASUREMENT
/begin MEASUREMENT iItfInput.iv_usensor1_estatus "electrical status of sensor supply voltage 1" UBYTE Conv.cItfInput._.iv_usensor1_estatus_S6_S3 1 100 0 64 DISPLAY_IDENTIFIER iv_usensor1_estatus.iItfInput ECU_ADDRESS 0xFFF8BE2C /end MEASUREMENT
/begin MEASUREMENT iItfInput.usensor1_estatus "electrical status of sensor supply voltage 1" UBYTE Conv.cItfInput._.usensor1_estatus_S6_S3 1 100 0 64 DISPLAY_IDENTIFIER usensor1_estatus.iItfInput ECU_ADDRESS 0xFFF8BE2D /end MEASUREMENT
/begin MEASUREMENT iItfInput.ags_zka_index "Anzeige ob Moment waehrend der Schaltung ohne dki Aenderung nachgefuehrt wird." UBYTE Conv.cItfInput._.ags_zka_index_S6_S3 1 100 0 1 DISPLAY_IDENTIFIER ags_zka_index.iItfInput ECU_ADDRESS 0xFFF8BE2E /end MEASUREMENT
/begin MEASUREMENT iItfInput.iv_ags_zka_index "Eingangsgroese: Anzeige ob Moment waehrend der Schaltung ohne dki Aenderung nachgefuehrt wird." UBYTE Conv.cItfInput._.iv_ags_zka_index_S6_S3 1 100 0 1 DISPLAY_IDENTIFIER iv_ags_zka_index.iItfInput ECU_ADDRESS 0xFFF8BE2F /end MEASUREMENT
/begin MEASUREMENT iItfInput.iv_timeegsoff "Zeit die die EGS aus war" ULONG UMR_SEC__1_1_0_S6_S3 1 100 0 4294967295 DISPLAY_IDENTIFIER iv_timeegsoff.iItfInput ECU_ADDRESS 0xFFF8BE30 /end MEASUREMENT
/begin MEASUREMENT iItfInput.timeegsoff "Zeit die die EGS aus war" ULONG UMR_SEC__1_1_0_S6_S3 1 100 0 4294967295 DISPLAY_IDENTIFIER timeegsoff.iItfInput ECU_ADDRESS 0xFFF8BE34 /end MEASUREMENT
/begin MEASUREMENT iItfInput.iv_timeegsoff_status "Status der Zeit die die EGS aus war" UBYTE UMR___1_1_0_S6_S3 1 100 0 2 DISPLAY_IDENTIFIER iv_timeegsoff_status.iItfInput ECU_ADDRESS 0xFFF8BE38 /end MEASUREMENT
/begin MEASUREMENT iItfInput.timeegsoff_status "Status der Zeit die die EGS aus war" UBYTE UMR___1_1_0_S6_S3 1 100 0 2 DISPLAY_IDENTIFIER timeegsoff_status.iItfInput ECU_ADDRESS 0xFFF8BE39 /end MEASUREMENT
/begin MEASUREMENT iItfInput.iv_preadaption_start "Testersignal zur aktivierung der Preadaption nur ein Spezieller aktiviert die Funktion" UBYTE UMR___1_1_0_S6_S3 1 100 0 255 DISPLAY_IDENTIFIER iv_preadaption_start.iItfInput ECU_ADDRESS 0xFFF8BE3A /end MEASUREMENT
/begin MEASUREMENT iItfInput.preadaption_start "Stillstandadaption starten/stoppen über Kundentester" UBYTE UMR___1_1_0_S6_S3 1 100 0 255 DISPLAY_IDENTIFIER preadaption_start.iItfInput ECU_ADDRESS 0xFFF8BE3B /end MEASUREMENT
/begin MEASUREMENT iItfInput.azg_aktiv_stada "Stillstandadaption starten und stoppen über AZG" UBYTE UMR___1_1_0_S6_S3 1 100 0 255 DISPLAY_IDENTIFIER azg_aktiv_stada.iItfInput ECU_ADDRESS 0xFFF8BE3C /end MEASUREMENT
/begin MEASUREMENT iItfInput.sfkt_starten_azg "Sonderfunktionen ueber AZG starten" UBYTE UMR___1_1_0_S6_S3 1 100 0 255 DISPLAY_IDENTIFIER sfkt_starten_azg.iItfInput ECU_ADDRESS 0xFFF8BE3D /end MEASUREMENT
/begin MEASUREMENT iItfInputParaumsch.iv_seraprsas "Eingangsgroesse Nr. Serap-Umschaltung Ref. Arb. Seite" UBYTE UMR___1_1_0_S6_S3 1 100 0 1 DISPLAY_IDENTIFIER iv_seraprsas.iItfInputParaumsch ECU_ADDRESS 0xFFF8A072 /end MEASUREMENT
/begin MEASUREMENT iItfInputParaumsch.iv_seraprsas_komp "Komplement Eingangsgroesse Nr. Serap-Umschaltung Ref. Arb. Seite" UBYTE UMR___1_1_0_S6_S3 1 100 254 255 DISPLAY_IDENTIFIER iv_seraprsas_komp.iItfInputParaumsch ECU_ADDRESS 0xFFF8A073 /end MEASUREMENT
/begin MEASUREMENT iItfInputParaumsch.serap_rsas "Eingangsgroesse Nr. Serap-Umschaltung Ref. Arb. Seite" UBYTE UMR___1_1_0_S6_S3 1 100 0 1 DISPLAY_IDENTIFIER serap_rsas.iItfInputParaumsch ECU_ADDRESS 0xFFF8A074 /end MEASUREMENT
/begin MEASUREMENT iItfInputParaumsch.serap_rsas_komp "Komplement Eingangsgroesse Nr. Serap-Umschaltung Ref. Arb. Seite" UBYTE UMR___1_1_0_S6_S3 1 100 254 255 DISPLAY_IDENTIFIER serap_rsas_komp.iItfInputParaumsch ECU_ADDRESS 0xFFF8A075 /end MEASUREMENT
/begin MEASUREMENT iItfInputParaumsch.iv_f_e_fahren_aktiv "Elektomotorisches Fahren aktiv" UBYTE Conv.cItfInputParaumsch._.iv_f_e_fahren_aktiv_S6_S3 1 100 0 1 DISPLAY_IDENTIFIER iv_f_e_fahren_aktiv.iItfInputParaumsch ECU_ADDRESS 0xFFF8A076 /end MEASUREMENT
/begin MEASUREMENT iItfInputParaumsch.f_e_fahren_aktiv "Elektomotorisches Fahren aktiv" UBYTE Conv.cItfInputParaumsch._.f_e_fahren_aktiv_S6_S3 1 100 0 1 DISPLAY_IDENTIFIER f_e_fahren_aktiv.iItfInputParaumsch ECU_ADDRESS 0xFFF8A077 /end MEASUREMENT
/begin MEASUREMENT iAzsKorgl.pos_red "Reduzierte Positioninformation" UBYTE Conv.cAzsKorgl._.pos_red_S6_S3 1 100 0 255 DISPLAY_IDENTIFIER pos_red.iAzsKorgl ECU_ADDRESS 0xFFF8C848 /end MEASUREMENT
/begin MEASUREMENT iAzsKorgl.parksperre_ziel "Parksperre Zielvorgabe" UBYTE Conv.cAzsKorgl._.parksperre_ziel_S6_S3 1 100 0 1 BIT_MASK 0x1 DISPLAY_IDENTIFIER parksperre_ziel.iAzsKorgl ECU_ADDRESS 0xFFF8C849 /end MEASUREMENT
/begin MEASUREMENT iAzsKorgl.f_kfl_direkt "Soll ein Kraftfluss-Wechsel direkt durchgefuert werden" UBYTE Conv.cAzsKorgl._.f_kfl_direkt_S6_S3 1 100 0 1 BIT_MASK 0x1 DISPLAY_IDENTIFIER f_kfl_direkt.iAzsKorgl ECU_ADDRESS 0xFFF8C84A /end MEASUREMENT
/begin MEASUREMENT iAzsKorgl.f_schaltung_direkt "Soll ein Gang-Wechsel direkt durchgefuert werden" UBYTE Conv.cAzsKorgl._.f_schaltung_direkt_S6_S3 1 100 0 1 BIT_MASK 0x1 DISPLAY_IDENTIFIER f_schaltung_direkt.iAzsKorgl ECU_ADDRESS 0xFFF8C84B /end MEASUREMENT
/begin MEASUREMENT iAzsKorgl.f_stromlos_zzs "Befindet sich die ZZS im Stromlos-Zustand (Hydraulischer Notlauf/elektr. simulierter Notlauf)" UBYTE Conv.cAzsKorgl._.f_stromlos_zzs_S6_S3 1 100 0 1 BIT_MASK 0x1 DISPLAY_IDENTIFIER f_stromlos_zzs.iAzsKorgl ECU_ADDRESS 0xFFF8C84C /end MEASUREMENT
/begin MEASUREMENT iAzsKorgl.f_notgang_gesetzt "Ist derzeit ein Notgang gesetzt" UBYTE Conv.cAzsKorgl._.f_notgang_gesetzt_S6_S3 1 100 0 1 BIT_MASK 0x1 DISPLAY_IDENTIFIER f_notgang_gesetzt.iAzsKorgl ECU_ADDRESS 0xFFF8C84D /end MEASUREMENT
/begin MEASUREMENT iAzsKorgl.f_abbruch_schaltung_durch_ga "Soll die laufende Schaltung aufgrund eines Gang-Auslegen beendet werden - Hinweis: auf Messgroesse ist dieses Ereignis nicht sichtbar" UBYTE Conv.cAzsKorgl._.f_abbruch_schaltung_durch_ga_S6_S3 1 100 0 1 BIT_MASK 0x1 DISPLAY_IDENTIFIER f_abbruch_schaltung_durch_ga.iAzsKorgl ECU_ADDRESS 0xFFF8C84E /end MEASUREMENT
/begin MEASUREMENT iAzsKorgl.istgang_abbruch_schaltung_durch_ga "Istgang der laufende Schaltung die aufgrund eines Gang-Auslegen beendet wurde" SBYTE Conv.cAzsKorgl._.istgang_abbruch_schaltung_durch_ga_S6_S3 1 100 -1 8 DISPLAY_IDENTIFIER istgang_abbruch_schaltung_durch_ga.iAzsKorgl ECU_ADDRESS 0xFFF8C84F /end MEASUREMENT
/begin MEASUREMENT iAzsUeFunktionen.ue_fkt_abschalten "Ueberwachungsfunktionen sollen abgeschalten werden" UBYTE UMR___1_1_0_S6_S3 1 100 0 255 DISPLAY_IDENTIFIER ue_fkt_abschalten.iAzsUeFunktionen ECU_ADDRESS 0xFFF8A0AC /end MEASUREMENT
/begin MEASUREMENT iAzsUeFunktionen.ue_fkt_aufgerufen "-Ueberwachungsfunktionen abschalten/freigeben- wurde in diesem Zyklus aufgerufen" UBYTE UMR___1_1_0_S6_S3 1 100 0 255 DISPLAY_IDENTIFIER ue_fkt_aufgerufen.iAzsUeFunktionen ECU_ADDRESS 0xFFF8A0AD /end MEASUREMENT
/begin MEASUREMENT iAzsSchluesselStart.s_start_status "Zustand des Schluessel-Starts" UBYTE Conv.cAzsSchluesselStart._.s_start_status_S6_S3 1 100 0 3 DISPLAY_IDENTIFIER s_start_status.iAzsSchluesselStart ECU_ADDRESS 0xFFF8A690 /end MEASUREMENT
/begin MEASUREMENT iAzsSZPulsAda.TimerSZPulsAda.time "Zeit des Timers" UWORD UMR_SEC__1_100_0_S6_S3 1 100 0 655.35 DISPLAY_IDENTIFIER TimerSZPulsAda.iAzsSZPulsAda ECU_ADDRESS 0xFFF8A0A8 /end MEASUREMENT
/begin MEASUREMENT iAzsSZPulsAda.TimerMaxTime.time "Zeit des Timers" UWORD UMR_SEC__1_100_0_S6_S3 1 100 0 655.35 DISPLAY_IDENTIFIER TimerMaxTime.iAzsSZPulsAda ECU_ADDRESS 0xFFF8A0AA /end MEASUREMENT
/begin MEASUREMENT iAzsSZPulsAda.z_sonder_zustand_puls_ada "Zustandsgraph der ZZS, um den Sonderzustand fuer die Puls-Pre-Ada anzufahren" UBYTE Conv.cAzsSZPulsAda._.z_sonder_zustand_puls_ada_S6_S3 1 100 0 12 DISPLAY_IDENTIFIER z_sonder_zustand_puls_ada.iAzsSZPulsAda ECU_ADDRESS 0xFFF8A0A2 /end MEASUREMENT
/begin MEASUREMENT iAzsSZPulsAda.f_neutral_vorgabe "Kraftfluss-Vorgabe Neutral fuer SZPuls" UBYTE Conv.cAzsSZPulsAda._.f_neutral_vorgabe_S6_S3 1 100 0 1 BIT_MASK 0x1 DISPLAY_IDENTIFIER f_neutral_vorgabe.iAzsSZPulsAda ECU_ADDRESS 0xFFF8A0A3 /end MEASUREMENT
/begin MEASUREMENT iAzsSZPulsAda.f_gang_vorgabe "Gang-Vorgabe fuer SZPuls" UBYTE Conv.cAzsSZPulsAda._.f_gang_vorgabe_S6_S3 1 100 0 1 BIT_MASK 0x1 DISPLAY_IDENTIFIER f_gang_vorgabe.iAzsSZPulsAda ECU_ADDRESS 0xFFF8A0A4 /end MEASUREMENT
/begin MEASUREMENT iAzsSZPulsAda.f_abbruch_pre_ada_azs "Abbruch der uebergeordneten Pre-Adaption aus Sicht der ZZS" UBYTE Conv.cAzsSZPulsAda._.f_abbruch_pre_ada_azs_S6_S3 1 100 0 1 BIT_MASK 0x1 DISPLAY_IDENTIFIER f_abbruch_pre_ada_azs.iAzsSZPulsAda ECU_ADDRESS 0xFFF8A0A5 /end MEASUREMENT
/begin MEASUREMENT iAzsSZPulsAda.f_sz_puls_ada_aktiv "Sonderzustand: Beeinflussung der kraftschliessenden Kupplung" UBYTE Conv.cAzsSZPulsAda._.f_sz_puls_ada_aktiv_S6_S3 1 100 0 1 BIT_MASK 0x1 DISPLAY_IDENTIFIER f_sz_puls_ada_aktiv.iAzsSZPulsAda ECU_ADDRESS 0xFFF8A0A6 /end MEASUREMENT
/begin MEASUREMENT iAzsSZPulsAda.sz_puls_ada_gang "Gang-Vorgabe von SZPuls" SBYTE Conv.cAzsSZPulsAda._.sz_puls_ada_gang_S6_S3 1 100 -1 8 DISPLAY_IDENTIFIER sz_puls_ada_gang.iAzsSZPulsAda ECU_ADDRESS 0xFFF8A0A7 /end MEASUREMENT
/begin MEASUREMENT iAzsNeutralEbene.TimerNE.time "Zeit des Timers" UWORD UMR_SEC__1_100_0_S6_S3 1 100 0 655.35 DISPLAY_IDENTIFIER TimerNE.iAzsNeutralEbene ECU_ADDRESS 0xFFF8C896 /end MEASUREMENT
/begin MEASUREMENT iAzsNeutralEbene.z_neutral_ebene "Zustand der Neutral Ebenen Ansteuerung" UBYTE Conv.cAzsNeutralEbene._.z_neutral_ebene_S6_S3 1 100 0 14 DISPLAY_IDENTIFIER z_neutral_ebene.iAzsNeutralEbene ECU_ADDRESS 0xFFF8C890 /end MEASUREMENT
/begin MEASUREMENT iAzsNeutralEbene.fkt_neutral_ebene "welche Funktion fordert eine Neutral-Ebenen Ansteuerung an" UWORD Conv.cAzsNeutralEbene._.fkt_neutral_ebene_S6_S3 1 100 0 256 DISPLAY_IDENTIFIER fkt_neutral_ebene.iAzsNeutralEbene ECU_ADDRESS 0xFFF8C892 /end MEASUREMENT
/begin MEASUREMENT iAzsNeutralEbene.pos_neutral_n_stern "reine Anzeigegroesse fuer ES" UBYTE Conv.cAzsNeutralEbene._.pos_neutral_n_stern_S6_S3 1 100 0 5 DISPLAY_IDENTIFIER pos_neutral_n_stern.iAzsNeutralEbene ECU_ADDRESS 0xFFF8C894 /end MEASUREMENT
/begin MEASUREMENT iAzsKflSoll.kfl_soll "kfl_soll" UBYTE Conv.cAzsKflSoll._.kfl_soll_S6_S3 1 100 0 2 DISPLAY_IDENTIFIER kfl_soll.iAzsKflSoll ECU_ADDRESS 0xFFF8A392 /end MEASUREMENT
/begin MEASUREMENT iAzsKflZiel.kfl_ziel "kfl_ziel" UBYTE Conv.cAzsKflZiel._.kfl_ziel_S6_S3 1 100 0 2 DISPLAY_IDENTIFIER kfl_ziel.iAzsKflZiel ECU_ADDRESS 0xFFF8A393 /end MEASUREMENT
/begin MEASUREMENT iAzsKflIst.kfl_ist "kfl_ist" UBYTE Conv.cAzsKflIst._.kfl_ist_S6_S3 1 100 0 2 DISPLAY_IDENTIFIER kfl_ist.iAzsKflIst ECU_ADDRESS 0xFFF8A68E /end MEASUREMENT
/begin COMPU_METHOD SBW_VKMH_160_S1_S3 "int = ((phys * 160) / 1) - (0) km/h" RAT_FUNC "%5.3" "km/h" COEFFS 0 160 -0 0 0 1 /end COMPU_METHOD
/begin COMPU_METHOD UMR___1_1000_0_S6_S3 "int = ((phys * 1000) / 1) - (0) [-]" RAT_FUNC "%5.3" "[-]" COEFFS 0 1000 -0 0 0 1 /end COMPU_METHOD
/begin COMPU_METHOD UMR___1_100_0_S6_S3 "int = ((phys * 100) / 1) - (0) [-]" RAT_FUNC "%4.2" "[-]" COEFFS 0 100 -0 0 0 1 /end COMPU_METHOD
/begin COMPU_METHOD UMR___1_1_0_S6_S3 "int = ((phys * 1) / 1) - (0) [-]" RAT_FUNC "%2.0" "[-]" COEFFS 0 1 -0 0 0 1 /end COMPU_METHOD
/begin COMPU_METHOD UMR_MA__1_10_0_S6_S3 "int = ((phys * 10) / 1) - (0) [mA]" RAT_FUNC "%3.1" "[mA]" COEFFS 0 10 -0 0 0 1 /end COMPU_METHOD
/begin COMPU_METHOD UMR_NM__1_10_0_S6_S3 "int = ((phys * 10) / 1) - (0) [Nm]" RAT_FUNC "%3.1" "[Nm]" COEFFS 0 10 -0 0 0 1 /end COMPU_METHOD
/begin COMPU_METHOD UMR_NM__1_1_0_S6_S3 "int = ((phys * 1) / 1) - (0) [Nm]" RAT_FUNC "%2.0" "[Nm]" COEFFS 0 1 -0 0 0 1 /end COMPU_METHOD
/begin COMPU_METHOD UMR_NM__8_1_M50_S6_S3 "int = ((phys * 1) / 8) - (-50) [Nm]" RAT_FUNC "%2.0" "[Nm]" COEFFS 0 1 400 0 0 8 /end COMPU_METHOD
/begin COMPU_METHOD UMR_NM_SEC_1_1_0_S6_S3 "int = ((phys * 1) / 1) - (0) [Nm/s]" RAT_FUNC "%2.0" "[Nm/s]" COEFFS 0 1 -0 0 0 1 /end COMPU_METHOD
/begin COMPU_METHOD UMR_MBAR__1_1_0_S6_S3 "int = ((phys * 1) / 1) - (0) [mbar]" RAT_FUNC "%2.0" "[mbar]" COEFFS 0 1 -0 0 0 1 /end COMPU_METHOD
/begin COMPU_METHOD UMR_BAR__1_1_0_S6_S3 "int = ((phys * 1) / 1) - (0) [bar]" RAT_FUNC "%2.0" "[bar]" COEFFS 0 1 -0 0 0 1 /end COMPU_METHOD
/begin COMPU_METHOD UMR_BAR__1_2_0_S6_S3 "int = ((phys * 2) / 1) - (0) [bar]" RAT_FUNC "%4.2" "[bar]" COEFFS 0 2 -0 0 0 1 /end COMPU_METHOD
/begin COMPU_METHOD UMR_U_MIN_1_1_0_S6_S3 "int = ((phys * 1) / 1) - (0) [U/min]" RAT_FUNC "%2.0" "[U/min]" COEFFS 0 1 -0 0 0 1 /end COMPU_METHOD
/begin COMPU_METHOD UMR_U_MIN_10_1_0_S6_S3 "int = ((phys * 1) / 10) - (0) [U/min]" RAT_FUNC "%2.0" "[U/min]" COEFFS 0 1 -0 0 0 10 /end COMPU_METHOD
/begin COMPU_METHOD UMR_U_MIN_32_1_0_S6_S3 "int = ((phys * 1) / 32) - (0) [U/min]" RAT_FUNC "%2.0" "[U/min]" COEFFS 0 1 -0 0 0 32 /end COMPU_METHOD
/begin COMPU_METHOD UMR_U_MINSEC_1_1_0_S6_S3 "int = ((phys * 1) / 1) - (0) [U/(min*s)]" RAT_FUNC "%2.0" "[U/(min*s)]" COEFFS 0 1 -0 0 0 1 /end COMPU_METHOD
/begin COMPU_METHOD UMR_SEC__1_100_0_S6_S3 "int = ((phys * 100) / 1) - (0) [s]" RAT_FUNC "%4.2" "[s]" COEFFS 0 100 -0 0 0 1 /end COMPU_METHOD
/begin COMPU_METHOD UMR_SEC__1_1_0_S6_S3 "int = ((phys * 1) / 1) - (0) [s]" RAT_FUNC "%2.0" "[s]" COEFFS 0 1 -0 0 0 1 /end COMPU_METHOD
/begin COMPU_METHOD UMR_MIN__1_1_0_S6_S3 "int = ((phys * 1) / 1) - (0) [min]" RAT_FUNC "%2.0" "[min]" COEFFS 0 1 -0 0 0 1 /end COMPU_METHOD
/begin COMPU_METHOD UMR__SEC_1_1000_0_S6_S3 "int = ((phys * 1000) / 1) - (0) [1/s]" RAT_FUNC "%5.3" "[1/s]" COEFFS 0 1000 -0 0 0 1 /end COMPU_METHOD
/begin COMPU_METHOD UMR_GRADC__1_1_0_S6_S3 "int = ((phys * 1) / 1) - (0) [°C]" RAT_FUNC "%2.0" "[°C]" COEFFS 0 1 -0 0 0 1 /end COMPU_METHOD
/begin COMPU_METHOD UMR_GRADC__1_1_M40_S6_S3 "int = ((phys * 1) / 1) - (-40) [°C]" RAT_FUNC "%2.0" "[°C]" COEFFS 0 1 40 0 0 1 /end COMPU_METHOD
/begin COMPU_METHOD UMR_GRADC__1_1_M48_S6_S3 "int = ((phys * 1) / 1) - (-48) [°C]" RAT_FUNC "%2.0" "[°C]" COEFFS 0 1 48 0 0 1 /end COMPU_METHOD
/begin COMPU_METHOD UMR_PROZENT__20_51_0_S6_S3 "int = ((phys * 51) / 20) - (0) [%]" RAT_FUNC "%6.4" "[%]" COEFFS 0 51 -0 0 0 20 /end COMPU_METHOD
/begin COMPU_METHOD UMR_PROZENT__1_1_0_2_S6_S3 "int = ((phys * 1) / 1) - (0) [%]" RAT_FUNC "%2.0" "[%]" COEFFS 0 1 -0 0 0 1 /end COMPU_METHOD
/begin COMPU_METHOD UMR_PROZENT_SEC_20_51_0_S6_S3 "int = ((phys * 51) / 20) - (0) [%/s]" RAT_FUNC "%6.4" "[%/s]" COEFFS 0 51 -0 0 0 20 /end COMPU_METHOD
/begin COMPU_METHOD UMR_VOLT__1_1000_0_S6_S3 "int = ((phys * 1000) / 1) - (0) [Volt]" RAT_FUNC "%5.3" "[Volt]" COEFFS 0 1000 -0 0 0 1 /end COMPU_METHOD
/begin COMPU_METHOD UMR_VOLT__1_10_0_S6_S3 "int = ((phys * 10) / 1) - (0) [Volt]" RAT_FUNC "%3.1" "[Volt]" COEFFS 0 10 -0 0 0 1 /end COMPU_METHOD
/begin COMPU_METHOD UMR_KM__1_1_0_S6_S3 "int = ((phys * 1) / 1) - (0) [Km]" RAT_FUNC "%2.0" "[Km]" COEFFS 0 1 -0 0 0 1 /end COMPU_METHOD
/begin COMPU_METHOD UMR_KM_H_1_1_0_S6_S3 "int = ((phys * 1) / 1) - (0) [km/h]" RAT_FUNC "%2.0" "[km/h]" COEFFS 0 1 -0 0 0 1 /end COMPU_METHOD
/begin COMPU_METHOD UMR_KM_H_1_16_0_S6_S3 "int = ((phys * 16) / 1) - (0) [km/h]" RAT_FUNC "%4.2" "[km/h]" COEFFS 0 16 -0 0 0 1 /end COMPU_METHOD
/begin COMPU_METHOD UMR_GRAD__1_3_M128_S6_S3 "int = ((phys * 3) / 1) - (-128) [Grad]" RAT_FUNC "%5.3" "[Grad]" COEFFS 0 3 128 0 0 1 /end COMPU_METHOD
/begin COMPU_METHOD UMR_GRAD__1_3_0_S6_S3 "int = ((phys * 3) / 1) - (0) [Grad]" RAT_FUNC "%5.3" "[Grad]" COEFFS 0 3 -0 0 0 1 /end COMPU_METHOD
/begin COMPU_METHOD UMR_M_SEC2_1_32_0_S6_S3 "int = ((phys * 32) / 1) - (0) [m/s^2]" RAT_FUNC "%4.2" "[m/s^2]" COEFFS 0 32 -0 0 0 1 /end COMPU_METHOD
/begin COMPU_METHOD Conv.mv_1_S6_S3 "Umrechnung fuer Messgroesse mv_1" TAB_VERB "%4.0" "" COMPU_TAB_REF Conv.mv_1_S6_S3 /end COMPU_METHOD
/begin COMPU_METHOD Conv.mv_2_S6_S3 "Umrechnung fuer Messgroesse mv_2" TAB_VERB "%4.0" "" COMPU_TAB_REF Conv.mv_2_S6_S3 /end COMPU_METHOD
/begin COMPU_METHOD Conv.mv_3_S6_S3 "Umrechnung fuer Messgroesse mv_3" TAB_VERB "%4.0" "" COMPU_TAB_REF Conv.mv_3_S6_S3 /end COMPU_METHOD
/begin COMPU_METHOD Conv.cItfInput._.notlauf_S6_S3 "Umrechnung fuer Messgroesse cItfInput::notlauf" TAB_VERB "%4.0" "" COMPU_TAB_REF Conv.cItfInput._.notlauf_S6_S3 /end COMPU_METHOD
/begin COMPU_METHOD Conv.cItfInput._.standby_S6_S3 "Umrechnung fuer Messgroesse cItfInput::standby" TAB_VERB "%4.0" "" COMPU_TAB_REF Conv.cItfInput._.standby_S6_S3 /end COMPU_METHOD
/begin COMPU_METHOD Conv.cItfInput._.fahrbetrieb_S6_S3 "Umrechnung fuer Messgroesse cItfInput::fahrbetrieb" TAB_VERB "%4.0" "" COMPU_TAB_REF Conv.cItfInput._.fahrbetrieb_S6_S3 /end COMPU_METHOD
/begin COMPU_METHOD Conv.cItfInput._.iv_gnotinfo_S6_S3 "Umrechnung fuer Messgroesse cItfInput::iv_gnotinfo" TAB_VERB "%4.0" "" COMPU_TAB_REF Conv.cItfInput._.iv_gnotinfo_S6_S3 /end COMPU_METHOD
/begin COMPU_METHOD Conv.cItfInput._.notgang_info_S6_S3 "Umrechnung fuer Messgroesse cItfInput::notgang_info" TAB_VERB "%4.0" "" COMPU_TAB_REF Conv.cItfInput._.notgang_info_S6_S3 /end COMPU_METHOD
/begin COMPU_METHOD Conv.cItfInput._.notgang_S6_S3 "Umrechnung fuer Messgroesse cItfInput::notgang" TAB_VERB "%4.0" "" COMPU_TAB_REF Conv.cItfInput._.notgang_S6_S3 /end COMPU_METHOD
/begin COMPU_METHOD Conv.cItfInput._.iv_edsmversatzinfo_S6_S3 "Umrechnung fuer Messgroesse cItfInput::iv_edsmversatzinfo" TAB_VERB "%4.0" "" COMPU_TAB_REF Conv.cItfInput._.iv_edsmversatzinfo_S6_S3 /end COMPU_METHOD
/begin COMPU_METHOD Conv.cItfInput._.iv_fahrbet_task_S6_S3 "Umrechnung fuer Messgroesse cItfInput::iv_fahrbet_task" TAB_VERB "%4.0" "" COMPU_TAB_REF Conv.cItfInput._.iv_fahrbet_task_S6_S3 /end COMPU_METHOD
/begin COMPU_METHOD Conv.cItfInput._.iv_notltask_S6_S3 "Umrechnung fuer Messgroesse cItfInput::iv_notltask" TAB_VERB "%4.0" "" COMPU_TAB_REF Conv.cItfInput._.iv_notltask_S6_S3 /end COMPU_METHOD
/begin COMPU_METHOD Conv.cItfInput._.iv_sbytask_S6_S3 "Umrechnung fuer Messgroesse cItfInput::iv_sbytask" TAB_VERB "%4.0" "" COMPU_TAB_REF Conv.cItfInput._.iv_sbytask_S6_S3 /end COMPU_METHOD
/begin COMPU_METHOD Conv.cItfInput._.verbot_sas_fkt_S6_S3 "Umrechnung fuer Messgroesse cItfInput::verbot_sas_fkt" TAB_VERB "%4.0" "" COMPU_TAB_REF Conv.cItfInput._.verbot_sas_fkt_S6_S3 /end COMPU_METHOD
/begin COMPU_METHOD Conv.cItfInput._.saf_has_aktiv_S6_S3 "Umrechnung fuer Messgroesse cItfInput::saf_has_aktiv" TAB_VERB "%4.0" "" COMPU_TAB_REF Conv.cItfInput._.saf_has_aktiv_S6_S3 /end COMPU_METHOD
/begin COMPU_METHOD Conv.cItfInput._.schluesselstart_aktiv_S6_S3 "Umrechnung fuer Messgroesse cItfInput::schluesselstart_aktiv" TAB_VERB "%4.0" "" COMPU_TAB_REF Conv.cItfInput._.schluesselstart_aktiv_S6_S3 /end COMPU_METHOD
/begin COMPU_METHOD Conv.cItfInput._.svh_aktiv_has_S6_S3 "Umrechnung fuer Messgroesse cItfInput::svh_aktiv_has" TAB_VERB "%4.0" "" COMPU_TAB_REF Conv.cItfInput._.svh_aktiv_has_S6_S3 /end COMPU_METHOD
/begin COMPU_METHOD Conv.cItfInput._.iv_has_aktiv_S6_S3 "Umrechnung fuer Messgroesse cItfInput::iv_has_aktiv" TAB_VERB "%4.0" "" COMPU_TAB_REF Conv.cItfInput._.iv_has_aktiv_S6_S3 /end COMPU_METHOD
/begin COMPU_METHOD Conv.cItfInput._.has_aktiv_S6_S3 "Umrechnung fuer Messgroesse cItfInput::has_aktiv" TAB_VERB "%4.0" "" COMPU_TAB_REF Conv.cItfInput._.has_aktiv_S6_S3 /end COMPU_METHOD
/begin COMPU_METHOD Conv.cItfInput._.iv_pos_S6_S3 "Umrechnung fuer Messgroesse cItfInput::iv_pos" TAB_VERB "%4.0" "" COMPU_TAB_REF Conv.cItfInput._.iv_pos_S6_S3 /end COMPU_METHOD
/begin COMPU_METHOD Conv.cItfInput._.iv_gsoll_S6_S3 "Umrechnung fuer Messgroesse cItfInput::iv_gsoll" TAB_VERB "%4.0" "" COMPU_TAB_REF Conv.cItfInput._.iv_gsoll_S6_S3 /end COMPU_METHOD
/begin COMPU_METHOD Conv.cItfInput._.iv_blsdefakt_S6_S3 "Umrechnung fuer Messgroesse cItfInput::iv_blsdefakt" TAB_VERB "%4.0" "" COMPU_TAB_REF Conv.cItfInput._.iv_blsdefakt_S6_S3 /end COMPU_METHOD
/begin COMPU_METHOD Conv.cItfInput._.iv_blsdefpas_S6_S3 "Umrechnung fuer Messgroesse cItfInput::iv_blsdefpas" TAB_VERB "%4.0" "" COMPU_TAB_REF Conv.cItfInput._.iv_blsdefpas_S6_S3 /end COMPU_METHOD
/begin COMPU_METHOD Conv.cItfInput._.iv_feststellbremseaktiv_S6_S3 "Umrechnung fuer Messgroesse cItfInput::iv_feststellbremseaktiv" TAB_VERB "%4.0" "" COMPU_TAB_REF Conv.cItfInput._.iv_feststellbremseaktiv_S6_S3 /end COMPU_METHOD
/begin COMPU_METHOD Conv.cItfInput._.iv_el_not_entr_S6_S3 "Umrechnung fuer Messgroesse cItfInput::iv_el_not_entr" TAB_VERB "%4.0" "" COMPU_TAB_REF Conv.cItfInput._.iv_el_not_entr_S6_S3 /end COMPU_METHOD
/begin COMPU_METHOD Conv.cItfInput._.iv_druck_vorhanden_mod_S6_S3 "Umrechnung fuer Messgroesse cItfInput::iv_druck_vorhanden_mod" TAB_VERB "%4.0" "" COMPU_TAB_REF Conv.cItfInput._.iv_druck_vorhanden_mod_S6_S3 /end COMPU_METHOD
/begin COMPU_METHOD Conv.cItfInput._.iv_anhaengeraktiv_S6_S3 "Umrechnung fuer Messgroesse cItfInput::iv_anhaengeraktiv" TAB_VERB "%4.0" "" COMPU_TAB_REF Conv.cItfInput._.iv_anhaengeraktiv_S6_S3 /end COMPU_METHOD
/begin COMPU_METHOD Conv.cItfInput._.iv_transportmode_aktiv_S6_S3 "Umrechnung fuer Messgroesse cItfInput::iv_transportmode_aktiv" TAB_VERB "%4.0" "" COMPU_TAB_REF Conv.cItfInput._.iv_transportmode_aktiv_S6_S3 /end COMPU_METHOD
/begin COMPU_METHOD Conv.cItfInput._.iv_ascreg_S6_S3 "Umrechnung fuer Messgroesse cItfInput::iv_ascreg" TAB_VERB "%4.0" "" COMPU_TAB_REF Conv.cItfInput._.iv_ascreg_S6_S3 /end COMPU_METHOD
/begin COMPU_METHOD Conv.cItfInput._.iv_ascpas_S6_S3 "Umrechnung fuer Messgroesse cItfInput::iv_ascpas" TAB_VERB "%4.0" "" COMPU_TAB_REF Conv.cItfInput._.iv_ascpas_S6_S3 /end COMPU_METHOD
/begin COMPU_METHOD Conv.cItfInput._.iv_pssensorsignal_S6_S3 "Umrechnung fuer Messgroesse cItfInput::iv_pssensorsignal" TAB_VERB "%4.0" "" COMPU_TAB_REF Conv.cItfInput._.iv_pssensorsignal_S6_S3 /end COMPU_METHOD
/begin COMPU_METHOD Conv.cItfInput._.iv_pssensorsignal_status_S6_S3 "Umrechnung fuer Messgroesse cItfInput::iv_pssensorsignal_status" TAB_VERB "%4.0" "" COMPU_TAB_REF Conv.cItfInput._.iv_pssensorsignal_status_S6_S3 /end COMPU_METHOD
/begin COMPU_METHOD Conv.cItfInput._.manuell_S6_S3 "Umrechnung fuer Messgroesse cItfInput::manuell" TAB_VERB "%4.0" "" COMPU_TAB_REF Conv.cItfInput._.manuell_S6_S3 /end COMPU_METHOD
/begin COMPU_METHOD Conv.cItfInput._.iv_zzuendung_S6_S3 "Umrechnung fuer Messgroesse cItfInput::iv_zzuendung" TAB_VERB "%4.0" "" COMPU_TAB_REF Conv.cItfInput._.iv_zzuendung_S6_S3 /end COMPU_METHOD
/begin COMPU_METHOD Conv.cItfInput._.z_zuendung_S6_S3 "Umrechnung fuer Messgroesse cItfInput::z_zuendung" TAB_VERB "%4.0" "" COMPU_TAB_REF Conv.cItfInput._.z_zuendung_S6_S3 /end COMPU_METHOD
/begin COMPU_METHOD Conv.cItfInput._.freigabe_posvdiag_S6_S3 "Umrechnung fuer Messgroesse cItfInput::freigabe_posvdiag" TAB_VERB "%4.0" "" COMPU_TAB_REF Conv.cItfInput._.freigabe_posvdiag_S6_S3 /end COMPU_METHOD
/begin COMPU_METHOD Conv.cItfInput._.iv_freigabe_posvdiag_S6_S3 "Umrechnung fuer Messgroesse cItfInput::iv_freigabe_posvdiag" TAB_VERB "%4.0" "" COMPU_TAB_REF Conv.cItfInput._.iv_freigabe_posvdiag_S6_S3 /end COMPU_METHOD
/begin COMPU_METHOD Conv.cItfInput._.iv_posstatus_S6_S3 "Umrechnung fuer Messgroesse cItfInput::iv_posstatus" TAB_VERB "%4.0" "" COMPU_TAB_REF Conv.cItfInput._.iv_posstatus_S6_S3 /end COMPU_METHOD
/begin COMPU_METHOD Conv.cItfInput._.iv_nabstatus_S6_S3 "Umrechnung fuer Messgroesse cItfInput::iv_nabstatus" TAB_VERB "%4.0" "" COMPU_TAB_REF Conv.cItfInput._.iv_nabstatus_S6_S3 /end COMPU_METHOD
/begin COMPU_METHOD Conv.cItfInput._.iv_ntstatus_S6_S3 "Umrechnung fuer Messgroesse cItfInput::iv_ntstatus" TAB_VERB "%4.0" "" COMPU_TAB_REF Conv.cItfInput._.iv_ntstatus_S6_S3 /end COMPU_METHOD
/begin COMPU_METHOD Conv.cItfInput._.iv_nmotstatus_S6_S3 "Umrechnung fuer Messgroesse cItfInput::iv_nmotstatus" TAB_VERB "%4.0" "" COMPU_TAB_REF Conv.cItfInput._.iv_nmotstatus_S6_S3 /end COMPU_METHOD
/begin COMPU_METHOD Conv.cItfInput._.iv_mmotstatus_S6_S3 "Umrechnung fuer Messgroesse cItfInput::iv_mmotstatus" TAB_VERB "%4.0" "" COMPU_TAB_REF Conv.cItfInput._.iv_mmotstatus_S6_S3 /end COMPU_METHOD
/begin COMPU_METHOD Conv.cItfInput._.iv_cgetrstatus_S6_S3 "Umrechnung fuer Messgroesse cItfInput::iv_cgetrstatus" TAB_VERB "%4.0" "" COMPU_TAB_REF Conv.cItfInput._.iv_cgetrstatus_S6_S3 /end COMPU_METHOD
/begin COMPU_METHOD Conv.cItfInput._.iv_neigungstatus_S6_S3 "Umrechnung fuer Messgroesse cItfInput::iv_neigungstatus" TAB_VERB "%4.0" "" COMPU_TAB_REF Conv.cItfInput._.iv_neigungstatus_S6_S3 /end COMPU_METHOD
/begin COMPU_METHOD Conv.cItfInput._.init_n_t_S6_S3 "Umrechnung fuer Messgroesse cItfInput::init_n_t" TAB_VERB "%4.0" "" COMPU_TAB_REF Conv.cItfInput._.init_n_t_S6_S3 /end COMPU_METHOD
/begin COMPU_METHOD Conv.cItfInput._.init_n_abneu_gef_S6_S3 "Umrechnung fuer Messgroesse cItfInput::init_n_abneu_gef" TAB_VERB "%4.0" "" COMPU_TAB_REF Conv.cItfInput._.init_n_abneu_gef_S6_S3 /end COMPU_METHOD
/begin COMPU_METHOD Conv.cItfInput._.pos_S6_S3 "Umrechnung fuer Messgroesse cItfInput::pos" TAB_VERB "%4.0" "" COMPU_TAB_REF Conv.cItfInput._.pos_S6_S3 /end COMPU_METHOD
/begin COMPU_METHOD Conv.cItfInput._.pos_wunsch_S6_S3 "Umrechnung fuer Messgroesse cItfInput::pos_wunsch" TAB_VERB "%4.0" "" COMPU_TAB_REF Conv.cItfInput._.pos_wunsch_S6_S3 /end COMPU_METHOD
/begin COMPU_METHOD Conv.cItfInput._.pssensorsignal_status_S6_S3 "Umrechnung fuer Messgroesse cItfInput::pssensorsignal_status" TAB_VERB "%4.0" "" COMPU_TAB_REF Conv.cItfInput._.pssensorsignal_status_S6_S3 /end COMPU_METHOD
/begin COMPU_METHOD Conv.cItfInput._.iv_abs_reg_status_S6_S3 "Umrechnung fuer Messgroesse cItfInput::iv_abs_reg_status" TAB_VERB "%4.0" "" COMPU_TAB_REF Conv.cItfInput._.iv_abs_reg_status_S6_S3 /end COMPU_METHOD
/begin COMPU_METHOD Conv.cItfInput._.abs_reg_status_S6_S3 "Umrechnung fuer Messgroesse cItfInput::abs_reg_status" TAB_VERB "%4.0" "" COMPU_TAB_REF Conv.cItfInput._.abs_reg_status_S6_S3 /end COMPU_METHOD
/begin COMPU_METHOD Conv.cItfInput._.sollgang_S6_S3 "Umrechnung fuer Messgroesse cItfInput::sollgang" TAB_VERB "%4.0" "" COMPU_TAB_REF Conv.cItfInput._.sollgang_S6_S3 /end COMPU_METHOD
/begin COMPU_METHOD Conv.cItfInput._.k0_soll_S6_S3 "Umrechnung fuer Messgroesse cItfInput::k0_soll" TAB_VERB "%4.0" "" COMPU_TAB_REF Conv.cItfInput._.k0_soll_S6_S3 /end COMPU_METHOD
/begin COMPU_METHOD Conv.cItfInput._.n_vm_status_S6_S3 "Umrechnung fuer Messgroesse cItfInput::n_vm_status" TAB_VERB "%4.0" "" COMPU_TAB_REF Conv.cItfInput._.n_vm_status_S6_S3 /end COMPU_METHOD
/begin COMPU_METHOD Conv.cItfInput._.z_k0_soll_subst_S6_S3 "Umrechnung fuer Messgroesse cItfInput::z_k0_soll_subst" TAB_VERB "%4.0" "" COMPU_TAB_REF Conv.cItfInput._.z_k0_soll_subst_S6_S3 /end COMPU_METHOD
/begin COMPU_METHOD Conv.cItfInput._.z_k0_befuellopt_S6_S3 "Umrechnung fuer Messgroesse cItfInput::z_k0_befuellopt" TAB_VERB "%4.0" "" COMPU_TAB_REF Conv.cItfInput._.z_k0_befuellopt_S6_S3 /end COMPU_METHOD
/begin COMPU_METHOD Conv.cItfInput._.flag_p_hys_k0_has_S6_S3 "Umrechnung fuer Messgroesse cItfInput::flag_p_hys_k0_has" TAB_VERB "%4.0" "" COMPU_TAB_REF Conv.cItfInput._.flag_p_hys_k0_has_S6_S3 /end COMPU_METHOD
/begin COMPU_METHOD Conv.cItfInput._.mvg_vm_start_S6_S3 "Umrechnung fuer Messgroesse cItfInput::mvg_vm_start" TAB_VERB "%4.0" "" COMPU_TAB_REF Conv.cItfInput._.mvg_vm_start_S6_S3 /end COMPU_METHOD
/begin COMPU_METHOD Conv.cItfInput._.iv_mvg_vm_start_S6_S3 "Umrechnung fuer Messgroesse cItfInput::iv_mvg_vm_start" TAB_VERB "%4.0" "" COMPU_TAB_REF Conv.cItfInput._.iv_mvg_vm_start_S6_S3 /end COMPU_METHOD
/begin COMPU_METHOD Conv.cItfInput._.pt_damping_active_S6_S3 "Umrechnung fuer Messgroesse cItfInput::pt_damping_active" TAB_VERB "%4.0" "" COMPU_TAB_REF Conv.cItfInput._.pt_damping_active_S6_S3 /end COMPU_METHOD
/begin COMPU_METHOD Conv.cItfInput._.iv_pt_damping_active_S6_S3 "Umrechnung fuer Messgroesse cItfInput::iv_pt_damping_active" TAB_VERB "%4.0" "" COMPU_TAB_REF Conv.cItfInput._.iv_pt_damping_active_S6_S3 /end COMPU_METHOD
/begin COMPU_METHOD Conv.cItfInput._.iv_svh_aktiv_has_S6_S3 "Umrechnung fuer Messgroesse cItfInput::iv_svh_aktiv_has" TAB_VERB "%4.0" "" COMPU_TAB_REF Conv.cItfInput._.iv_svh_aktiv_has_S6_S3 /end COMPU_METHOD
/begin COMPU_METHOD Conv.cItfInput._.iv_n_vm_status_S6_S3 "Umrechnung fuer Messgroesse cItfInput::iv_n_vm_status" TAB_VERB "%4.0" "" COMPU_TAB_REF Conv.cItfInput._.iv_n_vm_status_S6_S3 /end COMPU_METHOD
/begin COMPU_METHOD Conv.cItfInput._.iv_k0_soll_S6_S3 "Umrechnung fuer Messgroesse cItfInput::iv_k0_soll" TAB_VERB "%4.0" "" COMPU_TAB_REF Conv.cItfInput._.iv_k0_soll_S6_S3 /end COMPU_METHOD
/begin COMPU_METHOD Conv.cItfInput._.iv_z_k0_soll_subst_S6_S3 "Umrechnung fuer Messgroesse cItfInput::iv_z_k0_soll_subst" TAB_VERB "%4.0" "" COMPU_TAB_REF Conv.cItfInput._.iv_z_k0_soll_subst_S6_S3 /end COMPU_METHOD
/begin COMPU_METHOD Conv.cItfInput._.iv_z_k0_befuellopt_S6_S3 "Umrechnung fuer Messgroesse cItfInput::iv_z_k0_befuellopt" TAB_VERB "%4.0" "" COMPU_TAB_REF Conv.cItfInput._.iv_z_k0_befuellopt_S6_S3 /end COMPU_METHOD
/begin COMPU_METHOD Conv.cItfInput._.iv_flag_p_hys_k0_has_S6_S3 "Umrechnung fuer Messgroesse cItfInput::iv_flag_p_hys_k0_has" TAB_VERB "%4.0" "" COMPU_TAB_REF Conv.cItfInput._.iv_flag_p_hys_k0_has_S6_S3 /end COMPU_METHOD
/begin COMPU_METHOD Conv.cItfInput._.iv_saf_has_aktiv_S6_S3 "Umrechnung fuer Messgroesse cItfInput::iv_saf_has_aktiv" TAB_VERB "%4.0" "" COMPU_TAB_REF Conv.cItfInput._.iv_saf_has_aktiv_S6_S3 /end COMPU_METHOD
/begin COMPU_METHOD Conv.cItfInput._.iv_verbot_sas_fkt_S6_S3 "Umrechnung fuer Messgroesse cItfInput::iv_verbot_sas_fkt" TAB_VERB "%4.0" "" COMPU_TAB_REF Conv.cItfInput._.iv_verbot_sas_fkt_S6_S3 /end COMPU_METHOD
/begin COMPU_METHOD Conv.cItfInput._.iv_schluesselstart_aktiv_S6_S3 "Umrechnung fuer Messgroesse cItfInput::iv_schluesselstart_aktiv" TAB_VERB "%4.0" "" COMPU_TAB_REF Conv.cItfInput._.iv_schluesselstart_aktiv_S6_S3 /end COMPU_METHOD
/begin COMPU_METHOD Conv.cItfInput._.iv_status_has_S6_S3 "Umrechnung fuer Messgroesse cItfInput::iv_status_has" TAB_VERB "%4.0" "" COMPU_TAB_REF Conv.cItfInput._.iv_status_has_S6_S3 /end COMPU_METHOD
/begin COMPU_METHOD Conv.cItfInput._.status_has_S6_S3 "Umrechnung fuer Messgroesse cItfInput::status_has" TAB_VERB "%4.0" "" COMPU_TAB_REF Conv.cItfInput._.status_has_S6_S3 /end COMPU_METHOD
/begin COMPU_METHOD Conv.cItfInput._.edsmv_ersatzinfo_S6_S3 "Umrechnung fuer Messgroesse cItfInput::edsmv_ersatzinfo" TAB_VERB "%4.0" "" COMPU_TAB_REF Conv.cItfInput._.edsmv_ersatzinfo_S6_S3 /end COMPU_METHOD
/begin COMPU_METHOD Conv.cItfInput._.stromlos_ausser_ps_S6_S3 "Umrechnung fuer Messgroesse cItfInput::stromlos_ausser_ps" TAB_VERB "%4.0" "" COMPU_TAB_REF Conv.cItfInput._.stromlos_ausser_ps_S6_S3 /end COMPU_METHOD
/begin COMPU_METHOD Conv.cItfInput._.stromlos_ausser_ps_und_i_min_S6_S3 "Umrechnung fuer Messgroesse cItfInput::stromlos_ausser_ps_und_i_min" TAB_VERB "%4.0" "" COMPU_TAB_REF Conv.cItfInput._.stromlos_ausser_ps_und_i_min_S6_S3 /end COMPU_METHOD
/begin COMPU_METHOD Conv.cItfInput._.stromlos_ges_S6_S3 "Umrechnung fuer Messgroesse cItfInput::stromlos_ges" TAB_VERB "%4.0" "" COMPU_TAB_REF Conv.cItfInput._.stromlos_ges_S6_S3 /end COMPU_METHOD
/begin COMPU_METHOD Conv.cItfInput._.hyd_notlauf_S6_S3 "Umrechnung fuer Messgroesse cItfInput::hyd_notlauf" TAB_VERB "%4.0" "" COMPU_TAB_REF Conv.cItfInput._.hyd_notlauf_S6_S3 /end COMPU_METHOD
/begin COMPU_METHOD Conv.cItfInput._.stromlos_ps_S6_S3 "Umrechnung fuer Messgroesse cItfInput::stromlos_ps" TAB_VERB "%4.0" "" COMPU_TAB_REF Conv.cItfInput._.stromlos_ps_S6_S3 /end COMPU_METHOD
/begin COMPU_METHOD Conv.cItfInput._.max_p_haupt_S6_S3 "Umrechnung fuer Messgroesse cItfInput::max_p_haupt" TAB_VERB "%4.0" "" COMPU_TAB_REF Conv.cItfInput._.max_p_haupt_S6_S3 /end COMPU_METHOD
/begin COMPU_METHOD Conv.cItfInput._.ersf_k0auf_S6_S3 "Umrechnung fuer Messgroesse cItfInput::ersf_k0auf" TAB_VERB "%4.0" "" COMPU_TAB_REF Conv.cItfInput._.ersf_k0auf_S6_S3 /end COMPU_METHOD
/begin COMPU_METHOD Conv.cItfInput._.zug_schub_S6_S3 "Umrechnung fuer Messgroesse cItfInput::zug_schub" TAB_VERB "%4.0" "" COMPU_TAB_REF Conv.cItfInput._.zug_schub_S6_S3 /end COMPU_METHOD
/begin COMPU_METHOD Conv.cItfInput._.bls_defakt_S6_S3 "Umrechnung fuer Messgroesse cItfInput::bls_defakt" TAB_VERB "%4.0" "" COMPU_TAB_REF Conv.cItfInput._.bls_defakt_S6_S3 /end COMPU_METHOD
/begin COMPU_METHOD Conv.cItfInput._.bls_defpas_S6_S3 "Umrechnung fuer Messgroesse cItfInput::bls_defpas" TAB_VERB "%4.0" "" COMPU_TAB_REF Conv.cItfInput._.bls_defpas_S6_S3 /end COMPU_METHOD
/begin COMPU_METHOD Conv.cItfInput._.feststellbremse_aktiv_S6_S3 "Umrechnung fuer Messgroesse cItfInput::feststellbremse_aktiv" TAB_VERB "%4.0" "" COMPU_TAB_REF Conv.cItfInput._.feststellbremse_aktiv_S6_S3 /end COMPU_METHOD
/begin COMPU_METHOD Conv.cItfInput._.el_not_entr_S6_S3 "Umrechnung fuer Messgroesse cItfInput::el_not_entr" TAB_VERB "%4.0" "" COMPU_TAB_REF Conv.cItfInput._.el_not_entr_S6_S3 /end COMPU_METHOD
/begin COMPU_METHOD Conv.cItfInput._.druck_vorhanden_mod_S6_S3 "Umrechnung fuer Messgroesse cItfInput::druck_vorhanden_mod" TAB_VERB "%4.0" "" COMPU_TAB_REF Conv.cItfInput._.druck_vorhanden_mod_S6_S3 /end COMPU_METHOD
/begin COMPU_METHOD Conv.cItfInput._.anhaenger_aktiv_S6_S3 "Umrechnung fuer Messgroesse cItfInput::anhaenger_aktiv" TAB_VERB "%4.0" "" COMPU_TAB_REF Conv.cItfInput._.anhaenger_aktiv_S6_S3 /end COMPU_METHOD
/begin COMPU_METHOD Conv.cItfInput._.transportmode_aktiv_S6_S3 "Umrechnung fuer Messgroesse cItfInput::transportmode_aktiv" TAB_VERB "%4.0" "" COMPU_TAB_REF Conv.cItfInput._.transportmode_aktiv_S6_S3 /end COMPU_METHOD
/begin COMPU_METHOD Conv.cItfInput._.asc_regelt_S6_S3 "Umrechnung fuer Messgroesse cItfInput::asc_regelt" TAB_VERB "%4.0" "" COMPU_TAB_REF Conv.cItfInput._.asc_regelt_S6_S3 /end COMPU_METHOD
/begin COMPU_METHOD Conv.cItfInput._.asc_passiv_S6_S3 "Umrechnung fuer Messgroesse cItfInput::asc_passiv" TAB_VERB "%4.0" "" COMPU_TAB_REF Conv.cItfInput._.asc_passiv_S6_S3 /end COMPU_METHOD
/begin COMPU_METHOD Conv.cItfInput._.iv_blsstatus_S6_S3 "Umrechnung fuer Messgroesse cItfInput::iv_blsstatus" TAB_VERB "%4.0" "" COMPU_TAB_REF Conv.cItfInput._.iv_blsstatus_S6_S3 /end COMPU_METHOD
/begin COMPU_METHOD Conv.cItfInput._.n_mot_status_S6_S3 "Umrechnung fuer Messgroesse cItfInput::n_mot_status" TAB_VERB "%4.0" "" COMPU_TAB_REF Conv.cItfInput._.n_mot_status_S6_S3 /end COMPU_METHOD
/begin COMPU_METHOD Conv.cItfInput._.pos_status_S6_S3 "Umrechnung fuer Messgroesse cItfInput::pos_status" TAB_VERB "%4.0" "" COMPU_TAB_REF Conv.cItfInput._.pos_status_S6_S3 /end COMPU_METHOD
/begin COMPU_METHOD Conv.cItfInput._.n_ab_status_S6_S3 "Umrechnung fuer Messgroesse cItfInput::n_ab_status" TAB_VERB "%4.0" "" COMPU_TAB_REF Conv.cItfInput._.n_ab_status_S6_S3 /end COMPU_METHOD
/begin COMPU_METHOD Conv.cItfInput._.n_t_status_S6_S3 "Umrechnung fuer Messgroesse cItfInput::n_t_status" TAB_VERB "%4.0" "" COMPU_TAB_REF Conv.cItfInput._.n_t_status_S6_S3 /end COMPU_METHOD
/begin COMPU_METHOD Conv.cItfInput._.m_mot_status_S6_S3 "Umrechnung fuer Messgroesse cItfInput::m_mot_status" TAB_VERB "%4.0" "" COMPU_TAB_REF Conv.cItfInput._.m_mot_status_S6_S3 /end COMPU_METHOD
/begin COMPU_METHOD Conv.cItfInput._.c_getr_status_S6_S3 "Umrechnung fuer Messgroesse cItfInput::c_getr_status" TAB_VERB "%4.0" "" COMPU_TAB_REF Conv.cItfInput._.c_getr_status_S6_S3 /end COMPU_METHOD
/begin COMPU_METHOD Conv.cItfInput._.bls_status_S6_S3 "Umrechnung fuer Messgroesse cItfInput::bls_status" TAB_VERB "%4.0" "" COMPU_TAB_REF Conv.cItfInput._.bls_status_S6_S3 /end COMPU_METHOD
/begin COMPU_METHOD Conv.cItfInput._.neigung_status_S6_S3 "Umrechnung fuer Messgroesse cItfInput::neigung_status" TAB_VERB "%4.0" "" COMPU_TAB_REF Conv.cItfInput._.neigung_status_S6_S3 /end COMPU_METHOD
/begin COMPU_METHOD Conv.cItfInput._.k0_diag_moeglich_S6_S3 "Umrechnung fuer Messgroesse cItfInput::k0_diag_moeglich" TAB_VERB "%4.0" "" COMPU_TAB_REF Conv.cItfInput._.k0_diag_moeglich_S6_S3 /end COMPU_METHOD
/begin COMPU_METHOD Conv.cItfInput._.pumpendruck_vorhanden_S6_S3 "Umrechnung fuer Messgroesse cItfInput::pumpendruck_vorhanden" TAB_VERB "%4.0" "" COMPU_TAB_REF Conv.cItfInput._.pumpendruck_vorhanden_S6_S3 /end COMPU_METHOD
/begin COMPU_METHOD Conv.cItfInput._.pumpendruck_nicht_vorhanden_S6_S3 "Umrechnung fuer Messgroesse cItfInput::pumpendruck_nicht_vorhanden" TAB_VERB "%4.0" "" COMPU_TAB_REF Conv.cItfInput._.pumpendruck_nicht_vorhanden_S6_S3 /end COMPU_METHOD
/begin COMPU_METHOD Conv.cItfInput._.i_min_ausser_parksperre_S6_S3 "Umrechnung fuer Messgroesse cItfInput::i_min_ausser_parksperre" TAB_VERB "%4.0" "" COMPU_TAB_REF Conv.cItfInput._.i_min_ausser_parksperre_S6_S3 /end COMPU_METHOD
/begin COMPU_METHOD Conv.cItfInput._.f_minimaldruck_ausgabe_S6_S3 "Umrechnung fuer Messgroesse cItfInput::f_minimaldruck_ausgabe" TAB_VERB "%4.0" "" COMPU_TAB_REF Conv.cItfInput._.f_minimaldruck_ausgabe_S6_S3 /end COMPU_METHOD
/begin COMPU_METHOD Conv.cItfInput._.nullbestromung_aktiv_S6_S3 "Umrechnung fuer Messgroesse cItfInput::nullbestromung_aktiv" TAB_VERB "%4.0" "" COMPU_TAB_REF Conv.cItfInput._.nullbestromung_aktiv_S6_S3 /end COMPU_METHOD
/begin COMPU_METHOD Conv.cItfInput._.hdc_S6_S3 "Umrechnung fuer Messgroesse cItfInput::hdc" TAB_VERB "%4.0" "" COMPU_TAB_REF Conv.cItfInput._.hdc_S6_S3 /end COMPU_METHOD
/begin COMPU_METHOD Conv.cItfInput._.iv_hdc_S6_S3 "Umrechnung fuer Messgroesse cItfInput::iv_hdc" TAB_VERB "%4.0" "" COMPU_TAB_REF Conv.cItfInput._.iv_hdc_S6_S3 /end COMPU_METHOD
/begin COMPU_METHOD Conv.cItfInput._.fl_brake_inter_status_S6_S3 "Umrechnung fuer Messgroesse cItfInput::fl_brake_inter_status" TAB_VERB "%4.0" "" COMPU_TAB_REF Conv.cItfInput._.fl_brake_inter_status_S6_S3 /end COMPU_METHOD
/begin COMPU_METHOD Conv.cItfInput._.iv_fl_brake_inter_status_S6_S3 "Umrechnung fuer Messgroesse cItfInput::iv_fl_brake_inter_status" TAB_VERB "%4.0" "" COMPU_TAB_REF Conv.cItfInput._.iv_fl_brake_inter_status_S6_S3 /end COMPU_METHOD
/begin COMPU_METHOD Conv.cItfInput._.ldm_S6_S3 "Umrechnung fuer Messgroesse cItfInput::ldm" TAB_VERB "%4.0" "" COMPU_TAB_REF Conv.cItfInput._.ldm_S6_S3 /end COMPU_METHOD
/begin COMPU_METHOD Conv.cItfInput._.iv_ldm_S6_S3 "Umrechnung fuer Messgroesse cItfInput::iv_ldm" TAB_VERB "%4.0" "" COMPU_TAB_REF Conv.cItfInput._.iv_ldm_S6_S3 /end COMPU_METHOD
/begin COMPU_METHOD Conv.cItfInput._.ldm_status_S6_S3 "Umrechnung fuer Messgroesse cItfInput::ldm_status" TAB_VERB "%4.0" "" COMPU_TAB_REF Conv.cItfInput._.ldm_status_S6_S3 /end COMPU_METHOD
/begin COMPU_METHOD Conv.cItfInput._.iv_ldm_status_S6_S3 "Umrechnung fuer Messgroesse cItfInput::iv_ldm_status" TAB_VERB "%4.0" "" COMPU_TAB_REF Conv.cItfInput._.iv_ldm_status_S6_S3 /end COMPU_METHOD
/begin COMPU_METHOD Conv.cItfInput._.autohold_aktiv_S6_S3 "Umrechnung fuer Messgroesse cItfInput::autohold_aktiv" TAB_VERB "%4.0" "" COMPU_TAB_REF Conv.cItfInput._.autohold_aktiv_S6_S3 /end COMPU_METHOD
/begin COMPU_METHOD Conv.cItfInput._.hillhold_aktiv_S6_S3 "Umrechnung fuer Messgroesse cItfInput::hillhold_aktiv" TAB_VERB "%4.0" "" COMPU_TAB_REF Conv.cItfInput._.hillhold_aktiv_S6_S3 /end COMPU_METHOD
/begin COMPU_METHOD Conv.cItfInput._.iv_fzg_rollverh_aktiv_stat_S6_S3 "Umrechnung fuer Messgroesse cItfInput::iv_fzg_rollverh_aktiv_stat" TAB_VERB "%4.0" "" COMPU_TAB_REF Conv.cItfInput._.iv_fzg_rollverh_aktiv_stat_S6_S3 /end COMPU_METHOD
/begin COMPU_METHOD Conv.cItfInput._.fzg_rollverh_aktiv_stat_S6_S3 "Umrechnung fuer Messgroesse cItfInput::fzg_rollverh_aktiv_stat" TAB_VERB "%4.0" "" COMPU_TAB_REF Conv.cItfInput._.fzg_rollverh_aktiv_stat_S6_S3 /end COMPU_METHOD
/begin COMPU_METHOD Conv.cItfInput._.ax_ref_status_S6_S3 "Umrechnung fuer Messgroesse cItfInput::ax_ref_status" TAB_VERB "%4.0" "" COMPU_TAB_REF Conv.cItfInput._.ax_ref_status_S6_S3 /end COMPU_METHOD
/begin COMPU_METHOD Conv.cItfInput._.iv_ax_ref_status_S6_S3 "Umrechnung fuer Messgroesse cItfInput::iv_ax_ref_status" TAB_VERB "%4.0" "" COMPU_TAB_REF Conv.cItfInput._.iv_ax_ref_status_S6_S3 /end COMPU_METHOD
/begin COMPU_METHOD Conv.cItfInput._.ay_ref_status_S6_S3 "Umrechnung fuer Messgroesse cItfInput::ay_ref_status" TAB_VERB "%4.0" "" COMPU_TAB_REF Conv.cItfInput._.ay_ref_status_S6_S3 /end COMPU_METHOD
/begin COMPU_METHOD Conv.cItfInput._.iv_ay_ref_status_S6_S3 "Umrechnung fuer Messgroesse cItfInput::iv_ay_ref_status" TAB_VERB "%4.0" "" COMPU_TAB_REF Conv.cItfInput._.iv_ay_ref_status_S6_S3 /end COMPU_METHOD
/begin COMPU_METHOD Conv.cItfInput._.n_ab_dir_S6_S3 "Umrechnung fuer Messgroesse cItfInput::n_ab_dir" TAB_VERB "%4.0" "" COMPU_TAB_REF Conv.cItfInput._.n_ab_dir_S6_S3 /end COMPU_METHOD
/begin COMPU_METHOD Conv.cItfInput._.iv_n_ab_dir_S6_S3 "Umrechnung fuer Messgroesse cItfInput::iv_n_ab_dir" TAB_VERB "%4.0" "" COMPU_TAB_REF Conv.cItfInput._.iv_n_ab_dir_S6_S3 /end COMPU_METHOD
/begin COMPU_METHOD Conv.cItfInput._.n_t_dir_S6_S3 "Umrechnung fuer Messgroesse cItfInput::n_t_dir" TAB_VERB "%4.0" "" COMPU_TAB_REF Conv.cItfInput._.n_t_dir_S6_S3 /end COMPU_METHOD
/begin COMPU_METHOD Conv.cItfInput._.iv_n_t_dir_S6_S3 "Umrechnung fuer Messgroesse cItfInput::iv_n_t_dir" TAB_VERB "%4.0" "" COMPU_TAB_REF Conv.cItfInput._.iv_n_t_dir_S6_S3 /end COMPU_METHOD
/begin COMPU_METHOD Conv.cItfInput._.iv_n_ab_dir_status_S6_S3 "Umrechnung fuer Messgroesse cItfInput::iv_n_ab_dir_status" TAB_VERB "%4.0" "" COMPU_TAB_REF Conv.cItfInput._.iv_n_ab_dir_status_S6_S3 /end COMPU_METHOD
/begin COMPU_METHOD Conv.cItfInput._.n_ab_dir_status_S6_S3 "Umrechnung fuer Messgroesse cItfInput::n_ab_dir_status" TAB_VERB "%4.0" "" COMPU_TAB_REF Conv.cItfInput._.n_ab_dir_status_S6_S3 /end COMPU_METHOD
/begin COMPU_METHOD Conv.cItfInput._.iv_n_t_dir_status_S6_S3 "Umrechnung fuer Messgroesse cItfInput::iv_n_t_dir_status" TAB_VERB "%4.0" "" COMPU_TAB_REF Conv.cItfInput._.iv_n_t_dir_status_S6_S3 /end COMPU_METHOD
/begin COMPU_METHOD Conv.cItfInput._.n_t_dir_status_S6_S3 "Umrechnung fuer Messgroesse cItfInput::n_t_dir_status" TAB_VERB "%4.0" "" COMPU_TAB_REF Conv.cItfInput._.n_t_dir_status_S6_S3 /end COMPU_METHOD
/begin COMPU_METHOD Conv.cItfInput._.iv_ntu_virt_dir_S6_S3 "Umrechnung fuer Messgroesse cItfInput::iv_ntu_virt_dir" TAB_VERB "%4.0" "" COMPU_TAB_REF Conv.cItfInput._.iv_ntu_virt_dir_S6_S3 /end COMPU_METHOD
/begin COMPU_METHOD Conv.cItfInput._.ntu_virt_dir_S6_S3 "Umrechnung fuer Messgroesse cItfInput::ntu_virt_dir" TAB_VERB "%4.0" "" COMPU_TAB_REF Conv.cItfInput._.ntu_virt_dir_S6_S3 /end COMPU_METHOD
/begin COMPU_METHOD Conv.cItfInput._.iv_ntu_virt_dir_status_S6_S3 "Umrechnung fuer Messgroesse cItfInput::iv_ntu_virt_dir_status" TAB_VERB "%4.0" "" COMPU_TAB_REF Conv.cItfInput._.iv_ntu_virt_dir_status_S6_S3 /end COMPU_METHOD
/begin COMPU_METHOD Conv.cItfInput._.ntu_virt_dir_status_S6_S3 "Umrechnung fuer Messgroesse cItfInput::ntu_virt_dir_status" TAB_VERB "%4.0" "" COMPU_TAB_REF Conv.cItfInput._.ntu_virt_dir_status_S6_S3 /end COMPU_METHOD
/begin COMPU_METHOD Conv.cItfInput._.iv_m_motsoll_mod_status_S6_S3 "Umrechnung fuer Messgroesse cItfInput::iv_m_motsoll_mod_status" TAB_VERB "%4.0" "" COMPU_TAB_REF Conv.cItfInput._.iv_m_motsoll_mod_status_S6_S3 /end COMPU_METHOD
/begin COMPU_METHOD Conv.cItfInput._.m_motsoll_mod_status_S6_S3 "Umrechnung fuer Messgroesse cItfInput::m_motsoll_mod_status" TAB_VERB "%4.0" "" COMPU_TAB_REF Conv.cItfInput._.m_motsoll_mod_status_S6_S3 /end COMPU_METHOD
/begin COMPU_METHOD Conv.cItfInput._.f_iep_shutdown_S6_S3 "Umrechnung fuer Messgroesse cItfInput::f_iep_shutdown" TAB_VERB "%4.0" "" COMPU_TAB_REF Conv.cItfInput._.f_iep_shutdown_S6_S3 /end COMPU_METHOD
/begin COMPU_METHOD Conv.cItfInput._.iv_f_iep_shutdown_S6_S3 "Umrechnung fuer Messgroesse cItfInput::iv_f_iep_shutdown" TAB_VERB "%4.0" "" COMPU_TAB_REF Conv.cItfInput._.iv_f_iep_shutdown_S6_S3 /end COMPU_METHOD
/begin COMPU_METHOD Conv.cItfInput._.iv_pumpenstatus_iep_S6_S3 "Umrechnung fuer Messgroesse cItfInput::iv_pumpenstatus_iep" TAB_VERB "%4.0" "" COMPU_TAB_REF Conv.cItfInput._.iv_pumpenstatus_iep_S6_S3 /end COMPU_METHOD
/begin COMPU_METHOD Conv.cItfInput._.pumpenstatus_iep_S6_S3 "Umrechnung fuer Messgroesse cItfInput::pumpenstatus_iep" TAB_VERB "%4.0" "" COMPU_TAB_REF Conv.cItfInput._.pumpenstatus_iep_S6_S3 /end COMPU_METHOD
/begin COMPU_METHOD Conv.cItfInput._.iv_iep_soll_has_S6_S3 "Umrechnung fuer Messgroesse cItfInput::iv_iep_soll_has" TAB_VERB "%4.0" "" COMPU_TAB_REF Conv.cItfInput._.iv_iep_soll_has_S6_S3 /end COMPU_METHOD
/begin COMPU_METHOD Conv.cItfInput._.iep_soll_has_S6_S3 "Umrechnung fuer Messgroesse cItfInput::iep_soll_has" TAB_VERB "%4.0" "" COMPU_TAB_REF Conv.cItfInput._.iep_soll_has_S6_S3 /end COMPU_METHOD
/begin COMPU_METHOD Conv.cItfInput._.iv_iep_soll_abk_S6_S3 "Umrechnung fuer Messgroesse cItfInput::iv_iep_soll_abk" TAB_VERB "%4.0" "" COMPU_TAB_REF Conv.cItfInput._.iv_iep_soll_abk_S6_S3 /end COMPU_METHOD
/begin COMPU_METHOD Conv.cItfInput._.iep_soll_abk_S6_S3 "Umrechnung fuer Messgroesse cItfInput::iep_soll_abk" TAB_VERB "%4.0" "" COMPU_TAB_REF Conv.cItfInput._.iep_soll_abk_S6_S3 /end COMPU_METHOD
/begin COMPU_METHOD Conv.cItfInput._.iv_iep_soll_sab_S6_S3 "Umrechnung fuer Messgroesse cItfInput::iv_iep_soll_sab" TAB_VERB "%4.0" "" COMPU_TAB_REF Conv.cItfInput._.iv_iep_soll_sab_S6_S3 /end COMPU_METHOD
/begin COMPU_METHOD Conv.cItfInput._.iep_soll_sab_S6_S3 "Umrechnung fuer Messgroesse cItfInput::iep_soll_sab" TAB_VERB "%4.0" "" COMPU_TAB_REF Conv.cItfInput._.iep_soll_sab_S6_S3 /end COMPU_METHOD
/begin COMPU_METHOD Conv.cItfInput._.iv_iep_soll_tes_S6_S3 "Umrechnung fuer Messgroesse cItfInput::iv_iep_soll_tes" TAB_VERB "%4.0" "" COMPU_TAB_REF Conv.cItfInput._.iv_iep_soll_tes_S6_S3 /end COMPU_METHOD
/begin COMPU_METHOD Conv.cItfInput._.iep_soll_tes_S6_S3 "Umrechnung fuer Messgroesse cItfInput::iep_soll_tes" TAB_VERB "%4.0" "" COMPU_TAB_REF Conv.cItfInput._.iep_soll_tes_S6_S3 /end COMPU_METHOD
/begin COMPU_METHOD Conv.cItfInput._.iv_flag_m_max_has_iae_S6_S3 "Umrechnung fuer Messgroesse cItfInput::iv_flag_m_max_has_iae" TAB_VERB "%4.0" "" COMPU_TAB_REF Conv.cItfInput._.iv_flag_m_max_has_iae_S6_S3 /end COMPU_METHOD
/begin COMPU_METHOD Conv.cItfInput._.flag_m_max_has_iae_S6_S3 "Umrechnung fuer Messgroesse cItfInput::flag_m_max_has_iae" TAB_VERB "%4.0" "" COMPU_TAB_REF Conv.cItfInput._.flag_m_max_has_iae_S6_S3 /end COMPU_METHOD
/begin COMPU_METHOD Conv.cItfInput._.iv_iae_req_subst_S6_S3 "Umrechnung fuer Messgroesse cItfInput::iv_iae_req_subst" TAB_VERB "%4.0" "" COMPU_TAB_REF Conv.cItfInput._.iv_iae_req_subst_S6_S3 /end COMPU_METHOD
/begin COMPU_METHOD Conv.cItfInput._.iae_req_subst_S6_S3 "Umrechnung fuer Messgroesse cItfInput::iae_req_subst" TAB_VERB "%4.0" "" COMPU_TAB_REF Conv.cItfInput._.iae_req_subst_S6_S3 /end COMPU_METHOD
/begin COMPU_METHOD Conv.cItfInput._.z_modus_iae_S6_S3 "Umrechnung fuer Messgroesse cItfInput::z_modus_iae" TAB_VERB "%4.0" "" COMPU_TAB_REF Conv.cItfInput._.z_modus_iae_S6_S3 /end COMPU_METHOD
/begin COMPU_METHOD Conv.cItfInput._.iv_z_modus_iae_S6_S3 "Umrechnung fuer Messgroesse cItfInput::iv_z_modus_iae" TAB_VERB "%4.0" "" COMPU_TAB_REF Conv.cItfInput._.iv_z_modus_iae_S6_S3 /end COMPU_METHOD
/begin COMPU_METHOD Conv.cItfInput._.iv_ll_mot_aktiv_status_S6_S3 "Umrechnung fuer Messgroesse cItfInput::iv_ll_mot_aktiv_status" TAB_VERB "%4.0" "" COMPU_TAB_REF Conv.cItfInput._.iv_ll_mot_aktiv_status_S6_S3 /end COMPU_METHOD
/begin COMPU_METHOD Conv.cItfInput._.ll_mot_aktiv_status_S6_S3 "Umrechnung fuer Messgroesse cItfInput::ll_mot_aktiv_status" TAB_VERB "%4.0" "" COMPU_TAB_REF Conv.cItfInput._.ll_mot_aktiv_status_S6_S3 /end COMPU_METHOD
/begin COMPU_METHOD Conv.cItfInput._.flag_partfilt_aktiv_S6_S3 "Umrechnung fuer Messgroesse cItfInput::flag_partfilt_aktiv" TAB_VERB "%4.0" "" COMPU_TAB_REF Conv.cItfInput._.flag_partfilt_aktiv_S6_S3 /end COMPU_METHOD
/begin COMPU_METHOD Conv.cItfInput._.iv_flag_partfilt_aktiv_S6_S3 "Umrechnung fuer Messgroesse cItfInput::iv_flag_partfilt_aktiv" TAB_VERB "%4.0" "" COMPU_TAB_REF Conv.cItfInput._.iv_flag_partfilt_aktiv_S6_S3 /end COMPU_METHOD
/begin COMPU_METHOD Conv.cItfInput._.status_n_haltephase_S6_S3 "Umrechnung fuer Messgroesse cItfInput::status_n_haltephase" TAB_VERB "%4.0" "" COMPU_TAB_REF Conv.cItfInput._.status_n_haltephase_S6_S3 /end COMPU_METHOD
/begin COMPU_METHOD Conv.cItfInput._.iv_status_n_haltephase_S6_S3 "Umrechnung fuer Messgroesse cItfInput::iv_status_n_haltephase" TAB_VERB "%4.0" "" COMPU_TAB_REF Conv.cItfInput._.iv_status_n_haltephase_S6_S3 /end COMPU_METHOD
/begin COMPU_METHOD Conv.cItfInput._.fet0_active_S6_S3 "Umrechnung fuer Messgroesse cItfInput::fet0_active" TAB_VERB "%4.0" "" COMPU_TAB_REF Conv.cItfInput._.fet0_active_S6_S3 /end COMPU_METHOD
/begin COMPU_METHOD Conv.cItfInput._.iv_fet0_active_S6_S3 "Umrechnung fuer Messgroesse cItfInput::iv_fet0_active" TAB_VERB "%4.0" "" COMPU_TAB_REF Conv.cItfInput._.iv_fet0_active_S6_S3 /end COMPU_METHOD
/begin COMPU_METHOD Conv.cItfInput._.iv_usensor1_estatus_S6_S3 "Umrechnung fuer Messgroesse cItfInput::iv_usensor1_estatus" TAB_VERB "%4.0" "" COMPU_TAB_REF Conv.cItfInput._.iv_usensor1_estatus_S6_S3 /end COMPU_METHOD
/begin COMPU_METHOD Conv.cItfInput._.usensor1_estatus_S6_S3 "Umrechnung fuer Messgroesse cItfInput::usensor1_estatus" TAB_VERB "%4.0" "" COMPU_TAB_REF Conv.cItfInput._.usensor1_estatus_S6_S3 /end COMPU_METHOD
/begin COMPU_METHOD Conv.cItfInput._.ags_zka_index_S6_S3 "Umrechnung fuer Messgroesse cItfInput::ags_zka_index" TAB_VERB "%4.0" "" COMPU_TAB_REF Conv.cItfInput._.ags_zka_index_S6_S3 /end COMPU_METHOD
/begin COMPU_METHOD Conv.cItfInput._.iv_ags_zka_index_S6_S3 "Umrechnung fuer Messgroesse cItfInput::iv_ags_zka_index" TAB_VERB "%4.0" "" COMPU_TAB_REF Conv.cItfInput._.iv_ags_zka_index_S6_S3 /end COMPU_METHOD
/begin COMPU_METHOD Conv.cItfInputParaumsch._.iv_f_e_fahren_aktiv_S6_S3 "Umrechnung fuer Messgroesse cItfInputParaumsch::iv_f_e_fahren_aktiv" TAB_VERB "%4.0" "" COMPU_TAB_REF Conv.cItfInputParaumsch._.iv_f_e_fahren_aktiv_S6_S3 /end COMPU_METHOD
/begin COMPU_METHOD Conv.cItfInputParaumsch._.f_e_fahren_aktiv_S6_S3 "Umrechnung fuer Messgroesse cItfInputParaumsch::f_e_fahren_aktiv" TAB_VERB "%4.0" "" COMPU_TAB_REF Conv.cItfInputParaumsch._.f_e_fahren_aktiv_S6_S3 /end COMPU_METHOD
/begin COMPU_METHOD Conv.cAzsKorgl._.pos_red_S6_S3 "Umrechnung fuer Messgroesse cAzsKorgl::pos_red" TAB_VERB "%4.0" "" COMPU_TAB_REF Conv.cAzsKorgl._.pos_red_S6_S3 /end COMPU_METHOD
/begin COMPU_METHOD Conv.cAzsKorgl._.parksperre_ziel_S6_S3 "Umrechnung fuer Messgroesse cAzsKorgl::parksperre_ziel" TAB_VERB "%4.0" "" COMPU_TAB_REF Conv.cAzsKorgl._.parksperre_ziel_S6_S3 /end COMPU_METHOD
/begin COMPU_METHOD Conv.cAzsKorgl._.f_kfl_direkt_S6_S3 "Umrechnung fuer Messgroesse cAzsKorgl::f_kfl_direkt" TAB_VERB "%4.0" "" COMPU_TAB_REF Conv.cAzsKorgl._.f_kfl_direkt_S6_S3 /end COMPU_METHOD
/begin COMPU_METHOD Conv.cAzsKorgl._.f_schaltung_direkt_S6_S3 "Umrechnung fuer Messgroesse cAzsKorgl::f_schaltung_direkt" TAB_VERB "%4.0" "" COMPU_TAB_REF Conv.cAzsKorgl._.f_schaltung_direkt_S6_S3 /end COMPU_METHOD
/begin COMPU_METHOD Conv.cAzsKorgl._.f_stromlos_zzs_S6_S3 "Umrechnung fuer Messgroesse cAzsKorgl::f_stromlos_zzs" TAB_VERB "%4.0" "" COMPU_TAB_REF Conv.cAzsKorgl._.f_stromlos_zzs_S6_S3 /end COMPU_METHOD
/begin COMPU_METHOD Conv.cAzsKorgl._.f_notgang_gesetzt_S6_S3 "Umrechnung fuer Messgroesse cAzsKorgl::f_notgang_gesetzt" TAB_VERB "%4.0" "" COMPU_TAB_REF Conv.cAzsKorgl._.f_notgang_gesetzt_S6_S3 /end COMPU_METHOD
/begin COMPU_METHOD Conv.cAzsKorgl._.f_abbruch_schaltung_durch_ga_S6_S3 "Umrechnung fuer Messgroesse cAzsKorgl::f_abbruch_schaltung_durch_ga" TAB_VERB "%4.0" "" COMPU_TAB_REF Conv.cAzsKorgl._.f_abbruch_schaltung_durch_ga_S6_S3 /end COMPU_METHOD
/begin COMPU_METHOD Conv.cAzsKorgl._.istgang_abbruch_schaltung_durch_ga_S6_S3 "Umrechnung fuer Messgroesse cAzsKorgl::istgang_abbruch_schaltung_durch_ga" TAB_VERB "%4.0" "" COMPU_TAB_REF Conv.cAzsKorgl._.istgang_abbruch_schaltung_durch_ga_S6_S3 /end COMPU_METHOD
/begin COMPU_METHOD Conv.cAzsSchluesselStart._.s_start_status_S6_S3 "Umrechnung fuer Messgroesse cAzsSchluesselStart::s_start_status" TAB_VERB "%4.0" "" COMPU_TAB_REF Conv.cAzsSchluesselStart._.s_start_status_S6_S3 /end COMPU_METHOD
/begin COMPU_METHOD Conv.cAzsSZPulsAda._.z_sonder_zustand_puls_ada_S6_S3 "Umrechnung fuer Messgroesse cAzsSZPulsAda::z_sonder_zustand_puls_ada" TAB_VERB "%4.0" "" COMPU_TAB_REF Conv.cAzsSZPulsAda._.z_sonder_zustand_puls_ada_S6_S3 /end COMPU_METHOD
/begin COMPU_METHOD Conv.cAzsSZPulsAda._.f_neutral_vorgabe_S6_S3 "Umrechnung fuer Messgroesse cAzsSZPulsAda::f_neutral_vorgabe" TAB_VERB "%4.0" "" COMPU_TAB_REF Conv.cAzsSZPulsAda._.f_neutral_vorgabe_S6_S3 /end COMPU_METHOD
/begin COMPU_METHOD Conv.cAzsSZPulsAda._.f_gang_vorgabe_S6_S3 "Umrechnung fuer Messgroesse cAzsSZPulsAda::f_gang_vorgabe" TAB_VERB "%4.0" "" COMPU_TAB_REF Conv.cAzsSZPulsAda._.f_gang_vorgabe_S6_S3 /end COMPU_METHOD
/begin COMPU_METHOD Conv.cAzsSZPulsAda._.f_abbruch_pre_ada_azs_S6_S3 "Umrechnung fuer Messgroesse cAzsSZPulsAda::f_abbruch_pre_ada_azs" TAB_VERB "%4.0" "" COMPU_TAB_REF Conv.cAzsSZPulsAda._.f_abbruch_pre_ada_azs_S6_S3 /end COMPU_METHOD
/begin COMPU_METHOD Conv.cAzsSZPulsAda._.f_sz_puls_ada_aktiv_S6_S3 "Umrechnung fuer Messgroesse cAzsSZPulsAda::f_sz_puls_ada_aktiv" TAB_VERB "%4.0" "" COMPU_TAB_REF Conv.cAzsSZPulsAda._.f_sz_puls_ada_aktiv_S6_S3 /end COMPU_METHOD
/begin COMPU_METHOD Conv.cAzsSZPulsAda._.sz_puls_ada_gang_S6_S3 "Umrechnung fuer Messgroesse cAzsSZPulsAda::sz_puls_ada_gang" TAB_VERB "%4.0" "" COMPU_TAB_REF Conv.cAzsSZPulsAda._.sz_puls_ada_gang_S6_S3 /end COMPU_METHOD
/begin COMPU_METHOD Conv.cAzsNeutralEbene._.z_neutral_ebene_S6_S3 "Umrechnung fuer Messgroesse cAzsNeutralEbene::z_neutral_ebene" TAB_VERB "%4.0" "" COMPU_TAB_REF Conv.cAzsNeutralEbene._.z_neutral_ebene_S6_S3 /end COMPU_METHOD
/begin COMPU_METHOD Conv.cAzsNeutralEbene._.fkt_neutral_ebene_S6_S3 "Umrechnung fuer Messgroesse cAzsNeutralEbene::fkt_neutral_ebene" TAB_VERB "%4.0" "" COMPU_TAB_REF Conv.cAzsNeutralEbene._.fkt_neutral_ebene_S6_S3 /end COMPU_METHOD
/begin COMPU_METHOD Conv.cAzsNeutralEbene._.pos_neutral_n_stern_S6_S3 "Umrechnung fuer Messgroesse cAzsNeutralEbene::pos_neutral_n_stern" TAB_VERB "%4.0" "" COMPU_TAB_REF Conv.cAzsNeutralEbene._.pos_neutral_n_stern_S6_S3 /end COMPU_METHOD
/begin COMPU_METHOD Conv.cAzsKflSoll._.kfl_soll_S6_S3 "Umrechnung fuer Messgroesse cAzsKflSoll::kfl_soll" TAB_VERB "%4.0" "" COMPU_TAB_REF Conv.cAzsKflSoll._.kfl_soll_S6_S3 /end COMPU_METHOD
/begin COMPU_METHOD Conv.cAzsKflZiel._.kfl_ziel_S6_S3 "Umrechnung fuer Messgroesse cAzsKflZiel::kfl_ziel" TAB_VERB "%4.0" "" COMPU_TAB_REF Conv.cAzsKflZiel._.kfl_ziel_S6_S3 /end COMPU_METHOD
/begin COMPU_METHOD Conv.cAzsKflIst._.kfl_ist_S6_S3 "Umrechnung fuer Messgroesse cAzsKflIst::kfl_ist" TAB_VERB "%4.0" "" COMPU_TAB_REF Conv.cAzsKflIst._.kfl_ist_S6_S3 /end COMPU_METHOD
/begin COMPU_VTAB Conv.mv_1_S6_S3 "Umrechnung fuer Messgroesse mv_1" TAB_VERB 2 0 "OFF" 1 "ON" /end COMPU_VTAB
/begin COMPU_VTAB Conv.mv_2_S6_S3 "Umrechnung fuer Messgroesse mv_2" TAB_VERB 2 0 "OFF" 1 "ON" /end COMPU_VTAB
/begin COMPU_VTAB Conv.mv_3_S6_S3 "Umrechnung fuer Messgroesse mv_3" TAB_VERB 2 0 "OFF" 1 "ON" /end COMPU_VTAB
/begin COMPU_VTAB Conv.cItfInput._.notlauf_S6_S3 "Umrechnung fuer Messgroesse cItfInput::notlauf" TAB_VERB 2 0 "Notlauftask nicht aktiv" 1 "Notlauftask aktiv" /end COMPU_VTAB
/begin COMPU_VTAB Conv.cItfInput._.standby_S6_S3 "Umrechnung fuer Messgroesse cItfInput::standby" TAB_VERB 2 0 "Standbytask nicht aktiv" 1 "Standbytask aktiv" /end COMPU_VTAB
/begin COMPU_VTAB Conv.cItfInput._.fahrbetrieb_S6_S3 "Umrechnung fuer Messgroesse cItfInput::fahrbetrieb" TAB_VERB 2 0 "Fahrbetiebstask nicht aktiv" 1 "Fahrbetriebstask aktiv" /end COMPU_VTAB
/begin COMPU_VTAB Conv.cItfInput._.iv_gnotinfo_S6_S3 "Umrechnung fuer Messgroesse cItfInput::iv_gnotinfo" TAB_VERB 51 0 "kein Notgang" 1 "modulierter Ersatzgang" 2 "S/W Ersatzgang" 3 "Gang halten" 4 "Gang halten mit aktivem Zwangsneutral - nur in Verbindung mit ENPGx" 5 "nicht belegt war mal G5FIX" 6 "mechanischer NOTLAUF" 7 "nur Gaenge 1 oder 2" 8 "bed. NP" 9 "ENP 5. moduliert" 10 "ENP 4. moduliert" 11 "nicht belegt war mal G3FIX" 12 "nicht belegt war mal BENP3" 13 "nicht belegt war mal BENP4" 14 "nicht belegt war mal BENP1" 15 "nicht belegt war mal BENP2" 16 "ENP 3. oder 5. Gang und Bed. nicht erfuellt vorbelegt" 17 "ENP 3. oder 5. Gang und Bed. erfuellt vorbelegt" 18 "vorbelegt" 19 "nur Gaenge 1 2 oder 3" 20 "vorbelegt_1" 21 "nur 1. Gang" 22 "Zwangsneutral fuer MV2 fehler" 23 "ENPG5 mit aktivem Zwangsneutral" 24 "ENPG35 3. Gang mit aktivem Zwangsneutral" 25 "ENPG35 5. Gang mit aktivem Zwangsneutral" 26 "LOW-SIDE-OFF 3/5. Gang wie mech Notlauf" 27 "ENPG2 mit aktivem Zwangsneutral" 28 "ENPG3 mit aktivem Zwangsneutral" 29 "ENPG4 mit aktivem Zwangsneutral" 30 "ENPG6 mit aktivem Zwangsneutral" 31 "ENPG2 ohne aktivem Zwangsneutral" 32 "ENPG3 ohne aktivem Zwangsneutral" 33 "ENPG4 ohne aktivem Zwangsneutral" 34 "ENPG6 ohne aktivem Zwangsneutral" 35 "ENPG1 mit aktivem Zwangsneutral" 36 "ENPG1 ohne aktivem Zwangsneutral" 37 "ENPG7 mit aktivem Zwangsneutral" 38 "ENPG7 ohne aktivem Zwangsneutral" 39 "ENPG8 mit aktivem Zwangsneutral" 40 "ENPG8 ohne aktivem Zwangsneutral" 41 "nicht aktiv" 42 "nicht aktiv" 43 "nicht aktiv" 44 "ENPG1 ohne aktivem Zwangsneutral (IAE)" 45 "nicht aktiv" 46 "nicht aktiv" 47 "nicht aktiv" 48 "nicht aktiv" 49 "nicht aktiv" 50 "nicht aktiv" /end COMPU_VTAB
/begin COMPU_VTAB Conv.cItfInput._.notgang_info_S6_S3 "Umrechnung fuer Messgroesse cItfInput::notgang_info" TAB_VERB 51 0 "kein Notgang" 1 "modulierter Ersatzgang" 2 "S/W Ersatzgang" 3 "Gang halten" 4 "Gang halten mit aktivem Zwangsneutral - nur in Verbindung mit ENPGx" 5 "nicht belegt war mal G5FIX" 6 "mechanischer NOTLAUF" 7 "nur Gaenge 1 oder 2" 8 "bed. NP" 9 "ENP 5. moduliert" 10 "ENP 4. moduliert" 11 "nicht belegt war mal G3FIX" 12 "nicht belegt war mal BENP3" 13 "nicht belegt war mal BENP4" 14 "nicht belegt war mal BENP1" 15 "nicht belegt war mal BENP2" 16 "ENP 3. oder 5. Gang und Bed. nicht erfuellt vorbelegt" 17 "ENP 3. oder 5. Gang und Bed. erfuellt vorbelegt" 18 "vorbelegt" 19 "nur Gaenge 1 2 oder 3" 20 "vorbelegt_1" 21 "nur 1. Gang" 22 "Zwangsneutral fuer MV2 fehler" 23 "ENPG5 mit aktivem Zwangsneutral" 24 "ENPG35 3. Gang mit aktivem Zwangsneutral" 25 "ENPG35 5. Gang mit aktivem Zwangsneutral" 26 "LOW-SIDE-OFF 3/5. Gang wie mech Notlauf" 27 "ENPG2 mit aktivem Zwangsneutral" 28 "ENPG3 mit aktivem Zwangsneutral" 29 "ENPG4 mit aktivem Zwangsneutral" 30 "ENPG6 mit aktivem Zwangsneutral" 31 "ENPG2 ohne aktivem Zwangsneutral" 32 "ENPG3 ohne aktivem Zwangsneutral" 33 "ENPG4 ohne aktivem Zwangsneutral" 34 "ENPG6 ohne aktivem Zwangsneutral" 35 "ENPG1 mit aktivem Zwangsneutral" 36 "ENPG1 ohne aktivem Zwangsneutral" 37 "ENPG7 mit aktivem Zwangsneutral" 38 "ENPG7 ohne aktivem Zwangsneutral" 39 "ENPG8 mit aktivem Zwangsneutral" 40 "ENPG8 ohne aktivem Zwangsneutral" 41 "nicht aktiv" 42 "nicht aktiv" 43 "nicht aktiv" 44 "ENPG1 ohne aktivem Zwangsneutral (IAE)" 45 "nicht aktiv" 46 "nicht aktiv" 47 "nicht aktiv" 48 "nicht aktiv" 49 "nicht aktiv" 50 "nicht aktiv" /end COMPU_VTAB
/begin COMPU_VTAB Conv.cItfInput._.notgang_S6_S3 "Umrechnung fuer Messgroesse cItfInput::notgang" TAB_VERB 10 -1 "GR1" 0 "KEIN_GANG" 1 "G1" 2 "G2" 3 "G3" 4 "G4" 5 "G5" 6 "G6" 7 "G7" 8 "G8" /end COMPU_VTAB
/begin COMPU_VTAB Conv.cItfInput._.iv_edsmversatzinfo_S6_S3 "Umrechnung fuer Messgroesse cItfInput::iv_edsmversatzinfo" TAB_VERB 8 0 "keine edsmv_ersatzinfo" 1 "GRAUS -vorbelegt fuer MECH_NOTLAUF- nur HSS1 aus" 2 "LOWSIDE-OFF -vorbelegt fuer LOWSIDEOFF-" 3 "nicht belegt war mal EL_SIM_NL in der 53 Umsschaltphase" 4 "nicht belegt war mal EL_SIM_NL" 5 "nicht belegt war mal Sonderbestromung Notlauf 2" 6 "nicht relevant fuer ATSYS" 7 "HSS1 und HSS2 aus" /end COMPU_VTAB
/begin COMPU_VTAB Conv.cItfInput._.iv_fahrbet_task_S6_S3 "Umrechnung fuer Messgroesse cItfInput::iv_fahrbet_task" TAB_VERB 2 0 "Fahrbetiebstask nicht aktiv" 1 "Fahrbetriebstask aktiv" /end COMPU_VTAB
/begin COMPU_VTAB Conv.cItfInput._.iv_notltask_S6_S3 "Umrechnung fuer Messgroesse cItfInput::iv_notltask" TAB_VERB 2 0 "Notlauftask nicht aktiv" 1 "Notlauftask aktiv" /end COMPU_VTAB
/begin COMPU_VTAB Conv.cItfInput._.iv_sbytask_S6_S3 "Umrechnung fuer Messgroesse cItfInput::iv_sbytask" TAB_VERB 2 0 "Standbytask nicht aktiv" 1 "Standbytask aktiv" /end COMPU_VTAB
/begin COMPU_VTAB Conv.cItfInput._.verbot_sas_fkt_S6_S3 "Umrechnung fuer Messgroesse cItfInput::verbot_sas_fkt" TAB_VERB 2 0 "kein Verbot der SAS Funktionen" 1 "Verbot der SAS Funktionen" /end COMPU_VTAB
/begin COMPU_VTAB Conv.cItfInput._.saf_has_aktiv_S6_S3 "Umrechnung fuer Messgroesse cItfInput::saf_has_aktiv" TAB_VERB 2 0 "keine Schaltanforderung HAS" 1 "Schaltanforderung HAS" /end COMPU_VTAB
/begin COMPU_VTAB Conv.cItfInput._.schluesselstart_aktiv_S6_S3 "Umrechnung fuer Messgroesse cItfInput::schluesselstart_aktiv" TAB_VERB 2 0 "keine Schluesselstart (Standard)" 1 "Schluesselstart (Prio K0)" /end COMPU_VTAB
/begin COMPU_VTAB Conv.cItfInput._.svh_aktiv_has_S6_S3 "Umrechnung fuer Messgroesse cItfInput::svh_aktiv_has" TAB_VERB 2 0 "keine Schaltverhinderung" 1 "Schaltverhinderung aktiv" /end COMPU_VTAB
/begin COMPU_VTAB Conv.cItfInput._.iv_has_aktiv_S6_S3 "Umrechnung fuer Messgroesse cItfInput::iv_has_aktiv" TAB_VERB 2 0 "HAS_ABLAUF_NICHTAKTIV" 1 "HAS_ABLAUF_AKTIV" /end COMPU_VTAB
/begin COMPU_VTAB Conv.cItfInput._.has_aktiv_S6_S3 "Umrechnung fuer Messgroesse cItfInput::has_aktiv" TAB_VERB 2 0 "HAS_ABLAUF_NICHTAKTIV" 1 "HAS_ABLAUF_AKTIV" /end COMPU_VTAB
/begin COMPU_VTAB Conv.cItfInput._.iv_pos_S6_S3 "Umrechnung fuer Messgroesse cItfInput::iv_pos" TAB_VERB 9 0 "Pos. 1" 1 "Pos. 2" 2 "Pos. 3" 3 "Pos. 4" 4 "Pos. 5" 5 "Pos. D" 6 "Pos. N" 7 "Pos. R" 8 "Pos. P" /end COMPU_VTAB
/begin COMPU_VTAB Conv.cItfInput._.iv_gsoll_S6_S3 "Umrechnung fuer Messgroesse cItfInput::iv_gsoll" TAB_VERB 10 -1 "GR1" 0 "KEIN_GANG" 1 "G1" 2 "G2" 3 "G3" 4 "G4" 5 "G5" 6 "G6" 7 "G7" 8 "G8" /end COMPU_VTAB
/begin COMPU_VTAB Conv.cItfInput._.iv_blsdefakt_S6_S3 "Umrechnung fuer Messgroesse cItfInput::iv_blsdefakt" TAB_VERB 2 0 "Bremslicht aus" 1 "Bremslicht ein" /end COMPU_VTAB
/begin COMPU_VTAB Conv.cItfInput._.iv_blsdefpas_S6_S3 "Umrechnung fuer Messgroesse cItfInput::iv_blsdefpas" TAB_VERB 2 0 "Bremslicht aus" 1 "Bremslicht ein" /end COMPU_VTAB
/begin COMPU_VTAB Conv.cItfInput._.iv_feststellbremseaktiv_S6_S3 "Umrechnung fuer Messgroesse cItfInput::iv_feststellbremseaktiv" TAB_VERB 2 0 "Feststellbremse nicht angezogen" 1 "Feststellbremse angezogen" /end COMPU_VTAB
/begin COMPU_VTAB Conv.cItfInput._.iv_el_not_entr_S6_S3 "Umrechnung fuer Messgroesse cItfInput::iv_el_not_entr" TAB_VERB 2 0 "Normalbetrieb" 1 "Elektrische Notentriegelung aktiv" /end COMPU_VTAB
/begin COMPU_VTAB Conv.cItfInput._.iv_druck_vorhanden_mod_S6_S3 "Umrechnung fuer Messgroesse cItfInput::iv_druck_vorhanden_mod" TAB_VERB 2 0 "keine Modifikation" 1 "Modifikation aktiv" /end COMPU_VTAB
/begin COMPU_VTAB Conv.cItfInput._.iv_anhaengeraktiv_S6_S3 "Umrechnung fuer Messgroesse cItfInput::iv_anhaengeraktiv" TAB_VERB 2 0 "Kein Anhaengerbetrieb" 1 "Anhaengerbetrieb" /end COMPU_VTAB
/begin COMPU_VTAB Conv.cItfInput._.iv_transportmode_aktiv_S6_S3 "Umrechnung fuer Messgroesse cItfInput::iv_transportmode_aktiv" TAB_VERB 2 0 "Transportmode nicht aktiv" 1 "Transportmode aktiv" /end COMPU_VTAB
/begin COMPU_VTAB Conv.cItfInput._.iv_ascreg_S6_S3 "Umrechnung fuer Messgroesse cItfInput::iv_ascreg" TAB_VERB 2 0 "ASC regelt nicht" 1 "ASC regelt" /end COMPU_VTAB
/begin COMPU_VTAB Conv.cItfInput._.iv_ascpas_S6_S3 "Umrechnung fuer Messgroesse cItfInput::iv_ascpas" TAB_VERB 2 0 "ASC funktional nicht abgeschaltet" 1 "ASC funktional abgeschaltet" /end COMPU_VTAB
/begin COMPU_VTAB Conv.cItfInput._.iv_pssensorsignal_S6_S3 "Umrechnung fuer Messgroesse cItfInput::iv_pssensorsignal" TAB_VERB 4 0 "Position nicht P" 1 "Position P" 2 "Zwischenposition" 3 "Fehler" /end COMPU_VTAB
/begin COMPU_VTAB Conv.cItfInput._.iv_pssensorsignal_status_S6_S3 "Umrechnung fuer Messgroesse cItfInput::iv_pssensorsignal_status" TAB_VERB 3 0 "Signal o.K." 1 "Ersatzwert" 2 "Signal fehlerhaft" /end COMPU_VTAB
/begin COMPU_VTAB Conv.cItfInput._.manuell_S6_S3 "Umrechnung fuer Messgroesse cItfInput::manuell" TAB_VERB 2 0 "kein Steptronicbetrieb" 1 "Steptronicbetrieb" /end COMPU_VTAB
/begin COMPU_VTAB Conv.cItfInput._.iv_zzuendung_S6_S3 "Umrechnung fuer Messgroesse cItfInput::iv_zzuendung" TAB_VERB 5 0 "undefiniert" 1 "Zuendung aus->ein" 2 "Zuendung ein" 3 "Zuendung ein->aus" 4 "Zuendung aus" /end COMPU_VTAB
/begin COMPU_VTAB Conv.cItfInput._.z_zuendung_S6_S3 "Umrechnung fuer Messgroesse cItfInput::z_zuendung" TAB_VERB 5 0 "undefiniert" 1 "Zuendung aus->ein" 2 "Zuendung ein" 3 "Zuendung ein->aus" 4 "Zuendung aus" /end COMPU_VTAB
/begin COMPU_VTAB Conv.cItfInput._.freigabe_posvdiag_S6_S3 "Umrechnung fuer Messgroesse cItfInput::freigabe_posvdiag" TAB_VERB 2 0 "Posv Ueberwachung nicht freigegeben" 1 "Posv Ueberwachung freigegeben" /end COMPU_VTAB
/begin COMPU_VTAB Conv.cItfInput._.iv_freigabe_posvdiag_S6_S3 "Umrechnung fuer Messgroesse cItfInput::iv_freigabe_posvdiag" TAB_VERB 2 0 "Posv Ueberwachung nicht freigegeben" 1 "Posv Ueberwachung freigegeben" /end COMPU_VTAB
/begin COMPU_VTAB Conv.cItfInput._.iv_posstatus_S6_S3 "Umrechnung fuer Messgroesse cItfInput::iv_posstatus" TAB_VERB 3 0 "Signal o.K." 1 "Ersatzwert" 2 "Signal fehlerhaft" /end COMPU_VTAB
/begin COMPU_VTAB Conv.cItfInput._.iv_nabstatus_S6_S3 "Umrechnung fuer Messgroesse cItfInput::iv_nabstatus" TAB_VERB 3 0 "Signal o.K." 1 "Ersatzwert" 2 "Signal fehlerhaft" /end COMPU_VTAB
/begin COMPU_VTAB Conv.cItfInput._.iv_ntstatus_S6_S3 "Umrechnung fuer Messgroesse cItfInput::iv_ntstatus" TAB_VERB 3 0 "Signal o.K." 1 "Ersatzwert" 2 "Signal fehlerhaft" /end COMPU_VTAB
/begin COMPU_VTAB Conv.cItfInput._.iv_nmotstatus_S6_S3 "Umrechnung fuer Messgroesse cItfInput::iv_nmotstatus" TAB_VERB 3 0 "Signal o.K." 1 "Ersatzwert" 2 "Signal fehlerhaft" /end COMPU_VTAB
/begin COMPU_VTAB Conv.cItfInput._.iv_mmotstatus_S6_S3 "Umrechnung fuer Messgroesse cItfInput::iv_mmotstatus" TAB_VERB 3 0 "Signal o.K." 1 "Ersatzwert" 2 "Signal fehlerhaft" /end COMPU_VTAB
/begin COMPU_VTAB Conv.cItfInput._.iv_cgetrstatus_S6_S3 "Umrechnung fuer Messgroesse cItfInput::iv_cgetrstatus" TAB_VERB 3 0 "Signal o.K." 1 "Ersatzwert" 2 "Signal fehlerhaft" /end COMPU_VTAB
/begin COMPU_VTAB Conv.cItfInput._.iv_neigungstatus_S6_S3 "Umrechnung fuer Messgroesse cItfInput::iv_neigungstatus" TAB_VERB 3 0 "Signal o.K." 1 "Ersatzwert" 2 "Signal fehlerhaft" /end COMPU_VTAB
/begin COMPU_VTAB Conv.cItfInput._.init_n_t_S6_S3 "Umrechnung fuer Messgroesse cItfInput::init_n_t" TAB_VERB 2 0 "FALSE" 1 "TRUE" /end COMPU_VTAB
/begin COMPU_VTAB Conv.cItfInput._.init_n_abneu_gef_S6_S3 "Umrechnung fuer Messgroesse cItfInput::init_n_abneu_gef" TAB_VERB 2 0 "FALSE" 1 "TRUE" /end COMPU_VTAB
/begin COMPU_VTAB Conv.cItfInput._.pos_S6_S3 "Umrechnung fuer Messgroesse cItfInput::pos" TAB_VERB 9 0 "Pos. 1" 1 "Pos. 2" 2 "Pos. 3" 3 "Pos. 4" 4 "Pos. 5" 5 "Pos. D" 6 "Pos. N" 7 "Pos. R" 8 "Pos. P" /end COMPU_VTAB
/begin COMPU_VTAB Conv.cItfInput._.pos_wunsch_S6_S3 "Umrechnung fuer Messgroesse cItfInput::pos_wunsch" TAB_VERB 9 0 "Pos. 1" 1 "Pos. 2" 2 "Pos. 3" 3 "Pos. 4" 4 "Pos. 5" 5 "Pos. D" 6 "Pos. N" 7 "Pos. R" 8 "Pos. P" /end COMPU_VTAB
/begin COMPU_VTAB Conv.cItfInput._.pssensorsignal_status_S6_S3 "Umrechnung fuer Messgroesse cItfInput::pssensorsignal_status" TAB_VERB 3 0 "Signal o.K." 1 "Ersatzwert" 2 "Signal fehlerhaft" /end COMPU_VTAB
/begin COMPU_VTAB Conv.cItfInput._.iv_abs_reg_status_S6_S3 "Umrechnung fuer Messgroesse cItfInput::iv_abs_reg_status" TAB_VERB 3 0 "Signal o.K." 1 "Ersatzwert" 2 "Signal fehlerhaft" /end COMPU_VTAB
/begin COMPU_VTAB Conv.cItfInput._.abs_reg_status_S6_S3 "Umrechnung fuer Messgroesse cItfInput::abs_reg_status" TAB_VERB 3 0 "Signal o.K." 1 "Ersatzwert" 2 "Signal fehlerhaft" /end COMPU_VTAB
/begin COMPU_VTAB Conv.cItfInput._.sollgang_S6_S3 "Umrechnung fuer Messgroesse cItfInput::sollgang" TAB_VERB 10 -1 "GR1" 0 "KEIN_GANG" 1 "G1" 2 "G2" 3 "G3" 4 "G4" 5 "G5" 6 "G6" 7 "G7" 8 "G8" /end COMPU_VTAB
/begin COMPU_VTAB Conv.cItfInput._.k0_soll_S6_S3 "Umrechnung fuer Messgroesse cItfInput::k0_soll" TAB_VERB 6 0 "K0 Oeffnen" 1 "K0 Befuellen" 2 "K0 Druckstellung" 3 "K0 Schlupfgeregelt" 4 "K0 Geregelt geschlossen" 5 "K0 Geschlossen" /end COMPU_VTAB
/begin COMPU_VTAB Conv.cItfInput._.n_vm_status_S6_S3 "Umrechnung fuer Messgroesse cItfInput::n_vm_status" TAB_VERB 3 0 "Signal o.K." 1 "Ersatzwert" 2 "Signal fehlerhaft" /end COMPU_VTAB
/begin COMPU_VTAB Conv.cItfInput._.z_k0_soll_subst_S6_S3 "Umrechnung fuer Messgroesse cItfInput::z_k0_soll_subst" TAB_VERB 4 0 "Keine Anforderung aus der Diagnose - K0 Normalbetrieb" 1 "k0_soll_gepr = 5 (GESCHLOSSEN)" 2 "k0_soll_gepr = 0 (OEFFNENSW)" 3 "k0_soll_gepr = 6 (GESCHLOSSENALT)" /end COMPU_VTAB
/begin COMPU_VTAB Conv.cItfInput._.z_k0_befuellopt_S6_S3 "Umrechnung fuer Messgroesse cItfInput::z_k0_befuellopt" TAB_VERB 3 0 "normale Befuellung K0" 1 "optimierte Befuellung K0" 2 "reduzierte Befuellung K0" /end COMPU_VTAB
/begin COMPU_VTAB Conv.cItfInput._.flag_p_hys_k0_has_S6_S3 "Umrechnung fuer Messgroesse cItfInput::flag_p_hys_k0_has" TAB_VERB 2 0 "Druckanteil p_hys_k0 inaktiv" 1 "Druckanteil p_hys_k0 aktiv" /end COMPU_VTAB
/begin COMPU_VTAB Conv.cItfInput._.mvg_vm_start_S6_S3 "Umrechnung fuer Messgroesse cItfInput::mvg_vm_start" TAB_VERB 9 0 "kein Start der VM" 1 "Startart 1 der VM" 2 "Startart 2 der VM" 3 "Startart 3 der VM" 4 "Startart 4 der VM" 5 "Startart 5 der VM" 6 "Startart 6 der VM" 7 "Startart 7 der VM" 8 "Startart 8 der VM" /end COMPU_VTAB
/begin COMPU_VTAB Conv.cItfInput._.iv_mvg_vm_start_S6_S3 "Umrechnung fuer Messgroesse cItfInput::iv_mvg_vm_start" TAB_VERB 9 0 "kein Start der VM" 1 "Startart 1 der VM" 2 "Startart 2 der VM" 3 "Startart 3 der VM" 4 "Startart 4 der VM" 5 "Startart 5 der VM" 6 "Startart 6 der VM" 7 "Startart 7 der VM" 8 "Startart 8 der VM" /end COMPU_VTAB
/begin COMPU_VTAB Conv.cItfInput._.pt_damping_active_S6_S3 "Umrechnung fuer Messgroesse cItfInput::pt_damping_active" TAB_VERB 2 0 "damping Power train not active" 1 "damping Power train active" /end COMPU_VTAB
/begin COMPU_VTAB Conv.cItfInput._.iv_pt_damping_active_S6_S3 "Umrechnung fuer Messgroesse cItfInput::iv_pt_damping_active" TAB_VERB 2 0 "damping Power train not active" 1 "damping Power train active" /end COMPU_VTAB
/begin COMPU_VTAB Conv.cItfInput._.iv_svh_aktiv_has_S6_S3 "Umrechnung fuer Messgroesse cItfInput::iv_svh_aktiv_has" TAB_VERB 2 0 "keine Schaltverhinderung" 1 "Schaltverhinderung aktiv" /end COMPU_VTAB
/begin COMPU_VTAB Conv.cItfInput._.iv_n_vm_status_S6_S3 "Umrechnung fuer Messgroesse cItfInput::iv_n_vm_status" TAB_VERB 3 0 "Signal o.K." 1 "Ersatzwert" 2 "Signal fehlerhaft" /end COMPU_VTAB
/begin COMPU_VTAB Conv.cItfInput._.iv_k0_soll_S6_S3 "Umrechnung fuer Messgroesse cItfInput::iv_k0_soll" TAB_VERB 6 0 "K0 Oeffnen" 1 "K0 Befuellen" 2 "K0 Druckstellung" 3 "K0 Schlupfgeregelt" 4 "K0 Geregelt geschlossen" 5 "K0 Geschlossen" /end COMPU_VTAB
/begin COMPU_VTAB Conv.cItfInput._.iv_z_k0_soll_subst_S6_S3 "Umrechnung fuer Messgroesse cItfInput::iv_z_k0_soll_subst" TAB_VERB 4 0 "Keine Anforderung aus der Diagnose - K0 Normalbetrieb" 1 "k0_soll_gepr = 5 (GESCHLOSSEN)" 2 "k0_soll_gepr = 0 (OEFFNENSW)" 3 "k0_soll_gepr = 6 (GESCHLOSSENALT)" /end COMPU_VTAB
/begin COMPU_VTAB Conv.cItfInput._.iv_z_k0_befuellopt_S6_S3 "Umrechnung fuer Messgroesse cItfInput::iv_z_k0_befuellopt" TAB_VERB 3 0 "normale Befuellung K0" 1 "optimierte Befuellung K0" 2 "reduzierte Befuellung K0" /end COMPU_VTAB
/begin COMPU_VTAB Conv.cItfInput._.iv_flag_p_hys_k0_has_S6_S3 "Umrechnung fuer Messgroesse cItfInput::iv_flag_p_hys_k0_has" TAB_VERB 2 0 "Druckanteil p_hys_k0 inaktiv" 1 "Druckanteil p_hys_k0 inaktiv" /end COMPU_VTAB
/begin COMPU_VTAB Conv.cItfInput._.iv_saf_has_aktiv_S6_S3 "Umrechnung fuer Messgroesse cItfInput::iv_saf_has_aktiv" TAB_VERB 2 0 "keine Schaltanforderungt" 1 "Schaltanforderung" /end COMPU_VTAB
/begin COMPU_VTAB Conv.cItfInput._.iv_verbot_sas_fkt_S6_S3 "Umrechnung fuer Messgroesse cItfInput::iv_verbot_sas_fkt" TAB_VERB 2 0 "kein Verbot der GLS-Funktionen" 1 "Verbot der GLS-Funktionen" /end COMPU_VTAB
/begin COMPU_VTAB Conv.cItfInput._.iv_schluesselstart_aktiv_S6_S3 "Umrechnung fuer Messgroesse cItfInput::iv_schluesselstart_aktiv" TAB_VERB 2 0 "keine Schluesselstart" 1 "Schluesselstart" /end COMPU_VTAB
/begin COMPU_VTAB Conv.cItfInput._.iv_status_has_S6_S3 "Umrechnung fuer Messgroesse cItfInput::iv_status_has" TAB_VERB 16 0 "kein Ablauf aktiv" 1 "normaler Ablauf" 2 "normaler Ablauf" 3 "normaler Ablauf" 4 "normaler Ablauf" 5 "normaler Ablauf" 6 "normaler Ablauf" 7 "normaler Ablauf" 8 "Ende normaler Ablauf" 9 "Abbruch aktiv" 10 "Abbruch aktiv" 11 "Abbruch aktiv" 12 "Abbruch aktiv" 13 "Abbruch aktiv" 14 "Abbruch abgeschlossen" 15 "Sprunganf. bei aufgetretenem Fehler" /end COMPU_VTAB
/begin COMPU_VTAB Conv.cItfInput._.status_has_S6_S3 "Umrechnung fuer Messgroesse cItfInput::status_has" TAB_VERB 16 0 "kein Ablauf aktiv" 1 "normaler Ablauf" 2 "normaler Ablauf" 3 "normaler Ablauf" 4 "normaler Ablauf" 5 "normaler Ablauf" 6 "normaler Ablauf" 7 "normaler Ablauf" 8 "Ende normaler Ablauf" 9 "Abbruch aktiv" 10 "Abbruch aktiv" 11 "Abbruch aktiv" 12 "Abbruch aktiv" 13 "Abbruch aktiv" 14 "Abbruch abgeschlossen" 15 "Sprunganf. bei aufgetretenem Fehler" /end COMPU_VTAB
/begin COMPU_VTAB Conv.cItfInput._.edsmv_ersatzinfo_S6_S3 "Umrechnung fuer Messgroesse cItfInput::edsmv_ersatzinfo" TAB_VERB 8 0 "keine edsmv_ersatzinfo" 1 "GRAUS -vorbelegt fuer MECH_NOTLAUF- nur HSS1 aus" 2 "LOWSIDE-OFF -vorbelegt fuer LOWSIDEOFF-" 3 "nicht belegt war mal EL_SIM_NL in der 53 Umsschaltphase" 4 "nicht belegt war mal EL_SIM_NL" 5 "nicht belegt war mal Sonderbestromung Notlauf 2" 6 "nicht relevant fuer ATSYS" 7 "HSS1 und HSS2 aus" /end COMPU_VTAB
/begin COMPU_VTAB Conv.cItfInput._.stromlos_ausser_ps_S6_S3 "Umrechnung fuer Messgroesse cItfInput::stromlos_ausser_ps" TAB_VERB 2 0 "Endstufe nicht stromlos" 1 "Endstufen stromlos" /end COMPU_VTAB
/begin COMPU_VTAB Conv.cItfInput._.stromlos_ausser_ps_und_i_min_S6_S3 "Umrechnung fuer Messgroesse cItfInput::stromlos_ausser_ps_und_i_min" TAB_VERB 2 0 "Endstufe nicht stromlos" 1 "Endstufen stromlos" /end COMPU_VTAB
/begin COMPU_VTAB Conv.cItfInput._.stromlos_ges_S6_S3 "Umrechnung fuer Messgroesse cItfInput::stromlos_ges" TAB_VERB 2 0 "Endstufe nicht stromlos" 1 "Endstufen stromlos" /end COMPU_VTAB
/begin COMPU_VTAB Conv.cItfInput._.hyd_notlauf_S6_S3 "Umrechnung fuer Messgroesse cItfInput::hyd_notlauf" TAB_VERB 2 0 "kein hyd. Notlauf" 1 "hyd. Notlauf inkl simulierter NL" /end COMPU_VTAB
/begin COMPU_VTAB Conv.cItfInput._.stromlos_ps_S6_S3 "Umrechnung fuer Messgroesse cItfInput::stromlos_ps" TAB_VERB 2 0 "Endstufe nicht stromlos" 1 "Endstufen stromlos" /end COMPU_VTAB
/begin COMPU_VTAB Conv.cItfInput._.max_p_haupt_S6_S3 "Umrechnung fuer Messgroesse cItfInput::max_p_haupt" TAB_VERB 2 0 "Max. Hauptdruck nicht aktiv" 1 "Max. Hauptdruck aktiv" /end COMPU_VTAB
/begin COMPU_VTAB Conv.cItfInput._.ersf_k0auf_S6_S3 "Umrechnung fuer Messgroesse cItfInput::ersf_k0auf" TAB_VERB 2 0 "Ersatzfkt. nicht aktiv" 1 "Ersatzfkt. aktiv" /end COMPU_VTAB
/begin COMPU_VTAB Conv.cItfInput._.zug_schub_S6_S3 "Umrechnung fuer Messgroesse cItfInput::zug_schub" TAB_VERB 2 0 "SCHUB" 1 "ZUG" /end COMPU_VTAB
/begin COMPU_VTAB Conv.cItfInput._.bls_defakt_S6_S3 "Umrechnung fuer Messgroesse cItfInput::bls_defakt" TAB_VERB 2 0 "Bremslicht aus" 1 "Bremslicht ein" /end COMPU_VTAB
/begin COMPU_VTAB Conv.cItfInput._.bls_defpas_S6_S3 "Umrechnung fuer Messgroesse cItfInput::bls_defpas" TAB_VERB 2 0 "Bremslicht aus" 1 "Bremslicht ein" /end COMPU_VTAB
/begin COMPU_VTAB Conv.cItfInput._.feststellbremse_aktiv_S6_S3 "Umrechnung fuer Messgroesse cItfInput::feststellbremse_aktiv" TAB_VERB 2 0 "Feststellbremse nicht angezogen" 1 "Feststellbremse angezogen" /end COMPU_VTAB
/begin COMPU_VTAB Conv.cItfInput._.el_not_entr_S6_S3 "Umrechnung fuer Messgroesse cItfInput::el_not_entr" TAB_VERB 2 0 "Normalbetrieb" 1 "Elektrische Notentriegelung aktiv" /end COMPU_VTAB
/begin COMPU_VTAB Conv.cItfInput._.druck_vorhanden_mod_S6_S3 "Umrechnung fuer Messgroesse cItfInput::druck_vorhanden_mod" TAB_VERB 2 0 "keine Modifikation" 1 "Modifikation aktiv" /end COMPU_VTAB
/begin COMPU_VTAB Conv.cItfInput._.anhaenger_aktiv_S6_S3 "Umrechnung fuer Messgroesse cItfInput::anhaenger_aktiv" TAB_VERB 2 0 "Kein Anhaengerbetrieb" 1 "Anhaengerbetrieb" /end COMPU_VTAB
/begin COMPU_VTAB Conv.cItfInput._.transportmode_aktiv_S6_S3 "Umrechnung fuer Messgroesse cItfInput::transportmode_aktiv" TAB_VERB 2 0 "Transportmode nicht aktiv" 1 "Transportmode aktiv" /end COMPU_VTAB
/begin COMPU_VTAB Conv.cItfInput._.asc_regelt_S6_S3 "Umrechnung fuer Messgroesse cItfInput::asc_regelt" TAB_VERB 2 0 "ASC regelt nicht" 1 "ASC regelt" /end COMPU_VTAB
/begin COMPU_VTAB Conv.cItfInput._.asc_passiv_S6_S3 "Umrechnung fuer Messgroesse cItfInput::asc_passiv" TAB_VERB 2 0 "ASC funktional nicht abgeschaltet" 1 "ASC funktional abgeschaltet" /end COMPU_VTAB
/begin COMPU_VTAB Conv.cItfInput._.iv_blsstatus_S6_S3 "Umrechnung fuer Messgroesse cItfInput::iv_blsstatus" TAB_VERB 3 0 "Signal o.K." 1 "Ersatzwert" 2 "Signal fehlerhaft" /end COMPU_VTAB
/begin COMPU_VTAB Conv.cItfInput._.n_mot_status_S6_S3 "Umrechnung fuer Messgroesse cItfInput::n_mot_status" TAB_VERB 3 0 "Signal o.K." 1 "Ersatzwert" 2 "Signal fehlerhaft" /end COMPU_VTAB
/begin COMPU_VTAB Conv.cItfInput._.pos_status_S6_S3 "Umrechnung fuer Messgroesse cItfInput::pos_status" TAB_VERB 3 0 "Signal o.K." 1 "Ersatzwert" 2 "Signal fehlerhaft" /end COMPU_VTAB
/begin COMPU_VTAB Conv.cItfInput._.n_ab_status_S6_S3 "Umrechnung fuer Messgroesse cItfInput::n_ab_status" TAB_VERB 3 0 "Signal o.K." 1 "Ersatzwert" 2 "Signal fehlerhaft" /end COMPU_VTAB
/begin COMPU_VTAB Conv.cItfInput._.n_t_status_S6_S3 "Umrechnung fuer Messgroesse cItfInput::n_t_status" TAB_VERB 3 0 "Signal o.K." 1 "Ersatzwert" 2 "Signal fehlerhaft" /end COMPU_VTAB
/begin COMPU_VTAB Conv.cItfInput._.m_mot_status_S6_S3 "Umrechnung fuer Messgroesse cItfInput::m_mot_status" TAB_VERB 3 0 "Signal o.K." 1 "Ersatzwert" 2 "Signal fehlerhaft" /end COMPU_VTAB
/begin COMPU_VTAB Conv.cItfInput._.c_getr_status_S6_S3 "Umrechnung fuer Messgroesse cItfInput::c_getr_status" TAB_VERB 3 0 "Signal o.K." 1 "Ersatzwert" 2 "Signal fehlerhaft" /end COMPU_VTAB
/begin COMPU_VTAB Conv.cItfInput._.bls_status_S6_S3 "Umrechnung fuer Messgroesse cItfInput::bls_status" TAB_VERB 3 0 "Signal o.K." 1 "Ersatzwert" 2 "Signal fehlerhaft" /end COMPU_VTAB
/begin COMPU_VTAB Conv.cItfInput._.neigung_status_S6_S3 "Umrechnung fuer Messgroesse cItfInput::neigung_status" TAB_VERB 3 0 "Signal o.K." 1 "Ersatzwert" 2 "Signal fehlerhaft" /end COMPU_VTAB
/begin COMPU_VTAB Conv.cItfInput._.k0_diag_moeglich_S6_S3 "Umrechnung fuer Messgroesse cItfInput::k0_diag_moeglich" TAB_VERB 2 0 "Signale fehlerhaft" 1 "Signale n_mot n_ab und m_mot ok" /end COMPU_VTAB
/begin COMPU_VTAB Conv.cItfInput._.pumpendruck_vorhanden_S6_S3 "Umrechnung fuer Messgroesse cItfInput::pumpendruck_vorhanden" TAB_VERB 2 0 "Event. kein Pumpendruck vorhanden" 1 "Pumpendruck sicher vorhanden" /end COMPU_VTAB
/begin COMPU_VTAB Conv.cItfInput._.pumpendruck_nicht_vorhanden_S6_S3 "Umrechnung fuer Messgroesse cItfInput::pumpendruck_nicht_vorhanden" TAB_VERB 2 0 "Pumpendruck eventuell vorhanden" 1 "Pumpendruck sicher nicht vorhanden" /end COMPU_VTAB
/begin COMPU_VTAB Conv.cItfInput._.i_min_ausser_parksperre_S6_S3 "Umrechnung fuer Messgroesse cItfInput::i_min_ausser_parksperre" TAB_VERB 2 0 "Keine Minimalbestromung EDS1-6 und MV1-2" 1 "Minimalbestromung EDS1-6 und MV1-2" /end COMPU_VTAB
/begin COMPU_VTAB Conv.cItfInput._.f_minimaldruck_ausgabe_S6_S3 "Umrechnung fuer Messgroesse cItfInput::f_minimaldruck_ausgabe" TAB_VERB 2 0 "keine Vorgabe" 1 "Minimal-Druck Vorgabe" /end COMPU_VTAB
/begin COMPU_VTAB Conv.cItfInput._.nullbestromung_aktiv_S6_S3 "Umrechnung fuer Messgroesse cItfInput::nullbestromung_aktiv" TAB_VERB 2 0 "Keine Nullbestromung (0mA) auf I_ABGESCHALTET" 1 "Nullbestromung (0mA) auf EDS1-6" /end COMPU_VTAB
/begin COMPU_VTAB Conv.cItfInput._.hdc_S6_S3 "Umrechnung fuer Messgroesse cItfInput::hdc" TAB_VERB 8 0 "HDC aus - nicht eingeschaltet" 1 "gesperrt  nicht im korrekten Gang" 2 "gesperrt nicht im unteren Gangbereich - falls vorhanden" 3 "aufgrund zu hoher Geschwindigkeit gesperrt" 4 "inaktiv vorübergehend" 5 "freigegeben aber nicht aktiv keine Gefällefahrt" 6 "aktiv - freigegeben und Gefällefahrt Kombiinstrument lässt Lampe blinken." 7 "HDC-Fehler" /end COMPU_VTAB
/begin COMPU_VTAB Conv.cItfInput._.iv_hdc_S6_S3 "Umrechnung fuer Messgroesse cItfInput::iv_hdc" TAB_VERB 8 0 "HDC aus - nicht eingeschaltet" 1 "gesperrt  nicht im korrekten Gang" 2 "gesperrt nicht im unteren Gangbereich - falls vorhanden" 3 "aufgrund zu hoher Geschwindigkeit gesperrt" 4 "inaktiv vorübergehend" 5 "freigegeben aber nicht aktiv keine Gefällefahrt" 6 "aktiv - freigegeben und Gefällefahrt Kombiinstrument lässt Lampe blinken." 7 "HDC-Fehler" /end COMPU_VTAB
/begin COMPU_VTAB Conv.cItfInput._.fl_brake_inter_status_S6_S3 "Umrechnung fuer Messgroesse cItfInput::fl_brake_inter_status" TAB_VERB 3 0 "Signal o.K." 1 "Ersatzwert" 2 "Signal fehlerhaft" /end COMPU_VTAB
/begin COMPU_VTAB Conv.cItfInput._.iv_fl_brake_inter_status_S6_S3 "Umrechnung fuer Messgroesse cItfInput::iv_fl_brake_inter_status" TAB_VERB 3 0 "Signal o.K." 1 "Ersatzwert" 2 "Signal fehlerhaft" /end COMPU_VTAB
/begin COMPU_VTAB Conv.cItfInput._.ldm_S6_S3 "Umrechnung fuer Messgroesse cItfInput::ldm" TAB_VERB 5 0 "Laengsmanagement inaktiv" 1 "ACC/DCC aktiv" 2 "SLD aktiv" 3 "PMA_LQ/RCP aktiv" 4 "EDL aktiv" /end COMPU_VTAB
/begin COMPU_VTAB Conv.cItfInput._.iv_ldm_S6_S3 "Umrechnung fuer Messgroesse cItfInput::iv_ldm" TAB_VERB 5 0 "Laengsmanagement inaktiv" 1 "ACC/DCC aktiv" 2 "SLD aktiv" 3 "PMA_LQ/RCP aktiv" 4 "EDL aktiv" /end COMPU_VTAB
/begin COMPU_VTAB Conv.cItfInput._.ldm_status_S6_S3 "Umrechnung fuer Messgroesse cItfInput::ldm_status" TAB_VERB 3 0 "Signal o.K." 1 "Ersatzwert" 2 "Signal fehlerhaft" /end COMPU_VTAB
/begin COMPU_VTAB Conv.cItfInput._.iv_ldm_status_S6_S3 "Umrechnung fuer Messgroesse cItfInput::iv_ldm_status" TAB_VERB 3 0 "Signal o.K." 1 "Ersatzwert" 2 "Signal fehlerhaft" /end COMPU_VTAB
/begin COMPU_VTAB Conv.cItfInput._.autohold_aktiv_S6_S3 "Umrechnung fuer Messgroesse cItfInput::autohold_aktiv" TAB_VERB 2 0 "FALSE" 1 "TRUE" /end COMPU_VTAB
/begin COMPU_VTAB Conv.cItfInput._.hillhold_aktiv_S6_S3 "Umrechnung fuer Messgroesse cItfInput::hillhold_aktiv" TAB_VERB 2 0 "FALSE" 1 "TRUE" /end COMPU_VTAB
/begin COMPU_VTAB Conv.cItfInput._.iv_fzg_rollverh_aktiv_stat_S6_S3 "Umrechnung fuer Messgroesse cItfInput::iv_fzg_rollverh_aktiv_stat" TAB_VERB 3 0 "Signal o.K." 1 "Ersatzwert" 2 "Signal fehlerhaft" /end COMPU_VTAB
/begin COMPU_VTAB Conv.cItfInput._.fzg_rollverh_aktiv_stat_S6_S3 "Umrechnung fuer Messgroesse cItfInput::fzg_rollverh_aktiv_stat" TAB_VERB 3 0 "Signal o.K." 1 "Ersatzwert" 2 "Signal fehlerhaft" /end COMPU_VTAB
/begin COMPU_VTAB Conv.cItfInput._.ax_ref_status_S6_S3 "Umrechnung fuer Messgroesse cItfInput::ax_ref_status" TAB_VERB 3 0 "Signal o.K." 1 "Ersatzwert" 2 "Signal fehlerhaft" /end COMPU_VTAB
/begin COMPU_VTAB Conv.cItfInput._.iv_ax_ref_status_S6_S3 "Umrechnung fuer Messgroesse cItfInput::iv_ax_ref_status" TAB_VERB 3 0 "Signal o.K." 1 "Ersatzwert" 2 "Signal fehlerhaft" /end COMPU_VTAB
/begin COMPU_VTAB Conv.cItfInput._.ay_ref_status_S6_S3 "Umrechnung fuer Messgroesse cItfInput::ay_ref_status" TAB_VERB 3 0 "Signal o.K." 1 "Ersatzwert" 2 "Signal fehlerhaft" /end COMPU_VTAB
/begin COMPU_VTAB Conv.cItfInput._.iv_ay_ref_status_S6_S3 "Umrechnung fuer Messgroesse cItfInput::iv_ay_ref_status" TAB_VERB 3 0 "Signal o.K." 1 "Ersatzwert" 2 "Signal fehlerhaft" /end COMPU_VTAB
/begin COMPU_VTAB Conv.cItfInput._.n_ab_dir_S6_S3 "Umrechnung fuer Messgroesse cItfInput::n_ab_dir" TAB_VERB 2 -1 "Drehrichtung rueckwaerts" 1 "Drehrichtung vorwaerts" /end COMPU_VTAB
/begin COMPU_VTAB Conv.cItfInput._.iv_n_ab_dir_S6_S3 "Umrechnung fuer Messgroesse cItfInput::iv_n_ab_dir" TAB_VERB 3 0 "Drehrichtung unbestimmt" 1 "Drehrichtung vorwaerts" 2 "Drehrichtung rueckwaerts" /end COMPU_VTAB
/begin COMPU_VTAB Conv.cItfInput._.n_t_dir_S6_S3 "Umrechnung fuer Messgroesse cItfInput::n_t_dir" TAB_VERB 2 -1 "Drehrichtung Pumpe Turbinde ungleichsinnig" 1 "Drehrichtung Pumpe Turbinde gleichsinnig" /end COMPU_VTAB
/begin COMPU_VTAB Conv.cItfInput._.iv_n_t_dir_S6_S3 "Umrechnung fuer Messgroesse cItfInput::iv_n_t_dir" TAB_VERB 3 0 "Drehrichtung unbestimmt" 1 "Drehrichtung Pumpe Turbine gleichsinnig" 2 "Drehrichtung Pumpe Turbine ungleichsinnig" /end COMPU_VTAB
/begin COMPU_VTAB Conv.cItfInput._.iv_n_ab_dir_status_S6_S3 "Umrechnung fuer Messgroesse cItfInput::iv_n_ab_dir_status" TAB_VERB 3 0 "Signal o.K." 1 "Ersatzwert" 2 "Signal fehlerhaft" /end COMPU_VTAB
/begin COMPU_VTAB Conv.cItfInput._.n_ab_dir_status_S6_S3 "Umrechnung fuer Messgroesse cItfInput::n_ab_dir_status" TAB_VERB 3 0 "Signal o.K." 1 "Ersatzwert" 2 "Signal fehlerhaft" /end COMPU_VTAB
/begin COMPU_VTAB Conv.cItfInput._.iv_n_t_dir_status_S6_S3 "Umrechnung fuer Messgroesse cItfInput::iv_n_t_dir_status" TAB_VERB 3 0 "Signal o.K." 1 "Ersatzwert" 2 "Signal fehlerhaft" /end COMPU_VTAB
/begin COMPU_VTAB Conv.cItfInput._.n_t_dir_status_S6_S3 "Umrechnung fuer Messgroesse cItfInput::n_t_dir_status" TAB_VERB 3 0 "Signal o.K." 1 "Ersatzwert" 2 "Signal fehlerhaft" /end COMPU_VTAB
/begin COMPU_VTAB Conv.cItfInput._.iv_ntu_virt_dir_S6_S3 "Umrechnung fuer Messgroesse cItfInput::iv_ntu_virt_dir" TAB_VERB 3 0 "Drehrichtung unbestimmt" 1 "Drehrichtung Pumpe Turbine gleichsinnig" 2 "Drehrichtung Pumpe Turbine ungleichsinnig" /end COMPU_VTAB
/begin COMPU_VTAB Conv.cItfInput._.ntu_virt_dir_S6_S3 "Umrechnung fuer Messgroesse cItfInput::ntu_virt_dir" TAB_VERB 2 -1 "Drehrichtung Pumpe Turbinde ungleichsinnig" 1 "Drehrichtung Pumpe Turbinde gleichsinnig" /end COMPU_VTAB
/begin COMPU_VTAB Conv.cItfInput._.iv_ntu_virt_dir_status_S6_S3 "Umrechnung fuer Messgroesse cItfInput::iv_ntu_virt_dir_status" TAB_VERB 3 0 "Signal o.K." 1 "Ersatzwert" 2 "Signal fehlerhaft" /end COMPU_VTAB
/begin COMPU_VTAB Conv.cItfInput._.ntu_virt_dir_status_S6_S3 "Umrechnung fuer Messgroesse cItfInput::ntu_virt_dir_status" TAB_VERB 3 0 "Signal o.K." 1 "Ersatzwert" 2 "Signal fehlerhaft" /end COMPU_VTAB
/begin COMPU_VTAB Conv.cItfInput._.iv_m_motsoll_mod_status_S6_S3 "Umrechnung fuer Messgroesse cItfInput::iv_m_motsoll_mod_status" TAB_VERB 3 0 "Signal o.K." 1 "Ersatzwert" 2 "Signal fehlerhaft" /end COMPU_VTAB
/begin COMPU_VTAB Conv.cItfInput._.m_motsoll_mod_status_S6_S3 "Umrechnung fuer Messgroesse cItfInput::m_motsoll_mod_status" TAB_VERB 3 0 "Signal o.K." 1 "Ersatzwert" 2 "Signal fehlerhaft" /end COMPU_VTAB
/begin COMPU_VTAB Conv.cItfInput._.f_iep_shutdown_S6_S3 "Umrechnung fuer Messgroesse cItfInput::f_iep_shutdown" TAB_VERB 2 0 "normaler Betrieb" 1 "Abschaltbedingungn erfuelt" /end COMPU_VTAB
/begin COMPU_VTAB Conv.cItfInput._.iv_f_iep_shutdown_S6_S3 "Umrechnung fuer Messgroesse cItfInput::iv_f_iep_shutdown" TAB_VERB 2 0 "normaler Betrieb" 1 "Abschaltbedingungn erfuelt" /end COMPU_VTAB
/begin COMPU_VTAB Conv.cItfInput._.iv_pumpenstatus_iep_S6_S3 "Umrechnung fuer Messgroesse cItfInput::iv_pumpenstatus_iep" TAB_VERB 5 0 "keine Vorgabe" 1 "Iep in Sleep" 2 "Leistungs Punkt 1 angefordert" 3 "Leistungs Punkt 2 angefordert" 4 "Leistungs Punkt 3 angefordert" /end COMPU_VTAB
/begin COMPU_VTAB Conv.cItfInput._.pumpenstatus_iep_S6_S3 "Umrechnung fuer Messgroesse cItfInput::pumpenstatus_iep" TAB_VERB 5 0 "keine Vorgabe" 1 "Iep in Sleep" 2 "Leistungs Punkt 1 angefordert" 3 "Leistungs Punkt 2 angefordert" 4 "Leistungs Punkt 3 angefordert" /end COMPU_VTAB
/begin COMPU_VTAB Conv.cItfInput._.iv_iep_soll_has_S6_S3 "Umrechnung fuer Messgroesse cItfInput::iv_iep_soll_has" TAB_VERB 5 0 "keine Vorgabe" 1 "iep Aus" 2 "Leistungs Punkt 1 angefordert" 3 "Leistungs Punkt 2 angefordert" 4 "Leistungs Punkt 3 angefordert" /end COMPU_VTAB
/begin COMPU_VTAB Conv.cItfInput._.iep_soll_has_S6_S3 "Umrechnung fuer Messgroesse cItfInput::iep_soll_has" TAB_VERB 5 0 "keine Vorgabe" 1 "iep Aus" 2 "Leistungs Punkt 1 angefordert" 3 "Leistungs Punkt 2 angefordert" 4 "Leistungs Punkt 3 angefordert" /end COMPU_VTAB
/begin COMPU_VTAB Conv.cItfInput._.iv_iep_soll_abk_S6_S3 "Umrechnung fuer Messgroesse cItfInput::iv_iep_soll_abk" TAB_VERB 5 0 "keine Vorgabe" 1 "iep Aus" 2 "Leistungs Punkt 1 angefordert" 3 "Leistungs Punkt 2 angefordert" 4 "Leistungs Punkt 3 angefordert" /end COMPU_VTAB
/begin COMPU_VTAB Conv.cItfInput._.iep_soll_abk_S6_S3 "Umrechnung fuer Messgroesse cItfInput::iep_soll_abk" TAB_VERB 5 0 "keine Vorgabe" 1 "iep Aus" 2 "Leistungs Punkt 1 angefordert" 3 "Leistungs Punkt 2 angefordert" 4 "Leistungs Punkt 3 angefordert" /end COMPU_VTAB
/begin COMPU_VTAB Conv.cItfInput._.iv_iep_soll_sab_S6_S3 "Umrechnung fuer Messgroesse cItfInput::iv_iep_soll_sab" TAB_VERB 5 0 "keine Vorgabe" 1 "iep Aus" 2 "Leistungs Punkt 1 angefordert" 3 "Leistungs Punkt 2 angefordert" 4 "Leistungs Punkt 3 angefordert" /end COMPU_VTAB
/begin COMPU_VTAB Conv.cItfInput._.iep_soll_sab_S6_S3 "Umrechnung fuer Messgroesse cItfInput::iep_soll_sab" TAB_VERB 5 0 "keine Vorgabe" 1 "iep Aus" 2 "Leistungs Punkt 1 angefordert" 3 "Leistungs Punkt 2 angefordert" 4 "Leistungs Punkt 3 angefordert" /end COMPU_VTAB
/begin COMPU_VTAB Conv.cItfInput._.iv_iep_soll_tes_S6_S3 "Umrechnung fuer Messgroesse cItfInput::iv_iep_soll_tes" TAB_VERB 4 0 "keine Vorgabe" 1 "Leistungspunkt 1" 2 "Leistungspunkt 2" 3 "Leistungspunkt 3" /end COMPU_VTAB
/begin COMPU_VTAB Conv.cItfInput._.iep_soll_tes_S6_S3 "Umrechnung fuer Messgroesse cItfInput::iep_soll_tes" TAB_VERB 4 0 "keine Vorgabe" 1 "Leistungspunkt 1" 2 "Leistungspunkt 2" 3 "Leistungspunkt 3" /end COMPU_VTAB
/begin COMPU_VTAB Conv.cItfInput._.iv_flag_m_max_has_iae_S6_S3 "Umrechnung fuer Messgroesse cItfInput::iv_flag_m_max_has_iae" TAB_VERB 2 0 "Keine Begrenzung des IAE Moments" 1 "Begrenzung des IAE Moments" /end COMPU_VTAB
/begin COMPU_VTAB Conv.cItfInput._.flag_m_max_has_iae_S6_S3 "Umrechnung fuer Messgroesse cItfInput::flag_m_max_has_iae" TAB_VERB 2 0 "Keine Begrenzung des IAE Moments" 1 "Begrenzung des IAE Moments" /end COMPU_VTAB
/begin COMPU_VTAB Conv.cItfInput._.iv_iae_req_subst_S6_S3 "Umrechnung fuer Messgroesse cItfInput::iv_iae_req_subst" TAB_VERB 2 0 "Keine Überanpressung für IAE angefordert" 1 "Überanpressung für IAE angefordert" /end COMPU_VTAB
/begin COMPU_VTAB Conv.cItfInput._.iae_req_subst_S6_S3 "Umrechnung fuer Messgroesse cItfInput::iae_req_subst" TAB_VERB 2 0 "Keine Überanpressung für IAE angefordert" 1 "Überanpressung für IAE angefordert" /end COMPU_VTAB
/begin COMPU_VTAB Conv.cItfInput._.z_modus_iae_S6_S3 "Umrechnung fuer Messgroesse cItfInput::z_modus_iae" TAB_VERB 3 2 "Hybrid-Anfahren" 0 "E-Anfahren mit Schlupf" 1 "E-Anfahren geschlossen" /end COMPU_VTAB
/begin COMPU_VTAB Conv.cItfInput._.iv_z_modus_iae_S6_S3 "Umrechnung fuer Messgroesse cItfInput::iv_z_modus_iae" TAB_VERB 3 2 "Hybrid-Anfahren" 0 "E-Anfahren mit Schlupf" 1 "E-Anfahren geschlossen" /end COMPU_VTAB
/begin COMPU_VTAB Conv.cItfInput._.iv_ll_mot_aktiv_status_S6_S3 "Umrechnung fuer Messgroesse cItfInput::iv_ll_mot_aktiv_status" TAB_VERB 3 0 "Signal o.K." 1 "Ersatzwert" 2 "Signal fehlerhaft" /end COMPU_VTAB
/begin COMPU_VTAB Conv.cItfInput._.ll_mot_aktiv_status_S6_S3 "Umrechnung fuer Messgroesse cItfInput::ll_mot_aktiv_status" TAB_VERB 3 0 "Signal o.K." 1 "Ersatzwert" 2 "Signal fehlerhaft" /end COMPU_VTAB
/begin COMPU_VTAB Conv.cItfInput._.flag_partfilt_aktiv_S6_S3 "Umrechnung fuer Messgroesse cItfInput::flag_partfilt_aktiv" TAB_VERB 2 0 "keine Regeneration" 1 "Regenertation aktiv" /end COMPU_VTAB
/begin COMPU_VTAB Conv.cItfInput._.iv_flag_partfilt_aktiv_S6_S3 "Umrechnung fuer Messgroesse cItfInput::iv_flag_partfilt_aktiv" TAB_VERB 2 0 "keine Regeneration" 1 "Regenertation aktiv" /end COMPU_VTAB
/begin COMPU_VTAB Conv.cItfInput._.status_n_haltephase_S6_S3 "Umrechnung fuer Messgroesse cItfInput::status_n_haltephase" TAB_VERB 6 0 "HoldN Function not active" 1 "Entrance into HoldN Function" 2 "HoldN Function active" 3 "HoldN Function active (end)" 6 "HoldN Functon interrupted" 7 "Restart of HoldN Function" /end COMPU_VTAB
/begin COMPU_VTAB Conv.cItfInput._.iv_status_n_haltephase_S6_S3 "Umrechnung fuer Messgroesse cItfInput::iv_status_n_haltephase" TAB_VERB 6 0 "HoldN Function not active" 1 "Entrance into HoldN Function" 2 "HoldN Function active" 3 "HoldN Function active (end)" 6 "HoldN Functon interrupted" 7 "Restart of HoldN Function" /end COMPU_VTAB
/begin COMPU_VTAB Conv.cItfInput._.fet0_active_S6_S3 "Umrechnung fuer Messgroesse cItfInput::fet0_active" TAB_VERB 5 0 "FET0 in Sollzustand abgeschaltet" 1 "FET0 in Sollzustand eingeschaltet" 2 "FET0 aufgrund Fehler abgeschaltet" 3 "FET0 wird durch HW Software getestet" 4 "FET0 wegen Unterspannung abgeschaltet" /end COMPU_VTAB
/begin COMPU_VTAB Conv.cItfInput._.iv_fet0_active_S6_S3 "Umrechnung fuer Messgroesse cItfInput::iv_fet0_active" TAB_VERB 5 0 "FET0 in Sollzustand abgeschaltet" 1 "FET0 in Sollzustand eingeschaltet" 2 "FET0 aufgrund Fehler abgeschaltet" 3 "FET0 wird durch HW Software getestet" 4 "FET0 wegen Unterspannung abgeschaltet" /end COMPU_VTAB
/begin COMPU_VTAB Conv.cItfInput._.iv_usensor1_estatus_S6_S3 "Umrechnung fuer Messgroesse cItfInput::iv_usensor1_estatus" TAB_VERB 4 0 "no Error" 4 "0x04 open pin" 32 "0x20 signal to small" 64 "0x40 signal to large" /end COMPU_VTAB
/begin COMPU_VTAB Conv.cItfInput._.usensor1_estatus_S6_S3 "Umrechnung fuer Messgroesse cItfInput::usensor1_estatus" TAB_VERB 4 0 "no Error" 4 "0x04 open pin" 32 "0x20 signal to small" 64 "0x40 signal to large" /end COMPU_VTAB
/begin COMPU_VTAB Conv.cItfInput._.ags_zka_index_S6_S3 "Umrechnung fuer Messgroesse cItfInput::ags_zka_index" TAB_VERB 2 0 "keinen Momentennachfuehrung" 1 "Momentennachfuehrung" /end COMPU_VTAB
/begin COMPU_VTAB Conv.cItfInput._.iv_ags_zka_index_S6_S3 "Umrechnung fuer Messgroesse cItfInput::iv_ags_zka_index" TAB_VERB 2 0 "keinen Momentennachfuehrung" 1 "Momentennachfuehrung" /end COMPU_VTAB
/begin COMPU_VTAB Conv.cItfInputParaumsch._.iv_f_e_fahren_aktiv_S6_S3 "Umrechnung fuer Messgroesse cItfInputParaumsch::iv_f_e_fahren_aktiv" TAB_VERB 2 0 "" 1 "" /end COMPU_VTAB
/begin COMPU_VTAB Conv.cItfInputParaumsch._.f_e_fahren_aktiv_S6_S3 "Umrechnung fuer Messgroesse cItfInputParaumsch::f_e_fahren_aktiv" TAB_VERB 2 0 "" 1 "" /end COMPU_VTAB
/begin COMPU_VTAB Conv.cAzsKorgl._.pos_red_S6_S3 "Umrechnung fuer Messgroesse cAzsKorgl::pos_red" TAB_VERB 4 0 "Position Neutral" 1 "Position Drive" 2 "Position Rueckwaerts" 255 "Undefiniert" /end COMPU_VTAB
/begin COMPU_VTAB Conv.cAzsKorgl._.parksperre_ziel_S6_S3 "Umrechnung fuer Messgroesse cAzsKorgl::parksperre_ziel" TAB_VERB 2 0 "FALSE" 1 "Parksperre einlegen" /end COMPU_VTAB
/begin COMPU_VTAB Conv.cAzsKorgl._.f_kfl_direkt_S6_S3 "Umrechnung fuer Messgroesse cAzsKorgl::f_kfl_direkt" TAB_VERB 2 0 "FALSE" 1 "TRUE" /end COMPU_VTAB
/begin COMPU_VTAB Conv.cAzsKorgl._.f_schaltung_direkt_S6_S3 "Umrechnung fuer Messgroesse cAzsKorgl::f_schaltung_direkt" TAB_VERB 2 0 "FALSE" 1 "TRUE" /end COMPU_VTAB
/begin COMPU_VTAB Conv.cAzsKorgl._.f_stromlos_zzs_S6_S3 "Umrechnung fuer Messgroesse cAzsKorgl::f_stromlos_zzs" TAB_VERB 2 0 "FALSE" 1 "TRUE" /end COMPU_VTAB
/begin COMPU_VTAB Conv.cAzsKorgl._.f_notgang_gesetzt_S6_S3 "Umrechnung fuer Messgroesse cAzsKorgl::f_notgang_gesetzt" TAB_VERB 2 0 "FALSE" 1 "TRUE" /end COMPU_VTAB
/begin COMPU_VTAB Conv.cAzsKorgl._.f_abbruch_schaltung_durch_ga_S6_S3 "Umrechnung fuer Messgroesse cAzsKorgl::f_abbruch_schaltung_durch_ga" TAB_VERB 2 0 "FALSE" 1 "TRUE" /end COMPU_VTAB
/begin COMPU_VTAB Conv.cAzsKorgl._.istgang_abbruch_schaltung_durch_ga_S6_S3 "Umrechnung fuer Messgroesse cAzsKorgl::istgang_abbruch_schaltung_durch_ga" TAB_VERB 10 -1 "GR1" 0 "KEIN_GANG" 1 "G1" 2 "G2" 3 "G3" 4 "G4" 5 "G5" 6 "G6" 7 "G7" 8 "G8" /end COMPU_VTAB
/begin COMPU_VTAB Conv.cAzsSchluesselStart._.s_start_status_S6_S3 "Umrechnung fuer Messgroesse cAzsSchluesselStart::s_start_status" TAB_VERB 4 0 "Motor AUS" 1 "Schluessel-Start erkannt" 2 "Schluessel-Start aktiv" 3 "Normalbetrieb" /end COMPU_VTAB
/begin COMPU_VTAB Conv.cAzsSZPulsAda._.z_sonder_zustand_puls_ada_S6_S3 "Umrechnung fuer Messgroesse cAzsSZPulsAda::z_sonder_zustand_puls_ada" TAB_VERB 13 0 "SZ_PA_PASSIV" 1 "SZ_PA_WARTEN_EINSTIEG" 2 "SZ_PA_EINSTIEG_GA" 3 "SZ_PA_EINSTIEG_WARTEN_VORGABE" 4 "SZ_PA_AKTIV_GA" 5 "SZ_PA_AKTIV_WARTEN" 6 "SZ_PA_AKTIV_SCHALTEN" 7 "SZ_PA_AKTIV_GE" 8 "SZ_PA_AKTIV_IN_D" 9 "SZ_PA_EXIT_GA" 10 "SZ_PA_EXIT_N1" 11 "SZ_PA_EXIT_WARTEN_POS_ERLAUBT" 12 "SZ_PA_EXIT_POS_UEBERNEHMEN" /end COMPU_VTAB
/begin COMPU_VTAB Conv.cAzsSZPulsAda._.f_neutral_vorgabe_S6_S3 "Umrechnung fuer Messgroesse cAzsSZPulsAda::f_neutral_vorgabe" TAB_VERB 2 0 "NEIN" 1 "JA" /end COMPU_VTAB
/begin COMPU_VTAB Conv.cAzsSZPulsAda._.f_gang_vorgabe_S6_S3 "Umrechnung fuer Messgroesse cAzsSZPulsAda::f_gang_vorgabe" TAB_VERB 2 0 "NEIN" 1 "JA" /end COMPU_VTAB
/begin COMPU_VTAB Conv.cAzsSZPulsAda._.f_abbruch_pre_ada_azs_S6_S3 "Umrechnung fuer Messgroesse cAzsSZPulsAda::f_abbruch_pre_ada_azs" TAB_VERB 2 0 "NEIN" 1 "JA" /end COMPU_VTAB
/begin COMPU_VTAB Conv.cAzsSZPulsAda._.f_sz_puls_ada_aktiv_S6_S3 "Umrechnung fuer Messgroesse cAzsSZPulsAda::f_sz_puls_ada_aktiv" TAB_VERB 2 0 "NEIN" 1 "JA" /end COMPU_VTAB
/begin COMPU_VTAB Conv.cAzsSZPulsAda._.sz_puls_ada_gang_S6_S3 "Umrechnung fuer Messgroesse cAzsSZPulsAda::sz_puls_ada_gang" TAB_VERB 10 -1 "GR1" 0 "KEIN_GANG" 1 "G1" 2 "G2" 3 "G3" 4 "G4" 5 "G5" 6 "G6" 7 "G7" 8 "G8" /end COMPU_VTAB
/begin COMPU_VTAB Conv.cAzsNeutralEbene._.z_neutral_ebene_S6_S3 "Umrechnung fuer Messgroesse cAzsNeutralEbene::z_neutral_ebene" TAB_VERB 15 0 "NE_PASSIV" 1 "NE_ELEMENTE_OFFEN_EINSTIEG" 2 "NE_ELEMENTE_OFFEN_AKTIV" 3 "NE_ELEMENTE_OFFEN_AUSSTIEG" 4 "NE_MINDRUCK_EINSTIEG" 5 "NE_MINDRUCK_AKTIV" 6 "NE_MINDRUCK_AUSSTIEG" 7 "NE_RC_WARTEN_NEUTRAL" 8 "NE_RC_EINSTIEG" 9 "NE_RC_AKTIV" 10 "NE_RC_AUSSTIEG" 11 "NE_RC_NACHLAUF" 12 "NE_REMOTESTART_EINSTIEG" 13 "NE_REMOTESTART_AKTIV" 14 "NE_REMOTESTART_AUSSTIEG" /end COMPU_VTAB
/begin COMPU_VTAB Conv.cAzsNeutralEbene._.fkt_neutral_ebene_S6_S3 "Umrechnung fuer Messgroesse cAzsNeutralEbene::fkt_neutral_ebene" TAB_VERB 9 0 "FKT_NE_PASSIV" 1 "FKT_NE_STROMLOS" 4 "FKT_NE_NEUSTART" 8 "FKT_NE_MINIMALDRUCK" 16 "FKT_NE_MINIMALSTROM" 32 "FKT_NE_SCHLEPPRED" 64 "FKT_NE_S_START" 128 "FKT_POSVUEB" 256 "FKT_NE_REMOTE" /end COMPU_VTAB
/begin COMPU_VTAB Conv.cAzsNeutralEbene._.pos_neutral_n_stern_S6_S3 "Umrechnung fuer Messgroesse cAzsNeutralEbene::pos_neutral_n_stern" TAB_VERB 6 0 "POS_NE_KEINE_ANSTEUERUNG" 1 "POS_NE_KLAUE_GESCHLOSSEN" 2 "POS_NE_ALLE_ELEMENTE_GEOEFFNET" 3 "POS_NE_KLAUE_F_GESCHLOSSEN" 4 "POS_NE_KUP_B_PF" 5 "POS_NE_KUP_A_GESCHLOSSEN" /end COMPU_VTAB
/begin COMPU_VTAB Conv.cAzsKflSoll._.kfl_soll_S6_S3 "Umrechnung fuer Messgroesse cAzsKflSoll::kfl_soll" TAB_VERB 3 0 "KEIN_KFL" 1 "KFL_VORWAERTS" 2 "KFL_RUECKWAERTS" /end COMPU_VTAB
/begin COMPU_VTAB Conv.cAzsKflZiel._.kfl_ziel_S6_S3 "Umrechnung fuer Messgroesse cAzsKflZiel::kfl_ziel" TAB_VERB 3 0 "KEIN_KFL" 1 "KFL_VORWAERTS" 2 "KFL_RUECKWAERTS" /end COMPU_VTAB
/begin COMPU_VTAB Conv.cAzsKflIst._.kfl_ist_S6_S3 "Umrechnung fuer Messgroesse cAzsKflIst::kfl_ist" TAB_VERB 3 0 "KEIN_KFL" 1 "KFL_VORWAERTS" 2 "KFL_RUECKWAERTS" /end COMPU_VTAB
/begin FUNCTION ITF "In SIG_KOORDINATOR sind die Schnittstellenumrechungsfunktionen enthalten"
 /begin LOC_MEASUREMENT defaultgang drehz_anhebung_has f_deakt_dither0 f_deakt_dither1 f_deakt_dither2 f_deakt_dither3 f_deakt_dither4 f_deakt_dither5 f_deakt_dither6 f_deakt_dither7 f_min_emdrehzahl_iae hochtemp_betrieb_sps iItfInput.abs_reg_status iItfInput.ags_zka_index iItfInput.anhaenger_aktiv iItfInput.asc_passiv iItfInput.asc_regelt iItfInput.atsys_ee_busy iItfInput.autohold_aktiv iItfInput.ax_ref iItfInput.ax_ref_status iItfInput.ay_ref iItfInput.ay_ref_status iItfInput.azg_aktiv_stada iItfInput.bls_defakt iItfInput.bls_defpas iItfInput.bls_status iItfInput.bs_timer iItfInput.c_chip iItfInput.c_getr iItfInput.c_getr_fl32 iItfInput.c_getr_status iItfInput.c_getrabst iItfInput.c_mot iItfInput.cdd_u_supply_iep iItfInput.codierung_nic iItfInput.dk_pedal iItfInput.dki iItfInput.dki_fl32 iItfInput.dki_mmotsoll iItfInput.dkig iItfInput.druck_vorhanden_mod iItfInput.edsmv_ersatzinfo iItfInput.el_not_entr iItfInput.eng_red_limit iItfInput.ersf_k0auf iItfInput.f_aufwaerm_erlaubt_iep iItfInput.f_iep_shutdown iItfInput.f_minimaldruck_ausgabe iItfInput.fahr_bereit iItfInput.fahrbetrieb iItfInput.feststellbremse_aktiv iItfInput.fet0_active iItfInput.fl_brake_inter iItfInput.fl_brake_inter_status iItfInput.fl_schubabschaltung_aktiv iItfInput.flag_m_max_has_iae iItfInput.flag_p_hys_k0_has iItfInput.flag_partfilt_aktiv iItfInput.freigabe_posvdiag iItfInput.fzg_anfahrassistent_aktiv iItfInput.fzg_geschwindigkeit iItfInput.fzg_rollverh_aktiv_stat iItfInput.gbx_rdy_to_drv iItfInput.gbx_rdy_to_drv_status iItfInput.getr_betriebszeit iItfInput.has_aktiv iItfInput.hdc iItfInput.hillhold_aktiv iItfInput.hyd_notlauf iItfInput.i_min_ausser_parksperre iItfInput.iae_req_subst iItfInput.iep_soll_abk iItfInput.iep_soll_has iItfInput.iep_soll_sab iItfInput.iep_soll_tes iItfInput.index_sp_sps iItfInput.init_n_abneu_gef iItfInput.init_n_t iItfInput.iv_abs_reg_status iItfInput.iv_ags_zka_index iItfInput.iv_anhaengeraktiv iItfInput.iv_ascpas iItfInput.iv_ascreg iItfInput.iv_atsys_ee_busy iItfInput.iv_ax_ref iItfInput.iv_ax_ref_status iItfInput.iv_ay_ref iItfInput.iv_ay_ref_status iItfInput.iv_blsdefakt iItfInput.iv_blsdefpas iItfInput.iv_blsstatus iItfInput.iv_bstimer iItfInput.iv_cchip iItfInput.iv_cdd_u_supply_iep iItfInput.iv_cgetr iItfInput.iv_cgetrstatus iItfInput.iv_cmot iItfInput.iv_codierungnic iItfInput.iv_dki iItfInput.iv_dkpedal iItfInput.iv_druck_vorhanden_mod iItfInput.iv_edsmversatzinfo iItfInput.iv_el_not_entr iItfInput.iv_eng_red_limit iItfInput.iv_f_aufwaerm_erlaubt_iep iItfInput.iv_f_iep_shutdown iItfInput.iv_fahr_bereit iItfInput.iv_fahrbet_task iItfInput.iv_feststellbremseaktiv iItfInput.iv_fet0_active iItfInput.iv_fl_brake_inter iItfInput.iv_fl_brake_inter_status iItfInput.iv_fl_schubabschaltung_aktiv iItfInput.iv_flag_m_max_has_iae iItfInput.iv_flag_p_hys_k0_has iItfInput.iv_flag_partfilt_aktiv iItfInput.iv_freigabe_posvdiag iItfInput.iv_fzg_anfahrassistent_aktiv iItfInput.iv_fzg_rollverh_aktiv_stat iItfInput.iv_fzggeschwindigkeit iItfInput.iv_gbx_rdy_to_drv iItfInput.iv_gbx_rdy_to_drv_status iItfInput.iv_getrbetriebszeit iItfInput.iv_gnotinfo iItfInput.iv_gsoll iItfInput.iv_has_aktiv iItfInput.iv_hdc iItfInput.iv_iae_req_subst iItfInput.iv_iep_soll_abk iItfInput.iv_iep_soll_has iItfInput.iv_iep_soll_sab iItfInput.iv_iep_soll_tes iItfInput.iv_indexspsps iItfInput.iv_k0_req_schlupf_rel iItfInput.iv_k0_soll iItfInput.iv_km_stand_aus_nab iItfInput.iv_ldm iItfInput.iv_ldm_status iItfInput.iv_ll_mot_aktiv iItfInput.iv_ll_mot_aktiv_status iItfInput.iv_m_emist iItfInput.iv_m_emsoll iItfInput.iv_m_max_dyn_em iItfInput.iv_m_max_has_iae iItfInput.iv_m_min_dyn_em iItfInput.iv_m_motsoll_mod iItfInput.iv_m_motsoll_mod_status iItfInput.iv_m_soll_k0_has iItfInput.iv_m_vmist iItfInput.iv_m_vmsoll iItfInput.iv_mg_soll_k0_neg_has iItfInput.iv_mg_soll_k0_pos_has iItfInput.iv_mmot iItfInput.iv_mmotist iItfInput.iv_mmotsoll_in iItfInput.iv_mmotstatus iItfInput.iv_modus_em iItfInput.iv_mvg_vm_start iItfInput.iv_n6 iItfInput.iv_n_ab_dir iItfInput.iv_n_ab_dir_status iItfInput.iv_n_dif_iae_virt iItfInput.iv_n_mot_llsoll_has iItfInput.iv_n_t_dir iItfInput.iv_n_t_dir_status iItfInput.iv_n_vm iItfInput.iv_n_vm_status iItfInput.iv_nab_ausvra iItfInput.iv_nabneu iItfInput.iv_nabstatus iItfInput.iv_ndiaeneu iItfInput.iv_neigung iItfInput.iv_neigungstatus iItfInput.iv_nmot iItfInput.iv_nmotabregel iItfInput.iv_nmotsolleer iItfInput.iv_nmotstatus iItfInput.iv_notltask iItfInput.iv_ntneu iItfInput.iv_ntstatus iItfInput.iv_ntu_virt iItfInput.iv_ntu_virt_dir iItfInput.iv_ntu_virt_dir_status iItfInput.iv_p_air iItfInput.iv_p_bremse_halbe iItfInput.iv_pbremse iItfInput.iv_pos iItfInput.iv_posstatus iItfInput.iv_preadaption_start iItfInput.iv_progauswahl iItfInput.iv_pssensorsignal iItfInput.iv_pssensorsignal_status iItfInput.iv_pt_damping_active iItfInput.iv_pumpenstatus_iep iItfInput.iv_rad_geschw_hinten_links iItfInput.iv_rad_geschw_hinten_rechts iItfInput.iv_rad_geschw_vorne_links iItfInput.iv_rad_geschw_vorne_rechts iItfInput.iv_saf_has_aktiv iItfInput.iv_sbytask iItfInput.iv_schluesselstart_aktiv iItfInput.iv_statistics_ee_busy iItfInput.iv_status_has iItfInput.iv_status_n_haltephase iItfInput.iv_svh_aktiv_has iItfInput.iv_timeegsoff iItfInput.iv_timeegsoff_status iItfInput.iv_transportmode_aktiv iItfInput.iv_udrmv iItfInput.iv_usensor1_estatus iItfInput.iv_verbot_sas_fkt iItfInput.iv_z_k0_befuellopt iItfInput.iv_z_k0_soll_subst iItfInput.iv_z_modus_iae iItfInput.iv_zzuendung iItfInput.k0_diag_moeglich iItfInput.k0_req_schlupf_rel iItfInput.k0_soll iItfInput.km_stand_aus_nab iItfInput.ldm iItfInput.ldm_status iItfInput.ll_mot_aktiv iItfInput.ll_mot_aktiv_status iItfInput.m_emist iItfInput.m_emsoll iItfInput.m_max_dyn_em iItfInput.m_max_has_iae iItfInput.m_min_dyn_em iItfInput.m_mot iItfInput.m_mot_faktor10 iItfInput.m_mot_fl32 iItfInput.m_mot_status iItfInput.m_motist iItfInput.m_motist_faktor10 iItfInput.m_motkor iItfInput.m_motkor_in iItfInput.m_motsoll iItfInput.m_motsoll_faktor10 iItfInput.m_motsoll_in iItfInput.m_motsoll_mod iItfInput.m_motsoll_mod_status iItfInput.m_soll_k0_has iItfInput.m_t iItfInput.m_t8 iItfInput.m_vmist iItfInput.m_vmsoll iItfInput.manuell iItfInput.max_p_haupt iItfInput.mg_soll_k0_neg_has iItfInput.mg_soll_k0_pos_has iItfInput.modus_em iItfInput.mvg_vm_start iItfInput.n6 iItfInput.n_ab iItfInput.n_ab8 iItfInput.n_ab_dir iItfInput.n_ab_dir_status iItfInput.n_ab_status iItfInput.n_abneu iItfInput.n_abneu_int16 iItfInput.n_dif_iae_virt iItfInput.n_mot iItfInput.n_mot8 iItfInput.n_mot_int16 iItfInput.n_mot_llsoll_has iItfInput.n_mot_solleer iItfInput.n_mot_status iItfInput.n_motabregel iItfInput.n_t iItfInput.n_t8 iItfInput.n_t_dir iItfInput.n_t_dir_status iItfInput.n_t_status iItfInput.n_tneu iItfInput.n_tneu_int16 iItfInput.n_vm iItfInput.n_vm_status iItfInput.nab_ausvra iItfInput.nd_iaeneu iItfInput.neigung iItfInput.neigung_gef iItfInput.neigung_si8 iItfInput.neigung_status iItfInput.ng_ab iItfInput.ng_mot iItfInput.ng_t iItfInput.notgang iItfInput.notgang_info iItfInput.notlauf iItfInput.ntu_virt iItfInput.ntu_virt_dir iItfInput.ntu_virt_dir_status iItfInput.nue iItfInput.nueg iItfInput.nullbestromung_aktiv iItfInput.p_air iItfInput.p_bremse iItfInput.p_bremse_halbe iItfInput.pos iItfInput.pos_status iItfInput.pos_wunsch iItfInput.preadaption_start iItfInput.prog_auswahl iItfInput.ps_sensor_signal iItfInput.pssensorsignal_status iItfInput.pt_damping_active iItfInput.pumpendruck_nicht_vorhanden iItfInput.pumpendruck_vorhanden iItfInput.pumpenstatus_iep iItfInput.rad_geschw_hinten_links iItfInput.rad_geschw_hinten_rechts iItfInput.rad_geschw_vorne_links iItfInput.rad_geschw_vorne_rechts iItfInput.saf_has_aktiv iItfInput.schluesselstart_aktiv iItfInput.sfkt_starten_azg iItfInput.sollgang iItfInput.standby iItfInput.statistics_ee_busy iItfInput.status_has iItfInput.status_n_haltephase iItfInput.stromlos_ausser_ps iItfInput.stromlos_ausser_ps_und_i_min iItfInput.stromlos_ges iItfInput.stromlos_ps iItfInput.svh_aktiv_has iItfInput.timeegsoff iItfInput.timeegsoff_status iItfInput.transportmode_aktiv iItfInput.u_drmv iItfInput.usensor1_estatus iItfInput.verbot_sas_fkt iItfInput.z_k0_befuellopt iItfInput.z_k0_soll_subst iItfInput.z_modus_iae iItfInput.z_zuendung iItfInput.zug_schub iItfInputParaumsch.f_e_fahren_aktiv iItfInputParaumsch.iv_f_e_fahren_aktiv iItfInputParaumsch.iv_seraprsas iItfInputParaumsch.iv_seraprsas_komp iItfInputParaumsch.serap_rsas iItfInputParaumsch.serap_rsas_komp i_eds0 i_eds0_komp i_eds1 i_eds10 i_eds10_komp i_eds11 i_eds11_komp i_eds1_komp i_eds2 i_eds2_komp i_eds3 i_eds3_komp i_eds4 i_eds4_komp i_eds5 i_eds5_komp i_eds6 i_eds6_komp i_eds7 i_eds7_komp i_eds8 i_eds8_komp i_eds9 i_eds9_komp i_eds_k0 i_eds_kupa i_eds_kupb i_eds_kupc i_eds_kupd i_eds_kupe i_eds_psys kraftschluss m_hotmodemax m_motmax max_kuehlung_anfordern me_komp me_red_abs me_red_abs_luft me_red_abs_pos_vor me_red_abs_pos_vor_rel me_red_abs_pos_vor_status me_red_status me_rel me_rel_komp me_rel_luft me_status_komp mv_1 mv_2 mv_3 reihenschaltung_moeglich sbc_info sollgang_pruefung z_mmotmax z_n_mot_llsoll_iae /end LOC_MEASUREMENT
/end FUNCTION
/begin FUNCTION AZS "Das Paket AZS enthält alle Klassen und Funktionalitäten, welche für die zentrale Zustandssteuerung notwendig sind."
 /begin SUB_FUNCTION AZS_GLOBAL AZS_SONDER_ANSTEUERUNG AZS_KFL_WECHSEL AZS_SCHALTUNG AZS_UEBERWACHUNG /end SUB_FUNCTION
/end FUNCTION
/begin FUNCTION AZS_GLOBAL "die globalen Klassen beinhalten zentrale Größen der AZS und die Verwaltung der Betriebssystem-Aufrufe"
 /begin LOC_MEASUREMENT iAzsKorgl.f_abbruch_schaltung_durch_ga iAzsKorgl.f_kfl_direkt iAzsKorgl.f_notgang_gesetzt iAzsKorgl.f_schaltung_direkt iAzsKorgl.f_stromlos_zzs iAzsKorgl.istgang_abbruch_schaltung_durch_ga iAzsKorgl.parksperre_ziel iAzsKorgl.pos_red iAzsUeFunktionen.ue_fkt_abschalten iAzsUeFunktionen.ue_fkt_aufgerufen /end LOC_MEASUREMENT
/end FUNCTION
/begin FUNCTION AZS_SONDER_ANSTEUERUNG "Sonderansteuerungen gibt es für den Schlüsselstart sowie für die Pulsadaption im Stillstand -Werkstatt-"
 /begin LOC_MEASUREMENT iAzsNeutralEbene.TimerNE.time iAzsNeutralEbene.fkt_neutral_ebene iAzsNeutralEbene.pos_neutral_n_stern iAzsNeutralEbene.z_neutral_ebene iAzsSZPulsAda.TimerMaxTime.time iAzsSZPulsAda.TimerSZPulsAda.time iAzsSZPulsAda.f_abbruch_pre_ada_azs iAzsSZPulsAda.f_gang_vorgabe iAzsSZPulsAda.f_neutral_vorgabe iAzsSZPulsAda.f_sz_puls_ada_aktiv iAzsSZPulsAda.sz_puls_ada_gang iAzsSZPulsAda.z_sonder_zustand_puls_ada iAzsSchluesselStart.s_start_status /end LOC_MEASUREMENT
/end FUNCTION
/begin FUNCTION AZS_KFL_WECHSEL "beinhaltet die verschiedenen Klassen und Kfl-Groessen, die an einem Kraftfluss-Wechsel beteiligt sind"
 /begin LOC_MEASUREMENT iAzsKflIst.kfl_ist iAzsKflSoll.kfl_soll iAzsKflZiel.kfl_ziel /end LOC_MEASUREMENT
/end FUNCTION
/end MODULE
/end PROJECT
