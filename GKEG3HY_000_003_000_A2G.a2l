ASAP2_VERSION 1 51
/begin PROJECT _929_929 "Gen2_BMW_System_Supplier_Lib"
/begin HEADER "" VERSION "C_03_03" PROJECT_NO _929_929 /end HEADER
/begin MODULE DIM ""
/begin MOD_COMMON "" BYTE_ORDER MSB_FIRST ALIGNMENT_BYTE 1 ALIGNMENT_WORD 2 ALIGNMENT_LONG 4 ALIGNMENT_FLOAT32_IEEE 4 /end MOD_COMMON
/begin MEASUREMENT ZFEH_EepromData.ydiMemory_xau16[0].amb_cond.ambient_condition[0][0] "ambient condition shot [0 .. 2-1] with 25 data bytes [0 .. 25-1] for the error code stored in this error memory slot" UBYTE EH_STANDARD_S5_S3 1 100 0 255 DISPLAY_IDENTIFIER ambient_condition[0][0].amb_cond.ydiMemory_xau16[0].ZFEH_EepromData ECU_ADDRESS 0xFFF82820 /end MEASUREMENT
/begin MEASUREMENT ZFEH_EepromData.ydiMemory_xau16[0].amb_cond.ambient_condition[0][1] "ambient condition shot [0 .. 2-1] with 25 data bytes [0 .. 25-1] for the error code stored in this error memory slot" UBYTE EH_STANDARD_S5_S3 1 100 0 255 DISPLAY_IDENTIFIER ambient_condition[0][1].amb_cond.ydiMemory_xau16[0].ZFEH_EepromData ECU_ADDRESS 0xFFF82821 /end MEASUREMENT
/begin MEASUREMENT ZFEH_EepromData.ydiMemory_xau16[0].amb_cond.ambient_condition[0][2] "ambient condition shot [0 .. 2-1] with 25 data bytes [0 .. 25-1] for the error code stored in this error memory slot" UBYTE EH_STANDARD_S5_S3 1 100 0 255 DISPLAY_IDENTIFIER ambient_condition[0][2].amb_cond.ydiMemory_xau16[0].ZFEH_EepromData ECU_ADDRESS 0xFFF82822 /end MEASUREMENT
/begin MEASUREMENT ZFEH_EepromData.ydiMemory_xau16[0].amb_cond.ambient_condition[0][3] "ambient condition shot [0 .. 2-1] with 25 data bytes [0 .. 25-1] for the error code stored in this error memory slot" UBYTE EH_STANDARD_S5_S3 1 100 0 255 DISPLAY_IDENTIFIER ambient_condition[0][3].amb_cond.ydiMemory_xau16[0].ZFEH_EepromData ECU_ADDRESS 0xFFF82823 /end MEASUREMENT
/begin MEASUREMENT ZFEH_EepromData.ydiMemory_xau16[0].amb_cond.ambient_condition[0][4] "ambient condition shot [0 .. 2-1] with 25 data bytes [0 .. 25-1] for the error code stored in this error memory slot" UBYTE EH_STANDARD_S5_S3 1 100 0 255 DISPLAY_IDENTIFIER ambient_condition[0][4].amb_cond.ydiMemory_xau16[0].ZFEH_EepromData ECU_ADDRESS 0xFFF82824 /end MEASUREMENT
/begin MEASUREMENT ZFEH_EepromData.ydiMemory_xau16[0].amb_cond.ambient_condition[0][5] "ambient condition shot [0 .. 2-1] with 25 data bytes [0 .. 25-1] for the error code stored in this error memory slot" UBYTE EH_STANDARD_S5_S3 1 100 0 255 DISPLAY_IDENTIFIER ambient_condition[0][5].amb_cond.ydiMemory_xau16[0].ZFEH_EepromData ECU_ADDRESS 0xFFF82825 /end MEASUREMENT
/begin MEASUREMENT ZFEH_EepromData.ydiMemory_xau16[0].amb_cond.ambient_condition[0][6] "ambient condition shot [0 .. 2-1] with 25 data bytes [0 .. 25-1] for the error code stored in this error memory slot" UBYTE EH_STANDARD_S5_S3 1 100 0 255 DISPLAY_IDENTIFIER ambient_condition[0][6].amb_cond.ydiMemory_xau16[0].ZFEH_EepromData ECU_ADDRESS 0xFFF82826 /end MEASUREMENT
/begin MEASUREMENT ZFEH_EepromData.ydiMemory_xau16[0].amb_cond.ambient_condition[0][7] "ambient condition shot [0 .. 2-1] with 25 data bytes [0 .. 25-1] for the error code stored in this error memory slot" UBYTE EH_STANDARD_S5_S3 1 100 0 255 DISPLAY_IDENTIFIER ambient_condition[0][7].amb_cond.ydiMemory_xau16[0].ZFEH_EepromData ECU_ADDRESS 0xFFF82827 /end MEASUREMENT
/begin MEASUREMENT ZFEH_EepromData.ydiMemory_xau16[0].amb_cond.ambient_condition[0][8] "ambient condition shot [0 .. 2-1] with 25 data bytes [0 .. 25-1] for the error code stored in this error memory slot" UBYTE EH_STANDARD_S5_S3 1 100 0 255 DISPLAY_IDENTIFIER ambient_condition[0][8].amb_cond.ydiMemory_xau16[0].ZFEH_EepromData ECU_ADDRESS 0xFFF82828 /end MEASUREMENT
/begin MEASUREMENT ZFEH_EepromData.ydiMemory_xau16[0].amb_cond.ambient_condition[0][9] "ambient condition shot [0 .. 2-1] with 25 data bytes [0 .. 25-1] for the error code stored in this error memory slot" UBYTE EH_STANDARD_S5_S3 1 100 0 255 DISPLAY_IDENTIFIER ambient_condition[0][9].amb_cond.ydiMemory_xau16[0].ZFEH_EepromData ECU_ADDRESS 0xFFF82829 /end MEASUREMENT
/begin MEASUREMENT ZFEH_EepromData.ydiMemory_xau16[0].amb_cond.ambient_condition[0][10] "ambient condition shot [0 .. 2-1] with 25 data bytes [0 .. 25-1] for the error code stored in this error memory slot" UBYTE EH_STANDARD_S5_S3 1 100 0 255 DISPLAY_IDENTIFIER ambient_condition[0][10].amb_cond.ydiMemory_xau16[0].ZFEH_EepromData ECU_ADDRESS 0xFFF8282A /end MEASUREMENT
/begin MEASUREMENT ZFEH_EepromData.ydiMemory_xau16[0].amb_cond.ambient_condition[0][11] "ambient condition shot [0 .. 2-1] with 25 data bytes [0 .. 25-1] for the error code stored in this error memory slot" UBYTE EH_STANDARD_S5_S3 1 100 0 255 DISPLAY_IDENTIFIER ambient_condition[0][11].amb_cond.ydiMemory_xau16[0].ZFEH_EepromData ECU_ADDRESS 0xFFF8282B /end MEASUREMENT
/begin MEASUREMENT ZFEH_EepromData.ydiMemory_xau16[0].amb_cond.ambient_condition[0][12] "ambient condition shot [0 .. 2-1] with 25 data bytes [0 .. 25-1] for the error code stored in this error memory slot" UBYTE EH_STANDARD_S5_S3 1 100 0 255 DISPLAY_IDENTIFIER ambient_condition[0][12].amb_cond.ydiMemory_xau16[0].ZFEH_EepromData ECU_ADDRESS 0xFFF8282C /end MEASUREMENT
/begin MEASUREMENT ZFEH_EepromData.ydiMemory_xau16[0].amb_cond.ambient_condition[0][13] "ambient condition shot [0 .. 2-1] with 25 data bytes [0 .. 25-1] for the error code stored in this error memory slot" UBYTE EH_STANDARD_S5_S3 1 100 0 255 DISPLAY_IDENTIFIER ambient_condition[0][13].amb_cond.ydiMemory_xau16[0].ZFEH_EepromData ECU_ADDRESS 0xFFF8282D /end MEASUREMENT
/begin MEASUREMENT ZFEH_EepromData.ydiMemory_xau16[0].amb_cond.ambient_condition[0][14] "ambient condition shot [0 .. 2-1] with 25 data bytes [0 .. 25-1] for the error code stored in this error memory slot" UBYTE EH_STANDARD_S5_S3 1 100 0 255 DISPLAY_IDENTIFIER ambient_condition[0][14].amb_cond.ydiMemory_xau16[0].ZFEH_EepromData ECU_ADDRESS 0xFFF8282E /end MEASUREMENT
/begin MEASUREMENT ZFEH_EepromData.ydiMemory_xau16[0].amb_cond.ambient_condition[0][15] "ambient condition shot [0 .. 2-1] with 25 data bytes [0 .. 25-1] for the error code stored in this error memory slot" UBYTE EH_STANDARD_S5_S3 1 100 0 255 DISPLAY_IDENTIFIER ambient_condition[0][15].amb_cond.ydiMemory_xau16[0].ZFEH_EepromData ECU_ADDRESS 0xFFF8282F /end MEASUREMENT
/begin MEASUREMENT ZFEH_EepromData.ydiMemory_xau16[0].amb_cond.ambient_condition[0][16] "ambient condition shot [0 .. 2-1] with 25 data bytes [0 .. 25-1] for the error code stored in this error memory slot" UBYTE EH_STANDARD_S5_S3 1 100 0 255 DISPLAY_IDENTIFIER ambient_condition[0][16].amb_cond.ydiMemory_xau16[0].ZFEH_EepromData ECU_ADDRESS 0xFFF82830 /end MEASUREMENT
/begin MEASUREMENT ZFEH_EepromData.ydiMemory_xau16[0].amb_cond.ambient_condition[0][17] "ambient condition shot [0 .. 2-1] with 25 data bytes [0 .. 25-1] for the error code stored in this error memory slot" UBYTE EH_STANDARD_S5_S3 1 100 0 255 DISPLAY_IDENTIFIER ambient_condition[0][17].amb_cond.ydiMemory_xau16[0].ZFEH_EepromData ECU_ADDRESS 0xFFF82831 /end MEASUREMENT
/begin MEASUREMENT ZFEH_EepromData.ydiMemory_xau16[0].amb_cond.ambient_condition[0][18] "ambient condition shot [0 .. 2-1] with 25 data bytes [0 .. 25-1] for the error code stored in this error memory slot" UBYTE EH_STANDARD_S5_S3 1 100 0 255 DISPLAY_IDENTIFIER ambient_condition[0][18].amb_cond.ydiMemory_xau16[0].ZFEH_EepromData ECU_ADDRESS 0xFFF82832 /end MEASUREMENT
/begin MEASUREMENT ZFEH_EepromData.ydiMemory_xau16[0].amb_cond.ambient_condition[0][19] "ambient condition shot [0 .. 2-1] with 25 data bytes [0 .. 25-1] for the error code stored in this error memory slot" UBYTE EH_STANDARD_S5_S3 1 100 0 255 DISPLAY_IDENTIFIER ambient_condition[0][19].amb_cond.ydiMemory_xau16[0].ZFEH_EepromData ECU_ADDRESS 0xFFF82833 /end MEASUREMENT
/begin MEASUREMENT ZFEH_EepromData.ydiMemory_xau16[0].amb_cond.ambient_condition[0][20] "ambient condition shot [0 .. 2-1] with 25 data bytes [0 .. 25-1] for the error code stored in this error memory slot" UBYTE EH_STANDARD_S5_S3 1 100 0 255 DISPLAY_IDENTIFIER ambient_condition[0][20].amb_cond.ydiMemory_xau16[0].ZFEH_EepromData ECU_ADDRESS 0xFFF82834 /end MEASUREMENT
/begin MEASUREMENT ZFEH_EepromData.ydiMemory_xau16[0].amb_cond.ambient_condition[0][21] "ambient condition shot [0 .. 2-1] with 25 data bytes [0 .. 25-1] for the error code stored in this error memory slot" UBYTE EH_STANDARD_S5_S3 1 100 0 255 DISPLAY_IDENTIFIER ambient_condition[0][21].amb_cond.ydiMemory_xau16[0].ZFEH_EepromData ECU_ADDRESS 0xFFF82835 /end MEASUREMENT
/begin MEASUREMENT ZFEH_EepromData.ydiMemory_xau16[0].amb_cond.ambient_condition[0][22] "ambient condition shot [0 .. 2-1] with 25 data bytes [0 .. 25-1] for the error code stored in this error memory slot" UBYTE EH_STANDARD_S5_S3 1 100 0 255 DISPLAY_IDENTIFIER ambient_condition[0][22].amb_cond.ydiMemory_xau16[0].ZFEH_EepromData ECU_ADDRESS 0xFFF82836 /end MEASUREMENT
/begin MEASUREMENT ZFEH_EepromData.ydiMemory_xau16[0].amb_cond.ambient_condition[0][23] "ambient condition shot [0 .. 2-1] with 25 data bytes [0 .. 25-1] for the error code stored in this error memory slot" UBYTE EH_STANDARD_S5_S3 1 100 0 255 DISPLAY_IDENTIFIER ambient_condition[0][23].amb_cond.ydiMemory_xau16[0].ZFEH_EepromData ECU_ADDRESS 0xFFF82837 /end MEASUREMENT
/begin MEASUREMENT ZFEH_EepromData.ydiMemory_xau16[0].amb_cond.ambient_condition[0][24] "ambient condition shot [0 .. 2-1] with 25 data bytes [0 .. 25-1] for the error code stored in this error memory slot" UBYTE EH_STANDARD_S5_S3 1 100 0 255 DISPLAY_IDENTIFIER ambient_condition[0][24].amb_cond.ydiMemory_xau16[0].ZFEH_EepromData ECU_ADDRESS 0xFFF82838 /end MEASUREMENT
/begin MEASUREMENT ZFEH_EepromData.ydiMemory_xau16[0].amb_cond.ambient_condition[1][0] "ambient condition shot [0 .. 2-1] with 25 data bytes [0 .. 25-1] for the error code stored in this error memory slot" UBYTE EH_STANDARD_S5_S3 1 100 0 255 DISPLAY_IDENTIFIER ambient_condition[1][0].amb_cond.ydiMemory_xau16[0].ZFEH_EepromData ECU_ADDRESS 0xFFF82839 /end MEASUREMENT
/begin MEASUREMENT ZFEH_EepromData.ydiMemory_xau16[0].amb_cond.ambient_condition[1][1] "ambient condition shot [0 .. 2-1] with 25 data bytes [0 .. 25-1] for the error code stored in this error memory slot" UBYTE EH_STANDARD_S5_S3 1 100 0 255 DISPLAY_IDENTIFIER ambient_condition[1][1].amb_cond.ydiMemory_xau16[0].ZFEH_EepromData ECU_ADDRESS 0xFFF8283A /end MEASUREMENT
/begin MEASUREMENT ZFEH_EepromData.ydiMemory_xau16[0].amb_cond.ambient_condition[1][2] "ambient condition shot [0 .. 2-1] with 25 data bytes [0 .. 25-1] for the error code stored in this error memory slot" UBYTE EH_STANDARD_S5_S3 1 100 0 255 DISPLAY_IDENTIFIER ambient_condition[1][2].amb_cond.ydiMemory_xau16[0].ZFEH_EepromData ECU_ADDRESS 0xFFF8283B /end MEASUREMENT
/begin MEASUREMENT ZFEH_EepromData.ydiMemory_xau16[0].amb_cond.ambient_condition[1][3] "ambient condition shot [0 .. 2-1] with 25 data bytes [0 .. 25-1] for the error code stored in this error memory slot" UBYTE EH_STANDARD_S5_S3 1 100 0 255 DISPLAY_IDENTIFIER ambient_condition[1][3].amb_cond.ydiMemory_xau16[0].ZFEH_EepromData ECU_ADDRESS 0xFFF8283C /end MEASUREMENT
/begin MEASUREMENT ZFEH_EepromData.ydiMemory_xau16[0].amb_cond.ambient_condition[1][4] "ambient condition shot [0 .. 2-1] with 25 data bytes [0 .. 25-1] for the error code stored in this error memory slot" UBYTE EH_STANDARD_S5_S3 1 100 0 255 DISPLAY_IDENTIFIER ambient_condition[1][4].amb_cond.ydiMemory_xau16[0].ZFEH_EepromData ECU_ADDRESS 0xFFF8283D /end MEASUREMENT
/begin MEASUREMENT ZFEH_EepromData.ydiMemory_xau16[0].amb_cond.ambient_condition[1][5] "ambient condition shot [0 .. 2-1] with 25 data bytes [0 .. 25-1] for the error code stored in this error memory slot" UBYTE EH_STANDARD_S5_S3 1 100 0 255 DISPLAY_IDENTIFIER ambient_condition[1][5].amb_cond.ydiMemory_xau16[0].ZFEH_EepromData ECU_ADDRESS 0xFFF8283E /end MEASUREMENT
/begin MEASUREMENT ZFEH_EepromData.ydiMemory_xau16[0].amb_cond.ambient_condition[1][6] "ambient condition shot [0 .. 2-1] with 25 data bytes [0 .. 25-1] for the error code stored in this error memory slot" UBYTE EH_STANDARD_S5_S3 1 100 0 255 DISPLAY_IDENTIFIER ambient_condition[1][6].amb_cond.ydiMemory_xau16[0].ZFEH_EepromData ECU_ADDRESS 0xFFF8283F /end MEASUREMENT
/begin MEASUREMENT ZFEH_EepromData.ydiMemory_xau16[0].amb_cond.ambient_condition[1][7] "ambient condition shot [0 .. 2-1] with 25 data bytes [0 .. 25-1] for the error code stored in this error memory slot" UBYTE EH_STANDARD_S5_S3 1 100 0 255 DISPLAY_IDENTIFIER ambient_condition[1][7].amb_cond.ydiMemory_xau16[0].ZFEH_EepromData ECU_ADDRESS 0xFFF82840 /end MEASUREMENT
/begin MEASUREMENT ZFEH_EepromData.ydiMemory_xau16[0].amb_cond.ambient_condition[1][8] "ambient condition shot [0 .. 2-1] with 25 data bytes [0 .. 25-1] for the error code stored in this error memory slot" UBYTE EH_STANDARD_S5_S3 1 100 0 255 DISPLAY_IDENTIFIER ambient_condition[1][8].amb_cond.ydiMemory_xau16[0].ZFEH_EepromData ECU_ADDRESS 0xFFF82841 /end MEASUREMENT
/begin MEASUREMENT ZFEH_EepromData.ydiMemory_xau16[0].amb_cond.ambient_condition[1][9] "ambient condition shot [0 .. 2-1] with 25 data bytes [0 .. 25-1] for the error code stored in this error memory slot" UBYTE EH_STANDARD_S5_S3 1 100 0 255 DISPLAY_IDENTIFIER ambient_condition[1][9].amb_cond.ydiMemory_xau16[0].ZFEH_EepromData ECU_ADDRESS 0xFFF82842 /end MEASUREMENT
/begin MEASUREMENT ZFEH_EepromData.ydiMemory_xau16[0].amb_cond.ambient_condition[1][10] "ambient condition shot [0 .. 2-1] with 25 data bytes [0 .. 25-1] for the error code stored in this error memory slot" UBYTE EH_STANDARD_S5_S3 1 100 0 255 DISPLAY_IDENTIFIER ambient_condition[1][10].amb_cond.ydiMemory_xau16[0].ZFEH_EepromData ECU_ADDRESS 0xFFF82843 /end MEASUREMENT
/begin MEASUREMENT ZFEH_EepromData.ydiMemory_xau16[0].amb_cond.ambient_condition[1][11] "ambient condition shot [0 .. 2-1] with 25 data bytes [0 .. 25-1] for the error code stored in this error memory slot" UBYTE EH_STANDARD_S5_S3 1 100 0 255 DISPLAY_IDENTIFIER ambient_condition[1][11].amb_cond.ydiMemory_xau16[0].ZFEH_EepromData ECU_ADDRESS 0xFFF82844 /end MEASUREMENT
/begin MEASUREMENT ZFEH_EepromData.ydiMemory_xau16[0].amb_cond.ambient_condition[1][12] "ambient condition shot [0 .. 2-1] with 25 data bytes [0 .. 25-1] for the error code stored in this error memory slot" UBYTE EH_STANDARD_S5_S3 1 100 0 255 DISPLAY_IDENTIFIER ambient_condition[1][12].amb_cond.ydiMemory_xau16[0].ZFEH_EepromData ECU_ADDRESS 0xFFF82845 /end MEASUREMENT
/begin MEASUREMENT ZFEH_EepromData.ydiMemory_xau16[0].amb_cond.ambient_condition[1][13] "ambient condition shot [0 .. 2-1] with 25 data bytes [0 .. 25-1] for the error code stored in this error memory slot" UBYTE EH_STANDARD_S5_S3 1 100 0 255 DISPLAY_IDENTIFIER ambient_condition[1][13].amb_cond.ydiMemory_xau16[0].ZFEH_EepromData ECU_ADDRESS 0xFFF82846 /end MEASUREMENT
/begin MEASUREMENT ZFEH_EepromData.ydiMemory_xau16[0].amb_cond.ambient_condition[1][14] "ambient condition shot [0 .. 2-1] with 25 data bytes [0 .. 25-1] for the error code stored in this error memory slot" UBYTE EH_STANDARD_S5_S3 1 100 0 255 DISPLAY_IDENTIFIER ambient_condition[1][14].amb_cond.ydiMemory_xau16[0].ZFEH_EepromData ECU_ADDRESS 0xFFF82847 /end MEASUREMENT
/begin MEASUREMENT ZFEH_EepromData.ydiMemory_xau16[0].amb_cond.ambient_condition[1][15] "ambient condition shot [0 .. 2-1] with 25 data bytes [0 .. 25-1] for the error code stored in this error memory slot" UBYTE EH_STANDARD_S5_S3 1 100 0 255 DISPLAY_IDENTIFIER ambient_condition[1][15].amb_cond.ydiMemory_xau16[0].ZFEH_EepromData ECU_ADDRESS 0xFFF82848 /end MEASUREMENT
/begin MEASUREMENT ZFEH_EepromData.ydiMemory_xau16[0].amb_cond.ambient_condition[1][16] "ambient condition shot [0 .. 2-1] with 25 data bytes [0 .. 25-1] for the error code stored in this error memory slot" UBYTE EH_STANDARD_S5_S3 1 100 0 255 DISPLAY_IDENTIFIER ambient_condition[1][16].amb_cond.ydiMemory_xau16[0].ZFEH_EepromData ECU_ADDRESS 0xFFF82849 /end MEASUREMENT
/begin MEASUREMENT ZFEH_EepromData.ydiMemory_xau16[0].amb_cond.ambient_condition[1][17] "ambient condition shot [0 .. 2-1] with 25 data bytes [0 .. 25-1] for the error code stored in this error memory slot" UBYTE EH_STANDARD_S5_S3 1 100 0 255 DISPLAY_IDENTIFIER ambient_condition[1][17].amb_cond.ydiMemory_xau16[0].ZFEH_EepromData ECU_ADDRESS 0xFFF8284A /end MEASUREMENT
/begin MEASUREMENT ZFEH_EepromData.ydiMemory_xau16[0].amb_cond.ambient_condition[1][18] "ambient condition shot [0 .. 2-1] with 25 data bytes [0 .. 25-1] for the error code stored in this error memory slot" UBYTE EH_STANDARD_S5_S3 1 100 0 255 DISPLAY_IDENTIFIER ambient_condition[1][18].amb_cond.ydiMemory_xau16[0].ZFEH_EepromData ECU_ADDRESS 0xFFF8284B /end MEASUREMENT
/begin MEASUREMENT ZFEH_EepromData.ydiMemory_xau16[0].amb_cond.ambient_condition[1][19] "ambient condition shot [0 .. 2-1] with 25 data bytes [0 .. 25-1] for the error code stored in this error memory slot" UBYTE EH_STANDARD_S5_S3 1 100 0 255 DISPLAY_IDENTIFIER ambient_condition[1][19].amb_cond.ydiMemory_xau16[0].ZFEH_EepromData ECU_ADDRESS 0xFFF8284C /end MEASUREMENT
/begin MEASUREMENT ZFEH_EepromData.ydiMemory_xau16[0].amb_cond.ambient_condition[1][20] "ambient condition shot [0 .. 2-1] with 25 data bytes [0 .. 25-1] for the error code stored in this error memory slot" UBYTE EH_STANDARD_S5_S3 1 100 0 255 DISPLAY_IDENTIFIER ambient_condition[1][20].amb_cond.ydiMemory_xau16[0].ZFEH_EepromData ECU_ADDRESS 0xFFF8284D /end MEASUREMENT
/begin MEASUREMENT ZFEH_EepromData.ydiMemory_xau16[0].amb_cond.ambient_condition[1][21] "ambient condition shot [0 .. 2-1] with 25 data bytes [0 .. 25-1] for the error code stored in this error memory slot" UBYTE EH_STANDARD_S5_S3 1 100 0 255 DISPLAY_IDENTIFIER ambient_condition[1][21].amb_cond.ydiMemory_xau16[0].ZFEH_EepromData ECU_ADDRESS 0xFFF8284E /end MEASUREMENT
/begin MEASUREMENT ZFEH_EepromData.ydiMemory_xau16[0].amb_cond.ambient_condition[1][22] "ambient condition shot [0 .. 2-1] with 25 data bytes [0 .. 25-1] for the error code stored in this error memory slot" UBYTE EH_STANDARD_S5_S3 1 100 0 255 DISPLAY_IDENTIFIER ambient_condition[1][22].amb_cond.ydiMemory_xau16[0].ZFEH_EepromData ECU_ADDRESS 0xFFF8284F /end MEASUREMENT
/begin MEASUREMENT ZFEH_EepromData.ydiMemory_xau16[0].amb_cond.ambient_condition[1][23] "ambient condition shot [0 .. 2-1] with 25 data bytes [0 .. 25-1] for the error code stored in this error memory slot" UBYTE EH_STANDARD_S5_S3 1 100 0 255 DISPLAY_IDENTIFIER ambient_condition[1][23].amb_cond.ydiMemory_xau16[0].ZFEH_EepromData ECU_ADDRESS 0xFFF82850 /end MEASUREMENT
/begin MEASUREMENT ZFEH_EepromData.ydiMemory_xau16[0].amb_cond.ambient_condition[1][24] "ambient condition shot [0 .. 2-1] with 25 data bytes [0 .. 25-1] for the error code stored in this error memory slot" UBYTE EH_STANDARD_S5_S3 1 100 0 255 DISPLAY_IDENTIFIER ambient_condition[1][24].amb_cond.ydiMemory_xau16[0].ZFEH_EepromData ECU_ADDRESS 0xFFF82851 /end MEASUREMENT
/begin MEASUREMENT ZFEH_EepromData.ydiMemory_xau16[0].amb_cond.status_of_ambient_conditions[0] "status of ambient condition shot x: 0=invalid 1=valid" UBYTE EH_STANDARD_S5_S3 1 100 0 1 DISPLAY_IDENTIFIER status_of_ambient_conditions[0].amb_cond.ydiMemory_xau16[0].ZFEH_EepromData ECU_ADDRESS 0xFFF82852 /end MEASUREMENT
/begin MEASUREMENT ZFEH_EepromData.ydiMemory_xau16[0].amb_cond.status_of_ambient_conditions[1] "status of ambient condition shot x: 0=invalid 1=valid" UBYTE EH_STANDARD_S5_S3 1 100 0 1 DISPLAY_IDENTIFIER status_of_ambient_conditions[1].amb_cond.ydiMemory_xau16[0].ZFEH_EepromData ECU_ADDRESS 0xFFF82853 /end MEASUREMENT
/begin MEASUREMENT ZFEH_EepromData.ydiMemory_xau16[0].error_code "error code stored in error memory slot" UWORD CONV_KFC_NAME 0 255 0 65535 DISPLAY_IDENTIFIER error_code.ydiMemory_xau16[0].ZFEH_EepromData ECU_ADDRESS 0xFFF8280C /end MEASUREMENT
/begin MEASUREMENT ZFEH_EepromData.ydiMemory_xau16[0].error_type "error type of error code stored in error memory slot" UWORD EH_STANDARD_S5_S3 1 100 0 65535 DISPLAY_IDENTIFIER error_type.ydiMemory_xau16[0].ZFEH_EepromData ECU_ADDRESS 0xFFF8280E /end MEASUREMENT
/begin MEASUREMENT ZFEH_EepromData.ydiMemory_xau16[0].status_word "status word of error code stored in error memory slot" UWORD EH_STANDARD_S5_S3 1 100 0 65535 DISPLAY_IDENTIFIER status_word.ydiMemory_xau16[0].ZFEH_EepromData ECU_ADDRESS 0xFFF82810 /end MEASUREMENT
/begin MEASUREMENT ZFEH_EepromData.ydiMemory_xau16[0].frequency_counter "frequency counter of error code stored in error memory slot" UBYTE EH_STANDARD_S5_S3 1 100 0 255 DISPLAY_IDENTIFIER frequency_counter.ydiMemory_xau16[0].ZFEH_EepromData ECU_ADDRESS 0xFFF82812 /end MEASUREMENT
/begin MEASUREMENT ZFEH_EepromData.ydiMemory_xau16[0].backwards_counter "backwards counter of error code stored in error memory slot" UBYTE EH_STANDARD_S5_S3 1 100 0 255 DISPLAY_IDENTIFIER backwards_counter.ydiMemory_xau16[0].ZFEH_EepromData ECU_ADDRESS 0xFFF82813 /end MEASUREMENT
/begin MEASUREMENT ZFEH_EepromData.ydiMemory_xau16[0].permanent_counter "counter of permanent error codes stored in error memory slot" UBYTE EH_STANDARD_S5_S3 1 100 0 255 DISPLAY_IDENTIFIER permanent_counter.ydiMemory_xau16[0].ZFEH_EepromData ECU_ADDRESS 0xFFF82814 /end MEASUREMENT
/begin MEASUREMENT ZFEH_EepromData.ydiMemory_xau16[0].sequence_counter "sequence counter of error code stored in error memory slot" UBYTE EH_STANDARD_S5_S3 1 100 0 255 DISPLAY_IDENTIFIER sequence_counter.ydiMemory_xau16[0].ZFEH_EepromData ECU_ADDRESS 0xFFF82815 /end MEASUREMENT
/begin MEASUREMENT ZFEH_EepromData.ydiMemory_xau16[0].master_time "master time of error code stored in error memory slot" ULONG EH_STANDARD_S5_S3 1 100 0 4294967295 DISPLAY_IDENTIFIER master_time.ydiMemory_xau16[0].ZFEH_EepromData ECU_ADDRESS 0xFFF82818 /end MEASUREMENT
/begin MEASUREMENT ZFEH_EepromData.ydiMemory_xau16[0].condition_byte "condition byte of error code stored in error memory slot" UBYTE EH_STANDARD_S5_S3 1 100 0 255 DISPLAY_IDENTIFIER condition_byte.ydiMemory_xau16[0].ZFEH_EepromData ECU_ADDRESS 0xFFF8281D /end MEASUREMENT
/begin MEASUREMENT ZFEH_EepromData.ydiMemory_xau16[0].obd_driving_cycle_counter "obd driving cycle counter of error code stored in error memory slot" UWORD EH_STANDARD_S5_S3 1 100 0 65535 DISPLAY_IDENTIFIER obd_driving_cycle_counter.ydiMemory_xau16[0].ZFEH_EepromData ECU_ADDRESS 0xFFF8281E /end MEASUREMENT
/begin MEASUREMENT ZFEH_EepromData.ydiMemory_xau16[10].amb_cond.ambient_condition[0][0] "ambient condition shot [0 .. 2-1] with 25 data bytes [0 .. 25-1] for the error code stored in this error memory slot" UBYTE EH_STANDARD_S5_S3 1 100 0 255 DISPLAY_IDENTIFIER ambient_condition[0][0].amb_cond.ydiMemory_xau16[10].ZFEH_EepromData ECU_ADDRESS 0xFFF82AF0 /end MEASUREMENT
/begin MEASUREMENT ZFEH_EepromData.ydiMemory_xau16[10].amb_cond.ambient_condition[0][1] "ambient condition shot [0 .. 2-1] with 25 data bytes [0 .. 25-1] for the error code stored in this error memory slot" UBYTE EH_STANDARD_S5_S3 1 100 0 255 DISPLAY_IDENTIFIER ambient_condition[0][1].amb_cond.ydiMemory_xau16[10].ZFEH_EepromData ECU_ADDRESS 0xFFF82AF1 /end MEASUREMENT
/begin MEASUREMENT ZFEH_EepromData.ydiMemory_xau16[10].amb_cond.ambient_condition[0][2] "ambient condition shot [0 .. 2-1] with 25 data bytes [0 .. 25-1] for the error code stored in this error memory slot" UBYTE EH_STANDARD_S5_S3 1 100 0 255 DISPLAY_IDENTIFIER ambient_condition[0][2].amb_cond.ydiMemory_xau16[10].ZFEH_EepromData ECU_ADDRESS 0xFFF82AF2 /end MEASUREMENT
/begin MEASUREMENT ZFEH_EepromData.ydiMemory_xau16[10].amb_cond.ambient_condition[0][3] "ambient condition shot [0 .. 2-1] with 25 data bytes [0 .. 25-1] for the error code stored in this error memory slot" UBYTE EH_STANDARD_S5_S3 1 100 0 255 DISPLAY_IDENTIFIER ambient_condition[0][3].amb_cond.ydiMemory_xau16[10].ZFEH_EepromData ECU_ADDRESS 0xFFF82AF3 /end MEASUREMENT
/begin MEASUREMENT ZFEH_EepromData.ydiMemory_xau16[10].amb_cond.ambient_condition[0][4] "ambient condition shot [0 .. 2-1] with 25 data bytes [0 .. 25-1] for the error code stored in this error memory slot" UBYTE EH_STANDARD_S5_S3 1 100 0 255 DISPLAY_IDENTIFIER ambient_condition[0][4].amb_cond.ydiMemory_xau16[10].ZFEH_EepromData ECU_ADDRESS 0xFFF82AF4 /end MEASUREMENT
/begin MEASUREMENT ZFEH_EepromData.ydiMemory_xau16[10].amb_cond.ambient_condition[0][5] "ambient condition shot [0 .. 2-1] with 25 data bytes [0 .. 25-1] for the error code stored in this error memory slot" UBYTE EH_STANDARD_S5_S3 1 100 0 255 DISPLAY_IDENTIFIER ambient_condition[0][5].amb_cond.ydiMemory_xau16[10].ZFEH_EepromData ECU_ADDRESS 0xFFF82AF5 /end MEASUREMENT
/begin MEASUREMENT ZFEH_EepromData.ydiMemory_xau16[10].amb_cond.ambient_condition[0][6] "ambient condition shot [0 .. 2-1] with 25 data bytes [0 .. 25-1] for the error code stored in this error memory slot" UBYTE EH_STANDARD_S5_S3 1 100 0 255 DISPLAY_IDENTIFIER ambient_condition[0][6].amb_cond.ydiMemory_xau16[10].ZFEH_EepromData ECU_ADDRESS 0xFFF82AF6 /end MEASUREMENT
/begin MEASUREMENT ZFEH_EepromData.ydiMemory_xau16[10].amb_cond.ambient_condition[0][7] "ambient condition shot [0 .. 2-1] with 25 data bytes [0 .. 25-1] for the error code stored in this error memory slot" UBYTE EH_STANDARD_S5_S3 1 100 0 255 DISPLAY_IDENTIFIER ambient_condition[0][7].amb_cond.ydiMemory_xau16[10].ZFEH_EepromData ECU_ADDRESS 0xFFF82AF7 /end MEASUREMENT
/begin MEASUREMENT ZFEH_EepromData.ydiMemory_xau16[10].amb_cond.ambient_condition[0][8] "ambient condition shot [0 .. 2-1] with 25 data bytes [0 .. 25-1] for the error code stored in this error memory slot" UBYTE EH_STANDARD_S5_S3 1 100 0 255 DISPLAY_IDENTIFIER ambient_condition[0][8].amb_cond.ydiMemory_xau16[10].ZFEH_EepromData ECU_ADDRESS 0xFFF82AF8 /end MEASUREMENT
/begin MEASUREMENT ZFEH_EepromData.ydiMemory_xau16[10].amb_cond.ambient_condition[0][9] "ambient condition shot [0 .. 2-1] with 25 data bytes [0 .. 25-1] for the error code stored in this error memory slot" UBYTE EH_STANDARD_S5_S3 1 100 0 255 DISPLAY_IDENTIFIER ambient_condition[0][9].amb_cond.ydiMemory_xau16[10].ZFEH_EepromData ECU_ADDRESS 0xFFF82AF9 /end MEASUREMENT
/begin MEASUREMENT ZFEH_EepromData.ydiMemory_xau16[10].amb_cond.ambient_condition[0][10] "ambient condition shot [0 .. 2-1] with 25 data bytes [0 .. 25-1] for the error code stored in this error memory slot" UBYTE EH_STANDARD_S5_S3 1 100 0 255 DISPLAY_IDENTIFIER ambient_condition[0][10].amb_cond.ydiMemory_xau16[10].ZFEH_EepromData ECU_ADDRESS 0xFFF82AFA /end MEASUREMENT
/begin MEASUREMENT ZFEH_EepromData.ydiMemory_xau16[10].amb_cond.ambient_condition[0][11] "ambient condition shot [0 .. 2-1] with 25 data bytes [0 .. 25-1] for the error code stored in this error memory slot" UBYTE EH_STANDARD_S5_S3 1 100 0 255 DISPLAY_IDENTIFIER ambient_condition[0][11].amb_cond.ydiMemory_xau16[10].ZFEH_EepromData ECU_ADDRESS 0xFFF82AFB /end MEASUREMENT
/begin MEASUREMENT ZFEH_EepromData.ydiMemory_xau16[10].amb_cond.ambient_condition[0][12] "ambient condition shot [0 .. 2-1] with 25 data bytes [0 .. 25-1] for the error code stored in this error memory slot" UBYTE EH_STANDARD_S5_S3 1 100 0 255 DISPLAY_IDENTIFIER ambient_condition[0][12].amb_cond.ydiMemory_xau16[10].ZFEH_EepromData ECU_ADDRESS 0xFFF82AFC /end MEASUREMENT
/begin MEASUREMENT ZFEH_EepromData.ydiMemory_xau16[10].amb_cond.ambient_condition[0][13] "ambient condition shot [0 .. 2-1] with 25 data bytes [0 .. 25-1] for the error code stored in this error memory slot" UBYTE EH_STANDARD_S5_S3 1 100 0 255 DISPLAY_IDENTIFIER ambient_condition[0][13].amb_cond.ydiMemory_xau16[10].ZFEH_EepromData ECU_ADDRESS 0xFFF82AFD /end MEASUREMENT
/begin MEASUREMENT ZFEH_EepromData.ydiMemory_xau16[10].amb_cond.ambient_condition[0][14] "ambient condition shot [0 .. 2-1] with 25 data bytes [0 .. 25-1] for the error code stored in this error memory slot" UBYTE EH_STANDARD_S5_S3 1 100 0 255 DISPLAY_IDENTIFIER ambient_condition[0][14].amb_cond.ydiMemory_xau16[10].ZFEH_EepromData ECU_ADDRESS 0xFFF82AFE /end MEASUREMENT
/begin MEASUREMENT ZFEH_EepromData.ydiMemory_xau16[10].amb_cond.ambient_condition[0][15] "ambient condition shot [0 .. 2-1] with 25 data bytes [0 .. 25-1] for the error code stored in this error memory slot" UBYTE EH_STANDARD_S5_S3 1 100 0 255 DISPLAY_IDENTIFIER ambient_condition[0][15].amb_cond.ydiMemory_xau16[10].ZFEH_EepromData ECU_ADDRESS 0xFFF82AFF /end MEASUREMENT
/begin MEASUREMENT ZFEH_EepromData.ydiMemory_xau16[10].amb_cond.ambient_condition[0][16] "ambient condition shot [0 .. 2-1] with 25 data bytes [0 .. 25-1] for the error code stored in this error memory slot" UBYTE EH_STANDARD_S5_S3 1 100 0 255 DISPLAY_IDENTIFIER ambient_condition[0][16].amb_cond.ydiMemory_xau16[10].ZFEH_EepromData ECU_ADDRESS 0xFFF82B00 /end MEASUREMENT
/begin MEASUREMENT ZFEH_EepromData.ydiMemory_xau16[10].amb_cond.ambient_condition[0][17] "ambient condition shot [0 .. 2-1] with 25 data bytes [0 .. 25-1] for the error code stored in this error memory slot" UBYTE EH_STANDARD_S5_S3 1 100 0 255 DISPLAY_IDENTIFIER ambient_condition[0][17].amb_cond.ydiMemory_xau16[10].ZFEH_EepromData ECU_ADDRESS 0xFFF82B01 /end MEASUREMENT
/begin MEASUREMENT ZFEH_EepromData.ydiMemory_xau16[10].amb_cond.ambient_condition[0][18] "ambient condition shot [0 .. 2-1] with 25 data bytes [0 .. 25-1] for the error code stored in this error memory slot" UBYTE EH_STANDARD_S5_S3 1 100 0 255 DISPLAY_IDENTIFIER ambient_condition[0][18].amb_cond.ydiMemory_xau16[10].ZFEH_EepromData ECU_ADDRESS 0xFFF82B02 /end MEASUREMENT
/begin MEASUREMENT ZFEH_EepromData.ydiMemory_xau16[10].amb_cond.ambient_condition[0][19] "ambient condition shot [0 .. 2-1] with 25 data bytes [0 .. 25-1] for the error code stored in this error memory slot" UBYTE EH_STANDARD_S5_S3 1 100 0 255 DISPLAY_IDENTIFIER ambient_condition[0][19].amb_cond.ydiMemory_xau16[10].ZFEH_EepromData ECU_ADDRESS 0xFFF82B03 /end MEASUREMENT
/begin MEASUREMENT ZFEH_EepromData.ydiMemory_xau16[10].amb_cond.ambient_condition[0][20] "ambient condition shot [0 .. 2-1] with 25 data bytes [0 .. 25-1] for the error code stored in this error memory slot" UBYTE EH_STANDARD_S5_S3 1 100 0 255 DISPLAY_IDENTIFIER ambient_condition[0][20].amb_cond.ydiMemory_xau16[10].ZFEH_EepromData ECU_ADDRESS 0xFFF82B04 /end MEASUREMENT
/begin MEASUREMENT ZFEH_EepromData.ydiMemory_xau16[10].amb_cond.ambient_condition[0][21] "ambient condition shot [0 .. 2-1] with 25 data bytes [0 .. 25-1] for the error code stored in this error memory slot" UBYTE EH_STANDARD_S5_S3 1 100 0 255 DISPLAY_IDENTIFIER ambient_condition[0][21].amb_cond.ydiMemory_xau16[10].ZFEH_EepromData ECU_ADDRESS 0xFFF82B05 /end MEASUREMENT
/begin MEASUREMENT ZFEH_EepromData.ydiMemory_xau16[10].amb_cond.ambient_condition[0][22] "ambient condition shot [0 .. 2-1] with 25 data bytes [0 .. 25-1] for the error code stored in this error memory slot" UBYTE EH_STANDARD_S5_S3 1 100 0 255 DISPLAY_IDENTIFIER ambient_condition[0][22].amb_cond.ydiMemory_xau16[10].ZFEH_EepromData ECU_ADDRESS 0xFFF82B06 /end MEASUREMENT
/begin MEASUREMENT ZFEH_EepromData.ydiMemory_xau16[10].amb_cond.ambient_condition[0][23] "ambient condition shot [0 .. 2-1] with 25 data bytes [0 .. 25-1] for the error code stored in this error memory slot" UBYTE EH_STANDARD_S5_S3 1 100 0 255 DISPLAY_IDENTIFIER ambient_condition[0][23].amb_cond.ydiMemory_xau16[10].ZFEH_EepromData ECU_ADDRESS 0xFFF82B07 /end MEASUREMENT
/begin MEASUREMENT ZFEH_EepromData.ydiMemory_xau16[10].amb_cond.ambient_condition[0][24] "ambient condition shot [0 .. 2-1] with 25 data bytes [0 .. 25-1] for the error code stored in this error memory slot" UBYTE EH_STANDARD_S5_S3 1 100 0 255 DISPLAY_IDENTIFIER ambient_condition[0][24].amb_cond.ydiMemory_xau16[10].ZFEH_EepromData ECU_ADDRESS 0xFFF82B08 /end MEASUREMENT
/begin MEASUREMENT ZFEH_EepromData.ydiMemory_xau16[10].amb_cond.ambient_condition[1][0] "ambient condition shot [0 .. 2-1] with 25 data bytes [0 .. 25-1] for the error code stored in this error memory slot" UBYTE EH_STANDARD_S5_S3 1 100 0 255 DISPLAY_IDENTIFIER ambient_condition[1][0].amb_cond.ydiMemory_xau16[10].ZFEH_EepromData ECU_ADDRESS 0xFFF82B09 /end MEASUREMENT
/begin MEASUREMENT ZFEH_EepromData.ydiMemory_xau16[10].amb_cond.ambient_condition[1][1] "ambient condition shot [0 .. 2-1] with 25 data bytes [0 .. 25-1] for the error code stored in this error memory slot" UBYTE EH_STANDARD_S5_S3 1 100 0 255 DISPLAY_IDENTIFIER ambient_condition[1][1].amb_cond.ydiMemory_xau16[10].ZFEH_EepromData ECU_ADDRESS 0xFFF82B0A /end MEASUREMENT
/begin MEASUREMENT ZFEH_EepromData.ydiMemory_xau16[10].amb_cond.ambient_condition[1][2] "ambient condition shot [0 .. 2-1] with 25 data bytes [0 .. 25-1] for the error code stored in this error memory slot" UBYTE EH_STANDARD_S5_S3 1 100 0 255 DISPLAY_IDENTIFIER ambient_condition[1][2].amb_cond.ydiMemory_xau16[10].ZFEH_EepromData ECU_ADDRESS 0xFFF82B0B /end MEASUREMENT
/begin MEASUREMENT ZFEH_EepromData.ydiMemory_xau16[10].amb_cond.ambient_condition[1][3] "ambient condition shot [0 .. 2-1] with 25 data bytes [0 .. 25-1] for the error code stored in this error memory slot" UBYTE EH_STANDARD_S5_S3 1 100 0 255 DISPLAY_IDENTIFIER ambient_condition[1][3].amb_cond.ydiMemory_xau16[10].ZFEH_EepromData ECU_ADDRESS 0xFFF82B0C /end MEASUREMENT
/begin MEASUREMENT ZFEH_EepromData.ydiMemory_xau16[10].amb_cond.ambient_condition[1][4] "ambient condition shot [0 .. 2-1] with 25 data bytes [0 .. 25-1] for the error code stored in this error memory slot" UBYTE EH_STANDARD_S5_S3 1 100 0 255 DISPLAY_IDENTIFIER ambient_condition[1][4].amb_cond.ydiMemory_xau16[10].ZFEH_EepromData ECU_ADDRESS 0xFFF82B0D /end MEASUREMENT
/begin MEASUREMENT ZFEH_EepromData.ydiMemory_xau16[10].amb_cond.ambient_condition[1][5] "ambient condition shot [0 .. 2-1] with 25 data bytes [0 .. 25-1] for the error code stored in this error memory slot" UBYTE EH_STANDARD_S5_S3 1 100 0 255 DISPLAY_IDENTIFIER ambient_condition[1][5].amb_cond.ydiMemory_xau16[10].ZFEH_EepromData ECU_ADDRESS 0xFFF82B0E /end MEASUREMENT
/begin MEASUREMENT ZFEH_EepromData.ydiMemory_xau16[10].amb_cond.ambient_condition[1][6] "ambient condition shot [0 .. 2-1] with 25 data bytes [0 .. 25-1] for the error code stored in this error memory slot" UBYTE EH_STANDARD_S5_S3 1 100 0 255 DISPLAY_IDENTIFIER ambient_condition[1][6].amb_cond.ydiMemory_xau16[10].ZFEH_EepromData ECU_ADDRESS 0xFFF82B0F /end MEASUREMENT
/begin MEASUREMENT ZFEH_EepromData.ydiMemory_xau16[10].amb_cond.ambient_condition[1][7] "ambient condition shot [0 .. 2-1] with 25 data bytes [0 .. 25-1] for the error code stored in this error memory slot" UBYTE EH_STANDARD_S5_S3 1 100 0 255 DISPLAY_IDENTIFIER ambient_condition[1][7].amb_cond.ydiMemory_xau16[10].ZFEH_EepromData ECU_ADDRESS 0xFFF82B10 /end MEASUREMENT
/begin MEASUREMENT ZFEH_EepromData.ydiMemory_xau16[10].amb_cond.ambient_condition[1][8] "ambient condition shot [0 .. 2-1] with 25 data bytes [0 .. 25-1] for the error code stored in this error memory slot" UBYTE EH_STANDARD_S5_S3 1 100 0 255 DISPLAY_IDENTIFIER ambient_condition[1][8].amb_cond.ydiMemory_xau16[10].ZFEH_EepromData ECU_ADDRESS 0xFFF82B11 /end MEASUREMENT
/begin MEASUREMENT ZFEH_EepromData.ydiMemory_xau16[10].amb_cond.ambient_condition[1][9] "ambient condition shot [0 .. 2-1] with 25 data bytes [0 .. 25-1] for the error code stored in this error memory slot" UBYTE EH_STANDARD_S5_S3 1 100 0 255 DISPLAY_IDENTIFIER ambient_condition[1][9].amb_cond.ydiMemory_xau16[10].ZFEH_EepromData ECU_ADDRESS 0xFFF82B12 /end MEASUREMENT
/begin MEASUREMENT ZFEH_EepromData.ydiMemory_xau16[10].amb_cond.ambient_condition[1][10] "ambient condition shot [0 .. 2-1] with 25 data bytes [0 .. 25-1] for the error code stored in this error memory slot" UBYTE EH_STANDARD_S5_S3 1 100 0 255 DISPLAY_IDENTIFIER ambient_condition[1][10].amb_cond.ydiMemory_xau16[10].ZFEH_EepromData ECU_ADDRESS 0xFFF82B13 /end MEASUREMENT
/begin MEASUREMENT ZFEH_EepromData.ydiMemory_xau16[10].amb_cond.ambient_condition[1][11] "ambient condition shot [0 .. 2-1] with 25 data bytes [0 .. 25-1] for the error code stored in this error memory slot" UBYTE EH_STANDARD_S5_S3 1 100 0 255 DISPLAY_IDENTIFIER ambient_condition[1][11].amb_cond.ydiMemory_xau16[10].ZFEH_EepromData ECU_ADDRESS 0xFFF82B14 /end MEASUREMENT
/begin MEASUREMENT ZFEH_EepromData.ydiMemory_xau16[10].amb_cond.ambient_condition[1][12] "ambient condition shot [0 .. 2-1] with 25 data bytes [0 .. 25-1] for the error code stored in this error memory slot" UBYTE EH_STANDARD_S5_S3 1 100 0 255 DISPLAY_IDENTIFIER ambient_condition[1][12].amb_cond.ydiMemory_xau16[10].ZFEH_EepromData ECU_ADDRESS 0xFFF82B15 /end MEASUREMENT
/begin MEASUREMENT ZFEH_EepromData.ydiMemory_xau16[10].amb_cond.ambient_condition[1][13] "ambient condition shot [0 .. 2-1] with 25 data bytes [0 .. 25-1] for the error code stored in this error memory slot" UBYTE EH_STANDARD_S5_S3 1 100 0 255 DISPLAY_IDENTIFIER ambient_condition[1][13].amb_cond.ydiMemory_xau16[10].ZFEH_EepromData ECU_ADDRESS 0xFFF82B16 /end MEASUREMENT
/begin MEASUREMENT ZFEH_EepromData.ydiMemory_xau16[10].amb_cond.ambient_condition[1][14] "ambient condition shot [0 .. 2-1] with 25 data bytes [0 .. 25-1] for the error code stored in this error memory slot" UBYTE EH_STANDARD_S5_S3 1 100 0 255 DISPLAY_IDENTIFIER ambient_condition[1][14].amb_cond.ydiMemory_xau16[10].ZFEH_EepromData ECU_ADDRESS 0xFFF82B17 /end MEASUREMENT
/begin MEASUREMENT ZFEH_EepromData.ydiMemory_xau16[10].amb_cond.ambient_condition[1][15] "ambient condition shot [0 .. 2-1] with 25 data bytes [0 .. 25-1] for the error code stored in this error memory slot" UBYTE EH_STANDARD_S5_S3 1 100 0 255 DISPLAY_IDENTIFIER ambient_condition[1][15].amb_cond.ydiMemory_xau16[10].ZFEH_EepromData ECU_ADDRESS 0xFFF82B18 /end MEASUREMENT
/begin MEASUREMENT ZFEH_EepromData.ydiMemory_xau16[10].amb_cond.ambient_condition[1][16] "ambient condition shot [0 .. 2-1] with 25 data bytes [0 .. 25-1] for the error code stored in this error memory slot" UBYTE EH_STANDARD_S5_S3 1 100 0 255 DISPLAY_IDENTIFIER ambient_condition[1][16].amb_cond.ydiMemory_xau16[10].ZFEH_EepromData ECU_ADDRESS 0xFFF82B19 /end MEASUREMENT
/begin MEASUREMENT ZFEH_EepromData.ydiMemory_xau16[10].amb_cond.ambient_condition[1][17] "ambient condition shot [0 .. 2-1] with 25 data bytes [0 .. 25-1] for the error code stored in this error memory slot" UBYTE EH_STANDARD_S5_S3 1 100 0 255 DISPLAY_IDENTIFIER ambient_condition[1][17].amb_cond.ydiMemory_xau16[10].ZFEH_EepromData ECU_ADDRESS 0xFFF82B1A /end MEASUREMENT
/begin MEASUREMENT ZFEH_EepromData.ydiMemory_xau16[10].amb_cond.ambient_condition[1][18] "ambient condition shot [0 .. 2-1] with 25 data bytes [0 .. 25-1] for the error code stored in this error memory slot" UBYTE EH_STANDARD_S5_S3 1 100 0 255 DISPLAY_IDENTIFIER ambient_condition[1][18].amb_cond.ydiMemory_xau16[10].ZFEH_EepromData ECU_ADDRESS 0xFFF82B1B /end MEASUREMENT
/begin MEASUREMENT ZFEH_EepromData.ydiMemory_xau16[10].amb_cond.ambient_condition[1][19] "ambient condition shot [0 .. 2-1] with 25 data bytes [0 .. 25-1] for the error code stored in this error memory slot" UBYTE EH_STANDARD_S5_S3 1 100 0 255 DISPLAY_IDENTIFIER ambient_condition[1][19].amb_cond.ydiMemory_xau16[10].ZFEH_EepromData ECU_ADDRESS 0xFFF82B1C /end MEASUREMENT
/begin MEASUREMENT ZFEH_EepromData.ydiMemory_xau16[10].amb_cond.ambient_condition[1][20] "ambient condition shot [0 .. 2-1] with 25 data bytes [0 .. 25-1] for the error code stored in this error memory slot" UBYTE EH_STANDARD_S5_S3 1 100 0 255 DISPLAY_IDENTIFIER ambient_condition[1][20].amb_cond.ydiMemory_xau16[10].ZFEH_EepromData ECU_ADDRESS 0xFFF82B1D /end MEASUREMENT
/begin MEASUREMENT ZFEH_EepromData.ydiMemory_xau16[10].amb_cond.ambient_condition[1][21] "ambient condition shot [0 .. 2-1] with 25 data bytes [0 .. 25-1] for the error code stored in this error memory slot" UBYTE EH_STANDARD_S5_S3 1 100 0 255 DISPLAY_IDENTIFIER ambient_condition[1][21].amb_cond.ydiMemory_xau16[10].ZFEH_EepromData ECU_ADDRESS 0xFFF82B1E /end MEASUREMENT
/begin MEASUREMENT ZFEH_EepromData.ydiMemory_xau16[10].amb_cond.ambient_condition[1][22] "ambient condition shot [0 .. 2-1] with 25 data bytes [0 .. 25-1] for the error code stored in this error memory slot" UBYTE EH_STANDARD_S5_S3 1 100 0 255 DISPLAY_IDENTIFIER ambient_condition[1][22].amb_cond.ydiMemory_xau16[10].ZFEH_EepromData ECU_ADDRESS 0xFFF82B1F /end MEASUREMENT
/begin MEASUREMENT ZFEH_EepromData.ydiMemory_xau16[10].amb_cond.ambient_condition[1][23] "ambient condition shot [0 .. 2-1] with 25 data bytes [0 .. 25-1] for the error code stored in this error memory slot" UBYTE EH_STANDARD_S5_S3 1 100 0 255 DISPLAY_IDENTIFIER ambient_condition[1][23].amb_cond.ydiMemory_xau16[10].ZFEH_EepromData ECU_ADDRESS 0xFFF82B20 /end MEASUREMENT
/begin MEASUREMENT ZFEH_EepromData.ydiMemory_xau16[10].amb_cond.ambient_condition[1][24] "ambient condition shot [0 .. 2-1] with 25 data bytes [0 .. 25-1] for the error code stored in this error memory slot" UBYTE EH_STANDARD_S5_S3 1 100 0 255 DISPLAY_IDENTIFIER ambient_condition[1][24].amb_cond.ydiMemory_xau16[10].ZFEH_EepromData ECU_ADDRESS 0xFFF82B21 /end MEASUREMENT
/begin MEASUREMENT ZFEH_EepromData.ydiMemory_xau16[10].amb_cond.status_of_ambient_conditions[0] "status of ambient condition shot x: 0=invalid 1=valid" UBYTE EH_STANDARD_S5_S3 1 100 0 1 DISPLAY_IDENTIFIER status_of_ambient_conditions[0].amb_cond.ydiMemory_xau16[10].ZFEH_EepromData ECU_ADDRESS 0xFFF82B22 /end MEASUREMENT
/begin MEASUREMENT ZFEH_EepromData.ydiMemory_xau16[10].amb_cond.status_of_ambient_conditions[1] "status of ambient condition shot x: 0=invalid 1=valid" UBYTE EH_STANDARD_S5_S3 1 100 0 1 DISPLAY_IDENTIFIER status_of_ambient_conditions[1].amb_cond.ydiMemory_xau16[10].ZFEH_EepromData ECU_ADDRESS 0xFFF82B23 /end MEASUREMENT
/begin MEASUREMENT ZFEH_EepromData.ydiMemory_xau16[10].error_code "error code stored in error memory slot" UWORD CONV_KFC_NAME 0 255 0 65535 DISPLAY_IDENTIFIER error_code.ydiMemory_xau16[10].ZFEH_EepromData ECU_ADDRESS 0xFFF82ADC /end MEASUREMENT
/begin MEASUREMENT ZFEH_EepromData.ydiMemory_xau16[10].error_type "error type of error code stored in error memory slot" UWORD EH_STANDARD_S5_S3 1 100 0 65535 DISPLAY_IDENTIFIER error_type.ydiMemory_xau16[10].ZFEH_EepromData ECU_ADDRESS 0xFFF82ADE /end MEASUREMENT
/begin MEASUREMENT ZFEH_EepromData.ydiMemory_xau16[10].status_word "status word of error code stored in error memory slot" UWORD EH_STANDARD_S5_S3 1 100 0 65535 DISPLAY_IDENTIFIER status_word.ydiMemory_xau16[10].ZFEH_EepromData ECU_ADDRESS 0xFFF82AE0 /end MEASUREMENT
/begin MEASUREMENT ZFEH_EepromData.ydiMemory_xau16[10].frequency_counter "frequency counter of error code stored in error memory slot" UBYTE EH_STANDARD_S5_S3 1 100 0 255 DISPLAY_IDENTIFIER frequency_counter.ydiMemory_xau16[10].ZFEH_EepromData ECU_ADDRESS 0xFFF82AE2 /end MEASUREMENT
/begin MEASUREMENT ZFEH_EepromData.ydiMemory_xau16[10].backwards_counter "backwards counter of error code stored in error memory slot" UBYTE EH_STANDARD_S5_S3 1 100 0 255 DISPLAY_IDENTIFIER backwards_counter.ydiMemory_xau16[10].ZFEH_EepromData ECU_ADDRESS 0xFFF82AE3 /end MEASUREMENT
/begin MEASUREMENT ZFEH_EepromData.ydiMemory_xau16[10].permanent_counter "counter of permanent error codes stored in error memory slot" UBYTE EH_STANDARD_S5_S3 1 100 0 255 DISPLAY_IDENTIFIER permanent_counter.ydiMemory_xau16[10].ZFEH_EepromData ECU_ADDRESS 0xFFF82AE4 /end MEASUREMENT
/begin MEASUREMENT ZFEH_EepromData.ydiMemory_xau16[10].sequence_counter "sequence counter of error code stored in error memory slot" UBYTE EH_STANDARD_S5_S3 1 100 0 255 DISPLAY_IDENTIFIER sequence_counter.ydiMemory_xau16[10].ZFEH_EepromData ECU_ADDRESS 0xFFF82AE5 /end MEASUREMENT
/begin MEASUREMENT ZFEH_EepromData.ydiMemory_xau16[10].master_time "master time of error code stored in error memory slot" ULONG EH_STANDARD_S5_S3 1 100 0 4294967295 DISPLAY_IDENTIFIER master_time.ydiMemory_xau16[10].ZFEH_EepromData ECU_ADDRESS 0xFFF82AE8 /end MEASUREMENT
/begin MEASUREMENT ZFEH_EepromData.ydiMemory_xau16[10].condition_byte "condition byte of error code stored in error memory slot" UBYTE EH_STANDARD_S5_S3 1 100 0 255 DISPLAY_IDENTIFIER condition_byte.ydiMemory_xau16[10].ZFEH_EepromData ECU_ADDRESS 0xFFF82AED /end MEASUREMENT
/begin MEASUREMENT ZFEH_EepromData.ydiMemory_xau16[10].obd_driving_cycle_counter "obd driving cycle counter of error code stored in error memory slot" UWORD EH_STANDARD_S5_S3 1 100 0 65535 DISPLAY_IDENTIFIER obd_driving_cycle_counter.ydiMemory_xau16[10].ZFEH_EepromData ECU_ADDRESS 0xFFF82AEE /end MEASUREMENT
/begin MEASUREMENT ZFEH_EepromData.ydiMemory_xau16[11].amb_cond.ambient_condition[0][0] "ambient condition shot [0 .. 2-1] with 25 data bytes [0 .. 25-1] for the error code stored in this error memory slot" UBYTE EH_STANDARD_S5_S3 1 100 0 255 DISPLAY_IDENTIFIER ambient_condition[0][0].amb_cond.ydiMemory_xau16[11].ZFEH_EepromData ECU_ADDRESS 0xFFF82B38 /end MEASUREMENT
/begin MEASUREMENT ZFEH_EepromData.ydiMemory_xau16[11].amb_cond.ambient_condition[0][1] "ambient condition shot [0 .. 2-1] with 25 data bytes [0 .. 25-1] for the error code stored in this error memory slot" UBYTE EH_STANDARD_S5_S3 1 100 0 255 DISPLAY_IDENTIFIER ambient_condition[0][1].amb_cond.ydiMemory_xau16[11].ZFEH_EepromData ECU_ADDRESS 0xFFF82B39 /end MEASUREMENT
/begin MEASUREMENT ZFEH_EepromData.ydiMemory_xau16[11].amb_cond.ambient_condition[0][2] "ambient condition shot [0 .. 2-1] with 25 data bytes [0 .. 25-1] for the error code stored in this error memory slot" UBYTE EH_STANDARD_S5_S3 1 100 0 255 DISPLAY_IDENTIFIER ambient_condition[0][2].amb_cond.ydiMemory_xau16[11].ZFEH_EepromData ECU_ADDRESS 0xFFF82B3A /end MEASUREMENT
/begin MEASUREMENT ZFEH_EepromData.ydiMemory_xau16[11].amb_cond.ambient_condition[0][3] "ambient condition shot [0 .. 2-1] with 25 data bytes [0 .. 25-1] for the error code stored in this error memory slot" UBYTE EH_STANDARD_S5_S3 1 100 0 255 DISPLAY_IDENTIFIER ambient_condition[0][3].amb_cond.ydiMemory_xau16[11].ZFEH_EepromData ECU_ADDRESS 0xFFF82B3B /end MEASUREMENT
/begin MEASUREMENT ZFEH_EepromData.ydiMemory_xau16[11].amb_cond.ambient_condition[0][4] "ambient condition shot [0 .. 2-1] with 25 data bytes [0 .. 25-1] for the error code stored in this error memory slot" UBYTE EH_STANDARD_S5_S3 1 100 0 255 DISPLAY_IDENTIFIER ambient_condition[0][4].amb_cond.ydiMemory_xau16[11].ZFEH_EepromData ECU_ADDRESS 0xFFF82B3C /end MEASUREMENT
/begin MEASUREMENT ZFEH_EepromData.ydiMemory_xau16[11].amb_cond.ambient_condition[0][5] "ambient condition shot [0 .. 2-1] with 25 data bytes [0 .. 25-1] for the error code stored in this error memory slot" UBYTE EH_STANDARD_S5_S3 1 100 0 255 DISPLAY_IDENTIFIER ambient_condition[0][5].amb_cond.ydiMemory_xau16[11].ZFEH_EepromData ECU_ADDRESS 0xFFF82B3D /end MEASUREMENT
/begin MEASUREMENT ZFEH_EepromData.ydiMemory_xau16[11].amb_cond.ambient_condition[0][6] "ambient condition shot [0 .. 2-1] with 25 data bytes [0 .. 25-1] for the error code stored in this error memory slot" UBYTE EH_STANDARD_S5_S3 1 100 0 255 DISPLAY_IDENTIFIER ambient_condition[0][6].amb_cond.ydiMemory_xau16[11].ZFEH_EepromData ECU_ADDRESS 0xFFF82B3E /end MEASUREMENT
/begin MEASUREMENT ZFEH_EepromData.ydiMemory_xau16[11].amb_cond.ambient_condition[0][7] "ambient condition shot [0 .. 2-1] with 25 data bytes [0 .. 25-1] for the error code stored in this error memory slot" UBYTE EH_STANDARD_S5_S3 1 100 0 255 DISPLAY_IDENTIFIER ambient_condition[0][7].amb_cond.ydiMemory_xau16[11].ZFEH_EepromData ECU_ADDRESS 0xFFF82B3F /end MEASUREMENT
/begin MEASUREMENT ZFEH_EepromData.ydiMemory_xau16[11].amb_cond.ambient_condition[0][8] "ambient condition shot [0 .. 2-1] with 25 data bytes [0 .. 25-1] for the error code stored in this error memory slot" UBYTE EH_STANDARD_S5_S3 1 100 0 255 DISPLAY_IDENTIFIER ambient_condition[0][8].amb_cond.ydiMemory_xau16[11].ZFEH_EepromData ECU_ADDRESS 0xFFF82B40 /end MEASUREMENT
/begin MEASUREMENT ZFEH_EepromData.ydiMemory_xau16[11].amb_cond.ambient_condition[0][9] "ambient condition shot [0 .. 2-1] with 25 data bytes [0 .. 25-1] for the error code stored in this error memory slot" UBYTE EH_STANDARD_S5_S3 1 100 0 255 DISPLAY_IDENTIFIER ambient_condition[0][9].amb_cond.ydiMemory_xau16[11].ZFEH_EepromData ECU_ADDRESS 0xFFF82B41 /end MEASUREMENT
/begin MEASUREMENT ZFEH_EepromData.ydiMemory_xau16[11].amb_cond.ambient_condition[0][10] "ambient condition shot [0 .. 2-1] with 25 data bytes [0 .. 25-1] for the error code stored in this error memory slot" UBYTE EH_STANDARD_S5_S3 1 100 0 255 DISPLAY_IDENTIFIER ambient_condition[0][10].amb_cond.ydiMemory_xau16[11].ZFEH_EepromData ECU_ADDRESS 0xFFF82B42 /end MEASUREMENT
/begin MEASUREMENT ZFEH_EepromData.ydiMemory_xau16[11].amb_cond.ambient_condition[0][11] "ambient condition shot [0 .. 2-1] with 25 data bytes [0 .. 25-1] for the error code stored in this error memory slot" UBYTE EH_STANDARD_S5_S3 1 100 0 255 DISPLAY_IDENTIFIER ambient_condition[0][11].amb_cond.ydiMemory_xau16[11].ZFEH_EepromData ECU_ADDRESS 0xFFF82B43 /end MEASUREMENT
/begin MEASUREMENT ZFEH_EepromData.ydiMemory_xau16[11].amb_cond.ambient_condition[0][12] "ambient condition shot [0 .. 2-1] with 25 data bytes [0 .. 25-1] for the error code stored in this error memory slot" UBYTE EH_STANDARD_S5_S3 1 100 0 255 DISPLAY_IDENTIFIER ambient_condition[0][12].amb_cond.ydiMemory_xau16[11].ZFEH_EepromData ECU_ADDRESS 0xFFF82B44 /end MEASUREMENT
/begin MEASUREMENT ZFEH_EepromData.ydiMemory_xau16[11].amb_cond.ambient_condition[0][13] "ambient condition shot [0 .. 2-1] with 25 data bytes [0 .. 25-1] for the error code stored in this error memory slot" UBYTE EH_STANDARD_S5_S3 1 100 0 255 DISPLAY_IDENTIFIER ambient_condition[0][13].amb_cond.ydiMemory_xau16[11].ZFEH_EepromData ECU_ADDRESS 0xFFF82B45 /end MEASUREMENT
/begin MEASUREMENT ZFEH_EepromData.ydiMemory_xau16[11].amb_cond.ambient_condition[0][14] "ambient condition shot [0 .. 2-1] with 25 data bytes [0 .. 25-1] for the error code stored in this error memory slot" UBYTE EH_STANDARD_S5_S3 1 100 0 255 DISPLAY_IDENTIFIER ambient_condition[0][14].amb_cond.ydiMemory_xau16[11].ZFEH_EepromData ECU_ADDRESS 0xFFF82B46 /end MEASUREMENT
/begin MEASUREMENT ZFEH_EepromData.ydiMemory_xau16[11].amb_cond.ambient_condition[0][15] "ambient condition shot [0 .. 2-1] with 25 data bytes [0 .. 25-1] for the error code stored in this error memory slot" UBYTE EH_STANDARD_S5_S3 1 100 0 255 DISPLAY_IDENTIFIER ambient_condition[0][15].amb_cond.ydiMemory_xau16[11].ZFEH_EepromData ECU_ADDRESS 0xFFF82B47 /end MEASUREMENT
/begin MEASUREMENT ZFEH_EepromData.ydiMemory_xau16[11].amb_cond.ambient_condition[0][16] "ambient condition shot [0 .. 2-1] with 25 data bytes [0 .. 25-1] for the error code stored in this error memory slot" UBYTE EH_STANDARD_S5_S3 1 100 0 255 DISPLAY_IDENTIFIER ambient_condition[0][16].amb_cond.ydiMemory_xau16[11].ZFEH_EepromData ECU_ADDRESS 0xFFF82B48 /end MEASUREMENT
/begin MEASUREMENT ZFEH_EepromData.ydiMemory_xau16[11].amb_cond.ambient_condition[0][17] "ambient condition shot [0 .. 2-1] with 25 data bytes [0 .. 25-1] for the error code stored in this error memory slot" UBYTE EH_STANDARD_S5_S3 1 100 0 255 DISPLAY_IDENTIFIER ambient_condition[0][17].amb_cond.ydiMemory_xau16[11].ZFEH_EepromData ECU_ADDRESS 0xFFF82B49 /end MEASUREMENT
/begin MEASUREMENT ZFEH_EepromData.ydiMemory_xau16[11].amb_cond.ambient_condition[0][18] "ambient condition shot [0 .. 2-1] with 25 data bytes [0 .. 25-1] for the error code stored in this error memory slot" UBYTE EH_STANDARD_S5_S3 1 100 0 255 DISPLAY_IDENTIFIER ambient_condition[0][18].amb_cond.ydiMemory_xau16[11].ZFEH_EepromData ECU_ADDRESS 0xFFF82B4A /end MEASUREMENT
/begin MEASUREMENT ZFEH_EepromData.ydiMemory_xau16[11].amb_cond.ambient_condition[0][19] "ambient condition shot [0 .. 2-1] with 25 data bytes [0 .. 25-1] for the error code stored in this error memory slot" UBYTE EH_STANDARD_S5_S3 1 100 0 255 DISPLAY_IDENTIFIER ambient_condition[0][19].amb_cond.ydiMemory_xau16[11].ZFEH_EepromData ECU_ADDRESS 0xFFF82B4B /end MEASUREMENT
/begin MEASUREMENT ZFEH_EepromData.ydiMemory_xau16[11].amb_cond.ambient_condition[0][20] "ambient condition shot [0 .. 2-1] with 25 data bytes [0 .. 25-1] for the error code stored in this error memory slot" UBYTE EH_STANDARD_S5_S3 1 100 0 255 DISPLAY_IDENTIFIER ambient_condition[0][20].amb_cond.ydiMemory_xau16[11].ZFEH_EepromData ECU_ADDRESS 0xFFF82B4C /end MEASUREMENT
/begin MEASUREMENT ZFEH_EepromData.ydiMemory_xau16[11].amb_cond.ambient_condition[0][21] "ambient condition shot [0 .. 2-1] with 25 data bytes [0 .. 25-1] for the error code stored in this error memory slot" UBYTE EH_STANDARD_S5_S3 1 100 0 255 DISPLAY_IDENTIFIER ambient_condition[0][21].amb_cond.ydiMemory_xau16[11].ZFEH_EepromData ECU_ADDRESS 0xFFF82B4D /end MEASUREMENT
/begin MEASUREMENT ZFEH_EepromData.ydiMemory_xau16[11].amb_cond.ambient_condition[0][22] "ambient condition shot [0 .. 2-1] with 25 data bytes [0 .. 25-1] for the error code stored in this error memory slot" UBYTE EH_STANDARD_S5_S3 1 100 0 255 DISPLAY_IDENTIFIER ambient_condition[0][22].amb_cond.ydiMemory_xau16[11].ZFEH_EepromData ECU_ADDRESS 0xFFF82B4E /end MEASUREMENT
/begin MEASUREMENT ZFEH_EepromData.ydiMemory_xau16[11].amb_cond.ambient_condition[0][23] "ambient condition shot [0 .. 2-1] with 25 data bytes [0 .. 25-1] for the error code stored in this error memory slot" UBYTE EH_STANDARD_S5_S3 1 100 0 255 DISPLAY_IDENTIFIER ambient_condition[0][23].amb_cond.ydiMemory_xau16[11].ZFEH_EepromData ECU_ADDRESS 0xFFF82B4F /end MEASUREMENT
/begin MEASUREMENT ZFEH_EepromData.ydiMemory_xau16[11].amb_cond.ambient_condition[0][24] "ambient condition shot [0 .. 2-1] with 25 data bytes [0 .. 25-1] for the error code stored in this error memory slot" UBYTE EH_STANDARD_S5_S3 1 100 0 255 DISPLAY_IDENTIFIER ambient_condition[0][24].amb_cond.ydiMemory_xau16[11].ZFEH_EepromData ECU_ADDRESS 0xFFF82B50 /end MEASUREMENT
/begin MEASUREMENT ZFEH_EepromData.ydiMemory_xau16[11].amb_cond.ambient_condition[1][0] "ambient condition shot [0 .. 2-1] with 25 data bytes [0 .. 25-1] for the error code stored in this error memory slot" UBYTE EH_STANDARD_S5_S3 1 100 0 255 DISPLAY_IDENTIFIER ambient_condition[1][0].amb_cond.ydiMemory_xau16[11].ZFEH_EepromData ECU_ADDRESS 0xFFF82B51 /end MEASUREMENT
/begin MEASUREMENT ZFEH_EepromData.ydiMemory_xau16[11].amb_cond.ambient_condition[1][1] "ambient condition shot [0 .. 2-1] with 25 data bytes [0 .. 25-1] for the error code stored in this error memory slot" UBYTE EH_STANDARD_S5_S3 1 100 0 255 DISPLAY_IDENTIFIER ambient_condition[1][1].amb_cond.ydiMemory_xau16[11].ZFEH_EepromData ECU_ADDRESS 0xFFF82B52 /end MEASUREMENT
/begin MEASUREMENT ZFEH_EepromData.ydiMemory_xau16[11].amb_cond.ambient_condition[1][2] "ambient condition shot [0 .. 2-1] with 25 data bytes [0 .. 25-1] for the error code stored in this error memory slot" UBYTE EH_STANDARD_S5_S3 1 100 0 255 DISPLAY_IDENTIFIER ambient_condition[1][2].amb_cond.ydiMemory_xau16[11].ZFEH_EepromData ECU_ADDRESS 0xFFF82B53 /end MEASUREMENT
/begin MEASUREMENT ZFEH_EepromData.ydiMemory_xau16[11].amb_cond.ambient_condition[1][3] "ambient condition shot [0 .. 2-1] with 25 data bytes [0 .. 25-1] for the error code stored in this error memory slot" UBYTE EH_STANDARD_S5_S3 1 100 0 255 DISPLAY_IDENTIFIER ambient_condition[1][3].amb_cond.ydiMemory_xau16[11].ZFEH_EepromData ECU_ADDRESS 0xFFF82B54 /end MEASUREMENT
/begin MEASUREMENT ZFEH_EepromData.ydiMemory_xau16[11].amb_cond.ambient_condition[1][4] "ambient condition shot [0 .. 2-1] with 25 data bytes [0 .. 25-1] for the error code stored in this error memory slot" UBYTE EH_STANDARD_S5_S3 1 100 0 255 DISPLAY_IDENTIFIER ambient_condition[1][4].amb_cond.ydiMemory_xau16[11].ZFEH_EepromData ECU_ADDRESS 0xFFF82B55 /end MEASUREMENT
/begin MEASUREMENT ZFEH_EepromData.ydiMemory_xau16[11].amb_cond.ambient_condition[1][5] "ambient condition shot [0 .. 2-1] with 25 data bytes [0 .. 25-1] for the error code stored in this error memory slot" UBYTE EH_STANDARD_S5_S3 1 100 0 255 DISPLAY_IDENTIFIER ambient_condition[1][5].amb_cond.ydiMemory_xau16[11].ZFEH_EepromData ECU_ADDRESS 0xFFF82B56 /end MEASUREMENT
/begin MEASUREMENT ZFEH_EepromData.ydiMemory_xau16[11].amb_cond.ambient_condition[1][6] "ambient condition shot [0 .. 2-1] with 25 data bytes [0 .. 25-1] for the error code stored in this error memory slot" UBYTE EH_STANDARD_S5_S3 1 100 0 255 DISPLAY_IDENTIFIER ambient_condition[1][6].amb_cond.ydiMemory_xau16[11].ZFEH_EepromData ECU_ADDRESS 0xFFF82B57 /end MEASUREMENT
/begin MEASUREMENT ZFEH_EepromData.ydiMemory_xau16[11].amb_cond.ambient_condition[1][7] "ambient condition shot [0 .. 2-1] with 25 data bytes [0 .. 25-1] for the error code stored in this error memory slot" UBYTE EH_STANDARD_S5_S3 1 100 0 255 DISPLAY_IDENTIFIER ambient_condition[1][7].amb_cond.ydiMemory_xau16[11].ZFEH_EepromData ECU_ADDRESS 0xFFF82B58 /end MEASUREMENT
/begin MEASUREMENT ZFEH_EepromData.ydiMemory_xau16[11].amb_cond.ambient_condition[1][8] "ambient condition shot [0 .. 2-1] with 25 data bytes [0 .. 25-1] for the error code stored in this error memory slot" UBYTE EH_STANDARD_S5_S3 1 100 0 255 DISPLAY_IDENTIFIER ambient_condition[1][8].amb_cond.ydiMemory_xau16[11].ZFEH_EepromData ECU_ADDRESS 0xFFF82B59 /end MEASUREMENT
/begin MEASUREMENT ZFEH_EepromData.ydiMemory_xau16[11].amb_cond.ambient_condition[1][9] "ambient condition shot [0 .. 2-1] with 25 data bytes [0 .. 25-1] for the error code stored in this error memory slot" UBYTE EH_STANDARD_S5_S3 1 100 0 255 DISPLAY_IDENTIFIER ambient_condition[1][9].amb_cond.ydiMemory_xau16[11].ZFEH_EepromData ECU_ADDRESS 0xFFF82B5A /end MEASUREMENT
/begin MEASUREMENT ZFEH_EepromData.ydiMemory_xau16[11].amb_cond.ambient_condition[1][10] "ambient condition shot [0 .. 2-1] with 25 data bytes [0 .. 25-1] for the error code stored in this error memory slot" UBYTE EH_STANDARD_S5_S3 1 100 0 255 DISPLAY_IDENTIFIER ambient_condition[1][10].amb_cond.ydiMemory_xau16[11].ZFEH_EepromData ECU_ADDRESS 0xFFF82B5B /end MEASUREMENT
/begin MEASUREMENT ZFEH_EepromData.ydiMemory_xau16[11].amb_cond.ambient_condition[1][11] "ambient condition shot [0 .. 2-1] with 25 data bytes [0 .. 25-1] for the error code stored in this error memory slot" UBYTE EH_STANDARD_S5_S3 1 100 0 255 DISPLAY_IDENTIFIER ambient_condition[1][11].amb_cond.ydiMemory_xau16[11].ZFEH_EepromData ECU_ADDRESS 0xFFF82B5C /end MEASUREMENT
/begin MEASUREMENT ZFEH_EepromData.ydiMemory_xau16[11].amb_cond.ambient_condition[1][12] "ambient condition shot [0 .. 2-1] with 25 data bytes [0 .. 25-1] for the error code stored in this error memory slot" UBYTE EH_STANDARD_S5_S3 1 100 0 255 DISPLAY_IDENTIFIER ambient_condition[1][12].amb_cond.ydiMemory_xau16[11].ZFEH_EepromData ECU_ADDRESS 0xFFF82B5D /end MEASUREMENT
/begin MEASUREMENT ZFEH_EepromData.ydiMemory_xau16[11].amb_cond.ambient_condition[1][13] "ambient condition shot [0 .. 2-1] with 25 data bytes [0 .. 25-1] for the error code stored in this error memory slot" UBYTE EH_STANDARD_S5_S3 1 100 0 255 DISPLAY_IDENTIFIER ambient_condition[1][13].amb_cond.ydiMemory_xau16[11].ZFEH_EepromData ECU_ADDRESS 0xFFF82B5E /end MEASUREMENT
/begin MEASUREMENT ZFEH_EepromData.ydiMemory_xau16[11].amb_cond.ambient_condition[1][14] "ambient condition shot [0 .. 2-1] with 25 data bytes [0 .. 25-1] for the error code stored in this error memory slot" UBYTE EH_STANDARD_S5_S3 1 100 0 255 DISPLAY_IDENTIFIER ambient_condition[1][14].amb_cond.ydiMemory_xau16[11].ZFEH_EepromData ECU_ADDRESS 0xFFF82B5F /end MEASUREMENT
/begin MEASUREMENT ZFEH_EepromData.ydiMemory_xau16[11].amb_cond.ambient_condition[1][15] "ambient condition shot [0 .. 2-1] with 25 data bytes [0 .. 25-1] for the error code stored in this error memory slot" UBYTE EH_STANDARD_S5_S3 1 100 0 255 DISPLAY_IDENTIFIER ambient_condition[1][15].amb_cond.ydiMemory_xau16[11].ZFEH_EepromData ECU_ADDRESS 0xFFF82B60 /end MEASUREMENT
/begin MEASUREMENT ZFEH_EepromData.ydiMemory_xau16[11].amb_cond.ambient_condition[1][16] "ambient condition shot [0 .. 2-1] with 25 data bytes [0 .. 25-1] for the error code stored in this error memory slot" UBYTE EH_STANDARD_S5_S3 1 100 0 255 DISPLAY_IDENTIFIER ambient_condition[1][16].amb_cond.ydiMemory_xau16[11].ZFEH_EepromData ECU_ADDRESS 0xFFF82B61 /end MEASUREMENT
/begin MEASUREMENT ZFEH_EepromData.ydiMemory_xau16[11].amb_cond.ambient_condition[1][17] "ambient condition shot [0 .. 2-1] with 25 data bytes [0 .. 25-1] for the error code stored in this error memory slot" UBYTE EH_STANDARD_S5_S3 1 100 0 255 DISPLAY_IDENTIFIER ambient_condition[1][17].amb_cond.ydiMemory_xau16[11].ZFEH_EepromData ECU_ADDRESS 0xFFF82B62 /end MEASUREMENT
/begin MEASUREMENT ZFEH_EepromData.ydiMemory_xau16[11].amb_cond.ambient_condition[1][18] "ambient condition shot [0 .. 2-1] with 25 data bytes [0 .. 25-1] for the error code stored in this error memory slot" UBYTE EH_STANDARD_S5_S3 1 100 0 255 DISPLAY_IDENTIFIER ambient_condition[1][18].amb_cond.ydiMemory_xau16[11].ZFEH_EepromData ECU_ADDRESS 0xFFF82B63 /end MEASUREMENT
/begin MEASUREMENT ZFEH_EepromData.ydiMemory_xau16[11].amb_cond.ambient_condition[1][19] "ambient condition shot [0 .. 2-1] with 25 data bytes [0 .. 25-1] for the error code stored in this error memory slot" UBYTE EH_STANDARD_S5_S3 1 100 0 255 DISPLAY_IDENTIFIER ambient_condition[1][19].amb_cond.ydiMemory_xau16[11].ZFEH_EepromData ECU_ADDRESS 0xFFF82B64 /end MEASUREMENT
/begin MEASUREMENT ZFEH_EepromData.ydiMemory_xau16[11].amb_cond.ambient_condition[1][20] "ambient condition shot [0 .. 2-1] with 25 data bytes [0 .. 25-1] for the error code stored in this error memory slot" UBYTE EH_STANDARD_S5_S3 1 100 0 255 DISPLAY_IDENTIFIER ambient_condition[1][20].amb_cond.ydiMemory_xau16[11].ZFEH_EepromData ECU_ADDRESS 0xFFF82B65 /end MEASUREMENT
/begin MEASUREMENT ZFEH_EepromData.ydiMemory_xau16[11].amb_cond.ambient_condition[1][21] "ambient condition shot [0 .. 2-1] with 25 data bytes [0 .. 25-1] for the error code stored in this error memory slot" UBYTE EH_STANDARD_S5_S3 1 100 0 255 DISPLAY_IDENTIFIER ambient_condition[1][21].amb_cond.ydiMemory_xau16[11].ZFEH_EepromData ECU_ADDRESS 0xFFF82B66 /end MEASUREMENT
/begin MEASUREMENT ZFEH_EepromData.ydiMemory_xau16[11].amb_cond.ambient_condition[1][22] "ambient condition shot [0 .. 2-1] with 25 data bytes [0 .. 25-1] for the error code stored in this error memory slot" UBYTE EH_STANDARD_S5_S3 1 100 0 255 DISPLAY_IDENTIFIER ambient_condition[1][22].amb_cond.ydiMemory_xau16[11].ZFEH_EepromData ECU_ADDRESS 0xFFF82B67 /end MEASUREMENT
/begin MEASUREMENT ZFEH_EepromData.ydiMemory_xau16[11].amb_cond.ambient_condition[1][23] "ambient condition shot [0 .. 2-1] with 25 data bytes [0 .. 25-1] for the error code stored in this error memory slot" UBYTE EH_STANDARD_S5_S3 1 100 0 255 DISPLAY_IDENTIFIER ambient_condition[1][23].amb_cond.ydiMemory_xau16[11].ZFEH_EepromData ECU_ADDRESS 0xFFF82B68 /end MEASUREMENT
/begin MEASUREMENT ZFEH_EepromData.ydiMemory_xau16[11].amb_cond.ambient_condition[1][24] "ambient condition shot [0 .. 2-1] with 25 data bytes [0 .. 25-1] for the error code stored in this error memory slot" UBYTE EH_STANDARD_S5_S3 1 100 0 255 DISPLAY_IDENTIFIER ambient_condition[1][24].amb_cond.ydiMemory_xau16[11].ZFEH_EepromData ECU_ADDRESS 0xFFF82B69 /end MEASUREMENT
/begin MEASUREMENT ZFEH_EepromData.ydiMemory_xau16[11].amb_cond.status_of_ambient_conditions[0] "status of ambient condition shot x: 0=invalid 1=valid" UBYTE EH_STANDARD_S5_S3 1 100 0 1 DISPLAY_IDENTIFIER status_of_ambient_conditions[0].amb_cond.ydiMemory_xau16[11].ZFEH_EepromData ECU_ADDRESS 0xFFF82B6A /end MEASUREMENT
/begin MEASUREMENT ZFEH_EepromData.ydiMemory_xau16[11].amb_cond.status_of_ambient_conditions[1] "status of ambient condition shot x: 0=invalid 1=valid" UBYTE EH_STANDARD_S5_S3 1 100 0 1 DISPLAY_IDENTIFIER status_of_ambient_conditions[1].amb_cond.ydiMemory_xau16[11].ZFEH_EepromData ECU_ADDRESS 0xFFF82B6B /end MEASUREMENT
/begin MEASUREMENT ZFEH_EepromData.ydiMemory_xau16[11].error_code "error code stored in error memory slot" UWORD CONV_KFC_NAME 0 255 0 65535 DISPLAY_IDENTIFIER error_code.ydiMemory_xau16[11].ZFEH_EepromData ECU_ADDRESS 0xFFF82B24 /end MEASUREMENT
/begin MEASUREMENT ZFEH_EepromData.ydiMemory_xau16[11].error_type "error type of error code stored in error memory slot" UWORD EH_STANDARD_S5_S3 1 100 0 65535 DISPLAY_IDENTIFIER error_type.ydiMemory_xau16[11].ZFEH_EepromData ECU_ADDRESS 0xFFF82B26 /end MEASUREMENT
/begin MEASUREMENT ZFEH_EepromData.ydiMemory_xau16[11].status_word "status word of error code stored in error memory slot" UWORD EH_STANDARD_S5_S3 1 100 0 65535 DISPLAY_IDENTIFIER status_word.ydiMemory_xau16[11].ZFEH_EepromData ECU_ADDRESS 0xFFF82B28 /end MEASUREMENT
/begin MEASUREMENT ZFEH_EepromData.ydiMemory_xau16[11].frequency_counter "frequency counter of error code stored in error memory slot" UBYTE EH_STANDARD_S5_S3 1 100 0 255 DISPLAY_IDENTIFIER frequency_counter.ydiMemory_xau16[11].ZFEH_EepromData ECU_ADDRESS 0xFFF82B2A /end MEASUREMENT
/begin MEASUREMENT ZFEH_EepromData.ydiMemory_xau16[11].backwards_counter "backwards counter of error code stored in error memory slot" UBYTE EH_STANDARD_S5_S3 1 100 0 255 DISPLAY_IDENTIFIER backwards_counter.ydiMemory_xau16[11].ZFEH_EepromData ECU_ADDRESS 0xFFF82B2B /end MEASUREMENT
/begin MEASUREMENT ZFEH_EepromData.ydiMemory_xau16[11].permanent_counter "counter of permanent error codes stored in error memory slot" UBYTE EH_STANDARD_S5_S3 1 100 0 255 DISPLAY_IDENTIFIER permanent_counter.ydiMemory_xau16[11].ZFEH_EepromData ECU_ADDRESS 0xFFF82B2C /end MEASUREMENT
/begin MEASUREMENT ZFEH_EepromData.ydiMemory_xau16[11].sequence_counter "sequence counter of error code stored in error memory slot" UBYTE EH_STANDARD_S5_S3 1 100 0 255 DISPLAY_IDENTIFIER sequence_counter.ydiMemory_xau16[11].ZFEH_EepromData ECU_ADDRESS 0xFFF82B2D /end MEASUREMENT
/begin MEASUREMENT ZFEH_EepromData.ydiMemory_xau16[11].master_time "master time of error code stored in error memory slot" ULONG EH_STANDARD_S5_S3 1 100 0 4294967295 DISPLAY_IDENTIFIER master_time.ydiMemory_xau16[11].ZFEH_EepromData ECU_ADDRESS 0xFFF82B30 /end MEASUREMENT
/begin MEASUREMENT ZFEH_EepromData.ydiMemory_xau16[11].condition_byte "condition byte of error code stored in error memory slot" UBYTE EH_STANDARD_S5_S3 1 100 0 255 DISPLAY_IDENTIFIER condition_byte.ydiMemory_xau16[11].ZFEH_EepromData ECU_ADDRESS 0xFFF82B35 /end MEASUREMENT
/begin MEASUREMENT ZFEH_EepromData.ydiMemory_xau16[11].obd_driving_cycle_counter "obd driving cycle counter of error code stored in error memory slot" UWORD EH_STANDARD_S5_S3 1 100 0 65535 DISPLAY_IDENTIFIER obd_driving_cycle_counter.ydiMemory_xau16[11].ZFEH_EepromData ECU_ADDRESS 0xFFF82B36 /end MEASUREMENT
/begin MEASUREMENT ZFEH_EepromData.ydiMemory_xau16[12].amb_cond.ambient_condition[0][0] "ambient condition shot [0 .. 2-1] with 25 data bytes [0 .. 25-1] for the error code stored in this error memory slot" UBYTE EH_STANDARD_S5_S3 1 100 0 255 DISPLAY_IDENTIFIER ambient_condition[0][0].amb_cond.ydiMemory_xau16[12].ZFEH_EepromData ECU_ADDRESS 0xFFF82B80 /end MEASUREMENT
/begin MEASUREMENT ZFEH_EepromData.ydiMemory_xau16[12].amb_cond.ambient_condition[0][1] "ambient condition shot [0 .. 2-1] with 25 data bytes [0 .. 25-1] for the error code stored in this error memory slot" UBYTE EH_STANDARD_S5_S3 1 100 0 255 DISPLAY_IDENTIFIER ambient_condition[0][1].amb_cond.ydiMemory_xau16[12].ZFEH_EepromData ECU_ADDRESS 0xFFF82B81 /end MEASUREMENT
/begin MEASUREMENT ZFEH_EepromData.ydiMemory_xau16[12].amb_cond.ambient_condition[0][2] "ambient condition shot [0 .. 2-1] with 25 data bytes [0 .. 25-1] for the error code stored in this error memory slot" UBYTE EH_STANDARD_S5_S3 1 100 0 255 DISPLAY_IDENTIFIER ambient_condition[0][2].amb_cond.ydiMemory_xau16[12].ZFEH_EepromData ECU_ADDRESS 0xFFF82B82 /end MEASUREMENT
/begin MEASUREMENT ZFEH_EepromData.ydiMemory_xau16[12].amb_cond.ambient_condition[0][3] "ambient condition shot [0 .. 2-1] with 25 data bytes [0 .. 25-1] for the error code stored in this error memory slot" UBYTE EH_STANDARD_S5_S3 1 100 0 255 DISPLAY_IDENTIFIER ambient_condition[0][3].amb_cond.ydiMemory_xau16[12].ZFEH_EepromData ECU_ADDRESS 0xFFF82B83 /end MEASUREMENT
/begin MEASUREMENT ZFEH_EepromData.ydiMemory_xau16[12].amb_cond.ambient_condition[0][4] "ambient condition shot [0 .. 2-1] with 25 data bytes [0 .. 25-1] for the error code stored in this error memory slot" UBYTE EH_STANDARD_S5_S3 1 100 0 255 DISPLAY_IDENTIFIER ambient_condition[0][4].amb_cond.ydiMemory_xau16[12].ZFEH_EepromData ECU_ADDRESS 0xFFF82B84 /end MEASUREMENT
/begin MEASUREMENT ZFEH_EepromData.ydiMemory_xau16[12].amb_cond.ambient_condition[0][5] "ambient condition shot [0 .. 2-1] with 25 data bytes [0 .. 25-1] for the error code stored in this error memory slot" UBYTE EH_STANDARD_S5_S3 1 100 0 255 DISPLAY_IDENTIFIER ambient_condition[0][5].amb_cond.ydiMemory_xau16[12].ZFEH_EepromData ECU_ADDRESS 0xFFF82B85 /end MEASUREMENT
/begin MEASUREMENT ZFEH_EepromData.ydiMemory_xau16[12].amb_cond.ambient_condition[0][6] "ambient condition shot [0 .. 2-1] with 25 data bytes [0 .. 25-1] for the error code stored in this error memory slot" UBYTE EH_STANDARD_S5_S3 1 100 0 255 DISPLAY_IDENTIFIER ambient_condition[0][6].amb_cond.ydiMemory_xau16[12].ZFEH_EepromData ECU_ADDRESS 0xFFF82B86 /end MEASUREMENT
/begin MEASUREMENT ZFEH_EepromData.ydiMemory_xau16[12].amb_cond.ambient_condition[0][7] "ambient condition shot [0 .. 2-1] with 25 data bytes [0 .. 25-1] for the error code stored in this error memory slot" UBYTE EH_STANDARD_S5_S3 1 100 0 255 DISPLAY_IDENTIFIER ambient_condition[0][7].amb_cond.ydiMemory_xau16[12].ZFEH_EepromData ECU_ADDRESS 0xFFF82B87 /end MEASUREMENT
/begin MEASUREMENT ZFEH_EepromData.ydiMemory_xau16[12].amb_cond.ambient_condition[0][8] "ambient condition shot [0 .. 2-1] with 25 data bytes [0 .. 25-1] for the error code stored in this error memory slot" UBYTE EH_STANDARD_S5_S3 1 100 0 255 DISPLAY_IDENTIFIER ambient_condition[0][8].amb_cond.ydiMemory_xau16[12].ZFEH_EepromData ECU_ADDRESS 0xFFF82B88 /end MEASUREMENT
/begin MEASUREMENT ZFEH_EepromData.ydiMemory_xau16[12].amb_cond.ambient_condition[0][9] "ambient condition shot [0 .. 2-1] with 25 data bytes [0 .. 25-1] for the error code stored in this error memory slot" UBYTE EH_STANDARD_S5_S3 1 100 0 255 DISPLAY_IDENTIFIER ambient_condition[0][9].amb_cond.ydiMemory_xau16[12].ZFEH_EepromData ECU_ADDRESS 0xFFF82B89 /end MEASUREMENT
/begin MEASUREMENT ZFEH_EepromData.ydiMemory_xau16[12].amb_cond.ambient_condition[0][10] "ambient condition shot [0 .. 2-1] with 25 data bytes [0 .. 25-1] for the error code stored in this error memory slot" UBYTE EH_STANDARD_S5_S3 1 100 0 255 DISPLAY_IDENTIFIER ambient_condition[0][10].amb_cond.ydiMemory_xau16[12].ZFEH_EepromData ECU_ADDRESS 0xFFF82B8A /end MEASUREMENT
/begin MEASUREMENT ZFEH_EepromData.ydiMemory_xau16[12].amb_cond.ambient_condition[0][11] "ambient condition shot [0 .. 2-1] with 25 data bytes [0 .. 25-1] for the error code stored in this error memory slot" UBYTE EH_STANDARD_S5_S3 1 100 0 255 DISPLAY_IDENTIFIER ambient_condition[0][11].amb_cond.ydiMemory_xau16[12].ZFEH_EepromData ECU_ADDRESS 0xFFF82B8B /end MEASUREMENT
/begin MEASUREMENT ZFEH_EepromData.ydiMemory_xau16[12].amb_cond.ambient_condition[0][12] "ambient condition shot [0 .. 2-1] with 25 data bytes [0 .. 25-1] for the error code stored in this error memory slot" UBYTE EH_STANDARD_S5_S3 1 100 0 255 DISPLAY_IDENTIFIER ambient_condition[0][12].amb_cond.ydiMemory_xau16[12].ZFEH_EepromData ECU_ADDRESS 0xFFF82B8C /end MEASUREMENT
/begin MEASUREMENT ZFEH_EepromData.ydiMemory_xau16[12].amb_cond.ambient_condition[0][13] "ambient condition shot [0 .. 2-1] with 25 data bytes [0 .. 25-1] for the error code stored in this error memory slot" UBYTE EH_STANDARD_S5_S3 1 100 0 255 DISPLAY_IDENTIFIER ambient_condition[0][13].amb_cond.ydiMemory_xau16[12].ZFEH_EepromData ECU_ADDRESS 0xFFF82B8D /end MEASUREMENT
/begin MEASUREMENT ZFEH_EepromData.ydiMemory_xau16[12].amb_cond.ambient_condition[0][14] "ambient condition shot [0 .. 2-1] with 25 data bytes [0 .. 25-1] for the error code stored in this error memory slot" UBYTE EH_STANDARD_S5_S3 1 100 0 255 DISPLAY_IDENTIFIER ambient_condition[0][14].amb_cond.ydiMemory_xau16[12].ZFEH_EepromData ECU_ADDRESS 0xFFF82B8E /end MEASUREMENT
/begin MEASUREMENT ZFEH_EepromData.ydiMemory_xau16[12].amb_cond.ambient_condition[0][15] "ambient condition shot [0 .. 2-1] with 25 data bytes [0 .. 25-1] for the error code stored in this error memory slot" UBYTE EH_STANDARD_S5_S3 1 100 0 255 DISPLAY_IDENTIFIER ambient_condition[0][15].amb_cond.ydiMemory_xau16[12].ZFEH_EepromData ECU_ADDRESS 0xFFF82B8F /end MEASUREMENT
/begin MEASUREMENT ZFEH_EepromData.ydiMemory_xau16[12].amb_cond.ambient_condition[0][16] "ambient condition shot [0 .. 2-1] with 25 data bytes [0 .. 25-1] for the error code stored in this error memory slot" UBYTE EH_STANDARD_S5_S3 1 100 0 255 DISPLAY_IDENTIFIER ambient_condition[0][16].amb_cond.ydiMemory_xau16[12].ZFEH_EepromData ECU_ADDRESS 0xFFF82B90 /end MEASUREMENT
/begin MEASUREMENT ZFEH_EepromData.ydiMemory_xau16[12].amb_cond.ambient_condition[0][17] "ambient condition shot [0 .. 2-1] with 25 data bytes [0 .. 25-1] for the error code stored in this error memory slot" UBYTE EH_STANDARD_S5_S3 1 100 0 255 DISPLAY_IDENTIFIER ambient_condition[0][17].amb_cond.ydiMemory_xau16[12].ZFEH_EepromData ECU_ADDRESS 0xFFF82B91 /end MEASUREMENT
/begin MEASUREMENT ZFEH_EepromData.ydiMemory_xau16[12].amb_cond.ambient_condition[0][18] "ambient condition shot [0 .. 2-1] with 25 data bytes [0 .. 25-1] for the error code stored in this error memory slot" UBYTE EH_STANDARD_S5_S3 1 100 0 255 DISPLAY_IDENTIFIER ambient_condition[0][18].amb_cond.ydiMemory_xau16[12].ZFEH_EepromData ECU_ADDRESS 0xFFF82B92 /end MEASUREMENT
/begin MEASUREMENT ZFEH_EepromData.ydiMemory_xau16[12].amb_cond.ambient_condition[0][19] "ambient condition shot [0 .. 2-1] with 25 data bytes [0 .. 25-1] for the error code stored in this error memory slot" UBYTE EH_STANDARD_S5_S3 1 100 0 255 DISPLAY_IDENTIFIER ambient_condition[0][19].amb_cond.ydiMemory_xau16[12].ZFEH_EepromData ECU_ADDRESS 0xFFF82B93 /end MEASUREMENT
/begin MEASUREMENT ZFEH_EepromData.ydiMemory_xau16[12].amb_cond.ambient_condition[0][20] "ambient condition shot [0 .. 2-1] with 25 data bytes [0 .. 25-1] for the error code stored in this error memory slot" UBYTE EH_STANDARD_S5_S3 1 100 0 255 DISPLAY_IDENTIFIER ambient_condition[0][20].amb_cond.ydiMemory_xau16[12].ZFEH_EepromData ECU_ADDRESS 0xFFF82B94 /end MEASUREMENT
/begin MEASUREMENT ZFEH_EepromData.ydiMemory_xau16[12].amb_cond.ambient_condition[0][21] "ambient condition shot [0 .. 2-1] with 25 data bytes [0 .. 25-1] for the error code stored in this error memory slot" UBYTE EH_STANDARD_S5_S3 1 100 0 255 DISPLAY_IDENTIFIER ambient_condition[0][21].amb_cond.ydiMemory_xau16[12].ZFEH_EepromData ECU_ADDRESS 0xFFF82B95 /end MEASUREMENT
/begin MEASUREMENT ZFEH_EepromData.ydiMemory_xau16[12].amb_cond.ambient_condition[0][22] "ambient condition shot [0 .. 2-1] with 25 data bytes [0 .. 25-1] for the error code stored in this error memory slot" UBYTE EH_STANDARD_S5_S3 1 100 0 255 DISPLAY_IDENTIFIER ambient_condition[0][22].amb_cond.ydiMemory_xau16[12].ZFEH_EepromData ECU_ADDRESS 0xFFF82B96 /end MEASUREMENT
/begin MEASUREMENT ZFEH_EepromData.ydiMemory_xau16[12].amb_cond.ambient_condition[0][23] "ambient condition shot [0 .. 2-1] with 25 data bytes [0 .. 25-1] for the error code stored in this error memory slot" UBYTE EH_STANDARD_S5_S3 1 100 0 255 DISPLAY_IDENTIFIER ambient_condition[0][23].amb_cond.ydiMemory_xau16[12].ZFEH_EepromData ECU_ADDRESS 0xFFF82B97 /end MEASUREMENT
/begin MEASUREMENT ZFEH_EepromData.ydiMemory_xau16[12].amb_cond.ambient_condition[0][24] "ambient condition shot [0 .. 2-1] with 25 data bytes [0 .. 25-1] for the error code stored in this error memory slot" UBYTE EH_STANDARD_S5_S3 1 100 0 255 DISPLAY_IDENTIFIER ambient_condition[0][24].amb_cond.ydiMemory_xau16[12].ZFEH_EepromData ECU_ADDRESS 0xFFF82B98 /end MEASUREMENT
/begin MEASUREMENT ZFEH_EepromData.ydiMemory_xau16[12].amb_cond.ambient_condition[1][0] "ambient condition shot [0 .. 2-1] with 25 data bytes [0 .. 25-1] for the error code stored in this error memory slot" UBYTE EH_STANDARD_S5_S3 1 100 0 255 DISPLAY_IDENTIFIER ambient_condition[1][0].amb_cond.ydiMemory_xau16[12].ZFEH_EepromData ECU_ADDRESS 0xFFF82B99 /end MEASUREMENT
/begin MEASUREMENT ZFEH_EepromData.ydiMemory_xau16[12].amb_cond.ambient_condition[1][1] "ambient condition shot [0 .. 2-1] with 25 data bytes [0 .. 25-1] for the error code stored in this error memory slot" UBYTE EH_STANDARD_S5_S3 1 100 0 255 DISPLAY_IDENTIFIER ambient_condition[1][1].amb_cond.ydiMemory_xau16[12].ZFEH_EepromData ECU_ADDRESS 0xFFF82B9A /end MEASUREMENT
/begin MEASUREMENT ZFEH_EepromData.ydiMemory_xau16[12].amb_cond.ambient_condition[1][2] "ambient condition shot [0 .. 2-1] with 25 data bytes [0 .. 25-1] for the error code stored in this error memory slot" UBYTE EH_STANDARD_S5_S3 1 100 0 255 DISPLAY_IDENTIFIER ambient_condition[1][2].amb_cond.ydiMemory_xau16[12].ZFEH_EepromData ECU_ADDRESS 0xFFF82B9B /end MEASUREMENT
/begin MEASUREMENT ZFEH_EepromData.ydiMemory_xau16[12].amb_cond.ambient_condition[1][3] "ambient condition shot [0 .. 2-1] with 25 data bytes [0 .. 25-1] for the error code stored in this error memory slot" UBYTE EH_STANDARD_S5_S3 1 100 0 255 DISPLAY_IDENTIFIER ambient_condition[1][3].amb_cond.ydiMemory_xau16[12].ZFEH_EepromData ECU_ADDRESS 0xFFF82B9C /end MEASUREMENT
/begin MEASUREMENT ZFEH_EepromData.ydiMemory_xau16[12].amb_cond.ambient_condition[1][4] "ambient condition shot [0 .. 2-1] with 25 data bytes [0 .. 25-1] for the error code stored in this error memory slot" UBYTE EH_STANDARD_S5_S3 1 100 0 255 DISPLAY_IDENTIFIER ambient_condition[1][4].amb_cond.ydiMemory_xau16[12].ZFEH_EepromData ECU_ADDRESS 0xFFF82B9D /end MEASUREMENT
/begin MEASUREMENT ZFEH_EepromData.ydiMemory_xau16[12].amb_cond.ambient_condition[1][5] "ambient condition shot [0 .. 2-1] with 25 data bytes [0 .. 25-1] for the error code stored in this error memory slot" UBYTE EH_STANDARD_S5_S3 1 100 0 255 DISPLAY_IDENTIFIER ambient_condition[1][5].amb_cond.ydiMemory_xau16[12].ZFEH_EepromData ECU_ADDRESS 0xFFF82B9E /end MEASUREMENT
/begin MEASUREMENT ZFEH_EepromData.ydiMemory_xau16[12].amb_cond.ambient_condition[1][6] "ambient condition shot [0 .. 2-1] with 25 data bytes [0 .. 25-1] for the error code stored in this error memory slot" UBYTE EH_STANDARD_S5_S3 1 100 0 255 DISPLAY_IDENTIFIER ambient_condition[1][6].amb_cond.ydiMemory_xau16[12].ZFEH_EepromData ECU_ADDRESS 0xFFF82B9F /end MEASUREMENT
/begin MEASUREMENT ZFEH_EepromData.ydiMemory_xau16[12].amb_cond.ambient_condition[1][7] "ambient condition shot [0 .. 2-1] with 25 data bytes [0 .. 25-1] for the error code stored in this error memory slot" UBYTE EH_STANDARD_S5_S3 1 100 0 255 DISPLAY_IDENTIFIER ambient_condition[1][7].amb_cond.ydiMemory_xau16[12].ZFEH_EepromData ECU_ADDRESS 0xFFF82BA0 /end MEASUREMENT
/begin MEASUREMENT ZFEH_EepromData.ydiMemory_xau16[12].amb_cond.ambient_condition[1][8] "ambient condition shot [0 .. 2-1] with 25 data bytes [0 .. 25-1] for the error code stored in this error memory slot" UBYTE EH_STANDARD_S5_S3 1 100 0 255 DISPLAY_IDENTIFIER ambient_condition[1][8].amb_cond.ydiMemory_xau16[12].ZFEH_EepromData ECU_ADDRESS 0xFFF82BA1 /end MEASUREMENT
/begin MEASUREMENT ZFEH_EepromData.ydiMemory_xau16[12].amb_cond.ambient_condition[1][9] "ambient condition shot [0 .. 2-1] with 25 data bytes [0 .. 25-1] for the error code stored in this error memory slot" UBYTE EH_STANDARD_S5_S3 1 100 0 255 DISPLAY_IDENTIFIER ambient_condition[1][9].amb_cond.ydiMemory_xau16[12].ZFEH_EepromData ECU_ADDRESS 0xFFF82BA2 /end MEASUREMENT
/begin MEASUREMENT ZFEH_EepromData.ydiMemory_xau16[12].amb_cond.ambient_condition[1][10] "ambient condition shot [0 .. 2-1] with 25 data bytes [0 .. 25-1] for the error code stored in this error memory slot" UBYTE EH_STANDARD_S5_S3 1 100 0 255 DISPLAY_IDENTIFIER ambient_condition[1][10].amb_cond.ydiMemory_xau16[12].ZFEH_EepromData ECU_ADDRESS 0xFFF82BA3 /end MEASUREMENT
/begin MEASUREMENT ZFEH_EepromData.ydiMemory_xau16[12].amb_cond.ambient_condition[1][11] "ambient condition shot [0 .. 2-1] with 25 data bytes [0 .. 25-1] for the error code stored in this error memory slot" UBYTE EH_STANDARD_S5_S3 1 100 0 255 DISPLAY_IDENTIFIER ambient_condition[1][11].amb_cond.ydiMemory_xau16[12].ZFEH_EepromData ECU_ADDRESS 0xFFF82BA4 /end MEASUREMENT
/begin MEASUREMENT ZFEH_EepromData.ydiMemory_xau16[12].amb_cond.ambient_condition[1][12] "ambient condition shot [0 .. 2-1] with 25 data bytes [0 .. 25-1] for the error code stored in this error memory slot" UBYTE EH_STANDARD_S5_S3 1 100 0 255 DISPLAY_IDENTIFIER ambient_condition[1][12].amb_cond.ydiMemory_xau16[12].ZFEH_EepromData ECU_ADDRESS 0xFFF82BA5 /end MEASUREMENT
/begin MEASUREMENT ZFEH_EepromData.ydiMemory_xau16[12].amb_cond.ambient_condition[1][13] "ambient condition shot [0 .. 2-1] with 25 data bytes [0 .. 25-1] for the error code stored in this error memory slot" UBYTE EH_STANDARD_S5_S3 1 100 0 255 DISPLAY_IDENTIFIER ambient_condition[1][13].amb_cond.ydiMemory_xau16[12].ZFEH_EepromData ECU_ADDRESS 0xFFF82BA6 /end MEASUREMENT
/begin MEASUREMENT ZFEH_EepromData.ydiMemory_xau16[12].amb_cond.ambient_condition[1][14] "ambient condition shot [0 .. 2-1] with 25 data bytes [0 .. 25-1] for the error code stored in this error memory slot" UBYTE EH_STANDARD_S5_S3 1 100 0 255 DISPLAY_IDENTIFIER ambient_condition[1][14].amb_cond.ydiMemory_xau16[12].ZFEH_EepromData ECU_ADDRESS 0xFFF82BA7 /end MEASUREMENT
/begin MEASUREMENT ZFEH_EepromData.ydiMemory_xau16[12].amb_cond.ambient_condition[1][15] "ambient condition shot [0 .. 2-1] with 25 data bytes [0 .. 25-1] for the error code stored in this error memory slot" UBYTE EH_STANDARD_S5_S3 1 100 0 255 DISPLAY_IDENTIFIER ambient_condition[1][15].amb_cond.ydiMemory_xau16[12].ZFEH_EepromData ECU_ADDRESS 0xFFF82BA8 /end MEASUREMENT
/begin MEASUREMENT ZFEH_EepromData.ydiMemory_xau16[12].amb_cond.ambient_condition[1][16] "ambient condition shot [0 .. 2-1] with 25 data bytes [0 .. 25-1] for the error code stored in this error memory slot" UBYTE EH_STANDARD_S5_S3 1 100 0 255 DISPLAY_IDENTIFIER ambient_condition[1][16].amb_cond.ydiMemory_xau16[12].ZFEH_EepromData ECU_ADDRESS 0xFFF82BA9 /end MEASUREMENT
/begin MEASUREMENT ZFEH_EepromData.ydiMemory_xau16[12].amb_cond.ambient_condition[1][17] "ambient condition shot [0 .. 2-1] with 25 data bytes [0 .. 25-1] for the error code stored in this error memory slot" UBYTE EH_STANDARD_S5_S3 1 100 0 255 DISPLAY_IDENTIFIER ambient_condition[1][17].amb_cond.ydiMemory_xau16[12].ZFEH_EepromData ECU_ADDRESS 0xFFF82BAA /end MEASUREMENT
/begin MEASUREMENT ZFEH_EepromData.ydiMemory_xau16[12].amb_cond.ambient_condition[1][18] "ambient condition shot [0 .. 2-1] with 25 data bytes [0 .. 25-1] for the error code stored in this error memory slot" UBYTE EH_STANDARD_S5_S3 1 100 0 255 DISPLAY_IDENTIFIER ambient_condition[1][18].amb_cond.ydiMemory_xau16[12].ZFEH_EepromData ECU_ADDRESS 0xFFF82BAB /end MEASUREMENT
/begin MEASUREMENT ZFEH_EepromData.ydiMemory_xau16[12].amb_cond.ambient_condition[1][19] "ambient condition shot [0 .. 2-1] with 25 data bytes [0 .. 25-1] for the error code stored in this error memory slot" UBYTE EH_STANDARD_S5_S3 1 100 0 255 DISPLAY_IDENTIFIER ambient_condition[1][19].amb_cond.ydiMemory_xau16[12].ZFEH_EepromData ECU_ADDRESS 0xFFF82BAC /end MEASUREMENT
/begin MEASUREMENT ZFEH_EepromData.ydiMemory_xau16[12].amb_cond.ambient_condition[1][20] "ambient condition shot [0 .. 2-1] with 25 data bytes [0 .. 25-1] for the error code stored in this error memory slot" UBYTE EH_STANDARD_S5_S3 1 100 0 255 DISPLAY_IDENTIFIER ambient_condition[1][20].amb_cond.ydiMemory_xau16[12].ZFEH_EepromData ECU_ADDRESS 0xFFF82BAD /end MEASUREMENT
/begin MEASUREMENT ZFEH_EepromData.ydiMemory_xau16[12].amb_cond.ambient_condition[1][21] "ambient condition shot [0 .. 2-1] with 25 data bytes [0 .. 25-1] for the error code stored in this error memory slot" UBYTE EH_STANDARD_S5_S3 1 100 0 255 DISPLAY_IDENTIFIER ambient_condition[1][21].amb_cond.ydiMemory_xau16[12].ZFEH_EepromData ECU_ADDRESS 0xFFF82BAE /end MEASUREMENT
/begin MEASUREMENT ZFEH_EepromData.ydiMemory_xau16[12].amb_cond.ambient_condition[1][22] "ambient condition shot [0 .. 2-1] with 25 data bytes [0 .. 25-1] for the error code stored in this error memory slot" UBYTE EH_STANDARD_S5_S3 1 100 0 255 DISPLAY_IDENTIFIER ambient_condition[1][22].amb_cond.ydiMemory_xau16[12].ZFEH_EepromData ECU_ADDRESS 0xFFF82BAF /end MEASUREMENT
/begin MEASUREMENT ZFEH_EepromData.ydiMemory_xau16[12].amb_cond.ambient_condition[1][23] "ambient condition shot [0 .. 2-1] with 25 data bytes [0 .. 25-1] for the error code stored in this error memory slot" UBYTE EH_STANDARD_S5_S3 1 100 0 255 DISPLAY_IDENTIFIER ambient_condition[1][23].amb_cond.ydiMemory_xau16[12].ZFEH_EepromData ECU_ADDRESS 0xFFF82BB0 /end MEASUREMENT
/begin MEASUREMENT ZFEH_EepromData.ydiMemory_xau16[12].amb_cond.ambient_condition[1][24] "ambient condition shot [0 .. 2-1] with 25 data bytes [0 .. 25-1] for the error code stored in this error memory slot" UBYTE EH_STANDARD_S5_S3 1 100 0 255 DISPLAY_IDENTIFIER ambient_condition[1][24].amb_cond.ydiMemory_xau16[12].ZFEH_EepromData ECU_ADDRESS 0xFFF82BB1 /end MEASUREMENT
/begin MEASUREMENT ZFEH_EepromData.ydiMemory_xau16[12].amb_cond.status_of_ambient_conditions[0] "status of ambient condition shot x: 0=invalid 1=valid" UBYTE EH_STANDARD_S5_S3 1 100 0 1 DISPLAY_IDENTIFIER status_of_ambient_conditions[0].amb_cond.ydiMemory_xau16[12].ZFEH_EepromData ECU_ADDRESS 0xFFF82BB2 /end MEASUREMENT
/begin MEASUREMENT ZFEH_EepromData.ydiMemory_xau16[12].amb_cond.status_of_ambient_conditions[1] "status of ambient condition shot x: 0=invalid 1=valid" UBYTE EH_STANDARD_S5_S3 1 100 0 1 DISPLAY_IDENTIFIER status_of_ambient_conditions[1].amb_cond.ydiMemory_xau16[12].ZFEH_EepromData ECU_ADDRESS 0xFFF82BB3 /end MEASUREMENT
/begin MEASUREMENT ZFEH_EepromData.ydiMemory_xau16[12].error_code "error code stored in error memory slot" UWORD CONV_KFC_NAME 0 255 0 65535 DISPLAY_IDENTIFIER error_code.ydiMemory_xau16[12].ZFEH_EepromData ECU_ADDRESS 0xFFF82B6C /end MEASUREMENT
/begin MEASUREMENT ZFEH_EepromData.ydiMemory_xau16[12].error_type "error type of error code stored in error memory slot" UWORD EH_STANDARD_S5_S3 1 100 0 65535 DISPLAY_IDENTIFIER error_type.ydiMemory_xau16[12].ZFEH_EepromData ECU_ADDRESS 0xFFF82B6E /end MEASUREMENT
/begin MEASUREMENT ZFEH_EepromData.ydiMemory_xau16[12].status_word "status word of error code stored in error memory slot" UWORD EH_STANDARD_S5_S3 1 100 0 65535 DISPLAY_IDENTIFIER status_word.ydiMemory_xau16[12].ZFEH_EepromData ECU_ADDRESS 0xFFF82B70 /end MEASUREMENT
/begin MEASUREMENT ZFEH_EepromData.ydiMemory_xau16[12].frequency_counter "frequency counter of error code stored in error memory slot" UBYTE EH_STANDARD_S5_S3 1 100 0 255 DISPLAY_IDENTIFIER frequency_counter.ydiMemory_xau16[12].ZFEH_EepromData ECU_ADDRESS 0xFFF82B72 /end MEASUREMENT
/begin MEASUREMENT ZFEH_EepromData.ydiMemory_xau16[12].backwards_counter "backwards counter of error code stored in error memory slot" UBYTE EH_STANDARD_S5_S3 1 100 0 255 DISPLAY_IDENTIFIER backwards_counter.ydiMemory_xau16[12].ZFEH_EepromData ECU_ADDRESS 0xFFF82B73 /end MEASUREMENT
/begin MEASUREMENT ZFEH_EepromData.ydiMemory_xau16[12].permanent_counter "counter of permanent error codes stored in error memory slot" UBYTE EH_STANDARD_S5_S3 1 100 0 255 DISPLAY_IDENTIFIER permanent_counter.ydiMemory_xau16[12].ZFEH_EepromData ECU_ADDRESS 0xFFF82B74 /end MEASUREMENT
/begin MEASUREMENT ZFEH_EepromData.ydiMemory_xau16[12].sequence_counter "sequence counter of error code stored in error memory slot" UBYTE EH_STANDARD_S5_S3 1 100 0 255 DISPLAY_IDENTIFIER sequence_counter.ydiMemory_xau16[12].ZFEH_EepromData ECU_ADDRESS 0xFFF82B75 /end MEASUREMENT
/begin MEASUREMENT ZFEH_EepromData.ydiMemory_xau16[12].master_time "master time of error code stored in error memory slot" ULONG EH_STANDARD_S5_S3 1 100 0 4294967295 DISPLAY_IDENTIFIER master_time.ydiMemory_xau16[12].ZFEH_EepromData ECU_ADDRESS 0xFFF82B78 /end MEASUREMENT
/begin MEASUREMENT ZFEH_EepromData.ydiMemory_xau16[12].condition_byte "condition byte of error code stored in error memory slot" UBYTE EH_STANDARD_S5_S3 1 100 0 255 DISPLAY_IDENTIFIER condition_byte.ydiMemory_xau16[12].ZFEH_EepromData ECU_ADDRESS 0xFFF82B7D /end MEASUREMENT
/begin MEASUREMENT ZFEH_EepromData.ydiMemory_xau16[12].obd_driving_cycle_counter "obd driving cycle counter of error code stored in error memory slot" UWORD EH_STANDARD_S5_S3 1 100 0 65535 DISPLAY_IDENTIFIER obd_driving_cycle_counter.ydiMemory_xau16[12].ZFEH_EepromData ECU_ADDRESS 0xFFF82B7E /end MEASUREMENT
/begin MEASUREMENT ZFEH_EepromData.ydiMemory_xau16[13].amb_cond.ambient_condition[0][0] "ambient condition shot [0 .. 2-1] with 25 data bytes [0 .. 25-1] for the error code stored in this error memory slot" UBYTE EH_STANDARD_S5_S3 1 100 0 255 DISPLAY_IDENTIFIER ambient_condition[0][0].amb_cond.ydiMemory_xau16[13].ZFEH_EepromData ECU_ADDRESS 0xFFF82BC8 /end MEASUREMENT
/begin MEASUREMENT ZFEH_EepromData.ydiMemory_xau16[13].amb_cond.ambient_condition[0][10] "ambient condition shot [0 .. 2-1] with 25 data bytes [0 .. 25-1] for the error code stored in this error memory slot" UBYTE EH_STANDARD_S5_S3 1 100 0 255 DISPLAY_IDENTIFIER ambient_condition[0][10].amb_cond.ydiMemory_xau16[13].ZFEH_EepromData ECU_ADDRESS 0xFFF82BD2 /end MEASUREMENT
/begin MEASUREMENT ZFEH_EepromData.ydiMemory_xau16[13].amb_cond.ambient_condition[0][11] "ambient condition shot [0 .. 2-1] with 25 data bytes [0 .. 25-1] for the error code stored in this error memory slot" UBYTE EH_STANDARD_S5_S3 1 100 0 255 DISPLAY_IDENTIFIER ambient_condition[0][11].amb_cond.ydiMemory_xau16[13].ZFEH_EepromData ECU_ADDRESS 0xFFF82BD3 /end MEASUREMENT
/begin MEASUREMENT ZFEH_EepromData.ydiMemory_xau16[13].amb_cond.ambient_condition[0][12] "ambient condition shot [0 .. 2-1] with 25 data bytes [0 .. 25-1] for the error code stored in this error memory slot" UBYTE EH_STANDARD_S5_S3 1 100 0 255 DISPLAY_IDENTIFIER ambient_condition[0][12].amb_cond.ydiMemory_xau16[13].ZFEH_EepromData ECU_ADDRESS 0xFFF82BD4 /end MEASUREMENT
/begin MEASUREMENT ZFEH_EepromData.ydiMemory_xau16[13].amb_cond.ambient_condition[0][13] "ambient condition shot [0 .. 2-1] with 25 data bytes [0 .. 25-1] for the error code stored in this error memory slot" UBYTE EH_STANDARD_S5_S3 1 100 0 255 DISPLAY_IDENTIFIER ambient_condition[0][13].amb_cond.ydiMemory_xau16[13].ZFEH_EepromData ECU_ADDRESS 0xFFF82BD5 /end MEASUREMENT
/begin MEASUREMENT ZFEH_EepromData.ydiMemory_xau16[13].amb_cond.ambient_condition[0][14] "ambient condition shot [0 .. 2-1] with 25 data bytes [0 .. 25-1] for the error code stored in this error memory slot" UBYTE EH_STANDARD_S5_S3 1 100 0 255 DISPLAY_IDENTIFIER ambient_condition[0][14].amb_cond.ydiMemory_xau16[13].ZFEH_EepromData ECU_ADDRESS 0xFFF82BD6 /end MEASUREMENT
/begin MEASUREMENT ZFEH_EepromData.ydiBackupMemory_xau16[6].amb_cond.ambient_condition[1][8] "ambient condition shot [0 .. 2-1] with 25 data bytes [0 .. 25-1] for the error code stored in this error memory slot" UBYTE EH_STANDARD_S5_S3 1 100 0 255 DISPLAY_IDENTIFIER ambient_condition[1][8].amb_cond.ydiBackupMemory_xau16[6].ZFEH_EepromData ECU_ADDRESS 0xFFF82F91 /end MEASUREMENT
/begin MEASUREMENT ZFEH_EepromData.ydiBackupMemory_xau16[6].amb_cond.ambient_condition[1][9] "ambient condition shot [0 .. 2-1] with 25 data bytes [0 .. 25-1] for the error code stored in this error memory slot" UBYTE EH_STANDARD_S5_S3 1 100 0 255 DISPLAY_IDENTIFIER ambient_condition[1][9].amb_cond.ydiBackupMemory_xau16[6].ZFEH_EepromData ECU_ADDRESS 0xFFF82F92 /end MEASUREMENT
/begin MEASUREMENT ZFEH_EepromData.ydiBackupMemory_xau16[6].amb_cond.status_of_ambient_conditions[0] "status of ambient condition shot x: 0=invalid 1=valid" UBYTE EH_STANDARD_S5_S3 1 100 0 1 DISPLAY_IDENTIFIER status_of_ambient_conditions[0].amb_cond.ydiBackupMemory_xau16[6].ZFEH_EepromData ECU_ADDRESS 0xFFF82FA2 /end MEASUREMENT
/begin MEASUREMENT ZFEH_EepromData.ydiBackupMemory_xau16[6].amb_cond.status_of_ambient_conditions[1] "status of ambient condition shot x: 0=invalid 1=valid" UBYTE EH_STANDARD_S5_S3 1 100 0 1 DISPLAY_IDENTIFIER status_of_ambient_conditions[1].amb_cond.ydiBackupMemory_xau16[6].ZFEH_EepromData ECU_ADDRESS 0xFFF82FA3 /end MEASUREMENT
/begin MEASUREMENT ZFEH_EepromData.ydiBackupMemory_xau16[6].error_code "error code stored in error memory slot" UWORD EH_STANDARD_S5_S3 1 100 0 65535 DISPLAY_IDENTIFIER error_code.ydiBackupMemory_xau16[6].ZFEH_EepromData ECU_ADDRESS 0xFFF82F5C /end MEASUREMENT
/begin MEASUREMENT ZFEH_EepromData.ydiBackupMemory_xau16[6].error_type "error type of error code stored in error memory slot" UWORD EH_STANDARD_S5_S3 1 100 0 65535 DISPLAY_IDENTIFIER error_type.ydiBackupMemory_xau16[6].ZFEH_EepromData ECU_ADDRESS 0xFFF82F5E /end MEASUREMENT
/begin MEASUREMENT ZFEH_EepromData.ydiBackupMemory_xau16[6].status_word "status word of error code stored in error memory slot" UWORD EH_STANDARD_S5_S3 1 100 0 65535 DISPLAY_IDENTIFIER status_word.ydiBackupMemory_xau16[6].ZFEH_EepromData ECU_ADDRESS 0xFFF82F60 /end MEASUREMENT
/begin MEASUREMENT ZFEH_EepromData.ydiBackupMemory_xau16[6].frequency_counter "frequency counter of error code stored in error memory slot" UBYTE EH_STANDARD_S5_S3 1 100 0 255 DISPLAY_IDENTIFIER frequency_counter.ydiBackupMemory_xau16[6].ZFEH_EepromData ECU_ADDRESS 0xFFF82F62 /end MEASUREMENT
/begin MEASUREMENT ZFEH_EepromData.ydiBackupMemory_xau16[6].backwards_counter "backwards counter of error code stored in error memory slot" UBYTE EH_STANDARD_S5_S3 1 100 0 255 DISPLAY_IDENTIFIER backwards_counter.ydiBackupMemory_xau16[6].ZFEH_EepromData ECU_ADDRESS 0xFFF82F63 /end MEASUREMENT
/begin MEASUREMENT ZFEH_EepromData.ydiBackupMemory_xau16[6].permanent_counter "counter of permanent error codes stored in error memory slot" UBYTE EH_STANDARD_S5_S3 1 100 0 255 DISPLAY_IDENTIFIER permanent_counter.ydiBackupMemory_xau16[6].ZFEH_EepromData ECU_ADDRESS 0xFFF82F64 /end MEASUREMENT
/begin MEASUREMENT ZFEH_EepromData.ydiBackupMemory_xau16[6].sequence_counter "sequence counter of error code stored in error memory slot" UBYTE EH_STANDARD_S5_S3 1 100 0 255 DISPLAY_IDENTIFIER sequence_counter.ydiBackupMemory_xau16[6].ZFEH_EepromData ECU_ADDRESS 0xFFF82F65 /end MEASUREMENT
/begin MEASUREMENT ZFEH_EepromData.ydiBackupMemory_xau16[6].master_time "master time of error code stored in error memory slot" ULONG EH_STANDARD_S5_S3 1 100 0 4294967295 DISPLAY_IDENTIFIER master_time.ydiBackupMemory_xau16[6].ZFEH_EepromData ECU_ADDRESS 0xFFF82F68 /end MEASUREMENT
/begin MEASUREMENT ZFEH_EepromData.ydiBackupMemory_xau16[6].condition_byte "condition byte of error code stored in error memory slot" UBYTE EH_STANDARD_S5_S3 1 100 0 255 DISPLAY_IDENTIFIER condition_byte.ydiBackupMemory_xau16[6].ZFEH_EepromData ECU_ADDRESS 0xFFF82F6D /end MEASUREMENT
/begin MEASUREMENT ZFEH_EepromData.ydiBackupMemory_xau16[6].obd_driving_cycle_counter "obd driving cycle counter of error code stored in error memory slot" UWORD EH_STANDARD_S5_S3 1 100 0 65535 DISPLAY_IDENTIFIER obd_driving_cycle_counter.ydiBackupMemory_xau16[6].ZFEH_EepromData ECU_ADDRESS 0xFFF82F6E /end MEASUREMENT
/begin MEASUREMENT ZFEH_EepromData.ydiBackupMemory_xau16[7].amb_cond.ambient_condition[0][0] "ambient condition shot [0 .. 2-1] with 25 data bytes [0 .. 25-1] for the error code stored in this error memory slot" UBYTE EH_STANDARD_S5_S3 1 100 0 255 DISPLAY_IDENTIFIER ambient_condition[0][0].amb_cond.ydiBackupMemory_xau16[7].ZFEH_EepromData ECU_ADDRESS 0xFFF82FB8 /end MEASUREMENT
/begin MEASUREMENT ZFEH_EepromData.ydiBackupMemory_xau16[7].amb_cond.ambient_condition[0][1] "ambient condition shot [0 .. 2-1] with 25 data bytes [0 .. 25-1] for the error code stored in this error memory slot" UBYTE EH_STANDARD_S5_S3 1 100 0 255 DISPLAY_IDENTIFIER ambient_condition[0][1].amb_cond.ydiBackupMemory_xau16[7].ZFEH_EepromData ECU_ADDRESS 0xFFF82FB9 /end MEASUREMENT
/begin MEASUREMENT ZFEH_EepromData.ydiBackupMemory_xau16[7].amb_cond.ambient_condition[0][2] "ambient condition shot [0 .. 2-1] with 25 data bytes [0 .. 25-1] for the error code stored in this error memory slot" UBYTE EH_STANDARD_S5_S3 1 100 0 255 DISPLAY_IDENTIFIER ambient_condition[0][2].amb_cond.ydiBackupMemory_xau16[7].ZFEH_EepromData ECU_ADDRESS 0xFFF82FBA /end MEASUREMENT
/begin MEASUREMENT ZFEH_EepromData.ydiBackupMemory_xau16[7].amb_cond.ambient_condition[0][3] "ambient condition shot [0 .. 2-1] with 25 data bytes [0 .. 25-1] for the error code stored in this error memory slot" UBYTE EH_STANDARD_S5_S3 1 100 0 255 DISPLAY_IDENTIFIER ambient_condition[0][3].amb_cond.ydiBackupMemory_xau16[7].ZFEH_EepromData ECU_ADDRESS 0xFFF82FBB /end MEASUREMENT
/begin MEASUREMENT ZFEH_EepromData.ydiBackupMemory_xau16[7].amb_cond.ambient_condition[0][4] "ambient condition shot [0 .. 2-1] with 25 data bytes [0 .. 25-1] for the error code stored in this error memory slot" UBYTE EH_STANDARD_S5_S3 1 100 0 255 DISPLAY_IDENTIFIER ambient_condition[0][4].amb_cond.ydiBackupMemory_xau16[7].ZFEH_EepromData ECU_ADDRESS 0xFFF82FBC /end MEASUREMENT
/begin MEASUREMENT ZFEH_EepromData.ydiBackupMemory_xau16[7].amb_cond.ambient_condition[0][5] "ambient condition shot [0 .. 2-1] with 25 data bytes [0 .. 25-1] for the error code stored in this error memory slot" UBYTE EH_STANDARD_S5_S3 1 100 0 255 DISPLAY_IDENTIFIER ambient_condition[0][5].amb_cond.ydiBackupMemory_xau16[7].ZFEH_EepromData ECU_ADDRESS 0xFFF82FBD /end MEASUREMENT
/begin MEASUREMENT ZFEH_EepromData.ydiBackupMemory_xau16[7].amb_cond.ambient_condition[0][6] "ambient condition shot [0 .. 2-1] with 25 data bytes [0 .. 25-1] for the error code stored in this error memory slot" UBYTE EH_STANDARD_S5_S3 1 100 0 255 DISPLAY_IDENTIFIER ambient_condition[0][6].amb_cond.ydiBackupMemory_xau16[7].ZFEH_EepromData ECU_ADDRESS 0xFFF82FBE /end MEASUREMENT
/begin MEASUREMENT ZFEH_EepromData.ydiBackupMemory_xau16[7].amb_cond.ambient_condition[0][7] "ambient condition shot [0 .. 2-1] with 25 data bytes [0 .. 25-1] for the error code stored in this error memory slot" UBYTE EH_STANDARD_S5_S3 1 100 0 255 DISPLAY_IDENTIFIER ambient_condition[0][7].amb_cond.ydiBackupMemory_xau16[7].ZFEH_EepromData ECU_ADDRESS 0xFFF82FBF /end MEASUREMENT
/begin MEASUREMENT ZFEH_EepromData.ydiBackupMemory_xau16[7].amb_cond.ambient_condition[0][8] "ambient condition shot [0 .. 2-1] with 25 data bytes [0 .. 25-1] for the error code stored in this error memory slot" UBYTE EH_STANDARD_S5_S3 1 100 0 255 DISPLAY_IDENTIFIER ambient_condition[0][8].amb_cond.ydiBackupMemory_xau16[7].ZFEH_EepromData ECU_ADDRESS 0xFFF82FC0 /end MEASUREMENT
/begin MEASUREMENT ZFEH_EepromData.ydiBackupMemory_xau16[7].amb_cond.ambient_condition[0][9] "ambient condition shot [0 .. 2-1] with 25 data bytes [0 .. 25-1] for the error code stored in this error memory slot" UBYTE EH_STANDARD_S5_S3 1 100 0 255 DISPLAY_IDENTIFIER ambient_condition[0][9].amb_cond.ydiBackupMemory_xau16[7].ZFEH_EepromData ECU_ADDRESS 0xFFF82FC1 /end MEASUREMENT
/begin MEASUREMENT ZFEH_EepromData.ydiBackupMemory_xau16[7].amb_cond.ambient_condition[0][10] "ambient condition shot [0 .. 2-1] with 25 data bytes [0 .. 25-1] for the error code stored in this error memory slot" UBYTE EH_STANDARD_S5_S3 1 100 0 255 DISPLAY_IDENTIFIER ambient_condition[0][10].amb_cond.ydiBackupMemory_xau16[7].ZFEH_EepromData ECU_ADDRESS 0xFFF82FC2 /end MEASUREMENT
/begin MEASUREMENT ZFEH_EepromData.ydiBackupMemory_xau16[7].amb_cond.ambient_condition[0][11] "ambient condition shot [0 .. 2-1] with 25 data bytes [0 .. 25-1] for the error code stored in this error memory slot" UBYTE EH_STANDARD_S5_S3 1 100 0 255 DISPLAY_IDENTIFIER ambient_condition[0][11].amb_cond.ydiBackupMemory_xau16[7].ZFEH_EepromData ECU_ADDRESS 0xFFF82FC3 /end MEASUREMENT
/begin MEASUREMENT ZFEH_EepromData.ydiBackupMemory_xau16[7].amb_cond.ambient_condition[0][12] "ambient condition shot [0 .. 2-1] with 25 data bytes [0 .. 25-1] for the error code stored in this error memory slot" UBYTE EH_STANDARD_S5_S3 1 100 0 255 DISPLAY_IDENTIFIER ambient_condition[0][12].amb_cond.ydiBackupMemory_xau16[7].ZFEH_EepromData ECU_ADDRESS 0xFFF82FC4 /end MEASUREMENT
/begin MEASUREMENT ZFEH_EepromData.ydiBackupMemory_xau16[7].amb_cond.ambient_condition[0][13] "ambient condition shot [0 .. 2-1] with 25 data bytes [0 .. 25-1] for the error code stored in this error memory slot" UBYTE EH_STANDARD_S5_S3 1 100 0 255 DISPLAY_IDENTIFIER ambient_condition[0][13].amb_cond.ydiBackupMemory_xau16[7].ZFEH_EepromData ECU_ADDRESS 0xFFF82FC5 /end MEASUREMENT
/begin MEASUREMENT ZFEH_EepromData.ydiBackupMemory_xau16[7].amb_cond.ambient_condition[0][14] "ambient condition shot [0 .. 2-1] with 25 data bytes [0 .. 25-1] for the error code stored in this error memory slot" UBYTE EH_STANDARD_S5_S3 1 100 0 255 DISPLAY_IDENTIFIER ambient_condition[0][14].amb_cond.ydiBackupMemory_xau16[7].ZFEH_EepromData ECU_ADDRESS 0xFFF82FC6 /end MEASUREMENT
/begin MEASUREMENT ZFEH_EepromData.ydiBackupMemory_xau16[7].amb_cond.ambient_condition[0][15] "ambient condition shot [0 .. 2-1] with 25 data bytes [0 .. 25-1] for the error code stored in this error memory slot" UBYTE EH_STANDARD_S5_S3 1 100 0 255 DISPLAY_IDENTIFIER ambient_condition[0][15].amb_cond.ydiBackupMemory_xau16[7].ZFEH_EepromData ECU_ADDRESS 0xFFF82FC7 /end MEASUREMENT
/begin MEASUREMENT ZFEH_EepromData.ydiBackupMemory_xau16[7].amb_cond.ambient_condition[0][16] "ambient condition shot [0 .. 2-1] with 25 data bytes [0 .. 25-1] for the error code stored in this error memory slot" UBYTE EH_STANDARD_S5_S3 1 100 0 255 DISPLAY_IDENTIFIER ambient_condition[0][16].amb_cond.ydiBackupMemory_xau16[7].ZFEH_EepromData ECU_ADDRESS 0xFFF82FC8 /end MEASUREMENT
/begin MEASUREMENT ZFEH_EepromData.ydiBackupMemory_xau16[7].amb_cond.ambient_condition[0][17] "ambient condition shot [0 .. 2-1] with 25 data bytes [0 .. 25-1] for the error code stored in this error memory slot" UBYTE EH_STANDARD_S5_S3 1 100 0 255 DISPLAY_IDENTIFIER ambient_condition[0][17].amb_cond.ydiBackupMemory_xau16[7].ZFEH_EepromData ECU_ADDRESS 0xFFF82FC9 /end MEASUREMENT
/begin MEASUREMENT ZFEH_EepromData.ydiBackupMemory_xau16[7].amb_cond.ambient_condition[0][18] "ambient condition shot [0 .. 2-1] with 25 data bytes [0 .. 25-1] for the error code stored in this error memory slot" UBYTE EH_STANDARD_S5_S3 1 100 0 255 DISPLAY_IDENTIFIER ambient_condition[0][18].amb_cond.ydiBackupMemory_xau16[7].ZFEH_EepromData ECU_ADDRESS 0xFFF82FCA /end MEASUREMENT
/begin MEASUREMENT ZFEH_EepromData.ydiBackupMemory_xau16[7].amb_cond.ambient_condition[0][19] "ambient condition shot [0 .. 2-1] with 25 data bytes [0 .. 25-1] for the error code stored in this error memory slot" UBYTE EH_STANDARD_S5_S3 1 100 0 255 DISPLAY_IDENTIFIER ambient_condition[0][19].amb_cond.ydiBackupMemory_xau16[7].ZFEH_EepromData ECU_ADDRESS 0xFFF82FCB /end MEASUREMENT
/begin MEASUREMENT ZFEH_EepromData.ydiBackupMemory_xau16[7].amb_cond.ambient_condition[0][20] "ambient condition shot [0 .. 2-1] with 25 data bytes [0 .. 25-1] for the error code stored in this error memory slot" UBYTE EH_STANDARD_S5_S3 1 100 0 255 DISPLAY_IDENTIFIER ambient_condition[0][20].amb_cond.ydiBackupMemory_xau16[7].ZFEH_EepromData ECU_ADDRESS 0xFFF82FCC /end MEASUREMENT
/begin MEASUREMENT ZFEH_EepromData.ydiBackupMemory_xau16[7].amb_cond.ambient_condition[0][21] "ambient condition shot [0 .. 2-1] with 25 data bytes [0 .. 25-1] for the error code stored in this error memory slot" UBYTE EH_STANDARD_S5_S3 1 100 0 255 DISPLAY_IDENTIFIER ambient_condition[0][21].amb_cond.ydiBackupMemory_xau16[7].ZFEH_EepromData ECU_ADDRESS 0xFFF82FCD /end MEASUREMENT
/begin MEASUREMENT ZFEH_EepromData.ydiBackupMemory_xau16[7].amb_cond.ambient_condition[0][22] "ambient condition shot [0 .. 2-1] with 25 data bytes [0 .. 25-1] for the error code stored in this error memory slot" UBYTE EH_STANDARD_S5_S3 1 100 0 255 DISPLAY_IDENTIFIER ambient_condition[0][22].amb_cond.ydiBackupMemory_xau16[7].ZFEH_EepromData ECU_ADDRESS 0xFFF82FCE /end MEASUREMENT
/begin MEASUREMENT ZFEH_EepromData.ydiBackupMemory_xau16[7].amb_cond.ambient_condition[0][23] "ambient condition shot [0 .. 2-1] with 25 data bytes [0 .. 25-1] for the error code stored in this error memory slot" UBYTE EH_STANDARD_S5_S3 1 100 0 255 DISPLAY_IDENTIFIER ambient_condition[0][23].amb_cond.ydiBackupMemory_xau16[7].ZFEH_EepromData ECU_ADDRESS 0xFFF82FCF /end MEASUREMENT
/begin MEASUREMENT ZFEH_EepromData.ydiBackupMemory_xau16[7].amb_cond.ambient_condition[0][24] "ambient condition shot [0 .. 2-1] with 25 data bytes [0 .. 25-1] for the error code stored in this error memory slot" UBYTE EH_STANDARD_S5_S3 1 100 0 255 DISPLAY_IDENTIFIER ambient_condition[0][24].amb_cond.ydiBackupMemory_xau16[7].ZFEH_EepromData ECU_ADDRESS 0xFFF82FD0 /end MEASUREMENT
/begin MEASUREMENT ZFEH_EepromData.ydiBackupMemory_xau16[7].amb_cond.ambient_condition[1][0] "ambient condition shot [0 .. 2-1] with 25 data bytes [0 .. 25-1] for the error code stored in this error memory slot" UBYTE EH_STANDARD_S5_S3 1 100 0 255 DISPLAY_IDENTIFIER ambient_condition[1][0].amb_cond.ydiBackupMemory_xau16[7].ZFEH_EepromData ECU_ADDRESS 0xFFF82FD1 /end MEASUREMENT
/begin MEASUREMENT ZFEH_EepromData.ydiBackupMemory_xau16[7].amb_cond.ambient_condition[1][1] "ambient condition shot [0 .. 2-1] with 25 data bytes [0 .. 25-1] for the error code stored in this error memory slot" UBYTE EH_STANDARD_S5_S3 1 100 0 255 DISPLAY_IDENTIFIER ambient_condition[1][1].amb_cond.ydiBackupMemory_xau16[7].ZFEH_EepromData ECU_ADDRESS 0xFFF82FD2 /end MEASUREMENT
/begin MEASUREMENT ZFEH_EepromData.ydiBackupMemory_xau16[7].amb_cond.ambient_condition[1][2] "ambient condition shot [0 .. 2-1] with 25 data bytes [0 .. 25-1] for the error code stored in this error memory slot" UBYTE EH_STANDARD_S5_S3 1 100 0 255 DISPLAY_IDENTIFIER ambient_condition[1][2].amb_cond.ydiBackupMemory_xau16[7].ZFEH_EepromData ECU_ADDRESS 0xFFF82FD3 /end MEASUREMENT
/begin MEASUREMENT ZFEH_EepromData.ydiBackupMemory_xau16[7].amb_cond.ambient_condition[1][3] "ambient condition shot [0 .. 2-1] with 25 data bytes [0 .. 25-1] for the error code stored in this error memory slot" UBYTE EH_STANDARD_S5_S3 1 100 0 255 DISPLAY_IDENTIFIER ambient_condition[1][3].amb_cond.ydiBackupMemory_xau16[7].ZFEH_EepromData ECU_ADDRESS 0xFFF82FD4 /end MEASUREMENT
/begin MEASUREMENT ZFEH_EepromData.ydiBackupMemory_xau16[7].amb_cond.ambient_condition[1][4] "ambient condition shot [0 .. 2-1] with 25 data bytes [0 .. 25-1] for the error code stored in this error memory slot" UBYTE EH_STANDARD_S5_S3 1 100 0 255 DISPLAY_IDENTIFIER ambient_condition[1][4].amb_cond.ydiBackupMemory_xau16[7].ZFEH_EepromData ECU_ADDRESS 0xFFF82FD5 /end MEASUREMENT
/begin MEASUREMENT ZFEH_EepromData.ydiBackupMemory_xau16[7].amb_cond.ambient_condition[1][5] "ambient condition shot [0 .. 2-1] with 25 data bytes [0 .. 25-1] for the error code stored in this error memory slot" UBYTE EH_STANDARD_S5_S3 1 100 0 255 DISPLAY_IDENTIFIER ambient_condition[1][5].amb_cond.ydiBackupMemory_xau16[7].ZFEH_EepromData ECU_ADDRESS 0xFFF82FD6 /end MEASUREMENT
/begin MEASUREMENT ZFEH_EepromData.ydiBackupMemory_xau16[7].amb_cond.ambient_condition[1][6] "ambient condition shot [0 .. 2-1] with 25 data bytes [0 .. 25-1] for the error code stored in this error memory slot" UBYTE EH_STANDARD_S5_S3 1 100 0 255 DISPLAY_IDENTIFIER ambient_condition[1][6].amb_cond.ydiBackupMemory_xau16[7].ZFEH_EepromData ECU_ADDRESS 0xFFF82FD7 /end MEASUREMENT
/begin MEASUREMENT ZFEH_EepromData.ydiBackupMemory_xau16[7].amb_cond.ambient_condition[1][7] "ambient condition shot [0 .. 2-1] with 25 data bytes [0 .. 25-1] for the error code stored in this error memory slot" UBYTE EH_STANDARD_S5_S3 1 100 0 255 DISPLAY_IDENTIFIER ambient_condition[1][7].amb_cond.ydiBackupMemory_xau16[7].ZFEH_EepromData ECU_ADDRESS 0xFFF82FD8 /end MEASUREMENT
/begin MEASUREMENT ZFEH_EepromData.ydiBackupMemory_xau16[7].amb_cond.ambient_condition[1][8] "ambient condition shot [0 .. 2-1] with 25 data bytes [0 .. 25-1] for the error code stored in this error memory slot" UBYTE EH_STANDARD_S5_S3 1 100 0 255 DISPLAY_IDENTIFIER ambient_condition[1][8].amb_cond.ydiBackupMemory_xau16[7].ZFEH_EepromData ECU_ADDRESS 0xFFF82FD9 /end MEASUREMENT
/begin MEASUREMENT ZFEH_EepromData.ydiBackupMemory_xau16[7].amb_cond.ambient_condition[1][9] "ambient condition shot [0 .. 2-1] with 25 data bytes [0 .. 25-1] for the error code stored in this error memory slot" UBYTE EH_STANDARD_S5_S3 1 100 0 255 DISPLAY_IDENTIFIER ambient_condition[1][9].amb_cond.ydiBackupMemory_xau16[7].ZFEH_EepromData ECU_ADDRESS 0xFFF82FDA /end MEASUREMENT
/begin MEASUREMENT ZFEH_EepromData.ydiBackupMemory_xau16[7].amb_cond.ambient_condition[1][10] "ambient condition shot [0 .. 2-1] with 25 data bytes [0 .. 25-1] for the error code stored in this error memory slot" UBYTE EH_STANDARD_S5_S3 1 100 0 255 DISPLAY_IDENTIFIER ambient_condition[1][10].amb_cond.ydiBackupMemory_xau16[7].ZFEH_EepromData ECU_ADDRESS 0xFFF82FDB /end MEASUREMENT
/begin MEASUREMENT ZFEH_EepromData.ydiBackupMemory_xau16[7].amb_cond.ambient_condition[1][11] "ambient condition shot [0 .. 2-1] with 25 data bytes [0 .. 25-1] for the error code stored in this error memory slot" UBYTE EH_STANDARD_S5_S3 1 100 0 255 DISPLAY_IDENTIFIER ambient_condition[1][11].amb_cond.ydiBackupMemory_xau16[7].ZFEH_EepromData ECU_ADDRESS 0xFFF82FDC /end MEASUREMENT
/begin MEASUREMENT ZFEH_EepromData.ydiBackupMemory_xau16[7].amb_cond.ambient_condition[1][12] "ambient condition shot [0 .. 2-1] with 25 data bytes [0 .. 25-1] for the error code stored in this error memory slot" UBYTE EH_STANDARD_S5_S3 1 100 0 255 DISPLAY_IDENTIFIER ambient_condition[1][12].amb_cond.ydiBackupMemory_xau16[7].ZFEH_EepromData ECU_ADDRESS 0xFFF82FDD /end MEASUREMENT
/begin MEASUREMENT ZFEH_EepromData.ydiBackupMemory_xau16[7].amb_cond.ambient_condition[1][13] "ambient condition shot [0 .. 2-1] with 25 data bytes [0 .. 25-1] for the error code stored in this error memory slot" UBYTE EH_STANDARD_S5_S3 1 100 0 255 DISPLAY_IDENTIFIER ambient_condition[1][13].amb_cond.ydiBackupMemory_xau16[7].ZFEH_EepromData ECU_ADDRESS 0xFFF82FDE /end MEASUREMENT
/begin MEASUREMENT ZFEH_EepromData.ydiBackupMemory_xau16[7].amb_cond.ambient_condition[1][14] "ambient condition shot [0 .. 2-1] with 25 data bytes [0 .. 25-1] for the error code stored in this error memory slot" UBYTE EH_STANDARD_S5_S3 1 100 0 255 DISPLAY_IDENTIFIER ambient_condition[1][14].amb_cond.ydiBackupMemory_xau16[7].ZFEH_EepromData ECU_ADDRESS 0xFFF82FDF /end MEASUREMENT
/begin MEASUREMENT ZFEH_EepromData.ydiBackupMemory_xau16[7].amb_cond.ambient_condition[1][15] "ambient condition shot [0 .. 2-1] with 25 data bytes [0 .. 25-1] for the error code stored in this error memory slot" UBYTE EH_STANDARD_S5_S3 1 100 0 255 DISPLAY_IDENTIFIER ambient_condition[1][15].amb_cond.ydiBackupMemory_xau16[7].ZFEH_EepromData ECU_ADDRESS 0xFFF82FE0 /end MEASUREMENT
/begin MEASUREMENT ZFEH_EepromData.ydiBackupMemory_xau16[7].amb_cond.ambient_condition[1][16] "ambient condition shot [0 .. 2-1] with 25 data bytes [0 .. 25-1] for the error code stored in this error memory slot" UBYTE EH_STANDARD_S5_S3 1 100 0 255 DISPLAY_IDENTIFIER ambient_condition[1][16].amb_cond.ydiBackupMemory_xau16[7].ZFEH_EepromData ECU_ADDRESS 0xFFF82FE1 /end MEASUREMENT
/begin MEASUREMENT ZFEH_EepromData.ydiBackupMemory_xau16[7].amb_cond.ambient_condition[1][17] "ambient condition shot [0 .. 2-1] with 25 data bytes [0 .. 25-1] for the error code stored in this error memory slot" UBYTE EH_STANDARD_S5_S3 1 100 0 255 DISPLAY_IDENTIFIER ambient_condition[1][17].amb_cond.ydiBackupMemory_xau16[7].ZFEH_EepromData ECU_ADDRESS 0xFFF82FE2 /end MEASUREMENT
/begin MEASUREMENT ZFEH_EepromData.ydiBackupMemory_xau16[7].amb_cond.ambient_condition[1][18] "ambient condition shot [0 .. 2-1] with 25 data bytes [0 .. 25-1] for the error code stored in this error memory slot" UBYTE EH_STANDARD_S5_S3 1 100 0 255 DISPLAY_IDENTIFIER ambient_condition[1][18].amb_cond.ydiBackupMemory_xau16[7].ZFEH_EepromData ECU_ADDRESS 0xFFF82FE3 /end MEASUREMENT
/begin MEASUREMENT ZFEH_EepromData.ydiBackupMemory_xau16[7].amb_cond.ambient_condition[1][19] "ambient condition shot [0 .. 2-1] with 25 data bytes [0 .. 25-1] for the error code stored in this error memory slot" UBYTE EH_STANDARD_S5_S3 1 100 0 255 DISPLAY_IDENTIFIER ambient_condition[1][19].amb_cond.ydiBackupMemory_xau16[7].ZFEH_EepromData ECU_ADDRESS 0xFFF82FE4 /end MEASUREMENT
/begin MEASUREMENT ZFEH_EepromData.ydiBackupMemory_xau16[7].amb_cond.ambient_condition[1][20] "ambient condition shot [0 .. 2-1] with 25 data bytes [0 .. 25-1] for the error code stored in this error memory slot" UBYTE EH_STANDARD_S5_S3 1 100 0 255 DISPLAY_IDENTIFIER ambient_condition[1][20].amb_cond.ydiBackupMemory_xau16[7].ZFEH_EepromData ECU_ADDRESS 0xFFF82FE5 /end MEASUREMENT
/begin MEASUREMENT ZFEH_EepromData.ydiBackupMemory_xau16[7].amb_cond.ambient_condition[1][21] "ambient condition shot [0 .. 2-1] with 25 data bytes [0 .. 25-1] for the error code stored in this error memory slot" UBYTE EH_STANDARD_S5_S3 1 100 0 255 DISPLAY_IDENTIFIER ambient_condition[1][21].amb_cond.ydiBackupMemory_xau16[7].ZFEH_EepromData ECU_ADDRESS 0xFFF82FE6 /end MEASUREMENT
/begin MEASUREMENT ZFEH_EepromData.ydiBackupMemory_xau16[7].amb_cond.ambient_condition[1][22] "ambient condition shot [0 .. 2-1] with 25 data bytes [0 .. 25-1] for the error code stored in this error memory slot" UBYTE EH_STANDARD_S5_S3 1 100 0 255 DISPLAY_IDENTIFIER ambient_condition[1][22].amb_cond.ydiBackupMemory_xau16[7].ZFEH_EepromData ECU_ADDRESS 0xFFF82FE7 /end MEASUREMENT
/begin MEASUREMENT ZFEH_EepromData.ydiBackupMemory_xau16[7].amb_cond.ambient_condition[1][23] "ambient condition shot [0 .. 2-1] with 25 data bytes [0 .. 25-1] for the error code stored in this error memory slot" UBYTE EH_STANDARD_S5_S3 1 100 0 255 DISPLAY_IDENTIFIER ambient_condition[1][23].amb_cond.ydiBackupMemory_xau16[7].ZFEH_EepromData ECU_ADDRESS 0xFFF82FE8 /end MEASUREMENT
/begin MEASUREMENT ZFEH_EepromData.ydiBackupMemory_xau16[7].amb_cond.ambient_condition[1][24] "ambient condition shot [0 .. 2-1] with 25 data bytes [0 .. 25-1] for the error code stored in this error memory slot" UBYTE EH_STANDARD_S5_S3 1 100 0 255 DISPLAY_IDENTIFIER ambient_condition[1][24].amb_cond.ydiBackupMemory_xau16[7].ZFEH_EepromData ECU_ADDRESS 0xFFF82FE9 /end MEASUREMENT
/begin MEASUREMENT ZFEH_EepromData.ydiBackupMemory_xau16[7].amb_cond.status_of_ambient_conditions[0] "status of ambient condition shot x: 0=invalid 1=valid" UBYTE EH_STANDARD_S5_S3 1 100 0 1 DISPLAY_IDENTIFIER status_of_ambient_conditions[0].amb_cond.ydiBackupMemory_xau16[7].ZFEH_EepromData ECU_ADDRESS 0xFFF82FEA /end MEASUREMENT
/begin MEASUREMENT ZFEH_EepromData.ydiBackupMemory_xau16[7].amb_cond.status_of_ambient_conditions[1] "status of ambient condition shot x: 0=invalid 1=valid" UBYTE EH_STANDARD_S5_S3 1 100 0 1 DISPLAY_IDENTIFIER status_of_ambient_conditions[1].amb_cond.ydiBackupMemory_xau16[7].ZFEH_EepromData ECU_ADDRESS 0xFFF82FEB /end MEASUREMENT
/begin MEASUREMENT ZFEH_EepromData.ydiBackupMemory_xau16[7].error_code "error code stored in error memory slot" UWORD EH_STANDARD_S5_S3 1 100 0 65535 DISPLAY_IDENTIFIER error_code.ydiBackupMemory_xau16[7].ZFEH_EepromData ECU_ADDRESS 0xFFF82FA4 /end MEASUREMENT
/begin MEASUREMENT ZFEH_EepromData.ydiBackupMemory_xau16[7].error_type "error type of error code stored in error memory slot" UWORD EH_STANDARD_S5_S3 1 100 0 65535 DISPLAY_IDENTIFIER error_type.ydiBackupMemory_xau16[7].ZFEH_EepromData ECU_ADDRESS 0xFFF82FA6 /end MEASUREMENT
/begin MEASUREMENT ZFEH_EepromData.ydiBackupMemory_xau16[7].status_word "status word of error code stored in error memory slot" UWORD EH_STANDARD_S5_S3 1 100 0 65535 DISPLAY_IDENTIFIER status_word.ydiBackupMemory_xau16[7].ZFEH_EepromData ECU_ADDRESS 0xFFF82FA8 /end MEASUREMENT
/begin MEASUREMENT ZFEH_EepromData.ydiBackupMemory_xau16[7].frequency_counter "frequency counter of error code stored in error memory slot" UBYTE EH_STANDARD_S5_S3 1 100 0 255 DISPLAY_IDENTIFIER frequency_counter.ydiBackupMemory_xau16[7].ZFEH_EepromData ECU_ADDRESS 0xFFF82FAA /end MEASUREMENT
/begin MEASUREMENT ZFEH_EepromData.ydiBackupMemory_xau16[7].backwards_counter "backwards counter of error code stored in error memory slot" UBYTE EH_STANDARD_S5_S3 1 100 0 255 DISPLAY_IDENTIFIER backwards_counter.ydiBackupMemory_xau16[7].ZFEH_EepromData ECU_ADDRESS 0xFFF82FAB /end MEASUREMENT
/begin MEASUREMENT ZFEH_EepromData.ydiBackupMemory_xau16[7].permanent_counter "counter of permanent error codes stored in error memory slot" UBYTE EH_STANDARD_S5_S3 1 100 0 255 DISPLAY_IDENTIFIER permanent_counter.ydiBackupMemory_xau16[7].ZFEH_EepromData ECU_ADDRESS 0xFFF82FAC /end MEASUREMENT
/begin MEASUREMENT ZFEH_EepromData.ydiBackupMemory_xau16[7].sequence_counter "sequence counter of error code stored in error memory slot" UBYTE EH_STANDARD_S5_S3 1 100 0 255 DISPLAY_IDENTIFIER sequence_counter.ydiBackupMemory_xau16[7].ZFEH_EepromData ECU_ADDRESS 0xFFF82FAD /end MEASUREMENT
/begin MEASUREMENT ZFEH_EepromData.ydiBackupMemory_xau16[7].master_time "master time of error code stored in error memory slot" ULONG EH_STANDARD_S5_S3 1 100 0 4294967295 DISPLAY_IDENTIFIER master_time.ydiBackupMemory_xau16[7].ZFEH_EepromData ECU_ADDRESS 0xFFF82FB0 /end MEASUREMENT
/begin MEASUREMENT ZFEH_EepromData.ydiBackupMemory_xau16[7].condition_byte "condition byte of error code stored in error memory slot" UBYTE EH_STANDARD_S5_S3 1 100 0 255 DISPLAY_IDENTIFIER condition_byte.ydiBackupMemory_xau16[7].ZFEH_EepromData ECU_ADDRESS 0xFFF82FB5 /end MEASUREMENT
/begin MEASUREMENT ZFEH_EepromData.ydiBackupMemory_xau16[7].obd_driving_cycle_counter "obd driving cycle counter of error code stored in error memory slot" UWORD EH_STANDARD_S5_S3 1 100 0 65535 DISPLAY_IDENTIFIER obd_driving_cycle_counter.ydiBackupMemory_xau16[7].ZFEH_EepromData ECU_ADDRESS 0xFFF82FB6 /end MEASUREMENT
/begin MEASUREMENT ZFEH_EepromData.ydiBackupMemory_xau16[8].amb_cond.ambient_condition[0][0] "ambient condition shot [0 .. 2-1] with 25 data bytes [0 .. 25-1] for the error code stored in this error memory slot" UBYTE EH_STANDARD_S5_S3 1 100 0 255 DISPLAY_IDENTIFIER ambient_condition[0][0].amb_cond.ydiBackupMemory_xau16[8].ZFEH_EepromData ECU_ADDRESS 0xFFF83000 /end MEASUREMENT
/begin MEASUREMENT ZFEH_EepromData.ydiBackupMemory_xau16[8].amb_cond.ambient_condition[0][1] "ambient condition shot [0 .. 2-1] with 25 data bytes [0 .. 25-1] for the error code stored in this error memory slot" UBYTE EH_STANDARD_S5_S3 1 100 0 255 DISPLAY_IDENTIFIER ambient_condition[0][1].amb_cond.ydiBackupMemory_xau16[8].ZFEH_EepromData ECU_ADDRESS 0xFFF83001 /end MEASUREMENT
/begin MEASUREMENT ZFEH_EepromData.ydiBackupMemory_xau16[8].amb_cond.ambient_condition[0][2] "ambient condition shot [0 .. 2-1] with 25 data bytes [0 .. 25-1] for the error code stored in this error memory slot" UBYTE EH_STANDARD_S5_S3 1 100 0 255 DISPLAY_IDENTIFIER ambient_condition[0][2].amb_cond.ydiBackupMemory_xau16[8].ZFEH_EepromData ECU_ADDRESS 0xFFF83002 /end MEASUREMENT
/begin MEASUREMENT ZFEH_EepromData.ydiBackupMemory_xau16[8].amb_cond.ambient_condition[0][3] "ambient condition shot [0 .. 2-1] with 25 data bytes [0 .. 25-1] for the error code stored in this error memory slot" UBYTE EH_STANDARD_S5_S3 1 100 0 255 DISPLAY_IDENTIFIER ambient_condition[0][3].amb_cond.ydiBackupMemory_xau16[8].ZFEH_EepromData ECU_ADDRESS 0xFFF83003 /end MEASUREMENT
/begin MEASUREMENT ZFEH_EepromData.ydiBackupMemory_xau16[8].amb_cond.ambient_condition[0][4] "ambient condition shot [0 .. 2-1] with 25 data bytes [0 .. 25-1] for the error code stored in this error memory slot" UBYTE EH_STANDARD_S5_S3 1 100 0 255 DISPLAY_IDENTIFIER ambient_condition[0][4].amb_cond.ydiBackupMemory_xau16[8].ZFEH_EepromData ECU_ADDRESS 0xFFF83004 /end MEASUREMENT
/begin MEASUREMENT ZFEH_EepromData.ydiBackupMemory_xau16[8].amb_cond.ambient_condition[0][5] "ambient condition shot [0 .. 2-1] with 25 data bytes [0 .. 25-1] for the error code stored in this error memory slot" UBYTE EH_STANDARD_S5_S3 1 100 0 255 DISPLAY_IDENTIFIER ambient_condition[0][5].amb_cond.ydiBackupMemory_xau16[8].ZFEH_EepromData ECU_ADDRESS 0xFFF83005 /end MEASUREMENT
/begin MEASUREMENT ZFEH_EepromData.ydiBackupMemory_xau16[8].amb_cond.ambient_condition[0][6] "ambient condition shot [0 .. 2-1] with 25 data bytes [0 .. 25-1] for the error code stored in this error memory slot" UBYTE EH_STANDARD_S5_S3 1 100 0 255 DISPLAY_IDENTIFIER ambient_condition[0][6].amb_cond.ydiBackupMemory_xau16[8].ZFEH_EepromData ECU_ADDRESS 0xFFF83006 /end MEASUREMENT
/begin MEASUREMENT ZFEH_EepromData.ydiBackupMemory_xau16[8].amb_cond.ambient_condition[0][7] "ambient condition shot [0 .. 2-1] with 25 data bytes [0 .. 25-1] for the error code stored in this error memory slot" UBYTE EH_STANDARD_S5_S3 1 100 0 255 DISPLAY_IDENTIFIER ambient_condition[0][7].amb_cond.ydiBackupMemory_xau16[8].ZFEH_EepromData ECU_ADDRESS 0xFFF83007 /end MEASUREMENT
/begin MEASUREMENT ZFEH_EepromData.ydiBackupMemory_xau16[8].amb_cond.ambient_condition[0][8] "ambient condition shot [0 .. 2-1] with 25 data bytes [0 .. 25-1] for the error code stored in this error memory slot" UBYTE EH_STANDARD_S5_S3 1 100 0 255 DISPLAY_IDENTIFIER ambient_condition[0][8].amb_cond.ydiBackupMemory_xau16[8].ZFEH_EepromData ECU_ADDRESS 0xFFF83008 /end MEASUREMENT
/begin MEASUREMENT ZFEH_EepromData.ydiBackupMemory_xau16[8].amb_cond.ambient_condition[0][9] "ambient condition shot [0 .. 2-1] with 25 data bytes [0 .. 25-1] for the error code stored in this error memory slot" UBYTE EH_STANDARD_S5_S3 1 100 0 255 DISPLAY_IDENTIFIER ambient_condition[0][9].amb_cond.ydiBackupMemory_xau16[8].ZFEH_EepromData ECU_ADDRESS 0xFFF83009 /end MEASUREMENT
/begin MEASUREMENT ZFEH_EepromData.ydiBackupMemory_xau16[8].amb_cond.ambient_condition[0][10] "ambient condition shot [0 .. 2-1] with 25 data bytes [0 .. 25-1] for the error code stored in this error memory slot" UBYTE EH_STANDARD_S5_S3 1 100 0 255 DISPLAY_IDENTIFIER ambient_condition[0][10].amb_cond.ydiBackupMemory_xau16[8].ZFEH_EepromData ECU_ADDRESS 0xFFF8300A /end MEASUREMENT
/begin MEASUREMENT ZFEH_EepromData.ydiBackupMemory_xau16[8].amb_cond.ambient_condition[0][11] "ambient condition shot [0 .. 2-1] with 25 data bytes [0 .. 25-1] for the error code stored in this error memory slot" UBYTE EH_STANDARD_S5_S3 1 100 0 255 DISPLAY_IDENTIFIER ambient_condition[0][11].amb_cond.ydiBackupMemory_xau16[8].ZFEH_EepromData ECU_ADDRESS 0xFFF8300B /end MEASUREMENT
/begin MEASUREMENT ZFEH_EepromData.ydiBackupMemory_xau16[8].amb_cond.ambient_condition[0][12] "ambient condition shot [0 .. 2-1] with 25 data bytes [0 .. 25-1] for the error code stored in this error memory slot" UBYTE EH_STANDARD_S5_S3 1 100 0 255 DISPLAY_IDENTIFIER ambient_condition[0][12].amb_cond.ydiBackupMemory_xau16[8].ZFEH_EepromData ECU_ADDRESS 0xFFF8300C /end MEASUREMENT
/begin MEASUREMENT ZFEH_EepromData.ydiBackupMemory_xau16[8].amb_cond.ambient_condition[0][13] "ambient condition shot [0 .. 2-1] with 25 data bytes [0 .. 25-1] for the error code stored in this error memory slot" UBYTE EH_STANDARD_S5_S3 1 100 0 255 DISPLAY_IDENTIFIER ambient_condition[0][13].amb_cond.ydiBackupMemory_xau16[8].ZFEH_EepromData ECU_ADDRESS 0xFFF8300D /end MEASUREMENT
/begin MEASUREMENT ZFEH_EepromData.ydiBackupMemory_xau16[8].amb_cond.ambient_condition[0][14] "ambient condition shot [0 .. 2-1] with 25 data bytes [0 .. 25-1] for the error code stored in this error memory slot" UBYTE EH_STANDARD_S5_S3 1 100 0 255 DISPLAY_IDENTIFIER ambient_condition[0][14].amb_cond.ydiBackupMemory_xau16[8].ZFEH_EepromData ECU_ADDRESS 0xFFF8300E /end MEASUREMENT
/begin MEASUREMENT ZFEH_EepromData.ydiBackupMemory_xau16[8].amb_cond.ambient_condition[0][15] "ambient condition shot [0 .. 2-1] with 25 data bytes [0 .. 25-1] for the error code stored in this error memory slot" UBYTE EH_STANDARD_S5_S3 1 100 0 255 DISPLAY_IDENTIFIER ambient_condition[0][15].amb_cond.ydiBackupMemory_xau16[8].ZFEH_EepromData ECU_ADDRESS 0xFFF8300F /end MEASUREMENT
/begin MEASUREMENT ZFEH_EepromData.ydiBackupMemory_xau16[8].amb_cond.ambient_condition[0][16] "ambient condition shot [0 .. 2-1] with 25 data bytes [0 .. 25-1] for the error code stored in this error memory slot" UBYTE EH_STANDARD_S5_S3 1 100 0 255 DISPLAY_IDENTIFIER ambient_condition[0][16].amb_cond.ydiBackupMemory_xau16[8].ZFEH_EepromData ECU_ADDRESS 0xFFF83010 /end MEASUREMENT
/begin MEASUREMENT ZFEH_EepromData.ydiBackupMemory_xau16[8].amb_cond.ambient_condition[0][17] "ambient condition shot [0 .. 2-1] with 25 data bytes [0 .. 25-1] for the error code stored in this error memory slot" UBYTE EH_STANDARD_S5_S3 1 100 0 255 DISPLAY_IDENTIFIER ambient_condition[0][17].amb_cond.ydiBackupMemory_xau16[8].ZFEH_EepromData ECU_ADDRESS 0xFFF83011 /end MEASUREMENT
/begin MEASUREMENT ZFEH_EepromData.ydiBackupMemory_xau16[8].amb_cond.ambient_condition[0][18] "ambient condition shot [0 .. 2-1] with 25 data bytes [0 .. 25-1] for the error code stored in this error memory slot" UBYTE EH_STANDARD_S5_S3 1 100 0 255 DISPLAY_IDENTIFIER ambient_condition[0][18].amb_cond.ydiBackupMemory_xau16[8].ZFEH_EepromData ECU_ADDRESS 0xFFF83012 /end MEASUREMENT
/begin MEASUREMENT ZFEH_EepromData.ydiBackupMemory_xau16[8].amb_cond.ambient_condition[0][19] "ambient condition shot [0 .. 2-1] with 25 data bytes [0 .. 25-1] for the error code stored in this error memory slot" UBYTE EH_STANDARD_S5_S3 1 100 0 255 DISPLAY_IDENTIFIER ambient_condition[0][19].amb_cond.ydiBackupMemory_xau16[8].ZFEH_EepromData ECU_ADDRESS 0xFFF83013 /end MEASUREMENT
/begin MEASUREMENT ZFEH_EepromData.ydiBackupMemory_xau16[8].amb_cond.ambient_condition[0][20] "ambient condition shot [0 .. 2-1] with 25 data bytes [0 .. 25-1] for the error code stored in this error memory slot" UBYTE EH_STANDARD_S5_S3 1 100 0 255 DISPLAY_IDENTIFIER ambient_condition[0][20].amb_cond.ydiBackupMemory_xau16[8].ZFEH_EepromData ECU_ADDRESS 0xFFF83014 /end MEASUREMENT
/begin MEASUREMENT ZFEH_EepromData.ydiBackupMemory_xau16[8].amb_cond.ambient_condition[0][21] "ambient condition shot [0 .. 2-1] with 25 data bytes [0 .. 25-1] for the error code stored in this error memory slot" UBYTE EH_STANDARD_S5_S3 1 100 0 255 DISPLAY_IDENTIFIER ambient_condition[0][21].amb_cond.ydiBackupMemory_xau16[8].ZFEH_EepromData ECU_ADDRESS 0xFFF83015 /end MEASUREMENT
/begin MEASUREMENT ZFEH_EepromData.ydiBackupMemory_xau16[8].amb_cond.ambient_condition[0][22] "ambient condition shot [0 .. 2-1] with 25 data bytes [0 .. 25-1] for the error code stored in this error memory slot" UBYTE EH_STANDARD_S5_S3 1 100 0 255 DISPLAY_IDENTIFIER ambient_condition[0][22].amb_cond.ydiBackupMemory_xau16[8].ZFEH_EepromData ECU_ADDRESS 0xFFF83016 /end MEASUREMENT
/begin MEASUREMENT ZFEH_EepromData.ydiBackupMemory_xau16[8].amb_cond.ambient_condition[0][23] "ambient condition shot [0 .. 2-1] with 25 data bytes [0 .. 25-1] for the error code stored in this error memory slot" UBYTE EH_STANDARD_S5_S3 1 100 0 255 DISPLAY_IDENTIFIER ambient_condition[0][23].amb_cond.ydiBackupMemory_xau16[8].ZFEH_EepromData ECU_ADDRESS 0xFFF83017 /end MEASUREMENT
/begin MEASUREMENT ZFEH_EepromData.ydiBackupMemory_xau16[8].amb_cond.ambient_condition[0][24] "ambient condition shot [0 .. 2-1] with 25 data bytes [0 .. 25-1] for the error code stored in this error memory slot" UBYTE EH_STANDARD_S5_S3 1 100 0 255 DISPLAY_IDENTIFIER ambient_condition[0][24].amb_cond.ydiBackupMemory_xau16[8].ZFEH_EepromData ECU_ADDRESS 0xFFF83018 /end MEASUREMENT
/begin MEASUREMENT ZFEH_EepromData.ydiBackupMemory_xau16[8].amb_cond.ambient_condition[1][0] "ambient condition shot [0 .. 2-1] with 25 data bytes [0 .. 25-1] for the error code stored in this error memory slot" UBYTE EH_STANDARD_S5_S3 1 100 0 255 DISPLAY_IDENTIFIER ambient_condition[1][0].amb_cond.ydiBackupMemory_xau16[8].ZFEH_EepromData ECU_ADDRESS 0xFFF83019 /end MEASUREMENT
/begin MEASUREMENT ZFEH_EepromData.ydiBackupMemory_xau16[8].amb_cond.ambient_condition[1][1] "ambient condition shot [0 .. 2-1] with 25 data bytes [0 .. 25-1] for the error code stored in this error memory slot" UBYTE EH_STANDARD_S5_S3 1 100 0 255 DISPLAY_IDENTIFIER ambient_condition[1][1].amb_cond.ydiBackupMemory_xau16[8].ZFEH_EepromData ECU_ADDRESS 0xFFF8301A /end MEASUREMENT
/begin MEASUREMENT ZFEH_EepromData.ydiBackupMemory_xau16[8].amb_cond.ambient_condition[1][2] "ambient condition shot [0 .. 2-1] with 25 data bytes [0 .. 25-1] for the error code stored in this error memory slot" UBYTE EH_STANDARD_S5_S3 1 100 0 255 DISPLAY_IDENTIFIER ambient_condition[1][2].amb_cond.ydiBackupMemory_xau16[8].ZFEH_EepromData ECU_ADDRESS 0xFFF8301B /end MEASUREMENT
/begin MEASUREMENT ZFEH_EepromData.ydiBackupMemory_xau16[8].amb_cond.ambient_condition[1][3] "ambient condition shot [0 .. 2-1] with 25 data bytes [0 .. 25-1] for the error code stored in this error memory slot" UBYTE EH_STANDARD_S5_S3 1 100 0 255 DISPLAY_IDENTIFIER ambient_condition[1][3].amb_cond.ydiBackupMemory_xau16[8].ZFEH_EepromData ECU_ADDRESS 0xFFF8301C /end MEASUREMENT
/begin MEASUREMENT ZFEH_EepromData.ydiBackupMemory_xau16[8].amb_cond.ambient_condition[1][4] "ambient condition shot [0 .. 2-1] with 25 data bytes [0 .. 25-1] for the error code stored in this error memory slot" UBYTE EH_STANDARD_S5_S3 1 100 0 255 DISPLAY_IDENTIFIER ambient_condition[1][4].amb_cond.ydiBackupMemory_xau16[8].ZFEH_EepromData ECU_ADDRESS 0xFFF8301D /end MEASUREMENT
/begin MEASUREMENT ZFEH_EepromData.ydiBackupMemory_xau16[8].amb_cond.ambient_condition[1][5] "ambient condition shot [0 .. 2-1] with 25 data bytes [0 .. 25-1] for the error code stored in this error memory slot" UBYTE EH_STANDARD_S5_S3 1 100 0 255 DISPLAY_IDENTIFIER ambient_condition[1][5].amb_cond.ydiBackupMemory_xau16[8].ZFEH_EepromData ECU_ADDRESS 0xFFF8301E /end MEASUREMENT
/begin MEASUREMENT ZFEH_EepromData.ydiBackupMemory_xau16[8].amb_cond.ambient_condition[1][6] "ambient condition shot [0 .. 2-1] with 25 data bytes [0 .. 25-1] for the error code stored in this error memory slot" UBYTE EH_STANDARD_S5_S3 1 100 0 255 DISPLAY_IDENTIFIER ambient_condition[1][6].amb_cond.ydiBackupMemory_xau16[8].ZFEH_EepromData ECU_ADDRESS 0xFFF8301F /end MEASUREMENT
/begin MEASUREMENT ZFEH_EepromData.ydiBackupMemory_xau16[8].amb_cond.ambient_condition[1][7] "ambient condition shot [0 .. 2-1] with 25 data bytes [0 .. 25-1] for the error code stored in this error memory slot" UBYTE EH_STANDARD_S5_S3 1 100 0 255 DISPLAY_IDENTIFIER ambient_condition[1][7].amb_cond.ydiBackupMemory_xau16[8].ZFEH_EepromData ECU_ADDRESS 0xFFF83020 /end MEASUREMENT
/begin MEASUREMENT ZFEH_EepromData.ydiBackupMemory_xau16[8].amb_cond.ambient_condition[1][8] "ambient condition shot [0 .. 2-1] with 25 data bytes [0 .. 25-1] for the error code stored in this error memory slot" UBYTE EH_STANDARD_S5_S3 1 100 0 255 DISPLAY_IDENTIFIER ambient_condition[1][8].amb_cond.ydiBackupMemory_xau16[8].ZFEH_EepromData ECU_ADDRESS 0xFFF83021 /end MEASUREMENT
/begin MEASUREMENT ZFEH_EepromData.ydiBackupMemory_xau16[8].amb_cond.ambient_condition[1][9] "ambient condition shot [0 .. 2-1] with 25 data bytes [0 .. 25-1] for the error code stored in this error memory slot" UBYTE EH_STANDARD_S5_S3 1 100 0 255 DISPLAY_IDENTIFIER ambient_condition[1][9].amb_cond.ydiBackupMemory_xau16[8].ZFEH_EepromData ECU_ADDRESS 0xFFF83022 /end MEASUREMENT
/begin MEASUREMENT ZFEH_EepromData.ydiBackupMemory_xau16[8].amb_cond.ambient_condition[1][10] "ambient condition shot [0 .. 2-1] with 25 data bytes [0 .. 25-1] for the error code stored in this error memory slot" UBYTE EH_STANDARD_S5_S3 1 100 0 255 DISPLAY_IDENTIFIER ambient_condition[1][10].amb_cond.ydiBackupMemory_xau16[8].ZFEH_EepromData ECU_ADDRESS 0xFFF83023 /end MEASUREMENT
/begin MEASUREMENT ZFEH_EepromData.ydiBackupMemory_xau16[8].amb_cond.ambient_condition[1][11] "ambient condition shot [0 .. 2-1] with 25 data bytes [0 .. 25-1] for the error code stored in this error memory slot" UBYTE EH_STANDARD_S5_S3 1 100 0 255 DISPLAY_IDENTIFIER ambient_condition[1][11].amb_cond.ydiBackupMemory_xau16[8].ZFEH_EepromData ECU_ADDRESS 0xFFF83024 /end MEASUREMENT
/begin MEASUREMENT ZFEH_EepromData.ydiBackupMemory_xau16[8].amb_cond.ambient_condition[1][12] "ambient condition shot [0 .. 2-1] with 25 data bytes [0 .. 25-1] for the error code stored in this error memory slot" UBYTE EH_STANDARD_S5_S3 1 100 0 255 DISPLAY_IDENTIFIER ambient_condition[1][12].amb_cond.ydiBackupMemory_xau16[8].ZFEH_EepromData ECU_ADDRESS 0xFFF83025 /end MEASUREMENT
/begin MEASUREMENT ZFEH_EepromData.ydiBackupMemory_xau16[8].amb_cond.ambient_condition[1][13] "ambient condition shot [0 .. 2-1] with 25 data bytes [0 .. 25-1] for the error code stored in this error memory slot" UBYTE EH_STANDARD_S5_S3 1 100 0 255 DISPLAY_IDENTIFIER ambient_condition[1][13].amb_cond.ydiBackupMemory_xau16[8].ZFEH_EepromData ECU_ADDRESS 0xFFF83026 /end MEASUREMENT
/begin MEASUREMENT ZFEH_EepromData.ydiBackupMemory_xau16[8].amb_cond.ambient_condition[1][14] "ambient condition shot [0 .. 2-1] with 25 data bytes [0 .. 25-1] for the error code stored in this error memory slot" UBYTE EH_STANDARD_S5_S3 1 100 0 255 DISPLAY_IDENTIFIER ambient_condition[1][14].amb_cond.ydiBackupMemory_xau16[8].ZFEH_EepromData ECU_ADDRESS 0xFFF83027 /end MEASUREMENT
/begin MEASUREMENT ZFEH_EepromData.ydiBackupMemory_xau16[8].amb_cond.ambient_condition[1][15] "ambient condition shot [0 .. 2-1] with 25 data bytes [0 .. 25-1] for the error code stored in this error memory slot" UBYTE EH_STANDARD_S5_S3 1 100 0 255 DISPLAY_IDENTIFIER ambient_condition[1][15].amb_cond.ydiBackupMemory_xau16[8].ZFEH_EepromData ECU_ADDRESS 0xFFF83028 /end MEASUREMENT
/begin MEASUREMENT ZFEH_EepromData.ydiBackupMemory_xau16[8].amb_cond.ambient_condition[1][16] "ambient condition shot [0 .. 2-1] with 25 data bytes [0 .. 25-1] for the error code stored in this error memory slot" UBYTE EH_STANDARD_S5_S3 1 100 0 255 DISPLAY_IDENTIFIER ambient_condition[1][16].amb_cond.ydiBackupMemory_xau16[8].ZFEH_EepromData ECU_ADDRESS 0xFFF83029 /end MEASUREMENT
/begin MEASUREMENT ZFEH_EepromData.ydiBackupMemory_xau16[8].amb_cond.ambient_condition[1][17] "ambient condition shot [0 .. 2-1] with 25 data bytes [0 .. 25-1] for the error code stored in this error memory slot" UBYTE EH_STANDARD_S5_S3 1 100 0 255 DISPLAY_IDENTIFIER ambient_condition[1][17].amb_cond.ydiBackupMemory_xau16[8].ZFEH_EepromData ECU_ADDRESS 0xFFF8302A /end MEASUREMENT
/begin MEASUREMENT ZFEH_EepromData.ydiBackupMemory_xau16[8].amb_cond.ambient_condition[1][18] "ambient condition shot [0 .. 2-1] with 25 data bytes [0 .. 25-1] for the error code stored in this error memory slot" UBYTE EH_STANDARD_S5_S3 1 100 0 255 DISPLAY_IDENTIFIER ambient_condition[1][18].amb_cond.ydiBackupMemory_xau16[8].ZFEH_EepromData ECU_ADDRESS 0xFFF8302B /end MEASUREMENT
/begin MEASUREMENT ZFEH_EepromData.ydiBackupMemory_xau16[8].amb_cond.ambient_condition[1][19] "ambient condition shot [0 .. 2-1] with 25 data bytes [0 .. 25-1] for the error code stored in this error memory slot" UBYTE EH_STANDARD_S5_S3 1 100 0 255 DISPLAY_IDENTIFIER ambient_condition[1][19].amb_cond.ydiBackupMemory_xau16[8].ZFEH_EepromData ECU_ADDRESS 0xFFF8302C /end MEASUREMENT
/begin MEASUREMENT ZFEH_EepromData.ydiBackupMemory_xau16[8].amb_cond.ambient_condition[1][20] "ambient condition shot [0 .. 2-1] with 25 data bytes [0 .. 25-1] for the error code stored in this error memory slot" UBYTE EH_STANDARD_S5_S3 1 100 0 255 DISPLAY_IDENTIFIER ambient_condition[1][20].amb_cond.ydiBackupMemory_xau16[8].ZFEH_EepromData ECU_ADDRESS 0xFFF8302D /end MEASUREMENT
/begin MEASUREMENT ZFEH_EepromData.ydiBackupMemory_xau16[8].amb_cond.ambient_condition[1][21] "ambient condition shot [0 .. 2-1] with 25 data bytes [0 .. 25-1] for the error code stored in this error memory slot" UBYTE EH_STANDARD_S5_S3 1 100 0 255 DISPLAY_IDENTIFIER ambient_condition[1][21].amb_cond.ydiBackupMemory_xau16[8].ZFEH_EepromData ECU_ADDRESS 0xFFF8302E /end MEASUREMENT
/begin MEASUREMENT ZFEH_EepromData.ydiBackupMemory_xau16[8].amb_cond.ambient_condition[1][22] "ambient condition shot [0 .. 2-1] with 25 data bytes [0 .. 25-1] for the error code stored in this error memory slot" UBYTE EH_STANDARD_S5_S3 1 100 0 255 DISPLAY_IDENTIFIER ambient_condition[1][22].amb_cond.ydiBackupMemory_xau16[8].ZFEH_EepromData ECU_ADDRESS 0xFFF8302F /end MEASUREMENT
/begin MEASUREMENT ZFEH_EepromData.ydiBackupMemory_xau16[8].amb_cond.ambient_condition[1][23] "ambient condition shot [0 .. 2-1] with 25 data bytes [0 .. 25-1] for the error code stored in this error memory slot" UBYTE EH_STANDARD_S5_S3 1 100 0 255 DISPLAY_IDENTIFIER ambient_condition[1][23].amb_cond.ydiBackupMemory_xau16[8].ZFEH_EepromData ECU_ADDRESS 0xFFF83030 /end MEASUREMENT
/begin MEASUREMENT ZFEH_EepromData.ydiBackupMemory_xau16[8].amb_cond.ambient_condition[1][24] "ambient condition shot [0 .. 2-1] with 25 data bytes [0 .. 25-1] for the error code stored in this error memory slot" UBYTE EH_STANDARD_S5_S3 1 100 0 255 DISPLAY_IDENTIFIER ambient_condition[1][24].amb_cond.ydiBackupMemory_xau16[8].ZFEH_EepromData ECU_ADDRESS 0xFFF83031 /end MEASUREMENT
/begin MEASUREMENT ZFEH_EepromData.ydiBackupMemory_xau16[8].amb_cond.status_of_ambient_conditions[0] "status of ambient condition shot x: 0=invalid 1=valid" UBYTE EH_STANDARD_S5_S3 1 100 0 1 DISPLAY_IDENTIFIER status_of_ambient_conditions[0].amb_cond.ydiBackupMemory_xau16[8].ZFEH_EepromData ECU_ADDRESS 0xFFF83032 /end MEASUREMENT
/begin MEASUREMENT ZFEH_EepromData.ydiBackupMemory_xau16[8].amb_cond.status_of_ambient_conditions[1] "status of ambient condition shot x: 0=invalid 1=valid" UBYTE EH_STANDARD_S5_S3 1 100 0 1 DISPLAY_IDENTIFIER status_of_ambient_conditions[1].amb_cond.ydiBackupMemory_xau16[8].ZFEH_EepromData ECU_ADDRESS 0xFFF83033 /end MEASUREMENT
/begin MEASUREMENT ZFEH_EepromData.ydiBackupMemory_xau16[8].error_code "error code stored in error memory slot" UWORD EH_STANDARD_S5_S3 1 100 0 65535 DISPLAY_IDENTIFIER error_code.ydiBackupMemory_xau16[8].ZFEH_EepromData ECU_ADDRESS 0xFFF82FEC /end MEASUREMENT
/begin MEASUREMENT ZFEH_EepromData.ydiBackupMemory_xau16[8].error_type "error type of error code stored in error memory slot" UWORD EH_STANDARD_S5_S3 1 100 0 65535 DISPLAY_IDENTIFIER error_type.ydiBackupMemory_xau16[8].ZFEH_EepromData ECU_ADDRESS 0xFFF82FEE /end MEASUREMENT
/begin MEASUREMENT ZFEH_EepromData.ydiBackupMemory_xau16[8].status_word "status word of error code stored in error memory slot" UWORD EH_STANDARD_S5_S3 1 100 0 65535 DISPLAY_IDENTIFIER status_word.ydiBackupMemory_xau16[8].ZFEH_EepromData ECU_ADDRESS 0xFFF82FF0 /end MEASUREMENT
/begin MEASUREMENT ZFEH_EepromData.ydiBackupMemory_xau16[8].frequency_counter "frequency counter of error code stored in error memory slot" UBYTE EH_STANDARD_S5_S3 1 100 0 255 DISPLAY_IDENTIFIER frequency_counter.ydiBackupMemory_xau16[8].ZFEH_EepromData ECU_ADDRESS 0xFFF82FF2 /end MEASUREMENT
/begin MEASUREMENT ZFEH_EepromData.ydiBackupMemory_xau16[8].backwards_counter "backwards counter of error code stored in error memory slot" UBYTE EH_STANDARD_S5_S3 1 100 0 255 DISPLAY_IDENTIFIER backwards_counter.ydiBackupMemory_xau16[8].ZFEH_EepromData ECU_ADDRESS 0xFFF82FF3 /end MEASUREMENT
/begin MEASUREMENT ZFEH_EepromData.ydiBackupMemory_xau16[8].permanent_counter "counter of permanent error codes stored in error memory slot" UBYTE EH_STANDARD_S5_S3 1 100 0 255 DISPLAY_IDENTIFIER permanent_counter.ydiBackupMemory_xau16[8].ZFEH_EepromData ECU_ADDRESS 0xFFF82FF4 /end MEASUREMENT
/begin MEASUREMENT ZFEH_EepromData.ydiBackupMemory_xau16[8].sequence_counter "sequence counter of error code stored in error memory slot" UBYTE EH_STANDARD_S5_S3 1 100 0 255 DISPLAY_IDENTIFIER sequence_counter.ydiBackupMemory_xau16[8].ZFEH_EepromData ECU_ADDRESS 0xFFF82FF5 /end MEASUREMENT
/begin MEASUREMENT ZFEH_EepromData.ydiBackupMemory_xau16[8].master_time "master time of error code stored in error memory slot" ULONG EH_STANDARD_S5_S3 1 100 0 4294967295 DISPLAY_IDENTIFIER master_time.ydiBackupMemory_xau16[8].ZFEH_EepromData ECU_ADDRESS 0xFFF82FF8 /end MEASUREMENT
/begin MEASUREMENT ZFEH_EepromData.ydiBackupMemory_xau16[8].condition_byte "condition byte of error code stored in error memory slot" UBYTE EH_STANDARD_S5_S3 1 100 0 255 DISPLAY_IDENTIFIER condition_byte.ydiBackupMemory_xau16[8].ZFEH_EepromData ECU_ADDRESS 0xFFF82FFD /end MEASUREMENT
/begin MEASUREMENT ZFEH_EepromData.ydiBackupMemory_xau16[8].obd_driving_cycle_counter "obd driving cycle counter of error code stored in error memory slot" UWORD EH_STANDARD_S5_S3 1 100 0 65535 DISPLAY_IDENTIFIER obd_driving_cycle_counter.ydiBackupMemory_xau16[8].ZFEH_EepromData ECU_ADDRESS 0xFFF82FFE /end MEASUREMENT
/begin MEASUREMENT ZFEH_EepromData.ydiBackupMemory_xau16[9].amb_cond.ambient_condition[0][0] "ambient condition shot [0 .. 2-1] with 25 data bytes [0 .. 25-1] for the error code stored in this error memory slot" UBYTE EH_STANDARD_S5_S3 1 100 0 255 DISPLAY_IDENTIFIER ambient_condition[0][0].amb_cond.ydiBackupMemory_xau16[9].ZFEH_EepromData ECU_ADDRESS 0xFFF83048 /end MEASUREMENT
/begin MEASUREMENT ZFEH_EepromData.ydiBackupMemory_xau16[9].amb_cond.ambient_condition[0][1] "ambient condition shot [0 .. 2-1] with 25 data bytes [0 .. 25-1] for the error code stored in this error memory slot" UBYTE EH_STANDARD_S5_S3 1 100 0 255 DISPLAY_IDENTIFIER ambient_condition[0][1].amb_cond.ydiBackupMemory_xau16[9].ZFEH_EepromData ECU_ADDRESS 0xFFF83049 /end MEASUREMENT
/begin MEASUREMENT ZFEH_EepromData.ydiBackupMemory_xau16[9].amb_cond.ambient_condition[0][2] "ambient condition shot [0 .. 2-1] with 25 data bytes [0 .. 25-1] for the error code stored in this error memory slot" UBYTE EH_STANDARD_S5_S3 1 100 0 255 DISPLAY_IDENTIFIER ambient_condition[0][2].amb_cond.ydiBackupMemory_xau16[9].ZFEH_EepromData ECU_ADDRESS 0xFFF8304A /end MEASUREMENT
/begin MEASUREMENT ZFEH_EepromData.ydiBackupMemory_xau16[9].amb_cond.ambient_condition[0][3] "ambient condition shot [0 .. 2-1] with 25 data bytes [0 .. 25-1] for the error code stored in this error memory slot" UBYTE EH_STANDARD_S5_S3 1 100 0 255 DISPLAY_IDENTIFIER ambient_condition[0][3].amb_cond.ydiBackupMemory_xau16[9].ZFEH_EepromData ECU_ADDRESS 0xFFF8304B /end MEASUREMENT
/begin MEASUREMENT ZFEH_EepromData.ydiBackupMemory_xau16[9].amb_cond.ambient_condition[0][4] "ambient condition shot [0 .. 2-1] with 25 data bytes [0 .. 25-1] for the error code stored in this error memory slot" UBYTE EH_STANDARD_S5_S3 1 100 0 255 DISPLAY_IDENTIFIER ambient_condition[0][4].amb_cond.ydiBackupMemory_xau16[9].ZFEH_EepromData ECU_ADDRESS 0xFFF8304C /end MEASUREMENT
/begin MEASUREMENT ZFEH_EepromData.ydiBackupMemory_xau16[9].amb_cond.ambient_condition[0][5] "ambient condition shot [0 .. 2-1] with 25 data bytes [0 .. 25-1] for the error code stored in this error memory slot" UBYTE EH_STANDARD_S5_S3 1 100 0 255 DISPLAY_IDENTIFIER ambient_condition[0][5].amb_cond.ydiBackupMemory_xau16[9].ZFEH_EepromData ECU_ADDRESS 0xFFF8304D /end MEASUREMENT
/begin MEASUREMENT ZFEH_EepromData.ydiBackupMemory_xau16[9].amb_cond.ambient_condition[0][6] "ambient condition shot [0 .. 2-1] with 25 data bytes [0 .. 25-1] for the error code stored in this error memory slot" UBYTE EH_STANDARD_S5_S3 1 100 0 255 DISPLAY_IDENTIFIER ambient_condition[0][6].amb_cond.ydiBackupMemory_xau16[9].ZFEH_EepromData ECU_ADDRESS 0xFFF8304E /end MEASUREMENT
/begin MEASUREMENT ZFEH_EepromData.ydiBackupMemory_xau16[9].amb_cond.ambient_condition[0][7] "ambient condition shot [0 .. 2-1] with 25 data bytes [0 .. 25-1] for the error code stored in this error memory slot" UBYTE EH_STANDARD_S5_S3 1 100 0 255 DISPLAY_IDENTIFIER ambient_condition[0][7].amb_cond.ydiBackupMemory_xau16[9].ZFEH_EepromData ECU_ADDRESS 0xFFF8304F /end MEASUREMENT
/begin MEASUREMENT ZFEH_EepromData.ydiBackupMemory_xau16[9].amb_cond.ambient_condition[0][8] "ambient condition shot [0 .. 2-1] with 25 data bytes [0 .. 25-1] for the error code stored in this error memory slot" UBYTE EH_STANDARD_S5_S3 1 100 0 255 DISPLAY_IDENTIFIER ambient_condition[0][8].amb_cond.ydiBackupMemory_xau16[9].ZFEH_EepromData ECU_ADDRESS 0xFFF83050 /end MEASUREMENT
/begin MEASUREMENT ZFEH_EepromData.ydiBackupMemory_xau16[9].amb_cond.ambient_condition[0][9] "ambient condition shot [0 .. 2-1] with 25 data bytes [0 .. 25-1] for the error code stored in this error memory slot" UBYTE EH_STANDARD_S5_S3 1 100 0 255 DISPLAY_IDENTIFIER ambient_condition[0][9].amb_cond.ydiBackupMemory_xau16[9].ZFEH_EepromData ECU_ADDRESS 0xFFF83051 /end MEASUREMENT
/begin MEASUREMENT ZFEH_EepromData.ydiBackupMemory_xau16[9].amb_cond.ambient_condition[0][10] "ambient condition shot [0 .. 2-1] with 25 data bytes [0 .. 25-1] for the error code stored in this error memory slot" UBYTE EH_STANDARD_S5_S3 1 100 0 255 DISPLAY_IDENTIFIER ambient_condition[0][10].amb_cond.ydiBackupMemory_xau16[9].ZFEH_EepromData ECU_ADDRESS 0xFFF83052 /end MEASUREMENT
/begin MEASUREMENT ZFEH_EepromData.ydiBackupMemory_xau16[9].amb_cond.ambient_condition[0][11] "ambient condition shot [0 .. 2-1] with 25 data bytes [0 .. 25-1] for the error code stored in this error memory slot" UBYTE EH_STANDARD_S5_S3 1 100 0 255 DISPLAY_IDENTIFIER ambient_condition[0][11].amb_cond.ydiBackupMemory_xau16[9].ZFEH_EepromData ECU_ADDRESS 0xFFF83053 /end MEASUREMENT
/begin MEASUREMENT ZFEH_EepromData.ydiBackupMemory_xau16[9].amb_cond.ambient_condition[0][12] "ambient condition shot [0 .. 2-1] with 25 data bytes [0 .. 25-1] for the error code stored in this error memory slot" UBYTE EH_STANDARD_S5_S3 1 100 0 255 DISPLAY_IDENTIFIER ambient_condition[0][12].amb_cond.ydiBackupMemory_xau16[9].ZFEH_EepromData ECU_ADDRESS 0xFFF83054 /end MEASUREMENT
/begin MEASUREMENT ZFEH_EepromData.ydiBackupMemory_xau16[9].amb_cond.ambient_condition[0][13] "ambient condition shot [0 .. 2-1] with 25 data bytes [0 .. 25-1] for the error code stored in this error memory slot" UBYTE EH_STANDARD_S5_S3 1 100 0 255 DISPLAY_IDENTIFIER ambient_condition[0][13].amb_cond.ydiBackupMemory_xau16[9].ZFEH_EepromData ECU_ADDRESS 0xFFF83055 /end MEASUREMENT
/begin MEASUREMENT ZFEH_EepromData.ydiBackupMemory_xau16[9].amb_cond.ambient_condition[0][14] "ambient condition shot [0 .. 2-1] with 25 data bytes [0 .. 25-1] for the error code stored in this error memory slot" UBYTE EH_STANDARD_S5_S3 1 100 0 255 DISPLAY_IDENTIFIER ambient_condition[0][14].amb_cond.ydiBackupMemory_xau16[9].ZFEH_EepromData ECU_ADDRESS 0xFFF83056 /end MEASUREMENT
/begin MEASUREMENT ZFEH_EepromData.ydiBackupMemory_xau16[9].amb_cond.ambient_condition[0][15] "ambient condition shot [0 .. 2-1] with 25 data bytes [0 .. 25-1] for the error code stored in this error memory slot" UBYTE EH_STANDARD_S5_S3 1 100 0 255 DISPLAY_IDENTIFIER ambient_condition[0][15].amb_cond.ydiBackupMemory_xau16[9].ZFEH_EepromData ECU_ADDRESS 0xFFF83057 /end MEASUREMENT
/begin MEASUREMENT ZFEH_EepromData.ydiBackupMemory_xau16[9].amb_cond.ambient_condition[0][16] "ambient condition shot [0 .. 2-1] with 25 data bytes [0 .. 25-1] for the error code stored in this error memory slot" UBYTE EH_STANDARD_S5_S3 1 100 0 255 DISPLAY_IDENTIFIER ambient_condition[0][16].amb_cond.ydiBackupMemory_xau16[9].ZFEH_EepromData ECU_ADDRESS 0xFFF83058 /end MEASUREMENT
/begin MEASUREMENT ZFEH_EepromData.ydiBackupMemory_xau16[9].amb_cond.ambient_condition[0][17] "ambient condition shot [0 .. 2-1] with 25 data bytes [0 .. 25-1] for the error code stored in this error memory slot" UBYTE EH_STANDARD_S5_S3 1 100 0 255 DISPLAY_IDENTIFIER ambient_condition[0][17].amb_cond.ydiBackupMemory_xau16[9].ZFEH_EepromData ECU_ADDRESS 0xFFF83059 /end MEASUREMENT
/begin MEASUREMENT ZFEH_EepromData.ydiBackupMemory_xau16[9].amb_cond.ambient_condition[0][18] "ambient condition shot [0 .. 2-1] with 25 data bytes [0 .. 25-1] for the error code stored in this error memory slot" UBYTE EH_STANDARD_S5_S3 1 100 0 255 DISPLAY_IDENTIFIER ambient_condition[0][18].amb_cond.ydiBackupMemory_xau16[9].ZFEH_EepromData ECU_ADDRESS 0xFFF8305A /end MEASUREMENT
/begin MEASUREMENT ZFEH_EepromData.ydiBackupMemory_xau16[9].amb_cond.ambient_condition[0][19] "ambient condition shot [0 .. 2-1] with 25 data bytes [0 .. 25-1] for the error code stored in this error memory slot" UBYTE EH_STANDARD_S5_S3 1 100 0 255 DISPLAY_IDENTIFIER ambient_condition[0][19].amb_cond.ydiBackupMemory_xau16[9].ZFEH_EepromData ECU_ADDRESS 0xFFF8305B /end MEASUREMENT
/begin MEASUREMENT ZFEH_EepromData.ydiBackupMemory_xau16[9].amb_cond.ambient_condition[0][20] "ambient condition shot [0 .. 2-1] with 25 data bytes [0 .. 25-1] for the error code stored in this error memory slot" UBYTE EH_STANDARD_S5_S3 1 100 0 255 DISPLAY_IDENTIFIER ambient_condition[0][20].amb_cond.ydiBackupMemory_xau16[9].ZFEH_EepromData ECU_ADDRESS 0xFFF8305C /end MEASUREMENT
/begin MEASUREMENT ZFEH_EepromData.ydiBackupMemory_xau16[9].amb_cond.ambient_condition[0][21] "ambient condition shot [0 .. 2-1] with 25 data bytes [0 .. 25-1] for the error code stored in this error memory slot" UBYTE EH_STANDARD_S5_S3 1 100 0 255 DISPLAY_IDENTIFIER ambient_condition[0][21].amb_cond.ydiBackupMemory_xau16[9].ZFEH_EepromData ECU_ADDRESS 0xFFF8305D /end MEASUREMENT
/begin MEASUREMENT ZFEH_EepromData.ydiBackupMemory_xau16[9].amb_cond.ambient_condition[0][22] "ambient condition shot [0 .. 2-1] with 25 data bytes [0 .. 25-1] for the error code stored in this error memory slot" UBYTE EH_STANDARD_S5_S3 1 100 0 255 DISPLAY_IDENTIFIER ambient_condition[0][22].amb_cond.ydiBackupMemory_xau16[9].ZFEH_EepromData ECU_ADDRESS 0xFFF8305E /end MEASUREMENT
/begin MEASUREMENT ZFEH_EepromData.ydiBackupMemory_xau16[9].amb_cond.ambient_condition[0][23] "ambient condition shot [0 .. 2-1] with 25 data bytes [0 .. 25-1] for the error code stored in this error memory slot" UBYTE EH_STANDARD_S5_S3 1 100 0 255 DISPLAY_IDENTIFIER ambient_condition[0][23].amb_cond.ydiBackupMemory_xau16[9].ZFEH_EepromData ECU_ADDRESS 0xFFF8305F /end MEASUREMENT
/begin MEASUREMENT ZFEH_EepromData.ydiBackupMemory_xau16[9].amb_cond.ambient_condition[0][24] "ambient condition shot [0 .. 2-1] with 25 data bytes [0 .. 25-1] for the error code stored in this error memory slot" UBYTE EH_STANDARD_S5_S3 1 100 0 255 DISPLAY_IDENTIFIER ambient_condition[0][24].amb_cond.ydiBackupMemory_xau16[9].ZFEH_EepromData ECU_ADDRESS 0xFFF83060 /end MEASUREMENT
/begin MEASUREMENT ZFEH_EepromData.ydiBackupMemory_xau16[9].amb_cond.ambient_condition[1][0] "ambient condition shot [0 .. 2-1] with 25 data bytes [0 .. 25-1] for the error code stored in this error memory slot" UBYTE EH_STANDARD_S5_S3 1 100 0 255 DISPLAY_IDENTIFIER ambient_condition[1][0].amb_cond.ydiBackupMemory_xau16[9].ZFEH_EepromData ECU_ADDRESS 0xFFF83061 /end MEASUREMENT
/begin MEASUREMENT ZFEH_EepromData.ydiBackupMemory_xau16[9].amb_cond.ambient_condition[1][1] "ambient condition shot [0 .. 2-1] with 25 data bytes [0 .. 25-1] for the error code stored in this error memory slot" UBYTE EH_STANDARD_S5_S3 1 100 0 255 DISPLAY_IDENTIFIER ambient_condition[1][1].amb_cond.ydiBackupMemory_xau16[9].ZFEH_EepromData ECU_ADDRESS 0xFFF83062 /end MEASUREMENT
/begin MEASUREMENT ZFEH_EepromData.ydiBackupMemory_xau16[9].amb_cond.ambient_condition[1][2] "ambient condition shot [0 .. 2-1] with 25 data bytes [0 .. 25-1] for the error code stored in this error memory slot" UBYTE EH_STANDARD_S5_S3 1 100 0 255 DISPLAY_IDENTIFIER ambient_condition[1][2].amb_cond.ydiBackupMemory_xau16[9].ZFEH_EepromData ECU_ADDRESS 0xFFF83063 /end MEASUREMENT
/begin MEASUREMENT ZFEH_EepromData.ydiBackupMemory_xau16[9].amb_cond.ambient_condition[1][3] "ambient condition shot [0 .. 2-1] with 25 data bytes [0 .. 25-1] for the error code stored in this error memory slot" UBYTE EH_STANDARD_S5_S3 1 100 0 255 DISPLAY_IDENTIFIER ambient_condition[1][3].amb_cond.ydiBackupMemory_xau16[9].ZFEH_EepromData ECU_ADDRESS 0xFFF83064 /end MEASUREMENT
/begin MEASUREMENT ZFEH_EepromData.ydiBackupMemory_xau16[9].amb_cond.ambient_condition[1][4] "ambient condition shot [0 .. 2-1] with 25 data bytes [0 .. 25-1] for the error code stored in this error memory slot" UBYTE EH_STANDARD_S5_S3 1 100 0 255 DISPLAY_IDENTIFIER ambient_condition[1][4].amb_cond.ydiBackupMemory_xau16[9].ZFEH_EepromData ECU_ADDRESS 0xFFF83065 /end MEASUREMENT
/begin MEASUREMENT ZFEH_EepromData.ydiBackupMemory_xau16[9].amb_cond.ambient_condition[1][5] "ambient condition shot [0 .. 2-1] with 25 data bytes [0 .. 25-1] for the error code stored in this error memory slot" UBYTE EH_STANDARD_S5_S3 1 100 0 255 DISPLAY_IDENTIFIER ambient_condition[1][5].amb_cond.ydiBackupMemory_xau16[9].ZFEH_EepromData ECU_ADDRESS 0xFFF83066 /end MEASUREMENT
/begin MEASUREMENT ZFEH_EepromData.ydiBackupMemory_xau16[9].amb_cond.ambient_condition[1][6] "ambient condition shot [0 .. 2-1] with 25 data bytes [0 .. 25-1] for the error code stored in this error memory slot" UBYTE EH_STANDARD_S5_S3 1 100 0 255 DISPLAY_IDENTIFIER ambient_condition[1][6].amb_cond.ydiBackupMemory_xau16[9].ZFEH_EepromData ECU_ADDRESS 0xFFF83067 /end MEASUREMENT
/begin MEASUREMENT ZFEH_EepromData.ydiBackupMemory_xau16[9].amb_cond.ambient_condition[1][7] "ambient condition shot [0 .. 2-1] with 25 data bytes [0 .. 25-1] for the error code stored in this error memory slot" UBYTE EH_STANDARD_S5_S3 1 100 0 255 DISPLAY_IDENTIFIER ambient_condition[1][7].amb_cond.ydiBackupMemory_xau16[9].ZFEH_EepromData ECU_ADDRESS 0xFFF83068 /end MEASUREMENT
/begin MEASUREMENT ZFEH_EepromData.ydiBackupMemory_xau16[9].amb_cond.ambient_condition[1][8] "ambient condition shot [0 .. 2-1] with 25 data bytes [0 .. 25-1] for the error code stored in this error memory slot" UBYTE EH_STANDARD_S5_S3 1 100 0 255 DISPLAY_IDENTIFIER ambient_condition[1][8].amb_cond.ydiBackupMemory_xau16[9].ZFEH_EepromData ECU_ADDRESS 0xFFF83069 /end MEASUREMENT
/begin MEASUREMENT ZFEH_EepromData.ydiBackupMemory_xau16[9].amb_cond.ambient_condition[1][9] "ambient condition shot [0 .. 2-1] with 25 data bytes [0 .. 25-1] for the error code stored in this error memory slot" UBYTE EH_STANDARD_S5_S3 1 100 0 255 DISPLAY_IDENTIFIER ambient_condition[1][9].amb_cond.ydiBackupMemory_xau16[9].ZFEH_EepromData ECU_ADDRESS 0xFFF8306A /end MEASUREMENT
/begin MEASUREMENT ZFEH_EepromData.ydiBackupMemory_xau16[9].amb_cond.ambient_condition[1][10] "ambient condition shot [0 .. 2-1] with 25 data bytes [0 .. 25-1] for the error code stored in this error memory slot" UBYTE EH_STANDARD_S5_S3 1 100 0 255 DISPLAY_IDENTIFIER ambient_condition[1][10].amb_cond.ydiBackupMemory_xau16[9].ZFEH_EepromData ECU_ADDRESS 0xFFF8306B /end MEASUREMENT
/begin MEASUREMENT ZFEH_EepromData.ydiBackupMemory_xau16[9].amb_cond.ambient_condition[1][11] "ambient condition shot [0 .. 2-1] with 25 data bytes [0 .. 25-1] for the error code stored in this error memory slot" UBYTE EH_STANDARD_S5_S3 1 100 0 255 DISPLAY_IDENTIFIER ambient_condition[1][11].amb_cond.ydiBackupMemory_xau16[9].ZFEH_EepromData ECU_ADDRESS 0xFFF8306C /end MEASUREMENT
/begin MEASUREMENT ZFEH_EepromData.ydiBackupMemory_xau16[9].amb_cond.ambient_condition[1][12] "ambient condition shot [0 .. 2-1] with 25 data bytes [0 .. 25-1] for the error code stored in this error memory slot" UBYTE EH_STANDARD_S5_S3 1 100 0 255 DISPLAY_IDENTIFIER ambient_condition[1][12].amb_cond.ydiBackupMemory_xau16[9].ZFEH_EepromData ECU_ADDRESS 0xFFF8306D /end MEASUREMENT
/begin MEASUREMENT ZFEH_EepromData.ydiBackupMemory_xau16[9].amb_cond.ambient_condition[1][13] "ambient condition shot [0 .. 2-1] with 25 data bytes [0 .. 25-1] for the error code stored in this error memory slot" UBYTE EH_STANDARD_S5_S3 1 100 0 255 DISPLAY_IDENTIFIER ambient_condition[1][13].amb_cond.ydiBackupMemory_xau16[9].ZFEH_EepromData ECU_ADDRESS 0xFFF8306E /end MEASUREMENT
/begin MEASUREMENT ZFEH_EepromData.ydiBackupMemory_xau16[9].amb_cond.ambient_condition[1][14] "ambient condition shot [0 .. 2-1] with 25 data bytes [0 .. 25-1] for the error code stored in this error memory slot" UBYTE EH_STANDARD_S5_S3 1 100 0 255 DISPLAY_IDENTIFIER ambient_condition[1][14].amb_cond.ydiBackupMemory_xau16[9].ZFEH_EepromData ECU_ADDRESS 0xFFF8306F /end MEASUREMENT
/begin MEASUREMENT ZFEH_EepromData.ydiBackupMemory_xau16[9].amb_cond.ambient_condition[1][15] "ambient condition shot [0 .. 2-1] with 25 data bytes [0 .. 25-1] for the error code stored in this error memory slot" UBYTE EH_STANDARD_S5_S3 1 100 0 255 DISPLAY_IDENTIFIER ambient_condition[1][15].amb_cond.ydiBackupMemory_xau16[9].ZFEH_EepromData ECU_ADDRESS 0xFFF83070 /end MEASUREMENT
/begin MEASUREMENT ZFEH_EepromData.ydiBackupMemory_xau16[9].amb_cond.ambient_condition[1][16] "ambient condition shot [0 .. 2-1] with 25 data bytes [0 .. 25-1] for the error code stored in this error memory slot" UBYTE EH_STANDARD_S5_S3 1 100 0 255 DISPLAY_IDENTIFIER ambient_condition[1][16].amb_cond.ydiBackupMemory_xau16[9].ZFEH_EepromData ECU_ADDRESS 0xFFF83071 /end MEASUREMENT
/begin MEASUREMENT ZFEH_EepromData.ydiBackupMemory_xau16[9].amb_cond.ambient_condition[1][17] "ambient condition shot [0 .. 2-1] with 25 data bytes [0 .. 25-1] for the error code stored in this error memory slot" UBYTE EH_STANDARD_S5_S3 1 100 0 255 DISPLAY_IDENTIFIER ambient_condition[1][17].amb_cond.ydiBackupMemory_xau16[9].ZFEH_EepromData ECU_ADDRESS 0xFFF83072 /end MEASUREMENT
/begin MEASUREMENT ZFEH_EepromData.ydiBackupMemory_xau16[9].amb_cond.ambient_condition[1][18] "ambient condition shot [0 .. 2-1] with 25 data bytes [0 .. 25-1] for the error code stored in this error memory slot" UBYTE EH_STANDARD_S5_S3 1 100 0 255 DISPLAY_IDENTIFIER ambient_condition[1][18].amb_cond.ydiBackupMemory_xau16[9].ZFEH_EepromData ECU_ADDRESS 0xFFF83073 /end MEASUREMENT
/begin MEASUREMENT ZFEH_EepromData.ydiBackupMemory_xau16[9].amb_cond.ambient_condition[1][19] "ambient condition shot [0 .. 2-1] with 25 data bytes [0 .. 25-1] for the error code stored in this error memory slot" UBYTE EH_STANDARD_S5_S3 1 100 0 255 DISPLAY_IDENTIFIER ambient_condition[1][19].amb_cond.ydiBackupMemory_xau16[9].ZFEH_EepromData ECU_ADDRESS 0xFFF83074 /end MEASUREMENT
/begin MEASUREMENT ZFEH_EepromData.ydiBackupMemory_xau16[9].amb_cond.ambient_condition[1][20] "ambient condition shot [0 .. 2-1] with 25 data bytes [0 .. 25-1] for the error code stored in this error memory slot" UBYTE EH_STANDARD_S5_S3 1 100 0 255 DISPLAY_IDENTIFIER ambient_condition[1][20].amb_cond.ydiBackupMemory_xau16[9].ZFEH_EepromData ECU_ADDRESS 0xFFF83075 /end MEASUREMENT
/begin MEASUREMENT ZFEH_EepromData.ydiBackupMemory_xau16[9].amb_cond.ambient_condition[1][21] "ambient condition shot [0 .. 2-1] with 25 data bytes [0 .. 25-1] for the error code stored in this error memory slot" UBYTE EH_STANDARD_S5_S3 1 100 0 255 DISPLAY_IDENTIFIER ambient_condition[1][21].amb_cond.ydiBackupMemory_xau16[9].ZFEH_EepromData ECU_ADDRESS 0xFFF83076 /end MEASUREMENT
/begin MEASUREMENT ZFEH_EepromData.ydiBackupMemory_xau16[9].amb_cond.ambient_condition[1][22] "ambient condition shot [0 .. 2-1] with 25 data bytes [0 .. 25-1] for the error code stored in this error memory slot" UBYTE EH_STANDARD_S5_S3 1 100 0 255 DISPLAY_IDENTIFIER ambient_condition[1][22].amb_cond.ydiBackupMemory_xau16[9].ZFEH_EepromData ECU_ADDRESS 0xFFF83077 /end MEASUREMENT
/begin MEASUREMENT ZFEH_EepromData.ydiBackupMemory_xau16[9].amb_cond.ambient_condition[1][23] "ambient condition shot [0 .. 2-1] with 25 data bytes [0 .. 25-1] for the error code stored in this error memory slot" UBYTE EH_STANDARD_S5_S3 1 100 0 255 DISPLAY_IDENTIFIER ambient_condition[1][23].amb_cond.ydiBackupMemory_xau16[9].ZFEH_EepromData ECU_ADDRESS 0xFFF83078 /end MEASUREMENT
/begin MEASUREMENT ZFEH_EepromData.ydiBackupMemory_xau16[9].amb_cond.ambient_condition[1][24] "ambient condition shot [0 .. 2-1] with 25 data bytes [0 .. 25-1] for the error code stored in this error memory slot" UBYTE EH_STANDARD_S5_S3 1 100 0 255 DISPLAY_IDENTIFIER ambient_condition[1][24].amb_cond.ydiBackupMemory_xau16[9].ZFEH_EepromData ECU_ADDRESS 0xFFF83079 /end MEASUREMENT
/begin MEASUREMENT ZFEH_EepromData.ydiBackupMemory_xau16[9].amb_cond.status_of_ambient_conditions[0] "status of ambient condition shot x: 0=invalid 1=valid" UBYTE EH_STANDARD_S5_S3 1 100 0 1 DISPLAY_IDENTIFIER status_of_ambient_conditions[0].amb_cond.ydiBackupMemory_xau16[9].ZFEH_EepromData ECU_ADDRESS 0xFFF8307A /end MEASUREMENT
/begin MEASUREMENT ZFEH_EepromData.ydiBackupMemory_xau16[9].amb_cond.status_of_ambient_conditions[1] "status of ambient condition shot x: 0=invalid 1=valid" UBYTE EH_STANDARD_S5_S3 1 100 0 1 DISPLAY_IDENTIFIER status_of_ambient_conditions[1].amb_cond.ydiBackupMemory_xau16[9].ZFEH_EepromData ECU_ADDRESS 0xFFF8307B /end MEASUREMENT
/begin MEASUREMENT ZFEH_EepromData.ydiBackupMemory_xau16[9].error_code "error code stored in error memory slot" UWORD EH_STANDARD_S5_S3 1 100 0 65535 DISPLAY_IDENTIFIER error_code.ydiBackupMemory_xau16[9].ZFEH_EepromData ECU_ADDRESS 0xFFF83034 /end MEASUREMENT
/begin MEASUREMENT ZFEH_EepromData.ydiBackupMemory_xau16[9].error_type "error type of error code stored in error memory slot" UWORD EH_STANDARD_S5_S3 1 100 0 65535 DISPLAY_IDENTIFIER error_type.ydiBackupMemory_xau16[9].ZFEH_EepromData ECU_ADDRESS 0xFFF83036 /end MEASUREMENT
/begin MEASUREMENT ZFEH_EepromData.ydiBackupMemory_xau16[9].status_word "status word of error code stored in error memory slot" UWORD EH_STANDARD_S5_S3 1 100 0 65535 DISPLAY_IDENTIFIER status_word.ydiBackupMemory_xau16[9].ZFEH_EepromData ECU_ADDRESS 0xFFF83038 /end MEASUREMENT
/begin MEASUREMENT ZFEH_EepromData.ydiBackupMemory_xau16[9].frequency_counter "frequency counter of error code stored in error memory slot" UBYTE EH_STANDARD_S5_S3 1 100 0 255 DISPLAY_IDENTIFIER frequency_counter.ydiBackupMemory_xau16[9].ZFEH_EepromData ECU_ADDRESS 0xFFF8303A /end MEASUREMENT
/begin MEASUREMENT ZFEH_EepromData.ydiBackupMemory_xau16[9].backwards_counter "backwards counter of error code stored in error memory slot" UBYTE EH_STANDARD_S5_S3 1 100 0 255 DISPLAY_IDENTIFIER backwards_counter.ydiBackupMemory_xau16[9].ZFEH_EepromData ECU_ADDRESS 0xFFF8303B /end MEASUREMENT
/begin MEASUREMENT ZFEH_EepromData.ydiBackupMemory_xau16[9].permanent_counter "counter of permanent error codes stored in error memory slot" UBYTE EH_STANDARD_S5_S3 1 100 0 255 DISPLAY_IDENTIFIER permanent_counter.ydiBackupMemory_xau16[9].ZFEH_EepromData ECU_ADDRESS 0xFFF8303C /end MEASUREMENT
/begin MEASUREMENT ZFEH_EepromData.ydiBackupMemory_xau16[9].sequence_counter "sequence counter of error code stored in error memory slot" UBYTE EH_STANDARD_S5_S3 1 100 0 255 DISPLAY_IDENTIFIER sequence_counter.ydiBackupMemory_xau16[9].ZFEH_EepromData ECU_ADDRESS 0xFFF8303D /end MEASUREMENT
/begin MEASUREMENT ZFEH_EepromData.ydiBackupMemory_xau16[9].master_time "master time of error code stored in error memory slot" ULONG EH_STANDARD_S5_S3 1 100 0 4294967295 DISPLAY_IDENTIFIER master_time.ydiBackupMemory_xau16[9].ZFEH_EepromData ECU_ADDRESS 0xFFF83040 /end MEASUREMENT
/begin MEASUREMENT ZFEH_EepromData.ydiBackupMemory_xau16[9].condition_byte "condition byte of error code stored in error memory slot" UBYTE EH_STANDARD_S5_S3 1 100 0 255 DISPLAY_IDENTIFIER condition_byte.ydiBackupMemory_xau16[9].ZFEH_EepromData ECU_ADDRESS 0xFFF83045 /end MEASUREMENT
/begin MEASUREMENT ZFEH_EepromData.ydiBackupMemory_xau16[9].obd_driving_cycle_counter "obd driving cycle counter of error code stored in error memory slot" UWORD EH_STANDARD_S5_S3 1 100 0 65535 DISPLAY_IDENTIFIER obd_driving_cycle_counter.ydiBackupMemory_xau16[9].ZFEH_EepromData ECU_ADDRESS 0xFFF83046 /end MEASUREMENT
/begin COMPU_METHOD CONV_KFC_NAME "" TAB_VERB "%6.3" "" COMPU_TAB_REF CONV_TAB_KFC_NAME /end COMPU_METHOD
/begin COMPU_METHOD EH_STANDARD_S5_S3 "int = ((phys * 1) / 1) - (0) -" RAT_FUNC "%2.0" "-" COEFFS 0 1 -0 0 0 1 /end COMPU_METHOD
/begin COMPU_VTAB CONV_TAB_KFC_NAME "Conversion table" TAB_VERB 256 0 "empty" 1 "KFC1_OUT0" 2 "KFC2_OUT0" 3 "KFC1_OUT1" 4 "KFC2_OUT1" 5 "KFC1_OUT2" 6 "KFC2_OUT2" 7 "KFC1_OUT3" 8 "KFC2_OUT3" 9 "KFC1_OUT4" 10 "KFC2_OUT4" 11 "KFC1_OUT5" 12 "KFC2_OUT5" 13 "KFC1_OUT6" 14 "KFC2_OUT6" 15 "KFC1_OUT7" 16 "KFC2_OUT7" 17 "KFC1_OUT8" 18 "KFC2_OUT8" 19 "KFC1_OUT9" 20 "KFC2_OUT9" 21 "KFC1_OUT10" 22 "KFC2_OUT10" 23 "KFC1_OUT11" 24 "KFC2_OUT11" 25 "KFC1_OUT12" 26 "KFC2_OUT12" 27 "KFC1_OUT13" 28 "KFC2_OUT13" 29 "KFC1_OUT14" 30 "KFC2_OUT14" 31 "KFC_UDRMV1" 32 "KFC_UDRMV2" 33 "KFC_USENS1" 34 "KFC_RESUNDERVOLTAGE" 35 "KFC_RESSUP" 36 "KFC_RESZF" 37 "KFC_EEPROM" 38 "KFC_DISABLEERM" 39 "KFC_EPROM" 40 "KFC_N6PLAUSILEV2" 41 "KFC_TCUHOT" 42 "KFC_SFRM" 43 "KFC1_POSLEV2" 44 "KFC2_POSLEV2" 45 "KFC3_POSLEV2" 46 "KFC4_POSLEV2" 47 "KFC_NTUVIRTLEV2" 48 "KFC_SENSORLEV2" 49 "KFC_WDOG" 50 "KFC_MCCOMP" 51 "KFC_LEV2" 52 "KFC1_LEV2" 53 "KFC_VUNPLAUSILEV2" 54 "KFC3_LEV2" 55 "KFC_RATIOGEAR" 56 "KFC_RATIOA" 57 "KFC_RATIOB" 58 "KFC_RATIOC" 59 "KFC_RATIOD" 60 "KFC_RATIOE" 61 "KFC_RATIOAB" 62 "KFC_RATIOAD" 63 "KFC_RATIOBD" 64 "KFC_RATIOBE" 65 "KFC_RATIOCD" 66 "KFC_RATIOAE" 67 "KFC_RATIOAC" 68 "KFC_RATIOBC" 69 "KFC_RATIOCE" 70 "KFC_RATIODE" 71 "KFC_RATIOABC" 72 "KFC_RATIOABE" 73 "KFC_RATIOBCE" 74 "KFC_RATIOBDE" 75 "KFC_RATIOBCD" 76 "KFC_RATIOCDE" 77 "KFC_RATIOACD" 78 "KFC_RATIOADE" 79 "KFC_RATIOABD" 80 "KFC_RATIOSHIFT" 81 "KFC_RATIOSHIFT1" 82 "KFC_RATIOSHIFT2" 83 "KFC_RATIOSHIFT3" 84 "KFC_RATIOSHIFT4" 85 "KFC_RATIOSHIFT5" 86 "KFC_RATIOSHIFT6" 87 "KFC_RATIOSHIFT7" 88 "KFC_RATIOSHIFT8" 89 "KFC_UBATTU" 90 "KFC_UBATTL" 91 "KFC_UBATTO" 92 "KFC_N6LEV2" 93 "KFC5_CLUTCHOVERHEAT" 94 "KFC_NABLEV2" 95 "KFC_USENS" 96 "KFC_NABPLAUSILEV2" 97 "KFC_NWHEELPLAUSILEV2" 98 "KFC_PARK" 99 "KFC_STADARDY" 100 "KFC_CCHIP1LEV2" 101 "KFC_CGTLEV2" 102 "KFC_NMOUEB" 103 "KFC1_CLUTCHOVERHEAT" 104 "KFC_POSV" 105 "KFC_PEDALF" 106 "KFC_NWHEELLEV2" 107 "KFC_POSINFO1" 108 "KFC_POSINFO2" 109 "KFC_POSSBW" 110 "KFC_TARGETSPEED" 111 "KFC_CANB1" 112 "KFC_CANB2" 113 "KFC_PSIN" 114 "KFC_PSOUT" 115 "KFC_PSABUSE" 116 "KFC2_ENGSIGTRQ" 117 "KFC_ENGSIGEM" 118 "KFC2_CLUTCHOVERHEAT" 119 "KFC3_CLUTCHOVERHEAT" 120 "KFC_NMOE" 121 "KFC4_CLUTCHOVERHEAT" 122 "KFC_ERSATZ" 123 "KFC_TIPP" 124 "KFC_RESUB" 125 "KFC_RATIOGLOBAL" 126 "KFC2_PSOUT" 127 "KFC_TRANSM" 128 "KFC1_POSDISP" 129 "KFC_NMOFLL" 130 "KFC_PRLOGIC" 131 "KFC_CCHIP2LEV2" 132 "KFC_ENGSIG" 133 "KFC_BRAKEF" 134 "KFC_BRAKETRQ" 135 "KFC_DOOR" 136 "KFC_SEAT" 137 "KFC_OBDCYCLES" 138 "KFC_PINFO" 139 "KFC_INFOHOT1" 140 "KFC_INFOHOT2" 141 "KFC_INFO4" 142 "KFC_INFO5" 143 "KFC_CGTELECTRICERRLEV2" 144 "KFC_FEHLBAU" 145 "KFC_ACCELY" 146 "KFC_BRAKETRQDRV" 147 "KFC1_ENGSIGEM" 148 "KFC_FLASHNOTPOS" 149 "KFC_PSHOLDERR" 150 "KFC_PSABSERR" 151 "KFC_TMS" 152 "KFC_KL15" 153 "KFC1_KL15" 154 "KFC_C0SYNCHOT" 155 "KFC1_TRSMTRQ" 156 "KFC_OBD" 157 "KFC_INTME" 158 "KFC1_INTME" 159 "KFC_DMEG1" 160 "KFC_DMEG2" 161 "KFC_DMEG3" 162 "KFC_GWSACAN" 163 "KFC_GWSFACAN" 164 "KFC_INFOHOTWARNING2" 165 "KFC_INFOHOTWARNING3" 166 "KFC_INFO6" 167 "KFC3_ENGSIGTRQ" 168 "KFC_DSCG1" 169 "KFC_DSCG2" 170 "KFC_DSCG3" 171 "KFC_C0DEFECTHOT" 172 "KFC_INFO9" 173 "KFC_INFO10" 174 "KFC_MAXDECELERATION" 175 "KFC_FEMG1" 176 "KFC_FEMG2" 177 "KFC_FEMG3" 178 "KFC1_SENSORLEV2" 179 "KFC2_ENGSIGEM" 180 "KFC_NEMNEGDIR" 181 "KFC_EGNERENABLED" 182 "KFC_EGNERFAILED" 183 "KFC_EGNERMISUSE" 184 "KFC_CIC" 185 "KFC_ICMG1" 186 "KFC_ICMG2" 187 "KFC_ICMG3" 188 "KFC_C0CLOSEASYNC" 189 "KFC_PARKASSIST" 190 "KFC_HASCYCERR" 191 "KFC_HASCYCNEMERR" 192 "KFC_INSTG1" 193 "KFC_INSTG2" 194 "KFC_INSTG3" 195 "KFC_SZL1" 196 "KFC_ACSM1" 197 "KFC1_UBATTU" 198 "KFC_AHM1" 199 "KFC_ENGWATCOOL" 200 "KFC_EWSSCAN" 201 "KFC_EWSDRVRQ" 202 "KFC_NEMPSYS" 203 "KFC_NEGTRQREQHAS" 204 "KFC_TARGETTRQEM" 205 "KFC_HASERROR" 206 "KFC_VEHDYNREG" 207 "KFC_SME" 208 "KFC_TRQ" 209 "KFC_EMEG1" 210 "KFC_EMEG2" 211 "KFC_EMEG3" 212 "KFC_ENGSIGINFO" 213 "KFC_INFON" 214 "KFC_INFOHOTWARNING" 215 "KFC_DMEOBD" 216 "KFC_POSNPLAUSI" 217 "KFC1_ENGSIGTRQ" 218 "KFC_IAENOOPEN" 219 "KFC_IAENOCLOSE" 220 "KFC_IAECLOSE" 221 "KFC_IAEHOT" 222 "KFC_HASCYCNEMERR2" 223 "KFC_C0DEFECT" 224 "KFC_SAFETYPARMISM" 225 "KFC_IEP" 226 "KFC_ZGW" 227 "KFC1_IEPERROR" 228 "KFC_C0NOCLOSE" 229 "KFC_TARGETSPEEDVM" 230 "KFC_TARGETSPEEDEM" 231 "KFC_MINSPEEDEM" 232 "KFC_IEPLEV2" 233 "KFC_HASCYCNVMERR" 234 "KFC_NABGRAD" 235 "KFC_C0HOT" 236 "KFC_C0CLOSELEV2" 237 "KFC_CGTJUMPLEV2" 238 "KFC_CGTPLAUSILEV2" 239 "KFC_CCHIP2PLAUSILEV2" 240 "KFC_CCHIP1PLAUSILEV2" 241 "KFC1_NEGTRQREQ" 242 "KFC_IEPCOM" 243 "KFC_RATIOIEPSYM" 244 "KFC_RATIOIEP" 245 "KFC_C0NOOPEN" 246 "CODING_EVENT_NOT_CODED" 247 "CODING_EVENT_TRANSACTION_FAILED" 248 "CODING_EVENT_SIGNATURE_ERROR" 249 "CODING_EVENT_WRONG_VEHICLE" 250 "CODING_EVENT_INVALID_DATA" 251 "DM_EVENT_ZEITBOTSCHAFTTIMEOUT" 252 "DM_TEST_APPL" 253 "DM_TEST_COM" 254 "VSM_EVENT_OPMODE" 255 "DI_EC_NUMBER_ENTRIES" DEFAULT_VALUE "unknown" /end COMPU_VTAB
/begin FUNCTION zff_EH_ErrorMemoryInformation "desc_en"
 /begin LOC_MEASUREMENT ZFEH_EepromData.ydiBackupMemory_xau16[6].amb_cond.ambient_condition[1][8] ZFEH_EepromData.ydiBackupMemory_xau16[6].amb_cond.ambient_condition[1][9] ZFEH_EepromData.ydiBackupMemory_xau16[6].amb_cond.status_of_ambient_conditions[0] ZFEH_EepromData.ydiBackupMemory_xau16[6].amb_cond.status_of_ambient_conditions[1] ZFEH_EepromData.ydiBackupMemory_xau16[6].backwards_counter ZFEH_EepromData.ydiBackupMemory_xau16[6].condition_byte ZFEH_EepromData.ydiBackupMemory_xau16[6].error_code ZFEH_EepromData.ydiBackupMemory_xau16[6].error_type ZFEH_EepromData.ydiBackupMemory_xau16[6].frequency_counter ZFEH_EepromData.ydiBackupMemory_xau16[6].master_time ZFEH_EepromData.ydiBackupMemory_xau16[6].obd_driving_cycle_counter ZFEH_EepromData.ydiBackupMemory_xau16[6].permanent_counter ZFEH_EepromData.ydiBackupMemory_xau16[6].sequence_counter ZFEH_EepromData.ydiBackupMemory_xau16[6].status_word ZFEH_EepromData.ydiBackupMemory_xau16[7].amb_cond.ambient_condition[0][0] ZFEH_EepromData.ydiBackupMemory_xau16[7].amb_cond.ambient_condition[0][10] ZFEH_EepromData.ydiBackupMemory_xau16[7].amb_cond.ambient_condition[0][11] ZFEH_EepromData.ydiBackupMemory_xau16[7].amb_cond.ambient_condition[0][12] ZFEH_EepromData.ydiBackupMemory_xau16[7].amb_cond.ambient_condition[0][13] ZFEH_EepromData.ydiBackupMemory_xau16[7].amb_cond.ambient_condition[0][14] ZFEH_EepromData.ydiBackupMemory_xau16[7].amb_cond.ambient_condition[0][15] ZFEH_EepromData.ydiBackupMemory_xau16[7].amb_cond.ambient_condition[0][16] ZFEH_EepromData.ydiBackupMemory_xau16[7].amb_cond.ambient_condition[0][17] ZFEH_EepromData.ydiBackupMemory_xau16[7].amb_cond.ambient_condition[0][18] ZFEH_EepromData.ydiBackupMemory_xau16[7].amb_cond.ambient_condition[0][19] ZFEH_EepromData.ydiBackupMemory_xau16[7].amb_cond.ambient_condition[0][1] ZFEH_EepromData.ydiBackupMemory_xau16[7].amb_cond.ambient_condition[0][20] ZFEH_EepromData.ydiBackupMemory_xau16[7].amb_cond.ambient_condition[0][21] ZFEH_EepromData.ydiBackupMemory_xau16[7].amb_cond.ambient_condition[0][22] ZFEH_EepromData.ydiBackupMemory_xau16[7].amb_cond.ambient_condition[0][23] ZFEH_EepromData.ydiBackupMemory_xau16[7].amb_cond.ambient_condition[0][24] ZFEH_EepromData.ydiBackupMemory_xau16[7].amb_cond.ambient_condition[0][2] ZFEH_EepromData.ydiBackupMemory_xau16[7].amb_cond.ambient_condition[0][3] ZFEH_EepromData.ydiBackupMemory_xau16[7].amb_cond.ambient_condition[0][4] ZFEH_EepromData.ydiBackupMemory_xau16[7].amb_cond.ambient_condition[0][5] ZFEH_EepromData.ydiBackupMemory_xau16[7].amb_cond.ambient_condition[0][6] ZFEH_EepromData.ydiBackupMemory_xau16[7].amb_cond.ambient_condition[0][7] ZFEH_EepromData.ydiBackupMemory_xau16[7].amb_cond.ambient_condition[0][8] ZFEH_EepromData.ydiBackupMemory_xau16[7].amb_cond.ambient_condition[0][9] ZFEH_EepromData.ydiBackupMemory_xau16[7].amb_cond.ambient_condition[1][0] ZFEH_EepromData.ydiBackupMemory_xau16[7].amb_cond.ambient_condition[1][10] ZFEH_EepromData.ydiBackupMemory_xau16[7].amb_cond.ambient_condition[1][11] ZFEH_EepromData.ydiBackupMemory_xau16[7].amb_cond.ambient_condition[1][12] ZFEH_EepromData.ydiBackupMemory_xau16[7].amb_cond.ambient_condition[1][13] ZFEH_EepromData.ydiBackupMemory_xau16[7].amb_cond.ambient_condition[1][14] ZFEH_EepromData.ydiBackupMemory_xau16[7].amb_cond.ambient_condition[1][15] ZFEH_EepromData.ydiBackupMemory_xau16[7].amb_cond.ambient_condition[1][16] ZFEH_EepromData.ydiBackupMemory_xau16[7].amb_cond.ambient_condition[1][17] ZFEH_EepromData.ydiBackupMemory_xau16[7].amb_cond.ambient_condition[1][18] ZFEH_EepromData.ydiBackupMemory_xau16[7].amb_cond.ambient_condition[1][19] ZFEH_EepromData.ydiBackupMemory_xau16[7].amb_cond.ambient_condition[1][1] ZFEH_EepromData.ydiBackupMemory_xau16[7].amb_cond.ambient_condition[1][20] ZFEH_EepromData.ydiBackupMemory_xau16[7].amb_cond.ambient_condition[1][21] ZFEH_EepromData.ydiBackupMemory_xau16[7].amb_cond.ambient_condition[1][22] ZFEH_EepromData.ydiBackupMemory_xau16[7].amb_cond.ambient_condition[1][23] ZFEH_EepromData.ydiBackupMemory_xau16[7].amb_cond.ambient_condition[1][24] ZFEH_EepromData.ydiBackupMemory_xau16[7].amb_cond.ambient_condition[1][2] ZFEH_EepromData.ydiBackupMemory_xau16[7].amb_cond.ambient_condition[1][3] ZFEH_EepromData.ydiBackupMemory_xau16[7].amb_cond.ambient_condition[1][4] ZFEH_EepromData.ydiBackupMemory_xau16[7].amb_cond.ambient_condition[1][5] ZFEH_EepromData.ydiBackupMemory_xau16[7].amb_cond.ambient_condition[1][6] ZFEH_EepromData.ydiBackupMemory_xau16[7].amb_cond.ambient_condition[1][7] ZFEH_EepromData.ydiBackupMemory_xau16[7].amb_cond.ambient_condition[1][8] ZFEH_EepromData.ydiBackupMemory_xau16[7].amb_cond.ambient_condition[1][9] ZFEH_EepromData.ydiBackupMemory_xau16[7].amb_cond.status_of_ambient_conditions[0] ZFEH_EepromData.ydiBackupMemory_xau16[7].amb_cond.status_of_ambient_conditions[1] ZFEH_EepromData.ydiBackupMemory_xau16[7].backwards_counter ZFEH_EepromData.ydiBackupMemory_xau16[7].condition_byte ZFEH_EepromData.ydiBackupMemory_xau16[7].error_code ZFEH_EepromData.ydiBackupMemory_xau16[7].error_type ZFEH_EepromData.ydiBackupMemory_xau16[7].frequency_counter ZFEH_EepromData.ydiBackupMemory_xau16[7].master_time ZFEH_EepromData.ydiBackupMemory_xau16[7].obd_driving_cycle_counter ZFEH_EepromData.ydiBackupMemory_xau16[7].permanent_counter ZFEH_EepromData.ydiBackupMemory_xau16[7].sequence_counter ZFEH_EepromData.ydiBackupMemory_xau16[7].status_word ZFEH_EepromData.ydiBackupMemory_xau16[8].amb_cond.ambient_condition[0][0] ZFEH_EepromData.ydiBackupMemory_xau16[8].amb_cond.ambient_condition[0][10] ZFEH_EepromData.ydiBackupMemory_xau16[8].amb_cond.ambient_condition[0][11] ZFEH_EepromData.ydiBackupMemory_xau16[8].amb_cond.ambient_condition[0][12] ZFEH_EepromData.ydiBackupMemory_xau16[8].amb_cond.ambient_condition[0][13] ZFEH_EepromData.ydiBackupMemory_xau16[8].amb_cond.ambient_condition[0][14] ZFEH_EepromData.ydiBackupMemory_xau16[8].amb_cond.ambient_condition[0][15] ZFEH_EepromData.ydiBackupMemory_xau16[8].amb_cond.ambient_condition[0][16] ZFEH_EepromData.ydiBackupMemory_xau16[8].amb_cond.ambient_condition[0][17] ZFEH_EepromData.ydiBackupMemory_xau16[8].amb_cond.ambient_condition[0][18] ZFEH_EepromData.ydiBackupMemory_xau16[8].amb_cond.ambient_condition[0][19] ZFEH_EepromData.ydiBackupMemory_xau16[8].amb_cond.ambient_condition[0][1] ZFEH_EepromData.ydiBackupMemory_xau16[8].amb_cond.ambient_condition[0][20] ZFEH_EepromData.ydiBackupMemory_xau16[8].amb_cond.ambient_condition[0][21] ZFEH_EepromData.ydiBackupMemory_xau16[8].amb_cond.ambient_condition[0][22] ZFEH_EepromData.ydiBackupMemory_xau16[8].amb_cond.ambient_condition[0][23] ZFEH_EepromData.ydiBackupMemory_xau16[8].amb_cond.ambient_condition[0][24] ZFEH_EepromData.ydiBackupMemory_xau16[8].amb_cond.ambient_condition[0][2] ZFEH_EepromData.ydiBackupMemory_xau16[8].amb_cond.ambient_condition[0][3] ZFEH_EepromData.ydiBackupMemory_xau16[8].amb_cond.ambient_condition[0][4] ZFEH_EepromData.ydiBackupMemory_xau16[8].amb_cond.ambient_condition[0][5] ZFEH_EepromData.ydiBackupMemory_xau16[8].amb_cond.ambient_condition[0][6] ZFEH_EepromData.ydiBackupMemory_xau16[8].amb_cond.ambient_condition[0][7] ZFEH_EepromData.ydiBackupMemory_xau16[8].amb_cond.ambient_condition[0][8] ZFEH_EepromData.ydiBackupMemory_xau16[8].amb_cond.ambient_condition[0][9] ZFEH_EepromData.ydiBackupMemory_xau16[8].amb_cond.ambient_condition[1][0] ZFEH_EepromData.ydiBackupMemory_xau16[8].amb_cond.ambient_condition[1][10] ZFEH_EepromData.ydiBackupMemory_xau16[8].amb_cond.ambient_condition[1][11] ZFEH_EepromData.ydiBackupMemory_xau16[8].amb_cond.ambient_condition[1][12] ZFEH_EepromData.ydiBackupMemory_xau16[8].amb_cond.ambient_condition[1][13] ZFEH_EepromData.ydiBackupMemory_xau16[8].amb_cond.ambient_condition[1][14] ZFEH_EepromData.ydiBackupMemory_xau16[8].amb_cond.ambient_condition[1][15] ZFEH_EepromData.ydiBackupMemory_xau16[8].amb_cond.ambient_condition[1][16] ZFEH_EepromData.ydiBackupMemory_xau16[8].amb_cond.ambient_condition[1][17] ZFEH_EepromData.ydiBackupMemory_xau16[8].amb_cond.ambient_condition[1][18] ZFEH_EepromData.ydiBackupMemory_xau16[8].amb_cond.ambient_condition[1][19] ZFEH_EepromData.ydiBackupMemory_xau16[8].amb_cond.ambient_condition[1][1] ZFEH_EepromData.ydiBackupMemory_xau16[8].amb_cond.ambient_condition[1][20] ZFEH_EepromData.ydiBackupMemory_xau16[8].amb_cond.ambient_condition[1][21] ZFEH_EepromData.ydiBackupMemory_xau16[8].amb_cond.ambient_condition[1][22] ZFEH_EepromData.ydiBackupMemory_xau16[8].amb_cond.ambient_condition[1][23] ZFEH_EepromData.ydiBackupMemory_xau16[8].amb_cond.ambient_condition[1][24] ZFEH_EepromData.ydiBackupMemory_xau16[8].amb_cond.ambient_condition[1][2] ZFEH_EepromData.ydiBackupMemory_xau16[8].amb_cond.ambient_condition[1][3] ZFEH_EepromData.ydiBackupMemory_xau16[8].amb_cond.ambient_condition[1][4] ZFEH_EepromData.ydiBackupMemory_xau16[8].amb_cond.ambient_condition[1][5] ZFEH_EepromData.ydiBackupMemory_xau16[8].amb_cond.ambient_condition[1][6] ZFEH_EepromData.ydiBackupMemory_xau16[8].amb_cond.ambient_condition[1][7] ZFEH_EepromData.ydiBackupMemory_xau16[8].amb_cond.ambient_condition[1][8] ZFEH_EepromData.ydiBackupMemory_xau16[8].amb_cond.ambient_condition[1][9] ZFEH_EepromData.ydiBackupMemory_xau16[8].amb_cond.status_of_ambient_conditions[0] ZFEH_EepromData.ydiBackupMemory_xau16[8].amb_cond.status_of_ambient_conditions[1] ZFEH_EepromData.ydiBackupMemory_xau16[8].backwards_counter ZFEH_EepromData.ydiBackupMemory_xau16[8].condition_byte ZFEH_EepromData.ydiBackupMemory_xau16[8].error_code ZFEH_EepromData.ydiBackupMemory_xau16[8].error_type ZFEH_EepromData.ydiBackupMemory_xau16[8].frequency_counter ZFEH_EepromData.ydiBackupMemory_xau16[8].master_time ZFEH_EepromData.ydiBackupMemory_xau16[8].obd_driving_cycle_counter ZFEH_EepromData.ydiBackupMemory_xau16[8].permanent_counter ZFEH_EepromData.ydiBackupMemory_xau16[8].sequence_counter ZFEH_EepromData.ydiBackupMemory_xau16[8].status_word ZFEH_EepromData.ydiBackupMemory_xau16[9].amb_cond.ambient_condition[0][0] ZFEH_EepromData.ydiBackupMemory_xau16[9].amb_cond.ambient_condition[0][10] ZFEH_EepromData.ydiBackupMemory_xau16[9].amb_cond.ambient_condition[0][11] ZFEH_EepromData.ydiBackupMemory_xau16[9].amb_cond.ambient_condition[0][12] ZFEH_EepromData.ydiBackupMemory_xau16[9].amb_cond.ambient_condition[0][13] ZFEH_EepromData.ydiBackupMemory_xau16[9].amb_cond.ambient_condition[0][14] ZFEH_EepromData.ydiBackupMemory_xau16[9].amb_cond.ambient_condition[0][15] ZFEH_EepromData.ydiBackupMemory_xau16[9].amb_cond.ambient_condition[0][16] ZFEH_EepromData.ydiBackupMemory_xau16[9].amb_cond.ambient_condition[0][17] ZFEH_EepromData.ydiBackupMemory_xau16[9].amb_cond.ambient_condition[0][18] ZFEH_EepromData.ydiBackupMemory_xau16[9].amb_cond.ambient_condition[0][19] ZFEH_EepromData.ydiBackupMemory_xau16[9].amb_cond.ambient_condition[0][1] ZFEH_EepromData.ydiBackupMemory_xau16[9].amb_cond.ambient_condition[0][20] ZFEH_EepromData.ydiBackupMemory_xau16[9].amb_cond.ambient_condition[0][21] ZFEH_EepromData.ydiBackupMemory_xau16[9].amb_cond.ambient_condition[0][22] ZFEH_EepromData.ydiBackupMemory_xau16[9].amb_cond.ambient_condition[0][23] ZFEH_EepromData.ydiBackupMemory_xau16[9].amb_cond.ambient_condition[0][24] ZFEH_EepromData.ydiBackupMemory_xau16[9].amb_cond.ambient_condition[0][2] ZFEH_EepromData.ydiBackupMemory_xau16[9].amb_cond.ambient_condition[0][3] ZFEH_EepromData.ydiBackupMemory_xau16[9].amb_cond.ambient_condition[0][4] ZFEH_EepromData.ydiBackupMemory_xau16[9].amb_cond.ambient_condition[0][5] ZFEH_EepromData.ydiBackupMemory_xau16[9].amb_cond.ambient_condition[0][6] ZFEH_EepromData.ydiBackupMemory_xau16[9].amb_cond.ambient_condition[0][7] ZFEH_EepromData.ydiBackupMemory_xau16[9].amb_cond.ambient_condition[0][8] ZFEH_EepromData.ydiBackupMemory_xau16[9].amb_cond.ambient_condition[0][9] ZFEH_EepromData.ydiBackupMemory_xau16[9].amb_cond.ambient_condition[1][0] ZFEH_EepromData.ydiBackupMemory_xau16[9].amb_cond.ambient_condition[1][10] ZFEH_EepromData.ydiBackupMemory_xau16[9].amb_cond.ambient_condition[1][11] ZFEH_EepromData.ydiBackupMemory_xau16[9].amb_cond.ambient_condition[1][12] ZFEH_EepromData.ydiBackupMemory_xau16[9].amb_cond.ambient_condition[1][13] ZFEH_EepromData.ydiBackupMemory_xau16[9].amb_cond.ambient_condition[1][14] ZFEH_EepromData.ydiBackupMemory_xau16[9].amb_cond.ambient_condition[1][15] ZFEH_EepromData.ydiBackupMemory_xau16[9].amb_cond.ambient_condition[1][16] ZFEH_EepromData.ydiBackupMemory_xau16[9].amb_cond.ambient_condition[1][17] ZFEH_EepromData.ydiBackupMemory_xau16[9].amb_cond.ambient_condition[1][18] ZFEH_EepromData.ydiBackupMemory_xau16[9].amb_cond.ambient_condition[1][19] ZFEH_EepromData.ydiBackupMemory_xau16[9].amb_cond.ambient_condition[1][1] ZFEH_EepromData.ydiBackupMemory_xau16[9].amb_cond.ambient_condition[1][20] ZFEH_EepromData.ydiBackupMemory_xau16[9].amb_cond.ambient_condition[1][21] ZFEH_EepromData.ydiBackupMemory_xau16[9].amb_cond.ambient_condition[1][22] ZFEH_EepromData.ydiBackupMemory_xau16[9].amb_cond.ambient_condition[1][23] ZFEH_EepromData.ydiBackupMemory_xau16[9].amb_cond.ambient_condition[1][24] ZFEH_EepromData.ydiBackupMemory_xau16[9].amb_cond.ambient_condition[1][2] ZFEH_EepromData.ydiBackupMemory_xau16[9].amb_cond.ambient_condition[1][3] ZFEH_EepromData.ydiBackupMemory_xau16[9].amb_cond.ambient_condition[1][4] ZFEH_EepromData.ydiBackupMemory_xau16[9].amb_cond.ambient_condition[1][5] ZFEH_EepromData.ydiBackupMemory_xau16[9].amb_cond.ambient_condition[1][6] ZFEH_EepromData.ydiBackupMemory_xau16[9].amb_cond.ambient_condition[1][7] ZFEH_EepromData.ydiBackupMemory_xau16[9].amb_cond.ambient_condition[1][8] ZFEH_EepromData.ydiBackupMemory_xau16[9].amb_cond.ambient_condition[1][9] ZFEH_EepromData.ydiBackupMemory_xau16[9].amb_cond.status_of_ambient_conditions[0] ZFEH_EepromData.ydiBackupMemory_xau16[9].amb_cond.status_of_ambient_conditions[1] ZFEH_EepromData.ydiBackupMemory_xau16[9].backwards_counter ZFEH_EepromData.ydiBackupMemory_xau16[9].condition_byte ZFEH_EepromData.ydiBackupMemory_xau16[9].error_code ZFEH_EepromData.ydiBackupMemory_xau16[9].error_type ZFEH_EepromData.ydiBackupMemory_xau16[9].frequency_counter ZFEH_EepromData.ydiBackupMemory_xau16[9].master_time ZFEH_EepromData.ydiBackupMemory_xau16[9].obd_driving_cycle_counter ZFEH_EepromData.ydiBackupMemory_xau16[9].permanent_counter ZFEH_EepromData.ydiBackupMemory_xau16[9].sequence_counter ZFEH_EepromData.ydiBackupMemory_xau16[9].status_word ZFEH_EepromData.ydiMemory_xau16[0].amb_cond.ambient_condition[0][0] ZFEH_EepromData.ydiMemory_xau16[0].amb_cond.ambient_condition[0][10] ZFEH_EepromData.ydiMemory_xau16[0].amb_cond.ambient_condition[0][11] ZFEH_EepromData.ydiMemory_xau16[0].amb_cond.ambient_condition[0][12] ZFEH_EepromData.ydiMemory_xau16[0].amb_cond.ambient_condition[0][13] ZFEH_EepromData.ydiMemory_xau16[0].amb_cond.ambient_condition[0][14] ZFEH_EepromData.ydiMemory_xau16[0].amb_cond.ambient_condition[0][15] ZFEH_EepromData.ydiMemory_xau16[0].amb_cond.ambient_condition[0][16] ZFEH_EepromData.ydiMemory_xau16[0].amb_cond.ambient_condition[0][17] ZFEH_EepromData.ydiMemory_xau16[0].amb_cond.ambient_condition[0][18] ZFEH_EepromData.ydiMemory_xau16[0].amb_cond.ambient_condition[0][19] ZFEH_EepromData.ydiMemory_xau16[0].amb_cond.ambient_condition[0][1] ZFEH_EepromData.ydiMemory_xau16[0].amb_cond.ambient_condition[0][20] ZFEH_EepromData.ydiMemory_xau16[0].amb_cond.ambient_condition[0][21] ZFEH_EepromData.ydiMemory_xau16[0].amb_cond.ambient_condition[0][22] ZFEH_EepromData.ydiMemory_xau16[0].amb_cond.ambient_condition[0][23] ZFEH_EepromData.ydiMemory_xau16[0].amb_cond.ambient_condition[0][24] ZFEH_EepromData.ydiMemory_xau16[0].amb_cond.ambient_condition[0][2] ZFEH_EepromData.ydiMemory_xau16[0].amb_cond.ambient_condition[0][3] ZFEH_EepromData.ydiMemory_xau16[0].amb_cond.ambient_condition[0][4] ZFEH_EepromData.ydiMemory_xau16[0].amb_cond.ambient_condition[0][5] ZFEH_EepromData.ydiMemory_xau16[0].amb_cond.ambient_condition[0][6] ZFEH_EepromData.ydiMemory_xau16[0].amb_cond.ambient_condition[0][7] ZFEH_EepromData.ydiMemory_xau16[0].amb_cond.ambient_condition[0][8] ZFEH_EepromData.ydiMemory_xau16[0].amb_cond.ambient_condition[0][9] ZFEH_EepromData.ydiMemory_xau16[0].amb_cond.ambient_condition[1][0] ZFEH_EepromData.ydiMemory_xau16[0].amb_cond.ambient_condition[1][10] ZFEH_EepromData.ydiMemory_xau16[0].amb_cond.ambient_condition[1][11] ZFEH_EepromData.ydiMemory_xau16[0].amb_cond.ambient_condition[1][12] ZFEH_EepromData.ydiMemory_xau16[0].amb_cond.ambient_condition[1][13] ZFEH_EepromData.ydiMemory_xau16[0].amb_cond.ambient_condition[1][14] ZFEH_EepromData.ydiMemory_xau16[0].amb_cond.ambient_condition[1][15] ZFEH_EepromData.ydiMemory_xau16[0].amb_cond.ambient_condition[1][16] ZFEH_EepromData.ydiMemory_xau16[0].amb_cond.ambient_condition[1][17] ZFEH_EepromData.ydiMemory_xau16[0].amb_cond.ambient_condition[1][18] ZFEH_EepromData.ydiMemory_xau16[0].amb_cond.ambient_condition[1][19] ZFEH_EepromData.ydiMemory_xau16[0].amb_cond.ambient_condition[1][1] ZFEH_EepromData.ydiMemory_xau16[0].amb_cond.ambient_condition[1][20] ZFEH_EepromData.ydiMemory_xau16[0].amb_cond.ambient_condition[1][21] ZFEH_EepromData.ydiMemory_xau16[0].amb_cond.ambient_condition[1][22] ZFEH_EepromData.ydiMemory_xau16[0].amb_cond.ambient_condition[1][23] ZFEH_EepromData.ydiMemory_xau16[0].amb_cond.ambient_condition[1][24] ZFEH_EepromData.ydiMemory_xau16[0].amb_cond.ambient_condition[1][2] ZFEH_EepromData.ydiMemory_xau16[0].amb_cond.ambient_condition[1][3] ZFEH_EepromData.ydiMemory_xau16[0].amb_cond.ambient_condition[1][4] ZFEH_EepromData.ydiMemory_xau16[0].amb_cond.ambient_condition[1][5] ZFEH_EepromData.ydiMemory_xau16[0].amb_cond.ambient_condition[1][6] ZFEH_EepromData.ydiMemory_xau16[0].amb_cond.ambient_condition[1][7] ZFEH_EepromData.ydiMemory_xau16[0].amb_cond.ambient_condition[1][8] ZFEH_EepromData.ydiMemory_xau16[0].amb_cond.ambient_condition[1][9] ZFEH_EepromData.ydiMemory_xau16[0].amb_cond.status_of_ambient_conditions[0] ZFEH_EepromData.ydiMemory_xau16[0].amb_cond.status_of_ambient_conditions[1] ZFEH_EepromData.ydiMemory_xau16[0].backwards_counter ZFEH_EepromData.ydiMemory_xau16[0].condition_byte ZFEH_EepromData.ydiMemory_xau16[0].error_code ZFEH_EepromData.ydiMemory_xau16[0].error_type ZFEH_EepromData.ydiMemory_xau16[0].frequency_counter ZFEH_EepromData.ydiMemory_xau16[0].master_time ZFEH_EepromData.ydiMemory_xau16[0].obd_driving_cycle_counter ZFEH_EepromData.ydiMemory_xau16[0].permanent_counter ZFEH_EepromData.ydiMemory_xau16[0].sequence_counter ZFEH_EepromData.ydiMemory_xau16[0].status_word ZFEH_EepromData.ydiMemory_xau16[10].amb_cond.ambient_condition[0][0] ZFEH_EepromData.ydiMemory_xau16[10].amb_cond.ambient_condition[0][10] ZFEH_EepromData.ydiMemory_xau16[10].amb_cond.ambient_condition[0][11] ZFEH_EepromData.ydiMemory_xau16[10].amb_cond.ambient_condition[0][12] ZFEH_EepromData.ydiMemory_xau16[10].amb_cond.ambient_condition[0][13] ZFEH_EepromData.ydiMemory_xau16[10].amb_cond.ambient_condition[0][14] ZFEH_EepromData.ydiMemory_xau16[10].amb_cond.ambient_condition[0][15] ZFEH_EepromData.ydiMemory_xau16[10].amb_cond.ambient_condition[0][16] ZFEH_EepromData.ydiMemory_xau16[10].amb_cond.ambient_condition[0][17] ZFEH_EepromData.ydiMemory_xau16[10].amb_cond.ambient_condition[0][18] ZFEH_EepromData.ydiMemory_xau16[10].amb_cond.ambient_condition[0][19] ZFEH_EepromData.ydiMemory_xau16[10].amb_cond.ambient_condition[0][1] ZFEH_EepromData.ydiMemory_xau16[10].amb_cond.ambient_condition[0][20] ZFEH_EepromData.ydiMemory_xau16[10].amb_cond.ambient_condition[0][21] ZFEH_EepromData.ydiMemory_xau16[10].amb_cond.ambient_condition[0][22] ZFEH_EepromData.ydiMemory_xau16[10].amb_cond.ambient_condition[0][23] ZFEH_EepromData.ydiMemory_xau16[10].amb_cond.ambient_condition[0][24] ZFEH_EepromData.ydiMemory_xau16[10].amb_cond.ambient_condition[0][2] ZFEH_EepromData.ydiMemory_xau16[10].amb_cond.ambient_condition[0][3] ZFEH_EepromData.ydiMemory_xau16[10].amb_cond.ambient_condition[0][4] ZFEH_EepromData.ydiMemory_xau16[10].amb_cond.ambient_condition[0][5] ZFEH_EepromData.ydiMemory_xau16[10].amb_cond.ambient_condition[0][6] ZFEH_EepromData.ydiMemory_xau16[10].amb_cond.ambient_condition[0][7] ZFEH_EepromData.ydiMemory_xau16[10].amb_cond.ambient_condition[0][8] ZFEH_EepromData.ydiMemory_xau16[10].amb_cond.ambient_condition[0][9] ZFEH_EepromData.ydiMemory_xau16[10].amb_cond.ambient_condition[1][0] ZFEH_EepromData.ydiMemory_xau16[10].amb_cond.ambient_condition[1][10] ZFEH_EepromData.ydiMemory_xau16[10].amb_cond.ambient_condition[1][11] ZFEH_EepromData.ydiMemory_xau16[10].amb_cond.ambient_condition[1][12] ZFEH_EepromData.ydiMemory_xau16[10].amb_cond.ambient_condition[1][13] ZFEH_EepromData.ydiMemory_xau16[10].amb_cond.ambient_condition[1][14] ZFEH_EepromData.ydiMemory_xau16[10].amb_cond.ambient_condition[1][15] ZFEH_EepromData.ydiMemory_xau16[10].amb_cond.ambient_condition[1][16] ZFEH_EepromData.ydiMemory_xau16[10].amb_cond.ambient_condition[1][17] ZFEH_EepromData.ydiMemory_xau16[10].amb_cond.ambient_condition[1][18] ZFEH_EepromData.ydiMemory_xau16[10].amb_cond.ambient_condition[1][19] ZFEH_EepromData.ydiMemory_xau16[10].amb_cond.ambient_condition[1][1] ZFEH_EepromData.ydiMemory_xau16[10].amb_cond.ambient_condition[1][20] ZFEH_EepromData.ydiMemory_xau16[10].amb_cond.ambient_condition[1][21] ZFEH_EepromData.ydiMemory_xau16[10].amb_cond.ambient_condition[1][22] ZFEH_EepromData.ydiMemory_xau16[10].amb_cond.ambient_condition[1][23] ZFEH_EepromData.ydiMemory_xau16[10].amb_cond.ambient_condition[1][24] ZFEH_EepromData.ydiMemory_xau16[10].amb_cond.ambient_condition[1][2] ZFEH_EepromData.ydiMemory_xau16[10].amb_cond.ambient_condition[1][3] ZFEH_EepromData.ydiMemory_xau16[10].amb_cond.ambient_condition[1][4] ZFEH_EepromData.ydiMemory_xau16[10].amb_cond.ambient_condition[1][5] ZFEH_EepromData.ydiMemory_xau16[10].amb_cond.ambient_condition[1][6] ZFEH_EepromData.ydiMemory_xau16[10].amb_cond.ambient_condition[1][7] ZFEH_EepromData.ydiMemory_xau16[10].amb_cond.ambient_condition[1][8] ZFEH_EepromData.ydiMemory_xau16[10].amb_cond.ambient_condition[1][9] ZFEH_EepromData.ydiMemory_xau16[10].amb_cond.status_of_ambient_conditions[0] ZFEH_EepromData.ydiMemory_xau16[10].amb_cond.status_of_ambient_conditions[1] ZFEH_EepromData.ydiMemory_xau16[10].backwards_counter ZFEH_EepromData.ydiMemory_xau16[10].condition_byte ZFEH_EepromData.ydiMemory_xau16[10].error_code ZFEH_EepromData.ydiMemory_xau16[10].error_type ZFEH_EepromData.ydiMemory_xau16[10].frequency_counter ZFEH_EepromData.ydiMemory_xau16[10].master_time ZFEH_EepromData.ydiMemory_xau16[10].obd_driving_cycle_counter ZFEH_EepromData.ydiMemory_xau16[10].permanent_counter ZFEH_EepromData.ydiMemory_xau16[10].sequence_counter ZFEH_EepromData.ydiMemory_xau16[10].status_word ZFEH_EepromData.ydiMemory_xau16[11].amb_cond.ambient_condition[0][0] ZFEH_EepromData.ydiMemory_xau16[11].amb_cond.ambient_condition[0][10] ZFEH_EepromData.ydiMemory_xau16[11].amb_cond.ambient_condition[0][11] ZFEH_EepromData.ydiMemory_xau16[11].amb_cond.ambient_condition[0][12] ZFEH_EepromData.ydiMemory_xau16[11].amb_cond.ambient_condition[0][13] ZFEH_EepromData.ydiMemory_xau16[11].amb_cond.ambient_condition[0][14] ZFEH_EepromData.ydiMemory_xau16[11].amb_cond.ambient_condition[0][15] ZFEH_EepromData.ydiMemory_xau16[11].amb_cond.ambient_condition[0][16] ZFEH_EepromData.ydiMemory_xau16[11].amb_cond.ambient_condition[0][17] ZFEH_EepromData.ydiMemory_xau16[11].amb_cond.ambient_condition[0][18] ZFEH_EepromData.ydiMemory_xau16[11].amb_cond.ambient_condition[0][19] ZFEH_EepromData.ydiMemory_xau16[11].amb_cond.ambient_condition[0][1] ZFEH_EepromData.ydiMemory_xau16[11].amb_cond.ambient_condition[0][20] ZFEH_EepromData.ydiMemory_xau16[11].amb_cond.ambient_condition[0][21] ZFEH_EepromData.ydiMemory_xau16[11].amb_cond.ambient_condition[0][22] ZFEH_EepromData.ydiMemory_xau16[11].amb_cond.ambient_condition[0][23] ZFEH_EepromData.ydiMemory_xau16[11].amb_cond.ambient_condition[0][24] ZFEH_EepromData.ydiMemory_xau16[11].amb_cond.ambient_condition[0][2] ZFEH_EepromData.ydiMemory_xau16[11].amb_cond.ambient_condition[0][3] ZFEH_EepromData.ydiMemory_xau16[11].amb_cond.ambient_condition[0][4] ZFEH_EepromData.ydiMemory_xau16[11].amb_cond.ambient_condition[0][5] ZFEH_EepromData.ydiMemory_xau16[11].amb_cond.ambient_condition[0][6] ZFEH_EepromData.ydiMemory_xau16[11].amb_cond.ambient_condition[0][7] ZFEH_EepromData.ydiMemory_xau16[11].amb_cond.ambient_condition[0][8] ZFEH_EepromData.ydiMemory_xau16[11].amb_cond.ambient_condition[0][9] ZFEH_EepromData.ydiMemory_xau16[11].amb_cond.ambient_condition[1][0] ZFEH_EepromData.ydiMemory_xau16[11].amb_cond.ambient_condition[1][10] ZFEH_EepromData.ydiMemory_xau16[11].amb_cond.ambient_condition[1][11] ZFEH_EepromData.ydiMemory_xau16[11].amb_cond.ambient_condition[1][12] ZFEH_EepromData.ydiMemory_xau16[11].amb_cond.ambient_condition[1][13] ZFEH_EepromData.ydiMemory_xau16[11].amb_cond.ambient_condition[1][14] ZFEH_EepromData.ydiMemory_xau16[11].amb_cond.ambient_condition[1][15] ZFEH_EepromData.ydiMemory_xau16[11].amb_cond.ambient_condition[1][16] ZFEH_EepromData.ydiMemory_xau16[11].amb_cond.ambient_condition[1][17] ZFEH_EepromData.ydiMemory_xau16[11].amb_cond.ambient_condition[1][18] ZFEH_EepromData.ydiMemory_xau16[11].amb_cond.ambient_condition[1][19] ZFEH_EepromData.ydiMemory_xau16[11].amb_cond.ambient_condition[1][1] ZFEH_EepromData.ydiMemory_xau16[11].amb_cond.ambient_condition[1][20] ZFEH_EepromData.ydiMemory_xau16[11].amb_cond.ambient_condition[1][21] ZFEH_EepromData.ydiMemory_xau16[11].amb_cond.ambient_condition[1][22] ZFEH_EepromData.ydiMemory_xau16[11].amb_cond.ambient_condition[1][23] ZFEH_EepromData.ydiMemory_xau16[11].amb_cond.ambient_condition[1][24] ZFEH_EepromData.ydiMemory_xau16[11].amb_cond.ambient_condition[1][2] ZFEH_EepromData.ydiMemory_xau16[11].amb_cond.ambient_condition[1][3] ZFEH_EepromData.ydiMemory_xau16[11].amb_cond.ambient_condition[1][4] ZFEH_EepromData.ydiMemory_xau16[11].amb_cond.ambient_condition[1][5] ZFEH_EepromData.ydiMemory_xau16[11].amb_cond.ambient_condition[1][6] ZFEH_EepromData.ydiMemory_xau16[11].amb_cond.ambient_condition[1][7] ZFEH_EepromData.ydiMemory_xau16[11].amb_cond.ambient_condition[1][8] ZFEH_EepromData.ydiMemory_xau16[11].amb_cond.ambient_condition[1][9] ZFEH_EepromData.ydiMemory_xau16[11].amb_cond.status_of_ambient_conditions[0] ZFEH_EepromData.ydiMemory_xau16[11].amb_cond.status_of_ambient_conditions[1] ZFEH_EepromData.ydiMemory_xau16[11].backwards_counter ZFEH_EepromData.ydiMemory_xau16[11].condition_byte ZFEH_EepromData.ydiMemory_xau16[11].error_code ZFEH_EepromData.ydiMemory_xau16[11].error_type ZFEH_EepromData.ydiMemory_xau16[11].frequency_counter ZFEH_EepromData.ydiMemory_xau16[11].master_time ZFEH_EepromData.ydiMemory_xau16[11].obd_driving_cycle_counter ZFEH_EepromData.ydiMemory_xau16[11].permanent_counter ZFEH_EepromData.ydiMemory_xau16[11].sequence_counter ZFEH_EepromData.ydiMemory_xau16[11].status_word ZFEH_EepromData.ydiMemory_xau16[12].amb_cond.ambient_condition[0][0] ZFEH_EepromData.ydiMemory_xau16[12].amb_cond.ambient_condition[0][10] ZFEH_EepromData.ydiMemory_xau16[12].amb_cond.ambient_condition[0][11] ZFEH_EepromData.ydiMemory_xau16[12].amb_cond.ambient_condition[0][12] ZFEH_EepromData.ydiMemory_xau16[12].amb_cond.ambient_condition[0][13] ZFEH_EepromData.ydiMemory_xau16[12].amb_cond.ambient_condition[0][14] ZFEH_EepromData.ydiMemory_xau16[12].amb_cond.ambient_condition[0][15] ZFEH_EepromData.ydiMemory_xau16[12].amb_cond.ambient_condition[0][16] ZFEH_EepromData.ydiMemory_xau16[12].amb_cond.ambient_condition[0][17] ZFEH_EepromData.ydiMemory_xau16[12].amb_cond.ambient_condition[0][18] ZFEH_EepromData.ydiMemory_xau16[12].amb_cond.ambient_condition[0][19] ZFEH_EepromData.ydiMemory_xau16[12].amb_cond.ambient_condition[0][1] ZFEH_EepromData.ydiMemory_xau16[12].amb_cond.ambient_condition[0][20] ZFEH_EepromData.ydiMemory_xau16[12].amb_cond.ambient_condition[0][21] ZFEH_EepromData.ydiMemory_xau16[12].amb_cond.ambient_condition[0][22] ZFEH_EepromData.ydiMemory_xau16[12].amb_cond.ambient_condition[0][23] ZFEH_EepromData.ydiMemory_xau16[12].amb_cond.ambient_condition[0][24] ZFEH_EepromData.ydiMemory_xau16[12].amb_cond.ambient_condition[0][2] ZFEH_EepromData.ydiMemory_xau16[12].amb_cond.ambient_condition[0][3] ZFEH_EepromData.ydiMemory_xau16[12].amb_cond.ambient_condition[0][4] ZFEH_EepromData.ydiMemory_xau16[12].amb_cond.ambient_condition[0][5] ZFEH_EepromData.ydiMemory_xau16[12].amb_cond.ambient_condition[0][6] ZFEH_EepromData.ydiMemory_xau16[12].amb_cond.ambient_condition[0][7] ZFEH_EepromData.ydiMemory_xau16[12].amb_cond.ambient_condition[0][8] ZFEH_EepromData.ydiMemory_xau16[12].amb_cond.ambient_condition[0][9] ZFEH_EepromData.ydiMemory_xau16[12].amb_cond.ambient_condition[1][0] ZFEH_EepromData.ydiMemory_xau16[12].amb_cond.ambient_condition[1][10] ZFEH_EepromData.ydiMemory_xau16[12].amb_cond.ambient_condition[1][11] ZFEH_EepromData.ydiMemory_xau16[12].amb_cond.ambient_condition[1][12] ZFEH_EepromData.ydiMemory_xau16[12].amb_cond.ambient_condition[1][13] ZFEH_EepromData.ydiMemory_xau16[12].amb_cond.ambient_condition[1][14] ZFEH_EepromData.ydiMemory_xau16[12].amb_cond.ambient_condition[1][15] ZFEH_EepromData.ydiMemory_xau16[12].amb_cond.ambient_condition[1][16] ZFEH_EepromData.ydiMemory_xau16[12].amb_cond.ambient_condition[1][17] ZFEH_EepromData.ydiMemory_xau16[12].amb_cond.ambient_condition[1][18] ZFEH_EepromData.ydiMemory_xau16[12].amb_cond.ambient_condition[1][19] ZFEH_EepromData.ydiMemory_xau16[12].amb_cond.ambient_condition[1][1] ZFEH_EepromData.ydiMemory_xau16[12].amb_cond.ambient_condition[1][20] ZFEH_EepromData.ydiMemory_xau16[12].amb_cond.ambient_condition[1][21] ZFEH_EepromData.ydiMemory_xau16[12].amb_cond.ambient_condition[1][22] ZFEH_EepromData.ydiMemory_xau16[12].amb_cond.ambient_condition[1][23] ZFEH_EepromData.ydiMemory_xau16[12].amb_cond.ambient_condition[1][24] ZFEH_EepromData.ydiMemory_xau16[12].amb_cond.ambient_condition[1][2] ZFEH_EepromData.ydiMemory_xau16[12].amb_cond.ambient_condition[1][3] ZFEH_EepromData.ydiMemory_xau16[12].amb_cond.ambient_condition[1][4] ZFEH_EepromData.ydiMemory_xau16[12].amb_cond.ambient_condition[1][5] ZFEH_EepromData.ydiMemory_xau16[12].amb_cond.ambient_condition[1][6] ZFEH_EepromData.ydiMemory_xau16[12].amb_cond.ambient_condition[1][7] ZFEH_EepromData.ydiMemory_xau16[12].amb_cond.ambient_condition[1][8] ZFEH_EepromData.ydiMemory_xau16[12].amb_cond.ambient_condition[1][9] ZFEH_EepromData.ydiMemory_xau16[12].amb_cond.status_of_ambient_conditions[0] ZFEH_EepromData.ydiMemory_xau16[12].amb_cond.status_of_ambient_conditions[1] ZFEH_EepromData.ydiMemory_xau16[12].backwards_counter ZFEH_EepromData.ydiMemory_xau16[12].condition_byte ZFEH_EepromData.ydiMemory_xau16[12].error_code ZFEH_EepromData.ydiMemory_xau16[12].error_type ZFEH_EepromData.ydiMemory_xau16[12].frequency_counter ZFEH_EepromData.ydiMemory_xau16[12].master_time ZFEH_EepromData.ydiMemory_xau16[12].obd_driving_cycle_counter ZFEH_EepromData.ydiMemory_xau16[12].permanent_counter ZFEH_EepromData.ydiMemory_xau16[12].sequence_counter ZFEH_EepromData.ydiMemory_xau16[12].status_word ZFEH_EepromData.ydiMemory_xau16[13].amb_cond.ambient_condition[0][0] ZFEH_EepromData.ydiMemory_xau16[13].amb_cond.ambient_condition[0][10] ZFEH_EepromData.ydiMemory_xau16[13].amb_cond.ambient_condition[0][11] ZFEH_EepromData.ydiMemory_xau16[13].amb_cond.ambient_condition[0][12] ZFEH_EepromData.ydiMemory_xau16[13].amb_cond.ambient_condition[0][13] ZFEH_EepromData.ydiMemory_xau16[13].amb_cond.ambient_condition[0][14] /end LOC_MEASUREMENT
/end FUNCTION
/end MODULE
/end PROJECT
