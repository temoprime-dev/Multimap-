ASAP2_VERSION 1 51
/begin PROJECT _929_929 "Gen2_BMW_System_Supplier_Lib"
/begin HEADER "" VERSION "C_03_03" PROJECT_NO _929_929 /end HEADER
/begin MODULE DIM ""
/begin MOD_COMMON "" BYTE_ORDER MSB_FIRST ALIGNMENT_BYTE 1 ALIGNMENT_WORD 2 ALIGNMENT_LONG 4 ALIGNMENT_FLOAT32_IEEE 4 /end MOD_COMMON
/begin CHARACTERISTIC KL_TSYNMTKZUSFV54 "Zeit vor sync. Start Schnellfuellung vorb. KZU" CURVE 0x25DC80 kl_si16_S6_S3 5000 UMR_MSEC__10_1_0_S6_S3 -5000 0
 /begin AXIS_DESCR STD_AXIS zff_atsys._.iSignale._.obj.sig_m_t UMR_NM__1_1_0_S6_S3 4 -400 1640 DEPOSIT ABSOLUTE MONOTONY MON_INCREASE /end AXIS_DESCR
/end CHARACTERISTIC
/begin CHARACTERISTIC KL_TSYNMTTRAKZUV54 "Zeit vor sync. Ende Fuellausgleich vorb. KZU" CURVE 0x25DC94 kl_ui8_S6_S3 1280 UMR_MSEC__10_1_M128_S6_S3 -1280 0
 /begin AXIS_DESCR STD_AXIS zff_atsys._.iSignale._.obj.sig_m_t8 UMR_NM__8_1_M50_S6_S3 4 -400 1640 DEPOSIT ABSOLUTE MONOTONY MON_INCREASE /end AXIS_DESCR
/end CHARACTERISTIC
/begin CHARACTERISTIC T_SYN54 "Zeit n_t innerhalb Synchronschwelle bis Start Rampe 4" VALUE 0x26E9B2 kw_ui8_S6_S3 2540 UMR_MSEC__10_1_0_S6_S3 0 2540 /end CHARACTERISTIC
/begin CHARACTERISTIC T_VKZU54 "Verzoegerungszeit Start SF zuschaltende Kupplung" VALUE 0x26E9B3 kw_ui8_S6_S3 2540 UMR_MSEC__10_1_0_S6_S3 0 2540 /end CHARACTERISTIC
/begin CHARACTERISTIC TO_VKZUSLST54 "Zeitoffset auf Verzögerung Schnellfüllung bei Schleppstart" VALUE 0x26E9B4 kw_ui8_S6_S3 90 UMR_MSEC__10_1_0_S6_S3 10 100 /end CHARACTERISTIC
/begin CHARACTERISTIC T_MIN_IG_CHANGE54 "Mindestzeit fuer Ausgabe von Momentenuebergang" VALUE 0x26E9B5 kw_ui8_S6_S3 2540 UMR_MSEC__10_1_0_S6_S3 0 2540 /end CHARACTERISTIC
/begin CHARACTERISTIC KF_T_DT_IG_CHANGE54 "Kennfeld Zeitvorhalt für Übergabe Rampenzeit auf Schaltdruck" MAP 0x25DCA0 kf_si16_S6_S3 5080 UMR_MSEC__10_1_0_S6_S3 -2540 2540
 /begin AXIS_DESCR STD_AXIS zff_atsys._.iSignale._.obj.sig_n_t UMR_U_MIN_1_1_0_S6_S3 4 0 8160 DEPOSIT ABSOLUTE MONOTONY MON_INCREASE /end AXIS_DESCR
 /begin AXIS_DESCR STD_AXIS zff_atsys._.iSignale._.obj.sig_m_t UMR_NM__1_1_0_S6_S3 4 -400 1640 DEPOSIT ABSOLUTE MONOTONY MON_INCREASE /end AXIS_DESCR
/end CHARACTERISTIC
/begin CHARACTERISTIC KF_T2_DT_IG_CHANGE54 "Kennfeld Zeitvorhalt für Übergabe Rampenzeit auf Schaltdruck" MAP 0x25DCD8 kf_si16_S6_S3 5080 UMR_MSEC__10_1_0_S6_S3 -2540 2540
 /begin AXIS_DESCR STD_AXIS zff_atsys._.iSignale._.obj.sig_n_t UMR_U_MIN_1_1_0_S6_S3 4 0 8160 DEPOSIT ABSOLUTE MONOTONY MON_INCREASE /end AXIS_DESCR
 /begin AXIS_DESCR STD_AXIS zff_atsys._.iSignale._.obj.sig_m_t UMR_NM__1_1_0_S6_S3 4 -400 1640 DEPOSIT ABSOLUTE MONOTONY MON_INCREASE /end AXIS_DESCR
/end CHARACTERISTIC
/begin CHARACTERISTIC KL_POKZUCG54 "Schaltdruckoffset" CURVE 0x25DD10 kl_si16_S6_S3 12.75 UMR_BAR__1_1000_0_S6_S3 -6.4 6.35
 /begin AXIS_DESCR STD_AXIS zff_atsys._.iSignale._.obj.sig_c_getr UMR_GRADC__1_1_M40_S6_S3 10 -40 150 DEPOSIT ABSOLUTE MONOTONY MON_INCREASE /end AXIS_DESCR
/end CHARACTERISTIC
/begin CHARACTERISTIC KL_POFCG54 "Kennlinie Fuelldruckoffset" CURVE 0x25DD3C kl_si16_S6_S3 12.75 UMR_BAR__1_1000_0_S6_S3 -6.4 6.35
 /begin AXIS_DESCR STD_AXIS zff_atsys._.iSignale._.obj.sig_c_getr UMR_GRADC__1_1_M40_S6_S3 10 -40 150 DEPOSIT ABSOLUTE MONOTONY MON_INCREASE /end AXIS_DESCR
/end CHARACTERISTIC
/begin CHARACTERISTIC KL_PORASYN54 "Rampe n.Syn.->l.Stuetzst. y PMAX" CURVE 0x25DD68 kl_si16_S6_S3 12.75 UMR_BAR__1_1000_0_S6_S3 0 12.75
 /begin AXIS_DESCR STD_AXIS iSasZentr.iSchaltend.iKzu.timer_zkzu UMR_MSEC__10_1_0_S6_S3 3 0 2540 DEPOSIT ABSOLUTE MONOTONY MON_INCREASE /end AXIS_DESCR
/end CHARACTERISTIC
/begin CHARACTERISTIC T_RA2SSCHR54 "Zeit 2.Rampe bei Schrittschaltung" VALUE 0x26E9B6 kw_ui8_S6_S3 2540 UMR_MSEC__10_1_0_S6_S3 0 2540 /end CHARACTERISTIC
/begin CHARACTERISTIC KL_POKZUNGAB54 "Druckoffset in Abhaengigkeit von ng_ab" CURVE 0x25DD78 kl_si16_S6_S3 12.75 UMR_BAR__1_1000_0_S6_S3 -6.4 6.35
 /begin AXIS_DESCR STD_AXIS iItfInput.ng_ab UMR_U_MINSEC_1_1_0_S6_S3 4 -5000 1000 DEPOSIT ABSOLUTE MONOTONY MON_INCREASE /end AXIS_DESCR
/end CHARACTERISTIC
/begin CHARACTERISTIC KL_PORAKZU54 "Schaltdruckoffset" CURVE 0x25DD8C kl_si16_S6_S3 12.75 UMR_BAR__1_1000_0_S6_S3 -6.4 6.35
 /begin AXIS_DESCR STD_AXIS iSasZentr.iSchaltend.iKzu.timer_zkzu UMR_MSEC__10_1_0_S6_S3 3 0 2540 DEPOSIT ABSOLUTE MONOTONY MON_INCREASE /end AXIS_DESCR
/end CHARACTERISTIC
/begin CHARACTERISTIC KL_PGOKZU54 "Druckgradient in Abhaengigkeit von m_t" CURVE 0x25DD9C kl_si16_S6_S3 200 UMR_BAR_SEC_1_10_0_S6_S3 -100 100
 /begin AXIS_DESCR STD_AXIS zff_atsys._.iSignale._.obj.sig_m_t UMR_NM__1_1_0_S6_S3 6 -400 1640 DEPOSIT ABSOLUTE MONOTONY MON_INCREASE /end AXIS_DESCR
/end CHARACTERISTIC
/begin CHARACTERISTIC KL_PGOKZUWS54 "Druckgradient in Abhaengigkeit von m_t" CURVE 0x25DDB8 kl_si16_S6_S3 200 UMR_BAR_SEC_1_10_0_S6_S3 -100 100
 /begin AXIS_DESCR STD_AXIS zff_atsys._.iSignale._.obj.sig_m_t UMR_NM__1_1_0_S6_S3 6 -400 1640 DEPOSIT ABSOLUTE MONOTONY MON_INCREASE /end AXIS_DESCR
/end CHARACTERISTIC
/begin CHARACTERISTIC KL_POMDTSYN54 "Druckoffset Schliessphase f(delta_m_t seit synchron)" CURVE 0x25DDD4 kl_si16_S6_S3 12 UMR_BAR__1_1000_0_S6_S3 -6 6
 /begin AXIS_DESCR STD_AXIS iSasZentr.md_tpgrasyn UMR_NM__1_1_0_S6_S3 4 -2000 2000 DEPOSIT ABSOLUTE MONOTONY MON_INCREASE /end AXIS_DESCR
/end CHARACTERISTIC
/begin CHARACTERISTIC KL_FPGRASYN54 "Faktor Schließrampengradient" CURVE 0x25DDE8 kl_si16_S6_S3 50 UMR___1_10_0_S6_S3 0 50
 /begin AXIS_DESCR STD_AXIS iItfInput.ng_ab UMR_U_MINSEC_1_1_0_S6_S3 4 -5000 1000 DEPOSIT ABSOLUTE MONOTONY MON_INCREASE /end AXIS_DESCR
/end CHARACTERISTIC
/begin CHARACTERISTIC KF_PKZUWS54 "Schaltdruckkennfeld (n_tkf, m_t)" MAP 0x25DDFC kf_si16_S6_S3 12.75 UMR_BAR__1_1000_0_S6_S3 0 12.75
 /begin AXIS_DESCR STD_AXIS iSasZentr.iSchaltend.n_tkf UMR_U_MIN_32_1_0_S6_S3 8 0 8160 DEPOSIT ABSOLUTE MONOTONY MON_INCREASE /end AXIS_DESCR
 /begin AXIS_DESCR STD_AXIS zff_atsys._.iSignale._.obj.sig_m_t UMR_NM__1_1_0_S6_S3 8 -400 1640 DEPOSIT ABSOLUTE MONOTONY MON_INCREASE /end AXIS_DESCR
/end CHARACTERISTIC
/begin CHARACTERISTIC KL_TSYNCGRAKZU54 "Zeit vor sync. Ende Schaltdruck/Start 3. Rampe KZU" CURVE 0x25DEA4 kl_ui8_S6_S3 1280 UMR_MSEC__10_1_M128_S6_S3 -1280 0
 /begin AXIS_DESCR STD_AXIS zff_atsys._.iSignale._.obj.sig_c_getr UMR_GRADC__1_1_M40_S6_S3 4 -40 215 DEPOSIT ABSOLUTE MONOTONY MON_INCREASE /end AXIS_DESCR
/end CHARACTERISTIC
/begin CHARACTERISTIC KF_TSYNMTNTRAKZUWS54 "Zeit vor sync. Ende Schaltdruck/Start 3. Rampe KZU bei Weiterschaltung (n_tkf, m_t8)" MAP 0x25DEB0 kf_ui8_S6_S3 1280 UMR_MSEC__10_1_M128_S6_S3 -1280 0
 /begin AXIS_DESCR STD_AXIS zff_atsys._.iSignale._.obj.sig_m_t8 UMR_NM__8_1_M50_S6_S3 4 -400 1640 DEPOSIT ABSOLUTE MONOTONY MON_INCREASE /end AXIS_DESCR
 /begin AXIS_DESCR STD_AXIS iSasZentr.iSchaltend.n_tkf UMR_U_MIN_32_1_0_S6_S3 4 0 8160 DEPOSIT ABSOLUTE MONOTONY MON_INCREASE /end AXIS_DESCR
/end CHARACTERISTIC
/begin CHARACTERISTIC KL_POFMDMOTSOLL54 "Fuelldruckoffset f(Erhoehung Motorsollmoment)" CURVE 0x25DED0 kl_si16_S6_S3 12.75 UMR_BAR__1_1000_0_S6_S3 -6.4 6.35
 /begin AXIS_DESCR STD_AXIS NO_INPUT_QUANTITY UMR_NM__1_1_0_S6_S3 6 -2000 2000 DEPOSIT ABSOLUTE MONOTONY MON_INCREASE /end AXIS_DESCR
/end CHARACTERISTIC
/begin CHARACTERISTIC KL_POKZUMDMOTSOLL54 "Schaltdruckoffset in Abhaengigkeit von md_motsoll_sas" CURVE 0x25DEEC kl_si16_S6_S3 12.75 UMR_BAR__1_1000_0_S6_S3 -6.4 6.35
 /begin AXIS_DESCR STD_AXIS NO_INPUT_QUANTITY UMR_NM__1_1_0_S6_S3 6 -2000 2000 DEPOSIT ABSOLUTE MONOTONY MON_INCREASE /end AXIS_DESCR
/end CHARACTERISTIC
/begin CHARACTERISTIC KL_TSYNMTKZUSFV65 "Zeit vor sync. Start Schnellfuellung vorb. KZU" CURVE 0x25DF08 kl_si16_S6_S3 5000 UMR_MSEC__10_1_0_S6_S3 -5000 0
 /begin AXIS_DESCR STD_AXIS zff_atsys._.iSignale._.obj.sig_m_t UMR_NM__1_1_0_S6_S3 4 -400 1640 DEPOSIT ABSOLUTE MONOTONY MON_INCREASE /end AXIS_DESCR
/end CHARACTERISTIC
/begin CHARACTERISTIC KL_TSYNMTTRAKZUV65 "Zeit vor sync. Ende Fuellausgleich vorb. KZU" CURVE 0x25DF1C kl_ui8_S6_S3 1280 UMR_MSEC__10_1_M128_S6_S3 -1280 0
 /begin AXIS_DESCR STD_AXIS zff_atsys._.iSignale._.obj.sig_m_t8 UMR_NM__8_1_M50_S6_S3 4 -400 1640 DEPOSIT ABSOLUTE MONOTONY MON_INCREASE /end AXIS_DESCR
/end CHARACTERISTIC
/begin CHARACTERISTIC T_SYN65 "Zeit n_t innerhalb Synchronschwelle bis Start Rampe 4" VALUE 0x26E9B7 kw_ui8_S6_S3 2540 UMR_MSEC__10_1_0_S6_S3 0 2540 /end CHARACTERISTIC
/begin CHARACTERISTIC T_VKZU65 "Verzoegerungszeit Start SF zuschaltende Kupplung" VALUE 0x26E9B8 kw_ui8_S6_S3 2540 UMR_MSEC__10_1_0_S6_S3 0 2540 /end CHARACTERISTIC
/begin CHARACTERISTIC TO_VKZUSLST65 "Zeitoffset auf Verzögerung Schnellfüllung bei Schleppstart" VALUE 0x26E9B9 kw_ui8_S6_S3 90 UMR_MSEC__10_1_0_S6_S3 10 100 /end CHARACTERISTIC
/begin CHARACTERISTIC T_MIN_IG_CHANGE65 "Mindestzeit fuer Ausgabe von Momentenuebergang" VALUE 0x26E9BA kw_ui8_S6_S3 2540 UMR_MSEC__10_1_0_S6_S3 0 2540 /end CHARACTERISTIC
/begin CHARACTERISTIC KF_T_DT_IG_CHANGE65 "Kennfeld Zeitvorhalt für Übergabe Rampenzeit auf Schaltdruck" MAP 0x25DF28 kf_si16_S6_S3 5080 UMR_MSEC__10_1_0_S6_S3 -2540 2540
 /begin AXIS_DESCR STD_AXIS zff_atsys._.iSignale._.obj.sig_n_t UMR_U_MIN_1_1_0_S6_S3 4 0 8160 DEPOSIT ABSOLUTE MONOTONY MON_INCREASE /end AXIS_DESCR
 /begin AXIS_DESCR STD_AXIS zff_atsys._.iSignale._.obj.sig_m_t UMR_NM__1_1_0_S6_S3 4 -400 1640 DEPOSIT ABSOLUTE MONOTONY MON_INCREASE /end AXIS_DESCR
/end CHARACTERISTIC
/begin CHARACTERISTIC KF_T2_DT_IG_CHANGE65 "Kennfeld Zeitvorhalt für Übergabe Rampenzeit auf Schaltdruck" MAP 0x25DF60 kf_si16_S6_S3 5080 UMR_MSEC__10_1_0_S6_S3 -2540 2540
 /begin AXIS_DESCR STD_AXIS zff_atsys._.iSignale._.obj.sig_n_t UMR_U_MIN_1_1_0_S6_S3 4 0 8160 DEPOSIT ABSOLUTE MONOTONY MON_INCREASE /end AXIS_DESCR
 /begin AXIS_DESCR STD_AXIS zff_atsys._.iSignale._.obj.sig_m_t UMR_NM__1_1_0_S6_S3 4 -400 1640 DEPOSIT ABSOLUTE MONOTONY MON_INCREASE /end AXIS_DESCR
/end CHARACTERISTIC
/begin CHARACTERISTIC KL_POKZUCG65 "Schaltdruckoffset" CURVE 0x25DF98 kl_si16_S6_S3 12.75 UMR_BAR__1_1000_0_S6_S3 -6.4 6.35
 /begin AXIS_DESCR STD_AXIS zff_atsys._.iSignale._.obj.sig_c_getr UMR_GRADC__1_1_M40_S6_S3 10 -40 150 DEPOSIT ABSOLUTE MONOTONY MON_INCREASE /end AXIS_DESCR
/end CHARACTERISTIC
/begin CHARACTERISTIC KL_POFCG65 "Kennlinie Fuelldruckoffset" CURVE 0x25DFC4 kl_si16_S6_S3 12.75 UMR_BAR__1_1000_0_S6_S3 -6.4 6.35
 /begin AXIS_DESCR STD_AXIS zff_atsys._.iSignale._.obj.sig_c_getr UMR_GRADC__1_1_M40_S6_S3 10 -40 150 DEPOSIT ABSOLUTE MONOTONY MON_INCREASE /end AXIS_DESCR
/end CHARACTERISTIC
/begin CHARACTERISTIC KL_PORASYN65 "Rampe n.Syn.->l.Stuetzst. y PMAX" CURVE 0x25DFF0 kl_si16_S6_S3 12.75 UMR_BAR__1_1000_0_S6_S3 0 12.75
 /begin AXIS_DESCR STD_AXIS iSasZentr.iSchaltend.iKzu.timer_zkzu UMR_MSEC__10_1_0_S6_S3 3 0 2540 DEPOSIT ABSOLUTE MONOTONY MON_INCREASE /end AXIS_DESCR
/end CHARACTERISTIC
/begin CHARACTERISTIC T_RA2SSCHR65 "Zeit 2.Rampe bei Schrittschaltung" VALUE 0x26E9BB kw_ui8_S6_S3 2540 UMR_MSEC__10_1_0_S6_S3 0 2540 /end CHARACTERISTIC
/begin CHARACTERISTIC KL_POKZUNGAB65 "Druckoffset in Abhaengigkeit von ng_ab" CURVE 0x25E000 kl_si16_S6_S3 12.75 UMR_BAR__1_1000_0_S6_S3 -6.4 6.35
 /begin AXIS_DESCR STD_AXIS iItfInput.ng_ab UMR_U_MINSEC_1_1_0_S6_S3 4 -5000 1000 DEPOSIT ABSOLUTE MONOTONY MON_INCREASE /end AXIS_DESCR
/end CHARACTERISTIC
/begin CHARACTERISTIC KL_PORAKZU65 "Schaltdruckoffset" CURVE 0x25E014 kl_si16_S6_S3 12.75 UMR_BAR__1_1000_0_S6_S3 -6.4 6.35
 /begin AXIS_DESCR STD_AXIS iSasZentr.iSchaltend.iKzu.timer_zkzu UMR_MSEC__10_1_0_S6_S3 3 0 2540 DEPOSIT ABSOLUTE MONOTONY MON_INCREASE /end AXIS_DESCR
/end CHARACTERISTIC
/begin CHARACTERISTIC KL_PGOKZU65 "Druckgradient in Abhaengigkeit von m_t" CURVE 0x25E024 kl_si16_S6_S3 200 UMR_BAR_SEC_1_10_0_S6_S3 -100 100
 /begin AXIS_DESCR STD_AXIS zff_atsys._.iSignale._.obj.sig_m_t UMR_NM__1_1_0_S6_S3 6 -400 1640 DEPOSIT ABSOLUTE MONOTONY MON_INCREASE /end AXIS_DESCR
/end CHARACTERISTIC
/begin CHARACTERISTIC KL_PGOKZUWS65 "Druckgradient in Abhaengigkeit von m_t" CURVE 0x25E040 kl_si16_S6_S3 200 UMR_BAR_SEC_1_10_0_S6_S3 -100 100
 /begin AXIS_DESCR STD_AXIS zff_atsys._.iSignale._.obj.sig_m_t UMR_NM__1_1_0_S6_S3 6 -400 1640 DEPOSIT ABSOLUTE MONOTONY MON_INCREASE /end AXIS_DESCR
/end CHARACTERISTIC
/begin CHARACTERISTIC KL_POMDTSYN65 "Druckoffset Schliessphase f(delta_m_t seit synchron)" CURVE 0x25E05C kl_si16_S6_S3 12 UMR_BAR__1_1000_0_S6_S3 -6 6
 /begin AXIS_DESCR STD_AXIS iSasZentr.md_tpgrasyn UMR_NM__1_1_0_S6_S3 4 -2000 2000 DEPOSIT ABSOLUTE MONOTONY MON_INCREASE /end AXIS_DESCR
/end CHARACTERISTIC
/begin CHARACTERISTIC KL_FPGRASYN65 "Faktor Schließrampengradient" CURVE 0x25E070 kl_si16_S6_S3 50 UMR___1_10_0_S6_S3 0 50
 /begin AXIS_DESCR STD_AXIS iItfInput.ng_ab UMR_U_MINSEC_1_1_0_S6_S3 4 -5000 1000 DEPOSIT ABSOLUTE MONOTONY MON_INCREASE /end AXIS_DESCR
/end CHARACTERISTIC
/begin CHARACTERISTIC KF_PKZUWS65 "Schaltdruckkennfeld (n_tkf, m_t)" MAP 0x25E084 kf_si16_S6_S3 12.75 UMR_BAR__1_1000_0_S6_S3 0 12.75
 /begin AXIS_DESCR STD_AXIS iSasZentr.iSchaltend.n_tkf UMR_U_MIN_32_1_0_S6_S3 8 0 8160 DEPOSIT ABSOLUTE MONOTONY MON_INCREASE /end AXIS_DESCR
 /begin AXIS_DESCR STD_AXIS zff_atsys._.iSignale._.obj.sig_m_t UMR_NM__1_1_0_S6_S3 8 -400 1640 DEPOSIT ABSOLUTE MONOTONY MON_INCREASE /end AXIS_DESCR
/end CHARACTERISTIC
/begin CHARACTERISTIC KL_TSYNCGRAKZU65 "Zeit vor sync. Ende Schaltdruck/Start 3. Rampe KZU" CURVE 0x25E12C kl_ui8_S6_S3 1280 UMR_MSEC__10_1_M128_S6_S3 -1280 0
 /begin AXIS_DESCR STD_AXIS zff_atsys._.iSignale._.obj.sig_c_getr UMR_GRADC__1_1_M40_S6_S3 4 -40 215 DEPOSIT ABSOLUTE MONOTONY MON_INCREASE /end AXIS_DESCR
/end CHARACTERISTIC
/begin CHARACTERISTIC KF_TSYNMTNTRAKZUWS65 "Zeit vor sync. Ende Schaltdruck/Start 3. Rampe KZU bei Weiterschaltung (n_tkf, m_t8)" MAP 0x25E138 kf_ui8_S6_S3 1280 UMR_MSEC__10_1_M128_S6_S3 -1280 0
 /begin AXIS_DESCR STD_AXIS zff_atsys._.iSignale._.obj.sig_m_t8 UMR_NM__8_1_M50_S6_S3 4 -400 1640 DEPOSIT ABSOLUTE MONOTONY MON_INCREASE /end AXIS_DESCR
 /begin AXIS_DESCR STD_AXIS iSasZentr.iSchaltend.n_tkf UMR_U_MIN_32_1_0_S6_S3 4 0 8160 DEPOSIT ABSOLUTE MONOTONY MON_INCREASE /end AXIS_DESCR
/end CHARACTERISTIC
/begin CHARACTERISTIC KL_POFMDMOTSOLL65 "Fuelldruckoffset f(Erhoehung Motorsollmoment)" CURVE 0x25E158 kl_si16_S6_S3 12.75 UMR_BAR__1_1000_0_S6_S3 -6.4 6.35
 /begin AXIS_DESCR STD_AXIS NO_INPUT_QUANTITY UMR_NM__1_1_0_S6_S3 6 -2000 2000 DEPOSIT ABSOLUTE MONOTONY MON_INCREASE /end AXIS_DESCR
/end CHARACTERISTIC
/begin CHARACTERISTIC KL_POKZUMDMOTSOLL65 "Schaltdruckoffset in Abhaengigkeit von md_motsoll_sas" CURVE 0x25E174 kl_si16_S6_S3 12.75 UMR_BAR__1_1000_0_S6_S3 -6.4 6.35
 /begin AXIS_DESCR STD_AXIS NO_INPUT_QUANTITY UMR_NM__1_1_0_S6_S3 6 -2000 2000 DEPOSIT ABSOLUTE MONOTONY MON_INCREASE /end AXIS_DESCR
/end CHARACTERISTIC
/begin CHARACTERISTIC KL_TSYNMTKZUSFV76 "Zeit vor sync. Start Schnellfuellung vorb. KZU" CURVE 0x25E190 kl_si16_S6_S3 5000 UMR_MSEC__10_1_0_S6_S3 -5000 0
 /begin AXIS_DESCR STD_AXIS zff_atsys._.iSignale._.obj.sig_m_t UMR_NM__1_1_0_S6_S3 4 -400 1640 DEPOSIT ABSOLUTE MONOTONY MON_INCREASE /end AXIS_DESCR
/end CHARACTERISTIC
/begin CHARACTERISTIC KL_TSYNMTTRAKZUV76 "Zeit vor sync. Ende Fuellausgleich vorb. KZU" CURVE 0x25E1A4 kl_ui8_S6_S3 1280 UMR_MSEC__10_1_M128_S6_S3 -1280 0
 /begin AXIS_DESCR STD_AXIS zff_atsys._.iSignale._.obj.sig_m_t8 UMR_NM__8_1_M50_S6_S3 4 -400 1640 DEPOSIT ABSOLUTE MONOTONY MON_INCREASE /end AXIS_DESCR
/end CHARACTERISTIC
/begin CHARACTERISTIC T_SYN76 "Zeit n_t innerhalb Synchronschwelle bis Start Rampe 4" VALUE 0x26E9BC kw_ui8_S6_S3 2540 UMR_MSEC__10_1_0_S6_S3 0 2540 /end CHARACTERISTIC
/begin CHARACTERISTIC T_VKZU76 "Verzoegerungszeit Start SF zuschaltende Kupplung" VALUE 0x26E9BD kw_ui8_S6_S3 2540 UMR_MSEC__10_1_0_S6_S3 0 2540 /end CHARACTERISTIC
/begin CHARACTERISTIC TO_VKZUSLST76 "Zeitoffset auf Verzögerung Schnellfüllung bei Schleppstart" VALUE 0x26E9BE kw_ui8_S6_S3 90 UMR_MSEC__10_1_0_S6_S3 10 100 /end CHARACTERISTIC
/begin CHARACTERISTIC T_MIN_IG_CHANGE76 "Mindestzeit fuer Ausgabe von Momentenuebergang" VALUE 0x26E9BF kw_ui8_S6_S3 2540 UMR_MSEC__10_1_0_S6_S3 0 2540 /end CHARACTERISTIC
/begin CHARACTERISTIC KF_T_DT_IG_CHANGE76 "Kennfeld Zeitvorhalt für Übergabe Rampenzeit auf Schaltdruck" MAP 0x25E1B0 kf_si16_S6_S3 5080 UMR_MSEC__10_1_0_S6_S3 -2540 2540
 /begin AXIS_DESCR STD_AXIS zff_atsys._.iSignale._.obj.sig_n_t UMR_U_MIN_1_1_0_S6_S3 4 0 8160 DEPOSIT ABSOLUTE MONOTONY MON_INCREASE /end AXIS_DESCR
 /begin AXIS_DESCR STD_AXIS zff_atsys._.iSignale._.obj.sig_m_t UMR_NM__1_1_0_S6_S3 4 -400 1640 DEPOSIT ABSOLUTE MONOTONY MON_INCREASE /end AXIS_DESCR
/end CHARACTERISTIC
/begin CHARACTERISTIC KF_T2_DT_IG_CHANGE76 "Kennfeld Zeitvorhalt für Übergabe Rampenzeit auf Schaltdruck" MAP 0x25E1E8 kf_si16_S6_S3 5080 UMR_MSEC__10_1_0_S6_S3 -2540 2540
 /begin AXIS_DESCR STD_AXIS zff_atsys._.iSignale._.obj.sig_n_t UMR_U_MIN_1_1_0_S6_S3 4 0 8160 DEPOSIT ABSOLUTE MONOTONY MON_INCREASE /end AXIS_DESCR
 /begin AXIS_DESCR STD_AXIS zff_atsys._.iSignale._.obj.sig_m_t UMR_NM__1_1_0_S6_S3 4 -400 1640 DEPOSIT ABSOLUTE MONOTONY MON_INCREASE /end AXIS_DESCR
/end CHARACTERISTIC
/begin CHARACTERISTIC KL_POKZUCG76 "Schaltdruckoffset" CURVE 0x25E220 kl_si16_S6_S3 12.75 UMR_BAR__1_1000_0_S6_S3 -6.4 6.35
 /begin AXIS_DESCR STD_AXIS zff_atsys._.iSignale._.obj.sig_c_getr UMR_GRADC__1_1_M40_S6_S3 10 -40 150 DEPOSIT ABSOLUTE MONOTONY MON_INCREASE /end AXIS_DESCR
/end CHARACTERISTIC
/begin CHARACTERISTIC KL_POFCG76 "Kennlinie Fuelldruckoffset" CURVE 0x25E24C kl_si16_S6_S3 12.75 UMR_BAR__1_1000_0_S6_S3 -6.4 6.35
 /begin AXIS_DESCR STD_AXIS zff_atsys._.iSignale._.obj.sig_c_getr UMR_GRADC__1_1_M40_S6_S3 10 -40 150 DEPOSIT ABSOLUTE MONOTONY MON_INCREASE /end AXIS_DESCR
/end CHARACTERISTIC
/begin CHARACTERISTIC KL_PORASYN76 "Rampe n.Syn.->l.Stuetzst. y PMAX" CURVE 0x25E278 kl_si16_S6_S3 12.75 UMR_BAR__1_1000_0_S6_S3 0 12.75
 /begin AXIS_DESCR STD_AXIS iSasZentr.iSchaltend.iKzu.timer_zkzu UMR_MSEC__10_1_0_S6_S3 3 0 2540 DEPOSIT ABSOLUTE MONOTONY MON_INCREASE /end AXIS_DESCR
/end CHARACTERISTIC
/begin CHARACTERISTIC T_RA2SSCHR76 "Zeit 2.Rampe bei Schrittschaltung" VALUE 0x26E9C0 kw_ui8_S6_S3 2540 UMR_MSEC__10_1_0_S6_S3 0 2540 /end CHARACTERISTIC
/begin CHARACTERISTIC KL_POKZUNGAB76 "Druckoffset in Abhaengigkeit von ng_ab" CURVE 0x25E288 kl_si16_S6_S3 12.75 UMR_BAR__1_1000_0_S6_S3 -6.4 6.35
 /begin AXIS_DESCR STD_AXIS iItfInput.ng_ab UMR_U_MINSEC_1_1_0_S6_S3 4 -5000 1000 DEPOSIT ABSOLUTE MONOTONY MON_INCREASE /end AXIS_DESCR
/end CHARACTERISTIC
/begin CHARACTERISTIC KL_PORAKZU76 "Schaltdruckoffset" CURVE 0x25E29C kl_si16_S6_S3 12.75 UMR_BAR__1_1000_0_S6_S3 -6.4 6.35
 /begin AXIS_DESCR STD_AXIS iSasZentr.iSchaltend.iKzu.timer_zkzu UMR_MSEC__10_1_0_S6_S3 3 0 2540 DEPOSIT ABSOLUTE MONOTONY MON_INCREASE /end AXIS_DESCR
/end CHARACTERISTIC
/begin CHARACTERISTIC KL_PGOKZU76 "Druckgradient in Abhaengigkeit von m_t" CURVE 0x25E2AC kl_si16_S6_S3 200 UMR_BAR_SEC_1_10_0_S6_S3 -100 100
 /begin AXIS_DESCR STD_AXIS zff_atsys._.iSignale._.obj.sig_m_t UMR_NM__1_1_0_S6_S3 6 -400 1640 DEPOSIT ABSOLUTE MONOTONY MON_INCREASE /end AXIS_DESCR
/end CHARACTERISTIC
/begin CHARACTERISTIC KL_PGOKZUWS76 "Druckgradient in Abhaengigkeit von m_t" CURVE 0x25E2C8 kl_si16_S6_S3 200 UMR_BAR_SEC_1_10_0_S6_S3 -100 100
 /begin AXIS_DESCR STD_AXIS zff_atsys._.iSignale._.obj.sig_m_t UMR_NM__1_1_0_S6_S3 6 -400 1640 DEPOSIT ABSOLUTE MONOTONY MON_INCREASE /end AXIS_DESCR
/end CHARACTERISTIC
/begin CHARACTERISTIC KL_POMDTSYN76 "Druckoffset Schliessphase f(delta_m_t seit synchron)" CURVE 0x25E2E4 kl_si16_S6_S3 12 UMR_BAR__1_1000_0_S6_S3 -6 6
 /begin AXIS_DESCR STD_AXIS iSasZentr.md_tpgrasyn UMR_NM__1_1_0_S6_S3 4 -2000 2000 DEPOSIT ABSOLUTE MONOTONY MON_INCREASE /end AXIS_DESCR
/end CHARACTERISTIC
/begin CHARACTERISTIC KL_FPGRASYN76 "Faktor Schließrampengradient" CURVE 0x25E2F8 kl_si16_S6_S3 50 UMR___1_10_0_S6_S3 0 50
 /begin AXIS_DESCR STD_AXIS iItfInput.ng_ab UMR_U_MINSEC_1_1_0_S6_S3 4 -5000 1000 DEPOSIT ABSOLUTE MONOTONY MON_INCREASE /end AXIS_DESCR
/end CHARACTERISTIC
/begin CHARACTERISTIC KF_PKZUWS76 "Schaltdruckkennfeld (n_tkf, m_t)" MAP 0x25E30C kf_si16_S6_S3 12.75 UMR_BAR__1_1000_0_S6_S3 0 12.75
 /begin AXIS_DESCR STD_AXIS iSasZentr.iSchaltend.n_tkf UMR_U_MIN_32_1_0_S6_S3 8 0 8160 DEPOSIT ABSOLUTE MONOTONY MON_INCREASE /end AXIS_DESCR
 /begin AXIS_DESCR STD_AXIS zff_atsys._.iSignale._.obj.sig_m_t UMR_NM__1_1_0_S6_S3 8 -400 1640 DEPOSIT ABSOLUTE MONOTONY MON_INCREASE /end AXIS_DESCR
/end CHARACTERISTIC
/begin CHARACTERISTIC KL_TSYNCGRAKZU76 "Zeit vor sync. Ende Schaltdruck/Start 3. Rampe KZU" CURVE 0x25E3B4 kl_ui8_S6_S3 1280 UMR_MSEC__10_1_M128_S6_S3 -1280 0
 /begin AXIS_DESCR STD_AXIS zff_atsys._.iSignale._.obj.sig_c_getr UMR_GRADC__1_1_M40_S6_S3 4 -40 215 DEPOSIT ABSOLUTE MONOTONY MON_INCREASE /end AXIS_DESCR
/end CHARACTERISTIC
/begin CHARACTERISTIC KF_TSYNMTNTRAKZUWS76 "Zeit vor sync. Ende Schaltdruck/Start 3. Rampe KZU bei Weiterschaltung (n_tkf, m_t8)" MAP 0x25E3C0 kf_ui8_S6_S3 1280 UMR_MSEC__10_1_M128_S6_S3 -1280 0
 /begin AXIS_DESCR STD_AXIS zff_atsys._.iSignale._.obj.sig_m_t8 UMR_NM__8_1_M50_S6_S3 4 -400 1640 DEPOSIT ABSOLUTE MONOTONY MON_INCREASE /end AXIS_DESCR
 /begin AXIS_DESCR STD_AXIS iSasZentr.iSchaltend.n_tkf UMR_U_MIN_32_1_0_S6_S3 4 0 8160 DEPOSIT ABSOLUTE MONOTONY MON_INCREASE /end AXIS_DESCR
/end CHARACTERISTIC
/begin CHARACTERISTIC KL_POFMDMOTSOLL76 "Fuelldruckoffset f(Erhoehung Motorsollmoment)" CURVE 0x25E3E0 kl_si16_S6_S3 12.75 UMR_BAR__1_1000_0_S6_S3 -6.4 6.35
 /begin AXIS_DESCR STD_AXIS NO_INPUT_QUANTITY UMR_NM__1_1_0_S6_S3 6 -2000 2000 DEPOSIT ABSOLUTE MONOTONY MON_INCREASE /end AXIS_DESCR
/end CHARACTERISTIC
/begin CHARACTERISTIC KL_POKZUMDMOTSOLL76 "Schaltdruckoffset in Abhaengigkeit von md_motsoll_sas" CURVE 0x25E3FC kl_si16_S6_S3 12.75 UMR_BAR__1_1000_0_S6_S3 -6.4 6.35
 /begin AXIS_DESCR STD_AXIS NO_INPUT_QUANTITY UMR_NM__1_1_0_S6_S3 6 -2000 2000 DEPOSIT ABSOLUTE MONOTONY MON_INCREASE /end AXIS_DESCR
/end CHARACTERISTIC
/begin CHARACTERISTIC KL_TSYNMTKZUSFV87 "Zeit vor sync. Start Schnellfuellung vorb. KZU" CURVE 0x25E418 kl_si16_S6_S3 5000 UMR_MSEC__10_1_0_S6_S3 -5000 0
 /begin AXIS_DESCR STD_AXIS zff_atsys._.iSignale._.obj.sig_m_t UMR_NM__1_1_0_S6_S3 4 -400 1640 DEPOSIT ABSOLUTE MONOTONY MON_INCREASE /end AXIS_DESCR
/end CHARACTERISTIC
/begin CHARACTERISTIC KL_TSYNMTTRAKZUV87 "Zeit vor sync. Ende Fuellausgleich vorb. KZU" CURVE 0x25E42C kl_ui8_S6_S3 1280 UMR_MSEC__10_1_M128_S6_S3 -1280 0
 /begin AXIS_DESCR STD_AXIS zff_atsys._.iSignale._.obj.sig_m_t8 UMR_NM__8_1_M50_S6_S3 4 -400 1640 DEPOSIT ABSOLUTE MONOTONY MON_INCREASE /end AXIS_DESCR
/end CHARACTERISTIC
/begin CHARACTERISTIC T_SYN87 "Zeit n_t innerhalb Synchronschwelle bis Start Rampe 4" VALUE 0x26E9C1 kw_ui8_S6_S3 2540 UMR_MSEC__10_1_0_S6_S3 0 2540 /end CHARACTERISTIC
/begin CHARACTERISTIC T_VKZU87 "Verzoegerungszeit Start SF zuschaltende Kupplung" VALUE 0x26E9C2 kw_ui8_S6_S3 2540 UMR_MSEC__10_1_0_S6_S3 0 2540 /end CHARACTERISTIC
/begin CHARACTERISTIC TO_VKZUSLST87 "Zeitoffset auf Verzögerung Schnellfüllung bei Schleppstart" VALUE 0x26E9C3 kw_ui8_S6_S3 90 UMR_MSEC__10_1_0_S6_S3 10 100 /end CHARACTERISTIC
/begin CHARACTERISTIC T_MIN_IG_CHANGE87 "Mindestzeit fuer Ausgabe von Momentenuebergang" VALUE 0x26E9C4 kw_ui8_S6_S3 2540 UMR_MSEC__10_1_0_S6_S3 0 2540 /end CHARACTERISTIC
/begin CHARACTERISTIC KF_T_DT_IG_CHANGE87 "Kennfeld Zeitvorhalt für Übergabe Rampenzeit auf Schaltdruck" MAP 0x25E438 kf_si16_S6_S3 5080 UMR_MSEC__10_1_0_S6_S3 -2540 2540
 /begin AXIS_DESCR STD_AXIS zff_atsys._.iSignale._.obj.sig_n_t UMR_U_MIN_1_1_0_S6_S3 4 0 8160 DEPOSIT ABSOLUTE MONOTONY MON_INCREASE /end AXIS_DESCR
 /begin AXIS_DESCR STD_AXIS zff_atsys._.iSignale._.obj.sig_m_t UMR_NM__1_1_0_S6_S3 4 -400 1640 DEPOSIT ABSOLUTE MONOTONY MON_INCREASE /end AXIS_DESCR
/end CHARACTERISTIC
/begin CHARACTERISTIC KF_T2_DT_IG_CHANGE87 "Kennfeld Zeitvorhalt für Übergabe Rampenzeit auf Schaltdruck" MAP 0x25E470 kf_si16_S6_S3 5080 UMR_MSEC__10_1_0_S6_S3 -2540 2540
 /begin AXIS_DESCR STD_AXIS zff_atsys._.iSignale._.obj.sig_n_t UMR_U_MIN_1_1_0_S6_S3 4 0 8160 DEPOSIT ABSOLUTE MONOTONY MON_INCREASE /end AXIS_DESCR
 /begin AXIS_DESCR STD_AXIS zff_atsys._.iSignale._.obj.sig_m_t UMR_NM__1_1_0_S6_S3 4 -400 1640 DEPOSIT ABSOLUTE MONOTONY MON_INCREASE /end AXIS_DESCR
/end CHARACTERISTIC
/begin CHARACTERISTIC KL_POKZUCG87 "Schaltdruckoffset" CURVE 0x25E4A8 kl_si16_S6_S3 12.75 UMR_BAR__1_1000_0_S6_S3 -6.4 6.35
 /begin AXIS_DESCR STD_AXIS zff_atsys._.iSignale._.obj.sig_c_getr UMR_GRADC__1_1_M40_S6_S3 10 -40 150 DEPOSIT ABSOLUTE MONOTONY MON_INCREASE /end AXIS_DESCR
/end CHARACTERISTIC
/begin CHARACTERISTIC KL_POFCG87 "Kennlinie Fuelldruckoffset" CURVE 0x25E4D4 kl_si16_S6_S3 12.75 UMR_BAR__1_1000_0_S6_S3 -6.4 6.35
 /begin AXIS_DESCR STD_AXIS zff_atsys._.iSignale._.obj.sig_c_getr UMR_GRADC__1_1_M40_S6_S3 10 -40 150 DEPOSIT ABSOLUTE MONOTONY MON_INCREASE /end AXIS_DESCR
/end CHARACTERISTIC
/begin CHARACTERISTIC KL_PORASYN87 "Rampe n.Syn.->l.Stuetzst. y PMAX" CURVE 0x25E500 kl_si16_S6_S3 12.75 UMR_BAR__1_1000_0_S6_S3 0 12.75
 /begin AXIS_DESCR STD_AXIS iSasZentr.iSchaltend.iKzu.timer_zkzu UMR_MSEC__10_1_0_S6_S3 3 0 2540 DEPOSIT ABSOLUTE MONOTONY MON_INCREASE /end AXIS_DESCR
/end CHARACTERISTIC
/begin CHARACTERISTIC T_RA2SSCHR87 "Zeit 2.Rampe bei Schrittschaltung" VALUE 0x26E9C5 kw_ui8_S6_S3 2540 UMR_MSEC__10_1_0_S6_S3 0 2540 /end CHARACTERISTIC
/begin CHARACTERISTIC KL_POKZUNGAB87 "Druckoffset in Abhaengigkeit von ng_ab" CURVE 0x25E510 kl_si16_S6_S3 12.75 UMR_BAR__1_1000_0_S6_S3 -6.4 6.35
 /begin AXIS_DESCR STD_AXIS iItfInput.ng_ab UMR_U_MINSEC_1_1_0_S6_S3 4 -5000 1000 DEPOSIT ABSOLUTE MONOTONY MON_INCREASE /end AXIS_DESCR
/end CHARACTERISTIC
/begin CHARACTERISTIC KL_PORAKZU87 "Schaltdruckoffset" CURVE 0x25E524 kl_si16_S6_S3 12.75 UMR_BAR__1_1000_0_S6_S3 -6.4 6.35
 /begin AXIS_DESCR STD_AXIS iSasZentr.iSchaltend.iKzu.timer_zkzu UMR_MSEC__10_1_0_S6_S3 3 0 2540 DEPOSIT ABSOLUTE MONOTONY MON_INCREASE /end AXIS_DESCR
/end CHARACTERISTIC
/begin CHARACTERISTIC KL_PGOKZU87 "Druckgradient in Abhaengigkeit von m_t" CURVE 0x25E534 kl_si16_S6_S3 200 UMR_BAR_SEC_1_10_0_S6_S3 -100 100
 /begin AXIS_DESCR STD_AXIS zff_atsys._.iSignale._.obj.sig_m_t UMR_NM__1_1_0_S6_S3 6 -400 1640 DEPOSIT ABSOLUTE MONOTONY MON_INCREASE /end AXIS_DESCR
/end CHARACTERISTIC
/begin CHARACTERISTIC KL_PGOKZUWS87 "Druckgradient in Abhaengigkeit von m_t" CURVE 0x25E550 kl_si16_S6_S3 200 UMR_BAR_SEC_1_10_0_S6_S3 -100 100
 /begin AXIS_DESCR STD_AXIS zff_atsys._.iSignale._.obj.sig_m_t UMR_NM__1_1_0_S6_S3 6 -400 1640 DEPOSIT ABSOLUTE MONOTONY MON_INCREASE /end AXIS_DESCR
/end CHARACTERISTIC
/begin CHARACTERISTIC KL_POMDTSYN87 "Druckoffset Schliessphase f(delta_m_t seit synchron)" CURVE 0x25E56C kl_si16_S6_S3 12 UMR_BAR__1_1000_0_S6_S3 -6 6
 /begin AXIS_DESCR STD_AXIS iSasZentr.md_tpgrasyn UMR_NM__1_1_0_S6_S3 4 -2000 2000 DEPOSIT ABSOLUTE MONOTONY MON_INCREASE /end AXIS_DESCR
/end CHARACTERISTIC
/begin CHARACTERISTIC KL_FPGRASYN87 "Faktor Schließrampengradient" CURVE 0x25E580 kl_si16_S6_S3 50 UMR___1_10_0_S6_S3 0 50
 /begin AXIS_DESCR STD_AXIS iItfInput.ng_ab UMR_U_MINSEC_1_1_0_S6_S3 4 -5000 1000 DEPOSIT ABSOLUTE MONOTONY MON_INCREASE /end AXIS_DESCR
/end CHARACTERISTIC
/begin CHARACTERISTIC KF_PKZUWS87 "Schaltdruckkennfeld (n_tkf, m_t)" MAP 0x25E594 kf_si16_S6_S3 12.75 UMR_BAR__1_1000_0_S6_S3 0 12.75
 /begin AXIS_DESCR STD_AXIS iSasZentr.iSchaltend.n_tkf UMR_U_MIN_32_1_0_S6_S3 8 0 8160 DEPOSIT ABSOLUTE MONOTONY MON_INCREASE /end AXIS_DESCR
 /begin AXIS_DESCR STD_AXIS zff_atsys._.iSignale._.obj.sig_m_t UMR_NM__1_1_0_S6_S3 8 -400 1640 DEPOSIT ABSOLUTE MONOTONY MON_INCREASE /end AXIS_DESCR
/end CHARACTERISTIC
/begin CHARACTERISTIC KL_TSYNCGRAKZU87 "Zeit vor sync. Ende Schaltdruck/Start 3. Rampe KZU" CURVE 0x25E63C kl_ui8_S6_S3 1280 UMR_MSEC__10_1_M128_S6_S3 -1280 0
 /begin AXIS_DESCR STD_AXIS zff_atsys._.iSignale._.obj.sig_c_getr UMR_GRADC__1_1_M40_S6_S3 4 -40 215 DEPOSIT ABSOLUTE MONOTONY MON_INCREASE /end AXIS_DESCR
/end CHARACTERISTIC
/begin CHARACTERISTIC KF_TSYNMTNTRAKZUWS87 "Zeit vor sync. Ende Schaltdruck/Start 3. Rampe KZU bei Weiterschaltung (n_tkf, m_t8)" MAP 0x25E648 kf_ui8_S6_S3 1280 UMR_MSEC__10_1_M128_S6_S3 -1280 0
 /begin AXIS_DESCR STD_AXIS zff_atsys._.iSignale._.obj.sig_m_t8 UMR_NM__8_1_M50_S6_S3 4 -400 1640 DEPOSIT ABSOLUTE MONOTONY MON_INCREASE /end AXIS_DESCR
 /begin AXIS_DESCR STD_AXIS iSasZentr.iSchaltend.n_tkf UMR_U_MIN_32_1_0_S6_S3 4 0 8160 DEPOSIT ABSOLUTE MONOTONY MON_INCREASE /end AXIS_DESCR
/end CHARACTERISTIC
/begin CHARACTERISTIC KL_POFMDMOTSOLL87 "Fuelldruckoffset f(Erhoehung Motorsollmoment)" CURVE 0x25E668 kl_si16_S6_S3 12.75 UMR_BAR__1_1000_0_S6_S3 -6.4 6.35
 /begin AXIS_DESCR STD_AXIS NO_INPUT_QUANTITY UMR_NM__1_1_0_S6_S3 6 -2000 2000 DEPOSIT ABSOLUTE MONOTONY MON_INCREASE /end AXIS_DESCR
/end CHARACTERISTIC
/begin CHARACTERISTIC KL_POKZUMDMOTSOLL87 "Schaltdruckoffset in Abhaengigkeit von md_motsoll_sas" CURVE 0x25E684 kl_si16_S6_S3 12.75 UMR_BAR__1_1000_0_S6_S3 -6.4 6.35
 /begin AXIS_DESCR STD_AXIS NO_INPUT_QUANTITY UMR_NM__1_1_0_S6_S3 6 -2000 2000 DEPOSIT ABSOLUTE MONOTONY MON_INCREASE /end AXIS_DESCR
/end CHARACTERISTIC
/begin CHARACTERISTIC KL_TSYNMTKZUSFVSP31 "Zeit vor sync. Start Schnellfuellung vorb. KZU" CURVE 0x25E6A0 kl_si16_S6_S3 5000 UMR_MSEC__10_1_0_S6_S3 -5000 0
 /begin AXIS_DESCR STD_AXIS zff_atsys._.iSignale._.obj.sig_m_t UMR_NM__1_1_0_S6_S3 4 -400 1640 DEPOSIT ABSOLUTE MONOTONY MON_INCREASE /end AXIS_DESCR
/end CHARACTERISTIC
/begin CHARACTERISTIC KL_TSYNMTTRAKZUVSP31 "Zeit vor sync. Ende Fuellausgleich vorb. KZU" CURVE 0x25E6B4 kl_ui8_S6_S3 1280 UMR_MSEC__10_1_M128_S6_S3 -1280 0
 /begin AXIS_DESCR STD_AXIS zff_atsys._.iSignale._.obj.sig_m_t8 UMR_NM__8_1_M50_S6_S3 4 -400 1640 DEPOSIT ABSOLUTE MONOTONY MON_INCREASE /end AXIS_DESCR
/end CHARACTERISTIC
/begin CHARACTERISTIC T_SYNSP31 "Zeit n_t innerhalb Synchronschwelle bis Start Rampe 4" VALUE 0x26E9C6 kw_ui8_S6_S3 2540 UMR_MSEC__10_1_0_S6_S3 0 2540 /end CHARACTERISTIC
/begin CHARACTERISTIC T_VKZUSP31 "Verzoegerungszeit Start SF zuschaltende Kupplung" VALUE 0x26E9C7 kw_ui8_S6_S3 2540 UMR_MSEC__10_1_0_S6_S3 0 2540 /end CHARACTERISTIC
/begin CHARACTERISTIC TO_VKZUSLSTSP31 "Zeitoffset auf Verzögerung Schnellfüllung bei Schleppstart" VALUE 0x26E9C8 kw_ui8_S6_S3 90 UMR_MSEC__10_1_0_S6_S3 10 100 /end CHARACTERISTIC
/begin CHARACTERISTIC T_MIN_IG_CHANGESP31 "Mindestzeit fuer Ausgabe von Momentenuebergang" VALUE 0x26E9C9 kw_ui8_S6_S3 2540 UMR_MSEC__10_1_0_S6_S3 0 2540 /end CHARACTERISTIC
/begin CHARACTERISTIC KF_T_DT_IG_CHANGESP31 "Kennfeld Zeitvorhalt für Übergabe Rampenzeit auf Schaltdruck" MAP 0x25E6C0 kf_si16_S6_S3 5080 UMR_MSEC__10_1_0_S6_S3 -2540 2540
 /begin AXIS_DESCR STD_AXIS zff_atsys._.iSignale._.obj.sig_n_t UMR_U_MIN_1_1_0_S6_S3 4 0 8160 DEPOSIT ABSOLUTE MONOTONY MON_INCREASE /end AXIS_DESCR
 /begin AXIS_DESCR STD_AXIS zff_atsys._.iSignale._.obj.sig_m_t UMR_NM__1_1_0_S6_S3 4 -400 1640 DEPOSIT ABSOLUTE MONOTONY MON_INCREASE /end AXIS_DESCR
/end CHARACTERISTIC
/begin CHARACTERISTIC KF_T2_DT_IG_CHANGESP31 "Kennfeld Zeitvorhalt für Übergabe Rampenzeit auf Schaltdruck" MAP 0x25E6F8 kf_si16_S6_S3 5080 UMR_MSEC__10_1_0_S6_S3 -2540 2540
 /begin AXIS_DESCR STD_AXIS zff_atsys._.iSignale._.obj.sig_n_t UMR_U_MIN_1_1_0_S6_S3 4 0 8160 DEPOSIT ABSOLUTE MONOTONY MON_INCREASE /end AXIS_DESCR
 /begin AXIS_DESCR STD_AXIS zff_atsys._.iSignale._.obj.sig_m_t UMR_NM__1_1_0_S6_S3 4 -400 1640 DEPOSIT ABSOLUTE MONOTONY MON_INCREASE /end AXIS_DESCR
/end CHARACTERISTIC
/begin CHARACTERISTIC KL_POKZUCGSP31 "Schaltdruckoffset" CURVE 0x25E730 kl_si16_S6_S3 12.75 UMR_BAR__1_1000_0_S6_S3 -6.4 6.35
 /begin AXIS_DESCR STD_AXIS zff_atsys._.iSignale._.obj.sig_c_getr UMR_GRADC__1_1_M40_S6_S3 10 -40 150 DEPOSIT ABSOLUTE MONOTONY MON_INCREASE /end AXIS_DESCR
/end CHARACTERISTIC
/begin CHARACTERISTIC KL_POFCGSP31 "Kennlinie Fuelldruckoffset" CURVE 0x25E75C kl_si16_S6_S3 12.75 UMR_BAR__1_1000_0_S6_S3 -6.4 6.35
 /begin AXIS_DESCR STD_AXIS zff_atsys._.iSignale._.obj.sig_c_getr UMR_GRADC__1_1_M40_S6_S3 10 -40 150 DEPOSIT ABSOLUTE MONOTONY MON_INCREASE /end AXIS_DESCR
/end CHARACTERISTIC
/begin CHARACTERISTIC KL_PORASYNSP31 "Rampe n.Syn.->l.Stuetzst. y PMAX" CURVE 0x25E788 kl_si16_S6_S3 12.75 UMR_BAR__1_1000_0_S6_S3 0 12.75
 /begin AXIS_DESCR STD_AXIS iSasZentr.iSchaltend.iKzu.timer_zkzu UMR_MSEC__10_1_0_S6_S3 3 0 2540 DEPOSIT ABSOLUTE MONOTONY MON_INCREASE /end AXIS_DESCR
/end CHARACTERISTIC
/begin CHARACTERISTIC T_RA2SSCHRSP31 "Zeit 2.Rampe bei Schrittschaltung" VALUE 0x26E9CA kw_ui8_S6_S3 2540 UMR_MSEC__10_1_0_S6_S3 0 2540 /end CHARACTERISTIC
/begin CHARACTERISTIC KL_POKZUNGABSP31 "Druckoffset in Abhaengigkeit von ng_ab" CURVE 0x25E798 kl_si16_S6_S3 12.75 UMR_BAR__1_1000_0_S6_S3 -6.4 6.35
 /begin AXIS_DESCR STD_AXIS iItfInput.ng_ab UMR_U_MINSEC_1_1_0_S6_S3 4 -5000 1000 DEPOSIT ABSOLUTE MONOTONY MON_INCREASE /end AXIS_DESCR
/end CHARACTERISTIC
/begin CHARACTERISTIC KL_PORAKZUSP31 "Schaltdruckoffset" CURVE 0x25E7AC kl_si16_S6_S3 12.75 UMR_BAR__1_1000_0_S6_S3 -6.4 6.35
 /begin AXIS_DESCR STD_AXIS iSasZentr.iSchaltend.iKzu.timer_zkzu UMR_MSEC__10_1_0_S6_S3 3 0 2540 DEPOSIT ABSOLUTE MONOTONY MON_INCREASE /end AXIS_DESCR
/end CHARACTERISTIC
/begin CHARACTERISTIC KL_PGOKZUSP31 "Druckgradient in Abhaengigkeit von m_t" CURVE 0x25E7BC kl_si16_S6_S3 200 UMR_BAR_SEC_1_10_0_S6_S3 -100 100
 /begin AXIS_DESCR STD_AXIS zff_atsys._.iSignale._.obj.sig_m_t UMR_NM__1_1_0_S6_S3 6 -400 1640 DEPOSIT ABSOLUTE MONOTONY MON_INCREASE /end AXIS_DESCR
/end CHARACTERISTIC
/begin CHARACTERISTIC KL_PGOKZUWSSP31 "Druckgradient in Abhaengigkeit von m_t" CURVE 0x25E7D8 kl_si16_S6_S3 200 UMR_BAR_SEC_1_10_0_S6_S3 -100 100
 /begin AXIS_DESCR STD_AXIS zff_atsys._.iSignale._.obj.sig_m_t UMR_NM__1_1_0_S6_S3 6 -400 1640 DEPOSIT ABSOLUTE MONOTONY MON_INCREASE /end AXIS_DESCR
/end CHARACTERISTIC
/begin CHARACTERISTIC KL_POMDTSYNSP31 "Druckoffset Schliessphase f(delta_m_t seit synchron)" CURVE 0x25E7F4 kl_si16_S6_S3 12 UMR_BAR__1_1000_0_S6_S3 -6 6
 /begin AXIS_DESCR STD_AXIS iSasZentr.md_tpgrasyn UMR_NM__1_1_0_S6_S3 4 -2000 2000 DEPOSIT ABSOLUTE MONOTONY MON_INCREASE /end AXIS_DESCR
/end CHARACTERISTIC
/begin CHARACTERISTIC KL_FPGRASYNSP31 "Faktor Schließrampengradient" CURVE 0x25E808 kl_si16_S6_S3 50 UMR___1_10_0_S6_S3 0 50
 /begin AXIS_DESCR STD_AXIS iItfInput.ng_ab UMR_U_MINSEC_1_1_0_S6_S3 4 -5000 1000 DEPOSIT ABSOLUTE MONOTONY MON_INCREASE /end AXIS_DESCR
/end CHARACTERISTIC
/begin CHARACTERISTIC KF_PKZUWSSP31 "Schaltdruckkennfeld (n_tkf, m_t)" MAP 0x25E81C kf_si16_S6_S3 12.75 UMR_BAR__1_1000_0_S6_S3 0 12.75
 /begin AXIS_DESCR STD_AXIS iSasZentr.iSchaltend.n_tkf UMR_U_MIN_32_1_0_S6_S3 8 0 8160 DEPOSIT ABSOLUTE MONOTONY MON_INCREASE /end AXIS_DESCR
 /begin AXIS_DESCR STD_AXIS zff_atsys._.iSignale._.obj.sig_m_t UMR_NM__1_1_0_S6_S3 8 -400 1640 DEPOSIT ABSOLUTE MONOTONY MON_INCREASE /end AXIS_DESCR
/end CHARACTERISTIC
/begin CHARACTERISTIC KL_TSYNCGRAKZUSP31 "Zeit vor sync. Ende Schaltdruck/Start 3. Rampe KZU" CURVE 0x25E8C4 kl_ui8_S6_S3 1280 UMR_MSEC__10_1_M128_S6_S3 -1280 0
 /begin AXIS_DESCR STD_AXIS zff_atsys._.iSignale._.obj.sig_c_getr UMR_GRADC__1_1_M40_S6_S3 4 -40 215 DEPOSIT ABSOLUTE MONOTONY MON_INCREASE /end AXIS_DESCR
/end CHARACTERISTIC
/begin CHARACTERISTIC KF_TSYNMTNTRAKZUWSSP31 "Zeit vor sync. Ende Schaltdruck/Start 3. Rampe KZU bei Weiterschaltung (n_tkf, m_t8)" MAP 0x25E8D0 kf_ui8_S6_S3 1280 UMR_MSEC__10_1_M128_S6_S3 -1280 0
 /begin AXIS_DESCR STD_AXIS zff_atsys._.iSignale._.obj.sig_m_t8 UMR_NM__8_1_M50_S6_S3 4 -400 1640 DEPOSIT ABSOLUTE MONOTONY MON_INCREASE /end AXIS_DESCR
 /begin AXIS_DESCR STD_AXIS iSasZentr.iSchaltend.n_tkf UMR_U_MIN_32_1_0_S6_S3 4 0 8160 DEPOSIT ABSOLUTE MONOTONY MON_INCREASE /end AXIS_DESCR
/end CHARACTERISTIC
/begin CHARACTERISTIC KL_POFMDMOTSOLLSP31 "Fuelldruckoffset f(Erhoehung Motorsollmoment)" CURVE 0x25E8F0 kl_si16_S6_S3 12.75 UMR_BAR__1_1000_0_S6_S3 -6.4 6.35
 /begin AXIS_DESCR STD_AXIS NO_INPUT_QUANTITY UMR_NM__1_1_0_S6_S3 6 -2000 2000 DEPOSIT ABSOLUTE MONOTONY MON_INCREASE /end AXIS_DESCR
/end CHARACTERISTIC
/begin CHARACTERISTIC KL_POKZUMDMOTSOLLSP31 "Schaltdruckoffset in Abhaengigkeit von md_motsoll_sas" CURVE 0x25E90C kl_si16_S6_S3 12.75 UMR_BAR__1_1000_0_S6_S3 -6.4 6.35
 /begin AXIS_DESCR STD_AXIS NO_INPUT_QUANTITY UMR_NM__1_1_0_S6_S3 6 -2000 2000 DEPOSIT ABSOLUTE MONOTONY MON_INCREASE /end AXIS_DESCR
/end CHARACTERISTIC
/begin CHARACTERISTIC KL_TSYNMTKZUSFVSP42 "Zeit vor sync. Start Schnellfuellung vorb. KZU" CURVE 0x25E928 kl_si16_S6_S3 5000 UMR_MSEC__10_1_0_S6_S3 -5000 0
 /begin AXIS_DESCR STD_AXIS zff_atsys._.iSignale._.obj.sig_m_t UMR_NM__1_1_0_S6_S3 4 -400 1640 DEPOSIT ABSOLUTE MONOTONY MON_INCREASE /end AXIS_DESCR
/end CHARACTERISTIC
/begin CHARACTERISTIC KL_TSYNMTTRAKZUVSP42 "Zeit vor sync. Ende Fuellausgleich vorb. KZU" CURVE 0x25E93C kl_ui8_S6_S3 1280 UMR_MSEC__10_1_M128_S6_S3 -1280 0
 /begin AXIS_DESCR STD_AXIS zff_atsys._.iSignale._.obj.sig_m_t8 UMR_NM__8_1_M50_S6_S3 4 -400 1640 DEPOSIT ABSOLUTE MONOTONY MON_INCREASE /end AXIS_DESCR
/end CHARACTERISTIC
/begin CHARACTERISTIC T_SYNSP42 "Zeit n_t innerhalb Synchronschwelle bis Start Rampe 4" VALUE 0x26E9CB kw_ui8_S6_S3 2540 UMR_MSEC__10_1_0_S6_S3 0 2540 /end CHARACTERISTIC
/begin CHARACTERISTIC T_VKZUSP42 "Verzoegerungszeit Start SF zuschaltende Kupplung" VALUE 0x26E9CC kw_ui8_S6_S3 2540 UMR_MSEC__10_1_0_S6_S3 0 2540 /end CHARACTERISTIC
/begin CHARACTERISTIC TO_VKZUSLSTSP42 "Zeitoffset auf Verzögerung Schnellfüllung bei Schleppstart" VALUE 0x26E9CD kw_ui8_S6_S3 90 UMR_MSEC__10_1_0_S6_S3 10 100 /end CHARACTERISTIC
/begin CHARACTERISTIC T_MIN_IG_CHANGESP42 "Mindestzeit fuer Ausgabe von Momentenuebergang" VALUE 0x26E9CE kw_ui8_S6_S3 2540 UMR_MSEC__10_1_0_S6_S3 0 2540 /end CHARACTERISTIC
/begin CHARACTERISTIC KF_T_DT_IG_CHANGESP42 "Kennfeld Zeitvorhalt für Übergabe Rampenzeit auf Schaltdruck" MAP 0x25E948 kf_si16_S6_S3 5080 UMR_MSEC__10_1_0_S6_S3 -2540 2540
 /begin AXIS_DESCR STD_AXIS zff_atsys._.iSignale._.obj.sig_n_t UMR_U_MIN_1_1_0_S6_S3 4 0 8160 DEPOSIT ABSOLUTE MONOTONY MON_INCREASE /end AXIS_DESCR
 /begin AXIS_DESCR STD_AXIS zff_atsys._.iSignale._.obj.sig_m_t UMR_NM__1_1_0_S6_S3 4 -400 1640 DEPOSIT ABSOLUTE MONOTONY MON_INCREASE /end AXIS_DESCR
/end CHARACTERISTIC
/begin CHARACTERISTIC KF_T2_DT_IG_CHANGESP42 "Kennfeld Zeitvorhalt für Übergabe Rampenzeit auf Schaltdruck" MAP 0x25E980 kf_si16_S6_S3 5080 UMR_MSEC__10_1_0_S6_S3 -2540 2540
 /begin AXIS_DESCR STD_AXIS zff_atsys._.iSignale._.obj.sig_n_t UMR_U_MIN_1_1_0_S6_S3 4 0 8160 DEPOSIT ABSOLUTE MONOTONY MON_INCREASE /end AXIS_DESCR
 /begin AXIS_DESCR STD_AXIS zff_atsys._.iSignale._.obj.sig_m_t UMR_NM__1_1_0_S6_S3 4 -400 1640 DEPOSIT ABSOLUTE MONOTONY MON_INCREASE /end AXIS_DESCR
/end CHARACTERISTIC
/begin CHARACTERISTIC KL_POKZUCGSP42 "Schaltdruckoffset" CURVE 0x25E9B8 kl_si16_S6_S3 12.75 UMR_BAR__1_1000_0_S6_S3 -6.4 6.35
 /begin AXIS_DESCR STD_AXIS zff_atsys._.iSignale._.obj.sig_c_getr UMR_GRADC__1_1_M40_S6_S3 10 -40 150 DEPOSIT ABSOLUTE MONOTONY MON_INCREASE /end AXIS_DESCR
/end CHARACTERISTIC
/begin CHARACTERISTIC KL_POFCGSP42 "Kennlinie Fuelldruckoffset" CURVE 0x25E9E4 kl_si16_S6_S3 12.75 UMR_BAR__1_1000_0_S6_S3 -6.4 6.35
 /begin AXIS_DESCR STD_AXIS zff_atsys._.iSignale._.obj.sig_c_getr UMR_GRADC__1_1_M40_S6_S3 10 -40 150 DEPOSIT ABSOLUTE MONOTONY MON_INCREASE /end AXIS_DESCR
/end CHARACTERISTIC
/begin CHARACTERISTIC KL_PORASYNSP42 "Rampe n.Syn.->l.Stuetzst. y PMAX" CURVE 0x25EA10 kl_si16_S6_S3 12.75 UMR_BAR__1_1000_0_S6_S3 0 12.75
 /begin AXIS_DESCR STD_AXIS iSasZentr.iSchaltend.iKzu.timer_zkzu UMR_MSEC__10_1_0_S6_S3 3 0 2540 DEPOSIT ABSOLUTE MONOTONY MON_INCREASE /end AXIS_DESCR
/end CHARACTERISTIC
/begin CHARACTERISTIC T_RA2SSCHRSP42 "Zeit 2.Rampe bei Schrittschaltung" VALUE 0x26E9CF kw_ui8_S6_S3 2540 UMR_MSEC__10_1_0_S6_S3 0 2540 /end CHARACTERISTIC
/begin CHARACTERISTIC KL_POKZUNGABSP42 "Druckoffset in Abhaengigkeit von ng_ab" CURVE 0x25EA20 kl_si16_S6_S3 12.75 UMR_BAR__1_1000_0_S6_S3 -6.4 6.35
 /begin AXIS_DESCR STD_AXIS iItfInput.ng_ab UMR_U_MINSEC_1_1_0_S6_S3 4 -5000 1000 DEPOSIT ABSOLUTE MONOTONY MON_INCREASE /end AXIS_DESCR
/end CHARACTERISTIC
/begin CHARACTERISTIC KL_PORAKZUSP42 "Schaltdruckoffset" CURVE 0x25EA34 kl_si16_S6_S3 12.75 UMR_BAR__1_1000_0_S6_S3 -6.4 6.35
 /begin AXIS_DESCR STD_AXIS iSasZentr.iSchaltend.iKzu.timer_zkzu UMR_MSEC__10_1_0_S6_S3 3 0 2540 DEPOSIT ABSOLUTE MONOTONY MON_INCREASE /end AXIS_DESCR
/end CHARACTERISTIC
/begin CHARACTERISTIC KL_PGOKZUSP42 "Druckgradient in Abhaengigkeit von m_t" CURVE 0x25EA44 kl_si16_S6_S3 200 UMR_BAR_SEC_1_10_0_S6_S3 -100 100
 /begin AXIS_DESCR STD_AXIS zff_atsys._.iSignale._.obj.sig_m_t UMR_NM__1_1_0_S6_S3 6 -400 1640 DEPOSIT ABSOLUTE MONOTONY MON_INCREASE /end AXIS_DESCR
/end CHARACTERISTIC
/begin CHARACTERISTIC KL_PGOKZUWSSP42 "Druckgradient in Abhaengigkeit von m_t" CURVE 0x25EA60 kl_si16_S6_S3 200 UMR_BAR_SEC_1_10_0_S6_S3 -100 100
 /begin AXIS_DESCR STD_AXIS zff_atsys._.iSignale._.obj.sig_m_t UMR_NM__1_1_0_S6_S3 6 -400 1640 DEPOSIT ABSOLUTE MONOTONY MON_INCREASE /end AXIS_DESCR
/end CHARACTERISTIC
/begin CHARACTERISTIC KL_POMDTSYNSP42 "Druckoffset Schliessphase f(delta_m_t seit synchron)" CURVE 0x25EA7C kl_si16_S6_S3 12 UMR_BAR__1_1000_0_S6_S3 -6 6
 /begin AXIS_DESCR STD_AXIS iSasZentr.md_tpgrasyn UMR_NM__1_1_0_S6_S3 4 -2000 2000 DEPOSIT ABSOLUTE MONOTONY MON_INCREASE /end AXIS_DESCR
/end CHARACTERISTIC
/begin CHARACTERISTIC KL_FPGRASYNSP42 "Faktor Schließrampengradient" CURVE 0x25EA90 kl_si16_S6_S3 50 UMR___1_10_0_S6_S3 0 50
 /begin AXIS_DESCR STD_AXIS iItfInput.ng_ab UMR_U_MINSEC_1_1_0_S6_S3 4 -5000 1000 DEPOSIT ABSOLUTE MONOTONY MON_INCREASE /end AXIS_DESCR
/end CHARACTERISTIC
/begin CHARACTERISTIC KF_PKZUWSSP42 "Schaltdruckkennfeld (n_tkf, m_t)" MAP 0x25EAA4 kf_si16_S6_S3 12.75 UMR_BAR__1_1000_0_S6_S3 0 12.75
 /begin AXIS_DESCR STD_AXIS iSasZentr.iSchaltend.n_tkf UMR_U_MIN_32_1_0_S6_S3 8 0 8160 DEPOSIT ABSOLUTE MONOTONY MON_INCREASE /end AXIS_DESCR
 /begin AXIS_DESCR STD_AXIS zff_atsys._.iSignale._.obj.sig_m_t UMR_NM__1_1_0_S6_S3 8 -400 1640 DEPOSIT ABSOLUTE MONOTONY MON_INCREASE /end AXIS_DESCR
/end CHARACTERISTIC
/begin CHARACTERISTIC KL_TSYNCGRAKZUSP42 "Zeit vor sync. Ende Schaltdruck/Start 3. Rampe KZU" CURVE 0x25EB4C kl_ui8_S6_S3 1280 UMR_MSEC__10_1_M128_S6_S3 -1280 0
 /begin AXIS_DESCR STD_AXIS zff_atsys._.iSignale._.obj.sig_c_getr UMR_GRADC__1_1_M40_S6_S3 4 -40 215 DEPOSIT ABSOLUTE MONOTONY MON_INCREASE /end AXIS_DESCR
/end CHARACTERISTIC
/begin CHARACTERISTIC KF_TSYNMTNTRAKZUWSSP42 "Zeit vor sync. Ende Schaltdruck/Start 3. Rampe KZU bei Weiterschaltung (n_tkf, m_t8)" MAP 0x25EB58 kf_ui8_S6_S3 1280 UMR_MSEC__10_1_M128_S6_S3 -1280 0
 /begin AXIS_DESCR STD_AXIS zff_atsys._.iSignale._.obj.sig_m_t8 UMR_NM__8_1_M50_S6_S3 4 -400 1640 DEPOSIT ABSOLUTE MONOTONY MON_INCREASE /end AXIS_DESCR
 /begin AXIS_DESCR STD_AXIS iSasZentr.iSchaltend.n_tkf UMR_U_MIN_32_1_0_S6_S3 4 0 8160 DEPOSIT ABSOLUTE MONOTONY MON_INCREASE /end AXIS_DESCR
/end CHARACTERISTIC
/begin CHARACTERISTIC KL_POFMDMOTSOLLSP42 "Fuelldruckoffset f(Erhoehung Motorsollmoment)" CURVE 0x25EB78 kl_si16_S6_S3 12.75 UMR_BAR__1_1000_0_S6_S3 -6.4 6.35
 /begin AXIS_DESCR STD_AXIS NO_INPUT_QUANTITY UMR_NM__1_1_0_S6_S3 6 -2000 2000 DEPOSIT ABSOLUTE MONOTONY MON_INCREASE /end AXIS_DESCR
/end CHARACTERISTIC
/begin CHARACTERISTIC KL_POKZUMDMOTSOLLSP42 "Schaltdruckoffset in Abhaengigkeit von md_motsoll_sas" CURVE 0x25EB94 kl_si16_S6_S3 12.75 UMR_BAR__1_1000_0_S6_S3 -6.4 6.35
 /begin AXIS_DESCR STD_AXIS NO_INPUT_QUANTITY UMR_NM__1_1_0_S6_S3 6 -2000 2000 DEPOSIT ABSOLUTE MONOTONY MON_INCREASE /end AXIS_DESCR
/end CHARACTERISTIC
/begin CHARACTERISTIC KL_TSYNMTKZUSFVSP51 "Zeit vor sync. Start Schnellfuellung vorb. KZU" CURVE 0x25EBB0 kl_si16_S6_S3 5000 UMR_MSEC__10_1_0_S6_S3 -5000 0
 /begin AXIS_DESCR STD_AXIS zff_atsys._.iSignale._.obj.sig_m_t UMR_NM__1_1_0_S6_S3 4 -400 1640 DEPOSIT ABSOLUTE MONOTONY MON_INCREASE /end AXIS_DESCR
/end CHARACTERISTIC
/begin CHARACTERISTIC KL_TSYNMTTRAKZUVSP51 "Zeit vor sync. Ende Fuellausgleich vorb. KZU" CURVE 0x25EBC4 kl_ui8_S6_S3 1280 UMR_MSEC__10_1_M128_S6_S3 -1280 0
 /begin AXIS_DESCR STD_AXIS zff_atsys._.iSignale._.obj.sig_m_t8 UMR_NM__8_1_M50_S6_S3 4 -400 1640 DEPOSIT ABSOLUTE MONOTONY MON_INCREASE /end AXIS_DESCR
/end CHARACTERISTIC
/begin CHARACTERISTIC T_SYNSP51 "Zeit n_t innerhalb Synchronschwelle bis Start Rampe 4" VALUE 0x26E9D0 kw_ui8_S6_S3 2540 UMR_MSEC__10_1_0_S6_S3 0 2540 /end CHARACTERISTIC
/begin CHARACTERISTIC T_VKZUSP51 "Verzoegerungszeit Start SF zuschaltende Kupplung" VALUE 0x26E9D1 kw_ui8_S6_S3 2540 UMR_MSEC__10_1_0_S6_S3 0 2540 /end CHARACTERISTIC
/begin CHARACTERISTIC TO_VKZUSLSTSP51 "Zeitoffset auf Verzögerung Schnellfüllung bei Schleppstart" VALUE 0x26E9D2 kw_ui8_S6_S3 90 UMR_MSEC__10_1_0_S6_S3 10 100 /end CHARACTERISTIC
/begin CHARACTERISTIC T_MIN_IG_CHANGESP51 "Mindestzeit fuer Ausgabe von Momentenuebergang" VALUE 0x26E9D3 kw_ui8_S6_S3 2540 UMR_MSEC__10_1_0_S6_S3 0 2540 /end CHARACTERISTIC
/begin CHARACTERISTIC KF_T_DT_IG_CHANGESP51 "Kennfeld Zeitvorhalt für Übergabe Rampenzeit auf Schaltdruck" MAP 0x25EBD0 kf_si16_S6_S3 5080 UMR_MSEC__10_1_0_S6_S3 -2540 2540
 /begin AXIS_DESCR STD_AXIS zff_atsys._.iSignale._.obj.sig_n_t UMR_U_MIN_1_1_0_S6_S3 4 0 8160 DEPOSIT ABSOLUTE MONOTONY MON_INCREASE /end AXIS_DESCR
 /begin AXIS_DESCR STD_AXIS zff_atsys._.iSignale._.obj.sig_m_t UMR_NM__1_1_0_S6_S3 4 -400 1640 DEPOSIT ABSOLUTE MONOTONY MON_INCREASE /end AXIS_DESCR
/end CHARACTERISTIC
/begin CHARACTERISTIC KF_T2_DT_IG_CHANGESP51 "Kennfeld Zeitvorhalt für Übergabe Rampenzeit auf Schaltdruck" MAP 0x25EC08 kf_si16_S6_S3 5080 UMR_MSEC__10_1_0_S6_S3 -2540 2540
 /begin AXIS_DESCR STD_AXIS zff_atsys._.iSignale._.obj.sig_n_t UMR_U_MIN_1_1_0_S6_S3 4 0 8160 DEPOSIT ABSOLUTE MONOTONY MON_INCREASE /end AXIS_DESCR
 /begin AXIS_DESCR STD_AXIS zff_atsys._.iSignale._.obj.sig_m_t UMR_NM__1_1_0_S6_S3 4 -400 1640 DEPOSIT ABSOLUTE MONOTONY MON_INCREASE /end AXIS_DESCR
/end CHARACTERISTIC
/begin CHARACTERISTIC KL_POKZUCGSP51 "Schaltdruckoffset" CURVE 0x25EC40 kl_si16_S6_S3 12.75 UMR_BAR__1_1000_0_S6_S3 -6.4 6.35
 /begin AXIS_DESCR STD_AXIS zff_atsys._.iSignale._.obj.sig_c_getr UMR_GRADC__1_1_M40_S6_S3 10 -40 150 DEPOSIT ABSOLUTE MONOTONY MON_INCREASE /end AXIS_DESCR
/end CHARACTERISTIC
/begin CHARACTERISTIC KL_POFCGSP51 "Kennlinie Fuelldruckoffset" CURVE 0x25EC6C kl_si16_S6_S3 12.75 UMR_BAR__1_1000_0_S6_S3 -6.4 6.35
 /begin AXIS_DESCR STD_AXIS zff_atsys._.iSignale._.obj.sig_c_getr UMR_GRADC__1_1_M40_S6_S3 10 -40 150 DEPOSIT ABSOLUTE MONOTONY MON_INCREASE /end AXIS_DESCR
/end CHARACTERISTIC
/begin CHARACTERISTIC KL_PORASYNSP51 "Rampe n.Syn.->l.Stuetzst. y PMAX" CURVE 0x25EC98 kl_si16_S6_S3 12.75 UMR_BAR__1_1000_0_S6_S3 0 12.75
 /begin AXIS_DESCR STD_AXIS iSasZentr.iSchaltend.iKzu.timer_zkzu UMR_MSEC__10_1_0_S6_S3 3 0 2540 DEPOSIT ABSOLUTE MONOTONY MON_INCREASE /end AXIS_DESCR
/end CHARACTERISTIC
/begin CHARACTERISTIC T_RA2SSCHRSP51 "Zeit 2.Rampe bei Schrittschaltung" VALUE 0x26E9D4 kw_ui8_S6_S3 2540 UMR_MSEC__10_1_0_S6_S3 0 2540 /end CHARACTERISTIC
/begin CHARACTERISTIC KL_POKZUNGABSP51 "Druckoffset in Abhaengigkeit von ng_ab" CURVE 0x25ECA8 kl_si16_S6_S3 12.75 UMR_BAR__1_1000_0_S6_S3 -6.4 6.35
 /begin AXIS_DESCR STD_AXIS iItfInput.ng_ab UMR_U_MINSEC_1_1_0_S6_S3 4 -5000 1000 DEPOSIT ABSOLUTE MONOTONY MON_INCREASE /end AXIS_DESCR
/end CHARACTERISTIC
/begin CHARACTERISTIC KL_PORAKZUSP51 "Schaltdruckoffset" CURVE 0x25ECBC kl_si16_S6_S3 12.75 UMR_BAR__1_1000_0_S6_S3 -6.4 6.35
 /begin AXIS_DESCR STD_AXIS iSasZentr.iSchaltend.iKzu.timer_zkzu UMR_MSEC__10_1_0_S6_S3 3 0 2540 DEPOSIT ABSOLUTE MONOTONY MON_INCREASE /end AXIS_DESCR
/end CHARACTERISTIC
/begin CHARACTERISTIC KL_PGOKZUSP51 "Druckgradient in Abhaengigkeit von m_t" CURVE 0x25ECCC kl_si16_S6_S3 200 UMR_BAR_SEC_1_10_0_S6_S3 -100 100
 /begin AXIS_DESCR STD_AXIS zff_atsys._.iSignale._.obj.sig_m_t UMR_NM__1_1_0_S6_S3 6 -400 1640 DEPOSIT ABSOLUTE MONOTONY MON_INCREASE /end AXIS_DESCR
/end CHARACTERISTIC
/begin CHARACTERISTIC KL_PGOKZUWSSP51 "Druckgradient in Abhaengigkeit von m_t" CURVE 0x25ECE8 kl_si16_S6_S3 200 UMR_BAR_SEC_1_10_0_S6_S3 -100 100
 /begin AXIS_DESCR STD_AXIS zff_atsys._.iSignale._.obj.sig_m_t UMR_NM__1_1_0_S6_S3 6 -400 1640 DEPOSIT ABSOLUTE MONOTONY MON_INCREASE /end AXIS_DESCR
/end CHARACTERISTIC
/begin CHARACTERISTIC KL_POMDTSYNSP51 "Druckoffset Schliessphase f(delta_m_t seit synchron)" CURVE 0x25ED04 kl_si16_S6_S3 12 UMR_BAR__1_1000_0_S6_S3 -6 6
 /begin AXIS_DESCR STD_AXIS iSasZentr.md_tpgrasyn UMR_NM__1_1_0_S6_S3 4 -2000 2000 DEPOSIT ABSOLUTE MONOTONY MON_INCREASE /end AXIS_DESCR
/end CHARACTERISTIC
/begin CHARACTERISTIC KL_FPGRASYNSP51 "Faktor Schließrampengradient" CURVE 0x25ED18 kl_si16_S6_S3 50 UMR___1_10_0_S6_S3 0 50
 /begin AXIS_DESCR STD_AXIS iItfInput.ng_ab UMR_U_MINSEC_1_1_0_S6_S3 4 -5000 1000 DEPOSIT ABSOLUTE MONOTONY MON_INCREASE /end AXIS_DESCR
/end CHARACTERISTIC
/begin CHARACTERISTIC KF_PKZUWSSP51 "Schaltdruckkennfeld (n_tkf, m_t)" MAP 0x25ED2C kf_si16_S6_S3 12.75 UMR_BAR__1_1000_0_S6_S3 0 12.75
 /begin AXIS_DESCR STD_AXIS iSasZentr.iSchaltend.n_tkf UMR_U_MIN_32_1_0_S6_S3 8 0 8160 DEPOSIT ABSOLUTE MONOTONY MON_INCREASE /end AXIS_DESCR
 /begin AXIS_DESCR STD_AXIS zff_atsys._.iSignale._.obj.sig_m_t UMR_NM__1_1_0_S6_S3 8 -400 1640 DEPOSIT ABSOLUTE MONOTONY MON_INCREASE /end AXIS_DESCR
/end CHARACTERISTIC
/begin CHARACTERISTIC KL_TSYNCGRAKZUSP51 "Zeit vor sync. Ende Schaltdruck/Start 3. Rampe KZU" CURVE 0x25EDD4 kl_ui8_S6_S3 1280 UMR_MSEC__10_1_M128_S6_S3 -1280 0
 /begin AXIS_DESCR STD_AXIS zff_atsys._.iSignale._.obj.sig_c_getr UMR_GRADC__1_1_M40_S6_S3 4 -40 215 DEPOSIT ABSOLUTE MONOTONY MON_INCREASE /end AXIS_DESCR
/end CHARACTERISTIC
/begin CHARACTERISTIC KF_TSYNMTNTRAKZUWSSP51 "Zeit vor sync. Ende Schaltdruck/Start 3. Rampe KZU bei Weiterschaltung (n_tkf, m_t8)" MAP 0x25EDE0 kf_ui8_S6_S3 1280 UMR_MSEC__10_1_M128_S6_S3 -1280 0
 /begin AXIS_DESCR STD_AXIS zff_atsys._.iSignale._.obj.sig_m_t8 UMR_NM__8_1_M50_S6_S3 4 -400 1640 DEPOSIT ABSOLUTE MONOTONY MON_INCREASE /end AXIS_DESCR
 /begin AXIS_DESCR STD_AXIS iSasZentr.iSchaltend.n_tkf UMR_U_MIN_32_1_0_S6_S3 4 0 8160 DEPOSIT ABSOLUTE MONOTONY MON_INCREASE /end AXIS_DESCR
/end CHARACTERISTIC
/begin CHARACTERISTIC KL_POFMDMOTSOLLSP51 "Fuelldruckoffset f(Erhoehung Motorsollmoment)" CURVE 0x25EE00 kl_si16_S6_S3 12.75 UMR_BAR__1_1000_0_S6_S3 -6.4 6.35
 /begin AXIS_DESCR STD_AXIS NO_INPUT_QUANTITY UMR_NM__1_1_0_S6_S3 6 -2000 2000 DEPOSIT ABSOLUTE MONOTONY MON_INCREASE /end AXIS_DESCR
/end CHARACTERISTIC
/begin CHARACTERISTIC KL_POKZUMDMOTSOLLSP51 "Schaltdruckoffset in Abhaengigkeit von md_motsoll_sas" CURVE 0x25EE1C kl_si16_S6_S3 12.75 UMR_BAR__1_1000_0_S6_S3 -6.4 6.35
 /begin AXIS_DESCR STD_AXIS NO_INPUT_QUANTITY UMR_NM__1_1_0_S6_S3 6 -2000 2000 DEPOSIT ABSOLUTE MONOTONY MON_INCREASE /end AXIS_DESCR
/end CHARACTERISTIC
/begin CHARACTERISTIC KL_TSYNMTKZUSFVSP53 "Zeit vor sync. Start Schnellfuellung vorb. KZU" CURVE 0x25EE38 kl_si16_S6_S3 5000 UMR_MSEC__10_1_0_S6_S3 -5000 0
 /begin AXIS_DESCR STD_AXIS zff_atsys._.iSignale._.obj.sig_m_t UMR_NM__1_1_0_S6_S3 4 -400 1640 DEPOSIT ABSOLUTE MONOTONY MON_INCREASE /end AXIS_DESCR
/end CHARACTERISTIC
/begin CHARACTERISTIC KL_TSYNMTTRAKZUVSP53 "Zeit vor sync. Ende Fuellausgleich vorb. KZU" CURVE 0x25EE4C kl_ui8_S6_S3 1280 UMR_MSEC__10_1_M128_S6_S3 -1280 0
 /begin AXIS_DESCR STD_AXIS zff_atsys._.iSignale._.obj.sig_m_t8 UMR_NM__8_1_M50_S6_S3 4 -400 1640 DEPOSIT ABSOLUTE MONOTONY MON_INCREASE /end AXIS_DESCR
/end CHARACTERISTIC
/begin CHARACTERISTIC T_SYNSP53 "Zeit n_t innerhalb Synchronschwelle bis Start Rampe 4" VALUE 0x26E9D5 kw_ui8_S6_S3 2540 UMR_MSEC__10_1_0_S6_S3 0 2540 /end CHARACTERISTIC
/begin CHARACTERISTIC T_VKZUSP53 "Verzoegerungszeit Start SF zuschaltende Kupplung" VALUE 0x26E9D6 kw_ui8_S6_S3 2540 UMR_MSEC__10_1_0_S6_S3 0 2540 /end CHARACTERISTIC
/begin CHARACTERISTIC TO_VKZUSLSTSP53 "Zeitoffset auf Verzögerung Schnellfüllung bei Schleppstart" VALUE 0x26E9D7 kw_ui8_S6_S3 90 UMR_MSEC__10_1_0_S6_S3 10 100 /end CHARACTERISTIC
/begin CHARACTERISTIC T_MIN_IG_CHANGESP53 "Mindestzeit fuer Ausgabe von Momentenuebergang" VALUE 0x26E9D8 kw_ui8_S6_S3 2540 UMR_MSEC__10_1_0_S6_S3 0 2540 /end CHARACTERISTIC
/begin CHARACTERISTIC KF_T_DT_IG_CHANGESP53 "Kennfeld Zeitvorhalt für Übergabe Rampenzeit auf Schaltdruck" MAP 0x25EE58 kf_si16_S6_S3 5080 UMR_MSEC__10_1_0_S6_S3 -2540 2540
 /begin AXIS_DESCR STD_AXIS zff_atsys._.iSignale._.obj.sig_n_t UMR_U_MIN_1_1_0_S6_S3 4 0 8160 DEPOSIT ABSOLUTE MONOTONY MON_INCREASE /end AXIS_DESCR
 /begin AXIS_DESCR STD_AXIS zff_atsys._.iSignale._.obj.sig_m_t UMR_NM__1_1_0_S6_S3 4 -400 1640 DEPOSIT ABSOLUTE MONOTONY MON_INCREASE /end AXIS_DESCR
/end CHARACTERISTIC
/begin CHARACTERISTIC KF_T2_DT_IG_CHANGESP53 "Kennfeld Zeitvorhalt für Übergabe Rampenzeit auf Schaltdruck" MAP 0x25EE90 kf_si16_S6_S3 5080 UMR_MSEC__10_1_0_S6_S3 -2540 2540
 /begin AXIS_DESCR STD_AXIS zff_atsys._.iSignale._.obj.sig_n_t UMR_U_MIN_1_1_0_S6_S3 4 0 8160 DEPOSIT ABSOLUTE MONOTONY MON_INCREASE /end AXIS_DESCR
 /begin AXIS_DESCR STD_AXIS zff_atsys._.iSignale._.obj.sig_m_t UMR_NM__1_1_0_S6_S3 4 -400 1640 DEPOSIT ABSOLUTE MONOTONY MON_INCREASE /end AXIS_DESCR
/end CHARACTERISTIC
/begin CHARACTERISTIC KL_POKZUCGSP53 "Schaltdruckoffset" CURVE 0x25EEC8 kl_si16_S6_S3 12.75 UMR_BAR__1_1000_0_S6_S3 -6.4 6.35
 /begin AXIS_DESCR STD_AXIS zff_atsys._.iSignale._.obj.sig_c_getr UMR_GRADC__1_1_M40_S6_S3 10 -40 150 DEPOSIT ABSOLUTE MONOTONY MON_INCREASE /end AXIS_DESCR
/end CHARACTERISTIC
/begin CHARACTERISTIC KL_POFCGSP53 "Kennlinie Fuelldruckoffset" CURVE 0x25EEF4 kl_si16_S6_S3 12.75 UMR_BAR__1_1000_0_S6_S3 -6.4 6.35
 /begin AXIS_DESCR STD_AXIS zff_atsys._.iSignale._.obj.sig_c_getr UMR_GRADC__1_1_M40_S6_S3 10 -40 150 DEPOSIT ABSOLUTE MONOTONY MON_INCREASE /end AXIS_DESCR
/end CHARACTERISTIC
/begin CHARACTERISTIC KL_PORASYNSP53 "Rampe n.Syn.->l.Stuetzst. y PMAX" CURVE 0x25EF20 kl_si16_S6_S3 12.75 UMR_BAR__1_1000_0_S6_S3 0 12.75
 /begin AXIS_DESCR STD_AXIS iSasZentr.iSchaltend.iKzu.timer_zkzu UMR_MSEC__10_1_0_S6_S3 3 0 2540 DEPOSIT ABSOLUTE MONOTONY MON_INCREASE /end AXIS_DESCR
/end CHARACTERISTIC
/begin CHARACTERISTIC T_RA2SSCHRSP53 "Zeit 2.Rampe bei Schrittschaltung" VALUE 0x26E9D9 kw_ui8_S6_S3 2540 UMR_MSEC__10_1_0_S6_S3 0 2540 /end CHARACTERISTIC
/begin CHARACTERISTIC KL_POKZUNGABSP53 "Druckoffset in Abhaengigkeit von ng_ab" CURVE 0x25EF30 kl_si16_S6_S3 12.75 UMR_BAR__1_1000_0_S6_S3 -6.4 6.35
 /begin AXIS_DESCR STD_AXIS iItfInput.ng_ab UMR_U_MINSEC_1_1_0_S6_S3 4 -5000 1000 DEPOSIT ABSOLUTE MONOTONY MON_INCREASE /end AXIS_DESCR
/end CHARACTERISTIC
/begin CHARACTERISTIC KL_PORAKZUSP53 "Schaltdruckoffset" CURVE 0x25EF44 kl_si16_S6_S3 12.75 UMR_BAR__1_1000_0_S6_S3 -6.4 6.35
 /begin AXIS_DESCR STD_AXIS iSasZentr.iSchaltend.iKzu.timer_zkzu UMR_MSEC__10_1_0_S6_S3 3 0 2540 DEPOSIT ABSOLUTE MONOTONY MON_INCREASE /end AXIS_DESCR
/end CHARACTERISTIC
/begin CHARACTERISTIC KL_PGOKZUSP53 "Druckgradient in Abhaengigkeit von m_t" CURVE 0x25EF54 kl_si16_S6_S3 200 UMR_BAR_SEC_1_10_0_S6_S3 -100 100
 /begin AXIS_DESCR STD_AXIS zff_atsys._.iSignale._.obj.sig_m_t UMR_NM__1_1_0_S6_S3 6 -400 1640 DEPOSIT ABSOLUTE MONOTONY MON_INCREASE /end AXIS_DESCR
/end CHARACTERISTIC
/begin CHARACTERISTIC KL_PGOKZUWSSP53 "Druckgradient in Abhaengigkeit von m_t" CURVE 0x25EF70 kl_si16_S6_S3 200 UMR_BAR_SEC_1_10_0_S6_S3 -100 100
 /begin AXIS_DESCR STD_AXIS zff_atsys._.iSignale._.obj.sig_m_t UMR_NM__1_1_0_S6_S3 6 -400 1640 DEPOSIT ABSOLUTE MONOTONY MON_INCREASE /end AXIS_DESCR
/end CHARACTERISTIC
/begin CHARACTERISTIC KL_POMDTSYNSP53 "Druckoffset Schliessphase f(delta_m_t seit synchron)" CURVE 0x25EF8C kl_si16_S6_S3 12 UMR_BAR__1_1000_0_S6_S3 -6 6
 /begin AXIS_DESCR STD_AXIS iSasZentr.md_tpgrasyn UMR_NM__1_1_0_S6_S3 4 -2000 2000 DEPOSIT ABSOLUTE MONOTONY MON_INCREASE /end AXIS_DESCR
/end CHARACTERISTIC
/begin CHARACTERISTIC KL_FPGRASYNSP53 "Faktor Schließrampengradient" CURVE 0x25EFA0 kl_si16_S6_S3 50 UMR___1_10_0_S6_S3 0 50
 /begin AXIS_DESCR STD_AXIS iItfInput.ng_ab UMR_U_MINSEC_1_1_0_S6_S3 4 -5000 1000 DEPOSIT ABSOLUTE MONOTONY MON_INCREASE /end AXIS_DESCR
/end CHARACTERISTIC
/begin CHARACTERISTIC KF_PKZUWSSP53 "Schaltdruckkennfeld (n_tkf, m_t)" MAP 0x25EFB4 kf_si16_S6_S3 12.75 UMR_BAR__1_1000_0_S6_S3 0 12.75
 /begin AXIS_DESCR STD_AXIS iSasZentr.iSchaltend.n_tkf UMR_U_MIN_32_1_0_S6_S3 8 0 8160 DEPOSIT ABSOLUTE MONOTONY MON_INCREASE /end AXIS_DESCR
 /begin AXIS_DESCR STD_AXIS zff_atsys._.iSignale._.obj.sig_m_t UMR_NM__1_1_0_S6_S3 8 -400 1640 DEPOSIT ABSOLUTE MONOTONY MON_INCREASE /end AXIS_DESCR
/end CHARACTERISTIC
/begin CHARACTERISTIC KL_TSYNCGRAKZUSP53 "Zeit vor sync. Ende Schaltdruck/Start 3. Rampe KZU" CURVE 0x25F05C kl_ui8_S6_S3 1280 UMR_MSEC__10_1_M128_S6_S3 -1280 0
 /begin AXIS_DESCR STD_AXIS zff_atsys._.iSignale._.obj.sig_c_getr UMR_GRADC__1_1_M40_S6_S3 4 -40 215 DEPOSIT ABSOLUTE MONOTONY MON_INCREASE /end AXIS_DESCR
/end CHARACTERISTIC
/begin CHARACTERISTIC KF_TSYNMTNTRAKZUWSSP53 "Zeit vor sync. Ende Schaltdruck/Start 3. Rampe KZU bei Weiterschaltung (n_tkf, m_t8)" MAP 0x25F068 kf_ui8_S6_S3 1280 UMR_MSEC__10_1_M128_S6_S3 -1280 0
 /begin AXIS_DESCR STD_AXIS zff_atsys._.iSignale._.obj.sig_m_t8 UMR_NM__8_1_M50_S6_S3 4 -400 1640 DEPOSIT ABSOLUTE MONOTONY MON_INCREASE /end AXIS_DESCR
 /begin AXIS_DESCR STD_AXIS iSasZentr.iSchaltend.n_tkf UMR_U_MIN_32_1_0_S6_S3 4 0 8160 DEPOSIT ABSOLUTE MONOTONY MON_INCREASE /end AXIS_DESCR
/end CHARACTERISTIC
/begin CHARACTERISTIC KL_POFMDMOTSOLLSP53 "Fuelldruckoffset f(Erhoehung Motorsollmoment)" CURVE 0x25F088 kl_si16_S6_S3 12.75 UMR_BAR__1_1000_0_S6_S3 -6.4 6.35
 /begin AXIS_DESCR STD_AXIS NO_INPUT_QUANTITY UMR_NM__1_1_0_S6_S3 6 -2000 2000 DEPOSIT ABSOLUTE MONOTONY MON_INCREASE /end AXIS_DESCR
/end CHARACTERISTIC
/begin CHARACTERISTIC KL_POKZUMDMOTSOLLSP53 "Schaltdruckoffset in Abhaengigkeit von md_motsoll_sas" CURVE 0x25F0A4 kl_si16_S6_S3 12.75 UMR_BAR__1_1000_0_S6_S3 -6.4 6.35
 /begin AXIS_DESCR STD_AXIS NO_INPUT_QUANTITY UMR_NM__1_1_0_S6_S3 6 -2000 2000 DEPOSIT ABSOLUTE MONOTONY MON_INCREASE /end AXIS_DESCR
/end CHARACTERISTIC
/begin CHARACTERISTIC KL_TSYNMTKZUSFVSP63 "Zeit vor sync. Start Schnellfuellung vorb. KZU" CURVE 0x25F0C0 kl_si16_S6_S3 5000 UMR_MSEC__10_1_0_S6_S3 -5000 0
 /begin AXIS_DESCR STD_AXIS zff_atsys._.iSignale._.obj.sig_m_t UMR_NM__1_1_0_S6_S3 4 -400 1640 DEPOSIT ABSOLUTE MONOTONY MON_INCREASE /end AXIS_DESCR
/end CHARACTERISTIC
/begin CHARACTERISTIC KL_TSYNMTTRAKZUVSP63 "Zeit vor sync. Ende Fuellausgleich vorb. KZU" CURVE 0x25F0D4 kl_ui8_S6_S3 1280 UMR_MSEC__10_1_M128_S6_S3 -1280 0
 /begin AXIS_DESCR STD_AXIS zff_atsys._.iSignale._.obj.sig_m_t8 UMR_NM__8_1_M50_S6_S3 4 -400 1640 DEPOSIT ABSOLUTE MONOTONY MON_INCREASE /end AXIS_DESCR
/end CHARACTERISTIC
/begin CHARACTERISTIC T_SYNSP63 "Zeit n_t innerhalb Synchronschwelle bis Start Rampe 4" VALUE 0x26E9DA kw_ui8_S6_S3 2540 UMR_MSEC__10_1_0_S6_S3 0 2540 /end CHARACTERISTIC
/begin CHARACTERISTIC T_VKZUSP63 "Verzoegerungszeit Start SF zuschaltende Kupplung" VALUE 0x26E9DB kw_ui8_S6_S3 2540 UMR_MSEC__10_1_0_S6_S3 0 2540 /end CHARACTERISTIC
/begin CHARACTERISTIC TO_VKZUSLSTSP63 "Zeitoffset auf Verzögerung Schnellfüllung bei Schleppstart" VALUE 0x26E9DC kw_ui8_S6_S3 90 UMR_MSEC__10_1_0_S6_S3 10 100 /end CHARACTERISTIC
/begin CHARACTERISTIC T_MIN_IG_CHANGESP63 "Mindestzeit fuer Ausgabe von Momentenuebergang" VALUE 0x26E9DD kw_ui8_S6_S3 2540 UMR_MSEC__10_1_0_S6_S3 0 2540 /end CHARACTERISTIC
/begin CHARACTERISTIC KF_T_DT_IG_CHANGESP63 "Kennfeld Zeitvorhalt für Übergabe Rampenzeit auf Schaltdruck" MAP 0x25F0E0 kf_si16_S6_S3 5080 UMR_MSEC__10_1_0_S6_S3 -2540 2540
 /begin AXIS_DESCR STD_AXIS zff_atsys._.iSignale._.obj.sig_n_t UMR_U_MIN_1_1_0_S6_S3 4 0 8160 DEPOSIT ABSOLUTE MONOTONY MON_INCREASE /end AXIS_DESCR
 /begin AXIS_DESCR STD_AXIS zff_atsys._.iSignale._.obj.sig_m_t UMR_NM__1_1_0_S6_S3 4 -400 1640 DEPOSIT ABSOLUTE MONOTONY MON_INCREASE /end AXIS_DESCR
/end CHARACTERISTIC
/begin CHARACTERISTIC KF_T2_DT_IG_CHANGESP63 "Kennfeld Zeitvorhalt für Übergabe Rampenzeit auf Schaltdruck" MAP 0x25F118 kf_si16_S6_S3 5080 UMR_MSEC__10_1_0_S6_S3 -2540 2540
 /begin AXIS_DESCR STD_AXIS zff_atsys._.iSignale._.obj.sig_n_t UMR_U_MIN_1_1_0_S6_S3 4 0 8160 DEPOSIT ABSOLUTE MONOTONY MON_INCREASE /end AXIS_DESCR
 /begin AXIS_DESCR STD_AXIS zff_atsys._.iSignale._.obj.sig_m_t UMR_NM__1_1_0_S6_S3 4 -400 1640 DEPOSIT ABSOLUTE MONOTONY MON_INCREASE /end AXIS_DESCR
/end CHARACTERISTIC
/begin CHARACTERISTIC KL_POKZUCGSP63 "Schaltdruckoffset" CURVE 0x25F150 kl_si16_S6_S3 12.75 UMR_BAR__1_1000_0_S6_S3 -6.4 6.35
 /begin AXIS_DESCR STD_AXIS zff_atsys._.iSignale._.obj.sig_c_getr UMR_GRADC__1_1_M40_S6_S3 10 -40 150 DEPOSIT ABSOLUTE MONOTONY MON_INCREASE /end AXIS_DESCR
/end CHARACTERISTIC
/begin CHARACTERISTIC KL_POFCGSP63 "Kennlinie Fuelldruckoffset" CURVE 0x25F17C kl_si16_S6_S3 12.75 UMR_BAR__1_1000_0_S6_S3 -6.4 6.35
 /begin AXIS_DESCR STD_AXIS zff_atsys._.iSignale._.obj.sig_c_getr UMR_GRADC__1_1_M40_S6_S3 10 -40 150 DEPOSIT ABSOLUTE MONOTONY MON_INCREASE /end AXIS_DESCR
/end CHARACTERISTIC
/begin CHARACTERISTIC KL_PORASYNSP63 "Rampe n.Syn.->l.Stuetzst. y PMAX" CURVE 0x25F1A8 kl_si16_S6_S3 12.75 UMR_BAR__1_1000_0_S6_S3 0 12.75
 /begin AXIS_DESCR STD_AXIS iSasZentr.iSchaltend.iKzu.timer_zkzu UMR_MSEC__10_1_0_S6_S3 3 0 2540 DEPOSIT ABSOLUTE MONOTONY MON_INCREASE /end AXIS_DESCR
/end CHARACTERISTIC
/begin CHARACTERISTIC T_RA2SSCHRSP63 "Zeit 2.Rampe bei Schrittschaltung" VALUE 0x26E9DE kw_ui8_S6_S3 2540 UMR_MSEC__10_1_0_S6_S3 0 2540 /end CHARACTERISTIC
/begin CHARACTERISTIC KL_POKZUNGABSP63 "Druckoffset in Abhaengigkeit von ng_ab" CURVE 0x25F1B8 kl_si16_S6_S3 12.75 UMR_BAR__1_1000_0_S6_S3 -6.4 6.35
 /begin AXIS_DESCR STD_AXIS iItfInput.ng_ab UMR_U_MINSEC_1_1_0_S6_S3 4 -5000 1000 DEPOSIT ABSOLUTE MONOTONY MON_INCREASE /end AXIS_DESCR
/end CHARACTERISTIC
/begin CHARACTERISTIC KL_PORAKZUSP63 "Schaltdruckoffset" CURVE 0x25F1CC kl_si16_S6_S3 12.75 UMR_BAR__1_1000_0_S6_S3 -6.4 6.35
 /begin AXIS_DESCR STD_AXIS iSasZentr.iSchaltend.iKzu.timer_zkzu UMR_MSEC__10_1_0_S6_S3 3 0 2540 DEPOSIT ABSOLUTE MONOTONY MON_INCREASE /end AXIS_DESCR
/end CHARACTERISTIC
/begin CHARACTERISTIC KL_PGOKZUSP63 "Druckgradient in Abhaengigkeit von m_t" CURVE 0x25F1DC kl_si16_S6_S3 200 UMR_BAR_SEC_1_10_0_S6_S3 -100 100
 /begin AXIS_DESCR STD_AXIS zff_atsys._.iSignale._.obj.sig_m_t UMR_NM__1_1_0_S6_S3 6 -400 1640 DEPOSIT ABSOLUTE MONOTONY MON_INCREASE /end AXIS_DESCR
/end CHARACTERISTIC
/begin CHARACTERISTIC KL_PGOKZUWSSP63 "Druckgradient in Abhaengigkeit von m_t" CURVE 0x25F1F8 kl_si16_S6_S3 200 UMR_BAR_SEC_1_10_0_S6_S3 -100 100
 /begin AXIS_DESCR STD_AXIS zff_atsys._.iSignale._.obj.sig_m_t UMR_NM__1_1_0_S6_S3 6 -400 1640 DEPOSIT ABSOLUTE MONOTONY MON_INCREASE /end AXIS_DESCR
/end CHARACTERISTIC
/begin CHARACTERISTIC KL_POMDTSYNSP63 "Druckoffset Schliessphase f(delta_m_t seit synchron)" CURVE 0x25F214 kl_si16_S6_S3 12 UMR_BAR__1_1000_0_S6_S3 -6 6
 /begin AXIS_DESCR STD_AXIS iSasZentr.md_tpgrasyn UMR_NM__1_1_0_S6_S3 4 -2000 2000 DEPOSIT ABSOLUTE MONOTONY MON_INCREASE /end AXIS_DESCR
/end CHARACTERISTIC
/begin CHARACTERISTIC KL_FPGRASYNSP63 "Faktor Schließrampengradient" CURVE 0x25F228 kl_si16_S6_S3 50 UMR___1_10_0_S6_S3 0 50
 /begin AXIS_DESCR STD_AXIS iItfInput.ng_ab UMR_U_MINSEC_1_1_0_S6_S3 4 -5000 1000 DEPOSIT ABSOLUTE MONOTONY MON_INCREASE /end AXIS_DESCR
/end CHARACTERISTIC
/begin CHARACTERISTIC KF_PKZUWSSP63 "Schaltdruckkennfeld (n_tkf, m_t)" MAP 0x25F23C kf_si16_S6_S3 12.75 UMR_BAR__1_1000_0_S6_S3 0 12.75
 /begin AXIS_DESCR STD_AXIS iSasZentr.iSchaltend.n_tkf UMR_U_MIN_32_1_0_S6_S3 8 0 8160 DEPOSIT ABSOLUTE MONOTONY MON_INCREASE /end AXIS_DESCR
 /begin AXIS_DESCR STD_AXIS zff_atsys._.iSignale._.obj.sig_m_t UMR_NM__1_1_0_S6_S3 8 -400 1640 DEPOSIT ABSOLUTE MONOTONY MON_INCREASE /end AXIS_DESCR
/end CHARACTERISTIC
/begin CHARACTERISTIC KL_TSYNCGRAKZUSP63 "Zeit vor sync. Ende Schaltdruck/Start 3. Rampe KZU" CURVE 0x25F2E4 kl_ui8_S6_S3 1280 UMR_MSEC__10_1_M128_S6_S3 -1280 0
 /begin AXIS_DESCR STD_AXIS zff_atsys._.iSignale._.obj.sig_c_getr UMR_GRADC__1_1_M40_S6_S3 4 -40 215 DEPOSIT ABSOLUTE MONOTONY MON_INCREASE /end AXIS_DESCR
/end CHARACTERISTIC
/begin CHARACTERISTIC KF_TSYNMTNTRAKZUWSSP63 "Zeit vor sync. Ende Schaltdruck/Start 3. Rampe KZU bei Weiterschaltung (n_tkf, m_t8)" MAP 0x25F2F0 kf_ui8_S6_S3 1280 UMR_MSEC__10_1_M128_S6_S3 -1280 0
 /begin AXIS_DESCR STD_AXIS zff_atsys._.iSignale._.obj.sig_m_t8 UMR_NM__8_1_M50_S6_S3 4 -400 1640 DEPOSIT ABSOLUTE MONOTONY MON_INCREASE /end AXIS_DESCR
 /begin AXIS_DESCR STD_AXIS iSasZentr.iSchaltend.n_tkf UMR_U_MIN_32_1_0_S6_S3 4 0 8160 DEPOSIT ABSOLUTE MONOTONY MON_INCREASE /end AXIS_DESCR
/end CHARACTERISTIC
/begin CHARACTERISTIC KL_POFMDMOTSOLLSP63 "Fuelldruckoffset f(Erhoehung Motorsollmoment)" CURVE 0x25F310 kl_si16_S6_S3 12.75 UMR_BAR__1_1000_0_S6_S3 -6.4 6.35
 /begin AXIS_DESCR STD_AXIS NO_INPUT_QUANTITY UMR_NM__1_1_0_S6_S3 6 -2000 2000 DEPOSIT ABSOLUTE MONOTONY MON_INCREASE /end AXIS_DESCR
/end CHARACTERISTIC
/begin CHARACTERISTIC KL_POKZUMDMOTSOLLSP63 "Schaltdruckoffset in Abhaengigkeit von md_motsoll_sas" CURVE 0x25F32C kl_si16_S6_S3 12.75 UMR_BAR__1_1000_0_S6_S3 -6.4 6.35
 /begin AXIS_DESCR STD_AXIS NO_INPUT_QUANTITY UMR_NM__1_1_0_S6_S3 6 -2000 2000 DEPOSIT ABSOLUTE MONOTONY MON_INCREASE /end AXIS_DESCR
/end CHARACTERISTIC
/begin CHARACTERISTIC KL_TSYNMTKZUSFVSP64 "Zeit vor sync. Start Schnellfuellung vorb. KZU" CURVE 0x25F348 kl_si16_S6_S3 5000 UMR_MSEC__10_1_0_S6_S3 -5000 0
 /begin AXIS_DESCR STD_AXIS zff_atsys._.iSignale._.obj.sig_m_t UMR_NM__1_1_0_S6_S3 4 -400 1640 DEPOSIT ABSOLUTE MONOTONY MON_INCREASE /end AXIS_DESCR
/end CHARACTERISTIC
/begin CHARACTERISTIC KL_TSYNMTTRAKZUVSP64 "Zeit vor sync. Ende Fuellausgleich vorb. KZU" CURVE 0x25F35C kl_ui8_S6_S3 1280 UMR_MSEC__10_1_M128_S6_S3 -1280 0
 /begin AXIS_DESCR STD_AXIS zff_atsys._.iSignale._.obj.sig_m_t8 UMR_NM__8_1_M50_S6_S3 4 -400 1640 DEPOSIT ABSOLUTE MONOTONY MON_INCREASE /end AXIS_DESCR
/end CHARACTERISTIC
/begin CHARACTERISTIC T_SYNSP64 "Zeit n_t innerhalb Synchronschwelle bis Start Rampe 4" VALUE 0x26E9DF kw_ui8_S6_S3 2540 UMR_MSEC__10_1_0_S6_S3 0 2540 /end CHARACTERISTIC
/begin CHARACTERISTIC T_VKZUSP64 "Verzoegerungszeit Start SF zuschaltende Kupplung" VALUE 0x26E9E0 kw_ui8_S6_S3 2540 UMR_MSEC__10_1_0_S6_S3 0 2540 /end CHARACTERISTIC
/begin CHARACTERISTIC TO_VKZUSLSTSP64 "Zeitoffset auf Verzögerung Schnellfüllung bei Schleppstart" VALUE 0x26E9E1 kw_ui8_S6_S3 90 UMR_MSEC__10_1_0_S6_S3 10 100 /end CHARACTERISTIC
/begin CHARACTERISTIC T_MIN_IG_CHANGESP64 "Mindestzeit fuer Ausgabe von Momentenuebergang" VALUE 0x26E9E2 kw_ui8_S6_S3 2540 UMR_MSEC__10_1_0_S6_S3 0 2540 /end CHARACTERISTIC
/begin CHARACTERISTIC KF_T_DT_IG_CHANGESP64 "Kennfeld Zeitvorhalt für Übergabe Rampenzeit auf Schaltdruck" MAP 0x25F368 kf_si16_S6_S3 5080 UMR_MSEC__10_1_0_S6_S3 -2540 2540
 /begin AXIS_DESCR STD_AXIS zff_atsys._.iSignale._.obj.sig_n_t UMR_U_MIN_1_1_0_S6_S3 4 0 8160 DEPOSIT ABSOLUTE MONOTONY MON_INCREASE /end AXIS_DESCR
 /begin AXIS_DESCR STD_AXIS zff_atsys._.iSignale._.obj.sig_m_t UMR_NM__1_1_0_S6_S3 4 -400 1640 DEPOSIT ABSOLUTE MONOTONY MON_INCREASE /end AXIS_DESCR
/end CHARACTERISTIC
/begin CHARACTERISTIC KF_T2_DT_IG_CHANGESP64 "Kennfeld Zeitvorhalt für Übergabe Rampenzeit auf Schaltdruck" MAP 0x25F3A0 kf_si16_S6_S3 5080 UMR_MSEC__10_1_0_S6_S3 -2540 2540
 /begin AXIS_DESCR STD_AXIS zff_atsys._.iSignale._.obj.sig_n_t UMR_U_MIN_1_1_0_S6_S3 4 0 8160 DEPOSIT ABSOLUTE MONOTONY MON_INCREASE /end AXIS_DESCR
 /begin AXIS_DESCR STD_AXIS zff_atsys._.iSignale._.obj.sig_m_t UMR_NM__1_1_0_S6_S3 4 -400 1640 DEPOSIT ABSOLUTE MONOTONY MON_INCREASE /end AXIS_DESCR
/end CHARACTERISTIC
/begin CHARACTERISTIC KL_POKZUCGSP64 "Schaltdruckoffset" CURVE 0x25F3D8 kl_si16_S6_S3 12.75 UMR_BAR__1_1000_0_S6_S3 -6.4 6.35
 /begin AXIS_DESCR STD_AXIS zff_atsys._.iSignale._.obj.sig_c_getr UMR_GRADC__1_1_M40_S6_S3 10 -40 150 DEPOSIT ABSOLUTE MONOTONY MON_INCREASE /end AXIS_DESCR
/end CHARACTERISTIC
/begin CHARACTERISTIC KL_POFCGSP64 "Kennlinie Fuelldruckoffset" CURVE 0x25F404 kl_si16_S6_S3 12.75 UMR_BAR__1_1000_0_S6_S3 -6.4 6.35
 /begin AXIS_DESCR STD_AXIS zff_atsys._.iSignale._.obj.sig_c_getr UMR_GRADC__1_1_M40_S6_S3 10 -40 150 DEPOSIT ABSOLUTE MONOTONY MON_INCREASE /end AXIS_DESCR
/end CHARACTERISTIC
/begin CHARACTERISTIC KL_PORASYNSP64 "Rampe n.Syn.->l.Stuetzst. y PMAX" CURVE 0x25F430 kl_si16_S6_S3 12.75 UMR_BAR__1_1000_0_S6_S3 0 12.75
 /begin AXIS_DESCR STD_AXIS iSasZentr.iSchaltend.iKzu.timer_zkzu UMR_MSEC__10_1_0_S6_S3 3 0 2540 DEPOSIT ABSOLUTE MONOTONY MON_INCREASE /end AXIS_DESCR
/end CHARACTERISTIC
/begin CHARACTERISTIC T_RA2SSCHRSP64 "Zeit 2.Rampe bei Schrittschaltung" VALUE 0x26E9E3 kw_ui8_S6_S3 2540 UMR_MSEC__10_1_0_S6_S3 0 2540 /end CHARACTERISTIC
/begin CHARACTERISTIC KL_POKZUNGABSP64 "Druckoffset in Abhaengigkeit von ng_ab" CURVE 0x25F440 kl_si16_S6_S3 12.75 UMR_BAR__1_1000_0_S6_S3 -6.4 6.35
 /begin AXIS_DESCR STD_AXIS iItfInput.ng_ab UMR_U_MINSEC_1_1_0_S6_S3 4 -5000 1000 DEPOSIT ABSOLUTE MONOTONY MON_INCREASE /end AXIS_DESCR
/end CHARACTERISTIC
/begin CHARACTERISTIC KL_PORAKZUSP64 "Schaltdruckoffset" CURVE 0x25F454 kl_si16_S6_S3 12.75 UMR_BAR__1_1000_0_S6_S3 -6.4 6.35
 /begin AXIS_DESCR STD_AXIS iSasZentr.iSchaltend.iKzu.timer_zkzu UMR_MSEC__10_1_0_S6_S3 3 0 2540 DEPOSIT ABSOLUTE MONOTONY MON_INCREASE /end AXIS_DESCR
/end CHARACTERISTIC
/begin CHARACTERISTIC KL_PGOKZUSP64 "Druckgradient in Abhaengigkeit von m_t" CURVE 0x25F464 kl_si16_S6_S3 200 UMR_BAR_SEC_1_10_0_S6_S3 -100 100
 /begin AXIS_DESCR STD_AXIS zff_atsys._.iSignale._.obj.sig_m_t UMR_NM__1_1_0_S6_S3 6 -400 1640 DEPOSIT ABSOLUTE MONOTONY MON_INCREASE /end AXIS_DESCR
/end CHARACTERISTIC
/begin CHARACTERISTIC KL_PGOKZUWSSP64 "Druckgradient in Abhaengigkeit von m_t" CURVE 0x25F480 kl_si16_S6_S3 200 UMR_BAR_SEC_1_10_0_S6_S3 -100 100
 /begin AXIS_DESCR STD_AXIS zff_atsys._.iSignale._.obj.sig_m_t UMR_NM__1_1_0_S6_S3 6 -400 1640 DEPOSIT ABSOLUTE MONOTONY MON_INCREASE /end AXIS_DESCR
/end CHARACTERISTIC
/begin CHARACTERISTIC KL_POMDTSYNSP64 "Druckoffset Schliessphase f(delta_m_t seit synchron)" CURVE 0x25F49C kl_si16_S6_S3 12 UMR_BAR__1_1000_0_S6_S3 -6 6
 /begin AXIS_DESCR STD_AXIS iSasZentr.md_tpgrasyn UMR_NM__1_1_0_S6_S3 4 -2000 2000 DEPOSIT ABSOLUTE MONOTONY MON_INCREASE /end AXIS_DESCR
/end CHARACTERISTIC
/begin CHARACTERISTIC KL_FPGRASYNSP64 "Faktor Schließrampengradient" CURVE 0x25F4B0 kl_si16_S6_S3 50 UMR___1_10_0_S6_S3 0 50
 /begin AXIS_DESCR STD_AXIS iItfInput.ng_ab UMR_U_MINSEC_1_1_0_S6_S3 4 -5000 1000 DEPOSIT ABSOLUTE MONOTONY MON_INCREASE /end AXIS_DESCR
/end CHARACTERISTIC
/begin CHARACTERISTIC KF_PKZUWSSP64 "Schaltdruckkennfeld (n_tkf, m_t)" MAP 0x25F4C4 kf_si16_S6_S3 12.75 UMR_BAR__1_1000_0_S6_S3 0 12.75
 /begin AXIS_DESCR STD_AXIS iSasZentr.iSchaltend.n_tkf UMR_U_MIN_32_1_0_S6_S3 8 0 8160 DEPOSIT ABSOLUTE MONOTONY MON_INCREASE /end AXIS_DESCR
 /begin AXIS_DESCR STD_AXIS zff_atsys._.iSignale._.obj.sig_m_t UMR_NM__1_1_0_S6_S3 8 -400 1640 DEPOSIT ABSOLUTE MONOTONY MON_INCREASE /end AXIS_DESCR
/end CHARACTERISTIC
/begin CHARACTERISTIC KL_TSYNCGRAKZUSP64 "Zeit vor sync. Ende Schaltdruck/Start 3. Rampe KZU" CURVE 0x25F56C kl_ui8_S6_S3 1280 UMR_MSEC__10_1_M128_S6_S3 -1280 0
 /begin AXIS_DESCR STD_AXIS zff_atsys._.iSignale._.obj.sig_c_getr UMR_GRADC__1_1_M40_S6_S3 4 -40 215 DEPOSIT ABSOLUTE MONOTONY MON_INCREASE /end AXIS_DESCR
/end CHARACTERISTIC
/begin CHARACTERISTIC KF_TSYNMTNTRAKZUWSSP64 "Zeit vor sync. Ende Schaltdruck/Start 3. Rampe KZU bei Weiterschaltung (n_tkf, m_t8)" MAP 0x25F578 kf_ui8_S6_S3 1280 UMR_MSEC__10_1_M128_S6_S3 -1280 0
 /begin AXIS_DESCR STD_AXIS zff_atsys._.iSignale._.obj.sig_m_t8 UMR_NM__8_1_M50_S6_S3 4 -400 1640 DEPOSIT ABSOLUTE MONOTONY MON_INCREASE /end AXIS_DESCR
 /begin AXIS_DESCR STD_AXIS iSasZentr.iSchaltend.n_tkf UMR_U_MIN_32_1_0_S6_S3 4 0 8160 DEPOSIT ABSOLUTE MONOTONY MON_INCREASE /end AXIS_DESCR
/end CHARACTERISTIC
/begin CHARACTERISTIC KL_POFMDMOTSOLLSP64 "Fuelldruckoffset f(Erhoehung Motorsollmoment)" CURVE 0x25F598 kl_si16_S6_S3 12.75 UMR_BAR__1_1000_0_S6_S3 -6.4 6.35
 /begin AXIS_DESCR STD_AXIS NO_INPUT_QUANTITY UMR_NM__1_1_0_S6_S3 6 -2000 2000 DEPOSIT ABSOLUTE MONOTONY MON_INCREASE /end AXIS_DESCR
/end CHARACTERISTIC
/begin CHARACTERISTIC KL_POKZUMDMOTSOLLSP64 "Schaltdruckoffset in Abhaengigkeit von md_motsoll_sas" CURVE 0x25F5B4 kl_si16_S6_S3 12.75 UMR_BAR__1_1000_0_S6_S3 -6.4 6.35
 /begin AXIS_DESCR STD_AXIS NO_INPUT_QUANTITY UMR_NM__1_1_0_S6_S3 6 -2000 2000 DEPOSIT ABSOLUTE MONOTONY MON_INCREASE /end AXIS_DESCR
/end CHARACTERISTIC
/begin CHARACTERISTIC KL_TSYNMTKZUSFVSP71 "Zeit vor sync. Start Schnellfuellung vorb. KZU" CURVE 0x25F5D0 kl_si16_S6_S3 5000 UMR_MSEC__10_1_0_S6_S3 -5000 0
 /begin AXIS_DESCR STD_AXIS zff_atsys._.iSignale._.obj.sig_m_t UMR_NM__1_1_0_S6_S3 4 -400 1640 DEPOSIT ABSOLUTE MONOTONY MON_INCREASE /end AXIS_DESCR
/end CHARACTERISTIC
/begin CHARACTERISTIC KL_TSYNMTTRAKZUVSP71 "Zeit vor sync. Ende Fuellausgleich vorb. KZU" CURVE 0x25F5E4 kl_ui8_S6_S3 1280 UMR_MSEC__10_1_M128_S6_S3 -1280 0
 /begin AXIS_DESCR STD_AXIS zff_atsys._.iSignale._.obj.sig_m_t8 UMR_NM__8_1_M50_S6_S3 4 -400 1640 DEPOSIT ABSOLUTE MONOTONY MON_INCREASE /end AXIS_DESCR
/end CHARACTERISTIC
/begin CHARACTERISTIC T_SYNSP71 "Zeit n_t innerhalb Synchronschwelle bis Start Rampe 4" VALUE 0x26E9E4 kw_ui8_S6_S3 2540 UMR_MSEC__10_1_0_S6_S3 0 2540 /end CHARACTERISTIC
/begin CHARACTERISTIC T_VKZUSP71 "Verzoegerungszeit Start SF zuschaltende Kupplung" VALUE 0x26E9E5 kw_ui8_S6_S3 2540 UMR_MSEC__10_1_0_S6_S3 0 2540 /end CHARACTERISTIC
/begin CHARACTERISTIC TO_VKZUSLSTSP71 "Zeitoffset auf Verzögerung Schnellfüllung bei Schleppstart" VALUE 0x26E9E6 kw_ui8_S6_S3 90 UMR_MSEC__10_1_0_S6_S3 10 100 /end CHARACTERISTIC
/begin CHARACTERISTIC T_MIN_IG_CHANGESP71 "Mindestzeit fuer Ausgabe von Momentenuebergang" VALUE 0x26E9E7 kw_ui8_S6_S3 2540 UMR_MSEC__10_1_0_S6_S3 0 2540 /end CHARACTERISTIC
/begin CHARACTERISTIC KF_T_DT_IG_CHANGESP71 "Kennfeld Zeitvorhalt für Übergabe Rampenzeit auf Schaltdruck" MAP 0x25F5F0 kf_si16_S6_S3 5080 UMR_MSEC__10_1_0_S6_S3 -2540 2540
 /begin AXIS_DESCR STD_AXIS zff_atsys._.iSignale._.obj.sig_n_t UMR_U_MIN_1_1_0_S6_S3 4 0 8160 DEPOSIT ABSOLUTE MONOTONY MON_INCREASE /end AXIS_DESCR
 /begin AXIS_DESCR STD_AXIS zff_atsys._.iSignale._.obj.sig_m_t UMR_NM__1_1_0_S6_S3 4 -400 1640 DEPOSIT ABSOLUTE MONOTONY MON_INCREASE /end AXIS_DESCR
/end CHARACTERISTIC
/begin CHARACTERISTIC KF_T2_DT_IG_CHANGESP71 "Kennfeld Zeitvorhalt für Übergabe Rampenzeit auf Schaltdruck" MAP 0x25F628 kf_si16_S6_S3 5080 UMR_MSEC__10_1_0_S6_S3 -2540 2540
 /begin AXIS_DESCR STD_AXIS zff_atsys._.iSignale._.obj.sig_n_t UMR_U_MIN_1_1_0_S6_S3 4 0 8160 DEPOSIT ABSOLUTE MONOTONY MON_INCREASE /end AXIS_DESCR
 /begin AXIS_DESCR STD_AXIS zff_atsys._.iSignale._.obj.sig_m_t UMR_NM__1_1_0_S6_S3 4 -400 1640 DEPOSIT ABSOLUTE MONOTONY MON_INCREASE /end AXIS_DESCR
/end CHARACTERISTIC
/begin CHARACTERISTIC KL_POKZUCGSP71 "Schaltdruckoffset" CURVE 0x25F660 kl_si16_S6_S3 12.75 UMR_BAR__1_1000_0_S6_S3 -6.4 6.35
 /begin AXIS_DESCR STD_AXIS zff_atsys._.iSignale._.obj.sig_c_getr UMR_GRADC__1_1_M40_S6_S3 10 -40 150 DEPOSIT ABSOLUTE MONOTONY MON_INCREASE /end AXIS_DESCR
/end CHARACTERISTIC
/begin CHARACTERISTIC KL_POFCGSP71 "Kennlinie Fuelldruckoffset" CURVE 0x25F68C kl_si16_S6_S3 12.75 UMR_BAR__1_1000_0_S6_S3 -6.4 6.35
 /begin AXIS_DESCR STD_AXIS zff_atsys._.iSignale._.obj.sig_c_getr UMR_GRADC__1_1_M40_S6_S3 10 -40 150 DEPOSIT ABSOLUTE MONOTONY MON_INCREASE /end AXIS_DESCR
/end CHARACTERISTIC
/begin CHARACTERISTIC KL_PORASYNSP71 "Rampe n.Syn.->l.Stuetzst. y PMAX" CURVE 0x25F6B8 kl_si16_S6_S3 12.75 UMR_BAR__1_1000_0_S6_S3 0 12.75
 /begin AXIS_DESCR STD_AXIS iSasZentr.iSchaltend.iKzu.timer_zkzu UMR_MSEC__10_1_0_S6_S3 3 0 2540 DEPOSIT ABSOLUTE MONOTONY MON_INCREASE /end AXIS_DESCR
/end CHARACTERISTIC
/begin CHARACTERISTIC T_RA2SSCHRSP71 "Zeit 2.Rampe bei Schrittschaltung" VALUE 0x26E9E8 kw_ui8_S6_S3 2540 UMR_MSEC__10_1_0_S6_S3 0 2540 /end CHARACTERISTIC
/begin CHARACTERISTIC KL_POKZUNGABSP71 "Druckoffset in Abhaengigkeit von ng_ab" CURVE 0x25F6C8 kl_si16_S6_S3 12.75 UMR_BAR__1_1000_0_S6_S3 -6.4 6.35
 /begin AXIS_DESCR STD_AXIS iItfInput.ng_ab UMR_U_MINSEC_1_1_0_S6_S3 4 -5000 1000 DEPOSIT ABSOLUTE MONOTONY MON_INCREASE /end AXIS_DESCR
/end CHARACTERISTIC
/begin CHARACTERISTIC KL_PORAKZUSP71 "Schaltdruckoffset" CURVE 0x25F6DC kl_si16_S6_S3 12.75 UMR_BAR__1_1000_0_S6_S3 -6.4 6.35
 /begin AXIS_DESCR STD_AXIS iSasZentr.iSchaltend.iKzu.timer_zkzu UMR_MSEC__10_1_0_S6_S3 3 0 2540 DEPOSIT ABSOLUTE MONOTONY MON_INCREASE /end AXIS_DESCR
/end CHARACTERISTIC
/begin CHARACTERISTIC KL_PGOKZUSP71 "Druckgradient in Abhaengigkeit von m_t" CURVE 0x25F6EC kl_si16_S6_S3 200 UMR_BAR_SEC_1_10_0_S6_S3 -100 100
 /begin AXIS_DESCR STD_AXIS zff_atsys._.iSignale._.obj.sig_m_t UMR_NM__1_1_0_S6_S3 6 -400 1640 DEPOSIT ABSOLUTE MONOTONY MON_INCREASE /end AXIS_DESCR
/end CHARACTERISTIC
/begin CHARACTERISTIC KL_PGOKZUWSSP71 "Druckgradient in Abhaengigkeit von m_t" CURVE 0x25F708 kl_si16_S6_S3 200 UMR_BAR_SEC_1_10_0_S6_S3 -100 100
 /begin AXIS_DESCR STD_AXIS zff_atsys._.iSignale._.obj.sig_m_t UMR_NM__1_1_0_S6_S3 6 -400 1640 DEPOSIT ABSOLUTE MONOTONY MON_INCREASE /end AXIS_DESCR
/end CHARACTERISTIC
/begin CHARACTERISTIC KL_POMDTSYNSP71 "Druckoffset Schliessphase f(delta_m_t seit synchron)" CURVE 0x25F724 kl_si16_S6_S3 12 UMR_BAR__1_1000_0_S6_S3 -6 6
 /begin AXIS_DESCR STD_AXIS iSasZentr.md_tpgrasyn UMR_NM__1_1_0_S6_S3 4 -2000 2000 DEPOSIT ABSOLUTE MONOTONY MON_INCREASE /end AXIS_DESCR
/end CHARACTERISTIC
/begin CHARACTERISTIC KL_FPGRASYNSP71 "Faktor Schließrampengradient" CURVE 0x25F738 kl_si16_S6_S3 50 UMR___1_10_0_S6_S3 0 50
 /begin AXIS_DESCR STD_AXIS iItfInput.ng_ab UMR_U_MINSEC_1_1_0_S6_S3 4 -5000 1000 DEPOSIT ABSOLUTE MONOTONY MON_INCREASE /end AXIS_DESCR
/end CHARACTERISTIC
/begin CHARACTERISTIC KF_PKZUWSSP71 "Schaltdruckkennfeld (n_tkf, m_t)" MAP 0x25F74C kf_si16_S6_S3 12.75 UMR_BAR__1_1000_0_S6_S3 0 12.75
 /begin AXIS_DESCR STD_AXIS iSasZentr.iSchaltend.n_tkf UMR_U_MIN_32_1_0_S6_S3 8 0 8160 DEPOSIT ABSOLUTE MONOTONY MON_INCREASE /end AXIS_DESCR
 /begin AXIS_DESCR STD_AXIS zff_atsys._.iSignale._.obj.sig_m_t UMR_NM__1_1_0_S6_S3 8 -400 1640 DEPOSIT ABSOLUTE MONOTONY MON_INCREASE /end AXIS_DESCR
/end CHARACTERISTIC
/begin CHARACTERISTIC KL_TSYNCGRAKZUSP71 "Zeit vor sync. Ende Schaltdruck/Start 3. Rampe KZU" CURVE 0x25F7F4 kl_ui8_S6_S3 1280 UMR_MSEC__10_1_M128_S6_S3 -1280 0
 /begin AXIS_DESCR STD_AXIS zff_atsys._.iSignale._.obj.sig_c_getr UMR_GRADC__1_1_M40_S6_S3 4 -40 215 DEPOSIT ABSOLUTE MONOTONY MON_INCREASE /end AXIS_DESCR
/end CHARACTERISTIC
/begin CHARACTERISTIC KF_TSYNMTNTRAKZUWSSP71 "Zeit vor sync. Ende Schaltdruck/Start 3. Rampe KZU bei Weiterschaltung (n_tkf, m_t8)" MAP 0x25F800 kf_ui8_S6_S3 1280 UMR_MSEC__10_1_M128_S6_S3 -1280 0
 /begin AXIS_DESCR STD_AXIS zff_atsys._.iSignale._.obj.sig_m_t8 UMR_NM__8_1_M50_S6_S3 4 -400 1640 DEPOSIT ABSOLUTE MONOTONY MON_INCREASE /end AXIS_DESCR
 /begin AXIS_DESCR STD_AXIS iSasZentr.iSchaltend.n_tkf UMR_U_MIN_32_1_0_S6_S3 4 0 8160 DEPOSIT ABSOLUTE MONOTONY MON_INCREASE /end AXIS_DESCR
/end CHARACTERISTIC
/begin CHARACTERISTIC KL_POFMDMOTSOLLSP71 "Fuelldruckoffset f(Erhoehung Motorsollmoment)" CURVE 0x25F820 kl_si16_S6_S3 12.75 UMR_BAR__1_1000_0_S6_S3 -6.4 6.35
 /begin AXIS_DESCR STD_AXIS NO_INPUT_QUANTITY UMR_NM__1_1_0_S6_S3 6 -2000 2000 DEPOSIT ABSOLUTE MONOTONY MON_INCREASE /end AXIS_DESCR
/end CHARACTERISTIC
/begin CHARACTERISTIC KL_POKZUMDMOTSOLLSP71 "Schaltdruckoffset in Abhaengigkeit von md_motsoll_sas" CURVE 0x25F83C kl_si16_S6_S3 12.75 UMR_BAR__1_1000_0_S6_S3 -6.4 6.35
 /begin AXIS_DESCR STD_AXIS NO_INPUT_QUANTITY UMR_NM__1_1_0_S6_S3 6 -2000 2000 DEPOSIT ABSOLUTE MONOTONY MON_INCREASE /end AXIS_DESCR
/end CHARACTERISTIC
/begin CHARACTERISTIC KL_TSYNMTKZUSFVSP75 "Zeit vor sync. Start Schnellfuellung vorb. KZU" CURVE 0x25F858 kl_si16_S6_S3 5000 UMR_MSEC__10_1_0_S6_S3 -5000 0
 /begin AXIS_DESCR STD_AXIS zff_atsys._.iSignale._.obj.sig_m_t UMR_NM__1_1_0_S6_S3 4 -400 1640 DEPOSIT ABSOLUTE MONOTONY MON_INCREASE /end AXIS_DESCR
/end CHARACTERISTIC
/begin CHARACTERISTIC KL_TSYNMTTRAKZUVSP75 "Zeit vor sync. Ende Fuellausgleich vorb. KZU" CURVE 0x25F86C kl_ui8_S6_S3 1280 UMR_MSEC__10_1_M128_S6_S3 -1280 0
 /begin AXIS_DESCR STD_AXIS zff_atsys._.iSignale._.obj.sig_m_t8 UMR_NM__8_1_M50_S6_S3 4 -400 1640 DEPOSIT ABSOLUTE MONOTONY MON_INCREASE /end AXIS_DESCR
/end CHARACTERISTIC
/begin CHARACTERISTIC T_SYNSP75 "Zeit n_t innerhalb Synchronschwelle bis Start Rampe 4" VALUE 0x26E9E9 kw_ui8_S6_S3 2540 UMR_MSEC__10_1_0_S6_S3 0 2540 /end CHARACTERISTIC
/begin CHARACTERISTIC T_VKZUSP75 "Verzoegerungszeit Start SF zuschaltende Kupplung" VALUE 0x26E9EA kw_ui8_S6_S3 2540 UMR_MSEC__10_1_0_S6_S3 0 2540 /end CHARACTERISTIC
/begin CHARACTERISTIC TO_VKZUSLSTSP75 "Zeitoffset auf Verzögerung Schnellfüllung bei Schleppstart" VALUE 0x26E9EB kw_ui8_S6_S3 90 UMR_MSEC__10_1_0_S6_S3 10 100 /end CHARACTERISTIC
/begin CHARACTERISTIC T_MIN_IG_CHANGESP75 "Mindestzeit fuer Ausgabe von Momentenuebergang" VALUE 0x26E9EC kw_ui8_S6_S3 2540 UMR_MSEC__10_1_0_S6_S3 0 2540 /end CHARACTERISTIC
/begin CHARACTERISTIC KF_T_DT_IG_CHANGESP75 "Kennfeld Zeitvorhalt für Übergabe Rampenzeit auf Schaltdruck" MAP 0x25F878 kf_si16_S6_S3 5080 UMR_MSEC__10_1_0_S6_S3 -2540 2540
 /begin AXIS_DESCR STD_AXIS zff_atsys._.iSignale._.obj.sig_n_t UMR_U_MIN_1_1_0_S6_S3 4 0 8160 DEPOSIT ABSOLUTE MONOTONY MON_INCREASE /end AXIS_DESCR
 /begin AXIS_DESCR STD_AXIS zff_atsys._.iSignale._.obj.sig_m_t UMR_NM__1_1_0_S6_S3 4 -400 1640 DEPOSIT ABSOLUTE MONOTONY MON_INCREASE /end AXIS_DESCR
/end CHARACTERISTIC
/begin CHARACTERISTIC KF_T2_DT_IG_CHANGESP75 "Kennfeld Zeitvorhalt für Übergabe Rampenzeit auf Schaltdruck" MAP 0x25F8B0 kf_si16_S6_S3 5080 UMR_MSEC__10_1_0_S6_S3 -2540 2540
 /begin AXIS_DESCR STD_AXIS zff_atsys._.iSignale._.obj.sig_n_t UMR_U_MIN_1_1_0_S6_S3 4 0 8160 DEPOSIT ABSOLUTE MONOTONY MON_INCREASE /end AXIS_DESCR
 /begin AXIS_DESCR STD_AXIS zff_atsys._.iSignale._.obj.sig_m_t UMR_NM__1_1_0_S6_S3 4 -400 1640 DEPOSIT ABSOLUTE MONOTONY MON_INCREASE /end AXIS_DESCR
/end CHARACTERISTIC
/begin CHARACTERISTIC KL_POKZUCGSP75 "Schaltdruckoffset" CURVE 0x25F8E8 kl_si16_S6_S3 12.75 UMR_BAR__1_1000_0_S6_S3 -6.4 6.35
 /begin AXIS_DESCR STD_AXIS zff_atsys._.iSignale._.obj.sig_c_getr UMR_GRADC__1_1_M40_S6_S3 10 -40 150 DEPOSIT ABSOLUTE MONOTONY MON_INCREASE /end AXIS_DESCR
/end CHARACTERISTIC
/begin CHARACTERISTIC KL_POFCGSP75 "Kennlinie Fuelldruckoffset" CURVE 0x25F914 kl_si16_S6_S3 12.75 UMR_BAR__1_1000_0_S6_S3 -6.4 6.35
 /begin AXIS_DESCR STD_AXIS zff_atsys._.iSignale._.obj.sig_c_getr UMR_GRADC__1_1_M40_S6_S3 10 -40 150 DEPOSIT ABSOLUTE MONOTONY MON_INCREASE /end AXIS_DESCR
/end CHARACTERISTIC
/begin CHARACTERISTIC KL_PORASYNSP75 "Rampe n.Syn.->l.Stuetzst. y PMAX" CURVE 0x25F940 kl_si16_S6_S3 12.75 UMR_BAR__1_1000_0_S6_S3 0 12.75
 /begin AXIS_DESCR STD_AXIS iSasZentr.iSchaltend.iKzu.timer_zkzu UMR_MSEC__10_1_0_S6_S3 3 0 2540 DEPOSIT ABSOLUTE MONOTONY MON_INCREASE /end AXIS_DESCR
/end CHARACTERISTIC
/begin CHARACTERISTIC T_RA2SSCHRSP75 "Zeit 2.Rampe bei Schrittschaltung" VALUE 0x26E9ED kw_ui8_S6_S3 2540 UMR_MSEC__10_1_0_S6_S3 0 2540 /end CHARACTERISTIC
/begin CHARACTERISTIC KL_POKZUNGABSP75 "Druckoffset in Abhaengigkeit von ng_ab" CURVE 0x25F950 kl_si16_S6_S3 12.75 UMR_BAR__1_1000_0_S6_S3 -6.4 6.35
 /begin AXIS_DESCR STD_AXIS iItfInput.ng_ab UMR_U_MINSEC_1_1_0_S6_S3 4 -5000 1000 DEPOSIT ABSOLUTE MONOTONY MON_INCREASE /end AXIS_DESCR
/end CHARACTERISTIC
/begin CHARACTERISTIC KL_PORAKZUSP75 "Schaltdruckoffset" CURVE 0x25F964 kl_si16_S6_S3 12.75 UMR_BAR__1_1000_0_S6_S3 -6.4 6.35
 /begin AXIS_DESCR STD_AXIS iSasZentr.iSchaltend.iKzu.timer_zkzu UMR_MSEC__10_1_0_S6_S3 3 0 2540 DEPOSIT ABSOLUTE MONOTONY MON_INCREASE /end AXIS_DESCR
/end CHARACTERISTIC
/begin CHARACTERISTIC KL_PGOKZUSP75 "Druckgradient in Abhaengigkeit von m_t" CURVE 0x25F974 kl_si16_S6_S3 200 UMR_BAR_SEC_1_10_0_S6_S3 -100 100
 /begin AXIS_DESCR STD_AXIS zff_atsys._.iSignale._.obj.sig_m_t UMR_NM__1_1_0_S6_S3 6 -400 1640 DEPOSIT ABSOLUTE MONOTONY MON_INCREASE /end AXIS_DESCR
/end CHARACTERISTIC
/begin CHARACTERISTIC KL_PGOKZUWSSP75 "Druckgradient in Abhaengigkeit von m_t" CURVE 0x25F990 kl_si16_S6_S3 200 UMR_BAR_SEC_1_10_0_S6_S3 -100 100
 /begin AXIS_DESCR STD_AXIS zff_atsys._.iSignale._.obj.sig_m_t UMR_NM__1_1_0_S6_S3 6 -400 1640 DEPOSIT ABSOLUTE MONOTONY MON_INCREASE /end AXIS_DESCR
/end CHARACTERISTIC
/begin CHARACTERISTIC KL_POMDTSYNSP75 "Druckoffset Schliessphase f(delta_m_t seit synchron)" CURVE 0x25F9AC kl_si16_S6_S3 12 UMR_BAR__1_1000_0_S6_S3 -6 6
 /begin AXIS_DESCR STD_AXIS iSasZentr.md_tpgrasyn UMR_NM__1_1_0_S6_S3 4 -2000 2000 DEPOSIT ABSOLUTE MONOTONY MON_INCREASE /end AXIS_DESCR
/end CHARACTERISTIC
/begin CHARACTERISTIC KL_FPGRASYNSP75 "Faktor Schließrampengradient" CURVE 0x25F9C0 kl_si16_S6_S3 50 UMR___1_10_0_S6_S3 0 50
 /begin AXIS_DESCR STD_AXIS iItfInput.ng_ab UMR_U_MINSEC_1_1_0_S6_S3 4 -5000 1000 DEPOSIT ABSOLUTE MONOTONY MON_INCREASE /end AXIS_DESCR
/end CHARACTERISTIC
/begin CHARACTERISTIC KF_PKZUWSSP75 "Schaltdruckkennfeld (n_tkf, m_t)" MAP 0x25F9D4 kf_si16_S6_S3 12.75 UMR_BAR__1_1000_0_S6_S3 0 12.75
 /begin AXIS_DESCR STD_AXIS iSasZentr.iSchaltend.n_tkf UMR_U_MIN_32_1_0_S6_S3 8 0 8160 DEPOSIT ABSOLUTE MONOTONY MON_INCREASE /end AXIS_DESCR
 /begin AXIS_DESCR STD_AXIS zff_atsys._.iSignale._.obj.sig_m_t UMR_NM__1_1_0_S6_S3 8 -400 1640 DEPOSIT ABSOLUTE MONOTONY MON_INCREASE /end AXIS_DESCR
/end CHARACTERISTIC
/begin CHARACTERISTIC KL_TSYNCGRAKZUSP75 "Zeit vor sync. Ende Schaltdruck/Start 3. Rampe KZU" CURVE 0x25FA7C kl_ui8_S6_S3 1280 UMR_MSEC__10_1_M128_S6_S3 -1280 0
 /begin AXIS_DESCR STD_AXIS zff_atsys._.iSignale._.obj.sig_c_getr UMR_GRADC__1_1_M40_S6_S3 4 -40 215 DEPOSIT ABSOLUTE MONOTONY MON_INCREASE /end AXIS_DESCR
/end CHARACTERISTIC
/begin CHARACTERISTIC KF_TSYNMTNTRAKZUWSSP75 "Zeit vor sync. Ende Schaltdruck/Start 3. Rampe KZU bei Weiterschaltung (n_tkf, m_t8)" MAP 0x25FA88 kf_ui8_S6_S3 1280 UMR_MSEC__10_1_M128_S6_S3 -1280 0
 /begin AXIS_DESCR STD_AXIS zff_atsys._.iSignale._.obj.sig_m_t8 UMR_NM__8_1_M50_S6_S3 4 -400 1640 DEPOSIT ABSOLUTE MONOTONY MON_INCREASE /end AXIS_DESCR
 /begin AXIS_DESCR STD_AXIS iSasZentr.iSchaltend.n_tkf UMR_U_MIN_32_1_0_S6_S3 4 0 8160 DEPOSIT ABSOLUTE MONOTONY MON_INCREASE /end AXIS_DESCR
/end CHARACTERISTIC
/begin CHARACTERISTIC KL_POFMDMOTSOLLSP75 "Fuelldruckoffset f(Erhoehung Motorsollmoment)" CURVE 0x25FAA8 kl_si16_S6_S3 12.75 UMR_BAR__1_1000_0_S6_S3 -6.4 6.35
 /begin AXIS_DESCR STD_AXIS NO_INPUT_QUANTITY UMR_NM__1_1_0_S6_S3 6 -2000 2000 DEPOSIT ABSOLUTE MONOTONY MON_INCREASE /end AXIS_DESCR
/end CHARACTERISTIC
/begin CHARACTERISTIC KL_POKZUMDMOTSOLLSP75 "Schaltdruckoffset in Abhaengigkeit von md_motsoll_sas" CURVE 0x25FAC4 kl_si16_S6_S3 12.75 UMR_BAR__1_1000_0_S6_S3 -6.4 6.35
 /begin AXIS_DESCR STD_AXIS NO_INPUT_QUANTITY UMR_NM__1_1_0_S6_S3 6 -2000 2000 DEPOSIT ABSOLUTE MONOTONY MON_INCREASE /end AXIS_DESCR
/end CHARACTERISTIC
/begin CHARACTERISTIC KL_TSYNMTKZUSFVSP82 "Zeit vor sync. Start Schnellfuellung vorb. KZU" CURVE 0x25FAE0 kl_si16_S6_S3 5000 UMR_MSEC__10_1_0_S6_S3 -5000 0
 /begin AXIS_DESCR STD_AXIS zff_atsys._.iSignale._.obj.sig_m_t UMR_NM__1_1_0_S6_S3 4 -400 1640 DEPOSIT ABSOLUTE MONOTONY MON_INCREASE /end AXIS_DESCR
/end CHARACTERISTIC
/begin CHARACTERISTIC KL_TSYNMTTRAKZUVSP82 "Zeit vor sync. Ende Fuellausgleich vorb. KZU" CURVE 0x25FAF4 kl_ui8_S6_S3 1280 UMR_MSEC__10_1_M128_S6_S3 -1280 0
 /begin AXIS_DESCR STD_AXIS zff_atsys._.iSignale._.obj.sig_m_t8 UMR_NM__8_1_M50_S6_S3 4 -400 1640 DEPOSIT ABSOLUTE MONOTONY MON_INCREASE /end AXIS_DESCR
/end CHARACTERISTIC
/begin CHARACTERISTIC T_SYNSP82 "Zeit n_t innerhalb Synchronschwelle bis Start Rampe 4" VALUE 0x26E9EE kw_ui8_S6_S3 2540 UMR_MSEC__10_1_0_S6_S3 0 2540 /end CHARACTERISTIC
/begin CHARACTERISTIC T_VKZUSP82 "Verzoegerungszeit Start SF zuschaltende Kupplung" VALUE 0x26E9EF kw_ui8_S6_S3 2540 UMR_MSEC__10_1_0_S6_S3 0 2540 /end CHARACTERISTIC
/begin CHARACTERISTIC TO_VKZUSLSTSP82 "Zeitoffset auf Verzögerung Schnellfüllung bei Schleppstart" VALUE 0x26E9F0 kw_ui8_S6_S3 90 UMR_MSEC__10_1_0_S6_S3 10 100 /end CHARACTERISTIC
/begin CHARACTERISTIC T_MIN_IG_CHANGESP82 "Mindestzeit fuer Ausgabe von Momentenuebergang" VALUE 0x26E9F1 kw_ui8_S6_S3 2540 UMR_MSEC__10_1_0_S6_S3 0 2540 /end CHARACTERISTIC
/begin CHARACTERISTIC KF_T_DT_IG_CHANGESP82 "Kennfeld Zeitvorhalt für Übergabe Rampenzeit auf Schaltdruck" MAP 0x25FB00 kf_si16_S6_S3 5080 UMR_MSEC__10_1_0_S6_S3 -2540 2540
 /begin AXIS_DESCR STD_AXIS zff_atsys._.iSignale._.obj.sig_n_t UMR_U_MIN_1_1_0_S6_S3 4 0 8160 DEPOSIT ABSOLUTE MONOTONY MON_INCREASE /end AXIS_DESCR
 /begin AXIS_DESCR STD_AXIS zff_atsys._.iSignale._.obj.sig_m_t UMR_NM__1_1_0_S6_S3 4 -400 1640 DEPOSIT ABSOLUTE MONOTONY MON_INCREASE /end AXIS_DESCR
/end CHARACTERISTIC
/begin CHARACTERISTIC KF_T2_DT_IG_CHANGESP82 "Kennfeld Zeitvorhalt für Übergabe Rampenzeit auf Schaltdruck" MAP 0x25FB38 kf_si16_S6_S3 5080 UMR_MSEC__10_1_0_S6_S3 -2540 2540
 /begin AXIS_DESCR STD_AXIS zff_atsys._.iSignale._.obj.sig_n_t UMR_U_MIN_1_1_0_S6_S3 4 0 8160 DEPOSIT ABSOLUTE MONOTONY MON_INCREASE /end AXIS_DESCR
 /begin AXIS_DESCR STD_AXIS zff_atsys._.iSignale._.obj.sig_m_t UMR_NM__1_1_0_S6_S3 4 -400 1640 DEPOSIT ABSOLUTE MONOTONY MON_INCREASE /end AXIS_DESCR
/end CHARACTERISTIC
/begin CHARACTERISTIC KL_POKZUCGSP82 "Schaltdruckoffset" CURVE 0x25FB70 kl_si16_S6_S3 12.75 UMR_BAR__1_1000_0_S6_S3 -6.4 6.35
 /begin AXIS_DESCR STD_AXIS zff_atsys._.iSignale._.obj.sig_c_getr UMR_GRADC__1_1_M40_S6_S3 10 -40 150 DEPOSIT ABSOLUTE MONOTONY MON_INCREASE /end AXIS_DESCR
/end CHARACTERISTIC
/begin CHARACTERISTIC KL_POFCGSP82 "Kennlinie Fuelldruckoffset" CURVE 0x25FB9C kl_si16_S6_S3 12.75 UMR_BAR__1_1000_0_S6_S3 -6.4 6.35
 /begin AXIS_DESCR STD_AXIS zff_atsys._.iSignale._.obj.sig_c_getr UMR_GRADC__1_1_M40_S6_S3 10 -40 150 DEPOSIT ABSOLUTE MONOTONY MON_INCREASE /end AXIS_DESCR
/end CHARACTERISTIC
/begin CHARACTERISTIC KL_PORASYNSP82 "Rampe n.Syn.->l.Stuetzst. y PMAX" CURVE 0x25FBC8 kl_si16_S6_S3 12.75 UMR_BAR__1_1000_0_S6_S3 0 12.75
 /begin AXIS_DESCR STD_AXIS iSasZentr.iSchaltend.iKzu.timer_zkzu UMR_MSEC__10_1_0_S6_S3 3 0 2540 DEPOSIT ABSOLUTE MONOTONY MON_INCREASE /end AXIS_DESCR
/end CHARACTERISTIC
/begin CHARACTERISTIC T_RA2SSCHRSP82 "Zeit 2.Rampe bei Schrittschaltung" VALUE 0x26E9F2 kw_ui8_S6_S3 2540 UMR_MSEC__10_1_0_S6_S3 0 2540 /end CHARACTERISTIC
/begin CHARACTERISTIC KL_POKZUNGABSP82 "Druckoffset in Abhaengigkeit von ng_ab" CURVE 0x25FBD8 kl_si16_S6_S3 12.75 UMR_BAR__1_1000_0_S6_S3 -6.4 6.35
 /begin AXIS_DESCR STD_AXIS iItfInput.ng_ab UMR_U_MINSEC_1_1_0_S6_S3 4 -5000 1000 DEPOSIT ABSOLUTE MONOTONY MON_INCREASE /end AXIS_DESCR
/end CHARACTERISTIC
/begin CHARACTERISTIC KL_PORAKZUSP82 "Schaltdruckoffset" CURVE 0x25FBEC kl_si16_S6_S3 12.75 UMR_BAR__1_1000_0_S6_S3 -6.4 6.35
 /begin AXIS_DESCR STD_AXIS iSasZentr.iSchaltend.iKzu.timer_zkzu UMR_MSEC__10_1_0_S6_S3 3 0 2540 DEPOSIT ABSOLUTE MONOTONY MON_INCREASE /end AXIS_DESCR
/end CHARACTERISTIC
/begin CHARACTERISTIC KL_PGOKZUSP82 "Druckgradient in Abhaengigkeit von m_t" CURVE 0x25FBFC kl_si16_S6_S3 200 UMR_BAR_SEC_1_10_0_S6_S3 -100 100
 /begin AXIS_DESCR STD_AXIS zff_atsys._.iSignale._.obj.sig_m_t UMR_NM__1_1_0_S6_S3 6 -400 1640 DEPOSIT ABSOLUTE MONOTONY MON_INCREASE /end AXIS_DESCR
/end CHARACTERISTIC
/begin CHARACTERISTIC KL_PGOKZUWSSP82 "Druckgradient in Abhaengigkeit von m_t" CURVE 0x25FC18 kl_si16_S6_S3 200 UMR_BAR_SEC_1_10_0_S6_S3 -100 100
 /begin AXIS_DESCR STD_AXIS zff_atsys._.iSignale._.obj.sig_m_t UMR_NM__1_1_0_S6_S3 6 -400 1640 DEPOSIT ABSOLUTE MONOTONY MON_INCREASE /end AXIS_DESCR
/end CHARACTERISTIC
/begin CHARACTERISTIC KL_POMDTSYNSP82 "Druckoffset Schliessphase f(delta_m_t seit synchron)" CURVE 0x25FC34 kl_si16_S6_S3 12 UMR_BAR__1_1000_0_S6_S3 -6 6
 /begin AXIS_DESCR STD_AXIS iSasZentr.md_tpgrasyn UMR_NM__1_1_0_S6_S3 4 -2000 2000 DEPOSIT ABSOLUTE MONOTONY MON_INCREASE /end AXIS_DESCR
/end CHARACTERISTIC
/begin CHARACTERISTIC KL_FPGRASYNSP82 "Faktor Schließrampengradient" CURVE 0x25FC48 kl_si16_S6_S3 50 UMR___1_10_0_S6_S3 0 50
 /begin AXIS_DESCR STD_AXIS iItfInput.ng_ab UMR_U_MINSEC_1_1_0_S6_S3 4 -5000 1000 DEPOSIT ABSOLUTE MONOTONY MON_INCREASE /end AXIS_DESCR
/end CHARACTERISTIC
/begin CHARACTERISTIC KF_PKZUWSSP82 "Schaltdruckkennfeld (n_tkf, m_t)" MAP 0x25FC5C kf_si16_S6_S3 12.75 UMR_BAR__1_1000_0_S6_S3 0 12.75
 /begin AXIS_DESCR STD_AXIS iSasZentr.iSchaltend.n_tkf UMR_U_MIN_32_1_0_S6_S3 8 0 8160 DEPOSIT ABSOLUTE MONOTONY MON_INCREASE /end AXIS_DESCR
 /begin AXIS_DESCR STD_AXIS zff_atsys._.iSignale._.obj.sig_m_t UMR_NM__1_1_0_S6_S3 8 -400 1640 DEPOSIT ABSOLUTE MONOTONY MON_INCREASE /end AXIS_DESCR
/end CHARACTERISTIC
/begin CHARACTERISTIC KL_TSYNCGRAKZUSP82 "Zeit vor sync. Ende Schaltdruck/Start 3. Rampe KZU" CURVE 0x25FD04 kl_ui8_S6_S3 1280 UMR_MSEC__10_1_M128_S6_S3 -1280 0
 /begin AXIS_DESCR STD_AXIS zff_atsys._.iSignale._.obj.sig_c_getr UMR_GRADC__1_1_M40_S6_S3 4 -40 215 DEPOSIT ABSOLUTE MONOTONY MON_INCREASE /end AXIS_DESCR
/end CHARACTERISTIC
/begin CHARACTERISTIC KF_TSYNMTNTRAKZUWSSP82 "Zeit vor sync. Ende Schaltdruck/Start 3. Rampe KZU bei Weiterschaltung (n_tkf, m_t8)" MAP 0x25FD10 kf_ui8_S6_S3 1280 UMR_MSEC__10_1_M128_S6_S3 -1280 0
 /begin AXIS_DESCR STD_AXIS zff_atsys._.iSignale._.obj.sig_m_t8 UMR_NM__8_1_M50_S6_S3 4 -400 1640 DEPOSIT ABSOLUTE MONOTONY MON_INCREASE /end AXIS_DESCR
 /begin AXIS_DESCR STD_AXIS iSasZentr.iSchaltend.n_tkf UMR_U_MIN_32_1_0_S6_S3 4 0 8160 DEPOSIT ABSOLUTE MONOTONY MON_INCREASE /end AXIS_DESCR
/end CHARACTERISTIC
/begin CHARACTERISTIC KL_POFMDMOTSOLLSP82 "Fuelldruckoffset f(Erhoehung Motorsollmoment)" CURVE 0x25FD30 kl_si16_S6_S3 12.75 UMR_BAR__1_1000_0_S6_S3 -6.4 6.35
 /begin AXIS_DESCR STD_AXIS NO_INPUT_QUANTITY UMR_NM__1_1_0_S6_S3 6 -2000 2000 DEPOSIT ABSOLUTE MONOTONY MON_INCREASE /end AXIS_DESCR
/end CHARACTERISTIC
/begin CHARACTERISTIC KL_POKZUMDMOTSOLLSP82 "Schaltdruckoffset in Abhaengigkeit von md_motsoll_sas" CURVE 0x25FD4C kl_si16_S6_S3 12.75 UMR_BAR__1_1000_0_S6_S3 -6.4 6.35
 /begin AXIS_DESCR STD_AXIS NO_INPUT_QUANTITY UMR_NM__1_1_0_S6_S3 6 -2000 2000 DEPOSIT ABSOLUTE MONOTONY MON_INCREASE /end AXIS_DESCR
/end CHARACTERISTIC
/begin CHARACTERISTIC KL_TSYNMTKZUSFVSP84 "Zeit vor sync. Start Schnellfuellung vorb. KZU" CURVE 0x25FD68 kl_si16_S6_S3 5000 UMR_MSEC__10_1_0_S6_S3 -5000 0
 /begin AXIS_DESCR STD_AXIS zff_atsys._.iSignale._.obj.sig_m_t UMR_NM__1_1_0_S6_S3 4 -400 1640 DEPOSIT ABSOLUTE MONOTONY MON_INCREASE /end AXIS_DESCR
/end CHARACTERISTIC
/begin CHARACTERISTIC KL_TSYNMTTRAKZUVSP84 "Zeit vor sync. Ende Fuellausgleich vorb. KZU" CURVE 0x25FD7C kl_ui8_S6_S3 1280 UMR_MSEC__10_1_M128_S6_S3 -1280 0
 /begin AXIS_DESCR STD_AXIS zff_atsys._.iSignale._.obj.sig_m_t8 UMR_NM__8_1_M50_S6_S3 4 -400 1640 DEPOSIT ABSOLUTE MONOTONY MON_INCREASE /end AXIS_DESCR
/end CHARACTERISTIC
/begin CHARACTERISTIC T_SYNSP84 "Zeit n_t innerhalb Synchronschwelle bis Start Rampe 4" VALUE 0x26E9F3 kw_ui8_S6_S3 2540 UMR_MSEC__10_1_0_S6_S3 0 2540 /end CHARACTERISTIC
/begin CHARACTERISTIC T_VKZUSP84 "Verzoegerungszeit Start SF zuschaltende Kupplung" VALUE 0x26E9F4 kw_ui8_S6_S3 2540 UMR_MSEC__10_1_0_S6_S3 0 2540 /end CHARACTERISTIC
/begin CHARACTERISTIC TO_VKZUSLSTSP84 "Zeitoffset auf Verzögerung Schnellfüllung bei Schleppstart" VALUE 0x26E9F5 kw_ui8_S6_S3 90 UMR_MSEC__10_1_0_S6_S3 10 100 /end CHARACTERISTIC
/begin CHARACTERISTIC T_MIN_IG_CHANGESP84 "Mindestzeit fuer Ausgabe von Momentenuebergang" VALUE 0x26E9F6 kw_ui8_S6_S3 2540 UMR_MSEC__10_1_0_S6_S3 0 2540 /end CHARACTERISTIC
/begin CHARACTERISTIC KF_T_DT_IG_CHANGESP84 "Kennfeld Zeitvorhalt für Übergabe Rampenzeit auf Schaltdruck" MAP 0x25FD88 kf_si16_S6_S3 5080 UMR_MSEC__10_1_0_S6_S3 -2540 2540
 /begin AXIS_DESCR STD_AXIS zff_atsys._.iSignale._.obj.sig_n_t UMR_U_MIN_1_1_0_S6_S3 4 0 8160 DEPOSIT ABSOLUTE MONOTONY MON_INCREASE /end AXIS_DESCR
 /begin AXIS_DESCR STD_AXIS zff_atsys._.iSignale._.obj.sig_m_t UMR_NM__1_1_0_S6_S3 4 -400 1640 DEPOSIT ABSOLUTE MONOTONY MON_INCREASE /end AXIS_DESCR
/end CHARACTERISTIC
/begin CHARACTERISTIC KF_T2_DT_IG_CHANGESP84 "Kennfeld Zeitvorhalt für Übergabe Rampenzeit auf Schaltdruck" MAP 0x25FDC0 kf_si16_S6_S3 5080 UMR_MSEC__10_1_0_S6_S3 -2540 2540
 /begin AXIS_DESCR STD_AXIS zff_atsys._.iSignale._.obj.sig_n_t UMR_U_MIN_1_1_0_S6_S3 4 0 8160 DEPOSIT ABSOLUTE MONOTONY MON_INCREASE /end AXIS_DESCR
 /begin AXIS_DESCR STD_AXIS zff_atsys._.iSignale._.obj.sig_m_t UMR_NM__1_1_0_S6_S3 4 -400 1640 DEPOSIT ABSOLUTE MONOTONY MON_INCREASE /end AXIS_DESCR
/end CHARACTERISTIC
/begin CHARACTERISTIC KL_POKZUCGSP84 "Schaltdruckoffset" CURVE 0x25FDF8 kl_si16_S6_S3 12.75 UMR_BAR__1_1000_0_S6_S3 -6.4 6.35
 /begin AXIS_DESCR STD_AXIS zff_atsys._.iSignale._.obj.sig_c_getr UMR_GRADC__1_1_M40_S6_S3 10 -40 150 DEPOSIT ABSOLUTE MONOTONY MON_INCREASE /end AXIS_DESCR
/end CHARACTERISTIC
/begin CHARACTERISTIC KL_POFCGSP84 "Kennlinie Fuelldruckoffset" CURVE 0x25FE24 kl_si16_S6_S3 12.75 UMR_BAR__1_1000_0_S6_S3 -6.4 6.35
 /begin AXIS_DESCR STD_AXIS zff_atsys._.iSignale._.obj.sig_c_getr UMR_GRADC__1_1_M40_S6_S3 10 -40 150 DEPOSIT ABSOLUTE MONOTONY MON_INCREASE /end AXIS_DESCR
/end CHARACTERISTIC
/begin CHARACTERISTIC KL_PORASYNSP84 "Rampe n.Syn.->l.Stuetzst. y PMAX" CURVE 0x25FE50 kl_si16_S6_S3 12.75 UMR_BAR__1_1000_0_S6_S3 0 12.75
 /begin AXIS_DESCR STD_AXIS iSasZentr.iSchaltend.iKzu.timer_zkzu UMR_MSEC__10_1_0_S6_S3 3 0 2540 DEPOSIT ABSOLUTE MONOTONY MON_INCREASE /end AXIS_DESCR
/end CHARACTERISTIC
/begin CHARACTERISTIC T_RA2SSCHRSP84 "Zeit 2.Rampe bei Schrittschaltung" VALUE 0x26E9F7 kw_ui8_S6_S3 2540 UMR_MSEC__10_1_0_S6_S3 0 2540 /end CHARACTERISTIC
/begin CHARACTERISTIC KL_POKZUNGABSP84 "Druckoffset in Abhaengigkeit von ng_ab" CURVE 0x25FE60 kl_si16_S6_S3 12.75 UMR_BAR__1_1000_0_S6_S3 -6.4 6.35
 /begin AXIS_DESCR STD_AXIS iItfInput.ng_ab UMR_U_MINSEC_1_1_0_S6_S3 4 -5000 1000 DEPOSIT ABSOLUTE MONOTONY MON_INCREASE /end AXIS_DESCR
/end CHARACTERISTIC
/begin CHARACTERISTIC KL_PORAKZUSP84 "Schaltdruckoffset" CURVE 0x25FE74 kl_si16_S6_S3 12.75 UMR_BAR__1_1000_0_S6_S3 -6.4 6.35
 /begin AXIS_DESCR STD_AXIS iSasZentr.iSchaltend.iKzu.timer_zkzu UMR_MSEC__10_1_0_S6_S3 3 0 2540 DEPOSIT ABSOLUTE MONOTONY MON_INCREASE /end AXIS_DESCR
/end CHARACTERISTIC
/begin CHARACTERISTIC KL_PGOKZUSP84 "Druckgradient in Abhaengigkeit von m_t" CURVE 0x25FE84 kl_si16_S6_S3 200 UMR_BAR_SEC_1_10_0_S6_S3 -100 100
 /begin AXIS_DESCR STD_AXIS zff_atsys._.iSignale._.obj.sig_m_t UMR_NM__1_1_0_S6_S3 6 -400 1640 DEPOSIT ABSOLUTE MONOTONY MON_INCREASE /end AXIS_DESCR
/end CHARACTERISTIC
/begin CHARACTERISTIC KL_PGOKZUWSSP84 "Druckgradient in Abhaengigkeit von m_t" CURVE 0x25FEA0 kl_si16_S6_S3 200 UMR_BAR_SEC_1_10_0_S6_S3 -100 100
 /begin AXIS_DESCR STD_AXIS zff_atsys._.iSignale._.obj.sig_m_t UMR_NM__1_1_0_S6_S3 6 -400 1640 DEPOSIT ABSOLUTE MONOTONY MON_INCREASE /end AXIS_DESCR
/end CHARACTERISTIC
/begin CHARACTERISTIC KL_POMDTSYNSP84 "Druckoffset Schliessphase f(delta_m_t seit synchron)" CURVE 0x25FEBC kl_si16_S6_S3 12 UMR_BAR__1_1000_0_S6_S3 -6 6
 /begin AXIS_DESCR STD_AXIS iSasZentr.md_tpgrasyn UMR_NM__1_1_0_S6_S3 4 -2000 2000 DEPOSIT ABSOLUTE MONOTONY MON_INCREASE /end AXIS_DESCR
/end CHARACTERISTIC
/begin CHARACTERISTIC KL_FPGRASYNSP84 "Faktor Schließrampengradient" CURVE 0x25FED0 kl_si16_S6_S3 50 UMR___1_10_0_S6_S3 0 50
 /begin AXIS_DESCR STD_AXIS iItfInput.ng_ab UMR_U_MINSEC_1_1_0_S6_S3 4 -5000 1000 DEPOSIT ABSOLUTE MONOTONY MON_INCREASE /end AXIS_DESCR
/end CHARACTERISTIC
/begin CHARACTERISTIC KF_PKZUWSSP84 "Schaltdruckkennfeld (n_tkf, m_t)" MAP 0x25FEE4 kf_si16_S6_S3 12.75 UMR_BAR__1_1000_0_S6_S3 0 12.75
 /begin AXIS_DESCR STD_AXIS iSasZentr.iSchaltend.n_tkf UMR_U_MIN_32_1_0_S6_S3 8 0 8160 DEPOSIT ABSOLUTE MONOTONY MON_INCREASE /end AXIS_DESCR
 /begin AXIS_DESCR STD_AXIS zff_atsys._.iSignale._.obj.sig_m_t UMR_NM__1_1_0_S6_S3 8 -400 1640 DEPOSIT ABSOLUTE MONOTONY MON_INCREASE /end AXIS_DESCR
/end CHARACTERISTIC
/begin CHARACTERISTIC KL_TSYNCGRAKZUSP84 "Zeit vor sync. Ende Schaltdruck/Start 3. Rampe KZU" CURVE 0x25FF8C kl_ui8_S6_S3 1280 UMR_MSEC__10_1_M128_S6_S3 -1280 0
 /begin AXIS_DESCR STD_AXIS zff_atsys._.iSignale._.obj.sig_c_getr UMR_GRADC__1_1_M40_S6_S3 4 -40 215 DEPOSIT ABSOLUTE MONOTONY MON_INCREASE /end AXIS_DESCR
/end CHARACTERISTIC
/begin CHARACTERISTIC KF_TSYNMTNTRAKZUWSSP84 "Zeit vor sync. Ende Schaltdruck/Start 3. Rampe KZU bei Weiterschaltung (n_tkf, m_t8)" MAP 0x25FF98 kf_ui8_S6_S3 1280 UMR_MSEC__10_1_M128_S6_S3 -1280 0
 /begin AXIS_DESCR STD_AXIS zff_atsys._.iSignale._.obj.sig_m_t8 UMR_NM__8_1_M50_S6_S3 4 -400 1640 DEPOSIT ABSOLUTE MONOTONY MON_INCREASE /end AXIS_DESCR
 /begin AXIS_DESCR STD_AXIS iSasZentr.iSchaltend.n_tkf UMR_U_MIN_32_1_0_S6_S3 4 0 8160 DEPOSIT ABSOLUTE MONOTONY MON_INCREASE /end AXIS_DESCR
/end CHARACTERISTIC
/begin CHARACTERISTIC KL_POFMDMOTSOLLSP84 "Fuelldruckoffset f(Erhoehung Motorsollmoment)" CURVE 0x25FFB8 kl_si16_S6_S3 12.75 UMR_BAR__1_1000_0_S6_S3 -6.4 6.35
 /begin AXIS_DESCR STD_AXIS NO_INPUT_QUANTITY UMR_NM__1_1_0_S6_S3 6 -2000 2000 DEPOSIT ABSOLUTE MONOTONY MON_INCREASE /end AXIS_DESCR
/end CHARACTERISTIC
/begin CHARACTERISTIC KL_POKZUMDMOTSOLLSP84 "Schaltdruckoffset in Abhaengigkeit von md_motsoll_sas" CURVE 0x25FFD4 kl_si16_S6_S3 12.75 UMR_BAR__1_1000_0_S6_S3 -6.4 6.35
 /begin AXIS_DESCR STD_AXIS NO_INPUT_QUANTITY UMR_NM__1_1_0_S6_S3 6 -2000 2000 DEPOSIT ABSOLUTE MONOTONY MON_INCREASE /end AXIS_DESCR
/end CHARACTERISTIC
/begin CHARACTERISTIC KL_TSYNMTKZUSFVSP86 "Zeit vor sync. Start Schnellfuellung vorb. KZU" CURVE 0x25FFF0 kl_si16_S6_S3 5000 UMR_MSEC__10_1_0_S6_S3 -5000 0
 /begin AXIS_DESCR STD_AXIS zff_atsys._.iSignale._.obj.sig_m_t UMR_NM__1_1_0_S6_S3 4 -400 1640 DEPOSIT ABSOLUTE MONOTONY MON_INCREASE /end AXIS_DESCR
/end CHARACTERISTIC
/begin CHARACTERISTIC KL_TSYNMTTRAKZUVSP86 "Zeit vor sync. Ende Fuellausgleich vorb. KZU" CURVE 0x260004 kl_ui8_S6_S3 1280 UMR_MSEC__10_1_M128_S6_S3 -1280 0
 /begin AXIS_DESCR STD_AXIS zff_atsys._.iSignale._.obj.sig_m_t8 UMR_NM__8_1_M50_S6_S3 4 -400 1640 DEPOSIT ABSOLUTE MONOTONY MON_INCREASE /end AXIS_DESCR
/end CHARACTERISTIC
/begin CHARACTERISTIC T_SYNSP86 "Zeit n_t innerhalb Synchronschwelle bis Start Rampe 4" VALUE 0x26E9F8 kw_ui8_S6_S3 2540 UMR_MSEC__10_1_0_S6_S3 0 2540 /end CHARACTERISTIC
/begin CHARACTERISTIC T_VKZUSP86 "Verzoegerungszeit Start SF zuschaltende Kupplung" VALUE 0x26E9F9 kw_ui8_S6_S3 2540 UMR_MSEC__10_1_0_S6_S3 0 2540 /end CHARACTERISTIC
/begin CHARACTERISTIC TO_VKZUSLSTSP86 "Zeitoffset auf Verzögerung Schnellfüllung bei Schleppstart" VALUE 0x26E9FA kw_ui8_S6_S3 90 UMR_MSEC__10_1_0_S6_S3 10 100 /end CHARACTERISTIC
/begin CHARACTERISTIC T_MIN_IG_CHANGESP86 "Mindestzeit fuer Ausgabe von Momentenuebergang" VALUE 0x26E9FB kw_ui8_S6_S3 2540 UMR_MSEC__10_1_0_S6_S3 0 2540 /end CHARACTERISTIC
/begin CHARACTERISTIC KF_T_DT_IG_CHANGESP86 "Kennfeld Zeitvorhalt für Übergabe Rampenzeit auf Schaltdruck" MAP 0x260010 kf_si16_S6_S3 5080 UMR_MSEC__10_1_0_S6_S3 -2540 2540
 /begin AXIS_DESCR STD_AXIS zff_atsys._.iSignale._.obj.sig_n_t UMR_U_MIN_1_1_0_S6_S3 4 0 8160 DEPOSIT ABSOLUTE MONOTONY MON_INCREASE /end AXIS_DESCR
 /begin AXIS_DESCR STD_AXIS zff_atsys._.iSignale._.obj.sig_m_t UMR_NM__1_1_0_S6_S3 4 -400 1640 DEPOSIT ABSOLUTE MONOTONY MON_INCREASE /end AXIS_DESCR
/end CHARACTERISTIC
/begin CHARACTERISTIC KF_T2_DT_IG_CHANGESP86 "Kennfeld Zeitvorhalt für Übergabe Rampenzeit auf Schaltdruck" MAP 0x260048 kf_si16_S6_S3 5080 UMR_MSEC__10_1_0_S6_S3 -2540 2540
 /begin AXIS_DESCR STD_AXIS zff_atsys._.iSignale._.obj.sig_n_t UMR_U_MIN_1_1_0_S6_S3 4 0 8160 DEPOSIT ABSOLUTE MONOTONY MON_INCREASE /end AXIS_DESCR
 /begin AXIS_DESCR STD_AXIS zff_atsys._.iSignale._.obj.sig_m_t UMR_NM__1_1_0_S6_S3 4 -400 1640 DEPOSIT ABSOLUTE MONOTONY MON_INCREASE /end AXIS_DESCR
/end CHARACTERISTIC
/begin CHARACTERISTIC KL_POKZUCGSP86 "Schaltdruckoffset" CURVE 0x260080 kl_si16_S6_S3 12.75 UMR_BAR__1_1000_0_S6_S3 -6.4 6.35
 /begin AXIS_DESCR STD_AXIS zff_atsys._.iSignale._.obj.sig_c_getr UMR_GRADC__1_1_M40_S6_S3 10 -40 150 DEPOSIT ABSOLUTE MONOTONY MON_INCREASE /end AXIS_DESCR
/end CHARACTERISTIC
/begin CHARACTERISTIC KL_POFCGSP86 "Kennlinie Fuelldruckoffset" CURVE 0x2600AC kl_si16_S6_S3 12.75 UMR_BAR__1_1000_0_S6_S3 -6.4 6.35
 /begin AXIS_DESCR STD_AXIS zff_atsys._.iSignale._.obj.sig_c_getr UMR_GRADC__1_1_M40_S6_S3 10 -40 150 DEPOSIT ABSOLUTE MONOTONY MON_INCREASE /end AXIS_DESCR
/end CHARACTERISTIC
/begin CHARACTERISTIC KL_PORASYNSP86 "Rampe n.Syn.->l.Stuetzst. y PMAX" CURVE 0x2600D8 kl_si16_S6_S3 12.75 UMR_BAR__1_1000_0_S6_S3 0 12.75
 /begin AXIS_DESCR STD_AXIS iSasZentr.iSchaltend.iKzu.timer_zkzu UMR_MSEC__10_1_0_S6_S3 3 0 2540 DEPOSIT ABSOLUTE MONOTONY MON_INCREASE /end AXIS_DESCR
/end CHARACTERISTIC
/begin CHARACTERISTIC T_RA2SSCHRSP86 "Zeit 2.Rampe bei Schrittschaltung" VALUE 0x26E9FC kw_ui8_S6_S3 2540 UMR_MSEC__10_1_0_S6_S3 0 2540 /end CHARACTERISTIC
/begin CHARACTERISTIC KL_POKZUNGABSP86 "Druckoffset in Abhaengigkeit von ng_ab" CURVE 0x2600E8 kl_si16_S6_S3 12.75 UMR_BAR__1_1000_0_S6_S3 -6.4 6.35
 /begin AXIS_DESCR STD_AXIS iItfInput.ng_ab UMR_U_MINSEC_1_1_0_S6_S3 4 -5000 1000 DEPOSIT ABSOLUTE MONOTONY MON_INCREASE /end AXIS_DESCR
/end CHARACTERISTIC
/begin CHARACTERISTIC KL_PORAKZUSP86 "Schaltdruckoffset" CURVE 0x2600FC kl_si16_S6_S3 12.75 UMR_BAR__1_1000_0_S6_S3 -6.4 6.35
 /begin AXIS_DESCR STD_AXIS iSasZentr.iSchaltend.iKzu.timer_zkzu UMR_MSEC__10_1_0_S6_S3 3 0 2540 DEPOSIT ABSOLUTE MONOTONY MON_INCREASE /end AXIS_DESCR
/end CHARACTERISTIC
/begin CHARACTERISTIC KL_PGOKZUSP86 "Druckgradient in Abhaengigkeit von m_t" CURVE 0x26010C kl_si16_S6_S3 200 UMR_BAR_SEC_1_10_0_S6_S3 -100 100
 /begin AXIS_DESCR STD_AXIS zff_atsys._.iSignale._.obj.sig_m_t UMR_NM__1_1_0_S6_S3 6 -400 1640 DEPOSIT ABSOLUTE MONOTONY MON_INCREASE /end AXIS_DESCR
/end CHARACTERISTIC
/begin CHARACTERISTIC KL_PGOKZUWSSP86 "Druckgradient in Abhaengigkeit von m_t" CURVE 0x260128 kl_si16_S6_S3 200 UMR_BAR_SEC_1_10_0_S6_S3 -100 100
 /begin AXIS_DESCR STD_AXIS zff_atsys._.iSignale._.obj.sig_m_t UMR_NM__1_1_0_S6_S3 6 -400 1640 DEPOSIT ABSOLUTE MONOTONY MON_INCREASE /end AXIS_DESCR
/end CHARACTERISTIC
/begin CHARACTERISTIC KL_POMDTSYNSP86 "Druckoffset Schliessphase f(delta_m_t seit synchron)" CURVE 0x260144 kl_si16_S6_S3 12 UMR_BAR__1_1000_0_S6_S3 -6 6
 /begin AXIS_DESCR STD_AXIS iSasZentr.md_tpgrasyn UMR_NM__1_1_0_S6_S3 4 -2000 2000 DEPOSIT ABSOLUTE MONOTONY MON_INCREASE /end AXIS_DESCR
/end CHARACTERISTIC
/begin CHARACTERISTIC KL_FPGRASYNSP86 "Faktor Schließrampengradient" CURVE 0x260158 kl_si16_S6_S3 50 UMR___1_10_0_S6_S3 0 50
 /begin AXIS_DESCR STD_AXIS iItfInput.ng_ab UMR_U_MINSEC_1_1_0_S6_S3 4 -5000 1000 DEPOSIT ABSOLUTE MONOTONY MON_INCREASE /end AXIS_DESCR
/end CHARACTERISTIC
/begin CHARACTERISTIC KF_PKZUWSSP86 "Schaltdruckkennfeld (n_tkf, m_t)" MAP 0x26016C kf_si16_S6_S3 12.75 UMR_BAR__1_1000_0_S6_S3 0 12.75
 /begin AXIS_DESCR STD_AXIS iSasZentr.iSchaltend.n_tkf UMR_U_MIN_32_1_0_S6_S3 8 0 8160 DEPOSIT ABSOLUTE MONOTONY MON_INCREASE /end AXIS_DESCR
 /begin AXIS_DESCR STD_AXIS zff_atsys._.iSignale._.obj.sig_m_t UMR_NM__1_1_0_S6_S3 8 -400 1640 DEPOSIT ABSOLUTE MONOTONY MON_INCREASE /end AXIS_DESCR
/end CHARACTERISTIC
/begin CHARACTERISTIC KL_TSYNCGRAKZUSP86 "Zeit vor sync. Ende Schaltdruck/Start 3. Rampe KZU" CURVE 0x260214 kl_ui8_S6_S3 1280 UMR_MSEC__10_1_M128_S6_S3 -1280 0
 /begin AXIS_DESCR STD_AXIS zff_atsys._.iSignale._.obj.sig_c_getr UMR_GRADC__1_1_M40_S6_S3 4 -40 215 DEPOSIT ABSOLUTE MONOTONY MON_INCREASE /end AXIS_DESCR
/end CHARACTERISTIC
/begin CHARACTERISTIC KF_TSYNMTNTRAKZUWSSP86 "Zeit vor sync. Ende Schaltdruck/Start 3. Rampe KZU bei Weiterschaltung (n_tkf, m_t8)" MAP 0x260220 kf_ui8_S6_S3 1280 UMR_MSEC__10_1_M128_S6_S3 -1280 0
 /begin AXIS_DESCR STD_AXIS zff_atsys._.iSignale._.obj.sig_m_t8 UMR_NM__8_1_M50_S6_S3 4 -400 1640 DEPOSIT ABSOLUTE MONOTONY MON_INCREASE /end AXIS_DESCR
 /begin AXIS_DESCR STD_AXIS iSasZentr.iSchaltend.n_tkf UMR_U_MIN_32_1_0_S6_S3 4 0 8160 DEPOSIT ABSOLUTE MONOTONY MON_INCREASE /end AXIS_DESCR
/end CHARACTERISTIC
/begin CHARACTERISTIC KL_POFMDMOTSOLLSP86 "Fuelldruckoffset f(Erhoehung Motorsollmoment)" CURVE 0x260240 kl_si16_S6_S3 12.75 UMR_BAR__1_1000_0_S6_S3 -6.4 6.35
 /begin AXIS_DESCR STD_AXIS NO_INPUT_QUANTITY UMR_NM__1_1_0_S6_S3 6 -2000 2000 DEPOSIT ABSOLUTE MONOTONY MON_INCREASE /end AXIS_DESCR
/end CHARACTERISTIC
/begin CHARACTERISTIC KL_POKZUMDMOTSOLLSP86 "Schaltdruckoffset in Abhaengigkeit von md_motsoll_sas" CURVE 0x26025C kl_si16_S6_S3 12.75 UMR_BAR__1_1000_0_S6_S3 -6.4 6.35
 /begin AXIS_DESCR STD_AXIS NO_INPUT_QUANTITY UMR_NM__1_1_0_S6_S3 6 -2000 2000 DEPOSIT ABSOLUTE MONOTONY MON_INCREASE /end AXIS_DESCR
/end CHARACTERISTIC
/begin CHARACTERISTIC TAB_SWI_POKZUFOL "Schalter für Entscheidung Druckoffset bei Folgesch." CURVE 0x24C42C tab_ui8_S6_S3 2 UMR___1_1_0_S6_S3 0 2
 /begin AXIS_DESCR FIX_AXIS iSasZentr.iVorbereitend.iKzu.kup_kzu UMR___1_1_0_S6_S3 5 1 5 FIX_AXIS_PAR_DIST 1 1 5 /end AXIS_DESCR
/end CHARACTERISTIC
/begin CHARACTERISTIC KF_POFMTNESTART12 "Kennfeld Fuelldruckoffset(n_t, m_t)" MAP 0x24C438 kf_si16_S6_S3 12.75 UMR_BAR__1_1000_0_S6_S3 -6.4 6.35
 /begin AXIS_DESCR STD_AXIS zff_atsys._.iSignale._.obj.sig_n_t UMR_U_MIN_1_1_0_S6_S3 4 0 8160 DEPOSIT ABSOLUTE MONOTONY MON_INCREASE /end AXIS_DESCR
 /begin AXIS_DESCR STD_AXIS zff_atsys._.iSignale._.obj.sig_m_t UMR_NM__1_1_0_S6_S3 6 -400 1640 DEPOSIT ABSOLUTE MONOTONY MON_INCREASE /end AXIS_DESCR
/end CHARACTERISTIC
/begin CHARACTERISTIC KF_POFMTNESTART12_EL "Kennfeld Fuelldruckoffset(n_t, m_t)" MAP 0x24C484 kf_si16_S6_S3 12.75 UMR_BAR__1_1000_0_S6_S3 -6.4 6.35
 /begin AXIS_DESCR STD_AXIS zff_atsys._.iSignale._.obj.sig_n_t UMR_U_MIN_1_1_0_S6_S3 4 0 8160 DEPOSIT ABSOLUTE MONOTONY MON_INCREASE /end AXIS_DESCR
 /begin AXIS_DESCR STD_AXIS zff_atsys._.iSignale._.obj.sig_m_t UMR_NM__1_1_0_S6_S3 6 -400 1640 DEPOSIT ABSOLUTE MONOTONY MON_INCREASE /end AXIS_DESCR
/end CHARACTERISTIC
/begin CHARACTERISTIC KL_PGOFMTESTART12 "Gradient Druckoffset Fuellphase" CURVE 0x24C4D0 kl_si16_S6_S3 200 UMR_BAR_SEC_1_10_0_S6_S3 -100 100
 /begin AXIS_DESCR STD_AXIS zff_atsys._.iSignale._.obj.sig_m_t UMR_NM__1_1_0_S6_S3 4 -400 1640 DEPOSIT ABSOLUTE MONOTONY MON_INCREASE /end AXIS_DESCR
/end CHARACTERISTIC
/begin CHARACTERISTIC KF_TFMTNTESTART12 "Fuellzeit" MAP 0x24C4E4 kf_si16_S6_S3 2540 UMR_MSEC__10_1_0_S6_S3 0 2540
 /begin AXIS_DESCR STD_AXIS zff_atsys._.iSignale._.obj.sig_m_t UMR_NM__1_1_0_S6_S3 10 -400 1640 DEPOSIT ABSOLUTE MONOTONY MON_INCREASE /end AXIS_DESCR
 /begin AXIS_DESCR STD_AXIS zff_atsys._.iSignale._.obj.sig_n_t UMR_U_MIN_1_1_0_S6_S3 3 0 8160 DEPOSIT ABSOLUTE MONOTONY MON_INCREASE /end AXIS_DESCR
/end CHARACTERISTIC
/begin CHARACTERISTIC T_SYNKABE12 "Zeit vor sync. Ende Schaltdruck KAB" VALUE 0x26DDCA kw_si16_S6_S3 5000 UMR_MSEC__10_1_0_S6_S3 -5000 0 /end CHARACTERISTIC
/begin CHARACTERISTIC KF_PKAB12 "Schaltdruck abschaltende Kupplung" MAP 0x242434 kf_si16_S6_S3 12.75 UMR_BAR__1_1000_0_S6_S3 0 12.75
 /begin AXIS_DESCR STD_AXIS iSasZentr.iSchaltend.n_tkf UMR_U_MIN_32_1_0_S6_S3 8 0 8160 DEPOSIT ABSOLUTE MONOTONY MON_INCREASE /end AXIS_DESCR
 /begin AXIS_DESCR STD_AXIS zff_atsys._.iSignale._.obj.sig_m_t UMR_NM__1_1_0_S6_S3 10 -400 1640 DEPOSIT ABSOLUTE MONOTONY MON_INCREASE /end AXIS_DESCR
/end CHARACTERISTIC
/begin CHARACTERISTIC KF_PKAB12_EL "Schaltdruck abschaltende Kupplung" MAP 0x242500 kf_si16_S6_S3 12.75 UMR_BAR__1_1000_0_S6_S3 0 12.75
 /begin AXIS_DESCR STD_AXIS iSasZentr.iSchaltend.n_tkf UMR_U_MIN_32_1_0_S6_S3 8 0 8160 DEPOSIT ABSOLUTE MONOTONY MON_INCREASE /end AXIS_DESCR
 /begin AXIS_DESCR STD_AXIS zff_atsys._.iSignale._.obj.sig_m_t UMR_NM__1_1_0_S6_S3 10 -400 1640 DEPOSIT ABSOLUTE MONOTONY MON_INCREASE /end AXIS_DESCR
/end CHARACTERISTIC
/begin CHARACTERISTIC PO_HKAB12 "Druckoffset waehrend Haltephase k_ab" VALUE 0x26DDCC kw_si16_S6_S3 12.75 UMR_BAR__1_1000_0_S6_S3 0 12.75 /end CHARACTERISTIC
/begin CHARACTERISTIC TO_HKAB12 "Zeit fuer Druckoffset waehrend Haltephase k_ab" VALUE 0x26E734 kw_ui8_S6_S3 1000 UMR_MSEC__10_1_0_S6_S3 0 1000 /end CHARACTERISTIC
/begin CHARACTERISTIC PS_ABBSYNISTHS12 "Schwellwert Abbruch einer HS bevor sync istgang verlassen" VALUE 0x26DDCE kw_si16_S6_S3 22 UMR_BAR__1_1000_0_S6_S3 0 22 /end CHARACTERISTIC
/begin CHARACTERISTIC KL_PGOMTKAB12 "Gradientenoffset fuer Schaltdruckphase bei HS" CURVE 0x2425CC kl_si16_S6_S3 100 UMR_BAR_SEC_1_10_0_S6_S3 -100 0
 /begin AXIS_DESCR STD_AXIS zff_atsys._.iSignale._.obj.sig_m_t UMR_NM__1_1_0_S6_S3 4 -400 1640 DEPOSIT ABSOLUTE MONOTONY MON_INCREASE /end AXIS_DESCR
/end CHARACTERISTIC
/begin CHARACTERISTIC T_SYNKABE23 "Zeit vor sync. Ende Schaltdruck KAB" VALUE 0x26DDD0 kw_si16_S6_S3 5000 UMR_MSEC__10_1_0_S6_S3 -5000 0 /end CHARACTERISTIC
/begin CHARACTERISTIC KF_PKAB23 "Schaltdruck abschaltende Kupplung" MAP 0x2425E0 kf_si16_S6_S3 12.75 UMR_BAR__1_1000_0_S6_S3 0 12.75
 /begin AXIS_DESCR STD_AXIS iSasZentr.iSchaltend.n_tkf UMR_U_MIN_32_1_0_S6_S3 8 0 8160 DEPOSIT ABSOLUTE MONOTONY MON_INCREASE /end AXIS_DESCR
 /begin AXIS_DESCR STD_AXIS zff_atsys._.iSignale._.obj.sig_m_t UMR_NM__1_1_0_S6_S3 10 -400 1640 DEPOSIT ABSOLUTE MONOTONY MON_INCREASE /end AXIS_DESCR
/end CHARACTERISTIC
/begin CHARACTERISTIC KF_PKAB23_EL "Schaltdruck abschaltende Kupplung" MAP 0x2426AC kf_si16_S6_S3 12.75 UMR_BAR__1_1000_0_S6_S3 0 12.75
 /begin AXIS_DESCR STD_AXIS iSasZentr.iSchaltend.n_tkf UMR_U_MIN_32_1_0_S6_S3 8 0 8160 DEPOSIT ABSOLUTE MONOTONY MON_INCREASE /end AXIS_DESCR
 /begin AXIS_DESCR STD_AXIS zff_atsys._.iSignale._.obj.sig_m_t UMR_NM__1_1_0_S6_S3 10 -400 1640 DEPOSIT ABSOLUTE MONOTONY MON_INCREASE /end AXIS_DESCR
/end CHARACTERISTIC
/begin CHARACTERISTIC PO_HKAB23 "Druckoffset waehrend Haltephase k_ab" VALUE 0x26DDD2 kw_si16_S6_S3 12.75 UMR_BAR__1_1000_0_S6_S3 0 12.75 /end CHARACTERISTIC
/begin CHARACTERISTIC TO_HKAB23 "Zeit fuer Druckoffset waehrend Haltephase k_ab" VALUE 0x26E735 kw_ui8_S6_S3 1000 UMR_MSEC__10_1_0_S6_S3 0 1000 /end CHARACTERISTIC
/begin CHARACTERISTIC PS_ABBSYNISTHS23 "Schwellwert Abbruch einer HS bevor sync istgang verlassen" VALUE 0x26DDD4 kw_si16_S6_S3 22 UMR_BAR__1_1000_0_S6_S3 0 22 /end CHARACTERISTIC
/begin CHARACTERISTIC KL_PGOMTKAB23 "Gradientenoffset fuer Schaltdruckphase bei HS" CURVE 0x242778 kl_si16_S6_S3 100 UMR_BAR_SEC_1_10_0_S6_S3 -100 0
 /begin AXIS_DESCR STD_AXIS zff_atsys._.iSignale._.obj.sig_m_t UMR_NM__1_1_0_S6_S3 4 -400 1640 DEPOSIT ABSOLUTE MONOTONY MON_INCREASE /end AXIS_DESCR
/end CHARACTERISTIC
/begin CHARACTERISTIC T_SYNKABE34 "Zeit vor sync. Ende Schaltdruck KAB" VALUE 0x26DDD6 kw_si16_S6_S3 5000 UMR_MSEC__10_1_0_S6_S3 -5000 0 /end CHARACTERISTIC
/begin CHARACTERISTIC KF_PKAB34 "Schaltdruck abschaltende Kupplung" MAP 0x24278C kf_si16_S6_S3 12.75 UMR_BAR__1_1000_0_S6_S3 0 12.75
 /begin AXIS_DESCR STD_AXIS iSasZentr.iSchaltend.n_tkf UMR_U_MIN_32_1_0_S6_S3 8 0 8160 DEPOSIT ABSOLUTE MONOTONY MON_INCREASE /end AXIS_DESCR
 /begin AXIS_DESCR STD_AXIS zff_atsys._.iSignale._.obj.sig_m_t UMR_NM__1_1_0_S6_S3 10 -400 1640 DEPOSIT ABSOLUTE MONOTONY MON_INCREASE /end AXIS_DESCR
/end CHARACTERISTIC
/begin CHARACTERISTIC KF_PKAB34_EL "Schaltdruck abschaltende Kupplung" MAP 0x242858 kf_si16_S6_S3 12.75 UMR_BAR__1_1000_0_S6_S3 0 12.75
 /begin AXIS_DESCR STD_AXIS iSasZentr.iSchaltend.n_tkf UMR_U_MIN_32_1_0_S6_S3 8 0 8160 DEPOSIT ABSOLUTE MONOTONY MON_INCREASE /end AXIS_DESCR
 /begin AXIS_DESCR STD_AXIS zff_atsys._.iSignale._.obj.sig_m_t UMR_NM__1_1_0_S6_S3 10 -400 1640 DEPOSIT ABSOLUTE MONOTONY MON_INCREASE /end AXIS_DESCR
/end CHARACTERISTIC
/begin CHARACTERISTIC PO_HKAB34 "Druckoffset waehrend Haltephase k_ab" VALUE 0x26DDD8 kw_si16_S6_S3 12.75 UMR_BAR__1_1000_0_S6_S3 0 12.75 /end CHARACTERISTIC
/begin CHARACTERISTIC TO_HKAB34 "Zeit fuer Druckoffset waehrend Haltephase k_ab" VALUE 0x26E736 kw_ui8_S6_S3 1000 UMR_MSEC__10_1_0_S6_S3 0 1000 /end CHARACTERISTIC
/begin CHARACTERISTIC PS_ABBSYNISTHS34 "Schwellwert Abbruch einer HS bevor sync istgang verlassen" VALUE 0x26DDDA kw_si16_S6_S3 22 UMR_BAR__1_1000_0_S6_S3 0 22 /end CHARACTERISTIC
/begin CHARACTERISTIC KL_PGOMTKAB34 "Gradientenoffset fuer Schaltdruckphase bei HS" CURVE 0x242924 kl_si16_S6_S3 100 UMR_BAR_SEC_1_10_0_S6_S3 -100 0
 /begin AXIS_DESCR STD_AXIS zff_atsys._.iSignale._.obj.sig_m_t UMR_NM__1_1_0_S6_S3 4 -400 1640 DEPOSIT ABSOLUTE MONOTONY MON_INCREASE /end AXIS_DESCR
/end CHARACTERISTIC
/begin CHARACTERISTIC T_SYNKABE45 "Zeit vor sync. Ende Schaltdruck KAB" VALUE 0x26DDDC kw_si16_S6_S3 5000 UMR_MSEC__10_1_0_S6_S3 -5000 0 /end CHARACTERISTIC
/begin CHARACTERISTIC KF_PKAB45 "Schaltdruck abschaltende Kupplung" MAP 0x242938 kf_si16_S6_S3 12.75 UMR_BAR__1_1000_0_S6_S3 0 12.75
 /begin AXIS_DESCR STD_AXIS iSasZentr.iSchaltend.n_tkf UMR_U_MIN_32_1_0_S6_S3 8 0 8160 DEPOSIT ABSOLUTE MONOTONY MON_INCREASE /end AXIS_DESCR
 /begin AXIS_DESCR STD_AXIS zff_atsys._.iSignale._.obj.sig_m_t UMR_NM__1_1_0_S6_S3 10 -400 1640 DEPOSIT ABSOLUTE MONOTONY MON_INCREASE /end AXIS_DESCR
/end CHARACTERISTIC
/begin CHARACTERISTIC KF_PKAB45_EL "Schaltdruck abschaltende Kupplung" MAP 0x242A04 kf_si16_S6_S3 12.75 UMR_BAR__1_1000_0_S6_S3 0 12.75
 /begin AXIS_DESCR STD_AXIS iSasZentr.iSchaltend.n_tkf UMR_U_MIN_32_1_0_S6_S3 8 0 8160 DEPOSIT ABSOLUTE MONOTONY MON_INCREASE /end AXIS_DESCR
 /begin AXIS_DESCR STD_AXIS zff_atsys._.iSignale._.obj.sig_m_t UMR_NM__1_1_0_S6_S3 10 -400 1640 DEPOSIT ABSOLUTE MONOTONY MON_INCREASE /end AXIS_DESCR
/end CHARACTERISTIC
/begin CHARACTERISTIC PO_HKAB45 "Druckoffset waehrend Haltephase k_ab" VALUE 0x26DDDE kw_si16_S6_S3 12.75 UMR_BAR__1_1000_0_S6_S3 0 12.75 /end CHARACTERISTIC
/begin CHARACTERISTIC TO_HKAB45 "Zeit fuer Druckoffset waehrend Haltephase k_ab" VALUE 0x26E737 kw_ui8_S6_S3 1000 UMR_MSEC__10_1_0_S6_S3 0 1000 /end CHARACTERISTIC
/begin CHARACTERISTIC PS_ABBSYNISTHS45 "Schwellwert Abbruch einer HS bevor sync istgang verlassen" VALUE 0x26DDE0 kw_si16_S6_S3 22 UMR_BAR__1_1000_0_S6_S3 0 22 /end CHARACTERISTIC
/begin CHARACTERISTIC KL_PGOMTKAB45 "Gradientenoffset fuer Schaltdruckphase bei HS" CURVE 0x242AD0 kl_si16_S6_S3 100 UMR_BAR_SEC_1_10_0_S6_S3 -100 0
 /begin AXIS_DESCR STD_AXIS zff_atsys._.iSignale._.obj.sig_m_t UMR_NM__1_1_0_S6_S3 4 -400 1640 DEPOSIT ABSOLUTE MONOTONY MON_INCREASE /end AXIS_DESCR
/end CHARACTERISTIC
/begin CHARACTERISTIC T_SYNKABE56 "Zeit vor sync. Ende Schaltdruck KAB" VALUE 0x26DDE2 kw_si16_S6_S3 5000 UMR_MSEC__10_1_0_S6_S3 -5000 0 /end CHARACTERISTIC
/begin CHARACTERISTIC KF_PKAB56 "Schaltdruck abschaltende Kupplung" MAP 0x242AE4 kf_si16_S6_S3 12.75 UMR_BAR__1_1000_0_S6_S3 0 12.75
 /begin AXIS_DESCR STD_AXIS iSasZentr.iSchaltend.n_tkf UMR_U_MIN_32_1_0_S6_S3 8 0 8160 DEPOSIT ABSOLUTE MONOTONY MON_INCREASE /end AXIS_DESCR
 /begin AXIS_DESCR STD_AXIS zff_atsys._.iSignale._.obj.sig_m_t UMR_NM__1_1_0_S6_S3 10 -400 1640 DEPOSIT ABSOLUTE MONOTONY MON_INCREASE /end AXIS_DESCR
/end CHARACTERISTIC
/begin CHARACTERISTIC KF_PKAB56_EL "Schaltdruck abschaltende Kupplung" MAP 0x242BB0 kf_si16_S6_S3 12.75 UMR_BAR__1_1000_0_S6_S3 0 12.75
 /begin AXIS_DESCR STD_AXIS iSasZentr.iSchaltend.n_tkf UMR_U_MIN_32_1_0_S6_S3 8 0 8160 DEPOSIT ABSOLUTE MONOTONY MON_INCREASE /end AXIS_DESCR
 /begin AXIS_DESCR STD_AXIS zff_atsys._.iSignale._.obj.sig_m_t UMR_NM__1_1_0_S6_S3 10 -400 1640 DEPOSIT ABSOLUTE MONOTONY MON_INCREASE /end AXIS_DESCR
/end CHARACTERISTIC
/begin CHARACTERISTIC PO_HKAB56 "Druckoffset waehrend Haltephase k_ab" VALUE 0x26DDE4 kw_si16_S6_S3 12.75 UMR_BAR__1_1000_0_S6_S3 0 12.75 /end CHARACTERISTIC
/begin CHARACTERISTIC TO_HKAB56 "Zeit fuer Druckoffset waehrend Haltephase k_ab" VALUE 0x26E738 kw_ui8_S6_S3 1000 UMR_MSEC__10_1_0_S6_S3 0 1000 /end CHARACTERISTIC
/begin CHARACTERISTIC PS_ABBSYNISTHS56 "Schwellwert Abbruch einer HS bevor sync istgang verlassen" VALUE 0x26DDE6 kw_si16_S6_S3 22 UMR_BAR__1_1000_0_S6_S3 0 22 /end CHARACTERISTIC
/begin CHARACTERISTIC KL_PGOMTKAB56 "Gradientenoffset fuer Schaltdruckphase bei HS" CURVE 0x242C7C kl_si16_S6_S3 100 UMR_BAR_SEC_1_10_0_S6_S3 -100 0
 /begin AXIS_DESCR STD_AXIS zff_atsys._.iSignale._.obj.sig_m_t UMR_NM__1_1_0_S6_S3 4 -400 1640 DEPOSIT ABSOLUTE MONOTONY MON_INCREASE /end AXIS_DESCR
/end CHARACTERISTIC
/begin CHARACTERISTIC T_SYNKABE67 "Zeit vor sync. Ende Schaltdruck KAB" VALUE 0x26DDE8 kw_si16_S6_S3 5000 UMR_MSEC__10_1_0_S6_S3 -5000 0 /end CHARACTERISTIC
/begin CHARACTERISTIC KF_PKAB67 "Schaltdruck abschaltende Kupplung" MAP 0x242C90 kf_si16_S6_S3 12.75 UMR_BAR__1_1000_0_S6_S3 0 12.75
 /begin AXIS_DESCR STD_AXIS iSasZentr.iSchaltend.n_tkf UMR_U_MIN_32_1_0_S6_S3 8 0 8160 DEPOSIT ABSOLUTE MONOTONY MON_INCREASE /end AXIS_DESCR
 /begin AXIS_DESCR STD_AXIS zff_atsys._.iSignale._.obj.sig_m_t UMR_NM__1_1_0_S6_S3 10 -400 1640 DEPOSIT ABSOLUTE MONOTONY MON_INCREASE /end AXIS_DESCR
/end CHARACTERISTIC
/begin CHARACTERISTIC KF_PKAB67_EL "Schaltdruck abschaltende Kupplung" MAP 0x242D5C kf_si16_S6_S3 12.75 UMR_BAR__1_1000_0_S6_S3 0 12.75
 /begin AXIS_DESCR STD_AXIS iSasZentr.iSchaltend.n_tkf UMR_U_MIN_32_1_0_S6_S3 8 0 8160 DEPOSIT ABSOLUTE MONOTONY MON_INCREASE /end AXIS_DESCR
 /begin AXIS_DESCR STD_AXIS zff_atsys._.iSignale._.obj.sig_m_t UMR_NM__1_1_0_S6_S3 10 -400 1640 DEPOSIT ABSOLUTE MONOTONY MON_INCREASE /end AXIS_DESCR
/end CHARACTERISTIC
/begin CHARACTERISTIC PO_HKAB67 "Druckoffset waehrend Haltephase k_ab" VALUE 0x26DDEA kw_si16_S6_S3 12.75 UMR_BAR__1_1000_0_S6_S3 0 12.75 /end CHARACTERISTIC
/begin CHARACTERISTIC TO_HKAB67 "Zeit fuer Druckoffset waehrend Haltephase k_ab" VALUE 0x26E739 kw_ui8_S6_S3 1000 UMR_MSEC__10_1_0_S6_S3 0 1000 /end CHARACTERISTIC
/begin CHARACTERISTIC PS_ABBSYNISTHS67 "Schwellwert Abbruch einer HS bevor sync istgang verlassen" VALUE 0x26DDEC kw_si16_S6_S3 22 UMR_BAR__1_1000_0_S6_S3 0 22 /end CHARACTERISTIC
/begin CHARACTERISTIC KL_PGOMTKAB67 "Gradientenoffset fuer Schaltdruckphase bei HS" CURVE 0x242E28 kl_si16_S6_S3 100 UMR_BAR_SEC_1_10_0_S6_S3 -100 0
 /begin AXIS_DESCR STD_AXIS zff_atsys._.iSignale._.obj.sig_m_t UMR_NM__1_1_0_S6_S3 4 -400 1640 DEPOSIT ABSOLUTE MONOTONY MON_INCREASE /end AXIS_DESCR
/end CHARACTERISTIC
/begin CHARACTERISTIC T_SYNKABE78 "Zeit vor sync. Ende Schaltdruck KAB" VALUE 0x26DDEE kw_si16_S6_S3 5000 UMR_MSEC__10_1_0_S6_S3 -5000 0 /end CHARACTERISTIC
/begin CHARACTERISTIC KF_PKAB78 "Schaltdruck abschaltende Kupplung" MAP 0x242E3C kf_si16_S6_S3 12.75 UMR_BAR__1_1000_0_S6_S3 0 12.75
 /begin AXIS_DESCR STD_AXIS iSasZentr.iSchaltend.n_tkf UMR_U_MIN_32_1_0_S6_S3 8 0 8160 DEPOSIT ABSOLUTE MONOTONY MON_INCREASE /end AXIS_DESCR
 /begin AXIS_DESCR STD_AXIS zff_atsys._.iSignale._.obj.sig_m_t UMR_NM__1_1_0_S6_S3 10 -400 1640 DEPOSIT ABSOLUTE MONOTONY MON_INCREASE /end AXIS_DESCR
/end CHARACTERISTIC
/begin CHARACTERISTIC KF_PKAB78_EL "Schaltdruck abschaltende Kupplung" MAP 0x242F08 kf_si16_S6_S3 12.75 UMR_BAR__1_1000_0_S6_S3 0 12.75
 /begin AXIS_DESCR STD_AXIS iSasZentr.iSchaltend.n_tkf UMR_U_MIN_32_1_0_S6_S3 8 0 8160 DEPOSIT ABSOLUTE MONOTONY MON_INCREASE /end AXIS_DESCR
 /begin AXIS_DESCR STD_AXIS zff_atsys._.iSignale._.obj.sig_m_t UMR_NM__1_1_0_S6_S3 10 -400 1640 DEPOSIT ABSOLUTE MONOTONY MON_INCREASE /end AXIS_DESCR
/end CHARACTERISTIC
/begin CHARACTERISTIC PO_HKAB78 "Druckoffset waehrend Haltephase k_ab" VALUE 0x26DDF0 kw_si16_S6_S3 12.75 UMR_BAR__1_1000_0_S6_S3 0 12.75 /end CHARACTERISTIC
/begin CHARACTERISTIC TO_HKAB78 "Zeit fuer Druckoffset waehrend Haltephase k_ab" VALUE 0x26E73A kw_ui8_S6_S3 1000 UMR_MSEC__10_1_0_S6_S3 0 1000 /end CHARACTERISTIC
/begin CHARACTERISTIC PS_ABBSYNISTHS78 "Schwellwert Abbruch einer HS bevor sync istgang verlassen" VALUE 0x26DDF2 kw_si16_S6_S3 22 UMR_BAR__1_1000_0_S6_S3 0 22 /end CHARACTERISTIC
/begin CHARACTERISTIC KL_PGOMTKAB78 "Gradientenoffset fuer Schaltdruckphase bei HS" CURVE 0x242FD4 kl_si16_S6_S3 100 UMR_BAR_SEC_1_10_0_S6_S3 -100 0
 /begin AXIS_DESCR STD_AXIS zff_atsys._.iSignale._.obj.sig_m_t UMR_NM__1_1_0_S6_S3 4 -400 1640 DEPOSIT ABSOLUTE MONOTONY MON_INCREASE /end AXIS_DESCR
/end CHARACTERISTIC
/begin CHARACTERISTIC T_SYNKABE13 "Zeit vor sync. Ende Schaltdruck KAB" VALUE 0x26DDF4 kw_si16_S6_S3 5000 UMR_MSEC__10_1_0_S6_S3 -5000 0 /end CHARACTERISTIC
/begin CHARACTERISTIC KF_PKAB13 "Schaltdruck abschaltende Kupplung" MAP 0x242FE8 kf_si16_S6_S3 12.75 UMR_BAR__1_1000_0_S6_S3 0 12.75
 /begin AXIS_DESCR STD_AXIS iSasZentr.iSchaltend.n_tkf UMR_U_MIN_32_1_0_S6_S3 8 0 8160 DEPOSIT ABSOLUTE MONOTONY MON_INCREASE /end AXIS_DESCR
 /begin AXIS_DESCR STD_AXIS zff_atsys._.iSignale._.obj.sig_m_t UMR_NM__1_1_0_S6_S3 10 -400 1640 DEPOSIT ABSOLUTE MONOTONY MON_INCREASE /end AXIS_DESCR
/end CHARACTERISTIC
/begin CHARACTERISTIC PO_HKAB13 "Druckoffset waehrend Haltephase k_ab" VALUE 0x26DDF6 kw_si16_S6_S3 12.75 UMR_BAR__1_1000_0_S6_S3 0 12.75 /end CHARACTERISTIC
/begin CHARACTERISTIC TO_HKAB13 "Zeit fuer Druckoffset waehrend Haltephase k_ab" VALUE 0x26E73B kw_ui8_S6_S3 1000 UMR_MSEC__10_1_0_S6_S3 0 1000 /end CHARACTERISTIC
/begin CHARACTERISTIC PS_ABBSYNISTHS13 "Schwellwert Abbruch einer HS bevor sync istgang verlassen" VALUE 0x26DDF8 kw_si16_S6_S3 22 UMR_BAR__1_1000_0_S6_S3 0 22 /end CHARACTERISTIC
/begin CHARACTERISTIC KL_PGOMTKAB13 "Gradientenoffset fuer Schaltdruckphase bei HS" CURVE 0x2430B4 kl_si16_S6_S3 100 UMR_BAR_SEC_1_10_0_S6_S3 -100 0
 /begin AXIS_DESCR STD_AXIS zff_atsys._.iSignale._.obj.sig_m_t UMR_NM__1_1_0_S6_S3 4 -400 1640 DEPOSIT ABSOLUTE MONOTONY MON_INCREASE /end AXIS_DESCR
/end CHARACTERISTIC
/begin CHARACTERISTIC T_SYNKABE24 "Zeit vor sync. Ende Schaltdruck KAB" VALUE 0x26DDFA kw_si16_S6_S3 5000 UMR_MSEC__10_1_0_S6_S3 -5000 0 /end CHARACTERISTIC
/begin CHARACTERISTIC KF_PKAB24 "Schaltdruck abschaltende Kupplung" MAP 0x2430C8 kf_si16_S6_S3 12.75 UMR_BAR__1_1000_0_S6_S3 0 12.75
 /begin AXIS_DESCR STD_AXIS iSasZentr.iSchaltend.n_tkf UMR_U_MIN_32_1_0_S6_S3 8 0 8160 DEPOSIT ABSOLUTE MONOTONY MON_INCREASE /end AXIS_DESCR
 /begin AXIS_DESCR STD_AXIS zff_atsys._.iSignale._.obj.sig_m_t UMR_NM__1_1_0_S6_S3 10 -400 1640 DEPOSIT ABSOLUTE MONOTONY MON_INCREASE /end AXIS_DESCR
/end CHARACTERISTIC
/begin CHARACTERISTIC PO_HKAB24 "Druckoffset waehrend Haltephase k_ab" VALUE 0x26DDFC kw_si16_S6_S3 12.75 UMR_BAR__1_1000_0_S6_S3 0 12.75 /end CHARACTERISTIC
/begin CHARACTERISTIC TO_HKAB24 "Zeit fuer Druckoffset waehrend Haltephase k_ab" VALUE 0x26E73C kw_ui8_S6_S3 1000 UMR_MSEC__10_1_0_S6_S3 0 1000 /end CHARACTERISTIC
/begin CHARACTERISTIC PS_ABBSYNISTHS24 "Schwellwert Abbruch einer HS bevor sync istgang verlassen" VALUE 0x26DDFE kw_si16_S6_S3 22 UMR_BAR__1_1000_0_S6_S3 0 22 /end CHARACTERISTIC
/begin CHARACTERISTIC KL_PGOMTKAB24 "Gradientenoffset fuer Schaltdruckphase bei HS" CURVE 0x243194 kl_si16_S6_S3 100 UMR_BAR_SEC_1_10_0_S6_S3 -100 0
 /begin AXIS_DESCR STD_AXIS zff_atsys._.iSignale._.obj.sig_m_t UMR_NM__1_1_0_S6_S3 4 -400 1640 DEPOSIT ABSOLUTE MONOTONY MON_INCREASE /end AXIS_DESCR
/end CHARACTERISTIC
/begin CHARACTERISTIC T_SYNKABE35 "Zeit vor sync. Ende Schaltdruck KAB" VALUE 0x26DE00 kw_si16_S6_S3 5000 UMR_MSEC__10_1_0_S6_S3 -5000 0 /end CHARACTERISTIC
/begin CHARACTERISTIC KF_PKAB35 "Schaltdruck abschaltende Kupplung" MAP 0x2431A8 kf_si16_S6_S3 12.75 UMR_BAR__1_1000_0_S6_S3 0 12.75
 /begin AXIS_DESCR STD_AXIS iSasZentr.iSchaltend.n_tkf UMR_U_MIN_32_1_0_S6_S3 8 0 8160 DEPOSIT ABSOLUTE MONOTONY MON_INCREASE /end AXIS_DESCR
 /begin AXIS_DESCR STD_AXIS zff_atsys._.iSignale._.obj.sig_m_t UMR_NM__1_1_0_S6_S3 10 -400 1640 DEPOSIT ABSOLUTE MONOTONY MON_INCREASE /end AXIS_DESCR
/end CHARACTERISTIC
/begin CHARACTERISTIC PO_HKAB35 "Druckoffset waehrend Haltephase k_ab" VALUE 0x26DE02 kw_si16_S6_S3 12.75 UMR_BAR__1_1000_0_S6_S3 0 12.75 /end CHARACTERISTIC
/begin CHARACTERISTIC TO_HKAB35 "Zeit fuer Druckoffset waehrend Haltephase k_ab" VALUE 0x26E73D kw_ui8_S6_S3 1000 UMR_MSEC__10_1_0_S6_S3 0 1000 /end CHARACTERISTIC
/begin CHARACTERISTIC PS_ABBSYNISTHS35 "Schwellwert Abbruch einer HS bevor sync istgang verlassen" VALUE 0x26DE04 kw_si16_S6_S3 22 UMR_BAR__1_1000_0_S6_S3 0 22 /end CHARACTERISTIC
/begin CHARACTERISTIC KL_PGOMTKAB35 "Gradientenoffset fuer Schaltdruckphase bei HS" CURVE 0x243274 kl_si16_S6_S3 100 UMR_BAR_SEC_1_10_0_S6_S3 -100 0
 /begin AXIS_DESCR STD_AXIS zff_atsys._.iSignale._.obj.sig_m_t UMR_NM__1_1_0_S6_S3 4 -400 1640 DEPOSIT ABSOLUTE MONOTONY MON_INCREASE /end AXIS_DESCR
/end CHARACTERISTIC
/begin CHARACTERISTIC T_SYNKABE46 "Zeit vor sync. Ende Schaltdruck KAB" VALUE 0x26DE06 kw_si16_S6_S3 5000 UMR_MSEC__10_1_0_S6_S3 -5000 0 /end CHARACTERISTIC
/begin CHARACTERISTIC KF_PKAB46 "Schaltdruck abschaltende Kupplung" MAP 0x243288 kf_si16_S6_S3 12.75 UMR_BAR__1_1000_0_S6_S3 0 12.75
 /begin AXIS_DESCR STD_AXIS iSasZentr.iSchaltend.n_tkf UMR_U_MIN_32_1_0_S6_S3 8 0 8160 DEPOSIT ABSOLUTE MONOTONY MON_INCREASE /end AXIS_DESCR
 /begin AXIS_DESCR STD_AXIS zff_atsys._.iSignale._.obj.sig_m_t UMR_NM__1_1_0_S6_S3 10 -400 1640 DEPOSIT ABSOLUTE MONOTONY MON_INCREASE /end AXIS_DESCR
/end CHARACTERISTIC
/begin CHARACTERISTIC PO_HKAB46 "Druckoffset waehrend Haltephase k_ab" VALUE 0x26DE08 kw_si16_S6_S3 12.75 UMR_BAR__1_1000_0_S6_S3 0 12.75 /end CHARACTERISTIC
/begin CHARACTERISTIC TO_HKAB46 "Zeit fuer Druckoffset waehrend Haltephase k_ab" VALUE 0x26E73E kw_ui8_S6_S3 1000 UMR_MSEC__10_1_0_S6_S3 0 1000 /end CHARACTERISTIC
/begin CHARACTERISTIC PS_ABBSYNISTHS46 "Schwellwert Abbruch einer HS bevor sync istgang verlassen" VALUE 0x26DE0A kw_si16_S6_S3 22 UMR_BAR__1_1000_0_S6_S3 0 22 /end CHARACTERISTIC
/begin CHARACTERISTIC KL_PGOMTKAB46 "Gradientenoffset fuer Schaltdruckphase bei HS" CURVE 0x243354 kl_si16_S6_S3 100 UMR_BAR_SEC_1_10_0_S6_S3 -100 0
 /begin AXIS_DESCR STD_AXIS zff_atsys._.iSignale._.obj.sig_m_t UMR_NM__1_1_0_S6_S3 4 -400 1640 DEPOSIT ABSOLUTE MONOTONY MON_INCREASE /end AXIS_DESCR
/end CHARACTERISTIC
/begin CHARACTERISTIC T_SYNKABE57 "Zeit vor sync. Ende Schaltdruck KAB" VALUE 0x26DE0C kw_si16_S6_S3 5000 UMR_MSEC__10_1_0_S6_S3 -5000 0 /end CHARACTERISTIC
/begin CHARACTERISTIC KF_PKAB57 "Schaltdruck abschaltende Kupplung" MAP 0x243368 kf_si16_S6_S3 12.75 UMR_BAR__1_1000_0_S6_S3 0 12.75
 /begin AXIS_DESCR STD_AXIS iSasZentr.iSchaltend.n_tkf UMR_U_MIN_32_1_0_S6_S3 8 0 8160 DEPOSIT ABSOLUTE MONOTONY MON_INCREASE /end AXIS_DESCR
 /begin AXIS_DESCR STD_AXIS zff_atsys._.iSignale._.obj.sig_m_t UMR_NM__1_1_0_S6_S3 10 -400 1640 DEPOSIT ABSOLUTE MONOTONY MON_INCREASE /end AXIS_DESCR
/end CHARACTERISTIC
/begin CHARACTERISTIC PO_HKAB57 "Druckoffset waehrend Haltephase k_ab" VALUE 0x26DE0E kw_si16_S6_S3 12.75 UMR_BAR__1_1000_0_S6_S3 0 12.75 /end CHARACTERISTIC
/begin CHARACTERISTIC TO_HKAB57 "Zeit fuer Druckoffset waehrend Haltephase k_ab" VALUE 0x26E73F kw_ui8_S6_S3 1000 UMR_MSEC__10_1_0_S6_S3 0 1000 /end CHARACTERISTIC
/begin CHARACTERISTIC PS_ABBSYNISTHS57 "Schwellwert Abbruch einer HS bevor sync istgang verlassen" VALUE 0x26DE10 kw_si16_S6_S3 22 UMR_BAR__1_1000_0_S6_S3 0 22 /end CHARACTERISTIC
/begin CHARACTERISTIC KL_PGOMTKAB57 "Gradientenoffset fuer Schaltdruckphase bei HS" CURVE 0x243434 kl_si16_S6_S3 100 UMR_BAR_SEC_1_10_0_S6_S3 -100 0
 /begin AXIS_DESCR STD_AXIS zff_atsys._.iSignale._.obj.sig_m_t UMR_NM__1_1_0_S6_S3 4 -400 1640 DEPOSIT ABSOLUTE MONOTONY MON_INCREASE /end AXIS_DESCR
/end CHARACTERISTIC
/begin CHARACTERISTIC T_SYNKABE68 "Zeit vor sync. Ende Schaltdruck KAB" VALUE 0x26DE12 kw_si16_S6_S3 5000 UMR_MSEC__10_1_0_S6_S3 -5000 0 /end CHARACTERISTIC
/begin CHARACTERISTIC KF_PKAB68 "Schaltdruck abschaltende Kupplung" MAP 0x243448 kf_si16_S6_S3 12.75 UMR_BAR__1_1000_0_S6_S3 0 12.75
 /begin AXIS_DESCR STD_AXIS iSasZentr.iSchaltend.n_tkf UMR_U_MIN_32_1_0_S6_S3 8 0 8160 DEPOSIT ABSOLUTE MONOTONY MON_INCREASE /end AXIS_DESCR
 /begin AXIS_DESCR STD_AXIS zff_atsys._.iSignale._.obj.sig_m_t UMR_NM__1_1_0_S6_S3 10 -400 1640 DEPOSIT ABSOLUTE MONOTONY MON_INCREASE /end AXIS_DESCR
/end CHARACTERISTIC
/begin CHARACTERISTIC PO_HKAB68 "Druckoffset waehrend Haltephase k_ab" VALUE 0x26DE14 kw_si16_S6_S3 12.75 UMR_BAR__1_1000_0_S6_S3 0 12.75 /end CHARACTERISTIC
/begin CHARACTERISTIC TO_HKAB68 "Zeit fuer Druckoffset waehrend Haltephase k_ab" VALUE 0x26E740 kw_ui8_S6_S3 1000 UMR_MSEC__10_1_0_S6_S3 0 1000 /end CHARACTERISTIC
/begin CHARACTERISTIC PS_ABBSYNISTHS68 "Schwellwert Abbruch einer HS bevor sync istgang verlassen" VALUE 0x26DE16 kw_si16_S6_S3 22 UMR_BAR__1_1000_0_S6_S3 0 22 /end CHARACTERISTIC
/begin CHARACTERISTIC KL_PGOMTKAB68 "Gradientenoffset fuer Schaltdruckphase bei HS" CURVE 0x243514 kl_si16_S6_S3 100 UMR_BAR_SEC_1_10_0_S6_S3 -100 0
 /begin AXIS_DESCR STD_AXIS zff_atsys._.iSignale._.obj.sig_m_t UMR_NM__1_1_0_S6_S3 4 -400 1640 DEPOSIT ABSOLUTE MONOTONY MON_INCREASE /end AXIS_DESCR
/end CHARACTERISTIC
/begin CHARACTERISTIC T_VKABHS12 "Verzögerungszeit abschaltende Kupplung bei HS" VALUE 0x26E70D kw_ui8_S6_S3 2000 UMR_MSEC__10_1_0_S6_S3 0 2000 /end CHARACTERISTIC
/begin CHARACTERISTIC KF_TPKABMTCG12 "Zeitoffset Ende Rampe auf Schaltdruck KAB fuer HS" MAP 0x23F7A4 kf_ui8_S6_S3 2000 UMR_MSEC__10_1_M128_S6_S3 -1000 1000
 /begin AXIS_DESCR STD_AXIS zff_atsys._.iSignale._.obj.sig_m_t8 UMR_NM__8_1_M50_S6_S3 8 -400 1640 DEPOSIT ABSOLUTE MONOTONY MON_INCREASE /end AXIS_DESCR
 /begin AXIS_DESCR STD_AXIS zff_atsys._.iSignale._.obj.sig_c_getr UMR_GRADC__1_1_M40_S6_S3 8 -40 150 DEPOSIT ABSOLUTE MONOTONY MON_INCREASE /end AXIS_DESCR
/end CHARACTERISTIC
/begin CHARACTERISTIC KF_TPKABMTCG12_EL "Zeitoffset Ende Rampe auf Schaltdruck KAB fuer HS" MAP 0x23F7FC kf_ui8_S6_S3 2000 UMR_MSEC__10_1_M128_S6_S3 -1000 1000
 /begin AXIS_DESCR STD_AXIS zff_atsys._.iSignale._.obj.sig_m_t8 UMR_NM__8_1_M50_S6_S3 8 -400 1640 DEPOSIT ABSOLUTE MONOTONY MON_INCREASE /end AXIS_DESCR
 /begin AXIS_DESCR STD_AXIS zff_atsys._.iSignale._.obj.sig_c_getr UMR_GRADC__1_1_M40_S6_S3 8 -40 150 DEPOSIT ABSOLUTE MONOTONY MON_INCREASE /end AXIS_DESCR
/end CHARACTERISTIC
/begin CHARACTERISTIC KL_TOPKABND12 "Zeitoffset f(nd_synistgang) Ende Rampe auf Schaltdruck KAB fuer HS" CURVE 0x23F854 kl_si16_S6_S3 1000 UMR_MSEC__10_1_0_S6_S3 0 1000
 /begin AXIS_DESCR STD_AXIS iSasZentr.iSchaltend.nd_synistgang UMR_U_MIN_1_1_0_S6_S3 4 -8000 8000 DEPOSIT ABSOLUTE MONOTONY MON_INCREASE /end AXIS_DESCR
/end CHARACTERISTIC
/begin CHARACTERISTIC KL_TOPKABND12_EL "Zeitoffset f(nd_synistgang) Ende Rampe auf Schaltdruck KAB fuer HS" CURVE 0x23F868 kl_si16_S6_S3 1000 UMR_MSEC__10_1_0_S6_S3 0 1000
 /begin AXIS_DESCR STD_AXIS iSasZentr.iSchaltend.nd_synistgang UMR_U_MIN_1_1_0_S6_S3 4 -8000 8000 DEPOSIT ABSOLUTE MONOTONY MON_INCREASE /end AXIS_DESCR
/end CHARACTERISTIC
/begin CHARACTERISTIC KL_PHKABMT12 "Haltedruck abschaltende Kupplung bei HS" CURVE 0x23F87C kl_si16_S6_S3 22 UMR_BAR__1_1000_0_S6_S3 0 22
 /begin AXIS_DESCR STD_AXIS zff_atsys._.iSignale._.obj.sig_m_t UMR_NM__1_1_0_S6_S3 8 -400 1640 DEPOSIT ABSOLUTE MONOTONY MON_INCREASE /end AXIS_DESCR
/end CHARACTERISTIC
/begin CHARACTERISTIC KL_PHKABMT12_EL "Haltedruck abschaltende Kupplung bei HS" CURVE 0x23F8A0 kl_si16_S6_S3 22 UMR_BAR__1_1000_0_S6_S3 0 22
 /begin AXIS_DESCR STD_AXIS zff_atsys._.iSignale._.obj.sig_m_t UMR_NM__1_1_0_S6_S3 8 -400 1640 DEPOSIT ABSOLUTE MONOTONY MON_INCREASE /end AXIS_DESCR
/end CHARACTERISTIC
/begin CHARACTERISTIC KF_THKABMTCG12 "Zeitoffset Ende Haltephase KAB fuer HS" MAP 0x23F8C4 kf_ui8_S6_S3 2000 UMR_MSEC__10_1_M128_S6_S3 -1000 1000
 /begin AXIS_DESCR STD_AXIS zff_atsys._.iSignale._.obj.sig_m_t8 UMR_NM__8_1_M50_S6_S3 8 -400 1640 DEPOSIT ABSOLUTE MONOTONY MON_INCREASE /end AXIS_DESCR
 /begin AXIS_DESCR STD_AXIS zff_atsys._.iSignale._.obj.sig_c_getr UMR_GRADC__1_1_M40_S6_S3 8 -40 150 DEPOSIT ABSOLUTE MONOTONY MON_INCREASE /end AXIS_DESCR
/end CHARACTERISTIC
/begin CHARACTERISTIC KF_THKABMTCG12_EL "Zeitoffset Ende Haltephase KAB fuer HS" MAP 0x23F91C kf_ui8_S6_S3 2000 UMR_MSEC__10_1_M128_S6_S3 -1000 1000
 /begin AXIS_DESCR STD_AXIS zff_atsys._.iSignale._.obj.sig_m_t8 UMR_NM__8_1_M50_S6_S3 8 -400 1640 DEPOSIT ABSOLUTE MONOTONY MON_INCREASE /end AXIS_DESCR
 /begin AXIS_DESCR STD_AXIS zff_atsys._.iSignale._.obj.sig_c_getr UMR_GRADC__1_1_M40_S6_S3 8 -40 150 DEPOSIT ABSOLUTE MONOTONY MON_INCREASE /end AXIS_DESCR
/end CHARACTERISTIC
/begin CHARACTERISTIC KL_POKABCG12 "Temp. abhängiger Druckoffset auf Schaltdruck KAB fuer HS" CURVE 0x23F974 kl_si16_S6_S3 2.5 UMR_BAR__1_1000_0_S6_S3 -1.25 1.25
 /begin AXIS_DESCR STD_AXIS zff_atsys._.iSignale._.obj.sig_c_getr UMR_GRADC__1_1_M40_S6_S3 3 -40 150 DEPOSIT ABSOLUTE MONOTONY MON_INCREASE /end AXIS_DESCR
/end CHARACTERISTIC
/begin CHARACTERISTIC KL_POKABCG12_EL "Temp. abhängiger Druckoffset auf Schaltdruck KAB fuer HS" CURVE 0x23F984 kl_si16_S6_S3 2.5 UMR_BAR__1_1000_0_S6_S3 -1.25 1.25
 /begin AXIS_DESCR STD_AXIS zff_atsys._.iSignale._.obj.sig_c_getr UMR_GRADC__1_1_M40_S6_S3 3 -40 150 DEPOSIT ABSOLUTE MONOTONY MON_INCREASE /end AXIS_DESCR
/end CHARACTERISTIC
/begin CHARACTERISTIC T_VKABHS23 "Verzögerungszeit abschaltende Kupplung bei HS" VALUE 0x26E70E kw_ui8_S6_S3 2000 UMR_MSEC__10_1_0_S6_S3 0 2000 /end CHARACTERISTIC
/begin CHARACTERISTIC KF_TPKABMTCG23 "Zeitoffset Ende Rampe auf Schaltdruck KAB fuer HS" MAP 0x23F994 kf_ui8_S6_S3 2000 UMR_MSEC__10_1_M128_S6_S3 -1000 1000
 /begin AXIS_DESCR STD_AXIS zff_atsys._.iSignale._.obj.sig_m_t8 UMR_NM__8_1_M50_S6_S3 8 -400 1640 DEPOSIT ABSOLUTE MONOTONY MON_INCREASE /end AXIS_DESCR
 /begin AXIS_DESCR STD_AXIS zff_atsys._.iSignale._.obj.sig_c_getr UMR_GRADC__1_1_M40_S6_S3 8 -40 150 DEPOSIT ABSOLUTE MONOTONY MON_INCREASE /end AXIS_DESCR
/end CHARACTERISTIC
/begin CHARACTERISTIC KF_TPKABMTCG23_EL "Zeitoffset Ende Rampe auf Schaltdruck KAB fuer HS" MAP 0x23F9EC kf_ui8_S6_S3 2000 UMR_MSEC__10_1_M128_S6_S3 -1000 1000
 /begin AXIS_DESCR STD_AXIS zff_atsys._.iSignale._.obj.sig_m_t8 UMR_NM__8_1_M50_S6_S3 8 -400 1640 DEPOSIT ABSOLUTE MONOTONY MON_INCREASE /end AXIS_DESCR
 /begin AXIS_DESCR STD_AXIS zff_atsys._.iSignale._.obj.sig_c_getr UMR_GRADC__1_1_M40_S6_S3 8 -40 150 DEPOSIT ABSOLUTE MONOTONY MON_INCREASE /end AXIS_DESCR
/end CHARACTERISTIC
/begin CHARACTERISTIC KL_TOPKABND23 "Zeitoffset f(nd_synistgang) Ende Rampe auf Schaltdruck KAB fuer HS" CURVE 0x23FA44 kl_si16_S6_S3 1000 UMR_MSEC__10_1_0_S6_S3 0 1000
 /begin AXIS_DESCR STD_AXIS iSasZentr.iSchaltend.nd_synistgang UMR_U_MIN_1_1_0_S6_S3 4 -8000 8000 DEPOSIT ABSOLUTE MONOTONY MON_INCREASE /end AXIS_DESCR
/end CHARACTERISTIC
/begin CHARACTERISTIC KL_TOPKABND23_EL "Zeitoffset f(nd_synistgang) Ende Rampe auf Schaltdruck KAB fuer HS" CURVE 0x23FA58 kl_si16_S6_S3 1000 UMR_MSEC__10_1_0_S6_S3 0 1000
 /begin AXIS_DESCR STD_AXIS iSasZentr.iSchaltend.nd_synistgang UMR_U_MIN_1_1_0_S6_S3 4 -8000 8000 DEPOSIT ABSOLUTE MONOTONY MON_INCREASE /end AXIS_DESCR
/end CHARACTERISTIC
/begin CHARACTERISTIC KL_PHKABMT23 "Haltedruck abschaltende Kupplung bei HS" CURVE 0x23FA6C kl_si16_S6_S3 22 UMR_BAR__1_1000_0_S6_S3 0 22
 /begin AXIS_DESCR STD_AXIS zff_atsys._.iSignale._.obj.sig_m_t UMR_NM__1_1_0_S6_S3 8 -400 1640 DEPOSIT ABSOLUTE MONOTONY MON_INCREASE /end AXIS_DESCR
/end CHARACTERISTIC
/begin CHARACTERISTIC KL_PHKABMT23_EL "Haltedruck abschaltende Kupplung bei HS" CURVE 0x23FA90 kl_si16_S6_S3 22 UMR_BAR__1_1000_0_S6_S3 0 22
 /begin AXIS_DESCR STD_AXIS zff_atsys._.iSignale._.obj.sig_m_t UMR_NM__1_1_0_S6_S3 8 -400 1640 DEPOSIT ABSOLUTE MONOTONY MON_INCREASE /end AXIS_DESCR
/end CHARACTERISTIC
/begin CHARACTERISTIC KF_THKABMTCG23 "Zeitoffset Ende Haltephase KAB fuer HS" MAP 0x23FAB4 kf_ui8_S6_S3 2000 UMR_MSEC__10_1_M128_S6_S3 -1000 1000
 /begin AXIS_DESCR STD_AXIS zff_atsys._.iSignale._.obj.sig_m_t8 UMR_NM__8_1_M50_S6_S3 8 -400 1640 DEPOSIT ABSOLUTE MONOTONY MON_INCREASE /end AXIS_DESCR
 /begin AXIS_DESCR STD_AXIS zff_atsys._.iSignale._.obj.sig_c_getr UMR_GRADC__1_1_M40_S6_S3 8 -40 150 DEPOSIT ABSOLUTE MONOTONY MON_INCREASE /end AXIS_DESCR
/end CHARACTERISTIC
/begin CHARACTERISTIC KF_THKABMTCG23_EL "Zeitoffset Ende Haltephase KAB fuer HS" MAP 0x23FB0C kf_ui8_S6_S3 2000 UMR_MSEC__10_1_M128_S6_S3 -1000 1000
 /begin AXIS_DESCR STD_AXIS zff_atsys._.iSignale._.obj.sig_m_t8 UMR_NM__8_1_M50_S6_S3 8 -400 1640 DEPOSIT ABSOLUTE MONOTONY MON_INCREASE /end AXIS_DESCR
 /begin AXIS_DESCR STD_AXIS zff_atsys._.iSignale._.obj.sig_c_getr UMR_GRADC__1_1_M40_S6_S3 8 -40 150 DEPOSIT ABSOLUTE MONOTONY MON_INCREASE /end AXIS_DESCR
/end CHARACTERISTIC
/begin CHARACTERISTIC KL_POKABCG23 "Temp. abhängiger Druckoffset auf Schaltdruck KAB fuer HS" CURVE 0x23FB64 kl_si16_S6_S3 2.5 UMR_BAR__1_1000_0_S6_S3 -1.25 1.25
 /begin AXIS_DESCR STD_AXIS zff_atsys._.iSignale._.obj.sig_c_getr UMR_GRADC__1_1_M40_S6_S3 3 -40 150 DEPOSIT ABSOLUTE MONOTONY MON_INCREASE /end AXIS_DESCR
/end CHARACTERISTIC
/begin CHARACTERISTIC KL_POKABCG23_EL "Temp. abhängiger Druckoffset auf Schaltdruck KAB fuer HS" CURVE 0x23FB74 kl_si16_S6_S3 2.5 UMR_BAR__1_1000_0_S6_S3 -1.25 1.25
 /begin AXIS_DESCR STD_AXIS zff_atsys._.iSignale._.obj.sig_c_getr UMR_GRADC__1_1_M40_S6_S3 3 -40 150 DEPOSIT ABSOLUTE MONOTONY MON_INCREASE /end AXIS_DESCR
/end CHARACTERISTIC
/begin CHARACTERISTIC T_VKABHS34 "Verzögerungszeit abschaltende Kupplung bei HS" VALUE 0x26E70F kw_ui8_S6_S3 2000 UMR_MSEC__10_1_0_S6_S3 0 2000 /end CHARACTERISTIC
/begin CHARACTERISTIC KF_TPKABMTCG34 "Zeitoffset Ende Rampe auf Schaltdruck KAB fuer HS" MAP 0x23FB84 kf_ui8_S6_S3 2000 UMR_MSEC__10_1_M128_S6_S3 -1000 1000
 /begin AXIS_DESCR STD_AXIS zff_atsys._.iSignale._.obj.sig_m_t8 UMR_NM__8_1_M50_S6_S3 8 -400 1640 DEPOSIT ABSOLUTE MONOTONY MON_INCREASE /end AXIS_DESCR
 /begin AXIS_DESCR STD_AXIS zff_atsys._.iSignale._.obj.sig_c_getr UMR_GRADC__1_1_M40_S6_S3 8 -40 150 DEPOSIT ABSOLUTE MONOTONY MON_INCREASE /end AXIS_DESCR
/end CHARACTERISTIC
/begin CHARACTERISTIC KF_TPKABMTCG34_EL "Zeitoffset Ende Rampe auf Schaltdruck KAB fuer HS" MAP 0x23FBDC kf_ui8_S6_S3 2000 UMR_MSEC__10_1_M128_S6_S3 -1000 1000
 /begin AXIS_DESCR STD_AXIS zff_atsys._.iSignale._.obj.sig_m_t8 UMR_NM__8_1_M50_S6_S3 8 -400 1640 DEPOSIT ABSOLUTE MONOTONY MON_INCREASE /end AXIS_DESCR
 /begin AXIS_DESCR STD_AXIS zff_atsys._.iSignale._.obj.sig_c_getr UMR_GRADC__1_1_M40_S6_S3 8 -40 150 DEPOSIT ABSOLUTE MONOTONY MON_INCREASE /end AXIS_DESCR
/end CHARACTERISTIC
/begin CHARACTERISTIC KL_TOPKABND34 "Zeitoffset f(nd_synistgang) Ende Rampe auf Schaltdruck KAB fuer HS" CURVE 0x23FC34 kl_si16_S6_S3 1000 UMR_MSEC__10_1_0_S6_S3 0 1000
 /begin AXIS_DESCR STD_AXIS iSasZentr.iSchaltend.nd_synistgang UMR_U_MIN_1_1_0_S6_S3 4 -8000 8000 DEPOSIT ABSOLUTE MONOTONY MON_INCREASE /end AXIS_DESCR
/end CHARACTERISTIC
/begin CHARACTERISTIC KL_TOPKABND34_EL "Zeitoffset f(nd_synistgang) Ende Rampe auf Schaltdruck KAB fuer HS" CURVE 0x23FC48 kl_si16_S6_S3 1000 UMR_MSEC__10_1_0_S6_S3 0 1000
 /begin AXIS_DESCR STD_AXIS iSasZentr.iSchaltend.nd_synistgang UMR_U_MIN_1_1_0_S6_S3 4 -8000 8000 DEPOSIT ABSOLUTE MONOTONY MON_INCREASE /end AXIS_DESCR
/end CHARACTERISTIC
/begin CHARACTERISTIC KL_PHKABMT34 "Haltedruck abschaltende Kupplung bei HS" CURVE 0x23FC5C kl_si16_S6_S3 22 UMR_BAR__1_1000_0_S6_S3 0 22
 /begin AXIS_DESCR STD_AXIS zff_atsys._.iSignale._.obj.sig_m_t UMR_NM__1_1_0_S6_S3 8 -400 1640 DEPOSIT ABSOLUTE MONOTONY MON_INCREASE /end AXIS_DESCR
/end CHARACTERISTIC
/begin CHARACTERISTIC KL_PHKABMT34_EL "Haltedruck abschaltende Kupplung bei HS" CURVE 0x23FC80 kl_si16_S6_S3 22 UMR_BAR__1_1000_0_S6_S3 0 22
 /begin AXIS_DESCR STD_AXIS zff_atsys._.iSignale._.obj.sig_m_t UMR_NM__1_1_0_S6_S3 8 -400 1640 DEPOSIT ABSOLUTE MONOTONY MON_INCREASE /end AXIS_DESCR
/end CHARACTERISTIC
/begin CHARACTERISTIC KF_THKABMTCG34 "Zeitoffset Ende Haltephase KAB fuer HS" MAP 0x23FCA4 kf_ui8_S6_S3 2000 UMR_MSEC__10_1_M128_S6_S3 -1000 1000
 /begin AXIS_DESCR STD_AXIS zff_atsys._.iSignale._.obj.sig_m_t8 UMR_NM__8_1_M50_S6_S3 8 -400 1640 DEPOSIT ABSOLUTE MONOTONY MON_INCREASE /end AXIS_DESCR
 /begin AXIS_DESCR STD_AXIS zff_atsys._.iSignale._.obj.sig_c_getr UMR_GRADC__1_1_M40_S6_S3 8 -40 150 DEPOSIT ABSOLUTE MONOTONY MON_INCREASE /end AXIS_DESCR
/end CHARACTERISTIC
/begin CHARACTERISTIC KF_THKABMTCG34_EL "Zeitoffset Ende Haltephase KAB fuer HS" MAP 0x23FCFC kf_ui8_S6_S3 2000 UMR_MSEC__10_1_M128_S6_S3 -1000 1000
 /begin AXIS_DESCR STD_AXIS zff_atsys._.iSignale._.obj.sig_m_t8 UMR_NM__8_1_M50_S6_S3 8 -400 1640 DEPOSIT ABSOLUTE MONOTONY MON_INCREASE /end AXIS_DESCR
 /begin AXIS_DESCR STD_AXIS zff_atsys._.iSignale._.obj.sig_c_getr UMR_GRADC__1_1_M40_S6_S3 8 -40 150 DEPOSIT ABSOLUTE MONOTONY MON_INCREASE /end AXIS_DESCR
/end CHARACTERISTIC
/begin CHARACTERISTIC KL_POKABCG34 "Temp. abhängiger Druckoffset auf Schaltdruck KAB fuer HS" CURVE 0x23FD54 kl_si16_S6_S3 2.5 UMR_BAR__1_1000_0_S6_S3 -1.25 1.25
 /begin AXIS_DESCR STD_AXIS zff_atsys._.iSignale._.obj.sig_c_getr UMR_GRADC__1_1_M40_S6_S3 3 -40 150 DEPOSIT ABSOLUTE MONOTONY MON_INCREASE /end AXIS_DESCR
/end CHARACTERISTIC
/begin CHARACTERISTIC KL_POKABCG34_EL "Temp. abhängiger Druckoffset auf Schaltdruck KAB fuer HS" CURVE 0x23FD64 kl_si16_S6_S3 2.5 UMR_BAR__1_1000_0_S6_S3 -1.25 1.25
 /begin AXIS_DESCR STD_AXIS zff_atsys._.iSignale._.obj.sig_c_getr UMR_GRADC__1_1_M40_S6_S3 3 -40 150 DEPOSIT ABSOLUTE MONOTONY MON_INCREASE /end AXIS_DESCR
/end CHARACTERISTIC
/begin CHARACTERISTIC T_VKABHS45 "Verzögerungszeit abschaltende Kupplung bei HS" VALUE 0x26E710 kw_ui8_S6_S3 2000 UMR_MSEC__10_1_0_S6_S3 0 2000 /end CHARACTERISTIC
/begin CHARACTERISTIC KF_TPKABMTCG45 "Zeitoffset Ende Rampe auf Schaltdruck KAB fuer HS" MAP 0x23FD74 kf_ui8_S6_S3 2000 UMR_MSEC__10_1_M128_S6_S3 -1000 1000
 /begin AXIS_DESCR STD_AXIS zff_atsys._.iSignale._.obj.sig_m_t8 UMR_NM__8_1_M50_S6_S3 8 -400 1640 DEPOSIT ABSOLUTE MONOTONY MON_INCREASE /end AXIS_DESCR
 /begin AXIS_DESCR STD_AXIS zff_atsys._.iSignale._.obj.sig_c_getr UMR_GRADC__1_1_M40_S6_S3 8 -40 150 DEPOSIT ABSOLUTE MONOTONY MON_INCREASE /end AXIS_DESCR
/end CHARACTERISTIC
/begin CHARACTERISTIC KF_TPKABMTCG45_EL "Zeitoffset Ende Rampe auf Schaltdruck KAB fuer HS" MAP 0x23FDCC kf_ui8_S6_S3 2000 UMR_MSEC__10_1_M128_S6_S3 -1000 1000
 /begin AXIS_DESCR STD_AXIS zff_atsys._.iSignale._.obj.sig_m_t8 UMR_NM__8_1_M50_S6_S3 8 -400 1640 DEPOSIT ABSOLUTE MONOTONY MON_INCREASE /end AXIS_DESCR
 /begin AXIS_DESCR STD_AXIS zff_atsys._.iSignale._.obj.sig_c_getr UMR_GRADC__1_1_M40_S6_S3 8 -40 150 DEPOSIT ABSOLUTE MONOTONY MON_INCREASE /end AXIS_DESCR
/end CHARACTERISTIC
/begin CHARACTERISTIC KL_TOPKABND45 "Zeitoffset f(nd_synistgang) Ende Rampe auf Schaltdruck KAB fuer HS" CURVE 0x23FE24 kl_si16_S6_S3 1000 UMR_MSEC__10_1_0_S6_S3 0 1000
 /begin AXIS_DESCR STD_AXIS iSasZentr.iSchaltend.nd_synistgang UMR_U_MIN_1_1_0_S6_S3 4 -8000 8000 DEPOSIT ABSOLUTE MONOTONY MON_INCREASE /end AXIS_DESCR
/end CHARACTERISTIC
/begin CHARACTERISTIC KL_TOPKABND45_EL "Zeitoffset f(nd_synistgang) Ende Rampe auf Schaltdruck KAB fuer HS" CURVE 0x23FE38 kl_si16_S6_S3 1000 UMR_MSEC__10_1_0_S6_S3 0 1000
 /begin AXIS_DESCR STD_AXIS iSasZentr.iSchaltend.nd_synistgang UMR_U_MIN_1_1_0_S6_S3 4 -8000 8000 DEPOSIT ABSOLUTE MONOTONY MON_INCREASE /end AXIS_DESCR
/end CHARACTERISTIC
/begin CHARACTERISTIC KL_PHKABMT45 "Haltedruck abschaltende Kupplung bei HS" CURVE 0x23FE4C kl_si16_S6_S3 22 UMR_BAR__1_1000_0_S6_S3 0 22
 /begin AXIS_DESCR STD_AXIS zff_atsys._.iSignale._.obj.sig_m_t UMR_NM__1_1_0_S6_S3 8 -400 1640 DEPOSIT ABSOLUTE MONOTONY MON_INCREASE /end AXIS_DESCR
/end CHARACTERISTIC
/begin CHARACTERISTIC KL_PHKABMT45_EL "Haltedruck abschaltende Kupplung bei HS" CURVE 0x23FE70 kl_si16_S6_S3 22 UMR_BAR__1_1000_0_S6_S3 0 22
 /begin AXIS_DESCR STD_AXIS zff_atsys._.iSignale._.obj.sig_m_t UMR_NM__1_1_0_S6_S3 8 -400 1640 DEPOSIT ABSOLUTE MONOTONY MON_INCREASE /end AXIS_DESCR
/end CHARACTERISTIC
/begin CHARACTERISTIC KF_THKABMTCG45 "Zeitoffset Ende Haltephase KAB fuer HS" MAP 0x23FE94 kf_ui8_S6_S3 2000 UMR_MSEC__10_1_M128_S6_S3 -1000 1000
 /begin AXIS_DESCR STD_AXIS zff_atsys._.iSignale._.obj.sig_m_t8 UMR_NM__8_1_M50_S6_S3 8 -400 1640 DEPOSIT ABSOLUTE MONOTONY MON_INCREASE /end AXIS_DESCR
 /begin AXIS_DESCR STD_AXIS zff_atsys._.iSignale._.obj.sig_c_getr UMR_GRADC__1_1_M40_S6_S3 8 -40 150 DEPOSIT ABSOLUTE MONOTONY MON_INCREASE /end AXIS_DESCR
/end CHARACTERISTIC
/begin CHARACTERISTIC KF_THKABMTCG45_EL "Zeitoffset Ende Haltephase KAB fuer HS" MAP 0x23FEEC kf_ui8_S6_S3 2000 UMR_MSEC__10_1_M128_S6_S3 -1000 1000
 /begin AXIS_DESCR STD_AXIS zff_atsys._.iSignale._.obj.sig_m_t8 UMR_NM__8_1_M50_S6_S3 8 -400 1640 DEPOSIT ABSOLUTE MONOTONY MON_INCREASE /end AXIS_DESCR
 /begin AXIS_DESCR STD_AXIS zff_atsys._.iSignale._.obj.sig_c_getr UMR_GRADC__1_1_M40_S6_S3 8 -40 150 DEPOSIT ABSOLUTE MONOTONY MON_INCREASE /end AXIS_DESCR
/end CHARACTERISTIC
/begin CHARACTERISTIC KL_POKABCG45 "Temp. abhängiger Druckoffset auf Schaltdruck KAB fuer HS" CURVE 0x23FF44 kl_si16_S6_S3 2.5 UMR_BAR__1_1000_0_S6_S3 -1.25 1.25
 /begin AXIS_DESCR STD_AXIS zff_atsys._.iSignale._.obj.sig_c_getr UMR_GRADC__1_1_M40_S6_S3 3 -40 150 DEPOSIT ABSOLUTE MONOTONY MON_INCREASE /end AXIS_DESCR
/end CHARACTERISTIC
/begin CHARACTERISTIC KL_POKABCG45_EL "Temp. abhängiger Druckoffset auf Schaltdruck KAB fuer HS" CURVE 0x23FF54 kl_si16_S6_S3 2.5 UMR_BAR__1_1000_0_S6_S3 -1.25 1.25
 /begin AXIS_DESCR STD_AXIS zff_atsys._.iSignale._.obj.sig_c_getr UMR_GRADC__1_1_M40_S6_S3 3 -40 150 DEPOSIT ABSOLUTE MONOTONY MON_INCREASE /end AXIS_DESCR
/end CHARACTERISTIC
/begin CHARACTERISTIC T_VKABHS56 "Verzögerungszeit abschaltende Kupplung bei HS" VALUE 0x26E711 kw_ui8_S6_S3 2000 UMR_MSEC__10_1_0_S6_S3 0 2000 /end CHARACTERISTIC
/begin CHARACTERISTIC KF_TPKABMTCG56 "Zeitoffset Ende Rampe auf Schaltdruck KAB fuer HS" MAP 0x23FF64 kf_ui8_S6_S3 2000 UMR_MSEC__10_1_M128_S6_S3 -1000 1000
 /begin AXIS_DESCR STD_AXIS zff_atsys._.iSignale._.obj.sig_m_t8 UMR_NM__8_1_M50_S6_S3 8 -400 1640 DEPOSIT ABSOLUTE MONOTONY MON_INCREASE /end AXIS_DESCR
 /begin AXIS_DESCR STD_AXIS zff_atsys._.iSignale._.obj.sig_c_getr UMR_GRADC__1_1_M40_S6_S3 8 -40 150 DEPOSIT ABSOLUTE MONOTONY MON_INCREASE /end AXIS_DESCR
/end CHARACTERISTIC
/begin CHARACTERISTIC KF_TPKABMTCG56_EL "Zeitoffset Ende Rampe auf Schaltdruck KAB fuer HS" MAP 0x23FFBC kf_ui8_S6_S3 2000 UMR_MSEC__10_1_M128_S6_S3 -1000 1000
 /begin AXIS_DESCR STD_AXIS zff_atsys._.iSignale._.obj.sig_m_t8 UMR_NM__8_1_M50_S6_S3 8 -400 1640 DEPOSIT ABSOLUTE MONOTONY MON_INCREASE /end AXIS_DESCR
 /begin AXIS_DESCR STD_AXIS zff_atsys._.iSignale._.obj.sig_c_getr UMR_GRADC__1_1_M40_S6_S3 8 -40 150 DEPOSIT ABSOLUTE MONOTONY MON_INCREASE /end AXIS_DESCR
/end CHARACTERISTIC
/begin CHARACTERISTIC KL_TOPKABND56 "Zeitoffset f(nd_synistgang) Ende Rampe auf Schaltdruck KAB fuer HS" CURVE 0x240014 kl_si16_S6_S3 1000 UMR_MSEC__10_1_0_S6_S3 0 1000
 /begin AXIS_DESCR STD_AXIS iSasZentr.iSchaltend.nd_synistgang UMR_U_MIN_1_1_0_S6_S3 4 -8000 8000 DEPOSIT ABSOLUTE MONOTONY MON_INCREASE /end AXIS_DESCR
/end CHARACTERISTIC
/begin CHARACTERISTIC KL_TOPKABND56_EL "Zeitoffset f(nd_synistgang) Ende Rampe auf Schaltdruck KAB fuer HS" CURVE 0x240028 kl_si16_S6_S3 1000 UMR_MSEC__10_1_0_S6_S3 0 1000
 /begin AXIS_DESCR STD_AXIS iSasZentr.iSchaltend.nd_synistgang UMR_U_MIN_1_1_0_S6_S3 4 -8000 8000 DEPOSIT ABSOLUTE MONOTONY MON_INCREASE /end AXIS_DESCR
/end CHARACTERISTIC
/begin CHARACTERISTIC KL_PHKABMT56 "Haltedruck abschaltende Kupplung bei HS" CURVE 0x24003C kl_si16_S6_S3 22 UMR_BAR__1_1000_0_S6_S3 0 22
 /begin AXIS_DESCR STD_AXIS zff_atsys._.iSignale._.obj.sig_m_t UMR_NM__1_1_0_S6_S3 8 -400 1640 DEPOSIT ABSOLUTE MONOTONY MON_INCREASE /end AXIS_DESCR
/end CHARACTERISTIC
/begin CHARACTERISTIC KL_PHKABMT56_EL "Haltedruck abschaltende Kupplung bei HS" CURVE 0x240060 kl_si16_S6_S3 22 UMR_BAR__1_1000_0_S6_S3 0 22
 /begin AXIS_DESCR STD_AXIS zff_atsys._.iSignale._.obj.sig_m_t UMR_NM__1_1_0_S6_S3 8 -400 1640 DEPOSIT ABSOLUTE MONOTONY MON_INCREASE /end AXIS_DESCR
/end CHARACTERISTIC
/begin CHARACTERISTIC KF_THKABMTCG56 "Zeitoffset Ende Haltephase KAB fuer HS" MAP 0x240084 kf_ui8_S6_S3 2000 UMR_MSEC__10_1_M128_S6_S3 -1000 1000
 /begin AXIS_DESCR STD_AXIS zff_atsys._.iSignale._.obj.sig_m_t8 UMR_NM__8_1_M50_S6_S3 8 -400 1640 DEPOSIT ABSOLUTE MONOTONY MON_INCREASE /end AXIS_DESCR
 /begin AXIS_DESCR STD_AXIS zff_atsys._.iSignale._.obj.sig_c_getr UMR_GRADC__1_1_M40_S6_S3 8 -40 150 DEPOSIT ABSOLUTE MONOTONY MON_INCREASE /end AXIS_DESCR
/end CHARACTERISTIC
/begin CHARACTERISTIC KF_THKABMTCG56_EL "Zeitoffset Ende Haltephase KAB fuer HS" MAP 0x2400DC kf_ui8_S6_S3 2000 UMR_MSEC__10_1_M128_S6_S3 -1000 1000
 /begin AXIS_DESCR STD_AXIS zff_atsys._.iSignale._.obj.sig_m_t8 UMR_NM__8_1_M50_S6_S3 8 -400 1640 DEPOSIT ABSOLUTE MONOTONY MON_INCREASE /end AXIS_DESCR
 /begin AXIS_DESCR STD_AXIS zff_atsys._.iSignale._.obj.sig_c_getr UMR_GRADC__1_1_M40_S6_S3 8 -40 150 DEPOSIT ABSOLUTE MONOTONY MON_INCREASE /end AXIS_DESCR
/end CHARACTERISTIC
/begin CHARACTERISTIC KL_POKABCG56 "Temp. abhängiger Druckoffset auf Schaltdruck KAB fuer HS" CURVE 0x240134 kl_si16_S6_S3 2.5 UMR_BAR__1_1000_0_S6_S3 -1.25 1.25
 /begin AXIS_DESCR STD_AXIS zff_atsys._.iSignale._.obj.sig_c_getr UMR_GRADC__1_1_M40_S6_S3 3 -40 150 DEPOSIT ABSOLUTE MONOTONY MON_INCREASE /end AXIS_DESCR
/end CHARACTERISTIC
/begin CHARACTERISTIC KL_POKABCG56_EL "Temp. abhängiger Druckoffset auf Schaltdruck KAB fuer HS" CURVE 0x240144 kl_si16_S6_S3 2.5 UMR_BAR__1_1000_0_S6_S3 -1.25 1.25
 /begin AXIS_DESCR STD_AXIS zff_atsys._.iSignale._.obj.sig_c_getr UMR_GRADC__1_1_M40_S6_S3 3 -40 150 DEPOSIT ABSOLUTE MONOTONY MON_INCREASE /end AXIS_DESCR
/end CHARACTERISTIC
/begin CHARACTERISTIC T_VKABHS67 "Verzögerungszeit abschaltende Kupplung bei HS" VALUE 0x26E712 kw_ui8_S6_S3 2000 UMR_MSEC__10_1_0_S6_S3 0 2000 /end CHARACTERISTIC
/begin CHARACTERISTIC KF_TPKABMTCG67 "Zeitoffset Ende Rampe auf Schaltdruck KAB fuer HS" MAP 0x240154 kf_ui8_S6_S3 2000 UMR_MSEC__10_1_M128_S6_S3 -1000 1000
 /begin AXIS_DESCR STD_AXIS zff_atsys._.iSignale._.obj.sig_m_t8 UMR_NM__8_1_M50_S6_S3 8 -400 1640 DEPOSIT ABSOLUTE MONOTONY MON_INCREASE /end AXIS_DESCR
 /begin AXIS_DESCR STD_AXIS zff_atsys._.iSignale._.obj.sig_c_getr UMR_GRADC__1_1_M40_S6_S3 8 -40 150 DEPOSIT ABSOLUTE MONOTONY MON_INCREASE /end AXIS_DESCR
/end CHARACTERISTIC
/begin CHARACTERISTIC KF_TPKABMTCG67_EL "Zeitoffset Ende Rampe auf Schaltdruck KAB fuer HS" MAP 0x2401AC kf_ui8_S6_S3 2000 UMR_MSEC__10_1_M128_S6_S3 -1000 1000
 /begin AXIS_DESCR STD_AXIS zff_atsys._.iSignale._.obj.sig_m_t8 UMR_NM__8_1_M50_S6_S3 8 -400 1640 DEPOSIT ABSOLUTE MONOTONY MON_INCREASE /end AXIS_DESCR
 /begin AXIS_DESCR STD_AXIS zff_atsys._.iSignale._.obj.sig_c_getr UMR_GRADC__1_1_M40_S6_S3 8 -40 150 DEPOSIT ABSOLUTE MONOTONY MON_INCREASE /end AXIS_DESCR
/end CHARACTERISTIC
/begin CHARACTERISTIC KL_TOPKABND67 "Zeitoffset f(nd_synistgang) Ende Rampe auf Schaltdruck KAB fuer HS" CURVE 0x240204 kl_si16_S6_S3 1000 UMR_MSEC__10_1_0_S6_S3 0 1000
 /begin AXIS_DESCR STD_AXIS iSasZentr.iSchaltend.nd_synistgang UMR_U_MIN_1_1_0_S6_S3 4 -8000 8000 DEPOSIT ABSOLUTE MONOTONY MON_INCREASE /end AXIS_DESCR
/end CHARACTERISTIC
/begin CHARACTERISTIC KL_TOPKABND67_EL "Zeitoffset f(nd_synistgang) Ende Rampe auf Schaltdruck KAB fuer HS" CURVE 0x240218 kl_si16_S6_S3 1000 UMR_MSEC__10_1_0_S6_S3 0 1000
 /begin AXIS_DESCR STD_AXIS iSasZentr.iSchaltend.nd_synistgang UMR_U_MIN_1_1_0_S6_S3 4 -8000 8000 DEPOSIT ABSOLUTE MONOTONY MON_INCREASE /end AXIS_DESCR
/end CHARACTERISTIC
/begin CHARACTERISTIC KL_PHKABMT67 "Haltedruck abschaltende Kupplung bei HS" CURVE 0x24022C kl_si16_S6_S3 22 UMR_BAR__1_1000_0_S6_S3 0 22
 /begin AXIS_DESCR STD_AXIS zff_atsys._.iSignale._.obj.sig_m_t UMR_NM__1_1_0_S6_S3 8 -400 1640 DEPOSIT ABSOLUTE MONOTONY MON_INCREASE /end AXIS_DESCR
/end CHARACTERISTIC
/begin CHARACTERISTIC KL_PHKABMT67_EL "Haltedruck abschaltende Kupplung bei HS" CURVE 0x240250 kl_si16_S6_S3 22 UMR_BAR__1_1000_0_S6_S3 0 22
 /begin AXIS_DESCR STD_AXIS zff_atsys._.iSignale._.obj.sig_m_t UMR_NM__1_1_0_S6_S3 8 -400 1640 DEPOSIT ABSOLUTE MONOTONY MON_INCREASE /end AXIS_DESCR
/end CHARACTERISTIC
/begin CHARACTERISTIC KF_THKABMTCG67 "Zeitoffset Ende Haltephase KAB fuer HS" MAP 0x240274 kf_ui8_S6_S3 2000 UMR_MSEC__10_1_M128_S6_S3 -1000 1000
 /begin AXIS_DESCR STD_AXIS zff_atsys._.iSignale._.obj.sig_m_t8 UMR_NM__8_1_M50_S6_S3 8 -400 1640 DEPOSIT ABSOLUTE MONOTONY MON_INCREASE /end AXIS_DESCR
 /begin AXIS_DESCR STD_AXIS zff_atsys._.iSignale._.obj.sig_c_getr UMR_GRADC__1_1_M40_S6_S3 8 -40 150 DEPOSIT ABSOLUTE MONOTONY MON_INCREASE /end AXIS_DESCR
/end CHARACTERISTIC
/begin CHARACTERISTIC KF_THKABMTCG67_EL "Zeitoffset Ende Haltephase KAB fuer HS" MAP 0x2402CC kf_ui8_S6_S3 2000 UMR_MSEC__10_1_M128_S6_S3 -1000 1000
 /begin AXIS_DESCR STD_AXIS zff_atsys._.iSignale._.obj.sig_m_t8 UMR_NM__8_1_M50_S6_S3 8 -400 1640 DEPOSIT ABSOLUTE MONOTONY MON_INCREASE /end AXIS_DESCR
 /begin AXIS_DESCR STD_AXIS zff_atsys._.iSignale._.obj.sig_c_getr UMR_GRADC__1_1_M40_S6_S3 8 -40 150 DEPOSIT ABSOLUTE MONOTONY MON_INCREASE /end AXIS_DESCR
/end CHARACTERISTIC
/begin CHARACTERISTIC KL_POKABCG67 "Temp. abhängiger Druckoffset auf Schaltdruck KAB fuer HS" CURVE 0x240324 kl_si16_S6_S3 2.5 UMR_BAR__1_1000_0_S6_S3 -1.25 1.25
 /begin AXIS_DESCR STD_AXIS zff_atsys._.iSignale._.obj.sig_c_getr UMR_GRADC__1_1_M40_S6_S3 3 -40 150 DEPOSIT ABSOLUTE MONOTONY MON_INCREASE /end AXIS_DESCR
/end CHARACTERISTIC
/begin CHARACTERISTIC KL_POKABCG67_EL "Temp. abhängiger Druckoffset auf Schaltdruck KAB fuer HS" CURVE 0x240334 kl_si16_S6_S3 2.5 UMR_BAR__1_1000_0_S6_S3 -1.25 1.25
 /begin AXIS_DESCR STD_AXIS zff_atsys._.iSignale._.obj.sig_c_getr UMR_GRADC__1_1_M40_S6_S3 3 -40 150 DEPOSIT ABSOLUTE MONOTONY MON_INCREASE /end AXIS_DESCR
/end CHARACTERISTIC
/begin CHARACTERISTIC T_VKABHS78 "Verzögerungszeit abschaltende Kupplung bei HS" VALUE 0x26E713 kw_ui8_S6_S3 2000 UMR_MSEC__10_1_0_S6_S3 0 2000 /end CHARACTERISTIC
/begin CHARACTERISTIC KF_TPKABMTCG78 "Zeitoffset Ende Rampe auf Schaltdruck KAB fuer HS" MAP 0x240344 kf_ui8_S6_S3 2000 UMR_MSEC__10_1_M128_S6_S3 -1000 1000
 /begin AXIS_DESCR STD_AXIS zff_atsys._.iSignale._.obj.sig_m_t8 UMR_NM__8_1_M50_S6_S3 8 -400 1640 DEPOSIT ABSOLUTE MONOTONY MON_INCREASE /end AXIS_DESCR
 /begin AXIS_DESCR STD_AXIS zff_atsys._.iSignale._.obj.sig_c_getr UMR_GRADC__1_1_M40_S6_S3 8 -40 150 DEPOSIT ABSOLUTE MONOTONY MON_INCREASE /end AXIS_DESCR
/end CHARACTERISTIC
/begin CHARACTERISTIC KF_TPKABMTCG78_EL "Zeitoffset Ende Rampe auf Schaltdruck KAB fuer HS" MAP 0x24039C kf_ui8_S6_S3 2000 UMR_MSEC__10_1_M128_S6_S3 -1000 1000
 /begin AXIS_DESCR STD_AXIS zff_atsys._.iSignale._.obj.sig_m_t8 UMR_NM__8_1_M50_S6_S3 8 -400 1640 DEPOSIT ABSOLUTE MONOTONY MON_INCREASE /end AXIS_DESCR
 /begin AXIS_DESCR STD_AXIS zff_atsys._.iSignale._.obj.sig_c_getr UMR_GRADC__1_1_M40_S6_S3 8 -40 150 DEPOSIT ABSOLUTE MONOTONY MON_INCREASE /end AXIS_DESCR
/end CHARACTERISTIC
/begin CHARACTERISTIC KL_TOPKABND78 "Zeitoffset f(nd_synistgang) Ende Rampe auf Schaltdruck KAB fuer HS" CURVE 0x2403F4 kl_si16_S6_S3 1000 UMR_MSEC__10_1_0_S6_S3 0 1000
 /begin AXIS_DESCR STD_AXIS iSasZentr.iSchaltend.nd_synistgang UMR_U_MIN_1_1_0_S6_S3 4 -8000 8000 DEPOSIT ABSOLUTE MONOTONY MON_INCREASE /end AXIS_DESCR
/end CHARACTERISTIC
/begin CHARACTERISTIC KL_TOPKABND78_EL "Zeitoffset f(nd_synistgang) Ende Rampe auf Schaltdruck KAB fuer HS" CURVE 0x240408 kl_si16_S6_S3 1000 UMR_MSEC__10_1_0_S6_S3 0 1000
 /begin AXIS_DESCR STD_AXIS iSasZentr.iSchaltend.nd_synistgang UMR_U_MIN_1_1_0_S6_S3 4 -8000 8000 DEPOSIT ABSOLUTE MONOTONY MON_INCREASE /end AXIS_DESCR
/end CHARACTERISTIC
/begin CHARACTERISTIC KL_PHKABMT78 "Haltedruck abschaltende Kupplung bei HS" CURVE 0x24041C kl_si16_S6_S3 22 UMR_BAR__1_1000_0_S6_S3 0 22
 /begin AXIS_DESCR STD_AXIS zff_atsys._.iSignale._.obj.sig_m_t UMR_NM__1_1_0_S6_S3 8 -400 1640 DEPOSIT ABSOLUTE MONOTONY MON_INCREASE /end AXIS_DESCR
/end CHARACTERISTIC
/begin CHARACTERISTIC KL_PHKABMT78_EL "Haltedruck abschaltende Kupplung bei HS" CURVE 0x240440 kl_si16_S6_S3 22 UMR_BAR__1_1000_0_S6_S3 0 22
 /begin AXIS_DESCR STD_AXIS zff_atsys._.iSignale._.obj.sig_m_t UMR_NM__1_1_0_S6_S3 8 -400 1640 DEPOSIT ABSOLUTE MONOTONY MON_INCREASE /end AXIS_DESCR
/end CHARACTERISTIC
/begin CHARACTERISTIC KF_THKABMTCG78 "Zeitoffset Ende Haltephase KAB fuer HS" MAP 0x240464 kf_ui8_S6_S3 2000 UMR_MSEC__10_1_M128_S6_S3 -1000 1000
 /begin AXIS_DESCR STD_AXIS zff_atsys._.iSignale._.obj.sig_m_t8 UMR_NM__8_1_M50_S6_S3 8 -400 1640 DEPOSIT ABSOLUTE MONOTONY MON_INCREASE /end AXIS_DESCR
 /begin AXIS_DESCR STD_AXIS zff_atsys._.iSignale._.obj.sig_c_getr UMR_GRADC__1_1_M40_S6_S3 8 -40 150 DEPOSIT ABSOLUTE MONOTONY MON_INCREASE /end AXIS_DESCR
/end CHARACTERISTIC
/begin CHARACTERISTIC KF_THKABMTCG78_EL "Zeitoffset Ende Haltephase KAB fuer HS" MAP 0x2404BC kf_ui8_S6_S3 2000 UMR_MSEC__10_1_M128_S6_S3 -1000 1000
 /begin AXIS_DESCR STD_AXIS zff_atsys._.iSignale._.obj.sig_m_t8 UMR_NM__8_1_M50_S6_S3 8 -400 1640 DEPOSIT ABSOLUTE MONOTONY MON_INCREASE /end AXIS_DESCR
 /begin AXIS_DESCR STD_AXIS zff_atsys._.iSignale._.obj.sig_c_getr UMR_GRADC__1_1_M40_S6_S3 8 -40 150 DEPOSIT ABSOLUTE MONOTONY MON_INCREASE /end AXIS_DESCR
/end CHARACTERISTIC
/begin CHARACTERISTIC KL_POKABCG78 "Temp. abhängiger Druckoffset auf Schaltdruck KAB fuer HS" CURVE 0x240514 kl_si16_S6_S3 2.5 UMR_BAR__1_1000_0_S6_S3 -1.25 1.25
 /begin AXIS_DESCR STD_AXIS zff_atsys._.iSignale._.obj.sig_c_getr UMR_GRADC__1_1_M40_S6_S3 3 -40 150 DEPOSIT ABSOLUTE MONOTONY MON_INCREASE /end AXIS_DESCR
/end CHARACTERISTIC
/begin CHARACTERISTIC KL_POKABCG78_EL "Temp. abhängiger Druckoffset auf Schaltdruck KAB fuer HS" CURVE 0x240524 kl_si16_S6_S3 2.5 UMR_BAR__1_1000_0_S6_S3 -1.25 1.25
 /begin AXIS_DESCR STD_AXIS zff_atsys._.iSignale._.obj.sig_c_getr UMR_GRADC__1_1_M40_S6_S3 3 -40 150 DEPOSIT ABSOLUTE MONOTONY MON_INCREASE /end AXIS_DESCR
/end CHARACTERISTIC
/begin CHARACTERISTIC T_VKABHS13 "Verzögerungszeit abschaltende Kupplung bei HS" VALUE 0x26E714 kw_ui8_S6_S3 2000 UMR_MSEC__10_1_0_S6_S3 0 2000 /end CHARACTERISTIC
/begin CHARACTERISTIC KF_TPKABMTCG13 "Zeitoffset Ende Rampe auf Schaltdruck KAB fuer HS" MAP 0x240534 kf_ui8_S6_S3 2000 UMR_MSEC__10_1_M128_S6_S3 -1000 1000
 /begin AXIS_DESCR STD_AXIS zff_atsys._.iSignale._.obj.sig_m_t8 UMR_NM__8_1_M50_S6_S3 8 -400 1640 DEPOSIT ABSOLUTE MONOTONY MON_INCREASE /end AXIS_DESCR
 /begin AXIS_DESCR STD_AXIS zff_atsys._.iSignale._.obj.sig_c_getr UMR_GRADC__1_1_M40_S6_S3 8 -40 150 DEPOSIT ABSOLUTE MONOTONY MON_INCREASE /end AXIS_DESCR
/end CHARACTERISTIC
/begin CHARACTERISTIC KL_TOPKABND13 "Zeitoffset f(nd_synistgang) Ende Rampe auf Schaltdruck KAB fuer HS" CURVE 0x24058C kl_si16_S6_S3 1000 UMR_MSEC__10_1_0_S6_S3 0 1000
 /begin AXIS_DESCR STD_AXIS iSasZentr.iSchaltend.nd_synistgang UMR_U_MIN_1_1_0_S6_S3 4 -8000 8000 DEPOSIT ABSOLUTE MONOTONY MON_INCREASE /end AXIS_DESCR
/end CHARACTERISTIC
/begin CHARACTERISTIC KL_PHKABMT13 "Haltedruck abschaltende Kupplung bei HS" CURVE 0x2405A0 kl_si16_S6_S3 22 UMR_BAR__1_1000_0_S6_S3 0 22
 /begin AXIS_DESCR STD_AXIS zff_atsys._.iSignale._.obj.sig_m_t UMR_NM__1_1_0_S6_S3 8 -400 1640 DEPOSIT ABSOLUTE MONOTONY MON_INCREASE /end AXIS_DESCR
/end CHARACTERISTIC
/begin CHARACTERISTIC KF_THKABMTCG13 "Zeitoffset Ende Haltephase KAB fuer HS" MAP 0x2405C4 kf_ui8_S6_S3 2000 UMR_MSEC__10_1_M128_S6_S3 -1000 1000
 /begin AXIS_DESCR STD_AXIS zff_atsys._.iSignale._.obj.sig_m_t8 UMR_NM__8_1_M50_S6_S3 8 -400 1640 DEPOSIT ABSOLUTE MONOTONY MON_INCREASE /end AXIS_DESCR
 /begin AXIS_DESCR STD_AXIS zff_atsys._.iSignale._.obj.sig_c_getr UMR_GRADC__1_1_M40_S6_S3 8 -40 150 DEPOSIT ABSOLUTE MONOTONY MON_INCREASE /end AXIS_DESCR
/end CHARACTERISTIC
/begin CHARACTERISTIC KL_POKABCG13 "Temp. abhängiger Druckoffset auf Schaltdruck KAB fuer HS" CURVE 0x24061C kl_si16_S6_S3 2.5 UMR_BAR__1_1000_0_S6_S3 -1.25 1.25
 /begin AXIS_DESCR STD_AXIS zff_atsys._.iSignale._.obj.sig_c_getr UMR_GRADC__1_1_M40_S6_S3 3 -40 150 DEPOSIT ABSOLUTE MONOTONY MON_INCREASE /end AXIS_DESCR
/end CHARACTERISTIC
/begin CHARACTERISTIC T_VKABHS24 "Verzögerungszeit abschaltende Kupplung bei HS" VALUE 0x26E715 kw_ui8_S6_S3 2000 UMR_MSEC__10_1_0_S6_S3 0 2000 /end CHARACTERISTIC
/begin CHARACTERISTIC KF_TPKABMTCG24 "Zeitoffset Ende Rampe auf Schaltdruck KAB fuer HS" MAP 0x24062C kf_ui8_S6_S3 2000 UMR_MSEC__10_1_M128_S6_S3 -1000 1000
 /begin AXIS_DESCR STD_AXIS zff_atsys._.iSignale._.obj.sig_m_t8 UMR_NM__8_1_M50_S6_S3 8 -400 1640 DEPOSIT ABSOLUTE MONOTONY MON_INCREASE /end AXIS_DESCR
 /begin AXIS_DESCR STD_AXIS zff_atsys._.iSignale._.obj.sig_c_getr UMR_GRADC__1_1_M40_S6_S3 8 -40 150 DEPOSIT ABSOLUTE MONOTONY MON_INCREASE /end AXIS_DESCR
/end CHARACTERISTIC
/begin CHARACTERISTIC KL_TOPKABND24 "Zeitoffset f(nd_synistgang) Ende Rampe auf Schaltdruck KAB fuer HS" CURVE 0x240684 kl_si16_S6_S3 1000 UMR_MSEC__10_1_0_S6_S3 0 1000
 /begin AXIS_DESCR STD_AXIS iSasZentr.iSchaltend.nd_synistgang UMR_U_MIN_1_1_0_S6_S3 4 -8000 8000 DEPOSIT ABSOLUTE MONOTONY MON_INCREASE /end AXIS_DESCR
/end CHARACTERISTIC
/begin CHARACTERISTIC KL_PHKABMT24 "Haltedruck abschaltende Kupplung bei HS" CURVE 0x240698 kl_si16_S6_S3 22 UMR_BAR__1_1000_0_S6_S3 0 22
 /begin AXIS_DESCR STD_AXIS zff_atsys._.iSignale._.obj.sig_m_t UMR_NM__1_1_0_S6_S3 8 -400 1640 DEPOSIT ABSOLUTE MONOTONY MON_INCREASE /end AXIS_DESCR
/end CHARACTERISTIC
/begin CHARACTERISTIC KF_THKABMTCG24 "Zeitoffset Ende Haltephase KAB fuer HS" MAP 0x2406BC kf_ui8_S6_S3 2000 UMR_MSEC__10_1_M128_S6_S3 -1000 1000
 /begin AXIS_DESCR STD_AXIS zff_atsys._.iSignale._.obj.sig_m_t8 UMR_NM__8_1_M50_S6_S3 8 -400 1640 DEPOSIT ABSOLUTE MONOTONY MON_INCREASE /end AXIS_DESCR
 /begin AXIS_DESCR STD_AXIS zff_atsys._.iSignale._.obj.sig_c_getr UMR_GRADC__1_1_M40_S6_S3 8 -40 150 DEPOSIT ABSOLUTE MONOTONY MON_INCREASE /end AXIS_DESCR
/end CHARACTERISTIC
/begin CHARACTERISTIC KL_POKABCG24 "Temp. abhängiger Druckoffset auf Schaltdruck KAB fuer HS" CURVE 0x240714 kl_si16_S6_S3 2.5 UMR_BAR__1_1000_0_S6_S3 -1.25 1.25
 /begin AXIS_DESCR STD_AXIS zff_atsys._.iSignale._.obj.sig_c_getr UMR_GRADC__1_1_M40_S6_S3 3 -40 150 DEPOSIT ABSOLUTE MONOTONY MON_INCREASE /end AXIS_DESCR
/end CHARACTERISTIC
/begin CHARACTERISTIC T_VKABHS35 "Verzögerungszeit abschaltende Kupplung bei HS" VALUE 0x26E716 kw_ui8_S6_S3 2000 UMR_MSEC__10_1_0_S6_S3 0 2000 /end CHARACTERISTIC
/begin CHARACTERISTIC KF_TPKABMTCG35 "Zeitoffset Ende Rampe auf Schaltdruck KAB fuer HS" MAP 0x240724 kf_ui8_S6_S3 2000 UMR_MSEC__10_1_M128_S6_S3 -1000 1000
 /begin AXIS_DESCR STD_AXIS zff_atsys._.iSignale._.obj.sig_m_t8 UMR_NM__8_1_M50_S6_S3 8 -400 1640 DEPOSIT ABSOLUTE MONOTONY MON_INCREASE /end AXIS_DESCR
 /begin AXIS_DESCR STD_AXIS zff_atsys._.iSignale._.obj.sig_c_getr UMR_GRADC__1_1_M40_S6_S3 8 -40 150 DEPOSIT ABSOLUTE MONOTONY MON_INCREASE /end AXIS_DESCR
/end CHARACTERISTIC
/begin CHARACTERISTIC KL_TOPKABND35 "Zeitoffset f(nd_synistgang) Ende Rampe auf Schaltdruck KAB fuer HS" CURVE 0x24077C kl_si16_S6_S3 1000 UMR_MSEC__10_1_0_S6_S3 0 1000
 /begin AXIS_DESCR STD_AXIS iSasZentr.iSchaltend.nd_synistgang UMR_U_MIN_1_1_0_S6_S3 4 -8000 8000 DEPOSIT ABSOLUTE MONOTONY MON_INCREASE /end AXIS_DESCR
/end CHARACTERISTIC
/begin CHARACTERISTIC KL_PHKABMT35 "Haltedruck abschaltende Kupplung bei HS" CURVE 0x240790 kl_si16_S6_S3 22 UMR_BAR__1_1000_0_S6_S3 0 22
 /begin AXIS_DESCR STD_AXIS zff_atsys._.iSignale._.obj.sig_m_t UMR_NM__1_1_0_S6_S3 8 -400 1640 DEPOSIT ABSOLUTE MONOTONY MON_INCREASE /end AXIS_DESCR
/end CHARACTERISTIC
/begin CHARACTERISTIC KF_THKABMTCG35 "Zeitoffset Ende Haltephase KAB fuer HS" MAP 0x2407B4 kf_ui8_S6_S3 2000 UMR_MSEC__10_1_M128_S6_S3 -1000 1000
 /begin AXIS_DESCR STD_AXIS zff_atsys._.iSignale._.obj.sig_m_t8 UMR_NM__8_1_M50_S6_S3 8 -400 1640 DEPOSIT ABSOLUTE MONOTONY MON_INCREASE /end AXIS_DESCR
 /begin AXIS_DESCR STD_AXIS zff_atsys._.iSignale._.obj.sig_c_getr UMR_GRADC__1_1_M40_S6_S3 8 -40 150 DEPOSIT ABSOLUTE MONOTONY MON_INCREASE /end AXIS_DESCR
/end CHARACTERISTIC
/begin CHARACTERISTIC KL_POKABCG35 "Temp. abhängiger Druckoffset auf Schaltdruck KAB fuer HS" CURVE 0x24080C kl_si16_S6_S3 2.5 UMR_BAR__1_1000_0_S6_S3 -1.25 1.25
 /begin AXIS_DESCR STD_AXIS zff_atsys._.iSignale._.obj.sig_c_getr UMR_GRADC__1_1_M40_S6_S3 3 -40 150 DEPOSIT ABSOLUTE MONOTONY MON_INCREASE /end AXIS_DESCR
/end CHARACTERISTIC
/begin CHARACTERISTIC T_VKABHS46 "Verzögerungszeit abschaltende Kupplung bei HS" VALUE 0x26E717 kw_ui8_S6_S3 2000 UMR_MSEC__10_1_0_S6_S3 0 2000 /end CHARACTERISTIC
/begin CHARACTERISTIC KF_TPKABMTCG46 "Zeitoffset Ende Rampe auf Schaltdruck KAB fuer HS" MAP 0x24081C kf_ui8_S6_S3 2000 UMR_MSEC__10_1_M128_S6_S3 -1000 1000
 /begin AXIS_DESCR STD_AXIS zff_atsys._.iSignale._.obj.sig_m_t8 UMR_NM__8_1_M50_S6_S3 8 -400 1640 DEPOSIT ABSOLUTE MONOTONY MON_INCREASE /end AXIS_DESCR
 /begin AXIS_DESCR STD_AXIS zff_atsys._.iSignale._.obj.sig_c_getr UMR_GRADC__1_1_M40_S6_S3 8 -40 150 DEPOSIT ABSOLUTE MONOTONY MON_INCREASE /end AXIS_DESCR
/end CHARACTERISTIC
/begin CHARACTERISTIC KL_TOPKABND46 "Zeitoffset f(nd_synistgang) Ende Rampe auf Schaltdruck KAB fuer HS" CURVE 0x240874 kl_si16_S6_S3 1000 UMR_MSEC__10_1_0_S6_S3 0 1000
 /begin AXIS_DESCR STD_AXIS iSasZentr.iSchaltend.nd_synistgang UMR_U_MIN_1_1_0_S6_S3 4 -8000 8000 DEPOSIT ABSOLUTE MONOTONY MON_INCREASE /end AXIS_DESCR
/end CHARACTERISTIC
/begin CHARACTERISTIC KL_PHKABMT46 "Haltedruck abschaltende Kupplung bei HS" CURVE 0x240888 kl_si16_S6_S3 22 UMR_BAR__1_1000_0_S6_S3 0 22
 /begin AXIS_DESCR STD_AXIS zff_atsys._.iSignale._.obj.sig_m_t UMR_NM__1_1_0_S6_S3 8 -400 1640 DEPOSIT ABSOLUTE MONOTONY MON_INCREASE /end AXIS_DESCR
/end CHARACTERISTIC
/begin CHARACTERISTIC KF_THKABMTCG46 "Zeitoffset Ende Haltephase KAB fuer HS" MAP 0x2408AC kf_ui8_S6_S3 2000 UMR_MSEC__10_1_M128_S6_S3 -1000 1000
 /begin AXIS_DESCR STD_AXIS zff_atsys._.iSignale._.obj.sig_m_t8 UMR_NM__8_1_M50_S6_S3 8 -400 1640 DEPOSIT ABSOLUTE MONOTONY MON_INCREASE /end AXIS_DESCR
 /begin AXIS_DESCR STD_AXIS zff_atsys._.iSignale._.obj.sig_c_getr UMR_GRADC__1_1_M40_S6_S3 8 -40 150 DEPOSIT ABSOLUTE MONOTONY MON_INCREASE /end AXIS_DESCR
/end CHARACTERISTIC
/begin CHARACTERISTIC KL_POKABCG46 "Temp. abhängiger Druckoffset auf Schaltdruck KAB fuer HS" CURVE 0x240904 kl_si16_S6_S3 2.5 UMR_BAR__1_1000_0_S6_S3 -1.25 1.25
 /begin AXIS_DESCR STD_AXIS zff_atsys._.iSignale._.obj.sig_c_getr UMR_GRADC__1_1_M40_S6_S3 3 -40 150 DEPOSIT ABSOLUTE MONOTONY MON_INCREASE /end AXIS_DESCR
/end CHARACTERISTIC
/begin CHARACTERISTIC T_VKABHS57 "Verzögerungszeit abschaltende Kupplung bei HS" VALUE 0x26E718 kw_ui8_S6_S3 2000 UMR_MSEC__10_1_0_S6_S3 0 2000 /end CHARACTERISTIC
/begin CHARACTERISTIC KF_TPKABMTCG57 "Zeitoffset Ende Rampe auf Schaltdruck KAB fuer HS" MAP 0x240914 kf_ui8_S6_S3 2000 UMR_MSEC__10_1_M128_S6_S3 -1000 1000
 /begin AXIS_DESCR STD_AXIS zff_atsys._.iSignale._.obj.sig_m_t8 UMR_NM__8_1_M50_S6_S3 8 -400 1640 DEPOSIT ABSOLUTE MONOTONY MON_INCREASE /end AXIS_DESCR
 /begin AXIS_DESCR STD_AXIS zff_atsys._.iSignale._.obj.sig_c_getr UMR_GRADC__1_1_M40_S6_S3 8 -40 150 DEPOSIT ABSOLUTE MONOTONY MON_INCREASE /end AXIS_DESCR
/end CHARACTERISTIC
/begin CHARACTERISTIC KL_TOPKABND57 "Zeitoffset f(nd_synistgang) Ende Rampe auf Schaltdruck KAB fuer HS" CURVE 0x24096C kl_si16_S6_S3 1000 UMR_MSEC__10_1_0_S6_S3 0 1000
 /begin AXIS_DESCR STD_AXIS iSasZentr.iSchaltend.nd_synistgang UMR_U_MIN_1_1_0_S6_S3 4 -8000 8000 DEPOSIT ABSOLUTE MONOTONY MON_INCREASE /end AXIS_DESCR
/end CHARACTERISTIC
/begin CHARACTERISTIC KL_PHKABMT57 "Haltedruck abschaltende Kupplung bei HS" CURVE 0x240980 kl_si16_S6_S3 22 UMR_BAR__1_1000_0_S6_S3 0 22
 /begin AXIS_DESCR STD_AXIS zff_atsys._.iSignale._.obj.sig_m_t UMR_NM__1_1_0_S6_S3 8 -400 1640 DEPOSIT ABSOLUTE MONOTONY MON_INCREASE /end AXIS_DESCR
/end CHARACTERISTIC
/begin CHARACTERISTIC KF_THKABMTCG57 "Zeitoffset Ende Haltephase KAB fuer HS" MAP 0x2409A4 kf_ui8_S6_S3 2000 UMR_MSEC__10_1_M128_S6_S3 -1000 1000
 /begin AXIS_DESCR STD_AXIS zff_atsys._.iSignale._.obj.sig_m_t8 UMR_NM__8_1_M50_S6_S3 8 -400 1640 DEPOSIT ABSOLUTE MONOTONY MON_INCREASE /end AXIS_DESCR
 /begin AXIS_DESCR STD_AXIS zff_atsys._.iSignale._.obj.sig_c_getr UMR_GRADC__1_1_M40_S6_S3 8 -40 150 DEPOSIT ABSOLUTE MONOTONY MON_INCREASE /end AXIS_DESCR
/end CHARACTERISTIC
/begin CHARACTERISTIC KL_POKABCG57 "Temp. abhängiger Druckoffset auf Schaltdruck KAB fuer HS" CURVE 0x2409FC kl_si16_S6_S3 2.5 UMR_BAR__1_1000_0_S6_S3 -1.25 1.25
 /begin AXIS_DESCR STD_AXIS zff_atsys._.iSignale._.obj.sig_c_getr UMR_GRADC__1_1_M40_S6_S3 3 -40 150 DEPOSIT ABSOLUTE MONOTONY MON_INCREASE /end AXIS_DESCR
/end CHARACTERISTIC
/begin CHARACTERISTIC T_VKABHS68 "Verzögerungszeit abschaltende Kupplung bei HS" VALUE 0x26E719 kw_ui8_S6_S3 2000 UMR_MSEC__10_1_0_S6_S3 0 2000 /end CHARACTERISTIC
/begin CHARACTERISTIC KF_TPKABMTCG68 "Zeitoffset Ende Rampe auf Schaltdruck KAB fuer HS" MAP 0x240A0C kf_ui8_S6_S3 2000 UMR_MSEC__10_1_M128_S6_S3 -1000 1000
 /begin AXIS_DESCR STD_AXIS zff_atsys._.iSignale._.obj.sig_m_t8 UMR_NM__8_1_M50_S6_S3 8 -400 1640 DEPOSIT ABSOLUTE MONOTONY MON_INCREASE /end AXIS_DESCR
 /begin AXIS_DESCR STD_AXIS zff_atsys._.iSignale._.obj.sig_c_getr UMR_GRADC__1_1_M40_S6_S3 8 -40 150 DEPOSIT ABSOLUTE MONOTONY MON_INCREASE /end AXIS_DESCR
/end CHARACTERISTIC
/begin CHARACTERISTIC KL_TOPKABND68 "Zeitoffset f(nd_synistgang) Ende Rampe auf Schaltdruck KAB fuer HS" CURVE 0x240A64 kl_si16_S6_S3 1000 UMR_MSEC__10_1_0_S6_S3 0 1000
 /begin AXIS_DESCR STD_AXIS iSasZentr.iSchaltend.nd_synistgang UMR_U_MIN_1_1_0_S6_S3 4 -8000 8000 DEPOSIT ABSOLUTE MONOTONY MON_INCREASE /end AXIS_DESCR
/end CHARACTERISTIC
/begin CHARACTERISTIC KL_PHKABMT68 "Haltedruck abschaltende Kupplung bei HS" CURVE 0x240A78 kl_si16_S6_S3 22 UMR_BAR__1_1000_0_S6_S3 0 22
 /begin AXIS_DESCR STD_AXIS zff_atsys._.iSignale._.obj.sig_m_t UMR_NM__1_1_0_S6_S3 8 -400 1640 DEPOSIT ABSOLUTE MONOTONY MON_INCREASE /end AXIS_DESCR
/end CHARACTERISTIC
/begin CHARACTERISTIC KF_THKABMTCG68 "Zeitoffset Ende Haltephase KAB fuer HS" MAP 0x240A9C kf_ui8_S6_S3 2000 UMR_MSEC__10_1_M128_S6_S3 -1000 1000
 /begin AXIS_DESCR STD_AXIS zff_atsys._.iSignale._.obj.sig_m_t8 UMR_NM__8_1_M50_S6_S3 8 -400 1640 DEPOSIT ABSOLUTE MONOTONY MON_INCREASE /end AXIS_DESCR
 /begin AXIS_DESCR STD_AXIS zff_atsys._.iSignale._.obj.sig_c_getr UMR_GRADC__1_1_M40_S6_S3 8 -40 150 DEPOSIT ABSOLUTE MONOTONY MON_INCREASE /end AXIS_DESCR
/end CHARACTERISTIC
/begin CHARACTERISTIC KL_POKABCG68 "Temp. abhängiger Druckoffset auf Schaltdruck KAB fuer HS" CURVE 0x240AF4 kl_si16_S6_S3 2.5 UMR_BAR__1_1000_0_S6_S3 -1.25 1.25
 /begin AXIS_DESCR STD_AXIS zff_atsys._.iSignale._.obj.sig_c_getr UMR_GRADC__1_1_M40_S6_S3 3 -40 150 DEPOSIT ABSOLUTE MONOTONY MON_INCREASE /end AXIS_DESCR
/end CHARACTERISTIC
/begin CHARACTERISTIC T_VKABHSSP12 "Verzögerungszeit abschaltende Kupplung bei HS" VALUE 0x26E71A kw_ui8_S6_S3 2000 UMR_MSEC__10_1_0_S6_S3 0 2000 /end CHARACTERISTIC
/begin CHARACTERISTIC KF_TPKABMTCGSP12 "Zeitoffset Ende Rampe auf Schaltdruck KAB fuer HS" MAP 0x240B04 kf_ui8_S6_S3 2000 UMR_MSEC__10_1_M128_S6_S3 -1000 1000
 /begin AXIS_DESCR STD_AXIS zff_atsys._.iSignale._.obj.sig_m_t8 UMR_NM__8_1_M50_S6_S3 8 -400 1640 DEPOSIT ABSOLUTE MONOTONY MON_INCREASE /end AXIS_DESCR
 /begin AXIS_DESCR STD_AXIS zff_atsys._.iSignale._.obj.sig_c_getr UMR_GRADC__1_1_M40_S6_S3 8 -40 150 DEPOSIT ABSOLUTE MONOTONY MON_INCREASE /end AXIS_DESCR
/end CHARACTERISTIC
/begin CHARACTERISTIC KL_TOPKABNDSP12 "Zeitoffset f(nd_synistgang) Ende Rampe auf Schaltdruck KAB fuer HS" CURVE 0x240B5C kl_si16_S6_S3 1000 UMR_MSEC__10_1_0_S6_S3 0 1000
 /begin AXIS_DESCR STD_AXIS iSasZentr.iSchaltend.nd_synistgang UMR_U_MIN_1_1_0_S6_S3 4 -8000 8000 DEPOSIT ABSOLUTE MONOTONY MON_INCREASE /end AXIS_DESCR
/end CHARACTERISTIC
/begin CHARACTERISTIC KL_PHKABMTSP12 "Haltedruck abschaltende Kupplung bei HS" CURVE 0x240B70 kl_si16_S6_S3 22 UMR_BAR__1_1000_0_S6_S3 0 22
 /begin AXIS_DESCR STD_AXIS zff_atsys._.iSignale._.obj.sig_m_t UMR_NM__1_1_0_S6_S3 8 -400 1640 DEPOSIT ABSOLUTE MONOTONY MON_INCREASE /end AXIS_DESCR
/end CHARACTERISTIC
/begin CHARACTERISTIC KF_THKABMTCGSP12 "Zeitoffset Ende Haltephase KAB fuer HS" MAP 0x240B94 kf_ui8_S6_S3 2000 UMR_MSEC__10_1_M128_S6_S3 -1000 1000
 /begin AXIS_DESCR STD_AXIS zff_atsys._.iSignale._.obj.sig_m_t8 UMR_NM__8_1_M50_S6_S3 8 -400 1640 DEPOSIT ABSOLUTE MONOTONY MON_INCREASE /end AXIS_DESCR
 /begin AXIS_DESCR STD_AXIS zff_atsys._.iSignale._.obj.sig_c_getr UMR_GRADC__1_1_M40_S6_S3 8 -40 150 DEPOSIT ABSOLUTE MONOTONY MON_INCREASE /end AXIS_DESCR
/end CHARACTERISTIC
/begin CHARACTERISTIC KL_POKABCGSP12 "Temp. abhängiger Druckoffset auf Schaltdruck KAB fuer HS" CURVE 0x240BEC kl_si16_S6_S3 2.5 UMR_BAR__1_1000_0_S6_S3 -1.25 1.25
 /begin AXIS_DESCR STD_AXIS zff_atsys._.iSignale._.obj.sig_c_getr UMR_GRADC__1_1_M40_S6_S3 3 -40 150 DEPOSIT ABSOLUTE MONOTONY MON_INCREASE /end AXIS_DESCR
/end CHARACTERISTIC
/begin CHARACTERISTIC T_VKABHSSP23 "Verzögerungszeit abschaltende Kupplung bei HS" VALUE 0x26E71B kw_ui8_S6_S3 2000 UMR_MSEC__10_1_0_S6_S3 0 2000 /end CHARACTERISTIC
/begin CHARACTERISTIC KF_TPKABMTCGSP23 "Zeitoffset Ende Rampe auf Schaltdruck KAB fuer HS" MAP 0x240BFC kf_ui8_S6_S3 2000 UMR_MSEC__10_1_M128_S6_S3 -1000 1000
 /begin AXIS_DESCR STD_AXIS zff_atsys._.iSignale._.obj.sig_m_t8 UMR_NM__8_1_M50_S6_S3 8 -400 1640 DEPOSIT ABSOLUTE MONOTONY MON_INCREASE /end AXIS_DESCR
 /begin AXIS_DESCR STD_AXIS zff_atsys._.iSignale._.obj.sig_c_getr UMR_GRADC__1_1_M40_S6_S3 8 -40 150 DEPOSIT ABSOLUTE MONOTONY MON_INCREASE /end AXIS_DESCR
/end CHARACTERISTIC
/begin CHARACTERISTIC KL_TOPKABNDSP23 "Zeitoffset f(nd_synistgang) Ende Rampe auf Schaltdruck KAB fuer HS" CURVE 0x240C54 kl_si16_S6_S3 1000 UMR_MSEC__10_1_0_S6_S3 0 1000
 /begin AXIS_DESCR STD_AXIS iSasZentr.iSchaltend.nd_synistgang UMR_U_MIN_1_1_0_S6_S3 4 -8000 8000 DEPOSIT ABSOLUTE MONOTONY MON_INCREASE /end AXIS_DESCR
/end CHARACTERISTIC
/begin CHARACTERISTIC KL_PHKABMTSP23 "Haltedruck abschaltende Kupplung bei HS" CURVE 0x240C68 kl_si16_S6_S3 22 UMR_BAR__1_1000_0_S6_S3 0 22
 /begin AXIS_DESCR STD_AXIS zff_atsys._.iSignale._.obj.sig_m_t UMR_NM__1_1_0_S6_S3 8 -400 1640 DEPOSIT ABSOLUTE MONOTONY MON_INCREASE /end AXIS_DESCR
/end CHARACTERISTIC
/begin CHARACTERISTIC KF_THKABMTCGSP23 "Zeitoffset Ende Haltephase KAB fuer HS" MAP 0x240C8C kf_ui8_S6_S3 2000 UMR_MSEC__10_1_M128_S6_S3 -1000 1000
 /begin AXIS_DESCR STD_AXIS zff_atsys._.iSignale._.obj.sig_m_t8 UMR_NM__8_1_M50_S6_S3 8 -400 1640 DEPOSIT ABSOLUTE MONOTONY MON_INCREASE /end AXIS_DESCR
 /begin AXIS_DESCR STD_AXIS zff_atsys._.iSignale._.obj.sig_c_getr UMR_GRADC__1_1_M40_S6_S3 8 -40 150 DEPOSIT ABSOLUTE MONOTONY MON_INCREASE /end AXIS_DESCR
/end CHARACTERISTIC
/begin CHARACTERISTIC KL_POKABCGSP23 "Temp. abhängiger Druckoffset auf Schaltdruck KAB fuer HS" CURVE 0x240CE4 kl_si16_S6_S3 2.5 UMR_BAR__1_1000_0_S6_S3 -1.25 1.25
 /begin AXIS_DESCR STD_AXIS zff_atsys._.iSignale._.obj.sig_c_getr UMR_GRADC__1_1_M40_S6_S3 3 -40 150 DEPOSIT ABSOLUTE MONOTONY MON_INCREASE /end AXIS_DESCR
/end CHARACTERISTIC
/begin COMPU_METHOD SAB_249PROZENT1000_M127_S2_S3 "int = ((phys * 1000) / 249) - (-127) %" RAT_FUNC "%5.3" "%" COEFFS 0 1000 31623 0 0 249 /end COMPU_METHOD
/begin COMPU_METHOD SAB_T_TIMER_50NS_S2_S3 "int = ((phys * 20000) / 1) - (0) ms" RAT_FUNC "%7.5" "ms" COEFFS 0 20000 -0 0 0 1 /end COMPU_METHOD
/begin COMPU_METHOD SAB_T_TIMER_125NS_S2_S3 "int = ((phys * 8000) / 1) - (0) ms" RAT_FUNC "%8.6" "ms" COEFFS 0 8000 -0 0 0 1 /end COMPU_METHOD
/begin COMPU_METHOD SAB_T_TIMER_31NS25_S2_S3 "int = ((phys * 32000) / 1) - (0) ms" RAT_FUNC "%10.8" "ms" COEFFS 0 32000 -0 0 0 1 /end COMPU_METHOD
/begin COMPU_METHOD SAB_T_TIMER_266NS66_S2_S3 "int = ((phys * 3750) / 1) - (0) ms" RAT_FUNC "%10.8" "ms" COEFFS 0 3750 -0 0 0 1 /end COMPU_METHOD
/begin COMPU_METHOD SAB_T_TIMER_100US_S2_S3 "int = ((phys * 1) / 100) - (0) us" RAT_FUNC "%5.3" "us" COEFFS 0 1 -0 0 0 100 /end COMPU_METHOD
/begin COMPU_METHOD UMR___1_10_0_S6_S3 "int = ((phys * 10) / 1) - (0) [-]" RAT_FUNC "%3.1" "[-]" COEFFS 0 10 -0 0 0 1 /end COMPU_METHOD
/begin COMPU_METHOD UMR___1_1_0_S6_S3 "int = ((phys * 1) / 1) - (0) [-]" RAT_FUNC "%2.0" "[-]" COEFFS 0 1 -0 0 0 1 /end COMPU_METHOD
/begin COMPU_METHOD UMR_NM__1_1_0_S6_S3 "int = ((phys * 1) / 1) - (0) [Nm]" RAT_FUNC "%2.0" "[Nm]" COEFFS 0 1 -0 0 0 1 /end COMPU_METHOD
/begin COMPU_METHOD UMR_NM__8_1_M50_S6_S3 "int = ((phys * 1) / 8) - (-50) [Nm]" RAT_FUNC "%2.0" "[Nm]" COEFFS 0 1 400 0 0 8 /end COMPU_METHOD
/begin COMPU_METHOD UMR_BAR__1_1000_0_S6_S3 "int = ((phys * 1000) / 1) - (0) [bar]" RAT_FUNC "%5.3" "[bar]" COEFFS 0 1000 -0 0 0 1 /end COMPU_METHOD
/begin COMPU_METHOD UMR_BAR_SEC_1_10_0_S6_S3 "int = ((phys * 10) / 1) - (0) [bar/s]" RAT_FUNC "%3.1" "[bar/s]" COEFFS 0 10 -0 0 0 1 /end COMPU_METHOD
/begin COMPU_METHOD UMR_U_MIN_1_1_0_S6_S3 "int = ((phys * 1) / 1) - (0) [U/min]" RAT_FUNC "%2.0" "[U/min]" COEFFS 0 1 -0 0 0 1 /end COMPU_METHOD
/begin COMPU_METHOD UMR_U_MIN_32_1_0_S6_S3 "int = ((phys * 1) / 32) - (0) [U/min]" RAT_FUNC "%2.0" "[U/min]" COEFFS 0 1 -0 0 0 32 /end COMPU_METHOD
/begin COMPU_METHOD UMR_U_MINSEC_1_1_0_S6_S3 "int = ((phys * 1) / 1) - (0) [U/(min*s)]" RAT_FUNC "%2.0" "[U/(min*s)]" COEFFS 0 1 -0 0 0 1 /end COMPU_METHOD
/begin COMPU_METHOD UMR_MSEC__10_1_0_S6_S3 "int = ((phys * 1) / 10) - (0) [ms]" RAT_FUNC "%2.0" "[ms]" COEFFS 0 1 -0 0 0 10 /end COMPU_METHOD
/begin COMPU_METHOD UMR_MSEC__10_1_M128_S6_S3 "int = ((phys * 1) / 10) - (-128) [ms]" RAT_FUNC "%2.0" "[ms]" COEFFS 0 1 1280 0 0 10 /end COMPU_METHOD
/begin COMPU_METHOD UMR_GRADC__1_1_M40_S6_S3 "int = ((phys * 1) / 1) - (-40) [°C]" RAT_FUNC "%2.0" "[°C]" COEFFS 0 1 40 0 0 1 /end COMPU_METHOD
/begin FUNCTION jSasKzuRSS54_Fktn "Applikationesgroessen Instanz jSasKzuRSS54"
 /begin DEF_CHARACTERISTIC KF_PKZUWS54 KF_T2_DT_IG_CHANGE54 KF_TSYNMTNTRAKZUWS54 KF_T_DT_IG_CHANGE54 KL_FPGRASYN54 KL_PGOKZU54 KL_PGOKZUWS54 KL_POFCG54 KL_POFMDMOTSOLL54 KL_POKZUCG54 KL_POKZUMDMOTSOLL54 KL_POKZUNGAB54 KL_POMDTSYN54 KL_PORAKZU54 KL_PORASYN54 KL_TSYNCGRAKZU54 KL_TSYNMTKZUSFV54 KL_TSYNMTTRAKZUV54 TO_VKZUSLST54 T_MIN_IG_CHANGE54 T_RA2SSCHR54 T_SYN54 T_VKZU54 /end DEF_CHARACTERISTIC
/end FUNCTION
/begin FUNCTION jSasKzuRSS65_Fktn "Applikationesgroessen Instanz jSasKzuRSS65"
 /begin DEF_CHARACTERISTIC KF_PKZUWS65 KF_T2_DT_IG_CHANGE65 KF_TSYNMTNTRAKZUWS65 KF_T_DT_IG_CHANGE65 KL_FPGRASYN65 KL_PGOKZU65 KL_PGOKZUWS65 KL_POFCG65 KL_POFMDMOTSOLL65 KL_POKZUCG65 KL_POKZUMDMOTSOLL65 KL_POKZUNGAB65 KL_POMDTSYN65 KL_PORAKZU65 KL_PORASYN65 KL_TSYNCGRAKZU65 KL_TSYNMTKZUSFV65 KL_TSYNMTTRAKZUV65 TO_VKZUSLST65 T_MIN_IG_CHANGE65 T_RA2SSCHR65 T_SYN65 T_VKZU65 /end DEF_CHARACTERISTIC
/end FUNCTION
/begin FUNCTION jSasKzuRSS76_Fktn "Applikationesgroessen Instanz jSasKzuRSS76"
 /begin DEF_CHARACTERISTIC KF_PKZUWS76 KF_T2_DT_IG_CHANGE76 KF_TSYNMTNTRAKZUWS76 KF_T_DT_IG_CHANGE76 KL_FPGRASYN76 KL_PGOKZU76 KL_PGOKZUWS76 KL_POFCG76 KL_POFMDMOTSOLL76 KL_POKZUCG76 KL_POKZUMDMOTSOLL76 KL_POKZUNGAB76 KL_POMDTSYN76 KL_PORAKZU76 KL_PORASYN76 KL_TSYNCGRAKZU76 KL_TSYNMTKZUSFV76 KL_TSYNMTTRAKZUV76 TO_VKZUSLST76 T_MIN_IG_CHANGE76 T_RA2SSCHR76 T_SYN76 T_VKZU76 /end DEF_CHARACTERISTIC
/end FUNCTION
/begin FUNCTION jSasKzuRSS87_Fktn "Applikationesgroessen Instanz jSasKzuRSS87"
 /begin DEF_CHARACTERISTIC KF_PKZUWS87 KF_T2_DT_IG_CHANGE87 KF_TSYNMTNTRAKZUWS87 KF_T_DT_IG_CHANGE87 KL_FPGRASYN87 KL_PGOKZU87 KL_PGOKZUWS87 KL_POFCG87 KL_POFMDMOTSOLL87 KL_POKZUCG87 KL_POKZUMDMOTSOLL87 KL_POKZUNGAB87 KL_POMDTSYN87 KL_PORAKZU87 KL_PORASYN87 KL_TSYNCGRAKZU87 KL_TSYNMTKZUSFV87 KL_TSYNMTTRAKZUV87 TO_VKZUSLST87 T_MIN_IG_CHANGE87 T_RA2SSCHR87 T_SYN87 T_VKZU87 /end DEF_CHARACTERISTIC
/end FUNCTION
/begin FUNCTION jSasKzuRSS31_Fktn "Applikationesgroessen Instanz jSasKzuRSS31"
 /begin DEF_CHARACTERISTIC KF_PKZUWSSP31 KF_T2_DT_IG_CHANGESP31 KF_TSYNMTNTRAKZUWSSP31 KF_T_DT_IG_CHANGESP31 KL_FPGRASYNSP31 KL_PGOKZUSP31 KL_PGOKZUWSSP31 KL_POFCGSP31 KL_POFMDMOTSOLLSP31 KL_POKZUCGSP31 KL_POKZUMDMOTSOLLSP31 KL_POKZUNGABSP31 KL_POMDTSYNSP31 KL_PORAKZUSP31 KL_PORASYNSP31 KL_TSYNCGRAKZUSP31 KL_TSYNMTKZUSFVSP31 KL_TSYNMTTRAKZUVSP31 TO_VKZUSLSTSP31 T_MIN_IG_CHANGESP31 T_RA2SSCHRSP31 T_SYNSP31 T_VKZUSP31 /end DEF_CHARACTERISTIC
/end FUNCTION
/begin FUNCTION jSasKzuRSS42_Fktn "Applikationesgroessen Instanz jSasKzuRSS42"
 /begin DEF_CHARACTERISTIC KF_PKZUWSSP42 KF_T2_DT_IG_CHANGESP42 KF_TSYNMTNTRAKZUWSSP42 KF_T_DT_IG_CHANGESP42 KL_FPGRASYNSP42 KL_PGOKZUSP42 KL_PGOKZUWSSP42 KL_POFCGSP42 KL_POFMDMOTSOLLSP42 KL_POKZUCGSP42 KL_POKZUMDMOTSOLLSP42 KL_POKZUNGABSP42 KL_POMDTSYNSP42 KL_PORAKZUSP42 KL_PORASYNSP42 KL_TSYNCGRAKZUSP42 KL_TSYNMTKZUSFVSP42 KL_TSYNMTTRAKZUVSP42 TO_VKZUSLSTSP42 T_MIN_IG_CHANGESP42 T_RA2SSCHRSP42 T_SYNSP42 T_VKZUSP42 /end DEF_CHARACTERISTIC
/end FUNCTION
/begin FUNCTION jSasKzuRSS51_Fktn "Applikationesgroessen Instanz jSasKzuRSS51"
 /begin DEF_CHARACTERISTIC KF_PKZUWSSP51 KF_T2_DT_IG_CHANGESP51 KF_TSYNMTNTRAKZUWSSP51 KF_T_DT_IG_CHANGESP51 KL_FPGRASYNSP51 KL_PGOKZUSP51 KL_PGOKZUWSSP51 KL_POFCGSP51 KL_POFMDMOTSOLLSP51 KL_POKZUCGSP51 KL_POKZUMDMOTSOLLSP51 KL_POKZUNGABSP51 KL_POMDTSYNSP51 KL_PORAKZUSP51 KL_PORASYNSP51 KL_TSYNCGRAKZUSP51 KL_TSYNMTKZUSFVSP51 KL_TSYNMTTRAKZUVSP51 TO_VKZUSLSTSP51 T_MIN_IG_CHANGESP51 T_RA2SSCHRSP51 T_SYNSP51 T_VKZUSP51 /end DEF_CHARACTERISTIC
/end FUNCTION
/begin FUNCTION jSasKzuRSS53_Fktn "Applikationesgroessen Instanz jSasKzuRSS53"
 /begin DEF_CHARACTERISTIC KF_PKZUWSSP53 KF_T2_DT_IG_CHANGESP53 KF_TSYNMTNTRAKZUWSSP53 KF_T_DT_IG_CHANGESP53 KL_FPGRASYNSP53 KL_PGOKZUSP53 KL_PGOKZUWSSP53 KL_POFCGSP53 KL_POFMDMOTSOLLSP53 KL_POKZUCGSP53 KL_POKZUMDMOTSOLLSP53 KL_POKZUNGABSP53 KL_POMDTSYNSP53 KL_PORAKZUSP53 KL_PORASYNSP53 KL_TSYNCGRAKZUSP53 KL_TSYNMTKZUSFVSP53 KL_TSYNMTTRAKZUVSP53 TO_VKZUSLSTSP53 T_MIN_IG_CHANGESP53 T_RA2SSCHRSP53 T_SYNSP53 T_VKZUSP53 /end DEF_CHARACTERISTIC
/end FUNCTION
/begin FUNCTION jSasKzuRSS63_Fktn "Applikationesgroessen Instanz jSasKzuRSS63"
 /begin DEF_CHARACTERISTIC KF_PKZUWSSP63 KF_T2_DT_IG_CHANGESP63 KF_TSYNMTNTRAKZUWSSP63 KF_T_DT_IG_CHANGESP63 KL_FPGRASYNSP63 KL_PGOKZUSP63 KL_PGOKZUWSSP63 KL_POFCGSP63 KL_POFMDMOTSOLLSP63 KL_POKZUCGSP63 KL_POKZUMDMOTSOLLSP63 KL_POKZUNGABSP63 KL_POMDTSYNSP63 KL_PORAKZUSP63 KL_PORASYNSP63 KL_TSYNCGRAKZUSP63 KL_TSYNMTKZUSFVSP63 KL_TSYNMTTRAKZUVSP63 TO_VKZUSLSTSP63 T_MIN_IG_CHANGESP63 T_RA2SSCHRSP63 T_SYNSP63 T_VKZUSP63 /end DEF_CHARACTERISTIC
/end FUNCTION
/begin FUNCTION jSasKzuRSS64_Fktn "Applikationesgroessen Instanz jSasKzuRSS64"
 /begin DEF_CHARACTERISTIC KF_PKZUWSSP64 KF_T2_DT_IG_CHANGESP64 KF_TSYNMTNTRAKZUWSSP64 KF_T_DT_IG_CHANGESP64 KL_FPGRASYNSP64 KL_PGOKZUSP64 KL_PGOKZUWSSP64 KL_POFCGSP64 KL_POFMDMOTSOLLSP64 KL_POKZUCGSP64 KL_POKZUMDMOTSOLLSP64 KL_POKZUNGABSP64 KL_POMDTSYNSP64 KL_PORAKZUSP64 KL_PORASYNSP64 KL_TSYNCGRAKZUSP64 KL_TSYNMTKZUSFVSP64 KL_TSYNMTTRAKZUVSP64 TO_VKZUSLSTSP64 T_MIN_IG_CHANGESP64 T_RA2SSCHRSP64 T_SYNSP64 T_VKZUSP64 /end DEF_CHARACTERISTIC
/end FUNCTION
/begin FUNCTION jSasKzuRSS71_Fktn "Applikationesgroessen Instanz jSasKzuRSS71"
 /begin DEF_CHARACTERISTIC KF_PKZUWSSP71 KF_T2_DT_IG_CHANGESP71 KF_TSYNMTNTRAKZUWSSP71 KF_T_DT_IG_CHANGESP71 KL_FPGRASYNSP71 KL_PGOKZUSP71 KL_PGOKZUWSSP71 KL_POFCGSP71 KL_POFMDMOTSOLLSP71 KL_POKZUCGSP71 KL_POKZUMDMOTSOLLSP71 KL_POKZUNGABSP71 KL_POMDTSYNSP71 KL_PORAKZUSP71 KL_PORASYNSP71 KL_TSYNCGRAKZUSP71 KL_TSYNMTKZUSFVSP71 KL_TSYNMTTRAKZUVSP71 TO_VKZUSLSTSP71 T_MIN_IG_CHANGESP71 T_RA2SSCHRSP71 T_SYNSP71 T_VKZUSP71 /end DEF_CHARACTERISTIC
/end FUNCTION
/begin FUNCTION jSasKzuRSS75_Fktn "Applikationesgroessen Instanz jSasKzuRSS75"
 /begin DEF_CHARACTERISTIC KF_PKZUWSSP75 KF_T2_DT_IG_CHANGESP75 KF_TSYNMTNTRAKZUWSSP75 KF_T_DT_IG_CHANGESP75 KL_FPGRASYNSP75 KL_PGOKZUSP75 KL_PGOKZUWSSP75 KL_POFCGSP75 KL_POFMDMOTSOLLSP75 KL_POKZUCGSP75 KL_POKZUMDMOTSOLLSP75 KL_POKZUNGABSP75 KL_POMDTSYNSP75 KL_PORAKZUSP75 KL_PORASYNSP75 KL_TSYNCGRAKZUSP75 KL_TSYNMTKZUSFVSP75 KL_TSYNMTTRAKZUVSP75 TO_VKZUSLSTSP75 T_MIN_IG_CHANGESP75 T_RA2SSCHRSP75 T_SYNSP75 T_VKZUSP75 /end DEF_CHARACTERISTIC
/end FUNCTION
/begin FUNCTION jSasKzuRSS82_Fktn "Applikationesgroessen Instanz jSasKzuRSS82"
 /begin DEF_CHARACTERISTIC KF_PKZUWSSP82 KF_T2_DT_IG_CHANGESP82 KF_TSYNMTNTRAKZUWSSP82 KF_T_DT_IG_CHANGESP82 KL_FPGRASYNSP82 KL_PGOKZUSP82 KL_PGOKZUWSSP82 KL_POFCGSP82 KL_POFMDMOTSOLLSP82 KL_POKZUCGSP82 KL_POKZUMDMOTSOLLSP82 KL_POKZUNGABSP82 KL_POMDTSYNSP82 KL_PORAKZUSP82 KL_PORASYNSP82 KL_TSYNCGRAKZUSP82 KL_TSYNMTKZUSFVSP82 KL_TSYNMTTRAKZUVSP82 TO_VKZUSLSTSP82 T_MIN_IG_CHANGESP82 T_RA2SSCHRSP82 T_SYNSP82 T_VKZUSP82 /end DEF_CHARACTERISTIC
/end FUNCTION
/begin FUNCTION jSasKzuRSS84_Fktn "Applikationesgroessen Instanz jSasKzuRSS84"
 /begin DEF_CHARACTERISTIC KF_PKZUWSSP84 KF_T2_DT_IG_CHANGESP84 KF_TSYNMTNTRAKZUWSSP84 KF_T_DT_IG_CHANGESP84 KL_FPGRASYNSP84 KL_PGOKZUSP84 KL_PGOKZUWSSP84 KL_POFCGSP84 KL_POFMDMOTSOLLSP84 KL_POKZUCGSP84 KL_POKZUMDMOTSOLLSP84 KL_POKZUNGABSP84 KL_POMDTSYNSP84 KL_PORAKZUSP84 KL_PORASYNSP84 KL_TSYNCGRAKZUSP84 KL_TSYNMTKZUSFVSP84 KL_TSYNMTTRAKZUVSP84 TO_VKZUSLSTSP84 T_MIN_IG_CHANGESP84 T_RA2SSCHRSP84 T_SYNSP84 T_VKZUSP84 /end DEF_CHARACTERISTIC
/end FUNCTION
/begin FUNCTION jSasKzuRSS86_Fktn "Applikationesgroessen Instanz jSasKzuRSS86"
 /begin DEF_CHARACTERISTIC KF_PKZUWSSP86 KF_T2_DT_IG_CHANGESP86 KF_TSYNMTNTRAKZUWSSP86 KF_T_DT_IG_CHANGESP86 KL_FPGRASYNSP86 KL_PGOKZUSP86 KL_PGOKZUWSSP86 KL_POFCGSP86 KL_POFMDMOTSOLLSP86 KL_POKZUCGSP86 KL_POKZUMDMOTSOLLSP86 KL_POKZUNGABSP86 KL_POMDTSYNSP86 KL_PORAKZUSP86 KL_PORASYNSP86 KL_TSYNCGRAKZUSP86 KL_TSYNMTKZUSFVSP86 KL_TSYNMTTRAKZUVSP86 TO_VKZUSLSTSP86 T_MIN_IG_CHANGESP86 T_RA2SSCHRSP86 T_SYNSP86 T_VKZUSP86 /end DEF_CHARACTERISTIC
/end FUNCTION
/begin FUNCTION dSasKzuAl_Fktn "Applikationesgroessen der Komponente dSasKzuAl" /begin SUB_FUNCTION jSasKzuAl_Fktn /end SUB_FUNCTION /end FUNCTION
/begin FUNCTION jSasKzuAl_Fktn "Applikationesgroessen Instanz jSasKzuAl"
 /begin DEF_CHARACTERISTIC KF_POFMTNESTART12 KF_POFMTNESTART12_EL KF_TFMTNTESTART12 KL_PGOFMTESTART12 TAB_SWI_POKZUFOL /end DEF_CHARACTERISTIC
/end FUNCTION
/begin FUNCTION dSasKabHSS_Fktn "Applikationesgroessen der Komponente dSasKabHSS"
 /begin SUB_FUNCTION jSasKabHSS12_Fktn jSasKabHSS23_Fktn jSasKabHSS34_Fktn jSasKabHSS45_Fktn jSasKabHSS56_Fktn jSasKabHSS67_Fktn jSasKabHSS78_Fktn jSasKabHSS13_Fktn jSasKabHSS24_Fktn jSasKabHSS35_Fktn jSasKabHSS46_Fktn jSasKabHSS57_Fktn jSasKabHSS68_Fktn /end SUB_FUNCTION
/end FUNCTION
/begin FUNCTION jSasKabHSS12_Fktn "Applikationesgroessen Instanz jSasKabHSS12"
 /begin DEF_CHARACTERISTIC KF_PKAB12 KF_PKAB12_EL KL_PGOMTKAB12 PO_HKAB12 PS_ABBSYNISTHS12 TO_HKAB12 T_SYNKABE12 /end DEF_CHARACTERISTIC
/end FUNCTION
/begin FUNCTION jSasKabHSS23_Fktn "Applikationesgroessen Instanz jSasKabHSS23"
 /begin DEF_CHARACTERISTIC KF_PKAB23 KF_PKAB23_EL KL_PGOMTKAB23 PO_HKAB23 PS_ABBSYNISTHS23 TO_HKAB23 T_SYNKABE23 /end DEF_CHARACTERISTIC
/end FUNCTION
/begin FUNCTION jSasKabHSS34_Fktn "Applikationesgroessen Instanz jSasKabHSS34"
 /begin DEF_CHARACTERISTIC KF_PKAB34 KF_PKAB34_EL KL_PGOMTKAB34 PO_HKAB34 PS_ABBSYNISTHS34 TO_HKAB34 T_SYNKABE34 /end DEF_CHARACTERISTIC
/end FUNCTION
/begin FUNCTION jSasKabHSS45_Fktn "Applikationesgroessen Instanz jSasKabHSS45"
 /begin DEF_CHARACTERISTIC KF_PKAB45 KF_PKAB45_EL KL_PGOMTKAB45 PO_HKAB45 PS_ABBSYNISTHS45 TO_HKAB45 T_SYNKABE45 /end DEF_CHARACTERISTIC
/end FUNCTION
/begin FUNCTION jSasKabHSS56_Fktn "Applikationesgroessen Instanz jSasKabHSS56"
 /begin DEF_CHARACTERISTIC KF_PKAB56 KF_PKAB56_EL KL_PGOMTKAB56 PO_HKAB56 PS_ABBSYNISTHS56 TO_HKAB56 T_SYNKABE56 /end DEF_CHARACTERISTIC
/end FUNCTION
/begin FUNCTION jSasKabHSS67_Fktn "Applikationesgroessen Instanz jSasKabHSS67"
 /begin DEF_CHARACTERISTIC KF_PKAB67 KF_PKAB67_EL KL_PGOMTKAB67 PO_HKAB67 PS_ABBSYNISTHS67 TO_HKAB67 T_SYNKABE67 /end DEF_CHARACTERISTIC
/end FUNCTION
/begin FUNCTION jSasKabHSS78_Fktn "Applikationesgroessen Instanz jSasKabHSS78"
 /begin DEF_CHARACTERISTIC KF_PKAB78 KF_PKAB78_EL KL_PGOMTKAB78 PO_HKAB78 PS_ABBSYNISTHS78 TO_HKAB78 T_SYNKABE78 /end DEF_CHARACTERISTIC
/end FUNCTION
/begin FUNCTION jSasKabHSS13_Fktn "Applikationesgroessen Instanz jSasKabHSS13"
 /begin DEF_CHARACTERISTIC KF_PKAB13 KL_PGOMTKAB13 PO_HKAB13 PS_ABBSYNISTHS13 TO_HKAB13 T_SYNKABE13 /end DEF_CHARACTERISTIC
/end FUNCTION
/begin FUNCTION jSasKabHSS24_Fktn "Applikationesgroessen Instanz jSasKabHSS24"
 /begin DEF_CHARACTERISTIC KF_PKAB24 KL_PGOMTKAB24 PO_HKAB24 PS_ABBSYNISTHS24 TO_HKAB24 T_SYNKABE24 /end DEF_CHARACTERISTIC
/end FUNCTION
/begin FUNCTION jSasKabHSS35_Fktn "Applikationesgroessen Instanz jSasKabHSS35"
 /begin DEF_CHARACTERISTIC KF_PKAB35 KL_PGOMTKAB35 PO_HKAB35 PS_ABBSYNISTHS35 TO_HKAB35 T_SYNKABE35 /end DEF_CHARACTERISTIC
/end FUNCTION
/begin FUNCTION jSasKabHSS46_Fktn "Applikationesgroessen Instanz jSasKabHSS46"
 /begin DEF_CHARACTERISTIC KF_PKAB46 KL_PGOMTKAB46 PO_HKAB46 PS_ABBSYNISTHS46 TO_HKAB46 T_SYNKABE46 /end DEF_CHARACTERISTIC
/end FUNCTION
/begin FUNCTION jSasKabHSS57_Fktn "Applikationesgroessen Instanz jSasKabHSS57"
 /begin DEF_CHARACTERISTIC KF_PKAB57 KL_PGOMTKAB57 PO_HKAB57 PS_ABBSYNISTHS57 TO_HKAB57 T_SYNKABE57 /end DEF_CHARACTERISTIC
/end FUNCTION
/begin FUNCTION jSasKabHSS68_Fktn "Applikationesgroessen Instanz jSasKabHSS68"
 /begin DEF_CHARACTERISTIC KF_PKAB68 KL_PGOMTKAB68 PO_HKAB68 PS_ABBSYNISTHS68 TO_HKAB68 T_SYNKABE68 /end DEF_CHARACTERISTIC
/end FUNCTION
/begin FUNCTION dSasKabHSP_Fktn "Applikationesgroessen der Komponente dSasKabHSP"
 /begin SUB_FUNCTION jSasKabHSP112_Fktn jSasKabHSP123_Fktn jSasKabHSP134_Fktn jSasKabHSP145_Fktn jSasKabHSP156_Fktn jSasKabHSP167_Fktn jSasKabHSP178_Fktn jSasKabHSP113_Fktn jSasKabHSP124_Fktn jSasKabHSP135_Fktn jSasKabHSP146_Fktn jSasKabHSP157_Fktn jSasKabHSP168_Fktn jSasKabHSP212_Fktn jSasKabHSP223_Fktn jSasKabHSP234_Fktn jSasKabHSP245_Fktn jSasKabHSP256_Fktn jSasKabHSP267_Fktn jSasKabHSP278_Fktn jSasKabHSP213_Fktn jSasKabHSP224_Fktn jSasKabHSP235_Fktn jSasKabHSP246_Fktn jSasKabHSP257_Fktn jSasKabHSP268_Fktn jSasKabHSP312_Fktn jSasKabHSP323_Fktn jSasKabHSP334_Fktn jSasKabHSP345_Fktn jSasKabHSP356_Fktn jSasKabHSP367_Fktn jSasKabHSP378_Fktn jSasKabHSP313_Fktn jSasKabHSP324_Fktn jSasKabHSP335_Fktn jSasKabHSP346_Fktn jSasKabHSP357_Fktn jSasKabHSP368_Fktn /end SUB_FUNCTION
/end FUNCTION
/begin FUNCTION jSasKabHSP112_Fktn "Applikationesgroessen Instanz jSasKabHSP112"
 /begin DEF_CHARACTERISTIC KF_THKABMTCG12 KF_THKABMTCG12_EL KF_TPKABMTCG12 KF_TPKABMTCG12_EL KL_PHKABMT12 KL_PHKABMT12_EL KL_POKABCG12 KL_POKABCG12_EL KL_TOPKABND12 KL_TOPKABND12_EL T_VKABHS12 /end DEF_CHARACTERISTIC
/end FUNCTION
/begin FUNCTION jSasKabHSP123_Fktn "Applikationesgroessen Instanz jSasKabHSP123"
 /begin DEF_CHARACTERISTIC KF_THKABMTCG23 KF_THKABMTCG23_EL KF_TPKABMTCG23 KF_TPKABMTCG23_EL KL_PHKABMT23 KL_PHKABMT23_EL KL_POKABCG23 KL_POKABCG23_EL KL_TOPKABND23 KL_TOPKABND23_EL T_VKABHS23 /end DEF_CHARACTERISTIC
/end FUNCTION
/begin FUNCTION jSasKabHSP134_Fktn "Applikationesgroessen Instanz jSasKabHSP134"
 /begin DEF_CHARACTERISTIC KF_THKABMTCG34 KF_THKABMTCG34_EL KF_TPKABMTCG34 KF_TPKABMTCG34_EL KL_PHKABMT34 KL_PHKABMT34_EL KL_POKABCG34 KL_POKABCG34_EL KL_TOPKABND34 KL_TOPKABND34_EL T_VKABHS34 /end DEF_CHARACTERISTIC
/end FUNCTION
/begin FUNCTION jSasKabHSP145_Fktn "Applikationesgroessen Instanz jSasKabHSP145"
 /begin DEF_CHARACTERISTIC KF_THKABMTCG45 KF_THKABMTCG45_EL KF_TPKABMTCG45 KF_TPKABMTCG45_EL KL_PHKABMT45 KL_PHKABMT45_EL KL_POKABCG45 KL_POKABCG45_EL KL_TOPKABND45 KL_TOPKABND45_EL T_VKABHS45 /end DEF_CHARACTERISTIC
/end FUNCTION
/begin FUNCTION jSasKabHSP156_Fktn "Applikationesgroessen Instanz jSasKabHSP156"
 /begin DEF_CHARACTERISTIC KF_THKABMTCG56 KF_THKABMTCG56_EL KF_TPKABMTCG56 KF_TPKABMTCG56_EL KL_PHKABMT56 KL_PHKABMT56_EL KL_POKABCG56 KL_POKABCG56_EL KL_TOPKABND56 KL_TOPKABND56_EL T_VKABHS56 /end DEF_CHARACTERISTIC
/end FUNCTION
/begin FUNCTION jSasKabHSP167_Fktn "Applikationesgroessen Instanz jSasKabHSP167"
 /begin DEF_CHARACTERISTIC KF_THKABMTCG67 KF_THKABMTCG67_EL KF_TPKABMTCG67 KF_TPKABMTCG67_EL KL_PHKABMT67 KL_PHKABMT67_EL KL_POKABCG67 KL_POKABCG67_EL KL_TOPKABND67 KL_TOPKABND67_EL T_VKABHS67 /end DEF_CHARACTERISTIC
/end FUNCTION
/begin FUNCTION jSasKabHSP178_Fktn "Applikationesgroessen Instanz jSasKabHSP178"
 /begin DEF_CHARACTERISTIC KF_THKABMTCG78 KF_THKABMTCG78_EL KF_TPKABMTCG78 KF_TPKABMTCG78_EL KL_PHKABMT78 KL_PHKABMT78_EL KL_POKABCG78 KL_POKABCG78_EL KL_TOPKABND78 KL_TOPKABND78_EL T_VKABHS78 /end DEF_CHARACTERISTIC
/end FUNCTION
/begin FUNCTION jSasKabHSP113_Fktn "Applikationesgroessen Instanz jSasKabHSP113"
 /begin DEF_CHARACTERISTIC KF_THKABMTCG13 KF_TPKABMTCG13 KL_PHKABMT13 KL_POKABCG13 KL_TOPKABND13 T_VKABHS13 /end DEF_CHARACTERISTIC
/end FUNCTION
/begin FUNCTION jSasKabHSP124_Fktn "Applikationesgroessen Instanz jSasKabHSP124"
 /begin DEF_CHARACTERISTIC KF_THKABMTCG24 KF_TPKABMTCG24 KL_PHKABMT24 KL_POKABCG24 KL_TOPKABND24 T_VKABHS24 /end DEF_CHARACTERISTIC
/end FUNCTION
/begin FUNCTION jSasKabHSP135_Fktn "Applikationesgroessen Instanz jSasKabHSP135"
 /begin DEF_CHARACTERISTIC KF_THKABMTCG35 KF_TPKABMTCG35 KL_PHKABMT35 KL_POKABCG35 KL_TOPKABND35 T_VKABHS35 /end DEF_CHARACTERISTIC
/end FUNCTION
/begin FUNCTION jSasKabHSP146_Fktn "Applikationesgroessen Instanz jSasKabHSP146"
 /begin DEF_CHARACTERISTIC KF_THKABMTCG46 KF_TPKABMTCG46 KL_PHKABMT46 KL_POKABCG46 KL_TOPKABND46 T_VKABHS46 /end DEF_CHARACTERISTIC
/end FUNCTION
/begin FUNCTION jSasKabHSP157_Fktn "Applikationesgroessen Instanz jSasKabHSP157"
 /begin DEF_CHARACTERISTIC KF_THKABMTCG57 KF_TPKABMTCG57 KL_PHKABMT57 KL_POKABCG57 KL_TOPKABND57 T_VKABHS57 /end DEF_CHARACTERISTIC
/end FUNCTION
/begin FUNCTION jSasKabHSP168_Fktn "Applikationesgroessen Instanz jSasKabHSP168"
 /begin DEF_CHARACTERISTIC KF_THKABMTCG68 KF_TPKABMTCG68 KL_PHKABMT68 KL_POKABCG68 KL_TOPKABND68 T_VKABHS68 /end DEF_CHARACTERISTIC
/end FUNCTION
/begin FUNCTION jSasKabHSP212_Fktn "Applikationesgroessen Instanz jSasKabHSP212"
 /begin DEF_CHARACTERISTIC KF_THKABMTCGSP12 KF_TPKABMTCGSP12 KL_PHKABMTSP12 KL_POKABCGSP12 KL_TOPKABNDSP12 T_VKABHSSP12 /end DEF_CHARACTERISTIC
/end FUNCTION
/begin FUNCTION jSasKabHSP223_Fktn "Applikationesgroessen Instanz jSasKabHSP223"
 /begin DEF_CHARACTERISTIC KF_THKABMTCGSP23 KF_TPKABMTCGSP23 KL_PHKABMTSP23 KL_POKABCGSP23 KL_TOPKABNDSP23 T_VKABHSSP23 /end DEF_CHARACTERISTIC
/end FUNCTION
/begin RECORD_LAYOUT kw_ui8_S6_S3 FNC_VALUES 1 UBYTE COLUMN_DIR DIRECT /end RECORD_LAYOUT
/begin RECORD_LAYOUT kw_si16_S6_S3 FNC_VALUES 1 SWORD COLUMN_DIR DIRECT /end RECORD_LAYOUT
/begin RECORD_LAYOUT tab_ui8_S6_S3 FNC_VALUES 2 UBYTE COLUMN_DIR DIRECT NO_AXIS_PTS_X 1 ULONG /end RECORD_LAYOUT
/begin RECORD_LAYOUT kl_ui8_S6_S3 FNC_VALUES 3 UBYTE COLUMN_DIR DIRECT AXIS_PTS_X 2 UBYTE INDEX_INCR DIRECT NO_AXIS_PTS_X 1 ULONG /end RECORD_LAYOUT
/begin RECORD_LAYOUT kl_si16_S6_S3 FNC_VALUES 3 SWORD COLUMN_DIR DIRECT AXIS_PTS_X 2 SWORD INDEX_INCR DIRECT NO_AXIS_PTS_X 1 ULONG /end RECORD_LAYOUT
/begin RECORD_LAYOUT kf_ui8_S6_S3 FNC_VALUES 5 UBYTE ROW_DIR DIRECT AXIS_PTS_X 3 UBYTE INDEX_INCR DIRECT AXIS_PTS_Y 4 UBYTE INDEX_INCR DIRECT NO_AXIS_PTS_X 1 ULONG NO_AXIS_PTS_Y 2 ULONG /end RECORD_LAYOUT
/begin RECORD_LAYOUT kf_si16_S6_S3 FNC_VALUES 5 SWORD ROW_DIR DIRECT AXIS_PTS_X 3 SWORD INDEX_INCR DIRECT AXIS_PTS_Y 4 SWORD INDEX_INCR DIRECT NO_AXIS_PTS_X 1 ULONG NO_AXIS_PTS_Y 2 ULONG /end RECORD_LAYOUT
/end MODULE
/end PROJECT
