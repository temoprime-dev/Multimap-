ASAP2_VERSION 1 51
/begin PROJECT _929_929 "Gen2_BMW_System_Supplier_Lib"
/begin HEADER "" VERSION "C_03_03" PROJECT_NO _929_929 /end HEADER
/begin MODULE DIM ""
/begin MOD_COMMON "" BYTE_ORDER MSB_FIRST ALIGNMENT_BYTE 1 ALIGNMENT_WORD 2 ALIGNMENT_LONG 4 ALIGNMENT_FLOAT32_IEEE 4 /end MOD_COMMON
/begin CHARACTERISTIC BM_SCHALTARTNEMMODRS_SYN_ZUS "Bitmaske zur Festlegung der Schaltart der RS zur Anhebung der modifizierten EM- Drehzahl als Basisdrehzahl zur Bestimmung der VM Solldrehzahl bei RS beim K0 Synchronisieren beim Zustart" VALUE 0x26F1B0 UBYTE_COL_DIRECT_M_S7_S3 0 void_int_M_S7_S3 0 255 /end CHARACTERISTIC
/begin CHARACTERISTIC FK_NSOLLVM_ANH_ZUS "Filterung der VM Solldrehzahl beim VM Start Variante Zustarten" VALUE 0x26D054 FLOAT32_IEEE_COL_DIRECT_M_S7_S3 0 void_fl_M_S7_S3 0 1 /end CHARACTERISTIC
/begin CHARACTERISTIC FK_NSOLLVM_SAK_ZUS "Filterung der VM-Solldrehzahl im Zustand Schaltung aktiv beim Zustart" VALUE 0x26D058 FLOAT32_IEEE_COL_DIRECT_M_S7_S3 0 void_fl_M_S7_S3 0 1 /end CHARACTERISTIC
/begin CHARACTERISTIC FK_NSOLLVM_ZST_ZUS "Filterung der VM Solldrehzahl beim VM Start Variante Zustarten" VALUE 0x26D05C FLOAT32_IEEE_COL_DIRECT_M_S7_S3 0 void_fl_M_S7_S3 0 1 /end CHARACTERISTIC
/begin CHARACTERISTIC K_KFMGK0RS_SYN_ZUS "Gangsprung zur Auswahl des Kennfelds der Schaltungsabhaengigkeit beim K0 Sollmomentgradienten beim K0 Synchronisieren beim Zustart" VALUE 0x26F1B1 SBYTE_COL_DIRECT_M_S7_S3 0 void_int_M_S7_S3 -8 0 /end CHARACTERISTIC
/begin CHARACTERISTIC K_KOLBENPOSK0BEF_ZST_ZUS "Wert der Kolbenposition zur Erkennung K0 befuellt im Zustand Zustarten beim Zustart" VALUE 0x26D060 FLOAT32_IEEE_COL_DIRECT_M_S7_S3 0 rel_int_p_M_S7_S3 0 100 /end CHARACTERISTIC
/begin CHARACTERISTIC K_MZIELNOEMNSOLLVM_ZST_ZUS "Faktor zur Gewichtung des VM-Zielmoment der HAS aus der Fahrpedal-Interpretation zur  Bestimmung der VM-Solldrehzahl ab dem Zustand Zustarten und in den Zustaenden Schaltung aktiv und VM Abfangen beim Zustart" VALUE 0x26D064 FLOAT32_IEEE_COL_DIRECT_M_S7_S3 0 void_fl_M_S7_S3 0 10 /end CHARACTERISTIC
/begin CHARACTERISTIC K_NOEMNSOLLVMOKS_ZST_ZUS "Faktor fuer Gewichstung des Drehzahloffsets bei der Bestimmung der VM-Solldrehzahl ohne Kraftschluss ab dem Zustand Zustarten und in den Zustaenden Schaltung aktiv und VM Abfangen beim Zustart." VALUE 0x26D068 FLOAT32_IEEE_COL_DIRECT_M_S7_S3 0 void_fl_M_S7_S3 0 1 /end CHARACTERISTIC
/begin CHARACTERISTIC K_SVH_RESET_ABB_ZUS "Ruecksetzen einer Schaltverhinderung waehrend VM-Zustart beim Abbruch Zustart (255 = alle Arten von Schaltungen zuruecksetzen, 0 = keine Schaltung zuruecksetzen) -> Bit-Codierung siehe Handbuch" VALUE 0x26F1B4 UBYTE_COL_DIRECT_M_S7_S3 0 b_int_b_M_S7_S3 0 255 /end CHARACTERISTIC
/begin CHARACTERISTIC K_SVH_RESET_SZA_ZUS "Ruecksetzen der Schaltverhinderung absolut notwendiger Schaltungen bei der Ablaufvariante Schneller Zustartablauf beim Zustart (255 = alle Arten von Schaltungen zuruecksetzen, 0 = keine Schaltung zuruecksetzen) Bit-Codierung siehe Handbuch" VALUE 0x26F1B5 UBYTE_COL_DIRECT_M_S7_S3 0 b_int_b_M_S7_S3 0 255 /end CHARACTERISTIC
/begin CHARACTERISTIC KF_MGK0NDK0M_IAEREG_SYN_ZUS_W "Gradient des K0-Sollmoments in Abhaengigkeit der K0 Differenzdrehzahl und dem VM Zielmoment bei aktiver IAE-Regelung im Zustand K0 Synchronisieren beim Zustart" MAP 0x26AF48 FLOAT32_IEEE_COL_DIRECT_M_S7_S3 0 trqg_fl_k_M_S7_S3 0 50000
 /begin AXIS_DESCR COM_AXIS nd_k0_in n_fl_M_S7_S3 7 -3.40282E+038 3.40282E+038 AXIS_PTS_REF KF_MGK0NDK0M_IAEREG_SYN_ZUS_X /end AXIS_DESCR
 /begin AXIS_DESCR COM_AXIS m_ziel_vm_has_zus trq_fl_a_M_S7_S3 6 -3.40282E+038 3.40282E+038 AXIS_PTS_REF KF_MGK0NDK0M_IAEREG_SYN_ZUS_Y /end AXIS_DESCR
/end CHARACTERISTIC
/begin CHARACTERISTIC KF_MGK0NDK0M_K0ZUHEISS_SYN_ZUS_W "Mindest-Gradient des K0-Sollmoments in Abhaengigkeit der K0 Differenzdrehzahl und dem VM Zielmoment bei zu heisser K0 im Zustand K0-Synchronisieren beim Zustart" MAP 0x26B024 FLOAT32_IEEE_COL_DIRECT_M_S7_S3 0 trqg_fl_k_M_S7_S3 0 50000
 /begin AXIS_DESCR COM_AXIS nd_k0_in n_fl_M_S7_S3 7 -3.40282E+038 3.40282E+038 AXIS_PTS_REF KF_MGK0NDK0M_K0ZUHEISS_SYN_ZUS_X /end AXIS_DESCR
 /begin AXIS_DESCR COM_AXIS m_ziel_vm_has_zus trq_fl_a_M_S7_S3 6 -3.40282E+038 3.40282E+038 AXIS_PTS_REF KF_MGK0NDK0M_K0ZUHEISS_SYN_ZUS_Y /end AXIS_DESCR
/end CHARACTERISTIC
/begin CHARACTERISTIC KF_MGK0NDK0M_MRS_SYN_ZUS_W "Gradient des K0-Sollmoments in Abhaengigkeit der K0 Differenzdrehzahl und dem VM Zielmoment  bei Mehrfachrueckschaltungen beim K0 Synchronisieren beim Zustart " MAP 0x26B100 FLOAT32_IEEE_COL_DIRECT_M_S7_S3 0 trqg_fl_k_M_S7_S3 0 50000
 /begin AXIS_DESCR COM_AXIS nd_k0_in n_fl_M_S7_S3 7 -3.40282E+038 3.40282E+038 AXIS_PTS_REF KF_MGK0NDK0M_MRS_SYN_ZUS_X /end AXIS_DESCR
 /begin AXIS_DESCR COM_AXIS m_ziel_vm_has_zus trq_fl_a_M_S7_S3 6 -3.40282E+038 3.40282E+038 AXIS_PTS_REF KF_MGK0NDK0M_MRS_SYN_ZUS_Y /end AXIS_DESCR
/end CHARACTERISTIC
/begin CHARACTERISTIC KF_MGK0NDK0M_RS_SYN_ZUS_W "Gradient des K0-Sollmoments in Abhaengigkeit der K0 Differenzdrehzahl und dem VM Zielmoment  bei Rueckschaltungen beim K0 Synchronisieren beim Zustart " MAP 0x26B1DC FLOAT32_IEEE_COL_DIRECT_M_S7_S3 0 trqg_fl_k_M_S7_S3 0 50000
 /begin AXIS_DESCR COM_AXIS nd_k0_in n_fl_M_S7_S3 7 -3.40282E+038 3.40282E+038 AXIS_PTS_REF KF_MGK0NDK0M_RS_SYN_ZUS_X /end AXIS_DESCR
 /begin AXIS_DESCR COM_AXIS m_ziel_vm_has_zus trq_fl_a_M_S7_S3 6 -3.40282E+038 3.40282E+038 AXIS_PTS_REF KF_MGK0NDK0M_RS_SYN_ZUS_Y /end AXIS_DESCR
/end CHARACTERISTIC
/begin CHARACTERISTIC KF_MGK0NDK0M_SYN_ZUS_W "Gradient des K0 Sollmoments in Abhaengigkeit der K0 Differenzdrehzahl und VM Zielmoment beim K0 Synchronisieren beim Zustart" MAP 0x26B470 FLOAT32_IEEE_COL_DIRECT_M_S7_S3 0 trqg_fl_k_M_S7_S3 0 50000
 /begin AXIS_DESCR COM_AXIS nd_k0_in n_fl_M_S7_S3 7 -3.40282E+038 3.40282E+038 AXIS_PTS_REF KF_MGK0NDK0M_SYN_ZUS_X /end AXIS_DESCR
 /begin AXIS_DESCR COM_AXIS m_ziel_vm_has_zus trq_fl_a_M_S7_S3 6 -3.40282E+038 3.40282E+038 AXIS_PTS_REF KF_MGK0NDK0M_SYN_ZUS_Y /end AXIS_DESCR
/end CHARACTERISTIC
/begin CHARACTERISTIC KF_MGK0NDK0M_SYNCDDA_SYN_ZUS_W "Mindest-Gradient des K0-Sollmoments in Abhaengigkeit der K0 Differenzdrehzahl und dem VM Zielmoment bei durchdrehenden Antriebsraedern im Zustand K0-Synchronisieren beim Zustart" MAP 0x26B2B8 FLOAT32_IEEE_COL_DIRECT_M_S7_S3 0 trqg_fl_k_M_S7_S3 0 50000
 /begin AXIS_DESCR COM_AXIS nd_k0_in n_fl_M_S7_S3 7 -3.40282E+038 3.40282E+038 AXIS_PTS_REF KF_MGK0NDK0M_SYNCDDA_SYN_ZUS_X /end AXIS_DESCR
 /begin AXIS_DESCR COM_AXIS m_ziel_vm_has_zus trq_fl_a_M_S7_S3 6 -3.40282E+038 3.40282E+038 AXIS_PTS_REF KF_MGK0NDK0M_SYNCDDA_SYN_ZUS_Y /end AXIS_DESCR
/end CHARACTERISTIC
/begin CHARACTERISTIC KF_MGK0NDK0M_SYNCSZA_SYN_ZUS_W "Mindest-Gradient des K0-Sollmoments in Abhaengigkeit der K0 Differenzdrehzahl und dem VM Zielmoment bei der aktiven Ablaufvariante Schneller Zustartablauf (SZA) im Zustand K0-Synchronisieren beim Zustart" MAP 0x26B394 FLOAT32_IEEE_COL_DIRECT_M_S7_S3 0 trqg_fl_k_M_S7_S3 0 50000
 /begin AXIS_DESCR COM_AXIS nd_k0_in n_fl_M_S7_S3 7 -3.40282E+038 3.40282E+038 AXIS_PTS_REF KF_MGK0NDK0M_SYNCSZA_SYN_ZUS_X /end AXIS_DESCR
 /begin AXIS_DESCR COM_AXIS m_ziel_vm_has_zus trq_fl_a_M_S7_S3 6 -3.40282E+038 3.40282E+038 AXIS_PTS_REF KF_MGK0NDK0M_SYNCSZA_SYN_ZUS_Y /end AXIS_DESCR
/end CHARACTERISTIC
/begin CHARACTERISTIC KF_MGK0NDK0M_ZMANH_SYN_ZUS_W "Gradient des K0-Sollmoments in Abhaengigkeit der K0 Differenzdrehzahl und dem VM Zielmoment bei aktiver Zusatzdrehmomentanhebung beim K0 Synchronisieren beim Zustart " MAP 0x26B54C FLOAT32_IEEE_COL_DIRECT_M_S7_S3 0 trqg_fl_k_M_S7_S3 0 50000
 /begin AXIS_DESCR COM_AXIS nd_k0_in n_fl_M_S7_S3 7 -3.40282E+038 3.40282E+038 AXIS_PTS_REF KF_MGK0NDK0M_ZMANH_SYN_ZUS_X /end AXIS_DESCR
 /begin AXIS_DESCR COM_AXIS m_ziel_vm_has_zus trq_fl_a_M_S7_S3 6 -3.40282E+038 3.40282E+038 AXIS_PTS_REF KF_MGK0NDK0M_ZMANH_SYN_ZUS_Y /end AXIS_DESCR
/end CHARACTERISTIC
/begin CHARACTERISTIC KF_MGK0NDK0NGVM_SYN_ZUS_W "Gradient des K0 Sollmoments in Abhaengigkeit der K0 Differenzdrehzahl und des VM Drehzahlgradienten beim K0 Synchronisieren beim Zustart" MAP 0x26B628 FLOAT32_IEEE_COL_DIRECT_M_S7_S3 0 trqg_fl_k_M_S7_S3 0 50000
 /begin AXIS_DESCR COM_AXIS nd_k0_in n_fl_M_S7_S3 7 -3.40282E+038 3.40282E+038 AXIS_PTS_REF KF_MGK0NDK0NGVM_SYN_ZUS_X /end AXIS_DESCR
 /begin AXIS_DESCR COM_AXIS ng_vm_in trq_fl_a_M_S7_S3 9 -3.40282E+038 3.40282E+038 AXIS_PTS_REF KF_MGK0NDK0NGVM_SYN_ZUS_Y /end AXIS_DESCR
/end CHARACTERISTIC
/begin CHARACTERISTIC KF_MOSOLLK0BEF_ZST_ZUS_W "Offset auf das K0-Sollmoment in Abhaengigkeit des VM-Zielmoments und der Getriebeoeltemperatur ab dem Zustand Zustarten beim Zustart." MAP 0x26B764 FLOAT32_IEEE_COL_DIRECT_M_S7_S3 0 trq_fl_a_M_S7_S3 -100 100
 /begin AXIS_DESCR COM_AXIS m_ziel_vm_has_zus trq_fl_a_M_S7_S3 5 -3.40282E+038 3.40282E+038 AXIS_PTS_REF KF_MOSOLLK0BEF_ZST_ZUS_X /end AXIS_DESCR
 /begin AXIS_DESCR COM_AXIS c_getriebe_egs_in c_fl_M_S7_S3 8 -3.40282E+038 3.40282E+038 AXIS_PTS_REF KF_MOSOLLK0BEF_ZST_ZUS_Y /end AXIS_DESCR
/end CHARACTERISTIC
/begin CHARACTERISTIC KF_MSOLLK0BEF_2_SAK_ZUS_W "Vorgabe des K0-Sollmoments bei angelegter K0 in Abhaengigkeit des VM-Zielmoments und des maximalen dynamischen EM Moments im Zustand Schaltung aktiv beim VM Zustart" MAP 0x26BD3C FLOAT32_IEEE_COL_DIRECT_M_S7_S3 0 trq_fl_a_M_S7_S3 0 100
 /begin AXIS_DESCR COM_AXIS m_ziel_vm_has_zus trq_fl_a_M_S7_S3 5 -3.40282E+038 3.40282E+038 AXIS_PTS_REF KF_MSOLLK0BEF_2_SAK_ZUS_X /end AXIS_DESCR
 /begin AXIS_DESCR COM_AXIS m_max_dyn_em_in trq_fl_a_M_S7_S3 5 -3.40282E+038 3.40282E+038 AXIS_PTS_REF KF_MSOLLK0BEF_2_SAK_ZUS_Y /end AXIS_DESCR
/end CHARACTERISTIC
/begin CHARACTERISTIC KF_MSOLLK0BEF_2_ZST_ZUS_W "Vorgabe des K0-Sollmoments bei angelegter K0 in Abhaengigkeit des VM-Zielmoments und des maximalen dynamischen EM Moments im Zustand Zustart beim VM Zustart" MAP 0x26BDC8 FLOAT32_IEEE_COL_DIRECT_M_S7_S3 0 trq_fl_a_M_S7_S3 0 100
 /begin AXIS_DESCR COM_AXIS m_ziel_vm_has_zus trq_fl_a_M_S7_S3 5 -3.40282E+038 3.40282E+038 AXIS_PTS_REF KF_MSOLLK0BEF_2_ZST_ZUS_X /end AXIS_DESCR
 /begin AXIS_DESCR COM_AXIS m_max_dyn_em_in trq_fl_a_M_S7_S3 5 -3.40282E+038 3.40282E+038 AXIS_PTS_REF KF_MSOLLK0BEF_2_ZST_ZUS_Y /end AXIS_DESCR
/end CHARACTERISTIC
/begin CHARACTERISTIC KF_MSOLLK0BEF_ABF_ZUS_W "Vorgabe des K0-Sollmoments in der Fuellausgleichsphase in Abhaengigkeit des VM-Zielmoments und des maximalen dynamischen EM Moments im Zustand VM Abfangen beim VM Zustart" MAP 0x26BE54 FLOAT32_IEEE_COL_DIRECT_M_S7_S3 0 trq_fl_a_M_S7_S3 0 100
 /begin AXIS_DESCR COM_AXIS m_ziel_vm_has_zus trq_fl_a_M_S7_S3 5 -3.40282E+038 3.40282E+038 AXIS_PTS_REF KF_MSOLLK0BEF_ABF_ZUS_X /end AXIS_DESCR
 /begin AXIS_DESCR COM_AXIS m_max_dyn_em_in trq_fl_a_M_S7_S3 5 -3.40282E+038 3.40282E+038 AXIS_PTS_REF KF_MSOLLK0BEF_ABF_ZUS_Y /end AXIS_DESCR
/end CHARACTERISTIC
/begin CHARACTERISTIC KF_MSOLLK0BEF_ANH_ZUS_W "Vorgabe des K0-Sollmoments in Abhaengigkeit des VM-Zielmoments und des maximalen dynamischen EM Moments im Zustand Drehzahlanhebung beim VM Zustart" MAP 0x26BEE0 FLOAT32_IEEE_COL_DIRECT_M_S7_S3 0 trq_fl_a_M_S7_S3 0 100
 /begin AXIS_DESCR COM_AXIS m_ziel_vm_has_zus trq_fl_a_M_S7_S3 5 -3.40282E+038 3.40282E+038 AXIS_PTS_REF KF_MSOLLK0BEF_ANH_ZUS_X /end AXIS_DESCR
 /begin AXIS_DESCR COM_AXIS m_max_dyn_em_in trq_fl_a_M_S7_S3 5 -3.40282E+038 3.40282E+038 AXIS_PTS_REF KF_MSOLLK0BEF_ANH_ZUS_Y /end AXIS_DESCR
/end CHARACTERISTIC
/begin CHARACTERISTIC KF_MSOLLK0BEF_SAK_ZUS_W "Vorgabe des K0-Sollmoments in der Fuellausgleichsphase in Abhaengigkeit des VM-Zielmoments und des maximalen dynamischen EM Moments im Zustand Schaltung aktiv beim VM Zustart" MAP 0x26BF6C FLOAT32_IEEE_COL_DIRECT_M_S7_S3 0 trq_fl_a_M_S7_S3 0 100
 /begin AXIS_DESCR COM_AXIS m_ziel_vm_has_zus trq_fl_a_M_S7_S3 5 -3.40282E+038 3.40282E+038 AXIS_PTS_REF KF_MSOLLK0BEF_SAK_ZUS_X /end AXIS_DESCR
 /begin AXIS_DESCR COM_AXIS m_max_dyn_em_in trq_fl_a_M_S7_S3 5 -3.40282E+038 3.40282E+038 AXIS_PTS_REF KF_MSOLLK0BEF_SAK_ZUS_Y /end AXIS_DESCR
/end CHARACTERISTIC
/begin CHARACTERISTIC KF_MSOLLK0BEF_ZST_ZUS_W "Vorgabe des K0-Sollmoments in der Fuellausgleichsphase in Abhaengigkeit des VM-Zielmoments und des maximalen dynamischen EM Moments im Zustand Zustart beim VM Zustart" MAP 0x26BFF8 FLOAT32_IEEE_COL_DIRECT_M_S7_S3 0 trq_fl_a_M_S7_S3 0 100
 /begin AXIS_DESCR COM_AXIS m_ziel_vm_has_zus trq_fl_a_M_S7_S3 5 -3.40282E+038 3.40282E+038 AXIS_PTS_REF KF_MSOLLK0BEF_ZST_ZUS_X /end AXIS_DESCR
 /begin AXIS_DESCR COM_AXIS m_max_dyn_em_in trq_fl_a_M_S7_S3 5 -3.40282E+038 3.40282E+038 AXIS_PTS_REF KF_MSOLLK0BEF_ZST_ZUS_Y /end AXIS_DESCR
/end CHARACTERISTIC
/begin CHARACTERISTIC KF_NDEMNSOLLVM_ANH_ZUS_W "Differenzdrehzahl zum Abbau des Drehzahloffset auf die Basis-Drehzahl zur Berechnung des Zielwerts der VM Solldrehzahl ab dem Zustand Drehzahlanhebung und in den Zustand VM Abfangen beim Zustart" MAP 0x26C084 FLOAT32_IEEE_COL_DIRECT_M_S7_S3 0 n_fl_M_S7_S3 0 10000
 /begin AXIS_DESCR COM_AXIS n_em_in n_fl_M_S7_S3 10 -3.40282E+038 3.40282E+038 AXIS_PTS_REF KF_NDEMNSOLLVM_ANH_ZUS_X /end AXIS_DESCR
 /begin AXIS_DESCR COM_AXIS NO_INPUT_QUANTITY trq_fl_a_M_S7_S3 7 -3.40282E+038 3.40282E+038 AXIS_PTS_REF KF_NDEMNSOLLVM_ANH_ZUS_Y /end AXIS_DESCR
/end CHARACTERISTIC
/begin CHARACTERISTIC KF_NDEMNSOLLVM_K0ZUHEISS_SYN_ZUS_W "Mindest-Differenzdrehzahl zum schnelleren Abbau des Drehzahloffset auf die Basis-Drehzahl zur Berechnung des Zielwerts der VM Solldrehzahl bei zu heisser K0 im Zustand K0-Synchronisieren beim Zustart" MAP 0x26C1E0 FLOAT32_IEEE_COL_DIRECT_M_S7_S3 0 n_fl_M_S7_S3 0 10000
 /begin AXIS_DESCR COM_AXIS n_em_in n_fl_M_S7_S3 10 -3.40282E+038 3.40282E+038 AXIS_PTS_REF KF_NDEMNSOLLVM_K0ZUHEISS_SYN_ZUS_X /end AXIS_DESCR
 /begin AXIS_DESCR COM_AXIS NO_INPUT_QUANTITY trq_fl_a_M_S7_S3 7 -3.40282E+038 3.40282E+038 AXIS_PTS_REF KF_NDEMNSOLLVM_K0ZUHEISS_SYN_ZUS_Y /end AXIS_DESCR
/end CHARACTERISTIC
/begin CHARACTERISTIC KF_NDEMNSOLLVM_SAK_ZUS_W "Differenzdrehzahl zum Abbau des Drehzahloffsets auf die Basis-Drehzahl zur Berechnung des Zielwerts der VM Solldrehzahl bei zuvor Schaltung aktiv ab dem Zustand Drehzahlanhebung beim Zustart" MAP 0x26C33C FLOAT32_IEEE_COL_DIRECT_M_S7_S3 0 n_fl_M_S7_S3 0 10000
 /begin AXIS_DESCR COM_AXIS n_em_in n_fl_M_S7_S3 10 -3.40282E+038 3.40282E+038 AXIS_PTS_REF KF_NDEMNSOLLVM_SAK_ZUS_X /end AXIS_DESCR
 /begin AXIS_DESCR COM_AXIS NO_INPUT_QUANTITY trq_fl_a_M_S7_S3 7 -3.40282E+038 3.40282E+038 AXIS_PTS_REF KF_NDEMNSOLLVM_SAK_ZUS_Y /end AXIS_DESCR
/end CHARACTERISTIC
/begin CHARACTERISTIC KF_NGEMMODRSMAX_SYN_ZUS_W "Maximaler Gradient der modifizierten EM-Drehzahl als Basisdrehzahl zur Bestimmung der VM Solldrehzahl bei RS beim K0 Synchronisieren beim Zustart" MAP 0x26C498 FLOAT32_IEEE_COL_DIRECT_M_S7_S3 0 ng_fl_M_S7_S3 0 50000
 /begin AXIS_DESCR COM_AXIS n_sec_iae_ist_zus n_fl_M_S7_S3 5 -3.40282E+038 3.40282E+038 AXIS_PTS_REF KF_NGEMMODRSMAX_SYN_ZUS_X /end AXIS_DESCR
 /begin AXIS_DESCR COM_AXIS nd_sec_iae_syn_zus n_fl_M_S7_S3 4 -3.40282E+038 3.40282E+038 AXIS_PTS_REF KF_NGEMMODRSMAX_SYN_ZUS_Y /end AXIS_DESCR
/end CHARACTERISTIC
/begin CHARACTERISTIC KF_NOEMNSOLLVM_SAK_ZUS_W "Drehzahloffset auf die Basis-Drehzahl zur Berechnung des Zielwerts der VM Solldrehzahl im Zustand Schaltung aktiv und in den Folgezustaenden beim Zustart" MAP 0x26C50C FLOAT32_IEEE_COL_DIRECT_M_S7_S3 0 n_fl_M_S7_S3 0 10000
 /begin AXIS_DESCR COM_AXIS n_sec_iae_ziel_zus n_fl_M_S7_S3 10 -3.40282E+038 3.40282E+038 AXIS_PTS_REF KF_NOEMNSOLLVM_SAK_ZUS_X /end AXIS_DESCR
 /begin AXIS_DESCR COM_AXIS NO_INPUT_QUANTITY trq_fl_a_M_S7_S3 7 -3.40282E+038 3.40282E+038 AXIS_PTS_REF KF_NOEMNSOLLVM_SAK_ZUS_Y /end AXIS_DESCR
/end CHARACTERISTIC
/begin CHARACTERISTIC KF_NOEMNSOLLVM_ZST_ZUS_W "Drehzahloffset auf die Basis-Drehzahl zur Berechnung des Zielwerts der VM Solldrehzahl ab dem Zustand Zustarten und im Zustand VM Abfangen beim Zustart" MAP 0x26C668 FLOAT32_IEEE_COL_DIRECT_M_S7_S3 0 n_fl_M_S7_S3 0 10000
 /begin AXIS_DESCR COM_AXIS n_em_in n_fl_M_S7_S3 10 -3.40282E+038 3.40282E+038 AXIS_PTS_REF KF_NOEMNSOLLVM_ZST_ZUS_X /end AXIS_DESCR
 /begin AXIS_DESCR COM_AXIS NO_INPUT_QUANTITY trq_fl_a_M_S7_S3 7 -3.40282E+038 3.40282E+038 AXIS_PTS_REF KF_NOEMNSOLLVM_ZST_ZUS_Y /end AXIS_DESCR
/end CHARACTERISTIC
/begin CHARACTERISTIC KL_KSVHABBRLAUSFST_ZUS_Y "Festlegung der Schaltart der von der Fahrstrategie abzubrechenden  laufenden Schaltungen in Abhaengigkeit des aktuellen Zustands beim Zustart -> Bit-Codierung wie z_ablauf_shv_reset_has" CURVE 0x26F192 UBYTE_COL_DIRECT_M_S7_S3 0 b_int_b_M_S7_S3 0 255
 /begin AXIS_DESCR COM_AXIS st_ablauf_fkt st_int_g_M_S7_S3 7 0 65535 AXIS_PTS_REF KL_KSVHABBRLAUSFST_ZUS_X /end AXIS_DESCR
/end CHARACTERISTIC
/begin CHARACTERISTIC KL_KSVHPALAUSNACHVSI_LA_SAK_ZUS_Y "Festlegung der Schaltart der zum Rest des Zustart-Ablaufs parallel laufenden Schaltungen im E-Fahr-Modus \"Ladung abbauen\" in Abhaengigkeit des Istgangs nach Verlassen Synchron Istgang im Zustand SAK beim ZUS->Kodierung wie z_ablauf_shv_reset_has" CURVE 0x26CF04 UBYTE_COL_DIRECT_M_S7_S3 0 b_int_b_M_S7_S3 0 255
 /begin AXIS_DESCR COM_AXIS istgang_egs_in void_int_M_S7_S3 8 -128 127 AXIS_PTS_REF KL_KSVHPALAUSNACHVSI_LA_SAK_ZUS_X /end AXIS_DESCR
/end CHARACTERISTIC
/begin CHARACTERISTIC KL_KSVHPALAUSNACHVSI_LE_SAK_ZUS_Y "Festlegung der Schaltart der zum Rest des Zustart-Ablaufs parallel laufenden Schaltungen im E-Fahr-Modus \"Ladung erhalten\" in Abhaengigkeit des Istgangs nach Verlassen Synchron Istgang im Zustand SAK beim ZUS->Kodierung wie z_ablauf_shv_reset_has" CURVE 0x26CF14 UBYTE_COL_DIRECT_M_S7_S3 0 b_int_b_M_S7_S3 0 255
 /begin AXIS_DESCR COM_AXIS istgang_egs_in void_int_M_S7_S3 8 -128 127 AXIS_PTS_REF KL_KSVHPALAUSNACHVSI_LE_SAK_ZUS_X /end AXIS_DESCR
/end CHARACTERISTIC
/begin CHARACTERISTIC KL_KSVHPALAUSVORVSI_LA_SAK_ZUS_Y "Festlegung der Schaltart der zum Rest des Zustart-Ablaufs parallel laufenden Schaltungen im E-Fahr-Modus \"Ladung abbauen\" in Abhaengigkeit des Istgangs vor Verlassen Synchron Istgang im Zustand SAK beim ZUS->Kodierung wie z_ablauf_shv_reset_has" CURVE 0x26CF24 UBYTE_COL_DIRECT_M_S7_S3 0 b_int_b_M_S7_S3 0 255
 /begin AXIS_DESCR COM_AXIS istgang_egs_in void_int_M_S7_S3 8 -128 127 AXIS_PTS_REF KL_KSVHPALAUSVORVSI_LA_SAK_ZUS_X /end AXIS_DESCR
/end CHARACTERISTIC
/begin CHARACTERISTIC KL_KSVHPALAUSVORVSI_LE_SAK_ZUS_Y "Festlegung der Schaltart der zum Rest des Zustart-Ablaufs parallel laufenden Schaltungen im E-Fahr-Modus \"Ladung erhalten\" in Abhaengigkeit des Istgangs vor Verlassen Synchron Istgang im Zustand SAK beim ZUS->Kodierung z_ablauf_shv_reset_has" CURVE 0x26CF34 UBYTE_COL_DIRECT_M_S7_S3 0 b_int_b_M_S7_S3 0 255
 /begin AXIS_DESCR COM_AXIS istgang_egs_in void_int_M_S7_S3 8 -128 127 AXIS_PTS_REF KL_KSVHPALAUSVORVSI_LE_SAK_ZUS_X /end AXIS_DESCR
/end CHARACTERISTIC
/begin CHARACTERISTIC KL_KSVHRESET_ABF_ZUS_Y "Ruecksetzen einer Schaltverhinderung in Abhaengigkeit des Istgangs im Zustand VM-Abfangen beim Zustart (255 = alle Arten von Schaltungen zuruecksetzen, 0 = keine Schaltung zuruecksetzen) -> Bit-Codierung siehe Handbuch" CURVE 0x26CFE4 UBYTE_COL_DIRECT_M_S7_S3 0 b_int_b_M_S7_S3 0 255
 /begin AXIS_DESCR COM_AXIS istgang_egs_in void_int_M_S7_S3 8 -1 8 AXIS_PTS_REF KL_KSVHRESET_ABF_ZUS_X /end AXIS_DESCR
/end CHARACTERISTIC
/begin CHARACTERISTIC KL_KSVHRESET_ANH_ZUS_Y "Ruecksetzen einer Schaltverhinderung in Abhaengigkeit des Istgangs im Zustand VM-Drehzahlanhebung beim Zustart (255 = alle Arten von Schaltungen zuruecksetzen, 0 = keine Schaltung zuruecksetzen) -> Bit-Codierung siehe Handbuch" CURVE 0x26CFF4 UBYTE_COL_DIRECT_M_S7_S3 0 b_int_b_M_S7_S3 0 255
 /begin AXIS_DESCR COM_AXIS istgang_egs_in void_int_M_S7_S3 8 -1 8 AXIS_PTS_REF KL_KSVHRESET_ANH_ZUS_X /end AXIS_DESCR
/end CHARACTERISTIC
/begin CHARACTERISTIC KL_KSVHRESET_SYN_ZUS_Y "Ruecksetzen einer Schaltverhinderung in Abhaengigkeit des Istgangs im Zustand K0-Synchronisieren beim Zustart (255 = alle Arten von Schaltungen zuruecksetzen, 0 = keine Schaltung zuruecksetzen) -> Bit-Codierung siehe Handbuch" CURVE 0x26D014 UBYTE_COL_DIRECT_M_S7_S3 0 b_int_b_M_S7_S3 0 255
 /begin AXIS_DESCR COM_AXIS istgang_egs_in void_int_M_S7_S3 8 -1 8 AXIS_PTS_REF KL_KSVHRESET_SYN_ZUS_X /end AXIS_DESCR
/end CHARACTERISTIC
/begin CHARACTERISTIC KL_KSVHRESETABLABBR_SAK_ZUS_Y "Ruecksetzen Schaltverhinderung bei vorherigem Ablauf-Abbruch in Abhaengigkeit des Istgangs im Zustand Schaltung aktiv (255 = alle Arten von Schaltungen zuruecksetzen, 0 = keine Schaltung zuruecksetzen) -> Bit-Codierung siehe Handbuch" CURVE 0x26CF44 UBYTE_COL_DIRECT_M_S7_S3 0 b_int_b_M_S7_S3 0 255
 /begin AXIS_DESCR COM_AXIS istgang_egs_in void_int_M_S7_S3 8 -128 127 AXIS_PTS_REF KL_KSVHRESETABLABBR_SAK_ZUS_X /end AXIS_DESCR
/end CHARACTERISTIC
/begin CHARACTERISTIC KL_KSVHRESETAUSZST_LA_SAK_ZUS_Y "Bedingtes Ruecksetzen einer Schaltverhinderung waehrend VM-Zustart im E-Fahr-Modus \"Ladung abbauen\" in Abhaengigkeit des Istgangs im Zustand SAK (255 = alle Arten von Schaltungen zuruecksetzen, 0 = keine Schaltung zuruecksetzen) ->Kodierung siehe Handbuch" CURVE 0x26CF54 UBYTE_COL_DIRECT_M_S7_S3 0 b_int_b_M_S7_S3 0 255
 /begin AXIS_DESCR COM_AXIS istgang_egs_in void_int_M_S7_S3 8 -128 127 AXIS_PTS_REF KL_KSVHRESETAUSZST_LA_SAK_ZUS_X /end AXIS_DESCR
/end CHARACTERISTIC
/begin CHARACTERISTIC KL_KSVHRESETAUSZST_LE_SAK_ZUS_Y "Bedingtes Ruecksetzen einer Schaltverhinderung waehrend VM-Zustart im E-Fahr-Modus \"Ladung erhalten\" in Abhaengigkeit des Istgangs im Zustand SAK(255 = alle Arten von Schaltungen zuruecksetzen, 0 = keine Schaltung zuruecksetzen)->Kodierung siehe Handbuch" CURVE 0x26CF64 UBYTE_COL_DIRECT_M_S7_S3 0 b_int_b_M_S7_S3 0 255
 /begin AXIS_DESCR COM_AXIS istgang_egs_in void_int_M_S7_S3 8 -128 127 AXIS_PTS_REF KL_KSVHRESETAUSZST_LE_SAK_ZUS_X /end AXIS_DESCR
/end CHARACTERISTIC
/begin CHARACTERISTIC KL_KSVHRESETK0ANGELEGT_ZST_ZUS_Y "Ruecksetzen einer Schaltverhinderung in Abhaengigkeit des Istgangs bei zumindest angelegter K0 im Zustand Zustarten beim Zustart (255 = alle Arten von Schaltungen zuruecksetzen, 0 = keine Schaltung zuruecksetzen) -> Bit-Codierung siehe Handbuch" CURVE 0x26CF74 UBYTE_COL_DIRECT_M_S7_S3 0 b_int_b_M_S7_S3 0 255
 /begin AXIS_DESCR COM_AXIS istgang_egs_in void_int_M_S7_S3 8 -1 8 AXIS_PTS_REF KL_KSVHRESETK0ANGELEGT_ZST_ZUS_X /end AXIS_DESCR
/end CHARACTERISTIC
/begin CHARACTERISTIC KL_KSVHRESETK0FUELLEN_ZST_ZUS_Y "Ruecksetzen einer Schaltverhinderung in Abhaengigkeit des Istgangs beim Befuellen der K0 im Zustand Zustarten beim Zustart (255 = alle Arten von Schaltungen zuruecksetzen, 0 = keine Schaltung zuruecksetzen) -> Bit-Codierung siehe Handbuch" CURVE 0x26CF84 UBYTE_COL_DIRECT_M_S7_S3 0 b_int_b_M_S7_S3 0 255
 /begin AXIS_DESCR COM_AXIS istgang_egs_in void_int_M_S7_S3 8 -128 127 AXIS_PTS_REF KL_KSVHRESETK0FUELLEN_ZST_ZUS_X /end AXIS_DESCR
/end CHARACTERISTIC
/begin CHARACTERISTIC KL_KSVHRESETK0OFFEN_ZST_ZUS_Y "Ruecksetzen einer Schaltverhinderung in Abhaengigkeit des Istgangs bei offener K0 im Zustand Zustarten beim Zustart (255 = alle Arten von Schaltungen zuruecksetzen, 0 = keine Schaltung zuruecksetzen) -> Bit-Codierung siehe Handbuch" CURVE 0x26CF94 UBYTE_COL_DIRECT_M_S7_S3 0 b_int_b_M_S7_S3 0 255
 /begin AXIS_DESCR COM_AXIS istgang_egs_in void_int_M_S7_S3 8 -1 8 AXIS_PTS_REF KL_KSVHRESETK0OFFEN_ZST_ZUS_X /end AXIS_DESCR
/end CHARACTERISTIC
/begin CHARACTERISTIC KL_KSVHRESETNACHVSI_LA_SAK_ZUS_Y "Ruecksetzen einer Schaltverhinderung im EFahr-Modus \"Ladung abbauen\" in Abhaengigkeit des Istgangs nach Verlassen Synchron Istgang im Zustand SAK (255 = alle Arten von Schaltungen zuruecksetzen, 0 = keine Schaltung zuruecksetzen)->Kodierung siehe Handbuch" CURVE 0x26CFA4 UBYTE_COL_DIRECT_M_S7_S3 0 b_int_b_M_S7_S3 0 255
 /begin AXIS_DESCR COM_AXIS istgang_egs_in void_int_M_S7_S3 8 -128 127 AXIS_PTS_REF KL_KSVHRESETNACHVSI_LA_SAK_ZUS_X /end AXIS_DESCR
/end CHARACTERISTIC
/begin CHARACTERISTIC KL_KSVHRESETNACHVSI_LE_SAK_ZUS_Y "Ruecksetzen einer Schaltverhinderung im EFahr-Modus \"Ladung erhalten\" in Abhaengigkeit des Istgangs nach Verlassen Synchron Istgang im Zustand SAK (255 = alle Arten von Schaltungen zuruecksetzen,0 = keine Schaltung zuruecksetzen)->Kodierung siehe Handbuch" CURVE 0x26CFB4 UBYTE_COL_DIRECT_M_S7_S3 0 b_int_b_M_S7_S3 0 255
 /begin AXIS_DESCR COM_AXIS istgang_egs_in void_int_M_S7_S3 8 -128 127 AXIS_PTS_REF KL_KSVHRESETNACHVSI_LE_SAK_ZUS_X /end AXIS_DESCR
/end CHARACTERISTIC
/begin CHARACTERISTIC KL_KSVHRESETVORVSI_LA_SAK_ZUS_Y "Ruecksetzen einer Schaltverhinderung im EFahr-Modus \"Ladung abbauen\" in Abhaengigkeit des Istgangs vor Verlassen Synchron Istgang im Zustand SAK(255 = alle Arten von Schaltungen zuruecksetzen, 0 = keine Schaltung zuruecksetzen)->Kodierung siehe Handbuch" CURVE 0x26CFC4 UBYTE_COL_DIRECT_M_S7_S3 0 b_int_b_M_S7_S3 0 255
 /begin AXIS_DESCR COM_AXIS istgang_egs_in void_int_M_S7_S3 8 -128 127 AXIS_PTS_REF KL_KSVHRESETVORVSI_LA_SAK_ZUS_X /end AXIS_DESCR
/end CHARACTERISTIC
/begin CHARACTERISTIC KL_KSVHRESETVORVSI_LE_SAK_ZUS_Y "Ruecksetzen einer Schaltverhinderung im EFahr-Modus \"Ladung erhalten\" in Abhaengigkeit des Istgangs vor Verlassen Synchron Istgang im Zustand SAK (255 = alle Arten von Schaltungen zuruecksetzen,0 = keine Schaltung zuruecksetzen)->Kodierung siehe Handbuch" CURVE 0x26CFD4 UBYTE_COL_DIRECT_M_S7_S3 0 b_int_b_M_S7_S3 0 255
 /begin AXIS_DESCR COM_AXIS istgang_egs_in void_int_M_S7_S3 8 -128 127 AXIS_PTS_REF KL_KSVHRESETVORVSI_LE_SAK_ZUS_X /end AXIS_DESCR
/end CHARACTERISTIC
/begin CHARACTERISTIC KL_MGK0MODMAXMAX_SYN_ZUS_Y "Maximaler Gradienten des Maximalwerts des modifizierten K0-Moments der HAS in Abhaengigkeit des Gradienten des K0 Sollmoments im Zustand K0-Synchronisieren beim Zustart" CURVE 0x26C80C FLOAT32_IEEE_COL_DIRECT_M_S7_S3 0 trqg_fl_k_M_S7_S3 0 50000
 /begin AXIS_DESCR COM_AXIS mg_soll_k0_syn_zus trqg_fl_k_M_S7_S3 6 -3.40282E+038 3.40282E+038 AXIS_PTS_REF KL_MGK0MODMAXMAX_SYN_ZUS_X /end AXIS_DESCR
/end CHARACTERISTIC
/begin CHARACTERISTIC KL_MGSOLLK0SUS_SYN_ZUS_Y "Gradienten zur Anhebung des K0-Sollmoments der Funktion zur Synchronisationsunterstuetzung (SUS) in Anhaengigkeit des VM-Zielmoments im Zustand K0-Synchronisieren beim Zustart" CURVE 0x26C874 FLOAT32_IEEE_COL_DIRECT_M_S7_S3 0 trqg_fl_k_M_S7_S3 0 50000
 /begin AXIS_DESCR COM_AXIS m_ziel_vm_has_zus trq_fl_a_M_S7_S3 8 -3.40282E+038 3.40282E+038 AXIS_PTS_REF KL_MGSOLLK0SUS_SYN_ZUS_X /end AXIS_DESCR
/end CHARACTERISTIC
/begin CHARACTERISTIC KL_MK0MODFUW_ANH_ZUS_Y "Modifiziertes K0-Moment der HAS bei erkannter EM-Fehlfunktion durch die FUW in Abhaengigkeit des K0 Istmoments im Zustand VM-Drehzahlanhebung beim Zustart" CURVE 0x26C8AC FLOAT32_IEEE_COL_DIRECT_M_S7_S3 0 trq_fl_a_M_S7_S3 0 1000
 /begin AXIS_DESCR COM_AXIS m_k0_in trq_fl_a_M_S7_S3 6 -3.40282E+038 3.40282E+038 AXIS_PTS_REF KL_MK0MODFUW_ANH_ZUS_X /end AXIS_DESCR
/end CHARACTERISTIC
/begin CHARACTERISTIC KL_MK0MODK0BEF_ZUS_Y "Modifiziertes K0-Moment der HAS in Abhaengigkeit des K0 Istmoments in den Zustaenden der K0-Befuellung ZST, SAK, ANH, ABF beim Zustart" CURVE 0x26C8DC FLOAT32_IEEE_COL_DIRECT_M_S7_S3 0 trq_fl_a_M_S7_S3 0 1000
 /begin AXIS_DESCR COM_AXIS m_k0_in trq_fl_a_M_S7_S3 6 -3.40282E+038 3.40282E+038 AXIS_PTS_REF KL_MK0MODK0BEF_ZUS_X /end AXIS_DESCR
/end CHARACTERISTIC
/begin CHARACTERISTIC KL_MK0MODKALTNEM_ANH_ZUS_Y "Modifiziertes K0-Moment der HAS beim Kaltstart mit abgesenkter EM-Drehzahl in Abhaengigkeit des K0 Istmoments im Zustand VM-Drehzahlanhebung beim Zustart" CURVE 0x26C90C FLOAT32_IEEE_COL_DIRECT_M_S7_S3 0 trq_fl_a_M_S7_S3 0 1000
 /begin AXIS_DESCR COM_AXIS m_k0_in trq_fl_a_M_S7_S3 6 -3.40282E+038 3.40282E+038 AXIS_PTS_REF KL_MK0MODKALTNEM_ANH_ZUS_X /end AXIS_DESCR
/end CHARACTERISTIC
/begin CHARACTERISTIC KL_MK0MODUVS_ZST_ZUS_Y "Modifiziertes K0-Moment der HAS bei Anforderung einer K0-Unterstuetzung des VM Startsystems durch die HAS Zustandssteuerung (OML) in Abhaengigkeit des K0 Istmoments im Zustand Zustart beim VM Zustart" CURVE 0x26C93C FLOAT32_IEEE_COL_DIRECT_M_S7_S3 0 trq_fl_a_M_S7_S3 0 1000
 /begin AXIS_DESCR COM_AXIS m_k0_in trq_fl_a_M_S7_S3 6 -3.40282E+038 3.40282E+038 AXIS_PTS_REF KL_MK0MODUVS_ZST_ZUS_X /end AXIS_DESCR
/end CHARACTERISTIC
/begin CHARACTERISTIC KL_MK0ZIEL_ABF_ZUS_Y "Zielwert des K0-Moments zum Abfangen des VM bei einem Abbruch VM Abstellen im Zustand VM Abfangen beim Zustart in Abhaengigkeit des VM Minimalmoments" CURVE 0x26C96C FLOAT32_IEEE_COL_DIRECT_M_S7_S3 0 trq_fl_a_M_S7_S3 -1000 1000
 /begin AXIS_DESCR COM_AXIS m_min_vm_in trq_fl_a_M_S7_S3 6 -3.40282E+038 3.40282E+038 AXIS_PTS_REF KL_MK0ZIEL_ABF_ZUS_X /end AXIS_DESCR
/end CHARACTERISTIC
/begin CHARACTERISTIC KL_MOZIELK0ZMANH_SYN_ZUS_Y "Festlegung des K0-Drehmomentoffsets  zur Bestimmung des K0-Zielmoments der Zusatzdrehmomentanhebung im Zustand K0 Synchronisieren beim Zustart in Abhaengigkeit  des VM-Zielmoments" CURVE 0x26C9C4 FLOAT32_IEEE_COL_DIRECT_M_S7_S3 0 trq_fl_a_M_S7_S3 -1000 1000
 /begin AXIS_DESCR COM_AXIS m_ziel_vm_has_zus trq_fl_a_M_S7_S3 8 -3.40282E+038 3.40282E+038 AXIS_PTS_REF KL_MOZIELK0ZMANH_SYN_ZUS_X /end AXIS_DESCR
/end CHARACTERISTIC
/begin CHARACTERISTIC KL_MOZIELK0ZMANHMAX_SYN_ZUS_Y "Festlegung des Maximalwerts der K0-Drehmomentoffsets  der Zusatzdrehmomentanhebung im Zustand K0 Synchronisieren beim Zustart in Abhaengigkeit  der maximal moeglichen EM-Drehmomentabsenkung" CURVE 0x26C994 FLOAT32_IEEE_COL_DIRECT_M_S7_S3 0 trq_fl_a_M_S7_S3 0 1000
 /begin AXIS_DESCR COM_AXIS NO_INPUT_QUANTITY trq_fl_a_M_S7_S3 4 -3.40282E+038 3.40282E+038 AXIS_PTS_REF KL_MOZIELK0ZMANHMAX_SYN_ZUS_X /end AXIS_DESCR
/end CHARACTERISTIC
/begin CHARACTERISTIC KL_MSOLLK0EMANK_FUW_ZUS_Y "K0 Sollmoment zur Ankoppelung der EM an den VM bei EM-Fehlfunktion der Funktionsueberwachung der EM-Funktion beim Zustart in Abhaengigkeit der Getriebeoeltemperatur" CURVE 0x26CA04 FLOAT32_IEEE_COL_DIRECT_M_S7_S3 0 trq_fl_a_M_S7_S3 0 1000
 /begin AXIS_DESCR COM_AXIS c_getriebe_egs_in trq_fl_a_M_S7_S3 8 -3.40282E+038 3.40282E+038 AXIS_PTS_REF KL_MSOLLK0EMANK_FUW_ZUS_X /end AXIS_DESCR
/end CHARACTERISTIC
/begin CHARACTERISTIC KL_MSOLLK0KALTNEM_ANH_ZUS_Y "K0 Sollmoment zur Ankoppelung der EM an den VM beim Kaltstart mit abgesenkter EM Drehzahl in Abhaengigkeit der Getriebeoeltemperatur im Zustand Drehzahlanhebung beim VM Zustart" CURVE 0x26CA44 FLOAT32_IEEE_COL_DIRECT_M_S7_S3 0 trq_fl_a_M_S7_S3 0 1000
 /begin AXIS_DESCR COM_AXIS c_getriebe_egs_in trq_fl_a_M_S7_S3 8 -3.40282E+038 3.40282E+038 AXIS_PTS_REF KL_MSOLLK0KALTNEM_ANH_ZUS_X /end AXIS_DESCR
/end CHARACTERISTIC
/begin CHARACTERISTIC KL_MSOLLK0MIN_SYN_ZUS_Y "Minimalwert zur Initialisierung des K0-Sollmoments in Anhaengigkeit des VM-Zielmoments im Zustand K0 Synchronisieren beim Zustart" CURVE 0x26CAB0 FLOAT32_IEEE_COL_DIRECT_M_S7_S3 0 trq_fl_a_M_S7_S3 0 100
 /begin AXIS_DESCR COM_AXIS m_ziel_vm_has_zus trq_fl_a_M_S7_S3 5 0 1000 AXIS_PTS_REF KL_MSOLLK0MIN_SYN_ZUS_X /end AXIS_DESCR
/end CHARACTERISTIC
/begin CHARACTERISTIC KL_MVMVOLLASTSAUG_SYN_ZUS_Y "Maximales Saug-Vollastmoment des VM zur Begrenzung des K0-Sollmoments im Zustand K0 Synchronisieren beim Zustart in Abhaengigkeit der VM Drehzahl" CURVE 0x26CB7C FLOAT32_IEEE_COL_DIRECT_M_S7_S3 0 trq_fl_a_M_S7_S3 0 1000
 /begin AXIS_DESCR COM_AXIS n_vm_in n_fl_M_S7_S3 10 -3.40282E+038 3.40282E+038 AXIS_PTS_REF KL_MVMVOLLASTSAUG_SYN_ZUS_X /end AXIS_DESCR
/end CHARACTERISTIC
/begin CHARACTERISTIC KL_MZIELK0MIN_K0ZUHEISS_SYN_ZUS_Y "Festlegung des minimalen K0-Zielmoments zur Bestimmung des K0 Sollmoments bei zu heisser K0 im Zustand K0-Synchronisieren beim Zustart in Abhaengigkeit des VM-Zielmoments" CURVE 0x26CBC4 FLOAT32_IEEE_COL_DIRECT_M_S7_S3 0 trq_fl_a_M_S7_S3 0 1000
 /begin AXIS_DESCR COM_AXIS m_ziel_vm_has_zus trq_fl_a_M_S7_S3 8 -3.40282E+038 3.40282E+038 AXIS_PTS_REF KL_MZIELK0MIN_K0ZUHEISS_SYN_ZUS_X /end AXIS_DESCR
/end CHARACTERISTIC
/begin CHARACTERISTIC KL_MZIELK0MIN_SYN_ZUS_Y "Festlegung des minimalen K0-Zielmoments zur Bestimmung des K0 Sollmoments im Zustand K0 Synchronisieren beim Zustart in Abhaengigkeit  des VM-Zielmoments" CURVE 0x26CC54 FLOAT32_IEEE_COL_DIRECT_M_S7_S3 0 trq_fl_a_M_S7_S3 0 1000
 /begin AXIS_DESCR COM_AXIS m_ziel_vm_has_zus trq_fl_a_M_S7_S3 8 -3.40282E+038 3.40282E+038 AXIS_PTS_REF KL_MZIELK0MIN_SYN_ZUS_X /end AXIS_DESCR
/end CHARACTERISTIC
/begin CHARACTERISTIC KL_MZIELK0MIN_SYNCDDA_SYN_ZUS_Y "Festlegung des minimalen K0-Zielmoments zur Bestimmung des K0 Sollmoments bei durchdrehenden Antriebsraedern im Zustand K0-Synchronisieren beim Zustart in Abhaengigkeit der Differenz zwischen dem Fahrerwunschmoment und dem minimal moeglichen EM-Moment" CURVE 0x26CBF8 FLOAT32_IEEE_COL_DIRECT_M_S7_S3 0 trq_fl_a_M_S7_S3 0 1000
 /begin AXIS_DESCR COM_AXIS NO_INPUT_QUANTITY trq_fl_a_M_S7_S3 5 -3.40282E+038 3.40282E+038 AXIS_PTS_REF KL_MZIELK0MIN_SYNCDDA_SYN_ZUS_X /end AXIS_DESCR
/end CHARACTERISTIC
/begin CHARACTERISTIC KL_MZIELK0MIN_SYNCSZA_SYN_ZUS_Y "Festlegung des minimalen K0-Zielmoments zur Bestimmung des K0 Sollmoments bei aktiver Ablaufvariante Schneller Zustartablauf (SZA) im K0-Synchronisieren beim Zustart in Abhaengigkeit der Differenz zwischen Fahrerwunsch- und minimal moeglichem EM-Moment" CURVE 0x26CC20 FLOAT32_IEEE_COL_DIRECT_M_S7_S3 0 trq_fl_a_M_S7_S3 0 1000
 /begin AXIS_DESCR COM_AXIS NO_INPUT_QUANTITY trq_fl_a_M_S7_S3 5 -3.40282E+038 3.40282E+038 AXIS_PTS_REF KL_MZIELK0MIN_SYNCSZA_SYN_ZUS_X /end AXIS_DESCR
/end CHARACTERISTIC
/begin CHARACTERISTIC KL_NDSK0K0SREG_SYN_ZUS_Y "K0-Differenzdrehzahlschwelle zur Bestimmung des Zeitpunkts der Anforderung der Aktivierung der K0-Schlupfregelung in Abhaengigkeit des K0 Sollmoments im Zustand K0 Synchronisieren beim Zustart" CURVE 0x26CCD8 FLOAT32_IEEE_COL_DIRECT_M_S7_S3 0 n_fl_M_S7_S3 0 10000
 /begin AXIS_DESCR COM_AXIS NO_INPUT_QUANTITY trq_fl_a_M_S7_S3 5 -3.40282E+038 3.40282E+038 AXIS_PTS_REF KL_NDSK0K0SREG_SYN_ZUS_X /end AXIS_DESCR
/end CHARACTERISTIC
/begin CHARACTERISTIC KL_NDSK0SYNCERK_SYN_ZUS_Y "Schwellwert zur Erkennung Synchron beim VM-Zustart in Abhaengigkeit des EM-Drehzahlgradienten " CURVE 0x26CD50 FLOAT32_IEEE_COL_DIRECT_M_S7_S3 0 n_fl_M_S7_S3 0 10000
 /begin AXIS_DESCR COM_AXIS ng_em_zus ng_fl_M_S7_S3 5 -3.40282E+038 3.40282E+038 AXIS_PTS_REF KL_NDSK0SYNCERK_SYN_ZUS_X /end AXIS_DESCR
/end CHARACTERISTIC
/begin CHARACTERISTIC KL_NDZIELK0K0SREG_SYN_ZUS_Y "K0-Zieldifferenzdrehzahl zur Bestimmung der VM-Solldrehzahl bei der Aktivierung der K0-Schlupfregelung in Abhaengigkeit des K0 Sollmoments im Zustand K0 Synchronisieren beim Zustart" CURVE 0x26CD78 FLOAT32_IEEE_COL_DIRECT_M_S7_S3 0 n_fl_M_S7_S3 0 10000
 /begin AXIS_DESCR COM_AXIS NO_INPUT_QUANTITY trq_fl_a_M_S7_S3 5 -3.40282E+038 3.40282E+038 AXIS_PTS_REF KL_NDZIELK0K0SREG_SYN_ZUS_X /end AXIS_DESCR
/end CHARACTERISTIC
/begin CHARACTERISTIC KL_NSEMK0BEFVERZ_SAK_ZUS_Y "EM-Drehzahlschwelle zur Verzoegerung der K0-Befuellung in Abhaengigkeit der Getriebeoeltemperatur im Zustand Schaltung aktiv beim Zustart" CURVE 0x26CDA4 FLOAT32_IEEE_COL_DIRECT_M_S7_S3 0 n_fl_M_S7_S3 0 10000
 /begin AXIS_DESCR COM_AXIS c_getriebe_egs_in c_fl_M_S7_S3 6 -3.40282E+038 3.40282E+038 AXIS_PTS_REF KL_NSEMK0BEFVERZ_SAK_ZUS_X /end AXIS_DESCR
/end CHARACTERISTIC
/begin CHARACTERISTIC KL_SCHALTARTK0BEFVERZ_SAK_ZUS_Y "Festlegung der Schaltart der Schaltungen die zu einer Verzoegerung der K0-Befuellung im fuehren in Abhaengigkeit des Istgangs im Zustand Schaltung aktiv beim Zustart -> Bit-Codierung wie z_ablauf_shv_reset_has" CURVE 0x26D024 UBYTE_COL_DIRECT_M_S7_S3 0 void_int_M_S7_S3 0 255
 /begin AXIS_DESCR COM_AXIS istgang_egs_in void_int_M_S7_S3 8 -1 8 AXIS_PTS_REF KL_SCHALTARTK0BEFVERZ_SAK_ZUS_X /end AXIS_DESCR
/end CHARACTERISTIC
/begin CHARACTERISTIC KL_TK0SYNCERKUMS_SYN_ZUS_Y "Zeit bis zur Umschaltung der Differenzdrehzahlschwelle zur Erkennung Synchron beim VM-Zustart in Abhaengigkeit des VM-Zielmoments" CURVE 0x26CEA8 FLOAT32_IEEE_COL_DIRECT_M_S7_S3 0 t_fl_M_S7_S3 0 10
 /begin AXIS_DESCR COM_AXIS m_ziel_vm_has_zus trq_fl_a_M_S7_S3 5 -3.40282E+038 3.40282E+038 AXIS_PTS_REF KL_TK0SYNCERKUMS_SYN_ZUS_X /end AXIS_DESCR
/end CHARACTERISTIC
/begin CHARACTERISTIC MG_K0SYNCMK0ERHDIAG_SYN_ZUS "Gradient des K0 Sollmoments diagnoseseitiger Anhebung des K0-Sollmoments im Zustand K0 Synchronisieren beim VM Zustart" VALUE 0x26D084 FLOAT32_IEEE_COL_DIRECT_M_S7_S3 0 trqg_fl_k_M_S7_S3 0 10000 /end CHARACTERISTIC
/begin CHARACTERISTIC MG_K0SYNCVMVOLLAST_SYN_ZUS "Gradient des K0 Sollmoments bei Momenten ueber der Saug-Vollastkennlinie des VM im Zustand K0 Synchronisieren beim VM Zustart" VALUE 0x26D088 FLOAT32_IEEE_COL_DIRECT_M_S7_S3 0 trqg_fl_k_M_S7_S3 0 10000 /end CHARACTERISTIC
/begin CHARACTERISTIC MG_SOLLK0_ABB_ZUS "Gradienten fuer das K0-Sollmoments der HAS im Zustand Abbruch Zustart beim Zustart" VALUE 0x26D0D8 FLOAT32_IEEE_COL_DIRECT_M_S7_S3 0 trqg_fl_k_M_S7_S3 0 50000 /end CHARACTERISTIC
/begin CHARACTERISTIC MG_SOLLK0EMANKPOS_FUW_ZUS "Gradient des K0 Sollmoments zur Ankopplung der EM an den VM bei Erkennung EM Fehlfunktion der Funktionsueberwachung der EM Funktion beim Zustart" VALUE 0x26D08C FLOAT32_IEEE_COL_DIRECT_M_S7_S3 0 trqg_fl_k_M_S7_S3 0 50000 /end CHARACTERISTIC
/begin CHARACTERISTIC MG_SOLLK0MIN_SYN_ZUS "Minimaler Gradient des K0-Sollmoments im Zustand K0 Synchronisieren beim Zustart" VALUE 0x26D098 FLOAT32_IEEE_COL_DIRECT_M_S7_S3 0 trqg_fl_k_M_S7_S3 -10000 0 /end CHARACTERISTIC
/begin CHARACTERISTIC MG_SOLLK0NEG_2_SAK_ZUS "Negativer Gradient des K0 Sollmoments zur Begrenzung der K0 Vorsteuerung bei angelegter K0 im Zustand Schaltung aktiv beim VM Zustart" VALUE 0x26D09C FLOAT32_IEEE_COL_DIRECT_M_S7_S3 0 trqg_fl_k_M_S7_S3 -10000 0 /end CHARACTERISTIC
/begin CHARACTERISTIC MG_SOLLK0NEG_2_ZST_ZUS "Negativer Gradient des K0 Sollmoments zur Begrenzung der K0 Vorsteuerung bei angelegter K0 im Zustand Zustarten beim VM Zustart" VALUE 0x26D0A0 FLOAT32_IEEE_COL_DIRECT_M_S7_S3 0 trqg_fl_k_M_S7_S3 -10000 0 /end CHARACTERISTIC
/begin CHARACTERISTIC MG_SOLLK0NEG_ABF_ZUS "Negativer Gradient des K0 Sollmoments zum Abfangen des VM bei einem Abbruch VM Abstellen im Zustand VM Abfangen beim Zustart" VALUE 0x26D0A4 FLOAT32_IEEE_COL_DIRECT_M_S7_S3 0 trqg_fl_k_M_S7_S3 -10000 0 /end CHARACTERISTIC
/begin CHARACTERISTIC MG_SOLLK0NEG_ANH_ZUS "Negativer Gradient des K0 Sollmoments zur Begrenzung der K0 Vorsteuerung im Zustand Drehzahlanhebung beim VM Zustart" VALUE 0x26D0A8 FLOAT32_IEEE_COL_DIRECT_M_S7_S3 0 trqg_fl_k_M_S7_S3 -10000 0 /end CHARACTERISTIC
/begin CHARACTERISTIC MG_SOLLK0NEG_SAK_ZUS "Negativer Gradient des K0 Sollmoments zur Begrenzung der K0 Vorsteuerung waehrend K0 Befuellung im Zustand Schaltung aktiv beim VM Zustart" VALUE 0x26D0AC FLOAT32_IEEE_COL_DIRECT_M_S7_S3 0 trqg_fl_k_M_S7_S3 -10000 0 /end CHARACTERISTIC
/begin CHARACTERISTIC MG_SOLLK0NEG_ZST_ZUS "Negativer Gradient des K0 Sollmoments zur Begrenzung der K0 Vorsteuerung waehrend K0 Befuellung im Zustand Zustarten beim VM Zustart" VALUE 0x26D0B0 FLOAT32_IEEE_COL_DIRECT_M_S7_S3 0 trqg_fl_k_M_S7_S3 -10000 0 /end CHARACTERISTIC
/begin CHARACTERISTIC MG_SOLLK0POS_2_SAK_ZUS "Positiver Gradient des K0 Sollmoments zur Begrenzung der K0 Vorsteuerung bei angelegter K0 im Zustand Schaltung aktiv beim VM Zustart" VALUE 0x26D0B8 FLOAT32_IEEE_COL_DIRECT_M_S7_S3 0 trqg_fl_k_M_S7_S3 0 10000 /end CHARACTERISTIC
/begin CHARACTERISTIC MG_SOLLK0POS_2_ZST_ZUS "Positiver Gradient des K0 Sollmoments zur Begrenzung der K0 Vorsteuerung bei angelegter K0 im Zustand Zustarten beim VM Zustart" VALUE 0x26D0BC FLOAT32_IEEE_COL_DIRECT_M_S7_S3 0 trqg_fl_k_M_S7_S3 0 10000 /end CHARACTERISTIC
/begin CHARACTERISTIC MG_SOLLK0POS_ABF_ZUS "Positiver Gradient des K0 Sollmoments zum Abfangen des VM bei einem Abbruch VM Abstellen im Zustand VM Abfangen beim Zustart" VALUE 0x26D0C0 FLOAT32_IEEE_COL_DIRECT_M_S7_S3 0 trqg_fl_k_M_S7_S3 0 10000 /end CHARACTERISTIC
/begin CHARACTERISTIC MG_SOLLK0POS_ANH_ZUS "Positiver Gradient des K0 Sollmoments zur Begrenzung der K0 Vorsteuerung im Zustand Drehzahlanhebung beim VM Zustart" VALUE 0x26D0C4 FLOAT32_IEEE_COL_DIRECT_M_S7_S3 0 trqg_fl_k_M_S7_S3 0 10000 /end CHARACTERISTIC
/begin CHARACTERISTIC MG_SOLLK0POS_SAK_ZUS "Positiver Gradient des K0 Sollmoments zur Begrenzung der K0 Vorsteuerung waehrend K0 Befuellung im Zustand Schaltung aktiv beim VM Zustart" VALUE 0x26D0C8 FLOAT32_IEEE_COL_DIRECT_M_S7_S3 0 trqg_fl_k_M_S7_S3 0 10000 /end CHARACTERISTIC
/begin CHARACTERISTIC MG_SOLLK0POS_ZST_ZUS "Positiver Gradient des K0 Sollmoments zur Begrenzung der K0 Vorsteuerung waehrend K0 Befuellung im Zustand Zustarten beim VM Zustart" VALUE 0x26D0CC FLOAT32_IEEE_COL_DIRECT_M_S7_S3 0 trqg_fl_k_M_S7_S3 0 10000 /end CHARACTERISTIC
/begin CHARACTERISTIC MG_SOLLK0POSKALTNEM_ANH_ZUS "Gradient des K0 Sollmoment zur Ankoppelung der EM an den VM beim Kaltstart mit abgesenkter EM Drehzahl im Zustand Drehzahlanhebung beim VM Zustart" VALUE 0x26D0B4 FLOAT32_IEEE_COL_DIRECT_M_S7_S3 0 trqg_fl_k_M_S7_S3 0 50000 /end CHARACTERISTIC
/begin CHARACTERISTIC MGS_WUNSCHFPW_ABF_ZUS "Gradientenschwelle zur Initialisierung der VM Solldrehzahl Im Zustand VM-Abfangen beim Zustart" VALUE 0x26D06C FLOAT32_IEEE_COL_DIRECT_M_S7_S3 0 trqg_fl_k_M_S7_S3 -25000 25000 /end CHARACTERISTIC
/begin CHARACTERISTIC MGS_WUNSCHFPW_ANH_ZUS "Gradientenschwelle zur Initialisierung der VM Solldrehzahl im Zustand Drehzahlanhebung beim Zustart" VALUE 0x26D070 FLOAT32_IEEE_COL_DIRECT_M_S7_S3 0 trqg_fl_k_M_S7_S3 -25000 25000 /end CHARACTERISTIC
/begin CHARACTERISTIC MGS_WUNSCHFPW_SYN_ZUS "Gradientenschwelle zur Initialisierung der VM Solldrehzahl im Zustand Synchronisieren beim Zustart" VALUE 0x26D074 FLOAT32_IEEE_COL_DIRECT_M_S7_S3 0 trqg_fl_k_M_S7_S3 -25000 25000 /end CHARACTERISTIC
/begin CHARACTERISTIC MO_VMMGSOLLK0_SYN_ZUS "Offset zur Reduzierung des VM-Istmoments bei der Bestimmung des K0 Sollmomentgradienten im Zustand K0 Synchronisieren beim Zustart" VALUE 0x26D0EC FLOAT32_IEEE_COL_DIRECT_M_S7_S3 0 trq_fl_a_M_S7_S3 -1000 1000 /end CHARACTERISTIC
/begin CHARACTERISTIC MO_ZIELK0MINZMANH_SYN_ZUS "Offset zur Aktivierung des separaten Kennfelds der K0 Sollmomentgradienten bei aktiver Zusatzdrehmomentanhebung im Zustand K0 Synchronisieren beim Zustart" VALUE 0x26D0F0 FLOAT32_IEEE_COL_DIRECT_M_S7_S3 0 trq_fl_a_M_S7_S3 -1000 1000 /end CHARACTERISTIC
/begin CHARACTERISTIC MS_SOLLEMVORSTEUER_ZUS "Drehmomentschwelle des EM Vorsteuermoments zur Aktivierung der Vorgabe des EM-Sollmoments beim Zustart" VALUE 0x26D104 FLOAT32_IEEE_COL_DIRECT_M_S7_S3 0 trq_fl_a_M_S7_S3 -1000 1000 /end CHARACTERISTIC
/begin CHARACTERISTIC MS_SOLLK0K0SREG_SYN_ZUS "Schwelle fuer das K0-Sollmoment der HAS als Basisbedingung fuer die Anforderung der Aktivierung der K0-Schlupfregelung im Zustand K0 Synchronisieren beim Zustart" VALUE 0x26D108 FLOAT32_IEEE_COL_DIRECT_M_S7_S3 0 trq_fl_a_M_S7_S3 -1000 1000 /end CHARACTERISTIC
/begin CHARACTERISTIC MS_WUNSCHK0HYS_ANH_ZUS "Schwelle fuer das gefilterte Fahrerwunschmoment der HST zum Setzen des K0-Hystereseflags der HAS im Zustand VM-Drehzahlanhebung beim Zustart" VALUE 0x26D10C FLOAT32_IEEE_COL_DIRECT_M_S7_S3 0 trq_fl_a_M_S7_S3 -1000 1000 /end CHARACTERISTIC
/begin CHARACTERISTIC MS_ZIELVMHASK0HYS_ANH_ZUS "Schwelle fuer das VM-Zielmoment zum Setzen des K0-Hystereseflags der HAS im Zustand VM-Drehzahlanhebung beim Zustart" VALUE 0x26D114 FLOAT32_IEEE_COL_DIRECT_M_S7_S3 0 trq_fl_a_M_S7_S3 -1000 1000 /end CHARACTERISTIC
/begin CHARACTERISTIC MS_ZIELVMK0SREG_SYN_ZUS "Schwelle fuer das VM-Zielmoment als Basisbedingung fuer die Anforderung der Aktivierung der K0-Schlupfregelung im Zustand K0 Synchronisieren beim Zustart" VALUE 0x26D118 FLOAT32_IEEE_COL_DIRECT_M_S7_S3 0 trq_fl_a_M_S7_S3 -1000 1000 /end CHARACTERISTIC
/begin CHARACTERISTIC N_MINEMNSOLLVM_ZST_ZUS "Minimale EM-Drehzahl als Basis fuer die Bestimmung der VM-Solldrehzahl ab dem Zustand Zustarten und in den Zustaenden Schaltung aktiv und VM Abfangen beim Zustart" VALUE 0x26D1C8 FLOAT32_IEEE_COL_DIRECT_M_S7_S3 0 n_fl_M_S7_S3 0 2000 /end CHARACTERISTIC
/begin CHARACTERISTIC N_SOLLVMFUW_ZST_ZUS "VM-Solldrehzahl bei erkannter EM-Fehlfunktion durch die FUW ab dem Zustand Zustarten beim Zustart" VALUE 0x26D1CC FLOAT32_IEEE_COL_DIRECT_M_S7_S3 0 n_fl_M_S7_S3 0 3000 /end CHARACTERISTIC
/begin CHARACTERISTIC NDGS_K0K0SREG_SYN_ZUS "Maximaler Betrag des K0-Differenzdrehzahlgradienten zur Bestimmung des Zeitpunkts der Anforderung der Aktivierung der K0-Schlupfregelung im Zustand K0 Synchronisieren beim Zustart" VALUE 0x26D124 FLOAT32_IEEE_COL_DIRECT_M_S7_S3 0 ng_fl_M_S7_S3 0 10000 /end CHARACTERISTIC
/begin CHARACTERISTIC NDS_K0MK0ANH_ABF_ZUS "K0-Differenzdrehzahlschwelle zur Aktivierung der K0-Momentenanhebung im Zustand VM Abfangen beim Zustart" VALUE 0x26D140 FLOAT32_IEEE_COL_DIRECT_M_S7_S3 0 n_fl_M_S7_S3 -1000 1000 /end CHARACTERISTIC
/begin CHARACTERISTIC NDS_K0SYNCERKDDA_SYN_ZUS "Schwellwert der Differenzdrehzahl zur Erkennung Synchron bei durchdrehenden Antriebsraedern beim VM Zustart" VALUE 0x26D144 FLOAT32_IEEE_COL_DIRECT_M_S7_S3 0 n_fl_M_S7_S3 0 10000 /end CHARACTERISTIC
/begin CHARACTERISTIC NDS_K0SYNCERKMAX_SYN_ZUS "Schwellwert nach Umschaltung der Differenzdrehzahl zur Erkennung Synchron beim VM-Zustart" VALUE 0x26D148 FLOAT32_IEEE_COL_DIRECT_M_S7_S3 0 n_fl_M_S7_S3 0 10000 /end CHARACTERISTIC
/begin CHARACTERISTIC NDS_K0SYNCERKSZA_SYN_ZUS "Schwellwert der Differenzdrehzahl zur Erkennung Synchron bei der aktiven Ablaufvariante Schneller Zustartablauf (SZA) beim VM Zustart" VALUE 0x26D14C FLOAT32_IEEE_COL_DIRECT_M_S7_S3 0 n_fl_M_S7_S3 0 10000 /end CHARACTERISTIC
/begin CHARACTERISTIC NDS_K0VZWERKSYNCERK_SYN_ZUS "K0-Differenzdrehzahlschwelle zur Erkennung eines signifikanten Vorzeichenwechsels der Erkennung einer Antriebsstrangschwingung
bei geschlossener K0 zur Erkennung Synchron beim VM Zustart" VALUE 0x26D150 FLOAT32_IEEE_COL_DIRECT_M_S7_S3 0 n_fl_M_S7_S3 0 10000 /end CHARACTERISTIC
/begin CHARACTERISTIC NDS_VMNEMBED_ANH_ZUS "Schwellwert der Differenzdrehzahl zwischen VM und EM Drehzahl als uebergangsbedingung nach K0 Synchronisieren im Zustand Drehzahlanhebung beim Zustart" VALUE 0x26D15C FLOAT32_IEEE_COL_DIRECT_M_S7_S3 0 n_fl_M_S7_S3 -10000 0 /end CHARACTERISTIC
/begin CHARACTERISTIC NDS_VMNEMK0HYS_ANH_ZUS "Schwellwert der Differenzdrehzahl zwischen VM und EM Drehzahl zur Aktivierung der Logik zur Ruecknahme des K0-Hystereseflags im Zustand VM Drehzahlanhebung beim Zustart" VALUE 0x26D160 FLOAT32_IEEE_COL_DIRECT_M_S7_S3 0 n_fl_M_S7_S3 -10000 10000 /end CHARACTERISTIC
/begin CHARACTERISTIC NDS_VMNEMK0HYS_SAK_ZUS "Schwellwert der Differenzdrehzahl zwischen VM und der EM Drehzahl zur Aktivierung der Logik zur Ruecknahme des K0-Hystereseflags im Zustand 'Schaltung aktiv' beim Zustart" VALUE 0x26D164 FLOAT32_IEEE_COL_DIRECT_M_S7_S3 0 n_fl_M_S7_S3 -10000 10000 /end CHARACTERISTIC
/begin CHARACTERISTIC NDS_VMNEMSVHRESET_ANH_ZUS "Schwellwert der Differenzdrehzahl zwischen VM und EM Drehzahl zum Setzen der SVH Reset-Anforderung des Zustands K0-Synchronisieren bereits im Zustand VM Drehzahlanhebung beim Zustart" VALUE 0x26D168 FLOAT32_IEEE_COL_DIRECT_M_S7_S3 0 n_fl_M_S7_S3 -10000 0 /end CHARACTERISTIC
/begin CHARACTERISTIC NDS_VMNSOLLLLVMFUW_ANH_ZUS "Schwellwert der Differenzdrehzahl zwischen der VM Drehzahl und der Leerlauf-Solldrehzahl des VM zur Freigabe der K0-Sollmomentanhebung
bei aktiver FUW im Zustand VM-Drehzahlanhebung beim Zustart" VALUE 0x26D16C FLOAT32_IEEE_COL_DIRECT_M_S7_S3 0 n_fl_M_S7_S3 -10000 0 /end CHARACTERISTIC
/begin CHARACTERISTIC NG_EMMODRSMIN_SYN_ZUS "Minimaler Gradient der modifizierten EM-Drehzahl als Basisdrehzahl zur Bestimmung der VM Solldrehzahl bei RS beim K0 Synchronisieren beim Zustart" VALUE 0x26D178 FLOAT32_IEEE_COL_DIRECT_M_S7_S3 0 ng_fl_M_S7_S3 -50000 0 /end CHARACTERISTIC
/begin CHARACTERISTIC NGS_VMMK0ANH_ABF_ZUS "Maximaler VM-Drehzahlgradient zur Aktivierung der K0-Momentenanhebung im Zustand VM Abfangen beim Zustart" VALUE 0x26D170 FLOAT32_IEEE_COL_DIRECT_M_S7_S3 0 n_fl_M_S7_S3 -30000 30000 /end CHARACTERISTIC
/begin CHARACTERISTIC NO_EMNSOLLVMSAK_ZST_ZUS "EM Drehzahloffset zur Beibehaltung des VM-Solldrehzahloffsets des Zustands 'Schaltung aktiv' im Zustand 'Zustarten' beim Zustart" VALUE 0x26D184 FLOAT32_IEEE_COL_DIRECT_M_S7_S3 0 n_fl_M_S7_S3 -10000 10000 /end CHARACTERISTIC
/begin CHARACTERISTIC NO_SOLLVMANHFRK_ANH_ZUS "VM-Solldrehzahloffset aufgrund einer Anforderung des Fehlerreaktionskoordinators in den Zustaenden VM-Drehzahlanhebung und VM Abfangen beim VM Zustart" VALUE 0x26D188 FLOAT32_IEEE_COL_DIRECT_M_S7_S3 0 n_fl_M_S7_S3 0 10000 /end CHARACTERISTIC
/begin CHARACTERISTIC NOS_EMNSOLLVM_SYN_ZUS "Schwelle zur Initialisierung des Timers fuer die Umschaltung der Differenzdrehzahlschwelle zur Erkennung Synchron beim VM Zustart" VALUE 0x26D180 FLOAT32_IEEE_COL_DIRECT_M_S7_S3 0 n_fl_M_S7_S3 0 10000 /end CHARACTERISTIC
/begin CHARACTERISTIC NOS_EMNSOLLVMK0SREG_SYN_ZUS "Schwelle des Drehzahloffsets der VM-Solldrehzahl zur EM-Drehzahl zur Bestimmung des Zeitpunkts der Anforderung der Aktivierung der K0-Schlupfregelung im Zustand K0 Synchronisieren beim Zustart" VALUE 0x26D17C FLOAT32_IEEE_COL_DIRECT_M_S7_S3 0 n_fl_M_S7_S3 0 10000 /end CHARACTERISTIC
/begin CHARACTERISTIC NS_EMK0HYS_ANH_ZUS "EM-Drehzahlschwelle zur Aktivierung der Logik zur Ruecknahme des K0 Hystereseflags im Zustand VM Drehzahlanhebung beim Zustart" VALUE 0x26D18C FLOAT32_IEEE_COL_DIRECT_M_S7_S3 0 n_fl_M_S7_S3 0 2000 /end CHARACTERISTIC
/begin CHARACTERISTIC NS_EMKALTNEM_ZST_ZUS "EM-Drehzahlschwelle zur Erkennung der ausreichenden oelversorgung zur K0 Befuellung beim Kaltstart mit abgesenkter EM-Drehzahl im Zustand Zustarten beim Zustart" VALUE 0x26D190 FLOAT32_IEEE_COL_DIRECT_M_S7_S3 0 n_fl_M_S7_S3 0 10000 /end CHARACTERISTIC
/begin CHARACTERISTIC NS_EMMGSOLLK0NULL_SYN_ZUS "Minimale EM-Drehzahl zur Freigabe der Anhebung des K0-Sollmoments im Zustand K0 Synchronisieren im Zustart" VALUE 0x26D194 FLOAT32_IEEE_COL_DIRECT_M_S7_S3 0 n_fl_M_S7_S3 0 1000 /end CHARACTERISTIC
/begin CHARACTERISTIC NS_EMMINBED_SYN_ZUS "EM-Drehzahlschwelle zur Erkennung 'EM laeuft noch' als uebergangsbedingung nach K0-Schliessen im Zustand K0 Synchronisieren beim Zustart" VALUE 0x26D19C FLOAT32_IEEE_COL_DIRECT_M_S7_S3 0 n_fl_M_S7_S3 0 2000 /end CHARACTERISTIC
/begin CHARACTERISTIC NS_EMSVHRESET_ANH_ZUS "EM-Drehzahlschwelle zum Setzen der SVH Reset-Anforderung des Zustands K0-Synchronisieren bereits im Zustand VM Drehzahlanhebung beim Zustart" VALUE 0x26D1AC FLOAT32_IEEE_COL_DIRECT_M_S7_S3 0 n_fl_M_S7_S3 0 10000 /end CHARACTERISTIC
/begin CHARACTERISTIC NS_SOLLEMKALTNEM_ZST_ZUS "EM-Solldrehzahlschwelle zur Erkennung der Sicherstellung der ausreichenden oelversorgung zur K0 Befuellung beim Kaltstart mit abgesenkter EM-Drehzahl im Zustand Zustarten beim Zustart" VALUE 0x26D1B0 FLOAT32_IEEE_COL_DIRECT_M_S7_S3 0 n_fl_M_S7_S3 0 10000 /end CHARACTERISTIC
/begin CHARACTERISTIC SCHALTART_VMABFLAUSBED_SRT_ZUS "Festlegung der Schaltart der laufenden Schaltungen zur Freigabe des Zustandsuebergangs in den Zustand VM-Abfangen im Zustand Start beim Zustart" VALUE 0x26F1B6 UBYTE_COL_DIRECT_M_S7_S3 0 void_int_M_S7_S3 0 255 /end CHARACTERISTIC
/begin CHARACTERISTIC STATUS_ABL_ABF_ZUS "Projektspezifische Statusrueckmeldung an HST im Zustand VM Abfangen beim Zustart" VALUE 0x26F1BA UBYTE_COL_DIRECT_M_S7_S3 0 sts_int_M_S7_S3 0 255 /end CHARACTERISTIC
/begin CHARACTERISTIC STATUS_ABL_ANH_ZUS "Projektspezifische Statusrueckmeldung an HST im Zustand Drehzahlanhebung beim Zustart" VALUE 0x26F1BB UBYTE_COL_DIRECT_M_S7_S3 0 sts_int_M_S7_S3 0 255 /end CHARACTERISTIC
/begin CHARACTERISTIC STATUS_ABL_SCL_ZUS "Projektspezifische Statusrueckmeldung an HST im Zustand K0-Schliessen beim Zustart" VALUE 0x26F1BD UBYTE_COL_DIRECT_M_S7_S3 0 sts_int_M_S7_S3 0 255 /end CHARACTERISTIC
/begin CHARACTERISTIC STATUS_ABL_ZST_ZUS "Projektspezifische Vorgabe des Zahlenwerts fuer den Ablaufstatus status_ablauf_has in den einzelnen Zustaenden eines Hybridablaufs" VALUE 0x26F1BF UBYTE_COL_DIRECT_M_S7_S3 0 sts_int_M_S7_S3 0 255 /end CHARACTERISTIC
/begin CHARACTERISTIC SWI_K0BEFLP1FUW_ZST_ZUS "Schalter zur Aktivierung der K0 Befuellung bei Status Pumpendruck Leistungspunkt 1 und erkannter EM-Fehlfunktion im Zustand Zustarten beim Zustart" VALUE 0x26F1C1 UBYTE_COL_DIRECT_M_S7_S3 0 swi_int_M_S7_S3 0 1 /end CHARACTERISTIC
/begin CHARACTERISTIC SWI_K0SREGBASIS_SYN_ZUS "Aktivierung und Konfiguration der Aktivierung der K0 Schlupfregelung beim K0 Synchronisieren beim Zustart: bit0 = K0SREG aktiv, bit1 = Beruecksichtigung IAE, bit2 = Ber. Schaltung, bit3 = Ber. FST" VALUE 0x26F1C2 UBYTE_COL_DIRECT_M_S7_S3 0 swi_int_o_M_S7_S3 0 15 /end CHARACTERISTIC
/begin CHARACTERISTIC SWI_K0SUS_SYN_ZUS "Schalter zur Aktivierung der K0 Synchronisationsunterstuetzung (SUS) im Zustand K0 Synchronisieren beim Zustart" VALUE 0x26F1C3 UBYTE_COL_DIRECT_M_S7_S3 0 swi_int_M_S7_S3 0 1 /end CHARACTERISTIC
/begin CHARACTERISTIC SWI_KFMGK0AUSWAHL_SYN_ZUS "Auswahl des KF_MGK0xxx_ZUS - FALSE = xxxNDK0M_x, TRUE = xxxNDK0NGVM_x im Zustand K0 Synchronisieren beim Zustart" VALUE 0x26F1C4 UBYTE_COL_DIRECT_M_S7_S3 0 swi_int_M_S7_S3 0 1 /end CHARACTERISTIC
/begin CHARACTERISTIC SWI_MGK0RSKF_SYN_ZUS "Aktivierung der Schaltungsabhaengigkeit beim K0 Sollmomentgradienten beim K0 Synchronisieren beim Zustart" VALUE 0x26F1C5 UBYTE_COL_DIRECT_M_S7_S3 0 swi_int_M_S7_S3 0 1 /end CHARACTERISTIC
/begin CHARACTERISTIC SWI_MK0MODBEGR_ABF_ZUS "Aktivierung der Null-Setzung des modifizierten K0-Moments der HAS im Zustand VM Abfangen beim Zustart" VALUE 0x26F1C6 UBYTE_COL_DIRECT_M_S7_S3 0 swi_int_M_S7_S3 0 1 /end CHARACTERISTIC
/begin CHARACTERISTIC SWI_MK0MODBEGR_ANH_ZUS "Aktivierung der Null-Setzung des modifizierten K0-Moments der HAS im Zustand K0-Synchronisieren beim Zustart" VALUE 0x26F1C7 UBYTE_COL_DIRECT_M_S7_S3 0 swi_int_M_S7_S3 0 1 /end CHARACTERISTIC
/begin CHARACTERISTIC SWI_MK0MODBEGR_SAK_ZUS "Aktivierung der Null-Setzung des modifizierten K0-Moments der HAS im Zustand Schaltung aktiv beim Zustart" VALUE 0x26F1C8 UBYTE_COL_DIRECT_M_S7_S3 0 swi_int_M_S7_S3 0 1 /end CHARACTERISTIC
/begin CHARACTERISTIC SWI_MK0MODBEGR_SYN_ZUS "Aktivierung der Maximalwertbegrenzung des modifizierten K0-Moments der HAS im Zustand K0-Synchronisieren beim Zustart" VALUE 0x26F1C9 UBYTE_COL_DIRECT_M_S7_S3 0 swi_int_M_S7_S3 0 1 /end CHARACTERISTIC
/begin CHARACTERISTIC SWI_MK0MODBEGR_ZST_ZUS "Aktivierung der Null-Setzung des modifizierten K0-Moments der HAS im Zustand Zustart beim Zustart" VALUE 0x26F1CA UBYTE_COL_DIRECT_M_S7_S3 0 swi_int_M_S7_S3 0 1 /end CHARACTERISTIC
/begin CHARACTERISTIC SWI_UVS_ZUS "Aktivierung und Konfiguration der K0-Unterstuetzung des VM Startsystems beim Zustart: 0 = keine UVS, 1 = UVS in ZST, 2 = UVS in ZST und SAK, 3 = UVS in ZST und ABF, 4 = UVS in ZST, SAK und ABF" VALUE 0x26F1CD UBYTE_COL_DIRECT_M_S7_S3 0 swi_int_o_M_S7_S3 0 4 /end CHARACTERISTIC
/begin CHARACTERISTIC SWI_ZMSOLLEM_ABF_ZUS "Schalter zur Aktivierung der EM-Sollmomentvorgabe im Zustand VM- Abfangen beim Zustart" VALUE 0x26F1D0 UBYTE_COL_DIRECT_M_S7_S3 0 swi_int_M_S7_S3 0 1 /end CHARACTERISTIC
/begin CHARACTERISTIC SWI_ZMSOLLEM_ANH_ZUS "Schalter zur Aktivierung der EM-Sollmomentvorgabe im Zustand Drehzahlanhebung beim Zustart" VALUE 0x26F1D1 UBYTE_COL_DIRECT_M_S7_S3 0 swi_int_M_S7_S3 0 1 /end CHARACTERISTIC
/begin CHARACTERISTIC SWI_ZMSOLLEM_SAK_ZUS "Schalter zur Aktivierung der EM-Sollmomentvorgabe im Zustand Schaltung aktiv beim Zustart" VALUE 0x26F1D2 UBYTE_COL_DIRECT_M_S7_S3 0 swi_int_M_S7_S3 0 1 /end CHARACTERISTIC
/begin CHARACTERISTIC SWI_ZMSOLLEM_SYN_ZUS "Schalter zur Aktivierung der EM-Sollmomentvorgabe im Zustand K0-Synchronisieren beim Zustart" VALUE 0x26F1D3 UBYTE_COL_DIRECT_M_S7_S3 0 swi_int_M_S7_S3 0 1 /end CHARACTERISTIC
/begin CHARACTERISTIC SWI_ZMSOLLEM_ZST_ZUS "Schalter zur Aktivierung der EM-Sollmomentvorgabe im Zustand Zustarten beim Zustart" VALUE 0x26F1D4 UBYTE_COL_DIRECT_M_S7_S3 0 swi_int_M_S7_S3 0 1 /end CHARACTERISTIC
/begin CHARACTERISTIC SWI_ZPHYSK0_ABB_ZUS "SWI fuer die Hysteresekompensation K0 im Zustand Zustarten beim Abbruch Zustart: 0 = Druckanteil p_hys_k0_has inaktiv, 1 = Druckanteil p_hys_k0_has aktiv" VALUE 0x26F1D6 UBYTE_COL_DIRECT_M_S7_S3 0 swi_int_M_S7_S3 0 1 /end CHARACTERISTIC
/begin CHARACTERISTIC SWI_ZPHYSK0_ABF_ZUS "SWI fuer die Hysteresekompensation K0 im Zustand VM Abfangen beim VM Zustarten: 0 = Druckanteil p_hys_k0_has inaktiv, 1 = Druckanteil p_hys_k0_has aktiv" VALUE 0x26F1D7 UBYTE_COL_DIRECT_M_S7_S3 0 swi_int_M_S7_S3 0 1 /end CHARACTERISTIC
/begin CHARACTERISTIC SWI_ZPHYSK0_ANH_ZUS "SWI fuer die Hysteresekompensation K0 im Zustand VM Drehzahlanhebung beim VM Zustarten: 0 = Druckanteil p_hys_k0_has inaktiv, 1 = Druckanteil p_hys_k0_has aktiv" VALUE 0x26F1D8 UBYTE_COL_DIRECT_M_S7_S3 0 swi_int_M_S7_S3 0 1 /end CHARACTERISTIC
/begin CHARACTERISTIC SWI_ZPHYSK0_SAK_ZUS "SWI fuer die Hysteresekompensation K0 im Zustand Schaltung aktiv beim Zustart: 0 : Druckanteil p_hys_k0_has inaktiv 1 : Druckanteil p_hys_k0_has aktiv " VALUE 0x26F1D9 UBYTE_COL_DIRECT_M_S7_S3 0 swi_int_M_S7_S3 0 1 /end CHARACTERISTIC
/begin CHARACTERISTIC SWI_ZPHYSK0_SCL_ZUS "SWI fuer die Hysteresekompensation K0 im Zustand K0 Schliessen beim VM Zustarten: 0 = Druckanteil p_hys_k0_has inaktiv, 1 = Druckanteil p_hys_k0_has aktiv" VALUE 0x26F1DA UBYTE_COL_DIRECT_M_S7_S3 0 swi_int_M_S7_S3 0 1 /end CHARACTERISTIC
/begin CHARACTERISTIC SWI_ZPHYSK0_SYN_ZUS "SWI fuer die Hysteresekompensation K0 im Zustand K0 Synchronisieren beim VM Zustarten: 0 = Druckanteil p_hys_k0_has inaktiv, 1 = Druckanteil p_hys_k0_has aktiv" VALUE 0x26F1DC UBYTE_COL_DIRECT_M_S7_S3 0 swi_int_M_S7_S3 0 1 /end CHARACTERISTIC
/begin CHARACTERISTIC SWI_ZPHYSK0_ZST_ZUS "SWI fuer die Hysteresekompensation K0 im Zustand Zustarten beim VM Zustarten: 0 = Druckanteil p_hys_k0_has inaktiv, 1 = Druckanteil p_hys_k0_has aktiv" VALUE 0x26F1DF UBYTE_COL_DIRECT_M_S7_S3 0 swi_int_M_S7_S3 0 1 /end CHARACTERISTIC
/begin CHARACTERISTIC SWI_ZPHYSK0RUECKSTATUSK0_ZST_ZUS "Schalter zur Aktivierung der Ruecknahme der Vorgabe in Abhaengigkeit des K0-Status in den Zustaenden Zustarten, Schaltung aktiv und VM Abfangen beim VM-Zustarten" VALUE 0x26F1D5 UBYTE_COL_DIRECT_M_S7_S3 0 swi_int_M_S7_S3 0 1 /end CHARACTERISTIC
/begin CHARACTERISTIC T_K0SREGBASISMAX_SYN_ZUS "Maximalzeit zum Setzen der Basisbedingung zur Aktivierung der K0-Schlupfregelung im Zustand K0 Synchronisieren beim Zustart" VALUE 0x26D1D0 FLOAT32_IEEE_COL_DIRECT_M_S7_S3 0 t_fl_M_S7_S3 0 10 /end CHARACTERISTIC
/begin CHARACTERISTIC T_MAX_ABB_ZUS "Maximale Verweildauer im Zustand Abbruch beim Zustart" VALUE 0x26D1D4 FLOAT32_IEEE_COL_DIRECT_M_S7_S3 0 t_fl_M_S7_S3 0 10 /end CHARACTERISTIC
/begin CHARACTERISTIC T_MAX_SAK_ZUS "Max-Timer in Phase Schaltung Aktiv (100)" VALUE 0x26D1D8 FLOAT32_IEEE_COL_DIRECT_M_S7_S3 0 t_fl_M_S7_S3 0 10 /end CHARACTERISTIC
/begin CHARACTERISTIC T_NDGK0K0SREGMIN_SYN_ZUS "Mindestdauer bei der Abfrage des K0-Differenzdrehzahlgradienten zur Bestimmung des Zeitpunkt der Anforderung der Aktivierung der K0-Schlupfregelung im Zustand K0 Synchronisieren beim Zustart" VALUE 0x26D1EC FLOAT32_IEEE_COL_DIRECT_M_S7_S3 0 t_fl_M_S7_S3 0 5 /end CHARACTERISTIC
/begin CHARACTERISTIC T_VK0BEFKALTNEM_ZST_ZUS "Verzoegerungszeit zur Sicherstellung der oelversorgung zur Befuellung der K0 bei einem Kaltstart-Ablauf mit abgesenkter EM-Drehzahl im Zustand Zustarten beim Zustart" VALUE 0x26D1F0 FLOAT32_IEEE_COL_DIRECT_M_S7_S3 0 t_fl_M_S7_S3 0 5 /end CHARACTERISTIC
/begin CHARACTERISTIC T_VK0BEFVERZ_ZST_ZUS "Verzoegerung der K0 Befuellung in Erwartung einer Schaltanforderung die zu einem Ruecksprung in dem Zustand Schaltung aktiv fuehrt im Zustand Zustarten beim Zustart" VALUE 0x26D1F4 FLOAT32_IEEE_COL_DIRECT_M_S7_S3 0 t_fl_M_S7_S3 0 1 /end CHARACTERISTIC
/begin CHARACTERISTIC T_VK0SREGAKTIV_SYN_ZUS "Verzoegerungszeit zur Aktivierung der K0-Schlupfregelung nach Eintritt in den Zustand K0 Synchronisieren beim Zustart" VALUE 0x26D1F8 FLOAT32_IEEE_COL_DIRECT_M_S7_S3 0 t_fl_M_S7_S3 0 5 /end CHARACTERISTIC
/begin CHARACTERISTIC T_VK0SYNCERK_SYN_ZUS "Timer zur K0 Synchronerkennung im Zustand K0 Synchronisieren beim Zustart" VALUE 0x26D204 FLOAT32_IEEE_COL_DIRECT_M_S7_S3 0 t_fl_M_S7_S3 0 10 /end CHARACTERISTIC
/begin CHARACTERISTIC T_VK0SYNCERKDDA_SYN_ZUS "Verzoegerungszeit der K0-Synchron-Erkennung bei durchdrehenden Antriebsraedern im Zustand K0-Synchronisieren beim Zustart" VALUE 0x26D1FC FLOAT32_IEEE_COL_DIRECT_M_S7_S3 0 t_fl_M_S7_S3 0 10 /end CHARACTERISTIC
/begin CHARACTERISTIC T_VK0SYNCERKSZA_SYN_ZUS "Verzoegerungszeit der K0-Synchron-Erkennung bei der aktiven Ablaufvariante Schneller Zustartablauf (SZA) im Zustand K0-Synchronisieren beim Zustart" VALUE 0x26D200 FLOAT32_IEEE_COL_DIRECT_M_S7_S3 0 t_fl_M_S7_S3 0 10 /end CHARACTERISTIC
/begin CHARACTERISTIC T_VK0ZUNEMFEHLER_FUW_ZUS "Verzoegerungszeit zur Abschaetzung 'K0 zu' bei fehlerhafter EM-Drehzahl der Funktionsueberwachung der EM-Funktion bei beim Zustart" VALUE 0x26D208 FLOAT32_IEEE_COL_DIRECT_M_S7_S3 0 t_fl_M_S7_S3 0 5 /end CHARACTERISTIC
/begin CHARACTERISTIC T_VMSTATUSMAX_ABF_ZUS "Maximalzeit der Beruecksichtigung der Anzeige VM selbstlauffaehig als Uebergangsbedingung nach K0- Synchronisieren im Zustand VM-Abfangen beim Zustart" VALUE 0x26D20C FLOAT32_IEEE_COL_DIRECT_M_S7_S3 0 t_fl_M_S7_S3 0 5 /end CHARACTERISTIC
/begin CHARACTERISTIC T_VMSTATUSMAX_ANH_ZUS "Maximalzeit der Beruecksichtigung der Anzeige VM selbstlauffaehig als Uebergangsbedingung nach K0- Synchronisieren im Zustand VM-Drehzahlanhebung beim Zustart" VALUE 0x26D210 FLOAT32_IEEE_COL_DIRECT_M_S7_S3 0 t_fl_M_S7_S3 0 5 /end CHARACTERISTIC
/begin CHARACTERISTIC T_ZNDK0VZWSYNCERK_SYN_ZUS "Zeit zur Erkennung eines Vorzeichenwechsels der K0-Differenzdrehzahl der Erkennung einer Antriebsstrangschwingung bei geschlossener
K0 zur Erkennung Synchron beim VM Zustart" VALUE 0x26D214 FLOAT32_IEEE_COL_DIRECT_M_S7_S3 0 t_fl_M_S7_S3 0 5 /end CHARACTERISTIC
/begin CHARACTERISTIC TAB_KFMGK0STATUSIAE_SYN_ZUS "Tabelle zur Aktivierung des Kennfelds KF_MGK0NDK0M_IAEREG_SYN_ZUS in Abhaengigkeit des IAE Status im Zustand K0 Synchronisieren beim Zustart" VAL_BLK 0x26F1A7 UBYTE_COL_DIRECT_M_S7_S3 0 void_int_d_M_S7_S3 0 1 NUMBER 9 /end CHARACTERISTIC
/begin CHARACTERISTIC Z_ABLAUF_ABBRUCH_ZUS "Anzeigen eines Abbruchs durch die HAS-Zustandssteuerung (OML) beim Zustart" VALUE 0x26F1E3 UBYTE_COL_DIRECT_M_S7_S3 0 void_int_M_S7_S3 0 255 /end CHARACTERISTIC
/begin CHARACTERISTIC Z_ABLAUFVARIANTE_KALTNEM_ZUS "Anforderung eines Kaltstart-Ablaufs mit abgesenkter EM-Drehzahl durch die HAS Zustandssteuerung (OML) beim Zustart (z_ablaufvariante_has_stg)" VALUE 0x26F1E0 UBYTE_COL_DIRECT_M_S7_S3 0 void_int_M_S7_S3 0 100 /end CHARACTERISTIC
/begin CHARACTERISTIC Z_ABLAUFVARIANTE_UVS_ZUS "Anforderung einer K0-Unterstuetzung des VM Startsystems durch die HAS Zustandssteuerung (OML) beim Zustart (z_ablaufvariante_has_stg) " VALUE 0x26F1E2 UBYTE_COL_DIRECT_M_S7_S3 0 void_int_M_S7_S3 0 100 /end CHARACTERISTIC
/begin CHARACTERISTIC Z_NDK0VZWMINSYNCERK_SYN_ZUS "Minimale Anzahl von Vorzeichenwechseln der K0-Differenzdrehzahl zur Erkennung einer Antriebsstrangschwingung bei geschlossener K0 zur Erkennung Synchron beim VM Zustart" VALUE 0x26F1E4 UBYTE_COL_DIRECT_M_S7_S3 0 void_int_M_S7_S3 0 100 /end CHARACTERISTIC
/begin AXIS_PTS KF_MGK0NDK0M_IAEREG_SYN_ZUS_X "Gradient des K0-Sollmoments in Abhaengigkeit der K0 Differenzdrehzahl und dem VM Zielmoment bei aktiver IAE-Regelung im Zustand K0 Synchronisieren beim Zustart" 0x26AFF0 nd_k0_in FLOAT32_IEEE_X_INCR_DIRECT_M_S7_S3 0 n_fl_M_S7_S3 7 -3.40282E+038 3.40282E+038 /end AXIS_PTS
/begin AXIS_PTS KF_MGK0NDK0M_IAEREG_SYN_ZUS_Y "Gradient des K0-Sollmoments in Abhaengigkeit der K0 Differenzdrehzahl und dem VM Zielmoment bei aktiver IAE-Regelung im Zustand K0 Synchronisieren beim Zustart" 0x26B00C m_ziel_vm_has_zus FLOAT32_IEEE_X_INCR_DIRECT_M_S7_S3 0 trq_fl_a_M_S7_S3 6 -3.40282E+038 3.40282E+038 /end AXIS_PTS
/begin AXIS_PTS KF_MGK0NDK0M_K0ZUHEISS_SYN_ZUS_X "Mindest-Gradient des K0-Sollmoments in Abhaengigkeit der K0 Differenzdrehzahl und dem VM Zielmoment bei zu heisser K0 im Zustand K0-Synchronisieren beim Zustart" 0x26B0CC nd_k0_in FLOAT32_IEEE_X_INCR_DIRECT_M_S7_S3 0 n_fl_M_S7_S3 7 -3.40282E+038 3.40282E+038 /end AXIS_PTS
/begin AXIS_PTS KF_MGK0NDK0M_K0ZUHEISS_SYN_ZUS_Y "Mindest-Gradient des K0-Sollmoments in Abhaengigkeit der K0 Differenzdrehzahl und dem VM Zielmoment bei zu heisser K0 im Zustand K0-Synchronisieren beim Zustart" 0x26B0E8 m_ziel_vm_has_zus FLOAT32_IEEE_X_INCR_DIRECT_M_S7_S3 0 trq_fl_a_M_S7_S3 6 -3.40282E+038 3.40282E+038 /end AXIS_PTS
/begin AXIS_PTS KF_MGK0NDK0M_MRS_SYN_ZUS_X "Gradient des K0-Sollmoments in Abhaengigkeit der K0 Differenzdrehzahl und dem VM Zielmoment  bei Mehrfachrueckschaltungen beim K0 Synchronisieren beim Zustart " 0x26B1A8 nd_k0_in FLOAT32_IEEE_X_INCR_DIRECT_M_S7_S3 0 n_fl_M_S7_S3 7 -3.40282E+038 3.40282E+038 /end AXIS_PTS
/begin AXIS_PTS KF_MGK0NDK0M_MRS_SYN_ZUS_Y "Gradient des K0-Sollmoments in Abhaengigkeit der K0 Differenzdrehzahl und dem VM Zielmoment  bei Mehrfachrueckschaltungen beim K0 Synchronisieren beim Zustart " 0x26B1C4 m_ziel_vm_has_zus FLOAT32_IEEE_X_INCR_DIRECT_M_S7_S3 0 trq_fl_a_M_S7_S3 6 -3.40282E+038 3.40282E+038 /end AXIS_PTS
/begin AXIS_PTS KF_MGK0NDK0M_RS_SYN_ZUS_X "Gradient des K0-Sollmoments in Abhaengigkeit der K0 Differenzdrehzahl und dem VM Zielmoment  bei Rueckschaltungen beim K0 Synchronisieren beim Zustart " 0x26B284 nd_k0_in FLOAT32_IEEE_X_INCR_DIRECT_M_S7_S3 0 n_fl_M_S7_S3 7 -3.40282E+038 3.40282E+038 /end AXIS_PTS
/begin AXIS_PTS KF_MGK0NDK0M_RS_SYN_ZUS_Y "Gradient des K0-Sollmoments in Abhaengigkeit der K0 Differenzdrehzahl und dem VM Zielmoment  bei Rueckschaltungen beim K0 Synchronisieren beim Zustart " 0x26B2A0 m_ziel_vm_has_zus FLOAT32_IEEE_X_INCR_DIRECT_M_S7_S3 0 trq_fl_a_M_S7_S3 6 -3.40282E+038 3.40282E+038 /end AXIS_PTS
/begin AXIS_PTS KF_MGK0NDK0M_SYN_ZUS_X "Gradient des K0 Sollmoments in Abhaengigkeit der K0 Differenzdrehzahl und VM Zielmoment beim K0 Synchronisieren beim Zustart" 0x26B518 nd_k0_in FLOAT32_IEEE_X_INCR_DIRECT_M_S7_S3 0 n_fl_M_S7_S3 7 -3.40282E+038 3.40282E+038 /end AXIS_PTS
/begin AXIS_PTS KF_MGK0NDK0M_SYN_ZUS_Y "Gradient des K0 Sollmoments in Abhaengigkeit der K0 Differenzdrehzahl und VM Zielmoment beim K0 Synchronisieren beim Zustart" 0x26B534 m_ziel_vm_has_zus FLOAT32_IEEE_X_INCR_DIRECT_M_S7_S3 0 trq_fl_a_M_S7_S3 6 -3.40282E+038 3.40282E+038 /end AXIS_PTS
/begin AXIS_PTS KF_MGK0NDK0M_SYNCDDA_SYN_ZUS_X "Mindest-Gradient des K0-Sollmoments in Abhaengigkeit der K0 Differenzdrehzahl und dem VM Zielmoment bei durchdrehenden Antriebsraedern im Zustand K0-Synchronisieren beim Zustart" 0x26B360 nd_k0_in FLOAT32_IEEE_X_INCR_DIRECT_M_S7_S3 0 n_fl_M_S7_S3 7 -3.40282E+038 3.40282E+038 /end AXIS_PTS
/begin AXIS_PTS KF_MGK0NDK0M_SYNCDDA_SYN_ZUS_Y "Mindest-Gradient des K0-Sollmoments in Abhaengigkeit der K0 Differenzdrehzahl und dem VM Zielmoment bei durchdrehenden Antriebsraedern im Zustand K0-Synchronisieren beim Zustart" 0x26B37C m_ziel_vm_has_zus FLOAT32_IEEE_X_INCR_DIRECT_M_S7_S3 0 trq_fl_a_M_S7_S3 6 -3.40282E+038 3.40282E+038 /end AXIS_PTS
/begin AXIS_PTS KF_MGK0NDK0M_SYNCSZA_SYN_ZUS_X "Mindest-Gradient des K0-Sollmoments in Abhaengigkeit der K0 Differenzdrehzahl und dem VM Zielmoment bei der aktiven Ablaufvariante Schneller Zustartablauf (SZA) im Zustand K0-Synchronisieren beim Zustart" 0x26B43C nd_k0_in FLOAT32_IEEE_X_INCR_DIRECT_M_S7_S3 0 n_fl_M_S7_S3 7 -3.40282E+038 3.40282E+038 /end AXIS_PTS
/begin AXIS_PTS KF_MGK0NDK0M_SYNCSZA_SYN_ZUS_Y "Mindest-Gradient des K0-Sollmoments in Abhaengigkeit der K0 Differenzdrehzahl und dem VM Zielmoment bei der aktiven Ablaufvariante Schneller Zustartablauf (SZA) im Zustand K0-Synchronisieren beim Zustart" 0x26B458 m_ziel_vm_has_zus FLOAT32_IEEE_X_INCR_DIRECT_M_S7_S3 0 trq_fl_a_M_S7_S3 6 -3.40282E+038 3.40282E+038 /end AXIS_PTS
/begin AXIS_PTS KF_MGK0NDK0M_ZMANH_SYN_ZUS_X "Gradient des K0-Sollmoments in Abhaengigkeit der K0 Differenzdrehzahl und dem VM Zielmoment bei aktiver Zusatzdrehmomentanhebung beim K0 Synchronisieren beim Zustart " 0x26B5F4 nd_k0_in FLOAT32_IEEE_X_INCR_DIRECT_M_S7_S3 0 n_fl_M_S7_S3 7 -3.40282E+038 3.40282E+038 /end AXIS_PTS
/begin AXIS_PTS KF_MGK0NDK0M_ZMANH_SYN_ZUS_Y "Gradient des K0-Sollmoments in Abhaengigkeit der K0 Differenzdrehzahl und dem VM Zielmoment bei aktiver Zusatzdrehmomentanhebung beim K0 Synchronisieren beim Zustart " 0x26B610 m_ziel_vm_has_zus FLOAT32_IEEE_X_INCR_DIRECT_M_S7_S3 0 trq_fl_a_M_S7_S3 6 -3.40282E+038 3.40282E+038 /end AXIS_PTS
/begin AXIS_PTS KF_MGK0NDK0NGVM_SYN_ZUS_X "Gradient des K0 Sollmoments in Abhaengigkeit der K0 Differenzdrehzahl und des VM Drehzahlgradienten beim K0 Synchronisieren beim Zustart" 0x26B724 nd_k0_in FLOAT32_IEEE_X_INCR_DIRECT_M_S7_S3 0 n_fl_M_S7_S3 7 -3.40282E+038 3.40282E+038 /end AXIS_PTS
/begin AXIS_PTS KF_MGK0NDK0NGVM_SYN_ZUS_Y "Gradient des K0 Sollmoments in Abhaengigkeit der K0 Differenzdrehzahl und des VM Drehzahlgradienten beim K0 Synchronisieren beim Zustart" 0x26B740 ng_vm_in FLOAT32_IEEE_X_INCR_DIRECT_M_S7_S3 0 trq_fl_a_M_S7_S3 9 -3.40282E+038 3.40282E+038 /end AXIS_PTS
/begin AXIS_PTS KF_MOSOLLK0BEF_ZST_ZUS_X "Offset auf das K0-Sollmoment in Abhaengigkeit des VM-Zielmoments und der Getriebeoeltemperatur ab dem Zustand Zustarten beim Zustart." 0x26B804 m_ziel_vm_has_zus FLOAT32_IEEE_X_INCR_DIRECT_M_S7_S3 0 trq_fl_a_M_S7_S3 5 -3.40282E+038 3.40282E+038 /end AXIS_PTS
/begin AXIS_PTS KF_MOSOLLK0BEF_ZST_ZUS_Y "Offset auf das K0-Sollmoment in Abhaengigkeit des VM-Zielmoments und der Getriebeoeltemperatur ab dem Zustand Zustarten beim Zustart." 0x26B818 c_getriebe_egs_in FLOAT32_IEEE_X_INCR_DIRECT_M_S7_S3 0 c_fl_M_S7_S3 8 -3.40282E+038 3.40282E+038 /end AXIS_PTS
/begin AXIS_PTS KF_MSOLLK0BEF_2_SAK_ZUS_X "Vorgabe des K0-Sollmoments bei angelegter K0 in Abhaengigkeit des VM-Zielmoments und des maximalen dynamischen EM Moments im Zustand Schaltung aktiv beim VM Zustart" 0x26BDA0 m_ziel_vm_has_zus FLOAT32_IEEE_X_INCR_DIRECT_M_S7_S3 0 trq_fl_a_M_S7_S3 5 -3.40282E+038 3.40282E+038 /end AXIS_PTS
/begin AXIS_PTS KF_MSOLLK0BEF_2_SAK_ZUS_Y "Vorgabe des K0-Sollmoments bei angelegter K0 in Abhaengigkeit des VM-Zielmoments und des maximalen dynamischen EM Moments im Zustand Schaltung aktiv beim VM Zustart" 0x26BDB4 m_max_dyn_em_in FLOAT32_IEEE_X_INCR_DIRECT_M_S7_S3 0 trq_fl_a_M_S7_S3 5 -3.40282E+038 3.40282E+038 /end AXIS_PTS
/begin AXIS_PTS KF_MSOLLK0BEF_2_ZST_ZUS_X "Vorgabe des K0-Sollmoments bei angelegter K0 in Abhaengigkeit des VM-Zielmoments und des maximalen dynamischen EM Moments im Zustand Zustart beim VM Zustart" 0x26BE2C m_ziel_vm_has_zus FLOAT32_IEEE_X_INCR_DIRECT_M_S7_S3 0 trq_fl_a_M_S7_S3 5 -3.40282E+038 3.40282E+038 /end AXIS_PTS
/begin AXIS_PTS KF_MSOLLK0BEF_2_ZST_ZUS_Y "Vorgabe des K0-Sollmoments bei angelegter K0 in Abhaengigkeit des VM-Zielmoments und des maximalen dynamischen EM Moments im Zustand Zustart beim VM Zustart" 0x26BE40 m_max_dyn_em_in FLOAT32_IEEE_X_INCR_DIRECT_M_S7_S3 0 trq_fl_a_M_S7_S3 5 -3.40282E+038 3.40282E+038 /end AXIS_PTS
/begin AXIS_PTS KF_MSOLLK0BEF_ABF_ZUS_X "Vorgabe des K0-Sollmoments in der Fuellausgleichsphase in Abhaengigkeit des VM-Zielmoments und des maximalen dynamischen EM Moments im Zustand VM Abfangen beim VM Zustart" 0x26BEB8 m_ziel_vm_has_zus FLOAT32_IEEE_X_INCR_DIRECT_M_S7_S3 0 trq_fl_a_M_S7_S3 5 -3.40282E+038 3.40282E+038 /end AXIS_PTS
/begin AXIS_PTS KF_MSOLLK0BEF_ABF_ZUS_Y "Vorgabe des K0-Sollmoments in der Fuellausgleichsphase in Abhaengigkeit des VM-Zielmoments und des maximalen dynamischen EM Moments im Zustand VM Abfangen beim VM Zustart" 0x26BECC m_max_dyn_em_in FLOAT32_IEEE_X_INCR_DIRECT_M_S7_S3 0 trq_fl_a_M_S7_S3 5 -3.40282E+038 3.40282E+038 /end AXIS_PTS
/begin AXIS_PTS KF_MSOLLK0BEF_ANH_ZUS_X "Vorgabe des K0-Sollmoments in Abhaengigkeit des VM-Zielmoments und des maximalen dynamischen EM Moments im Zustand Drehzahlanhebung beim VM Zustart" 0x26BF44 m_ziel_vm_has_zus FLOAT32_IEEE_X_INCR_DIRECT_M_S7_S3 0 trq_fl_a_M_S7_S3 5 -3.40282E+038 3.40282E+038 /end AXIS_PTS
/begin AXIS_PTS KF_MSOLLK0BEF_ANH_ZUS_Y "Vorgabe des K0-Sollmoments in Abhaengigkeit des VM-Zielmoments und des maximalen dynamischen EM Moments im Zustand Drehzahlanhebung beim VM Zustart" 0x26BF58 m_max_dyn_em_in FLOAT32_IEEE_X_INCR_DIRECT_M_S7_S3 0 trq_fl_a_M_S7_S3 5 -3.40282E+038 3.40282E+038 /end AXIS_PTS
/begin AXIS_PTS KF_MSOLLK0BEF_SAK_ZUS_X "Vorgabe des K0-Sollmoments in der Fuellausgleichsphase in Abhaengigkeit des VM-Zielmoments und des maximalen dynamischen EM Moments im Zustand Schaltung aktiv beim VM Zustart" 0x26BFD0 m_ziel_vm_has_zus FLOAT32_IEEE_X_INCR_DIRECT_M_S7_S3 0 trq_fl_a_M_S7_S3 5 -3.40282E+038 3.40282E+038 /end AXIS_PTS
/begin AXIS_PTS KF_MSOLLK0BEF_SAK_ZUS_Y "Vorgabe des K0-Sollmoments in der Fuellausgleichsphase in Abhaengigkeit des VM-Zielmoments und des maximalen dynamischen EM Moments im Zustand Schaltung aktiv beim VM Zustart" 0x26BFE4 m_max_dyn_em_in FLOAT32_IEEE_X_INCR_DIRECT_M_S7_S3 0 trq_fl_a_M_S7_S3 5 -3.40282E+038 3.40282E+038 /end AXIS_PTS
/begin AXIS_PTS KF_MSOLLK0BEF_ZST_ZUS_X "Vorgabe des K0-Sollmoments in der Fuellausgleichsphase in Abhaengigkeit des VM-Zielmoments und des maximalen dynamischen EM Moments im Zustand Zustart beim VM Zustart" 0x26C05C m_ziel_vm_has_zus FLOAT32_IEEE_X_INCR_DIRECT_M_S7_S3 0 trq_fl_a_M_S7_S3 5 -3.40282E+038 3.40282E+038 /end AXIS_PTS
/begin AXIS_PTS KF_MSOLLK0BEF_ZST_ZUS_Y "Vorgabe des K0-Sollmoments in der Fuellausgleichsphase in Abhaengigkeit des VM-Zielmoments und des maximalen dynamischen EM Moments im Zustand Zustart beim VM Zustart" 0x26C070 m_max_dyn_em_in FLOAT32_IEEE_X_INCR_DIRECT_M_S7_S3 0 trq_fl_a_M_S7_S3 5 -3.40282E+038 3.40282E+038 /end AXIS_PTS
/begin AXIS_PTS KF_NDEMNSOLLVM_ANH_ZUS_X "Differenzdrehzahl zum Abbau des Drehzahloffset auf die Basis-Drehzahl zur Berechnung des Zielwerts der VM Solldrehzahl ab dem Zustand Drehzahlanhebung und in den Zustand VM Abfangen beim Zustart" 0x26C19C n_em_in FLOAT32_IEEE_X_INCR_DIRECT_M_S7_S3 0 n_fl_M_S7_S3 10 -3.40282E+038 3.40282E+038 /end AXIS_PTS
/begin AXIS_PTS KF_NDEMNSOLLVM_ANH_ZUS_Y "Differenzdrehzahl zum Abbau des Drehzahloffset auf die Basis-Drehzahl zur Berechnung des Zielwerts der VM Solldrehzahl ab dem Zustand Drehzahlanhebung und in den Zustand VM Abfangen beim Zustart" 0x26C1C4 NO_INPUT_QUANTITY FLOAT32_IEEE_X_INCR_DIRECT_M_S7_S3 0 trq_fl_a_M_S7_S3 7 -3.40282E+038 3.40282E+038 /end AXIS_PTS
/begin AXIS_PTS KF_NDEMNSOLLVM_K0ZUHEISS_SYN_ZUS_X "Mindest-Differenzdrehzahl zum schnelleren Abbau des Drehzahloffset auf die Basis-Drehzahl zur Berechnung des Zielwerts der VM Solldrehzahl bei zu heisser K0 im Zustand K0-Synchronisieren beim Zustart" 0x26C2F8 n_em_in FLOAT32_IEEE_X_INCR_DIRECT_M_S7_S3 0 n_fl_M_S7_S3 10 -3.40282E+038 3.40282E+038 /end AXIS_PTS
/begin AXIS_PTS KF_NDEMNSOLLVM_K0ZUHEISS_SYN_ZUS_Y "Mindest-Differenzdrehzahl zum schnelleren Abbau des Drehzahloffset auf die Basis-Drehzahl zur Berechnung des Zielwerts der VM Solldrehzahl bei zu heisser K0 im Zustand K0-Synchronisieren beim Zustart" 0x26C320 NO_INPUT_QUANTITY FLOAT32_IEEE_X_INCR_DIRECT_M_S7_S3 0 trq_fl_a_M_S7_S3 7 -3.40282E+038 3.40282E+038 /end AXIS_PTS
/begin AXIS_PTS KF_NDEMNSOLLVM_SAK_ZUS_X "Differenzdrehzahl zum Abbau des Drehzahloffsets auf die Basis-Drehzahl zur Berechnung des Zielwerts der VM Solldrehzahl bei zuvor Schaltung aktiv ab dem Zustand Drehzahlanhebung beim Zustart" 0x26C454 n_em_in FLOAT32_IEEE_X_INCR_DIRECT_M_S7_S3 0 n_fl_M_S7_S3 10 -3.40282E+038 3.40282E+038 /end AXIS_PTS
/begin AXIS_PTS KF_NDEMNSOLLVM_SAK_ZUS_Y "Differenzdrehzahl zum Abbau des Drehzahloffsets auf die Basis-Drehzahl zur Berechnung des Zielwerts der VM Solldrehzahl bei zuvor Schaltung aktiv ab dem Zustand Drehzahlanhebung beim Zustart" 0x26C47C NO_INPUT_QUANTITY FLOAT32_IEEE_X_INCR_DIRECT_M_S7_S3 0 trq_fl_a_M_S7_S3 7 -3.40282E+038 3.40282E+038 /end AXIS_PTS
/begin AXIS_PTS KF_NGEMMODRSMAX_SYN_ZUS_X "Maximaler Gradient der modifizierten EM-Drehzahl als Basisdrehzahl zur Bestimmung der VM Solldrehzahl bei RS beim K0 Synchronisieren beim Zustart" 0x26C4E8 n_sec_iae_ist_zus FLOAT32_IEEE_X_INCR_DIRECT_M_S7_S3 0 n_fl_M_S7_S3 5 -3.40282E+038 3.40282E+038 /end AXIS_PTS
/begin AXIS_PTS KF_NGEMMODRSMAX_SYN_ZUS_Y "Maximaler Gradient der modifizierten EM-Drehzahl als Basisdrehzahl zur Bestimmung der VM Solldrehzahl bei RS beim K0 Synchronisieren beim Zustart" 0x26C4FC nd_sec_iae_syn_zus FLOAT32_IEEE_X_INCR_DIRECT_M_S7_S3 0 n_fl_M_S7_S3 4 -3.40282E+038 3.40282E+038 /end AXIS_PTS
/begin AXIS_PTS KF_NOEMNSOLLVM_SAK_ZUS_X "Drehzahloffset auf die Basis-Drehzahl zur Berechnung des Zielwerts der VM Solldrehzahl im Zustand Schaltung aktiv und in den Folgezustaenden beim Zustart" 0x26C624 NO_INPUT_QUANTITY FLOAT32_IEEE_X_INCR_DIRECT_M_S7_S3 0 n_fl_M_S7_S3 10 -3.40282E+038 3.40282E+038 /end AXIS_PTS
/begin AXIS_PTS KF_NOEMNSOLLVM_SAK_ZUS_Y "Drehzahloffset auf die Basis-Drehzahl zur Berechnung des Zielwerts der VM Solldrehzahl im Zustand Schaltung aktiv und in den Folgezustaenden beim Zustart" 0x26C64C NO_INPUT_QUANTITY FLOAT32_IEEE_X_INCR_DIRECT_M_S7_S3 0 trq_fl_a_M_S7_S3 7 -3.40282E+038 3.40282E+038 /end AXIS_PTS
/begin AXIS_PTS KF_NOEMNSOLLVM_ZST_ZUS_X "Drehzahloffset auf die Basis-Drehzahl zur Berechnung des Zielwerts der VM Solldrehzahl ab dem Zustand Zustarten und im Zustand VM Abfangen beim Zustart" 0x26C780 n_em_in FLOAT32_IEEE_X_INCR_DIRECT_M_S7_S3 0 n_fl_M_S7_S3 10 -3.40282E+038 3.40282E+038 /end AXIS_PTS
/begin AXIS_PTS KF_NOEMNSOLLVM_ZST_ZUS_Y "Drehzahloffset auf die Basis-Drehzahl zur Berechnung des Zielwerts der VM Solldrehzahl ab dem Zustand Zustarten und im Zustand VM Abfangen beim Zustart" 0x26C7A8 NO_INPUT_QUANTITY FLOAT32_IEEE_X_INCR_DIRECT_M_S7_S3 0 trq_fl_a_M_S7_S3 7 -3.40282E+038 3.40282E+038 /end AXIS_PTS
/begin AXIS_PTS KL_KSVHABBRLAUSFST_ZUS_X "Festlegung der Schaltart der von der Fahrstrategie abzubrechenden  laufenden Schaltungen in Abhaengigkeit des aktuellen Zustands beim Zustart -> Bit-Codierung wie z_ablauf_shv_reset_has" 0x26E33C st_ablauf_fkt UWORD_X_INCR_DIRECT_M_S7_S3 0 st_int_g_M_S7_S3 7 0 65535 /end AXIS_PTS
/begin AXIS_PTS KL_KSVHPALAUSNACHVSI_LA_SAK_ZUS_X "Festlegung der Schaltart der zum Rest des Zustart-Ablaufs parallel laufenden Schaltungen im E-Fahr-Modus \"Ladung abbauen\" in Abhaengigkeit des Istgangs nach Verlassen Synchron Istgang im Zustand SAK beim ZUS->Kodierung wie z_ablauf_shv_reset_has" 0x26CEFC istgang_egs_in SBYTE_X_INCR_DIRECT_M_S7_S3 0 void_int_M_S7_S3 8 -128 127 /end AXIS_PTS
/begin AXIS_PTS KL_KSVHPALAUSNACHVSI_LE_SAK_ZUS_X "Festlegung der Schaltart der zum Rest des Zustart-Ablaufs parallel laufenden Schaltungen im E-Fahr-Modus \"Ladung erhalten\" in Abhaengigkeit des Istgangs nach Verlassen Synchron Istgang im Zustand SAK beim ZUS->Kodierung wie z_ablauf_shv_reset_has" 0x26CF0C istgang_egs_in SBYTE_X_INCR_DIRECT_M_S7_S3 0 void_int_M_S7_S3 8 -128 127 /end AXIS_PTS
/begin AXIS_PTS KL_KSVHPALAUSVORVSI_LA_SAK_ZUS_X "Festlegung der Schaltart der zum Rest des Zustart-Ablaufs parallel laufenden Schaltungen im E-Fahr-Modus \"Ladung abbauen\" in Abhaengigkeit des Istgangs vor Verlassen Synchron Istgang im Zustand SAK beim ZUS->Kodierung wie z_ablauf_shv_reset_has" 0x26CF1C istgang_egs_in SBYTE_X_INCR_DIRECT_M_S7_S3 0 void_int_M_S7_S3 8 -128 127 /end AXIS_PTS
/begin AXIS_PTS KL_KSVHPALAUSVORVSI_LE_SAK_ZUS_X "Festlegung der Schaltart der zum Rest des Zustart-Ablaufs parallel laufenden Schaltungen im E-Fahr-Modus \"Ladung erhalten\" in Abhaengigkeit des Istgangs vor Verlassen Synchron Istgang im Zustand SAK beim ZUS->Kodierung z_ablauf_shv_reset_has" 0x26CF2C istgang_egs_in SBYTE_X_INCR_DIRECT_M_S7_S3 0 void_int_M_S7_S3 8 -128 127 /end AXIS_PTS
/begin AXIS_PTS KL_KSVHRESET_ABF_ZUS_X "Ruecksetzen einer Schaltverhinderung in Abhaengigkeit des Istgangs im Zustand VM-Abfangen beim Zustart (255 = alle Arten von Schaltungen zuruecksetzen, 0 = keine Schaltung zuruecksetzen) -> Bit-Codierung siehe Handbuch" 0x26CFDC istgang_egs_in SBYTE_X_INCR_DIRECT_M_S7_S3 0 void_int_M_S7_S3 8 -1 8 /end AXIS_PTS
/begin AXIS_PTS KL_KSVHRESET_ANH_ZUS_X "Ruecksetzen einer Schaltverhinderung in Abhaengigkeit des Istgangs im Zustand VM-Drehzahlanhebung beim Zustart (255 = alle Arten von Schaltungen zuruecksetzen, 0 = keine Schaltung zuruecksetzen) -> Bit-Codierung siehe Handbuch" 0x26CFEC istgang_egs_in SBYTE_X_INCR_DIRECT_M_S7_S3 0 void_int_M_S7_S3 8 -1 8 /end AXIS_PTS
/begin AXIS_PTS KL_KSVHRESET_SYN_ZUS_X "Ruecksetzen einer Schaltverhinderung in Abhaengigkeit des Istgangs im Zustand K0-Synchronisieren beim Zustart (255 = alle Arten von Schaltungen zuruecksetzen, 0 = keine Schaltung zuruecksetzen) -> Bit-Codierung siehe Handbuch" 0x26D00C istgang_egs_in SBYTE_X_INCR_DIRECT_M_S7_S3 0 void_int_M_S7_S3 8 -1 8 /end AXIS_PTS
/begin AXIS_PTS KL_KSVHRESETABLABBR_SAK_ZUS_X "Ruecksetzen Schaltverhinderung bei vorherigem Ablauf-Abbruch in Abhaengigkeit des Istgangs im Zustand Schaltung aktiv (255 = alle Arten von Schaltungen zuruecksetzen, 0 = keine Schaltung zuruecksetzen) -> Bit-Codierung siehe Handbuch" 0x26CF3C istgang_egs_in SBYTE_X_INCR_DIRECT_M_S7_S3 0 void_int_M_S7_S3 8 -128 127 /end AXIS_PTS
/begin AXIS_PTS KL_KSVHRESETAUSZST_LA_SAK_ZUS_X "Bedingtes Ruecksetzen einer Schaltverhinderung waehrend VM-Zustart im E-Fahr-Modus \"Ladung abbauen\" in Abhaengigkeit des Istgangs im Zustand SAK (255 = alle Arten von Schaltungen zuruecksetzen, 0 = keine Schaltung zuruecksetzen) ->Kodierung siehe Handbuch" 0x26CF4C istgang_egs_in SBYTE_X_INCR_DIRECT_M_S7_S3 0 void_int_M_S7_S3 8 -128 127 /end AXIS_PTS
/begin AXIS_PTS KL_KSVHRESETAUSZST_LE_SAK_ZUS_X "Bedingtes Ruecksetzen einer Schaltverhinderung waehrend VM-Zustart im E-Fahr-Modus \"Ladung erhalten\" in Abhaengigkeit des Istgangs im Zustand SAK(255 = alle Arten von Schaltungen zuruecksetzen, 0 = keine Schaltung zuruecksetzen)->Kodierung siehe Handbuch" 0x26CF5C istgang_egs_in SBYTE_X_INCR_DIRECT_M_S7_S3 0 void_int_M_S7_S3 8 -128 127 /end AXIS_PTS
/begin AXIS_PTS KL_KSVHRESETK0ANGELEGT_ZST_ZUS_X "Ruecksetzen einer Schaltverhinderung in Abhaengigkeit des Istgangs bei zumindest angelegter K0 im Zustand Zustarten beim Zustart (255 = alle Arten von Schaltungen zuruecksetzen, 0 = keine Schaltung zuruecksetzen) -> Bit-Codierung siehe Handbuch" 0x26CF6C istgang_egs_in SBYTE_X_INCR_DIRECT_M_S7_S3 0 void_int_M_S7_S3 8 -1 8 /end AXIS_PTS
/begin AXIS_PTS KL_KSVHRESETK0FUELLEN_ZST_ZUS_X "Ruecksetzen einer Schaltverhinderung in Abhaengigkeit des Istgangs beim Befuellen der K0 im Zustand Zustarten beim Zustart (255 = alle Arten von Schaltungen zuruecksetzen, 0 = keine Schaltung zuruecksetzen) -> Bit-Codierung siehe Handbuch" 0x26CF7C istgang_egs_in SBYTE_X_INCR_DIRECT_M_S7_S3 0 void_int_M_S7_S3 8 -128 127 /end AXIS_PTS
/begin AXIS_PTS KL_KSVHRESETK0OFFEN_ZST_ZUS_X "Ruecksetzen einer Schaltverhinderung in Abhaengigkeit des Istgangs bei offener K0 im Zustand Zustarten beim Zustart (255 = alle Arten von Schaltungen zuruecksetzen, 0 = keine Schaltung zuruecksetzen) -> Bit-Codierung siehe Handbuch" 0x26CF8C istgang_egs_in SBYTE_X_INCR_DIRECT_M_S7_S3 0 void_int_M_S7_S3 8 -1 8 /end AXIS_PTS
/begin AXIS_PTS KL_KSVHRESETNACHVSI_LA_SAK_ZUS_X "Ruecksetzen einer Schaltverhinderung im EFahr-Modus \"Ladung abbauen\" in Abhaengigkeit des Istgangs nach Verlassen Synchron Istgang im Zustand SAK (255 = alle Arten von Schaltungen zuruecksetzen, 0 = keine Schaltung zuruecksetzen)->Kodierung siehe Handbuch" 0x26CF9C istgang_egs_in SBYTE_X_INCR_DIRECT_M_S7_S3 0 void_int_M_S7_S3 8 -128 127 /end AXIS_PTS
/begin AXIS_PTS KL_KSVHRESETNACHVSI_LE_SAK_ZUS_X "Ruecksetzen einer Schaltverhinderung im EFahr-Modus \"Ladung erhalten\" in Abhaengigkeit des Istgangs nach Verlassen Synchron Istgang im Zustand SAK (255 = alle Arten von Schaltungen zuruecksetzen,0 = keine Schaltung zuruecksetzen)->Kodierung siehe Handbuch" 0x26CFAC istgang_egs_in SBYTE_X_INCR_DIRECT_M_S7_S3 0 void_int_M_S7_S3 8 -128 127 /end AXIS_PTS
/begin AXIS_PTS KL_KSVHRESETVORVSI_LA_SAK_ZUS_X "Ruecksetzen einer Schaltverhinderung im EFahr-Modus \"Ladung abbauen\" in Abhaengigkeit des Istgangs vor Verlassen Synchron Istgang im Zustand SAK(255 = alle Arten von Schaltungen zuruecksetzen, 0 = keine Schaltung zuruecksetzen)->Kodierung siehe Handbuch" 0x26CFBC istgang_egs_in SBYTE_X_INCR_DIRECT_M_S7_S3 0 void_int_M_S7_S3 8 -128 127 /end AXIS_PTS
/begin AXIS_PTS KL_KSVHRESETVORVSI_LE_SAK_ZUS_X "Ruecksetzen einer Schaltverhinderung im EFahr-Modus \"Ladung erhalten\" in Abhaengigkeit des Istgangs vor Verlassen Synchron Istgang im Zustand SAK (255 = alle Arten von Schaltungen zuruecksetzen,0 = keine Schaltung zuruecksetzen)->Kodierung siehe Handbuch" 0x26CFCC istgang_egs_in SBYTE_X_INCR_DIRECT_M_S7_S3 0 void_int_M_S7_S3 8 -128 127 /end AXIS_PTS
/begin AXIS_PTS KL_MGK0MODMAXMAX_SYN_ZUS_X "Maximaler Gradienten des Maximalwerts des modifizierten K0-Moments der HAS in Abhaengigkeit des Gradienten des K0 Sollmoments im Zustand K0-Synchronisieren beim Zustart" 0x26C7F4 mg_soll_k0_syn_zus FLOAT32_IEEE_X_INCR_DIRECT_M_S7_S3 0 trqg_fl_k_M_S7_S3 6 -3.40282E+038 3.40282E+038 /end AXIS_PTS
/begin AXIS_PTS KL_MGSOLLK0SUS_SYN_ZUS_X "Gradienten zur Anhebung des K0-Sollmoments der Funktion zur Synchronisationsunterstuetzung (SUS) in Anhaengigkeit des VM-Zielmoments im Zustand K0-Synchronisieren beim Zustart" 0x26C854 m_ziel_vm_has_zus FLOAT32_IEEE_X_INCR_DIRECT_M_S7_S3 0 trq_fl_a_M_S7_S3 8 -3.40282E+038 3.40282E+038 /end AXIS_PTS
/begin AXIS_PTS KL_MK0MODFUW_ANH_ZUS_X "Modifiziertes K0-Moment der HAS bei erkannter EM-Fehlfunktion durch die FUW in Abhaengigkeit des K0 Istmoments im Zustand VM-Drehzahlanhebung beim Zustart" 0x26C894 m_k0_in FLOAT32_IEEE_X_INCR_DIRECT_M_S7_S3 0 trq_fl_a_M_S7_S3 6 -3.40282E+038 3.40282E+038 /end AXIS_PTS
/begin AXIS_PTS KL_MK0MODK0BEF_ZUS_X "Modifiziertes K0-Moment der HAS in Abhaengigkeit des K0 Istmoments in den Zustaenden der K0-Befuellung ZST, SAK, ANH, ABF beim Zustart" 0x26C8C4 m_k0_in FLOAT32_IEEE_X_INCR_DIRECT_M_S7_S3 0 trq_fl_a_M_S7_S3 6 -3.40282E+038 3.40282E+038 /end AXIS_PTS
/begin AXIS_PTS KL_MK0MODKALTNEM_ANH_ZUS_X "Modifiziertes K0-Moment der HAS beim Kaltstart mit abgesenkter EM-Drehzahl in Abhaengigkeit des K0 Istmoments im Zustand VM-Drehzahlanhebung beim Zustart" 0x26C8F4 m_k0_in FLOAT32_IEEE_X_INCR_DIRECT_M_S7_S3 0 trq_fl_a_M_S7_S3 6 -3.40282E+038 3.40282E+038 /end AXIS_PTS
/begin AXIS_PTS KL_MK0MODUVS_ZST_ZUS_X "Modifiziertes K0-Moment der HAS bei Anforderung einer K0-Unterstuetzung des VM Startsystems durch die HAS Zustandssteuerung (OML) in Abhaengigkeit des K0 Istmoments im Zustand Zustart beim VM Zustart" 0x26C924 m_k0_in FLOAT32_IEEE_X_INCR_DIRECT_M_S7_S3 0 trq_fl_a_M_S7_S3 6 -3.40282E+038 3.40282E+038 /end AXIS_PTS
/begin AXIS_PTS KL_MK0ZIEL_ABF_ZUS_X "Zielwert des K0-Moments zum Abfangen des VM bei einem Abbruch VM Abstellen im Zustand VM Abfangen beim Zustart in Abhaengigkeit des VM Minimalmoments" 0x26C954 m_min_vm_in FLOAT32_IEEE_X_INCR_DIRECT_M_S7_S3 0 trq_fl_a_M_S7_S3 6 -3.40282E+038 3.40282E+038 /end AXIS_PTS
/begin AXIS_PTS KL_MOZIELK0ZMANH_SYN_ZUS_X "Festlegung des K0-Drehmomentoffsets  zur Bestimmung des K0-Zielmoments der Zusatzdrehmomentanhebung im Zustand K0 Synchronisieren beim Zustart in Abhaengigkeit  des VM-Zielmoments" 0x26C9A4 m_ziel_vm_has_zus FLOAT32_IEEE_X_INCR_DIRECT_M_S7_S3 0 trq_fl_a_M_S7_S3 8 -3.40282E+038 3.40282E+038 /end AXIS_PTS
/begin AXIS_PTS KL_MOZIELK0ZMANHMAX_SYN_ZUS_X "Festlegung des Maximalwerts der K0-Drehmomentoffsets  der Zusatzdrehmomentanhebung im Zustand K0 Synchronisieren beim Zustart in Abhaengigkeit  der maximal moeglichen EM-Drehmomentabsenkung" 0x26C984 NO_INPUT_QUANTITY FLOAT32_IEEE_X_INCR_DIRECT_M_S7_S3 0 trq_fl_a_M_S7_S3 4 -3.40282E+038 3.40282E+038 /end AXIS_PTS
/begin AXIS_PTS KL_MSOLLK0EMANK_FUW_ZUS_X "K0 Sollmoment zur Ankoppelung der EM an den VM bei EM-Fehlfunktion der Funktionsueberwachung der EM-Funktion beim Zustart in Abhaengigkeit der Getriebeoeltemperatur" 0x26C9E4 c_getriebe_egs_in FLOAT32_IEEE_X_INCR_DIRECT_M_S7_S3 0 trq_fl_a_M_S7_S3 8 -3.40282E+038 3.40282E+038 /end AXIS_PTS
/begin AXIS_PTS KL_MSOLLK0KALTNEM_ANH_ZUS_X "K0 Sollmoment zur Ankoppelung der EM an den VM beim Kaltstart mit abgesenkter EM Drehzahl in Abhaengigkeit der Getriebeoeltemperatur im Zustand Drehzahlanhebung beim VM Zustart" 0x26CA24 c_getriebe_egs_in FLOAT32_IEEE_X_INCR_DIRECT_M_S7_S3 0 trq_fl_a_M_S7_S3 8 -3.40282E+038 3.40282E+038 /end AXIS_PTS
/begin AXIS_PTS KL_MSOLLK0MIN_SYN_ZUS_X "Minimalwert zur Initialisierung des K0-Sollmoments in Anhaengigkeit des VM-Zielmoments im Zustand K0 Synchronisieren beim Zustart" 0x26CA9C m_ziel_vm_has_zus FLOAT32_IEEE_X_INCR_DIRECT_M_S7_S3 0 trq_fl_a_M_S7_S3 5 0 1000 /end AXIS_PTS
/begin AXIS_PTS KL_MVMVOLLASTSAUG_SYN_ZUS_X "Maximales Saug-Vollastmoment des VM zur Begrenzung des K0-Sollmoments im Zustand K0 Synchronisieren beim Zustart in Abhaengigkeit der VM Drehzahl" 0x26CB54 n_vm_in FLOAT32_IEEE_X_INCR_DIRECT_M_S7_S3 0 n_fl_M_S7_S3 10 -3.40282E+038 3.40282E+038 /end AXIS_PTS
/begin AXIS_PTS KL_MZIELK0MIN_K0ZUHEISS_SYN_ZUS_X "Festlegung des minimalen K0-Zielmoments zur Bestimmung des K0 Sollmoments bei zu heisser K0 im Zustand K0-Synchronisieren beim Zustart in Abhaengigkeit des VM-Zielmoments" 0x26CBA4 m_ziel_vm_has_zus FLOAT32_IEEE_X_INCR_DIRECT_M_S7_S3 0 trq_fl_a_M_S7_S3 8 -3.40282E+038 3.40282E+038 /end AXIS_PTS
/begin AXIS_PTS KL_MZIELK0MIN_SYN_ZUS_X "Festlegung des minimalen K0-Zielmoments zur Bestimmung des K0 Sollmoments im Zustand K0 Synchronisieren beim Zustart in Abhaengigkeit  des VM-Zielmoments" 0x26CC34 m_ziel_vm_has_zus FLOAT32_IEEE_X_INCR_DIRECT_M_S7_S3 0 trq_fl_a_M_S7_S3 8 -3.40282E+038 3.40282E+038 /end AXIS_PTS
/begin AXIS_PTS KL_MZIELK0MIN_SYNCDDA_SYN_ZUS_X "Festlegung des minimalen K0-Zielmoments zur Bestimmung des K0 Sollmoments bei durchdrehenden Antriebsraedern im Zustand K0-Synchronisieren beim Zustart in Abhaengigkeit der Differenz zwischen dem Fahrerwunschmoment und dem minimal moeglichen EM-Moment" 0x26CBE4 NO_INPUT_QUANTITY FLOAT32_IEEE_X_INCR_DIRECT_M_S7_S3 0 trq_fl_a_M_S7_S3 5 -3.40282E+038 3.40282E+038 /end AXIS_PTS
/begin AXIS_PTS KL_MZIELK0MIN_SYNCSZA_SYN_ZUS_X "Festlegung des minimalen K0-Zielmoments zur Bestimmung des K0 Sollmoments bei aktiver Ablaufvariante Schneller Zustartablauf (SZA) im K0-Synchronisieren beim Zustart in Abhaengigkeit der Differenz zwischen Fahrerwunsch- und minimal moeglichem EM-Moment" 0x26CC0C NO_INPUT_QUANTITY FLOAT32_IEEE_X_INCR_DIRECT_M_S7_S3 0 trq_fl_a_M_S7_S3 5 -3.40282E+038 3.40282E+038 /end AXIS_PTS
/begin AXIS_PTS KL_NDSK0K0SREG_SYN_ZUS_X "K0-Differenzdrehzahlschwelle zur Bestimmung des Zeitpunkts der Anforderung der Aktivierung der K0-Schlupfregelung in Abhaengigkeit des K0 Sollmoments im Zustand K0 Synchronisieren beim Zustart" 0x26CCC4 NO_INPUT_QUANTITY FLOAT32_IEEE_X_INCR_DIRECT_M_S7_S3 0 trq_fl_a_M_S7_S3 5 -3.40282E+038 3.40282E+038 /end AXIS_PTS
/begin AXIS_PTS KL_NDSK0SYNCERK_SYN_ZUS_X "Schwellwert zur Erkennung Synchron beim VM-Zustart in Abhaengigkeit des EM-Drehzahlgradienten " 0x26CD3C ng_em_zus FLOAT32_IEEE_X_INCR_DIRECT_M_S7_S3 0 ng_fl_M_S7_S3 5 -3.40282E+038 3.40282E+038 /end AXIS_PTS
/begin AXIS_PTS KL_NDZIELK0K0SREG_SYN_ZUS_X "K0-Zieldifferenzdrehzahl zur Bestimmung der VM-Solldrehzahl bei der Aktivierung der K0-Schlupfregelung in Abhaengigkeit des K0 Sollmoments im Zustand K0 Synchronisieren beim Zustart" 0x26CD64 NO_INPUT_QUANTITY FLOAT32_IEEE_X_INCR_DIRECT_M_S7_S3 0 trq_fl_a_M_S7_S3 5 -3.40282E+038 3.40282E+038 /end AXIS_PTS
/begin AXIS_PTS KL_NSEMK0BEFVERZ_SAK_ZUS_X "EM-Drehzahlschwelle zur Verzoegerung der K0-Befuellung in Abhaengigkeit der Getriebeoeltemperatur im Zustand Schaltung aktiv beim Zustart" 0x26CD8C c_getriebe_egs_in FLOAT32_IEEE_X_INCR_DIRECT_M_S7_S3 0 c_fl_M_S7_S3 6 -3.40282E+038 3.40282E+038 /end AXIS_PTS
/begin AXIS_PTS KL_SCHALTARTK0BEFVERZ_SAK_ZUS_X "Festlegung der Schaltart der Schaltungen die zu einer Verzoegerung der K0-Befuellung im fuehren in Abhaengigkeit des Istgangs im Zustand Schaltung aktiv beim Zustart -> Bit-Codierung wie z_ablauf_shv_reset_has" 0x26D01C istgang_egs_in SBYTE_X_INCR_DIRECT_M_S7_S3 0 void_int_M_S7_S3 8 -1 8 /end AXIS_PTS
/begin AXIS_PTS KL_TK0SYNCERKUMS_SYN_ZUS_X "Zeit bis zur Umschaltung der Differenzdrehzahlschwelle zur Erkennung Synchron beim VM-Zustart in Abhaengigkeit des VM-Zielmoments" 0x26CE94 m_ziel_vm_has_zus FLOAT32_IEEE_X_INCR_DIRECT_M_S7_S3 0 trq_fl_a_M_S7_S3 5 -3.40282E+038 3.40282E+038 /end AXIS_PTS
/begin MEASUREMENT abstellpos_vm_in "Abstellposition VM vor naechstem ZOT" UWORD void_int_c_M_S7_S3 1 100 0 360 ECU_ADDRESS 0xFFF86784 /end MEASUREMENT
/begin MEASUREMENT c_getriebe_egs_in "" FLOAT32_IEEE c_int_M_S7_S3 1 100 -40 215 ECU_ADDRESS 0xFFF86214 /end MEASUREMENT
/begin MEASUREMENT gangwechsel_egs_in "Flag waehrend laufender Schaltung, bei synchron verlassen bis synchron erreicht" UBYTE void_int_M_S7_S3 1 100 0 1 ECU_ADDRESS 0xFFF86C9F /end MEASUREMENT
/begin MEASUREMENT i_zielgang_egs "Uebersetzung des Zielgangs" FLOAT32_IEEE ratio_fl_M_S7_S3 1 100 0 8 ECU_ADDRESS 0xFFF861B8 /end MEASUREMENT
/begin MEASUREMENT istgang_egs_in "" SBYTE void_int_M_S7_S3 1 100 -128 127 ECU_ADDRESS 0xFFF86CA0 /end MEASUREMENT
/begin MEASUREMENT k_mstoerk0em_zus "Faktor zur Modifikation des K0-Stoermoments zur Bestimmung des EM-Vorsteuermoments beim Zustart" FLOAT32_IEEE void_fl_M_S7_S3 1 100 0 2 ECU_ADDRESS 0xFFF86084 /end MEASUREMENT
/begin MEASUREMENT kolbenpos_k0_in "" FLOAT32_IEEE sts_fl_M_S7_S3 1 100 -3.40282E+038 3.40282E+038 ECU_ADDRESS 0xFFF8621C /end MEASUREMENT
/begin MEASUREMENT m_em_in "" FLOAT32_IEEE trq_fl_a_M_S7_S3 1 100 -1024 1024 ECU_ADDRESS 0xFFF86220 /end MEASUREMENT
/begin MEASUREMENT m_k0_in "" FLOAT32_IEEE trq_fl_a_M_S7_S3 1 100 -32768 32767 ECU_ADDRESS 0xFFF86228 /end MEASUREMENT
/begin MEASUREMENT m_k0_mod_has_fkt "" FLOAT32_IEEE trq_fl_a_M_S7_S3 1 100 -1200 1200 ECU_ADDRESS 0xFFF86184 /end MEASUREMENT
/begin MEASUREMENT m_k0_mod_max_syn_zus "Maximalwert des modifizierten K0-Istmoments der HAS beim K0 Synchronisieren beim Zustart" FLOAT32_IEEE trq_fl_a_M_S7_S3 1 100 -1000 1000 ECU_ADDRESS 0xFFF86088 /end MEASUREMENT
/begin MEASUREMENT m_max_dyn_em_in "" FLOAT32_IEEE trq_fl_a_M_S7_S3 1 100 -3.40282E+038 3.40282E+038 ECU_ADDRESS 0xFFF8622C /end MEASUREMENT
/begin MEASUREMENT m_max_em_has_fkt "" FLOAT32_IEEE trq_fl_a_M_S7_S3 1 100 -1200 1200 ECU_ADDRESS 0xFFF86188 /end MEASUREMENT
/begin MEASUREMENT m_max_iae_has_fkt "" FLOAT32_IEEE trq_fl_a_M_S7_S3 1 100 -1200 1200 ECU_ADDRESS 0xFFF8618C /end MEASUREMENT
/begin MEASUREMENT m_min_dyn_em_in "" FLOAT32_IEEE trq_fl_a_M_S7_S3 1 100 -3.40282E+038 3.40282E+038 ECU_ADDRESS 0xFFF86230 /end MEASUREMENT
/begin MEASUREMENT m_min_em_has_fkt "" FLOAT32_IEEE trq_fl_a_M_S7_S3 1 100 -1200 1200 ECU_ADDRESS 0xFFF86190 /end MEASUREMENT
/begin MEASUREMENT m_min_vm_in "" FLOAT32_IEEE trq_fl_a_M_S7_S3 1 100 -3.40282E+038 3.40282E+038 ECU_ADDRESS 0xFFF8628C /end MEASUREMENT
/begin MEASUREMENT m_soll_em_has_fkt "" FLOAT32_IEEE trq_fl_a_M_S7_S3 1 100 -1200 1200 ECU_ADDRESS 0xFFF86194 /end MEASUREMENT
/begin MEASUREMENT m_soll_k0_has_fkt "" FLOAT32_IEEE trq_fl_a_M_S7_S3 1 100 -1200 1200 ECU_ADDRESS 0xFFF86198 /end MEASUREMENT
/begin MEASUREMENT m_soll_k0_min_uvs_zus "Minimalwert des K0 Sollmoment bei Anforderung einer K0-Unterstuetzung des VM Startsystems durch die HAS Zustandssteuerung (OML) beim VM Zustart" FLOAT32_IEEE trq_fl_a_M_S7_S3 1 100 -1000 1000 ECU_ADDRESS 0xFFF8608C /end MEASUREMENT
/begin MEASUREMENT m_soll_res_em_has_fkt "" FLOAT32_IEEE trq_fl_a_M_S7_S3 1 100 -1200 1200 ECU_ADDRESS 0xFFF8619C /end MEASUREMENT
/begin MEASUREMENT m_soll_vm_hst_in "" FLOAT32_IEEE trq_fl_a_M_S7_S3 1 100 -32768 32767 ECU_ADDRESS 0xFFF8623C /end MEASUREMENT
/begin MEASUREMENT m_soll_vm_l_hst_in "" FLOAT32_IEEE trq_fl_a_M_S7_S3 1 100 -3.40282E+038 3.40282E+038 ECU_ADDRESS 0xFFF86290 /end MEASUREMENT
/begin MEASUREMENT m_stoerk0em_fil_zus "Gefiltertes K0-Stoermoment zur Bestimmung des EM-Vorsteuermoments beim Zustart" FLOAT32_IEEE trq_fl_a_M_S7_S3 1 100 -1000 1000 ECU_ADDRESS 0xFFF86090 /end MEASUREMENT
/begin MEASUREMENT m_stoerk0em_zus "Ungefiltertes K0-Stoermoments zur Bestimmung des EM-Vorsteuermoments beim Zustart" FLOAT32_IEEE trq_fl_a_M_S7_S3 1 100 -1000 1000 ECU_ADDRESS 0xFFF86094 /end MEASUREMENT
/begin MEASUREMENT m_vm_in "" FLOAT32_IEEE trq_fl_a_M_S7_S3 1 100 -1024 1023.5 ECU_ADDRESS 0xFFF86240 /end MEASUREMENT
/begin MEASUREMENT m_vm_start_in "" FLOAT32_IEEE trq_fl_a_M_S7_S3 1 100 -1024 1023.5 ECU_ADDRESS 0xFFF86244 /end MEASUREMENT
/begin MEASUREMENT m_wunsch_fpw_hst_in "" FLOAT32_IEEE trq_fl_a_M_S7_S3 1 100 -3.40282E+038 3.40282E+038 ECU_ADDRESS 0xFFF86294 /end MEASUREMENT
/begin MEASUREMENT m_wunsch_fpw_in "" FLOAT32_IEEE trq_fl_a_M_S7_S3 1 100 -32768 32767 ECU_ADDRESS 0xFFF86248 /end MEASUREMENT
/begin MEASUREMENT m_ziel_k0_hst_in "Target torque of K0 sent by ECU" FLOAT32_IEEE trq_fl_a_M_S7_S3 1 100 -1000 2000 ECU_ADDRESS 0xFFF8624C /end MEASUREMENT
/begin MEASUREMENT m_ziel_k0_min_syn_zus "Minimalwert des  Zielmoment der Trennkupplung K0 zur Realisierung des Fahrerwunschmoments beim K0 Synchronisieren beim Zustart" FLOAT32_IEEE trq_fl_a_M_S7_S3 1 100 -1000 1000 ECU_ADDRESS 0xFFF86098 /end MEASUREMENT
/begin MEASUREMENT m_ziel_k0_min_syn_zus__int "Integer Messstelle von m_ziel_k0_min_syn_zus" SWORD trq_int_M_S7_S3 1 100 -1000 1000 ECU_ADDRESS 0xFFF866F0 /end MEASUREMENT
/begin MEASUREMENT m_ziel_k0_zus "Zielmoment der Trennkupplung K0 beim Zustart" FLOAT32_IEEE trq_fl_a_M_S7_S3 1 100 -1000 1000 ECU_ADDRESS 0xFFF8609C /end MEASUREMENT
/begin MEASUREMENT m_ziel_vm_has_zus "Zielmoment des VM bei Zustart" FLOAT32_IEEE trq_fl_a_M_S7_S3 1 100 -1000 1000 ECU_ADDRESS 0xFFF860A0 /end MEASUREMENT
/begin MEASUREMENT mg_soll_k0_has_fkt "" FLOAT32_IEEE trqg_fl_k_M_S7_S3 1 100 -3000 3000 ECU_ADDRESS 0xFFF861A0 /end MEASUREMENT
/begin MEASUREMENT mg_soll_k0_syn_zus "Gradient des K0-Soll-Moments im K0 Synchronisieren beim Zustart" FLOAT32_IEEE trqg_fl_k_M_S7_S3 1 100 0 50000 ECU_ADDRESS 0xFFF860AC /end MEASUREMENT
/begin MEASUREMENT mg_wunsch_fpw_hst_in "Gradient des gefilterten oder koordinierten Fahrerwunschmoments aus Fahrpedalinterpretation" FLOAT32_IEEE trqg_fl_k_M_S7_S3 1 100 -2000 2000 ECU_ADDRESS 0xFFF861C4 /end MEASUREMENT
/begin MEASUREMENT mo_k0befuell_zus "Momentoffset aus der K0-Erfuellung" FLOAT32_IEEE trq_fl_a_M_S7_S3 1 100 -1000 1000 ECU_ADDRESS 0xFFF860B0 /end MEASUREMENT
/begin MEASUREMENT mo_ziel_k0_zmanh_syn_zus "Offset auf das VM-Zielmoment zur Bestimmung des K0-Zielmoments der Zusatzdrehmomentanhebung (ZMANH) beim K0 Synchronisieren beim Zustart" FLOAT32_IEEE trq_fl_a_M_S7_S3 1 100 -1000 1000 ECU_ADDRESS 0xFFF860B4 /end MEASUREMENT
/begin MEASUREMENT modus_e_fahren_zus "Anzeige des E-Fahr-Modus des Hybridsystems beim Zustart" UBYTE E_MODUSEFAH_M_S7_S3 1 100 0 1 ECU_ADDRESS 0xFFF86B68 /end MEASUREMENT
/begin MEASUREMENT n_ab_egs_in "" FLOAT32_IEEE n_fl_M_S7_S3 1 100 0 65535 ECU_ADDRESS 0xFFF86250 /end MEASUREMENT
/begin MEASUREMENT n_em_in "" FLOAT32_IEEE n_fl_M_S7_S3 1 100 -3.40282E+038 3.40282E+038 ECU_ADDRESS 0xFFF86254 /end MEASUREMENT
/begin MEASUREMENT n_em_mod_syn_zus "Wirksame DifferenzdrehModifizierte EM-Drehzahl als Basisdrehzahl zur Bestimmung der VM Solldrehzahl bei RS beim K0 Synchronisieren beim Zustartzahlschwelle zur Erkennung Synchron beim VM-Zustart" FLOAT32_IEEE n_fl_M_S7_S3 1 100 0 10000 ECU_ADDRESS 0xFFF860B8 /end MEASUREMENT
/begin MEASUREMENT n_em_ref_syn_zus "EM Referenzdrehzahl zur Bestimmung der modifizierten EM-Drehzahl als Basisdrehzahl zur Bestimmung der VM Solldrehzahl bei RS beim K0 Synchronisieren beim Zustart" FLOAT32_IEEE n_fl_M_S7_S3 1 100 0 10000 ECU_ADDRESS 0xFFF860BC /end MEASUREMENT
/begin MEASUREMENT n_sec_iae_ist_zus "Abtriebsseitige IAE-Drehzahl bezogen auf den Getriebeeeingang und den aktuellen  Istgang waehrend einer Schaltung beim Zustart" FLOAT32_IEEE n_fl_M_S7_S3 1 100 0 10000 ECU_ADDRESS 0xFFF860C0 /end MEASUREMENT
/begin MEASUREMENT n_sec_iae_ziel_zus "Abtriebsseitige IAE Zieldrehzahl bezogen auf den Getriebeeingang waehrend einer Schaltung beim Zustart" FLOAT32_IEEE n_fl_M_S7_S3 1 100 0 10000 ECU_ADDRESS 0xFFF860C4 /end MEASUREMENT
/begin MEASUREMENT n_soll_em_has_fkt "" FLOAT32_IEEE n_fl_M_S7_S3 1 100 0 8000 ECU_ADDRESS 0xFFF861A4 /end MEASUREMENT
/begin MEASUREMENT n_soll_em_hst_in "" FLOAT32_IEEE n_fl_M_S7_S3 1 100 -3.40282E+038 3.40282E+038 ECU_ADDRESS 0xFFF86298 /end MEASUREMENT
/begin MEASUREMENT n_soll_ll_vm_in "" FLOAT32_IEEE n_fl_M_S7_S3 1 100 0 2540 ECU_ADDRESS 0xFFF8625C /end MEASUREMENT
/begin MEASUREMENT n_soll_vm_has_fkt "" FLOAT32_IEEE n_fl_M_S7_S3 1 100 0 8000 ECU_ADDRESS 0xFFF861A8 /end MEASUREMENT
/begin MEASUREMENT n_vm_in "" FLOAT32_IEEE n_fl_M_S7_S3 1 100 0 65535 ECU_ADDRESS 0xFFF86264 /end MEASUREMENT
/begin MEASUREMENT nd_k0_in "Differenzdrehzahl der Trennkupplung" FLOAT32_IEEE n_fl_M_S7_S3 1 100 -10000 10000 ECU_ADDRESS 0xFFF861D4 /end MEASUREMENT
/begin MEASUREMENT nd_min_saf_has_fkt "Anforderung min. Drehzahlsprung an ASIS" FLOAT32_IEEE n_fl_M_S7_S3 1 100 0 8000 ECU_ADDRESS 0xFFF861AC /end MEASUREMENT
/begin MEASUREMENT nd_sec_iae_syn_zus "Abtriebsseitiger IAE-Drehzahlsprung bezogen auf den Getriebeeeingang waehrend einer Schaltung im Zustand K0 Synchronisieren beim Zustart" FLOAT32_IEEE n_fl_M_S7_S3 1 100 -10000 10000 ECU_ADDRESS 0xFFF860C8 /end MEASUREMENT
/begin MEASUREMENT nd_soll_iae_fkt "Differenzdrehzahl der Anfahrkupplung" FLOAT32_IEEE ng_fl_M_S7_S3 1 100 -8000 8000 ECU_ADDRESS 0xFFF861B0 /end MEASUREMENT
/begin MEASUREMENT ndg_k0_in "Gradienten der Differenzdrehzahl der Trennkupplung" FLOAT32_IEEE ng_fl_M_S7_S3 1 100 -10000 10000 ECU_ADDRESS 0xFFF861D8 /end MEASUREMENT
/begin MEASUREMENT nds_k0syncerk_syn_zus "Wirksame Differenzdrehzahlschwelle zur Erkennung Synchron beim VM-Zustart" FLOAT32_IEEE n_fl_M_S7_S3 1 100 0 10000 ECU_ADDRESS 0xFFF860CC /end MEASUREMENT
/begin MEASUREMENT ng_em_zus "EM-Drehzahlgradient beim Zustart" FLOAT32_IEEE ng_fl_M_S7_S3 1 100 -10000 10000 ECU_ADDRESS 0xFFF860D0 /end MEASUREMENT
/begin MEASUREMENT ng_emmodrsmax_syn_zus "Maximaler Gradient der modifizierten EM-Drehzahl als Basisdrehzahl zur Bestimmung der VM Solldrehzahl bei RS beim K0 Synchronisieren beim Zustart" FLOAT32_IEEE ng_fl_M_S7_S3 1 100 -50000 50000 ECU_ADDRESS 0xFFF860D4 /end MEASUREMENT
/begin MEASUREMENT ng_vm_in "Gradient der VM Drehzahl" FLOAT32_IEEE ng_fl_M_S7_S3 1 100 -10000 10000 ECU_ADDRESS 0xFFF861DC /end MEASUREMENT
/begin MEASUREMENT pos_egs_in "Waehlhebelposition" UBYTE E_POS_M_S7_S3 1 100 0 8 ECU_ADDRESS 0xFFF86CA2 /end MEASUREMENT
/begin MEASUREMENT sollgang_egs_in "" SBYTE void_int_M_S7_S3 1 100 -128 127 ECU_ADDRESS 0xFFF86CA3 /end MEASUREMENT
/begin MEASUREMENT st_ablauf_fkt "Phase des Ablauf" UWORD st_int_g_M_S7_S3 1 100 0 65535 ECU_ADDRESS 0xFFF86774 /end MEASUREMENT
/begin MEASUREMENT status_ablauf_has_fkt "" UBYTE sts_int_M_S7_S3 1 100 0 50 ECU_ADDRESS 0xFFF86C5A /end MEASUREMENT
/begin MEASUREMENT status_iae_in "" UBYTE E_STATUSIAE_M_S7_S3 1 100 0 8 ECU_ADDRESS 0xFFF86CAA /end MEASUREMENT
/begin MEASUREMENT status_k0_befuellung_in "Interface provides the current filling mode of clutch 0" UBYTE E_STAK0BEF_M_S7_S3 1 100 0 3 ECU_ADDRESS 0xFFF86CAE /end MEASUREMENT
/begin MEASUREMENT status_k0_in "" UBYTE E_STATUSK0_M_S7_S3 1 100 0 5 ECU_ADDRESS 0xFFF86CAF /end MEASUREMENT
/begin MEASUREMENT status_kraftfluss_egs_in "" UBYTE E_STATUSKSL_M_S7_S3 1 100 0 6 ECU_ADDRESS 0xFFF86CB0 /end MEASUREMENT
/begin MEASUREMENT status_nem_in "Status zur Drehzahl E-Motor" UBYTE E_SIGSTATUS_M_S7_S3 1 100 0 2 ECU_ADDRESS 0xFFF86CB3 /end MEASUREMENT
/begin MEASUREMENT status_nreg_em_hst_in "" UBYTE sts_int_M_S7_S3 1 100 0 255 ECU_ADDRESS 0xFFF86CCE /end MEASUREMENT
/begin MEASUREMENT status_psys_has_sbe "Anzeige des Status Pumpendruck der HAS" UBYTE E_STATUSPSY_M_S7_S3 1 100 0 4 ECU_ADDRESS 0xFFF86C6C /end MEASUREMENT
/begin MEASUREMENT status_radschlupf_rse_has_sbe "Anzeige des Status der Radschlupferkennung (RSE) der HAS" UBYTE E_STATUSRSE_M_S7_S3 1 100 0 1 ECU_ADDRESS 0xFFF86C6D /end MEASUREMENT
/begin MEASUREMENT status_schaltart_svh_has_sbe "Schaltart der angeforderten Schaltung der Schaltverhinderung der HAS (0 = keine Schaltung angefordert) - Bit-Codierung (m/oL = mit/ohne Lastanh.) =  bit0=ZRSmL, 1=ZHSmL, 2=SRSmL, 3=SHSmL, 4=ZRSoL, 5=ZHSoL, 6=SRSoL, 7=SHSoL" UBYTE sts_int_M_S7_S3 1 100 0 255 ECU_ADDRESS 0xFFF86C6E /end MEASUREMENT
/begin MEASUREMENT status_schaltung_egs_in "Anzeige ob Schaltung des Getriebes aktiv ist" SBYTE sts_int_M_S7_S3 1 100 -9 9 ECU_ADDRESS 0xFFF86C6F /end MEASUREMENT
/begin MEASUREMENT status_sync_schaltung_sbe "Anzeige der Synchronerkennung der aktuellen Schaltung innerhalb der HAS" UBYTE sts_int_M_S7_S3 1 100 0 1 ECU_ADDRESS 0xFFF86C70 /end MEASUREMENT
/begin MEASUREMENT t_k0bef_kaltnem_zst_zus "Timer zur Sicherstellung der oelversorgung zur Befuellung der K0 bei einem Kaltstart-Ablauf mit abgesenkter EM-Drehzahl im Zustand Zustarten beim Zustart" UWORD t_int_n_M_S7_S3 1 100 0 5 ECU_ADDRESS 0xFFF866FE /end MEASUREMENT
/begin MEASUREMENT t_k0bef_verz_zst_zus "Timer zur Verzoegerung der K0 Befuellung in Erwartung einer Schaltanforderung die zu einem Ruecksprung in dem Zustand Schaltung aktiv fuehrt im Zustand Zustarten beim Zustart" UWORD t_int_n_M_S7_S3 1 100 0 1 ECU_ADDRESS 0xFFF86700 /end MEASUREMENT
/begin MEASUREMENT t_k0sregaktiv_syn_zus "Timer der Verzoegerungszeit zur Aktivierung der K0-Schlupfregelung nach Eintritt in den Zustand K0 Synchronisieren beim Zustart" UWORD t_int_n_M_S7_S3 1 100 0 5 ECU_ADDRESS 0xFFF86702 /end MEASUREMENT
/begin MEASUREMENT t_k0sregbasis_syn_zus "Timer der Maximalzeit zum Setzen der Basisbedingung zur Aktivierung der K0-Schlupfregelung im Zustand K0 Synchronisieren beim Zustartart" UWORD t_int_n_M_S7_S3 1 100 0 10 ECU_ADDRESS 0xFFF86704 /end MEASUREMENT
/begin MEASUREMENT t_k0syncerk_syn_zus "Timer zur Initialisierung der VM Solldrehzahlberechnung beim K0 Synchronisieren beim Zustart" UWORD t_int_n_M_S7_S3 1 100 0 5 ECU_ADDRESS 0xFFF86706 /end MEASUREMENT
/begin MEASUREMENT t_k0syncerkums_syn_zus "Timer fuer die Umschaltung der Differenzdrehzahlschwelle zur Erkennung Synchron bei VM-Zustart" UWORD t_int_n_M_S7_S3 1 100 0 10 ECU_ADDRESS 0xFFF86708 /end MEASUREMENT
/begin MEASUREMENT t_k0zunemfehlerbed_fuw_zus "Timer zur Abschaetzung 'K0 zu' bei fehlerhafter EM-Drehzahl der Funktionsueberwachung der EM-Funktion beim Zustart" UWORD t_int_n_M_S7_S3 1 100 0 5 ECU_ADDRESS 0xFFF8670A /end MEASUREMENT
/begin MEASUREMENT t_maxbed_abb_zus "Timer zur ueberwachung der maximalen Verweildauer im Zustand zustart_abbruch_zus im Zustart" UWORD t_int_n_M_S7_S3 1 100 0 10 ECU_ADDRESS 0xFFF86710 /end MEASUREMENT
/begin MEASUREMENT t_maxbed_sak_zus "Timer zur ueberwachung der maximalen Verweildauer im Zustand Schaltung aktiv beim Zustart" UWORD t_int_n_M_S7_S3 1 100 0 10 ECU_ADDRESS 0xFFF86712 /end MEASUREMENT
/begin MEASUREMENT t_ndgk0k0sreg_syn_zus "Timer der Mindestdauer bei der Abfrage des K0-Differenzdrehzahlgradienten zur Bestimmung des Zeitpunkt der Anforderung der Aktivierung der K0-Schlupfregelung im Zustand K0 Synchronisieren beim Zustart" UWORD t_int_n_M_S7_S3 1 100 0 5 ECU_ADDRESS 0xFFF8671A /end MEASUREMENT
/begin MEASUREMENT t_vmstatus_abf_zus "Timer der Maximalzeit der Beruecksichtigung der Anzeige VM selbstlauffaehig als Uebergangsbedingung nach K0- Synchronisieren im Zustand VM-Abfangen beim Zustart" UWORD t_int_n_M_S7_S3 1 100 0 5 ECU_ADDRESS 0xFFF8671C /end MEASUREMENT
/begin MEASUREMENT t_vmstatus_anh_zus "Timer der Maximalzeit der Beruecksichtigung der Anzeige VM selbstlauffaehig als Uebergangsbedingung nach K0- Synchronisieren im Zustand VM-Drehzahlanhebung beim Zustart" UWORD t_int_n_M_S7_S3 1 100 0 5 ECU_ADDRESS 0xFFF8671E /end MEASUREMENT
/begin MEASUREMENT z_ablauf_has_hst_in "" UBYTE sts_int_M_S7_S3 1 100 0 15 ECU_ADDRESS 0xFFF86CB8 /end MEASUREMENT
/begin MEASUREMENT z_ablauf_has_stg "Zusaetzliche Steuergroesse zur Ablaufsteuerung" UBYTE ctrl_int_M_S7_S3 1 100 0 15 ECU_ADDRESS 0xFFF86C57 /end MEASUREMENT
/begin MEASUREMENT z_ablauf_svh_reset_has_fkt "" UBYTE sts_int_M_S7_S3 1 100 0 255 ECU_ADDRESS 0xFFF86C5B /end MEASUREMENT
/begin MEASUREMENT z_ablaufreinit_frk_dihi "Zeigt an, dass der aktuelle HAS-Ablauf erneut begonnen werden soll" UBYTE sts_int_e_M_S7_S3 1 100 0 1 ECU_ADDRESS 0xFFF86C40 /end MEASUREMENT
/begin MEASUREMENT z_ablaufvariante_has_stg "Ablaufvariante, die  die OML ausgibt" UBYTE sts_int_M_S7_S3 1 100 0 99 ECU_ADDRESS 0xFFF86C58 /end MEASUREMENT
/begin MEASUREMENT z_ablaufvariante_kalt_zus "Anzeige der aktiven Ablaufvariante Kaltstart beim Zustart - 0 = kein Kaltstart, 1 = Kaltstart mit abgesenkter EM-Drehzahl" UBYTE st_int_M_S7_S3 1 100 0 255 ECU_ADDRESS 0xFFF86C5C /end MEASUREMENT
/begin MEASUREMENT z_ablaufvariante_sza_zus "Anzeige der aktiven Ablaufvariante Schneller Zustartablauf (SZA) beim Zustart" UBYTE sts_int_e_M_S7_S3 1 100 0 1 ECU_ADDRESS 0xFFF86B69 /end MEASUREMENT
/begin MEASUREMENT z_ala_frk_dihi "Zeigt an, dass die Anlasserstartanforderung der HAS aktiviert werden soll" UBYTE sts_int_e_M_S7_S3 1 100 0 1 ECU_ADDRESS 0xFFF86C41 /end MEASUREMENT
/begin MEASUREMENT z_deaktiv_abo_frk_dihi "Zeigt an, dass die ABO Funktion verlassen werden soll." UBYTE sts_int_e_M_S7_S3 1 100 0 1 ECU_ADDRESS 0xFFF86C42 /end MEASUREMENT
/begin MEASUREMENT z_emaktiv_fuw_zus_fkt "Anzeige der EM Fehlfuntion der Funktionsueberwachung der EM beim Zustart" UBYTE b_int_h_M_S7_S3 1 100 0 1 ECU_ADDRESS 0xFFF86C5D /end MEASUREMENT
/begin MEASUREMENT z_emaktiv_nemfehler_fuw_zus "Anzeige des Ablaufs bei fehlerhafter oder ersetzter EM-Drehzahl der Funktionsueberwachung der EM-Funktion beim Zustart" UBYTE sts_int_e_M_S7_S3 1 100 0 1 ECU_ADDRESS 0xFFF86B6A /end MEASUREMENT
/begin MEASUREMENT z_emfehler_frk_dihi "Zeigt an, dass eine EM Fehlfunktion erkannt wurde, die in der HAS ausgewertet werden soll" UBYTE sts_int_e_M_S7_S3 1 100 0 1 ECU_ADDRESS 0xFFF86C43 /end MEASUREMENT
/begin MEASUREMENT z_fehler15_eh_fkt "" UBYTE st_int_M_S7_S3 1 100 0 1 ECU_ADDRESS 0xFFF86C5E /end MEASUREMENT
/begin MEASUREMENT z_fuwdeakt_frk_dihi "Zeigt an, dass die FUW-Funktion nicht aktiviert werden darf" UBYTE sts_int_e_M_S7_S3 1 100 0 1 ECU_ADDRESS 0xFFF86C44 /end MEASUREMENT
/begin MEASUREMENT z_gebruefahrenaus_frk_dihi "Erkennung Aufheben gebruecktes E Fahren" UBYTE sts_int_e_M_S7_S3 1 100 0 1 ECU_ADDRESS 0xFFF86C45 /end MEASUREMENT
/begin MEASUREMENT z_iepein_frk_dihi "Zeigt an, dass die IEP aktiviert werden soll, wenn ein EM-Drehzahl Signalfehler vorliegt, um die Oelversorgung weiterhin sicher zu stellen." UBYTE sts_int_e_M_S7_S3 1 100 0 1 ECU_ADDRESS 0xFFF86C46 /end MEASUREMENT
/begin MEASUREMENT z_k0_befuellopt_has_fkt "" UBYTE st_int_M_S7_S3 1 100 0 1 ECU_ADDRESS 0xFFF86C5F /end MEASUREMENT
/begin MEASUREMENT z_k0_fst_in "" UBYTE E_ZK0FSTIN_M_S7_S3 1 100 0 3 ECU_ADDRESS 0xFFF86CBC /end MEASUREMENT
/begin MEASUREMENT z_k0_has_fkt "" UBYTE E_ZK0_M_S7_S3 1 100 0 5 ECU_ADDRESS 0xFFF86C60 /end MEASUREMENT
/begin MEASUREMENT z_k0sregaktiv_zus "Anforderung der Aktivierung der K0 Schlupfregelung beim Zustart" UBYTE sts_int_e_M_S7_S3 1 100 0 1 ECU_ADDRESS 0xFFF86B6B /end MEASUREMENT
/begin MEASUREMENT z_k0sregbasis_zus "Anzeige der Basisbedingung fuer die Anforderung der Aktivierung der K0 Schlupfregelung beim Zustart" UBYTE sts_int_e_M_S7_S3 1 100 0 1 ECU_ADDRESS 0xFFF86B6C /end MEASUREMENT
/begin MEASUREMENT z_k0sus_syn_zus "Anzeige der Aktivierung der Funktion zur Synchronisationsunterstuetzung (SUS) im Zustand K0 Synchronisieren beim Zustart" UBYTE sts_int_e_M_S7_S3 1 100 0 1 ECU_ADDRESS 0xFFF86B6D /end MEASUREMENT
/begin MEASUREMENT z_k0syncmk0erh_frk_dihi "Zeigt an, dass eine K0-Zwangsynchronisation mittels Erhoehung des K0-Moments erfolgen soll" UBYTE sts_int_e_M_S7_S3 1 100 0 1 ECU_ADDRESS 0xFFF86C47 /end MEASUREMENT
/begin MEASUREMENT z_k0zuheiss_zus "Anzeige K0 zu heiss - Aktivierung der Massnahmen zur Verhinderung der K0-Ueberhitzung beim Zustart" UBYTE sts_int_e_M_S7_S3 1 100 0 1 ECU_ADDRESS 0xFFF86B6E /end MEASUREMENT
/begin MEASUREMENT z_m_max_iae_has_fkt "" UBYTE st_int_M_S7_S3 1 100 0 50 ECU_ADDRESS 0xFFF86C61 /end MEASUREMENT
/begin MEASUREMENT z_m_soll_em_has_fkt "" UBYTE st_int_l_M_S7_S3 1 100 0 1 ECU_ADDRESS 0xFFF86C62 /end MEASUREMENT
/begin MEASUREMENT z_n_soll_em_has_fkt "" UBYTE st_int_M_S7_S3 1 100 0 50 ECU_ADDRESS 0xFFF86C63 /end MEASUREMENT
/begin MEASUREMENT z_n_soll_vm_has_fkt "" UBYTE st_int_M_S7_S3 1 100 0 50 ECU_ADDRESS 0xFFF86C64 /end MEASUREMENT
/begin MEASUREMENT z_ndk0vzwsyncerk_syn_zus "Zaehler der Anzahl von Vorzeichenwechseln der K0-Differenzdrehzahl zur Erkennung einer Antriebsstrangschwingung bei geschlossener K0 zur Erkennung Synchron beim VM Zustart" UBYTE void_int_M_S7_S3 1 100 0 100 ECU_ADDRESS 0xFFF86B6F /end MEASUREMENT
/begin MEASUREMENT z_ndsk0k0sreg_syn_zus "Anzeige der des Aktivierungszeitpunkts im Bestimmungsmodus \"NDSK0\" zur Anforderung der Aktivierung der K0-Schlupfregelung im Zustand K0 Synchronisieren beim Zustart" UBYTE sts_int_M_S7_S3 1 100 0 1 ECU_ADDRESS 0xFFF86B70 /end MEASUREMENT
/begin MEASUREMENT z_nemmin_frk_dihi "Zeigt an, dass die EM Leerlauf angehoben werden soll." UBYTE sts_int_e_M_S7_S3 1 100 0 1 ECU_ADDRESS 0xFFF86C48 /end MEASUREMENT
/begin MEASUREMENT z_nminemnull_frk_dihi "Zeigt an, dass die Ausgabe der minimalen EM Drehzahl der HAS unterdrueckt werden soll." UBYTE sts_int_e_M_S7_S3 1 100 0 1 ECU_ADDRESS 0xFFF86C49 /end MEASUREMENT
/begin MEASUREMENT z_nsollvmanh_frk_dihi "Zeigt an, dass die VM-Solldrehzahl waehrend eines Start-Ablaufs angehoben werden soll" UBYTE sts_int_e_M_S7_S3 1 100 0 1 ECU_ADDRESS 0xFFF86C4A /end MEASUREMENT
/begin MEASUREMENT z_nsollvmnull_frk_dihi "Zeigt an, dass die VM-Solldrehzahl Vorgabe unterbunden werden soll" UBYTE sts_int_e_M_S7_S3 1 100 0 1 ECU_ADDRESS 0xFFF86C4B /end MEASUREMENT
/begin MEASUREMENT z_nvmsollbegr_frk_dihi "Zeigt an, dass die VM-Solldrehzahl auf die EM-Istdrehzahl be-grenzt werden soll" UBYTE sts_int_e_M_S7_S3 1 100 0 1 ECU_ADDRESS 0xFFF86C4C /end MEASUREMENT
/begin MEASUREMENT z_p_hys_k0_has_fkt "Hysteresekompensation" UBYTE st_int_M_S7_S3 1 100 0 1 ECU_ADDRESS 0xFFF86C65 /end MEASUREMENT
/begin MEASUREMENT z_ponr_fkt "point of no return" UBYTE st_int_M_S7_S3 1 100 0 1 ECU_ADDRESS 0xFFF86C66 /end MEASUREMENT
/begin MEASUREMENT z_pvu_has_sbe "Beeinflussung des Hybridsystems zur Unterstuetzung der Positionsventil- Ueberwachung der HAS-Codierung: 0 = keine Beeinflussung, 1 = Beeinflussung Stufe 1, 2 = Beeinflussung Stufe 2" UBYTE st_int_M_S7_S3 1 100 0 2 ECU_ADDRESS 0xFFF86C72 /end MEASUREMENT
/begin MEASUREMENT z_respschlepp_sas_fkt "" UBYTE st_int_M_S7_S3 1 100 0 1 ECU_ADDRESS 0xFFF86C67 /end MEASUREMENT
/begin MEASUREMENT z_saf_has_fkt "Schaltanforderung 1...aktiv" UBYTE st_int_M_S7_S3 1 100 0 1 ECU_ADDRESS 0xFFF86C68 /end MEASUREMENT
/begin MEASUREMENT z_sbe_has_fkt "Schaltbeeinflussung  1...aktiv" UBYTE st_int_M_S7_S3 1 100 0 1 ECU_ADDRESS 0xFFF86C69 /end MEASUREMENT
/begin MEASUREMENT z_schaltprioverh_frk_dihi "Zeigt an, dass die Schaltungspriorisierung bei einem Zustart-Ablauf  uterbunden werden soll" UBYTE sts_int_e_M_S7_S3 1 100 0 1 ECU_ADDRESS 0xFFF86C4D /end MEASUREMENT
/begin MEASUREMENT z_schwingungsyncerk_syn_zus "Anzeige einer Antriebsstrangschwingung bei geschlossener K0 zur Erkennung Synchron beim K0-Synchronisieren beim Zustart" UBYTE sts_int_e_M_S7_S3 1 100 0 1 ECU_ADDRESS 0xFFF86B71 /end MEASUREMENT
/begin MEASUREMENT z_statuspsysmps_frk_dihi "Zeigt an, dass der Pumpendruck-Status der ATSYS modifiziert werden soll" UBYTE sts_int_e_M_S7_S3 1 100 0 1 ECU_ADDRESS 0xFFF86C4E /end MEASUREMENT
/begin MEASUREMENT z_svh_abbrlaus_fst_zus "Anzeige des Abbruchs einer laufenden Schaltung durch die Fahrstrategie beim Zustart" UBYTE sts_int_M_S7_S3 1 100 0 1 ECU_ADDRESS 0xFFF86B72 /end MEASUREMENT
/begin MEASUREMENT z_svh_frk_dihi "Zeigt an, dass die Schaltverhinderung (SVH) aktiviert werden soll" UBYTE sts_int_e_M_S7_S3 1 100 0 1 ECU_ADDRESS 0xFFF86C4F /end MEASUREMENT
/begin MEASUREMENT z_svh_has_sbe "Anforderung einer Schaltverhinderung der HAS" UBYTE st_int_M_S7_S3 1 100 0 1 ECU_ADDRESS 0xFFF86C7F /end MEASUREMENT
/begin MEASUREMENT z_svh_palaus_sak_zus "Anzeige der Schaltart der zum Rest des Zustart-Ablaufs parallel laufenden Schaltungen im Zustand Schaltung aktiv beim Zustart -> Bit-Codierung wie z_ablauf_shv_reset_has" UBYTE b_int_b_M_S7_S3 1 100 0 255 ECU_ADDRESS 0xFFF86B73 /end MEASUREMENT
/begin MEASUREMENT z_svh_reset_palaus_zus "Anzeige der Schaltart der, zum Zustart-Ablaufs parallel laufend, freigegebenen Schaltungen beim Zustart -> Bit-Codierung wie z_ablauf_shv_reset_has" UBYTE b_int_b_M_S7_S3 1 100 0 255 ECU_ADDRESS 0xFFF86B74 /end MEASUREMENT
/begin MEASUREMENT z_svh_reset_zustand_zus "Anzeige der Schaltart der in den einzelnen Zustaenden des Zustart-Ablaufs freigegebenen Schaltungen beim Zustart -> Bit-Codierung wie z_ablauf_shv_reset_has" UBYTE b_int_b_M_S7_S3 1 100 0 255 ECU_ADDRESS 0xFFF86B75 /end MEASUREMENT
/begin MEASUREMENT z_syncdda_zus "Anzeige der Aktivierung der Beeinflussung der K0-Synchronisation bei durchdrehenden Antriebsraedern beim Zustart" UBYTE sts_int_e_M_S7_S3 1 100 0 1 ECU_ADDRESS 0xFFF86B76 /end MEASUREMENT
/begin MEASUREMENT z_uvs_zus "Anzeige der Phase der K0-Unterstuetzung des VM Startsystems (UVS) beim Zustart" UBYTE E_ZUVSZUS_M_S7_S3 1 100 0 3 ECU_ADDRESS 0xFFF86B77 /end MEASUREMENT
/begin MEASUREMENT z_vmstartanf_frk_dihi "Zeigt an, dass der VM gestartet werden soll." UBYTE sts_int_e_M_S7_S3 1 100 0 1 ECU_ADDRESS 0xFFF86C50 /end MEASUREMENT
/begin MEASUREMENT z_vmstartverbot_frk_dihi "Zeigt an, dass der VM nicht gestartet werden darf." UBYTE sts_int_e_M_S7_S3 1 100 0 1 ECU_ADDRESS 0xFFF86C51 /end MEASUREMENT
/begin MEASUREMENT z_vmstopverbot_frk_dihi "Zeigt an, dass der VM nicht gestoppt werden darf." UBYTE sts_int_e_M_S7_S3 1 100 0 1 ECU_ADDRESS 0xFFF86C52 /end MEASUREMENT
/begin MEASUREMENT z_zuendfreigabe_vm_fkt "" UBYTE st_int_M_S7_S3 1 100 0 1 ECU_ADDRESS 0xFFF86C6A /end MEASUREMENT
/begin MEASUREMENT z_zuendfreigabe_vm_has_fkt "" UBYTE st_int_M_S7_S3 1 100 0 1 ECU_ADDRESS 0xFFF86C6B /end MEASUREMENT
/begin MEASUREMENT z_zust_halten_frk_dihi "Zeigt an, ob der Betriebszustand \"HAS Zustand halten\" aktiv sein soll." UBYTE sts_int_e_M_S7_S3 1 100 0 1 ECU_ADDRESS 0xFFF86C53 /end MEASUREMENT
/begin MEASUREMENT z_zust_init_frk_dihi "Zeigt an, ob der Betriebszustand \"HAS Zustand Init\" aktiv sein soll." UBYTE sts_int_e_M_S7_S3 1 100 0 1 ECU_ADDRESS 0xFFF86C54 /end MEASUREMENT
/begin MEASUREMENT zielgang_egs_in "" SBYTE sts_int_M_S7_S3 1 100 -128 127 ECU_ADDRESS 0xFFF86CC4 /end MEASUREMENT
/begin COMPU_METHOD SAB_M_NM_M2048_S2_S3 "int = ((phys * 1) / 1) - (-2048) Nm" RAT_FUNC "%2.0" "Nm" COEFFS 0 1 2048 0 0 1 /end COMPU_METHOD
/begin COMPU_METHOD SAB_M_NM_M100_S2_S3 "int = ((phys * 1) / 1) - (-100) Nm" RAT_FUNC "%2.0" "Nm" COEFFS 0 1 100 0 0 1 /end COMPU_METHOD
/begin COMPU_METHOD SAB_M_NM_M500_S2_S3 "int = ((phys * 1) / 1) - (-500) Nm" RAT_FUNC "%2.0" "Nm" COEFFS 0 1 500 0 0 1 /end COMPU_METHOD
/begin COMPU_METHOD SAB_M_NM_M511_S2_S3 "int = ((phys * 1) / 1) - (-511) Nm" RAT_FUNC "%2.0" "Nm" COEFFS 0 1 511 0 0 1 /end COMPU_METHOD
/begin COMPU_METHOD SAB_M_NM_M510_S2_S3 "int = ((phys * 1) / 1) - (-510) Nm" RAT_FUNC "%2.0" "Nm" COEFFS 0 1 510 0 0 1 /end COMPU_METHOD
/begin COMPU_METHOD b_int_b_M_S7_S3 "Bit Feld" RAT_FUNC "%3.0" "-" COEFFS 0 1 0 0 0 1 /end COMPU_METHOD
/begin COMPU_METHOD b_int_h_M_S7_S3 "Bit Feld" RAT_FUNC "%1.0" "-" COEFFS 0 1 0 0 0 1 /end COMPU_METHOD
/begin COMPU_METHOD c_fl_M_S7_S3 "Temperatur" RAT_FUNC "%12.6" "°C" COEFFS 0 1 0 0 0 1 /end COMPU_METHOD
/begin COMPU_METHOD c_int_M_S7_S3 "Temperatur" RAT_FUNC "%12.6" "°C" COEFFS 0 1 0 0 0 1 /end COMPU_METHOD
/begin COMPU_METHOD ctrl_int_M_S7_S3 "Steuerwort" RAT_FUNC "%3.0" "-" COEFFS 0 1 0 0 0 1 /end COMPU_METHOD
/begin COMPU_METHOD E_MODUSEFAH_M_S7_S3 "" TAB_VERB "%12.6" "" COMPU_TAB_REF CONV_TAB_E_MODUSEFAH_M_S7_S3 /end COMPU_METHOD
/begin COMPU_METHOD E_POS_M_S7_S3 "" TAB_VERB "%12.6" "" COMPU_TAB_REF CONV_TAB_E_POS_M_S7_S3 /end COMPU_METHOD
/begin COMPU_METHOD E_SIGSTATUS_M_S7_S3 "" TAB_VERB "%12.6" "" COMPU_TAB_REF CONV_TAB_E_SIGSTATUS_M_S7_S3 /end COMPU_METHOD
/begin COMPU_METHOD E_STAK0BEF_M_S7_S3 "" TAB_VERB "%12.6" "" COMPU_TAB_REF CONV_TAB_E_STAK0BEF_M_S7_S3 /end COMPU_METHOD
/begin COMPU_METHOD E_STATUSIAE_M_S7_S3 "" TAB_VERB "%12.6" "" COMPU_TAB_REF CONV_TAB_E_STATUSIAE_M_S7_S3 /end COMPU_METHOD
/begin COMPU_METHOD E_STATUSK0_M_S7_S3 "" TAB_VERB "%12.6" "" COMPU_TAB_REF CONV_TAB_E_STATUSK0_M_S7_S3 /end COMPU_METHOD
/begin COMPU_METHOD E_STATUSKSL_M_S7_S3 "" TAB_VERB "%12.6" "" COMPU_TAB_REF CONV_TAB_E_STATUSKSL_M_S7_S3 /end COMPU_METHOD
/begin COMPU_METHOD E_STATUSPSY_M_S7_S3 "" TAB_VERB "%12.6" "" COMPU_TAB_REF CONV_TAB_E_STATUSPSY_M_S7_S3 /end COMPU_METHOD
/begin COMPU_METHOD E_STATUSRSE_M_S7_S3 "" TAB_VERB "%12.6" "" COMPU_TAB_REF CONV_TAB_E_STATUSRSE_M_S7_S3 /end COMPU_METHOD
/begin COMPU_METHOD E_ZK0_M_S7_S3 "" TAB_VERB "%12.6" "" COMPU_TAB_REF CONV_TAB_E_ZK0_M_S7_S3 /end COMPU_METHOD
/begin COMPU_METHOD E_ZK0FSTIN_M_S7_S3 "" TAB_VERB "%12.6" "" COMPU_TAB_REF CONV_TAB_E_ZK0FSTIN_M_S7_S3 /end COMPU_METHOD
/begin COMPU_METHOD E_ZUVSZUS_M_S7_S3 "" TAB_VERB "%12.6" "" COMPU_TAB_REF CONV_TAB_E_ZUVSZUS_M_S7_S3 /end COMPU_METHOD
/begin COMPU_METHOD n_fl_M_S7_S3 "Drehzahl" RAT_FUNC "%12.6" "1/min" COEFFS 0 1 0 0 0 1 /end COMPU_METHOD
/begin COMPU_METHOD ng_fl_M_S7_S3 "Drehzahlgradient" RAT_FUNC "%12.6" "1/min/s" COEFFS 0 1 0 0 0 1 /end COMPU_METHOD
/begin COMPU_METHOD ratio_fl_M_S7_S3 "Uebersetzungsverhaeltnis" RAT_FUNC "%12.6" "-" COEFFS 0 1 0 0 0 1 /end COMPU_METHOD
/begin COMPU_METHOD rel_int_p_M_S7_S3 "Relative Groesse" RAT_FUNC "%12.6" "%" COEFFS 0 1 0 0 0 1 /end COMPU_METHOD
/begin COMPU_METHOD st_int_M_S7_S3 "Zustandsgroesse" RAT_FUNC "%3.0" "-" COEFFS 0 1 0 0 0 1 /end COMPU_METHOD
/begin COMPU_METHOD st_int_g_M_S7_S3 "Zustandsgroesse" RAT_FUNC "%5.0" "-" COEFFS 0 1 0 0 0 1 /end COMPU_METHOD
/begin COMPU_METHOD st_int_l_M_S7_S3 "Zustandsgroesse" RAT_FUNC "%1.0" "-" COEFFS 0 1 0 0 0 1 /end COMPU_METHOD
/begin COMPU_METHOD sts_fl_M_S7_S3 "Status" RAT_FUNC "%12.6" "-" COEFFS 0 1 0 0 0 1 /end COMPU_METHOD
/begin COMPU_METHOD sts_int_M_S7_S3 "Status" RAT_FUNC "%3.0" "-" COEFFS 0 1 0 0 0 1 /end COMPU_METHOD
/begin COMPU_METHOD sts_int_e_M_S7_S3 "Status" RAT_FUNC "%1.0" "-" COEFFS 0 1 0 0 0 1 /end COMPU_METHOD
/begin COMPU_METHOD swi_int_M_S7_S3 "Schalter" RAT_FUNC "%1.0" "-" COEFFS 0 1 0 0 0 1 /end COMPU_METHOD
/begin COMPU_METHOD swi_int_o_M_S7_S3 "Schalter" RAT_FUNC "%3.0" "-" COEFFS 0 1 0 0 0 1 /end COMPU_METHOD
/begin COMPU_METHOD t_fl_M_S7_S3 "Zeit" RAT_FUNC "%12.6" "s" COEFFS 0 1 0 0 0 1 /end COMPU_METHOD
/begin COMPU_METHOD t_int_n_M_S7_S3 "Zeit" RAT_FUNC "%6.2" "s" COEFFS 0 1 0 0 0 0.01 /end COMPU_METHOD
/begin COMPU_METHOD trq_fl_a_M_S7_S3 "Moment" RAT_FUNC "%12.6" "Nm" COEFFS 0 1 0 0 0 1 /end COMPU_METHOD
/begin COMPU_METHOD trq_int_M_S7_S3 "Moment" RAT_FUNC "%5.0" "Nm" COEFFS 0 1 0 0 0 1 /end COMPU_METHOD
/begin COMPU_METHOD trqg_fl_k_M_S7_S3 "Momentengradient" RAT_FUNC "%12.6" "Nm/s" COEFFS 0 1 0 0 0 1 /end COMPU_METHOD
/begin COMPU_METHOD void_fl_M_S7_S3 "ohne Umrechnung" RAT_FUNC "%12.6" "-" COEFFS 0 1 0 0 0 1 /end COMPU_METHOD
/begin COMPU_METHOD void_int_M_S7_S3 "ohne Umrechnung" RAT_FUNC "%3.0" "-" COEFFS 0 1 0 0 0 1 /end COMPU_METHOD
/begin COMPU_METHOD void_int_c_M_S7_S3 "ohne Umrechnung" RAT_FUNC "%5.0" "-" COEFFS 0 1 0 0 0 1 /end COMPU_METHOD
/begin COMPU_METHOD void_int_d_M_S7_S3 "ohne Umrechnung" RAT_FUNC "%1.0" "-" COEFFS 0 1 0 0 0 1 /end COMPU_METHOD
/begin COMPU_VTAB CONV_TAB_E_MODUSEFAH_M_S7_S3 "Conversion table" TAB_VERB 2 0 "LADUNG_ABBAUEN" 1 "LADUNG_ERHALTEN" /end COMPU_VTAB
/begin COMPU_VTAB CONV_TAB_E_POS_M_S7_S3 "Conversion table" TAB_VERB 9 0 "D1" 1 "D2" 2 "D3" 3 "D4" 4 "D5" 5 "D" 6 "N" 7 "R" 8 "P" /end COMPU_VTAB
/begin COMPU_VTAB CONV_TAB_E_SIGSTATUS_M_S7_S3 "Conversion table" TAB_VERB 3 0 "SIGNAL_OK" 1 "ERSATZWERT" 2 "SIGNAL_FEHLER" /end COMPU_VTAB
/begin COMPU_VTAB CONV_TAB_E_STAK0BEF_M_S7_S3 "Conversion table" TAB_VERB 4 0 "NICHT_AKTIV" 1 "STANDARD_BEF" 2 "OPTIMIERTBEF" 3 "REDUZIERTBEF" /end COMPU_VTAB
/begin COMPU_VTAB CONV_TAB_E_STATUSIAE_M_S7_S3 "Conversion table" TAB_VERB 9 0 "NICHTDEFINIERT" 1 "OFFEN" 2 "ANGELEGT" 3 "ANFAHREN" 4 "ENTKOPPELT" 5 "ENTKOPPELT_ANFAHREN" 6 "SYNCHRONISIEREN" 7 "GESCHLOSSEN" 8 "OEFFNEN" /end COMPU_VTAB
/begin COMPU_VTAB CONV_TAB_E_STATUSK0_M_S7_S3 "Conversion table" TAB_VERB 6 0 "OFFEN" 1 "ANGELEGT" 2 "DRUCKSTELLUNG" 3 "SCHLUPFGEREGELT" 4 "GEREGELTGESCHL" 5 "GESCHLOSSEN" /end COMPU_VTAB
/begin COMPU_VTAB CONV_TAB_E_STATUSKSL_M_S7_S3 "Conversion table" TAB_VERB 7 0 "KEIN_KRAFTSCHLUSS" 1 "VORW_AUF_ABBAUEND" 2 "VORWAERTS" 3 "RUECKW_AUF_ABBAUEND" 4 "RUECKWAERTS" 5 "VORWAERTS_SCHLUPF" 6 "RUECKWAERTS_SCHLUPF" /end COMPU_VTAB
/begin COMPU_VTAB CONV_TAB_E_STATUSPSY_M_S7_S3 "Conversion table" TAB_VERB 5 0 "AUS" 1 "NICHTDEFINIERT" 2 "LP1" 3 "LP2" 4 "LP3" /end COMPU_VTAB
/begin COMPU_VTAB CONV_TAB_E_STATUSRSE_M_S7_S3 "Conversion table" TAB_VERB 2 0 "KEIN_RADSCHLUPF" 1 "DURCHDREHEN_ERKANNT" /end COMPU_VTAB
/begin COMPU_VTAB CONV_TAB_E_ZK0_M_S7_S3 "Conversion table" TAB_VERB 6 0 "OEFFNENSW" 1 "BEFUELLEN" 2 "DRUCKSTELLUNG" 3 "SCHLUPFREGELUNG" 4 "GEREGELTGESCHL" 5 "GESCHLOSSEN" /end COMPU_VTAB
/begin COMPU_VTAB CONV_TAB_E_ZK0FSTIN_M_S7_S3 "Conversion table" TAB_VERB 4 0 "OFFEN" 1 "SCHLUPFGEREGELT" 2 "GEREGELTGESCHL" 3 "GESCHLOSSEN" /end COMPU_VTAB
/begin COMPU_VTAB CONV_TAB_E_ZUVSZUS_M_S7_S3 "Conversion table" TAB_VERB 4 0 "KEINANFORDERUNG" 1 "ANGEFORDERT" 2 "AKTIVIERT" 3 "RUECKNAHME" /end COMPU_VTAB
/begin FUNCTION SFOp_Zus22_st_k0_synchronisieren_zus ""
 /begin DEF_CHARACTERISTIC KF_NGEMMODRSMAX_SYN_ZUS_W KF_NGEMMODRSMAX_SYN_ZUS_X KF_NGEMMODRSMAX_SYN_ZUS_Y KF_NDEMNSOLLVM_ANH_ZUS_W KF_NDEMNSOLLVM_ANH_ZUS_X KF_NDEMNSOLLVM_ANH_ZUS_Y KF_NDEMNSOLLVM_K0ZUHEISS_SYN_ZUS_W KF_NDEMNSOLLVM_K0ZUHEISS_SYN_ZUS_X KF_NDEMNSOLLVM_K0ZUHEISS_SYN_ZUS_Y KF_NOEMNSOLLVM_ZST_ZUS_W KF_NOEMNSOLLVM_ZST_ZUS_X KF_NOEMNSOLLVM_ZST_ZUS_Y KL_NDZIELK0K0SREG_SYN_ZUS_Y KL_NDZIELK0K0SREG_SYN_ZUS_X KL_KSVHRESET_SYN_ZUS_Y KL_KSVHRESET_SYN_ZUS_X KL_NDSK0SYNCERK_SYN_ZUS_Y KL_NDSK0SYNCERK_SYN_ZUS_X KL_TK0SYNCERKUMS_SYN_ZUS_Y KL_TK0SYNCERKUMS_SYN_ZUS_X KL_MGK0MODMAXMAX_SYN_ZUS_Y KL_MGK0MODMAXMAX_SYN_ZUS_X KF_MGK0NDK0M_K0ZUHEISS_SYN_ZUS_W KF_MGK0NDK0M_K0ZUHEISS_SYN_ZUS_X KF_MGK0NDK0M_K0ZUHEISS_SYN_ZUS_Y KF_MGK0NDK0M_SYNCDDA_SYN_ZUS_W KF_MGK0NDK0M_SYNCDDA_SYN_ZUS_X KF_MGK0NDK0M_SYNCDDA_SYN_ZUS_Y KF_MGK0NDK0M_SYNCSZA_SYN_ZUS_W KF_MGK0NDK0M_SYNCSZA_SYN_ZUS_X KF_MGK0NDK0M_SYNCSZA_SYN_ZUS_Y KL_MGSOLLK0SUS_SYN_ZUS_Y KL_MGSOLLK0SUS_SYN_ZUS_X KL_MVMVOLLASTSAUG_SYN_ZUS_Y KL_MVMVOLLASTSAUG_SYN_ZUS_X KF_MGK0NDK0M_IAEREG_SYN_ZUS_W KF_MGK0NDK0M_IAEREG_SYN_ZUS_X KF_MGK0NDK0M_IAEREG_SYN_ZUS_Y KF_MGK0NDK0M_MRS_SYN_ZUS_W KF_MGK0NDK0M_MRS_SYN_ZUS_X KF_MGK0NDK0M_MRS_SYN_ZUS_Y KF_MGK0NDK0M_RS_SYN_ZUS_W KF_MGK0NDK0M_RS_SYN_ZUS_X KF_MGK0NDK0M_RS_SYN_ZUS_Y KF_MGK0NDK0M_SYN_ZUS_W KF_MGK0NDK0M_SYN_ZUS_X KF_MGK0NDK0M_SYN_ZUS_Y KF_MGK0NDK0M_ZMANH_SYN_ZUS_W KF_MGK0NDK0M_ZMANH_SYN_ZUS_X KF_MGK0NDK0M_ZMANH_SYN_ZUS_Y KF_MGK0NDK0NGVM_SYN_ZUS_W KF_MGK0NDK0NGVM_SYN_ZUS_X KF_MGK0NDK0NGVM_SYN_ZUS_Y KL_MSOLLK0MIN_SYN_ZUS_Y KL_MSOLLK0MIN_SYN_ZUS_X KL_MZIELK0MIN_K0ZUHEISS_SYN_ZUS_Y KL_MZIELK0MIN_K0ZUHEISS_SYN_ZUS_X KL_MZIELK0MIN_SYNCDDA_SYN_ZUS_Y KL_MZIELK0MIN_SYNCDDA_SYN_ZUS_X KL_MZIELK0MIN_SYNCSZA_SYN_ZUS_Y KL_MZIELK0MIN_SYNCSZA_SYN_ZUS_X KL_MZIELK0MIN_SYN_ZUS_Y KL_MZIELK0MIN_SYN_ZUS_X KL_MOZIELK0ZMANHMAX_SYN_ZUS_Y KL_MOZIELK0ZMANHMAX_SYN_ZUS_X KL_MOZIELK0ZMANH_SYN_ZUS_Y KL_MOZIELK0ZMANH_SYN_ZUS_X KL_NDSK0K0SREG_SYN_ZUS_Y KL_NDSK0K0SREG_SYN_ZUS_X MS_SOLLEMVORSTEUER_ZUS SWI_ZMSOLLEM_SYN_ZUS SWI_K0SREGBASIS_SYN_ZUS MS_SOLLK0K0SREG_SYN_ZUS MS_ZIELVMK0SREG_SYN_ZUS T_K0SREGBASISMAX_SYN_ZUS NDGS_K0K0SREG_SYN_ZUS NOS_EMNSOLLVMK0SREG_SYN_ZUS T_NDGK0K0SREGMIN_SYN_ZUS NS_EMMINBED_SYN_ZUS T_VK0SREGAKTIV_SYN_ZUS MG_SOLLK0MIN_SYN_ZUS SWI_K0SUS_SYN_ZUS MS_ZIELVMHASK0HYS_ANH_ZUS SWI_ZPHYSK0_SYN_ZUS MG_K0SYNCMK0ERHDIAG_SYN_ZUS MG_K0SYNCVMVOLLAST_SYN_ZUS MO_VMMGSOLLK0_SYN_ZUS NS_EMMGSOLLK0NULL_SYN_ZUS K_KFMGK0RS_SYN_ZUS MO_ZIELK0MINZMANH_SYN_ZUS SWI_KFMGK0AUSWAHL_SYN_ZUS SWI_MGK0RSKF_SYN_ZUS SWI_MK0MODBEGR_SYN_ZUS K_NOEMNSOLLVMOKS_ZST_ZUS NDS_K0SYNCERKDDA_SYN_ZUS NDS_K0SYNCERKMAX_SYN_ZUS NDS_K0SYNCERKSZA_SYN_ZUS NDS_K0VZWERKSYNCERK_SYN_ZUS NOS_EMNSOLLVM_SYN_ZUS T_VK0SYNCERKDDA_SYN_ZUS T_VK0SYNCERKSZA_SYN_ZUS T_VK0SYNCERK_SYN_ZUS T_ZNDK0VZWSYNCERK_SYN_ZUS Z_NDK0VZWMINSYNCERK_SYN_ZUS FK_NSOLLVM_ANH_ZUS N_MINEMNSOLLVM_ZST_ZUS K_MZIELNOEMNSOLLVM_ZST_ZUS MGS_WUNSCHFPW_SYN_ZUS BM_SCHALTARTNEMMODRS_SYN_ZUS NG_EMMODRSMIN_SYN_ZUS TAB_KFMGK0STATUSIAE_SYN_ZUS /end DEF_CHARACTERISTIC
 /begin LOC_MEASUREMENT m_ziel_k0_zus z_svh_reset_zustand_zus z_k0sregbasis_zus z_k0sregaktiv_zus z_emaktiv_nemfehler_fuw_zus m_stoerk0em_zus z_svh_palaus_sak_zus m_ziel_k0_min_syn_zus z_schwingungsyncerk_syn_zus t_k0sregbasis_syn_zus t_ndgk0k0sreg_syn_zus z_ndsk0k0sreg_syn_zus t_k0sregaktiv_syn_zus mo_ziel_k0_zmanh_syn_zus m_ziel_k0_min_syn_zus__int z_k0sus_syn_zus mg_soll_k0_syn_zus m_k0_mod_max_syn_zus nds_k0syncerk_syn_zus t_k0syncerk_syn_zus t_k0syncerkums_syn_zus z_ndk0vzwsyncerk_syn_zus n_em_mod_syn_zus n_em_ref_syn_zus nd_sec_iae_syn_zus ng_emmodrsmax_syn_zus z_syncdda_zus z_ablaufvariante_sza_zus k_mstoerk0em_zus m_ziel_vm_has_zus ng_em_zus n_sec_iae_ziel_zus n_sec_iae_ist_zus m_stoerk0em_fil_zus modus_e_fahren_zus z_k0zuheiss_zus m_soll_k0_min_uvs_zus z_uvs_zus mo_k0befuell_zus m_k0_mod_has_fkt m_soll_em_has_fkt m_soll_k0_has_fkt n_soll_em_has_fkt n_soll_vm_has_fkt st_ablauf_fkt status_ablauf_has_fkt z_k0_has_fkt z_m_soll_em_has_fkt z_n_soll_em_has_fkt z_n_soll_vm_has_fkt z_zuendfreigabe_vm_has_fkt z_p_hys_k0_has_fkt m_soll_res_em_has_fkt z_emaktiv_fuw_zus_fkt z_saf_has_fkt z_m_max_iae_has_fkt m_max_iae_has_fkt z_ablaufvariante_kalt_zus z_emfehler_frk_dihi z_k0syncmk0erh_frk_dihi z_fuwdeakt_frk_dihi z_nsollvmnull_frk_dihi z_schaltprioverh_frk_dihi z_nsollvmanh_frk_dihi z_ablauf_has_stg z_ablaufvariante_has_stg c_getriebe_egs_in m_em_in m_k0_in m_max_dyn_em_in m_soll_vm_hst_in m_vm_in m_wunsch_fpw_in n_ab_egs_in n_em_in n_vm_in status_k0_in n_soll_ll_vm_in m_vm_start_in status_iae_in z_k0_fst_in istgang_egs_in status_kraftfluss_egs_in gangwechsel_egs_in sollgang_egs_in status_nem_in pos_egs_in z_ablauf_has_hst_in m_min_dyn_em_in m_ziel_k0_hst_in zielgang_egs_in kolbenpos_k0_in status_k0_befuellung_in m_soll_vm_l_hst_in status_nreg_em_hst_in m_min_vm_in m_wunsch_fpw_hst_in n_soll_em_hst_in abstellpos_vm_in nd_k0_in ndg_k0_in ng_vm_in status_schaltung_egs_in status_psys_has_sbe mg_wunsch_fpw_hst_in i_zielgang_egs status_schaltart_svh_has_sbe status_sync_schaltung_sbe z_pvu_has_sbe status_radschlupf_rse_has_sbe z_svh_has_sbe /end LOC_MEASUREMENT
 /begin SUB_FUNCTION Run_SFOp_Zus101_cLimiter_Gradient_MSollK0 Run_SFOp_Zus107_cLimiter_Gradient_m_k0_mod_has Run_SFOp_Zus142_cLimiter_Gradient_MSollK0 Run_SFOp_Zus137_cPT1_NVMSoll SFOp_Zus135_Initialisierung SFOp_Zus105_Initialisierung Run_SFOp_Zus116_abs_fl32 Run_SFOp_Zus92_abs_fl32 SFOp_Zus141_Bitwise_AND_ui8 SFOp_Zus88_Bitwise_AND_ui8_1 SFOp_Zus84_Bitwise_AND_ui8_1 SFOp_Zus85_Bitwise_AND_ui8_2 SFOp_Zus86_Bitwise_AND_ui8_3 /end SUB_FUNCTION
/end FUNCTION
/begin FUNCTION SFOp_Zus23_st_schaltung_aktiv_zus ""
 /begin DEF_CHARACTERISTIC KF_NOEMNSOLLVM_SAK_ZUS_W KF_NOEMNSOLLVM_SAK_ZUS_X KF_NOEMNSOLLVM_SAK_ZUS_Y KF_NOEMNSOLLVM_ZST_ZUS_W KF_NOEMNSOLLVM_ZST_ZUS_X KF_NOEMNSOLLVM_ZST_ZUS_Y KL_KSVHPALAUSNACHVSI_LA_SAK_ZUS_Y KL_KSVHPALAUSNACHVSI_LA_SAK_ZUS_X KL_KSVHPALAUSNACHVSI_LE_SAK_ZUS_Y KL_KSVHPALAUSNACHVSI_LE_SAK_ZUS_X KL_KSVHPALAUSVORVSI_LA_SAK_ZUS_Y KL_KSVHPALAUSVORVSI_LA_SAK_ZUS_X KL_KSVHPALAUSVORVSI_LE_SAK_ZUS_Y KL_KSVHPALAUSVORVSI_LE_SAK_ZUS_X KL_KSVHRESETABLABBR_SAK_ZUS_Y KL_KSVHRESETABLABBR_SAK_ZUS_X KL_KSVHRESETAUSZST_LA_SAK_ZUS_Y KL_KSVHRESETAUSZST_LA_SAK_ZUS_X KL_KSVHRESETAUSZST_LE_SAK_ZUS_Y KL_KSVHRESETAUSZST_LE_SAK_ZUS_X KL_KSVHRESETNACHVSI_LA_SAK_ZUS_Y KL_KSVHRESETNACHVSI_LA_SAK_ZUS_X KL_KSVHRESETNACHVSI_LE_SAK_ZUS_Y KL_KSVHRESETNACHVSI_LE_SAK_ZUS_X KL_KSVHRESETVORVSI_LA_SAK_ZUS_Y KL_KSVHRESETVORVSI_LA_SAK_ZUS_X KL_KSVHRESETVORVSI_LE_SAK_ZUS_Y KL_KSVHRESETVORVSI_LE_SAK_ZUS_X KL_MK0MODK0BEF_ZUS_Y KL_MK0MODK0BEF_ZUS_X KL_MK0MODUVS_ZST_ZUS_Y KL_MK0MODUVS_ZST_ZUS_X KF_MOSOLLK0BEF_ZST_ZUS_W KF_MOSOLLK0BEF_ZST_ZUS_X KF_MOSOLLK0BEF_ZST_ZUS_Y KF_MSOLLK0BEF_2_SAK_ZUS_W KF_MSOLLK0BEF_2_SAK_ZUS_X KF_MSOLLK0BEF_2_SAK_ZUS_Y KF_MSOLLK0BEF_SAK_ZUS_W KF_MSOLLK0BEF_SAK_ZUS_X KF_MSOLLK0BEF_SAK_ZUS_Y KL_NSEMK0BEFVERZ_SAK_ZUS_Y KL_NSEMK0BEFVERZ_SAK_ZUS_X KL_SCHALTARTK0BEFVERZ_SAK_ZUS_Y KL_SCHALTARTK0BEFVERZ_SAK_ZUS_X MS_SOLLEMVORSTEUER_ZUS MS_ZIELVMHASK0HYS_ANH_ZUS K_NOEMNSOLLVMOKS_ZST_ZUS N_MINEMNSOLLVM_ZST_ZUS K_MZIELNOEMNSOLLVM_ZST_ZUS SWI_ZMSOLLEM_SAK_ZUS MS_WUNSCHK0HYS_ANH_ZUS NDS_VMNEMBED_ANH_ZUS NDS_VMNEMK0HYS_SAK_ZUS NS_EMK0HYS_ANH_ZUS SWI_ZPHYSK0RUECKSTATUSK0_ZST_ZUS SWI_ZPHYSK0_SAK_ZUS MG_SOLLK0NEG_2_SAK_ZUS MG_SOLLK0NEG_SAK_ZUS MG_SOLLK0POS_2_SAK_ZUS MG_SOLLK0POS_SAK_ZUS SWI_MK0MODBEGR_SAK_ZUS SWI_UVS_ZUS Z_ABLAUFVARIANTE_UVS_ZUS T_MAX_SAK_ZUS Z_ABLAUF_ABBRUCH_ZUS FK_NSOLLVM_SAK_ZUS /end DEF_CHARACTERISTIC
 /begin LOC_MEASUREMENT m_ziel_k0_zus z_svh_reset_zustand_zus z_k0sregbasis_zus z_k0sregaktiv_zus z_emaktiv_nemfehler_fuw_zus m_stoerk0em_zus z_svh_palaus_sak_zus m_ziel_k0_min_syn_zus z_schwingungsyncerk_syn_zus t_maxbed_sak_zus z_syncdda_zus z_ablaufvariante_sza_zus k_mstoerk0em_zus m_ziel_vm_has_zus ng_em_zus n_sec_iae_ziel_zus n_sec_iae_ist_zus m_stoerk0em_fil_zus modus_e_fahren_zus z_k0zuheiss_zus m_soll_k0_min_uvs_zus z_uvs_zus mo_k0befuell_zus m_k0_mod_has_fkt m_soll_em_has_fkt m_soll_k0_has_fkt n_soll_em_has_fkt n_soll_vm_has_fkt st_ablauf_fkt status_ablauf_has_fkt z_k0_has_fkt z_m_soll_em_has_fkt z_n_soll_em_has_fkt z_n_soll_vm_has_fkt z_zuendfreigabe_vm_has_fkt z_p_hys_k0_has_fkt m_soll_res_em_has_fkt z_emaktiv_fuw_zus_fkt z_saf_has_fkt z_m_max_iae_has_fkt m_max_iae_has_fkt z_ablaufvariante_kalt_zus z_emfehler_frk_dihi z_k0syncmk0erh_frk_dihi z_fuwdeakt_frk_dihi z_nsollvmnull_frk_dihi z_schaltprioverh_frk_dihi z_nsollvmanh_frk_dihi z_ablauf_has_stg z_ablaufvariante_has_stg c_getriebe_egs_in m_em_in m_k0_in m_max_dyn_em_in m_soll_vm_hst_in m_vm_in m_wunsch_fpw_in n_ab_egs_in n_em_in n_vm_in status_k0_in n_soll_ll_vm_in m_vm_start_in status_iae_in z_k0_fst_in istgang_egs_in status_kraftfluss_egs_in gangwechsel_egs_in sollgang_egs_in status_nem_in pos_egs_in z_ablauf_has_hst_in m_min_dyn_em_in m_ziel_k0_hst_in zielgang_egs_in kolbenpos_k0_in status_k0_befuellung_in m_soll_vm_l_hst_in status_nreg_em_hst_in m_min_vm_in m_wunsch_fpw_hst_in n_soll_em_hst_in abstellpos_vm_in nd_k0_in ndg_k0_in ng_vm_in status_schaltung_egs_in status_psys_has_sbe mg_wunsch_fpw_hst_in i_zielgang_egs status_schaltart_svh_has_sbe status_sync_schaltung_sbe z_pvu_has_sbe status_radschlupf_rse_has_sbe z_svh_has_sbe /end LOC_MEASUREMENT
 /begin SUB_FUNCTION SFOp_Zus171_Initialisierung SFOp_Zus179_Initialisierung SFOp_Zus165_Bitwise_AND_ui8 SFOp_Zus178_Bitwise_AND_ui8 Run_SFOp_Zus180_cPT1_NVMSoll /end SUB_FUNCTION
/end FUNCTION
/begin FUNCTION SFOp_Zus238_Initialisierung "" /begin DEF_CHARACTERISTIC STATUS_ABL_ABF_ZUS /end DEF_CHARACTERISTIC /begin LOC_MEASUREMENT st_ablauf_fkt status_ablauf_has_fkt /end LOC_MEASUREMENT /end FUNCTION
/begin FUNCTION SFOp_Zus239_Initialisierung "" /begin LOC_MEASUREMENT z_n_soll_vm_has_fkt /end LOC_MEASUREMENT /end FUNCTION
/begin FUNCTION SFOp_Zus24_st_start_zus ""
 /begin LOC_MEASUREMENT m_ziel_k0_zus z_svh_reset_zustand_zus z_k0sregbasis_zus z_k0sregaktiv_zus z_emaktiv_nemfehler_fuw_zus m_stoerk0em_zus z_svh_palaus_sak_zus m_ziel_k0_min_syn_zus z_schwingungsyncerk_syn_zus z_syncdda_zus z_ablaufvariante_sza_zus k_mstoerk0em_zus m_ziel_vm_has_zus ng_em_zus n_sec_iae_ziel_zus n_sec_iae_ist_zus m_stoerk0em_fil_zus modus_e_fahren_zus z_k0zuheiss_zus m_soll_k0_min_uvs_zus z_uvs_zus mo_k0befuell_zus m_k0_mod_has_fkt m_soll_em_has_fkt m_soll_k0_has_fkt n_soll_em_has_fkt n_soll_vm_has_fkt st_ablauf_fkt status_ablauf_has_fkt z_k0_has_fkt z_m_soll_em_has_fkt z_n_soll_em_has_fkt z_n_soll_vm_has_fkt z_zuendfreigabe_vm_has_fkt z_p_hys_k0_has_fkt m_soll_res_em_has_fkt z_emaktiv_fuw_zus_fkt z_saf_has_fkt z_m_max_iae_has_fkt m_max_iae_has_fkt z_ablaufvariante_kalt_zus z_emfehler_frk_dihi z_k0syncmk0erh_frk_dihi z_fuwdeakt_frk_dihi z_nsollvmnull_frk_dihi z_schaltprioverh_frk_dihi z_nsollvmanh_frk_dihi z_ablauf_has_stg z_ablaufvariante_has_stg c_getriebe_egs_in m_em_in m_k0_in m_max_dyn_em_in m_soll_vm_hst_in m_vm_in m_wunsch_fpw_in n_ab_egs_in n_em_in n_vm_in status_k0_in n_soll_ll_vm_in m_vm_start_in status_iae_in z_k0_fst_in istgang_egs_in status_kraftfluss_egs_in gangwechsel_egs_in sollgang_egs_in status_nem_in pos_egs_in z_ablauf_has_hst_in m_min_dyn_em_in m_ziel_k0_hst_in zielgang_egs_in kolbenpos_k0_in status_k0_befuellung_in m_soll_vm_l_hst_in status_nreg_em_hst_in m_min_vm_in m_wunsch_fpw_hst_in n_soll_em_hst_in abstellpos_vm_in nd_k0_in ndg_k0_in ng_vm_in status_schaltung_egs_in status_psys_has_sbe mg_wunsch_fpw_hst_in i_zielgang_egs status_schaltart_svh_has_sbe status_sync_schaltung_sbe z_pvu_has_sbe status_radschlupf_rse_has_sbe z_svh_has_sbe /end LOC_MEASUREMENT
 /begin SUB_FUNCTION SFOp_Zus184_st_start_zus /end SUB_FUNCTION
/end FUNCTION
/begin FUNCTION SFOp_Zus25_st_uebergabe_zus ""
 /begin LOC_MEASUREMENT m_ziel_k0_zus z_svh_reset_zustand_zus z_k0sregbasis_zus z_k0sregaktiv_zus z_emaktiv_nemfehler_fuw_zus m_stoerk0em_zus z_svh_palaus_sak_zus m_ziel_k0_min_syn_zus z_schwingungsyncerk_syn_zus m_k0_mod_has_fkt m_soll_em_has_fkt m_soll_k0_has_fkt n_soll_em_has_fkt n_soll_vm_has_fkt st_ablauf_fkt status_ablauf_has_fkt z_k0_has_fkt z_m_soll_em_has_fkt z_n_soll_em_has_fkt z_n_soll_vm_has_fkt z_zuendfreigabe_vm_has_fkt z_p_hys_k0_has_fkt m_soll_res_em_has_fkt z_emaktiv_fuw_zus_fkt z_saf_has_fkt z_m_max_iae_has_fkt m_max_iae_has_fkt /end LOC_MEASUREMENT
 /begin SUB_FUNCTION SFOp_Zus205_Initialisierung SFOp_Zus204_Initialisierung SFOp_Zus209_Initialisierung SFOp_Zus207_Initialisierung SFOp_Zus208_Initialisierung /end SUB_FUNCTION
/end FUNCTION
/begin FUNCTION SFOp_Zus26_st_uebergabe_zustart_abbruch_zus ""
 /begin LOC_MEASUREMENT m_ziel_k0_zus z_svh_reset_zustand_zus z_k0sregbasis_zus z_k0sregaktiv_zus z_emaktiv_nemfehler_fuw_zus m_stoerk0em_zus z_svh_palaus_sak_zus m_ziel_k0_min_syn_zus z_schwingungsyncerk_syn_zus z_syncdda_zus z_ablaufvariante_sza_zus k_mstoerk0em_zus m_ziel_vm_has_zus ng_em_zus n_sec_iae_ziel_zus n_sec_iae_ist_zus m_stoerk0em_fil_zus modus_e_fahren_zus z_k0zuheiss_zus m_soll_k0_min_uvs_zus z_uvs_zus mo_k0befuell_zus m_k0_mod_has_fkt m_soll_em_has_fkt m_soll_k0_has_fkt n_soll_em_has_fkt n_soll_vm_has_fkt st_ablauf_fkt status_ablauf_has_fkt z_k0_has_fkt z_m_soll_em_has_fkt z_n_soll_em_has_fkt z_n_soll_vm_has_fkt z_zuendfreigabe_vm_has_fkt z_p_hys_k0_has_fkt m_soll_res_em_has_fkt z_emaktiv_fuw_zus_fkt z_saf_has_fkt z_m_max_iae_has_fkt m_max_iae_has_fkt z_ablaufvariante_kalt_zus z_emfehler_frk_dihi z_k0syncmk0erh_frk_dihi z_fuwdeakt_frk_dihi z_nsollvmnull_frk_dihi z_schaltprioverh_frk_dihi z_nsollvmanh_frk_dihi z_ablauf_has_stg z_ablaufvariante_has_stg c_getriebe_egs_in m_em_in m_k0_in m_max_dyn_em_in m_soll_vm_hst_in m_vm_in m_wunsch_fpw_in n_ab_egs_in n_em_in n_vm_in status_k0_in n_soll_ll_vm_in m_vm_start_in status_iae_in z_k0_fst_in istgang_egs_in status_kraftfluss_egs_in gangwechsel_egs_in sollgang_egs_in status_nem_in pos_egs_in z_ablauf_has_hst_in m_min_dyn_em_in m_ziel_k0_hst_in zielgang_egs_in kolbenpos_k0_in status_k0_befuellung_in m_soll_vm_l_hst_in status_nreg_em_hst_in m_min_vm_in m_wunsch_fpw_hst_in n_soll_em_hst_in abstellpos_vm_in nd_k0_in ndg_k0_in ng_vm_in status_schaltung_egs_in status_psys_has_sbe mg_wunsch_fpw_hst_in i_zielgang_egs status_schaltart_svh_has_sbe status_sync_schaltung_sbe z_pvu_has_sbe status_radschlupf_rse_has_sbe z_svh_has_sbe /end LOC_MEASUREMENT
 /begin SUB_FUNCTION SFOp_Zus216_Initialisierung SFOp_Zus219_Initialisierung SFOp_Zus217_Initialisierung SFOp_Zus218_Initialisierung /end SUB_FUNCTION
/end FUNCTION
/begin FUNCTION SFOp_Zus260_Initialisierung "" /begin LOC_MEASUREMENT z_k0_has_fkt /end LOC_MEASUREMENT /end FUNCTION
/begin FUNCTION SFOp_Zus261_Berechnung_m_soll_k0_basis_zus ""
 /begin DEF_CHARACTERISTIC KF_MOSOLLK0BEF_ZST_ZUS_W KF_MOSOLLK0BEF_ZST_ZUS_X KF_MOSOLLK0BEF_ZST_ZUS_Y KF_MSOLLK0BEF_ANH_ZUS_W KF_MSOLLK0BEF_ANH_ZUS_X KF_MSOLLK0BEF_ANH_ZUS_Y MG_SOLLK0NEG_ANH_ZUS MG_SOLLK0POS_ANH_ZUS /end DEF_CHARACTERISTIC
 /begin LOC_MEASUREMENT m_ziel_vm_has_zus c_getriebe_egs_in m_max_dyn_em_in /end LOC_MEASUREMENT
 /begin SUB_FUNCTION Run_SFOp_Zus263_cLimiter_Gradient_m_soll_k0_basis_zus /end SUB_FUNCTION
/end FUNCTION
/begin FUNCTION SFOp_Zus262_Berechnung_m_soll_k0_fuwkalt ""
 /begin DEF_CHARACTERISTIC KL_MSOLLK0EMANK_FUW_ZUS_Y KL_MSOLLK0EMANK_FUW_ZUS_X KL_MSOLLK0KALTNEM_ANH_ZUS_Y KL_MSOLLK0KALTNEM_ANH_ZUS_X MG_SOLLK0NEG_ANH_ZUS MG_SOLLK0EMANKPOS_FUW_ZUS MG_SOLLK0POSKALTNEM_ANH_ZUS NDS_VMNSOLLLLVMFUW_ANH_ZUS /end DEF_CHARACTERISTIC
 /begin LOC_MEASUREMENT z_nsollvmnull_frk_dihi c_getriebe_egs_in n_vm_in status_k0_in n_soll_ll_vm_in status_iae_in /end LOC_MEASUREMENT
/end FUNCTION
/begin FUNCTION SFOp_Zus27_st_vm_abfangen_zus ""
 /begin DEF_CHARACTERISTIC KF_NDEMNSOLLVM_ANH_ZUS_W KF_NDEMNSOLLVM_ANH_ZUS_X KF_NDEMNSOLLVM_ANH_ZUS_Y KF_NOEMNSOLLVM_ZST_ZUS_W KF_NOEMNSOLLVM_ZST_ZUS_X KF_NOEMNSOLLVM_ZST_ZUS_Y KL_KSVHRESET_ABF_ZUS_Y KL_KSVHRESET_ABF_ZUS_X KL_MK0MODK0BEF_ZUS_Y KL_MK0MODK0BEF_ZUS_X KL_MK0MODUVS_ZST_ZUS_Y KL_MK0MODUVS_ZST_ZUS_X KF_MOSOLLK0BEF_ZST_ZUS_W KF_MOSOLLK0BEF_ZST_ZUS_X KF_MOSOLLK0BEF_ZST_ZUS_Y KF_MSOLLK0BEF_ABF_ZUS_W KF_MSOLLK0BEF_ABF_ZUS_X KF_MSOLLK0BEF_ABF_ZUS_Y KL_MK0ZIEL_ABF_ZUS_Y KL_MK0ZIEL_ABF_ZUS_X MS_SOLLEMVORSTEUER_ZUS K_NOEMNSOLLVMOKS_ZST_ZUS FK_NSOLLVM_ANH_ZUS N_MINEMNSOLLVM_ZST_ZUS K_MZIELNOEMNSOLLVM_ZST_ZUS SWI_ZPHYSK0RUECKSTATUSK0_ZST_ZUS SWI_UVS_ZUS Z_ABLAUFVARIANTE_UVS_ZUS SWI_ZMSOLLEM_ABF_ZUS SWI_ZPHYSK0_ABF_ZUS MG_SOLLK0NEG_ABF_ZUS MG_SOLLK0POS_ABF_ZUS NDS_K0MK0ANH_ABF_ZUS NGS_VMMK0ANH_ABF_ZUS SWI_MK0MODBEGR_ABF_ZUS T_VMSTATUSMAX_ABF_ZUS MGS_WUNSCHFPW_ABF_ZUS NO_SOLLVMANHFRK_ANH_ZUS /end DEF_CHARACTERISTIC
 /begin LOC_MEASUREMENT m_ziel_k0_zus z_svh_reset_zustand_zus z_k0sregbasis_zus z_k0sregaktiv_zus z_emaktiv_nemfehler_fuw_zus m_stoerk0em_zus z_svh_palaus_sak_zus m_ziel_k0_min_syn_zus z_schwingungsyncerk_syn_zus t_vmstatus_abf_zus z_syncdda_zus z_ablaufvariante_sza_zus k_mstoerk0em_zus m_ziel_vm_has_zus ng_em_zus n_sec_iae_ziel_zus n_sec_iae_ist_zus m_stoerk0em_fil_zus modus_e_fahren_zus z_k0zuheiss_zus m_soll_k0_min_uvs_zus z_uvs_zus mo_k0befuell_zus m_k0_mod_has_fkt m_soll_em_has_fkt m_soll_k0_has_fkt n_soll_em_has_fkt n_soll_vm_has_fkt st_ablauf_fkt status_ablauf_has_fkt z_k0_has_fkt z_m_soll_em_has_fkt z_n_soll_em_has_fkt z_n_soll_vm_has_fkt z_zuendfreigabe_vm_has_fkt z_p_hys_k0_has_fkt m_soll_res_em_has_fkt z_emaktiv_fuw_zus_fkt z_saf_has_fkt z_m_max_iae_has_fkt m_max_iae_has_fkt z_ablaufvariante_kalt_zus z_emfehler_frk_dihi z_k0syncmk0erh_frk_dihi z_fuwdeakt_frk_dihi z_nsollvmnull_frk_dihi z_schaltprioverh_frk_dihi z_nsollvmanh_frk_dihi z_ablauf_has_stg z_ablaufvariante_has_stg c_getriebe_egs_in m_em_in m_k0_in m_max_dyn_em_in m_soll_vm_hst_in m_vm_in m_wunsch_fpw_in n_ab_egs_in n_em_in n_vm_in status_k0_in n_soll_ll_vm_in m_vm_start_in status_iae_in z_k0_fst_in istgang_egs_in status_kraftfluss_egs_in gangwechsel_egs_in sollgang_egs_in status_nem_in pos_egs_in z_ablauf_has_hst_in m_min_dyn_em_in m_ziel_k0_hst_in zielgang_egs_in kolbenpos_k0_in status_k0_befuellung_in m_soll_vm_l_hst_in status_nreg_em_hst_in m_min_vm_in m_wunsch_fpw_hst_in n_soll_em_hst_in abstellpos_vm_in nd_k0_in ndg_k0_in ng_vm_in status_schaltung_egs_in status_psys_has_sbe mg_wunsch_fpw_hst_in i_zielgang_egs status_schaltart_svh_has_sbe status_sync_schaltung_sbe z_pvu_has_sbe status_radschlupf_rse_has_sbe z_svh_has_sbe /end LOC_MEASUREMENT
 /begin SUB_FUNCTION Run_SFOp_Zus242_cPT1_NVMSoll SFOp_Zus238_Initialisierung SFOp_Zus239_Initialisierung Run_SFOp_Zus233_cLimiter_Gradient_m_k0_has /end SUB_FUNCTION
/end FUNCTION
/begin FUNCTION SFOp_Zus278_Initialisierung "" /begin DEF_CHARACTERISTIC STATUS_ABL_ANH_ZUS /end DEF_CHARACTERISTIC /begin LOC_MEASUREMENT st_ablauf_fkt status_ablauf_has_fkt /end LOC_MEASUREMENT /end FUNCTION
/begin FUNCTION SFOp_Zus279_K_SVH_RESET_ANH_ZUS "" /begin DEF_CHARACTERISTIC KL_KSVHRESET_ANH_ZUS_Y KL_KSVHRESET_ANH_ZUS_X /end DEF_CHARACTERISTIC /begin LOC_MEASUREMENT z_svh_reset_zustand_zus istgang_egs_in /end LOC_MEASUREMENT /end FUNCTION
/begin FUNCTION SFOp_Zus28_st_vm_drehzahlanhebung_zus ""
 /begin DEF_CHARACTERISTIC KF_NDEMNSOLLVM_ANH_ZUS_W KF_NDEMNSOLLVM_ANH_ZUS_X KF_NDEMNSOLLVM_ANH_ZUS_Y KF_NDEMNSOLLVM_SAK_ZUS_W KF_NDEMNSOLLVM_SAK_ZUS_X KF_NDEMNSOLLVM_SAK_ZUS_Y KF_NOEMNSOLLVM_SAK_ZUS_W KF_NOEMNSOLLVM_SAK_ZUS_X KF_NOEMNSOLLVM_SAK_ZUS_Y KF_NOEMNSOLLVM_ZST_ZUS_W KF_NOEMNSOLLVM_ZST_ZUS_X KF_NOEMNSOLLVM_ZST_ZUS_Y KL_MSOLLK0EMANK_FUW_ZUS_Y KL_MSOLLK0EMANK_FUW_ZUS_X KL_MK0MODFUW_ANH_ZUS_Y KL_MK0MODFUW_ANH_ZUS_X KL_MK0MODK0BEF_ZUS_Y KL_MK0MODK0BEF_ZUS_X KL_MK0MODKALTNEM_ANH_ZUS_Y KL_MK0MODKALTNEM_ANH_ZUS_X KL_MK0MODUVS_ZST_ZUS_Y KL_MK0MODUVS_ZST_ZUS_X MS_SOLLEMVORSTEUER_ZUS MS_ZIELVMHASK0HYS_ANH_ZUS K_NOEMNSOLLVMOKS_ZST_ZUS FK_NSOLLVM_ANH_ZUS N_MINEMNSOLLVM_ZST_ZUS K_MZIELNOEMNSOLLVM_ZST_ZUS MS_WUNSCHK0HYS_ANH_ZUS NDS_VMNEMBED_ANH_ZUS NS_EMK0HYS_ANH_ZUS NO_SOLLVMANHFRK_ANH_ZUS SWI_ZMSOLLEM_ANH_ZUS NDS_VMNEMK0HYS_ANH_ZUS SWI_ZPHYSK0_ANH_ZUS SWI_MK0MODBEGR_ANH_ZUS T_VK0ZUNEMFEHLER_FUW_ZUS NDS_VMNEMSVHRESET_ANH_ZUS NS_EMSVHRESET_ANH_ZUS T_VMSTATUSMAX_ANH_ZUS N_SOLLVMFUW_ZST_ZUS MGS_WUNSCHFPW_ANH_ZUS /end DEF_CHARACTERISTIC
 /begin LOC_MEASUREMENT m_ziel_k0_zus z_svh_reset_zustand_zus z_k0sregbasis_zus z_k0sregaktiv_zus z_emaktiv_nemfehler_fuw_zus m_stoerk0em_zus z_svh_palaus_sak_zus m_ziel_k0_min_syn_zus z_schwingungsyncerk_syn_zus t_k0zunemfehlerbed_fuw_zus t_vmstatus_anh_zus z_syncdda_zus z_ablaufvariante_sza_zus k_mstoerk0em_zus m_ziel_vm_has_zus ng_em_zus n_sec_iae_ziel_zus n_sec_iae_ist_zus m_stoerk0em_fil_zus modus_e_fahren_zus z_k0zuheiss_zus m_soll_k0_min_uvs_zus z_uvs_zus mo_k0befuell_zus m_k0_mod_has_fkt m_soll_em_has_fkt m_soll_k0_has_fkt n_soll_em_has_fkt n_soll_vm_has_fkt st_ablauf_fkt status_ablauf_has_fkt z_k0_has_fkt z_m_soll_em_has_fkt z_n_soll_em_has_fkt z_n_soll_vm_has_fkt z_zuendfreigabe_vm_has_fkt z_p_hys_k0_has_fkt m_soll_res_em_has_fkt z_emaktiv_fuw_zus_fkt z_saf_has_fkt z_m_max_iae_has_fkt m_max_iae_has_fkt z_ablaufvariante_kalt_zus z_emfehler_frk_dihi z_k0syncmk0erh_frk_dihi z_fuwdeakt_frk_dihi z_nsollvmnull_frk_dihi z_schaltprioverh_frk_dihi z_nsollvmanh_frk_dihi z_ablauf_has_stg z_ablaufvariante_has_stg c_getriebe_egs_in m_em_in m_k0_in m_max_dyn_em_in m_soll_vm_hst_in m_vm_in m_wunsch_fpw_in n_ab_egs_in n_em_in n_vm_in status_k0_in n_soll_ll_vm_in m_vm_start_in status_iae_in z_k0_fst_in istgang_egs_in status_kraftfluss_egs_in gangwechsel_egs_in sollgang_egs_in status_nem_in pos_egs_in z_ablauf_has_hst_in m_min_dyn_em_in m_ziel_k0_hst_in zielgang_egs_in kolbenpos_k0_in status_k0_befuellung_in m_soll_vm_l_hst_in status_nreg_em_hst_in m_min_vm_in m_wunsch_fpw_hst_in n_soll_em_hst_in abstellpos_vm_in nd_k0_in ndg_k0_in ng_vm_in status_schaltung_egs_in status_psys_has_sbe mg_wunsch_fpw_hst_in i_zielgang_egs status_schaltart_svh_has_sbe status_sync_schaltung_sbe z_pvu_has_sbe status_radschlupf_rse_has_sbe z_svh_has_sbe /end LOC_MEASUREMENT
 /begin SUB_FUNCTION SFOp_Zus280_K_SVH_RESET_SYN_ZUS SFOp_Zus279_K_SVH_RESET_ANH_ZUS SFOp_Zus262_Berechnung_m_soll_k0_fuwkalt SFOp_Zus261_Berechnung_m_soll_k0_basis_zus SFOp_Zus278_Initialisierung SFOp_Zus260_Initialisierung Run_SFOp_Zus283_cPT1_NVMSoll /end SUB_FUNCTION
/end FUNCTION
/begin FUNCTION SFOp_Zus280_K_SVH_RESET_SYN_ZUS "" /begin DEF_CHARACTERISTIC KL_KSVHRESET_SYN_ZUS_Y KL_KSVHRESET_SYN_ZUS_X /end DEF_CHARACTERISTIC /begin LOC_MEASUREMENT z_svh_reset_zustand_zus istgang_egs_in /end LOC_MEASUREMENT /end FUNCTION
/begin FUNCTION SFOp_Zus29_st_zustart_abbruch_zus "" /begin DEF_CHARACTERISTIC MG_SOLLK0_ABB_ZUS T_MAX_ABB_ZUS /end DEF_CHARACTERISTIC
 /begin LOC_MEASUREMENT m_ziel_k0_zus z_svh_reset_zustand_zus z_k0sregbasis_zus z_k0sregaktiv_zus z_emaktiv_nemfehler_fuw_zus m_stoerk0em_zus z_svh_palaus_sak_zus m_ziel_k0_min_syn_zus z_schwingungsyncerk_syn_zus t_maxbed_abb_zus z_syncdda_zus z_ablaufvariante_sza_zus k_mstoerk0em_zus m_ziel_vm_has_zus ng_em_zus n_sec_iae_ziel_zus n_sec_iae_ist_zus m_stoerk0em_fil_zus modus_e_fahren_zus z_k0zuheiss_zus m_soll_k0_min_uvs_zus z_uvs_zus mo_k0befuell_zus m_k0_mod_has_fkt m_soll_em_has_fkt m_soll_k0_has_fkt n_soll_em_has_fkt n_soll_vm_has_fkt st_ablauf_fkt status_ablauf_has_fkt z_k0_has_fkt z_m_soll_em_has_fkt z_n_soll_em_has_fkt z_n_soll_vm_has_fkt z_zuendfreigabe_vm_has_fkt z_p_hys_k0_has_fkt m_soll_res_em_has_fkt z_emaktiv_fuw_zus_fkt z_saf_has_fkt z_m_max_iae_has_fkt m_max_iae_has_fkt z_ablaufvariante_kalt_zus z_emfehler_frk_dihi z_k0syncmk0erh_frk_dihi z_fuwdeakt_frk_dihi z_nsollvmnull_frk_dihi z_schaltprioverh_frk_dihi z_nsollvmanh_frk_dihi z_ablauf_has_stg z_ablaufvariante_has_stg c_getriebe_egs_in m_em_in m_k0_in m_max_dyn_em_in m_soll_vm_hst_in m_vm_in m_wunsch_fpw_in n_ab_egs_in n_em_in n_vm_in status_k0_in n_soll_ll_vm_in m_vm_start_in status_iae_in z_k0_fst_in istgang_egs_in status_kraftfluss_egs_in gangwechsel_egs_in sollgang_egs_in status_nem_in pos_egs_in z_ablauf_has_hst_in m_min_dyn_em_in m_ziel_k0_hst_in zielgang_egs_in kolbenpos_k0_in status_k0_befuellung_in m_soll_vm_l_hst_in status_nreg_em_hst_in m_min_vm_in m_wunsch_fpw_hst_in n_soll_em_hst_in abstellpos_vm_in nd_k0_in ndg_k0_in ng_vm_in status_schaltung_egs_in status_psys_has_sbe mg_wunsch_fpw_hst_in i_zielgang_egs status_schaltart_svh_has_sbe status_sync_schaltung_sbe z_pvu_has_sbe status_radschlupf_rse_has_sbe z_svh_has_sbe /end LOC_MEASUREMENT
 /begin SUB_FUNCTION SFOp_Zus306_Initialisierung SFOp_Zus307_Initialisierung SFOp_Zus302_Initialisierung SFOp_Zus298_Initialisierung Run_SFOp_Zus297_cLimiter_Gradient_MSollK0 /end SUB_FUNCTION
/end FUNCTION
/begin FUNCTION SFOp_Zus298_Initialisierung "" /begin DEF_CHARACTERISTIC SWI_ZPHYSK0_ABB_ZUS /end DEF_CHARACTERISTIC /begin LOC_MEASUREMENT z_p_hys_k0_has_fkt /end LOC_MEASUREMENT /end FUNCTION
/begin FUNCTION SFOp_Zus30_st_zustarten_zus ""
 /begin DEF_CHARACTERISTIC KF_NOEMNSOLLVM_SAK_ZUS_W KF_NOEMNSOLLVM_SAK_ZUS_X KF_NOEMNSOLLVM_SAK_ZUS_Y KF_NOEMNSOLLVM_ZST_ZUS_W KF_NOEMNSOLLVM_ZST_ZUS_X KF_NOEMNSOLLVM_ZST_ZUS_Y KL_KSVHRESETK0ANGELEGT_ZST_ZUS_Y KL_KSVHRESETK0ANGELEGT_ZST_ZUS_X KL_KSVHRESETK0FUELLEN_ZST_ZUS_Y KL_KSVHRESETK0FUELLEN_ZST_ZUS_X KL_KSVHRESETK0OFFEN_ZST_ZUS_Y KL_KSVHRESETK0OFFEN_ZST_ZUS_X KL_MK0MODK0BEF_ZUS_Y KL_MK0MODK0BEF_ZUS_X KL_MK0MODUVS_ZST_ZUS_Y KL_MK0MODUVS_ZST_ZUS_X KF_MOSOLLK0BEF_ZST_ZUS_W KF_MOSOLLK0BEF_ZST_ZUS_X KF_MOSOLLK0BEF_ZST_ZUS_Y KF_MSOLLK0BEF_2_ZST_ZUS_W KF_MSOLLK0BEF_2_ZST_ZUS_X KF_MSOLLK0BEF_2_ZST_ZUS_Y KF_MSOLLK0BEF_ZST_ZUS_W KF_MSOLLK0BEF_ZST_ZUS_X KF_MSOLLK0BEF_ZST_ZUS_Y MS_SOLLEMVORSTEUER_ZUS K_NOEMNSOLLVMOKS_ZST_ZUS N_MINEMNSOLLVM_ZST_ZUS K_MZIELNOEMNSOLLVM_ZST_ZUS SWI_ZPHYSK0RUECKSTATUSK0_ZST_ZUS SWI_UVS_ZUS Z_ABLAUFVARIANTE_UVS_ZUS N_SOLLVMFUW_ZST_ZUS SWI_ZMSOLLEM_ZST_ZUS SWI_ZPHYSK0_ZST_ZUS NS_EMKALTNEM_ZST_ZUS NS_SOLLEMKALTNEM_ZST_ZUS SWI_K0BEFLP1FUW_ZST_ZUS T_VK0BEFKALTNEM_ZST_ZUS T_VK0BEFVERZ_ZST_ZUS MG_SOLLK0NEG_2_ZST_ZUS MG_SOLLK0NEG_ZST_ZUS MG_SOLLK0POS_2_ZST_ZUS MG_SOLLK0POS_ZST_ZUS SWI_MK0MODBEGR_ZST_ZUS K_KOLBENPOSK0BEF_ZST_ZUS FK_NSOLLVM_ZST_ZUS NO_EMNSOLLVMSAK_ZST_ZUS /end DEF_CHARACTERISTIC
 /begin LOC_MEASUREMENT m_ziel_k0_zus z_svh_reset_zustand_zus z_k0sregbasis_zus z_k0sregaktiv_zus z_emaktiv_nemfehler_fuw_zus m_stoerk0em_zus z_svh_palaus_sak_zus m_ziel_k0_min_syn_zus z_schwingungsyncerk_syn_zus t_k0bef_kaltnem_zst_zus t_k0bef_verz_zst_zus z_syncdda_zus z_ablaufvariante_sza_zus k_mstoerk0em_zus m_ziel_vm_has_zus ng_em_zus n_sec_iae_ziel_zus n_sec_iae_ist_zus m_stoerk0em_fil_zus modus_e_fahren_zus z_k0zuheiss_zus m_soll_k0_min_uvs_zus z_uvs_zus mo_k0befuell_zus m_k0_mod_has_fkt m_soll_em_has_fkt m_soll_k0_has_fkt n_soll_em_has_fkt n_soll_vm_has_fkt st_ablauf_fkt status_ablauf_has_fkt z_k0_has_fkt z_m_soll_em_has_fkt z_n_soll_em_has_fkt z_n_soll_vm_has_fkt z_zuendfreigabe_vm_has_fkt z_p_hys_k0_has_fkt m_soll_res_em_has_fkt z_emaktiv_fuw_zus_fkt z_saf_has_fkt z_m_max_iae_has_fkt m_max_iae_has_fkt z_ablaufvariante_kalt_zus z_emfehler_frk_dihi z_k0syncmk0erh_frk_dihi z_fuwdeakt_frk_dihi z_nsollvmnull_frk_dihi z_schaltprioverh_frk_dihi z_nsollvmanh_frk_dihi z_ablauf_has_stg z_ablaufvariante_has_stg c_getriebe_egs_in m_em_in m_k0_in m_max_dyn_em_in m_soll_vm_hst_in m_vm_in m_wunsch_fpw_in n_ab_egs_in n_em_in n_vm_in status_k0_in n_soll_ll_vm_in m_vm_start_in status_iae_in z_k0_fst_in istgang_egs_in status_kraftfluss_egs_in gangwechsel_egs_in sollgang_egs_in status_nem_in pos_egs_in z_ablauf_has_hst_in m_min_dyn_em_in m_ziel_k0_hst_in zielgang_egs_in kolbenpos_k0_in status_k0_befuellung_in m_soll_vm_l_hst_in status_nreg_em_hst_in m_min_vm_in m_wunsch_fpw_hst_in n_soll_em_hst_in abstellpos_vm_in nd_k0_in ndg_k0_in ng_vm_in status_schaltung_egs_in status_psys_has_sbe mg_wunsch_fpw_hst_in i_zielgang_egs status_schaltart_svh_has_sbe status_sync_schaltung_sbe z_pvu_has_sbe status_radschlupf_rse_has_sbe z_svh_has_sbe /end LOC_MEASUREMENT
 /begin SUB_FUNCTION SFOp_Zus335_Initialisierung SFOp_Zus334_Initialisierung SFOp_Zus336_Initialisierung Run_SFOp_Zus338_cPT1_NVMSoll /end SUB_FUNCTION
/end FUNCTION
/begin FUNCTION SFOp_Zus302_Initialisierung "" /begin LOC_MEASUREMENT st_ablauf_fkt status_ablauf_has_fkt /end LOC_MEASUREMENT /end FUNCTION
/begin FUNCTION SFOp_Zus306_Initialisierung "" /begin DEF_CHARACTERISTIC K_SVH_RESET_ABB_ZUS /end DEF_CHARACTERISTIC /begin LOC_MEASUREMENT z_svh_reset_zustand_zus z_svh_palaus_sak_zus /end LOC_MEASUREMENT /end FUNCTION
/begin FUNCTION SFOp_Zus307_Initialisierung "" /begin LOC_MEASUREMENT n_soll_vm_has_fkt z_n_soll_vm_has_fkt /end LOC_MEASUREMENT /end FUNCTION
/begin FUNCTION SFOp_Zus334_Initialisierung "" /begin DEF_CHARACTERISTIC STATUS_ABL_ZST_ZUS /end DEF_CHARACTERISTIC /begin LOC_MEASUREMENT st_ablauf_fkt status_ablauf_has_fkt /end LOC_MEASUREMENT /end FUNCTION
/begin FUNCTION SFOp_Zus335_Initialisierung "" /begin LOC_MEASUREMENT z_svh_palaus_sak_zus /end LOC_MEASUREMENT /end FUNCTION
/begin FUNCTION SFOp_Zus336_Initialisierung "" /begin LOC_MEASUREMENT z_zuendfreigabe_vm_has_fkt /end LOC_MEASUREMENT /end FUNCTION
/begin FUNCTION SFOp_Zus343_Ablaufvariante_Kaltstart_abgesenkter_EM_Drehzahl "" /begin DEF_CHARACTERISTIC Z_ABLAUFVARIANTE_KALTNEM_ZUS /end DEF_CHARACTERISTIC /begin LOC_MEASUREMENT z_ablaufvariante_has_stg /end LOC_MEASUREMENT /end FUNCTION
/begin FUNCTION SFOp_Zus345_Alt_Bus_Output ""
 /begin LOC_MEASUREMENT m_ziel_k0_zus z_svh_reset_zustand_zus z_k0sregbasis_zus z_k0sregaktiv_zus z_emaktiv_nemfehler_fuw_zus m_stoerk0em_zus z_svh_palaus_sak_zus m_ziel_k0_min_syn_zus z_schwingungsyncerk_syn_zus m_k0_mod_has_fkt m_soll_em_has_fkt m_soll_k0_has_fkt n_soll_em_has_fkt n_soll_vm_has_fkt st_ablauf_fkt status_ablauf_has_fkt z_k0_has_fkt z_m_soll_em_has_fkt z_n_soll_em_has_fkt z_n_soll_vm_has_fkt z_zuendfreigabe_vm_has_fkt z_p_hys_k0_has_fkt m_soll_res_em_has_fkt z_emaktiv_fuw_zus_fkt z_saf_has_fkt z_m_max_iae_has_fkt m_max_iae_has_fkt z_ablauf_svh_reset_has_fkt z_ablaufvariante_kalt_zus z_ponr_fkt m_max_em_has_fkt m_min_em_has_fkt mg_soll_k0_has_fkt nd_min_saf_has_fkt nd_soll_iae_fkt z_fehler15_eh_fkt z_k0_befuellopt_has_fkt z_respschlepp_sas_fkt z_sbe_has_fkt z_zuendfreigabe_vm_fkt z_nvmsollbegr_frk_dihi z_statuspsysmps_frk_dihi z_nminemnull_frk_dihi z_emfehler_frk_dihi z_ablaufreinit_frk_dihi z_k0syncmk0erh_frk_dihi z_fuwdeakt_frk_dihi z_nemmin_frk_dihi z_vmstopverbot_frk_dihi z_vmstartverbot_frk_dihi z_zust_halten_frk_dihi z_zust_init_frk_dihi z_deaktiv_abo_frk_dihi z_vmstartanf_frk_dihi z_svh_frk_dihi z_iepein_frk_dihi z_nsollvmnull_frk_dihi z_ala_frk_dihi z_schaltprioverh_frk_dihi z_nsollvmanh_frk_dihi z_gebruefahrenaus_frk_dihi /end LOC_MEASUREMENT
/end FUNCTION
/begin FUNCTION SFOp_Zus38_Initialisierung "" /begin LOC_MEASUREMENT m_soll_em_has_fkt z_m_soll_em_has_fkt /end LOC_MEASUREMENT /end FUNCTION
/begin FUNCTION SFOp_Zus4_CalcFcn ""
 /begin LOC_MEASUREMENT m_ziel_k0_zus z_svh_reset_zustand_zus z_k0sregbasis_zus z_k0sregaktiv_zus z_emaktiv_nemfehler_fuw_zus m_stoerk0em_zus z_svh_palaus_sak_zus m_ziel_k0_min_syn_zus z_schwingungsyncerk_syn_zus z_syncdda_zus z_ablaufvariante_sza_zus k_mstoerk0em_zus m_ziel_vm_has_zus ng_em_zus n_sec_iae_ziel_zus n_sec_iae_ist_zus m_stoerk0em_fil_zus modus_e_fahren_zus z_k0zuheiss_zus m_soll_k0_min_uvs_zus z_uvs_zus mo_k0befuell_zus m_k0_mod_has_fkt m_soll_em_has_fkt m_soll_k0_has_fkt n_soll_em_has_fkt n_soll_vm_has_fkt st_ablauf_fkt status_ablauf_has_fkt z_k0_has_fkt z_m_soll_em_has_fkt z_n_soll_em_has_fkt z_n_soll_vm_has_fkt z_zuendfreigabe_vm_has_fkt z_p_hys_k0_has_fkt m_soll_res_em_has_fkt z_emaktiv_fuw_zus_fkt z_saf_has_fkt z_m_max_iae_has_fkt m_max_iae_has_fkt z_ablaufvariante_kalt_zus z_emfehler_frk_dihi z_k0syncmk0erh_frk_dihi z_fuwdeakt_frk_dihi z_nsollvmnull_frk_dihi z_schaltprioverh_frk_dihi z_nsollvmanh_frk_dihi z_ablauf_has_stg z_ablaufvariante_has_stg c_getriebe_egs_in m_em_in m_k0_in m_max_dyn_em_in m_soll_vm_hst_in m_vm_in m_wunsch_fpw_in n_ab_egs_in n_em_in n_vm_in status_k0_in n_soll_ll_vm_in m_vm_start_in status_iae_in z_k0_fst_in istgang_egs_in status_kraftfluss_egs_in gangwechsel_egs_in sollgang_egs_in status_nem_in pos_egs_in z_ablauf_has_hst_in m_min_dyn_em_in m_ziel_k0_hst_in zielgang_egs_in kolbenpos_k0_in status_k0_befuellung_in m_soll_vm_l_hst_in status_nreg_em_hst_in m_min_vm_in m_wunsch_fpw_hst_in n_soll_em_hst_in abstellpos_vm_in nd_k0_in ndg_k0_in ng_vm_in status_schaltung_egs_in status_psys_has_sbe mg_wunsch_fpw_hst_in i_zielgang_egs status_schaltart_svh_has_sbe status_sync_schaltung_sbe z_pvu_has_sbe status_radschlupf_rse_has_sbe z_svh_has_sbe /end LOC_MEASUREMENT
 /begin SUB_FUNCTION SFOp_Zus30_st_zustarten_zus SFOp_Zus28_st_vm_drehzahlanhebung_zus SFOp_Zus27_st_vm_abfangen_zus SFOp_Zus23_st_schaltung_aktiv_zus SFOp_Zus22_st_k0_synchronisieren_zus SFOp_Zus21_st_k0_schliessen_zus SFOp_Zus24_st_start_zus SFOp_Zus25_st_uebergabe_zus SFOp_Zus26_st_uebergabe_zustart_abbruch_zus SFOp_Zus29_st_zustart_abbruch_zus /end SUB_FUNCTION
/end FUNCTION
/begin FUNCTION SFOp_Zus40_Initialisierung "" /begin DEF_CHARACTERISTIC SWI_ZPHYSK0_SCL_ZUS /end DEF_CHARACTERISTIC /begin LOC_MEASUREMENT z_p_hys_k0_has_fkt /end LOC_MEASUREMENT /end FUNCTION
/begin FUNCTION SFOp_Zus436_Schaltungsbeeinflussung ""
 /begin DEF_CHARACTERISTIC KL_KSVHABBRLAUSFST_ZUS_Y KL_KSVHABBRLAUSFST_ZUS_X K_SVH_RESET_SZA_ZUS /end DEF_CHARACTERISTIC
 /begin LOC_MEASUREMENT m_ziel_k0_zus z_svh_reset_zustand_zus z_k0sregbasis_zus z_k0sregaktiv_zus z_emaktiv_nemfehler_fuw_zus m_stoerk0em_zus z_svh_palaus_sak_zus m_ziel_k0_min_syn_zus z_schwingungsyncerk_syn_zus z_syncdda_zus z_ablaufvariante_sza_zus k_mstoerk0em_zus m_ziel_vm_has_zus ng_em_zus n_sec_iae_ziel_zus n_sec_iae_ist_zus m_stoerk0em_fil_zus modus_e_fahren_zus z_k0zuheiss_zus m_soll_k0_min_uvs_zus z_uvs_zus mo_k0befuell_zus z_svh_abbrlaus_fst_zus z_svh_reset_palaus_zus m_k0_mod_has_fkt m_soll_em_has_fkt m_soll_k0_has_fkt n_soll_em_has_fkt n_soll_vm_has_fkt st_ablauf_fkt status_ablauf_has_fkt z_k0_has_fkt z_m_soll_em_has_fkt z_n_soll_em_has_fkt z_n_soll_vm_has_fkt z_zuendfreigabe_vm_has_fkt z_p_hys_k0_has_fkt m_soll_res_em_has_fkt z_emaktiv_fuw_zus_fkt z_saf_has_fkt z_m_max_iae_has_fkt m_max_iae_has_fkt z_ablaufvariante_kalt_zus z_emfehler_frk_dihi z_k0syncmk0erh_frk_dihi z_fuwdeakt_frk_dihi z_nsollvmnull_frk_dihi z_schaltprioverh_frk_dihi z_nsollvmanh_frk_dihi z_ablauf_has_stg z_ablaufvariante_has_stg c_getriebe_egs_in m_em_in m_k0_in m_max_dyn_em_in m_soll_vm_hst_in m_vm_in m_wunsch_fpw_in n_ab_egs_in n_em_in n_vm_in status_k0_in n_soll_ll_vm_in m_vm_start_in status_iae_in z_k0_fst_in istgang_egs_in status_kraftfluss_egs_in gangwechsel_egs_in sollgang_egs_in status_nem_in pos_egs_in z_ablauf_has_hst_in m_min_dyn_em_in m_ziel_k0_hst_in zielgang_egs_in kolbenpos_k0_in status_k0_befuellung_in m_soll_vm_l_hst_in status_nreg_em_hst_in m_min_vm_in m_wunsch_fpw_hst_in n_soll_em_hst_in abstellpos_vm_in nd_k0_in ndg_k0_in ng_vm_in status_schaltung_egs_in status_psys_has_sbe mg_wunsch_fpw_hst_in i_zielgang_egs status_schaltart_svh_has_sbe status_sync_schaltung_sbe z_pvu_has_sbe status_radschlupf_rse_has_sbe z_svh_has_sbe /end LOC_MEASUREMENT
 /begin SUB_FUNCTION SFOp_Zus442_Bitwise_OR_ui8 SFOp_Zus443_Bitwise_AND_ui8 /end SUB_FUNCTION
/end FUNCTION
/begin FUNCTION SFOp_Zus442_Bitwise_OR_ui8 "" /begin LOC_MEASUREMENT z_svh_reset_zustand_zus z_ablauf_svh_reset_has_fkt /end LOC_MEASUREMENT /end FUNCTION
/begin FUNCTION SFOp_Zus443_Bitwise_AND_ui8 "" /begin LOC_MEASUREMENT status_schaltart_svh_has_sbe /end LOC_MEASUREMENT /end FUNCTION
/begin FUNCTION SFOp_Zus464_Bitwise_AND_ui8 "" /begin LOC_MEASUREMENT status_schaltart_svh_has_sbe /end LOC_MEASUREMENT /end FUNCTION
/begin FUNCTION SFOp_Zus465_Bitwise_AND_ui8 "" /begin DEF_CHARACTERISTIC SCHALTART_VMABFLAUSBED_SRT_ZUS /end DEF_CHARACTERISTIC /begin LOC_MEASUREMENT status_schaltart_svh_has_sbe /end LOC_MEASUREMENT /end FUNCTION
/begin FUNCTION SFOp_Zus466_Bitwise_AND_ui8 "" /begin LOC_MEASUREMENT status_schaltart_svh_has_sbe /end LOC_MEASUREMENT /end FUNCTION
/begin FUNCTION SFOp_Zus467_Bitwise_AND_ui8_1 "" /begin LOC_MEASUREMENT status_schaltart_svh_has_sbe /end LOC_MEASUREMENT /end FUNCTION
/begin FUNCTION SFOp_Zus468_Bitwise_AND_ui8_2 "" /begin LOC_MEASUREMENT status_schaltart_svh_has_sbe /end LOC_MEASUREMENT /end FUNCTION
/begin FUNCTION SFOp_Zus59_Initialisierung "" /begin DEF_CHARACTERISTIC STATUS_ABL_SCL_ZUS /end DEF_CHARACTERISTIC /begin LOC_MEASUREMENT st_ablauf_fkt status_ablauf_has_fkt /end LOC_MEASUREMENT /end FUNCTION
/begin RECORD_LAYOUT FLOAT32_IEEE_COL_DIRECT_M_S7_S3 FNC_VALUES 1 FLOAT32_IEEE COLUMN_DIR DIRECT /end RECORD_LAYOUT
/begin RECORD_LAYOUT FLOAT32_IEEE_X_INCR_DIRECT_M_S7_S3 AXIS_PTS_X 1 FLOAT32_IEEE INDEX_INCR DIRECT /end RECORD_LAYOUT
/begin RECORD_LAYOUT SBYTE_COL_DIRECT_M_S7_S3 FNC_VALUES 1 SBYTE COLUMN_DIR DIRECT /end RECORD_LAYOUT
/begin RECORD_LAYOUT SBYTE_X_INCR_DIRECT_M_S7_S3 AXIS_PTS_X 1 SBYTE INDEX_INCR DIRECT /end RECORD_LAYOUT
/begin RECORD_LAYOUT UBYTE_COL_DIRECT_M_S7_S3 FNC_VALUES 1 UBYTE COLUMN_DIR DIRECT /end RECORD_LAYOUT
/begin RECORD_LAYOUT UWORD_X_INCR_DIRECT_M_S7_S3 AXIS_PTS_X 1 UWORD INDEX_INCR DIRECT /end RECORD_LAYOUT
/end MODULE
/end PROJECT
