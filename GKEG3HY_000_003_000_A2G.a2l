ASAP2_VERSION 1 51
/begin PROJECT _929_929 "Gen2_BMW_System_Supplier_Lib"
/begin HEADER "" VERSION "C_03_03" PROJECT_NO _929_929 /end HEADER
/begin MODULE DIM ""
/begin MOD_COMMON "" BYTE_ORDER MSB_FIRST ALIGNMENT_BYTE 1 ALIGNMENT_WORD 2 ALIGNMENT_LONG 4 ALIGNMENT_FLOAT32_IEEE 4 /end MOD_COMMON
/begin CHARACTERISTIC BM_SCHALTARTNEMMODRS_SYN_ANS "Bitmaske zur Festlegung der Schaltart der RS zur Anhebung der modifizierten EM- Drehzahl als Basisdrehzahl zur Bestimmung der VM Solldrehzahl bei RS beim K0 Synchronisieren beim Schleppstart" VALUE 0x26F11E UBYTE_COL_DIRECT_M_S7_S3 0 void_int_M_S7_S3 0 255 /end CHARACTERISTIC
/begin CHARACTERISTIC CS_GETR_RESPPARAL_SRT_ANS "Temperaturabfrage zur Freigabe von SLST SCHLTG" VALUE 0x26AA7C FLOAT32_IEEE_COL_DIRECT_M_S7_S3 0 c_fl_M_S7_S3 -3.40282E+038 3.40282E+038 /end CHARACTERISTIC
/begin CHARACTERISTIC F_NDSOLLIAESTAT_KON_ANS "Gewichtungsfaktor fuer nd_ziel_iae_stat im Zustand KON -> SYN" VALUE 0x26AA98 FLOAT32_IEEE_COL_DIRECT_M_S7_S3 0 void_fl_M_S7_S3 0 5 /end CHARACTERISTIC
/begin CHARACTERISTIC FK_NSOLLVM_KON_ANS "Filterung der VM-Solldrehzahl im Zustand Konditionieren beim Schleppstart" VALUE 0x26AA84 FLOAT32_IEEE_COL_DIRECT_M_S7_S3 0 t_fl_M_S7_S3 0 1 /end CHARACTERISTIC
/begin CHARACTERISTIC FK_NSOLLVM_SST_ANS "Filterung der VM-Solldrehzahl im Zustand Anschleppen beim Schleppstart" VALUE 0x26AA8C FLOAT32_IEEE_COL_DIRECT_M_S7_S3 0 t_fl_M_S7_S3 0 1 /end CHARACTERISTIC
/begin CHARACTERISTIC FK_NSOLLVM_SYN_ANS "Filterung der VM-Solldrehzahl im Zustand K0 Synchronissieren beim Schleppstart" VALUE 0x26AA90 FLOAT32_IEEE_COL_DIRECT_M_S7_S3 0 t_fl_M_S7_S3 0 1 /end CHARACTERISTIC
/begin CHARACTERISTIC K_MSTOERKPL_KON_ANS "Gewichtungsfaktor auf das Kupplungsmoment zur Berechnung des Stoermoments im Zustand KON" VALUE 0x26AAA4 FLOAT32_IEEE_COL_DIRECT_M_S7_S3 0 void_fl_M_S7_S3 0 5 /end CHARACTERISTIC
/begin CHARACTERISTIC K_MSTOERKPL_SST_ANS "Gewichtungsfaktor auf das Kupplungsmoment zur Berechnung des Stoermoments im Zustand SST" VALUE 0x26AAA8 FLOAT32_IEEE_COL_DIRECT_M_S7_S3 0 void_fl_M_S7_S3 0 5 /end CHARACTERISTIC
/begin CHARACTERISTIC K_MSTOERKPL_SYN_ANS "Gewichtungsfaktor auf das Kupplungsmoment zur Berechnung des Stoermoments im Zustand SYN" VALUE 0x26AAAC FLOAT32_IEEE_COL_DIRECT_M_S7_S3 0 void_fl_M_S7_S3 0 5 /end CHARACTERISTIC
/begin CHARACTERISTIC K_MZIELNOEMNSOLLVM_KON_ANS "Faktor zur Gewichtung des VM-Zielmoment der HAS aus der Fahrpedal-Interpretation zur  Bestimmung der VM-Solldrehzahl ab dem Zustand Konditionieren und in dem Zustanden Schaltung aktiv beim Schleppstart" VALUE 0x26AAB4 FLOAT32_IEEE_COL_DIRECT_M_S7_S3 0 void_fl_M_S7_S3 0 5 /end CHARACTERISTIC
/begin CHARACTERISTIC K_NOEMNSOLLVMOKS_KON_ANS "Faktor fuer Gewichtung des Drehzahloffsets bei der Bestimmung der VM-Solldrehzahl ohne Kraftschluss ab dem Zustand Konditionieren und in dem Zustand Schaltung aktiv beim Schleppstart." VALUE 0x26AAB8 FLOAT32_IEEE_COL_DIRECT_M_S7_S3 0 void_fl_M_S7_S3 0 1 /end CHARACTERISTIC
/begin CHARACTERISTIC K_SVH_RESET_RESPPARAL_SCL_ANS "Bedingtes Ruecksetzen einer Schaltverhinderung waehrend VM-Schleppstart im Zustand Konditionieren und SLST SCHLTG (255=alle Arten von Schaltungen zuruecksetzen, 0= keine Schltg. zuruecksetzen) -> Bit Codierung siehe Handbuch" VALUE 0x26F120 UBYTE_COL_DIRECT_M_S7_S3 0 void_int_M_S7_S3 0 255 /end CHARACTERISTIC
/begin CHARACTERISTIC K_SVH_RESET_RESPPARAL_SRT_ANS "Bedingtes Ruecksetzen einer Schaltverhinderung waehrend VM-Schleppstart im Zustand Anschleppen und SLST SCHLTG (255=alle Arten von Schaltugne zuruecksetzen, 0= keine Schltg. zuruecksetzen) -> Bit Codierung siehe Handbuch" VALUE 0x26F121 UBYTE_COL_DIRECT_M_S7_S3 0 void_int_M_S7_S3 0 255 /end CHARACTERISTIC
/begin CHARACTERISTIC K_SVH_RESET_RESPPARAL_SST_ANS "Bedingtes Ruecksetzen einer Schaltverhinderung waehrend VM-Schleppstart im Zustand Anschleppen waehrend Response SLST V2 (255=alle Arten von Schaltugne zuruecksetzen, 0= keine Schltg. zuruecksetzen) Bit Codierung siehe Handbuch" VALUE 0x26F122 UBYTE_COL_DIRECT_M_S7_S3 0 void_int_M_S7_S3 0 255 /end CHARACTERISTIC
/begin CHARACTERISTIC K_SVH_RESET_RESPPARAL_SYN_ANS "Bedingtes Ruecksetzen einer Schaltverhinderung waehrend VM-Schleppstart im Zustand Konditionieren und SLST SCHLTG (255=alle Arten von Schaltungen zuruecksetzen, 0= keine Schltg. zuruecksetzen) -> Bit Codierung siehe Handbuch" VALUE 0x26F123 UBYTE_COL_DIRECT_M_S7_S3 0 void_int_M_S7_S3 0 255 /end CHARACTERISTIC
/begin CHARACTERISTIC K_SVH_RESET_RESPTEILPAR_SCL_ANS "Bedingtes Ruecksetzen einer Schaltverhinderung waehrend VM-Schleppstart im Zustand Zuenden (255=alle Arten von Schaltugne zuruecksetzen, 0= keine Schltg. zuruecksetzen) -> Bit Codierung siehe Handbuch" VALUE 0x26F125 UBYTE_COL_DIRECT_M_S7_S3 0 void_int_M_S7_S3 0 255 /end CHARACTERISTIC
/begin CHARACTERISTIC K_SVH_RESET_RESPTEILPAR_SYN_ANS "Bedingtes Ruecksetzen einer Schaltverhinderung waehrend VM-Schleppstart im Zustand Zuenden (255=alle Arten von Schaltugne zuruecksetzen, 0= keine Schltg. zuruecksetzen) -> Bit Codierung siehe Handbuch" VALUE 0x26F126 UBYTE_COL_DIRECT_M_S7_S3 0 void_int_M_S7_S3 0 255 /end CHARACTERISTIC
/begin CHARACTERISTIC KF_ABLV_RESPPARAL_SRT_ANS_W "Variantenabfrage zur Freigabe ds parallelen Schleppstart Schaltung" MAP 0x26A8D8 UBYTE_COL_DIRECT_M_S7_S3 0 void_fl_s_M_S7_S3 0 1
 /begin AXIS_DESCR COM_AXIS NO_INPUT_QUANTITY c_fl_t_M_S7_S3 10 -1 8 AXIS_PTS_REF KF_ABLV_RESPPARAL_SRT_ANS_X /end AXIS_DESCR
 /begin AXIS_DESCR COM_AXIS NO_INPUT_QUANTITY void_int_M_S7_S3 8 0 15 AXIS_PTS_REF KF_ABLV_RESPPARAL_SRT_ANS_Y /end AXIS_DESCR
/end CHARACTERISTIC
/begin CHARACTERISTIC KF_FFKMSTOERKPL_ANS_W "Faktor KF_FFKMSTOERKPL_ANS = f(m_mot_in,m_wunsch_fpw_hst_in) auf KF_FKMSTOERKPL_ANS" MAP 0x264AD0 FLOAT32_IEEE_COL_DIRECT_M_S7_S3 0 trq_fl_a_M_S7_S3 0 100
 /begin AXIS_DESCR COM_AXIS m_mot_in trq_fl_a_M_S7_S3 8 -3.40282E+038 3.40282E+038 AXIS_PTS_REF KF_FFKMSTOERKPL_ANS_X /end AXIS_DESCR
 /begin AXIS_DESCR COM_AXIS m_wunsch_fpw_hst_in trq_fl_a_M_S7_S3 8 -3.40282E+038 3.40282E+038 AXIS_PTS_REF KF_FFKMSTOERKPL_ANS_Y /end AXIS_DESCR
/end CHARACTERISTIC
/begin CHARACTERISTIC KF_FKMSTOERKPL_ANS_W "Filterzeitkonstante m_stoer_k0_em =f(c_getriebe_egs_in, m_stoer_k0_em_fil)" MAP 0x264C10 FLOAT32_IEEE_COL_DIRECT_M_S7_S3 0 t_fl_M_S7_S3 -3.40282E+038 3.40282E+038
 /begin AXIS_DESCR COM_AXIS c_getriebe_egs_in c_fl_M_S7_S3 8 -3.40282E+038 3.40282E+038 AXIS_PTS_REF KF_FKMSTOERKPL_ANS_X /end AXIS_DESCR
 /begin AXIS_DESCR COM_AXIS NO_INPUT_QUANTITY trq_fl_a_M_S7_S3 8 -3.40282E+038 3.40282E+038 AXIS_PTS_REF KF_FKMSTOERKPL_ANS_Y /end AXIS_DESCR
/end CHARACTERISTIC
/begin CHARACTERISTIC KF_FKNMOTSOLLIAEPT1_ANS_W "Filterzeit fuer PT1 Filter zur Berechnung von n_mot_soll_iae_fil_in" MAP 0x264D50 FLOAT32_IEEE_COL_DIRECT_M_S7_S3 0 t_fl_M_S7_S3 0 2
 /begin AXIS_DESCR COM_AXIS nd_nmotsolliaefilt_ans n_fl_M_S7_S3 8 -3.40282E+038 3.40282E+038 AXIS_PTS_REF KF_FKNMOTSOLLIAEPT1_ANS_X /end AXIS_DESCR
 /begin AXIS_DESCR COM_AXIS NO_INPUT_QUANTITY sts_int_r_M_S7_S3 2 0 1 AXIS_PTS_REF KF_FKNMOTSOLLIAEPT1_ANS_Y /end AXIS_DESCR
/end CHARACTERISTIC
/begin CHARACTERISTIC KF_FKNMOTSOLLIAEPT2_ANS_W "Filterzeit fuer den zweiten PT1 Filter zur Berechnung von n_mot_soll_iae_fil_in" MAP 0x264DB8 FLOAT32_IEEE_COL_DIRECT_M_S7_S3 0 t_fl_M_S7_S3 0 2
 /begin AXIS_DESCR COM_AXIS nd_nmotsolliaefilt_ans n_fl_M_S7_S3 8 -3.40282E+038 3.40282E+038 AXIS_PTS_REF KF_FKNMOTSOLLIAEPT2_ANS_X /end AXIS_DESCR
 /begin AXIS_DESCR COM_AXIS NO_INPUT_QUANTITY sts_int_r_M_S7_S3 2 0 1 AXIS_PTS_REF KF_FKNMOTSOLLIAEPT2_ANS_Y /end AXIS_DESCR
/end CHARACTERISTIC
/begin CHARACTERISTIC KF_FMOSTOERKPL_ANS_W "Faktor fuer KF_MOSTOERKPL_ANS" MAP 0x264F60 FLOAT32_IEEE_COL_DIRECT_M_S7_S3 0 void_fl_M_S7_S3 0 5
 /begin AXIS_DESCR COM_AXIS nd_k0_in t_fl_M_S7_S3 10 -3.40282E+038 3.40282E+038 AXIS_PTS_REF KF_FMOSTOERKPL_ANS_X /end AXIS_DESCR
 /begin AXIS_DESCR COM_AXIS n_em_in trq_fl_a_M_S7_S3 8 -3.40282E+038 3.40282E+038 AXIS_PTS_REF KF_FMOSTOERKPL_ANS_Y /end AXIS_DESCR
/end CHARACTERISTIC
/begin CHARACTERISTIC KF_FMOSTOERKPLSCHALT_ANS_W "Faktor auf Momentoffset gerech. auf m_stoer_kpl im Falle RespSchleppstart" MAP 0x264E20 FLOAT32_IEEE_COL_DIRECT_M_S7_S3 0 void_fl_M_S7_S3 0 3.40282E+038
 /begin AXIS_DESCR COM_AXIS m_mot_in trq_fl_a_M_S7_S3 8 -3.40282E+038 3.40282E+038 AXIS_PTS_REF KF_FMOSTOERKPLSCHALT_ANS_X /end AXIS_DESCR
 /begin AXIS_DESCR COM_AXIS m_wunsch_fpw_hst_in trq_fl_a_M_S7_S3 8 -3.40282E+038 3.40282E+038 AXIS_PTS_REF KF_FMOSTOERKPLSCHALT_ANS_Y /end AXIS_DESCR
/end CHARACTERISTIC
/begin CHARACTERISTIC KF_FMSTOERKPL_ANS_W "Faktor zur Berechnung EM-Vorsteuermoment vor PT2 Filter" MAP 0x2650E8 FLOAT32_IEEE_COL_DIRECT_M_S7_S3 0 void_fl_M_S7_S3 0 1
 /begin AXIS_DESCR COM_AXIS NO_INPUT_QUANTITY tc_fl_M_S7_S3 10 -3.40282E+038 3.40282E+038 AXIS_PTS_REF KF_FMSTOERKPL_ANS_X /end AXIS_DESCR
 /begin AXIS_DESCR COM_AXIS NO_INPUT_QUANTITY trq_fl_a_M_S7_S3 8 -3.40282E+038 3.40282E+038 AXIS_PTS_REF KF_FMSTOERKPL_ANS_Y /end AXIS_DESCR
/end CHARACTERISTIC
/begin CHARACTERISTIC KF_FNDSOLLIAE_KON_ANS_W "Gewichtungsfaktor fuer Berechnung flag_ndiae_erreicht" MAP 0x2653F8 FLOAT32_IEEE_COL_DIRECT_M_S7_S3 0 VOID_SCALING_M_S7_S3 0 5
 /begin AXIS_DESCR COM_AXIS NO_INPUT_QUANTITY t_fl_M_S7_S3 8 0 5 AXIS_PTS_REF KF_FNDSOLLIAE_KON_ANS_X /end AXIS_DESCR
 /begin AXIS_DESCR COM_AXIS NO_INPUT_QUANTITY void_int_q_M_S7_S3 10 -3.40282346639E+038 3.40282346639E+038 AXIS_PTS_REF KF_FNDSOLLIAE_KON_ANS_Y /end AXIS_DESCR
/end CHARACTERISTIC
/begin CHARACTERISTIC KF_KOLBPOSINIT_RESP_SCHALT_ANS_W "Kolbenpositionsschwelle zur Aktiveriung von m_stoer_k0_em_fil in Prozent" MAP 0x2656C0 FLOAT32_IEEE_COL_DIRECT_M_S7_S3 0 void_int_q_M_S7_S3 0 100
 /begin AXIS_DESCR COM_AXIS c_getriebe_egs_in c_fl_M_S7_S3 8 -3.40282E+038 3.40282E+038 AXIS_PTS_REF KF_KOLBPOSINIT_RESP_SCHALT_ANS_X /end AXIS_DESCR
 /begin AXIS_DESCR COM_AXIS NO_INPUT_QUANTITY trq_fl_a_M_S7_S3 8 -3.40282E+038 3.40282E+038 AXIS_PTS_REF KF_KOLBPOSINIT_RESP_SCHALT_ANS_Y /end AXIS_DESCR
/end CHARACTERISTIC
/begin CHARACTERISTIC KF_KOLBPOSINITTIMER_ANS_W "Kolbenpositionsschwelle zur Aktiveriung von m_stoer_k0_em_fil in Prozent" MAP 0x265580 FLOAT32_IEEE_COL_DIRECT_M_S7_S3 0 void_int_q_M_S7_S3 0 100
 /begin AXIS_DESCR COM_AXIS c_getriebe_egs_in c_fl_M_S7_S3 8 -3.40282E+038 3.40282E+038 AXIS_PTS_REF KF_KOLBPOSINITTIMER_ANS_X /end AXIS_DESCR
 /begin AXIS_DESCR COM_AXIS NO_INPUT_QUANTITY trq_fl_a_M_S7_S3 8 -3.40282E+038 3.40282E+038 AXIS_PTS_REF KF_KOLBPOSINITTIMER_ANS_Y /end AXIS_DESCR
/end CHARACTERISTIC
/begin CHARACTERISTIC KF_MGK0NDK0M_SCHUB_SYN_ANS_W "Momentgradient der K0 im nichtentkoppeltem Zustand" MAP 0x265E40 FLOAT32_IEEE_COL_DIRECT_M_S7_S3 0 trqg_fl_k_M_S7_S3 -10000 10000
 /begin AXIS_DESCR COM_AXIS NO_INPUT_QUANTITY n_fl_M_S7_S3 7 -3.40282E+038 3.40282E+038 AXIS_PTS_REF KF_MGK0NDK0M_SCHUB_SYN_ANS_X /end AXIS_DESCR
 /begin AXIS_DESCR COM_AXIS m_ziel_vm_has_ans ng_fl_M_S7_S3 6 -3.40282E+038 3.40282E+038 AXIS_PTS_REF KF_MGK0NDK0M_SCHUB_SYN_ANS_Y /end AXIS_DESCR
/end CHARACTERISTIC
/begin CHARACTERISTIC KF_MGK0NDK0M_SYN_ANS_W "Ausgabe Gradient Kupplungsmoment in Abh. von nd_k0_in und ndg_k0_in" MAP 0x265FF8 FLOAT32_IEEE_COL_DIRECT_M_S7_S3 0 trqg_fl_k_M_S7_S3 -10000 10000
 /begin AXIS_DESCR COM_AXIS NO_INPUT_QUANTITY n_fl_M_S7_S3 7 -3.40282E+038 3.40282E+038 AXIS_PTS_REF KF_MGK0NDK0M_SYN_ANS_X /end AXIS_DESCR
 /begin AXIS_DESCR COM_AXIS m_ziel_vm_has_ans trq_fl_a_M_S7_S3 6 -3.40282E+038 3.40282E+038 AXIS_PTS_REF KF_MGK0NDK0M_SYN_ANS_Y /end AXIS_DESCR
/end CHARACTERISTIC
/begin CHARACTERISTIC KF_MGK0NDK0M_SYNCDDA_SYN_ANS_W "Mindest-Gradient des K0-Sollmoments in Abhaengigkeit der K0 Differenzdrehzahl und dem VM Zielmoment bei durchdrehenden Antriebsraedern im Zustand K0-Synchronisieren beim Schleppstart" MAP 0x265F1C FLOAT32_IEEE_COL_DIRECT_M_S7_S3 0 trqg_fl_k_M_S7_S3 0 50000
 /begin AXIS_DESCR COM_AXIS NO_INPUT_QUANTITY n_fl_M_S7_S3 7 -3.40282E+038 3.40282E+038 AXIS_PTS_REF KF_MGK0NDK0M_SYNCDDA_SYN_ANS_X /end AXIS_DESCR
 /begin AXIS_DESCR COM_AXIS m_ziel_vm_has_ans trq_fl_a_M_S7_S3 6 -3.40282E+038 3.40282E+038 AXIS_PTS_REF KF_MGK0NDK0M_SYNCDDA_SYN_ANS_Y /end AXIS_DESCR
/end CHARACTERISTIC
/begin CHARACTERISTIC KF_MGK0NDK0NGVM_SCHUB_SYN_ANS_W "Momentgradient der K0 im nichtentkoppeltem Zustand" MAP 0x2660D4 FLOAT32_IEEE_COL_DIRECT_M_S7_S3 0 trqg_fl_k_M_S7_S3 -10000 10000
 /begin AXIS_DESCR COM_AXIS NO_INPUT_QUANTITY n_fl_M_S7_S3 7 -3.40282E+038 3.40282E+038 AXIS_PTS_REF KF_MGK0NDK0NGVM_SCHUB_SYN_ANS_X /end AXIS_DESCR
 /begin AXIS_DESCR COM_AXIS NO_INPUT_QUANTITY ng_fl_M_S7_S3 6 -3.40282E+038 3.40282E+038 AXIS_PTS_REF KF_MGK0NDK0NGVM_SCHUB_SYN_ANS_Y /end AXIS_DESCR
/end CHARACTERISTIC
/begin CHARACTERISTIC KF_MGK0NDK0NGVM_SYN_ANS_W "Ausgabe Gradient Kupplungsmoment in Abh. von nd_k0_in und ndg_k0_in" MAP 0x2661B0 FLOAT32_IEEE_COL_DIRECT_M_S7_S3 0 trqg_fl_k_M_S7_S3 -10000 10000
 /begin AXIS_DESCR COM_AXIS NO_INPUT_QUANTITY n_fl_M_S7_S3 7 -3.40282E+038 3.40282E+038 AXIS_PTS_REF KF_MGK0NDK0NGVM_SYN_ANS_X /end AXIS_DESCR
 /begin AXIS_DESCR COM_AXIS NO_INPUT_QUANTITY ng_fl_M_S7_S3 6 -3.40282E+038 3.40282E+038 AXIS_PTS_REF KF_MGK0NDK0NGVM_SYN_ANS_Y /end AXIS_DESCR
/end CHARACTERISTIC
/begin CHARACTERISTIC KF_MGSOLLK0VMMIN_SST_ANS_W "Gradient des K0-Sollmoments Rampe 1" MAP 0x2664A8 FLOAT32_IEEE_COL_DIRECT_M_S7_S3 0 trqg_fl_k_M_S7_S3 -10000 10000
 /begin AXIS_DESCR COM_AXIS NO_INPUT_QUANTITY sts_int_r_M_S7_S3 8 0 255 AXIS_PTS_REF KF_MGSOLLK0VMMIN_SST_ANS_X /end AXIS_DESCR
 /begin AXIS_DESCR COM_AXIS NO_INPUT_QUANTITY phi_fl_M_S7_S3 8 -3.40282E+038 3.40282E+038 AXIS_PTS_REF KF_MGSOLLK0VMMIN_SST_ANS_Y /end AXIS_DESCR
/end CHARACTERISTIC
/begin CHARACTERISTIC KF_MGSOLLK0VMMINRS_SST_ANS_W "Gradient des K0-Sollmoments Rampe 1 mit Schaltung" MAP 0x2663CC FLOAT32_IEEE_COL_DIRECT_M_S7_S3 0 trqg_fl_k_M_S7_S3 -10000 10000
 /begin AXIS_DESCR COM_AXIS NO_INPUT_QUANTITY trq_fl_a_M_S7_S3 6 -3.40282E+038 3.40282E+038 AXIS_PTS_REF KF_MGSOLLK0VMMINRS_SST_ANS_X /end AXIS_DESCR
 /begin AXIS_DESCR COM_AXIS NO_INPUT_QUANTITY trq_fl_a_M_S7_S3 7 0 360 AXIS_PTS_REF KF_MGSOLLK0VMMINRS_SST_ANS_Y /end AXIS_DESCR
/end CHARACTERISTIC
/begin CHARACTERISTIC KF_MGSOLLK0VMSTART_SST_ANS_W "Gradient des K0-Sollmoments Rampe 2" MAP 0x2666C4 FLOAT32_IEEE_COL_DIRECT_M_S7_S3 0 trqg_fl_k_M_S7_S3 -10000 10000
 /begin AXIS_DESCR COM_AXIS NO_INPUT_QUANTITY sts_int_r_M_S7_S3 8 0 255 AXIS_PTS_REF KF_MGSOLLK0VMSTART_SST_ANS_X /end AXIS_DESCR
 /begin AXIS_DESCR COM_AXIS NO_INPUT_QUANTITY phi_fl_M_S7_S3 8 -3.40282E+038 3.40282E+038 AXIS_PTS_REF KF_MGSOLLK0VMSTART_SST_ANS_Y /end AXIS_DESCR
/end CHARACTERISTIC
/begin CHARACTERISTIC KF_MGSOLLK0VMSTARTRS_SST_ANS_W "Gradient des K0-Sollmoments Rampe 2 mit Schaltung" MAP 0x2665E8 FLOAT32_IEEE_COL_DIRECT_M_S7_S3 0 trqg_fl_k_M_S7_S3 -10000 10000
 /begin AXIS_DESCR COM_AXIS NO_INPUT_QUANTITY trq_fl_a_M_S7_S3 6 -3.40282E+038 3.40282E+038 AXIS_PTS_REF KF_MGSOLLK0VMSTARTRS_SST_ANS_X /end AXIS_DESCR
 /begin AXIS_DESCR COM_AXIS NO_INPUT_QUANTITY trq_fl_a_M_S7_S3 7 0 360 AXIS_PTS_REF KF_MGSOLLK0VMSTARTRS_SST_ANS_Y /end AXIS_DESCR
/end CHARACTERISTIC
/begin CHARACTERISTIC KF_MGZIELMAXEM_KON_ANS_W "Gradient des Maximalmoments des EM-Drehzahlreglers" MAP 0x266804 FLOAT32_IEEE_COL_DIRECT_M_S7_S3 0 trqg_fl_k_M_S7_S3 0 50000
 /begin AXIS_DESCR COM_AXIS NO_INPUT_QUANTITY trq_fl_a_M_S7_S3 8 -1000 1000 AXIS_PTS_REF KF_MGZIELMAXEM_KON_ANS_X /end AXIS_DESCR
 /begin AXIS_DESCR COM_AXIS nd_iae_ans n_fl_M_S7_S3 7 -10000 10000 AXIS_PTS_REF KF_MGZIELMAXEM_KON_ANS_Y /end AXIS_DESCR
/end CHARACTERISTIC
/begin CHARACTERISTIC KF_MGZIELMINEM_KON_ANS_W "Gradient des Minimalmoments des EM-Drehzahlreglers" MAP 0x266920 FLOAT32_IEEE_COL_DIRECT_M_S7_S3 0 trqg_fl_k_M_S7_S3 0 50000
 /begin AXIS_DESCR COM_AXIS NO_INPUT_QUANTITY trq_fl_a_M_S7_S3 8 -1000 1000 AXIS_PTS_REF KF_MGZIELMINEM_KON_ANS_X /end AXIS_DESCR
 /begin AXIS_DESCR COM_AXIS nd_iae_ans n_fl_M_S7_S3 7 -10000 10000 AXIS_PTS_REF KF_MGZIELMINEM_KON_ANS_Y /end AXIS_DESCR
/end CHARACTERISTIC
/begin CHARACTERISTIC KF_MK0MMOTNVM1_SCHUB_SST_ANS_W "K0-Zielmoment fuer Rampe 1 im Schub in der Phase SST" MAP 0x266CBC FLOAT32_IEEE_COL_DIRECT_M_S7_S3 0 trq_fl_a_M_S7_S3 -1000 1000
 /begin AXIS_DESCR COM_AXIS NO_INPUT_QUANTITY trq_fl_a_M_S7_S3 8 -1000 1000 AXIS_PTS_REF KF_MK0MMOTNVM1_SCHUB_SST_ANS_X /end AXIS_DESCR
 /begin AXIS_DESCR COM_AXIS NO_INPUT_QUANTITY n_fl_M_S7_S3 8 -10000 10000 AXIS_PTS_REF KF_MK0MMOTNVM1_SCHUB_SST_ANS_Y /end AXIS_DESCR
/end CHARACTERISTIC
/begin CHARACTERISTIC KF_MK0MMOTNVM1_SST_ANS_W "K0-Zielmoment fuer Rampe 1 in der Phase SST" MAP 0x266DFC FLOAT32_IEEE_COL_DIRECT_M_S7_S3 0 trq_fl_a_M_S7_S3 -1000 1000
 /begin AXIS_DESCR COM_AXIS NO_INPUT_QUANTITY trq_fl_a_M_S7_S3 8 -1000 1000 AXIS_PTS_REF KF_MK0MMOTNVM1_SST_ANS_X /end AXIS_DESCR
 /begin AXIS_DESCR COM_AXIS NO_INPUT_QUANTITY n_fl_M_S7_S3 8 -10000 10000 AXIS_PTS_REF KF_MK0MMOTNVM1_SST_ANS_Y /end AXIS_DESCR
/end CHARACTERISTIC
/begin CHARACTERISTIC KF_MK0MMOTNVM2_SCHUB_SST_ANS_W "K0-Zielmoment fuer Rampe 2 im Schub in der Phase SST" MAP 0x266F3C FLOAT32_IEEE_COL_DIRECT_M_S7_S3 0 trq_fl_a_M_S7_S3 -1000 1000
 /begin AXIS_DESCR COM_AXIS NO_INPUT_QUANTITY trq_fl_a_M_S7_S3 8 -3.40282E+038 3.40282E+038 AXIS_PTS_REF KF_MK0MMOTNVM2_SCHUB_SST_ANS_X /end AXIS_DESCR
 /begin AXIS_DESCR COM_AXIS NO_INPUT_QUANTITY n_fl_M_S7_S3 8 -3.40282E+038 3.40282E+038 AXIS_PTS_REF KF_MK0MMOTNVM2_SCHUB_SST_ANS_Y /end AXIS_DESCR
/end CHARACTERISTIC
/begin CHARACTERISTIC KF_MK0MMOTNVM2_SST_ANS_W "K0-Zielmoment fuer Rampe 2 in der Phase SST" MAP 0x26707C FLOAT32_IEEE_COL_DIRECT_M_S7_S3 0 trq_fl_a_M_S7_S3 -1000 1000
 /begin AXIS_DESCR COM_AXIS NO_INPUT_QUANTITY trq_fl_a_M_S7_S3 8 -10000 10000 AXIS_PTS_REF KF_MK0MMOTNVM2_SST_ANS_X /end AXIS_DESCR
 /begin AXIS_DESCR COM_AXIS NO_INPUT_QUANTITY n_fl_M_S7_S3 8 -10000 10000 AXIS_PTS_REF KF_MK0MMOTNVM2_SST_ANS_Y /end AXIS_DESCR
/end CHARACTERISTIC
/begin CHARACTERISTIC KF_MMOT_LASTWECHSEL_SRT_ANS_W "Kennfeld zur Erkennung Lastwechsel in der Phase Start" MAP 0x26743C FLOAT32_IEEE_COL_DIRECT_M_S7_S3 0 trq_fl_a_M_S7_S3 -3.40282E+038 3.40282E+038
 /begin AXIS_DESCR COM_AXIS NO_INPUT_QUANTITY void_int_q_M_S7_S3 10 -3.40282346639E+038 3.40282346639E+038 AXIS_PTS_REF KF_MMOT_LASTWECHSEL_SRT_ANS_X /end AXIS_DESCR
 /begin AXIS_DESCR COM_AXIS NO_INPUT_QUANTITY trqg_fl_k_M_S7_S3 6 -3.40282E+038 3.40282E+038 AXIS_PTS_REF KF_MMOT_LASTWECHSEL_SRT_ANS_Y /end AXIS_DESCR
/end CHARACTERISTIC
/begin CHARACTERISTIC KF_MMOT_RESPPAR_SCHUB_KON_ANS_W "Momentenschwelle um Zug fuer SCHLT SLTG zu erkennen" MAP 0x2676AC FLOAT32_IEEE_COL_DIRECT_M_S7_S3 0 trq_fl_a_M_S7_S3 -3.40282E+038 3.40282E+038
 /begin AXIS_DESCR COM_AXIS NO_INPUT_QUANTITY c_fl_M_S7_S3 8 -3.40282E+038 3.40282E+038 AXIS_PTS_REF KF_MMOT_RESPPAR_SCHUB_KON_ANS_X /end AXIS_DESCR
 /begin AXIS_DESCR COM_AXIS NO_INPUT_QUANTITY void_int_q_M_S7_S3 8 -3.40282346639E+038 3.40282346639E+038 AXIS_PTS_REF KF_MMOT_RESPPAR_SCHUB_KON_ANS_Y /end AXIS_DESCR
/end CHARACTERISTIC
/begin CHARACTERISTIC KF_MMOT_RESPPARAL_SRT_ANS_W "Summenmomentenabfrage zur Freigabe des parallelen Schleppstart Schaltung" MAP 0x26756C FLOAT32_IEEE_COL_DIRECT_M_S7_S3 0 trq_fl_a_M_S7_S3 -3.40282E+038 3.40282E+038
 /begin AXIS_DESCR COM_AXIS NO_INPUT_QUANTITY c_fl_M_S7_S3 8 -3.40282E+038 3.40282E+038 AXIS_PTS_REF KF_MMOT_RESPPARAL_SRT_ANS_X /end AXIS_DESCR
 /begin AXIS_DESCR COM_AXIS NO_INPUT_QUANTITY void_int_q_M_S7_S3 8 -3.40282346639E+038 3.40282346639E+038 AXIS_PTS_REF KF_MMOT_RESPPARAL_SRT_ANS_Y /end AXIS_DESCR
/end CHARACTERISTIC
/begin CHARACTERISTIC KF_MO_K0BEFUELL_NORM_CGET_ANS_W "Momentoffset fuer die K0-Stoermomentberechnung waehrend einer normalen K0-Befuellung beim SLST" MAP 0x267EBC FLOAT32_IEEE_COL_DIRECT_M_S7_S3 0 trq_fl_a_M_S7_S3 0 1000
 /begin AXIS_DESCR COM_AXIS NO_INPUT_QUANTITY rel_fl_M_S7_S3 11 0 200 AXIS_PTS_REF KF_MO_K0BEFUELL_NORM_CGET_ANS_X /end AXIS_DESCR
 /begin AXIS_DESCR COM_AXIS c_getriebe_egs_in c_fl_M_S7_S3 8 -50 200 AXIS_PTS_REF KF_MO_K0BEFUELL_NORM_CGET_ANS_Y /end AXIS_DESCR
/end CHARACTERISTIC
/begin CHARACTERISTIC KF_MO_K0BEFUELL_OPT_CGET_ANS_W "Momentoffset fuer die K0-Stoermomentberechnung waehrend einer optimierten K0-Befuellung beim SLST" MAP 0x268068 FLOAT32_IEEE_COL_DIRECT_M_S7_S3 0 trq_fl_a_M_S7_S3 0 1000
 /begin AXIS_DESCR COM_AXIS NO_INPUT_QUANTITY rel_fl_M_S7_S3 11 0 200 AXIS_PTS_REF KF_MO_K0BEFUELL_OPT_CGET_ANS_X /end AXIS_DESCR
 /begin AXIS_DESCR COM_AXIS c_getriebe_egs_in c_fl_M_S7_S3 8 -50 200 AXIS_PTS_REF KF_MO_K0BEFUELL_OPT_CGET_ANS_Y /end AXIS_DESCR
/end CHARACTERISTIC
/begin CHARACTERISTIC KF_MO_K0BEFUELL_RED_CGET_ANS_W "Momentoffset fuer die K0-Stoermomentberechnung waehrend einer reduzierten K0-Befuellung beim SLST" MAP 0x268214 FLOAT32_IEEE_COL_DIRECT_M_S7_S3 0 trq_fl_a_M_S7_S3 0 1000
 /begin AXIS_DESCR COM_AXIS NO_INPUT_QUANTITY rel_fl_M_S7_S3 11 0 200 AXIS_PTS_REF KF_MO_K0BEFUELL_RED_CGET_ANS_X /end AXIS_DESCR
 /begin AXIS_DESCR COM_AXIS c_getriebe_egs_in c_fl_M_S7_S3 8 -50 200 AXIS_PTS_REF KF_MO_K0BEFUELL_RED_CGET_ANS_Y /end AXIS_DESCR
/end CHARACTERISTIC
/begin CHARACTERISTIC KF_MOK0ABSTELLPOS_SST_ANS_W "K0 Momentoffset aus der Abstellpos in der Phase SST" MAP 0x267AFC FLOAT32_IEEE_COL_DIRECT_M_S7_S3 0 trq_fl_a_M_S7_S3 -1000 1000
 /begin AXIS_DESCR COM_AXIS NO_INPUT_QUANTITY c_fl_M_S7_S3 8 -40 150 AXIS_PTS_REF KF_MOK0ABSTELLPOS_SST_ANS_X /end AXIS_DESCR
 /begin AXIS_DESCR COM_AXIS NO_INPUT_QUANTITY phi_fl_M_S7_S3 8 0 360 AXIS_PTS_REF KF_MOK0ABSTELLPOS_SST_ANS_Y /end AXIS_DESCR
/end CHARACTERISTIC
/begin CHARACTERISTIC KF_MOSTOERKPL_ANS_W "Momentoffset auf m_stoer_k0_em_has = f(z_ablaufvariante_has_stg, status_k0_in)" MAP 0x267D7C FLOAT32_IEEE_COL_DIRECT_M_S7_S3 0 trq_fl_a_M_S7_S3 -1000 1000
 /begin AXIS_DESCR COM_AXIS m_mot_in trq_fl_a_M_S7_S3 8 -1000 1000 AXIS_PTS_REF KF_MOSTOERKPL_ANS_X /end AXIS_DESCR
 /begin AXIS_DESCR COM_AXIS m_wunsch_fpw_hst_in trq_fl_a_M_S7_S3 8 -1000 1000 AXIS_PTS_REF KF_MOSTOERKPL_ANS_Y /end AXIS_DESCR
/end CHARACTERISTIC
/begin CHARACTERISTIC KF_MOSTOERKPLSCHALT_ANS_W "Momentoffset gerech. auf m_stoer_kpl im Falle RespSchleppstart" MAP 0x267C3C FLOAT32_IEEE_COL_DIRECT_M_S7_S3 0 void_fl_M_S7_S3 -1000 1000
 /begin AXIS_DESCR COM_AXIS NO_INPUT_QUANTITY n_fl_M_S7_S3 8 -10000 10000 AXIS_PTS_REF KF_MOSTOERKPLSCHALT_ANS_X /end AXIS_DESCR
 /begin AXIS_DESCR COM_AXIS NO_INPUT_QUANTITY n_fl_M_S7_S3 8 -10000 10000 AXIS_PTS_REF KF_MOSTOERKPLSCHALT_ANS_Y /end AXIS_DESCR
/end CHARACTERISTIC
/begin CHARACTERISTIC KF_MRESEMANFIAE_KON_ANS_W "Bestimmung Reservemoment im St_Konditionieren waehrend IAE Anfahren" MAP 0x2683C0 FLOAT32_IEEE_COL_DIRECT_M_S7_S3 0 trq_fl_a_M_S7_S3 -1000 1000
 /begin AXIS_DESCR COM_AXIS nd_iae_ans n_fl_M_S7_S3 8 -10000 10000 AXIS_PTS_REF KF_MRESEMANFIAE_KON_ANS_X /end AXIS_DESCR
 /begin AXIS_DESCR COM_AXIS NO_INPUT_QUANTITY void_int_q_M_S7_S3 10 -1 8 AXIS_PTS_REF KF_MRESEMANFIAE_KON_ANS_Y /end AXIS_DESCR
/end CHARACTERISTIC
/begin CHARACTERISTIC KF_MZIELK0BEFMODUS_SST_ANS_W "m_ziel_k0_ans, wenn status_k0befuellung_ans = FALSE im ab Anschleppen" MAP 0x268688 FLOAT32_IEEE_COL_DIRECT_M_S7_S3 0 trq_fl_a_M_S7_S3 -1000 1000
 /begin AXIS_DESCR COM_AXIS NO_INPUT_QUANTITY c_fl_M_S7_S3 8 -3.40282E+038 3.40282E+038 AXIS_PTS_REF KF_MZIELK0BEFMODUS_SST_ANS_X /end AXIS_DESCR
 /begin AXIS_DESCR COM_AXIS NO_INPUT_QUANTITY sts_int_r_M_S7_S3 3 0 2 AXIS_PTS_REF KF_MZIELK0BEFMODUS_SST_ANS_Y /end AXIS_DESCR
/end CHARACTERISTIC
/begin CHARACTERISTIC KF_MZIELMAXEM_KON_ANS_W "Zielmoment des Maximalmoments des EM-Drehzahlreglers" MAP 0x268D54 FLOAT32_IEEE_COL_DIRECT_M_S7_S3 0 trq_fl_a_M_S7_S3 0 1000
 /begin AXIS_DESCR COM_AXIS NO_INPUT_QUANTITY trq_fl_a_M_S7_S3 8 -1000 1000 AXIS_PTS_REF KF_MZIELMAXEM_KON_ANS_X /end AXIS_DESCR
 /begin AXIS_DESCR COM_AXIS nd_iae_ans n_fl_M_S7_S3 7 -10000 10000 AXIS_PTS_REF KF_MZIELMAXEM_KON_ANS_Y /end AXIS_DESCR
/end CHARACTERISTIC
/begin CHARACTERISTIC KF_MZIELMINEM_KON_ANS_W "Zielmoment des Minimalmoments des EM-Drehzahlreglers" MAP 0x268E70 FLOAT32_IEEE_COL_DIRECT_M_S7_S3 0 trq_fl_a_M_S7_S3 -1000 0
 /begin AXIS_DESCR COM_AXIS NO_INPUT_QUANTITY trq_fl_a_M_S7_S3 8 -1000 1000 AXIS_PTS_REF KF_MZIELMINEM_KON_ANS_X /end AXIS_DESCR
 /begin AXIS_DESCR COM_AXIS nd_iae_ans n_fl_M_S7_S3 7 -10000 10000 AXIS_PTS_REF KF_MZIELMINEM_KON_ANS_Y /end AXIS_DESCR
/end CHARACTERISTIC
/begin CHARACTERISTIC KF_NDEMNSOLLVM_ZND_ANS_W "Differenzdrehzahl zum Abbau des Drehzahloffset auf die Basis-Drehzahl zur Berechnung des Zielwerts der VM Solldrehzahl ab dem Zustand Zuenden beim Schleppstart" MAP 0x268F8C FLOAT32_IEEE_COL_DIRECT_M_S7_S3 0 n_fl_M_S7_S3 0 10000
 /begin AXIS_DESCR COM_AXIS NO_INPUT_QUANTITY n_fl_M_S7_S3 10 0 10000 AXIS_PTS_REF KF_NDEMNSOLLVM_ZND_ANS_X /end AXIS_DESCR
 /begin AXIS_DESCR COM_AXIS NO_INPUT_QUANTITY trq_fl_a_M_S7_S3 7 -1000 1000 AXIS_PTS_REF KF_NDEMNSOLLVM_ZND_ANS_Y /end AXIS_DESCR
/end CHARACTERISTIC
/begin CHARACTERISTIC KF_NDGSOLLIAE_KON_ANS_W "Drehzahlgradient fuer die EM-Solldrehzahl in den Phasen KON - SCL" MAP 0x2690E8 FLOAT32_IEEE_COL_DIRECT_M_S7_S3 0 ng_fl_M_S7_S3 -10000 10000
 /begin AXIS_DESCR COM_AXIS NO_INPUT_QUANTITY trq_fl_a_M_S7_S3 6 -1000 1000 AXIS_PTS_REF KF_NDGSOLLIAE_KON_ANS_X /end AXIS_DESCR
 /begin AXIS_DESCR COM_AXIS NO_INPUT_QUANTITY n_fl_M_S7_S3 7 -10000 10000 AXIS_PTS_REF KF_NDGSOLLIAE_KON_ANS_Y /end AXIS_DESCR
/end CHARACTERISTIC
/begin CHARACTERISTIC KF_NDSK0SYNCERK_SYN_ANS_W "Drehzahloffset auf die Basis-Drehzahl zur Berechnung des Zielwerts der VM Solldrehzahl ab dem Zustand Konditionieren und in dem Zustand Schaltung aktiv beim Schleppstart" MAP 0x2691C4 FLOAT32_IEEE_COL_DIRECT_M_S7_S3 0 void_fl_M_S7_S3 0 10000
 /begin AXIS_DESCR COM_AXIS ng_em_ans void_fl_M_S7_S3 5 -10000 10000 AXIS_PTS_REF KF_NDSK0SYNCERK_SYN_ANS_X /end AXIS_DESCR
 /begin AXIS_DESCR COM_AXIS NO_INPUT_QUANTITY sts_int_r_M_S7_S3 2 0 1 AXIS_PTS_REF KF_NDSK0SYNCERK_SYN_ANS_Y /end AXIS_DESCR
/end CHARACTERISTIC
/begin CHARACTERISTIC KF_NDSOLLIAE_KON_ANS_W "EM-Solldrehzahl in den Phasen KON - SCL" MAP 0x269208 FLOAT32_IEEE_COL_DIRECT_M_S7_S3 0 n_fl_M_S7_S3 -10000 10000
 /begin AXIS_DESCR COM_AXIS NO_INPUT_QUANTITY trq_fl_a_M_S7_S3 6 -1000 1000 AXIS_PTS_REF KF_NDSOLLIAE_KON_ANS_X /end AXIS_DESCR
 /begin AXIS_DESCR COM_AXIS NO_INPUT_QUANTITY n_fl_M_S7_S3 7 -10000 10000 AXIS_PTS_REF KF_NDSOLLIAE_KON_ANS_Y /end AXIS_DESCR
/end CHARACTERISTIC
/begin CHARACTERISTIC KF_NGEMMODRSMAX_SYN_ANS_W "Maximaler Gradient der modifizierten EM-Drehzahl als Basisdrehzahl zur Bestimmung der VM Solldrehzahl bei RS beim K0 Synchronisieren beim Schleppstart" MAP 0x2692E4 FLOAT32_IEEE_COL_DIRECT_M_S7_S3 0 ng_fl_M_S7_S3 0 50000
 /begin AXIS_DESCR COM_AXIS n_sec_iae_ist_ans n_fl_M_S7_S3 5 0 10000 AXIS_PTS_REF KF_NGEMMODRSMAX_SYN_ANS_X /end AXIS_DESCR
 /begin AXIS_DESCR COM_AXIS nd_sec_iae_syn_ans n_fl_M_S7_S3 4 -10000 10000 AXIS_PTS_REF KF_NGEMMODRSMAX_SYN_ANS_Y /end AXIS_DESCR
/end CHARACTERISTIC
/begin CHARACTERISTIC KF_NGSOLLEM_NEMNDIAE_KON_ANS_W "Drehzahlgradient fuer die EM-Solldrehzahl in den Phasen KON - SCL" MAP 0x269358 FLOAT32_IEEE_COL_DIRECT_M_S7_S3 0 ng_fl_M_S7_S3 -10000 10000
 /begin AXIS_DESCR COM_AXIS NO_INPUT_QUANTITY n_fl_M_S7_S3 9 -10000 10000 AXIS_PTS_REF KF_NGSOLLEM_NEMNDIAE_KON_ANS_X /end AXIS_DESCR
 /begin AXIS_DESCR COM_AXIS nd_iae_ans n_fl_M_S7_S3 7 -10000 10000 AXIS_PTS_REF KF_NGSOLLEM_NEMNDIAE_KON_ANS_Y /end AXIS_DESCR
/end CHARACTERISTIC
/begin CHARACTERISTIC KF_NGSOLLEM_STIAEKRAFT_KON_ANS_W "Bestimmung Umschaltkriterium ng_sollemststkraftfluss in Phasen KON -SCL" MAP 0x26EE3E UBYTE_COL_DIRECT_M_S7_S3 0 st_int_M_S7_S3 0 1
 /begin AXIS_DESCR COM_AXIS NO_INPUT_QUANTITY sts_int_M_S7_S3 9 0 8 AXIS_PTS_REF KF_NGSOLLEM_STIAEKRAFT_KON_ANS_X /end AXIS_DESCR
 /begin AXIS_DESCR COM_AXIS NO_INPUT_QUANTITY sts_int_M_S7_S3 7 0 6 AXIS_PTS_REF KF_NGSOLLEM_STIAEKRAFT_KON_ANS_Y /end AXIS_DESCR
/end CHARACTERISTIC
/begin CHARACTERISTIC KF_NOEMNSOLLVM_KON_ANS_W "Drehzahloffset auf die Basis-Drehzahl zur Berechnung des Zielwerts der VM Solldrehzahl ab dem Zustand Konditionieren und in dem Zustand Schaltung aktiv beim Schleppstart" MAP 0x269494 FLOAT32_IEEE_COL_DIRECT_M_S7_S3 0 n_fl_M_S7_S3 0 10000
 /begin AXIS_DESCR COM_AXIS NO_INPUT_QUANTITY n_fl_M_S7_S3 10 0 10000 AXIS_PTS_REF KF_NOEMNSOLLVM_KON_ANS_X /end AXIS_DESCR
 /begin AXIS_DESCR COM_AXIS NO_INPUT_QUANTITY trq_fl_a_M_S7_S3 7 -1000 1000 AXIS_PTS_REF KF_NOEMNSOLLVM_KON_ANS_Y /end AXIS_DESCR
/end CHARACTERISTIC
/begin CHARACTERISTIC KF_NOSOLLIAEAKTIV_ANS_W "Aktivierung Drehzahloffset fuer EM Solldrehzahl als f=(status_iae_in, status_kraftfluss_egs_in)" MAP 0x26EE8D UBYTE_COL_DIRECT_M_S7_S3 0 st_int_M_S7_S3 0 1
 /begin AXIS_DESCR COM_AXIS NO_INPUT_QUANTITY sts_int_M_S7_S3 9 0 8 AXIS_PTS_REF KF_NOSOLLIAEAKTIV_ANS_X /end AXIS_DESCR
 /begin AXIS_DESCR COM_AXIS NO_INPUT_QUANTITY st_int_M_S7_S3 7 0 6 AXIS_PTS_REF KF_NOSOLLIAEAKTIV_ANS_Y /end AXIS_DESCR
/end CHARACTERISTIC
/begin CHARACTERISTIC KF_STIAESTKRAFT_RESCH_SRT_ANS_W "Bestimmung z_resp_schalt2_statisch" MAP 0x26EF2B UBYTE_COL_DIRECT_M_S7_S3 0 st_int_M_S7_S3 0 1
 /begin AXIS_DESCR COM_AXIS NO_INPUT_QUANTITY sts_int_M_S7_S3 9 0 255 AXIS_PTS_REF KF_STIAESTKRAFT_RESCH_SRT_ANS_X /end AXIS_DESCR
 /begin AXIS_DESCR COM_AXIS NO_INPUT_QUANTITY sts_int_M_S7_S3 7 0 255 AXIS_PTS_REF KF_STIAESTKRAFT_RESCH_SRT_ANS_Y /end AXIS_DESCR
/end CHARACTERISTIC
/begin CHARACTERISTIC KF_TK0SYNCERKUMS_SYN_ANS_W "Zeit bis zur Umschaltung der Differenzdrehzahlschwelle zur Erkennung Synchron beim Schleppstart in Abhaengigkeit des VM-Zielmoments" MAP 0x2695F0 FLOAT32_IEEE_COL_DIRECT_M_S7_S3 0 t_fl_M_S7_S3 0 10
 /begin AXIS_DESCR COM_AXIS m_ziel_vm_has_ans trq_fl_a_M_S7_S3 5 -1000 1000 AXIS_PTS_REF KF_TK0SYNCERKUMS_SYN_ANS_X /end AXIS_DESCR
 /begin AXIS_DESCR COM_AXIS NO_INPUT_QUANTITY sts_int_r_M_S7_S3 2 0 1 AXIS_PTS_REF KF_TK0SYNCERKUMS_SYN_ANS_Y /end AXIS_DESCR
/end CHARACTERISTIC
/begin CHARACTERISTIC KF_TSSCHLSCHALT_SRT_ANS_W "Zeit  um die die K0 Befuellung verlaengert werden kann. Resp SLST V2" MAP 0x269634 FLOAT32_IEEE_COL_DIRECT_M_S7_S3 0 t_fl_M_S7_S3 0 1
 /begin AXIS_DESCR COM_AXIS NO_INPUT_QUANTITY trq_fl_a_M_S7_S3 7 -1000 1000 AXIS_PTS_REF KF_TSSCHLSCHALT_SRT_ANS_X /end AXIS_DESCR
 /begin AXIS_DESCR COM_AXIS NO_INPUT_QUANTITY void_int_q_M_S7_S3 8 -3.40282346639E+038 3.40282346639E+038 AXIS_PTS_REF KF_TSSCHLSCHALT_SRT_ANS_Y /end AXIS_DESCR
/end CHARACTERISTIC
/begin CHARACTERISTIC KF_TVMSTOERK0EMFIL_ANS_W "Timerzeit zur Aktiveriung von m_stoer_k0_em_fil, begrenzt auf min. 20ms" MAP 0x269750 FLOAT32_IEEE_COL_DIRECT_M_S7_S3 0 t_fl_M_S7_S3 0.02 1
 /begin AXIS_DESCR COM_AXIS c_getriebe_egs_in c_fl_M_S7_S3 8 -50 200 AXIS_PTS_REF KF_TVMSTOERK0EMFIL_ANS_X /end AXIS_DESCR
 /begin AXIS_DESCR COM_AXIS NO_INPUT_QUANTITY trq_fl_a_M_S7_S3 8 -1000 1000 AXIS_PTS_REF KF_TVMSTOERK0EMFIL_ANS_Y /end AXIS_DESCR
/end CHARACTERISTIC
/begin CHARACTERISTIC KF_TVMSTOERK0EMFIL_RESP_SCHALT_ANS_W "Timerzeit zur Aktiveriung von m_stoer_k0_em_fil, begrenzt auf min. 20ms" MAP 0x269890 FLOAT32_IEEE_COL_DIRECT_M_S7_S3 0 t_fl_M_S7_S3 0 1
 /begin AXIS_DESCR COM_AXIS c_getriebe_egs_in c_fl_M_S7_S3 8 -50 200 AXIS_PTS_REF KF_TVMSTOERK0EMFIL_RESP_SCHALT_ANS_X /end AXIS_DESCR
 /begin AXIS_DESCR COM_AXIS NO_INPUT_QUANTITY trq_fl_a_M_S7_S3 8 -1000 1000 AXIS_PTS_REF KF_TVMSTOERK0EMFIL_RESP_SCHALT_ANS_Y /end AXIS_DESCR
/end CHARACTERISTIC
/begin CHARACTERISTIC KF_UMSCHNSOLLEMABS_ANS_W "Umschaltung n_soll_em_has Berechnung, relativ oder absolut" MAP 0x26EF7A UBYTE_COL_DIRECT_M_S7_S3 0 st_int_M_S7_S3 0 1
 /begin AXIS_DESCR COM_AXIS NO_INPUT_QUANTITY sts_int_M_S7_S3 9 0 8 AXIS_PTS_REF KF_UMSCHNSOLLEMABS_ANS_X /end AXIS_DESCR
 /begin AXIS_DESCR COM_AXIS NO_INPUT_QUANTITY sts_int_M_S7_S3 7 0 6 AXIS_PTS_REF KF_UMSCHNSOLLEMABS_ANS_Y /end AXIS_DESCR
/end CHARACTERISTIC
/begin CHARACTERISTIC KF_ZSCHLEPPSCHALTABLVAR_SRT_ANS_W "z_schleppschaltaktiv_ans = f(istgang_egs_in, z_ablaufvariante_has_ans)" MAP 0x26AA0C UBYTE_COL_DIRECT_M_S7_S3 0 void_int_M_S7_S3 0 1
 /begin AXIS_DESCR COM_AXIS NO_INPUT_QUANTITY void_int_M_S7_S3 10 -1 8 AXIS_PTS_REF KF_ZSCHLEPPSCHALTABLVAR_SRT_ANS_X /end AXIS_DESCR
 /begin AXIS_DESCR COM_AXIS NO_INPUT_QUANTITY void_int_M_S7_S3 6 0 15 AXIS_PTS_REF KF_ZSCHLEPPSCHALTABLVAR_SRT_ANS_Y /end AXIS_DESCR
/end CHARACTERISTIC
/begin CHARACTERISTIC KL_FMGK0ISTGANG_SYN_ANS_Y "Faktor auf den K0-Momentgradient" CURVE 0x269B38 FLOAT32_IEEE_COL_DIRECT_M_S7_S3 0 void_fl_M_S7_S3 -10000 10000
 /begin AXIS_DESCR COM_AXIS NO_INPUT_QUANTITY void_fl_M_S7_S3 10 -1 8 AXIS_PTS_REF KL_FMGK0ISTGANG_SYN_ANS_X /end AXIS_DESCR
/end CHARACTERISTIC
/begin CHARACTERISTIC KL_FMK0MMOTNVM1_SCHUB_SST_ANS_Y "Gewichtungsfaktor K0-Moment fuer Rampe 1 im Schub" CURVE 0x269C28 FLOAT32_IEEE_COL_DIRECT_M_S7_S3 0 void_fl_M_S7_S3 0 5
 /begin AXIS_DESCR COM_AXIS NO_INPUT_QUANTITY void_fl_M_S7_S3 10 -1 8 AXIS_PTS_REF KL_FMK0MMOTNVM1_SCHUB_SST_ANS_X /end AXIS_DESCR
/end CHARACTERISTIC
/begin CHARACTERISTIC KL_FMK0MMOTNVM1_SST_ANS_Y "Gewichtungsfaktor K0-Moment fuer Rampe 1" CURVE 0x269C78 FLOAT32_IEEE_COL_DIRECT_M_S7_S3 0 void_fl_M_S7_S3 0 5
 /begin AXIS_DESCR COM_AXIS NO_INPUT_QUANTITY void_fl_M_S7_S3 10 -1 8 AXIS_PTS_REF KL_FMK0MMOTNVM1_SST_ANS_X /end AXIS_DESCR
/end CHARACTERISTIC
/begin CHARACTERISTIC KL_FMK0MMOTNVM2_SCHUB_SST_ANS_Y "Gewichtungsfaktor K0-Moment fuer Rampe 2 im Schub" CURVE 0x269CC8 FLOAT32_IEEE_COL_DIRECT_M_S7_S3 0 void_fl_M_S7_S3 0 5
 /begin AXIS_DESCR COM_AXIS NO_INPUT_QUANTITY void_fl_M_S7_S3 10 -1 8 AXIS_PTS_REF KL_FMK0MMOTNVM2_SCHUB_SST_ANS_X /end AXIS_DESCR
/end CHARACTERISTIC
/begin CHARACTERISTIC KL_FMK0MMOTNVM2_SST_ANS_Y "Gewichtungsfaktor K0-Moment fuer Rampe 2" CURVE 0x269D18 FLOAT32_IEEE_COL_DIRECT_M_S7_S3 0 void_fl_M_S7_S3 0 5
 /begin AXIS_DESCR COM_AXIS NO_INPUT_QUANTITY void_fl_M_S7_S3 10 -1 8 AXIS_PTS_REF KL_FMK0MMOTNVM2_SST_ANS_X /end AXIS_DESCR
/end CHARACTERISTIC
/begin CHARACTERISTIC KL_FNDGSOLLIAE_KON_ANS_Y "Faktor auf das KF_NDGSOLLIAE_KON_ANS " CURVE 0x269E48 FLOAT32_IEEE_COL_DIRECT_M_S7_S3 0 void_fl_M_S7_S3 0 5
 /begin AXIS_DESCR COM_AXIS NO_INPUT_QUANTITY void_fl_M_S7_S3 10 -1 8 AXIS_PTS_REF KL_FNDGSOLLIAE_KON_ANS_X /end AXIS_DESCR
/end CHARACTERISTIC
/begin CHARACTERISTIC KL_FNDGSOLLIAE_SCL_ANS_Y "Faktor auf den EM-Solldrehzahlgradient" CURVE 0x269E98 FLOAT32_IEEE_COL_DIRECT_M_S7_S3 0 ng_fl_M_S7_S3 0 5
 /begin AXIS_DESCR COM_AXIS NO_INPUT_QUANTITY void_fl_M_S7_S3 10 -1 8 AXIS_PTS_REF KL_FNDGSOLLIAE_SCL_ANS_X /end AXIS_DESCR
/end CHARACTERISTIC
/begin CHARACTERISTIC KL_FNDGSOLLIAE_SST_ANS_Y "Faktor auf den EM-Solldrehzahlgradient" CURVE 0x269EE8 FLOAT32_IEEE_COL_DIRECT_M_S7_S3 0 void_fl_M_S7_S3 0 5
 /begin AXIS_DESCR COM_AXIS NO_INPUT_QUANTITY void_fl_M_S7_S3 10 -1 8 AXIS_PTS_REF KL_FNDGSOLLIAE_SST_ANS_X /end AXIS_DESCR
/end CHARACTERISTIC
/begin CHARACTERISTIC KL_FNDGSOLLIAE_SYN_ANS_Y "Faktor auf den EM-Solldrehzahlgradient" CURVE 0x269F38 FLOAT32_IEEE_COL_DIRECT_M_S7_S3 0 void_fl_M_S7_S3 0 5
 /begin AXIS_DESCR COM_AXIS NO_INPUT_QUANTITY void_fl_M_S7_S3 10 -1 8 AXIS_PTS_REF KL_FNDGSOLLIAE_SYN_ANS_X /end AXIS_DESCR
/end CHARACTERISTIC
/begin CHARACTERISTIC KL_FNDGSOLLIAE_ZND_ANS_Y "Faktor auf den EM-Solldrehzahlgradient" CURVE 0x269F88 FLOAT32_IEEE_COL_DIRECT_M_S7_S3 0 void_fl_M_S7_S3 0 5
 /begin AXIS_DESCR COM_AXIS NO_INPUT_QUANTITY void_fl_M_S7_S3 10 -1 8 AXIS_PTS_REF KL_FNDGSOLLIAE_ZND_ANS_X /end AXIS_DESCR
/end CHARACTERISTIC
/begin CHARACTERISTIC KL_FNDSOLLIAE_KON_ANS_Y "Faktor auf das KF_NDSOLLIAE_KON_ANS " CURVE 0x269FD8 FLOAT32_IEEE_COL_DIRECT_M_S7_S3 0 void_fl_M_S7_S3 0 5
 /begin AXIS_DESCR COM_AXIS NO_INPUT_QUANTITY void_fl_M_S7_S3 10 -1 8 AXIS_PTS_REF KL_FNDSOLLIAE_KON_ANS_X /end AXIS_DESCR
/end CHARACTERISTIC
/begin CHARACTERISTIC KL_FNDSOLLIAE_SCL_ANS_Y "Faktor auf die EM-Solldrehzahl" CURVE 0x26A028 FLOAT32_IEEE_COL_DIRECT_M_S7_S3 0 void_fl_M_S7_S3 0 5
 /begin AXIS_DESCR COM_AXIS NO_INPUT_QUANTITY void_fl_M_S7_S3 10 -1 8 AXIS_PTS_REF KL_FNDSOLLIAE_SCL_ANS_X /end AXIS_DESCR
/end CHARACTERISTIC
/begin CHARACTERISTIC KL_FNDSOLLIAE_SST_ANS_Y "Faktor auf den EM-Solldrehzahl" CURVE 0x26A078 FLOAT32_IEEE_COL_DIRECT_M_S7_S3 0 void_fl_M_S7_S3 0 5
 /begin AXIS_DESCR COM_AXIS NO_INPUT_QUANTITY void_fl_M_S7_S3 10 -1 8 AXIS_PTS_REF KL_FNDSOLLIAE_SST_ANS_X /end AXIS_DESCR
/end CHARACTERISTIC
/begin CHARACTERISTIC KL_FNDSOLLIAE_SYN_ANS_Y "Faktor auf die EM-Solldrehzahl" CURVE 0x26A0C8 FLOAT32_IEEE_COL_DIRECT_M_S7_S3 0 void_fl_M_S7_S3 0 5
 /begin AXIS_DESCR COM_AXIS NO_INPUT_QUANTITY void_fl_M_S7_S3 10 -1 8 AXIS_PTS_REF KL_FNDSOLLIAE_SYN_ANS_X /end AXIS_DESCR
/end CHARACTERISTIC
/begin CHARACTERISTIC KL_FNDSOLLIAE_ZND_ANS_Y "Faktor auf die EM-Solldrehzahl" CURVE 0x26A118 FLOAT32_IEEE_COL_DIRECT_M_S7_S3 0 void_fl_M_S7_S3 0 5
 /begin AXIS_DESCR COM_AXIS NO_INPUT_QUANTITY void_fl_M_S7_S3 10 -1 8 AXIS_PTS_REF KL_FNDSOLLIAE_ZND_ANS_X /end AXIS_DESCR
/end CHARACTERISTIC
/begin CHARACTERISTIC KL_K0SREGSTATUSIAE_SYN_ANS_Y "Aktivierung der K0 Schlupfregelung in Abhaengigkeit von status_iae_in" CURVE 0x26F0CD UBYTE_COL_DIRECT_M_S7_S3 0 sts_int_M_S7_S3 0 1
 /begin AXIS_DESCR COM_AXIS NO_INPUT_QUANTITY void_int_M_S7_S3 9 0 8 AXIS_PTS_REF KL_K0SREGSTATUSIAE_SYN_ANS_X /end AXIS_DESCR
/end CHARACTERISTIC
/begin CHARACTERISTIC KL_KSVH_RESET_SCL_ANS_Y "Bedingtes Ruecksetzen einer Schaltverhinderung waehrend VM-Schleppstart im Zustand Anschleppen (255=alle Arten von Schaltugne zuruecksetzen, 0= keine Schltg. zuruecksetzen) -> Bit Codierung siehe Handbuch" CURVE 0x26E250 UBYTE_COL_DIRECT_M_S7_S3 0 void_int_M_S7_S3 0 255
 /begin AXIS_DESCR COM_AXIS NO_INPUT_QUANTITY void_int_M_S7_S3 10 -1 8 AXIS_PTS_REF KL_KSVH_RESET_SCL_ANS_X /end AXIS_DESCR
/end CHARACTERISTIC
/begin CHARACTERISTIC KL_KSVH_RESET_SRT_ANS_Y "Bedingtes Ruecksetzen einer Schaltverhinderung waehrend VM-Schleppstart im Zustand Start (255=alle Arten von Schaltugne zuruecksetzen, 0= keine Schltg. zuruecksetzen) -> Bit Codierung siehe Handbuch" CURVE 0x26E28C UBYTE_COL_DIRECT_M_S7_S3 0 void_int_M_S7_S3 0 255
 /begin AXIS_DESCR COM_AXIS NO_INPUT_QUANTITY void_int_M_S7_S3 10 -1 8 AXIS_PTS_REF KL_KSVH_RESET_SRT_ANS_X /end AXIS_DESCR
/end CHARACTERISTIC
/begin CHARACTERISTIC KL_KSVH_RESET_SST_ANS_Y "Bedingtes Ruecksetzen einer Schaltverhinderung waehrend VM-Schleppstart im Zustand Anschleppen (255=alle Arten von Schaltugne zuruecksetzen, 0= keine Schltg. zuruecksetzen) -> Bit Codierung siehe Handbuch" CURVE 0x26E2A0 UBYTE_COL_DIRECT_M_S7_S3 0 void_int_M_S7_S3 0 255
 /begin AXIS_DESCR COM_AXIS NO_INPUT_QUANTITY void_int_M_S7_S3 10 -1 8 AXIS_PTS_REF KL_KSVH_RESET_SST_ANS_X /end AXIS_DESCR
/end CHARACTERISTIC
/begin CHARACTERISTIC KL_KSVH_RESET_SYN_ANS_Y "Bedingtes Ruecksetzen einer Schaltverhinderung waehrend VM-Schleppstart im Zustand Anschleppen (255=alle Arten von Schaltugne zuruecksetzen, 0= keine Schltg. zuruecksetzen) -> Bit Codierung siehe Handbuch" CURVE 0x26E2B4 UBYTE_COL_DIRECT_M_S7_S3 0 void_int_M_S7_S3 0 255
 /begin AXIS_DESCR COM_AXIS NO_INPUT_QUANTITY void_int_M_S7_S3 10 -1 8 AXIS_PTS_REF KL_KSVH_RESET_SYN_ANS_X /end AXIS_DESCR
/end CHARACTERISTIC
/begin CHARACTERISTIC KL_MGK0MODMAX_SCL_ANS_Y "Maximaler Gradient des modifizierten K0 Moments der HAS in Abhaengigkeit des VM Zielmoments im Zustand K0-Schliessen beim Schleppstart" CURVE 0x26A158 FLOAT32_IEEE_COL_DIRECT_M_S7_S3 0 trqg_fl_k_M_S7_S3 0 10000
 /begin AXIS_DESCR COM_AXIS m_ziel_vm_has_ans trq_fl_a_M_S7_S3 6 -10000 10000 AXIS_PTS_REF KL_MGK0MODMAX_SCL_ANS_X /end AXIS_DESCR
/end CHARACTERISTIC
/begin CHARACTERISTIC KL_MGK0MODMAX_SYN_ANS_Y "Maximaler Gradient des modifizierten K0 Moments der HAS in Abhaengigkeit des Gradienten des K0 Sollmoments im Zustand K0-Synchronisieren beim Schleppstart" CURVE 0x26A188 FLOAT32_IEEE_COL_DIRECT_M_S7_S3 0 trqg_fl_k_M_S7_S3 0 10000
 /begin AXIS_DESCR COM_AXIS NO_INPUT_QUANTITY trqg_fl_k_M_S7_S3 6 -10000 10000 AXIS_PTS_REF KL_MGK0MODMAX_SYN_ANS_X /end AXIS_DESCR
/end CHARACTERISTIC
/begin CHARACTERISTIC KL_MGK0MODMIN_SYN_ANS_Y "Minimaler Gradient (negative Werte) des modifizierten K0 Moments der HAS in Abhaengigkeit des Gradienten des K0 Sollmoments im Zustand K0-Synchronisieren beim Schleppstart" CURVE 0x26A1B8 FLOAT32_IEEE_COL_DIRECT_M_S7_S3 0 trqg_fl_k_M_S7_S3 -10000 0
 /begin AXIS_DESCR COM_AXIS NO_INPUT_QUANTITY trqg_fl_k_M_S7_S3 6 -10000 10000 AXIS_PTS_REF KL_MGK0MODMIN_SYN_ANS_X /end AXIS_DESCR
/end CHARACTERISTIC
/begin CHARACTERISTIC KL_MGSOLLK0_SCHUB_SST_ANS_Y "Y-Achse: Gradientoffset fuer die Ber. von mg_soll_k0_has_nverz im Anschleppen" CURVE 0x26A1E8 FLOAT32_IEEE_COL_DIRECT_M_S7_S3 0 trqg_fl_k_M_S7_S3 -10000 10000
 /begin AXIS_DESCR COM_AXIS NO_INPUT_QUANTITY trq_fl_a_M_S7_S3 6 -1000 1000 AXIS_PTS_REF KL_MGSOLLK0_SCHUB_SST_ANS_X /end AXIS_DESCR
/end CHARACTERISTIC
/begin CHARACTERISTIC KL_MGSOLLK0_SST_ANS_Y "Y-Achse: Gradientoffset fuer die Ber. von mg_soll_k0_has_nverz im Anschleppen" CURVE 0x26A23C FLOAT32_IEEE_COL_DIRECT_M_S7_S3 0 trqg_fl_k_M_S7_S3 -10000 10000
 /begin AXIS_DESCR COM_AXIS NO_INPUT_QUANTITY trq_fl_a_M_S7_S3 5 -1000 1000 AXIS_PTS_REF KL_MGSOLLK0_SST_ANS_X /end AXIS_DESCR
/end CHARACTERISTIC
/begin CHARACTERISTIC KL_MGZIELMAXEM_SYN_ANS_Y "Zielmoment des Maximalmoments des EM-Drehzahlreglers" CURVE 0x26A298 FLOAT32_IEEE_COL_DIRECT_M_S7_S3 0 trqg_fl_k_M_S7_S3 0 50000
 /begin AXIS_DESCR COM_AXIS NO_INPUT_QUANTITY trq_fl_a_M_S7_S3 8 -1000 1000 AXIS_PTS_REF KL_MGZIELMAXEM_SYN_ANS_X /end AXIS_DESCR
/end CHARACTERISTIC
/begin CHARACTERISTIC KL_MGZIELMINEM_SYN_ANS_Y "Zielmoment des Minimalmoments des EM-Drehzahlreglers" CURVE 0x26A2D8 FLOAT32_IEEE_COL_DIRECT_M_S7_S3 0 trqg_fl_k_M_S7_S3 0 50000
 /begin AXIS_DESCR COM_AXIS NO_INPUT_QUANTITY trq_fl_a_M_S7_S3 8 -1000 1000 AXIS_PTS_REF KL_MGZIELMINEM_SYN_ANS_X /end AXIS_DESCR
/end CHARACTERISTIC
/begin CHARACTERISTIC KL_MK0MVMSTART_SST_ANS_Y "Anteil des K0-Zielmoments beim VM Zuenden in Abhaengigkeit des VM Startmoments beim VM Anschleppen" CURVE 0x26A318 FLOAT32_IEEE_COL_DIRECT_M_S7_S3 0 trq_fl_a_M_S7_S3 -1000 1000
 /begin AXIS_DESCR COM_AXIS NO_INPUT_QUANTITY trq_fl_a_M_S7_S3 8 -1000 1000 AXIS_PTS_REF KL_MK0MVMSTART_SST_ANS_X /end AXIS_DESCR
/end CHARACTERISTIC
/begin CHARACTERISTIC KL_MSSOLLK0BED_SYN_ANS_Y "Schwelle des Sollmoments der K0, ab der ins Schliessen uebergegangen werden darf" CURVE 0x26A400 FLOAT32_IEEE_COL_DIRECT_M_S7_S3 0 trq_fl_a_M_S7_S3 0 1000
 /begin AXIS_DESCR COM_AXIS m_ziel_vm_has_ans trq_fl_a_M_S7_S3 8 -1000 1000 AXIS_PTS_REF KL_MSSOLLK0BED_SYN_ANS_X /end AXIS_DESCR
/end CHARACTERISTIC
/begin CHARACTERISTIC KL_MWUNSCH_RESPPAR_SCHUB_KON_ANS_Y "Fahrerwunschmomentenschwelle um Zug fuer SCHLT SLTG zu erkennen" CURVE 0x26A478 FLOAT32_IEEE_COL_DIRECT_M_S7_S3 0 trq_fl_a_M_S7_S3 -1000 1000
 /begin AXIS_DESCR COM_AXIS NO_INPUT_QUANTITY c_fl_M_S7_S3 8 1 8 AXIS_PTS_REF KL_MWUNSCH_RESPPAR_SCHUB_KON_ANS_X /end AXIS_DESCR
/end CHARACTERISTIC
/begin CHARACTERISTIC KL_MWUNSCH_RESPPARAL_SRT_ANS_Y "Fahrmomentenabfrage zur Freigabe des parallelen Schleppstart Schaltung" CURVE 0x26A43C FLOAT32_IEEE_COL_DIRECT_M_S7_S3 0 trq_fl_a_M_S7_S3 -1000 1000
 /begin AXIS_DESCR COM_AXIS NO_INPUT_QUANTITY c_fl_M_S7_S3 7 -50 200 AXIS_PTS_REF KL_MWUNSCH_RESPPARAL_SRT_ANS_X /end AXIS_DESCR
/end CHARACTERISTIC
/begin CHARACTERISTIC KL_MZIELK0_SYN_ANS_Y "Festlegung des K0 Zielmoments zur Bestimmung des K0 Sollmoments im Zustand K0 Synchronisieren beim Schleppstart in Abhaengigkeit  des VM Zielmoments" CURVE 0x26A520 FLOAT32_IEEE_COL_DIRECT_M_S7_S3 0 trq_fl_a_M_S7_S3 0 1000
 /begin AXIS_DESCR COM_AXIS m_ziel_vm_has_ans trq_fl_a_M_S7_S3 8 -1000 1000 AXIS_PTS_REF KL_MZIELK0_SYN_ANS_X /end AXIS_DESCR
/end CHARACTERISTIC
/begin CHARACTERISTIC KL_MZIELK0MIN_SYN_ANS_Y "Festlegung des min. K0-Zielmoments zur Bestimmung des K0 Sollmoments im Zustand K0 Synchronisieren beim SLST in Abhaengigkeit des VM-Zielmoments" CURVE 0x26A4E0 FLOAT32_IEEE_COL_DIRECT_M_S7_S3 0 trq_fl_a_M_S7_S3 0 1000
 /begin AXIS_DESCR COM_AXIS m_ziel_vm_has_ans trq_fl_a_M_S7_S3 8 -1000 1000 AXIS_PTS_REF KL_MZIELK0MIN_SYN_ANS_X /end AXIS_DESCR
/end CHARACTERISTIC
/begin CHARACTERISTIC KL_MZIELK0MIN_SYNCDDA_SYN_ANS_Y "Festlegung des min. K0-Zielmoments zur Bestimmung des K0 Sollmoments bei durchdrehenden Antriebsraedern im Zustand K0-Synchronisieren beim Schleppstart in Abhaengigkeit der Differenz zwischen dem Fahrerwunschmoment und dem min. moeglichen EM-Moment" CURVE 0x26A4AC FLOAT32_IEEE_COL_DIRECT_M_S7_S3 0 trq_fl_a_M_S7_S3 0 1000
 /begin AXIS_DESCR COM_AXIS NO_INPUT_QUANTITY trq_fl_a_M_S7_S3 5 -1000 1000 AXIS_PTS_REF KL_MZIELK0MIN_SYNCDDA_SYN_ANS_X /end AXIS_DESCR
/end CHARACTERISTIC
/begin CHARACTERISTIC KL_NDGSK0SYNCERK_SYN_ANS_Y "Maximaler Betrag des K0-Differenzdrehzahlgradienten zur Erkennung Synchron im Zustand K0 Synchronisieren beim Zustart in Abhaengigkeit des VM Zielmoments beim Schleppstart" CURVE 0x26A568 FLOAT32_IEEE_COL_DIRECT_M_S7_S3 0 ng_fl_M_S7_S3 -10000 10000
 /begin AXIS_DESCR COM_AXIS m_ziel_vm_has_ans trq_fl_a_M_S7_S3 10 -10000 10000 AXIS_PTS_REF KL_NDGSK0SYNCERK_SYN_ANS_X /end AXIS_DESCR
/end CHARACTERISTIC
/begin CHARACTERISTIC KL_NDIAEEMMAXIAE_KON_ANS_Y "Momentoffset auf m_max_iae_has = f(nd_iae, nd_ziel_iae_stat)" CURVE 0x26A5B0 FLOAT32_IEEE_COL_DIRECT_M_S7_S3 0 trq_fl_a_M_S7_S3 -1000 1000
 /begin AXIS_DESCR COM_AXIS NO_INPUT_QUANTITY n_fl_M_S7_S3 8 -10000 10000 AXIS_PTS_REF KL_NDIAEEMMAXIAE_KON_ANS_X /end AXIS_DESCR
/end CHARACTERISTIC
/begin CHARACTERISTIC KL_NDIAEEMMAXIAE_SST_ANS_Y "Momentoffset auf m_max_iae_has =  f(nd_iae-nd_soll_iae_stat)" CURVE 0x26A5F0 FLOAT32_IEEE_COL_DIRECT_M_S7_S3 0 trq_fl_a_M_S7_S3 -1000 1000
 /begin AXIS_DESCR COM_AXIS NO_INPUT_QUANTITY n_fl_M_S7_S3 8 -10000 10000 AXIS_PTS_REF KL_NDIAEEMMAXIAE_SST_ANS_X /end AXIS_DESCR
/end CHARACTERISTIC
/begin CHARACTERISTIC KL_NDIAEEMMAXIAE_SYN_ANS_Y "Momentoffset auf m_max_iae_has =  f(nd_iae-nd_soll_iae_stat)" CURVE 0x26A630 FLOAT32_IEEE_COL_DIRECT_M_S7_S3 0 trq_fl_a_M_S7_S3 -1000 1000
 /begin AXIS_DESCR COM_AXIS NO_INPUT_QUANTITY n_fl_M_S7_S3 8 -10000 10000 AXIS_PTS_REF KL_NDIAEEMMAXIAE_SYN_ANS_X /end AXIS_DESCR
/end CHARACTERISTIC
/begin CHARACTERISTIC KL_NDSK0K0SREG_SYN_ANS_Y "K0-Differenzdrehzahlschwelle zur Bestimmung des Zeitpunkts der Anforderung der Aktivierung der K0-Schlupfregelung in Abhaengigkeit des K0 Sollmoments im Zustand K0 Synchronisieren beim Schleppstart" CURVE 0x26A6A4 FLOAT32_IEEE_COL_DIRECT_M_S7_S3 0 n_fl_M_S7_S3 0 10000
 /begin AXIS_DESCR COM_AXIS NO_INPUT_QUANTITY trq_fl_a_M_S7_S3 5 -10000 10000 AXIS_PTS_REF KL_NDSK0K0SREG_SYN_ANS_X /end AXIS_DESCR
/end CHARACTERISTIC
/begin CHARACTERISTIC KL_NDZIELK0K0SREG_SYN_ANS_Y "K0-Zieldifferenzdrehzahl zur Bestimmung der VM-Solldrehzahl bei der Aktivierung der K0-Schlupfregelung in Abhaengigkeit des K0 Sollmoments im Zustand K0 Synchronisieren beim Schleppstart" CURVE 0x26A6CC FLOAT32_IEEE_COL_DIRECT_M_S7_S3 0 n_fl_M_S7_S3 0 10000
 /begin AXIS_DESCR COM_AXIS NO_INPUT_QUANTITY trq_fl_a_M_S7_S3 5 0 1000 AXIS_PTS_REF KL_NDZIELK0K0SREG_SYN_ANS_X /end AXIS_DESCR
/end CHARACTERISTIC
/begin CHARACTERISTIC KL_NGIAEANF_ANS_Y "Gradientenbegrenzer fuer Uebergang n_soll_em aus Anfahrdrehzahl IAE oder HAS intern" CURVE 0x26A708 FLOAT32_IEEE_COL_DIRECT_M_S7_S3 0 ng_fl_M_S7_S3 -10000 10000
 /begin AXIS_DESCR COM_AXIS NO_INPUT_QUANTITY n_fl_M_S7_S3 10 -3500 3500 AXIS_PTS_REF KL_NGIAEANF_ANS_X /end AXIS_DESCR
/end CHARACTERISTIC
/begin CHARACTERISTIC KL_NONEMABLVARBED_KON_ANS_Y "Drehzahloffset auf die EM-Drehzahl als Uebergangsbedinung von KON -> SST" CURVE 0x26A750 FLOAT32_IEEE_COL_DIRECT_M_S7_S3 0 n_fl_M_S7_S3 -10000 10000
 /begin AXIS_DESCR COM_AXIS NO_INPUT_QUANTITY void_fl_M_S7_S3 8 0 15 AXIS_PTS_REF KL_NONEMABLVARBED_KON_ANS_X /end AXIS_DESCR
/end CHARACTERISTIC
/begin CHARACTERISTIC KL_NSMINEMCGETRBED_KON_ANS_Y "Minimale EM-Drehzahl als Uebergangsbedinung von KON -> SST" CURVE 0x26A790 FLOAT32_IEEE_COL_DIRECT_M_S7_S3 0 n_fl_M_S7_S3 0 10000
 /begin AXIS_DESCR COM_AXIS NO_INPUT_QUANTITY c_fl_M_S7_S3 8 -40 200 AXIS_PTS_REF KL_NSMINEMCGETRBED_KON_ANS_X /end AXIS_DESCR
/end CHARACTERISTIC
/begin CHARACTERISTIC KL_NZIELEMKRAFTFLUSS_ANS_Y "In Abhaengigkeit von status_kraftfluss_egs_in kann n_ab_egs_in mal i_istgang_egs_in bei der Berechnung von n_soll_em_has beruecksichtigt werden" CURVE 0x26F0EB UBYTE_COL_DIRECT_M_S7_S3 0 sts_int_M_S7_S3 0 1
 /begin AXIS_DESCR COM_AXIS NO_INPUT_QUANTITY sts_int_M_S7_S3 7 0 6 AXIS_PTS_REF KL_NZIELEMKRAFTFLUSS_ANS_X /end AXIS_DESCR
/end CHARACTERISTIC
/begin CHARACTERISTIC KL_TFC_K0_ANS_Y "Fuellausgleichzeit einer Normalen K0-Befuellung zur Bestimmung des K0-Stoermoments beim SLST in Abhaengigkeit der Getriebeoeltemperatur" CURVE 0x26A7D4 FLOAT32_IEEE_COL_DIRECT_M_S7_S3 0 t_fl_M_S7_S3 0 5
 /begin AXIS_DESCR COM_AXIS c_getriebe_egs_in c_fl_M_S7_S3 9 -50 200 AXIS_PTS_REF KL_TFC_K0_ANS_X /end AXIS_DESCR
/end CHARACTERISTIC
/begin CHARACTERISTIC KL_TFC_K0_OPT_ANS_Y "Fuellausgleichzeit einer Optimierten K0-Befuellung zur Bestimmung des K0-Stoermoments beim SLST in Abhaengigkeit der Getriebeoeltemperatur" CURVE 0x26A81C FLOAT32_IEEE_COL_DIRECT_M_S7_S3 0 t_fl_M_S7_S3 0 5
 /begin AXIS_DESCR COM_AXIS c_getriebe_egs_in c_fl_M_S7_S3 9 -50 200 AXIS_PTS_REF KL_TFC_K0_OPT_ANS_X /end AXIS_DESCR
/end CHARACTERISTIC
/begin CHARACTERISTIC KL_TFC_K0_RED_ANS_Y "Fuellausgleichzeit einer Reduzierten K0-Befuellung zur Bestimmung des K0-Stoermoments beim SLST in Abhaengigkeit der Getriebeoeltemperatur" CURVE 0x26A864 FLOAT32_IEEE_COL_DIRECT_M_S7_S3 0 t_fl_M_S7_S3 0 5
 /begin AXIS_DESCR COM_AXIS c_getriebe_egs_in c_fl_M_S7_S3 9 -50 200 AXIS_PTS_REF KL_TFC_K0_RED_ANS_X /end AXIS_DESCR
/end CHARACTERISTIC
/begin CHARACTERISTIC KOLBENPOSK0_KON_ANS "Schwelle fuer das Umschalten status_ablauf_has in der Phase KON in Abhaengigkeit status_kolbenpos_k0_in" VALUE 0x26AA9C FLOAT32_IEEE_COL_DIRECT_M_S7_S3 0 void_fl_M_S7_S3 0 100 /end CHARACTERISTIC
/begin CHARACTERISTIC M_ZIELMAXEM_SST_ANS "Zielmoment des Maximalmoments des EM-Drehzahlreglers" VALUE 0x26AB4C FLOAT32_IEEE_COL_DIRECT_M_S7_S3 0 trq_fl_a_M_S7_S3 0 1000 /end CHARACTERISTIC
/begin CHARACTERISTIC M_ZIELMINEM_SST_ANS "Zielmoment des Minimalmoments des EM-Drehzahlreglers" VALUE 0x26AB50 FLOAT32_IEEE_COL_DIRECT_M_S7_S3 0 trq_fl_a_M_S7_S3 -1000 0 /end CHARACTERISTIC
/begin CHARACTERISTIC MG_K0OFFSET_SST_ANS "Momentengradient fuer die Notanschlepprampe K0" VALUE 0x26AAC4 FLOAT32_IEEE_COL_DIRECT_M_S7_S3 0 trqg_fl_k_M_S7_S3 -10000 10000 /end CHARACTERISTIC
/begin CHARACTERISTIC MG_MOMAXIAE1_KON_ANS "Drehmomentgradient 1 zur Beeinflussung des IAE-Begrenzungsmoment" VALUE 0x26AAC8 FLOAT32_IEEE_COL_DIRECT_M_S7_S3 0 trqg_fl_k_M_S7_S3 -10000 10000 /end CHARACTERISTIC
/begin CHARACTERISTIC MG_MOMAXIAE1_SST_ANS "Drehmomentgradient 1 zur Beeinflussung des IAE-Begrenzungsmoment" VALUE 0x26AACC FLOAT32_IEEE_COL_DIRECT_M_S7_S3 0 trqg_fl_k_M_S7_S3 -10000 10000 /end CHARACTERISTIC
/begin CHARACTERISTIC MG_MOMAXIAE1_SYN_ANS "Drehmomentgradient 1 zur Beeinflussung des IAE-Begrenzungsmoment" VALUE 0x26AAD0 FLOAT32_IEEE_COL_DIRECT_M_S7_S3 0 trqg_fl_k_M_S7_S3 -10000 10000 /end CHARACTERISTIC
/begin CHARACTERISTIC MG_MOMAXIAE2_KON_ANS "Drehmomentgradient 2 zur Beeinflussung des IAE-Begrenzungsmoment" VALUE 0x26AAD8 FLOAT32_IEEE_COL_DIRECT_M_S7_S3 0 trqg_fl_k_M_S7_S3 -10000 10000 /end CHARACTERISTIC
/begin CHARACTERISTIC MG_MOMAXIAE2_SST_ANS "Drehmomentgradient 2 zur Beeinflussung des IAE-Begrenzungsmoment" VALUE 0x26AADC FLOAT32_IEEE_COL_DIRECT_M_S7_S3 0 trqg_fl_k_M_S7_S3 -10000 10000 /end CHARACTERISTIC
/begin CHARACTERISTIC MG_MOMAXIAE2_SYN_ANS "Drehmomentgradient 2 zur Beeinflussung des IAE-Begrenzungsmoment" VALUE 0x26AAE0 FLOAT32_IEEE_COL_DIRECT_M_S7_S3 0 trqg_fl_k_M_S7_S3 -10000 10000 /end CHARACTERISTIC
/begin CHARACTERISTIC MGS_WUNSCHFPW_SYN_ANS "Gradientenschwelle zur Initialisierung der VM Solldrehzahl im Zustand Synchronisieren beim Schleppstart" VALUE 0x26AABC FLOAT32_IEEE_COL_DIRECT_M_S7_S3 0 trqg_fl_k_M_S7_S3 -25000 25000 /end CHARACTERISTIC
/begin CHARACTERISTIC MO_K0ABSTELLPOSUNGUELTIG_SST_ANS "Momentoffset der K0 Vorgabe fuer Abstellpos. ungueltig" VALUE 0x26AAEC FLOAT32_IEEE_COL_DIRECT_M_S7_S3 0 trq_fl_a_M_S7_S3 -1000 1000 /end CHARACTERISTIC
/begin CHARACTERISTIC MO_K0BED_SCL_ANS "Offset auf das K0 Istmoment zum Ver-gleich mit dem modifizierten K0-Moment der HAS als Uebergangsbedin-gung im Uebergabe SCL -> UEB" VALUE 0x26AAF0 FLOAT32_IEEE_COL_DIRECT_M_S7_S3 0 trq_fl_a_M_S7_S3 -1000 1000 /end CHARACTERISTIC
/begin CHARACTERISTIC MO_K0OFFSET_SST_ANS "Momentenoffset fuer die Notanschlepprampe K0" VALUE 0x26AAF4 FLOAT32_IEEE_COL_DIRECT_M_S7_S3 0 trq_fl_a_M_S7_S3 0 1000 /end CHARACTERISTIC
/begin CHARACTERISTIC MO_MEM_KON_ANS "Drehmoment-Offset auf das max. dynamische EM-Moment im Zustand KON -> SYN" VALUE 0x26AAF8 FLOAT32_IEEE_COL_DIRECT_M_S7_S3 0 trq_fl_a_M_S7_S3 0 1000 /end CHARACTERISTIC
/begin CHARACTERISTIC MO_VMSOLLK0GESCHLBED_SCL_ANS "Offset Kupplungsmoment fuer Erkennung Kupplung geschlossen fuer den Uebergang von SCL -> UEB" VALUE 0x26AAFC FLOAT32_IEEE_COL_DIRECT_M_S7_S3 0 trq_fl_a_M_S7_S3 -1000 1000 /end CHARACTERISTIC
/begin CHARACTERISTIC MS_K0BED_ABB_ANS "Momentschwelle fuer Uebergang ABB - > UAB" VALUE 0x26AB00 FLOAT32_IEEE_COL_DIRECT_M_S7_S3 0 trq_fl_a_M_S7_S3 -100 1000 /end CHARACTERISTIC
/begin CHARACTERISTIC MS_K0STATUSABL_SST_ANS "Momentschwelle K0 zur Umschaltung status_ablauf_has in 102" VALUE 0x26AB04 FLOAT32_IEEE_COL_DIRECT_M_S7_S3 0 trq_fl_a_M_S7_S3 0 1000 /end CHARACTERISTIC
/begin CHARACTERISTIC MS_MINMGSOLLK0_SST_ANS "Minimalwert des Betrags des VM Minimalmoments zur Auswahl der K0 Sollgradienten" VALUE 0x26AB0C FLOAT32_IEEE_COL_DIRECT_M_S7_S3 0 trq_fl_a_M_S7_S3 0 1000 /end CHARACTERISTIC
/begin CHARACTERISTIC MS_MINMGSOLLK0RS_SST_ANS "Minimalwert des Betrags des VM Minimalmoments zur Auswahl der K0 Sollgradienten fuer Resp SLST V2" VALUE 0x26AB08 FLOAT32_IEEE_COL_DIRECT_M_S7_S3 0 trq_fl_a_M_S7_S3 0 1000 /end CHARACTERISTIC
/begin CHARACTERISTIC MS_MMAXIAEINAKTIV_ANS "Maxmoment der IAE" VALUE 0x26AB10 FLOAT32_IEEE_COL_DIRECT_M_S7_S3 0 trq_fl_a_M_S7_S3 -1000 1000 /end CHARACTERISTIC
/begin CHARACTERISTIC MS_MOTIAEANFERK_KON_ANS "Momentschwelle aus dem Getriebeeingangsmoment m_m_mot_in zur praediktiven Erkennung einer IAE-Anfahrt im Zustand IAE Kriechen" VALUE 0x26AB14 FLOAT32_IEEE_COL_DIRECT_M_S7_S3 0 trq_fl_a_M_S7_S3 -1000 1000 /end CHARACTERISTIC
/begin CHARACTERISTIC MS_RESEM_KON_ANS "Minmalwert fuer m_soll_res_em im Zustand KON" VALUE 0x26AB20 FLOAT32_IEEE_COL_DIRECT_M_S7_S3 0 trq_fl_a_M_S7_S3 0 200 /end CHARACTERISTIC
/begin CHARACTERISTIC MS_RESEM_SST_ANS "Minmalwert fuer m_soll_res_em im Zustand ANS" VALUE 0x26AB2C FLOAT32_IEEE_COL_DIRECT_M_S7_S3 0 trq_fl_a_M_S7_S3 0 200 /end CHARACTERISTIC
/begin CHARACTERISTIC MS_SOLLK0K0SREG_SYN_ANS "Schwelle fuer das K0-Sollmoment der HAS als Basisbedingung fuer die Anforderung der Aktivierung der K0-Schlupfregelung im Zustand K0 Synchronisieren beim Schleppstart" VALUE 0x26AB34 FLOAT32_IEEE_COL_DIRECT_M_S7_S3 0 trq_fl_a_M_S7_S3 -1000 1000 /end CHARACTERISTIC
/begin CHARACTERISTIC MS_WUNSCHIAEANFERK_KON_ANS "Momentschwelle aus dem Fahrerwunschmoment m_wunsch_fpw_hst_in zur praediktiven Erkennung einer IAE-Anfahrt im Zustand IAE Kriechen" VALUE 0x26AB38 FLOAT32_IEEE_COL_DIRECT_M_S7_S3 0 trq_fl_a_M_S7_S3 -1000 1000 /end CHARACTERISTIC
/begin CHARACTERISTIC MS_ZIELPHYSK0_SST_ANS "Schwellwert fuer Aktivierung Hysteresekompensation" VALUE 0x26AB40 FLOAT32_IEEE_COL_DIRECT_M_S7_S3 0 trq_fl_a_M_S7_S3 -1000 1000 /end CHARACTERISTIC
/begin CHARACTERISTIC MS_ZIELVMK0SREG_SYN_ANS "Schwelle fuer das VM-Zielmoment als Basisbedingung fuer die Anforderung der Aktivierung der K0-Schlupfregelung im Zustand K0 Synchronisieren beim Schleppstart" VALUE 0x26AB44 FLOAT32_IEEE_COL_DIRECT_M_S7_S3 0 trq_fl_a_M_S7_S3 -1000 1000 /end CHARACTERISTIC
/begin CHARACTERISTIC MS_ZMSOLLEMAKTIV_KON_ANS "Momentenschwelle fuer die Aktivierung z_m_soll_em_has (Eingangsgroesse m_soll_em_has) Im Zustand KON -> SCL" VALUE 0x26AB48 FLOAT32_IEEE_COL_DIRECT_M_S7_S3 0 trq_fl_a_M_S7_S3 0 1000 /end CHARACTERISTIC
/begin CHARACTERISTIC N_MINEMNSOLLVM_KON_ANS "Minimale EM-Drehzahl als Basis fuer die Bestimmung der VM-Solldrehzahl ab dem Zustand Konditionieren und in dem Zustand Schaltung aktiv beim Schleppstart" VALUE 0x26AC2C FLOAT32_IEEE_COL_DIRECT_M_S7_S3 0 n_fl_M_S7_S3 0 2000 /end CHARACTERISTIC
/begin CHARACTERISTIC ND_IAEANFAHRENTK_ANS "Differenzdrehzahlschwelle ab der im Konditionieren (IAE Anfahren) ein anderes K0 Moment vorgegeben wird" VALUE 0x26AB90 FLOAT32_IEEE_COL_DIRECT_M_S7_S3 0 n_fl_M_S7_S3 0 10000 /end CHARACTERISTIC
/begin CHARACTERISTIC ND_IAEBED_KON_ANS "IAE-Differenzdrehzahlschwelle als Uebergangsbedingung von KON -> SST" VALUE 0x26AB94 FLOAT32_IEEE_COL_DIRECT_M_S7_S3 0 n_fl_M_S7_S3 -10000 10000 /end CHARACTERISTIC
/begin CHARACTERISTIC ND_MIN_SAF_ANS "Ausgabe Mindesdrehzahlsprung  an die ASIS fuer RespSLST V2" VALUE 0x26AB98 FLOAT32_IEEE_COL_DIRECT_M_S7_S3 0 n_fl_M_S7_S3 -3000 3000 /end CHARACTERISTIC
/begin CHARACTERISTIC NDGS_K0K0SREG_SYN_ANS "Maximaler Betrag des K0-Differenzdrehzahlgradienten zur Bestimmung des Zeitpunkts der Anforderung der Aktivierung der K0-Schlupfregelung im Zustand K0 Synchronisieren beim Schleppstart" VALUE 0x26AB54 FLOAT32_IEEE_COL_DIRECT_M_S7_S3 0 ng_fl_M_S7_S3 0 10000 /end CHARACTERISTIC
/begin CHARACTERISTIC NDGS_K0SYNCERK_SYN_ANS "Minimaler K0-Differenzdrehzahlgradient (negativer Wert!) zur Erkennung Synchron im Zustand K0 Synchronisieren beim Schleppstart" VALUE 0x26AB58 FLOAT32_IEEE_COL_DIRECT_M_S7_S3 0 ng_fl_M_S7_S3 -10000 10000 /end CHARACTERISTIC
/begin CHARACTERISTIC NDS_EMNSOLLLLVMBED_ZND_ANS "Differenzdrehzahlschwelle n_em_in - n_soll_ll_vm_in als Ubergangsbedingung von ZND -> SYN" VALUE 0x26AB60 FLOAT32_IEEE_COL_DIRECT_M_S7_S3 0 n_fl_M_S7_S3 -10000 10000 /end CHARACTERISTIC
/begin CHARACTERISTIC NDS_K0BED_ZND_ANS "K0-Differenzdrehzahlschwelle fuer den Uebergang ZND - SYN" VALUE 0x26AB68 FLOAT32_IEEE_COL_DIRECT_M_S7_S3 0 n_fl_M_S7_S3 -10000 10000 /end CHARACTERISTIC
/begin CHARACTERISTIC NDS_K0SYNCERKDDA_SYN_ANS "Schwellwert der Differenzdrehzahl zur Erkennung Synchron bei durchdrehenden Antriebsraedern beim Schleppstart" VALUE 0x26AB6C FLOAT32_IEEE_COL_DIRECT_M_S7_S3 0 n_fl_M_S7_S3 0 10000 /end CHARACTERISTIC
/begin CHARACTERISTIC NDS_K0SYNCERKMAX_SYN_ANS "Schwellwert nach Umschaltung der Differenzdrehzahl zur Erkennung Synchron beim VM-Schleppstart" VALUE 0x26AB70 FLOAT32_IEEE_COL_DIRECT_M_S7_S3 0 n_fl_M_S7_S3 0 10000 /end CHARACTERISTIC
/begin CHARACTERISTIC NDS_SOLLIAEZMMAXIAE_SYN_ANS "Drehzahldifferenzschwelle zur Deaktivierung der IAE-Entkopplungsanforderung" VALUE 0x26AB78 FLOAT32_IEEE_COL_DIRECT_M_S7_S3 0 n_fl_M_S7_S3 -10000 10000 /end CHARACTERISTIC
/begin CHARACTERISTIC NDS_VMDREHTBED_ZND_ANS "Differenzdrehzahlschwelle VM fuer VM dreht  fuer den Uebergang ZND - SYN" VALUE 0x26AB80 FLOAT32_IEEE_COL_DIRECT_M_S7_S3 0 n_fl_M_S7_S3 -10000 10000 /end CHARACTERISTIC
/begin CHARACTERISTIC NDS_VMFEHLERBED_ZND_ANS "Differenzdrehzahlschwelle VM startet fehlerhaft fuer den Uebergang ZND - SYN" VALUE 0x26AB84 FLOAT32_IEEE_COL_DIRECT_M_S7_S3 0 n_fl_M_S7_S3 -10000 10000 /end CHARACTERISTIC
/begin CHARACTERISTIC NDS_VMLAEUFTBED_ZND_ANS "Differenzdrehzahlschwelle VM fuer VM laeuft fuer den Uebergang ZND - SYN" VALUE 0x26AB88 FLOAT32_IEEE_COL_DIRECT_M_S7_S3 0 n_fl_M_S7_S3 -10000 10000 /end CHARACTERISTIC
/begin CHARACTERISTIC NDS_ZNSOLLEM_INAKTIV_ANS "Drehzahlschwelle fuer Deaktivierung EM-Solldrehzahlvorgabe" VALUE 0x26AB8C FLOAT32_IEEE_COL_DIRECT_M_S7_S3 0 n_fl_M_S7_S3 -10000 10000 /end CHARACTERISTIC
/begin CHARACTERISTIC NG_EMMODRSMIN_SYN_ANS "Minimaler Gradient der modifizierten EM-Drehzahl als Basisdrehzahl zur Bestimmung der VM Solldrehzahl bei RS beim K0 Synchronisieren beim Schleppstart" VALUE 0x26ABA0 FLOAT32_IEEE_COL_DIRECT_M_S7_S3 0 n_fl_M_S7_S3 -50000 0 /end CHARACTERISTIC
/begin CHARACTERISTIC NG_SOLLEM_KON_ANS "Drehzahlgradient zur Ueberfuehrung der EM-Solldrehzahl" VALUE 0x26ABAC FLOAT32_IEEE_COL_DIRECT_M_S7_S3 0 ng_fl_M_S7_S3 -10000 10000 /end CHARACTERISTIC
/begin CHARACTERISTIC NG_SOLLEMIAEENTK_SYN_ANS "Drehzahlgradient zur Ueberfuehrung der EM-Solldrehzahl auf die sekundaere IAE-Drehzahl beim K0-Synchronisieren im Schleppstart" VALUE 0x26ABA4 FLOAT32_IEEE_COL_DIRECT_M_S7_S3 0 ng_fl_M_S7_S3 -10000 10000 /end CHARACTERISTIC
/begin CHARACTERISTIC NG_SOLLEMNSOLLLLVM_KON_ANS "Drehzahlgradient fuer n_soll_em < n_soll_ll_vm von KON -SCL" VALUE 0x26ABA8 FLOAT32_IEEE_COL_DIRECT_M_S7_S3 0 ng_fl_M_S7_S3 -10000 10000 /end CHARACTERISTIC
/begin CHARACTERISTIC NGS_VMSYNCERK_SYN_ANS "Maximaler VM Drehzahlgradient zur Erkennung Synchron im Zustand K0 Synchronisieren beim Schleppstart" VALUE 0x26AB9C FLOAT32_IEEE_COL_DIRECT_M_S7_S3 0 ng_fl_M_S7_S3 -10000 10000 /end CHARACTERISTIC
/begin CHARACTERISTIC NO_EMNSOLLVMRESPPARALRS_KON_ANS "Negativer Offset bei paralleem Schleppstart mit Rueckschaltung " VALUE 0x26ABBC FLOAT32_IEEE_COL_DIRECT_M_S7_S3 0 n_fl_M_S7_S3 -1000 0 /end CHARACTERISTIC
/begin CHARACTERISTIC NO_EMNSOLLVMRESPPARALRS_SYN_ANS "" VALUE 0x26ABC0 FLOAT32_IEEE_COL_DIRECT_M_S7_S3 0 n_fl_M_S7_S3 0 10000 /end CHARACTERISTIC
/begin CHARACTERISTIC NO_NSOLLLLVM_RESPS_SRT_ANS "Drehzahlschwelle zur Aktivierung von z_respschle.." VALUE 0x26ABC8 FLOAT32_IEEE_COL_DIRECT_M_S7_S3 0 n_fl_M_S7_S3 -1000 1000 /end CHARACTERISTIC
/begin CHARACTERISTIC NO_NVMSOLLNEM_SYN_ANS "Offset ab wann die VM Solldrehzahl abgefiltert werden soll" VALUE 0x26ABCC FLOAT32_IEEE_COL_DIRECT_M_S7_S3 0 n_fl_M_S7_S3 -10000 10000 /end CHARACTERISTIC
/begin CHARACTERISTIC NO_SECIAEFIL_NZIELEMANF_ANS "Drehzahloffset auf n_sec_iae_fil fuer die EM-Solldrehzahlueberfuehrung beim status_iae_in = Entkoppelt - Anfahren" VALUE 0x26ABD0 FLOAT32_IEEE_COL_DIRECT_M_S7_S3 0 n_fl_M_S7_S3 -10000 10000 /end CHARACTERISTIC
/begin CHARACTERISTIC NO_SOLLLLVM_NZIELEM_ANS "Drehzahloffset auf n_soll_ll_vm_in zur Bestimmung der n_em_ziel_grad_ans" VALUE 0x26ABD8 FLOAT32_IEEE_COL_DIRECT_M_S7_S3 0 n_fl_M_S7_S3 -10000 10000 /end CHARACTERISTIC
/begin CHARACTERISTIC NO_SOLLLLVM_NZIELEMANF_ANS "Drehzahloffset auf n_soll_ll_vm_in fuer die EM-Solldrehzahlueberfuehrung beim status_iae_in = Entkoppelt - Anfahren" VALUE 0x26ABD4 FLOAT32_IEEE_COL_DIRECT_M_S7_S3 0 n_fl_M_S7_S3 -10000 10000 /end CHARACTERISTIC
/begin CHARACTERISTIC NO_SOLLVMNREGEM_SYN_ANS "Drehzahloffset auf  n_soll_ll_vm_in, wenn status_nreg_em_hst_in = TRUE" VALUE 0x26ABDC FLOAT32_IEEE_COL_DIRECT_M_S7_S3 0 n_fl_M_S7_S3 0 10000 /end CHARACTERISTIC
/begin CHARACTERISTIC NOS_EMNSOLLVM_SYN_ANS "Schwelle zur Initialisierung des Timers fuer die Umschaltung der Differenzdrehzahlschwelle zur Erkennung Synchron beim VM Schleppstart" VALUE 0x26ABB4 FLOAT32_IEEE_COL_DIRECT_M_S7_S3 0 n_fl_M_S7_S3 0 10000 /end CHARACTERISTIC
/begin CHARACTERISTIC NOS_EMNSOLLVMK0SREG_SYN_ANS "Schwelle des Drehzahloffsets der VM-Solldrehzahl zur EM-Drehzahl zur Bestimmung des Zeitpunkts der Anforderung der Aktivierung der K0-Schlupfregelung im Zustand K0 Synchronisieren beim Schleppstart" VALUE 0x26ABB0 FLOAT32_IEEE_COL_DIRECT_M_S7_S3 0 n_fl_M_S7_S3 0 10000 /end CHARACTERISTIC
/begin CHARACTERISTIC NOS_NSOLLVMZK0SREGBAS_SYN_ANS "" VALUE 0x26ABB8 FLOAT32_IEEE_COL_DIRECT_M_S7_S3 0 n_fl_M_S7_S3 0 10000 /end CHARACTERISTIC
/begin CHARACTERISTIC NS_EMIAEANFAHRENTK_ANS "Drehzahlschwelle ab der im Konditionieren (IAE Anfahren) ein anderes K0 Moment vorgegeben wird" VALUE 0x26ABE4 FLOAT32_IEEE_COL_DIRECT_M_S7_S3 0 n_fl_M_S7_S3 -10000 10000 /end CHARACTERISTIC
/begin CHARACTERISTIC NS_EMMINBED_SCL_ANS "Drehzahlschwelle n_em_in als Uebergangsbedingung von SCL -> UEB" VALUE 0x26ABE8 FLOAT32_IEEE_COL_DIRECT_M_S7_S3 0 n_fl_M_S7_S3 -10000 10000 /end CHARACTERISTIC
/begin CHARACTERISTIC NS_EMMINBED_SST_ANS "Drehzahlschwelle n_em_in als Uebergangsbedingung von SST -> ZND" VALUE 0x26ABEC FLOAT32_IEEE_COL_DIRECT_M_S7_S3 0 n_fl_M_S7_S3 -10000 10000 /end CHARACTERISTIC
/begin CHARACTERISTIC NS_EMMINBED_SYN_ANS "Drehzahlschwelle n_em_in als Uebergangsbedingung von SYN -> SCL" VALUE 0x26ABF0 FLOAT32_IEEE_COL_DIRECT_M_S7_S3 0 n_fl_M_S7_S3 -10000 10000 /end CHARACTERISTIC
/begin CHARACTERISTIC NS_K0ABSTELLPOSUNGUELTIG_SST_ANS "Drehzahloffset der K0 Vorgabe fuer Abstellpos. ungueltig" VALUE 0x26ABF4 FLOAT32_IEEE_COL_DIRECT_M_S7_S3 0 n_fl_M_S7_S3 -10000 10000 /end CHARACTERISTIC
/begin CHARACTERISTIC NS_MGK0VMSTART_SST_ANS "Drehzahlschwelle fuer Umschaltung mg_soll_k0 von Rampe 1 nach Rampe 2" VALUE 0x26ABF8 FLOAT32_IEEE_COL_DIRECT_M_S7_S3 0 n_fl_M_S7_S3 -10000 10000 /end CHARACTERISTIC
/begin CHARACTERISTIC NS_MOK0ABSTELLPOSNVM_SST_ANS "Umschalten der Eingangsgroessen n_vm_in nach nd_k0" VALUE 0x26ABFC FLOAT32_IEEE_COL_DIRECT_M_S7_S3 0 n_fl_M_S7_S3 -10000 10000 /end CHARACTERISTIC
/begin CHARACTERISTIC NS_NEM_RESPPARAL_SRT_ANS "EM-Drehzahlschwelle zum aktiveren des SLST SCHLTG" VALUE 0x26AC04 FLOAT32_IEEE_COL_DIRECT_M_S7_S3 0 n_fl_M_S7_S3 -10000 10000 /end CHARACTERISTIC
/begin CHARACTERISTIC NS_NVMCONDBED_SAK_ANS "VM-Drehzahlschwelle fuer den Uebergang SAK -> KON" VALUE 0x26AC08 FLOAT32_IEEE_COL_DIRECT_M_S7_S3 0 n_fl_M_S7_S3 -10000 10000 /end CHARACTERISTIC
/begin CHARACTERISTIC NS_VMDREHT_SST_ANS "Drehzahlschwelle VM dreht" VALUE 0x26AC1C FLOAT32_IEEE_COL_DIRECT_M_S7_S3 0 n_fl_M_S7_S3 -10000 10000 /end CHARACTERISTIC
/begin CHARACTERISTIC NS_VMFEHLER_SST_ANS "Drehzahlschwelle n_VN fuer Fehler" VALUE 0x26AC20 FLOAT32_IEEE_COL_DIRECT_M_S7_S3 0 n_fl_M_S7_S3 -10000 10000 /end CHARACTERISTIC
/begin CHARACTERISTIC NS_VMLAEUFT_SST_ANS "VM Drehzahlschwelle n_VM laeuft" VALUE 0x26AC24 FLOAT32_IEEE_COL_DIRECT_M_S7_S3 0 n_fl_M_S7_S3 -10000 10000 /end CHARACTERISTIC
/begin CHARACTERISTIC NS_VMMRESAUS_ANS "Drehzahlschwelle n_vm fuer wegnehmen m_res" VALUE 0x26AC28 FLOAT32_IEEE_COL_DIRECT_M_S7_S3 0 n_fl_M_S7_S3 -10000 10000 /end CHARACTERISTIC
/begin CHARACTERISTIC STATUS_ABL_K0ENTK_SST_ANS "Statusrueckmeldung an HST bei K0-Entkopplung" VALUE 0x26F12E UBYTE_COL_DIRECT_M_S7_S3 0 void_int_M_S7_S3 0 15 /end CHARACTERISTIC
/begin CHARACTERISTIC STATUS_ABL_KOLBENPOSK0_KON_ANS "Projektspezifische Vorgabe des Zahlenwerts fuer den Ablaufstatus status_ablauf_has in Abhaengigkeit status_kolbenpos_k0_in" VALUE 0x26F12F UBYTE_COL_DIRECT_M_S7_S3 0 void_int_M_S7_S3 0 15 /end CHARACTERISTIC
/begin CHARACTERISTIC STATUS_ABL_KON_ANS "Projektspezifische Vorgabe des Zahlenwerts fuer den Ablaufstatus status_ablauf_has in den einzelnen Zustaenden eines Hybridablaufs" VALUE 0x26F130 UBYTE_COL_DIRECT_M_S7_S3 0 void_int_M_S7_S3 0 15 /end CHARACTERISTIC
/begin CHARACTERISTIC STATUS_ABL_SCL_ANS "Projektspezifische Vorgabe des Zahlenwerts fuer den Ablaufstatus status_ablauf_has in den einzelnen Zustaenden eines Hybridablaufs" VALUE 0x26F132 UBYTE_COL_DIRECT_M_S7_S3 0 void_int_M_S7_S3 0 15 /end CHARACTERISTIC
/begin CHARACTERISTIC STATUS_ABL_SRT_ANS "Projektspezifische Vorgabe des Zahlenwerts fuer den Ablaufstatus status_ablauf_has in dem Zustand St_Start" VALUE 0x26F133 UBYTE_COL_DIRECT_M_S7_S3 0 void_int_M_S7_S3 0 15 /end CHARACTERISTIC
/begin CHARACTERISTIC STATUS_ABL_SST_ANS "Projektspezifische Vorgabe des Zahlenwerts fuer den Ablaufstatus status_ablauf_has in den einzelnen Zustaenden eines Hybridablaufs" VALUE 0x26F134 UBYTE_COL_DIRECT_M_S7_S3 0 void_int_M_S7_S3 0 15 /end CHARACTERISTIC
/begin CHARACTERISTIC STATUS_ABL_SYN_ANS "Projektspezifische Vorgabe des Zahlenwerts fuer den Ablaufstatus status_ablauf_has in den einzelnen Zustaenden eines Hybridablaufs" VALUE 0x26F135 UBYTE_COL_DIRECT_M_S7_S3 0 void_int_M_S7_S3 0 15 /end CHARACTERISTIC
/begin CHARACTERISTIC STATUS_ABL_ZIAEENTK_HST_KON_ANS "Projektspezifische Vorgabe des Zahlenwerts fuer den Ablaufstatus status_ablauf_has in den einzelnen Zustaenden eines Hybridablaufs" VALUE 0x26F136 UBYTE_COL_DIRECT_M_S7_S3 0 void_int_M_S7_S3 0 15 /end CHARACTERISTIC
/begin CHARACTERISTIC STATUS_ABL_ZND_ANS "Projektspezifische Vorgabe des Zahlenwerts fuer den Ablaufstatus status_ablauf_has in den einzelnen Zustaenden eines Hybridablaufs" VALUE 0x26F137 UBYTE_COL_DIRECT_M_S7_S3 0 void_int_M_S7_S3 0 15 /end CHARACTERISTIC
/begin CHARACTERISTIC STATUS_ABL_ZNSOLLEM_KON_ANS "Projektspezifische Vorgabe des Zahlenwerts fuer den Ablaufstatus status_ablauf_has in den einzelnen Zustaenden eines Hybridablaufs" VALUE 0x26F138 UBYTE_COL_DIRECT_M_S7_S3 0 void_int_M_S7_S3 0 15 /end CHARACTERISTIC
/begin CHARACTERISTIC STATUS_ABLVMDREHT_HST_SST_ANS "Anzeige der Strategie fuer VM dreht" VALUE 0x26F128 UBYTE_COL_DIRECT_M_S7_S3 0 void_int_M_S7_S3 0 8 /end CHARACTERISTIC
/begin CHARACTERISTIC STATUS_ABLVMDREHT_HST_ZND_ANS "Anzeige der Strategie fuer VM dreht" VALUE 0x26F129 UBYTE_COL_DIRECT_M_S7_S3 0 void_int_M_S7_S3 0 8 /end CHARACTERISTIC
/begin CHARACTERISTIC STATUS_ABLVMFEHLER_HST_SST_ANS "Status Ablauf von HST VM startet fehlerhaft" VALUE 0x26F12A UBYTE_COL_DIRECT_M_S7_S3 0 void_int_M_S7_S3 0 8 /end CHARACTERISTIC
/begin CHARACTERISTIC STATUS_ABLVMFEHLER_HST_ZND_ANS "Status Ablauf von HST VM startet fehlerhaft" VALUE 0x26F12B UBYTE_COL_DIRECT_M_S7_S3 0 void_int_M_S7_S3 0 8 /end CHARACTERISTIC
/begin CHARACTERISTIC STATUS_ABLVMLAEUFT_HST_SST_ANS "Anzeige der Strategie fuer VM laeuft" VALUE 0x26F12C UBYTE_COL_DIRECT_M_S7_S3 0 void_int_M_S7_S3 0 8 /end CHARACTERISTIC
/begin CHARACTERISTIC STATUS_ABLVMLAEUFT_HST_ZND_ANS "Anzeige der Strategie fuer VM laeuft" VALUE 0x26F12D UBYTE_COL_DIRECT_M_S7_S3 0 void_int_M_S7_S3 0 8 /end CHARACTERISTIC
/begin CHARACTERISTIC STATUS_ABSTELLPOSVMGUELTIG_ANS "Abstellposition gueltig" VALUE 0x26F139 UBYTE_COL_DIRECT_M_S7_S3 0 void_int_M_S7_S3 0 2 /end CHARACTERISTIC
/begin CHARACTERISTIC STATUS_K0ZMSOLLEMAKTIV_KON_ANS "Status K0 fuer die Aktivierung z_m_soll_em_has im Zustand KON" VALUE 0x26F13A UBYTE_COL_DIRECT_M_S7_S3 0 void_int_M_S7_S3 0 8 /end CHARACTERISTIC
/begin CHARACTERISTIC STATUS_K0ZMSOLLEMAKTIV_SST_ANS "Status K0 fuer die Aktivierung z_m_soll_em_has im Zustand SST -> SYN, ABB" VALUE 0x26F13B UBYTE_COL_DIRECT_M_S7_S3 0 void_int_M_S7_S3 0 8 /end CHARACTERISTIC
/begin CHARACTERISTIC SWI_ABBRUCH_AKTIV_ANS "Schalter Abbruch Schleppstart" VALUE 0x26F13C UBYTE_COL_DIRECT_M_S7_S3 0 swi_int_M_S7_S3 0 1 /end CHARACTERISTIC
/begin CHARACTERISTIC SWI_AUSW_NIAEANF_ANS "Umschaltung: n_soll_em_has ueber n_motanfahr_gef_iae (1) oder n_soll_em_has (0)" VALUE 0x26F13E UBYTE_COL_DIRECT_M_S7_S3 0 swi_int_M_S7_S3 0 1 /end CHARACTERISTIC
/begin CHARACTERISTIC SWI_K0SREGBASIS_SYN_ANS "Aktivierung und Konfiguration der Aktivierung der K0 Schlupfregelung beim K0 Synchronisieren beim Schleppstart: bit0 = K0SREG aktiv, bit1 = Beruecksichtigung IAE, bit2 = Ber. Schaltung, bit3 = Ber. FST" VALUE 0x26F140 UBYTE_COL_DIRECT_M_S7_S3 0 swi_int_o_M_S7_S3 0 15 /end CHARACTERISTIC
/begin CHARACTERISTIC SWI_KFMGK0AUSWAHL_SYN_ANS "Auswahl des KF_MGK0xxx_SYN_ANS - FALSE = xxxNDK0M_x, TRUE = xxxNDK0NGVM_x im Zustand K0 Synchronisieren beim SLST" VALUE 0x26F141 UBYTE_COL_DIRECT_M_S7_S3 0 swi_int_M_S7_S3 0 1 /end CHARACTERISTIC
/begin CHARACTERISTIC SWI_MK0MOD_HAS_ANS "Schalter zur Umschaltung zwischen  m_stoer_k0_em_verz_fil und m_k0_mod_has_ablauf zur Ausgabe auf m_k0_mod. 0: m_k0_mod = m_k0_mod_has_ablauf 1: m_k0_mod = m_stoer_k0_em_verz_fil
" VALUE 0x26F142 UBYTE_COL_DIRECT_M_S7_S3 0 swi_int_M_S7_S3 0 1 /end CHARACTERISTIC
/begin CHARACTERISTIC SWI_MSTOERK0EMFILMK0_KON_ANS "Umschaltung der Einganggroessen fuer Berechnung msollem =f(mstoerkoemverzfil oder m_k0_in)" VALUE 0x26F143 UBYTE_COL_DIRECT_M_S7_S3 0 swi_int_M_S7_S3 0 1 /end CHARACTERISTIC
/begin CHARACTERISTIC SWI_MSTOERK0EMMK0_KON_ANS "Umschaltung der Einganggroessen m_stoer_k0_em_verz_fil (SWI TRUE) nach m_k0_in (SWI FALSE)" VALUE 0x26F144 UBYTE_COL_DIRECT_M_S7_S3 0 swi_int_M_S7_S3 0 1 /end CHARACTERISTIC
/begin CHARACTERISTIC SWI_MSTOERK0EMMK0_SST_ANS "Umschaltung der Einganggroessen m_stoer_k0_em_verz_fil (SWI = 1) nach m_k0_in (SWI = 0) im Zustand SST -> SYN" VALUE 0x26F145 UBYTE_COL_DIRECT_M_S7_S3 0 swi_int_M_S7_S3 0 1 /end CHARACTERISTIC
/begin CHARACTERISTIC SWI_NMOTSOLLIAEFILAKTIV_ANS "Filterung der IAE Anfahrdrehzahl - ja oder nein" VALUE 0x26F147 UBYTE_COL_DIRECT_M_S7_S3 0 swi_int_M_S7_S3 0 1 /end CHARACTERISTIC
/begin CHARACTERISTIC SWI_NSOLLEMENTKIAE_KON_ANS "Umschaltung auf die Einganggroessen n_soll_em_has fuer Berechnung n_soll_vm_has bei einem IAE-Entkoppelten SLST" VALUE 0x26F148 UBYTE_COL_DIRECT_M_S7_S3 0 swi_int_M_S7_S3 0 1 /end CHARACTERISTIC
/begin CHARACTERISTIC SWI_NSOLLVMENTKIAE_KON_ANS "Aktivierung der Bestimmung n_soll_vm_has bei einem IAE-Entkoppelten SLST" VALUE 0x26F149 UBYTE_COL_DIRECT_M_S7_S3 0 swi_int_M_S7_S3 0 1 /end CHARACTERISTIC
/begin CHARACTERISTIC SWI_NZIELEMBEGRLLS_ANS "Aktivierung der Begrenzung des Zielwerts der EM-Solldrehzahl auf die minimale EM-Drehzahl der HAS (LLS)" VALUE 0x26F14A UBYTE_COL_DIRECT_M_S7_S3 0 swi_int_M_S7_S3 0 1 /end CHARACTERISTIC
/begin CHARACTERISTIC SWI_RESPPARAL_SRT_ANS "Schalter zum aktivieren des parallelen Schleppstart Schaltung" VALUE 0x26F14C UBYTE_COL_DIRECT_M_S7_S3 0 swi_int_M_S7_S3 0 1 /end CHARACTERISTIC
/begin CHARACTERISTIC SWI_RESPPARALHS_SRT_ANS "Schalter zum aktivieren des parallelen Schleppstart Hochschaltung " VALUE 0x26F14B UBYTE_COL_DIRECT_M_S7_S3 0 swi_int_M_S7_S3 0 1 /end CHARACTERISTIC
/begin CHARACTERISTIC SWI_RESPSCHLE_SCHALT_SRT_ANS "Schalter zum aktivieren des Response Schleppstarts" VALUE 0x26F14D UBYTE_COL_DIRECT_M_S7_S3 0 swi_int_M_S7_S3 0 1 /end CHARACTERISTIC
/begin CHARACTERISTIC SWI_SAF_SYN_ANS "SWI zur Aktiverung der Schaltaufforderung an ASIS im Zustand Synchronieren" VALUE 0x26F14F UBYTE_COL_DIRECT_M_S7_S3 0 swi_int_M_S7_S3 0 1 /end CHARACTERISTIC
/begin CHARACTERISTIC SWI_SAS_ANS "Schalter zur Akivierung der Befuellreihenfolge bei RespSchleSchalt V2" VALUE 0x26F150 UBYTE_COL_DIRECT_M_S7_S3 0 swi_int_M_S7_S3 0 1 /end CHARACTERISTIC
/begin CHARACTERISTIC SWI_STLASTWECHSELAKTIV_SRT_ANS "Die Funktion ist aktiviert falls SWI = true" VALUE 0x26F152 UBYTE_COL_DIRECT_M_S7_S3 0 swi_int_M_S7_S3 0 1 /end CHARACTERISTIC
/begin CHARACTERISTIC SWI_SYNCDDA_ANS "Schalter zur Aktivierung der Beeinflussung der K0-Synchronisation bei durchdrehenden Antriebsraedern beim Schleppstart" VALUE 0x26F154 UBYTE_COL_DIRECT_M_S7_S3 0 swi_int_M_S7_S3 0 1 /end CHARACTERISTIC
/begin CHARACTERISTIC SWI_UMSCH_NDIAENEM_ANS "Umschaltung Berechnung nd_znsollem = f(nd_iae) oder f=(nem)" VALUE 0x26F15B UBYTE_COL_DIRECT_M_S7_S3 0 swi_int_M_S7_S3 0 1 /end CHARACTERISTIC
/begin CHARACTERISTIC SWI_UMSCH_NSOLLEM_ABFIL_ANS "Umschaltung der Berechnung fuer das Abfiltern der n_soll_em_has (SWI = 1, n_em_in/nd_iae_ans; SWI = 0, n_sec_iae_fil, 0) " VALUE 0x26F15C UBYTE_COL_DIRECT_M_S7_S3 0 swi_int_M_S7_S3 0 1 /end CHARACTERISTIC
/begin CHARACTERISTIC SWI_UMSCH_ZVMSTARTFEHLER_ANS "Swi zur Deaktivierung der K0 und VM Vorgaben wenn VM nicht zuendet" VALUE 0x26F15D UBYTE_COL_DIRECT_M_S7_S3 0 swi_int_M_S7_S3 0 1 /end CHARACTERISTIC
/begin CHARACTERISTIC SWI_UMSCHMGMOT_SRT_ANS "Umschaltung der Einganggroessen mg_mot_sbe = TRUE, mg_wunsch_fpw_hst = FALSE" VALUE 0x26F155 UBYTE_COL_DIRECT_M_S7_S3 0 swi_int_M_S7_S3 0 1 /end CHARACTERISTIC
/begin CHARACTERISTIC SWI_UMSCHMSOLLK0MMOT_ANS "Umschaltung der Eingangsgroesse fuer KF_TVMSTOERK0EMFIL_ANS = f(m_soll_k0_has_alt oder m_mot_in)" VALUE 0x26F156 UBYTE_COL_DIRECT_M_S7_S3 0 swi_int_M_S7_S3 0 1 /end CHARACTERISTIC
/begin CHARACTERISTIC SWI_UMSCHMSTOERK0MMOT_ANS "Umschaltung der Eingangsgroesse fuer KF_UMSCHMSTOERK0MMOT_ANS = f(m_soll_k0_has_alt oder m_mot_in)" VALUE 0x26F158 UBYTE_COL_DIRECT_M_S7_S3 0 swi_int_M_S7_S3 0 1 /end CHARACTERISTIC
/begin CHARACTERISTIC SWI_UMSCHSTATUSABL_KON_ANS "Umschaltung der Ausgabe status_ablauf_has in Abhaengigkeit von der K0-Kolbenposition (SWI = TRUE) oder z_n_soll_em_has (SWI_FALSE) " VALUE 0x26F15A UBYTE_COL_DIRECT_M_S7_S3 0 swi_int_M_S7_S3 0 1 /end CHARACTERISTIC
/begin CHARACTERISTIC SWI_ZANFIAEVERRAKTIV_KON_ANS "Umschaltung Erkennung von z_anfiae_erk_ans auf steigende Flange oder immer in St_Konditionieren" VALUE 0x26F15E UBYTE_COL_DIRECT_M_S7_S3 0 swi_int_M_S7_S3 0 1 /end CHARACTERISTIC
/begin CHARACTERISTIC SWI_ZK0BEFIAE_AKTIV_ANS "Schalter zur Aktivierung der Verzoegerung der K0-Befuellung bei entkoppelten Schleppstarts" VALUE 0x26F15F UBYTE_COL_DIRECT_M_S7_S3 0 swi_int_M_S7_S3 0 1 /end CHARACTERISTIC
/begin CHARACTERISTIC SWI_ZK0SREGMODUS_SYN_ANS "Festlegung des Modus zur Bestimmung des Zeitpunkts der Aktivierung der K0 Schlupfregelung beim K0 Synchronisieren beim Schleppstart: 0 = NDSK0, 1 = NVMEINZUG" VALUE 0x26F160 UBYTE_COL_DIRECT_M_S7_S3 0 swi_int_M_S7_S3 0 1 /end CHARACTERISTIC
/begin CHARACTERISTIC SWI_ZMMAXIAE_SYN_ANS "SWI zur Umschaltung IAE Vorsteuermoment aus der HAS" VALUE 0x26F161 UBYTE_COL_DIRECT_M_S7_S3 0 swi_int_M_S7_S3 0 1 /end CHARACTERISTIC
/begin CHARACTERISTIC SWI_ZMSOLLEM_KON_ANS "SWI Vorgabe Sollmoment EM" VALUE 0x26F164 UBYTE_COL_DIRECT_M_S7_S3 0 swi_int_M_S7_S3 0 1 /end CHARACTERISTIC
/begin CHARACTERISTIC SWI_ZMSOLLEM_NULL_SCL_ANS "SWI zur Umschaltung Aktivierung EM Sollmoment" VALUE 0x26F165 UBYTE_COL_DIRECT_M_S7_S3 0 swi_int_M_S7_S3 0 1 /end CHARACTERISTIC
/begin CHARACTERISTIC SWI_ZMSOLLEM_SCL_ANS "SWI Vorgabe Sollmoment EM" VALUE 0x26F166 UBYTE_COL_DIRECT_M_S7_S3 0 swi_int_M_S7_S3 0 1 /end CHARACTERISTIC
/begin CHARACTERISTIC SWI_ZMSOLLEM_SST_ANS "SWI Vorgabe Sollmoment EM" VALUE 0x26F167 UBYTE_COL_DIRECT_M_S7_S3 0 swi_int_M_S7_S3 0 1 /end CHARACTERISTIC
/begin CHARACTERISTIC SWI_ZMSOLLEM_SYN_ANS "SWI Vorgabe Sollmoment EM" VALUE 0x26F168 UBYTE_COL_DIRECT_M_S7_S3 0 swi_int_M_S7_S3 0 1 /end CHARACTERISTIC
/begin CHARACTERISTIC SWI_ZNSOLLEM_KON_ANS "SWI Vorgabe Solldrehzahl EM" VALUE 0x26F16D UBYTE_COL_DIRECT_M_S7_S3 0 swi_int_M_S7_S3 0 1 /end CHARACTERISTIC
/begin CHARACTERISTIC SWI_ZNSOLLEM_SCL_ANS "SWI Vorgabe Solldrehzahl EM" VALUE 0x26F16E UBYTE_COL_DIRECT_M_S7_S3 0 swi_int_M_S7_S3 0 1 /end CHARACTERISTIC
/begin CHARACTERISTIC SWI_ZNSOLLEM_SST_ANS "SWI Vorgabe Solldrehzahl EM" VALUE 0x26F16F UBYTE_COL_DIRECT_M_S7_S3 0 swi_int_M_S7_S3 0 1 /end CHARACTERISTIC
/begin CHARACTERISTIC SWI_ZNSOLLEM_SYN_ANS "SWI Vorgabe Solldrehzahl EM" VALUE 0x26F170 UBYTE_COL_DIRECT_M_S7_S3 0 swi_int_M_S7_S3 0 1 /end CHARACTERISTIC
/begin CHARACTERISTIC SWI_ZNSOLLEMBED_SCL_ANS "Aktivierung Abfrage znsollem im Uebergang SCL -> UEB" VALUE 0x26F16B UBYTE_COL_DIRECT_M_S7_S3 0 swi_int_M_S7_S3 0 1 /end CHARACTERISTIC
/begin CHARACTERISTIC SWI_ZNSOLLEMMINMAX_SYN_ANS "Schalter zum Aktivieren der Funktion Ruecknahme z_n_soll_em_has, wenn die Drehzahlreglergrenzen = 0Nm erreicht werden (SWI =1 aktiv, Swi = 0 inaktiv)" VALUE 0x26F16C UBYTE_COL_DIRECT_M_S7_S3 0 swi_int_M_S7_S3 0 1 /end CHARACTERISTIC
/begin CHARACTERISTIC SWI_ZPHYSK0_KON_ANS "SWI fuer die Hysteresekompensation K0 im Zustand Konditionieren: 0 : Druckanteil p_hys_k0_has inaktiv 1 : Druckanteil p_hys_k0_has aktiv" VALUE 0x26F173 UBYTE_COL_DIRECT_M_S7_S3 0 swi_int_M_S7_S3 0 1 /end CHARACTERISTIC
/begin CHARACTERISTIC SWI_ZPHYSK0_SCL_ANS "SWI fuer die Hysteresekompensation K0 im Zustand k0 schliessen: 0 : Druckanteil p_hys_k0_has inaktiv 1 : Druckanteil p_hys_k0_has aktiv" VALUE 0x26F175 UBYTE_COL_DIRECT_M_S7_S3 0 swi_int_M_S7_S3 0 1 /end CHARACTERISTIC
/begin CHARACTERISTIC SWI_ZPHYSK0_SST_ANS "SWI fuer die Hysteresekompensation K0 im Zustand Anschleppen: 0 : Druckanteil p_hys_k0_has inaktiv 1 : Druckanteil p_hys_k0_has aktiv" VALUE 0x26F177 UBYTE_COL_DIRECT_M_S7_S3 0 swi_int_M_S7_S3 0 1 /end CHARACTERISTIC
/begin CHARACTERISTIC SWI_ZPHYSK0_SYN_ANS "SWI fuer die Hysteresekompensation K0 im Zustand K0 Synchronisieren: 0 : Druckanteil p_hys_k0_has inaktiv 1 : Druckanteil p_hys_k0_has aktiv" VALUE 0x26F178 UBYTE_COL_DIRECT_M_S7_S3 0 swi_int_M_S7_S3 0 1 /end CHARACTERISTIC
/begin CHARACTERISTIC T_ASISTASKMAX_ANS "Verzoegerung der K0 Befuellung bei Response SLST V2" VALUE 0x26E2FE UWORD_COL_DIRECT_M_S7_S3 0 t_int_n_M_S7_S3 0 1 /end CHARACTERISTIC
/begin CHARACTERISTIC T_K0SREGBASISMAX_SYN_ANS "Maximalzeit zum Setzen der Basisbedingung zur Aktivierung der K0-Schlupfregelung im Zustand K0 Synchronisieren beim Schleppstart" VALUE 0x26E300 UWORD_COL_DIRECT_M_S7_S3 0 t_int_n_M_S7_S3 0 10 /end CHARACTERISTIC
/begin CHARACTERISTIC T_LASTWECHSELMAX_SRT_ANS "Max. Timer zur Ueberwachung Lastwechsel in der Phase Start" VALUE 0x26E302 UWORD_COL_DIRECT_M_S7_S3 0 t_int_n_M_S7_S3 0 1 /end CHARACTERISTIC
/begin CHARACTERISTIC T_MAX_KON_ANS "Max. Verweilzeit in der Phase Konditionieren KON" VALUE 0x26E308 UWORD_COL_DIRECT_M_S7_S3 0 t_int_n_M_S7_S3 0 10 /end CHARACTERISTIC
/begin CHARACTERISTIC T_MAX_SCL_ANS "Max. Verweilzeit in der Phase K0 Schliessen SCL" VALUE 0x26E30C UWORD_COL_DIRECT_M_S7_S3 0 t_int_n_M_S7_S3 0 10 /end CHARACTERISTIC
/begin CHARACTERISTIC T_MAX_SST_ANS "Max. Verweilzeit in der Phase Anschleppen SST" VALUE 0x26E30E UWORD_COL_DIRECT_M_S7_S3 0 t_int_n_M_S7_S3 0 10 /end CHARACTERISTIC
/begin CHARACTERISTIC T_MAX_SYN_ANS "Max. Verweilzeit in der Phase K0 Synchronisieren SYN" VALUE 0x26E310 UWORD_COL_DIRECT_M_S7_S3 0 t_int_n_M_S7_S3 0 10 /end CHARACTERISTIC
/begin CHARACTERISTIC T_MAXZK0ENTKIAE_KON_ANS "Max. Wartezeit zur Befuellunganforderung der K0 bei Anforderung Entkopplung IAE" VALUE 0x26E304 UWORD_COL_DIRECT_M_S7_S3 0 t_int_n_M_S7_S3 0 1 /end CHARACTERISTIC
/begin CHARACTERISTIC T_MIN_SST_ANS "Min. Verweilzeit in der Phase Anschleppen SST" VALUE 0x26E314 UWORD_COL_DIRECT_M_S7_S3 0 t_int_n_M_S7_S3 0 10 /end CHARACTERISTIC
/begin CHARACTERISTIC T_MK0OFFSETMAX_SST_ANS "Max.-Wartezeit bis zum Ausloesen der K0-Notrampe in der Phase SST" VALUE 0x26E316 UWORD_COL_DIRECT_M_S7_S3 0 t_int_n_M_S7_S3 0 5 /end CHARACTERISTIC
/begin CHARACTERISTIC T_NDGK0K0SREGMIN_SYN_ANS "Mindestdauer bei der Abfrage des K0-Differenzdrehzahlgradienten zur Bestimmung des Zeitpunkt der Anforderung der Aktivierung der K0-Schlupfregelung im Zustand K0 Synchronisieren beim Schleppstart" VALUE 0x26E31A UWORD_COL_DIRECT_M_S7_S3 0 t_int_n_M_S7_S3 0 5 /end CHARACTERISTIC
/begin CHARACTERISTIC T_RESPMAX_SAS_KON_ANS "" VALUE 0x26E31C UWORD_COL_DIRECT_M_S7_S3 0 t_int_n_M_S7_S3 0 1 /end CHARACTERISTIC
/begin CHARACTERISTIC T_SCHLSCHALT_SRT_ANS "Timer zur Verzoegerung K0 Befuellung im Falle Recp. SLST V2" VALUE 0x26E322 UWORD_COL_DIRECT_M_S7_S3 0 t_int_n_M_S7_S3 0 1 /end CHARACTERISTIC
/begin CHARACTERISTIC T_SCHLSCHALTMAX_KON_ANS "Max. Timer fuer Erkennung Schubschaltung waehrend Response SLST" VALUE 0x26E320 UWORD_COL_DIRECT_M_S7_S3 0 t_int_n_M_S7_S3 0 1 /end CHARACTERISTIC
/begin CHARACTERISTIC T_VK0SREGAKTIV_SYN_ANS "Verzoegerungszeit zur Aktivierung der K0-Schlupfregelung nach Eintritt in den Zustand K0 Synchronisieren beim Schleppstart" VALUE 0x26E328 UWORD_COL_DIRECT_M_S7_S3 0 t_int_n_M_S7_S3 0 5 /end CHARACTERISTIC
/begin CHARACTERISTIC T_VK0SYNCERK_SYN_ANS "Timer zur K0 Synchronerkennung im Zustand K0 Synchronisieren beim Schleppstart" VALUE 0x26E32C UWORD_COL_DIRECT_M_S7_S3 0 t_int_n_M_S7_S3 0 10 /end CHARACTERISTIC
/begin CHARACTERISTIC T_VK0SYNCERKDDA_SYN_ANS "Verzoegerungszeit der K0-Synchron-Erkennung bei durchdrehenden Antriebsraedern im Zustand K0-Synchronisieren beim Schleppstart" VALUE 0x26E32A UWORD_COL_DIRECT_M_S7_S3 0 t_int_n_M_S7_S3 0 10 /end CHARACTERISTIC
/begin CHARACTERISTIC T_WAITSCHLUPFMAX_KON_ANS "Zeit, fuer das Warten auf Schlupf an der IAE um die Schlupfschwellen ueber die Zeit aufzuweiten" VALUE 0x26E32E UWORD_COL_DIRECT_M_S7_S3 0 t_int_n_M_S7_S3 0 5 /end CHARACTERISTIC
/begin CHARACTERISTIC TAB_MOMZIELK0BED_SYN_ANS "Drehmomentoffset auf das K0 Zielmoment in Abhaengigkeit des IAE Status als Uebergangsbedingung nach K0-Schliessen im Zustand K0 Synchronisieren beim Schleppstart" VAL_BLK 0x26AA50 FLOAT32_IEEE_COL_DIRECT_M_S7_S3 0 trq_fl_a_M_S7_S3 -1000 1000 NUMBER 9 /end CHARACTERISTIC
/begin AXIS_PTS KF_ABLV_RESPPARAL_SRT_ANS_X "X-Achse istgang_egs_in" 0x26E1A8 NO_INPUT_QUANTITY SBYTE_X_INCR_DIRECT_M_S7_S3 0 c_fl_t_M_S7_S3 10 -1 8 /end AXIS_PTS
/begin AXIS_PTS KF_ABLV_RESPPARAL_SRT_ANS_Y "Y-Achse: z_ablaufvariante_has_ans" 0x26A928 NO_INPUT_QUANTITY UBYTE_X_INCR_DIRECT_M_S7_S3 0 void_int_M_S7_S3 8 0 15 /end AXIS_PTS
/begin AXIS_PTS KF_FFKMSTOERKPL_ANS_X "X-Achse: m_mot_in" 0x264BD0 m_mot_in FLOAT32_IEEE_X_INCR_DIRECT_M_S7_S3 0 trq_fl_a_M_S7_S3 8 -3.40282E+038 3.40282E+038 /end AXIS_PTS
/begin AXIS_PTS KF_FFKMSTOERKPL_ANS_Y "Y-Achse: m_wunsch_fpw_hst_in" 0x264BF0 m_wunsch_fpw_hst_in FLOAT32_IEEE_X_INCR_DIRECT_M_S7_S3 0 trq_fl_a_M_S7_S3 8 -3.40282E+038 3.40282E+038 /end AXIS_PTS
/begin AXIS_PTS KF_FKMSTOERKPL_ANS_X "X-Achse: c_getriebe_egs_in" 0x264D10 c_getriebe_egs_in FLOAT32_IEEE_X_INCR_DIRECT_M_S7_S3 0 c_fl_M_S7_S3 8 -3.40282E+038 3.40282E+038 /end AXIS_PTS
/begin AXIS_PTS KF_FKMSTOERKPL_ANS_Y "Y-Achse: m_stoer_k0_em_fil" 0x264D30 NO_INPUT_QUANTITY FLOAT32_IEEE_X_INCR_DIRECT_M_S7_S3 0 trq_fl_a_M_S7_S3 8 -3.40282E+038 3.40282E+038 /end AXIS_PTS
/begin AXIS_PTS KF_FKNMOTSOLLIAEPT1_ANS_X "X-Achse: nd_nmotsolliaefilt_ans" 0x264D90 nd_nmotsolliaefilt_ans FLOAT32_IEEE_X_INCR_DIRECT_M_S7_S3 0 n_fl_M_S7_S3 8 -3.40282E+038 3.40282E+038 /end AXIS_PTS
/begin AXIS_PTS KF_FKNMOTSOLLIAEPT1_ANS_Y "Y-Achse: status_nmotsolliaesteigend_ans" 0x264DB0 NO_INPUT_QUANTITY FLOAT32_IEEE_X_INCR_DIRECT_M_S7_S3 0 sts_int_r_M_S7_S3 2 0 1 /end AXIS_PTS
/begin AXIS_PTS KF_FKNMOTSOLLIAEPT2_ANS_X "X-Achse: nd_nmotsolliaefilt_ans" 0x264DF8 nd_nmotsolliaefilt_ans FLOAT32_IEEE_X_INCR_DIRECT_M_S7_S3 0 n_fl_M_S7_S3 8 -3.40282E+038 3.40282E+038 /end AXIS_PTS
/begin AXIS_PTS KF_FKNMOTSOLLIAEPT2_ANS_Y "Y-Achse: status_nmotsolliaesteigend_ans" 0x264E18 NO_INPUT_QUANTITY FLOAT32_IEEE_X_INCR_DIRECT_M_S7_S3 0 sts_int_r_M_S7_S3 2 0 1 /end AXIS_PTS
/begin AXIS_PTS KF_FMOSTOERKPL_ANS_X "X-Achse:t_mstoerk0emfil_ans" 0x2650A0 nd_k0_in FLOAT32_IEEE_X_INCR_DIRECT_M_S7_S3 0 t_fl_M_S7_S3 10 -3.40282E+038 3.40282E+038 /end AXIS_PTS
/begin AXIS_PTS KF_FMOSTOERKPL_ANS_Y "Y-Achse: m_stoer_k0_em_has_alt" 0x2650C8 n_em_in FLOAT32_IEEE_X_INCR_DIRECT_M_S7_S3 0 trq_fl_a_M_S7_S3 8 -3.40282E+038 3.40282E+038 /end AXIS_PTS
/begin AXIS_PTS KF_FMOSTOERKPLSCHALT_ANS_X "X-Achse: m_mot_in" 0x264F20 m_mot_in FLOAT32_IEEE_X_INCR_DIRECT_M_S7_S3 0 trq_fl_a_M_S7_S3 8 -3.40282E+038 3.40282E+038 /end AXIS_PTS
/begin AXIS_PTS KF_FMOSTOERKPLSCHALT_ANS_Y "Y-Achse: m_wunsch_fpw_hst_in" 0x264F40 m_wunsch_fpw_hst_in FLOAT32_IEEE_X_INCR_DIRECT_M_S7_S3 0 trq_fl_a_M_S7_S3 8 -3.40282E+038 3.40282E+038 /end AXIS_PTS
/begin AXIS_PTS KF_FMSTOERKPL_ANS_X "X-Achse: Norm. Zeit aus Timer t_mstoerk0emfil" 0x265228 NO_INPUT_QUANTITY FLOAT32_IEEE_X_INCR_DIRECT_M_S7_S3 0 tc_fl_M_S7_S3 10 -3.40282E+038 3.40282E+038 /end AXIS_PTS
/begin AXIS_PTS KF_FMSTOERKPL_ANS_Y "Y-Achse: m_stoer_k0_em_has_alt" 0x265250 NO_INPUT_QUANTITY FLOAT32_IEEE_X_INCR_DIRECT_M_S7_S3 0 trq_fl_a_M_S7_S3 8 -3.40282E+038 3.40282E+038 /end AXIS_PTS
/begin AXIS_PTS KF_FNDSOLLIAE_KON_ANS_X "X-Achse: t_waitschlupf_kon_ans" 0x265538 NO_INPUT_QUANTITY FLOAT32_IEEE_X_INCR_DIRECT_M_S7_S3 0 t_fl_M_S7_S3 8 0 5 /end AXIS_PTS
/begin AXIS_PTS KF_FNDSOLLIAE_KON_ANS_Y "Y-Achse: istgang_egs_in" 0x265558 NO_INPUT_QUANTITY FLOAT32_IEEE_X_INCR_DIRECT_M_S7_S3 0 void_int_q_M_S7_S3 10 -3.40282346639E+038 3.40282346639E+038 /end AXIS_PTS
/begin AXIS_PTS KF_KOLBPOSINIT_RESP_SCHALT_ANS_X "X-Achse: c_getriebe_egs_in" 0x2657C0 c_getriebe_egs_in FLOAT32_IEEE_X_INCR_DIRECT_M_S7_S3 0 c_fl_M_S7_S3 8 -3.40282E+038 3.40282E+038 /end AXIS_PTS
/begin AXIS_PTS KF_KOLBPOSINIT_RESP_SCHALT_ANS_Y "Y-Achse: m_soll_k0_has_alt" 0x2657E0 NO_INPUT_QUANTITY FLOAT32_IEEE_X_INCR_DIRECT_M_S7_S3 0 trq_fl_a_M_S7_S3 8 -3.40282E+038 3.40282E+038 /end AXIS_PTS
/begin AXIS_PTS KF_KOLBPOSINITTIMER_ANS_X "X-Achse: c_getriebe_egs_in" 0x265680 c_getriebe_egs_in FLOAT32_IEEE_X_INCR_DIRECT_M_S7_S3 0 c_fl_M_S7_S3 8 -3.40282E+038 3.40282E+038 /end AXIS_PTS
/begin AXIS_PTS KF_KOLBPOSINITTIMER_ANS_Y "Y-Achse: m_soll_k0_has_alt" 0x2656A0 NO_INPUT_QUANTITY FLOAT32_IEEE_X_INCR_DIRECT_M_S7_S3 0 trq_fl_a_M_S7_S3 8 -3.40282E+038 3.40282E+038 /end AXIS_PTS
/begin AXIS_PTS KF_MGK0NDK0M_SCHUB_SYN_ANS_X "X-Achse: nd_k0_in" 0x265EE8 NO_INPUT_QUANTITY FLOAT32_IEEE_X_INCR_DIRECT_M_S7_S3 0 n_fl_M_S7_S3 7 -3.40282E+038 3.40282E+038 /end AXIS_PTS
/begin AXIS_PTS KF_MGK0NDK0M_SCHUB_SYN_ANS_Y "Y-Achse:  m_ziel_vm_has_ans" 0x265F04 m_ziel_vm_has_ans FLOAT32_IEEE_X_INCR_DIRECT_M_S7_S3 0 ng_fl_M_S7_S3 6 -3.40282E+038 3.40282E+038 /end AXIS_PTS
/begin AXIS_PTS KF_MGK0NDK0M_SYN_ANS_X "X-Achse: nd_k0_in" 0x2660A0 NO_INPUT_QUANTITY FLOAT32_IEEE_X_INCR_DIRECT_M_S7_S3 0 n_fl_M_S7_S3 7 -3.40282E+038 3.40282E+038 /end AXIS_PTS
/begin AXIS_PTS KF_MGK0NDK0M_SYN_ANS_Y "Y-Achse:  m_ziel_vm_has_ans" 0x2660BC m_ziel_vm_has_ans FLOAT32_IEEE_X_INCR_DIRECT_M_S7_S3 0 trq_fl_a_M_S7_S3 6 -3.40282E+038 3.40282E+038 /end AXIS_PTS
/begin AXIS_PTS KF_MGK0NDK0M_SYNCDDA_SYN_ANS_X "X-Achse: nd_k0_in" 0x265FC4 NO_INPUT_QUANTITY FLOAT32_IEEE_X_INCR_DIRECT_M_S7_S3 0 n_fl_M_S7_S3 7 -3.40282E+038 3.40282E+038 /end AXIS_PTS
/begin AXIS_PTS KF_MGK0NDK0M_SYNCDDA_SYN_ANS_Y "Y-Achse: m_ziel_vm_has_ans" 0x265FE0 m_ziel_vm_has_ans FLOAT32_IEEE_X_INCR_DIRECT_M_S7_S3 0 trq_fl_a_M_S7_S3 6 -3.40282E+038 3.40282E+038 /end AXIS_PTS
/begin AXIS_PTS KF_MGK0NDK0NGVM_SCHUB_SYN_ANS_X "X-Achse nd_k0_in" 0x26617C NO_INPUT_QUANTITY FLOAT32_IEEE_X_INCR_DIRECT_M_S7_S3 0 n_fl_M_S7_S3 7 -3.40282E+038 3.40282E+038 /end AXIS_PTS
/begin AXIS_PTS KF_MGK0NDK0NGVM_SCHUB_SYN_ANS_Y "Y-Achse: ndg_k0_in" 0x266198 NO_INPUT_QUANTITY FLOAT32_IEEE_X_INCR_DIRECT_M_S7_S3 0 ng_fl_M_S7_S3 6 -3.40282E+038 3.40282E+038 /end AXIS_PTS
/begin AXIS_PTS KF_MGK0NDK0NGVM_SYN_ANS_X "X-Achse: nd_k0_in" 0x266258 NO_INPUT_QUANTITY FLOAT32_IEEE_X_INCR_DIRECT_M_S7_S3 0 n_fl_M_S7_S3 7 -3.40282E+038 3.40282E+038 /end AXIS_PTS
/begin AXIS_PTS KF_MGK0NDK0NGVM_SYN_ANS_Y "Y-Achse:  ndg_k0_in" 0x266274 NO_INPUT_QUANTITY FLOAT32_IEEE_X_INCR_DIRECT_M_S7_S3 0 ng_fl_M_S7_S3 6 -3.40282E+038 3.40282E+038 /end AXIS_PTS
/begin AXIS_PTS KF_MGSOLLK0VMMIN_SST_ANS_X "X-Achse: z_ablaufvariante_has_ans" 0x2665A8 NO_INPUT_QUANTITY FLOAT32_IEEE_X_INCR_DIRECT_M_S7_S3 0 sts_int_r_M_S7_S3 8 0 255 /end AXIS_PTS
/begin AXIS_PTS KF_MGSOLLK0VMMIN_SST_ANS_Y "Y-Achse: abstellpos_vm_in" 0x2665C8 NO_INPUT_QUANTITY FLOAT32_IEEE_X_INCR_DIRECT_M_S7_S3 0 phi_fl_M_S7_S3 8 -3.40282E+038 3.40282E+038 /end AXIS_PTS
/begin AXIS_PTS KF_MGSOLLK0VMMINRS_SST_ANS_X "X-Achse: z_ablaufvariante_has_ans" 0x266474 NO_INPUT_QUANTITY FLOAT32_IEEE_X_INCR_DIRECT_M_S7_S3 0 trq_fl_a_M_S7_S3 6 -3.40282E+038 3.40282E+038 /end AXIS_PTS
/begin AXIS_PTS KF_MGSOLLK0VMMINRS_SST_ANS_Y "Y-Achse: abstellpos_vm_in" 0x26648C NO_INPUT_QUANTITY FLOAT32_IEEE_X_INCR_DIRECT_M_S7_S3 0 trq_fl_a_M_S7_S3 7 0 360 /end AXIS_PTS
/begin AXIS_PTS KF_MGSOLLK0VMSTART_SST_ANS_X "X-Achse: z_ablaufvariante_has_ans" 0x2667C4 NO_INPUT_QUANTITY FLOAT32_IEEE_X_INCR_DIRECT_M_S7_S3 0 sts_int_r_M_S7_S3 8 0 255 /end AXIS_PTS
/begin AXIS_PTS KF_MGSOLLK0VMSTART_SST_ANS_Y "Y-Achse: abstellpos_vm_in" 0x2667E4 NO_INPUT_QUANTITY FLOAT32_IEEE_X_INCR_DIRECT_M_S7_S3 0 phi_fl_M_S7_S3 8 -3.40282E+038 3.40282E+038 /end AXIS_PTS
/begin AXIS_PTS KF_MGSOLLK0VMSTARTRS_SST_ANS_X "X-Achse: z_ablaufvariante_has_ans" 0x266690 NO_INPUT_QUANTITY FLOAT32_IEEE_X_INCR_DIRECT_M_S7_S3 0 trq_fl_a_M_S7_S3 6 -3.40282E+038 3.40282E+038 /end AXIS_PTS
/begin AXIS_PTS KF_MGSOLLK0VMSTARTRS_SST_ANS_Y "Y-Achse: abstellpos_vm_in" 0x2666A8 NO_INPUT_QUANTITY FLOAT32_IEEE_X_INCR_DIRECT_M_S7_S3 0 trq_fl_a_M_S7_S3 7 0 360 /end AXIS_PTS
/begin AXIS_PTS KF_MGZIELMAXEM_KON_ANS_X "X-Achse: m_mot_in" 0x2668E4 NO_INPUT_QUANTITY FLOAT32_IEEE_X_INCR_DIRECT_M_S7_S3 0 trq_fl_a_M_S7_S3 8 -1000 1000 /end AXIS_PTS
/begin AXIS_PTS KF_MGZIELMAXEM_KON_ANS_Y "Y-Achse: nd_iae_ans" 0x266904 nd_iae_ans FLOAT32_IEEE_X_INCR_DIRECT_M_S7_S3 0 n_fl_M_S7_S3 7 -10000 10000 /end AXIS_PTS
/begin AXIS_PTS KF_MGZIELMINEM_KON_ANS_X "X-Achse: m_mot_in" 0x266A00 NO_INPUT_QUANTITY FLOAT32_IEEE_X_INCR_DIRECT_M_S7_S3 0 trq_fl_a_M_S7_S3 8 -1000 1000 /end AXIS_PTS
/begin AXIS_PTS KF_MGZIELMINEM_KON_ANS_Y "Y-Achse: nd_iae_ans" 0x266A20 nd_iae_ans FLOAT32_IEEE_X_INCR_DIRECT_M_S7_S3 0 n_fl_M_S7_S3 7 -10000 10000 /end AXIS_PTS
/begin AXIS_PTS KF_MK0MMOTNVM1_SCHUB_SST_ANS_X "X-Achse: m_mot_in" 0x266DBC NO_INPUT_QUANTITY FLOAT32_IEEE_X_INCR_DIRECT_M_S7_S3 0 trq_fl_a_M_S7_S3 8 -1000 1000 /end AXIS_PTS
/begin AXIS_PTS KF_MK0MMOTNVM1_SCHUB_SST_ANS_Y "Y-Achse: n_vm_in" 0x266DDC NO_INPUT_QUANTITY FLOAT32_IEEE_X_INCR_DIRECT_M_S7_S3 0 n_fl_M_S7_S3 8 -10000 10000 /end AXIS_PTS
/begin AXIS_PTS KF_MK0MMOTNVM1_SST_ANS_X "X-Achse: m_mot_in" 0x266EFC NO_INPUT_QUANTITY FLOAT32_IEEE_X_INCR_DIRECT_M_S7_S3 0 trq_fl_a_M_S7_S3 8 -1000 1000 /end AXIS_PTS
/begin AXIS_PTS KF_MK0MMOTNVM1_SST_ANS_Y "Y-Achse: n_vm_in" 0x266F1C NO_INPUT_QUANTITY FLOAT32_IEEE_X_INCR_DIRECT_M_S7_S3 0 n_fl_M_S7_S3 8 -10000 10000 /end AXIS_PTS
/begin AXIS_PTS KF_MK0MMOTNVM2_SCHUB_SST_ANS_X "X-Achse: m_mot_in" 0x26703C NO_INPUT_QUANTITY FLOAT32_IEEE_X_INCR_DIRECT_M_S7_S3 0 trq_fl_a_M_S7_S3 8 -3.40282E+038 3.40282E+038 /end AXIS_PTS
/begin AXIS_PTS KF_MK0MMOTNVM2_SCHUB_SST_ANS_Y "Y-Achse: n_vm_in" 0x26705C NO_INPUT_QUANTITY FLOAT32_IEEE_X_INCR_DIRECT_M_S7_S3 0 n_fl_M_S7_S3 8 -3.40282E+038 3.40282E+038 /end AXIS_PTS
/begin AXIS_PTS KF_MK0MMOTNVM2_SST_ANS_X "X-Achse: ng_vm_in" 0x26717C NO_INPUT_QUANTITY FLOAT32_IEEE_X_INCR_DIRECT_M_S7_S3 0 trq_fl_a_M_S7_S3 8 -10000 10000 /end AXIS_PTS
/begin AXIS_PTS KF_MK0MMOTNVM2_SST_ANS_Y "Y-Achse: n_vm_in" 0x26719C NO_INPUT_QUANTITY FLOAT32_IEEE_X_INCR_DIRECT_M_S7_S3 0 n_fl_M_S7_S3 8 -10000 10000 /end AXIS_PTS
/begin AXIS_PTS KF_MMOT_LASTWECHSEL_SRT_ANS_X "X-Achse Istgang_egs_in" 0x26752C NO_INPUT_QUANTITY FLOAT32_IEEE_X_INCR_DIRECT_M_S7_S3 0 void_int_q_M_S7_S3 10 -3.40282346639E+038 3.40282346639E+038 /end AXIS_PTS
/begin AXIS_PTS KF_MMOT_LASTWECHSEL_SRT_ANS_Y "Y-Achse: mg_wunsch_fpw_hst" 0x267554 NO_INPUT_QUANTITY FLOAT32_IEEE_X_INCR_DIRECT_M_S7_S3 0 trqg_fl_k_M_S7_S3 6 -3.40282E+038 3.40282E+038 /end AXIS_PTS
/begin AXIS_PTS KF_MMOT_RESPPAR_SCHUB_KON_ANS_X "X-Achse c_getriebe_egs_in" 0x2677AC NO_INPUT_QUANTITY FLOAT32_IEEE_X_INCR_DIRECT_M_S7_S3 0 c_fl_M_S7_S3 8 -3.40282E+038 3.40282E+038 /end AXIS_PTS
/begin AXIS_PTS KF_MMOT_RESPPAR_SCHUB_KON_ANS_Y "Y-Achse: istgang_egs_in" 0x2677CC NO_INPUT_QUANTITY FLOAT32_IEEE_X_INCR_DIRECT_M_S7_S3 0 void_int_q_M_S7_S3 8 -3.40282346639E+038 3.40282346639E+038 /end AXIS_PTS
/begin AXIS_PTS KF_MMOT_RESPPARAL_SRT_ANS_X "X-Achse c_getriebe_egs_in" 0x26766C NO_INPUT_QUANTITY FLOAT32_IEEE_X_INCR_DIRECT_M_S7_S3 0 c_fl_M_S7_S3 8 -3.40282E+038 3.40282E+038 /end AXIS_PTS
/begin AXIS_PTS KF_MMOT_RESPPARAL_SRT_ANS_Y "Y-Achse: istgang_egs_in" 0x26768C NO_INPUT_QUANTITY FLOAT32_IEEE_X_INCR_DIRECT_M_S7_S3 0 void_int_q_M_S7_S3 8 -3.40282346639E+038 3.40282346639E+038 /end AXIS_PTS
/begin AXIS_PTS KF_MO_K0BEFUELL_NORM_CGET_ANS_X "X-Achse: t_k0befuellnormiert_ans" 0x26801C NO_INPUT_QUANTITY FLOAT32_IEEE_X_INCR_DIRECT_M_S7_S3 0 rel_fl_M_S7_S3 11 0 200 /end AXIS_PTS
/begin AXIS_PTS KF_MO_K0BEFUELL_NORM_CGET_ANS_Y "Y-Achse: c_getriebe_egs_in" 0x268048 c_getriebe_egs_in FLOAT32_IEEE_X_INCR_DIRECT_M_S7_S3 0 c_fl_M_S7_S3 8 -50 200 /end AXIS_PTS
/begin AXIS_PTS KF_MO_K0BEFUELL_OPT_CGET_ANS_X "X-Achse: t_k0befuellnormiert_ans" 0x2681C8 NO_INPUT_QUANTITY FLOAT32_IEEE_X_INCR_DIRECT_M_S7_S3 0 rel_fl_M_S7_S3 11 0 200 /end AXIS_PTS
/begin AXIS_PTS KF_MO_K0BEFUELL_OPT_CGET_ANS_Y "Y-Achse: c_getriebe_egs_in" 0x2681F4 c_getriebe_egs_in FLOAT32_IEEE_X_INCR_DIRECT_M_S7_S3 0 c_fl_M_S7_S3 8 -50 200 /end AXIS_PTS
/begin AXIS_PTS KF_MO_K0BEFUELL_RED_CGET_ANS_X "X-Achse: t_k0befuellnormiert_ans" 0x268374 NO_INPUT_QUANTITY FLOAT32_IEEE_X_INCR_DIRECT_M_S7_S3 0 rel_fl_M_S7_S3 11 0 200 /end AXIS_PTS
/begin AXIS_PTS KF_MO_K0BEFUELL_RED_CGET_ANS_Y "Y-Achse: c_getriebe_egs_in" 0x2683A0 c_getriebe_egs_in FLOAT32_IEEE_X_INCR_DIRECT_M_S7_S3 0 c_fl_M_S7_S3 8 -50 200 /end AXIS_PTS
/begin AXIS_PTS KF_MOK0ABSTELLPOS_SST_ANS_X "X-Achse: c_vm_in" 0x267BFC NO_INPUT_QUANTITY FLOAT32_IEEE_X_INCR_DIRECT_M_S7_S3 0 c_fl_M_S7_S3 8 -40 150 /end AXIS_PTS
/begin AXIS_PTS KF_MOK0ABSTELLPOS_SST_ANS_Y "Y-Achse: abstellpos_vm_in" 0x267C1C NO_INPUT_QUANTITY FLOAT32_IEEE_X_INCR_DIRECT_M_S7_S3 0 phi_fl_M_S7_S3 8 0 360 /end AXIS_PTS
/begin AXIS_PTS KF_MOSTOERKPL_ANS_X "X-Achse: m_mot_in" 0x267E7C m_mot_in FLOAT32_IEEE_X_INCR_DIRECT_M_S7_S3 0 trq_fl_a_M_S7_S3 8 -1000 1000 /end AXIS_PTS
/begin AXIS_PTS KF_MOSTOERKPL_ANS_Y "Y-Achse: m_wunsch_fpw_hst_in" 0x267E9C m_wunsch_fpw_hst_in FLOAT32_IEEE_X_INCR_DIRECT_M_S7_S3 0 trq_fl_a_M_S7_S3 8 -1000 1000 /end AXIS_PTS
/begin AXIS_PTS KF_MOSTOERKPLSCHALT_ANS_X "X-Achse: nd_emnabiistgang" 0x267D3C NO_INPUT_QUANTITY FLOAT32_IEEE_X_INCR_DIRECT_M_S7_S3 0 n_fl_M_S7_S3 8 -10000 10000 /end AXIS_PTS
/begin AXIS_PTS KF_MOSTOERKPLSCHALT_ANS_Y "Y-Achse: nd_gangsprung_ans" 0x267D5C NO_INPUT_QUANTITY FLOAT32_IEEE_X_INCR_DIRECT_M_S7_S3 0 n_fl_M_S7_S3 8 -10000 10000 /end AXIS_PTS
/begin AXIS_PTS KF_MRESEMANFIAE_KON_ANS_X "X-Achse: nd_iae" 0x268500 nd_iae_ans FLOAT32_IEEE_X_INCR_DIRECT_M_S7_S3 0 n_fl_M_S7_S3 8 -10000 10000 /end AXIS_PTS
/begin AXIS_PTS KF_MRESEMANFIAE_KON_ANS_Y "Y-Achse: istagang_egs_in" 0x268520 NO_INPUT_QUANTITY FLOAT32_IEEE_X_INCR_DIRECT_M_S7_S3 0 void_int_q_M_S7_S3 10 -1 8 /end AXIS_PTS
/begin AXIS_PTS KF_MZIELK0BEFMODUS_SST_ANS_X "X-Achse: c_getriebe_egs_in" 0x2686E8 NO_INPUT_QUANTITY FLOAT32_IEEE_X_INCR_DIRECT_M_S7_S3 0 c_fl_M_S7_S3 8 -3.40282E+038 3.40282E+038 /end AXIS_PTS
/begin AXIS_PTS KF_MZIELK0BEFMODUS_SST_ANS_Y "Y-Achse: z_k0_befuellopt_has" 0x268708 NO_INPUT_QUANTITY FLOAT32_IEEE_X_INCR_DIRECT_M_S7_S3 0 sts_int_r_M_S7_S3 3 0 2 /end AXIS_PTS
/begin AXIS_PTS KF_MZIELMAXEM_KON_ANS_X "X-Achse: m_mot_in" 0x268E34 NO_INPUT_QUANTITY FLOAT32_IEEE_X_INCR_DIRECT_M_S7_S3 0 trq_fl_a_M_S7_S3 8 -1000 1000 /end AXIS_PTS
/begin AXIS_PTS KF_MZIELMAXEM_KON_ANS_Y "Y-Achse: nd_iae_ans" 0x268E54 nd_iae_ans FLOAT32_IEEE_X_INCR_DIRECT_M_S7_S3 0 n_fl_M_S7_S3 7 -10000 10000 /end AXIS_PTS
/begin AXIS_PTS KF_MZIELMINEM_KON_ANS_X "X-Achse: m_mot_in" 0x268F50 NO_INPUT_QUANTITY FLOAT32_IEEE_X_INCR_DIRECT_M_S7_S3 0 trq_fl_a_M_S7_S3 8 -1000 1000 /end AXIS_PTS
/begin AXIS_PTS KF_MZIELMINEM_KON_ANS_Y "Y-Achse: nd_iae_ans" 0x268F70 nd_iae_ans FLOAT32_IEEE_X_INCR_DIRECT_M_S7_S3 0 n_fl_M_S7_S3 7 -10000 10000 /end AXIS_PTS
/begin AXIS_PTS KF_NDEMNSOLLVM_ZND_ANS_X "X-Achse: n_em_in" 0x2690A4 NO_INPUT_QUANTITY FLOAT32_IEEE_X_INCR_DIRECT_M_S7_S3 0 n_fl_M_S7_S3 10 0 10000 /end AXIS_PTS
/begin AXIS_PTS KF_NDEMNSOLLVM_ZND_ANS_Y "Y-Achse: m_ziel_vm_has_ans" 0x2690CC NO_INPUT_QUANTITY FLOAT32_IEEE_X_INCR_DIRECT_M_S7_S3 0 trq_fl_a_M_S7_S3 7 -1000 1000 /end AXIS_PTS
/begin AXIS_PTS KF_NDGSOLLIAE_KON_ANS_X "X-Achse m_mot_in" 0x269190 NO_INPUT_QUANTITY FLOAT32_IEEE_X_INCR_DIRECT_M_S7_S3 0 trq_fl_a_M_S7_S3 6 -1000 1000 /end AXIS_PTS
/begin AXIS_PTS KF_NDGSOLLIAE_KON_ANS_Y "Y-Achse n_sec_iae_fil" 0x2691A8 NO_INPUT_QUANTITY FLOAT32_IEEE_X_INCR_DIRECT_M_S7_S3 0 n_fl_M_S7_S3 7 -10000 10000 /end AXIS_PTS
/begin AXIS_PTS KF_NDSK0SYNCERK_SYN_ANS_X "X-Achse: ng_em_ans" 0x2691EC ng_em_ans FLOAT32_IEEE_X_INCR_DIRECT_M_S7_S3 0 void_fl_M_S7_S3 5 -10000 10000 /end AXIS_PTS
/begin AXIS_PTS KF_NDSK0SYNCERK_SYN_ANS_Y "Y-Achse: z_k0entkaktiv_ans" 0x269200 NO_INPUT_QUANTITY FLOAT32_IEEE_X_INCR_DIRECT_M_S7_S3 0 sts_int_r_M_S7_S3 2 0 1 /end AXIS_PTS
/begin AXIS_PTS KF_NDSOLLIAE_KON_ANS_X "X-Achse m_mot_in" 0x2692B0 NO_INPUT_QUANTITY FLOAT32_IEEE_X_INCR_DIRECT_M_S7_S3 0 trq_fl_a_M_S7_S3 6 -1000 1000 /end AXIS_PTS
/begin AXIS_PTS KF_NDSOLLIAE_KON_ANS_Y "Y-Achse: n_sec_iae_fil" 0x2692C8 NO_INPUT_QUANTITY FLOAT32_IEEE_X_INCR_DIRECT_M_S7_S3 0 n_fl_M_S7_S3 7 -10000 10000 /end AXIS_PTS
/begin AXIS_PTS KF_NGEMMODRSMAX_SYN_ANS_X "X-Achse: n_sec_iae_ist_ans" 0x269334 n_sec_iae_ist_ans FLOAT32_IEEE_X_INCR_DIRECT_M_S7_S3 0 n_fl_M_S7_S3 5 0 10000 /end AXIS_PTS
/begin AXIS_PTS KF_NGEMMODRSMAX_SYN_ANS_Y "Y-Achse: nd_sec_iae_syn_ans" 0x269348 nd_sec_iae_syn_ans FLOAT32_IEEE_X_INCR_DIRECT_M_S7_S3 0 n_fl_M_S7_S3 4 -10000 10000 /end AXIS_PTS
/begin AXIS_PTS KF_NGSOLLEM_NEMNDIAE_KON_ANS_X "X-Achse: n_em_in" 0x269454 NO_INPUT_QUANTITY FLOAT32_IEEE_X_INCR_DIRECT_M_S7_S3 0 n_fl_M_S7_S3 9 -10000 10000 /end AXIS_PTS
/begin AXIS_PTS KF_NGSOLLEM_NEMNDIAE_KON_ANS_Y "Y-Achse: nd_iae_in" 0x269478 nd_iae_ans FLOAT32_IEEE_X_INCR_DIRECT_M_S7_S3 0 n_fl_M_S7_S3 7 -10000 10000 /end AXIS_PTS
/begin AXIS_PTS KF_NGSOLLEM_STIAEKRAFT_KON_ANS_X "X-Achse: status_iae_in" 0x26EE7D NO_INPUT_QUANTITY UBYTE_X_INCR_DIRECT_M_S7_S3 0 sts_int_M_S7_S3 9 0 8 /end AXIS_PTS
/begin AXIS_PTS KF_NGSOLLEM_STIAEKRAFT_KON_ANS_Y "Y-Achse: status_kraftfluss_egs_in" 0x26EE86 NO_INPUT_QUANTITY UBYTE_X_INCR_DIRECT_M_S7_S3 0 sts_int_M_S7_S3 7 0 6 /end AXIS_PTS
/begin AXIS_PTS KF_NOEMNSOLLVM_KON_ANS_X "X-Achse: Phase SAK n_em_in; Phase KON n_em_in" 0x2695AC NO_INPUT_QUANTITY FLOAT32_IEEE_X_INCR_DIRECT_M_S7_S3 0 n_fl_M_S7_S3 10 0 10000 /end AXIS_PTS
/begin AXIS_PTS KF_NOEMNSOLLVM_KON_ANS_Y "Y-Achse: m_ziel_vm_has_ans" 0x2695D4 NO_INPUT_QUANTITY FLOAT32_IEEE_X_INCR_DIRECT_M_S7_S3 0 trq_fl_a_M_S7_S3 7 -1000 1000 /end AXIS_PTS
/begin AXIS_PTS KF_NOSOLLIAEAKTIV_ANS_X "X-Achse: status_iae_in" 0x26EECC NO_INPUT_QUANTITY UBYTE_X_INCR_DIRECT_M_S7_S3 0 sts_int_M_S7_S3 9 0 8 /end AXIS_PTS
/begin AXIS_PTS KF_NOSOLLIAEAKTIV_ANS_Y "Y-Achse: status_kraftfluss_egs_in" 0x26EED5 NO_INPUT_QUANTITY UBYTE_X_INCR_DIRECT_M_S7_S3 0 st_int_M_S7_S3 7 0 6 /end AXIS_PTS
/begin AXIS_PTS KF_STIAESTKRAFT_RESCH_SRT_ANS_X "X-Achse: status_iae_in" 0x26EF6A NO_INPUT_QUANTITY UBYTE_X_INCR_DIRECT_M_S7_S3 0 sts_int_M_S7_S3 9 0 255 /end AXIS_PTS
/begin AXIS_PTS KF_STIAESTKRAFT_RESCH_SRT_ANS_Y "Y-Achse: status_kraftfluss_egs_in" 0x26EF73 NO_INPUT_QUANTITY UBYTE_X_INCR_DIRECT_M_S7_S3 0 sts_int_M_S7_S3 7 0 255 /end AXIS_PTS
/begin AXIS_PTS KF_TK0SYNCERKUMS_SYN_ANS_X "X-Achse: m_ziel_vm_has_ans" 0x269618 m_ziel_vm_has_ans FLOAT32_IEEE_X_INCR_DIRECT_M_S7_S3 0 trq_fl_a_M_S7_S3 5 -1000 1000 /end AXIS_PTS
/begin AXIS_PTS KF_TK0SYNCERKUMS_SYN_ANS_Y "Y-Achse: z_k0entkaktiv_ans" 0x26962C NO_INPUT_QUANTITY FLOAT32_IEEE_X_INCR_DIRECT_M_S7_S3 0 sts_int_r_M_S7_S3 2 0 1 /end AXIS_PTS
/begin AXIS_PTS KF_TSSCHLSCHALT_SRT_ANS_X "X-Achse: m_wunschf_pw_hst_in" 0x269714 NO_INPUT_QUANTITY FLOAT32_IEEE_X_INCR_DIRECT_M_S7_S3 0 trq_fl_a_M_S7_S3 7 -1000 1000 /end AXIS_PTS
/begin AXIS_PTS KF_TSSCHLSCHALT_SRT_ANS_Y "Y-Achse: z_ablaufvariante_has_ans" 0x269730 NO_INPUT_QUANTITY FLOAT32_IEEE_X_INCR_DIRECT_M_S7_S3 0 void_int_q_M_S7_S3 8 -3.40282346639E+038 3.40282346639E+038 /end AXIS_PTS
/begin AXIS_PTS KF_TVMSTOERK0EMFIL_ANS_X "X-Achse: c_getriebe_egs_in" 0x269850 c_getriebe_egs_in FLOAT32_IEEE_X_INCR_DIRECT_M_S7_S3 0 c_fl_M_S7_S3 8 -50 200 /end AXIS_PTS
/begin AXIS_PTS KF_TVMSTOERK0EMFIL_ANS_Y "Y-Achse: m_soll_k0_has_alt" 0x269870 NO_INPUT_QUANTITY FLOAT32_IEEE_X_INCR_DIRECT_M_S7_S3 0 trq_fl_a_M_S7_S3 8 -1000 1000 /end AXIS_PTS
/begin AXIS_PTS KF_TVMSTOERK0EMFIL_RESP_SCHALT_ANS_X "X-Achse: c_getriebe_egs_in" 0x269990 c_getriebe_egs_in FLOAT32_IEEE_X_INCR_DIRECT_M_S7_S3 0 c_fl_M_S7_S3 8 -50 200 /end AXIS_PTS
/begin AXIS_PTS KF_TVMSTOERK0EMFIL_RESP_SCHALT_ANS_Y "Y-Achse: m_soll_k0_has_alt" 0x2699B0 NO_INPUT_QUANTITY FLOAT32_IEEE_X_INCR_DIRECT_M_S7_S3 0 trq_fl_a_M_S7_S3 8 -1000 1000 /end AXIS_PTS
/begin AXIS_PTS KF_UMSCHNSOLLEMABS_ANS_X "X-Achse: status_iae_in" 0x26EFB9 NO_INPUT_QUANTITY UBYTE_X_INCR_DIRECT_M_S7_S3 0 sts_int_M_S7_S3 9 0 8 /end AXIS_PTS
/begin AXIS_PTS KF_UMSCHNSOLLEMABS_ANS_Y "Y-Achse: status_kraftfluss_egs_in" 0x26EFC2 NO_INPUT_QUANTITY UBYTE_X_INCR_DIRECT_M_S7_S3 0 sts_int_M_S7_S3 7 0 6 /end AXIS_PTS
/begin AXIS_PTS KF_ZSCHLEPPSCHALTABLVAR_SRT_ANS_X "X: istgang_egs_in" 0x26E1E6 NO_INPUT_QUANTITY SBYTE_X_INCR_DIRECT_M_S7_S3 0 void_int_M_S7_S3 10 -1 8 /end AXIS_PTS
/begin AXIS_PTS KF_ZSCHLEPPSCHALTABLVAR_SRT_ANS_Y "Y: z_ablaufvariante_has_ans" 0x26E1F0 NO_INPUT_QUANTITY UBYTE_X_INCR_DIRECT_M_S7_S3 0 void_int_M_S7_S3 6 0 15 /end AXIS_PTS
/begin AXIS_PTS KL_FMGK0ISTGANG_SYN_ANS_X "X-Achse: istgang_egs_in" 0x269B10 NO_INPUT_QUANTITY FLOAT32_IEEE_X_INCR_DIRECT_M_S7_S3 0 void_fl_M_S7_S3 10 -1 8 /end AXIS_PTS
/begin AXIS_PTS KL_FMK0MMOTNVM1_SCHUB_SST_ANS_X "X-Achse: istgang_egs_in" 0x269C00 NO_INPUT_QUANTITY FLOAT32_IEEE_X_INCR_DIRECT_M_S7_S3 0 void_fl_M_S7_S3 10 -1 8 /end AXIS_PTS
/begin AXIS_PTS KL_FMK0MMOTNVM1_SST_ANS_X "X-Achse: istgang_egs_in" 0x269C50 NO_INPUT_QUANTITY FLOAT32_IEEE_X_INCR_DIRECT_M_S7_S3 0 void_fl_M_S7_S3 10 -1 8 /end AXIS_PTS
/begin AXIS_PTS KL_FMK0MMOTNVM2_SCHUB_SST_ANS_X "X-Achse: istgang_egs_in" 0x269CA0 NO_INPUT_QUANTITY FLOAT32_IEEE_X_INCR_DIRECT_M_S7_S3 0 void_fl_M_S7_S3 10 -1 8 /end AXIS_PTS
/begin AXIS_PTS KL_FMK0MMOTNVM2_SST_ANS_X "X-Achse: istgang_egs_in" 0x269CF0 NO_INPUT_QUANTITY FLOAT32_IEEE_X_INCR_DIRECT_M_S7_S3 0 void_fl_M_S7_S3 10 -1 8 /end AXIS_PTS
/begin AXIS_PTS KL_FNDGSOLLIAE_KON_ANS_X "X-Achse: istgang_egs_in" 0x269E20 NO_INPUT_QUANTITY FLOAT32_IEEE_X_INCR_DIRECT_M_S7_S3 0 void_fl_M_S7_S3 10 -1 8 /end AXIS_PTS
/begin AXIS_PTS KL_FNDGSOLLIAE_SCL_ANS_X "X-Achse: istgang_egs_in" 0x269E70 NO_INPUT_QUANTITY FLOAT32_IEEE_X_INCR_DIRECT_M_S7_S3 0 void_fl_M_S7_S3 10 -1 8 /end AXIS_PTS
/begin AXIS_PTS KL_FNDGSOLLIAE_SST_ANS_X "X-Achse: istgang_egs_in" 0x269EC0 NO_INPUT_QUANTITY FLOAT32_IEEE_X_INCR_DIRECT_M_S7_S3 0 void_fl_M_S7_S3 10 -1 8 /end AXIS_PTS
/begin AXIS_PTS KL_FNDGSOLLIAE_SYN_ANS_X "X-Achse: istgang_egs_in" 0x269F10 NO_INPUT_QUANTITY FLOAT32_IEEE_X_INCR_DIRECT_M_S7_S3 0 void_fl_M_S7_S3 10 -1 8 /end AXIS_PTS
/begin AXIS_PTS KL_FNDGSOLLIAE_ZND_ANS_X "X-Achse: istgang_egs_in" 0x269F60 NO_INPUT_QUANTITY FLOAT32_IEEE_X_INCR_DIRECT_M_S7_S3 0 void_fl_M_S7_S3 10 -1 8 /end AXIS_PTS
/begin AXIS_PTS KL_FNDSOLLIAE_KON_ANS_X "X-Achse: istgange_egs_in" 0x269FB0 NO_INPUT_QUANTITY FLOAT32_IEEE_X_INCR_DIRECT_M_S7_S3 0 void_fl_M_S7_S3 10 -1 8 /end AXIS_PTS
/begin AXIS_PTS KL_FNDSOLLIAE_SCL_ANS_X "X-Achse: istgang_egs_in" 0x26A000 NO_INPUT_QUANTITY FLOAT32_IEEE_X_INCR_DIRECT_M_S7_S3 0 void_fl_M_S7_S3 10 -1 8 /end AXIS_PTS
/begin AXIS_PTS KL_FNDSOLLIAE_SST_ANS_X "X-Achse: istgang_egs_in" 0x26A050 NO_INPUT_QUANTITY FLOAT32_IEEE_X_INCR_DIRECT_M_S7_S3 0 void_fl_M_S7_S3 10 -1 8 /end AXIS_PTS
/begin AXIS_PTS KL_FNDSOLLIAE_SYN_ANS_X "X-Achse: istgang_egs_in" 0x26A0A0 NO_INPUT_QUANTITY FLOAT32_IEEE_X_INCR_DIRECT_M_S7_S3 0 void_fl_M_S7_S3 10 -1 8 /end AXIS_PTS
/begin AXIS_PTS KL_FNDSOLLIAE_ZND_ANS_X "X-Achse: istgang_egs_in" 0x26A0F0 NO_INPUT_QUANTITY FLOAT32_IEEE_X_INCR_DIRECT_M_S7_S3 0 void_fl_M_S7_S3 10 -1 8 /end AXIS_PTS
/begin AXIS_PTS KL_K0SREGSTATUSIAE_SYN_ANS_X "X-Achse: status_iae_in" 0x26F0C4 NO_INPUT_QUANTITY UBYTE_X_INCR_DIRECT_M_S7_S3 0 void_int_M_S7_S3 9 0 8 /end AXIS_PTS
/begin AXIS_PTS KL_KSVH_RESET_SCL_ANS_X "X-Achse: istgang_egs_in" 0x26E246 NO_INPUT_QUANTITY SBYTE_X_INCR_DIRECT_M_S7_S3 0 void_int_M_S7_S3 10 -1 8 /end AXIS_PTS
/begin AXIS_PTS KL_KSVH_RESET_SRT_ANS_X "X-Achse: istgang_egs_in" 0x26E282 NO_INPUT_QUANTITY SBYTE_X_INCR_DIRECT_M_S7_S3 0 void_int_M_S7_S3 10 -1 8 /end AXIS_PTS
/begin AXIS_PTS KL_KSVH_RESET_SST_ANS_X "X-Achse: istgang_egs_in" 0x26E296 NO_INPUT_QUANTITY SBYTE_X_INCR_DIRECT_M_S7_S3 0 void_int_M_S7_S3 10 -1 8 /end AXIS_PTS
/begin AXIS_PTS KL_KSVH_RESET_SYN_ANS_X "X-Achse: istgang_egs_in" 0x26E2AA NO_INPUT_QUANTITY SBYTE_X_INCR_DIRECT_M_S7_S3 0 void_int_M_S7_S3 10 -1 8 /end AXIS_PTS
/begin AXIS_PTS KL_MGK0MODMAX_SCL_ANS_X "Maximaler Gradient des modifizierten K0 Moments der HAS in Abhaengigkeit des VM Zielmoments im Zustand K0-Schliessen beim Schleppstart" 0x26A140 m_ziel_vm_has_ans FLOAT32_IEEE_X_INCR_DIRECT_M_S7_S3 0 trq_fl_a_M_S7_S3 6 -10000 10000 /end AXIS_PTS
/begin AXIS_PTS KL_MGK0MODMAX_SYN_ANS_X "Maximaler Gradient des modifizierten K0 Moments der HAS in Abhaengigkeit des Gradienten des K0 Sollmoments im Zustand K0-Synchronisieren beim Schleppstart" 0x26A170 NO_INPUT_QUANTITY FLOAT32_IEEE_X_INCR_DIRECT_M_S7_S3 0 trqg_fl_k_M_S7_S3 6 -10000 10000 /end AXIS_PTS
/begin AXIS_PTS KL_MGK0MODMIN_SYN_ANS_X "Minimaler Gradient des modifizierten K0 Moments der HAS in Abhaengigkeit des Gradienten des K0 Sollmoments im Zustand K0-Synchronisieren beim Schleppstart" 0x26A1A0 NO_INPUT_QUANTITY FLOAT32_IEEE_X_INCR_DIRECT_M_S7_S3 0 trqg_fl_k_M_S7_S3 6 -10000 10000 /end AXIS_PTS
/begin AXIS_PTS KL_MGSOLLK0_SCHUB_SST_ANS_X "X-Achse: m_ziel_k0_has_basis_ans - m_soll_k0_has" 0x26A1D0 NO_INPUT_QUANTITY FLOAT32_IEEE_X_INCR_DIRECT_M_S7_S3 0 trq_fl_a_M_S7_S3 6 -1000 1000 /end AXIS_PTS
/begin AXIS_PTS KL_MGSOLLK0_SST_ANS_X "X-Achse: m_ziel_k0_has_basis_ans - m_soll_k0_has" 0x26A228 NO_INPUT_QUANTITY FLOAT32_IEEE_X_INCR_DIRECT_M_S7_S3 0 trq_fl_a_M_S7_S3 5 -1000 1000 /end AXIS_PTS
/begin AXIS_PTS KL_MGZIELMAXEM_SYN_ANS_X "X-Achse: m_wunsch_fpw_hst_in" 0x26A278 NO_INPUT_QUANTITY FLOAT32_IEEE_X_INCR_DIRECT_M_S7_S3 0 trq_fl_a_M_S7_S3 8 -1000 1000 /end AXIS_PTS
/begin AXIS_PTS KL_MGZIELMINEM_SYN_ANS_X "X-Achse: m_wunsch_fpw_hst_in" 0x26A2B8 NO_INPUT_QUANTITY FLOAT32_IEEE_X_INCR_DIRECT_M_S7_S3 0 trq_fl_a_M_S7_S3 8 -1000 1000 /end AXIS_PTS
/begin AXIS_PTS KL_MK0MVMSTART_SST_ANS_X "Anteil des K0-Zielmoments beim VM Zuenden in Abhaengigkeit des VM Startmoments beim VM Anschleppen" 0x26A2F8 NO_INPUT_QUANTITY FLOAT32_IEEE_X_INCR_DIRECT_M_S7_S3 0 trq_fl_a_M_S7_S3 8 -1000 1000 /end AXIS_PTS
/begin AXIS_PTS KL_MSSOLLK0BED_SYN_ANS_X "Schwelle des Sollmoments der K0, ab der ins Schliessen uebergegangen werden darf" 0x26A3E0 m_ziel_vm_has_ans FLOAT32_IEEE_X_INCR_DIRECT_M_S7_S3 0 trq_fl_a_M_S7_S3 8 -1000 1000 /end AXIS_PTS
/begin AXIS_PTS KL_MWUNSCH_RESPPAR_SCHUB_KON_ANS_X "X-Achse: istgang egs in" 0x26A458 NO_INPUT_QUANTITY FLOAT32_IEEE_X_INCR_DIRECT_M_S7_S3 0 c_fl_M_S7_S3 8 1 8 /end AXIS_PTS
/begin AXIS_PTS KL_MWUNSCH_RESPPARAL_SRT_ANS_X "X-Achse: c_getriebe_egs_in" 0x26A420 NO_INPUT_QUANTITY FLOAT32_IEEE_X_INCR_DIRECT_M_S7_S3 0 c_fl_M_S7_S3 7 -50 200 /end AXIS_PTS
/begin AXIS_PTS KL_MZIELK0_SYN_ANS_X "Festlegung des K0 Zielmoments zur Bestimmung des K0 Sollmoments im Zustand K0 Synchronisieren beim Schleppstart in Abhaengigkeit  des VM Zielmoments" 0x26A500 m_ziel_vm_has_ans FLOAT32_IEEE_X_INCR_DIRECT_M_S7_S3 0 trq_fl_a_M_S7_S3 8 -1000 1000 /end AXIS_PTS
/begin AXIS_PTS KL_MZIELK0MIN_SYN_ANS_X "X-Achse: m_ziel_vm_has_ans" 0x26A4C0 m_ziel_vm_has_ans FLOAT32_IEEE_X_INCR_DIRECT_M_S7_S3 0 trq_fl_a_M_S7_S3 8 -1000 1000 /end AXIS_PTS
/begin AXIS_PTS KL_MZIELK0MIN_SYNCDDA_SYN_ANS_X "X-Achse: m_wunsch_fpw_hst_in - m_min_dyn_em_in" 0x26A498 NO_INPUT_QUANTITY FLOAT32_IEEE_X_INCR_DIRECT_M_S7_S3 0 trq_fl_a_M_S7_S3 5 -1000 1000 /end AXIS_PTS
/begin AXIS_PTS KL_NDGSK0SYNCERK_SYN_ANS_X "Maximaler Betrag des K0-Differenzdrehzahlgradienten zur Erkennung Synchron im Zustand K0 Synchronisieren beim Zustart in Abhaengigkeit des VM Zielmoments beim Zustart" 0x26A540 m_ziel_vm_has_ans FLOAT32_IEEE_X_INCR_DIRECT_M_S7_S3 0 trq_fl_a_M_S7_S3 10 -10000 10000 /end AXIS_PTS
/begin AXIS_PTS KL_NDIAEEMMAXIAE_KON_ANS_X "X: Momentoffset auf m_max_iae_has = f(nd_iae, nd_ziel_iae_stat)" 0x26A590 NO_INPUT_QUANTITY FLOAT32_IEEE_X_INCR_DIRECT_M_S7_S3 0 n_fl_M_S7_S3 8 -10000 10000 /end AXIS_PTS
/begin AXIS_PTS KL_NDIAEEMMAXIAE_SST_ANS_X "X-Achse:  f(nd_iae-nd_soll_iae_stat)" 0x26A5D0 NO_INPUT_QUANTITY FLOAT32_IEEE_X_INCR_DIRECT_M_S7_S3 0 n_fl_M_S7_S3 8 -10000 10000 /end AXIS_PTS
/begin AXIS_PTS KL_NDIAEEMMAXIAE_SYN_ANS_X "X-Achse: (nd_iae-nd_soll_iae_stat)" 0x26A610 NO_INPUT_QUANTITY FLOAT32_IEEE_X_INCR_DIRECT_M_S7_S3 0 n_fl_M_S7_S3 8 -10000 10000 /end AXIS_PTS
/begin AXIS_PTS KL_NDSK0K0SREG_SYN_ANS_X "K0-Differenzdrehzahlschwelle zur Bestimmung des Zeitpunkts der Anforderung der Aktivierung der K0-Schlupfregelung in Abhaengigkeit des K0 Sollmoments im Zustand K0 Synchronisieren beim Schleppstart" 0x26A690 NO_INPUT_QUANTITY FLOAT32_IEEE_X_INCR_DIRECT_M_S7_S3 0 trq_fl_a_M_S7_S3 5 -10000 10000 /end AXIS_PTS
/begin AXIS_PTS KL_NDZIELK0K0SREG_SYN_ANS_X "X-Achse: m_soll_k0_has" 0x26A6B8 NO_INPUT_QUANTITY FLOAT32_IEEE_X_INCR_DIRECT_M_S7_S3 0 trq_fl_a_M_S7_S3 5 0 1000 /end AXIS_PTS
/begin AXIS_PTS KL_NGIAEANF_ANS_X "X-Achse: (n_motanfahr_gef_iae_in - n_soll_em_has)" 0x26A6E0 NO_INPUT_QUANTITY FLOAT32_IEEE_X_INCR_DIRECT_M_S7_S3 0 n_fl_M_S7_S3 10 -3500 3500 /end AXIS_PTS
/begin AXIS_PTS KL_NONEMABLVARBED_KON_ANS_X "X-Achse: z_ablaufvariante_has_ans" 0x26A730 NO_INPUT_QUANTITY FLOAT32_IEEE_X_INCR_DIRECT_M_S7_S3 0 void_fl_M_S7_S3 8 0 15 /end AXIS_PTS
/begin AXIS_PTS KL_NSMINEMCGETRBED_KON_ANS_X "X-Achse: c_getriebe_egs_in" 0x26A770 NO_INPUT_QUANTITY FLOAT32_IEEE_X_INCR_DIRECT_M_S7_S3 0 c_fl_M_S7_S3 8 -40 200 /end AXIS_PTS
/begin AXIS_PTS KL_NZIELEMKRAFTFLUSS_ANS_X "X-Achse: status_kraftfluss_egs_in" 0x26F0E4 NO_INPUT_QUANTITY UBYTE_X_INCR_DIRECT_M_S7_S3 0 sts_int_M_S7_S3 7 0 6 /end AXIS_PTS
/begin AXIS_PTS KL_TFC_K0_ANS_X "X-Achse: c_getriebe_egs_in" 0x26A7B0 c_getriebe_egs_in FLOAT32_IEEE_X_INCR_DIRECT_M_S7_S3 0 c_fl_M_S7_S3 9 -50 200 /end AXIS_PTS
/begin AXIS_PTS KL_TFC_K0_OPT_ANS_X "X-Achse: c_getriebe_egs_in" 0x26A7F8 c_getriebe_egs_in FLOAT32_IEEE_X_INCR_DIRECT_M_S7_S3 0 c_fl_M_S7_S3 9 -50 200 /end AXIS_PTS
/begin AXIS_PTS KL_TFC_K0_RED_ANS_X "X-Achse: c_getriebe_egs_in" 0x26A840 c_getriebe_egs_in FLOAT32_IEEE_X_INCR_DIRECT_M_S7_S3 0 c_fl_M_S7_S3 9 -50 200 /end AXIS_PTS
/begin MEASUREMENT abstellpos_vm_in "Abstellposition VM vor naechstem ZOT" UWORD void_int_c_M_S7_S3 1 100 0 360 ECU_ADDRESS 0xFFF86784 /end MEASUREMENT
/begin MEASUREMENT abstellpos_vm_status_in "Status Abstellposition VM" UBYTE void_int_M_S7_S3 1 100 0 2 ECU_ADDRESS 0xFFF86CC5 /end MEASUREMENT
/begin MEASUREMENT c_getriebe_egs_in "" FLOAT32_IEEE c_int_M_S7_S3 1 100 -40 215 ECU_ADDRESS 0xFFF86214 /end MEASUREMENT
/begin MEASUREMENT c_vm_in "" FLOAT32_IEEE c_fl_M_S7_S3 1 100 -3.40282E+038 3.40282E+038 ECU_ADDRESS 0xFFF86288 /end MEASUREMENT
/begin MEASUREMENT f_mstoerk0befuell_ans "Faktor zur Berechnung vom K0-Stoermoment" FLOAT32_IEEE void_fl_M_S7_S3 1 100 0 1 ECU_ADDRESS 0xFFF85E34 /end MEASUREMENT
/begin MEASUREMENT gangwechsel_egs_in "Flag waehrend laufender Schaltung, bei synchron verlassen bis synchron erreicht" UBYTE void_int_M_S7_S3 1 100 0 1 ECU_ADDRESS 0xFFF86C9F /end MEASUREMENT
/begin MEASUREMENT i_istgang_egs "Uebersetzung des aktuellen Gangs" FLOAT32_IEEE ratio_fl_M_S7_S3 1 100 0 8 ECU_ADDRESS 0xFFF861B4 /end MEASUREMENT
/begin MEASUREMENT i_zielgang_egs "Uebersetzung des Zielgangs" FLOAT32_IEEE ratio_fl_M_S7_S3 1 100 0 8 ECU_ADDRESS 0xFFF861B8 /end MEASUREMENT
/begin MEASUREMENT init_anfiae_aktiv_ans "Trigger zur Aktivierung des Gradientenbegrenzer" UBYTE void_int_d_M_S7_S3 1 100 0 1 ECU_ADDRESS 0xFFF86A7F /end MEASUREMENT
/begin MEASUREMENT init_n_em_mod_syn_ans "Flag zeigt an, ob n_em_mod_basis_syn_ans neu initialisiert wird" UBYTE sts_int_e_M_S7_S3 1 100 0 1 ECU_ADDRESS 0xFFF86A80 /end MEASUREMENT
/begin MEASUREMENT init_nsollem_grad_ans "Initflag zur Initi. des Gradientenbegrenzer fuer die Ber. n_soll_em" UBYTE void_fl_u_M_S7_S3 1 100 0 1 ECU_ADDRESS 0xFFF86A81 /end MEASUREMENT
/begin MEASUREMENT istgang_egs_in "" SBYTE void_int_M_S7_S3 1 100 -128 127 ECU_ADDRESS 0xFFF86CA0 /end MEASUREMENT
/begin MEASUREMENT kolbenpos_k0_in "" FLOAT32_IEEE sts_fl_M_S7_S3 1 100 -3.40282E+038 3.40282E+038 ECU_ADDRESS 0xFFF8621C /end MEASUREMENT
/begin MEASUREMENT m_em_in "" FLOAT32_IEEE trq_fl_a_M_S7_S3 1 100 -1024 1024 ECU_ADDRESS 0xFFF86220 /end MEASUREMENT
/begin MEASUREMENT m_iae_in "" FLOAT32_IEEE trq_fl_a_M_S7_S3 1 100 -32768 32767 ECU_ADDRESS 0xFFF86224 /end MEASUREMENT
/begin MEASUREMENT m_k0_in "" FLOAT32_IEEE trq_fl_a_M_S7_S3 1 100 -32768 32767 ECU_ADDRESS 0xFFF86228 /end MEASUREMENT
/begin MEASUREMENT m_max_dyn_em_in "" FLOAT32_IEEE trq_fl_a_M_S7_S3 1 100 -3.40282E+038 3.40282E+038 ECU_ADDRESS 0xFFF8622C /end MEASUREMENT
/begin MEASUREMENT m_min_dyn_em_in "" FLOAT32_IEEE trq_fl_a_M_S7_S3 1 100 -3.40282E+038 3.40282E+038 ECU_ADDRESS 0xFFF86230 /end MEASUREMENT
/begin MEASUREMENT m_min_vm_in "" FLOAT32_IEEE trq_fl_a_M_S7_S3 1 100 -3.40282E+038 3.40282E+038 ECU_ADDRESS 0xFFF8628C /end MEASUREMENT
/begin MEASUREMENT m_mot_in "" FLOAT32_IEEE trq_fl_a_M_S7_S3 1 100 -1024 1024 ECU_ADDRESS 0xFFF86234 /end MEASUREMENT
/begin MEASUREMENT m_soll_em_hst_in "" FLOAT32_IEEE trq_fl_a_M_S7_S3 1 100 -32768 32767 ECU_ADDRESS 0xFFF86238 /end MEASUREMENT
/begin MEASUREMENT m_soll_res_em_bas_sbe "Basis-Reservemoment fuer den VM-Start" FLOAT32_IEEE trq_fl_a_M_S7_S3 1 100 -3.40282E+038 3.40282E+038 ECU_ADDRESS 0xFFF861FC /end MEASUREMENT
/begin MEASUREMENT m_soll_vm_hst_in "" FLOAT32_IEEE trq_fl_a_M_S7_S3 1 100 -32768 32767 ECU_ADDRESS 0xFFF8623C /end MEASUREMENT
/begin MEASUREMENT m_soll_vm_l_hst_in "" FLOAT32_IEEE trq_fl_a_M_S7_S3 1 100 -3.40282E+038 3.40282E+038 ECU_ADDRESS 0xFFF86290 /end MEASUREMENT
/begin MEASUREMENT m_stoer_k0_em_fil_ans "Gefiltertes Stoermoment der K0 im Schleppstart" FLOAT32_IEEE trq_fl_a_M_S7_S3 1 100 -1000 1000 ECU_ADDRESS 0xFFF85E40 /end MEASUREMENT
/begin MEASUREMENT m_vm_in "" FLOAT32_IEEE trq_fl_a_M_S7_S3 1 100 -1024 1023.5 ECU_ADDRESS 0xFFF86240 /end MEASUREMENT
/begin MEASUREMENT m_vm_start_in "" FLOAT32_IEEE trq_fl_a_M_S7_S3 1 100 -1024 1023.5 ECU_ADDRESS 0xFFF86244 /end MEASUREMENT
/begin MEASUREMENT m_wunsch_fpw_hst_fil "Gefiltertes Wunschmoment" FLOAT32_IEEE trqg_fl_k_M_S7_S3 1 100 -2000 2000 ECU_ADDRESS 0xFFF861BC /end MEASUREMENT
/begin MEASUREMENT m_wunsch_fpw_hst_in "" FLOAT32_IEEE trq_fl_a_M_S7_S3 1 100 -3.40282E+038 3.40282E+038 ECU_ADDRESS 0xFFF86294 /end MEASUREMENT
/begin MEASUREMENT m_wunsch_fpw_in "" FLOAT32_IEEE trq_fl_a_M_S7_S3 1 100 -32768 32767 ECU_ADDRESS 0xFFF86248 /end MEASUREMENT
/begin MEASUREMENT m_ziel_k0_min_syn_ans "Minimales Zielmoment der Trennkupplung K0 zur Realisierung des Fahrerwunschmoments beim K0 Synchronisieren beim SLST" FLOAT32_IEEE trq_fl_a_M_S7_S3 1 100 -1000 1000 ECU_ADDRESS 0xFFF85E48 /end MEASUREMENT
/begin MEASUREMENT m_ziel_vm_has_ans "Zielmoment des VM beim Schleppstart" FLOAT32_IEEE trq_fl_a_M_S7_S3 1 100 -1000 1000 ECU_ADDRESS 0xFFF85E4C /end MEASUREMENT
/begin MEASUREMENT mg_mot_in "Gradient des Getriebeeingangsmoment" FLOAT32_IEEE trqg_fl_k_M_S7_S3 1 100 -2000 2000 ECU_ADDRESS 0xFFF861C0 /end MEASUREMENT
/begin MEASUREMENT mg_wunsch_fpw_hst_in "Gradient des gefilterten oder koordinierten Fahrerwunschmoments aus Fahrpedalinterpretation" FLOAT32_IEEE trqg_fl_k_M_S7_S3 1 100 -2000 2000 ECU_ADDRESS 0xFFF861C4 /end MEASUREMENT
/begin MEASUREMENT mo_k0befuell_ans "Momentoffset aus der K0-Erfuellung" FLOAT32_IEEE trq_fl_a_M_S7_S3 1 100 -1000 1000 ECU_ADDRESS 0xFFF85E50 /end MEASUREMENT
/begin MEASUREMENT mo_stoer_k0_mmotschalt_ans "Momentoffset auf das Vorsteuermoment aus mo_stoerkplresschl_ans und KF_MOSTOERKPL_ANS(m_mot_in, m_wunsch_fpw_hst_in)" FLOAT32_IEEE trq_fl_a_M_S7_S3 1 100 -1000 1000 ECU_ADDRESS 0xFFF85E54 /end MEASUREMENT
/begin MEASUREMENT mo_stoerkplresschl_ans "Momentoffset auf das Vorstuermoment im Falle Reponse SLST V2" FLOAT32_IEEE trq_fl_a_M_S7_S3 1 100 -1000 1000 ECU_ADDRESS 0xFFF85E58 /end MEASUREMENT
/begin MEASUREMENT msollresem_stat_mes "Gem. in Input nach Getr. Subsystem" FLOAT32_IEEE trq_fl_a_M_S7_S3 1 100 -10000 10000 ECU_ADDRESS 0xFFF85E5C /end MEASUREMENT
/begin MEASUREMENT n_ab_egs_in "" FLOAT32_IEEE n_fl_M_S7_S3 1 100 0 65535 ECU_ADDRESS 0xFFF86250 /end MEASUREMENT
/begin MEASUREMENT n_em_in "" FLOAT32_IEEE n_fl_M_S7_S3 1 100 -3.40282E+038 3.40282E+038 ECU_ADDRESS 0xFFF86254 /end MEASUREMENT
/begin MEASUREMENT n_em_mod_basis_syn_ans "Initialisierungs/ Ziel-Drehzahl zur Bestimmung der n_ziel_em_mod_syn_ans" FLOAT32_IEEE n_fl_M_S7_S3 1 100 -10000 10000 ECU_ADDRESS 0xFFF85E60 /end MEASUREMENT
/begin MEASUREMENT n_em_mod_syn_ans "Modifizierte EM-Drehzahl als Basisdrehzahl zur Bestimmung der VM Solldrehzahl bei RS beim K0 Synchronisieren beim Schleppstart" FLOAT32_IEEE n_fl_M_S7_S3 1 100 0 10000 ECU_ADDRESS 0xFFF85E64 /end MEASUREMENT
/begin MEASUREMENT n_em_ref_syn_ans "EM Referenzdrehzahl zur Bestimmung der modifizierten EM-Drehzahl als Basisdrehzahl zur Bestimmung der VM Solldrehzahl bei RS beim K0 Synchronisieren beim Schleppstart" FLOAT32_IEEE n_fl_M_S7_S3 1 100 0 10000 ECU_ADDRESS 0xFFF85E68 /end MEASUREMENT
/begin MEASUREMENT n_em_ziel_gradbr_ans "Zieldrehzahl fuer das Auffiltern der n_soll_em_has nach n_ziel_em_ans" FLOAT32_IEEE n_fl_M_S7_S3 1 100 -10000 10000 ECU_ADDRESS 0xFFF85E6C /end MEASUREMENT
/begin MEASUREMENT n_min_em_has_sbe "Minimale EM Drehzahl der Leerlaufsimulation der HAS (LLS)" FLOAT32_IEEE n_fl_M_S7_S3 1 100 -32767 32767 ECU_ADDRESS 0xFFF86204 /end MEASUREMENT
/begin MEASUREMENT n_mot_soll_iae_fil_ans "PT2 gefilterte Anfahrdrehzahl der IAE" FLOAT32_IEEE n_fl_M_S7_S3 1 100 -10000 10000 ECU_ADDRESS 0xFFF85E70 /end MEASUREMENT
/begin MEASUREMENT n_mot_soll_iae_in "" FLOAT32_IEEE n_fl_M_S7_S3 1 100 -3.40282E+038 3.40282E+038 ECU_ADDRESS 0xFFF86258 /end MEASUREMENT
/begin MEASUREMENT n_sec_iae "Sekundaere IAE-Drehzahl" FLOAT32_IEEE n_fl_M_S7_S3 1 100 -10000 10000 ECU_ADDRESS 0xFFF861D0 /end MEASUREMENT
/begin MEASUREMENT n_sec_iae_ist_ans "Abtriebsseitige IAE-Drehzahl bezogen auf den Getriebeeeingang und den aktuellen  Istgang waehrend einer Schaltung beim Schleppstart" FLOAT32_IEEE n_fl_M_S7_S3 1 100 -10000 10000 ECU_ADDRESS 0xFFF85E74 /end MEASUREMENT
/begin MEASUREMENT n_soll_em_anfiae_ans "Gemessen in solldrehzahlgrad.begr. n_soll_em_has aus regulaerer Berechnung" FLOAT32_IEEE n_fl_M_S7_S3 1 100 -10000 10000 ECU_ADDRESS 0xFFF85E7C /end MEASUREMENT
/begin MEASUREMENT n_soll_ll_vm_in "" FLOAT32_IEEE n_fl_M_S7_S3 1 100 0 2540 ECU_ADDRESS 0xFFF8625C /end MEASUREMENT
/begin MEASUREMENT n_vm_in "" FLOAT32_IEEE n_fl_M_S7_S3 1 100 0 65535 ECU_ADDRESS 0xFFF86264 /end MEASUREMENT
/begin MEASUREMENT n_ziel_em_mod_syn_ans "Initialisierungs/ Ziel-Drehzahl zur Bestimmung der n_em_ref_syn_ans" FLOAT32_IEEE n_fl_M_S7_S3 1 100 -10000 10000 ECU_ADDRESS 0xFFF85E80 /end MEASUREMENT
/begin MEASUREMENT nd_anfiaensollem_ans "Gemessen in solldrehzahl_em/grad. Begrenzter Ueberfuehrungsoffset" FLOAT32_IEEE n_fl_M_S7_S3 1 100 -10000 10000 ECU_ADDRESS 0xFFF85E84 /end MEASUREMENT
/begin MEASUREMENT nd_iae_ans "Differenzdrehzahl der IAE bezogen auf den Getriebeeingang  (n_em_in - n_sec_iae_fil)" FLOAT32_IEEE n_fl_M_S7_S3 1 100 -10000 10000 ECU_ADDRESS 0xFFF85E8C /end MEASUREMENT
/begin MEASUREMENT nd_iae_init_ans "Initialiseriung Gradientenbeg. zur Berechnung n_soll_em " FLOAT32_IEEE n_fl_M_S7_S3 1 100 -10000 10000 ECU_ADDRESS 0xFFF85E90 /end MEASUREMENT
/begin MEASUREMENT nd_k0_in "Differenzdrehzahl der Trennkupplung" FLOAT32_IEEE n_fl_M_S7_S3 1 100 -10000 10000 ECU_ADDRESS 0xFFF861D4 /end MEASUREMENT
/begin MEASUREMENT nd_nmotsolliaefilt_ans "Differenzdrehzahl als Eingangsgroesse in die Kennfelder zur Bestimmung der PT2-Filter der IAE-Soll-Anfahrderhzahl.." FLOAT32_IEEE n_fl_M_S7_S3 1 100 -10000 10000 ECU_ADDRESS 0xFFF85E94 /end MEASUREMENT
/begin MEASUREMENT nd_sec_iae_syn_ans "Abtriebsseitiger IAE-Drehzahlsprung bezogen auf den Getriebeeeingang waehrend einer Schaltung im Zustand K0 Synchronisieren beim Schleppstart" FLOAT32_IEEE n_fl_M_S7_S3 1 100 -10000 10000 ECU_ADDRESS 0xFFF85E98 /end MEASUREMENT
/begin MEASUREMENT nd_soll_iae_ans "Gemessen in solldrehzahl_em/konditionieren" FLOAT32_IEEE n_fl_M_S7_S3 1 100 -10000 10000 ECU_ADDRESS 0xFFF85E9C /end MEASUREMENT
/begin MEASUREMENT nd_soll_iae_init_ans "Initialiseriung Gradientenbeg. zur Berechnung n_soll_em " FLOAT32_IEEE n_fl_M_S7_S3 1 100 -10000 10000 ECU_ADDRESS 0xFFF85EA0 /end MEASUREMENT
/begin MEASUREMENT nd_soll_iae_stat_ans "Statischer Sollschlupf (Zielwert) bezogen auf den Getriebeeingang" FLOAT32_IEEE n_fl_M_S7_S3 1 100 -10000 10000 ECU_ADDRESS 0xFFF85EA4 /end MEASUREMENT
/begin MEASUREMENT ndg_k0_in "Gradienten der Differenzdrehzahl der Trennkupplung" FLOAT32_IEEE ng_fl_M_S7_S3 1 100 -10000 10000 ECU_ADDRESS 0xFFF861D8 /end MEASUREMENT
/begin MEASUREMENT nds_k0syncerk_syn_ans "Wirksame Differenzdrehzahlschwelle zur Erkennung Synchron beim Schleppstart" FLOAT32_IEEE n_fl_M_S7_S3 1 100 -10000 10000 ECU_ADDRESS 0xFFF85EA8 /end MEASUREMENT
/begin MEASUREMENT ng_em_ans "Drehzahlgradient der EM-Ist-Drehzahl" FLOAT32_IEEE ng_fl_M_S7_S3 1 100 -10000 10000 ECU_ADDRESS 0xFFF85EAC /end MEASUREMENT
/begin MEASUREMENT ng_emmodrsmax_syn_ans "Maximaler Gradient der modifizierten EM-Drehzahl als Basisdrehzahl zur Bestimmung der VM Solldrehzahl bei RS beim K0 Synchronisieren beim Schleppstart" FLOAT32_IEEE ng_fl_M_S7_S3 1 100 -10000 10000 ECU_ADDRESS 0xFFF85EB0 /end MEASUREMENT
/begin MEASUREMENT ng_sollem_ans "Drehzahlgradient (Betrag) fuer die Bestimmung der EM-Solldrehzahl" FLOAT32_IEEE ng_fl_M_S7_S3 1 100 -10000 10000 ECU_ADDRESS 0xFFF85EB4 /end MEASUREMENT
/begin MEASUREMENT ng_vm_in "Gradient der VM Drehzahl" FLOAT32_IEEE ng_fl_M_S7_S3 1 100 -10000 10000 ECU_ADDRESS 0xFFF861DC /end MEASUREMENT
/begin MEASUREMENT schalt_mode_egs_in "" UWORD void_int_c_M_S7_S3 1 100 0 65535 ECU_ADDRESS 0xFFF86780 /end MEASUREMENT
/begin MEASUREMENT sollgang_egs_in "" SBYTE void_int_M_S7_S3 1 100 -128 127 ECU_ADDRESS 0xFFF86CA3 /end MEASUREMENT
/begin MEASUREMENT status_iae_in "" UBYTE E_STATUSIAE_M_S7_S3 1 100 0 8 ECU_ADDRESS 0xFFF86CAA /end MEASUREMENT
/begin MEASUREMENT status_k0_befuellung_in "Interface provides the current filling mode of clutch 0" UBYTE E_STAK0BEF_M_S7_S3 1 100 0 3 ECU_ADDRESS 0xFFF86CAE /end MEASUREMENT
/begin MEASUREMENT status_k0_in "" UBYTE E_STATUSK0_M_S7_S3 1 100 0 5 ECU_ADDRESS 0xFFF86CAF /end MEASUREMENT
/begin MEASUREMENT status_kraftfluss_egs_in "" UBYTE E_STATUSKSL_M_S7_S3 1 100 0 6 ECU_ADDRESS 0xFFF86CB0 /end MEASUREMENT
/begin MEASUREMENT status_ll_vm_in "" UBYTE sts_int_M_S7_S3 1 100 0 255 ECU_ADDRESS 0xFFF86CB2 /end MEASUREMENT
/begin MEASUREMENT status_nmotsolliaesteigend_ans "Der Status zeigt an,ob die IAE-Soll-Anfahrdrehzahl steigt = 1 oder faellt, gleich = 0 bleibt und dient als Eingangsgroesse in die Kennfelder zur Bestimmung der PT2-Filter der IAE-Soll-Anfahrderhzahl." UBYTE sts_int_e_M_S7_S3 1 100 0 1 ECU_ADDRESS 0xFFF86A86 /end MEASUREMENT
/begin MEASUREMENT status_nreg_em_hst_in "" UBYTE sts_int_M_S7_S3 1 100 0 255 ECU_ADDRESS 0xFFF86CCE /end MEASUREMENT
/begin MEASUREMENT status_psys_has_sbe "Anzeige des Status Pumpendruck der HAS" UBYTE E_STATUSPSY_M_S7_S3 1 100 0 4 ECU_ADDRESS 0xFFF86C6C /end MEASUREMENT
/begin MEASUREMENT status_radschlupf_rse_has_sbe "Anzeige des Status der Radschlupferkennung (RSE) der HAS" UBYTE E_STATUSRSE_M_S7_S3 1 100 0 1 ECU_ADDRESS 0xFFF86C6D /end MEASUREMENT
/begin MEASUREMENT status_rs_aktiv_syn_ans "Der Status zeigt an, ob eine Rueckschaltung fuer die Bestimmung der n_em_ref_syn_ans aktiv ist" UBYTE sts_int_e_M_S7_S3 1 100 0 1 ECU_ADDRESS 0xFFF86A87 /end MEASUREMENT
/begin MEASUREMENT status_schaltart_svh_has_sbe "Schaltart der angeforderten Schaltung der Schaltverhinderung der HAS (0 = keine Schaltung angefordert) - Bit-Codierung (m/oL = mit/ohne Lastanh.) =  bit0=ZRSmL, 1=ZHSmL, 2=SRSmL, 3=SHSmL, 4=ZRSoL, 5=ZHSoL, 6=SRSoL, 7=SHSoL" UBYTE sts_int_M_S7_S3 1 100 0 255 ECU_ADDRESS 0xFFF86C6E /end MEASUREMENT
/begin MEASUREMENT status_schaltung_egs_in "Anzeige ob Schaltung des Getriebes aktiv ist" SBYTE sts_int_M_S7_S3 1 100 -9 9 ECU_ADDRESS 0xFFF86C6F /end MEASUREMENT
/begin MEASUREMENT status_sync_schaltung_sbe "Anzeige der Synchronerkennung der aktuellen Schaltung innerhalb der HAS" UBYTE sts_int_M_S7_S3 1 100 0 1 ECU_ADDRESS 0xFFF86C70 /end MEASUREMENT
/begin MEASUREMENT t_asistask_ans "Maximale Wartezeit fuer eine Schaltanforderung der Fahrstrategie" UWORD t_int_n_M_S7_S3 1 100 0 5 ECU_ADDRESS 0xFFF86650 /end MEASUREMENT
/begin MEASUREMENT t_fak0normiert_ans "Normierte Zeit fuer die K0-Fuellausgleichszeit 0 -100%" UWORD t_int_n_M_S7_S3 1 100 0 200 ECU_ADDRESS 0xFFF86652 /end MEASUREMENT
/begin MEASUREMENT t_fuellausk0_ans "Aktuelle Zeit einer aktiven Fuellausgleichszeit der K0" UWORD t_int_n_M_S7_S3 1 100 0 5 ECU_ADDRESS 0xFFF86654 /end MEASUREMENT
/begin MEASUREMENT t_k0sregaktiv_syn_ans "Timer der Verzoegerungszeit zur Aktivierung der K0-Schlupfregelung nach Eintritt in den Zustand K0 Synchronisieren beim Schleppstart" UWORD t_int_n_M_S7_S3 1 100 0 5 ECU_ADDRESS 0xFFF86656 /end MEASUREMENT
/begin MEASUREMENT t_k0sregbasis_syn_ans "Timer der Maximalzeit zum Setzen der Basisbedingung zur Aktivierung der K0-Schlupfregelung im Zustand K0 Synchronisieren beim Schleppstart" UWORD t_int_n_M_S7_S3 1 100 0 10 ECU_ADDRESS 0xFFF86658 /end MEASUREMENT
/begin MEASUREMENT t_k0syncerk_syn_ans "Timer zur Initialisierung der VM Solldrehzahlberechnung beim K0 Synchronisieren beim Schleppstart" UWORD t_int_n_M_S7_S3 1 100 0 10 ECU_ADDRESS 0xFFF8665A /end MEASUREMENT
/begin MEASUREMENT t_k0syncerkums_syn_ans "Timer fuer die Umschaltung der Differenzdrehzahlschwelle zur Erkennung Synchron bei Schleppstart" UWORD t_int_n_M_S7_S3 1 100 0 10 ECU_ADDRESS 0xFFF8665C /end MEASUREMENT
/begin MEASUREMENT t_maxbed_kon_ans "Verweilzeit in der Phase Konditionieren KON" UWORD t_int_n_M_S7_S3 1 100 0 10 ECU_ADDRESS 0xFFF86660 /end MEASUREMENT
/begin MEASUREMENT t_maxbed_lastwechel_ans "Restzeit bis Max._Timer abgelaufen ist in der Phase Start SRT" UWORD t_int_n_M_S7_S3 1 100 0 5 ECU_ADDRESS 0xFFF86662 /end MEASUREMENT
/begin MEASUREMENT t_maxbed_scl_ans "Verweilzeit in der Phase K0 Schliessen SCL" UWORD t_int_n_M_S7_S3 1 100 0 10 ECU_ADDRESS 0xFFF86666 /end MEASUREMENT
/begin MEASUREMENT t_maxbed_sst_ans "Verweilzeit in der Phase Anschleppen SST" UWORD t_int_n_M_S7_S3 1 100 0 10 ECU_ADDRESS 0xFFF86668 /end MEASUREMENT
/begin MEASUREMENT t_maxbed_syn_ans "Verweilzeit in der Phase K0 Synchronisieren SYN" UWORD t_int_n_M_S7_S3 1 100 0 10 ECU_ADDRESS 0xFFF8666A /end MEASUREMENT
/begin MEASUREMENT t_maxentkiae_kon_ans "Restzeit bis Befuellanforderung der K0 bei Anforderung Entkopplung IAE" UWORD t_int_n_M_S7_S3 1 100 0 1 ECU_ADDRESS 0xFFF8666E /end MEASUREMENT
/begin MEASUREMENT t_minbed_sst_ans "Min. Verweilzeit in der Phase Anschleppen SST" UWORD t_int_n_M_S7_S3 1 100 0 10 ECU_ADDRESS 0xFFF86674 /end MEASUREMENT
/begin MEASUREMENT t_mk0offset_sst_ans "Restzeit, bis die K0-Notrampe startet" UWORD t_int_n_M_S7_S3 1 100 0 10 ECU_ADDRESS 0xFFF86678 /end MEASUREMENT
/begin MEASUREMENT t_mstoerk0emfil_ans "Timerzeit zur Init. m_stoer_k0" UWORD t_int_n_M_S7_S3 1 100 0 5 ECU_ADDRESS 0xFFF8667C /end MEASUREMENT
/begin MEASUREMENT t_ndgk0k0sreg_syn_ans "Timer der Mindestdauer bei der Abfrage des K0-Differenzdrehzahlgradienten zur Bestimmung des Zeitpunkt der Anforderung der Aktivierung der K0-Schlupfregelung im Zustand K0 Synchronisieren beim Schleppstart" UWORD t_int_n_M_S7_S3 1 100 0 5 ECU_ADDRESS 0xFFF8667E /end MEASUREMENT
/begin MEASUREMENT t_resp_sas_kon_ans "Maxiamale Wartezeit zum Umschalten von z_respschlepp_sas_ans" UWORD t_int_n_M_S7_S3 1 100 0 5 ECU_ADDRESS 0xFFF86680 /end MEASUREMENT
/begin MEASUREMENT t_schlschalt_kon_ans "Maxiamale Wartezeit zum Umschalten von z_k0_bef_aktiv_ans, wenn LP3 (Druckversorgung) verfuegbar" UWORD t_int_n_M_S7_S3 1 100 0 5 ECU_ADDRESS 0xFFF86684 /end MEASUREMENT
/begin MEASUREMENT t_waitschlupf_kon_ans "Zeit, die gewartet wird bis Schlupf an der IAE erreicht sein soll." UWORD t_int_n_M_S7_S3 1 100 0 5 ECU_ADDRESS 0xFFF8668A /end MEASUREMENT
/begin MEASUREMENT t_zielfuellausgleichk0_ans "Max-Zeit einer aktiven Fuellausgleichszeit der K0" UWORD t_int_n_M_S7_S3 1 100 0 5 ECU_ADDRESS 0xFFF8668C /end MEASUREMENT
/begin MEASUREMENT trig_anfiae_aktiv_ans "Trigger zur Aktivierung der Gradientenueberfuehrung nach Anfahrdrehzahl der IAE" UBYTE void_int_d_M_S7_S3 1 100 0 1 ECU_ADDRESS 0xFFF86A88 /end MEASUREMENT
/begin MEASUREMENT trig_anfiae_deaktiv_ans "Trigger zur Deaktivierung der Gradientenueberfuehrung zurueck zu n_soll_em_has" UBYTE void_int_d_M_S7_S3 1 100 0 1 ECU_ADDRESS 0xFFF86A89 /end MEASUREMENT
/begin MEASUREMENT z_ablauf_has_hst_in "" UBYTE sts_int_M_S7_S3 1 100 0 15 ECU_ADDRESS 0xFFF86CB8 /end MEASUREMENT
/begin MEASUREMENT z_ablauf_has_stg "Zusaetzliche Steuergroesse zur Ablaufsteuerung" UBYTE ctrl_int_M_S7_S3 1 100 0 15 ECU_ADDRESS 0xFFF86C57 /end MEASUREMENT
/begin MEASUREMENT z_iae_entkoppelt_ans "Zeigt an, ob eine Entkopplung fuer die Ausgabe der EM-Solldrehzahl vorliegt." UBYTE void_int_d_M_S7_S3 1 100 0 1 ECU_ADDRESS 0xFFF86A8C /end MEASUREMENT
/begin MEASUREMENT z_k0_fst_in "" UBYTE E_ZK0FSTIN_M_S7_S3 1 100 0 3 ECU_ADDRESS 0xFFF86CBC /end MEASUREMENT
/begin MEASUREMENT z_k0entkaktiv_ans "Anzeige an, ob aus dem Ablauf heraus eine K0-Momentenabsenkung (K0-Entkoppelung) angefordert wird" UBYTE sts_int_e_M_S7_S3 1 100 0 1 ECU_ADDRESS 0xFFF86A91 /end MEASUREMENT
/begin MEASUREMENT z_m_max_iae_has_in "Gemessen in St_Konditionieren_En_St" UBYTE void_int_d_M_S7_S3 1 100 0 1 ECU_ADDRESS 0xFFF86A95 /end MEASUREMENT
/begin MEASUREMENT z_m_max_stiae_has "Gemessen in St_Konditionieren_En_St" UBYTE void_int_d_M_S7_S3 1 100 0 1 ECU_ADDRESS 0xFFF86A96 /end MEASUREMENT
/begin MEASUREMENT z_modus_em_hst_in "" UBYTE sts_int_M_S7_S3 1 100 0 255 ECU_ADDRESS 0xFFF86CBE /end MEASUREMENT
/begin MEASUREMENT z_n_soll_em_aktiv_ans "Flag, ueber das die EM-Solldrehzahl aktiviert wird." UBYTE void_int_d_M_S7_S3 1 100 0 1 ECU_ADDRESS 0xFFF86A98 /end MEASUREMENT
/begin MEASUREMENT z_n_soll_em_minmax_deaktiv_ans "Flag zeigt an, wenn die Drehzahlreglergrenzen Min/Max den Wert 0Nm in der PHase SYN erreicht haben. " UBYTE void_int_d_M_S7_S3 1 100 0 1 ECU_ADDRESS 0xFFF86A9A /end MEASUREMENT
/begin MEASUREMENT z_ndsk0k0sreg_syn_ans "Anzeige des Aktivierungszeitpunkts im Bestimmungsmodus \"NDSK0\" zur Anforderung der Aktivierung der K0-Schlupfregelung im Zustand K0 Synchronisieren beim Schleppstart" UBYTE sts_int_e_M_S7_S3 1 100 0 1 ECU_ADDRESS 0xFFF86A9B /end MEASUREMENT
/begin MEASUREMENT z_nsollvmaktiv_ans "Anzeige an, ob aus dem Ablauf heraus eine VM-Solldrehzahl angefordert wird" UBYTE sts_int_e_M_S7_S3 1 100 0 1 ECU_ADDRESS 0xFFF86A9C /end MEASUREMENT
/begin MEASUREMENT z_resp_schalt2_ans "Gemessen in St_Start" UBYTE void_int_d_M_S7_S3 1 100 0 1 ECU_ADDRESS 0xFFF86A9D /end MEASUREMENT
/begin MEASUREMENT z_resp_schalt2_statisch_ans "Gemessen in St_Start" UBYTE void_int_d_M_S7_S3 1 100 0 1 ECU_ADDRESS 0xFFF86A9E /end MEASUREMENT
/begin MEASUREMENT z_svh_has_sbe "Anforderung einer Schaltverhinderung der HAS" UBYTE st_int_M_S7_S3 1 100 0 1 ECU_ADDRESS 0xFFF86C7F /end MEASUREMENT
/begin MEASUREMENT z_syncdda_ans "Anzeige der Aktivierung der Beeinflussung der K0-Synchronisation bei durchdrehenden Antriebsraedern beim Schleppstart" UBYTE void_int_d_M_S7_S3 1 100 0 1 ECU_ADDRESS 0xFFF86AA2 /end MEASUREMENT
/begin MEASUREMENT zielgang_egs_in "" SBYTE sts_int_M_S7_S3 1 100 -128 127 ECU_ADDRESS 0xFFF86CC4 /end MEASUREMENT
/begin COMPU_METHOD SAB_PHI_GRAD100_S2_S3 "int = ((phys * 100) / 1) - (0) grad" RAT_FUNC "%4.2" "grad" COEFFS 0 100 -0 0 0 1 /end COMPU_METHOD
/begin COMPU_METHOD SAB_PHI_GRAD256_S2_S3 "int = ((phys * 256) / 1) - (0) grad" RAT_FUNC "%5.3" "grad" COEFFS 0 256 -0 0 0 1 /end COMPU_METHOD
/begin COMPU_METHOD SAB_L_MM_S2_S3 "int = ((phys * 1) / 1) - (0) mm" RAT_FUNC "%2.0" "mm" COEFFS 0 1 -0 0 0 1 /end COMPU_METHOD
/begin COMPU_METHOD SAB_L_KM1_S2_S3 "int = ((phys * 10) / 1) - (0) km" RAT_FUNC "%5.3" "km" COEFFS 0 10 -0 0 0 1 /end COMPU_METHOD
/begin COMPU_METHOD SAB_L_KM8_S2_S3 "int = ((phys * 8) / 1) - (0) km" RAT_FUNC "%5.3" "km" COEFFS 0 8 -0 0 0 1 /end COMPU_METHOD
/begin COMPU_METHOD c_fl_M_S7_S3 "Temperatur" RAT_FUNC "%12.6" "°C" COEFFS 0 1 0 0 0 1 /end COMPU_METHOD
/begin COMPU_METHOD c_fl_t_M_S7_S3 "Temperatur" RAT_FUNC "%3.0" "°C" COEFFS 0 1 0 0 0 1 /end COMPU_METHOD
/begin COMPU_METHOD c_int_M_S7_S3 "Temperatur" RAT_FUNC "%12.6" "°C" COEFFS 0 1 0 0 0 1 /end COMPU_METHOD
/begin COMPU_METHOD ctrl_int_M_S7_S3 "Steuerwort" RAT_FUNC "%3.0" "-" COEFFS 0 1 0 0 0 1 /end COMPU_METHOD
/begin COMPU_METHOD E_STAK0BEF_M_S7_S3 "" TAB_VERB "%12.6" "" COMPU_TAB_REF CONV_TAB_E_STAK0BEF_M_S7_S3 /end COMPU_METHOD
/begin COMPU_METHOD E_STATUSIAE_M_S7_S3 "" TAB_VERB "%12.6" "" COMPU_TAB_REF CONV_TAB_E_STATUSIAE_M_S7_S3 /end COMPU_METHOD
/begin COMPU_METHOD E_STATUSK0_M_S7_S3 "" TAB_VERB "%12.6" "" COMPU_TAB_REF CONV_TAB_E_STATUSK0_M_S7_S3 /end COMPU_METHOD
/begin COMPU_METHOD E_STATUSKSL_M_S7_S3 "" TAB_VERB "%12.6" "" COMPU_TAB_REF CONV_TAB_E_STATUSKSL_M_S7_S3 /end COMPU_METHOD
/begin COMPU_METHOD E_STATUSPSY_M_S7_S3 "" TAB_VERB "%12.6" "" COMPU_TAB_REF CONV_TAB_E_STATUSPSY_M_S7_S3 /end COMPU_METHOD
/begin COMPU_METHOD E_STATUSRSE_M_S7_S3 "" TAB_VERB "%12.6" "" COMPU_TAB_REF CONV_TAB_E_STATUSRSE_M_S7_S3 /end COMPU_METHOD
/begin COMPU_METHOD E_ZK0FSTIN_M_S7_S3 "" TAB_VERB "%12.6" "" COMPU_TAB_REF CONV_TAB_E_ZK0FSTIN_M_S7_S3 /end COMPU_METHOD
/begin COMPU_METHOD n_fl_M_S7_S3 "Drehzahl" RAT_FUNC "%12.6" "1/min" COEFFS 0 1 0 0 0 1 /end COMPU_METHOD
/begin COMPU_METHOD ng_fl_M_S7_S3 "Drehzahlgradient" RAT_FUNC "%12.6" "1/min/s" COEFFS 0 1 0 0 0 1 /end COMPU_METHOD
/begin COMPU_METHOD phi_fl_M_S7_S3 "Winkel in rad" RAT_FUNC "%12.6" "rad" COEFFS 0 1 0 0 0 1 /end COMPU_METHOD
/begin COMPU_METHOD ratio_fl_M_S7_S3 "Uebersetzungsverhaeltnis" RAT_FUNC "%12.6" "-" COEFFS 0 1 0 0 0 1 /end COMPU_METHOD
/begin COMPU_METHOD rel_fl_M_S7_S3 "Relative Groesse" RAT_FUNC "%12.6" "%" COEFFS 0 1 0 0 0 1 /end COMPU_METHOD
/begin COMPU_METHOD st_int_M_S7_S3 "Zustandsgroesse" RAT_FUNC "%3.0" "-" COEFFS 0 1 0 0 0 1 /end COMPU_METHOD
/begin COMPU_METHOD sts_fl_M_S7_S3 "Status" RAT_FUNC "%12.6" "-" COEFFS 0 1 0 0 0 1 /end COMPU_METHOD
/begin COMPU_METHOD sts_int_M_S7_S3 "Status" RAT_FUNC "%3.0" "-" COEFFS 0 1 0 0 0 1 /end COMPU_METHOD
/begin COMPU_METHOD sts_int_e_M_S7_S3 "Status" RAT_FUNC "%1.0" "-" COEFFS 0 1 0 0 0 1 /end COMPU_METHOD
/begin COMPU_METHOD sts_int_r_M_S7_S3 "Status" RAT_FUNC "%12.6" "-" COEFFS 0 1 0 0 0 1 /end COMPU_METHOD
/begin COMPU_METHOD swi_int_M_S7_S3 "Schalter" RAT_FUNC "%1.0" "-" COEFFS 0 1 0 0 0 1 /end COMPU_METHOD
/begin COMPU_METHOD swi_int_o_M_S7_S3 "Schalter" RAT_FUNC "%3.0" "-" COEFFS 0 1 0 0 0 1 /end COMPU_METHOD
/begin COMPU_METHOD t_fl_M_S7_S3 "Zeit" RAT_FUNC "%12.6" "s" COEFFS 0 1 0 0 0 1 /end COMPU_METHOD
/begin COMPU_METHOD t_int_n_M_S7_S3 "Zeit" RAT_FUNC "%6.2" "s" COEFFS 0 1 0 0 0 0.01 /end COMPU_METHOD
/begin COMPU_METHOD tc_fl_M_S7_S3 "Filterzeit" RAT_FUNC "%12.6" "s" COEFFS 0 1 0 0 0 1 /end COMPU_METHOD
/begin COMPU_METHOD trq_fl_a_M_S7_S3 "Moment" RAT_FUNC "%12.6" "Nm" COEFFS 0 1 0 0 0 1 /end COMPU_METHOD
/begin COMPU_METHOD trqg_fl_k_M_S7_S3 "Momentengradient" RAT_FUNC "%12.6" "Nm/s" COEFFS 0 1 0 0 0 1 /end COMPU_METHOD
/begin COMPU_METHOD void_fl_M_S7_S3 "ohne Umrechnung" RAT_FUNC "%12.6" "-" COEFFS 0 1 0 0 0 1 /end COMPU_METHOD
/begin COMPU_METHOD void_fl_s_M_S7_S3 "ohne Umrechnung" RAT_FUNC "%3.0" "-" COEFFS 0 1 0 0 0 1 /end COMPU_METHOD
/begin COMPU_METHOD void_fl_u_M_S7_S3 "ohne Umrechnung" RAT_FUNC "%1.0" "-" COEFFS 0 1 0 0 0 1 /end COMPU_METHOD
/begin COMPU_METHOD void_int_M_S7_S3 "ohne Umrechnung" RAT_FUNC "%3.0" "-" COEFFS 0 1 0 0 0 1 /end COMPU_METHOD
/begin COMPU_METHOD void_int_c_M_S7_S3 "ohne Umrechnung" RAT_FUNC "%5.0" "-" COEFFS 0 1 0 0 0 1 /end COMPU_METHOD
/begin COMPU_METHOD void_int_d_M_S7_S3 "ohne Umrechnung" RAT_FUNC "%1.0" "-" COEFFS 0 1 0 0 0 1 /end COMPU_METHOD
/begin COMPU_METHOD void_int_q_M_S7_S3 "ohne Umrechnung" RAT_FUNC "%12.6" "-" COEFFS 0 1 0 0 0 1 /end COMPU_METHOD
/begin COMPU_METHOD VOID_SCALING_M_S7_S3 "Void scaling for unscaled variables" RAT_FUNC "%12.6" "" COEFFS 0 1 0 0 0 1 /end COMPU_METHOD
/begin COMPU_VTAB CONV_TAB_E_STAK0BEF_M_S7_S3 "Conversion table" TAB_VERB 4 0 "NICHT_AKTIV" 1 "STANDARD_BEF" 2 "OPTIMIERTBEF" 3 "REDUZIERTBEF" /end COMPU_VTAB
/begin COMPU_VTAB CONV_TAB_E_STATUSIAE_M_S7_S3 "Conversion table" TAB_VERB 9 0 "NICHTDEFINIERT" 1 "OFFEN" 2 "ANGELEGT" 3 "ANFAHREN" 4 "ENTKOPPELT" 5 "ENTKOPPELT_ANFAHREN" 6 "SYNCHRONISIEREN" 7 "GESCHLOSSEN" 8 "OEFFNEN" /end COMPU_VTAB
/begin COMPU_VTAB CONV_TAB_E_STATUSK0_M_S7_S3 "Conversion table" TAB_VERB 6 0 "OFFEN" 1 "ANGELEGT" 2 "DRUCKSTELLUNG" 3 "SCHLUPFGEREGELT" 4 "GEREGELTGESCHL" 5 "GESCHLOSSEN" /end COMPU_VTAB
/begin COMPU_VTAB CONV_TAB_E_STATUSKSL_M_S7_S3 "Conversion table" TAB_VERB 7 0 "KEIN_KRAFTSCHLUSS" 1 "VORW_AUF_ABBAUEND" 2 "VORWAERTS" 3 "RUECKW_AUF_ABBAUEND" 4 "RUECKWAERTS" 5 "VORWAERTS_SCHLUPF" 6 "RUECKWAERTS_SCHLUPF" /end COMPU_VTAB
/begin COMPU_VTAB CONV_TAB_E_STATUSPSY_M_S7_S3 "Conversion table" TAB_VERB 5 0 "AUS" 1 "NICHTDEFINIERT" 2 "LP1" 3 "LP2" 4 "LP3" /end COMPU_VTAB
/begin COMPU_VTAB CONV_TAB_E_STATUSRSE_M_S7_S3 "Conversion table" TAB_VERB 2 0 "KEIN_RADSCHLUPF" 1 "DURCHDREHEN_ERKANNT" /end COMPU_VTAB
/begin COMPU_VTAB CONV_TAB_E_ZK0FSTIN_M_S7_S3 "Conversion table" TAB_VERB 4 0 "OFFEN" 1 "SCHLUPFGEREGELT" 2 "GEREGELTGESCHL" 3 "GESCHLOSSEN" /end COMPU_VTAB
/begin FUNCTION SFOp_SLST164_St_Start ""
 /begin DEF_CHARACTERISTIC KL_KSVH_RESET_SRT_ANS_Y KL_KSVH_RESET_SRT_ANS_X KF_ABLV_RESPPARAL_SRT_ANS_W KF_ABLV_RESPPARAL_SRT_ANS_X KF_ABLV_RESPPARAL_SRT_ANS_Y KF_MMOT_RESPPARAL_SRT_ANS_W KF_MMOT_RESPPARAL_SRT_ANS_X KF_MMOT_RESPPARAL_SRT_ANS_Y KF_STIAESTKRAFT_RESCH_SRT_ANS_W KF_STIAESTKRAFT_RESCH_SRT_ANS_X KF_STIAESTKRAFT_RESCH_SRT_ANS_Y KF_TSSCHLSCHALT_SRT_ANS_W KF_TSSCHLSCHALT_SRT_ANS_X KF_TSSCHLSCHALT_SRT_ANS_Y KF_ZSCHLEPPSCHALTABLVAR_SRT_ANS_W KF_ZSCHLEPPSCHALTABLVAR_SRT_ANS_X KF_ZSCHLEPPSCHALTABLVAR_SRT_ANS_Y KL_MWUNSCH_RESPPARAL_SRT_ANS_Y KL_MWUNSCH_RESPPARAL_SRT_ANS_X KF_MMOT_LASTWECHSEL_SRT_ANS_W KF_MMOT_LASTWECHSEL_SRT_ANS_X KF_MMOT_LASTWECHSEL_SRT_ANS_Y SWI_STLASTWECHSELAKTIV_SRT_ANS SWI_UMSCHMGMOT_SRT_ANS T_LASTWECHSELMAX_SRT_ANS STATUS_ABL_SRT_ANS CS_GETR_RESPPARAL_SRT_ANS NO_NSOLLLLVM_RESPS_SRT_ANS NS_NEM_RESPPARAL_SRT_ANS SWI_RESPPARALHS_SRT_ANS SWI_RESPPARAL_SRT_ANS SWI_RESPSCHLE_SCHALT_SRT_ANS T_ASISTASKMAX_ANS T_SCHLSCHALT_SRT_ANS ND_MIN_SAF_ANS K_SVH_RESET_RESPPARAL_SRT_ANS /end DEF_CHARACTERISTIC
 /begin LOC_MEASUREMENT nd_iae_ans z_k0entkaktiv_ans z_m_max_iae_has_in z_m_max_stiae_has z_nsollvmaktiv_ans z_iae_entkoppelt_ans m_ziel_vm_has_ans n_sec_iae_ist_ans t_maxbed_lastwechel_ans t_asistask_ans z_resp_schalt2_ans z_resp_schalt2_statisch_ans z_ablauf_has_stg i_istgang_egs i_zielgang_egs m_wunsch_fpw_hst_fil mg_wunsch_fpw_hst_in n_sec_iae nd_k0_in ndg_k0_in ng_vm_in status_schaltung_egs_in status_psys_has_sbe status_sync_schaltung_sbe mg_mot_in status_schaltart_svh_has_sbe z_svh_has_sbe n_min_em_has_sbe z_modus_em_hst_in c_getriebe_egs_in istgang_egs_in m_em_in m_iae_in m_k0_in m_max_dyn_em_in m_soll_em_hst_in m_soll_vm_hst_in m_vm_in m_vm_start_in m_wunsch_fpw_in n_ab_egs_in n_em_in n_soll_ll_vm_in n_vm_in sollgang_egs_in status_iae_in status_k0_in z_ablauf_has_hst_in zielgang_egs_in z_k0_fst_in m_mot_in status_kraftfluss_egs_in n_mot_soll_iae_in gangwechsel_egs_in kolbenpos_k0_in status_ll_vm_in m_min_dyn_em_in schalt_mode_egs_in status_k0_befuellung_in c_vm_in abstellpos_vm_in abstellpos_vm_status_in status_nreg_em_hst_in m_min_vm_in m_soll_vm_l_hst_in m_wunsch_fpw_hst_in /end LOC_MEASUREMENT
 /begin SUB_FUNCTION SFOp_SLST638_Initialisierung SFOp_SLST637_Initialisierung SFOp_SLST640_Initialisierung SFOp_SLST645_Initialisierung /end SUB_FUNCTION
/end FUNCTION
/begin FUNCTION SFOp_SLST165_St_Uebergabe "" /begin DEF_CHARACTERISTIC MS_MMAXIAEINAKTIV_ANS /end DEF_CHARACTERISTIC
 /begin LOC_MEASUREMENT nd_iae_ans z_k0entkaktiv_ans z_m_max_iae_has_in z_m_max_stiae_has z_nsollvmaktiv_ans z_iae_entkoppelt_ans m_ziel_vm_has_ans n_sec_iae_ist_ans z_ablauf_has_stg i_istgang_egs i_zielgang_egs m_wunsch_fpw_hst_fil mg_wunsch_fpw_hst_in n_sec_iae nd_k0_in ndg_k0_in ng_vm_in status_schaltung_egs_in status_psys_has_sbe status_sync_schaltung_sbe mg_mot_in status_schaltart_svh_has_sbe z_svh_has_sbe n_min_em_has_sbe z_modus_em_hst_in c_getriebe_egs_in istgang_egs_in m_em_in m_iae_in m_k0_in m_max_dyn_em_in m_soll_em_hst_in m_soll_vm_hst_in m_vm_in m_vm_start_in m_wunsch_fpw_in n_ab_egs_in n_em_in n_soll_ll_vm_in n_vm_in sollgang_egs_in status_iae_in status_k0_in z_ablauf_has_hst_in zielgang_egs_in z_k0_fst_in m_mot_in status_kraftfluss_egs_in n_mot_soll_iae_in gangwechsel_egs_in kolbenpos_k0_in status_ll_vm_in m_min_dyn_em_in schalt_mode_egs_in status_k0_befuellung_in c_vm_in abstellpos_vm_in abstellpos_vm_status_in status_nreg_em_hst_in m_min_vm_in m_soll_vm_l_hst_in m_wunsch_fpw_hst_in /end LOC_MEASUREMENT
 /begin SUB_FUNCTION SFOp_SLST664_st_uebergabe /end SUB_FUNCTION
/end FUNCTION
/begin FUNCTION SFOp_SLST166_St_Uebergabe_SLSTAbbruch_Ans ""
 /begin LOC_MEASUREMENT nd_iae_ans z_k0entkaktiv_ans z_m_max_iae_has_in z_m_max_stiae_has z_nsollvmaktiv_ans z_iae_entkoppelt_ans m_ziel_vm_has_ans n_sec_iae_ist_ans z_ablauf_has_stg i_istgang_egs i_zielgang_egs m_wunsch_fpw_hst_fil mg_wunsch_fpw_hst_in n_sec_iae nd_k0_in ndg_k0_in ng_vm_in status_schaltung_egs_in status_psys_has_sbe status_sync_schaltung_sbe mg_mot_in status_schaltart_svh_has_sbe z_svh_has_sbe n_min_em_has_sbe z_modus_em_hst_in c_getriebe_egs_in istgang_egs_in m_em_in m_iae_in m_k0_in m_max_dyn_em_in m_soll_em_hst_in m_soll_vm_hst_in m_vm_in m_vm_start_in m_wunsch_fpw_in n_ab_egs_in n_em_in n_soll_ll_vm_in n_vm_in sollgang_egs_in status_iae_in status_k0_in z_ablauf_has_hst_in zielgang_egs_in z_k0_fst_in m_mot_in status_kraftfluss_egs_in n_mot_soll_iae_in gangwechsel_egs_in kolbenpos_k0_in status_ll_vm_in m_min_dyn_em_in schalt_mode_egs_in status_k0_befuellung_in c_vm_in abstellpos_vm_in abstellpos_vm_status_in status_nreg_em_hst_in m_min_vm_in m_soll_vm_l_hst_in m_wunsch_fpw_hst_in /end LOC_MEASUREMENT
 /begin SUB_FUNCTION SFOp_SLST679_st_slstabbr_uebergabe_ans /end SUB_FUNCTION
/end FUNCTION
/begin FUNCTION SFOp_SLST167_St_VM_zuenden_Ans "" /begin DEF_CHARACTERISTIC STATUS_ABL_ZND_ANS /end DEF_CHARACTERISTIC
 /begin LOC_MEASUREMENT nd_iae_ans z_nsollvmaktiv_ans m_ziel_vm_has_ans n_sec_iae_ist_ans z_ablauf_has_stg i_istgang_egs i_zielgang_egs m_wunsch_fpw_hst_fil n_sec_iae ndg_k0_in status_schaltung_egs_in status_sync_schaltung_sbe mg_mot_in status_schaltart_svh_has_sbe z_svh_has_sbe n_min_em_has_sbe z_modus_em_hst_in m_iae_in m_soll_em_hst_in m_soll_vm_hst_in m_vm_in m_vm_start_in n_ab_egs_in status_iae_in z_k0_fst_in n_mot_soll_iae_in kolbenpos_k0_in status_ll_vm_in schalt_mode_egs_in status_k0_befuellung_in c_vm_in abstellpos_vm_in abstellpos_vm_status_in m_min_vm_in m_soll_vm_l_hst_in m_wunsch_fpw_hst_in /end LOC_MEASUREMENT
 /begin SUB_FUNCTION SFOp_SLST695_st_vm_zuenden_ans /end SUB_FUNCTION
/end FUNCTION
/begin FUNCTION SFOp_SLST169_Gradient ""
 /begin LOC_MEASUREMENT nd_iae_ans z_k0entkaktiv_ans z_m_max_iae_has_in z_m_max_stiae_has z_nsollvmaktiv_ans z_iae_entkoppelt_ans m_ziel_vm_has_ans n_sec_iae_ist_ans z_ablauf_has_stg i_zielgang_egs m_wunsch_fpw_hst_fil mg_wunsch_fpw_hst_in nd_k0_in ndg_k0_in ng_vm_in status_schaltung_egs_in status_psys_has_sbe status_sync_schaltung_sbe mg_mot_in status_schaltart_svh_has_sbe z_svh_has_sbe z_modus_em_hst_in c_getriebe_egs_in istgang_egs_in m_em_in m_iae_in m_k0_in m_max_dyn_em_in m_soll_em_hst_in m_soll_vm_hst_in m_vm_in m_vm_start_in m_wunsch_fpw_in n_vm_in sollgang_egs_in status_k0_in z_ablauf_has_hst_in zielgang_egs_in z_k0_fst_in m_mot_in gangwechsel_egs_in kolbenpos_k0_in status_ll_vm_in m_min_dyn_em_in schalt_mode_egs_in status_k0_befuellung_in c_vm_in abstellpos_vm_in abstellpos_vm_status_in m_min_vm_in m_soll_vm_l_hst_in m_wunsch_fpw_hst_in /end LOC_MEASUREMENT
 /begin SUB_FUNCTION SFOp_SLST179_EM_Drehzahl_Berechnung /end SUB_FUNCTION
/end FUNCTION
/begin FUNCTION SFOp_SLST170_Out "" /begin LOC_MEASUREMENT nd_soll_iae_ans nd_soll_iae_stat_ans /end LOC_MEASUREMENT /end FUNCTION
/begin FUNCTION SFOp_SLST172_anschleppen ""
 /begin DEF_CHARACTERISTIC KF_NDGSOLLIAE_KON_ANS_W KF_NDGSOLLIAE_KON_ANS_X KF_NDGSOLLIAE_KON_ANS_Y KF_NDSOLLIAE_KON_ANS_W KF_NDSOLLIAE_KON_ANS_X KF_NDSOLLIAE_KON_ANS_Y KF_NGSOLLEM_NEMNDIAE_KON_ANS_W KF_NGSOLLEM_NEMNDIAE_KON_ANS_X KF_NGSOLLEM_NEMNDIAE_KON_ANS_Y KF_NGSOLLEM_STIAEKRAFT_KON_ANS_W KF_NGSOLLEM_STIAEKRAFT_KON_ANS_X KF_NGSOLLEM_STIAEKRAFT_KON_ANS_Y KF_NOSOLLIAEAKTIV_ANS_W KF_NOSOLLIAEAKTIV_ANS_X KF_NOSOLLIAEAKTIV_ANS_Y KL_FNDGSOLLIAE_SST_ANS_Y KL_FNDGSOLLIAE_SST_ANS_X KL_FNDSOLLIAE_SST_ANS_Y KL_FNDSOLLIAE_SST_ANS_X NG_SOLLEMNSOLLLLVM_KON_ANS NG_SOLLEM_KON_ANS /end DEF_CHARACTERISTIC
 /begin LOC_MEASUREMENT nd_iae_ans z_k0entkaktiv_ans z_m_max_iae_has_in z_m_max_stiae_has z_nsollvmaktiv_ans z_iae_entkoppelt_ans m_ziel_vm_has_ans n_sec_iae_ist_ans z_ablauf_has_stg i_istgang_egs i_zielgang_egs m_wunsch_fpw_hst_fil mg_wunsch_fpw_hst_in n_sec_iae nd_k0_in ndg_k0_in ng_vm_in status_schaltung_egs_in status_psys_has_sbe status_sync_schaltung_sbe mg_mot_in status_schaltart_svh_has_sbe z_svh_has_sbe n_min_em_has_sbe z_modus_em_hst_in c_getriebe_egs_in istgang_egs_in m_em_in m_iae_in m_k0_in m_max_dyn_em_in m_soll_em_hst_in m_soll_vm_hst_in m_vm_in m_vm_start_in m_wunsch_fpw_in n_ab_egs_in n_em_in n_soll_ll_vm_in n_vm_in sollgang_egs_in status_iae_in status_k0_in z_ablauf_has_hst_in zielgang_egs_in z_k0_fst_in m_mot_in status_kraftfluss_egs_in n_mot_soll_iae_in gangwechsel_egs_in kolbenpos_k0_in status_ll_vm_in m_min_dyn_em_in schalt_mode_egs_in status_k0_befuellung_in c_vm_in abstellpos_vm_in abstellpos_vm_status_in status_nreg_em_hst_in m_min_vm_in m_soll_vm_l_hst_in m_wunsch_fpw_hst_in /end LOC_MEASUREMENT
/end FUNCTION
/begin FUNCTION SFOp_SLST175_k0_schliessen ""
 /begin DEF_CHARACTERISTIC KF_NDGSOLLIAE_KON_ANS_W KF_NDGSOLLIAE_KON_ANS_X KF_NDGSOLLIAE_KON_ANS_Y KF_NDSOLLIAE_KON_ANS_W KF_NDSOLLIAE_KON_ANS_X KF_NDSOLLIAE_KON_ANS_Y KF_NGSOLLEM_NEMNDIAE_KON_ANS_W KF_NGSOLLEM_NEMNDIAE_KON_ANS_X KF_NGSOLLEM_NEMNDIAE_KON_ANS_Y KF_NGSOLLEM_STIAEKRAFT_KON_ANS_W KF_NGSOLLEM_STIAEKRAFT_KON_ANS_X KF_NGSOLLEM_STIAEKRAFT_KON_ANS_Y KF_NOSOLLIAEAKTIV_ANS_W KF_NOSOLLIAEAKTIV_ANS_X KF_NOSOLLIAEAKTIV_ANS_Y KL_FNDGSOLLIAE_SCL_ANS_Y KL_FNDGSOLLIAE_SCL_ANS_X KL_FNDSOLLIAE_SCL_ANS_Y KL_FNDSOLLIAE_SCL_ANS_X NG_SOLLEMNSOLLLLVM_KON_ANS NG_SOLLEM_KON_ANS /end DEF_CHARACTERISTIC
 /begin LOC_MEASUREMENT nd_iae_ans z_k0entkaktiv_ans z_m_max_iae_has_in z_m_max_stiae_has z_nsollvmaktiv_ans z_iae_entkoppelt_ans m_ziel_vm_has_ans n_sec_iae_ist_ans z_ablauf_has_stg i_istgang_egs i_zielgang_egs m_wunsch_fpw_hst_fil mg_wunsch_fpw_hst_in n_sec_iae nd_k0_in ndg_k0_in ng_vm_in status_schaltung_egs_in status_psys_has_sbe status_sync_schaltung_sbe mg_mot_in status_schaltart_svh_has_sbe z_svh_has_sbe n_min_em_has_sbe z_modus_em_hst_in c_getriebe_egs_in istgang_egs_in m_em_in m_iae_in m_k0_in m_max_dyn_em_in m_soll_em_hst_in m_soll_vm_hst_in m_vm_in m_vm_start_in m_wunsch_fpw_in n_ab_egs_in n_em_in n_soll_ll_vm_in n_vm_in sollgang_egs_in status_iae_in status_k0_in z_ablauf_has_hst_in zielgang_egs_in z_k0_fst_in m_mot_in status_kraftfluss_egs_in n_mot_soll_iae_in gangwechsel_egs_in kolbenpos_k0_in status_ll_vm_in m_min_dyn_em_in schalt_mode_egs_in status_k0_befuellung_in c_vm_in abstellpos_vm_in abstellpos_vm_status_in status_nreg_em_hst_in m_min_vm_in m_soll_vm_l_hst_in m_wunsch_fpw_hst_in /end LOC_MEASUREMENT
/end FUNCTION
/begin FUNCTION SFOp_SLST176_konditionieren ""
 /begin DEF_CHARACTERISTIC KF_NDGSOLLIAE_KON_ANS_W KF_NDGSOLLIAE_KON_ANS_X KF_NDGSOLLIAE_KON_ANS_Y KF_NDSOLLIAE_KON_ANS_W KF_NDSOLLIAE_KON_ANS_X KF_NDSOLLIAE_KON_ANS_Y KF_NGSOLLEM_NEMNDIAE_KON_ANS_W KF_NGSOLLEM_NEMNDIAE_KON_ANS_X KF_NGSOLLEM_NEMNDIAE_KON_ANS_Y KF_NGSOLLEM_STIAEKRAFT_KON_ANS_W KF_NGSOLLEM_STIAEKRAFT_KON_ANS_X KF_NGSOLLEM_STIAEKRAFT_KON_ANS_Y KF_NOSOLLIAEAKTIV_ANS_W KF_NOSOLLIAEAKTIV_ANS_X KF_NOSOLLIAEAKTIV_ANS_Y KL_FNDGSOLLIAE_KON_ANS_Y KL_FNDGSOLLIAE_KON_ANS_X KL_FNDSOLLIAE_KON_ANS_Y KL_FNDSOLLIAE_KON_ANS_X NG_SOLLEMNSOLLLLVM_KON_ANS NG_SOLLEM_KON_ANS /end DEF_CHARACTERISTIC
 /begin LOC_MEASUREMENT nd_iae_ans z_k0entkaktiv_ans z_m_max_iae_has_in z_m_max_stiae_has z_nsollvmaktiv_ans z_iae_entkoppelt_ans m_ziel_vm_has_ans n_sec_iae_ist_ans z_ablauf_has_stg i_istgang_egs i_zielgang_egs m_wunsch_fpw_hst_fil mg_wunsch_fpw_hst_in n_sec_iae nd_k0_in ndg_k0_in ng_vm_in status_schaltung_egs_in status_psys_has_sbe status_sync_schaltung_sbe mg_mot_in status_schaltart_svh_has_sbe z_svh_has_sbe n_min_em_has_sbe z_modus_em_hst_in c_getriebe_egs_in istgang_egs_in m_em_in m_iae_in m_k0_in m_max_dyn_em_in m_soll_em_hst_in m_soll_vm_hst_in m_vm_in m_vm_start_in m_wunsch_fpw_in n_ab_egs_in n_em_in n_soll_ll_vm_in n_vm_in sollgang_egs_in status_iae_in status_k0_in z_ablauf_has_hst_in zielgang_egs_in z_k0_fst_in m_mot_in status_kraftfluss_egs_in n_mot_soll_iae_in gangwechsel_egs_in kolbenpos_k0_in status_ll_vm_in m_min_dyn_em_in schalt_mode_egs_in status_k0_befuellung_in c_vm_in abstellpos_vm_in abstellpos_vm_status_in status_nreg_em_hst_in m_min_vm_in m_soll_vm_l_hst_in m_wunsch_fpw_hst_in /end LOC_MEASUREMENT
/end FUNCTION
/begin FUNCTION SFOp_SLST177_synchronisieren ""
 /begin DEF_CHARACTERISTIC KF_NDGSOLLIAE_KON_ANS_W KF_NDGSOLLIAE_KON_ANS_X KF_NDGSOLLIAE_KON_ANS_Y KF_NDSOLLIAE_KON_ANS_W KF_NDSOLLIAE_KON_ANS_X KF_NDSOLLIAE_KON_ANS_Y KF_NGSOLLEM_NEMNDIAE_KON_ANS_W KF_NGSOLLEM_NEMNDIAE_KON_ANS_X KF_NGSOLLEM_NEMNDIAE_KON_ANS_Y KF_NGSOLLEM_STIAEKRAFT_KON_ANS_W KF_NGSOLLEM_STIAEKRAFT_KON_ANS_X KF_NGSOLLEM_STIAEKRAFT_KON_ANS_Y KF_NOSOLLIAEAKTIV_ANS_W KF_NOSOLLIAEAKTIV_ANS_X KF_NOSOLLIAEAKTIV_ANS_Y KL_FNDGSOLLIAE_SYN_ANS_Y KL_FNDGSOLLIAE_SYN_ANS_X KL_FNDSOLLIAE_SYN_ANS_Y KL_FNDSOLLIAE_SYN_ANS_X NG_SOLLEMNSOLLLLVM_KON_ANS NG_SOLLEM_KON_ANS NG_SOLLEMIAEENTK_SYN_ANS /end DEF_CHARACTERISTIC
 /begin LOC_MEASUREMENT nd_iae_ans z_k0entkaktiv_ans z_m_max_iae_has_in z_m_max_stiae_has z_nsollvmaktiv_ans z_iae_entkoppelt_ans m_ziel_vm_has_ans n_sec_iae_ist_ans z_ablauf_has_stg i_istgang_egs i_zielgang_egs m_wunsch_fpw_hst_fil mg_wunsch_fpw_hst_in n_sec_iae nd_k0_in ndg_k0_in ng_vm_in status_schaltung_egs_in status_psys_has_sbe status_sync_schaltung_sbe mg_mot_in status_schaltart_svh_has_sbe z_svh_has_sbe n_min_em_has_sbe z_modus_em_hst_in c_getriebe_egs_in istgang_egs_in m_em_in m_iae_in m_k0_in m_max_dyn_em_in m_soll_em_hst_in m_soll_vm_hst_in m_vm_in m_vm_start_in m_wunsch_fpw_in n_ab_egs_in n_em_in n_soll_ll_vm_in n_vm_in sollgang_egs_in status_iae_in status_k0_in z_ablauf_has_hst_in zielgang_egs_in z_k0_fst_in m_mot_in status_kraftfluss_egs_in n_mot_soll_iae_in gangwechsel_egs_in kolbenpos_k0_in status_ll_vm_in m_min_dyn_em_in schalt_mode_egs_in status_k0_befuellung_in c_vm_in abstellpos_vm_in abstellpos_vm_status_in status_nreg_em_hst_in m_min_vm_in m_soll_vm_l_hst_in m_wunsch_fpw_hst_in /end LOC_MEASUREMENT
/end FUNCTION
/begin FUNCTION SFOp_SLST178_zuenden ""
 /begin DEF_CHARACTERISTIC KF_NDGSOLLIAE_KON_ANS_W KF_NDGSOLLIAE_KON_ANS_X KF_NDGSOLLIAE_KON_ANS_Y KF_NDSOLLIAE_KON_ANS_W KF_NDSOLLIAE_KON_ANS_X KF_NDSOLLIAE_KON_ANS_Y KF_NGSOLLEM_NEMNDIAE_KON_ANS_W KF_NGSOLLEM_NEMNDIAE_KON_ANS_X KF_NGSOLLEM_NEMNDIAE_KON_ANS_Y KF_NGSOLLEM_STIAEKRAFT_KON_ANS_W KF_NGSOLLEM_STIAEKRAFT_KON_ANS_X KF_NGSOLLEM_STIAEKRAFT_KON_ANS_Y KF_NOSOLLIAEAKTIV_ANS_W KF_NOSOLLIAEAKTIV_ANS_X KF_NOSOLLIAEAKTIV_ANS_Y KL_FNDGSOLLIAE_ZND_ANS_Y KL_FNDGSOLLIAE_ZND_ANS_X KL_FNDSOLLIAE_ZND_ANS_Y KL_FNDSOLLIAE_ZND_ANS_X NG_SOLLEMNSOLLLLVM_KON_ANS NG_SOLLEM_KON_ANS /end DEF_CHARACTERISTIC
 /begin LOC_MEASUREMENT nd_iae_ans z_k0entkaktiv_ans z_m_max_iae_has_in z_m_max_stiae_has z_nsollvmaktiv_ans z_iae_entkoppelt_ans m_ziel_vm_has_ans n_sec_iae_ist_ans z_ablauf_has_stg i_istgang_egs i_zielgang_egs m_wunsch_fpw_hst_fil mg_wunsch_fpw_hst_in n_sec_iae nd_k0_in ndg_k0_in ng_vm_in status_schaltung_egs_in status_psys_has_sbe status_sync_schaltung_sbe mg_mot_in status_schaltart_svh_has_sbe z_svh_has_sbe n_min_em_has_sbe z_modus_em_hst_in c_getriebe_egs_in istgang_egs_in m_em_in m_iae_in m_k0_in m_max_dyn_em_in m_soll_em_hst_in m_soll_vm_hst_in m_vm_in m_vm_start_in m_wunsch_fpw_in n_ab_egs_in n_em_in n_soll_ll_vm_in n_vm_in sollgang_egs_in status_iae_in status_k0_in z_ablauf_has_hst_in zielgang_egs_in z_k0_fst_in m_mot_in status_kraftfluss_egs_in n_mot_soll_iae_in gangwechsel_egs_in kolbenpos_k0_in status_ll_vm_in m_min_dyn_em_in schalt_mode_egs_in status_k0_befuellung_in c_vm_in abstellpos_vm_in abstellpos_vm_status_in status_nreg_em_hst_in m_min_vm_in m_soll_vm_l_hst_in m_wunsch_fpw_hst_in /end LOC_MEASUREMENT
/end FUNCTION
/begin FUNCTION SFOp_SLST179_EM_Drehzahl_Berechnung ""
 /begin DEF_CHARACTERISTIC KL_NGIAEANF_ANS_Y KL_NGIAEANF_ANS_X KF_FKNMOTSOLLIAEPT1_ANS_W KF_FKNMOTSOLLIAEPT1_ANS_X KF_FKNMOTSOLLIAEPT1_ANS_Y KF_FKNMOTSOLLIAEPT2_ANS_W KF_FKNMOTSOLLIAEPT2_ANS_X KF_FKNMOTSOLLIAEPT2_ANS_Y KF_UMSCHNSOLLEMABS_ANS_W KF_UMSCHNSOLLEMABS_ANS_X KF_UMSCHNSOLLEMABS_ANS_Y KL_NZIELEMKRAFTFLUSS_ANS_Y KL_NZIELEMKRAFTFLUSS_ANS_X NO_SOLLLLVM_NZIELEM_ANS SWI_NZIELEMBEGRLLS_ANS SWI_UMSCH_NSOLLEM_ABFIL_ANS SWI_AUSW_NIAEANF_ANS NO_SECIAEFIL_NZIELEMANF_ANS NO_SOLLLLVM_NZIELEMANF_ANS SWI_NMOTSOLLIAEFILAKTIV_ANS /end DEF_CHARACTERISTIC
 /begin LOC_MEASUREMENT nd_iae_ans z_k0entkaktiv_ans z_m_max_iae_has_in z_m_max_stiae_has z_nsollvmaktiv_ans z_iae_entkoppelt_ans m_ziel_vm_has_ans n_sec_iae_ist_ans n_em_ziel_gradbr_ans init_nsollem_grad_ans nd_iae_init_ans nd_soll_iae_init_ans nd_soll_iae_ans ng_sollem_ans nd_soll_iae_stat_ans nd_nmotsolliaefilt_ans status_nmotsolliaesteigend_ans init_anfiae_aktiv_ans n_mot_soll_iae_fil_ans n_soll_em_anfiae_ans nd_anfiaensollem_ans trig_anfiae_aktiv_ans trig_anfiae_deaktiv_ans z_ablauf_has_stg i_istgang_egs i_zielgang_egs m_wunsch_fpw_hst_fil mg_wunsch_fpw_hst_in n_sec_iae nd_k0_in ndg_k0_in ng_vm_in status_schaltung_egs_in status_psys_has_sbe status_sync_schaltung_sbe mg_mot_in status_schaltart_svh_has_sbe z_svh_has_sbe n_min_em_has_sbe z_modus_em_hst_in c_getriebe_egs_in istgang_egs_in m_em_in m_iae_in m_k0_in m_max_dyn_em_in m_soll_em_hst_in m_soll_vm_hst_in m_vm_in m_vm_start_in m_wunsch_fpw_in n_ab_egs_in n_em_in n_soll_ll_vm_in n_vm_in sollgang_egs_in status_iae_in status_k0_in z_ablauf_has_hst_in zielgang_egs_in z_k0_fst_in m_mot_in status_kraftfluss_egs_in n_mot_soll_iae_in gangwechsel_egs_in kolbenpos_k0_in status_ll_vm_in m_min_dyn_em_in schalt_mode_egs_in status_k0_befuellung_in c_vm_in abstellpos_vm_in abstellpos_vm_status_in status_nreg_em_hst_in m_min_vm_in m_soll_vm_l_hst_in m_wunsch_fpw_hst_in /end LOC_MEASUREMENT
 /begin SUB_FUNCTION Run_SFOp_SLST198_cLimiter_Gradient_ndiae1 Run_SFOp_SLST203_cLimiter_nsollemiae /end SUB_FUNCTION
/end FUNCTION
/begin FUNCTION SFOp_SLST227_st_anschleppen_ans ""
 /begin DEF_CHARACTERISTIC KF_NOEMNSOLLVM_KON_ANS_W KF_NOEMNSOLLVM_KON_ANS_X KF_NOEMNSOLLVM_KON_ANS_Y KF_MGSOLLK0VMMINRS_SST_ANS_W KF_MGSOLLK0VMMINRS_SST_ANS_X KF_MGSOLLK0VMMINRS_SST_ANS_Y KF_MGSOLLK0VMMIN_SST_ANS_W KF_MGSOLLK0VMMIN_SST_ANS_X KF_MGSOLLK0VMMIN_SST_ANS_Y KF_MGSOLLK0VMSTARTRS_SST_ANS_W KF_MGSOLLK0VMSTARTRS_SST_ANS_X KF_MGSOLLK0VMSTARTRS_SST_ANS_Y KF_MGSOLLK0VMSTART_SST_ANS_W KF_MGSOLLK0VMSTART_SST_ANS_X KF_MGSOLLK0VMSTART_SST_ANS_Y KL_MGSOLLK0_SCHUB_SST_ANS_Y KL_MGSOLLK0_SCHUB_SST_ANS_X KL_MGSOLLK0_SST_ANS_Y KL_MGSOLLK0_SST_ANS_X KF_MK0MMOTNVM2_SCHUB_SST_ANS_W KF_MK0MMOTNVM2_SCHUB_SST_ANS_X KF_MK0MMOTNVM2_SCHUB_SST_ANS_Y KF_MK0MMOTNVM2_SST_ANS_W KF_MK0MMOTNVM2_SST_ANS_X KF_MK0MMOTNVM2_SST_ANS_Y KF_MZIELK0BEFMODUS_SST_ANS_W KF_MZIELK0BEFMODUS_SST_ANS_X KF_MZIELK0BEFMODUS_SST_ANS_Y KL_FMK0MMOTNVM2_SCHUB_SST_ANS_Y KL_FMK0MMOTNVM2_SCHUB_SST_ANS_X KL_FMK0MMOTNVM2_SST_ANS_Y KL_FMK0MMOTNVM2_SST_ANS_X KL_NDIAEEMMAXIAE_SST_ANS_Y KL_NDIAEEMMAXIAE_SST_ANS_X KF_MGZIELMAXEM_KON_ANS_W KF_MGZIELMAXEM_KON_ANS_X KF_MGZIELMAXEM_KON_ANS_Y KF_MGZIELMINEM_KON_ANS_W KF_MGZIELMINEM_KON_ANS_X KF_MGZIELMINEM_KON_ANS_Y STATUS_ABLVMDREHT_HST_SST_ANS STATUS_ABLVMFEHLER_HST_SST_ANS STATUS_ABLVMLAEUFT_HST_SST_ANS M_ZIELMAXEM_SST_ANS M_ZIELMINEM_SST_ANS K_MSTOERKPL_SST_ANS MS_ZMSOLLEMAKTIV_KON_ANS MS_RESEM_SST_ANS STATUS_K0ZMSOLLEMAKTIV_SST_ANS SWI_MSTOERK0EMMK0_SST_ANS SWI_ZMSOLLEM_SST_ANS SWI_ZNSOLLEM_SST_ANS F_NDSOLLIAESTAT_KON_ANS MG_MOMAXIAE1_SST_ANS MG_MOMAXIAE2_SST_ANS MO_MEM_KON_ANS MS_MMAXIAEINAKTIV_ANS NS_MOK0ABSTELLPOSNVM_SST_ANS MS_MINMGSOLLK0RS_SST_ANS MS_MINMGSOLLK0_SST_ANS NS_MGK0VMSTART_SST_ANS MG_K0OFFSET_SST_ANS MS_ZIELPHYSK0_SST_ANS MO_K0OFFSET_SST_ANS T_MK0OFFSETMAX_SST_ANS SWI_MK0MOD_HAS_ANS SWI_ZPHYSK0_SST_ANS MS_K0STATUSABL_SST_ANS STATUS_ABL_K0ENTK_SST_ANS STATUS_ABL_SST_ANS T_MAX_SST_ANS T_MIN_SST_ANS SWI_UMSCH_ZVMSTARTFEHLER_ANS FK_NSOLLVM_SST_ANS K_MZIELNOEMNSOLLVM_KON_ANS K_NOEMNSOLLVMOKS_KON_ANS NO_EMNSOLLVMRESPPARALRS_KON_ANS N_MINEMNSOLLVM_KON_ANS SWI_NSOLLEMENTKIAE_KON_ANS SWI_NSOLLVMENTKIAE_KON_ANS /end DEF_CHARACTERISTIC
 /begin LOC_MEASUREMENT nd_iae_ans z_k0entkaktiv_ans z_m_max_iae_has_in z_m_max_stiae_has z_nsollvmaktiv_ans z_iae_entkoppelt_ans m_ziel_vm_has_ans n_sec_iae_ist_ans t_mk0offset_sst_ans t_maxbed_sst_ans t_minbed_sst_ans z_ablauf_has_stg i_istgang_egs i_zielgang_egs m_wunsch_fpw_hst_fil mg_wunsch_fpw_hst_in n_sec_iae nd_k0_in ndg_k0_in ng_vm_in status_schaltung_egs_in status_psys_has_sbe status_sync_schaltung_sbe mg_mot_in status_schaltart_svh_has_sbe z_svh_has_sbe n_min_em_has_sbe z_modus_em_hst_in c_getriebe_egs_in istgang_egs_in m_em_in m_iae_in m_k0_in m_max_dyn_em_in m_soll_em_hst_in m_soll_vm_hst_in m_vm_in m_vm_start_in m_wunsch_fpw_in n_ab_egs_in n_em_in n_soll_ll_vm_in n_vm_in sollgang_egs_in status_iae_in status_k0_in z_ablauf_has_hst_in zielgang_egs_in z_k0_fst_in m_mot_in status_kraftfluss_egs_in n_mot_soll_iae_in gangwechsel_egs_in kolbenpos_k0_in status_ll_vm_in m_min_dyn_em_in schalt_mode_egs_in status_k0_befuellung_in c_vm_in abstellpos_vm_in abstellpos_vm_status_in status_nreg_em_hst_in m_min_vm_in m_soll_vm_l_hst_in m_wunsch_fpw_hst_in /end LOC_MEASUREMENT
 /begin SUB_FUNCTION SFOp_SLST280_Initialisierung SFOp_SLST261_Initialisierung SFOp_SLST294_Initialisierung Run_SFOp_SLST296_CL_PT1_14nsollvm /end SUB_FUNCTION
/end FUNCTION
/begin FUNCTION SFOp_SLST261_Initialisierung ""
 /begin DEF_CHARACTERISTIC KF_MK0MMOTNVM1_SCHUB_SST_ANS_W KF_MK0MMOTNVM1_SCHUB_SST_ANS_X KF_MK0MMOTNVM1_SCHUB_SST_ANS_Y KF_MK0MMOTNVM1_SST_ANS_W KF_MK0MMOTNVM1_SST_ANS_X KF_MK0MMOTNVM1_SST_ANS_Y KL_FMK0MMOTNVM1_SCHUB_SST_ANS_Y KL_FMK0MMOTNVM1_SCHUB_SST_ANS_X KL_FMK0MMOTNVM1_SST_ANS_Y KL_FMK0MMOTNVM1_SST_ANS_X KL_MK0MVMSTART_SST_ANS_Y KL_MK0MVMSTART_SST_ANS_X KF_MOK0ABSTELLPOS_SST_ANS_W KF_MOK0ABSTELLPOS_SST_ANS_X KF_MOK0ABSTELLPOS_SST_ANS_Y MO_K0ABSTELLPOSUNGUELTIG_SST_ANS NS_K0ABSTELLPOSUNGUELTIG_SST_ANS STATUS_ABSTELLPOSVMGUELTIG_ANS /end DEF_CHARACTERISTIC
 /begin LOC_MEASUREMENT nd_iae_ans z_k0entkaktiv_ans z_m_max_iae_has_in z_m_max_stiae_has z_nsollvmaktiv_ans z_iae_entkoppelt_ans m_ziel_vm_has_ans n_sec_iae_ist_ans z_ablauf_has_stg i_istgang_egs i_zielgang_egs m_wunsch_fpw_hst_fil mg_wunsch_fpw_hst_in n_sec_iae nd_k0_in ndg_k0_in ng_vm_in status_schaltung_egs_in status_psys_has_sbe status_sync_schaltung_sbe mg_mot_in status_schaltart_svh_has_sbe z_svh_has_sbe n_min_em_has_sbe z_modus_em_hst_in c_getriebe_egs_in istgang_egs_in m_em_in m_iae_in m_k0_in m_max_dyn_em_in m_soll_em_hst_in m_soll_vm_hst_in m_vm_in m_vm_start_in m_wunsch_fpw_in n_ab_egs_in n_em_in n_soll_ll_vm_in n_vm_in sollgang_egs_in status_iae_in status_k0_in z_ablauf_has_hst_in zielgang_egs_in z_k0_fst_in m_mot_in status_kraftfluss_egs_in n_mot_soll_iae_in gangwechsel_egs_in kolbenpos_k0_in status_ll_vm_in m_min_dyn_em_in schalt_mode_egs_in status_k0_befuellung_in c_vm_in abstellpos_vm_in abstellpos_vm_status_in status_nreg_em_hst_in m_min_vm_in m_soll_vm_l_hst_in m_wunsch_fpw_hst_in /end LOC_MEASUREMENT
/end FUNCTION
/begin FUNCTION SFOp_SLST280_Initialisierung ""
 /begin DEF_CHARACTERISTIC KL_KSVH_RESET_SST_ANS_Y KL_KSVH_RESET_SST_ANS_X K_SVH_RESET_RESPPARAL_SST_ANS /end DEF_CHARACTERISTIC
 /begin LOC_MEASUREMENT nd_iae_ans z_k0entkaktiv_ans z_m_max_iae_has_in z_m_max_stiae_has z_nsollvmaktiv_ans z_iae_entkoppelt_ans m_ziel_vm_has_ans n_sec_iae_ist_ans z_ablauf_has_stg i_istgang_egs i_zielgang_egs m_wunsch_fpw_hst_fil mg_wunsch_fpw_hst_in n_sec_iae nd_k0_in ndg_k0_in ng_vm_in status_schaltung_egs_in status_psys_has_sbe status_sync_schaltung_sbe mg_mot_in status_schaltart_svh_has_sbe z_svh_has_sbe n_min_em_has_sbe z_modus_em_hst_in c_getriebe_egs_in istgang_egs_in m_em_in m_iae_in m_k0_in m_max_dyn_em_in m_soll_em_hst_in m_soll_vm_hst_in m_vm_in m_vm_start_in m_wunsch_fpw_in n_ab_egs_in n_em_in n_soll_ll_vm_in n_vm_in sollgang_egs_in status_iae_in status_k0_in z_ablauf_has_hst_in zielgang_egs_in z_k0_fst_in m_mot_in status_kraftfluss_egs_in n_mot_soll_iae_in gangwechsel_egs_in kolbenpos_k0_in status_ll_vm_in m_min_dyn_em_in schalt_mode_egs_in status_k0_befuellung_in c_vm_in abstellpos_vm_in abstellpos_vm_status_in status_nreg_em_hst_in m_min_vm_in m_soll_vm_l_hst_in m_wunsch_fpw_hst_in /end LOC_MEASUREMENT
/end FUNCTION
/begin FUNCTION SFOp_SLST294_Initialisierung ""
 /begin LOC_MEASUREMENT nd_iae_ans z_k0entkaktiv_ans z_m_max_iae_has_in z_m_max_stiae_has z_nsollvmaktiv_ans z_iae_entkoppelt_ans m_ziel_vm_has_ans n_sec_iae_ist_ans z_ablauf_has_stg i_istgang_egs i_zielgang_egs m_wunsch_fpw_hst_fil mg_wunsch_fpw_hst_in n_sec_iae nd_k0_in ndg_k0_in ng_vm_in status_schaltung_egs_in status_psys_has_sbe status_sync_schaltung_sbe mg_mot_in status_schaltart_svh_has_sbe z_svh_has_sbe n_min_em_has_sbe z_modus_em_hst_in c_getriebe_egs_in istgang_egs_in m_em_in m_iae_in m_k0_in m_max_dyn_em_in m_soll_em_hst_in m_soll_vm_hst_in m_vm_in m_wunsch_fpw_in n_ab_egs_in n_em_in n_soll_ll_vm_in n_vm_in sollgang_egs_in status_iae_in status_k0_in z_ablauf_has_hst_in zielgang_egs_in z_k0_fst_in m_mot_in status_kraftfluss_egs_in n_mot_soll_iae_in gangwechsel_egs_in kolbenpos_k0_in status_ll_vm_in m_min_dyn_em_in schalt_mode_egs_in status_k0_befuellung_in c_vm_in abstellpos_vm_in abstellpos_vm_status_in status_nreg_em_hst_in m_min_vm_in m_soll_vm_l_hst_in m_wunsch_fpw_hst_in /end LOC_MEASUREMENT
/end FUNCTION
/begin FUNCTION SFOp_SLST305_st_k0_schliessen_ans ""
 /begin DEF_CHARACTERISTIC KL_MGK0MODMAX_SCL_ANS_Y KL_MGK0MODMAX_SCL_ANS_X MS_MMAXIAEINAKTIV_ANS SWI_ZMSOLLEM_NULL_SCL_ANS SWI_ZNSOLLEMMINMAX_SYN_ANS SWI_ZNSOLLEM_SCL_ANS STATUS_ABL_SCL_ANS T_MAX_SCL_ANS /end DEF_CHARACTERISTIC
 /begin LOC_MEASUREMENT nd_iae_ans z_k0entkaktiv_ans z_m_max_iae_has_in z_m_max_stiae_has z_nsollvmaktiv_ans z_iae_entkoppelt_ans m_ziel_vm_has_ans n_sec_iae_ist_ans t_maxbed_scl_ans z_ablauf_has_stg i_istgang_egs i_zielgang_egs m_wunsch_fpw_hst_fil mg_wunsch_fpw_hst_in n_sec_iae nd_k0_in ndg_k0_in ng_vm_in status_schaltung_egs_in status_psys_has_sbe status_sync_schaltung_sbe mg_mot_in status_schaltart_svh_has_sbe z_svh_has_sbe n_min_em_has_sbe z_modus_em_hst_in c_getriebe_egs_in istgang_egs_in m_em_in m_iae_in m_k0_in m_max_dyn_em_in m_soll_em_hst_in m_soll_vm_hst_in m_vm_in m_vm_start_in m_wunsch_fpw_in n_ab_egs_in n_em_in n_soll_ll_vm_in n_vm_in sollgang_egs_in status_iae_in status_k0_in z_ablauf_has_hst_in zielgang_egs_in z_k0_fst_in m_mot_in status_kraftfluss_egs_in n_mot_soll_iae_in gangwechsel_egs_in kolbenpos_k0_in status_ll_vm_in m_min_dyn_em_in schalt_mode_egs_in status_k0_befuellung_in c_vm_in abstellpos_vm_in abstellpos_vm_status_in status_nreg_em_hst_in m_min_vm_in m_soll_vm_l_hst_in m_wunsch_fpw_hst_in /end LOC_MEASUREMENT
 /begin SUB_FUNCTION SFOp_SLST324_Initialisierung SFOp_SLST315_Initialisierung SFOp_SLST312_Initialisierung SFOp_SLST317_Initialisierung SFOp_SLST323_Initialisierung /end SUB_FUNCTION
/end FUNCTION
/begin FUNCTION SFOp_SLST312_Initialisierung "" /begin DEF_CHARACTERISTIC SWI_ZMSOLLEM_SCL_ANS /end DEF_CHARACTERISTIC /end FUNCTION
/begin FUNCTION SFOp_SLST315_Initialisierung "" /begin DEF_CHARACTERISTIC MS_MMAXIAEINAKTIV_ANS /end DEF_CHARACTERISTIC /end FUNCTION
/begin FUNCTION SFOp_SLST317_Initialisierung "" /begin DEF_CHARACTERISTIC SWI_ZPHYSK0_SCL_ANS /end DEF_CHARACTERISTIC /end FUNCTION
/begin FUNCTION SFOp_SLST323_Initialisierung "" /begin DEF_CHARACTERISTIC STATUS_ABL_SCL_ANS /end DEF_CHARACTERISTIC /end FUNCTION
/begin FUNCTION SFOp_SLST324_Initialisierung ""
 /begin DEF_CHARACTERISTIC KL_KSVH_RESET_SCL_ANS_Y KL_KSVH_RESET_SCL_ANS_X K_SVH_RESET_RESPPARAL_SCL_ANS K_SVH_RESET_RESPTEILPAR_SCL_ANS /end DEF_CHARACTERISTIC
 /begin LOC_MEASUREMENT nd_iae_ans z_k0entkaktiv_ans z_m_max_iae_has_in z_m_max_stiae_has z_nsollvmaktiv_ans z_iae_entkoppelt_ans m_ziel_vm_has_ans n_sec_iae_ist_ans z_ablauf_has_stg i_istgang_egs i_zielgang_egs m_wunsch_fpw_hst_fil mg_wunsch_fpw_hst_in n_sec_iae nd_k0_in ndg_k0_in ng_vm_in status_schaltung_egs_in status_psys_has_sbe status_sync_schaltung_sbe mg_mot_in status_schaltart_svh_has_sbe z_svh_has_sbe n_min_em_has_sbe z_modus_em_hst_in c_getriebe_egs_in istgang_egs_in m_em_in m_iae_in m_k0_in m_max_dyn_em_in m_soll_em_hst_in m_soll_vm_hst_in m_vm_in m_vm_start_in m_wunsch_fpw_in n_ab_egs_in n_em_in n_soll_ll_vm_in n_vm_in sollgang_egs_in status_iae_in status_k0_in z_ablauf_has_hst_in zielgang_egs_in z_k0_fst_in m_mot_in status_kraftfluss_egs_in n_mot_soll_iae_in gangwechsel_egs_in kolbenpos_k0_in status_ll_vm_in m_min_dyn_em_in schalt_mode_egs_in status_k0_befuellung_in c_vm_in abstellpos_vm_in abstellpos_vm_status_in status_nreg_em_hst_in m_min_vm_in m_soll_vm_l_hst_in m_wunsch_fpw_hst_in /end LOC_MEASUREMENT
/end FUNCTION
/begin FUNCTION SFOp_SLST334_st_k0_synchronisieren_ans ""
 /begin DEF_CHARACTERISTIC KF_MGK0NDK0M_SCHUB_SYN_ANS_W KF_MGK0NDK0M_SCHUB_SYN_ANS_X KF_MGK0NDK0M_SCHUB_SYN_ANS_Y KF_MGK0NDK0M_SYNCDDA_SYN_ANS_W KF_MGK0NDK0M_SYNCDDA_SYN_ANS_X KF_MGK0NDK0M_SYNCDDA_SYN_ANS_Y KF_MGK0NDK0M_SYN_ANS_W KF_MGK0NDK0M_SYN_ANS_X KF_MGK0NDK0M_SYN_ANS_Y KF_MGK0NDK0NGVM_SCHUB_SYN_ANS_W KF_MGK0NDK0NGVM_SCHUB_SYN_ANS_X KF_MGK0NDK0NGVM_SCHUB_SYN_ANS_Y KF_MGK0NDK0NGVM_SYN_ANS_W KF_MGK0NDK0NGVM_SYN_ANS_X KF_MGK0NDK0NGVM_SYN_ANS_Y KL_FMGK0ISTGANG_SYN_ANS_Y KL_FMGK0ISTGANG_SYN_ANS_X KL_MGK0MODMAX_SYN_ANS_Y KL_MGK0MODMAX_SYN_ANS_X KL_MGK0MODMIN_SYN_ANS_Y KL_MGK0MODMIN_SYN_ANS_X KL_MZIELK0MIN_SYNCDDA_SYN_ANS_Y KL_MZIELK0MIN_SYNCDDA_SYN_ANS_X KL_MZIELK0MIN_SYN_ANS_Y KL_MZIELK0MIN_SYN_ANS_X KF_NDSK0SYNCERK_SYN_ANS_W KF_NDSK0SYNCERK_SYN_ANS_X KF_NDSK0SYNCERK_SYN_ANS_Y KF_TK0SYNCERKUMS_SYN_ANS_W KF_TK0SYNCERKUMS_SYN_ANS_X KF_TK0SYNCERKUMS_SYN_ANS_Y KL_NDSK0K0SREG_SYN_ANS_Y KL_NDSK0K0SREG_SYN_ANS_X KL_K0SREGSTATUSIAE_SYN_ANS_Y KL_K0SREGSTATUSIAE_SYN_ANS_X KL_NDIAEEMMAXIAE_SYN_ANS_Y KL_NDIAEEMMAXIAE_SYN_ANS_X KL_MGZIELMAXEM_SYN_ANS_Y KL_MGZIELMAXEM_SYN_ANS_X KL_MGZIELMINEM_SYN_ANS_Y KL_MGZIELMINEM_SYN_ANS_X NS_EMMINBED_SYN_ANS SWI_UMSCH_NSOLLEM_ABFIL_ANS M_ZIELMAXEM_SST_ANS M_ZIELMINEM_SST_ANS MS_ZMSOLLEMAKTIV_KON_ANS STATUS_K0ZMSOLLEMAKTIV_SST_ANS SWI_MSTOERK0EMMK0_SST_ANS F_NDSOLLIAESTAT_KON_ANS MO_MEM_KON_ANS MS_MMAXIAEINAKTIV_ANS K_NOEMNSOLLVMOKS_KON_ANS N_MINEMNSOLLVM_KON_ANS SWI_ZNSOLLEMMINMAX_SYN_ANS K_MSTOERKPL_SYN_ANS SWI_ZMSOLLEM_SYN_ANS SWI_ZNSOLLEM_SYN_ANS MG_MOMAXIAE1_SYN_ANS MG_MOMAXIAE2_SYN_ANS NDS_SOLLIAEZMMAXIAE_SYN_ANS SWI_ZMMAXIAE_SYN_ANS SWI_K0SREGBASIS_SYN_ANS MS_SOLLK0K0SREG_SYN_ANS MS_ZIELVMK0SREG_SYN_ANS NOS_NSOLLVMZK0SREGBAS_SYN_ANS T_K0SREGBASISMAX_SYN_ANS NDGS_K0K0SREG_SYN_ANS NOS_EMNSOLLVMK0SREG_SYN_ANS SWI_ZK0SREGMODUS_SYN_ANS T_NDGK0K0SREGMIN_SYN_ANS T_VK0SREGAKTIV_SYN_ANS SWI_KFMGK0AUSWAHL_SYN_ANS NDS_K0SYNCERKDDA_SYN_ANS NDS_K0SYNCERKMAX_SYN_ANS T_VK0SYNCERKDDA_SYN_ANS T_VK0SYNCERK_SYN_ANS NOS_EMNSOLLVM_SYN_ANS STATUS_ABL_SYN_ANS T_MAX_SYN_ANS FK_NSOLLVM_SYN_ANS NO_SOLLVMNREGEM_SYN_ANS /end DEF_CHARACTERISTIC
 /begin LOC_MEASUREMENT nd_iae_ans z_k0entkaktiv_ans z_m_max_iae_has_in z_m_max_stiae_has z_nsollvmaktiv_ans z_iae_entkoppelt_ans ng_em_ans m_ziel_vm_has_ans n_sec_iae_ist_ans z_n_soll_em_minmax_deaktiv_ans t_k0sregbasis_syn_ans t_ndgk0k0sreg_syn_ans z_ndsk0k0sreg_syn_ans t_k0sregaktiv_syn_ans nds_k0syncerk_syn_ans t_k0syncerk_syn_ans t_k0syncerkums_syn_ans m_ziel_k0_min_syn_ans t_maxbed_syn_ans z_ablauf_has_stg i_istgang_egs i_zielgang_egs m_wunsch_fpw_hst_fil mg_wunsch_fpw_hst_in n_sec_iae nd_k0_in ndg_k0_in ng_vm_in status_schaltung_egs_in status_psys_has_sbe status_sync_schaltung_sbe mg_mot_in status_schaltart_svh_has_sbe z_svh_has_sbe n_min_em_has_sbe z_modus_em_hst_in c_getriebe_egs_in istgang_egs_in m_em_in m_iae_in m_k0_in m_max_dyn_em_in m_soll_em_hst_in m_soll_vm_hst_in m_vm_in m_vm_start_in m_wunsch_fpw_in n_ab_egs_in n_em_in n_soll_ll_vm_in n_vm_in sollgang_egs_in status_iae_in status_k0_in z_ablauf_has_hst_in zielgang_egs_in z_k0_fst_in m_mot_in status_kraftfluss_egs_in n_mot_soll_iae_in gangwechsel_egs_in kolbenpos_k0_in status_ll_vm_in m_min_dyn_em_in schalt_mode_egs_in status_k0_befuellung_in c_vm_in abstellpos_vm_in abstellpos_vm_status_in status_nreg_em_hst_in m_min_vm_in m_soll_vm_l_hst_in m_wunsch_fpw_hst_in /end LOC_MEASUREMENT
 /begin SUB_FUNCTION SFOp_SLST438_modifizierte_EM_Drehzahl_bestimmen SFOp_SLST435_Bestimmung_VM_Solldrehzahl SFOp_SLST426_Initialisierung SFOp_SLST384_Bitwise_AND_ui8_ SFOp_SLST385_Bitwise_AND_ui8_ SFOp_SLST386_Bitwise_AND_ui8_ SFOp_SLST382_Bitwise_AND_ui8_ SFOp_SLST374_Initialisierung SFOp_SLST425_Initialisierung Run_SFOp_SLST436_CL_PT1_14nsollvm /end SUB_FUNCTION
/end FUNCTION
/begin FUNCTION SFOp_SLST374_Initialisierung "" /begin DEF_CHARACTERISTIC SWI_ZPHYSK0_SYN_ANS /end DEF_CHARACTERISTIC /end FUNCTION
/begin FUNCTION SFOp_SLST382_Bitwise_AND_ui8_ "" /begin DEF_CHARACTERISTIC SWI_K0SREGBASIS_SYN_ANS /end DEF_CHARACTERISTIC /end FUNCTION
/begin FUNCTION SFOp_SLST384_Bitwise_AND_ui8_ "" /begin DEF_CHARACTERISTIC SWI_K0SREGBASIS_SYN_ANS /end DEF_CHARACTERISTIC /end FUNCTION
/begin FUNCTION SFOp_SLST385_Bitwise_AND_ui8_ "" /begin DEF_CHARACTERISTIC SWI_K0SREGBASIS_SYN_ANS /end DEF_CHARACTERISTIC /end FUNCTION
/begin FUNCTION SFOp_SLST386_Bitwise_AND_ui8_ "" /begin DEF_CHARACTERISTIC SWI_K0SREGBASIS_SYN_ANS /end DEF_CHARACTERISTIC /end FUNCTION
/begin FUNCTION SFOp_SLST4_Conditions ""
 /begin DEF_CHARACTERISTIC KL_MSSOLLK0BED_SYN_ANS_Y KL_MSSOLLK0BED_SYN_ANS_X KL_MZIELK0_SYN_ANS_Y KL_MZIELK0_SYN_ANS_X KL_NDGSK0SYNCERK_SYN_ANS_Y KL_NDGSK0SYNCERK_SYN_ANS_X KL_NONEMABLVARBED_KON_ANS_Y KL_NONEMABLVARBED_KON_ANS_X KL_NSMINEMCGETRBED_KON_ANS_Y KL_NSMINEMCGETRBED_KON_ANS_X ND_IAEBED_KON_ANS NDGS_K0SYNCERK_SYN_ANS NGS_VMSYNCERK_SYN_ANS NS_EMMINBED_SYN_ANS MO_K0BED_SCL_ANS MO_VMSOLLK0GESCHLBED_SCL_ANS NS_EMMINBED_SCL_ANS SWI_ZNSOLLEMBED_SCL_ANS NS_NVMCONDBED_SAK_ANS SWI_ABBRUCH_AKTIV_ANS MS_K0BED_ABB_ANS NDS_EMNSOLLLLVMBED_ZND_ANS NDS_VMDREHTBED_ZND_ANS NDS_VMFEHLERBED_ZND_ANS NDS_VMLAEUFTBED_ZND_ANS STATUS_ABLVMDREHT_HST_ZND_ANS STATUS_ABLVMFEHLER_HST_ZND_ANS STATUS_ABLVMLAEUFT_HST_ZND_ANS NDS_K0BED_ZND_ANS NS_EMMINBED_SST_ANS NS_VMDREHT_SST_ANS NS_VMFEHLER_SST_ANS NS_VMLAEUFT_SST_ANS STATUS_ABLVMDREHT_HST_SST_ANS STATUS_ABLVMFEHLER_HST_SST_ANS STATUS_ABLVMLAEUFT_HST_SST_ANS TAB_MOMZIELK0BED_SYN_ANS /end DEF_CHARACTERISTIC
 /begin LOC_MEASUREMENT nd_iae_ans z_k0entkaktiv_ans z_m_max_iae_has_in z_m_max_stiae_has z_nsollvmaktiv_ans z_iae_entkoppelt_ans m_ziel_vm_has_ans n_sec_iae_ist_ans z_ablauf_has_stg i_istgang_egs i_zielgang_egs m_wunsch_fpw_hst_fil mg_wunsch_fpw_hst_in n_sec_iae nd_k0_in ndg_k0_in ng_vm_in status_schaltung_egs_in status_psys_has_sbe status_sync_schaltung_sbe mg_mot_in status_schaltart_svh_has_sbe z_svh_has_sbe n_min_em_has_sbe z_modus_em_hst_in c_getriebe_egs_in istgang_egs_in m_em_in m_iae_in m_k0_in m_max_dyn_em_in m_soll_em_hst_in m_soll_vm_hst_in m_vm_in m_vm_start_in m_wunsch_fpw_in n_ab_egs_in n_em_in n_soll_ll_vm_in n_vm_in sollgang_egs_in status_iae_in status_k0_in z_ablauf_has_hst_in zielgang_egs_in z_k0_fst_in m_mot_in status_kraftfluss_egs_in n_mot_soll_iae_in gangwechsel_egs_in kolbenpos_k0_in status_ll_vm_in m_min_dyn_em_in schalt_mode_egs_in status_k0_befuellung_in c_vm_in abstellpos_vm_in abstellpos_vm_status_in status_nreg_em_hst_in m_min_vm_in m_soll_vm_l_hst_in m_wunsch_fpw_hst_in /end LOC_MEASUREMENT
 /begin SUB_FUNCTION Run_SFOp_SLST23_abs_fl32 /end SUB_FUNCTION
/end FUNCTION
/begin FUNCTION SFOp_SLST425_Initialisierung "" /begin DEF_CHARACTERISTIC STATUS_ABL_SYN_ANS /end DEF_CHARACTERISTIC /end FUNCTION
/begin FUNCTION SFOp_SLST426_Initialisierung ""
 /begin DEF_CHARACTERISTIC KL_KSVH_RESET_SYN_ANS_Y KL_KSVH_RESET_SYN_ANS_X SWI_SAF_SYN_ANS K_SVH_RESET_RESPPARAL_SYN_ANS K_SVH_RESET_RESPTEILPAR_SYN_ANS /end DEF_CHARACTERISTIC
 /begin LOC_MEASUREMENT nd_iae_ans z_k0entkaktiv_ans z_m_max_iae_has_in z_m_max_stiae_has z_nsollvmaktiv_ans z_iae_entkoppelt_ans m_ziel_vm_has_ans n_sec_iae_ist_ans z_ablauf_has_stg i_istgang_egs i_zielgang_egs m_wunsch_fpw_hst_fil mg_wunsch_fpw_hst_in n_sec_iae nd_k0_in ndg_k0_in ng_vm_in status_schaltung_egs_in status_psys_has_sbe status_sync_schaltung_sbe mg_mot_in status_schaltart_svh_has_sbe z_svh_has_sbe n_min_em_has_sbe z_modus_em_hst_in c_getriebe_egs_in istgang_egs_in m_em_in m_iae_in m_k0_in m_max_dyn_em_in m_soll_em_hst_in m_soll_vm_hst_in m_vm_in m_vm_start_in m_wunsch_fpw_in n_ab_egs_in n_em_in n_soll_ll_vm_in n_vm_in sollgang_egs_in status_iae_in status_k0_in z_ablauf_has_hst_in zielgang_egs_in z_k0_fst_in m_mot_in status_kraftfluss_egs_in n_mot_soll_iae_in gangwechsel_egs_in kolbenpos_k0_in status_ll_vm_in m_min_dyn_em_in schalt_mode_egs_in status_k0_befuellung_in c_vm_in abstellpos_vm_in abstellpos_vm_status_in status_nreg_em_hst_in m_min_vm_in m_soll_vm_l_hst_in m_wunsch_fpw_hst_in /end LOC_MEASUREMENT
/end FUNCTION
/begin FUNCTION SFOp_SLST435_Bestimmung_VM_Solldrehzahl ""
 /begin DEF_CHARACTERISTIC KF_NDEMNSOLLVM_ZND_ANS_W KF_NDEMNSOLLVM_ZND_ANS_X KF_NDEMNSOLLVM_ZND_ANS_Y KF_NOEMNSOLLVM_KON_ANS_W KF_NOEMNSOLLVM_KON_ANS_X KF_NOEMNSOLLVM_KON_ANS_Y KL_NDZIELK0K0SREG_SYN_ANS_Y KL_NDZIELK0K0SREG_SYN_ANS_X K_MZIELNOEMNSOLLVM_KON_ANS SWI_NSOLLEMENTKIAE_KON_ANS SWI_NSOLLVMENTKIAE_KON_ANS SWI_ZK0SREGMODUS_SYN_ANS MGS_WUNSCHFPW_SYN_ANS NO_EMNSOLLVMRESPPARALRS_SYN_ANS NO_NVMSOLLNEM_SYN_ANS /end DEF_CHARACTERISTIC
 /begin LOC_MEASUREMENT m_ziel_vm_has_ans /end LOC_MEASUREMENT
/end FUNCTION
/begin FUNCTION SFOp_SLST438_modifizierte_EM_Drehzahl_bestimmen ""
 /begin DEF_CHARACTERISTIC KF_NGEMMODRSMAX_SYN_ANS_W KF_NGEMMODRSMAX_SYN_ANS_X KF_NGEMMODRSMAX_SYN_ANS_Y BM_SCHALTARTNEMMODRS_SYN_ANS NG_EMMODRSMIN_SYN_ANS /end DEF_CHARACTERISTIC
 /begin LOC_MEASUREMENT n_sec_iae_ist_ans init_n_em_mod_syn_ans status_rs_aktiv_syn_ans n_em_mod_basis_syn_ans n_ziel_em_mod_syn_ans n_em_mod_syn_ans n_em_ref_syn_ans nd_sec_iae_syn_ans ng_emmodrsmax_syn_ans status_schaltung_egs_in status_schaltart_svh_has_sbe n_em_in /end LOC_MEASUREMENT
 /begin SUB_FUNCTION Run_SFOp_SLST449_cLimiter_Gradient_NEMmod SFOp_SLST450_Bitwise_AND_ui8_ /end SUB_FUNCTION
/end FUNCTION
/begin FUNCTION SFOp_SLST45_Ablauf_in_Fahrzustaenden_mit_schlupfenden_Antriebsraedern "" /begin DEF_CHARACTERISTIC SWI_SYNCDDA_ANS /end DEF_CHARACTERISTIC /begin LOC_MEASUREMENT z_syncdda_ans status_radschlupf_rse_has_sbe /end LOC_MEASUREMENT /end FUNCTION
/begin FUNCTION SFOp_SLST450_Bitwise_AND_ui8_ "" /begin DEF_CHARACTERISTIC BM_SCHALTARTNEMMODRS_SYN_ANS /end DEF_CHARACTERISTIC /end FUNCTION
/begin FUNCTION SFOp_SLST457_st_konditionieren_ans ""
 /begin DEF_CHARACTERISTIC KF_NOEMNSOLLVM_KON_ANS_W KF_NOEMNSOLLVM_KON_ANS_X KF_NOEMNSOLLVM_KON_ANS_Y KF_MMOT_RESPPAR_SCHUB_KON_ANS_W KF_MMOT_RESPPAR_SCHUB_KON_ANS_X KF_MMOT_RESPPAR_SCHUB_KON_ANS_Y KL_MWUNSCH_RESPPAR_SCHUB_KON_ANS_Y KL_MWUNSCH_RESPPAR_SCHUB_KON_ANS_X KF_FNDSOLLIAE_KON_ANS_W KF_FNDSOLLIAE_KON_ANS_X KF_FNDSOLLIAE_KON_ANS_Y KL_NDIAEEMMAXIAE_KON_ANS_Y KL_NDIAEEMMAXIAE_KON_ANS_X KF_MRESEMANFIAE_KON_ANS_W KF_MRESEMANFIAE_KON_ANS_X KF_MRESEMANFIAE_KON_ANS_Y KF_MGZIELMAXEM_KON_ANS_W KF_MGZIELMAXEM_KON_ANS_X KF_MGZIELMAXEM_KON_ANS_Y KF_MGZIELMINEM_KON_ANS_W KF_MGZIELMINEM_KON_ANS_X KF_MGZIELMINEM_KON_ANS_Y KF_MZIELMAXEM_KON_ANS_W KF_MZIELMAXEM_KON_ANS_X KF_MZIELMAXEM_KON_ANS_Y KF_MZIELMINEM_KON_ANS_W KF_MZIELMINEM_KON_ANS_X KF_MZIELMINEM_KON_ANS_Y STATUS_ABL_ZIAEENTK_HST_KON_ANS MS_ZMSOLLEMAKTIV_KON_ANS F_NDSOLLIAESTAT_KON_ANS MO_MEM_KON_ANS MS_MMAXIAEINAKTIV_ANS SWI_MK0MOD_HAS_ANS K_MZIELNOEMNSOLLVM_KON_ANS K_NOEMNSOLLVMOKS_KON_ANS NO_EMNSOLLVMRESPPARALRS_KON_ANS N_MINEMNSOLLVM_KON_ANS SWI_NSOLLEMENTKIAE_KON_ANS SWI_NSOLLVMENTKIAE_KON_ANS K_MSTOERKPL_KON_ANS MS_RESEM_KON_ANS STATUS_K0ZMSOLLEMAKTIV_KON_ANS SWI_MSTOERK0EMFILMK0_KON_ANS SWI_MSTOERK0EMMK0_KON_ANS SWI_ZMSOLLEM_KON_ANS SWI_ZNSOLLEM_KON_ANS MG_MOMAXIAE1_KON_ANS MG_MOMAXIAE2_KON_ANS MS_MOTIAEANFERK_KON_ANS MS_WUNSCHIAEANFERK_KON_ANS ND_IAEANFAHRENTK_ANS NS_EMIAEANFAHRENTK_ANS T_WAITSCHLUPFMAX_KON_ANS SWI_ZANFIAEVERRAKTIV_KON_ANS T_SCHLSCHALTMAX_KON_ANS SWI_ZK0BEFIAE_AKTIV_ANS T_MAXZK0ENTKIAE_KON_ANS KOLBENPOSK0_KON_ANS STATUS_ABL_KOLBENPOSK0_KON_ANS STATUS_ABL_KON_ANS STATUS_ABL_ZNSOLLEM_KON_ANS SWI_UMSCHSTATUSABL_KON_ANS SWI_SAS_ANS T_RESPMAX_SAS_KON_ANS T_MAX_KON_ANS FK_NSOLLVM_KON_ANS /end DEF_CHARACTERISTIC
 /begin LOC_MEASUREMENT nd_iae_ans z_k0entkaktiv_ans z_m_max_iae_has_in z_m_max_stiae_has z_nsollvmaktiv_ans z_iae_entkoppelt_ans m_ziel_vm_has_ans n_sec_iae_ist_ans t_waitschlupf_kon_ans t_schlschalt_kon_ans t_maxentkiae_kon_ans t_resp_sas_kon_ans t_maxbed_kon_ans z_ablauf_has_stg i_istgang_egs i_zielgang_egs m_wunsch_fpw_hst_fil mg_wunsch_fpw_hst_in n_sec_iae nd_k0_in ndg_k0_in ng_vm_in status_schaltung_egs_in status_psys_has_sbe status_sync_schaltung_sbe mg_mot_in status_schaltart_svh_has_sbe z_svh_has_sbe n_min_em_has_sbe z_modus_em_hst_in c_getriebe_egs_in istgang_egs_in m_em_in m_iae_in m_k0_in m_max_dyn_em_in m_soll_em_hst_in m_soll_vm_hst_in m_vm_in m_vm_start_in m_wunsch_fpw_in n_ab_egs_in n_em_in n_soll_ll_vm_in n_vm_in sollgang_egs_in status_iae_in status_k0_in z_ablauf_has_hst_in zielgang_egs_in z_k0_fst_in m_mot_in status_kraftfluss_egs_in n_mot_soll_iae_in gangwechsel_egs_in kolbenpos_k0_in status_ll_vm_in m_min_dyn_em_in schalt_mode_egs_in status_k0_befuellung_in c_vm_in abstellpos_vm_in abstellpos_vm_status_in status_nreg_em_hst_in m_min_vm_in m_soll_vm_l_hst_in m_wunsch_fpw_hst_in /end LOC_MEASUREMENT
 /begin SUB_FUNCTION SFOp_SLST545_Initialisierung SFOp_SLST505_Vorgaben_LP3 SFOp_SLST556_Initialisierung Run_SFOp_SLST487_abs_fl32 SFOp_SLST501_Initialisierung Run_SFOp_SLST558_CL_PT1_14nsollvm /end SUB_FUNCTION
/end FUNCTION
/begin FUNCTION SFOp_SLST47_Ber_Reservemoment ""
 /begin DEF_CHARACTERISTIC STATUS_ABLVMDREHT_HST_ZND_ANS NS_VMDREHT_SST_ANS NS_VMLAEUFT_SST_ANS STATUS_ABLVMDREHT_HST_SST_ANS NS_VMMRESAUS_ANS /end DEF_CHARACTERISTIC
 /begin LOC_MEASUREMENT msollresem_stat_mes m_soll_res_em_bas_sbe n_vm_in z_ablauf_has_hst_in /end LOC_MEASUREMENT
 /begin SUB_FUNCTION SFOp_SLST62_Triggered_Subsystem /end SUB_FUNCTION
/end FUNCTION
/begin FUNCTION SFOp_SLST48_Berechnung_Sollflag_nem "" /begin DEF_CHARACTERISTIC NDS_ZNSOLLEM_INAKTIV_ANS SWI_UMSCH_NDIAENEM_ANS /end DEF_CHARACTERISTIC /begin LOC_MEASUREMENT z_n_soll_em_aktiv_ans nd_iae_ans n_em_in /end LOC_MEASUREMENT /end FUNCTION
/begin FUNCTION SFOp_SLST49_Berechnung_Stoermoment ""
 /begin DEF_CHARACTERISTIC KF_FFKMSTOERKPL_ANS_W KF_FFKMSTOERKPL_ANS_X KF_FFKMSTOERKPL_ANS_Y KF_FKMSTOERKPL_ANS_W KF_FKMSTOERKPL_ANS_X KF_FKMSTOERKPL_ANS_Y KF_FMOSTOERKPLSCHALT_ANS_W KF_FMOSTOERKPLSCHALT_ANS_X KF_FMOSTOERKPLSCHALT_ANS_Y KF_FMOSTOERKPL_ANS_W KF_FMOSTOERKPL_ANS_X KF_FMOSTOERKPL_ANS_Y KF_MOSTOERKPLSCHALT_ANS_W KF_MOSTOERKPLSCHALT_ANS_X KF_MOSTOERKPLSCHALT_ANS_Y KF_MOSTOERKPL_ANS_W KF_MOSTOERKPL_ANS_X KF_MOSTOERKPL_ANS_Y KF_MO_K0BEFUELL_NORM_CGET_ANS_W KF_MO_K0BEFUELL_NORM_CGET_ANS_X KF_MO_K0BEFUELL_NORM_CGET_ANS_Y KF_MO_K0BEFUELL_OPT_CGET_ANS_W KF_MO_K0BEFUELL_OPT_CGET_ANS_X KF_MO_K0BEFUELL_OPT_CGET_ANS_Y KF_MO_K0BEFUELL_RED_CGET_ANS_W KF_MO_K0BEFUELL_RED_CGET_ANS_X KF_MO_K0BEFUELL_RED_CGET_ANS_Y KL_TFC_K0_ANS_Y KL_TFC_K0_ANS_X KL_TFC_K0_OPT_ANS_Y KL_TFC_K0_OPT_ANS_X KL_TFC_K0_RED_ANS_Y KL_TFC_K0_RED_ANS_X KF_FMSTOERKPL_ANS_W KF_FMSTOERKPL_ANS_X KF_FMSTOERKPL_ANS_Y KF_KOLBPOSINITTIMER_ANS_W KF_KOLBPOSINITTIMER_ANS_X KF_KOLBPOSINITTIMER_ANS_Y KF_KOLBPOSINIT_RESP_SCHALT_ANS_W KF_KOLBPOSINIT_RESP_SCHALT_ANS_X KF_KOLBPOSINIT_RESP_SCHALT_ANS_Y KF_TVMSTOERK0EMFIL_ANS_W KF_TVMSTOERK0EMFIL_ANS_X KF_TVMSTOERK0EMFIL_ANS_Y KF_TVMSTOERK0EMFIL_RESP_SCHALT_ANS_W KF_TVMSTOERK0EMFIL_RESP_SCHALT_ANS_X KF_TVMSTOERK0EMFIL_RESP_SCHALT_ANS_Y SWI_UMSCHMSOLLK0MMOT_ANS SWI_UMSCHMSTOERK0MMOT_ANS /end DEF_CHARACTERISTIC
 /begin LOC_MEASUREMENT t_mstoerk0emfil_ans f_mstoerk0befuell_ans t_fak0normiert_ans t_fuellausk0_ans t_zielfuellausgleichk0_ans mo_k0befuell_ans mo_stoer_k0_mmotschalt_ans mo_stoerkplresschl_ans m_stoer_k0_em_fil_ans i_istgang_egs i_zielgang_egs nd_k0_in c_getriebe_egs_in n_ab_egs_in n_em_in m_mot_in kolbenpos_k0_in status_k0_befuellung_in m_wunsch_fpw_hst_in /end LOC_MEASUREMENT
/end FUNCTION
/begin FUNCTION SFOp_SLST50_Berechnung_nd_iae_ans "" /begin LOC_MEASUREMENT nd_iae_ans n_sec_iae n_em_in /end LOC_MEASUREMENT /end FUNCTION
/begin FUNCTION SFOp_SLST501_Initialisierung "" /begin DEF_CHARACTERISTIC SWI_ZPHYSK0_KON_ANS /end DEF_CHARACTERISTIC /end FUNCTION
/begin RECORD_LAYOUT FLOAT32_IEEE_COL_DIRECT_M_S7_S3 FNC_VALUES 1 FLOAT32_IEEE COLUMN_DIR DIRECT /end RECORD_LAYOUT
/begin RECORD_LAYOUT FLOAT32_IEEE_X_INCR_DIRECT_M_S7_S3 AXIS_PTS_X 1 FLOAT32_IEEE INDEX_INCR DIRECT /end RECORD_LAYOUT
/begin RECORD_LAYOUT SBYTE_X_INCR_DIRECT_M_S7_S3 AXIS_PTS_X 1 SBYTE INDEX_INCR DIRECT /end RECORD_LAYOUT
/begin RECORD_LAYOUT UBYTE_COL_DIRECT_M_S7_S3 FNC_VALUES 1 UBYTE COLUMN_DIR DIRECT /end RECORD_LAYOUT
/begin RECORD_LAYOUT UBYTE_X_INCR_DIRECT_M_S7_S3 AXIS_PTS_X 1 UBYTE INDEX_INCR DIRECT /end RECORD_LAYOUT
/begin RECORD_LAYOUT UWORD_COL_DIRECT_M_S7_S3 FNC_VALUES 1 UWORD COLUMN_DIR DIRECT /end RECORD_LAYOUT
/end MODULE
/end PROJECT
