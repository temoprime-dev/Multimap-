ASAP2_VERSION 1 51
/begin PROJECT _929_929 "Gen2_BMW_System_Supplier_Lib"
/begin HEADER "" VERSION "C_03_03" PROJECT_NO _929_929 /end HEADER
/begin MODULE DIM ""
/begin MOD_COMMON "" BYTE_ORDER MSB_FIRST ALIGNMENT_BYTE 1 ALIGNMENT_WORD 2 ALIGNMENT_LONG 4 ALIGNMENT_FLOAT32_IEEE 4 /end MOD_COMMON
/begin CHARACTERISTIC T_VGLSKZU_7 "Verzoegerungszeit GLS-Beginn Gangeinlegen" VALUE 0x26E6B6 kw_ui8_S6_S3 2540 UMR_MSEC__10_1_0_S6_S3 0 2540 /end CHARACTERISTIC
/begin CHARACTERISTIC KL_MPT_WNGTGLS_INIT_7 "Filterkonstante Sollgradient PT1-Filter" CURVE 0x238AE0 kl_si16_S6_S3 0.99 UMR___1_100_0_S6_S3 0.01 1
 /begin AXIS_DESCR STD_AXIS NO_INPUT_QUANTITY UMR_U_MINSEC_10000_32767_0_S6_S3 3 -9765.92303232 9765.92303232 DEPOSIT ABSOLUTE MONOTONY MON_INCREASE /end AXIS_DESCR
/end CHARACTERISTIC
/begin CHARACTERISTIC KL_KPGLSKZUCG_7 "Proportionalfaktor PID-Regler GLS Gangeinlegen" CURVE 0x238AF0 kl_ui16_S6_S3 10000 UMR_MBARMINSEC__1_1_0_S6_S3 0 10000
 /begin AXIS_DESCR STD_AXIS iSasZentr.c_getr_sas UMR_GRADC__1_1_M40_S6_S3 4 -40 150 DEPOSIT ABSOLUTE MONOTONY MON_INCREASE /end AXIS_DESCR
/end CHARACTERISTIC
/begin CHARACTERISTIC KL_KIGLSKZUCG_7 "Integralfaktor PID-Regler GLS Gangeinlegen" CURVE 0x238B04 kl_ui16_S6_S3 10000 UMR_MBARMINSEC__1_1_0_S6_S3 0 10000
 /begin AXIS_DESCR STD_AXIS iSasZentr.c_getr_sas UMR_GRADC__1_1_M40_S6_S3 4 -40 150 DEPOSIT ABSOLUTE MONOTONY MON_INCREASE /end AXIS_DESCR
/end CHARACTERISTIC
/begin CHARACTERISTIC KF_WNGTNDSYNCGGE_7 "Sollturbinengradient geregeltes Gangeinlegen" MAP 0x238B18 kf_si16_S6_S3 20000 UMR_U_MINSEC_1_1_0_S6_S3 -10000 10000
 /begin AXIS_DESCR STD_AXIS NO_INPUT_QUANTITY UMR_U_MIN_1_1_0_S6_S3 6 -8160 8160 DEPOSIT ABSOLUTE MONOTONY MON_INCREASE /end AXIS_DESCR
 /begin AXIS_DESCR STD_AXIS iSasZentr.c_getr_sas UMR_GRADC__1_1_M40_S6_S3 4 -40 150 DEPOSIT ABSOLUTE MONOTONY MON_INCREASE /end AXIS_DESCR
/end CHARACTERISTIC
/begin CHARACTERISTIC ND_GLSGE_7 "Drehzahlkriterium Start Regelung Gangeinlegen" VALUE 0x26DA08 kw_ui16_S6_S3 8000 UMR_U_MIN_1_1_0_S6_S3 0 8000 /end CHARACTERISTIC
/begin CHARACTERISTIC T_VGLSKZU_8 "Verzoegerungszeit GLS-Beginn Gangeinlegen" VALUE 0x26E6B7 kw_ui8_S6_S3 2540 UMR_MSEC__10_1_0_S6_S3 0 2540 /end CHARACTERISTIC
/begin CHARACTERISTIC KL_MPT_WNGTGLS_INIT_8 "Filterkonstante Sollgradient PT1-Filter" CURVE 0x238B64 kl_si16_S6_S3 0.99 UMR___1_100_0_S6_S3 0.01 1
 /begin AXIS_DESCR STD_AXIS NO_INPUT_QUANTITY UMR_U_MINSEC_10000_32767_0_S6_S3 3 -9765.92303232 9765.92303232 DEPOSIT ABSOLUTE MONOTONY MON_INCREASE /end AXIS_DESCR
/end CHARACTERISTIC
/begin CHARACTERISTIC KL_KPGLSKZUCG_8 "Proportionalfaktor PID-Regler GLS Gangeinlegen" CURVE 0x238B74 kl_ui16_S6_S3 10000 UMR_MBARMINSEC__1_1_0_S6_S3 0 10000
 /begin AXIS_DESCR STD_AXIS iSasZentr.c_getr_sas UMR_GRADC__1_1_M40_S6_S3 4 -40 150 DEPOSIT ABSOLUTE MONOTONY MON_INCREASE /end AXIS_DESCR
/end CHARACTERISTIC
/begin CHARACTERISTIC KL_KIGLSKZUCG_8 "Integralfaktor PID-Regler GLS Gangeinlegen" CURVE 0x238B88 kl_ui16_S6_S3 10000 UMR_MBARMINSEC__1_1_0_S6_S3 0 10000
 /begin AXIS_DESCR STD_AXIS iSasZentr.c_getr_sas UMR_GRADC__1_1_M40_S6_S3 4 -40 150 DEPOSIT ABSOLUTE MONOTONY MON_INCREASE /end AXIS_DESCR
/end CHARACTERISTIC
/begin CHARACTERISTIC KF_WNGTNDSYNCGGE_8 "Sollturbinengradient geregeltes Gangeinlegen" MAP 0x238B9C kf_si16_S6_S3 20000 UMR_U_MINSEC_1_1_0_S6_S3 -10000 10000
 /begin AXIS_DESCR STD_AXIS NO_INPUT_QUANTITY UMR_U_MIN_1_1_0_S6_S3 6 -8160 8160 DEPOSIT ABSOLUTE MONOTONY MON_INCREASE /end AXIS_DESCR
 /begin AXIS_DESCR STD_AXIS iSasZentr.c_getr_sas UMR_GRADC__1_1_M40_S6_S3 4 -40 150 DEPOSIT ABSOLUTE MONOTONY MON_INCREASE /end AXIS_DESCR
/end CHARACTERISTIC
/begin CHARACTERISTIC ND_GLSGE_8 "Drehzahlkriterium Start Regelung Gangeinlegen" VALUE 0x26DA0A kw_ui16_S6_S3 8000 UMR_U_MIN_1_1_0_S6_S3 0 8000 /end CHARACTERISTIC
/begin CHARACTERISTIC KL_TVGLSKZUCG12 "Verzoegerungszeit GLS-Beginn" CURVE 0x238BE8 kl_ui8_S6_S3 2540 UMR_MSEC__10_1_0_S6_S3 0 2540
 /begin AXIS_DESCR STD_AXIS zff_atsys._.iSignale._.obj.sig_c_getr UMR_GRADC__1_1_M40_S6_S3 3 -40 150 DEPOSIT ABSOLUTE MONOTONY MON_INCREASE /end AXIS_DESCR
/end CHARACTERISTIC
/begin CHARACTERISTIC KL_TVGLSKZUCG12_EL "Verzoegerungszeit GLS-Beginn" CURVE 0x238BF4 kl_ui8_S6_S3 2540 UMR_MSEC__10_1_0_S6_S3 0 2540
 /begin AXIS_DESCR STD_AXIS zff_atsys._.iSignale._.obj.sig_c_getr UMR_GRADC__1_1_M40_S6_S3 3 -40 150 DEPOSIT ABSOLUTE MONOTONY MON_INCREASE /end AXIS_DESCR
/end CHARACTERISTIC
/begin CHARACTERISTIC KF_WTSGLS12 "Sollschleifzeit GLS" MAP 0x238C00 kf_ui8_S6_S3 2550 UMR_MSEC__10_1_0_S6_S3 0 2550
 /begin AXIS_DESCR STD_AXIS zff_atsys._.iSignale._.obj.sig_n_t8 UMR_U_MIN_32_1_0_S6_S3 4 0 8160 DEPOSIT ABSOLUTE MONOTONY MON_INCREASE /end AXIS_DESCR
 /begin AXIS_DESCR STD_AXIS zff_atsys._.iSignale._.obj.sig_m_t8 UMR_NM__8_1_M50_S6_S3 6 -400 1640 DEPOSIT ABSOLUTE MONOTONY MON_INCREASE /end AXIS_DESCR
/end CHARACTERISTIC
/begin CHARACTERISTIC KF_WTSGLS12_EL "Sollschleifzeit GLS" MAP 0x238C2C kf_ui8_S6_S3 2550 UMR_MSEC__10_1_0_S6_S3 0 2550
 /begin AXIS_DESCR STD_AXIS zff_atsys._.iSignale._.obj.sig_n_t8 UMR_U_MIN_32_1_0_S6_S3 4 0 8160 DEPOSIT ABSOLUTE MONOTONY MON_INCREASE /end AXIS_DESCR
 /begin AXIS_DESCR STD_AXIS zff_atsys._.iSignale._.obj.sig_m_t8 UMR_NM__8_1_M50_S6_S3 6 -400 1640 DEPOSIT ABSOLUTE MONOTONY MON_INCREASE /end AXIS_DESCR
/end CHARACTERISTIC
/begin CHARACTERISTIC KL_FMENACHGLSENDE12 "Faktor der Nach-ME-Rampe HS fuer Start Filterung GLS" CURVE 0x238C58 kl_ui8_S6_S3 1 UMR___1_100_0_S6_S3 0 1
 /begin AXIS_DESCR STD_AXIS zff_atsys._.iSignale._.obj.sig_m_t8 UMR_NM__8_1_M50_S6_S3 4 -400 1640 DEPOSIT ABSOLUTE MONOTONY MON_INCREASE /end AXIS_DESCR
/end CHARACTERISTIC
/begin CHARACTERISTIC KL_TVGLSKZUCG23 "Verzoegerungszeit GLS-Beginn" CURVE 0x238C64 kl_ui8_S6_S3 2540 UMR_MSEC__10_1_0_S6_S3 0 2540
 /begin AXIS_DESCR STD_AXIS zff_atsys._.iSignale._.obj.sig_c_getr UMR_GRADC__1_1_M40_S6_S3 3 -40 150 DEPOSIT ABSOLUTE MONOTONY MON_INCREASE /end AXIS_DESCR
/end CHARACTERISTIC
/begin CHARACTERISTIC KL_TVGLSKZUCG23_EL "Verzoegerungszeit GLS-Beginn" CURVE 0x238C70 kl_ui8_S6_S3 2540 UMR_MSEC__10_1_0_S6_S3 0 2540
 /begin AXIS_DESCR STD_AXIS zff_atsys._.iSignale._.obj.sig_c_getr UMR_GRADC__1_1_M40_S6_S3 3 -40 150 DEPOSIT ABSOLUTE MONOTONY MON_INCREASE /end AXIS_DESCR
/end CHARACTERISTIC
/begin CHARACTERISTIC KF_WTSGLS23 "Sollschleifzeit GLS" MAP 0x238C7C kf_ui8_S6_S3 2550 UMR_MSEC__10_1_0_S6_S3 0 2550
 /begin AXIS_DESCR STD_AXIS zff_atsys._.iSignale._.obj.sig_n_t8 UMR_U_MIN_32_1_0_S6_S3 4 0 8160 DEPOSIT ABSOLUTE MONOTONY MON_INCREASE /end AXIS_DESCR
 /begin AXIS_DESCR STD_AXIS zff_atsys._.iSignale._.obj.sig_m_t8 UMR_NM__8_1_M50_S6_S3 6 -400 1640 DEPOSIT ABSOLUTE MONOTONY MON_INCREASE /end AXIS_DESCR
/end CHARACTERISTIC
/begin CHARACTERISTIC KF_WTSGLS23_EL "Sollschleifzeit GLS" MAP 0x238CA8 kf_ui8_S6_S3 2550 UMR_MSEC__10_1_0_S6_S3 0 2550
 /begin AXIS_DESCR STD_AXIS zff_atsys._.iSignale._.obj.sig_n_t8 UMR_U_MIN_32_1_0_S6_S3 4 0 8160 DEPOSIT ABSOLUTE MONOTONY MON_INCREASE /end AXIS_DESCR
 /begin AXIS_DESCR STD_AXIS zff_atsys._.iSignale._.obj.sig_m_t8 UMR_NM__8_1_M50_S6_S3 6 -400 1640 DEPOSIT ABSOLUTE MONOTONY MON_INCREASE /end AXIS_DESCR
/end CHARACTERISTIC
/begin CHARACTERISTIC KL_FMENACHGLSENDE23 "Faktor der Nach-ME-Rampe HS fuer Start Filterung GLS" CURVE 0x238CD4 kl_ui8_S6_S3 1 UMR___1_100_0_S6_S3 0 1
 /begin AXIS_DESCR STD_AXIS zff_atsys._.iSignale._.obj.sig_m_t8 UMR_NM__8_1_M50_S6_S3 4 -400 1640 DEPOSIT ABSOLUTE MONOTONY MON_INCREASE /end AXIS_DESCR
/end CHARACTERISTIC
/begin CHARACTERISTIC KL_TVGLSKZUCG34 "Verzoegerungszeit GLS-Beginn" CURVE 0x238CE0 kl_ui8_S6_S3 2540 UMR_MSEC__10_1_0_S6_S3 0 2540
 /begin AXIS_DESCR STD_AXIS zff_atsys._.iSignale._.obj.sig_c_getr UMR_GRADC__1_1_M40_S6_S3 3 -40 150 DEPOSIT ABSOLUTE MONOTONY MON_INCREASE /end AXIS_DESCR
/end CHARACTERISTIC
/begin CHARACTERISTIC KL_TVGLSKZUCG34_EL "Verzoegerungszeit GLS-Beginn" CURVE 0x238CEC kl_ui8_S6_S3 2540 UMR_MSEC__10_1_0_S6_S3 0 2540
 /begin AXIS_DESCR STD_AXIS zff_atsys._.iSignale._.obj.sig_c_getr UMR_GRADC__1_1_M40_S6_S3 3 -40 150 DEPOSIT ABSOLUTE MONOTONY MON_INCREASE /end AXIS_DESCR
/end CHARACTERISTIC
/begin CHARACTERISTIC KF_WTSGLS34 "Sollschleifzeit GLS" MAP 0x238CF8 kf_ui8_S6_S3 2550 UMR_MSEC__10_1_0_S6_S3 0 2550
 /begin AXIS_DESCR STD_AXIS zff_atsys._.iSignale._.obj.sig_n_t8 UMR_U_MIN_32_1_0_S6_S3 4 0 8160 DEPOSIT ABSOLUTE MONOTONY MON_INCREASE /end AXIS_DESCR
 /begin AXIS_DESCR STD_AXIS zff_atsys._.iSignale._.obj.sig_m_t8 UMR_NM__8_1_M50_S6_S3 6 -400 1640 DEPOSIT ABSOLUTE MONOTONY MON_INCREASE /end AXIS_DESCR
/end CHARACTERISTIC
/begin CHARACTERISTIC KF_WTSGLS34_EL "Sollschleifzeit GLS" MAP 0x238D24 kf_ui8_S6_S3 2550 UMR_MSEC__10_1_0_S6_S3 0 2550
 /begin AXIS_DESCR STD_AXIS zff_atsys._.iSignale._.obj.sig_n_t8 UMR_U_MIN_32_1_0_S6_S3 4 0 8160 DEPOSIT ABSOLUTE MONOTONY MON_INCREASE /end AXIS_DESCR
 /begin AXIS_DESCR STD_AXIS zff_atsys._.iSignale._.obj.sig_m_t8 UMR_NM__8_1_M50_S6_S3 6 -400 1640 DEPOSIT ABSOLUTE MONOTONY MON_INCREASE /end AXIS_DESCR
/end CHARACTERISTIC
/begin CHARACTERISTIC KL_FMENACHGLSENDE34 "Faktor der Nach-ME-Rampe HS fuer Start Filterung GLS" CURVE 0x238D50 kl_ui8_S6_S3 1 UMR___1_100_0_S6_S3 0 1
 /begin AXIS_DESCR STD_AXIS zff_atsys._.iSignale._.obj.sig_m_t8 UMR_NM__8_1_M50_S6_S3 4 -400 1640 DEPOSIT ABSOLUTE MONOTONY MON_INCREASE /end AXIS_DESCR
/end CHARACTERISTIC
/begin CHARACTERISTIC KL_TVGLSKZUCG45 "Verzoegerungszeit GLS-Beginn" CURVE 0x238D5C kl_ui8_S6_S3 2540 UMR_MSEC__10_1_0_S6_S3 0 2540
 /begin AXIS_DESCR STD_AXIS zff_atsys._.iSignale._.obj.sig_c_getr UMR_GRADC__1_1_M40_S6_S3 3 -40 150 DEPOSIT ABSOLUTE MONOTONY MON_INCREASE /end AXIS_DESCR
/end CHARACTERISTIC
/begin CHARACTERISTIC KL_TVGLSKZUCG45_EL "Verzoegerungszeit GLS-Beginn" CURVE 0x238D68 kl_ui8_S6_S3 2540 UMR_MSEC__10_1_0_S6_S3 0 2540
 /begin AXIS_DESCR STD_AXIS zff_atsys._.iSignale._.obj.sig_c_getr UMR_GRADC__1_1_M40_S6_S3 3 -40 150 DEPOSIT ABSOLUTE MONOTONY MON_INCREASE /end AXIS_DESCR
/end CHARACTERISTIC
/begin CHARACTERISTIC KF_WTSGLS45 "Sollschleifzeit GLS" MAP 0x238D74 kf_ui8_S6_S3 2550 UMR_MSEC__10_1_0_S6_S3 0 2550
 /begin AXIS_DESCR STD_AXIS zff_atsys._.iSignale._.obj.sig_n_t8 UMR_U_MIN_32_1_0_S6_S3 4 0 8160 DEPOSIT ABSOLUTE MONOTONY MON_INCREASE /end AXIS_DESCR
 /begin AXIS_DESCR STD_AXIS zff_atsys._.iSignale._.obj.sig_m_t8 UMR_NM__8_1_M50_S6_S3 6 -400 1640 DEPOSIT ABSOLUTE MONOTONY MON_INCREASE /end AXIS_DESCR
/end CHARACTERISTIC
/begin CHARACTERISTIC KF_WTSGLS45_EL "Sollschleifzeit GLS" MAP 0x238DA0 kf_ui8_S6_S3 2550 UMR_MSEC__10_1_0_S6_S3 0 2550
 /begin AXIS_DESCR STD_AXIS zff_atsys._.iSignale._.obj.sig_n_t8 UMR_U_MIN_32_1_0_S6_S3 4 0 8160 DEPOSIT ABSOLUTE MONOTONY MON_INCREASE /end AXIS_DESCR
 /begin AXIS_DESCR STD_AXIS zff_atsys._.iSignale._.obj.sig_m_t8 UMR_NM__8_1_M50_S6_S3 6 -400 1640 DEPOSIT ABSOLUTE MONOTONY MON_INCREASE /end AXIS_DESCR
/end CHARACTERISTIC
/begin CHARACTERISTIC KL_FMENACHGLSENDE45 "Faktor der Nach-ME-Rampe HS fuer Start Filterung GLS" CURVE 0x238DCC kl_ui8_S6_S3 1 UMR___1_100_0_S6_S3 0 1
 /begin AXIS_DESCR STD_AXIS zff_atsys._.iSignale._.obj.sig_m_t8 UMR_NM__8_1_M50_S6_S3 4 -400 1640 DEPOSIT ABSOLUTE MONOTONY MON_INCREASE /end AXIS_DESCR
/end CHARACTERISTIC
/begin CHARACTERISTIC KL_TVGLSKZUCG56 "Verzoegerungszeit GLS-Beginn" CURVE 0x238DD8 kl_ui8_S6_S3 2540 UMR_MSEC__10_1_0_S6_S3 0 2540
 /begin AXIS_DESCR STD_AXIS zff_atsys._.iSignale._.obj.sig_c_getr UMR_GRADC__1_1_M40_S6_S3 3 -40 150 DEPOSIT ABSOLUTE MONOTONY MON_INCREASE /end AXIS_DESCR
/end CHARACTERISTIC
/begin CHARACTERISTIC KL_TVGLSKZUCG56_EL "Verzoegerungszeit GLS-Beginn" CURVE 0x238DE4 kl_ui8_S6_S3 2540 UMR_MSEC__10_1_0_S6_S3 0 2540
 /begin AXIS_DESCR STD_AXIS zff_atsys._.iSignale._.obj.sig_c_getr UMR_GRADC__1_1_M40_S6_S3 3 -40 150 DEPOSIT ABSOLUTE MONOTONY MON_INCREASE /end AXIS_DESCR
/end CHARACTERISTIC
/begin CHARACTERISTIC KF_WTSGLS56 "Sollschleifzeit GLS" MAP 0x238DF0 kf_ui8_S6_S3 2550 UMR_MSEC__10_1_0_S6_S3 0 2550
 /begin AXIS_DESCR STD_AXIS zff_atsys._.iSignale._.obj.sig_n_t8 UMR_U_MIN_32_1_0_S6_S3 4 0 8160 DEPOSIT ABSOLUTE MONOTONY MON_INCREASE /end AXIS_DESCR
 /begin AXIS_DESCR STD_AXIS zff_atsys._.iSignale._.obj.sig_m_t8 UMR_NM__8_1_M50_S6_S3 6 -400 1640 DEPOSIT ABSOLUTE MONOTONY MON_INCREASE /end AXIS_DESCR
/end CHARACTERISTIC
/begin CHARACTERISTIC KF_WTSGLS56_EL "Sollschleifzeit GLS" MAP 0x238E1C kf_ui8_S6_S3 2550 UMR_MSEC__10_1_0_S6_S3 0 2550
 /begin AXIS_DESCR STD_AXIS zff_atsys._.iSignale._.obj.sig_n_t8 UMR_U_MIN_32_1_0_S6_S3 4 0 8160 DEPOSIT ABSOLUTE MONOTONY MON_INCREASE /end AXIS_DESCR
 /begin AXIS_DESCR STD_AXIS zff_atsys._.iSignale._.obj.sig_m_t8 UMR_NM__8_1_M50_S6_S3 6 -400 1640 DEPOSIT ABSOLUTE MONOTONY MON_INCREASE /end AXIS_DESCR
/end CHARACTERISTIC
/begin CHARACTERISTIC KL_FMENACHGLSENDE56 "Faktor der Nach-ME-Rampe HS fuer Start Filterung GLS" CURVE 0x238E48 kl_ui8_S6_S3 1 UMR___1_100_0_S6_S3 0 1
 /begin AXIS_DESCR STD_AXIS zff_atsys._.iSignale._.obj.sig_m_t8 UMR_NM__8_1_M50_S6_S3 4 -400 1640 DEPOSIT ABSOLUTE MONOTONY MON_INCREASE /end AXIS_DESCR
/end CHARACTERISTIC
/begin CHARACTERISTIC KL_TVGLSKZUCG67 "Verzoegerungszeit GLS-Beginn" CURVE 0x238E54 kl_ui8_S6_S3 2540 UMR_MSEC__10_1_0_S6_S3 0 2540
 /begin AXIS_DESCR STD_AXIS zff_atsys._.iSignale._.obj.sig_c_getr UMR_GRADC__1_1_M40_S6_S3 3 -40 150 DEPOSIT ABSOLUTE MONOTONY MON_INCREASE /end AXIS_DESCR
/end CHARACTERISTIC
/begin CHARACTERISTIC KL_TVGLSKZUCG67_EL "Verzoegerungszeit GLS-Beginn" CURVE 0x238E60 kl_ui8_S6_S3 2540 UMR_MSEC__10_1_0_S6_S3 0 2540
 /begin AXIS_DESCR STD_AXIS zff_atsys._.iSignale._.obj.sig_c_getr UMR_GRADC__1_1_M40_S6_S3 3 -40 150 DEPOSIT ABSOLUTE MONOTONY MON_INCREASE /end AXIS_DESCR
/end CHARACTERISTIC
/begin CHARACTERISTIC KF_WTSGLS67 "Sollschleifzeit GLS" MAP 0x238E6C kf_ui8_S6_S3 2550 UMR_MSEC__10_1_0_S6_S3 0 2550
 /begin AXIS_DESCR STD_AXIS zff_atsys._.iSignale._.obj.sig_n_t8 UMR_U_MIN_32_1_0_S6_S3 4 0 8160 DEPOSIT ABSOLUTE MONOTONY MON_INCREASE /end AXIS_DESCR
 /begin AXIS_DESCR STD_AXIS zff_atsys._.iSignale._.obj.sig_m_t8 UMR_NM__8_1_M50_S6_S3 6 -400 1640 DEPOSIT ABSOLUTE MONOTONY MON_INCREASE /end AXIS_DESCR
/end CHARACTERISTIC
/begin CHARACTERISTIC KF_WTSGLS67_EL "Sollschleifzeit GLS" MAP 0x238E98 kf_ui8_S6_S3 2550 UMR_MSEC__10_1_0_S6_S3 0 2550
 /begin AXIS_DESCR STD_AXIS zff_atsys._.iSignale._.obj.sig_n_t8 UMR_U_MIN_32_1_0_S6_S3 4 0 8160 DEPOSIT ABSOLUTE MONOTONY MON_INCREASE /end AXIS_DESCR
 /begin AXIS_DESCR STD_AXIS zff_atsys._.iSignale._.obj.sig_m_t8 UMR_NM__8_1_M50_S6_S3 6 -400 1640 DEPOSIT ABSOLUTE MONOTONY MON_INCREASE /end AXIS_DESCR
/end CHARACTERISTIC
/begin CHARACTERISTIC KL_FMENACHGLSENDE67 "Faktor der Nach-ME-Rampe HS fuer Start Filterung GLS" CURVE 0x238EC4 kl_ui8_S6_S3 1 UMR___1_100_0_S6_S3 0 1
 /begin AXIS_DESCR STD_AXIS zff_atsys._.iSignale._.obj.sig_m_t8 UMR_NM__8_1_M50_S6_S3 4 -400 1640 DEPOSIT ABSOLUTE MONOTONY MON_INCREASE /end AXIS_DESCR
/end CHARACTERISTIC
/begin CHARACTERISTIC KL_TVGLSKZUCG78 "Verzoegerungszeit GLS-Beginn" CURVE 0x238ED0 kl_ui8_S6_S3 2540 UMR_MSEC__10_1_0_S6_S3 0 2540
 /begin AXIS_DESCR STD_AXIS zff_atsys._.iSignale._.obj.sig_c_getr UMR_GRADC__1_1_M40_S6_S3 3 -40 150 DEPOSIT ABSOLUTE MONOTONY MON_INCREASE /end AXIS_DESCR
/end CHARACTERISTIC
/begin CHARACTERISTIC KL_TVGLSKZUCG78_EL "Verzoegerungszeit GLS-Beginn" CURVE 0x238EDC kl_ui8_S6_S3 2540 UMR_MSEC__10_1_0_S6_S3 0 2540
 /begin AXIS_DESCR STD_AXIS zff_atsys._.iSignale._.obj.sig_c_getr UMR_GRADC__1_1_M40_S6_S3 3 -40 150 DEPOSIT ABSOLUTE MONOTONY MON_INCREASE /end AXIS_DESCR
/end CHARACTERISTIC
/begin CHARACTERISTIC KF_WTSGLS78 "Sollschleifzeit GLS" MAP 0x238EE8 kf_ui8_S6_S3 2550 UMR_MSEC__10_1_0_S6_S3 0 2550
 /begin AXIS_DESCR STD_AXIS zff_atsys._.iSignale._.obj.sig_n_t8 UMR_U_MIN_32_1_0_S6_S3 4 0 8160 DEPOSIT ABSOLUTE MONOTONY MON_INCREASE /end AXIS_DESCR
 /begin AXIS_DESCR STD_AXIS zff_atsys._.iSignale._.obj.sig_m_t8 UMR_NM__8_1_M50_S6_S3 6 -400 1640 DEPOSIT ABSOLUTE MONOTONY MON_INCREASE /end AXIS_DESCR
/end CHARACTERISTIC
/begin CHARACTERISTIC KF_WTSGLS78_EL "Sollschleifzeit GLS" MAP 0x238F14 kf_ui8_S6_S3 2550 UMR_MSEC__10_1_0_S6_S3 0 2550
 /begin AXIS_DESCR STD_AXIS zff_atsys._.iSignale._.obj.sig_n_t8 UMR_U_MIN_32_1_0_S6_S3 4 0 8160 DEPOSIT ABSOLUTE MONOTONY MON_INCREASE /end AXIS_DESCR
 /begin AXIS_DESCR STD_AXIS zff_atsys._.iSignale._.obj.sig_m_t8 UMR_NM__8_1_M50_S6_S3 6 -400 1640 DEPOSIT ABSOLUTE MONOTONY MON_INCREASE /end AXIS_DESCR
/end CHARACTERISTIC
/begin CHARACTERISTIC KL_FMENACHGLSENDE78 "Faktor der Nach-ME-Rampe HS fuer Start Filterung GLS" CURVE 0x238F40 kl_ui8_S6_S3 1 UMR___1_100_0_S6_S3 0 1
 /begin AXIS_DESCR STD_AXIS zff_atsys._.iSignale._.obj.sig_m_t8 UMR_NM__8_1_M50_S6_S3 4 -400 1640 DEPOSIT ABSOLUTE MONOTONY MON_INCREASE /end AXIS_DESCR
/end CHARACTERISTIC
/begin CHARACTERISTIC KL_TVGLSKZUCG13 "Verzoegerungszeit GLS-Beginn" CURVE 0x238F4C kl_ui8_S6_S3 2540 UMR_MSEC__10_1_0_S6_S3 0 2540
 /begin AXIS_DESCR STD_AXIS zff_atsys._.iSignale._.obj.sig_c_getr UMR_GRADC__1_1_M40_S6_S3 3 -40 150 DEPOSIT ABSOLUTE MONOTONY MON_INCREASE /end AXIS_DESCR
/end CHARACTERISTIC
/begin CHARACTERISTIC KF_WTSGLS13 "Sollschleifzeit GLS" MAP 0x238F58 kf_ui8_S6_S3 2550 UMR_MSEC__10_1_0_S6_S3 0 2550
 /begin AXIS_DESCR STD_AXIS zff_atsys._.iSignale._.obj.sig_n_t8 UMR_U_MIN_32_1_0_S6_S3 4 0 8160 DEPOSIT ABSOLUTE MONOTONY MON_INCREASE /end AXIS_DESCR
 /begin AXIS_DESCR STD_AXIS zff_atsys._.iSignale._.obj.sig_m_t8 UMR_NM__8_1_M50_S6_S3 6 -400 1640 DEPOSIT ABSOLUTE MONOTONY MON_INCREASE /end AXIS_DESCR
/end CHARACTERISTIC
/begin CHARACTERISTIC KL_FMENACHGLSENDE13 "Faktor der Nach-ME-Rampe HS fuer Start Filterung GLS" CURVE 0x238F84 kl_ui8_S6_S3 1 UMR___1_100_0_S6_S3 0 1
 /begin AXIS_DESCR STD_AXIS zff_atsys._.iSignale._.obj.sig_m_t8 UMR_NM__8_1_M50_S6_S3 4 -400 1640 DEPOSIT ABSOLUTE MONOTONY MON_INCREASE /end AXIS_DESCR
/end CHARACTERISTIC
/begin CHARACTERISTIC KL_TVGLSKZUCG24 "Verzoegerungszeit GLS-Beginn" CURVE 0x238F90 kl_ui8_S6_S3 2540 UMR_MSEC__10_1_0_S6_S3 0 2540
 /begin AXIS_DESCR STD_AXIS zff_atsys._.iSignale._.obj.sig_c_getr UMR_GRADC__1_1_M40_S6_S3 3 -40 150 DEPOSIT ABSOLUTE MONOTONY MON_INCREASE /end AXIS_DESCR
/end CHARACTERISTIC
/begin CHARACTERISTIC KF_WTSGLS24 "Sollschleifzeit GLS" MAP 0x238F9C kf_ui8_S6_S3 2550 UMR_MSEC__10_1_0_S6_S3 0 2550
 /begin AXIS_DESCR STD_AXIS zff_atsys._.iSignale._.obj.sig_n_t8 UMR_U_MIN_32_1_0_S6_S3 4 0 8160 DEPOSIT ABSOLUTE MONOTONY MON_INCREASE /end AXIS_DESCR
 /begin AXIS_DESCR STD_AXIS zff_atsys._.iSignale._.obj.sig_m_t8 UMR_NM__8_1_M50_S6_S3 6 -400 1640 DEPOSIT ABSOLUTE MONOTONY MON_INCREASE /end AXIS_DESCR
/end CHARACTERISTIC
/begin CHARACTERISTIC KL_FMENACHGLSENDE24 "Faktor der Nach-ME-Rampe HS fuer Start Filterung GLS" CURVE 0x238FC8 kl_ui8_S6_S3 1 UMR___1_100_0_S6_S3 0 1
 /begin AXIS_DESCR STD_AXIS zff_atsys._.iSignale._.obj.sig_m_t8 UMR_NM__8_1_M50_S6_S3 4 -400 1640 DEPOSIT ABSOLUTE MONOTONY MON_INCREASE /end AXIS_DESCR
/end CHARACTERISTIC
/begin CHARACTERISTIC KL_TVGLSKZUCG35 "Verzoegerungszeit GLS-Beginn" CURVE 0x238FD4 kl_ui8_S6_S3 2540 UMR_MSEC__10_1_0_S6_S3 0 2540
 /begin AXIS_DESCR STD_AXIS zff_atsys._.iSignale._.obj.sig_c_getr UMR_GRADC__1_1_M40_S6_S3 3 -40 150 DEPOSIT ABSOLUTE MONOTONY MON_INCREASE /end AXIS_DESCR
/end CHARACTERISTIC
/begin CHARACTERISTIC KF_WTSGLS35 "Sollschleifzeit GLS" MAP 0x238FE0 kf_ui8_S6_S3 2550 UMR_MSEC__10_1_0_S6_S3 0 2550
 /begin AXIS_DESCR STD_AXIS zff_atsys._.iSignale._.obj.sig_n_t8 UMR_U_MIN_32_1_0_S6_S3 4 0 8160 DEPOSIT ABSOLUTE MONOTONY MON_INCREASE /end AXIS_DESCR
 /begin AXIS_DESCR STD_AXIS zff_atsys._.iSignale._.obj.sig_m_t8 UMR_NM__8_1_M50_S6_S3 6 -400 1640 DEPOSIT ABSOLUTE MONOTONY MON_INCREASE /end AXIS_DESCR
/end CHARACTERISTIC
/begin CHARACTERISTIC KL_FMENACHGLSENDE35 "Faktor der Nach-ME-Rampe HS fuer Start Filterung GLS" CURVE 0x23900C kl_ui8_S6_S3 1 UMR___1_100_0_S6_S3 0 1
 /begin AXIS_DESCR STD_AXIS zff_atsys._.iSignale._.obj.sig_m_t8 UMR_NM__8_1_M50_S6_S3 4 -400 1640 DEPOSIT ABSOLUTE MONOTONY MON_INCREASE /end AXIS_DESCR
/end CHARACTERISTIC
/begin CHARACTERISTIC KL_TVGLSKZUCG46 "Verzoegerungszeit GLS-Beginn" CURVE 0x239018 kl_ui8_S6_S3 2540 UMR_MSEC__10_1_0_S6_S3 0 2540
 /begin AXIS_DESCR STD_AXIS zff_atsys._.iSignale._.obj.sig_c_getr UMR_GRADC__1_1_M40_S6_S3 3 -40 150 DEPOSIT ABSOLUTE MONOTONY MON_INCREASE /end AXIS_DESCR
/end CHARACTERISTIC
/begin CHARACTERISTIC KF_WTSGLS46 "Sollschleifzeit GLS" MAP 0x239024 kf_ui8_S6_S3 2550 UMR_MSEC__10_1_0_S6_S3 0 2550
 /begin AXIS_DESCR STD_AXIS zff_atsys._.iSignale._.obj.sig_n_t8 UMR_U_MIN_32_1_0_S6_S3 4 0 8160 DEPOSIT ABSOLUTE MONOTONY MON_INCREASE /end AXIS_DESCR
 /begin AXIS_DESCR STD_AXIS zff_atsys._.iSignale._.obj.sig_m_t8 UMR_NM__8_1_M50_S6_S3 6 -400 1640 DEPOSIT ABSOLUTE MONOTONY MON_INCREASE /end AXIS_DESCR
/end CHARACTERISTIC
/begin CHARACTERISTIC KL_FMENACHGLSENDE46 "Faktor der Nach-ME-Rampe HS fuer Start Filterung GLS" CURVE 0x239050 kl_ui8_S6_S3 1 UMR___1_100_0_S6_S3 0 1
 /begin AXIS_DESCR STD_AXIS zff_atsys._.iSignale._.obj.sig_m_t8 UMR_NM__8_1_M50_S6_S3 4 -400 1640 DEPOSIT ABSOLUTE MONOTONY MON_INCREASE /end AXIS_DESCR
/end CHARACTERISTIC
/begin CHARACTERISTIC KL_TVGLSKZUCG57 "Verzoegerungszeit GLS-Beginn" CURVE 0x23905C kl_ui8_S6_S3 2540 UMR_MSEC__10_1_0_S6_S3 0 2540
 /begin AXIS_DESCR STD_AXIS zff_atsys._.iSignale._.obj.sig_c_getr UMR_GRADC__1_1_M40_S6_S3 3 -40 150 DEPOSIT ABSOLUTE MONOTONY MON_INCREASE /end AXIS_DESCR
/end CHARACTERISTIC
/begin CHARACTERISTIC KF_WTSGLS57 "Sollschleifzeit GLS" MAP 0x239068 kf_ui8_S6_S3 2550 UMR_MSEC__10_1_0_S6_S3 0 2550
 /begin AXIS_DESCR STD_AXIS zff_atsys._.iSignale._.obj.sig_n_t8 UMR_U_MIN_32_1_0_S6_S3 4 0 8160 DEPOSIT ABSOLUTE MONOTONY MON_INCREASE /end AXIS_DESCR
 /begin AXIS_DESCR STD_AXIS zff_atsys._.iSignale._.obj.sig_m_t8 UMR_NM__8_1_M50_S6_S3 6 -400 1640 DEPOSIT ABSOLUTE MONOTONY MON_INCREASE /end AXIS_DESCR
/end CHARACTERISTIC
/begin CHARACTERISTIC KL_FMENACHGLSENDE57 "Faktor der Nach-ME-Rampe HS fuer Start Filterung GLS" CURVE 0x239094 kl_ui8_S6_S3 1 UMR___1_100_0_S6_S3 0 1
 /begin AXIS_DESCR STD_AXIS zff_atsys._.iSignale._.obj.sig_m_t8 UMR_NM__8_1_M50_S6_S3 4 -400 1640 DEPOSIT ABSOLUTE MONOTONY MON_INCREASE /end AXIS_DESCR
/end CHARACTERISTIC
/begin CHARACTERISTIC KL_TVGLSKZUCG68 "Verzoegerungszeit GLS-Beginn" CURVE 0x2390A0 kl_ui8_S6_S3 2540 UMR_MSEC__10_1_0_S6_S3 0 2540
 /begin AXIS_DESCR STD_AXIS zff_atsys._.iSignale._.obj.sig_c_getr UMR_GRADC__1_1_M40_S6_S3 3 -40 150 DEPOSIT ABSOLUTE MONOTONY MON_INCREASE /end AXIS_DESCR
/end CHARACTERISTIC
/begin CHARACTERISTIC KF_WTSGLS68 "Sollschleifzeit GLS" MAP 0x2390AC kf_ui8_S6_S3 2550 UMR_MSEC__10_1_0_S6_S3 0 2550
 /begin AXIS_DESCR STD_AXIS zff_atsys._.iSignale._.obj.sig_n_t8 UMR_U_MIN_32_1_0_S6_S3 4 0 8160 DEPOSIT ABSOLUTE MONOTONY MON_INCREASE /end AXIS_DESCR
 /begin AXIS_DESCR STD_AXIS zff_atsys._.iSignale._.obj.sig_m_t8 UMR_NM__8_1_M50_S6_S3 6 -400 1640 DEPOSIT ABSOLUTE MONOTONY MON_INCREASE /end AXIS_DESCR
/end CHARACTERISTIC
/begin CHARACTERISTIC KL_FMENACHGLSENDE68 "Faktor der Nach-ME-Rampe HS fuer Start Filterung GLS" CURVE 0x2390D8 kl_ui8_S6_S3 1 UMR___1_100_0_S6_S3 0 1
 /begin AXIS_DESCR STD_AXIS zff_atsys._.iSignale._.obj.sig_m_t8 UMR_NM__8_1_M50_S6_S3 4 -400 1640 DEPOSIT ABSOLUTE MONOTONY MON_INCREASE /end AXIS_DESCR
/end CHARACTERISTIC
/begin CHARACTERISTIC KL_TVGLSKZUCGSP12 "Verzoegerungszeit GLS-Beginn" CURVE 0x2390E4 kl_ui8_S6_S3 2540 UMR_MSEC__10_1_0_S6_S3 0 2540
 /begin AXIS_DESCR STD_AXIS zff_atsys._.iSignale._.obj.sig_c_getr UMR_GRADC__1_1_M40_S6_S3 3 -40 150 DEPOSIT ABSOLUTE MONOTONY MON_INCREASE /end AXIS_DESCR
/end CHARACTERISTIC
/begin CHARACTERISTIC KF_WTSGLSSP12 "Sollschleifzeit GLS" MAP 0x2390F0 kf_ui8_S6_S3 2550 UMR_MSEC__10_1_0_S6_S3 0 2550
 /begin AXIS_DESCR STD_AXIS zff_atsys._.iSignale._.obj.sig_n_t8 UMR_U_MIN_32_1_0_S6_S3 4 0 8160 DEPOSIT ABSOLUTE MONOTONY MON_INCREASE /end AXIS_DESCR
 /begin AXIS_DESCR STD_AXIS zff_atsys._.iSignale._.obj.sig_m_t8 UMR_NM__8_1_M50_S6_S3 6 -400 1640 DEPOSIT ABSOLUTE MONOTONY MON_INCREASE /end AXIS_DESCR
/end CHARACTERISTIC
/begin CHARACTERISTIC KL_FMENACHGLSENDESP12 "Faktor der Nach-ME-Rampe HS fuer Start Filterung GLS" CURVE 0x23911C kl_ui8_S6_S3 1 UMR___1_100_0_S6_S3 0 1
 /begin AXIS_DESCR STD_AXIS zff_atsys._.iSignale._.obj.sig_m_t8 UMR_NM__8_1_M50_S6_S3 4 -400 1640 DEPOSIT ABSOLUTE MONOTONY MON_INCREASE /end AXIS_DESCR
/end CHARACTERISTIC
/begin CHARACTERISTIC KL_TVGLSKZUCGSP23 "Verzoegerungszeit GLS-Beginn" CURVE 0x239128 kl_ui8_S6_S3 2540 UMR_MSEC__10_1_0_S6_S3 0 2540
 /begin AXIS_DESCR STD_AXIS zff_atsys._.iSignale._.obj.sig_c_getr UMR_GRADC__1_1_M40_S6_S3 3 -40 150 DEPOSIT ABSOLUTE MONOTONY MON_INCREASE /end AXIS_DESCR
/end CHARACTERISTIC
/begin CHARACTERISTIC KF_WTSGLSSP23 "Sollschleifzeit GLS" MAP 0x239134 kf_ui8_S6_S3 2550 UMR_MSEC__10_1_0_S6_S3 0 2550
 /begin AXIS_DESCR STD_AXIS zff_atsys._.iSignale._.obj.sig_n_t8 UMR_U_MIN_32_1_0_S6_S3 4 0 8160 DEPOSIT ABSOLUTE MONOTONY MON_INCREASE /end AXIS_DESCR
 /begin AXIS_DESCR STD_AXIS zff_atsys._.iSignale._.obj.sig_m_t8 UMR_NM__8_1_M50_S6_S3 6 -400 1640 DEPOSIT ABSOLUTE MONOTONY MON_INCREASE /end AXIS_DESCR
/end CHARACTERISTIC
/begin CHARACTERISTIC KL_FMENACHGLSENDESP23 "Faktor der Nach-ME-Rampe HS fuer Start Filterung GLS" CURVE 0x239160 kl_ui8_S6_S3 1 UMR___1_100_0_S6_S3 0 1
 /begin AXIS_DESCR STD_AXIS zff_atsys._.iSignale._.obj.sig_m_t8 UMR_NM__8_1_M50_S6_S3 4 -400 1640 DEPOSIT ABSOLUTE MONOTONY MON_INCREASE /end AXIS_DESCR
/end CHARACTERISTIC
/begin CHARACTERISTIC KL_TVGLSKZUCGSP34 "Verzoegerungszeit GLS-Beginn" CURVE 0x23916C kl_ui8_S6_S3 2540 UMR_MSEC__10_1_0_S6_S3 0 2540
 /begin AXIS_DESCR STD_AXIS zff_atsys._.iSignale._.obj.sig_c_getr UMR_GRADC__1_1_M40_S6_S3 3 -40 150 DEPOSIT ABSOLUTE MONOTONY MON_INCREASE /end AXIS_DESCR
/end CHARACTERISTIC
/begin CHARACTERISTIC KF_WTSGLSSP34 "Sollschleifzeit GLS" MAP 0x239178 kf_ui8_S6_S3 2550 UMR_MSEC__10_1_0_S6_S3 0 2550
 /begin AXIS_DESCR STD_AXIS zff_atsys._.iSignale._.obj.sig_n_t8 UMR_U_MIN_32_1_0_S6_S3 4 0 8160 DEPOSIT ABSOLUTE MONOTONY MON_INCREASE /end AXIS_DESCR
 /begin AXIS_DESCR STD_AXIS zff_atsys._.iSignale._.obj.sig_m_t8 UMR_NM__8_1_M50_S6_S3 6 -400 1640 DEPOSIT ABSOLUTE MONOTONY MON_INCREASE /end AXIS_DESCR
/end CHARACTERISTIC
/begin CHARACTERISTIC KL_FMENACHGLSENDESP34 "Faktor der Nach-ME-Rampe HS fuer Start Filterung GLS" CURVE 0x2391A4 kl_ui8_S6_S3 1 UMR___1_100_0_S6_S3 0 1
 /begin AXIS_DESCR STD_AXIS zff_atsys._.iSignale._.obj.sig_m_t8 UMR_NM__8_1_M50_S6_S3 4 -400 1640 DEPOSIT ABSOLUTE MONOTONY MON_INCREASE /end AXIS_DESCR
/end CHARACTERISTIC
/begin CHARACTERISTIC KL_TVGLSKZUCGSP45 "Verzoegerungszeit GLS-Beginn" CURVE 0x2391B0 kl_ui8_S6_S3 2540 UMR_MSEC__10_1_0_S6_S3 0 2540
 /begin AXIS_DESCR STD_AXIS zff_atsys._.iSignale._.obj.sig_c_getr UMR_GRADC__1_1_M40_S6_S3 3 -40 150 DEPOSIT ABSOLUTE MONOTONY MON_INCREASE /end AXIS_DESCR
/end CHARACTERISTIC
/begin CHARACTERISTIC KF_WTSGLSSP45 "Sollschleifzeit GLS" MAP 0x2391BC kf_ui8_S6_S3 2550 UMR_MSEC__10_1_0_S6_S3 0 2550
 /begin AXIS_DESCR STD_AXIS zff_atsys._.iSignale._.obj.sig_n_t8 UMR_U_MIN_32_1_0_S6_S3 4 0 8160 DEPOSIT ABSOLUTE MONOTONY MON_INCREASE /end AXIS_DESCR
 /begin AXIS_DESCR STD_AXIS zff_atsys._.iSignale._.obj.sig_m_t8 UMR_NM__8_1_M50_S6_S3 6 -400 1640 DEPOSIT ABSOLUTE MONOTONY MON_INCREASE /end AXIS_DESCR
/end CHARACTERISTIC
/begin CHARACTERISTIC KL_FMENACHGLSENDESP45 "Faktor der Nach-ME-Rampe HS fuer Start Filterung GLS" CURVE 0x2391E8 kl_ui8_S6_S3 1 UMR___1_100_0_S6_S3 0 1
 /begin AXIS_DESCR STD_AXIS zff_atsys._.iSignale._.obj.sig_m_t8 UMR_NM__8_1_M50_S6_S3 4 -400 1640 DEPOSIT ABSOLUTE MONOTONY MON_INCREASE /end AXIS_DESCR
/end CHARACTERISTIC
/begin CHARACTERISTIC KL_TVGLSKZUCGSP56 "Verzoegerungszeit GLS-Beginn" CURVE 0x2391F4 kl_ui8_S6_S3 2540 UMR_MSEC__10_1_0_S6_S3 0 2540
 /begin AXIS_DESCR STD_AXIS zff_atsys._.iSignale._.obj.sig_c_getr UMR_GRADC__1_1_M40_S6_S3 3 -40 150 DEPOSIT ABSOLUTE MONOTONY MON_INCREASE /end AXIS_DESCR
/end CHARACTERISTIC
/begin CHARACTERISTIC KF_WTSGLSSP56 "Sollschleifzeit GLS" MAP 0x239200 kf_ui8_S6_S3 2550 UMR_MSEC__10_1_0_S6_S3 0 2550
 /begin AXIS_DESCR STD_AXIS zff_atsys._.iSignale._.obj.sig_n_t8 UMR_U_MIN_32_1_0_S6_S3 4 0 8160 DEPOSIT ABSOLUTE MONOTONY MON_INCREASE /end AXIS_DESCR
 /begin AXIS_DESCR STD_AXIS zff_atsys._.iSignale._.obj.sig_m_t8 UMR_NM__8_1_M50_S6_S3 6 -400 1640 DEPOSIT ABSOLUTE MONOTONY MON_INCREASE /end AXIS_DESCR
/end CHARACTERISTIC
/begin CHARACTERISTIC KL_FMENACHGLSENDESP56 "Faktor der Nach-ME-Rampe HS fuer Start Filterung GLS" CURVE 0x23922C kl_ui8_S6_S3 1 UMR___1_100_0_S6_S3 0 1
 /begin AXIS_DESCR STD_AXIS zff_atsys._.iSignale._.obj.sig_m_t8 UMR_NM__8_1_M50_S6_S3 4 -400 1640 DEPOSIT ABSOLUTE MONOTONY MON_INCREASE /end AXIS_DESCR
/end CHARACTERISTIC
/begin CHARACTERISTIC KL_TVGLSKZUCGSP67 "Verzoegerungszeit GLS-Beginn" CURVE 0x239238 kl_ui8_S6_S3 2540 UMR_MSEC__10_1_0_S6_S3 0 2540
 /begin AXIS_DESCR STD_AXIS zff_atsys._.iSignale._.obj.sig_c_getr UMR_GRADC__1_1_M40_S6_S3 3 -40 150 DEPOSIT ABSOLUTE MONOTONY MON_INCREASE /end AXIS_DESCR
/end CHARACTERISTIC
/begin CHARACTERISTIC KF_WTSGLSSP67 "Sollschleifzeit GLS" MAP 0x239244 kf_ui8_S6_S3 2550 UMR_MSEC__10_1_0_S6_S3 0 2550
 /begin AXIS_DESCR STD_AXIS zff_atsys._.iSignale._.obj.sig_n_t8 UMR_U_MIN_32_1_0_S6_S3 4 0 8160 DEPOSIT ABSOLUTE MONOTONY MON_INCREASE /end AXIS_DESCR
 /begin AXIS_DESCR STD_AXIS zff_atsys._.iSignale._.obj.sig_m_t8 UMR_NM__8_1_M50_S6_S3 6 -400 1640 DEPOSIT ABSOLUTE MONOTONY MON_INCREASE /end AXIS_DESCR
/end CHARACTERISTIC
/begin CHARACTERISTIC KL_FMENACHGLSENDESP67 "Faktor der Nach-ME-Rampe HS fuer Start Filterung GLS" CURVE 0x239270 kl_ui8_S6_S3 1 UMR___1_100_0_S6_S3 0 1
 /begin AXIS_DESCR STD_AXIS zff_atsys._.iSignale._.obj.sig_m_t8 UMR_NM__8_1_M50_S6_S3 4 -400 1640 DEPOSIT ABSOLUTE MONOTONY MON_INCREASE /end AXIS_DESCR
/end CHARACTERISTIC
/begin CHARACTERISTIC KL_TVGLSKZUCGSP78 "Verzoegerungszeit GLS-Beginn" CURVE 0x23927C kl_ui8_S6_S3 2540 UMR_MSEC__10_1_0_S6_S3 0 2540
 /begin AXIS_DESCR STD_AXIS zff_atsys._.iSignale._.obj.sig_c_getr UMR_GRADC__1_1_M40_S6_S3 3 -40 150 DEPOSIT ABSOLUTE MONOTONY MON_INCREASE /end AXIS_DESCR
/end CHARACTERISTIC
/begin CHARACTERISTIC KF_WTSGLSSP78 "Sollschleifzeit GLS" MAP 0x239288 kf_ui8_S6_S3 2550 UMR_MSEC__10_1_0_S6_S3 0 2550
 /begin AXIS_DESCR STD_AXIS zff_atsys._.iSignale._.obj.sig_n_t8 UMR_U_MIN_32_1_0_S6_S3 4 0 8160 DEPOSIT ABSOLUTE MONOTONY MON_INCREASE /end AXIS_DESCR
 /begin AXIS_DESCR STD_AXIS zff_atsys._.iSignale._.obj.sig_m_t8 UMR_NM__8_1_M50_S6_S3 6 -400 1640 DEPOSIT ABSOLUTE MONOTONY MON_INCREASE /end AXIS_DESCR
/end CHARACTERISTIC
/begin CHARACTERISTIC KL_FMENACHGLSENDESP78 "Faktor der Nach-ME-Rampe HS fuer Start Filterung GLS" CURVE 0x2392B4 kl_ui8_S6_S3 1 UMR___1_100_0_S6_S3 0 1
 /begin AXIS_DESCR STD_AXIS zff_atsys._.iSignale._.obj.sig_m_t8 UMR_NM__8_1_M50_S6_S3 4 -400 1640 DEPOSIT ABSOLUTE MONOTONY MON_INCREASE /end AXIS_DESCR
/end CHARACTERISTIC
/begin CHARACTERISTIC KL_TVGLSKZUCGSP13 "Verzoegerungszeit GLS-Beginn" CURVE 0x2392C0 kl_ui8_S6_S3 2540 UMR_MSEC__10_1_0_S6_S3 0 2540
 /begin AXIS_DESCR STD_AXIS zff_atsys._.iSignale._.obj.sig_c_getr UMR_GRADC__1_1_M40_S6_S3 3 -40 150 DEPOSIT ABSOLUTE MONOTONY MON_INCREASE /end AXIS_DESCR
/end CHARACTERISTIC
/begin CHARACTERISTIC KF_WTSGLSSP13 "Sollschleifzeit GLS" MAP 0x2392CC kf_ui8_S6_S3 2550 UMR_MSEC__10_1_0_S6_S3 0 2550
 /begin AXIS_DESCR STD_AXIS zff_atsys._.iSignale._.obj.sig_n_t8 UMR_U_MIN_32_1_0_S6_S3 4 0 8160 DEPOSIT ABSOLUTE MONOTONY MON_INCREASE /end AXIS_DESCR
 /begin AXIS_DESCR STD_AXIS zff_atsys._.iSignale._.obj.sig_m_t8 UMR_NM__8_1_M50_S6_S3 6 -400 1640 DEPOSIT ABSOLUTE MONOTONY MON_INCREASE /end AXIS_DESCR
/end CHARACTERISTIC
/begin CHARACTERISTIC KL_FMENACHGLSENDESP13 "Faktor der Nach-ME-Rampe HS fuer Start Filterung GLS" CURVE 0x2392F8 kl_ui8_S6_S3 1 UMR___1_100_0_S6_S3 0 1
 /begin AXIS_DESCR STD_AXIS zff_atsys._.iSignale._.obj.sig_m_t8 UMR_NM__8_1_M50_S6_S3 4 -400 1640 DEPOSIT ABSOLUTE MONOTONY MON_INCREASE /end AXIS_DESCR
/end CHARACTERISTIC
/begin CHARACTERISTIC KL_TVGLSKZUCGSP24 "Verzoegerungszeit GLS-Beginn" CURVE 0x239304 kl_ui8_S6_S3 2540 UMR_MSEC__10_1_0_S6_S3 0 2540
 /begin AXIS_DESCR STD_AXIS zff_atsys._.iSignale._.obj.sig_c_getr UMR_GRADC__1_1_M40_S6_S3 3 -40 150 DEPOSIT ABSOLUTE MONOTONY MON_INCREASE /end AXIS_DESCR
/end CHARACTERISTIC
/begin CHARACTERISTIC KF_WTSGLSSP24 "Sollschleifzeit GLS" MAP 0x239310 kf_ui8_S6_S3 2550 UMR_MSEC__10_1_0_S6_S3 0 2550
 /begin AXIS_DESCR STD_AXIS zff_atsys._.iSignale._.obj.sig_n_t8 UMR_U_MIN_32_1_0_S6_S3 4 0 8160 DEPOSIT ABSOLUTE MONOTONY MON_INCREASE /end AXIS_DESCR
 /begin AXIS_DESCR STD_AXIS zff_atsys._.iSignale._.obj.sig_m_t8 UMR_NM__8_1_M50_S6_S3 6 -400 1640 DEPOSIT ABSOLUTE MONOTONY MON_INCREASE /end AXIS_DESCR
/end CHARACTERISTIC
/begin CHARACTERISTIC KL_FMENACHGLSENDESP24 "Faktor der Nach-ME-Rampe HS fuer Start Filterung GLS" CURVE 0x23933C kl_ui8_S6_S3 1 UMR___1_100_0_S6_S3 0 1
 /begin AXIS_DESCR STD_AXIS zff_atsys._.iSignale._.obj.sig_m_t8 UMR_NM__8_1_M50_S6_S3 4 -400 1640 DEPOSIT ABSOLUTE MONOTONY MON_INCREASE /end AXIS_DESCR
/end CHARACTERISTIC
/begin CHARACTERISTIC KL_TVGLSKZUCGSP35 "Verzoegerungszeit GLS-Beginn" CURVE 0x239348 kl_ui8_S6_S3 2540 UMR_MSEC__10_1_0_S6_S3 0 2540
 /begin AXIS_DESCR STD_AXIS zff_atsys._.iSignale._.obj.sig_c_getr UMR_GRADC__1_1_M40_S6_S3 3 -40 150 DEPOSIT ABSOLUTE MONOTONY MON_INCREASE /end AXIS_DESCR
/end CHARACTERISTIC
/begin CHARACTERISTIC KF_WTSGLSSP35 "Sollschleifzeit GLS" MAP 0x239354 kf_ui8_S6_S3 2550 UMR_MSEC__10_1_0_S6_S3 0 2550
 /begin AXIS_DESCR STD_AXIS zff_atsys._.iSignale._.obj.sig_n_t8 UMR_U_MIN_32_1_0_S6_S3 4 0 8160 DEPOSIT ABSOLUTE MONOTONY MON_INCREASE /end AXIS_DESCR
 /begin AXIS_DESCR STD_AXIS zff_atsys._.iSignale._.obj.sig_m_t8 UMR_NM__8_1_M50_S6_S3 6 -400 1640 DEPOSIT ABSOLUTE MONOTONY MON_INCREASE /end AXIS_DESCR
/end CHARACTERISTIC
/begin CHARACTERISTIC KL_FMENACHGLSENDESP35 "Faktor der Nach-ME-Rampe HS fuer Start Filterung GLS" CURVE 0x239380 kl_ui8_S6_S3 1 UMR___1_100_0_S6_S3 0 1
 /begin AXIS_DESCR STD_AXIS zff_atsys._.iSignale._.obj.sig_m_t8 UMR_NM__8_1_M50_S6_S3 4 -400 1640 DEPOSIT ABSOLUTE MONOTONY MON_INCREASE /end AXIS_DESCR
/end CHARACTERISTIC
/begin CHARACTERISTIC KL_TVGLSKZUCGSP46 "Verzoegerungszeit GLS-Beginn" CURVE 0x23938C kl_ui8_S6_S3 2540 UMR_MSEC__10_1_0_S6_S3 0 2540
 /begin AXIS_DESCR STD_AXIS zff_atsys._.iSignale._.obj.sig_c_getr UMR_GRADC__1_1_M40_S6_S3 3 -40 150 DEPOSIT ABSOLUTE MONOTONY MON_INCREASE /end AXIS_DESCR
/end CHARACTERISTIC
/begin CHARACTERISTIC KF_WTSGLSSP46 "Sollschleifzeit GLS" MAP 0x239398 kf_ui8_S6_S3 2550 UMR_MSEC__10_1_0_S6_S3 0 2550
 /begin AXIS_DESCR STD_AXIS zff_atsys._.iSignale._.obj.sig_n_t8 UMR_U_MIN_32_1_0_S6_S3 4 0 8160 DEPOSIT ABSOLUTE MONOTONY MON_INCREASE /end AXIS_DESCR
 /begin AXIS_DESCR STD_AXIS zff_atsys._.iSignale._.obj.sig_m_t8 UMR_NM__8_1_M50_S6_S3 6 -400 1640 DEPOSIT ABSOLUTE MONOTONY MON_INCREASE /end AXIS_DESCR
/end CHARACTERISTIC
/begin CHARACTERISTIC KL_FMENACHGLSENDESP46 "Faktor der Nach-ME-Rampe HS fuer Start Filterung GLS" CURVE 0x2393C4 kl_ui8_S6_S3 1 UMR___1_100_0_S6_S3 0 1
 /begin AXIS_DESCR STD_AXIS zff_atsys._.iSignale._.obj.sig_m_t8 UMR_NM__8_1_M50_S6_S3 4 -400 1640 DEPOSIT ABSOLUTE MONOTONY MON_INCREASE /end AXIS_DESCR
/end CHARACTERISTIC
/begin CHARACTERISTIC KL_TVGLSKZUCGSP57 "Verzoegerungszeit GLS-Beginn" CURVE 0x2393D0 kl_ui8_S6_S3 2540 UMR_MSEC__10_1_0_S6_S3 0 2540
 /begin AXIS_DESCR STD_AXIS zff_atsys._.iSignale._.obj.sig_c_getr UMR_GRADC__1_1_M40_S6_S3 3 -40 150 DEPOSIT ABSOLUTE MONOTONY MON_INCREASE /end AXIS_DESCR
/end CHARACTERISTIC
/begin CHARACTERISTIC KF_WTSGLSSP57 "Sollschleifzeit GLS" MAP 0x2393DC kf_ui8_S6_S3 2550 UMR_MSEC__10_1_0_S6_S3 0 2550
 /begin AXIS_DESCR STD_AXIS zff_atsys._.iSignale._.obj.sig_n_t8 UMR_U_MIN_32_1_0_S6_S3 4 0 8160 DEPOSIT ABSOLUTE MONOTONY MON_INCREASE /end AXIS_DESCR
 /begin AXIS_DESCR STD_AXIS zff_atsys._.iSignale._.obj.sig_m_t8 UMR_NM__8_1_M50_S6_S3 6 -400 1640 DEPOSIT ABSOLUTE MONOTONY MON_INCREASE /end AXIS_DESCR
/end CHARACTERISTIC
/begin CHARACTERISTIC KL_FMENACHGLSENDESP57 "Faktor der Nach-ME-Rampe HS fuer Start Filterung GLS" CURVE 0x239408 kl_ui8_S6_S3 1 UMR___1_100_0_S6_S3 0 1
 /begin AXIS_DESCR STD_AXIS zff_atsys._.iSignale._.obj.sig_m_t8 UMR_NM__8_1_M50_S6_S3 4 -400 1640 DEPOSIT ABSOLUTE MONOTONY MON_INCREASE /end AXIS_DESCR
/end CHARACTERISTIC
/begin CHARACTERISTIC KL_TVGLSKZUCGSP68 "Verzoegerungszeit GLS-Beginn" CURVE 0x239414 kl_ui8_S6_S3 2540 UMR_MSEC__10_1_0_S6_S3 0 2540
 /begin AXIS_DESCR STD_AXIS zff_atsys._.iSignale._.obj.sig_c_getr UMR_GRADC__1_1_M40_S6_S3 3 -40 150 DEPOSIT ABSOLUTE MONOTONY MON_INCREASE /end AXIS_DESCR
/end CHARACTERISTIC
/begin CHARACTERISTIC KF_WTSGLSSP68 "Sollschleifzeit GLS" MAP 0x239420 kf_ui8_S6_S3 2550 UMR_MSEC__10_1_0_S6_S3 0 2550
 /begin AXIS_DESCR STD_AXIS zff_atsys._.iSignale._.obj.sig_n_t8 UMR_U_MIN_32_1_0_S6_S3 4 0 8160 DEPOSIT ABSOLUTE MONOTONY MON_INCREASE /end AXIS_DESCR
 /begin AXIS_DESCR STD_AXIS zff_atsys._.iSignale._.obj.sig_m_t8 UMR_NM__8_1_M50_S6_S3 6 -400 1640 DEPOSIT ABSOLUTE MONOTONY MON_INCREASE /end AXIS_DESCR
/end CHARACTERISTIC
/begin CHARACTERISTIC KL_FMENACHGLSENDESP68 "Faktor der Nach-ME-Rampe HS fuer Start Filterung GLS" CURVE 0x23944C kl_ui8_S6_S3 1 UMR___1_100_0_S6_S3 0 1
 /begin AXIS_DESCR STD_AXIS zff_atsys._.iSignale._.obj.sig_m_t8 UMR_NM__8_1_M50_S6_S3 4 -400 1640 DEPOSIT ABSOLUTE MONOTONY MON_INCREASE /end AXIS_DESCR
/end CHARACTERISTIC
/begin CHARACTERISTIC KL_TVGLSKZUCGSPORT12 "Verzoegerungszeit GLS-Beginn" CURVE 0x239458 kl_ui8_S6_S3 2540 UMR_MSEC__10_1_0_S6_S3 0 2540
 /begin AXIS_DESCR STD_AXIS zff_atsys._.iSignale._.obj.sig_c_getr UMR_GRADC__1_1_M40_S6_S3 3 -40 150 DEPOSIT ABSOLUTE MONOTONY MON_INCREASE /end AXIS_DESCR
/end CHARACTERISTIC
/begin CHARACTERISTIC KF_WTSGLSSPORT12 "Sollschleifzeit GLS" MAP 0x239464 kf_ui8_S6_S3 2550 UMR_MSEC__10_1_0_S6_S3 0 2550
 /begin AXIS_DESCR STD_AXIS zff_atsys._.iSignale._.obj.sig_n_t8 UMR_U_MIN_32_1_0_S6_S3 4 0 8160 DEPOSIT ABSOLUTE MONOTONY MON_INCREASE /end AXIS_DESCR
 /begin AXIS_DESCR STD_AXIS zff_atsys._.iSignale._.obj.sig_m_t8 UMR_NM__8_1_M50_S6_S3 6 -400 1640 DEPOSIT ABSOLUTE MONOTONY MON_INCREASE /end AXIS_DESCR
/end CHARACTERISTIC
/begin CHARACTERISTIC KL_FMENACHGLSENDESPORT12 "Faktor der Nach-ME-Rampe HS fuer Start Filterung GLS" CURVE 0x239490 kl_ui8_S6_S3 1 UMR___1_100_0_S6_S3 0 1
 /begin AXIS_DESCR STD_AXIS zff_atsys._.iSignale._.obj.sig_m_t8 UMR_NM__8_1_M50_S6_S3 4 -400 1640 DEPOSIT ABSOLUTE MONOTONY MON_INCREASE /end AXIS_DESCR
/end CHARACTERISTIC
/begin CHARACTERISTIC KL_TVGLSKZUCGSPORT23 "Verzoegerungszeit GLS-Beginn" CURVE 0x23949C kl_ui8_S6_S3 2540 UMR_MSEC__10_1_0_S6_S3 0 2540
 /begin AXIS_DESCR STD_AXIS zff_atsys._.iSignale._.obj.sig_c_getr UMR_GRADC__1_1_M40_S6_S3 3 -40 150 DEPOSIT ABSOLUTE MONOTONY MON_INCREASE /end AXIS_DESCR
/end CHARACTERISTIC
/begin CHARACTERISTIC KF_WTSGLSSPORT23 "Sollschleifzeit GLS" MAP 0x2394A8 kf_ui8_S6_S3 2550 UMR_MSEC__10_1_0_S6_S3 0 2550
 /begin AXIS_DESCR STD_AXIS zff_atsys._.iSignale._.obj.sig_n_t8 UMR_U_MIN_32_1_0_S6_S3 4 0 8160 DEPOSIT ABSOLUTE MONOTONY MON_INCREASE /end AXIS_DESCR
 /begin AXIS_DESCR STD_AXIS zff_atsys._.iSignale._.obj.sig_m_t8 UMR_NM__8_1_M50_S6_S3 6 -400 1640 DEPOSIT ABSOLUTE MONOTONY MON_INCREASE /end AXIS_DESCR
/end CHARACTERISTIC
/begin CHARACTERISTIC KL_FMENACHGLSENDESPORT23 "Faktor der Nach-ME-Rampe HS fuer Start Filterung GLS" CURVE 0x2394D4 kl_ui8_S6_S3 1 UMR___1_100_0_S6_S3 0 1
 /begin AXIS_DESCR STD_AXIS zff_atsys._.iSignale._.obj.sig_m_t8 UMR_NM__8_1_M50_S6_S3 4 -400 1640 DEPOSIT ABSOLUTE MONOTONY MON_INCREASE /end AXIS_DESCR
/end CHARACTERISTIC
/begin CHARACTERISTIC KL_TVGLSKZUCGSPORT34 "Verzoegerungszeit GLS-Beginn" CURVE 0x2394E0 kl_ui8_S6_S3 2540 UMR_MSEC__10_1_0_S6_S3 0 2540
 /begin AXIS_DESCR STD_AXIS zff_atsys._.iSignale._.obj.sig_c_getr UMR_GRADC__1_1_M40_S6_S3 3 -40 150 DEPOSIT ABSOLUTE MONOTONY MON_INCREASE /end AXIS_DESCR
/end CHARACTERISTIC
/begin CHARACTERISTIC KF_WTSGLSSPORT34 "Sollschleifzeit GLS" MAP 0x2394EC kf_ui8_S6_S3 2550 UMR_MSEC__10_1_0_S6_S3 0 2550
 /begin AXIS_DESCR STD_AXIS zff_atsys._.iSignale._.obj.sig_n_t8 UMR_U_MIN_32_1_0_S6_S3 4 0 8160 DEPOSIT ABSOLUTE MONOTONY MON_INCREASE /end AXIS_DESCR
 /begin AXIS_DESCR STD_AXIS zff_atsys._.iSignale._.obj.sig_m_t8 UMR_NM__8_1_M50_S6_S3 6 -400 1640 DEPOSIT ABSOLUTE MONOTONY MON_INCREASE /end AXIS_DESCR
/end CHARACTERISTIC
/begin CHARACTERISTIC KL_FMENACHGLSENDESPORT34 "Faktor der Nach-ME-Rampe HS fuer Start Filterung GLS" CURVE 0x239518 kl_ui8_S6_S3 1 UMR___1_100_0_S6_S3 0 1
 /begin AXIS_DESCR STD_AXIS zff_atsys._.iSignale._.obj.sig_m_t8 UMR_NM__8_1_M50_S6_S3 4 -400 1640 DEPOSIT ABSOLUTE MONOTONY MON_INCREASE /end AXIS_DESCR
/end CHARACTERISTIC
/begin CHARACTERISTIC KL_TVGLSKZUCGSPORT45 "Verzoegerungszeit GLS-Beginn" CURVE 0x239524 kl_ui8_S6_S3 2540 UMR_MSEC__10_1_0_S6_S3 0 2540
 /begin AXIS_DESCR STD_AXIS zff_atsys._.iSignale._.obj.sig_c_getr UMR_GRADC__1_1_M40_S6_S3 3 -40 150 DEPOSIT ABSOLUTE MONOTONY MON_INCREASE /end AXIS_DESCR
/end CHARACTERISTIC
/begin CHARACTERISTIC KF_WTSGLSSPORT45 "Sollschleifzeit GLS" MAP 0x239530 kf_ui8_S6_S3 2550 UMR_MSEC__10_1_0_S6_S3 0 2550
 /begin AXIS_DESCR STD_AXIS zff_atsys._.iSignale._.obj.sig_n_t8 UMR_U_MIN_32_1_0_S6_S3 4 0 8160 DEPOSIT ABSOLUTE MONOTONY MON_INCREASE /end AXIS_DESCR
 /begin AXIS_DESCR STD_AXIS zff_atsys._.iSignale._.obj.sig_m_t8 UMR_NM__8_1_M50_S6_S3 6 -400 1640 DEPOSIT ABSOLUTE MONOTONY MON_INCREASE /end AXIS_DESCR
/end CHARACTERISTIC
/begin CHARACTERISTIC KL_FMENACHGLSENDESPORT45 "Faktor der Nach-ME-Rampe HS fuer Start Filterung GLS" CURVE 0x23955C kl_ui8_S6_S3 1 UMR___1_100_0_S6_S3 0 1
 /begin AXIS_DESCR STD_AXIS zff_atsys._.iSignale._.obj.sig_m_t8 UMR_NM__8_1_M50_S6_S3 4 -400 1640 DEPOSIT ABSOLUTE MONOTONY MON_INCREASE /end AXIS_DESCR
/end CHARACTERISTIC
/begin CHARACTERISTIC KL_TVGLSKZUCGSPORT56 "Verzoegerungszeit GLS-Beginn" CURVE 0x239568 kl_ui8_S6_S3 2540 UMR_MSEC__10_1_0_S6_S3 0 2540
 /begin AXIS_DESCR STD_AXIS zff_atsys._.iSignale._.obj.sig_c_getr UMR_GRADC__1_1_M40_S6_S3 3 -40 150 DEPOSIT ABSOLUTE MONOTONY MON_INCREASE /end AXIS_DESCR
/end CHARACTERISTIC
/begin CHARACTERISTIC KF_WTSGLSSPORT56 "Sollschleifzeit GLS" MAP 0x239574 kf_ui8_S6_S3 2550 UMR_MSEC__10_1_0_S6_S3 0 2550
 /begin AXIS_DESCR STD_AXIS zff_atsys._.iSignale._.obj.sig_n_t8 UMR_U_MIN_32_1_0_S6_S3 4 0 8160 DEPOSIT ABSOLUTE MONOTONY MON_INCREASE /end AXIS_DESCR
 /begin AXIS_DESCR STD_AXIS zff_atsys._.iSignale._.obj.sig_m_t8 UMR_NM__8_1_M50_S6_S3 6 -400 1640 DEPOSIT ABSOLUTE MONOTONY MON_INCREASE /end AXIS_DESCR
/end CHARACTERISTIC
/begin CHARACTERISTIC KL_FMENACHGLSENDESPORT56 "Faktor der Nach-ME-Rampe HS fuer Start Filterung GLS" CURVE 0x2395A0 kl_ui8_S6_S3 1 UMR___1_100_0_S6_S3 0 1
 /begin AXIS_DESCR STD_AXIS zff_atsys._.iSignale._.obj.sig_m_t8 UMR_NM__8_1_M50_S6_S3 4 -400 1640 DEPOSIT ABSOLUTE MONOTONY MON_INCREASE /end AXIS_DESCR
/end CHARACTERISTIC
/begin CHARACTERISTIC KL_TVGLSKZUCGSPORT67 "Verzoegerungszeit GLS-Beginn" CURVE 0x2395AC kl_ui8_S6_S3 2540 UMR_MSEC__10_1_0_S6_S3 0 2540
 /begin AXIS_DESCR STD_AXIS zff_atsys._.iSignale._.obj.sig_c_getr UMR_GRADC__1_1_M40_S6_S3 3 -40 150 DEPOSIT ABSOLUTE MONOTONY MON_INCREASE /end AXIS_DESCR
/end CHARACTERISTIC
/begin CHARACTERISTIC KF_WTSGLSSPORT67 "Sollschleifzeit GLS" MAP 0x2395B8 kf_ui8_S6_S3 2550 UMR_MSEC__10_1_0_S6_S3 0 2550
 /begin AXIS_DESCR STD_AXIS zff_atsys._.iSignale._.obj.sig_n_t8 UMR_U_MIN_32_1_0_S6_S3 4 0 8160 DEPOSIT ABSOLUTE MONOTONY MON_INCREASE /end AXIS_DESCR
 /begin AXIS_DESCR STD_AXIS zff_atsys._.iSignale._.obj.sig_m_t8 UMR_NM__8_1_M50_S6_S3 6 -400 1640 DEPOSIT ABSOLUTE MONOTONY MON_INCREASE /end AXIS_DESCR
/end CHARACTERISTIC
/begin CHARACTERISTIC KL_FMENACHGLSENDESPORT67 "Faktor der Nach-ME-Rampe HS fuer Start Filterung GLS" CURVE 0x2395E4 kl_ui8_S6_S3 1 UMR___1_100_0_S6_S3 0 1
 /begin AXIS_DESCR STD_AXIS zff_atsys._.iSignale._.obj.sig_m_t8 UMR_NM__8_1_M50_S6_S3 4 -400 1640 DEPOSIT ABSOLUTE MONOTONY MON_INCREASE /end AXIS_DESCR
/end CHARACTERISTIC
/begin CHARACTERISTIC KL_TVGLSKZUCGSPORT78 "Verzoegerungszeit GLS-Beginn" CURVE 0x2395F0 kl_ui8_S6_S3 2540 UMR_MSEC__10_1_0_S6_S3 0 2540
 /begin AXIS_DESCR STD_AXIS zff_atsys._.iSignale._.obj.sig_c_getr UMR_GRADC__1_1_M40_S6_S3 3 -40 150 DEPOSIT ABSOLUTE MONOTONY MON_INCREASE /end AXIS_DESCR
/end CHARACTERISTIC
/begin CHARACTERISTIC KF_WTSGLSSPORT78 "Sollschleifzeit GLS" MAP 0x2395FC kf_ui8_S6_S3 2550 UMR_MSEC__10_1_0_S6_S3 0 2550
 /begin AXIS_DESCR STD_AXIS zff_atsys._.iSignale._.obj.sig_n_t8 UMR_U_MIN_32_1_0_S6_S3 4 0 8160 DEPOSIT ABSOLUTE MONOTONY MON_INCREASE /end AXIS_DESCR
 /begin AXIS_DESCR STD_AXIS zff_atsys._.iSignale._.obj.sig_m_t8 UMR_NM__8_1_M50_S6_S3 6 -400 1640 DEPOSIT ABSOLUTE MONOTONY MON_INCREASE /end AXIS_DESCR
/end CHARACTERISTIC
/begin CHARACTERISTIC KL_FMENACHGLSENDESPORT78 "Faktor der Nach-ME-Rampe HS fuer Start Filterung GLS" CURVE 0x239628 kl_ui8_S6_S3 1 UMR___1_100_0_S6_S3 0 1
 /begin AXIS_DESCR STD_AXIS zff_atsys._.iSignale._.obj.sig_m_t8 UMR_NM__8_1_M50_S6_S3 4 -400 1640 DEPOSIT ABSOLUTE MONOTONY MON_INCREASE /end AXIS_DESCR
/end CHARACTERISTIC
/begin CHARACTERISTIC KL_TVGLSKZUCGSPORT13 "Verzoegerungszeit GLS-Beginn" CURVE 0x239634 kl_ui8_S6_S3 2540 UMR_MSEC__10_1_0_S6_S3 0 2540
 /begin AXIS_DESCR STD_AXIS zff_atsys._.iSignale._.obj.sig_c_getr UMR_GRADC__1_1_M40_S6_S3 3 -40 150 DEPOSIT ABSOLUTE MONOTONY MON_INCREASE /end AXIS_DESCR
/end CHARACTERISTIC
/begin CHARACTERISTIC KF_WTSGLSSPORT13 "Sollschleifzeit GLS" MAP 0x239640 kf_ui8_S6_S3 2550 UMR_MSEC__10_1_0_S6_S3 0 2550
 /begin AXIS_DESCR STD_AXIS zff_atsys._.iSignale._.obj.sig_n_t8 UMR_U_MIN_32_1_0_S6_S3 4 0 8160 DEPOSIT ABSOLUTE MONOTONY MON_INCREASE /end AXIS_DESCR
 /begin AXIS_DESCR STD_AXIS zff_atsys._.iSignale._.obj.sig_m_t8 UMR_NM__8_1_M50_S6_S3 6 -400 1640 DEPOSIT ABSOLUTE MONOTONY MON_INCREASE /end AXIS_DESCR
/end CHARACTERISTIC
/begin CHARACTERISTIC KL_FMENACHGLSENDESPORT13 "Faktor der Nach-ME-Rampe HS fuer Start Filterung GLS" CURVE 0x23966C kl_ui8_S6_S3 1 UMR___1_100_0_S6_S3 0 1
 /begin AXIS_DESCR STD_AXIS zff_atsys._.iSignale._.obj.sig_m_t8 UMR_NM__8_1_M50_S6_S3 4 -400 1640 DEPOSIT ABSOLUTE MONOTONY MON_INCREASE /end AXIS_DESCR
/end CHARACTERISTIC
/begin CHARACTERISTIC KL_TVGLSKZUCGSPORT24 "Verzoegerungszeit GLS-Beginn" CURVE 0x239678 kl_ui8_S6_S3 2540 UMR_MSEC__10_1_0_S6_S3 0 2540
 /begin AXIS_DESCR STD_AXIS zff_atsys._.iSignale._.obj.sig_c_getr UMR_GRADC__1_1_M40_S6_S3 3 -40 150 DEPOSIT ABSOLUTE MONOTONY MON_INCREASE /end AXIS_DESCR
/end CHARACTERISTIC
/begin CHARACTERISTIC KF_WTSGLSSPORT24 "Sollschleifzeit GLS" MAP 0x239684 kf_ui8_S6_S3 2550 UMR_MSEC__10_1_0_S6_S3 0 2550
 /begin AXIS_DESCR STD_AXIS zff_atsys._.iSignale._.obj.sig_n_t8 UMR_U_MIN_32_1_0_S6_S3 4 0 8160 DEPOSIT ABSOLUTE MONOTONY MON_INCREASE /end AXIS_DESCR
 /begin AXIS_DESCR STD_AXIS zff_atsys._.iSignale._.obj.sig_m_t8 UMR_NM__8_1_M50_S6_S3 6 -400 1640 DEPOSIT ABSOLUTE MONOTONY MON_INCREASE /end AXIS_DESCR
/end CHARACTERISTIC
/begin CHARACTERISTIC KL_FMENACHGLSENDESPORT24 "Faktor der Nach-ME-Rampe HS fuer Start Filterung GLS" CURVE 0x2396B0 kl_ui8_S6_S3 1 UMR___1_100_0_S6_S3 0 1
 /begin AXIS_DESCR STD_AXIS zff_atsys._.iSignale._.obj.sig_m_t8 UMR_NM__8_1_M50_S6_S3 4 -400 1640 DEPOSIT ABSOLUTE MONOTONY MON_INCREASE /end AXIS_DESCR
/end CHARACTERISTIC
/begin CHARACTERISTIC KL_TVGLSKZUCGSPORT35 "Verzoegerungszeit GLS-Beginn" CURVE 0x2396BC kl_ui8_S6_S3 2540 UMR_MSEC__10_1_0_S6_S3 0 2540
 /begin AXIS_DESCR STD_AXIS zff_atsys._.iSignale._.obj.sig_c_getr UMR_GRADC__1_1_M40_S6_S3 3 -40 150 DEPOSIT ABSOLUTE MONOTONY MON_INCREASE /end AXIS_DESCR
/end CHARACTERISTIC
/begin CHARACTERISTIC KF_WTSGLSSPORT35 "Sollschleifzeit GLS" MAP 0x2396C8 kf_ui8_S6_S3 2550 UMR_MSEC__10_1_0_S6_S3 0 2550
 /begin AXIS_DESCR STD_AXIS zff_atsys._.iSignale._.obj.sig_n_t8 UMR_U_MIN_32_1_0_S6_S3 4 0 8160 DEPOSIT ABSOLUTE MONOTONY MON_INCREASE /end AXIS_DESCR
 /begin AXIS_DESCR STD_AXIS zff_atsys._.iSignale._.obj.sig_m_t8 UMR_NM__8_1_M50_S6_S3 6 -400 1640 DEPOSIT ABSOLUTE MONOTONY MON_INCREASE /end AXIS_DESCR
/end CHARACTERISTIC
/begin CHARACTERISTIC KL_FMENACHGLSENDESPORT35 "Faktor der Nach-ME-Rampe HS fuer Start Filterung GLS" CURVE 0x2396F4 kl_ui8_S6_S3 1 UMR___1_100_0_S6_S3 0 1
 /begin AXIS_DESCR STD_AXIS zff_atsys._.iSignale._.obj.sig_m_t8 UMR_NM__8_1_M50_S6_S3 4 -400 1640 DEPOSIT ABSOLUTE MONOTONY MON_INCREASE /end AXIS_DESCR
/end CHARACTERISTIC
/begin CHARACTERISTIC KL_TVGLSKZUCGSPORT46 "Verzoegerungszeit GLS-Beginn" CURVE 0x239700 kl_ui8_S6_S3 2540 UMR_MSEC__10_1_0_S6_S3 0 2540
 /begin AXIS_DESCR STD_AXIS zff_atsys._.iSignale._.obj.sig_c_getr UMR_GRADC__1_1_M40_S6_S3 3 -40 150 DEPOSIT ABSOLUTE MONOTONY MON_INCREASE /end AXIS_DESCR
/end CHARACTERISTIC
/begin CHARACTERISTIC KF_WTSGLSSPORT46 "Sollschleifzeit GLS" MAP 0x23970C kf_ui8_S6_S3 2550 UMR_MSEC__10_1_0_S6_S3 0 2550
 /begin AXIS_DESCR STD_AXIS zff_atsys._.iSignale._.obj.sig_n_t8 UMR_U_MIN_32_1_0_S6_S3 4 0 8160 DEPOSIT ABSOLUTE MONOTONY MON_INCREASE /end AXIS_DESCR
 /begin AXIS_DESCR STD_AXIS zff_atsys._.iSignale._.obj.sig_m_t8 UMR_NM__8_1_M50_S6_S3 6 -400 1640 DEPOSIT ABSOLUTE MONOTONY MON_INCREASE /end AXIS_DESCR
/end CHARACTERISTIC
/begin CHARACTERISTIC KL_FMENACHGLSENDESPORT46 "Faktor der Nach-ME-Rampe HS fuer Start Filterung GLS" CURVE 0x239738 kl_ui8_S6_S3 1 UMR___1_100_0_S6_S3 0 1
 /begin AXIS_DESCR STD_AXIS zff_atsys._.iSignale._.obj.sig_m_t8 UMR_NM__8_1_M50_S6_S3 4 -400 1640 DEPOSIT ABSOLUTE MONOTONY MON_INCREASE /end AXIS_DESCR
/end CHARACTERISTIC
/begin CHARACTERISTIC KL_TVGLSKZUCGSPORT57 "Verzoegerungszeit GLS-Beginn" CURVE 0x239744 kl_ui8_S6_S3 2540 UMR_MSEC__10_1_0_S6_S3 0 2540
 /begin AXIS_DESCR STD_AXIS zff_atsys._.iSignale._.obj.sig_c_getr UMR_GRADC__1_1_M40_S6_S3 3 -40 150 DEPOSIT ABSOLUTE MONOTONY MON_INCREASE /end AXIS_DESCR
/end CHARACTERISTIC
/begin CHARACTERISTIC KF_WTSGLSSPORT57 "Sollschleifzeit GLS" MAP 0x239750 kf_ui8_S6_S3 2550 UMR_MSEC__10_1_0_S6_S3 0 2550
 /begin AXIS_DESCR STD_AXIS zff_atsys._.iSignale._.obj.sig_n_t8 UMR_U_MIN_32_1_0_S6_S3 4 0 8160 DEPOSIT ABSOLUTE MONOTONY MON_INCREASE /end AXIS_DESCR
 /begin AXIS_DESCR STD_AXIS zff_atsys._.iSignale._.obj.sig_m_t8 UMR_NM__8_1_M50_S6_S3 6 -400 1640 DEPOSIT ABSOLUTE MONOTONY MON_INCREASE /end AXIS_DESCR
/end CHARACTERISTIC
/begin CHARACTERISTIC KL_FMENACHGLSENDESPORT57 "Faktor der Nach-ME-Rampe HS fuer Start Filterung GLS" CURVE 0x23977C kl_ui8_S6_S3 1 UMR___1_100_0_S6_S3 0 1
 /begin AXIS_DESCR STD_AXIS zff_atsys._.iSignale._.obj.sig_m_t8 UMR_NM__8_1_M50_S6_S3 4 -400 1640 DEPOSIT ABSOLUTE MONOTONY MON_INCREASE /end AXIS_DESCR
/end CHARACTERISTIC
/begin CHARACTERISTIC KL_TVGLSKZUCGSPORT68 "Verzoegerungszeit GLS-Beginn" CURVE 0x239788 kl_ui8_S6_S3 2540 UMR_MSEC__10_1_0_S6_S3 0 2540
 /begin AXIS_DESCR STD_AXIS zff_atsys._.iSignale._.obj.sig_c_getr UMR_GRADC__1_1_M40_S6_S3 3 -40 150 DEPOSIT ABSOLUTE MONOTONY MON_INCREASE /end AXIS_DESCR
/end CHARACTERISTIC
/begin CHARACTERISTIC KF_WTSGLSSPORT68 "Sollschleifzeit GLS" MAP 0x239794 kf_ui8_S6_S3 2550 UMR_MSEC__10_1_0_S6_S3 0 2550
 /begin AXIS_DESCR STD_AXIS zff_atsys._.iSignale._.obj.sig_n_t8 UMR_U_MIN_32_1_0_S6_S3 4 0 8160 DEPOSIT ABSOLUTE MONOTONY MON_INCREASE /end AXIS_DESCR
 /begin AXIS_DESCR STD_AXIS zff_atsys._.iSignale._.obj.sig_m_t8 UMR_NM__8_1_M50_S6_S3 6 -400 1640 DEPOSIT ABSOLUTE MONOTONY MON_INCREASE /end AXIS_DESCR
/end CHARACTERISTIC
/begin CHARACTERISTIC KL_FMENACHGLSENDESPORT68 "Faktor der Nach-ME-Rampe HS fuer Start Filterung GLS" CURVE 0x2397C0 kl_ui8_S6_S3 1 UMR___1_100_0_S6_S3 0 1
 /begin AXIS_DESCR STD_AXIS zff_atsys._.iSignale._.obj.sig_m_t8 UMR_NM__8_1_M50_S6_S3 4 -400 1640 DEPOSIT ABSOLUTE MONOTONY MON_INCREASE /end AXIS_DESCR
/end CHARACTERISTIC
/begin CHARACTERISTIC KF_WTSGLS21 "Sollschleifzeit GLS" MAP 0x23A020 kf_ui8_S6_S3 2550 UMR_MSEC__10_1_0_S6_S3 0 2550
 /begin AXIS_DESCR STD_AXIS zff_atsys._.iSignale._.obj.sig_n_t8 UMR_U_MIN_32_1_0_S6_S3 4 0 8160 DEPOSIT ABSOLUTE MONOTONY MON_INCREASE /end AXIS_DESCR
 /begin AXIS_DESCR STD_AXIS zff_atsys._.iSignale._.obj.sig_m_t8 UMR_NM__8_1_M50_S6_S3 6 -400 1640 DEPOSIT ABSOLUTE MONOTONY MON_INCREASE /end AXIS_DESCR
/end CHARACTERISTIC
/begin CHARACTERISTIC KF_WTSGLS21_EL "Sollschleifzeit GLS" MAP 0x23A04C kf_ui8_S6_S3 2550 UMR_MSEC__10_1_0_S6_S3 0 2550
 /begin AXIS_DESCR STD_AXIS zff_atsys._.iSignale._.obj.sig_n_t8 UMR_U_MIN_32_1_0_S6_S3 4 0 8160 DEPOSIT ABSOLUTE MONOTONY MON_INCREASE /end AXIS_DESCR
 /begin AXIS_DESCR STD_AXIS zff_atsys._.iSignale._.obj.sig_m_t8 UMR_NM__8_1_M50_S6_S3 6 -400 1640 DEPOSIT ABSOLUTE MONOTONY MON_INCREASE /end AXIS_DESCR
/end CHARACTERISTIC
/begin CHARACTERISTIC KL_TVGLSKABCG21 "Verzoegerungszeit GLS-Beginn" CURVE 0x23A078 kl_ui8_S6_S3 2540 UMR_MSEC__10_1_0_S6_S3 0 2540
 /begin AXIS_DESCR STD_AXIS zff_atsys._.iSignale._.obj.sig_c_getr UMR_GRADC__1_1_M40_S6_S3 3 -40 150 DEPOSIT ABSOLUTE MONOTONY MON_INCREASE /end AXIS_DESCR
/end CHARACTERISTIC
/begin CHARACTERISTIC KL_TVGLSKABCG21_EL "Verzoegerungszeit GLS-Beginn" CURVE 0x23A084 kl_ui8_S6_S3 2540 UMR_MSEC__10_1_0_S6_S3 0 2540
 /begin AXIS_DESCR STD_AXIS zff_atsys._.iSignale._.obj.sig_c_getr UMR_GRADC__1_1_M40_S6_S3 3 -40 150 DEPOSIT ABSOLUTE MONOTONY MON_INCREASE /end AXIS_DESCR
/end CHARACTERISTIC
/begin CHARACTERISTIC KL_POMTABBGLSHSZ21 "Schaltdruckoffset nach Umstellung einer HSZ in eine RSZ waehrend der GLS-Phase" CURVE 0x23A090 kl_si16_S6_S3 12 UMR_BAR__1_1000_0_S6_S3 -6 6
 /begin AXIS_DESCR STD_AXIS zff_atsys._.iSignale._.obj.sig_m_t UMR_NM__1_1_0_S6_S3 4 -400 1640 DEPOSIT ABSOLUTE MONOTONY MON_INCREASE /end AXIS_DESCR
/end CHARACTERISTIC
/begin CHARACTERISTIC KF_WTSGLS32 "Sollschleifzeit GLS" MAP 0x23A0A4 kf_ui8_S6_S3 2550 UMR_MSEC__10_1_0_S6_S3 0 2550
 /begin AXIS_DESCR STD_AXIS zff_atsys._.iSignale._.obj.sig_n_t8 UMR_U_MIN_32_1_0_S6_S3 4 0 8160 DEPOSIT ABSOLUTE MONOTONY MON_INCREASE /end AXIS_DESCR
 /begin AXIS_DESCR STD_AXIS zff_atsys._.iSignale._.obj.sig_m_t8 UMR_NM__8_1_M50_S6_S3 6 -400 1640 DEPOSIT ABSOLUTE MONOTONY MON_INCREASE /end AXIS_DESCR
/end CHARACTERISTIC
/begin CHARACTERISTIC KF_WTSGLS32_EL "Sollschleifzeit GLS" MAP 0x23A0D0 kf_ui8_S6_S3 2550 UMR_MSEC__10_1_0_S6_S3 0 2550
 /begin AXIS_DESCR STD_AXIS zff_atsys._.iSignale._.obj.sig_n_t8 UMR_U_MIN_32_1_0_S6_S3 4 0 8160 DEPOSIT ABSOLUTE MONOTONY MON_INCREASE /end AXIS_DESCR
 /begin AXIS_DESCR STD_AXIS zff_atsys._.iSignale._.obj.sig_m_t8 UMR_NM__8_1_M50_S6_S3 6 -400 1640 DEPOSIT ABSOLUTE MONOTONY MON_INCREASE /end AXIS_DESCR
/end CHARACTERISTIC
/begin CHARACTERISTIC KL_TVGLSKABCG32 "Verzoegerungszeit GLS-Beginn" CURVE 0x23A0FC kl_ui8_S6_S3 2540 UMR_MSEC__10_1_0_S6_S3 0 2540
 /begin AXIS_DESCR STD_AXIS zff_atsys._.iSignale._.obj.sig_c_getr UMR_GRADC__1_1_M40_S6_S3 3 -40 150 DEPOSIT ABSOLUTE MONOTONY MON_INCREASE /end AXIS_DESCR
/end CHARACTERISTIC
/begin CHARACTERISTIC KL_TVGLSKABCG32_EL "Verzoegerungszeit GLS-Beginn" CURVE 0x23A108 kl_ui8_S6_S3 2540 UMR_MSEC__10_1_0_S6_S3 0 2540
 /begin AXIS_DESCR STD_AXIS zff_atsys._.iSignale._.obj.sig_c_getr UMR_GRADC__1_1_M40_S6_S3 3 -40 150 DEPOSIT ABSOLUTE MONOTONY MON_INCREASE /end AXIS_DESCR
/end CHARACTERISTIC
/begin CHARACTERISTIC KL_POMTABBGLSHSZ32 "Schaltdruckoffset nach Umstellung einer HSZ in eine RSZ waehrend der GLS-Phase" CURVE 0x23A114 kl_si16_S6_S3 12 UMR_BAR__1_1000_0_S6_S3 -6 6
 /begin AXIS_DESCR STD_AXIS zff_atsys._.iSignale._.obj.sig_m_t UMR_NM__1_1_0_S6_S3 4 -400 1640 DEPOSIT ABSOLUTE MONOTONY MON_INCREASE /end AXIS_DESCR
/end CHARACTERISTIC
/begin CHARACTERISTIC KF_WTSGLS43 "Sollschleifzeit GLS" MAP 0x23A128 kf_ui8_S6_S3 2550 UMR_MSEC__10_1_0_S6_S3 0 2550
 /begin AXIS_DESCR STD_AXIS zff_atsys._.iSignale._.obj.sig_n_t8 UMR_U_MIN_32_1_0_S6_S3 4 0 8160 DEPOSIT ABSOLUTE MONOTONY MON_INCREASE /end AXIS_DESCR
 /begin AXIS_DESCR STD_AXIS zff_atsys._.iSignale._.obj.sig_m_t8 UMR_NM__8_1_M50_S6_S3 6 -400 1640 DEPOSIT ABSOLUTE MONOTONY MON_INCREASE /end AXIS_DESCR
/end CHARACTERISTIC
/begin CHARACTERISTIC KF_WTSGLS43_EL "Sollschleifzeit GLS" MAP 0x23A154 kf_ui8_S6_S3 2550 UMR_MSEC__10_1_0_S6_S3 0 2550
 /begin AXIS_DESCR STD_AXIS zff_atsys._.iSignale._.obj.sig_n_t8 UMR_U_MIN_32_1_0_S6_S3 4 0 8160 DEPOSIT ABSOLUTE MONOTONY MON_INCREASE /end AXIS_DESCR
 /begin AXIS_DESCR STD_AXIS zff_atsys._.iSignale._.obj.sig_m_t8 UMR_NM__8_1_M50_S6_S3 6 -400 1640 DEPOSIT ABSOLUTE MONOTONY MON_INCREASE /end AXIS_DESCR
/end CHARACTERISTIC
/begin CHARACTERISTIC KL_TVGLSKABCG43 "Verzoegerungszeit GLS-Beginn" CURVE 0x23A180 kl_ui8_S6_S3 2540 UMR_MSEC__10_1_0_S6_S3 0 2540
 /begin AXIS_DESCR STD_AXIS zff_atsys._.iSignale._.obj.sig_c_getr UMR_GRADC__1_1_M40_S6_S3 3 -40 150 DEPOSIT ABSOLUTE MONOTONY MON_INCREASE /end AXIS_DESCR
/end CHARACTERISTIC
/begin CHARACTERISTIC KL_TVGLSKABCG43_EL "Verzoegerungszeit GLS-Beginn" CURVE 0x23A18C kl_ui8_S6_S3 2540 UMR_MSEC__10_1_0_S6_S3 0 2540
 /begin AXIS_DESCR STD_AXIS zff_atsys._.iSignale._.obj.sig_c_getr UMR_GRADC__1_1_M40_S6_S3 3 -40 150 DEPOSIT ABSOLUTE MONOTONY MON_INCREASE /end AXIS_DESCR
/end CHARACTERISTIC
/begin CHARACTERISTIC KL_POMTABBGLSHSZ43 "Schaltdruckoffset nach Umstellung einer HSZ in eine RSZ waehrend der GLS-Phase" CURVE 0x23A198 kl_si16_S6_S3 12 UMR_BAR__1_1000_0_S6_S3 -6 6
 /begin AXIS_DESCR STD_AXIS zff_atsys._.iSignale._.obj.sig_m_t UMR_NM__1_1_0_S6_S3 4 -400 1640 DEPOSIT ABSOLUTE MONOTONY MON_INCREASE /end AXIS_DESCR
/end CHARACTERISTIC
/begin CHARACTERISTIC KF_WTSGLS54 "Sollschleifzeit GLS" MAP 0x23A1AC kf_ui8_S6_S3 2550 UMR_MSEC__10_1_0_S6_S3 0 2550
 /begin AXIS_DESCR STD_AXIS zff_atsys._.iSignale._.obj.sig_n_t8 UMR_U_MIN_32_1_0_S6_S3 4 0 8160 DEPOSIT ABSOLUTE MONOTONY MON_INCREASE /end AXIS_DESCR
 /begin AXIS_DESCR STD_AXIS zff_atsys._.iSignale._.obj.sig_m_t8 UMR_NM__8_1_M50_S6_S3 6 -400 1640 DEPOSIT ABSOLUTE MONOTONY MON_INCREASE /end AXIS_DESCR
/end CHARACTERISTIC
/begin CHARACTERISTIC KF_WTSGLS54_EL "Sollschleifzeit GLS" MAP 0x23A1D8 kf_ui8_S6_S3 2550 UMR_MSEC__10_1_0_S6_S3 0 2550
 /begin AXIS_DESCR STD_AXIS zff_atsys._.iSignale._.obj.sig_n_t8 UMR_U_MIN_32_1_0_S6_S3 4 0 8160 DEPOSIT ABSOLUTE MONOTONY MON_INCREASE /end AXIS_DESCR
 /begin AXIS_DESCR STD_AXIS zff_atsys._.iSignale._.obj.sig_m_t8 UMR_NM__8_1_M50_S6_S3 6 -400 1640 DEPOSIT ABSOLUTE MONOTONY MON_INCREASE /end AXIS_DESCR
/end CHARACTERISTIC
/begin CHARACTERISTIC KL_TVGLSKABCG54 "Verzoegerungszeit GLS-Beginn" CURVE 0x23A204 kl_ui8_S6_S3 2540 UMR_MSEC__10_1_0_S6_S3 0 2540
 /begin AXIS_DESCR STD_AXIS zff_atsys._.iSignale._.obj.sig_c_getr UMR_GRADC__1_1_M40_S6_S3 3 -40 150 DEPOSIT ABSOLUTE MONOTONY MON_INCREASE /end AXIS_DESCR
/end CHARACTERISTIC
/begin CHARACTERISTIC KL_TVGLSKABCG54_EL "Verzoegerungszeit GLS-Beginn" CURVE 0x23A210 kl_ui8_S6_S3 2540 UMR_MSEC__10_1_0_S6_S3 0 2540
 /begin AXIS_DESCR STD_AXIS zff_atsys._.iSignale._.obj.sig_c_getr UMR_GRADC__1_1_M40_S6_S3 3 -40 150 DEPOSIT ABSOLUTE MONOTONY MON_INCREASE /end AXIS_DESCR
/end CHARACTERISTIC
/begin CHARACTERISTIC KL_POMTABBGLSHSZ54 "Schaltdruckoffset nach Umstellung einer HSZ in eine RSZ waehrend der GLS-Phase" CURVE 0x23A21C kl_si16_S6_S3 12 UMR_BAR__1_1000_0_S6_S3 -6 6
 /begin AXIS_DESCR STD_AXIS zff_atsys._.iSignale._.obj.sig_m_t UMR_NM__1_1_0_S6_S3 4 -400 1640 DEPOSIT ABSOLUTE MONOTONY MON_INCREASE /end AXIS_DESCR
/end CHARACTERISTIC
/begin CHARACTERISTIC KF_WTSGLS65 "Sollschleifzeit GLS" MAP 0x23A230 kf_ui8_S6_S3 2550 UMR_MSEC__10_1_0_S6_S3 0 2550
 /begin AXIS_DESCR STD_AXIS zff_atsys._.iSignale._.obj.sig_n_t8 UMR_U_MIN_32_1_0_S6_S3 4 0 8160 DEPOSIT ABSOLUTE MONOTONY MON_INCREASE /end AXIS_DESCR
 /begin AXIS_DESCR STD_AXIS zff_atsys._.iSignale._.obj.sig_m_t8 UMR_NM__8_1_M50_S6_S3 6 -400 1640 DEPOSIT ABSOLUTE MONOTONY MON_INCREASE /end AXIS_DESCR
/end CHARACTERISTIC
/begin CHARACTERISTIC KF_WTSGLS65_EL "Sollschleifzeit GLS" MAP 0x23A25C kf_ui8_S6_S3 2550 UMR_MSEC__10_1_0_S6_S3 0 2550
 /begin AXIS_DESCR STD_AXIS zff_atsys._.iSignale._.obj.sig_n_t8 UMR_U_MIN_32_1_0_S6_S3 4 0 8160 DEPOSIT ABSOLUTE MONOTONY MON_INCREASE /end AXIS_DESCR
 /begin AXIS_DESCR STD_AXIS zff_atsys._.iSignale._.obj.sig_m_t8 UMR_NM__8_1_M50_S6_S3 6 -400 1640 DEPOSIT ABSOLUTE MONOTONY MON_INCREASE /end AXIS_DESCR
/end CHARACTERISTIC
/begin CHARACTERISTIC KL_TVGLSKABCG65 "Verzoegerungszeit GLS-Beginn" CURVE 0x23A288 kl_ui8_S6_S3 2540 UMR_MSEC__10_1_0_S6_S3 0 2540
 /begin AXIS_DESCR STD_AXIS zff_atsys._.iSignale._.obj.sig_c_getr UMR_GRADC__1_1_M40_S6_S3 3 -40 150 DEPOSIT ABSOLUTE MONOTONY MON_INCREASE /end AXIS_DESCR
/end CHARACTERISTIC
/begin CHARACTERISTIC KL_TVGLSKABCG65_EL "Verzoegerungszeit GLS-Beginn" CURVE 0x23A294 kl_ui8_S6_S3 2540 UMR_MSEC__10_1_0_S6_S3 0 2540
 /begin AXIS_DESCR STD_AXIS zff_atsys._.iSignale._.obj.sig_c_getr UMR_GRADC__1_1_M40_S6_S3 3 -40 150 DEPOSIT ABSOLUTE MONOTONY MON_INCREASE /end AXIS_DESCR
/end CHARACTERISTIC
/begin CHARACTERISTIC KL_POMTABBGLSHSZ65 "Schaltdruckoffset nach Umstellung einer HSZ in eine RSZ waehrend der GLS-Phase" CURVE 0x23A2A0 kl_si16_S6_S3 12 UMR_BAR__1_1000_0_S6_S3 -6 6
 /begin AXIS_DESCR STD_AXIS zff_atsys._.iSignale._.obj.sig_m_t UMR_NM__1_1_0_S6_S3 4 -400 1640 DEPOSIT ABSOLUTE MONOTONY MON_INCREASE /end AXIS_DESCR
/end CHARACTERISTIC
/begin CHARACTERISTIC KF_WTSGLS76 "Sollschleifzeit GLS" MAP 0x23A2B4 kf_ui8_S6_S3 2550 UMR_MSEC__10_1_0_S6_S3 0 2550
 /begin AXIS_DESCR STD_AXIS zff_atsys._.iSignale._.obj.sig_n_t8 UMR_U_MIN_32_1_0_S6_S3 4 0 8160 DEPOSIT ABSOLUTE MONOTONY MON_INCREASE /end AXIS_DESCR
 /begin AXIS_DESCR STD_AXIS zff_atsys._.iSignale._.obj.sig_m_t8 UMR_NM__8_1_M50_S6_S3 6 -400 1640 DEPOSIT ABSOLUTE MONOTONY MON_INCREASE /end AXIS_DESCR
/end CHARACTERISTIC
/begin CHARACTERISTIC KF_WTSGLS76_EL "Sollschleifzeit GLS" MAP 0x23A2E0 kf_ui8_S6_S3 2550 UMR_MSEC__10_1_0_S6_S3 0 2550
 /begin AXIS_DESCR STD_AXIS zff_atsys._.iSignale._.obj.sig_n_t8 UMR_U_MIN_32_1_0_S6_S3 4 0 8160 DEPOSIT ABSOLUTE MONOTONY MON_INCREASE /end AXIS_DESCR
 /begin AXIS_DESCR STD_AXIS zff_atsys._.iSignale._.obj.sig_m_t8 UMR_NM__8_1_M50_S6_S3 6 -400 1640 DEPOSIT ABSOLUTE MONOTONY MON_INCREASE /end AXIS_DESCR
/end CHARACTERISTIC
/begin CHARACTERISTIC KL_TVGLSKABCG76 "Verzoegerungszeit GLS-Beginn" CURVE 0x23A30C kl_ui8_S6_S3 2540 UMR_MSEC__10_1_0_S6_S3 0 2540
 /begin AXIS_DESCR STD_AXIS zff_atsys._.iSignale._.obj.sig_c_getr UMR_GRADC__1_1_M40_S6_S3 3 -40 150 DEPOSIT ABSOLUTE MONOTONY MON_INCREASE /end AXIS_DESCR
/end CHARACTERISTIC
/begin CHARACTERISTIC KL_TVGLSKABCG76_EL "Verzoegerungszeit GLS-Beginn" CURVE 0x23A318 kl_ui8_S6_S3 2540 UMR_MSEC__10_1_0_S6_S3 0 2540
 /begin AXIS_DESCR STD_AXIS zff_atsys._.iSignale._.obj.sig_c_getr UMR_GRADC__1_1_M40_S6_S3 3 -40 150 DEPOSIT ABSOLUTE MONOTONY MON_INCREASE /end AXIS_DESCR
/end CHARACTERISTIC
/begin CHARACTERISTIC KL_POMTABBGLSHSZ76 "Schaltdruckoffset nach Umstellung einer HSZ in eine RSZ waehrend der GLS-Phase" CURVE 0x23A324 kl_si16_S6_S3 12 UMR_BAR__1_1000_0_S6_S3 -6 6
 /begin AXIS_DESCR STD_AXIS zff_atsys._.iSignale._.obj.sig_m_t UMR_NM__1_1_0_S6_S3 4 -400 1640 DEPOSIT ABSOLUTE MONOTONY MON_INCREASE /end AXIS_DESCR
/end CHARACTERISTIC
/begin CHARACTERISTIC KF_WTSGLS87 "Sollschleifzeit GLS" MAP 0x23A338 kf_ui8_S6_S3 2550 UMR_MSEC__10_1_0_S6_S3 0 2550
 /begin AXIS_DESCR STD_AXIS zff_atsys._.iSignale._.obj.sig_n_t8 UMR_U_MIN_32_1_0_S6_S3 4 0 8160 DEPOSIT ABSOLUTE MONOTONY MON_INCREASE /end AXIS_DESCR
 /begin AXIS_DESCR STD_AXIS zff_atsys._.iSignale._.obj.sig_m_t8 UMR_NM__8_1_M50_S6_S3 6 -400 1640 DEPOSIT ABSOLUTE MONOTONY MON_INCREASE /end AXIS_DESCR
/end CHARACTERISTIC
/begin CHARACTERISTIC KF_WTSGLS87_EL "Sollschleifzeit GLS" MAP 0x23A364 kf_ui8_S6_S3 2550 UMR_MSEC__10_1_0_S6_S3 0 2550
 /begin AXIS_DESCR STD_AXIS zff_atsys._.iSignale._.obj.sig_n_t8 UMR_U_MIN_32_1_0_S6_S3 4 0 8160 DEPOSIT ABSOLUTE MONOTONY MON_INCREASE /end AXIS_DESCR
 /begin AXIS_DESCR STD_AXIS zff_atsys._.iSignale._.obj.sig_m_t8 UMR_NM__8_1_M50_S6_S3 6 -400 1640 DEPOSIT ABSOLUTE MONOTONY MON_INCREASE /end AXIS_DESCR
/end CHARACTERISTIC
/begin CHARACTERISTIC KL_TVGLSKABCG87 "Verzoegerungszeit GLS-Beginn" CURVE 0x23A390 kl_ui8_S6_S3 2540 UMR_MSEC__10_1_0_S6_S3 0 2540
 /begin AXIS_DESCR STD_AXIS zff_atsys._.iSignale._.obj.sig_c_getr UMR_GRADC__1_1_M40_S6_S3 3 -40 150 DEPOSIT ABSOLUTE MONOTONY MON_INCREASE /end AXIS_DESCR
/end CHARACTERISTIC
/begin CHARACTERISTIC KL_TVGLSKABCG87_EL "Verzoegerungszeit GLS-Beginn" CURVE 0x23A39C kl_ui8_S6_S3 2540 UMR_MSEC__10_1_0_S6_S3 0 2540
 /begin AXIS_DESCR STD_AXIS zff_atsys._.iSignale._.obj.sig_c_getr UMR_GRADC__1_1_M40_S6_S3 3 -40 150 DEPOSIT ABSOLUTE MONOTONY MON_INCREASE /end AXIS_DESCR
/end CHARACTERISTIC
/begin CHARACTERISTIC KL_POMTABBGLSHSZ87 "Schaltdruckoffset nach Umstellung einer HSZ in eine RSZ waehrend der GLS-Phase" CURVE 0x23A3A8 kl_si16_S6_S3 12 UMR_BAR__1_1000_0_S6_S3 -6 6
 /begin AXIS_DESCR STD_AXIS zff_atsys._.iSignale._.obj.sig_m_t UMR_NM__1_1_0_S6_S3 4 -400 1640 DEPOSIT ABSOLUTE MONOTONY MON_INCREASE /end AXIS_DESCR
/end CHARACTERISTIC
/begin CHARACTERISTIC KF_WTSGLSSP21 "Sollschleifzeit GLS" MAP 0x23A3BC kf_ui8_S6_S3 2550 UMR_MSEC__10_1_0_S6_S3 0 2550
 /begin AXIS_DESCR STD_AXIS zff_atsys._.iSignale._.obj.sig_n_t8 UMR_U_MIN_32_1_0_S6_S3 4 0 8160 DEPOSIT ABSOLUTE MONOTONY MON_INCREASE /end AXIS_DESCR
 /begin AXIS_DESCR STD_AXIS zff_atsys._.iSignale._.obj.sig_m_t8 UMR_NM__8_1_M50_S6_S3 6 -400 1640 DEPOSIT ABSOLUTE MONOTONY MON_INCREASE /end AXIS_DESCR
/end CHARACTERISTIC
/begin CHARACTERISTIC KL_TVGLSKABCGSP21 "Verzoegerungszeit GLS-Beginn" CURVE 0x23A3E8 kl_ui8_S6_S3 2540 UMR_MSEC__10_1_0_S6_S3 0 2540
 /begin AXIS_DESCR STD_AXIS zff_atsys._.iSignale._.obj.sig_c_getr UMR_GRADC__1_1_M40_S6_S3 3 -40 150 DEPOSIT ABSOLUTE MONOTONY MON_INCREASE /end AXIS_DESCR
/end CHARACTERISTIC
/begin CHARACTERISTIC KL_POMTABBGLSHSZSP21 "Schaltdruckoffset nach Umstellung einer HSZ in eine RSZ waehrend der GLS-Phase" CURVE 0x23A3F4 kl_si16_S6_S3 12 UMR_BAR__1_1000_0_S6_S3 -6 6
 /begin AXIS_DESCR STD_AXIS zff_atsys._.iSignale._.obj.sig_m_t UMR_NM__1_1_0_S6_S3 4 -400 1640 DEPOSIT ABSOLUTE MONOTONY MON_INCREASE /end AXIS_DESCR
/end CHARACTERISTIC
/begin CHARACTERISTIC KF_WTSGLSSP32 "Sollschleifzeit GLS" MAP 0x23A408 kf_ui8_S6_S3 2550 UMR_MSEC__10_1_0_S6_S3 0 2550
 /begin AXIS_DESCR STD_AXIS zff_atsys._.iSignale._.obj.sig_n_t8 UMR_U_MIN_32_1_0_S6_S3 4 0 8160 DEPOSIT ABSOLUTE MONOTONY MON_INCREASE /end AXIS_DESCR
 /begin AXIS_DESCR STD_AXIS zff_atsys._.iSignale._.obj.sig_m_t8 UMR_NM__8_1_M50_S6_S3 6 -400 1640 DEPOSIT ABSOLUTE MONOTONY MON_INCREASE /end AXIS_DESCR
/end CHARACTERISTIC
/begin CHARACTERISTIC KL_TVGLSKABCGSP32 "Verzoegerungszeit GLS-Beginn" CURVE 0x23A434 kl_ui8_S6_S3 2540 UMR_MSEC__10_1_0_S6_S3 0 2540
 /begin AXIS_DESCR STD_AXIS zff_atsys._.iSignale._.obj.sig_c_getr UMR_GRADC__1_1_M40_S6_S3 3 -40 150 DEPOSIT ABSOLUTE MONOTONY MON_INCREASE /end AXIS_DESCR
/end CHARACTERISTIC
/begin CHARACTERISTIC KL_POMTABBGLSHSZSP32 "Schaltdruckoffset nach Umstellung einer HSZ in eine RSZ waehrend der GLS-Phase" CURVE 0x23A440 kl_si16_S6_S3 12 UMR_BAR__1_1000_0_S6_S3 -6 6
 /begin AXIS_DESCR STD_AXIS zff_atsys._.iSignale._.obj.sig_m_t UMR_NM__1_1_0_S6_S3 4 -400 1640 DEPOSIT ABSOLUTE MONOTONY MON_INCREASE /end AXIS_DESCR
/end CHARACTERISTIC
/begin CHARACTERISTIC KF_WTSGLSSP43 "Sollschleifzeit GLS" MAP 0x23A454 kf_ui8_S6_S3 2550 UMR_MSEC__10_1_0_S6_S3 0 2550
 /begin AXIS_DESCR STD_AXIS zff_atsys._.iSignale._.obj.sig_n_t8 UMR_U_MIN_32_1_0_S6_S3 4 0 8160 DEPOSIT ABSOLUTE MONOTONY MON_INCREASE /end AXIS_DESCR
 /begin AXIS_DESCR STD_AXIS zff_atsys._.iSignale._.obj.sig_m_t8 UMR_NM__8_1_M50_S6_S3 6 -400 1640 DEPOSIT ABSOLUTE MONOTONY MON_INCREASE /end AXIS_DESCR
/end CHARACTERISTIC
/begin CHARACTERISTIC KL_TVGLSKABCGSP43 "Verzoegerungszeit GLS-Beginn" CURVE 0x23A480 kl_ui8_S6_S3 2540 UMR_MSEC__10_1_0_S6_S3 0 2540
 /begin AXIS_DESCR STD_AXIS zff_atsys._.iSignale._.obj.sig_c_getr UMR_GRADC__1_1_M40_S6_S3 3 -40 150 DEPOSIT ABSOLUTE MONOTONY MON_INCREASE /end AXIS_DESCR
/end CHARACTERISTIC
/begin CHARACTERISTIC KL_POMTABBGLSHSZSP43 "Schaltdruckoffset nach Umstellung einer HSZ in eine RSZ waehrend der GLS-Phase" CURVE 0x23A48C kl_si16_S6_S3 12 UMR_BAR__1_1000_0_S6_S3 -6 6
 /begin AXIS_DESCR STD_AXIS zff_atsys._.iSignale._.obj.sig_m_t UMR_NM__1_1_0_S6_S3 4 -400 1640 DEPOSIT ABSOLUTE MONOTONY MON_INCREASE /end AXIS_DESCR
/end CHARACTERISTIC
/begin CHARACTERISTIC KF_WTSGLSSP54 "Sollschleifzeit GLS" MAP 0x23A4A0 kf_ui8_S6_S3 2550 UMR_MSEC__10_1_0_S6_S3 0 2550
 /begin AXIS_DESCR STD_AXIS zff_atsys._.iSignale._.obj.sig_n_t8 UMR_U_MIN_32_1_0_S6_S3 4 0 8160 DEPOSIT ABSOLUTE MONOTONY MON_INCREASE /end AXIS_DESCR
 /begin AXIS_DESCR STD_AXIS zff_atsys._.iSignale._.obj.sig_m_t8 UMR_NM__8_1_M50_S6_S3 6 -400 1640 DEPOSIT ABSOLUTE MONOTONY MON_INCREASE /end AXIS_DESCR
/end CHARACTERISTIC
/begin CHARACTERISTIC KL_TVGLSKABCGSP54 "Verzoegerungszeit GLS-Beginn" CURVE 0x23A4CC kl_ui8_S6_S3 2540 UMR_MSEC__10_1_0_S6_S3 0 2540
 /begin AXIS_DESCR STD_AXIS zff_atsys._.iSignale._.obj.sig_c_getr UMR_GRADC__1_1_M40_S6_S3 3 -40 150 DEPOSIT ABSOLUTE MONOTONY MON_INCREASE /end AXIS_DESCR
/end CHARACTERISTIC
/begin CHARACTERISTIC KL_POMTABBGLSHSZSP54 "Schaltdruckoffset nach Umstellung einer HSZ in eine RSZ waehrend der GLS-Phase" CURVE 0x23A4D8 kl_si16_S6_S3 12 UMR_BAR__1_1000_0_S6_S3 -6 6
 /begin AXIS_DESCR STD_AXIS zff_atsys._.iSignale._.obj.sig_m_t UMR_NM__1_1_0_S6_S3 4 -400 1640 DEPOSIT ABSOLUTE MONOTONY MON_INCREASE /end AXIS_DESCR
/end CHARACTERISTIC
/begin CHARACTERISTIC KF_WTSGLSSP65 "Sollschleifzeit GLS" MAP 0x23A4EC kf_ui8_S6_S3 2550 UMR_MSEC__10_1_0_S6_S3 0 2550
 /begin AXIS_DESCR STD_AXIS zff_atsys._.iSignale._.obj.sig_n_t8 UMR_U_MIN_32_1_0_S6_S3 4 0 8160 DEPOSIT ABSOLUTE MONOTONY MON_INCREASE /end AXIS_DESCR
 /begin AXIS_DESCR STD_AXIS zff_atsys._.iSignale._.obj.sig_m_t8 UMR_NM__8_1_M50_S6_S3 6 -400 1640 DEPOSIT ABSOLUTE MONOTONY MON_INCREASE /end AXIS_DESCR
/end CHARACTERISTIC
/begin CHARACTERISTIC KL_TVGLSKABCGSP65 "Verzoegerungszeit GLS-Beginn" CURVE 0x23A518 kl_ui8_S6_S3 2540 UMR_MSEC__10_1_0_S6_S3 0 2540
 /begin AXIS_DESCR STD_AXIS zff_atsys._.iSignale._.obj.sig_c_getr UMR_GRADC__1_1_M40_S6_S3 3 -40 150 DEPOSIT ABSOLUTE MONOTONY MON_INCREASE /end AXIS_DESCR
/end CHARACTERISTIC
/begin CHARACTERISTIC KL_POMTABBGLSHSZSP65 "Schaltdruckoffset nach Umstellung einer HSZ in eine RSZ waehrend der GLS-Phase" CURVE 0x23A524 kl_si16_S6_S3 12 UMR_BAR__1_1000_0_S6_S3 -6 6
 /begin AXIS_DESCR STD_AXIS zff_atsys._.iSignale._.obj.sig_m_t UMR_NM__1_1_0_S6_S3 4 -400 1640 DEPOSIT ABSOLUTE MONOTONY MON_INCREASE /end AXIS_DESCR
/end CHARACTERISTIC
/begin CHARACTERISTIC KF_WTSGLSSP76 "Sollschleifzeit GLS" MAP 0x23A538 kf_ui8_S6_S3 2550 UMR_MSEC__10_1_0_S6_S3 0 2550
 /begin AXIS_DESCR STD_AXIS zff_atsys._.iSignale._.obj.sig_n_t8 UMR_U_MIN_32_1_0_S6_S3 4 0 8160 DEPOSIT ABSOLUTE MONOTONY MON_INCREASE /end AXIS_DESCR
 /begin AXIS_DESCR STD_AXIS zff_atsys._.iSignale._.obj.sig_m_t8 UMR_NM__8_1_M50_S6_S3 6 -400 1640 DEPOSIT ABSOLUTE MONOTONY MON_INCREASE /end AXIS_DESCR
/end CHARACTERISTIC
/begin CHARACTERISTIC KL_TVGLSKABCGSP76 "Verzoegerungszeit GLS-Beginn" CURVE 0x23A564 kl_ui8_S6_S3 2540 UMR_MSEC__10_1_0_S6_S3 0 2540
 /begin AXIS_DESCR STD_AXIS zff_atsys._.iSignale._.obj.sig_c_getr UMR_GRADC__1_1_M40_S6_S3 3 -40 150 DEPOSIT ABSOLUTE MONOTONY MON_INCREASE /end AXIS_DESCR
/end CHARACTERISTIC
/begin CHARACTERISTIC KL_POMTABBGLSHSZSP76 "Schaltdruckoffset nach Umstellung einer HSZ in eine RSZ waehrend der GLS-Phase" CURVE 0x23A570 kl_si16_S6_S3 12 UMR_BAR__1_1000_0_S6_S3 -6 6
 /begin AXIS_DESCR STD_AXIS zff_atsys._.iSignale._.obj.sig_m_t UMR_NM__1_1_0_S6_S3 4 -400 1640 DEPOSIT ABSOLUTE MONOTONY MON_INCREASE /end AXIS_DESCR
/end CHARACTERISTIC
/begin CHARACTERISTIC KF_WTSGLSSP87 "Sollschleifzeit GLS" MAP 0x23A584 kf_ui8_S6_S3 2550 UMR_MSEC__10_1_0_S6_S3 0 2550
 /begin AXIS_DESCR STD_AXIS zff_atsys._.iSignale._.obj.sig_n_t8 UMR_U_MIN_32_1_0_S6_S3 4 0 8160 DEPOSIT ABSOLUTE MONOTONY MON_INCREASE /end AXIS_DESCR
 /begin AXIS_DESCR STD_AXIS zff_atsys._.iSignale._.obj.sig_m_t8 UMR_NM__8_1_M50_S6_S3 6 -400 1640 DEPOSIT ABSOLUTE MONOTONY MON_INCREASE /end AXIS_DESCR
/end CHARACTERISTIC
/begin CHARACTERISTIC KL_TVGLSKABCGSP87 "Verzoegerungszeit GLS-Beginn" CURVE 0x23A5B0 kl_ui8_S6_S3 2540 UMR_MSEC__10_1_0_S6_S3 0 2540
 /begin AXIS_DESCR STD_AXIS zff_atsys._.iSignale._.obj.sig_c_getr UMR_GRADC__1_1_M40_S6_S3 3 -40 150 DEPOSIT ABSOLUTE MONOTONY MON_INCREASE /end AXIS_DESCR
/end CHARACTERISTIC
/begin CHARACTERISTIC KL_POMTABBGLSHSZSP87 "Schaltdruckoffset nach Umstellung einer HSZ in eine RSZ waehrend der GLS-Phase" CURVE 0x23A5BC kl_si16_S6_S3 12 UMR_BAR__1_1000_0_S6_S3 -6 6
 /begin AXIS_DESCR STD_AXIS zff_atsys._.iSignale._.obj.sig_m_t UMR_NM__1_1_0_S6_S3 4 -400 1640 DEPOSIT ABSOLUTE MONOTONY MON_INCREASE /end AXIS_DESCR
/end CHARACTERISTIC
/begin CHARACTERISTIC KF_WTSGLSSP31 "Sollschleifzeit GLS" MAP 0x23A5D0 kf_ui8_S6_S3 2550 UMR_MSEC__10_1_0_S6_S3 0 2550
 /begin AXIS_DESCR STD_AXIS zff_atsys._.iSignale._.obj.sig_n_t8 UMR_U_MIN_32_1_0_S6_S3 4 0 8160 DEPOSIT ABSOLUTE MONOTONY MON_INCREASE /end AXIS_DESCR
 /begin AXIS_DESCR STD_AXIS zff_atsys._.iSignale._.obj.sig_m_t8 UMR_NM__8_1_M50_S6_S3 6 -400 1640 DEPOSIT ABSOLUTE MONOTONY MON_INCREASE /end AXIS_DESCR
/end CHARACTERISTIC
/begin CHARACTERISTIC KL_TVGLSKABCGSP31 "Verzoegerungszeit GLS-Beginn" CURVE 0x23A5FC kl_ui8_S6_S3 2540 UMR_MSEC__10_1_0_S6_S3 0 2540
 /begin AXIS_DESCR STD_AXIS zff_atsys._.iSignale._.obj.sig_c_getr UMR_GRADC__1_1_M40_S6_S3 3 -40 150 DEPOSIT ABSOLUTE MONOTONY MON_INCREASE /end AXIS_DESCR
/end CHARACTERISTIC
/begin CHARACTERISTIC KL_POMTABBGLSHSZSP31 "Schaltdruckoffset nach Umstellung einer HSZ in eine RSZ waehrend der GLS-Phase" CURVE 0x23A608 kl_si16_S6_S3 12 UMR_BAR__1_1000_0_S6_S3 -6 6
 /begin AXIS_DESCR STD_AXIS zff_atsys._.iSignale._.obj.sig_m_t UMR_NM__1_1_0_S6_S3 4 -400 1640 DEPOSIT ABSOLUTE MONOTONY MON_INCREASE /end AXIS_DESCR
/end CHARACTERISTIC
/begin CHARACTERISTIC KF_WTSGLSSP42 "Sollschleifzeit GLS" MAP 0x23A61C kf_ui8_S6_S3 2550 UMR_MSEC__10_1_0_S6_S3 0 2550
 /begin AXIS_DESCR STD_AXIS zff_atsys._.iSignale._.obj.sig_n_t8 UMR_U_MIN_32_1_0_S6_S3 4 0 8160 DEPOSIT ABSOLUTE MONOTONY MON_INCREASE /end AXIS_DESCR
 /begin AXIS_DESCR STD_AXIS zff_atsys._.iSignale._.obj.sig_m_t8 UMR_NM__8_1_M50_S6_S3 6 -400 1640 DEPOSIT ABSOLUTE MONOTONY MON_INCREASE /end AXIS_DESCR
/end CHARACTERISTIC
/begin CHARACTERISTIC KF_WTSGLSSP42_EL "Sollschleifzeit GLS" MAP 0x23A648 kf_ui8_S6_S3 2550 UMR_MSEC__10_1_0_S6_S3 0 2550
 /begin AXIS_DESCR STD_AXIS zff_atsys._.iSignale._.obj.sig_n_t8 UMR_U_MIN_32_1_0_S6_S3 4 0 8160 DEPOSIT ABSOLUTE MONOTONY MON_INCREASE /end AXIS_DESCR
 /begin AXIS_DESCR STD_AXIS zff_atsys._.iSignale._.obj.sig_m_t8 UMR_NM__8_1_M50_S6_S3 6 -400 1640 DEPOSIT ABSOLUTE MONOTONY MON_INCREASE /end AXIS_DESCR
/end CHARACTERISTIC
/begin CHARACTERISTIC KL_TVGLSKABCGSP42 "Verzoegerungszeit GLS-Beginn" CURVE 0x23A674 kl_ui8_S6_S3 2540 UMR_MSEC__10_1_0_S6_S3 0 2540
 /begin AXIS_DESCR STD_AXIS zff_atsys._.iSignale._.obj.sig_c_getr UMR_GRADC__1_1_M40_S6_S3 3 -40 150 DEPOSIT ABSOLUTE MONOTONY MON_INCREASE /end AXIS_DESCR
/end CHARACTERISTIC
/begin CHARACTERISTIC KL_TVGLSKABCGSP42_EL "Verzoegerungszeit GLS-Beginn" CURVE 0x23A680 kl_ui8_S6_S3 2540 UMR_MSEC__10_1_0_S6_S3 0 2540
 /begin AXIS_DESCR STD_AXIS zff_atsys._.iSignale._.obj.sig_c_getr UMR_GRADC__1_1_M40_S6_S3 3 -40 150 DEPOSIT ABSOLUTE MONOTONY MON_INCREASE /end AXIS_DESCR
/end CHARACTERISTIC
/begin CHARACTERISTIC KL_POMTABBGLSHSZSP42 "Schaltdruckoffset nach Umstellung einer HSZ in eine RSZ waehrend der GLS-Phase" CURVE 0x23A68C kl_si16_S6_S3 12 UMR_BAR__1_1000_0_S6_S3 -6 6
 /begin AXIS_DESCR STD_AXIS zff_atsys._.iSignale._.obj.sig_m_t UMR_NM__1_1_0_S6_S3 4 -400 1640 DEPOSIT ABSOLUTE MONOTONY MON_INCREASE /end AXIS_DESCR
/end CHARACTERISTIC
/begin CHARACTERISTIC KF_WTSGLSSP51 "Sollschleifzeit GLS" MAP 0x23A6A0 kf_ui8_S6_S3 2550 UMR_MSEC__10_1_0_S6_S3 0 2550
 /begin AXIS_DESCR STD_AXIS zff_atsys._.iSignale._.obj.sig_n_t8 UMR_U_MIN_32_1_0_S6_S3 4 0 8160 DEPOSIT ABSOLUTE MONOTONY MON_INCREASE /end AXIS_DESCR
 /begin AXIS_DESCR STD_AXIS zff_atsys._.iSignale._.obj.sig_m_t8 UMR_NM__8_1_M50_S6_S3 6 -400 1640 DEPOSIT ABSOLUTE MONOTONY MON_INCREASE /end AXIS_DESCR
/end CHARACTERISTIC
/begin CHARACTERISTIC KL_TVGLSKABCGSP51 "Verzoegerungszeit GLS-Beginn" CURVE 0x23A6CC kl_ui8_S6_S3 2540 UMR_MSEC__10_1_0_S6_S3 0 2540
 /begin AXIS_DESCR STD_AXIS zff_atsys._.iSignale._.obj.sig_c_getr UMR_GRADC__1_1_M40_S6_S3 3 -40 150 DEPOSIT ABSOLUTE MONOTONY MON_INCREASE /end AXIS_DESCR
/end CHARACTERISTIC
/begin CHARACTERISTIC KL_POMTABBGLSHSZSP51 "Schaltdruckoffset nach Umstellung einer HSZ in eine RSZ waehrend der GLS-Phase" CURVE 0x23A6D8 kl_si16_S6_S3 12 UMR_BAR__1_1000_0_S6_S3 -6 6
 /begin AXIS_DESCR STD_AXIS zff_atsys._.iSignale._.obj.sig_m_t UMR_NM__1_1_0_S6_S3 4 -400 1640 DEPOSIT ABSOLUTE MONOTONY MON_INCREASE /end AXIS_DESCR
/end CHARACTERISTIC
/begin CHARACTERISTIC KF_WTSGLSSP53 "Sollschleifzeit GLS" MAP 0x23A6EC kf_ui8_S6_S3 2550 UMR_MSEC__10_1_0_S6_S3 0 2550
 /begin AXIS_DESCR STD_AXIS zff_atsys._.iSignale._.obj.sig_n_t8 UMR_U_MIN_32_1_0_S6_S3 4 0 8160 DEPOSIT ABSOLUTE MONOTONY MON_INCREASE /end AXIS_DESCR
 /begin AXIS_DESCR STD_AXIS zff_atsys._.iSignale._.obj.sig_m_t8 UMR_NM__8_1_M50_S6_S3 6 -400 1640 DEPOSIT ABSOLUTE MONOTONY MON_INCREASE /end AXIS_DESCR
/end CHARACTERISTIC
/begin CHARACTERISTIC KF_WTSGLSSP53_EL "Sollschleifzeit GLS" MAP 0x23A718 kf_ui8_S6_S3 2550 UMR_MSEC__10_1_0_S6_S3 0 2550
 /begin AXIS_DESCR STD_AXIS zff_atsys._.iSignale._.obj.sig_n_t8 UMR_U_MIN_32_1_0_S6_S3 4 0 8160 DEPOSIT ABSOLUTE MONOTONY MON_INCREASE /end AXIS_DESCR
 /begin AXIS_DESCR STD_AXIS zff_atsys._.iSignale._.obj.sig_m_t8 UMR_NM__8_1_M50_S6_S3 6 -400 1640 DEPOSIT ABSOLUTE MONOTONY MON_INCREASE /end AXIS_DESCR
/end CHARACTERISTIC
/begin CHARACTERISTIC KL_TVGLSKABCGSP53 "Verzoegerungszeit GLS-Beginn" CURVE 0x23A744 kl_ui8_S6_S3 2540 UMR_MSEC__10_1_0_S6_S3 0 2540
 /begin AXIS_DESCR STD_AXIS zff_atsys._.iSignale._.obj.sig_c_getr UMR_GRADC__1_1_M40_S6_S3 3 -40 150 DEPOSIT ABSOLUTE MONOTONY MON_INCREASE /end AXIS_DESCR
/end CHARACTERISTIC
/begin CHARACTERISTIC KL_TVGLSKABCGSP53_EL "Verzoegerungszeit GLS-Beginn" CURVE 0x23A750 kl_ui8_S6_S3 2540 UMR_MSEC__10_1_0_S6_S3 0 2540
 /begin AXIS_DESCR STD_AXIS zff_atsys._.iSignale._.obj.sig_c_getr UMR_GRADC__1_1_M40_S6_S3 3 -40 150 DEPOSIT ABSOLUTE MONOTONY MON_INCREASE /end AXIS_DESCR
/end CHARACTERISTIC
/begin CHARACTERISTIC KL_POMTABBGLSHSZSP53 "Schaltdruckoffset nach Umstellung einer HSZ in eine RSZ waehrend der GLS-Phase" CURVE 0x23A75C kl_si16_S6_S3 12 UMR_BAR__1_1000_0_S6_S3 -6 6
 /begin AXIS_DESCR STD_AXIS zff_atsys._.iSignale._.obj.sig_m_t UMR_NM__1_1_0_S6_S3 4 -400 1640 DEPOSIT ABSOLUTE MONOTONY MON_INCREASE /end AXIS_DESCR
/end CHARACTERISTIC
/begin CHARACTERISTIC KF_WTSGLSSP63 "Sollschleifzeit GLS" MAP 0x23A770 kf_ui8_S6_S3 2550 UMR_MSEC__10_1_0_S6_S3 0 2550
 /begin AXIS_DESCR STD_AXIS zff_atsys._.iSignale._.obj.sig_n_t8 UMR_U_MIN_32_1_0_S6_S3 4 0 8160 DEPOSIT ABSOLUTE MONOTONY MON_INCREASE /end AXIS_DESCR
 /begin AXIS_DESCR STD_AXIS zff_atsys._.iSignale._.obj.sig_m_t8 UMR_NM__8_1_M50_S6_S3 6 -400 1640 DEPOSIT ABSOLUTE MONOTONY MON_INCREASE /end AXIS_DESCR
/end CHARACTERISTIC
/begin CHARACTERISTIC KF_WTSGLSSP63_EL "Sollschleifzeit GLS" MAP 0x23A79C kf_ui8_S6_S3 2550 UMR_MSEC__10_1_0_S6_S3 0 2550
 /begin AXIS_DESCR STD_AXIS zff_atsys._.iSignale._.obj.sig_n_t8 UMR_U_MIN_32_1_0_S6_S3 4 0 8160 DEPOSIT ABSOLUTE MONOTONY MON_INCREASE /end AXIS_DESCR
 /begin AXIS_DESCR STD_AXIS zff_atsys._.iSignale._.obj.sig_m_t8 UMR_NM__8_1_M50_S6_S3 6 -400 1640 DEPOSIT ABSOLUTE MONOTONY MON_INCREASE /end AXIS_DESCR
/end CHARACTERISTIC
/begin CHARACTERISTIC KL_TVGLSKABCGSP63 "Verzoegerungszeit GLS-Beginn" CURVE 0x23A7C8 kl_ui8_S6_S3 2540 UMR_MSEC__10_1_0_S6_S3 0 2540
 /begin AXIS_DESCR STD_AXIS zff_atsys._.iSignale._.obj.sig_c_getr UMR_GRADC__1_1_M40_S6_S3 3 -40 150 DEPOSIT ABSOLUTE MONOTONY MON_INCREASE /end AXIS_DESCR
/end CHARACTERISTIC
/begin CHARACTERISTIC KL_TVGLSKABCGSP63_EL "Verzoegerungszeit GLS-Beginn" CURVE 0x23A7D4 kl_ui8_S6_S3 2540 UMR_MSEC__10_1_0_S6_S3 0 2540
 /begin AXIS_DESCR STD_AXIS zff_atsys._.iSignale._.obj.sig_c_getr UMR_GRADC__1_1_M40_S6_S3 3 -40 150 DEPOSIT ABSOLUTE MONOTONY MON_INCREASE /end AXIS_DESCR
/end CHARACTERISTIC
/begin CHARACTERISTIC KL_POMTABBGLSHSZSP63 "Schaltdruckoffset nach Umstellung einer HSZ in eine RSZ waehrend der GLS-Phase" CURVE 0x23A7E0 kl_si16_S6_S3 12 UMR_BAR__1_1000_0_S6_S3 -6 6
 /begin AXIS_DESCR STD_AXIS zff_atsys._.iSignale._.obj.sig_m_t UMR_NM__1_1_0_S6_S3 4 -400 1640 DEPOSIT ABSOLUTE MONOTONY MON_INCREASE /end AXIS_DESCR
/end CHARACTERISTIC
/begin CHARACTERISTIC KF_WTSGLSSP64 "Sollschleifzeit GLS" MAP 0x23A7F4 kf_ui8_S6_S3 2550 UMR_MSEC__10_1_0_S6_S3 0 2550
 /begin AXIS_DESCR STD_AXIS zff_atsys._.iSignale._.obj.sig_n_t8 UMR_U_MIN_32_1_0_S6_S3 4 0 8160 DEPOSIT ABSOLUTE MONOTONY MON_INCREASE /end AXIS_DESCR
 /begin AXIS_DESCR STD_AXIS zff_atsys._.iSignale._.obj.sig_m_t8 UMR_NM__8_1_M50_S6_S3 6 -400 1640 DEPOSIT ABSOLUTE MONOTONY MON_INCREASE /end AXIS_DESCR
/end CHARACTERISTIC
/begin CHARACTERISTIC KF_WTSGLSSP64_EL "Sollschleifzeit GLS" MAP 0x23A820 kf_ui8_S6_S3 2550 UMR_MSEC__10_1_0_S6_S3 0 2550
 /begin AXIS_DESCR STD_AXIS zff_atsys._.iSignale._.obj.sig_n_t8 UMR_U_MIN_32_1_0_S6_S3 4 0 8160 DEPOSIT ABSOLUTE MONOTONY MON_INCREASE /end AXIS_DESCR
 /begin AXIS_DESCR STD_AXIS zff_atsys._.iSignale._.obj.sig_m_t8 UMR_NM__8_1_M50_S6_S3 6 -400 1640 DEPOSIT ABSOLUTE MONOTONY MON_INCREASE /end AXIS_DESCR
/end CHARACTERISTIC
/begin CHARACTERISTIC KL_TVGLSKABCGSP64 "Verzoegerungszeit GLS-Beginn" CURVE 0x23A84C kl_ui8_S6_S3 2540 UMR_MSEC__10_1_0_S6_S3 0 2540
 /begin AXIS_DESCR STD_AXIS zff_atsys._.iSignale._.obj.sig_c_getr UMR_GRADC__1_1_M40_S6_S3 3 -40 150 DEPOSIT ABSOLUTE MONOTONY MON_INCREASE /end AXIS_DESCR
/end CHARACTERISTIC
/begin CHARACTERISTIC KL_TVGLSKABCGSP64_EL "Verzoegerungszeit GLS-Beginn" CURVE 0x23A858 kl_ui8_S6_S3 2540 UMR_MSEC__10_1_0_S6_S3 0 2540
 /begin AXIS_DESCR STD_AXIS zff_atsys._.iSignale._.obj.sig_c_getr UMR_GRADC__1_1_M40_S6_S3 3 -40 150 DEPOSIT ABSOLUTE MONOTONY MON_INCREASE /end AXIS_DESCR
/end CHARACTERISTIC
/begin CHARACTERISTIC KL_POMTABBGLSHSZSP64 "Schaltdruckoffset nach Umstellung einer HSZ in eine RSZ waehrend der GLS-Phase" CURVE 0x23A864 kl_si16_S6_S3 12 UMR_BAR__1_1000_0_S6_S3 -6 6
 /begin AXIS_DESCR STD_AXIS zff_atsys._.iSignale._.obj.sig_m_t UMR_NM__1_1_0_S6_S3 4 -400 1640 DEPOSIT ABSOLUTE MONOTONY MON_INCREASE /end AXIS_DESCR
/end CHARACTERISTIC
/begin CHARACTERISTIC KF_WTSGLSSP71 "Sollschleifzeit GLS" MAP 0x23A878 kf_ui8_S6_S3 2550 UMR_MSEC__10_1_0_S6_S3 0 2550
 /begin AXIS_DESCR STD_AXIS zff_atsys._.iSignale._.obj.sig_n_t8 UMR_U_MIN_32_1_0_S6_S3 4 0 8160 DEPOSIT ABSOLUTE MONOTONY MON_INCREASE /end AXIS_DESCR
 /begin AXIS_DESCR STD_AXIS zff_atsys._.iSignale._.obj.sig_m_t8 UMR_NM__8_1_M50_S6_S3 6 -400 1640 DEPOSIT ABSOLUTE MONOTONY MON_INCREASE /end AXIS_DESCR
/end CHARACTERISTIC
/begin CHARACTERISTIC KL_TVGLSKABCGSP71 "Verzoegerungszeit GLS-Beginn" CURVE 0x23A8A4 kl_ui8_S6_S3 2540 UMR_MSEC__10_1_0_S6_S3 0 2540
 /begin AXIS_DESCR STD_AXIS zff_atsys._.iSignale._.obj.sig_c_getr UMR_GRADC__1_1_M40_S6_S3 3 -40 150 DEPOSIT ABSOLUTE MONOTONY MON_INCREASE /end AXIS_DESCR
/end CHARACTERISTIC
/begin CHARACTERISTIC KL_POMTABBGLSHSZSP71 "Schaltdruckoffset nach Umstellung einer HSZ in eine RSZ waehrend der GLS-Phase" CURVE 0x23A8B0 kl_si16_S6_S3 12 UMR_BAR__1_1000_0_S6_S3 -6 6
 /begin AXIS_DESCR STD_AXIS zff_atsys._.iSignale._.obj.sig_m_t UMR_NM__1_1_0_S6_S3 4 -400 1640 DEPOSIT ABSOLUTE MONOTONY MON_INCREASE /end AXIS_DESCR
/end CHARACTERISTIC
/begin CHARACTERISTIC KF_WTSGLSSP75 "Sollschleifzeit GLS" MAP 0x23A8C4 kf_ui8_S6_S3 2550 UMR_MSEC__10_1_0_S6_S3 0 2550
 /begin AXIS_DESCR STD_AXIS zff_atsys._.iSignale._.obj.sig_n_t8 UMR_U_MIN_32_1_0_S6_S3 4 0 8160 DEPOSIT ABSOLUTE MONOTONY MON_INCREASE /end AXIS_DESCR
 /begin AXIS_DESCR STD_AXIS zff_atsys._.iSignale._.obj.sig_m_t8 UMR_NM__8_1_M50_S6_S3 6 -400 1640 DEPOSIT ABSOLUTE MONOTONY MON_INCREASE /end AXIS_DESCR
/end CHARACTERISTIC
/begin CHARACTERISTIC KF_WTSGLSSP75_EL "Sollschleifzeit GLS" MAP 0x23A8F0 kf_ui8_S6_S3 2550 UMR_MSEC__10_1_0_S6_S3 0 2550
 /begin AXIS_DESCR STD_AXIS zff_atsys._.iSignale._.obj.sig_n_t8 UMR_U_MIN_32_1_0_S6_S3 4 0 8160 DEPOSIT ABSOLUTE MONOTONY MON_INCREASE /end AXIS_DESCR
 /begin AXIS_DESCR STD_AXIS zff_atsys._.iSignale._.obj.sig_m_t8 UMR_NM__8_1_M50_S6_S3 6 -400 1640 DEPOSIT ABSOLUTE MONOTONY MON_INCREASE /end AXIS_DESCR
/end CHARACTERISTIC
/begin CHARACTERISTIC KL_TVGLSKABCGSP75 "Verzoegerungszeit GLS-Beginn" CURVE 0x23A91C kl_ui8_S6_S3 2540 UMR_MSEC__10_1_0_S6_S3 0 2540
 /begin AXIS_DESCR STD_AXIS zff_atsys._.iSignale._.obj.sig_c_getr UMR_GRADC__1_1_M40_S6_S3 3 -40 150 DEPOSIT ABSOLUTE MONOTONY MON_INCREASE /end AXIS_DESCR
/end CHARACTERISTIC
/begin CHARACTERISTIC KL_TVGLSKABCGSP75_EL "Verzoegerungszeit GLS-Beginn" CURVE 0x23A928 kl_ui8_S6_S3 2540 UMR_MSEC__10_1_0_S6_S3 0 2540
 /begin AXIS_DESCR STD_AXIS zff_atsys._.iSignale._.obj.sig_c_getr UMR_GRADC__1_1_M40_S6_S3 3 -40 150 DEPOSIT ABSOLUTE MONOTONY MON_INCREASE /end AXIS_DESCR
/end CHARACTERISTIC
/begin CHARACTERISTIC KL_POMTABBGLSHSZSP75 "Schaltdruckoffset nach Umstellung einer HSZ in eine RSZ waehrend der GLS-Phase" CURVE 0x23A934 kl_si16_S6_S3 12 UMR_BAR__1_1000_0_S6_S3 -6 6
 /begin AXIS_DESCR STD_AXIS zff_atsys._.iSignale._.obj.sig_m_t UMR_NM__1_1_0_S6_S3 4 -400 1640 DEPOSIT ABSOLUTE MONOTONY MON_INCREASE /end AXIS_DESCR
/end CHARACTERISTIC
/begin CHARACTERISTIC KF_WTSGLSSP82 "Sollschleifzeit GLS" MAP 0x23A948 kf_ui8_S6_S3 2550 UMR_MSEC__10_1_0_S6_S3 0 2550
 /begin AXIS_DESCR STD_AXIS zff_atsys._.iSignale._.obj.sig_n_t8 UMR_U_MIN_32_1_0_S6_S3 4 0 8160 DEPOSIT ABSOLUTE MONOTONY MON_INCREASE /end AXIS_DESCR
 /begin AXIS_DESCR STD_AXIS zff_atsys._.iSignale._.obj.sig_m_t8 UMR_NM__8_1_M50_S6_S3 6 -400 1640 DEPOSIT ABSOLUTE MONOTONY MON_INCREASE /end AXIS_DESCR
/end CHARACTERISTIC
/begin CHARACTERISTIC KF_WTSGLSSP82_EL "Sollschleifzeit GLS" MAP 0x23A974 kf_ui8_S6_S3 2550 UMR_MSEC__10_1_0_S6_S3 0 2550
 /begin AXIS_DESCR STD_AXIS zff_atsys._.iSignale._.obj.sig_n_t8 UMR_U_MIN_32_1_0_S6_S3 4 0 8160 DEPOSIT ABSOLUTE MONOTONY MON_INCREASE /end AXIS_DESCR
 /begin AXIS_DESCR STD_AXIS zff_atsys._.iSignale._.obj.sig_m_t8 UMR_NM__8_1_M50_S6_S3 6 -400 1640 DEPOSIT ABSOLUTE MONOTONY MON_INCREASE /end AXIS_DESCR
/end CHARACTERISTIC
/begin CHARACTERISTIC KL_TVGLSKABCGSP82 "Verzoegerungszeit GLS-Beginn" CURVE 0x23A9A0 kl_ui8_S6_S3 2540 UMR_MSEC__10_1_0_S6_S3 0 2540
 /begin AXIS_DESCR STD_AXIS zff_atsys._.iSignale._.obj.sig_c_getr UMR_GRADC__1_1_M40_S6_S3 3 -40 150 DEPOSIT ABSOLUTE MONOTONY MON_INCREASE /end AXIS_DESCR
/end CHARACTERISTIC
/begin CHARACTERISTIC KL_TVGLSKABCGSP82_EL "Verzoegerungszeit GLS-Beginn" CURVE 0x23A9AC kl_ui8_S6_S3 2540 UMR_MSEC__10_1_0_S6_S3 0 2540
 /begin AXIS_DESCR STD_AXIS zff_atsys._.iSignale._.obj.sig_c_getr UMR_GRADC__1_1_M40_S6_S3 3 -40 150 DEPOSIT ABSOLUTE MONOTONY MON_INCREASE /end AXIS_DESCR
/end CHARACTERISTIC
/begin CHARACTERISTIC KL_POMTABBGLSHSZSP82 "Schaltdruckoffset nach Umstellung einer HSZ in eine RSZ waehrend der GLS-Phase" CURVE 0x23A9B8 kl_si16_S6_S3 12 UMR_BAR__1_1000_0_S6_S3 -6 6
 /begin AXIS_DESCR STD_AXIS zff_atsys._.iSignale._.obj.sig_m_t UMR_NM__1_1_0_S6_S3 4 -400 1640 DEPOSIT ABSOLUTE MONOTONY MON_INCREASE /end AXIS_DESCR
/end CHARACTERISTIC
/begin CHARACTERISTIC KF_WTSGLSSP84 "Sollschleifzeit GLS" MAP 0x23A9CC kf_ui8_S6_S3 2550 UMR_MSEC__10_1_0_S6_S3 0 2550
 /begin AXIS_DESCR STD_AXIS zff_atsys._.iSignale._.obj.sig_n_t8 UMR_U_MIN_32_1_0_S6_S3 4 0 8160 DEPOSIT ABSOLUTE MONOTONY MON_INCREASE /end AXIS_DESCR
 /begin AXIS_DESCR STD_AXIS zff_atsys._.iSignale._.obj.sig_m_t8 UMR_NM__8_1_M50_S6_S3 6 -400 1640 DEPOSIT ABSOLUTE MONOTONY MON_INCREASE /end AXIS_DESCR
/end CHARACTERISTIC
/begin CHARACTERISTIC KF_WTSGLSSP84_EL "Sollschleifzeit GLS" MAP 0x23A9F8 kf_ui8_S6_S3 2550 UMR_MSEC__10_1_0_S6_S3 0 2550
 /begin AXIS_DESCR STD_AXIS zff_atsys._.iSignale._.obj.sig_n_t8 UMR_U_MIN_32_1_0_S6_S3 4 0 8160 DEPOSIT ABSOLUTE MONOTONY MON_INCREASE /end AXIS_DESCR
 /begin AXIS_DESCR STD_AXIS zff_atsys._.iSignale._.obj.sig_m_t8 UMR_NM__8_1_M50_S6_S3 6 -400 1640 DEPOSIT ABSOLUTE MONOTONY MON_INCREASE /end AXIS_DESCR
/end CHARACTERISTIC
/begin CHARACTERISTIC KL_TVGLSKABCGSP84 "Verzoegerungszeit GLS-Beginn" CURVE 0x23AA24 kl_ui8_S6_S3 2540 UMR_MSEC__10_1_0_S6_S3 0 2540
 /begin AXIS_DESCR STD_AXIS zff_atsys._.iSignale._.obj.sig_c_getr UMR_GRADC__1_1_M40_S6_S3 3 -40 150 DEPOSIT ABSOLUTE MONOTONY MON_INCREASE /end AXIS_DESCR
/end CHARACTERISTIC
/begin CHARACTERISTIC KL_TVGLSKABCGSP84_EL "Verzoegerungszeit GLS-Beginn" CURVE 0x23AA30 kl_ui8_S6_S3 2540 UMR_MSEC__10_1_0_S6_S3 0 2540
 /begin AXIS_DESCR STD_AXIS zff_atsys._.iSignale._.obj.sig_c_getr UMR_GRADC__1_1_M40_S6_S3 3 -40 150 DEPOSIT ABSOLUTE MONOTONY MON_INCREASE /end AXIS_DESCR
/end CHARACTERISTIC
/begin CHARACTERISTIC KL_POMTABBGLSHSZSP84 "Schaltdruckoffset nach Umstellung einer HSZ in eine RSZ waehrend der GLS-Phase" CURVE 0x23AA3C kl_si16_S6_S3 12 UMR_BAR__1_1000_0_S6_S3 -6 6
 /begin AXIS_DESCR STD_AXIS zff_atsys._.iSignale._.obj.sig_m_t UMR_NM__1_1_0_S6_S3 4 -400 1640 DEPOSIT ABSOLUTE MONOTONY MON_INCREASE /end AXIS_DESCR
/end CHARACTERISTIC
/begin CHARACTERISTIC KF_WTSGLSSP86 "Sollschleifzeit GLS" MAP 0x23AA50 kf_ui8_S6_S3 2550 UMR_MSEC__10_1_0_S6_S3 0 2550
 /begin AXIS_DESCR STD_AXIS zff_atsys._.iSignale._.obj.sig_n_t8 UMR_U_MIN_32_1_0_S6_S3 4 0 8160 DEPOSIT ABSOLUTE MONOTONY MON_INCREASE /end AXIS_DESCR
 /begin AXIS_DESCR STD_AXIS zff_atsys._.iSignale._.obj.sig_m_t8 UMR_NM__8_1_M50_S6_S3 6 -400 1640 DEPOSIT ABSOLUTE MONOTONY MON_INCREASE /end AXIS_DESCR
/end CHARACTERISTIC
/begin CHARACTERISTIC KF_WTSGLSSP86_EL "Sollschleifzeit GLS" MAP 0x23AA7C kf_ui8_S6_S3 2550 UMR_MSEC__10_1_0_S6_S3 0 2550
 /begin AXIS_DESCR STD_AXIS zff_atsys._.iSignale._.obj.sig_n_t8 UMR_U_MIN_32_1_0_S6_S3 4 0 8160 DEPOSIT ABSOLUTE MONOTONY MON_INCREASE /end AXIS_DESCR
 /begin AXIS_DESCR STD_AXIS zff_atsys._.iSignale._.obj.sig_m_t8 UMR_NM__8_1_M50_S6_S3 6 -400 1640 DEPOSIT ABSOLUTE MONOTONY MON_INCREASE /end AXIS_DESCR
/end CHARACTERISTIC
/begin CHARACTERISTIC KL_TVGLSKABCGSP86 "Verzoegerungszeit GLS-Beginn" CURVE 0x23AAA8 kl_ui8_S6_S3 2540 UMR_MSEC__10_1_0_S6_S3 0 2540
 /begin AXIS_DESCR STD_AXIS zff_atsys._.iSignale._.obj.sig_c_getr UMR_GRADC__1_1_M40_S6_S3 3 -40 150 DEPOSIT ABSOLUTE MONOTONY MON_INCREASE /end AXIS_DESCR
/end CHARACTERISTIC
/begin CHARACTERISTIC KL_TVGLSKABCGSP86_EL "Verzoegerungszeit GLS-Beginn" CURVE 0x23AAB4 kl_ui8_S6_S3 2540 UMR_MSEC__10_1_0_S6_S3 0 2540
 /begin AXIS_DESCR STD_AXIS zff_atsys._.iSignale._.obj.sig_c_getr UMR_GRADC__1_1_M40_S6_S3 3 -40 150 DEPOSIT ABSOLUTE MONOTONY MON_INCREASE /end AXIS_DESCR
/end CHARACTERISTIC
/begin CHARACTERISTIC KL_POMTABBGLSHSZSP86 "Schaltdruckoffset nach Umstellung einer HSZ in eine RSZ waehrend der GLS-Phase" CURVE 0x23AAC0 kl_si16_S6_S3 12 UMR_BAR__1_1000_0_S6_S3 -6 6
 /begin AXIS_DESCR STD_AXIS zff_atsys._.iSignale._.obj.sig_m_t UMR_NM__1_1_0_S6_S3 4 -400 1640 DEPOSIT ABSOLUTE MONOTONY MON_INCREASE /end AXIS_DESCR
/end CHARACTERISTIC
/begin CHARACTERISTIC KF_WTSGLSSPORT21 "Sollschleifzeit GLS" MAP 0x23AAD4 kf_ui8_S6_S3 2550 UMR_MSEC__10_1_0_S6_S3 0 2550
 /begin AXIS_DESCR STD_AXIS zff_atsys._.iSignale._.obj.sig_n_t8 UMR_U_MIN_32_1_0_S6_S3 4 0 8160 DEPOSIT ABSOLUTE MONOTONY MON_INCREASE /end AXIS_DESCR
 /begin AXIS_DESCR STD_AXIS zff_atsys._.iSignale._.obj.sig_m_t8 UMR_NM__8_1_M50_S6_S3 6 -400 1640 DEPOSIT ABSOLUTE MONOTONY MON_INCREASE /end AXIS_DESCR
/end CHARACTERISTIC
/begin CHARACTERISTIC KL_TVGLSKABCGSPORT21 "Verzoegerungszeit GLS-Beginn" CURVE 0x23AB00 kl_ui8_S6_S3 2540 UMR_MSEC__10_1_0_S6_S3 0 2540
 /begin AXIS_DESCR STD_AXIS zff_atsys._.iSignale._.obj.sig_c_getr UMR_GRADC__1_1_M40_S6_S3 3 -40 150 DEPOSIT ABSOLUTE MONOTONY MON_INCREASE /end AXIS_DESCR
/end CHARACTERISTIC
/begin CHARACTERISTIC KL_POMTABBGLSHSZSPORT21 "Schaltdruckoffset nach Umstellung einer HSZ in eine RSZ waehrend der GLS-Phase" CURVE 0x23AB0C kl_si16_S6_S3 12 UMR_BAR__1_1000_0_S6_S3 -6 6
 /begin AXIS_DESCR STD_AXIS zff_atsys._.iSignale._.obj.sig_m_t UMR_NM__1_1_0_S6_S3 4 -400 1640 DEPOSIT ABSOLUTE MONOTONY MON_INCREASE /end AXIS_DESCR
/end CHARACTERISTIC
/begin CHARACTERISTIC KF_WTSGLSSPORT32 "Sollschleifzeit GLS" MAP 0x23AB20 kf_ui8_S6_S3 2550 UMR_MSEC__10_1_0_S6_S3 0 2550
 /begin AXIS_DESCR STD_AXIS zff_atsys._.iSignale._.obj.sig_n_t8 UMR_U_MIN_32_1_0_S6_S3 4 0 8160 DEPOSIT ABSOLUTE MONOTONY MON_INCREASE /end AXIS_DESCR
 /begin AXIS_DESCR STD_AXIS zff_atsys._.iSignale._.obj.sig_m_t8 UMR_NM__8_1_M50_S6_S3 6 -400 1640 DEPOSIT ABSOLUTE MONOTONY MON_INCREASE /end AXIS_DESCR
/end CHARACTERISTIC
/begin CHARACTERISTIC KL_TVGLSKABCGSPORT32 "Verzoegerungszeit GLS-Beginn" CURVE 0x23AB4C kl_ui8_S6_S3 2540 UMR_MSEC__10_1_0_S6_S3 0 2540
 /begin AXIS_DESCR STD_AXIS zff_atsys._.iSignale._.obj.sig_c_getr UMR_GRADC__1_1_M40_S6_S3 3 -40 150 DEPOSIT ABSOLUTE MONOTONY MON_INCREASE /end AXIS_DESCR
/end CHARACTERISTIC
/begin CHARACTERISTIC KL_POMTABBGLSHSZSPORT32 "Schaltdruckoffset nach Umstellung einer HSZ in eine RSZ waehrend der GLS-Phase" CURVE 0x23AB58 kl_si16_S6_S3 12 UMR_BAR__1_1000_0_S6_S3 -6 6
 /begin AXIS_DESCR STD_AXIS zff_atsys._.iSignale._.obj.sig_m_t UMR_NM__1_1_0_S6_S3 4 -400 1640 DEPOSIT ABSOLUTE MONOTONY MON_INCREASE /end AXIS_DESCR
/end CHARACTERISTIC
/begin CHARACTERISTIC KF_WTSGLSSPORT43 "Sollschleifzeit GLS" MAP 0x23AB6C kf_ui8_S6_S3 2550 UMR_MSEC__10_1_0_S6_S3 0 2550
 /begin AXIS_DESCR STD_AXIS zff_atsys._.iSignale._.obj.sig_n_t8 UMR_U_MIN_32_1_0_S6_S3 4 0 8160 DEPOSIT ABSOLUTE MONOTONY MON_INCREASE /end AXIS_DESCR
 /begin AXIS_DESCR STD_AXIS zff_atsys._.iSignale._.obj.sig_m_t8 UMR_NM__8_1_M50_S6_S3 6 -400 1640 DEPOSIT ABSOLUTE MONOTONY MON_INCREASE /end AXIS_DESCR
/end CHARACTERISTIC
/begin CHARACTERISTIC KL_TVGLSKABCGSPORT43 "Verzoegerungszeit GLS-Beginn" CURVE 0x23AB98 kl_ui8_S6_S3 2540 UMR_MSEC__10_1_0_S6_S3 0 2540
 /begin AXIS_DESCR STD_AXIS zff_atsys._.iSignale._.obj.sig_c_getr UMR_GRADC__1_1_M40_S6_S3 3 -40 150 DEPOSIT ABSOLUTE MONOTONY MON_INCREASE /end AXIS_DESCR
/end CHARACTERISTIC
/begin CHARACTERISTIC KL_POMTABBGLSHSZSPORT43 "Schaltdruckoffset nach Umstellung einer HSZ in eine RSZ waehrend der GLS-Phase" CURVE 0x23ABA4 kl_si16_S6_S3 12 UMR_BAR__1_1000_0_S6_S3 -6 6
 /begin AXIS_DESCR STD_AXIS zff_atsys._.iSignale._.obj.sig_m_t UMR_NM__1_1_0_S6_S3 4 -400 1640 DEPOSIT ABSOLUTE MONOTONY MON_INCREASE /end AXIS_DESCR
/end CHARACTERISTIC
/begin CHARACTERISTIC KF_WTSGLSSPORT54 "Sollschleifzeit GLS" MAP 0x23ABB8 kf_ui8_S6_S3 2550 UMR_MSEC__10_1_0_S6_S3 0 2550
 /begin AXIS_DESCR STD_AXIS zff_atsys._.iSignale._.obj.sig_n_t8 UMR_U_MIN_32_1_0_S6_S3 4 0 8160 DEPOSIT ABSOLUTE MONOTONY MON_INCREASE /end AXIS_DESCR
 /begin AXIS_DESCR STD_AXIS zff_atsys._.iSignale._.obj.sig_m_t8 UMR_NM__8_1_M50_S6_S3 6 -400 1640 DEPOSIT ABSOLUTE MONOTONY MON_INCREASE /end AXIS_DESCR
/end CHARACTERISTIC
/begin CHARACTERISTIC KL_TVGLSKABCGSPORT54 "Verzoegerungszeit GLS-Beginn" CURVE 0x23ABE4 kl_ui8_S6_S3 2540 UMR_MSEC__10_1_0_S6_S3 0 2540
 /begin AXIS_DESCR STD_AXIS zff_atsys._.iSignale._.obj.sig_c_getr UMR_GRADC__1_1_M40_S6_S3 3 -40 150 DEPOSIT ABSOLUTE MONOTONY MON_INCREASE /end AXIS_DESCR
/end CHARACTERISTIC
/begin CHARACTERISTIC KL_POMTABBGLSHSZSPORT54 "Schaltdruckoffset nach Umstellung einer HSZ in eine RSZ waehrend der GLS-Phase" CURVE 0x23ABF0 kl_si16_S6_S3 12 UMR_BAR__1_1000_0_S6_S3 -6 6
 /begin AXIS_DESCR STD_AXIS zff_atsys._.iSignale._.obj.sig_m_t UMR_NM__1_1_0_S6_S3 4 -400 1640 DEPOSIT ABSOLUTE MONOTONY MON_INCREASE /end AXIS_DESCR
/end CHARACTERISTIC
/begin CHARACTERISTIC KF_WTSGLSSPORT65 "Sollschleifzeit GLS" MAP 0x23AC04 kf_ui8_S6_S3 2550 UMR_MSEC__10_1_0_S6_S3 0 2550
 /begin AXIS_DESCR STD_AXIS zff_atsys._.iSignale._.obj.sig_n_t8 UMR_U_MIN_32_1_0_S6_S3 4 0 8160 DEPOSIT ABSOLUTE MONOTONY MON_INCREASE /end AXIS_DESCR
 /begin AXIS_DESCR STD_AXIS zff_atsys._.iSignale._.obj.sig_m_t8 UMR_NM__8_1_M50_S6_S3 6 -400 1640 DEPOSIT ABSOLUTE MONOTONY MON_INCREASE /end AXIS_DESCR
/end CHARACTERISTIC
/begin CHARACTERISTIC KL_TVGLSKABCGSPORT65 "Verzoegerungszeit GLS-Beginn" CURVE 0x23AC30 kl_ui8_S6_S3 2540 UMR_MSEC__10_1_0_S6_S3 0 2540
 /begin AXIS_DESCR STD_AXIS zff_atsys._.iSignale._.obj.sig_c_getr UMR_GRADC__1_1_M40_S6_S3 3 -40 150 DEPOSIT ABSOLUTE MONOTONY MON_INCREASE /end AXIS_DESCR
/end CHARACTERISTIC
/begin CHARACTERISTIC KL_POMTABBGLSHSZSPORT65 "Schaltdruckoffset nach Umstellung einer HSZ in eine RSZ waehrend der GLS-Phase" CURVE 0x23AC3C kl_si16_S6_S3 12 UMR_BAR__1_1000_0_S6_S3 -6 6
 /begin AXIS_DESCR STD_AXIS zff_atsys._.iSignale._.obj.sig_m_t UMR_NM__1_1_0_S6_S3 4 -400 1640 DEPOSIT ABSOLUTE MONOTONY MON_INCREASE /end AXIS_DESCR
/end CHARACTERISTIC
/begin CHARACTERISTIC KF_WTSGLSSPORT76 "Sollschleifzeit GLS" MAP 0x23AC50 kf_ui8_S6_S3 2550 UMR_MSEC__10_1_0_S6_S3 0 2550
 /begin AXIS_DESCR STD_AXIS zff_atsys._.iSignale._.obj.sig_n_t8 UMR_U_MIN_32_1_0_S6_S3 4 0 8160 DEPOSIT ABSOLUTE MONOTONY MON_INCREASE /end AXIS_DESCR
 /begin AXIS_DESCR STD_AXIS zff_atsys._.iSignale._.obj.sig_m_t8 UMR_NM__8_1_M50_S6_S3 6 -400 1640 DEPOSIT ABSOLUTE MONOTONY MON_INCREASE /end AXIS_DESCR
/end CHARACTERISTIC
/begin CHARACTERISTIC KL_TVGLSKABCGSPORT76 "Verzoegerungszeit GLS-Beginn" CURVE 0x23AC7C kl_ui8_S6_S3 2540 UMR_MSEC__10_1_0_S6_S3 0 2540
 /begin AXIS_DESCR STD_AXIS zff_atsys._.iSignale._.obj.sig_c_getr UMR_GRADC__1_1_M40_S6_S3 3 -40 150 DEPOSIT ABSOLUTE MONOTONY MON_INCREASE /end AXIS_DESCR
/end CHARACTERISTIC
/begin CHARACTERISTIC KL_POMTABBGLSHSZSPORT76 "Schaltdruckoffset nach Umstellung einer HSZ in eine RSZ waehrend der GLS-Phase" CURVE 0x23AC88 kl_si16_S6_S3 12 UMR_BAR__1_1000_0_S6_S3 -6 6
 /begin AXIS_DESCR STD_AXIS zff_atsys._.iSignale._.obj.sig_m_t UMR_NM__1_1_0_S6_S3 4 -400 1640 DEPOSIT ABSOLUTE MONOTONY MON_INCREASE /end AXIS_DESCR
/end CHARACTERISTIC
/begin CHARACTERISTIC KF_WTSGLSSPORT87 "Sollschleifzeit GLS" MAP 0x23AC9C kf_ui8_S6_S3 2550 UMR_MSEC__10_1_0_S6_S3 0 2550
 /begin AXIS_DESCR STD_AXIS zff_atsys._.iSignale._.obj.sig_n_t8 UMR_U_MIN_32_1_0_S6_S3 4 0 8160 DEPOSIT ABSOLUTE MONOTONY MON_INCREASE /end AXIS_DESCR
 /begin AXIS_DESCR STD_AXIS zff_atsys._.iSignale._.obj.sig_m_t8 UMR_NM__8_1_M50_S6_S3 6 -400 1640 DEPOSIT ABSOLUTE MONOTONY MON_INCREASE /end AXIS_DESCR
/end CHARACTERISTIC
/begin CHARACTERISTIC KL_TVGLSKABCGSPORT87 "Verzoegerungszeit GLS-Beginn" CURVE 0x23ACC8 kl_ui8_S6_S3 2540 UMR_MSEC__10_1_0_S6_S3 0 2540
 /begin AXIS_DESCR STD_AXIS zff_atsys._.iSignale._.obj.sig_c_getr UMR_GRADC__1_1_M40_S6_S3 3 -40 150 DEPOSIT ABSOLUTE MONOTONY MON_INCREASE /end AXIS_DESCR
/end CHARACTERISTIC
/begin CHARACTERISTIC KL_POMTABBGLSHSZSPORT87 "Schaltdruckoffset nach Umstellung einer HSZ in eine RSZ waehrend der GLS-Phase" CURVE 0x23ACD4 kl_si16_S6_S3 12 UMR_BAR__1_1000_0_S6_S3 -6 6
 /begin AXIS_DESCR STD_AXIS zff_atsys._.iSignale._.obj.sig_m_t UMR_NM__1_1_0_S6_S3 4 -400 1640 DEPOSIT ABSOLUTE MONOTONY MON_INCREASE /end AXIS_DESCR
/end CHARACTERISTIC
/begin CHARACTERISTIC KF_WTSGLSSPORT31 "Sollschleifzeit GLS" MAP 0x23ACE8 kf_ui8_S6_S3 2550 UMR_MSEC__10_1_0_S6_S3 0 2550
 /begin AXIS_DESCR STD_AXIS zff_atsys._.iSignale._.obj.sig_n_t8 UMR_U_MIN_32_1_0_S6_S3 4 0 8160 DEPOSIT ABSOLUTE MONOTONY MON_INCREASE /end AXIS_DESCR
 /begin AXIS_DESCR STD_AXIS zff_atsys._.iSignale._.obj.sig_m_t8 UMR_NM__8_1_M50_S6_S3 6 -400 1640 DEPOSIT ABSOLUTE MONOTONY MON_INCREASE /end AXIS_DESCR
/end CHARACTERISTIC
/begin CHARACTERISTIC KL_TVGLSKABCGSPORT31 "Verzoegerungszeit GLS-Beginn" CURVE 0x23AD14 kl_ui8_S6_S3 2540 UMR_MSEC__10_1_0_S6_S3 0 2540
 /begin AXIS_DESCR STD_AXIS zff_atsys._.iSignale._.obj.sig_c_getr UMR_GRADC__1_1_M40_S6_S3 3 -40 150 DEPOSIT ABSOLUTE MONOTONY MON_INCREASE /end AXIS_DESCR
/end CHARACTERISTIC
/begin CHARACTERISTIC KL_POMTABBGLSHSZSPORT31 "Schaltdruckoffset nach Umstellung einer HSZ in eine RSZ waehrend der GLS-Phase" CURVE 0x23AD20 kl_si16_S6_S3 12 UMR_BAR__1_1000_0_S6_S3 -6 6
 /begin AXIS_DESCR STD_AXIS zff_atsys._.iSignale._.obj.sig_m_t UMR_NM__1_1_0_S6_S3 4 -400 1640 DEPOSIT ABSOLUTE MONOTONY MON_INCREASE /end AXIS_DESCR
/end CHARACTERISTIC
/begin CHARACTERISTIC KF_WTSGLSSPORT42 "Sollschleifzeit GLS" MAP 0x23AD34 kf_ui8_S6_S3 2550 UMR_MSEC__10_1_0_S6_S3 0 2550
 /begin AXIS_DESCR STD_AXIS zff_atsys._.iSignale._.obj.sig_n_t8 UMR_U_MIN_32_1_0_S6_S3 4 0 8160 DEPOSIT ABSOLUTE MONOTONY MON_INCREASE /end AXIS_DESCR
 /begin AXIS_DESCR STD_AXIS zff_atsys._.iSignale._.obj.sig_m_t8 UMR_NM__8_1_M50_S6_S3 6 -400 1640 DEPOSIT ABSOLUTE MONOTONY MON_INCREASE /end AXIS_DESCR
/end CHARACTERISTIC
/begin CHARACTERISTIC KL_TVGLSKABCGSPORT42 "Verzoegerungszeit GLS-Beginn" CURVE 0x23AD60 kl_ui8_S6_S3 2540 UMR_MSEC__10_1_0_S6_S3 0 2540
 /begin AXIS_DESCR STD_AXIS zff_atsys._.iSignale._.obj.sig_c_getr UMR_GRADC__1_1_M40_S6_S3 3 -40 150 DEPOSIT ABSOLUTE MONOTONY MON_INCREASE /end AXIS_DESCR
/end CHARACTERISTIC
/begin CHARACTERISTIC KL_POMTABBGLSHSZSPORT42 "Schaltdruckoffset nach Umstellung einer HSZ in eine RSZ waehrend der GLS-Phase" CURVE 0x23AD6C kl_si16_S6_S3 12 UMR_BAR__1_1000_0_S6_S3 -6 6
 /begin AXIS_DESCR STD_AXIS zff_atsys._.iSignale._.obj.sig_m_t UMR_NM__1_1_0_S6_S3 4 -400 1640 DEPOSIT ABSOLUTE MONOTONY MON_INCREASE /end AXIS_DESCR
/end CHARACTERISTIC
/begin CHARACTERISTIC KF_WTSGLSSPORT51 "Sollschleifzeit GLS" MAP 0x23AD80 kf_ui8_S6_S3 2550 UMR_MSEC__10_1_0_S6_S3 0 2550
 /begin AXIS_DESCR STD_AXIS zff_atsys._.iSignale._.obj.sig_n_t8 UMR_U_MIN_32_1_0_S6_S3 4 0 8160 DEPOSIT ABSOLUTE MONOTONY MON_INCREASE /end AXIS_DESCR
 /begin AXIS_DESCR STD_AXIS zff_atsys._.iSignale._.obj.sig_m_t8 UMR_NM__8_1_M50_S6_S3 6 -400 1640 DEPOSIT ABSOLUTE MONOTONY MON_INCREASE /end AXIS_DESCR
/end CHARACTERISTIC
/begin CHARACTERISTIC KL_TVGLSKABCGSPORT51 "Verzoegerungszeit GLS-Beginn" CURVE 0x23ADAC kl_ui8_S6_S3 2540 UMR_MSEC__10_1_0_S6_S3 0 2540
 /begin AXIS_DESCR STD_AXIS zff_atsys._.iSignale._.obj.sig_c_getr UMR_GRADC__1_1_M40_S6_S3 3 -40 150 DEPOSIT ABSOLUTE MONOTONY MON_INCREASE /end AXIS_DESCR
/end CHARACTERISTIC
/begin CHARACTERISTIC KL_POMTABBGLSHSZSPORT51 "Schaltdruckoffset nach Umstellung einer HSZ in eine RSZ waehrend der GLS-Phase" CURVE 0x23ADB8 kl_si16_S6_S3 12 UMR_BAR__1_1000_0_S6_S3 -6 6
 /begin AXIS_DESCR STD_AXIS zff_atsys._.iSignale._.obj.sig_m_t UMR_NM__1_1_0_S6_S3 4 -400 1640 DEPOSIT ABSOLUTE MONOTONY MON_INCREASE /end AXIS_DESCR
/end CHARACTERISTIC
/begin CHARACTERISTIC KF_WTSGLSSPORT53 "Sollschleifzeit GLS" MAP 0x23ADCC kf_ui8_S6_S3 2550 UMR_MSEC__10_1_0_S6_S3 0 2550
 /begin AXIS_DESCR STD_AXIS zff_atsys._.iSignale._.obj.sig_n_t8 UMR_U_MIN_32_1_0_S6_S3 4 0 8160 DEPOSIT ABSOLUTE MONOTONY MON_INCREASE /end AXIS_DESCR
 /begin AXIS_DESCR STD_AXIS zff_atsys._.iSignale._.obj.sig_m_t8 UMR_NM__8_1_M50_S6_S3 6 -400 1640 DEPOSIT ABSOLUTE MONOTONY MON_INCREASE /end AXIS_DESCR
/end CHARACTERISTIC
/begin CHARACTERISTIC KL_TVGLSKABCGSPORT53 "Verzoegerungszeit GLS-Beginn" CURVE 0x23ADF8 kl_ui8_S6_S3 2540 UMR_MSEC__10_1_0_S6_S3 0 2540
 /begin AXIS_DESCR STD_AXIS zff_atsys._.iSignale._.obj.sig_c_getr UMR_GRADC__1_1_M40_S6_S3 3 -40 150 DEPOSIT ABSOLUTE MONOTONY MON_INCREASE /end AXIS_DESCR
/end CHARACTERISTIC
/begin CHARACTERISTIC KL_POMTABBGLSHSZSPORT53 "Schaltdruckoffset nach Umstellung einer HSZ in eine RSZ waehrend der GLS-Phase" CURVE 0x23AE04 kl_si16_S6_S3 12 UMR_BAR__1_1000_0_S6_S3 -6 6
 /begin AXIS_DESCR STD_AXIS zff_atsys._.iSignale._.obj.sig_m_t UMR_NM__1_1_0_S6_S3 4 -400 1640 DEPOSIT ABSOLUTE MONOTONY MON_INCREASE /end AXIS_DESCR
/end CHARACTERISTIC
/begin CHARACTERISTIC KF_WTSGLSSPORT63 "Sollschleifzeit GLS" MAP 0x23AE18 kf_ui8_S6_S3 2550 UMR_MSEC__10_1_0_S6_S3 0 2550
 /begin AXIS_DESCR STD_AXIS zff_atsys._.iSignale._.obj.sig_n_t8 UMR_U_MIN_32_1_0_S6_S3 4 0 8160 DEPOSIT ABSOLUTE MONOTONY MON_INCREASE /end AXIS_DESCR
 /begin AXIS_DESCR STD_AXIS zff_atsys._.iSignale._.obj.sig_m_t8 UMR_NM__8_1_M50_S6_S3 6 -400 1640 DEPOSIT ABSOLUTE MONOTONY MON_INCREASE /end AXIS_DESCR
/end CHARACTERISTIC
/begin CHARACTERISTIC KL_TVGLSKABCGSPORT63 "Verzoegerungszeit GLS-Beginn" CURVE 0x23AE44 kl_ui8_S6_S3 2540 UMR_MSEC__10_1_0_S6_S3 0 2540
 /begin AXIS_DESCR STD_AXIS zff_atsys._.iSignale._.obj.sig_c_getr UMR_GRADC__1_1_M40_S6_S3 3 -40 150 DEPOSIT ABSOLUTE MONOTONY MON_INCREASE /end AXIS_DESCR
/end CHARACTERISTIC
/begin CHARACTERISTIC KL_POMTABBGLSHSZSPORT63 "Schaltdruckoffset nach Umstellung einer HSZ in eine RSZ waehrend der GLS-Phase" CURVE 0x23AE50 kl_si16_S6_S3 12 UMR_BAR__1_1000_0_S6_S3 -6 6
 /begin AXIS_DESCR STD_AXIS zff_atsys._.iSignale._.obj.sig_m_t UMR_NM__1_1_0_S6_S3 4 -400 1640 DEPOSIT ABSOLUTE MONOTONY MON_INCREASE /end AXIS_DESCR
/end CHARACTERISTIC
/begin CHARACTERISTIC KF_WTSGLSSPORT64 "Sollschleifzeit GLS" MAP 0x23AE64 kf_ui8_S6_S3 2550 UMR_MSEC__10_1_0_S6_S3 0 2550
 /begin AXIS_DESCR STD_AXIS zff_atsys._.iSignale._.obj.sig_n_t8 UMR_U_MIN_32_1_0_S6_S3 4 0 8160 DEPOSIT ABSOLUTE MONOTONY MON_INCREASE /end AXIS_DESCR
 /begin AXIS_DESCR STD_AXIS zff_atsys._.iSignale._.obj.sig_m_t8 UMR_NM__8_1_M50_S6_S3 6 -400 1640 DEPOSIT ABSOLUTE MONOTONY MON_INCREASE /end AXIS_DESCR
/end CHARACTERISTIC
/begin CHARACTERISTIC KL_TVGLSKABCGSPORT64 "Verzoegerungszeit GLS-Beginn" CURVE 0x23AE90 kl_ui8_S6_S3 2540 UMR_MSEC__10_1_0_S6_S3 0 2540
 /begin AXIS_DESCR STD_AXIS zff_atsys._.iSignale._.obj.sig_c_getr UMR_GRADC__1_1_M40_S6_S3 3 -40 150 DEPOSIT ABSOLUTE MONOTONY MON_INCREASE /end AXIS_DESCR
/end CHARACTERISTIC
/begin CHARACTERISTIC KL_POMTABBGLSHSZSPORT64 "Schaltdruckoffset nach Umstellung einer HSZ in eine RSZ waehrend der GLS-Phase" CURVE 0x23AE9C kl_si16_S6_S3 12 UMR_BAR__1_1000_0_S6_S3 -6 6
 /begin AXIS_DESCR STD_AXIS zff_atsys._.iSignale._.obj.sig_m_t UMR_NM__1_1_0_S6_S3 4 -400 1640 DEPOSIT ABSOLUTE MONOTONY MON_INCREASE /end AXIS_DESCR
/end CHARACTERISTIC
/begin CHARACTERISTIC KF_WTSGLSSPORT71 "Sollschleifzeit GLS" MAP 0x23AEB0 kf_ui8_S6_S3 2550 UMR_MSEC__10_1_0_S6_S3 0 2550
 /begin AXIS_DESCR STD_AXIS zff_atsys._.iSignale._.obj.sig_n_t8 UMR_U_MIN_32_1_0_S6_S3 4 0 8160 DEPOSIT ABSOLUTE MONOTONY MON_INCREASE /end AXIS_DESCR
 /begin AXIS_DESCR STD_AXIS zff_atsys._.iSignale._.obj.sig_m_t8 UMR_NM__8_1_M50_S6_S3 6 -400 1640 DEPOSIT ABSOLUTE MONOTONY MON_INCREASE /end AXIS_DESCR
/end CHARACTERISTIC
/begin CHARACTERISTIC KL_TVGLSKABCGSPORT71 "Verzoegerungszeit GLS-Beginn" CURVE 0x23AEDC kl_ui8_S6_S3 2540 UMR_MSEC__10_1_0_S6_S3 0 2540
 /begin AXIS_DESCR STD_AXIS zff_atsys._.iSignale._.obj.sig_c_getr UMR_GRADC__1_1_M40_S6_S3 3 -40 150 DEPOSIT ABSOLUTE MONOTONY MON_INCREASE /end AXIS_DESCR
/end CHARACTERISTIC
/begin CHARACTERISTIC KL_POMTABBGLSHSZSPORT71 "Schaltdruckoffset nach Umstellung einer HSZ in eine RSZ waehrend der GLS-Phase" CURVE 0x23AEE8 kl_si16_S6_S3 12 UMR_BAR__1_1000_0_S6_S3 -6 6
 /begin AXIS_DESCR STD_AXIS zff_atsys._.iSignale._.obj.sig_m_t UMR_NM__1_1_0_S6_S3 4 -400 1640 DEPOSIT ABSOLUTE MONOTONY MON_INCREASE /end AXIS_DESCR
/end CHARACTERISTIC
/begin CHARACTERISTIC KF_WTSGLSSPORT75 "Sollschleifzeit GLS" MAP 0x23AEFC kf_ui8_S6_S3 2550 UMR_MSEC__10_1_0_S6_S3 0 2550
 /begin AXIS_DESCR STD_AXIS zff_atsys._.iSignale._.obj.sig_n_t8 UMR_U_MIN_32_1_0_S6_S3 4 0 8160 DEPOSIT ABSOLUTE MONOTONY MON_INCREASE /end AXIS_DESCR
 /begin AXIS_DESCR STD_AXIS zff_atsys._.iSignale._.obj.sig_m_t8 UMR_NM__8_1_M50_S6_S3 6 -400 1640 DEPOSIT ABSOLUTE MONOTONY MON_INCREASE /end AXIS_DESCR
/end CHARACTERISTIC
/begin CHARACTERISTIC KL_TVGLSKABCGSPORT75 "Verzoegerungszeit GLS-Beginn" CURVE 0x23AF28 kl_ui8_S6_S3 2540 UMR_MSEC__10_1_0_S6_S3 0 2540
 /begin AXIS_DESCR STD_AXIS zff_atsys._.iSignale._.obj.sig_c_getr UMR_GRADC__1_1_M40_S6_S3 3 -40 150 DEPOSIT ABSOLUTE MONOTONY MON_INCREASE /end AXIS_DESCR
/end CHARACTERISTIC
/begin CHARACTERISTIC KL_POMTABBGLSHSZSPORT75 "Schaltdruckoffset nach Umstellung einer HSZ in eine RSZ waehrend der GLS-Phase" CURVE 0x23AF34 kl_si16_S6_S3 12 UMR_BAR__1_1000_0_S6_S3 -6 6
 /begin AXIS_DESCR STD_AXIS zff_atsys._.iSignale._.obj.sig_m_t UMR_NM__1_1_0_S6_S3 4 -400 1640 DEPOSIT ABSOLUTE MONOTONY MON_INCREASE /end AXIS_DESCR
/end CHARACTERISTIC
/begin CHARACTERISTIC KF_WTSGLSSPORT82 "Sollschleifzeit GLS" MAP 0x23AF48 kf_ui8_S6_S3 2550 UMR_MSEC__10_1_0_S6_S3 0 2550
 /begin AXIS_DESCR STD_AXIS zff_atsys._.iSignale._.obj.sig_n_t8 UMR_U_MIN_32_1_0_S6_S3 4 0 8160 DEPOSIT ABSOLUTE MONOTONY MON_INCREASE /end AXIS_DESCR
 /begin AXIS_DESCR STD_AXIS zff_atsys._.iSignale._.obj.sig_m_t8 UMR_NM__8_1_M50_S6_S3 6 -400 1640 DEPOSIT ABSOLUTE MONOTONY MON_INCREASE /end AXIS_DESCR
/end CHARACTERISTIC
/begin CHARACTERISTIC KL_TVGLSKABCGSPORT82 "Verzoegerungszeit GLS-Beginn" CURVE 0x23AF74 kl_ui8_S6_S3 2540 UMR_MSEC__10_1_0_S6_S3 0 2540
 /begin AXIS_DESCR STD_AXIS zff_atsys._.iSignale._.obj.sig_c_getr UMR_GRADC__1_1_M40_S6_S3 3 -40 150 DEPOSIT ABSOLUTE MONOTONY MON_INCREASE /end AXIS_DESCR
/end CHARACTERISTIC
/begin CHARACTERISTIC KL_POMTABBGLSHSZSPORT82 "Schaltdruckoffset nach Umstellung einer HSZ in eine RSZ waehrend der GLS-Phase" CURVE 0x23AF80 kl_si16_S6_S3 12 UMR_BAR__1_1000_0_S6_S3 -6 6
 /begin AXIS_DESCR STD_AXIS zff_atsys._.iSignale._.obj.sig_m_t UMR_NM__1_1_0_S6_S3 4 -400 1640 DEPOSIT ABSOLUTE MONOTONY MON_INCREASE /end AXIS_DESCR
/end CHARACTERISTIC
/begin CHARACTERISTIC KF_WTSGLSSPORT84 "Sollschleifzeit GLS" MAP 0x23AF94 kf_ui8_S6_S3 2550 UMR_MSEC__10_1_0_S6_S3 0 2550
 /begin AXIS_DESCR STD_AXIS zff_atsys._.iSignale._.obj.sig_n_t8 UMR_U_MIN_32_1_0_S6_S3 4 0 8160 DEPOSIT ABSOLUTE MONOTONY MON_INCREASE /end AXIS_DESCR
 /begin AXIS_DESCR STD_AXIS zff_atsys._.iSignale._.obj.sig_m_t8 UMR_NM__8_1_M50_S6_S3 6 -400 1640 DEPOSIT ABSOLUTE MONOTONY MON_INCREASE /end AXIS_DESCR
/end CHARACTERISTIC
/begin CHARACTERISTIC KL_TVGLSKABCGSPORT84 "Verzoegerungszeit GLS-Beginn" CURVE 0x23AFC0 kl_ui8_S6_S3 2540 UMR_MSEC__10_1_0_S6_S3 0 2540
 /begin AXIS_DESCR STD_AXIS zff_atsys._.iSignale._.obj.sig_c_getr UMR_GRADC__1_1_M40_S6_S3 3 -40 150 DEPOSIT ABSOLUTE MONOTONY MON_INCREASE /end AXIS_DESCR
/end CHARACTERISTIC
/begin CHARACTERISTIC KL_POMTABBGLSHSZSPORT84 "Schaltdruckoffset nach Umstellung einer HSZ in eine RSZ waehrend der GLS-Phase" CURVE 0x23AFCC kl_si16_S6_S3 12 UMR_BAR__1_1000_0_S6_S3 -6 6
 /begin AXIS_DESCR STD_AXIS zff_atsys._.iSignale._.obj.sig_m_t UMR_NM__1_1_0_S6_S3 4 -400 1640 DEPOSIT ABSOLUTE MONOTONY MON_INCREASE /end AXIS_DESCR
/end CHARACTERISTIC
/begin CHARACTERISTIC KF_WTSGLSSPORT86 "Sollschleifzeit GLS" MAP 0x23AFE0 kf_ui8_S6_S3 2550 UMR_MSEC__10_1_0_S6_S3 0 2550
 /begin AXIS_DESCR STD_AXIS zff_atsys._.iSignale._.obj.sig_n_t8 UMR_U_MIN_32_1_0_S6_S3 4 0 8160 DEPOSIT ABSOLUTE MONOTONY MON_INCREASE /end AXIS_DESCR
 /begin AXIS_DESCR STD_AXIS zff_atsys._.iSignale._.obj.sig_m_t8 UMR_NM__8_1_M50_S6_S3 6 -400 1640 DEPOSIT ABSOLUTE MONOTONY MON_INCREASE /end AXIS_DESCR
/end CHARACTERISTIC
/begin CHARACTERISTIC KL_TVGLSKABCGSPORT86 "Verzoegerungszeit GLS-Beginn" CURVE 0x23B00C kl_ui8_S6_S3 2540 UMR_MSEC__10_1_0_S6_S3 0 2540
 /begin AXIS_DESCR STD_AXIS zff_atsys._.iSignale._.obj.sig_c_getr UMR_GRADC__1_1_M40_S6_S3 3 -40 150 DEPOSIT ABSOLUTE MONOTONY MON_INCREASE /end AXIS_DESCR
/end CHARACTERISTIC
/begin CHARACTERISTIC KL_POMTABBGLSHSZSPORT86 "Schaltdruckoffset nach Umstellung einer HSZ in eine RSZ waehrend der GLS-Phase" CURVE 0x23B018 kl_si16_S6_S3 12 UMR_BAR__1_1000_0_S6_S3 -6 6
 /begin AXIS_DESCR STD_AXIS zff_atsys._.iSignale._.obj.sig_m_t UMR_NM__1_1_0_S6_S3 4 -400 1640 DEPOSIT ABSOLUTE MONOTONY MON_INCREASE /end AXIS_DESCR
/end CHARACTERISTIC
/begin CHARACTERISTIC SWI_GLS "Schalter GLS" VALUE 0x26E6AA kw_ui8_S6_S3 1 UMR___1_1_0_S6_S3 0 1 /end CHARACTERISTIC
/begin CHARACTERISTIC SWI_NGABGLS "Schalter Beruecksichtigung Gradient(n_ab) bei GLS" VALUE 0x26E6AB kw_ui8_S6_S3 2 UMR___1_1_0_S6_S3 0 2 /end CHARACTERISTIC
/begin CHARACTERISTIC T_FNGTGLS "Filterzeit fuer Turbinendrehzahlgradient bei GLS" VALUE 0x26D9F0 kw_ui16_S6_S3 999 UMR_MSEC__1_1_0_S6_S3 1 1000 /end CHARACTERISTIC
/begin CHARACTERISTIC CS_GLSGE "Getriebetemp.schwelle Einstieg Regelung Gangeinlegen" VALUE 0x26E6AC kw_ui8_S6_S3 190 UMR_GRADC__1_1_M40_S6_S3 -40 150 /end CHARACTERISTIC
/begin CHARACTERISTIC SWI_GLSGE "Schalter GLS-Regelung Gangeinlegen" VALUE 0x26E6AD kw_bool8_S6_S3 1 UMR___1_1_0_S6_S3 0 1 /end CHARACTERISTIC
/begin CHARACTERISTIC SWI_UMSCH_GLS_KAB "Schalter GLS-Regelung me auf p_gls" VALUE 0x26E6AE kw_bool8_S6_S3 1 UMR___1_1_0_S6_S3 0 1 /end CHARACTERISTIC
/begin CHARACTERISTIC P_MAXOBGLS "Max. Reglerdruck nach oben bei GLS" VALUE 0x26D9F2 kw_si16_S6_S3 12.75 UMR_BAR__1_1000_0_S6_S3 0 12.75 /end CHARACTERISTIC
/begin CHARACTERISTIC P_MAXUNGLS "Max. Reglerdruck nach unten bei GLS" VALUE 0x26D9F4 kw_si16_S6_S3 12.75 UMR_BAR__1_1000_0_S6_S3 0 12.75 /end CHARACTERISTIC
/begin CHARACTERISTIC P_MAXOBGLSGE "Max. Regeldruck nach oben bei GLS Gangeinlegen" VALUE 0x26D9F6 kw_si16_S6_S3 12.75 UMR_BAR__1_1000_0_S6_S3 0 12.75 /end CHARACTERISTIC
/begin CHARACTERISTIC P_MAXUNGLSGE "Max. Reglerdruck nach unten bei GLS Gangeinlegen" VALUE 0x26D9F8 kw_si16_S6_S3 12.75 UMR_BAR__1_1000_0_S6_S3 0 12.75 /end CHARACTERISTIC
/begin CHARACTERISTIC TAB_SWI_REGLERINITART "Umschaltung Druckreglerinitialisierung funktionsorientiert HS RS GE" CURVE 0x23873C tab_bool8_S6_S3 1 UMR___1_1_0_S6_S3 0 1
 /begin AXIS_DESCR FIX_AXIS NO_INPUT_QUANTITY UMR___1_1_0_S6_S3 3 0 2 FIX_AXIS_PAR_DIST 0 1 3 /end AXIS_DESCR
/end CHARACTERISTIC
/begin CHARACTERISTIC KL_NDGLSPOSHS12 "Drehzahlschwelle positiv fuer den Start der GLS bei HS" CURVE 0x2397CC kl_si16_S6_S3 8000 UMR_U_MIN_1_1_0_S6_S3 0 8000
 /begin AXIS_DESCR STD_AXIS zff_atsys._.iSignale._.obj.sig_m_t UMR_NM__1_1_0_S6_S3 4 -400 1640 DEPOSIT ABSOLUTE MONOTONY MON_INCREASE /end AXIS_DESCR
/end CHARACTERISTIC
/begin CHARACTERISTIC KL_NDGLSNEGHS12 "Drehzahlschwelle negativ fuer den Start der GLS bei HS" CURVE 0x2397E0 kl_si16_S6_S3 8000 UMR_U_MIN_1_1_0_S6_S3 -8000 0
 /begin AXIS_DESCR STD_AXIS zff_atsys._.iSignale._.obj.sig_m_t UMR_NM__1_1_0_S6_S3 4 -400 1640 DEPOSIT ABSOLUTE MONOTONY MON_INCREASE /end AXIS_DESCR
/end CHARACTERISTIC
/begin CHARACTERISTIC KF_NGTGLSHS12 "Turbinendrehzahlgradient fuer Startbedingung der GLS HS" MAP 0x2397F4 kf_si16_S6_S3 32000 UMR_U_MINSEC_1_1_0_S6_S3 -32000 0
 /begin AXIS_DESCR STD_AXIS zff_atsys._.iSignale._.obj.sig_m_t UMR_NM__1_1_0_S6_S3 6 -400 1640 DEPOSIT ABSOLUTE MONOTONY MON_INCREASE /end AXIS_DESCR
 /begin AXIS_DESCR STD_AXIS zff_atsys._.iSignale._.obj.sig_n_t UMR_U_MIN_1_1_0_S6_S3 4 0 8160 DEPOSIT ABSOLUTE MONOTONY MON_INCREASE /end AXIS_DESCR
/end CHARACTERISTIC
/begin CHARACTERISTIC KL_UMSCHGLSKZU12 "Momentenschwelle zu Regelumschaltung" CURVE 0x239840 kl_si16_S6_S3 1400 UMR_NM__1_1_0_S6_S3 -100 1300
 /begin AXIS_DESCR STD_AXIS zff_atsys._.iSignale._.obj.sig_c_getr UMR_GRADC__1_1_M40_S6_S3 4 -40 215 DEPOSIT ABSOLUTE MONOTONY MON_INCREASE /end AXIS_DESCR
/end CHARACTERISTIC
/begin CHARACTERISTIC KP_GLSKZU12 "Proportionalfaktor PID-Regler GLS" VALUE 0x26DA0C kw_ui16_S6_S3 10000 UMR_MBARMINSEC__1_1_0_S6_S3 0 10000 /end CHARACTERISTIC
/begin CHARACTERISTIC KP_GLSKZU12_EL "Proportionalfaktor PID-Regler GLS" VALUE 0x26DA0E kw_ui16_S6_S3 10000 UMR_MBARMINSEC__1_1_0_S6_S3 0 10000 /end CHARACTERISTIC
/begin CHARACTERISTIC KI_GLSKZU12 "Integralfaktor PID-Regler GLS" VALUE 0x26DA10 kw_ui16_S6_S3 10000 UMR_MBARMINSEC_10MSEC_1_1_0_S6_S3 0 10000 /end CHARACTERISTIC
/begin CHARACTERISTIC KI_GLSKZU12_EL "Integralfaktor PID-Regler GLS" VALUE 0x26DA12 kw_ui16_S6_S3 10000 UMR_MBARMINSEC_10MSEC_1_1_0_S6_S3 0 10000 /end CHARACTERISTIC
/begin CHARACTERISTIC TD_STOLGLS12 "max. tol. Schleifzeitdifferenz GLS" VALUE 0x26E6B8 kw_ui8_S6_S3 2540 UMR_MSEC__10_1_0_S6_S3 0 2540 /end CHARACTERISTIC
/begin CHARACTERISTIC TD_STOLGLS12_EL "max. tol. Schleifzeitdifferenz GLS" VALUE 0x26E6B9 kw_ui8_S6_S3 2540 UMR_MSEC__10_1_0_S6_S3 0 2540 /end CHARACTERISTIC
/begin CHARACTERISTIC K_WNGGRGLSPKZU12 "Korrekturfaktor, wenn gemessene Schleifzeit zu gross (oberhalb der Toleranz) bei Regelung KZU" VALUE 0x26DA14 kw_ui16_S6_S3 65530 UMR_U_MINSEC2_1_1_0_S6_S3 0 65530 /end CHARACTERISTIC
/begin CHARACTERISTIC K_WNGGRGLSPKZU12_EL "Korrekturfaktor, wenn gemessene Schleifzeit zu gross (oberhalb der Toleranz) bei Regelung KZU" VALUE 0x26DA16 kw_ui16_S6_S3 65530 UMR_U_MINSEC2_1_1_0_S6_S3 0 65530 /end CHARACTERISTIC
/begin CHARACTERISTIC K_WNGGRGLSPKAB12 "Korrekturfaktor, wenn gemessene Schleifzeit zu gross (oberhalb der Toleranz) bei Regelung KAB" VALUE 0x26DA18 kw_ui16_S6_S3 65530 UMR_U_MINSEC2_1_1_0_S6_S3 0 65530 /end CHARACTERISTIC
/begin CHARACTERISTIC K_WNGGRGLSPKAB12_EL "Korrekturfaktor, wenn gemessene Schleifzeit zu gross (oberhalb der Toleranz) bei Regelung KAB" VALUE 0x26DA1A kw_ui16_S6_S3 65530 UMR_U_MINSEC2_1_1_0_S6_S3 0 65530 /end CHARACTERISTIC
/begin CHARACTERISTIC K_WNGKLGLSPKZU12 "Korrekturfaktor, wenn gemessene Schleifzeit zu klein (unterhalb der Toleranz) bei Regelung KZU" VALUE 0x26DA1C kw_ui16_S6_S3 65530 UMR_U_MINSEC2_1_1_0_S6_S3 0 65530 /end CHARACTERISTIC
/begin CHARACTERISTIC K_WNGKLGLSPKZU12_EL "Korrekturfaktor, wenn gemessene Schleifzeit zu klein (unterhalb der Toleranz) bei Regelung KZU" VALUE 0x26DA1E kw_ui16_S6_S3 65530 UMR_U_MINSEC2_1_1_0_S6_S3 0 65530 /end CHARACTERISTIC
/begin CHARACTERISTIC K_WNGKLGLSPKAB12 "Korrekturfaktor, wenn gemessene Schleifzeit zu klein (unterhalb der Toleranz) bei Regelung KAB" VALUE 0x26DA20 kw_ui16_S6_S3 65530 UMR_U_MINSEC2_1_1_0_S6_S3 0 65530 /end CHARACTERISTIC
/begin CHARACTERISTIC K_WNGKLGLSPKAB12_EL "Korrekturfaktor, wenn gemessene Schleifzeit zu klein (unterhalb der Toleranz) bei Regelung KAB" VALUE 0x26DA22 kw_ui16_S6_S3 65530 UMR_U_MINSEC2_1_1_0_S6_S3 0 65530 /end CHARACTERISTIC
/begin CHARACTERISTIC KI_GLSKAB12 "Integralfaktor PID-Regler GLS" VALUE 0x26DA24 kw_ui16_S6_S3 10000 UMR_MBARMINSEC_10MSEC_1_1_0_S6_S3 0 10000 /end CHARACTERISTIC
/begin CHARACTERISTIC KI_GLSKAB12_EL "Integralfaktor PID-Regler GLS" VALUE 0x26DA26 kw_ui16_S6_S3 10000 UMR_MBARMINSEC_10MSEC_1_1_0_S6_S3 0 10000 /end CHARACTERISTIC
/begin CHARACTERISTIC KP_GLSKAB12 "Proportionalfaktor PID-Regler GLS" VALUE 0x26DA28 kw_ui16_S6_S3 10000 UMR_MBARMINSEC__1_1_0_S6_S3 0 10000 /end CHARACTERISTIC
/begin CHARACTERISTIC KP_GLSKAB12_EL "Proportionalfaktor PID-Regler GLS" VALUE 0x26DA2A kw_ui16_S6_S3 10000 UMR_MBARMINSEC__1_1_0_S6_S3 0 10000 /end CHARACTERISTIC
/begin CHARACTERISTIC T_FNGTGLSENDE12 "Filterwert für Filterung Sollgradient bei HS" VALUE 0x26E6BA kw_ui8_S6_S3 254 UMR_MSEC__1_1_0_S6_S3 0 254 /end CHARACTERISTIC
/begin CHARACTERISTIC W_NGTGLSENDE12 "Endwert für Filterung Sollgradient bei HS" VALUE 0x26DA2C kw_si16_S6_S3 5000 UMR_U_MINSEC_1_1_0_S6_S3 -5000 0 /end CHARACTERISTIC
/begin CHARACTERISTIC KL_TVGLSKABCG12 "Verzoegerungszeit GLS-Beginn" CURVE 0x239854 kl_ui8_S6_S3 2540 UMR_MSEC__10_1_0_S6_S3 0 2540
 /begin AXIS_DESCR STD_AXIS zff_atsys._.iSignale._.obj.sig_c_getr UMR_GRADC__1_1_M40_S6_S3 3 -40 150 DEPOSIT ABSOLUTE MONOTONY MON_INCREASE /end AXIS_DESCR
/end CHARACTERISTIC
/begin CHARACTERISTIC KL_MPT_WNGTGLS_INIT12 "Filterkonstante Sollgradient PT1-Filter" CURVE 0x239860 kl_si16_S6_S3 0.99 UMR___1_100_0_S6_S3 0.01 1
 /begin AXIS_DESCR STD_AXIS NO_INPUT_QUANTITY UMR_U_MINSEC_10000_32767_0_S6_S3 3 -9765.92303232 9765.92303232 DEPOSIT ABSOLUTE MONOTONY MON_INCREASE /end AXIS_DESCR
/end CHARACTERISTIC
/begin CHARACTERISTIC KL_NDGLSPOSHS23 "Drehzahlschwelle positiv fuer den Start der GLS bei HS" CURVE 0x239870 kl_si16_S6_S3 8000 UMR_U_MIN_1_1_0_S6_S3 0 8000
 /begin AXIS_DESCR STD_AXIS zff_atsys._.iSignale._.obj.sig_m_t UMR_NM__1_1_0_S6_S3 4 -400 1640 DEPOSIT ABSOLUTE MONOTONY MON_INCREASE /end AXIS_DESCR
/end CHARACTERISTIC
/begin CHARACTERISTIC KL_NDGLSNEGHS23 "Drehzahlschwelle negativ fuer den Start der GLS bei HS" CURVE 0x239884 kl_si16_S6_S3 8000 UMR_U_MIN_1_1_0_S6_S3 -8000 0
 /begin AXIS_DESCR STD_AXIS zff_atsys._.iSignale._.obj.sig_m_t UMR_NM__1_1_0_S6_S3 4 -400 1640 DEPOSIT ABSOLUTE MONOTONY MON_INCREASE /end AXIS_DESCR
/end CHARACTERISTIC
/begin CHARACTERISTIC KF_NGTGLSHS23 "Turbinendrehzahlgradient fuer Startbedingung der GLS HS" MAP 0x239898 kf_si16_S6_S3 32000 UMR_U_MINSEC_1_1_0_S6_S3 -32000 0
 /begin AXIS_DESCR STD_AXIS zff_atsys._.iSignale._.obj.sig_m_t UMR_NM__1_1_0_S6_S3 6 -400 1640 DEPOSIT ABSOLUTE MONOTONY MON_INCREASE /end AXIS_DESCR
 /begin AXIS_DESCR STD_AXIS zff_atsys._.iSignale._.obj.sig_n_t UMR_U_MIN_1_1_0_S6_S3 4 0 8160 DEPOSIT ABSOLUTE MONOTONY MON_INCREASE /end AXIS_DESCR
/end CHARACTERISTIC
/begin CHARACTERISTIC KL_UMSCHGLSKZU23 "Momentenschwelle zu Regelumschaltung" CURVE 0x2398E4 kl_si16_S6_S3 1400 UMR_NM__1_1_0_S6_S3 -100 1300
 /begin AXIS_DESCR STD_AXIS zff_atsys._.iSignale._.obj.sig_c_getr UMR_GRADC__1_1_M40_S6_S3 4 -40 215 DEPOSIT ABSOLUTE MONOTONY MON_INCREASE /end AXIS_DESCR
/end CHARACTERISTIC
/begin CHARACTERISTIC KP_GLSKZU23 "Proportionalfaktor PID-Regler GLS" VALUE 0x26DA2E kw_ui16_S6_S3 10000 UMR_MBARMINSEC__1_1_0_S6_S3 0 10000 /end CHARACTERISTIC
/begin CHARACTERISTIC KP_GLSKZU23_EL "Proportionalfaktor PID-Regler GLS" VALUE 0x26DA30 kw_ui16_S6_S3 10000 UMR_MBARMINSEC__1_1_0_S6_S3 0 10000 /end CHARACTERISTIC
/begin CHARACTERISTIC KI_GLSKZU23 "Integralfaktor PID-Regler GLS" VALUE 0x26DA32 kw_ui16_S6_S3 10000 UMR_MBARMINSEC_10MSEC_1_1_0_S6_S3 0 10000 /end CHARACTERISTIC
/begin CHARACTERISTIC KI_GLSKZU23_EL "Integralfaktor PID-Regler GLS" VALUE 0x26DA34 kw_ui16_S6_S3 10000 UMR_MBARMINSEC_10MSEC_1_1_0_S6_S3 0 10000 /end CHARACTERISTIC
/begin CHARACTERISTIC TD_STOLGLS23 "max. tol. Schleifzeitdifferenz GLS" VALUE 0x26E6BB kw_ui8_S6_S3 2540 UMR_MSEC__10_1_0_S6_S3 0 2540 /end CHARACTERISTIC
/begin CHARACTERISTIC TD_STOLGLS23_EL "max. tol. Schleifzeitdifferenz GLS" VALUE 0x26E6BC kw_ui8_S6_S3 2540 UMR_MSEC__10_1_0_S6_S3 0 2540 /end CHARACTERISTIC
/begin CHARACTERISTIC K_WNGGRGLSPKZU23 "Korrekturfaktor, wenn gemessene Schleifzeit zu gross (oberhalb der Toleranz) bei Regelung KZU" VALUE 0x26DA36 kw_ui16_S6_S3 65530 UMR_U_MINSEC2_1_1_0_S6_S3 0 65530 /end CHARACTERISTIC
/begin CHARACTERISTIC K_WNGGRGLSPKZU23_EL "Korrekturfaktor, wenn gemessene Schleifzeit zu gross (oberhalb der Toleranz) bei Regelung KZU" VALUE 0x26DA38 kw_ui16_S6_S3 65530 UMR_U_MINSEC2_1_1_0_S6_S3 0 65530 /end CHARACTERISTIC
/begin CHARACTERISTIC K_WNGGRGLSPKAB23 "Korrekturfaktor, wenn gemessene Schleifzeit zu gross (oberhalb der Toleranz) bei Regelung KAB" VALUE 0x26DA3A kw_ui16_S6_S3 65530 UMR_U_MINSEC2_1_1_0_S6_S3 0 65530 /end CHARACTERISTIC
/begin CHARACTERISTIC K_WNGGRGLSPKAB23_EL "Korrekturfaktor, wenn gemessene Schleifzeit zu gross (oberhalb der Toleranz) bei Regelung KAB" VALUE 0x26DA3C kw_ui16_S6_S3 65530 UMR_U_MINSEC2_1_1_0_S6_S3 0 65530 /end CHARACTERISTIC
/begin CHARACTERISTIC K_WNGKLGLSPKZU23 "Korrekturfaktor, wenn gemessene Schleifzeit zu klein (unterhalb der Toleranz) bei Regelung KZU" VALUE 0x26DA3E kw_ui16_S6_S3 65530 UMR_U_MINSEC2_1_1_0_S6_S3 0 65530 /end CHARACTERISTIC
/begin CHARACTERISTIC K_WNGKLGLSPKZU23_EL "Korrekturfaktor, wenn gemessene Schleifzeit zu klein (unterhalb der Toleranz) bei Regelung KZU" VALUE 0x26DA40 kw_ui16_S6_S3 65530 UMR_U_MINSEC2_1_1_0_S6_S3 0 65530 /end CHARACTERISTIC
/begin CHARACTERISTIC K_WNGKLGLSPKAB23 "Korrekturfaktor, wenn gemessene Schleifzeit zu klein (unterhalb der Toleranz) bei Regelung KAB" VALUE 0x26DA42 kw_ui16_S6_S3 65530 UMR_U_MINSEC2_1_1_0_S6_S3 0 65530 /end CHARACTERISTIC
/begin CHARACTERISTIC K_WNGKLGLSPKAB23_EL "Korrekturfaktor, wenn gemessene Schleifzeit zu klein (unterhalb der Toleranz) bei Regelung KAB" VALUE 0x26DA44 kw_ui16_S6_S3 65530 UMR_U_MINSEC2_1_1_0_S6_S3 0 65530 /end CHARACTERISTIC
/begin CHARACTERISTIC KI_GLSKAB23 "Integralfaktor PID-Regler GLS" VALUE 0x26DA46 kw_ui16_S6_S3 10000 UMR_MBARMINSEC_10MSEC_1_1_0_S6_S3 0 10000 /end CHARACTERISTIC
/begin CHARACTERISTIC KI_GLSKAB23_EL "Integralfaktor PID-Regler GLS" VALUE 0x26DA48 kw_ui16_S6_S3 10000 UMR_MBARMINSEC_10MSEC_1_1_0_S6_S3 0 10000 /end CHARACTERISTIC
/begin CHARACTERISTIC KP_GLSKAB23 "Proportionalfaktor PID-Regler GLS" VALUE 0x26DA4A kw_ui16_S6_S3 10000 UMR_MBARMINSEC__1_1_0_S6_S3 0 10000 /end CHARACTERISTIC
/begin CHARACTERISTIC KP_GLSKAB23_EL "Proportionalfaktor PID-Regler GLS" VALUE 0x26DA4C kw_ui16_S6_S3 10000 UMR_MBARMINSEC__1_1_0_S6_S3 0 10000 /end CHARACTERISTIC
/begin CHARACTERISTIC T_FNGTGLSENDE23 "Filterwert für Filterung Sollgradient bei HS" VALUE 0x26E6BD kw_ui8_S6_S3 254 UMR_MSEC__1_1_0_S6_S3 0 254 /end CHARACTERISTIC
/begin CHARACTERISTIC W_NGTGLSENDE23 "Endwert für Filterung Sollgradient bei HS" VALUE 0x26DA4E kw_si16_S6_S3 5000 UMR_U_MINSEC_1_1_0_S6_S3 -5000 0 /end CHARACTERISTIC
/begin CHARACTERISTIC KL_TVGLSKABCG23 "Verzoegerungszeit GLS-Beginn" CURVE 0x2398F8 kl_ui8_S6_S3 2540 UMR_MSEC__10_1_0_S6_S3 0 2540
 /begin AXIS_DESCR STD_AXIS zff_atsys._.iSignale._.obj.sig_c_getr UMR_GRADC__1_1_M40_S6_S3 3 -40 150 DEPOSIT ABSOLUTE MONOTONY MON_INCREASE /end AXIS_DESCR
/end CHARACTERISTIC
/begin CHARACTERISTIC KL_MPT_WNGTGLS_INIT23 "Filterkonstante Sollgradient PT1-Filter" CURVE 0x239904 kl_si16_S6_S3 0.99 UMR___1_100_0_S6_S3 0.01 1
 /begin AXIS_DESCR STD_AXIS NO_INPUT_QUANTITY UMR_U_MINSEC_10000_32767_0_S6_S3 3 -9765.92303232 9765.92303232 DEPOSIT ABSOLUTE MONOTONY MON_INCREASE /end AXIS_DESCR
/end CHARACTERISTIC
/begin CHARACTERISTIC KL_NDGLSPOSHS34 "Drehzahlschwelle positiv fuer den Start der GLS bei HS" CURVE 0x239914 kl_si16_S6_S3 8000 UMR_U_MIN_1_1_0_S6_S3 0 8000
 /begin AXIS_DESCR STD_AXIS zff_atsys._.iSignale._.obj.sig_m_t UMR_NM__1_1_0_S6_S3 4 -400 1640 DEPOSIT ABSOLUTE MONOTONY MON_INCREASE /end AXIS_DESCR
/end CHARACTERISTIC
/begin CHARACTERISTIC KL_NDGLSNEGHS34 "Drehzahlschwelle negativ fuer den Start der GLS bei HS" CURVE 0x239928 kl_si16_S6_S3 8000 UMR_U_MIN_1_1_0_S6_S3 -8000 0
 /begin AXIS_DESCR STD_AXIS zff_atsys._.iSignale._.obj.sig_m_t UMR_NM__1_1_0_S6_S3 4 -400 1640 DEPOSIT ABSOLUTE MONOTONY MON_INCREASE /end AXIS_DESCR
/end CHARACTERISTIC
/begin CHARACTERISTIC KF_NGTGLSHS34 "Turbinendrehzahlgradient fuer Startbedingung der GLS HS" MAP 0x23993C kf_si16_S6_S3 32000 UMR_U_MINSEC_1_1_0_S6_S3 -32000 0
 /begin AXIS_DESCR STD_AXIS zff_atsys._.iSignale._.obj.sig_m_t UMR_NM__1_1_0_S6_S3 6 -400 1640 DEPOSIT ABSOLUTE MONOTONY MON_INCREASE /end AXIS_DESCR
 /begin AXIS_DESCR STD_AXIS zff_atsys._.iSignale._.obj.sig_n_t UMR_U_MIN_1_1_0_S6_S3 4 0 8160 DEPOSIT ABSOLUTE MONOTONY MON_INCREASE /end AXIS_DESCR
/end CHARACTERISTIC
/begin CHARACTERISTIC KL_UMSCHGLSKZU34 "Momentenschwelle zu Regelumschaltung" CURVE 0x239988 kl_si16_S6_S3 1400 UMR_NM__1_1_0_S6_S3 -100 1300
 /begin AXIS_DESCR STD_AXIS zff_atsys._.iSignale._.obj.sig_c_getr UMR_GRADC__1_1_M40_S6_S3 4 -40 215 DEPOSIT ABSOLUTE MONOTONY MON_INCREASE /end AXIS_DESCR
/end CHARACTERISTIC
/begin CHARACTERISTIC KP_GLSKZU34 "Proportionalfaktor PID-Regler GLS" VALUE 0x26DA50 kw_ui16_S6_S3 10000 UMR_MBARMINSEC__1_1_0_S6_S3 0 10000 /end CHARACTERISTIC
/begin CHARACTERISTIC KP_GLSKZU34_EL "Proportionalfaktor PID-Regler GLS" VALUE 0x26DA52 kw_ui16_S6_S3 10000 UMR_MBARMINSEC__1_1_0_S6_S3 0 10000 /end CHARACTERISTIC
/begin CHARACTERISTIC KI_GLSKZU34 "Integralfaktor PID-Regler GLS" VALUE 0x26DA54 kw_ui16_S6_S3 10000 UMR_MBARMINSEC_10MSEC_1_1_0_S6_S3 0 10000 /end CHARACTERISTIC
/begin CHARACTERISTIC KI_GLSKZU34_EL "Integralfaktor PID-Regler GLS" VALUE 0x26DA56 kw_ui16_S6_S3 10000 UMR_MBARMINSEC_10MSEC_1_1_0_S6_S3 0 10000 /end CHARACTERISTIC
/begin CHARACTERISTIC TD_STOLGLS34 "max. tol. Schleifzeitdifferenz GLS" VALUE 0x26E6BE kw_ui8_S6_S3 2540 UMR_MSEC__10_1_0_S6_S3 0 2540 /end CHARACTERISTIC
/begin CHARACTERISTIC TD_STOLGLS34_EL "max. tol. Schleifzeitdifferenz GLS" VALUE 0x26E6BF kw_ui8_S6_S3 2540 UMR_MSEC__10_1_0_S6_S3 0 2540 /end CHARACTERISTIC
/begin CHARACTERISTIC K_WNGGRGLSPKZU34 "Korrekturfaktor, wenn gemessene Schleifzeit zu gross (oberhalb der Toleranz) bei Regelung KZU" VALUE 0x26DA58 kw_ui16_S6_S3 65530 UMR_U_MINSEC2_1_1_0_S6_S3 0 65530 /end CHARACTERISTIC
/begin CHARACTERISTIC K_WNGGRGLSPKZU34_EL "Korrekturfaktor, wenn gemessene Schleifzeit zu gross (oberhalb der Toleranz) bei Regelung KZU" VALUE 0x26DA5A kw_ui16_S6_S3 65530 UMR_U_MINSEC2_1_1_0_S6_S3 0 65530 /end CHARACTERISTIC
/begin CHARACTERISTIC K_WNGGRGLSPKAB34 "Korrekturfaktor, wenn gemessene Schleifzeit zu gross (oberhalb der Toleranz) bei Regelung KAB" VALUE 0x26DA5C kw_ui16_S6_S3 65530 UMR_U_MINSEC2_1_1_0_S6_S3 0 65530 /end CHARACTERISTIC
/begin CHARACTERISTIC K_WNGGRGLSPKAB34_EL "Korrekturfaktor, wenn gemessene Schleifzeit zu gross (oberhalb der Toleranz) bei Regelung KAB" VALUE 0x26DA5E kw_ui16_S6_S3 65530 UMR_U_MINSEC2_1_1_0_S6_S3 0 65530 /end CHARACTERISTIC
/begin CHARACTERISTIC K_WNGKLGLSPKZU34 "Korrekturfaktor, wenn gemessene Schleifzeit zu klein (unterhalb der Toleranz) bei Regelung KZU" VALUE 0x26DA60 kw_ui16_S6_S3 65530 UMR_U_MINSEC2_1_1_0_S6_S3 0 65530 /end CHARACTERISTIC
/begin CHARACTERISTIC K_WNGKLGLSPKZU34_EL "Korrekturfaktor, wenn gemessene Schleifzeit zu klein (unterhalb der Toleranz) bei Regelung KZU" VALUE 0x26DA62 kw_ui16_S6_S3 65530 UMR_U_MINSEC2_1_1_0_S6_S3 0 65530 /end CHARACTERISTIC
/begin CHARACTERISTIC K_WNGKLGLSPKAB34 "Korrekturfaktor, wenn gemessene Schleifzeit zu klein (unterhalb der Toleranz) bei Regelung KAB" VALUE 0x26DA64 kw_ui16_S6_S3 65530 UMR_U_MINSEC2_1_1_0_S6_S3 0 65530 /end CHARACTERISTIC
/begin CHARACTERISTIC K_WNGKLGLSPKAB34_EL "Korrekturfaktor, wenn gemessene Schleifzeit zu klein (unterhalb der Toleranz) bei Regelung KAB" VALUE 0x26DA66 kw_ui16_S6_S3 65530 UMR_U_MINSEC2_1_1_0_S6_S3 0 65530 /end CHARACTERISTIC
/begin CHARACTERISTIC KI_GLSKAB34 "Integralfaktor PID-Regler GLS" VALUE 0x26DA68 kw_ui16_S6_S3 10000 UMR_MBARMINSEC_10MSEC_1_1_0_S6_S3 0 10000 /end CHARACTERISTIC
/begin CHARACTERISTIC KI_GLSKAB34_EL "Integralfaktor PID-Regler GLS" VALUE 0x26DA6A kw_ui16_S6_S3 10000 UMR_MBARMINSEC_10MSEC_1_1_0_S6_S3 0 10000 /end CHARACTERISTIC
/begin CHARACTERISTIC KP_GLSKAB34 "Proportionalfaktor PID-Regler GLS" VALUE 0x26DA6C kw_ui16_S6_S3 10000 UMR_MBARMINSEC__1_1_0_S6_S3 0 10000 /end CHARACTERISTIC
/begin CHARACTERISTIC KP_GLSKAB34_EL "Proportionalfaktor PID-Regler GLS" VALUE 0x26DA6E kw_ui16_S6_S3 10000 UMR_MBARMINSEC__1_1_0_S6_S3 0 10000 /end CHARACTERISTIC
/begin CHARACTERISTIC T_FNGTGLSENDE34 "Filterwert für Filterung Sollgradient bei HS" VALUE 0x26E6C0 kw_ui8_S6_S3 254 UMR_MSEC__1_1_0_S6_S3 0 254 /end CHARACTERISTIC
/begin CHARACTERISTIC W_NGTGLSENDE34 "Endwert für Filterung Sollgradient bei HS" VALUE 0x26DA70 kw_si16_S6_S3 5000 UMR_U_MINSEC_1_1_0_S6_S3 -5000 0 /end CHARACTERISTIC
/begin CHARACTERISTIC KL_TVGLSKABCG34 "Verzoegerungszeit GLS-Beginn" CURVE 0x23999C kl_ui8_S6_S3 2540 UMR_MSEC__10_1_0_S6_S3 0 2540
 /begin AXIS_DESCR STD_AXIS zff_atsys._.iSignale._.obj.sig_c_getr UMR_GRADC__1_1_M40_S6_S3 3 -40 150 DEPOSIT ABSOLUTE MONOTONY MON_INCREASE /end AXIS_DESCR
/end CHARACTERISTIC
/begin CHARACTERISTIC KL_MPT_WNGTGLS_INIT34 "Filterkonstante Sollgradient PT1-Filter" CURVE 0x2399A8 kl_si16_S6_S3 0.99 UMR___1_100_0_S6_S3 0.01 1
 /begin AXIS_DESCR STD_AXIS NO_INPUT_QUANTITY UMR_U_MINSEC_10000_32767_0_S6_S3 3 -9765.92303232 9765.92303232 DEPOSIT ABSOLUTE MONOTONY MON_INCREASE /end AXIS_DESCR
/end CHARACTERISTIC
/begin CHARACTERISTIC KL_NDGLSPOSHS45 "Drehzahlschwelle positiv fuer den Start der GLS bei HS" CURVE 0x2399B8 kl_si16_S6_S3 8000 UMR_U_MIN_1_1_0_S6_S3 0 8000
 /begin AXIS_DESCR STD_AXIS zff_atsys._.iSignale._.obj.sig_m_t UMR_NM__1_1_0_S6_S3 4 -400 1640 DEPOSIT ABSOLUTE MONOTONY MON_INCREASE /end AXIS_DESCR
/end CHARACTERISTIC
/begin CHARACTERISTIC KL_NDGLSNEGHS45 "Drehzahlschwelle negativ fuer den Start der GLS bei HS" CURVE 0x2399CC kl_si16_S6_S3 8000 UMR_U_MIN_1_1_0_S6_S3 -8000 0
 /begin AXIS_DESCR STD_AXIS zff_atsys._.iSignale._.obj.sig_m_t UMR_NM__1_1_0_S6_S3 4 -400 1640 DEPOSIT ABSOLUTE MONOTONY MON_INCREASE /end AXIS_DESCR
/end CHARACTERISTIC
/begin CHARACTERISTIC KF_NGTGLSHS45 "Turbinendrehzahlgradient fuer Startbedingung der GLS HS" MAP 0x2399E0 kf_si16_S6_S3 32000 UMR_U_MINSEC_1_1_0_S6_S3 -32000 0
 /begin AXIS_DESCR STD_AXIS zff_atsys._.iSignale._.obj.sig_m_t UMR_NM__1_1_0_S6_S3 6 -400 1640 DEPOSIT ABSOLUTE MONOTONY MON_INCREASE /end AXIS_DESCR
 /begin AXIS_DESCR STD_AXIS zff_atsys._.iSignale._.obj.sig_n_t UMR_U_MIN_1_1_0_S6_S3 4 0 8160 DEPOSIT ABSOLUTE MONOTONY MON_INCREASE /end AXIS_DESCR
/end CHARACTERISTIC
/begin CHARACTERISTIC KL_UMSCHGLSKZU45 "Momentenschwelle zu Regelumschaltung" CURVE 0x239A2C kl_si16_S6_S3 1400 UMR_NM__1_1_0_S6_S3 -100 1300
 /begin AXIS_DESCR STD_AXIS zff_atsys._.iSignale._.obj.sig_c_getr UMR_GRADC__1_1_M40_S6_S3 4 -40 215 DEPOSIT ABSOLUTE MONOTONY MON_INCREASE /end AXIS_DESCR
/end CHARACTERISTIC
/begin CHARACTERISTIC KP_GLSKZU45 "Proportionalfaktor PID-Regler GLS" VALUE 0x26DA72 kw_ui16_S6_S3 10000 UMR_MBARMINSEC__1_1_0_S6_S3 0 10000 /end CHARACTERISTIC
/begin CHARACTERISTIC KP_GLSKZU45_EL "Proportionalfaktor PID-Regler GLS" VALUE 0x26DA74 kw_ui16_S6_S3 10000 UMR_MBARMINSEC__1_1_0_S6_S3 0 10000 /end CHARACTERISTIC
/begin CHARACTERISTIC KI_GLSKZU45 "Integralfaktor PID-Regler GLS" VALUE 0x26DA76 kw_ui16_S6_S3 10000 UMR_MBARMINSEC_10MSEC_1_1_0_S6_S3 0 10000 /end CHARACTERISTIC
/begin CHARACTERISTIC KI_GLSKZU45_EL "Integralfaktor PID-Regler GLS" VALUE 0x26DA78 kw_ui16_S6_S3 10000 UMR_MBARMINSEC_10MSEC_1_1_0_S6_S3 0 10000 /end CHARACTERISTIC
/begin CHARACTERISTIC TD_STOLGLS45 "max. tol. Schleifzeitdifferenz GLS" VALUE 0x26E6C1 kw_ui8_S6_S3 2540 UMR_MSEC__10_1_0_S6_S3 0 2540 /end CHARACTERISTIC
/begin CHARACTERISTIC TD_STOLGLS45_EL "max. tol. Schleifzeitdifferenz GLS" VALUE 0x26E6C2 kw_ui8_S6_S3 2540 UMR_MSEC__10_1_0_S6_S3 0 2540 /end CHARACTERISTIC
/begin CHARACTERISTIC K_WNGGRGLSPKZU45 "Korrekturfaktor, wenn gemessene Schleifzeit zu gross (oberhalb der Toleranz) bei Regelung KZU" VALUE 0x26DA7A kw_ui16_S6_S3 65530 UMR_U_MINSEC2_1_1_0_S6_S3 0 65530 /end CHARACTERISTIC
/begin CHARACTERISTIC K_WNGGRGLSPKZU45_EL "Korrekturfaktor, wenn gemessene Schleifzeit zu gross (oberhalb der Toleranz) bei Regelung KZU" VALUE 0x26DA7C kw_ui16_S6_S3 65530 UMR_U_MINSEC2_1_1_0_S6_S3 0 65530 /end CHARACTERISTIC
/begin CHARACTERISTIC K_WNGGRGLSPKAB45 "Korrekturfaktor, wenn gemessene Schleifzeit zu gross (oberhalb der Toleranz) bei Regelung KAB" VALUE 0x26DA7E kw_ui16_S6_S3 65530 UMR_U_MINSEC2_1_1_0_S6_S3 0 65530 /end CHARACTERISTIC
/begin CHARACTERISTIC K_WNGGRGLSPKAB45_EL "Korrekturfaktor, wenn gemessene Schleifzeit zu gross (oberhalb der Toleranz) bei Regelung KAB" VALUE 0x26DA80 kw_ui16_S6_S3 65530 UMR_U_MINSEC2_1_1_0_S6_S3 0 65530 /end CHARACTERISTIC
/begin CHARACTERISTIC K_WNGKLGLSPKZU45 "Korrekturfaktor, wenn gemessene Schleifzeit zu klein (unterhalb der Toleranz) bei Regelung KZU" VALUE 0x26DA82 kw_ui16_S6_S3 65530 UMR_U_MINSEC2_1_1_0_S6_S3 0 65530 /end CHARACTERISTIC
/begin CHARACTERISTIC K_WNGKLGLSPKZU45_EL "Korrekturfaktor, wenn gemessene Schleifzeit zu klein (unterhalb der Toleranz) bei Regelung KZU" VALUE 0x26DA84 kw_ui16_S6_S3 65530 UMR_U_MINSEC2_1_1_0_S6_S3 0 65530 /end CHARACTERISTIC
/begin CHARACTERISTIC K_WNGKLGLSPKAB45 "Korrekturfaktor, wenn gemessene Schleifzeit zu klein (unterhalb der Toleranz) bei Regelung KAB" VALUE 0x26DA86 kw_ui16_S6_S3 65530 UMR_U_MINSEC2_1_1_0_S6_S3 0 65530 /end CHARACTERISTIC
/begin CHARACTERISTIC K_WNGKLGLSPKAB45_EL "Korrekturfaktor, wenn gemessene Schleifzeit zu klein (unterhalb der Toleranz) bei Regelung KAB" VALUE 0x26DA88 kw_ui16_S6_S3 65530 UMR_U_MINSEC2_1_1_0_S6_S3 0 65530 /end CHARACTERISTIC
/begin CHARACTERISTIC KI_GLSKAB45 "Integralfaktor PID-Regler GLS" VALUE 0x26DA8A kw_ui16_S6_S3 10000 UMR_MBARMINSEC_10MSEC_1_1_0_S6_S3 0 10000 /end CHARACTERISTIC
/begin CHARACTERISTIC KI_GLSKAB45_EL "Integralfaktor PID-Regler GLS" VALUE 0x26DA8C kw_ui16_S6_S3 10000 UMR_MBARMINSEC_10MSEC_1_1_0_S6_S3 0 10000 /end CHARACTERISTIC
/begin CHARACTERISTIC KP_GLSKAB45 "Proportionalfaktor PID-Regler GLS" VALUE 0x26DA8E kw_ui16_S6_S3 10000 UMR_MBARMINSEC__1_1_0_S6_S3 0 10000 /end CHARACTERISTIC
/begin CHARACTERISTIC KP_GLSKAB45_EL "Proportionalfaktor PID-Regler GLS" VALUE 0x26DA90 kw_ui16_S6_S3 10000 UMR_MBARMINSEC__1_1_0_S6_S3 0 10000 /end CHARACTERISTIC
/begin CHARACTERISTIC T_FNGTGLSENDE45 "Filterwert für Filterung Sollgradient bei HS" VALUE 0x26E6C3 kw_ui8_S6_S3 254 UMR_MSEC__1_1_0_S6_S3 0 254 /end CHARACTERISTIC
/begin CHARACTERISTIC W_NGTGLSENDE45 "Endwert für Filterung Sollgradient bei HS" VALUE 0x26DA92 kw_si16_S6_S3 5000 UMR_U_MINSEC_1_1_0_S6_S3 -5000 0 /end CHARACTERISTIC
/begin CHARACTERISTIC KL_TVGLSKABCG45 "Verzoegerungszeit GLS-Beginn" CURVE 0x239A40 kl_ui8_S6_S3 2540 UMR_MSEC__10_1_0_S6_S3 0 2540
 /begin AXIS_DESCR STD_AXIS zff_atsys._.iSignale._.obj.sig_c_getr UMR_GRADC__1_1_M40_S6_S3 3 -40 150 DEPOSIT ABSOLUTE MONOTONY MON_INCREASE /end AXIS_DESCR
/end CHARACTERISTIC
/begin CHARACTERISTIC KL_MPT_WNGTGLS_INIT45 "Filterkonstante Sollgradient PT1-Filter" CURVE 0x239A4C kl_si16_S6_S3 0.99 UMR___1_100_0_S6_S3 0.01 1
 /begin AXIS_DESCR STD_AXIS NO_INPUT_QUANTITY UMR_U_MINSEC_10000_32767_0_S6_S3 3 -9765.92303232 9765.92303232 DEPOSIT ABSOLUTE MONOTONY MON_INCREASE /end AXIS_DESCR
/end CHARACTERISTIC
/begin CHARACTERISTIC KL_NDGLSPOSHS56 "Drehzahlschwelle positiv fuer den Start der GLS bei HS" CURVE 0x239A5C kl_si16_S6_S3 8000 UMR_U_MIN_1_1_0_S6_S3 0 8000
 /begin AXIS_DESCR STD_AXIS zff_atsys._.iSignale._.obj.sig_m_t UMR_NM__1_1_0_S6_S3 4 -400 1640 DEPOSIT ABSOLUTE MONOTONY MON_INCREASE /end AXIS_DESCR
/end CHARACTERISTIC
/begin CHARACTERISTIC KL_NDGLSNEGHS56 "Drehzahlschwelle negativ fuer den Start der GLS bei HS" CURVE 0x239A70 kl_si16_S6_S3 8000 UMR_U_MIN_1_1_0_S6_S3 -8000 0
 /begin AXIS_DESCR STD_AXIS zff_atsys._.iSignale._.obj.sig_m_t UMR_NM__1_1_0_S6_S3 4 -400 1640 DEPOSIT ABSOLUTE MONOTONY MON_INCREASE /end AXIS_DESCR
/end CHARACTERISTIC
/begin CHARACTERISTIC KF_NGTGLSHS56 "Turbinendrehzahlgradient fuer Startbedingung der GLS HS" MAP 0x239A84 kf_si16_S6_S3 32000 UMR_U_MINSEC_1_1_0_S6_S3 -32000 0
 /begin AXIS_DESCR STD_AXIS zff_atsys._.iSignale._.obj.sig_m_t UMR_NM__1_1_0_S6_S3 6 -400 1640 DEPOSIT ABSOLUTE MONOTONY MON_INCREASE /end AXIS_DESCR
 /begin AXIS_DESCR STD_AXIS zff_atsys._.iSignale._.obj.sig_n_t UMR_U_MIN_1_1_0_S6_S3 4 0 8160 DEPOSIT ABSOLUTE MONOTONY MON_INCREASE /end AXIS_DESCR
/end CHARACTERISTIC
/begin CHARACTERISTIC KL_UMSCHGLSKZU56 "Momentenschwelle zu Regelumschaltung" CURVE 0x239AD0 kl_si16_S6_S3 1400 UMR_NM__1_1_0_S6_S3 -100 1300
 /begin AXIS_DESCR STD_AXIS zff_atsys._.iSignale._.obj.sig_c_getr UMR_GRADC__1_1_M40_S6_S3 4 -40 215 DEPOSIT ABSOLUTE MONOTONY MON_INCREASE /end AXIS_DESCR
/end CHARACTERISTIC
/begin CHARACTERISTIC KP_GLSKZU56 "Proportionalfaktor PID-Regler GLS" VALUE 0x26DA94 kw_ui16_S6_S3 10000 UMR_MBARMINSEC__1_1_0_S6_S3 0 10000 /end CHARACTERISTIC
/begin CHARACTERISTIC KP_GLSKZU56_EL "Proportionalfaktor PID-Regler GLS" VALUE 0x26DA96 kw_ui16_S6_S3 10000 UMR_MBARMINSEC__1_1_0_S6_S3 0 10000 /end CHARACTERISTIC
/begin CHARACTERISTIC KI_GLSKZU56 "Integralfaktor PID-Regler GLS" VALUE 0x26DA98 kw_ui16_S6_S3 10000 UMR_MBARMINSEC_10MSEC_1_1_0_S6_S3 0 10000 /end CHARACTERISTIC
/begin CHARACTERISTIC KI_GLSKZU56_EL "Integralfaktor PID-Regler GLS" VALUE 0x26DA9A kw_ui16_S6_S3 10000 UMR_MBARMINSEC_10MSEC_1_1_0_S6_S3 0 10000 /end CHARACTERISTIC
/begin CHARACTERISTIC TD_STOLGLS56 "max. tol. Schleifzeitdifferenz GLS" VALUE 0x26E6C4 kw_ui8_S6_S3 2540 UMR_MSEC__10_1_0_S6_S3 0 2540 /end CHARACTERISTIC
/begin CHARACTERISTIC TD_STOLGLS56_EL "max. tol. Schleifzeitdifferenz GLS" VALUE 0x26E6C5 kw_ui8_S6_S3 2540 UMR_MSEC__10_1_0_S6_S3 0 2540 /end CHARACTERISTIC
/begin CHARACTERISTIC K_WNGGRGLSPKZU56 "Korrekturfaktor, wenn gemessene Schleifzeit zu gross (oberhalb der Toleranz) bei Regelung KZU" VALUE 0x26DA9C kw_ui16_S6_S3 65530 UMR_U_MINSEC2_1_1_0_S6_S3 0 65530 /end CHARACTERISTIC
/begin CHARACTERISTIC K_WNGGRGLSPKZU56_EL "Korrekturfaktor, wenn gemessene Schleifzeit zu gross (oberhalb der Toleranz) bei Regelung KZU" VALUE 0x26DA9E kw_ui16_S6_S3 65530 UMR_U_MINSEC2_1_1_0_S6_S3 0 65530 /end CHARACTERISTIC
/begin CHARACTERISTIC K_WNGGRGLSPKAB56 "Korrekturfaktor, wenn gemessene Schleifzeit zu gross (oberhalb der Toleranz) bei Regelung KAB" VALUE 0x26DAA0 kw_ui16_S6_S3 65530 UMR_U_MINSEC2_1_1_0_S6_S3 0 65530 /end CHARACTERISTIC
/begin CHARACTERISTIC K_WNGGRGLSPKAB56_EL "Korrekturfaktor, wenn gemessene Schleifzeit zu gross (oberhalb der Toleranz) bei Regelung KAB" VALUE 0x26DAA2 kw_ui16_S6_S3 65530 UMR_U_MINSEC2_1_1_0_S6_S3 0 65530 /end CHARACTERISTIC
/begin CHARACTERISTIC K_WNGKLGLSPKZU56 "Korrekturfaktor, wenn gemessene Schleifzeit zu klein (unterhalb der Toleranz) bei Regelung KZU" VALUE 0x26DAA4 kw_ui16_S6_S3 65530 UMR_U_MINSEC2_1_1_0_S6_S3 0 65530 /end CHARACTERISTIC
/begin CHARACTERISTIC K_WNGKLGLSPKZU56_EL "Korrekturfaktor, wenn gemessene Schleifzeit zu klein (unterhalb der Toleranz) bei Regelung KZU" VALUE 0x26DAA6 kw_ui16_S6_S3 65530 UMR_U_MINSEC2_1_1_0_S6_S3 0 65530 /end CHARACTERISTIC
/begin CHARACTERISTIC K_WNGKLGLSPKAB56 "Korrekturfaktor, wenn gemessene Schleifzeit zu klein (unterhalb der Toleranz) bei Regelung KAB" VALUE 0x26DAA8 kw_ui16_S6_S3 65530 UMR_U_MINSEC2_1_1_0_S6_S3 0 65530 /end CHARACTERISTIC
/begin CHARACTERISTIC K_WNGKLGLSPKAB56_EL "Korrekturfaktor, wenn gemessene Schleifzeit zu klein (unterhalb der Toleranz) bei Regelung KAB" VALUE 0x26DAAA kw_ui16_S6_S3 65530 UMR_U_MINSEC2_1_1_0_S6_S3 0 65530 /end CHARACTERISTIC
/begin CHARACTERISTIC KI_GLSKAB56 "Integralfaktor PID-Regler GLS" VALUE 0x26DAAC kw_ui16_S6_S3 10000 UMR_MBARMINSEC_10MSEC_1_1_0_S6_S3 0 10000 /end CHARACTERISTIC
/begin CHARACTERISTIC KI_GLSKAB56_EL "Integralfaktor PID-Regler GLS" VALUE 0x26DAAE kw_ui16_S6_S3 10000 UMR_MBARMINSEC_10MSEC_1_1_0_S6_S3 0 10000 /end CHARACTERISTIC
/begin CHARACTERISTIC KP_GLSKAB56 "Proportionalfaktor PID-Regler GLS" VALUE 0x26DAB0 kw_ui16_S6_S3 10000 UMR_MBARMINSEC__1_1_0_S6_S3 0 10000 /end CHARACTERISTIC
/begin CHARACTERISTIC KP_GLSKAB56_EL "Proportionalfaktor PID-Regler GLS" VALUE 0x26DAB2 kw_ui16_S6_S3 10000 UMR_MBARMINSEC__1_1_0_S6_S3 0 10000 /end CHARACTERISTIC
/begin CHARACTERISTIC T_FNGTGLSENDE56 "Filterwert für Filterung Sollgradient bei HS" VALUE 0x26E6C6 kw_ui8_S6_S3 254 UMR_MSEC__1_1_0_S6_S3 0 254 /end CHARACTERISTIC
/begin CHARACTERISTIC W_NGTGLSENDE56 "Endwert für Filterung Sollgradient bei HS" VALUE 0x26DAB4 kw_si16_S6_S3 5000 UMR_U_MINSEC_1_1_0_S6_S3 -5000 0 /end CHARACTERISTIC
/begin CHARACTERISTIC KL_TVGLSKABCG56 "Verzoegerungszeit GLS-Beginn" CURVE 0x239AE4 kl_ui8_S6_S3 2540 UMR_MSEC__10_1_0_S6_S3 0 2540
 /begin AXIS_DESCR STD_AXIS zff_atsys._.iSignale._.obj.sig_c_getr UMR_GRADC__1_1_M40_S6_S3 3 -40 150 DEPOSIT ABSOLUTE MONOTONY MON_INCREASE /end AXIS_DESCR
/end CHARACTERISTIC
/begin CHARACTERISTIC KL_MPT_WNGTGLS_INIT56 "Filterkonstante Sollgradient PT1-Filter" CURVE 0x239AF0 kl_si16_S6_S3 0.99 UMR___1_100_0_S6_S3 0.01 1
 /begin AXIS_DESCR STD_AXIS NO_INPUT_QUANTITY UMR_U_MINSEC_10000_32767_0_S6_S3 3 -9765.92303232 9765.92303232 DEPOSIT ABSOLUTE MONOTONY MON_INCREASE /end AXIS_DESCR
/end CHARACTERISTIC
/begin CHARACTERISTIC KL_NDGLSPOSHS67 "Drehzahlschwelle positiv fuer den Start der GLS bei HS" CURVE 0x239B00 kl_si16_S6_S3 8000 UMR_U_MIN_1_1_0_S6_S3 0 8000
 /begin AXIS_DESCR STD_AXIS zff_atsys._.iSignale._.obj.sig_m_t UMR_NM__1_1_0_S6_S3 4 -400 1640 DEPOSIT ABSOLUTE MONOTONY MON_INCREASE /end AXIS_DESCR
/end CHARACTERISTIC
/begin CHARACTERISTIC KL_NDGLSNEGHS67 "Drehzahlschwelle negativ fuer den Start der GLS bei HS" CURVE 0x239B14 kl_si16_S6_S3 8000 UMR_U_MIN_1_1_0_S6_S3 -8000 0
 /begin AXIS_DESCR STD_AXIS zff_atsys._.iSignale._.obj.sig_m_t UMR_NM__1_1_0_S6_S3 4 -400 1640 DEPOSIT ABSOLUTE MONOTONY MON_INCREASE /end AXIS_DESCR
/end CHARACTERISTIC
/begin CHARACTERISTIC KF_NGTGLSHS67 "Turbinendrehzahlgradient fuer Startbedingung der GLS HS" MAP 0x239B28 kf_si16_S6_S3 32000 UMR_U_MINSEC_1_1_0_S6_S3 -32000 0
 /begin AXIS_DESCR STD_AXIS zff_atsys._.iSignale._.obj.sig_m_t UMR_NM__1_1_0_S6_S3 6 -400 1640 DEPOSIT ABSOLUTE MONOTONY MON_INCREASE /end AXIS_DESCR
 /begin AXIS_DESCR STD_AXIS zff_atsys._.iSignale._.obj.sig_n_t UMR_U_MIN_1_1_0_S6_S3 4 0 8160 DEPOSIT ABSOLUTE MONOTONY MON_INCREASE /end AXIS_DESCR
/end CHARACTERISTIC
/begin CHARACTERISTIC KL_UMSCHGLSKZU67 "Momentenschwelle zu Regelumschaltung" CURVE 0x239B74 kl_si16_S6_S3 1400 UMR_NM__1_1_0_S6_S3 -100 1300
 /begin AXIS_DESCR STD_AXIS zff_atsys._.iSignale._.obj.sig_c_getr UMR_GRADC__1_1_M40_S6_S3 4 -40 215 DEPOSIT ABSOLUTE MONOTONY MON_INCREASE /end AXIS_DESCR
/end CHARACTERISTIC
/begin CHARACTERISTIC KP_GLSKZU67 "Proportionalfaktor PID-Regler GLS" VALUE 0x26DAB6 kw_ui16_S6_S3 10000 UMR_MBARMINSEC__1_1_0_S6_S3 0 10000 /end CHARACTERISTIC
/begin CHARACTERISTIC KP_GLSKZU67_EL "Proportionalfaktor PID-Regler GLS" VALUE 0x26DAB8 kw_ui16_S6_S3 10000 UMR_MBARMINSEC__1_1_0_S6_S3 0 10000 /end CHARACTERISTIC
/begin CHARACTERISTIC KI_GLSKZU67 "Integralfaktor PID-Regler GLS" VALUE 0x26DABA kw_ui16_S6_S3 10000 UMR_MBARMINSEC_10MSEC_1_1_0_S6_S3 0 10000 /end CHARACTERISTIC
/begin CHARACTERISTIC KI_GLSKZU67_EL "Integralfaktor PID-Regler GLS" VALUE 0x26DABC kw_ui16_S6_S3 10000 UMR_MBARMINSEC_10MSEC_1_1_0_S6_S3 0 10000 /end CHARACTERISTIC
/begin CHARACTERISTIC TD_STOLGLS67 "max. tol. Schleifzeitdifferenz GLS" VALUE 0x26E6C7 kw_ui8_S6_S3 2540 UMR_MSEC__10_1_0_S6_S3 0 2540 /end CHARACTERISTIC
/begin CHARACTERISTIC TD_STOLGLS67_EL "max. tol. Schleifzeitdifferenz GLS" VALUE 0x26E6C8 kw_ui8_S6_S3 2540 UMR_MSEC__10_1_0_S6_S3 0 2540 /end CHARACTERISTIC
/begin CHARACTERISTIC K_WNGGRGLSPKZU67 "Korrekturfaktor, wenn gemessene Schleifzeit zu gross (oberhalb der Toleranz) bei Regelung KZU" VALUE 0x26DABE kw_ui16_S6_S3 65530 UMR_U_MINSEC2_1_1_0_S6_S3 0 65530 /end CHARACTERISTIC
/begin CHARACTERISTIC K_WNGGRGLSPKZU67_EL "Korrekturfaktor, wenn gemessene Schleifzeit zu gross (oberhalb der Toleranz) bei Regelung KZU" VALUE 0x26DAC0 kw_ui16_S6_S3 65530 UMR_U_MINSEC2_1_1_0_S6_S3 0 65530 /end CHARACTERISTIC
/begin CHARACTERISTIC K_WNGGRGLSPKAB67 "Korrekturfaktor, wenn gemessene Schleifzeit zu gross (oberhalb der Toleranz) bei Regelung KAB" VALUE 0x26DAC2 kw_ui16_S6_S3 65530 UMR_U_MINSEC2_1_1_0_S6_S3 0 65530 /end CHARACTERISTIC
/begin CHARACTERISTIC K_WNGGRGLSPKAB67_EL "Korrekturfaktor, wenn gemessene Schleifzeit zu gross (oberhalb der Toleranz) bei Regelung KAB" VALUE 0x26DAC4 kw_ui16_S6_S3 65530 UMR_U_MINSEC2_1_1_0_S6_S3 0 65530 /end CHARACTERISTIC
/begin CHARACTERISTIC K_WNGKLGLSPKZU67 "Korrekturfaktor, wenn gemessene Schleifzeit zu klein (unterhalb der Toleranz) bei Regelung KZU" VALUE 0x26DAC6 kw_ui16_S6_S3 65530 UMR_U_MINSEC2_1_1_0_S6_S3 0 65530 /end CHARACTERISTIC
/begin CHARACTERISTIC K_WNGKLGLSPKZU67_EL "Korrekturfaktor, wenn gemessene Schleifzeit zu klein (unterhalb der Toleranz) bei Regelung KZU" VALUE 0x26DAC8 kw_ui16_S6_S3 65530 UMR_U_MINSEC2_1_1_0_S6_S3 0 65530 /end CHARACTERISTIC
/begin CHARACTERISTIC K_WNGKLGLSPKAB67 "Korrekturfaktor, wenn gemessene Schleifzeit zu klein (unterhalb der Toleranz) bei Regelung KAB" VALUE 0x26DACA kw_ui16_S6_S3 65530 UMR_U_MINSEC2_1_1_0_S6_S3 0 65530 /end CHARACTERISTIC
/begin CHARACTERISTIC K_WNGKLGLSPKAB67_EL "Korrekturfaktor, wenn gemessene Schleifzeit zu klein (unterhalb der Toleranz) bei Regelung KAB" VALUE 0x26DACC kw_ui16_S6_S3 65530 UMR_U_MINSEC2_1_1_0_S6_S3 0 65530 /end CHARACTERISTIC
/begin CHARACTERISTIC KI_GLSKAB67 "Integralfaktor PID-Regler GLS" VALUE 0x26DACE kw_ui16_S6_S3 10000 UMR_MBARMINSEC_10MSEC_1_1_0_S6_S3 0 10000 /end CHARACTERISTIC
/begin CHARACTERISTIC KI_GLSKAB67_EL "Integralfaktor PID-Regler GLS" VALUE 0x26DAD0 kw_ui16_S6_S3 10000 UMR_MBARMINSEC_10MSEC_1_1_0_S6_S3 0 10000 /end CHARACTERISTIC
/begin CHARACTERISTIC KP_GLSKAB67 "Proportionalfaktor PID-Regler GLS" VALUE 0x26DAD2 kw_ui16_S6_S3 10000 UMR_MBARMINSEC__1_1_0_S6_S3 0 10000 /end CHARACTERISTIC
/begin CHARACTERISTIC KP_GLSKAB67_EL "Proportionalfaktor PID-Regler GLS" VALUE 0x26DAD4 kw_ui16_S6_S3 10000 UMR_MBARMINSEC__1_1_0_S6_S3 0 10000 /end CHARACTERISTIC
/begin CHARACTERISTIC T_FNGTGLSENDE67 "Filterwert für Filterung Sollgradient bei HS" VALUE 0x26E6C9 kw_ui8_S6_S3 254 UMR_MSEC__1_1_0_S6_S3 0 254 /end CHARACTERISTIC
/begin CHARACTERISTIC W_NGTGLSENDE67 "Endwert für Filterung Sollgradient bei HS" VALUE 0x26DAD6 kw_si16_S6_S3 5000 UMR_U_MINSEC_1_1_0_S6_S3 -5000 0 /end CHARACTERISTIC
/begin CHARACTERISTIC KL_TVGLSKABCG67 "Verzoegerungszeit GLS-Beginn" CURVE 0x239B88 kl_ui8_S6_S3 2540 UMR_MSEC__10_1_0_S6_S3 0 2540
 /begin AXIS_DESCR STD_AXIS zff_atsys._.iSignale._.obj.sig_c_getr UMR_GRADC__1_1_M40_S6_S3 3 -40 150 DEPOSIT ABSOLUTE MONOTONY MON_INCREASE /end AXIS_DESCR
/end CHARACTERISTIC
/begin CHARACTERISTIC KL_MPT_WNGTGLS_INIT67 "Filterkonstante Sollgradient PT1-Filter" CURVE 0x239B94 kl_si16_S6_S3 0.99 UMR___1_100_0_S6_S3 0.01 1
 /begin AXIS_DESCR STD_AXIS NO_INPUT_QUANTITY UMR_U_MINSEC_10000_32767_0_S6_S3 3 -9765.92303232 9765.92303232 DEPOSIT ABSOLUTE MONOTONY MON_INCREASE /end AXIS_DESCR
/end CHARACTERISTIC
/begin CHARACTERISTIC KL_NDGLSPOSHS78 "Drehzahlschwelle positiv fuer den Start der GLS bei HS" CURVE 0x239BA4 kl_si16_S6_S3 8000 UMR_U_MIN_1_1_0_S6_S3 0 8000
 /begin AXIS_DESCR STD_AXIS zff_atsys._.iSignale._.obj.sig_m_t UMR_NM__1_1_0_S6_S3 4 -400 1640 DEPOSIT ABSOLUTE MONOTONY MON_INCREASE /end AXIS_DESCR
/end CHARACTERISTIC
/begin CHARACTERISTIC KL_NDGLSNEGHS78 "Drehzahlschwelle negativ fuer den Start der GLS bei HS" CURVE 0x239BB8 kl_si16_S6_S3 8000 UMR_U_MIN_1_1_0_S6_S3 -8000 0
 /begin AXIS_DESCR STD_AXIS zff_atsys._.iSignale._.obj.sig_m_t UMR_NM__1_1_0_S6_S3 4 -400 1640 DEPOSIT ABSOLUTE MONOTONY MON_INCREASE /end AXIS_DESCR
/end CHARACTERISTIC
/begin CHARACTERISTIC KF_NGTGLSHS78 "Turbinendrehzahlgradient fuer Startbedingung der GLS HS" MAP 0x239BCC kf_si16_S6_S3 32000 UMR_U_MINSEC_1_1_0_S6_S3 -32000 0
 /begin AXIS_DESCR STD_AXIS zff_atsys._.iSignale._.obj.sig_m_t UMR_NM__1_1_0_S6_S3 6 -400 1640 DEPOSIT ABSOLUTE MONOTONY MON_INCREASE /end AXIS_DESCR
 /begin AXIS_DESCR STD_AXIS zff_atsys._.iSignale._.obj.sig_n_t UMR_U_MIN_1_1_0_S6_S3 4 0 8160 DEPOSIT ABSOLUTE MONOTONY MON_INCREASE /end AXIS_DESCR
/end CHARACTERISTIC
/begin CHARACTERISTIC KL_UMSCHGLSKZU78 "Momentenschwelle zu Regelumschaltung" CURVE 0x239C18 kl_si16_S6_S3 1400 UMR_NM__1_1_0_S6_S3 -100 1300
 /begin AXIS_DESCR STD_AXIS zff_atsys._.iSignale._.obj.sig_c_getr UMR_GRADC__1_1_M40_S6_S3 4 -40 215 DEPOSIT ABSOLUTE MONOTONY MON_INCREASE /end AXIS_DESCR
/end CHARACTERISTIC
/begin CHARACTERISTIC KP_GLSKZU78 "Proportionalfaktor PID-Regler GLS" VALUE 0x26DAD8 kw_ui16_S6_S3 10000 UMR_MBARMINSEC__1_1_0_S6_S3 0 10000 /end CHARACTERISTIC
/begin CHARACTERISTIC KP_GLSKZU78_EL "Proportionalfaktor PID-Regler GLS" VALUE 0x26DADA kw_ui16_S6_S3 10000 UMR_MBARMINSEC__1_1_0_S6_S3 0 10000 /end CHARACTERISTIC
/begin CHARACTERISTIC KI_GLSKZU78 "Integralfaktor PID-Regler GLS" VALUE 0x26DADC kw_ui16_S6_S3 10000 UMR_MBARMINSEC_10MSEC_1_1_0_S6_S3 0 10000 /end CHARACTERISTIC
/begin CHARACTERISTIC KI_GLSKZU78_EL "Integralfaktor PID-Regler GLS" VALUE 0x26DADE kw_ui16_S6_S3 10000 UMR_MBARMINSEC_10MSEC_1_1_0_S6_S3 0 10000 /end CHARACTERISTIC
/begin CHARACTERISTIC TD_STOLGLS78 "max. tol. Schleifzeitdifferenz GLS" VALUE 0x26E6CA kw_ui8_S6_S3 2540 UMR_MSEC__10_1_0_S6_S3 0 2540 /end CHARACTERISTIC
/begin CHARACTERISTIC TD_STOLGLS78_EL "max. tol. Schleifzeitdifferenz GLS" VALUE 0x26E6CB kw_ui8_S6_S3 2540 UMR_MSEC__10_1_0_S6_S3 0 2540 /end CHARACTERISTIC
/begin CHARACTERISTIC K_WNGGRGLSPKZU78 "Korrekturfaktor, wenn gemessene Schleifzeit zu gross (oberhalb der Toleranz) bei Regelung KZU" VALUE 0x26DAE0 kw_ui16_S6_S3 65530 UMR_U_MINSEC2_1_1_0_S6_S3 0 65530 /end CHARACTERISTIC
/begin CHARACTERISTIC K_WNGGRGLSPKZU78_EL "Korrekturfaktor, wenn gemessene Schleifzeit zu gross (oberhalb der Toleranz) bei Regelung KZU" VALUE 0x26DAE2 kw_ui16_S6_S3 65530 UMR_U_MINSEC2_1_1_0_S6_S3 0 65530 /end CHARACTERISTIC
/begin CHARACTERISTIC K_WNGGRGLSPKAB78 "Korrekturfaktor, wenn gemessene Schleifzeit zu gross (oberhalb der Toleranz) bei Regelung KAB" VALUE 0x26DAE4 kw_ui16_S6_S3 65530 UMR_U_MINSEC2_1_1_0_S6_S3 0 65530 /end CHARACTERISTIC
/begin CHARACTERISTIC K_WNGGRGLSPKAB78_EL "Korrekturfaktor, wenn gemessene Schleifzeit zu gross (oberhalb der Toleranz) bei Regelung KAB" VALUE 0x26DAE6 kw_ui16_S6_S3 65530 UMR_U_MINSEC2_1_1_0_S6_S3 0 65530 /end CHARACTERISTIC
/begin CHARACTERISTIC K_WNGKLGLSPKZU78 "Korrekturfaktor, wenn gemessene Schleifzeit zu klein (unterhalb der Toleranz) bei Regelung KZU" VALUE 0x26DAE8 kw_ui16_S6_S3 65530 UMR_U_MINSEC2_1_1_0_S6_S3 0 65530 /end CHARACTERISTIC
/begin CHARACTERISTIC K_WNGKLGLSPKZU78_EL "Korrekturfaktor, wenn gemessene Schleifzeit zu klein (unterhalb der Toleranz) bei Regelung KZU" VALUE 0x26DAEA kw_ui16_S6_S3 65530 UMR_U_MINSEC2_1_1_0_S6_S3 0 65530 /end CHARACTERISTIC
/begin CHARACTERISTIC K_WNGKLGLSPKAB78 "Korrekturfaktor, wenn gemessene Schleifzeit zu klein (unterhalb der Toleranz) bei Regelung KAB" VALUE 0x26DAEC kw_ui16_S6_S3 65530 UMR_U_MINSEC2_1_1_0_S6_S3 0 65530 /end CHARACTERISTIC
/begin CHARACTERISTIC K_WNGKLGLSPKAB78_EL "Korrekturfaktor, wenn gemessene Schleifzeit zu klein (unterhalb der Toleranz) bei Regelung KAB" VALUE 0x26DAEE kw_ui16_S6_S3 65530 UMR_U_MINSEC2_1_1_0_S6_S3 0 65530 /end CHARACTERISTIC
/begin CHARACTERISTIC KI_GLSKAB78 "Integralfaktor PID-Regler GLS" VALUE 0x26DAF0 kw_ui16_S6_S3 10000 UMR_MBARMINSEC_10MSEC_1_1_0_S6_S3 0 10000 /end CHARACTERISTIC
/begin CHARACTERISTIC KI_GLSKAB78_EL "Integralfaktor PID-Regler GLS" VALUE 0x26DAF2 kw_ui16_S6_S3 10000 UMR_MBARMINSEC_10MSEC_1_1_0_S6_S3 0 10000 /end CHARACTERISTIC
/begin CHARACTERISTIC KP_GLSKAB78 "Proportionalfaktor PID-Regler GLS" VALUE 0x26DAF4 kw_ui16_S6_S3 10000 UMR_MBARMINSEC__1_1_0_S6_S3 0 10000 /end CHARACTERISTIC
/begin CHARACTERISTIC KP_GLSKAB78_EL "Proportionalfaktor PID-Regler GLS" VALUE 0x26DAF6 kw_ui16_S6_S3 10000 UMR_MBARMINSEC__1_1_0_S6_S3 0 10000 /end CHARACTERISTIC
/begin CHARACTERISTIC T_FNGTGLSENDE78 "Filterwert für Filterung Sollgradient bei HS" VALUE 0x26E6CC kw_ui8_S6_S3 254 UMR_MSEC__1_1_0_S6_S3 0 254 /end CHARACTERISTIC
/begin CHARACTERISTIC W_NGTGLSENDE78 "Endwert für Filterung Sollgradient bei HS" VALUE 0x26DAF8 kw_si16_S6_S3 5000 UMR_U_MINSEC_1_1_0_S6_S3 -5000 0 /end CHARACTERISTIC
/begin CHARACTERISTIC KL_TVGLSKABCG78 "Verzoegerungszeit GLS-Beginn" CURVE 0x239C2C kl_ui8_S6_S3 2540 UMR_MSEC__10_1_0_S6_S3 0 2540
 /begin AXIS_DESCR STD_AXIS zff_atsys._.iSignale._.obj.sig_c_getr UMR_GRADC__1_1_M40_S6_S3 3 -40 150 DEPOSIT ABSOLUTE MONOTONY MON_INCREASE /end AXIS_DESCR
/end CHARACTERISTIC
/begin CHARACTERISTIC KL_MPT_WNGTGLS_INIT78 "Filterkonstante Sollgradient PT1-Filter" CURVE 0x239C38 kl_si16_S6_S3 0.99 UMR___1_100_0_S6_S3 0.01 1
 /begin AXIS_DESCR STD_AXIS NO_INPUT_QUANTITY UMR_U_MINSEC_10000_32767_0_S6_S3 3 -9765.92303232 9765.92303232 DEPOSIT ABSOLUTE MONOTONY MON_INCREASE /end AXIS_DESCR
/end CHARACTERISTIC
/begin CHARACTERISTIC KL_NDGLSPOSHS13 "Drehzahlschwelle positiv fuer den Start der GLS bei HS" CURVE 0x239C48 kl_si16_S6_S3 8000 UMR_U_MIN_1_1_0_S6_S3 0 8000
 /begin AXIS_DESCR STD_AXIS zff_atsys._.iSignale._.obj.sig_m_t UMR_NM__1_1_0_S6_S3 4 -400 1640 DEPOSIT ABSOLUTE MONOTONY MON_INCREASE /end AXIS_DESCR
/end CHARACTERISTIC
/begin CHARACTERISTIC KL_NDGLSNEGHS13 "Drehzahlschwelle negativ fuer den Start der GLS bei HS" CURVE 0x239C5C kl_si16_S6_S3 8000 UMR_U_MIN_1_1_0_S6_S3 -8000 0
 /begin AXIS_DESCR STD_AXIS zff_atsys._.iSignale._.obj.sig_m_t UMR_NM__1_1_0_S6_S3 4 -400 1640 DEPOSIT ABSOLUTE MONOTONY MON_INCREASE /end AXIS_DESCR
/end CHARACTERISTIC
/begin CHARACTERISTIC KF_NGTGLSHS13 "Turbinendrehzahlgradient fuer Startbedingung der GLS HS" MAP 0x239C70 kf_si16_S6_S3 32000 UMR_U_MINSEC_1_1_0_S6_S3 -32000 0
 /begin AXIS_DESCR STD_AXIS zff_atsys._.iSignale._.obj.sig_m_t UMR_NM__1_1_0_S6_S3 6 -400 1640 DEPOSIT ABSOLUTE MONOTONY MON_INCREASE /end AXIS_DESCR
 /begin AXIS_DESCR STD_AXIS zff_atsys._.iSignale._.obj.sig_n_t UMR_U_MIN_1_1_0_S6_S3 4 0 8160 DEPOSIT ABSOLUTE MONOTONY MON_INCREASE /end AXIS_DESCR
/end CHARACTERISTIC
/begin CHARACTERISTIC KL_UMSCHGLSKZU13 "Momentenschwelle zu Regelumschaltung" CURVE 0x239CBC kl_si16_S6_S3 1400 UMR_NM__1_1_0_S6_S3 -100 1300
 /begin AXIS_DESCR STD_AXIS zff_atsys._.iSignale._.obj.sig_c_getr UMR_GRADC__1_1_M40_S6_S3 4 -40 215 DEPOSIT ABSOLUTE MONOTONY MON_INCREASE /end AXIS_DESCR
/end CHARACTERISTIC
/begin CHARACTERISTIC KP_GLSKZU13 "Proportionalfaktor PID-Regler GLS" VALUE 0x26DAFA kw_ui16_S6_S3 10000 UMR_MBARMINSEC__1_1_0_S6_S3 0 10000 /end CHARACTERISTIC
/begin CHARACTERISTIC KI_GLSKZU13 "Integralfaktor PID-Regler GLS" VALUE 0x26DAFC kw_ui16_S6_S3 10000 UMR_MBARMINSEC_10MSEC_1_1_0_S6_S3 0 10000 /end CHARACTERISTIC
/begin CHARACTERISTIC TD_STOLGLS13 "max. tol. Schleifzeitdifferenz GLS" VALUE 0x26E6CD kw_ui8_S6_S3 2540 UMR_MSEC__10_1_0_S6_S3 0 2540 /end CHARACTERISTIC
/begin CHARACTERISTIC K_WNGGRGLSPKZU13 "Korrekturfaktor, wenn gemessene Schleifzeit zu gross (oberhalb der Toleranz) bei Regelung KZU" VALUE 0x26DAFE kw_ui16_S6_S3 65530 UMR_U_MINSEC2_1_1_0_S6_S3 0 65530 /end CHARACTERISTIC
/begin CHARACTERISTIC K_WNGGRGLSPKAB13 "Korrekturfaktor, wenn gemessene Schleifzeit zu gross (oberhalb der Toleranz) bei Regelung KAB" VALUE 0x26DB00 kw_ui16_S6_S3 65530 UMR_U_MINSEC2_1_1_0_S6_S3 0 65530 /end CHARACTERISTIC
/begin CHARACTERISTIC K_WNGKLGLSPKZU13 "Korrekturfaktor, wenn gemessene Schleifzeit zu klein (unterhalb der Toleranz) bei Regelung KZU" VALUE 0x26DB02 kw_ui16_S6_S3 65530 UMR_U_MINSEC2_1_1_0_S6_S3 0 65530 /end CHARACTERISTIC
/begin CHARACTERISTIC K_WNGKLGLSPKAB13 "Korrekturfaktor, wenn gemessene Schleifzeit zu klein (unterhalb der Toleranz) bei Regelung KAB" VALUE 0x26DB04 kw_ui16_S6_S3 65530 UMR_U_MINSEC2_1_1_0_S6_S3 0 65530 /end CHARACTERISTIC
/begin CHARACTERISTIC KI_GLSKAB13 "Integralfaktor PID-Regler GLS" VALUE 0x26DB06 kw_ui16_S6_S3 10000 UMR_MBARMINSEC_10MSEC_1_1_0_S6_S3 0 10000 /end CHARACTERISTIC
/begin CHARACTERISTIC KP_GLSKAB13 "Proportionalfaktor PID-Regler GLS" VALUE 0x26DB08 kw_ui16_S6_S3 10000 UMR_MBARMINSEC__1_1_0_S6_S3 0 10000 /end CHARACTERISTIC
/begin CHARACTERISTIC T_FNGTGLSENDE13 "Filterwert für Filterung Sollgradient bei HS" VALUE 0x26E6CE kw_ui8_S6_S3 254 UMR_MSEC__1_1_0_S6_S3 0 254 /end CHARACTERISTIC
/begin CHARACTERISTIC W_NGTGLSENDE13 "Endwert für Filterung Sollgradient bei HS" VALUE 0x26DB0A kw_si16_S6_S3 5000 UMR_U_MINSEC_1_1_0_S6_S3 -5000 0 /end CHARACTERISTIC
/begin CHARACTERISTIC KL_TVGLSKABCG13 "Verzoegerungszeit GLS-Beginn" CURVE 0x239CD0 kl_ui8_S6_S3 2540 UMR_MSEC__10_1_0_S6_S3 0 2540
 /begin AXIS_DESCR STD_AXIS zff_atsys._.iSignale._.obj.sig_c_getr UMR_GRADC__1_1_M40_S6_S3 3 -40 150 DEPOSIT ABSOLUTE MONOTONY MON_INCREASE /end AXIS_DESCR
/end CHARACTERISTIC
/begin CHARACTERISTIC KL_MPT_WNGTGLS_INIT13 "Filterkonstante Sollgradient PT1-Filter" CURVE 0x239CDC kl_si16_S6_S3 0.99 UMR___1_100_0_S6_S3 0.01 1
 /begin AXIS_DESCR STD_AXIS NO_INPUT_QUANTITY UMR_U_MINSEC_10000_32767_0_S6_S3 3 -9765.92303232 9765.92303232 DEPOSIT ABSOLUTE MONOTONY MON_INCREASE /end AXIS_DESCR
/end CHARACTERISTIC
/begin CHARACTERISTIC KL_NDGLSPOSHS24 "Drehzahlschwelle positiv fuer den Start der GLS bei HS" CURVE 0x239CEC kl_si16_S6_S3 8000 UMR_U_MIN_1_1_0_S6_S3 0 8000
 /begin AXIS_DESCR STD_AXIS zff_atsys._.iSignale._.obj.sig_m_t UMR_NM__1_1_0_S6_S3 4 -400 1640 DEPOSIT ABSOLUTE MONOTONY MON_INCREASE /end AXIS_DESCR
/end CHARACTERISTIC
/begin CHARACTERISTIC KL_NDGLSNEGHS24 "Drehzahlschwelle negativ fuer den Start der GLS bei HS" CURVE 0x239D00 kl_si16_S6_S3 8000 UMR_U_MIN_1_1_0_S6_S3 -8000 0
 /begin AXIS_DESCR STD_AXIS zff_atsys._.iSignale._.obj.sig_m_t UMR_NM__1_1_0_S6_S3 4 -400 1640 DEPOSIT ABSOLUTE MONOTONY MON_INCREASE /end AXIS_DESCR
/end CHARACTERISTIC
/begin CHARACTERISTIC KF_NGTGLSHS24 "Turbinendrehzahlgradient fuer Startbedingung der GLS HS" MAP 0x239D14 kf_si16_S6_S3 32000 UMR_U_MINSEC_1_1_0_S6_S3 -32000 0
 /begin AXIS_DESCR STD_AXIS zff_atsys._.iSignale._.obj.sig_m_t UMR_NM__1_1_0_S6_S3 6 -400 1640 DEPOSIT ABSOLUTE MONOTONY MON_INCREASE /end AXIS_DESCR
 /begin AXIS_DESCR STD_AXIS zff_atsys._.iSignale._.obj.sig_n_t UMR_U_MIN_1_1_0_S6_S3 4 0 8160 DEPOSIT ABSOLUTE MONOTONY MON_INCREASE /end AXIS_DESCR
/end CHARACTERISTIC
/begin CHARACTERISTIC KL_UMSCHGLSKZU24 "Momentenschwelle zu Regelumschaltung" CURVE 0x239D60 kl_si16_S6_S3 1400 UMR_NM__1_1_0_S6_S3 -100 1300
 /begin AXIS_DESCR STD_AXIS zff_atsys._.iSignale._.obj.sig_c_getr UMR_GRADC__1_1_M40_S6_S3 4 -40 215 DEPOSIT ABSOLUTE MONOTONY MON_INCREASE /end AXIS_DESCR
/end CHARACTERISTIC
/begin CHARACTERISTIC KP_GLSKZU24 "Proportionalfaktor PID-Regler GLS" VALUE 0x26DB0C kw_ui16_S6_S3 10000 UMR_MBARMINSEC__1_1_0_S6_S3 0 10000 /end CHARACTERISTIC
/begin CHARACTERISTIC KI_GLSKZU24 "Integralfaktor PID-Regler GLS" VALUE 0x26DB0E kw_ui16_S6_S3 10000 UMR_MBARMINSEC_10MSEC_1_1_0_S6_S3 0 10000 /end CHARACTERISTIC
/begin CHARACTERISTIC TD_STOLGLS24 "max. tol. Schleifzeitdifferenz GLS" VALUE 0x26E6CF kw_ui8_S6_S3 2540 UMR_MSEC__10_1_0_S6_S3 0 2540 /end CHARACTERISTIC
/begin CHARACTERISTIC K_WNGGRGLSPKZU24 "Korrekturfaktor, wenn gemessene Schleifzeit zu gross (oberhalb der Toleranz) bei Regelung KZU" VALUE 0x26DB10 kw_ui16_S6_S3 65530 UMR_U_MINSEC2_1_1_0_S6_S3 0 65530 /end CHARACTERISTIC
/begin CHARACTERISTIC K_WNGGRGLSPKAB24 "Korrekturfaktor, wenn gemessene Schleifzeit zu gross (oberhalb der Toleranz) bei Regelung KAB" VALUE 0x26DB12 kw_ui16_S6_S3 65530 UMR_U_MINSEC2_1_1_0_S6_S3 0 65530 /end CHARACTERISTIC
/begin CHARACTERISTIC K_WNGKLGLSPKZU24 "Korrekturfaktor, wenn gemessene Schleifzeit zu klein (unterhalb der Toleranz) bei Regelung KZU" VALUE 0x26DB14 kw_ui16_S6_S3 65530 UMR_U_MINSEC2_1_1_0_S6_S3 0 65530 /end CHARACTERISTIC
/begin CHARACTERISTIC K_WNGKLGLSPKAB24 "Korrekturfaktor, wenn gemessene Schleifzeit zu klein (unterhalb der Toleranz) bei Regelung KAB" VALUE 0x26DB16 kw_ui16_S6_S3 65530 UMR_U_MINSEC2_1_1_0_S6_S3 0 65530 /end CHARACTERISTIC
/begin CHARACTERISTIC KI_GLSKAB24 "Integralfaktor PID-Regler GLS" VALUE 0x26DB18 kw_ui16_S6_S3 10000 UMR_MBARMINSEC_10MSEC_1_1_0_S6_S3 0 10000 /end CHARACTERISTIC
/begin CHARACTERISTIC KP_GLSKAB24 "Proportionalfaktor PID-Regler GLS" VALUE 0x26DB1A kw_ui16_S6_S3 10000 UMR_MBARMINSEC__1_1_0_S6_S3 0 10000 /end CHARACTERISTIC
/begin CHARACTERISTIC T_FNGTGLSENDE24 "Filterwert für Filterung Sollgradient bei HS" VALUE 0x26E6D0 kw_ui8_S6_S3 254 UMR_MSEC__1_1_0_S6_S3 0 254 /end CHARACTERISTIC
/begin CHARACTERISTIC W_NGTGLSENDE24 "Endwert für Filterung Sollgradient bei HS" VALUE 0x26DB1C kw_si16_S6_S3 5000 UMR_U_MINSEC_1_1_0_S6_S3 -5000 0 /end CHARACTERISTIC
/begin CHARACTERISTIC KL_TVGLSKABCG24 "Verzoegerungszeit GLS-Beginn" CURVE 0x239D74 kl_ui8_S6_S3 2540 UMR_MSEC__10_1_0_S6_S3 0 2540
 /begin AXIS_DESCR STD_AXIS zff_atsys._.iSignale._.obj.sig_c_getr UMR_GRADC__1_1_M40_S6_S3 3 -40 150 DEPOSIT ABSOLUTE MONOTONY MON_INCREASE /end AXIS_DESCR
/end CHARACTERISTIC
/begin CHARACTERISTIC KL_MPT_WNGTGLS_INIT24 "Filterkonstante Sollgradient PT1-Filter" CURVE 0x239D80 kl_si16_S6_S3 0.99 UMR___1_100_0_S6_S3 0.01 1
 /begin AXIS_DESCR STD_AXIS NO_INPUT_QUANTITY UMR_U_MINSEC_10000_32767_0_S6_S3 3 -9765.92303232 9765.92303232 DEPOSIT ABSOLUTE MONOTONY MON_INCREASE /end AXIS_DESCR
/end CHARACTERISTIC
/begin COMPU_METHOD SAB_N_3RPM20_S2_S3 "int = ((phys * 20) / 3) - (0) 1/min" RAT_FUNC "%5.3" "1/min" COEFFS 0 20 -0 0 0 3 /end COMPU_METHOD
/begin COMPU_METHOD SAB_N_20RPM_S2_S3 "int = ((phys * 1) / 20) - (0) 1/min" RAT_FUNC "%2.0" "1/min" COEFFS 0 1 -0 0 0 20 /end COMPU_METHOD
/begin COMPU_METHOD SAB_C_CEL2_M100_S2_S3 "int = ((phys * 2) / 1) - (-100) Grad Celsius" RAT_FUNC "%5.3" "Grad Celsius" COEFFS 0 2 100 0 0 1 /end COMPU_METHOD
/begin COMPU_METHOD SAB_C_CEL2_M40_S2_S3 "int = ((phys * 2) / 1) - (-80) C" RAT_FUNC "%3.1" "C" COEFFS 0 2 80 0 0 1 /end COMPU_METHOD
/begin COMPU_METHOD SAB_C_CEL2_M50_S2_S3 "int = ((phys * 2) / 1) - (-100) Unit_DegreCelsi" RAT_FUNC "%5.3" "Unit_DegreCelsi" COEFFS 0 2 100 0 0 1 /end COMPU_METHOD
/begin COMPU_METHOD SAB_C_CEL2_M85_S2_S3 "int = ((phys * 2) / 1) - (-170) C" RAT_FUNC "%5.3" "C" COEFFS 0 2 170 0 0 1 /end COMPU_METHOD
/begin COMPU_METHOD SAB_C_CEL_M48_S2_S3 "int = ((phys * 1) / 1) - (-48) Grad Celsius" RAT_FUNC "%2.0" "Grad Celsius" COEFFS 0 1 48 0 0 1 /end COMPU_METHOD
/begin COMPU_METHOD SAB_C_75CEL100_M48_S2_S3 "int = ((phys * 100) / 75) - (-64) Grad Celsius" RAT_FUNC "%5.3" "Grad Celsius" COEFFS 0 100 4800 0 0 75 /end COMPU_METHOD
/begin COMPU_METHOD SAB_C_1CEL_M55_S2_S3 "int = ((phys * 1) / 1) - (-55) Grad Celsius" RAT_FUNC "%2.0" "Grad Celsius" COEFFS 0 1 55 0 0 1 /end COMPU_METHOD
/begin COMPU_METHOD SAB_C_CMO_3CEL4_M48_S2_S3 "int = ((phys * 4) / 3) - (-64) Grad Celsius" RAT_FUNC "%5.3" "Grad Celsius" COEFFS 0 4 192 0 0 3 /end COMPU_METHOD
/begin COMPU_METHOD SAB_C_CMO_1CEL_M60_S2_S3 "int = ((phys * 1) / 1) - (-60) Grad Celsius" RAT_FUNC "%2.0" "Grad Celsius" COEFFS 0 1 60 0 0 1 /end COMPU_METHOD
/begin COMPU_METHOD SAB_C_CEL_M60_S2_S3 "int = ((phys * 1) / 1) - (-60) Grad Celsius" RAT_FUNC "%2.0" "Grad Celsius" COEFFS 0 1 60 0 0 1 /end COMPU_METHOD
/begin COMPU_METHOD UMR___1_100_0_S6_S3 "int = ((phys * 100) / 1) - (0) [-]" RAT_FUNC "%4.2" "[-]" COEFFS 0 100 -0 0 0 1 /end COMPU_METHOD
/begin COMPU_METHOD UMR___1_1_0_S6_S3 "int = ((phys * 1) / 1) - (0) [-]" RAT_FUNC "%2.0" "[-]" COEFFS 0 1 -0 0 0 1 /end COMPU_METHOD
/begin COMPU_METHOD UMR_NM__1_1_0_S6_S3 "int = ((phys * 1) / 1) - (0) [Nm]" RAT_FUNC "%2.0" "[Nm]" COEFFS 0 1 -0 0 0 1 /end COMPU_METHOD
/begin COMPU_METHOD UMR_NM__8_1_M50_S6_S3 "int = ((phys * 1) / 8) - (-50) [Nm]" RAT_FUNC "%2.0" "[Nm]" COEFFS 0 1 400 0 0 8 /end COMPU_METHOD
/begin COMPU_METHOD UMR_BAR__1_1000_0_S6_S3 "int = ((phys * 1000) / 1) - (0) [bar]" RAT_FUNC "%5.3" "[bar]" COEFFS 0 1000 -0 0 0 1 /end COMPU_METHOD
/begin COMPU_METHOD UMR_U_MIN_1_1_0_S6_S3 "int = ((phys * 1) / 1) - (0) [U/min]" RAT_FUNC "%2.0" "[U/min]" COEFFS 0 1 -0 0 0 1 /end COMPU_METHOD
/begin COMPU_METHOD UMR_U_MIN_32_1_0_S6_S3 "int = ((phys * 1) / 32) - (0) [U/min]" RAT_FUNC "%2.0" "[U/min]" COEFFS 0 1 -0 0 0 32 /end COMPU_METHOD
/begin COMPU_METHOD UMR_U_MINSEC_1_1_0_S6_S3 "int = ((phys * 1) / 1) - (0) [U/(min*s)]" RAT_FUNC "%2.0" "[U/(min*s)]" COEFFS 0 1 -0 0 0 1 /end COMPU_METHOD
/begin COMPU_METHOD UMR_U_MINSEC_10000_32767_0_S6_S3 "int = ((phys * 32767) / 10000) - (0) [U/(min*s)]" RAT_FUNC "%6.4" "[U/(min*s)]" COEFFS 0 32767 -0 0 0 10000 /end COMPU_METHOD
/begin COMPU_METHOD UMR_U_MINSEC2_1_1_0_S6_S3 "int = ((phys * 1) / 1) - (0) [U/(min*s^2)]" RAT_FUNC "%2.0" "[U/(min*s^2)]" COEFFS 0 1 -0 0 0 1 /end COMPU_METHOD
/begin COMPU_METHOD UMR_MSEC__1_1_0_S6_S3 "int = ((phys * 1) / 1) - (0) [ms]" RAT_FUNC "%2.0" "[ms]" COEFFS 0 1 -0 0 0 1 /end COMPU_METHOD
/begin COMPU_METHOD UMR_MSEC__10_1_0_S6_S3 "int = ((phys * 1) / 10) - (0) [ms]" RAT_FUNC "%2.0" "[ms]" COEFFS 0 1 -0 0 0 10 /end COMPU_METHOD
/begin COMPU_METHOD UMR_GRADC__1_1_M40_S6_S3 "int = ((phys * 1) / 1) - (-40) [°C]" RAT_FUNC "%2.0" "[°C]" COEFFS 0 1 40 0 0 1 /end COMPU_METHOD
/begin COMPU_METHOD UMR_MBARMINSEC__1_1_0_S6_S3 "int = ((phys * 1) / 1) - (0) [0,02mbar/(1/(min*s))]" RAT_FUNC "%2.0" "[0,02mbar/(1/(min*s))]" COEFFS 0 1 -0 0 0 1 /end COMPU_METHOD
/begin COMPU_METHOD UMR_MBARMINSEC_10MSEC_1_1_0_S6_S3 "int = ((phys * 1) / 1) - (0) [0,00031mbar/(10ms/(min*s))]" RAT_FUNC "%2.0" "[0,00031mbar/(10ms/(min*s))]" COEFFS 0 1 -0 0 0 1 /end COMPU_METHOD
/begin FUNCTION jSasGlsGeG7_Fktn "Applikationesgroessen Instanz jSasGlsGeG7"
 /begin DEF_CHARACTERISTIC KF_WNGTNDSYNCGGE_7 KL_KIGLSKZUCG_7 KL_KPGLSKZUCG_7 KL_MPT_WNGTGLS_INIT_7 ND_GLSGE_7 T_VGLSKZU_7 /end DEF_CHARACTERISTIC
/end FUNCTION
/begin FUNCTION jSasGlsGeG8_Fktn "Applikationesgroessen Instanz jSasGlsGeG8"
 /begin DEF_CHARACTERISTIC KF_WNGTNDSYNCGGE_8 KL_KIGLSKZUCG_8 KL_KPGLSKZUCG_8 KL_MPT_WNGTGLS_INIT_8 ND_GLSGE_8 T_VGLSKZU_8 /end DEF_CHARACTERISTIC
/end FUNCTION
/begin FUNCTION dSasGlsHSP_Fktn "Applikationesgroessen der Komponente dSasGlsHSP"
 /begin SUB_FUNCTION jSasGlsHSP112_Fktn jSasGlsHSP123_Fktn jSasGlsHSP134_Fktn jSasGlsHSP145_Fktn jSasGlsHSP156_Fktn jSasGlsHSP167_Fktn jSasGlsHSP178_Fktn jSasGlsHSP113_Fktn jSasGlsHSP124_Fktn jSasGlsHSP135_Fktn jSasGlsHSP146_Fktn jSasGlsHSP157_Fktn jSasGlsHSP168_Fktn jSasGlsHSP212_Fktn jSasGlsHSP223_Fktn jSasGlsHSP234_Fktn jSasGlsHSP245_Fktn jSasGlsHSP256_Fktn jSasGlsHSP267_Fktn jSasGlsHSP278_Fktn jSasGlsHSP213_Fktn jSasGlsHSP224_Fktn jSasGlsHSP235_Fktn jSasGlsHSP246_Fktn jSasGlsHSP257_Fktn jSasGlsHSP268_Fktn jSasGlsHSP312_Fktn jSasGlsHSP323_Fktn jSasGlsHSP334_Fktn jSasGlsHSP345_Fktn jSasGlsHSP356_Fktn jSasGlsHSP367_Fktn jSasGlsHSP378_Fktn jSasGlsHSP313_Fktn jSasGlsHSP324_Fktn jSasGlsHSP335_Fktn jSasGlsHSP346_Fktn jSasGlsHSP357_Fktn jSasGlsHSP368_Fktn /end SUB_FUNCTION
/end FUNCTION
/begin FUNCTION jSasGlsHSP112_Fktn "Applikationesgroessen Instanz jSasGlsHSP112"
 /begin DEF_CHARACTERISTIC KF_WTSGLS12 KF_WTSGLS12_EL KL_FMENACHGLSENDE12 KL_TVGLSKZUCG12 KL_TVGLSKZUCG12_EL /end DEF_CHARACTERISTIC
/end FUNCTION
/begin FUNCTION jSasGlsHSP123_Fktn "Applikationesgroessen Instanz jSasGlsHSP123"
 /begin DEF_CHARACTERISTIC KF_WTSGLS23 KF_WTSGLS23_EL KL_FMENACHGLSENDE23 KL_TVGLSKZUCG23 KL_TVGLSKZUCG23_EL /end DEF_CHARACTERISTIC
/end FUNCTION
/begin FUNCTION jSasGlsHSP134_Fktn "Applikationesgroessen Instanz jSasGlsHSP134"
 /begin DEF_CHARACTERISTIC KF_WTSGLS34 KF_WTSGLS34_EL KL_FMENACHGLSENDE34 KL_TVGLSKZUCG34 KL_TVGLSKZUCG34_EL /end DEF_CHARACTERISTIC
/end FUNCTION
/begin FUNCTION jSasGlsHSP145_Fktn "Applikationesgroessen Instanz jSasGlsHSP145"
 /begin DEF_CHARACTERISTIC KF_WTSGLS45 KF_WTSGLS45_EL KL_FMENACHGLSENDE45 KL_TVGLSKZUCG45 KL_TVGLSKZUCG45_EL /end DEF_CHARACTERISTIC
/end FUNCTION
/begin FUNCTION jSasGlsHSP156_Fktn "Applikationesgroessen Instanz jSasGlsHSP156"
 /begin DEF_CHARACTERISTIC KF_WTSGLS56 KF_WTSGLS56_EL KL_FMENACHGLSENDE56 KL_TVGLSKZUCG56 KL_TVGLSKZUCG56_EL /end DEF_CHARACTERISTIC
/end FUNCTION
/begin FUNCTION jSasGlsHSP167_Fktn "Applikationesgroessen Instanz jSasGlsHSP167"
 /begin DEF_CHARACTERISTIC KF_WTSGLS67 KF_WTSGLS67_EL KL_FMENACHGLSENDE67 KL_TVGLSKZUCG67 KL_TVGLSKZUCG67_EL /end DEF_CHARACTERISTIC
/end FUNCTION
/begin FUNCTION jSasGlsHSP178_Fktn "Applikationesgroessen Instanz jSasGlsHSP178"
 /begin DEF_CHARACTERISTIC KF_WTSGLS78 KF_WTSGLS78_EL KL_FMENACHGLSENDE78 KL_TVGLSKZUCG78 KL_TVGLSKZUCG78_EL /end DEF_CHARACTERISTIC
/end FUNCTION
/begin FUNCTION jSasGlsHSP113_Fktn "Applikationesgroessen Instanz jSasGlsHSP113" /begin DEF_CHARACTERISTIC KF_WTSGLS13 KL_FMENACHGLSENDE13 KL_TVGLSKZUCG13 /end DEF_CHARACTERISTIC /end FUNCTION
/begin FUNCTION jSasGlsHSP124_Fktn "Applikationesgroessen Instanz jSasGlsHSP124" /begin DEF_CHARACTERISTIC KF_WTSGLS24 KL_FMENACHGLSENDE24 KL_TVGLSKZUCG24 /end DEF_CHARACTERISTIC /end FUNCTION
/begin FUNCTION jSasGlsHSP135_Fktn "Applikationesgroessen Instanz jSasGlsHSP135" /begin DEF_CHARACTERISTIC KF_WTSGLS35 KL_FMENACHGLSENDE35 KL_TVGLSKZUCG35 /end DEF_CHARACTERISTIC /end FUNCTION
/begin FUNCTION jSasGlsHSP146_Fktn "Applikationesgroessen Instanz jSasGlsHSP146" /begin DEF_CHARACTERISTIC KF_WTSGLS46 KL_FMENACHGLSENDE46 KL_TVGLSKZUCG46 /end DEF_CHARACTERISTIC /end FUNCTION
/begin FUNCTION jSasGlsHSP157_Fktn "Applikationesgroessen Instanz jSasGlsHSP157" /begin DEF_CHARACTERISTIC KF_WTSGLS57 KL_FMENACHGLSENDE57 KL_TVGLSKZUCG57 /end DEF_CHARACTERISTIC /end FUNCTION
/begin FUNCTION jSasGlsHSP168_Fktn "Applikationesgroessen Instanz jSasGlsHSP168" /begin DEF_CHARACTERISTIC KF_WTSGLS68 KL_FMENACHGLSENDE68 KL_TVGLSKZUCG68 /end DEF_CHARACTERISTIC /end FUNCTION
/begin FUNCTION jSasGlsHSP212_Fktn "Applikationesgroessen Instanz jSasGlsHSP212" /begin DEF_CHARACTERISTIC KF_WTSGLSSP12 KL_FMENACHGLSENDESP12 KL_TVGLSKZUCGSP12 /end DEF_CHARACTERISTIC /end FUNCTION
/begin FUNCTION jSasGlsHSP223_Fktn "Applikationesgroessen Instanz jSasGlsHSP223" /begin DEF_CHARACTERISTIC KF_WTSGLSSP23 KL_FMENACHGLSENDESP23 KL_TVGLSKZUCGSP23 /end DEF_CHARACTERISTIC /end FUNCTION
/begin FUNCTION jSasGlsHSP234_Fktn "Applikationesgroessen Instanz jSasGlsHSP234" /begin DEF_CHARACTERISTIC KF_WTSGLSSP34 KL_FMENACHGLSENDESP34 KL_TVGLSKZUCGSP34 /end DEF_CHARACTERISTIC /end FUNCTION
/begin FUNCTION jSasGlsHSP245_Fktn "Applikationesgroessen Instanz jSasGlsHSP245" /begin DEF_CHARACTERISTIC KF_WTSGLSSP45 KL_FMENACHGLSENDESP45 KL_TVGLSKZUCGSP45 /end DEF_CHARACTERISTIC /end FUNCTION
/begin FUNCTION jSasGlsHSP256_Fktn "Applikationesgroessen Instanz jSasGlsHSP256" /begin DEF_CHARACTERISTIC KF_WTSGLSSP56 KL_FMENACHGLSENDESP56 KL_TVGLSKZUCGSP56 /end DEF_CHARACTERISTIC /end FUNCTION
/begin FUNCTION jSasGlsHSP267_Fktn "Applikationesgroessen Instanz jSasGlsHSP267" /begin DEF_CHARACTERISTIC KF_WTSGLSSP67 KL_FMENACHGLSENDESP67 KL_TVGLSKZUCGSP67 /end DEF_CHARACTERISTIC /end FUNCTION
/begin FUNCTION jSasGlsHSP278_Fktn "Applikationesgroessen Instanz jSasGlsHSP278" /begin DEF_CHARACTERISTIC KF_WTSGLSSP78 KL_FMENACHGLSENDESP78 KL_TVGLSKZUCGSP78 /end DEF_CHARACTERISTIC /end FUNCTION
/begin FUNCTION jSasGlsHSP213_Fktn "Applikationesgroessen Instanz jSasGlsHSP213" /begin DEF_CHARACTERISTIC KF_WTSGLSSP13 KL_FMENACHGLSENDESP13 KL_TVGLSKZUCGSP13 /end DEF_CHARACTERISTIC /end FUNCTION
/begin FUNCTION jSasGlsHSP224_Fktn "Applikationesgroessen Instanz jSasGlsHSP224" /begin DEF_CHARACTERISTIC KF_WTSGLSSP24 KL_FMENACHGLSENDESP24 KL_TVGLSKZUCGSP24 /end DEF_CHARACTERISTIC /end FUNCTION
/begin FUNCTION jSasGlsHSP235_Fktn "Applikationesgroessen Instanz jSasGlsHSP235" /begin DEF_CHARACTERISTIC KF_WTSGLSSP35 KL_FMENACHGLSENDESP35 KL_TVGLSKZUCGSP35 /end DEF_CHARACTERISTIC /end FUNCTION
/begin FUNCTION jSasGlsHSP246_Fktn "Applikationesgroessen Instanz jSasGlsHSP246" /begin DEF_CHARACTERISTIC KF_WTSGLSSP46 KL_FMENACHGLSENDESP46 KL_TVGLSKZUCGSP46 /end DEF_CHARACTERISTIC /end FUNCTION
/begin FUNCTION jSasGlsHSP257_Fktn "Applikationesgroessen Instanz jSasGlsHSP257" /begin DEF_CHARACTERISTIC KF_WTSGLSSP57 KL_FMENACHGLSENDESP57 KL_TVGLSKZUCGSP57 /end DEF_CHARACTERISTIC /end FUNCTION
/begin FUNCTION jSasGlsHSP268_Fktn "Applikationesgroessen Instanz jSasGlsHSP268" /begin DEF_CHARACTERISTIC KF_WTSGLSSP68 KL_FMENACHGLSENDESP68 KL_TVGLSKZUCGSP68 /end DEF_CHARACTERISTIC /end FUNCTION
/begin FUNCTION jSasGlsHSP312_Fktn "Applikationesgroessen Instanz jSasGlsHSP312"
 /begin DEF_CHARACTERISTIC KF_WTSGLSSPORT12 KL_FMENACHGLSENDESPORT12 KL_TVGLSKZUCGSPORT12 /end DEF_CHARACTERISTIC
/end FUNCTION
/begin FUNCTION jSasGlsHSP323_Fktn "Applikationesgroessen Instanz jSasGlsHSP323"
 /begin DEF_CHARACTERISTIC KF_WTSGLSSPORT23 KL_FMENACHGLSENDESPORT23 KL_TVGLSKZUCGSPORT23 /end DEF_CHARACTERISTIC
/end FUNCTION
/begin FUNCTION jSasGlsHSP334_Fktn "Applikationesgroessen Instanz jSasGlsHSP334"
 /begin DEF_CHARACTERISTIC KF_WTSGLSSPORT34 KL_FMENACHGLSENDESPORT34 KL_TVGLSKZUCGSPORT34 /end DEF_CHARACTERISTIC
/end FUNCTION
/begin FUNCTION jSasGlsHSP345_Fktn "Applikationesgroessen Instanz jSasGlsHSP345"
 /begin DEF_CHARACTERISTIC KF_WTSGLSSPORT45 KL_FMENACHGLSENDESPORT45 KL_TVGLSKZUCGSPORT45 /end DEF_CHARACTERISTIC
/end FUNCTION
/begin FUNCTION jSasGlsHSP356_Fktn "Applikationesgroessen Instanz jSasGlsHSP356"
 /begin DEF_CHARACTERISTIC KF_WTSGLSSPORT56 KL_FMENACHGLSENDESPORT56 KL_TVGLSKZUCGSPORT56 /end DEF_CHARACTERISTIC
/end FUNCTION
/begin FUNCTION jSasGlsHSP367_Fktn "Applikationesgroessen Instanz jSasGlsHSP367"
 /begin DEF_CHARACTERISTIC KF_WTSGLSSPORT67 KL_FMENACHGLSENDESPORT67 KL_TVGLSKZUCGSPORT67 /end DEF_CHARACTERISTIC
/end FUNCTION
/begin FUNCTION jSasGlsHSP378_Fktn "Applikationesgroessen Instanz jSasGlsHSP378"
 /begin DEF_CHARACTERISTIC KF_WTSGLSSPORT78 KL_FMENACHGLSENDESPORT78 KL_TVGLSKZUCGSPORT78 /end DEF_CHARACTERISTIC
/end FUNCTION
/begin FUNCTION jSasGlsHSP313_Fktn "Applikationesgroessen Instanz jSasGlsHSP313"
 /begin DEF_CHARACTERISTIC KF_WTSGLSSPORT13 KL_FMENACHGLSENDESPORT13 KL_TVGLSKZUCGSPORT13 /end DEF_CHARACTERISTIC
/end FUNCTION
/begin FUNCTION jSasGlsHSP324_Fktn "Applikationesgroessen Instanz jSasGlsHSP324"
 /begin DEF_CHARACTERISTIC KF_WTSGLSSPORT24 KL_FMENACHGLSENDESPORT24 KL_TVGLSKZUCGSPORT24 /end DEF_CHARACTERISTIC
/end FUNCTION
/begin FUNCTION jSasGlsHSP335_Fktn "Applikationesgroessen Instanz jSasGlsHSP335"
 /begin DEF_CHARACTERISTIC KF_WTSGLSSPORT35 KL_FMENACHGLSENDESPORT35 KL_TVGLSKZUCGSPORT35 /end DEF_CHARACTERISTIC
/end FUNCTION
/begin FUNCTION jSasGlsHSP346_Fktn "Applikationesgroessen Instanz jSasGlsHSP346"
 /begin DEF_CHARACTERISTIC KF_WTSGLSSPORT46 KL_FMENACHGLSENDESPORT46 KL_TVGLSKZUCGSPORT46 /end DEF_CHARACTERISTIC
/end FUNCTION
/begin FUNCTION jSasGlsHSP357_Fktn "Applikationesgroessen Instanz jSasGlsHSP357"
 /begin DEF_CHARACTERISTIC KF_WTSGLSSPORT57 KL_FMENACHGLSENDESPORT57 KL_TVGLSKZUCGSPORT57 /end DEF_CHARACTERISTIC
/end FUNCTION
/begin FUNCTION jSasGlsHSP368_Fktn "Applikationesgroessen Instanz jSasGlsHSP368"
 /begin DEF_CHARACTERISTIC KF_WTSGLSSPORT68 KL_FMENACHGLSENDESPORT68 KL_TVGLSKZUCGSPORT68 /end DEF_CHARACTERISTIC
/end FUNCTION
/begin FUNCTION dSasGlsRSP_Fktn "Applikationesgroessen der Komponente dSasGlsRSP"
 /begin SUB_FUNCTION jSasGlsRSP121_Fktn jSasGlsRSP132_Fktn jSasGlsRSP143_Fktn jSasGlsRSP154_Fktn jSasGlsRSP165_Fktn jSasGlsRSP176_Fktn jSasGlsRSP187_Fktn jSasGlsRSP221_Fktn jSasGlsRSP232_Fktn jSasGlsRSP243_Fktn jSasGlsRSP254_Fktn jSasGlsRSP265_Fktn jSasGlsRSP276_Fktn jSasGlsRSP287_Fktn jSasGlsRSP231_Fktn jSasGlsRSP242_Fktn jSasGlsRSP251_Fktn jSasGlsRSP253_Fktn jSasGlsRSP263_Fktn jSasGlsRSP264_Fktn jSasGlsRSP271_Fktn jSasGlsRSP275_Fktn jSasGlsRSP282_Fktn jSasGlsRSP284_Fktn jSasGlsRSP286_Fktn jSasGlsRSP321_Fktn jSasGlsRSP332_Fktn jSasGlsRSP343_Fktn jSasGlsRSP354_Fktn jSasGlsRSP365_Fktn jSasGlsRSP376_Fktn jSasGlsRSP387_Fktn jSasGlsRSP331_Fktn jSasGlsRSP342_Fktn jSasGlsRSP351_Fktn jSasGlsRSP353_Fktn jSasGlsRSP363_Fktn jSasGlsRSP364_Fktn jSasGlsRSP371_Fktn jSasGlsRSP375_Fktn jSasGlsRSP382_Fktn jSasGlsRSP384_Fktn jSasGlsRSP386_Fktn /end SUB_FUNCTION
/end FUNCTION
/begin FUNCTION jSasGlsRSP121_Fktn "Applikationesgroessen Instanz jSasGlsRSP121"
 /begin DEF_CHARACTERISTIC KF_WTSGLS21 KF_WTSGLS21_EL KL_POMTABBGLSHSZ21 KL_TVGLSKABCG21 KL_TVGLSKABCG21_EL /end DEF_CHARACTERISTIC
/end FUNCTION
/begin FUNCTION jSasGlsRSP132_Fktn "Applikationesgroessen Instanz jSasGlsRSP132"
 /begin DEF_CHARACTERISTIC KF_WTSGLS32 KF_WTSGLS32_EL KL_POMTABBGLSHSZ32 KL_TVGLSKABCG32 KL_TVGLSKABCG32_EL /end DEF_CHARACTERISTIC
/end FUNCTION
/begin FUNCTION jSasGlsRSP143_Fktn "Applikationesgroessen Instanz jSasGlsRSP143"
 /begin DEF_CHARACTERISTIC KF_WTSGLS43 KF_WTSGLS43_EL KL_POMTABBGLSHSZ43 KL_TVGLSKABCG43 KL_TVGLSKABCG43_EL /end DEF_CHARACTERISTIC
/end FUNCTION
/begin FUNCTION jSasGlsRSP154_Fktn "Applikationesgroessen Instanz jSasGlsRSP154"
 /begin DEF_CHARACTERISTIC KF_WTSGLS54 KF_WTSGLS54_EL KL_POMTABBGLSHSZ54 KL_TVGLSKABCG54 KL_TVGLSKABCG54_EL /end DEF_CHARACTERISTIC
/end FUNCTION
/begin FUNCTION jSasGlsRSP165_Fktn "Applikationesgroessen Instanz jSasGlsRSP165"
 /begin DEF_CHARACTERISTIC KF_WTSGLS65 KF_WTSGLS65_EL KL_POMTABBGLSHSZ65 KL_TVGLSKABCG65 KL_TVGLSKABCG65_EL /end DEF_CHARACTERISTIC
/end FUNCTION
/begin FUNCTION jSasGlsRSP176_Fktn "Applikationesgroessen Instanz jSasGlsRSP176"
 /begin DEF_CHARACTERISTIC KF_WTSGLS76 KF_WTSGLS76_EL KL_POMTABBGLSHSZ76 KL_TVGLSKABCG76 KL_TVGLSKABCG76_EL /end DEF_CHARACTERISTIC
/end FUNCTION
/begin FUNCTION jSasGlsRSP187_Fktn "Applikationesgroessen Instanz jSasGlsRSP187"
 /begin DEF_CHARACTERISTIC KF_WTSGLS87 KF_WTSGLS87_EL KL_POMTABBGLSHSZ87 KL_TVGLSKABCG87 KL_TVGLSKABCG87_EL /end DEF_CHARACTERISTIC
/end FUNCTION
/begin FUNCTION jSasGlsRSP221_Fktn "Applikationesgroessen Instanz jSasGlsRSP221" /begin DEF_CHARACTERISTIC KF_WTSGLSSP21 KL_POMTABBGLSHSZSP21 KL_TVGLSKABCGSP21 /end DEF_CHARACTERISTIC /end FUNCTION
/begin FUNCTION jSasGlsRSP232_Fktn "Applikationesgroessen Instanz jSasGlsRSP232" /begin DEF_CHARACTERISTIC KF_WTSGLSSP32 KL_POMTABBGLSHSZSP32 KL_TVGLSKABCGSP32 /end DEF_CHARACTERISTIC /end FUNCTION
/begin FUNCTION jSasGlsRSP243_Fktn "Applikationesgroessen Instanz jSasGlsRSP243" /begin DEF_CHARACTERISTIC KF_WTSGLSSP43 KL_POMTABBGLSHSZSP43 KL_TVGLSKABCGSP43 /end DEF_CHARACTERISTIC /end FUNCTION
/begin FUNCTION jSasGlsRSP254_Fktn "Applikationesgroessen Instanz jSasGlsRSP254" /begin DEF_CHARACTERISTIC KF_WTSGLSSP54 KL_POMTABBGLSHSZSP54 KL_TVGLSKABCGSP54 /end DEF_CHARACTERISTIC /end FUNCTION
/begin FUNCTION jSasGlsRSP265_Fktn "Applikationesgroessen Instanz jSasGlsRSP265" /begin DEF_CHARACTERISTIC KF_WTSGLSSP65 KL_POMTABBGLSHSZSP65 KL_TVGLSKABCGSP65 /end DEF_CHARACTERISTIC /end FUNCTION
/begin FUNCTION jSasGlsRSP276_Fktn "Applikationesgroessen Instanz jSasGlsRSP276" /begin DEF_CHARACTERISTIC KF_WTSGLSSP76 KL_POMTABBGLSHSZSP76 KL_TVGLSKABCGSP76 /end DEF_CHARACTERISTIC /end FUNCTION
/begin FUNCTION jSasGlsRSP287_Fktn "Applikationesgroessen Instanz jSasGlsRSP287" /begin DEF_CHARACTERISTIC KF_WTSGLSSP87 KL_POMTABBGLSHSZSP87 KL_TVGLSKABCGSP87 /end DEF_CHARACTERISTIC /end FUNCTION
/begin FUNCTION jSasGlsRSP231_Fktn "Applikationesgroessen Instanz jSasGlsRSP231" /begin DEF_CHARACTERISTIC KF_WTSGLSSP31 KL_POMTABBGLSHSZSP31 KL_TVGLSKABCGSP31 /end DEF_CHARACTERISTIC /end FUNCTION
/begin FUNCTION jSasGlsRSP242_Fktn "Applikationesgroessen Instanz jSasGlsRSP242"
 /begin DEF_CHARACTERISTIC KF_WTSGLSSP42 KF_WTSGLSSP42_EL KL_POMTABBGLSHSZSP42 KL_TVGLSKABCGSP42 KL_TVGLSKABCGSP42_EL /end DEF_CHARACTERISTIC
/end FUNCTION
/begin FUNCTION jSasGlsRSP251_Fktn "Applikationesgroessen Instanz jSasGlsRSP251" /begin DEF_CHARACTERISTIC KF_WTSGLSSP51 KL_POMTABBGLSHSZSP51 KL_TVGLSKABCGSP51 /end DEF_CHARACTERISTIC /end FUNCTION
/begin FUNCTION jSasGlsRSP253_Fktn "Applikationesgroessen Instanz jSasGlsRSP253"
 /begin DEF_CHARACTERISTIC KF_WTSGLSSP53 KF_WTSGLSSP53_EL KL_POMTABBGLSHSZSP53 KL_TVGLSKABCGSP53 KL_TVGLSKABCGSP53_EL /end DEF_CHARACTERISTIC
/end FUNCTION
/begin FUNCTION jSasGlsRSP263_Fktn "Applikationesgroessen Instanz jSasGlsRSP263"
 /begin DEF_CHARACTERISTIC KF_WTSGLSSP63 KF_WTSGLSSP63_EL KL_POMTABBGLSHSZSP63 KL_TVGLSKABCGSP63 KL_TVGLSKABCGSP63_EL /end DEF_CHARACTERISTIC
/end FUNCTION
/begin FUNCTION jSasGlsRSP264_Fktn "Applikationesgroessen Instanz jSasGlsRSP264"
 /begin DEF_CHARACTERISTIC KF_WTSGLSSP64 KF_WTSGLSSP64_EL KL_POMTABBGLSHSZSP64 KL_TVGLSKABCGSP64 KL_TVGLSKABCGSP64_EL /end DEF_CHARACTERISTIC
/end FUNCTION
/begin FUNCTION jSasGlsRSP271_Fktn "Applikationesgroessen Instanz jSasGlsRSP271" /begin DEF_CHARACTERISTIC KF_WTSGLSSP71 KL_POMTABBGLSHSZSP71 KL_TVGLSKABCGSP71 /end DEF_CHARACTERISTIC /end FUNCTION
/begin FUNCTION jSasGlsRSP275_Fktn "Applikationesgroessen Instanz jSasGlsRSP275"
 /begin DEF_CHARACTERISTIC KF_WTSGLSSP75 KF_WTSGLSSP75_EL KL_POMTABBGLSHSZSP75 KL_TVGLSKABCGSP75 KL_TVGLSKABCGSP75_EL /end DEF_CHARACTERISTIC
/end FUNCTION
/begin FUNCTION jSasGlsRSP282_Fktn "Applikationesgroessen Instanz jSasGlsRSP282"
 /begin DEF_CHARACTERISTIC KF_WTSGLSSP82 KF_WTSGLSSP82_EL KL_POMTABBGLSHSZSP82 KL_TVGLSKABCGSP82 KL_TVGLSKABCGSP82_EL /end DEF_CHARACTERISTIC
/end FUNCTION
/begin FUNCTION jSasGlsRSP284_Fktn "Applikationesgroessen Instanz jSasGlsRSP284"
 /begin DEF_CHARACTERISTIC KF_WTSGLSSP84 KF_WTSGLSSP84_EL KL_POMTABBGLSHSZSP84 KL_TVGLSKABCGSP84 KL_TVGLSKABCGSP84_EL /end DEF_CHARACTERISTIC
/end FUNCTION
/begin FUNCTION jSasGlsRSP286_Fktn "Applikationesgroessen Instanz jSasGlsRSP286"
 /begin DEF_CHARACTERISTIC KF_WTSGLSSP86 KF_WTSGLSSP86_EL KL_POMTABBGLSHSZSP86 KL_TVGLSKABCGSP86 KL_TVGLSKABCGSP86_EL /end DEF_CHARACTERISTIC
/end FUNCTION
/begin FUNCTION jSasGlsRSP321_Fktn "Applikationesgroessen Instanz jSasGlsRSP321"
 /begin DEF_CHARACTERISTIC KF_WTSGLSSPORT21 KL_POMTABBGLSHSZSPORT21 KL_TVGLSKABCGSPORT21 /end DEF_CHARACTERISTIC
/end FUNCTION
/begin FUNCTION jSasGlsRSP332_Fktn "Applikationesgroessen Instanz jSasGlsRSP332"
 /begin DEF_CHARACTERISTIC KF_WTSGLSSPORT32 KL_POMTABBGLSHSZSPORT32 KL_TVGLSKABCGSPORT32 /end DEF_CHARACTERISTIC
/end FUNCTION
/begin FUNCTION jSasGlsRSP343_Fktn "Applikationesgroessen Instanz jSasGlsRSP343"
 /begin DEF_CHARACTERISTIC KF_WTSGLSSPORT43 KL_POMTABBGLSHSZSPORT43 KL_TVGLSKABCGSPORT43 /end DEF_CHARACTERISTIC
/end FUNCTION
/begin FUNCTION jSasGlsRSP354_Fktn "Applikationesgroessen Instanz jSasGlsRSP354"
 /begin DEF_CHARACTERISTIC KF_WTSGLSSPORT54 KL_POMTABBGLSHSZSPORT54 KL_TVGLSKABCGSPORT54 /end DEF_CHARACTERISTIC
/end FUNCTION
/begin FUNCTION jSasGlsRSP365_Fktn "Applikationesgroessen Instanz jSasGlsRSP365"
 /begin DEF_CHARACTERISTIC KF_WTSGLSSPORT65 KL_POMTABBGLSHSZSPORT65 KL_TVGLSKABCGSPORT65 /end DEF_CHARACTERISTIC
/end FUNCTION
/begin FUNCTION jSasGlsRSP376_Fktn "Applikationesgroessen Instanz jSasGlsRSP376"
 /begin DEF_CHARACTERISTIC KF_WTSGLSSPORT76 KL_POMTABBGLSHSZSPORT76 KL_TVGLSKABCGSPORT76 /end DEF_CHARACTERISTIC
/end FUNCTION
/begin FUNCTION jSasGlsRSP387_Fktn "Applikationesgroessen Instanz jSasGlsRSP387"
 /begin DEF_CHARACTERISTIC KF_WTSGLSSPORT87 KL_POMTABBGLSHSZSPORT87 KL_TVGLSKABCGSPORT87 /end DEF_CHARACTERISTIC
/end FUNCTION
/begin FUNCTION jSasGlsRSP331_Fktn "Applikationesgroessen Instanz jSasGlsRSP331"
 /begin DEF_CHARACTERISTIC KF_WTSGLSSPORT31 KL_POMTABBGLSHSZSPORT31 KL_TVGLSKABCGSPORT31 /end DEF_CHARACTERISTIC
/end FUNCTION
/begin FUNCTION jSasGlsRSP342_Fktn "Applikationesgroessen Instanz jSasGlsRSP342"
 /begin DEF_CHARACTERISTIC KF_WTSGLSSPORT42 KL_POMTABBGLSHSZSPORT42 KL_TVGLSKABCGSPORT42 /end DEF_CHARACTERISTIC
/end FUNCTION
/begin FUNCTION jSasGlsRSP351_Fktn "Applikationesgroessen Instanz jSasGlsRSP351"
 /begin DEF_CHARACTERISTIC KF_WTSGLSSPORT51 KL_POMTABBGLSHSZSPORT51 KL_TVGLSKABCGSPORT51 /end DEF_CHARACTERISTIC
/end FUNCTION
/begin FUNCTION jSasGlsRSP353_Fktn "Applikationesgroessen Instanz jSasGlsRSP353"
 /begin DEF_CHARACTERISTIC KF_WTSGLSSPORT53 KL_POMTABBGLSHSZSPORT53 KL_TVGLSKABCGSPORT53 /end DEF_CHARACTERISTIC
/end FUNCTION
/begin FUNCTION jSasGlsRSP363_Fktn "Applikationesgroessen Instanz jSasGlsRSP363"
 /begin DEF_CHARACTERISTIC KF_WTSGLSSPORT63 KL_POMTABBGLSHSZSPORT63 KL_TVGLSKABCGSPORT63 /end DEF_CHARACTERISTIC
/end FUNCTION
/begin FUNCTION jSasGlsRSP364_Fktn "Applikationesgroessen Instanz jSasGlsRSP364"
 /begin DEF_CHARACTERISTIC KF_WTSGLSSPORT64 KL_POMTABBGLSHSZSPORT64 KL_TVGLSKABCGSPORT64 /end DEF_CHARACTERISTIC
/end FUNCTION
/begin FUNCTION jSasGlsRSP371_Fktn "Applikationesgroessen Instanz jSasGlsRSP371"
 /begin DEF_CHARACTERISTIC KF_WTSGLSSPORT71 KL_POMTABBGLSHSZSPORT71 KL_TVGLSKABCGSPORT71 /end DEF_CHARACTERISTIC
/end FUNCTION
/begin FUNCTION jSasGlsRSP375_Fktn "Applikationesgroessen Instanz jSasGlsRSP375"
 /begin DEF_CHARACTERISTIC KF_WTSGLSSPORT75 KL_POMTABBGLSHSZSPORT75 KL_TVGLSKABCGSPORT75 /end DEF_CHARACTERISTIC
/end FUNCTION
/begin FUNCTION jSasGlsRSP382_Fktn "Applikationesgroessen Instanz jSasGlsRSP382"
 /begin DEF_CHARACTERISTIC KF_WTSGLSSPORT82 KL_POMTABBGLSHSZSPORT82 KL_TVGLSKABCGSPORT82 /end DEF_CHARACTERISTIC
/end FUNCTION
/begin FUNCTION jSasGlsRSP384_Fktn "Applikationesgroessen Instanz jSasGlsRSP384"
 /begin DEF_CHARACTERISTIC KF_WTSGLSSPORT84 KL_POMTABBGLSHSZSPORT84 KL_TVGLSKABCGSPORT84 /end DEF_CHARACTERISTIC
/end FUNCTION
/begin FUNCTION jSasGlsRSP386_Fktn "Applikationesgroessen Instanz jSasGlsRSP386"
 /begin DEF_CHARACTERISTIC KF_WTSGLSSPORT86 KL_POMTABBGLSHSZSPORT86 KL_TVGLSKABCGSPORT86 /end DEF_CHARACTERISTIC
/end FUNCTION
/begin FUNCTION dSasGlsAl_Fktn "Applikationesgroessen der Komponente dSasGlsAl" /begin SUB_FUNCTION jSasGlsAl_Fktn /end SUB_FUNCTION /end FUNCTION
/begin FUNCTION jSasGlsAl_Fktn "Applikationesgroessen Instanz jSasGlsAl"
 /begin DEF_CHARACTERISTIC CS_GLSGE P_MAXOBGLS P_MAXOBGLSGE P_MAXUNGLS P_MAXUNGLSGE SWI_GLS SWI_GLSGE SWI_NGABGLS SWI_UMSCH_GLS_KAB TAB_SWI_REGLERINITART T_FNGTGLS /end DEF_CHARACTERISTIC
/end FUNCTION
/begin FUNCTION dSasGlsHSS_Fktn "Applikationesgroessen der Komponente dSasGlsHSS"
 /begin SUB_FUNCTION jSasGlsHSS12_Fktn jSasGlsHSS23_Fktn jSasGlsHSS34_Fktn jSasGlsHSS45_Fktn jSasGlsHSS56_Fktn jSasGlsHSS67_Fktn jSasGlsHSS78_Fktn jSasGlsHSS13_Fktn jSasGlsHSS24_Fktn jSasGlsHSS35_Fktn jSasGlsHSS46_Fktn jSasGlsHSS57_Fktn jSasGlsHSS68_Fktn /end SUB_FUNCTION
/end FUNCTION
/begin FUNCTION jSasGlsHSS12_Fktn "Applikationesgroessen Instanz jSasGlsHSS12"
 /begin DEF_CHARACTERISTIC KF_NGTGLSHS12 KI_GLSKAB12 KI_GLSKAB12_EL KI_GLSKZU12 KI_GLSKZU12_EL KL_MPT_WNGTGLS_INIT12 KL_NDGLSNEGHS12 KL_NDGLSPOSHS12 KL_TVGLSKABCG12 KL_UMSCHGLSKZU12 KP_GLSKAB12 KP_GLSKAB12_EL KP_GLSKZU12 KP_GLSKZU12_EL K_WNGGRGLSPKAB12 K_WNGGRGLSPKAB12_EL K_WNGGRGLSPKZU12 K_WNGGRGLSPKZU12_EL K_WNGKLGLSPKAB12 K_WNGKLGLSPKAB12_EL K_WNGKLGLSPKZU12 K_WNGKLGLSPKZU12_EL TD_STOLGLS12 TD_STOLGLS12_EL T_FNGTGLSENDE12 W_NGTGLSENDE12 /end DEF_CHARACTERISTIC
/end FUNCTION
/begin FUNCTION jSasGlsHSS23_Fktn "Applikationesgroessen Instanz jSasGlsHSS23"
 /begin DEF_CHARACTERISTIC KF_NGTGLSHS23 KI_GLSKAB23 KI_GLSKAB23_EL KI_GLSKZU23 KI_GLSKZU23_EL KL_MPT_WNGTGLS_INIT23 KL_NDGLSNEGHS23 KL_NDGLSPOSHS23 KL_TVGLSKABCG23 KL_UMSCHGLSKZU23 KP_GLSKAB23 KP_GLSKAB23_EL KP_GLSKZU23 KP_GLSKZU23_EL K_WNGGRGLSPKAB23 K_WNGGRGLSPKAB23_EL K_WNGGRGLSPKZU23 K_WNGGRGLSPKZU23_EL K_WNGKLGLSPKAB23 K_WNGKLGLSPKAB23_EL K_WNGKLGLSPKZU23 K_WNGKLGLSPKZU23_EL TD_STOLGLS23 TD_STOLGLS23_EL T_FNGTGLSENDE23 W_NGTGLSENDE23 /end DEF_CHARACTERISTIC
/end FUNCTION
/begin FUNCTION jSasGlsHSS34_Fktn "Applikationesgroessen Instanz jSasGlsHSS34"
 /begin DEF_CHARACTERISTIC KF_NGTGLSHS34 KI_GLSKAB34 KI_GLSKAB34_EL KI_GLSKZU34 KI_GLSKZU34_EL KL_MPT_WNGTGLS_INIT34 KL_NDGLSNEGHS34 KL_NDGLSPOSHS34 KL_TVGLSKABCG34 KL_UMSCHGLSKZU34 KP_GLSKAB34 KP_GLSKAB34_EL KP_GLSKZU34 KP_GLSKZU34_EL K_WNGGRGLSPKAB34 K_WNGGRGLSPKAB34_EL K_WNGGRGLSPKZU34 K_WNGGRGLSPKZU34_EL K_WNGKLGLSPKAB34 K_WNGKLGLSPKAB34_EL K_WNGKLGLSPKZU34 K_WNGKLGLSPKZU34_EL TD_STOLGLS34 TD_STOLGLS34_EL T_FNGTGLSENDE34 W_NGTGLSENDE34 /end DEF_CHARACTERISTIC
/end FUNCTION
/begin FUNCTION jSasGlsHSS45_Fktn "Applikationesgroessen Instanz jSasGlsHSS45"
 /begin DEF_CHARACTERISTIC KF_NGTGLSHS45 KI_GLSKAB45 KI_GLSKAB45_EL KI_GLSKZU45 KI_GLSKZU45_EL KL_MPT_WNGTGLS_INIT45 KL_NDGLSNEGHS45 KL_NDGLSPOSHS45 KL_TVGLSKABCG45 KL_UMSCHGLSKZU45 KP_GLSKAB45 KP_GLSKAB45_EL KP_GLSKZU45 KP_GLSKZU45_EL K_WNGGRGLSPKAB45 K_WNGGRGLSPKAB45_EL K_WNGGRGLSPKZU45 K_WNGGRGLSPKZU45_EL K_WNGKLGLSPKAB45 K_WNGKLGLSPKAB45_EL K_WNGKLGLSPKZU45 K_WNGKLGLSPKZU45_EL TD_STOLGLS45 TD_STOLGLS45_EL T_FNGTGLSENDE45 W_NGTGLSENDE45 /end DEF_CHARACTERISTIC
/end FUNCTION
/begin FUNCTION jSasGlsHSS56_Fktn "Applikationesgroessen Instanz jSasGlsHSS56"
 /begin DEF_CHARACTERISTIC KF_NGTGLSHS56 KI_GLSKAB56 KI_GLSKAB56_EL KI_GLSKZU56 KI_GLSKZU56_EL KL_MPT_WNGTGLS_INIT56 KL_NDGLSNEGHS56 KL_NDGLSPOSHS56 KL_TVGLSKABCG56 KL_UMSCHGLSKZU56 KP_GLSKAB56 KP_GLSKAB56_EL KP_GLSKZU56 KP_GLSKZU56_EL K_WNGGRGLSPKAB56 K_WNGGRGLSPKAB56_EL K_WNGGRGLSPKZU56 K_WNGGRGLSPKZU56_EL K_WNGKLGLSPKAB56 K_WNGKLGLSPKAB56_EL K_WNGKLGLSPKZU56 K_WNGKLGLSPKZU56_EL TD_STOLGLS56 TD_STOLGLS56_EL T_FNGTGLSENDE56 W_NGTGLSENDE56 /end DEF_CHARACTERISTIC
/end FUNCTION
/begin FUNCTION jSasGlsHSS67_Fktn "Applikationesgroessen Instanz jSasGlsHSS67"
 /begin DEF_CHARACTERISTIC KF_NGTGLSHS67 KI_GLSKAB67 KI_GLSKAB67_EL KI_GLSKZU67 KI_GLSKZU67_EL KL_MPT_WNGTGLS_INIT67 KL_NDGLSNEGHS67 KL_NDGLSPOSHS67 KL_TVGLSKABCG67 KL_UMSCHGLSKZU67 KP_GLSKAB67 KP_GLSKAB67_EL KP_GLSKZU67 KP_GLSKZU67_EL K_WNGGRGLSPKAB67 K_WNGGRGLSPKAB67_EL K_WNGGRGLSPKZU67 K_WNGGRGLSPKZU67_EL K_WNGKLGLSPKAB67 K_WNGKLGLSPKAB67_EL K_WNGKLGLSPKZU67 K_WNGKLGLSPKZU67_EL TD_STOLGLS67 TD_STOLGLS67_EL T_FNGTGLSENDE67 W_NGTGLSENDE67 /end DEF_CHARACTERISTIC
/end FUNCTION
/begin FUNCTION jSasGlsHSS78_Fktn "Applikationesgroessen Instanz jSasGlsHSS78"
 /begin DEF_CHARACTERISTIC KF_NGTGLSHS78 KI_GLSKAB78 KI_GLSKAB78_EL KI_GLSKZU78 KI_GLSKZU78_EL KL_MPT_WNGTGLS_INIT78 KL_NDGLSNEGHS78 KL_NDGLSPOSHS78 KL_TVGLSKABCG78 KL_UMSCHGLSKZU78 KP_GLSKAB78 KP_GLSKAB78_EL KP_GLSKZU78 KP_GLSKZU78_EL K_WNGGRGLSPKAB78 K_WNGGRGLSPKAB78_EL K_WNGGRGLSPKZU78 K_WNGGRGLSPKZU78_EL K_WNGKLGLSPKAB78 K_WNGKLGLSPKAB78_EL K_WNGKLGLSPKZU78 K_WNGKLGLSPKZU78_EL TD_STOLGLS78 TD_STOLGLS78_EL T_FNGTGLSENDE78 W_NGTGLSENDE78 /end DEF_CHARACTERISTIC
/end FUNCTION
/begin FUNCTION jSasGlsHSS13_Fktn "Applikationesgroessen Instanz jSasGlsHSS13"
 /begin DEF_CHARACTERISTIC KF_NGTGLSHS13 KI_GLSKAB13 KI_GLSKZU13 KL_MPT_WNGTGLS_INIT13 KL_NDGLSNEGHS13 KL_NDGLSPOSHS13 KL_TVGLSKABCG13 KL_UMSCHGLSKZU13 KP_GLSKAB13 KP_GLSKZU13 K_WNGGRGLSPKAB13 K_WNGGRGLSPKZU13 K_WNGKLGLSPKAB13 K_WNGKLGLSPKZU13 TD_STOLGLS13 T_FNGTGLSENDE13 W_NGTGLSENDE13 /end DEF_CHARACTERISTIC
/end FUNCTION
/begin FUNCTION jSasGlsHSS24_Fktn "Applikationesgroessen Instanz jSasGlsHSS24"
 /begin DEF_CHARACTERISTIC KF_NGTGLSHS24 KI_GLSKAB24 KI_GLSKZU24 KL_MPT_WNGTGLS_INIT24 KL_NDGLSNEGHS24 KL_NDGLSPOSHS24 KL_TVGLSKABCG24 KL_UMSCHGLSKZU24 KP_GLSKAB24 KP_GLSKZU24 K_WNGGRGLSPKAB24 K_WNGGRGLSPKZU24 K_WNGKLGLSPKAB24 K_WNGKLGLSPKZU24 TD_STOLGLS24 T_FNGTGLSENDE24 W_NGTGLSENDE24 /end DEF_CHARACTERISTIC
/end FUNCTION
/begin RECORD_LAYOUT kw_bool8_S6_S3 FNC_VALUES 1 UBYTE COLUMN_DIR DIRECT /end RECORD_LAYOUT
/begin RECORD_LAYOUT kw_ui8_S6_S3 FNC_VALUES 1 UBYTE COLUMN_DIR DIRECT /end RECORD_LAYOUT
/begin RECORD_LAYOUT kw_ui16_S6_S3 FNC_VALUES 1 UWORD COLUMN_DIR DIRECT /end RECORD_LAYOUT
/begin RECORD_LAYOUT kw_si16_S6_S3 FNC_VALUES 1 SWORD COLUMN_DIR DIRECT /end RECORD_LAYOUT
/begin RECORD_LAYOUT tab_bool8_S6_S3 FNC_VALUES 2 UBYTE COLUMN_DIR DIRECT NO_AXIS_PTS_X 1 ULONG /end RECORD_LAYOUT
/begin RECORD_LAYOUT kl_ui8_S6_S3 FNC_VALUES 3 UBYTE COLUMN_DIR DIRECT AXIS_PTS_X 2 UBYTE INDEX_INCR DIRECT NO_AXIS_PTS_X 1 ULONG /end RECORD_LAYOUT
/begin RECORD_LAYOUT kl_ui16_S6_S3 FNC_VALUES 3 UWORD COLUMN_DIR DIRECT AXIS_PTS_X 2 UWORD INDEX_INCR DIRECT NO_AXIS_PTS_X 1 ULONG /end RECORD_LAYOUT
/begin RECORD_LAYOUT kl_si16_S6_S3 FNC_VALUES 3 SWORD COLUMN_DIR DIRECT AXIS_PTS_X 2 SWORD INDEX_INCR DIRECT NO_AXIS_PTS_X 1 ULONG /end RECORD_LAYOUT
/begin RECORD_LAYOUT kf_ui8_S6_S3 FNC_VALUES 5 UBYTE ROW_DIR DIRECT AXIS_PTS_X 3 UBYTE INDEX_INCR DIRECT AXIS_PTS_Y 4 UBYTE INDEX_INCR DIRECT NO_AXIS_PTS_X 1 ULONG NO_AXIS_PTS_Y 2 ULONG /end RECORD_LAYOUT
/begin RECORD_LAYOUT kf_si16_S6_S3 FNC_VALUES 5 SWORD ROW_DIR DIRECT AXIS_PTS_X 3 SWORD INDEX_INCR DIRECT AXIS_PTS_Y 4 SWORD INDEX_INCR DIRECT NO_AXIS_PTS_X 1 ULONG NO_AXIS_PTS_Y 2 ULONG /end RECORD_LAYOUT
/end MODULE
/end PROJECT
