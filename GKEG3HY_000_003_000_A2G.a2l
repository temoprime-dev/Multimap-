ASAP2_VERSION 1 51
/begin PROJECT _929_929 "Gen2_BMW_System_Supplier_Lib"
/begin HEADER "" VERSION "C_03_03" PROJECT_NO _929_929 /end HEADER
/begin MODULE DIM ""
/begin MOD_COMMON "" BYTE_ORDER MSB_FIRST ALIGNMENT_BYTE 1 ALIGNMENT_WORD 2 ALIGNMENT_LONG 4 ALIGNMENT_FLOAT32_IEEE 4 /end MOD_COMMON
/begin MEASUREMENT ZFEH_EepromData.ydiMemory_xau16[1].amb_cond.ambient_condition[0][0] "ambient condition shot [0 .. 2-1] with 25 data bytes [0 .. 25-1] for the error code stored in this error memory slot" UBYTE EH_STANDARD_S5_S3 1 100 0 255 DISPLAY_IDENTIFIER ambient_condition[0][0].amb_cond.ydiMemory_xau16[1].ZFEH_EepromData ECU_ADDRESS 0xFFF82868 /end MEASUREMENT
/begin MEASUREMENT ZFEH_EepromData.ydiMemory_xau16[1].amb_cond.ambient_condition[0][1] "ambient condition shot [0 .. 2-1] with 25 data bytes [0 .. 25-1] for the error code stored in this error memory slot" UBYTE EH_STANDARD_S5_S3 1 100 0 255 DISPLAY_IDENTIFIER ambient_condition[0][1].amb_cond.ydiMemory_xau16[1].ZFEH_EepromData ECU_ADDRESS 0xFFF82869 /end MEASUREMENT
/begin MEASUREMENT ZFEH_EepromData.ydiMemory_xau16[1].amb_cond.ambient_condition[0][2] "ambient condition shot [0 .. 2-1] with 25 data bytes [0 .. 25-1] for the error code stored in this error memory slot" UBYTE EH_STANDARD_S5_S3 1 100 0 255 DISPLAY_IDENTIFIER ambient_condition[0][2].amb_cond.ydiMemory_xau16[1].ZFEH_EepromData ECU_ADDRESS 0xFFF8286A /end MEASUREMENT
/begin MEASUREMENT ZFEH_EepromData.ydiMemory_xau16[1].amb_cond.ambient_condition[0][3] "ambient condition shot [0 .. 2-1] with 25 data bytes [0 .. 25-1] for the error code stored in this error memory slot" UBYTE EH_STANDARD_S5_S3 1 100 0 255 DISPLAY_IDENTIFIER ambient_condition[0][3].amb_cond.ydiMemory_xau16[1].ZFEH_EepromData ECU_ADDRESS 0xFFF8286B /end MEASUREMENT
/begin MEASUREMENT ZFEH_EepromData.ydiMemory_xau16[1].amb_cond.ambient_condition[0][4] "ambient condition shot [0 .. 2-1] with 25 data bytes [0 .. 25-1] for the error code stored in this error memory slot" UBYTE EH_STANDARD_S5_S3 1 100 0 255 DISPLAY_IDENTIFIER ambient_condition[0][4].amb_cond.ydiMemory_xau16[1].ZFEH_EepromData ECU_ADDRESS 0xFFF8286C /end MEASUREMENT
/begin MEASUREMENT ZFEH_EepromData.ydiMemory_xau16[1].amb_cond.ambient_condition[0][5] "ambient condition shot [0 .. 2-1] with 25 data bytes [0 .. 25-1] for the error code stored in this error memory slot" UBYTE EH_STANDARD_S5_S3 1 100 0 255 DISPLAY_IDENTIFIER ambient_condition[0][5].amb_cond.ydiMemory_xau16[1].ZFEH_EepromData ECU_ADDRESS 0xFFF8286D /end MEASUREMENT
/begin MEASUREMENT ZFEH_EepromData.ydiMemory_xau16[1].amb_cond.ambient_condition[0][6] "ambient condition shot [0 .. 2-1] with 25 data bytes [0 .. 25-1] for the error code stored in this error memory slot" UBYTE EH_STANDARD_S5_S3 1 100 0 255 DISPLAY_IDENTIFIER ambient_condition[0][6].amb_cond.ydiMemory_xau16[1].ZFEH_EepromData ECU_ADDRESS 0xFFF8286E /end MEASUREMENT
/begin MEASUREMENT ZFEH_EepromData.ydiMemory_xau16[1].amb_cond.ambient_condition[0][7] "ambient condition shot [0 .. 2-1] with 25 data bytes [0 .. 25-1] for the error code stored in this error memory slot" UBYTE EH_STANDARD_S5_S3 1 100 0 255 DISPLAY_IDENTIFIER ambient_condition[0][7].amb_cond.ydiMemory_xau16[1].ZFEH_EepromData ECU_ADDRESS 0xFFF8286F /end MEASUREMENT
/begin MEASUREMENT ZFEH_EepromData.ydiMemory_xau16[1].amb_cond.ambient_condition[0][8] "ambient condition shot [0 .. 2-1] with 25 data bytes [0 .. 25-1] for the error code stored in this error memory slot" UBYTE EH_STANDARD_S5_S3 1 100 0 255 DISPLAY_IDENTIFIER ambient_condition[0][8].amb_cond.ydiMemory_xau16[1].ZFEH_EepromData ECU_ADDRESS 0xFFF82870 /end MEASUREMENT
/begin MEASUREMENT ZFEH_EepromData.ydiMemory_xau16[1].amb_cond.ambient_condition[0][9] "ambient condition shot [0 .. 2-1] with 25 data bytes [0 .. 25-1] for the error code stored in this error memory slot" UBYTE EH_STANDARD_S5_S3 1 100 0 255 DISPLAY_IDENTIFIER ambient_condition[0][9].amb_cond.ydiMemory_xau16[1].ZFEH_EepromData ECU_ADDRESS 0xFFF82871 /end MEASUREMENT
/begin MEASUREMENT ZFEH_EepromData.ydiMemory_xau16[1].amb_cond.ambient_condition[0][10] "ambient condition shot [0 .. 2-1] with 25 data bytes [0 .. 25-1] for the error code stored in this error memory slot" UBYTE EH_STANDARD_S5_S3 1 100 0 255 DISPLAY_IDENTIFIER ambient_condition[0][10].amb_cond.ydiMemory_xau16[1].ZFEH_EepromData ECU_ADDRESS 0xFFF82872 /end MEASUREMENT
/begin MEASUREMENT ZFEH_EepromData.ydiMemory_xau16[1].amb_cond.ambient_condition[0][11] "ambient condition shot [0 .. 2-1] with 25 data bytes [0 .. 25-1] for the error code stored in this error memory slot" UBYTE EH_STANDARD_S5_S3 1 100 0 255 DISPLAY_IDENTIFIER ambient_condition[0][11].amb_cond.ydiMemory_xau16[1].ZFEH_EepromData ECU_ADDRESS 0xFFF82873 /end MEASUREMENT
/begin MEASUREMENT ZFEH_EepromData.ydiMemory_xau16[1].amb_cond.ambient_condition[0][12] "ambient condition shot [0 .. 2-1] with 25 data bytes [0 .. 25-1] for the error code stored in this error memory slot" UBYTE EH_STANDARD_S5_S3 1 100 0 255 DISPLAY_IDENTIFIER ambient_condition[0][12].amb_cond.ydiMemory_xau16[1].ZFEH_EepromData ECU_ADDRESS 0xFFF82874 /end MEASUREMENT
/begin MEASUREMENT ZFEH_EepromData.ydiMemory_xau16[1].amb_cond.ambient_condition[0][13] "ambient condition shot [0 .. 2-1] with 25 data bytes [0 .. 25-1] for the error code stored in this error memory slot" UBYTE EH_STANDARD_S5_S3 1 100 0 255 DISPLAY_IDENTIFIER ambient_condition[0][13].amb_cond.ydiMemory_xau16[1].ZFEH_EepromData ECU_ADDRESS 0xFFF82875 /end MEASUREMENT
/begin MEASUREMENT ZFEH_EepromData.ydiMemory_xau16[1].amb_cond.ambient_condition[0][14] "ambient condition shot [0 .. 2-1] with 25 data bytes [0 .. 25-1] for the error code stored in this error memory slot" UBYTE EH_STANDARD_S5_S3 1 100 0 255 DISPLAY_IDENTIFIER ambient_condition[0][14].amb_cond.ydiMemory_xau16[1].ZFEH_EepromData ECU_ADDRESS 0xFFF82876 /end MEASUREMENT
/begin MEASUREMENT ZFEH_EepromData.ydiMemory_xau16[1].amb_cond.ambient_condition[0][15] "ambient condition shot [0 .. 2-1] with 25 data bytes [0 .. 25-1] for the error code stored in this error memory slot" UBYTE EH_STANDARD_S5_S3 1 100 0 255 DISPLAY_IDENTIFIER ambient_condition[0][15].amb_cond.ydiMemory_xau16[1].ZFEH_EepromData ECU_ADDRESS 0xFFF82877 /end MEASUREMENT
/begin MEASUREMENT ZFEH_EepromData.ydiMemory_xau16[1].amb_cond.ambient_condition[0][16] "ambient condition shot [0 .. 2-1] with 25 data bytes [0 .. 25-1] for the error code stored in this error memory slot" UBYTE EH_STANDARD_S5_S3 1 100 0 255 DISPLAY_IDENTIFIER ambient_condition[0][16].amb_cond.ydiMemory_xau16[1].ZFEH_EepromData ECU_ADDRESS 0xFFF82878 /end MEASUREMENT
/begin MEASUREMENT ZFEH_EepromData.ydiMemory_xau16[1].amb_cond.ambient_condition[0][17] "ambient condition shot [0 .. 2-1] with 25 data bytes [0 .. 25-1] for the error code stored in this error memory slot" UBYTE EH_STANDARD_S5_S3 1 100 0 255 DISPLAY_IDENTIFIER ambient_condition[0][17].amb_cond.ydiMemory_xau16[1].ZFEH_EepromData ECU_ADDRESS 0xFFF82879 /end MEASUREMENT
/begin MEASUREMENT ZFEH_EepromData.ydiMemory_xau16[1].amb_cond.ambient_condition[0][18] "ambient condition shot [0 .. 2-1] with 25 data bytes [0 .. 25-1] for the error code stored in this error memory slot" UBYTE EH_STANDARD_S5_S3 1 100 0 255 DISPLAY_IDENTIFIER ambient_condition[0][18].amb_cond.ydiMemory_xau16[1].ZFEH_EepromData ECU_ADDRESS 0xFFF8287A /end MEASUREMENT
/begin MEASUREMENT ZFEH_EepromData.ydiMemory_xau16[1].amb_cond.ambient_condition[0][19] "ambient condition shot [0 .. 2-1] with 25 data bytes [0 .. 25-1] for the error code stored in this error memory slot" UBYTE EH_STANDARD_S5_S3 1 100 0 255 DISPLAY_IDENTIFIER ambient_condition[0][19].amb_cond.ydiMemory_xau16[1].ZFEH_EepromData ECU_ADDRESS 0xFFF8287B /end MEASUREMENT
/begin MEASUREMENT ZFEH_EepromData.ydiMemory_xau16[1].amb_cond.ambient_condition[0][20] "ambient condition shot [0 .. 2-1] with 25 data bytes [0 .. 25-1] for the error code stored in this error memory slot" UBYTE EH_STANDARD_S5_S3 1 100 0 255 DISPLAY_IDENTIFIER ambient_condition[0][20].amb_cond.ydiMemory_xau16[1].ZFEH_EepromData ECU_ADDRESS 0xFFF8287C /end MEASUREMENT
/begin MEASUREMENT ZFEH_EepromData.ydiMemory_xau16[1].amb_cond.ambient_condition[0][21] "ambient condition shot [0 .. 2-1] with 25 data bytes [0 .. 25-1] for the error code stored in this error memory slot" UBYTE EH_STANDARD_S5_S3 1 100 0 255 DISPLAY_IDENTIFIER ambient_condition[0][21].amb_cond.ydiMemory_xau16[1].ZFEH_EepromData ECU_ADDRESS 0xFFF8287D /end MEASUREMENT
/begin MEASUREMENT ZFEH_EepromData.ydiMemory_xau16[1].amb_cond.ambient_condition[0][22] "ambient condition shot [0 .. 2-1] with 25 data bytes [0 .. 25-1] for the error code stored in this error memory slot" UBYTE EH_STANDARD_S5_S3 1 100 0 255 DISPLAY_IDENTIFIER ambient_condition[0][22].amb_cond.ydiMemory_xau16[1].ZFEH_EepromData ECU_ADDRESS 0xFFF8287E /end MEASUREMENT
/begin MEASUREMENT ZFEH_EepromData.ydiMemory_xau16[1].amb_cond.ambient_condition[0][23] "ambient condition shot [0 .. 2-1] with 25 data bytes [0 .. 25-1] for the error code stored in this error memory slot" UBYTE EH_STANDARD_S5_S3 1 100 0 255 DISPLAY_IDENTIFIER ambient_condition[0][23].amb_cond.ydiMemory_xau16[1].ZFEH_EepromData ECU_ADDRESS 0xFFF8287F /end MEASUREMENT
/begin MEASUREMENT ZFEH_EepromData.ydiMemory_xau16[1].amb_cond.ambient_condition[0][24] "ambient condition shot [0 .. 2-1] with 25 data bytes [0 .. 25-1] for the error code stored in this error memory slot" UBYTE EH_STANDARD_S5_S3 1 100 0 255 DISPLAY_IDENTIFIER ambient_condition[0][24].amb_cond.ydiMemory_xau16[1].ZFEH_EepromData ECU_ADDRESS 0xFFF82880 /end MEASUREMENT
/begin MEASUREMENT ZFEH_EepromData.ydiMemory_xau16[1].amb_cond.ambient_condition[1][0] "ambient condition shot [0 .. 2-1] with 25 data bytes [0 .. 25-1] for the error code stored in this error memory slot" UBYTE EH_STANDARD_S5_S3 1 100 0 255 DISPLAY_IDENTIFIER ambient_condition[1][0].amb_cond.ydiMemory_xau16[1].ZFEH_EepromData ECU_ADDRESS 0xFFF82881 /end MEASUREMENT
/begin MEASUREMENT ZFEH_EepromData.ydiMemory_xau16[1].amb_cond.ambient_condition[1][10] "ambient condition shot [0 .. 2-1] with 25 data bytes [0 .. 25-1] for the error code stored in this error memory slot" UBYTE EH_STANDARD_S5_S3 1 100 0 255 DISPLAY_IDENTIFIER ambient_condition[1][10].amb_cond.ydiMemory_xau16[1].ZFEH_EepromData ECU_ADDRESS 0xFFF8288B /end MEASUREMENT
/begin MEASUREMENT ZFEH_EepromData.ydiMemory_xau16[1].amb_cond.ambient_condition[1][11] "ambient condition shot [0 .. 2-1] with 25 data bytes [0 .. 25-1] for the error code stored in this error memory slot" UBYTE EH_STANDARD_S5_S3 1 100 0 255 DISPLAY_IDENTIFIER ambient_condition[1][11].amb_cond.ydiMemory_xau16[1].ZFEH_EepromData ECU_ADDRESS 0xFFF8288C /end MEASUREMENT
/begin MEASUREMENT ZFEH_EepromData.ydiMemory_xau16[1].amb_cond.ambient_condition[1][12] "ambient condition shot [0 .. 2-1] with 25 data bytes [0 .. 25-1] for the error code stored in this error memory slot" UBYTE EH_STANDARD_S5_S3 1 100 0 255 DISPLAY_IDENTIFIER ambient_condition[1][12].amb_cond.ydiMemory_xau16[1].ZFEH_EepromData ECU_ADDRESS 0xFFF8288D /end MEASUREMENT
/begin MEASUREMENT ZFEH_EepromData.ydiMemory_xau16[1].amb_cond.ambient_condition[1][13] "ambient condition shot [0 .. 2-1] with 25 data bytes [0 .. 25-1] for the error code stored in this error memory slot" UBYTE EH_STANDARD_S5_S3 1 100 0 255 DISPLAY_IDENTIFIER ambient_condition[1][13].amb_cond.ydiMemory_xau16[1].ZFEH_EepromData ECU_ADDRESS 0xFFF8288E /end MEASUREMENT
/begin MEASUREMENT ZFEH_EepromData.ydiMemory_xau16[13].amb_cond.ambient_condition[0][1] "ambient condition shot [0 .. 2-1] with 25 data bytes [0 .. 25-1] for the error code stored in this error memory slot" UBYTE EH_STANDARD_S5_S3 1 100 0 255 DISPLAY_IDENTIFIER ambient_condition[0][1].amb_cond.ydiMemory_xau16[13].ZFEH_EepromData ECU_ADDRESS 0xFFF82BC9 /end MEASUREMENT
/begin MEASUREMENT ZFEH_EepromData.ydiMemory_xau16[13].amb_cond.ambient_condition[0][2] "ambient condition shot [0 .. 2-1] with 25 data bytes [0 .. 25-1] for the error code stored in this error memory slot" UBYTE EH_STANDARD_S5_S3 1 100 0 255 DISPLAY_IDENTIFIER ambient_condition[0][2].amb_cond.ydiMemory_xau16[13].ZFEH_EepromData ECU_ADDRESS 0xFFF82BCA /end MEASUREMENT
/begin MEASUREMENT ZFEH_EepromData.ydiMemory_xau16[13].amb_cond.ambient_condition[0][3] "ambient condition shot [0 .. 2-1] with 25 data bytes [0 .. 25-1] for the error code stored in this error memory slot" UBYTE EH_STANDARD_S5_S3 1 100 0 255 DISPLAY_IDENTIFIER ambient_condition[0][3].amb_cond.ydiMemory_xau16[13].ZFEH_EepromData ECU_ADDRESS 0xFFF82BCB /end MEASUREMENT
/begin MEASUREMENT ZFEH_EepromData.ydiMemory_xau16[13].amb_cond.ambient_condition[0][4] "ambient condition shot [0 .. 2-1] with 25 data bytes [0 .. 25-1] for the error code stored in this error memory slot" UBYTE EH_STANDARD_S5_S3 1 100 0 255 DISPLAY_IDENTIFIER ambient_condition[0][4].amb_cond.ydiMemory_xau16[13].ZFEH_EepromData ECU_ADDRESS 0xFFF82BCC /end MEASUREMENT
/begin MEASUREMENT ZFEH_EepromData.ydiMemory_xau16[13].amb_cond.ambient_condition[0][5] "ambient condition shot [0 .. 2-1] with 25 data bytes [0 .. 25-1] for the error code stored in this error memory slot" UBYTE EH_STANDARD_S5_S3 1 100 0 255 DISPLAY_IDENTIFIER ambient_condition[0][5].amb_cond.ydiMemory_xau16[13].ZFEH_EepromData ECU_ADDRESS 0xFFF82BCD /end MEASUREMENT
/begin MEASUREMENT ZFEH_EepromData.ydiMemory_xau16[13].amb_cond.ambient_condition[0][6] "ambient condition shot [0 .. 2-1] with 25 data bytes [0 .. 25-1] for the error code stored in this error memory slot" UBYTE EH_STANDARD_S5_S3 1 100 0 255 DISPLAY_IDENTIFIER ambient_condition[0][6].amb_cond.ydiMemory_xau16[13].ZFEH_EepromData ECU_ADDRESS 0xFFF82BCE /end MEASUREMENT
/begin MEASUREMENT ZFEH_EepromData.ydiMemory_xau16[13].amb_cond.ambient_condition[0][7] "ambient condition shot [0 .. 2-1] with 25 data bytes [0 .. 25-1] for the error code stored in this error memory slot" UBYTE EH_STANDARD_S5_S3 1 100 0 255 DISPLAY_IDENTIFIER ambient_condition[0][7].amb_cond.ydiMemory_xau16[13].ZFEH_EepromData ECU_ADDRESS 0xFFF82BCF /end MEASUREMENT
/begin MEASUREMENT ZFEH_EepromData.ydiMemory_xau16[13].amb_cond.ambient_condition[0][8] "ambient condition shot [0 .. 2-1] with 25 data bytes [0 .. 25-1] for the error code stored in this error memory slot" UBYTE EH_STANDARD_S5_S3 1 100 0 255 DISPLAY_IDENTIFIER ambient_condition[0][8].amb_cond.ydiMemory_xau16[13].ZFEH_EepromData ECU_ADDRESS 0xFFF82BD0 /end MEASUREMENT
/begin MEASUREMENT ZFEH_EepromData.ydiMemory_xau16[13].amb_cond.ambient_condition[0][9] "ambient condition shot [0 .. 2-1] with 25 data bytes [0 .. 25-1] for the error code stored in this error memory slot" UBYTE EH_STANDARD_S5_S3 1 100 0 255 DISPLAY_IDENTIFIER ambient_condition[0][9].amb_cond.ydiMemory_xau16[13].ZFEH_EepromData ECU_ADDRESS 0xFFF82BD1 /end MEASUREMENT
/begin MEASUREMENT ZFEH_EepromData.ydiMemory_xau16[13].amb_cond.ambient_condition[0][15] "ambient condition shot [0 .. 2-1] with 25 data bytes [0 .. 25-1] for the error code stored in this error memory slot" UBYTE EH_STANDARD_S5_S3 1 100 0 255 DISPLAY_IDENTIFIER ambient_condition[0][15].amb_cond.ydiMemory_xau16[13].ZFEH_EepromData ECU_ADDRESS 0xFFF82BD7 /end MEASUREMENT
/begin MEASUREMENT ZFEH_EepromData.ydiMemory_xau16[13].amb_cond.ambient_condition[0][16] "ambient condition shot [0 .. 2-1] with 25 data bytes [0 .. 25-1] for the error code stored in this error memory slot" UBYTE EH_STANDARD_S5_S3 1 100 0 255 DISPLAY_IDENTIFIER ambient_condition[0][16].amb_cond.ydiMemory_xau16[13].ZFEH_EepromData ECU_ADDRESS 0xFFF82BD8 /end MEASUREMENT
/begin MEASUREMENT ZFEH_EepromData.ydiMemory_xau16[13].amb_cond.ambient_condition[0][17] "ambient condition shot [0 .. 2-1] with 25 data bytes [0 .. 25-1] for the error code stored in this error memory slot" UBYTE EH_STANDARD_S5_S3 1 100 0 255 DISPLAY_IDENTIFIER ambient_condition[0][17].amb_cond.ydiMemory_xau16[13].ZFEH_EepromData ECU_ADDRESS 0xFFF82BD9 /end MEASUREMENT
/begin MEASUREMENT ZFEH_EepromData.ydiMemory_xau16[13].amb_cond.ambient_condition[0][18] "ambient condition shot [0 .. 2-1] with 25 data bytes [0 .. 25-1] for the error code stored in this error memory slot" UBYTE EH_STANDARD_S5_S3 1 100 0 255 DISPLAY_IDENTIFIER ambient_condition[0][18].amb_cond.ydiMemory_xau16[13].ZFEH_EepromData ECU_ADDRESS 0xFFF82BDA /end MEASUREMENT
/begin MEASUREMENT ZFEH_EepromData.ydiMemory_xau16[13].amb_cond.ambient_condition[0][19] "ambient condition shot [0 .. 2-1] with 25 data bytes [0 .. 25-1] for the error code stored in this error memory slot" UBYTE EH_STANDARD_S5_S3 1 100 0 255 DISPLAY_IDENTIFIER ambient_condition[0][19].amb_cond.ydiMemory_xau16[13].ZFEH_EepromData ECU_ADDRESS 0xFFF82BDB /end MEASUREMENT
/begin MEASUREMENT ZFEH_EepromData.ydiMemory_xau16[13].amb_cond.ambient_condition[0][20] "ambient condition shot [0 .. 2-1] with 25 data bytes [0 .. 25-1] for the error code stored in this error memory slot" UBYTE EH_STANDARD_S5_S3 1 100 0 255 DISPLAY_IDENTIFIER ambient_condition[0][20].amb_cond.ydiMemory_xau16[13].ZFEH_EepromData ECU_ADDRESS 0xFFF82BDC /end MEASUREMENT
/begin MEASUREMENT ZFEH_EepromData.ydiMemory_xau16[13].amb_cond.ambient_condition[0][21] "ambient condition shot [0 .. 2-1] with 25 data bytes [0 .. 25-1] for the error code stored in this error memory slot" UBYTE EH_STANDARD_S5_S3 1 100 0 255 DISPLAY_IDENTIFIER ambient_condition[0][21].amb_cond.ydiMemory_xau16[13].ZFEH_EepromData ECU_ADDRESS 0xFFF82BDD /end MEASUREMENT
/begin MEASUREMENT ZFEH_EepromData.ydiMemory_xau16[13].amb_cond.ambient_condition[0][22] "ambient condition shot [0 .. 2-1] with 25 data bytes [0 .. 25-1] for the error code stored in this error memory slot" UBYTE EH_STANDARD_S5_S3 1 100 0 255 DISPLAY_IDENTIFIER ambient_condition[0][22].amb_cond.ydiMemory_xau16[13].ZFEH_EepromData ECU_ADDRESS 0xFFF82BDE /end MEASUREMENT
/begin MEASUREMENT ZFEH_EepromData.ydiMemory_xau16[13].amb_cond.ambient_condition[0][23] "ambient condition shot [0 .. 2-1] with 25 data bytes [0 .. 25-1] for the error code stored in this error memory slot" UBYTE EH_STANDARD_S5_S3 1 100 0 255 DISPLAY_IDENTIFIER ambient_condition[0][23].amb_cond.ydiMemory_xau16[13].ZFEH_EepromData ECU_ADDRESS 0xFFF82BDF /end MEASUREMENT
/begin MEASUREMENT ZFEH_EepromData.ydiMemory_xau16[13].amb_cond.ambient_condition[0][24] "ambient condition shot [0 .. 2-1] with 25 data bytes [0 .. 25-1] for the error code stored in this error memory slot" UBYTE EH_STANDARD_S5_S3 1 100 0 255 DISPLAY_IDENTIFIER ambient_condition[0][24].amb_cond.ydiMemory_xau16[13].ZFEH_EepromData ECU_ADDRESS 0xFFF82BE0 /end MEASUREMENT
/begin MEASUREMENT ZFEH_EepromData.ydiMemory_xau16[13].amb_cond.ambient_condition[1][0] "ambient condition shot [0 .. 2-1] with 25 data bytes [0 .. 25-1] for the error code stored in this error memory slot" UBYTE EH_STANDARD_S5_S3 1 100 0 255 DISPLAY_IDENTIFIER ambient_condition[1][0].amb_cond.ydiMemory_xau16[13].ZFEH_EepromData ECU_ADDRESS 0xFFF82BE1 /end MEASUREMENT
/begin MEASUREMENT ZFEH_EepromData.ydiMemory_xau16[13].amb_cond.ambient_condition[1][1] "ambient condition shot [0 .. 2-1] with 25 data bytes [0 .. 25-1] for the error code stored in this error memory slot" UBYTE EH_STANDARD_S5_S3 1 100 0 255 DISPLAY_IDENTIFIER ambient_condition[1][1].amb_cond.ydiMemory_xau16[13].ZFEH_EepromData ECU_ADDRESS 0xFFF82BE2 /end MEASUREMENT
/begin MEASUREMENT ZFEH_EepromData.ydiMemory_xau16[13].amb_cond.ambient_condition[1][2] "ambient condition shot [0 .. 2-1] with 25 data bytes [0 .. 25-1] for the error code stored in this error memory slot" UBYTE EH_STANDARD_S5_S3 1 100 0 255 DISPLAY_IDENTIFIER ambient_condition[1][2].amb_cond.ydiMemory_xau16[13].ZFEH_EepromData ECU_ADDRESS 0xFFF82BE3 /end MEASUREMENT
/begin MEASUREMENT ZFEH_EepromData.ydiMemory_xau16[13].amb_cond.ambient_condition[1][3] "ambient condition shot [0 .. 2-1] with 25 data bytes [0 .. 25-1] for the error code stored in this error memory slot" UBYTE EH_STANDARD_S5_S3 1 100 0 255 DISPLAY_IDENTIFIER ambient_condition[1][3].amb_cond.ydiMemory_xau16[13].ZFEH_EepromData ECU_ADDRESS 0xFFF82BE4 /end MEASUREMENT
/begin MEASUREMENT ZFEH_EepromData.ydiMemory_xau16[13].amb_cond.ambient_condition[1][4] "ambient condition shot [0 .. 2-1] with 25 data bytes [0 .. 25-1] for the error code stored in this error memory slot" UBYTE EH_STANDARD_S5_S3 1 100 0 255 DISPLAY_IDENTIFIER ambient_condition[1][4].amb_cond.ydiMemory_xau16[13].ZFEH_EepromData ECU_ADDRESS 0xFFF82BE5 /end MEASUREMENT
/begin MEASUREMENT ZFEH_EepromData.ydiMemory_xau16[13].amb_cond.ambient_condition[1][5] "ambient condition shot [0 .. 2-1] with 25 data bytes [0 .. 25-1] for the error code stored in this error memory slot" UBYTE EH_STANDARD_S5_S3 1 100 0 255 DISPLAY_IDENTIFIER ambient_condition[1][5].amb_cond.ydiMemory_xau16[13].ZFEH_EepromData ECU_ADDRESS 0xFFF82BE6 /end MEASUREMENT
/begin MEASUREMENT ZFEH_EepromData.ydiMemory_xau16[13].amb_cond.ambient_condition[1][6] "ambient condition shot [0 .. 2-1] with 25 data bytes [0 .. 25-1] for the error code stored in this error memory slot" UBYTE EH_STANDARD_S5_S3 1 100 0 255 DISPLAY_IDENTIFIER ambient_condition[1][6].amb_cond.ydiMemory_xau16[13].ZFEH_EepromData ECU_ADDRESS 0xFFF82BE7 /end MEASUREMENT
/begin MEASUREMENT ZFEH_EepromData.ydiMemory_xau16[13].amb_cond.ambient_condition[1][7] "ambient condition shot [0 .. 2-1] with 25 data bytes [0 .. 25-1] for the error code stored in this error memory slot" UBYTE EH_STANDARD_S5_S3 1 100 0 255 DISPLAY_IDENTIFIER ambient_condition[1][7].amb_cond.ydiMemory_xau16[13].ZFEH_EepromData ECU_ADDRESS 0xFFF82BE8 /end MEASUREMENT
/begin MEASUREMENT ZFEH_EepromData.ydiMemory_xau16[13].amb_cond.ambient_condition[1][8] "ambient condition shot [0 .. 2-1] with 25 data bytes [0 .. 25-1] for the error code stored in this error memory slot" UBYTE EH_STANDARD_S5_S3 1 100 0 255 DISPLAY_IDENTIFIER ambient_condition[1][8].amb_cond.ydiMemory_xau16[13].ZFEH_EepromData ECU_ADDRESS 0xFFF82BE9 /end MEASUREMENT
/begin MEASUREMENT ZFEH_EepromData.ydiMemory_xau16[13].amb_cond.ambient_condition[1][9] "ambient condition shot [0 .. 2-1] with 25 data bytes [0 .. 25-1] for the error code stored in this error memory slot" UBYTE EH_STANDARD_S5_S3 1 100 0 255 DISPLAY_IDENTIFIER ambient_condition[1][9].amb_cond.ydiMemory_xau16[13].ZFEH_EepromData ECU_ADDRESS 0xFFF82BEA /end MEASUREMENT
/begin MEASUREMENT ZFEH_EepromData.ydiMemory_xau16[13].amb_cond.ambient_condition[1][10] "ambient condition shot [0 .. 2-1] with 25 data bytes [0 .. 25-1] for the error code stored in this error memory slot" UBYTE EH_STANDARD_S5_S3 1 100 0 255 DISPLAY_IDENTIFIER ambient_condition[1][10].amb_cond.ydiMemory_xau16[13].ZFEH_EepromData ECU_ADDRESS 0xFFF82BEB /end MEASUREMENT
/begin MEASUREMENT ZFEH_EepromData.ydiMemory_xau16[13].amb_cond.ambient_condition[1][11] "ambient condition shot [0 .. 2-1] with 25 data bytes [0 .. 25-1] for the error code stored in this error memory slot" UBYTE EH_STANDARD_S5_S3 1 100 0 255 DISPLAY_IDENTIFIER ambient_condition[1][11].amb_cond.ydiMemory_xau16[13].ZFEH_EepromData ECU_ADDRESS 0xFFF82BEC /end MEASUREMENT
/begin MEASUREMENT ZFEH_EepromData.ydiMemory_xau16[13].amb_cond.ambient_condition[1][12] "ambient condition shot [0 .. 2-1] with 25 data bytes [0 .. 25-1] for the error code stored in this error memory slot" UBYTE EH_STANDARD_S5_S3 1 100 0 255 DISPLAY_IDENTIFIER ambient_condition[1][12].amb_cond.ydiMemory_xau16[13].ZFEH_EepromData ECU_ADDRESS 0xFFF82BED /end MEASUREMENT
/begin MEASUREMENT ZFEH_EepromData.ydiMemory_xau16[13].amb_cond.ambient_condition[1][13] "ambient condition shot [0 .. 2-1] with 25 data bytes [0 .. 25-1] for the error code stored in this error memory slot" UBYTE EH_STANDARD_S5_S3 1 100 0 255 DISPLAY_IDENTIFIER ambient_condition[1][13].amb_cond.ydiMemory_xau16[13].ZFEH_EepromData ECU_ADDRESS 0xFFF82BEE /end MEASUREMENT
/begin MEASUREMENT ZFEH_EepromData.ydiMemory_xau16[13].amb_cond.ambient_condition[1][14] "ambient condition shot [0 .. 2-1] with 25 data bytes [0 .. 25-1] for the error code stored in this error memory slot" UBYTE EH_STANDARD_S5_S3 1 100 0 255 DISPLAY_IDENTIFIER ambient_condition[1][14].amb_cond.ydiMemory_xau16[13].ZFEH_EepromData ECU_ADDRESS 0xFFF82BEF /end MEASUREMENT
/begin MEASUREMENT ZFEH_EepromData.ydiMemory_xau16[13].amb_cond.ambient_condition[1][15] "ambient condition shot [0 .. 2-1] with 25 data bytes [0 .. 25-1] for the error code stored in this error memory slot" UBYTE EH_STANDARD_S5_S3 1 100 0 255 DISPLAY_IDENTIFIER ambient_condition[1][15].amb_cond.ydiMemory_xau16[13].ZFEH_EepromData ECU_ADDRESS 0xFFF82BF0 /end MEASUREMENT
/begin MEASUREMENT ZFEH_EepromData.ydiMemory_xau16[13].amb_cond.ambient_condition[1][16] "ambient condition shot [0 .. 2-1] with 25 data bytes [0 .. 25-1] for the error code stored in this error memory slot" UBYTE EH_STANDARD_S5_S3 1 100 0 255 DISPLAY_IDENTIFIER ambient_condition[1][16].amb_cond.ydiMemory_xau16[13].ZFEH_EepromData ECU_ADDRESS 0xFFF82BF1 /end MEASUREMENT
/begin MEASUREMENT ZFEH_EepromData.ydiMemory_xau16[13].amb_cond.ambient_condition[1][17] "ambient condition shot [0 .. 2-1] with 25 data bytes [0 .. 25-1] for the error code stored in this error memory slot" UBYTE EH_STANDARD_S5_S3 1 100 0 255 DISPLAY_IDENTIFIER ambient_condition[1][17].amb_cond.ydiMemory_xau16[13].ZFEH_EepromData ECU_ADDRESS 0xFFF82BF2 /end MEASUREMENT
/begin MEASUREMENT ZFEH_EepromData.ydiMemory_xau16[13].amb_cond.ambient_condition[1][18] "ambient condition shot [0 .. 2-1] with 25 data bytes [0 .. 25-1] for the error code stored in this error memory slot" UBYTE EH_STANDARD_S5_S3 1 100 0 255 DISPLAY_IDENTIFIER ambient_condition[1][18].amb_cond.ydiMemory_xau16[13].ZFEH_EepromData ECU_ADDRESS 0xFFF82BF3 /end MEASUREMENT
/begin MEASUREMENT ZFEH_EepromData.ydiMemory_xau16[13].amb_cond.ambient_condition[1][19] "ambient condition shot [0 .. 2-1] with 25 data bytes [0 .. 25-1] for the error code stored in this error memory slot" UBYTE EH_STANDARD_S5_S3 1 100 0 255 DISPLAY_IDENTIFIER ambient_condition[1][19].amb_cond.ydiMemory_xau16[13].ZFEH_EepromData ECU_ADDRESS 0xFFF82BF4 /end MEASUREMENT
/begin MEASUREMENT ZFEH_EepromData.ydiMemory_xau16[13].amb_cond.ambient_condition[1][20] "ambient condition shot [0 .. 2-1] with 25 data bytes [0 .. 25-1] for the error code stored in this error memory slot" UBYTE EH_STANDARD_S5_S3 1 100 0 255 DISPLAY_IDENTIFIER ambient_condition[1][20].amb_cond.ydiMemory_xau16[13].ZFEH_EepromData ECU_ADDRESS 0xFFF82BF5 /end MEASUREMENT
/begin MEASUREMENT ZFEH_EepromData.ydiMemory_xau16[13].amb_cond.ambient_condition[1][21] "ambient condition shot [0 .. 2-1] with 25 data bytes [0 .. 25-1] for the error code stored in this error memory slot" UBYTE EH_STANDARD_S5_S3 1 100 0 255 DISPLAY_IDENTIFIER ambient_condition[1][21].amb_cond.ydiMemory_xau16[13].ZFEH_EepromData ECU_ADDRESS 0xFFF82BF6 /end MEASUREMENT
/begin MEASUREMENT ZFEH_EepromData.ydiMemory_xau16[13].amb_cond.ambient_condition[1][22] "ambient condition shot [0 .. 2-1] with 25 data bytes [0 .. 25-1] for the error code stored in this error memory slot" UBYTE EH_STANDARD_S5_S3 1 100 0 255 DISPLAY_IDENTIFIER ambient_condition[1][22].amb_cond.ydiMemory_xau16[13].ZFEH_EepromData ECU_ADDRESS 0xFFF82BF7 /end MEASUREMENT
/begin MEASUREMENT ZFEH_EepromData.ydiMemory_xau16[13].amb_cond.ambient_condition[1][23] "ambient condition shot [0 .. 2-1] with 25 data bytes [0 .. 25-1] for the error code stored in this error memory slot" UBYTE EH_STANDARD_S5_S3 1 100 0 255 DISPLAY_IDENTIFIER ambient_condition[1][23].amb_cond.ydiMemory_xau16[13].ZFEH_EepromData ECU_ADDRESS 0xFFF82BF8 /end MEASUREMENT
/begin MEASUREMENT ZFEH_EepromData.ydiMemory_xau16[13].amb_cond.ambient_condition[1][24] "ambient condition shot [0 .. 2-1] with 25 data bytes [0 .. 25-1] for the error code stored in this error memory slot" UBYTE EH_STANDARD_S5_S3 1 100 0 255 DISPLAY_IDENTIFIER ambient_condition[1][24].amb_cond.ydiMemory_xau16[13].ZFEH_EepromData ECU_ADDRESS 0xFFF82BF9 /end MEASUREMENT
/begin MEASUREMENT ZFEH_EepromData.ydiMemory_xau16[13].amb_cond.status_of_ambient_conditions[0] "status of ambient condition shot x: 0=invalid 1=valid" UBYTE EH_STANDARD_S5_S3 1 100 0 1 DISPLAY_IDENTIFIER status_of_ambient_conditions[0].amb_cond.ydiMemory_xau16[13].ZFEH_EepromData ECU_ADDRESS 0xFFF82BFA /end MEASUREMENT
/begin MEASUREMENT ZFEH_EepromData.ydiMemory_xau16[13].amb_cond.status_of_ambient_conditions[1] "status of ambient condition shot x: 0=invalid 1=valid" UBYTE EH_STANDARD_S5_S3 1 100 0 1 DISPLAY_IDENTIFIER status_of_ambient_conditions[1].amb_cond.ydiMemory_xau16[13].ZFEH_EepromData ECU_ADDRESS 0xFFF82BFB /end MEASUREMENT
/begin MEASUREMENT ZFEH_EepromData.ydiMemory_xau16[13].error_code "error code stored in error memory slot" UWORD CONV_KFC_NAME 0 255 0 65535 DISPLAY_IDENTIFIER error_code.ydiMemory_xau16[13].ZFEH_EepromData ECU_ADDRESS 0xFFF82BB4 /end MEASUREMENT
/begin MEASUREMENT ZFEH_EepromData.ydiMemory_xau16[13].error_type "error type of error code stored in error memory slot" UWORD EH_STANDARD_S5_S3 1 100 0 65535 DISPLAY_IDENTIFIER error_type.ydiMemory_xau16[13].ZFEH_EepromData ECU_ADDRESS 0xFFF82BB6 /end MEASUREMENT
/begin MEASUREMENT ZFEH_EepromData.ydiMemory_xau16[13].status_word "status word of error code stored in error memory slot" UWORD EH_STANDARD_S5_S3 1 100 0 65535 DISPLAY_IDENTIFIER status_word.ydiMemory_xau16[13].ZFEH_EepromData ECU_ADDRESS 0xFFF82BB8 /end MEASUREMENT
/begin MEASUREMENT ZFEH_EepromData.ydiMemory_xau16[13].frequency_counter "frequency counter of error code stored in error memory slot" UBYTE EH_STANDARD_S5_S3 1 100 0 255 DISPLAY_IDENTIFIER frequency_counter.ydiMemory_xau16[13].ZFEH_EepromData ECU_ADDRESS 0xFFF82BBA /end MEASUREMENT
/begin MEASUREMENT ZFEH_EepromData.ydiMemory_xau16[13].backwards_counter "backwards counter of error code stored in error memory slot" UBYTE EH_STANDARD_S5_S3 1 100 0 255 DISPLAY_IDENTIFIER backwards_counter.ydiMemory_xau16[13].ZFEH_EepromData ECU_ADDRESS 0xFFF82BBB /end MEASUREMENT
/begin MEASUREMENT ZFEH_EepromData.ydiMemory_xau16[13].permanent_counter "counter of permanent error codes stored in error memory slot" UBYTE EH_STANDARD_S5_S3 1 100 0 255 DISPLAY_IDENTIFIER permanent_counter.ydiMemory_xau16[13].ZFEH_EepromData ECU_ADDRESS 0xFFF82BBC /end MEASUREMENT
/begin MEASUREMENT ZFEH_EepromData.ydiMemory_xau16[13].sequence_counter "sequence counter of error code stored in error memory slot" UBYTE EH_STANDARD_S5_S3 1 100 0 255 DISPLAY_IDENTIFIER sequence_counter.ydiMemory_xau16[13].ZFEH_EepromData ECU_ADDRESS 0xFFF82BBD /end MEASUREMENT
/begin MEASUREMENT ZFEH_EepromData.ydiMemory_xau16[13].master_time "master time of error code stored in error memory slot" ULONG EH_STANDARD_S5_S3 1 100 0 4294967295 DISPLAY_IDENTIFIER master_time.ydiMemory_xau16[13].ZFEH_EepromData ECU_ADDRESS 0xFFF82BC0 /end MEASUREMENT
/begin MEASUREMENT ZFEH_EepromData.ydiMemory_xau16[13].condition_byte "condition byte of error code stored in error memory slot" UBYTE EH_STANDARD_S5_S3 1 100 0 255 DISPLAY_IDENTIFIER condition_byte.ydiMemory_xau16[13].ZFEH_EepromData ECU_ADDRESS 0xFFF82BC5 /end MEASUREMENT
/begin MEASUREMENT ZFEH_EepromData.ydiMemory_xau16[13].obd_driving_cycle_counter "obd driving cycle counter of error code stored in error memory slot" UWORD EH_STANDARD_S5_S3 1 100 0 65535 DISPLAY_IDENTIFIER obd_driving_cycle_counter.ydiMemory_xau16[13].ZFEH_EepromData ECU_ADDRESS 0xFFF82BC6 /end MEASUREMENT
/begin MEASUREMENT ZFEH_EepromData.ydiMemory_xau16[14].amb_cond.ambient_condition[0][0] "ambient condition shot [0 .. 2-1] with 25 data bytes [0 .. 25-1] for the error code stored in this error memory slot" UBYTE EH_STANDARD_S5_S3 1 100 0 255 DISPLAY_IDENTIFIER ambient_condition[0][0].amb_cond.ydiMemory_xau16[14].ZFEH_EepromData ECU_ADDRESS 0xFFF82C10 /end MEASUREMENT
/begin MEASUREMENT ZFEH_EepromData.ydiMemory_xau16[14].amb_cond.ambient_condition[0][1] "ambient condition shot [0 .. 2-1] with 25 data bytes [0 .. 25-1] for the error code stored in this error memory slot" UBYTE EH_STANDARD_S5_S3 1 100 0 255 DISPLAY_IDENTIFIER ambient_condition[0][1].amb_cond.ydiMemory_xau16[14].ZFEH_EepromData ECU_ADDRESS 0xFFF82C11 /end MEASUREMENT
/begin MEASUREMENT ZFEH_EepromData.ydiMemory_xau16[14].amb_cond.ambient_condition[0][2] "ambient condition shot [0 .. 2-1] with 25 data bytes [0 .. 25-1] for the error code stored in this error memory slot" UBYTE EH_STANDARD_S5_S3 1 100 0 255 DISPLAY_IDENTIFIER ambient_condition[0][2].amb_cond.ydiMemory_xau16[14].ZFEH_EepromData ECU_ADDRESS 0xFFF82C12 /end MEASUREMENT
/begin MEASUREMENT ZFEH_EepromData.ydiMemory_xau16[14].amb_cond.ambient_condition[0][3] "ambient condition shot [0 .. 2-1] with 25 data bytes [0 .. 25-1] for the error code stored in this error memory slot" UBYTE EH_STANDARD_S5_S3 1 100 0 255 DISPLAY_IDENTIFIER ambient_condition[0][3].amb_cond.ydiMemory_xau16[14].ZFEH_EepromData ECU_ADDRESS 0xFFF82C13 /end MEASUREMENT
/begin MEASUREMENT ZFEH_EepromData.ydiMemory_xau16[14].amb_cond.ambient_condition[0][4] "ambient condition shot [0 .. 2-1] with 25 data bytes [0 .. 25-1] for the error code stored in this error memory slot" UBYTE EH_STANDARD_S5_S3 1 100 0 255 DISPLAY_IDENTIFIER ambient_condition[0][4].amb_cond.ydiMemory_xau16[14].ZFEH_EepromData ECU_ADDRESS 0xFFF82C14 /end MEASUREMENT
/begin MEASUREMENT ZFEH_EepromData.ydiMemory_xau16[14].amb_cond.ambient_condition[0][5] "ambient condition shot [0 .. 2-1] with 25 data bytes [0 .. 25-1] for the error code stored in this error memory slot" UBYTE EH_STANDARD_S5_S3 1 100 0 255 DISPLAY_IDENTIFIER ambient_condition[0][5].amb_cond.ydiMemory_xau16[14].ZFEH_EepromData ECU_ADDRESS 0xFFF82C15 /end MEASUREMENT
/begin MEASUREMENT ZFEH_EepromData.ydiMemory_xau16[14].amb_cond.ambient_condition[0][6] "ambient condition shot [0 .. 2-1] with 25 data bytes [0 .. 25-1] for the error code stored in this error memory slot" UBYTE EH_STANDARD_S5_S3 1 100 0 255 DISPLAY_IDENTIFIER ambient_condition[0][6].amb_cond.ydiMemory_xau16[14].ZFEH_EepromData ECU_ADDRESS 0xFFF82C16 /end MEASUREMENT
/begin MEASUREMENT ZFEH_EepromData.ydiMemory_xau16[14].amb_cond.ambient_condition[0][7] "ambient condition shot [0 .. 2-1] with 25 data bytes [0 .. 25-1] for the error code stored in this error memory slot" UBYTE EH_STANDARD_S5_S3 1 100 0 255 DISPLAY_IDENTIFIER ambient_condition[0][7].amb_cond.ydiMemory_xau16[14].ZFEH_EepromData ECU_ADDRESS 0xFFF82C17 /end MEASUREMENT
/begin MEASUREMENT ZFEH_EepromData.ydiMemory_xau16[14].amb_cond.ambient_condition[0][8] "ambient condition shot [0 .. 2-1] with 25 data bytes [0 .. 25-1] for the error code stored in this error memory slot" UBYTE EH_STANDARD_S5_S3 1 100 0 255 DISPLAY_IDENTIFIER ambient_condition[0][8].amb_cond.ydiMemory_xau16[14].ZFEH_EepromData ECU_ADDRESS 0xFFF82C18 /end MEASUREMENT
/begin MEASUREMENT ZFEH_EepromData.ydiMemory_xau16[14].amb_cond.ambient_condition[0][9] "ambient condition shot [0 .. 2-1] with 25 data bytes [0 .. 25-1] for the error code stored in this error memory slot" UBYTE EH_STANDARD_S5_S3 1 100 0 255 DISPLAY_IDENTIFIER ambient_condition[0][9].amb_cond.ydiMemory_xau16[14].ZFEH_EepromData ECU_ADDRESS 0xFFF82C19 /end MEASUREMENT
/begin MEASUREMENT ZFEH_EepromData.ydiMemory_xau16[14].amb_cond.ambient_condition[0][10] "ambient condition shot [0 .. 2-1] with 25 data bytes [0 .. 25-1] for the error code stored in this error memory slot" UBYTE EH_STANDARD_S5_S3 1 100 0 255 DISPLAY_IDENTIFIER ambient_condition[0][10].amb_cond.ydiMemory_xau16[14].ZFEH_EepromData ECU_ADDRESS 0xFFF82C1A /end MEASUREMENT
/begin MEASUREMENT ZFEH_EepromData.ydiMemory_xau16[14].amb_cond.ambient_condition[0][11] "ambient condition shot [0 .. 2-1] with 25 data bytes [0 .. 25-1] for the error code stored in this error memory slot" UBYTE EH_STANDARD_S5_S3 1 100 0 255 DISPLAY_IDENTIFIER ambient_condition[0][11].amb_cond.ydiMemory_xau16[14].ZFEH_EepromData ECU_ADDRESS 0xFFF82C1B /end MEASUREMENT
/begin MEASUREMENT ZFEH_EepromData.ydiMemory_xau16[14].amb_cond.ambient_condition[0][12] "ambient condition shot [0 .. 2-1] with 25 data bytes [0 .. 25-1] for the error code stored in this error memory slot" UBYTE EH_STANDARD_S5_S3 1 100 0 255 DISPLAY_IDENTIFIER ambient_condition[0][12].amb_cond.ydiMemory_xau16[14].ZFEH_EepromData ECU_ADDRESS 0xFFF82C1C /end MEASUREMENT
/begin MEASUREMENT ZFEH_EepromData.ydiMemory_xau16[14].amb_cond.ambient_condition[0][13] "ambient condition shot [0 .. 2-1] with 25 data bytes [0 .. 25-1] for the error code stored in this error memory slot" UBYTE EH_STANDARD_S5_S3 1 100 0 255 DISPLAY_IDENTIFIER ambient_condition[0][13].amb_cond.ydiMemory_xau16[14].ZFEH_EepromData ECU_ADDRESS 0xFFF82C1D /end MEASUREMENT
/begin MEASUREMENT ZFEH_EepromData.ydiMemory_xau16[14].amb_cond.ambient_condition[0][14] "ambient condition shot [0 .. 2-1] with 25 data bytes [0 .. 25-1] for the error code stored in this error memory slot" UBYTE EH_STANDARD_S5_S3 1 100 0 255 DISPLAY_IDENTIFIER ambient_condition[0][14].amb_cond.ydiMemory_xau16[14].ZFEH_EepromData ECU_ADDRESS 0xFFF82C1E /end MEASUREMENT
/begin MEASUREMENT ZFEH_EepromData.ydiMemory_xau16[14].amb_cond.ambient_condition[0][15] "ambient condition shot [0 .. 2-1] with 25 data bytes [0 .. 25-1] for the error code stored in this error memory slot" UBYTE EH_STANDARD_S5_S3 1 100 0 255 DISPLAY_IDENTIFIER ambient_condition[0][15].amb_cond.ydiMemory_xau16[14].ZFEH_EepromData ECU_ADDRESS 0xFFF82C1F /end MEASUREMENT
/begin MEASUREMENT ZFEH_EepromData.ydiMemory_xau16[14].amb_cond.ambient_condition[0][16] "ambient condition shot [0 .. 2-1] with 25 data bytes [0 .. 25-1] for the error code stored in this error memory slot" UBYTE EH_STANDARD_S5_S3 1 100 0 255 DISPLAY_IDENTIFIER ambient_condition[0][16].amb_cond.ydiMemory_xau16[14].ZFEH_EepromData ECU_ADDRESS 0xFFF82C20 /end MEASUREMENT
/begin MEASUREMENT ZFEH_EepromData.ydiMemory_xau16[14].amb_cond.ambient_condition[0][17] "ambient condition shot [0 .. 2-1] with 25 data bytes [0 .. 25-1] for the error code stored in this error memory slot" UBYTE EH_STANDARD_S5_S3 1 100 0 255 DISPLAY_IDENTIFIER ambient_condition[0][17].amb_cond.ydiMemory_xau16[14].ZFEH_EepromData ECU_ADDRESS 0xFFF82C21 /end MEASUREMENT
/begin MEASUREMENT ZFEH_EepromData.ydiMemory_xau16[14].amb_cond.ambient_condition[0][18] "ambient condition shot [0 .. 2-1] with 25 data bytes [0 .. 25-1] for the error code stored in this error memory slot" UBYTE EH_STANDARD_S5_S3 1 100 0 255 DISPLAY_IDENTIFIER ambient_condition[0][18].amb_cond.ydiMemory_xau16[14].ZFEH_EepromData ECU_ADDRESS 0xFFF82C22 /end MEASUREMENT
/begin MEASUREMENT ZFEH_EepromData.ydiMemory_xau16[14].amb_cond.ambient_condition[0][19] "ambient condition shot [0 .. 2-1] with 25 data bytes [0 .. 25-1] for the error code stored in this error memory slot" UBYTE EH_STANDARD_S5_S3 1 100 0 255 DISPLAY_IDENTIFIER ambient_condition[0][19].amb_cond.ydiMemory_xau16[14].ZFEH_EepromData ECU_ADDRESS 0xFFF82C23 /end MEASUREMENT
/begin MEASUREMENT ZFEH_EepromData.ydiMemory_xau16[14].amb_cond.ambient_condition[0][20] "ambient condition shot [0 .. 2-1] with 25 data bytes [0 .. 25-1] for the error code stored in this error memory slot" UBYTE EH_STANDARD_S5_S3 1 100 0 255 DISPLAY_IDENTIFIER ambient_condition[0][20].amb_cond.ydiMemory_xau16[14].ZFEH_EepromData ECU_ADDRESS 0xFFF82C24 /end MEASUREMENT
/begin MEASUREMENT ZFEH_EepromData.ydiMemory_xau16[14].amb_cond.ambient_condition[0][21] "ambient condition shot [0 .. 2-1] with 25 data bytes [0 .. 25-1] for the error code stored in this error memory slot" UBYTE EH_STANDARD_S5_S3 1 100 0 255 DISPLAY_IDENTIFIER ambient_condition[0][21].amb_cond.ydiMemory_xau16[14].ZFEH_EepromData ECU_ADDRESS 0xFFF82C25 /end MEASUREMENT
/begin MEASUREMENT ZFEH_EepromData.ydiMemory_xau16[14].amb_cond.ambient_condition[0][22] "ambient condition shot [0 .. 2-1] with 25 data bytes [0 .. 25-1] for the error code stored in this error memory slot" UBYTE EH_STANDARD_S5_S3 1 100 0 255 DISPLAY_IDENTIFIER ambient_condition[0][22].amb_cond.ydiMemory_xau16[14].ZFEH_EepromData ECU_ADDRESS 0xFFF82C26 /end MEASUREMENT
/begin MEASUREMENT ZFEH_EepromData.ydiMemory_xau16[14].amb_cond.ambient_condition[0][23] "ambient condition shot [0 .. 2-1] with 25 data bytes [0 .. 25-1] for the error code stored in this error memory slot" UBYTE EH_STANDARD_S5_S3 1 100 0 255 DISPLAY_IDENTIFIER ambient_condition[0][23].amb_cond.ydiMemory_xau16[14].ZFEH_EepromData ECU_ADDRESS 0xFFF82C27 /end MEASUREMENT
/begin MEASUREMENT ZFEH_EepromData.ydiMemory_xau16[14].amb_cond.ambient_condition[0][24] "ambient condition shot [0 .. 2-1] with 25 data bytes [0 .. 25-1] for the error code stored in this error memory slot" UBYTE EH_STANDARD_S5_S3 1 100 0 255 DISPLAY_IDENTIFIER ambient_condition[0][24].amb_cond.ydiMemory_xau16[14].ZFEH_EepromData ECU_ADDRESS 0xFFF82C28 /end MEASUREMENT
/begin MEASUREMENT ZFEH_EepromData.ydiMemory_xau16[14].amb_cond.ambient_condition[1][0] "ambient condition shot [0 .. 2-1] with 25 data bytes [0 .. 25-1] for the error code stored in this error memory slot" UBYTE EH_STANDARD_S5_S3 1 100 0 255 DISPLAY_IDENTIFIER ambient_condition[1][0].amb_cond.ydiMemory_xau16[14].ZFEH_EepromData ECU_ADDRESS 0xFFF82C29 /end MEASUREMENT
/begin MEASUREMENT ZFEH_EepromData.ydiMemory_xau16[14].amb_cond.ambient_condition[1][1] "ambient condition shot [0 .. 2-1] with 25 data bytes [0 .. 25-1] for the error code stored in this error memory slot" UBYTE EH_STANDARD_S5_S3 1 100 0 255 DISPLAY_IDENTIFIER ambient_condition[1][1].amb_cond.ydiMemory_xau16[14].ZFEH_EepromData ECU_ADDRESS 0xFFF82C2A /end MEASUREMENT
/begin MEASUREMENT ZFEH_EepromData.ydiMemory_xau16[14].amb_cond.ambient_condition[1][2] "ambient condition shot [0 .. 2-1] with 25 data bytes [0 .. 25-1] for the error code stored in this error memory slot" UBYTE EH_STANDARD_S5_S3 1 100 0 255 DISPLAY_IDENTIFIER ambient_condition[1][2].amb_cond.ydiMemory_xau16[14].ZFEH_EepromData ECU_ADDRESS 0xFFF82C2B /end MEASUREMENT
/begin MEASUREMENT ZFEH_EepromData.ydiMemory_xau16[14].amb_cond.ambient_condition[1][3] "ambient condition shot [0 .. 2-1] with 25 data bytes [0 .. 25-1] for the error code stored in this error memory slot" UBYTE EH_STANDARD_S5_S3 1 100 0 255 DISPLAY_IDENTIFIER ambient_condition[1][3].amb_cond.ydiMemory_xau16[14].ZFEH_EepromData ECU_ADDRESS 0xFFF82C2C /end MEASUREMENT
/begin MEASUREMENT ZFEH_EepromData.ydiMemory_xau16[14].amb_cond.ambient_condition[1][4] "ambient condition shot [0 .. 2-1] with 25 data bytes [0 .. 25-1] for the error code stored in this error memory slot" UBYTE EH_STANDARD_S5_S3 1 100 0 255 DISPLAY_IDENTIFIER ambient_condition[1][4].amb_cond.ydiMemory_xau16[14].ZFEH_EepromData ECU_ADDRESS 0xFFF82C2D /end MEASUREMENT
/begin MEASUREMENT ZFEH_EepromData.ydiMemory_xau16[14].amb_cond.ambient_condition[1][5] "ambient condition shot [0 .. 2-1] with 25 data bytes [0 .. 25-1] for the error code stored in this error memory slot" UBYTE EH_STANDARD_S5_S3 1 100 0 255 DISPLAY_IDENTIFIER ambient_condition[1][5].amb_cond.ydiMemory_xau16[14].ZFEH_EepromData ECU_ADDRESS 0xFFF82C2E /end MEASUREMENT
/begin MEASUREMENT ZFEH_EepromData.ydiMemory_xau16[14].amb_cond.ambient_condition[1][6] "ambient condition shot [0 .. 2-1] with 25 data bytes [0 .. 25-1] for the error code stored in this error memory slot" UBYTE EH_STANDARD_S5_S3 1 100 0 255 DISPLAY_IDENTIFIER ambient_condition[1][6].amb_cond.ydiMemory_xau16[14].ZFEH_EepromData ECU_ADDRESS 0xFFF82C2F /end MEASUREMENT
/begin MEASUREMENT ZFEH_EepromData.ydiMemory_xau16[14].amb_cond.ambient_condition[1][7] "ambient condition shot [0 .. 2-1] with 25 data bytes [0 .. 25-1] for the error code stored in this error memory slot" UBYTE EH_STANDARD_S5_S3 1 100 0 255 DISPLAY_IDENTIFIER ambient_condition[1][7].amb_cond.ydiMemory_xau16[14].ZFEH_EepromData ECU_ADDRESS 0xFFF82C30 /end MEASUREMENT
/begin MEASUREMENT ZFEH_EepromData.ydiMemory_xau16[14].amb_cond.ambient_condition[1][8] "ambient condition shot [0 .. 2-1] with 25 data bytes [0 .. 25-1] for the error code stored in this error memory slot" UBYTE EH_STANDARD_S5_S3 1 100 0 255 DISPLAY_IDENTIFIER ambient_condition[1][8].amb_cond.ydiMemory_xau16[14].ZFEH_EepromData ECU_ADDRESS 0xFFF82C31 /end MEASUREMENT
/begin MEASUREMENT ZFEH_EepromData.ydiMemory_xau16[14].amb_cond.ambient_condition[1][9] "ambient condition shot [0 .. 2-1] with 25 data bytes [0 .. 25-1] for the error code stored in this error memory slot" UBYTE EH_STANDARD_S5_S3 1 100 0 255 DISPLAY_IDENTIFIER ambient_condition[1][9].amb_cond.ydiMemory_xau16[14].ZFEH_EepromData ECU_ADDRESS 0xFFF82C32 /end MEASUREMENT
/begin MEASUREMENT ZFEH_EepromData.ydiMemory_xau16[14].amb_cond.ambient_condition[1][10] "ambient condition shot [0 .. 2-1] with 25 data bytes [0 .. 25-1] for the error code stored in this error memory slot" UBYTE EH_STANDARD_S5_S3 1 100 0 255 DISPLAY_IDENTIFIER ambient_condition[1][10].amb_cond.ydiMemory_xau16[14].ZFEH_EepromData ECU_ADDRESS 0xFFF82C33 /end MEASUREMENT
/begin MEASUREMENT ZFEH_EepromData.ydiMemory_xau16[14].amb_cond.ambient_condition[1][11] "ambient condition shot [0 .. 2-1] with 25 data bytes [0 .. 25-1] for the error code stored in this error memory slot" UBYTE EH_STANDARD_S5_S3 1 100 0 255 DISPLAY_IDENTIFIER ambient_condition[1][11].amb_cond.ydiMemory_xau16[14].ZFEH_EepromData ECU_ADDRESS 0xFFF82C34 /end MEASUREMENT
/begin MEASUREMENT ZFEH_EepromData.ydiMemory_xau16[14].amb_cond.ambient_condition[1][12] "ambient condition shot [0 .. 2-1] with 25 data bytes [0 .. 25-1] for the error code stored in this error memory slot" UBYTE EH_STANDARD_S5_S3 1 100 0 255 DISPLAY_IDENTIFIER ambient_condition[1][12].amb_cond.ydiMemory_xau16[14].ZFEH_EepromData ECU_ADDRESS 0xFFF82C35 /end MEASUREMENT
/begin MEASUREMENT ZFEH_EepromData.ydiMemory_xau16[14].amb_cond.ambient_condition[1][13] "ambient condition shot [0 .. 2-1] with 25 data bytes [0 .. 25-1] for the error code stored in this error memory slot" UBYTE EH_STANDARD_S5_S3 1 100 0 255 DISPLAY_IDENTIFIER ambient_condition[1][13].amb_cond.ydiMemory_xau16[14].ZFEH_EepromData ECU_ADDRESS 0xFFF82C36 /end MEASUREMENT
/begin MEASUREMENT ZFEH_EepromData.ydiMemory_xau16[14].amb_cond.ambient_condition[1][14] "ambient condition shot [0 .. 2-1] with 25 data bytes [0 .. 25-1] for the error code stored in this error memory slot" UBYTE EH_STANDARD_S5_S3 1 100 0 255 DISPLAY_IDENTIFIER ambient_condition[1][14].amb_cond.ydiMemory_xau16[14].ZFEH_EepromData ECU_ADDRESS 0xFFF82C37 /end MEASUREMENT
/begin MEASUREMENT ZFEH_EepromData.ydiMemory_xau16[14].amb_cond.ambient_condition[1][15] "ambient condition shot [0 .. 2-1] with 25 data bytes [0 .. 25-1] for the error code stored in this error memory slot" UBYTE EH_STANDARD_S5_S3 1 100 0 255 DISPLAY_IDENTIFIER ambient_condition[1][15].amb_cond.ydiMemory_xau16[14].ZFEH_EepromData ECU_ADDRESS 0xFFF82C38 /end MEASUREMENT
/begin MEASUREMENT ZFEH_EepromData.ydiMemory_xau16[14].amb_cond.ambient_condition[1][16] "ambient condition shot [0 .. 2-1] with 25 data bytes [0 .. 25-1] for the error code stored in this error memory slot" UBYTE EH_STANDARD_S5_S3 1 100 0 255 DISPLAY_IDENTIFIER ambient_condition[1][16].amb_cond.ydiMemory_xau16[14].ZFEH_EepromData ECU_ADDRESS 0xFFF82C39 /end MEASUREMENT
/begin MEASUREMENT ZFEH_EepromData.ydiMemory_xau16[14].amb_cond.ambient_condition[1][17] "ambient condition shot [0 .. 2-1] with 25 data bytes [0 .. 25-1] for the error code stored in this error memory slot" UBYTE EH_STANDARD_S5_S3 1 100 0 255 DISPLAY_IDENTIFIER ambient_condition[1][17].amb_cond.ydiMemory_xau16[14].ZFEH_EepromData ECU_ADDRESS 0xFFF82C3A /end MEASUREMENT
/begin MEASUREMENT ZFEH_EepromData.ydiMemory_xau16[14].amb_cond.ambient_condition[1][18] "ambient condition shot [0 .. 2-1] with 25 data bytes [0 .. 25-1] for the error code stored in this error memory slot" UBYTE EH_STANDARD_S5_S3 1 100 0 255 DISPLAY_IDENTIFIER ambient_condition[1][18].amb_cond.ydiMemory_xau16[14].ZFEH_EepromData ECU_ADDRESS 0xFFF82C3B /end MEASUREMENT
/begin MEASUREMENT ZFEH_EepromData.ydiMemory_xau16[14].amb_cond.ambient_condition[1][19] "ambient condition shot [0 .. 2-1] with 25 data bytes [0 .. 25-1] for the error code stored in this error memory slot" UBYTE EH_STANDARD_S5_S3 1 100 0 255 DISPLAY_IDENTIFIER ambient_condition[1][19].amb_cond.ydiMemory_xau16[14].ZFEH_EepromData ECU_ADDRESS 0xFFF82C3C /end MEASUREMENT
/begin MEASUREMENT ZFEH_EepromData.ydiMemory_xau16[14].amb_cond.ambient_condition[1][20] "ambient condition shot [0 .. 2-1] with 25 data bytes [0 .. 25-1] for the error code stored in this error memory slot" UBYTE EH_STANDARD_S5_S3 1 100 0 255 DISPLAY_IDENTIFIER ambient_condition[1][20].amb_cond.ydiMemory_xau16[14].ZFEH_EepromData ECU_ADDRESS 0xFFF82C3D /end MEASUREMENT
/begin MEASUREMENT ZFEH_EepromData.ydiMemory_xau16[14].amb_cond.ambient_condition[1][21] "ambient condition shot [0 .. 2-1] with 25 data bytes [0 .. 25-1] for the error code stored in this error memory slot" UBYTE EH_STANDARD_S5_S3 1 100 0 255 DISPLAY_IDENTIFIER ambient_condition[1][21].amb_cond.ydiMemory_xau16[14].ZFEH_EepromData ECU_ADDRESS 0xFFF82C3E /end MEASUREMENT
/begin MEASUREMENT ZFEH_EepromData.ydiMemory_xau16[14].amb_cond.ambient_condition[1][22] "ambient condition shot [0 .. 2-1] with 25 data bytes [0 .. 25-1] for the error code stored in this error memory slot" UBYTE EH_STANDARD_S5_S3 1 100 0 255 DISPLAY_IDENTIFIER ambient_condition[1][22].amb_cond.ydiMemory_xau16[14].ZFEH_EepromData ECU_ADDRESS 0xFFF82C3F /end MEASUREMENT
/begin MEASUREMENT ZFEH_EepromData.ydiMemory_xau16[14].amb_cond.ambient_condition[1][23] "ambient condition shot [0 .. 2-1] with 25 data bytes [0 .. 25-1] for the error code stored in this error memory slot" UBYTE EH_STANDARD_S5_S3 1 100 0 255 DISPLAY_IDENTIFIER ambient_condition[1][23].amb_cond.ydiMemory_xau16[14].ZFEH_EepromData ECU_ADDRESS 0xFFF82C40 /end MEASUREMENT
/begin MEASUREMENT ZFEH_EepromData.ydiMemory_xau16[14].amb_cond.ambient_condition[1][24] "ambient condition shot [0 .. 2-1] with 25 data bytes [0 .. 25-1] for the error code stored in this error memory slot" UBYTE EH_STANDARD_S5_S3 1 100 0 255 DISPLAY_IDENTIFIER ambient_condition[1][24].amb_cond.ydiMemory_xau16[14].ZFEH_EepromData ECU_ADDRESS 0xFFF82C41 /end MEASUREMENT
/begin MEASUREMENT ZFEH_EepromData.ydiMemory_xau16[14].amb_cond.status_of_ambient_conditions[0] "status of ambient condition shot x: 0=invalid 1=valid" UBYTE EH_STANDARD_S5_S3 1 100 0 1 DISPLAY_IDENTIFIER status_of_ambient_conditions[0].amb_cond.ydiMemory_xau16[14].ZFEH_EepromData ECU_ADDRESS 0xFFF82C42 /end MEASUREMENT
/begin MEASUREMENT ZFEH_EepromData.ydiMemory_xau16[14].amb_cond.status_of_ambient_conditions[1] "status of ambient condition shot x: 0=invalid 1=valid" UBYTE EH_STANDARD_S5_S3 1 100 0 1 DISPLAY_IDENTIFIER status_of_ambient_conditions[1].amb_cond.ydiMemory_xau16[14].ZFEH_EepromData ECU_ADDRESS 0xFFF82C43 /end MEASUREMENT
/begin MEASUREMENT ZFEH_EepromData.ydiMemory_xau16[14].error_code "error code stored in error memory slot" UWORD CONV_KFC_NAME 0 255 0 65535 DISPLAY_IDENTIFIER error_code.ydiMemory_xau16[14].ZFEH_EepromData ECU_ADDRESS 0xFFF82BFC /end MEASUREMENT
/begin MEASUREMENT ZFEH_EepromData.ydiMemory_xau16[14].error_type "error type of error code stored in error memory slot" UWORD EH_STANDARD_S5_S3 1 100 0 65535 DISPLAY_IDENTIFIER error_type.ydiMemory_xau16[14].ZFEH_EepromData ECU_ADDRESS 0xFFF82BFE /end MEASUREMENT
/begin MEASUREMENT ZFEH_EepromData.ydiMemory_xau16[14].status_word "status word of error code stored in error memory slot" UWORD EH_STANDARD_S5_S3 1 100 0 65535 DISPLAY_IDENTIFIER status_word.ydiMemory_xau16[14].ZFEH_EepromData ECU_ADDRESS 0xFFF82C00 /end MEASUREMENT
/begin MEASUREMENT ZFEH_EepromData.ydiMemory_xau16[14].frequency_counter "frequency counter of error code stored in error memory slot" UBYTE EH_STANDARD_S5_S3 1 100 0 255 DISPLAY_IDENTIFIER frequency_counter.ydiMemory_xau16[14].ZFEH_EepromData ECU_ADDRESS 0xFFF82C02 /end MEASUREMENT
/begin MEASUREMENT ZFEH_EepromData.ydiMemory_xau16[14].backwards_counter "backwards counter of error code stored in error memory slot" UBYTE EH_STANDARD_S5_S3 1 100 0 255 DISPLAY_IDENTIFIER backwards_counter.ydiMemory_xau16[14].ZFEH_EepromData ECU_ADDRESS 0xFFF82C03 /end MEASUREMENT
/begin MEASUREMENT ZFEH_EepromData.ydiMemory_xau16[14].permanent_counter "counter of permanent error codes stored in error memory slot" UBYTE EH_STANDARD_S5_S3 1 100 0 255 DISPLAY_IDENTIFIER permanent_counter.ydiMemory_xau16[14].ZFEH_EepromData ECU_ADDRESS 0xFFF82C04 /end MEASUREMENT
/begin MEASUREMENT ZFEH_EepromData.ydiMemory_xau16[14].sequence_counter "sequence counter of error code stored in error memory slot" UBYTE EH_STANDARD_S5_S3 1 100 0 255 DISPLAY_IDENTIFIER sequence_counter.ydiMemory_xau16[14].ZFEH_EepromData ECU_ADDRESS 0xFFF82C05 /end MEASUREMENT
/begin MEASUREMENT ZFEH_EepromData.ydiMemory_xau16[14].master_time "master time of error code stored in error memory slot" ULONG EH_STANDARD_S5_S3 1 100 0 4294967295 DISPLAY_IDENTIFIER master_time.ydiMemory_xau16[14].ZFEH_EepromData ECU_ADDRESS 0xFFF82C08 /end MEASUREMENT
/begin MEASUREMENT ZFEH_EepromData.ydiMemory_xau16[14].condition_byte "condition byte of error code stored in error memory slot" UBYTE EH_STANDARD_S5_S3 1 100 0 255 DISPLAY_IDENTIFIER condition_byte.ydiMemory_xau16[14].ZFEH_EepromData ECU_ADDRESS 0xFFF82C0D /end MEASUREMENT
/begin MEASUREMENT ZFEH_EepromData.ydiMemory_xau16[14].obd_driving_cycle_counter "obd driving cycle counter of error code stored in error memory slot" UWORD EH_STANDARD_S5_S3 1 100 0 65535 DISPLAY_IDENTIFIER obd_driving_cycle_counter.ydiMemory_xau16[14].ZFEH_EepromData ECU_ADDRESS 0xFFF82C0E /end MEASUREMENT
/begin MEASUREMENT ZFEH_EepromData.ydiMemory_xau16[15].amb_cond.ambient_condition[0][0] "ambient condition shot [0 .. 2-1] with 25 data bytes [0 .. 25-1] for the error code stored in this error memory slot" UBYTE EH_STANDARD_S5_S3 1 100 0 255 DISPLAY_IDENTIFIER ambient_condition[0][0].amb_cond.ydiMemory_xau16[15].ZFEH_EepromData ECU_ADDRESS 0xFFF82C58 /end MEASUREMENT
/begin MEASUREMENT ZFEH_EepromData.ydiMemory_xau16[15].amb_cond.ambient_condition[0][1] "ambient condition shot [0 .. 2-1] with 25 data bytes [0 .. 25-1] for the error code stored in this error memory slot" UBYTE EH_STANDARD_S5_S3 1 100 0 255 DISPLAY_IDENTIFIER ambient_condition[0][1].amb_cond.ydiMemory_xau16[15].ZFEH_EepromData ECU_ADDRESS 0xFFF82C59 /end MEASUREMENT
/begin MEASUREMENT ZFEH_EepromData.ydiMemory_xau16[15].amb_cond.ambient_condition[0][2] "ambient condition shot [0 .. 2-1] with 25 data bytes [0 .. 25-1] for the error code stored in this error memory slot" UBYTE EH_STANDARD_S5_S3 1 100 0 255 DISPLAY_IDENTIFIER ambient_condition[0][2].amb_cond.ydiMemory_xau16[15].ZFEH_EepromData ECU_ADDRESS 0xFFF82C5A /end MEASUREMENT
/begin MEASUREMENT ZFEH_EepromData.ydiMemory_xau16[15].amb_cond.ambient_condition[0][3] "ambient condition shot [0 .. 2-1] with 25 data bytes [0 .. 25-1] for the error code stored in this error memory slot" UBYTE EH_STANDARD_S5_S3 1 100 0 255 DISPLAY_IDENTIFIER ambient_condition[0][3].amb_cond.ydiMemory_xau16[15].ZFEH_EepromData ECU_ADDRESS 0xFFF82C5B /end MEASUREMENT
/begin MEASUREMENT ZFEH_EepromData.ydiMemory_xau16[15].amb_cond.ambient_condition[0][4] "ambient condition shot [0 .. 2-1] with 25 data bytes [0 .. 25-1] for the error code stored in this error memory slot" UBYTE EH_STANDARD_S5_S3 1 100 0 255 DISPLAY_IDENTIFIER ambient_condition[0][4].amb_cond.ydiMemory_xau16[15].ZFEH_EepromData ECU_ADDRESS 0xFFF82C5C /end MEASUREMENT
/begin MEASUREMENT ZFEH_EepromData.ydiMemory_xau16[15].amb_cond.ambient_condition[0][5] "ambient condition shot [0 .. 2-1] with 25 data bytes [0 .. 25-1] for the error code stored in this error memory slot" UBYTE EH_STANDARD_S5_S3 1 100 0 255 DISPLAY_IDENTIFIER ambient_condition[0][5].amb_cond.ydiMemory_xau16[15].ZFEH_EepromData ECU_ADDRESS 0xFFF82C5D /end MEASUREMENT
/begin MEASUREMENT ZFEH_EepromData.ydiMemory_xau16[15].amb_cond.ambient_condition[0][6] "ambient condition shot [0 .. 2-1] with 25 data bytes [0 .. 25-1] for the error code stored in this error memory slot" UBYTE EH_STANDARD_S5_S3 1 100 0 255 DISPLAY_IDENTIFIER ambient_condition[0][6].amb_cond.ydiMemory_xau16[15].ZFEH_EepromData ECU_ADDRESS 0xFFF82C5E /end MEASUREMENT
/begin MEASUREMENT ZFEH_EepromData.ydiMemory_xau16[15].amb_cond.ambient_condition[0][7] "ambient condition shot [0 .. 2-1] with 25 data bytes [0 .. 25-1] for the error code stored in this error memory slot" UBYTE EH_STANDARD_S5_S3 1 100 0 255 DISPLAY_IDENTIFIER ambient_condition[0][7].amb_cond.ydiMemory_xau16[15].ZFEH_EepromData ECU_ADDRESS 0xFFF82C5F /end MEASUREMENT
/begin MEASUREMENT ZFEH_EepromData.ydiMemory_xau16[15].amb_cond.ambient_condition[0][8] "ambient condition shot [0 .. 2-1] with 25 data bytes [0 .. 25-1] for the error code stored in this error memory slot" UBYTE EH_STANDARD_S5_S3 1 100 0 255 DISPLAY_IDENTIFIER ambient_condition[0][8].amb_cond.ydiMemory_xau16[15].ZFEH_EepromData ECU_ADDRESS 0xFFF82C60 /end MEASUREMENT
/begin MEASUREMENT ZFEH_EepromData.ydiMemory_xau16[15].amb_cond.ambient_condition[0][9] "ambient condition shot [0 .. 2-1] with 25 data bytes [0 .. 25-1] for the error code stored in this error memory slot" UBYTE EH_STANDARD_S5_S3 1 100 0 255 DISPLAY_IDENTIFIER ambient_condition[0][9].amb_cond.ydiMemory_xau16[15].ZFEH_EepromData ECU_ADDRESS 0xFFF82C61 /end MEASUREMENT
/begin MEASUREMENT ZFEH_EepromData.ydiMemory_xau16[15].amb_cond.ambient_condition[0][10] "ambient condition shot [0 .. 2-1] with 25 data bytes [0 .. 25-1] for the error code stored in this error memory slot" UBYTE EH_STANDARD_S5_S3 1 100 0 255 DISPLAY_IDENTIFIER ambient_condition[0][10].amb_cond.ydiMemory_xau16[15].ZFEH_EepromData ECU_ADDRESS 0xFFF82C62 /end MEASUREMENT
/begin MEASUREMENT ZFEH_EepromData.ydiMemory_xau16[15].amb_cond.ambient_condition[0][11] "ambient condition shot [0 .. 2-1] with 25 data bytes [0 .. 25-1] for the error code stored in this error memory slot" UBYTE EH_STANDARD_S5_S3 1 100 0 255 DISPLAY_IDENTIFIER ambient_condition[0][11].amb_cond.ydiMemory_xau16[15].ZFEH_EepromData ECU_ADDRESS 0xFFF82C63 /end MEASUREMENT
/begin MEASUREMENT ZFEH_EepromData.ydiMemory_xau16[15].amb_cond.ambient_condition[0][12] "ambient condition shot [0 .. 2-1] with 25 data bytes [0 .. 25-1] for the error code stored in this error memory slot" UBYTE EH_STANDARD_S5_S3 1 100 0 255 DISPLAY_IDENTIFIER ambient_condition[0][12].amb_cond.ydiMemory_xau16[15].ZFEH_EepromData ECU_ADDRESS 0xFFF82C64 /end MEASUREMENT
/begin MEASUREMENT ZFEH_EepromData.ydiMemory_xau16[15].amb_cond.ambient_condition[0][13] "ambient condition shot [0 .. 2-1] with 25 data bytes [0 .. 25-1] for the error code stored in this error memory slot" UBYTE EH_STANDARD_S5_S3 1 100 0 255 DISPLAY_IDENTIFIER ambient_condition[0][13].amb_cond.ydiMemory_xau16[15].ZFEH_EepromData ECU_ADDRESS 0xFFF82C65 /end MEASUREMENT
/begin MEASUREMENT ZFEH_EepromData.ydiMemory_xau16[15].amb_cond.ambient_condition[0][14] "ambient condition shot [0 .. 2-1] with 25 data bytes [0 .. 25-1] for the error code stored in this error memory slot" UBYTE EH_STANDARD_S5_S3 1 100 0 255 DISPLAY_IDENTIFIER ambient_condition[0][14].amb_cond.ydiMemory_xau16[15].ZFEH_EepromData ECU_ADDRESS 0xFFF82C66 /end MEASUREMENT
/begin MEASUREMENT ZFEH_EepromData.ydiMemory_xau16[15].amb_cond.ambient_condition[0][15] "ambient condition shot [0 .. 2-1] with 25 data bytes [0 .. 25-1] for the error code stored in this error memory slot" UBYTE EH_STANDARD_S5_S3 1 100 0 255 DISPLAY_IDENTIFIER ambient_condition[0][15].amb_cond.ydiMemory_xau16[15].ZFEH_EepromData ECU_ADDRESS 0xFFF82C67 /end MEASUREMENT
/begin MEASUREMENT ZFEH_EepromData.ydiMemory_xau16[15].amb_cond.ambient_condition[0][16] "ambient condition shot [0 .. 2-1] with 25 data bytes [0 .. 25-1] for the error code stored in this error memory slot" UBYTE EH_STANDARD_S5_S3 1 100 0 255 DISPLAY_IDENTIFIER ambient_condition[0][16].amb_cond.ydiMemory_xau16[15].ZFEH_EepromData ECU_ADDRESS 0xFFF82C68 /end MEASUREMENT
/begin MEASUREMENT ZFEH_EepromData.ydiMemory_xau16[15].amb_cond.ambient_condition[0][17] "ambient condition shot [0 .. 2-1] with 25 data bytes [0 .. 25-1] for the error code stored in this error memory slot" UBYTE EH_STANDARD_S5_S3 1 100 0 255 DISPLAY_IDENTIFIER ambient_condition[0][17].amb_cond.ydiMemory_xau16[15].ZFEH_EepromData ECU_ADDRESS 0xFFF82C69 /end MEASUREMENT
/begin MEASUREMENT ZFEH_EepromData.ydiMemory_xau16[15].amb_cond.ambient_condition[0][18] "ambient condition shot [0 .. 2-1] with 25 data bytes [0 .. 25-1] for the error code stored in this error memory slot" UBYTE EH_STANDARD_S5_S3 1 100 0 255 DISPLAY_IDENTIFIER ambient_condition[0][18].amb_cond.ydiMemory_xau16[15].ZFEH_EepromData ECU_ADDRESS 0xFFF82C6A /end MEASUREMENT
/begin MEASUREMENT ZFEH_EepromData.ydiMemory_xau16[15].amb_cond.ambient_condition[0][19] "ambient condition shot [0 .. 2-1] with 25 data bytes [0 .. 25-1] for the error code stored in this error memory slot" UBYTE EH_STANDARD_S5_S3 1 100 0 255 DISPLAY_IDENTIFIER ambient_condition[0][19].amb_cond.ydiMemory_xau16[15].ZFEH_EepromData ECU_ADDRESS 0xFFF82C6B /end MEASUREMENT
/begin MEASUREMENT ZFEH_EepromData.ydiMemory_xau16[15].amb_cond.ambient_condition[0][20] "ambient condition shot [0 .. 2-1] with 25 data bytes [0 .. 25-1] for the error code stored in this error memory slot" UBYTE EH_STANDARD_S5_S3 1 100 0 255 DISPLAY_IDENTIFIER ambient_condition[0][20].amb_cond.ydiMemory_xau16[15].ZFEH_EepromData ECU_ADDRESS 0xFFF82C6C /end MEASUREMENT
/begin MEASUREMENT ZFEH_EepromData.ydiMemory_xau16[15].amb_cond.ambient_condition[0][21] "ambient condition shot [0 .. 2-1] with 25 data bytes [0 .. 25-1] for the error code stored in this error memory slot" UBYTE EH_STANDARD_S5_S3 1 100 0 255 DISPLAY_IDENTIFIER ambient_condition[0][21].amb_cond.ydiMemory_xau16[15].ZFEH_EepromData ECU_ADDRESS 0xFFF82C6D /end MEASUREMENT
/begin MEASUREMENT ZFEH_EepromData.ydiMemory_xau16[15].amb_cond.ambient_condition[0][22] "ambient condition shot [0 .. 2-1] with 25 data bytes [0 .. 25-1] for the error code stored in this error memory slot" UBYTE EH_STANDARD_S5_S3 1 100 0 255 DISPLAY_IDENTIFIER ambient_condition[0][22].amb_cond.ydiMemory_xau16[15].ZFEH_EepromData ECU_ADDRESS 0xFFF82C6E /end MEASUREMENT
/begin MEASUREMENT ZFEH_EepromData.ydiMemory_xau16[15].amb_cond.ambient_condition[0][23] "ambient condition shot [0 .. 2-1] with 25 data bytes [0 .. 25-1] for the error code stored in this error memory slot" UBYTE EH_STANDARD_S5_S3 1 100 0 255 DISPLAY_IDENTIFIER ambient_condition[0][23].amb_cond.ydiMemory_xau16[15].ZFEH_EepromData ECU_ADDRESS 0xFFF82C6F /end MEASUREMENT
/begin MEASUREMENT ZFEH_EepromData.ydiMemory_xau16[15].amb_cond.ambient_condition[0][24] "ambient condition shot [0 .. 2-1] with 25 data bytes [0 .. 25-1] for the error code stored in this error memory slot" UBYTE EH_STANDARD_S5_S3 1 100 0 255 DISPLAY_IDENTIFIER ambient_condition[0][24].amb_cond.ydiMemory_xau16[15].ZFEH_EepromData ECU_ADDRESS 0xFFF82C70 /end MEASUREMENT
/begin MEASUREMENT ZFEH_EepromData.ydiMemory_xau16[15].amb_cond.ambient_condition[1][0] "ambient condition shot [0 .. 2-1] with 25 data bytes [0 .. 25-1] for the error code stored in this error memory slot" UBYTE EH_STANDARD_S5_S3 1 100 0 255 DISPLAY_IDENTIFIER ambient_condition[1][0].amb_cond.ydiMemory_xau16[15].ZFEH_EepromData ECU_ADDRESS 0xFFF82C71 /end MEASUREMENT
/begin MEASUREMENT ZFEH_EepromData.ydiMemory_xau16[15].amb_cond.ambient_condition[1][1] "ambient condition shot [0 .. 2-1] with 25 data bytes [0 .. 25-1] for the error code stored in this error memory slot" UBYTE EH_STANDARD_S5_S3 1 100 0 255 DISPLAY_IDENTIFIER ambient_condition[1][1].amb_cond.ydiMemory_xau16[15].ZFEH_EepromData ECU_ADDRESS 0xFFF82C72 /end MEASUREMENT
/begin MEASUREMENT ZFEH_EepromData.ydiMemory_xau16[15].amb_cond.ambient_condition[1][2] "ambient condition shot [0 .. 2-1] with 25 data bytes [0 .. 25-1] for the error code stored in this error memory slot" UBYTE EH_STANDARD_S5_S3 1 100 0 255 DISPLAY_IDENTIFIER ambient_condition[1][2].amb_cond.ydiMemory_xau16[15].ZFEH_EepromData ECU_ADDRESS 0xFFF82C73 /end MEASUREMENT
/begin MEASUREMENT ZFEH_EepromData.ydiMemory_xau16[15].amb_cond.ambient_condition[1][3] "ambient condition shot [0 .. 2-1] with 25 data bytes [0 .. 25-1] for the error code stored in this error memory slot" UBYTE EH_STANDARD_S5_S3 1 100 0 255 DISPLAY_IDENTIFIER ambient_condition[1][3].amb_cond.ydiMemory_xau16[15].ZFEH_EepromData ECU_ADDRESS 0xFFF82C74 /end MEASUREMENT
/begin MEASUREMENT ZFEH_EepromData.ydiMemory_xau16[15].amb_cond.ambient_condition[1][4] "ambient condition shot [0 .. 2-1] with 25 data bytes [0 .. 25-1] for the error code stored in this error memory slot" UBYTE EH_STANDARD_S5_S3 1 100 0 255 DISPLAY_IDENTIFIER ambient_condition[1][4].amb_cond.ydiMemory_xau16[15].ZFEH_EepromData ECU_ADDRESS 0xFFF82C75 /end MEASUREMENT
/begin MEASUREMENT ZFEH_EepromData.ydiMemory_xau16[15].amb_cond.ambient_condition[1][5] "ambient condition shot [0 .. 2-1] with 25 data bytes [0 .. 25-1] for the error code stored in this error memory slot" UBYTE EH_STANDARD_S5_S3 1 100 0 255 DISPLAY_IDENTIFIER ambient_condition[1][5].amb_cond.ydiMemory_xau16[15].ZFEH_EepromData ECU_ADDRESS 0xFFF82C76 /end MEASUREMENT
/begin MEASUREMENT ZFEH_EepromData.ydiMemory_xau16[15].amb_cond.ambient_condition[1][6] "ambient condition shot [0 .. 2-1] with 25 data bytes [0 .. 25-1] for the error code stored in this error memory slot" UBYTE EH_STANDARD_S5_S3 1 100 0 255 DISPLAY_IDENTIFIER ambient_condition[1][6].amb_cond.ydiMemory_xau16[15].ZFEH_EepromData ECU_ADDRESS 0xFFF82C77 /end MEASUREMENT
/begin MEASUREMENT ZFEH_EepromData.ydiMemory_xau16[15].amb_cond.ambient_condition[1][7] "ambient condition shot [0 .. 2-1] with 25 data bytes [0 .. 25-1] for the error code stored in this error memory slot" UBYTE EH_STANDARD_S5_S3 1 100 0 255 DISPLAY_IDENTIFIER ambient_condition[1][7].amb_cond.ydiMemory_xau16[15].ZFEH_EepromData ECU_ADDRESS 0xFFF82C78 /end MEASUREMENT
/begin MEASUREMENT ZFEH_EepromData.ydiMemory_xau16[15].amb_cond.ambient_condition[1][8] "ambient condition shot [0 .. 2-1] with 25 data bytes [0 .. 25-1] for the error code stored in this error memory slot" UBYTE EH_STANDARD_S5_S3 1 100 0 255 DISPLAY_IDENTIFIER ambient_condition[1][8].amb_cond.ydiMemory_xau16[15].ZFEH_EepromData ECU_ADDRESS 0xFFF82C79 /end MEASUREMENT
/begin MEASUREMENT ZFEH_EepromData.ydiMemory_xau16[15].amb_cond.ambient_condition[1][9] "ambient condition shot [0 .. 2-1] with 25 data bytes [0 .. 25-1] for the error code stored in this error memory slot" UBYTE EH_STANDARD_S5_S3 1 100 0 255 DISPLAY_IDENTIFIER ambient_condition[1][9].amb_cond.ydiMemory_xau16[15].ZFEH_EepromData ECU_ADDRESS 0xFFF82C7A /end MEASUREMENT
/begin MEASUREMENT ZFEH_EepromData.ydiMemory_xau16[15].amb_cond.ambient_condition[1][10] "ambient condition shot [0 .. 2-1] with 25 data bytes [0 .. 25-1] for the error code stored in this error memory slot" UBYTE EH_STANDARD_S5_S3 1 100 0 255 DISPLAY_IDENTIFIER ambient_condition[1][10].amb_cond.ydiMemory_xau16[15].ZFEH_EepromData ECU_ADDRESS 0xFFF82C7B /end MEASUREMENT
/begin MEASUREMENT ZFEH_EepromData.ydiMemory_xau16[15].amb_cond.ambient_condition[1][11] "ambient condition shot [0 .. 2-1] with 25 data bytes [0 .. 25-1] for the error code stored in this error memory slot" UBYTE EH_STANDARD_S5_S3 1 100 0 255 DISPLAY_IDENTIFIER ambient_condition[1][11].amb_cond.ydiMemory_xau16[15].ZFEH_EepromData ECU_ADDRESS 0xFFF82C7C /end MEASUREMENT
/begin MEASUREMENT ZFEH_EepromData.ydiMemory_xau16[15].amb_cond.ambient_condition[1][12] "ambient condition shot [0 .. 2-1] with 25 data bytes [0 .. 25-1] for the error code stored in this error memory slot" UBYTE EH_STANDARD_S5_S3 1 100 0 255 DISPLAY_IDENTIFIER ambient_condition[1][12].amb_cond.ydiMemory_xau16[15].ZFEH_EepromData ECU_ADDRESS 0xFFF82C7D /end MEASUREMENT
/begin MEASUREMENT ZFEH_EepromData.ydiMemory_xau16[15].amb_cond.ambient_condition[1][13] "ambient condition shot [0 .. 2-1] with 25 data bytes [0 .. 25-1] for the error code stored in this error memory slot" UBYTE EH_STANDARD_S5_S3 1 100 0 255 DISPLAY_IDENTIFIER ambient_condition[1][13].amb_cond.ydiMemory_xau16[15].ZFEH_EepromData ECU_ADDRESS 0xFFF82C7E /end MEASUREMENT
/begin MEASUREMENT ZFEH_EepromData.ydiMemory_xau16[15].amb_cond.ambient_condition[1][14] "ambient condition shot [0 .. 2-1] with 25 data bytes [0 .. 25-1] for the error code stored in this error memory slot" UBYTE EH_STANDARD_S5_S3 1 100 0 255 DISPLAY_IDENTIFIER ambient_condition[1][14].amb_cond.ydiMemory_xau16[15].ZFEH_EepromData ECU_ADDRESS 0xFFF82C7F /end MEASUREMENT
/begin MEASUREMENT ZFEH_EepromData.ydiMemory_xau16[15].amb_cond.ambient_condition[1][15] "ambient condition shot [0 .. 2-1] with 25 data bytes [0 .. 25-1] for the error code stored in this error memory slot" UBYTE EH_STANDARD_S5_S3 1 100 0 255 DISPLAY_IDENTIFIER ambient_condition[1][15].amb_cond.ydiMemory_xau16[15].ZFEH_EepromData ECU_ADDRESS 0xFFF82C80 /end MEASUREMENT
/begin MEASUREMENT ZFEH_EepromData.ydiMemory_xau16[15].amb_cond.ambient_condition[1][16] "ambient condition shot [0 .. 2-1] with 25 data bytes [0 .. 25-1] for the error code stored in this error memory slot" UBYTE EH_STANDARD_S5_S3 1 100 0 255 DISPLAY_IDENTIFIER ambient_condition[1][16].amb_cond.ydiMemory_xau16[15].ZFEH_EepromData ECU_ADDRESS 0xFFF82C81 /end MEASUREMENT
/begin MEASUREMENT ZFEH_EepromData.ydiMemory_xau16[15].amb_cond.ambient_condition[1][17] "ambient condition shot [0 .. 2-1] with 25 data bytes [0 .. 25-1] for the error code stored in this error memory slot" UBYTE EH_STANDARD_S5_S3 1 100 0 255 DISPLAY_IDENTIFIER ambient_condition[1][17].amb_cond.ydiMemory_xau16[15].ZFEH_EepromData ECU_ADDRESS 0xFFF82C82 /end MEASUREMENT
/begin MEASUREMENT ZFEH_EepromData.ydiMemory_xau16[15].amb_cond.ambient_condition[1][18] "ambient condition shot [0 .. 2-1] with 25 data bytes [0 .. 25-1] for the error code stored in this error memory slot" UBYTE EH_STANDARD_S5_S3 1 100 0 255 DISPLAY_IDENTIFIER ambient_condition[1][18].amb_cond.ydiMemory_xau16[15].ZFEH_EepromData ECU_ADDRESS 0xFFF82C83 /end MEASUREMENT
/begin MEASUREMENT ZFEH_EepromData.ydiMemory_xau16[15].amb_cond.ambient_condition[1][19] "ambient condition shot [0 .. 2-1] with 25 data bytes [0 .. 25-1] for the error code stored in this error memory slot" UBYTE EH_STANDARD_S5_S3 1 100 0 255 DISPLAY_IDENTIFIER ambient_condition[1][19].amb_cond.ydiMemory_xau16[15].ZFEH_EepromData ECU_ADDRESS 0xFFF82C84 /end MEASUREMENT
/begin MEASUREMENT ZFEH_EepromData.ydiMemory_xau16[15].amb_cond.ambient_condition[1][20] "ambient condition shot [0 .. 2-1] with 25 data bytes [0 .. 25-1] for the error code stored in this error memory slot" UBYTE EH_STANDARD_S5_S3 1 100 0 255 DISPLAY_IDENTIFIER ambient_condition[1][20].amb_cond.ydiMemory_xau16[15].ZFEH_EepromData ECU_ADDRESS 0xFFF82C85 /end MEASUREMENT
/begin MEASUREMENT ZFEH_EepromData.ydiMemory_xau16[15].amb_cond.ambient_condition[1][21] "ambient condition shot [0 .. 2-1] with 25 data bytes [0 .. 25-1] for the error code stored in this error memory slot" UBYTE EH_STANDARD_S5_S3 1 100 0 255 DISPLAY_IDENTIFIER ambient_condition[1][21].amb_cond.ydiMemory_xau16[15].ZFEH_EepromData ECU_ADDRESS 0xFFF82C86 /end MEASUREMENT
/begin MEASUREMENT ZFEH_EepromData.ydiMemory_xau16[15].amb_cond.ambient_condition[1][22] "ambient condition shot [0 .. 2-1] with 25 data bytes [0 .. 25-1] for the error code stored in this error memory slot" UBYTE EH_STANDARD_S5_S3 1 100 0 255 DISPLAY_IDENTIFIER ambient_condition[1][22].amb_cond.ydiMemory_xau16[15].ZFEH_EepromData ECU_ADDRESS 0xFFF82C87 /end MEASUREMENT
/begin MEASUREMENT ZFEH_EepromData.ydiMemory_xau16[15].amb_cond.ambient_condition[1][23] "ambient condition shot [0 .. 2-1] with 25 data bytes [0 .. 25-1] for the error code stored in this error memory slot" UBYTE EH_STANDARD_S5_S3 1 100 0 255 DISPLAY_IDENTIFIER ambient_condition[1][23].amb_cond.ydiMemory_xau16[15].ZFEH_EepromData ECU_ADDRESS 0xFFF82C88 /end MEASUREMENT
/begin MEASUREMENT ZFEH_EepromData.ydiMemory_xau16[15].amb_cond.ambient_condition[1][24] "ambient condition shot [0 .. 2-1] with 25 data bytes [0 .. 25-1] for the error code stored in this error memory slot" UBYTE EH_STANDARD_S5_S3 1 100 0 255 DISPLAY_IDENTIFIER ambient_condition[1][24].amb_cond.ydiMemory_xau16[15].ZFEH_EepromData ECU_ADDRESS 0xFFF82C89 /end MEASUREMENT
/begin MEASUREMENT ZFEH_EepromData.ydiMemory_xau16[15].amb_cond.status_of_ambient_conditions[0] "status of ambient condition shot x: 0=invalid 1=valid" UBYTE EH_STANDARD_S5_S3 1 100 0 1 DISPLAY_IDENTIFIER status_of_ambient_conditions[0].amb_cond.ydiMemory_xau16[15].ZFEH_EepromData ECU_ADDRESS 0xFFF82C8A /end MEASUREMENT
/begin MEASUREMENT ZFEH_EepromData.ydiMemory_xau16[15].amb_cond.status_of_ambient_conditions[1] "status of ambient condition shot x: 0=invalid 1=valid" UBYTE EH_STANDARD_S5_S3 1 100 0 1 DISPLAY_IDENTIFIER status_of_ambient_conditions[1].amb_cond.ydiMemory_xau16[15].ZFEH_EepromData ECU_ADDRESS 0xFFF82C8B /end MEASUREMENT
/begin MEASUREMENT ZFEH_EepromData.ydiMemory_xau16[15].error_code "error code stored in error memory slot" UWORD CONV_KFC_NAME 0 255 0 65535 DISPLAY_IDENTIFIER error_code.ydiMemory_xau16[15].ZFEH_EepromData ECU_ADDRESS 0xFFF82C44 /end MEASUREMENT
/begin MEASUREMENT ZFEH_EepromData.ydiMemory_xau16[15].error_type "error type of error code stored in error memory slot" UWORD EH_STANDARD_S5_S3 1 100 0 65535 DISPLAY_IDENTIFIER error_type.ydiMemory_xau16[15].ZFEH_EepromData ECU_ADDRESS 0xFFF82C46 /end MEASUREMENT
/begin MEASUREMENT ZFEH_EepromData.ydiMemory_xau16[15].status_word "status word of error code stored in error memory slot" UWORD EH_STANDARD_S5_S3 1 100 0 65535 DISPLAY_IDENTIFIER status_word.ydiMemory_xau16[15].ZFEH_EepromData ECU_ADDRESS 0xFFF82C48 /end MEASUREMENT
/begin MEASUREMENT ZFEH_EepromData.ydiMemory_xau16[15].frequency_counter "frequency counter of error code stored in error memory slot" UBYTE EH_STANDARD_S5_S3 1 100 0 255 DISPLAY_IDENTIFIER frequency_counter.ydiMemory_xau16[15].ZFEH_EepromData ECU_ADDRESS 0xFFF82C4A /end MEASUREMENT
/begin MEASUREMENT ZFEH_EepromData.ydiMemory_xau16[15].backwards_counter "backwards counter of error code stored in error memory slot" UBYTE EH_STANDARD_S5_S3 1 100 0 255 DISPLAY_IDENTIFIER backwards_counter.ydiMemory_xau16[15].ZFEH_EepromData ECU_ADDRESS 0xFFF82C4B /end MEASUREMENT
/begin MEASUREMENT ZFEH_EepromData.ydiMemory_xau16[15].permanent_counter "counter of permanent error codes stored in error memory slot" UBYTE EH_STANDARD_S5_S3 1 100 0 255 DISPLAY_IDENTIFIER permanent_counter.ydiMemory_xau16[15].ZFEH_EepromData ECU_ADDRESS 0xFFF82C4C /end MEASUREMENT
/begin MEASUREMENT ZFEH_EepromData.ydiMemory_xau16[15].sequence_counter "sequence counter of error code stored in error memory slot" UBYTE EH_STANDARD_S5_S3 1 100 0 255 DISPLAY_IDENTIFIER sequence_counter.ydiMemory_xau16[15].ZFEH_EepromData ECU_ADDRESS 0xFFF82C4D /end MEASUREMENT
/begin MEASUREMENT ZFEH_EepromData.ydiMemory_xau16[15].master_time "master time of error code stored in error memory slot" ULONG EH_STANDARD_S5_S3 1 100 0 4294967295 DISPLAY_IDENTIFIER master_time.ydiMemory_xau16[15].ZFEH_EepromData ECU_ADDRESS 0xFFF82C50 /end MEASUREMENT
/begin MEASUREMENT ZFEH_EepromData.ydiMemory_xau16[15].condition_byte "condition byte of error code stored in error memory slot" UBYTE EH_STANDARD_S5_S3 1 100 0 255 DISPLAY_IDENTIFIER condition_byte.ydiMemory_xau16[15].ZFEH_EepromData ECU_ADDRESS 0xFFF82C55 /end MEASUREMENT
/begin MEASUREMENT ZFEH_EepromData.ydiMemory_xau16[15].obd_driving_cycle_counter "obd driving cycle counter of error code stored in error memory slot" UWORD EH_STANDARD_S5_S3 1 100 0 65535 DISPLAY_IDENTIFIER obd_driving_cycle_counter.ydiMemory_xau16[15].ZFEH_EepromData ECU_ADDRESS 0xFFF82C56 /end MEASUREMENT
/begin MEASUREMENT ZFEH_EepromData.ydiMemory_xau16[16].amb_cond.ambient_condition[0][0] "ambient condition shot [0 .. 2-1] with 25 data bytes [0 .. 25-1] for the error code stored in this error memory slot" UBYTE EH_STANDARD_S5_S3 1 100 0 255 DISPLAY_IDENTIFIER ambient_condition[0][0].amb_cond.ydiMemory_xau16[16].ZFEH_EepromData ECU_ADDRESS 0xFFF82CA0 /end MEASUREMENT
/begin MEASUREMENT ZFEH_EepromData.ydiMemory_xau16[16].amb_cond.ambient_condition[0][1] "ambient condition shot [0 .. 2-1] with 25 data bytes [0 .. 25-1] for the error code stored in this error memory slot" UBYTE EH_STANDARD_S5_S3 1 100 0 255 DISPLAY_IDENTIFIER ambient_condition[0][1].amb_cond.ydiMemory_xau16[16].ZFEH_EepromData ECU_ADDRESS 0xFFF82CA1 /end MEASUREMENT
/begin MEASUREMENT ZFEH_EepromData.ydiMemory_xau16[16].amb_cond.ambient_condition[0][2] "ambient condition shot [0 .. 2-1] with 25 data bytes [0 .. 25-1] for the error code stored in this error memory slot" UBYTE EH_STANDARD_S5_S3 1 100 0 255 DISPLAY_IDENTIFIER ambient_condition[0][2].amb_cond.ydiMemory_xau16[16].ZFEH_EepromData ECU_ADDRESS 0xFFF82CA2 /end MEASUREMENT
/begin MEASUREMENT ZFEH_EepromData.ydiMemory_xau16[16].amb_cond.ambient_condition[0][3] "ambient condition shot [0 .. 2-1] with 25 data bytes [0 .. 25-1] for the error code stored in this error memory slot" UBYTE EH_STANDARD_S5_S3 1 100 0 255 DISPLAY_IDENTIFIER ambient_condition[0][3].amb_cond.ydiMemory_xau16[16].ZFEH_EepromData ECU_ADDRESS 0xFFF82CA3 /end MEASUREMENT
/begin MEASUREMENT ZFEH_EepromData.ydiMemory_xau16[16].amb_cond.ambient_condition[0][4] "ambient condition shot [0 .. 2-1] with 25 data bytes [0 .. 25-1] for the error code stored in this error memory slot" UBYTE EH_STANDARD_S5_S3 1 100 0 255 DISPLAY_IDENTIFIER ambient_condition[0][4].amb_cond.ydiMemory_xau16[16].ZFEH_EepromData ECU_ADDRESS 0xFFF82CA4 /end MEASUREMENT
/begin MEASUREMENT ZFEH_EepromData.ydiMemory_xau16[16].amb_cond.ambient_condition[0][5] "ambient condition shot [0 .. 2-1] with 25 data bytes [0 .. 25-1] for the error code stored in this error memory slot" UBYTE EH_STANDARD_S5_S3 1 100 0 255 DISPLAY_IDENTIFIER ambient_condition[0][5].amb_cond.ydiMemory_xau16[16].ZFEH_EepromData ECU_ADDRESS 0xFFF82CA5 /end MEASUREMENT
/begin MEASUREMENT ZFEH_EepromData.ydiMemory_xau16[16].amb_cond.ambient_condition[0][6] "ambient condition shot [0 .. 2-1] with 25 data bytes [0 .. 25-1] for the error code stored in this error memory slot" UBYTE EH_STANDARD_S5_S3 1 100 0 255 DISPLAY_IDENTIFIER ambient_condition[0][6].amb_cond.ydiMemory_xau16[16].ZFEH_EepromData ECU_ADDRESS 0xFFF82CA6 /end MEASUREMENT
/begin MEASUREMENT ZFEH_EepromData.ydiMemory_xau16[16].amb_cond.ambient_condition[0][7] "ambient condition shot [0 .. 2-1] with 25 data bytes [0 .. 25-1] for the error code stored in this error memory slot" UBYTE EH_STANDARD_S5_S3 1 100 0 255 DISPLAY_IDENTIFIER ambient_condition[0][7].amb_cond.ydiMemory_xau16[16].ZFEH_EepromData ECU_ADDRESS 0xFFF82CA7 /end MEASUREMENT
/begin MEASUREMENT ZFEH_EepromData.ydiMemory_xau16[16].amb_cond.ambient_condition[0][8] "ambient condition shot [0 .. 2-1] with 25 data bytes [0 .. 25-1] for the error code stored in this error memory slot" UBYTE EH_STANDARD_S5_S3 1 100 0 255 DISPLAY_IDENTIFIER ambient_condition[0][8].amb_cond.ydiMemory_xau16[16].ZFEH_EepromData ECU_ADDRESS 0xFFF82CA8 /end MEASUREMENT
/begin MEASUREMENT ZFEH_EepromData.ydiMemory_xau16[16].amb_cond.ambient_condition[0][9] "ambient condition shot [0 .. 2-1] with 25 data bytes [0 .. 25-1] for the error code stored in this error memory slot" UBYTE EH_STANDARD_S5_S3 1 100 0 255 DISPLAY_IDENTIFIER ambient_condition[0][9].amb_cond.ydiMemory_xau16[16].ZFEH_EepromData ECU_ADDRESS 0xFFF82CA9 /end MEASUREMENT
/begin MEASUREMENT ZFEH_EepromData.ydiMemory_xau16[16].amb_cond.ambient_condition[0][10] "ambient condition shot [0 .. 2-1] with 25 data bytes [0 .. 25-1] for the error code stored in this error memory slot" UBYTE EH_STANDARD_S5_S3 1 100 0 255 DISPLAY_IDENTIFIER ambient_condition[0][10].amb_cond.ydiMemory_xau16[16].ZFEH_EepromData ECU_ADDRESS 0xFFF82CAA /end MEASUREMENT
/begin MEASUREMENT ZFEH_EepromData.ydiMemory_xau16[16].amb_cond.ambient_condition[0][11] "ambient condition shot [0 .. 2-1] with 25 data bytes [0 .. 25-1] for the error code stored in this error memory slot" UBYTE EH_STANDARD_S5_S3 1 100 0 255 DISPLAY_IDENTIFIER ambient_condition[0][11].amb_cond.ydiMemory_xau16[16].ZFEH_EepromData ECU_ADDRESS 0xFFF82CAB /end MEASUREMENT
/begin MEASUREMENT ZFEH_EepromData.ydiMemory_xau16[16].amb_cond.ambient_condition[0][12] "ambient condition shot [0 .. 2-1] with 25 data bytes [0 .. 25-1] for the error code stored in this error memory slot" UBYTE EH_STANDARD_S5_S3 1 100 0 255 DISPLAY_IDENTIFIER ambient_condition[0][12].amb_cond.ydiMemory_xau16[16].ZFEH_EepromData ECU_ADDRESS 0xFFF82CAC /end MEASUREMENT
/begin MEASUREMENT ZFEH_EepromData.ydiMemory_xau16[16].amb_cond.ambient_condition[0][13] "ambient condition shot [0 .. 2-1] with 25 data bytes [0 .. 25-1] for the error code stored in this error memory slot" UBYTE EH_STANDARD_S5_S3 1 100 0 255 DISPLAY_IDENTIFIER ambient_condition[0][13].amb_cond.ydiMemory_xau16[16].ZFEH_EepromData ECU_ADDRESS 0xFFF82CAD /end MEASUREMENT
/begin MEASUREMENT ZFEH_EepromData.ydiMemory_xau16[16].amb_cond.ambient_condition[0][14] "ambient condition shot [0 .. 2-1] with 25 data bytes [0 .. 25-1] for the error code stored in this error memory slot" UBYTE EH_STANDARD_S5_S3 1 100 0 255 DISPLAY_IDENTIFIER ambient_condition[0][14].amb_cond.ydiMemory_xau16[16].ZFEH_EepromData ECU_ADDRESS 0xFFF82CAE /end MEASUREMENT
/begin MEASUREMENT ZFEH_EepromData.ydiMemory_xau16[16].amb_cond.ambient_condition[0][15] "ambient condition shot [0 .. 2-1] with 25 data bytes [0 .. 25-1] for the error code stored in this error memory slot" UBYTE EH_STANDARD_S5_S3 1 100 0 255 DISPLAY_IDENTIFIER ambient_condition[0][15].amb_cond.ydiMemory_xau16[16].ZFEH_EepromData ECU_ADDRESS 0xFFF82CAF /end MEASUREMENT
/begin MEASUREMENT ZFEH_EepromData.ydiMemory_xau16[16].amb_cond.ambient_condition[0][16] "ambient condition shot [0 .. 2-1] with 25 data bytes [0 .. 25-1] for the error code stored in this error memory slot" UBYTE EH_STANDARD_S5_S3 1 100 0 255 DISPLAY_IDENTIFIER ambient_condition[0][16].amb_cond.ydiMemory_xau16[16].ZFEH_EepromData ECU_ADDRESS 0xFFF82CB0 /end MEASUREMENT
/begin MEASUREMENT ZFEH_EepromData.ydiMemory_xau16[16].amb_cond.ambient_condition[0][17] "ambient condition shot [0 .. 2-1] with 25 data bytes [0 .. 25-1] for the error code stored in this error memory slot" UBYTE EH_STANDARD_S5_S3 1 100 0 255 DISPLAY_IDENTIFIER ambient_condition[0][17].amb_cond.ydiMemory_xau16[16].ZFEH_EepromData ECU_ADDRESS 0xFFF82CB1 /end MEASUREMENT
/begin MEASUREMENT ZFEH_EepromData.ydiMemory_xau16[16].amb_cond.ambient_condition[0][18] "ambient condition shot [0 .. 2-1] with 25 data bytes [0 .. 25-1] for the error code stored in this error memory slot" UBYTE EH_STANDARD_S5_S3 1 100 0 255 DISPLAY_IDENTIFIER ambient_condition[0][18].amb_cond.ydiMemory_xau16[16].ZFEH_EepromData ECU_ADDRESS 0xFFF82CB2 /end MEASUREMENT
/begin MEASUREMENT ZFEH_EepromData.ydiMemory_xau16[16].amb_cond.ambient_condition[0][19] "ambient condition shot [0 .. 2-1] with 25 data bytes [0 .. 25-1] for the error code stored in this error memory slot" UBYTE EH_STANDARD_S5_S3 1 100 0 255 DISPLAY_IDENTIFIER ambient_condition[0][19].amb_cond.ydiMemory_xau16[16].ZFEH_EepromData ECU_ADDRESS 0xFFF82CB3 /end MEASUREMENT
/begin MEASUREMENT ZFEH_EepromData.ydiMemory_xau16[16].amb_cond.ambient_condition[0][20] "ambient condition shot [0 .. 2-1] with 25 data bytes [0 .. 25-1] for the error code stored in this error memory slot" UBYTE EH_STANDARD_S5_S3 1 100 0 255 DISPLAY_IDENTIFIER ambient_condition[0][20].amb_cond.ydiMemory_xau16[16].ZFEH_EepromData ECU_ADDRESS 0xFFF82CB4 /end MEASUREMENT
/begin MEASUREMENT ZFEH_EepromData.ydiMemory_xau16[16].amb_cond.ambient_condition[0][21] "ambient condition shot [0 .. 2-1] with 25 data bytes [0 .. 25-1] for the error code stored in this error memory slot" UBYTE EH_STANDARD_S5_S3 1 100 0 255 DISPLAY_IDENTIFIER ambient_condition[0][21].amb_cond.ydiMemory_xau16[16].ZFEH_EepromData ECU_ADDRESS 0xFFF82CB5 /end MEASUREMENT
/begin MEASUREMENT ZFEH_EepromData.ydiMemory_xau16[16].amb_cond.ambient_condition[0][22] "ambient condition shot [0 .. 2-1] with 25 data bytes [0 .. 25-1] for the error code stored in this error memory slot" UBYTE EH_STANDARD_S5_S3 1 100 0 255 DISPLAY_IDENTIFIER ambient_condition[0][22].amb_cond.ydiMemory_xau16[16].ZFEH_EepromData ECU_ADDRESS 0xFFF82CB6 /end MEASUREMENT
/begin MEASUREMENT ZFEH_EepromData.ydiMemory_xau16[16].amb_cond.ambient_condition[0][23] "ambient condition shot [0 .. 2-1] with 25 data bytes [0 .. 25-1] for the error code stored in this error memory slot" UBYTE EH_STANDARD_S5_S3 1 100 0 255 DISPLAY_IDENTIFIER ambient_condition[0][23].amb_cond.ydiMemory_xau16[16].ZFEH_EepromData ECU_ADDRESS 0xFFF82CB7 /end MEASUREMENT
/begin MEASUREMENT ZFEH_EepromData.ydiMemory_xau16[16].amb_cond.ambient_condition[0][24] "ambient condition shot [0 .. 2-1] with 25 data bytes [0 .. 25-1] for the error code stored in this error memory slot" UBYTE EH_STANDARD_S5_S3 1 100 0 255 DISPLAY_IDENTIFIER ambient_condition[0][24].amb_cond.ydiMemory_xau16[16].ZFEH_EepromData ECU_ADDRESS 0xFFF82CB8 /end MEASUREMENT
/begin MEASUREMENT ZFEH_EepromData.ydiMemory_xau16[16].amb_cond.ambient_condition[1][0] "ambient condition shot [0 .. 2-1] with 25 data bytes [0 .. 25-1] for the error code stored in this error memory slot" UBYTE EH_STANDARD_S5_S3 1 100 0 255 DISPLAY_IDENTIFIER ambient_condition[1][0].amb_cond.ydiMemory_xau16[16].ZFEH_EepromData ECU_ADDRESS 0xFFF82CB9 /end MEASUREMENT
/begin MEASUREMENT ZFEH_EepromData.ydiMemory_xau16[16].amb_cond.ambient_condition[1][1] "ambient condition shot [0 .. 2-1] with 25 data bytes [0 .. 25-1] for the error code stored in this error memory slot" UBYTE EH_STANDARD_S5_S3 1 100 0 255 DISPLAY_IDENTIFIER ambient_condition[1][1].amb_cond.ydiMemory_xau16[16].ZFEH_EepromData ECU_ADDRESS 0xFFF82CBA /end MEASUREMENT
/begin MEASUREMENT ZFEH_EepromData.ydiMemory_xau16[16].amb_cond.ambient_condition[1][2] "ambient condition shot [0 .. 2-1] with 25 data bytes [0 .. 25-1] for the error code stored in this error memory slot" UBYTE EH_STANDARD_S5_S3 1 100 0 255 DISPLAY_IDENTIFIER ambient_condition[1][2].amb_cond.ydiMemory_xau16[16].ZFEH_EepromData ECU_ADDRESS 0xFFF82CBB /end MEASUREMENT
/begin MEASUREMENT ZFEH_EepromData.ydiMemory_xau16[16].amb_cond.ambient_condition[1][3] "ambient condition shot [0 .. 2-1] with 25 data bytes [0 .. 25-1] for the error code stored in this error memory slot" UBYTE EH_STANDARD_S5_S3 1 100 0 255 DISPLAY_IDENTIFIER ambient_condition[1][3].amb_cond.ydiMemory_xau16[16].ZFEH_EepromData ECU_ADDRESS 0xFFF82CBC /end MEASUREMENT
/begin MEASUREMENT ZFEH_EepromData.ydiMemory_xau16[16].amb_cond.ambient_condition[1][4] "ambient condition shot [0 .. 2-1] with 25 data bytes [0 .. 25-1] for the error code stored in this error memory slot" UBYTE EH_STANDARD_S5_S3 1 100 0 255 DISPLAY_IDENTIFIER ambient_condition[1][4].amb_cond.ydiMemory_xau16[16].ZFEH_EepromData ECU_ADDRESS 0xFFF82CBD /end MEASUREMENT
/begin MEASUREMENT ZFEH_EepromData.ydiMemory_xau16[16].amb_cond.ambient_condition[1][5] "ambient condition shot [0 .. 2-1] with 25 data bytes [0 .. 25-1] for the error code stored in this error memory slot" UBYTE EH_STANDARD_S5_S3 1 100 0 255 DISPLAY_IDENTIFIER ambient_condition[1][5].amb_cond.ydiMemory_xau16[16].ZFEH_EepromData ECU_ADDRESS 0xFFF82CBE /end MEASUREMENT
/begin MEASUREMENT ZFEH_EepromData.ydiMemory_xau16[16].amb_cond.ambient_condition[1][6] "ambient condition shot [0 .. 2-1] with 25 data bytes [0 .. 25-1] for the error code stored in this error memory slot" UBYTE EH_STANDARD_S5_S3 1 100 0 255 DISPLAY_IDENTIFIER ambient_condition[1][6].amb_cond.ydiMemory_xau16[16].ZFEH_EepromData ECU_ADDRESS 0xFFF82CBF /end MEASUREMENT
/begin MEASUREMENT ZFEH_EepromData.ydiMemory_xau16[16].amb_cond.ambient_condition[1][7] "ambient condition shot [0 .. 2-1] with 25 data bytes [0 .. 25-1] for the error code stored in this error memory slot" UBYTE EH_STANDARD_S5_S3 1 100 0 255 DISPLAY_IDENTIFIER ambient_condition[1][7].amb_cond.ydiMemory_xau16[16].ZFEH_EepromData ECU_ADDRESS 0xFFF82CC0 /end MEASUREMENT
/begin MEASUREMENT ZFEH_EepromData.ydiMemory_xau16[16].amb_cond.ambient_condition[1][8] "ambient condition shot [0 .. 2-1] with 25 data bytes [0 .. 25-1] for the error code stored in this error memory slot" UBYTE EH_STANDARD_S5_S3 1 100 0 255 DISPLAY_IDENTIFIER ambient_condition[1][8].amb_cond.ydiMemory_xau16[16].ZFEH_EepromData ECU_ADDRESS 0xFFF82CC1 /end MEASUREMENT
/begin MEASUREMENT ZFEH_EepromData.ydiMemory_xau16[16].amb_cond.ambient_condition[1][9] "ambient condition shot [0 .. 2-1] with 25 data bytes [0 .. 25-1] for the error code stored in this error memory slot" UBYTE EH_STANDARD_S5_S3 1 100 0 255 DISPLAY_IDENTIFIER ambient_condition[1][9].amb_cond.ydiMemory_xau16[16].ZFEH_EepromData ECU_ADDRESS 0xFFF82CC2 /end MEASUREMENT
/begin MEASUREMENT ZFEH_EepromData.ydiMemory_xau16[16].amb_cond.ambient_condition[1][10] "ambient condition shot [0 .. 2-1] with 25 data bytes [0 .. 25-1] for the error code stored in this error memory slot" UBYTE EH_STANDARD_S5_S3 1 100 0 255 DISPLAY_IDENTIFIER ambient_condition[1][10].amb_cond.ydiMemory_xau16[16].ZFEH_EepromData ECU_ADDRESS 0xFFF82CC3 /end MEASUREMENT
/begin MEASUREMENT ZFEH_EepromData.ydiMemory_xau16[16].amb_cond.ambient_condition[1][11] "ambient condition shot [0 .. 2-1] with 25 data bytes [0 .. 25-1] for the error code stored in this error memory slot" UBYTE EH_STANDARD_S5_S3 1 100 0 255 DISPLAY_IDENTIFIER ambient_condition[1][11].amb_cond.ydiMemory_xau16[16].ZFEH_EepromData ECU_ADDRESS 0xFFF82CC4 /end MEASUREMENT
/begin MEASUREMENT ZFEH_EepromData.ydiMemory_xau16[16].amb_cond.ambient_condition[1][12] "ambient condition shot [0 .. 2-1] with 25 data bytes [0 .. 25-1] for the error code stored in this error memory slot" UBYTE EH_STANDARD_S5_S3 1 100 0 255 DISPLAY_IDENTIFIER ambient_condition[1][12].amb_cond.ydiMemory_xau16[16].ZFEH_EepromData ECU_ADDRESS 0xFFF82CC5 /end MEASUREMENT
/begin MEASUREMENT ZFEH_EepromData.ydiMemory_xau16[16].amb_cond.ambient_condition[1][13] "ambient condition shot [0 .. 2-1] with 25 data bytes [0 .. 25-1] for the error code stored in this error memory slot" UBYTE EH_STANDARD_S5_S3 1 100 0 255 DISPLAY_IDENTIFIER ambient_condition[1][13].amb_cond.ydiMemory_xau16[16].ZFEH_EepromData ECU_ADDRESS 0xFFF82CC6 /end MEASUREMENT
/begin MEASUREMENT ZFEH_EepromData.ydiMemory_xau16[16].amb_cond.ambient_condition[1][14] "ambient condition shot [0 .. 2-1] with 25 data bytes [0 .. 25-1] for the error code stored in this error memory slot" UBYTE EH_STANDARD_S5_S3 1 100 0 255 DISPLAY_IDENTIFIER ambient_condition[1][14].amb_cond.ydiMemory_xau16[16].ZFEH_EepromData ECU_ADDRESS 0xFFF82CC7 /end MEASUREMENT
/begin MEASUREMENT ZFEH_EepromData.ydiMemory_xau16[16].amb_cond.ambient_condition[1][15] "ambient condition shot [0 .. 2-1] with 25 data bytes [0 .. 25-1] for the error code stored in this error memory slot" UBYTE EH_STANDARD_S5_S3 1 100 0 255 DISPLAY_IDENTIFIER ambient_condition[1][15].amb_cond.ydiMemory_xau16[16].ZFEH_EepromData ECU_ADDRESS 0xFFF82CC8 /end MEASUREMENT
/begin MEASUREMENT ZFEH_EepromData.ydiMemory_xau16[16].amb_cond.ambient_condition[1][16] "ambient condition shot [0 .. 2-1] with 25 data bytes [0 .. 25-1] for the error code stored in this error memory slot" UBYTE EH_STANDARD_S5_S3 1 100 0 255 DISPLAY_IDENTIFIER ambient_condition[1][16].amb_cond.ydiMemory_xau16[16].ZFEH_EepromData ECU_ADDRESS 0xFFF82CC9 /end MEASUREMENT
/begin MEASUREMENT ZFEH_EepromData.ydiMemory_xau16[16].amb_cond.ambient_condition[1][17] "ambient condition shot [0 .. 2-1] with 25 data bytes [0 .. 25-1] for the error code stored in this error memory slot" UBYTE EH_STANDARD_S5_S3 1 100 0 255 DISPLAY_IDENTIFIER ambient_condition[1][17].amb_cond.ydiMemory_xau16[16].ZFEH_EepromData ECU_ADDRESS 0xFFF82CCA /end MEASUREMENT
/begin MEASUREMENT ZFEH_EepromData.ydiMemory_xau16[16].amb_cond.ambient_condition[1][18] "ambient condition shot [0 .. 2-1] with 25 data bytes [0 .. 25-1] for the error code stored in this error memory slot" UBYTE EH_STANDARD_S5_S3 1 100 0 255 DISPLAY_IDENTIFIER ambient_condition[1][18].amb_cond.ydiMemory_xau16[16].ZFEH_EepromData ECU_ADDRESS 0xFFF82CCB /end MEASUREMENT
/begin MEASUREMENT ZFEH_EepromData.ydiMemory_xau16[16].amb_cond.ambient_condition[1][19] "ambient condition shot [0 .. 2-1] with 25 data bytes [0 .. 25-1] for the error code stored in this error memory slot" UBYTE EH_STANDARD_S5_S3 1 100 0 255 DISPLAY_IDENTIFIER ambient_condition[1][19].amb_cond.ydiMemory_xau16[16].ZFEH_EepromData ECU_ADDRESS 0xFFF82CCC /end MEASUREMENT
/begin MEASUREMENT ZFEH_EepromData.ydiMemory_xau16[16].amb_cond.ambient_condition[1][20] "ambient condition shot [0 .. 2-1] with 25 data bytes [0 .. 25-1] for the error code stored in this error memory slot" UBYTE EH_STANDARD_S5_S3 1 100 0 255 DISPLAY_IDENTIFIER ambient_condition[1][20].amb_cond.ydiMemory_xau16[16].ZFEH_EepromData ECU_ADDRESS 0xFFF82CCD /end MEASUREMENT
/begin MEASUREMENT ZFEH_EepromData.ydiMemory_xau16[16].amb_cond.ambient_condition[1][21] "ambient condition shot [0 .. 2-1] with 25 data bytes [0 .. 25-1] for the error code stored in this error memory slot" UBYTE EH_STANDARD_S5_S3 1 100 0 255 DISPLAY_IDENTIFIER ambient_condition[1][21].amb_cond.ydiMemory_xau16[16].ZFEH_EepromData ECU_ADDRESS 0xFFF82CCE /end MEASUREMENT
/begin MEASUREMENT ZFEH_EepromData.ydiMemory_xau16[16].amb_cond.ambient_condition[1][22] "ambient condition shot [0 .. 2-1] with 25 data bytes [0 .. 25-1] for the error code stored in this error memory slot" UBYTE EH_STANDARD_S5_S3 1 100 0 255 DISPLAY_IDENTIFIER ambient_condition[1][22].amb_cond.ydiMemory_xau16[16].ZFEH_EepromData ECU_ADDRESS 0xFFF82CCF /end MEASUREMENT
/begin MEASUREMENT ZFEH_EepromData.ydiMemory_xau16[16].amb_cond.ambient_condition[1][23] "ambient condition shot [0 .. 2-1] with 25 data bytes [0 .. 25-1] for the error code stored in this error memory slot" UBYTE EH_STANDARD_S5_S3 1 100 0 255 DISPLAY_IDENTIFIER ambient_condition[1][23].amb_cond.ydiMemory_xau16[16].ZFEH_EepromData ECU_ADDRESS 0xFFF82CD0 /end MEASUREMENT
/begin MEASUREMENT ZFEH_EepromData.ydiMemory_xau16[16].amb_cond.ambient_condition[1][24] "ambient condition shot [0 .. 2-1] with 25 data bytes [0 .. 25-1] for the error code stored in this error memory slot" UBYTE EH_STANDARD_S5_S3 1 100 0 255 DISPLAY_IDENTIFIER ambient_condition[1][24].amb_cond.ydiMemory_xau16[16].ZFEH_EepromData ECU_ADDRESS 0xFFF82CD1 /end MEASUREMENT
/begin MEASUREMENT ZFEH_EepromData.ydiMemory_xau16[16].amb_cond.status_of_ambient_conditions[0] "status of ambient condition shot x: 0=invalid 1=valid" UBYTE EH_STANDARD_S5_S3 1 100 0 1 DISPLAY_IDENTIFIER status_of_ambient_conditions[0].amb_cond.ydiMemory_xau16[16].ZFEH_EepromData ECU_ADDRESS 0xFFF82CD2 /end MEASUREMENT
/begin MEASUREMENT ZFEH_EepromData.ydiMemory_xau16[16].amb_cond.status_of_ambient_conditions[1] "status of ambient condition shot x: 0=invalid 1=valid" UBYTE EH_STANDARD_S5_S3 1 100 0 1 DISPLAY_IDENTIFIER status_of_ambient_conditions[1].amb_cond.ydiMemory_xau16[16].ZFEH_EepromData ECU_ADDRESS 0xFFF82CD3 /end MEASUREMENT
/begin MEASUREMENT ZFEH_EepromData.ydiMemory_xau16[16].error_code "error code stored in error memory slot" UWORD CONV_KFC_NAME 0 255 0 65535 DISPLAY_IDENTIFIER error_code.ydiMemory_xau16[16].ZFEH_EepromData ECU_ADDRESS 0xFFF82C8C /end MEASUREMENT
/begin MEASUREMENT ZFEH_EepromData.ydiMemory_xau16[16].error_type "error type of error code stored in error memory slot" UWORD EH_STANDARD_S5_S3 1 100 0 65535 DISPLAY_IDENTIFIER error_type.ydiMemory_xau16[16].ZFEH_EepromData ECU_ADDRESS 0xFFF82C8E /end MEASUREMENT
/begin MEASUREMENT ZFEH_EepromData.ydiMemory_xau16[16].status_word "status word of error code stored in error memory slot" UWORD EH_STANDARD_S5_S3 1 100 0 65535 DISPLAY_IDENTIFIER status_word.ydiMemory_xau16[16].ZFEH_EepromData ECU_ADDRESS 0xFFF82C90 /end MEASUREMENT
/begin MEASUREMENT ZFEH_EepromData.ydiMemory_xau16[16].frequency_counter "frequency counter of error code stored in error memory slot" UBYTE EH_STANDARD_S5_S3 1 100 0 255 DISPLAY_IDENTIFIER frequency_counter.ydiMemory_xau16[16].ZFEH_EepromData ECU_ADDRESS 0xFFF82C92 /end MEASUREMENT
/begin MEASUREMENT ZFEH_EepromData.ydiMemory_xau16[16].backwards_counter "backwards counter of error code stored in error memory slot" UBYTE EH_STANDARD_S5_S3 1 100 0 255 DISPLAY_IDENTIFIER backwards_counter.ydiMemory_xau16[16].ZFEH_EepromData ECU_ADDRESS 0xFFF82C93 /end MEASUREMENT
/begin MEASUREMENT ZFEH_EepromData.ydiMemory_xau16[16].permanent_counter "counter of permanent error codes stored in error memory slot" UBYTE EH_STANDARD_S5_S3 1 100 0 255 DISPLAY_IDENTIFIER permanent_counter.ydiMemory_xau16[16].ZFEH_EepromData ECU_ADDRESS 0xFFF82C94 /end MEASUREMENT
/begin MEASUREMENT ZFEH_EepromData.ydiMemory_xau16[16].sequence_counter "sequence counter of error code stored in error memory slot" UBYTE EH_STANDARD_S5_S3 1 100 0 255 DISPLAY_IDENTIFIER sequence_counter.ydiMemory_xau16[16].ZFEH_EepromData ECU_ADDRESS 0xFFF82C95 /end MEASUREMENT
/begin MEASUREMENT ZFEH_EepromData.ydiMemory_xau16[16].master_time "master time of error code stored in error memory slot" ULONG EH_STANDARD_S5_S3 1 100 0 4294967295 DISPLAY_IDENTIFIER master_time.ydiMemory_xau16[16].ZFEH_EepromData ECU_ADDRESS 0xFFF82C98 /end MEASUREMENT
/begin MEASUREMENT ZFEH_EepromData.ydiMemory_xau16[16].condition_byte "condition byte of error code stored in error memory slot" UBYTE EH_STANDARD_S5_S3 1 100 0 255 DISPLAY_IDENTIFIER condition_byte.ydiMemory_xau16[16].ZFEH_EepromData ECU_ADDRESS 0xFFF82C9D /end MEASUREMENT
/begin MEASUREMENT ZFEH_EepromData.ydiMemory_xau16[16].obd_driving_cycle_counter "obd driving cycle counter of error code stored in error memory slot" UWORD EH_STANDARD_S5_S3 1 100 0 65535 DISPLAY_IDENTIFIER obd_driving_cycle_counter.ydiMemory_xau16[16].ZFEH_EepromData ECU_ADDRESS 0xFFF82C9E /end MEASUREMENT
/begin MEASUREMENT ZFEH_EepromData.ydiMemory_xau16[17].amb_cond.ambient_condition[0][0] "ambient condition shot [0 .. 2-1] with 25 data bytes [0 .. 25-1] for the error code stored in this error memory slot" UBYTE EH_STANDARD_S5_S3 1 100 0 255 DISPLAY_IDENTIFIER ambient_condition[0][0].amb_cond.ydiMemory_xau16[17].ZFEH_EepromData ECU_ADDRESS 0xFFF82CE8 /end MEASUREMENT
/begin MEASUREMENT ZFEH_EepromData.ydiMemory_xau16[17].amb_cond.ambient_condition[0][1] "ambient condition shot [0 .. 2-1] with 25 data bytes [0 .. 25-1] for the error code stored in this error memory slot" UBYTE EH_STANDARD_S5_S3 1 100 0 255 DISPLAY_IDENTIFIER ambient_condition[0][1].amb_cond.ydiMemory_xau16[17].ZFEH_EepromData ECU_ADDRESS 0xFFF82CE9 /end MEASUREMENT
/begin MEASUREMENT ZFEH_EepromData.ydiMemory_xau16[17].amb_cond.ambient_condition[0][2] "ambient condition shot [0 .. 2-1] with 25 data bytes [0 .. 25-1] for the error code stored in this error memory slot" UBYTE EH_STANDARD_S5_S3 1 100 0 255 DISPLAY_IDENTIFIER ambient_condition[0][2].amb_cond.ydiMemory_xau16[17].ZFEH_EepromData ECU_ADDRESS 0xFFF82CEA /end MEASUREMENT
/begin MEASUREMENT ZFEH_EepromData.ydiMemory_xau16[17].amb_cond.ambient_condition[0][3] "ambient condition shot [0 .. 2-1] with 25 data bytes [0 .. 25-1] for the error code stored in this error memory slot" UBYTE EH_STANDARD_S5_S3 1 100 0 255 DISPLAY_IDENTIFIER ambient_condition[0][3].amb_cond.ydiMemory_xau16[17].ZFEH_EepromData ECU_ADDRESS 0xFFF82CEB /end MEASUREMENT
/begin MEASUREMENT ZFEH_EepromData.ydiMemory_xau16[17].amb_cond.ambient_condition[0][4] "ambient condition shot [0 .. 2-1] with 25 data bytes [0 .. 25-1] for the error code stored in this error memory slot" UBYTE EH_STANDARD_S5_S3 1 100 0 255 DISPLAY_IDENTIFIER ambient_condition[0][4].amb_cond.ydiMemory_xau16[17].ZFEH_EepromData ECU_ADDRESS 0xFFF82CEC /end MEASUREMENT
/begin MEASUREMENT ZFEH_EepromData.ydiMemory_xau16[17].amb_cond.ambient_condition[0][5] "ambient condition shot [0 .. 2-1] with 25 data bytes [0 .. 25-1] for the error code stored in this error memory slot" UBYTE EH_STANDARD_S5_S3 1 100 0 255 DISPLAY_IDENTIFIER ambient_condition[0][5].amb_cond.ydiMemory_xau16[17].ZFEH_EepromData ECU_ADDRESS 0xFFF82CED /end MEASUREMENT
/begin MEASUREMENT ZFEH_EepromData.ydiMemory_xau16[17].amb_cond.ambient_condition[0][6] "ambient condition shot [0 .. 2-1] with 25 data bytes [0 .. 25-1] for the error code stored in this error memory slot" UBYTE EH_STANDARD_S5_S3 1 100 0 255 DISPLAY_IDENTIFIER ambient_condition[0][6].amb_cond.ydiMemory_xau16[17].ZFEH_EepromData ECU_ADDRESS 0xFFF82CEE /end MEASUREMENT
/begin MEASUREMENT ZFEH_EepromData.ydiMemory_xau16[17].amb_cond.ambient_condition[0][7] "ambient condition shot [0 .. 2-1] with 25 data bytes [0 .. 25-1] for the error code stored in this error memory slot" UBYTE EH_STANDARD_S5_S3 1 100 0 255 DISPLAY_IDENTIFIER ambient_condition[0][7].amb_cond.ydiMemory_xau16[17].ZFEH_EepromData ECU_ADDRESS 0xFFF82CEF /end MEASUREMENT
/begin MEASUREMENT ZFEH_EepromData.ydiMemory_xau16[17].amb_cond.ambient_condition[0][8] "ambient condition shot [0 .. 2-1] with 25 data bytes [0 .. 25-1] for the error code stored in this error memory slot" UBYTE EH_STANDARD_S5_S3 1 100 0 255 DISPLAY_IDENTIFIER ambient_condition[0][8].amb_cond.ydiMemory_xau16[17].ZFEH_EepromData ECU_ADDRESS 0xFFF82CF0 /end MEASUREMENT
/begin MEASUREMENT ZFEH_EepromData.ydiMemory_xau16[17].amb_cond.ambient_condition[0][9] "ambient condition shot [0 .. 2-1] with 25 data bytes [0 .. 25-1] for the error code stored in this error memory slot" UBYTE EH_STANDARD_S5_S3 1 100 0 255 DISPLAY_IDENTIFIER ambient_condition[0][9].amb_cond.ydiMemory_xau16[17].ZFEH_EepromData ECU_ADDRESS 0xFFF82CF1 /end MEASUREMENT
/begin MEASUREMENT ZFEH_EepromData.ydiMemory_xau16[17].amb_cond.ambient_condition[0][10] "ambient condition shot [0 .. 2-1] with 25 data bytes [0 .. 25-1] for the error code stored in this error memory slot" UBYTE EH_STANDARD_S5_S3 1 100 0 255 DISPLAY_IDENTIFIER ambient_condition[0][10].amb_cond.ydiMemory_xau16[17].ZFEH_EepromData ECU_ADDRESS 0xFFF82CF2 /end MEASUREMENT
/begin MEASUREMENT ZFEH_EepromData.ydiMemory_xau16[17].amb_cond.ambient_condition[0][11] "ambient condition shot [0 .. 2-1] with 25 data bytes [0 .. 25-1] for the error code stored in this error memory slot" UBYTE EH_STANDARD_S5_S3 1 100 0 255 DISPLAY_IDENTIFIER ambient_condition[0][11].amb_cond.ydiMemory_xau16[17].ZFEH_EepromData ECU_ADDRESS 0xFFF82CF3 /end MEASUREMENT
/begin MEASUREMENT ZFEH_EepromData.ydiMemory_xau16[17].amb_cond.ambient_condition[0][12] "ambient condition shot [0 .. 2-1] with 25 data bytes [0 .. 25-1] for the error code stored in this error memory slot" UBYTE EH_STANDARD_S5_S3 1 100 0 255 DISPLAY_IDENTIFIER ambient_condition[0][12].amb_cond.ydiMemory_xau16[17].ZFEH_EepromData ECU_ADDRESS 0xFFF82CF4 /end MEASUREMENT
/begin MEASUREMENT ZFEH_EepromData.ydiMemory_xau16[17].amb_cond.ambient_condition[0][13] "ambient condition shot [0 .. 2-1] with 25 data bytes [0 .. 25-1] for the error code stored in this error memory slot" UBYTE EH_STANDARD_S5_S3 1 100 0 255 DISPLAY_IDENTIFIER ambient_condition[0][13].amb_cond.ydiMemory_xau16[17].ZFEH_EepromData ECU_ADDRESS 0xFFF82CF5 /end MEASUREMENT
/begin MEASUREMENT ZFEH_EepromData.ydiMemory_xau16[17].amb_cond.ambient_condition[0][14] "ambient condition shot [0 .. 2-1] with 25 data bytes [0 .. 25-1] for the error code stored in this error memory slot" UBYTE EH_STANDARD_S5_S3 1 100 0 255 DISPLAY_IDENTIFIER ambient_condition[0][14].amb_cond.ydiMemory_xau16[17].ZFEH_EepromData ECU_ADDRESS 0xFFF82CF6 /end MEASUREMENT
/begin MEASUREMENT ZFEH_EepromData.ydiMemory_xau16[17].amb_cond.ambient_condition[0][15] "ambient condition shot [0 .. 2-1] with 25 data bytes [0 .. 25-1] for the error code stored in this error memory slot" UBYTE EH_STANDARD_S5_S3 1 100 0 255 DISPLAY_IDENTIFIER ambient_condition[0][15].amb_cond.ydiMemory_xau16[17].ZFEH_EepromData ECU_ADDRESS 0xFFF82CF7 /end MEASUREMENT
/begin MEASUREMENT ZFEH_EepromData.ydiMemory_xau16[17].amb_cond.ambient_condition[0][16] "ambient condition shot [0 .. 2-1] with 25 data bytes [0 .. 25-1] for the error code stored in this error memory slot" UBYTE EH_STANDARD_S5_S3 1 100 0 255 DISPLAY_IDENTIFIER ambient_condition[0][16].amb_cond.ydiMemory_xau16[17].ZFEH_EepromData ECU_ADDRESS 0xFFF82CF8 /end MEASUREMENT
/begin MEASUREMENT ZFEH_EepromData.ydiMemory_xau16[17].amb_cond.ambient_condition[0][17] "ambient condition shot [0 .. 2-1] with 25 data bytes [0 .. 25-1] for the error code stored in this error memory slot" UBYTE EH_STANDARD_S5_S3 1 100 0 255 DISPLAY_IDENTIFIER ambient_condition[0][17].amb_cond.ydiMemory_xau16[17].ZFEH_EepromData ECU_ADDRESS 0xFFF82CF9 /end MEASUREMENT
/begin MEASUREMENT ZFEH_EepromData.ydiMemory_xau16[17].amb_cond.ambient_condition[0][18] "ambient condition shot [0 .. 2-1] with 25 data bytes [0 .. 25-1] for the error code stored in this error memory slot" UBYTE EH_STANDARD_S5_S3 1 100 0 255 DISPLAY_IDENTIFIER ambient_condition[0][18].amb_cond.ydiMemory_xau16[17].ZFEH_EepromData ECU_ADDRESS 0xFFF82CFA /end MEASUREMENT
/begin MEASUREMENT ZFEH_EepromData.ydiMemory_xau16[17].amb_cond.ambient_condition[0][19] "ambient condition shot [0 .. 2-1] with 25 data bytes [0 .. 25-1] for the error code stored in this error memory slot" UBYTE EH_STANDARD_S5_S3 1 100 0 255 DISPLAY_IDENTIFIER ambient_condition[0][19].amb_cond.ydiMemory_xau16[17].ZFEH_EepromData ECU_ADDRESS 0xFFF82CFB /end MEASUREMENT
/begin MEASUREMENT ZFEH_EepromData.ydiMemory_xau16[17].amb_cond.ambient_condition[0][20] "ambient condition shot [0 .. 2-1] with 25 data bytes [0 .. 25-1] for the error code stored in this error memory slot" UBYTE EH_STANDARD_S5_S3 1 100 0 255 DISPLAY_IDENTIFIER ambient_condition[0][20].amb_cond.ydiMemory_xau16[17].ZFEH_EepromData ECU_ADDRESS 0xFFF82CFC /end MEASUREMENT
/begin MEASUREMENT ZFEH_EepromData.ydiMemory_xau16[17].amb_cond.ambient_condition[0][21] "ambient condition shot [0 .. 2-1] with 25 data bytes [0 .. 25-1] for the error code stored in this error memory slot" UBYTE EH_STANDARD_S5_S3 1 100 0 255 DISPLAY_IDENTIFIER ambient_condition[0][21].amb_cond.ydiMemory_xau16[17].ZFEH_EepromData ECU_ADDRESS 0xFFF82CFD /end MEASUREMENT
/begin MEASUREMENT ZFEH_EepromData.ydiMemory_xau16[17].amb_cond.ambient_condition[0][22] "ambient condition shot [0 .. 2-1] with 25 data bytes [0 .. 25-1] for the error code stored in this error memory slot" UBYTE EH_STANDARD_S5_S3 1 100 0 255 DISPLAY_IDENTIFIER ambient_condition[0][22].amb_cond.ydiMemory_xau16[17].ZFEH_EepromData ECU_ADDRESS 0xFFF82CFE /end MEASUREMENT
/begin MEASUREMENT ZFEH_EepromData.ydiMemory_xau16[17].amb_cond.ambient_condition[0][23] "ambient condition shot [0 .. 2-1] with 25 data bytes [0 .. 25-1] for the error code stored in this error memory slot" UBYTE EH_STANDARD_S5_S3 1 100 0 255 DISPLAY_IDENTIFIER ambient_condition[0][23].amb_cond.ydiMemory_xau16[17].ZFEH_EepromData ECU_ADDRESS 0xFFF82CFF /end MEASUREMENT
/begin MEASUREMENT ZFEH_EepromData.ydiMemory_xau16[17].amb_cond.ambient_condition[0][24] "ambient condition shot [0 .. 2-1] with 25 data bytes [0 .. 25-1] for the error code stored in this error memory slot" UBYTE EH_STANDARD_S5_S3 1 100 0 255 DISPLAY_IDENTIFIER ambient_condition[0][24].amb_cond.ydiMemory_xau16[17].ZFEH_EepromData ECU_ADDRESS 0xFFF82D00 /end MEASUREMENT
/begin MEASUREMENT ZFEH_EepromData.ydiMemory_xau16[17].amb_cond.ambient_condition[1][0] "ambient condition shot [0 .. 2-1] with 25 data bytes [0 .. 25-1] for the error code stored in this error memory slot" UBYTE EH_STANDARD_S5_S3 1 100 0 255 DISPLAY_IDENTIFIER ambient_condition[1][0].amb_cond.ydiMemory_xau16[17].ZFEH_EepromData ECU_ADDRESS 0xFFF82D01 /end MEASUREMENT
/begin MEASUREMENT ZFEH_EepromData.ydiMemory_xau16[17].amb_cond.ambient_condition[1][1] "ambient condition shot [0 .. 2-1] with 25 data bytes [0 .. 25-1] for the error code stored in this error memory slot" UBYTE EH_STANDARD_S5_S3 1 100 0 255 DISPLAY_IDENTIFIER ambient_condition[1][1].amb_cond.ydiMemory_xau16[17].ZFEH_EepromData ECU_ADDRESS 0xFFF82D02 /end MEASUREMENT
/begin MEASUREMENT ZFEH_EepromData.ydiMemory_xau16[17].amb_cond.ambient_condition[1][2] "ambient condition shot [0 .. 2-1] with 25 data bytes [0 .. 25-1] for the error code stored in this error memory slot" UBYTE EH_STANDARD_S5_S3 1 100 0 255 DISPLAY_IDENTIFIER ambient_condition[1][2].amb_cond.ydiMemory_xau16[17].ZFEH_EepromData ECU_ADDRESS 0xFFF82D03 /end MEASUREMENT
/begin MEASUREMENT ZFEH_EepromData.ydiMemory_xau16[17].amb_cond.ambient_condition[1][3] "ambient condition shot [0 .. 2-1] with 25 data bytes [0 .. 25-1] for the error code stored in this error memory slot" UBYTE EH_STANDARD_S5_S3 1 100 0 255 DISPLAY_IDENTIFIER ambient_condition[1][3].amb_cond.ydiMemory_xau16[17].ZFEH_EepromData ECU_ADDRESS 0xFFF82D04 /end MEASUREMENT
/begin MEASUREMENT ZFEH_EepromData.ydiMemory_xau16[17].amb_cond.ambient_condition[1][4] "ambient condition shot [0 .. 2-1] with 25 data bytes [0 .. 25-1] for the error code stored in this error memory slot" UBYTE EH_STANDARD_S5_S3 1 100 0 255 DISPLAY_IDENTIFIER ambient_condition[1][4].amb_cond.ydiMemory_xau16[17].ZFEH_EepromData ECU_ADDRESS 0xFFF82D05 /end MEASUREMENT
/begin MEASUREMENT ZFEH_EepromData.ydiMemory_xau16[17].amb_cond.ambient_condition[1][5] "ambient condition shot [0 .. 2-1] with 25 data bytes [0 .. 25-1] for the error code stored in this error memory slot" UBYTE EH_STANDARD_S5_S3 1 100 0 255 DISPLAY_IDENTIFIER ambient_condition[1][5].amb_cond.ydiMemory_xau16[17].ZFEH_EepromData ECU_ADDRESS 0xFFF82D06 /end MEASUREMENT
/begin MEASUREMENT ZFEH_EepromData.ydiMemory_xau16[17].amb_cond.ambient_condition[1][6] "ambient condition shot [0 .. 2-1] with 25 data bytes [0 .. 25-1] for the error code stored in this error memory slot" UBYTE EH_STANDARD_S5_S3 1 100 0 255 DISPLAY_IDENTIFIER ambient_condition[1][6].amb_cond.ydiMemory_xau16[17].ZFEH_EepromData ECU_ADDRESS 0xFFF82D07 /end MEASUREMENT
/begin MEASUREMENT ZFEH_EepromData.ydiMemory_xau16[17].amb_cond.ambient_condition[1][7] "ambient condition shot [0 .. 2-1] with 25 data bytes [0 .. 25-1] for the error code stored in this error memory slot" UBYTE EH_STANDARD_S5_S3 1 100 0 255 DISPLAY_IDENTIFIER ambient_condition[1][7].amb_cond.ydiMemory_xau16[17].ZFEH_EepromData ECU_ADDRESS 0xFFF82D08 /end MEASUREMENT
/begin MEASUREMENT ZFEH_EepromData.ydiMemory_xau16[17].amb_cond.ambient_condition[1][8] "ambient condition shot [0 .. 2-1] with 25 data bytes [0 .. 25-1] for the error code stored in this error memory slot" UBYTE EH_STANDARD_S5_S3 1 100 0 255 DISPLAY_IDENTIFIER ambient_condition[1][8].amb_cond.ydiMemory_xau16[17].ZFEH_EepromData ECU_ADDRESS 0xFFF82D09 /end MEASUREMENT
/begin MEASUREMENT ZFEH_EepromData.ydiMemory_xau16[17].amb_cond.ambient_condition[1][9] "ambient condition shot [0 .. 2-1] with 25 data bytes [0 .. 25-1] for the error code stored in this error memory slot" UBYTE EH_STANDARD_S5_S3 1 100 0 255 DISPLAY_IDENTIFIER ambient_condition[1][9].amb_cond.ydiMemory_xau16[17].ZFEH_EepromData ECU_ADDRESS 0xFFF82D0A /end MEASUREMENT
/begin MEASUREMENT ZFEH_EepromData.ydiMemory_xau16[17].amb_cond.ambient_condition[1][10] "ambient condition shot [0 .. 2-1] with 25 data bytes [0 .. 25-1] for the error code stored in this error memory slot" UBYTE EH_STANDARD_S5_S3 1 100 0 255 DISPLAY_IDENTIFIER ambient_condition[1][10].amb_cond.ydiMemory_xau16[17].ZFEH_EepromData ECU_ADDRESS 0xFFF82D0B /end MEASUREMENT
/begin MEASUREMENT ZFEH_EepromData.ydiMemory_xau16[17].amb_cond.ambient_condition[1][11] "ambient condition shot [0 .. 2-1] with 25 data bytes [0 .. 25-1] for the error code stored in this error memory slot" UBYTE EH_STANDARD_S5_S3 1 100 0 255 DISPLAY_IDENTIFIER ambient_condition[1][11].amb_cond.ydiMemory_xau16[17].ZFEH_EepromData ECU_ADDRESS 0xFFF82D0C /end MEASUREMENT
/begin MEASUREMENT ZFEH_EepromData.ydiMemory_xau16[17].amb_cond.ambient_condition[1][12] "ambient condition shot [0 .. 2-1] with 25 data bytes [0 .. 25-1] for the error code stored in this error memory slot" UBYTE EH_STANDARD_S5_S3 1 100 0 255 DISPLAY_IDENTIFIER ambient_condition[1][12].amb_cond.ydiMemory_xau16[17].ZFEH_EepromData ECU_ADDRESS 0xFFF82D0D /end MEASUREMENT
/begin MEASUREMENT ZFEH_EepromData.ydiMemory_xau16[17].amb_cond.ambient_condition[1][13] "ambient condition shot [0 .. 2-1] with 25 data bytes [0 .. 25-1] for the error code stored in this error memory slot" UBYTE EH_STANDARD_S5_S3 1 100 0 255 DISPLAY_IDENTIFIER ambient_condition[1][13].amb_cond.ydiMemory_xau16[17].ZFEH_EepromData ECU_ADDRESS 0xFFF82D0E /end MEASUREMENT
/begin MEASUREMENT ZFEH_EepromData.ydiMemory_xau16[17].amb_cond.ambient_condition[1][14] "ambient condition shot [0 .. 2-1] with 25 data bytes [0 .. 25-1] for the error code stored in this error memory slot" UBYTE EH_STANDARD_S5_S3 1 100 0 255 DISPLAY_IDENTIFIER ambient_condition[1][14].amb_cond.ydiMemory_xau16[17].ZFEH_EepromData ECU_ADDRESS 0xFFF82D0F /end MEASUREMENT
/begin MEASUREMENT ZFEH_EepromData.ydiMemory_xau16[17].amb_cond.ambient_condition[1][15] "ambient condition shot [0 .. 2-1] with 25 data bytes [0 .. 25-1] for the error code stored in this error memory slot" UBYTE EH_STANDARD_S5_S3 1 100 0 255 DISPLAY_IDENTIFIER ambient_condition[1][15].amb_cond.ydiMemory_xau16[17].ZFEH_EepromData ECU_ADDRESS 0xFFF82D10 /end MEASUREMENT
/begin MEASUREMENT ZFEH_EepromData.ydiMemory_xau16[17].amb_cond.ambient_condition[1][16] "ambient condition shot [0 .. 2-1] with 25 data bytes [0 .. 25-1] for the error code stored in this error memory slot" UBYTE EH_STANDARD_S5_S3 1 100 0 255 DISPLAY_IDENTIFIER ambient_condition[1][16].amb_cond.ydiMemory_xau16[17].ZFEH_EepromData ECU_ADDRESS 0xFFF82D11 /end MEASUREMENT
/begin MEASUREMENT ZFEH_EepromData.ydiMemory_xau16[17].amb_cond.ambient_condition[1][17] "ambient condition shot [0 .. 2-1] with 25 data bytes [0 .. 25-1] for the error code stored in this error memory slot" UBYTE EH_STANDARD_S5_S3 1 100 0 255 DISPLAY_IDENTIFIER ambient_condition[1][17].amb_cond.ydiMemory_xau16[17].ZFEH_EepromData ECU_ADDRESS 0xFFF82D12 /end MEASUREMENT
/begin MEASUREMENT ZFEH_EepromData.ydiMemory_xau16[17].amb_cond.ambient_condition[1][18] "ambient condition shot [0 .. 2-1] with 25 data bytes [0 .. 25-1] for the error code stored in this error memory slot" UBYTE EH_STANDARD_S5_S3 1 100 0 255 DISPLAY_IDENTIFIER ambient_condition[1][18].amb_cond.ydiMemory_xau16[17].ZFEH_EepromData ECU_ADDRESS 0xFFF82D13 /end MEASUREMENT
/begin MEASUREMENT ZFEH_EepromData.ydiMemory_xau16[17].amb_cond.ambient_condition[1][19] "ambient condition shot [0 .. 2-1] with 25 data bytes [0 .. 25-1] for the error code stored in this error memory slot" UBYTE EH_STANDARD_S5_S3 1 100 0 255 DISPLAY_IDENTIFIER ambient_condition[1][19].amb_cond.ydiMemory_xau16[17].ZFEH_EepromData ECU_ADDRESS 0xFFF82D14 /end MEASUREMENT
/begin MEASUREMENT ZFEH_EepromData.ydiMemory_xau16[17].amb_cond.ambient_condition[1][20] "ambient condition shot [0 .. 2-1] with 25 data bytes [0 .. 25-1] for the error code stored in this error memory slot" UBYTE EH_STANDARD_S5_S3 1 100 0 255 DISPLAY_IDENTIFIER ambient_condition[1][20].amb_cond.ydiMemory_xau16[17].ZFEH_EepromData ECU_ADDRESS 0xFFF82D15 /end MEASUREMENT
/begin MEASUREMENT ZFEH_EepromData.ydiMemory_xau16[17].amb_cond.ambient_condition[1][21] "ambient condition shot [0 .. 2-1] with 25 data bytes [0 .. 25-1] for the error code stored in this error memory slot" UBYTE EH_STANDARD_S5_S3 1 100 0 255 DISPLAY_IDENTIFIER ambient_condition[1][21].amb_cond.ydiMemory_xau16[17].ZFEH_EepromData ECU_ADDRESS 0xFFF82D16 /end MEASUREMENT
/begin MEASUREMENT ZFEH_EepromData.ydiMemory_xau16[17].amb_cond.ambient_condition[1][22] "ambient condition shot [0 .. 2-1] with 25 data bytes [0 .. 25-1] for the error code stored in this error memory slot" UBYTE EH_STANDARD_S5_S3 1 100 0 255 DISPLAY_IDENTIFIER ambient_condition[1][22].amb_cond.ydiMemory_xau16[17].ZFEH_EepromData ECU_ADDRESS 0xFFF82D17 /end MEASUREMENT
/begin MEASUREMENT ZFEH_EepromData.ydiMemory_xau16[17].amb_cond.ambient_condition[1][23] "ambient condition shot [0 .. 2-1] with 25 data bytes [0 .. 25-1] for the error code stored in this error memory slot" UBYTE EH_STANDARD_S5_S3 1 100 0 255 DISPLAY_IDENTIFIER ambient_condition[1][23].amb_cond.ydiMemory_xau16[17].ZFEH_EepromData ECU_ADDRESS 0xFFF82D18 /end MEASUREMENT
/begin MEASUREMENT ZFEH_EepromData.ydiMemory_xau16[17].amb_cond.ambient_condition[1][24] "ambient condition shot [0 .. 2-1] with 25 data bytes [0 .. 25-1] for the error code stored in this error memory slot" UBYTE EH_STANDARD_S5_S3 1 100 0 255 DISPLAY_IDENTIFIER ambient_condition[1][24].amb_cond.ydiMemory_xau16[17].ZFEH_EepromData ECU_ADDRESS 0xFFF82D19 /end MEASUREMENT
/begin MEASUREMENT ZFEH_EepromData.ydiMemory_xau16[17].amb_cond.status_of_ambient_conditions[0] "status of ambient condition shot x: 0=invalid 1=valid" UBYTE EH_STANDARD_S5_S3 1 100 0 1 DISPLAY_IDENTIFIER status_of_ambient_conditions[0].amb_cond.ydiMemory_xau16[17].ZFEH_EepromData ECU_ADDRESS 0xFFF82D1A /end MEASUREMENT
/begin MEASUREMENT ZFEH_EepromData.ydiMemory_xau16[17].amb_cond.status_of_ambient_conditions[1] "status of ambient condition shot x: 0=invalid 1=valid" UBYTE EH_STANDARD_S5_S3 1 100 0 1 DISPLAY_IDENTIFIER status_of_ambient_conditions[1].amb_cond.ydiMemory_xau16[17].ZFEH_EepromData ECU_ADDRESS 0xFFF82D1B /end MEASUREMENT
/begin MEASUREMENT ZFEH_EepromData.ydiMemory_xau16[17].error_code "error code stored in error memory slot" UWORD CONV_KFC_NAME 0 255 0 65535 DISPLAY_IDENTIFIER error_code.ydiMemory_xau16[17].ZFEH_EepromData ECU_ADDRESS 0xFFF82CD4 /end MEASUREMENT
/begin MEASUREMENT ZFEH_EepromData.ydiMemory_xau16[17].error_type "error type of error code stored in error memory slot" UWORD EH_STANDARD_S5_S3 1 100 0 65535 DISPLAY_IDENTIFIER error_type.ydiMemory_xau16[17].ZFEH_EepromData ECU_ADDRESS 0xFFF82CD6 /end MEASUREMENT
/begin MEASUREMENT ZFEH_EepromData.ydiMemory_xau16[17].status_word "status word of error code stored in error memory slot" UWORD EH_STANDARD_S5_S3 1 100 0 65535 DISPLAY_IDENTIFIER status_word.ydiMemory_xau16[17].ZFEH_EepromData ECU_ADDRESS 0xFFF82CD8 /end MEASUREMENT
/begin MEASUREMENT ZFEH_EepromData.ydiMemory_xau16[17].frequency_counter "frequency counter of error code stored in error memory slot" UBYTE EH_STANDARD_S5_S3 1 100 0 255 DISPLAY_IDENTIFIER frequency_counter.ydiMemory_xau16[17].ZFEH_EepromData ECU_ADDRESS 0xFFF82CDA /end MEASUREMENT
/begin MEASUREMENT ZFEH_EepromData.ydiMemory_xau16[17].backwards_counter "backwards counter of error code stored in error memory slot" UBYTE EH_STANDARD_S5_S3 1 100 0 255 DISPLAY_IDENTIFIER backwards_counter.ydiMemory_xau16[17].ZFEH_EepromData ECU_ADDRESS 0xFFF82CDB /end MEASUREMENT
/begin MEASUREMENT ZFEH_EepromData.ydiMemory_xau16[17].permanent_counter "counter of permanent error codes stored in error memory slot" UBYTE EH_STANDARD_S5_S3 1 100 0 255 DISPLAY_IDENTIFIER permanent_counter.ydiMemory_xau16[17].ZFEH_EepromData ECU_ADDRESS 0xFFF82CDC /end MEASUREMENT
/begin MEASUREMENT ZFEH_EepromData.ydiMemory_xau16[17].sequence_counter "sequence counter of error code stored in error memory slot" UBYTE EH_STANDARD_S5_S3 1 100 0 255 DISPLAY_IDENTIFIER sequence_counter.ydiMemory_xau16[17].ZFEH_EepromData ECU_ADDRESS 0xFFF82CDD /end MEASUREMENT
/begin MEASUREMENT ZFEH_EepromData.ydiMemory_xau16[17].master_time "master time of error code stored in error memory slot" ULONG EH_STANDARD_S5_S3 1 100 0 4294967295 DISPLAY_IDENTIFIER master_time.ydiMemory_xau16[17].ZFEH_EepromData ECU_ADDRESS 0xFFF82CE0 /end MEASUREMENT
/begin MEASUREMENT ZFEH_EepromData.ydiMemory_xau16[17].condition_byte "condition byte of error code stored in error memory slot" UBYTE EH_STANDARD_S5_S3 1 100 0 255 DISPLAY_IDENTIFIER condition_byte.ydiMemory_xau16[17].ZFEH_EepromData ECU_ADDRESS 0xFFF82CE5 /end MEASUREMENT
/begin MEASUREMENT ZFEH_EepromData.ydiMemory_xau16[17].obd_driving_cycle_counter "obd driving cycle counter of error code stored in error memory slot" UWORD EH_STANDARD_S5_S3 1 100 0 65535 DISPLAY_IDENTIFIER obd_driving_cycle_counter.ydiMemory_xau16[17].ZFEH_EepromData ECU_ADDRESS 0xFFF82CE6 /end MEASUREMENT
/begin MEASUREMENT ZFEH_EepromData.ydiMemory_xau16[18].amb_cond.ambient_condition[0][0] "ambient condition shot [0 .. 2-1] with 25 data bytes [0 .. 25-1] for the error code stored in this error memory slot" UBYTE EH_STANDARD_S5_S3 1 100 0 255 DISPLAY_IDENTIFIER ambient_condition[0][0].amb_cond.ydiMemory_xau16[18].ZFEH_EepromData ECU_ADDRESS 0xFFF82D30 /end MEASUREMENT
/begin MEASUREMENT ZFEH_EepromData.ydiMemory_xau16[18].amb_cond.ambient_condition[0][1] "ambient condition shot [0 .. 2-1] with 25 data bytes [0 .. 25-1] for the error code stored in this error memory slot" UBYTE EH_STANDARD_S5_S3 1 100 0 255 DISPLAY_IDENTIFIER ambient_condition[0][1].amb_cond.ydiMemory_xau16[18].ZFEH_EepromData ECU_ADDRESS 0xFFF82D31 /end MEASUREMENT
/begin MEASUREMENT ZFEH_EepromData.ydiMemory_xau16[18].amb_cond.ambient_condition[0][2] "ambient condition shot [0 .. 2-1] with 25 data bytes [0 .. 25-1] for the error code stored in this error memory slot" UBYTE EH_STANDARD_S5_S3 1 100 0 255 DISPLAY_IDENTIFIER ambient_condition[0][2].amb_cond.ydiMemory_xau16[18].ZFEH_EepromData ECU_ADDRESS 0xFFF82D32 /end MEASUREMENT
/begin MEASUREMENT ZFEH_EepromData.ydiMemory_xau16[18].amb_cond.ambient_condition[0][3] "ambient condition shot [0 .. 2-1] with 25 data bytes [0 .. 25-1] for the error code stored in this error memory slot" UBYTE EH_STANDARD_S5_S3 1 100 0 255 DISPLAY_IDENTIFIER ambient_condition[0][3].amb_cond.ydiMemory_xau16[18].ZFEH_EepromData ECU_ADDRESS 0xFFF82D33 /end MEASUREMENT
/begin MEASUREMENT ZFEH_EepromData.ydiMemory_xau16[18].amb_cond.ambient_condition[0][4] "ambient condition shot [0 .. 2-1] with 25 data bytes [0 .. 25-1] for the error code stored in this error memory slot" UBYTE EH_STANDARD_S5_S3 1 100 0 255 DISPLAY_IDENTIFIER ambient_condition[0][4].amb_cond.ydiMemory_xau16[18].ZFEH_EepromData ECU_ADDRESS 0xFFF82D34 /end MEASUREMENT
/begin MEASUREMENT ZFEH_EepromData.ydiMemory_xau16[18].amb_cond.ambient_condition[0][5] "ambient condition shot [0 .. 2-1] with 25 data bytes [0 .. 25-1] for the error code stored in this error memory slot" UBYTE EH_STANDARD_S5_S3 1 100 0 255 DISPLAY_IDENTIFIER ambient_condition[0][5].amb_cond.ydiMemory_xau16[18].ZFEH_EepromData ECU_ADDRESS 0xFFF82D35 /end MEASUREMENT
/begin MEASUREMENT ZFEH_EepromData.ydiMemory_xau16[18].amb_cond.ambient_condition[0][6] "ambient condition shot [0 .. 2-1] with 25 data bytes [0 .. 25-1] for the error code stored in this error memory slot" UBYTE EH_STANDARD_S5_S3 1 100 0 255 DISPLAY_IDENTIFIER ambient_condition[0][6].amb_cond.ydiMemory_xau16[18].ZFEH_EepromData ECU_ADDRESS 0xFFF82D36 /end MEASUREMENT
/begin MEASUREMENT ZFEH_EepromData.ydiMemory_xau16[18].amb_cond.ambient_condition[0][7] "ambient condition shot [0 .. 2-1] with 25 data bytes [0 .. 25-1] for the error code stored in this error memory slot" UBYTE EH_STANDARD_S5_S3 1 100 0 255 DISPLAY_IDENTIFIER ambient_condition[0][7].amb_cond.ydiMemory_xau16[18].ZFEH_EepromData ECU_ADDRESS 0xFFF82D37 /end MEASUREMENT
/begin MEASUREMENT ZFEH_EepromData.ydiMemory_xau16[18].amb_cond.ambient_condition[0][8] "ambient condition shot [0 .. 2-1] with 25 data bytes [0 .. 25-1] for the error code stored in this error memory slot" UBYTE EH_STANDARD_S5_S3 1 100 0 255 DISPLAY_IDENTIFIER ambient_condition[0][8].amb_cond.ydiMemory_xau16[18].ZFEH_EepromData ECU_ADDRESS 0xFFF82D38 /end MEASUREMENT
/begin MEASUREMENT ZFEH_EepromData.ydiMemory_xau16[18].amb_cond.ambient_condition[0][9] "ambient condition shot [0 .. 2-1] with 25 data bytes [0 .. 25-1] for the error code stored in this error memory slot" UBYTE EH_STANDARD_S5_S3 1 100 0 255 DISPLAY_IDENTIFIER ambient_condition[0][9].amb_cond.ydiMemory_xau16[18].ZFEH_EepromData ECU_ADDRESS 0xFFF82D39 /end MEASUREMENT
/begin MEASUREMENT ZFEH_EepromData.ydiMemory_xau16[18].amb_cond.ambient_condition[0][10] "ambient condition shot [0 .. 2-1] with 25 data bytes [0 .. 25-1] for the error code stored in this error memory slot" UBYTE EH_STANDARD_S5_S3 1 100 0 255 DISPLAY_IDENTIFIER ambient_condition[0][10].amb_cond.ydiMemory_xau16[18].ZFEH_EepromData ECU_ADDRESS 0xFFF82D3A /end MEASUREMENT
/begin MEASUREMENT ZFEH_EepromData.ydiMemory_xau16[18].amb_cond.ambient_condition[0][11] "ambient condition shot [0 .. 2-1] with 25 data bytes [0 .. 25-1] for the error code stored in this error memory slot" UBYTE EH_STANDARD_S5_S3 1 100 0 255 DISPLAY_IDENTIFIER ambient_condition[0][11].amb_cond.ydiMemory_xau16[18].ZFEH_EepromData ECU_ADDRESS 0xFFF82D3B /end MEASUREMENT
/begin MEASUREMENT ZFEH_EepromData.ydiMemory_xau16[18].amb_cond.ambient_condition[0][12] "ambient condition shot [0 .. 2-1] with 25 data bytes [0 .. 25-1] for the error code stored in this error memory slot" UBYTE EH_STANDARD_S5_S3 1 100 0 255 DISPLAY_IDENTIFIER ambient_condition[0][12].amb_cond.ydiMemory_xau16[18].ZFEH_EepromData ECU_ADDRESS 0xFFF82D3C /end MEASUREMENT
/begin MEASUREMENT ZFEH_EepromData.ydiMemory_xau16[18].amb_cond.ambient_condition[0][13] "ambient condition shot [0 .. 2-1] with 25 data bytes [0 .. 25-1] for the error code stored in this error memory slot" UBYTE EH_STANDARD_S5_S3 1 100 0 255 DISPLAY_IDENTIFIER ambient_condition[0][13].amb_cond.ydiMemory_xau16[18].ZFEH_EepromData ECU_ADDRESS 0xFFF82D3D /end MEASUREMENT
/begin MEASUREMENT ZFEH_EepromData.ydiMemory_xau16[18].amb_cond.ambient_condition[0][14] "ambient condition shot [0 .. 2-1] with 25 data bytes [0 .. 25-1] for the error code stored in this error memory slot" UBYTE EH_STANDARD_S5_S3 1 100 0 255 DISPLAY_IDENTIFIER ambient_condition[0][14].amb_cond.ydiMemory_xau16[18].ZFEH_EepromData ECU_ADDRESS 0xFFF82D3E /end MEASUREMENT
/begin MEASUREMENT ZFEH_EepromData.ydiMemory_xau16[18].amb_cond.ambient_condition[0][15] "ambient condition shot [0 .. 2-1] with 25 data bytes [0 .. 25-1] for the error code stored in this error memory slot" UBYTE EH_STANDARD_S5_S3 1 100 0 255 DISPLAY_IDENTIFIER ambient_condition[0][15].amb_cond.ydiMemory_xau16[18].ZFEH_EepromData ECU_ADDRESS 0xFFF82D3F /end MEASUREMENT
/begin MEASUREMENT ZFEH_EepromData.ydiMemory_xau16[18].amb_cond.ambient_condition[0][16] "ambient condition shot [0 .. 2-1] with 25 data bytes [0 .. 25-1] for the error code stored in this error memory slot" UBYTE EH_STANDARD_S5_S3 1 100 0 255 DISPLAY_IDENTIFIER ambient_condition[0][16].amb_cond.ydiMemory_xau16[18].ZFEH_EepromData ECU_ADDRESS 0xFFF82D40 /end MEASUREMENT
/begin MEASUREMENT ZFEH_EepromData.ydiMemory_xau16[18].amb_cond.ambient_condition[0][17] "ambient condition shot [0 .. 2-1] with 25 data bytes [0 .. 25-1] for the error code stored in this error memory slot" UBYTE EH_STANDARD_S5_S3 1 100 0 255 DISPLAY_IDENTIFIER ambient_condition[0][17].amb_cond.ydiMemory_xau16[18].ZFEH_EepromData ECU_ADDRESS 0xFFF82D41 /end MEASUREMENT
/begin MEASUREMENT ZFEH_EepromData.ydiMemory_xau16[18].amb_cond.ambient_condition[0][18] "ambient condition shot [0 .. 2-1] with 25 data bytes [0 .. 25-1] for the error code stored in this error memory slot" UBYTE EH_STANDARD_S5_S3 1 100 0 255 DISPLAY_IDENTIFIER ambient_condition[0][18].amb_cond.ydiMemory_xau16[18].ZFEH_EepromData ECU_ADDRESS 0xFFF82D42 /end MEASUREMENT
/begin MEASUREMENT ZFEH_EepromData.ydiMemory_xau16[18].amb_cond.ambient_condition[0][19] "ambient condition shot [0 .. 2-1] with 25 data bytes [0 .. 25-1] for the error code stored in this error memory slot" UBYTE EH_STANDARD_S5_S3 1 100 0 255 DISPLAY_IDENTIFIER ambient_condition[0][19].amb_cond.ydiMemory_xau16[18].ZFEH_EepromData ECU_ADDRESS 0xFFF82D43 /end MEASUREMENT
/begin MEASUREMENT ZFEH_EepromData.ydiMemory_xau16[18].amb_cond.ambient_condition[0][20] "ambient condition shot [0 .. 2-1] with 25 data bytes [0 .. 25-1] for the error code stored in this error memory slot" UBYTE EH_STANDARD_S5_S3 1 100 0 255 DISPLAY_IDENTIFIER ambient_condition[0][20].amb_cond.ydiMemory_xau16[18].ZFEH_EepromData ECU_ADDRESS 0xFFF82D44 /end MEASUREMENT
/begin MEASUREMENT ZFEH_EepromData.ydiMemory_xau16[18].amb_cond.ambient_condition[0][21] "ambient condition shot [0 .. 2-1] with 25 data bytes [0 .. 25-1] for the error code stored in this error memory slot" UBYTE EH_STANDARD_S5_S3 1 100 0 255 DISPLAY_IDENTIFIER ambient_condition[0][21].amb_cond.ydiMemory_xau16[18].ZFEH_EepromData ECU_ADDRESS 0xFFF82D45 /end MEASUREMENT
/begin MEASUREMENT ZFEH_EepromData.ydiMemory_xau16[18].amb_cond.ambient_condition[0][22] "ambient condition shot [0 .. 2-1] with 25 data bytes [0 .. 25-1] for the error code stored in this error memory slot" UBYTE EH_STANDARD_S5_S3 1 100 0 255 DISPLAY_IDENTIFIER ambient_condition[0][22].amb_cond.ydiMemory_xau16[18].ZFEH_EepromData ECU_ADDRESS 0xFFF82D46 /end MEASUREMENT
/begin MEASUREMENT ZFEH_EepromData.ydiMemory_xau16[18].amb_cond.ambient_condition[0][23] "ambient condition shot [0 .. 2-1] with 25 data bytes [0 .. 25-1] for the error code stored in this error memory slot" UBYTE EH_STANDARD_S5_S3 1 100 0 255 DISPLAY_IDENTIFIER ambient_condition[0][23].amb_cond.ydiMemory_xau16[18].ZFEH_EepromData ECU_ADDRESS 0xFFF82D47 /end MEASUREMENT
/begin MEASUREMENT ZFEH_EepromData.ydiMemory_xau16[18].amb_cond.ambient_condition[0][24] "ambient condition shot [0 .. 2-1] with 25 data bytes [0 .. 25-1] for the error code stored in this error memory slot" UBYTE EH_STANDARD_S5_S3 1 100 0 255 DISPLAY_IDENTIFIER ambient_condition[0][24].amb_cond.ydiMemory_xau16[18].ZFEH_EepromData ECU_ADDRESS 0xFFF82D48 /end MEASUREMENT
/begin MEASUREMENT ZFEH_EepromData.ydiMemory_xau16[18].amb_cond.ambient_condition[1][0] "ambient condition shot [0 .. 2-1] with 25 data bytes [0 .. 25-1] for the error code stored in this error memory slot" UBYTE EH_STANDARD_S5_S3 1 100 0 255 DISPLAY_IDENTIFIER ambient_condition[1][0].amb_cond.ydiMemory_xau16[18].ZFEH_EepromData ECU_ADDRESS 0xFFF82D49 /end MEASUREMENT
/begin MEASUREMENT ZFEH_EepromData.ydiMemory_xau16[18].amb_cond.ambient_condition[1][1] "ambient condition shot [0 .. 2-1] with 25 data bytes [0 .. 25-1] for the error code stored in this error memory slot" UBYTE EH_STANDARD_S5_S3 1 100 0 255 DISPLAY_IDENTIFIER ambient_condition[1][1].amb_cond.ydiMemory_xau16[18].ZFEH_EepromData ECU_ADDRESS 0xFFF82D4A /end MEASUREMENT
/begin MEASUREMENT ZFEH_EepromData.ydiMemory_xau16[18].amb_cond.ambient_condition[1][2] "ambient condition shot [0 .. 2-1] with 25 data bytes [0 .. 25-1] for the error code stored in this error memory slot" UBYTE EH_STANDARD_S5_S3 1 100 0 255 DISPLAY_IDENTIFIER ambient_condition[1][2].amb_cond.ydiMemory_xau16[18].ZFEH_EepromData ECU_ADDRESS 0xFFF82D4B /end MEASUREMENT
/begin MEASUREMENT ZFEH_EepromData.ydiMemory_xau16[18].amb_cond.ambient_condition[1][3] "ambient condition shot [0 .. 2-1] with 25 data bytes [0 .. 25-1] for the error code stored in this error memory slot" UBYTE EH_STANDARD_S5_S3 1 100 0 255 DISPLAY_IDENTIFIER ambient_condition[1][3].amb_cond.ydiMemory_xau16[18].ZFEH_EepromData ECU_ADDRESS 0xFFF82D4C /end MEASUREMENT
/begin MEASUREMENT ZFEH_EepromData.ydiMemory_xau16[18].amb_cond.ambient_condition[1][4] "ambient condition shot [0 .. 2-1] with 25 data bytes [0 .. 25-1] for the error code stored in this error memory slot" UBYTE EH_STANDARD_S5_S3 1 100 0 255 DISPLAY_IDENTIFIER ambient_condition[1][4].amb_cond.ydiMemory_xau16[18].ZFEH_EepromData ECU_ADDRESS 0xFFF82D4D /end MEASUREMENT
/begin MEASUREMENT ZFEH_EepromData.ydiMemory_xau16[18].amb_cond.ambient_condition[1][5] "ambient condition shot [0 .. 2-1] with 25 data bytes [0 .. 25-1] for the error code stored in this error memory slot" UBYTE EH_STANDARD_S5_S3 1 100 0 255 DISPLAY_IDENTIFIER ambient_condition[1][5].amb_cond.ydiMemory_xau16[18].ZFEH_EepromData ECU_ADDRESS 0xFFF82D4E /end MEASUREMENT
/begin MEASUREMENT ZFEH_EepromData.ydiMemory_xau16[18].amb_cond.ambient_condition[1][6] "ambient condition shot [0 .. 2-1] with 25 data bytes [0 .. 25-1] for the error code stored in this error memory slot" UBYTE EH_STANDARD_S5_S3 1 100 0 255 DISPLAY_IDENTIFIER ambient_condition[1][6].amb_cond.ydiMemory_xau16[18].ZFEH_EepromData ECU_ADDRESS 0xFFF82D4F /end MEASUREMENT
/begin MEASUREMENT ZFEH_EepromData.ydiMemory_xau16[18].amb_cond.ambient_condition[1][7] "ambient condition shot [0 .. 2-1] with 25 data bytes [0 .. 25-1] for the error code stored in this error memory slot" UBYTE EH_STANDARD_S5_S3 1 100 0 255 DISPLAY_IDENTIFIER ambient_condition[1][7].amb_cond.ydiMemory_xau16[18].ZFEH_EepromData ECU_ADDRESS 0xFFF82D50 /end MEASUREMENT
/begin MEASUREMENT ZFEH_EepromData.ydiMemory_xau16[18].amb_cond.ambient_condition[1][8] "ambient condition shot [0 .. 2-1] with 25 data bytes [0 .. 25-1] for the error code stored in this error memory slot" UBYTE EH_STANDARD_S5_S3 1 100 0 255 DISPLAY_IDENTIFIER ambient_condition[1][8].amb_cond.ydiMemory_xau16[18].ZFEH_EepromData ECU_ADDRESS 0xFFF82D51 /end MEASUREMENT
/begin MEASUREMENT ZFEH_EepromData.ydiMemory_xau16[18].amb_cond.ambient_condition[1][9] "ambient condition shot [0 .. 2-1] with 25 data bytes [0 .. 25-1] for the error code stored in this error memory slot" UBYTE EH_STANDARD_S5_S3 1 100 0 255 DISPLAY_IDENTIFIER ambient_condition[1][9].amb_cond.ydiMemory_xau16[18].ZFEH_EepromData ECU_ADDRESS 0xFFF82D52 /end MEASUREMENT
/begin MEASUREMENT ZFEH_EepromData.ydiMemory_xau16[18].amb_cond.ambient_condition[1][10] "ambient condition shot [0 .. 2-1] with 25 data bytes [0 .. 25-1] for the error code stored in this error memory slot" UBYTE EH_STANDARD_S5_S3 1 100 0 255 DISPLAY_IDENTIFIER ambient_condition[1][10].amb_cond.ydiMemory_xau16[18].ZFEH_EepromData ECU_ADDRESS 0xFFF82D53 /end MEASUREMENT
/begin MEASUREMENT ZFEH_EepromData.ydiMemory_xau16[18].amb_cond.ambient_condition[1][11] "ambient condition shot [0 .. 2-1] with 25 data bytes [0 .. 25-1] for the error code stored in this error memory slot" UBYTE EH_STANDARD_S5_S3 1 100 0 255 DISPLAY_IDENTIFIER ambient_condition[1][11].amb_cond.ydiMemory_xau16[18].ZFEH_EepromData ECU_ADDRESS 0xFFF82D54 /end MEASUREMENT
/begin MEASUREMENT ZFEH_EepromData.ydiMemory_xau16[18].amb_cond.ambient_condition[1][12] "ambient condition shot [0 .. 2-1] with 25 data bytes [0 .. 25-1] for the error code stored in this error memory slot" UBYTE EH_STANDARD_S5_S3 1 100 0 255 DISPLAY_IDENTIFIER ambient_condition[1][12].amb_cond.ydiMemory_xau16[18].ZFEH_EepromData ECU_ADDRESS 0xFFF82D55 /end MEASUREMENT
/begin MEASUREMENT ZFEH_EepromData.ydiMemory_xau16[18].amb_cond.ambient_condition[1][13] "ambient condition shot [0 .. 2-1] with 25 data bytes [0 .. 25-1] for the error code stored in this error memory slot" UBYTE EH_STANDARD_S5_S3 1 100 0 255 DISPLAY_IDENTIFIER ambient_condition[1][13].amb_cond.ydiMemory_xau16[18].ZFEH_EepromData ECU_ADDRESS 0xFFF82D56 /end MEASUREMENT
/begin MEASUREMENT ZFEH_EepromData.ydiMemory_xau16[18].amb_cond.ambient_condition[1][14] "ambient condition shot [0 .. 2-1] with 25 data bytes [0 .. 25-1] for the error code stored in this error memory slot" UBYTE EH_STANDARD_S5_S3 1 100 0 255 DISPLAY_IDENTIFIER ambient_condition[1][14].amb_cond.ydiMemory_xau16[18].ZFEH_EepromData ECU_ADDRESS 0xFFF82D57 /end MEASUREMENT
/begin MEASUREMENT ZFEH_EepromData.ydiMemory_xau16[18].amb_cond.ambient_condition[1][15] "ambient condition shot [0 .. 2-1] with 25 data bytes [0 .. 25-1] for the error code stored in this error memory slot" UBYTE EH_STANDARD_S5_S3 1 100 0 255 DISPLAY_IDENTIFIER ambient_condition[1][15].amb_cond.ydiMemory_xau16[18].ZFEH_EepromData ECU_ADDRESS 0xFFF82D58 /end MEASUREMENT
/begin MEASUREMENT ZFEH_EepromData.ydiMemory_xau16[18].amb_cond.ambient_condition[1][16] "ambient condition shot [0 .. 2-1] with 25 data bytes [0 .. 25-1] for the error code stored in this error memory slot" UBYTE EH_STANDARD_S5_S3 1 100 0 255 DISPLAY_IDENTIFIER ambient_condition[1][16].amb_cond.ydiMemory_xau16[18].ZFEH_EepromData ECU_ADDRESS 0xFFF82D59 /end MEASUREMENT
/begin MEASUREMENT ZFEH_EepromData.ydiMemory_xau16[18].amb_cond.ambient_condition[1][17] "ambient condition shot [0 .. 2-1] with 25 data bytes [0 .. 25-1] for the error code stored in this error memory slot" UBYTE EH_STANDARD_S5_S3 1 100 0 255 DISPLAY_IDENTIFIER ambient_condition[1][17].amb_cond.ydiMemory_xau16[18].ZFEH_EepromData ECU_ADDRESS 0xFFF82D5A /end MEASUREMENT
/begin MEASUREMENT ZFEH_EepromData.ydiMemory_xau16[18].amb_cond.ambient_condition[1][18] "ambient condition shot [0 .. 2-1] with 25 data bytes [0 .. 25-1] for the error code stored in this error memory slot" UBYTE EH_STANDARD_S5_S3 1 100 0 255 DISPLAY_IDENTIFIER ambient_condition[1][18].amb_cond.ydiMemory_xau16[18].ZFEH_EepromData ECU_ADDRESS 0xFFF82D5B /end MEASUREMENT
/begin MEASUREMENT ZFEH_EepromData.ydiMemory_xau16[18].amb_cond.ambient_condition[1][19] "ambient condition shot [0 .. 2-1] with 25 data bytes [0 .. 25-1] for the error code stored in this error memory slot" UBYTE EH_STANDARD_S5_S3 1 100 0 255 DISPLAY_IDENTIFIER ambient_condition[1][19].amb_cond.ydiMemory_xau16[18].ZFEH_EepromData ECU_ADDRESS 0xFFF82D5C /end MEASUREMENT
/begin MEASUREMENT ZFEH_EepromData.ydiMemory_xau16[18].amb_cond.ambient_condition[1][20] "ambient condition shot [0 .. 2-1] with 25 data bytes [0 .. 25-1] for the error code stored in this error memory slot" UBYTE EH_STANDARD_S5_S3 1 100 0 255 DISPLAY_IDENTIFIER ambient_condition[1][20].amb_cond.ydiMemory_xau16[18].ZFEH_EepromData ECU_ADDRESS 0xFFF82D5D /end MEASUREMENT
/begin MEASUREMENT ZFEH_EepromData.ydiMemory_xau16[18].amb_cond.ambient_condition[1][21] "ambient condition shot [0 .. 2-1] with 25 data bytes [0 .. 25-1] for the error code stored in this error memory slot" UBYTE EH_STANDARD_S5_S3 1 100 0 255 DISPLAY_IDENTIFIER ambient_condition[1][21].amb_cond.ydiMemory_xau16[18].ZFEH_EepromData ECU_ADDRESS 0xFFF82D5E /end MEASUREMENT
/begin MEASUREMENT ZFEH_EepromData.ydiMemory_xau16[18].amb_cond.ambient_condition[1][22] "ambient condition shot [0 .. 2-1] with 25 data bytes [0 .. 25-1] for the error code stored in this error memory slot" UBYTE EH_STANDARD_S5_S3 1 100 0 255 DISPLAY_IDENTIFIER ambient_condition[1][22].amb_cond.ydiMemory_xau16[18].ZFEH_EepromData ECU_ADDRESS 0xFFF82D5F /end MEASUREMENT
/begin MEASUREMENT ZFEH_EepromData.ydiMemory_xau16[18].amb_cond.ambient_condition[1][23] "ambient condition shot [0 .. 2-1] with 25 data bytes [0 .. 25-1] for the error code stored in this error memory slot" UBYTE EH_STANDARD_S5_S3 1 100 0 255 DISPLAY_IDENTIFIER ambient_condition[1][23].amb_cond.ydiMemory_xau16[18].ZFEH_EepromData ECU_ADDRESS 0xFFF82D60 /end MEASUREMENT
/begin MEASUREMENT ZFEH_EepromData.ydiMemory_xau16[18].amb_cond.ambient_condition[1][24] "ambient condition shot [0 .. 2-1] with 25 data bytes [0 .. 25-1] for the error code stored in this error memory slot" UBYTE EH_STANDARD_S5_S3 1 100 0 255 DISPLAY_IDENTIFIER ambient_condition[1][24].amb_cond.ydiMemory_xau16[18].ZFEH_EepromData ECU_ADDRESS 0xFFF82D61 /end MEASUREMENT
/begin MEASUREMENT ZFEH_EepromData.ydiMemory_xau16[18].amb_cond.status_of_ambient_conditions[0] "status of ambient condition shot x: 0=invalid 1=valid" UBYTE EH_STANDARD_S5_S3 1 100 0 1 DISPLAY_IDENTIFIER status_of_ambient_conditions[0].amb_cond.ydiMemory_xau16[18].ZFEH_EepromData ECU_ADDRESS 0xFFF82D62 /end MEASUREMENT
/begin MEASUREMENT ZFEH_EepromData.ydiMemory_xau16[18].amb_cond.status_of_ambient_conditions[1] "status of ambient condition shot x: 0=invalid 1=valid" UBYTE EH_STANDARD_S5_S3 1 100 0 1 DISPLAY_IDENTIFIER status_of_ambient_conditions[1].amb_cond.ydiMemory_xau16[18].ZFEH_EepromData ECU_ADDRESS 0xFFF82D63 /end MEASUREMENT
/begin MEASUREMENT ZFEH_EepromData.ydiMemory_xau16[18].error_code "error code stored in error memory slot" UWORD CONV_KFC_NAME 0 255 0 65535 DISPLAY_IDENTIFIER error_code.ydiMemory_xau16[18].ZFEH_EepromData ECU_ADDRESS 0xFFF82D1C /end MEASUREMENT
/begin MEASUREMENT ZFEH_EepromData.ydiMemory_xau16[18].error_type "error type of error code stored in error memory slot" UWORD EH_STANDARD_S5_S3 1 100 0 65535 DISPLAY_IDENTIFIER error_type.ydiMemory_xau16[18].ZFEH_EepromData ECU_ADDRESS 0xFFF82D1E /end MEASUREMENT
/begin MEASUREMENT ZFEH_EepromData.ydiMemory_xau16[18].status_word "status word of error code stored in error memory slot" UWORD EH_STANDARD_S5_S3 1 100 0 65535 DISPLAY_IDENTIFIER status_word.ydiMemory_xau16[18].ZFEH_EepromData ECU_ADDRESS 0xFFF82D20 /end MEASUREMENT
/begin MEASUREMENT ZFEH_EepromData.ydiMemory_xau16[18].frequency_counter "frequency counter of error code stored in error memory slot" UBYTE EH_STANDARD_S5_S3 1 100 0 255 DISPLAY_IDENTIFIER frequency_counter.ydiMemory_xau16[18].ZFEH_EepromData ECU_ADDRESS 0xFFF82D22 /end MEASUREMENT
/begin MEASUREMENT ZFEH_EepromData.ydiMemory_xau16[18].backwards_counter "backwards counter of error code stored in error memory slot" UBYTE EH_STANDARD_S5_S3 1 100 0 255 DISPLAY_IDENTIFIER backwards_counter.ydiMemory_xau16[18].ZFEH_EepromData ECU_ADDRESS 0xFFF82D23 /end MEASUREMENT
/begin MEASUREMENT ZFEH_EepromData.ydiMemory_xau16[18].permanent_counter "counter of permanent error codes stored in error memory slot" UBYTE EH_STANDARD_S5_S3 1 100 0 255 DISPLAY_IDENTIFIER permanent_counter.ydiMemory_xau16[18].ZFEH_EepromData ECU_ADDRESS 0xFFF82D24 /end MEASUREMENT
/begin MEASUREMENT ZFEH_EepromData.ydiMemory_xau16[18].sequence_counter "sequence counter of error code stored in error memory slot" UBYTE EH_STANDARD_S5_S3 1 100 0 255 DISPLAY_IDENTIFIER sequence_counter.ydiMemory_xau16[18].ZFEH_EepromData ECU_ADDRESS 0xFFF82D25 /end MEASUREMENT
/begin MEASUREMENT ZFEH_EepromData.ydiMemory_xau16[18].master_time "master time of error code stored in error memory slot" ULONG EH_STANDARD_S5_S3 1 100 0 4294967295 DISPLAY_IDENTIFIER master_time.ydiMemory_xau16[18].ZFEH_EepromData ECU_ADDRESS 0xFFF82D28 /end MEASUREMENT
/begin MEASUREMENT ZFEH_EepromData.ydiMemory_xau16[18].condition_byte "condition byte of error code stored in error memory slot" UBYTE EH_STANDARD_S5_S3 1 100 0 255 DISPLAY_IDENTIFIER condition_byte.ydiMemory_xau16[18].ZFEH_EepromData ECU_ADDRESS 0xFFF82D2D /end MEASUREMENT
/begin MEASUREMENT ZFEH_EepromData.ydiMemory_xau16[18].obd_driving_cycle_counter "obd driving cycle counter of error code stored in error memory slot" UWORD EH_STANDARD_S5_S3 1 100 0 65535 DISPLAY_IDENTIFIER obd_driving_cycle_counter.ydiMemory_xau16[18].ZFEH_EepromData ECU_ADDRESS 0xFFF82D2E /end MEASUREMENT
/begin MEASUREMENT ZFEH_EepromData.ydiMemory_xau16[19].amb_cond.ambient_condition[0][0] "ambient condition shot [0 .. 2-1] with 25 data bytes [0 .. 25-1] for the error code stored in this error memory slot" UBYTE EH_STANDARD_S5_S3 1 100 0 255 DISPLAY_IDENTIFIER ambient_condition[0][0].amb_cond.ydiMemory_xau16[19].ZFEH_EepromData ECU_ADDRESS 0xFFF82D78 /end MEASUREMENT
/begin MEASUREMENT ZFEH_EepromData.ydiMemory_xau16[19].amb_cond.ambient_condition[0][1] "ambient condition shot [0 .. 2-1] with 25 data bytes [0 .. 25-1] for the error code stored in this error memory slot" UBYTE EH_STANDARD_S5_S3 1 100 0 255 DISPLAY_IDENTIFIER ambient_condition[0][1].amb_cond.ydiMemory_xau16[19].ZFEH_EepromData ECU_ADDRESS 0xFFF82D79 /end MEASUREMENT
/begin MEASUREMENT ZFEH_EepromData.ydiMemory_xau16[19].amb_cond.ambient_condition[0][2] "ambient condition shot [0 .. 2-1] with 25 data bytes [0 .. 25-1] for the error code stored in this error memory slot" UBYTE EH_STANDARD_S5_S3 1 100 0 255 DISPLAY_IDENTIFIER ambient_condition[0][2].amb_cond.ydiMemory_xau16[19].ZFEH_EepromData ECU_ADDRESS 0xFFF82D7A /end MEASUREMENT
/begin MEASUREMENT ZFEH_EepromData.ydiMemory_xau16[19].amb_cond.ambient_condition[0][3] "ambient condition shot [0 .. 2-1] with 25 data bytes [0 .. 25-1] for the error code stored in this error memory slot" UBYTE EH_STANDARD_S5_S3 1 100 0 255 DISPLAY_IDENTIFIER ambient_condition[0][3].amb_cond.ydiMemory_xau16[19].ZFEH_EepromData ECU_ADDRESS 0xFFF82D7B /end MEASUREMENT
/begin MEASUREMENT ZFEH_EepromData.ydiMemory_xau16[19].amb_cond.ambient_condition[0][4] "ambient condition shot [0 .. 2-1] with 25 data bytes [0 .. 25-1] for the error code stored in this error memory slot" UBYTE EH_STANDARD_S5_S3 1 100 0 255 DISPLAY_IDENTIFIER ambient_condition[0][4].amb_cond.ydiMemory_xau16[19].ZFEH_EepromData ECU_ADDRESS 0xFFF82D7C /end MEASUREMENT
/begin MEASUREMENT ZFEH_EepromData.ydiMemory_xau16[19].amb_cond.ambient_condition[0][5] "ambient condition shot [0 .. 2-1] with 25 data bytes [0 .. 25-1] for the error code stored in this error memory slot" UBYTE EH_STANDARD_S5_S3 1 100 0 255 DISPLAY_IDENTIFIER ambient_condition[0][5].amb_cond.ydiMemory_xau16[19].ZFEH_EepromData ECU_ADDRESS 0xFFF82D7D /end MEASUREMENT
/begin MEASUREMENT ZFEH_EepromData.ydiMemory_xau16[19].amb_cond.ambient_condition[0][6] "ambient condition shot [0 .. 2-1] with 25 data bytes [0 .. 25-1] for the error code stored in this error memory slot" UBYTE EH_STANDARD_S5_S3 1 100 0 255 DISPLAY_IDENTIFIER ambient_condition[0][6].amb_cond.ydiMemory_xau16[19].ZFEH_EepromData ECU_ADDRESS 0xFFF82D7E /end MEASUREMENT
/begin MEASUREMENT ZFEH_EepromData.ydiMemory_xau16[19].amb_cond.ambient_condition[0][7] "ambient condition shot [0 .. 2-1] with 25 data bytes [0 .. 25-1] for the error code stored in this error memory slot" UBYTE EH_STANDARD_S5_S3 1 100 0 255 DISPLAY_IDENTIFIER ambient_condition[0][7].amb_cond.ydiMemory_xau16[19].ZFEH_EepromData ECU_ADDRESS 0xFFF82D7F /end MEASUREMENT
/begin MEASUREMENT ZFEH_EepromData.ydiMemory_xau16[19].amb_cond.ambient_condition[0][8] "ambient condition shot [0 .. 2-1] with 25 data bytes [0 .. 25-1] for the error code stored in this error memory slot" UBYTE EH_STANDARD_S5_S3 1 100 0 255 DISPLAY_IDENTIFIER ambient_condition[0][8].amb_cond.ydiMemory_xau16[19].ZFEH_EepromData ECU_ADDRESS 0xFFF82D80 /end MEASUREMENT
/begin MEASUREMENT ZFEH_EepromData.ydiMemory_xau16[19].amb_cond.ambient_condition[0][9] "ambient condition shot [0 .. 2-1] with 25 data bytes [0 .. 25-1] for the error code stored in this error memory slot" UBYTE EH_STANDARD_S5_S3 1 100 0 255 DISPLAY_IDENTIFIER ambient_condition[0][9].amb_cond.ydiMemory_xau16[19].ZFEH_EepromData ECU_ADDRESS 0xFFF82D81 /end MEASUREMENT
/begin MEASUREMENT ZFEH_EepromData.ydiMemory_xau16[19].amb_cond.ambient_condition[0][10] "ambient condition shot [0 .. 2-1] with 25 data bytes [0 .. 25-1] for the error code stored in this error memory slot" UBYTE EH_STANDARD_S5_S3 1 100 0 255 DISPLAY_IDENTIFIER ambient_condition[0][10].amb_cond.ydiMemory_xau16[19].ZFEH_EepromData ECU_ADDRESS 0xFFF82D82 /end MEASUREMENT
/begin MEASUREMENT ZFEH_EepromData.ydiMemory_xau16[19].amb_cond.ambient_condition[0][11] "ambient condition shot [0 .. 2-1] with 25 data bytes [0 .. 25-1] for the error code stored in this error memory slot" UBYTE EH_STANDARD_S5_S3 1 100 0 255 DISPLAY_IDENTIFIER ambient_condition[0][11].amb_cond.ydiMemory_xau16[19].ZFEH_EepromData ECU_ADDRESS 0xFFF82D83 /end MEASUREMENT
/begin MEASUREMENT ZFEH_EepromData.ydiMemory_xau16[19].amb_cond.ambient_condition[0][12] "ambient condition shot [0 .. 2-1] with 25 data bytes [0 .. 25-1] for the error code stored in this error memory slot" UBYTE EH_STANDARD_S5_S3 1 100 0 255 DISPLAY_IDENTIFIER ambient_condition[0][12].amb_cond.ydiMemory_xau16[19].ZFEH_EepromData ECU_ADDRESS 0xFFF82D84 /end MEASUREMENT
/begin MEASUREMENT ZFEH_EepromData.ydiMemory_xau16[19].amb_cond.ambient_condition[0][13] "ambient condition shot [0 .. 2-1] with 25 data bytes [0 .. 25-1] for the error code stored in this error memory slot" UBYTE EH_STANDARD_S5_S3 1 100 0 255 DISPLAY_IDENTIFIER ambient_condition[0][13].amb_cond.ydiMemory_xau16[19].ZFEH_EepromData ECU_ADDRESS 0xFFF82D85 /end MEASUREMENT
/begin MEASUREMENT ZFEH_EepromData.ydiMemory_xau16[19].amb_cond.ambient_condition[0][14] "ambient condition shot [0 .. 2-1] with 25 data bytes [0 .. 25-1] for the error code stored in this error memory slot" UBYTE EH_STANDARD_S5_S3 1 100 0 255 DISPLAY_IDENTIFIER ambient_condition[0][14].amb_cond.ydiMemory_xau16[19].ZFEH_EepromData ECU_ADDRESS 0xFFF82D86 /end MEASUREMENT
/begin MEASUREMENT ZFEH_EepromData.ydiMemory_xau16[19].amb_cond.ambient_condition[0][15] "ambient condition shot [0 .. 2-1] with 25 data bytes [0 .. 25-1] for the error code stored in this error memory slot" UBYTE EH_STANDARD_S5_S3 1 100 0 255 DISPLAY_IDENTIFIER ambient_condition[0][15].amb_cond.ydiMemory_xau16[19].ZFEH_EepromData ECU_ADDRESS 0xFFF82D87 /end MEASUREMENT
/begin MEASUREMENT ZFEH_EepromData.ydiMemory_xau16[19].amb_cond.ambient_condition[0][16] "ambient condition shot [0 .. 2-1] with 25 data bytes [0 .. 25-1] for the error code stored in this error memory slot" UBYTE EH_STANDARD_S5_S3 1 100 0 255 DISPLAY_IDENTIFIER ambient_condition[0][16].amb_cond.ydiMemory_xau16[19].ZFEH_EepromData ECU_ADDRESS 0xFFF82D88 /end MEASUREMENT
/begin MEASUREMENT ZFEH_EepromData.ydiMemory_xau16[19].amb_cond.ambient_condition[0][17] "ambient condition shot [0 .. 2-1] with 25 data bytes [0 .. 25-1] for the error code stored in this error memory slot" UBYTE EH_STANDARD_S5_S3 1 100 0 255 DISPLAY_IDENTIFIER ambient_condition[0][17].amb_cond.ydiMemory_xau16[19].ZFEH_EepromData ECU_ADDRESS 0xFFF82D89 /end MEASUREMENT
/begin MEASUREMENT ZFEH_EepromData.ydiMemory_xau16[19].amb_cond.ambient_condition[0][18] "ambient condition shot [0 .. 2-1] with 25 data bytes [0 .. 25-1] for the error code stored in this error memory slot" UBYTE EH_STANDARD_S5_S3 1 100 0 255 DISPLAY_IDENTIFIER ambient_condition[0][18].amb_cond.ydiMemory_xau16[19].ZFEH_EepromData ECU_ADDRESS 0xFFF82D8A /end MEASUREMENT
/begin MEASUREMENT ZFEH_EepromData.ydiMemory_xau16[19].amb_cond.ambient_condition[0][19] "ambient condition shot [0 .. 2-1] with 25 data bytes [0 .. 25-1] for the error code stored in this error memory slot" UBYTE EH_STANDARD_S5_S3 1 100 0 255 DISPLAY_IDENTIFIER ambient_condition[0][19].amb_cond.ydiMemory_xau16[19].ZFEH_EepromData ECU_ADDRESS 0xFFF82D8B /end MEASUREMENT
/begin MEASUREMENT ZFEH_EepromData.ydiMemory_xau16[19].amb_cond.ambient_condition[0][20] "ambient condition shot [0 .. 2-1] with 25 data bytes [0 .. 25-1] for the error code stored in this error memory slot" UBYTE EH_STANDARD_S5_S3 1 100 0 255 DISPLAY_IDENTIFIER ambient_condition[0][20].amb_cond.ydiMemory_xau16[19].ZFEH_EepromData ECU_ADDRESS 0xFFF82D8C /end MEASUREMENT
/begin MEASUREMENT ZFEH_EepromData.ydiMemory_xau16[19].amb_cond.ambient_condition[0][21] "ambient condition shot [0 .. 2-1] with 25 data bytes [0 .. 25-1] for the error code stored in this error memory slot" UBYTE EH_STANDARD_S5_S3 1 100 0 255 DISPLAY_IDENTIFIER ambient_condition[0][21].amb_cond.ydiMemory_xau16[19].ZFEH_EepromData ECU_ADDRESS 0xFFF82D8D /end MEASUREMENT
/begin MEASUREMENT ZFEH_EepromData.ydiMemory_xau16[19].amb_cond.ambient_condition[0][22] "ambient condition shot [0 .. 2-1] with 25 data bytes [0 .. 25-1] for the error code stored in this error memory slot" UBYTE EH_STANDARD_S5_S3 1 100 0 255 DISPLAY_IDENTIFIER ambient_condition[0][22].amb_cond.ydiMemory_xau16[19].ZFEH_EepromData ECU_ADDRESS 0xFFF82D8E /end MEASUREMENT
/begin MEASUREMENT ZFEH_EepromData.ydiMemory_xau16[19].amb_cond.ambient_condition[0][23] "ambient condition shot [0 .. 2-1] with 25 data bytes [0 .. 25-1] for the error code stored in this error memory slot" UBYTE EH_STANDARD_S5_S3 1 100 0 255 DISPLAY_IDENTIFIER ambient_condition[0][23].amb_cond.ydiMemory_xau16[19].ZFEH_EepromData ECU_ADDRESS 0xFFF82D8F /end MEASUREMENT
/begin MEASUREMENT ZFEH_EepromData.ydiMemory_xau16[19].amb_cond.ambient_condition[0][24] "ambient condition shot [0 .. 2-1] with 25 data bytes [0 .. 25-1] for the error code stored in this error memory slot" UBYTE EH_STANDARD_S5_S3 1 100 0 255 DISPLAY_IDENTIFIER ambient_condition[0][24].amb_cond.ydiMemory_xau16[19].ZFEH_EepromData ECU_ADDRESS 0xFFF82D90 /end MEASUREMENT
/begin MEASUREMENT ZFEH_EepromData.ydiMemory_xau16[19].amb_cond.ambient_condition[1][0] "ambient condition shot [0 .. 2-1] with 25 data bytes [0 .. 25-1] for the error code stored in this error memory slot" UBYTE EH_STANDARD_S5_S3 1 100 0 255 DISPLAY_IDENTIFIER ambient_condition[1][0].amb_cond.ydiMemory_xau16[19].ZFEH_EepromData ECU_ADDRESS 0xFFF82D91 /end MEASUREMENT
/begin MEASUREMENT ZFEH_EepromData.ydiMemory_xau16[19].amb_cond.ambient_condition[1][1] "ambient condition shot [0 .. 2-1] with 25 data bytes [0 .. 25-1] for the error code stored in this error memory slot" UBYTE EH_STANDARD_S5_S3 1 100 0 255 DISPLAY_IDENTIFIER ambient_condition[1][1].amb_cond.ydiMemory_xau16[19].ZFEH_EepromData ECU_ADDRESS 0xFFF82D92 /end MEASUREMENT
/begin MEASUREMENT ZFEH_EepromData.ydiMemory_xau16[19].amb_cond.ambient_condition[1][2] "ambient condition shot [0 .. 2-1] with 25 data bytes [0 .. 25-1] for the error code stored in this error memory slot" UBYTE EH_STANDARD_S5_S3 1 100 0 255 DISPLAY_IDENTIFIER ambient_condition[1][2].amb_cond.ydiMemory_xau16[19].ZFEH_EepromData ECU_ADDRESS 0xFFF82D93 /end MEASUREMENT
/begin MEASUREMENT ZFEH_EepromData.ydiMemory_xau16[19].amb_cond.ambient_condition[1][3] "ambient condition shot [0 .. 2-1] with 25 data bytes [0 .. 25-1] for the error code stored in this error memory slot" UBYTE EH_STANDARD_S5_S3 1 100 0 255 DISPLAY_IDENTIFIER ambient_condition[1][3].amb_cond.ydiMemory_xau16[19].ZFEH_EepromData ECU_ADDRESS 0xFFF82D94 /end MEASUREMENT
/begin MEASUREMENT ZFEH_EepromData.ydiMemory_xau16[19].amb_cond.ambient_condition[1][4] "ambient condition shot [0 .. 2-1] with 25 data bytes [0 .. 25-1] for the error code stored in this error memory slot" UBYTE EH_STANDARD_S5_S3 1 100 0 255 DISPLAY_IDENTIFIER ambient_condition[1][4].amb_cond.ydiMemory_xau16[19].ZFEH_EepromData ECU_ADDRESS 0xFFF82D95 /end MEASUREMENT
/begin MEASUREMENT ZFEH_EepromData.ydiMemory_xau16[19].amb_cond.ambient_condition[1][5] "ambient condition shot [0 .. 2-1] with 25 data bytes [0 .. 25-1] for the error code stored in this error memory slot" UBYTE EH_STANDARD_S5_S3 1 100 0 255 DISPLAY_IDENTIFIER ambient_condition[1][5].amb_cond.ydiMemory_xau16[19].ZFEH_EepromData ECU_ADDRESS 0xFFF82D96 /end MEASUREMENT
/begin MEASUREMENT ZFEH_EepromData.ydiMemory_xau16[19].amb_cond.ambient_condition[1][6] "ambient condition shot [0 .. 2-1] with 25 data bytes [0 .. 25-1] for the error code stored in this error memory slot" UBYTE EH_STANDARD_S5_S3 1 100 0 255 DISPLAY_IDENTIFIER ambient_condition[1][6].amb_cond.ydiMemory_xau16[19].ZFEH_EepromData ECU_ADDRESS 0xFFF82D97 /end MEASUREMENT
/begin MEASUREMENT ZFEH_EepromData.ydiMemory_xau16[19].amb_cond.ambient_condition[1][7] "ambient condition shot [0 .. 2-1] with 25 data bytes [0 .. 25-1] for the error code stored in this error memory slot" UBYTE EH_STANDARD_S5_S3 1 100 0 255 DISPLAY_IDENTIFIER ambient_condition[1][7].amb_cond.ydiMemory_xau16[19].ZFEH_EepromData ECU_ADDRESS 0xFFF82D98 /end MEASUREMENT
/begin MEASUREMENT ZFEH_EepromData.ydiMemory_xau16[19].amb_cond.ambient_condition[1][8] "ambient condition shot [0 .. 2-1] with 25 data bytes [0 .. 25-1] for the error code stored in this error memory slot" UBYTE EH_STANDARD_S5_S3 1 100 0 255 DISPLAY_IDENTIFIER ambient_condition[1][8].amb_cond.ydiMemory_xau16[19].ZFEH_EepromData ECU_ADDRESS 0xFFF82D99 /end MEASUREMENT
/begin MEASUREMENT ZFEH_EepromData.ydiMemory_xau16[19].amb_cond.ambient_condition[1][9] "ambient condition shot [0 .. 2-1] with 25 data bytes [0 .. 25-1] for the error code stored in this error memory slot" UBYTE EH_STANDARD_S5_S3 1 100 0 255 DISPLAY_IDENTIFIER ambient_condition[1][9].amb_cond.ydiMemory_xau16[19].ZFEH_EepromData ECU_ADDRESS 0xFFF82D9A /end MEASUREMENT
/begin MEASUREMENT ZFEH_EepromData.ydiMemory_xau16[19].amb_cond.ambient_condition[1][10] "ambient condition shot [0 .. 2-1] with 25 data bytes [0 .. 25-1] for the error code stored in this error memory slot" UBYTE EH_STANDARD_S5_S3 1 100 0 255 DISPLAY_IDENTIFIER ambient_condition[1][10].amb_cond.ydiMemory_xau16[19].ZFEH_EepromData ECU_ADDRESS 0xFFF82D9B /end MEASUREMENT
/begin MEASUREMENT ZFEH_EepromData.ydiMemory_xau16[19].amb_cond.ambient_condition[1][11] "ambient condition shot [0 .. 2-1] with 25 data bytes [0 .. 25-1] for the error code stored in this error memory slot" UBYTE EH_STANDARD_S5_S3 1 100 0 255 DISPLAY_IDENTIFIER ambient_condition[1][11].amb_cond.ydiMemory_xau16[19].ZFEH_EepromData ECU_ADDRESS 0xFFF82D9C /end MEASUREMENT
/begin MEASUREMENT ZFEH_EepromData.ydiMemory_xau16[19].amb_cond.ambient_condition[1][12] "ambient condition shot [0 .. 2-1] with 25 data bytes [0 .. 25-1] for the error code stored in this error memory slot" UBYTE EH_STANDARD_S5_S3 1 100 0 255 DISPLAY_IDENTIFIER ambient_condition[1][12].amb_cond.ydiMemory_xau16[19].ZFEH_EepromData ECU_ADDRESS 0xFFF82D9D /end MEASUREMENT
/begin MEASUREMENT ZFEH_EepromData.ydiMemory_xau16[19].amb_cond.ambient_condition[1][13] "ambient condition shot [0 .. 2-1] with 25 data bytes [0 .. 25-1] for the error code stored in this error memory slot" UBYTE EH_STANDARD_S5_S3 1 100 0 255 DISPLAY_IDENTIFIER ambient_condition[1][13].amb_cond.ydiMemory_xau16[19].ZFEH_EepromData ECU_ADDRESS 0xFFF82D9E /end MEASUREMENT
/begin MEASUREMENT ZFEH_EepromData.ydiMemory_xau16[19].amb_cond.ambient_condition[1][14] "ambient condition shot [0 .. 2-1] with 25 data bytes [0 .. 25-1] for the error code stored in this error memory slot" UBYTE EH_STANDARD_S5_S3 1 100 0 255 DISPLAY_IDENTIFIER ambient_condition[1][14].amb_cond.ydiMemory_xau16[19].ZFEH_EepromData ECU_ADDRESS 0xFFF82D9F /end MEASUREMENT
/begin MEASUREMENT ZFEH_EepromData.ydiMemory_xau16[19].amb_cond.ambient_condition[1][15] "ambient condition shot [0 .. 2-1] with 25 data bytes [0 .. 25-1] for the error code stored in this error memory slot" UBYTE EH_STANDARD_S5_S3 1 100 0 255 DISPLAY_IDENTIFIER ambient_condition[1][15].amb_cond.ydiMemory_xau16[19].ZFEH_EepromData ECU_ADDRESS 0xFFF82DA0 /end MEASUREMENT
/begin MEASUREMENT ZFEH_EepromData.ydiMemory_xau16[19].amb_cond.ambient_condition[1][16] "ambient condition shot [0 .. 2-1] with 25 data bytes [0 .. 25-1] for the error code stored in this error memory slot" UBYTE EH_STANDARD_S5_S3 1 100 0 255 DISPLAY_IDENTIFIER ambient_condition[1][16].amb_cond.ydiMemory_xau16[19].ZFEH_EepromData ECU_ADDRESS 0xFFF82DA1 /end MEASUREMENT
/begin MEASUREMENT ZFEH_EepromData.ydiMemory_xau16[19].amb_cond.ambient_condition[1][17] "ambient condition shot [0 .. 2-1] with 25 data bytes [0 .. 25-1] for the error code stored in this error memory slot" UBYTE EH_STANDARD_S5_S3 1 100 0 255 DISPLAY_IDENTIFIER ambient_condition[1][17].amb_cond.ydiMemory_xau16[19].ZFEH_EepromData ECU_ADDRESS 0xFFF82DA2 /end MEASUREMENT
/begin MEASUREMENT ZFEH_EepromData.ydiMemory_xau16[19].amb_cond.ambient_condition[1][18] "ambient condition shot [0 .. 2-1] with 25 data bytes [0 .. 25-1] for the error code stored in this error memory slot" UBYTE EH_STANDARD_S5_S3 1 100 0 255 DISPLAY_IDENTIFIER ambient_condition[1][18].amb_cond.ydiMemory_xau16[19].ZFEH_EepromData ECU_ADDRESS 0xFFF82DA3 /end MEASUREMENT
/begin MEASUREMENT ZFEH_EepromData.ydiMemory_xau16[19].amb_cond.ambient_condition[1][19] "ambient condition shot [0 .. 2-1] with 25 data bytes [0 .. 25-1] for the error code stored in this error memory slot" UBYTE EH_STANDARD_S5_S3 1 100 0 255 DISPLAY_IDENTIFIER ambient_condition[1][19].amb_cond.ydiMemory_xau16[19].ZFEH_EepromData ECU_ADDRESS 0xFFF82DA4 /end MEASUREMENT
/begin MEASUREMENT ZFEH_EepromData.ydiMemory_xau16[19].amb_cond.ambient_condition[1][20] "ambient condition shot [0 .. 2-1] with 25 data bytes [0 .. 25-1] for the error code stored in this error memory slot" UBYTE EH_STANDARD_S5_S3 1 100 0 255 DISPLAY_IDENTIFIER ambient_condition[1][20].amb_cond.ydiMemory_xau16[19].ZFEH_EepromData ECU_ADDRESS 0xFFF82DA5 /end MEASUREMENT
/begin MEASUREMENT ZFEH_EepromData.ydiMemory_xau16[19].amb_cond.ambient_condition[1][21] "ambient condition shot [0 .. 2-1] with 25 data bytes [0 .. 25-1] for the error code stored in this error memory slot" UBYTE EH_STANDARD_S5_S3 1 100 0 255 DISPLAY_IDENTIFIER ambient_condition[1][21].amb_cond.ydiMemory_xau16[19].ZFEH_EepromData ECU_ADDRESS 0xFFF82DA6 /end MEASUREMENT
/begin MEASUREMENT ZFEH_EepromData.ydiMemory_xau16[19].amb_cond.ambient_condition[1][22] "ambient condition shot [0 .. 2-1] with 25 data bytes [0 .. 25-1] for the error code stored in this error memory slot" UBYTE EH_STANDARD_S5_S3 1 100 0 255 DISPLAY_IDENTIFIER ambient_condition[1][22].amb_cond.ydiMemory_xau16[19].ZFEH_EepromData ECU_ADDRESS 0xFFF82DA7 /end MEASUREMENT
/begin MEASUREMENT ZFEH_EepromData.ydiMemory_xau16[19].amb_cond.ambient_condition[1][23] "ambient condition shot [0 .. 2-1] with 25 data bytes [0 .. 25-1] for the error code stored in this error memory slot" UBYTE EH_STANDARD_S5_S3 1 100 0 255 DISPLAY_IDENTIFIER ambient_condition[1][23].amb_cond.ydiMemory_xau16[19].ZFEH_EepromData ECU_ADDRESS 0xFFF82DA8 /end MEASUREMENT
/begin MEASUREMENT ZFEH_EepromData.ydiMemory_xau16[19].amb_cond.ambient_condition[1][24] "ambient condition shot [0 .. 2-1] with 25 data bytes [0 .. 25-1] for the error code stored in this error memory slot" UBYTE EH_STANDARD_S5_S3 1 100 0 255 DISPLAY_IDENTIFIER ambient_condition[1][24].amb_cond.ydiMemory_xau16[19].ZFEH_EepromData ECU_ADDRESS 0xFFF82DA9 /end MEASUREMENT
/begin MEASUREMENT ZFEH_EepromData.ydiMemory_xau16[19].amb_cond.status_of_ambient_conditions[0] "status of ambient condition shot x: 0=invalid 1=valid" UBYTE EH_STANDARD_S5_S3 1 100 0 1 DISPLAY_IDENTIFIER status_of_ambient_conditions[0].amb_cond.ydiMemory_xau16[19].ZFEH_EepromData ECU_ADDRESS 0xFFF82DAA /end MEASUREMENT
/begin MEASUREMENT ZFEH_EepromData.ydiMemory_xau16[19].amb_cond.status_of_ambient_conditions[1] "status of ambient condition shot x: 0=invalid 1=valid" UBYTE EH_STANDARD_S5_S3 1 100 0 1 DISPLAY_IDENTIFIER status_of_ambient_conditions[1].amb_cond.ydiMemory_xau16[19].ZFEH_EepromData ECU_ADDRESS 0xFFF82DAB /end MEASUREMENT
/begin MEASUREMENT ZFEH_EepromData.ydiMemory_xau16[19].error_code "error code stored in error memory slot" UWORD CONV_KFC_NAME 0 255 0 65535 DISPLAY_IDENTIFIER error_code.ydiMemory_xau16[19].ZFEH_EepromData ECU_ADDRESS 0xFFF82D64 /end MEASUREMENT
/begin MEASUREMENT ZFEH_EepromData.ydiMemory_xau16[19].error_type "error type of error code stored in error memory slot" UWORD EH_STANDARD_S5_S3 1 100 0 65535 DISPLAY_IDENTIFIER error_type.ydiMemory_xau16[19].ZFEH_EepromData ECU_ADDRESS 0xFFF82D66 /end MEASUREMENT
/begin MEASUREMENT ZFEH_EepromData.ydiMemory_xau16[19].status_word "status word of error code stored in error memory slot" UWORD EH_STANDARD_S5_S3 1 100 0 65535 DISPLAY_IDENTIFIER status_word.ydiMemory_xau16[19].ZFEH_EepromData ECU_ADDRESS 0xFFF82D68 /end MEASUREMENT
/begin MEASUREMENT ZFEH_EepromData.ydiMemory_xau16[19].frequency_counter "frequency counter of error code stored in error memory slot" UBYTE EH_STANDARD_S5_S3 1 100 0 255 DISPLAY_IDENTIFIER frequency_counter.ydiMemory_xau16[19].ZFEH_EepromData ECU_ADDRESS 0xFFF82D6A /end MEASUREMENT
/begin MEASUREMENT ZFEH_EepromData.ydiMemory_xau16[19].backwards_counter "backwards counter of error code stored in error memory slot" UBYTE EH_STANDARD_S5_S3 1 100 0 255 DISPLAY_IDENTIFIER backwards_counter.ydiMemory_xau16[19].ZFEH_EepromData ECU_ADDRESS 0xFFF82D6B /end MEASUREMENT
/begin MEASUREMENT ZFEH_EepromData.ydiMemory_xau16[19].permanent_counter "counter of permanent error codes stored in error memory slot" UBYTE EH_STANDARD_S5_S3 1 100 0 255 DISPLAY_IDENTIFIER permanent_counter.ydiMemory_xau16[19].ZFEH_EepromData ECU_ADDRESS 0xFFF82D6C /end MEASUREMENT
/begin MEASUREMENT ZFEH_EepromData.ydiMemory_xau16[19].sequence_counter "sequence counter of error code stored in error memory slot" UBYTE EH_STANDARD_S5_S3 1 100 0 255 DISPLAY_IDENTIFIER sequence_counter.ydiMemory_xau16[19].ZFEH_EepromData ECU_ADDRESS 0xFFF82D6D /end MEASUREMENT
/begin MEASUREMENT ZFEH_EepromData.ydiMemory_xau16[19].master_time "master time of error code stored in error memory slot" ULONG EH_STANDARD_S5_S3 1 100 0 4294967295 DISPLAY_IDENTIFIER master_time.ydiMemory_xau16[19].ZFEH_EepromData ECU_ADDRESS 0xFFF82D70 /end MEASUREMENT
/begin MEASUREMENT ZFEH_EepromData.ydiMemory_xau16[19].condition_byte "condition byte of error code stored in error memory slot" UBYTE EH_STANDARD_S5_S3 1 100 0 255 DISPLAY_IDENTIFIER condition_byte.ydiMemory_xau16[19].ZFEH_EepromData ECU_ADDRESS 0xFFF82D75 /end MEASUREMENT
/begin MEASUREMENT ZFEH_EepromData.ydiMemory_xau16[19].obd_driving_cycle_counter "obd driving cycle counter of error code stored in error memory slot" UWORD EH_STANDARD_S5_S3 1 100 0 65535 DISPLAY_IDENTIFIER obd_driving_cycle_counter.ydiMemory_xau16[19].ZFEH_EepromData ECU_ADDRESS 0xFFF82D76 /end MEASUREMENT
/begin COMPU_METHOD CONV_KFC_NAME "" TAB_VERB "%6.3" "" COMPU_TAB_REF CONV_TAB_KFC_NAME /end COMPU_METHOD
/begin COMPU_METHOD EH_STANDARD_S5_S3 "int = ((phys * 1) / 1) - (0) -" RAT_FUNC "%2.0" "-" COEFFS 0 1 -0 0 0 1 /end COMPU_METHOD
/begin COMPU_VTAB CONV_TAB_KFC_NAME "Conversion table" TAB_VERB 256 0 "empty" 1 "KFC1_OUT0" 2 "KFC2_OUT0" 3 "KFC1_OUT1" 4 "KFC2_OUT1" 5 "KFC1_OUT2" 6 "KFC2_OUT2" 7 "KFC1_OUT3" 8 "KFC2_OUT3" 9 "KFC1_OUT4" 10 "KFC2_OUT4" 11 "KFC1_OUT5" 12 "KFC2_OUT5" 13 "KFC1_OUT6" 14 "KFC2_OUT6" 15 "KFC1_OUT7" 16 "KFC2_OUT7" 17 "KFC1_OUT8" 18 "KFC2_OUT8" 19 "KFC1_OUT9" 20 "KFC2_OUT9" 21 "KFC1_OUT10" 22 "KFC2_OUT10" 23 "KFC1_OUT11" 24 "KFC2_OUT11" 25 "KFC1_OUT12" 26 "KFC2_OUT12" 27 "KFC1_OUT13" 28 "KFC2_OUT13" 29 "KFC1_OUT14" 30 "KFC2_OUT14" 31 "KFC_UDRMV1" 32 "KFC_UDRMV2" 33 "KFC_USENS1" 34 "KFC_RESUNDERVOLTAGE" 35 "KFC_RESSUP" 36 "KFC_RESZF" 37 "KFC_EEPROM" 38 "KFC_DISABLEERM" 39 "KFC_EPROM" 40 "KFC_N6PLAUSILEV2" 41 "KFC_TCUHOT" 42 "KFC_SFRM" 43 "KFC1_POSLEV2" 44 "KFC2_POSLEV2" 45 "KFC3_POSLEV2" 46 "KFC4_POSLEV2" 47 "KFC_NTUVIRTLEV2" 48 "KFC_SENSORLEV2" 49 "KFC_WDOG" 50 "KFC_MCCOMP" 51 "KFC_LEV2" 52 "KFC1_LEV2" 53 "KFC_VUNPLAUSILEV2" 54 "KFC3_LEV2" 55 "KFC_RATIOGEAR" 56 "KFC_RATIOA" 57 "KFC_RATIOB" 58 "KFC_RATIOC" 59 "KFC_RATIOD" 60 "KFC_RATIOE" 61 "KFC_RATIOAB" 62 "KFC_RATIOAD" 63 "KFC_RATIOBD" 64 "KFC_RATIOBE" 65 "KFC_RATIOCD" 66 "KFC_RATIOAE" 67 "KFC_RATIOAC" 68 "KFC_RATIOBC" 69 "KFC_RATIOCE" 70 "KFC_RATIODE" 71 "KFC_RATIOABC" 72 "KFC_RATIOABE" 73 "KFC_RATIOBCE" 74 "KFC_RATIOBDE" 75 "KFC_RATIOBCD" 76 "KFC_RATIOCDE" 77 "KFC_RATIOACD" 78 "KFC_RATIOADE" 79 "KFC_RATIOABD" 80 "KFC_RATIOSHIFT" 81 "KFC_RATIOSHIFT1" 82 "KFC_RATIOSHIFT2" 83 "KFC_RATIOSHIFT3" 84 "KFC_RATIOSHIFT4" 85 "KFC_RATIOSHIFT5" 86 "KFC_RATIOSHIFT6" 87 "KFC_RATIOSHIFT7" 88 "KFC_RATIOSHIFT8" 89 "KFC_UBATTU" 90 "KFC_UBATTL" 91 "KFC_UBATTO" 92 "KFC_N6LEV2" 93 "KFC5_CLUTCHOVERHEAT" 94 "KFC_NABLEV2" 95 "KFC_USENS" 96 "KFC_NABPLAUSILEV2" 97 "KFC_NWHEELPLAUSILEV2" 98 "KFC_PARK" 99 "KFC_STADARDY" 100 "KFC_CCHIP1LEV2" 101 "KFC_CGTLEV2" 102 "KFC_NMOUEB" 103 "KFC1_CLUTCHOVERHEAT" 104 "KFC_POSV" 105 "KFC_PEDALF" 106 "KFC_NWHEELLEV2" 107 "KFC_POSINFO1" 108 "KFC_POSINFO2" 109 "KFC_POSSBW" 110 "KFC_TARGETSPEED" 111 "KFC_CANB1" 112 "KFC_CANB2" 113 "KFC_PSIN" 114 "KFC_PSOUT" 115 "KFC_PSABUSE" 116 "KFC2_ENGSIGTRQ" 117 "KFC_ENGSIGEM" 118 "KFC2_CLUTCHOVERHEAT" 119 "KFC3_CLUTCHOVERHEAT" 120 "KFC_NMOE" 121 "KFC4_CLUTCHOVERHEAT" 122 "KFC_ERSATZ" 123 "KFC_TIPP" 124 "KFC_RESUB" 125 "KFC_RATIOGLOBAL" 126 "KFC2_PSOUT" 127 "KFC_TRANSM" 128 "KFC1_POSDISP" 129 "KFC_NMOFLL" 130 "KFC_PRLOGIC" 131 "KFC_CCHIP2LEV2" 132 "KFC_ENGSIG" 133 "KFC_BRAKEF" 134 "KFC_BRAKETRQ" 135 "KFC_DOOR" 136 "KFC_SEAT" 137 "KFC_OBDCYCLES" 138 "KFC_PINFO" 139 "KFC_INFOHOT1" 140 "KFC_INFOHOT2" 141 "KFC_INFO4" 142 "KFC_INFO5" 143 "KFC_CGTELECTRICERRLEV2" 144 "KFC_FEHLBAU" 145 "KFC_ACCELY" 146 "KFC_BRAKETRQDRV" 147 "KFC1_ENGSIGEM" 148 "KFC_FLASHNOTPOS" 149 "KFC_PSHOLDERR" 150 "KFC_PSABSERR" 151 "KFC_TMS" 152 "KFC_KL15" 153 "KFC1_KL15" 154 "KFC_C0SYNCHOT" 155 "KFC1_TRSMTRQ" 156 "KFC_OBD" 157 "KFC_INTME" 158 "KFC1_INTME" 159 "KFC_DMEG1" 160 "KFC_DMEG2" 161 "KFC_DMEG3" 162 "KFC_GWSACAN" 163 "KFC_GWSFACAN" 164 "KFC_INFOHOTWARNING2" 165 "KFC_INFOHOTWARNING3" 166 "KFC_INFO6" 167 "KFC3_ENGSIGTRQ" 168 "KFC_DSCG1" 169 "KFC_DSCG2" 170 "KFC_DSCG3" 171 "KFC_C0DEFECTHOT" 172 "KFC_INFO9" 173 "KFC_INFO10" 174 "KFC_MAXDECELERATION" 175 "KFC_FEMG1" 176 "KFC_FEMG2" 177 "KFC_FEMG3" 178 "KFC1_SENSORLEV2" 179 "KFC2_ENGSIGEM" 180 "KFC_NEMNEGDIR" 181 "KFC_EGNERENABLED" 182 "KFC_EGNERFAILED" 183 "KFC_EGNERMISUSE" 184 "KFC_CIC" 185 "KFC_ICMG1" 186 "KFC_ICMG2" 187 "KFC_ICMG3" 188 "KFC_C0CLOSEASYNC" 189 "KFC_PARKASSIST" 190 "KFC_HASCYCERR" 191 "KFC_HASCYCNEMERR" 192 "KFC_INSTG1" 193 "KFC_INSTG2" 194 "KFC_INSTG3" 195 "KFC_SZL1" 196 "KFC_ACSM1" 197 "KFC1_UBATTU" 198 "KFC_AHM1" 199 "KFC_ENGWATCOOL" 200 "KFC_EWSSCAN" 201 "KFC_EWSDRVRQ" 202 "KFC_NEMPSYS" 203 "KFC_NEGTRQREQHAS" 204 "KFC_TARGETTRQEM" 205 "KFC_HASERROR" 206 "KFC_VEHDYNREG" 207 "KFC_SME" 208 "KFC_TRQ" 209 "KFC_EMEG1" 210 "KFC_EMEG2" 211 "KFC_EMEG3" 212 "KFC_ENGSIGINFO" 213 "KFC_INFON" 214 "KFC_INFOHOTWARNING" 215 "KFC_DMEOBD" 216 "KFC_POSNPLAUSI" 217 "KFC1_ENGSIGTRQ" 218 "KFC_IAENOOPEN" 219 "KFC_IAENOCLOSE" 220 "KFC_IAECLOSE" 221 "KFC_IAEHOT" 222 "KFC_HASCYCNEMERR2" 223 "KFC_C0DEFECT" 224 "KFC_SAFETYPARMISM" 225 "KFC_IEP" 226 "KFC_ZGW" 227 "KFC1_IEPERROR" 228 "KFC_C0NOCLOSE" 229 "KFC_TARGETSPEEDVM" 230 "KFC_TARGETSPEEDEM" 231 "KFC_MINSPEEDEM" 232 "KFC_IEPLEV2" 233 "KFC_HASCYCNVMERR" 234 "KFC_NABGRAD" 235 "KFC_C0HOT" 236 "KFC_C0CLOSELEV2" 237 "KFC_CGTJUMPLEV2" 238 "KFC_CGTPLAUSILEV2" 239 "KFC_CCHIP2PLAUSILEV2" 240 "KFC_CCHIP1PLAUSILEV2" 241 "KFC1_NEGTRQREQ" 242 "KFC_IEPCOM" 243 "KFC_RATIOIEPSYM" 244 "KFC_RATIOIEP" 245 "KFC_C0NOOPEN" 246 "CODING_EVENT_NOT_CODED" 247 "CODING_EVENT_TRANSACTION_FAILED" 248 "CODING_EVENT_SIGNATURE_ERROR" 249 "CODING_EVENT_WRONG_VEHICLE" 250 "CODING_EVENT_INVALID_DATA" 251 "DM_EVENT_ZEITBOTSCHAFTTIMEOUT" 252 "DM_TEST_APPL" 253 "DM_TEST_COM" 254 "VSM_EVENT_OPMODE" 255 "DI_EC_NUMBER_ENTRIES" DEFAULT_VALUE "unknown" /end COMPU_VTAB
/begin FUNCTION zff_EH_ErrorMemoryInformation "desc_en"
 /begin LOC_MEASUREMENT ZFEH_EepromData.ydiMemory_xau16[13].amb_cond.ambient_condition[0][15] ZFEH_EepromData.ydiMemory_xau16[13].amb_cond.ambient_condition[0][16] ZFEH_EepromData.ydiMemory_xau16[13].amb_cond.ambient_condition[0][17] ZFEH_EepromData.ydiMemory_xau16[13].amb_cond.ambient_condition[0][18] ZFEH_EepromData.ydiMemory_xau16[13].amb_cond.ambient_condition[0][19] ZFEH_EepromData.ydiMemory_xau16[13].amb_cond.ambient_condition[0][1] ZFEH_EepromData.ydiMemory_xau16[13].amb_cond.ambient_condition[0][20] ZFEH_EepromData.ydiMemory_xau16[13].amb_cond.ambient_condition[0][21] ZFEH_EepromData.ydiMemory_xau16[13].amb_cond.ambient_condition[0][22] ZFEH_EepromData.ydiMemory_xau16[13].amb_cond.ambient_condition[0][23] ZFEH_EepromData.ydiMemory_xau16[13].amb_cond.ambient_condition[0][24] ZFEH_EepromData.ydiMemory_xau16[13].amb_cond.ambient_condition[0][2] ZFEH_EepromData.ydiMemory_xau16[13].amb_cond.ambient_condition[0][3] ZFEH_EepromData.ydiMemory_xau16[13].amb_cond.ambient_condition[0][4] ZFEH_EepromData.ydiMemory_xau16[13].amb_cond.ambient_condition[0][5] ZFEH_EepromData.ydiMemory_xau16[13].amb_cond.ambient_condition[0][6] ZFEH_EepromData.ydiMemory_xau16[13].amb_cond.ambient_condition[0][7] ZFEH_EepromData.ydiMemory_xau16[13].amb_cond.ambient_condition[0][8] ZFEH_EepromData.ydiMemory_xau16[13].amb_cond.ambient_condition[0][9] ZFEH_EepromData.ydiMemory_xau16[13].amb_cond.ambient_condition[1][0] ZFEH_EepromData.ydiMemory_xau16[13].amb_cond.ambient_condition[1][10] ZFEH_EepromData.ydiMemory_xau16[13].amb_cond.ambient_condition[1][11] ZFEH_EepromData.ydiMemory_xau16[13].amb_cond.ambient_condition[1][12] ZFEH_EepromData.ydiMemory_xau16[13].amb_cond.ambient_condition[1][13] ZFEH_EepromData.ydiMemory_xau16[13].amb_cond.ambient_condition[1][14] ZFEH_EepromData.ydiMemory_xau16[13].amb_cond.ambient_condition[1][15] ZFEH_EepromData.ydiMemory_xau16[13].amb_cond.ambient_condition[1][16] ZFEH_EepromData.ydiMemory_xau16[13].amb_cond.ambient_condition[1][17] ZFEH_EepromData.ydiMemory_xau16[13].amb_cond.ambient_condition[1][18] ZFEH_EepromData.ydiMemory_xau16[13].amb_cond.ambient_condition[1][19] ZFEH_EepromData.ydiMemory_xau16[13].amb_cond.ambient_condition[1][1] ZFEH_EepromData.ydiMemory_xau16[13].amb_cond.ambient_condition[1][20] ZFEH_EepromData.ydiMemory_xau16[13].amb_cond.ambient_condition[1][21] ZFEH_EepromData.ydiMemory_xau16[13].amb_cond.ambient_condition[1][22] ZFEH_EepromData.ydiMemory_xau16[13].amb_cond.ambient_condition[1][23] ZFEH_EepromData.ydiMemory_xau16[13].amb_cond.ambient_condition[1][24] ZFEH_EepromData.ydiMemory_xau16[13].amb_cond.ambient_condition[1][2] ZFEH_EepromData.ydiMemory_xau16[13].amb_cond.ambient_condition[1][3] ZFEH_EepromData.ydiMemory_xau16[13].amb_cond.ambient_condition[1][4] ZFEH_EepromData.ydiMemory_xau16[13].amb_cond.ambient_condition[1][5] ZFEH_EepromData.ydiMemory_xau16[13].amb_cond.ambient_condition[1][6] ZFEH_EepromData.ydiMemory_xau16[13].amb_cond.ambient_condition[1][7] ZFEH_EepromData.ydiMemory_xau16[13].amb_cond.ambient_condition[1][8] ZFEH_EepromData.ydiMemory_xau16[13].amb_cond.ambient_condition[1][9] ZFEH_EepromData.ydiMemory_xau16[13].amb_cond.status_of_ambient_conditions[0] ZFEH_EepromData.ydiMemory_xau16[13].amb_cond.status_of_ambient_conditions[1] ZFEH_EepromData.ydiMemory_xau16[13].backwards_counter ZFEH_EepromData.ydiMemory_xau16[13].condition_byte ZFEH_EepromData.ydiMemory_xau16[13].error_code ZFEH_EepromData.ydiMemory_xau16[13].error_type ZFEH_EepromData.ydiMemory_xau16[13].frequency_counter ZFEH_EepromData.ydiMemory_xau16[13].master_time ZFEH_EepromData.ydiMemory_xau16[13].obd_driving_cycle_counter ZFEH_EepromData.ydiMemory_xau16[13].permanent_counter ZFEH_EepromData.ydiMemory_xau16[13].sequence_counter ZFEH_EepromData.ydiMemory_xau16[13].status_word ZFEH_EepromData.ydiMemory_xau16[14].amb_cond.ambient_condition[0][0] ZFEH_EepromData.ydiMemory_xau16[14].amb_cond.ambient_condition[0][10] ZFEH_EepromData.ydiMemory_xau16[14].amb_cond.ambient_condition[0][11] ZFEH_EepromData.ydiMemory_xau16[14].amb_cond.ambient_condition[0][12] ZFEH_EepromData.ydiMemory_xau16[14].amb_cond.ambient_condition[0][13] ZFEH_EepromData.ydiMemory_xau16[14].amb_cond.ambient_condition[0][14] ZFEH_EepromData.ydiMemory_xau16[14].amb_cond.ambient_condition[0][15] ZFEH_EepromData.ydiMemory_xau16[14].amb_cond.ambient_condition[0][16] ZFEH_EepromData.ydiMemory_xau16[14].amb_cond.ambient_condition[0][17] ZFEH_EepromData.ydiMemory_xau16[14].amb_cond.ambient_condition[0][18] ZFEH_EepromData.ydiMemory_xau16[14].amb_cond.ambient_condition[0][19] ZFEH_EepromData.ydiMemory_xau16[14].amb_cond.ambient_condition[0][1] ZFEH_EepromData.ydiMemory_xau16[14].amb_cond.ambient_condition[0][20] ZFEH_EepromData.ydiMemory_xau16[14].amb_cond.ambient_condition[0][21] ZFEH_EepromData.ydiMemory_xau16[14].amb_cond.ambient_condition[0][22] ZFEH_EepromData.ydiMemory_xau16[14].amb_cond.ambient_condition[0][23] ZFEH_EepromData.ydiMemory_xau16[14].amb_cond.ambient_condition[0][24] ZFEH_EepromData.ydiMemory_xau16[14].amb_cond.ambient_condition[0][2] ZFEH_EepromData.ydiMemory_xau16[14].amb_cond.ambient_condition[0][3] ZFEH_EepromData.ydiMemory_xau16[14].amb_cond.ambient_condition[0][4] ZFEH_EepromData.ydiMemory_xau16[14].amb_cond.ambient_condition[0][5] ZFEH_EepromData.ydiMemory_xau16[14].amb_cond.ambient_condition[0][6] ZFEH_EepromData.ydiMemory_xau16[14].amb_cond.ambient_condition[0][7] ZFEH_EepromData.ydiMemory_xau16[14].amb_cond.ambient_condition[0][8] ZFEH_EepromData.ydiMemory_xau16[14].amb_cond.ambient_condition[0][9] ZFEH_EepromData.ydiMemory_xau16[14].amb_cond.ambient_condition[1][0] ZFEH_EepromData.ydiMemory_xau16[14].amb_cond.ambient_condition[1][10] ZFEH_EepromData.ydiMemory_xau16[14].amb_cond.ambient_condition[1][11] ZFEH_EepromData.ydiMemory_xau16[14].amb_cond.ambient_condition[1][12] ZFEH_EepromData.ydiMemory_xau16[14].amb_cond.ambient_condition[1][13] ZFEH_EepromData.ydiMemory_xau16[14].amb_cond.ambient_condition[1][14] ZFEH_EepromData.ydiMemory_xau16[14].amb_cond.ambient_condition[1][15] ZFEH_EepromData.ydiMemory_xau16[14].amb_cond.ambient_condition[1][16] ZFEH_EepromData.ydiMemory_xau16[14].amb_cond.ambient_condition[1][17] ZFEH_EepromData.ydiMemory_xau16[14].amb_cond.ambient_condition[1][18] ZFEH_EepromData.ydiMemory_xau16[14].amb_cond.ambient_condition[1][19] ZFEH_EepromData.ydiMemory_xau16[14].amb_cond.ambient_condition[1][1] ZFEH_EepromData.ydiMemory_xau16[14].amb_cond.ambient_condition[1][20] ZFEH_EepromData.ydiMemory_xau16[14].amb_cond.ambient_condition[1][21] ZFEH_EepromData.ydiMemory_xau16[14].amb_cond.ambient_condition[1][22] ZFEH_EepromData.ydiMemory_xau16[14].amb_cond.ambient_condition[1][23] ZFEH_EepromData.ydiMemory_xau16[14].amb_cond.ambient_condition[1][24] ZFEH_EepromData.ydiMemory_xau16[14].amb_cond.ambient_condition[1][2] ZFEH_EepromData.ydiMemory_xau16[14].amb_cond.ambient_condition[1][3] ZFEH_EepromData.ydiMemory_xau16[14].amb_cond.ambient_condition[1][4] ZFEH_EepromData.ydiMemory_xau16[14].amb_cond.ambient_condition[1][5] ZFEH_EepromData.ydiMemory_xau16[14].amb_cond.ambient_condition[1][6] ZFEH_EepromData.ydiMemory_xau16[14].amb_cond.ambient_condition[1][7] ZFEH_EepromData.ydiMemory_xau16[14].amb_cond.ambient_condition[1][8] ZFEH_EepromData.ydiMemory_xau16[14].amb_cond.ambient_condition[1][9] ZFEH_EepromData.ydiMemory_xau16[14].amb_cond.status_of_ambient_conditions[0] ZFEH_EepromData.ydiMemory_xau16[14].amb_cond.status_of_ambient_conditions[1] ZFEH_EepromData.ydiMemory_xau16[14].backwards_counter ZFEH_EepromData.ydiMemory_xau16[14].condition_byte ZFEH_EepromData.ydiMemory_xau16[14].error_code ZFEH_EepromData.ydiMemory_xau16[14].error_type ZFEH_EepromData.ydiMemory_xau16[14].frequency_counter ZFEH_EepromData.ydiMemory_xau16[14].master_time ZFEH_EepromData.ydiMemory_xau16[14].obd_driving_cycle_counter ZFEH_EepromData.ydiMemory_xau16[14].permanent_counter ZFEH_EepromData.ydiMemory_xau16[14].sequence_counter ZFEH_EepromData.ydiMemory_xau16[14].status_word ZFEH_EepromData.ydiMemory_xau16[15].amb_cond.ambient_condition[0][0] ZFEH_EepromData.ydiMemory_xau16[15].amb_cond.ambient_condition[0][10] ZFEH_EepromData.ydiMemory_xau16[15].amb_cond.ambient_condition[0][11] ZFEH_EepromData.ydiMemory_xau16[15].amb_cond.ambient_condition[0][12] ZFEH_EepromData.ydiMemory_xau16[15].amb_cond.ambient_condition[0][13] ZFEH_EepromData.ydiMemory_xau16[15].amb_cond.ambient_condition[0][14] ZFEH_EepromData.ydiMemory_xau16[15].amb_cond.ambient_condition[0][15] ZFEH_EepromData.ydiMemory_xau16[15].amb_cond.ambient_condition[0][16] ZFEH_EepromData.ydiMemory_xau16[15].amb_cond.ambient_condition[0][17] ZFEH_EepromData.ydiMemory_xau16[15].amb_cond.ambient_condition[0][18] ZFEH_EepromData.ydiMemory_xau16[15].amb_cond.ambient_condition[0][19] ZFEH_EepromData.ydiMemory_xau16[15].amb_cond.ambient_condition[0][1] ZFEH_EepromData.ydiMemory_xau16[15].amb_cond.ambient_condition[0][20] ZFEH_EepromData.ydiMemory_xau16[15].amb_cond.ambient_condition[0][21] ZFEH_EepromData.ydiMemory_xau16[15].amb_cond.ambient_condition[0][22] ZFEH_EepromData.ydiMemory_xau16[15].amb_cond.ambient_condition[0][23] ZFEH_EepromData.ydiMemory_xau16[15].amb_cond.ambient_condition[0][24] ZFEH_EepromData.ydiMemory_xau16[15].amb_cond.ambient_condition[0][2] ZFEH_EepromData.ydiMemory_xau16[15].amb_cond.ambient_condition[0][3] ZFEH_EepromData.ydiMemory_xau16[15].amb_cond.ambient_condition[0][4] ZFEH_EepromData.ydiMemory_xau16[15].amb_cond.ambient_condition[0][5] ZFEH_EepromData.ydiMemory_xau16[15].amb_cond.ambient_condition[0][6] ZFEH_EepromData.ydiMemory_xau16[15].amb_cond.ambient_condition[0][7] ZFEH_EepromData.ydiMemory_xau16[15].amb_cond.ambient_condition[0][8] ZFEH_EepromData.ydiMemory_xau16[15].amb_cond.ambient_condition[0][9] ZFEH_EepromData.ydiMemory_xau16[15].amb_cond.ambient_condition[1][0] ZFEH_EepromData.ydiMemory_xau16[15].amb_cond.ambient_condition[1][10] ZFEH_EepromData.ydiMemory_xau16[15].amb_cond.ambient_condition[1][11] ZFEH_EepromData.ydiMemory_xau16[15].amb_cond.ambient_condition[1][12] ZFEH_EepromData.ydiMemory_xau16[15].amb_cond.ambient_condition[1][13] ZFEH_EepromData.ydiMemory_xau16[15].amb_cond.ambient_condition[1][14] ZFEH_EepromData.ydiMemory_xau16[15].amb_cond.ambient_condition[1][15] ZFEH_EepromData.ydiMemory_xau16[15].amb_cond.ambient_condition[1][16] ZFEH_EepromData.ydiMemory_xau16[15].amb_cond.ambient_condition[1][17] ZFEH_EepromData.ydiMemory_xau16[15].amb_cond.ambient_condition[1][18] ZFEH_EepromData.ydiMemory_xau16[15].amb_cond.ambient_condition[1][19] ZFEH_EepromData.ydiMemory_xau16[15].amb_cond.ambient_condition[1][1] ZFEH_EepromData.ydiMemory_xau16[15].amb_cond.ambient_condition[1][20] ZFEH_EepromData.ydiMemory_xau16[15].amb_cond.ambient_condition[1][21] ZFEH_EepromData.ydiMemory_xau16[15].amb_cond.ambient_condition[1][22] ZFEH_EepromData.ydiMemory_xau16[15].amb_cond.ambient_condition[1][23] ZFEH_EepromData.ydiMemory_xau16[15].amb_cond.ambient_condition[1][24] ZFEH_EepromData.ydiMemory_xau16[15].amb_cond.ambient_condition[1][2] ZFEH_EepromData.ydiMemory_xau16[15].amb_cond.ambient_condition[1][3] ZFEH_EepromData.ydiMemory_xau16[15].amb_cond.ambient_condition[1][4] ZFEH_EepromData.ydiMemory_xau16[15].amb_cond.ambient_condition[1][5] ZFEH_EepromData.ydiMemory_xau16[15].amb_cond.ambient_condition[1][6] ZFEH_EepromData.ydiMemory_xau16[15].amb_cond.ambient_condition[1][7] ZFEH_EepromData.ydiMemory_xau16[15].amb_cond.ambient_condition[1][8] ZFEH_EepromData.ydiMemory_xau16[15].amb_cond.ambient_condition[1][9] ZFEH_EepromData.ydiMemory_xau16[15].amb_cond.status_of_ambient_conditions[0] ZFEH_EepromData.ydiMemory_xau16[15].amb_cond.status_of_ambient_conditions[1] ZFEH_EepromData.ydiMemory_xau16[15].backwards_counter ZFEH_EepromData.ydiMemory_xau16[15].condition_byte ZFEH_EepromData.ydiMemory_xau16[15].error_code ZFEH_EepromData.ydiMemory_xau16[15].error_type ZFEH_EepromData.ydiMemory_xau16[15].frequency_counter ZFEH_EepromData.ydiMemory_xau16[15].master_time ZFEH_EepromData.ydiMemory_xau16[15].obd_driving_cycle_counter ZFEH_EepromData.ydiMemory_xau16[15].permanent_counter ZFEH_EepromData.ydiMemory_xau16[15].sequence_counter ZFEH_EepromData.ydiMemory_xau16[15].status_word ZFEH_EepromData.ydiMemory_xau16[16].amb_cond.ambient_condition[0][0] ZFEH_EepromData.ydiMemory_xau16[16].amb_cond.ambient_condition[0][10] ZFEH_EepromData.ydiMemory_xau16[16].amb_cond.ambient_condition[0][11] ZFEH_EepromData.ydiMemory_xau16[16].amb_cond.ambient_condition[0][12] ZFEH_EepromData.ydiMemory_xau16[16].amb_cond.ambient_condition[0][13] ZFEH_EepromData.ydiMemory_xau16[16].amb_cond.ambient_condition[0][14] ZFEH_EepromData.ydiMemory_xau16[16].amb_cond.ambient_condition[0][15] ZFEH_EepromData.ydiMemory_xau16[16].amb_cond.ambient_condition[0][16] ZFEH_EepromData.ydiMemory_xau16[16].amb_cond.ambient_condition[0][17] ZFEH_EepromData.ydiMemory_xau16[16].amb_cond.ambient_condition[0][18] ZFEH_EepromData.ydiMemory_xau16[16].amb_cond.ambient_condition[0][19] ZFEH_EepromData.ydiMemory_xau16[16].amb_cond.ambient_condition[0][1] ZFEH_EepromData.ydiMemory_xau16[16].amb_cond.ambient_condition[0][20] ZFEH_EepromData.ydiMemory_xau16[16].amb_cond.ambient_condition[0][21] ZFEH_EepromData.ydiMemory_xau16[16].amb_cond.ambient_condition[0][22] ZFEH_EepromData.ydiMemory_xau16[16].amb_cond.ambient_condition[0][23] ZFEH_EepromData.ydiMemory_xau16[16].amb_cond.ambient_condition[0][24] ZFEH_EepromData.ydiMemory_xau16[16].amb_cond.ambient_condition[0][2] ZFEH_EepromData.ydiMemory_xau16[16].amb_cond.ambient_condition[0][3] ZFEH_EepromData.ydiMemory_xau16[16].amb_cond.ambient_condition[0][4] ZFEH_EepromData.ydiMemory_xau16[16].amb_cond.ambient_condition[0][5] ZFEH_EepromData.ydiMemory_xau16[16].amb_cond.ambient_condition[0][6] ZFEH_EepromData.ydiMemory_xau16[16].amb_cond.ambient_condition[0][7] ZFEH_EepromData.ydiMemory_xau16[16].amb_cond.ambient_condition[0][8] ZFEH_EepromData.ydiMemory_xau16[16].amb_cond.ambient_condition[0][9] ZFEH_EepromData.ydiMemory_xau16[16].amb_cond.ambient_condition[1][0] ZFEH_EepromData.ydiMemory_xau16[16].amb_cond.ambient_condition[1][10] ZFEH_EepromData.ydiMemory_xau16[16].amb_cond.ambient_condition[1][11] ZFEH_EepromData.ydiMemory_xau16[16].amb_cond.ambient_condition[1][12] ZFEH_EepromData.ydiMemory_xau16[16].amb_cond.ambient_condition[1][13] ZFEH_EepromData.ydiMemory_xau16[16].amb_cond.ambient_condition[1][14] ZFEH_EepromData.ydiMemory_xau16[16].amb_cond.ambient_condition[1][15] ZFEH_EepromData.ydiMemory_xau16[16].amb_cond.ambient_condition[1][16] ZFEH_EepromData.ydiMemory_xau16[16].amb_cond.ambient_condition[1][17] ZFEH_EepromData.ydiMemory_xau16[16].amb_cond.ambient_condition[1][18] ZFEH_EepromData.ydiMemory_xau16[16].amb_cond.ambient_condition[1][19] ZFEH_EepromData.ydiMemory_xau16[16].amb_cond.ambient_condition[1][1] ZFEH_EepromData.ydiMemory_xau16[16].amb_cond.ambient_condition[1][20] ZFEH_EepromData.ydiMemory_xau16[16].amb_cond.ambient_condition[1][21] ZFEH_EepromData.ydiMemory_xau16[16].amb_cond.ambient_condition[1][22] ZFEH_EepromData.ydiMemory_xau16[16].amb_cond.ambient_condition[1][23] ZFEH_EepromData.ydiMemory_xau16[16].amb_cond.ambient_condition[1][24] ZFEH_EepromData.ydiMemory_xau16[16].amb_cond.ambient_condition[1][2] ZFEH_EepromData.ydiMemory_xau16[16].amb_cond.ambient_condition[1][3] ZFEH_EepromData.ydiMemory_xau16[16].amb_cond.ambient_condition[1][4] ZFEH_EepromData.ydiMemory_xau16[16].amb_cond.ambient_condition[1][5] ZFEH_EepromData.ydiMemory_xau16[16].amb_cond.ambient_condition[1][6] ZFEH_EepromData.ydiMemory_xau16[16].amb_cond.ambient_condition[1][7] ZFEH_EepromData.ydiMemory_xau16[16].amb_cond.ambient_condition[1][8] ZFEH_EepromData.ydiMemory_xau16[16].amb_cond.ambient_condition[1][9] ZFEH_EepromData.ydiMemory_xau16[16].amb_cond.status_of_ambient_conditions[0] ZFEH_EepromData.ydiMemory_xau16[16].amb_cond.status_of_ambient_conditions[1] ZFEH_EepromData.ydiMemory_xau16[16].backwards_counter ZFEH_EepromData.ydiMemory_xau16[16].condition_byte ZFEH_EepromData.ydiMemory_xau16[16].error_code ZFEH_EepromData.ydiMemory_xau16[16].error_type ZFEH_EepromData.ydiMemory_xau16[16].frequency_counter ZFEH_EepromData.ydiMemory_xau16[16].master_time ZFEH_EepromData.ydiMemory_xau16[16].obd_driving_cycle_counter ZFEH_EepromData.ydiMemory_xau16[16].permanent_counter ZFEH_EepromData.ydiMemory_xau16[16].sequence_counter ZFEH_EepromData.ydiMemory_xau16[16].status_word ZFEH_EepromData.ydiMemory_xau16[17].amb_cond.ambient_condition[0][0] ZFEH_EepromData.ydiMemory_xau16[17].amb_cond.ambient_condition[0][10] ZFEH_EepromData.ydiMemory_xau16[17].amb_cond.ambient_condition[0][11] ZFEH_EepromData.ydiMemory_xau16[17].amb_cond.ambient_condition[0][12] ZFEH_EepromData.ydiMemory_xau16[17].amb_cond.ambient_condition[0][13] ZFEH_EepromData.ydiMemory_xau16[17].amb_cond.ambient_condition[0][14] ZFEH_EepromData.ydiMemory_xau16[17].amb_cond.ambient_condition[0][15] ZFEH_EepromData.ydiMemory_xau16[17].amb_cond.ambient_condition[0][16] ZFEH_EepromData.ydiMemory_xau16[17].amb_cond.ambient_condition[0][17] ZFEH_EepromData.ydiMemory_xau16[17].amb_cond.ambient_condition[0][18] ZFEH_EepromData.ydiMemory_xau16[17].amb_cond.ambient_condition[0][19] ZFEH_EepromData.ydiMemory_xau16[17].amb_cond.ambient_condition[0][1] ZFEH_EepromData.ydiMemory_xau16[17].amb_cond.ambient_condition[0][20] ZFEH_EepromData.ydiMemory_xau16[17].amb_cond.ambient_condition[0][21] ZFEH_EepromData.ydiMemory_xau16[17].amb_cond.ambient_condition[0][22] ZFEH_EepromData.ydiMemory_xau16[17].amb_cond.ambient_condition[0][23] ZFEH_EepromData.ydiMemory_xau16[17].amb_cond.ambient_condition[0][24] ZFEH_EepromData.ydiMemory_xau16[17].amb_cond.ambient_condition[0][2] ZFEH_EepromData.ydiMemory_xau16[17].amb_cond.ambient_condition[0][3] ZFEH_EepromData.ydiMemory_xau16[17].amb_cond.ambient_condition[0][4] ZFEH_EepromData.ydiMemory_xau16[17].amb_cond.ambient_condition[0][5] ZFEH_EepromData.ydiMemory_xau16[17].amb_cond.ambient_condition[0][6] ZFEH_EepromData.ydiMemory_xau16[17].amb_cond.ambient_condition[0][7] ZFEH_EepromData.ydiMemory_xau16[17].amb_cond.ambient_condition[0][8] ZFEH_EepromData.ydiMemory_xau16[17].amb_cond.ambient_condition[0][9] ZFEH_EepromData.ydiMemory_xau16[17].amb_cond.ambient_condition[1][0] ZFEH_EepromData.ydiMemory_xau16[17].amb_cond.ambient_condition[1][10] ZFEH_EepromData.ydiMemory_xau16[17].amb_cond.ambient_condition[1][11] ZFEH_EepromData.ydiMemory_xau16[17].amb_cond.ambient_condition[1][12] ZFEH_EepromData.ydiMemory_xau16[17].amb_cond.ambient_condition[1][13] ZFEH_EepromData.ydiMemory_xau16[17].amb_cond.ambient_condition[1][14] ZFEH_EepromData.ydiMemory_xau16[17].amb_cond.ambient_condition[1][15] ZFEH_EepromData.ydiMemory_xau16[17].amb_cond.ambient_condition[1][16] ZFEH_EepromData.ydiMemory_xau16[17].amb_cond.ambient_condition[1][17] ZFEH_EepromData.ydiMemory_xau16[17].amb_cond.ambient_condition[1][18] ZFEH_EepromData.ydiMemory_xau16[17].amb_cond.ambient_condition[1][19] ZFEH_EepromData.ydiMemory_xau16[17].amb_cond.ambient_condition[1][1] ZFEH_EepromData.ydiMemory_xau16[17].amb_cond.ambient_condition[1][20] ZFEH_EepromData.ydiMemory_xau16[17].amb_cond.ambient_condition[1][21] ZFEH_EepromData.ydiMemory_xau16[17].amb_cond.ambient_condition[1][22] ZFEH_EepromData.ydiMemory_xau16[17].amb_cond.ambient_condition[1][23] ZFEH_EepromData.ydiMemory_xau16[17].amb_cond.ambient_condition[1][24] ZFEH_EepromData.ydiMemory_xau16[17].amb_cond.ambient_condition[1][2] ZFEH_EepromData.ydiMemory_xau16[17].amb_cond.ambient_condition[1][3] ZFEH_EepromData.ydiMemory_xau16[17].amb_cond.ambient_condition[1][4] ZFEH_EepromData.ydiMemory_xau16[17].amb_cond.ambient_condition[1][5] ZFEH_EepromData.ydiMemory_xau16[17].amb_cond.ambient_condition[1][6] ZFEH_EepromData.ydiMemory_xau16[17].amb_cond.ambient_condition[1][7] ZFEH_EepromData.ydiMemory_xau16[17].amb_cond.ambient_condition[1][8] ZFEH_EepromData.ydiMemory_xau16[17].amb_cond.ambient_condition[1][9] ZFEH_EepromData.ydiMemory_xau16[17].amb_cond.status_of_ambient_conditions[0] ZFEH_EepromData.ydiMemory_xau16[17].amb_cond.status_of_ambient_conditions[1] ZFEH_EepromData.ydiMemory_xau16[17].backwards_counter ZFEH_EepromData.ydiMemory_xau16[17].condition_byte ZFEH_EepromData.ydiMemory_xau16[17].error_code ZFEH_EepromData.ydiMemory_xau16[17].error_type ZFEH_EepromData.ydiMemory_xau16[17].frequency_counter ZFEH_EepromData.ydiMemory_xau16[17].master_time ZFEH_EepromData.ydiMemory_xau16[17].obd_driving_cycle_counter ZFEH_EepromData.ydiMemory_xau16[17].permanent_counter ZFEH_EepromData.ydiMemory_xau16[17].sequence_counter ZFEH_EepromData.ydiMemory_xau16[17].status_word ZFEH_EepromData.ydiMemory_xau16[18].amb_cond.ambient_condition[0][0] ZFEH_EepromData.ydiMemory_xau16[18].amb_cond.ambient_condition[0][10] ZFEH_EepromData.ydiMemory_xau16[18].amb_cond.ambient_condition[0][11] ZFEH_EepromData.ydiMemory_xau16[18].amb_cond.ambient_condition[0][12] ZFEH_EepromData.ydiMemory_xau16[18].amb_cond.ambient_condition[0][13] ZFEH_EepromData.ydiMemory_xau16[18].amb_cond.ambient_condition[0][14] ZFEH_EepromData.ydiMemory_xau16[18].amb_cond.ambient_condition[0][15] ZFEH_EepromData.ydiMemory_xau16[18].amb_cond.ambient_condition[0][16] ZFEH_EepromData.ydiMemory_xau16[18].amb_cond.ambient_condition[0][17] ZFEH_EepromData.ydiMemory_xau16[18].amb_cond.ambient_condition[0][18] ZFEH_EepromData.ydiMemory_xau16[18].amb_cond.ambient_condition[0][19] ZFEH_EepromData.ydiMemory_xau16[18].amb_cond.ambient_condition[0][1] ZFEH_EepromData.ydiMemory_xau16[18].amb_cond.ambient_condition[0][20] ZFEH_EepromData.ydiMemory_xau16[18].amb_cond.ambient_condition[0][21] ZFEH_EepromData.ydiMemory_xau16[18].amb_cond.ambient_condition[0][22] ZFEH_EepromData.ydiMemory_xau16[18].amb_cond.ambient_condition[0][23] ZFEH_EepromData.ydiMemory_xau16[18].amb_cond.ambient_condition[0][24] ZFEH_EepromData.ydiMemory_xau16[18].amb_cond.ambient_condition[0][2] ZFEH_EepromData.ydiMemory_xau16[18].amb_cond.ambient_condition[0][3] ZFEH_EepromData.ydiMemory_xau16[18].amb_cond.ambient_condition[0][4] ZFEH_EepromData.ydiMemory_xau16[18].amb_cond.ambient_condition[0][5] ZFEH_EepromData.ydiMemory_xau16[18].amb_cond.ambient_condition[0][6] ZFEH_EepromData.ydiMemory_xau16[18].amb_cond.ambient_condition[0][7] ZFEH_EepromData.ydiMemory_xau16[18].amb_cond.ambient_condition[0][8] ZFEH_EepromData.ydiMemory_xau16[18].amb_cond.ambient_condition[0][9] ZFEH_EepromData.ydiMemory_xau16[18].amb_cond.ambient_condition[1][0] ZFEH_EepromData.ydiMemory_xau16[18].amb_cond.ambient_condition[1][10] ZFEH_EepromData.ydiMemory_xau16[18].amb_cond.ambient_condition[1][11] ZFEH_EepromData.ydiMemory_xau16[18].amb_cond.ambient_condition[1][12] ZFEH_EepromData.ydiMemory_xau16[18].amb_cond.ambient_condition[1][13] ZFEH_EepromData.ydiMemory_xau16[18].amb_cond.ambient_condition[1][14] ZFEH_EepromData.ydiMemory_xau16[18].amb_cond.ambient_condition[1][15] ZFEH_EepromData.ydiMemory_xau16[18].amb_cond.ambient_condition[1][16] ZFEH_EepromData.ydiMemory_xau16[18].amb_cond.ambient_condition[1][17] ZFEH_EepromData.ydiMemory_xau16[18].amb_cond.ambient_condition[1][18] ZFEH_EepromData.ydiMemory_xau16[18].amb_cond.ambient_condition[1][19] ZFEH_EepromData.ydiMemory_xau16[18].amb_cond.ambient_condition[1][1] ZFEH_EepromData.ydiMemory_xau16[18].amb_cond.ambient_condition[1][20] ZFEH_EepromData.ydiMemory_xau16[18].amb_cond.ambient_condition[1][21] ZFEH_EepromData.ydiMemory_xau16[18].amb_cond.ambient_condition[1][22] ZFEH_EepromData.ydiMemory_xau16[18].amb_cond.ambient_condition[1][23] ZFEH_EepromData.ydiMemory_xau16[18].amb_cond.ambient_condition[1][24] ZFEH_EepromData.ydiMemory_xau16[18].amb_cond.ambient_condition[1][2] ZFEH_EepromData.ydiMemory_xau16[18].amb_cond.ambient_condition[1][3] ZFEH_EepromData.ydiMemory_xau16[18].amb_cond.ambient_condition[1][4] ZFEH_EepromData.ydiMemory_xau16[18].amb_cond.ambient_condition[1][5] ZFEH_EepromData.ydiMemory_xau16[18].amb_cond.ambient_condition[1][6] ZFEH_EepromData.ydiMemory_xau16[18].amb_cond.ambient_condition[1][7] ZFEH_EepromData.ydiMemory_xau16[18].amb_cond.ambient_condition[1][8] ZFEH_EepromData.ydiMemory_xau16[18].amb_cond.ambient_condition[1][9] ZFEH_EepromData.ydiMemory_xau16[18].amb_cond.status_of_ambient_conditions[0] ZFEH_EepromData.ydiMemory_xau16[18].amb_cond.status_of_ambient_conditions[1] ZFEH_EepromData.ydiMemory_xau16[18].backwards_counter ZFEH_EepromData.ydiMemory_xau16[18].condition_byte ZFEH_EepromData.ydiMemory_xau16[18].error_code ZFEH_EepromData.ydiMemory_xau16[18].error_type ZFEH_EepromData.ydiMemory_xau16[18].frequency_counter ZFEH_EepromData.ydiMemory_xau16[18].master_time ZFEH_EepromData.ydiMemory_xau16[18].obd_driving_cycle_counter ZFEH_EepromData.ydiMemory_xau16[18].permanent_counter ZFEH_EepromData.ydiMemory_xau16[18].sequence_counter ZFEH_EepromData.ydiMemory_xau16[18].status_word ZFEH_EepromData.ydiMemory_xau16[19].amb_cond.ambient_condition[0][0] ZFEH_EepromData.ydiMemory_xau16[19].amb_cond.ambient_condition[0][10] ZFEH_EepromData.ydiMemory_xau16[19].amb_cond.ambient_condition[0][11] ZFEH_EepromData.ydiMemory_xau16[19].amb_cond.ambient_condition[0][12] ZFEH_EepromData.ydiMemory_xau16[19].amb_cond.ambient_condition[0][13] ZFEH_EepromData.ydiMemory_xau16[19].amb_cond.ambient_condition[0][14] ZFEH_EepromData.ydiMemory_xau16[19].amb_cond.ambient_condition[0][15] ZFEH_EepromData.ydiMemory_xau16[19].amb_cond.ambient_condition[0][16] ZFEH_EepromData.ydiMemory_xau16[19].amb_cond.ambient_condition[0][17] ZFEH_EepromData.ydiMemory_xau16[19].amb_cond.ambient_condition[0][18] ZFEH_EepromData.ydiMemory_xau16[19].amb_cond.ambient_condition[0][19] ZFEH_EepromData.ydiMemory_xau16[19].amb_cond.ambient_condition[0][1] ZFEH_EepromData.ydiMemory_xau16[19].amb_cond.ambient_condition[0][20] ZFEH_EepromData.ydiMemory_xau16[19].amb_cond.ambient_condition[0][21] ZFEH_EepromData.ydiMemory_xau16[19].amb_cond.ambient_condition[0][22] ZFEH_EepromData.ydiMemory_xau16[19].amb_cond.ambient_condition[0][23] ZFEH_EepromData.ydiMemory_xau16[19].amb_cond.ambient_condition[0][24] ZFEH_EepromData.ydiMemory_xau16[19].amb_cond.ambient_condition[0][2] ZFEH_EepromData.ydiMemory_xau16[19].amb_cond.ambient_condition[0][3] ZFEH_EepromData.ydiMemory_xau16[19].amb_cond.ambient_condition[0][4] ZFEH_EepromData.ydiMemory_xau16[19].amb_cond.ambient_condition[0][5] ZFEH_EepromData.ydiMemory_xau16[19].amb_cond.ambient_condition[0][6] ZFEH_EepromData.ydiMemory_xau16[19].amb_cond.ambient_condition[0][7] ZFEH_EepromData.ydiMemory_xau16[19].amb_cond.ambient_condition[0][8] ZFEH_EepromData.ydiMemory_xau16[19].amb_cond.ambient_condition[0][9] ZFEH_EepromData.ydiMemory_xau16[19].amb_cond.ambient_condition[1][0] ZFEH_EepromData.ydiMemory_xau16[19].amb_cond.ambient_condition[1][10] ZFEH_EepromData.ydiMemory_xau16[19].amb_cond.ambient_condition[1][11] ZFEH_EepromData.ydiMemory_xau16[19].amb_cond.ambient_condition[1][12] ZFEH_EepromData.ydiMemory_xau16[19].amb_cond.ambient_condition[1][13] ZFEH_EepromData.ydiMemory_xau16[19].amb_cond.ambient_condition[1][14] ZFEH_EepromData.ydiMemory_xau16[19].amb_cond.ambient_condition[1][15] ZFEH_EepromData.ydiMemory_xau16[19].amb_cond.ambient_condition[1][16] ZFEH_EepromData.ydiMemory_xau16[19].amb_cond.ambient_condition[1][17] ZFEH_EepromData.ydiMemory_xau16[19].amb_cond.ambient_condition[1][18] ZFEH_EepromData.ydiMemory_xau16[19].amb_cond.ambient_condition[1][19] ZFEH_EepromData.ydiMemory_xau16[19].amb_cond.ambient_condition[1][1] ZFEH_EepromData.ydiMemory_xau16[19].amb_cond.ambient_condition[1][20] ZFEH_EepromData.ydiMemory_xau16[19].amb_cond.ambient_condition[1][21] ZFEH_EepromData.ydiMemory_xau16[19].amb_cond.ambient_condition[1][22] ZFEH_EepromData.ydiMemory_xau16[19].amb_cond.ambient_condition[1][23] ZFEH_EepromData.ydiMemory_xau16[19].amb_cond.ambient_condition[1][24] ZFEH_EepromData.ydiMemory_xau16[19].amb_cond.ambient_condition[1][2] ZFEH_EepromData.ydiMemory_xau16[19].amb_cond.ambient_condition[1][3] ZFEH_EepromData.ydiMemory_xau16[19].amb_cond.ambient_condition[1][4] ZFEH_EepromData.ydiMemory_xau16[19].amb_cond.ambient_condition[1][5] ZFEH_EepromData.ydiMemory_xau16[19].amb_cond.ambient_condition[1][6] ZFEH_EepromData.ydiMemory_xau16[19].amb_cond.ambient_condition[1][7] ZFEH_EepromData.ydiMemory_xau16[19].amb_cond.ambient_condition[1][8] ZFEH_EepromData.ydiMemory_xau16[19].amb_cond.ambient_condition[1][9] ZFEH_EepromData.ydiMemory_xau16[19].amb_cond.status_of_ambient_conditions[0] ZFEH_EepromData.ydiMemory_xau16[19].amb_cond.status_of_ambient_conditions[1] ZFEH_EepromData.ydiMemory_xau16[19].backwards_counter ZFEH_EepromData.ydiMemory_xau16[19].condition_byte ZFEH_EepromData.ydiMemory_xau16[19].error_code ZFEH_EepromData.ydiMemory_xau16[19].error_type ZFEH_EepromData.ydiMemory_xau16[19].frequency_counter ZFEH_EepromData.ydiMemory_xau16[19].master_time ZFEH_EepromData.ydiMemory_xau16[19].obd_driving_cycle_counter ZFEH_EepromData.ydiMemory_xau16[19].permanent_counter ZFEH_EepromData.ydiMemory_xau16[19].sequence_counter ZFEH_EepromData.ydiMemory_xau16[19].status_word ZFEH_EepromData.ydiMemory_xau16[1].amb_cond.ambient_condition[0][0] ZFEH_EepromData.ydiMemory_xau16[1].amb_cond.ambient_condition[0][10] ZFEH_EepromData.ydiMemory_xau16[1].amb_cond.ambient_condition[0][11] ZFEH_EepromData.ydiMemory_xau16[1].amb_cond.ambient_condition[0][12] ZFEH_EepromData.ydiMemory_xau16[1].amb_cond.ambient_condition[0][13] ZFEH_EepromData.ydiMemory_xau16[1].amb_cond.ambient_condition[0][14] ZFEH_EepromData.ydiMemory_xau16[1].amb_cond.ambient_condition[0][15] ZFEH_EepromData.ydiMemory_xau16[1].amb_cond.ambient_condition[0][16] ZFEH_EepromData.ydiMemory_xau16[1].amb_cond.ambient_condition[0][17] ZFEH_EepromData.ydiMemory_xau16[1].amb_cond.ambient_condition[0][18] ZFEH_EepromData.ydiMemory_xau16[1].amb_cond.ambient_condition[0][19] ZFEH_EepromData.ydiMemory_xau16[1].amb_cond.ambient_condition[0][1] ZFEH_EepromData.ydiMemory_xau16[1].amb_cond.ambient_condition[0][20] ZFEH_EepromData.ydiMemory_xau16[1].amb_cond.ambient_condition[0][21] ZFEH_EepromData.ydiMemory_xau16[1].amb_cond.ambient_condition[0][22] ZFEH_EepromData.ydiMemory_xau16[1].amb_cond.ambient_condition[0][23] ZFEH_EepromData.ydiMemory_xau16[1].amb_cond.ambient_condition[0][24] ZFEH_EepromData.ydiMemory_xau16[1].amb_cond.ambient_condition[0][2] ZFEH_EepromData.ydiMemory_xau16[1].amb_cond.ambient_condition[0][3] ZFEH_EepromData.ydiMemory_xau16[1].amb_cond.ambient_condition[0][4] ZFEH_EepromData.ydiMemory_xau16[1].amb_cond.ambient_condition[0][5] ZFEH_EepromData.ydiMemory_xau16[1].amb_cond.ambient_condition[0][6] ZFEH_EepromData.ydiMemory_xau16[1].amb_cond.ambient_condition[0][7] ZFEH_EepromData.ydiMemory_xau16[1].amb_cond.ambient_condition[0][8] ZFEH_EepromData.ydiMemory_xau16[1].amb_cond.ambient_condition[0][9] ZFEH_EepromData.ydiMemory_xau16[1].amb_cond.ambient_condition[1][0] ZFEH_EepromData.ydiMemory_xau16[1].amb_cond.ambient_condition[1][10] ZFEH_EepromData.ydiMemory_xau16[1].amb_cond.ambient_condition[1][11] ZFEH_EepromData.ydiMemory_xau16[1].amb_cond.ambient_condition[1][12] ZFEH_EepromData.ydiMemory_xau16[1].amb_cond.ambient_condition[1][13] /end LOC_MEASUREMENT
/end FUNCTION
/end MODULE
/end PROJECT
