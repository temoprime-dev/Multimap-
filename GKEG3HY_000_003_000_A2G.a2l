ASAP2_VERSION 1 51
/begin PROJECT _929_929 "Gen2_BMW_System_Supplier_Lib"
/begin HEADER "" VERSION "C_03_03" PROJECT_NO _929_929 /end HEADER
/begin MODULE DIM ""
/begin MOD_COMMON "" BYTE_ORDER MSB_FIRST ALIGNMENT_BYTE 1 ALIGNMENT_WORD 2 ALIGNMENT_LONG 4 ALIGNMENT_FLOAT32_IEEE 4 /end MOD_COMMON
/begin MEASUREMENT ZFFSAB._.CDD_IEP_Control.iv_OperationPointTarget "GET_IEP_ZIELVORGABE from ATSYS returns information which IEP operating point has to be selected. 0=IEP_AUS 1=IEP_SLEEP 2=IEP_LP1 3=IEP_LP2 4=IEP_LP3" UBYTE SAB_STANDARD_S2_S3 1 100 0 4 DISPLAY_IDENTIFIER iv_OperationPointTarget.CDD_IEP_Control._.ZFFSAB ECU_ADDRESS 0xFFF8F4FD /end MEASUREMENT
/begin MEASUREMENT ZFFSAB._.CDD_IEP_Control.iv_f_linComActive "LIN Communication State 1 = LIN Active 0 = No LIN Communication" UBYTE SAB_STANDARD_S2_S3 1 100 0 1 DISPLAY_IDENTIFIER iv_f_linComActive.CDD_IEP_Control._.ZFFSAB ECU_ADDRESS 0xFFF8F4FE /end MEASUREMENT
/begin MEASUREMENT ZFFSAB._.CDD_IEP_Control.iv_c_OilTrans "Getriebeoeltemperatur" UBYTE SAB_C_CEL_M40_S2_S3 1 100 -40 215 DISPLAY_IDENTIFIER iv_c_OilTrans.CDD_IEP_Control._.ZFFSAB ECU_ADDRESS 0xFFF8F4FF /end MEASUREMENT
/begin MEASUREMENT ZFFSAB._.CDD_IEP_Control.iv_f_GetUndervoltageTC "Signalizes if the Voltage Testcondition is fullfilled" UBYTE SAB_STANDARD_S2_S3 1 100 0 1 DISPLAY_IDENTIFIER iv_f_GetUndervoltageTC.CDD_IEP_Control._.ZFFSAB ECU_ADDRESS 0xFFF8F500 /end MEASUREMENT
/begin MEASUREMENT ZFFSAB._.CDD_IEP_Control.iv_f_JumpstartAktiv "Signalizes if Jumpstart is active or not" UBYTE SAB_STANDARD_S2_S3 1 100 0 1 DISPLAY_IDENTIFIER iv_f_JumpstartAktiv.CDD_IEP_Control._.ZFFSAB ECU_ADDRESS 0xFFF8F501 /end MEASUREMENT
/begin MEASUREMENT ZFFSAB._.CDD_IEP_Control.iv_f_iep_limphome "Flag for request for limp home mode to IEP. 0: No request for limphome mode 1: Request for limphome mode" UBYTE SAB_STANDARD_S2_S3 1 100 0 1 DISPLAY_IDENTIFIER iv_f_iep_limphome.CDD_IEP_Control._.ZFFSAB ECU_ADDRESS 0xFFF8F502 /end MEASUREMENT
/begin MEASUREMENT ZFFSAB._.CDD_IEP_Control.iv_ctl_ReqIep "Interface provides requests to IEP. 0x0001 - Off 0x0002 - Sleep 0x0004 - Warm up 0x0010 - Operating point 1 0x0020 - Operating point 2 0x0040 - Operating point 3 0x0400 - Limp home mode" UWORD SAB_STANDARD_S2_S3 1 100 0 1024 DISPLAY_IDENTIFIER iv_ctl_ReqIep.CDD_IEP_Control._.ZFFSAB ECU_ADDRESS 0xFFF8F504 /end MEASUREMENT
/begin MEASUREMENT ZFFSAB._.CDD_IEP_Control.sv_ActualOperationPointIEP "Actual read back of states from LIN IEP and mapped to operating points for ATSYS. 0 = IEP_AUS 1 = IEP_SLEEP 2 = IEP_LP1 3 = IEP_LP2 4 = IEP_LP3" UBYTE SAB_STANDARD_S2_S3 1 100 0 4 DISPLAY_IDENTIFIER sv_ActualOperationPointIEP.CDD_IEP_Control._.ZFFSAB ECU_ADDRESS 0xFFF8F506 /end MEASUREMENT
/begin MEASUREMENT ZFFSAB._.CDD_IEP_Control.sv_LIN_EPumpErr "Bit coded error state of LIN-IEP Bit0: IEP_TEMPORARY_FAILURE Bit1: IEP_PERMANENT_FAILURE Bit2: IEP_COMMUNICATION_FAILURE Error is active for BitX = 1" UBYTE SAB_STANDARD_S2_S3 1 100 0 4 DISPLAY_IDENTIFIER sv_LIN_EPumpErr.CDD_IEP_Control._.ZFFSAB ECU_ADDRESS 0xFFF8F507 /end MEASUREMENT
/begin MEASUREMENT ZFFSAB._.CDD_IEP_Control.f_clearIepErr "If flag is set to 1 IEP shall clear error flags. Set by - Ignition status change from off to on - Errorhandler request mode04 - Change from IEP limphome to normal operating mode Reset from 1 to 0 after IEP clear error command was sent." UBYTE SAB_STANDARD_S2_S3 1 100 0 1 DISPLAY_IDENTIFIER f_clearIepErr.CDD_IEP_Control._.ZFFSAB ECU_ADDRESS 0xFFF8F508 /end MEASUREMENT
/begin MEASUREMENT ZFFSAB._.CDD_IEP_Control.cnt_AliveAtCmdClrErr "Alive counter-1 of tx message where the command IEP Clear Error is send - used to detect transmission" UWORD SAB_STANDARD_S2_S3 1 100 0 1 DISPLAY_IDENTIFIER cnt_AliveAtCmdClrErr.CDD_IEP_Control._.ZFFSAB ECU_ADDRESS 0xFFF8F50A /end MEASUREMENT
/begin MEASUREMENT ZFFSAB._.CDD_IEP_Control.ctl_IEP_Status "Bit coded error flags indicating an error in IEP or communicating to IEP: 0=no error :: errors bit31..bit24=ErrorByte1 bit23..bit16=ErrorByte0 bit13=SWNrErr bit12=HWNrErr bit9=CRC8Err bit8=BusOff bit7=NotReceived bit6..5=- bit4=AliveCnt bit3=LIN Chksum..." ULONG SAB_STANDARD_S2_S3 1 100 0 4294967295
 /begin ANNOTATION ANNOTATION_LABEL "Description"
  /begin ANNOTATION_TEXT "Bit coded error flags indicating an error in IEP or communicating to IEP: 0=no error :: errors bit31..bit24=ErrorByte1 bit23..bit16=ErrorByte0 bit13=SWNrErr bit12=HWNrErr bit9=CRC8Err bit8=BusOff bit7=NotReceived bit6..5=- bit4=AliveCnt bit3=LIN Chksum bi" "t2=- bit1=LINBus bit0=timeout" /end ANNOTATION_TEXT
 /end ANNOTATION
 DISPLAY_IDENTIFIER ctl_IEP_Status.CDD_IEP_Control._.ZFFSAB ECU_ADDRESS 0xFFF8F50C /end MEASUREMENT
/begin MEASUREMENT ZFFSAB._.CDD_IEP_Control.TxMessageStatus[0] "Array of all up to 8 transmit message status. 0x01=Busoff" UBYTE SAB_STANDARD_S2_S3 1 100 0 1 DISPLAY_IDENTIFIER TxMessageStatus[0].CDD_IEP_Control._.ZFFSAB ECU_ADDRESS 0xFFF8F510 /end MEASUREMENT
/begin MEASUREMENT ZFFSAB._.CDD_IEP_Control.TxMessageStatus[1] "Array of all up to 8 transmit message status. 0x01=Busoff" UBYTE SAB_STANDARD_S2_S3 1 100 0 1 DISPLAY_IDENTIFIER TxMessageStatus[1].CDD_IEP_Control._.ZFFSAB ECU_ADDRESS 0xFFF8F511 /end MEASUREMENT
/begin MEASUREMENT ZFFSAB._.CDD_IEP_Control.TxMessageStatus[2] "Array of all up to 8 transmit message status. 0x01=Busoff" UBYTE SAB_STANDARD_S2_S3 1 100 0 1 DISPLAY_IDENTIFIER TxMessageStatus[2].CDD_IEP_Control._.ZFFSAB ECU_ADDRESS 0xFFF8F512 /end MEASUREMENT
/begin MEASUREMENT ZFFSAB._.CDD_IEP_Control.TxMessageStatus[3] "Array of all up to 8 transmit message status. 0x01=Busoff" UBYTE SAB_STANDARD_S2_S3 1 100 0 1 DISPLAY_IDENTIFIER TxMessageStatus[3].CDD_IEP_Control._.ZFFSAB ECU_ADDRESS 0xFFF8F513 /end MEASUREMENT
/begin MEASUREMENT ZFFSAB._.CDD_IEP_Control.TxMessageStatus[4] "Array of all up to 8 transmit message status. 0x01=Busoff" UBYTE SAB_STANDARD_S2_S3 1 100 0 1 DISPLAY_IDENTIFIER TxMessageStatus[4].CDD_IEP_Control._.ZFFSAB ECU_ADDRESS 0xFFF8F514 /end MEASUREMENT
/begin MEASUREMENT ZFFSAB._.CDD_IEP_Control.TxMessageStatus[5] "Array of all up to 8 transmit message status. 0x01=Busoff" UBYTE SAB_STANDARD_S2_S3 1 100 0 1 DISPLAY_IDENTIFIER TxMessageStatus[5].CDD_IEP_Control._.ZFFSAB ECU_ADDRESS 0xFFF8F515 /end MEASUREMENT
/begin MEASUREMENT ZFFSAB._.CDD_IEP_Control.TxMessageStatus[6] "Array of all up to 8 transmit message status. 0x01=Busoff" UBYTE SAB_STANDARD_S2_S3 1 100 0 1 DISPLAY_IDENTIFIER TxMessageStatus[6].CDD_IEP_Control._.ZFFSAB ECU_ADDRESS 0xFFF8F516 /end MEASUREMENT
/begin MEASUREMENT ZFFSAB._.CDD_IEP_Control.TxMessageStatus[7] "Array of all up to 8 transmit message status. 0x01=Busoff" UBYTE SAB_STANDARD_S2_S3 1 100 0 1 DISPLAY_IDENTIFIER TxMessageStatus[7].CDD_IEP_Control._.ZFFSAB ECU_ADDRESS 0xFFF8F517 /end MEASUREMENT
/begin MEASUREMENT ZFFSAB._.CDD_IEP_Control.RxMessageStatus[0] "Array of all up to 8 receive message status. 0x0200=CRC8Err 0x0100=Busoff LowByte=GETBUS2_RX_STATUS" UWORD SAB_STANDARD_S2_S3 1 100 0 1023 DISPLAY_IDENTIFIER RxMessageStatus[0].CDD_IEP_Control._.ZFFSAB ECU_ADDRESS 0xFFF8F518 /end MEASUREMENT
/begin MEASUREMENT ZFFSAB._.CDD_IEP_Control.RxMessageStatus[1] "Array of all up to 8 receive message status. 0x0200=CRC8Err 0x0100=Busoff LowByte=GETBUS2_RX_STATUS" UWORD SAB_STANDARD_S2_S3 1 100 0 1023 DISPLAY_IDENTIFIER RxMessageStatus[1].CDD_IEP_Control._.ZFFSAB ECU_ADDRESS 0xFFF8F51A /end MEASUREMENT
/begin MEASUREMENT ZFFSAB._.CDD_IEP_Control.RxMessageStatus[2] "Array of all up to 8 receive message status. 0x0200=CRC8Err 0x0100=Busoff LowByte=GETBUS2_RX_STATUS" UWORD SAB_STANDARD_S2_S3 1 100 0 1023 DISPLAY_IDENTIFIER RxMessageStatus[2].CDD_IEP_Control._.ZFFSAB ECU_ADDRESS 0xFFF8F51C /end MEASUREMENT
/begin MEASUREMENT ZFFSAB._.CDD_IEP_Control.RxMessageStatus[3] "Array of all up to 8 receive message status. 0x0200=CRC8Err 0x0100=Busoff LowByte=GETBUS2_RX_STATUS" UWORD SAB_STANDARD_S2_S3 1 100 0 1023 DISPLAY_IDENTIFIER RxMessageStatus[3].CDD_IEP_Control._.ZFFSAB ECU_ADDRESS 0xFFF8F51E /end MEASUREMENT
/begin MEASUREMENT ZFFSAB._.CDD_IEP_Control.RxMessageStatus[4] "Array of all up to 8 receive message status. 0x0200=CRC8Err 0x0100=Busoff LowByte=GETBUS2_RX_STATUS" UWORD SAB_STANDARD_S2_S3 1 100 0 1023 DISPLAY_IDENTIFIER RxMessageStatus[4].CDD_IEP_Control._.ZFFSAB ECU_ADDRESS 0xFFF8F520 /end MEASUREMENT
/begin MEASUREMENT ZFFSAB._.CDD_IEP_Control.RxMessageStatus[5] "Array of all up to 8 receive message status. 0x0200=CRC8Err 0x0100=Busoff LowByte=GETBUS2_RX_STATUS" UWORD SAB_STANDARD_S2_S3 1 100 0 1023 DISPLAY_IDENTIFIER RxMessageStatus[5].CDD_IEP_Control._.ZFFSAB ECU_ADDRESS 0xFFF8F522 /end MEASUREMENT
/begin MEASUREMENT ZFFSAB._.CDD_IEP_Control.RxMessageStatus[6] "Array of all up to 8 receive message status. 0x0200=CRC8Err 0x0100=Busoff LowByte=GETBUS2_RX_STATUS" UWORD SAB_STANDARD_S2_S3 1 100 0 1023 DISPLAY_IDENTIFIER RxMessageStatus[6].CDD_IEP_Control._.ZFFSAB ECU_ADDRESS 0xFFF8F524 /end MEASUREMENT
/begin MEASUREMENT ZFFSAB._.CDD_IEP_Control.RxMessageStatus[7] "Array of all up to 8 receive message status. 0x0200=CRC8Err 0x0100=Busoff LowByte=GETBUS2_RX_STATUS" UWORD SAB_STANDARD_S2_S3 1 100 0 1023 DISPLAY_IDENTIFIER RxMessageStatus[7].CDD_IEP_Control._.ZFFSAB ECU_ADDRESS 0xFFF8F526 /end MEASUREMENT
/begin MEASUREMENT ZFFSAB._.CDD_IEP_Control.RxMessage0IdData[0] "Array of RxPID and the 8 data bytes of LIN receive Message 0 with RxMessageIndex=0. In default configuration used for MsgID=0x32" UBYTE SAB_STANDARD_S2_S3 1 100 0 255 DISPLAY_IDENTIFIER RxMessage0IdData[0].CDD_IEP_Control._.ZFFSAB ECU_ADDRESS 0xFFF8F528 /end MEASUREMENT
/begin MEASUREMENT ZFFSAB._.CDD_IEP_Control.RxMessage0IdData[1] "Array of RxPID and the 8 data bytes of LIN receive Message 0 with RxMessageIndex=0. In default configuration used for MsgID=0x32" UBYTE SAB_STANDARD_S2_S3 1 100 0 255 DISPLAY_IDENTIFIER RxMessage0IdData[1].CDD_IEP_Control._.ZFFSAB ECU_ADDRESS 0xFFF8F529 /end MEASUREMENT
/begin MEASUREMENT ZFFSAB._.CDD_IEP_Control.RxMessage0IdData[2] "Array of RxPID and the 8 data bytes of LIN receive Message 0 with RxMessageIndex=0. In default configuration used for MsgID=0x32" UBYTE SAB_STANDARD_S2_S3 1 100 0 255 DISPLAY_IDENTIFIER RxMessage0IdData[2].CDD_IEP_Control._.ZFFSAB ECU_ADDRESS 0xFFF8F52A /end MEASUREMENT
/begin MEASUREMENT ZFFSAB._.CDD_IEP_Control.RxMessage0IdData[3] "Array of RxPID and the 8 data bytes of LIN receive Message 0 with RxMessageIndex=0. In default configuration used for MsgID=0x32" UBYTE SAB_STANDARD_S2_S3 1 100 0 255 DISPLAY_IDENTIFIER RxMessage0IdData[3].CDD_IEP_Control._.ZFFSAB ECU_ADDRESS 0xFFF8F52B /end MEASUREMENT
/begin MEASUREMENT ZFFSAB._.CDD_IEP_Control.RxMessage0IdData[4] "Array of RxPID and the 8 data bytes of LIN receive Message 0 with RxMessageIndex=0. In default configuration used for MsgID=0x32" UBYTE SAB_STANDARD_S2_S3 1 100 0 255 DISPLAY_IDENTIFIER RxMessage0IdData[4].CDD_IEP_Control._.ZFFSAB ECU_ADDRESS 0xFFF8F52C /end MEASUREMENT
/begin MEASUREMENT ZFFSAB._.CDD_IEP_Control.RxMessage0IdData[5] "Array of RxPID and the 8 data bytes of LIN receive Message 0 with RxMessageIndex=0. In default configuration used for MsgID=0x32" UBYTE SAB_STANDARD_S2_S3 1 100 0 255 DISPLAY_IDENTIFIER RxMessage0IdData[5].CDD_IEP_Control._.ZFFSAB ECU_ADDRESS 0xFFF8F52D /end MEASUREMENT
/begin MEASUREMENT ZFFSAB._.CDD_IEP_Control.RxMessage0IdData[6] "Array of RxPID and the 8 data bytes of LIN receive Message 0 with RxMessageIndex=0. In default configuration used for MsgID=0x32" UBYTE SAB_STANDARD_S2_S3 1 100 0 255 DISPLAY_IDENTIFIER RxMessage0IdData[6].CDD_IEP_Control._.ZFFSAB ECU_ADDRESS 0xFFF8F52E /end MEASUREMENT
/begin MEASUREMENT ZFFSAB._.CDD_IEP_Control.RxMessage0IdData[7] "Array of RxPID and the 8 data bytes of LIN receive Message 0 with RxMessageIndex=0. In default configuration used for MsgID=0x32" UBYTE SAB_STANDARD_S2_S3 1 100 0 255 DISPLAY_IDENTIFIER RxMessage0IdData[7].CDD_IEP_Control._.ZFFSAB ECU_ADDRESS 0xFFF8F52F /end MEASUREMENT
/begin MEASUREMENT ZFFSAB._.CDD_IEP_Control.RxMessage0IdData[8] "Array of RxPID and the 8 data bytes of LIN receive Message 0 with RxMessageIndex=0. In default configuration used for MsgID=0x32" UBYTE SAB_STANDARD_S2_S3 1 100 0 255 DISPLAY_IDENTIFIER RxMessage0IdData[8].CDD_IEP_Control._.ZFFSAB ECU_ADDRESS 0xFFF8F530 /end MEASUREMENT
/begin MEASUREMENT ZFFSAB._.CDD_IEP_Control.RxMessage1IdData[0] "Array of RxPID and the 8 data bytes of LIN receive Message 1 with RxMessageIndex=1. In default configuration used for MsgID=0x33" UBYTE SAB_STANDARD_S2_S3 1 100 0 255 DISPLAY_IDENTIFIER RxMessage1IdData[0].CDD_IEP_Control._.ZFFSAB ECU_ADDRESS 0xFFF8F531 /end MEASUREMENT
/begin MEASUREMENT ZFFSAB._.CDD_IEP_Control.RxMessage1IdData[1] "Array of RxPID and the 8 data bytes of LIN receive Message 1 with RxMessageIndex=1. In default configuration used for MsgID=0x33" UBYTE SAB_STANDARD_S2_S3 1 100 0 255 DISPLAY_IDENTIFIER RxMessage1IdData[1].CDD_IEP_Control._.ZFFSAB ECU_ADDRESS 0xFFF8F532 /end MEASUREMENT
/begin MEASUREMENT ZFFSAB._.CDD_IEP_Control.RxMessage1IdData[2] "Array of RxPID and the 8 data bytes of LIN receive Message 1 with RxMessageIndex=1. In default configuration used for MsgID=0x33" UBYTE SAB_STANDARD_S2_S3 1 100 0 255 DISPLAY_IDENTIFIER RxMessage1IdData[2].CDD_IEP_Control._.ZFFSAB ECU_ADDRESS 0xFFF8F533 /end MEASUREMENT
/begin MEASUREMENT ZFFSAB._.CDD_IEP_Control.RxMessage1IdData[3] "Array of RxPID and the 8 data bytes of LIN receive Message 1 with RxMessageIndex=1. In default configuration used for MsgID=0x33" UBYTE SAB_STANDARD_S2_S3 1 100 0 255 DISPLAY_IDENTIFIER RxMessage1IdData[3].CDD_IEP_Control._.ZFFSAB ECU_ADDRESS 0xFFF8F534 /end MEASUREMENT
/begin MEASUREMENT ZFFSAB._.CDD_IEP_Control.RxMessage1IdData[4] "Array of RxPID and the 8 data bytes of LIN receive Message 1 with RxMessageIndex=1. In default configuration used for MsgID=0x33" UBYTE SAB_STANDARD_S2_S3 1 100 0 255 DISPLAY_IDENTIFIER RxMessage1IdData[4].CDD_IEP_Control._.ZFFSAB ECU_ADDRESS 0xFFF8F535 /end MEASUREMENT
/begin MEASUREMENT ZFFSAB._.CDD_IEP_Control.RxMessage1IdData[5] "Array of RxPID and the 8 data bytes of LIN receive Message 1 with RxMessageIndex=1. In default configuration used for MsgID=0x33" UBYTE SAB_STANDARD_S2_S3 1 100 0 255 DISPLAY_IDENTIFIER RxMessage1IdData[5].CDD_IEP_Control._.ZFFSAB ECU_ADDRESS 0xFFF8F536 /end MEASUREMENT
/begin MEASUREMENT ZFFSAB._.CDD_IEP_Control.RxMessage1IdData[6] "Array of RxPID and the 8 data bytes of LIN receive Message 1 with RxMessageIndex=1. In default configuration used for MsgID=0x33" UBYTE SAB_STANDARD_S2_S3 1 100 0 255 DISPLAY_IDENTIFIER RxMessage1IdData[6].CDD_IEP_Control._.ZFFSAB ECU_ADDRESS 0xFFF8F537 /end MEASUREMENT
/begin MEASUREMENT ZFFSAB._.CDD_IEP_Control.RxMessage1IdData[7] "Array of RxPID and the 8 data bytes of LIN receive Message 1 with RxMessageIndex=1. In default configuration used for MsgID=0x33" UBYTE SAB_STANDARD_S2_S3 1 100 0 255 DISPLAY_IDENTIFIER RxMessage1IdData[7].CDD_IEP_Control._.ZFFSAB ECU_ADDRESS 0xFFF8F538 /end MEASUREMENT
/begin MEASUREMENT ZFFSAB._.CDD_IEP_Control.RxMessage1IdData[8] "Array of RxPID and the 8 data bytes of LIN receive Message 1 with RxMessageIndex=1. In default configuration used for MsgID=0x33" UBYTE SAB_STANDARD_S2_S3 1 100 0 255 DISPLAY_IDENTIFIER RxMessage1IdData[8].CDD_IEP_Control._.ZFFSAB ECU_ADDRESS 0xFFF8F539 /end MEASUREMENT
/begin MEASUREMENT ZFFSAB._.CDD_IEP_Control.RxMessage2IdData[0] "Array of RxPID and the 8 data bytes of LIN receive Message 2 with RxMessageIndex=2. In default configuration used for MsgID=0x34" UBYTE SAB_STANDARD_S2_S3 1 100 0 255 DISPLAY_IDENTIFIER RxMessage2IdData[0].CDD_IEP_Control._.ZFFSAB ECU_ADDRESS 0xFFF8F53A /end MEASUREMENT
/begin MEASUREMENT ZFFSAB._.CDD_IEP_Control.RxMessage2IdData[1] "Array of RxPID and the 8 data bytes of LIN receive Message 2 with RxMessageIndex=2. In default configuration used for MsgID=0x34" UBYTE SAB_STANDARD_S2_S3 1 100 0 255 DISPLAY_IDENTIFIER RxMessage2IdData[1].CDD_IEP_Control._.ZFFSAB ECU_ADDRESS 0xFFF8F53B /end MEASUREMENT
/begin MEASUREMENT ZFFSAB._.CDD_IEP_Control.RxMessage2IdData[2] "Array of RxPID and the 8 data bytes of LIN receive Message 2 with RxMessageIndex=2. In default configuration used for MsgID=0x34" UBYTE SAB_STANDARD_S2_S3 1 100 0 255 DISPLAY_IDENTIFIER RxMessage2IdData[2].CDD_IEP_Control._.ZFFSAB ECU_ADDRESS 0xFFF8F53C /end MEASUREMENT
/begin MEASUREMENT ZFFSAB._.CDD_IEP_Control.RxMessage2IdData[3] "Array of RxPID and the 8 data bytes of LIN receive Message 2 with RxMessageIndex=2. In default configuration used for MsgID=0x34" UBYTE SAB_STANDARD_S2_S3 1 100 0 255 DISPLAY_IDENTIFIER RxMessage2IdData[3].CDD_IEP_Control._.ZFFSAB ECU_ADDRESS 0xFFF8F53D /end MEASUREMENT
/begin MEASUREMENT ZFFSAB._.CDD_IEP_Control.RxMessage2IdData[4] "Array of RxPID and the 8 data bytes of LIN receive Message 2 with RxMessageIndex=2. In default configuration used for MsgID=0x34" UBYTE SAB_STANDARD_S2_S3 1 100 0 255 DISPLAY_IDENTIFIER RxMessage2IdData[4].CDD_IEP_Control._.ZFFSAB ECU_ADDRESS 0xFFF8F53E /end MEASUREMENT
/begin MEASUREMENT ZFFSAB._.CDD_IEP_Control.RxMessage2IdData[5] "Array of RxPID and the 8 data bytes of LIN receive Message 2 with RxMessageIndex=2. In default configuration used for MsgID=0x34" UBYTE SAB_STANDARD_S2_S3 1 100 0 255 DISPLAY_IDENTIFIER RxMessage2IdData[5].CDD_IEP_Control._.ZFFSAB ECU_ADDRESS 0xFFF8F53F /end MEASUREMENT
/begin MEASUREMENT ZFFSAB._.CDD_IEP_Control.RxMessage2IdData[6] "Array of RxPID and the 8 data bytes of LIN receive Message 2 with RxMessageIndex=2. In default configuration used for MsgID=0x34" UBYTE SAB_STANDARD_S2_S3 1 100 0 255 DISPLAY_IDENTIFIER RxMessage2IdData[6].CDD_IEP_Control._.ZFFSAB ECU_ADDRESS 0xFFF8F540 /end MEASUREMENT
/begin MEASUREMENT ZFFSAB._.CDD_IEP_Control.RxMessage2IdData[7] "Array of RxPID and the 8 data bytes of LIN receive Message 2 with RxMessageIndex=2. In default configuration used for MsgID=0x34" UBYTE SAB_STANDARD_S2_S3 1 100 0 255 DISPLAY_IDENTIFIER RxMessage2IdData[7].CDD_IEP_Control._.ZFFSAB ECU_ADDRESS 0xFFF8F541 /end MEASUREMENT
/begin MEASUREMENT ZFFSAB._.CDD_IEP_Control.RxMessage2IdData[8] "Array of RxPID and the 8 data bytes of LIN receive Message 2 with RxMessageIndex=2. In default configuration used for MsgID=0x34" UBYTE SAB_STANDARD_S2_S3 1 100 0 255 DISPLAY_IDENTIFIER RxMessage2IdData[8].CDD_IEP_Control._.ZFFSAB ECU_ADDRESS 0xFFF8F542 /end MEASUREMENT
/begin MEASUREMENT ZFFSAB._.CDD_IEP_Control.RxMessageAliveCntExp[0] "Array of all up to 8 expected alive counters of all possible LIN receive messages" UWORD SAB_STANDARD_S2_S3 1 100 0 65535 DISPLAY_IDENTIFIER RxMessageAliveCntExp[0].CDD_IEP_Control._.ZFFSAB ECU_ADDRESS 0xFFF8F544 /end MEASUREMENT
/begin MEASUREMENT ZFFSAB._.CDD_IEP_Control.RxMessageAliveCntExp[1] "Array of all up to 8 expected alive counters of all possible LIN receive messages" UWORD SAB_STANDARD_S2_S3 1 100 0 65535 DISPLAY_IDENTIFIER RxMessageAliveCntExp[1].CDD_IEP_Control._.ZFFSAB ECU_ADDRESS 0xFFF8F546 /end MEASUREMENT
/begin MEASUREMENT ZFFSAB._.CDD_IEP_Control.RxMessageAliveCntExp[2] "Array of all up to 8 expected alive counters of all possible LIN receive messages" UWORD SAB_STANDARD_S2_S3 1 100 0 65535 DISPLAY_IDENTIFIER RxMessageAliveCntExp[2].CDD_IEP_Control._.ZFFSAB ECU_ADDRESS 0xFFF8F548 /end MEASUREMENT
/begin MEASUREMENT ZFFSAB._.CDD_IEP_Control.RxMessageAliveCntExp[3] "Array of all up to 8 expected alive counters of all possible LIN receive messages" UWORD SAB_STANDARD_S2_S3 1 100 0 65535 DISPLAY_IDENTIFIER RxMessageAliveCntExp[3].CDD_IEP_Control._.ZFFSAB ECU_ADDRESS 0xFFF8F54A /end MEASUREMENT
/begin MEASUREMENT ZFFSAB._.CDD_IEP_Control.RxMessageAliveCntExp[4] "Array of all up to 8 expected alive counters of all possible LIN receive messages" UWORD SAB_STANDARD_S2_S3 1 100 0 65535 DISPLAY_IDENTIFIER RxMessageAliveCntExp[4].CDD_IEP_Control._.ZFFSAB ECU_ADDRESS 0xFFF8F54C /end MEASUREMENT
/begin MEASUREMENT ZFFSAB._.CDD_IEP_Control.RxMessageAliveCntExp[5] "Array of all up to 8 expected alive counters of all possible LIN receive messages" UWORD SAB_STANDARD_S2_S3 1 100 0 65535 DISPLAY_IDENTIFIER RxMessageAliveCntExp[5].CDD_IEP_Control._.ZFFSAB ECU_ADDRESS 0xFFF8F54E /end MEASUREMENT
/begin MEASUREMENT ZFFSAB._.CDD_IEP_Control.RxMessageAliveCntExp[6] "Array of all up to 8 expected alive counters of all possible LIN receive messages" UWORD SAB_STANDARD_S2_S3 1 100 0 65535 DISPLAY_IDENTIFIER RxMessageAliveCntExp[6].CDD_IEP_Control._.ZFFSAB ECU_ADDRESS 0xFFF8F550 /end MEASUREMENT
/begin MEASUREMENT ZFFSAB._.CDD_IEP_Control.RxMessageAliveCntExp[7] "Array of all up to 8 expected alive counters of all possible LIN receive messages" UWORD SAB_STANDARD_S2_S3 1 100 0 65535 DISPLAY_IDENTIFIER RxMessageAliveCntExp[7].CDD_IEP_Control._.ZFFSAB ECU_ADDRESS 0xFFF8F552 /end MEASUREMENT
/begin MEASUREMENT ZFFSAB._.CDD_IEP_Control.RxMessageAliveStuckCnt[0] "Array of all up to 8 stuck counters of alive signal of all possible LIN receive messages" UBYTE SAB_STANDARD_S2_S3 1 100 0 255 DISPLAY_IDENTIFIER RxMessageAliveStuckCnt[0].CDD_IEP_Control._.ZFFSAB ECU_ADDRESS 0xFFF8F554 /end MEASUREMENT
/begin MEASUREMENT ZFFSAB._.CDD_IEP_Control.RxMessageAliveStuckCnt[1] "Array of all up to 8 stuck counters of alive signal of all possible LIN receive messages" UBYTE SAB_STANDARD_S2_S3 1 100 0 255 DISPLAY_IDENTIFIER RxMessageAliveStuckCnt[1].CDD_IEP_Control._.ZFFSAB ECU_ADDRESS 0xFFF8F555 /end MEASUREMENT
/begin MEASUREMENT ZFFSAB._.CDD_IEP_Control.RxMessageAliveStuckCnt[2] "Array of all up to 8 stuck counters of alive signal of all possible LIN receive messages" UBYTE SAB_STANDARD_S2_S3 1 100 0 255 DISPLAY_IDENTIFIER RxMessageAliveStuckCnt[2].CDD_IEP_Control._.ZFFSAB ECU_ADDRESS 0xFFF8F556 /end MEASUREMENT
/begin MEASUREMENT ZFFSAB._.CDD_IEP_Control.RxMessageAliveStuckCnt[3] "Array of all up to 8 stuck counters of alive signal of all possible LIN receive messages" UBYTE SAB_STANDARD_S2_S3 1 100 0 255 DISPLAY_IDENTIFIER RxMessageAliveStuckCnt[3].CDD_IEP_Control._.ZFFSAB ECU_ADDRESS 0xFFF8F557 /end MEASUREMENT
/begin MEASUREMENT ZFFSAB._.CDD_IEP_Control.RxMessageAliveStuckCnt[4] "Array of all up to 8 stuck counters of alive signal of all possible LIN receive messages" UBYTE SAB_STANDARD_S2_S3 1 100 0 255 DISPLAY_IDENTIFIER RxMessageAliveStuckCnt[4].CDD_IEP_Control._.ZFFSAB ECU_ADDRESS 0xFFF8F558 /end MEASUREMENT
/begin MEASUREMENT ZFFSAB._.CDD_IEP_Control.RxMessageAliveStuckCnt[5] "Array of all up to 8 stuck counters of alive signal of all possible LIN receive messages" UBYTE SAB_STANDARD_S2_S3 1 100 0 255 DISPLAY_IDENTIFIER RxMessageAliveStuckCnt[5].CDD_IEP_Control._.ZFFSAB ECU_ADDRESS 0xFFF8F559 /end MEASUREMENT
/begin MEASUREMENT ZFFSAB._.CDD_IEP_Control.RxMessageAliveStuckCnt[6] "Array of all up to 8 stuck counters of alive signal of all possible LIN receive messages" UBYTE SAB_STANDARD_S2_S3 1 100 0 255 DISPLAY_IDENTIFIER RxMessageAliveStuckCnt[6].CDD_IEP_Control._.ZFFSAB ECU_ADDRESS 0xFFF8F55A /end MEASUREMENT
/begin MEASUREMENT ZFFSAB._.CDD_IEP_Control.RxMessageAliveStuckCnt[7] "Array of all up to 8 stuck counters of alive signal of all possible LIN receive messages" UBYTE SAB_STANDARD_S2_S3 1 100 0 255 DISPLAY_IDENTIFIER RxMessageAliveStuckCnt[7].CDD_IEP_Control._.ZFFSAB ECU_ADDRESS 0xFFF8F55B /end MEASUREMENT
/begin MEASUREMENT ZFFSAB._.CDD_IEP_Control.RxMessageCRC8ErrCnt[0] "Array of all up to 8 CRC error counters of all possible LIN receive messages" UBYTE SAB_STANDARD_S2_S3 1 100 0 255 DISPLAY_IDENTIFIER RxMessageCRC8ErrCnt[0].CDD_IEP_Control._.ZFFSAB ECU_ADDRESS 0xFFF8F55C /end MEASUREMENT
/begin MEASUREMENT ZFFSAB._.CDD_IEP_Control.RxMessageCRC8ErrCnt[1] "Array of all up to 8 CRC error counters of all possible LIN receive messages" UBYTE SAB_STANDARD_S2_S3 1 100 0 255 DISPLAY_IDENTIFIER RxMessageCRC8ErrCnt[1].CDD_IEP_Control._.ZFFSAB ECU_ADDRESS 0xFFF8F55D /end MEASUREMENT
/begin MEASUREMENT ZFFSAB._.CDD_IEP_Control.RxMessageCRC8ErrCnt[2] "Array of all up to 8 CRC error counters of all possible LIN receive messages" UBYTE SAB_STANDARD_S2_S3 1 100 0 255 DISPLAY_IDENTIFIER RxMessageCRC8ErrCnt[2].CDD_IEP_Control._.ZFFSAB ECU_ADDRESS 0xFFF8F55E /end MEASUREMENT
/begin MEASUREMENT ZFFSAB._.CDD_IEP_Control.RxMessageCRC8ErrCnt[3] "Array of all up to 8 CRC error counters of all possible LIN receive messages" UBYTE SAB_STANDARD_S2_S3 1 100 0 255 DISPLAY_IDENTIFIER RxMessageCRC8ErrCnt[3].CDD_IEP_Control._.ZFFSAB ECU_ADDRESS 0xFFF8F55F /end MEASUREMENT
/begin MEASUREMENT ZFFSAB._.CDD_IEP_Control.RxMessageCRC8ErrCnt[4] "Array of all up to 8 CRC error counters of all possible LIN receive messages" UBYTE SAB_STANDARD_S2_S3 1 100 0 255 DISPLAY_IDENTIFIER RxMessageCRC8ErrCnt[4].CDD_IEP_Control._.ZFFSAB ECU_ADDRESS 0xFFF8F560 /end MEASUREMENT
/begin MEASUREMENT ZFFSAB._.CDD_IEP_Control.RxMessageCRC8ErrCnt[5] "Array of all up to 8 CRC error counters of all possible LIN receive messages" UBYTE SAB_STANDARD_S2_S3 1 100 0 255 DISPLAY_IDENTIFIER RxMessageCRC8ErrCnt[5].CDD_IEP_Control._.ZFFSAB ECU_ADDRESS 0xFFF8F561 /end MEASUREMENT
/begin MEASUREMENT ZFFSAB._.CDD_IEP_Control.RxMessageCRC8ErrCnt[6] "Array of all up to 8 CRC error counters of all possible LIN receive messages" UBYTE SAB_STANDARD_S2_S3 1 100 0 255 DISPLAY_IDENTIFIER RxMessageCRC8ErrCnt[6].CDD_IEP_Control._.ZFFSAB ECU_ADDRESS 0xFFF8F562 /end MEASUREMENT
/begin MEASUREMENT ZFFSAB._.CDD_IEP_Control.RxMessageCRC8ErrCnt[7] "Array of all up to 8 CRC error counters of all possible LIN receive messages" UBYTE SAB_STANDARD_S2_S3 1 100 0 255 DISPLAY_IDENTIFIER RxMessageCRC8ErrCnt[7].CDD_IEP_Control._.ZFFSAB ECU_ADDRESS 0xFFF8F563 /end MEASUREMENT
/begin MEASUREMENT ZFFSAB._.CDD_IEP_Control.TxMessage0Data[0] "Array of 8 data bytes of LIN transmit Message 0 with TxMessageIndex=0" UBYTE SAB_STANDARD_S2_S3 1 100 0 255 DISPLAY_IDENTIFIER TxMessage0Data[0].CDD_IEP_Control._.ZFFSAB ECU_ADDRESS 0xFFF8F564 /end MEASUREMENT
/begin MEASUREMENT ZFFSAB._.CDD_IEP_Control.TxMessage0Data[1] "Array of 8 data bytes of LIN transmit Message 0 with TxMessageIndex=0" UBYTE SAB_STANDARD_S2_S3 1 100 0 255 DISPLAY_IDENTIFIER TxMessage0Data[1].CDD_IEP_Control._.ZFFSAB ECU_ADDRESS 0xFFF8F565 /end MEASUREMENT
/begin MEASUREMENT ZFFSAB._.CDD_IEP_Control.TxMessage0Data[2] "Array of 8 data bytes of LIN transmit Message 0 with TxMessageIndex=0" UBYTE SAB_STANDARD_S2_S3 1 100 0 255 DISPLAY_IDENTIFIER TxMessage0Data[2].CDD_IEP_Control._.ZFFSAB ECU_ADDRESS 0xFFF8F566 /end MEASUREMENT
/begin MEASUREMENT ZFFSAB._.CDD_IEP_Control.TxMessage0Data[3] "Array of 8 data bytes of LIN transmit Message 0 with TxMessageIndex=0" UBYTE SAB_STANDARD_S2_S3 1 100 0 255 DISPLAY_IDENTIFIER TxMessage0Data[3].CDD_IEP_Control._.ZFFSAB ECU_ADDRESS 0xFFF8F567 /end MEASUREMENT
/begin MEASUREMENT ZFFSAB._.CDD_IEP_Control.TxMessage0Data[4] "Array of 8 data bytes of LIN transmit Message 0 with TxMessageIndex=0" UBYTE SAB_STANDARD_S2_S3 1 100 0 255 DISPLAY_IDENTIFIER TxMessage0Data[4].CDD_IEP_Control._.ZFFSAB ECU_ADDRESS 0xFFF8F568 /end MEASUREMENT
/begin MEASUREMENT ZFFSAB._.CDD_IEP_Control.TxMessage0Data[5] "Array of 8 data bytes of LIN transmit Message 0 with TxMessageIndex=0" UBYTE SAB_STANDARD_S2_S3 1 100 0 255 DISPLAY_IDENTIFIER TxMessage0Data[5].CDD_IEP_Control._.ZFFSAB ECU_ADDRESS 0xFFF8F569 /end MEASUREMENT
/begin MEASUREMENT ZFFSAB._.CDD_IEP_Control.TxMessage0Data[6] "Array of 8 data bytes of LIN transmit Message 0 with TxMessageIndex=0" UBYTE SAB_STANDARD_S2_S3 1 100 0 255 DISPLAY_IDENTIFIER TxMessage0Data[6].CDD_IEP_Control._.ZFFSAB ECU_ADDRESS 0xFFF8F56A /end MEASUREMENT
/begin MEASUREMENT ZFFSAB._.CDD_IEP_Control.TxMessage0Data[7] "Array of 8 data bytes of LIN transmit Message 0 with TxMessageIndex=0" UBYTE SAB_STANDARD_S2_S3 1 100 0 255 DISPLAY_IDENTIFIER TxMessage0Data[7].CDD_IEP_Control._.ZFFSAB ECU_ADDRESS 0xFFF8F56B /end MEASUREMENT
/begin MEASUREMENT ZFFSAB._.CDD_IEP_Control.TxMessage1Data[0] "Array of 8 data bytes of LIN transmit Message 1 with TxMessageIndex=1" UBYTE SAB_STANDARD_S2_S3 1 100 0 255 DISPLAY_IDENTIFIER TxMessage1Data[0].CDD_IEP_Control._.ZFFSAB ECU_ADDRESS 0xFFF8F56C /end MEASUREMENT
/begin MEASUREMENT ZFFSAB._.CDD_IEP_Control.TxMessage1Data[1] "Array of 8 data bytes of LIN transmit Message 1 with TxMessageIndex=1" UBYTE SAB_STANDARD_S2_S3 1 100 0 255 DISPLAY_IDENTIFIER TxMessage1Data[1].CDD_IEP_Control._.ZFFSAB ECU_ADDRESS 0xFFF8F56D /end MEASUREMENT
/begin MEASUREMENT ZFFSAB._.CDD_IEP_Control.TxMessage1Data[2] "Array of 8 data bytes of LIN transmit Message 1 with TxMessageIndex=1" UBYTE SAB_STANDARD_S2_S3 1 100 0 255 DISPLAY_IDENTIFIER TxMessage1Data[2].CDD_IEP_Control._.ZFFSAB ECU_ADDRESS 0xFFF8F56E /end MEASUREMENT
/begin MEASUREMENT ZFFSAB._.CDD_IEP_Control.TxMessage1Data[3] "Array of 8 data bytes of LIN transmit Message 1 with TxMessageIndex=1" UBYTE SAB_STANDARD_S2_S3 1 100 0 255 DISPLAY_IDENTIFIER TxMessage1Data[3].CDD_IEP_Control._.ZFFSAB ECU_ADDRESS 0xFFF8F56F /end MEASUREMENT
/begin MEASUREMENT ZFFSAB._.CDD_IEP_Control.TxMessage1Data[4] "Array of 8 data bytes of LIN transmit Message 1 with TxMessageIndex=1" UBYTE SAB_STANDARD_S2_S3 1 100 0 255 DISPLAY_IDENTIFIER TxMessage1Data[4].CDD_IEP_Control._.ZFFSAB ECU_ADDRESS 0xFFF8F570 /end MEASUREMENT
/begin MEASUREMENT ZFFSAB._.CDD_IEP_Control.TxMessage1Data[5] "Array of 8 data bytes of LIN transmit Message 1 with TxMessageIndex=1" UBYTE SAB_STANDARD_S2_S3 1 100 0 255 DISPLAY_IDENTIFIER TxMessage1Data[5].CDD_IEP_Control._.ZFFSAB ECU_ADDRESS 0xFFF8F571 /end MEASUREMENT
/begin MEASUREMENT ZFFSAB._.CDD_IEP_Control.TxMessage1Data[6] "Array of 8 data bytes of LIN transmit Message 1 with TxMessageIndex=1" UBYTE SAB_STANDARD_S2_S3 1 100 0 255 DISPLAY_IDENTIFIER TxMessage1Data[6].CDD_IEP_Control._.ZFFSAB ECU_ADDRESS 0xFFF8F572 /end MEASUREMENT
/begin MEASUREMENT ZFFSAB._.CDD_IEP_Control.TxMessage1Data[7] "Array of 8 data bytes of LIN transmit Message 1 with TxMessageIndex=1" UBYTE SAB_STANDARD_S2_S3 1 100 0 255 DISPLAY_IDENTIFIER TxMessage1Data[7].CDD_IEP_Control._.ZFFSAB ECU_ADDRESS 0xFFF8F573 /end MEASUREMENT
/begin MEASUREMENT ZFFSAB._.CDD_IEP_Control.iv_Actual_OpPoint_IEP "Input value readback from IEP" UBYTE SAB_STANDARD_S2_S3 1 100 0 255 DISPLAY_IDENTIFIER iv_Actual_OpPoint_IEP.CDD_IEP_Control._.ZFFSAB ECU_ADDRESS 0xFFF8F574 /end MEASUREMENT
/begin MEASUREMENT ZFFSAB._.CDD_IEP_Control.iv_Actual_n_IEP "RPM of IEP readback from IEP" UBYTE SAB_N_32RPM_S2_S3 1 100 0 8160 DISPLAY_IDENTIFIER iv_Actual_n_IEP.CDD_IEP_Control._.ZFFSAB ECU_ADDRESS 0xFFF8F575 /end MEASUREMENT
/begin MEASUREMENT ZFFSAB._.CDD_IEP_Control.iv_Actual_i_IEP "IEP current value readback from IEP" UBYTE SAB_I_A5_S2_S3 1 100 0 51 DISPLAY_IDENTIFIER iv_Actual_i_IEP.CDD_IEP_Control._.ZFFSAB ECU_ADDRESS 0xFFF8F576 /end MEASUREMENT
/begin MEASUREMENT ZFFSAB._.CDD_IEP_Control.iv_Actual_u_IEP "IEP voltage at KL.30 readback from IEP" UBYTE SAB_U_VOLT10_S2_S3 1 100 0 25.5 DISPLAY_IDENTIFIER iv_Actual_u_IEP.CDD_IEP_Control._.ZFFSAB ECU_ADDRESS 0xFFF8F577 /end MEASUREMENT
/begin MEASUREMENT ZFFSAB._.CDD_IEP_Control.iv_Actual_crc8_1_IEP "Input value readback from IEP" UBYTE SAB_STANDARD_S2_S3 1 100 0 255 DISPLAY_IDENTIFIER iv_Actual_crc8_1_IEP.CDD_IEP_Control._.ZFFSAB ECU_ADDRESS 0xFFF8F578 /end MEASUREMENT
/begin MEASUREMENT ZFFSAB._.CDD_IEP_Control.iv_Actual_c_IEP "Input value readback from IEP" UBYTE SAB_U_73VOLT10000_S2_S3 1 100 0 1.8615 DISPLAY_IDENTIFIER iv_Actual_c_IEP.CDD_IEP_Control._.ZFFSAB ECU_ADDRESS 0xFFF8F579 /end MEASUREMENT
/begin MEASUREMENT ZFFSAB._.CDD_IEP_Control.iv_Actual_IDNr_IEP "Input value readback from IEP" ULONG SAB_STANDARD_S2_S3 1 100 0 4294967295 DISPLAY_IDENTIFIER iv_Actual_IDNr_IEP.CDD_IEP_Control._.ZFFSAB ECU_ADDRESS 0xFFF8F57C /end MEASUREMENT
/begin MEASUREMENT ZFFSAB._.CDD_IEP_Control.iv_Actual_HWVersion_IEP "Hardware version readback from IEP vvvm.msss vvv:b001=IEP85 b010=IEP400.1 b011=IEP400.2 mm:b00=A-b01=B-b10=C-b11=D-Muster sss:musterstand 0-7" UBYTE SAB_STANDARD_S2_S3 1 100 0 255 DISPLAY_IDENTIFIER iv_Actual_HWVersion_IEP.CDD_IEP_Control._.ZFFSAB ECU_ADDRESS 0xFFF8F580 /end MEASUREMENT
/begin MEASUREMENT ZFFSAB._.CDD_IEP_Control.iv_Actual_SWVersion_IEP "Software version readback from IEP vvvh.hhhh.nnnn.nnnn vvv:b001=IEP85 b010=IEP400.1 b011=IEP400.2 h:0..31 Hauptversion n:0..255 Nebenversion" UWORD SAB_STANDARD_S2_S3 1 100 0 65535 DISPLAY_IDENTIFIER iv_Actual_SWVersion_IEP.CDD_IEP_Control._.ZFFSAB ECU_ADDRESS 0xFFF8F582 /end MEASUREMENT
/begin MEASUREMENT ZFFSAB._.CDD_IEP_Control.TxMessageAliveCnt[0] "Array of all up to 8 alive counters of all possible LIN Transmit Messages" UWORD SAB_STANDARD_S2_S3 1 100 0 65535 DISPLAY_IDENTIFIER TxMessageAliveCnt[0].CDD_IEP_Control._.ZFFSAB ECU_ADDRESS 0xFFF8F584 /end MEASUREMENT
/begin MEASUREMENT ZFFSAB._.CDD_IEP_Control.TxMessageAliveCnt[1] "Array of all up to 8 alive counters of all possible LIN Transmit Messages" UWORD SAB_STANDARD_S2_S3 1 100 0 65535 DISPLAY_IDENTIFIER TxMessageAliveCnt[1].CDD_IEP_Control._.ZFFSAB ECU_ADDRESS 0xFFF8F586 /end MEASUREMENT
/begin MEASUREMENT ZFFSAB._.CDD_IEP_Control.TxMessageAliveCnt[2] "Array of all up to 8 alive counters of all possible LIN Transmit Messages" UWORD SAB_STANDARD_S2_S3 1 100 0 65535 DISPLAY_IDENTIFIER TxMessageAliveCnt[2].CDD_IEP_Control._.ZFFSAB ECU_ADDRESS 0xFFF8F588 /end MEASUREMENT
/begin MEASUREMENT ZFFSAB._.CDD_IEP_Control.TxMessageAliveCnt[3] "Array of all up to 8 alive counters of all possible LIN Transmit Messages" UWORD SAB_STANDARD_S2_S3 1 100 0 65535 DISPLAY_IDENTIFIER TxMessageAliveCnt[3].CDD_IEP_Control._.ZFFSAB ECU_ADDRESS 0xFFF8F58A /end MEASUREMENT
/begin MEASUREMENT ZFFSAB._.CDD_IEP_Control.TxMessageAliveCnt[4] "Array of all up to 8 alive counters of all possible LIN Transmit Messages" UWORD SAB_STANDARD_S2_S3 1 100 0 65535 DISPLAY_IDENTIFIER TxMessageAliveCnt[4].CDD_IEP_Control._.ZFFSAB ECU_ADDRESS 0xFFF8F58C /end MEASUREMENT
/begin MEASUREMENT ZFFSAB._.CDD_IEP_Control.TxMessageAliveCnt[5] "Array of all up to 8 alive counters of all possible LIN Transmit Messages" UWORD SAB_STANDARD_S2_S3 1 100 0 65535 DISPLAY_IDENTIFIER TxMessageAliveCnt[5].CDD_IEP_Control._.ZFFSAB ECU_ADDRESS 0xFFF8F58E /end MEASUREMENT
/begin MEASUREMENT ZFFSAB._.CDD_IEP_Control.TxMessageAliveCnt[6] "Array of all up to 8 alive counters of all possible LIN Transmit Messages" UWORD SAB_STANDARD_S2_S3 1 100 0 65535 DISPLAY_IDENTIFIER TxMessageAliveCnt[6].CDD_IEP_Control._.ZFFSAB ECU_ADDRESS 0xFFF8F590 /end MEASUREMENT
/begin MEASUREMENT ZFFSAB._.CDD_IEP_Control.TxMessageAliveCnt[7] "Array of all up to 8 alive counters of all possible LIN Transmit Messages" UWORD SAB_STANDARD_S2_S3 1 100 0 65535 DISPLAY_IDENTIFIER TxMessageAliveCnt[7].CDD_IEP_Control._.ZFFSAB ECU_ADDRESS 0xFFF8F592 /end MEASUREMENT
/begin MEASUREMENT ZFFSAB._.CDD_IEP_Control.LastTxMessageIndex "Last Tx message index ist stord here while Getbus2TxDataPtr is called." UBYTE SAB_STANDARD_S2_S3 1 100 0 255 DISPLAY_IDENTIFIER LastTxMessageIndex.CDD_IEP_Control._.ZFFSAB ECU_ADDRESS 0xFFF8F594 /end MEASUREMENT
/begin MEASUREMENT ZFFSAB._.CDD_IEP_Control.sv_IEP_Verbaut "Configuration of used IEP 0 = no IEP available 1 = PWM IEP 2 = LIN IEP" UBYTE SAB_STANDARD_S2_S3 1 100 0 2 DISPLAY_IDENTIFIER sv_IEP_Verbaut.CDD_IEP_Control._.ZFFSAB ECU_ADDRESS 0xFFF8F595 /end MEASUREMENT
/begin MEASUREMENT ZFFSAB._.CDD_IEP_Control.f_testCompletedInit "Shows status of Diagnosis during Initialisation 0 = Tests not Completed 1 = Tests complete" UBYTE SAB_STANDARD_S2_S3 1 100 0 1 DISPLAY_IDENTIFIER f_testCompletedInit.CDD_IEP_Control._.ZFFSAB ECU_ADDRESS 0xFFF8F596 /end MEASUREMENT
/begin MEASUREMENT ZFFSAB._.CDD_IEP_Control.f_testCompletedCyclic "Shows status of cyclic Diagnosis in the IEP 0 = Tests not completed 1 = Tests complete" UBYTE SAB_STANDARD_S2_S3 1 100 0 1 DISPLAY_IDENTIFIER f_testCompletedCyclic.CDD_IEP_Control._.ZFFSAB ECU_ADDRESS 0xFFF8F597 /end MEASUREMENT
/begin MEASUREMENT ZFFSAB._.CDD_IEP_Control.f_testCompletedRotation "Shows status for Diagnosis with BP > 0 0 = Tests not completed 1 = Tests complete" UBYTE SAB_STANDARD_S2_S3 1 100 0 1 DISPLAY_IDENTIFIER f_testCompletedRotation.CDD_IEP_Control._.ZFFSAB ECU_ADDRESS 0xFFF8F598 /end MEASUREMENT
/begin MEASUREMENT ZFFSAB._.CDD_IEP_Control.f_iepHw_testCondition "Test condition flag indicating Testconditions state for IEP Hardware Error 0 = Testconditions failed 1 = Testconditions OK" UBYTE SAB_STANDARD_S2_S3 1 100 0 1 DISPLAY_IDENTIFIER f_iepHw_testCondition.CDD_IEP_Control._.ZFFSAB ECU_ADDRESS 0xFFF8F599 /end MEASUREMENT
/begin MEASUREMENT ZFFSAB._.CDD_IEP_Control.f_iepHw_Error "Error Flag indication an IEP Hardware Error 0 = OK 1 = Error" UBYTE SAB_STANDARD_S2_S3 1 100 0 1 DISPLAY_IDENTIFIER f_iepHw_Error.CDD_IEP_Control._.ZFFSAB ECU_ADDRESS 0xFFF8F59A /end MEASUREMENT
/begin MEASUREMENT ZFFSAB._.CDD_IEP_Control.f_iepTempsens_testCondition "Test condition Flag for temperature sensor diagnosis 0 = Test Condition not ok 1 = Test Condition OK" UBYTE SAB_STANDARD_S2_S3 1 100 0 1 DISPLAY_IDENTIFIER f_iepTempsens_testCondition.CDD_IEP_Control._.ZFFSAB ECU_ADDRESS 0xFFF8F59B /end MEASUREMENT
/begin MEASUREMENT ZFFSAB._.CDD_IEP_Control.f_iepVersion_testCondition "Test condition Flag for Hardware and Software Version diagnosis 0 = Test Condition not ok 1 = Test Condition OK" UBYTE SAB_STANDARD_S2_S3 1 100 0 1 DISPLAY_IDENTIFIER f_iepVersion_testCondition.CDD_IEP_Control._.ZFFSAB ECU_ADDRESS 0xFFF8F59C /end MEASUREMENT
/begin MEASUREMENT ZFFSAB._.CDD_IEP_Control.sv_f_IEP_Act_CalidCvnAvailable "Output configuration of IEP CALID and CVN Quantisation: 0=output of IEP CALID and CVN disabled 1= output of IEP CALID and CVN enabled" UBYTE SAB_STANDARD_S2_S3 1 100 0 1 DISPLAY_IDENTIFIER sv_f_IEP_Act_CalidCvnAvailable.CDD_IEP_Control._.ZFFSAB ECU_ADDRESS 0xFFF8F59D /end MEASUREMENT
/begin MEASUREMENT ZFFSAB._.CDD_IEP_Control.sv_c_IEP_Act_Cel "Normal Operation: Interface returns temperature of integrated electrical pump IEP . Quantisation: phys = 1 * hex + 0 Failure: Interface returns last value" SWORD SAB_C_CEL_S2_S3 1 100 -50 500 DISPLAY_IDENTIFIER sv_c_IEP_Act_Cel.CDD_IEP_Control._.ZFFSAB ECU_ADDRESS 0xFFF8F59E /end MEASUREMENT
/begin MEASUREMENT ZFFSAB._.CDD_IEP_Control.sv_sts_C_IEP "0 ... 2 [No unit] 0 - Signal valid 1 - Signal contains dynamic substitute value 2 - Signal invalid Signal contains static substitute value or the last valid value is kept" UBYTE SAB_STANDARD_S2_S3 1 100 0 2 DISPLAY_IDENTIFIER sv_sts_C_IEP.CDD_IEP_Control._.ZFFSAB ECU_ADDRESS 0xFFF8F5A0 /end MEASUREMENT
/begin MEASUREMENT ZFFSAB._.CDD_IEP_Control.sv_ctl_LinEpumpErrDetail "Detailed error states of electrical pump. bit-coded [No unit] 0x0001 - IEP voltage error 2^ 1 bis 16 - Currently not used" UWORD SAB_STANDARD_S2_S3 1 100 0 65535 DISPLAY_IDENTIFIER sv_ctl_LinEpumpErrDetail.CDD_IEP_Control._.ZFFSAB ECU_ADDRESS 0xFFF8F5A2 /end MEASUREMENT
/begin MEASUREMENT ZFFSAB._.CDD_IEP_Control.f_iep_limphome_old "Flag to indicate if IEP limp home mode in last cycle 0: Limphome mode not active 1: Limphome mode active" UBYTE SAB_STANDARD_S2_S3 1 100 0 1 DISPLAY_IDENTIFIER f_iep_limphome_old.CDD_IEP_Control._.ZFFSAB ECU_ADDRESS 0xFFF8F5A4 /end MEASUREMENT
/begin MEASUREMENT ZFFSAB._.CDD_IEP_Control.f_IEPWarmup "Flag set to 1 if IEP warm up mode is active." UBYTE SAB_STANDARD_S2_S3 1 100 0 1 DISPLAY_IDENTIFIER f_IEPWarmup.CDD_IEP_Control._.ZFFSAB ECU_ADDRESS 0xFFF8F5A5 /end MEASUREMENT
/begin MEASUREMENT ZFFSAB._.CDD_IEP_Control.sv_ctl_Coding "This interface provides the IEP configuration information. When a bit is set the corresponding feature is available: Bit0=warm up available Bit1-15=not used yet" UWORD SAB_STANDARD_S2_S3 1 100 0 1 DISPLAY_IDENTIFIER sv_ctl_Coding.CDD_IEP_Control._.ZFFSAB ECU_ADDRESS 0xFFF8F5A6 /end MEASUREMENT
/begin MEASUREMENT ZFFSAB._.CDD_IEP_Control.f_iepWarmUpErr "Error flag indicating errors during warm-up" UBYTE SAB_STANDARD_S2_S3 1 100 0 1 DISPLAY_IDENTIFIER f_iepWarmUpErr.CDD_IEP_Control._.ZFFSAB ECU_ADDRESS 0xFFF8F5A8 /end MEASUREMENT
/begin MEASUREMENT ZFFSAB._.CDD_IEP_Control.sv_Actual_u_IEP "Interface provides voltage of the IEP power supply." UWORD SAB_U_VOLT10_S2_S3 1 100 0 25.5 DISPLAY_IDENTIFIER sv_Actual_u_IEP.CDD_IEP_Control._.ZFFSAB ECU_ADDRESS 0xFFF8F5AA /end MEASUREMENT
/begin MEASUREMENT ZFFSAB._.CDD_IEP_Control.sv_Actual_u_IEPSts "0 - Signal valid 1 - Signal contains dynamic substitute value 2 - Signal invalid Signal contains static substitute value or the last valid value is kept" UBYTE SAB_STANDARD_S2_S3 1 100 0 2 DISPLAY_IDENTIFIER sv_Actual_u_IEPSts.CDD_IEP_Control._.ZFFSAB ECU_ADDRESS 0xFFF8F5AC /end MEASUREMENT
/begin MEASUREMENT ZFFSAB._.CDD_IEP_Control.f_Actual_u_IEP_Valid "Flag to indicate if the Actual_u_IEP has received a valid value from IEP" UBYTE SAB_STANDARD_S2_S3 1 100 0 1 DISPLAY_IDENTIFIER f_Actual_u_IEP_Valid.CDD_IEP_Control._.ZFFSAB ECU_ADDRESS 0xFFF8F5AD /end MEASUREMENT
/begin MEASUREMENT ZFFSAB._.CDD_IEP_Control.f_linComActive_old "Value of iv_f_linComActive from last cycle. Use for debouncing purposes" UBYTE SAB_STANDARD_S2_S3 1 100 0 1 DISPLAY_IDENTIFIER f_linComActive_old.CDD_IEP_Control._.ZFFSAB ECU_ADDRESS 0xFFF8F5AE /end MEASUREMENT
/begin MEASUREMENT ZFFSAB._.CDD_IEP_Control.loc_IEP_StatusOld "Store value when LIN is active" ULONG SAB_STANDARD_S2_S3 1 100 0 4294967295 DISPLAY_IDENTIFIER loc_IEP_StatusOld.CDD_IEP_Control._.ZFFSAB ECU_ADDRESS 0xFFF8F5B0 /end MEASUREMENT
/begin MEASUREMENT ZFFSAB._.DrivingStateIn.iv_DriveCondition "Input raw signal of driving state 0-not driving 1-forward 2-backward 3-no direction detection possible 4-rear axle on roller test bench 5-rear both axles on roller test bench 7-error value" UBYTE SAB_STANDARD_S2_S3 1 100 0 7 DISPLAY_IDENTIFIER iv_DriveCondition.DrivingStateIn._.ZFFSAB ECU_ADDRESS 0xFFF90084 /end MEASUREMENT
/begin MEASUREMENT ZFFSAB._.DrivingStateIn.iv_DriveConditionSts "Input CAN message status of driving state" UBYTE SAB_STANDARD_S2_S3 1 100 0 255 DISPLAY_IDENTIFIER iv_DriveConditionSts.DrivingStateIn._.ZFFSAB ECU_ADDRESS 0xFFF90085 /end MEASUREMENT
/begin MEASUREMENT ZFFSAB._.DrivingStateIn.sv_AGS_DriveCondition "Output signal of AGS driving state 0-rear axle NOT on roller test bench 1-rear axle on roller test bench" UBYTE SAB_STANDARD_S2_S3 1 100 0 1 DISPLAY_IDENTIFIER sv_AGS_DriveCondition.DrivingStateIn._.ZFFSAB ECU_ADDRESS 0xFFF90086 /end MEASUREMENT
/begin MEASUREMENT ZFFSAB._.DrivingStateIn.sv_DriveCondition "Output signal of driving state 0-not driving 1-forward 2-backward 3-no direction detection possible 4-rear axle on roller test bench 7-error value" UBYTE SAB_STANDARD_S2_S3 1 100 0 7 DISPLAY_IDENTIFIER sv_DriveCondition.DrivingStateIn._.ZFFSAB ECU_ADDRESS 0xFFF90087 /end MEASUREMENT
/begin MEASUREMENT ZFFSAB._.DrivingStateIn.sv_DriveConditionSts "Output status signal of driving state" UBYTE SAB_STANDARD_S2_S3 1 100 0 2 DISPLAY_IDENTIFIER sv_DriveConditionSts.DrivingStateIn._.ZFFSAB ECU_ADDRESS 0xFFF90088 /end MEASUREMENT
/begin MEASUREMENT ZFFSAB._.DrivingStateIn.f_DriveConditionErr "Error flag of DriveCondition-signal" UBYTE SAB_STANDARD_S2_S3 1 100 0 1 DISPLAY_IDENTIFIER f_DriveConditionErr.DrivingStateIn._.ZFFSAB ECU_ADDRESS 0xFFF90089 /end MEASUREMENT
/begin MEASUREMENT ZFFSAB._.HybridVehicleReadyToDriveIn.iv_STAT_Drv "Input raw signal informing whether the vehicle is ready to drive" UBYTE SAB_STANDARD_S2_S3 1 100 0 255 DISPLAY_IDENTIFIER iv_STAT_Drv.HybridVehicleReadyToDriveIn._.ZFFSAB ECU_ADDRESS 0xFFF8F78C /end MEASUREMENT
/begin MEASUREMENT ZFFSAB._.HybridVehicleReadyToDriveIn.iv_STAT_DrvSts "Input CAN message status signal informing whether the vehicle is ready to drive" UBYTE SAB_STANDARD_S2_S3 1 100 0 255 DISPLAY_IDENTIFIER iv_STAT_DrvSts.HybridVehicleReadyToDriveIn._.ZFFSAB ECU_ADDRESS 0xFFF8F78D /end MEASUREMENT
/begin MEASUREMENT ZFFSAB._.HybridVehicleReadyToDriveIn.iv_ReqVehImdtVehRdyToDrvOff "Input raw signal from hardware informing whether the vehicle is ready to drive" UBYTE SAB_STANDARD_S2_S3 1 100 0 255 DISPLAY_IDENTIFIER iv_ReqVehImdtVehRdyToDrvOff.HybridVehicleReadyToDriveIn._.ZFFSAB ECU_ADDRESS 0xFFF8F78E /end MEASUREMENT
/begin MEASUREMENT ZFFSAB._.HybridVehicleReadyToDriveIn.iv_ReqVehImdtVehRdyToDrvOffSts "Input raw signal status from hardware informing whether the vehicle is ready to drive" UBYTE SAB_STANDARD_S2_S3 1 100 0 255 DISPLAY_IDENTIFIER iv_ReqVehImdtVehRdyToDrvOffSts.HybridVehicleReadyToDriveIn._.ZFFSAB ECU_ADDRESS 0xFFF8F78F /end MEASUREMENT
/begin MEASUREMENT ZFFSAB._.HybridVehicleReadyToDriveIn.sv_VehicleReadyToDrive "Output signal giving the information whether the vehicle is ready to drive" UBYTE SAB_STANDARD_S2_S3 1 100 0 255 DISPLAY_IDENTIFIER sv_VehicleReadyToDrive.HybridVehicleReadyToDriveIn._.ZFFSAB ECU_ADDRESS 0xFFF8F790 /end MEASUREMENT
/begin MEASUREMENT ZFFSAB._.HybridVehicleReadyToDriveIn.sv_VehicleReadyToDriveSts "Output status signal giving the information whether the vehicle is ready to drive" UBYTE SAB_STANDARD_S2_S3 1 100 0 255 DISPLAY_IDENTIFIER sv_VehicleReadyToDriveSts.HybridVehicleReadyToDriveIn._.ZFFSAB ECU_ADDRESS 0xFFF8F791 /end MEASUREMENT
/begin MEASUREMENT ZFFSAB._.HybridVehicleReadyToDriveIn.f_ReqVehImdtVehRdyToDrvOff "Flag set when no timer is needed to set the ready to drive bit" UBYTE SAB_STANDARD_S2_S3 1 100 0 255 DISPLAY_IDENTIFIER f_ReqVehImdtVehRdyToDrvOff.HybridVehicleReadyToDriveIn._.ZFFSAB ECU_ADDRESS 0xFFF8F792 /end MEASUREMENT
/begin MEASUREMENT ZFFSAB._.HybridVehicleReadyToDriveIn.VehicleReadyToDriveOld "Output signal of sv_VehicleReadyToDrive from previous cycle" UBYTE SAB_STANDARD_S2_S3 1 100 0 255 DISPLAY_IDENTIFIER VehicleReadyToDriveOld.HybridVehicleReadyToDriveIn._.ZFFSAB ECU_ADDRESS 0xFFF8F793 /end MEASUREMENT
/begin MEASUREMENT ZFFSAB._.HybridVehicleReadyToDriveIn.VehicleReadyToDriveOldSts "Output status signal of sv_VehicleReadyToDriveSts from previous cycle" UBYTE SAB_STANDARD_S2_S3 1 100 0 255 DISPLAY_IDENTIFIER VehicleReadyToDriveOldSts.HybridVehicleReadyToDriveIn._.ZFFSAB ECU_ADDRESS 0xFFF8F794 /end MEASUREMENT
/begin MEASUREMENT ZFFSAB._.HybridVehicleReadyToDriveInBPRAM.stc_VehicleReadyToDriveBPRAM "Value of the vehicle ready to drive flag in the BPRAM" UBYTE SAB_STANDARD_S2_S3 1 100 0 1 DISPLAY_IDENTIFIER stc_VehicleReadyToDriveBPRAM.HybridVehicleReadyToDriveInBPRAM._.ZFFSAB ECU_ADDRESS 0xFFF83B54 /end MEASUREMENT
/begin MEASUREMENT ZFFSAB._.HybridVehicleReadyToDriveInBPRAM.stc_VehicleReadyToDriveBPRAM_ "Complement of value of the vehicle ready to drive flag in the BPRAM" UBYTE SAB_STANDARD_S2_S3 1 100 0 255 DISPLAY_IDENTIFIER stc_VehicleReadyToDriveBPRAM_.HybridVehicleReadyToDriveInBPRAM._.ZFFSAB ECU_ADDRESS 0xFFF83B55 /end MEASUREMENT
/begin MEASUREMENT ZFFSAB._.HybridVehicleReadyToDriveInBPRAM.stc_VehicleReadyToDriveStsBPRAM "Value of the vehicle ready to drive flag status in the BPRAM" UBYTE SAB_STANDARD_S2_S3 1 100 0 1 DISPLAY_IDENTIFIER stc_VehicleReadyToDriveStsBPRAM.HybridVehicleReadyToDriveInBPRAM._.ZFFSAB ECU_ADDRESS 0xFFF83B56 /end MEASUREMENT
/begin MEASUREMENT ZFFSAB._.HybridVehicleReadyToDriveInBPRAM.stc_VehicleReadyToDriveStsBPRAM_ "Complement of value of the vehicle ready to drive flag status in the BPRAM" UBYTE SAB_STANDARD_S2_S3 1 100 0 255 DISPLAY_IDENTIFIER stc_VehicleReadyToDriveStsBPRAM_.HybridVehicleReadyToDriveInBPRAM._.ZFFSAB ECU_ADDRESS 0xFFF83B57 /end MEASUREMENT
/begin MEASUREMENT ZFFSAB._.HybridVehicleReadyToDriveInBPRAM.f_VehicleReadyToDriveInitPhase "Flag set to 1 if we were still in the initialization phase" UBYTE SAB_STANDARD_S2_S3 1 100 0 1 DISPLAY_IDENTIFIER f_VehicleReadyToDriveInitPhase.HybridVehicleReadyToDriveInBPRAM._.ZFFSAB ECU_ADDRESS 0xFFF83B58 /end MEASUREMENT
/begin MEASUREMENT ZFFSAB._.HybridVehicleReadyToDriveInBPRAM.f_VehicleReadyToDriveInitPhase_ "Complement of the flag set to 1 if we were still in the initialization phase" UBYTE SAB_STANDARD_S2_S3 1 100 0 255 DISPLAY_IDENTIFIER f_VehicleReadyToDriveInitPhase_.HybridVehicleReadyToDriveInBPRAM._.ZFFSAB ECU_ADDRESS 0xFFF83B59 /end MEASUREMENT
/begin MEASUREMENT ZFFSAB._.BrakePedalIn.iv_Brake "Input value brake information signal from CAN" UBYTE SAB_STANDARD_S2_S3 1 100 0 63 DISPLAY_IDENTIFIER iv_Brake.BrakePedalIn._.ZFFSAB ECU_ADDRESS 0xFFF8F864 /end MEASUREMENT
/begin MEASUREMENT ZFFSAB._.BrakePedalIn.iv_Brake_ "Input complement value brake information from CAN" UBYTE SAB_STANDARD_S2_S3 1 100 0 255 DISPLAY_IDENTIFIER iv_Brake_.BrakePedalIn._.ZFFSAB ECU_ADDRESS 0xFFF8F865 /end MEASUREMENT
/begin MEASUREMENT ZFFSAB._.BrakePedalIn.iv_BrakeSts "Input value message status of brake information from CAN" UBYTE SAB_STANDARD_S2_S3 1 100 0 255 DISPLAY_IDENTIFIER iv_BrakeSts.BrakePedalIn._.ZFFSAB ECU_ADDRESS 0xFFF8F866 /end MEASUREMENT
/begin MEASUREMENT ZFFSAB._.BrakePedalIn.iv_BrakeSts_ "Input complement value message status of brake information from CAN" UBYTE SAB_STANDARD_S2_S3 1 100 0 255 DISPLAY_IDENTIFIER iv_BrakeSts_.BrakePedalIn._.ZFFSAB ECU_ADDRESS 0xFFF8F867 /end MEASUREMENT
/begin MEASUREMENT ZFFSAB._.BrakePedalIn.sv_BrakeSts "Output status signal of brake information" UBYTE SAB_STANDARD_S2_S3 1 100 0 2 DISPLAY_IDENTIFIER sv_BrakeSts.BrakePedalIn._.ZFFSAB ECU_ADDRESS 0xFFF8F868 /end MEASUREMENT
/begin MEASUREMENT ZFFSAB._.BrakePedalIn.sv_f_Brake "Output signal of brake information" UBYTE SAB_STANDARD_S2_S3 1 100 0 1 DISPLAY_IDENTIFIER sv_f_Brake.BrakePedalIn._.ZFFSAB ECU_ADDRESS 0xFFF8F869 /end MEASUREMENT
/begin MEASUREMENT ZFFSAB._.BrakePedalIn.sv_f_Brake_AGS "Output signal of brake information for Layer AGS" UBYTE SAB_STANDARD_S2_S3 1 100 0 2 DISPLAY_IDENTIFIER sv_f_Brake_AGS.BrakePedalIn._.ZFFSAB ECU_ADDRESS 0xFFF8F86A /end MEASUREMENT
/begin MEASUREMENT ZFFSAB._.BrakePedalIn.sv_BrakeSts_ "Complement Output status signal of brake information" UBYTE SAB_STANDARD_S2_S3 1 100 0 255 DISPLAY_IDENTIFIER sv_BrakeSts_.BrakePedalIn._.ZFFSAB ECU_ADDRESS 0xFFF8F86B /end MEASUREMENT
/begin MEASUREMENT ZFFSAB._.BrakePedalIn.sv_f_Brake_ "Complement Output signal of brake information" UBYTE SAB_STANDARD_S2_S3 1 100 0 255 DISPLAY_IDENTIFIER sv_f_Brake_.BrakePedalIn._.ZFFSAB ECU_ADDRESS 0xFFF8F86C /end MEASUREMENT
/begin MEASUREMENT ZFFSAB._.BrakePedalIn.f_BrakeErr "Error flag set by valid status and signal-error-value" UBYTE SAB_STANDARD_S2_S3 1 100 0 1 DISPLAY_IDENTIFIER f_BrakeErr.BrakePedalIn._.ZFFSAB ECU_ADDRESS 0xFFF8F86D /end MEASUREMENT
/begin MEASUREMENT ZFFSAB._.BrakePedalIn.sv_f_BrakeLev2 "Lev2 diagnosis signal of brake information for KFC_VUNPLAUSILEV2" UBYTE SAB_STANDARD_S2_S3 1 100 0 1 DISPLAY_IDENTIFIER sv_f_BrakeLev2.BrakePedalIn._.ZFFSAB ECU_ADDRESS 0xFFF8F86E /end MEASUREMENT
/begin MEASUREMENT ZFFSAB._.BrakePedalIn.sv_BrakeLev2Sts "Lev2 diagnosis status signal of brake information for KFC_VUNPLAUSILEV2" UBYTE SAB_STANDARD_S2_S3 1 100 0 255 DISPLAY_IDENTIFIER sv_BrakeLev2Sts.BrakePedalIn._.ZFFSAB ECU_ADDRESS 0xFFF8F86F /end MEASUREMENT
/begin MEASUREMENT ZFFSAB._.FpDkVpIn.iv_ThrottlePosition "Input value from the CAN-Bus" UWORD SAB_0025PROZENT_S2_S3 1 100 0 102.375 DISPLAY_IDENTIFIER iv_ThrottlePosition.FpDkVpIn._.ZFFSAB ECU_ADDRESS 0xFFF8F97C /end MEASUREMENT
/begin MEASUREMENT ZFFSAB._.FpDkVpIn.iv_ThrottlePositionErr "seperate throttle position fault flag on CAN" UBYTE SAB_STANDARD_S2_S3 1 100 0 15 DISPLAY_IDENTIFIER iv_ThrottlePositionErr.FpDkVpIn._.ZFFSAB ECU_ADDRESS 0xFFF8F97E /end MEASUREMENT
/begin MEASUREMENT ZFFSAB._.FpDkVpIn.iv_ThrottlePositionSts "Input value from the CAN-Bus" UBYTE SAB_STANDARD_S2_S3 1 100 0 255 DISPLAY_IDENTIFIER iv_ThrottlePositionSts.FpDkVpIn._.ZFFSAB ECU_ADDRESS 0xFFF8F97F /end MEASUREMENT
/begin MEASUREMENT ZFFSAB._.FpDkVpIn.iv_ThrottlePositionVirt "The inputsignal which transport the calculated throttleposition based on the actual drivingspeedsettings of CAN2. Are there no FAS_interventions ThrottlePositionVirt equals ThrottlePosition" UWORD SAB_0025PROZENT_S2_S3 1 100 0 102.375 DISPLAY_IDENTIFIER iv_ThrottlePositionVirt.FpDkVpIn._.ZFFSAB ECU_ADDRESS 0xFFF8F980 /end MEASUREMENT
/begin MEASUREMENT ZFFSAB._.FpDkVpIn.iv_ThrottlePositionVirtSts "The inputsignal status of iv_ThrottlePositionVirt" UBYTE SAB_STANDARD_S2_S3 1 100 0 2 DISPLAY_IDENTIFIER iv_ThrottlePositionVirtSts.FpDkVpIn._.ZFFSAB ECU_ADDRESS 0xFFF8F982 /end MEASUREMENT
/begin MEASUREMENT ZFFSAB._.FpDkVpIn.sv_ThrottlePosition "ThrottlePositionCor2 output value for HPSYS" UBYTE SAB_100PROZENT254_S2_S3 1 100 0 100.393700787 DISPLAY_IDENTIFIER sv_ThrottlePosition.FpDkVpIn._.ZFFSAB ECU_ADDRESS 0xFFF8F983 /end MEASUREMENT
/begin MEASUREMENT ZFFSAB._.FpDkVpIn.sv_ThrottlePositionSts "ThrottlePositionSts as output value for HPSYS" UBYTE SAB_STANDARD_S2_S3 1 100 0 2 DISPLAY_IDENTIFIER sv_ThrottlePositionSts.FpDkVpIn._.ZFFSAB ECU_ADDRESS 0xFFF8F984 /end MEASUREMENT
/begin MEASUREMENT ZFFSAB._.FpDkVpIn.sv_ThrottlePositionLev2 "ThrottlePositionCor2 Level 2 output value for HPSYS" UBYTE SAB_100PROZENT254_S2_S3 1 100 0 100.393700787 DISPLAY_IDENTIFIER sv_ThrottlePositionLev2.FpDkVpIn._.ZFFSAB ECU_ADDRESS 0xFFF8F985 /end MEASUREMENT
/begin MEASUREMENT ZFFSAB._.FpDkVpIn.sv_ThrottlePositionLev2_ "ThrottlePositionCor2 Level 2 output value for HPSYS(Complement)" UBYTE SAB_STANDARD_S2_S3 1 100 0 255 DISPLAY_IDENTIFIER sv_ThrottlePositionLev2_.FpDkVpIn._.ZFFSAB ECU_ADDRESS 0xFFF8F986 /end MEASUREMENT
/begin MEASUREMENT ZFFSAB._.FpDkVpIn.sv_ThrottlePositionLev2Sts "ThrottlePositionLev2Sts as output value for HPSYS" UBYTE SAB_STANDARD_S2_S3 1 100 0 2 DISPLAY_IDENTIFIER sv_ThrottlePositionLev2Sts.FpDkVpIn._.ZFFSAB ECU_ADDRESS 0xFFF8F987 /end MEASUREMENT
/begin MEASUREMENT ZFFSAB._.FpDkVpIn.sv_ThrottlePositionLev2Sts_ "ThrottlePositionLev2Sts as complementary output value for HPSYS" UBYTE SAB_STANDARD_S2_S3 1 100 0 2 DISPLAY_IDENTIFIER sv_ThrottlePositionLev2Sts_.FpDkVpIn._.ZFFSAB ECU_ADDRESS 0xFFF8F988 /end MEASUREMENT
/begin MEASUREMENT ZFFSAB._.FpDkVpIn.sv_ThrottlePositionVirt "The output-signal which transport the calculated throttleposition based on the actual drivingspeedsettings" UBYTE SAB_100PROZENT254_S2_S3 1 100 0 100.393700787 DISPLAY_IDENTIFIER sv_ThrottlePositionVirt.FpDkVpIn._.ZFFSAB ECU_ADDRESS 0xFFF8F989 /end MEASUREMENT
/begin MEASUREMENT ZFFSAB._.FpDkVpIn.sv_MaxThrottlePosition "The output-signal which transport the calculated throttleposition based on the values provided from sv_ThrottlePosition or sv_ThrottlePositionVirt" UBYTE SAB_100PROZENT254_S2_S3 1 100 0 100.393700787 DISPLAY_IDENTIFIER sv_MaxThrottlePosition.FpDkVpIn._.ZFFSAB ECU_ADDRESS 0xFFF8F98A /end MEASUREMENT
/begin MEASUREMENT ZFFSAB._.FpDkVpIn.sv_MaxThrottlePositionSts "The output-signal status of sv_MaxThrottlePositionSts" UBYTE SAB_STANDARD_S2_S3 1 100 0 2 DISPLAY_IDENTIFIER sv_MaxThrottlePositionSts.FpDkVpIn._.ZFFSAB ECU_ADDRESS 0xFFF8F98B /end MEASUREMENT
/begin MEASUREMENT ZFFSAB._.FpDkVpIn.sv_ThrottlePositionVirtSts "The output-signal status of sv_ThrottlePositionVirt" UBYTE SAB_STANDARD_S2_S3 1 100 0 2 DISPLAY_IDENTIFIER sv_ThrottlePositionVirtSts.FpDkVpIn._.ZFFSAB ECU_ADDRESS 0xFFF8F98C /end MEASUREMENT
/begin MEASUREMENT ZFFSAB._.FpDkVpIn.f_ThrottlePositionErr "Error flag for error status" UBYTE SAB_STANDARD_S2_S3 1 100 0 1 DISPLAY_IDENTIFIER f_ThrottlePositionErr.FpDkVpIn._.ZFFSAB ECU_ADDRESS 0xFFF8F98D /end MEASUREMENT
/begin MEASUREMENT ZFFSAB._.FpDkVpIn.f_ThrottlePositionVirtErr "Errorflag set by detecting an errorvalue of the incoming signal and a valid signal-status at the the same time" UBYTE SAB_STANDARD_S2_S3 1 100 0 2 DISPLAY_IDENTIFIER f_ThrottlePositionVirtErr.FpDkVpIn._.ZFFSAB ECU_ADDRESS 0xFFF8F98E /end MEASUREMENT
/begin MEASUREMENT ZFFSAB._.FrictionIn.iv_m_Friction "Input value engine friction moment from CAN" UWORD SAB_M_NM2_M2047_S2_S3 1 100 -1023.5 -512 DISPLAY_IDENTIFIER iv_m_Friction.FrictionIn._.ZFFSAB ECU_ADDRESS 0xFFF8F990 /end MEASUREMENT
/begin MEASUREMENT ZFFSAB._.FrictionIn.iv_m_FrictionSts "Input value of engine friction moment message status" UBYTE SAB_STANDARD_S2_S3 1 100 0 255 DISPLAY_IDENTIFIER iv_m_FrictionSts.FrictionIn._.ZFFSAB ECU_ADDRESS 0xFFF8F992 /end MEASUREMENT
/begin MEASUREMENT ZFFSAB._.FrictionIn.sv_m_Friction "Output value of engine friction moment" UWORD SAB_M_1NM_S2_S3 1 100 0 1023 DISPLAY_IDENTIFIER sv_m_Friction.FrictionIn._.ZFFSAB ECU_ADDRESS 0xFFF8F994 /end MEASUREMENT
/begin MEASUREMENT ZFFSAB._.FrictionIn.sv_m_FrictionSts "Output value of engine friction moment signal status" UBYTE SAB_STANDARD_S2_S3 1 100 0 2 DISPLAY_IDENTIFIER sv_m_FrictionSts.FrictionIn._.ZFFSAB ECU_ADDRESS 0xFFF8F996 /end MEASUREMENT
/begin MEASUREMENT ZFFSAB._.FrictionIn.m_FrictionCor "Intermediate value converted quantisation of engine friction moment" SWORD SAB_M_1NM_S2_S3 1 100 -1024 1023 DISPLAY_IDENTIFIER m_FrictionCor.FrictionIn._.ZFFSAB ECU_ADDRESS 0xFFF8F998 /end MEASUREMENT
/begin MEASUREMENT ZFFSAB._.FrictionIn.f_m_FrictionErr "Error flag for engine friction moment" UBYTE SAB_STANDARD_S2_S3 1 100 0 1 DISPLAY_IDENTIFIER f_m_FrictionErr.FrictionIn._.ZFFSAB ECU_ADDRESS 0xFFF8F99A /end MEASUREMENT
/begin MEASUREMENT ZFFSAB._.GearboxTempIn.GearboxTempInFl.sv_c_OilTrans_ "Output value of gear oil temperature (Complement)" FLOAT32_IEEE SAB_STANDARD_S2_S3 1 100 0 255 FORMAT "%5.3" DISPLAY_IDENTIFIER sv_c_OilTrans_.GearboxTempInFl.GearboxTempIn._.ZFFSAB ECU_ADDRESS 0xFFF8F9E0 /end MEASUREMENT
/begin MEASUREMENT ZFFSAB._.GearboxTempIn.GearboxTempInFl.iv_c_Chip2Trans "Input raw signal substrate temperature Sensor 2(LM71)" FLOAT32_IEEE SAB_C_CGT_1CEL_M40_S2_S3 1 100 -40 215 FORMAT "%5.3" DISPLAY_IDENTIFIER iv_c_Chip2Trans.GearboxTempInFl.GearboxTempIn._.ZFFSAB ECU_ADDRESS 0xFFF8F9E4 /end MEASUREMENT
/begin MEASUREMENT ZFFSAB._.GearboxTempIn.GearboxTempInFl.sv_c_OilTransSts "Output value signal status of gear oil temperature" FLOAT32_IEEE SAB_STANDARD_S2_S3 1 100 0 2 FORMAT "%5.3" DISPLAY_IDENTIFIER sv_c_OilTransSts.GearboxTempInFl.GearboxTempIn._.ZFFSAB ECU_ADDRESS 0xFFF8F9E8 /end MEASUREMENT
/begin MEASUREMENT ZFFSAB._.GearboxTempIn.GearboxTempInFl.sv_c_OilTrans "Output value of gear oil temperature" FLOAT32_IEEE SAB_C_CGT_1CEL_M40_S2_S3 1 100 -40 215 FORMAT "%5.3" DISPLAY_IDENTIFIER sv_c_OilTrans.GearboxTempInFl.GearboxTempIn._.ZFFSAB ECU_ADDRESS 0xFFF8F9EC /end MEASUREMENT
/begin MEASUREMENT ZFFSAB._.GearboxTempIn.GearboxTempInFl.sv_c_ChipTrans "Output value substrate temperature" FLOAT32_IEEE SAB_C_CGT_1CEL_M40_S2_S3 1 100 -40 215 FORMAT "%5.3" DISPLAY_IDENTIFIER sv_c_ChipTrans.GearboxTempInFl.GearboxTempIn._.ZFFSAB ECU_ADDRESS 0xFFF8F9F0 /end MEASUREMENT
/begin MEASUREMENT ZFFSAB._.GearboxTempIn.GearboxTempInFl.sv_c_ChipTransSts "signal status substrate temperature" FLOAT32_IEEE SAB_STANDARD_S2_S3 1 100 0 2 FORMAT "%5.3" DISPLAY_IDENTIFIER sv_c_ChipTransSts.GearboxTempInFl.GearboxTempIn._.ZFFSAB ECU_ADDRESS 0xFFF8F9F4 /end MEASUREMENT
/begin MEASUREMENT ZFFSAB._.GearboxTempIn.f_IgnitionOff2On "represenets an Ignition OFF to ON" UBYTE SAB_STANDARD_S2_S3 1 100 0 1 DISPLAY_IDENTIFIER f_IgnitionOff2On.GearboxTempIn._.ZFFSAB ECU_ADDRESS 0xFFF8F9F8 /end MEASUREMENT
/begin MEASUREMENT ZFFSAB._.GearboxTempIn.iv_c_Chip2Trans "Input raw signal Chiptemperature Sensor 2(LM71)" UBYTE SAB_C_CGT_1CEL_M40_S2_S3 1 100 -40 215 DISPLAY_IDENTIFIER iv_c_Chip2Trans.GearboxTempIn._.ZFFSAB ECU_ADDRESS 0xFFF8FA08 /end MEASUREMENT
/begin MEASUREMENT ZFFSAB._.GearboxTempIn.iv_c_OilTrans "Input raw signal of CGT Sensor" UBYTE SAB_C_CGT_1CEL_M40_S2_S3 1 100 -40 215 DISPLAY_IDENTIFIER iv_c_OilTrans.GearboxTempIn._.ZFFSAB ECU_ADDRESS 0xFFF8FA09 /end MEASUREMENT
/begin MEASUREMENT ZFFSAB._.GearboxTempIn.iv_c_OilTransESts "Input raw signal for electrical status CGT Sensor" UBYTE SAB_STANDARD_S2_S3 1 100 0 255 DISPLAY_IDENTIFIER iv_c_OilTransESts.GearboxTempIn._.ZFFSAB ECU_ADDRESS 0xFFF8FA0A /end MEASUREMENT
/begin MEASUREMENT ZFFSAB._.GearboxTempIn.iv_c_Chip2TransESts "Input raw signal EStatus Chiptemperature Sensor 1(LM71)" UBYTE SAB_STANDARD_S2_S3 1 100 0 255 DISPLAY_IDENTIFIER iv_c_Chip2TransESts.GearboxTempIn._.ZFFSAB ECU_ADDRESS 0xFFF8FA0B /end MEASUREMENT
/begin MEASUREMENT ZFFSAB._.GearboxTempIn.iv_n_Eng "input signal engine speed" UWORD SAB_STANDARD_S2_S3 1 100 0 65535 DISPLAY_IDENTIFIER iv_n_Eng.GearboxTempIn._.ZFFSAB ECU_ADDRESS 0xFFF8FA0C /end MEASUREMENT
/begin MEASUREMENT ZFFSAB._.GearboxTempIn.iv_n_EngSts "input signal engine speed" UBYTE SAB_STANDARD_S2_S3 1 100 0 255 DISPLAY_IDENTIFIER iv_n_EngSts.GearboxTempIn._.ZFFSAB ECU_ADDRESS 0xFFF8FA0E /end MEASUREMENT
/begin MEASUREMENT ZFFSAB._.GearboxTempIn.sv_c_OilTrans "Output value of gear oil temperature" UBYTE SAB_C_CGT_1CEL_M40_S2_S3 1 100 -40 215 DISPLAY_IDENTIFIER sv_c_OilTrans.GearboxTempIn._.ZFFSAB ECU_ADDRESS 0xFFF8FA0F /end MEASUREMENT
/begin MEASUREMENT ZFFSAB._.GearboxTempIn.sv_c_OilTrans_ "Output value of gear oil temperature (Complement)" UBYTE SAB_STANDARD_S2_S3 1 100 0 255 DISPLAY_IDENTIFIER sv_c_OilTrans_.GearboxTempIn._.ZFFSAB ECU_ADDRESS 0xFFF8FA10 /end MEASUREMENT
/begin MEASUREMENT ZFFSAB._.GearboxTempIn.sv_c_OilTransSts "Output value signal status of gear oil temperature" UBYTE SAB_STANDARD_S2_S3 1 100 0 2 DISPLAY_IDENTIFIER sv_c_OilTransSts.GearboxTempIn._.ZFFSAB ECU_ADDRESS 0xFFF8FA11 /end MEASUREMENT
/begin MEASUREMENT ZFFSAB._.GearboxTempIn.sv_c_OilTransSts_ "Output value signal status of gear oil temperature (Complement)" UBYTE SAB_STANDARD_S2_S3 1 100 0 255 DISPLAY_IDENTIFIER sv_c_OilTransSts_.GearboxTempIn._.ZFFSAB ECU_ADDRESS 0xFFF8FA12 /end MEASUREMENT
/begin MEASUREMENT ZFFSAB._.GearboxTempIn.sv_c_ChipTrans "Output value substrate temperature" UBYTE SAB_C_CGT_1CEL_M40_S2_S3 1 100 -40 215 DISPLAY_IDENTIFIER sv_c_ChipTrans.GearboxTempIn._.ZFFSAB ECU_ADDRESS 0xFFF8FA13 /end MEASUREMENT
/begin MEASUREMENT ZFFSAB._.GearboxTempIn.sv_c_ChipTransSts "Output value substrate temperature Status" UBYTE SAB_STANDARD_S2_S3 1 100 0 255 DISPLAY_IDENTIFIER sv_c_ChipTransSts.GearboxTempIn._.ZFFSAB ECU_ADDRESS 0xFFF8FA14 /end MEASUREMENT
/begin MEASUREMENT ZFFSAB._.GearboxTempIn.sv_c_OilTransTXCAN "Output value of gear oil temperature for CAN" UBYTE SAB_C_CGT_1CEL_M40_S2_S3 1 100 -40 215 DISPLAY_IDENTIFIER sv_c_OilTransTXCAN.GearboxTempIn._.ZFFSAB ECU_ADDRESS 0xFFF8FA15 /end MEASUREMENT
/begin MEASUREMENT ZFFSAB._.GearboxTempIn.PAK_counter_start "counter Pak calls in 10 ms Task" UBYTE SAB_STANDARD_S2_S3 1 100 0 19 DISPLAY_IDENTIFIER PAK_counter_start.GearboxTempIn._.ZFFSAB ECU_ADDRESS 0xFFF8FA16 /end MEASUREMENT
/begin MEASUREMENT ZFFSAB._.GearboxTempIn.PAK_counter_start_ "complement of counter Pak calls in 10 ms Task" UBYTE SAB_STANDARD_S2_S3 1 100 0 19 DISPLAY_IDENTIFIER PAK_counter_start_.GearboxTempIn._.ZFFSAB ECU_ADDRESS 0xFFF8FA17 /end MEASUREMENT
/begin MEASUREMENT ZFFSAB._.GearboxTempIn.PAK_counter_end "counter Pak calls in 10 ms Task" UBYTE SAB_STANDARD_S2_S3 1 100 0 19 DISPLAY_IDENTIFIER PAK_counter_end.GearboxTempIn._.ZFFSAB ECU_ADDRESS 0xFFF8FA18 /end MEASUREMENT
/begin MEASUREMENT ZFFSAB._.GearboxTempIn.PAK_counter_end_ "complement of counter Pak calls in 10 ms Task" UBYTE SAB_STANDARD_S2_S3 1 100 0 19 DISPLAY_IDENTIFIER PAK_counter_end_.GearboxTempIn._.ZFFSAB ECU_ADDRESS 0xFFF8FA19 /end MEASUREMENT
/begin MEASUREMENT ZFFSAB._.HybridControlIn.iv_Ablaufvariante_HAS "input signal SPEC_TYP_ENGSTA of message STAT_ENG_STA_AUTO" UBYTE SAB_STANDARD_S2_S3 1 100 0 15 DISPLAY_IDENTIFIER iv_Ablaufvariante_HAS.HybridControlIn._.ZFFSAB ECU_ADDRESS 0xFFF90097 /end MEASUREMENT
/begin MEASUREMENT ZFFSAB._.HybridControlIn.iv_Startablauf "Type of start: 0 = normal 1 = low temperature 3 = signal error" UBYTE SAB_STANDARD_S2_S3 1 100 0 3 DISPLAY_IDENTIFIER iv_Startablauf.HybridControlIn._.ZFFSAB ECU_ADDRESS 0xFFF90098 /end MEASUREMENT
/begin MEASUREMENT ZFFSAB._.HybridControlIn.iv_Ablaufvariante_HASSts "State of the input signal Z_ABL_VAR_HAS" UBYTE SAB_STANDARD_S2_S3 1 100 0 255 DISPLAY_IDENTIFIER iv_Ablaufvariante_HASSts.HybridControlIn._.ZFFSAB ECU_ADDRESS 0xFFF90099 /end MEASUREMENT
/begin MEASUREMENT ZFFSAB._.HybridControlIn.iv_ST_TAR_PENG_CENG "input signal ST_TAR_PENG_CENG of message STAT_ENG_STA_AUTO" UBYTE SAB_STANDARD_S2_S3 1 100 0 3 DISPLAY_IDENTIFIER iv_ST_TAR_PENG_CENG.HybridControlIn._.ZFFSAB ECU_ADDRESS 0xFFF9009A /end MEASUREMENT
/begin MEASUREMENT ZFFSAB._.HybridControlIn.iv_ST_TAR_PENG_CENGSts "input value State STAT_ENG_STA_AUTO message status" UBYTE SAB_STANDARD_S2_S3 1 100 0 255 DISPLAY_IDENTIFIER iv_ST_TAR_PENG_CENGSts.HybridControlIn._.ZFFSAB ECU_ADDRESS 0xFFF9009B /end MEASUREMENT
/begin MEASUREMENT ZFFSAB._.HybridControlIn.iv_ST_TAR_CENG "input signal ST_TAR_PENG_CENG of message STAT_ENG_STA_AUTO" UBYTE SAB_STANDARD_S2_S3 1 100 0 3 DISPLAY_IDENTIFIER iv_ST_TAR_CENG.HybridControlIn._.ZFFSAB ECU_ADDRESS 0xFFF9009C /end MEASUREMENT
/begin MEASUREMENT ZFFSAB._.HybridControlIn.iv_ST_TAR_CENGSts "input value State STAT_ENG_STA_AUTO message status" UBYTE SAB_STANDARD_S2_S3 1 100 0 255 DISPLAY_IDENTIFIER iv_ST_TAR_CENGSts.HybridControlIn._.ZFFSAB ECU_ADDRESS 0xFFF9009D /end MEASUREMENT
/begin MEASUREMENT ZFFSAB._.HybridControlIn.iv_st_EngineSpeedControlEM "Input signal ST_RPM_CLCTR_MOT" UBYTE SAB_STANDARD_S2_S3 1 100 0 3 DISPLAY_IDENTIFIER iv_st_EngineSpeedControlEM.HybridControlIn._.ZFFSAB ECU_ADDRESS 0xFFF9009E /end MEASUREMENT
/begin MEASUREMENT ZFFSAB._.HybridControlIn.iv_st_EngineSpeedControlEM_ "Complement for input signal ST_RPM_CLCTR_MOT" UBYTE SAB_STANDARD_S2_S3 1 100 0 255 DISPLAY_IDENTIFIER iv_st_EngineSpeedControlEM_.HybridControlIn._.ZFFSAB ECU_ADDRESS 0xFFF9009F /end MEASUREMENT
/begin MEASUREMENT ZFFSAB._.HybridControlIn.iv_st_EngineSpeedControlEMSts "State of the input signal ST_RPM_CLCTR_MOT" UBYTE SAB_STANDARD_S2_S3 1 100 0 255 DISPLAY_IDENTIFIER iv_st_EngineSpeedControlEMSts.HybridControlIn._.ZFFSAB ECU_ADDRESS 0xFFF900A0 /end MEASUREMENT
/begin MEASUREMENT ZFFSAB._.HybridControlIn.iv_st_EngineSpeedControlEMSts_ "Complement for state of the input signal ST_RPM_CLCTR_MOT" UBYTE SAB_STANDARD_S2_S3 1 100 0 255 DISPLAY_IDENTIFIER iv_st_EngineSpeedControlEMSts_.HybridControlIn._.ZFFSAB ECU_ADDRESS 0xFFF900A1 /end MEASUREMENT
/begin MEASUREMENT ZFFSAB._.HybridControlIn.sv_Ablaufvariante_HAS "output value Ablaufvariante_HAS" UBYTE SAB_STANDARD_S2_S3 1 100 0 15 DISPLAY_IDENTIFIER sv_Ablaufvariante_HAS.HybridControlIn._.ZFFSAB ECU_ADDRESS 0xFFF900A2 /end MEASUREMENT
/begin MEASUREMENT ZFFSAB._.HybridControlIn.sv_STAT_Drv "output value STAT_Drv" UBYTE SAB_STANDARD_S2_S3 1 100 0 15 DISPLAY_IDENTIFIER sv_STAT_Drv.HybridControlIn._.ZFFSAB ECU_ADDRESS 0xFFF900A3 /end MEASUREMENT
/begin MEASUREMENT ZFFSAB._.HybridControlIn.sv_ST_TAR_PENG_CENG "output value ST_TAR_PENG_CENG" UBYTE SAB_STANDARD_S2_S3 1 100 0 15 DISPLAY_IDENTIFIER sv_ST_TAR_PENG_CENG.HybridControlIn._.ZFFSAB ECU_ADDRESS 0xFFF900A4 /end MEASUREMENT
/begin MEASUREMENT ZFFSAB._.HybridControlIn.sv_ST_TAR_PENG_CENGSts "output value ST_TAR_PENG_CENGSts" UBYTE SAB_STANDARD_S2_S3 1 100 0 2 DISPLAY_IDENTIFIER sv_ST_TAR_PENG_CENGSts.HybridControlIn._.ZFFSAB ECU_ADDRESS 0xFFF900A5 /end MEASUREMENT
/begin MEASUREMENT ZFFSAB._.HybridControlIn.sv_ST_TAR_CENG "output value ST_TAR_CENG" UBYTE SAB_STANDARD_S2_S3 1 100 0 15 DISPLAY_IDENTIFIER sv_ST_TAR_CENG.HybridControlIn._.ZFFSAB ECU_ADDRESS 0xFFF900A6 /end MEASUREMENT
/begin MEASUREMENT ZFFSAB._.HybridControlIn.sv_ST_TAR_CENGSts "output value ST_TAR_CENGSts" UBYTE SAB_STANDARD_S2_S3 1 100 0 2 DISPLAY_IDENTIFIER sv_ST_TAR_CENGSts.HybridControlIn._.ZFFSAB ECU_ADDRESS 0xFFF900A7 /end MEASUREMENT
/begin MEASUREMENT ZFFSAB._.HybridControlIn.sv_st_EngineSpeedControlEM "output value st_EngineSpeedControlEM" UBYTE SAB_STANDARD_S2_S3 1 100 0 1 DISPLAY_IDENTIFIER sv_st_EngineSpeedControlEM.HybridControlIn._.ZFFSAB ECU_ADDRESS 0xFFF900A8 /end MEASUREMENT
/begin MEASUREMENT ZFFSAB._.HybridControlIn.sv_st_EngineSpeedControlEM_ "Complement for output value st_EngineSpeedControlEM" UBYTE SAB_STANDARD_S2_S3 1 100 0 255 DISPLAY_IDENTIFIER sv_st_EngineSpeedControlEM_.HybridControlIn._.ZFFSAB ECU_ADDRESS 0xFFF900A9 /end MEASUREMENT
/begin MEASUREMENT ZFFSAB._.HybridControlIn.sv_st_EngineSpeedControlEMSts "state of output signal st_EngineSpeedControlEM" UBYTE SAB_STANDARD_S2_S3 1 100 0 2 DISPLAY_IDENTIFIER sv_st_EngineSpeedControlEMSts.HybridControlIn._.ZFFSAB ECU_ADDRESS 0xFFF900AA /end MEASUREMENT
/begin MEASUREMENT ZFFSAB._.HybridControlIn.sv_st_EngineSpeedControlEMSts_ "Complement for state of output signal st_EngineSpeedControlEM" UBYTE SAB_STANDARD_S2_S3 1 100 0 255 DISPLAY_IDENTIFIER sv_st_EngineSpeedControlEMSts_.HybridControlIn._.ZFFSAB ECU_ADDRESS 0xFFF900AB /end MEASUREMENT
/begin MEASUREMENT ZFFSAB._.HybridControlIn.f_ST_TAR_PENG_CENGErr "HAS error flag" UBYTE SAB_STANDARD_S2_S3 1 100 0 1 DISPLAY_IDENTIFIER f_ST_TAR_PENG_CENGErr.HybridControlIn._.ZFFSAB ECU_ADDRESS 0xFFF900AC /end MEASUREMENT
/begin MEASUREMENT ZFFSAB._.HybridControlIn.f_ST_TAR_CENGErr "HAS error flag" UBYTE SAB_STANDARD_S2_S3 1 100 0 1 DISPLAY_IDENTIFIER f_ST_TAR_CENGErr.HybridControlIn._.ZFFSAB ECU_ADDRESS 0xFFF900AD /end MEASUREMENT
/begin MEASUREMENT ZFFSAB._.GearRatioByCurrents.iv_iGang "Current gear ratio calculated by electric currents of actuators IEDS0..IEDS4" SWORD SAB_K1000_S2_S3 1 100 -32.768 32.767 DISPLAY_IDENTIFIER iv_iGang.GearRatioByCurrents._.ZFFSAB ECU_ADDRESS 0xFFF8FDAC /end MEASUREMENT
/begin MEASUREMENT ZFFSAB._.GearRatioByCurrents.iv_iGang_ "Complement value of GET_IGANG_LEV2" SWORD SAB_STANDARD_S2_S3 1 100 -32768 32767 DISPLAY_IDENTIFIER iv_iGang_.GearRatioByCurrents._.ZFFSAB ECU_ADDRESS 0xFFF8FDAE /end MEASUREMENT
/begin MEASUREMENT ZFFSAB._.GearRatioByCurrents.iv_IstGang "Current selected gear calculated by electric currents of actuators IEDS0..IEDS4" SBYTE SAB_STANDARD_S2_S3 1 100 -1 8 DISPLAY_IDENTIFIER iv_IstGang.GearRatioByCurrents._.ZFFSAB ECU_ADDRESS 0xFFF8FDB0 /end MEASUREMENT
/begin MEASUREMENT ZFFSAB._.GearRatioByCurrents.iv_IstGang_ "Complement value of GET_ISTGANG_LEV2" SBYTE SAB_STANDARD_S2_S3 1 100 -128 127 DISPLAY_IDENTIFIER iv_IstGang_.GearRatioByCurrents._.ZFFSAB ECU_ADDRESS 0xFFF8FDB1 /end MEASUREMENT
/begin MEASUREMENT ZFFSAB._.GearRatioByCurrents.iv_sts_ClutchIAE "State of the IAE aka clutch B" UBYTE SAB_STANDARD_S2_S3 1 100 0 255 DISPLAY_IDENTIFIER iv_sts_ClutchIAE.GearRatioByCurrents._.ZFFSAB ECU_ADDRESS 0xFFF8FDB2 /end MEASUREMENT
/begin MEASUREMENT ZFFSAB._.GearRatioByCurrents.sv_f_IAE_ReqSubst "Output signal indicating an IEA over closed request 0=No request to IAE - 1=Request to IAE active" UBYTE SAB_STANDARD_S2_S3 1 100 0 1 DISPLAY_IDENTIFIER sv_f_IAE_ReqSubst.GearRatioByCurrents._.ZFFSAB ECU_ADDRESS 0xFFF8FDB3 /end MEASUREMENT
/begin MEASUREMENT ZFFSAB._.GearRatioByCurrents.iGang "Calculated gear ratio" UWORD SAB_K1000_S2_S3 1 100 0 65.535 DISPLAY_IDENTIFIER iGang.GearRatioByCurrents._.ZFFSAB ECU_ADDRESS 0xFFF8FDB4 /end MEASUREMENT
/begin MEASUREMENT ZFFSAB._.GearRatioByCurrents.IstGang "Calculated gear with different definition: 255=not defined 0=backward 1..8 forward" UBYTE SAB_STANDARD_S2_S3 1 100 0 255 DISPLAY_IDENTIFIER IstGang.GearRatioByCurrents._.ZFFSAB ECU_ADDRESS 0xFFF8FDB6 /end MEASUREMENT
/begin MEASUREMENT ZFFSAB._.GearRatioByCurrents.IstGangOld "Old value of calculated gear" UBYTE SAB_STANDARD_S2_S3 1 100 0 255 DISPLAY_IDENTIFIER IstGangOld.GearRatioByCurrents._.ZFFSAB ECU_ADDRESS 0xFFF8FDB7 /end MEASUREMENT
/begin MEASUREMENT ZFFSAB._.GearRatioByCurrents.iv_n_Tu "Is the n_TuVirt of Lev1 calculation" UWORD SAB_N_1RPM_S2_S3 1 100 0 65535 DISPLAY_IDENTIFIER iv_n_Tu.GearRatioByCurrents._.ZFFSAB ECU_ADDRESS 0xFFF8FDB8 /end MEASUREMENT
/begin MEASUREMENT ZFFSAB._.GearRatioByCurrents.iv_n_Tu_ "Complement of iv_n_Tu" UWORD SAB_STANDARD_S2_S3 1 100 0 65535 DISPLAY_IDENTIFIER iv_n_Tu_.GearRatioByCurrents._.ZFFSAB ECU_ADDRESS 0xFFF8FDBA /end MEASUREMENT
/begin MEASUREMENT ZFFSAB._.GearRatioByCurrents.iv_n6 "Raw value of shaft 6 rotational speed" UWORD SAB_N_1RPM_S2_S3 1 100 0 65535 DISPLAY_IDENTIFIER iv_n6.GearRatioByCurrents._.ZFFSAB ECU_ADDRESS 0xFFF8FDBC /end MEASUREMENT
/begin MEASUREMENT ZFFSAB._.GearRatioByCurrents.iv_n6_ "Complement of iv_n6" UWORD SAB_STANDARD_S2_S3 1 100 0 65535 DISPLAY_IDENTIFIER iv_n6_.GearRatioByCurrents._.ZFFSAB ECU_ADDRESS 0xFFF8FDBE /end MEASUREMENT
/begin MEASUREMENT ZFFSAB._.GearRatioByCurrents.iv_sts_n6_DirectionDiag "Direction flag of n6 rotation" UBYTE SAB_STANDARD_S2_S3 1 100 0 255 DISPLAY_IDENTIFIER iv_sts_n6_DirectionDiag.GearRatioByCurrents._.ZFFSAB ECU_ADDRESS 0xFFF8FDC0 /end MEASUREMENT
/begin MEASUREMENT ZFFSAB._.GearRatioByCurrents.iv_sts_n6_DirectionDiag_ "Complement of iv_sts_n6_DirectionDiag" UBYTE SAB_STANDARD_S2_S3 1 100 0 255 DISPLAY_IDENTIFIER iv_sts_n6_DirectionDiag_.GearRatioByCurrents._.ZFFSAB ECU_ADDRESS 0xFFF8FDC1 /end MEASUREMENT
/begin MEASUREMENT ZFFSAB._.GearRatioByCurrents.sts_n6_Dir "Direction sign of n6 rotation 1=positive -1=negative 0=not defined" SBYTE SAB_STANDARD_S2_S3 1 100 -128 127 DISPLAY_IDENTIFIER sts_n6_Dir.GearRatioByCurrents._.ZFFSAB ECU_ADDRESS 0xFFF8FDC2 /end MEASUREMENT
/begin MEASUREMENT ZFFSAB._.GearRatioByCurrents.f_n6nEngErr "Flag indicating that n6 and nEM are not plausible to each other" UBYTE SAB_STANDARD_S2_S3 1 100 0 1 DISPLAY_IDENTIFIER f_n6nEngErr.GearRatioByCurrents._.ZFFSAB ECU_ADDRESS 0xFFF8FDC3 /end MEASUREMENT
/begin MEASUREMENT ZFFSAB._.GearRatioByCurrents.f_n_TuVirtPlausiErr "Flag indicating that iv_n_Tu = n_TuVirt Lev1 and n_TuVirtLev2 are not plausible to each other" UBYTE SAB_STANDARD_S2_S3 1 100 0 1 DISPLAY_IDENTIFIER f_n_TuVirtPlausiErr.GearRatioByCurrents._.ZFFSAB ECU_ADDRESS 0xFFF8FDC4 /end MEASUREMENT
/begin MEASUREMENT ZFFSAB._.GearRatioByCurrents.f_n_TuVirtPlausiErr_ "Complement of f_n_TuVirtPlausiErr" UBYTE SAB_STANDARD_S2_S3 1 100 0 255 DISPLAY_IDENTIFIER f_n_TuVirtPlausiErr_.GearRatioByCurrents._.ZFFSAB ECU_ADDRESS 0xFFF8FDC5 /end MEASUREMENT
/begin MEASUREMENT ZFFSAB._.GearRatioByCurrents.n_TuVirtLev2Sts "Status of n_TuVirtLev2 0=OK 2=Calculation not possible" UBYTE SAB_STANDARD_S2_S3 1 100 0 2 DISPLAY_IDENTIFIER n_TuVirtLev2Sts.GearRatioByCurrents._.ZFFSAB ECU_ADDRESS 0xFFF8FDC6 /end MEASUREMENT
/begin MEASUREMENT ZFFSAB._.GearRatioByCurrents.n_TuVirtLev2Sts_ "Complement of n_TuVirtLev2Sts" UBYTE SAB_STANDARD_S2_S3 1 100 0 255 DISPLAY_IDENTIFIER n_TuVirtLev2Sts_.GearRatioByCurrents._.ZFFSAB ECU_ADDRESS 0xFFF8FDC7 /end MEASUREMENT
/begin MEASUREMENT ZFFSAB._.GearRatioByCurrents.n_AbByWheelAvg "Calculated n_Ab using n_Wheel average from CAN" UWORD SAB_N_1RPM_S2_S3 1 100 0 65535 DISPLAY_IDENTIFIER n_AbByWheelAvg.GearRatioByCurrents._.ZFFSAB ECU_ADDRESS 0xFFF8FDC8 /end MEASUREMENT
/begin MEASUREMENT ZFFSAB._.GearRatioByCurrents.n_WheelAvgSts "Status of n_Wheel average signal from CAN" UBYTE SAB_STANDARD_S2_S3 1 100 0 2 DISPLAY_IDENTIFIER n_WheelAvgSts.GearRatioByCurrents._.ZFFSAB ECU_ADDRESS 0xFFF8FDCA /end MEASUREMENT
/begin MEASUREMENT ZFFSAB._.GearRatioByCurrents.n_TuVirtLev2 "Raw value of turbine rotational speed" UWORD SAB_N_1RPM_S2_S3 1 100 0 65535 DISPLAY_IDENTIFIER n_TuVirtLev2.GearRatioByCurrents._.ZFFSAB ECU_ADDRESS 0xFFF8FDCC /end MEASUREMENT
/begin MEASUREMENT ZFFSAB._.GearRatioByCurrents.iv_n6_ESts "Electrical status of turbine rotational speed" UBYTE SAB_STANDARD_S2_S3 1 100 0 2 DISPLAY_IDENTIFIER iv_n6_ESts.GearRatioByCurrents._.ZFFSAB ECU_ADDRESS 0xFFF8FDCE /end MEASUREMENT
/begin MEASUREMENT ZFFSAB._.GearRatioByCurrents.iv_n_Ab "Raw value of Transmission output rotational speed" UWORD SAB_N_1RPM_S2_S3 1 100 0 65535 DISPLAY_IDENTIFIER iv_n_Ab.GearRatioByCurrents._.ZFFSAB ECU_ADDRESS 0xFFF8FDD0 /end MEASUREMENT
/begin MEASUREMENT ZFFSAB._.GearRatioByCurrents.iv_n_AbESts "Electrical status of transmission output rotational speed" UBYTE SAB_STANDARD_S2_S3 1 100 0 2 DISPLAY_IDENTIFIER iv_n_AbESts.GearRatioByCurrents._.ZFFSAB ECU_ADDRESS 0xFFF8FDD2 /end MEASUREMENT
/begin MEASUREMENT ZFFSAB._.GearRatioByCurrents.sv_n_EngLev2 "Engine speed" UWORD SAB_N_1RPM_S2_S3 1 100 0 65535 DISPLAY_IDENTIFIER sv_n_EngLev2.GearRatioByCurrents._.ZFFSAB ECU_ADDRESS 0xFFF8FDD4 /end MEASUREMENT
/begin MEASUREMENT ZFFSAB._.GearRatioByCurrents.sv_n_EngLev2Sts "Status of Engine speed" UBYTE SAB_STANDARD_S2_S3 1 100 0 2 DISPLAY_IDENTIFIER sv_n_EngLev2Sts.GearRatioByCurrents._.ZFFSAB ECU_ADDRESS 0xFFF8FDD6 /end MEASUREMENT
/begin MEASUREMENT ZFFSAB._.GearRatioByCurrents.f_RearAxleRatioLearned "Flag indicating that rear axle ratio is learned or learn function is disabled" UBYTE SAB_STANDARD_S2_S3 1 100 0 1 DISPLAY_IDENTIFIER f_RearAxleRatioLearned.GearRatioByCurrents._.ZFFSAB ECU_ADDRESS 0xFFF8FDD7 /end MEASUREMENT
/begin MEASUREMENT ZFFSAB._.GearRatioByCurrents.f_RearAxleRatioLearned_ "Complement of f_RearAxleRatioLearned" UBYTE SAB_STANDARD_S2_S3 1 100 0 255 DISPLAY_IDENTIFIER f_RearAxleRatioLearned_.GearRatioByCurrents._.ZFFSAB ECU_ADDRESS 0xFFF8FDD8 /end MEASUREMENT
/begin MEASUREMENT ZFFSAB._.GearRatioByCurrents.n_AbByWheelAvg_ "Complement of n_AbByWheelAvg" UWORD SAB_STANDARD_S2_S3 1 100 0 65535 DISPLAY_IDENTIFIER n_AbByWheelAvg_.GearRatioByCurrents._.ZFFSAB ECU_ADDRESS 0xFFF8FDDA /end MEASUREMENT
/begin MEASUREMENT ZFFSAB._.GearRatioByCurrents.n_WheelAvgSts_ "Complement of n_WheelAvgSts" UBYTE SAB_STANDARD_S2_S3 1 100 0 255 DISPLAY_IDENTIFIER n_WheelAvgSts_.GearRatioByCurrents._.ZFFSAB ECU_ADDRESS 0xFFF8FDDC /end MEASUREMENT
/begin MEASUREMENT ZFFSAB._.GearRatioByCurrents.n_TuVirtLev2_ "Complement of iv_n_Tu" UWORD SAB_STANDARD_S2_S3 1 100 0 65535 DISPLAY_IDENTIFIER n_TuVirtLev2_.GearRatioByCurrents._.ZFFSAB ECU_ADDRESS 0xFFF8FDDE /end MEASUREMENT
/begin MEASUREMENT ZFFSAB._.GearRatioByCurrents.iv_n6_ESts_ "Complement of iv_n_TuESts" UBYTE SAB_STANDARD_S2_S3 1 100 0 255 DISPLAY_IDENTIFIER iv_n6_ESts_.GearRatioByCurrents._.ZFFSAB ECU_ADDRESS 0xFFF8FDE0 /end MEASUREMENT
/begin MEASUREMENT ZFFSAB._.GearRatioByCurrents.iv_n_Ab_ "Complement of iv_n_Ab" UWORD SAB_STANDARD_S2_S3 1 100 0 65535 DISPLAY_IDENTIFIER iv_n_Ab_.GearRatioByCurrents._.ZFFSAB ECU_ADDRESS 0xFFF8FDE2 /end MEASUREMENT
/begin MEASUREMENT ZFFSAB._.GearRatioByCurrents.iv_n_AbESts_ "Complement of iv_n_AbESts" UBYTE SAB_STANDARD_S2_S3 1 100 0 255 DISPLAY_IDENTIFIER iv_n_AbESts_.GearRatioByCurrents._.ZFFSAB ECU_ADDRESS 0xFFF8FDE4 /end MEASUREMENT
/begin MEASUREMENT ZFFSAB._.GearRatioByCurrents.sv_n_EngLev2_ "Complement of sv_n_EngLev2" UWORD SAB_STANDARD_S2_S3 1 100 0 65535 DISPLAY_IDENTIFIER sv_n_EngLev2_.GearRatioByCurrents._.ZFFSAB ECU_ADDRESS 0xFFF8FDE6 /end MEASUREMENT
/begin MEASUREMENT ZFFSAB._.GearRatioByCurrents.sv_n_EngLev2Sts_ "Complement of sv_n_EngLev2Sts" UBYTE SAB_STANDARD_S2_S3 1 100 0 255 DISPLAY_IDENTIFIER sv_n_EngLev2Sts_.GearRatioByCurrents._.ZFFSAB ECU_ADDRESS 0xFFF8FDE8 /end MEASUREMENT
/begin MEASUREMENT ZFFSAB._.GearRatioByCurrents.f_n_AbWheelErr "Flag indicating that n_Ab and CAN n_Wheel are not plausible to each other" UBYTE SAB_STANDARD_S2_S3 1 100 0 1 DISPLAY_IDENTIFIER f_n_AbWheelErr.GearRatioByCurrents._.ZFFSAB ECU_ADDRESS 0xFFF8FDE9 /end MEASUREMENT
/begin MEASUREMENT ZFFSAB._.GearRatioByCurrents.f_n_Abn6Err "Flag indicating that n_Ab and n_Tu are not plausible to each other" UBYTE SAB_STANDARD_S2_S3 1 100 0 1 DISPLAY_IDENTIFIER f_n_Abn6Err.GearRatioByCurrents._.ZFFSAB ECU_ADDRESS 0xFFF8FDEA /end MEASUREMENT
/begin MEASUREMENT ZFFSAB._.GearRatioByCurrents.f_n6WheelErr "Flag indicating that n_Tu and CAN n_Wheel are not plausible to each other" UBYTE SAB_STANDARD_S2_S3 1 100 0 1 DISPLAY_IDENTIFIER f_n6WheelErr.GearRatioByCurrents._.ZFFSAB ECU_ADDRESS 0xFFF8FDEB /end MEASUREMENT
/begin MEASUREMENT ZFFSAB._.GearRatioByCurrents.f_xErrChanged "Flag indicating that one of the f_n_*Err flags has changed from 0 to 1" UBYTE SAB_STANDARD_S2_S3 1 100 0 1 DISPLAY_IDENTIFIER f_xErrChanged.GearRatioByCurrents._.ZFFSAB ECU_ADDRESS 0xFFF8FDEC /end MEASUREMENT
/begin MEASUREMENT ZFFSAB._.GearRatioByCurrents.err_flags_old "Packed error flags to be stored in EEPROM Bits: 2: f_n_AbWheelErr 1: f_n_AbTuErr 0: f_n_TuWheelErr" UBYTE SAB_STANDARD_S2_S3 1 100 0 255 DISPLAY_IDENTIFIER err_flags_old.GearRatioByCurrents._.ZFFSAB ECU_ADDRESS 0xFFF8FDED /end MEASUREMENT
/begin MEASUREMENT ZFFSAB._.GearRatioByCurrents.err_flags_old_ "Complement of err_flags_old" UBYTE SAB_STANDARD_S2_S3 1 100 0 255 DISPLAY_IDENTIFIER err_flags_old_.GearRatioByCurrents._.ZFFSAB ECU_ADDRESS 0xFFF8FDEE /end MEASUREMENT
/begin MEASUREMENT ZFFSAB._.GearRatioByCurrents.sv_st_KL15 "Ignition state" UBYTE SAB_STANDARD_S2_S3 1 100 0 255 DISPLAY_IDENTIFIER sv_st_KL15.GearRatioByCurrents._.ZFFSAB ECU_ADDRESS 0xFFF8FDEF /end MEASUREMENT
/begin MEASUREMENT ZFFSAB._.GearRatioByCurrents.sv_st_KL15_ "Complement of sv_st_KL15" UBYTE SAB_STANDARD_S2_S3 1 100 0 255 DISPLAY_IDENTIFIER sv_st_KL15_.GearRatioByCurrents._.ZFFSAB ECU_ADDRESS 0xFFF8FDF0 /end MEASUREMENT
/begin MEASUREMENT ZFFSAB._.GearRatioByCurrents.f_n_AbPlausiErr "Flag indicating that n_Ab is not plausible to CAN n_Wheel and n_Tu" UBYTE SAB_STANDARD_S2_S3 1 100 0 1 DISPLAY_IDENTIFIER f_n_AbPlausiErr.GearRatioByCurrents._.ZFFSAB ECU_ADDRESS 0xFFF8FDF1 /end MEASUREMENT
/begin MEASUREMENT ZFFSAB._.GearRatioByCurrents.f_n_WheelPlausiErr "Flag indicating that CAN n_Wheel is not plausible to n_Ab and n_Tu" UBYTE SAB_STANDARD_S2_S3 1 100 0 1 DISPLAY_IDENTIFIER f_n_WheelPlausiErr.GearRatioByCurrents._.ZFFSAB ECU_ADDRESS 0xFFF8FDF2 /end MEASUREMENT
/begin MEASUREMENT ZFFSAB._.GearRatioByCurrents.f_n6PlausiErr "Flag indicating that n_Tu is not plausible to CAN n_Wheel and n_Ab" UBYTE SAB_STANDARD_S2_S3 1 100 0 1 DISPLAY_IDENTIFIER f_n6PlausiErr.GearRatioByCurrents._.ZFFSAB ECU_ADDRESS 0xFFF8FDF3 /end MEASUREMENT
/begin MEASUREMENT ZFFSAB._.GearRatioByCurrents.f_n_PlausiErr "Flag indicating that there are more than two signals of n_Ab n_Tu and n_Wheel have failed" UBYTE SAB_STANDARD_S2_S3 1 100 0 1 DISPLAY_IDENTIFIER f_n_PlausiErr.GearRatioByCurrents._.ZFFSAB ECU_ADDRESS 0xFFF8FDF4 /end MEASUREMENT
/begin MEASUREMENT ZFFSAB._.GearRatioByCurrents.f_n_AbPlausiErr_ "Complement of flag f_n_AbPlausiErr" UBYTE SAB_STANDARD_S2_S3 1 100 0 255 DISPLAY_IDENTIFIER f_n_AbPlausiErr_.GearRatioByCurrents._.ZFFSAB ECU_ADDRESS 0xFFF8FDF5 /end MEASUREMENT
/begin MEASUREMENT ZFFSAB._.GearRatioByCurrents.f_n_WheelPlausiErr_ "Complement of flag f_n_WheelPlausiErr" UBYTE SAB_STANDARD_S2_S3 1 100 0 255 DISPLAY_IDENTIFIER f_n_WheelPlausiErr_.GearRatioByCurrents._.ZFFSAB ECU_ADDRESS 0xFFF8FDF6 /end MEASUREMENT
/begin MEASUREMENT ZFFSAB._.GearRatioByCurrents.f_n6PlausiErr_ "Complement of flag f_n_InPlausiErr" UBYTE SAB_STANDARD_S2_S3 1 100 0 255 DISPLAY_IDENTIFIER f_n6PlausiErr_.GearRatioByCurrents._.ZFFSAB ECU_ADDRESS 0xFFF8FDF7 /end MEASUREMENT
/begin MEASUREMENT ZFFSAB._.GearRatioByCurrents.f_n_PlausiErr_ "Complement of flag f_n_PlausiErr" UBYTE SAB_STANDARD_S2_S3 1 100 0 255 DISPLAY_IDENTIFIER f_n_PlausiErr_.GearRatioByCurrents._.ZFFSAB ECU_ADDRESS 0xFFF8FDF8 /end MEASUREMENT
/begin MEASUREMENT ZFFSAB._.GearRatioByCurrents.iGang_ "Complement of Calculated gear ratio" UWORD SAB_STANDARD_S2_S3 1 100 0 65535 DISPLAY_IDENTIFIER iGang_.GearRatioByCurrents._.ZFFSAB ECU_ADDRESS 0xFFF8FDFA /end MEASUREMENT
/begin MEASUREMENT ZFFSAB._.GearRatioByCurrents.f_n_Abn6Err_ "Complement of flag f_n_AbInErr" UBYTE SAB_STANDARD_S2_S3 1 100 0 255 DISPLAY_IDENTIFIER f_n_Abn6Err_.GearRatioByCurrents._.ZFFSAB ECU_ADDRESS 0xFFF8FDFC /end MEASUREMENT
/begin MEASUREMENT ZFFSAB._.GearRatioByCurrents.f_n6WheelErr_ "Complement of flag f_n_InWheelErr" UBYTE SAB_STANDARD_S2_S3 1 100 0 255 DISPLAY_IDENTIFIER f_n6WheelErr_.GearRatioByCurrents._.ZFFSAB ECU_ADDRESS 0xFFF8FDFD /end MEASUREMENT
/begin MEASUREMENT ZFFSAB._.GearRatioByCurrents.f_n_AbWheelErr_ "Complement of flag f_n_AbWheelErr" UBYTE SAB_STANDARD_S2_S3 1 100 0 255 DISPLAY_IDENTIFIER f_n_AbWheelErr_.GearRatioByCurrents._.ZFFSAB ECU_ADDRESS 0xFFF8FDFE /end MEASUREMENT
/begin MEASUREMENT ZFFSAB._.CAN_SwitchingIn.sv_ACAN_FACAN_Static "Output variable to CAN with the information which CAN is used A(0) FA(1) both faulty (3)" UBYTE SAB_STANDARD_S2_S3 1 100 0 255 DISPLAY_IDENTIFIER sv_ACAN_FACAN_Static.CAN_SwitchingIn._.ZFFSAB ECU_ADDRESS 0xFFF974D5 /end MEASUREMENT
/begin MEASUREMENT ZFFSAB._.CAN_SwitchingIn.sv_f_ACAN_Or_FACAN_Active "Output variable to SAB2. Returns 0 if ACAN or 1 if FACAN is active" UBYTE SAB_STANDARD_S2_S3 1 100 0 1 DISPLAY_IDENTIFIER sv_f_ACAN_Or_FACAN_Active.CAN_SwitchingIn._.ZFFSAB ECU_ADDRESS 0xFFF974D6 /end MEASUREMENT
/begin MEASUREMENT ZFFSAB._.CAN_SwitchingIn.ACAN_FACAN "intermediate variable which describes if ACAN(0)FACAN(1)is chosen or both are faulty(3)" UBYTE SAB_STANDARD_S2_S3 1 100 0 255 DISPLAY_IDENTIFIER ACAN_FACAN.CAN_SwitchingIn._.ZFFSAB ECU_ADDRESS 0xFFF974D7 /end MEASUREMENT
/begin MEASUREMENT ZFFSAB._.CAN_SwitchingIn.CANA_Sts "this variable determines the Status of all ACAN DME Messages" UBYTE SAB_STANDARD_S2_S3 1 100 0 255 DISPLAY_IDENTIFIER CANA_Sts.CAN_SwitchingIn._.ZFFSAB ECU_ADDRESS 0xFFF974D8 /end MEASUREMENT
/begin MEASUREMENT ZFFSAB._.CAN_SwitchingIn.CANFA_Sts "this variable determines the Status of all FACAN DME Messages" UBYTE SAB_STANDARD_S2_S3 1 100 0 255 DISPLAY_IDENTIFIER CANFA_Sts.CAN_SwitchingIn._.ZFFSAB ECU_ADDRESS 0xFFF974D9 /end MEASUREMENT
/begin MEASUREMENT ZFFSAB._.CAN_SwitchingIn.LastCycleFaulty "this variable determines if there was a faulty CAN in last cycle" UBYTE SAB_STANDARD_S2_S3 1 100 0 1 DISPLAY_IDENTIFIER LastCycleFaulty.CAN_SwitchingIn._.ZFFSAB ECU_ADDRESS 0xFFF974DA /end MEASUREMENT
/begin MEASUREMENT ZFFSAB._.Coding.iv_CodingAppl "This variable provides the value of GET_CODING0x3000 means NIC" UWORD SAB_STANDARD_S2_S3 1 100 0 65535 DISPLAY_IDENTIFIER iv_CodingAppl.Coding._.ZFFSAB ECU_ADDRESS 0xFFF974E0 /end MEASUREMENT
/begin MEASUREMENT ZFFSAB._.Coding.iv_CodingElectrical "This variable provides the value of GET_CODING0x3001 means Coding" UWORD SAB_STANDARD_S2_S3 1 100 0 65535 DISPLAY_IDENTIFIER iv_CodingElectrical.Coding._.ZFFSAB ECU_ADDRESS 0xFFF974E2 /end MEASUREMENT
/begin MEASUREMENT ZFFSAB._.Coding.sv_Coding3000 "This variable provides the information of address 0x3000 from the _GET_CODING interface" UWORD SAB_STANDARD_S2_S3 1 100 0 255 DISPLAY_IDENTIFIER sv_Coding3000.Coding._.ZFFSAB ECU_ADDRESS 0xFFF974E4 /end MEASUREMENT
/begin MEASUREMENT ZFFSAB._.Coding.sv_Coding3001 "This variable provides the information of address 0x3001 from the _GET_CODING interface" UWORD SAB_STANDARD_S2_S3 1 100 0 255 DISPLAY_IDENTIFIER sv_Coding3001.Coding._.ZFFSAB ECU_ADDRESS 0xFFF974E6 /end MEASUREMENT
/begin MEASUREMENT ZFFSAB._.Coding.sv_VarCode_NIC "This variable provides the information of the NIC Status at the adress 0x3000 from the _GET_CODING interface: 0=NIC deactive 1=NIC active" UBYTE SAB_STANDARD_S2_S3 1 100 0 2 DISPLAY_IDENTIFIER sv_VarCode_NIC.Coding._.ZFFSAB ECU_ADDRESS 0xFFF974E8 /end MEASUREMENT
/begin MEASUREMENT ZFFSAB._.Coding.sv_VarCode_MILCycles "This variable provides information of macro GET_CODING_MIL_CYCLES: 0=Activate MIL-Lamp in 2.DC 1=Activate MIL-Lamp in 3.DC" UBYTE SAB_STANDARD_S2_S3 1 100 0 1 DISPLAY_IDENTIFIER sv_VarCode_MILCycles.Coding._.ZFFSAB ECU_ADDRESS 0xFFF974E9 /end MEASUREMENT
/begin MEASUREMENT ZFFSAB._.Coding.sv_VarCode_MILLamp "This variable provides information of macro GET_CODING_MIL_LAMP: 0=Deactivate MIL-Control (OBD) 1=Activate MIL-Control (EOBD)" UBYTE SAB_STANDARD_S2_S3 1 100 0 255 DISPLAY_IDENTIFIER sv_VarCode_MILLamp.Coding._.ZFFSAB ECU_ADDRESS 0xFFF974EA /end MEASUREMENT
/begin MEASUREMENT ZFFSAB._.Coding.sv_VarCode_Scantool_Enable "This variable provides information of macro GET_CODING_SCANTOOL_ENABLE: 0=Deactivate Scantool-Output 1=Activate Scantool-Output" UBYTE SAB_STANDARD_S2_S3 1 100 0 255 DISPLAY_IDENTIFIER sv_VarCode_Scantool_Enable.Coding._.ZFFSAB ECU_ADDRESS 0xFFF974EB /end MEASUREMENT
/begin MEASUREMENT ZFFSAB._.Coding.sv_AGS_Codierung "This variable provides the bitmasked high byte of GET_CODING(0x3000) to the AGS Layer LayerIn_Codierung" UBYTE SAB_STANDARD_S2_S3 1 100 0 255 DISPLAY_IDENTIFIER sv_AGS_Codierung.Coding._.ZFFSAB ECU_ADDRESS 0xFFF974EC /end MEASUREMENT
/begin MEASUREMENT ZFFSAB._.Coding.sv_AGS_CodierungOBD "Output to the AGS Layer LayerIn_CodierungOBD" UBYTE SAB_STANDARD_S2_S3 1 100 0 255 DISPLAY_IDENTIFIER sv_AGS_CodierungOBD.Coding._.ZFFSAB ECU_ADDRESS 0xFFF974ED /end MEASUREMENT
/begin MEASUREMENT ZFFSAB._.OSModeSwitchingOut.iv_n_Eng "Input value for engine speed" UWORD SAB_STANDARD_S2_S3 1 100 0 8000 DISPLAY_IDENTIFIER iv_n_Eng.OSModeSwitchingOut._.ZFFSAB ECU_ADDRESS 0xFFF974F4 /end MEASUREMENT
/begin MEASUREMENT ZFFSAB._.OSModeSwitchingOut.iv_n_EngSts "Input value for engine speed signal status" UBYTE SAB_STANDARD_S2_S3 1 100 0 4 DISPLAY_IDENTIFIER iv_n_EngSts.OSModeSwitchingOut._.ZFFSAB ECU_ADDRESS 0xFFF974F6 /end MEASUREMENT
/begin MEASUREMENT ZFFSAB._.OSModeSwitchingOut.OSModeNext "this value shows which mode is online" UBYTE SAB_STANDARD_S2_S3 1 100 0 3 DISPLAY_IDENTIFIER OSModeNext.OSModeSwitchingOut._.ZFFSAB ECU_ADDRESS 0xFFF974F7 /end MEASUREMENT
/begin MEASUREMENT ZFFSAB._.OSModeSwitchingOut.OSModeActive "this value shows which mode is online" UBYTE SAB_STANDARD_S2_S3 1 100 0 3 DISPLAY_IDENTIFIER OSModeActive.OSModeSwitchingOut._.ZFFSAB ECU_ADDRESS 0xFFF974F8 /end MEASUREMENT
/begin MEASUREMENT ZFFSAB._.EngineCoolantTempIn.iv_c_Eng "Input value engine coolant temperature from CAN" UBYTE SAB_C_CMO_1CEL_M48_S2_S3 1 100 -48 207 DISPLAY_IDENTIFIER iv_c_Eng.EngineCoolantTempIn._.ZFFSAB ECU_ADDRESS 0xFFF97500 /end MEASUREMENT
/begin MEASUREMENT ZFFSAB._.EngineCoolantTempIn.iv_c_EngSts "Input value message status of engine coolant temperature" UBYTE SAB_STANDARD_S2_S3 1 100 0 255 DISPLAY_IDENTIFIER iv_c_EngSts.EngineCoolantTempIn._.ZFFSAB ECU_ADDRESS 0xFFF97501 /end MEASUREMENT
/begin MEASUREMENT ZFFSAB._.EngineCoolantTempIn.iv_c_Cem "Input value Temperature of electrical machine from CAN" UBYTE SAB_C_CMO_1CEL_M48_S2_S3 1 100 -48 207 DISPLAY_IDENTIFIER iv_c_Cem.EngineCoolantTempIn._.ZFFSAB ECU_ADDRESS 0xFFF97502 /end MEASUREMENT
/begin MEASUREMENT ZFFSAB._.EngineCoolantTempIn.iv_c_CemSts "Input value message status Temperature of electrical machine" UBYTE SAB_STANDARD_S2_S3 1 100 0 255 DISPLAY_IDENTIFIER iv_c_CemSts.EngineCoolantTempIn._.ZFFSAB ECU_ADDRESS 0xFFF97503 /end MEASUREMENT
/begin MEASUREMENT ZFFSAB._.EngineCoolantTempIn.sv_c_Eng "Output value engine coolant temperature" UBYTE SAB_C_CMO_1CEL_M48_S2_S3 1 100 -48 207 DISPLAY_IDENTIFIER sv_c_Eng.EngineCoolantTempIn._.ZFFSAB ECU_ADDRESS 0xFFF97504 /end MEASUREMENT
/begin MEASUREMENT ZFFSAB._.EngineCoolantTempIn.sv_c_EngSts "Output value signal status of engine coolant temperature" UBYTE SAB_STANDARD_S2_S3 1 100 0 255 DISPLAY_IDENTIFIER sv_c_EngSts.EngineCoolantTempIn._.ZFFSAB ECU_ADDRESS 0xFFF97505 /end MEASUREMENT
/begin MEASUREMENT ZFFSAB._.EngineCoolantTempIn.sv_AGS_Cem "Output value engine coolant temperature" UBYTE SAB_C_CMO_1CEL_M48_S2_S3 1 100 -48 207 DISPLAY_IDENTIFIER sv_AGS_Cem.EngineCoolantTempIn._.ZFFSAB ECU_ADDRESS 0xFFF97506 /end MEASUREMENT
/begin MEASUREMENT ZFFSAB._.EngineCoolantTempIn.sv_c_CemSts "Output value signal status of engine coolant temperature" UBYTE SAB_STANDARD_S2_S3 1 100 0 255 DISPLAY_IDENTIFIER sv_c_CemSts.EngineCoolantTempIn._.ZFFSAB ECU_ADDRESS 0xFFF97507 /end MEASUREMENT
/begin MEASUREMENT ZFFSAB._.EngineCoolantTempIn.f_c_CemErr "Error flag of electrical machine temperature" UBYTE SAB_STANDARD_S2_S3 1 100 0 255 DISPLAY_IDENTIFIER f_c_CemErr.EngineCoolantTempIn._.ZFFSAB ECU_ADDRESS 0xFFF97508 /end MEASUREMENT
/begin MEASUREMENT ZFFSAB._.EngineCoolantTempIn.f_c_EngErr "Error flag of engine coolant temperature" UBYTE SAB_STANDARD_S2_S3 1 100 0 255 DISPLAY_IDENTIFIER f_c_EngErr.EngineCoolantTempIn._.ZFFSAB ECU_ADDRESS 0xFFF97509 /end MEASUREMENT
/begin MEASUREMENT ZFFSAB._.FlagTrailerInfoIn.iv_TrailerInfo "Input value trailer active from CAN" UBYTE SAB_STANDARD_S2_S3 1 100 0 3 DISPLAY_IDENTIFIER iv_TrailerInfo.FlagTrailerInfoIn._.ZFFSAB ECU_ADDRESS 0xFFF97510 /end MEASUREMENT
/begin MEASUREMENT ZFFSAB._.FlagTrailerInfoIn.iv_TrailerInfoSts "Input value message status of trailer active" UBYTE SAB_STANDARD_S2_S3 1 100 0 255 DISPLAY_IDENTIFIER iv_TrailerInfoSts.FlagTrailerInfoIn._.ZFFSAB ECU_ADDRESS 0xFFF97511 /end MEASUREMENT
/begin MEASUREMENT ZFFSAB._.FlagTrailerInfoIn.sv_f_TrailerInfo "Intermediate value trailer active" UBYTE SAB_STANDARD_S2_S3 1 100 0 1 DISPLAY_IDENTIFIER sv_f_TrailerInfo.FlagTrailerInfoIn._.ZFFSAB ECU_ADDRESS 0xFFF97512 /end MEASUREMENT
/begin MEASUREMENT ZFFSAB._.FlagTrailerInfoIn.sv_TrailerInfoSts "Intermediate value message status of trailer active" UBYTE SAB_STANDARD_S2_S3 1 100 0 2 DISPLAY_IDENTIFIER sv_TrailerInfoSts.FlagTrailerInfoIn._.ZFFSAB ECU_ADDRESS 0xFFF97513 /end MEASUREMENT
/begin MEASUREMENT ZFFSAB._.DrivingSpeedControlIn.sv_SpeedControlSts "Output value signal status for output signal" UBYTE SAB_STANDARD_S2_S3 1 100 0 255 DISPLAY_IDENTIFIER sv_SpeedControlSts.DrivingSpeedControlIn._.ZFFSAB ECU_ADDRESS 0xFFF98466 /end MEASUREMENT
/begin MEASUREMENT ZFFSAB._.DrivingSpeedControlIn.f_SpeedControlErr "Error flag of SpeedControl-signal" UBYTE SAB_STANDARD_S2_S3 1 100 0 1 DISPLAY_IDENTIFIER f_SpeedControlErr.DrivingSpeedControlIn._.ZFFSAB ECU_ADDRESS 0xFFF98467 /end MEASUREMENT
/begin MEASUREMENT ZFFSAB._.YawIn.iv_YawQURateSts "Qualifier signal for YawRate-signal" UBYTE SAB_STANDARD_S2_S3 1 100 0 255 DISPLAY_IDENTIFIER iv_YawQURateSts.YawIn._.ZFFSAB ECU_ADDRESS 0xFFF98468 /end MEASUREMENT
/begin MEASUREMENT ZFFSAB._.YawIn.iv_YawRate "Input value yaw rate from CAN" UWORD SAB_OM_YAWRATE_GRADPS200_M32768_S2_S3 1 100 -163.84 163.835 DISPLAY_IDENTIFIER iv_YawRate.YawIn._.ZFFSAB ECU_ADDRESS 0xFFF9846A /end MEASUREMENT
/begin MEASUREMENT ZFFSAB._.YawIn.iv_YawRateSts "Input value message status of yaw rate" UBYTE SAB_STANDARD_S2_S3 1 100 0 255 DISPLAY_IDENTIFIER iv_YawRateSts.YawIn._.ZFFSAB ECU_ADDRESS 0xFFF9846C /end MEASUREMENT
/begin MEASUREMENT ZFFSAB._.YawIn.sv_f_YawRateSts "Output value signal status of yaw rate" UBYTE SAB_STANDARD_S2_S3 1 100 0 2 DISPLAY_IDENTIFIER sv_f_YawRateSts.YawIn._.ZFFSAB ECU_ADDRESS 0xFFF9846D /end MEASUREMENT
/begin MEASUREMENT ZFFSAB._.YawIn.sv_YawRate "Output value yaw rate" SWORD SAB_OM_YAWRATE_GRADPS20_S2_S3 1 100 -1638.4 1638.35 DISPLAY_IDENTIFIER sv_YawRate.YawIn._.ZFFSAB ECU_ADDRESS 0xFFF9846E /end MEASUREMENT
/begin MEASUREMENT ZFFSAB._.YawIn.f_YawRateErr "Error flag of yaw rate" UBYTE SAB_STANDARD_S2_S3 1 100 0 1 DISPLAY_IDENTIFIER f_YawRateErr.YawIn._.ZFFSAB ECU_ADDRESS 0xFFF98470 /end MEASUREMENT
/begin MEASUREMENT ZFFSAB._.HDCIn.iv_HDC "Input value of HDC status from CAN" UBYTE SAB_STANDARD_S2_S3 1 100 0 15 DISPLAY_IDENTIFIER iv_HDC.HDCIn._.ZFFSAB ECU_ADDRESS 0xFFF98472 /end MEASUREMENT
/begin MEASUREMENT ZFFSAB._.HDCIn.iv_HDCSts "Input value message status of HDC status" UBYTE SAB_STANDARD_S2_S3 1 100 0 255 DISPLAY_IDENTIFIER iv_HDCSts.HDCIn._.ZFFSAB ECU_ADDRESS 0xFFF98473 /end MEASUREMENT
/begin MEASUREMENT ZFFSAB._.HDCIn.sv_HDC "Output value of HDC status" UBYTE SAB_STANDARD_S2_S3 1 100 0 7 DISPLAY_IDENTIFIER sv_HDC.HDCIn._.ZFFSAB ECU_ADDRESS 0xFFF98474 /end MEASUREMENT
/begin MEASUREMENT ZFFSAB._.HDCIn.sv_HDCSbe "Output value shifting request HDC" UBYTE SAB_STANDARD_S2_S3 1 100 0 7 DISPLAY_IDENTIFIER sv_HDCSbe.HDCIn._.ZFFSAB ECU_ADDRESS 0xFFF98475 /end MEASUREMENT
/begin MEASUREMENT ZFFSAB._.HDCIn.sv_HDCSts "Output value signal status of HDC status" UBYTE SAB_STANDARD_S2_S3 1 100 0 2 DISPLAY_IDENTIFIER sv_HDCSts.HDCIn._.ZFFSAB ECU_ADDRESS 0xFFF98476 /end MEASUREMENT
/begin MEASUREMENT ZFFSAB._.HDCIn.f_HDCErr "Error flag of HDC-signal" UBYTE SAB_STANDARD_S2_S3 1 100 0 1 DISPLAY_IDENTIFIER f_HDCErr.HDCIn._.ZFFSAB ECU_ADDRESS 0xFFF98477 /end MEASUREMENT
/begin MEASUREMENT ZFFSAB._.FlagKickDownIn.iv_Kickdown "Input value kickdown flag from CAN" UWORD SAB_0025PROZENT_S2_S3 1 100 0 102.375 DISPLAY_IDENTIFIER iv_Kickdown.FlagKickDownIn._.ZFFSAB ECU_ADDRESS 0xFFF98478 /end MEASUREMENT
/begin MEASUREMENT ZFFSAB._.FlagKickDownIn.iv_KickdownSts "Input value message status of kickdown flag" UBYTE SAB_STANDARD_S2_S3 1 100 0 255 DISPLAY_IDENTIFIER iv_KickdownSts.FlagKickDownIn._.ZFFSAB ECU_ADDRESS 0xFFF9847A /end MEASUREMENT
/begin MEASUREMENT ZFFSAB._.FlagKickDownIn.sv_f_Kickdown "Output value kickdown flag" UBYTE SAB_STANDARD_S2_S3 1 100 0 1 DISPLAY_IDENTIFIER sv_f_Kickdown.FlagKickDownIn._.ZFFSAB ECU_ADDRESS 0xFFF9847B /end MEASUREMENT
/begin MEASUREMENT ZFFSAB._.FlagKickDownIn.sv_KickdownSts "Output value signal status of kickdown flag" UBYTE SAB_STANDARD_S2_S3 1 100 0 2 DISPLAY_IDENTIFIER sv_KickdownSts.FlagKickDownIn._.ZFFSAB ECU_ADDRESS 0xFFF9847C /end MEASUREMENT
/begin MEASUREMENT ZFFSAB._.FlagKickDownIn.f_KickdownErr "Error flag of Kickdown-signal" UBYTE SAB_STANDARD_S2_S3 1 100 0 1 DISPLAY_IDENTIFIER f_KickdownErr.FlagKickDownIn._.ZFFSAB ECU_ADDRESS 0xFFF9847D /end MEASUREMENT
/begin MEASUREMENT ZFFSAB._.AccelerationLongIn.iv_AxRef "Input value cross acceleration from CAN" UWORD SAB_A_2MPSS1000_M32500_S2_S3 1 100 -65 66.07 DISPLAY_IDENTIFIER iv_AxRef.AccelerationLongIn._.ZFFSAB ECU_ADDRESS 0xFFF97514 /end MEASUREMENT
/begin MEASUREMENT ZFFSAB._.AccelerationLongIn.iv_AxRefErr "Input value qualifier of cross acceleration" UBYTE SAB_STANDARD_S2_S3 1 100 0 255 DISPLAY_IDENTIFIER iv_AxRefErr.AccelerationLongIn._.ZFFSAB ECU_ADDRESS 0xFFF97516 /end MEASUREMENT
/begin MEASUREMENT ZFFSAB._.AccelerationLongIn.iv_AxRefSts "Input value message status of cross acceleration" UBYTE SAB_STANDARD_S2_S3 1 100 0 255 DISPLAY_IDENTIFIER iv_AxRefSts.AccelerationLongIn._.ZFFSAB ECU_ADDRESS 0xFFF97517 /end MEASUREMENT
/begin MEASUREMENT ZFFSAB._.AccelerationLongIn.sv_AxRef "Output value cross acceleration" SWORD SAB_A_MPSS32_S2_S3 1 100 -65 65 DISPLAY_IDENTIFIER sv_AxRef.AccelerationLongIn._.ZFFSAB ECU_ADDRESS 0xFFF97518 /end MEASUREMENT
/begin MEASUREMENT ZFFSAB._.AccelerationLongIn.sv_AxRefSts "Output value signal status of cross acceleration" UBYTE SAB_STANDARD_S2_S3 1 100 0 2 DISPLAY_IDENTIFIER sv_AxRefSts.AccelerationLongIn._.ZFFSAB ECU_ADDRESS 0xFFF9751A /end MEASUREMENT
/begin MEASUREMENT ZFFSAB._.AccelerationLongIn.f_AxRefErr "Error flag of cross acceleration" UBYTE SAB_STANDARD_S2_S3 1 100 0 1 DISPLAY_IDENTIFIER f_AxRefErr.AccelerationLongIn._.ZFFSAB ECU_ADDRESS 0xFFF9751B /end MEASUREMENT
/begin MEASUREMENT ZFFSAB._.AmbConditionsIn.iv_c_OilTrans "Input value Gearbox Oil Temperatur (index = 1)" UBYTE SAB_C_CGT_1CEL_M40_S2_S3 1 100 -40 215 DISPLAY_IDENTIFIER iv_c_OilTrans.AmbConditionsIn._.ZFFSAB ECU_ADDRESS 0xFFF97528 /end MEASUREMENT
/begin MEASUREMENT ZFFSAB._.AmbConditionsIn.iv_u_BattFilt "Input value Voltage on clamp 30 (index = 2)" UWORD SAB_U_1VOLT1000_S2_S3 1 100 0 65.535 DISPLAY_IDENTIFIER iv_u_BattFilt.AmbConditionsIn._.ZFFSAB ECU_ADDRESS 0xFFF9752A /end MEASUREMENT
/begin MEASUREMENT ZFFSAB._.AmbConditionsIn.iv_Mileage "Kilometer reading (index = 3)" ULONG SAB_L_1KM_S2_S3 1 100 0 4294967295 DISPLAY_IDENTIFIER iv_Mileage.AmbConditionsIn._.ZFFSAB ECU_ADDRESS 0xFFF9752C /end MEASUREMENT
/begin MEASUREMENT ZFFSAB._.AmbConditionsIn.iv_t_SystemTime "System time (index = 4)" ULONG SAB_T_TIMER_1S_S2_S3 1 100 0 4294967295 DISPLAY_IDENTIFIER iv_t_SystemTime.AmbConditionsIn._.ZFFSAB ECU_ADDRESS 0xFFF97530 /end MEASUREMENT
/begin MEASUREMENT ZFFSAB._.AmbConditionsIn.iv_u_Sensor1 "Supply voltage of the sensor supply 1: Speed sensors (index = 5)" UWORD SAB_U_1VOLT1000_S2_S3 1 100 0 65.535 DISPLAY_IDENTIFIER iv_u_Sensor1.AmbConditionsIn._.ZFFSAB ECU_ADDRESS 0xFFF97534 /end MEASUREMENT
/begin MEASUREMENT ZFFSAB._.AmbConditionsIn.iv_c_Chip1Trans "Input value substrate temperature from HW supplier (index = 6)" UBYTE SAB_C_CGT_1CEL_M40_S2_S3 1 100 -40 215 DISPLAY_IDENTIFIER iv_c_Chip1Trans.AmbConditionsIn._.ZFFSAB ECU_ADDRESS 0xFFF97536 /end MEASUREMENT
/begin MEASUREMENT ZFFSAB._.AmbConditionsIn.iv_c_Chip2Trans "Chip Temperatur2 (index = 32)" UBYTE SAB_C_CGT_1CEL_M40_S2_S3 1 100 -40 215 DISPLAY_IDENTIFIER iv_c_Chip2Trans.AmbConditionsIn._.ZFFSAB ECU_ADDRESS 0xFFF97537 /end MEASUREMENT
/begin MEASUREMENT ZFFSAB._.AmbConditionsIn.iv_udrmv1_act "Input signal measured highside voltage EDSx (index = 7)" UWORD SAB_U_1VOLT1000_S2_S3 1 100 0 65.535 DISPLAY_IDENTIFIER iv_udrmv1_act.AmbConditionsIn._.ZFFSAB ECU_ADDRESS 0xFFF97538 /end MEASUREMENT
/begin MEASUREMENT ZFFSAB._.AmbConditionsIn.iv_ThrottlePosition "Input value throttle position (index = 8)" UBYTE SAB_100PROZENT254_S2_S3 1 100 0 100.393700787 DISPLAY_IDENTIFIER iv_ThrottlePosition.AmbConditionsIn._.ZFFSAB ECU_ADDRESS 0xFFF9753A /end MEASUREMENT
/begin MEASUREMENT ZFFSAB._.AmbConditionsIn.iv_n_Ab "Output RPM (index = 9)" UWORD SAB_N_1RPM_S2_S3 1 100 0 65535 DISPLAY_IDENTIFIER iv_n_Ab.AmbConditionsIn._.ZFFSAB ECU_ADDRESS 0xFFF9753C /end MEASUREMENT
/begin MEASUREMENT ZFFSAB._.AmbConditionsIn.iv_n_Tu "Input value turbine speed (index = 10)" UWORD SAB_N_1RPM_S2_S3 1 100 0 65535 DISPLAY_IDENTIFIER iv_n_Tu.AmbConditionsIn._.ZFFSAB ECU_ADDRESS 0xFFF9753E /end MEASUREMENT
/begin MEASUREMENT ZFFSAB._.AmbConditionsIn.iv_n_Eng "Input value engine rpm (index = 11)" UWORD SAB_N_1RPM_S2_S3 1 100 0 65535 DISPLAY_IDENTIFIER iv_n_Eng.AmbConditionsIn._.ZFFSAB ECU_ADDRESS 0xFFF97540 /end MEASUREMENT
/begin MEASUREMENT ZFFSAB._.AmbConditionsIn.iv_m_Eng "Input Motor moment (index = 13)" SWORD SAB_M_1NM_S2_S3 1 100 -32768 32767 DISPLAY_IDENTIFIER iv_m_Eng.AmbConditionsIn._.ZFFSAB ECU_ADDRESS 0xFFF97542 /end MEASUREMENT
/begin MEASUREMENT ZFFSAB._.AmbConditionsIn.iv_ActiveActionByte1 "Detection for active action on Byte1 (index = 15)" ULONG SAB_STANDARD_S2_S3 1 100 0 4294967295 DISPLAY_IDENTIFIER iv_ActiveActionByte1.AmbConditionsIn._.ZFFSAB ECU_ADDRESS 0xFFF97544 /end MEASUREMENT
/begin MEASUREMENT ZFFSAB._.AmbConditionsIn.iv_ActiveActionByte2 "Detection for active action on Byte2 (index = 16)" ULONG SAB_STANDARD_S2_S3 1 100 0 4294967295 DISPLAY_IDENTIFIER iv_ActiveActionByte2.AmbConditionsIn._.ZFFSAB ECU_ADDRESS 0xFFF97548 /end MEASUREMENT
/begin MEASUREMENT ZFFSAB._.AmbConditionsIn.iv_ActiveActionByte3 "Detection for active action on Byte3 (index = 17)" ULONG SAB_STANDARD_S2_S3 1 100 0 4294967295 DISPLAY_IDENTIFIER iv_ActiveActionByte3.AmbConditionsIn._.ZFFSAB ECU_ADDRESS 0xFFF9754C /end MEASUREMENT
/begin MEASUREMENT ZFFSAB._.AmbConditionsIn.iv_ActiveActionByte4 "Detection for active action on Byte4 (index = 18)" ULONG SAB_STANDARD_S2_S3 1 100 0 4294967295 DISPLAY_IDENTIFIER iv_ActiveActionByte4.AmbConditionsIn._.ZFFSAB ECU_ADDRESS 0xFFF97550 /end MEASUREMENT
/begin MEASUREMENT ZFFSAB._.AmbConditionsIn.iv_ActiveActionByte5 "Detection for active action on Byte5 (index = 19)" ULONG SAB_STANDARD_S2_S3 1 100 0 4294967295 DISPLAY_IDENTIFIER iv_ActiveActionByte5.AmbConditionsIn._.ZFFSAB ECU_ADDRESS 0xFFF97554 /end MEASUREMENT
/begin MEASUREMENT ZFFSAB._.AmbConditionsIn.iv_ActiveActionByte6 "Detection for active action on Byte6 (index = 20)" ULONG SAB_STANDARD_S2_S3 1 100 0 4294967295 DISPLAY_IDENTIFIER iv_ActiveActionByte6.AmbConditionsIn._.ZFFSAB ECU_ADDRESS 0xFFF97558 /end MEASUREMENT
/begin MEASUREMENT ZFFSAB._.AmbConditionsIn.iv_ActiveActionByte7 "Detection for active action on Byte7 (index = 21)" ULONG SAB_STANDARD_S2_S3 1 100 0 4294967295 DISPLAY_IDENTIFIER iv_ActiveActionByte7.AmbConditionsIn._.ZFFSAB ECU_ADDRESS 0xFFF9755C /end MEASUREMENT
/begin MEASUREMENT ZFFSAB._.AmbConditionsIn.iv_ActiveActionByte8 "Detection for active action on Byte8 (index = 21)" ULONG SAB_STANDARD_S2_S3 1 100 0 4294967295 DISPLAY_IDENTIFIER iv_ActiveActionByte8.AmbConditionsIn._.ZFFSAB ECU_ADDRESS 0xFFF97560 /end MEASUREMENT
/begin MEASUREMENT ZFFSAB._.AmbConditionsIn.iv_KL15 "Ignition 0=init 1=switching on 2=on 3=switching off 4=off" UBYTE SAB_STANDARD_S2_S3 1 100 0 4 DISPLAY_IDENTIFIER iv_KL15.AmbConditionsIn._.ZFFSAB ECU_ADDRESS 0xFFF97564 /end MEASUREMENT
/begin MEASUREMENT ZFFSAB._.AmbConditionsIn.iv_t_TimeSinceReset "System 1ms Counter (index = 25)" ULONG SAB_T_TIMER_1MS_S2_S3 1 100 0 4294967295 DISPLAY_IDENTIFIER iv_t_TimeSinceReset.AmbConditionsIn._.ZFFSAB ECU_ADDRESS 0xFFF97568 /end MEASUREMENT
/begin MEASUREMENT ZFFSAB._.AmbConditionsIn.iv_Kraftschluss "Power transmission (index = 26 or index = 94); 0 = kein Kraftschluss; 1 = Kraftschluss vorwaerts aufbauen / abbauen; 2 = Kraftschluss vorwaerts; 3 = Kraftschluss rueckwaerts aufbauen / abbauen; 4 = Kraftschluss rueckwaerts; 5 = schlupfendes Schalteleme..." UBYTE SAB_STANDARD_S2_S3 1 100 0 6
 /begin ANNOTATION ANNOTATION_LABEL "Description"
  /begin ANNOTATION_TEXT "Power transmission (index = 26 or index = 94); 0 = kein Kraftschluss; 1 = Kraftschluss vorwaerts aufbauen / abbauen; 2 = Kraftschluss vorwaerts; 3 = Kraftschluss rueckwaerts aufbauen / abbauen; 4 = Kraftschluss rueckwaerts; 5 = schlupfendes Schaltelement " "(8HP/8P: Bremse B) vorwaerts; 6 = schlupfendes Schaltelement (8HP/8P: Bremse B) rueckwaerts" /end ANNOTATION_TEXT
 /end ANNOTATION
 DISPLAY_IDENTIFIER iv_Kraftschluss.AmbConditionsIn._.ZFFSAB ECU_ADDRESS 0xFFF9756C /end MEASUREMENT
/begin MEASUREMENT ZFFSAB._.AmbConditionsIn.iv_st_WKZugSchub "Converter clutch drive overrun (index = 26 or index = 29)" UBYTE SAB_STANDARD_S2_S3 1 100 0 255 DISPLAY_IDENTIFIER iv_st_WKZugSchub.AmbConditionsIn._.ZFFSAB ECU_ADDRESS 0xFFF9756D /end MEASUREMENT
/begin MEASUREMENT ZFFSAB._.AmbConditionsIn.iv_f_L1 "First port of electrical input signal indicating whether mechanical parklock sensor is active.It provides information about gear position" UBYTE SAB_STANDARD_S2_S3 1 100 0 1 DISPLAY_IDENTIFIER iv_f_L1.AmbConditionsIn._.ZFFSAB ECU_ADDRESS 0xFFF9756E /end MEASUREMENT
/begin MEASUREMENT ZFFSAB._.AmbConditionsIn.iv_f_L2 "Second port of electrical input signal indicating whether mechanical parklock sensor is active.It provides information about gear position" UBYTE SAB_STANDARD_S2_S3 1 100 0 1 DISPLAY_IDENTIFIER iv_f_L2.AmbConditionsIn._.ZFFSAB ECU_ADDRESS 0xFFF9756F /end MEASUREMENT
/begin MEASUREMENT ZFFSAB._.AmbConditionsIn.iv_f_L3 "Third port of electrical input signal indicating whether mechanical parklock sensor is active.It provides information about gear position" UBYTE SAB_STANDARD_S2_S3 1 100 0 1 DISPLAY_IDENTIFIER iv_f_L3.AmbConditionsIn._.ZFFSAB ECU_ADDRESS 0xFFF97570 /end MEASUREMENT
/begin MEASUREMENT ZFFSAB._.AmbConditionsIn.iv_f_L4 "Fourth port of electrical input signal indicating whether mechanical parklock sensor is active.It provides information about gear position" UBYTE SAB_STANDARD_S2_S3 1 100 0 1 DISPLAY_IDENTIFIER iv_f_L4.AmbConditionsIn._.ZFFSAB ECU_ADDRESS 0xFFF97571 /end MEASUREMENT
/begin MEASUREMENT ZFFSAB._.AmbConditionsIn.iv_i_Out7 "State of current pressure regulator no.7 (index = 28)" UWORD SAB_I_MA10_S2_S3 1 100 0 6553.5 DISPLAY_IDENTIFIER iv_i_Out7.AmbConditionsIn._.ZFFSAB ECU_ADDRESS 0xFFF97572 /end MEASUREMENT
/begin MEASUREMENT ZFFSAB._.AmbConditionsIn.iv_i_Out8 "State of current pressure regulator no.8 (index = 28)" UWORD SAB_I_MA10_S2_S3 1 100 0 6553.5 DISPLAY_IDENTIFIER iv_i_Out8.AmbConditionsIn._.ZFFSAB ECU_ADDRESS 0xFFF97574 /end MEASUREMENT
/begin MEASUREMENT ZFFSAB._.AmbConditionsIn.iv_i_Out9 "State of current pressure regulator no.9 (index = 28)" UWORD SAB_I_MA10_S2_S3 1 100 0 6553.5 DISPLAY_IDENTIFIER iv_i_Out9.AmbConditionsIn._.ZFFSAB ECU_ADDRESS 0xFFF97576 /end MEASUREMENT
/begin MEASUREMENT ZFFSAB._.AmbConditionsIn.iv_i_Out10 "State of current pressure regulator no.10 (index = 28)" UWORD SAB_I_MA10_S2_S3 1 100 0 6553.5 DISPLAY_IDENTIFIER iv_i_Out10.AmbConditionsIn._.ZFFSAB ECU_ADDRESS 0xFFF97578 /end MEASUREMENT
/begin MEASUREMENT ZFFSAB._.AmbConditionsIn.iv_i_Out11 "State of current pressure regulator no.11 (index = 28)" UWORD SAB_I_MA10_S2_S3 1 100 0 6553.5 DISPLAY_IDENTIFIER iv_i_Out11.AmbConditionsIn._.ZFFSAB ECU_ADDRESS 0xFFF9757A /end MEASUREMENT
/begin MEASUREMENT ZFFSAB._.AmbConditionsIn.iv_i_Out12 "State of current pressure regulator no.12 (index = 28)" UWORD SAB_I_MA10_S2_S3 1 100 0 6553.5 DISPLAY_IDENTIFIER iv_i_Out12.AmbConditionsIn._.ZFFSAB ECU_ADDRESS 0xFFF9757C /end MEASUREMENT
/begin MEASUREMENT ZFFSAB._.AmbConditionsIn.iv_i_Out13 "State of current pressure regulator no.13 (index = 28)" UWORD SAB_I_MA10_S2_S3 1 100 0 6553.5 DISPLAY_IDENTIFIER iv_i_Out13.AmbConditionsIn._.ZFFSAB ECU_ADDRESS 0xFFF9757E /end MEASUREMENT
/begin MEASUREMENT ZFFSAB._.AmbConditionsIn.iv_i_Out14 "State of current pressure regulator no.14 (index = 28)" UWORD SAB_I_MA10_S2_S3 1 100 0 6553.5 DISPLAY_IDENTIFIER iv_i_Out14.AmbConditionsIn._.ZFFSAB ECU_ADDRESS 0xFFF97580 /end MEASUREMENT
/begin MEASUREMENT ZFFSAB._.AmbConditionsIn.iv_c_ChipTempESts "Input value signal status of substrate temperature (index = 29)" UBYTE SAB_STANDARD_S2_S3 1 100 0 255 DISPLAY_IDENTIFIER iv_c_ChipTempESts.AmbConditionsIn._.ZFFSAB ECU_ADDRESS 0xFFF97582 /end MEASUREMENT
/begin MEASUREMENT ZFFSAB._.AmbConditionsIn.iv_c_OilTransSts "Input value signal status of gear oil temperature (index = 29)" UBYTE SAB_STANDARD_S2_S3 1 100 0 255 DISPLAY_IDENTIFIER iv_c_OilTransSts.AmbConditionsIn._.ZFFSAB ECU_ADDRESS 0xFFF97583 /end MEASUREMENT
/begin MEASUREMENT ZFFSAB._.AmbConditionsIn.iv_n_AbSts "Input signal of Transmission Output Speed (index = 29)" UBYTE SAB_STANDARD_S2_S3 1 100 0 255 DISPLAY_IDENTIFIER iv_n_AbSts.AmbConditionsIn._.ZFFSAB ECU_ADDRESS 0xFFF97584 /end MEASUREMENT
/begin MEASUREMENT ZFFSAB._.AmbConditionsIn.iv_n_TuSts "State of the RPM (index = 29)" UBYTE SAB_STANDARD_S2_S3 1 100 0 255 DISPLAY_IDENTIFIER iv_n_TuSts.AmbConditionsIn._.ZFFSAB ECU_ADDRESS 0xFFF97585 /end MEASUREMENT
/begin MEASUREMENT ZFFSAB._.AmbConditionsIn.iv_PSensSts "Input of status of gearlevers signal (index = 29)" UBYTE SAB_STANDARD_S2_S3 1 100 0 255 DISPLAY_IDENTIFIER iv_PSensSts.AmbConditionsIn._.ZFFSAB ECU_ADDRESS 0xFFF97586 /end MEASUREMENT
/begin MEASUREMENT ZFFSAB._.AmbConditionsIn.iv_ThrottlePositionSts "Output value signal Status for angle for Acceleration Pedal (index = 30)" UBYTE SAB_STANDARD_S2_S3 1 100 0 255 DISPLAY_IDENTIFIER iv_ThrottlePositionSts.AmbConditionsIn._.ZFFSAB ECU_ADDRESS 0xFFF97587 /end MEASUREMENT
/begin MEASUREMENT ZFFSAB._.AmbConditionsIn.iv_m_EngSts "Output value signal status for GET_M_MOT (index = 30)" UBYTE SAB_STANDARD_S2_S3 1 100 0 255 DISPLAY_IDENTIFIER iv_m_EngSts.AmbConditionsIn._.ZFFSAB ECU_ADDRESS 0xFFF97588 /end MEASUREMENT
/begin MEASUREMENT ZFFSAB._.AmbConditionsIn.iv_n_EngSts "Output value signal status of engine RPM (index = 30)" UBYTE SAB_STANDARD_S2_S3 1 100 0 255 DISPLAY_IDENTIFIER iv_n_EngSts.AmbConditionsIn._.ZFFSAB ECU_ADDRESS 0xFFF97589 /end MEASUREMENT
/begin MEASUREMENT ZFFSAB._.AmbConditionsIn.iv_p_BrakeSts "Output value signal status of engine RPM (index = 31)" UBYTE SAB_STANDARD_S2_S3 1 100 0 255 DISPLAY_IDENTIFIER iv_p_BrakeSts.AmbConditionsIn._.ZFFSAB ECU_ADDRESS 0xFFF9758A /end MEASUREMENT
/begin MEASUREMENT ZFFSAB._.AmbConditionsIn.iv_f_P12TwoErr "defective park-buttons2 (index = 31)" UBYTE SAB_STANDARD_S2_S3 1 100 0 7 DISPLAY_IDENTIFIER iv_f_P12TwoErr.AmbConditionsIn._.ZFFSAB ECU_ADDRESS 0xFFF9758B /end MEASUREMENT
/begin MEASUREMENT ZFFSAB._.AmbConditionsIn.iv_BrakeSts "Output status signal of brake information (index = 31)" UBYTE SAB_STANDARD_S2_S3 1 100 0 255 DISPLAY_IDENTIFIER iv_BrakeSts.AmbConditionsIn._.ZFFSAB ECU_ADDRESS 0xFFF9758C /end MEASUREMENT
/begin MEASUREMENT ZFFSAB._.AmbConditionsIn.iv_CtrlSignalSourceSts "status of CtrlSignalSource" UBYTE SAB_STANDARD_S2_S3 1 100 0 2 DISPLAY_IDENTIFIER iv_CtrlSignalSourceSts.AmbConditionsIn._.ZFFSAB ECU_ADDRESS 0xFFF9758D /end MEASUREMENT
/begin MEASUREMENT ZFFSAB._.AmbConditionsIn.iv_ABSReg "Input value for ABSReg" UWORD SAB_STANDARD_S2_S3 1 100 0 4095 DISPLAY_IDENTIFIER iv_ABSReg.AmbConditionsIn._.ZFFSAB ECU_ADDRESS 0xFFF9758E /end MEASUREMENT
/begin MEASUREMENT ZFFSAB._.AmbConditionsIn.iv_ASCPas "Input value ASC passive indication from CAN" UWORD SAB_STANDARD_S2_S3 1 100 0 4095 DISPLAY_IDENTIFIER iv_ASCPas.AmbConditionsIn._.ZFFSAB ECU_ADDRESS 0xFFF97590 /end MEASUREMENT
/begin MEASUREMENT ZFFSAB._.AmbConditionsIn.iv_ASCReg "Input value ASC control activ from CAN" UWORD SAB_STANDARD_S2_S3 1 100 0 4095 DISPLAY_IDENTIFIER iv_ASCReg.AmbConditionsIn._.ZFFSAB ECU_ADDRESS 0xFFF97592 /end MEASUREMENT
/begin MEASUREMENT ZFFSAB._.AmbConditionsIn.iv_m_EngIntervention "Input value for pos torque intervention from HPSYS" SWORD SAB_M_1NM_S2_S3 1 100 -32768 32767 DISPLAY_IDENTIFIER iv_m_EngIntervention.AmbConditionsIn._.ZFFSAB ECU_ADDRESS 0xFFF97594 /end MEASUREMENT
/begin MEASUREMENT ZFFSAB._.AmbConditionsIn.iv_SeatBeltSts "Input value signal status of seatbelt detection" UBYTE SAB_STANDARD_S2_S3 1 100 0 2 DISPLAY_IDENTIFIER iv_SeatBeltSts.AmbConditionsIn._.ZFFSAB ECU_ADDRESS 0xFFF97596 /end MEASUREMENT
/begin MEASUREMENT ZFFSAB._.AmbConditionsIn.iv_u_Kl15_Pin "Input of the voltage terminal 15 value" UWORD SAB_U_1VOLT1000_S2_S3 1 100 0 25 DISPLAY_IDENTIFIER iv_u_Kl15_Pin.AmbConditionsIn._.ZFFSAB ECU_ADDRESS 0xFFF97598 /end MEASUREMENT
/begin MEASUREMENT ZFFSAB._.AmbConditionsIn.iv_n_Wheel_FL "Input raw signal of front left (FL) wheel speed from CAN" UWORD SAB_N_RADPS64_M32767_S2_S3 1 100 -511.984375 512 DISPLAY_IDENTIFIER iv_n_Wheel_FL.AmbConditionsIn._.ZFFSAB ECU_ADDRESS 0xFFF9759A /end MEASUREMENT
/begin MEASUREMENT ZFFSAB._.AmbConditionsIn.iv_n_Wheel_FR "Input raw signal of front right (FR) wheel speed from CAN" UWORD SAB_N_RADPS64_M32767_S2_S3 1 100 -511.984375 512 DISPLAY_IDENTIFIER iv_n_Wheel_FR.AmbConditionsIn._.ZFFSAB ECU_ADDRESS 0xFFF9759C /end MEASUREMENT
/begin MEASUREMENT ZFFSAB._.AmbConditionsIn.iv_n_Wheel_RL "Input raw signal of rear left (RL) wheel speed from CAN" UWORD SAB_N_RADPS64_M32767_S2_S3 1 100 -511.984375 512 DISPLAY_IDENTIFIER iv_n_Wheel_RL.AmbConditionsIn._.ZFFSAB ECU_ADDRESS 0xFFF9759E /end MEASUREMENT
/begin MEASUREMENT ZFFSAB._.AmbConditionsIn.iv_n_Wheel_RR "Input raw signal of rear right (RR) wheel speed from CAN" UWORD SAB_N_RADPS64_M32767_S2_S3 1 100 -511.984375 512 DISPLAY_IDENTIFIER iv_n_Wheel_RR.AmbConditionsIn._.ZFFSAB ECU_ADDRESS 0xFFF975A0 /end MEASUREMENT
/begin MEASUREMENT ZFFSAB._.AmbConditionsIn.iv_KL15_UWB81 "Input value of terminal 15 CAN signal" UBYTE SAB_STANDARD_S2_S3 1 100 0 15 DISPLAY_IDENTIFIER iv_KL15_UWB81.AmbConditionsIn._.ZFFSAB ECU_ADDRESS 0xFFF975A2 /end MEASUREMENT
/begin MEASUREMENT ZFFSAB._.AmbConditionsIn.iv_AblaufvarianteHas "Input value: Specification of HAS stateflow variant (HAS: Hybrid-Ablauf-Steuerung)" UBYTE SAB_STANDARD_S2_S3 1 100 0 255 DISPLAY_IDENTIFIER iv_AblaufvarianteHas.AmbConditionsIn._.ZFFSAB ECU_ADDRESS 0xFFF975A3 /end MEASUREMENT
/begin MEASUREMENT ZFFSAB._.AmbConditionsIn.iv_st_HasNominalState "Input value: nominal state of hybrid state machine" UBYTE SAB_STANDARD_S2_S3 1 100 0 255 DISPLAY_IDENTIFIER iv_st_HasNominalState.AmbConditionsIn._.ZFFSAB ECU_ADDRESS 0xFFF975A4 /end MEASUREMENT
/begin MEASUREMENT ZFFSAB._.AmbConditionsIn.iv_st_HasActualState "Input value: actual state of hybrid state machine" UBYTE SAB_STANDARD_S2_S3 1 100 0 255 DISPLAY_IDENTIFIER iv_st_HasActualState.AmbConditionsIn._.ZFFSAB ECU_ADDRESS 0xFFF975A5 /end MEASUREMENT
/begin MEASUREMENT ZFFSAB._.AmbConditionsIn.iv_n_SollEmHas "Input value: nominal speed electrical engine" UWORD SAB_N_1RPM_S2_S3 1 100 0 65535 DISPLAY_IDENTIFIER iv_n_SollEmHas.AmbConditionsIn._.ZFFSAB ECU_ADDRESS 0xFFF975A6 /end MEASUREMENT
/begin MEASUREMENT ZFFSAB._.AmbConditionsIn.iv_m_IstEm "Input value: actual electrical engine torque" SWORD SAB_M_1NM_S2_S3 1 100 -32768 32767 DISPLAY_IDENTIFIER iv_m_IstEm.AmbConditionsIn._.ZFFSAB ECU_ADDRESS 0xFFF975A8 /end MEASUREMENT
/begin MEASUREMENT ZFFSAB._.AmbConditionsIn.iv_m_MotMaxHas "Input value: maximum engine torque" SWORD SAB_M_1NM_S2_S3 1 100 -32768 32767 DISPLAY_IDENTIFIER iv_m_MotMaxHas.AmbConditionsIn._.ZFFSAB ECU_ADDRESS 0xFFF975AA /end MEASUREMENT
/begin MEASUREMENT ZFFSAB._.AmbConditionsIn.iv_m_IstK0 "Input value: actual K0 torque" SWORD SAB_M_1NM_S2_S3 1 100 -32768 32767 DISPLAY_IDENTIFIER iv_m_IstK0.AmbConditionsIn._.ZFFSAB ECU_ADDRESS 0xFFF975AC /end MEASUREMENT
/begin MEASUREMENT ZFFSAB._.AmbConditionsIn.iv_StatusK0 "Input value: state of K0" UBYTE SAB_STANDARD_S2_S3 1 100 0 255 DISPLAY_IDENTIFIER iv_StatusK0.AmbConditionsIn._.ZFFSAB ECU_ADDRESS 0xFFF975AE /end MEASUREMENT
/begin MEASUREMENT ZFFSAB._.AmbConditionsIn.iv_KupStatusIae "Input value: physical state of integrated starting device" UBYTE SAB_STANDARD_S2_S3 1 100 0 255 DISPLAY_IDENTIFIER iv_KupStatusIae.AmbConditionsIn._.ZFFSAB ECU_ADDRESS 0xFFF975AF /end MEASUREMENT
/begin MEASUREMENT ZFFSAB._.AmbConditionsIn.iv_IepIst "Input value: state of auxiliary electrical pump" UBYTE SAB_STANDARD_S2_S3 1 100 0 255 DISPLAY_IDENTIFIER iv_IepIst.AmbConditionsIn._.ZFFSAB ECU_ADDRESS 0xFFF975B0 /end MEASUREMENT
/begin MEASUREMENT ZFFSAB._.AmbConditionsIn.iv_ActualGear "Actual gear of the gear shifting control unit; -1 = R Gang; 0 = Kein Gang; 1 = 1. Gang; 2 = 2. Gang; 3 = 3. Gang; 4 = 4. Gang; 5 = 5. Gang; 6 = 6. Gang; 7 = 7. Gang; 8 = 8. Gang; 9 = 9. Gang (Getriebevarianten spezifisch)" SBYTE SAB_STANDARD_S2_S3 1 100 0 10 DISPLAY_IDENTIFIER iv_ActualGear.AmbConditionsIn._.ZFFSAB ECU_ADDRESS 0xFFF975B1 /end MEASUREMENT
/begin MEASUREMENT ZFFSAB._.AmbConditionsIn.iv_TargetGear "Target gear of the gear shifting control unit; -1 = R Gang; 0 = Kein Gang; 1 = 1. Gang; 2 = 2. Gang; 3 = 3. Gang; 4 = 4. Gang; 5 = 5. Gang; 6 = 6. Gang; 7 = 7. Gang; 8 = 8. Gang; 9 = 9. Gang (Getriebevarianten spezifisch)" SBYTE SAB_STANDARD_S2_S3 1 100 0 10 DISPLAY_IDENTIFIER iv_TargetGear.AmbConditionsIn._.ZFFSAB ECU_ADDRESS 0xFFF975B2 /end MEASUREMENT
/begin MEASUREMENT ZFFSAB._.AmbConditionsIn.iv_DrivingDirection "Input signal of driving direction wheel; 0 = Drehrichtung unbestimmt; 1 = Drehrichtung vorwaerts; 2 = Drehrichtung rueckwaerts" UBYTE SAB_STANDARD_S2_S3 1 100 0 2 DISPLAY_IDENTIFIER iv_DrivingDirection.AmbConditionsIn._.ZFFSAB ECU_ADDRESS 0xFFF975B3 /end MEASUREMENT
/begin MEASUREMENT ZFFSAB._.AmbConditionsIn.iv_Tu_sts_Direction "Input signal of direction of rotation (turbine); 0 = Drehrichtung unbestimmt; 1 = Drehrichtung Motor und Turbine gleichsinnig; 2 = Drehrichtung Motor und Turbine ungleichsinnig" UBYTE SAB_STANDARD_S2_S3 1 100 0 2 DISPLAY_IDENTIFIER iv_Tu_sts_Direction.AmbConditionsIn._.ZFFSAB ECU_ADDRESS 0xFFF975B4 /end MEASUREMENT
/begin MEASUREMENT ZFFSAB._.AmbConditionsIn.iv_m_Crank "Input value of current torque of crankshaft corrected by the pump intake torque" SWORD SAB_M_NM_S2_S3 1 100 -400 1640 DISPLAY_IDENTIFIER iv_m_Crank.AmbConditionsIn._.ZFFSAB ECU_ADDRESS 0xFFF975B6 /end MEASUREMENT
/begin MEASUREMENT ZFFSAB._.AmbConditionsIn.iv_m_EngMax "Input value for max torque" SWORD SAB_M_1NM_S2_S3 1 100 -32768 32767 DISPLAY_IDENTIFIER iv_m_EngMax.AmbConditionsIn._.ZFFSAB ECU_ADDRESS 0xFFF975B8 /end MEASUREMENT
/begin MEASUREMENT ZFFSAB._.AmbConditionsIn.iv_STAT_Drv "Input raw signal Status MSA" UBYTE SAB_STANDARD_S2_S3 1 100 0 255 DISPLAY_IDENTIFIER iv_STAT_Drv.AmbConditionsIn._.ZFFSAB ECU_ADDRESS 0xFFF975BA /end MEASUREMENT
/begin MEASUREMENT ZFFSAB._.AmbConditionsIn.iv_n_EngVM "Input value engine rpm" UWORD SAB_N_1RPM_S2_S3 1 100 0 65535 DISPLAY_IDENTIFIER iv_n_EngVM.AmbConditionsIn._.ZFFSAB ECU_ADDRESS 0xFFF975BC /end MEASUREMENT
/begin MEASUREMENT ZFFSAB._.AmbConditionsIn.iv_MileageFromNab "Mileage calculation based on GET_NAB" ULONG SAB_L_1KM_S2_S3 1 100 0 4294967295 DISPLAY_IDENTIFIER iv_MileageFromNab.AmbConditionsIn._.ZFFSAB ECU_ADDRESS 0xFFF975C0 /end MEASUREMENT
/begin MEASUREMENT ZFFSAB._.AmbConditionsIn.iv_t_Betrstd "Operating hours counter while control unit is in operating system status: CRUISE; stored in EEPROM" ULONG SAB_T_1MIN_S2_S3 1 100 0 4294967295 DISPLAY_IDENTIFIER iv_t_Betrstd.AmbConditionsIn._.ZFFSAB ECU_ADDRESS 0xFFF975C4 /end MEASUREMENT
/begin MEASUREMENT ZFFSAB._.AmbConditionsIn.iv_ctl_EIErrType "Error type of engine intervention." UBYTE SAB_STANDARD_S2_S3 1 100 0 255 DISPLAY_IDENTIFIER iv_ctl_EIErrType.AmbConditionsIn._.ZFFSAB ECU_ADDRESS 0xFFF975C8 /end MEASUREMENT
/begin MEASUREMENT ZFFSAB._.AmbConditionsIn.iv_ctl_EI1ErrType "Type of engine intervention fault (primary fault code for development phase)." UBYTE SAB_STANDARD_S2_S3 1 100 0 255 DISPLAY_IDENTIFIER iv_ctl_EI1ErrType.AmbConditionsIn._.ZFFSAB ECU_ADDRESS 0xFFF975C9 /end MEASUREMENT
/begin MEASUREMENT ZFFSAB._.AmbConditionsIn.iv_clutch_data "Environmental condition (ATSYS):Interface provides information concerning too high clutch temperatures." UBYTE SAB_STANDARD_S2_S3 1 100 0 255 DISPLAY_IDENTIFIER iv_clutch_data.AmbConditionsIn._.ZFFSAB ECU_ADDRESS 0xFFF975CA /end MEASUREMENT
/begin MEASUREMENT ZFFSAB._.AmbConditionsIn.iv_i_Out0 "Input value: Measured current at output OUT0" UWORD SAB_I_MA10_S2_S3 1 100 0 6553.5 DISPLAY_IDENTIFIER iv_i_Out0.AmbConditionsIn._.ZFFSAB ECU_ADDRESS 0xFFF975CC /end MEASUREMENT
/begin MEASUREMENT ZFFSAB._.AmbConditionsIn.iv_i_Out1 "Input value: Measured current at output OUT1" UWORD SAB_I_MA10_S2_S3 1 100 0 6553.5 DISPLAY_IDENTIFIER iv_i_Out1.AmbConditionsIn._.ZFFSAB ECU_ADDRESS 0xFFF975CE /end MEASUREMENT
/begin MEASUREMENT ZFFSAB._.AmbConditionsIn.iv_i_Out2 "Input value: Measured current at output OUT2" UWORD SAB_I_MA10_S2_S3 1 100 0 6553.5 DISPLAY_IDENTIFIER iv_i_Out2.AmbConditionsIn._.ZFFSAB ECU_ADDRESS 0xFFF975D0 /end MEASUREMENT
/begin MEASUREMENT ZFFSAB._.AmbConditionsIn.iv_i_Out3 "Input value: Measured current at output OUT3" UWORD SAB_I_MA10_S2_S3 1 100 0 6553.5 DISPLAY_IDENTIFIER iv_i_Out3.AmbConditionsIn._.ZFFSAB ECU_ADDRESS 0xFFF975D2 /end MEASUREMENT
/begin MEASUREMENT ZFFSAB._.AmbConditionsIn.iv_i_Out4 "Input value: Measured current at output OUT4" UWORD SAB_I_MA10_S2_S3 1 100 0 6553.5 DISPLAY_IDENTIFIER iv_i_Out4.AmbConditionsIn._.ZFFSAB ECU_ADDRESS 0xFFF975D4 /end MEASUREMENT
/begin MEASUREMENT ZFFSAB._.AmbConditionsIn.iv_i_Out5 "Input value: Measured current at output OUT5" UWORD SAB_I_MA10_S2_S3 1 100 0 6553.5 DISPLAY_IDENTIFIER iv_i_Out5.AmbConditionsIn._.ZFFSAB ECU_ADDRESS 0xFFF975D6 /end MEASUREMENT
/begin MEASUREMENT ZFFSAB._.AmbConditionsIn.iv_i_Out6 "Input value: Measured current at output OUT6" UWORD SAB_I_MA10_S2_S3 1 100 0 6553.5 DISPLAY_IDENTIFIER iv_i_Out6.AmbConditionsIn._.ZFFSAB ECU_ADDRESS 0xFFF975D8 /end MEASUREMENT
/begin MEASUREMENT ZFFSAB._.AmbConditionsIn.sv_c_OilTrans "Output value Gearbox Oil Temperatur (index = 1)" UBYTE SAB_C_CGT_1CEL_M40_S2_S3 1 100 -40 215 DISPLAY_IDENTIFIER sv_c_OilTrans.AmbConditionsIn._.ZFFSAB ECU_ADDRESS 0xFFF975DA /end MEASUREMENT
/begin MEASUREMENT ZFFSAB._.AmbConditionsIn.sv_u_BattFilt "Output value Voltage on clamp 30 (index = 2)" UBYTE SAB_U_100VOLT8_S2_S3 1 100 0 20.4 DISPLAY_IDENTIFIER sv_u_BattFilt.AmbConditionsIn._.ZFFSAB ECU_ADDRESS 0xFFF975DB /end MEASUREMENT
/begin MEASUREMENT ZFFSAB._.AmbConditionsIn.sv_Mileage "Output value of mileage (index = 3)" ULONG SAB_L_1KM_S2_S3 1 100 0 16777215 DISPLAY_IDENTIFIER sv_Mileage.AmbConditionsIn._.ZFFSAB ECU_ADDRESS 0xFFF975DC /end MEASUREMENT
/begin MEASUREMENT ZFFSAB._.AmbConditionsIn.sv_t_SystemTime "Current system time (index = 4)" ULONG SAB_T_TIMER_1S_S2_S3 1 100 0 4294967295 DISPLAY_IDENTIFIER sv_t_SystemTime.AmbConditionsIn._.ZFFSAB ECU_ADDRESS 0xFFF975E0 /end MEASUREMENT
/begin MEASUREMENT ZFFSAB._.AmbConditionsIn.sv_u_Sensor1 "Output value Supply voltage of the sensor supply 1 (index = 5)" UBYTE SAB_U_100VOLT8_S2_S3 1 100 0 20.4 DISPLAY_IDENTIFIER sv_u_Sensor1.AmbConditionsIn._.ZFFSAB ECU_ADDRESS 0xFFF975E4 /end MEASUREMENT
/begin MEASUREMENT ZFFSAB._.AmbConditionsIn.sv_c_Chip1Trans "Output value substrate temperature from HW supplier (index = 6)" UBYTE SAB_C_CGT_1CEL_M40_S2_S3 1 100 -40 215 DISPLAY_IDENTIFIER sv_c_Chip1Trans.AmbConditionsIn._.ZFFSAB ECU_ADDRESS 0xFFF975E5 /end MEASUREMENT
/begin MEASUREMENT ZFFSAB._.AmbConditionsIn.sv_udrmv1_act "Output signal measured highside voltage EDSx (index = 7)" UBYTE SAB_U_100VOLT8_S2_S3 1 100 0 20.4 DISPLAY_IDENTIFIER sv_udrmv1_act.AmbConditionsIn._.ZFFSAB ECU_ADDRESS 0xFFF975E6 /end MEASUREMENT
/begin MEASUREMENT ZFFSAB._.AmbConditionsIn.sv_ThrottlePosition "Output value throttle position (index = 8)" UBYTE SAB_100PROZENT254_S2_S3 1 100 0 100.393700787 DISPLAY_IDENTIFIER sv_ThrottlePosition.AmbConditionsIn._.ZFFSAB ECU_ADDRESS 0xFFF975E7 /end MEASUREMENT
/begin MEASUREMENT ZFFSAB._.AmbConditionsIn.sv_n_Ab "Output RPM (index = 9)" UBYTE SAB_N_32RPM_S2_S3 1 100 0 8160 DISPLAY_IDENTIFIER sv_n_Ab.AmbConditionsIn._.ZFFSAB ECU_ADDRESS 0xFFF975E8 /end MEASUREMENT
/begin MEASUREMENT ZFFSAB._.AmbConditionsIn.sv_n_Tu "Output value turbine speed (index = 10)" UBYTE SAB_N_32RPM_S2_S3 1 100 0 8160 DISPLAY_IDENTIFIER sv_n_Tu.AmbConditionsIn._.ZFFSAB ECU_ADDRESS 0xFFF975E9 /end MEASUREMENT
/begin MEASUREMENT ZFFSAB._.AmbConditionsIn.sv_n_Eng "Output value engine rpm (index = 11)" UBYTE SAB_N_32RPM_S2_S3 1 100 0 8160 DISPLAY_IDENTIFIER sv_n_Eng.AmbConditionsIn._.ZFFSAB ECU_ADDRESS 0xFFF975EA /end MEASUREMENT
/begin MEASUREMENT ZFFSAB._.AmbConditionsIn.iv_n_WheelAvg_UWB12 "Average Wheel rpm of all driven wheels (index = 12)" ULONG SAB_N_RPM100_S2_S3 1 100 0 42949672.95 DISPLAY_IDENTIFIER iv_n_WheelAvg_UWB12.AmbConditionsIn._.ZFFSAB ECU_ADDRESS 0xFFF975EC /end MEASUREMENT
/begin MEASUREMENT ZFFSAB._.AmbConditionsIn.sv_n_WheelAvg_UWB12 "Intermediate value of wheel speed from driven wheels" UWORD SAB_N_1RPM_S2_S3 1 100 0 65535 DISPLAY_IDENTIFIER sv_n_WheelAvg_UWB12.AmbConditionsIn._.ZFFSAB ECU_ADDRESS 0xFFF975F0 /end MEASUREMENT
/begin MEASUREMENT ZFFSAB._.AmbConditionsIn.sv_m_Eng "Motor moment (index = 13)" UBYTE SAB_M_4NM_M100_S2_S3 1 100 -100 920 DISPLAY_IDENTIFIER sv_m_Eng.AmbConditionsIn._.ZFFSAB ECU_ADDRESS 0xFFF975F2 /end MEASUREMENT
/begin MEASUREMENT ZFFSAB._.AmbConditionsIn.iv_st_IstGang "Actual Gear Information (index = 14 or index = 26)" SBYTE SAB_STANDARD_S2_S3 1 100 -1 7 DISPLAY_IDENTIFIER iv_st_IstGang.AmbConditionsIn._.ZFFSAB ECU_ADDRESS 0xFFF975F3 /end MEASUREMENT
/begin MEASUREMENT ZFFSAB._.AmbConditionsIn.sv_st_ZielGang "Destination Gear Information (index = 14 or index = 26)" SBYTE SAB_STANDARD_S2_S3 1 100 -1 7 DISPLAY_IDENTIFIER sv_st_ZielGang.AmbConditionsIn._.ZFFSAB ECU_ADDRESS 0xFFF975F4 /end MEASUREMENT
/begin MEASUREMENT ZFFSAB._.AmbConditionsIn.sv_st_GearShiftingInfo "Gear state (index = 26 or index = 91)" UBYTE SAB_STANDARD_S2_S3 1 100 0 255 DISPLAY_IDENTIFIER sv_st_GearShiftingInfo.AmbConditionsIn._.ZFFSAB ECU_ADDRESS 0xFFF975F5 /end MEASUREMENT
/begin MEASUREMENT ZFFSAB._.AmbConditionsIn.sv_ActiveActionByte1 "Detection for active action on Byte1 (index = 15)" UBYTE SAB_STANDARD_S2_S3 1 100 0 255 DISPLAY_IDENTIFIER sv_ActiveActionByte1.AmbConditionsIn._.ZFFSAB ECU_ADDRESS 0xFFF975F6 /end MEASUREMENT
/begin MEASUREMENT ZFFSAB._.AmbConditionsIn.sv_ActiveActionByte2 "Detection for active action on Byte2 (index = 16)" UBYTE SAB_STANDARD_S2_S3 1 100 0 255 DISPLAY_IDENTIFIER sv_ActiveActionByte2.AmbConditionsIn._.ZFFSAB ECU_ADDRESS 0xFFF975F7 /end MEASUREMENT
/begin MEASUREMENT ZFFSAB._.AmbConditionsIn.sv_ActiveActionByte3 "Detection for active action on Byte3 (index = 17)" UBYTE SAB_STANDARD_S2_S3 1 100 0 255 DISPLAY_IDENTIFIER sv_ActiveActionByte3.AmbConditionsIn._.ZFFSAB ECU_ADDRESS 0xFFF975F8 /end MEASUREMENT
/begin MEASUREMENT ZFFSAB._.AmbConditionsIn.sv_ActiveActionByte4 "Detection for active action on Byte4 (index = 18)" UBYTE SAB_STANDARD_S2_S3 1 100 0 255 DISPLAY_IDENTIFIER sv_ActiveActionByte4.AmbConditionsIn._.ZFFSAB ECU_ADDRESS 0xFFF975F9 /end MEASUREMENT
/begin MEASUREMENT ZFFSAB._.AmbConditionsIn.sv_ActiveActionByte5 "Detection for active action on Byte5 (index = 19)" UBYTE SAB_STANDARD_S2_S3 1 100 0 255 DISPLAY_IDENTIFIER sv_ActiveActionByte5.AmbConditionsIn._.ZFFSAB ECU_ADDRESS 0xFFF975FA /end MEASUREMENT
/begin MEASUREMENT ZFFSAB._.AmbConditionsIn.sv_ActiveActionByte6 "Detection for active action on Byte6 (index = 20)" UBYTE SAB_STANDARD_S2_S3 1 100 0 255 DISPLAY_IDENTIFIER sv_ActiveActionByte6.AmbConditionsIn._.ZFFSAB ECU_ADDRESS 0xFFF975FB /end MEASUREMENT
/begin MEASUREMENT ZFFSAB._.AmbConditionsIn.sv_ActiveActionByte7 "Detection for active action on Byte7 (index = 21)" UBYTE SAB_STANDARD_S2_S3 1 100 0 255 DISPLAY_IDENTIFIER sv_ActiveActionByte7.AmbConditionsIn._.ZFFSAB ECU_ADDRESS 0xFFF975FC /end MEASUREMENT
/begin MEASUREMENT ZFFSAB._.AmbConditionsIn.sv_ActiveActionByte8 "Detection for active action on Byte8 (index = 22)" UBYTE SAB_STANDARD_S2_S3 1 100 0 255 DISPLAY_IDENTIFIER sv_ActiveActionByte8.AmbConditionsIn._.ZFFSAB ECU_ADDRESS 0xFFF975FD /end MEASUREMENT
/begin MEASUREMENT ZFFSAB._.AmbConditionsIn.sv_KL15 "Ignition (index = 24)" UBYTE SAB_STANDARD_S2_S3 1 100 0 255 DISPLAY_IDENTIFIER sv_KL15.AmbConditionsIn._.ZFFSAB ECU_ADDRESS 0xFFF97600 /end MEASUREMENT
/begin MEASUREMENT ZFFSAB._.AmbConditionsIn.sv_t_TimeSinceReset "Time since reset (index = 25)" ULONG SAB_T_TIMER_30MS_S2_S3 1 100 0 128849018850 DISPLAY_IDENTIFIER sv_t_TimeSinceReset.AmbConditionsIn._.ZFFSAB ECU_ADDRESS 0xFFF97604 /end MEASUREMENT
/begin MEASUREMENT ZFFSAB._.AmbConditionsIn.sv_st_DiscreteEntries "State for discrete entries (index = 27)" UBYTE SAB_STANDARD_S2_S3 1 100 0 255 DISPLAY_IDENTIFIER sv_st_DiscreteEntries.AmbConditionsIn._.ZFFSAB ECU_ADDRESS 0xFFF97608 /end MEASUREMENT
/begin MEASUREMENT ZFFSAB._.AmbConditionsIn.sv_st_MVs "State for MVs signals (index = 28)" UBYTE SAB_STANDARD_S2_S3 1 100 0 255 DISPLAY_IDENTIFIER sv_st_MVs.AmbConditionsIn._.ZFFSAB ECU_ADDRESS 0xFFF97609 /end MEASUREMENT
/begin MEASUREMENT ZFFSAB._.AmbConditionsIn.sv_st_GearboxSig "State for EGS signals (index = 29)" UBYTE SAB_STANDARD_S2_S3 1 100 0 255 DISPLAY_IDENTIFIER sv_st_GearboxSig.AmbConditionsIn._.ZFFSAB ECU_ADDRESS 0xFFF9760A /end MEASUREMENT
/begin MEASUREMENT ZFFSAB._.AmbConditionsIn.sv_st_MotorCanSig "State for Motor signals (index = 30)" UBYTE SAB_STANDARD_S2_S3 1 100 0 255 DISPLAY_IDENTIFIER sv_st_MotorCanSig.AmbConditionsIn._.ZFFSAB ECU_ADDRESS 0xFFF9760B /end MEASUREMENT
/begin MEASUREMENT ZFFSAB._.AmbConditionsIn.iv_ABSRegSts "Message status of ABS regulation (index = 31)" UBYTE SAB_STANDARD_S2_S3 1 100 0 255 DISPLAY_IDENTIFIER iv_ABSRegSts.AmbConditionsIn._.ZFFSAB ECU_ADDRESS 0xFFF9760C /end MEASUREMENT
/begin MEASUREMENT ZFFSAB._.AmbConditionsIn.sv_st_AscDscCanSig "State for signals from ASC/DSC/GWS (index = 31)" UBYTE SAB_STANDARD_S2_S3 1 100 0 255 DISPLAY_IDENTIFIER sv_st_AscDscCanSig.AmbConditionsIn._.ZFFSAB ECU_ADDRESS 0xFFF9760D /end MEASUREMENT
/begin MEASUREMENT ZFFSAB._.AmbConditionsIn.sv_c_Chip2Trans "Output value substrate temperature from HW supplier (index = 32)" UBYTE SAB_C_1CEL_M40_S2_S3 1 100 -40 215 DISPLAY_IDENTIFIER sv_c_Chip2Trans.AmbConditionsIn._.ZFFSAB ECU_ADDRESS 0xFFF9760E /end MEASUREMENT
/begin MEASUREMENT ZFFSAB._.AmbConditionsIn.sv_ABSReg "Output value ABS status (index = 33)" UWORD SAB_STANDARD_S2_S3 1 100 0 4095 DISPLAY_IDENTIFIER sv_ABSReg.AmbConditionsIn._.ZFFSAB ECU_ADDRESS 0xFFF97610 /end MEASUREMENT
/begin MEASUREMENT ZFFSAB._.AmbConditionsIn.sv_ASCPas "Output value ASC passive indication from CAN (index = 34)" UWORD SAB_STANDARD_S2_S3 1 100 0 4095 DISPLAY_IDENTIFIER sv_ASCPas.AmbConditionsIn._.ZFFSAB ECU_ADDRESS 0xFFF97612 /end MEASUREMENT
/begin MEASUREMENT ZFFSAB._.AmbConditionsIn.sv_ASCReg "Output value ASC control activ from CAN (index = 35)" UWORD SAB_STANDARD_S2_S3 1 100 0 4095 DISPLAY_IDENTIFIER sv_ASCReg.AmbConditionsIn._.ZFFSAB ECU_ADDRESS 0xFFF97614 /end MEASUREMENT
/begin MEASUREMENT ZFFSAB._.AmbConditionsIn.sv_m_EngIntervention "Output value for pos torque intervention from HPSYS (index = 66)" SWORD SAB_M_1NM_S2_S3 1 100 -32768 32767 DISPLAY_IDENTIFIER sv_m_EngIntervention.AmbConditionsIn._.ZFFSAB ECU_ADDRESS 0xFFF97616 /end MEASUREMENT
/begin MEASUREMENT ZFFSAB._.AmbConditionsIn.iv_DoorDSts "Input value signal status of door detection (index = 68)" UBYTE SAB_STANDARD_S2_S3 1 100 0 255 DISPLAY_IDENTIFIER iv_DoorDSts.AmbConditionsIn._.ZFFSAB ECU_ADDRESS 0xFFF97618 /end MEASUREMENT
/begin MEASUREMENT ZFFSAB._.AmbConditionsIn.iv_SeatFLSts "Input value signal status of seat detection (index = 68)" UBYTE SAB_STANDARD_S2_S3 1 100 0 255 DISPLAY_IDENTIFIER iv_SeatFLSts.AmbConditionsIn._.ZFFSAB ECU_ADDRESS 0xFFF97619 /end MEASUREMENT
/begin MEASUREMENT ZFFSAB._.AmbConditionsIn.iv_KeyValidSts "Input value signal status of key detection (index = 68)" UBYTE SAB_STANDARD_S2_S3 1 100 0 255 DISPLAY_IDENTIFIER iv_KeyValidSts.AmbConditionsIn._.ZFFSAB ECU_ADDRESS 0xFFF9761A /end MEASUREMENT
/begin MEASUREMENT ZFFSAB._.AmbConditionsIn.sv_st_FemCasCanSig "State for FEM/CAS (index = 68)" UBYTE SAB_STANDARD_S2_S3 1 100 0 255 DISPLAY_IDENTIFIER sv_st_FemCasCanSig.AmbConditionsIn._.ZFFSAB ECU_ADDRESS 0xFFF9761B /end MEASUREMENT
/begin MEASUREMENT ZFFSAB._.AmbConditionsIn.iv_n_WheelAvg_UWB74 "Average Wheel rpm of all driven wheels" ULONG SAB_N_RPM100_S2_S3 1 100 0 42949672.95 DISPLAY_IDENTIFIER iv_n_WheelAvg_UWB74.AmbConditionsIn._.ZFFSAB ECU_ADDRESS 0xFFF9761C /end MEASUREMENT
/begin MEASUREMENT ZFFSAB._.AmbConditionsIn.sv_n_WheelAvg_UWB74 "Intermediate value of wheel speed from driven wheels (index = 74)" UBYTE SAB_N_32RPM_S2_S3 1 100 0 8160 DISPLAY_IDENTIFIER sv_n_WheelAvg_UWB74.AmbConditionsIn._.ZFFSAB ECU_ADDRESS 0xFFF97620 /end MEASUREMENT
/begin MEASUREMENT ZFFSAB._.AmbConditionsIn.sv_u_Kl15_Pin "input voltage of terminal 15 (index = 75)" UBYTE SAB_U_100VOLT8_S2_S3 1 100 0 20.4 DISPLAY_IDENTIFIER sv_u_Kl15_Pin.AmbConditionsIn._.ZFFSAB ECU_ADDRESS 0xFFF97621 /end MEASUREMENT
/begin MEASUREMENT ZFFSAB._.AmbConditionsIn.sv_n_Wheel_FR "input speed of wheel (index = 76)" UBYTE SAB_N_1RADPS_M40_S2_S3 1 100 -40 215 DISPLAY_IDENTIFIER sv_n_Wheel_FR.AmbConditionsIn._.ZFFSAB ECU_ADDRESS 0xFFF97622 /end MEASUREMENT
/begin MEASUREMENT ZFFSAB._.AmbConditionsIn.sv_n_Wheel_FL "input speed of wheel (index = 77)" UBYTE SAB_N_1RADPS_M40_S2_S3 1 100 -40 215 DISPLAY_IDENTIFIER sv_n_Wheel_FL.AmbConditionsIn._.ZFFSAB ECU_ADDRESS 0xFFF97623 /end MEASUREMENT
/begin MEASUREMENT ZFFSAB._.AmbConditionsIn.sv_n_Wheel_RR "input speed of wheel (index = 78)" UBYTE SAB_N_1RADPS_M40_S2_S3 1 100 -40 215 DISPLAY_IDENTIFIER sv_n_Wheel_RR.AmbConditionsIn._.ZFFSAB ECU_ADDRESS 0xFFF97624 /end MEASUREMENT
/begin MEASUREMENT ZFFSAB._.AmbConditionsIn.sv_n_Wheel_RL "input speed of wheel (index = 79)" UBYTE SAB_N_1RADPS_M40_S2_S3 1 100 -40 215 DISPLAY_IDENTIFIER sv_n_Wheel_RL.AmbConditionsIn._.ZFFSAB ECU_ADDRESS 0xFFF97625 /end MEASUREMENT
/begin MEASUREMENT ZFFSAB._.AmbConditionsIn.iv_KL15Sts "Error state of output value 0=no error 1=substitute value 2=error" UBYTE SAB_STANDARD_S2_S3 1 100 0 2 DISPLAY_IDENTIFIER iv_KL15Sts.AmbConditionsIn._.ZFFSAB ECU_ADDRESS 0xFFF97627 /end MEASUREMENT
/begin MEASUREMENT ZFFSAB._.AmbConditionsIn.iv_st_IgnPlausiErr "state of the plausibility check result CAN signal against hardware signal KL15 (index = 81)" UBYTE SAB_STANDARD_S2_S3 1 100 0 2 DISPLAY_IDENTIFIER iv_st_IgnPlausiErr.AmbConditionsIn._.ZFFSAB ECU_ADDRESS 0xFFF97628 /end MEASUREMENT
/begin MEASUREMENT ZFFSAB._.AmbConditionsIn.sv_st_IgnitionSignal "compilation of ignition signals (index = 81)" UWORD SAB_STANDARD_S2_S3 1 100 0 65535 DISPLAY_IDENTIFIER sv_st_IgnitionSignal.AmbConditionsIn._.ZFFSAB ECU_ADDRESS 0xFFF9762A /end MEASUREMENT
/begin MEASUREMENT ZFFSAB._.AmbConditionsIn.sv_AblaufvarianteHas "Output value: nominal HAS sequence by HST (index = 82)" UBYTE SAB_STANDARD_S2_S3 1 100 0 255 DISPLAY_IDENTIFIER sv_AblaufvarianteHas.AmbConditionsIn._.ZFFSAB ECU_ADDRESS 0xFFF9762C /end MEASUREMENT
/begin MEASUREMENT ZFFSAB._.AmbConditionsIn.sv_st_HasActualNominalState "Output value: actual state and nominal state of hybrid state machine (index = 83)" UBYTE SAB_STANDARD_S2_S3 1 100 0 255 DISPLAY_IDENTIFIER sv_st_HasActualNominalState.AmbConditionsIn._.ZFFSAB ECU_ADDRESS 0xFFF9762D /end MEASUREMENT
/begin MEASUREMENT ZFFSAB._.AmbConditionsIn.sv_n_SollEmHas "Output value: nominal speed electrical engine (index = 84)" UBYTE SAB_N_32RPM_S2_S3 1 100 0 8160 DISPLAY_IDENTIFIER sv_n_SollEmHas.AmbConditionsIn._.ZFFSAB ECU_ADDRESS 0xFFF9762E /end MEASUREMENT
/begin MEASUREMENT ZFFSAB._.AmbConditionsIn.sv_m_IstEm "Output value: actual torque electrical engine (index = 85)" UBYTE SAB_M_4NM_M500_S2_S3 1 100 -500 520 DISPLAY_IDENTIFIER sv_m_IstEm.AmbConditionsIn._.ZFFSAB ECU_ADDRESS 0xFFF9762F /end MEASUREMENT
/begin MEASUREMENT ZFFSAB._.AmbConditionsIn.sv_m_MotMaxHas "Output value: maximum engine torque (index = 86)" UBYTE SAB_M_4NM_M100_S2_S3 1 100 -100 920 DISPLAY_IDENTIFIER sv_m_MotMaxHas.AmbConditionsIn._.ZFFSAB ECU_ADDRESS 0xFFF97630 /end MEASUREMENT
/begin MEASUREMENT ZFFSAB._.AmbConditionsIn.sv_m_IstK0 "Output value: actual torque K0 (index = 87)" UBYTE SAB_M_4NM_M100_S2_S3 1 100 -100 920 DISPLAY_IDENTIFIER sv_m_IstK0.AmbConditionsIn._.ZFFSAB ECU_ADDRESS 0xFFF97631 /end MEASUREMENT
/begin MEASUREMENT ZFFSAB._.AmbConditionsIn.sv_StatusK0 "Output value: state of K0 (index = 88)" UBYTE SAB_STANDARD_S2_S3 1 100 0 255 DISPLAY_IDENTIFIER sv_StatusK0.AmbConditionsIn._.ZFFSAB ECU_ADDRESS 0xFFF97632 /end MEASUREMENT
/begin MEASUREMENT ZFFSAB._.AmbConditionsIn.sv_KupStatusIae "Output value: physical state of integrated starting device (index = 89)" UBYTE SAB_STANDARD_S2_S3 1 100 0 255 DISPLAY_IDENTIFIER sv_KupStatusIae.AmbConditionsIn._.ZFFSAB ECU_ADDRESS 0xFFF97633 /end MEASUREMENT
/begin MEASUREMENT ZFFSAB._.AmbConditionsIn.sv_IepIst "Output value: state of auxiliary electrical pump (index = 90)" UBYTE SAB_STANDARD_S2_S3 1 100 0 255 DISPLAY_IDENTIFIER sv_IepIst.AmbConditionsIn._.ZFFSAB ECU_ADDRESS 0xFFF97634 /end MEASUREMENT
/begin MEASUREMENT ZFFSAB._.AmbConditionsIn.sv_PowerTransRotation "Output value: Information about Power Transformation and direction of rotation (index = 94)" UBYTE SAB_STANDARD_S2_S3 1 100 0 255 DISPLAY_IDENTIFIER sv_PowerTransRotation.AmbConditionsIn._.ZFFSAB ECU_ADDRESS 0xFFF97635 /end MEASUREMENT
/begin MEASUREMENT ZFFSAB._.AmbConditionsIn.sv_m_Crank "Output value of current torque of crankshaft corrected by the pump intake torque (index = 95)" UBYTE SAB_M_4NM_M100_S2_S3 1 100 -100 920 DISPLAY_IDENTIFIER sv_m_Crank.AmbConditionsIn._.ZFFSAB ECU_ADDRESS 0xFFF97636 /end MEASUREMENT
/begin MEASUREMENT ZFFSAB._.AmbConditionsIn.sv_m_EngMax "Output value for max torque (index = 123)" UBYTE SAB_M_8NM_M400_S2_S3 1 100 -400 1640 DISPLAY_IDENTIFIER sv_m_EngMax.AmbConditionsIn._.ZFFSAB ECU_ADDRESS 0xFFF97637 /end MEASUREMENT
/begin MEASUREMENT ZFFSAB._.AmbConditionsIn.ctl_IEP_Status "Bit coded error flags indicating an error in IEP or communicating to IEP: 0=no error :: errors bit31..bit24=ErrorByte1 bit23..bit16=ErrorByte0 bit8=BusOff bit7=NotReceived bit6..5=- bit4=AliveCnt bit3=Chksum (LIN or ZF-CRC within data) bit2=- bit1=LINB..." ULONG SAB_STANDARD_S2_S3 1 100 0 4294967295
 /begin ANNOTATION ANNOTATION_LABEL "Description"
  /begin ANNOTATION_TEXT "Bit coded error flags indicating an error in IEP or communicating to IEP: 0=no error :: errors bit31..bit24=ErrorByte1 bit23..bit16=ErrorByte0 bit8=BusOff bit7=NotReceived bit6..5=- bit4=AliveCnt bit3=Chksum (LIN or ZF-CRC within data) bit2=- bit1=LINBus " "bit0=timeout" /end ANNOTATION_TEXT
 /end ANNOTATION
 DISPLAY_IDENTIFIER ctl_IEP_Status.AmbConditionsIn._.ZFFSAB ECU_ADDRESS 0xFFF97638 /end MEASUREMENT
/begin MEASUREMENT ZFFSAB._.AmbConditionsIn.sv_IEP_Errorbytes "Bit coded error flags indicating an error in IEP: 0=no error :: errors bit31..bit24=ErrorByte1 bit23..bit16=ErrorByte0" UWORD SAB_STANDARD_S2_S3 1 100 0 65535 DISPLAY_IDENTIFIER sv_IEP_Errorbytes.AmbConditionsIn._.ZFFSAB ECU_ADDRESS 0xFFF9763C /end MEASUREMENT
/begin MEASUREMENT ZFFSAB._.AmbConditionsIn.sv_IEP_Status "Bit coded error flags indicating an error in communicating to IEP: bit8=BusOff bit7=NotReceived bit6..5=- bit4=AliveCnt bit3=Chksum (LIN or ZF-CRC within data) bit2=- bit1=LINBus bit0=timeout" UWORD SAB_STANDARD_S2_S3 1 100 0 65535 DISPLAY_IDENTIFIER sv_IEP_Status.AmbConditionsIn._.ZFFSAB ECU_ADDRESS 0xFFF9763E /end MEASUREMENT
/begin MEASUREMENT ZFFSAB._.AmbConditionsIn.iv_Actual_OpPoint_IEP "Input value readback from IEP: BP1=0x55 BP0=0xAA" UBYTE SAB_STANDARD_S2_S3 1 100 0 255 DISPLAY_IDENTIFIER iv_Actual_OpPoint_IEP.AmbConditionsIn._.ZFFSAB ECU_ADDRESS 0xFFF97640 /end MEASUREMENT
/begin MEASUREMENT ZFFSAB._.AmbConditionsIn.iv_Actual_n_IEP "Input value readback from IEP" UBYTE SAB_N_32RPM_S2_S3 1 100 0 8160 DISPLAY_IDENTIFIER iv_Actual_n_IEP.AmbConditionsIn._.ZFFSAB ECU_ADDRESS 0xFFF97641 /end MEASUREMENT
/begin MEASUREMENT ZFFSAB._.AmbConditionsIn.iv_Actual_i_IEP "Input value readback from IEP" UBYTE SAB_I_100MA_S2_S3 1 100 0 25500 DISPLAY_IDENTIFIER iv_Actual_i_IEP.AmbConditionsIn._.ZFFSAB ECU_ADDRESS 0xFFF97642 /end MEASUREMENT
/begin MEASUREMENT ZFFSAB._.AmbConditionsIn.iv_Actual_u_IEP "Input value readback from IEP" UBYTE SAB_U_VOLT10_S2_S3 1 100 0 25.5 DISPLAY_IDENTIFIER iv_Actual_u_IEP.AmbConditionsIn._.ZFFSAB ECU_ADDRESS 0xFFF97643 /end MEASUREMENT
/begin MEASUREMENT ZFFSAB._.AmbConditionsIn.iv_TargetOperationPoint "Get target operation point which will be transmitted to IEP BP1=0x55 BP0=0xAA" UBYTE SAB_STANDARD_S2_S3 1 100 0 255 DISPLAY_IDENTIFIER iv_TargetOperationPoint.AmbConditionsIn._.ZFFSAB ECU_ADDRESS 0xFFF97644 /end MEASUREMENT
/begin MEASUREMENT ZFFSAB._.AmbConditionsIn.iv_Actual_c_IEP "Input value readback from IEP" UBYTE SAB_C_CEL_M50_S2_S3 1 100 -50 205 DISPLAY_IDENTIFIER iv_Actual_c_IEP.AmbConditionsIn._.ZFFSAB ECU_ADDRESS 0xFFF97645 /end MEASUREMENT
/begin MEASUREMENT ZFFSAB._.AmbConditionsIn.iv_Actual_IDNr_IEP "Input value readback from IEP: bit31..25=JJ(Prod-Jahr) bit24=MM(Prod-Monat) bit23..21=MM(Prod-Monat) bit20..16=TT(Prod-Tag) bit15..14=AA(Anlagennummer) bit13..8=MSBs NN(Zaehler) bit7..0=LSBs NN(Zaehler)" ULONG SAB_STANDARD_S2_S3 1 100 0 4294967295 DISPLAY_IDENTIFIER iv_Actual_IDNr_IEP.AmbConditionsIn._.ZFFSAB ECU_ADDRESS 0xFFF97648 /end MEASUREMENT
/begin MEASUREMENT ZFFSAB._.AmbConditionsIn.iv_Actual_HWVersion_IEP "Input value readback from IEP" UBYTE SAB_STANDARD_S2_S3 1 100 0 255 DISPLAY_IDENTIFIER iv_Actual_HWVersion_IEP.AmbConditionsIn._.ZFFSAB ECU_ADDRESS 0xFFF9764C /end MEASUREMENT
/begin MEASUREMENT ZFFSAB._.AmbConditionsIn.iv_Actual_SWVersion_IEP "Input value readback from IEP" UWORD SAB_STANDARD_S2_S3 1 100 0 65535 DISPLAY_IDENTIFIER iv_Actual_SWVersion_IEP.AmbConditionsIn._.ZFFSAB ECU_ADDRESS 0xFFF9764E /end MEASUREMENT
/begin MEASUREMENT ZFFSAB._.AmbConditionsIn.sv_n_EngVM "Output value for engine rpm (index = 135)" UBYTE SAB_N_32RPM_S2_S3 1 100 0 8160 DISPLAY_IDENTIFIER sv_n_EngVM.AmbConditionsIn._.ZFFSAB ECU_ADDRESS 0xFFF97650 /end MEASUREMENT
/begin MEASUREMENT ZFFSAB._.AmbConditionsIn.sv_sts_PMA "Output value of the states of signals which are relevant for the ParkManeuverAssistant Bit 0 = Modussignal Bit 1 = Positionssignal Bit 2 = Bremssignal (index = 136)" UBYTE SAB_STANDARD_S2_S3 1 100 0 255 DISPLAY_IDENTIFIER sv_sts_PMA.AmbConditionsIn._.ZFFSAB ECU_ADDRESS 0xFFF97651 /end MEASUREMENT
/begin MEASUREMENT ZFFSAB._.AmbConditionsIn.FaultCodeToAmbientCondition "Error Code supplied by the Errorhandler Component" UWORD SAB_STANDARD_S2_S3 1 100 0 65535 DISPLAY_IDENTIFIER FaultCodeToAmbientCondition.AmbConditionsIn._.ZFFSAB ECU_ADDRESS 0xFFF97652 /end MEASUREMENT
/begin MEASUREMENT ZFFSAB._.LDMDesiredTorqueIn.iv_FASMode "Input value controlling state of LDM system from CAN" UBYTE SAB_STANDARD_S2_S3 1 100 0 15 DISPLAY_IDENTIFIER iv_FASMode.LDMDesiredTorqueIn._.ZFFSAB ECU_ADDRESS 0xFFF97824 /end MEASUREMENT
/begin MEASUREMENT ZFFSAB._.LDMDesiredTorqueIn.iv_FASModeSts "Input value message status of LDM CAN Message" UBYTE SAB_STANDARD_S2_S3 1 100 0 255 DISPLAY_IDENTIFIER iv_FASModeSts.LDMDesiredTorqueIn._.ZFFSAB ECU_ADDRESS 0xFFF97825 /end MEASUREMENT
/begin MEASUREMENT ZFFSAB._.LDMDesiredTorqueIn.iv_m_LDM "Input value desired torque-LDM from CAN" UWORD SAB_M_1NM_M32000_S2_S3 1 100 -32000 0 DISPLAY_IDENTIFIER iv_m_LDM.LDMDesiredTorqueIn._.ZFFSAB ECU_ADDRESS 0xFFF97826 /end MEASUREMENT
/begin MEASUREMENT ZFFSAB._.LDMDesiredTorqueIn.iv_m_LDMSts "Input value message status of LDM CAN Message" UBYTE SAB_STANDARD_S2_S3 1 100 0 255 DISPLAY_IDENTIFIER iv_m_LDMSts.LDMDesiredTorqueIn._.ZFFSAB ECU_ADDRESS 0xFFF97828 /end MEASUREMENT
/begin MEASUREMENT ZFFSAB._.LDMDesiredTorqueIn.sv_m_LDM "Output value of desired torque-LDM" SWORD SAB_M_1NM_S2_S3 1 100 -32000 32000 DISPLAY_IDENTIFIER sv_m_LDM.LDMDesiredTorqueIn._.ZFFSAB ECU_ADDRESS 0xFFF9782A /end MEASUREMENT
/begin MEASUREMENT ZFFSAB._.LDMDesiredTorqueIn.sv_m_LDMSts "Output value signal status of desired torque-LDM" UBYTE SAB_STANDARD_S2_S3 1 100 0 2 DISPLAY_IDENTIFIER sv_m_LDMSts.LDMDesiredTorqueIn._.ZFFSAB ECU_ADDRESS 0xFFF9782C /end MEASUREMENT
/begin MEASUREMENT ZFFSAB._.LDMDesiredTorqueIn.sv_LDMDynamic "Output value of dynamic request" UBYTE SAB_STANDARD_S2_S3 1 100 0 1 DISPLAY_IDENTIFIER sv_LDMDynamic.LDMDesiredTorqueIn._.ZFFSAB ECU_ADDRESS 0xFFF9782D /end MEASUREMENT
/begin MEASUREMENT ZFFSAB._.LDMDesiredTorqueIn.sv_LDMDynamicSts "Output value signal status of dynamic request" UBYTE SAB_STANDARD_S2_S3 1 100 0 2 DISPLAY_IDENTIFIER sv_LDMDynamicSts.LDMDesiredTorqueIn._.ZFFSAB ECU_ADDRESS 0xFFF9782E /end MEASUREMENT
/begin MEASUREMENT ZFFSAB._.LDMDesiredTorqueIn.sv_LDMDynamic2 "Output value of dynamic2 request" UBYTE SAB_STANDARD_S2_S3 1 100 0 255 DISPLAY_IDENTIFIER sv_LDMDynamic2.LDMDesiredTorqueIn._.ZFFSAB ECU_ADDRESS 0xFFF9782F /end MEASUREMENT
/begin MEASUREMENT ZFFSAB._.LDMDesiredTorqueIn.sv_LDMDynamic2Sts "Output value signal status of dynamic2 request" UBYTE SAB_STANDARD_S2_S3 1 100 0 2 DISPLAY_IDENTIFIER sv_LDMDynamic2Sts.LDMDesiredTorqueIn._.ZFFSAB ECU_ADDRESS 0xFFF97830 /end MEASUREMENT
/begin MEASUREMENT ZFFSAB._.LDMDesiredTorqueIn.sv_LDMMode "ACC/DCC Schaltprogram Zustand" UBYTE SAB_STANDARD_S2_S3 1 100 0 1 DISPLAY_IDENTIFIER sv_LDMMode.LDMDesiredTorqueIn._.ZFFSAB ECU_ADDRESS 0xFFF97831 /end MEASUREMENT
/begin MEASUREMENT ZFFSAB._.LDMDesiredTorqueIn.sv_LDMModeSts "Output value signal status of controlling state of LDM system" UBYTE SAB_STANDARD_S2_S3 1 100 0 2 DISPLAY_IDENTIFIER sv_LDMModeSts.LDMDesiredTorqueIn._.ZFFSAB ECU_ADDRESS 0xFFF97832 /end MEASUREMENT
/begin MEASUREMENT ZFFSAB._.LDMDesiredTorqueIn.sv_LDMMode2 "ACC/DCC Schaltprogram Zustand" UBYTE SAB_STANDARD_S2_S3 1 100 0 4 DISPLAY_IDENTIFIER sv_LDMMode2.LDMDesiredTorqueIn._.ZFFSAB ECU_ADDRESS 0xFFF97833 /end MEASUREMENT
/begin MEASUREMENT ZFFSAB._.LDMDesiredTorqueIn.sv_LDMMode2Sts "Output value signal status of controlling state of LDM system" UBYTE SAB_STANDARD_S2_S3 1 100 0 2 DISPLAY_IDENTIFIER sv_LDMMode2Sts.LDMDesiredTorqueIn._.ZFFSAB ECU_ADDRESS 0xFFF97834 /end MEASUREMENT
/begin MEASUREMENT ZFFSAB._.LDMDesiredTorqueIn.f_m_LDMErr "Error flag of desired torque-LDM" UBYTE SAB_STANDARD_S2_S3 1 100 0 1 DISPLAY_IDENTIFIER f_m_LDMErr.LDMDesiredTorqueIn._.ZFFSAB ECU_ADDRESS 0xFFF97835 /end MEASUREMENT
/begin MEASUREMENT ZFFSAB._.LDMDesiredTorqueIn.f_LDMModeErr "Error flag of ACC/DCC program mode" UBYTE SAB_STANDARD_S2_S3 1 100 0 1 DISPLAY_IDENTIFIER f_LDMModeErr.LDMDesiredTorqueIn._.ZFFSAB ECU_ADDRESS 0xFFF97836 /end MEASUREMENT
/begin MEASUREMENT ZFFSAB._.DistanceIn.iv_Mileage "Input value mileage" ULONG SAB_L_1KM_S2_S3 1 100 0 16777215 DISPLAY_IDENTIFIER iv_Mileage.DistanceIn._.ZFFSAB ECU_ADDRESS 0xFFF97854 /end MEASUREMENT
/begin MEASUREMENT ZFFSAB._.DistanceIn.iv_MileageSts "Input value message status of mileage" UBYTE SAB_STANDARD_S2_S3 1 100 0 255 DISPLAY_IDENTIFIER iv_MileageSts.DistanceIn._.ZFFSAB ECU_ADDRESS 0xFFF97858 /end MEASUREMENT
/begin MEASUREMENT ZFFSAB._.DistanceIn.sv_f_MileageErr "Output error value of mileage" UBYTE SAB_STANDARD_S2_S3 1 100 0 255 DISPLAY_IDENTIFIER sv_f_MileageErr.DistanceIn._.ZFFSAB ECU_ADDRESS 0xFFF97859 /end MEASUREMENT
/begin MEASUREMENT ZFFSAB._.DistanceIn.sv_Mileage "Output value of mileage" UWORD SAB_L_10KM_S2_S3 1 100 0 655350 DISPLAY_IDENTIFIER sv_Mileage.DistanceIn._.ZFFSAB ECU_ADDRESS 0xFFF9785A /end MEASUREMENT
/begin MEASUREMENT ZFFSAB._.DistanceIn.sv_Mileage_1km "Output value of mileage 1km" ULONG SAB_L_1KM_S2_S3 1 100 0 4294967295 DISPLAY_IDENTIFIER sv_Mileage_1km.DistanceIn._.ZFFSAB ECU_ADDRESS 0xFFF9785C /end MEASUREMENT
/begin MEASUREMENT ZFFSAB._.DistanceIn.sv_MileageFromNab "Output value of MileageFromNab" ULONG SAB_L_1KM_S2_S3 1 100 0 4294967295 DISPLAY_IDENTIFIER sv_MileageFromNab.DistanceIn._.ZFFSAB ECU_ADDRESS 0xFFF97860 /end MEASUREMENT
/begin MEASUREMENT ZFFSAB._.DistanceIn.sv_MileageSts "REPRESENT_INTERMEDIATE value signal status of mileage" UBYTE SAB_STANDARD_S2_S3 1 100 0 2 DISPLAY_IDENTIFIER sv_MileageSts.DistanceIn._.ZFFSAB ECU_ADDRESS 0xFFF97864 /end MEASUREMENT
/begin MEASUREMENT ZFFSAB._.SABEeprom.EepromData.actual_IEP_CVN[0] "Last valid stored IEP CVN" UBYTE SAB_STANDARD_S2_S3 1 100 0 255 DISPLAY_IDENTIFIER actual_IEP_CVN[0].EepromData.SABEeprom._.ZFFSAB ECU_ADDRESS 0xFFF823EC /end MEASUREMENT
/begin MEASUREMENT ZFFSAB._.SABEeprom.EepromData.actual_IEP_CVN[1] "Last valid stored IEP CVN" UBYTE SAB_STANDARD_S2_S3 1 100 0 255 DISPLAY_IDENTIFIER actual_IEP_CVN[1].EepromData.SABEeprom._.ZFFSAB ECU_ADDRESS 0xFFF823ED /end MEASUREMENT
/begin MEASUREMENT ZFFSAB._.SABEeprom.EepromData.actual_IEP_CVN[2] "Last valid stored IEP CVN" UBYTE SAB_STANDARD_S2_S3 1 100 0 255 DISPLAY_IDENTIFIER actual_IEP_CVN[2].EepromData.SABEeprom._.ZFFSAB ECU_ADDRESS 0xFFF823EE /end MEASUREMENT
/begin MEASUREMENT ZFFSAB._.SABEeprom.EepromData.actual_IEP_CVN[3] "Last valid stored IEP CVN" UBYTE SAB_STANDARD_S2_S3 1 100 0 255 DISPLAY_IDENTIFIER actual_IEP_CVN[3].EepromData.SABEeprom._.ZFFSAB ECU_ADDRESS 0xFFF823EF /end MEASUREMENT
/begin MEASUREMENT ZFFSAB._.SABEeprom.EepromData.actual_IEP_CALID[0] "Last valid stored IEP CVN" UBYTE SAB_STANDARD_S2_S3 1 100 0 255 DISPLAY_IDENTIFIER actual_IEP_CALID[0].EepromData.SABEeprom._.ZFFSAB ECU_ADDRESS 0xFFF823F2 /end MEASUREMENT
/begin MEASUREMENT ZFFSAB._.SABEeprom.EepromData.actual_IEP_CALID[1] "Last valid stored IEP CVN" UBYTE SAB_STANDARD_S2_S3 1 100 0 255 DISPLAY_IDENTIFIER actual_IEP_CALID[1].EepromData.SABEeprom._.ZFFSAB ECU_ADDRESS 0xFFF823F3 /end MEASUREMENT
/begin MEASUREMENT ZFFSAB._.SABEeprom.EepromData.actual_IEP_CALID[2] "Last valid stored IEP CVN" UBYTE SAB_STANDARD_S2_S3 1 100 0 255 DISPLAY_IDENTIFIER actual_IEP_CALID[2].EepromData.SABEeprom._.ZFFSAB ECU_ADDRESS 0xFFF823F4 /end MEASUREMENT
/begin MEASUREMENT ZFFSAB._.SABEeprom.EepromData.actual_IEP_CALID[3] "Last valid stored IEP CVN" UBYTE SAB_STANDARD_S2_S3 1 100 0 255 DISPLAY_IDENTIFIER actual_IEP_CALID[3].EepromData.SABEeprom._.ZFFSAB ECU_ADDRESS 0xFFF823F5 /end MEASUREMENT
/begin MEASUREMENT ZFFSAB._.SABEeprom.EepromData.actual_IEP_CALID[4] "Last valid stored IEP CVN" UBYTE SAB_STANDARD_S2_S3 1 100 0 255 DISPLAY_IDENTIFIER actual_IEP_CALID[4].EepromData.SABEeprom._.ZFFSAB ECU_ADDRESS 0xFFF823F6 /end MEASUREMENT
/begin MEASUREMENT ZFFSAB._.SABEeprom.EepromData.actual_IEP_CALID[5] "Last valid stored IEP CVN" UBYTE SAB_STANDARD_S2_S3 1 100 0 255 DISPLAY_IDENTIFIER actual_IEP_CALID[5].EepromData.SABEeprom._.ZFFSAB ECU_ADDRESS 0xFFF823F7 /end MEASUREMENT
/begin MEASUREMENT ZFFSAB._.SABEeprom.EepromData.actual_IEP_CALID[6] "Last valid stored IEP CVN" UBYTE SAB_STANDARD_S2_S3 1 100 0 255 DISPLAY_IDENTIFIER actual_IEP_CALID[6].EepromData.SABEeprom._.ZFFSAB ECU_ADDRESS 0xFFF823F8 /end MEASUREMENT
/begin MEASUREMENT ZFFSAB._.SABEeprom.EepromData.actual_IEP_CALID[7] "Last valid stored IEP CVN" UBYTE SAB_STANDARD_S2_S3 1 100 0 255 DISPLAY_IDENTIFIER actual_IEP_CALID[7].EepromData.SABEeprom._.ZFFSAB ECU_ADDRESS 0xFFF823F9 /end MEASUREMENT
/begin MEASUREMENT ZFFSAB._.SABEeprom.EepromData.actual_IEP_CALID[8] "Last valid stored IEP CVN" UBYTE SAB_STANDARD_S2_S3 1 100 0 255 DISPLAY_IDENTIFIER actual_IEP_CALID[8].EepromData.SABEeprom._.ZFFSAB ECU_ADDRESS 0xFFF823FA /end MEASUREMENT
/begin MEASUREMENT ZFFSAB._.SABEeprom.EepromData.actual_IEP_CALID[9] "Last valid stored IEP CVN" UBYTE SAB_STANDARD_S2_S3 1 100 0 255 DISPLAY_IDENTIFIER actual_IEP_CALID[9].EepromData.SABEeprom._.ZFFSAB ECU_ADDRESS 0xFFF823FB /end MEASUREMENT
/begin MEASUREMENT ZFFSAB._.SABEeprom.EepromData.actual_IEP_CALID[10] "Last valid stored IEP CVN" UBYTE SAB_STANDARD_S2_S3 1 100 0 255 DISPLAY_IDENTIFIER actual_IEP_CALID[10].EepromData.SABEeprom._.ZFFSAB ECU_ADDRESS 0xFFF823FC /end MEASUREMENT
/begin MEASUREMENT ZFFSAB._.SABEeprom.EepromData.actual_IEP_CALID[11] "Last valid stored IEP CVN" UBYTE SAB_STANDARD_S2_S3 1 100 0 255 DISPLAY_IDENTIFIER actual_IEP_CALID[11].EepromData.SABEeprom._.ZFFSAB ECU_ADDRESS 0xFFF823FD /end MEASUREMENT
/begin MEASUREMENT ZFFSAB._.SABEeprom.EepromData.actual_IEP_CALID[12] "Last valid stored IEP CVN" UBYTE SAB_STANDARD_S2_S3 1 100 0 255 DISPLAY_IDENTIFIER actual_IEP_CALID[12].EepromData.SABEeprom._.ZFFSAB ECU_ADDRESS 0xFFF823FE /end MEASUREMENT
/begin MEASUREMENT ZFFSAB._.SABEeprom.EepromData.actual_IEP_CALID[13] "Last valid stored IEP CVN" UBYTE SAB_STANDARD_S2_S3 1 100 0 255 DISPLAY_IDENTIFIER actual_IEP_CALID[13].EepromData.SABEeprom._.ZFFSAB ECU_ADDRESS 0xFFF823FF /end MEASUREMENT
/begin MEASUREMENT ZFFSAB._.SABEeprom.EepromData.actual_IEP_CALID[14] "Last valid stored IEP CVN" UBYTE SAB_STANDARD_S2_S3 1 100 0 255 DISPLAY_IDENTIFIER actual_IEP_CALID[14].EepromData.SABEeprom._.ZFFSAB ECU_ADDRESS 0xFFF82400 /end MEASUREMENT
/begin MEASUREMENT ZFFSAB._.SABEeprom.EepromData.actual_IEP_CALID[15] "Last valid stored IEP CVN" UBYTE SAB_STANDARD_S2_S3 1 100 0 255 DISPLAY_IDENTIFIER actual_IEP_CALID[15].EepromData.SABEeprom._.ZFFSAB ECU_ADDRESS 0xFFF82401 /end MEASUREMENT
/begin MEASUREMENT ZFFSAB._.SABEeprom.EepromData.actSlaveSparePartNumber[0] "Actual IEP SparePartNumber" UBYTE SAB_STANDARD_S2_S3 1 100 0 255 DISPLAY_IDENTIFIER actSlaveSparePartNumber[0].EepromData.SABEeprom._.ZFFSAB ECU_ADDRESS 0xFFF824DC /end MEASUREMENT
/begin MEASUREMENT ZFFSAB._.SABEeprom.EepromData.actSlaveSparePartNumber[1] "Actual IEP SparePartNumber" UBYTE SAB_STANDARD_S2_S3 1 100 0 255 DISPLAY_IDENTIFIER actSlaveSparePartNumber[1].EepromData.SABEeprom._.ZFFSAB ECU_ADDRESS 0xFFF824DD /end MEASUREMENT
/begin MEASUREMENT ZFFSAB._.SABEeprom.EepromData.actSlaveSparePartNumber[2] "Actual IEP SparePartNumber" UBYTE SAB_STANDARD_S2_S3 1 100 0 255 DISPLAY_IDENTIFIER actSlaveSparePartNumber[2].EepromData.SABEeprom._.ZFFSAB ECU_ADDRESS 0xFFF824DE /end MEASUREMENT
/begin MEASUREMENT ZFFSAB._.SABEeprom.EepromData.actSlaveSparePartNumber[3] "Actual IEP SparePartNumber" UBYTE SAB_STANDARD_S2_S3 1 100 0 255 DISPLAY_IDENTIFIER actSlaveSparePartNumber[3].EepromData.SABEeprom._.ZFFSAB ECU_ADDRESS 0xFFF824DF /end MEASUREMENT
/begin MEASUREMENT ZFFSAB._.SABEeprom.EepromData.actSlaveSparePartNumber[4] "Actual IEP SparePartNumber" UBYTE SAB_STANDARD_S2_S3 1 100 0 255 DISPLAY_IDENTIFIER actSlaveSparePartNumber[4].EepromData.SABEeprom._.ZFFSAB ECU_ADDRESS 0xFFF824E0 /end MEASUREMENT
/begin MEASUREMENT ZFFSAB._.SABEeprom.EepromData.actSlaveSparePartNumber[5] "Actual IEP SparePartNumber" UBYTE SAB_STANDARD_S2_S3 1 100 0 255 DISPLAY_IDENTIFIER actSlaveSparePartNumber[5].EepromData.SABEeprom._.ZFFSAB ECU_ADDRESS 0xFFF824E1 /end MEASUREMENT
/begin MEASUREMENT ZFFSAB._.SABEeprom.EepromData.actSlaveSparePartNumber[6] "Actual IEP SparePartNumber" UBYTE SAB_STANDARD_S2_S3 1 100 0 255 DISPLAY_IDENTIFIER actSlaveSparePartNumber[6].EepromData.SABEeprom._.ZFFSAB ECU_ADDRESS 0xFFF824E2 /end MEASUREMENT
/begin MEASUREMENT ZFFSAB._.SABEeprom.EepromData.actSlaveSparePartNumber[7] "Actual IEP SparePartNumber" UBYTE SAB_STANDARD_S2_S3 1 100 0 255 DISPLAY_IDENTIFIER actSlaveSparePartNumber[7].EepromData.SABEeprom._.ZFFSAB ECU_ADDRESS 0xFFF824E3 /end MEASUREMENT
/begin MEASUREMENT ZFFSAB._.SABEeprom.EepromData.actSlaveSparePartNumber[8] "Actual IEP SparePartNumber" UBYTE SAB_STANDARD_S2_S3 1 100 0 255 DISPLAY_IDENTIFIER actSlaveSparePartNumber[8].EepromData.SABEeprom._.ZFFSAB ECU_ADDRESS 0xFFF824E4 /end MEASUREMENT
/begin MEASUREMENT ZFFSAB._.SABEeprom.EepromData.actSlaveSparePartNumber[9] "Actual IEP SparePartNumber" UBYTE SAB_STANDARD_S2_S3 1 100 0 255 DISPLAY_IDENTIFIER actSlaveSparePartNumber[9].EepromData.SABEeprom._.ZFFSAB ECU_ADDRESS 0xFFF824E5 /end MEASUREMENT
/begin MEASUREMENT ZFFSAB._.SABEeprom.EepromData.actSlaveSparePartNumber[10] "Actual IEP SparePartNumber" UBYTE SAB_STANDARD_S2_S3 1 100 0 255 DISPLAY_IDENTIFIER actSlaveSparePartNumber[10].EepromData.SABEeprom._.ZFFSAB ECU_ADDRESS 0xFFF824E6 /end MEASUREMENT
/begin MEASUREMENT ZFFSAB._.SABEeprom.EepromData.actSlaveAppSWVersionNum[0] "Current SlaveApplikationSoftwareVersionNumber" UBYTE SAB_STANDARD_S2_S3 1 100 0 255 DISPLAY_IDENTIFIER actSlaveAppSWVersionNum[0].EepromData.SABEeprom._.ZFFSAB ECU_ADDRESS 0xFFF824EA /end MEASUREMENT
/begin MEASUREMENT ZFFSAB._.SABEeprom.EepromData.actSlaveAppSWVersionNum[1] "Current SlaveApplikationSoftwareVersionNumber" UBYTE SAB_STANDARD_S2_S3 1 100 0 255 DISPLAY_IDENTIFIER actSlaveAppSWVersionNum[1].EepromData.SABEeprom._.ZFFSAB ECU_ADDRESS 0xFFF824EB /end MEASUREMENT
/begin MEASUREMENT ZFFSAB._.SABEeprom.EepromData.actSlaveAppSWVersionNum[2] "Current SlaveApplikationSoftwareVersionNumber" UBYTE SAB_STANDARD_S2_S3 1 100 0 255 DISPLAY_IDENTIFIER actSlaveAppSWVersionNum[2].EepromData.SABEeprom._.ZFFSAB ECU_ADDRESS 0xFFF824EC /end MEASUREMENT
/begin MEASUREMENT ZFFSAB._.SABEeprom.EepromData.actSlaveAppSWVersionNum[3] "Current SlaveApplikationSoftwareVersionNumber" UBYTE SAB_STANDARD_S2_S3 1 100 0 255 DISPLAY_IDENTIFIER actSlaveAppSWVersionNum[3].EepromData.SABEeprom._.ZFFSAB ECU_ADDRESS 0xFFF824ED /end MEASUREMENT
/begin COMPU_METHOD _CNV_S_3_Enum_EDNWK_343_CM_S2 "" TAB_VERB "%6.3" "" COMPU_TAB_REF _CNV_S_3_Enum_EDNWK_343_S2 /end COMPU_METHOD
/begin COMPU_METHOD _CNV_S_2_Enum_EALLR_347_CM_S2 "" TAB_VERB "%6.3" "" COMPU_TAB_REF _CNV_S_2_Enum_EALLR_347_S2 /end COMPU_METHOD
/begin COMPU_METHOD _CNV_S_3_Enum_EWDKK_353_CM_S2 "" TAB_VERB "%6.3" "" COMPU_TAB_REF _CNV_S_3_Enum_EWDKK_353_S2 /end COMPU_METHOD
/begin COMPU_METHOD SAB_STANDARD_S2_S3 "int = ((phys * 1) / 1) - (0) -" RAT_FUNC "%2.0" "-" COEFFS 0 1 -0 0 0 1 /end COMPU_METHOD
/begin COMPU_METHOD SAB_OM_YAWRATE_GRADPS20_S2_S3 "int = ((phys * 20) / 1) - (0) Grad/s" RAT_FUNC "%5.3" "Grad/s" COEFFS 0 20 -0 0 0 1 /end COMPU_METHOD
/begin COMPU_METHOD SAB_OM_YAWRATE_GRADPS200_M32768_S2_S3 "int = ((phys * 200) / 1) - (-32768) Grad/s" RAT_FUNC "%5.3" "Grad/s" COEFFS 0 200 32768 0 0 1 /end COMPU_METHOD
/begin COMPU_METHOD SAB_A_2MPSS1000_M32500_S2_S3 "int = ((phys * 1000) / 2) - (-32500) m/s^2" RAT_FUNC "%5.3" "m/s^2" COEFFS 0 1000 65000 0 0 2 /end COMPU_METHOD
/begin COMPU_METHOD SAB_A_MPSS32_S2_S3 "int = ((phys * 32) / 1) - (0) m/s^2" RAT_FUNC "%5.3" "m/s^2" COEFFS 0 32 -0 0 0 1 /end COMPU_METHOD
/begin COMPU_METHOD SAB_T_TIMER_1MS_S2_S3 "int = ((phys * 1) / 1) - (0) ms" RAT_FUNC "%2.0" "ms" COEFFS 0 1 -0 0 0 1 /end COMPU_METHOD
/begin COMPU_METHOD SAB_N_RADPS64_M32767_S2_S3 "int = ((phys * 64) / 1) - (-32767) rad/s" RAT_FUNC "%5.3" "rad/s" COEFFS 0 64 32767 0 0 1 /end COMPU_METHOD
/begin COMPU_METHOD SAB_N_1RADPS_M40_S2_S3 "int = ((phys * 1) / 1) - (-40) rad/s" RAT_FUNC "%2.0" "rad/s" COEFFS 0 1 40 0 0 1 /end COMPU_METHOD
/begin COMPU_METHOD SAB_T_TIMER_30MS_S2_S3 "int = ((phys * 1) / 30) - (0) ms" RAT_FUNC "%5.3" "ms" COEFFS 0 1 -0 0 0 30 /end COMPU_METHOD
/begin COMPU_METHOD SAB_T_TIMER_1S_S2_S3 "int = ((phys * 1) / 1) - (0) s" RAT_FUNC "%2.0" "s" COEFFS 0 1 -0 0 0 1 /end COMPU_METHOD
/begin COMPU_METHOD SAB_N_1RPM_S2_S3 "int = ((phys * 1) / 1) - (0) 1/min" RAT_FUNC "%2.0" "1/min" COEFFS 0 1 -0 0 0 1 /end COMPU_METHOD
/begin COMPU_METHOD SAB_N_32RPM_S2_S3 "int = ((phys * 1) / 32) - (0) 1/min" RAT_FUNC "%5.3" "1/min" COEFFS 0 1 -0 0 0 32 /end COMPU_METHOD
/begin COMPU_METHOD SAB_C_CMO_1CEL_M48_S2_S3 "int = ((phys * 1) / 1) - (-48) Grad Celsius" RAT_FUNC "%2.0" "Grad Celsius" COEFFS 0 1 48 0 0 1 /end COMPU_METHOD
/begin COMPU_METHOD SAB_C_CEL_M50_S2_S3 "int = ((phys * 1) / 1) - (-50) C" RAT_FUNC "%2.0" "C" COEFFS 0 1 50 0 0 1 /end COMPU_METHOD
/begin COMPU_METHOD SAB_C_CEL_S2_S3 "int = ((phys * 1) / 1) - (0) Grad Celsius" RAT_FUNC "%2.0" "Grad Celsius" COEFFS 0 1 -0 0 0 1 /end COMPU_METHOD
/begin COMPU_METHOD SAB_C_1CEL_M40_S2_S3 "int = ((phys * 1) / 1) - (-40) Grad Celsius" RAT_FUNC "%2.0" "Grad Celsius" COEFFS 0 1 40 0 0 1 /end COMPU_METHOD
/begin COMPU_METHOD SAB_C_CEL_M40_S2_S3 "int = ((phys * 1) / 1) - (-40) Grad Celsius" RAT_FUNC "%2.0" "Grad Celsius" COEFFS 0 1 40 0 0 1 /end COMPU_METHOD
/begin COMPU_METHOD SAB_C_CGT_1CEL_M40_S2_S3 "int = ((phys * 1) / 1) - (-40) Grad Celsius" RAT_FUNC "%2.0" "Grad Celsius" COEFFS 0 1 40 0 0 1 /end COMPU_METHOD
/begin COMPU_METHOD SAB_M_NM_S2_S3 "int = ((phys * 1) / 1) - (0) Nm" RAT_FUNC "%2.0" "Nm" COEFFS 0 1 -0 0 0 1 /end COMPU_METHOD
/begin COMPU_METHOD SAB_M_1NM_S2_S3 "int = ((phys * 1) / 1) - (0) Nm" RAT_FUNC "%2.0" "Nm" COEFFS 0 1 -0 0 0 1 /end COMPU_METHOD
/begin COMPU_METHOD SAB_L_1KM_S2_S3 "int = ((phys * 1) / 1) - (0) km" RAT_FUNC "%2.0" "km" COEFFS 0 1 -0 0 0 1 /end COMPU_METHOD
/begin COMPU_METHOD SAB_L_10KM_S2_S3 "int = ((phys * 1) / 10) - (0) km" RAT_FUNC "%5.3" "km" COEFFS 0 1 -0 0 0 10 /end COMPU_METHOD
/begin COMPU_METHOD SAB_M_8NM_M400_S2_S3 "int = ((phys * 1) / 8) - (-50) Nm" RAT_FUNC "%5.3" "Nm" COEFFS 0 1 400 0 0 8 /end COMPU_METHOD
/begin COMPU_METHOD SAB_M_4NM_M100_S2_S3 "int = ((phys * 1) / 4) - (-25) Nm" RAT_FUNC "%5.3" "Nm" COEFFS 0 1 100 0 0 4 /end COMPU_METHOD
/begin COMPU_METHOD SAB_M_4NM_M500_S2_S3 "int = ((phys * 1) / 4) - (-125) Nm" RAT_FUNC "%5.3" "Nm" COEFFS 0 1 500 0 0 4 /end COMPU_METHOD
/begin COMPU_METHOD SAB_K1000_S2_S3 "int = ((phys * 1000) / 1) - (0) -" RAT_FUNC "%5.3" "-" COEFFS 0 1000 -0 0 0 1 /end COMPU_METHOD
/begin COMPU_METHOD SAB_M_1NM_M32000_S2_S3 "int = ((phys * 1) / 1) - (-32000) Nm" RAT_FUNC "%2.0" "Nm" COEFFS 0 1 32000 0 0 1 /end COMPU_METHOD
/begin COMPU_METHOD SAB_N_RPM100_S2_S3 "int = ((phys * 100) / 1) - (0) 1/min" RAT_FUNC "%5.3" "1/min" COEFFS 0 100 -0 0 0 1 /end COMPU_METHOD
/begin COMPU_METHOD SAB_I_A5_S2_S3 "int = ((phys * 5) / 1) - (0) A" RAT_FUNC "%5.3" "A" COEFFS 0 5 -0 0 0 1 /end COMPU_METHOD
/begin COMPU_METHOD SAB_T_1MIN_S2_S3 "int = ((phys * 1) / 1) - (0) min" RAT_FUNC "%2.0" "min" COEFFS 0 1 -0 0 0 1 /end COMPU_METHOD
/begin COMPU_METHOD SAB_U_1VOLT1000_S2_S3 "int = ((phys * 1000) / 1) - (0) Volt" RAT_FUNC "%5.3" "Volt" COEFFS 0 1000 -0 0 0 1 /end COMPU_METHOD
/begin COMPU_METHOD SAB_U_100VOLT8_S2_S3 "int = ((phys * 100) / 8) - (0) Volt" RAT_FUNC "%5.3" "Volt" COEFFS 0 100 -0 0 0 8 /end COMPU_METHOD
/begin COMPU_METHOD SAB_U_73VOLT10000_S2_S3 "int = ((phys * 10000) / 73) - (0) V" RAT_FUNC "%7.5" "V" COEFFS 0 10000 -0 0 0 73 /end COMPU_METHOD
/begin COMPU_METHOD SAB_U_VOLT10_S2_S3 "int = ((phys * 10) / 1) - (0) Volt" RAT_FUNC "%5.3" "Volt" COEFFS 0 10 -0 0 0 1 /end COMPU_METHOD
/begin COMPU_METHOD SAB_M_NM2_M2047_S2_S3 "int = ((phys * 2) / 1) - (-2047) Nm" RAT_FUNC "%5.3" "Nm" COEFFS 0 2 2047 0 0 1 /end COMPU_METHOD
/begin COMPU_METHOD SAB_0025PROZENT_S2_S3 "int = ((phys * 1000) / 25) - (0) %" RAT_FUNC "%5.3" "%" COEFFS 0 1000 -0 0 0 25 /end COMPU_METHOD
/begin COMPU_METHOD SAB_100PROZENT254_S2_S3 "int = ((phys * 254) / 100) - (0) %" RAT_FUNC "%5.3" "%" COEFFS 0 254 -0 0 0 100 /end COMPU_METHOD
/begin COMPU_METHOD SAB_I_MA10_S2_S3 "int = ((phys * 10) / 1) - (0) mA" RAT_FUNC "%5.3" "mA" COEFFS 0 10 -0 0 0 1 /end COMPU_METHOD
/begin COMPU_METHOD SAB_I_100MA_S2_S3 "int = ((phys * 1) / 100) - (0) mA" RAT_FUNC "%5.3" "mA" COEFFS 0 1 -0 0 0 100 /end COMPU_METHOD
/begin COMPU_VTAB _CNV_S_3_Enum_EDNWK_343_S2 "" TAB_VERB 3 0 "KEIN_HOTMODE_KEINE_SCHALTUNG" 1 "HOTMODE" 2 "KEIN_HOTMODE_SCHALTUNG" /end COMPU_VTAB
/begin COMPU_VTAB _CNV_S_2_Enum_EALLR_347_S2 "" TAB_VERB 2 0 "KEIN ALLRAD" 1 "ALLRAD" /end COMPU_VTAB
/begin COMPU_VTAB _CNV_S_3_Enum_EWDKK_353_S2 "" TAB_VERB 3 0 "OBEN" 1 "UNTENAUS" 2 "UNTENEIN" /end COMPU_VTAB
/begin FUNCTION zf_SAB_GearRatioByCurrents "desc_en"
 /begin LOC_MEASUREMENT ZFFSAB._.GearRatioByCurrents.IstGang ZFFSAB._.GearRatioByCurrents.IstGangOld ZFFSAB._.GearRatioByCurrents.err_flags_old ZFFSAB._.GearRatioByCurrents.err_flags_old_ ZFFSAB._.GearRatioByCurrents.f_RearAxleRatioLearned ZFFSAB._.GearRatioByCurrents.f_RearAxleRatioLearned_ ZFFSAB._.GearRatioByCurrents.f_n6PlausiErr ZFFSAB._.GearRatioByCurrents.f_n6PlausiErr_ ZFFSAB._.GearRatioByCurrents.f_n6WheelErr ZFFSAB._.GearRatioByCurrents.f_n6WheelErr_ ZFFSAB._.GearRatioByCurrents.f_n6nEngErr ZFFSAB._.GearRatioByCurrents.f_n_AbPlausiErr ZFFSAB._.GearRatioByCurrents.f_n_AbPlausiErr_ ZFFSAB._.GearRatioByCurrents.f_n_AbWheelErr ZFFSAB._.GearRatioByCurrents.f_n_AbWheelErr_ ZFFSAB._.GearRatioByCurrents.f_n_Abn6Err ZFFSAB._.GearRatioByCurrents.f_n_Abn6Err_ ZFFSAB._.GearRatioByCurrents.f_n_PlausiErr ZFFSAB._.GearRatioByCurrents.f_n_PlausiErr_ ZFFSAB._.GearRatioByCurrents.f_n_TuVirtPlausiErr ZFFSAB._.GearRatioByCurrents.f_n_TuVirtPlausiErr_ ZFFSAB._.GearRatioByCurrents.f_n_WheelPlausiErr ZFFSAB._.GearRatioByCurrents.f_n_WheelPlausiErr_ ZFFSAB._.GearRatioByCurrents.f_xErrChanged ZFFSAB._.GearRatioByCurrents.iGang ZFFSAB._.GearRatioByCurrents.iGang_ ZFFSAB._.GearRatioByCurrents.iv_IstGang ZFFSAB._.GearRatioByCurrents.iv_IstGang_ ZFFSAB._.GearRatioByCurrents.iv_iGang ZFFSAB._.GearRatioByCurrents.iv_iGang_ ZFFSAB._.GearRatioByCurrents.iv_n6 ZFFSAB._.GearRatioByCurrents.iv_n6_ ZFFSAB._.GearRatioByCurrents.iv_n6_ESts ZFFSAB._.GearRatioByCurrents.iv_n6_ESts_ ZFFSAB._.GearRatioByCurrents.iv_n_Ab ZFFSAB._.GearRatioByCurrents.iv_n_AbESts ZFFSAB._.GearRatioByCurrents.iv_n_AbESts_ ZFFSAB._.GearRatioByCurrents.iv_n_Ab_ ZFFSAB._.GearRatioByCurrents.iv_n_Tu ZFFSAB._.GearRatioByCurrents.iv_n_Tu_ ZFFSAB._.GearRatioByCurrents.iv_sts_ClutchIAE ZFFSAB._.GearRatioByCurrents.iv_sts_n6_DirectionDiag ZFFSAB._.GearRatioByCurrents.iv_sts_n6_DirectionDiag_ ZFFSAB._.GearRatioByCurrents.n_AbByWheelAvg ZFFSAB._.GearRatioByCurrents.n_AbByWheelAvg_ ZFFSAB._.GearRatioByCurrents.n_TuVirtLev2 ZFFSAB._.GearRatioByCurrents.n_TuVirtLev2Sts ZFFSAB._.GearRatioByCurrents.n_TuVirtLev2Sts_ ZFFSAB._.GearRatioByCurrents.n_TuVirtLev2_ ZFFSAB._.GearRatioByCurrents.n_WheelAvgSts ZFFSAB._.GearRatioByCurrents.n_WheelAvgSts_ ZFFSAB._.GearRatioByCurrents.sts_n6_Dir ZFFSAB._.GearRatioByCurrents.sv_f_IAE_ReqSubst ZFFSAB._.GearRatioByCurrents.sv_n_EngLev2 ZFFSAB._.GearRatioByCurrents.sv_n_EngLev2Sts ZFFSAB._.GearRatioByCurrents.sv_n_EngLev2Sts_ ZFFSAB._.GearRatioByCurrents.sv_n_EngLev2_ ZFFSAB._.GearRatioByCurrents.sv_st_KL15 ZFFSAB._.GearRatioByCurrents.sv_st_KL15_ /end LOC_MEASUREMENT
/end FUNCTION
/begin FUNCTION zf_SAB_BrakePedalIn "desc_en"
 /begin LOC_MEASUREMENT ZFFSAB._.BrakePedalIn.f_BrakeErr ZFFSAB._.BrakePedalIn.iv_Brake ZFFSAB._.BrakePedalIn.iv_BrakeSts ZFFSAB._.BrakePedalIn.iv_BrakeSts_ ZFFSAB._.BrakePedalIn.iv_Brake_ ZFFSAB._.BrakePedalIn.sv_BrakeLev2Sts ZFFSAB._.BrakePedalIn.sv_BrakeSts ZFFSAB._.BrakePedalIn.sv_BrakeSts_ ZFFSAB._.BrakePedalIn.sv_f_Brake ZFFSAB._.BrakePedalIn.sv_f_BrakeLev2 ZFFSAB._.BrakePedalIn.sv_f_Brake_ ZFFSAB._.BrakePedalIn.sv_f_Brake_AGS /end LOC_MEASUREMENT
/end FUNCTION
/begin FUNCTION zf_SAB_CAN_SwitchingIn "desc_en"
 /begin LOC_MEASUREMENT ZFFSAB._.CAN_SwitchingIn.ACAN_FACAN ZFFSAB._.CAN_SwitchingIn.CANA_Sts ZFFSAB._.CAN_SwitchingIn.CANFA_Sts ZFFSAB._.CAN_SwitchingIn.LastCycleFaulty ZFFSAB._.CAN_SwitchingIn.sv_ACAN_FACAN_Static ZFFSAB._.CAN_SwitchingIn.sv_f_ACAN_Or_FACAN_Active /end LOC_MEASUREMENT
/end FUNCTION
/begin FUNCTION zf_SAB_Coding "desc_en"
 /begin LOC_MEASUREMENT ZFFSAB._.Coding.iv_CodingAppl ZFFSAB._.Coding.iv_CodingElectrical ZFFSAB._.Coding.sv_AGS_Codierung ZFFSAB._.Coding.sv_AGS_CodierungOBD ZFFSAB._.Coding.sv_Coding3000 ZFFSAB._.Coding.sv_Coding3001 ZFFSAB._.Coding.sv_VarCode_MILCycles ZFFSAB._.Coding.sv_VarCode_MILLamp ZFFSAB._.Coding.sv_VarCode_NIC ZFFSAB._.Coding.sv_VarCode_Scantool_Enable /end LOC_MEASUREMENT
/end FUNCTION
/begin FUNCTION zf_SAB_OSModeSwitchingOut "desc_en"
 /begin LOC_MEASUREMENT ZFFSAB._.OSModeSwitchingOut.OSModeActive ZFFSAB._.OSModeSwitchingOut.OSModeNext ZFFSAB._.OSModeSwitchingOut.iv_n_Eng ZFFSAB._.OSModeSwitchingOut.iv_n_EngSts /end LOC_MEASUREMENT
/end FUNCTION
/begin FUNCTION zf_SAB_EngineCoolantTempIn "desc_en"
 /begin LOC_MEASUREMENT ZFFSAB._.EngineCoolantTempIn.f_c_CemErr ZFFSAB._.EngineCoolantTempIn.f_c_EngErr ZFFSAB._.EngineCoolantTempIn.iv_c_Cem ZFFSAB._.EngineCoolantTempIn.iv_c_CemSts ZFFSAB._.EngineCoolantTempIn.iv_c_Eng ZFFSAB._.EngineCoolantTempIn.iv_c_EngSts ZFFSAB._.EngineCoolantTempIn.sv_AGS_Cem ZFFSAB._.EngineCoolantTempIn.sv_c_CemSts ZFFSAB._.EngineCoolantTempIn.sv_c_Eng ZFFSAB._.EngineCoolantTempIn.sv_c_EngSts /end LOC_MEASUREMENT
/end FUNCTION
/begin FUNCTION zf_SAB_GearboxTempInFl "desc_en"
 /begin LOC_MEASUREMENT ZFFSAB._.GearboxTempIn.GearboxTempInFl.iv_c_Chip2Trans ZFFSAB._.GearboxTempIn.GearboxTempInFl.sv_c_ChipTrans ZFFSAB._.GearboxTempIn.GearboxTempInFl.sv_c_ChipTransSts ZFFSAB._.GearboxTempIn.GearboxTempInFl.sv_c_OilTrans ZFFSAB._.GearboxTempIn.GearboxTempInFl.sv_c_OilTransSts ZFFSAB._.GearboxTempIn.GearboxTempInFl.sv_c_OilTrans_ /end LOC_MEASUREMENT
/end FUNCTION
/begin FUNCTION zf_SAB_GearboxTempIn "desc_en"
 /begin LOC_MEASUREMENT ZFFSAB._.GearboxTempIn.f_IgnitionOff2On ZFFSAB._.GearboxTempIn.iv_c_Chip2Trans ZFFSAB._.GearboxTempIn.iv_c_Chip2TransESts ZFFSAB._.GearboxTempIn.iv_c_OilTrans ZFFSAB._.GearboxTempIn.iv_c_OilTransESts ZFFSAB._.GearboxTempIn.iv_n_Eng ZFFSAB._.GearboxTempIn.iv_n_EngSts ZFFSAB._.GearboxTempIn.sv_c_ChipTrans ZFFSAB._.GearboxTempIn.sv_c_ChipTransSts ZFFSAB._.GearboxTempIn.sv_c_OilTrans ZFFSAB._.GearboxTempIn.sv_c_OilTransSts ZFFSAB._.GearboxTempIn.sv_c_OilTransSts_ ZFFSAB._.GearboxTempIn.sv_c_OilTransTXCAN ZFFSAB._.GearboxTempIn.sv_c_OilTrans_ /end LOC_MEASUREMENT
/end FUNCTION
/begin FUNCTION zf_SAB_TempDiagnosis_AT "desc_en"
 /begin LOC_MEASUREMENT ZFFSAB._.GearboxTempIn.PAK_counter_end ZFFSAB._.GearboxTempIn.PAK_counter_end_ ZFFSAB._.GearboxTempIn.PAK_counter_start ZFFSAB._.GearboxTempIn.PAK_counter_start_ /end LOC_MEASUREMENT
/end FUNCTION
/begin FUNCTION zf_SAB_FpDkVpIn "desc_en"
 /begin LOC_MEASUREMENT ZFFSAB._.FpDkVpIn.f_ThrottlePositionErr ZFFSAB._.FpDkVpIn.f_ThrottlePositionVirtErr ZFFSAB._.FpDkVpIn.iv_ThrottlePosition ZFFSAB._.FpDkVpIn.iv_ThrottlePositionErr ZFFSAB._.FpDkVpIn.iv_ThrottlePositionSts ZFFSAB._.FpDkVpIn.iv_ThrottlePositionVirt ZFFSAB._.FpDkVpIn.iv_ThrottlePositionVirtSts ZFFSAB._.FpDkVpIn.sv_MaxThrottlePosition ZFFSAB._.FpDkVpIn.sv_MaxThrottlePositionSts ZFFSAB._.FpDkVpIn.sv_ThrottlePosition ZFFSAB._.FpDkVpIn.sv_ThrottlePositionLev2 ZFFSAB._.FpDkVpIn.sv_ThrottlePositionLev2Sts ZFFSAB._.FpDkVpIn.sv_ThrottlePositionLev2Sts_ ZFFSAB._.FpDkVpIn.sv_ThrottlePositionLev2_ ZFFSAB._.FpDkVpIn.sv_ThrottlePositionSts ZFFSAB._.FpDkVpIn.sv_ThrottlePositionVirt ZFFSAB._.FpDkVpIn.sv_ThrottlePositionVirtSts /end LOC_MEASUREMENT
/end FUNCTION
/begin FUNCTION zf_SAB_FlagTrailerInfoIn "desc_en"
 /begin LOC_MEASUREMENT ZFFSAB._.FlagTrailerInfoIn.iv_TrailerInfo ZFFSAB._.FlagTrailerInfoIn.iv_TrailerInfoSts ZFFSAB._.FlagTrailerInfoIn.sv_TrailerInfoSts ZFFSAB._.FlagTrailerInfoIn.sv_f_TrailerInfo /end LOC_MEASUREMENT
/end FUNCTION
/begin FUNCTION zf_SAB_DrivingStateIn "desc_en"
 /begin LOC_MEASUREMENT ZFFSAB._.DrivingStateIn.f_DriveConditionErr ZFFSAB._.DrivingStateIn.iv_DriveCondition ZFFSAB._.DrivingStateIn.iv_DriveConditionSts ZFFSAB._.DrivingStateIn.sv_AGS_DriveCondition ZFFSAB._.DrivingStateIn.sv_DriveCondition ZFFSAB._.DrivingStateIn.sv_DriveConditionSts /end LOC_MEASUREMENT
/end FUNCTION
/begin FUNCTION zf_SAB_DrivingSpeedControlIn "desc_en"
 /begin LOC_MEASUREMENT ZFFSAB._.DrivingSpeedControlIn.f_SpeedControlErr ZFFSAB._.DrivingSpeedControlIn.sv_SpeedControlSts /end LOC_MEASUREMENT
/end FUNCTION
/begin FUNCTION zf_SAB_HybridControlIn "desc_en"
 /begin LOC_MEASUREMENT ZFFSAB._.HybridControlIn.f_ST_TAR_CENGErr ZFFSAB._.HybridControlIn.f_ST_TAR_PENG_CENGErr ZFFSAB._.HybridControlIn.iv_Ablaufvariante_HAS ZFFSAB._.HybridControlIn.iv_Ablaufvariante_HASSts ZFFSAB._.HybridControlIn.iv_ST_TAR_CENG ZFFSAB._.HybridControlIn.iv_ST_TAR_CENGSts ZFFSAB._.HybridControlIn.iv_ST_TAR_PENG_CENG ZFFSAB._.HybridControlIn.iv_ST_TAR_PENG_CENGSts ZFFSAB._.HybridControlIn.iv_Startablauf ZFFSAB._.HybridControlIn.iv_st_EngineSpeedControlEM ZFFSAB._.HybridControlIn.iv_st_EngineSpeedControlEMSts ZFFSAB._.HybridControlIn.iv_st_EngineSpeedControlEMSts_ ZFFSAB._.HybridControlIn.iv_st_EngineSpeedControlEM_ ZFFSAB._.HybridControlIn.sv_Ablaufvariante_HAS ZFFSAB._.HybridControlIn.sv_STAT_Drv ZFFSAB._.HybridControlIn.sv_ST_TAR_CENG ZFFSAB._.HybridControlIn.sv_ST_TAR_CENGSts ZFFSAB._.HybridControlIn.sv_ST_TAR_PENG_CENG ZFFSAB._.HybridControlIn.sv_ST_TAR_PENG_CENGSts ZFFSAB._.HybridControlIn.sv_st_EngineSpeedControlEM ZFFSAB._.HybridControlIn.sv_st_EngineSpeedControlEMSts ZFFSAB._.HybridControlIn.sv_st_EngineSpeedControlEMSts_ ZFFSAB._.HybridControlIn.sv_st_EngineSpeedControlEM_ /end LOC_MEASUREMENT
/end FUNCTION
/begin FUNCTION zf_SAB_HybridVehicleReadyToDriveIn "desc_en"
 /begin LOC_MEASUREMENT ZFFSAB._.HybridVehicleReadyToDriveIn.VehicleReadyToDriveOld ZFFSAB._.HybridVehicleReadyToDriveIn.VehicleReadyToDriveOldSts ZFFSAB._.HybridVehicleReadyToDriveIn.f_ReqVehImdtVehRdyToDrvOff ZFFSAB._.HybridVehicleReadyToDriveIn.iv_ReqVehImdtVehRdyToDrvOff ZFFSAB._.HybridVehicleReadyToDriveIn.iv_ReqVehImdtVehRdyToDrvOffSts ZFFSAB._.HybridVehicleReadyToDriveIn.iv_STAT_Drv ZFFSAB._.HybridVehicleReadyToDriveIn.iv_STAT_DrvSts ZFFSAB._.HybridVehicleReadyToDriveIn.sv_VehicleReadyToDrive ZFFSAB._.HybridVehicleReadyToDriveIn.sv_VehicleReadyToDriveSts ZFFSAB._.HybridVehicleReadyToDriveInBPRAM.f_VehicleReadyToDriveInitPhase ZFFSAB._.HybridVehicleReadyToDriveInBPRAM.f_VehicleReadyToDriveInitPhase_ ZFFSAB._.HybridVehicleReadyToDriveInBPRAM.stc_VehicleReadyToDriveBPRAM ZFFSAB._.HybridVehicleReadyToDriveInBPRAM.stc_VehicleReadyToDriveBPRAM_ ZFFSAB._.HybridVehicleReadyToDriveInBPRAM.stc_VehicleReadyToDriveStsBPRAM ZFFSAB._.HybridVehicleReadyToDriveInBPRAM.stc_VehicleReadyToDriveStsBPRAM_ /end LOC_MEASUREMENT
/end FUNCTION
/begin FUNCTION zf_SAB_YawIn "desc_en"
 /begin LOC_MEASUREMENT ZFFSAB._.YawIn.f_YawRateErr ZFFSAB._.YawIn.iv_YawQURateSts ZFFSAB._.YawIn.iv_YawRate ZFFSAB._.YawIn.iv_YawRateSts ZFFSAB._.YawIn.sv_YawRate ZFFSAB._.YawIn.sv_f_YawRateSts /end LOC_MEASUREMENT
/end FUNCTION
/begin FUNCTION zf_SAB_LDMDesiredTorqueIn "desc_en"
 /begin LOC_MEASUREMENT ZFFSAB._.LDMDesiredTorqueIn.f_LDMModeErr ZFFSAB._.LDMDesiredTorqueIn.f_m_LDMErr ZFFSAB._.LDMDesiredTorqueIn.iv_FASMode ZFFSAB._.LDMDesiredTorqueIn.iv_FASModeSts ZFFSAB._.LDMDesiredTorqueIn.iv_m_LDM ZFFSAB._.LDMDesiredTorqueIn.iv_m_LDMSts ZFFSAB._.LDMDesiredTorqueIn.sv_LDMDynamic ZFFSAB._.LDMDesiredTorqueIn.sv_LDMDynamic2 ZFFSAB._.LDMDesiredTorqueIn.sv_LDMDynamic2Sts ZFFSAB._.LDMDesiredTorqueIn.sv_LDMDynamicSts ZFFSAB._.LDMDesiredTorqueIn.sv_LDMMode ZFFSAB._.LDMDesiredTorqueIn.sv_LDMMode2 ZFFSAB._.LDMDesiredTorqueIn.sv_LDMMode2Sts ZFFSAB._.LDMDesiredTorqueIn.sv_LDMModeSts ZFFSAB._.LDMDesiredTorqueIn.sv_m_LDM ZFFSAB._.LDMDesiredTorqueIn.sv_m_LDMSts /end LOC_MEASUREMENT
/end FUNCTION
/begin FUNCTION zf_SAB_HDCIn "desc_en"
 /begin LOC_MEASUREMENT ZFFSAB._.HDCIn.f_HDCErr ZFFSAB._.HDCIn.iv_HDC ZFFSAB._.HDCIn.iv_HDCSts ZFFSAB._.HDCIn.sv_HDC ZFFSAB._.HDCIn.sv_HDCSbe ZFFSAB._.HDCIn.sv_HDCSts /end LOC_MEASUREMENT
/end FUNCTION
/begin FUNCTION zf_SAB_FlagKickDownIn "desc_en"
 /begin LOC_MEASUREMENT ZFFSAB._.FlagKickDownIn.f_KickdownErr ZFFSAB._.FlagKickDownIn.iv_Kickdown ZFFSAB._.FlagKickDownIn.iv_KickdownSts ZFFSAB._.FlagKickDownIn.sv_KickdownSts ZFFSAB._.FlagKickDownIn.sv_f_Kickdown /end LOC_MEASUREMENT
/end FUNCTION
/begin FUNCTION zf_SAB_AccelerationLongIn "desc_en"
 /begin LOC_MEASUREMENT ZFFSAB._.AccelerationLongIn.f_AxRefErr ZFFSAB._.AccelerationLongIn.iv_AxRef ZFFSAB._.AccelerationLongIn.iv_AxRefErr ZFFSAB._.AccelerationLongIn.iv_AxRefSts ZFFSAB._.AccelerationLongIn.sv_AxRef ZFFSAB._.AccelerationLongIn.sv_AxRefSts /end LOC_MEASUREMENT
/end FUNCTION
/begin FUNCTION zf_SAB_AmbConditionsIn "desc_en"
 /begin LOC_MEASUREMENT ZFFSAB._.AmbConditionsIn.FaultCodeToAmbientCondition ZFFSAB._.AmbConditionsIn.iv_ABSReg ZFFSAB._.AmbConditionsIn.iv_ABSRegSts ZFFSAB._.AmbConditionsIn.iv_ASCPas ZFFSAB._.AmbConditionsIn.iv_ASCReg ZFFSAB._.AmbConditionsIn.iv_AblaufvarianteHas ZFFSAB._.AmbConditionsIn.iv_ActiveActionByte1 ZFFSAB._.AmbConditionsIn.iv_ActiveActionByte2 ZFFSAB._.AmbConditionsIn.iv_ActiveActionByte3 ZFFSAB._.AmbConditionsIn.iv_ActiveActionByte4 ZFFSAB._.AmbConditionsIn.iv_ActiveActionByte5 ZFFSAB._.AmbConditionsIn.iv_ActiveActionByte6 ZFFSAB._.AmbConditionsIn.iv_ActiveActionByte7 ZFFSAB._.AmbConditionsIn.iv_ActiveActionByte8 ZFFSAB._.AmbConditionsIn.iv_ActualGear ZFFSAB._.AmbConditionsIn.iv_BrakeSts ZFFSAB._.AmbConditionsIn.iv_CtrlSignalSourceSts ZFFSAB._.AmbConditionsIn.iv_DoorDSts ZFFSAB._.AmbConditionsIn.iv_DrivingDirection ZFFSAB._.AmbConditionsIn.iv_IepIst ZFFSAB._.AmbConditionsIn.iv_KL15 ZFFSAB._.AmbConditionsIn.iv_KL15Sts ZFFSAB._.AmbConditionsIn.iv_KL15_UWB81 ZFFSAB._.AmbConditionsIn.iv_KeyValidSts ZFFSAB._.AmbConditionsIn.iv_Kraftschluss ZFFSAB._.AmbConditionsIn.iv_KupStatusIae ZFFSAB._.AmbConditionsIn.iv_Mileage ZFFSAB._.AmbConditionsIn.iv_MileageFromNab ZFFSAB._.AmbConditionsIn.iv_PSensSts ZFFSAB._.AmbConditionsIn.iv_STAT_Drv ZFFSAB._.AmbConditionsIn.iv_SeatBeltSts ZFFSAB._.AmbConditionsIn.iv_SeatFLSts ZFFSAB._.AmbConditionsIn.iv_StatusK0 ZFFSAB._.AmbConditionsIn.iv_TargetGear ZFFSAB._.AmbConditionsIn.iv_ThrottlePosition ZFFSAB._.AmbConditionsIn.iv_ThrottlePositionSts ZFFSAB._.AmbConditionsIn.iv_Tu_sts_Direction ZFFSAB._.AmbConditionsIn.iv_c_Chip1Trans ZFFSAB._.AmbConditionsIn.iv_c_Chip2Trans ZFFSAB._.AmbConditionsIn.iv_c_ChipTempESts ZFFSAB._.AmbConditionsIn.iv_c_OilTrans ZFFSAB._.AmbConditionsIn.iv_c_OilTransSts ZFFSAB._.AmbConditionsIn.iv_clutch_data ZFFSAB._.AmbConditionsIn.iv_ctl_EI1ErrType ZFFSAB._.AmbConditionsIn.iv_ctl_EIErrType ZFFSAB._.AmbConditionsIn.iv_f_L1 ZFFSAB._.AmbConditionsIn.iv_f_L2 ZFFSAB._.AmbConditionsIn.iv_f_L3 ZFFSAB._.AmbConditionsIn.iv_f_L4 ZFFSAB._.AmbConditionsIn.iv_f_P12TwoErr ZFFSAB._.AmbConditionsIn.iv_i_Out0 ZFFSAB._.AmbConditionsIn.iv_i_Out1 ZFFSAB._.AmbConditionsIn.iv_i_Out10 ZFFSAB._.AmbConditionsIn.iv_i_Out11 ZFFSAB._.AmbConditionsIn.iv_i_Out12 ZFFSAB._.AmbConditionsIn.iv_i_Out13 ZFFSAB._.AmbConditionsIn.iv_i_Out14 ZFFSAB._.AmbConditionsIn.iv_i_Out2 ZFFSAB._.AmbConditionsIn.iv_i_Out3 ZFFSAB._.AmbConditionsIn.iv_i_Out4 ZFFSAB._.AmbConditionsIn.iv_i_Out5 ZFFSAB._.AmbConditionsIn.iv_i_Out6 ZFFSAB._.AmbConditionsIn.iv_i_Out7 ZFFSAB._.AmbConditionsIn.iv_i_Out8 ZFFSAB._.AmbConditionsIn.iv_i_Out9 ZFFSAB._.AmbConditionsIn.iv_m_Crank ZFFSAB._.AmbConditionsIn.iv_m_Eng ZFFSAB._.AmbConditionsIn.iv_m_EngIntervention ZFFSAB._.AmbConditionsIn.iv_m_EngMax ZFFSAB._.AmbConditionsIn.iv_m_EngSts ZFFSAB._.AmbConditionsIn.iv_m_IstEm ZFFSAB._.AmbConditionsIn.iv_m_IstK0 ZFFSAB._.AmbConditionsIn.iv_m_MotMaxHas ZFFSAB._.AmbConditionsIn.iv_n_Ab ZFFSAB._.AmbConditionsIn.iv_n_AbSts ZFFSAB._.AmbConditionsIn.iv_n_Eng ZFFSAB._.AmbConditionsIn.iv_n_EngSts ZFFSAB._.AmbConditionsIn.iv_n_EngVM ZFFSAB._.AmbConditionsIn.iv_n_SollEmHas ZFFSAB._.AmbConditionsIn.iv_n_Tu ZFFSAB._.AmbConditionsIn.iv_n_TuSts ZFFSAB._.AmbConditionsIn.iv_n_WheelAvg_UWB12 ZFFSAB._.AmbConditionsIn.iv_n_WheelAvg_UWB74 ZFFSAB._.AmbConditionsIn.iv_n_Wheel_FL ZFFSAB._.AmbConditionsIn.iv_n_Wheel_FR ZFFSAB._.AmbConditionsIn.iv_n_Wheel_RL ZFFSAB._.AmbConditionsIn.iv_n_Wheel_RR ZFFSAB._.AmbConditionsIn.iv_p_BrakeSts ZFFSAB._.AmbConditionsIn.iv_st_HasActualState ZFFSAB._.AmbConditionsIn.iv_st_HasNominalState ZFFSAB._.AmbConditionsIn.iv_st_IgnPlausiErr ZFFSAB._.AmbConditionsIn.iv_st_IstGang ZFFSAB._.AmbConditionsIn.iv_st_WKZugSchub ZFFSAB._.AmbConditionsIn.iv_t_Betrstd ZFFSAB._.AmbConditionsIn.iv_t_SystemTime ZFFSAB._.AmbConditionsIn.iv_t_TimeSinceReset ZFFSAB._.AmbConditionsIn.iv_u_BattFilt ZFFSAB._.AmbConditionsIn.iv_u_Kl15_Pin ZFFSAB._.AmbConditionsIn.iv_u_Sensor1 ZFFSAB._.AmbConditionsIn.iv_udrmv1_act ZFFSAB._.AmbConditionsIn.sv_ABSReg ZFFSAB._.AmbConditionsIn.sv_ASCPas ZFFSAB._.AmbConditionsIn.sv_ASCReg ZFFSAB._.AmbConditionsIn.sv_AblaufvarianteHas ZFFSAB._.AmbConditionsIn.sv_ActiveActionByte1 ZFFSAB._.AmbConditionsIn.sv_ActiveActionByte2 ZFFSAB._.AmbConditionsIn.sv_ActiveActionByte3 ZFFSAB._.AmbConditionsIn.sv_ActiveActionByte4 ZFFSAB._.AmbConditionsIn.sv_ActiveActionByte5 ZFFSAB._.AmbConditionsIn.sv_ActiveActionByte6 ZFFSAB._.AmbConditionsIn.sv_ActiveActionByte7 ZFFSAB._.AmbConditionsIn.sv_ActiveActionByte8 ZFFSAB._.AmbConditionsIn.sv_IepIst ZFFSAB._.AmbConditionsIn.sv_KL15 ZFFSAB._.AmbConditionsIn.sv_KupStatusIae ZFFSAB._.AmbConditionsIn.sv_PowerTransRotation ZFFSAB._.AmbConditionsIn.sv_StatusK0 ZFFSAB._.AmbConditionsIn.sv_ThrottlePosition ZFFSAB._.AmbConditionsIn.sv_c_Chip1Trans ZFFSAB._.AmbConditionsIn.sv_c_Chip2Trans ZFFSAB._.AmbConditionsIn.sv_c_OilTrans ZFFSAB._.AmbConditionsIn.sv_m_Crank ZFFSAB._.AmbConditionsIn.sv_m_Eng ZFFSAB._.AmbConditionsIn.sv_m_EngIntervention ZFFSAB._.AmbConditionsIn.sv_m_EngMax ZFFSAB._.AmbConditionsIn.sv_m_IstEm ZFFSAB._.AmbConditionsIn.sv_m_IstK0 ZFFSAB._.AmbConditionsIn.sv_m_MotMaxHas ZFFSAB._.AmbConditionsIn.sv_n_Ab ZFFSAB._.AmbConditionsIn.sv_n_Eng ZFFSAB._.AmbConditionsIn.sv_n_EngVM ZFFSAB._.AmbConditionsIn.sv_n_SollEmHas ZFFSAB._.AmbConditionsIn.sv_n_Tu ZFFSAB._.AmbConditionsIn.sv_n_WheelAvg_UWB12 ZFFSAB._.AmbConditionsIn.sv_n_WheelAvg_UWB74 ZFFSAB._.AmbConditionsIn.sv_n_Wheel_FL ZFFSAB._.AmbConditionsIn.sv_n_Wheel_FR ZFFSAB._.AmbConditionsIn.sv_n_Wheel_RL ZFFSAB._.AmbConditionsIn.sv_n_Wheel_RR ZFFSAB._.AmbConditionsIn.sv_st_AscDscCanSig ZFFSAB._.AmbConditionsIn.sv_st_DiscreteEntries ZFFSAB._.AmbConditionsIn.sv_st_FemCasCanSig ZFFSAB._.AmbConditionsIn.sv_st_GearShiftingInfo ZFFSAB._.AmbConditionsIn.sv_st_GearboxSig ZFFSAB._.AmbConditionsIn.sv_st_HasActualNominalState ZFFSAB._.AmbConditionsIn.sv_st_IgnitionSignal ZFFSAB._.AmbConditionsIn.sv_st_MVs ZFFSAB._.AmbConditionsIn.sv_st_MotorCanSig ZFFSAB._.AmbConditionsIn.sv_st_ZielGang ZFFSAB._.AmbConditionsIn.sv_sts_PMA ZFFSAB._.AmbConditionsIn.sv_t_SystemTime ZFFSAB._.AmbConditionsIn.sv_t_TimeSinceReset ZFFSAB._.AmbConditionsIn.sv_u_BattFilt ZFFSAB._.AmbConditionsIn.sv_u_Kl15_Pin ZFFSAB._.AmbConditionsIn.sv_u_Sensor1 ZFFSAB._.AmbConditionsIn.sv_udrmv1_act /end LOC_MEASUREMENT
/end FUNCTION
/begin FUNCTION zf_SAB_DistanceIn "desc_en"
 /begin LOC_MEASUREMENT ZFFSAB._.AmbConditionsIn.sv_Mileage ZFFSAB._.DistanceIn.iv_Mileage ZFFSAB._.DistanceIn.iv_MileageSts ZFFSAB._.DistanceIn.sv_Mileage ZFFSAB._.DistanceIn.sv_MileageFromNab ZFFSAB._.DistanceIn.sv_MileageSts ZFFSAB._.DistanceIn.sv_Mileage_1km ZFFSAB._.DistanceIn.sv_f_MileageErr /end LOC_MEASUREMENT
/end FUNCTION
/begin FUNCTION zf_SAB_CDD_IEP_Control "desc_en"
 /begin LOC_MEASUREMENT ZFFSAB._.AmbConditionsIn.ctl_IEP_Status ZFFSAB._.AmbConditionsIn.iv_Actual_HWVersion_IEP ZFFSAB._.AmbConditionsIn.iv_Actual_IDNr_IEP ZFFSAB._.AmbConditionsIn.iv_Actual_OpPoint_IEP ZFFSAB._.AmbConditionsIn.iv_Actual_SWVersion_IEP ZFFSAB._.AmbConditionsIn.iv_Actual_c_IEP ZFFSAB._.AmbConditionsIn.iv_Actual_i_IEP ZFFSAB._.AmbConditionsIn.iv_Actual_n_IEP ZFFSAB._.AmbConditionsIn.iv_Actual_u_IEP ZFFSAB._.AmbConditionsIn.iv_TargetOperationPoint ZFFSAB._.AmbConditionsIn.sv_IEP_Errorbytes ZFFSAB._.AmbConditionsIn.sv_IEP_Status ZFFSAB._.CDD_IEP_Control.LastTxMessageIndex ZFFSAB._.CDD_IEP_Control.RxMessage0IdData[0] ZFFSAB._.CDD_IEP_Control.RxMessage0IdData[1] ZFFSAB._.CDD_IEP_Control.RxMessage0IdData[2] ZFFSAB._.CDD_IEP_Control.RxMessage0IdData[3] ZFFSAB._.CDD_IEP_Control.RxMessage0IdData[4] ZFFSAB._.CDD_IEP_Control.RxMessage0IdData[5] ZFFSAB._.CDD_IEP_Control.RxMessage0IdData[6] ZFFSAB._.CDD_IEP_Control.RxMessage0IdData[7] ZFFSAB._.CDD_IEP_Control.RxMessage0IdData[8] ZFFSAB._.CDD_IEP_Control.RxMessage1IdData[0] ZFFSAB._.CDD_IEP_Control.RxMessage1IdData[1] ZFFSAB._.CDD_IEP_Control.RxMessage1IdData[2] ZFFSAB._.CDD_IEP_Control.RxMessage1IdData[3] ZFFSAB._.CDD_IEP_Control.RxMessage1IdData[4] ZFFSAB._.CDD_IEP_Control.RxMessage1IdData[5] ZFFSAB._.CDD_IEP_Control.RxMessage1IdData[6] ZFFSAB._.CDD_IEP_Control.RxMessage1IdData[7] ZFFSAB._.CDD_IEP_Control.RxMessage1IdData[8] ZFFSAB._.CDD_IEP_Control.RxMessage2IdData[0] ZFFSAB._.CDD_IEP_Control.RxMessage2IdData[1] ZFFSAB._.CDD_IEP_Control.RxMessage2IdData[2] ZFFSAB._.CDD_IEP_Control.RxMessage2IdData[3] ZFFSAB._.CDD_IEP_Control.RxMessage2IdData[4] ZFFSAB._.CDD_IEP_Control.RxMessage2IdData[5] ZFFSAB._.CDD_IEP_Control.RxMessage2IdData[6] ZFFSAB._.CDD_IEP_Control.RxMessage2IdData[7] ZFFSAB._.CDD_IEP_Control.RxMessage2IdData[8] ZFFSAB._.CDD_IEP_Control.RxMessageAliveCntExp[0] ZFFSAB._.CDD_IEP_Control.RxMessageAliveCntExp[1] ZFFSAB._.CDD_IEP_Control.RxMessageAliveCntExp[2] ZFFSAB._.CDD_IEP_Control.RxMessageAliveCntExp[3] ZFFSAB._.CDD_IEP_Control.RxMessageAliveCntExp[4] ZFFSAB._.CDD_IEP_Control.RxMessageAliveCntExp[5] ZFFSAB._.CDD_IEP_Control.RxMessageAliveCntExp[6] ZFFSAB._.CDD_IEP_Control.RxMessageAliveCntExp[7] ZFFSAB._.CDD_IEP_Control.RxMessageAliveStuckCnt[0] ZFFSAB._.CDD_IEP_Control.RxMessageAliveStuckCnt[1] ZFFSAB._.CDD_IEP_Control.RxMessageAliveStuckCnt[2] ZFFSAB._.CDD_IEP_Control.RxMessageAliveStuckCnt[3] ZFFSAB._.CDD_IEP_Control.RxMessageAliveStuckCnt[4] ZFFSAB._.CDD_IEP_Control.RxMessageAliveStuckCnt[5] ZFFSAB._.CDD_IEP_Control.RxMessageAliveStuckCnt[6] ZFFSAB._.CDD_IEP_Control.RxMessageAliveStuckCnt[7] ZFFSAB._.CDD_IEP_Control.RxMessageCRC8ErrCnt[0] ZFFSAB._.CDD_IEP_Control.RxMessageCRC8ErrCnt[1] ZFFSAB._.CDD_IEP_Control.RxMessageCRC8ErrCnt[2] ZFFSAB._.CDD_IEP_Control.RxMessageCRC8ErrCnt[3] ZFFSAB._.CDD_IEP_Control.RxMessageCRC8ErrCnt[4] ZFFSAB._.CDD_IEP_Control.RxMessageCRC8ErrCnt[5] ZFFSAB._.CDD_IEP_Control.RxMessageCRC8ErrCnt[6] ZFFSAB._.CDD_IEP_Control.RxMessageCRC8ErrCnt[7] ZFFSAB._.CDD_IEP_Control.RxMessageStatus[0] ZFFSAB._.CDD_IEP_Control.RxMessageStatus[1] ZFFSAB._.CDD_IEP_Control.RxMessageStatus[2] ZFFSAB._.CDD_IEP_Control.RxMessageStatus[3] ZFFSAB._.CDD_IEP_Control.RxMessageStatus[4] ZFFSAB._.CDD_IEP_Control.RxMessageStatus[5] ZFFSAB._.CDD_IEP_Control.RxMessageStatus[6] ZFFSAB._.CDD_IEP_Control.RxMessageStatus[7] ZFFSAB._.CDD_IEP_Control.TxMessage0Data[0] ZFFSAB._.CDD_IEP_Control.TxMessage0Data[1] ZFFSAB._.CDD_IEP_Control.TxMessage0Data[2] ZFFSAB._.CDD_IEP_Control.TxMessage0Data[3] ZFFSAB._.CDD_IEP_Control.TxMessage0Data[4] ZFFSAB._.CDD_IEP_Control.TxMessage0Data[5] ZFFSAB._.CDD_IEP_Control.TxMessage0Data[6] ZFFSAB._.CDD_IEP_Control.TxMessage0Data[7] ZFFSAB._.CDD_IEP_Control.TxMessage1Data[0] ZFFSAB._.CDD_IEP_Control.TxMessage1Data[1] ZFFSAB._.CDD_IEP_Control.TxMessage1Data[2] ZFFSAB._.CDD_IEP_Control.TxMessage1Data[3] ZFFSAB._.CDD_IEP_Control.TxMessage1Data[4] ZFFSAB._.CDD_IEP_Control.TxMessage1Data[5] ZFFSAB._.CDD_IEP_Control.TxMessage1Data[6] ZFFSAB._.CDD_IEP_Control.TxMessage1Data[7] ZFFSAB._.CDD_IEP_Control.TxMessageAliveCnt[0] ZFFSAB._.CDD_IEP_Control.TxMessageAliveCnt[1] ZFFSAB._.CDD_IEP_Control.TxMessageAliveCnt[2] ZFFSAB._.CDD_IEP_Control.TxMessageAliveCnt[3] ZFFSAB._.CDD_IEP_Control.TxMessageAliveCnt[4] ZFFSAB._.CDD_IEP_Control.TxMessageAliveCnt[5] ZFFSAB._.CDD_IEP_Control.TxMessageAliveCnt[6] ZFFSAB._.CDD_IEP_Control.TxMessageAliveCnt[7] ZFFSAB._.CDD_IEP_Control.TxMessageStatus[0] ZFFSAB._.CDD_IEP_Control.TxMessageStatus[1] ZFFSAB._.CDD_IEP_Control.TxMessageStatus[2] ZFFSAB._.CDD_IEP_Control.TxMessageStatus[3] ZFFSAB._.CDD_IEP_Control.TxMessageStatus[4] ZFFSAB._.CDD_IEP_Control.TxMessageStatus[5] ZFFSAB._.CDD_IEP_Control.TxMessageStatus[6] ZFFSAB._.CDD_IEP_Control.TxMessageStatus[7] ZFFSAB._.CDD_IEP_Control.cnt_AliveAtCmdClrErr ZFFSAB._.CDD_IEP_Control.ctl_IEP_Status ZFFSAB._.CDD_IEP_Control.f_Actual_u_IEP_Valid ZFFSAB._.CDD_IEP_Control.f_IEPWarmup ZFFSAB._.CDD_IEP_Control.f_clearIepErr ZFFSAB._.CDD_IEP_Control.f_iepHw_Error ZFFSAB._.CDD_IEP_Control.f_iepHw_testCondition ZFFSAB._.CDD_IEP_Control.f_iepTempsens_testCondition ZFFSAB._.CDD_IEP_Control.f_iepVersion_testCondition ZFFSAB._.CDD_IEP_Control.f_iepWarmUpErr ZFFSAB._.CDD_IEP_Control.f_iep_limphome_old ZFFSAB._.CDD_IEP_Control.f_linComActive_old ZFFSAB._.CDD_IEP_Control.f_testCompletedCyclic ZFFSAB._.CDD_IEP_Control.f_testCompletedInit ZFFSAB._.CDD_IEP_Control.f_testCompletedRotation ZFFSAB._.CDD_IEP_Control.iv_Actual_HWVersion_IEP ZFFSAB._.CDD_IEP_Control.iv_Actual_IDNr_IEP ZFFSAB._.CDD_IEP_Control.iv_Actual_OpPoint_IEP ZFFSAB._.CDD_IEP_Control.iv_Actual_SWVersion_IEP ZFFSAB._.CDD_IEP_Control.iv_Actual_c_IEP ZFFSAB._.CDD_IEP_Control.iv_Actual_crc8_1_IEP ZFFSAB._.CDD_IEP_Control.iv_Actual_i_IEP ZFFSAB._.CDD_IEP_Control.iv_Actual_n_IEP ZFFSAB._.CDD_IEP_Control.iv_Actual_u_IEP ZFFSAB._.CDD_IEP_Control.iv_OperationPointTarget ZFFSAB._.CDD_IEP_Control.iv_c_OilTrans ZFFSAB._.CDD_IEP_Control.iv_ctl_ReqIep ZFFSAB._.CDD_IEP_Control.iv_f_GetUndervoltageTC ZFFSAB._.CDD_IEP_Control.iv_f_JumpstartAktiv ZFFSAB._.CDD_IEP_Control.iv_f_iep_limphome ZFFSAB._.CDD_IEP_Control.iv_f_linComActive ZFFSAB._.CDD_IEP_Control.loc_IEP_StatusOld ZFFSAB._.CDD_IEP_Control.sv_ActualOperationPointIEP ZFFSAB._.CDD_IEP_Control.sv_Actual_u_IEP ZFFSAB._.CDD_IEP_Control.sv_Actual_u_IEPSts ZFFSAB._.CDD_IEP_Control.sv_IEP_Verbaut ZFFSAB._.CDD_IEP_Control.sv_LIN_EPumpErr ZFFSAB._.CDD_IEP_Control.sv_c_IEP_Act_Cel ZFFSAB._.CDD_IEP_Control.sv_ctl_Coding ZFFSAB._.CDD_IEP_Control.sv_ctl_LinEpumpErrDetail ZFFSAB._.CDD_IEP_Control.sv_f_IEP_Act_CalidCvnAvailable ZFFSAB._.CDD_IEP_Control.sv_sts_C_IEP ZFFSAB._.SABEeprom.EepromData.actSlaveAppSWVersionNum[0] ZFFSAB._.SABEeprom.EepromData.actSlaveAppSWVersionNum[1] ZFFSAB._.SABEeprom.EepromData.actSlaveAppSWVersionNum[2] ZFFSAB._.SABEeprom.EepromData.actSlaveAppSWVersionNum[3] ZFFSAB._.SABEeprom.EepromData.actSlaveSparePartNumber[0] ZFFSAB._.SABEeprom.EepromData.actSlaveSparePartNumber[10] ZFFSAB._.SABEeprom.EepromData.actSlaveSparePartNumber[1] ZFFSAB._.SABEeprom.EepromData.actSlaveSparePartNumber[2] ZFFSAB._.SABEeprom.EepromData.actSlaveSparePartNumber[3] ZFFSAB._.SABEeprom.EepromData.actSlaveSparePartNumber[4] ZFFSAB._.SABEeprom.EepromData.actSlaveSparePartNumber[5] ZFFSAB._.SABEeprom.EepromData.actSlaveSparePartNumber[6] ZFFSAB._.SABEeprom.EepromData.actSlaveSparePartNumber[7] ZFFSAB._.SABEeprom.EepromData.actSlaveSparePartNumber[8] ZFFSAB._.SABEeprom.EepromData.actSlaveSparePartNumber[9] ZFFSAB._.SABEeprom.EepromData.actual_IEP_CALID[0] ZFFSAB._.SABEeprom.EepromData.actual_IEP_CALID[10] ZFFSAB._.SABEeprom.EepromData.actual_IEP_CALID[11] ZFFSAB._.SABEeprom.EepromData.actual_IEP_CALID[12] ZFFSAB._.SABEeprom.EepromData.actual_IEP_CALID[13] ZFFSAB._.SABEeprom.EepromData.actual_IEP_CALID[14] ZFFSAB._.SABEeprom.EepromData.actual_IEP_CALID[15] ZFFSAB._.SABEeprom.EepromData.actual_IEP_CALID[1] ZFFSAB._.SABEeprom.EepromData.actual_IEP_CALID[2] ZFFSAB._.SABEeprom.EepromData.actual_IEP_CALID[3] ZFFSAB._.SABEeprom.EepromData.actual_IEP_CALID[4] ZFFSAB._.SABEeprom.EepromData.actual_IEP_CALID[5] ZFFSAB._.SABEeprom.EepromData.actual_IEP_CALID[6] ZFFSAB._.SABEeprom.EepromData.actual_IEP_CALID[7] ZFFSAB._.SABEeprom.EepromData.actual_IEP_CALID[8] ZFFSAB._.SABEeprom.EepromData.actual_IEP_CALID[9] ZFFSAB._.SABEeprom.EepromData.actual_IEP_CVN[0] ZFFSAB._.SABEeprom.EepromData.actual_IEP_CVN[1] ZFFSAB._.SABEeprom.EepromData.actual_IEP_CVN[2] ZFFSAB._.SABEeprom.EepromData.actual_IEP_CVN[3] /end LOC_MEASUREMENT
/end FUNCTION
/begin FUNCTION zf_SAB_FrictionIn "desc_en"
 /begin LOC_MEASUREMENT ZFFSAB._.FrictionIn.f_m_FrictionErr ZFFSAB._.FrictionIn.iv_m_Friction ZFFSAB._.FrictionIn.iv_m_FrictionSts ZFFSAB._.FrictionIn.m_FrictionCor ZFFSAB._.FrictionIn.sv_m_Friction ZFFSAB._.FrictionIn.sv_m_FrictionSts /end LOC_MEASUREMENT
/end FUNCTION
/end MODULE
/end PROJECT
