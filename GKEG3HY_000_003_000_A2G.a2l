ASAP2_VERSION 1 51
/begin PROJECT _929_929 "Gen2_BMW_System_Supplier_Lib"
/begin HEADER "" VERSION "C_03_03" PROJECT_NO _929_929 /end HEADER
/begin MODULE DIM ""
/begin MOD_COMMON "" BYTE_ORDER MSB_FIRST ALIGNMENT_BYTE 1 ALIGNMENT_WORD 2 ALIGNMENT_LONG 4 ALIGNMENT_FLOAT32_IEEE 4 /end MOD_COMMON
/begin CHARACTERISTIC D_k_TuOld "filtering-factor of GET_NTU_FILTER" VALUE 0x217FF3 ZF_KW_NAT8_S2_S3 20 SAB_STANDARD_S2_S3 0 20 /end CHARACTERISTIC
/begin CHARACTERISTIC D_k_TuNew "filtering-factor of GET_NTU_FILTER" VALUE 0x217FF4 ZF_KW_NAT8_S2_S3 19 SAB_STANDARD_S2_S3 1 20 /end CHARACTERISTIC
/begin CHARACTERISTIC D_k_TuOld_CAN "filtering-factor of GET_NTU_CAN" VALUE 0x217FF5 ZF_KW_NAT8_S2_S3 20 SAB_STANDARD_S2_S3 0 20 /end CHARACTERISTIC
/begin CHARACTERISTIC D_k_TuNew_CAN "filtering-factor of GET_NTU_CAN" VALUE 0x217FF6 ZF_KW_NAT8_S2_S3 19 SAB_STANDARD_S2_S3 1 20 /end CHARACTERISTIC
/begin CHARACTERISTIC D_k_Ntu "scaling-factor for GET_NTU_CAN" VALUE 0x217FF7 ZF_KW_NAT8_S2_S3 7 SAB_STANDARD_S2_S3 1 8 /end CHARACTERISTIC
/begin CHARACTERISTIC D_tmr_Delay_TurbineSpeedTx "timer to delay the the tx signal in error case" VALUE 0x217FF8 ZF_KW_NAT8_S2_S3 2550 SAB_T_TIMER_10MS_S2_S3 0 2550 /end CHARACTERISTIC
/begin CHARACTERISTIC D_tmr_Init_n_TuFilt_aktiv "time how long the init value of N_Tu is sent over CAN" VALUE 0x21822E ZF_KW_NAT16_S2_S3 2000 SAB_T_TIMER_10MS_S2_S3 0 2000 /end CHARACTERISTIC
/begin CHARACTERISTIC D_n_Init_TuFilt_CAN "Init value of N_Tu which is sent over CAN" VALUE 0x218230 ZF_KW_NAT16_S2_S3 65535 SAB_N_1RPM_S2_S3 0 65535 /end CHARACTERISTIC
/begin CHARACTERISTIC D_n_Dif_IAEerkannt "Kraftschluss abhaengige Drehzahlschwelle zur Erkennung von Schlupf an der IAE" CURVE 0x201F90 ZF_TAB_NAT16_S2_S3 65535 SAB_STANDARD_S2_S3 0 65535
 /begin AXIS_DESCR FIX_AXIS NO_INPUT_QUANTITY SAB_STANDARD_S2_S3 7 0 6 FIX_AXIS_PAR_DIST 0 1 7 /end AXIS_DESCR
/end CHARACTERISTIC
/begin CHARACTERISTIC D_n_Dif_IAEerkanntHYS "Hysterese fuer die Schlupferkennung" VALUE 0x218232 ZF_KW_NAT16_S2_S3 65535 SAB_STANDARD_S2_S3 0 65535 /end CHARACTERISTIC
/begin CHARACTERISTIC D_n_Dif_IAEerkanntKUP "kup_status_iae abhaengige Drehzahlschwelle zur Erkennung von Schlupf an der IAE" CURVE 0x201FA4 ZF_TAB_NAT16_S2_S3 65535 SAB_STANDARD_S2_S3 0 65535
 /begin AXIS_DESCR FIX_AXIS NO_INPUT_QUANTITY SAB_STANDARD_S2_S3 10 0 9 FIX_AXIS_PAR_DIST 0 1 10 /end AXIS_DESCR
/end CHARACTERISTIC
/begin CHARACTERISTIC D_n_Ab_Min_nTOpt "Minimale noetige Abtriebsdrehzahl fuer die Berechnung n_Tu_VirtOpt" VALUE 0x218234 ZF_KW_NAT16_S2_S3 16535 SAB_STANDARD_S2_S3 0 16535 /end CHARACTERISTIC
/begin CHARACTERISTIC D_i_TargetGear "Applizierbarer Wert fuer Uebersetzung des Zielgangs Pos0=R Pos1=Gang1 Pos2=Gang2 usw bis Pos8=Gang8" CURVE 0x201FBC ZF_TAB_NAT16_S2_S3 65.535 SAB_K1000_S2_S3 0 65.535
 /begin AXIS_DESCR FIX_AXIS NO_INPUT_QUANTITY SAB_STANDARD_S2_S3 10 0 9 FIX_AXIS_PAR_DIST 0 1 10 /end AXIS_DESCR
/end CHARACTERISTIC
/begin CHARACTERISTIC D_k_DifIAENew "Gewichtungsfaktor neuer Wert fuer sv_n_Dif_IAEFilt fuer Vorzeichenbestimmung" VALUE 0x217FF9 ZF_KW_NAT8_S2_S3 255 SAB_STANDARD_S2_S3 0 255 /end CHARACTERISTIC
/begin CHARACTERISTIC D_k_DifIAEOld "Gewichtungsfaktor alter Wert fuer sv_n_Dif_IAEFilt fuer Vorzeichenbestimmung" VALUE 0x217FFA ZF_KW_NAT8_S2_S3 255 SAB_STANDARD_S2_S3 0 255 /end CHARACTERISTIC
/begin CHARACTERISTIC D_k_TuVirtNew "Gewichtungsfaktor neuer Wert fuer sv_n_TuVirtFilt fuer Vorzeichenbestimmung" VALUE 0x217FFB ZF_KW_NAT8_S2_S3 255 SAB_STANDARD_S2_S3 0 255 /end CHARACTERISTIC
/begin CHARACTERISTIC D_k_TuVirtOld "Gewichtungsfaktor alter Wert fuer sv_n_TuVirtFilt fuer Vorzeichenbestimmung" VALUE 0x217FFC ZF_KW_NAT8_S2_S3 255 SAB_STANDARD_S2_S3 0 255 /end CHARACTERISTIC
/begin CHARACTERISTIC D_n_TuVirt_Direction "Drehzahlschwelle zur Erkennung der Drehrichtung von sv_n_TuVirt" VALUE 0x218236 ZF_KW_NAT16_S2_S3 65535 SAB_STANDARD_S2_S3 0 65535 /end CHARACTERISTIC
/begin CHARACTERISTIC D_n_TuVirt_DirectionHYS "Hysterese fuer die Drehzahlschwelle zur Erkennung der Drehrichtung von sv_n_TuVirt" VALUE 0x218238 ZF_KW_NAT16_S2_S3 65535 SAB_STANDARD_S2_S3 0 65535 /end CHARACTERISTIC
/begin CHARACTERISTIC D_k_EngTuVirtNew "Gewichtungsfaktor neuer Wert fuer sv_n_EngTuVirtFilt" VALUE 0x217FFD ZF_KW_NAT8_S2_S3 255 SAB_STANDARD_S2_S3 0 255 /end CHARACTERISTIC
/begin CHARACTERISTIC D_k_EngTuVirtOld "Gewichtungsfaktor alter Wert fuer sv_n_EngTuVirtFilt" VALUE 0x217FFE ZF_KW_NAT8_S2_S3 255 SAB_STANDARD_S2_S3 0 255 /end CHARACTERISTIC
/begin CHARACTERISTIC D_k_AbTuVirtNew "Gewichtungsfaktor neuer Wert fuer sv_n_AbTuVirtFilt" VALUE 0x217FFF ZF_KW_NAT8_S2_S3 255 SAB_STANDARD_S2_S3 0 255 /end CHARACTERISTIC
/begin CHARACTERISTIC D_k_AbTuVirtOld "Gewichtungsfaktor alter Wert fuer sv_n_AbTuVirtFilt" VALUE 0x218000 ZF_KW_NAT8_S2_S3 255 SAB_STANDARD_S2_S3 0 255 /end CHARACTERISTIC
/begin CHARACTERISTIC D_k_n6TuVirtNew "Gewichtungsfaktor neuer Wert fuer iv_n_TuTuVirtFilt" VALUE 0x218001 ZF_KW_NAT8_S2_S3 255 SAB_STANDARD_S2_S3 0 255 /end CHARACTERISTIC
/begin CHARACTERISTIC D_k_n6TuVirtOld "Gewichtungsfaktor alter Wert fuer iv_n_TuTuVirtFilt" VALUE 0x218002 ZF_KW_NAT8_S2_S3 255 SAB_STANDARD_S2_S3 0 255 /end CHARACTERISTIC
/begin CHARACTERISTIC D_n_Dif_IAEerkanntGANG "Ist- und Zielgang- abhaengige Drehzahlschwelle zur Erkennung von Schlupf an der IAE x: iv_ActualGear y: iv_TargetGearInfo 0 ist R-Gang" MAP 0x201FD4 ZF_TAB2D_NAT16_S2_S3 6553.5 SAB_K10_S2_S3 0 6553.5
 /begin AXIS_DESCR FIX_AXIS NO_INPUT_QUANTITY SAB_STANDARD_S2_S3 6 0 5 FIX_AXIS_PAR_DIST 0 1 6 /end AXIS_DESCR
 /begin AXIS_DESCR FIX_AXIS NO_INPUT_QUANTITY SAB_STANDARD_S2_S3 8 0 7 FIX_AXIS_PAR_DIST 0 1 8 /end AXIS_DESCR
/end CHARACTERISTIC
/begin CHARACTERISTIC D_t_nEngTuVirtSync "Verzoegerungszeit zur Synchronisierung der Getriebeeingangsdrehzahl" VALUE 0x218003 ZF_KW_NAT8_S2_S3 50 SAB_T_TIMER_10MS_S2_S3 0 50 /end CHARACTERISTIC
/begin CHARACTERISTIC D_t_nAbTuVirtSync "Verzoegerungszeit zur Synchronisierung der Abtriebsdrehzahl" VALUE 0x218004 ZF_KW_NAT8_S2_S3 50 SAB_T_TIMER_10MS_S2_S3 0 50 /end CHARACTERISTIC
/begin CHARACTERISTIC D_t_n6TuVirtSync "Verzoegerungszeit zur Synchronisierung der sv_n6-Drehzahl" VALUE 0x218005 ZF_KW_NAT8_S2_S3 50 SAB_T_TIMER_10MS_S2_S3 0 50 /end CHARACTERISTIC
/begin CHARACTERISTIC D_t_n_Dif_IAEerkannt "Zeitdauer fuer die die Drehzahlschwellen ueber- bzw unterschritten werden muessen" VALUE 0x218006 ZF_KW_NAT8_S2_S3 2550 SAB_T_TIMER_10MS_S2_S3 0 2550 /end CHARACTERISTIC
/begin CHARACTERISTIC SWI_n6_InitControlActive "Schalter zur Aktivierung der Geisterdrehzahlunterdrueckung" VALUE 0x218007 ZF_KW_NAT8_S2_S3 1 SAB_STANDARD_S2_S3 0 1 /end CHARACTERISTIC
/begin CHARACTERISTIC SWI_GangnachfuehrungAktiv "Schalter fuer die Aktivierung der Berechnung waehrend Gangnachfuehrung" VALUE 0x218008 ZF_KW_NAT8_S2_S3 1 SAB_STANDARD_S2_S3 0 1 /end CHARACTERISTIC
/begin CHARACTERISTIC SWI_GangnachfuehrungAktivErw "Schalter fuer die Aktivierung der erweiterten Berechnung waehrend Gangnachfuehrung" VALUE 0x218009 ZF_KW_NAT8_S2_S3 1 SAB_STANDARD_S2_S3 0 1 /end CHARACTERISTIC
/begin CHARACTERISTIC D_k_nmot "Applizierbarer Wert fuer k_nmot" CURVE 0x20203C ZF_TAB_NAT32_S2_S3 20 SAB_K10000_M10_S2_S3 -10 10
 /begin AXIS_DESCR FIX_AXIS NO_INPUT_QUANTITY SAB_STANDARD_S2_S3 20 0 19 FIX_AXIS_PAR_DIST 0 1 20 /end AXIS_DESCR
/end CHARACTERISTIC
/begin CHARACTERISTIC D_k_nab "Applizierbarer Wert fuer k_nab" CURVE 0x202090 ZF_TAB_NAT32_S2_S3 20 SAB_K10000_M10_S2_S3 -10 10
 /begin AXIS_DESCR FIX_AXIS NO_INPUT_QUANTITY SAB_STANDARD_S2_S3 20 0 19 FIX_AXIS_PAR_DIST 0 1 20 /end AXIS_DESCR
/end CHARACTERISTIC
/begin CHARACTERISTIC D_k_n6 "Applizierbarer Wert fuer k_n6" CURVE 0x2020E4 ZF_TAB_NAT32_S2_S3 20 SAB_K10000_M10_S2_S3 -10 10
 /begin AXIS_DESCR FIX_AXIS NO_INPUT_QUANTITY SAB_STANDARD_S2_S3 20 0 19 FIX_AXIS_PAR_DIST 0 1 20 /end AXIS_DESCR
/end CHARACTERISTIC
/begin CHARACTERISTIC SWI_NTVIRTGBBZUG "Schalter fuer Auswahl ob waehrend Gegenbremsbetrieb nur Zugfall betrachtet werden soll" VALUE 0x21800A ZF_KW_NAT8_S2_S3 1 SAB_STANDARD_S2_S3 0 1 /end CHARACTERISTIC
/begin CHARACTERISTIC SWI_n_TuVirtOptCalcAlg "0 = Berechnung der virtuellen optimierten Turbinendrehzahl ueber die EM-Drehzahl 1 = Berechnung der virtuellen optimierten Turbinendrehzahl ueber K-Faktoren" VALUE 0x21800B ZF_KW_NAT8_S2_S3 1 SAB_STANDARD_S2_S3 0 1 /end CHARACTERISTIC
/begin CHARACTERISTIC D_k_nab_ntOpt "Applizierbarer k-Faktor" CURVE 0x202138 ZF_TAB_NAT32_S2_S3 20 SAB_K10000_M10_S2_S3 -10 10
 /begin AXIS_DESCR FIX_AXIS NO_INPUT_QUANTITY SAB_STANDARD_S2_S3 32 0 31 FIX_AXIS_PAR_DIST 0 1 32 /end AXIS_DESCR
/end CHARACTERISTIC
/begin CHARACTERISTIC D_k_n6_ntOpt "Applizierbarer k-Faktor" CURVE 0x2021BC ZF_TAB_NAT32_S2_S3 20 SAB_K10000_M10_S2_S3 -10 10
 /begin AXIS_DESCR FIX_AXIS NO_INPUT_QUANTITY SAB_STANDARD_S2_S3 32 0 31 FIX_AXIS_PAR_DIST 0 1 32 /end AXIS_DESCR
/end CHARACTERISTIC
/begin CHARACTERISTIC D_k_ActualGear_ntOpt "Applizierbarer Istgang" CURVE 0x202240 ZF_TAB_NAT8_S2_S3 9 SAB_STANDARD_S2_S3 1 10
 /begin AXIS_DESCR FIX_AXIS NO_INPUT_QUANTITY SAB_STANDARD_S2_S3 32 0 31 FIX_AXIS_PAR_DIST 0 1 32 /end AXIS_DESCR
/end CHARACTERISTIC
/begin CHARACTERISTIC D_k_TargetGear_ntOpt "Applizierbarer Zielgang" CURVE 0x202264 ZF_TAB_NAT8_S2_S3 9 SAB_STANDARD_S2_S3 1 10
 /begin AXIS_DESCR FIX_AXIS NO_INPUT_QUANTITY SAB_STANDARD_S2_S3 32 0 31 FIX_AXIS_PAR_DIST 0 1 32 /end AXIS_DESCR
/end CHARACTERISTIC
/begin CHARACTERISTIC D_t_VerschachtelungAktiv_ntOpt "Zeitdauer fuer die die Drehzahlschwellen ueber- bzw unterschritten werden muessen" VALUE 0x21800C ZF_KW_NAT8_S2_S3 2550 SAB_T_TIMER_10MS_S2_S3 0 2550 /end CHARACTERISTIC
/begin CHARACTERISTIC D_k_v_FzgByNabOld "filtering-factor of GET_VEHICLE_SPEED_BY_NAB" VALUE 0x21800E ZF_KW_NAT8_S2_S3 20 SAB_STANDARD_S2_S3 0 20 /end CHARACTERISTIC
/begin CHARACTERISTIC D_k_v_FzgByNabNew "filtering-factor of GET_VEHICLE_SPEED_BY_NAB" VALUE 0x21800F ZF_KW_NAT8_S2_S3 19 SAB_STANDARD_S2_S3 1 20 /end CHARACTERISTIC
/begin CHARACTERISTIC SWI_v_IstMaxCalc "Switch for selection when GET_VIST_MAX uses maximum-choise 0=not; 1=when nAb to nWheel is unplausible; 2=allways" VALUE 0x218010 ZF_KW_NAT8_S2_S3 2 SAB_STANDARD_S2_S3 0 2 /end CHARACTERISTIC
/begin CHARACTERISTIC D_t_DelayVIstMaxCalc "Delay time when GET_VIST_MAX uses maximum choice after nAb to nWheel gets unplausible" VALUE 0x218011 ZF_KW_NAT8_S2_S3 2550 SAB_T_TIMER_10MS_S2_S3 0 2550 /end CHARACTERISTIC
/begin CHARACTERISTIC SWI_ICM_S_Button "Switch if Sport-Button from ICM is monitored" VALUE 0x217FDB ZF_KW_NAT8_S2_S3 1 SAB_STANDARD_S2_S3 0 1 /end CHARACTERISTIC
/begin CHARACTERISTIC SWI_GWS_DriveLogic "Switch if Sport-Wippen are available or not" VALUE 0x217FDC ZF_KW_NAT8_S2_S3 1 SAB_STANDARD_S2_S3 0 1 /end CHARACTERISTIC
/begin CHARACTERISTIC SWI_GWS_S_Button "Switch if Sport-Button from GWS is monitored" VALUE 0x217FDD ZF_KW_NAT8_S2_S3 1 SAB_STANDARD_S2_S3 0 1 /end CHARACTERISTIC
/begin CHARACTERISTIC D_u_BattLth_INFOHOT1 "batterie voltage threshold as testcondition for KFC_INFOHOT1" VALUE 0x217FDE ZF_KW_NAT8_S2_S3 24 SAB_U_1VOLT_S2_S3 0 24 /end CHARACTERISTIC
/begin CHARACTERISTIC D_u_BattLth_INFOHOT2 "batterie voltage threshold as testcondition for KFC_INFOHOT2" VALUE 0x217FDF ZF_KW_NAT8_S2_S3 24 SAB_U_1VOLT_S2_S3 0 24 /end CHARACTERISTIC
/begin CHARACTERISTIC D_n_EngTuLth_CCHIP "Upper threshold of motor speed or turbine speed" VALUE 0x218218 ZF_KW_NAT16_S2_S3 65535 SAB_N_1RPM_S2_S3 0 65535 /end CHARACTERISTIC
/begin CHARACTERISTIC D_t_DefaultEGSOFF "Default EGS Off time value if calculation failed" VALUE 0x201F8C ZF_KW_NAT32_S2_S3 4.29497E+009 SAB_T_TIMER_1S_S2_S3 0 4294967295 /end CHARACTERISTIC
/begin CHARACTERISTIC SWI_DontLearnInvalidSignal "deactivates: CAN Paddle Learning if the signal is invalid" VALUE 0x217FE6 ZF_KW_NAT8_S2_S3 1 SAB_STANDARD_S2_S3 0 1 /end CHARACTERISTIC
/begin CHARACTERISTIC SWI_ResetPaddleLearned "set f_CANPaddleLearned and f_AnalogPaddleLearned to zero and reset corresponding timer if available" VALUE 0x217FE7 ZF_KW_NAT8_S2_S3 1 SAB_STANDARD_S2_S3 0 1 /end CHARACTERISTIC
/begin CHARACTERISTIC SWI_LearnTip "switches: learning or using fix of tip sources Bit3 = learn Bit2 = reserviert Bit1 = Analog Bit0 = CAN" VALUE 0x217FE8 ZF_KW_NAT8_S2_S3 15 SAB_STANDARD_S2_S3 0 15 /end CHARACTERISTIC
/begin CHARACTERISTIC SWI_DeactivateTipSourceSBW "deactivates the using of SBW tip signals" VALUE 0x217FE9 ZF_KW_NAT8_S2_S3 1 SAB_STANDARD_S2_S3 0 1 /end CHARACTERISTIC
/begin CHARACTERISTIC D_t_debounceAnalogTip "debounce time of the analog tip signal" VALUE 0x217FEA ZF_KW_NAT8_S2_S3 150 SAB_T_TIMER_10MS_S2_S3 0 150 /end CHARACTERISTIC
/begin CHARACTERISTIC D_t_debounceLearnAnalogTip "Time the electrical status of the analog tip paddle must be constant valid - to recognize the analog tip paddle as learned" VALUE 0x217FEB ZF_KW_NAT8_S2_S3 2550 SAB_T_TIMER_10MS_S2_S3 0 2550 /end CHARACTERISTIC
/begin CHARACTERISTIC D_u_BattLth_TIPP "battery-voltage threshold" VALUE 0x218226 ZF_KW_NAT16_S2_S3 20 SAB_U_1VOLT1000_S2_S3 0 20 /end CHARACTERISTIC
/begin CHARACTERISTIC D_t_CANPaddleReceive "shows how often a valid can paddle signal has to be received" VALUE 0x217FEC ZF_KW_NAT8_S2_S3 25500 SAB_T_TIMER_100MS_S2_S3 0 25500 /end CHARACTERISTIC
/begin CHARACTERISTIC D_m_Reserve "Application parameter replacement value for actual torque reserve" VALUE 0x218228 ZF_KW_INT16_S2_S3 1000 SAB_M_1NM_S2_S3 0 1000 /end CHARACTERISTIC
/begin CHARACTERISTIC D_dc_Offset "Offset adjustment of the 10 percent/90 percent threshold" VALUE 0x21800D ZF_KW_NAT8_S2_S3 10 SAB_PROZENT10_S2_S3 0 10 /end CHARACTERISTIC
/begin CHARACTERISTIC D_t_DiagActive_UBATTU "Delay time for suppressing the diagnosis of KFC-UBATTU after engine start up" VALUE 0x218012 ZF_KW_NAT8_S2_S3 2550 SAB_T_TIMER_10MS_S2_S3 0 2550 /end CHARACTERISTIC
/begin CHARACTERISTIC D_t_DiagActive_UBATTL "Delay time for suppressing the diagnosis of KFC-UBATTL after engine start up" VALUE 0x218013 ZF_KW_NAT8_S2_S3 2550 SAB_T_TIMER_10MS_S2_S3 0 2550 /end CHARACTERISTIC
/begin CHARACTERISTIC D_n_EngLth_UBATTU_UBATTL_UBATTO "Engine speed threshold for detecting engine start up (used in the diagnosis of KFC_UBATTU and KFC_UBATTL)" VALUE 0x21823A ZF_KW_NAT16_S2_S3 1920 SAB_N_1RPM_S2_S3 0 1920 /end CHARACTERISTIC
/begin CHARACTERISTIC D_u_BattLth_UBATTU "If the battery voltage is lower than this threshold (depends on CGT) an error code (KFC_UBATTU) is forward filtering" CURVE 0x202288 ZF_KL_NAT16_S2_S3 14 SAB_U_1VOLT1000_S2_S3 6 20
 /begin AXIS_DESCR STD_AXIS NO_INPUT_QUANTITY SAB_C_CGT_1CEL_M40_S2_S3 2 -40 215 DEPOSIT ABSOLUTE MONOTONY MON_INCREASE /end AXIS_DESCR
/end CHARACTERISTIC
/begin CHARACTERISTIC D_u_BattLthFix_UBATTU "If the battery voltage is lower than this threshold (not depends on CGT) an error code (KFC_UBATTU) is forward filtering" VALUE 0x21823C ZF_KW_NAT16_S2_S3 14 SAB_U_1VOLT1000_S2_S3 6 20 /end CHARACTERISTIC
/begin CHARACTERISTIC D_t_Batt_UBATTU "Timer start value for locking time at engine start in position N or P" VALUE 0x21823E ZF_KW_NAT16_S2_S3 2550 SAB_T_TIMER_10MS_S2_S3 0 2550 /end CHARACTERISTIC
/begin CHARACTERISTIC D_u_BattThHys_UBATTL "Hysteresis of Battery voltage for backward filtering of KFC_UBATTL" VALUE 0x218240 ZF_KW_NAT16_S2_S3 10 SAB_U_1VOLT1000_S2_S3 0 10 /end CHARACTERISTIC
/begin CHARACTERISTIC D_u_BattLth_UBATTL "If battery voltage is lower than this threshold an error code (KFC_UBATTL) is forward filtered" VALUE 0x218242 ZF_KW_NAT16_S2_S3 20 SAB_U_1VOLT1000_S2_S3 0 20 /end CHARACTERISTIC
/begin CHARACTERISTIC D_u_BattUth_UBATTO "If the battery voltage is higher than this threshold an error code (KFC_UBATTO) is forward filtering and an jumpstart modus will be activated" VALUE 0x218244 ZF_KW_NAT16_S2_S3 14 SAB_U_1VOLT1000_S2_S3 6 20 /end CHARACTERISTIC
/begin CHARACTERISTIC D_n_EngLThJump "If the engine speed is below this threshold the condition for detecting a jumpstart is fulfilled" VALUE 0x218246 ZF_KW_NAT16_S2_S3 2000 SAB_N_1RPM_S2_S3 0 2000 /end CHARACTERISTIC
/begin CHARACTERISTIC D_n_EngUThJump "If the engine speed is higher than this threshold the reset modus will be activated" VALUE 0x218248 ZF_KW_NAT16_S2_S3 2000 SAB_N_1RPM_S2_S3 0 2000 /end CHARACTERISTIC
/begin CHARACTERISTIC D_tmr_GearSubstLSSOFF "as long as this timer runs the Notganginfo stays valid" VALUE 0x21824A ZF_KW_NAT16_S2_S3 655350 SAB_T_TIMER_10MS_S2_S3 0 655350 /end CHARACTERISTIC
/begin CHARACTERISTIC D_t_JumpstartTh "max time for an active jumpstart" VALUE 0x21824C ZF_KW_NAT16_S2_S3 655350 SAB_T_TIMER_10MS_S2_S3 0 655350 /end CHARACTERISTIC
/begin CHARACTERISTIC SWI_JumpstartN "Switch for Jumpstart in Position N" VALUE 0x218014 ZF_KW_NAT8_S2_S3 1 SAB_STANDARD_S2_S3 0 1 /end CHARACTERISTIC
/begin CHARACTERISTIC D_k_AbOld "Application parameter weighting factor of old values in n_AbFilt1 calculation" VALUE 0x218015 ZF_KW_NAT8_S2_S3 31 SAB_STANDARD_S2_S3 0 31 /end CHARACTERISTIC
/begin CHARACTERISTIC D_k_AbNew "Application parameter weighting factor of new value in n_AbFilt1 calculation" VALUE 0x218016 ZF_KW_NAT8_S2_S3 30 SAB_STANDARD_S2_S3 1 31 /end CHARACTERISTIC
/begin CHARACTERISTIC D_lfz_Wheel "Application parameter of dynamic wheel circumference" VALUE 0x21824E ZF_KW_NAT16_S2_S3 1741 SAB_L_1MM_S2_S3 1000 2741 /end CHARACTERISTIC
/begin CHARACTERISTIC SWI_WheelUseAbsVal "Appplication switch for choosing absolut value of wheel speed (0 = signed; 1 = absolute)" VALUE 0x218017 ZF_KW_NAT8_S2_S3 1 SAB_STANDARD_S2_S3 0 1 /end CHARACTERISTIC
/begin CHARACTERISTIC SWI_WheelActivePassive "Switch for selection of driven axle 0=no axle; 1=front wheel drive; 2=rear wheel drive; 3=fourwheel drive" VALUE 0x218018 ZF_KW_NAT8_S2_S3 3 SAB_STANDARD_S2_S3 0 3 /end CHARACTERISTIC
/begin CHARACTERISTIC SWI_Zf_Application_Can "switch for the AZG activation 1 = AZG active; 0 = AZG inactive" VALUE 0x217F4C ZF_KW_NAT8_S2_S3 1 SAB_STANDARD_S2_S3 0 1 /end CHARACTERISTIC
/begin CHARACTERISTIC SWI_morethan255KFCs "use at the initialisation of user-specific error-codes for textual error display one or two bytes (AZGcmd 0x0E)(1 = read error codes with 2 bytes; 0 = provide AZG text for max 255 error codes)" VALUE 0x217F4D ZF_KW_NAT8_S2_S3 1 SAB_STANDARD_S2_S3 0 1 /end CHARACTERISTIC
/begin CHARACTERISTIC SWI_Zf_Edicmobil_Can "switch for the EDIC activation 1 = EDIC active; 0 = EDIC inactive" VALUE 0x217F4E ZF_KW_NAT8_S2_S3 1 SAB_STANDARD_S2_S3 0 1 /end CHARACTERISTIC
/begin CHARACTERISTIC D_Tab_Azgkng "Application parameter for TCU-identifier/EGS-Kennung (0-200: Inhalt aus D_Tab_Azgkng wird als ASCII-Zeichen in die EGS-Kennung uebernommen; 201-224: Position eines Zeichens aus der 43-Softwarestandskennung (SW_STAND_ZFF) = applizierter_Wert minus 201)" CURVE 0x201B10 ZF_TAB_NAT8_S2_S3 255 SAB_STANDARD_S2_S3 0 255
 /begin AXIS_DESCR FIX_AXIS NO_INPUT_QUANTITY SAB_STANDARD_S2_S3 14 0 13 FIX_AXIS_PAR_DIST 0 1 14 /end AXIS_DESCR
/end CHARACTERISTIC
/begin CHARACTERISTIC SWI_RpmDynOut "Switch for enabling dynamic revolution counter data" VALUE 0x217FAF ZF_KW_NAT8_S2_S3 1 SAB_STANDARD_S2_S3 0 1 /end CHARACTERISTIC
/begin CHARACTERISTIC SWI_SetOut0_DitherActive "activation dither functionality for output 0" VALUE 0x217F5E ZF_KW_NAT8_S2_S3 1 SAB_STANDARD_S2_S3 0 1 /end CHARACTERISTIC
/begin CHARACTERISTIC SWI_SetOut1_DitherActive "activation dither functionality for output 1" VALUE 0x217F5F ZF_KW_NAT8_S2_S3 1 SAB_STANDARD_S2_S3 0 1 /end CHARACTERISTIC
/begin CHARACTERISTIC SWI_SetOut2_DitherActive "activation dither functionality for output 2" VALUE 0x217F60 ZF_KW_NAT8_S2_S3 1 SAB_STANDARD_S2_S3 0 1 /end CHARACTERISTIC
/begin CHARACTERISTIC SWI_SetOut3_DitherActive "activation dither functionality for output 3" VALUE 0x217F61 ZF_KW_NAT8_S2_S3 1 SAB_STANDARD_S2_S3 0 1 /end CHARACTERISTIC
/begin CHARACTERISTIC SWI_SetOut4_DitherActive "activation dither functionality for output 4" VALUE 0x217F62 ZF_KW_NAT8_S2_S3 1 SAB_STANDARD_S2_S3 0 1 /end CHARACTERISTIC
/begin CHARACTERISTIC SWI_SetOut5_DitherActive "activation dither functionality for output 5" VALUE 0x217F63 ZF_KW_NAT8_S2_S3 1 SAB_STANDARD_S2_S3 0 1 /end CHARACTERISTIC
/begin CHARACTERISTIC SWI_SetOut6_DitherActive "activation dither functionality for output 6" VALUE 0x217F64 ZF_KW_NAT8_S2_S3 1 SAB_STANDARD_S2_S3 0 1 /end CHARACTERISTIC
/begin CHARACTERISTIC SWI_SetOut7_DitherActive "activation dither functionality for output 7" VALUE 0x217F65 ZF_KW_NAT8_S2_S3 1 SAB_STANDARD_S2_S3 0 1 /end CHARACTERISTIC
/begin CHARACTERISTIC D_t_HssOff "Delay time of st_HssOff before recognition of the mechanical emergency run" VALUE 0x218118 ZF_KW_NAT16_S2_S3 2550 SAB_T_10MS_S2_S3 0 2550 /end CHARACTERISTIC
/begin CHARACTERISTIC D_t_GetFet0Undervoltage "Delay time for the output of the information whether the mechanical emergency runs or not" VALUE 0x21811A ZF_KW_NAT16_S2_S3 500 SAB_T_10MS_S2_S3 0 500 /end CHARACTERISTIC
/begin CHARACTERISTIC D_t_ZeroCurrentFeed "Delay time after which the OUTs 0 to 7 are set on 0mA" VALUE 0x21811C ZF_KW_NAT16_S2_S3 500 SAB_T_10MS_S2_S3 0 500 /end CHARACTERISTIC
/begin CHARACTERISTIC D_n_ZeroCurrentFeedLth "Engine speed threshold for recognition that the motor runs when Lss is not fed" VALUE 0x21811E ZF_KW_NAT16_S2_S3 11000 SAB_N_RPM_S2_S3 0 11000 /end CHARACTERISTIC
/begin CHARACTERISTIC SWI_CalcLimpHomeLssOff "Switch to select the specification: 0 = Old Spec: Computation of limp-home state in ASIL-B HSS state is available in ASIL-B LSS state is max. ASIl-A 1 = New Spec: Computation of limp-home state in ASIL-C Both HSS and LSS are available in ASIL-B" VALUE 0x217F66 ZF_KW_NAT8_S2_S3 1 SAB_STANDARD_S2_S3 0 1 /end CHARACTERISTIC
/begin CHARACTERISTIC D_u_BattLimphomeLth "Lower threshold for recognition of the mechanical emergency run." VALUE 0x218120 ZF_KW_NAT16_S2_S3 24 SAB_U_VOLT1000_S2_S3 0 24 /end CHARACTERISTIC
/begin CHARACTERISTIC D_u_BattLimphomeUth "Upper threshold for recognition of the mechanical emergency run." VALUE 0x218122 ZF_KW_NAT16_S2_S3 24 SAB_U_VOLT1000_S2_S3 0 24 /end CHARACTERISTIC
/begin CHARACTERISTIC D_HWVersion_LINIEP "Hardware version of IEP: vvvm.msss vvv:b001=IEP85 b010=IEP400.1 b011=IEP400.2 mm:b00=A-b01=B-b10=C-b11=D-Muster sss:musterstand 0-7" VALUE 0x217F67 ZF_KW_NAT8_S2_S3 255 SAB_STANDARD_S2_S3 0 255 /end CHARACTERISTIC
/begin CHARACTERISTIC D_HWVersionMask_LINIEP "Hardware version mask of IEP: vvvm.msss eg. 0xE0 evaluates main version only" VALUE 0x217F68 ZF_KW_NAT8_S2_S3 255 SAB_STANDARD_S2_S3 0 255 /end CHARACTERISTIC
/begin CHARACTERISTIC D_SWVersion_LINIEP "Software version of IEP: vvvh.hhhh.nnnn.nnnn vvv:b001=IEP85 b010=IEP400.1 b011=IEP400.2 h:0..31 Hauptversion n:0..255 Nebenversion" VALUE 0x218124 ZF_KW_NAT16_S2_S3 65535 SAB_STANDARD_S2_S3 0 65535 /end CHARACTERISTIC
/begin CHARACTERISTIC D_SWVersionMask_LINIEP "Software version mask of IEP: vvvh.hhhh.nnnn.nnnn eg. 0xE000 evaluates main version only" VALUE 0x218126 ZF_KW_NAT16_S2_S3 65535 SAB_STANDARD_S2_S3 0 65535 /end CHARACTERISTIC
/begin CHARACTERISTIC D_t_AfterRunLINIEP "Time the IEP continues to runs after it has lost the LIN communication" VALUE 0x217F69 ZF_KW_NAT8_S2_S3 255 SAB_T_1MIN_S2_S3 0 255 /end CHARACTERISTIC
/begin CHARACTERISTIC D_MaxRxMsgLINIEP "Maximum count of LIN Rx Messages." VALUE 0x217F6A ZF_KW_NAT8_S2_S3 3 SAB_STANDARD_S2_S3 0 3 /end CHARACTERISTIC
/begin CHARACTERISTIC D_MaxTxMsgLINIEP "Maximum count of LIN Tx Messages." VALUE 0x217F6B ZF_KW_NAT8_S2_S3 2 SAB_STANDARD_S2_S3 0 2 /end CHARACTERISTIC
/begin CHARACTERISTIC D_RxID_IndexLINIEP "List of non Protected LIN Message ID numbers identifying the receive messages. 0xFE is used to identify a non used entry and the end of list" CURVE 0x201DB0 ZF_KL_NAT8_S2_S3 255 SAB_STANDARD_S2_S3 0 255
 /begin AXIS_DESCR STD_AXIS NO_INPUT_QUANTITY SAB_STANDARD_S2_S3 8 0 7 DEPOSIT ABSOLUTE MONOTONY MON_INCREASE /end AXIS_DESCR
/end CHARACTERISTIC
/begin CHARACTERISTIC D_TxID_IndexLINIEP "List of non Protected LIN Message ID numbers identifying the transmit messages. 0xFE is used to identify a non used entry and the end of list. 53 provides 0xFF to identify a wrong configuration" CURVE 0x201DC4 ZF_KL_NAT8_S2_S3 255 SAB_STANDARD_S2_S3 0 255
 /begin AXIS_DESCR STD_AXIS NO_INPUT_QUANTITY SAB_STANDARD_S2_S3 8 0 7 DEPOSIT ABSOLUTE MONOTONY MON_INCREASE /end AXIS_DESCR
/end CHARACTERISTIC
/begin CHARACTERISTIC D_MaskLinEPumpErr_LINIEP "Bit masks for the LIN EPumpErr Output Makro 0 = Bit0 = IEP_TEMPORARY_FAILURE 1 = Bit1 = IEP_PERMANENT_FAILURE 2 = Bit2 = IEP_COMMUNICATION_FAILURE Mask is ANDed with ctl_IEP_Status." CURVE 0x201DD8 ZF_KL_NAT32_S2_S3 4.29497E+009 SAB_STANDARD_S2_S3 0 4294967295
 /begin AXIS_DESCR STD_AXIS NO_INPUT_QUANTITY SAB_STANDARD_S2_S3 3 0 3 DEPOSIT ABSOLUTE MONOTONY MON_INCREASE /end AXIS_DESCR
/end CHARACTERISTIC
/begin CHARACTERISTIC D_ComErrorMask_LINIEP "Bit masks for detecting communication errors of the max 8 n*Tx+m*Rx n+m=8 IEP messages. The error information is retrived from GET_BUS_DISTURBANCE and GETBUS2_RX_STATUS. 0x0000=LIN com diag off. 0x0200=CRC8 0x0100=BusOff. Low byte correspondends to RX_..." CURVE 0x201DF4 ZF_KL_NAT16_S2_S3 65535 SAB_STANDARD_S2_S3 0 65535
 /begin AXIS_DESCR STD_AXIS NO_INPUT_QUANTITY SAB_STANDARD_S2_S3 8 0 7 DEPOSIT ABSOLUTE MONOTONY MON_INCREASE /end AXIS_DESCR
 /begin ANNOTATION ANNOTATION_LABEL "Description"
  /begin ANNOTATION_TEXT "Bit masks for detecting communication errors of the max 8 n*Tx+m*Rx n+m=8 IEP messages. The error information is retrived from GET_BUS_DISTURBANCE and GETBUS2_RX_STATUS. 0x0000=LIN com diag off. 0x0200=CRC8 0x0100=BusOff. Low byte correspondends to RX_STA" "TUS." /end ANNOTATION_TEXT
 /end ANNOTATION
/end CHARACTERISTIC
/begin CHARACTERISTIC D_ZIELVORGABE2TargetOpPoint_LINIEP "Mapping of GET_IEP_ZIELVORGABE 0..4 to target operation point values used by IEP" CURVE 0x201E18 ZF_KL_NAT8_S2_S3 255 SAB_STANDARD_S2_S3 0 255
 /begin AXIS_DESCR STD_AXIS NO_INPUT_QUANTITY SAB_STANDARD_S2_S3 5 0 4 DEPOSIT ABSOLUTE MONOTONY MON_INCREASE /end AXIS_DESCR
/end CHARACTERISTIC
/begin CHARACTERISTIC D_ActualOpPoint2IEP_STATE_LINIEP "Mapping of actual operation point returned by IEP 0x33=BP3=LP3=4 0x55=BP1=LP1=2 0xAA=BP0=OFF=0 0xCC=BP2=LP2=3 ascending order of value to GET_IEP_STATE 0..4 used by ATSYS" CURVE 0x201E28 ZF_KL_NAT8_S2_S3 255 SAB_STANDARD_S2_S3 0 255
 /begin AXIS_DESCR STD_AXIS NO_INPUT_QUANTITY SAB_STANDARD_S2_S3 4 0 255 DEPOSIT ABSOLUTE MONOTONY MON_INCREASE /end AXIS_DESCR
/end CHARACTERISTIC
/begin CHARACTERISTIC D_cntBUS2_MaxInvalidCRC8_LINIEP "Maximum count of consecutive received LIN Messages with wrong CRC8 values whithin the data until the error bit is set. 0xFF: Switch off Rx CRC8 check" VALUE 0x217F6C ZF_KW_NAT8_S2_S3 255 SAB_STANDARD_S2_S3 0 255 /end CHARACTERISTIC
/begin CHARACTERISTIC D_cntBUS2_MaxStuckAlv_LINIEP "Maximum count of consecutive received LIN Messages with the same alive counter value. 0xFF: Switch off Rx alive counter stuck check" VALUE 0x217F6D ZF_KW_NAT8_S2_S3 255 SAB_STANDARD_S2_S3 0 255 /end CHARACTERISTIC
/begin CHARACTERISTIC D_cntBUS2_MaxIncAlv_LINIEP "Maximum increment of alive counter between 2 consecutive received LIN Messages. 0xFF: Switch off Rx alive counter max increment check" VALUE 0x217F6E ZF_KW_NAT8_S2_S3 255 SAB_STANDARD_S2_S3 0 255 /end CHARACTERISTIC
/begin CHARACTERISTIC SWI_IEP_Verbaut "Configuration of used IEP: 0=no IEP available 1=PWM IEP 2=LIN IEP" VALUE 0x217F6F ZF_KW_NAT8_S2_S3 2 SAB_STANDARD_S2_S3 0 2 /end CHARACTERISTIC
/begin CHARACTERISTIC D_MaskKFC_IEPHW_LINIEP "Bitmasks for global Status and KFC_IEPHW 0 = Init Diagnosis 1= Cyclic Diagnosis 2 = BP > 0 Diagnosis" CURVE 0x201E34 ZF_KL_NAT32_S2_S3 4.29497E+009 SAB_STANDARD_S2_S3 0 4294967295
 /begin AXIS_DESCR STD_AXIS NO_INPUT_QUANTITY SAB_STANDARD_S2_S3 3 0 2 DEPOSIT ABSOLUTE MONOTONY MON_INCREASE /end AXIS_DESCR
/end CHARACTERISTIC
/begin CHARACTERISTIC D_MaskKFC1_IEPROTORSENS_LINIEP "Bitmask for global Satus and KFC1_IEPROTORSENS x00 = KFC inactive" VALUE 0x201E50 ZF_KW_NAT32_S2_S3 4.29497E+009 SAB_STANDARD_S2_S3 0 4294967295 /end CHARACTERISTIC
/begin CHARACTERISTIC D_MaskKFC2_IEPROTORSENS_LINIEP "Bitsmask for KFC2_IEPROTORSENS in global Satus x00 = KFC inactive" VALUE 0x201E54 ZF_KW_NAT32_S2_S3 4.29497E+009 SAB_STANDARD_S2_S3 0 4294967295 /end CHARACTERISTIC
/begin CHARACTERISTIC D_MaskKFC3_IEPROTORSENS_LINIEP "Bitmask for KFC3_IEPROTORSENS in global Status x00 = KFC inactive" VALUE 0x201E58 ZF_KW_NAT32_S2_S3 4.29497E+009 SAB_STANDARD_S2_S3 0 4294967295 /end CHARACTERISTIC
/begin CHARACTERISTIC D_MaskKFC_IEPCOM_LINIEP "Bitmask for KFC_IEPCOM in global Status x00 = KFC inactive" VALUE 0x201E5C ZF_KW_NAT32_S2_S3 4.2949E+009 SAB_STANDARD_S2_S3 0 4294901760 /end CHARACTERISTIC
/begin CHARACTERISTIC D_MaskKFC_IEPBUS_LINIEP "Bitmask for KFC_IEPBUS in global Status x00 = KFC inactive" VALUE 0x201E60 ZF_KW_NAT32_S2_S3 65535 SAB_STANDARD_S2_S3 0 65535 /end CHARACTERISTIC
/begin CHARACTERISTIC D_MaskKFC_IEPINFO_LINIEP "Bitmask for KFC_IEPINFO and global Status ctl_status" VALUE 0x201E64 ZF_KW_NAT32_S2_S3 4.29497E+009 SAB_STANDARD_S2_S3 0 4294967295 /end CHARACTERISTIC
/begin CHARACTERISTIC D_MaskKFC1_IEPINFO_LINIEP "Bitmask for KFC1_IEPINFO and global Status ctl_IEP_Status Also used to check if Clear Error-command shall be send to IEP when limp home mode gets inactive x00 = KFC inactive" VALUE 0x201E68 ZF_KW_NAT32_S2_S3 4.29497E+009 SAB_STANDARD_S2_S3 0 4294967295 /end CHARACTERISTIC
/begin CHARACTERISTIC D_MaskKFC_IEPVOLTAGE_LINIEP "Bitsmask for KFC_IEPVOLTAGE and global Status ctl_IEP_Status" VALUE 0x201E6C ZF_KW_NAT32_S2_S3 4.29497E+009 SAB_STANDARD_S2_S3 0 4294967295 /end CHARACTERISTIC
/begin CHARACTERISTIC D_Lth_KFC1_IEPTEMPSENS_LINIEP "Lower threshold for short to ground detection of IEP temperature sensor 0x00 = threshold disabled" VALUE 0x217F70 ZF_KW_NAT8_S2_S3 255 SAB_STANDARD_S2_S3 0 255 /end CHARACTERISTIC
/begin CHARACTERISTIC D_Uth_KFC2_IEPTEMPSENS_LINIEP "Upper threshold for short to VCC detection of IEP temperature sensor 0xFF = threshold disabled" VALUE 0x217F71 ZF_KW_NAT8_S2_S3 255 SAB_STANDARD_S2_S3 0 255 /end CHARACTERISTIC
/begin CHARACTERISTIC D_MaskKFC_IEPLEV2_LINIEP "Bitsmask for KFC_IEPLEV2 and global Status ctl_IEP_Status" VALUE 0x201E70 ZF_KW_NAT32_S2_S3 4.29497E+009 SAB_STANDARD_S2_S3 0 4294967295 /end CHARACTERISTIC
/begin CHARACTERISTIC D_MaskKFC_IEPVERSION_LINIEP "Bitsmask for KFC_IEPVERSION and global Status ctl_IEP_Status" VALUE 0x201E74 ZF_KW_NAT32_S2_S3 4.29497E+009 SAB_STANDARD_S2_S3 0 4294967295 /end CHARACTERISTIC
/begin CHARACTERISTIC SWI_IEP_CALID_CVN "Switch to decide if the IEP CVN and CALID of Integrated Electrical Pump is used" VALUE 0x217F72 ZF_KW_NAT8_S2_S3 1 SAB_STANDARD_S2_S3 0 1 /end CHARACTERISTIC
/begin CHARACTERISTIC D_k_UtoC_TEMPSENS_LINIEP "Temperature interplolation curve for IEP temperature sensor" CURVE 0x201E78 ZF_KL_INT16_S2_S3 550 SAB_STANDARD_S2_S3 -50 500
 /begin AXIS_DESCR STD_AXIS NO_INPUT_QUANTITY SAB_STANDARD_S2_S3 8 0 255 DEPOSIT ABSOLUTE MONOTONY MON_INCREASE /end AXIS_DESCR
/end CHARACTERISTIC
/begin CHARACTERISTIC D_MinSwVersionWarmUp_LINIEP "Minimum software version of IEP for which the warm-up function is available. First row is the variant number: 1=IEP85 2=IEP400.1 3=IEP400.2 4=not used" MAP 0x201E9C ZF_TAB2D_NAT16_S2_S3 65535 SAB_STANDARD_S2_S3 0 65535
 /begin AXIS_DESCR FIX_AXIS NO_INPUT_QUANTITY SAB_STANDARD_S2_S3 4 0 3 FIX_AXIS_PAR_DIST 0 1 4 /end AXIS_DESCR
 /begin AXIS_DESCR FIX_AXIS NO_INPUT_QUANTITY SAB_STANDARD_S2_S3 2 0 1 FIX_AXIS_PAR_DIST 0 1 2 /end AXIS_DESCR
/end CHARACTERISTIC
/begin CHARACTERISTIC D_t_DiagDelayAfterClearErr_LINIEP "Time to enable normal diagnosis after IEP ClearError-Command was sent to IEP." VALUE 0x217F73 ZF_KW_NAT8_S2_S3 2550 SAB_T_10MS_S2_S3 0 2550 /end CHARACTERISTIC
/begin CHARACTERISTIC D_t_DelayAfterIepWarmUpErr_LINIEP "Delay time after IEP WarmUp-Function error until the errors in IEP are Reset." VALUE 0x218128 ZF_KW_NAT16_S2_S3 65535 SAB_T_S_S2_S3 0 65535 /end CHARACTERISTIC
/begin CHARACTERISTIC D_t_DelayKFC_IEPBUS_LINIEP "Delay timer for monitoring of LIN-Bus between TCU and LIN-IEP KFC_IEPBUS" VALUE 0x217F74 ZF_KW_NAT8_S2_S3 2550 SAB_T_10MS_S2_S3 0 2550 /end CHARACTERISTIC
/begin CHARACTERISTIC D_MaskLinEPumpErrSuppressLinOff_LINIEP "Bit masks to suppress erros on interface GET_LIN_EPUMP_ERR while LIN is not active." VALUE 0x201EB4 ZF_KW_NAT32_S2_S3 4.29497E+009 SAB_STANDARD_S2_S3 0 4294967295 /end CHARACTERISTIC
/begin CHARACTERISTIC D_t_KMN_LINBUSOFF_Delay "Delay time for cutoff LIN communication after KMN_LINBUSOFF" VALUE 0x217F75 ZF_KW_NAT8_S2_S3 255 SAB_T_S_S2_S3 0 255 /end CHARACTERISTIC
/begin CHARACTERISTIC D_t_IEPSleepDelay "Delay time for IEPSleepMode" VALUE 0x21812A ZF_KW_NAT16_S2_S3 655.35 SAB_T_S100_S2_S3 0 655.35 /end CHARACTERISTIC
/begin CHARACTERISTIC SWI_OBD_PFC_ACTIVATION "Mode of PFC activation 0: Neutral Routine Control and Distance check for activation of OBD PFC entries in EH 1: Activate OBD PFC entries in EH 2: Deactivate distance check for activation of OBD PFC entries in EH" VALUE 0x217F76 ZF_KW_NAT8_S2_S3 2 SAB_STANDARD_S2_S3 0 2 /end CHARACTERISTIC
/begin CHARACTERISTIC D_t_DeactivatePfcTh "Time threshold for PFC deactivation. When mileage is above 250km as long as this threshold the PFC will be deactivated Depending also on SWI_OBD_PFC_ACTIVATION ." VALUE 0x217F77 ZF_KW_NAT8_S2_S3 255 SAB_T_S_S2_S3 0 255 /end CHARACTERISTIC
/begin CHARACTERISTIC D_Adr_Of_LIN_IEP_Image "Parameter for the start adress where the IEP program code has to be transfered from to the IEP controller" VALUE 0x201EB8 ZF_KW_NAT32_S2_S3 4.29497E+009 SAB_STANDARD_S2_S3 0 4294967295 /end CHARACTERISTIC
/begin CHARACTERISTIC D_Size_Of_LIN_IEP_Image "Number of bytes that have to be read from the start address" VALUE 0x21812C ZF_KW_NAT16_S2_S3 65535 SAB_STANDARD_S2_S3 0 65535 /end CHARACTERISTIC
/begin CHARACTERISTIC SWI_FlashLIN_IEP_Preconditions "Parameter for activating conditions of fashing the LIN-IEP. if bit is set the corresponding condition has to be fulfilled For the conditions see ZF8_PreconditionsAllg.doc ." VALUE 0x21812E ZF_KW_NAT16_S2_S3 65535 SAB_STANDARD_S2_S3 0 65535 /end CHARACTERISTIC
/begin CHARACTERISTIC SWI_FlashLIN_IEP_StartProgramming "Manual start of the flash programming by setting value from 0x55 to 0xAA" VALUE 0x217F78 ZF_KW_NAT8_S2_S3 255 SAB_STANDARD_S2_S3 0 255 /end CHARACTERISTIC
/begin CHARACTERISTIC D_x_ZfDataMechatronicOff "Address offset to mechatronic production data relative to base address of 43-Segment." VALUE 0x201EBC ZF_KW_NAT32_S2_S3 4.29497E+009 SAB_STANDARD_S2_S3 0 4294967295 /end CHARACTERISTIC
/begin CHARACTERISTIC D_x_ZfDataGearboxOff "Address offset to gearbox production data relative to base address of 43-Segment." VALUE 0x201EC0 ZF_KW_NAT32_S2_S3 4.29497E+009 SAB_STANDARD_S2_S3 0 4294967295 /end CHARACTERISTIC
/begin CHARACTERISTIC D_x_ZfDataCrcOff "Address offset to CRC data relative to start address of mechatronic or gearbox production data." VALUE 0x201EC4 ZF_KW_NAT32_S2_S3 4.29497E+009 SAB_STANDARD_S2_S3 0 4294967295 /end CHARACTERISTIC
/begin CHARACTERISTIC SWI_ExtCondASCReg "Extended conditions for ASCReg" VALUE 0x217F7F ZF_KW_NAT8_S2_S3 1 SAB_STANDARD_S2_S3 0 1 /end CHARACTERISTIC
/begin CHARACTERISTIC D_t_DiagDelPOSSBW "Time threshold since the ignition switched on after which the monitoring of KFC_POSSBW has to start." VALUE 0x2181A2 ZF_KW_NAT16_S2_S3 655350 SAB_T_10MS_S2_S3 0 655350 /end CHARACTERISTIC
/begin CHARACTERISTIC D_u_BattLth_PARKASSIST "Battery-voltage as threshold for KFC_PARKASSIST" VALUE 0x2181D2 ZF_KW_NAT16_S2_S3 24 SAB_U_VOLT1000_S2_S3 0 24 /end CHARACTERISTIC
/begin CHARACTERISTIC SWI_TransportMode "Activate or deactive the transport mode computation: 0=trans mode is deactivated 1=trans mode depends on input 2=trans mode is always activated" VALUE 0x217FF2 ZF_KW_NAT8_S2_S3 2 SAB_STANDARD_S2_S3 0 2 /end CHARACTERISTIC
/begin CHARACTERISTIC D_n_Ab_CalcMethodLth "Application parameter for upper threshold of gearbox reinforcement above n_Tu/n_Ab ratio is used" VALUE 0x21829E ZF_KW_NAT16_S3_S3 65535 SAB2_N_1RPM_S3_S3 0 65535 /end CHARACTERISTIC
/begin CHARACTERISTIC D_n_Ab_CalcMethodUth "Application parameter for lower threshold of gearbox reinforcement below n_Tu/n_Ab ratio is used" VALUE 0x2182A0 ZF_KW_NAT16_S3_S3 65535 SAB2_N_1RPM_S3_S3 0 65535 /end CHARACTERISTIC
/begin CHARACTERISTIC D_GearboxReinforcementFactor "Application parameter to change output quantization factor of gearbox reinforcement" VALUE 0x2182A2 ZF_KW_NAT16_S3_S3 7158 SAB2_STANDARD_S3_S3 10 7168 /end CHARACTERISTIC
/begin CHARACTERISTIC SWI_GearboxReinforcement_Err "Application parameter to activate error check" VALUE 0x21801D ZF_KW_NAT8_S3_S3 15 SAB2_STANDARD_S3_S3 0 15 /end CHARACTERISTIC
/begin CHARACTERISTIC D_GbxReinforcementMin "Application parameter for minimal value of gearbox reinforcement" VALUE 0x2182A4 ZF_KW_NAT16_S3_S3 127 SAB2_K8_S3_S3 0 127 /end CHARACTERISTIC
/begin CHARACTERISTIC D_GbxReinforcementMax "Application parameter for maximal value of gearbox reinforcement" VALUE 0x2182A6 ZF_KW_NAT16_S3_S3 127 SAB2_K8_S3_S3 0 127 /end CHARACTERISTIC
/begin CHARACTERISTIC SWI_GearboxReinforcementCalculation "Switch between types of gearbox reinforcement calculation." VALUE 0x21801E ZF_KW_NAT8_S3_S3 1 SAB2_STANDARD_S3_S3 0 1 /end CHARACTERISTIC
/begin CHARACTERISTIC D_GearboxReinforcementDef "Substitute value if no valid input." VALUE 0x2182A8 ZF_KW_NAT16_S3_S3 8191.88 SAB2_K8_S3_S3 0 8191.875 /end CHARACTERISTIC
/begin CHARACTERISTIC D_GearboxReinforcementDefSts "Status substitute value if no valid input." VALUE 0x21801F ZF_KW_NAT8_S3_S3 2 SAB2_STANDARD_S3_S3 0 2 /end CHARACTERISTIC
/begin CHARACTERISTIC D_GearboxReinforcementErr "Error value for invalid input signal." VALUE 0x2182AA ZF_KW_NAT16_S3_S3 8191.88 SAB2_K8_S3_S3 0 8191.875 /end CHARACTERISTIC
/begin CHARACTERISTIC SWI_PuCalc "Application switch for calculation of m_PumpCensored (0 = calculation off 1 calculation on)" VALUE 0x218023 ZF_KW_NAT8_S3_S3 1 SAB2_STANDARD_S3_S3 0 1 /end CHARACTERISTIC
/begin CHARACTERISTIC SWI_ChangeOfGear "Switch to deactivate RPM equality check during gear change" VALUE 0x218024 ZF_KW_NAT8_S3_S3 3 SAB2_STANDARD_S3_S3 0 3 /end CHARACTERISTIC
/begin CHARACTERISTIC SWI_UseDampgCanSignal "Switch to fill GETCAN_TX_RQ_DEAC_ACV_DMPNG_PT" VALUE 0x218025 ZF_KW_NAT8_S3_S3 1 SAB2_STANDARD_S3_S3 0 1 /end CHARACTERISTIC
/begin CHARACTERISTIC D_n_EngLth_SABLev2 "Application parameter for value of motor rotation speed limit." VALUE 0x21829C ZF_KW_NAT16_S3_S3 11000 SAB2_STANDARD_S3_S3 0 11000 /end CHARACTERISTIC
/begin CHARACTERISTIC SWI_EzaDecision "switch for EZA switching: 0 = EZA switch off; 1 = EZA switch on" VALUE 0x218019 ZF_KW_NAT8_S3_S3 1 SAB2_STANDARD_S3_S3 0 1 /end CHARACTERISTIC
/begin CHARACTERISTIC D_KMN_DiagnosticFunctCAN1 "Parameter to define which error measures codes between 0 and 31 lead to: K0 is not open" VALUE 0x2022B0 ZF_KW_NAT32_S3_S3 4.29497E+009 SAB2_STANDARD_S3_S3 0 4294967295 /end CHARACTERISTIC
/begin CHARACTERISTIC D_KMN_DiagnosticFunctCANHi1 "Parameter to define which error measures codes between 32 and 63 lead to: K0 is not open" VALUE 0x2022B4 ZF_KW_NAT32_S3_S3 4.29497E+009 SAB2_STANDARD_S3_S3 0 4294967295 /end CHARACTERISTIC
/begin CHARACTERISTIC D_KMN_DiagnosticFunctCAN2 "Parameter to define which error measures codes between 0 and 31 lead to: K0 is not close" VALUE 0x2022B8 ZF_KW_NAT32_S3_S3 4.29497E+009 SAB2_STANDARD_S3_S3 0 4294967295 /end CHARACTERISTIC
/begin CHARACTERISTIC D_KMN_DiagnosticFunctCANHi2 "Parameter to define which error measures codes between 32 and 63 lead to: K0 is not close / slip monitoring" VALUE 0x2022BC ZF_KW_NAT32_S3_S3 4.29497E+009 SAB2_STANDARD_S3_S3 0 4294967295 /end CHARACTERISTIC
/begin CHARACTERISTIC D_KMN_DiagnosticFunctCAN5 "Parameter to define which error measures codes between 0 and 31 lead to: HAS run impossible" VALUE 0x2022C0 ZF_KW_NAT32_S3_S3 4.29497E+009 SAB2_STANDARD_S3_S3 0 4294967295 /end CHARACTERISTIC
/begin CHARACTERISTIC D_KMN_DiagnosticFunctCANHi5 "Parameter to define which error measures codes between 32 and 63 lead to: HAS run impossible" VALUE 0x2022C4 ZF_KW_NAT32_S3_S3 4.29497E+009 SAB2_STANDARD_S3_S3 0 4294967295 /end CHARACTERISTIC
/begin CHARACTERISTIC D_KMN_DiagnosticFunctCAN8 "Parameter to define which error measures codes between 0 and 31 lead to: by-passed run" VALUE 0x2022C8 ZF_KW_NAT32_S3_S3 4.29497E+009 SAB2_STANDARD_S3_S3 0 4294967295 /end CHARACTERISTIC
/begin CHARACTERISTIC D_KMN_DiagnosticFunctCANHi8 "Parameter to define which error measures codes between 32 and 63 lead to: by-passed run" VALUE 0x2022CC ZF_KW_NAT32_S3_S3 4.29497E+009 SAB2_STANDARD_S3_S3 0 4294967295 /end CHARACTERISTIC
/begin CHARACTERISTIC D_KMN_DiagnosticFunctCAN9 "Parameter to define mask for lower 32 bits of error codes" VALUE 0x2022D0 ZF_KW_NAT32_S3_S3 4.29497E+009 SAB2_STANDARD_S3_S3 0 4294967295 /end CHARACTERISTIC
/begin CHARACTERISTIC D_KMN_DiagnosticFunctCANHi9 "Parameter to define mask for upper 32 bits of error codes" VALUE 0x2022D4 ZF_KW_NAT32_S3_S3 4.29497E+009 SAB2_STANDARD_S3_S3 0 4294967295 /end CHARACTERISTIC
/begin CHARACTERISTIC D_KMN_DiagnosticFunctCAN10 "Parameter to define mask for lower 32 bits of error codes" VALUE 0x2022D8 ZF_KW_NAT32_S3_S3 4.29497E+009 SAB2_STANDARD_S3_S3 0 4294967295 /end CHARACTERISTIC
/begin CHARACTERISTIC D_KMN_DiagnosticFunctCANHi10 "Parameter to define mask for upper 32 bits of error codes" VALUE 0x2022DC ZF_KW_NAT32_S3_S3 4.29497E+009 SAB2_STANDARD_S3_S3 0 4294967295 /end CHARACTERISTIC
/begin CHARACTERISTIC D_TX_ValueForLimphomeElectrical "Coding of electrical limphome" VALUE 0x21801A ZF_KW_NAT8_S3_S3 255 SAB2_STANDARD_S3_S3 0 255 /end CHARACTERISTIC
/begin CHARACTERISTIC D_TX_ValueForLimphomeEmSigErr "Coding of EM-signal error" VALUE 0x21801B ZF_KW_NAT8_S3_S3 255 SAB2_STANDARD_S3_S3 0 255 /end CHARACTERISTIC
/begin CHARACTERISTIC D_TX_ValueForLimphome "Coding of mechanical limphome" VALUE 0x21801C ZF_KW_NAT8_S3_S3 255 SAB2_STANDARD_S3_S3 0 255 /end CHARACTERISTIC
/begin CHARACTERISTIC D_t_freeze_mgt_Aufn_CAN "Debounce time for signal states" VALUE 0x2182AC ZF_KW_NAT16_S3_S3 655000 SAB2_T_TIMER_10MS_S3_S3 0 655000 /end CHARACTERISTIC
/begin CHARACTERISTIC D_Status_K0_Array "Table of output values of sv_status_k0" VAL_BLK 0x2022E0 ZF_TAB_NAT8_S3_S3 63 SAB2_STANDARD_S3_S3 0 63 NUMBER 12 /end CHARACTERISTIC
/begin CHARACTERISTIC D_k_m_MaxK0NewCan "Filtration degree of sv_m_MaxK0" VALUE 0x218020 ZF_KW_NAT8_S3_S3 19 SAB2_STANDARD_S3_S3 1 20 /end CHARACTERISTIC
/begin CHARACTERISTIC D_k_m_MaxK0OldCan "Filtration degree of sv_m_MaxK0" VALUE 0x218021 ZF_KW_NAT8_S3_S3 20 SAB2_STANDARD_S3_S3 0 20 /end CHARACTERISTIC
/begin CHARACTERISTIC SWI_TarTorqMaxMinMot1Grb "Switch for activation TAR_TORQ_minmax_MOT_1_GRB" VALUE 0x218022 ZF_KW_NAT8_S3_S3 1 SAB2_STANDARD_S3_S3 0 1 /end CHARACTERISTIC
/begin CHARACTERISTIC D_KplHybShifting "Parameter of torque converter state 'release gear'" VALUE 0x218026 ZF_KW_NAT8_S3_S3 7 SAB2_STANDARD_S3_S3 0 7 /end CHARACTERISTIC
/begin CHARACTERISTIC D_PreadaptionState "Output value of WK when idle is active" VALUE 0x218027 ZF_KW_NAT8_S3_S3 15 SAB2_STANDARD_S3_S3 0 15 /end CHARACTERISTIC
/begin CHARACTERISTIC D_KplHybEmergencyGear "Substitute value of TC state during limphome (KMN_ENPG1FIX or KMN_ENPG3FIX set)" VALUE 0x218028 ZF_KW_NAT8_S3_S3 7 SAB2_STANDARD_S3_S3 0 7 /end CHARACTERISTIC
/begin CHARACTERISTIC D_KplHyb "Application Field of torque converter states" MAP 0x2022F0 ZF_TAB2D_NAT8_S3_S3 7 SAB2_STANDARD_S3_S3 0 7
 /begin AXIS_DESCR FIX_AXIS NO_INPUT_QUANTITY SAB2_STANDARD_S3_S3 3 1 3 FIX_AXIS_PAR_DIST 1 1 3 /end AXIS_DESCR
 /begin AXIS_DESCR FIX_AXIS NO_INPUT_QUANTITY SAB2_STANDARD_S3_S3 9 1 9 FIX_AXIS_PAR_DIST 1 1 9 /end AXIS_DESCR
/end CHARACTERISTIC
/begin CHARACTERISTIC SWI_TestCalibrationSABAL "the value of SWI_TestCalibrationSABAL is written to iv_TestCalibrationSABAL for the purpose of testing the calibration of the component SABAL" VALUE 0x218029 ZF_UINT8_COL_DIRECT_S4_S3 255 VOID_SCALING_S4_S3 0 255 /end CHARACTERISTIC
/begin CHARACTERISTIC D_m_EngMaxLth "Lower Threshold with active gearbox guard" VALUE 0x21833C ZF_INT16_COL_DIRECT_S4_S3 65535 SABAL_M_1NM_S4_S3 -32768 32767 /end CHARACTERISTIC
/begin CHARACTERISTIC D_m_GearboxGuardActiveHys "Hysteresis for changing between active to inactive gearbox guard" VALUE 0x218340 ZF_UINT16_COL_DIRECT_S4_S3 1000 SABAL_M_1NM_S4_S3 0 1000 /end CHARACTERISTIC
/begin CHARACTERISTIC SWI_SlowIncReqMode "Switch for output of slow intervention request during increase" VALUE 0x21806C ZF_UINT8_COL_DIRECT_S4_S3 7 SABAL_STANDARD_S4_S3 0 7 /end CHARACTERISTIC
/begin CHARACTERISTIC D_m_EngTqCtrlReqNegLth "Lower threshold of a reducing engine torque intervention in case of turbinespeed error" VALUE 0x21833E ZF_INT16_COL_DIRECT_S4_S3 200 SABAL_M_1NM_S4_S3 -200 0 /end CHARACTERISTIC
/begin CHARACTERISTIC SWI_ME_abs_rel "Mode of engine intervention torque request, 0 - absolut, 1 - relativ" VALUE 0x21806B ZF_UINT8_COL_DIRECT_S4_S3 1 SABAL_STANDARD_S4_S3 0 1 /end CHARACTERISTIC
/begin CHARACTERISTIC D_m_EngTqCtrlReqTol "Accepted tolerance range for pos. engine intervention" VALUE 0x218069 ZF_UINT8_COL_DIRECT_S4_S3 100 SABAL_M_1NM_S4_S3 0 100 /end CHARACTERISTIC
/begin CHARACTERISTIC SWI_FaultSourceLEV2 "Switch for the error handling of flag errors and complement errors" VALUE 0x21806A ZF_UINT8_COL_DIRECT_S4_S3 255 SABAL_STANDARD_S4_S3 0 255 /end CHARACTERISTIC
/begin CHARACTERISTIC D_m_EngMaxSel "Parameter to reduce the max allowed torque by the jitter bandwith" VALUE 0x21806D ZF_UINT8_COL_DIRECT_S4_S3 10 SABAL_M_1NM_S4_S3 0 10 /end CHARACTERISTIC
/begin MEASUREMENT ZFFSAB2._.ConfEGSACCOut.iv_EGSACCStsReceipt "Input value message status of EGSACC status" UBYTE SAB2_STANDARD_S3_S3 1 100 0 255 DISPLAY_IDENTIFIER iv_EGSACCStsReceipt.ConfEGSACCOut._.ZFFSAB2 ECU_ADDRESS 0xFFF984B2 /end MEASUREMENT
/begin MEASUREMENT ZFFSAB2._.ConfEGSACCOut.sv_EGSACCStsReceipt "Output value confirmation of received message derived from message status" UBYTE SAB2_STANDARD_S3_S3 1 100 0 2 DISPLAY_IDENTIFIER sv_EGSACCStsReceipt.ConfEGSACCOut._.ZFFSAB2 ECU_ADDRESS 0xFFF984B3 /end MEASUREMENT
/begin MEASUREMENT ZFFSAB2._.CoolingReqOut.iv_c_CoolMax "Input value cooling request from HPSYS" UBYTE SAB2_STANDARD_S3_S3 1 100 0 2 DISPLAY_IDENTIFIER iv_c_CoolMax.CoolingReqOut._.ZFFSAB2 ECU_ADDRESS 0xFFF984B4 /end MEASUREMENT
/begin MEASUREMENT ZFFSAB2._.CoolingReqOut.sv_CoolerRequest "Output value cooling request" UBYTE SAB2_STANDARD_S3_S3 1 100 0 3 DISPLAY_IDENTIFIER sv_CoolerRequest.CoolingReqOut._.ZFFSAB2 ECU_ADDRESS 0xFFF984B5 /end MEASUREMENT
/begin MEASUREMENT ZFFSAB2._.DashboardInfoOut.iv_n_EngLev2 "Level 2 output value engine rpm" UWORD SAB2_N_1RPM_S3_S3 1 100 0 65535 DISPLAY_IDENTIFIER iv_n_EngLev2.DashboardInfoOut._.ZFFSAB2 ECU_ADDRESS 0xFFF98100 /end MEASUREMENT
/begin MEASUREMENT ZFFSAB2._.DashboardInfoOut.iv_n_EngLev2_ "Level 2 output value engine rpm complement" UWORD SAB2_STANDARD_S3_S3 1 100 0 65535 DISPLAY_IDENTIFIER iv_n_EngLev2_.DashboardInfoOut._.ZFFSAB2 ECU_ADDRESS 0xFFF98102 /end MEASUREMENT
/begin MEASUREMENT ZFFSAB2._.DashboardInfoOut.iv_n_EngLev2Sts "Level 2 output value signal status of engine rpm" UBYTE SAB2_STANDARD_S3_S3 1 100 0 2 DISPLAY_IDENTIFIER iv_n_EngLev2Sts.DashboardInfoOut._.ZFFSAB2 ECU_ADDRESS 0xFFF98104 /end MEASUREMENT
/begin MEASUREMENT ZFFSAB2._.DashboardInfoOut.iv_n_EngLev2Sts_ "Level 2 output value signal status complement of engine rpm" UBYTE SAB2_STANDARD_S3_S3 1 100 0 255 DISPLAY_IDENTIFIER iv_n_EngLev2Sts_.DashboardInfoOut._.ZFFSAB2 ECU_ADDRESS 0xFFF98105 /end MEASUREMENT
/begin MEASUREMENT ZFFSAB2._.DashboardInfoOut.iv_CtlDispPos "Indication of the gearbox position" UBYTE SAB2_STANDARD_S3_S3 1 100 0 7 DISPLAY_IDENTIFIER iv_CtlDispPos.DashboardInfoOut._.ZFFSAB2 ECU_ADDRESS 0xFFF98106 /end MEASUREMENT
/begin MEASUREMENT ZFFSAB2._.DashboardInfoOut.iv_CtlDispPos_ "Complement for the indication of the gearbox position" UBYTE SAB2_STANDARD_S3_S3 1 100 0 255 DISPLAY_IDENTIFIER iv_CtlDispPos_.DashboardInfoOut._.ZFFSAB2 ECU_ADDRESS 0xFFF98107 /end MEASUREMENT
/begin MEASUREMENT ZFFSAB2._.DashboardInfoOut.sv_CtlDispPos "Output signal of the complement for the indication of the gearbox position" UBYTE SAB2_STANDARD_S3_S3 1 100 0 7 DISPLAY_IDENTIFIER sv_CtlDispPos.DashboardInfoOut._.ZFFSAB2 ECU_ADDRESS 0xFFF98108 /end MEASUREMENT
/begin MEASUREMENT ZFFSAB2._.DashboardInfoOut.sv_CtlDispPos_ "Output signal of the complement for the indication of the gearbox position" UBYTE SAB2_STANDARD_S3_S3 1 100 0 255 DISPLAY_IDENTIFIER sv_CtlDispPos_.DashboardInfoOut._.ZFFSAB2 ECU_ADDRESS 0xFFF98109 /end MEASUREMENT
/begin MEASUREMENT ZFFSAB2._.DashboardInfoOut.f_CtlDispPosErr "Error flag of sv_CtlDispPos" UBYTE SAB2_STANDARD_S3_S3 1 100 0 255 DISPLAY_IDENTIFIER f_CtlDispPosErr.DashboardInfoOut._.ZFFSAB2 ECU_ADDRESS 0xFFF9810A /end MEASUREMENT
/begin MEASUREMENT ZFFSAB2._.DashboardInfoOut.f_CtlDispPosErr_ "Complement for the error flag of sv_CtlDispPos" UBYTE SAB2_STANDARD_S3_S3 1 100 0 255 DISPLAY_IDENTIFIER f_CtlDispPosErr_.DashboardInfoOut._.ZFFSAB2 ECU_ADDRESS 0xFFF9810B /end MEASUREMENT
/begin MEASUREMENT ZFFSAB2._.EngIdleRaiseReqOut.iv_n_EngIdleRaiseRequestHAS "Input value desired idle speed from HAS" UBYTE SAB2_N_10RPM_S3_S3 1 100 0 2550 DISPLAY_IDENTIFIER iv_n_EngIdleRaiseRequestHAS.EngIdleRaiseReqOut._.ZFFSAB2 ECU_ADDRESS 0xFFF9810D /end MEASUREMENT
/begin MEASUREMENT ZFFSAB2._.EngIdleRaiseReqOut.iv_n_EngIdleRaiseRequestHAS_ "Complement input value desired idle speed from HAS" UBYTE SAB2_STANDARD_S3_S3 1 100 0 255 DISPLAY_IDENTIFIER iv_n_EngIdleRaiseRequestHAS_.EngIdleRaiseReqOut._.ZFFSAB2 ECU_ADDRESS 0xFFF9810E /end MEASUREMENT
/begin MEASUREMENT ZFFSAB2._.EngIdleRaiseReqOut.iv_n_EngIdleRaiseRequestHiResHAS "Input value for iv_n_EngIdleRaiseRequestHiResHAS" UWORD SAB2_N_1RPM_S3_S3 1 100 0 2000 DISPLAY_IDENTIFIER iv_n_EngIdleRaiseRequestHiResHAS.EngIdleRaiseReqOut._.ZFFSAB2 ECU_ADDRESS 0xFFF98110 /end MEASUREMENT
/begin MEASUREMENT ZFFSAB2._.EngIdleRaiseReqOut.iv_n_EngIdleRaiseRequestHiResHAS_ "Complement input value of iv_n_EngIdleRaiseRequestHiResHAS" UWORD SAB2_STANDARD_S3_S3 1 100 0 65535 DISPLAY_IDENTIFIER iv_n_EngIdleRaiseRequestHiResHAS_.EngIdleRaiseReqOut._.ZFFSAB2 ECU_ADDRESS 0xFFF98112 /end MEASUREMENT
/begin MEASUREMENT ZFFSAB2._.EngIdleRaiseReqOut.sv_n_EngIdleRaiseRequestHiRes "Output signal sv_n_EngIdleRaiseRequestHiRes" UWORD SAB2_N_RPM_S3_S3 1 100 0 4092 DISPLAY_IDENTIFIER sv_n_EngIdleRaiseRequestHiRes.EngIdleRaiseReqOut._.ZFFSAB2 ECU_ADDRESS 0xFFF98114 /end MEASUREMENT
/begin MEASUREMENT ZFFSAB2._.EngIdleRaiseReqOut.sv_n_EngIdleRaiseRequestHiRes_ "Complement to sv_n_EngIdleRaiseRequestHiRes" UWORD SAB2_STANDARD_S3_S3 1 100 0 65535 DISPLAY_IDENTIFIER sv_n_EngIdleRaiseRequestHiRes_.EngIdleRaiseReqOut._.ZFFSAB2 ECU_ADDRESS 0xFFF98116 /end MEASUREMENT
/begin MEASUREMENT ZFFSAB2._.EngIdleRaiseReqOut.sv_n_EngIdleRaiseRequest "Output value of desired idle speed" UBYTE SAB2_N_8RPM_S3_S3 1 100 0 2040 DISPLAY_IDENTIFIER sv_n_EngIdleRaiseRequest.EngIdleRaiseReqOut._.ZFFSAB2 ECU_ADDRESS 0xFFF98118 /end MEASUREMENT
/begin MEASUREMENT ZFFSAB2._.EngIdleRaiseReqOut.sv_n_EngIdleRaiseRequest_ "Complement output value of desired idle speed" UBYTE SAB2_STANDARD_S3_S3 1 100 0 255 DISPLAY_IDENTIFIER sv_n_EngIdleRaiseRequest_.EngIdleRaiseReqOut._.ZFFSAB2 ECU_ADDRESS 0xFFF98119 /end MEASUREMENT
/begin MEASUREMENT ZFFSAB2._.EngIdleRaiseReqOut.f_n_EngIdleRaiseRequestErr "Error flag for the n_EngIdleRaiseRequest" UBYTE SAB2_STANDARD_S3_S3 1 100 0 1 DISPLAY_IDENTIFIER f_n_EngIdleRaiseRequestErr.EngIdleRaiseReqOut._.ZFFSAB2 ECU_ADDRESS 0xFFF9811A /end MEASUREMENT
/begin MEASUREMENT ZFFSAB2._.EngIdleRaiseReqOut.f_n_EngIdleRaiseRequestErr_ "Complement error flag for the n_EngIdleRaiseRequest" UBYTE SAB2_STANDARD_S3_S3 1 100 0 255 DISPLAY_IDENTIFIER f_n_EngIdleRaiseRequestErr_.EngIdleRaiseReqOut._.ZFFSAB2 ECU_ADDRESS 0xFFF9811B /end MEASUREMENT
/begin MEASUREMENT ZFFSAB2._.EngineInterventionTransOut.EngineInterventionTransOut_Fl.iv_m_EngTqCtrlReqSts "Input signal status of signal engine intervention request by ignition: 0 = signal ok; 1 = substitute value; 2 = signal faulty" FLOAT32_IEEE SAB2_STANDARD_S3_S3 1 100 0 2 FORMAT "%5.3" DISPLAY_IDENTIFIER iv_m_EngTqCtrlReqSts.EngineInterventionTransOut_Fl.EngineInterventionTransOut._.ZFFSAB2 ECU_ADDRESS 0xFFF98120 /end MEASUREMENT
/begin MEASUREMENT ZFFSAB2._.EngineInterventionTransOut.EngineInterventionTransOut_Fl.iv_m_EngTqCtrlReqSts_ "Complement of input signal status of signal engine intervention request by ignition" FLOAT32_IEEE SAB2_STANDARD_S3_S3 1 100 0 255 FORMAT "%5.3" DISPLAY_IDENTIFIER iv_m_EngTqCtrlReqSts_.EngineInterventionTransOut_Fl.EngineInterventionTransOut._.ZFFSAB2 ECU_ADDRESS 0xFFF98124 /end MEASUREMENT
/begin MEASUREMENT ZFFSAB2._.EngineInterventionTransOut.EngineInterventionTransOut_Fl.iv_m_EngTqCtrlReq "Input signal engine intervention request by ignition" FLOAT32_IEEE SAB2_M_1NM_S3_S3 1 100 -1000 2000 FORMAT "%5.3" DISPLAY_IDENTIFIER iv_m_EngTqCtrlReq.EngineInterventionTransOut_Fl.EngineInterventionTransOut._.ZFFSAB2 ECU_ADDRESS 0xFFF98128 /end MEASUREMENT
/begin MEASUREMENT ZFFSAB2._.EngineInterventionTransOut.EngineInterventionTransOut_Fl.iv_m_EngTqCtrlReq_ "Complement of input signal engine intervention request by ignition" FLOAT32_IEEE SAB2_STANDARD_S3_S3 1 100 -32768 32767 FORMAT "%5.3" DISPLAY_IDENTIFIER iv_m_EngTqCtrlReq_.EngineInterventionTransOut_Fl.EngineInterventionTransOut._.ZFFSAB2 ECU_ADDRESS 0xFFF9812C /end MEASUREMENT
/begin MEASUREMENT ZFFSAB2._.EngineInterventionTransOut.EngineInterventionTransOut_Fl.iv_ctl_RelEngTqCtrlSts "Input signal status of relative engine torque control request: 0 = signal ok; 1 = substitute value; 2 = signal faulty" FLOAT32_IEEE SAB2_STANDARD_S3_S3 1 100 0 2 FORMAT "%5.3" DISPLAY_IDENTIFIER iv_ctl_RelEngTqCtrlSts.EngineInterventionTransOut_Fl.EngineInterventionTransOut._.ZFFSAB2 ECU_ADDRESS 0xFFF98130 /end MEASUREMENT
/begin MEASUREMENT ZFFSAB2._.EngineInterventionTransOut.EngineInterventionTransOut_Fl.iv_ctl_RelEngTqCtrlSts_ "Complement of input signal status of relative engine torque control request" FLOAT32_IEEE SAB2_STANDARD_S3_S3 1 100 0 255 FORMAT "%5.3" DISPLAY_IDENTIFIER iv_ctl_RelEngTqCtrlSts_.EngineInterventionTransOut_Fl.EngineInterventionTransOut._.ZFFSAB2 ECU_ADDRESS 0xFFF98134 /end MEASUREMENT
/begin MEASUREMENT ZFFSAB2._.EngineInterventionTransOut.EngineInterventionTransOut_Fl.iv_ctl_EngTqCtrlReqModeSts "Input signal status of intervention mode of the engine intervention by ignition: 0 = signal ok; 1 = substitute value; 2 = signal faulty" FLOAT32_IEEE SAB2_STANDARD_S3_S3 1 100 0 2 FORMAT "%5.3" DISPLAY_IDENTIFIER iv_ctl_EngTqCtrlReqModeSts.EngineInterventionTransOut_Fl.EngineInterventionTransOut._.ZFFSAB2 ECU_ADDRESS 0xFFF98138 /end MEASUREMENT
/begin MEASUREMENT ZFFSAB2._.EngineInterventionTransOut.EngineInterventionTransOut_Fl.iv_ctl_EngTqCtrlReqModeSts_ "Complement of input signal status of intervention mode of the engine intervention by ignition" FLOAT32_IEEE SAB2_STANDARD_S3_S3 1 100 0 255 FORMAT "%5.3" DISPLAY_IDENTIFIER iv_ctl_EngTqCtrlReqModeSts_.EngineInterventionTransOut_Fl.EngineInterventionTransOut._.ZFFSAB2 ECU_ADDRESS 0xFFF9813C /end MEASUREMENT
/begin MEASUREMENT ZFFSAB2._.EngineInterventionTransOut.EngineInterventionTransOut_Fl.iv_ctl_EngTqCtrlReqPredModeSts "Input signal status of the intervention mode of engine intervention request by air: 0 = signal ok; 1 = substitute value; 2 = signal faulty" FLOAT32_IEEE SAB2_STANDARD_S3_S3 1 100 0 2 FORMAT "%5.3" DISPLAY_IDENTIFIER iv_ctl_EngTqCtrlReqPredModeSts.EngineInterventionTransOut_Fl.EngineInterventionTransOut._.ZFFSAB2 ECU_ADDRESS 0xFFF98140 /end MEASUREMENT
/begin MEASUREMENT ZFFSAB2._.EngineInterventionTransOut.EngineInterventionTransOut_Fl.iv_ctl_EngTqCtrlReqPredMode "Intervention mode of engine intervention request by air: 0 = no request; 1 = increasing; 2 = decreasing" FLOAT32_IEEE SAB2_STANDARD_S3_S3 1 100 0 2 FORMAT "%5.3" DISPLAY_IDENTIFIER iv_ctl_EngTqCtrlReqPredMode.EngineInterventionTransOut_Fl.EngineInterventionTransOut._.ZFFSAB2 ECU_ADDRESS 0xFFF98144 /end MEASUREMENT
/begin MEASUREMENT ZFFSAB2._.EngineInterventionTransOut.EngineInterventionTransOut_Fl.iv_ctl_EngTqCtrlReqMode "Intervention mode of the engine intervention by ignition: 0 = no request; 1 = increasing; 2 = decreasing" FLOAT32_IEEE SAB2_STANDARD_S3_S3 1 100 0 2 FORMAT "%5.3" DISPLAY_IDENTIFIER iv_ctl_EngTqCtrlReqMode.EngineInterventionTransOut_Fl.EngineInterventionTransOut._.ZFFSAB2 ECU_ADDRESS 0xFFF98148 /end MEASUREMENT
/begin MEASUREMENT ZFFSAB2._.EngineInterventionTransOut.EngineInterventionTransOut_Fl.iv_ctl_EngTqCtrlReqMode_ "Complement of intervention mode of the engine intervention by ignition" FLOAT32_IEEE SAB2_STANDARD_S3_S3 1 100 0 255 FORMAT "%5.3" DISPLAY_IDENTIFIER iv_ctl_EngTqCtrlReqMode_.EngineInterventionTransOut_Fl.EngineInterventionTransOut._.ZFFSAB2 ECU_ADDRESS 0xFFF9814C /end MEASUREMENT
/begin MEASUREMENT ZFFSAB2._.EngineInterventionTransOut.EngineInterventionTransOut_Fl.iv_ctl_RelEngTqCtrl "Input relative engine torque control request: 0 = EI absolute; 1 = EI relative" FLOAT32_IEEE SAB2_STANDARD_S3_S3 1 100 0 1 FORMAT "%5.3" DISPLAY_IDENTIFIER iv_ctl_RelEngTqCtrl.EngineInterventionTransOut_Fl.EngineInterventionTransOut._.ZFFSAB2 ECU_ADDRESS 0xFFF98150 /end MEASUREMENT
/begin MEASUREMENT ZFFSAB2._.EngineInterventionTransOut.EngineInterventionTransOut_Fl.iv_ctl_RelEngTqCtrl_ "Complement of input relative engine torque control request" FLOAT32_IEEE SAB2_STANDARD_S3_S3 1 100 0 255 FORMAT "%5.3" DISPLAY_IDENTIFIER iv_ctl_RelEngTqCtrl_.EngineInterventionTransOut_Fl.EngineInterventionTransOut._.ZFFSAB2 ECU_ADDRESS 0xFFF98154 /end MEASUREMENT
/begin MEASUREMENT ZFFSAB2._.EngineInterventionTransOut.EngineInterventionTransOut_Fl.iv_ctl_ActvCylCtrl "Mode of active cyclinder control request (EZA): 0 = EZA disabled; 1 = EZA enabled; 2 = EZA requested" FLOAT32_IEEE SAB2_STANDARD_S3_S3 1 100 0 2 FORMAT "%5.3" DISPLAY_IDENTIFIER iv_ctl_ActvCylCtrl.EngineInterventionTransOut_Fl.EngineInterventionTransOut._.ZFFSAB2 ECU_ADDRESS 0xFFF98158 /end MEASUREMENT
/begin MEASUREMENT ZFFSAB2._.EngineInterventionTransOut.EngineInterventionTransOut_Fl.iv_ctl_ActvCylCtrlSts "Input signal status of mode active cyclinder control request (EZA): 0 = signal ok; 1 = substitute value; 2 = signal faulty" FLOAT32_IEEE SAB2_STANDARD_S3_S3 1 100 0 2 FORMAT "%5.3" DISPLAY_IDENTIFIER iv_ctl_ActvCylCtrlSts.EngineInterventionTransOut_Fl.EngineInterventionTransOut._.ZFFSAB2 ECU_ADDRESS 0xFFF9815C /end MEASUREMENT
/begin MEASUREMENT ZFFSAB2._.EngineInterventionTransOut.EngineInterventionTransOut_Fl.sv_m_EngTqCtrlReq "Output signal engine intervention request by ignition" FLOAT32_IEEE SAB2_M_NM2_M2047_S3_S3 1 100 -1023.5 1024 DISPLAY_IDENTIFIER sv_m_EngTqCtrlReq.EngineInterventionTransOut_Fl.EngineInterventionTransOut._.ZFFSAB2 ECU_ADDRESS 0xFFF98160 /end MEASUREMENT
/begin MEASUREMENT ZFFSAB2._.EngineInterventionTransOut.EngineInterventionTransOut_Fl.sv_m_EngTqCtrlReq_ "Complement of output signal engine intervention request by ignition" FLOAT32_IEEE SAB2_STANDARD_S3_S3 1 100 0 65535 FORMAT "%5.3" DISPLAY_IDENTIFIER sv_m_EngTqCtrlReq_.EngineInterventionTransOut_Fl.EngineInterventionTransOut._.ZFFSAB2 ECU_ADDRESS 0xFFF98164 /end MEASUREMENT
/begin MEASUREMENT ZFFSAB2._.EngineInterventionTransOut.EngineInterventionTransOut_Fl.sv_m_EngTqCtrlReqSts "Output signal status of engine intervention request" FLOAT32_IEEE SAB2_STANDARD_S3_S3 1 100 0 15 FORMAT "%5.3" DISPLAY_IDENTIFIER sv_m_EngTqCtrlReqSts.EngineInterventionTransOut_Fl.EngineInterventionTransOut._.ZFFSAB2 ECU_ADDRESS 0xFFF98168 /end MEASUREMENT
/begin MEASUREMENT ZFFSAB2._.EngineInterventionTransOut.EngineInterventionTransOut_Fl.sv_m_EngTqCtrlReqSts_ "Complement of output signal status of engine intervention request" FLOAT32_IEEE SAB2_STANDARD_S3_S3 1 100 0 255 FORMAT "%5.3" DISPLAY_IDENTIFIER sv_m_EngTqCtrlReqSts_.EngineInterventionTransOut_Fl.EngineInterventionTransOut._.ZFFSAB2 ECU_ADDRESS 0xFFF9816C /end MEASUREMENT
/begin MEASUREMENT ZFFSAB2._.EngineInterventionTransOut.iv_m_EngTqCtrlReq "Input signal engine intervention request by ignition" SWORD SAB2_M_1NM_S3_S3 1 100 -1000 2000 DISPLAY_IDENTIFIER iv_m_EngTqCtrlReq.EngineInterventionTransOut._.ZFFSAB2 ECU_ADDRESS 0xFFF98178 /end MEASUREMENT
/begin MEASUREMENT ZFFSAB2._.EngineInterventionTransOut.iv_m_EngTqCtrlReq_ "Complement of input signal engine intervention request by ignition" SWORD SAB2_STANDARD_S3_S3 1 100 -32768 32767 DISPLAY_IDENTIFIER iv_m_EngTqCtrlReq_.EngineInterventionTransOut._.ZFFSAB2 ECU_ADDRESS 0xFFF9817A /end MEASUREMENT
/begin MEASUREMENT ZFFSAB2._.EngineInterventionTransOut.iv_m_EngTqCtrlReqSts "Input signal status of signal engine intervention request by ignition: 0 = signal ok; 1 = substitute value; 2 = signal faulty" UBYTE SAB2_STANDARD_S3_S3 1 100 0 2 DISPLAY_IDENTIFIER iv_m_EngTqCtrlReqSts.EngineInterventionTransOut._.ZFFSAB2 ECU_ADDRESS 0xFFF9817C /end MEASUREMENT
/begin MEASUREMENT ZFFSAB2._.EngineInterventionTransOut.iv_m_EngTqCtrlReqSts_ "Complement of input signal status of signal engine intervention request by ignition" UBYTE SAB2_STANDARD_S3_S3 1 100 0 255 DISPLAY_IDENTIFIER iv_m_EngTqCtrlReqSts_.EngineInterventionTransOut._.ZFFSAB2 ECU_ADDRESS 0xFFF9817D /end MEASUREMENT
/begin MEASUREMENT ZFFSAB2._.EngineInterventionTransOut.iv_ctl_EngTqCtrlReqMode "Intervention mode of the engine intervention by ignition: 0 = no request; 1 = increasing; 2 = decreasing" UBYTE SAB2_STANDARD_S3_S3 1 100 0 2 DISPLAY_IDENTIFIER iv_ctl_EngTqCtrlReqMode.EngineInterventionTransOut._.ZFFSAB2 ECU_ADDRESS 0xFFF9817E /end MEASUREMENT
/begin MEASUREMENT ZFFSAB2._.EngineInterventionTransOut.iv_ctl_EngTqCtrlReqMode_ "Complement of intervention mode of the engine intervention by ignition" UBYTE SAB2_STANDARD_S3_S3 1 100 0 255 DISPLAY_IDENTIFIER iv_ctl_EngTqCtrlReqMode_.EngineInterventionTransOut._.ZFFSAB2 ECU_ADDRESS 0xFFF9817F /end MEASUREMENT
/begin MEASUREMENT ZFFSAB2._.EngineInterventionTransOut.iv_ctl_EngTqCtrlReqModeSts "Input signal status of intervention mode of the engine intervention by ignition: 0 = signal ok; 1 = substitute value; 2 = signal faulty" UBYTE SAB2_STANDARD_S3_S3 1 100 0 2 DISPLAY_IDENTIFIER iv_ctl_EngTqCtrlReqModeSts.EngineInterventionTransOut._.ZFFSAB2 ECU_ADDRESS 0xFFF98180 /end MEASUREMENT
/begin MEASUREMENT ZFFSAB2._.EngineInterventionTransOut.iv_ctl_EngTqCtrlReqModeSts_ "Complement of input signal status of intervention mode of the engine intervention by ignition" UBYTE SAB2_STANDARD_S3_S3 1 100 0 255 DISPLAY_IDENTIFIER iv_ctl_EngTqCtrlReqModeSts_.EngineInterventionTransOut._.ZFFSAB2 ECU_ADDRESS 0xFFF98181 /end MEASUREMENT
/begin MEASUREMENT ZFFSAB2._.EngineInterventionTransOut.iv_m_EngTqCtrlReqPred "Input signal engine intervention request by air" SWORD SAB2_M_1NM_S3_S3 1 100 -1000 2000 DISPLAY_IDENTIFIER iv_m_EngTqCtrlReqPred.EngineInterventionTransOut._.ZFFSAB2 ECU_ADDRESS 0xFFF98182 /end MEASUREMENT
/begin MEASUREMENT ZFFSAB2._.EngineInterventionTransOut.iv_m_EngTqCtrlReqPredSts "Input signal status of signal engine intervention request by air: 0 = signal ok; 1 = substitute value; 2 = signal faulty" UBYTE SAB2_STANDARD_S3_S3 1 100 0 2 DISPLAY_IDENTIFIER iv_m_EngTqCtrlReqPredSts.EngineInterventionTransOut._.ZFFSAB2 ECU_ADDRESS 0xFFF98184 /end MEASUREMENT
/begin MEASUREMENT ZFFSAB2._.EngineInterventionTransOut.iv_ctl_EngTqCtrlReqPredMode "Intervention mode of engine intervention request by air: 0 = no request; 1 = increasing; 2 = decreasing" UBYTE SAB2_STANDARD_S3_S3 1 100 0 2 DISPLAY_IDENTIFIER iv_ctl_EngTqCtrlReqPredMode.EngineInterventionTransOut._.ZFFSAB2 ECU_ADDRESS 0xFFF98185 /end MEASUREMENT
/begin MEASUREMENT ZFFSAB2._.EngineInterventionTransOut.iv_ctl_EngTqCtrlReqPredModeSts "Input signal status of the intervention mode of engine intervention request by air: 0 = signal ok; 1 = substitute value; 2 = signal faulty" UBYTE SAB2_STANDARD_S3_S3 1 100 0 2 DISPLAY_IDENTIFIER iv_ctl_EngTqCtrlReqPredModeSts.EngineInterventionTransOut._.ZFFSAB2 ECU_ADDRESS 0xFFF98186 /end MEASUREMENT
/begin MEASUREMENT ZFFSAB2._.EngineInterventionTransOut.iv_m_EngTqMax "Input signal maximum allowed engine torque" SWORD SAB2_M_1NM_S3_S3 1 100 -1000 2000 DISPLAY_IDENTIFIER iv_m_EngTqMax.EngineInterventionTransOut._.ZFFSAB2 ECU_ADDRESS 0xFFF98188 /end MEASUREMENT
/begin MEASUREMENT ZFFSAB2._.EngineInterventionTransOut.iv_m_EngTqMaxSts "Input signal status of maximum allowed engine torque: 0 = signal ok; 1 = substitute value; 2 = signal faulty" UBYTE SAB2_STANDARD_S3_S3 1 100 0 2 DISPLAY_IDENTIFIER iv_m_EngTqMaxSts.EngineInterventionTransOut._.ZFFSAB2 ECU_ADDRESS 0xFFF9818A /end MEASUREMENT
/begin MEASUREMENT ZFFSAB2._.EngineInterventionTransOut.iv_ctl_ActvCylCtrl "Mode of active cyclinder control request (EZA): 0 = EZA disabled; 1 = EZA enabled; 2 = EZA requested" UBYTE SAB2_STANDARD_S3_S3 1 100 0 2 DISPLAY_IDENTIFIER iv_ctl_ActvCylCtrl.EngineInterventionTransOut._.ZFFSAB2 ECU_ADDRESS 0xFFF9818B /end MEASUREMENT
/begin MEASUREMENT ZFFSAB2._.EngineInterventionTransOut.iv_ctl_ActvCylCtrlSts "Input signal status of mode active cyclinder control request (EZA): 0 = signal ok; 1 = substitute value; 2 = signal faulty" UBYTE SAB2_STANDARD_S3_S3 1 100 0 2 DISPLAY_IDENTIFIER iv_ctl_ActvCylCtrlSts.EngineInterventionTransOut._.ZFFSAB2 ECU_ADDRESS 0xFFF9818C /end MEASUREMENT
/begin MEASUREMENT ZFFSAB2._.EngineInterventionTransOut.iv_ctl_RelEngTqCtrl "Input relative engine torque control request: 0 = EI absolute; 1 = EI relative" UBYTE SAB2_STANDARD_S3_S3 1 100 0 1 DISPLAY_IDENTIFIER iv_ctl_RelEngTqCtrl.EngineInterventionTransOut._.ZFFSAB2 ECU_ADDRESS 0xFFF9818D /end MEASUREMENT
/begin MEASUREMENT ZFFSAB2._.EngineInterventionTransOut.iv_ctl_RelEngTqCtrl_ "Complement of input relative engine torque control request" UBYTE SAB2_STANDARD_S3_S3 1 100 0 255 DISPLAY_IDENTIFIER iv_ctl_RelEngTqCtrl_.EngineInterventionTransOut._.ZFFSAB2 ECU_ADDRESS 0xFFF9818E /end MEASUREMENT
/begin MEASUREMENT ZFFSAB2._.EngineInterventionTransOut.iv_ctl_RelEngTqCtrlSts "Input signal status of relative engine torque control request: 0 = signal ok; 1 = substitute value; 2 = signal faulty" UBYTE SAB2_STANDARD_S3_S3 1 100 0 2 DISPLAY_IDENTIFIER iv_ctl_RelEngTqCtrlSts.EngineInterventionTransOut._.ZFFSAB2 ECU_ADDRESS 0xFFF9818F /end MEASUREMENT
/begin MEASUREMENT ZFFSAB2._.EngineInterventionTransOut.iv_ctl_RelEngTqCtrlSts_ "Complement of input signal status of relative engine torque control request" UBYTE SAB2_STANDARD_S3_S3 1 100 0 255 DISPLAY_IDENTIFIER iv_ctl_RelEngTqCtrlSts_.EngineInterventionTransOut._.ZFFSAB2 ECU_ADDRESS 0xFFF98190 /end MEASUREMENT
/begin MEASUREMENT ZFFSAB2._.EngineInterventionTransOut.sv_m_EngTqCtrlReq "Output signal engine intervention request by ignition" UWORD SAB2_M_NM2_M2047_S3_S3 1 100 -1023.5 1024 DISPLAY_IDENTIFIER sv_m_EngTqCtrlReq.EngineInterventionTransOut._.ZFFSAB2 ECU_ADDRESS 0xFFF98192 /end MEASUREMENT
/begin MEASUREMENT ZFFSAB2._.EngineInterventionTransOut.sv_m_EngTqCtrlReq_ "Complement of output signal engine intervention request by ignition" UWORD SAB2_STANDARD_S3_S3 1 100 0 65535 DISPLAY_IDENTIFIER sv_m_EngTqCtrlReq_.EngineInterventionTransOut._.ZFFSAB2 ECU_ADDRESS 0xFFF98194 /end MEASUREMENT
/begin MEASUREMENT ZFFSAB2._.EngineInterventionTransOut.sv_m_EngTqCtrlReqPred "Output signal engine intervention request by air" UWORD SAB2_M_NM2_M2047_S3_S3 1 100 -1023.5 1024 DISPLAY_IDENTIFIER sv_m_EngTqCtrlReqPred.EngineInterventionTransOut._.ZFFSAB2 ECU_ADDRESS 0xFFF98196 /end MEASUREMENT
/begin MEASUREMENT ZFFSAB2._.EngineInterventionTransOut.sv_m_EngTqMax "Output signal maximum allowed engine torque" UWORD SAB2_M_NM2_M2047_S3_S3 1 100 -1023.5 1024 DISPLAY_IDENTIFIER sv_m_EngTqMax.EngineInterventionTransOut._.ZFFSAB2 ECU_ADDRESS 0xFFF98198 /end MEASUREMENT
/begin MEASUREMENT ZFFSAB2._.EngineInterventionTransOut.sv_m_EngTqCtrlReqSts "Output signal status of engine intervention request" UBYTE SAB2_STANDARD_S3_S3 1 100 0 15 DISPLAY_IDENTIFIER sv_m_EngTqCtrlReqSts.EngineInterventionTransOut._.ZFFSAB2 ECU_ADDRESS 0xFFF9819A /end MEASUREMENT
/begin MEASUREMENT ZFFSAB2._.EngineInterventionTransOut.sv_m_EngTqCtrlReqSts_ "Complement of output signal status of engine intervention request" UBYTE SAB2_STANDARD_S3_S3 1 100 0 255 DISPLAY_IDENTIFIER sv_m_EngTqCtrlReqSts_.EngineInterventionTransOut._.ZFFSAB2 ECU_ADDRESS 0xFFF9819B /end MEASUREMENT
/begin MEASUREMENT ZFFSAB2._.ErrorEntryOut.ErrorEntryOut_Fl.sv_DiagnosticFunct "Diagnostics of hybrid functions" FLOAT32_IEEE SAB2_STANDARD_S3_S3 1 100 0 15 FORMAT "%5.3" DISPLAY_IDENTIFIER sv_DiagnosticFunct.ErrorEntryOut_Fl.ErrorEntryOut._.ZFFSAB2 ECU_ADDRESS 0xFFF981A0 /end MEASUREMENT
/begin MEASUREMENT ZFFSAB2._.ErrorEntryOut.ErrorEntryOut_Fl.sv_DiagnosticFunct_ "Complement to sv_DiagnosticFunct" FLOAT32_IEEE SAB2_STANDARD_S3_S3 1 100 0 255 FORMAT "%5.3" DISPLAY_IDENTIFIER sv_DiagnosticFunct_.ErrorEntryOut_Fl.ErrorEntryOut._.ZFFSAB2 ECU_ADDRESS 0xFFF981A4 /end MEASUREMENT
/begin MEASUREMENT ZFFSAB2._.ErrorEntryOut.ErrorEntryOut_Fl.iv_Limphome "Input value for gearbox emergency state" FLOAT32_IEEE SAB2_STANDARD_S3_S3 1 100 0 3 FORMAT "%5.3" DISPLAY_IDENTIFIER iv_Limphome.ErrorEntryOut_Fl.ErrorEntryOut._.ZFFSAB2 ECU_ADDRESS 0xFFF981A8 /end MEASUREMENT
/begin MEASUREMENT ZFFSAB2._.ErrorEntryOut.ErrorEntryOut_Fl.iv_Limphome_ "Complement to iv_Limphome" FLOAT32_IEEE SAB2_STANDARD_S3_S3 1 100 0 255 FORMAT "%5.3" DISPLAY_IDENTIFIER iv_Limphome_.ErrorEntryOut_Fl.ErrorEntryOut._.ZFFSAB2 ECU_ADDRESS 0xFFF981AC /end MEASUREMENT
/begin MEASUREMENT ZFFSAB2._.ErrorEntryOut.ErrorEntryOut_Fl.f_DiagnosticFunctSetByLimphomeError "Computation priority flag indicating that computation of sv_DiagnosticFunct was finished because iv_Limphome is not 0" FLOAT32_IEEE SAB2_STANDARD_S3_S3 1 100 0 1 FORMAT "%5.3" DISPLAY_IDENTIFIER f_DiagnosticFunctSetByLimphomeError.ErrorEntryOut_Fl.ErrorEntryOut._.ZFFSAB2 ECU_ADDRESS 0xFFF981B0 /end MEASUREMENT
/begin MEASUREMENT ZFFSAB2._.ErrorEntryOut.ErrorEntryOut_Fl.f_DiagnosticFunctSetByLimphomeError_ "Complement of f_DiagnosticFunctSetByLimphomeError" FLOAT32_IEEE SAB2_STANDARD_S3_S3 1 100 0 255 FORMAT "%5.3" DISPLAY_IDENTIFIER f_DiagnosticFunctSetByLimphomeError_.ErrorEntryOut_Fl.ErrorEntryOut._.ZFFSAB2 ECU_ADDRESS 0xFFF981B4 /end MEASUREMENT
/begin MEASUREMENT ZFFSAB2._.ErrorEntryOut.iv_SubstFunct "Bitcode for the currently active lower 32 error measures" ULONG SAB2_STANDARD_S3_S3 1 100 0 4294967295 DISPLAY_IDENTIFIER iv_SubstFunct.ErrorEntryOut._.ZFFSAB2 ECU_ADDRESS 0xFFF981C0 /end MEASUREMENT
/begin MEASUREMENT ZFFSAB2._.ErrorEntryOut.iv_SubstFunctHi "Bitcode for the currently active higher 32 error measures" ULONG SAB2_STANDARD_S3_S3 1 100 0 4294967295 DISPLAY_IDENTIFIER iv_SubstFunctHi.ErrorEntryOut._.ZFFSAB2 ECU_ADDRESS 0xFFF981C4 /end MEASUREMENT
/begin MEASUREMENT ZFFSAB2._.ErrorEntryOut.iv_EPumpErr "Output signal: descryption of PWM from E-Pump" UBYTE SAB2_STANDARD_S3_S3 1 100 0 3 DISPLAY_IDENTIFIER iv_EPumpErr.ErrorEntryOut._.ZFFSAB2 ECU_ADDRESS 0xFFF981C8 /end MEASUREMENT
/begin MEASUREMENT ZFFSAB2._.ErrorEntryOut.iv_Limphome "Input value for gearbox emergency state" UBYTE SAB2_STANDARD_S3_S3 1 100 0 3 DISPLAY_IDENTIFIER iv_Limphome.ErrorEntryOut._.ZFFSAB2 ECU_ADDRESS 0xFFF981C9 /end MEASUREMENT
/begin MEASUREMENT ZFFSAB2._.ErrorEntryOut.iv_Limphome_ "Input complement value for GET_STATUS_LIMPHOME" UBYTE SAB2_STANDARD_S3_S3 1 100 0 255 DISPLAY_IDENTIFIER iv_Limphome_.ErrorEntryOut._.ZFFSAB2 ECU_ADDRESS 0xFFF981CA /end MEASUREMENT
/begin MEASUREMENT ZFFSAB2._.ErrorEntryOut.sv_DiagnosticFunct "Diagnostics of hybrid functions" UBYTE SAB2_STANDARD_S3_S3 1 100 0 15 DISPLAY_IDENTIFIER sv_DiagnosticFunct.ErrorEntryOut._.ZFFSAB2 ECU_ADDRESS 0xFFF981CB /end MEASUREMENT
/begin MEASUREMENT ZFFSAB2._.ErrorEntryOut.sv_DiagnosticFunct_ "Diagnostics of hybrid functions - complement" UBYTE SAB2_STANDARD_S3_S3 1 100 0 255 DISPLAY_IDENTIFIER sv_DiagnosticFunct_.ErrorEntryOut._.ZFFSAB2 ECU_ADDRESS 0xFFF981CC /end MEASUREMENT
/begin MEASUREMENT ZFFSAB2._.ErrorEntryOut.f_DiagnosticFunctSetByLimphomeError "Computation priority flag indicating that computation of sv_DiagnosticFunct was finished because iv_Limphome is not 0" UBYTE SAB2_STANDARD_S3_S3 1 100 0 1 DISPLAY_IDENTIFIER f_DiagnosticFunctSetByLimphomeError.ErrorEntryOut._.ZFFSAB2 ECU_ADDRESS 0xFFF981CD /end MEASUREMENT
/begin MEASUREMENT ZFFSAB2._.ErrorEntryOut.f_DiagnosticFunctSetByLimphomeError_ "Complement of f_DiagnosticFunctSetByLimphomeError" UBYTE SAB2_STANDARD_S3_S3 1 100 0 255 DISPLAY_IDENTIFIER f_DiagnosticFunctSetByLimphomeError_.ErrorEntryOut._.ZFFSAB2 ECU_ADDRESS 0xFFF981CE /end MEASUREMENT
/begin MEASUREMENT ZFFSAB2._.GearboxLossesOut.iv_m_GearboxLosses "Gearbox losses calculate by HPSYS" SWORD SAB2_M_1NM_S3_S3 1 100 0 100 DISPLAY_IDENTIFIER iv_m_GearboxLosses.GearboxLossesOut._.ZFFSAB2 ECU_ADDRESS 0xFFF981D0 /end MEASUREMENT
/begin MEASUREMENT ZFFSAB2._.GearboxLossesOut.sv_m_GearboxLosses "CAN Output signal of gearbox losses" UBYTE SAB2_M_2NM_S3_S3 1 100 0 510 DISPLAY_IDENTIFIER sv_m_GearboxLosses.GearboxLossesOut._.ZFFSAB2 ECU_ADDRESS 0xFFF981D2 /end MEASUREMENT
/begin MEASUREMENT ZFFSAB2._.GearboxReinforcementOut.iv_in_ActualGear "Input value gearbox ratio of transferred gear from HPSYS" UWORD SAB2_K1000_S3_S3 1 100 0 10 DISPLAY_IDENTIFIER iv_in_ActualGear.GearboxReinforcementOut._.ZFFSAB2 ECU_ADDRESS 0xFFF981D8 /end MEASUREMENT
/begin MEASUREMENT ZFFSAB2._.GearboxReinforcementOut.iv_in_TargetGear "Input value gearbox ratio of transferred gear from HPSYS" UWORD SAB2_K1000_S3_S3 1 100 0 10 DISPLAY_IDENTIFIER iv_in_TargetGear.GearboxReinforcementOut._.ZFFSAB2 ECU_ADDRESS 0xFFF981DA /end MEASUREMENT
/begin MEASUREMENT ZFFSAB2._.GearboxReinforcementOut.iv_n_Ab "Output rpm - Output signal from WheelIn" UWORD SAB2_N_1RPM_S3_S3 1 100 0 65535 DISPLAY_IDENTIFIER iv_n_Ab.GearboxReinforcementOut._.ZFFSAB2 ECU_ADDRESS 0xFFF981DC /end MEASUREMENT
/begin MEASUREMENT ZFFSAB2._.GearboxReinforcementOut.iv_RearAxleRatio "Rear axle ratio - Output signal from RearAxleRatioIn" UWORD SAB2_K100_S3_S3 1 100 0 10 DISPLAY_IDENTIFIER iv_RearAxleRatio.GearboxReinforcementOut._.ZFFSAB2 ECU_ADDRESS 0xFFF981DE /end MEASUREMENT
/begin MEASUREMENT ZFFSAB2._.GearboxReinforcementOut.iv_rga_not_info "Input value rga_not_info from HPSYS" UBYTE SAB2_STANDARD_S3_S3 1 100 0 255 DISPLAY_IDENTIFIER iv_rga_not_info.GearboxReinforcementOut._.ZFFSAB2 ECU_ADDRESS 0xFFF981E0 /end MEASUREMENT
/begin MEASUREMENT ZFFSAB2._.GearboxReinforcementOut.iv_status_limphome "Output signal of Gearbox Staus from SABIN" UBYTE SAB2_STANDARD_S3_S3 1 100 0 3 DISPLAY_IDENTIFIER iv_status_limphome.GearboxReinforcementOut._.ZFFSAB2 ECU_ADDRESS 0xFFF981E1 /end MEASUREMENT
/begin MEASUREMENT ZFFSAB2._.GearboxReinforcementOut.iv_dt_IGChange "Input signal" UBYTE SAB2_T_TIMER_10MS_S3_S3 1 100 0 2540 DISPLAY_IDENTIFIER iv_dt_IGChange.GearboxReinforcementOut._.ZFFSAB2 ECU_ADDRESS 0xFFF981E2 /end MEASUREMENT
/begin MEASUREMENT ZFFSAB2._.GearboxReinforcementOut.sv_GearboxReinforcement "Output value gearbox reinforcement" UWORD SAB2_K8_S3_S3 1 100 0 511.875 DISPLAY_IDENTIFIER sv_GearboxReinforcement.GearboxReinforcementOut._.ZFFSAB2 ECU_ADDRESS 0xFFF981E4 /end MEASUREMENT
/begin MEASUREMENT ZFFSAB2._.GearboxReinforcementOut.sv_GearboxReinforcementCalcSts "Output value status of gearbox reinforcement" UBYTE SAB2_STANDARD_S3_S3 1 100 0 2 DISPLAY_IDENTIFIER sv_GearboxReinforcementCalcSts.GearboxReinforcementOut._.ZFFSAB2 ECU_ADDRESS 0xFFF981E6 /end MEASUREMENT
/begin MEASUREMENT ZFFSAB2._.GearboxReinforcementOut.TargetGearOld "Value of target gear from last cycle." SBYTE SAB2_STANDARD_S3_S3 1 100 -1 8 DISPLAY_IDENTIFIER TargetGearOld.GearboxReinforcementOut._.ZFFSAB2 ECU_ADDRESS 0xFFF981E7 /end MEASUREMENT
/begin MEASUREMENT ZFFSAB2._.GearboxReinforcementOut.GearboxReinforcementInter "Intermediate variable for sv_GearboxReinforcement." UWORD SAB2_K8_S3_S3 1 100 0 511.875 DISPLAY_IDENTIFIER GearboxReinforcementInter.GearboxReinforcementOut._.ZFFSAB2 ECU_ADDRESS 0xFFF981E8 /end MEASUREMENT
/begin MEASUREMENT ZFFSAB2._.GearboxReinforcementOut.iv_GearboxReinforcementErr "Input value of KMN_GBXRFMTOFF." UBYTE SAB2_STANDARD_S3_S3 1 100 0 1 DISPLAY_IDENTIFIER iv_GearboxReinforcementErr.GearboxReinforcementOut._.ZFFSAB2 ECU_ADDRESS 0xFFF981EA /end MEASUREMENT
/begin MEASUREMENT ZFFSAB2._.GearboxReinforcementOut.ActualGearOld "Value of iv_ActualGear from last cycle." SBYTE SAB2_STANDARD_S3_S3 1 100 -1 8 DISPLAY_IDENTIFIER ActualGearOld.GearboxReinforcementOut._.ZFFSAB2 ECU_ADDRESS 0xFFF981EB /end MEASUREMENT
/begin MEASUREMENT ZFFSAB2._.GearboxReinforcementOut.in_Gearbox "Calculated intermediate variable of actual gear" UWORD SAB2_K1000_S3_S3 1 100 0 10 DISPLAY_IDENTIFIER in_Gearbox.GearboxReinforcementOut._.ZFFSAB2 ECU_ADDRESS 0xFFF981EC /end MEASUREMENT
/begin MEASUREMENT ZFFSAB2._.GearboxReinforcementOut.in_GearboxOld "Value of variable in_Gearbox from last cycle." UWORD SAB2_K1000_S3_S3 1 100 0 10 DISPLAY_IDENTIFIER in_GearboxOld.GearboxReinforcementOut._.ZFFSAB2 ECU_ADDRESS 0xFFF981EE /end MEASUREMENT
/begin MEASUREMENT ZFFSAB2._.GearboxReinforcementOut.tmr_dt_IGChange "Value of actual timer." UBYTE SAB2_T_TIMER_10MS_S3_S3 1 100 0 2540 DISPLAY_IDENTIFIER tmr_dt_IGChange.GearboxReinforcementOut._.ZFFSAB2 ECU_ADDRESS 0xFFF981F0 /end MEASUREMENT
/begin MEASUREMENT ZFFSAB2._.GearboxReinforcementOut.dt_IGChangeOld "Value of tmr_dt_IGChange from last cycle." UBYTE SAB2_T_TIMER_10MS_S3_S3 1 100 0 2540 DISPLAY_IDENTIFIER dt_IGChangeOld.GearboxReinforcementOut._.ZFFSAB2 ECU_ADDRESS 0xFFF981F1 /end MEASUREMENT
/begin MEASUREMENT ZFFSAB2._.GearboxReinforcementOut.f_ShiftingAborted "Flag of gear shifting interruption." UBYTE SAB2_STANDARD_S3_S3 1 100 0 1 DISPLAY_IDENTIFIER f_ShiftingAborted.GearboxReinforcementOut._.ZFFSAB2 ECU_ADDRESS 0xFFF981F2 /end MEASUREMENT
/begin MEASUREMENT ZFFSAB2._.GearboxTorqueOut.t_freeze_mgt_Aufn_CAN.time "test_timer" UWORD SAB2_T_TIMER_10MS_S3_S3 1 100 0 655350 DISPLAY_IDENTIFIER time.t_freeze_mgt_Aufn_CAN.GearboxTorqueOut._.ZFFSAB2 ECU_ADDRESS 0xFFF98208 /end MEASUREMENT
/begin MEASUREMENT ZFFSAB2._.GearboxTorqueOut.iv_m_Gearbox "Input value from _ZF application transmission absorbing torque" SWORD SAB2_M_1NM_S3_S3 1 100 -32768 32767 DISPLAY_IDENTIFIER iv_m_Gearbox.GearboxTorqueOut._.ZFFSAB2 ECU_ADDRESS 0xFFF981FC /end MEASUREMENT
/begin MEASUREMENT ZFFSAB2._.GearboxTorqueOut.iv_m_Gearbox_ "Complement of input value from _ZF application transmission absorbing torque" SWORD SAB2_STANDARD_S3_S3 1 100 -32768 32767 DISPLAY_IDENTIFIER iv_m_Gearbox_.GearboxTorqueOut._.ZFFSAB2 ECU_ADDRESS 0xFFF981FE /end MEASUREMENT
/begin MEASUREMENT ZFFSAB2._.GearboxTorqueOut.iv_n_EngIdleSts "Input value from EngineIdleSpeedIn - Signalstatus of engine idle speed" UBYTE SAB2_STANDARD_S3_S3 1 100 0 255 DISPLAY_IDENTIFIER iv_n_EngIdleSts.GearboxTorqueOut._.ZFFSAB2 ECU_ADDRESS 0xFFF98200 /end MEASUREMENT
/begin MEASUREMENT ZFFSAB2._.GearboxTorqueOut.sv_m_Gearbox "Output value for calculated transmission absorbing torque" UWORD SAB2_M_NM2_M2047_S3_S3 1 100 -1023.5 1024 DISPLAY_IDENTIFIER sv_m_Gearbox.GearboxTorqueOut._.ZFFSAB2 ECU_ADDRESS 0xFFF98202 /end MEASUREMENT
/begin MEASUREMENT ZFFSAB2._.GearboxTorqueOut.sv_m_Gearbox_ "Complement of output value for calculated transmission absorbing torque" UWORD SAB2_STANDARD_S3_S3 1 100 0 65535 DISPLAY_IDENTIFIER sv_m_Gearbox_.GearboxTorqueOut._.ZFFSAB2 ECU_ADDRESS 0xFFF98204 /end MEASUREMENT
/begin MEASUREMENT ZFFSAB2._.GearboxTorqueOut.f_TimerStarted "Flag that timer is already running" UBYTE SAB2_STANDARD_S3_S3 1 100 0 255 DISPLAY_IDENTIFIER f_TimerStarted.GearboxTorqueOut._.ZFFSAB2 ECU_ADDRESS 0xFFF98206 /end MEASUREMENT
/begin MEASUREMENT ZFFSAB2._.HybridControlOut.iv_StatusAblauf_HAS "Input value sv_StatusAblauf_HAS from HAS" UBYTE SAB2_STANDARD_S3_S3 1 100 0 15 DISPLAY_IDENTIFIER iv_StatusAblauf_HAS.HybridControlOut._.ZFFSAB2 ECU_ADDRESS 0xFFF9820C /end MEASUREMENT
/begin MEASUREMENT ZFFSAB2._.HybridControlOut.iv_BetriebszustandIst "Input value current function state HAS IST from HAS 0 = Inactive 1 = Coupled P/N 2 = Uncoupled P/N 3 = E-run 4 = Stop 5 = Charging 6 = Uncoupled VM on P/N 7 = Uncoupled VM on D/R 8 = Hybridrun 14 = Init 15 = Error" UBYTE SAB2_STANDARD_S3_S3 1 100 0 15 DISPLAY_IDENTIFIER iv_BetriebszustandIst.HybridControlOut._.ZFFSAB2 ECU_ADDRESS 0xFFF9820D /end MEASUREMENT
/begin MEASUREMENT ZFFSAB2._.HybridControlOut.iv_BetriebszustandZiel "Input value requested function state HAS ZIEL from HAS 0 = Inactive 1 = Coupled P/N 2 = Uncoupled P/N 3 = E-run 4 = Stop 5 = Charging 6 = Uncoupled VM on P/N 7 = Uncoupled VM on D/R 8 = Hybridrun 14 = Init 15 = Error" UBYTE SAB2_STANDARD_S3_S3 1 100 0 15 DISPLAY_IDENTIFIER iv_BetriebszustandZiel.HybridControlOut._.ZFFSAB2 ECU_ADDRESS 0xFFF9820E /end MEASUREMENT
/begin MEASUREMENT ZFFSAB2._.HybridControlOut.sv_StatusAblauf_HAS "Output value sv_StatusAblauf_HAS" UBYTE SAB2_STANDARD_S3_S3 1 100 0 15 DISPLAY_IDENTIFIER sv_StatusAblauf_HAS.HybridControlOut._.ZFFSAB2 ECU_ADDRESS 0xFFF9820F /end MEASUREMENT
/begin MEASUREMENT ZFFSAB2._.HybridControlOut.sv_SollzustandKraftschluss "Output value sv_SollzustandKraftschluss" UBYTE SAB2_STANDARD_S3_S3 1 100 0 3 DISPLAY_IDENTIFIER sv_SollzustandKraftschluss.HybridControlOut._.ZFFSAB2 ECU_ADDRESS 0xFFF98210 /end MEASUREMENT
/begin MEASUREMENT ZFFSAB2._.HybridControlOut.sv_SollzustandVerbrenner "Output value sv_SollzustandVerbrenner" UBYTE SAB2_STANDARD_S3_S3 1 100 0 3 DISPLAY_IDENTIFIER sv_SollzustandVerbrenner.HybridControlOut._.ZFFSAB2 ECU_ADDRESS 0xFFF98211 /end MEASUREMENT
/begin MEASUREMENT ZFFSAB2._.HybridControlOut.sv_IstzustandKraftschluss "Output value sv_IstzustandKraftschluss" UBYTE SAB2_STANDARD_S3_S3 1 100 0 3 DISPLAY_IDENTIFIER sv_IstzustandKraftschluss.HybridControlOut._.ZFFSAB2 ECU_ADDRESS 0xFFF98212 /end MEASUREMENT
/begin MEASUREMENT ZFFSAB2._.HybridControlOut.sv_IstzustandVerbrenner "Output value sv_IstzustandVerbrenner" UBYTE SAB2_STANDARD_S3_S3 1 100 0 3 DISPLAY_IDENTIFIER sv_IstzustandVerbrenner.HybridControlOut._.ZFFSAB2 ECU_ADDRESS 0xFFF98213 /end MEASUREMENT
/begin MEASUREMENT ZFFSAB2._.HybridSignalsOut.iv_m_k0TargetExtern "K0 request torque : 0xFFD - function not respose 0xFFE - function report error 0xFFF - error" UWORD SAB2_2M_NM_M2046_S3_S3 1 100 -1023 1024.5 DISPLAY_IDENTIFIER iv_m_k0TargetExtern.HybridSignalsOut._.ZFFSAB2 ECU_ADDRESS 0xFFF98218 /end MEASUREMENT
/begin MEASUREMENT ZFFSAB2._.HybridSignalsOut.iv_k0ExternSts "Status of message RQ_CLT" UBYTE SAB2_STANDARD_S3_S3 1 100 0 255 DISPLAY_IDENTIFIER iv_k0ExternSts.HybridSignalsOut._.ZFFSAB2 ECU_ADDRESS 0xFFF9821A /end MEASUREMENT
/begin MEASUREMENT ZFFSAB2._.HybridSignalsOut.iv_k0SlipFactorExtern "State of position K0-slide : 0xFD - function not respose 0xFE - function report error 0xFF - error" UBYTE SAB2_04PROZENT_S3_S3 1 100 0 102 DISPLAY_IDENTIFIER iv_k0SlipFactorExtern.HybridSignalsOut._.ZFFSAB2 ECU_ADDRESS 0xFFF9821B /end MEASUREMENT
/begin MEASUREMENT ZFFSAB2._.HybridSignalsOut.iv_m_ResEM_HAS "Input value of the spare torque of the electric motor" SWORD SAB2_M_1NM_S3_S3 1 100 0 1000 DISPLAY_IDENTIFIER iv_m_ResEM_HAS.HybridSignalsOut._.ZFFSAB2 ECU_ADDRESS 0xFFF9821C /end MEASUREMENT
/begin MEASUREMENT ZFFSAB2._.HybridSignalsOut.iv_m_Max_EM_HAS "Input value maximum torque for electric motor" SWORD SAB2_M_1NM_S3_S3 1 100 -32768 32767 DISPLAY_IDENTIFIER iv_m_Max_EM_HAS.HybridSignalsOut._.ZFFSAB2 ECU_ADDRESS 0xFFF9821E /end MEASUREMENT
/begin MEASUREMENT ZFFSAB2._.HybridSignalsOut.iv_m_Min_EM_HAS "Input value minimum torque for electric motor" SWORD SAB2_M_1NM_S3_S3 1 100 -32768 32767 DISPLAY_IDENTIFIER iv_m_Min_EM_HAS.HybridSignalsOut._.ZFFSAB2 ECU_ADDRESS 0xFFF98220 /end MEASUREMENT
/begin MEASUREMENT ZFFSAB2._.HybridSignalsOut.iv_StatusK0 "Input value of the state of the clutch K0. 0 - open 1 - enclosed 2 - pressure seting 3 - slip regulated 4 - closed regulation 5 - closed" UBYTE SAB2_STANDARD_S3_S3 1 100 0 5 DISPLAY_IDENTIFIER iv_StatusK0.HybridSignalsOut._.ZFFSAB2 ECU_ADDRESS 0xFFF98222 /end MEASUREMENT
/begin MEASUREMENT ZFFSAB2._.HybridSignalsOut.iv_c_BelagK0 "Input value of the current K0 temperature" UWORD SAB2_C_1CEL_M40_S3_S3 1 100 -40 500 DISPLAY_IDENTIFIER iv_c_BelagK0.HybridSignalsOut._.ZFFSAB2 ECU_ADDRESS 0xFFF98224 /end MEASUREMENT
/begin MEASUREMENT ZFFSAB2._.HybridSignalsOut.iv_m_MaxK0Akt "Input value of the current clutch K0 torque" SWORD SAB2_M_1NM_S3_S3 1 100 0 1000 DISPLAY_IDENTIFIER iv_m_MaxK0Akt.HybridSignalsOut._.ZFFSAB2 ECU_ADDRESS 0xFFF98226 /end MEASUREMENT
/begin MEASUREMENT ZFFSAB2._.HybridSignalsOut.iv_m_SchleppK0Akt "Input value of signal from _GET_M_SCHLEPP_K0_AKT" SWORD SAB2_M_1NM_S3_S3 1 100 0 1000 DISPLAY_IDENTIFIER iv_m_SchleppK0Akt.HybridSignalsOut._.ZFFSAB2 ECU_ADDRESS 0xFFF98228 /end MEASUREMENT
/begin MEASUREMENT ZFFSAB2._.HybridSignalsOut.iv_m_MotMaxVM_K0 "Input value of the current clutch K0 torque" SWORD SAB2_M_1NM_S3_S3 1 100 -400 1640 DISPLAY_IDENTIFIER iv_m_MotMaxVM_K0.HybridSignalsOut._.ZFFSAB2 ECU_ADDRESS 0xFFF9822A /end MEASUREMENT
/begin MEASUREMENT ZFFSAB2._.HybridSignalsOut.iv_st_m_MotMaxVM_K0 "State of torque moment reduction. 0 - inactive 1 - active" UBYTE SAB2_STANDARD_S3_S3 1 100 0 1 DISPLAY_IDENTIFIER iv_st_m_MotMaxVM_K0.HybridSignalsOut._.ZFFSAB2 ECU_ADDRESS 0xFFF9822C /end MEASUREMENT
/begin MEASUREMENT ZFFSAB2._.HybridSignalsOut.sv_m_k0TargetExtern "K0 request torque" UWORD SAB2_M_1NM_S3_S3 1 100 0 65535 DISPLAY_IDENTIFIER sv_m_k0TargetExtern.HybridSignalsOut._.ZFFSAB2 ECU_ADDRESS 0xFFF9822E /end MEASUREMENT
/begin MEASUREMENT ZFFSAB2._.HybridSignalsOut.sv_k0SlipFactorExtern "State of position K0-slide" UBYTE SAB2_1PROZENT_S3_S3 1 100 0 100 DISPLAY_IDENTIFIER sv_k0SlipFactorExtern.HybridSignalsOut._.ZFFSAB2 ECU_ADDRESS 0xFFF98230 /end MEASUREMENT
/begin MEASUREMENT ZFFSAB2._.HybridSignalsOut.sv_m_ResEM_HAS "Output value of the spare torque of the electric motor" UWORD SAB2_M_NM2_M2047_S3_S3 1 100 -1023.5 1024 DISPLAY_IDENTIFIER sv_m_ResEM_HAS.HybridSignalsOut._.ZFFSAB2 ECU_ADDRESS 0xFFF98232 /end MEASUREMENT
/begin MEASUREMENT ZFFSAB2._.HybridSignalsOut.sv_m_Max_EM_HAS "Output value maximum torque of electric motor" UWORD SAB2_M_NM2_M2047_S3_S3 1 100 -1023.5 1024 DISPLAY_IDENTIFIER sv_m_Max_EM_HAS.HybridSignalsOut._.ZFFSAB2 ECU_ADDRESS 0xFFF98234 /end MEASUREMENT
/begin MEASUREMENT ZFFSAB2._.HybridSignalsOut.sv_m_Min_EM_HAS "Output value minimum torque of electric motor" UWORD SAB2_M_NM2_M2047_S3_S3 1 100 -1023.5 1024 DISPLAY_IDENTIFIER sv_m_Min_EM_HAS.HybridSignalsOut._.ZFFSAB2 ECU_ADDRESS 0xFFF98236 /end MEASUREMENT
/begin MEASUREMENT ZFFSAB2._.HybridSignalsOut.sv_StatusK0 "Output value of the state of the clutch K0. 0 - open 1 - quick filling 2 - compensatory filing phase 3 - enclosed (touch point) 4 - pressure seting 5 - closing ramp 6 - slip regulation 7 - closed regulation (micro slip 8 - close) 9 - unencumbered BIN:1..." UBYTE SAB2_STANDARD_S3_S3 1 100 0 63
 /begin ANNOTATION ANNOTATION_LABEL "Description"
  /begin ANNOTATION_TEXT "Output value of the state of the clutch K0. 0 - open 1 - quick filling 2 - compensatory filing phase 3 - enclosed (touch point) 4 - pressure seting 5 - closing ramp 6 - slip regulation 7 - closed regulation (micro slip 8 - close) 9 - unencumbered BIN:1x x" "xx - emergency-run (moment limitation active) 63 - invalid signal" /end ANNOTATION_TEXT
 /end ANNOTATION
 DISPLAY_IDENTIFIER sv_StatusK0.HybridSignalsOut._.ZFFSAB2 ECU_ADDRESS 0xFFF98238 /end MEASUREMENT
/begin MEASUREMENT ZFFSAB2._.HybridSignalsOut.sv_c_BelagK0 "Output value of the current K0 temperature" UBYTE SAB2_C_1CEL_M40_S3_S3 1 100 -40 214 DISPLAY_IDENTIFIER sv_c_BelagK0.HybridSignalsOut._.ZFFSAB2 ECU_ADDRESS 0xFFF98239 /end MEASUREMENT
/begin MEASUREMENT ZFFSAB2._.HybridSignalsOut.sv_m_MaxK0 "Output value of the current clutch K0 torque" UWORD SAB2_M_NM2_M2047_S3_S3 1 100 -1023.5 1024 DISPLAY_IDENTIFIER sv_m_MaxK0.HybridSignalsOut._.ZFFSAB2 ECU_ADDRESS 0xFFF9823A /end MEASUREMENT
/begin MEASUREMENT ZFFSAB2._.HybridSignalsOut.m_MaxK0_OldValue "Old Value form the signal sv_m_MaxK0." SWORD SAB2_M_1NM_S3_S3 1 100 0 4095 DISPLAY_IDENTIFIER m_MaxK0_OldValue.HybridSignalsOut._.ZFFSAB2 ECU_ADDRESS 0xFFF9823C /end MEASUREMENT
/begin MEASUREMENT ZFFSAB2._.MIL_RequestOut.iv_CodingMilLamp "Input signal from OBD switch function; 0 - MIL always off; 1 - Signalization from Errorhandler cause activation of MIL." UBYTE SAB2_STANDARD_S3_S3 1 100 0 1 DISPLAY_IDENTIFIER iv_CodingMilLamp.MIL_RequestOut._.ZFFSAB2 ECU_ADDRESS 0xFFF983F2 /end MEASUREMENT
/begin MEASUREMENT ZFFSAB2._.MIL_RequestOut.iv_MilReq "Input signal MIL request" UBYTE SAB2_STANDARD_S3_S3 1 100 0 1 DISPLAY_IDENTIFIER iv_MilReq.MIL_RequestOut._.ZFFSAB2 ECU_ADDRESS 0xFFF983F3 /end MEASUREMENT
/begin MEASUREMENT ZFFSAB2._.MIL_RequestOut.sv_MilReq "Output signal of MIL request" UBYTE SAB2_STANDARD_S3_S3 1 100 0 2 DISPLAY_IDENTIFIER sv_MilReq.MIL_RequestOut._.ZFFSAB2 ECU_ADDRESS 0xFFF983F4 /end MEASUREMENT
/begin MEASUREMENT ZFFSAB2._.MStartLimitationOut.sv_f_m_StartLimitation "Output value limitation of starting torque" UBYTE SAB2_STANDARD_S3_S3 1 100 0 3 DISPLAY_IDENTIFIER sv_f_m_StartLimitation.MStartLimitationOut._.ZFFSAB2 ECU_ADDRESS 0xFFF983F5 /end MEASUREMENT
/begin MEASUREMENT ZFFSAB2._.NICActiveOut.iv_SBCActive "input value SBC active / SBC inactive" UBYTE SAB2_STANDARD_S3_S3 1 100 0 7 DISPLAY_IDENTIFIER iv_SBCActive.NICActiveOut._.ZFFSAB2 ECU_ADDRESS 0xFFF984B6 /end MEASUREMENT
/begin MEASUREMENT ZFFSAB2._.NICActiveOut.sv_GearboxSts "output value with currrent SBC and SSC status" UBYTE SAB2_STANDARD_S3_S3 1 100 0 7 DISPLAY_IDENTIFIER sv_GearboxSts.NICActiveOut._.ZFFSAB2 ECU_ADDRESS 0xFFF984B7 /end MEASUREMENT
/begin MEASUREMENT ZFFSAB2._.PumpIntakeTorqueOut.iv_m_Pump "Input value pump intake torque" SWORD SAB2_M_1NM_S3_S3 1 100 -32768 32767 DISPLAY_IDENTIFIER iv_m_Pump.PumpIntakeTorqueOut._.ZFFSAB2 ECU_ADDRESS 0xFFF98244 /end MEASUREMENT
/begin MEASUREMENT ZFFSAB2._.PumpIntakeTorqueOut.sv_m_PumpCensored "Output value pump intake torque for internal usage in SABIN." SWORD SAB2_M_1NM_S3_S3 1 100 0 30 DISPLAY_IDENTIFIER sv_m_PumpCensored.PumpIntakeTorqueOut._.ZFFSAB2 ECU_ADDRESS 0xFFF98246 /end MEASUREMENT
/begin MEASUREMENT ZFFSAB2._.ShiftingActiveOut.iv_ReqDeactvtActvDampg "0 No deactivation requested. 1 Deactivation of damping is requested." UBYTE SAB2_STANDARD_S3_S3 1 100 0 1 DISPLAY_IDENTIFIER iv_ReqDeactvtActvDampg.ShiftingActiveOut._.ZFFSAB2 ECU_ADDRESS 0xFFF9824C /end MEASUREMENT
/begin MEASUREMENT ZFFSAB2._.ShiftingActiveOut.iv_f_ChangeOfGear "0 - gear change not aktiv; 1 - gear change aktiv" UBYTE SAB2_STANDARD_S3_S3 1 100 0 1 DISPLAY_IDENTIFIER iv_f_ChangeOfGear.ShiftingActiveOut._.ZFFSAB2 ECU_ADDRESS 0xFFF9824D /end MEASUREMENT
/begin MEASUREMENT ZFFSAB2._.ShiftingActiveOut.sv_f_ShiftingActive "Undelayed output value flag shifting active (SWP-RAM-cell)" UBYTE SAB2_STANDARD_S3_S3 1 100 0 3 DISPLAY_IDENTIFIER sv_f_ShiftingActive.ShiftingActiveOut._.ZFFSAB2 ECU_ADDRESS 0xFFF9824E /end MEASUREMENT
/begin MEASUREMENT ZFFSAB2._.ShiftingActiveOut.sv_ReqDeactvtActvDampg "0 No deactivation requested. 1 Deactivation of damping is requested. 3 Signal is not used or invalid" UBYTE SAB2_STANDARD_S3_S3 1 100 0 3 DISPLAY_IDENTIFIER sv_ReqDeactvtActvDampg.ShiftingActiveOut._.ZFFSAB2 ECU_ADDRESS 0xFFF9824F /end MEASUREMENT
/begin MEASUREMENT ZFFSAB2._.SynEngineSpeedOut.iv_n_mot_synEM "Input value n_mot_synEM" UWORD SAB2_N_1RPM_S3_S3 1 100 0 8000 DISPLAY_IDENTIFIER iv_n_mot_synEM.SynEngineSpeedOut._.ZFFSAB2 ECU_ADDRESS 0xFFF98252 /end MEASUREMENT
/begin MEASUREMENT ZFFSAB2._.SynEngineSpeedOut.iv_n_mot_synEM_ "Input value n_mot_synEM_" UWORD SAB2_STANDARD_S3_S3 1 100 0 65535 DISPLAY_IDENTIFIER iv_n_mot_synEM_.SynEngineSpeedOut._.ZFFSAB2 ECU_ADDRESS 0xFFF98254 /end MEASUREMENT
/begin MEASUREMENT ZFFSAB2._.SynEngineSpeedOut.iv_f_n_mot_synEMSts "Input value f_n_mot_synEMSts" UBYTE SAB2_STANDARD_S3_S3 1 100 0 1 DISPLAY_IDENTIFIER iv_f_n_mot_synEMSts.SynEngineSpeedOut._.ZFFSAB2 ECU_ADDRESS 0xFFF98256 /end MEASUREMENT
/begin MEASUREMENT ZFFSAB2._.SynEngineSpeedOut.iv_f_n_mot_synEMSts_ "Input value f_n_mot_synEMSts_" UBYTE SAB2_STANDARD_S3_S3 1 100 0 255 DISPLAY_IDENTIFIER iv_f_n_mot_synEMSts_.SynEngineSpeedOut._.ZFFSAB2 ECU_ADDRESS 0xFFF98257 /end MEASUREMENT
/begin MEASUREMENT ZFFSAB2._.SynEngineSpeedOut.iv_n_motsynEMErr "Input value n_motsynEMErr" UBYTE SAB2_STANDARD_S3_S3 1 100 0 1 DISPLAY_IDENTIFIER iv_n_motsynEMErr.SynEngineSpeedOut._.ZFFSAB2 ECU_ADDRESS 0xFFF98258 /end MEASUREMENT
/begin MEASUREMENT ZFFSAB2._.SynEngineSpeedOut.iv_n_motsynEMErr_ "Input value n_motsynEMErr_" UBYTE SAB2_STANDARD_S3_S3 1 100 0 255 DISPLAY_IDENTIFIER iv_n_motsynEMErr_.SynEngineSpeedOut._.ZFFSAB2 ECU_ADDRESS 0xFFF98259 /end MEASUREMENT
/begin MEASUREMENT ZFFSAB2._.SynEngineSpeedOut.iv_n_mot_synVM "Input value n_mot_synVM" UWORD SAB2_N_1RPM_S3_S3 1 100 0 8000 DISPLAY_IDENTIFIER iv_n_mot_synVM.SynEngineSpeedOut._.ZFFSAB2 ECU_ADDRESS 0xFFF9825A /end MEASUREMENT
/begin MEASUREMENT ZFFSAB2._.SynEngineSpeedOut.iv_n_mot_synVM_ "Input value n_mot_synVM_" UWORD SAB2_STANDARD_S3_S3 1 100 0 65535 DISPLAY_IDENTIFIER iv_n_mot_synVM_.SynEngineSpeedOut._.ZFFSAB2 ECU_ADDRESS 0xFFF9825C /end MEASUREMENT
/begin MEASUREMENT ZFFSAB2._.SynEngineSpeedOut.iv_f_n_mot_synVMSts "Input value f_n_mot_synVMSts" UBYTE SAB2_STANDARD_S3_S3 1 100 0 1 DISPLAY_IDENTIFIER iv_f_n_mot_synVMSts.SynEngineSpeedOut._.ZFFSAB2 ECU_ADDRESS 0xFFF9825E /end MEASUREMENT
/begin MEASUREMENT ZFFSAB2._.SynEngineSpeedOut.iv_f_n_mot_synVMSts_ "Input value f_n_mot_synVMSts_" UBYTE SAB2_STANDARD_S3_S3 1 100 0 255 DISPLAY_IDENTIFIER iv_f_n_mot_synVMSts_.SynEngineSpeedOut._.ZFFSAB2 ECU_ADDRESS 0xFFF9825F /end MEASUREMENT
/begin MEASUREMENT ZFFSAB2._.SynEngineSpeedOut.iv_n_motsynVMErr "Input value n_motsynVMErr" UBYTE SAB2_STANDARD_S3_S3 1 100 0 1 DISPLAY_IDENTIFIER iv_n_motsynVMErr.SynEngineSpeedOut._.ZFFSAB2 ECU_ADDRESS 0xFFF98260 /end MEASUREMENT
/begin MEASUREMENT ZFFSAB2._.SynEngineSpeedOut.iv_n_motsynVMErr_ "Input value n_motsynVMErr_" UBYTE SAB2_STANDARD_S3_S3 1 100 0 255 DISPLAY_IDENTIFIER iv_n_motsynVMErr_.SynEngineSpeedOut._.ZFFSAB2 ECU_ADDRESS 0xFFF98261 /end MEASUREMENT
/begin MEASUREMENT ZFFSAB2._.SynEngineSpeedOut.sv_n_mot_synSollEM "Output value of the target engine speed" UWORD SAB2_N_10RPM4_S3_S3 1 100 0 163837.5 DISPLAY_IDENTIFIER sv_n_mot_synSollEM.SynEngineSpeedOut._.ZFFSAB2 ECU_ADDRESS 0xFFF98262 /end MEASUREMENT
/begin MEASUREMENT ZFFSAB2._.SynEngineSpeedOut.sv_n_mot_synSollEM_ "Output value of the complement target engine speed" UWORD SAB2_STANDARD_S3_S3 1 100 0 65535 DISPLAY_IDENTIFIER sv_n_mot_synSollEM_.SynEngineSpeedOut._.ZFFSAB2 ECU_ADDRESS 0xFFF98264 /end MEASUREMENT
/begin MEASUREMENT ZFFSAB2._.SynEngineSpeedOut.sv_n_mot_synSollVM "output value n_mo_synSollVM" UWORD SAB2_N_RPM2_S3_S3 1 100 0 32767.5 DISPLAY_IDENTIFIER sv_n_mot_synSollVM.SynEngineSpeedOut._.ZFFSAB2 ECU_ADDRESS 0xFFF98266 /end MEASUREMENT
/begin MEASUREMENT ZFFSAB2._.SynEngineSpeedOut.sv_n_mot_synSollVM_ "output value n_mo_synSollVM_" UWORD SAB2_STANDARD_S3_S3 1 100 0 65535 DISPLAY_IDENTIFIER sv_n_mot_synSollVM_.SynEngineSpeedOut._.ZFFSAB2 ECU_ADDRESS 0xFFF98268 /end MEASUREMENT
/begin MEASUREMENT ZFFSAB2._.SynEngineSpeedOut.sv_n_mot_synSollEMVMSts "output value of the combined rpm control" UBYTE SAB2_STANDARD_S3_S3 1 100 0 7 DISPLAY_IDENTIFIER sv_n_mot_synSollEMVMSts.SynEngineSpeedOut._.ZFFSAB2 ECU_ADDRESS 0xFFF9826A /end MEASUREMENT
/begin MEASUREMENT ZFFSAB2._.SynEngineSpeedOut.sv_n_mot_synSollEMVMSts_ "complement of output value of the combined rpm control" UBYTE SAB2_STANDARD_S3_S3 1 100 0 255 DISPLAY_IDENTIFIER sv_n_mot_synSollEMVMSts_.SynEngineSpeedOut._.ZFFSAB2 ECU_ADDRESS 0xFFF9826B /end MEASUREMENT
/begin MEASUREMENT ZFFSAB2._.SynEngineSpeedOut.sv_f_n_mot_synSollEMSts "output value sv_f_n_mot_synSollEMSts" UBYTE SAB2_STANDARD_S3_S3 1 100 0 255 DISPLAY_IDENTIFIER sv_f_n_mot_synSollEMSts.SynEngineSpeedOut._.ZFFSAB2 ECU_ADDRESS 0xFFF9826C /end MEASUREMENT
/begin MEASUREMENT ZFFSAB2._.SynEngineSpeedOut.sv_f_n_mot_synSollEMSts_ "output value sv_f_n_mot_synSollEMSts complement" UBYTE SAB2_STANDARD_S3_S3 1 100 0 255 DISPLAY_IDENTIFIER sv_f_n_mot_synSollEMSts_.SynEngineSpeedOut._.ZFFSAB2 ECU_ADDRESS 0xFFF9826D /end MEASUREMENT
/begin MEASUREMENT ZFFSAB2._.SynEngineSpeedOut.f_n_mot_synSollVMSts "f_n_mot_synSollVMSts status flag" UBYTE SAB2_STANDARD_S3_S3 1 100 0 255 DISPLAY_IDENTIFIER f_n_mot_synSollVMSts.SynEngineSpeedOut._.ZFFSAB2 ECU_ADDRESS 0xFFF9826E /end MEASUREMENT
/begin MEASUREMENT ZFFSAB2._.SynEngineSpeedOut.f_n_mot_synSollVMSts_ "f_n_mot_synSollVMSts complement" UBYTE SAB2_STANDARD_S3_S3 1 100 0 255 DISPLAY_IDENTIFIER f_n_mot_synSollVMSts_.SynEngineSpeedOut._.ZFFSAB2 ECU_ADDRESS 0xFFF9826F /end MEASUREMENT
/begin MEASUREMENT ZFFSAB2._.TorqueConverterOut.TorqueConverterOutDAT.TableRowHyb "y-value of D_KplHyb" UWORD SAB2_STANDARD_S3_S3 1 100 0 65535 DISPLAY_IDENTIFIER TableRowHyb.TorqueConverterOutDAT.TorqueConverterOut._.ZFFSAB2 ECU_ADDRESS 0xFFF98274 /end MEASUREMENT
/begin MEASUREMENT ZFFSAB2._.TorqueConverterOut.TorqueConverterOutDAT.TableColumnHyb "x-value of D_KplHyb" UWORD SAB2_STANDARD_S3_S3 1 100 0 65535 DISPLAY_IDENTIFIER TableColumnHyb.TorqueConverterOutDAT.TorqueConverterOut._.ZFFSAB2 ECU_ADDRESS 0xFFF98276 /end MEASUREMENT
/begin MEASUREMENT ZFFSAB2._.TorqueConverterOut.iv_PreadaptionState "Input signal of preadaption: 0 = not started yet; 1 = Init state; 2 = running; 3 = will be finished; 4 = function interrupted" UBYTE SAB2_STANDARD_S3_S3 1 100 0 4 DISPLAY_IDENTIFIER iv_PreadaptionState.TorqueConverterOut._.ZFFSAB2 ECU_ADDRESS 0xFFF98278 /end MEASUREMENT
/begin MEASUREMENT ZFFSAB2._.TorqueConverterOut.iv_st_IAE "Input signal torque converter IAE" UBYTE SAB2_STANDARD_S3_S3 1 100 0 8 DISPLAY_IDENTIFIER iv_st_IAE.TorqueConverterOut._.ZFFSAB2 ECU_ADDRESS 0xFFF98279 /end MEASUREMENT
/begin MEASUREMENT ZFFSAB2._.TorqueConverterOut.sv_wk_IstHybrid "Output signal of torque converter status" UBYTE SAB2_STANDARD_S3_S3 1 100 0 15 DISPLAY_IDENTIFIER sv_wk_IstHybrid.TorqueConverterOut._.ZFFSAB2 ECU_ADDRESS 0xFFF9827A /end MEASUREMENT
/begin MEASUREMENT ZFFSAB2._.TorqueConverterOut.sv_wk_Ist "Output signal of torque converter" UBYTE SAB2_STANDARD_S3_S3 1 100 0 3 DISPLAY_IDENTIFIER sv_wk_Ist.TorqueConverterOut._.ZFFSAB2 ECU_ADDRESS 0xFFF9827B /end MEASUREMENT
/begin MEASUREMENT ZFFSAB2._.TorqueConverterOut.f_Enpg1fixActive "flag for KMN_ENPG1FIX" UBYTE SAB2_STANDARD_S3_S3 1 100 0 1 DISPLAY_IDENTIFIER f_Enpg1fixActive.TorqueConverterOut._.ZFFSAB2 ECU_ADDRESS 0xFFF9827C /end MEASUREMENT
/begin MEASUREMENT ZFFSAB2._.TorqueConverterOut.f_Enpg3fixActive "flag for KMN_ENPG3FIX" UBYTE SAB2_STANDARD_S3_S3 1 100 0 1 DISPLAY_IDENTIFIER f_Enpg3fixActive.TorqueConverterOut._.ZFFSAB2 ECU_ADDRESS 0xFFF9827D /end MEASUREMENT
/begin MEASUREMENT ZFFSAB2._.Interfi2.iv_Pos "Position of Gear Lever: D=5 N=6 R=7 P=8" UBYTE SAB2_STANDARD_S3_S3 1 100 0 8 DISPLAY_IDENTIFIER iv_Pos.Interfi2._.ZFFSAB2 ECU_ADDRESS 0xFFF98280 /end MEASUREMENT
/begin MEASUREMENT ZFFSAB2._.Interfi2.iv_f_IgnOn "Terminal 15 status - Output signal form IgnitionStatusIn" UBYTE SAB2_STANDARD_S3_S3 1 100 0 1 DISPLAY_IDENTIFIER iv_f_IgnOn.Interfi2._.ZFFSAB2 ECU_ADDRESS 0xFFF98281 /end MEASUREMENT
/begin MEASUREMENT ZFFSAB2._.Interfi2.iv_f_ACANorFACAN "CAN bus used - Output signal form CAN_SwitchingIn" UBYTE SAB2_STANDARD_S3_S3 1 100 0 1 DISPLAY_IDENTIFIER iv_f_ACANorFACAN.Interfi2._.ZFFSAB2 ECU_ADDRESS 0xFFF98282 /end MEASUREMENT
/begin MEASUREMENT ZFFSAB2._.Interfi2.iv_n_Tu "Turbine speed - Output signal from the class RPM_SensingIn" UWORD SAB2_N_1RPM_S3_S3 1 100 0 65535 DISPLAY_IDENTIFIER iv_n_Tu.Interfi2._.ZFFSAB2 ECU_ADDRESS 0xFFF98284 /end MEASUREMENT
/begin MEASUREMENT ZFFSAB2._.Interfi2.iv_n_TuSts "Turbine speed status - Output signal from the class RPM_SensingIn" UBYTE SAB2_STANDARD_S3_S3 1 100 0 255 DISPLAY_IDENTIFIER iv_n_TuSts.Interfi2._.ZFFSAB2 ECU_ADDRESS 0xFFF98286 /end MEASUREMENT
/begin MEASUREMENT ZFFSAB2._.Interfi2.iv_n_Eng "Reduction rpm - Output signal from EngineSpeedIn" UWORD SAB2_N_1RPM_S3_S3 1 100 0 65535 DISPLAY_IDENTIFIER iv_n_Eng.Interfi2._.ZFFSAB2 ECU_ADDRESS 0xFFF98288 /end MEASUREMENT
/begin MEASUREMENT ZFFSAB2._.Interfi2.iv_n_EngSts "Signal status of reduction rpm - Output signal from EngineSpeedIn" UBYTE SAB2_STANDARD_S3_S3 1 100 0 255 DISPLAY_IDENTIFIER iv_n_EngSts.Interfi2._.ZFFSAB2 ECU_ADDRESS 0xFFF9828A /end MEASUREMENT
/begin MEASUREMENT ZFFSAB2._.Interfi2.iv_m_EngSts "Signal status of engine torque. Output variable from SABIN class EngineTorqueIn." UBYTE SAB2_STANDARD_S3_S3 1 100 0 255 DISPLAY_IDENTIFIER iv_m_EngSts.Interfi2._.ZFFSAB2 ECU_ADDRESS 0xFFF9828B /end MEASUREMENT
/begin MEASUREMENT ZFFSAB2._.Interfi2.iv_c_OilTrans "Input value of gear oil temperature. From SABIn class GearboxTempIn." UBYTE SAB2_C_CGT_1CEL_M40_S3_S3 1 100 -40 215 DISPLAY_IDENTIFIER iv_c_OilTrans.Interfi2._.ZFFSAB2 ECU_ADDRESS 0xFFF9828C /end MEASUREMENT
/begin MEASUREMENT ZFFSAB2._.Interfi2.iv_c_OilTransSts "Signal status of gear oil temperature - Output signal from the class GearBoxTempIn" UBYTE SAB2_STANDARD_S3_S3 1 100 0 255 DISPLAY_IDENTIFIER iv_c_OilTransSts.Interfi2._.ZFFSAB2 ECU_ADDRESS 0xFFF9828D /end MEASUREMENT
/begin MEASUREMENT ZFFSAB2._.Interfi2.iv_TargetGear "Value of the target gear." SBYTE SAB2_STANDARD_S3_S3 1 100 -1 8 DISPLAY_IDENTIFIER iv_TargetGear.Interfi2._.ZFFSAB2 ECU_ADDRESS 0xFFF9828E /end MEASUREMENT
/begin MEASUREMENT ZFFSAB2._.Interfi2.iv_ActualGear "Value of the current gear." SBYTE SAB2_STANDARD_S3_S3 1 100 -1 8 DISPLAY_IDENTIFIER iv_ActualGear.Interfi2._.ZFFSAB2 ECU_ADDRESS 0xFFF9828F /end MEASUREMENT
/begin MEASUREMENT ZFFSAB2._.Interfi2.iv_kraftschluss "Input value grip from HPSYS" UBYTE SAB2_STANDARD_S3_S3 1 100 0 6 DISPLAY_IDENTIFIER iv_kraftschluss.Interfi2._.ZFFSAB2 ECU_ADDRESS 0xFFF98290 /end MEASUREMENT
/begin MEASUREMENT ZFFSAB2._.Interfi2.iv_KL15 "Input value of ignition 0=init 1=switching on 2=on 3=switching off 4=off" UBYTE SAB2_STANDARD_S3_S3 1 100 0 4 DISPLAY_IDENTIFIER iv_KL15.Interfi2._.ZFFSAB2 ECU_ADDRESS 0xFFF98291 /end MEASUREMENT
/begin MEASUREMENT ZFFSAB2._.Interfi2.iv_KL15_ "Complement of output value" UBYTE SAB2_STANDARD_S3_S3 1 100 0 255 DISPLAY_IDENTIFIER iv_KL15_.Interfi2._.ZFFSAB2 ECU_ADDRESS 0xFFF98292 /end MEASUREMENT
/begin MEASUREMENT iv_TestCalibrationSABAL "the value of SWI_TestCalibrationSABAL is written to iv_TestCalibrationSABAL for the purpose of testing the calibration of the component SABAL" UBYTE VOID_SCALING_S4_S3 1 100 0 255 ECU_ADDRESS 0xFFF86829 /end MEASUREMENT
/begin MEASUREMENT EngTqCtrl_iv_f_m_EngTqCtrlReqPosErr "Error flag from level2 safeguard for increasing engine intervention" UBYTE SABAL_STANDARD_S4_S3 1 100 0 1 ECU_ADDRESS 0xFFF85AA3 /end MEASUREMENT
/begin MEASUREMENT EngTqCtrl_iv_f_m_EngTqCtrlReqPosErr_ "Complement of error flag from level2 safeguard for increasing engine intervention" UBYTE SABAL_STANDARD_S4_S3 1 100 0 255 ECU_ADDRESS 0xFFF85AA4 /end MEASUREMENT
/begin MEASUREMENT EngTqCtrl_iv_f_m_EngTqCtrlReqNegErr "Error flag from level2 safeguard for negative engine intervention" UBYTE SABAL_STANDARD_S4_S3 1 100 0 1 ECU_ADDRESS 0xFFF85AA1 /end MEASUREMENT
/begin MEASUREMENT EngTqCtrl_iv_f_m_EngTqCtrlReqNegErr_ "Complement of error flag from level2 safeguard for negative engine intervention" UBYTE SABAL_STANDARD_S4_S3 1 100 0 255 ECU_ADDRESS 0xFFF85AA2 /end MEASUREMENT
/begin MEASUREMENT EngTqCtrl_iv_m_CrankSts "Signal status of crankshaft torque" UBYTE SABAL_SIGNAL_STATUS_S4_S3 1 100 0 2 ECU_ADDRESS 0xFFF85AA5 /end MEASUREMENT
/begin MEASUREMENT EngTqCtrl_iv_m_CrankSts_ "Complement of signal status of crankshaft torque" UBYTE SABAL_STANDARD_S4_S3 1 100 253 255 ECU_ADDRESS 0xFFF85AA6 /end MEASUREMENT
/begin MEASUREMENT EngTqCtrl_iv_m_EngLev2Sts "Signal status of engine torque" UBYTE SABAL_SIGNAL_STATUS_S4_S3 1 100 0 2 ECU_ADDRESS 0xFFF85AB4 /end MEASUREMENT
/begin MEASUREMENT EngTqCtrl_iv_m_EngLev2Sts_ "complement of signal status of engine torque" UBYTE SABAL_STANDARD_S4_S3 1 100 253 255 ECU_ADDRESS 0xFFF85AB5 /end MEASUREMENT
/begin MEASUREMENT EngTqCtrl_iv_m_PumpCensored "Censored and limited pump intake torque" SWORD SABAL_M_1NM_S4_S3 1 100 0 30 ECU_ADDRESS 0xFFF85A52 /end MEASUREMENT
/begin MEASUREMENT EngTqCtrl_iv_m_EngLev2 "Engine torque (without gearbox intervention)" SWORD SABAL_M_1NM_S4_S3 1 100 -1024 1023.5 ECU_ADDRESS 0xFFF85A42 /end MEASUREMENT
/begin MEASUREMENT EngTqCtrl_iv_m_EngLev2_ "Complement of engine torque" SWORD SABAL_M_1NM_S4_S3 1 100 -32768 32767 ECU_ADDRESS 0xFFF85A44 /end MEASUREMENT
/begin MEASUREMENT EngTqCtrl_iv_m_Eng "Engine torque (without gearbox intervention)" SWORD SABAL_M_1NM_S4_S3 1 100 -1024 1023.5 ECU_ADDRESS 0xFFF85A3C /end MEASUREMENT
/begin MEASUREMENT EngTqCtrl_iv_ctl_EngRedMode "Request of manner of torque reduction: 0 - no request, 1 - by ignition-path, 2 - by air-path, 3 - by ignition and air path" UBYTE SABAL_STANDARD_S4_S3 1 100 0 3 ECU_ADDRESS 0xFFF85A9F /end MEASUREMENT
/begin MEASUREMENT EngTqCtrl_iv_ctl_EngTqCtrlReqMode "Controlmode of the engine intervention request, 0 - no request, 1 - increase, 2 - decrease, 3 - invalid." UBYTE SABAL_STANDARD_S4_S3 1 100 0 3 ECU_ADDRESS 0xFFF85AB6 /end MEASUREMENT
/begin MEASUREMENT EngTqCtrl_iv_ctl_EngTqCtrlReqMode_ "Complement of controlmode of the engine intervention request" UBYTE SABAL_STANDARD_S4_S3 1 100 0 255 ECU_ADDRESS 0xFFF85AB7 /end MEASUREMENT
/begin MEASUREMENT EngTqCtrl_iv_ctl_EngTqCtrlReqPredMode "Controlmode of a predicted engine intervention request, 0 - No request, 1 - increase" UBYTE SABAL_STANDARD_S4_S3 1 100 0 1 ECU_ADDRESS 0xFFF85AA0 /end MEASUREMENT
/begin MEASUREMENT EngTqCtrl_iv_m_EngDesAdjustRange "Absolute engine intervention request on slow path (by air mass, cylinder cut-off) - only for torque reduction" SWORD SABAL_M_1NM_S4_S3 1 100 -32768 32767 ECU_ADDRESS 0xFFF85A3E /end MEASUREMENT
/begin MEASUREMENT EngTqCtrl_iv_m_EngDesAdjustRangeRel "Relative engine intervention request on slow path (relative to GET_M_MOT)" SWORD SABAL_M_1NM_S4_S3 1 100 -3000 3000 ECU_ADDRESS 0xFFF85A40 /end MEASUREMENT
/begin MEASUREMENT EngTqCtrl_iv_m_EngTqCtrlReq "Absolute engine intervention request on fast path" SWORD SABAL_M_1NM_S4_S3 1 100 -32768 32767 ECU_ADDRESS 0xFFF85A46 /end MEASUREMENT
/begin MEASUREMENT EngTqCtrl_iv_m_EngTqCtrlReqPred "Predicted absolute engine intervention request" SWORD SABAL_M_1NM_S4_S3 1 100 -32768 32767 ECU_ADDRESS 0xFFF85A48 /end MEASUREMENT
/begin MEASUREMENT EngTqCtrl_iv_m_EngTqCtrlReqPredRel "Predicted relative engine intervention request" SWORD SABAL_M_1NM_S4_S3 1 100 -3000 3000 ECU_ADDRESS 0xFFF85A4A /end MEASUREMENT
/begin MEASUREMENT EngTqCtrl_iv_m_EngTqCtrlReqRel "Relative engine intervention request on fast path (relative to GET_M_MOT)" SWORD SABAL_M_1NM_S4_S3 1 100 -3000 3000 ECU_ADDRESS 0xFFF85A4C /end MEASUREMENT
/begin MEASUREMENT EngTqCtrl_iv_m_EngTqCtrlReqRel_ "Complement of relative engine intervention request on fast path" SWORD SABAL_STANDARD_S4_S3 1 100 -32768 32767 ECU_ADDRESS 0xFFF85A4E /end MEASUREMENT
/begin MEASUREMENT EngTqCtrl_iv_m_EngTqCtrlReq_ "Complement of absolute engine intervention request on fast path" SWORD SABAL_STANDARD_S4_S3 1 100 -32768 32767 ECU_ADDRESS 0xFFF85A50 /end MEASUREMENT
/begin MEASUREMENT EngTqCtrl_iv_n_EngLev2Sts "Signal status of engine speed, 0 - signal ok, 1 - substitute value, 2 - signal faulty" UBYTE SABAL_SIGNAL_STATUS_S4_S3 1 100 0 2 ECU_ADDRESS 0xFFF85AA7 /end MEASUREMENT
/begin MEASUREMENT EngTqCtrl_iv_n_EngLev2Sts_ "Complement of signal status of engine speed" UBYTE SABAL_STANDARD_S4_S3 1 100 253 255 ECU_ADDRESS 0xFFF85AA8 /end MEASUREMENT
/begin MEASUREMENT EngTqCtrl_iv_n_TuLev2Sts "Signal status of turbine speed, 0 - signal ok, 1 - substitute value, 2 - signal faulty" UBYTE SABAL_SIGNAL_STATUS_S4_S3 1 100 0 2 ECU_ADDRESS 0xFFF85AA9 /end MEASUREMENT
/begin MEASUREMENT EngTqCtrl_iv_n_TuLev2Sts_ "Complement of signal status of turbine speed" UBYTE SABAL_STANDARD_S4_S3 1 100 0 255 ECU_ADDRESS 0xFFF85AAA /end MEASUREMENT
/begin MEASUREMENT EngTqCtrl_m_EngTqMaxCensored "Maximum permissable gearbox torque with limitation of lowest value" SWORD SABAL_M_1NM_S4_S3 1 100 -1000 2000 ECU_ADDRESS 0xFFF85A3A /end MEASUREMENT
/begin MEASUREMENT EngTqCtrl_st_ctl_LimitGearboxProtection "Flag for active gearbox guard (begrenzender Getriebeschutz)" UBYTE SABAL_STANDARD_S4_S3 1 100 0 1 ECU_ADDRESS 0xFFF85AB3 /end MEASUREMENT
/begin MEASUREMENT EngTqCtrl_st_ctl_LimitNegEngTqCtrl "Flag signaling the limitation of torque intervention requests to a minimum value in case of turbine speed errors" UBYTE SABAL_STANDARD_S4_S3 1 100 0 1 ECU_ADDRESS 0xFFF85A9E /end MEASUREMENT
/begin MEASUREMENT EngTqCtrl_sv_ctl_EngTqCtrlReqModeSts "Signal status of intervention mode of engine intervention on fast path, 0 - signal ok, 1 - substitute value, 2 - signal faulty" UBYTE SABAL_SIGNAL_STATUS_S4_S3 1 100 0 2 ECU_ADDRESS 0xFFF85ABB /end MEASUREMENT
/begin MEASUREMENT EngTqCtrl_sv_ctl_EngTqCtrlReqMode "Intervention mode of engine intervention on fast path, 0 - no request, 1 - increase, 2 - decrease" UBYTE SABAL_STANDARD_S4_S3 1 100 0 2 ECU_ADDRESS 0xFFF85ABA /end MEASUREMENT
/begin MEASUREMENT EngTqCtrl_sv_m_EngTqCtrlReqSts "Signal status of engine intervention on fast path, 0 - signal ok, 1 - substitute value, 2 - signal faulty" UBYTE SABAL_SIGNAL_STATUS_S4_S3 1 100 0 2 ECU_ADDRESS 0xFFF85ACA /end MEASUREMENT
/begin MEASUREMENT EngTqCtrl_sv_m_EngTqCtrlReq "Engine intervention on fast path" SWORD SABAL_M_1NM_S4_S3 1 100 -1000 2000 ECU_ADDRESS 0xFFF85A5C /end MEASUREMENT
/begin MEASUREMENT EngTqCtrl_sv_ctl_EngTqCtrlReqPredModeSts "Signal status of the intervention mode of engine intervention on slow path, 0 - signal ok, 1 - substitute value, 2 - signal faulty" UBYTE SABAL_SIGNAL_STATUS_S4_S3 1 100 0 2 ECU_ADDRESS 0xFFF85ABF /end MEASUREMENT
/begin MEASUREMENT EngTqCtrl_sv_ctl_EngTqCtrlReqPredMode "Intervention mode of engine intervention on slow path, 0 - no request, 1 - increase, 2 - decrease" UBYTE SABAL_STANDARD_S4_S3 1 100 0 2 ECU_ADDRESS 0xFFF85ABE /end MEASUREMENT
/begin MEASUREMENT EngTqCtrl_sv_m_EngTqCtrlReqPredSts "Signal status of engine intervention on slow path, 0 - signal ok, 1 - substitute value, 2 - signal faulty" UBYTE SABAL_SIGNAL_STATUS_S4_S3 1 100 0 2 ECU_ADDRESS 0xFFF85AC9 /end MEASUREMENT
/begin MEASUREMENT EngTqCtrl_sv_m_EngTqCtrlReqPred "Engine intervention on slow path" SWORD SABAL_M_1NM_S4_S3 1 100 -1000 2000 ECU_ADDRESS 0xFFF85A5E /end MEASUREMENT
/begin MEASUREMENT EngTqCtrl_sv_ctl_ActvCylCtrl "Controlmode for Active Cyclinder Control Request (Cylinder Cut-Off) (EZA), 0 - EZA prohibited, 1 - EZA allowed, 2 - EZA requested" UBYTE SABAL_STANDARD_S4_S3 1 100 0 2 ECU_ADDRESS 0xFFF85AB8 /end MEASUREMENT
/begin MEASUREMENT EngTqCtrl_sv_ctl_ActvCylCtrlSts "Signal status of controlmode for Active Cyclinder Control Request (Cylinder Cut-Off) (EZA), 0 - EZA prohibited, 1 - EZA allowed, 2 - EZA requested" UBYTE SABAL_SIGNAL_STATUS_S4_S3 1 100 0 2 ECU_ADDRESS 0xFFF85AB9 /end MEASUREMENT
/begin MEASUREMENT EngTqCtrl_sv_f_NoPosEngTqIntvReqActive "Flag for suppression of the increasing torque intervention request, 0 - inactive, 1 - active" UBYTE SABAL_STANDARD_S4_S3 1 100 0 1 ECU_ADDRESS 0xFFF85AC6 /end MEASUREMENT
/begin MEASUREMENT EngTqCtrl_sv_f_NoNegEngTqIntvReqActive "Flag for suppression of the negative torque intervention request, 0 - inactive, 1 - active" UBYTE SABAL_STANDARD_S4_S3 1 100 0 1 ECU_ADDRESS 0xFFF85AC4 /end MEASUREMENT
/begin MEASUREMENT EngTqCtrl_sv_ctl_RelEngTqCtrl "Controlmode for absolute or relative engine torque intervention request 0 - ME absolut, 1 - ME relativ" UBYTE SABAL_STANDARD_S4_S3 1 100 0 1 ECU_ADDRESS 0xFFF85AC0 /end MEASUREMENT
/begin MEASUREMENT EngTqCtrl_sv_ctl_RelEngTqCtrlSts "Signal status of controlmode for absolute or relative Engine torque intervention request 0 - signal ok 1 - substitute value 2 - signal faulty" UBYTE SABAL_SIGNAL_STATUS_S4_S3 1 100 0 2 ECU_ADDRESS 0xFFF85AC1 /end MEASUREMENT
/begin MEASUREMENT EngTqCtrl_f_m_EngTqCtrlReqPosErr "error flag for increasing torque intervention" UBYTE SABAL_STANDARD_S4_S3 1 100 0 1 ECU_ADDRESS 0xFFF85AB1 /end MEASUREMENT
/begin MEASUREMENT EngTqCtrl_f_m_EngTqCtrlReqPosErr_ "Complement of error flag for increasing torque intervention" UBYTE SABAL_STANDARD_S4_S3 1 100 254 255 ECU_ADDRESS 0xFFF85AB2 /end MEASUREMENT
/begin MEASUREMENT EngTqCtrl_f_m_EngTqCtrlReqNegErr_ "Complement of error flag for negative torque intervention" UBYTE SABAL_STANDARD_S4_S3 1 100 254 255 ECU_ADDRESS 0xFFF85AB0 /end MEASUREMENT
/begin MEASUREMENT EngTqCtrl_f_m_EngTqCtrlReqNegErr "error flag for negative torque intervention" UBYTE SABAL_STANDARD_S4_S3 1 100 0 1 ECU_ADDRESS 0xFFF85AAF /end MEASUREMENT
/begin MEASUREMENT EngTqCtrl_f_NoPosEngTqIntvReqActive_ "Complement of flag for suppression of the increasing torque intervention request" UBYTE SABAL_STANDARD_S4_S3 1 100 254 255 ECU_ADDRESS 0xFFF85AAC /end MEASUREMENT
/begin MEASUREMENT EngTqCtrl_sv_f_NoNegEngTqIntvReqActive_ "Complement of flag for suppression of the negative torque intervention request" UBYTE SABAL_STANDARD_S4_S3 1 100 254 255 ECU_ADDRESS 0xFFF85AC5 /end MEASUREMENT
/begin MEASUREMENT EngTqCtrl_f_m_EI_Lev2Err "error flag for increasing torque intervention" UBYTE SABAL_STANDARD_S4_S3 1 100 0 1 ECU_ADDRESS 0xFFF85AAD /end MEASUREMENT
/begin MEASUREMENT EngTqCtrl_f_m_EI_Lev2Err_ "Complement of error flag for increasing torque intervention" UBYTE SABAL_STANDARD_S4_S3 1 100 254 255 ECU_ADDRESS 0xFFF85AAE /end MEASUREMENT
/begin MEASUREMENT EngTqCtrl_sv_ctl_EngTqCtrlReqMode_ "Complement of intervention mode of engine intervention on fast path" UBYTE SABAL_STANDARD_S4_S3 1 100 253 255 ECU_ADDRESS 0xFFF85ABD /end MEASUREMENT
/begin MEASUREMENT EngTqCtrl_sv_m_EngTqCtrlReq_ "Complement of engine intervention on fast path" SWORD SABAL_STANDARD_S4_S3 1 100 -32768 32767 ECU_ADDRESS 0xFFF85A60 /end MEASUREMENT
/begin MEASUREMENT EngTqCtrl_sv_m_EngTqCtrlReqSts_ "Complement of signal status of Engine intervention on fast path" UBYTE SABAL_STANDARD_S4_S3 1 100 253 255 ECU_ADDRESS 0xFFF85ACB /end MEASUREMENT
/begin MEASUREMENT EngTqCtrl_sv_ctl_EngTqCtrlReqModeSts_ "Complement of signal status of intervention mode of engine intervention on fast path" UBYTE SABAL_STANDARD_S4_S3 1 100 253 255 ECU_ADDRESS 0xFFF85ABC /end MEASUREMENT
/begin MEASUREMENT EngTqCtrl_f_ErrorConditionKFC1_NEGTRQREQ "Error condition for KFC1_NEGTRQREQ" UBYTE SABAL_STANDARD_S4_S3 1 100 0 1 ECU_ADDRESS 0xFFF85A94 /end MEASUREMENT
/begin MEASUREMENT EngTqCtrl_f_TestConditionErrHdl "Condition for call of the 0x1000 errorhandler" UBYTE SABAL_STANDARD_S4_S3 1 100 0 1 ECU_ADDRESS 0xFFF85A98 /end MEASUREMENT
/begin MEASUREMENT EngTqCtrl_f_ErrorConditionKFC_LEV2 "Error condition for KFC_LEV2" UBYTE SABAL_STANDARD_S4_S3 1 100 0 1 ECU_ADDRESS 0xFFF85A96 /end MEASUREMENT
/begin MEASUREMENT EngTqCtrl_f_ErrorType "Selected error type (KFA)" UBYTE SABAL_STANDARD_S4_S3 1 100 0 255 ECU_ADDRESS 0xFFF85A97 /end MEASUREMENT
/begin MEASUREMENT EngTqCtrl_f_ErrorConditionKFC1_NEGTRQREQ_ "Complement of error condition KFC1_NEGTRQREQ" UBYTE SABAL_STANDARD_S4_S3 1 100 0 255 ECU_ADDRESS 0xFFF85A95 /end MEASUREMENT
/begin MEASUREMENT EngTqCtrl_f_TestConditionErrHdl_ "Complement of condition for call of 0x1000 errorhandler" UBYTE SABAL_STANDARD_S4_S3 1 100 254 255 ECU_ADDRESS 0xFFF85A99 /end MEASUREMENT
/begin MEASUREMENT EngTqCtrl_sv_ctl_RelEngTqCtrlSts_ "Complement of signal status of controlmode for absolute or relative Engine torque intervention request" UBYTE SABAL_STANDARD_S4_S3 1 100 253 255 ECU_ADDRESS 0xFFF85AC2 /end MEASUREMENT
/begin MEASUREMENT EngTqCtrl_sv_ctl_RelEngTqCtrl_ "Complement of modeselection for absolute or relative Engine torque intervention request" UBYTE SABAL_STANDARD_S4_S3 1 100 254 255 ECU_ADDRESS 0xFFF85AC3 /end MEASUREMENT
/begin MEASUREMENT EngTqCtrl_m_PumpCensored "Censored and limited pump intake torque" SWORD SABAL_M_1NM_S4_S3 1 100 0 30 ECU_ADDRESS 0xFFF85A56 /end MEASUREMENT
/begin MEASUREMENT EngTqCtrl_m_Eng "Engine torque (without gearbox intervention)" SWORD SABAL_M_1NM_S4_S3 1 100 -1000 2000 ECU_ADDRESS 0xFFF85A54 /end MEASUREMENT
/begin MEASUREMENT EngTqCtrl_ctl_RelSyncRpm "Activation mode of engine speed request" UBYTE SABAL_STANDARD_S4_S3 1 100 0 1 ECU_ADDRESS 0xFFF85AAB /end MEASUREMENT
/begin MEASUREMENT EngTqCtrl_m_EngCrankSts "Signal status of crankshaft torque" UBYTE SABAL_SIGNAL_STATUS_S4_S3 1 100 0 2 ECU_ADDRESS 0xFFF85A9A /end MEASUREMENT
/begin MEASUREMENT EngTqCtrl_m_EngCrankSts_ "Complement of signal status of crankshaft torque" UBYTE SABAL_STANDARD_S4_S3 1 100 253 255 ECU_ADDRESS 0xFFF85A9B /end MEASUREMENT
/begin MEASUREMENT EngTqCtrl_m_EngLev2 "Engine torque (without gearbox intervention)" SWORD SABAL_M_1NM_S4_S3 1 100 -1000 2000 ECU_ADDRESS 0xFFF85A36 /end MEASUREMENT
/begin MEASUREMENT EngTqCtrl_m_EngLev2_ "Complement of engine torque" SWORD SABAL_M_1NM_S4_S3 1 100 -32768 32767 ECU_ADDRESS 0xFFF85A38 /end MEASUREMENT
/begin MEASUREMENT EngTqCtrl_m_EngSts "Signal status of engine torque" UBYTE SABAL_SIGNAL_STATUS_S4_S3 1 100 0 2 ECU_ADDRESS 0xFFF85A9C /end MEASUREMENT
/begin MEASUREMENT EngTqCtrl_m_EngSts_ "Complement of signal status of engine torque" UBYTE SABAL_STANDARD_S4_S3 1 100 253 255 ECU_ADDRESS 0xFFF85A9D /end MEASUREMENT
/begin MEASUREMENT EngTqLim_iv_m_EngTqMaxHyb "Maximum permissable torque for hybrid power train" SWORD SABAL_M_1NM_S4_S3 1 100 -32768 32767 ECU_ADDRESS 0xFFF85A68 /end MEASUREMENT
/begin MEASUREMENT EngTqLim_iv_m_EngTqMaxHyb_ "Complement Maximum permissable torque for hybrid power train" SWORD SABAL_M_1NM_S4_S3 1 100 -32768 32767 ECU_ADDRESS 0xFFF85A6A /end MEASUREMENT
/begin MEASUREMENT EngTqLim_iv_m_EngTqMax "Maximum permissable torque for power train by ATSYS" SWORD SABAL_M_1NM_S4_S3 1 100 -32768 32767 ECU_ADDRESS 0xFFF85A66 /end MEASUREMENT
/begin MEASUREMENT EngTqLim_iv_m_EngTqMax_ "Complement of maximum permissable torque for power train by ATSYS" SWORD SABAL_STANDARD_S4_S3 1 100 -32768 32767 ECU_ADDRESS 0xFFF85A6C /end MEASUREMENT
/begin MEASUREMENT EngTqLim_m_EngMaxSel "Intermediate selected signal of max. allowed engine torque" SWORD SABAL_M_1NM_S4_S3 1 100 -1000 2000 ECU_ADDRESS 0xFFF85A70 /end MEASUREMENT
/begin MEASUREMENT EngTqLim_sv_m_EngTqMax "Maximum allowed engine torque" SWORD SABAL_M_1NM_S4_S3 1 100 -1000 2000 ECU_ADDRESS 0xFFF85A6E /end MEASUREMENT
/begin MEASUREMENT EngTqLim_sv_m_EngTqMaxSts "Signal status of max. allowed engine torque" UBYTE SABAL_SIGNAL_STATUS_S4_S3 1 100 0 2 ECU_ADDRESS 0xFFF85ACE /end MEASUREMENT
/begin MEASUREMENT EngTqLim_m_EngTqMaxSts_ "Complement of signal status of max. allowed engine torque" UBYTE SABAL_STANDARD_S4_S3 1 100 253 255 ECU_ADDRESS 0xFFF85ACF /end MEASUREMENT
/begin MEASUREMENT EngTqLim_m_EngTqMax_ "Complement of maximum allowed engine torque" SWORD SABAL_STANDARD_S4_S3 1 100 -32768 32767 ECU_ADDRESS 0xFFF85A72 /end MEASUREMENT
/begin MEASUREMENT GbxSt_sv_GbxRdyToDrv "0000 0000b = system pressure to change gear not available Bit 0=not used Bit 1=not used Bit 2=system pressure increase Bit 3=not used Bit 4=not used Bit 5=system pressure decrease Bit 6=not used Bit 7= system pressure to change gear available" UBYTE VOID_SCALING_S4_S3 1 100 0 255 ECU_ADDRESS 0xFFF85AFB /end MEASUREMENT
/begin MEASUREMENT GbxSt_sv_GbxRdyToDrvSts "0 = Signal is OK with high Quality 1 = Signal is OK but it is calculated with substituted values 2 = Signal from engine speed is not valid and the IEP does not run" UBYTE VOID_SCALING_S4_S3 1 100 0 2 ECU_ADDRESS 0xFFF85AFC /end MEASUREMENT
/begin MEASUREMENT GbxSt_RdyToDrvSts "0 = Signal is OK with high Quality 1 = Signal is OK but it is calculated with substituted values 2 = Signal from engine speed is not valid and the IEP does not run" UBYTE VOID_SCALING_S4_S3 1 100 0 2 ECU_ADDRESS 0xFFF85AD7 /end MEASUREMENT
/begin MEASUREMENT GbxSt_loc_n_InpSpd "gearbox input spped primary calculated from engine speed whitch can be substitutet from gearbox turbine speed in case of an error" UWORD SABAL_N_1RPM_S4_S3 1 100 0 65535 ECU_ADDRESS 0xFFF85A76 /end MEASUREMENT
/begin MEASUREMENT GbxSt_loc_n_InpSpdSts "internal state of gearbox input speed" UBYTE SABAL_SIGNAL_STATUS_S4_S3 1 100 0 2 ECU_ADDRESS 0xFFF85AE5 /end MEASUREMENT
/begin MEASUREMENT GbxSt_RdyToDrv_by_HIS "Internal RdyToDrv State from HIS" UBYTE VOID_SCALING_S4_S3 1 100 0 255 ECU_ADDRESS 0xFFF85AD8 /end MEASUREMENT
/begin MEASUREMENT GbxSt_RdyToDrv_by_IEP "Internal RdyToDrv State from IEP" UBYTE VOID_SCALING_S4_S3 1 100 0 255 ECU_ADDRESS 0xFFF85AD9 /end MEASUREMENT
/begin MEASUREMENT GbxSt_RdyToDrv_by_IEPext "Mapping from the IEPext states to the internal RdyToDrv state from IEP" UBYTE VOID_SCALING_S4_S3 1 100 0 255 ECU_ADDRESS 0xFFF85ADA /end MEASUREMENT
/begin MEASUREMENT GbxSt_p_SysFromEngSpd "Calculated pressure areas from input speed" UBYTE SABAL_STANDARD_S4_S3 1 100 0 4 ECU_ADDRESS 0xFFF85AE8 /end MEASUREMENT
/begin MEASUREMENT GbxSt_f_DlyRdyToDrvColdPwrUpExe "First ready to drive delay time is executed after cold power up" UBYTE VOID_SCALING_S4_S3 1 100 0 1 ECU_ADDRESS 0xFFF85ADC /end MEASUREMENT
/begin MEASUREMENT GbxSt_Idx_n_EngTemp "" UBYTE VOID_SCALING_S4_S3 1 100 0 4 ECU_ADDRESS 0xFFF85AD1 /end MEASUREMENT
/begin MEASUREMENT GbxSt_f_DlyRdyToDrvColdPwrUpExeOld "First ready to drive delay time is executed after cold power up" UBYTE VOID_SCALING_S4_S3 1 100 0 1 ECU_ADDRESS 0xFFF85ADD /end MEASUREMENT
/begin MEASUREMENT GbxSt_loc_t_HoldGbxSt "time, how long the state gearbox ready to drive must be hold, if the state gearbox ready to drive is not longer availabel" UBYTE SABAL_T_TIMER_10MS_S4_S3 1 100 0 2550 ECU_ADDRESS 0xFFF900B3 /end MEASUREMENT
/begin MEASUREMENT GbxSt_RdyToDrv_by_nEng "Internal RdyToDrv State from the sprocket driven pump" UBYTE VOID_SCALING_S4_S3 1 100 0 255 ECU_ADDRESS 0xFFF85ADB /end MEASUREMENT
/begin MEASUREMENT GbxSt_RdyToDrv "0000 0000b = system pressure to change gear not available Bit 0=not used Bit 1=not used Bit 2=system pressure increase Bit 3=not used Bit 4=not used Bit 5=system pressure decrease Bit 6=not used Bit 7= system pressure to change gear available" UBYTE VOID_SCALING_S4_S3 1 100 0 255 ECU_ADDRESS 0xFFF85AD2 /end MEASUREMENT
/begin MEASUREMENT GbxSt_RdyToDrvHldSts "0 = Signal is OK with high Quality 1 = Signal is OK but it is calculated with substituted values 2 = Signal from engine speed is not valid and the IEP does not run" UBYTE VOID_SCALING_S4_S3 1 100 0 2 ECU_ADDRESS 0xFFF85AD5 /end MEASUREMENT
/begin MEASUREMENT GbxSt_tmr_HoldGbxSt "" UBYTE SABAL_T_TIMER_10MS_S4_S3 1 100 0 2550 ECU_ADDRESS 0xFFF85AEA /end MEASUREMENT
/begin MEASUREMENT GbxSt_RdyToDrvHld "0000 0000b = system pressure to change gear not available Bit 0=not used Bit 1=not used Bit 2=system pressure increase Bit 3=not used Bit 4=not used Bit 5=system pressure decrease Bit 6=not used Bit 7= system pressure to change gear available" UBYTE VOID_SCALING_S4_S3 1 100 0 255 ECU_ADDRESS 0xFFF85AD3 /end MEASUREMENT
/begin MEASUREMENT GbxSt_RdyToDrvHldOld "0000 0000b = system pressure to change gear not available Bit 0=not used Bit 1=not used Bit 2=system pressure increase Bit 3=not used Bit 4=not used Bit 5=system pressure decrease Bit 6=not used Bit 7= system pressure to change gear available" UBYTE VOID_SCALING_S4_S3 1 100 0 255 ECU_ADDRESS 0xFFF85AD4 /end MEASUREMENT
/begin MEASUREMENT GbxSt_RdyToDrvHldStsOld "0 = Signal is OK with high Quality 1 = Signal is OK but it is calculated with substituted values 2 = Signal from engine speed is not valid and the IEP does not run" UBYTE VOID_SCALING_S4_S3 1 100 0 2 ECU_ADDRESS 0xFFF85AD6 /end MEASUREMENT
/begin MEASUREMENT GbxSt_loc_c_OilTrans "transmission oil temperature" UBYTE SABAL_C_1CEL_M40_S4_S3 1 100 -40 215 ECU_ADDRESS 0xFFF85AE0 /end MEASUREMENT
/begin MEASUREMENT GbxSt_loc_c_OilTransSts "signal status of transmission oil temperature" UBYTE SABAL_SIGNAL_STATUS_S4_S3 1 100 0 2 ECU_ADDRESS 0xFFF85AE1 /end MEASUREMENT
/begin MEASUREMENT GbxSt_loc_f_RemStrt "Engine remote start" UBYTE SABAL_STANDARD_S4_S3 1 100 0 4 ECU_ADDRESS 0xFFF85AE2 /end MEASUREMENT
/begin MEASUREMENT GbxSt_loc_f_RemStrtSts "Status of Engine remote start" UBYTE SABAL_SIGNAL_STATUS_S4_S3 1 100 0 2 ECU_ADDRESS 0xFFF85AE3 /end MEASUREMENT
/begin MEASUREMENT GbxSt_loc_n_Eng "Engine speed" UWORD SABAL_N_1RPM_S4_S3 1 100 0 65535 ECU_ADDRESS 0xFFF85A74 /end MEASUREMENT
/begin MEASUREMENT GbxSt_loc_n_EngSts "state of Engine speed" UBYTE SABAL_SIGNAL_STATUS_S4_S3 1 100 0 2 ECU_ADDRESS 0xFFF85AE4 /end MEASUREMENT
/begin MEASUREMENT GbxSt_loc_n_Tu "gearbox input speed" UWORD SABAL_N_1RPM_S4_S3 1 100 0 65535 ECU_ADDRESS 0xFFF85A78 /end MEASUREMENT
/begin MEASUREMENT GbxSt_loc_n_TuSts "signal state of the gearbox input speed" UBYTE SABAL_SIGNAL_STATUS_S4_S3 1 100 0 255 ECU_ADDRESS 0xFFF85AE6 /end MEASUREMENT
/begin MEASUREMENT GbxSt_loc_v_FzgByNab "vehicle speed calculated from the output speed" UWORD SABAL_V_1KMH16_S4_S3 1 100 0 4095 ECU_ADDRESS 0xFFF85A7A /end MEASUREMENT
/begin MEASUREMENT GbxSt_loc_v_FzgByNabSts "signal state of vehicle speed by Nab" UBYTE SABAL_SIGNAL_STATUS_S4_S3 1 100 0 255 ECU_ADDRESS 0xFFF85AE7 /end MEASUREMENT
/begin MEASUREMENT GbxSt_iv_ignition "State of ignition" UBYTE SABAL_STANDARD_S4_S3 1 100 0 4 ECU_ADDRESS 0xFFF85AEF /end MEASUREMENT
/begin MEASUREMENT GbxSt_iv_ignitionSts "Signal state of ignition" UBYTE SABAL_SIGNAL_STATUS_S4_S3 1 100 0 2 ECU_ADDRESS 0xFFF85AF0 /end MEASUREMENT
/begin MEASUREMENT GbxSt_iv_pos "Position Shifter" UBYTE SABAL_STANDARD_S4_S3 1 100 0 8 ECU_ADDRESS 0xFFF85AF3 /end MEASUREMENT
/begin MEASUREMENT GbxSt_iv_IEPSt "state of IEP" UBYTE VOID_SCALING_S4_S3 1 100 0 4 ECU_ADDRESS 0xFFF85AEB /end MEASUREMENT
/begin MEASUREMENT GbxSt_iv_n_Eng "Engine speed" UWORD SABAL_N_1RPM_S4_S3 1 100 0 65535 ECU_ADDRESS 0xFFF85A7E /end MEASUREMENT
/begin MEASUREMENT GbxSt_iv_n_EngSts "state of Engine speed" UBYTE SABAL_SIGNAL_STATUS_S4_S3 1 100 0 2 ECU_ADDRESS 0xFFF85AF1 /end MEASUREMENT
/begin MEASUREMENT GbxSt_iv_c_OilTrans "transmission oil temperature" UBYTE SABAL_C_1CEL_M40_S4_S3 1 100 -40 215 ECU_ADDRESS 0xFFF85AED /end MEASUREMENT
/begin MEASUREMENT GbxSt_iv_c_OilTransSts "signal status of transmission oil temperature" UBYTE SABAL_SIGNAL_STATUS_S4_S3 1 100 0 2 ECU_ADDRESS 0xFFF85AEE /end MEASUREMENT
/begin MEASUREMENT GbxSt_iv_n_Tu "gearbox input speed" UWORD SABAL_N_1RPM_S4_S3 1 100 0 65535 ECU_ADDRESS 0xFFF85A80 /end MEASUREMENT
/begin MEASUREMENT GbxSt_iv_n_TuSts "signal state of the gearbox input speed" UBYTE SABAL_SIGNAL_STATUS_S4_S3 1 100 0 255 ECU_ADDRESS 0xFFF85AF2 /end MEASUREMENT
/begin MEASUREMENT GbxSt_iv_v_FzgByNab "vehicle speed calculated from the output speed" UWORD SABAL_V_1KMH16_S4_S3 1 100 0 4095 ECU_ADDRESS 0xFFF85A82 /end MEASUREMENT
/begin MEASUREMENT GbxSt_iv_v_FzgByNabSts "signal state of vehicle speed by Nab" UBYTE SABAL_SIGNAL_STATUS_S4_S3 1 100 0 255 ECU_ADDRESS 0xFFF85AF4 /end MEASUREMENT
/begin MEASUREMENT GbxSt_loc_OneTimeInitState "0 = Systempressure to change gear not available; 1 = Systempressure invrease; Systempressure to change gear avaulable" UBYTE SABAL_STANDARD_S4_S3 1 100 0 2 ECU_ADDRESS 0xFFF85ADE /end MEASUREMENT
/begin MEASUREMENT GbxSt_tmr_DlyRdyToDrvColdPwrUpbyNInSpd "Time to delay ready to drive by gearbox input speed during a cold start up in according to the gearbox temperature" UBYTE SABAL_T_TIMER_100MS_S4_S3 1 100 0 15000 ECU_ADDRESS 0xFFF85AE9 /end MEASUREMENT
/begin MEASUREMENT GbxSt_loc_OneTimeInitStateMod "0 = Systempressure to change gear not available; 1 = Systempressure invrease; Systempressure to change gear avaulable" UBYTE SABAL_STANDARD_S4_S3 1 100 0 2 ECU_ADDRESS 0xFFF85ADF /end MEASUREMENT
/begin MEASUREMENT GbxSt_tmr_DebGbxSt2ToGbxSt3 "" UBYTE SABAL_T_TIMER_10MS_S4_S3 1 100 0 2550 ECU_ADDRESS 0xFFF85AD0 /end MEASUREMENT
/begin MEASUREMENT GbxSt_tmr_DlyRdyToDrv "Time to delay ready to drive by gearbox input speed during a cold start up in according to the gearbox temperature" UWORD SABAL_T_TIMER_10MS_S4_S3 1 100 0 15000 ECU_ADDRESS 0xFFF85A7C /end MEASUREMENT
/begin MEASUREMENT TqReqMon_sv_KFC1_EIFaultType "Type of Engine Intervention Fault (Primary Fault Code for Development Phase)" UBYTE SABAL_STANDARD_S4_S3 1 100 0 255 ECU_ADDRESS 0xFFF86860 /end MEASUREMENT
/begin MEASUREMENT TqReqMon_sv_KFC_EIFaultType "Type of Engine Intervention Fault (Secondary / Shadow Fault Code for Series)" UBYTE SABAL_STANDARD_S4_S3 1 100 0 255 ECU_ADDRESS 0xFFF86861 /end MEASUREMENT
/begin MEASUREMENT TqReqMon_f_ReinitErr "Error has been entered, reinitialize environmental conditions" UBYTE SABAL_STANDARD_S4_S3 1 100 0 1 BIT_MASK 0x1 ECU_ADDRESS 0xFFF86850 /end MEASUREMENT
/begin MEASUREMENT TqReqMon_f_SetKFC1_INTME "Condition to set KFC1_INTME (Primary Fault Code for Development Phase)" UBYTE SABAL_STANDARD_S4_S3 1 100 0 1 BIT_MASK 0x1 ECU_ADDRESS 0xFFF86851 /end MEASUREMENT
/begin MEASUREMENT TqReqMon_f_SetKFC_INTME "Condition to set KFC_INTME (Secondary / Shadow Fault Code for Series Status)" UBYTE SABAL_STANDARD_S4_S3 1 100 0 1 BIT_MASK 0x1 ECU_ADDRESS 0xFFF86852 /end MEASUREMENT
/begin MEASUREMENT TqReqMon_ctl_BasicConditionsFulfilled "Bitmask for fulfilled Basic-Conditions" UWORD SABAL_STANDARD_S4_S3 1 100 0 65535 ECU_ADDRESS 0xFFF86528 /end MEASUREMENT
/begin MEASUREMENT TqReqMon_f_BasicConditionsFulfilled "Basic condition fulfilled" UBYTE SABAL_STANDARD_S4_S3 1 100 0 1 BIT_MASK 0x1 ECU_ADDRESS 0xFFF86848 /end MEASUREMENT
/begin MEASUREMENT TqReqMon_tmr_EIMonDelay "Timer for delaying start integration" UBYTE SABAL_T_TIMER_10MS_S4_S3 1 100 0 2550 ECU_ADDRESS 0xFFF86859 /end MEASUREMENT
/begin MEASUREMENT TqReqMon_f_TmrDel "Timer for delaying start integration is active" UBYTE SABAL_STANDARD_S4_S3 1 100 0 1 BIT_MASK 0x1 ECU_ADDRESS 0xFFF86855 /end MEASUREMENT
/begin MEASUREMENT TqReqMon_tmr_EIMonActivDelay "Timer for delaying stop integration" UBYTE SABAL_T_TIMER_10MS_S4_S3 1 100 0 2550 ECU_ADDRESS 0xFFF86858 /end MEASUREMENT
/begin MEASUREMENT TqReqMon_f_TmrActDel "Timer for delaying start integration is active" UBYTE SABAL_STANDARD_S4_S3 1 100 0 1 BIT_MASK 0x1 ECU_ADDRESS 0xFFF86854 /end MEASUREMENT
/begin MEASUREMENT TqReqMon_f_IntervChanged "Change of the intervention mode" UBYTE SABAL_STANDARD_S4_S3 1 100 0 1 BIT_MASK 0x1 ECU_ADDRESS 0xFFF8684E /end MEASUREMENT
/begin MEASUREMENT TqReqMon_f_NewGearInterv "Trigger signal for new gear intervention during gearshift" UBYTE SABAL_STANDARD_S4_S3 1 100 0 1 BIT_MASK 0x1 ECU_ADDRESS 0xFFF8684F /end MEASUREMENT
/begin MEASUREMENT TqReqMon_f_EIMonActiv "Engine intervention monitoring active" UBYTE SABAL_STANDARD_S4_S3 1 100 0 1 BIT_MASK 0x1 ECU_ADDRESS 0xFFF8685A /end MEASUREMENT
/begin MEASUREMENT TqReqMon_f_Downshift_EIStart "Downshift at start of intervention monitoring" UBYTE SABAL_STANDARD_S4_S3 1 100 0 1 BIT_MASK 0x1 ECU_ADDRESS 0xFFF86849 /end MEASUREMENT
/begin MEASUREMENT TqReqMon_ThrottleFlap_EIStart "Throttle flap at start of intervention monitoring" UBYTE SABAL_100PROZENT254_S4_S3 1 100 0 100 ECU_ADDRESS 0xFFF8683B /end MEASUREMENT
/begin MEASUREMENT TqReqMon_m_EngInterventionMode_EIStart "Engine intervention torque request mode at start of intervention monitoring" UBYTE SABAL_TORQE_REQUEST_MODE_S4_S3 1 100 0 3 ECU_ADDRESS 0xFFF86840 /end MEASUREMENT
/begin MEASUREMENT TqReqMon_m_Eng_EIStart "Engine torque at start of intervention monitoring" SWORD SABAL_M_1NM_S4_S3 1 100 -1000 2000 ECU_ADDRESS 0xFFF86518 /end MEASUREMENT
/begin MEASUREMENT TqReqMon_tmr_Integral_EI "Timer integration time" UWORD SABAL_T_TIMER_10MS_S4_S3 1 100 0 16000 ECU_ADDRESS 0xFFF8652C /end MEASUREMENT
/begin MEASUREMENT TqReqMon_f_IntMaxTime "Stop integration, if maximal time has been reached" UBYTE SABAL_STANDARD_S4_S3 1 100 0 1 BIT_MASK 0x1 ECU_ADDRESS 0xFFF8684C /end MEASUREMENT
/begin MEASUREMENT TqReqMon_f_IntMinTime "Miniimal time has passed for analysis" UBYTE SABAL_STANDARD_S4_S3 1 100 0 1 BIT_MASK 0x1 ECU_ADDRESS 0xFFF8684D /end MEASUREMENT
/begin MEASUREMENT TqReqMon_ctl_EIMonBreak "Bitmask for fulfilled Break-Conditions" UBYTE SABAL_STANDARD_S4_S3 1 100 0 255 ECU_ADDRESS 0xFFF86847 /end MEASUREMENT
/begin MEASUREMENT TqReqMon_f_EIMonBreak "Abort engine intervention monitoring" UBYTE SABAL_STANDARD_S4_S3 1 100 0 1 BIT_MASK 0x1 ECU_ADDRESS 0xFFF8684A /end MEASUREMENT
/begin MEASUREMENT TqReqMon_f_EI_IntegralMonActive "Engine intervention integral analysis active" UBYTE SABAL_STANDARD_S4_S3 1 100 0 1 BIT_MASK 0x1 ECU_ADDRESS 0xFFF8684B /end MEASUREMENT
/begin MEASUREMENT TqReqMon_f_StartAnalysis "Start analysis of calculated integrals" UBYTE SABAL_STANDARD_S4_S3 1 100 0 1 BIT_MASK 0x1 ECU_ADDRESS 0xFFF86853 /end MEASUREMENT
/begin MEASUREMENT TqReqMon_m_Integral_EI_realizedRelativRaw "Realized engine intervention relativ calculated in 10 ms task" SLONG SABAL_MI_1NMS100_S4_S3 1 100 -21474836 21474836 ECU_ADDRESS 0xFFF85B58 /end MEASUREMENT
/begin MEASUREMENT TqReqMon_m_Integral_ReqAboveUth "Torque summation of intervention request above system limit" SLONG SABAL_MI_1NMS100_S4_S3 1 100 -21474836 21474836 ECU_ADDRESS 0xFFF85B64 /end MEASUREMENT
/begin MEASUREMENT TqReqMon_m_Integral_ReqBelowLth "Torque summation of intervention request below system limit" SLONG SABAL_MI_1NMS100_S4_S3 1 100 -21474836 21474836 ECU_ADDRESS 0xFFF85B68 /end MEASUREMENT
/begin MEASUREMENT TqReqMon_m_Integral_EI_requestedRelativRaw "Requested engine intervention relativ calculated in 10 ms task" SLONG SABAL_MI_1NMS100_S4_S3 1 100 -21474836 21474836 ECU_ADDRESS 0xFFF85B60 /end MEASUREMENT
/begin MEASUREMENT TqReqMon_m_Integral_EI_requestedRelativAbs "Requested engine intervention relativ calculated absolute value" UWORD SABAL_MI_1NMS_S4_S3 1 100 0 65535 ECU_ADDRESS 0xFFF8652A /end MEASUREMENT
/begin MEASUREMENT TqReqMon_f_m_IntEIReqValid "Requested integral is large enough for evaluation" UBYTE SABAL_STANDARD_S4_S3 1 100 0 1 BIT_MASK 0x1 ECU_ADDRESS 0xFFF86856 /end MEASUREMENT
/begin MEASUREMENT TqReqMon_idx_EIMonTh "Index of engine intervention 0=Upshift with increase 1=Downshift with increase 2=Upshift with decrease 3=Downshift with decrease" UBYTE SABAL_STANDARD_S4_S3 1 100 0 3 ECU_ADDRESS 0xFFF86857 /end MEASUREMENT
/begin MEASUREMENT TqReqMon_perc_EIRealizedPUth "Upper threshold of intensity for primary fault" SWORD SABAL_PROZENT_S4_S3 1 100 -1000 1000 ECU_ADDRESS 0xFFF8651C /end MEASUREMENT
/begin MEASUREMENT TqReqMon_perc_EIRealizedPLth "Lower threshold of intensity for primary fault" SWORD SABAL_PROZENT_S4_S3 1 100 -1000 1000 ECU_ADDRESS 0xFFF8651A /end MEASUREMENT
/begin MEASUREMENT TqReqMon_perc_EIRealizedSUth "Upper threshold of intensity for secondary fault" SWORD SABAL_PROZENT_S4_S3 1 100 -1000 1000 ECU_ADDRESS 0xFFF86520 /end MEASUREMENT
/begin MEASUREMENT TqReqMon_perc_EIRealizedSLth "Lower threshold of intensity for secondary fault" SWORD SABAL_PROZENT_S4_S3 1 100 -1000 1000 ECU_ADDRESS 0xFFF8651E /end MEASUREMENT
/begin MEASUREMENT TqReqMon_idx_EIMode_Uth "Index for interpolation of Upper threshold" UBYTE SABAL_STANDARD_S4_S3 1 100 0 4 ECU_ADDRESS 0xFFF8683F /end MEASUREMENT
/begin MEASUREMENT TqReqMon_idx_EIMode_Lth "Index for interpolation of Lower threshold" UBYTE SABAL_STANDARD_S4_S3 1 100 0 4 ECU_ADDRESS 0xFFF8683E /end MEASUREMENT
/begin MEASUREMENT TqReqMon_idx_EIFaultType_Lth "Bitnumber for adressing faulttype \"lower threshold\"" UBYTE SABAL_STANDARD_S4_S3 1 100 0 7 ECU_ADDRESS 0xFFF8683C /end MEASUREMENT
/begin MEASUREMENT TqReqMon_idx_EIFaultType_Uth "Bitnumber for adressing faulttype \"upper threshold\"" UBYTE SABAL_STANDARD_S4_S3 1 100 0 7 ECU_ADDRESS 0xFFF8683D /end MEASUREMENT
/begin MEASUREMENT TqReqMon_x_m_EI_realizedPercental "Engine intervention realized percental" SWORD SABAL_PROZENT_S4_S3 1 100 -32768 32767 ECU_ADDRESS 0xFFF8652E /end MEASUREMENT
/begin MEASUREMENT TqReqMon_m_Integral_EI_requestedRelativMod "Weighted integral of requested engine intervention" SLONG SABAL_MI_1NMS100_S4_S3 1 100 -21474836 21474836 ECU_ADDRESS 0xFFF85B5C /end MEASUREMENT
/begin MEASUREMENT TqReqMon_iv_m_EngRedLim "Minimal torque by ignition angle retardation" SWORD SABAL_M_1NM_S4_S3 1 100 -32768 32767 ECU_ADDRESS 0xFFF86534 /end MEASUREMENT
/begin MEASUREMENT TqReqMon_iv_m_Reserve "Torque reserve" SWORD SABAL_M_1NM_S4_S3 1 100 -1024 1023 ECU_ADDRESS 0xFFF86536 /end MEASUREMENT
/begin MEASUREMENT TqReqMon_iv_m_ReserveSts "Signal status of torque reserve" UBYTE SABAL_SIGNAL_STATUS_S4_S3 1 100 0 2 ECU_ADDRESS 0xFFF8685E /end MEASUREMENT
/begin MEASUREMENT TqReqMon_iv_n_TuLev2Sts "Signal status of turbine speed" UBYTE SABAL_SIGNAL_STATUS_S4_S3 1 100 0 2 ECU_ADDRESS 0xFFF8685F /end MEASUREMENT
/begin MEASUREMENT TqReqMon_iv_c_OilTrans "Gearbox oil temperature" UBYTE SABAL_C_1CEL_M40_S4_S3 1 100 -40 215 ECU_ADDRESS 0xFFF8685B /end MEASUREMENT
/begin MEASUREMENT TqReqMon_iv_m_Crank "Crankshaft torque" SWORD SABAL_M_1NM_S4_S3 1 100 -400 1640 ECU_ADDRESS 0xFFF86530 /end MEASUREMENT
/begin MEASUREMENT TqReqMon_iv_m_CrankSts "Signal status of crankshaft torque" UBYTE SABAL_SIGNAL_STATUS_S4_S3 1 100 0 2 ECU_ADDRESS 0xFFF8685C /end MEASUREMENT
/begin MEASUREMENT TqReqMon_iv_m_Eng "Engine torque" SWORD SABAL_M_1NM_S4_S3 1 100 -400 1640 ECU_ADDRESS 0xFFF86532 /end MEASUREMENT
/begin MEASUREMENT TqReqMon_iv_m_EngSts "Signal status of engine torque" UBYTE SABAL_SIGNAL_STATUS_S4_S3 1 100 0 2 ECU_ADDRESS 0xFFF8685D /end MEASUREMENT
/begin MEASUREMENT TqReqMon_iv_ActualGear "Actual gear" SBYTE SABAL_STANDARD_S4_S3 1 100 -1 9 ECU_ADDRESS 0xFFF86841 /end MEASUREMENT
/begin MEASUREMENT TqReqMon_iv_TargetGear "Target gear" SBYTE SABAL_STANDARD_S4_S3 1 100 -1 9 ECU_ADDRESS 0xFFF86842 /end MEASUREMENT
/begin MEASUREMENT TqReqMon_iv_ThrottleFlap "Throttle flap" UBYTE SABAL_100PROZENT254_S4_S3 1 100 0 100 ECU_ADDRESS 0xFFF86843 /end MEASUREMENT
/begin MEASUREMENT TqReqMon_iv_ThrottleFlapSts "Signal status of throttle flap" UBYTE SABAL_SIGNAL_STATUS_S4_S3 1 100 0 2 ECU_ADDRESS 0xFFF86844 /end MEASUREMENT
/begin MEASUREMENT TqReqMon_iv_m_EngIntervention "Engine intervention torque request" SWORD SABAL_M_1NM_S4_S3 1 100 -400 1640 ECU_ADDRESS 0xFFF86522 /end MEASUREMENT
/begin MEASUREMENT TqReqMon_iv_m_EngInterventionMode "Engine intervention torque request mode" UBYTE SABAL_STANDARD_S4_S3 1 100 0 3 ECU_ADDRESS 0xFFF86845 /end MEASUREMENT
/begin MEASUREMENT TqReqMon_iv_m_EngMax "Maximal permissable engine torque" SWORD SABAL_M_1NM_S4_S3 1 100 -400 1640 ECU_ADDRESS 0xFFF86524 /end MEASUREMENT
/begin MEASUREMENT TqReqMon_iv_n_Eng "Engine speed" UWORD SABAL_N_1RPM_S4_S3 1 100 0 65535 ECU_ADDRESS 0xFFF86526 /end MEASUREMENT
/begin MEASUREMENT TqReqMon_iv_n_EngLev2Sts "Signal status of engine speed" UBYTE SABAL_SIGNAL_STATUS_S4_S3 1 100 0 2 ECU_ADDRESS 0xFFF86846 /end MEASUREMENT
/begin COMPU_METHOD eLeverPosRN_S1_S3 "" TAB_VERB "%2.0" "" COMPU_TAB_REF eLeverPosRN_S1_S3 /end COMPU_METHOD
/begin COMPU_METHOD eShiftpattern_S1_S3 "" TAB_VERB "%2.0" "" COMPU_TAB_REF eShiftpattern_S1_S3 /end COMPU_METHOD
/begin COMPU_METHOD eBlockingMatrix_S1_S3 "" TAB_VERB "%2.0" "" COMPU_TAB_REF eBlockingMatrix_S1_S3 /end COMPU_METHOD
/begin COMPU_METHOD ePaddleCommand_S1_S3 "" TAB_VERB "%2.0" "" COMPU_TAB_REF ePaddleCommand_S1_S3 /end COMPU_METHOD
/begin COMPU_METHOD eTabPrioShifter_S1_S3 "" TAB_VERB "%2.0" "" COMPU_TAB_REF eTabPrioShifter_S1_S3 /end COMPU_METHOD
/begin COMPU_METHOD eSourcePrio_S1_S3 "" TAB_VERB "%2.0" "" COMPU_TAB_REF eSourcePrio_S1_S3 /end COMPU_METHOD
/begin COMPU_METHOD eMode4_S1_S3 "" TAB_VERB "%2.0" "" COMPU_TAB_REF eMode4_S1_S3 /end COMPU_METHOD
/begin COMPU_METHOD eCtlShiftlock_x_S1_S3 "" TAB_VERB "%2.0" "" COMPU_TAB_REF eCtlShiftlock_x_S1_S3 /end COMPU_METHOD
/begin COMPU_METHOD eCtlShiftlock_y_S1_S3 "" TAB_VERB "%2.0" "" COMPU_TAB_REF eCtlShiftlock_y_S1_S3 /end COMPU_METHOD
/begin COMPU_METHOD eFctReactMatrix_S1_S3 "" TAB_VERB "%2.0" "" COMPU_TAB_REF eFctReactMatrix_S1_S3 /end COMPU_METHOD
/begin COMPU_METHOD eRow15_S1_S3 "" TAB_VERB "%2.0" "" COMPU_TAB_REF eRow15_S1_S3 /end COMPU_METHOD
/begin COMPU_METHOD SBW_TIMER_10S_S1_S3 "int = ((phys * 1) / 10) - (0) s" RAT_FUNC "%2.0" "s" COEFFS 0 1 -0 0 0 10 /end COMPU_METHOD
/begin COMPU_METHOD SBW_TIMER_20MS_S1_S3 "int = ((phys * 1) / 20) - (0) ms" RAT_FUNC "%2.0" "ms" COEFFS 0 1 -0 0 0 20 /end COMPU_METHOD
/begin COMPU_METHOD SBW_TIMER_50MS_S1_S3 "int = ((phys * 1) / 50) - (0) ms" RAT_FUNC "%2.0" "ms" COEFFS 0 1 -0 0 0 50 /end COMPU_METHOD
/begin COMPU_METHOD SAB_STANDARD_S2_S3 "int = ((phys * 1) / 1) - (0) -" RAT_FUNC "%2.0" "-" COEFFS 0 1 -0 0 0 1 /end COMPU_METHOD
/begin COMPU_METHOD SAB_L_1MM_S2_S3 "int = ((phys * 1) / 1) - (0) mm" RAT_FUNC "%2.0" "mm" COEFFS 0 1 -0 0 0 1 /end COMPU_METHOD
/begin COMPU_METHOD SAB_N_RPM_S2_S3 "int = ((phys * 1) / 1) - (0) 1/min" RAT_FUNC "%2.0" "1/min" COEFFS 0 1 -0 0 0 1 /end COMPU_METHOD
/begin COMPU_METHOD SAB_PROZENT10_S2_S3 "int = ((phys * 10) / 1) - (0) %" RAT_FUNC "%5.3" "%" COEFFS 0 10 -0 0 0 1 /end COMPU_METHOD
/begin COMPU_METHOD SAB_T_TIMER_10MS_S2_S3 "int = ((phys * 1) / 10) - (0) ms" RAT_FUNC "%5.3" "ms" COEFFS 0 1 -0 0 0 10 /end COMPU_METHOD
/begin COMPU_METHOD SAB_T_TIMER_100MS_S2_S3 "int = ((phys * 1) / 100) - (0) ms" RAT_FUNC "%5.3" "ms" COEFFS 0 1 -0 0 0 100 /end COMPU_METHOD
/begin COMPU_METHOD SAB_T_TIMER_1S_S2_S3 "int = ((phys * 1) / 1) - (0) s" RAT_FUNC "%2.0" "s" COEFFS 0 1 -0 0 0 1 /end COMPU_METHOD
/begin COMPU_METHOD SAB_N_1RPM_S2_S3 "int = ((phys * 1) / 1) - (0) 1/min" RAT_FUNC "%2.0" "1/min" COEFFS 0 1 -0 0 0 1 /end COMPU_METHOD
/begin COMPU_METHOD SAB_C_CGT_1CEL_M40_S2_S3 "int = ((phys * 1) / 1) - (-40) Grad Celsius" RAT_FUNC "%2.0" "Grad Celsius" COEFFS 0 1 40 0 0 1 /end COMPU_METHOD
/begin COMPU_METHOD SAB_M_1NM_S2_S3 "int = ((phys * 1) / 1) - (0) Nm" RAT_FUNC "%2.0" "Nm" COEFFS 0 1 -0 0 0 1 /end COMPU_METHOD
/begin COMPU_METHOD SAB_K10000_M10_S2_S3 "int = ((phys * 10000) / 1) - (-100000) -" RAT_FUNC "%6.4" "-" COEFFS 0 10000 100000 0 0 1 /end COMPU_METHOD
/begin COMPU_METHOD SAB_K1000_S2_S3 "int = ((phys * 1000) / 1) - (0) -" RAT_FUNC "%5.3" "-" COEFFS 0 1000 -0 0 0 1 /end COMPU_METHOD
/begin COMPU_METHOD SAB_K10_S2_S3 "int = ((phys * 10) / 1) - (0) -" RAT_FUNC "%5.3" "-" COEFFS 0 10 -0 0 0 1 /end COMPU_METHOD
/begin COMPU_METHOD SAB_T_10MS_S2_S3 "int = ((phys * 1) / 10) - (0) ms" RAT_FUNC "%5.3" "ms" COEFFS 0 1 -0 0 0 10 /end COMPU_METHOD
/begin COMPU_METHOD SAB_T_1MIN_S2_S3 "int = ((phys * 1) / 1) - (0) min" RAT_FUNC "%2.0" "min" COEFFS 0 1 -0 0 0 1 /end COMPU_METHOD
/begin COMPU_METHOD SAB_T_S_S2_S3 "int = ((phys * 1) / 1) - (0) sec" RAT_FUNC "%2.0" "sec" COEFFS 0 1 -0 0 0 1 /end COMPU_METHOD
/begin COMPU_METHOD SAB_T_S100_S2_S3 "int = ((phys * 100) / 1) - (0) s" RAT_FUNC "%5.3" "s" COEFFS 0 100 -0 0 0 1 /end COMPU_METHOD
/begin COMPU_METHOD SAB_U_1VOLT1000_S2_S3 "int = ((phys * 1000) / 1) - (0) Volt" RAT_FUNC "%5.3" "Volt" COEFFS 0 1000 -0 0 0 1 /end COMPU_METHOD
/begin COMPU_METHOD SAB_U_VOLT1000_S2_S3 "int = ((phys * 1000) / 1) - (0) V" RAT_FUNC "%5.3" "V" COEFFS 0 1000 -0 0 0 1 /end COMPU_METHOD
/begin COMPU_METHOD SAB_U_1VOLT_S2_S3 "int = ((phys * 1) / 1) - (0) Volt" RAT_FUNC "%2.0" "Volt" COEFFS 0 1 -0 0 0 1 /end COMPU_METHOD
/begin COMPU_METHOD SAB2_STANDARD_S3_S3 "int = ((phys * 1) / 1) - (0) -" RAT_FUNC "%2.0" "-" COEFFS 0 1 -0 0 0 1 /end COMPU_METHOD
/begin COMPU_METHOD SAB2_N_RPM_S3_S3 "int = ((phys * 1) / 1) - (0) 1/min" RAT_FUNC "%2.0" "1/min" COEFFS 0 1 -0 0 0 1 /end COMPU_METHOD
/begin COMPU_METHOD SAB2_N_RPM2_S3_S3 "int = ((phys * 2) / 1) - (0) 1/min" RAT_FUNC "%5.3" "1/min" COEFFS 0 2 -0 0 0 1 /end COMPU_METHOD
/begin COMPU_METHOD SAB2_N_10RPM4_S3_S3 "int = ((phys * 4) / 10) - (0) 1/min" RAT_FUNC "%5.3" "1/min" COEFFS 0 4 -0 0 0 10 /end COMPU_METHOD
/begin COMPU_METHOD SAB2_T_TIMER_10MS_S3_S3 "int = ((phys * 1) / 10) - (0) ms" RAT_FUNC "%5.3" "ms" COEFFS 0 1 -0 0 0 10 /end COMPU_METHOD
/begin COMPU_METHOD SAB2_N_1RPM_S3_S3 "int = ((phys * 1) / 1) - (0) 1/min" RAT_FUNC "%2.0" "1/min" COEFFS 0 1 -0 0 0 1 /end COMPU_METHOD
/begin COMPU_METHOD SAB2_N_8RPM_S3_S3 "int = ((phys * 1) / 8) - (0) 1/min" RAT_FUNC "%5.3" "1/min" COEFFS 0 1 -0 0 0 8 /end COMPU_METHOD
/begin COMPU_METHOD SAB2_C_1CEL_M40_S3_S3 "int = ((phys * 1) / 1) - (-40) Grad Celsius" RAT_FUNC "%2.0" "Grad Celsius" COEFFS 0 1 40 0 0 1 /end COMPU_METHOD
/begin COMPU_METHOD SAB2_C_CGT_1CEL_M40_S3_S3 "int = ((phys * 1) / 1) - (-40) Grad Celsius" RAT_FUNC "%2.0" "Grad Celsius" COEFFS 0 1 40 0 0 1 /end COMPU_METHOD
/begin COMPU_METHOD SAB2_M_1NM_S3_S3 "int = ((phys * 1) / 1) - (0) Nm" RAT_FUNC "%2.0" "Nm" COEFFS 0 1 -0 0 0 1 /end COMPU_METHOD
/begin COMPU_METHOD SAB2_N_10RPM_S3_S3 "int = ((phys * 1) / 10) - (0) 1/min" RAT_FUNC "%5.3" "1/min" COEFFS 0 1 -0 0 0 10 /end COMPU_METHOD
/begin COMPU_METHOD SAB2_04PROZENT_S3_S3 "int = ((phys * 10) / 4) - (0) %" RAT_FUNC "%5.3" "%" COEFFS 0 10 -0 0 0 4 /end COMPU_METHOD
/begin COMPU_METHOD SAB2_M_2NM_S3_S3 "int = ((phys * 1) / 2) - (0) Nm" RAT_FUNC "%5.3" "Nm" COEFFS 0 1 -0 0 0 2 /end COMPU_METHOD
/begin COMPU_METHOD SAB2_K1000_S3_S3 "int = ((phys * 1000) / 1) - (0) -" RAT_FUNC "%5.3" "-" COEFFS 0 1000 -0 0 0 1 /end COMPU_METHOD
/begin COMPU_METHOD SAB2_K100_S3_S3 "int = ((phys * 100) / 1) - (0) -" RAT_FUNC "%5.3" "-" COEFFS 0 100 -0 0 0 1 /end COMPU_METHOD
/begin COMPU_METHOD SAB2_K8_S3_S3 "int = ((phys * 8) / 1) - (0) -" RAT_FUNC "%5.3" "-" COEFFS 0 8 -0 0 0 1 /end COMPU_METHOD
/begin COMPU_METHOD SAB2_1PROZENT_S3_S3 "int = ((phys * 1) / 1) - (0) %" RAT_FUNC "%2.0" "%" COEFFS 0 1 -0 0 0 1 /end COMPU_METHOD
/begin COMPU_METHOD SAB2_M_NM2_M2047_S3_S3 "int = ((phys * 2) / 1) - (-2047) Nm" RAT_FUNC "%5.3" "Nm" COEFFS 0 2 2047 0 0 1 /end COMPU_METHOD
/begin COMPU_METHOD SAB2_2M_NM_M2046_S3_S3 "int = ((phys * 2) / 1) - (-2046) Nm" RAT_FUNC "%5.3" "Nm" COEFFS 0 2 2046 0 0 1 /end COMPU_METHOD
/begin COMPU_METHOD VOID_SCALING_S4_S3 "int = ((phys * 1) / 1) - (0) " RAT_FUNC "%2.0" "" COEFFS 0 1 -0 0 0 1 /end COMPU_METHOD
/begin COMPU_METHOD SABAL_STANDARD_S4_S3 "int = ((phys * 1) / 1) - (0) " RAT_FUNC "%2.0" "" COEFFS 0 1 -0 0 0 1 /end COMPU_METHOD
/begin COMPU_METHOD SABAL_SIGNAL_STATUS_S4_S3 "" TAB_VERB "%2.0" "" COMPU_TAB_REF SABAL_SIGNAL_STATUS_S4_S3 /end COMPU_METHOD
/begin COMPU_METHOD SABAL_M_1NM_S4_S3 "int = ((phys * 1) / 1) - (0) Nm" RAT_FUNC "%2.0" "Nm" COEFFS 0 1 -0 0 0 1 /end COMPU_METHOD
/begin COMPU_METHOD SABAL_N_1RPM_S4_S3 "int = ((phys * 1) / 1) - (0) 1/min" RAT_FUNC "%2.0" "1/min" COEFFS 0 1 -0 0 0 1 /end COMPU_METHOD
/begin COMPU_METHOD SABAL_T_TIMER_10MS_S4_S3 "int = ((phys * 1) / 10) - (0) ms" RAT_FUNC "%2.0" "ms" COEFFS 0 1 -0 0 0 10 /end COMPU_METHOD
/begin COMPU_METHOD SABAL_C_1CEL_M40_S4_S3 "int = ((phys * 1) / 1) - (-40) Deg C" RAT_FUNC "%2.0" "Deg C" COEFFS 0 1 40 0 0 1 /end COMPU_METHOD
/begin COMPU_METHOD SABAL_V_1KMH16_S4_S3 "int = ((phys * 1) / 0.0625) - (0) km/h" RAT_FUNC "%4.2" "km/h" COEFFS 0 1 -0 0 0 0.0625 /end COMPU_METHOD
/begin COMPU_METHOD SABAL_T_TIMER_100MS_S4_S3 "int = ((phys * 1) / 100) - (0) ms" RAT_FUNC "%2.0" "ms" COEFFS 0 1 -0 0 0 100 /end COMPU_METHOD
/begin COMPU_METHOD SABAL_100PROZENT254_S4_S3 "int = ((phys * 1) / 0.3937007874015748) - (0) %" RAT_FUNC "%3.1" "%" COEFFS 0 1 -0 0 0 0.393700787402 /end COMPU_METHOD
/begin COMPU_METHOD SABAL_TORQE_REQUEST_MODE_S4_S3 "" TAB_VERB "%2.0" "" COMPU_TAB_REF SABAL_TORQE_REQUEST_MODE_S4_S3 /end COMPU_METHOD
/begin COMPU_METHOD SABAL_MI_1NMS100_S4_S3 "int = ((phys * 1) / 0.01) - (0) Nms" RAT_FUNC "%4.2" "Nms" COEFFS 0 1 -0 0 0 0.01 /end COMPU_METHOD
/begin COMPU_METHOD SABAL_MI_1NMS_S4_S3 "int = ((phys * 1) / 1) - (0) Nms" RAT_FUNC "%2.0" "Nms" COEFFS 0 1 -0 0 0 1 /end COMPU_METHOD
/begin COMPU_METHOD SABAL_PROZENT_S4_S3 "int = ((phys * 1) / 1) - (0) %" RAT_FUNC "%2.0" "%" COEFFS 0 1 -0 0 0 1 /end COMPU_METHOD
/begin COMPU_VTAB eLeverPosRN_S1_S3 "" TAB_VERB 2 0 "E_RN_R" 1 "E_RN_N" /end COMPU_VTAB
/begin COMPU_VTAB eShiftpattern_S1_S3 "" TAB_VERB 3 0 "E_FWD" 1 "E_BWD" 2 "E_NOTMOVED" /end COMPU_VTAB
/begin COMPU_VTAB eBlockingMatrix_S1_S3 "" TAB_VERB 3 0 "E_BLCKMTRX_PASS" 1 "E_BLCKMTRX_SUBSTN" 2 "E_BLCKMTRX_BLOCK" /end COMPU_VTAB
/begin COMPU_VTAB ePaddleCommand_S1_S3 "" TAB_VERB 3 0 "E_TIPPLUS" 1 "E_TIPMINUS" 2 "E_TIPBOTH" /end COMPU_VTAB
/begin COMPU_VTAB eTabPrioShifter_S1_S3 "" TAB_VERB 3 0 "E_PRIOSHIFTER_IGNORE" 1 "E_PRIOSHIFTER_ADD" 2 "E_PRIOSHIFTER_REPLACE" /end COMPU_VTAB
/begin COMPU_VTAB eSourcePrio_S1_S3 "" TAB_VERB 3 0 "E_SOURCE1PRIO" 1 "E_SOURCE2PRIO" 2 "E_SOURCE1AND2EQUAL" /end COMPU_VTAB
/begin COMPU_VTAB eMode4_S1_S3 "" TAB_VERB 4 0 "E_M0" 1 "E_M1" 2 "E_M2" 3 "E_M3" /end COMPU_VTAB
/begin COMPU_VTAB eCtlShiftlock_x_S1_S3 "" TAB_VERB 2 0 "E_ACTIVE" 1 "E_INVERT" /end COMPU_VTAB
/begin COMPU_VTAB eCtlShiftlock_y_S1_S3 "" TAB_VERB 9 0 "E_D" 1 "E_N" 2 "E_R" 3 "E_P" 4 "E_UNDEF" 5 "E_DZ" 6 "E_NZ" 7 "E_RZ" 8 "E_PZ" /end COMPU_VTAB
/begin COMPU_VTAB eFctReactMatrix_S1_S3 "" TAB_VERB 2 0 "E_FUNCTION_ID" 1 "E_REACTION" /end COMPU_VTAB
/begin COMPU_VTAB eRow15_S1_S3 "" TAB_VERB 16 0 "E_ROW15_0" 1 "E_ROW15_1" 2 "E_ROW15_2" 3 "E_ROW15_3" 4 "E_ROW15_4" 5 "E_ROW15_5" 6 "E_ROW15_6" 7 "E_ROW15_7" 8 "E_ROW15_8" 9 "E_ROW15_9" 10 "E_ROW15_10" 11 "E_ROW15_11" 12 "E_ROW15_12" 13 "E_ROW15_13" 14 "E_ROW15_14" 15 "E_ROW15_15" /end COMPU_VTAB
/begin COMPU_VTAB SABAL_SIGNAL_STATUS_S4_S3 "" TAB_VERB 3 0 "SIGNAL_STATUS_OK" 1 "SIGNAL_STATUS_SUBSTITUTE_VALUE" 2 "SIGNAL_STATUS_FAULTY" /end COMPU_VTAB
/begin COMPU_VTAB SABAL_TORQE_REQUEST_MODE_S4_S3 "" TAB_VERB 3 1 "TRQREQMODE_INC" 2 "TRQREQMODE_DEC" 0 "TRQREQMODE_PASSIVE" /end COMPU_VTAB
/begin FUNCTION jData_zf_SAB_TurbineSpeedIn_Fktn "Calibration values of the Instance jData_zf_SAB_TurbineSpeedIn"
 /begin DEF_CHARACTERISTIC D_k_Ntu D_k_TuNew D_k_TuNew_CAN D_k_TuOld D_k_TuOld_CAN D_n_Init_TuFilt_CAN D_tmr_Delay_TurbineSpeedTx D_tmr_Init_n_TuFilt_aktiv /end DEF_CHARACTERISTIC
/end FUNCTION
/begin FUNCTION dData_zf_SAB_TurbineSpeedVirtualIn_Fktn "Calibration values of the Component dData_zf_SAB_TurbineSpeedVirtualIn" /begin SUB_FUNCTION jData_zf_SAB_TurbineSpeedVirtualIn_Fktn /end SUB_FUNCTION /end FUNCTION
/begin FUNCTION jData_zf_SAB_TurbineSpeedVirtualIn_Fktn "Calibration values of the Instance jData_zf_SAB_TurbineSpeedVirtualIn"
 /begin DEF_CHARACTERISTIC D_i_TargetGear D_k_AbTuVirtNew D_k_AbTuVirtOld D_k_ActualGear_ntOpt D_k_DifIAENew D_k_DifIAEOld D_k_EngTuVirtNew D_k_EngTuVirtOld D_k_TargetGear_ntOpt D_k_TuVirtNew D_k_TuVirtOld D_k_n6 D_k_n6TuVirtNew D_k_n6TuVirtOld D_k_n6_ntOpt D_k_nab D_k_nab_ntOpt D_k_nmot D_n_Ab_Min_nTOpt D_n_Dif_IAEerkannt D_n_Dif_IAEerkanntGANG D_n_Dif_IAEerkanntHYS D_n_Dif_IAEerkanntKUP D_n_TuVirt_Direction D_n_TuVirt_DirectionHYS D_t_VerschachtelungAktiv_ntOpt D_t_n6TuVirtSync D_t_nAbTuVirtSync D_t_nEngTuVirtSync D_t_n_Dif_IAEerkannt SWI_GangnachfuehrungAktiv SWI_GangnachfuehrungAktivErw SWI_NTVIRTGBBZUG SWI_n6_InitControlActive SWI_n_TuVirtOptCalcAlg /end DEF_CHARACTERISTIC
/end FUNCTION
/begin FUNCTION dData_zf_SAB_VehicleSpeedIn_Fktn "Calibration values of the Component dData_zf_SAB_VehicleSpeedIn" /begin SUB_FUNCTION jData_zf_SAB_VehicleSpeedIn_Fktn /end SUB_FUNCTION /end FUNCTION
/begin FUNCTION jData_zf_SAB_VehicleSpeedIn_Fktn "Calibration values of the Instance jData_zf_SAB_VehicleSpeedIn"
 /begin DEF_CHARACTERISTIC D_k_v_FzgByNabNew D_k_v_FzgByNabOld D_t_DelayVIstMaxCalc SWI_v_IstMaxCalc /end DEF_CHARACTERISTIC
/end FUNCTION
/begin FUNCTION dData_zf_SAB_SportButtonIn_Fktn "Calibration values of the Component dData_zf_SAB_SportButtonIn" /begin SUB_FUNCTION jData_zf_SAB_SportButtonIn_Fktn /end SUB_FUNCTION /end FUNCTION
/begin FUNCTION jData_zf_SAB_SportButtonIn_Fktn "Calibration values of the Instance jData_zf_SAB_SportButtonIn" /begin DEF_CHARACTERISTIC SWI_GWS_DriveLogic SWI_GWS_S_Button SWI_ICM_S_Button /end DEF_CHARACTERISTIC /end FUNCTION
/begin FUNCTION dData_zf_SAB_SubstTempIn_Fktn "Calibration values of the Component dData_zf_SAB_SubstTempIn" /begin SUB_FUNCTION jData_zf_SAB_SubstTempIn_Fktn /end SUB_FUNCTION /end FUNCTION
/begin FUNCTION jData_zf_SAB_SubstTempIn_Fktn "Calibration values of the Instance jData_zf_SAB_SubstTempIn"
 /begin DEF_CHARACTERISTIC D_n_EngTuLth_CCHIP D_u_BattLth_INFOHOT1 D_u_BattLth_INFOHOT2 /end DEF_CHARACTERISTIC
/end FUNCTION
/begin FUNCTION dData_zf_SAB_TimeEGSOffIn_Fktn "Calibration values of the Component dData_zf_SAB_TimeEGSOffIn" /begin SUB_FUNCTION jData_zf_SAB_TimeEGSOffIn_Fktn /end SUB_FUNCTION /end FUNCTION
/begin FUNCTION jData_zf_SAB_TimeEGSOffIn_Fktn "Calibration values of the Instance jData_zf_SAB_TimeEGSOffIn" /begin DEF_CHARACTERISTIC D_t_DefaultEGSOFF /end DEF_CHARACTERISTIC /end FUNCTION
/begin FUNCTION dData_zf_SAB_TipTasterIn_Fktn "Calibration values of the Component dData_zf_SAB_TipTasterIn" /begin SUB_FUNCTION jData_zf_SAB_TipTasterIn_Fktn /end SUB_FUNCTION /end FUNCTION
/begin FUNCTION jData_zf_SAB_TipTasterIn_Fktn "Calibration values of the Instance jData_zf_SAB_TipTasterIn"
 /begin DEF_CHARACTERISTIC D_t_CANPaddleReceive D_t_debounceAnalogTip D_t_debounceLearnAnalogTip D_u_BattLth_TIPP SWI_DeactivateTipSourceSBW SWI_DontLearnInvalidSignal SWI_LearnTip SWI_ResetPaddleLearned /end DEF_CHARACTERISTIC
/end FUNCTION
/begin FUNCTION dData_zf_SAB_TorqueReserveIn_Fktn "Calibration values of the Component dData_zf_SAB_TorqueReserveIn" /begin SUB_FUNCTION jData_zf_SAB_TorqueReserveIn_Fktn /end SUB_FUNCTION /end FUNCTION
/begin FUNCTION jData_zf_SAB_TorqueReserveIn_Fktn "Calibration values of the Instance jData_zf_SAB_TorqueReserveIn" /begin DEF_CHARACTERISTIC D_m_Reserve /end DEF_CHARACTERISTIC /end FUNCTION
/begin FUNCTION dData_zf_SAB_TurbineTorqueIn_Fktn "Calibration values of the Component dData_zf_SAB_TurbineTorqueIn" /begin SUB_FUNCTION jData_zf_SAB_TurbineTorqueIn_Fktn /end SUB_FUNCTION /end FUNCTION
/begin FUNCTION jData_zf_SAB_TurbineTorqueIn_Fktn "Calibration values of the Instance jData_zf_SAB_TurbineTorqueIn" /begin DEF_CHARACTERISTIC D_dc_Offset /end DEF_CHARACTERISTIC /end FUNCTION
/begin FUNCTION dData_zf_SAB_VoltageMonitoringOut_Fktn "Calibration values of the Component dData_zf_SAB_VoltageMonitoringOut" /begin SUB_FUNCTION jData_zf_SAB_VoltageMonitoringOut_Fktn /end SUB_FUNCTION /end FUNCTION
/begin FUNCTION jData_zf_SAB_VoltageMonitoringOut_Fktn "Calibration values of the Instance jData_zf_SAB_VoltageMonitoringOut"
 /begin DEF_CHARACTERISTIC D_n_EngLThJump D_n_EngLth_UBATTU_UBATTL_UBATTO D_n_EngUThJump D_t_Batt_UBATTU D_t_DiagActive_UBATTL D_t_DiagActive_UBATTU D_t_JumpstartTh D_tmr_GearSubstLSSOFF D_u_BattLthFix_UBATTU D_u_BattLth_UBATTL D_u_BattLth_UBATTU D_u_BattThHys_UBATTL D_u_BattUth_UBATTO SWI_JumpstartN /end DEF_CHARACTERISTIC
/end FUNCTION
/begin FUNCTION dData_zf_SAB_WheelIn_Fktn "Calibration values of the Component dData_zf_SAB_WheelIn" /begin SUB_FUNCTION jData_zf_SAB_WheelIn_Fktn /end SUB_FUNCTION /end FUNCTION
/begin FUNCTION jData_zf_SAB_WheelIn_Fktn "Calibration values of the Instance jData_zf_SAB_WheelIn"
 /begin DEF_CHARACTERISTIC D_k_AbNew D_k_AbOld D_lfz_Wheel SWI_WheelActivePassive SWI_WheelUseAbsVal /end DEF_CHARACTERISTIC
/end FUNCTION
/begin FUNCTION dData_zf_SAB_AzgDriver_Fktn "Calibration values of the Component dData_zf_SAB_AzgDriver" /begin SUB_FUNCTION jData_zf_SAB_AzgDriver_Fktn /end SUB_FUNCTION /end FUNCTION
/begin FUNCTION jData_zf_SAB_AzgDriver_Fktn "Calibration values of the Instance jData_zf_SAB_AzgDriver"
 /begin DEF_CHARACTERISTIC D_Tab_Azgkng SWI_Zf_Application_Can SWI_Zf_Edicmobil_Can SWI_morethan255KFCs /end DEF_CHARACTERISTIC
/end FUNCTION
/begin FUNCTION dData_zf_SAB_LayerAGS_Fktn "Calibration values of the Component dData_zf_SAB_LayerAGS" /begin SUB_FUNCTION jData_zf_SAB_LayerAGS_Fktn /end SUB_FUNCTION /end FUNCTION
/begin FUNCTION jData_zf_SAB_LayerAGS_Fktn "Calibration values of the Instance jData_zf_SAB_LayerAGS" /begin DEF_CHARACTERISTIC SWI_RpmDynOut /end DEF_CHARACTERISTIC /end FUNCTION
/begin FUNCTION dData_zf_SAB_CDD_ActuatorOut_Fktn "Calibration values of the Component dData_zf_SAB_CDD_ActuatorOut" /begin SUB_FUNCTION jData_zf_SAB_CDD_ActuatorOut_Fktn /end SUB_FUNCTION /end FUNCTION
/begin FUNCTION jData_zf_SAB_CDD_ActuatorOut_Fktn "Calibration values of the Instance jData_zf_SAB_CDD_ActuatorOut"
 /begin DEF_CHARACTERISTIC SWI_SetOut0_DitherActive SWI_SetOut1_DitherActive SWI_SetOut2_DitherActive SWI_SetOut3_DitherActive SWI_SetOut4_DitherActive SWI_SetOut5_DitherActive SWI_SetOut6_DitherActive SWI_SetOut7_DitherActive /end DEF_CHARACTERISTIC
/end FUNCTION
/begin FUNCTION dData_zf_SAB_CDD_GearboxStateFl_Fktn "Calibration values of the Component dData_zf_SAB_CDD_GearboxStateFl" /begin SUB_FUNCTION jData_zf_SAB_CDD_GearboxStateFl_Fktn /end SUB_FUNCTION /end FUNCTION
/begin FUNCTION jData_zf_SAB_CDD_GearboxStateFl_Fktn "Calibration values of the Instance jData_zf_SAB_CDD_GearboxStateFl"
 /begin DEF_CHARACTERISTIC D_n_ZeroCurrentFeedLth D_t_GetFet0Undervoltage D_t_HssOff D_t_ZeroCurrentFeed D_u_BattLimphomeLth D_u_BattLimphomeUth SWI_CalcLimpHomeLssOff /end DEF_CHARACTERISTIC
/end FUNCTION
/begin FUNCTION dData_zf_SAB_CDD_IEP_Control_Fktn "Calibration values of the Component dData_zf_SAB_CDD_IEP_Control" /begin SUB_FUNCTION jData_zf_SAB_CDD_IEP_Control_Fktn /end SUB_FUNCTION /end FUNCTION
/begin FUNCTION jData_zf_SAB_CDD_IEP_Control_Fktn "Calibration values of the Instance jData_zf_SAB_CDD_IEP_Control"
 /begin DEF_CHARACTERISTIC D_ActualOpPoint2IEP_STATE_LINIEP D_ComErrorMask_LINIEP D_HWVersionMask_LINIEP D_HWVersion_LINIEP D_Lth_KFC1_IEPTEMPSENS_LINIEP D_MaskKFC1_IEPINFO_LINIEP D_MaskKFC1_IEPROTORSENS_LINIEP D_MaskKFC2_IEPROTORSENS_LINIEP D_MaskKFC3_IEPROTORSENS_LINIEP D_MaskKFC_IEPBUS_LINIEP D_MaskKFC_IEPCOM_LINIEP D_MaskKFC_IEPHW_LINIEP D_MaskKFC_IEPINFO_LINIEP D_MaskKFC_IEPLEV2_LINIEP D_MaskKFC_IEPVERSION_LINIEP D_MaskKFC_IEPVOLTAGE_LINIEP D_MaskLinEPumpErrSuppressLinOff_LINIEP D_MaskLinEPumpErr_LINIEP D_MaxRxMsgLINIEP D_MaxTxMsgLINIEP D_MinSwVersionWarmUp_LINIEP D_RxID_IndexLINIEP D_SWVersionMask_LINIEP D_SWVersion_LINIEP D_TxID_IndexLINIEP D_Uth_KFC2_IEPTEMPSENS_LINIEP D_ZIELVORGABE2TargetOpPoint_LINIEP D_cntBUS2_MaxIncAlv_LINIEP D_cntBUS2_MaxInvalidCRC8_LINIEP D_cntBUS2_MaxStuckAlv_LINIEP D_k_UtoC_TEMPSENS_LINIEP D_t_AfterRunLINIEP D_t_DelayAfterIepWarmUpErr_LINIEP D_t_DelayKFC_IEPBUS_LINIEP D_t_DiagDelayAfterClearErr_LINIEP SWI_IEP_CALID_CVN SWI_IEP_Verbaut /end DEF_CHARACTERISTIC
/end FUNCTION
/begin FUNCTION dData_zf_SAB_CDD_LINBusStartStop_Fktn "Calibration values of the Component dData_zf_SAB_CDD_LINBusStartStop" /begin SUB_FUNCTION jData_zf_SAB_CDD_LINBusStartStop_Fktn /end SUB_FUNCTION /end FUNCTION
/begin FUNCTION jData_zf_SAB_CDD_LINBusStartStop_Fktn "Calibration values of the Instance jData_zf_SAB_CDD_LINBusStartStop" /begin DEF_CHARACTERISTIC D_t_IEPSleepDelay D_t_KMN_LINBUSOFF_Delay /end DEF_CHARACTERISTIC /end FUNCTION
/begin FUNCTION dData_zf_SAB_CDD_PermanentFaultCodes_Fktn "Calibration values of the Component dData_zf_SAB_CDD_PermanentFaultCodes" /begin SUB_FUNCTION jData_zf_SAB_CDD_PermanentFaultCodes_Fktn /end SUB_FUNCTION /end FUNCTION
/begin FUNCTION jData_zf_SAB_CDD_PermanentFaultCodes_Fktn "Calibration values of the Instance jData_zf_SAB_CDD_PermanentFaultCodes" /begin DEF_CHARACTERISTIC D_t_DeactivatePfcTh SWI_OBD_PFC_ACTIVATION /end DEF_CHARACTERISTIC /end FUNCTION
/begin FUNCTION dData_zf_SAB_CDD_RoutineControlFlashProgLIN_IEP_Fktn "Calibration values of the Component dData_zf_SAB_CDD_RoutineControlFlashProgLIN_IEP" /begin SUB_FUNCTION jData_zf_SAB_CDD_RoutineControlFlashProgLIN_IEP_Fktn /end SUB_FUNCTION /end FUNCTION
/begin FUNCTION jData_zf_SAB_CDD_RoutineControlFlashProgLIN_IEP_Fktn "Calibration values of the Instance jData_zf_SAB_CDD_RoutineControlFlashProgLIN_IEP"
 /begin DEF_CHARACTERISTIC D_Adr_Of_LIN_IEP_Image D_Size_Of_LIN_IEP_Image SWI_FlashLIN_IEP_Preconditions SWI_FlashLIN_IEP_StartProgramming /end DEF_CHARACTERISTIC
/end FUNCTION
/begin FUNCTION dData_zf_SAB_CDD_ZfDataCRC_Fktn "Calibration values of the Component dData_zf_SAB_CDD_ZfDataCRC" /begin SUB_FUNCTION jData_zf_SAB_CDD_ZfDataCRC_Fktn /end SUB_FUNCTION /end FUNCTION
/begin FUNCTION jData_zf_SAB_CDD_ZfDataCRC_Fktn "Calibration values of the Instance jData_zf_SAB_CDD_ZfDataCRC"
 /begin DEF_CHARACTERISTIC D_x_ZfDataCrcOff D_x_ZfDataGearboxOff D_x_ZfDataMechatronicOff /end DEF_CHARACTERISTIC
/end FUNCTION
/begin FUNCTION dData_zf_SAB_DrivingStabilitySystemError_Fktn "Calibration values of the Component dData_zf_SAB_DrivingStabilitySystemError" /begin SUB_FUNCTION jData_zf_SAB_DrivingStabilitySystemError_Fktn /end SUB_FUNCTION /end FUNCTION
/begin FUNCTION jData_zf_SAB_DrivingStabilitySystemError_Fktn "Calibration values of the Instance jData_zf_SAB_DrivingStabilitySystemError" /begin DEF_CHARACTERISTIC SWI_ExtCondASCReg /end DEF_CHARACTERISTIC /end FUNCTION
/begin FUNCTION dData_zf_SAB_GLI_ErrorHandling_Fktn "Calibration values of the Component dData_zf_SAB_GLI_ErrorHandling" /begin SUB_FUNCTION jData_zf_SAB_GLI_ErrorHandling_Fktn /end SUB_FUNCTION /end FUNCTION
/begin FUNCTION jData_zf_SAB_GLI_ErrorHandling_Fktn "Calibration values of the Instance jData_zf_SAB_GLI_ErrorHandling" /begin DEF_CHARACTERISTIC D_t_DiagDelPOSSBW /end DEF_CHARACTERISTIC /end FUNCTION
/begin FUNCTION dData_zf_SAB_PMA_ErrorHandling_Fktn "Calibration values of the Component dData_zf_SAB_PMA_ErrorHandling" /begin SUB_FUNCTION jData_zf_SAB_PMA_ErrorHandling_Fktn /end SUB_FUNCTION /end FUNCTION
/begin FUNCTION jData_zf_SAB_PMA_ErrorHandling_Fktn "Calibration values of the Instance jData_zf_SAB_PMA_ErrorHandling" /begin DEF_CHARACTERISTIC D_u_BattLth_PARKASSIST /end DEF_CHARACTERISTIC /end FUNCTION
/begin FUNCTION dData_zf_SAB_TransportModeIn_Fktn "Calibration values of the Component dData_zf_SAB_TransportModeIn" /begin SUB_FUNCTION jData_zf_SAB_TransportModeIn_Fktn /end SUB_FUNCTION /end FUNCTION
/begin FUNCTION jData_zf_SAB_TransportModeIn_Fktn "Calibration values of the Instance jData_zf_SAB_TransportModeIn" /begin DEF_CHARACTERISTIC SWI_TransportMode /end DEF_CHARACTERISTIC /end FUNCTION
/begin FUNCTION zff_SABOUT "data of signal processing" /begin SUB_FUNCTION zff_SABOUT_Messgroessen zff_SABOUT_Applikationsgroessen /end SUB_FUNCTION /end FUNCTION
/begin FUNCTION zff_SABOUT_Messgroessen "all measurements of signal processing"
 /begin SUB_FUNCTION zf_SAB2_EngIdleRaiseReqOut zf_SAB2_Timer zf_SAB2_GearboxTorqueOut zf_SAB2_ConfEGSACCOut zf_SAB2_CoolingReqOut zf_SAB2_DashboardInfoOut zf_SAB2_EngineInterventionTransOut_Fl zf_SAB2_EngineInterventionTransOut zf_SAB2_ErrorEntryOut_Fl zf_SAB2_ErrorEntryOut zf_SAB2_GearboxLossesOut zf_SAB2_Interfi zf_SAB2_GearboxReinforcementOut zf_SAB2_HybridControlOut zf_SAB2_HybridSignalsOut zf_SAB2_MIL_RequestOut zf_SAB2_MStartLimitationOut zf_SAB2_NICActiveOut zf_SAB2_PumpIntakeTorqueOut zf_SAB2_ShiftingActiveOut zf_SAB2_SynEngineSpeedOut zf_SAB2_TorqueConverterOut /end SUB_FUNCTION
/end FUNCTION
/begin FUNCTION zf_SAB2_EngIdleRaiseReqOut "desc_en"
 /begin LOC_MEASUREMENT ZFFSAB2._.EngIdleRaiseReqOut.f_n_EngIdleRaiseRequestErr ZFFSAB2._.EngIdleRaiseReqOut.f_n_EngIdleRaiseRequestErr_ ZFFSAB2._.EngIdleRaiseReqOut.iv_n_EngIdleRaiseRequestHAS ZFFSAB2._.EngIdleRaiseReqOut.iv_n_EngIdleRaiseRequestHAS_ ZFFSAB2._.EngIdleRaiseReqOut.iv_n_EngIdleRaiseRequestHiResHAS ZFFSAB2._.EngIdleRaiseReqOut.iv_n_EngIdleRaiseRequestHiResHAS_ ZFFSAB2._.EngIdleRaiseReqOut.sv_n_EngIdleRaiseRequest ZFFSAB2._.EngIdleRaiseReqOut.sv_n_EngIdleRaiseRequestHiRes ZFFSAB2._.EngIdleRaiseReqOut.sv_n_EngIdleRaiseRequestHiRes_ ZFFSAB2._.EngIdleRaiseReqOut.sv_n_EngIdleRaiseRequest_ /end LOC_MEASUREMENT
/end FUNCTION
/begin FUNCTION zf_SAB2_Timer "desc_en" /begin LOC_MEASUREMENT ZFFSAB2._.GearboxTorqueOut.t_freeze_mgt_Aufn_CAN.time /end LOC_MEASUREMENT /end FUNCTION
/begin FUNCTION zf_SAB2_GearboxTorqueOut "desc_en"
 /begin LOC_MEASUREMENT ZFFSAB2._.GearboxTorqueOut.f_TimerStarted ZFFSAB2._.GearboxTorqueOut.iv_m_Gearbox ZFFSAB2._.GearboxTorqueOut.iv_m_Gearbox_ ZFFSAB2._.GearboxTorqueOut.iv_n_EngIdleSts ZFFSAB2._.GearboxTorqueOut.sv_m_Gearbox ZFFSAB2._.GearboxTorqueOut.sv_m_Gearbox_ /end LOC_MEASUREMENT
/end FUNCTION
/begin FUNCTION zf_SAB2_ConfEGSACCOut "desc_en"
 /begin LOC_MEASUREMENT ZFFSAB2._.ConfEGSACCOut.iv_EGSACCStsReceipt ZFFSAB2._.ConfEGSACCOut.sv_EGSACCStsReceipt /end LOC_MEASUREMENT
/end FUNCTION
/begin FUNCTION zf_SAB2_CoolingReqOut "desc_en"
 /begin LOC_MEASUREMENT ZFFSAB2._.CoolingReqOut.iv_c_CoolMax ZFFSAB2._.CoolingReqOut.sv_CoolerRequest /end LOC_MEASUREMENT
/end FUNCTION
/begin FUNCTION zf_SAB2_DashboardInfoOut "desc_en"
 /begin LOC_MEASUREMENT ZFFSAB2._.DashboardInfoOut.f_CtlDispPosErr ZFFSAB2._.DashboardInfoOut.f_CtlDispPosErr_ ZFFSAB2._.DashboardInfoOut.iv_CtlDispPos ZFFSAB2._.DashboardInfoOut.iv_CtlDispPos_ ZFFSAB2._.DashboardInfoOut.iv_n_EngLev2 ZFFSAB2._.DashboardInfoOut.iv_n_EngLev2Sts ZFFSAB2._.DashboardInfoOut.iv_n_EngLev2Sts_ ZFFSAB2._.DashboardInfoOut.iv_n_EngLev2_ ZFFSAB2._.DashboardInfoOut.sv_CtlDispPos ZFFSAB2._.DashboardInfoOut.sv_CtlDispPos_ /end LOC_MEASUREMENT
/end FUNCTION
/begin FUNCTION zf_SAB2_EngineInterventionTransOut_Fl "desc_en"
 /begin LOC_MEASUREMENT ZFFSAB2._.EngineInterventionTransOut.EngineInterventionTransOut_Fl.iv_ctl_ActvCylCtrl ZFFSAB2._.EngineInterventionTransOut.EngineInterventionTransOut_Fl.iv_ctl_ActvCylCtrlSts ZFFSAB2._.EngineInterventionTransOut.EngineInterventionTransOut_Fl.iv_ctl_EngTqCtrlReqMode ZFFSAB2._.EngineInterventionTransOut.EngineInterventionTransOut_Fl.iv_ctl_EngTqCtrlReqModeSts ZFFSAB2._.EngineInterventionTransOut.EngineInterventionTransOut_Fl.iv_ctl_EngTqCtrlReqModeSts_ ZFFSAB2._.EngineInterventionTransOut.EngineInterventionTransOut_Fl.iv_ctl_EngTqCtrlReqMode_ ZFFSAB2._.EngineInterventionTransOut.EngineInterventionTransOut_Fl.iv_ctl_EngTqCtrlReqPredMode ZFFSAB2._.EngineInterventionTransOut.EngineInterventionTransOut_Fl.iv_ctl_EngTqCtrlReqPredModeSts ZFFSAB2._.EngineInterventionTransOut.EngineInterventionTransOut_Fl.iv_ctl_RelEngTqCtrl ZFFSAB2._.EngineInterventionTransOut.EngineInterventionTransOut_Fl.iv_ctl_RelEngTqCtrlSts ZFFSAB2._.EngineInterventionTransOut.EngineInterventionTransOut_Fl.iv_ctl_RelEngTqCtrlSts_ ZFFSAB2._.EngineInterventionTransOut.EngineInterventionTransOut_Fl.iv_ctl_RelEngTqCtrl_ ZFFSAB2._.EngineInterventionTransOut.EngineInterventionTransOut_Fl.iv_m_EngTqCtrlReq ZFFSAB2._.EngineInterventionTransOut.EngineInterventionTransOut_Fl.iv_m_EngTqCtrlReqSts ZFFSAB2._.EngineInterventionTransOut.EngineInterventionTransOut_Fl.iv_m_EngTqCtrlReqSts_ ZFFSAB2._.EngineInterventionTransOut.EngineInterventionTransOut_Fl.iv_m_EngTqCtrlReq_ ZFFSAB2._.EngineInterventionTransOut.EngineInterventionTransOut_Fl.sv_m_EngTqCtrlReq ZFFSAB2._.EngineInterventionTransOut.EngineInterventionTransOut_Fl.sv_m_EngTqCtrlReqSts ZFFSAB2._.EngineInterventionTransOut.EngineInterventionTransOut_Fl.sv_m_EngTqCtrlReqSts_ ZFFSAB2._.EngineInterventionTransOut.EngineInterventionTransOut_Fl.sv_m_EngTqCtrlReq_ /end LOC_MEASUREMENT
/end FUNCTION
/begin FUNCTION zf_SAB2_EngineInterventionTransOut "desc_en"
 /begin LOC_MEASUREMENT ZFFSAB2._.EngineInterventionTransOut.iv_ctl_ActvCylCtrl ZFFSAB2._.EngineInterventionTransOut.iv_ctl_ActvCylCtrlSts ZFFSAB2._.EngineInterventionTransOut.iv_ctl_EngTqCtrlReqMode ZFFSAB2._.EngineInterventionTransOut.iv_ctl_EngTqCtrlReqModeSts ZFFSAB2._.EngineInterventionTransOut.iv_ctl_EngTqCtrlReqModeSts_ ZFFSAB2._.EngineInterventionTransOut.iv_ctl_EngTqCtrlReqMode_ ZFFSAB2._.EngineInterventionTransOut.iv_ctl_EngTqCtrlReqPredMode ZFFSAB2._.EngineInterventionTransOut.iv_ctl_EngTqCtrlReqPredModeSts ZFFSAB2._.EngineInterventionTransOut.iv_ctl_RelEngTqCtrl ZFFSAB2._.EngineInterventionTransOut.iv_ctl_RelEngTqCtrlSts ZFFSAB2._.EngineInterventionTransOut.iv_ctl_RelEngTqCtrlSts_ ZFFSAB2._.EngineInterventionTransOut.iv_ctl_RelEngTqCtrl_ ZFFSAB2._.EngineInterventionTransOut.iv_m_EngTqCtrlReq ZFFSAB2._.EngineInterventionTransOut.iv_m_EngTqCtrlReqPred ZFFSAB2._.EngineInterventionTransOut.iv_m_EngTqCtrlReqPredSts ZFFSAB2._.EngineInterventionTransOut.iv_m_EngTqCtrlReqSts ZFFSAB2._.EngineInterventionTransOut.iv_m_EngTqCtrlReqSts_ ZFFSAB2._.EngineInterventionTransOut.iv_m_EngTqCtrlReq_ ZFFSAB2._.EngineInterventionTransOut.iv_m_EngTqMax ZFFSAB2._.EngineInterventionTransOut.iv_m_EngTqMaxSts ZFFSAB2._.EngineInterventionTransOut.sv_m_EngTqCtrlReq ZFFSAB2._.EngineInterventionTransOut.sv_m_EngTqCtrlReqPred ZFFSAB2._.EngineInterventionTransOut.sv_m_EngTqCtrlReqSts ZFFSAB2._.EngineInterventionTransOut.sv_m_EngTqCtrlReqSts_ ZFFSAB2._.EngineInterventionTransOut.sv_m_EngTqCtrlReq_ ZFFSAB2._.EngineInterventionTransOut.sv_m_EngTqMax /end LOC_MEASUREMENT
/end FUNCTION
/begin FUNCTION zf_SAB2_ErrorEntryOut_Fl "desc_en"
 /begin LOC_MEASUREMENT ZFFSAB2._.ErrorEntryOut.ErrorEntryOut_Fl.f_DiagnosticFunctSetByLimphomeError ZFFSAB2._.ErrorEntryOut.ErrorEntryOut_Fl.f_DiagnosticFunctSetByLimphomeError_ ZFFSAB2._.ErrorEntryOut.ErrorEntryOut_Fl.iv_Limphome ZFFSAB2._.ErrorEntryOut.ErrorEntryOut_Fl.iv_Limphome_ ZFFSAB2._.ErrorEntryOut.ErrorEntryOut_Fl.sv_DiagnosticFunct ZFFSAB2._.ErrorEntryOut.ErrorEntryOut_Fl.sv_DiagnosticFunct_ /end LOC_MEASUREMENT
/end FUNCTION
/begin FUNCTION zf_SAB2_ErrorEntryOut "desc_en"
 /begin LOC_MEASUREMENT ZFFSAB2._.ErrorEntryOut.f_DiagnosticFunctSetByLimphomeError ZFFSAB2._.ErrorEntryOut.f_DiagnosticFunctSetByLimphomeError_ ZFFSAB2._.ErrorEntryOut.iv_EPumpErr ZFFSAB2._.ErrorEntryOut.iv_Limphome ZFFSAB2._.ErrorEntryOut.iv_Limphome_ ZFFSAB2._.ErrorEntryOut.iv_SubstFunct ZFFSAB2._.ErrorEntryOut.iv_SubstFunctHi ZFFSAB2._.ErrorEntryOut.sv_DiagnosticFunct ZFFSAB2._.ErrorEntryOut.sv_DiagnosticFunct_ /end LOC_MEASUREMENT
/end FUNCTION
/begin FUNCTION zf_SAB2_GearboxLossesOut "desc_en"
 /begin LOC_MEASUREMENT ZFFSAB2._.GearboxLossesOut.iv_m_GearboxLosses ZFFSAB2._.GearboxLossesOut.sv_m_GearboxLosses /end LOC_MEASUREMENT
/end FUNCTION
/begin FUNCTION zf_SAB2_Interfi "desc_en"
 /begin LOC_MEASUREMENT ZFFSAB2._.Interfi2.iv_ActualGear ZFFSAB2._.Interfi2.iv_KL15 ZFFSAB2._.Interfi2.iv_KL15_ ZFFSAB2._.Interfi2.iv_Pos ZFFSAB2._.Interfi2.iv_TargetGear ZFFSAB2._.Interfi2.iv_c_OilTrans ZFFSAB2._.Interfi2.iv_c_OilTransSts ZFFSAB2._.Interfi2.iv_f_ACANorFACAN ZFFSAB2._.Interfi2.iv_f_IgnOn ZFFSAB2._.Interfi2.iv_kraftschluss ZFFSAB2._.Interfi2.iv_m_EngSts ZFFSAB2._.Interfi2.iv_n_Eng ZFFSAB2._.Interfi2.iv_n_EngSts ZFFSAB2._.Interfi2.iv_n_Tu ZFFSAB2._.Interfi2.iv_n_TuSts /end LOC_MEASUREMENT
/end FUNCTION
/begin FUNCTION zf_SAB2_GearboxReinforcementOut "desc_en"
 /begin LOC_MEASUREMENT ZFFSAB2._.GearboxReinforcementOut.ActualGearOld ZFFSAB2._.GearboxReinforcementOut.GearboxReinforcementInter ZFFSAB2._.GearboxReinforcementOut.TargetGearOld ZFFSAB2._.GearboxReinforcementOut.dt_IGChangeOld ZFFSAB2._.GearboxReinforcementOut.f_ShiftingAborted ZFFSAB2._.GearboxReinforcementOut.in_Gearbox ZFFSAB2._.GearboxReinforcementOut.in_GearboxOld ZFFSAB2._.GearboxReinforcementOut.iv_GearboxReinforcementErr ZFFSAB2._.GearboxReinforcementOut.iv_RearAxleRatio ZFFSAB2._.GearboxReinforcementOut.iv_dt_IGChange ZFFSAB2._.GearboxReinforcementOut.iv_in_ActualGear ZFFSAB2._.GearboxReinforcementOut.iv_in_TargetGear ZFFSAB2._.GearboxReinforcementOut.iv_n_Ab ZFFSAB2._.GearboxReinforcementOut.iv_rga_not_info ZFFSAB2._.GearboxReinforcementOut.iv_status_limphome ZFFSAB2._.GearboxReinforcementOut.sv_GearboxReinforcement ZFFSAB2._.GearboxReinforcementOut.sv_GearboxReinforcementCalcSts ZFFSAB2._.GearboxReinforcementOut.tmr_dt_IGChange /end LOC_MEASUREMENT
/end FUNCTION
/begin FUNCTION zf_SAB2_HybridControlOut "desc_en"
 /begin LOC_MEASUREMENT ZFFSAB2._.HybridControlOut.iv_BetriebszustandIst ZFFSAB2._.HybridControlOut.iv_BetriebszustandZiel ZFFSAB2._.HybridControlOut.iv_StatusAblauf_HAS ZFFSAB2._.HybridControlOut.sv_IstzustandKraftschluss ZFFSAB2._.HybridControlOut.sv_IstzustandVerbrenner ZFFSAB2._.HybridControlOut.sv_SollzustandKraftschluss ZFFSAB2._.HybridControlOut.sv_SollzustandVerbrenner ZFFSAB2._.HybridControlOut.sv_StatusAblauf_HAS /end LOC_MEASUREMENT
/end FUNCTION
/begin FUNCTION zf_SAB2_HybridSignalsOut "desc_en"
 /begin LOC_MEASUREMENT ZFFSAB2._.HybridSignalsOut.iv_StatusK0 ZFFSAB2._.HybridSignalsOut.iv_c_BelagK0 ZFFSAB2._.HybridSignalsOut.iv_k0ExternSts ZFFSAB2._.HybridSignalsOut.iv_k0SlipFactorExtern ZFFSAB2._.HybridSignalsOut.iv_m_MaxK0Akt ZFFSAB2._.HybridSignalsOut.iv_m_Max_EM_HAS ZFFSAB2._.HybridSignalsOut.iv_m_Min_EM_HAS ZFFSAB2._.HybridSignalsOut.iv_m_MotMaxVM_K0 ZFFSAB2._.HybridSignalsOut.iv_m_ResEM_HAS ZFFSAB2._.HybridSignalsOut.iv_m_SchleppK0Akt ZFFSAB2._.HybridSignalsOut.iv_m_k0TargetExtern ZFFSAB2._.HybridSignalsOut.iv_st_m_MotMaxVM_K0 ZFFSAB2._.HybridSignalsOut.m_MaxK0_OldValue ZFFSAB2._.HybridSignalsOut.sv_StatusK0 ZFFSAB2._.HybridSignalsOut.sv_c_BelagK0 ZFFSAB2._.HybridSignalsOut.sv_k0SlipFactorExtern ZFFSAB2._.HybridSignalsOut.sv_m_MaxK0 ZFFSAB2._.HybridSignalsOut.sv_m_Max_EM_HAS ZFFSAB2._.HybridSignalsOut.sv_m_Min_EM_HAS ZFFSAB2._.HybridSignalsOut.sv_m_ResEM_HAS ZFFSAB2._.HybridSignalsOut.sv_m_k0TargetExtern /end LOC_MEASUREMENT
/end FUNCTION
/begin FUNCTION zf_SAB2_MIL_RequestOut "desc_en"
 /begin LOC_MEASUREMENT ZFFSAB2._.MIL_RequestOut.iv_CodingMilLamp ZFFSAB2._.MIL_RequestOut.iv_MilReq ZFFSAB2._.MIL_RequestOut.sv_MilReq /end LOC_MEASUREMENT
/end FUNCTION
/begin FUNCTION zf_SAB2_MStartLimitationOut "desc_en" /begin LOC_MEASUREMENT ZFFSAB2._.MStartLimitationOut.sv_f_m_StartLimitation /end LOC_MEASUREMENT /end FUNCTION
/begin FUNCTION zf_SAB2_NICActiveOut "desc_en"
 /begin LOC_MEASUREMENT ZFFSAB2._.NICActiveOut.iv_SBCActive ZFFSAB2._.NICActiveOut.sv_GearboxSts /end LOC_MEASUREMENT
/end FUNCTION
/begin FUNCTION zf_SAB2_PumpIntakeTorqueOut "desc_en"
 /begin LOC_MEASUREMENT ZFFSAB2._.PumpIntakeTorqueOut.iv_m_Pump ZFFSAB2._.PumpIntakeTorqueOut.sv_m_PumpCensored /end LOC_MEASUREMENT
/end FUNCTION
/begin FUNCTION zf_SAB2_ShiftingActiveOut "desc_en"
 /begin LOC_MEASUREMENT ZFFSAB2._.ShiftingActiveOut.iv_ReqDeactvtActvDampg ZFFSAB2._.ShiftingActiveOut.iv_f_ChangeOfGear ZFFSAB2._.ShiftingActiveOut.sv_ReqDeactvtActvDampg ZFFSAB2._.ShiftingActiveOut.sv_f_ShiftingActive /end LOC_MEASUREMENT
/end FUNCTION
/begin FUNCTION zf_SAB2_SynEngineSpeedOut "desc_en"
 /begin LOC_MEASUREMENT ZFFSAB2._.SynEngineSpeedOut.f_n_mot_synSollVMSts ZFFSAB2._.SynEngineSpeedOut.f_n_mot_synSollVMSts_ ZFFSAB2._.SynEngineSpeedOut.iv_f_n_mot_synEMSts ZFFSAB2._.SynEngineSpeedOut.iv_f_n_mot_synEMSts_ ZFFSAB2._.SynEngineSpeedOut.iv_f_n_mot_synVMSts ZFFSAB2._.SynEngineSpeedOut.iv_f_n_mot_synVMSts_ ZFFSAB2._.SynEngineSpeedOut.iv_n_mot_synEM ZFFSAB2._.SynEngineSpeedOut.iv_n_mot_synEM_ ZFFSAB2._.SynEngineSpeedOut.iv_n_mot_synVM ZFFSAB2._.SynEngineSpeedOut.iv_n_mot_synVM_ ZFFSAB2._.SynEngineSpeedOut.iv_n_motsynEMErr ZFFSAB2._.SynEngineSpeedOut.iv_n_motsynEMErr_ ZFFSAB2._.SynEngineSpeedOut.iv_n_motsynVMErr ZFFSAB2._.SynEngineSpeedOut.iv_n_motsynVMErr_ ZFFSAB2._.SynEngineSpeedOut.sv_f_n_mot_synSollEMSts ZFFSAB2._.SynEngineSpeedOut.sv_f_n_mot_synSollEMSts_ ZFFSAB2._.SynEngineSpeedOut.sv_n_mot_synSollEM ZFFSAB2._.SynEngineSpeedOut.sv_n_mot_synSollEMVMSts ZFFSAB2._.SynEngineSpeedOut.sv_n_mot_synSollEMVMSts_ ZFFSAB2._.SynEngineSpeedOut.sv_n_mot_synSollEM_ ZFFSAB2._.SynEngineSpeedOut.sv_n_mot_synSollVM ZFFSAB2._.SynEngineSpeedOut.sv_n_mot_synSollVM_ /end LOC_MEASUREMENT
/end FUNCTION
/begin FUNCTION zf_SAB2_TorqueConverterOut "desc_en"
 /begin LOC_MEASUREMENT ZFFSAB2._.TorqueConverterOut.TorqueConverterOutDAT.TableColumnHyb ZFFSAB2._.TorqueConverterOut.TorqueConverterOutDAT.TableRowHyb ZFFSAB2._.TorqueConverterOut.f_Enpg1fixActive ZFFSAB2._.TorqueConverterOut.f_Enpg3fixActive ZFFSAB2._.TorqueConverterOut.iv_PreadaptionState ZFFSAB2._.TorqueConverterOut.iv_st_IAE ZFFSAB2._.TorqueConverterOut.sv_wk_Ist ZFFSAB2._.TorqueConverterOut.sv_wk_IstHybrid /end LOC_MEASUREMENT
/end FUNCTION
/begin FUNCTION zff_SABOUT_Applikationsgroessen "all calibration values of signal processing"
 /begin SUB_FUNCTION dData_zf_SAB2_GearboxReinforcementOut_Fktn dData_zf_SAB2_PumpIntakeTorqueOut_Fktn dData_zf_SAB2_ShiftingActiveOut_Fktn dData_zf_SAB2_DashboardInfoOut_Fktn dData_zf_SAB2_EngineInterventionTransOut_Fktn dData_zf_SAB2_ErrorEntryOut_Fktn dData_zf_SAB2_GearboxTorqueOut_Fktn dData_zf_SAB2_HybridSignalsOut_Fktn dData_zf_SAB2_TorqueConverterOut_Fktn /end SUB_FUNCTION
/end FUNCTION
/begin FUNCTION dData_zf_SAB2_GearboxReinforcementOut_Fktn "Calibration values of the Component dData_zf_SAB2_GearboxReinforcementOut" /begin SUB_FUNCTION jData_zf_SAB2_GearboxReinforcementOut_Fktn /end SUB_FUNCTION /end FUNCTION
/begin FUNCTION jData_zf_SAB2_GearboxReinforcementOut_Fktn "Calibration values of the Instance jData_zf_SAB2_GearboxReinforcementOut"
 /begin DEF_CHARACTERISTIC D_GbxReinforcementMax D_GbxReinforcementMin D_GearboxReinforcementDef D_GearboxReinforcementDefSts D_GearboxReinforcementErr D_GearboxReinforcementFactor D_n_Ab_CalcMethodLth D_n_Ab_CalcMethodUth SWI_GearboxReinforcementCalculation SWI_GearboxReinforcement_Err /end DEF_CHARACTERISTIC
/end FUNCTION
/begin FUNCTION dData_zf_SAB2_PumpIntakeTorqueOut_Fktn "Calibration values of the Component dData_zf_SAB2_PumpIntakeTorqueOut" /begin SUB_FUNCTION jData_zf_SAB2_PumpIntakeTorqueOut_Fktn /end SUB_FUNCTION /end FUNCTION
/begin FUNCTION jData_zf_SAB2_PumpIntakeTorqueOut_Fktn "Calibration values of the Instance jData_zf_SAB2_PumpIntakeTorqueOut" /begin DEF_CHARACTERISTIC SWI_PuCalc /end DEF_CHARACTERISTIC /end FUNCTION
/begin FUNCTION dData_zf_SAB2_ShiftingActiveOut_Fktn "Calibration values of the Component dData_zf_SAB2_ShiftingActiveOut" /begin SUB_FUNCTION jData_zf_SAB2_ShiftingActiveOut_Fktn /end SUB_FUNCTION /end FUNCTION
/begin FUNCTION jData_zf_SAB2_ShiftingActiveOut_Fktn "Calibration values of the Instance jData_zf_SAB2_ShiftingActiveOut" /begin DEF_CHARACTERISTIC SWI_ChangeOfGear SWI_UseDampgCanSignal /end DEF_CHARACTERISTIC /end FUNCTION
/begin FUNCTION dData_zf_SAB2_DashboardInfoOut_Fktn "Calibration values of the Component dData_zf_SAB2_DashboardInfoOut" /begin SUB_FUNCTION jData_zf_SAB2_DashboardInfoOut_Fktn /end SUB_FUNCTION /end FUNCTION
/begin FUNCTION jData_zf_SAB2_DashboardInfoOut_Fktn "Calibration values of the Instance jData_zf_SAB2_DashboardInfoOut" /begin DEF_CHARACTERISTIC D_n_EngLth_SABLev2 /end DEF_CHARACTERISTIC /end FUNCTION
/begin FUNCTION dData_zf_SAB2_EngineInterventionTransOut_Fktn "Calibration values of the Component dData_zf_SAB2_EngineInterventionTransOut" /begin SUB_FUNCTION jData_zf_SAB2_EngineInterventionTransOut_Fktn /end SUB_FUNCTION /end FUNCTION
/begin FUNCTION jData_zf_SAB2_EngineInterventionTransOut_Fktn "Calibration values of the Instance jData_zf_SAB2_EngineInterventionTransOut" /begin DEF_CHARACTERISTIC SWI_EzaDecision /end DEF_CHARACTERISTIC /end FUNCTION
/begin FUNCTION dData_zf_SAB2_ErrorEntryOut_Fktn "Calibration values of the Component dData_zf_SAB2_ErrorEntryOut" /begin SUB_FUNCTION jData_zf_SAB2_ErrorEntryOut_Fktn /end SUB_FUNCTION /end FUNCTION
/begin FUNCTION jData_zf_SAB2_ErrorEntryOut_Fktn "Calibration values of the Instance jData_zf_SAB2_ErrorEntryOut"
 /begin DEF_CHARACTERISTIC D_KMN_DiagnosticFunctCAN1 D_KMN_DiagnosticFunctCAN10 D_KMN_DiagnosticFunctCAN2 D_KMN_DiagnosticFunctCAN5 D_KMN_DiagnosticFunctCAN8 D_KMN_DiagnosticFunctCAN9 D_KMN_DiagnosticFunctCANHi1 D_KMN_DiagnosticFunctCANHi10 D_KMN_DiagnosticFunctCANHi2 D_KMN_DiagnosticFunctCANHi5 D_KMN_DiagnosticFunctCANHi8 D_KMN_DiagnosticFunctCANHi9 D_TX_ValueForLimphome D_TX_ValueForLimphomeElectrical D_TX_ValueForLimphomeEmSigErr /end DEF_CHARACTERISTIC
/end FUNCTION
/begin FUNCTION dData_zf_SAB2_GearboxTorqueOut_Fktn "Calibration values of the Component dData_zf_SAB2_GearboxTorqueOut" /begin SUB_FUNCTION jData_zf_SAB2_GearboxTorqueOut_Fktn /end SUB_FUNCTION /end FUNCTION
/begin FUNCTION jData_zf_SAB2_GearboxTorqueOut_Fktn "Calibration values of the Instance jData_zf_SAB2_GearboxTorqueOut" /begin DEF_CHARACTERISTIC D_t_freeze_mgt_Aufn_CAN /end DEF_CHARACTERISTIC /end FUNCTION
/begin FUNCTION dData_zf_SAB2_HybridSignalsOut_Fktn "Calibration values of the Component dData_zf_SAB2_HybridSignalsOut" /begin SUB_FUNCTION jData_zf_SAB2_HybridSignalsOut_Fktn /end SUB_FUNCTION /end FUNCTION
/begin FUNCTION jData_zf_SAB2_HybridSignalsOut_Fktn "Calibration values of the Instance jData_zf_SAB2_HybridSignalsOut"
 /begin DEF_CHARACTERISTIC D_Status_K0_Array D_k_m_MaxK0NewCan D_k_m_MaxK0OldCan SWI_TarTorqMaxMinMot1Grb /end DEF_CHARACTERISTIC
/end FUNCTION
/begin FUNCTION dData_zf_SAB2_TorqueConverterOut_Fktn "Calibration values of the Component dData_zf_SAB2_TorqueConverterOut" /begin SUB_FUNCTION jData_zf_SAB2_TorqueConverterOut_Fktn /end SUB_FUNCTION /end FUNCTION
/begin FUNCTION jData_zf_SAB2_TorqueConverterOut_Fktn "Calibration values of the Instance jData_zf_SAB2_TorqueConverterOut"
 /begin DEF_CHARACTERISTIC D_KplHyb D_KplHybEmergencyGear D_KplHybShifting D_PreadaptionState /end DEF_CHARACTERISTIC
/end FUNCTION
/begin FUNCTION zff_SABAL "data of signal processing application" /begin SUB_FUNCTION zff_SABAL_Messgroessen zff_SABAL_Applikationsgroessen /end SUB_FUNCTION /end FUNCTION
/begin FUNCTION zff_SABAL_Messgroessen "all measurements of signal processing application"
 /begin SUB_FUNCTION fg_zf_SABAL_interfo fg_zf_SABAL_EngTqCtrl fg_zf_SABAL_EngTqLim fg_zf_SABAL_GbxSt fg_zf_SABAL_TqReqMon /end SUB_FUNCTION
/end FUNCTION
/begin FUNCTION fg_zf_SABAL_interfo "empty" /begin LOC_MEASUREMENT iv_TestCalibrationSABAL /end LOC_MEASUREMENT /end FUNCTION
/begin FUNCTION fg_zf_SABAL_EngTqCtrl "empty"
 /begin LOC_MEASUREMENT EngTqCtrl_ctl_RelSyncRpm EngTqCtrl_f_ErrorConditionKFC1_NEGTRQREQ EngTqCtrl_f_ErrorConditionKFC1_NEGTRQREQ_ EngTqCtrl_f_ErrorConditionKFC_LEV2 EngTqCtrl_f_ErrorType EngTqCtrl_f_NoPosEngTqIntvReqActive_ EngTqCtrl_f_TestConditionErrHdl EngTqCtrl_f_TestConditionErrHdl_ EngTqCtrl_f_m_EI_Lev2Err EngTqCtrl_f_m_EI_Lev2Err_ EngTqCtrl_f_m_EngTqCtrlReqNegErr EngTqCtrl_f_m_EngTqCtrlReqNegErr_ EngTqCtrl_f_m_EngTqCtrlReqPosErr EngTqCtrl_f_m_EngTqCtrlReqPosErr_ EngTqCtrl_iv_ctl_EngRedMode EngTqCtrl_iv_ctl_EngTqCtrlReqMode EngTqCtrl_iv_ctl_EngTqCtrlReqMode_ EngTqCtrl_iv_ctl_EngTqCtrlReqPredMode EngTqCtrl_iv_f_m_EngTqCtrlReqNegErr EngTqCtrl_iv_f_m_EngTqCtrlReqNegErr_ EngTqCtrl_iv_f_m_EngTqCtrlReqPosErr EngTqCtrl_iv_f_m_EngTqCtrlReqPosErr_ EngTqCtrl_iv_m_CrankSts EngTqCtrl_iv_m_CrankSts_ EngTqCtrl_iv_m_Eng EngTqCtrl_iv_m_EngDesAdjustRange EngTqCtrl_iv_m_EngDesAdjustRangeRel EngTqCtrl_iv_m_EngLev2 EngTqCtrl_iv_m_EngLev2Sts EngTqCtrl_iv_m_EngLev2Sts_ EngTqCtrl_iv_m_EngLev2_ EngTqCtrl_iv_m_EngTqCtrlReq EngTqCtrl_iv_m_EngTqCtrlReqPred EngTqCtrl_iv_m_EngTqCtrlReqPredRel EngTqCtrl_iv_m_EngTqCtrlReqRel EngTqCtrl_iv_m_EngTqCtrlReqRel_ EngTqCtrl_iv_m_EngTqCtrlReq_ EngTqCtrl_iv_m_PumpCensored EngTqCtrl_iv_n_EngLev2Sts EngTqCtrl_iv_n_EngLev2Sts_ EngTqCtrl_iv_n_TuLev2Sts EngTqCtrl_iv_n_TuLev2Sts_ EngTqCtrl_m_Eng EngTqCtrl_m_EngCrankSts EngTqCtrl_m_EngCrankSts_ EngTqCtrl_m_EngLev2 EngTqCtrl_m_EngLev2_ EngTqCtrl_m_EngSts EngTqCtrl_m_EngSts_ EngTqCtrl_m_EngTqMaxCensored EngTqCtrl_m_PumpCensored EngTqCtrl_st_ctl_LimitGearboxProtection EngTqCtrl_st_ctl_LimitNegEngTqCtrl EngTqCtrl_sv_ctl_ActvCylCtrl EngTqCtrl_sv_ctl_ActvCylCtrlSts EngTqCtrl_sv_ctl_EngTqCtrlReqMode EngTqCtrl_sv_ctl_EngTqCtrlReqModeSts EngTqCtrl_sv_ctl_EngTqCtrlReqModeSts_ EngTqCtrl_sv_ctl_EngTqCtrlReqMode_ EngTqCtrl_sv_ctl_EngTqCtrlReqPredMode EngTqCtrl_sv_ctl_EngTqCtrlReqPredModeSts EngTqCtrl_sv_ctl_RelEngTqCtrl EngTqCtrl_sv_ctl_RelEngTqCtrlSts EngTqCtrl_sv_ctl_RelEngTqCtrlSts_ EngTqCtrl_sv_ctl_RelEngTqCtrl_ EngTqCtrl_sv_f_NoNegEngTqIntvReqActive EngTqCtrl_sv_f_NoNegEngTqIntvReqActive_ EngTqCtrl_sv_f_NoPosEngTqIntvReqActive EngTqCtrl_sv_m_EngTqCtrlReq EngTqCtrl_sv_m_EngTqCtrlReqPred EngTqCtrl_sv_m_EngTqCtrlReqPredSts EngTqCtrl_sv_m_EngTqCtrlReqSts EngTqCtrl_sv_m_EngTqCtrlReqSts_ EngTqCtrl_sv_m_EngTqCtrlReq_ /end LOC_MEASUREMENT
/end FUNCTION
/begin FUNCTION fg_zf_SABAL_EngTqLim "empty"
 /begin LOC_MEASUREMENT EngTqLim_iv_m_EngTqMax EngTqLim_iv_m_EngTqMaxHyb EngTqLim_iv_m_EngTqMaxHyb_ EngTqLim_iv_m_EngTqMax_ EngTqLim_m_EngMaxSel EngTqLim_m_EngTqMaxSts_ EngTqLim_m_EngTqMax_ EngTqLim_sv_m_EngTqMax EngTqLim_sv_m_EngTqMaxSts /end LOC_MEASUREMENT
/end FUNCTION
/begin FUNCTION fg_zf_SABAL_GbxSt "empty"
 /begin LOC_MEASUREMENT GbxSt_Idx_n_EngTemp GbxSt_RdyToDrv GbxSt_RdyToDrvHld GbxSt_RdyToDrvHldOld GbxSt_RdyToDrvHldSts GbxSt_RdyToDrvHldStsOld GbxSt_RdyToDrvSts GbxSt_RdyToDrv_by_HIS GbxSt_RdyToDrv_by_IEP GbxSt_RdyToDrv_by_IEPext GbxSt_RdyToDrv_by_nEng GbxSt_f_DlyRdyToDrvColdPwrUpExe GbxSt_f_DlyRdyToDrvColdPwrUpExeOld GbxSt_iv_IEPSt GbxSt_iv_c_OilTrans GbxSt_iv_c_OilTransSts GbxSt_iv_ignition GbxSt_iv_ignitionSts GbxSt_iv_n_Eng GbxSt_iv_n_EngSts GbxSt_iv_n_Tu GbxSt_iv_n_TuSts GbxSt_iv_pos GbxSt_iv_v_FzgByNab GbxSt_iv_v_FzgByNabSts GbxSt_loc_OneTimeInitState GbxSt_loc_OneTimeInitStateMod GbxSt_loc_c_OilTrans GbxSt_loc_c_OilTransSts GbxSt_loc_f_RemStrt GbxSt_loc_f_RemStrtSts GbxSt_loc_n_Eng GbxSt_loc_n_EngSts GbxSt_loc_n_InpSpd GbxSt_loc_n_InpSpdSts GbxSt_loc_n_Tu GbxSt_loc_n_TuSts GbxSt_loc_t_HoldGbxSt GbxSt_loc_v_FzgByNab GbxSt_loc_v_FzgByNabSts GbxSt_p_SysFromEngSpd GbxSt_sv_GbxRdyToDrv GbxSt_sv_GbxRdyToDrvSts GbxSt_tmr_DebGbxSt2ToGbxSt3 GbxSt_tmr_DlyRdyToDrv GbxSt_tmr_DlyRdyToDrvColdPwrUpbyNInSpd GbxSt_tmr_HoldGbxSt /end LOC_MEASUREMENT
/end FUNCTION
/begin FUNCTION fg_zf_SABAL_TqReqMon "empty"
 /begin LOC_MEASUREMENT TqReqMon_ThrottleFlap_EIStart TqReqMon_ctl_BasicConditionsFulfilled TqReqMon_ctl_EIMonBreak TqReqMon_f_BasicConditionsFulfilled TqReqMon_f_Downshift_EIStart TqReqMon_f_EIMonActiv TqReqMon_f_EIMonBreak TqReqMon_f_EI_IntegralMonActive TqReqMon_f_IntMaxTime TqReqMon_f_IntMinTime TqReqMon_f_IntervChanged TqReqMon_f_NewGearInterv TqReqMon_f_ReinitErr TqReqMon_f_SetKFC1_INTME TqReqMon_f_SetKFC_INTME TqReqMon_f_StartAnalysis TqReqMon_f_TmrActDel TqReqMon_f_TmrDel TqReqMon_f_m_IntEIReqValid TqReqMon_idx_EIFaultType_Lth TqReqMon_idx_EIFaultType_Uth TqReqMon_idx_EIMode_Lth TqReqMon_idx_EIMode_Uth TqReqMon_idx_EIMonTh TqReqMon_iv_ActualGear TqReqMon_iv_TargetGear TqReqMon_iv_ThrottleFlap TqReqMon_iv_ThrottleFlapSts TqReqMon_iv_c_OilTrans TqReqMon_iv_m_Crank TqReqMon_iv_m_CrankSts TqReqMon_iv_m_Eng TqReqMon_iv_m_EngIntervention TqReqMon_iv_m_EngInterventionMode TqReqMon_iv_m_EngMax TqReqMon_iv_m_EngRedLim TqReqMon_iv_m_EngSts TqReqMon_iv_m_Reserve TqReqMon_iv_m_ReserveSts TqReqMon_iv_n_Eng TqReqMon_iv_n_EngLev2Sts TqReqMon_iv_n_TuLev2Sts TqReqMon_m_EngInterventionMode_EIStart TqReqMon_m_Eng_EIStart TqReqMon_m_Integral_EI_realizedRelativRaw TqReqMon_m_Integral_EI_requestedRelativAbs TqReqMon_m_Integral_EI_requestedRelativMod TqReqMon_m_Integral_EI_requestedRelativRaw TqReqMon_m_Integral_ReqAboveUth TqReqMon_m_Integral_ReqBelowLth TqReqMon_perc_EIRealizedPLth TqReqMon_perc_EIRealizedPUth TqReqMon_perc_EIRealizedSLth TqReqMon_perc_EIRealizedSUth TqReqMon_sv_KFC1_EIFaultType TqReqMon_sv_KFC_EIFaultType TqReqMon_tmr_EIMonActivDelay TqReqMon_tmr_EIMonDelay TqReqMon_tmr_Integral_EI TqReqMon_x_m_EI_realizedPercental /end LOC_MEASUREMENT
/end FUNCTION
/begin FUNCTION zff_SABAL_Applikationsgroessen "all calibration values of signal processing spplication"
 /begin SUB_FUNCTION dData_SABAL_interfo_Fctn dData_SABAL_EngTqCtrl_Fctn dData_SABAL_EngTqLim_Fctn dData_SABAL_GbxSt_Fctn dData_SABAL_TqReqMon_Fctn /end SUB_FUNCTION
/end FUNCTION
/begin FUNCTION dData_SABAL_interfo_Fctn "Calibration values of the Component dData_SABAL_interfo" /begin SUB_FUNCTION jData_SABAL_interfo_Fctn /end SUB_FUNCTION /end FUNCTION
/begin FUNCTION jData_SABAL_interfo_Fctn "Calibration values of the Instance jData_SABAL_interfo" /begin DEF_CHARACTERISTIC SWI_TestCalibrationSABAL /end DEF_CHARACTERISTIC /end FUNCTION
/begin FUNCTION dData_SABAL_EngTqCtrl_Fctn "Calibration values of the Component dData_SABAL_EngTqCtrl" /begin SUB_FUNCTION jData_SABAL_EngTqCtrl_Fctn /end SUB_FUNCTION /end FUNCTION
/begin FUNCTION jData_SABAL_EngTqCtrl_Fctn "Calibration values of the Instance jData_SABAL_EngTqCtrl"
 /begin DEF_CHARACTERISTIC D_m_EngMaxLth D_m_EngTqCtrlReqNegLth D_m_EngTqCtrlReqTol D_m_GearboxGuardActiveHys SWI_FaultSourceLEV2 SWI_ME_abs_rel SWI_SlowIncReqMode /end DEF_CHARACTERISTIC
/end FUNCTION
/begin FUNCTION dData_SABAL_EngTqLim_Fctn "Calibration values of the Component dData_SABAL_EngTqLim" /begin SUB_FUNCTION jData_SABAL_EngTqLim_Fctn /end SUB_FUNCTION /end FUNCTION
/begin FUNCTION jData_SABAL_EngTqLim_Fctn "Calibration values of the Instance jData_SABAL_EngTqLim" /begin DEF_CHARACTERISTIC D_m_EngMaxSel /end DEF_CHARACTERISTIC /end FUNCTION
/begin FUNCTION dData_SABAL_GbxSt_Fctn "Calibration values of the Component dData_SABAL_GbxSt" /begin SUB_FUNCTION jData_SABAL_GbxSt_Fctn /end SUB_FUNCTION /end FUNCTION
/begin RECORD_LAYOUT ZF_KW_NAT8_S2_S3 FNC_VALUES 1 UBYTE COLUMN_DIR DIRECT /end RECORD_LAYOUT
/begin RECORD_LAYOUT ZF_KW_NAT16_S2_S3 FNC_VALUES 1 UWORD COLUMN_DIR DIRECT /end RECORD_LAYOUT
/begin RECORD_LAYOUT ZF_KW_NAT32_S2_S3 FNC_VALUES 1 ULONG COLUMN_DIR DIRECT /end RECORD_LAYOUT
/begin RECORD_LAYOUT ZF_KW_INT16_S2_S3 FNC_VALUES 1 SWORD COLUMN_DIR DIRECT /end RECORD_LAYOUT
/begin RECORD_LAYOUT ZF_TAB_NAT8_S2_S3 FNC_VALUES 2 UBYTE COLUMN_DIR DIRECT NO_AXIS_PTS_X 1 ULONG /end RECORD_LAYOUT
/begin RECORD_LAYOUT ZF_TAB_NAT16_S2_S3 FNC_VALUES 2 UWORD COLUMN_DIR DIRECT NO_AXIS_PTS_X 1 ULONG /end RECORD_LAYOUT
/begin RECORD_LAYOUT ZF_TAB_NAT32_S2_S3 FNC_VALUES 2 ULONG COLUMN_DIR DIRECT NO_AXIS_PTS_X 1 ULONG /end RECORD_LAYOUT
/begin RECORD_LAYOUT ZF_TAB2D_NAT16_S2_S3 FNC_VALUES 3 UWORD ROW_DIR DIRECT NO_AXIS_PTS_X 1 ULONG NO_AXIS_PTS_Y 2 ULONG /end RECORD_LAYOUT
/begin RECORD_LAYOUT ZF_KL_NAT8_S2_S3 FNC_VALUES 3 UBYTE COLUMN_DIR DIRECT AXIS_PTS_X 2 UBYTE INDEX_INCR DIRECT NO_AXIS_PTS_X 1 ULONG /end RECORD_LAYOUT
/begin RECORD_LAYOUT ZF_KL_NAT16_S2_S3 FNC_VALUES 3 UWORD COLUMN_DIR DIRECT AXIS_PTS_X 2 UWORD INDEX_INCR DIRECT NO_AXIS_PTS_X 1 ULONG /end RECORD_LAYOUT
/begin RECORD_LAYOUT ZF_KL_NAT32_S2_S3 FNC_VALUES 3 ULONG COLUMN_DIR DIRECT AXIS_PTS_X 2 ULONG INDEX_INCR DIRECT NO_AXIS_PTS_X 1 ULONG /end RECORD_LAYOUT
/begin RECORD_LAYOUT ZF_KL_INT16_S2_S3 FNC_VALUES 3 SWORD COLUMN_DIR DIRECT AXIS_PTS_X 2 SWORD INDEX_INCR DIRECT NO_AXIS_PTS_X 1 ULONG /end RECORD_LAYOUT
/begin RECORD_LAYOUT ZF_KW_NAT8_S3_S3 FNC_VALUES 1 UBYTE COLUMN_DIR DIRECT /end RECORD_LAYOUT
/begin RECORD_LAYOUT ZF_KW_NAT16_S3_S3 FNC_VALUES 1 UWORD COLUMN_DIR DIRECT /end RECORD_LAYOUT
/begin RECORD_LAYOUT ZF_KW_NAT32_S3_S3 FNC_VALUES 1 ULONG COLUMN_DIR DIRECT /end RECORD_LAYOUT
/begin RECORD_LAYOUT ZF_TAB_NAT8_S3_S3 FNC_VALUES 2 UBYTE COLUMN_DIR DIRECT NO_AXIS_PTS_X 1 ULONG /end RECORD_LAYOUT
/begin RECORD_LAYOUT ZF_TAB2D_NAT8_S3_S3 FNC_VALUES 3 UBYTE ROW_DIR DIRECT NO_AXIS_PTS_X 1 ULONG NO_AXIS_PTS_Y 2 ULONG /end RECORD_LAYOUT
/begin RECORD_LAYOUT ZF_UINT8_COL_DIRECT_S4_S3 FNC_VALUES 1 UBYTE COLUMN_DIR DIRECT /end RECORD_LAYOUT
/begin RECORD_LAYOUT ZF_INT16_COL_DIRECT_S4_S3 FNC_VALUES 1 SWORD COLUMN_DIR DIRECT /end RECORD_LAYOUT
/begin RECORD_LAYOUT ZF_UINT16_COL_DIRECT_S4_S3 FNC_VALUES 1 UWORD COLUMN_DIR DIRECT /end RECORD_LAYOUT
/end MODULE
/end PROJECT
