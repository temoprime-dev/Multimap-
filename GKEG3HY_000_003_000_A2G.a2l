ASAP2_VERSION 1 51
/begin PROJECT _929_929 "Gen2_BMW_System_Supplier_Lib"
/begin HEADER "" VERSION "C_03_03" PROJECT_NO _929_929 /end HEADER
/begin MODULE DIM ""
/begin MOD_COMMON "" BYTE_ORDER MSB_FIRST ALIGNMENT_BYTE 1 ALIGNMENT_WORD 2 ALIGNMENT_LONG 4 ALIGNMENT_FLOAT32_IEEE 4 /end MOD_COMMON
/begin CHARACTERISTIC KL_POHKABSP53 "Druckoffset waehrend Haltedruckphase" CURVE 0x245FFC kl_si16_S6_S3 12.75 UMR_BAR__1_1000_0_S6_S3 -6.4 6.35
 /begin AXIS_DESCR STD_AXIS zff_atsys._.iSignale._.obj.sig_m_t8 UMR_NM__8_1_M50_S6_S3 4 -400 1640 DEPOSIT ABSOLUTE MONOTONY MON_INCREASE /end AXIS_DESCR
/end CHARACTERISTIC
/begin CHARACTERISTIC F_PRAHKABSP53 "Druckfaktor waehrend Rampe auf Schaltdruck" VALUE 0x26E782 kw_ui8_S6_S3 1 UMR___1_100_0_S6_S3 0 1 /end CHARACTERISTIC
/begin CHARACTERISTIC F_TRAHKABSP53 "Zeitfaktor waehrend Rampe auf Schaltdruck" VALUE 0x26E783 kw_ui8_S6_S3 1 UMR___1_100_0_S6_S3 0 1 /end CHARACTERISTIC
/begin CHARACTERISTIC KL_TRAHKABSP53 "Zeit fuer Rampe auf Schaltdruck" CURVE 0x246010 kl_ui8_S6_S3 2540 UMR_MSEC__10_1_0_S6_S3 0 2540
 /begin AXIS_DESCR STD_AXIS zff_atsys._.iSignale._.obj.sig_m_t8 UMR_NM__8_1_M50_S6_S3 4 -400 1640 DEPOSIT ABSOLUTE MONOTONY MON_INCREASE /end AXIS_DESCR
/end CHARACTERISTIC
/begin CHARACTERISTIC KL_TRAHKABSP53_EL "Zeit fuer Rampe auf Schaltdruck" CURVE 0x24601C kl_ui8_S6_S3 2540 UMR_MSEC__10_1_0_S6_S3 0 2540
 /begin AXIS_DESCR STD_AXIS zff_atsys._.iSignale._.obj.sig_m_t8 UMR_NM__8_1_M50_S6_S3 4 -400 1640 DEPOSIT ABSOLUTE MONOTONY MON_INCREASE /end AXIS_DESCR
/end CHARACTERISTIC
/begin CHARACTERISTIC KL_PGOKABSP53 "Druckgradient in Abhaengigkeit von m_t" CURVE 0x246028 kl_si16_S6_S3 200 UMR_BAR_SEC_1_10_0_S6_S3 -100 100
 /begin AXIS_DESCR STD_AXIS zff_atsys._.iSignale._.obj.sig_m_t UMR_NM__1_1_0_S6_S3 6 -400 1640 DEPOSIT ABSOLUTE MONOTONY MON_INCREASE /end AXIS_DESCR
/end CHARACTERISTIC
/begin CHARACTERISTIC KF_TOHKABMTNTSP53 "Zeitoffset auf Ende SF fuer Haltephase" MAP 0x246044 kf_ui8_S6_S3 2000 UMR_MSEC__10_1_M128_S6_S3 -1000 1000
 /begin AXIS_DESCR STD_AXIS zff_atsys._.iSignale._.obj.sig_n_t8 UMR_U_MIN_32_1_0_S6_S3 4 0 8160 DEPOSIT ABSOLUTE MONOTONY MON_INCREASE /end AXIS_DESCR
 /begin AXIS_DESCR STD_AXIS zff_atsys._.iSignale._.obj.sig_m_t8 UMR_NM__8_1_M50_S6_S3 6 -400 1640 DEPOSIT ABSOLUTE MONOTONY MON_INCREASE /end AXIS_DESCR
/end CHARACTERISTIC
/begin CHARACTERISTIC KL_TSYNMTKABSP53 "Zeit vor sync. Ende Schaltdruck KAB" CURVE 0x246070 kl_ui8_S6_S3 1280 UMR_MSEC__10_1_M128_S6_S3 -1280 0
 /begin AXIS_DESCR STD_AXIS zff_atsys._.iSignale._.obj.sig_m_t8 UMR_NM__8_1_M50_S6_S3 4 -400 1640 DEPOSIT ABSOLUTE MONOTONY MON_INCREASE /end AXIS_DESCR
/end CHARACTERISTIC
/begin CHARACTERISTIC KF_PKABSP53 "Schaltdruck abschaltende Kupplung" MAP 0x24607C kf_si16_S6_S3 12.75 UMR_BAR__1_1000_0_S6_S3 0 12.75
 /begin AXIS_DESCR STD_AXIS iSasZentr.iSchaltend.n_tkf UMR_U_MIN_32_1_0_S6_S3 8 0 8160 DEPOSIT ABSOLUTE MONOTONY MON_INCREASE /end AXIS_DESCR
 /begin AXIS_DESCR STD_AXIS zff_atsys._.iSignale._.obj.sig_m_t UMR_NM__1_1_0_S6_S3 10 -400 1640 DEPOSIT ABSOLUTE MONOTONY MON_INCREASE /end AXIS_DESCR
/end CHARACTERISTIC
/begin CHARACTERISTIC KF_PKABSP53_EL "Schaltdruck abschaltende Kupplung" MAP 0x246148 kf_si16_S6_S3 12.75 UMR_BAR__1_1000_0_S6_S3 0 12.75
 /begin AXIS_DESCR STD_AXIS iSasZentr.iSchaltend.n_tkf UMR_U_MIN_32_1_0_S6_S3 8 0 8160 DEPOSIT ABSOLUTE MONOTONY MON_INCREASE /end AXIS_DESCR
 /begin AXIS_DESCR STD_AXIS zff_atsys._.iSignale._.obj.sig_m_t UMR_NM__1_1_0_S6_S3 10 -400 1640 DEPOSIT ABSOLUTE MONOTONY MON_INCREASE /end AXIS_DESCR
/end CHARACTERISTIC
/begin CHARACTERISTIC KF_TSYNMTNTKABVSP53 "Zeit vor sync. Ende Haltephase vorb. KAB" MAP 0x246214 kf_si16_S6_S3 5000 UMR_MSEC__10_1_0_S6_S3 -5000 0
 /begin AXIS_DESCR STD_AXIS zff_atsys._.iSignale._.obj.sig_m_t UMR_NM__1_1_0_S6_S3 4 -400 1640 DEPOSIT ABSOLUTE MONOTONY MON_INCREASE /end AXIS_DESCR
 /begin AXIS_DESCR STD_AXIS zff_atsys._.iSignale._.obj.sig_n_t UMR_U_MIN_1_1_0_S6_S3 6 0 8160 DEPOSIT ABSOLUTE MONOTONY MON_INCREASE /end AXIS_DESCR
/end CHARACTERISTIC
/begin CHARACTERISTIC KL_TRAMTHINSYNKABSP53 "Zeit fuer Abschalten KAB nach Haltephase in Synchron" CURVE 0x246260 kl_ui8_S6_S3 2550 UMR_MSEC__10_1_0_S6_S3 0 2550
 /begin AXIS_DESCR STD_AXIS zff_atsys._.iSignale._.obj.sig_m_t8 UMR_NM__8_1_M50_S6_S3 4 -400 1640 DEPOSIT ABSOLUTE MONOTONY MON_INCREASE /end AXIS_DESCR
/end CHARACTERISTIC
/begin CHARACTERISTIC KF_POHINSYNKABSP53 "Kennfeld Haltedruckoffset(n_tkf, m_t) bei Haltephase in Synchron" MAP 0x24626C kf_si16_S6_S3 12.75 UMR_BAR__1_1000_0_S6_S3 -6.4 6.35
 /begin AXIS_DESCR STD_AXIS iSasZentr.iSchaltend.n_tkf UMR_U_MIN_32_1_0_S6_S3 6 0 8160 DEPOSIT ABSOLUTE MONOTONY MON_INCREASE /end AXIS_DESCR
 /begin AXIS_DESCR STD_AXIS zff_atsys._.iSignale._.obj.sig_m_t UMR_NM__1_1_0_S6_S3 6 -400 1640 DEPOSIT ABSOLUTE MONOTONY MON_INCREASE /end AXIS_DESCR
/end CHARACTERISTIC
/begin CHARACTERISTIC T_HINSYNSP53 "Zeit fuer Ende Haltephase in Synchron KZU/KAB" VALUE 0x26E784 kw_ui8_S6_S3 2540 UMR_MSEC__10_1_0_S6_S3 0 2540 /end CHARACTERISTIC
/begin CHARACTERISTIC KL_POHKABSP63 "Druckoffset waehrend Haltedruckphase" CURVE 0x2462D4 kl_si16_S6_S3 12.75 UMR_BAR__1_1000_0_S6_S3 -6.4 6.35
 /begin AXIS_DESCR STD_AXIS zff_atsys._.iSignale._.obj.sig_m_t8 UMR_NM__8_1_M50_S6_S3 4 -400 1640 DEPOSIT ABSOLUTE MONOTONY MON_INCREASE /end AXIS_DESCR
/end CHARACTERISTIC
/begin CHARACTERISTIC F_PRAHKABSP63 "Druckfaktor waehrend Rampe auf Schaltdruck" VALUE 0x26E785 kw_ui8_S6_S3 1 UMR___1_100_0_S6_S3 0 1 /end CHARACTERISTIC
/begin CHARACTERISTIC F_TRAHKABSP63 "Zeitfaktor waehrend Rampe auf Schaltdruck" VALUE 0x26E786 kw_ui8_S6_S3 1 UMR___1_100_0_S6_S3 0 1 /end CHARACTERISTIC
/begin CHARACTERISTIC KL_TRAHKABSP63 "Zeit fuer Rampe auf Schaltdruck" CURVE 0x2462E8 kl_ui8_S6_S3 2540 UMR_MSEC__10_1_0_S6_S3 0 2540
 /begin AXIS_DESCR STD_AXIS zff_atsys._.iSignale._.obj.sig_m_t8 UMR_NM__8_1_M50_S6_S3 4 -400 1640 DEPOSIT ABSOLUTE MONOTONY MON_INCREASE /end AXIS_DESCR
/end CHARACTERISTIC
/begin CHARACTERISTIC KL_TRAHKABSP63_EL "Zeit fuer Rampe auf Schaltdruck" CURVE 0x2462F4 kl_ui8_S6_S3 2540 UMR_MSEC__10_1_0_S6_S3 0 2540
 /begin AXIS_DESCR STD_AXIS zff_atsys._.iSignale._.obj.sig_m_t8 UMR_NM__8_1_M50_S6_S3 4 -400 1640 DEPOSIT ABSOLUTE MONOTONY MON_INCREASE /end AXIS_DESCR
/end CHARACTERISTIC
/begin CHARACTERISTIC KL_PGOKABSP63 "Druckgradient in Abhaengigkeit von m_t" CURVE 0x246300 kl_si16_S6_S3 200 UMR_BAR_SEC_1_10_0_S6_S3 -100 100
 /begin AXIS_DESCR STD_AXIS zff_atsys._.iSignale._.obj.sig_m_t UMR_NM__1_1_0_S6_S3 6 -400 1640 DEPOSIT ABSOLUTE MONOTONY MON_INCREASE /end AXIS_DESCR
/end CHARACTERISTIC
/begin CHARACTERISTIC KF_TOHKABMTNTSP63 "Zeitoffset auf Ende SF fuer Haltephase" MAP 0x24631C kf_ui8_S6_S3 2000 UMR_MSEC__10_1_M128_S6_S3 -1000 1000
 /begin AXIS_DESCR STD_AXIS zff_atsys._.iSignale._.obj.sig_n_t8 UMR_U_MIN_32_1_0_S6_S3 4 0 8160 DEPOSIT ABSOLUTE MONOTONY MON_INCREASE /end AXIS_DESCR
 /begin AXIS_DESCR STD_AXIS zff_atsys._.iSignale._.obj.sig_m_t8 UMR_NM__8_1_M50_S6_S3 6 -400 1640 DEPOSIT ABSOLUTE MONOTONY MON_INCREASE /end AXIS_DESCR
/end CHARACTERISTIC
/begin CHARACTERISTIC KL_TSYNMTKABSP63 "Zeit vor sync. Ende Schaltdruck KAB" CURVE 0x246348 kl_ui8_S6_S3 1280 UMR_MSEC__10_1_M128_S6_S3 -1280 0
 /begin AXIS_DESCR STD_AXIS zff_atsys._.iSignale._.obj.sig_m_t8 UMR_NM__8_1_M50_S6_S3 4 -400 1640 DEPOSIT ABSOLUTE MONOTONY MON_INCREASE /end AXIS_DESCR
/end CHARACTERISTIC
/begin CHARACTERISTIC KF_PKABSP63 "Schaltdruck abschaltende Kupplung" MAP 0x246354 kf_si16_S6_S3 12.75 UMR_BAR__1_1000_0_S6_S3 0 12.75
 /begin AXIS_DESCR STD_AXIS iSasZentr.iSchaltend.n_tkf UMR_U_MIN_32_1_0_S6_S3 8 0 8160 DEPOSIT ABSOLUTE MONOTONY MON_INCREASE /end AXIS_DESCR
 /begin AXIS_DESCR STD_AXIS zff_atsys._.iSignale._.obj.sig_m_t UMR_NM__1_1_0_S6_S3 10 -400 1640 DEPOSIT ABSOLUTE MONOTONY MON_INCREASE /end AXIS_DESCR
/end CHARACTERISTIC
/begin CHARACTERISTIC KF_PKABSP63_EL "Schaltdruck abschaltende Kupplung" MAP 0x246420 kf_si16_S6_S3 12.75 UMR_BAR__1_1000_0_S6_S3 0 12.75
 /begin AXIS_DESCR STD_AXIS iSasZentr.iSchaltend.n_tkf UMR_U_MIN_32_1_0_S6_S3 8 0 8160 DEPOSIT ABSOLUTE MONOTONY MON_INCREASE /end AXIS_DESCR
 /begin AXIS_DESCR STD_AXIS zff_atsys._.iSignale._.obj.sig_m_t UMR_NM__1_1_0_S6_S3 10 -400 1640 DEPOSIT ABSOLUTE MONOTONY MON_INCREASE /end AXIS_DESCR
/end CHARACTERISTIC
/begin CHARACTERISTIC KF_TSYNMTNTKABVSP63 "Zeit vor sync. Ende Haltephase vorb. KAB" MAP 0x2464EC kf_si16_S6_S3 5000 UMR_MSEC__10_1_0_S6_S3 -5000 0
 /begin AXIS_DESCR STD_AXIS zff_atsys._.iSignale._.obj.sig_m_t UMR_NM__1_1_0_S6_S3 4 -400 1640 DEPOSIT ABSOLUTE MONOTONY MON_INCREASE /end AXIS_DESCR
 /begin AXIS_DESCR STD_AXIS zff_atsys._.iSignale._.obj.sig_n_t UMR_U_MIN_1_1_0_S6_S3 6 0 8160 DEPOSIT ABSOLUTE MONOTONY MON_INCREASE /end AXIS_DESCR
/end CHARACTERISTIC
/begin CHARACTERISTIC KL_TRAMTHINSYNKABSP63 "Zeit fuer Abschalten KAB nach Haltephase in Synchron" CURVE 0x246538 kl_ui8_S6_S3 2550 UMR_MSEC__10_1_0_S6_S3 0 2550
 /begin AXIS_DESCR STD_AXIS zff_atsys._.iSignale._.obj.sig_m_t8 UMR_NM__8_1_M50_S6_S3 4 -400 1640 DEPOSIT ABSOLUTE MONOTONY MON_INCREASE /end AXIS_DESCR
/end CHARACTERISTIC
/begin CHARACTERISTIC KF_POHINSYNKABSP63 "Kennfeld Haltedruckoffset(n_tkf, m_t) bei Haltephase in Synchron" MAP 0x246544 kf_si16_S6_S3 12.75 UMR_BAR__1_1000_0_S6_S3 -6.4 6.35
 /begin AXIS_DESCR STD_AXIS iSasZentr.iSchaltend.n_tkf UMR_U_MIN_32_1_0_S6_S3 6 0 8160 DEPOSIT ABSOLUTE MONOTONY MON_INCREASE /end AXIS_DESCR
 /begin AXIS_DESCR STD_AXIS zff_atsys._.iSignale._.obj.sig_m_t UMR_NM__1_1_0_S6_S3 6 -400 1640 DEPOSIT ABSOLUTE MONOTONY MON_INCREASE /end AXIS_DESCR
/end CHARACTERISTIC
/begin CHARACTERISTIC T_HINSYNSP63 "Zeit fuer Ende Haltephase in Synchron KZU/KAB" VALUE 0x26E787 kw_ui8_S6_S3 2540 UMR_MSEC__10_1_0_S6_S3 0 2540 /end CHARACTERISTIC
/begin CHARACTERISTIC KL_POHKABSP64 "Druckoffset waehrend Haltedruckphase" CURVE 0x2465AC kl_si16_S6_S3 12.75 UMR_BAR__1_1000_0_S6_S3 -6.4 6.35
 /begin AXIS_DESCR STD_AXIS zff_atsys._.iSignale._.obj.sig_m_t8 UMR_NM__8_1_M50_S6_S3 4 -400 1640 DEPOSIT ABSOLUTE MONOTONY MON_INCREASE /end AXIS_DESCR
/end CHARACTERISTIC
/begin CHARACTERISTIC F_PRAHKABSP64 "Druckfaktor waehrend Rampe auf Schaltdruck" VALUE 0x26E788 kw_ui8_S6_S3 1 UMR___1_100_0_S6_S3 0 1 /end CHARACTERISTIC
/begin CHARACTERISTIC F_TRAHKABSP64 "Zeitfaktor waehrend Rampe auf Schaltdruck" VALUE 0x26E789 kw_ui8_S6_S3 1 UMR___1_100_0_S6_S3 0 1 /end CHARACTERISTIC
/begin CHARACTERISTIC KL_TRAHKABSP64 "Zeit fuer Rampe auf Schaltdruck" CURVE 0x2465C0 kl_ui8_S6_S3 2540 UMR_MSEC__10_1_0_S6_S3 0 2540
 /begin AXIS_DESCR STD_AXIS zff_atsys._.iSignale._.obj.sig_m_t8 UMR_NM__8_1_M50_S6_S3 4 -400 1640 DEPOSIT ABSOLUTE MONOTONY MON_INCREASE /end AXIS_DESCR
/end CHARACTERISTIC
/begin CHARACTERISTIC KL_TRAHKABSP64_EL "Zeit fuer Rampe auf Schaltdruck" CURVE 0x2465CC kl_ui8_S6_S3 2540 UMR_MSEC__10_1_0_S6_S3 0 2540
 /begin AXIS_DESCR STD_AXIS zff_atsys._.iSignale._.obj.sig_m_t8 UMR_NM__8_1_M50_S6_S3 4 -400 1640 DEPOSIT ABSOLUTE MONOTONY MON_INCREASE /end AXIS_DESCR
/end CHARACTERISTIC
/begin CHARACTERISTIC KL_PGOKABSP64 "Druckgradient in Abhaengigkeit von m_t" CURVE 0x2465D8 kl_si16_S6_S3 200 UMR_BAR_SEC_1_10_0_S6_S3 -100 100
 /begin AXIS_DESCR STD_AXIS zff_atsys._.iSignale._.obj.sig_m_t UMR_NM__1_1_0_S6_S3 6 -400 1640 DEPOSIT ABSOLUTE MONOTONY MON_INCREASE /end AXIS_DESCR
/end CHARACTERISTIC
/begin CHARACTERISTIC KF_TOHKABMTNTSP64 "Zeitoffset auf Ende SF fuer Haltephase" MAP 0x2465F4 kf_ui8_S6_S3 2000 UMR_MSEC__10_1_M128_S6_S3 -1000 1000
 /begin AXIS_DESCR STD_AXIS zff_atsys._.iSignale._.obj.sig_n_t8 UMR_U_MIN_32_1_0_S6_S3 4 0 8160 DEPOSIT ABSOLUTE MONOTONY MON_INCREASE /end AXIS_DESCR
 /begin AXIS_DESCR STD_AXIS zff_atsys._.iSignale._.obj.sig_m_t8 UMR_NM__8_1_M50_S6_S3 6 -400 1640 DEPOSIT ABSOLUTE MONOTONY MON_INCREASE /end AXIS_DESCR
/end CHARACTERISTIC
/begin CHARACTERISTIC KL_TSYNMTKABSP64 "Zeit vor sync. Ende Schaltdruck KAB" CURVE 0x246620 kl_ui8_S6_S3 1280 UMR_MSEC__10_1_M128_S6_S3 -1280 0
 /begin AXIS_DESCR STD_AXIS zff_atsys._.iSignale._.obj.sig_m_t8 UMR_NM__8_1_M50_S6_S3 4 -400 1640 DEPOSIT ABSOLUTE MONOTONY MON_INCREASE /end AXIS_DESCR
/end CHARACTERISTIC
/begin CHARACTERISTIC KF_PKABSP64 "Schaltdruck abschaltende Kupplung" MAP 0x24662C kf_si16_S6_S3 12.75 UMR_BAR__1_1000_0_S6_S3 0 12.75
 /begin AXIS_DESCR STD_AXIS iSasZentr.iSchaltend.n_tkf UMR_U_MIN_32_1_0_S6_S3 8 0 8160 DEPOSIT ABSOLUTE MONOTONY MON_INCREASE /end AXIS_DESCR
 /begin AXIS_DESCR STD_AXIS zff_atsys._.iSignale._.obj.sig_m_t UMR_NM__1_1_0_S6_S3 10 -400 1640 DEPOSIT ABSOLUTE MONOTONY MON_INCREASE /end AXIS_DESCR
/end CHARACTERISTIC
/begin CHARACTERISTIC KF_PKABSP64_EL "Schaltdruck abschaltende Kupplung" MAP 0x2466F8 kf_si16_S6_S3 12.75 UMR_BAR__1_1000_0_S6_S3 0 12.75
 /begin AXIS_DESCR STD_AXIS iSasZentr.iSchaltend.n_tkf UMR_U_MIN_32_1_0_S6_S3 8 0 8160 DEPOSIT ABSOLUTE MONOTONY MON_INCREASE /end AXIS_DESCR
 /begin AXIS_DESCR STD_AXIS zff_atsys._.iSignale._.obj.sig_m_t UMR_NM__1_1_0_S6_S3 10 -400 1640 DEPOSIT ABSOLUTE MONOTONY MON_INCREASE /end AXIS_DESCR
/end CHARACTERISTIC
/begin CHARACTERISTIC KF_TSYNMTNTKABVSP64 "Zeit vor sync. Ende Haltephase vorb. KAB" MAP 0x2467C4 kf_si16_S6_S3 5000 UMR_MSEC__10_1_0_S6_S3 -5000 0
 /begin AXIS_DESCR STD_AXIS zff_atsys._.iSignale._.obj.sig_m_t UMR_NM__1_1_0_S6_S3 4 -400 1640 DEPOSIT ABSOLUTE MONOTONY MON_INCREASE /end AXIS_DESCR
 /begin AXIS_DESCR STD_AXIS zff_atsys._.iSignale._.obj.sig_n_t UMR_U_MIN_1_1_0_S6_S3 6 0 8160 DEPOSIT ABSOLUTE MONOTONY MON_INCREASE /end AXIS_DESCR
/end CHARACTERISTIC
/begin CHARACTERISTIC KL_TRAMTHINSYNKABSP64 "Zeit fuer Abschalten KAB nach Haltephase in Synchron" CURVE 0x246810 kl_ui8_S6_S3 2550 UMR_MSEC__10_1_0_S6_S3 0 2550
 /begin AXIS_DESCR STD_AXIS zff_atsys._.iSignale._.obj.sig_m_t8 UMR_NM__8_1_M50_S6_S3 4 -400 1640 DEPOSIT ABSOLUTE MONOTONY MON_INCREASE /end AXIS_DESCR
/end CHARACTERISTIC
/begin CHARACTERISTIC KF_POHINSYNKABSP64 "Kennfeld Haltedruckoffset(n_tkf, m_t) bei Haltephase in Synchron" MAP 0x24681C kf_si16_S6_S3 12.75 UMR_BAR__1_1000_0_S6_S3 -6.4 6.35
 /begin AXIS_DESCR STD_AXIS iSasZentr.iSchaltend.n_tkf UMR_U_MIN_32_1_0_S6_S3 6 0 8160 DEPOSIT ABSOLUTE MONOTONY MON_INCREASE /end AXIS_DESCR
 /begin AXIS_DESCR STD_AXIS zff_atsys._.iSignale._.obj.sig_m_t UMR_NM__1_1_0_S6_S3 6 -400 1640 DEPOSIT ABSOLUTE MONOTONY MON_INCREASE /end AXIS_DESCR
/end CHARACTERISTIC
/begin CHARACTERISTIC T_HINSYNSP64 "Zeit fuer Ende Haltephase in Synchron KZU/KAB" VALUE 0x26E78A kw_ui8_S6_S3 2540 UMR_MSEC__10_1_0_S6_S3 0 2540 /end CHARACTERISTIC
/begin CHARACTERISTIC KL_POHKABSP71 "Druckoffset waehrend Haltedruckphase" CURVE 0x246884 kl_si16_S6_S3 12.75 UMR_BAR__1_1000_0_S6_S3 -6.4 6.35
 /begin AXIS_DESCR STD_AXIS zff_atsys._.iSignale._.obj.sig_m_t8 UMR_NM__8_1_M50_S6_S3 4 -400 1640 DEPOSIT ABSOLUTE MONOTONY MON_INCREASE /end AXIS_DESCR
/end CHARACTERISTIC
/begin CHARACTERISTIC F_PRAHKABSP71 "Druckfaktor waehrend Rampe auf Schaltdruck" VALUE 0x26E78B kw_ui8_S6_S3 1 UMR___1_100_0_S6_S3 0 1 /end CHARACTERISTIC
/begin CHARACTERISTIC F_TRAHKABSP71 "Zeitfaktor waehrend Rampe auf Schaltdruck" VALUE 0x26E78C kw_ui8_S6_S3 1 UMR___1_100_0_S6_S3 0 1 /end CHARACTERISTIC
/begin CHARACTERISTIC KL_TRAHKABSP71 "Zeit fuer Rampe auf Schaltdruck" CURVE 0x246898 kl_ui8_S6_S3 2540 UMR_MSEC__10_1_0_S6_S3 0 2540
 /begin AXIS_DESCR STD_AXIS zff_atsys._.iSignale._.obj.sig_m_t8 UMR_NM__8_1_M50_S6_S3 4 -400 1640 DEPOSIT ABSOLUTE MONOTONY MON_INCREASE /end AXIS_DESCR
/end CHARACTERISTIC
/begin CHARACTERISTIC KL_PGOKABSP71 "Druckgradient in Abhaengigkeit von m_t" CURVE 0x2468A4 kl_si16_S6_S3 200 UMR_BAR_SEC_1_10_0_S6_S3 -100 100
 /begin AXIS_DESCR STD_AXIS zff_atsys._.iSignale._.obj.sig_m_t UMR_NM__1_1_0_S6_S3 6 -400 1640 DEPOSIT ABSOLUTE MONOTONY MON_INCREASE /end AXIS_DESCR
/end CHARACTERISTIC
/begin CHARACTERISTIC KF_TOHKABMTNTSP71 "Zeitoffset auf Ende SF fuer Haltephase" MAP 0x2468C0 kf_ui8_S6_S3 2000 UMR_MSEC__10_1_M128_S6_S3 -1000 1000
 /begin AXIS_DESCR STD_AXIS zff_atsys._.iSignale._.obj.sig_n_t8 UMR_U_MIN_32_1_0_S6_S3 4 0 8160 DEPOSIT ABSOLUTE MONOTONY MON_INCREASE /end AXIS_DESCR
 /begin AXIS_DESCR STD_AXIS zff_atsys._.iSignale._.obj.sig_m_t8 UMR_NM__8_1_M50_S6_S3 6 -400 1640 DEPOSIT ABSOLUTE MONOTONY MON_INCREASE /end AXIS_DESCR
/end CHARACTERISTIC
/begin CHARACTERISTIC KL_TSYNMTKABSP71 "Zeit vor sync. Ende Schaltdruck KAB" CURVE 0x2468EC kl_ui8_S6_S3 1280 UMR_MSEC__10_1_M128_S6_S3 -1280 0
 /begin AXIS_DESCR STD_AXIS zff_atsys._.iSignale._.obj.sig_m_t8 UMR_NM__8_1_M50_S6_S3 4 -400 1640 DEPOSIT ABSOLUTE MONOTONY MON_INCREASE /end AXIS_DESCR
/end CHARACTERISTIC
/begin CHARACTERISTIC KF_PKABSP71 "Schaltdruck abschaltende Kupplung" MAP 0x2468F8 kf_si16_S6_S3 12.75 UMR_BAR__1_1000_0_S6_S3 0 12.75
 /begin AXIS_DESCR STD_AXIS iSasZentr.iSchaltend.n_tkf UMR_U_MIN_32_1_0_S6_S3 8 0 8160 DEPOSIT ABSOLUTE MONOTONY MON_INCREASE /end AXIS_DESCR
 /begin AXIS_DESCR STD_AXIS zff_atsys._.iSignale._.obj.sig_m_t UMR_NM__1_1_0_S6_S3 10 -400 1640 DEPOSIT ABSOLUTE MONOTONY MON_INCREASE /end AXIS_DESCR
/end CHARACTERISTIC
/begin CHARACTERISTIC KF_TSYNMTNTKABVSP71 "Zeit vor sync. Ende Haltephase vorb. KAB" MAP 0x2469C4 kf_si16_S6_S3 5000 UMR_MSEC__10_1_0_S6_S3 -5000 0
 /begin AXIS_DESCR STD_AXIS zff_atsys._.iSignale._.obj.sig_m_t UMR_NM__1_1_0_S6_S3 4 -400 1640 DEPOSIT ABSOLUTE MONOTONY MON_INCREASE /end AXIS_DESCR
 /begin AXIS_DESCR STD_AXIS zff_atsys._.iSignale._.obj.sig_n_t UMR_U_MIN_1_1_0_S6_S3 6 0 8160 DEPOSIT ABSOLUTE MONOTONY MON_INCREASE /end AXIS_DESCR
/end CHARACTERISTIC
/begin CHARACTERISTIC KL_TRAMTHINSYNKABSP71 "Zeit fuer Abschalten KAB nach Haltephase in Synchron" CURVE 0x246A10 kl_ui8_S6_S3 2550 UMR_MSEC__10_1_0_S6_S3 0 2550
 /begin AXIS_DESCR STD_AXIS zff_atsys._.iSignale._.obj.sig_m_t8 UMR_NM__8_1_M50_S6_S3 4 -400 1640 DEPOSIT ABSOLUTE MONOTONY MON_INCREASE /end AXIS_DESCR
/end CHARACTERISTIC
/begin CHARACTERISTIC KF_POHINSYNKABSP71 "Kennfeld Haltedruckoffset(n_tkf, m_t) bei Haltephase in Synchron" MAP 0x246A1C kf_si16_S6_S3 12.75 UMR_BAR__1_1000_0_S6_S3 -6.4 6.35
 /begin AXIS_DESCR STD_AXIS iSasZentr.iSchaltend.n_tkf UMR_U_MIN_32_1_0_S6_S3 6 0 8160 DEPOSIT ABSOLUTE MONOTONY MON_INCREASE /end AXIS_DESCR
 /begin AXIS_DESCR STD_AXIS zff_atsys._.iSignale._.obj.sig_m_t UMR_NM__1_1_0_S6_S3 6 -400 1640 DEPOSIT ABSOLUTE MONOTONY MON_INCREASE /end AXIS_DESCR
/end CHARACTERISTIC
/begin CHARACTERISTIC T_HINSYNSP71 "Zeit fuer Ende Haltephase in Synchron KZU/KAB" VALUE 0x26E78D kw_ui8_S6_S3 2540 UMR_MSEC__10_1_0_S6_S3 0 2540 /end CHARACTERISTIC
/begin CHARACTERISTIC KL_POHKABSP75 "Druckoffset waehrend Haltedruckphase" CURVE 0x246A84 kl_si16_S6_S3 12.75 UMR_BAR__1_1000_0_S6_S3 -6.4 6.35
 /begin AXIS_DESCR STD_AXIS zff_atsys._.iSignale._.obj.sig_m_t8 UMR_NM__8_1_M50_S6_S3 4 -400 1640 DEPOSIT ABSOLUTE MONOTONY MON_INCREASE /end AXIS_DESCR
/end CHARACTERISTIC
/begin CHARACTERISTIC F_PRAHKABSP75 "Druckfaktor waehrend Rampe auf Schaltdruck" VALUE 0x26E78E kw_ui8_S6_S3 1 UMR___1_100_0_S6_S3 0 1 /end CHARACTERISTIC
/begin CHARACTERISTIC F_TRAHKABSP75 "Zeitfaktor waehrend Rampe auf Schaltdruck" VALUE 0x26E78F kw_ui8_S6_S3 1 UMR___1_100_0_S6_S3 0 1 /end CHARACTERISTIC
/begin CHARACTERISTIC KL_TRAHKABSP75 "Zeit fuer Rampe auf Schaltdruck" CURVE 0x246A98 kl_ui8_S6_S3 2540 UMR_MSEC__10_1_0_S6_S3 0 2540
 /begin AXIS_DESCR STD_AXIS zff_atsys._.iSignale._.obj.sig_m_t8 UMR_NM__8_1_M50_S6_S3 4 -400 1640 DEPOSIT ABSOLUTE MONOTONY MON_INCREASE /end AXIS_DESCR
/end CHARACTERISTIC
/begin CHARACTERISTIC KL_TRAHKABSP75_EL "Zeit fuer Rampe auf Schaltdruck" CURVE 0x246AA4 kl_ui8_S6_S3 2540 UMR_MSEC__10_1_0_S6_S3 0 2540
 /begin AXIS_DESCR STD_AXIS zff_atsys._.iSignale._.obj.sig_m_t8 UMR_NM__8_1_M50_S6_S3 4 -400 1640 DEPOSIT ABSOLUTE MONOTONY MON_INCREASE /end AXIS_DESCR
/end CHARACTERISTIC
/begin CHARACTERISTIC KL_PGOKABSP75 "Druckgradient in Abhaengigkeit von m_t" CURVE 0x246AB0 kl_si16_S6_S3 200 UMR_BAR_SEC_1_10_0_S6_S3 -100 100
 /begin AXIS_DESCR STD_AXIS zff_atsys._.iSignale._.obj.sig_m_t UMR_NM__1_1_0_S6_S3 6 -400 1640 DEPOSIT ABSOLUTE MONOTONY MON_INCREASE /end AXIS_DESCR
/end CHARACTERISTIC
/begin CHARACTERISTIC KF_TOHKABMTNTSP75 "Zeitoffset auf Ende SF fuer Haltephase" MAP 0x246ACC kf_ui8_S6_S3 2000 UMR_MSEC__10_1_M128_S6_S3 -1000 1000
 /begin AXIS_DESCR STD_AXIS zff_atsys._.iSignale._.obj.sig_n_t8 UMR_U_MIN_32_1_0_S6_S3 4 0 8160 DEPOSIT ABSOLUTE MONOTONY MON_INCREASE /end AXIS_DESCR
 /begin AXIS_DESCR STD_AXIS zff_atsys._.iSignale._.obj.sig_m_t8 UMR_NM__8_1_M50_S6_S3 6 -400 1640 DEPOSIT ABSOLUTE MONOTONY MON_INCREASE /end AXIS_DESCR
/end CHARACTERISTIC
/begin CHARACTERISTIC KL_TSYNMTKABSP75 "Zeit vor sync. Ende Schaltdruck KAB" CURVE 0x246AF8 kl_ui8_S6_S3 1280 UMR_MSEC__10_1_M128_S6_S3 -1280 0
 /begin AXIS_DESCR STD_AXIS zff_atsys._.iSignale._.obj.sig_m_t8 UMR_NM__8_1_M50_S6_S3 4 -400 1640 DEPOSIT ABSOLUTE MONOTONY MON_INCREASE /end AXIS_DESCR
/end CHARACTERISTIC
/begin CHARACTERISTIC KF_PKABSP75 "Schaltdruck abschaltende Kupplung" MAP 0x246B04 kf_si16_S6_S3 12.75 UMR_BAR__1_1000_0_S6_S3 0 12.75
 /begin AXIS_DESCR STD_AXIS iSasZentr.iSchaltend.n_tkf UMR_U_MIN_32_1_0_S6_S3 8 0 8160 DEPOSIT ABSOLUTE MONOTONY MON_INCREASE /end AXIS_DESCR
 /begin AXIS_DESCR STD_AXIS zff_atsys._.iSignale._.obj.sig_m_t UMR_NM__1_1_0_S6_S3 10 -400 1640 DEPOSIT ABSOLUTE MONOTONY MON_INCREASE /end AXIS_DESCR
/end CHARACTERISTIC
/begin CHARACTERISTIC KF_PKABSP75_EL "Schaltdruck abschaltende Kupplung" MAP 0x246BD0 kf_si16_S6_S3 12.75 UMR_BAR__1_1000_0_S6_S3 0 12.75
 /begin AXIS_DESCR STD_AXIS iSasZentr.iSchaltend.n_tkf UMR_U_MIN_32_1_0_S6_S3 8 0 8160 DEPOSIT ABSOLUTE MONOTONY MON_INCREASE /end AXIS_DESCR
 /begin AXIS_DESCR STD_AXIS zff_atsys._.iSignale._.obj.sig_m_t UMR_NM__1_1_0_S6_S3 10 -400 1640 DEPOSIT ABSOLUTE MONOTONY MON_INCREASE /end AXIS_DESCR
/end CHARACTERISTIC
/begin CHARACTERISTIC KF_TSYNMTNTKABVSP75 "Zeit vor sync. Ende Haltephase vorb. KAB" MAP 0x246C9C kf_si16_S6_S3 5000 UMR_MSEC__10_1_0_S6_S3 -5000 0
 /begin AXIS_DESCR STD_AXIS zff_atsys._.iSignale._.obj.sig_m_t UMR_NM__1_1_0_S6_S3 4 -400 1640 DEPOSIT ABSOLUTE MONOTONY MON_INCREASE /end AXIS_DESCR
 /begin AXIS_DESCR STD_AXIS zff_atsys._.iSignale._.obj.sig_n_t UMR_U_MIN_1_1_0_S6_S3 6 0 8160 DEPOSIT ABSOLUTE MONOTONY MON_INCREASE /end AXIS_DESCR
/end CHARACTERISTIC
/begin CHARACTERISTIC KL_TRAMTHINSYNKABSP75 "Zeit fuer Abschalten KAB nach Haltephase in Synchron" CURVE 0x246CE8 kl_ui8_S6_S3 2550 UMR_MSEC__10_1_0_S6_S3 0 2550
 /begin AXIS_DESCR STD_AXIS zff_atsys._.iSignale._.obj.sig_m_t8 UMR_NM__8_1_M50_S6_S3 4 -400 1640 DEPOSIT ABSOLUTE MONOTONY MON_INCREASE /end AXIS_DESCR
/end CHARACTERISTIC
/begin CHARACTERISTIC KF_POHINSYNKABSP75 "Kennfeld Haltedruckoffset(n_tkf, m_t) bei Haltephase in Synchron" MAP 0x246CF4 kf_si16_S6_S3 12.75 UMR_BAR__1_1000_0_S6_S3 -6.4 6.35
 /begin AXIS_DESCR STD_AXIS iSasZentr.iSchaltend.n_tkf UMR_U_MIN_32_1_0_S6_S3 6 0 8160 DEPOSIT ABSOLUTE MONOTONY MON_INCREASE /end AXIS_DESCR
 /begin AXIS_DESCR STD_AXIS zff_atsys._.iSignale._.obj.sig_m_t UMR_NM__1_1_0_S6_S3 6 -400 1640 DEPOSIT ABSOLUTE MONOTONY MON_INCREASE /end AXIS_DESCR
/end CHARACTERISTIC
/begin CHARACTERISTIC T_HINSYNSP75 "Zeit fuer Ende Haltephase in Synchron KZU/KAB" VALUE 0x26E790 kw_ui8_S6_S3 2540 UMR_MSEC__10_1_0_S6_S3 0 2540 /end CHARACTERISTIC
/begin CHARACTERISTIC KL_POHKABSP82 "Druckoffset waehrend Haltedruckphase" CURVE 0x246D5C kl_si16_S6_S3 12.75 UMR_BAR__1_1000_0_S6_S3 -6.4 6.35
 /begin AXIS_DESCR STD_AXIS zff_atsys._.iSignale._.obj.sig_m_t8 UMR_NM__8_1_M50_S6_S3 4 -400 1640 DEPOSIT ABSOLUTE MONOTONY MON_INCREASE /end AXIS_DESCR
/end CHARACTERISTIC
/begin CHARACTERISTIC F_PRAHKABSP82 "Druckfaktor waehrend Rampe auf Schaltdruck" VALUE 0x26E791 kw_ui8_S6_S3 1 UMR___1_100_0_S6_S3 0 1 /end CHARACTERISTIC
/begin CHARACTERISTIC F_TRAHKABSP82 "Zeitfaktor waehrend Rampe auf Schaltdruck" VALUE 0x26E792 kw_ui8_S6_S3 1 UMR___1_100_0_S6_S3 0 1 /end CHARACTERISTIC
/begin CHARACTERISTIC KL_TRAHKABSP82 "Zeit fuer Rampe auf Schaltdruck" CURVE 0x246D70 kl_ui8_S6_S3 2540 UMR_MSEC__10_1_0_S6_S3 0 2540
 /begin AXIS_DESCR STD_AXIS zff_atsys._.iSignale._.obj.sig_m_t8 UMR_NM__8_1_M50_S6_S3 4 -400 1640 DEPOSIT ABSOLUTE MONOTONY MON_INCREASE /end AXIS_DESCR
/end CHARACTERISTIC
/begin CHARACTERISTIC KL_TRAHKABSP82_EL "Zeit fuer Rampe auf Schaltdruck" CURVE 0x246D7C kl_ui8_S6_S3 2540 UMR_MSEC__10_1_0_S6_S3 0 2540
 /begin AXIS_DESCR STD_AXIS zff_atsys._.iSignale._.obj.sig_m_t8 UMR_NM__8_1_M50_S6_S3 4 -400 1640 DEPOSIT ABSOLUTE MONOTONY MON_INCREASE /end AXIS_DESCR
/end CHARACTERISTIC
/begin CHARACTERISTIC KL_PGOKABSP82 "Druckgradient in Abhaengigkeit von m_t" CURVE 0x246D88 kl_si16_S6_S3 200 UMR_BAR_SEC_1_10_0_S6_S3 -100 100
 /begin AXIS_DESCR STD_AXIS zff_atsys._.iSignale._.obj.sig_m_t UMR_NM__1_1_0_S6_S3 6 -400 1640 DEPOSIT ABSOLUTE MONOTONY MON_INCREASE /end AXIS_DESCR
/end CHARACTERISTIC
/begin CHARACTERISTIC KF_TOHKABMTNTSP82 "Zeitoffset auf Ende SF fuer Haltephase" MAP 0x246DA4 kf_ui8_S6_S3 2000 UMR_MSEC__10_1_M128_S6_S3 -1000 1000
 /begin AXIS_DESCR STD_AXIS zff_atsys._.iSignale._.obj.sig_n_t8 UMR_U_MIN_32_1_0_S6_S3 4 0 8160 DEPOSIT ABSOLUTE MONOTONY MON_INCREASE /end AXIS_DESCR
 /begin AXIS_DESCR STD_AXIS zff_atsys._.iSignale._.obj.sig_m_t8 UMR_NM__8_1_M50_S6_S3 6 -400 1640 DEPOSIT ABSOLUTE MONOTONY MON_INCREASE /end AXIS_DESCR
/end CHARACTERISTIC
/begin CHARACTERISTIC KL_TSYNMTKABSP82 "Zeit vor sync. Ende Schaltdruck KAB" CURVE 0x246DD0 kl_ui8_S6_S3 1280 UMR_MSEC__10_1_M128_S6_S3 -1280 0
 /begin AXIS_DESCR STD_AXIS zff_atsys._.iSignale._.obj.sig_m_t8 UMR_NM__8_1_M50_S6_S3 4 -400 1640 DEPOSIT ABSOLUTE MONOTONY MON_INCREASE /end AXIS_DESCR
/end CHARACTERISTIC
/begin CHARACTERISTIC KF_PKABSP82 "Schaltdruck abschaltende Kupplung" MAP 0x246DDC kf_si16_S6_S3 12.75 UMR_BAR__1_1000_0_S6_S3 0 12.75
 /begin AXIS_DESCR STD_AXIS iSasZentr.iSchaltend.n_tkf UMR_U_MIN_32_1_0_S6_S3 8 0 8160 DEPOSIT ABSOLUTE MONOTONY MON_INCREASE /end AXIS_DESCR
 /begin AXIS_DESCR STD_AXIS zff_atsys._.iSignale._.obj.sig_m_t UMR_NM__1_1_0_S6_S3 10 -400 1640 DEPOSIT ABSOLUTE MONOTONY MON_INCREASE /end AXIS_DESCR
/end CHARACTERISTIC
/begin CHARACTERISTIC KF_PKABSP82_EL "Schaltdruck abschaltende Kupplung" MAP 0x246EA8 kf_si16_S6_S3 12.75 UMR_BAR__1_1000_0_S6_S3 0 12.75
 /begin AXIS_DESCR STD_AXIS iSasZentr.iSchaltend.n_tkf UMR_U_MIN_32_1_0_S6_S3 8 0 8160 DEPOSIT ABSOLUTE MONOTONY MON_INCREASE /end AXIS_DESCR
 /begin AXIS_DESCR STD_AXIS zff_atsys._.iSignale._.obj.sig_m_t UMR_NM__1_1_0_S6_S3 10 -400 1640 DEPOSIT ABSOLUTE MONOTONY MON_INCREASE /end AXIS_DESCR
/end CHARACTERISTIC
/begin CHARACTERISTIC KF_TSYNMTNTKABVSP82 "Zeit vor sync. Ende Haltephase vorb. KAB" MAP 0x246F74 kf_si16_S6_S3 5000 UMR_MSEC__10_1_0_S6_S3 -5000 0
 /begin AXIS_DESCR STD_AXIS zff_atsys._.iSignale._.obj.sig_m_t UMR_NM__1_1_0_S6_S3 4 -400 1640 DEPOSIT ABSOLUTE MONOTONY MON_INCREASE /end AXIS_DESCR
 /begin AXIS_DESCR STD_AXIS zff_atsys._.iSignale._.obj.sig_n_t UMR_U_MIN_1_1_0_S6_S3 6 0 8160 DEPOSIT ABSOLUTE MONOTONY MON_INCREASE /end AXIS_DESCR
/end CHARACTERISTIC
/begin CHARACTERISTIC KL_TRAMTHINSYNKABSP82 "Zeit fuer Abschalten KAB nach Haltephase in Synchron" CURVE 0x246FC0 kl_ui8_S6_S3 2550 UMR_MSEC__10_1_0_S6_S3 0 2550
 /begin AXIS_DESCR STD_AXIS zff_atsys._.iSignale._.obj.sig_m_t8 UMR_NM__8_1_M50_S6_S3 4 -400 1640 DEPOSIT ABSOLUTE MONOTONY MON_INCREASE /end AXIS_DESCR
/end CHARACTERISTIC
/begin CHARACTERISTIC KF_POHINSYNKABSP82 "Kennfeld Haltedruckoffset(n_tkf, m_t) bei Haltephase in Synchron" MAP 0x246FCC kf_si16_S6_S3 12.75 UMR_BAR__1_1000_0_S6_S3 -6.4 6.35
 /begin AXIS_DESCR STD_AXIS iSasZentr.iSchaltend.n_tkf UMR_U_MIN_32_1_0_S6_S3 6 0 8160 DEPOSIT ABSOLUTE MONOTONY MON_INCREASE /end AXIS_DESCR
 /begin AXIS_DESCR STD_AXIS zff_atsys._.iSignale._.obj.sig_m_t UMR_NM__1_1_0_S6_S3 6 -400 1640 DEPOSIT ABSOLUTE MONOTONY MON_INCREASE /end AXIS_DESCR
/end CHARACTERISTIC
/begin CHARACTERISTIC T_HINSYNSP82 "Zeit fuer Ende Haltephase in Synchron KZU/KAB" VALUE 0x26E793 kw_ui8_S6_S3 2540 UMR_MSEC__10_1_0_S6_S3 0 2540 /end CHARACTERISTIC
/begin CHARACTERISTIC KL_POHKABSP84 "Druckoffset waehrend Haltedruckphase" CURVE 0x247034 kl_si16_S6_S3 12.75 UMR_BAR__1_1000_0_S6_S3 -6.4 6.35
 /begin AXIS_DESCR STD_AXIS zff_atsys._.iSignale._.obj.sig_m_t8 UMR_NM__8_1_M50_S6_S3 4 -400 1640 DEPOSIT ABSOLUTE MONOTONY MON_INCREASE /end AXIS_DESCR
/end CHARACTERISTIC
/begin CHARACTERISTIC F_PRAHKABSP84 "Druckfaktor waehrend Rampe auf Schaltdruck" VALUE 0x26E794 kw_ui8_S6_S3 1 UMR___1_100_0_S6_S3 0 1 /end CHARACTERISTIC
/begin CHARACTERISTIC F_TRAHKABSP84 "Zeitfaktor waehrend Rampe auf Schaltdruck" VALUE 0x26E795 kw_ui8_S6_S3 1 UMR___1_100_0_S6_S3 0 1 /end CHARACTERISTIC
/begin CHARACTERISTIC KL_TRAHKABSP84 "Zeit fuer Rampe auf Schaltdruck" CURVE 0x247048 kl_ui8_S6_S3 2540 UMR_MSEC__10_1_0_S6_S3 0 2540
 /begin AXIS_DESCR STD_AXIS zff_atsys._.iSignale._.obj.sig_m_t8 UMR_NM__8_1_M50_S6_S3 4 -400 1640 DEPOSIT ABSOLUTE MONOTONY MON_INCREASE /end AXIS_DESCR
/end CHARACTERISTIC
/begin CHARACTERISTIC KL_TRAHKABSP84_EL "Zeit fuer Rampe auf Schaltdruck" CURVE 0x247054 kl_ui8_S6_S3 2540 UMR_MSEC__10_1_0_S6_S3 0 2540
 /begin AXIS_DESCR STD_AXIS zff_atsys._.iSignale._.obj.sig_m_t8 UMR_NM__8_1_M50_S6_S3 4 -400 1640 DEPOSIT ABSOLUTE MONOTONY MON_INCREASE /end AXIS_DESCR
/end CHARACTERISTIC
/begin CHARACTERISTIC KL_PGOKABSP84 "Druckgradient in Abhaengigkeit von m_t" CURVE 0x247060 kl_si16_S6_S3 200 UMR_BAR_SEC_1_10_0_S6_S3 -100 100
 /begin AXIS_DESCR STD_AXIS zff_atsys._.iSignale._.obj.sig_m_t UMR_NM__1_1_0_S6_S3 6 -400 1640 DEPOSIT ABSOLUTE MONOTONY MON_INCREASE /end AXIS_DESCR
/end CHARACTERISTIC
/begin CHARACTERISTIC KF_TOHKABMTNTSP84 "Zeitoffset auf Ende SF fuer Haltephase" MAP 0x24707C kf_ui8_S6_S3 2000 UMR_MSEC__10_1_M128_S6_S3 -1000 1000
 /begin AXIS_DESCR STD_AXIS zff_atsys._.iSignale._.obj.sig_n_t8 UMR_U_MIN_32_1_0_S6_S3 4 0 8160 DEPOSIT ABSOLUTE MONOTONY MON_INCREASE /end AXIS_DESCR
 /begin AXIS_DESCR STD_AXIS zff_atsys._.iSignale._.obj.sig_m_t8 UMR_NM__8_1_M50_S6_S3 6 -400 1640 DEPOSIT ABSOLUTE MONOTONY MON_INCREASE /end AXIS_DESCR
/end CHARACTERISTIC
/begin CHARACTERISTIC KL_TSYNMTKABSP84 "Zeit vor sync. Ende Schaltdruck KAB" CURVE 0x2470A8 kl_ui8_S6_S3 1280 UMR_MSEC__10_1_M128_S6_S3 -1280 0
 /begin AXIS_DESCR STD_AXIS zff_atsys._.iSignale._.obj.sig_m_t8 UMR_NM__8_1_M50_S6_S3 4 -400 1640 DEPOSIT ABSOLUTE MONOTONY MON_INCREASE /end AXIS_DESCR
/end CHARACTERISTIC
/begin CHARACTERISTIC KF_PKABSP84 "Schaltdruck abschaltende Kupplung" MAP 0x2470B4 kf_si16_S6_S3 12.75 UMR_BAR__1_1000_0_S6_S3 0 12.75
 /begin AXIS_DESCR STD_AXIS iSasZentr.iSchaltend.n_tkf UMR_U_MIN_32_1_0_S6_S3 8 0 8160 DEPOSIT ABSOLUTE MONOTONY MON_INCREASE /end AXIS_DESCR
 /begin AXIS_DESCR STD_AXIS zff_atsys._.iSignale._.obj.sig_m_t UMR_NM__1_1_0_S6_S3 10 -400 1640 DEPOSIT ABSOLUTE MONOTONY MON_INCREASE /end AXIS_DESCR
/end CHARACTERISTIC
/begin CHARACTERISTIC KF_PKABSP84_EL "Schaltdruck abschaltende Kupplung" MAP 0x247180 kf_si16_S6_S3 12.75 UMR_BAR__1_1000_0_S6_S3 0 12.75
 /begin AXIS_DESCR STD_AXIS iSasZentr.iSchaltend.n_tkf UMR_U_MIN_32_1_0_S6_S3 8 0 8160 DEPOSIT ABSOLUTE MONOTONY MON_INCREASE /end AXIS_DESCR
 /begin AXIS_DESCR STD_AXIS zff_atsys._.iSignale._.obj.sig_m_t UMR_NM__1_1_0_S6_S3 10 -400 1640 DEPOSIT ABSOLUTE MONOTONY MON_INCREASE /end AXIS_DESCR
/end CHARACTERISTIC
/begin CHARACTERISTIC KF_TSYNMTNTKABVSP84 "Zeit vor sync. Ende Haltephase vorb. KAB" MAP 0x24724C kf_si16_S6_S3 5000 UMR_MSEC__10_1_0_S6_S3 -5000 0
 /begin AXIS_DESCR STD_AXIS zff_atsys._.iSignale._.obj.sig_m_t UMR_NM__1_1_0_S6_S3 4 -400 1640 DEPOSIT ABSOLUTE MONOTONY MON_INCREASE /end AXIS_DESCR
 /begin AXIS_DESCR STD_AXIS zff_atsys._.iSignale._.obj.sig_n_t UMR_U_MIN_1_1_0_S6_S3 6 0 8160 DEPOSIT ABSOLUTE MONOTONY MON_INCREASE /end AXIS_DESCR
/end CHARACTERISTIC
/begin CHARACTERISTIC KL_TRAMTHINSYNKABSP84 "Zeit fuer Abschalten KAB nach Haltephase in Synchron" CURVE 0x247298 kl_ui8_S6_S3 2550 UMR_MSEC__10_1_0_S6_S3 0 2550
 /begin AXIS_DESCR STD_AXIS zff_atsys._.iSignale._.obj.sig_m_t8 UMR_NM__8_1_M50_S6_S3 4 -400 1640 DEPOSIT ABSOLUTE MONOTONY MON_INCREASE /end AXIS_DESCR
/end CHARACTERISTIC
/begin CHARACTERISTIC KF_POHINSYNKABSP84 "Kennfeld Haltedruckoffset(n_tkf, m_t) bei Haltephase in Synchron" MAP 0x2472A4 kf_si16_S6_S3 12.75 UMR_BAR__1_1000_0_S6_S3 -6.4 6.35
 /begin AXIS_DESCR STD_AXIS iSasZentr.iSchaltend.n_tkf UMR_U_MIN_32_1_0_S6_S3 6 0 8160 DEPOSIT ABSOLUTE MONOTONY MON_INCREASE /end AXIS_DESCR
 /begin AXIS_DESCR STD_AXIS zff_atsys._.iSignale._.obj.sig_m_t UMR_NM__1_1_0_S6_S3 6 -400 1640 DEPOSIT ABSOLUTE MONOTONY MON_INCREASE /end AXIS_DESCR
/end CHARACTERISTIC
/begin CHARACTERISTIC T_HINSYNSP84 "Zeit fuer Ende Haltephase in Synchron KZU/KAB" VALUE 0x26E796 kw_ui8_S6_S3 2540 UMR_MSEC__10_1_0_S6_S3 0 2540 /end CHARACTERISTIC
/begin CHARACTERISTIC KL_POHKABSP86 "Druckoffset waehrend Haltedruckphase" CURVE 0x24730C kl_si16_S6_S3 12.75 UMR_BAR__1_1000_0_S6_S3 -6.4 6.35
 /begin AXIS_DESCR STD_AXIS zff_atsys._.iSignale._.obj.sig_m_t8 UMR_NM__8_1_M50_S6_S3 4 -400 1640 DEPOSIT ABSOLUTE MONOTONY MON_INCREASE /end AXIS_DESCR
/end CHARACTERISTIC
/begin CHARACTERISTIC F_PRAHKABSP86 "Druckfaktor waehrend Rampe auf Schaltdruck" VALUE 0x26E797 kw_ui8_S6_S3 1 UMR___1_100_0_S6_S3 0 1 /end CHARACTERISTIC
/begin CHARACTERISTIC F_TRAHKABSP86 "Zeitfaktor waehrend Rampe auf Schaltdruck" VALUE 0x26E798 kw_ui8_S6_S3 1 UMR___1_100_0_S6_S3 0 1 /end CHARACTERISTIC
/begin CHARACTERISTIC KL_TRAHKABSP86 "Zeit fuer Rampe auf Schaltdruck" CURVE 0x247320 kl_ui8_S6_S3 2540 UMR_MSEC__10_1_0_S6_S3 0 2540
 /begin AXIS_DESCR STD_AXIS zff_atsys._.iSignale._.obj.sig_m_t8 UMR_NM__8_1_M50_S6_S3 4 -400 1640 DEPOSIT ABSOLUTE MONOTONY MON_INCREASE /end AXIS_DESCR
/end CHARACTERISTIC
/begin CHARACTERISTIC KL_TRAHKABSP86_EL "Zeit fuer Rampe auf Schaltdruck" CURVE 0x24732C kl_ui8_S6_S3 2540 UMR_MSEC__10_1_0_S6_S3 0 2540
 /begin AXIS_DESCR STD_AXIS zff_atsys._.iSignale._.obj.sig_m_t8 UMR_NM__8_1_M50_S6_S3 4 -400 1640 DEPOSIT ABSOLUTE MONOTONY MON_INCREASE /end AXIS_DESCR
/end CHARACTERISTIC
/begin CHARACTERISTIC KL_PGOKABSP86 "Druckgradient in Abhaengigkeit von m_t" CURVE 0x247338 kl_si16_S6_S3 200 UMR_BAR_SEC_1_10_0_S6_S3 -100 100
 /begin AXIS_DESCR STD_AXIS zff_atsys._.iSignale._.obj.sig_m_t UMR_NM__1_1_0_S6_S3 6 -400 1640 DEPOSIT ABSOLUTE MONOTONY MON_INCREASE /end AXIS_DESCR
/end CHARACTERISTIC
/begin CHARACTERISTIC KF_TOHKABMTNTSP86 "Zeitoffset auf Ende SF fuer Haltephase" MAP 0x247354 kf_ui8_S6_S3 2000 UMR_MSEC__10_1_M128_S6_S3 -1000 1000
 /begin AXIS_DESCR STD_AXIS zff_atsys._.iSignale._.obj.sig_n_t8 UMR_U_MIN_32_1_0_S6_S3 4 0 8160 DEPOSIT ABSOLUTE MONOTONY MON_INCREASE /end AXIS_DESCR
 /begin AXIS_DESCR STD_AXIS zff_atsys._.iSignale._.obj.sig_m_t8 UMR_NM__8_1_M50_S6_S3 6 -400 1640 DEPOSIT ABSOLUTE MONOTONY MON_INCREASE /end AXIS_DESCR
/end CHARACTERISTIC
/begin CHARACTERISTIC KL_TSYNMTKABSP86 "Zeit vor sync. Ende Schaltdruck KAB" CURVE 0x247380 kl_ui8_S6_S3 1280 UMR_MSEC__10_1_M128_S6_S3 -1280 0
 /begin AXIS_DESCR STD_AXIS zff_atsys._.iSignale._.obj.sig_m_t8 UMR_NM__8_1_M50_S6_S3 4 -400 1640 DEPOSIT ABSOLUTE MONOTONY MON_INCREASE /end AXIS_DESCR
/end CHARACTERISTIC
/begin CHARACTERISTIC KF_PKABSP86 "Schaltdruck abschaltende Kupplung" MAP 0x24738C kf_si16_S6_S3 12.75 UMR_BAR__1_1000_0_S6_S3 0 12.75
 /begin AXIS_DESCR STD_AXIS iSasZentr.iSchaltend.n_tkf UMR_U_MIN_32_1_0_S6_S3 8 0 8160 DEPOSIT ABSOLUTE MONOTONY MON_INCREASE /end AXIS_DESCR
 /begin AXIS_DESCR STD_AXIS zff_atsys._.iSignale._.obj.sig_m_t UMR_NM__1_1_0_S6_S3 10 -400 1640 DEPOSIT ABSOLUTE MONOTONY MON_INCREASE /end AXIS_DESCR
/end CHARACTERISTIC
/begin CHARACTERISTIC KF_PKABSP86_EL "Schaltdruck abschaltende Kupplung" MAP 0x247458 kf_si16_S6_S3 12.75 UMR_BAR__1_1000_0_S6_S3 0 12.75
 /begin AXIS_DESCR STD_AXIS iSasZentr.iSchaltend.n_tkf UMR_U_MIN_32_1_0_S6_S3 8 0 8160 DEPOSIT ABSOLUTE MONOTONY MON_INCREASE /end AXIS_DESCR
 /begin AXIS_DESCR STD_AXIS zff_atsys._.iSignale._.obj.sig_m_t UMR_NM__1_1_0_S6_S3 10 -400 1640 DEPOSIT ABSOLUTE MONOTONY MON_INCREASE /end AXIS_DESCR
/end CHARACTERISTIC
/begin CHARACTERISTIC KF_TSYNMTNTKABVSP86 "Zeit vor sync. Ende Haltephase vorb. KAB" MAP 0x247524 kf_si16_S6_S3 5000 UMR_MSEC__10_1_0_S6_S3 -5000 0
 /begin AXIS_DESCR STD_AXIS zff_atsys._.iSignale._.obj.sig_m_t UMR_NM__1_1_0_S6_S3 4 -400 1640 DEPOSIT ABSOLUTE MONOTONY MON_INCREASE /end AXIS_DESCR
 /begin AXIS_DESCR STD_AXIS zff_atsys._.iSignale._.obj.sig_n_t UMR_U_MIN_1_1_0_S6_S3 6 0 8160 DEPOSIT ABSOLUTE MONOTONY MON_INCREASE /end AXIS_DESCR
/end CHARACTERISTIC
/begin CHARACTERISTIC KL_TRAMTHINSYNKABSP86 "Zeit fuer Abschalten KAB nach Haltephase in Synchron" CURVE 0x247570 kl_ui8_S6_S3 2550 UMR_MSEC__10_1_0_S6_S3 0 2550
 /begin AXIS_DESCR STD_AXIS zff_atsys._.iSignale._.obj.sig_m_t8 UMR_NM__8_1_M50_S6_S3 4 -400 1640 DEPOSIT ABSOLUTE MONOTONY MON_INCREASE /end AXIS_DESCR
/end CHARACTERISTIC
/begin CHARACTERISTIC KF_POHINSYNKABSP86 "Kennfeld Haltedruckoffset(n_tkf, m_t) bei Haltephase in Synchron" MAP 0x24757C kf_si16_S6_S3 12.75 UMR_BAR__1_1000_0_S6_S3 -6.4 6.35
 /begin AXIS_DESCR STD_AXIS iSasZentr.iSchaltend.n_tkf UMR_U_MIN_32_1_0_S6_S3 6 0 8160 DEPOSIT ABSOLUTE MONOTONY MON_INCREASE /end AXIS_DESCR
 /begin AXIS_DESCR STD_AXIS zff_atsys._.iSignale._.obj.sig_m_t UMR_NM__1_1_0_S6_S3 6 -400 1640 DEPOSIT ABSOLUTE MONOTONY MON_INCREASE /end AXIS_DESCR
/end CHARACTERISTIC
/begin CHARACTERISTIC T_HINSYNSP86 "Zeit fuer Ende Haltephase in Synchron KZU/KAB" VALUE 0x26E799 kw_ui8_S6_S3 2540 UMR_MSEC__10_1_0_S6_S3 0 2540 /end CHARACTERISTIC
/begin CHARACTERISTIC KL_POHKABSPORT21 "Druckoffset waehrend Haltedruckphase" CURVE 0x2475E4 kl_si16_S6_S3 12.75 UMR_BAR__1_1000_0_S6_S3 -6.4 6.35
 /begin AXIS_DESCR STD_AXIS zff_atsys._.iSignale._.obj.sig_m_t8 UMR_NM__8_1_M50_S6_S3 4 -400 1640 DEPOSIT ABSOLUTE MONOTONY MON_INCREASE /end AXIS_DESCR
/end CHARACTERISTIC
/begin CHARACTERISTIC F_PRAHKABSPORT21 "Druckfaktor waehrend Rampe auf Schaltdruck" VALUE 0x26E79A kw_ui8_S6_S3 1 UMR___1_100_0_S6_S3 0 1 /end CHARACTERISTIC
/begin CHARACTERISTIC F_TRAHKABSPORT21 "Zeitfaktor waehrend Rampe auf Schaltdruck" VALUE 0x26E79B kw_ui8_S6_S3 1 UMR___1_100_0_S6_S3 0 1 /end CHARACTERISTIC
/begin CHARACTERISTIC KL_TRAHKABSPORT21 "Zeit fuer Rampe auf Schaltdruck" CURVE 0x2475F8 kl_ui8_S6_S3 2540 UMR_MSEC__10_1_0_S6_S3 0 2540
 /begin AXIS_DESCR STD_AXIS zff_atsys._.iSignale._.obj.sig_m_t8 UMR_NM__8_1_M50_S6_S3 4 -400 1640 DEPOSIT ABSOLUTE MONOTONY MON_INCREASE /end AXIS_DESCR
/end CHARACTERISTIC
/begin CHARACTERISTIC KL_PGOKABSPORT21 "Druckgradient in Abhaengigkeit von m_t" CURVE 0x247604 kl_si16_S6_S3 200 UMR_BAR_SEC_1_10_0_S6_S3 -100 100
 /begin AXIS_DESCR STD_AXIS zff_atsys._.iSignale._.obj.sig_m_t UMR_NM__1_1_0_S6_S3 6 -400 1640 DEPOSIT ABSOLUTE MONOTONY MON_INCREASE /end AXIS_DESCR
/end CHARACTERISTIC
/begin CHARACTERISTIC KF_TOHKABMTNTSPORT21 "Zeitoffset auf Ende SF fuer Haltephase" MAP 0x247620 kf_ui8_S6_S3 2000 UMR_MSEC__10_1_M128_S6_S3 -1000 1000
 /begin AXIS_DESCR STD_AXIS zff_atsys._.iSignale._.obj.sig_n_t8 UMR_U_MIN_32_1_0_S6_S3 4 0 8160 DEPOSIT ABSOLUTE MONOTONY MON_INCREASE /end AXIS_DESCR
 /begin AXIS_DESCR STD_AXIS zff_atsys._.iSignale._.obj.sig_m_t8 UMR_NM__8_1_M50_S6_S3 6 -400 1640 DEPOSIT ABSOLUTE MONOTONY MON_INCREASE /end AXIS_DESCR
/end CHARACTERISTIC
/begin CHARACTERISTIC KL_TSYNMTKABSPORT21 "Zeit vor sync. Ende Schaltdruck KAB" CURVE 0x24764C kl_ui8_S6_S3 1280 UMR_MSEC__10_1_M128_S6_S3 -1280 0
 /begin AXIS_DESCR STD_AXIS zff_atsys._.iSignale._.obj.sig_m_t8 UMR_NM__8_1_M50_S6_S3 4 -400 1640 DEPOSIT ABSOLUTE MONOTONY MON_INCREASE /end AXIS_DESCR
/end CHARACTERISTIC
/begin CHARACTERISTIC KF_PKABSPORT21 "Schaltdruck abschaltende Kupplung" MAP 0x247658 kf_si16_S6_S3 12.75 UMR_BAR__1_1000_0_S6_S3 0 12.75
 /begin AXIS_DESCR STD_AXIS iSasZentr.iSchaltend.n_tkf UMR_U_MIN_32_1_0_S6_S3 8 0 8160 DEPOSIT ABSOLUTE MONOTONY MON_INCREASE /end AXIS_DESCR
 /begin AXIS_DESCR STD_AXIS zff_atsys._.iSignale._.obj.sig_m_t UMR_NM__1_1_0_S6_S3 10 -400 1640 DEPOSIT ABSOLUTE MONOTONY MON_INCREASE /end AXIS_DESCR
/end CHARACTERISTIC
/begin CHARACTERISTIC KF_TSYNMTNTKABVSPORT21 "Zeit vor sync. Ende Haltephase vorb. KAB" MAP 0x247724 kf_si16_S6_S3 5000 UMR_MSEC__10_1_0_S6_S3 -5000 0
 /begin AXIS_DESCR STD_AXIS zff_atsys._.iSignale._.obj.sig_m_t UMR_NM__1_1_0_S6_S3 4 -400 1640 DEPOSIT ABSOLUTE MONOTONY MON_INCREASE /end AXIS_DESCR
 /begin AXIS_DESCR STD_AXIS zff_atsys._.iSignale._.obj.sig_n_t UMR_U_MIN_1_1_0_S6_S3 6 0 8160 DEPOSIT ABSOLUTE MONOTONY MON_INCREASE /end AXIS_DESCR
/end CHARACTERISTIC
/begin CHARACTERISTIC KL_TRAMTHINSYNKABSPORT21 "Zeit fuer Abschalten KAB nach Haltephase in Synchron" CURVE 0x247770 kl_ui8_S6_S3 2550 UMR_MSEC__10_1_0_S6_S3 0 2550
 /begin AXIS_DESCR STD_AXIS zff_atsys._.iSignale._.obj.sig_m_t8 UMR_NM__8_1_M50_S6_S3 4 -400 1640 DEPOSIT ABSOLUTE MONOTONY MON_INCREASE /end AXIS_DESCR
/end CHARACTERISTIC
/begin CHARACTERISTIC KF_POHINSYNKABSPORT21 "Kennfeld Haltedruckoffset(n_tkf, m_t) bei Haltephase in Synchron" MAP 0x24777C kf_si16_S6_S3 12.75 UMR_BAR__1_1000_0_S6_S3 -6.4 6.35
 /begin AXIS_DESCR STD_AXIS iSasZentr.iSchaltend.n_tkf UMR_U_MIN_32_1_0_S6_S3 6 0 8160 DEPOSIT ABSOLUTE MONOTONY MON_INCREASE /end AXIS_DESCR
 /begin AXIS_DESCR STD_AXIS zff_atsys._.iSignale._.obj.sig_m_t UMR_NM__1_1_0_S6_S3 6 -400 1640 DEPOSIT ABSOLUTE MONOTONY MON_INCREASE /end AXIS_DESCR
/end CHARACTERISTIC
/begin CHARACTERISTIC T_HINSYNSPORT21 "Zeit fuer Ende Haltephase in Synchron KZU/KAB" VALUE 0x26E79C kw_ui8_S6_S3 2540 UMR_MSEC__10_1_0_S6_S3 0 2540 /end CHARACTERISTIC
/begin CHARACTERISTIC KL_POHKABSPORT32 "Druckoffset waehrend Haltedruckphase" CURVE 0x2477E4 kl_si16_S6_S3 12.75 UMR_BAR__1_1000_0_S6_S3 -6.4 6.35
 /begin AXIS_DESCR STD_AXIS zff_atsys._.iSignale._.obj.sig_m_t8 UMR_NM__8_1_M50_S6_S3 4 -400 1640 DEPOSIT ABSOLUTE MONOTONY MON_INCREASE /end AXIS_DESCR
/end CHARACTERISTIC
/begin CHARACTERISTIC F_PRAHKABSPORT32 "Druckfaktor waehrend Rampe auf Schaltdruck" VALUE 0x26E79D kw_ui8_S6_S3 1 UMR___1_100_0_S6_S3 0 1 /end CHARACTERISTIC
/begin CHARACTERISTIC F_TRAHKABSPORT32 "Zeitfaktor waehrend Rampe auf Schaltdruck" VALUE 0x26E79E kw_ui8_S6_S3 1 UMR___1_100_0_S6_S3 0 1 /end CHARACTERISTIC
/begin CHARACTERISTIC KL_TRAHKABSPORT32 "Zeit fuer Rampe auf Schaltdruck" CURVE 0x2477F8 kl_ui8_S6_S3 2540 UMR_MSEC__10_1_0_S6_S3 0 2540
 /begin AXIS_DESCR STD_AXIS zff_atsys._.iSignale._.obj.sig_m_t8 UMR_NM__8_1_M50_S6_S3 4 -400 1640 DEPOSIT ABSOLUTE MONOTONY MON_INCREASE /end AXIS_DESCR
/end CHARACTERISTIC
/begin CHARACTERISTIC KL_PGOKABSPORT32 "Druckgradient in Abhaengigkeit von m_t" CURVE 0x247804 kl_si16_S6_S3 200 UMR_BAR_SEC_1_10_0_S6_S3 -100 100
 /begin AXIS_DESCR STD_AXIS zff_atsys._.iSignale._.obj.sig_m_t UMR_NM__1_1_0_S6_S3 6 -400 1640 DEPOSIT ABSOLUTE MONOTONY MON_INCREASE /end AXIS_DESCR
/end CHARACTERISTIC
/begin CHARACTERISTIC KF_TOHKABMTNTSPORT32 "Zeitoffset auf Ende SF fuer Haltephase" MAP 0x247820 kf_ui8_S6_S3 2000 UMR_MSEC__10_1_M128_S6_S3 -1000 1000
 /begin AXIS_DESCR STD_AXIS zff_atsys._.iSignale._.obj.sig_n_t8 UMR_U_MIN_32_1_0_S6_S3 4 0 8160 DEPOSIT ABSOLUTE MONOTONY MON_INCREASE /end AXIS_DESCR
 /begin AXIS_DESCR STD_AXIS zff_atsys._.iSignale._.obj.sig_m_t8 UMR_NM__8_1_M50_S6_S3 6 -400 1640 DEPOSIT ABSOLUTE MONOTONY MON_INCREASE /end AXIS_DESCR
/end CHARACTERISTIC
/begin CHARACTERISTIC KL_TSYNMTKABSPORT32 "Zeit vor sync. Ende Schaltdruck KAB" CURVE 0x24784C kl_ui8_S6_S3 1280 UMR_MSEC__10_1_M128_S6_S3 -1280 0
 /begin AXIS_DESCR STD_AXIS zff_atsys._.iSignale._.obj.sig_m_t8 UMR_NM__8_1_M50_S6_S3 4 -400 1640 DEPOSIT ABSOLUTE MONOTONY MON_INCREASE /end AXIS_DESCR
/end CHARACTERISTIC
/begin CHARACTERISTIC KF_PKABSPORT32 "Schaltdruck abschaltende Kupplung" MAP 0x247858 kf_si16_S6_S3 12.75 UMR_BAR__1_1000_0_S6_S3 0 12.75
 /begin AXIS_DESCR STD_AXIS iSasZentr.iSchaltend.n_tkf UMR_U_MIN_32_1_0_S6_S3 8 0 8160 DEPOSIT ABSOLUTE MONOTONY MON_INCREASE /end AXIS_DESCR
 /begin AXIS_DESCR STD_AXIS zff_atsys._.iSignale._.obj.sig_m_t UMR_NM__1_1_0_S6_S3 10 -400 1640 DEPOSIT ABSOLUTE MONOTONY MON_INCREASE /end AXIS_DESCR
/end CHARACTERISTIC
/begin CHARACTERISTIC KF_TSYNMTNTKABVSPORT32 "Zeit vor sync. Ende Haltephase vorb. KAB" MAP 0x247924 kf_si16_S6_S3 5000 UMR_MSEC__10_1_0_S6_S3 -5000 0
 /begin AXIS_DESCR STD_AXIS zff_atsys._.iSignale._.obj.sig_m_t UMR_NM__1_1_0_S6_S3 4 -400 1640 DEPOSIT ABSOLUTE MONOTONY MON_INCREASE /end AXIS_DESCR
 /begin AXIS_DESCR STD_AXIS zff_atsys._.iSignale._.obj.sig_n_t UMR_U_MIN_1_1_0_S6_S3 6 0 8160 DEPOSIT ABSOLUTE MONOTONY MON_INCREASE /end AXIS_DESCR
/end CHARACTERISTIC
/begin CHARACTERISTIC KL_TRAMTHINSYNKABSPORT32 "Zeit fuer Abschalten KAB nach Haltephase in Synchron" CURVE 0x247970 kl_ui8_S6_S3 2550 UMR_MSEC__10_1_0_S6_S3 0 2550
 /begin AXIS_DESCR STD_AXIS zff_atsys._.iSignale._.obj.sig_m_t8 UMR_NM__8_1_M50_S6_S3 4 -400 1640 DEPOSIT ABSOLUTE MONOTONY MON_INCREASE /end AXIS_DESCR
/end CHARACTERISTIC
/begin CHARACTERISTIC KF_POHINSYNKABSPORT32 "Kennfeld Haltedruckoffset(n_tkf, m_t) bei Haltephase in Synchron" MAP 0x24797C kf_si16_S6_S3 12.75 UMR_BAR__1_1000_0_S6_S3 -6.4 6.35
 /begin AXIS_DESCR STD_AXIS iSasZentr.iSchaltend.n_tkf UMR_U_MIN_32_1_0_S6_S3 6 0 8160 DEPOSIT ABSOLUTE MONOTONY MON_INCREASE /end AXIS_DESCR
 /begin AXIS_DESCR STD_AXIS zff_atsys._.iSignale._.obj.sig_m_t UMR_NM__1_1_0_S6_S3 6 -400 1640 DEPOSIT ABSOLUTE MONOTONY MON_INCREASE /end AXIS_DESCR
/end CHARACTERISTIC
/begin CHARACTERISTIC T_HINSYNSPORT32 "Zeit fuer Ende Haltephase in Synchron KZU/KAB" VALUE 0x26E79F kw_ui8_S6_S3 2540 UMR_MSEC__10_1_0_S6_S3 0 2540 /end CHARACTERISTIC
/begin CHARACTERISTIC KL_POHKABSPORT43 "Druckoffset waehrend Haltedruckphase" CURVE 0x2479E4 kl_si16_S6_S3 12.75 UMR_BAR__1_1000_0_S6_S3 -6.4 6.35
 /begin AXIS_DESCR STD_AXIS zff_atsys._.iSignale._.obj.sig_m_t8 UMR_NM__8_1_M50_S6_S3 4 -400 1640 DEPOSIT ABSOLUTE MONOTONY MON_INCREASE /end AXIS_DESCR
/end CHARACTERISTIC
/begin CHARACTERISTIC F_PRAHKABSPORT43 "Druckfaktor waehrend Rampe auf Schaltdruck" VALUE 0x26E7A0 kw_ui8_S6_S3 1 UMR___1_100_0_S6_S3 0 1 /end CHARACTERISTIC
/begin CHARACTERISTIC F_TRAHKABSPORT43 "Zeitfaktor waehrend Rampe auf Schaltdruck" VALUE 0x26E7A1 kw_ui8_S6_S3 1 UMR___1_100_0_S6_S3 0 1 /end CHARACTERISTIC
/begin CHARACTERISTIC KL_TRAHKABSPORT43 "Zeit fuer Rampe auf Schaltdruck" CURVE 0x2479F8 kl_ui8_S6_S3 2540 UMR_MSEC__10_1_0_S6_S3 0 2540
 /begin AXIS_DESCR STD_AXIS zff_atsys._.iSignale._.obj.sig_m_t8 UMR_NM__8_1_M50_S6_S3 4 -400 1640 DEPOSIT ABSOLUTE MONOTONY MON_INCREASE /end AXIS_DESCR
/end CHARACTERISTIC
/begin CHARACTERISTIC KL_PGOKABSPORT43 "Druckgradient in Abhaengigkeit von m_t" CURVE 0x247A04 kl_si16_S6_S3 200 UMR_BAR_SEC_1_10_0_S6_S3 -100 100
 /begin AXIS_DESCR STD_AXIS zff_atsys._.iSignale._.obj.sig_m_t UMR_NM__1_1_0_S6_S3 6 -400 1640 DEPOSIT ABSOLUTE MONOTONY MON_INCREASE /end AXIS_DESCR
/end CHARACTERISTIC
/begin CHARACTERISTIC KF_TOHKABMTNTSPORT43 "Zeitoffset auf Ende SF fuer Haltephase" MAP 0x247A20 kf_ui8_S6_S3 2000 UMR_MSEC__10_1_M128_S6_S3 -1000 1000
 /begin AXIS_DESCR STD_AXIS zff_atsys._.iSignale._.obj.sig_n_t8 UMR_U_MIN_32_1_0_S6_S3 4 0 8160 DEPOSIT ABSOLUTE MONOTONY MON_INCREASE /end AXIS_DESCR
 /begin AXIS_DESCR STD_AXIS zff_atsys._.iSignale._.obj.sig_m_t8 UMR_NM__8_1_M50_S6_S3 6 -400 1640 DEPOSIT ABSOLUTE MONOTONY MON_INCREASE /end AXIS_DESCR
/end CHARACTERISTIC
/begin CHARACTERISTIC KL_TSYNMTKABSPORT43 "Zeit vor sync. Ende Schaltdruck KAB" CURVE 0x247A4C kl_ui8_S6_S3 1280 UMR_MSEC__10_1_M128_S6_S3 -1280 0
 /begin AXIS_DESCR STD_AXIS zff_atsys._.iSignale._.obj.sig_m_t8 UMR_NM__8_1_M50_S6_S3 4 -400 1640 DEPOSIT ABSOLUTE MONOTONY MON_INCREASE /end AXIS_DESCR
/end CHARACTERISTIC
/begin CHARACTERISTIC KF_PKABSPORT43 "Schaltdruck abschaltende Kupplung" MAP 0x247A58 kf_si16_S6_S3 12.75 UMR_BAR__1_1000_0_S6_S3 0 12.75
 /begin AXIS_DESCR STD_AXIS iSasZentr.iSchaltend.n_tkf UMR_U_MIN_32_1_0_S6_S3 8 0 8160 DEPOSIT ABSOLUTE MONOTONY MON_INCREASE /end AXIS_DESCR
 /begin AXIS_DESCR STD_AXIS zff_atsys._.iSignale._.obj.sig_m_t UMR_NM__1_1_0_S6_S3 10 -400 1640 DEPOSIT ABSOLUTE MONOTONY MON_INCREASE /end AXIS_DESCR
/end CHARACTERISTIC
/begin CHARACTERISTIC KF_TSYNMTNTKABVSPORT43 "Zeit vor sync. Ende Haltephase vorb. KAB" MAP 0x247B24 kf_si16_S6_S3 5000 UMR_MSEC__10_1_0_S6_S3 -5000 0
 /begin AXIS_DESCR STD_AXIS zff_atsys._.iSignale._.obj.sig_m_t UMR_NM__1_1_0_S6_S3 4 -400 1640 DEPOSIT ABSOLUTE MONOTONY MON_INCREASE /end AXIS_DESCR
 /begin AXIS_DESCR STD_AXIS zff_atsys._.iSignale._.obj.sig_n_t UMR_U_MIN_1_1_0_S6_S3 6 0 8160 DEPOSIT ABSOLUTE MONOTONY MON_INCREASE /end AXIS_DESCR
/end CHARACTERISTIC
/begin CHARACTERISTIC KL_TRAMTHINSYNKABSPORT43 "Zeit fuer Abschalten KAB nach Haltephase in Synchron" CURVE 0x247B70 kl_ui8_S6_S3 2550 UMR_MSEC__10_1_0_S6_S3 0 2550
 /begin AXIS_DESCR STD_AXIS zff_atsys._.iSignale._.obj.sig_m_t8 UMR_NM__8_1_M50_S6_S3 4 -400 1640 DEPOSIT ABSOLUTE MONOTONY MON_INCREASE /end AXIS_DESCR
/end CHARACTERISTIC
/begin CHARACTERISTIC KF_POHINSYNKABSPORT43 "Kennfeld Haltedruckoffset(n_tkf, m_t) bei Haltephase in Synchron" MAP 0x247B7C kf_si16_S6_S3 12.75 UMR_BAR__1_1000_0_S6_S3 -6.4 6.35
 /begin AXIS_DESCR STD_AXIS iSasZentr.iSchaltend.n_tkf UMR_U_MIN_32_1_0_S6_S3 6 0 8160 DEPOSIT ABSOLUTE MONOTONY MON_INCREASE /end AXIS_DESCR
 /begin AXIS_DESCR STD_AXIS zff_atsys._.iSignale._.obj.sig_m_t UMR_NM__1_1_0_S6_S3 6 -400 1640 DEPOSIT ABSOLUTE MONOTONY MON_INCREASE /end AXIS_DESCR
/end CHARACTERISTIC
/begin CHARACTERISTIC T_HINSYNSPORT43 "Zeit fuer Ende Haltephase in Synchron KZU/KAB" VALUE 0x26E7A2 kw_ui8_S6_S3 2540 UMR_MSEC__10_1_0_S6_S3 0 2540 /end CHARACTERISTIC
/begin CHARACTERISTIC KL_POHKABSPORT54 "Druckoffset waehrend Haltedruckphase" CURVE 0x247BE4 kl_si16_S6_S3 12.75 UMR_BAR__1_1000_0_S6_S3 -6.4 6.35
 /begin AXIS_DESCR STD_AXIS zff_atsys._.iSignale._.obj.sig_m_t8 UMR_NM__8_1_M50_S6_S3 4 -400 1640 DEPOSIT ABSOLUTE MONOTONY MON_INCREASE /end AXIS_DESCR
/end CHARACTERISTIC
/begin CHARACTERISTIC F_PRAHKABSPORT54 "Druckfaktor waehrend Rampe auf Schaltdruck" VALUE 0x26E7A3 kw_ui8_S6_S3 1 UMR___1_100_0_S6_S3 0 1 /end CHARACTERISTIC
/begin CHARACTERISTIC F_TRAHKABSPORT54 "Zeitfaktor waehrend Rampe auf Schaltdruck" VALUE 0x26E7A4 kw_ui8_S6_S3 1 UMR___1_100_0_S6_S3 0 1 /end CHARACTERISTIC
/begin CHARACTERISTIC KL_TRAHKABSPORT54 "Zeit fuer Rampe auf Schaltdruck" CURVE 0x247BF8 kl_ui8_S6_S3 2540 UMR_MSEC__10_1_0_S6_S3 0 2540
 /begin AXIS_DESCR STD_AXIS zff_atsys._.iSignale._.obj.sig_m_t8 UMR_NM__8_1_M50_S6_S3 4 -400 1640 DEPOSIT ABSOLUTE MONOTONY MON_INCREASE /end AXIS_DESCR
/end CHARACTERISTIC
/begin CHARACTERISTIC KL_PGOKABSPORT54 "Druckgradient in Abhaengigkeit von m_t" CURVE 0x247C04 kl_si16_S6_S3 200 UMR_BAR_SEC_1_10_0_S6_S3 -100 100
 /begin AXIS_DESCR STD_AXIS zff_atsys._.iSignale._.obj.sig_m_t UMR_NM__1_1_0_S6_S3 6 -400 1640 DEPOSIT ABSOLUTE MONOTONY MON_INCREASE /end AXIS_DESCR
/end CHARACTERISTIC
/begin CHARACTERISTIC KF_TOHKABMTNTSPORT54 "Zeitoffset auf Ende SF fuer Haltephase" MAP 0x247C20 kf_ui8_S6_S3 2000 UMR_MSEC__10_1_M128_S6_S3 -1000 1000
 /begin AXIS_DESCR STD_AXIS zff_atsys._.iSignale._.obj.sig_n_t8 UMR_U_MIN_32_1_0_S6_S3 4 0 8160 DEPOSIT ABSOLUTE MONOTONY MON_INCREASE /end AXIS_DESCR
 /begin AXIS_DESCR STD_AXIS zff_atsys._.iSignale._.obj.sig_m_t8 UMR_NM__8_1_M50_S6_S3 6 -400 1640 DEPOSIT ABSOLUTE MONOTONY MON_INCREASE /end AXIS_DESCR
/end CHARACTERISTIC
/begin CHARACTERISTIC KL_TSYNMTKABSPORT54 "Zeit vor sync. Ende Schaltdruck KAB" CURVE 0x247C4C kl_ui8_S6_S3 1280 UMR_MSEC__10_1_M128_S6_S3 -1280 0
 /begin AXIS_DESCR STD_AXIS zff_atsys._.iSignale._.obj.sig_m_t8 UMR_NM__8_1_M50_S6_S3 4 -400 1640 DEPOSIT ABSOLUTE MONOTONY MON_INCREASE /end AXIS_DESCR
/end CHARACTERISTIC
/begin CHARACTERISTIC KF_PKABSPORT54 "Schaltdruck abschaltende Kupplung" MAP 0x247C58 kf_si16_S6_S3 12.75 UMR_BAR__1_1000_0_S6_S3 0 12.75
 /begin AXIS_DESCR STD_AXIS iSasZentr.iSchaltend.n_tkf UMR_U_MIN_32_1_0_S6_S3 8 0 8160 DEPOSIT ABSOLUTE MONOTONY MON_INCREASE /end AXIS_DESCR
 /begin AXIS_DESCR STD_AXIS zff_atsys._.iSignale._.obj.sig_m_t UMR_NM__1_1_0_S6_S3 10 -400 1640 DEPOSIT ABSOLUTE MONOTONY MON_INCREASE /end AXIS_DESCR
/end CHARACTERISTIC
/begin CHARACTERISTIC KF_TSYNMTNTKABVSPORT54 "Zeit vor sync. Ende Haltephase vorb. KAB" MAP 0x247D24 kf_si16_S6_S3 5000 UMR_MSEC__10_1_0_S6_S3 -5000 0
 /begin AXIS_DESCR STD_AXIS zff_atsys._.iSignale._.obj.sig_m_t UMR_NM__1_1_0_S6_S3 4 -400 1640 DEPOSIT ABSOLUTE MONOTONY MON_INCREASE /end AXIS_DESCR
 /begin AXIS_DESCR STD_AXIS zff_atsys._.iSignale._.obj.sig_n_t UMR_U_MIN_1_1_0_S6_S3 6 0 8160 DEPOSIT ABSOLUTE MONOTONY MON_INCREASE /end AXIS_DESCR
/end CHARACTERISTIC
/begin CHARACTERISTIC KL_TRAMTHINSYNKABSPORT54 "Zeit fuer Abschalten KAB nach Haltephase in Synchron" CURVE 0x247D70 kl_ui8_S6_S3 2550 UMR_MSEC__10_1_0_S6_S3 0 2550
 /begin AXIS_DESCR STD_AXIS zff_atsys._.iSignale._.obj.sig_m_t8 UMR_NM__8_1_M50_S6_S3 4 -400 1640 DEPOSIT ABSOLUTE MONOTONY MON_INCREASE /end AXIS_DESCR
/end CHARACTERISTIC
/begin CHARACTERISTIC KF_POHINSYNKABSPORT54 "Kennfeld Haltedruckoffset(n_tkf, m_t) bei Haltephase in Synchron" MAP 0x247D7C kf_si16_S6_S3 12.75 UMR_BAR__1_1000_0_S6_S3 -6.4 6.35
 /begin AXIS_DESCR STD_AXIS iSasZentr.iSchaltend.n_tkf UMR_U_MIN_32_1_0_S6_S3 6 0 8160 DEPOSIT ABSOLUTE MONOTONY MON_INCREASE /end AXIS_DESCR
 /begin AXIS_DESCR STD_AXIS zff_atsys._.iSignale._.obj.sig_m_t UMR_NM__1_1_0_S6_S3 6 -400 1640 DEPOSIT ABSOLUTE MONOTONY MON_INCREASE /end AXIS_DESCR
/end CHARACTERISTIC
/begin CHARACTERISTIC T_HINSYNSPORT54 "Zeit fuer Ende Haltephase in Synchron KZU/KAB" VALUE 0x26E7A5 kw_ui8_S6_S3 2540 UMR_MSEC__10_1_0_S6_S3 0 2540 /end CHARACTERISTIC
/begin CHARACTERISTIC KL_POHKABSPORT65 "Druckoffset waehrend Haltedruckphase" CURVE 0x247DE4 kl_si16_S6_S3 12.75 UMR_BAR__1_1000_0_S6_S3 -6.4 6.35
 /begin AXIS_DESCR STD_AXIS zff_atsys._.iSignale._.obj.sig_m_t8 UMR_NM__8_1_M50_S6_S3 4 -400 1640 DEPOSIT ABSOLUTE MONOTONY MON_INCREASE /end AXIS_DESCR
/end CHARACTERISTIC
/begin CHARACTERISTIC F_PRAHKABSPORT65 "Druckfaktor waehrend Rampe auf Schaltdruck" VALUE 0x26E7A6 kw_ui8_S6_S3 1 UMR___1_100_0_S6_S3 0 1 /end CHARACTERISTIC
/begin CHARACTERISTIC F_TRAHKABSPORT65 "Zeitfaktor waehrend Rampe auf Schaltdruck" VALUE 0x26E7A7 kw_ui8_S6_S3 1 UMR___1_100_0_S6_S3 0 1 /end CHARACTERISTIC
/begin CHARACTERISTIC KL_TRAHKABSPORT65 "Zeit fuer Rampe auf Schaltdruck" CURVE 0x247DF8 kl_ui8_S6_S3 2540 UMR_MSEC__10_1_0_S6_S3 0 2540
 /begin AXIS_DESCR STD_AXIS zff_atsys._.iSignale._.obj.sig_m_t8 UMR_NM__8_1_M50_S6_S3 4 -400 1640 DEPOSIT ABSOLUTE MONOTONY MON_INCREASE /end AXIS_DESCR
/end CHARACTERISTIC
/begin CHARACTERISTIC KL_PGOKABSPORT65 "Druckgradient in Abhaengigkeit von m_t" CURVE 0x247E04 kl_si16_S6_S3 200 UMR_BAR_SEC_1_10_0_S6_S3 -100 100
 /begin AXIS_DESCR STD_AXIS zff_atsys._.iSignale._.obj.sig_m_t UMR_NM__1_1_0_S6_S3 6 -400 1640 DEPOSIT ABSOLUTE MONOTONY MON_INCREASE /end AXIS_DESCR
/end CHARACTERISTIC
/begin CHARACTERISTIC KF_TOHKABMTNTSPORT65 "Zeitoffset auf Ende SF fuer Haltephase" MAP 0x247E20 kf_ui8_S6_S3 2000 UMR_MSEC__10_1_M128_S6_S3 -1000 1000
 /begin AXIS_DESCR STD_AXIS zff_atsys._.iSignale._.obj.sig_n_t8 UMR_U_MIN_32_1_0_S6_S3 4 0 8160 DEPOSIT ABSOLUTE MONOTONY MON_INCREASE /end AXIS_DESCR
 /begin AXIS_DESCR STD_AXIS zff_atsys._.iSignale._.obj.sig_m_t8 UMR_NM__8_1_M50_S6_S3 6 -400 1640 DEPOSIT ABSOLUTE MONOTONY MON_INCREASE /end AXIS_DESCR
/end CHARACTERISTIC
/begin CHARACTERISTIC KL_TSYNMTKABSPORT65 "Zeit vor sync. Ende Schaltdruck KAB" CURVE 0x247E4C kl_ui8_S6_S3 1280 UMR_MSEC__10_1_M128_S6_S3 -1280 0
 /begin AXIS_DESCR STD_AXIS zff_atsys._.iSignale._.obj.sig_m_t8 UMR_NM__8_1_M50_S6_S3 4 -400 1640 DEPOSIT ABSOLUTE MONOTONY MON_INCREASE /end AXIS_DESCR
/end CHARACTERISTIC
/begin CHARACTERISTIC KF_PKABSPORT65 "Schaltdruck abschaltende Kupplung" MAP 0x247E58 kf_si16_S6_S3 12.75 UMR_BAR__1_1000_0_S6_S3 0 12.75
 /begin AXIS_DESCR STD_AXIS iSasZentr.iSchaltend.n_tkf UMR_U_MIN_32_1_0_S6_S3 8 0 8160 DEPOSIT ABSOLUTE MONOTONY MON_INCREASE /end AXIS_DESCR
 /begin AXIS_DESCR STD_AXIS zff_atsys._.iSignale._.obj.sig_m_t UMR_NM__1_1_0_S6_S3 10 -400 1640 DEPOSIT ABSOLUTE MONOTONY MON_INCREASE /end AXIS_DESCR
/end CHARACTERISTIC
/begin CHARACTERISTIC KF_TSYNMTNTKABVSPORT65 "Zeit vor sync. Ende Haltephase vorb. KAB" MAP 0x247F24 kf_si16_S6_S3 5000 UMR_MSEC__10_1_0_S6_S3 -5000 0
 /begin AXIS_DESCR STD_AXIS zff_atsys._.iSignale._.obj.sig_m_t UMR_NM__1_1_0_S6_S3 4 -400 1640 DEPOSIT ABSOLUTE MONOTONY MON_INCREASE /end AXIS_DESCR
 /begin AXIS_DESCR STD_AXIS zff_atsys._.iSignale._.obj.sig_n_t UMR_U_MIN_1_1_0_S6_S3 6 0 8160 DEPOSIT ABSOLUTE MONOTONY MON_INCREASE /end AXIS_DESCR
/end CHARACTERISTIC
/begin CHARACTERISTIC KL_TRAMTHINSYNKABSPORT65 "Zeit fuer Abschalten KAB nach Haltephase in Synchron" CURVE 0x247F70 kl_ui8_S6_S3 2550 UMR_MSEC__10_1_0_S6_S3 0 2550
 /begin AXIS_DESCR STD_AXIS zff_atsys._.iSignale._.obj.sig_m_t8 UMR_NM__8_1_M50_S6_S3 4 -400 1640 DEPOSIT ABSOLUTE MONOTONY MON_INCREASE /end AXIS_DESCR
/end CHARACTERISTIC
/begin CHARACTERISTIC KF_POHINSYNKABSPORT65 "Kennfeld Haltedruckoffset(n_tkf, m_t) bei Haltephase in Synchron" MAP 0x247F7C kf_si16_S6_S3 12.75 UMR_BAR__1_1000_0_S6_S3 -6.4 6.35
 /begin AXIS_DESCR STD_AXIS iSasZentr.iSchaltend.n_tkf UMR_U_MIN_32_1_0_S6_S3 6 0 8160 DEPOSIT ABSOLUTE MONOTONY MON_INCREASE /end AXIS_DESCR
 /begin AXIS_DESCR STD_AXIS zff_atsys._.iSignale._.obj.sig_m_t UMR_NM__1_1_0_S6_S3 6 -400 1640 DEPOSIT ABSOLUTE MONOTONY MON_INCREASE /end AXIS_DESCR
/end CHARACTERISTIC
/begin CHARACTERISTIC T_HINSYNSPORT65 "Zeit fuer Ende Haltephase in Synchron KZU/KAB" VALUE 0x26E7A8 kw_ui8_S6_S3 2540 UMR_MSEC__10_1_0_S6_S3 0 2540 /end CHARACTERISTIC
/begin CHARACTERISTIC KL_POHKABSPORT76 "Druckoffset waehrend Haltedruckphase" CURVE 0x247FE4 kl_si16_S6_S3 12.75 UMR_BAR__1_1000_0_S6_S3 -6.4 6.35
 /begin AXIS_DESCR STD_AXIS zff_atsys._.iSignale._.obj.sig_m_t8 UMR_NM__8_1_M50_S6_S3 4 -400 1640 DEPOSIT ABSOLUTE MONOTONY MON_INCREASE /end AXIS_DESCR
/end CHARACTERISTIC
/begin CHARACTERISTIC F_PRAHKABSPORT76 "Druckfaktor waehrend Rampe auf Schaltdruck" VALUE 0x26E7A9 kw_ui8_S6_S3 1 UMR___1_100_0_S6_S3 0 1 /end CHARACTERISTIC
/begin CHARACTERISTIC F_TRAHKABSPORT76 "Zeitfaktor waehrend Rampe auf Schaltdruck" VALUE 0x26E7AA kw_ui8_S6_S3 1 UMR___1_100_0_S6_S3 0 1 /end CHARACTERISTIC
/begin CHARACTERISTIC KL_TRAHKABSPORT76 "Zeit fuer Rampe auf Schaltdruck" CURVE 0x247FF8 kl_ui8_S6_S3 2540 UMR_MSEC__10_1_0_S6_S3 0 2540
 /begin AXIS_DESCR STD_AXIS zff_atsys._.iSignale._.obj.sig_m_t8 UMR_NM__8_1_M50_S6_S3 4 -400 1640 DEPOSIT ABSOLUTE MONOTONY MON_INCREASE /end AXIS_DESCR
/end CHARACTERISTIC
/begin CHARACTERISTIC KL_PGOKABSPORT76 "Druckgradient in Abhaengigkeit von m_t" CURVE 0x248004 kl_si16_S6_S3 200 UMR_BAR_SEC_1_10_0_S6_S3 -100 100
 /begin AXIS_DESCR STD_AXIS zff_atsys._.iSignale._.obj.sig_m_t UMR_NM__1_1_0_S6_S3 6 -400 1640 DEPOSIT ABSOLUTE MONOTONY MON_INCREASE /end AXIS_DESCR
/end CHARACTERISTIC
/begin CHARACTERISTIC KF_TOHKABMTNTSPORT76 "Zeitoffset auf Ende SF fuer Haltephase" MAP 0x248020 kf_ui8_S6_S3 2000 UMR_MSEC__10_1_M128_S6_S3 -1000 1000
 /begin AXIS_DESCR STD_AXIS zff_atsys._.iSignale._.obj.sig_n_t8 UMR_U_MIN_32_1_0_S6_S3 4 0 8160 DEPOSIT ABSOLUTE MONOTONY MON_INCREASE /end AXIS_DESCR
 /begin AXIS_DESCR STD_AXIS zff_atsys._.iSignale._.obj.sig_m_t8 UMR_NM__8_1_M50_S6_S3 6 -400 1640 DEPOSIT ABSOLUTE MONOTONY MON_INCREASE /end AXIS_DESCR
/end CHARACTERISTIC
/begin CHARACTERISTIC KL_TSYNMTKABSPORT76 "Zeit vor sync. Ende Schaltdruck KAB" CURVE 0x24804C kl_ui8_S6_S3 1280 UMR_MSEC__10_1_M128_S6_S3 -1280 0
 /begin AXIS_DESCR STD_AXIS zff_atsys._.iSignale._.obj.sig_m_t8 UMR_NM__8_1_M50_S6_S3 4 -400 1640 DEPOSIT ABSOLUTE MONOTONY MON_INCREASE /end AXIS_DESCR
/end CHARACTERISTIC
/begin CHARACTERISTIC KF_PKABSPORT76 "Schaltdruck abschaltende Kupplung" MAP 0x248058 kf_si16_S6_S3 12.75 UMR_BAR__1_1000_0_S6_S3 0 12.75
 /begin AXIS_DESCR STD_AXIS iSasZentr.iSchaltend.n_tkf UMR_U_MIN_32_1_0_S6_S3 8 0 8160 DEPOSIT ABSOLUTE MONOTONY MON_INCREASE /end AXIS_DESCR
 /begin AXIS_DESCR STD_AXIS zff_atsys._.iSignale._.obj.sig_m_t UMR_NM__1_1_0_S6_S3 10 -400 1640 DEPOSIT ABSOLUTE MONOTONY MON_INCREASE /end AXIS_DESCR
/end CHARACTERISTIC
/begin CHARACTERISTIC KF_TSYNMTNTKABVSPORT76 "Zeit vor sync. Ende Haltephase vorb. KAB" MAP 0x248124 kf_si16_S6_S3 5000 UMR_MSEC__10_1_0_S6_S3 -5000 0
 /begin AXIS_DESCR STD_AXIS zff_atsys._.iSignale._.obj.sig_m_t UMR_NM__1_1_0_S6_S3 4 -400 1640 DEPOSIT ABSOLUTE MONOTONY MON_INCREASE /end AXIS_DESCR
 /begin AXIS_DESCR STD_AXIS zff_atsys._.iSignale._.obj.sig_n_t UMR_U_MIN_1_1_0_S6_S3 6 0 8160 DEPOSIT ABSOLUTE MONOTONY MON_INCREASE /end AXIS_DESCR
/end CHARACTERISTIC
/begin CHARACTERISTIC KL_TRAMTHINSYNKABSPORT76 "Zeit fuer Abschalten KAB nach Haltephase in Synchron" CURVE 0x248170 kl_ui8_S6_S3 2550 UMR_MSEC__10_1_0_S6_S3 0 2550
 /begin AXIS_DESCR STD_AXIS zff_atsys._.iSignale._.obj.sig_m_t8 UMR_NM__8_1_M50_S6_S3 4 -400 1640 DEPOSIT ABSOLUTE MONOTONY MON_INCREASE /end AXIS_DESCR
/end CHARACTERISTIC
/begin CHARACTERISTIC KF_POHINSYNKABSPORT76 "Kennfeld Haltedruckoffset(n_tkf, m_t) bei Haltephase in Synchron" MAP 0x24817C kf_si16_S6_S3 12.75 UMR_BAR__1_1000_0_S6_S3 -6.4 6.35
 /begin AXIS_DESCR STD_AXIS iSasZentr.iSchaltend.n_tkf UMR_U_MIN_32_1_0_S6_S3 6 0 8160 DEPOSIT ABSOLUTE MONOTONY MON_INCREASE /end AXIS_DESCR
 /begin AXIS_DESCR STD_AXIS zff_atsys._.iSignale._.obj.sig_m_t UMR_NM__1_1_0_S6_S3 6 -400 1640 DEPOSIT ABSOLUTE MONOTONY MON_INCREASE /end AXIS_DESCR
/end CHARACTERISTIC
/begin CHARACTERISTIC T_HINSYNSPORT76 "Zeit fuer Ende Haltephase in Synchron KZU/KAB" VALUE 0x26E7AB kw_ui8_S6_S3 2540 UMR_MSEC__10_1_0_S6_S3 0 2540 /end CHARACTERISTIC
/begin CHARACTERISTIC KL_POHKABSPORT87 "Druckoffset waehrend Haltedruckphase" CURVE 0x2481E4 kl_si16_S6_S3 12.75 UMR_BAR__1_1000_0_S6_S3 -6.4 6.35
 /begin AXIS_DESCR STD_AXIS zff_atsys._.iSignale._.obj.sig_m_t8 UMR_NM__8_1_M50_S6_S3 4 -400 1640 DEPOSIT ABSOLUTE MONOTONY MON_INCREASE /end AXIS_DESCR
/end CHARACTERISTIC
/begin CHARACTERISTIC F_PRAHKABSPORT87 "Druckfaktor waehrend Rampe auf Schaltdruck" VALUE 0x26E7AC kw_ui8_S6_S3 1 UMR___1_100_0_S6_S3 0 1 /end CHARACTERISTIC
/begin CHARACTERISTIC F_TRAHKABSPORT87 "Zeitfaktor waehrend Rampe auf Schaltdruck" VALUE 0x26E7AD kw_ui8_S6_S3 1 UMR___1_100_0_S6_S3 0 1 /end CHARACTERISTIC
/begin CHARACTERISTIC KL_TRAHKABSPORT87 "Zeit fuer Rampe auf Schaltdruck" CURVE 0x2481F8 kl_ui8_S6_S3 2540 UMR_MSEC__10_1_0_S6_S3 0 2540
 /begin AXIS_DESCR STD_AXIS zff_atsys._.iSignale._.obj.sig_m_t8 UMR_NM__8_1_M50_S6_S3 4 -400 1640 DEPOSIT ABSOLUTE MONOTONY MON_INCREASE /end AXIS_DESCR
/end CHARACTERISTIC
/begin CHARACTERISTIC KL_PGOKABSPORT87 "Druckgradient in Abhaengigkeit von m_t" CURVE 0x248204 kl_si16_S6_S3 200 UMR_BAR_SEC_1_10_0_S6_S3 -100 100
 /begin AXIS_DESCR STD_AXIS zff_atsys._.iSignale._.obj.sig_m_t UMR_NM__1_1_0_S6_S3 6 -400 1640 DEPOSIT ABSOLUTE MONOTONY MON_INCREASE /end AXIS_DESCR
/end CHARACTERISTIC
/begin CHARACTERISTIC KF_TOHKABMTNTSPORT87 "Zeitoffset auf Ende SF fuer Haltephase" MAP 0x248220 kf_ui8_S6_S3 2000 UMR_MSEC__10_1_M128_S6_S3 -1000 1000
 /begin AXIS_DESCR STD_AXIS zff_atsys._.iSignale._.obj.sig_n_t8 UMR_U_MIN_32_1_0_S6_S3 4 0 8160 DEPOSIT ABSOLUTE MONOTONY MON_INCREASE /end AXIS_DESCR
 /begin AXIS_DESCR STD_AXIS zff_atsys._.iSignale._.obj.sig_m_t8 UMR_NM__8_1_M50_S6_S3 6 -400 1640 DEPOSIT ABSOLUTE MONOTONY MON_INCREASE /end AXIS_DESCR
/end CHARACTERISTIC
/begin CHARACTERISTIC KL_TSYNMTKABSPORT87 "Zeit vor sync. Ende Schaltdruck KAB" CURVE 0x24824C kl_ui8_S6_S3 1280 UMR_MSEC__10_1_M128_S6_S3 -1280 0
 /begin AXIS_DESCR STD_AXIS zff_atsys._.iSignale._.obj.sig_m_t8 UMR_NM__8_1_M50_S6_S3 4 -400 1640 DEPOSIT ABSOLUTE MONOTONY MON_INCREASE /end AXIS_DESCR
/end CHARACTERISTIC
/begin CHARACTERISTIC KF_PKABSPORT87 "Schaltdruck abschaltende Kupplung" MAP 0x248258 kf_si16_S6_S3 12.75 UMR_BAR__1_1000_0_S6_S3 0 12.75
 /begin AXIS_DESCR STD_AXIS iSasZentr.iSchaltend.n_tkf UMR_U_MIN_32_1_0_S6_S3 8 0 8160 DEPOSIT ABSOLUTE MONOTONY MON_INCREASE /end AXIS_DESCR
 /begin AXIS_DESCR STD_AXIS zff_atsys._.iSignale._.obj.sig_m_t UMR_NM__1_1_0_S6_S3 10 -400 1640 DEPOSIT ABSOLUTE MONOTONY MON_INCREASE /end AXIS_DESCR
/end CHARACTERISTIC
/begin CHARACTERISTIC KF_TSYNMTNTKABVSPORT87 "Zeit vor sync. Ende Haltephase vorb. KAB" MAP 0x248324 kf_si16_S6_S3 5000 UMR_MSEC__10_1_0_S6_S3 -5000 0
 /begin AXIS_DESCR STD_AXIS zff_atsys._.iSignale._.obj.sig_m_t UMR_NM__1_1_0_S6_S3 4 -400 1640 DEPOSIT ABSOLUTE MONOTONY MON_INCREASE /end AXIS_DESCR
 /begin AXIS_DESCR STD_AXIS zff_atsys._.iSignale._.obj.sig_n_t UMR_U_MIN_1_1_0_S6_S3 6 0 8160 DEPOSIT ABSOLUTE MONOTONY MON_INCREASE /end AXIS_DESCR
/end CHARACTERISTIC
/begin CHARACTERISTIC KL_TRAMTHINSYNKABSPORT87 "Zeit fuer Abschalten KAB nach Haltephase in Synchron" CURVE 0x248370 kl_ui8_S6_S3 2550 UMR_MSEC__10_1_0_S6_S3 0 2550
 /begin AXIS_DESCR STD_AXIS zff_atsys._.iSignale._.obj.sig_m_t8 UMR_NM__8_1_M50_S6_S3 4 -400 1640 DEPOSIT ABSOLUTE MONOTONY MON_INCREASE /end AXIS_DESCR
/end CHARACTERISTIC
/begin CHARACTERISTIC KF_POHINSYNKABSPORT87 "Kennfeld Haltedruckoffset(n_tkf, m_t) bei Haltephase in Synchron" MAP 0x24837C kf_si16_S6_S3 12.75 UMR_BAR__1_1000_0_S6_S3 -6.4 6.35
 /begin AXIS_DESCR STD_AXIS iSasZentr.iSchaltend.n_tkf UMR_U_MIN_32_1_0_S6_S3 6 0 8160 DEPOSIT ABSOLUTE MONOTONY MON_INCREASE /end AXIS_DESCR
 /begin AXIS_DESCR STD_AXIS zff_atsys._.iSignale._.obj.sig_m_t UMR_NM__1_1_0_S6_S3 6 -400 1640 DEPOSIT ABSOLUTE MONOTONY MON_INCREASE /end AXIS_DESCR
/end CHARACTERISTIC
/begin CHARACTERISTIC T_HINSYNSPORT87 "Zeit fuer Ende Haltephase in Synchron KZU/KAB" VALUE 0x26E7AE kw_ui8_S6_S3 2540 UMR_MSEC__10_1_0_S6_S3 0 2540 /end CHARACTERISTIC
/begin CHARACTERISTIC KL_POHKABSPORT31 "Druckoffset waehrend Haltedruckphase" CURVE 0x2483E4 kl_si16_S6_S3 12.75 UMR_BAR__1_1000_0_S6_S3 -6.4 6.35
 /begin AXIS_DESCR STD_AXIS zff_atsys._.iSignale._.obj.sig_m_t8 UMR_NM__8_1_M50_S6_S3 4 -400 1640 DEPOSIT ABSOLUTE MONOTONY MON_INCREASE /end AXIS_DESCR
/end CHARACTERISTIC
/begin CHARACTERISTIC F_PRAHKABSPORT31 "Druckfaktor waehrend Rampe auf Schaltdruck" VALUE 0x26E7AF kw_ui8_S6_S3 1 UMR___1_100_0_S6_S3 0 1 /end CHARACTERISTIC
/begin CHARACTERISTIC F_TRAHKABSPORT31 "Zeitfaktor waehrend Rampe auf Schaltdruck" VALUE 0x26E7B0 kw_ui8_S6_S3 1 UMR___1_100_0_S6_S3 0 1 /end CHARACTERISTIC
/begin CHARACTERISTIC KL_TRAHKABSPORT31 "Zeit fuer Rampe auf Schaltdruck" CURVE 0x2483F8 kl_ui8_S6_S3 2540 UMR_MSEC__10_1_0_S6_S3 0 2540
 /begin AXIS_DESCR STD_AXIS zff_atsys._.iSignale._.obj.sig_m_t8 UMR_NM__8_1_M50_S6_S3 4 -400 1640 DEPOSIT ABSOLUTE MONOTONY MON_INCREASE /end AXIS_DESCR
/end CHARACTERISTIC
/begin CHARACTERISTIC KL_PGOKABSPORT31 "Druckgradient in Abhaengigkeit von m_t" CURVE 0x248404 kl_si16_S6_S3 200 UMR_BAR_SEC_1_10_0_S6_S3 -100 100
 /begin AXIS_DESCR STD_AXIS zff_atsys._.iSignale._.obj.sig_m_t UMR_NM__1_1_0_S6_S3 6 -400 1640 DEPOSIT ABSOLUTE MONOTONY MON_INCREASE /end AXIS_DESCR
/end CHARACTERISTIC
/begin CHARACTERISTIC KF_TOHKABMTNTSPORT31 "Zeitoffset auf Ende SF fuer Haltephase" MAP 0x248420 kf_ui8_S6_S3 2000 UMR_MSEC__10_1_M128_S6_S3 -1000 1000
 /begin AXIS_DESCR STD_AXIS zff_atsys._.iSignale._.obj.sig_n_t8 UMR_U_MIN_32_1_0_S6_S3 4 0 8160 DEPOSIT ABSOLUTE MONOTONY MON_INCREASE /end AXIS_DESCR
 /begin AXIS_DESCR STD_AXIS zff_atsys._.iSignale._.obj.sig_m_t8 UMR_NM__8_1_M50_S6_S3 6 -400 1640 DEPOSIT ABSOLUTE MONOTONY MON_INCREASE /end AXIS_DESCR
/end CHARACTERISTIC
/begin CHARACTERISTIC KL_TSYNMTKABSPORT31 "Zeit vor sync. Ende Schaltdruck KAB" CURVE 0x24844C kl_ui8_S6_S3 1280 UMR_MSEC__10_1_M128_S6_S3 -1280 0
 /begin AXIS_DESCR STD_AXIS zff_atsys._.iSignale._.obj.sig_m_t8 UMR_NM__8_1_M50_S6_S3 4 -400 1640 DEPOSIT ABSOLUTE MONOTONY MON_INCREASE /end AXIS_DESCR
/end CHARACTERISTIC
/begin CHARACTERISTIC KF_PKABSPORT31 "Schaltdruck abschaltende Kupplung" MAP 0x248458 kf_si16_S6_S3 12.75 UMR_BAR__1_1000_0_S6_S3 0 12.75
 /begin AXIS_DESCR STD_AXIS iSasZentr.iSchaltend.n_tkf UMR_U_MIN_32_1_0_S6_S3 8 0 8160 DEPOSIT ABSOLUTE MONOTONY MON_INCREASE /end AXIS_DESCR
 /begin AXIS_DESCR STD_AXIS zff_atsys._.iSignale._.obj.sig_m_t UMR_NM__1_1_0_S6_S3 10 -400 1640 DEPOSIT ABSOLUTE MONOTONY MON_INCREASE /end AXIS_DESCR
/end CHARACTERISTIC
/begin CHARACTERISTIC KF_TSYNMTNTKABVSPORT31 "Zeit vor sync. Ende Haltephase vorb. KAB" MAP 0x248524 kf_si16_S6_S3 5000 UMR_MSEC__10_1_0_S6_S3 -5000 0
 /begin AXIS_DESCR STD_AXIS zff_atsys._.iSignale._.obj.sig_m_t UMR_NM__1_1_0_S6_S3 4 -400 1640 DEPOSIT ABSOLUTE MONOTONY MON_INCREASE /end AXIS_DESCR
 /begin AXIS_DESCR STD_AXIS zff_atsys._.iSignale._.obj.sig_n_t UMR_U_MIN_1_1_0_S6_S3 6 0 8160 DEPOSIT ABSOLUTE MONOTONY MON_INCREASE /end AXIS_DESCR
/end CHARACTERISTIC
/begin CHARACTERISTIC KL_TRAMTHINSYNKABSPORT31 "Zeit fuer Abschalten KAB nach Haltephase in Synchron" CURVE 0x248570 kl_ui8_S6_S3 2550 UMR_MSEC__10_1_0_S6_S3 0 2550
 /begin AXIS_DESCR STD_AXIS zff_atsys._.iSignale._.obj.sig_m_t8 UMR_NM__8_1_M50_S6_S3 4 -400 1640 DEPOSIT ABSOLUTE MONOTONY MON_INCREASE /end AXIS_DESCR
/end CHARACTERISTIC
/begin CHARACTERISTIC KF_POHINSYNKABSPORT31 "Kennfeld Haltedruckoffset(n_tkf, m_t) bei Haltephase in Synchron" MAP 0x24857C kf_si16_S6_S3 12.75 UMR_BAR__1_1000_0_S6_S3 -6.4 6.35
 /begin AXIS_DESCR STD_AXIS iSasZentr.iSchaltend.n_tkf UMR_U_MIN_32_1_0_S6_S3 6 0 8160 DEPOSIT ABSOLUTE MONOTONY MON_INCREASE /end AXIS_DESCR
 /begin AXIS_DESCR STD_AXIS zff_atsys._.iSignale._.obj.sig_m_t UMR_NM__1_1_0_S6_S3 6 -400 1640 DEPOSIT ABSOLUTE MONOTONY MON_INCREASE /end AXIS_DESCR
/end CHARACTERISTIC
/begin CHARACTERISTIC T_HINSYNSPORT31 "Zeit fuer Ende Haltephase in Synchron KZU/KAB" VALUE 0x26E7B1 kw_ui8_S6_S3 2540 UMR_MSEC__10_1_0_S6_S3 0 2540 /end CHARACTERISTIC
/begin CHARACTERISTIC KL_POHKABSPORT42 "Druckoffset waehrend Haltedruckphase" CURVE 0x2485E4 kl_si16_S6_S3 12.75 UMR_BAR__1_1000_0_S6_S3 -6.4 6.35
 /begin AXIS_DESCR STD_AXIS zff_atsys._.iSignale._.obj.sig_m_t8 UMR_NM__8_1_M50_S6_S3 4 -400 1640 DEPOSIT ABSOLUTE MONOTONY MON_INCREASE /end AXIS_DESCR
/end CHARACTERISTIC
/begin CHARACTERISTIC F_PRAHKABSPORT42 "Druckfaktor waehrend Rampe auf Schaltdruck" VALUE 0x26E7B2 kw_ui8_S6_S3 1 UMR___1_100_0_S6_S3 0 1 /end CHARACTERISTIC
/begin CHARACTERISTIC F_TRAHKABSPORT42 "Zeitfaktor waehrend Rampe auf Schaltdruck" VALUE 0x26E7B3 kw_ui8_S6_S3 1 UMR___1_100_0_S6_S3 0 1 /end CHARACTERISTIC
/begin CHARACTERISTIC KL_TRAHKABSPORT42 "Zeit fuer Rampe auf Schaltdruck" CURVE 0x2485F8 kl_ui8_S6_S3 2540 UMR_MSEC__10_1_0_S6_S3 0 2540
 /begin AXIS_DESCR STD_AXIS zff_atsys._.iSignale._.obj.sig_m_t8 UMR_NM__8_1_M50_S6_S3 4 -400 1640 DEPOSIT ABSOLUTE MONOTONY MON_INCREASE /end AXIS_DESCR
/end CHARACTERISTIC
/begin CHARACTERISTIC KL_PGOKABSPORT42 "Druckgradient in Abhaengigkeit von m_t" CURVE 0x248604 kl_si16_S6_S3 200 UMR_BAR_SEC_1_10_0_S6_S3 -100 100
 /begin AXIS_DESCR STD_AXIS zff_atsys._.iSignale._.obj.sig_m_t UMR_NM__1_1_0_S6_S3 6 -400 1640 DEPOSIT ABSOLUTE MONOTONY MON_INCREASE /end AXIS_DESCR
/end CHARACTERISTIC
/begin CHARACTERISTIC KF_TOHKABMTNTSPORT42 "Zeitoffset auf Ende SF fuer Haltephase" MAP 0x248620 kf_ui8_S6_S3 2000 UMR_MSEC__10_1_M128_S6_S3 -1000 1000
 /begin AXIS_DESCR STD_AXIS zff_atsys._.iSignale._.obj.sig_n_t8 UMR_U_MIN_32_1_0_S6_S3 4 0 8160 DEPOSIT ABSOLUTE MONOTONY MON_INCREASE /end AXIS_DESCR
 /begin AXIS_DESCR STD_AXIS zff_atsys._.iSignale._.obj.sig_m_t8 UMR_NM__8_1_M50_S6_S3 6 -400 1640 DEPOSIT ABSOLUTE MONOTONY MON_INCREASE /end AXIS_DESCR
/end CHARACTERISTIC
/begin CHARACTERISTIC KL_TSYNMTKABSPORT42 "Zeit vor sync. Ende Schaltdruck KAB" CURVE 0x24864C kl_ui8_S6_S3 1280 UMR_MSEC__10_1_M128_S6_S3 -1280 0
 /begin AXIS_DESCR STD_AXIS zff_atsys._.iSignale._.obj.sig_m_t8 UMR_NM__8_1_M50_S6_S3 4 -400 1640 DEPOSIT ABSOLUTE MONOTONY MON_INCREASE /end AXIS_DESCR
/end CHARACTERISTIC
/begin CHARACTERISTIC KF_PKABSPORT42 "Schaltdruck abschaltende Kupplung" MAP 0x248658 kf_si16_S6_S3 12.75 UMR_BAR__1_1000_0_S6_S3 0 12.75
 /begin AXIS_DESCR STD_AXIS iSasZentr.iSchaltend.n_tkf UMR_U_MIN_32_1_0_S6_S3 8 0 8160 DEPOSIT ABSOLUTE MONOTONY MON_INCREASE /end AXIS_DESCR
 /begin AXIS_DESCR STD_AXIS zff_atsys._.iSignale._.obj.sig_m_t UMR_NM__1_1_0_S6_S3 10 -400 1640 DEPOSIT ABSOLUTE MONOTONY MON_INCREASE /end AXIS_DESCR
/end CHARACTERISTIC
/begin CHARACTERISTIC KF_TSYNMTNTKABVSPORT42 "Zeit vor sync. Ende Haltephase vorb. KAB" MAP 0x248724 kf_si16_S6_S3 5000 UMR_MSEC__10_1_0_S6_S3 -5000 0
 /begin AXIS_DESCR STD_AXIS zff_atsys._.iSignale._.obj.sig_m_t UMR_NM__1_1_0_S6_S3 4 -400 1640 DEPOSIT ABSOLUTE MONOTONY MON_INCREASE /end AXIS_DESCR
 /begin AXIS_DESCR STD_AXIS zff_atsys._.iSignale._.obj.sig_n_t UMR_U_MIN_1_1_0_S6_S3 6 0 8160 DEPOSIT ABSOLUTE MONOTONY MON_INCREASE /end AXIS_DESCR
/end CHARACTERISTIC
/begin CHARACTERISTIC KL_TRAMTHINSYNKABSPORT42 "Zeit fuer Abschalten KAB nach Haltephase in Synchron" CURVE 0x248770 kl_ui8_S6_S3 2550 UMR_MSEC__10_1_0_S6_S3 0 2550
 /begin AXIS_DESCR STD_AXIS zff_atsys._.iSignale._.obj.sig_m_t8 UMR_NM__8_1_M50_S6_S3 4 -400 1640 DEPOSIT ABSOLUTE MONOTONY MON_INCREASE /end AXIS_DESCR
/end CHARACTERISTIC
/begin CHARACTERISTIC KF_POHINSYNKABSPORT42 "Kennfeld Haltedruckoffset(n_tkf, m_t) bei Haltephase in Synchron" MAP 0x24877C kf_si16_S6_S3 12.75 UMR_BAR__1_1000_0_S6_S3 -6.4 6.35
 /begin AXIS_DESCR STD_AXIS iSasZentr.iSchaltend.n_tkf UMR_U_MIN_32_1_0_S6_S3 6 0 8160 DEPOSIT ABSOLUTE MONOTONY MON_INCREASE /end AXIS_DESCR
 /begin AXIS_DESCR STD_AXIS zff_atsys._.iSignale._.obj.sig_m_t UMR_NM__1_1_0_S6_S3 6 -400 1640 DEPOSIT ABSOLUTE MONOTONY MON_INCREASE /end AXIS_DESCR
/end CHARACTERISTIC
/begin CHARACTERISTIC T_HINSYNSPORT42 "Zeit fuer Ende Haltephase in Synchron KZU/KAB" VALUE 0x26E7B4 kw_ui8_S6_S3 2540 UMR_MSEC__10_1_0_S6_S3 0 2540 /end CHARACTERISTIC
/begin CHARACTERISTIC KL_POHKABSPORT51 "Druckoffset waehrend Haltedruckphase" CURVE 0x2487E4 kl_si16_S6_S3 12.75 UMR_BAR__1_1000_0_S6_S3 -6.4 6.35
 /begin AXIS_DESCR STD_AXIS zff_atsys._.iSignale._.obj.sig_m_t8 UMR_NM__8_1_M50_S6_S3 4 -400 1640 DEPOSIT ABSOLUTE MONOTONY MON_INCREASE /end AXIS_DESCR
/end CHARACTERISTIC
/begin CHARACTERISTIC F_PRAHKABSPORT51 "Druckfaktor waehrend Rampe auf Schaltdruck" VALUE 0x26E7B5 kw_ui8_S6_S3 1 UMR___1_100_0_S6_S3 0 1 /end CHARACTERISTIC
/begin CHARACTERISTIC F_TRAHKABSPORT51 "Zeitfaktor waehrend Rampe auf Schaltdruck" VALUE 0x26E7B6 kw_ui8_S6_S3 1 UMR___1_100_0_S6_S3 0 1 /end CHARACTERISTIC
/begin CHARACTERISTIC KL_TRAHKABSPORT51 "Zeit fuer Rampe auf Schaltdruck" CURVE 0x2487F8 kl_ui8_S6_S3 2540 UMR_MSEC__10_1_0_S6_S3 0 2540
 /begin AXIS_DESCR STD_AXIS zff_atsys._.iSignale._.obj.sig_m_t8 UMR_NM__8_1_M50_S6_S3 4 -400 1640 DEPOSIT ABSOLUTE MONOTONY MON_INCREASE /end AXIS_DESCR
/end CHARACTERISTIC
/begin CHARACTERISTIC KL_PGOKABSPORT51 "Druckgradient in Abhaengigkeit von m_t" CURVE 0x248804 kl_si16_S6_S3 200 UMR_BAR_SEC_1_10_0_S6_S3 -100 100
 /begin AXIS_DESCR STD_AXIS zff_atsys._.iSignale._.obj.sig_m_t UMR_NM__1_1_0_S6_S3 6 -400 1640 DEPOSIT ABSOLUTE MONOTONY MON_INCREASE /end AXIS_DESCR
/end CHARACTERISTIC
/begin CHARACTERISTIC KF_TOHKABMTNTSPORT51 "Zeitoffset auf Ende SF fuer Haltephase" MAP 0x248820 kf_ui8_S6_S3 2000 UMR_MSEC__10_1_M128_S6_S3 -1000 1000
 /begin AXIS_DESCR STD_AXIS zff_atsys._.iSignale._.obj.sig_n_t8 UMR_U_MIN_32_1_0_S6_S3 4 0 8160 DEPOSIT ABSOLUTE MONOTONY MON_INCREASE /end AXIS_DESCR
 /begin AXIS_DESCR STD_AXIS zff_atsys._.iSignale._.obj.sig_m_t8 UMR_NM__8_1_M50_S6_S3 6 -400 1640 DEPOSIT ABSOLUTE MONOTONY MON_INCREASE /end AXIS_DESCR
/end CHARACTERISTIC
/begin CHARACTERISTIC KL_TSYNMTKABSPORT51 "Zeit vor sync. Ende Schaltdruck KAB" CURVE 0x24884C kl_ui8_S6_S3 1280 UMR_MSEC__10_1_M128_S6_S3 -1280 0
 /begin AXIS_DESCR STD_AXIS zff_atsys._.iSignale._.obj.sig_m_t8 UMR_NM__8_1_M50_S6_S3 4 -400 1640 DEPOSIT ABSOLUTE MONOTONY MON_INCREASE /end AXIS_DESCR
/end CHARACTERISTIC
/begin CHARACTERISTIC KF_PKABSPORT51 "Schaltdruck abschaltende Kupplung" MAP 0x248858 kf_si16_S6_S3 12.75 UMR_BAR__1_1000_0_S6_S3 0 12.75
 /begin AXIS_DESCR STD_AXIS iSasZentr.iSchaltend.n_tkf UMR_U_MIN_32_1_0_S6_S3 8 0 8160 DEPOSIT ABSOLUTE MONOTONY MON_INCREASE /end AXIS_DESCR
 /begin AXIS_DESCR STD_AXIS zff_atsys._.iSignale._.obj.sig_m_t UMR_NM__1_1_0_S6_S3 10 -400 1640 DEPOSIT ABSOLUTE MONOTONY MON_INCREASE /end AXIS_DESCR
/end CHARACTERISTIC
/begin CHARACTERISTIC KF_TSYNMTNTKABVSPORT51 "Zeit vor sync. Ende Haltephase vorb. KAB" MAP 0x248924 kf_si16_S6_S3 5000 UMR_MSEC__10_1_0_S6_S3 -5000 0
 /begin AXIS_DESCR STD_AXIS zff_atsys._.iSignale._.obj.sig_m_t UMR_NM__1_1_0_S6_S3 4 -400 1640 DEPOSIT ABSOLUTE MONOTONY MON_INCREASE /end AXIS_DESCR
 /begin AXIS_DESCR STD_AXIS zff_atsys._.iSignale._.obj.sig_n_t UMR_U_MIN_1_1_0_S6_S3 6 0 8160 DEPOSIT ABSOLUTE MONOTONY MON_INCREASE /end AXIS_DESCR
/end CHARACTERISTIC
/begin CHARACTERISTIC KL_TRAMTHINSYNKABSPORT51 "Zeit fuer Abschalten KAB nach Haltephase in Synchron" CURVE 0x248970 kl_ui8_S6_S3 2550 UMR_MSEC__10_1_0_S6_S3 0 2550
 /begin AXIS_DESCR STD_AXIS zff_atsys._.iSignale._.obj.sig_m_t8 UMR_NM__8_1_M50_S6_S3 4 -400 1640 DEPOSIT ABSOLUTE MONOTONY MON_INCREASE /end AXIS_DESCR
/end CHARACTERISTIC
/begin CHARACTERISTIC KF_POHINSYNKABSPORT51 "Kennfeld Haltedruckoffset(n_tkf, m_t) bei Haltephase in Synchron" MAP 0x24897C kf_si16_S6_S3 12.75 UMR_BAR__1_1000_0_S6_S3 -6.4 6.35
 /begin AXIS_DESCR STD_AXIS iSasZentr.iSchaltend.n_tkf UMR_U_MIN_32_1_0_S6_S3 6 0 8160 DEPOSIT ABSOLUTE MONOTONY MON_INCREASE /end AXIS_DESCR
 /begin AXIS_DESCR STD_AXIS zff_atsys._.iSignale._.obj.sig_m_t UMR_NM__1_1_0_S6_S3 6 -400 1640 DEPOSIT ABSOLUTE MONOTONY MON_INCREASE /end AXIS_DESCR
/end CHARACTERISTIC
/begin CHARACTERISTIC T_HINSYNSPORT51 "Zeit fuer Ende Haltephase in Synchron KZU/KAB" VALUE 0x26E7B7 kw_ui8_S6_S3 2540 UMR_MSEC__10_1_0_S6_S3 0 2540 /end CHARACTERISTIC
/begin CHARACTERISTIC KL_POHKABSPORT53 "Druckoffset waehrend Haltedruckphase" CURVE 0x2489E4 kl_si16_S6_S3 12.75 UMR_BAR__1_1000_0_S6_S3 -6.4 6.35
 /begin AXIS_DESCR STD_AXIS zff_atsys._.iSignale._.obj.sig_m_t8 UMR_NM__8_1_M50_S6_S3 4 -400 1640 DEPOSIT ABSOLUTE MONOTONY MON_INCREASE /end AXIS_DESCR
/end CHARACTERISTIC
/begin CHARACTERISTIC F_PRAHKABSPORT53 "Druckfaktor waehrend Rampe auf Schaltdruck" VALUE 0x26E7B8 kw_ui8_S6_S3 1 UMR___1_100_0_S6_S3 0 1 /end CHARACTERISTIC
/begin CHARACTERISTIC F_TRAHKABSPORT53 "Zeitfaktor waehrend Rampe auf Schaltdruck" VALUE 0x26E7B9 kw_ui8_S6_S3 1 UMR___1_100_0_S6_S3 0 1 /end CHARACTERISTIC
/begin CHARACTERISTIC KL_TRAHKABSPORT53 "Zeit fuer Rampe auf Schaltdruck" CURVE 0x2489F8 kl_ui8_S6_S3 2540 UMR_MSEC__10_1_0_S6_S3 0 2540
 /begin AXIS_DESCR STD_AXIS zff_atsys._.iSignale._.obj.sig_m_t8 UMR_NM__8_1_M50_S6_S3 4 -400 1640 DEPOSIT ABSOLUTE MONOTONY MON_INCREASE /end AXIS_DESCR
/end CHARACTERISTIC
/begin CHARACTERISTIC KL_PGOKABSPORT53 "Druckgradient in Abhaengigkeit von m_t" CURVE 0x248A04 kl_si16_S6_S3 200 UMR_BAR_SEC_1_10_0_S6_S3 -100 100
 /begin AXIS_DESCR STD_AXIS zff_atsys._.iSignale._.obj.sig_m_t UMR_NM__1_1_0_S6_S3 6 -400 1640 DEPOSIT ABSOLUTE MONOTONY MON_INCREASE /end AXIS_DESCR
/end CHARACTERISTIC
/begin CHARACTERISTIC KF_TOHKABMTNTSPORT53 "Zeitoffset auf Ende SF fuer Haltephase" MAP 0x248A20 kf_ui8_S6_S3 2000 UMR_MSEC__10_1_M128_S6_S3 -1000 1000
 /begin AXIS_DESCR STD_AXIS zff_atsys._.iSignale._.obj.sig_n_t8 UMR_U_MIN_32_1_0_S6_S3 4 0 8160 DEPOSIT ABSOLUTE MONOTONY MON_INCREASE /end AXIS_DESCR
 /begin AXIS_DESCR STD_AXIS zff_atsys._.iSignale._.obj.sig_m_t8 UMR_NM__8_1_M50_S6_S3 6 -400 1640 DEPOSIT ABSOLUTE MONOTONY MON_INCREASE /end AXIS_DESCR
/end CHARACTERISTIC
/begin CHARACTERISTIC KL_TSYNMTKABSPORT53 "Zeit vor sync. Ende Schaltdruck KAB" CURVE 0x248A4C kl_ui8_S6_S3 1280 UMR_MSEC__10_1_M128_S6_S3 -1280 0
 /begin AXIS_DESCR STD_AXIS zff_atsys._.iSignale._.obj.sig_m_t8 UMR_NM__8_1_M50_S6_S3 4 -400 1640 DEPOSIT ABSOLUTE MONOTONY MON_INCREASE /end AXIS_DESCR
/end CHARACTERISTIC
/begin CHARACTERISTIC KF_PKABSPORT53 "Schaltdruck abschaltende Kupplung" MAP 0x248A58 kf_si16_S6_S3 12.75 UMR_BAR__1_1000_0_S6_S3 0 12.75
 /begin AXIS_DESCR STD_AXIS iSasZentr.iSchaltend.n_tkf UMR_U_MIN_32_1_0_S6_S3 8 0 8160 DEPOSIT ABSOLUTE MONOTONY MON_INCREASE /end AXIS_DESCR
 /begin AXIS_DESCR STD_AXIS zff_atsys._.iSignale._.obj.sig_m_t UMR_NM__1_1_0_S6_S3 10 -400 1640 DEPOSIT ABSOLUTE MONOTONY MON_INCREASE /end AXIS_DESCR
/end CHARACTERISTIC
/begin CHARACTERISTIC KF_TSYNMTNTKABVSPORT53 "Zeit vor sync. Ende Haltephase vorb. KAB" MAP 0x248B24 kf_si16_S6_S3 5000 UMR_MSEC__10_1_0_S6_S3 -5000 0
 /begin AXIS_DESCR STD_AXIS zff_atsys._.iSignale._.obj.sig_m_t UMR_NM__1_1_0_S6_S3 4 -400 1640 DEPOSIT ABSOLUTE MONOTONY MON_INCREASE /end AXIS_DESCR
 /begin AXIS_DESCR STD_AXIS zff_atsys._.iSignale._.obj.sig_n_t UMR_U_MIN_1_1_0_S6_S3 6 0 8160 DEPOSIT ABSOLUTE MONOTONY MON_INCREASE /end AXIS_DESCR
/end CHARACTERISTIC
/begin CHARACTERISTIC KL_TRAMTHINSYNKABSPORT53 "Zeit fuer Abschalten KAB nach Haltephase in Synchron" CURVE 0x248B70 kl_ui8_S6_S3 2550 UMR_MSEC__10_1_0_S6_S3 0 2550
 /begin AXIS_DESCR STD_AXIS zff_atsys._.iSignale._.obj.sig_m_t8 UMR_NM__8_1_M50_S6_S3 4 -400 1640 DEPOSIT ABSOLUTE MONOTONY MON_INCREASE /end AXIS_DESCR
/end CHARACTERISTIC
/begin CHARACTERISTIC KF_POHINSYNKABSPORT53 "Kennfeld Haltedruckoffset(n_tkf, m_t) bei Haltephase in Synchron" MAP 0x248B7C kf_si16_S6_S3 12.75 UMR_BAR__1_1000_0_S6_S3 -6.4 6.35
 /begin AXIS_DESCR STD_AXIS iSasZentr.iSchaltend.n_tkf UMR_U_MIN_32_1_0_S6_S3 6 0 8160 DEPOSIT ABSOLUTE MONOTONY MON_INCREASE /end AXIS_DESCR
 /begin AXIS_DESCR STD_AXIS zff_atsys._.iSignale._.obj.sig_m_t UMR_NM__1_1_0_S6_S3 6 -400 1640 DEPOSIT ABSOLUTE MONOTONY MON_INCREASE /end AXIS_DESCR
/end CHARACTERISTIC
/begin CHARACTERISTIC T_HINSYNSPORT53 "Zeit fuer Ende Haltephase in Synchron KZU/KAB" VALUE 0x26E7BA kw_ui8_S6_S3 2540 UMR_MSEC__10_1_0_S6_S3 0 2540 /end CHARACTERISTIC
/begin CHARACTERISTIC KL_POHKABSPORT63 "Druckoffset waehrend Haltedruckphase" CURVE 0x248BE4 kl_si16_S6_S3 12.75 UMR_BAR__1_1000_0_S6_S3 -6.4 6.35
 /begin AXIS_DESCR STD_AXIS zff_atsys._.iSignale._.obj.sig_m_t8 UMR_NM__8_1_M50_S6_S3 4 -400 1640 DEPOSIT ABSOLUTE MONOTONY MON_INCREASE /end AXIS_DESCR
/end CHARACTERISTIC
/begin CHARACTERISTIC F_PRAHKABSPORT63 "Druckfaktor waehrend Rampe auf Schaltdruck" VALUE 0x26E7BB kw_ui8_S6_S3 1 UMR___1_100_0_S6_S3 0 1 /end CHARACTERISTIC
/begin CHARACTERISTIC F_TRAHKABSPORT63 "Zeitfaktor waehrend Rampe auf Schaltdruck" VALUE 0x26E7BC kw_ui8_S6_S3 1 UMR___1_100_0_S6_S3 0 1 /end CHARACTERISTIC
/begin CHARACTERISTIC KL_TRAHKABSPORT63 "Zeit fuer Rampe auf Schaltdruck" CURVE 0x248BF8 kl_ui8_S6_S3 2540 UMR_MSEC__10_1_0_S6_S3 0 2540
 /begin AXIS_DESCR STD_AXIS zff_atsys._.iSignale._.obj.sig_m_t8 UMR_NM__8_1_M50_S6_S3 4 -400 1640 DEPOSIT ABSOLUTE MONOTONY MON_INCREASE /end AXIS_DESCR
/end CHARACTERISTIC
/begin CHARACTERISTIC KL_PGOKABSPORT63 "Druckgradient in Abhaengigkeit von m_t" CURVE 0x248C04 kl_si16_S6_S3 200 UMR_BAR_SEC_1_10_0_S6_S3 -100 100
 /begin AXIS_DESCR STD_AXIS zff_atsys._.iSignale._.obj.sig_m_t UMR_NM__1_1_0_S6_S3 6 -400 1640 DEPOSIT ABSOLUTE MONOTONY MON_INCREASE /end AXIS_DESCR
/end CHARACTERISTIC
/begin CHARACTERISTIC KF_TOHKABMTNTSPORT63 "Zeitoffset auf Ende SF fuer Haltephase" MAP 0x248C20 kf_ui8_S6_S3 2000 UMR_MSEC__10_1_M128_S6_S3 -1000 1000
 /begin AXIS_DESCR STD_AXIS zff_atsys._.iSignale._.obj.sig_n_t8 UMR_U_MIN_32_1_0_S6_S3 4 0 8160 DEPOSIT ABSOLUTE MONOTONY MON_INCREASE /end AXIS_DESCR
 /begin AXIS_DESCR STD_AXIS zff_atsys._.iSignale._.obj.sig_m_t8 UMR_NM__8_1_M50_S6_S3 6 -400 1640 DEPOSIT ABSOLUTE MONOTONY MON_INCREASE /end AXIS_DESCR
/end CHARACTERISTIC
/begin CHARACTERISTIC KL_TSYNMTKABSPORT63 "Zeit vor sync. Ende Schaltdruck KAB" CURVE 0x248C4C kl_ui8_S6_S3 1280 UMR_MSEC__10_1_M128_S6_S3 -1280 0
 /begin AXIS_DESCR STD_AXIS zff_atsys._.iSignale._.obj.sig_m_t8 UMR_NM__8_1_M50_S6_S3 4 -400 1640 DEPOSIT ABSOLUTE MONOTONY MON_INCREASE /end AXIS_DESCR
/end CHARACTERISTIC
/begin CHARACTERISTIC KF_PKABSPORT63 "Schaltdruck abschaltende Kupplung" MAP 0x248C58 kf_si16_S6_S3 12.75 UMR_BAR__1_1000_0_S6_S3 0 12.75
 /begin AXIS_DESCR STD_AXIS iSasZentr.iSchaltend.n_tkf UMR_U_MIN_32_1_0_S6_S3 8 0 8160 DEPOSIT ABSOLUTE MONOTONY MON_INCREASE /end AXIS_DESCR
 /begin AXIS_DESCR STD_AXIS zff_atsys._.iSignale._.obj.sig_m_t UMR_NM__1_1_0_S6_S3 10 -400 1640 DEPOSIT ABSOLUTE MONOTONY MON_INCREASE /end AXIS_DESCR
/end CHARACTERISTIC
/begin CHARACTERISTIC KF_TSYNMTNTKABVSPORT63 "Zeit vor sync. Ende Haltephase vorb. KAB" MAP 0x248D24 kf_si16_S6_S3 5000 UMR_MSEC__10_1_0_S6_S3 -5000 0
 /begin AXIS_DESCR STD_AXIS zff_atsys._.iSignale._.obj.sig_m_t UMR_NM__1_1_0_S6_S3 4 -400 1640 DEPOSIT ABSOLUTE MONOTONY MON_INCREASE /end AXIS_DESCR
 /begin AXIS_DESCR STD_AXIS zff_atsys._.iSignale._.obj.sig_n_t UMR_U_MIN_1_1_0_S6_S3 6 0 8160 DEPOSIT ABSOLUTE MONOTONY MON_INCREASE /end AXIS_DESCR
/end CHARACTERISTIC
/begin CHARACTERISTIC KL_TRAMTHINSYNKABSPORT63 "Zeit fuer Abschalten KAB nach Haltephase in Synchron" CURVE 0x248D70 kl_ui8_S6_S3 2550 UMR_MSEC__10_1_0_S6_S3 0 2550
 /begin AXIS_DESCR STD_AXIS zff_atsys._.iSignale._.obj.sig_m_t8 UMR_NM__8_1_M50_S6_S3 4 -400 1640 DEPOSIT ABSOLUTE MONOTONY MON_INCREASE /end AXIS_DESCR
/end CHARACTERISTIC
/begin CHARACTERISTIC KF_POHINSYNKABSPORT63 "Kennfeld Haltedruckoffset(n_tkf, m_t) bei Haltephase in Synchron" MAP 0x248D7C kf_si16_S6_S3 12.75 UMR_BAR__1_1000_0_S6_S3 -6.4 6.35
 /begin AXIS_DESCR STD_AXIS iSasZentr.iSchaltend.n_tkf UMR_U_MIN_32_1_0_S6_S3 6 0 8160 DEPOSIT ABSOLUTE MONOTONY MON_INCREASE /end AXIS_DESCR
 /begin AXIS_DESCR STD_AXIS zff_atsys._.iSignale._.obj.sig_m_t UMR_NM__1_1_0_S6_S3 6 -400 1640 DEPOSIT ABSOLUTE MONOTONY MON_INCREASE /end AXIS_DESCR
/end CHARACTERISTIC
/begin CHARACTERISTIC T_HINSYNSPORT63 "Zeit fuer Ende Haltephase in Synchron KZU/KAB" VALUE 0x26E7BD kw_ui8_S6_S3 2540 UMR_MSEC__10_1_0_S6_S3 0 2540 /end CHARACTERISTIC
/begin CHARACTERISTIC KL_POHKABSPORT64 "Druckoffset waehrend Haltedruckphase" CURVE 0x248DE4 kl_si16_S6_S3 12.75 UMR_BAR__1_1000_0_S6_S3 -6.4 6.35
 /begin AXIS_DESCR STD_AXIS zff_atsys._.iSignale._.obj.sig_m_t8 UMR_NM__8_1_M50_S6_S3 4 -400 1640 DEPOSIT ABSOLUTE MONOTONY MON_INCREASE /end AXIS_DESCR
/end CHARACTERISTIC
/begin CHARACTERISTIC F_PRAHKABSPORT64 "Druckfaktor waehrend Rampe auf Schaltdruck" VALUE 0x26E7BE kw_ui8_S6_S3 1 UMR___1_100_0_S6_S3 0 1 /end CHARACTERISTIC
/begin CHARACTERISTIC F_TRAHKABSPORT64 "Zeitfaktor waehrend Rampe auf Schaltdruck" VALUE 0x26E7BF kw_ui8_S6_S3 1 UMR___1_100_0_S6_S3 0 1 /end CHARACTERISTIC
/begin CHARACTERISTIC KL_TRAHKABSPORT64 "Zeit fuer Rampe auf Schaltdruck" CURVE 0x248DF8 kl_ui8_S6_S3 2540 UMR_MSEC__10_1_0_S6_S3 0 2540
 /begin AXIS_DESCR STD_AXIS zff_atsys._.iSignale._.obj.sig_m_t8 UMR_NM__8_1_M50_S6_S3 4 -400 1640 DEPOSIT ABSOLUTE MONOTONY MON_INCREASE /end AXIS_DESCR
/end CHARACTERISTIC
/begin CHARACTERISTIC KL_PGOKABSPORT64 "Druckgradient in Abhaengigkeit von m_t" CURVE 0x248E04 kl_si16_S6_S3 200 UMR_BAR_SEC_1_10_0_S6_S3 -100 100
 /begin AXIS_DESCR STD_AXIS zff_atsys._.iSignale._.obj.sig_m_t UMR_NM__1_1_0_S6_S3 6 -400 1640 DEPOSIT ABSOLUTE MONOTONY MON_INCREASE /end AXIS_DESCR
/end CHARACTERISTIC
/begin CHARACTERISTIC KF_TOHKABMTNTSPORT64 "Zeitoffset auf Ende SF fuer Haltephase" MAP 0x248E20 kf_ui8_S6_S3 2000 UMR_MSEC__10_1_M128_S6_S3 -1000 1000
 /begin AXIS_DESCR STD_AXIS zff_atsys._.iSignale._.obj.sig_n_t8 UMR_U_MIN_32_1_0_S6_S3 4 0 8160 DEPOSIT ABSOLUTE MONOTONY MON_INCREASE /end AXIS_DESCR
 /begin AXIS_DESCR STD_AXIS zff_atsys._.iSignale._.obj.sig_m_t8 UMR_NM__8_1_M50_S6_S3 6 -400 1640 DEPOSIT ABSOLUTE MONOTONY MON_INCREASE /end AXIS_DESCR
/end CHARACTERISTIC
/begin CHARACTERISTIC KL_TSYNMTKABSPORT64 "Zeit vor sync. Ende Schaltdruck KAB" CURVE 0x248E4C kl_ui8_S6_S3 1280 UMR_MSEC__10_1_M128_S6_S3 -1280 0
 /begin AXIS_DESCR STD_AXIS zff_atsys._.iSignale._.obj.sig_m_t8 UMR_NM__8_1_M50_S6_S3 4 -400 1640 DEPOSIT ABSOLUTE MONOTONY MON_INCREASE /end AXIS_DESCR
/end CHARACTERISTIC
/begin CHARACTERISTIC KF_PKABSPORT64 "Schaltdruck abschaltende Kupplung" MAP 0x248E58 kf_si16_S6_S3 12.75 UMR_BAR__1_1000_0_S6_S3 0 12.75
 /begin AXIS_DESCR STD_AXIS iSasZentr.iSchaltend.n_tkf UMR_U_MIN_32_1_0_S6_S3 8 0 8160 DEPOSIT ABSOLUTE MONOTONY MON_INCREASE /end AXIS_DESCR
 /begin AXIS_DESCR STD_AXIS zff_atsys._.iSignale._.obj.sig_m_t UMR_NM__1_1_0_S6_S3 10 -400 1640 DEPOSIT ABSOLUTE MONOTONY MON_INCREASE /end AXIS_DESCR
/end CHARACTERISTIC
/begin CHARACTERISTIC KF_TSYNMTNTKABVSPORT64 "Zeit vor sync. Ende Haltephase vorb. KAB" MAP 0x248F24 kf_si16_S6_S3 5000 UMR_MSEC__10_1_0_S6_S3 -5000 0
 /begin AXIS_DESCR STD_AXIS zff_atsys._.iSignale._.obj.sig_m_t UMR_NM__1_1_0_S6_S3 4 -400 1640 DEPOSIT ABSOLUTE MONOTONY MON_INCREASE /end AXIS_DESCR
 /begin AXIS_DESCR STD_AXIS zff_atsys._.iSignale._.obj.sig_n_t UMR_U_MIN_1_1_0_S6_S3 6 0 8160 DEPOSIT ABSOLUTE MONOTONY MON_INCREASE /end AXIS_DESCR
/end CHARACTERISTIC
/begin CHARACTERISTIC KL_TRAMTHINSYNKABSPORT64 "Zeit fuer Abschalten KAB nach Haltephase in Synchron" CURVE 0x248F70 kl_ui8_S6_S3 2550 UMR_MSEC__10_1_0_S6_S3 0 2550
 /begin AXIS_DESCR STD_AXIS zff_atsys._.iSignale._.obj.sig_m_t8 UMR_NM__8_1_M50_S6_S3 4 -400 1640 DEPOSIT ABSOLUTE MONOTONY MON_INCREASE /end AXIS_DESCR
/end CHARACTERISTIC
/begin CHARACTERISTIC KF_POHINSYNKABSPORT64 "Kennfeld Haltedruckoffset(n_tkf, m_t) bei Haltephase in Synchron" MAP 0x248F7C kf_si16_S6_S3 12.75 UMR_BAR__1_1000_0_S6_S3 -6.4 6.35
 /begin AXIS_DESCR STD_AXIS iSasZentr.iSchaltend.n_tkf UMR_U_MIN_32_1_0_S6_S3 6 0 8160 DEPOSIT ABSOLUTE MONOTONY MON_INCREASE /end AXIS_DESCR
 /begin AXIS_DESCR STD_AXIS zff_atsys._.iSignale._.obj.sig_m_t UMR_NM__1_1_0_S6_S3 6 -400 1640 DEPOSIT ABSOLUTE MONOTONY MON_INCREASE /end AXIS_DESCR
/end CHARACTERISTIC
/begin CHARACTERISTIC T_HINSYNSPORT64 "Zeit fuer Ende Haltephase in Synchron KZU/KAB" VALUE 0x26E7C0 kw_ui8_S6_S3 2540 UMR_MSEC__10_1_0_S6_S3 0 2540 /end CHARACTERISTIC
/begin CHARACTERISTIC KL_POHKABSPORT71 "Druckoffset waehrend Haltedruckphase" CURVE 0x248FE4 kl_si16_S6_S3 12.75 UMR_BAR__1_1000_0_S6_S3 -6.4 6.35
 /begin AXIS_DESCR STD_AXIS zff_atsys._.iSignale._.obj.sig_m_t8 UMR_NM__8_1_M50_S6_S3 4 -400 1640 DEPOSIT ABSOLUTE MONOTONY MON_INCREASE /end AXIS_DESCR
/end CHARACTERISTIC
/begin CHARACTERISTIC F_PRAHKABSPORT71 "Druckfaktor waehrend Rampe auf Schaltdruck" VALUE 0x26E7C1 kw_ui8_S6_S3 1 UMR___1_100_0_S6_S3 0 1 /end CHARACTERISTIC
/begin CHARACTERISTIC F_TRAHKABSPORT71 "Zeitfaktor waehrend Rampe auf Schaltdruck" VALUE 0x26E7C2 kw_ui8_S6_S3 1 UMR___1_100_0_S6_S3 0 1 /end CHARACTERISTIC
/begin CHARACTERISTIC KL_TRAHKABSPORT71 "Zeit fuer Rampe auf Schaltdruck" CURVE 0x248FF8 kl_ui8_S6_S3 2540 UMR_MSEC__10_1_0_S6_S3 0 2540
 /begin AXIS_DESCR STD_AXIS zff_atsys._.iSignale._.obj.sig_m_t8 UMR_NM__8_1_M50_S6_S3 4 -400 1640 DEPOSIT ABSOLUTE MONOTONY MON_INCREASE /end AXIS_DESCR
/end CHARACTERISTIC
/begin CHARACTERISTIC KL_PGOKABSPORT71 "Druckgradient in Abhaengigkeit von m_t" CURVE 0x249004 kl_si16_S6_S3 200 UMR_BAR_SEC_1_10_0_S6_S3 -100 100
 /begin AXIS_DESCR STD_AXIS zff_atsys._.iSignale._.obj.sig_m_t UMR_NM__1_1_0_S6_S3 6 -400 1640 DEPOSIT ABSOLUTE MONOTONY MON_INCREASE /end AXIS_DESCR
/end CHARACTERISTIC
/begin CHARACTERISTIC KF_TOHKABMTNTSPORT71 "Zeitoffset auf Ende SF fuer Haltephase" MAP 0x249020 kf_ui8_S6_S3 2000 UMR_MSEC__10_1_M128_S6_S3 -1000 1000
 /begin AXIS_DESCR STD_AXIS zff_atsys._.iSignale._.obj.sig_n_t8 UMR_U_MIN_32_1_0_S6_S3 4 0 8160 DEPOSIT ABSOLUTE MONOTONY MON_INCREASE /end AXIS_DESCR
 /begin AXIS_DESCR STD_AXIS zff_atsys._.iSignale._.obj.sig_m_t8 UMR_NM__8_1_M50_S6_S3 6 -400 1640 DEPOSIT ABSOLUTE MONOTONY MON_INCREASE /end AXIS_DESCR
/end CHARACTERISTIC
/begin CHARACTERISTIC KL_TSYNMTKABSPORT71 "Zeit vor sync. Ende Schaltdruck KAB" CURVE 0x24904C kl_ui8_S6_S3 1280 UMR_MSEC__10_1_M128_S6_S3 -1280 0
 /begin AXIS_DESCR STD_AXIS zff_atsys._.iSignale._.obj.sig_m_t8 UMR_NM__8_1_M50_S6_S3 4 -400 1640 DEPOSIT ABSOLUTE MONOTONY MON_INCREASE /end AXIS_DESCR
/end CHARACTERISTIC
/begin CHARACTERISTIC KF_PKABSPORT71 "Schaltdruck abschaltende Kupplung" MAP 0x249058 kf_si16_S6_S3 12.75 UMR_BAR__1_1000_0_S6_S3 0 12.75
 /begin AXIS_DESCR STD_AXIS iSasZentr.iSchaltend.n_tkf UMR_U_MIN_32_1_0_S6_S3 8 0 8160 DEPOSIT ABSOLUTE MONOTONY MON_INCREASE /end AXIS_DESCR
 /begin AXIS_DESCR STD_AXIS zff_atsys._.iSignale._.obj.sig_m_t UMR_NM__1_1_0_S6_S3 10 -400 1640 DEPOSIT ABSOLUTE MONOTONY MON_INCREASE /end AXIS_DESCR
/end CHARACTERISTIC
/begin CHARACTERISTIC KF_TSYNMTNTKABVSPORT71 "Zeit vor sync. Ende Haltephase vorb. KAB" MAP 0x249124 kf_si16_S6_S3 5000 UMR_MSEC__10_1_0_S6_S3 -5000 0
 /begin AXIS_DESCR STD_AXIS zff_atsys._.iSignale._.obj.sig_m_t UMR_NM__1_1_0_S6_S3 4 -400 1640 DEPOSIT ABSOLUTE MONOTONY MON_INCREASE /end AXIS_DESCR
 /begin AXIS_DESCR STD_AXIS zff_atsys._.iSignale._.obj.sig_n_t UMR_U_MIN_1_1_0_S6_S3 6 0 8160 DEPOSIT ABSOLUTE MONOTONY MON_INCREASE /end AXIS_DESCR
/end CHARACTERISTIC
/begin CHARACTERISTIC KL_TRAMTHINSYNKABSPORT71 "Zeit fuer Abschalten KAB nach Haltephase in Synchron" CURVE 0x249170 kl_ui8_S6_S3 2550 UMR_MSEC__10_1_0_S6_S3 0 2550
 /begin AXIS_DESCR STD_AXIS zff_atsys._.iSignale._.obj.sig_m_t8 UMR_NM__8_1_M50_S6_S3 4 -400 1640 DEPOSIT ABSOLUTE MONOTONY MON_INCREASE /end AXIS_DESCR
/end CHARACTERISTIC
/begin CHARACTERISTIC KF_POHINSYNKABSPORT71 "Kennfeld Haltedruckoffset(n_tkf, m_t) bei Haltephase in Synchron" MAP 0x24917C kf_si16_S6_S3 12.75 UMR_BAR__1_1000_0_S6_S3 -6.4 6.35
 /begin AXIS_DESCR STD_AXIS iSasZentr.iSchaltend.n_tkf UMR_U_MIN_32_1_0_S6_S3 6 0 8160 DEPOSIT ABSOLUTE MONOTONY MON_INCREASE /end AXIS_DESCR
 /begin AXIS_DESCR STD_AXIS zff_atsys._.iSignale._.obj.sig_m_t UMR_NM__1_1_0_S6_S3 6 -400 1640 DEPOSIT ABSOLUTE MONOTONY MON_INCREASE /end AXIS_DESCR
/end CHARACTERISTIC
/begin CHARACTERISTIC T_HINSYNSPORT71 "Zeit fuer Ende Haltephase in Synchron KZU/KAB" VALUE 0x26E7C3 kw_ui8_S6_S3 2540 UMR_MSEC__10_1_0_S6_S3 0 2540 /end CHARACTERISTIC
/begin CHARACTERISTIC KL_POHKABSPORT75 "Druckoffset waehrend Haltedruckphase" CURVE 0x2491E4 kl_si16_S6_S3 12.75 UMR_BAR__1_1000_0_S6_S3 -6.4 6.35
 /begin AXIS_DESCR STD_AXIS zff_atsys._.iSignale._.obj.sig_m_t8 UMR_NM__8_1_M50_S6_S3 4 -400 1640 DEPOSIT ABSOLUTE MONOTONY MON_INCREASE /end AXIS_DESCR
/end CHARACTERISTIC
/begin CHARACTERISTIC F_PRAHKABSPORT75 "Druckfaktor waehrend Rampe auf Schaltdruck" VALUE 0x26E7C4 kw_ui8_S6_S3 1 UMR___1_100_0_S6_S3 0 1 /end CHARACTERISTIC
/begin CHARACTERISTIC F_TRAHKABSPORT75 "Zeitfaktor waehrend Rampe auf Schaltdruck" VALUE 0x26E7C5 kw_ui8_S6_S3 1 UMR___1_100_0_S6_S3 0 1 /end CHARACTERISTIC
/begin CHARACTERISTIC KL_TRAHKABSPORT75 "Zeit fuer Rampe auf Schaltdruck" CURVE 0x2491F8 kl_ui8_S6_S3 2540 UMR_MSEC__10_1_0_S6_S3 0 2540
 /begin AXIS_DESCR STD_AXIS zff_atsys._.iSignale._.obj.sig_m_t8 UMR_NM__8_1_M50_S6_S3 4 -400 1640 DEPOSIT ABSOLUTE MONOTONY MON_INCREASE /end AXIS_DESCR
/end CHARACTERISTIC
/begin CHARACTERISTIC KL_PGOKABSPORT75 "Druckgradient in Abhaengigkeit von m_t" CURVE 0x249204 kl_si16_S6_S3 200 UMR_BAR_SEC_1_10_0_S6_S3 -100 100
 /begin AXIS_DESCR STD_AXIS zff_atsys._.iSignale._.obj.sig_m_t UMR_NM__1_1_0_S6_S3 6 -400 1640 DEPOSIT ABSOLUTE MONOTONY MON_INCREASE /end AXIS_DESCR
/end CHARACTERISTIC
/begin CHARACTERISTIC KF_TOHKABMTNTSPORT75 "Zeitoffset auf Ende SF fuer Haltephase" MAP 0x249220 kf_ui8_S6_S3 2000 UMR_MSEC__10_1_M128_S6_S3 -1000 1000
 /begin AXIS_DESCR STD_AXIS zff_atsys._.iSignale._.obj.sig_n_t8 UMR_U_MIN_32_1_0_S6_S3 4 0 8160 DEPOSIT ABSOLUTE MONOTONY MON_INCREASE /end AXIS_DESCR
 /begin AXIS_DESCR STD_AXIS zff_atsys._.iSignale._.obj.sig_m_t8 UMR_NM__8_1_M50_S6_S3 6 -400 1640 DEPOSIT ABSOLUTE MONOTONY MON_INCREASE /end AXIS_DESCR
/end CHARACTERISTIC
/begin CHARACTERISTIC KL_TSYNMTKABSPORT75 "Zeit vor sync. Ende Schaltdruck KAB" CURVE 0x24924C kl_ui8_S6_S3 1280 UMR_MSEC__10_1_M128_S6_S3 -1280 0
 /begin AXIS_DESCR STD_AXIS zff_atsys._.iSignale._.obj.sig_m_t8 UMR_NM__8_1_M50_S6_S3 4 -400 1640 DEPOSIT ABSOLUTE MONOTONY MON_INCREASE /end AXIS_DESCR
/end CHARACTERISTIC
/begin CHARACTERISTIC KF_PKABSPORT75 "Schaltdruck abschaltende Kupplung" MAP 0x249258 kf_si16_S6_S3 12.75 UMR_BAR__1_1000_0_S6_S3 0 12.75
 /begin AXIS_DESCR STD_AXIS iSasZentr.iSchaltend.n_tkf UMR_U_MIN_32_1_0_S6_S3 8 0 8160 DEPOSIT ABSOLUTE MONOTONY MON_INCREASE /end AXIS_DESCR
 /begin AXIS_DESCR STD_AXIS zff_atsys._.iSignale._.obj.sig_m_t UMR_NM__1_1_0_S6_S3 10 -400 1640 DEPOSIT ABSOLUTE MONOTONY MON_INCREASE /end AXIS_DESCR
/end CHARACTERISTIC
/begin CHARACTERISTIC KF_TSYNMTNTKABVSPORT75 "Zeit vor sync. Ende Haltephase vorb. KAB" MAP 0x249324 kf_si16_S6_S3 5000 UMR_MSEC__10_1_0_S6_S3 -5000 0
 /begin AXIS_DESCR STD_AXIS zff_atsys._.iSignale._.obj.sig_m_t UMR_NM__1_1_0_S6_S3 4 -400 1640 DEPOSIT ABSOLUTE MONOTONY MON_INCREASE /end AXIS_DESCR
 /begin AXIS_DESCR STD_AXIS zff_atsys._.iSignale._.obj.sig_n_t UMR_U_MIN_1_1_0_S6_S3 6 0 8160 DEPOSIT ABSOLUTE MONOTONY MON_INCREASE /end AXIS_DESCR
/end CHARACTERISTIC
/begin CHARACTERISTIC KL_TRAMTHINSYNKABSPORT75 "Zeit fuer Abschalten KAB nach Haltephase in Synchron" CURVE 0x249370 kl_ui8_S6_S3 2550 UMR_MSEC__10_1_0_S6_S3 0 2550
 /begin AXIS_DESCR STD_AXIS zff_atsys._.iSignale._.obj.sig_m_t8 UMR_NM__8_1_M50_S6_S3 4 -400 1640 DEPOSIT ABSOLUTE MONOTONY MON_INCREASE /end AXIS_DESCR
/end CHARACTERISTIC
/begin CHARACTERISTIC KF_POHINSYNKABSPORT75 "Kennfeld Haltedruckoffset(n_tkf, m_t) bei Haltephase in Synchron" MAP 0x24937C kf_si16_S6_S3 12.75 UMR_BAR__1_1000_0_S6_S3 -6.4 6.35
 /begin AXIS_DESCR STD_AXIS iSasZentr.iSchaltend.n_tkf UMR_U_MIN_32_1_0_S6_S3 6 0 8160 DEPOSIT ABSOLUTE MONOTONY MON_INCREASE /end AXIS_DESCR
 /begin AXIS_DESCR STD_AXIS zff_atsys._.iSignale._.obj.sig_m_t UMR_NM__1_1_0_S6_S3 6 -400 1640 DEPOSIT ABSOLUTE MONOTONY MON_INCREASE /end AXIS_DESCR
/end CHARACTERISTIC
/begin CHARACTERISTIC T_HINSYNSPORT75 "Zeit fuer Ende Haltephase in Synchron KZU/KAB" VALUE 0x26E7C6 kw_ui8_S6_S3 2540 UMR_MSEC__10_1_0_S6_S3 0 2540 /end CHARACTERISTIC
/begin CHARACTERISTIC KL_POHKABSPORT82 "Druckoffset waehrend Haltedruckphase" CURVE 0x2493E4 kl_si16_S6_S3 12.75 UMR_BAR__1_1000_0_S6_S3 -6.4 6.35
 /begin AXIS_DESCR STD_AXIS zff_atsys._.iSignale._.obj.sig_m_t8 UMR_NM__8_1_M50_S6_S3 4 -400 1640 DEPOSIT ABSOLUTE MONOTONY MON_INCREASE /end AXIS_DESCR
/end CHARACTERISTIC
/begin CHARACTERISTIC F_PRAHKABSPORT82 "Druckfaktor waehrend Rampe auf Schaltdruck" VALUE 0x26E7C7 kw_ui8_S6_S3 1 UMR___1_100_0_S6_S3 0 1 /end CHARACTERISTIC
/begin CHARACTERISTIC F_TRAHKABSPORT82 "Zeitfaktor waehrend Rampe auf Schaltdruck" VALUE 0x26E7C8 kw_ui8_S6_S3 1 UMR___1_100_0_S6_S3 0 1 /end CHARACTERISTIC
/begin CHARACTERISTIC KL_TRAHKABSPORT82 "Zeit fuer Rampe auf Schaltdruck" CURVE 0x2493F8 kl_ui8_S6_S3 2540 UMR_MSEC__10_1_0_S6_S3 0 2540
 /begin AXIS_DESCR STD_AXIS zff_atsys._.iSignale._.obj.sig_m_t8 UMR_NM__8_1_M50_S6_S3 4 -400 1640 DEPOSIT ABSOLUTE MONOTONY MON_INCREASE /end AXIS_DESCR
/end CHARACTERISTIC
/begin CHARACTERISTIC KL_PGOKABSPORT82 "Druckgradient in Abhaengigkeit von m_t" CURVE 0x249404 kl_si16_S6_S3 200 UMR_BAR_SEC_1_10_0_S6_S3 -100 100
 /begin AXIS_DESCR STD_AXIS zff_atsys._.iSignale._.obj.sig_m_t UMR_NM__1_1_0_S6_S3 6 -400 1640 DEPOSIT ABSOLUTE MONOTONY MON_INCREASE /end AXIS_DESCR
/end CHARACTERISTIC
/begin CHARACTERISTIC KF_TOHKABMTNTSPORT82 "Zeitoffset auf Ende SF fuer Haltephase" MAP 0x249420 kf_ui8_S6_S3 2000 UMR_MSEC__10_1_M128_S6_S3 -1000 1000
 /begin AXIS_DESCR STD_AXIS zff_atsys._.iSignale._.obj.sig_n_t8 UMR_U_MIN_32_1_0_S6_S3 4 0 8160 DEPOSIT ABSOLUTE MONOTONY MON_INCREASE /end AXIS_DESCR
 /begin AXIS_DESCR STD_AXIS zff_atsys._.iSignale._.obj.sig_m_t8 UMR_NM__8_1_M50_S6_S3 6 -400 1640 DEPOSIT ABSOLUTE MONOTONY MON_INCREASE /end AXIS_DESCR
/end CHARACTERISTIC
/begin CHARACTERISTIC KL_TSYNMTKABSPORT82 "Zeit vor sync. Ende Schaltdruck KAB" CURVE 0x24944C kl_ui8_S6_S3 1280 UMR_MSEC__10_1_M128_S6_S3 -1280 0
 /begin AXIS_DESCR STD_AXIS zff_atsys._.iSignale._.obj.sig_m_t8 UMR_NM__8_1_M50_S6_S3 4 -400 1640 DEPOSIT ABSOLUTE MONOTONY MON_INCREASE /end AXIS_DESCR
/end CHARACTERISTIC
/begin CHARACTERISTIC KF_PKABSPORT82 "Schaltdruck abschaltende Kupplung" MAP 0x249458 kf_si16_S6_S3 12.75 UMR_BAR__1_1000_0_S6_S3 0 12.75
 /begin AXIS_DESCR STD_AXIS iSasZentr.iSchaltend.n_tkf UMR_U_MIN_32_1_0_S6_S3 8 0 8160 DEPOSIT ABSOLUTE MONOTONY MON_INCREASE /end AXIS_DESCR
 /begin AXIS_DESCR STD_AXIS zff_atsys._.iSignale._.obj.sig_m_t UMR_NM__1_1_0_S6_S3 10 -400 1640 DEPOSIT ABSOLUTE MONOTONY MON_INCREASE /end AXIS_DESCR
/end CHARACTERISTIC
/begin CHARACTERISTIC KF_TSYNMTNTKABVSPORT82 "Zeit vor sync. Ende Haltephase vorb. KAB" MAP 0x249524 kf_si16_S6_S3 5000 UMR_MSEC__10_1_0_S6_S3 -5000 0
 /begin AXIS_DESCR STD_AXIS zff_atsys._.iSignale._.obj.sig_m_t UMR_NM__1_1_0_S6_S3 4 -400 1640 DEPOSIT ABSOLUTE MONOTONY MON_INCREASE /end AXIS_DESCR
 /begin AXIS_DESCR STD_AXIS zff_atsys._.iSignale._.obj.sig_n_t UMR_U_MIN_1_1_0_S6_S3 6 0 8160 DEPOSIT ABSOLUTE MONOTONY MON_INCREASE /end AXIS_DESCR
/end CHARACTERISTIC
/begin CHARACTERISTIC KL_TRAMTHINSYNKABSPORT82 "Zeit fuer Abschalten KAB nach Haltephase in Synchron" CURVE 0x249570 kl_ui8_S6_S3 2550 UMR_MSEC__10_1_0_S6_S3 0 2550
 /begin AXIS_DESCR STD_AXIS zff_atsys._.iSignale._.obj.sig_m_t8 UMR_NM__8_1_M50_S6_S3 4 -400 1640 DEPOSIT ABSOLUTE MONOTONY MON_INCREASE /end AXIS_DESCR
/end CHARACTERISTIC
/begin CHARACTERISTIC KF_POHINSYNKABSPORT82 "Kennfeld Haltedruckoffset(n_tkf, m_t) bei Haltephase in Synchron" MAP 0x24957C kf_si16_S6_S3 12.75 UMR_BAR__1_1000_0_S6_S3 -6.4 6.35
 /begin AXIS_DESCR STD_AXIS iSasZentr.iSchaltend.n_tkf UMR_U_MIN_32_1_0_S6_S3 6 0 8160 DEPOSIT ABSOLUTE MONOTONY MON_INCREASE /end AXIS_DESCR
 /begin AXIS_DESCR STD_AXIS zff_atsys._.iSignale._.obj.sig_m_t UMR_NM__1_1_0_S6_S3 6 -400 1640 DEPOSIT ABSOLUTE MONOTONY MON_INCREASE /end AXIS_DESCR
/end CHARACTERISTIC
/begin CHARACTERISTIC T_HINSYNSPORT82 "Zeit fuer Ende Haltephase in Synchron KZU/KAB" VALUE 0x26E7C9 kw_ui8_S6_S3 2540 UMR_MSEC__10_1_0_S6_S3 0 2540 /end CHARACTERISTIC
/begin CHARACTERISTIC KL_POHKABSPORT84 "Druckoffset waehrend Haltedruckphase" CURVE 0x2495E4 kl_si16_S6_S3 12.75 UMR_BAR__1_1000_0_S6_S3 -6.4 6.35
 /begin AXIS_DESCR STD_AXIS zff_atsys._.iSignale._.obj.sig_m_t8 UMR_NM__8_1_M50_S6_S3 4 -400 1640 DEPOSIT ABSOLUTE MONOTONY MON_INCREASE /end AXIS_DESCR
/end CHARACTERISTIC
/begin CHARACTERISTIC F_PRAHKABSPORT84 "Druckfaktor waehrend Rampe auf Schaltdruck" VALUE 0x26E7CA kw_ui8_S6_S3 1 UMR___1_100_0_S6_S3 0 1 /end CHARACTERISTIC
/begin CHARACTERISTIC F_TRAHKABSPORT84 "Zeitfaktor waehrend Rampe auf Schaltdruck" VALUE 0x26E7CB kw_ui8_S6_S3 1 UMR___1_100_0_S6_S3 0 1 /end CHARACTERISTIC
/begin CHARACTERISTIC KL_TRAHKABSPORT84 "Zeit fuer Rampe auf Schaltdruck" CURVE 0x2495F8 kl_ui8_S6_S3 2540 UMR_MSEC__10_1_0_S6_S3 0 2540
 /begin AXIS_DESCR STD_AXIS zff_atsys._.iSignale._.obj.sig_m_t8 UMR_NM__8_1_M50_S6_S3 4 -400 1640 DEPOSIT ABSOLUTE MONOTONY MON_INCREASE /end AXIS_DESCR
/end CHARACTERISTIC
/begin CHARACTERISTIC KL_PGOKABSPORT84 "Druckgradient in Abhaengigkeit von m_t" CURVE 0x249604 kl_si16_S6_S3 200 UMR_BAR_SEC_1_10_0_S6_S3 -100 100
 /begin AXIS_DESCR STD_AXIS zff_atsys._.iSignale._.obj.sig_m_t UMR_NM__1_1_0_S6_S3 6 -400 1640 DEPOSIT ABSOLUTE MONOTONY MON_INCREASE /end AXIS_DESCR
/end CHARACTERISTIC
/begin CHARACTERISTIC KF_TOHKABMTNTSPORT84 "Zeitoffset auf Ende SF fuer Haltephase" MAP 0x249620 kf_ui8_S6_S3 2000 UMR_MSEC__10_1_M128_S6_S3 -1000 1000
 /begin AXIS_DESCR STD_AXIS zff_atsys._.iSignale._.obj.sig_n_t8 UMR_U_MIN_32_1_0_S6_S3 4 0 8160 DEPOSIT ABSOLUTE MONOTONY MON_INCREASE /end AXIS_DESCR
 /begin AXIS_DESCR STD_AXIS zff_atsys._.iSignale._.obj.sig_m_t8 UMR_NM__8_1_M50_S6_S3 6 -400 1640 DEPOSIT ABSOLUTE MONOTONY MON_INCREASE /end AXIS_DESCR
/end CHARACTERISTIC
/begin CHARACTERISTIC KL_TSYNMTKABSPORT84 "Zeit vor sync. Ende Schaltdruck KAB" CURVE 0x24964C kl_ui8_S6_S3 1280 UMR_MSEC__10_1_M128_S6_S3 -1280 0
 /begin AXIS_DESCR STD_AXIS zff_atsys._.iSignale._.obj.sig_m_t8 UMR_NM__8_1_M50_S6_S3 4 -400 1640 DEPOSIT ABSOLUTE MONOTONY MON_INCREASE /end AXIS_DESCR
/end CHARACTERISTIC
/begin CHARACTERISTIC KF_PKABSPORT84 "Schaltdruck abschaltende Kupplung" MAP 0x249658 kf_si16_S6_S3 12.75 UMR_BAR__1_1000_0_S6_S3 0 12.75
 /begin AXIS_DESCR STD_AXIS iSasZentr.iSchaltend.n_tkf UMR_U_MIN_32_1_0_S6_S3 8 0 8160 DEPOSIT ABSOLUTE MONOTONY MON_INCREASE /end AXIS_DESCR
 /begin AXIS_DESCR STD_AXIS zff_atsys._.iSignale._.obj.sig_m_t UMR_NM__1_1_0_S6_S3 10 -400 1640 DEPOSIT ABSOLUTE MONOTONY MON_INCREASE /end AXIS_DESCR
/end CHARACTERISTIC
/begin CHARACTERISTIC KF_TSYNMTNTKABVSPORT84 "Zeit vor sync. Ende Haltephase vorb. KAB" MAP 0x249724 kf_si16_S6_S3 5000 UMR_MSEC__10_1_0_S6_S3 -5000 0
 /begin AXIS_DESCR STD_AXIS zff_atsys._.iSignale._.obj.sig_m_t UMR_NM__1_1_0_S6_S3 4 -400 1640 DEPOSIT ABSOLUTE MONOTONY MON_INCREASE /end AXIS_DESCR
 /begin AXIS_DESCR STD_AXIS zff_atsys._.iSignale._.obj.sig_n_t UMR_U_MIN_1_1_0_S6_S3 6 0 8160 DEPOSIT ABSOLUTE MONOTONY MON_INCREASE /end AXIS_DESCR
/end CHARACTERISTIC
/begin CHARACTERISTIC KL_TRAMTHINSYNKABSPORT84 "Zeit fuer Abschalten KAB nach Haltephase in Synchron" CURVE 0x249770 kl_ui8_S6_S3 2550 UMR_MSEC__10_1_0_S6_S3 0 2550
 /begin AXIS_DESCR STD_AXIS zff_atsys._.iSignale._.obj.sig_m_t8 UMR_NM__8_1_M50_S6_S3 4 -400 1640 DEPOSIT ABSOLUTE MONOTONY MON_INCREASE /end AXIS_DESCR
/end CHARACTERISTIC
/begin CHARACTERISTIC KF_POHINSYNKABSPORT84 "Kennfeld Haltedruckoffset(n_tkf, m_t) bei Haltephase in Synchron" MAP 0x24977C kf_si16_S6_S3 12.75 UMR_BAR__1_1000_0_S6_S3 -6.4 6.35
 /begin AXIS_DESCR STD_AXIS iSasZentr.iSchaltend.n_tkf UMR_U_MIN_32_1_0_S6_S3 6 0 8160 DEPOSIT ABSOLUTE MONOTONY MON_INCREASE /end AXIS_DESCR
 /begin AXIS_DESCR STD_AXIS zff_atsys._.iSignale._.obj.sig_m_t UMR_NM__1_1_0_S6_S3 6 -400 1640 DEPOSIT ABSOLUTE MONOTONY MON_INCREASE /end AXIS_DESCR
/end CHARACTERISTIC
/begin CHARACTERISTIC T_HINSYNSPORT84 "Zeit fuer Ende Haltephase in Synchron KZU/KAB" VALUE 0x26E7CC kw_ui8_S6_S3 2540 UMR_MSEC__10_1_0_S6_S3 0 2540 /end CHARACTERISTIC
/begin CHARACTERISTIC KL_POHKABSPORT86 "Druckoffset waehrend Haltedruckphase" CURVE 0x2497E4 kl_si16_S6_S3 12.75 UMR_BAR__1_1000_0_S6_S3 -6.4 6.35
 /begin AXIS_DESCR STD_AXIS zff_atsys._.iSignale._.obj.sig_m_t8 UMR_NM__8_1_M50_S6_S3 4 -400 1640 DEPOSIT ABSOLUTE MONOTONY MON_INCREASE /end AXIS_DESCR
/end CHARACTERISTIC
/begin CHARACTERISTIC F_PRAHKABSPORT86 "Druckfaktor waehrend Rampe auf Schaltdruck" VALUE 0x26E7CD kw_ui8_S6_S3 1 UMR___1_100_0_S6_S3 0 1 /end CHARACTERISTIC
/begin CHARACTERISTIC F_TRAHKABSPORT86 "Zeitfaktor waehrend Rampe auf Schaltdruck" VALUE 0x26E7CE kw_ui8_S6_S3 1 UMR___1_100_0_S6_S3 0 1 /end CHARACTERISTIC
/begin CHARACTERISTIC KL_TRAHKABSPORT86 "Zeit fuer Rampe auf Schaltdruck" CURVE 0x2497F8 kl_ui8_S6_S3 2540 UMR_MSEC__10_1_0_S6_S3 0 2540
 /begin AXIS_DESCR STD_AXIS zff_atsys._.iSignale._.obj.sig_m_t8 UMR_NM__8_1_M50_S6_S3 4 -400 1640 DEPOSIT ABSOLUTE MONOTONY MON_INCREASE /end AXIS_DESCR
/end CHARACTERISTIC
/begin CHARACTERISTIC KL_PGOKABSPORT86 "Druckgradient in Abhaengigkeit von m_t" CURVE 0x249804 kl_si16_S6_S3 200 UMR_BAR_SEC_1_10_0_S6_S3 -100 100
 /begin AXIS_DESCR STD_AXIS zff_atsys._.iSignale._.obj.sig_m_t UMR_NM__1_1_0_S6_S3 6 -400 1640 DEPOSIT ABSOLUTE MONOTONY MON_INCREASE /end AXIS_DESCR
/end CHARACTERISTIC
/begin CHARACTERISTIC KF_TOHKABMTNTSPORT86 "Zeitoffset auf Ende SF fuer Haltephase" MAP 0x249820 kf_ui8_S6_S3 2000 UMR_MSEC__10_1_M128_S6_S3 -1000 1000
 /begin AXIS_DESCR STD_AXIS zff_atsys._.iSignale._.obj.sig_n_t8 UMR_U_MIN_32_1_0_S6_S3 4 0 8160 DEPOSIT ABSOLUTE MONOTONY MON_INCREASE /end AXIS_DESCR
 /begin AXIS_DESCR STD_AXIS zff_atsys._.iSignale._.obj.sig_m_t8 UMR_NM__8_1_M50_S6_S3 6 -400 1640 DEPOSIT ABSOLUTE MONOTONY MON_INCREASE /end AXIS_DESCR
/end CHARACTERISTIC
/begin CHARACTERISTIC KL_TSYNMTKABSPORT86 "Zeit vor sync. Ende Schaltdruck KAB" CURVE 0x24984C kl_ui8_S6_S3 1280 UMR_MSEC__10_1_M128_S6_S3 -1280 0
 /begin AXIS_DESCR STD_AXIS zff_atsys._.iSignale._.obj.sig_m_t8 UMR_NM__8_1_M50_S6_S3 4 -400 1640 DEPOSIT ABSOLUTE MONOTONY MON_INCREASE /end AXIS_DESCR
/end CHARACTERISTIC
/begin CHARACTERISTIC KF_PKABSPORT86 "Schaltdruck abschaltende Kupplung" MAP 0x249858 kf_si16_S6_S3 12.75 UMR_BAR__1_1000_0_S6_S3 0 12.75
 /begin AXIS_DESCR STD_AXIS iSasZentr.iSchaltend.n_tkf UMR_U_MIN_32_1_0_S6_S3 8 0 8160 DEPOSIT ABSOLUTE MONOTONY MON_INCREASE /end AXIS_DESCR
 /begin AXIS_DESCR STD_AXIS zff_atsys._.iSignale._.obj.sig_m_t UMR_NM__1_1_0_S6_S3 10 -400 1640 DEPOSIT ABSOLUTE MONOTONY MON_INCREASE /end AXIS_DESCR
/end CHARACTERISTIC
/begin CHARACTERISTIC KF_TSYNMTNTKABVSPORT86 "Zeit vor sync. Ende Haltephase vorb. KAB" MAP 0x249924 kf_si16_S6_S3 5000 UMR_MSEC__10_1_0_S6_S3 -5000 0
 /begin AXIS_DESCR STD_AXIS zff_atsys._.iSignale._.obj.sig_m_t UMR_NM__1_1_0_S6_S3 4 -400 1640 DEPOSIT ABSOLUTE MONOTONY MON_INCREASE /end AXIS_DESCR
 /begin AXIS_DESCR STD_AXIS zff_atsys._.iSignale._.obj.sig_n_t UMR_U_MIN_1_1_0_S6_S3 6 0 8160 DEPOSIT ABSOLUTE MONOTONY MON_INCREASE /end AXIS_DESCR
/end CHARACTERISTIC
/begin CHARACTERISTIC KL_TRAMTHINSYNKABSPORT86 "Zeit fuer Abschalten KAB nach Haltephase in Synchron" CURVE 0x249970 kl_ui8_S6_S3 2550 UMR_MSEC__10_1_0_S6_S3 0 2550
 /begin AXIS_DESCR STD_AXIS zff_atsys._.iSignale._.obj.sig_m_t8 UMR_NM__8_1_M50_S6_S3 4 -400 1640 DEPOSIT ABSOLUTE MONOTONY MON_INCREASE /end AXIS_DESCR
/end CHARACTERISTIC
/begin CHARACTERISTIC KF_POHINSYNKABSPORT86 "Kennfeld Haltedruckoffset(n_tkf, m_t) bei Haltephase in Synchron" MAP 0x24997C kf_si16_S6_S3 12.75 UMR_BAR__1_1000_0_S6_S3 -6.4 6.35
 /begin AXIS_DESCR STD_AXIS iSasZentr.iSchaltend.n_tkf UMR_U_MIN_32_1_0_S6_S3 6 0 8160 DEPOSIT ABSOLUTE MONOTONY MON_INCREASE /end AXIS_DESCR
 /begin AXIS_DESCR STD_AXIS zff_atsys._.iSignale._.obj.sig_m_t UMR_NM__1_1_0_S6_S3 6 -400 1640 DEPOSIT ABSOLUTE MONOTONY MON_INCREASE /end AXIS_DESCR
/end CHARACTERISTIC
/begin CHARACTERISTIC T_HINSYNSPORT86 "Zeit fuer Ende Haltephase in Synchron KZU/KAB" VALUE 0x26E7CF kw_ui8_S6_S3 2540 UMR_MSEC__10_1_0_S6_S3 0 2540 /end CHARACTERISTIC
/begin CHARACTERISTIC KF_TSYNMTNTKABV12 "Zeit vor sync. Ende Haltephase vorb. KAB" MAP 0x23BD8C kf_si16_S6_S3 5000 UMR_MSEC__10_1_0_S6_S3 -5000 0
 /begin AXIS_DESCR STD_AXIS zff_atsys._.iSignale._.obj.sig_m_t UMR_NM__1_1_0_S6_S3 4 -400 1640 DEPOSIT ABSOLUTE MONOTONY MON_INCREASE /end AXIS_DESCR
 /begin AXIS_DESCR STD_AXIS zff_atsys._.iSignale._.obj.sig_n_t UMR_U_MIN_1_1_0_S6_S3 6 0 8160 DEPOSIT ABSOLUTE MONOTONY MON_INCREASE /end AXIS_DESCR
/end CHARACTERISTIC
/begin CHARACTERISTIC T_RAABV12 "Zeit Rampe auf Schaltdruck" VALUE 0x26E6FF kw_ui8_S6_S3 2540 UMR_MSEC__10_1_0_S6_S3 0 2540 /end CHARACTERISTIC
/begin CHARACTERISTIC KL_POKABV12 "Druckoffset Folgeschaltung in Abhaengigkeit von m_t" CURVE 0x23BDD8 kl_si16_S6_S3 12 UMR_BAR__1_1000_0_S6_S3 -6 6
 /begin AXIS_DESCR STD_AXIS zff_atsys._.iSignale._.obj.sig_m_t UMR_NM__1_1_0_S6_S3 4 -400 1640 DEPOSIT ABSOLUTE MONOTONY MON_INCREASE /end AXIS_DESCR
/end CHARACTERISTIC
/begin CHARACTERISTIC KL_POKABVFOLNACHDHS12 "Druckoffset Folgeschaltung nach Doppel HS" CURVE 0x23BDEC kl_si16_S6_S3 12 UMR_BAR__1_1000_0_S6_S3 -6 6
 /begin AXIS_DESCR STD_AXIS zff_atsys._.iSignale._.obj.sig_m_t UMR_NM__1_1_0_S6_S3 4 -400 1640 DEPOSIT ABSOLUTE MONOTONY MON_INCREASE /end AXIS_DESCR
/end CHARACTERISTIC
/begin CHARACTERISTIC T_RAABVFOLNACHDHS12 "Zeit Uebergangsrampe Verschachtelung nach Doppel HS" VALUE 0x26E700 kw_ui8_S6_S3 2000 UMR_MSEC__10_1_0_S6_S3 0 2000 /end CHARACTERISTIC
/begin CHARACTERISTIC KF_TSYNMTNTKABV23 "Zeit vor sync. Ende Haltephase vorb. KAB" MAP 0x23BE00 kf_si16_S6_S3 5000 UMR_MSEC__10_1_0_S6_S3 -5000 0
 /begin AXIS_DESCR STD_AXIS zff_atsys._.iSignale._.obj.sig_m_t UMR_NM__1_1_0_S6_S3 4 -400 1640 DEPOSIT ABSOLUTE MONOTONY MON_INCREASE /end AXIS_DESCR
 /begin AXIS_DESCR STD_AXIS zff_atsys._.iSignale._.obj.sig_n_t UMR_U_MIN_1_1_0_S6_S3 6 0 8160 DEPOSIT ABSOLUTE MONOTONY MON_INCREASE /end AXIS_DESCR
/end CHARACTERISTIC
/begin CHARACTERISTIC T_RAABV23 "Zeit Rampe auf Schaltdruck" VALUE 0x26E701 kw_ui8_S6_S3 2540 UMR_MSEC__10_1_0_S6_S3 0 2540 /end CHARACTERISTIC
/begin CHARACTERISTIC KL_POKABV23 "Druckoffset Folgeschaltung in Abhaengigkeit von m_t" CURVE 0x23BE4C kl_si16_S6_S3 12 UMR_BAR__1_1000_0_S6_S3 -6 6
 /begin AXIS_DESCR STD_AXIS zff_atsys._.iSignale._.obj.sig_m_t UMR_NM__1_1_0_S6_S3 4 -400 1640 DEPOSIT ABSOLUTE MONOTONY MON_INCREASE /end AXIS_DESCR
/end CHARACTERISTIC
/begin CHARACTERISTIC KL_POKABVFOLNACHDHS23 "Druckoffset Folgeschaltung nach Doppel HS" CURVE 0x23BE60 kl_si16_S6_S3 12 UMR_BAR__1_1000_0_S6_S3 -6 6
 /begin AXIS_DESCR STD_AXIS zff_atsys._.iSignale._.obj.sig_m_t UMR_NM__1_1_0_S6_S3 4 -400 1640 DEPOSIT ABSOLUTE MONOTONY MON_INCREASE /end AXIS_DESCR
/end CHARACTERISTIC
/begin CHARACTERISTIC T_RAABVFOLNACHDHS23 "Zeit Uebergangsrampe Verschachtelung nach Doppel HS" VALUE 0x26E702 kw_ui8_S6_S3 2000 UMR_MSEC__10_1_0_S6_S3 0 2000 /end CHARACTERISTIC
/begin CHARACTERISTIC KF_TSYNMTNTKABV34 "Zeit vor sync. Ende Haltephase vorb. KAB" MAP 0x23BE74 kf_si16_S6_S3 5000 UMR_MSEC__10_1_0_S6_S3 -5000 0
 /begin AXIS_DESCR STD_AXIS zff_atsys._.iSignale._.obj.sig_m_t UMR_NM__1_1_0_S6_S3 4 -400 1640 DEPOSIT ABSOLUTE MONOTONY MON_INCREASE /end AXIS_DESCR
 /begin AXIS_DESCR STD_AXIS zff_atsys._.iSignale._.obj.sig_n_t UMR_U_MIN_1_1_0_S6_S3 6 0 8160 DEPOSIT ABSOLUTE MONOTONY MON_INCREASE /end AXIS_DESCR
/end CHARACTERISTIC
/begin CHARACTERISTIC T_RAABV34 "Zeit Rampe auf Schaltdruck" VALUE 0x26E703 kw_ui8_S6_S3 2540 UMR_MSEC__10_1_0_S6_S3 0 2540 /end CHARACTERISTIC
/begin CHARACTERISTIC KL_POKABV34 "Druckoffset Folgeschaltung in Abhaengigkeit von m_t" CURVE 0x23BEC0 kl_si16_S6_S3 12 UMR_BAR__1_1000_0_S6_S3 -6 6
 /begin AXIS_DESCR STD_AXIS zff_atsys._.iSignale._.obj.sig_m_t UMR_NM__1_1_0_S6_S3 4 -400 1640 DEPOSIT ABSOLUTE MONOTONY MON_INCREASE /end AXIS_DESCR
/end CHARACTERISTIC
/begin CHARACTERISTIC KL_POKABVFOLNACHDHS34 "Druckoffset Folgeschaltung nach Doppel HS" CURVE 0x23BED4 kl_si16_S6_S3 12 UMR_BAR__1_1000_0_S6_S3 -6 6
 /begin AXIS_DESCR STD_AXIS zff_atsys._.iSignale._.obj.sig_m_t UMR_NM__1_1_0_S6_S3 4 -400 1640 DEPOSIT ABSOLUTE MONOTONY MON_INCREASE /end AXIS_DESCR
/end CHARACTERISTIC
/begin CHARACTERISTIC T_RAABVFOLNACHDHS34 "Zeit Uebergangsrampe Verschachtelung nach Doppel HS" VALUE 0x26E704 kw_ui8_S6_S3 2000 UMR_MSEC__10_1_0_S6_S3 0 2000 /end CHARACTERISTIC
/begin CHARACTERISTIC KF_TSYNMTNTKABV45 "Zeit vor sync. Ende Haltephase vorb. KAB" MAP 0x23BEE8 kf_si16_S6_S3 5000 UMR_MSEC__10_1_0_S6_S3 -5000 0
 /begin AXIS_DESCR STD_AXIS zff_atsys._.iSignale._.obj.sig_m_t UMR_NM__1_1_0_S6_S3 4 -400 1640 DEPOSIT ABSOLUTE MONOTONY MON_INCREASE /end AXIS_DESCR
 /begin AXIS_DESCR STD_AXIS zff_atsys._.iSignale._.obj.sig_n_t UMR_U_MIN_1_1_0_S6_S3 6 0 8160 DEPOSIT ABSOLUTE MONOTONY MON_INCREASE /end AXIS_DESCR
/end CHARACTERISTIC
/begin CHARACTERISTIC T_RAABV45 "Zeit Rampe auf Schaltdruck" VALUE 0x26E705 kw_ui8_S6_S3 2540 UMR_MSEC__10_1_0_S6_S3 0 2540 /end CHARACTERISTIC
/begin CHARACTERISTIC KL_POKABV45 "Druckoffset Folgeschaltung in Abhaengigkeit von m_t" CURVE 0x23BF34 kl_si16_S6_S3 12 UMR_BAR__1_1000_0_S6_S3 -6 6
 /begin AXIS_DESCR STD_AXIS zff_atsys._.iSignale._.obj.sig_m_t UMR_NM__1_1_0_S6_S3 4 -400 1640 DEPOSIT ABSOLUTE MONOTONY MON_INCREASE /end AXIS_DESCR
/end CHARACTERISTIC
/begin CHARACTERISTIC KL_POKABVFOLNACHDHS45 "Druckoffset Folgeschaltung nach Doppel HS" CURVE 0x23BF48 kl_si16_S6_S3 12 UMR_BAR__1_1000_0_S6_S3 -6 6
 /begin AXIS_DESCR STD_AXIS zff_atsys._.iSignale._.obj.sig_m_t UMR_NM__1_1_0_S6_S3 4 -400 1640 DEPOSIT ABSOLUTE MONOTONY MON_INCREASE /end AXIS_DESCR
/end CHARACTERISTIC
/begin CHARACTERISTIC T_RAABVFOLNACHDHS45 "Zeit Uebergangsrampe Verschachtelung nach Doppel HS" VALUE 0x26E706 kw_ui8_S6_S3 2000 UMR_MSEC__10_1_0_S6_S3 0 2000 /end CHARACTERISTIC
/begin CHARACTERISTIC KF_TSYNMTNTKABV56 "Zeit vor sync. Ende Haltephase vorb. KAB" MAP 0x23BF5C kf_si16_S6_S3 5000 UMR_MSEC__10_1_0_S6_S3 -5000 0
 /begin AXIS_DESCR STD_AXIS zff_atsys._.iSignale._.obj.sig_m_t UMR_NM__1_1_0_S6_S3 4 -400 1640 DEPOSIT ABSOLUTE MONOTONY MON_INCREASE /end AXIS_DESCR
 /begin AXIS_DESCR STD_AXIS zff_atsys._.iSignale._.obj.sig_n_t UMR_U_MIN_1_1_0_S6_S3 6 0 8160 DEPOSIT ABSOLUTE MONOTONY MON_INCREASE /end AXIS_DESCR
/end CHARACTERISTIC
/begin CHARACTERISTIC T_RAABV56 "Zeit Rampe auf Schaltdruck" VALUE 0x26E707 kw_ui8_S6_S3 2540 UMR_MSEC__10_1_0_S6_S3 0 2540 /end CHARACTERISTIC
/begin CHARACTERISTIC KL_POKABV56 "Druckoffset Folgeschaltung in Abhaengigkeit von m_t" CURVE 0x23BFA8 kl_si16_S6_S3 12 UMR_BAR__1_1000_0_S6_S3 -6 6
 /begin AXIS_DESCR STD_AXIS zff_atsys._.iSignale._.obj.sig_m_t UMR_NM__1_1_0_S6_S3 4 -400 1640 DEPOSIT ABSOLUTE MONOTONY MON_INCREASE /end AXIS_DESCR
/end CHARACTERISTIC
/begin CHARACTERISTIC KL_POKABVFOLNACHDHS56 "Druckoffset Folgeschaltung nach Doppel HS" CURVE 0x23BFBC kl_si16_S6_S3 12 UMR_BAR__1_1000_0_S6_S3 -6 6
 /begin AXIS_DESCR STD_AXIS zff_atsys._.iSignale._.obj.sig_m_t UMR_NM__1_1_0_S6_S3 4 -400 1640 DEPOSIT ABSOLUTE MONOTONY MON_INCREASE /end AXIS_DESCR
/end CHARACTERISTIC
/begin CHARACTERISTIC T_RAABVFOLNACHDHS56 "Zeit Uebergangsrampe Verschachtelung nach Doppel HS" VALUE 0x26E708 kw_ui8_S6_S3 2000 UMR_MSEC__10_1_0_S6_S3 0 2000 /end CHARACTERISTIC
/begin CHARACTERISTIC KF_TSYNMTNTKABV67 "Zeit vor sync. Ende Haltephase vorb. KAB" MAP 0x23BFD0 kf_si16_S6_S3 5000 UMR_MSEC__10_1_0_S6_S3 -5000 0
 /begin AXIS_DESCR STD_AXIS zff_atsys._.iSignale._.obj.sig_m_t UMR_NM__1_1_0_S6_S3 4 -400 1640 DEPOSIT ABSOLUTE MONOTONY MON_INCREASE /end AXIS_DESCR
 /begin AXIS_DESCR STD_AXIS zff_atsys._.iSignale._.obj.sig_n_t UMR_U_MIN_1_1_0_S6_S3 6 0 8160 DEPOSIT ABSOLUTE MONOTONY MON_INCREASE /end AXIS_DESCR
/end CHARACTERISTIC
/begin CHARACTERISTIC T_RAABV67 "Zeit Rampe auf Schaltdruck" VALUE 0x26E709 kw_ui8_S6_S3 2540 UMR_MSEC__10_1_0_S6_S3 0 2540 /end CHARACTERISTIC
/begin CHARACTERISTIC KL_POKABV67 "Druckoffset Folgeschaltung in Abhaengigkeit von m_t" CURVE 0x23C01C kl_si16_S6_S3 12 UMR_BAR__1_1000_0_S6_S3 -6 6
 /begin AXIS_DESCR STD_AXIS zff_atsys._.iSignale._.obj.sig_m_t UMR_NM__1_1_0_S6_S3 4 -400 1640 DEPOSIT ABSOLUTE MONOTONY MON_INCREASE /end AXIS_DESCR
/end CHARACTERISTIC
/begin CHARACTERISTIC KL_POKABVFOLNACHDHS67 "Druckoffset Folgeschaltung nach Doppel HS" CURVE 0x23C030 kl_si16_S6_S3 12 UMR_BAR__1_1000_0_S6_S3 -6 6
 /begin AXIS_DESCR STD_AXIS zff_atsys._.iSignale._.obj.sig_m_t UMR_NM__1_1_0_S6_S3 4 -400 1640 DEPOSIT ABSOLUTE MONOTONY MON_INCREASE /end AXIS_DESCR
/end CHARACTERISTIC
/begin CHARACTERISTIC T_RAABVFOLNACHDHS67 "Zeit Uebergangsrampe Verschachtelung nach Doppel HS" VALUE 0x26E70A kw_ui8_S6_S3 2000 UMR_MSEC__10_1_0_S6_S3 0 2000 /end CHARACTERISTIC
/begin CHARACTERISTIC KF_TSYNMTNTKABV78 "Zeit vor sync. Ende Haltephase vorb. KAB" MAP 0x23C044 kf_si16_S6_S3 5000 UMR_MSEC__10_1_0_S6_S3 -5000 0
 /begin AXIS_DESCR STD_AXIS zff_atsys._.iSignale._.obj.sig_m_t UMR_NM__1_1_0_S6_S3 4 -400 1640 DEPOSIT ABSOLUTE MONOTONY MON_INCREASE /end AXIS_DESCR
 /begin AXIS_DESCR STD_AXIS zff_atsys._.iSignale._.obj.sig_n_t UMR_U_MIN_1_1_0_S6_S3 6 0 8160 DEPOSIT ABSOLUTE MONOTONY MON_INCREASE /end AXIS_DESCR
/end CHARACTERISTIC
/begin CHARACTERISTIC T_RAABV78 "Zeit Rampe auf Schaltdruck" VALUE 0x26E70B kw_ui8_S6_S3 2540 UMR_MSEC__10_1_0_S6_S3 0 2540 /end CHARACTERISTIC
/begin CHARACTERISTIC KL_POKABV78 "Druckoffset Folgeschaltung in Abhaengigkeit von m_t" CURVE 0x23C090 kl_si16_S6_S3 12 UMR_BAR__1_1000_0_S6_S3 -6 6
 /begin AXIS_DESCR STD_AXIS zff_atsys._.iSignale._.obj.sig_m_t UMR_NM__1_1_0_S6_S3 4 -400 1640 DEPOSIT ABSOLUTE MONOTONY MON_INCREASE /end AXIS_DESCR
/end CHARACTERISTIC
/begin CHARACTERISTIC KL_POKABVFOLNACHDHS78 "Druckoffset Folgeschaltung nach Doppel HS" CURVE 0x23C0A4 kl_si16_S6_S3 12 UMR_BAR__1_1000_0_S6_S3 -6 6
 /begin AXIS_DESCR STD_AXIS zff_atsys._.iSignale._.obj.sig_m_t UMR_NM__1_1_0_S6_S3 4 -400 1640 DEPOSIT ABSOLUTE MONOTONY MON_INCREASE /end AXIS_DESCR
/end CHARACTERISTIC
/begin CHARACTERISTIC T_RAABVFOLNACHDHS78 "Zeit Uebergangsrampe Verschachtelung nach Doppel HS" VALUE 0x26E70C kw_ui8_S6_S3 2000 UMR_MSEC__10_1_0_S6_S3 0 2000 /end CHARACTERISTIC
/begin CHARACTERISTIC KL_TSYNMTRAKZU12 "Zeit vor sync. Ende Schaltdruck/Start 3. Rampe KZU" CURVE 0x24ED44 kl_ui8_S6_S3 1280 UMR_MSEC__10_1_M128_S6_S3 -1280 0
 /begin AXIS_DESCR STD_AXIS zff_atsys._.iSignale._.obj.sig_m_t8 UMR_NM__8_1_M50_S6_S3 4 -400 1640 DEPOSIT ABSOLUTE MONOTONY MON_INCREASE /end AXIS_DESCR
/end CHARACTERISTIC
/begin CHARACTERISTIC KL_TSYNMTRAKZU12_EL "Zeit vor sync. Ende Schaltdruck/Start 3. Rampe KZU" CURVE 0x24ED50 kl_ui8_S6_S3 1280 UMR_MSEC__10_1_M128_S6_S3 -1280 0
 /begin AXIS_DESCR STD_AXIS zff_atsys._.iSignale._.obj.sig_m_t8 UMR_NM__8_1_M50_S6_S3 4 -400 1640 DEPOSIT ABSOLUTE MONOTONY MON_INCREASE /end AXIS_DESCR
/end CHARACTERISTIC
/begin CHARACTERISTIC KF_TFCGNT12 "Fuellzeit" MAP 0x24ED5C kf_ui8_S6_S3 2540 UMR_MSEC__10_1_0_S6_S3 0 2540
 /begin AXIS_DESCR STD_AXIS zff_atsys._.iSignale._.obj.sig_c_getr UMR_GRADC__1_1_M40_S6_S3 6 -40 150 DEPOSIT ABSOLUTE MONOTONY MON_INCREASE /end AXIS_DESCR
 /begin AXIS_DESCR STD_AXIS zff_atsys._.iSignale._.obj.sig_n_t8 UMR_U_MIN_32_1_0_S6_S3 3 0 8160 DEPOSIT ABSOLUTE MONOTONY MON_INCREASE /end AXIS_DESCR
/end CHARACTERISTIC
/begin CHARACTERISTIC KF_TFCGNT12_EL "Fuellzeit" MAP 0x24ED80 kf_ui8_S6_S3 2540 UMR_MSEC__10_1_0_S6_S3 0 2540
 /begin AXIS_DESCR STD_AXIS zff_atsys._.iSignale._.obj.sig_c_getr UMR_GRADC__1_1_M40_S6_S3 6 -40 150 DEPOSIT ABSOLUTE MONOTONY MON_INCREASE /end AXIS_DESCR
 /begin AXIS_DESCR STD_AXIS zff_atsys._.iSignale._.obj.sig_n_t8 UMR_U_MIN_32_1_0_S6_S3 3 0 8160 DEPOSIT ABSOLUTE MONOTONY MON_INCREASE /end AXIS_DESCR
/end CHARACTERISTIC
/begin CHARACTERISTIC T_VKZU12 "Verzoegerungszeit zuschaltende Kupplung nach Schaltbeginn" VALUE 0x26E847 kw_ui8_S6_S3 2540 UMR_MSEC__10_1_0_S6_S3 0 2540 /end CHARACTERISTIC
/begin CHARACTERISTIC T_VKZU12_EL "Verzoegerungszeit zuschaltende Kupplung nach Schaltbeginn" VALUE 0x26E848 kw_ui8_S6_S3 2540 UMR_MSEC__10_1_0_S6_S3 0 2540 /end CHARACTERISTIC
/begin CHARACTERISTIC KF_POFMTN12 "Kennfeld Fuelldruckoffset(n_t, m_t)" MAP 0x24EDA4 kf_si16_S6_S3 12.75 UMR_BAR__1_1000_0_S6_S3 -6.4 6.35
 /begin AXIS_DESCR STD_AXIS zff_atsys._.iSignale._.obj.sig_n_t UMR_U_MIN_1_1_0_S6_S3 4 0 8160 DEPOSIT ABSOLUTE MONOTONY MON_INCREASE /end AXIS_DESCR
 /begin AXIS_DESCR STD_AXIS zff_atsys._.iSignale._.obj.sig_m_t UMR_NM__1_1_0_S6_S3 6 -400 1640 DEPOSIT ABSOLUTE MONOTONY MON_INCREASE /end AXIS_DESCR
/end CHARACTERISTIC
/begin CHARACTERISTIC KF_POFMTN12_EL "Kennfeld Fuelldruckoffset(n_t, m_t)" MAP 0x24EDF0 kf_si16_S6_S3 12.75 UMR_BAR__1_1000_0_S6_S3 -6.4 6.35
 /begin AXIS_DESCR STD_AXIS zff_atsys._.iSignale._.obj.sig_n_t UMR_U_MIN_1_1_0_S6_S3 4 0 8160 DEPOSIT ABSOLUTE MONOTONY MON_INCREASE /end AXIS_DESCR
 /begin AXIS_DESCR STD_AXIS zff_atsys._.iSignale._.obj.sig_m_t UMR_NM__1_1_0_S6_S3 6 -400 1640 DEPOSIT ABSOLUTE MONOTONY MON_INCREASE /end AXIS_DESCR
/end CHARACTERISTIC
/begin CHARACTERISTIC KF_T_DT_IG_CHANGE12 "Kennfeld Zeitvorhalt für Übergabe Rampenzeit auf Schaltdruck" MAP 0x24EE3C kf_si16_S6_S3 5080 UMR_MSEC__10_1_0_S6_S3 -2540 2540
 /begin AXIS_DESCR STD_AXIS zff_atsys._.iSignale._.obj.sig_n_t UMR_U_MIN_1_1_0_S6_S3 4 0 8160 DEPOSIT ABSOLUTE MONOTONY MON_INCREASE /end AXIS_DESCR
 /begin AXIS_DESCR STD_AXIS zff_atsys._.iSignale._.obj.sig_m_t UMR_NM__1_1_0_S6_S3 4 -400 1640 DEPOSIT ABSOLUTE MONOTONY MON_INCREASE /end AXIS_DESCR
/end CHARACTERISTIC
/begin CHARACTERISTIC KF_T_DT_IG_CHANGE12_EL "Kennfeld Zeitvorhalt für Übergabe Rampenzeit auf Schaltdruck" MAP 0x24EE74 kf_si16_S6_S3 5080 UMR_MSEC__10_1_0_S6_S3 -2540 2540
 /begin AXIS_DESCR STD_AXIS zff_atsys._.iSignale._.obj.sig_n_t UMR_U_MIN_1_1_0_S6_S3 4 0 8160 DEPOSIT ABSOLUTE MONOTONY MON_INCREASE /end AXIS_DESCR
 /begin AXIS_DESCR STD_AXIS zff_atsys._.iSignale._.obj.sig_m_t UMR_NM__1_1_0_S6_S3 4 -400 1640 DEPOSIT ABSOLUTE MONOTONY MON_INCREASE /end AXIS_DESCR
/end CHARACTERISTIC
/begin CHARACTERISTIC KF_T2_DT_IG_CHANGE12 "2. Kennfeld Zeitvorhalt für Übergabe Rampenzeit auf Schaltdruck" MAP 0x24EEAC kf_si16_S6_S3 5080 UMR_MSEC__10_1_0_S6_S3 -2540 2540
 /begin AXIS_DESCR STD_AXIS zff_atsys._.iSignale._.obj.sig_n_t UMR_U_MIN_1_1_0_S6_S3 4 0 8160 DEPOSIT ABSOLUTE MONOTONY MON_INCREASE /end AXIS_DESCR
 /begin AXIS_DESCR STD_AXIS zff_atsys._.iSignale._.obj.sig_m_t UMR_NM__1_1_0_S6_S3 4 -400 1640 DEPOSIT ABSOLUTE MONOTONY MON_INCREASE /end AXIS_DESCR
/end CHARACTERISTIC
/begin CHARACTERISTIC KF_TRAMTNT12 "Zeit 1. Rampe der zuschaltenden Kupplung" MAP 0x24EEE4 kf_ui8_S6_S3 2540 UMR_MSEC__10_1_0_S6_S3 0 2540
 /begin AXIS_DESCR STD_AXIS zff_atsys._.iSignale._.obj.sig_m_t8 UMR_NM__8_1_M50_S6_S3 4 -400 1640 DEPOSIT ABSOLUTE MONOTONY MON_INCREASE /end AXIS_DESCR
 /begin AXIS_DESCR STD_AXIS zff_atsys._.iSignale._.obj.sig_n_t8 UMR_U_MIN_32_1_0_S6_S3 4 0 8160 DEPOSIT ABSOLUTE MONOTONY MON_INCREASE /end AXIS_DESCR
/end CHARACTERISTIC
/begin CHARACTERISTIC KF_TRAMTNT12_EL "Zeit 1. Rampe der zuschaltenden Kupplung" MAP 0x24EF04 kf_ui8_S6_S3 2540 UMR_MSEC__10_1_0_S6_S3 0 2540
 /begin AXIS_DESCR STD_AXIS zff_atsys._.iSignale._.obj.sig_m_t8 UMR_NM__8_1_M50_S6_S3 4 -400 1640 DEPOSIT ABSOLUTE MONOTONY MON_INCREASE /end AXIS_DESCR
 /begin AXIS_DESCR STD_AXIS zff_atsys._.iSignale._.obj.sig_n_t8 UMR_U_MIN_32_1_0_S6_S3 4 0 8160 DEPOSIT ABSOLUTE MONOTONY MON_INCREASE /end AXIS_DESCR
/end CHARACTERISTIC
/begin CHARACTERISTIC KF_PKZU12 "Schaltdruck zuschaltende Kupplung" MAP 0x24EF24 kf_si16_S6_S3 12.75 UMR_BAR__1_1000_0_S6_S3 0 12.75
 /begin AXIS_DESCR STD_AXIS iSasZentr.iSchaltend.n_tkf UMR_U_MIN_32_1_0_S6_S3 8 0 8160 DEPOSIT ABSOLUTE MONOTONY MON_INCREASE /end AXIS_DESCR
 /begin AXIS_DESCR STD_AXIS zff_atsys._.iSignale._.obj.sig_m_t UMR_NM__1_1_0_S6_S3 10 -400 1640 DEPOSIT ABSOLUTE MONOTONY MON_INCREASE /end AXIS_DESCR
/end CHARACTERISTIC
/begin CHARACTERISTIC KF_PKZU12_EL "Schaltdruck zuschaltende Kupplung" MAP 0x24EFF0 kf_si16_S6_S3 12.75 UMR_BAR__1_1000_0_S6_S3 0 12.75
 /begin AXIS_DESCR STD_AXIS iSasZentr.iSchaltend.n_tkf UMR_U_MIN_32_1_0_S6_S3 8 0 8160 DEPOSIT ABSOLUTE MONOTONY MON_INCREASE /end AXIS_DESCR
 /begin AXIS_DESCR STD_AXIS zff_atsys._.iSignale._.obj.sig_m_t UMR_NM__1_1_0_S6_S3 10 -400 1640 DEPOSIT ABSOLUTE MONOTONY MON_INCREASE /end AXIS_DESCR
/end CHARACTERISTIC
/begin CHARACTERISTIC F_PRA12 "Druckfaktor waehrend Rampe auf Schaltdruck" VALUE 0x26E849 kw_ui8_S6_S3 1 UMR___1_100_0_S6_S3 0 1 /end CHARACTERISTIC
/begin CHARACTERISTIC F_PRA12_EL "Druckfaktor waehrend Rampe auf Schaltdruck" VALUE 0x26E84A kw_ui8_S6_S3 1 UMR___1_100_0_S6_S3 0 1 /end CHARACTERISTIC
/begin CHARACTERISTIC F_TRA12 "Zeitfaktor waehrend Rampe auf Schaltdruck" VALUE 0x26E84B kw_ui8_S6_S3 1 UMR___1_100_0_S6_S3 0 1 /end CHARACTERISTIC
/begin CHARACTERISTIC F_TRA12_EL "Zeitfaktor waehrend Rampe auf Schaltdruck" VALUE 0x26E84C kw_ui8_S6_S3 1 UMR___1_100_0_S6_S3 0 1 /end CHARACTERISTIC
/begin CHARACTERISTIC KF_PGOKZUMTNT12 "Schaltdruckgradient" MAP 0x24F0BC kf_si16_S6_S3 200 UMR_BAR_SEC_1_10_0_S6_S3 -100 100
 /begin AXIS_DESCR STD_AXIS zff_atsys._.iSignale._.obj.sig_m_t UMR_NM__1_1_0_S6_S3 6 -400 1640 DEPOSIT ABSOLUTE MONOTONY MON_INCREASE /end AXIS_DESCR
 /begin AXIS_DESCR STD_AXIS zff_atsys._.iSignale._.obj.sig_n_t UMR_U_MIN_1_1_0_S6_S3 4 0 8160 DEPOSIT ABSOLUTE MONOTONY MON_INCREASE /end AXIS_DESCR
/end CHARACTERISTIC
/begin CHARACTERISTIC KF_PGOKZUMTNT12_EL "Schaltdruckgradient" MAP 0x24F108 kf_si16_S6_S3 200 UMR_BAR_SEC_1_10_0_S6_S3 -100 100
 /begin AXIS_DESCR STD_AXIS zff_atsys._.iSignale._.obj.sig_m_t UMR_NM__1_1_0_S6_S3 6 -400 1640 DEPOSIT ABSOLUTE MONOTONY MON_INCREASE /end AXIS_DESCR
 /begin AXIS_DESCR STD_AXIS zff_atsys._.iSignale._.obj.sig_n_t UMR_U_MIN_1_1_0_S6_S3 4 0 8160 DEPOSIT ABSOLUTE MONOTONY MON_INCREASE /end AXIS_DESCR
/end CHARACTERISTIC
/begin CHARACTERISTIC KF_POKZUMTCG12 "Schaltdruckoffset" MAP 0x24F154 kf_si16_S6_S3 12.75 UMR_BAR__1_1000_0_S6_S3 -6.4 6.35
 /begin AXIS_DESCR STD_AXIS zff_atsys._.iSignale._.obj.sig_m_t UMR_NM__1_1_0_S6_S3 8 -400 1640 DEPOSIT ABSOLUTE MONOTONY MON_INCREASE /end AXIS_DESCR
 /begin AXIS_DESCR STD_AXIS zff_atsys._.iSignale._.obj.sig_c_getr UMR_GRADC__1_1_M40_S6_S3 10 -40 150 DEPOSIT ABSOLUTE MONOTONY MON_INCREASE /end AXIS_DESCR
/end CHARACTERISTIC
/begin CHARACTERISTIC KF_POKZUMTCG12_EL "Schaltdruckoffset" MAP 0x24F220 kf_si16_S6_S3 12.75 UMR_BAR__1_1000_0_S6_S3 -6.4 6.35
 /begin AXIS_DESCR STD_AXIS zff_atsys._.iSignale._.obj.sig_m_t UMR_NM__1_1_0_S6_S3 8 -400 1640 DEPOSIT ABSOLUTE MONOTONY MON_INCREASE /end AXIS_DESCR
 /begin AXIS_DESCR STD_AXIS zff_atsys._.iSignale._.obj.sig_c_getr UMR_GRADC__1_1_M40_S6_S3 10 -40 150 DEPOSIT ABSOLUTE MONOTONY MON_INCREASE /end AXIS_DESCR
/end CHARACTERISTIC
/begin CHARACTERISTIC KL_TSYNMTRAKZU23 "Zeit vor sync. Ende Schaltdruck/Start 3. Rampe KZU" CURVE 0x24F2EC kl_ui8_S6_S3 1280 UMR_MSEC__10_1_M128_S6_S3 -1280 0
 /begin AXIS_DESCR STD_AXIS zff_atsys._.iSignale._.obj.sig_m_t8 UMR_NM__8_1_M50_S6_S3 4 -400 1640 DEPOSIT ABSOLUTE MONOTONY MON_INCREASE /end AXIS_DESCR
/end CHARACTERISTIC
/begin CHARACTERISTIC KL_TSYNMTRAKZU23_EL "Zeit vor sync. Ende Schaltdruck/Start 3. Rampe KZU" CURVE 0x24F2F8 kl_ui8_S6_S3 1280 UMR_MSEC__10_1_M128_S6_S3 -1280 0
 /begin AXIS_DESCR STD_AXIS zff_atsys._.iSignale._.obj.sig_m_t8 UMR_NM__8_1_M50_S6_S3 4 -400 1640 DEPOSIT ABSOLUTE MONOTONY MON_INCREASE /end AXIS_DESCR
/end CHARACTERISTIC
/begin CHARACTERISTIC KF_TFCGNT23 "Fuellzeit" MAP 0x24F304 kf_ui8_S6_S3 2540 UMR_MSEC__10_1_0_S6_S3 0 2540
 /begin AXIS_DESCR STD_AXIS zff_atsys._.iSignale._.obj.sig_c_getr UMR_GRADC__1_1_M40_S6_S3 6 -40 150 DEPOSIT ABSOLUTE MONOTONY MON_INCREASE /end AXIS_DESCR
 /begin AXIS_DESCR STD_AXIS zff_atsys._.iSignale._.obj.sig_n_t8 UMR_U_MIN_32_1_0_S6_S3 3 0 8160 DEPOSIT ABSOLUTE MONOTONY MON_INCREASE /end AXIS_DESCR
/end CHARACTERISTIC
/begin CHARACTERISTIC KF_TFCGNT23_EL "Fuellzeit" MAP 0x24F328 kf_ui8_S6_S3 2540 UMR_MSEC__10_1_0_S6_S3 0 2540
 /begin AXIS_DESCR STD_AXIS zff_atsys._.iSignale._.obj.sig_c_getr UMR_GRADC__1_1_M40_S6_S3 6 -40 150 DEPOSIT ABSOLUTE MONOTONY MON_INCREASE /end AXIS_DESCR
 /begin AXIS_DESCR STD_AXIS zff_atsys._.iSignale._.obj.sig_n_t8 UMR_U_MIN_32_1_0_S6_S3 3 0 8160 DEPOSIT ABSOLUTE MONOTONY MON_INCREASE /end AXIS_DESCR
/end CHARACTERISTIC
/begin CHARACTERISTIC T_VKZU23 "Verzoegerungszeit zuschaltende Kupplung nach Schaltbeginn" VALUE 0x26E84D kw_ui8_S6_S3 2540 UMR_MSEC__10_1_0_S6_S3 0 2540 /end CHARACTERISTIC
/begin CHARACTERISTIC T_VKZU23_EL "Verzoegerungszeit zuschaltende Kupplung nach Schaltbeginn" VALUE 0x26E84E kw_ui8_S6_S3 2540 UMR_MSEC__10_1_0_S6_S3 0 2540 /end CHARACTERISTIC
/begin CHARACTERISTIC KF_POFMTN23 "Kennfeld Fuelldruckoffset(n_t, m_t)" MAP 0x24F34C kf_si16_S6_S3 12.75 UMR_BAR__1_1000_0_S6_S3 -6.4 6.35
 /begin AXIS_DESCR STD_AXIS zff_atsys._.iSignale._.obj.sig_n_t UMR_U_MIN_1_1_0_S6_S3 4 0 8160 DEPOSIT ABSOLUTE MONOTONY MON_INCREASE /end AXIS_DESCR
 /begin AXIS_DESCR STD_AXIS zff_atsys._.iSignale._.obj.sig_m_t UMR_NM__1_1_0_S6_S3 6 -400 1640 DEPOSIT ABSOLUTE MONOTONY MON_INCREASE /end AXIS_DESCR
/end CHARACTERISTIC
/begin CHARACTERISTIC KF_POFMTN23_EL "Kennfeld Fuelldruckoffset(n_t, m_t)" MAP 0x24F398 kf_si16_S6_S3 12.75 UMR_BAR__1_1000_0_S6_S3 -6.4 6.35
 /begin AXIS_DESCR STD_AXIS zff_atsys._.iSignale._.obj.sig_n_t UMR_U_MIN_1_1_0_S6_S3 4 0 8160 DEPOSIT ABSOLUTE MONOTONY MON_INCREASE /end AXIS_DESCR
 /begin AXIS_DESCR STD_AXIS zff_atsys._.iSignale._.obj.sig_m_t UMR_NM__1_1_0_S6_S3 6 -400 1640 DEPOSIT ABSOLUTE MONOTONY MON_INCREASE /end AXIS_DESCR
/end CHARACTERISTIC
/begin CHARACTERISTIC KF_T_DT_IG_CHANGE23 "Kennfeld Zeitvorhalt für Übergabe Rampenzeit auf Schaltdruck" MAP 0x24F3E4 kf_si16_S6_S3 5080 UMR_MSEC__10_1_0_S6_S3 -2540 2540
 /begin AXIS_DESCR STD_AXIS zff_atsys._.iSignale._.obj.sig_n_t UMR_U_MIN_1_1_0_S6_S3 4 0 8160 DEPOSIT ABSOLUTE MONOTONY MON_INCREASE /end AXIS_DESCR
 /begin AXIS_DESCR STD_AXIS zff_atsys._.iSignale._.obj.sig_m_t UMR_NM__1_1_0_S6_S3 4 -400 1640 DEPOSIT ABSOLUTE MONOTONY MON_INCREASE /end AXIS_DESCR
/end CHARACTERISTIC
/begin CHARACTERISTIC KF_T_DT_IG_CHANGE23_EL "Kennfeld Zeitvorhalt für Übergabe Rampenzeit auf Schaltdruck" MAP 0x24F41C kf_si16_S6_S3 5080 UMR_MSEC__10_1_0_S6_S3 -2540 2540
 /begin AXIS_DESCR STD_AXIS zff_atsys._.iSignale._.obj.sig_n_t UMR_U_MIN_1_1_0_S6_S3 4 0 8160 DEPOSIT ABSOLUTE MONOTONY MON_INCREASE /end AXIS_DESCR
 /begin AXIS_DESCR STD_AXIS zff_atsys._.iSignale._.obj.sig_m_t UMR_NM__1_1_0_S6_S3 4 -400 1640 DEPOSIT ABSOLUTE MONOTONY MON_INCREASE /end AXIS_DESCR
/end CHARACTERISTIC
/begin CHARACTERISTIC KF_T2_DT_IG_CHANGE23 "2. Kennfeld Zeitvorhalt für Übergabe Rampenzeit auf Schaltdruck" MAP 0x24F454 kf_si16_S6_S3 5080 UMR_MSEC__10_1_0_S6_S3 -2540 2540
 /begin AXIS_DESCR STD_AXIS zff_atsys._.iSignale._.obj.sig_n_t UMR_U_MIN_1_1_0_S6_S3 4 0 8160 DEPOSIT ABSOLUTE MONOTONY MON_INCREASE /end AXIS_DESCR
 /begin AXIS_DESCR STD_AXIS zff_atsys._.iSignale._.obj.sig_m_t UMR_NM__1_1_0_S6_S3 4 -400 1640 DEPOSIT ABSOLUTE MONOTONY MON_INCREASE /end AXIS_DESCR
/end CHARACTERISTIC
/begin CHARACTERISTIC KF_TRAMTNT23 "Zeit 1. Rampe der zuschaltenden Kupplung" MAP 0x24F48C kf_ui8_S6_S3 2540 UMR_MSEC__10_1_0_S6_S3 0 2540
 /begin AXIS_DESCR STD_AXIS zff_atsys._.iSignale._.obj.sig_m_t8 UMR_NM__8_1_M50_S6_S3 4 -400 1640 DEPOSIT ABSOLUTE MONOTONY MON_INCREASE /end AXIS_DESCR
 /begin AXIS_DESCR STD_AXIS zff_atsys._.iSignale._.obj.sig_n_t8 UMR_U_MIN_32_1_0_S6_S3 4 0 8160 DEPOSIT ABSOLUTE MONOTONY MON_INCREASE /end AXIS_DESCR
/end CHARACTERISTIC
/begin CHARACTERISTIC KF_TRAMTNT23_EL "Zeit 1. Rampe der zuschaltenden Kupplung" MAP 0x24F4AC kf_ui8_S6_S3 2540 UMR_MSEC__10_1_0_S6_S3 0 2540
 /begin AXIS_DESCR STD_AXIS zff_atsys._.iSignale._.obj.sig_m_t8 UMR_NM__8_1_M50_S6_S3 4 -400 1640 DEPOSIT ABSOLUTE MONOTONY MON_INCREASE /end AXIS_DESCR
 /begin AXIS_DESCR STD_AXIS zff_atsys._.iSignale._.obj.sig_n_t8 UMR_U_MIN_32_1_0_S6_S3 4 0 8160 DEPOSIT ABSOLUTE MONOTONY MON_INCREASE /end AXIS_DESCR
/end CHARACTERISTIC
/begin CHARACTERISTIC KF_PKZU23 "Schaltdruck zuschaltende Kupplung" MAP 0x24F4CC kf_si16_S6_S3 12.75 UMR_BAR__1_1000_0_S6_S3 0 12.75
 /begin AXIS_DESCR STD_AXIS iSasZentr.iSchaltend.n_tkf UMR_U_MIN_32_1_0_S6_S3 8 0 8160 DEPOSIT ABSOLUTE MONOTONY MON_INCREASE /end AXIS_DESCR
 /begin AXIS_DESCR STD_AXIS zff_atsys._.iSignale._.obj.sig_m_t UMR_NM__1_1_0_S6_S3 10 -400 1640 DEPOSIT ABSOLUTE MONOTONY MON_INCREASE /end AXIS_DESCR
/end CHARACTERISTIC
/begin CHARACTERISTIC KF_PKZU23_EL "Schaltdruck zuschaltende Kupplung" MAP 0x24F598 kf_si16_S6_S3 12.75 UMR_BAR__1_1000_0_S6_S3 0 12.75
 /begin AXIS_DESCR STD_AXIS iSasZentr.iSchaltend.n_tkf UMR_U_MIN_32_1_0_S6_S3 8 0 8160 DEPOSIT ABSOLUTE MONOTONY MON_INCREASE /end AXIS_DESCR
 /begin AXIS_DESCR STD_AXIS zff_atsys._.iSignale._.obj.sig_m_t UMR_NM__1_1_0_S6_S3 10 -400 1640 DEPOSIT ABSOLUTE MONOTONY MON_INCREASE /end AXIS_DESCR
/end CHARACTERISTIC
/begin CHARACTERISTIC F_PRA23 "Druckfaktor waehrend Rampe auf Schaltdruck" VALUE 0x26E84F kw_ui8_S6_S3 1 UMR___1_100_0_S6_S3 0 1 /end CHARACTERISTIC
/begin CHARACTERISTIC F_PRA23_EL "Druckfaktor waehrend Rampe auf Schaltdruck" VALUE 0x26E850 kw_ui8_S6_S3 1 UMR___1_100_0_S6_S3 0 1 /end CHARACTERISTIC
/begin CHARACTERISTIC F_TRA23 "Zeitfaktor waehrend Rampe auf Schaltdruck" VALUE 0x26E851 kw_ui8_S6_S3 1 UMR___1_100_0_S6_S3 0 1 /end CHARACTERISTIC
/begin CHARACTERISTIC F_TRA23_EL "Zeitfaktor waehrend Rampe auf Schaltdruck" VALUE 0x26E852 kw_ui8_S6_S3 1 UMR___1_100_0_S6_S3 0 1 /end CHARACTERISTIC
/begin CHARACTERISTIC KF_PGOKZUMTNT23 "Schaltdruckgradient" MAP 0x24F664 kf_si16_S6_S3 200 UMR_BAR_SEC_1_10_0_S6_S3 -100 100
 /begin AXIS_DESCR STD_AXIS zff_atsys._.iSignale._.obj.sig_m_t UMR_NM__1_1_0_S6_S3 6 -400 1640 DEPOSIT ABSOLUTE MONOTONY MON_INCREASE /end AXIS_DESCR
 /begin AXIS_DESCR STD_AXIS zff_atsys._.iSignale._.obj.sig_n_t UMR_U_MIN_1_1_0_S6_S3 4 0 8160 DEPOSIT ABSOLUTE MONOTONY MON_INCREASE /end AXIS_DESCR
/end CHARACTERISTIC
/begin CHARACTERISTIC KF_PGOKZUMTNT23_EL "Schaltdruckgradient" MAP 0x24F6B0 kf_si16_S6_S3 200 UMR_BAR_SEC_1_10_0_S6_S3 -100 100
 /begin AXIS_DESCR STD_AXIS zff_atsys._.iSignale._.obj.sig_m_t UMR_NM__1_1_0_S6_S3 6 -400 1640 DEPOSIT ABSOLUTE MONOTONY MON_INCREASE /end AXIS_DESCR
 /begin AXIS_DESCR STD_AXIS zff_atsys._.iSignale._.obj.sig_n_t UMR_U_MIN_1_1_0_S6_S3 4 0 8160 DEPOSIT ABSOLUTE MONOTONY MON_INCREASE /end AXIS_DESCR
/end CHARACTERISTIC
/begin CHARACTERISTIC KF_POKZUMTCG23 "Schaltdruckoffset" MAP 0x24F6FC kf_si16_S6_S3 12.75 UMR_BAR__1_1000_0_S6_S3 -6.4 6.35
 /begin AXIS_DESCR STD_AXIS zff_atsys._.iSignale._.obj.sig_m_t UMR_NM__1_1_0_S6_S3 8 -400 1640 DEPOSIT ABSOLUTE MONOTONY MON_INCREASE /end AXIS_DESCR
 /begin AXIS_DESCR STD_AXIS zff_atsys._.iSignale._.obj.sig_c_getr UMR_GRADC__1_1_M40_S6_S3 10 -40 150 DEPOSIT ABSOLUTE MONOTONY MON_INCREASE /end AXIS_DESCR
/end CHARACTERISTIC
/begin CHARACTERISTIC KF_POKZUMTCG23_EL "Schaltdruckoffset" MAP 0x24F7C8 kf_si16_S6_S3 12.75 UMR_BAR__1_1000_0_S6_S3 -6.4 6.35
 /begin AXIS_DESCR STD_AXIS zff_atsys._.iSignale._.obj.sig_m_t UMR_NM__1_1_0_S6_S3 8 -400 1640 DEPOSIT ABSOLUTE MONOTONY MON_INCREASE /end AXIS_DESCR
 /begin AXIS_DESCR STD_AXIS zff_atsys._.iSignale._.obj.sig_c_getr UMR_GRADC__1_1_M40_S6_S3 10 -40 150 DEPOSIT ABSOLUTE MONOTONY MON_INCREASE /end AXIS_DESCR
/end CHARACTERISTIC
/begin CHARACTERISTIC KL_TSYNMTRAKZU34 "Zeit vor sync. Ende Schaltdruck/Start 3. Rampe KZU" CURVE 0x24F894 kl_ui8_S6_S3 1280 UMR_MSEC__10_1_M128_S6_S3 -1280 0
 /begin AXIS_DESCR STD_AXIS zff_atsys._.iSignale._.obj.sig_m_t8 UMR_NM__8_1_M50_S6_S3 4 -400 1640 DEPOSIT ABSOLUTE MONOTONY MON_INCREASE /end AXIS_DESCR
/end CHARACTERISTIC
/begin CHARACTERISTIC KL_TSYNMTRAKZU34_EL "Zeit vor sync. Ende Schaltdruck/Start 3. Rampe KZU" CURVE 0x24F8A0 kl_ui8_S6_S3 1280 UMR_MSEC__10_1_M128_S6_S3 -1280 0
 /begin AXIS_DESCR STD_AXIS zff_atsys._.iSignale._.obj.sig_m_t8 UMR_NM__8_1_M50_S6_S3 4 -400 1640 DEPOSIT ABSOLUTE MONOTONY MON_INCREASE /end AXIS_DESCR
/end CHARACTERISTIC
/begin CHARACTERISTIC KF_TFCGNT34 "Fuellzeit" MAP 0x24F8AC kf_ui8_S6_S3 2540 UMR_MSEC__10_1_0_S6_S3 0 2540
 /begin AXIS_DESCR STD_AXIS zff_atsys._.iSignale._.obj.sig_c_getr UMR_GRADC__1_1_M40_S6_S3 6 -40 150 DEPOSIT ABSOLUTE MONOTONY MON_INCREASE /end AXIS_DESCR
 /begin AXIS_DESCR STD_AXIS zff_atsys._.iSignale._.obj.sig_n_t8 UMR_U_MIN_32_1_0_S6_S3 3 0 8160 DEPOSIT ABSOLUTE MONOTONY MON_INCREASE /end AXIS_DESCR
/end CHARACTERISTIC
/begin CHARACTERISTIC KF_TFCGNT34_EL "Fuellzeit" MAP 0x24F8D0 kf_ui8_S6_S3 2540 UMR_MSEC__10_1_0_S6_S3 0 2540
 /begin AXIS_DESCR STD_AXIS zff_atsys._.iSignale._.obj.sig_c_getr UMR_GRADC__1_1_M40_S6_S3 6 -40 150 DEPOSIT ABSOLUTE MONOTONY MON_INCREASE /end AXIS_DESCR
 /begin AXIS_DESCR STD_AXIS zff_atsys._.iSignale._.obj.sig_n_t8 UMR_U_MIN_32_1_0_S6_S3 3 0 8160 DEPOSIT ABSOLUTE MONOTONY MON_INCREASE /end AXIS_DESCR
/end CHARACTERISTIC
/begin CHARACTERISTIC T_VKZU34 "Verzoegerungszeit zuschaltende Kupplung nach Schaltbeginn" VALUE 0x26E853 kw_ui8_S6_S3 2540 UMR_MSEC__10_1_0_S6_S3 0 2540 /end CHARACTERISTIC
/begin CHARACTERISTIC T_VKZU34_EL "Verzoegerungszeit zuschaltende Kupplung nach Schaltbeginn" VALUE 0x26E854 kw_ui8_S6_S3 2540 UMR_MSEC__10_1_0_S6_S3 0 2540 /end CHARACTERISTIC
/begin CHARACTERISTIC KF_POFMTN34 "Kennfeld Fuelldruckoffset(n_t, m_t)" MAP 0x24F8F4 kf_si16_S6_S3 12.75 UMR_BAR__1_1000_0_S6_S3 -6.4 6.35
 /begin AXIS_DESCR STD_AXIS zff_atsys._.iSignale._.obj.sig_n_t UMR_U_MIN_1_1_0_S6_S3 4 0 8160 DEPOSIT ABSOLUTE MONOTONY MON_INCREASE /end AXIS_DESCR
 /begin AXIS_DESCR STD_AXIS zff_atsys._.iSignale._.obj.sig_m_t UMR_NM__1_1_0_S6_S3 6 -400 1640 DEPOSIT ABSOLUTE MONOTONY MON_INCREASE /end AXIS_DESCR
/end CHARACTERISTIC
/begin CHARACTERISTIC KF_POFMTN34_EL "Kennfeld Fuelldruckoffset(n_t, m_t)" MAP 0x24F940 kf_si16_S6_S3 12.75 UMR_BAR__1_1000_0_S6_S3 -6.4 6.35
 /begin AXIS_DESCR STD_AXIS zff_atsys._.iSignale._.obj.sig_n_t UMR_U_MIN_1_1_0_S6_S3 4 0 8160 DEPOSIT ABSOLUTE MONOTONY MON_INCREASE /end AXIS_DESCR
 /begin AXIS_DESCR STD_AXIS zff_atsys._.iSignale._.obj.sig_m_t UMR_NM__1_1_0_S6_S3 6 -400 1640 DEPOSIT ABSOLUTE MONOTONY MON_INCREASE /end AXIS_DESCR
/end CHARACTERISTIC
/begin CHARACTERISTIC KF_T_DT_IG_CHANGE34 "Kennfeld Zeitvorhalt für Übergabe Rampenzeit auf Schaltdruck" MAP 0x24F98C kf_si16_S6_S3 5080 UMR_MSEC__10_1_0_S6_S3 -2540 2540
 /begin AXIS_DESCR STD_AXIS zff_atsys._.iSignale._.obj.sig_n_t UMR_U_MIN_1_1_0_S6_S3 4 0 8160 DEPOSIT ABSOLUTE MONOTONY MON_INCREASE /end AXIS_DESCR
 /begin AXIS_DESCR STD_AXIS zff_atsys._.iSignale._.obj.sig_m_t UMR_NM__1_1_0_S6_S3 4 -400 1640 DEPOSIT ABSOLUTE MONOTONY MON_INCREASE /end AXIS_DESCR
/end CHARACTERISTIC
/begin CHARACTERISTIC KF_T_DT_IG_CHANGE34_EL "Kennfeld Zeitvorhalt für Übergabe Rampenzeit auf Schaltdruck" MAP 0x24F9C4 kf_si16_S6_S3 5080 UMR_MSEC__10_1_0_S6_S3 -2540 2540
 /begin AXIS_DESCR STD_AXIS zff_atsys._.iSignale._.obj.sig_n_t UMR_U_MIN_1_1_0_S6_S3 4 0 8160 DEPOSIT ABSOLUTE MONOTONY MON_INCREASE /end AXIS_DESCR
 /begin AXIS_DESCR STD_AXIS zff_atsys._.iSignale._.obj.sig_m_t UMR_NM__1_1_0_S6_S3 4 -400 1640 DEPOSIT ABSOLUTE MONOTONY MON_INCREASE /end AXIS_DESCR
/end CHARACTERISTIC
/begin CHARACTERISTIC KF_T2_DT_IG_CHANGE34 "2. Kennfeld Zeitvorhalt für Übergabe Rampenzeit auf Schaltdruck" MAP 0x24F9FC kf_si16_S6_S3 5080 UMR_MSEC__10_1_0_S6_S3 -2540 2540
 /begin AXIS_DESCR STD_AXIS zff_atsys._.iSignale._.obj.sig_n_t UMR_U_MIN_1_1_0_S6_S3 4 0 8160 DEPOSIT ABSOLUTE MONOTONY MON_INCREASE /end AXIS_DESCR
 /begin AXIS_DESCR STD_AXIS zff_atsys._.iSignale._.obj.sig_m_t UMR_NM__1_1_0_S6_S3 4 -400 1640 DEPOSIT ABSOLUTE MONOTONY MON_INCREASE /end AXIS_DESCR
/end CHARACTERISTIC
/begin CHARACTERISTIC KF_TRAMTNT34 "Zeit 1. Rampe der zuschaltenden Kupplung" MAP 0x24FA34 kf_ui8_S6_S3 2540 UMR_MSEC__10_1_0_S6_S3 0 2540
 /begin AXIS_DESCR STD_AXIS zff_atsys._.iSignale._.obj.sig_m_t8 UMR_NM__8_1_M50_S6_S3 4 -400 1640 DEPOSIT ABSOLUTE MONOTONY MON_INCREASE /end AXIS_DESCR
 /begin AXIS_DESCR STD_AXIS zff_atsys._.iSignale._.obj.sig_n_t8 UMR_U_MIN_32_1_0_S6_S3 4 0 8160 DEPOSIT ABSOLUTE MONOTONY MON_INCREASE /end AXIS_DESCR
/end CHARACTERISTIC
/begin CHARACTERISTIC KF_TRAMTNT34_EL "Zeit 1. Rampe der zuschaltenden Kupplung" MAP 0x24FA54 kf_ui8_S6_S3 2540 UMR_MSEC__10_1_0_S6_S3 0 2540
 /begin AXIS_DESCR STD_AXIS zff_atsys._.iSignale._.obj.sig_m_t8 UMR_NM__8_1_M50_S6_S3 4 -400 1640 DEPOSIT ABSOLUTE MONOTONY MON_INCREASE /end AXIS_DESCR
 /begin AXIS_DESCR STD_AXIS zff_atsys._.iSignale._.obj.sig_n_t8 UMR_U_MIN_32_1_0_S6_S3 4 0 8160 DEPOSIT ABSOLUTE MONOTONY MON_INCREASE /end AXIS_DESCR
/end CHARACTERISTIC
/begin CHARACTERISTIC KF_PKZU34 "Schaltdruck zuschaltende Kupplung" MAP 0x24FA74 kf_si16_S6_S3 12.75 UMR_BAR__1_1000_0_S6_S3 0 12.75
 /begin AXIS_DESCR STD_AXIS iSasZentr.iSchaltend.n_tkf UMR_U_MIN_32_1_0_S6_S3 8 0 8160 DEPOSIT ABSOLUTE MONOTONY MON_INCREASE /end AXIS_DESCR
 /begin AXIS_DESCR STD_AXIS zff_atsys._.iSignale._.obj.sig_m_t UMR_NM__1_1_0_S6_S3 10 -400 1640 DEPOSIT ABSOLUTE MONOTONY MON_INCREASE /end AXIS_DESCR
/end CHARACTERISTIC
/begin CHARACTERISTIC KF_PKZU34_EL "Schaltdruck zuschaltende Kupplung" MAP 0x24FB40 kf_si16_S6_S3 12.75 UMR_BAR__1_1000_0_S6_S3 0 12.75
 /begin AXIS_DESCR STD_AXIS iSasZentr.iSchaltend.n_tkf UMR_U_MIN_32_1_0_S6_S3 8 0 8160 DEPOSIT ABSOLUTE MONOTONY MON_INCREASE /end AXIS_DESCR
 /begin AXIS_DESCR STD_AXIS zff_atsys._.iSignale._.obj.sig_m_t UMR_NM__1_1_0_S6_S3 10 -400 1640 DEPOSIT ABSOLUTE MONOTONY MON_INCREASE /end AXIS_DESCR
/end CHARACTERISTIC
/begin CHARACTERISTIC F_PRA34 "Druckfaktor waehrend Rampe auf Schaltdruck" VALUE 0x26E855 kw_ui8_S6_S3 1 UMR___1_100_0_S6_S3 0 1 /end CHARACTERISTIC
/begin CHARACTERISTIC F_PRA34_EL "Druckfaktor waehrend Rampe auf Schaltdruck" VALUE 0x26E856 kw_ui8_S6_S3 1 UMR___1_100_0_S6_S3 0 1 /end CHARACTERISTIC
/begin CHARACTERISTIC F_TRA34 "Zeitfaktor waehrend Rampe auf Schaltdruck" VALUE 0x26E857 kw_ui8_S6_S3 1 UMR___1_100_0_S6_S3 0 1 /end CHARACTERISTIC
/begin CHARACTERISTIC F_TRA34_EL "Zeitfaktor waehrend Rampe auf Schaltdruck" VALUE 0x26E858 kw_ui8_S6_S3 1 UMR___1_100_0_S6_S3 0 1 /end CHARACTERISTIC
/begin CHARACTERISTIC KF_PGOKZUMTNT34 "Schaltdruckgradient" MAP 0x24FC0C kf_si16_S6_S3 200 UMR_BAR_SEC_1_10_0_S6_S3 -100 100
 /begin AXIS_DESCR STD_AXIS zff_atsys._.iSignale._.obj.sig_m_t UMR_NM__1_1_0_S6_S3 6 -400 1640 DEPOSIT ABSOLUTE MONOTONY MON_INCREASE /end AXIS_DESCR
 /begin AXIS_DESCR STD_AXIS zff_atsys._.iSignale._.obj.sig_n_t UMR_U_MIN_1_1_0_S6_S3 4 0 8160 DEPOSIT ABSOLUTE MONOTONY MON_INCREASE /end AXIS_DESCR
/end CHARACTERISTIC
/begin CHARACTERISTIC KF_PGOKZUMTNT34_EL "Schaltdruckgradient" MAP 0x24FC58 kf_si16_S6_S3 200 UMR_BAR_SEC_1_10_0_S6_S3 -100 100
 /begin AXIS_DESCR STD_AXIS zff_atsys._.iSignale._.obj.sig_m_t UMR_NM__1_1_0_S6_S3 6 -400 1640 DEPOSIT ABSOLUTE MONOTONY MON_INCREASE /end AXIS_DESCR
 /begin AXIS_DESCR STD_AXIS zff_atsys._.iSignale._.obj.sig_n_t UMR_U_MIN_1_1_0_S6_S3 4 0 8160 DEPOSIT ABSOLUTE MONOTONY MON_INCREASE /end AXIS_DESCR
/end CHARACTERISTIC
/begin CHARACTERISTIC KF_POKZUMTCG34 "Schaltdruckoffset" MAP 0x24FCA4 kf_si16_S6_S3 12.75 UMR_BAR__1_1000_0_S6_S3 -6.4 6.35
 /begin AXIS_DESCR STD_AXIS zff_atsys._.iSignale._.obj.sig_m_t UMR_NM__1_1_0_S6_S3 8 -400 1640 DEPOSIT ABSOLUTE MONOTONY MON_INCREASE /end AXIS_DESCR
 /begin AXIS_DESCR STD_AXIS zff_atsys._.iSignale._.obj.sig_c_getr UMR_GRADC__1_1_M40_S6_S3 10 -40 150 DEPOSIT ABSOLUTE MONOTONY MON_INCREASE /end AXIS_DESCR
/end CHARACTERISTIC
/begin CHARACTERISTIC KF_POKZUMTCG34_EL "Schaltdruckoffset" MAP 0x24FD70 kf_si16_S6_S3 12.75 UMR_BAR__1_1000_0_S6_S3 -6.4 6.35
 /begin AXIS_DESCR STD_AXIS zff_atsys._.iSignale._.obj.sig_m_t UMR_NM__1_1_0_S6_S3 8 -400 1640 DEPOSIT ABSOLUTE MONOTONY MON_INCREASE /end AXIS_DESCR
 /begin AXIS_DESCR STD_AXIS zff_atsys._.iSignale._.obj.sig_c_getr UMR_GRADC__1_1_M40_S6_S3 10 -40 150 DEPOSIT ABSOLUTE MONOTONY MON_INCREASE /end AXIS_DESCR
/end CHARACTERISTIC
/begin CHARACTERISTIC KL_TSYNMTRAKZU45 "Zeit vor sync. Ende Schaltdruck/Start 3. Rampe KZU" CURVE 0x24FE3C kl_ui8_S6_S3 1280 UMR_MSEC__10_1_M128_S6_S3 -1280 0
 /begin AXIS_DESCR STD_AXIS zff_atsys._.iSignale._.obj.sig_m_t8 UMR_NM__8_1_M50_S6_S3 4 -400 1640 DEPOSIT ABSOLUTE MONOTONY MON_INCREASE /end AXIS_DESCR
/end CHARACTERISTIC
/begin CHARACTERISTIC KL_TSYNMTRAKZU45_EL "Zeit vor sync. Ende Schaltdruck/Start 3. Rampe KZU" CURVE 0x24FE48 kl_ui8_S6_S3 1280 UMR_MSEC__10_1_M128_S6_S3 -1280 0
 /begin AXIS_DESCR STD_AXIS zff_atsys._.iSignale._.obj.sig_m_t8 UMR_NM__8_1_M50_S6_S3 4 -400 1640 DEPOSIT ABSOLUTE MONOTONY MON_INCREASE /end AXIS_DESCR
/end CHARACTERISTIC
/begin CHARACTERISTIC KF_TFCGNT45 "Fuellzeit" MAP 0x24FE54 kf_ui8_S6_S3 2540 UMR_MSEC__10_1_0_S6_S3 0 2540
 /begin AXIS_DESCR STD_AXIS zff_atsys._.iSignale._.obj.sig_c_getr UMR_GRADC__1_1_M40_S6_S3 6 -40 150 DEPOSIT ABSOLUTE MONOTONY MON_INCREASE /end AXIS_DESCR
 /begin AXIS_DESCR STD_AXIS zff_atsys._.iSignale._.obj.sig_n_t8 UMR_U_MIN_32_1_0_S6_S3 3 0 8160 DEPOSIT ABSOLUTE MONOTONY MON_INCREASE /end AXIS_DESCR
/end CHARACTERISTIC
/begin CHARACTERISTIC KF_TFCGNT45_EL "Fuellzeit" MAP 0x24FE78 kf_ui8_S6_S3 2540 UMR_MSEC__10_1_0_S6_S3 0 2540
 /begin AXIS_DESCR STD_AXIS zff_atsys._.iSignale._.obj.sig_c_getr UMR_GRADC__1_1_M40_S6_S3 6 -40 150 DEPOSIT ABSOLUTE MONOTONY MON_INCREASE /end AXIS_DESCR
 /begin AXIS_DESCR STD_AXIS zff_atsys._.iSignale._.obj.sig_n_t8 UMR_U_MIN_32_1_0_S6_S3 3 0 8160 DEPOSIT ABSOLUTE MONOTONY MON_INCREASE /end AXIS_DESCR
/end CHARACTERISTIC
/begin CHARACTERISTIC T_VKZU45 "Verzoegerungszeit zuschaltende Kupplung nach Schaltbeginn" VALUE 0x26E859 kw_ui8_S6_S3 2540 UMR_MSEC__10_1_0_S6_S3 0 2540 /end CHARACTERISTIC
/begin CHARACTERISTIC T_VKZU45_EL "Verzoegerungszeit zuschaltende Kupplung nach Schaltbeginn" VALUE 0x26E85A kw_ui8_S6_S3 2540 UMR_MSEC__10_1_0_S6_S3 0 2540 /end CHARACTERISTIC
/begin CHARACTERISTIC KF_POFMTN45 "Kennfeld Fuelldruckoffset(n_t, m_t)" MAP 0x24FE9C kf_si16_S6_S3 12.75 UMR_BAR__1_1000_0_S6_S3 -6.4 6.35
 /begin AXIS_DESCR STD_AXIS zff_atsys._.iSignale._.obj.sig_n_t UMR_U_MIN_1_1_0_S6_S3 4 0 8160 DEPOSIT ABSOLUTE MONOTONY MON_INCREASE /end AXIS_DESCR
 /begin AXIS_DESCR STD_AXIS zff_atsys._.iSignale._.obj.sig_m_t UMR_NM__1_1_0_S6_S3 6 -400 1640 DEPOSIT ABSOLUTE MONOTONY MON_INCREASE /end AXIS_DESCR
/end CHARACTERISTIC
/begin CHARACTERISTIC KF_POFMTN45_EL "Kennfeld Fuelldruckoffset(n_t, m_t)" MAP 0x24FEE8 kf_si16_S6_S3 12.75 UMR_BAR__1_1000_0_S6_S3 -6.4 6.35
 /begin AXIS_DESCR STD_AXIS zff_atsys._.iSignale._.obj.sig_n_t UMR_U_MIN_1_1_0_S6_S3 4 0 8160 DEPOSIT ABSOLUTE MONOTONY MON_INCREASE /end AXIS_DESCR
 /begin AXIS_DESCR STD_AXIS zff_atsys._.iSignale._.obj.sig_m_t UMR_NM__1_1_0_S6_S3 6 -400 1640 DEPOSIT ABSOLUTE MONOTONY MON_INCREASE /end AXIS_DESCR
/end CHARACTERISTIC
/begin CHARACTERISTIC KF_T_DT_IG_CHANGE45 "Kennfeld Zeitvorhalt für Übergabe Rampenzeit auf Schaltdruck" MAP 0x24FF34 kf_si16_S6_S3 5080 UMR_MSEC__10_1_0_S6_S3 -2540 2540
 /begin AXIS_DESCR STD_AXIS zff_atsys._.iSignale._.obj.sig_n_t UMR_U_MIN_1_1_0_S6_S3 4 0 8160 DEPOSIT ABSOLUTE MONOTONY MON_INCREASE /end AXIS_DESCR
 /begin AXIS_DESCR STD_AXIS zff_atsys._.iSignale._.obj.sig_m_t UMR_NM__1_1_0_S6_S3 4 -400 1640 DEPOSIT ABSOLUTE MONOTONY MON_INCREASE /end AXIS_DESCR
/end CHARACTERISTIC
/begin CHARACTERISTIC KF_T_DT_IG_CHANGE45_EL "Kennfeld Zeitvorhalt für Übergabe Rampenzeit auf Schaltdruck" MAP 0x24FF6C kf_si16_S6_S3 5080 UMR_MSEC__10_1_0_S6_S3 -2540 2540
 /begin AXIS_DESCR STD_AXIS zff_atsys._.iSignale._.obj.sig_n_t UMR_U_MIN_1_1_0_S6_S3 4 0 8160 DEPOSIT ABSOLUTE MONOTONY MON_INCREASE /end AXIS_DESCR
 /begin AXIS_DESCR STD_AXIS zff_atsys._.iSignale._.obj.sig_m_t UMR_NM__1_1_0_S6_S3 4 -400 1640 DEPOSIT ABSOLUTE MONOTONY MON_INCREASE /end AXIS_DESCR
/end CHARACTERISTIC
/begin CHARACTERISTIC KF_T2_DT_IG_CHANGE45 "2. Kennfeld Zeitvorhalt für Übergabe Rampenzeit auf Schaltdruck" MAP 0x24FFA4 kf_si16_S6_S3 5080 UMR_MSEC__10_1_0_S6_S3 -2540 2540
 /begin AXIS_DESCR STD_AXIS zff_atsys._.iSignale._.obj.sig_n_t UMR_U_MIN_1_1_0_S6_S3 4 0 8160 DEPOSIT ABSOLUTE MONOTONY MON_INCREASE /end AXIS_DESCR
 /begin AXIS_DESCR STD_AXIS zff_atsys._.iSignale._.obj.sig_m_t UMR_NM__1_1_0_S6_S3 4 -400 1640 DEPOSIT ABSOLUTE MONOTONY MON_INCREASE /end AXIS_DESCR
/end CHARACTERISTIC
/begin CHARACTERISTIC KF_TRAMTNT45 "Zeit 1. Rampe der zuschaltenden Kupplung" MAP 0x24FFDC kf_ui8_S6_S3 2540 UMR_MSEC__10_1_0_S6_S3 0 2540
 /begin AXIS_DESCR STD_AXIS zff_atsys._.iSignale._.obj.sig_m_t8 UMR_NM__8_1_M50_S6_S3 4 -400 1640 DEPOSIT ABSOLUTE MONOTONY MON_INCREASE /end AXIS_DESCR
 /begin AXIS_DESCR STD_AXIS zff_atsys._.iSignale._.obj.sig_n_t8 UMR_U_MIN_32_1_0_S6_S3 4 0 8160 DEPOSIT ABSOLUTE MONOTONY MON_INCREASE /end AXIS_DESCR
/end CHARACTERISTIC
/begin CHARACTERISTIC KF_TRAMTNT45_EL "Zeit 1. Rampe der zuschaltenden Kupplung" MAP 0x24FFFC kf_ui8_S6_S3 2540 UMR_MSEC__10_1_0_S6_S3 0 2540
 /begin AXIS_DESCR STD_AXIS zff_atsys._.iSignale._.obj.sig_m_t8 UMR_NM__8_1_M50_S6_S3 4 -400 1640 DEPOSIT ABSOLUTE MONOTONY MON_INCREASE /end AXIS_DESCR
 /begin AXIS_DESCR STD_AXIS zff_atsys._.iSignale._.obj.sig_n_t8 UMR_U_MIN_32_1_0_S6_S3 4 0 8160 DEPOSIT ABSOLUTE MONOTONY MON_INCREASE /end AXIS_DESCR
/end CHARACTERISTIC
/begin CHARACTERISTIC KF_PKZU45 "Schaltdruck zuschaltende Kupplung" MAP 0x25001C kf_si16_S6_S3 12.75 UMR_BAR__1_1000_0_S6_S3 0 12.75
 /begin AXIS_DESCR STD_AXIS iSasZentr.iSchaltend.n_tkf UMR_U_MIN_32_1_0_S6_S3 8 0 8160 DEPOSIT ABSOLUTE MONOTONY MON_INCREASE /end AXIS_DESCR
 /begin AXIS_DESCR STD_AXIS zff_atsys._.iSignale._.obj.sig_m_t UMR_NM__1_1_0_S6_S3 10 -400 1640 DEPOSIT ABSOLUTE MONOTONY MON_INCREASE /end AXIS_DESCR
/end CHARACTERISTIC
/begin CHARACTERISTIC KF_PKZU45_EL "Schaltdruck zuschaltende Kupplung" MAP 0x2500E8 kf_si16_S6_S3 12.75 UMR_BAR__1_1000_0_S6_S3 0 12.75
 /begin AXIS_DESCR STD_AXIS iSasZentr.iSchaltend.n_tkf UMR_U_MIN_32_1_0_S6_S3 8 0 8160 DEPOSIT ABSOLUTE MONOTONY MON_INCREASE /end AXIS_DESCR
 /begin AXIS_DESCR STD_AXIS zff_atsys._.iSignale._.obj.sig_m_t UMR_NM__1_1_0_S6_S3 10 -400 1640 DEPOSIT ABSOLUTE MONOTONY MON_INCREASE /end AXIS_DESCR
/end CHARACTERISTIC
/begin CHARACTERISTIC F_PRA45 "Druckfaktor waehrend Rampe auf Schaltdruck" VALUE 0x26E85B kw_ui8_S6_S3 1 UMR___1_100_0_S6_S3 0 1 /end CHARACTERISTIC
/begin CHARACTERISTIC F_PRA45_EL "Druckfaktor waehrend Rampe auf Schaltdruck" VALUE 0x26E85C kw_ui8_S6_S3 1 UMR___1_100_0_S6_S3 0 1 /end CHARACTERISTIC
/begin CHARACTERISTIC F_TRA45 "Zeitfaktor waehrend Rampe auf Schaltdruck" VALUE 0x26E85D kw_ui8_S6_S3 1 UMR___1_100_0_S6_S3 0 1 /end CHARACTERISTIC
/begin CHARACTERISTIC F_TRA45_EL "Zeitfaktor waehrend Rampe auf Schaltdruck" VALUE 0x26E85E kw_ui8_S6_S3 1 UMR___1_100_0_S6_S3 0 1 /end CHARACTERISTIC
/begin CHARACTERISTIC KF_PGOKZUMTNT45 "Schaltdruckgradient" MAP 0x2501B4 kf_si16_S6_S3 200 UMR_BAR_SEC_1_10_0_S6_S3 -100 100
 /begin AXIS_DESCR STD_AXIS zff_atsys._.iSignale._.obj.sig_m_t UMR_NM__1_1_0_S6_S3 6 -400 1640 DEPOSIT ABSOLUTE MONOTONY MON_INCREASE /end AXIS_DESCR
 /begin AXIS_DESCR STD_AXIS zff_atsys._.iSignale._.obj.sig_n_t UMR_U_MIN_1_1_0_S6_S3 4 0 8160 DEPOSIT ABSOLUTE MONOTONY MON_INCREASE /end AXIS_DESCR
/end CHARACTERISTIC
/begin CHARACTERISTIC KF_PGOKZUMTNT45_EL "Schaltdruckgradient" MAP 0x250200 kf_si16_S6_S3 200 UMR_BAR_SEC_1_10_0_S6_S3 -100 100
 /begin AXIS_DESCR STD_AXIS zff_atsys._.iSignale._.obj.sig_m_t UMR_NM__1_1_0_S6_S3 6 -400 1640 DEPOSIT ABSOLUTE MONOTONY MON_INCREASE /end AXIS_DESCR
 /begin AXIS_DESCR STD_AXIS zff_atsys._.iSignale._.obj.sig_n_t UMR_U_MIN_1_1_0_S6_S3 4 0 8160 DEPOSIT ABSOLUTE MONOTONY MON_INCREASE /end AXIS_DESCR
/end CHARACTERISTIC
/begin CHARACTERISTIC KF_POKZUMTCG45 "Schaltdruckoffset" MAP 0x25024C kf_si16_S6_S3 12.75 UMR_BAR__1_1000_0_S6_S3 -6.4 6.35
 /begin AXIS_DESCR STD_AXIS zff_atsys._.iSignale._.obj.sig_m_t UMR_NM__1_1_0_S6_S3 8 -400 1640 DEPOSIT ABSOLUTE MONOTONY MON_INCREASE /end AXIS_DESCR
 /begin AXIS_DESCR STD_AXIS zff_atsys._.iSignale._.obj.sig_c_getr UMR_GRADC__1_1_M40_S6_S3 10 -40 150 DEPOSIT ABSOLUTE MONOTONY MON_INCREASE /end AXIS_DESCR
/end CHARACTERISTIC
/begin CHARACTERISTIC KF_POKZUMTCG45_EL "Schaltdruckoffset" MAP 0x250318 kf_si16_S6_S3 12.75 UMR_BAR__1_1000_0_S6_S3 -6.4 6.35
 /begin AXIS_DESCR STD_AXIS zff_atsys._.iSignale._.obj.sig_m_t UMR_NM__1_1_0_S6_S3 8 -400 1640 DEPOSIT ABSOLUTE MONOTONY MON_INCREASE /end AXIS_DESCR
 /begin AXIS_DESCR STD_AXIS zff_atsys._.iSignale._.obj.sig_c_getr UMR_GRADC__1_1_M40_S6_S3 10 -40 150 DEPOSIT ABSOLUTE MONOTONY MON_INCREASE /end AXIS_DESCR
/end CHARACTERISTIC
/begin CHARACTERISTIC KL_TSYNMTRAKZU56 "Zeit vor sync. Ende Schaltdruck/Start 3. Rampe KZU" CURVE 0x2503E4 kl_ui8_S6_S3 1280 UMR_MSEC__10_1_M128_S6_S3 -1280 0
 /begin AXIS_DESCR STD_AXIS zff_atsys._.iSignale._.obj.sig_m_t8 UMR_NM__8_1_M50_S6_S3 4 -400 1640 DEPOSIT ABSOLUTE MONOTONY MON_INCREASE /end AXIS_DESCR
/end CHARACTERISTIC
/begin CHARACTERISTIC KL_TSYNMTRAKZU56_EL "Zeit vor sync. Ende Schaltdruck/Start 3. Rampe KZU" CURVE 0x2503F0 kl_ui8_S6_S3 1280 UMR_MSEC__10_1_M128_S6_S3 -1280 0
 /begin AXIS_DESCR STD_AXIS zff_atsys._.iSignale._.obj.sig_m_t8 UMR_NM__8_1_M50_S6_S3 4 -400 1640 DEPOSIT ABSOLUTE MONOTONY MON_INCREASE /end AXIS_DESCR
/end CHARACTERISTIC
/begin CHARACTERISTIC KF_TFCGNT56 "Fuellzeit" MAP 0x2503FC kf_ui8_S6_S3 2540 UMR_MSEC__10_1_0_S6_S3 0 2540
 /begin AXIS_DESCR STD_AXIS zff_atsys._.iSignale._.obj.sig_c_getr UMR_GRADC__1_1_M40_S6_S3 6 -40 150 DEPOSIT ABSOLUTE MONOTONY MON_INCREASE /end AXIS_DESCR
 /begin AXIS_DESCR STD_AXIS zff_atsys._.iSignale._.obj.sig_n_t8 UMR_U_MIN_32_1_0_S6_S3 3 0 8160 DEPOSIT ABSOLUTE MONOTONY MON_INCREASE /end AXIS_DESCR
/end CHARACTERISTIC
/begin CHARACTERISTIC KF_TFCGNT56_EL "Fuellzeit" MAP 0x250420 kf_ui8_S6_S3 2540 UMR_MSEC__10_1_0_S6_S3 0 2540
 /begin AXIS_DESCR STD_AXIS zff_atsys._.iSignale._.obj.sig_c_getr UMR_GRADC__1_1_M40_S6_S3 6 -40 150 DEPOSIT ABSOLUTE MONOTONY MON_INCREASE /end AXIS_DESCR
 /begin AXIS_DESCR STD_AXIS zff_atsys._.iSignale._.obj.sig_n_t8 UMR_U_MIN_32_1_0_S6_S3 3 0 8160 DEPOSIT ABSOLUTE MONOTONY MON_INCREASE /end AXIS_DESCR
/end CHARACTERISTIC
/begin CHARACTERISTIC T_VKZU56 "Verzoegerungszeit zuschaltende Kupplung nach Schaltbeginn" VALUE 0x26E85F kw_ui8_S6_S3 2540 UMR_MSEC__10_1_0_S6_S3 0 2540 /end CHARACTERISTIC
/begin CHARACTERISTIC T_VKZU56_EL "Verzoegerungszeit zuschaltende Kupplung nach Schaltbeginn" VALUE 0x26E860 kw_ui8_S6_S3 2540 UMR_MSEC__10_1_0_S6_S3 0 2540 /end CHARACTERISTIC
/begin CHARACTERISTIC KF_POFMTN56 "Kennfeld Fuelldruckoffset(n_t, m_t)" MAP 0x250444 kf_si16_S6_S3 12.75 UMR_BAR__1_1000_0_S6_S3 -6.4 6.35
 /begin AXIS_DESCR STD_AXIS zff_atsys._.iSignale._.obj.sig_n_t UMR_U_MIN_1_1_0_S6_S3 4 0 8160 DEPOSIT ABSOLUTE MONOTONY MON_INCREASE /end AXIS_DESCR
 /begin AXIS_DESCR STD_AXIS zff_atsys._.iSignale._.obj.sig_m_t UMR_NM__1_1_0_S6_S3 6 -400 1640 DEPOSIT ABSOLUTE MONOTONY MON_INCREASE /end AXIS_DESCR
/end CHARACTERISTIC
/begin CHARACTERISTIC KF_POFMTN56_EL "Kennfeld Fuelldruckoffset(n_t, m_t)" MAP 0x250490 kf_si16_S6_S3 12.75 UMR_BAR__1_1000_0_S6_S3 -6.4 6.35
 /begin AXIS_DESCR STD_AXIS zff_atsys._.iSignale._.obj.sig_n_t UMR_U_MIN_1_1_0_S6_S3 4 0 8160 DEPOSIT ABSOLUTE MONOTONY MON_INCREASE /end AXIS_DESCR
 /begin AXIS_DESCR STD_AXIS zff_atsys._.iSignale._.obj.sig_m_t UMR_NM__1_1_0_S6_S3 6 -400 1640 DEPOSIT ABSOLUTE MONOTONY MON_INCREASE /end AXIS_DESCR
/end CHARACTERISTIC
/begin CHARACTERISTIC KF_T_DT_IG_CHANGE56 "Kennfeld Zeitvorhalt für Übergabe Rampenzeit auf Schaltdruck" MAP 0x2504DC kf_si16_S6_S3 5080 UMR_MSEC__10_1_0_S6_S3 -2540 2540
 /begin AXIS_DESCR STD_AXIS zff_atsys._.iSignale._.obj.sig_n_t UMR_U_MIN_1_1_0_S6_S3 4 0 8160 DEPOSIT ABSOLUTE MONOTONY MON_INCREASE /end AXIS_DESCR
 /begin AXIS_DESCR STD_AXIS zff_atsys._.iSignale._.obj.sig_m_t UMR_NM__1_1_0_S6_S3 4 -400 1640 DEPOSIT ABSOLUTE MONOTONY MON_INCREASE /end AXIS_DESCR
/end CHARACTERISTIC
/begin CHARACTERISTIC KF_T_DT_IG_CHANGE56_EL "Kennfeld Zeitvorhalt für Übergabe Rampenzeit auf Schaltdruck" MAP 0x250514 kf_si16_S6_S3 5080 UMR_MSEC__10_1_0_S6_S3 -2540 2540
 /begin AXIS_DESCR STD_AXIS zff_atsys._.iSignale._.obj.sig_n_t UMR_U_MIN_1_1_0_S6_S3 4 0 8160 DEPOSIT ABSOLUTE MONOTONY MON_INCREASE /end AXIS_DESCR
 /begin AXIS_DESCR STD_AXIS zff_atsys._.iSignale._.obj.sig_m_t UMR_NM__1_1_0_S6_S3 4 -400 1640 DEPOSIT ABSOLUTE MONOTONY MON_INCREASE /end AXIS_DESCR
/end CHARACTERISTIC
/begin CHARACTERISTIC KF_T2_DT_IG_CHANGE56 "2. Kennfeld Zeitvorhalt für Übergabe Rampenzeit auf Schaltdruck" MAP 0x25054C kf_si16_S6_S3 5080 UMR_MSEC__10_1_0_S6_S3 -2540 2540
 /begin AXIS_DESCR STD_AXIS zff_atsys._.iSignale._.obj.sig_n_t UMR_U_MIN_1_1_0_S6_S3 4 0 8160 DEPOSIT ABSOLUTE MONOTONY MON_INCREASE /end AXIS_DESCR
 /begin AXIS_DESCR STD_AXIS zff_atsys._.iSignale._.obj.sig_m_t UMR_NM__1_1_0_S6_S3 4 -400 1640 DEPOSIT ABSOLUTE MONOTONY MON_INCREASE /end AXIS_DESCR
/end CHARACTERISTIC
/begin CHARACTERISTIC KF_TRAMTNT56 "Zeit 1. Rampe der zuschaltenden Kupplung" MAP 0x250584 kf_ui8_S6_S3 2540 UMR_MSEC__10_1_0_S6_S3 0 2540
 /begin AXIS_DESCR STD_AXIS zff_atsys._.iSignale._.obj.sig_m_t8 UMR_NM__8_1_M50_S6_S3 4 -400 1640 DEPOSIT ABSOLUTE MONOTONY MON_INCREASE /end AXIS_DESCR
 /begin AXIS_DESCR STD_AXIS zff_atsys._.iSignale._.obj.sig_n_t8 UMR_U_MIN_32_1_0_S6_S3 4 0 8160 DEPOSIT ABSOLUTE MONOTONY MON_INCREASE /end AXIS_DESCR
/end CHARACTERISTIC
/begin CHARACTERISTIC KF_TRAMTNT56_EL "Zeit 1. Rampe der zuschaltenden Kupplung" MAP 0x2505A4 kf_ui8_S6_S3 2540 UMR_MSEC__10_1_0_S6_S3 0 2540
 /begin AXIS_DESCR STD_AXIS zff_atsys._.iSignale._.obj.sig_m_t8 UMR_NM__8_1_M50_S6_S3 4 -400 1640 DEPOSIT ABSOLUTE MONOTONY MON_INCREASE /end AXIS_DESCR
 /begin AXIS_DESCR STD_AXIS zff_atsys._.iSignale._.obj.sig_n_t8 UMR_U_MIN_32_1_0_S6_S3 4 0 8160 DEPOSIT ABSOLUTE MONOTONY MON_INCREASE /end AXIS_DESCR
/end CHARACTERISTIC
/begin CHARACTERISTIC KF_PKZU56 "Schaltdruck zuschaltende Kupplung" MAP 0x2505C4 kf_si16_S6_S3 12.75 UMR_BAR__1_1000_0_S6_S3 0 12.75
 /begin AXIS_DESCR STD_AXIS iSasZentr.iSchaltend.n_tkf UMR_U_MIN_32_1_0_S6_S3 8 0 8160 DEPOSIT ABSOLUTE MONOTONY MON_INCREASE /end AXIS_DESCR
 /begin AXIS_DESCR STD_AXIS zff_atsys._.iSignale._.obj.sig_m_t UMR_NM__1_1_0_S6_S3 10 -400 1640 DEPOSIT ABSOLUTE MONOTONY MON_INCREASE /end AXIS_DESCR
/end CHARACTERISTIC
/begin CHARACTERISTIC KF_PKZU56_EL "Schaltdruck zuschaltende Kupplung" MAP 0x250690 kf_si16_S6_S3 12.75 UMR_BAR__1_1000_0_S6_S3 0 12.75
 /begin AXIS_DESCR STD_AXIS iSasZentr.iSchaltend.n_tkf UMR_U_MIN_32_1_0_S6_S3 8 0 8160 DEPOSIT ABSOLUTE MONOTONY MON_INCREASE /end AXIS_DESCR
 /begin AXIS_DESCR STD_AXIS zff_atsys._.iSignale._.obj.sig_m_t UMR_NM__1_1_0_S6_S3 10 -400 1640 DEPOSIT ABSOLUTE MONOTONY MON_INCREASE /end AXIS_DESCR
/end CHARACTERISTIC
/begin CHARACTERISTIC F_PRA56 "Druckfaktor waehrend Rampe auf Schaltdruck" VALUE 0x26E861 kw_ui8_S6_S3 1 UMR___1_100_0_S6_S3 0 1 /end CHARACTERISTIC
/begin CHARACTERISTIC F_PRA56_EL "Druckfaktor waehrend Rampe auf Schaltdruck" VALUE 0x26E862 kw_ui8_S6_S3 1 UMR___1_100_0_S6_S3 0 1 /end CHARACTERISTIC
/begin CHARACTERISTIC F_TRA56 "Zeitfaktor waehrend Rampe auf Schaltdruck" VALUE 0x26E863 kw_ui8_S6_S3 1 UMR___1_100_0_S6_S3 0 1 /end CHARACTERISTIC
/begin CHARACTERISTIC F_TRA56_EL "Zeitfaktor waehrend Rampe auf Schaltdruck" VALUE 0x26E864 kw_ui8_S6_S3 1 UMR___1_100_0_S6_S3 0 1 /end CHARACTERISTIC
/begin CHARACTERISTIC KF_PGOKZUMTNT56 "Schaltdruckgradient" MAP 0x25075C kf_si16_S6_S3 200 UMR_BAR_SEC_1_10_0_S6_S3 -100 100
 /begin AXIS_DESCR STD_AXIS zff_atsys._.iSignale._.obj.sig_m_t UMR_NM__1_1_0_S6_S3 6 -400 1640 DEPOSIT ABSOLUTE MONOTONY MON_INCREASE /end AXIS_DESCR
 /begin AXIS_DESCR STD_AXIS zff_atsys._.iSignale._.obj.sig_n_t UMR_U_MIN_1_1_0_S6_S3 4 0 8160 DEPOSIT ABSOLUTE MONOTONY MON_INCREASE /end AXIS_DESCR
/end CHARACTERISTIC
/begin CHARACTERISTIC KF_PGOKZUMTNT56_EL "Schaltdruckgradient" MAP 0x2507A8 kf_si16_S6_S3 200 UMR_BAR_SEC_1_10_0_S6_S3 -100 100
 /begin AXIS_DESCR STD_AXIS zff_atsys._.iSignale._.obj.sig_m_t UMR_NM__1_1_0_S6_S3 6 -400 1640 DEPOSIT ABSOLUTE MONOTONY MON_INCREASE /end AXIS_DESCR
 /begin AXIS_DESCR STD_AXIS zff_atsys._.iSignale._.obj.sig_n_t UMR_U_MIN_1_1_0_S6_S3 4 0 8160 DEPOSIT ABSOLUTE MONOTONY MON_INCREASE /end AXIS_DESCR
/end CHARACTERISTIC
/begin CHARACTERISTIC KF_POKZUMTCG56 "Schaltdruckoffset" MAP 0x2507F4 kf_si16_S6_S3 12.75 UMR_BAR__1_1000_0_S6_S3 -6.4 6.35
 /begin AXIS_DESCR STD_AXIS zff_atsys._.iSignale._.obj.sig_m_t UMR_NM__1_1_0_S6_S3 8 -400 1640 DEPOSIT ABSOLUTE MONOTONY MON_INCREASE /end AXIS_DESCR
 /begin AXIS_DESCR STD_AXIS zff_atsys._.iSignale._.obj.sig_c_getr UMR_GRADC__1_1_M40_S6_S3 10 -40 150 DEPOSIT ABSOLUTE MONOTONY MON_INCREASE /end AXIS_DESCR
/end CHARACTERISTIC
/begin CHARACTERISTIC KF_POKZUMTCG56_EL "Schaltdruckoffset" MAP 0x2508C0 kf_si16_S6_S3 12.75 UMR_BAR__1_1000_0_S6_S3 -6.4 6.35
 /begin AXIS_DESCR STD_AXIS zff_atsys._.iSignale._.obj.sig_m_t UMR_NM__1_1_0_S6_S3 8 -400 1640 DEPOSIT ABSOLUTE MONOTONY MON_INCREASE /end AXIS_DESCR
 /begin AXIS_DESCR STD_AXIS zff_atsys._.iSignale._.obj.sig_c_getr UMR_GRADC__1_1_M40_S6_S3 10 -40 150 DEPOSIT ABSOLUTE MONOTONY MON_INCREASE /end AXIS_DESCR
/end CHARACTERISTIC
/begin CHARACTERISTIC KL_TSYNMTRAKZU67 "Zeit vor sync. Ende Schaltdruck/Start 3. Rampe KZU" CURVE 0x25098C kl_ui8_S6_S3 1280 UMR_MSEC__10_1_M128_S6_S3 -1280 0
 /begin AXIS_DESCR STD_AXIS zff_atsys._.iSignale._.obj.sig_m_t8 UMR_NM__8_1_M50_S6_S3 4 -400 1640 DEPOSIT ABSOLUTE MONOTONY MON_INCREASE /end AXIS_DESCR
/end CHARACTERISTIC
/begin CHARACTERISTIC KL_TSYNMTRAKZU67_EL "Zeit vor sync. Ende Schaltdruck/Start 3. Rampe KZU" CURVE 0x250998 kl_ui8_S6_S3 1280 UMR_MSEC__10_1_M128_S6_S3 -1280 0
 /begin AXIS_DESCR STD_AXIS zff_atsys._.iSignale._.obj.sig_m_t8 UMR_NM__8_1_M50_S6_S3 4 -400 1640 DEPOSIT ABSOLUTE MONOTONY MON_INCREASE /end AXIS_DESCR
/end CHARACTERISTIC
/begin CHARACTERISTIC KF_TFCGNT67 "Fuellzeit" MAP 0x2509A4 kf_ui8_S6_S3 2540 UMR_MSEC__10_1_0_S6_S3 0 2540
 /begin AXIS_DESCR STD_AXIS zff_atsys._.iSignale._.obj.sig_c_getr UMR_GRADC__1_1_M40_S6_S3 6 -40 150 DEPOSIT ABSOLUTE MONOTONY MON_INCREASE /end AXIS_DESCR
 /begin AXIS_DESCR STD_AXIS zff_atsys._.iSignale._.obj.sig_n_t8 UMR_U_MIN_32_1_0_S6_S3 3 0 8160 DEPOSIT ABSOLUTE MONOTONY MON_INCREASE /end AXIS_DESCR
/end CHARACTERISTIC
/begin CHARACTERISTIC KF_TFCGNT67_EL "Fuellzeit" MAP 0x2509C8 kf_ui8_S6_S3 2540 UMR_MSEC__10_1_0_S6_S3 0 2540
 /begin AXIS_DESCR STD_AXIS zff_atsys._.iSignale._.obj.sig_c_getr UMR_GRADC__1_1_M40_S6_S3 6 -40 150 DEPOSIT ABSOLUTE MONOTONY MON_INCREASE /end AXIS_DESCR
 /begin AXIS_DESCR STD_AXIS zff_atsys._.iSignale._.obj.sig_n_t8 UMR_U_MIN_32_1_0_S6_S3 3 0 8160 DEPOSIT ABSOLUTE MONOTONY MON_INCREASE /end AXIS_DESCR
/end CHARACTERISTIC
/begin CHARACTERISTIC T_VKZU67 "Verzoegerungszeit zuschaltende Kupplung nach Schaltbeginn" VALUE 0x26E865 kw_ui8_S6_S3 2540 UMR_MSEC__10_1_0_S6_S3 0 2540 /end CHARACTERISTIC
/begin CHARACTERISTIC T_VKZU67_EL "Verzoegerungszeit zuschaltende Kupplung nach Schaltbeginn" VALUE 0x26E866 kw_ui8_S6_S3 2540 UMR_MSEC__10_1_0_S6_S3 0 2540 /end CHARACTERISTIC
/begin CHARACTERISTIC KF_POFMTN67 "Kennfeld Fuelldruckoffset(n_t, m_t)" MAP 0x2509EC kf_si16_S6_S3 12.75 UMR_BAR__1_1000_0_S6_S3 -6.4 6.35
 /begin AXIS_DESCR STD_AXIS zff_atsys._.iSignale._.obj.sig_n_t UMR_U_MIN_1_1_0_S6_S3 4 0 8160 DEPOSIT ABSOLUTE MONOTONY MON_INCREASE /end AXIS_DESCR
 /begin AXIS_DESCR STD_AXIS zff_atsys._.iSignale._.obj.sig_m_t UMR_NM__1_1_0_S6_S3 6 -400 1640 DEPOSIT ABSOLUTE MONOTONY MON_INCREASE /end AXIS_DESCR
/end CHARACTERISTIC
/begin CHARACTERISTIC KF_POFMTN67_EL "Kennfeld Fuelldruckoffset(n_t, m_t)" MAP 0x250A38 kf_si16_S6_S3 12.75 UMR_BAR__1_1000_0_S6_S3 -6.4 6.35
 /begin AXIS_DESCR STD_AXIS zff_atsys._.iSignale._.obj.sig_n_t UMR_U_MIN_1_1_0_S6_S3 4 0 8160 DEPOSIT ABSOLUTE MONOTONY MON_INCREASE /end AXIS_DESCR
 /begin AXIS_DESCR STD_AXIS zff_atsys._.iSignale._.obj.sig_m_t UMR_NM__1_1_0_S6_S3 6 -400 1640 DEPOSIT ABSOLUTE MONOTONY MON_INCREASE /end AXIS_DESCR
/end CHARACTERISTIC
/begin CHARACTERISTIC KF_T_DT_IG_CHANGE67 "Kennfeld Zeitvorhalt für Übergabe Rampenzeit auf Schaltdruck" MAP 0x250A84 kf_si16_S6_S3 5080 UMR_MSEC__10_1_0_S6_S3 -2540 2540
 /begin AXIS_DESCR STD_AXIS zff_atsys._.iSignale._.obj.sig_n_t UMR_U_MIN_1_1_0_S6_S3 4 0 8160 DEPOSIT ABSOLUTE MONOTONY MON_INCREASE /end AXIS_DESCR
 /begin AXIS_DESCR STD_AXIS zff_atsys._.iSignale._.obj.sig_m_t UMR_NM__1_1_0_S6_S3 4 -400 1640 DEPOSIT ABSOLUTE MONOTONY MON_INCREASE /end AXIS_DESCR
/end CHARACTERISTIC
/begin CHARACTERISTIC KF_T_DT_IG_CHANGE67_EL "Kennfeld Zeitvorhalt für Übergabe Rampenzeit auf Schaltdruck" MAP 0x250ABC kf_si16_S6_S3 5080 UMR_MSEC__10_1_0_S6_S3 -2540 2540
 /begin AXIS_DESCR STD_AXIS zff_atsys._.iSignale._.obj.sig_n_t UMR_U_MIN_1_1_0_S6_S3 4 0 8160 DEPOSIT ABSOLUTE MONOTONY MON_INCREASE /end AXIS_DESCR
 /begin AXIS_DESCR STD_AXIS zff_atsys._.iSignale._.obj.sig_m_t UMR_NM__1_1_0_S6_S3 4 -400 1640 DEPOSIT ABSOLUTE MONOTONY MON_INCREASE /end AXIS_DESCR
/end CHARACTERISTIC
/begin CHARACTERISTIC KF_T2_DT_IG_CHANGE67 "2. Kennfeld Zeitvorhalt für Übergabe Rampenzeit auf Schaltdruck" MAP 0x250AF4 kf_si16_S6_S3 5080 UMR_MSEC__10_1_0_S6_S3 -2540 2540
 /begin AXIS_DESCR STD_AXIS zff_atsys._.iSignale._.obj.sig_n_t UMR_U_MIN_1_1_0_S6_S3 4 0 8160 DEPOSIT ABSOLUTE MONOTONY MON_INCREASE /end AXIS_DESCR
 /begin AXIS_DESCR STD_AXIS zff_atsys._.iSignale._.obj.sig_m_t UMR_NM__1_1_0_S6_S3 4 -400 1640 DEPOSIT ABSOLUTE MONOTONY MON_INCREASE /end AXIS_DESCR
/end CHARACTERISTIC
/begin CHARACTERISTIC KF_TRAMTNT67 "Zeit 1. Rampe der zuschaltenden Kupplung" MAP 0x250B2C kf_ui8_S6_S3 2540 UMR_MSEC__10_1_0_S6_S3 0 2540
 /begin AXIS_DESCR STD_AXIS zff_atsys._.iSignale._.obj.sig_m_t8 UMR_NM__8_1_M50_S6_S3 4 -400 1640 DEPOSIT ABSOLUTE MONOTONY MON_INCREASE /end AXIS_DESCR
 /begin AXIS_DESCR STD_AXIS zff_atsys._.iSignale._.obj.sig_n_t8 UMR_U_MIN_32_1_0_S6_S3 4 0 8160 DEPOSIT ABSOLUTE MONOTONY MON_INCREASE /end AXIS_DESCR
/end CHARACTERISTIC
/begin CHARACTERISTIC KF_TRAMTNT67_EL "Zeit 1. Rampe der zuschaltenden Kupplung" MAP 0x250B4C kf_ui8_S6_S3 2540 UMR_MSEC__10_1_0_S6_S3 0 2540
 /begin AXIS_DESCR STD_AXIS zff_atsys._.iSignale._.obj.sig_m_t8 UMR_NM__8_1_M50_S6_S3 4 -400 1640 DEPOSIT ABSOLUTE MONOTONY MON_INCREASE /end AXIS_DESCR
 /begin AXIS_DESCR STD_AXIS zff_atsys._.iSignale._.obj.sig_n_t8 UMR_U_MIN_32_1_0_S6_S3 4 0 8160 DEPOSIT ABSOLUTE MONOTONY MON_INCREASE /end AXIS_DESCR
/end CHARACTERISTIC
/begin CHARACTERISTIC KF_PKZU67 "Schaltdruck zuschaltende Kupplung" MAP 0x250B6C kf_si16_S6_S3 12.75 UMR_BAR__1_1000_0_S6_S3 0 12.75
 /begin AXIS_DESCR STD_AXIS iSasZentr.iSchaltend.n_tkf UMR_U_MIN_32_1_0_S6_S3 8 0 8160 DEPOSIT ABSOLUTE MONOTONY MON_INCREASE /end AXIS_DESCR
 /begin AXIS_DESCR STD_AXIS zff_atsys._.iSignale._.obj.sig_m_t UMR_NM__1_1_0_S6_S3 10 -400 1640 DEPOSIT ABSOLUTE MONOTONY MON_INCREASE /end AXIS_DESCR
/end CHARACTERISTIC
/begin CHARACTERISTIC KF_PKZU67_EL "Schaltdruck zuschaltende Kupplung" MAP 0x250C38 kf_si16_S6_S3 12.75 UMR_BAR__1_1000_0_S6_S3 0 12.75
 /begin AXIS_DESCR STD_AXIS iSasZentr.iSchaltend.n_tkf UMR_U_MIN_32_1_0_S6_S3 8 0 8160 DEPOSIT ABSOLUTE MONOTONY MON_INCREASE /end AXIS_DESCR
 /begin AXIS_DESCR STD_AXIS zff_atsys._.iSignale._.obj.sig_m_t UMR_NM__1_1_0_S6_S3 10 -400 1640 DEPOSIT ABSOLUTE MONOTONY MON_INCREASE /end AXIS_DESCR
/end CHARACTERISTIC
/begin CHARACTERISTIC F_PRA67 "Druckfaktor waehrend Rampe auf Schaltdruck" VALUE 0x26E867 kw_ui8_S6_S3 1 UMR___1_100_0_S6_S3 0 1 /end CHARACTERISTIC
/begin CHARACTERISTIC F_PRA67_EL "Druckfaktor waehrend Rampe auf Schaltdruck" VALUE 0x26E868 kw_ui8_S6_S3 1 UMR___1_100_0_S6_S3 0 1 /end CHARACTERISTIC
/begin CHARACTERISTIC F_TRA67 "Zeitfaktor waehrend Rampe auf Schaltdruck" VALUE 0x26E869 kw_ui8_S6_S3 1 UMR___1_100_0_S6_S3 0 1 /end CHARACTERISTIC
/begin CHARACTERISTIC F_TRA67_EL "Zeitfaktor waehrend Rampe auf Schaltdruck" VALUE 0x26E86A kw_ui8_S6_S3 1 UMR___1_100_0_S6_S3 0 1 /end CHARACTERISTIC
/begin CHARACTERISTIC KF_PGOKZUMTNT67 "Schaltdruckgradient" MAP 0x250D04 kf_si16_S6_S3 200 UMR_BAR_SEC_1_10_0_S6_S3 -100 100
 /begin AXIS_DESCR STD_AXIS zff_atsys._.iSignale._.obj.sig_m_t UMR_NM__1_1_0_S6_S3 6 -400 1640 DEPOSIT ABSOLUTE MONOTONY MON_INCREASE /end AXIS_DESCR
 /begin AXIS_DESCR STD_AXIS zff_atsys._.iSignale._.obj.sig_n_t UMR_U_MIN_1_1_0_S6_S3 4 0 8160 DEPOSIT ABSOLUTE MONOTONY MON_INCREASE /end AXIS_DESCR
/end CHARACTERISTIC
/begin CHARACTERISTIC KF_PGOKZUMTNT67_EL "Schaltdruckgradient" MAP 0x250D50 kf_si16_S6_S3 200 UMR_BAR_SEC_1_10_0_S6_S3 -100 100
 /begin AXIS_DESCR STD_AXIS zff_atsys._.iSignale._.obj.sig_m_t UMR_NM__1_1_0_S6_S3 6 -400 1640 DEPOSIT ABSOLUTE MONOTONY MON_INCREASE /end AXIS_DESCR
 /begin AXIS_DESCR STD_AXIS zff_atsys._.iSignale._.obj.sig_n_t UMR_U_MIN_1_1_0_S6_S3 4 0 8160 DEPOSIT ABSOLUTE MONOTONY MON_INCREASE /end AXIS_DESCR
/end CHARACTERISTIC
/begin CHARACTERISTIC KF_POKZUMTCG67 "Schaltdruckoffset" MAP 0x250D9C kf_si16_S6_S3 12.75 UMR_BAR__1_1000_0_S6_S3 -6.4 6.35
 /begin AXIS_DESCR STD_AXIS zff_atsys._.iSignale._.obj.sig_m_t UMR_NM__1_1_0_S6_S3 8 -400 1640 DEPOSIT ABSOLUTE MONOTONY MON_INCREASE /end AXIS_DESCR
 /begin AXIS_DESCR STD_AXIS zff_atsys._.iSignale._.obj.sig_c_getr UMR_GRADC__1_1_M40_S6_S3 10 -40 150 DEPOSIT ABSOLUTE MONOTONY MON_INCREASE /end AXIS_DESCR
/end CHARACTERISTIC
/begin CHARACTERISTIC KF_POKZUMTCG67_EL "Schaltdruckoffset" MAP 0x250E68 kf_si16_S6_S3 12.75 UMR_BAR__1_1000_0_S6_S3 -6.4 6.35
 /begin AXIS_DESCR STD_AXIS zff_atsys._.iSignale._.obj.sig_m_t UMR_NM__1_1_0_S6_S3 8 -400 1640 DEPOSIT ABSOLUTE MONOTONY MON_INCREASE /end AXIS_DESCR
 /begin AXIS_DESCR STD_AXIS zff_atsys._.iSignale._.obj.sig_c_getr UMR_GRADC__1_1_M40_S6_S3 10 -40 150 DEPOSIT ABSOLUTE MONOTONY MON_INCREASE /end AXIS_DESCR
/end CHARACTERISTIC
/begin CHARACTERISTIC KL_TSYNMTRAKZU78 "Zeit vor sync. Ende Schaltdruck/Start 3. Rampe KZU" CURVE 0x250F34 kl_ui8_S6_S3 1280 UMR_MSEC__10_1_M128_S6_S3 -1280 0
 /begin AXIS_DESCR STD_AXIS zff_atsys._.iSignale._.obj.sig_m_t8 UMR_NM__8_1_M50_S6_S3 4 -400 1640 DEPOSIT ABSOLUTE MONOTONY MON_INCREASE /end AXIS_DESCR
/end CHARACTERISTIC
/begin CHARACTERISTIC KL_TSYNMTRAKZU78_EL "Zeit vor sync. Ende Schaltdruck/Start 3. Rampe KZU" CURVE 0x250F40 kl_ui8_S6_S3 1280 UMR_MSEC__10_1_M128_S6_S3 -1280 0
 /begin AXIS_DESCR STD_AXIS zff_atsys._.iSignale._.obj.sig_m_t8 UMR_NM__8_1_M50_S6_S3 4 -400 1640 DEPOSIT ABSOLUTE MONOTONY MON_INCREASE /end AXIS_DESCR
/end CHARACTERISTIC
/begin CHARACTERISTIC KF_TFCGNT78 "Fuellzeit" MAP 0x250F4C kf_ui8_S6_S3 2540 UMR_MSEC__10_1_0_S6_S3 0 2540
 /begin AXIS_DESCR STD_AXIS zff_atsys._.iSignale._.obj.sig_c_getr UMR_GRADC__1_1_M40_S6_S3 6 -40 150 DEPOSIT ABSOLUTE MONOTONY MON_INCREASE /end AXIS_DESCR
 /begin AXIS_DESCR STD_AXIS zff_atsys._.iSignale._.obj.sig_n_t8 UMR_U_MIN_32_1_0_S6_S3 3 0 8160 DEPOSIT ABSOLUTE MONOTONY MON_INCREASE /end AXIS_DESCR
/end CHARACTERISTIC
/begin CHARACTERISTIC KF_TFCGNT78_EL "Fuellzeit" MAP 0x250F70 kf_ui8_S6_S3 2540 UMR_MSEC__10_1_0_S6_S3 0 2540
 /begin AXIS_DESCR STD_AXIS zff_atsys._.iSignale._.obj.sig_c_getr UMR_GRADC__1_1_M40_S6_S3 6 -40 150 DEPOSIT ABSOLUTE MONOTONY MON_INCREASE /end AXIS_DESCR
 /begin AXIS_DESCR STD_AXIS zff_atsys._.iSignale._.obj.sig_n_t8 UMR_U_MIN_32_1_0_S6_S3 3 0 8160 DEPOSIT ABSOLUTE MONOTONY MON_INCREASE /end AXIS_DESCR
/end CHARACTERISTIC
/begin CHARACTERISTIC T_VKZU78 "Verzoegerungszeit zuschaltende Kupplung nach Schaltbeginn" VALUE 0x26E86B kw_ui8_S6_S3 2540 UMR_MSEC__10_1_0_S6_S3 0 2540 /end CHARACTERISTIC
/begin CHARACTERISTIC T_VKZU78_EL "Verzoegerungszeit zuschaltende Kupplung nach Schaltbeginn" VALUE 0x26E86C kw_ui8_S6_S3 2540 UMR_MSEC__10_1_0_S6_S3 0 2540 /end CHARACTERISTIC
/begin CHARACTERISTIC KF_POFMTN78 "Kennfeld Fuelldruckoffset(n_t, m_t)" MAP 0x250F94 kf_si16_S6_S3 12.75 UMR_BAR__1_1000_0_S6_S3 -6.4 6.35
 /begin AXIS_DESCR STD_AXIS zff_atsys._.iSignale._.obj.sig_n_t UMR_U_MIN_1_1_0_S6_S3 4 0 8160 DEPOSIT ABSOLUTE MONOTONY MON_INCREASE /end AXIS_DESCR
 /begin AXIS_DESCR STD_AXIS zff_atsys._.iSignale._.obj.sig_m_t UMR_NM__1_1_0_S6_S3 6 -400 1640 DEPOSIT ABSOLUTE MONOTONY MON_INCREASE /end AXIS_DESCR
/end CHARACTERISTIC
/begin CHARACTERISTIC KF_POFMTN78_EL "Kennfeld Fuelldruckoffset(n_t, m_t)" MAP 0x250FE0 kf_si16_S6_S3 12.75 UMR_BAR__1_1000_0_S6_S3 -6.4 6.35
 /begin AXIS_DESCR STD_AXIS zff_atsys._.iSignale._.obj.sig_n_t UMR_U_MIN_1_1_0_S6_S3 4 0 8160 DEPOSIT ABSOLUTE MONOTONY MON_INCREASE /end AXIS_DESCR
 /begin AXIS_DESCR STD_AXIS zff_atsys._.iSignale._.obj.sig_m_t UMR_NM__1_1_0_S6_S3 6 -400 1640 DEPOSIT ABSOLUTE MONOTONY MON_INCREASE /end AXIS_DESCR
/end CHARACTERISTIC
/begin CHARACTERISTIC KF_T_DT_IG_CHANGE78 "Kennfeld Zeitvorhalt für Übergabe Rampenzeit auf Schaltdruck" MAP 0x25102C kf_si16_S6_S3 5080 UMR_MSEC__10_1_0_S6_S3 -2540 2540
 /begin AXIS_DESCR STD_AXIS zff_atsys._.iSignale._.obj.sig_n_t UMR_U_MIN_1_1_0_S6_S3 4 0 8160 DEPOSIT ABSOLUTE MONOTONY MON_INCREASE /end AXIS_DESCR
 /begin AXIS_DESCR STD_AXIS zff_atsys._.iSignale._.obj.sig_m_t UMR_NM__1_1_0_S6_S3 4 -400 1640 DEPOSIT ABSOLUTE MONOTONY MON_INCREASE /end AXIS_DESCR
/end CHARACTERISTIC
/begin CHARACTERISTIC KF_T_DT_IG_CHANGE78_EL "Kennfeld Zeitvorhalt für Übergabe Rampenzeit auf Schaltdruck" MAP 0x251064 kf_si16_S6_S3 5080 UMR_MSEC__10_1_0_S6_S3 -2540 2540
 /begin AXIS_DESCR STD_AXIS zff_atsys._.iSignale._.obj.sig_n_t UMR_U_MIN_1_1_0_S6_S3 4 0 8160 DEPOSIT ABSOLUTE MONOTONY MON_INCREASE /end AXIS_DESCR
 /begin AXIS_DESCR STD_AXIS zff_atsys._.iSignale._.obj.sig_m_t UMR_NM__1_1_0_S6_S3 4 -400 1640 DEPOSIT ABSOLUTE MONOTONY MON_INCREASE /end AXIS_DESCR
/end CHARACTERISTIC
/begin CHARACTERISTIC KF_T2_DT_IG_CHANGE78 "2. Kennfeld Zeitvorhalt für Übergabe Rampenzeit auf Schaltdruck" MAP 0x25109C kf_si16_S6_S3 5080 UMR_MSEC__10_1_0_S6_S3 -2540 2540
 /begin AXIS_DESCR STD_AXIS zff_atsys._.iSignale._.obj.sig_n_t UMR_U_MIN_1_1_0_S6_S3 4 0 8160 DEPOSIT ABSOLUTE MONOTONY MON_INCREASE /end AXIS_DESCR
 /begin AXIS_DESCR STD_AXIS zff_atsys._.iSignale._.obj.sig_m_t UMR_NM__1_1_0_S6_S3 4 -400 1640 DEPOSIT ABSOLUTE MONOTONY MON_INCREASE /end AXIS_DESCR
/end CHARACTERISTIC
/begin CHARACTERISTIC KF_TRAMTNT78 "Zeit 1. Rampe der zuschaltenden Kupplung" MAP 0x2510D4 kf_ui8_S6_S3 2540 UMR_MSEC__10_1_0_S6_S3 0 2540
 /begin AXIS_DESCR STD_AXIS zff_atsys._.iSignale._.obj.sig_m_t8 UMR_NM__8_1_M50_S6_S3 4 -400 1640 DEPOSIT ABSOLUTE MONOTONY MON_INCREASE /end AXIS_DESCR
 /begin AXIS_DESCR STD_AXIS zff_atsys._.iSignale._.obj.sig_n_t8 UMR_U_MIN_32_1_0_S6_S3 4 0 8160 DEPOSIT ABSOLUTE MONOTONY MON_INCREASE /end AXIS_DESCR
/end CHARACTERISTIC
/begin CHARACTERISTIC KF_TRAMTNT78_EL "Zeit 1. Rampe der zuschaltenden Kupplung" MAP 0x2510F4 kf_ui8_S6_S3 2540 UMR_MSEC__10_1_0_S6_S3 0 2540
 /begin AXIS_DESCR STD_AXIS zff_atsys._.iSignale._.obj.sig_m_t8 UMR_NM__8_1_M50_S6_S3 4 -400 1640 DEPOSIT ABSOLUTE MONOTONY MON_INCREASE /end AXIS_DESCR
 /begin AXIS_DESCR STD_AXIS zff_atsys._.iSignale._.obj.sig_n_t8 UMR_U_MIN_32_1_0_S6_S3 4 0 8160 DEPOSIT ABSOLUTE MONOTONY MON_INCREASE /end AXIS_DESCR
/end CHARACTERISTIC
/begin CHARACTERISTIC KF_PKZU78 "Schaltdruck zuschaltende Kupplung" MAP 0x251114 kf_si16_S6_S3 12.75 UMR_BAR__1_1000_0_S6_S3 0 12.75
 /begin AXIS_DESCR STD_AXIS iSasZentr.iSchaltend.n_tkf UMR_U_MIN_32_1_0_S6_S3 8 0 8160 DEPOSIT ABSOLUTE MONOTONY MON_INCREASE /end AXIS_DESCR
 /begin AXIS_DESCR STD_AXIS zff_atsys._.iSignale._.obj.sig_m_t UMR_NM__1_1_0_S6_S3 10 -400 1640 DEPOSIT ABSOLUTE MONOTONY MON_INCREASE /end AXIS_DESCR
/end CHARACTERISTIC
/begin CHARACTERISTIC KF_PKZU78_EL "Schaltdruck zuschaltende Kupplung" MAP 0x2511E0 kf_si16_S6_S3 12.75 UMR_BAR__1_1000_0_S6_S3 0 12.75
 /begin AXIS_DESCR STD_AXIS iSasZentr.iSchaltend.n_tkf UMR_U_MIN_32_1_0_S6_S3 8 0 8160 DEPOSIT ABSOLUTE MONOTONY MON_INCREASE /end AXIS_DESCR
 /begin AXIS_DESCR STD_AXIS zff_atsys._.iSignale._.obj.sig_m_t UMR_NM__1_1_0_S6_S3 10 -400 1640 DEPOSIT ABSOLUTE MONOTONY MON_INCREASE /end AXIS_DESCR
/end CHARACTERISTIC
/begin CHARACTERISTIC F_PRA78 "Druckfaktor waehrend Rampe auf Schaltdruck" VALUE 0x26E86D kw_ui8_S6_S3 1 UMR___1_100_0_S6_S3 0 1 /end CHARACTERISTIC
/begin CHARACTERISTIC F_PRA78_EL "Druckfaktor waehrend Rampe auf Schaltdruck" VALUE 0x26E86E kw_ui8_S6_S3 1 UMR___1_100_0_S6_S3 0 1 /end CHARACTERISTIC
/begin CHARACTERISTIC F_TRA78 "Zeitfaktor waehrend Rampe auf Schaltdruck" VALUE 0x26E86F kw_ui8_S6_S3 1 UMR___1_100_0_S6_S3 0 1 /end CHARACTERISTIC
/begin CHARACTERISTIC F_TRA78_EL "Zeitfaktor waehrend Rampe auf Schaltdruck" VALUE 0x26E870 kw_ui8_S6_S3 1 UMR___1_100_0_S6_S3 0 1 /end CHARACTERISTIC
/begin CHARACTERISTIC KF_PGOKZUMTNT78 "Schaltdruckgradient" MAP 0x2512AC kf_si16_S6_S3 200 UMR_BAR_SEC_1_10_0_S6_S3 -100 100
 /begin AXIS_DESCR STD_AXIS zff_atsys._.iSignale._.obj.sig_m_t UMR_NM__1_1_0_S6_S3 6 -400 1640 DEPOSIT ABSOLUTE MONOTONY MON_INCREASE /end AXIS_DESCR
 /begin AXIS_DESCR STD_AXIS zff_atsys._.iSignale._.obj.sig_n_t UMR_U_MIN_1_1_0_S6_S3 4 0 8160 DEPOSIT ABSOLUTE MONOTONY MON_INCREASE /end AXIS_DESCR
/end CHARACTERISTIC
/begin CHARACTERISTIC KF_PGOKZUMTNT78_EL "Schaltdruckgradient" MAP 0x2512F8 kf_si16_S6_S3 200 UMR_BAR_SEC_1_10_0_S6_S3 -100 100
 /begin AXIS_DESCR STD_AXIS zff_atsys._.iSignale._.obj.sig_m_t UMR_NM__1_1_0_S6_S3 6 -400 1640 DEPOSIT ABSOLUTE MONOTONY MON_INCREASE /end AXIS_DESCR
 /begin AXIS_DESCR STD_AXIS zff_atsys._.iSignale._.obj.sig_n_t UMR_U_MIN_1_1_0_S6_S3 4 0 8160 DEPOSIT ABSOLUTE MONOTONY MON_INCREASE /end AXIS_DESCR
/end CHARACTERISTIC
/begin CHARACTERISTIC KF_POKZUMTCG78 "Schaltdruckoffset" MAP 0x251344 kf_si16_S6_S3 12.75 UMR_BAR__1_1000_0_S6_S3 -6.4 6.35
 /begin AXIS_DESCR STD_AXIS zff_atsys._.iSignale._.obj.sig_m_t UMR_NM__1_1_0_S6_S3 8 -400 1640 DEPOSIT ABSOLUTE MONOTONY MON_INCREASE /end AXIS_DESCR
 /begin AXIS_DESCR STD_AXIS zff_atsys._.iSignale._.obj.sig_c_getr UMR_GRADC__1_1_M40_S6_S3 10 -40 150 DEPOSIT ABSOLUTE MONOTONY MON_INCREASE /end AXIS_DESCR
/end CHARACTERISTIC
/begin CHARACTERISTIC KF_POKZUMTCG78_EL "Schaltdruckoffset" MAP 0x251410 kf_si16_S6_S3 12.75 UMR_BAR__1_1000_0_S6_S3 -6.4 6.35
 /begin AXIS_DESCR STD_AXIS zff_atsys._.iSignale._.obj.sig_m_t UMR_NM__1_1_0_S6_S3 8 -400 1640 DEPOSIT ABSOLUTE MONOTONY MON_INCREASE /end AXIS_DESCR
 /begin AXIS_DESCR STD_AXIS zff_atsys._.iSignale._.obj.sig_c_getr UMR_GRADC__1_1_M40_S6_S3 10 -40 150 DEPOSIT ABSOLUTE MONOTONY MON_INCREASE /end AXIS_DESCR
/end CHARACTERISTIC
/begin COMPU_METHOD SAB_1PROZENTG_M128_S2_S3 "int = ((phys * 1) / 1) - (-128) %" RAT_FUNC "%2.0" "%" COEFFS 0 1 128 0 0 1 /end COMPU_METHOD
/begin COMPU_METHOD SAB_A_4G1000_131068M1000_S2_S3 "int = ((phys * 1000) / 4) - (-32767) g" RAT_FUNC "%5.3" "g" COEFFS 0 1000 131068 0 0 4 /end COMPU_METHOD
/begin COMPU_METHOD SAB_A_G100_18M10_S2_S3 "int = ((phys * 100) / 1) - (-180) g" RAT_FUNC "%5.3" "g" COEFFS 0 100 180 0 0 1 /end COMPU_METHOD
/begin COMPU_METHOD SAB_A_G100_23M100_S2_S3 "int = ((phys * 100) / 1) - (-23) g" RAT_FUNC "%5.3" "g" COEFFS 0 100 23 0 0 1 /end COMPU_METHOD
/begin COMPU_METHOD SAB_A_MPSS50_65536M100_S2_S3 "int = ((phys * 50) / 1) - (-32768) m/s^2" RAT_FUNC "%5.3" "m/s^2" COEFFS 0 50 32768 0 0 1 /end COMPU_METHOD
/begin COMPU_METHOD SAB_A_MPSS32_M512_S2_S3 "int = ((phys * 32) / 1) - (-512) m/s^2" RAT_FUNC "%5.3" "m/s^2" COEFFS 0 32 512 0 0 1 /end COMPU_METHOD
/begin COMPU_METHOD UMR___1_100_0_S6_S3 "int = ((phys * 100) / 1) - (0) [-]" RAT_FUNC "%4.2" "[-]" COEFFS 0 100 -0 0 0 1 /end COMPU_METHOD
/begin COMPU_METHOD UMR_NM__1_1_0_S6_S3 "int = ((phys * 1) / 1) - (0) [Nm]" RAT_FUNC "%2.0" "[Nm]" COEFFS 0 1 -0 0 0 1 /end COMPU_METHOD
/begin COMPU_METHOD UMR_NM__8_1_M50_S6_S3 "int = ((phys * 1) / 8) - (-50) [Nm]" RAT_FUNC "%2.0" "[Nm]" COEFFS 0 1 400 0 0 8 /end COMPU_METHOD
/begin COMPU_METHOD UMR_BAR__1_1000_0_S6_S3 "int = ((phys * 1000) / 1) - (0) [bar]" RAT_FUNC "%5.3" "[bar]" COEFFS 0 1000 -0 0 0 1 /end COMPU_METHOD
/begin COMPU_METHOD UMR_BAR_SEC_1_10_0_S6_S3 "int = ((phys * 10) / 1) - (0) [bar/s]" RAT_FUNC "%3.1" "[bar/s]" COEFFS 0 10 -0 0 0 1 /end COMPU_METHOD
/begin COMPU_METHOD UMR_U_MIN_1_1_0_S6_S3 "int = ((phys * 1) / 1) - (0) [U/min]" RAT_FUNC "%2.0" "[U/min]" COEFFS 0 1 -0 0 0 1 /end COMPU_METHOD
/begin COMPU_METHOD UMR_U_MIN_32_1_0_S6_S3 "int = ((phys * 1) / 32) - (0) [U/min]" RAT_FUNC "%2.0" "[U/min]" COEFFS 0 1 -0 0 0 32 /end COMPU_METHOD
/begin COMPU_METHOD UMR_MSEC__10_1_0_S6_S3 "int = ((phys * 1) / 10) - (0) [ms]" RAT_FUNC "%2.0" "[ms]" COEFFS 0 1 -0 0 0 10 /end COMPU_METHOD
/begin COMPU_METHOD UMR_MSEC__10_1_M128_S6_S3 "int = ((phys * 1) / 10) - (-128) [ms]" RAT_FUNC "%2.0" "[ms]" COEFFS 0 1 1280 0 0 10 /end COMPU_METHOD
/begin COMPU_METHOD UMR_GRADC__1_1_M40_S6_S3 "int = ((phys * 1) / 1) - (-40) [°C]" RAT_FUNC "%2.0" "[°C]" COEFFS 0 1 40 0 0 1 /end COMPU_METHOD
/begin FUNCTION jSasKabRSP253_Fktn "Applikationesgroessen Instanz jSasKabRSP253"
 /begin DEF_CHARACTERISTIC F_PRAHKABSP53 F_TRAHKABSP53 KF_PKABSP53 KF_PKABSP53_EL KF_POHINSYNKABSP53 KF_TOHKABMTNTSP53 KF_TSYNMTNTKABVSP53 KL_PGOKABSP53 KL_POHKABSP53 KL_TRAHKABSP53 KL_TRAHKABSP53_EL KL_TRAMTHINSYNKABSP53 KL_TSYNMTKABSP53 T_HINSYNSP53 /end DEF_CHARACTERISTIC
/end FUNCTION
/begin FUNCTION jSasKabRSP263_Fktn "Applikationesgroessen Instanz jSasKabRSP263"
 /begin DEF_CHARACTERISTIC F_PRAHKABSP63 F_TRAHKABSP63 KF_PKABSP63 KF_PKABSP63_EL KF_POHINSYNKABSP63 KF_TOHKABMTNTSP63 KF_TSYNMTNTKABVSP63 KL_PGOKABSP63 KL_POHKABSP63 KL_TRAHKABSP63 KL_TRAHKABSP63_EL KL_TRAMTHINSYNKABSP63 KL_TSYNMTKABSP63 T_HINSYNSP63 /end DEF_CHARACTERISTIC
/end FUNCTION
/begin FUNCTION jSasKabRSP264_Fktn "Applikationesgroessen Instanz jSasKabRSP264"
 /begin DEF_CHARACTERISTIC F_PRAHKABSP64 F_TRAHKABSP64 KF_PKABSP64 KF_PKABSP64_EL KF_POHINSYNKABSP64 KF_TOHKABMTNTSP64 KF_TSYNMTNTKABVSP64 KL_PGOKABSP64 KL_POHKABSP64 KL_TRAHKABSP64 KL_TRAHKABSP64_EL KL_TRAMTHINSYNKABSP64 KL_TSYNMTKABSP64 T_HINSYNSP64 /end DEF_CHARACTERISTIC
/end FUNCTION
/begin FUNCTION jSasKabRSP271_Fktn "Applikationesgroessen Instanz jSasKabRSP271"
 /begin DEF_CHARACTERISTIC F_PRAHKABSP71 F_TRAHKABSP71 KF_PKABSP71 KF_POHINSYNKABSP71 KF_TOHKABMTNTSP71 KF_TSYNMTNTKABVSP71 KL_PGOKABSP71 KL_POHKABSP71 KL_TRAHKABSP71 KL_TRAMTHINSYNKABSP71 KL_TSYNMTKABSP71 T_HINSYNSP71 /end DEF_CHARACTERISTIC
/end FUNCTION
/begin FUNCTION jSasKabRSP275_Fktn "Applikationesgroessen Instanz jSasKabRSP275"
 /begin DEF_CHARACTERISTIC F_PRAHKABSP75 F_TRAHKABSP75 KF_PKABSP75 KF_PKABSP75_EL KF_POHINSYNKABSP75 KF_TOHKABMTNTSP75 KF_TSYNMTNTKABVSP75 KL_PGOKABSP75 KL_POHKABSP75 KL_TRAHKABSP75 KL_TRAHKABSP75_EL KL_TRAMTHINSYNKABSP75 KL_TSYNMTKABSP75 T_HINSYNSP75 /end DEF_CHARACTERISTIC
/end FUNCTION
/begin FUNCTION jSasKabRSP282_Fktn "Applikationesgroessen Instanz jSasKabRSP282"
 /begin DEF_CHARACTERISTIC F_PRAHKABSP82 F_TRAHKABSP82 KF_PKABSP82 KF_PKABSP82_EL KF_POHINSYNKABSP82 KF_TOHKABMTNTSP82 KF_TSYNMTNTKABVSP82 KL_PGOKABSP82 KL_POHKABSP82 KL_TRAHKABSP82 KL_TRAHKABSP82_EL KL_TRAMTHINSYNKABSP82 KL_TSYNMTKABSP82 T_HINSYNSP82 /end DEF_CHARACTERISTIC
/end FUNCTION
/begin FUNCTION jSasKabRSP284_Fktn "Applikationesgroessen Instanz jSasKabRSP284"
 /begin DEF_CHARACTERISTIC F_PRAHKABSP84 F_TRAHKABSP84 KF_PKABSP84 KF_PKABSP84_EL KF_POHINSYNKABSP84 KF_TOHKABMTNTSP84 KF_TSYNMTNTKABVSP84 KL_PGOKABSP84 KL_POHKABSP84 KL_TRAHKABSP84 KL_TRAHKABSP84_EL KL_TRAMTHINSYNKABSP84 KL_TSYNMTKABSP84 T_HINSYNSP84 /end DEF_CHARACTERISTIC
/end FUNCTION
/begin FUNCTION jSasKabRSP286_Fktn "Applikationesgroessen Instanz jSasKabRSP286"
 /begin DEF_CHARACTERISTIC F_PRAHKABSP86 F_TRAHKABSP86 KF_PKABSP86 KF_PKABSP86_EL KF_POHINSYNKABSP86 KF_TOHKABMTNTSP86 KF_TSYNMTNTKABVSP86 KL_PGOKABSP86 KL_POHKABSP86 KL_TRAHKABSP86 KL_TRAHKABSP86_EL KL_TRAMTHINSYNKABSP86 KL_TSYNMTKABSP86 T_HINSYNSP86 /end DEF_CHARACTERISTIC
/end FUNCTION
/begin FUNCTION jSasKabRSP321_Fktn "Applikationesgroessen Instanz jSasKabRSP321"
 /begin DEF_CHARACTERISTIC F_PRAHKABSPORT21 F_TRAHKABSPORT21 KF_PKABSPORT21 KF_POHINSYNKABSPORT21 KF_TOHKABMTNTSPORT21 KF_TSYNMTNTKABVSPORT21 KL_PGOKABSPORT21 KL_POHKABSPORT21 KL_TRAHKABSPORT21 KL_TRAMTHINSYNKABSPORT21 KL_TSYNMTKABSPORT21 T_HINSYNSPORT21 /end DEF_CHARACTERISTIC
/end FUNCTION
/begin FUNCTION jSasKabRSP332_Fktn "Applikationesgroessen Instanz jSasKabRSP332"
 /begin DEF_CHARACTERISTIC F_PRAHKABSPORT32 F_TRAHKABSPORT32 KF_PKABSPORT32 KF_POHINSYNKABSPORT32 KF_TOHKABMTNTSPORT32 KF_TSYNMTNTKABVSPORT32 KL_PGOKABSPORT32 KL_POHKABSPORT32 KL_TRAHKABSPORT32 KL_TRAMTHINSYNKABSPORT32 KL_TSYNMTKABSPORT32 T_HINSYNSPORT32 /end DEF_CHARACTERISTIC
/end FUNCTION
/begin FUNCTION jSasKabRSP343_Fktn "Applikationesgroessen Instanz jSasKabRSP343"
 /begin DEF_CHARACTERISTIC F_PRAHKABSPORT43 F_TRAHKABSPORT43 KF_PKABSPORT43 KF_POHINSYNKABSPORT43 KF_TOHKABMTNTSPORT43 KF_TSYNMTNTKABVSPORT43 KL_PGOKABSPORT43 KL_POHKABSPORT43 KL_TRAHKABSPORT43 KL_TRAMTHINSYNKABSPORT43 KL_TSYNMTKABSPORT43 T_HINSYNSPORT43 /end DEF_CHARACTERISTIC
/end FUNCTION
/begin FUNCTION jSasKabRSP354_Fktn "Applikationesgroessen Instanz jSasKabRSP354"
 /begin DEF_CHARACTERISTIC F_PRAHKABSPORT54 F_TRAHKABSPORT54 KF_PKABSPORT54 KF_POHINSYNKABSPORT54 KF_TOHKABMTNTSPORT54 KF_TSYNMTNTKABVSPORT54 KL_PGOKABSPORT54 KL_POHKABSPORT54 KL_TRAHKABSPORT54 KL_TRAMTHINSYNKABSPORT54 KL_TSYNMTKABSPORT54 T_HINSYNSPORT54 /end DEF_CHARACTERISTIC
/end FUNCTION
/begin FUNCTION jSasKabRSP365_Fktn "Applikationesgroessen Instanz jSasKabRSP365"
 /begin DEF_CHARACTERISTIC F_PRAHKABSPORT65 F_TRAHKABSPORT65 KF_PKABSPORT65 KF_POHINSYNKABSPORT65 KF_TOHKABMTNTSPORT65 KF_TSYNMTNTKABVSPORT65 KL_PGOKABSPORT65 KL_POHKABSPORT65 KL_TRAHKABSPORT65 KL_TRAMTHINSYNKABSPORT65 KL_TSYNMTKABSPORT65 T_HINSYNSPORT65 /end DEF_CHARACTERISTIC
/end FUNCTION
/begin FUNCTION jSasKabRSP376_Fktn "Applikationesgroessen Instanz jSasKabRSP376"
 /begin DEF_CHARACTERISTIC F_PRAHKABSPORT76 F_TRAHKABSPORT76 KF_PKABSPORT76 KF_POHINSYNKABSPORT76 KF_TOHKABMTNTSPORT76 KF_TSYNMTNTKABVSPORT76 KL_PGOKABSPORT76 KL_POHKABSPORT76 KL_TRAHKABSPORT76 KL_TRAMTHINSYNKABSPORT76 KL_TSYNMTKABSPORT76 T_HINSYNSPORT76 /end DEF_CHARACTERISTIC
/end FUNCTION
/begin FUNCTION jSasKabRSP387_Fktn "Applikationesgroessen Instanz jSasKabRSP387"
 /begin DEF_CHARACTERISTIC F_PRAHKABSPORT87 F_TRAHKABSPORT87 KF_PKABSPORT87 KF_POHINSYNKABSPORT87 KF_TOHKABMTNTSPORT87 KF_TSYNMTNTKABVSPORT87 KL_PGOKABSPORT87 KL_POHKABSPORT87 KL_TRAHKABSPORT87 KL_TRAMTHINSYNKABSPORT87 KL_TSYNMTKABSPORT87 T_HINSYNSPORT87 /end DEF_CHARACTERISTIC
/end FUNCTION
/begin FUNCTION jSasKabRSP331_Fktn "Applikationesgroessen Instanz jSasKabRSP331"
 /begin DEF_CHARACTERISTIC F_PRAHKABSPORT31 F_TRAHKABSPORT31 KF_PKABSPORT31 KF_POHINSYNKABSPORT31 KF_TOHKABMTNTSPORT31 KF_TSYNMTNTKABVSPORT31 KL_PGOKABSPORT31 KL_POHKABSPORT31 KL_TRAHKABSPORT31 KL_TRAMTHINSYNKABSPORT31 KL_TSYNMTKABSPORT31 T_HINSYNSPORT31 /end DEF_CHARACTERISTIC
/end FUNCTION
/begin FUNCTION jSasKabRSP342_Fktn "Applikationesgroessen Instanz jSasKabRSP342"
 /begin DEF_CHARACTERISTIC F_PRAHKABSPORT42 F_TRAHKABSPORT42 KF_PKABSPORT42 KF_POHINSYNKABSPORT42 KF_TOHKABMTNTSPORT42 KF_TSYNMTNTKABVSPORT42 KL_PGOKABSPORT42 KL_POHKABSPORT42 KL_TRAHKABSPORT42 KL_TRAMTHINSYNKABSPORT42 KL_TSYNMTKABSPORT42 T_HINSYNSPORT42 /end DEF_CHARACTERISTIC
/end FUNCTION
/begin FUNCTION jSasKabRSP351_Fktn "Applikationesgroessen Instanz jSasKabRSP351"
 /begin DEF_CHARACTERISTIC F_PRAHKABSPORT51 F_TRAHKABSPORT51 KF_PKABSPORT51 KF_POHINSYNKABSPORT51 KF_TOHKABMTNTSPORT51 KF_TSYNMTNTKABVSPORT51 KL_PGOKABSPORT51 KL_POHKABSPORT51 KL_TRAHKABSPORT51 KL_TRAMTHINSYNKABSPORT51 KL_TSYNMTKABSPORT51 T_HINSYNSPORT51 /end DEF_CHARACTERISTIC
/end FUNCTION
/begin FUNCTION jSasKabRSP353_Fktn "Applikationesgroessen Instanz jSasKabRSP353"
 /begin DEF_CHARACTERISTIC F_PRAHKABSPORT53 F_TRAHKABSPORT53 KF_PKABSPORT53 KF_POHINSYNKABSPORT53 KF_TOHKABMTNTSPORT53 KF_TSYNMTNTKABVSPORT53 KL_PGOKABSPORT53 KL_POHKABSPORT53 KL_TRAHKABSPORT53 KL_TRAMTHINSYNKABSPORT53 KL_TSYNMTKABSPORT53 T_HINSYNSPORT53 /end DEF_CHARACTERISTIC
/end FUNCTION
/begin FUNCTION jSasKabRSP363_Fktn "Applikationesgroessen Instanz jSasKabRSP363"
 /begin DEF_CHARACTERISTIC F_PRAHKABSPORT63 F_TRAHKABSPORT63 KF_PKABSPORT63 KF_POHINSYNKABSPORT63 KF_TOHKABMTNTSPORT63 KF_TSYNMTNTKABVSPORT63 KL_PGOKABSPORT63 KL_POHKABSPORT63 KL_TRAHKABSPORT63 KL_TRAMTHINSYNKABSPORT63 KL_TSYNMTKABSPORT63 T_HINSYNSPORT63 /end DEF_CHARACTERISTIC
/end FUNCTION
/begin FUNCTION jSasKabRSP364_Fktn "Applikationesgroessen Instanz jSasKabRSP364"
 /begin DEF_CHARACTERISTIC F_PRAHKABSPORT64 F_TRAHKABSPORT64 KF_PKABSPORT64 KF_POHINSYNKABSPORT64 KF_TOHKABMTNTSPORT64 KF_TSYNMTNTKABVSPORT64 KL_PGOKABSPORT64 KL_POHKABSPORT64 KL_TRAHKABSPORT64 KL_TRAMTHINSYNKABSPORT64 KL_TSYNMTKABSPORT64 T_HINSYNSPORT64 /end DEF_CHARACTERISTIC
/end FUNCTION
/begin FUNCTION jSasKabRSP371_Fktn "Applikationesgroessen Instanz jSasKabRSP371"
 /begin DEF_CHARACTERISTIC F_PRAHKABSPORT71 F_TRAHKABSPORT71 KF_PKABSPORT71 KF_POHINSYNKABSPORT71 KF_TOHKABMTNTSPORT71 KF_TSYNMTNTKABVSPORT71 KL_PGOKABSPORT71 KL_POHKABSPORT71 KL_TRAHKABSPORT71 KL_TRAMTHINSYNKABSPORT71 KL_TSYNMTKABSPORT71 T_HINSYNSPORT71 /end DEF_CHARACTERISTIC
/end FUNCTION
/begin FUNCTION jSasKabRSP375_Fktn "Applikationesgroessen Instanz jSasKabRSP375"
 /begin DEF_CHARACTERISTIC F_PRAHKABSPORT75 F_TRAHKABSPORT75 KF_PKABSPORT75 KF_POHINSYNKABSPORT75 KF_TOHKABMTNTSPORT75 KF_TSYNMTNTKABVSPORT75 KL_PGOKABSPORT75 KL_POHKABSPORT75 KL_TRAHKABSPORT75 KL_TRAMTHINSYNKABSPORT75 KL_TSYNMTKABSPORT75 T_HINSYNSPORT75 /end DEF_CHARACTERISTIC
/end FUNCTION
/begin FUNCTION jSasKabRSP382_Fktn "Applikationesgroessen Instanz jSasKabRSP382"
 /begin DEF_CHARACTERISTIC F_PRAHKABSPORT82 F_TRAHKABSPORT82 KF_PKABSPORT82 KF_POHINSYNKABSPORT82 KF_TOHKABMTNTSPORT82 KF_TSYNMTNTKABVSPORT82 KL_PGOKABSPORT82 KL_POHKABSPORT82 KL_TRAHKABSPORT82 KL_TRAMTHINSYNKABSPORT82 KL_TSYNMTKABSPORT82 T_HINSYNSPORT82 /end DEF_CHARACTERISTIC
/end FUNCTION
/begin FUNCTION jSasKabRSP384_Fktn "Applikationesgroessen Instanz jSasKabRSP384"
 /begin DEF_CHARACTERISTIC F_PRAHKABSPORT84 F_TRAHKABSPORT84 KF_PKABSPORT84 KF_POHINSYNKABSPORT84 KF_TOHKABMTNTSPORT84 KF_TSYNMTNTKABVSPORT84 KL_PGOKABSPORT84 KL_POHKABSPORT84 KL_TRAHKABSPORT84 KL_TRAMTHINSYNKABSPORT84 KL_TSYNMTKABSPORT84 T_HINSYNSPORT84 /end DEF_CHARACTERISTIC
/end FUNCTION
/begin FUNCTION jSasKabRSP386_Fktn "Applikationesgroessen Instanz jSasKabRSP386"
 /begin DEF_CHARACTERISTIC F_PRAHKABSPORT86 F_TRAHKABSPORT86 KF_PKABSPORT86 KF_POHINSYNKABSPORT86 KF_TOHKABMTNTSPORT86 KF_TSYNMTNTKABVSPORT86 KL_PGOKABSPORT86 KL_POHKABSPORT86 KL_TRAHKABSPORT86 KL_TRAMTHINSYNKABSPORT86 KL_TSYNMTKABSPORT86 T_HINSYNSPORT86 /end DEF_CHARACTERISTIC
/end FUNCTION
/begin FUNCTION dSasKabEHS_Fktn "Applikationesgroessen der Komponente dSasKabEHS"
 /begin SUB_FUNCTION jSasKabEHS12_Fktn jSasKabEHS23_Fktn jSasKabEHS34_Fktn jSasKabEHS45_Fktn jSasKabEHS56_Fktn jSasKabEHS67_Fktn jSasKabEHS78_Fktn /end SUB_FUNCTION
/end FUNCTION
/begin FUNCTION jSasKabEHS12_Fktn "Applikationesgroessen Instanz jSasKabEHS12"
 /begin DEF_CHARACTERISTIC KF_TSYNMTNTKABV12 KL_POKABV12 KL_POKABVFOLNACHDHS12 T_RAABV12 T_RAABVFOLNACHDHS12 /end DEF_CHARACTERISTIC
/end FUNCTION
/begin FUNCTION jSasKabEHS23_Fktn "Applikationesgroessen Instanz jSasKabEHS23"
 /begin DEF_CHARACTERISTIC KF_TSYNMTNTKABV23 KL_POKABV23 KL_POKABVFOLNACHDHS23 T_RAABV23 T_RAABVFOLNACHDHS23 /end DEF_CHARACTERISTIC
/end FUNCTION
/begin FUNCTION jSasKabEHS34_Fktn "Applikationesgroessen Instanz jSasKabEHS34"
 /begin DEF_CHARACTERISTIC KF_TSYNMTNTKABV34 KL_POKABV34 KL_POKABVFOLNACHDHS34 T_RAABV34 T_RAABVFOLNACHDHS34 /end DEF_CHARACTERISTIC
/end FUNCTION
/begin FUNCTION jSasKabEHS45_Fktn "Applikationesgroessen Instanz jSasKabEHS45"
 /begin DEF_CHARACTERISTIC KF_TSYNMTNTKABV45 KL_POKABV45 KL_POKABVFOLNACHDHS45 T_RAABV45 T_RAABVFOLNACHDHS45 /end DEF_CHARACTERISTIC
/end FUNCTION
/begin FUNCTION jSasKabEHS56_Fktn "Applikationesgroessen Instanz jSasKabEHS56"
 /begin DEF_CHARACTERISTIC KF_TSYNMTNTKABV56 KL_POKABV56 KL_POKABVFOLNACHDHS56 T_RAABV56 T_RAABVFOLNACHDHS56 /end DEF_CHARACTERISTIC
/end FUNCTION
/begin FUNCTION jSasKabEHS67_Fktn "Applikationesgroessen Instanz jSasKabEHS67"
 /begin DEF_CHARACTERISTIC KF_TSYNMTNTKABV67 KL_POKABV67 KL_POKABVFOLNACHDHS67 T_RAABV67 T_RAABVFOLNACHDHS67 /end DEF_CHARACTERISTIC
/end FUNCTION
/begin FUNCTION jSasKabEHS78_Fktn "Applikationesgroessen Instanz jSasKabEHS78"
 /begin DEF_CHARACTERISTIC KF_TSYNMTNTKABV78 KL_POKABV78 KL_POKABVFOLNACHDHS78 T_RAABV78 T_RAABVFOLNACHDHS78 /end DEF_CHARACTERISTIC
/end FUNCTION
/begin FUNCTION dSasKzuHSP_Fktn "Applikationesgroessen der Komponente dSasKzuHSP"
 /begin SUB_FUNCTION jSasKzuHSP112_Fktn jSasKzuHSP123_Fktn jSasKzuHSP134_Fktn jSasKzuHSP145_Fktn jSasKzuHSP156_Fktn jSasKzuHSP167_Fktn jSasKzuHSP178_Fktn jSasKzuHSP212_Fktn jSasKzuHSP223_Fktn jSasKzuHSP234_Fktn jSasKzuHSP245_Fktn jSasKzuHSP256_Fktn jSasKzuHSP267_Fktn jSasKzuHSP278_Fktn jSasKzuHSP312_Fktn jSasKzuHSP323_Fktn jSasKzuHSP334_Fktn jSasKzuHSP345_Fktn jSasKzuHSP356_Fktn jSasKzuHSP367_Fktn jSasKzuHSP378_Fktn jSasKzuHSP113_Fktn jSasKzuHSP124_Fktn jSasKzuHSP135_Fktn jSasKzuHSP146_Fktn jSasKzuHSP157_Fktn jSasKzuHSP168_Fktn jSasKzuHSP213_Fktn jSasKzuHSP224_Fktn jSasKzuHSP235_Fktn jSasKzuHSP246_Fktn jSasKzuHSP257_Fktn jSasKzuHSP268_Fktn jSasKzuHSP313_Fktn jSasKzuHSP324_Fktn jSasKzuHSP335_Fktn jSasKzuHSP346_Fktn jSasKzuHSP357_Fktn jSasKzuHSP368_Fktn /end SUB_FUNCTION
/end FUNCTION
/begin FUNCTION jSasKzuHSP112_Fktn "Applikationesgroessen Instanz jSasKzuHSP112"
 /begin DEF_CHARACTERISTIC F_PRA12 F_PRA12_EL F_TRA12 F_TRA12_EL KF_PGOKZUMTNT12 KF_PGOKZUMTNT12_EL KF_PKZU12 KF_PKZU12_EL KF_POFMTN12 KF_POFMTN12_EL KF_POKZUMTCG12 KF_POKZUMTCG12_EL KF_T2_DT_IG_CHANGE12 KF_TFCGNT12 KF_TFCGNT12_EL KF_TRAMTNT12 KF_TRAMTNT12_EL KF_T_DT_IG_CHANGE12 KF_T_DT_IG_CHANGE12_EL KL_TSYNMTRAKZU12 KL_TSYNMTRAKZU12_EL T_VKZU12 T_VKZU12_EL /end DEF_CHARACTERISTIC
/end FUNCTION
/begin FUNCTION jSasKzuHSP123_Fktn "Applikationesgroessen Instanz jSasKzuHSP123"
 /begin DEF_CHARACTERISTIC F_PRA23 F_PRA23_EL F_TRA23 F_TRA23_EL KF_PGOKZUMTNT23 KF_PGOKZUMTNT23_EL KF_PKZU23 KF_PKZU23_EL KF_POFMTN23 KF_POFMTN23_EL KF_POKZUMTCG23 KF_POKZUMTCG23_EL KF_T2_DT_IG_CHANGE23 KF_TFCGNT23 KF_TFCGNT23_EL KF_TRAMTNT23 KF_TRAMTNT23_EL KF_T_DT_IG_CHANGE23 KF_T_DT_IG_CHANGE23_EL KL_TSYNMTRAKZU23 KL_TSYNMTRAKZU23_EL T_VKZU23 T_VKZU23_EL /end DEF_CHARACTERISTIC
/end FUNCTION
/begin FUNCTION jSasKzuHSP134_Fktn "Applikationesgroessen Instanz jSasKzuHSP134"
 /begin DEF_CHARACTERISTIC F_PRA34 F_PRA34_EL F_TRA34 F_TRA34_EL KF_PGOKZUMTNT34 KF_PGOKZUMTNT34_EL KF_PKZU34 KF_PKZU34_EL KF_POFMTN34 KF_POFMTN34_EL KF_POKZUMTCG34 KF_POKZUMTCG34_EL KF_T2_DT_IG_CHANGE34 KF_TFCGNT34 KF_TFCGNT34_EL KF_TRAMTNT34 KF_TRAMTNT34_EL KF_T_DT_IG_CHANGE34 KF_T_DT_IG_CHANGE34_EL KL_TSYNMTRAKZU34 KL_TSYNMTRAKZU34_EL T_VKZU34 T_VKZU34_EL /end DEF_CHARACTERISTIC
/end FUNCTION
/begin FUNCTION jSasKzuHSP145_Fktn "Applikationesgroessen Instanz jSasKzuHSP145"
 /begin DEF_CHARACTERISTIC F_PRA45 F_PRA45_EL F_TRA45 F_TRA45_EL KF_PGOKZUMTNT45 KF_PGOKZUMTNT45_EL KF_PKZU45 KF_PKZU45_EL KF_POFMTN45 KF_POFMTN45_EL KF_POKZUMTCG45 KF_POKZUMTCG45_EL KF_T2_DT_IG_CHANGE45 KF_TFCGNT45 KF_TFCGNT45_EL KF_TRAMTNT45 KF_TRAMTNT45_EL KF_T_DT_IG_CHANGE45 KF_T_DT_IG_CHANGE45_EL KL_TSYNMTRAKZU45 KL_TSYNMTRAKZU45_EL T_VKZU45 T_VKZU45_EL /end DEF_CHARACTERISTIC
/end FUNCTION
/begin FUNCTION jSasKzuHSP156_Fktn "Applikationesgroessen Instanz jSasKzuHSP156"
 /begin DEF_CHARACTERISTIC F_PRA56 F_PRA56_EL F_TRA56 F_TRA56_EL KF_PGOKZUMTNT56 KF_PGOKZUMTNT56_EL KF_PKZU56 KF_PKZU56_EL KF_POFMTN56 KF_POFMTN56_EL KF_POKZUMTCG56 KF_POKZUMTCG56_EL KF_T2_DT_IG_CHANGE56 KF_TFCGNT56 KF_TFCGNT56_EL KF_TRAMTNT56 KF_TRAMTNT56_EL KF_T_DT_IG_CHANGE56 KF_T_DT_IG_CHANGE56_EL KL_TSYNMTRAKZU56 KL_TSYNMTRAKZU56_EL T_VKZU56 T_VKZU56_EL /end DEF_CHARACTERISTIC
/end FUNCTION
/begin FUNCTION jSasKzuHSP167_Fktn "Applikationesgroessen Instanz jSasKzuHSP167"
 /begin DEF_CHARACTERISTIC F_PRA67 F_PRA67_EL F_TRA67 F_TRA67_EL KF_PGOKZUMTNT67 KF_PGOKZUMTNT67_EL KF_PKZU67 KF_PKZU67_EL KF_POFMTN67 KF_POFMTN67_EL KF_POKZUMTCG67 KF_POKZUMTCG67_EL KF_T2_DT_IG_CHANGE67 KF_TFCGNT67 KF_TFCGNT67_EL KF_TRAMTNT67 KF_TRAMTNT67_EL KF_T_DT_IG_CHANGE67 KF_T_DT_IG_CHANGE67_EL KL_TSYNMTRAKZU67 KL_TSYNMTRAKZU67_EL T_VKZU67 T_VKZU67_EL /end DEF_CHARACTERISTIC
/end FUNCTION
/begin FUNCTION jSasKzuHSP178_Fktn "Applikationesgroessen Instanz jSasKzuHSP178"
 /begin DEF_CHARACTERISTIC F_PRA78 F_PRA78_EL F_TRA78 F_TRA78_EL KF_PGOKZUMTNT78 KF_PGOKZUMTNT78_EL KF_PKZU78 KF_PKZU78_EL KF_POFMTN78 KF_POFMTN78_EL KF_POKZUMTCG78 KF_POKZUMTCG78_EL KF_T2_DT_IG_CHANGE78 KF_TFCGNT78 KF_TFCGNT78_EL KF_TRAMTNT78 KF_TRAMTNT78_EL KF_T_DT_IG_CHANGE78 KF_T_DT_IG_CHANGE78_EL KL_TSYNMTRAKZU78 KL_TSYNMTRAKZU78_EL T_VKZU78 T_VKZU78_EL /end DEF_CHARACTERISTIC
/end FUNCTION
/begin RECORD_LAYOUT kw_ui8_S6_S3 FNC_VALUES 1 UBYTE COLUMN_DIR DIRECT /end RECORD_LAYOUT
/begin RECORD_LAYOUT kl_ui8_S6_S3 FNC_VALUES 3 UBYTE COLUMN_DIR DIRECT AXIS_PTS_X 2 UBYTE INDEX_INCR DIRECT NO_AXIS_PTS_X 1 ULONG /end RECORD_LAYOUT
/begin RECORD_LAYOUT kl_si16_S6_S3 FNC_VALUES 3 SWORD COLUMN_DIR DIRECT AXIS_PTS_X 2 SWORD INDEX_INCR DIRECT NO_AXIS_PTS_X 1 ULONG /end RECORD_LAYOUT
/begin RECORD_LAYOUT kf_ui8_S6_S3 FNC_VALUES 5 UBYTE ROW_DIR DIRECT AXIS_PTS_X 3 UBYTE INDEX_INCR DIRECT AXIS_PTS_Y 4 UBYTE INDEX_INCR DIRECT NO_AXIS_PTS_X 1 ULONG NO_AXIS_PTS_Y 2 ULONG /end RECORD_LAYOUT
/begin RECORD_LAYOUT kf_si16_S6_S3 FNC_VALUES 5 SWORD ROW_DIR DIRECT AXIS_PTS_X 3 SWORD INDEX_INCR DIRECT AXIS_PTS_Y 4 SWORD INDEX_INCR DIRECT NO_AXIS_PTS_X 1 ULONG NO_AXIS_PTS_Y 2 ULONG /end RECORD_LAYOUT
/end MODULE
/end PROJECT
