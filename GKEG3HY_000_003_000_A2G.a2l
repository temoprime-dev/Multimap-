ASAP2_VERSION 1 51
/begin PROJECT _929_929 "Gen2_BMW_System_Supplier_Lib"
/begin HEADER "" VERSION "C_03_03" PROJECT_NO _929_929 /end HEADER
/begin MODULE DIM ""
/begin MOD_COMMON "" BYTE_ORDER MSB_FIRST ALIGNMENT_BYTE 1 ALIGNMENT_WORD 2 ALIGNMENT_LONG 4 ALIGNMENT_FLOAT32_IEEE 4 /end MOD_COMMON
/begin CHARACTERISTIC sIepEinschaltbed.NS_HYBRID_IEP "Einschaltschwelle beim hybridischen Fahren" VALUE 0x217A3C Parameter.ui16_S6_S3 1500 UMRM_U_MIN_1_1_0_S6_S3 0 1500 /end CHARACTERISTIC
/begin CHARACTERISTIC sIepEinschaltbed.NS_HYBRID_HYS_IEP "Hysterese zur Einschaltschwelle beim hybridischen Fahren" VALUE 0x217A3E Parameter.ui8_S6_S3 200 UMRM_U_MIN_1_1_0_S6_S3 0 200 /end CHARACTERISTIC
/begin CHARACTERISTIC sIepEinschaltbed.SWI_P_STUE_HYBRID_PSS_IEP "Schalter um die Funktion Systemeinbrüche im hybridischen zu aktivieren:0 = Funktion deaktiviert 1 = Funktion aktiviert" VALUE 0x217A3F Parameter.ui8_S6_S3 255 UMRM___1_1_0_S6_S3 0 255 /end CHARACTERISTIC
/begin CHARACTERISTIC sIepEinschaltbed.TAB_T_AN_MIN_LP_IEP "Tabelle zur Eingabe der Mindestlaufzeit der IEP in einem LP" MAP 0x217A40 Matrix.ui8_S6_S3 30 UMRM_SEC__1_1_0_S6_S3 0 30
 /begin AXIS_DESCR FIX_AXIS NO_INPUT_QUANTITY eIepIst_S6_S3 5 0 4 FIX_AXIS_PAR_DIST 0 1 5 /end AXIS_DESCR
 /begin AXIS_DESCR FIX_AXIS NO_INPUT_QUANTITY eIepSoll_S6_S3 4 0 3 FIX_AXIS_PAR_DIST 0 1 4 /end AXIS_DESCR
/end CHARACTERISTIC
/begin CHARACTERISTIC sIepKoordi.SWI_VORGABE_MANUELL_IEP "Schalter für manuelle Istvorgange des Leistungspunktes der el. Zusatzpumpe, 0 = Funktion deaktiviert, 1 = Funktion aktiviert" VALUE 0x2132D9 Parameter.ui8_S6_S3 255 UMRM___1_1_0_S6_S3 0 255 /end CHARACTERISTIC
/begin CHARACTERISTIC sIepKoordi.SWI_IEP "Schalter zum Einschalten der Pumpe, 0 = Ausschalten der Pumpe, 1 = Einschalten der Pumpe" VALUE 0x2132D8 Parameter.ui8_S6_S3 255 UMRM___1_1_0_S6_S3 0 255 /end CHARACTERISTIC
/begin CHARACTERISTIC sIepKoordi.VORGABE_MANUELL_IEP "Ist-Zustand Vorgabe der elektrischen Zusatzpumpe wenn SWI_VORGABE_MANUELL=1" VALUE 0x2132DB Parameter.ui8_S6_S3 3 eIepSoll_S6_S3 0 3 /end CHARACTERISTIC
/begin CHARACTERISTIC sIepKoordi.T_FEHLER_RESET_IEP "Zeit , die die Pumpe mit 0 Prozent PWM angesteuert werden muss damit ein Reset durchgeführt werden kann" VALUE 0x2132DA Parameter.ui8_S6_S3 1 UMRM_SEC__1_100_0_S6_S3 0 1 /end CHARACTERISTIC
/begin MEASUREMENT sIepEinschaltbed.f_an_aus_iep "Flag fuer die Freigabe zum Einschalten der IEP." UBYTE eBool_true_false_S6_S3 1 100 0 1 ECU_ADDRESS 0xFFF85718 /end MEASUREMENT
/begin MEASUREMENT sIepEinschaltbed.f_ns_iep "Flag zur Anzeige, ob die berechnete und korrigierte Motordrehzahlschwelle unterschritten wird." UBYTE eBool_true_false_S6_S3 1 100 0 1 ECU_ADDRESS 0xFFF85719 /end MEASUREMENT
/begin MEASUREMENT sIepEinschaltbed.t_an_min_lp_iep "Sperrtimer Leistungspunktwechsel" UWORD UMRM_MSEC__10_1_0_S6_S3 1 100 0 655350 ECU_ADDRESS 0xFFF85714 /end MEASUREMENT
/begin MEASUREMENT sIepEinschaltbed.ts_an_min_lp_iep "Sperrzeit bis Leistungspunktwechsel erlaubt ist" UWORD UMRM_MSEC__10_1_0_S6_S3 1 100 0 655350 ECU_ADDRESS 0xFFF85716 /end MEASUREMENT
/begin MEASUREMENT sIepEinschaltbed.f_ts_lp_iep "Flag zur Anzeige das der Wechsel in ein niedrigeren Leistungspunkt verhindert wird" UBYTE eBool_true_false_S6_S3 1 100 0 1 ECU_ADDRESS 0xFFF8571A /end MEASUREMENT
/begin MEASUREMENT sIepKoordi.zustand_iep "Zustand der IEP" UBYTE eIepZust_S6_S3 1 100 0 6 ECU_ADDRESS 0xFFF852F3 /end MEASUREMENT
/begin MEASUREMENT sIepKoordi.ziel_iep "Zielvorgabe an die Hardware" UBYTE eIepIst_S6_S3 1 100 0 4 ECU_ADDRESS 0xFFF852F2 /end MEASUREMENT
/begin MEASUREMENT iUl2K0SPlausiDrehzInt.cUl2K0SPlausiInt._.n_diff_k0 "Differenz zwischen E-Maschinendrehz. u. Verbrennungsmotoerdrehz." SLONG UMR_U_MIN_1_1_0_S6_S3 1 100 0 65535 DISPLAY_IDENTIFIER n_diff_k0._.cUl2K0SPlausiInt.iUl2K0SPlausiDrehzInt ECU_ADDRESS 0xFFF8F3DC /end MEASUREMENT
/begin MEASUREMENT iUl2K0SPlausiDrehzInt.cUl2K0SPlausiInt._.n_diff_k0_einmalig "Wenn der Wert auf TRUE steht, dann wird die Überwachung gestartet." UBYTE Conv.cUl2K0SPlausiInt._.n_diff_k0_einmalig_S6_S3 1 100 0 1 BIT_MASK 0x1 DISPLAY_IDENTIFIER n_diff_k0_einmalig._.cUl2K0SPlausiInt.iUl2K0SPlausiDrehzInt ECU_ADDRESS 0xFFF8F3E0 /end MEASUREMENT
/begin MEASUREMENT iUl2K0SPlausiDrehzInt.cUl2K0SPlausiInt._.st_fehler "Gibt an ob ein Fehler vorhanden ist" UBYTE Conv.cUl2K0SPlausiInt._.st_fehler_S6_S3 1 100 0 2 DISPLAY_IDENTIFIER st_fehler._.cUl2K0SPlausiInt.iUl2K0SPlausiDrehzInt ECU_ADDRESS 0xFFF8F3E1 /end MEASUREMENT
/begin MEASUREMENT iUl2K0SPlausiDrehzInt.cUl2K0SPlausiInt._.n_stoeredslogik_k0 "Störzähler, der angibt ob überwacht wird" UWORD UMR___1_1_0_S6_S3 1 100 0 65535 DISPLAY_IDENTIFIER n_stoeredslogik_k0._.cUl2K0SPlausiInt.iUl2K0SPlausiDrehzInt ECU_ADDRESS 0xFFF8F3E2 /end MEASUREMENT
/begin MEASUREMENT iUl2K0SPlausiDrehzInt.cUl2K0SPlausiInt._.n_i_eds_k0_bed "Bedingung, nach wieviel Zyklen die Kupplung wieder als offen erkannt wird" UWORD UMR___1_1_0_S6_S3 1 100 0 256 DISPLAY_IDENTIFIER n_i_eds_k0_bed._.cUl2K0SPlausiInt.iUl2K0SPlausiDrehzInt ECU_ADDRESS 0xFFF8F3E4 /end MEASUREMENT
/begin MEASUREMENT iUl2K0SPlausiDrehzInt.cUl2K0SPlausiInt._.n_k0ueb "Tasks die der Strom an der K0 unterhalb der Schwelle I_MAXK0 liegt. Bei 0 wird wieder in die Funktion eingestiegen." UBYTE UMR___1_1_0_S6_S3 1 100 0 3 DISPLAY_IDENTIFIER n_k0ueb._.cUl2K0SPlausiInt.iUl2K0SPlausiDrehzInt ECU_ADDRESS 0xFFF8F3E6 /end MEASUREMENT
/begin MEASUREMENT iUl2K0SPlausiDrehzInt.n_emeink0_n "Wert der E-Maschinendrehzahl zu Beginn der Überwachung" UWORD UMR_U_MIN_1_1_0_S6_S3 1 100 0 65535 DISPLAY_IDENTIFIER n_emeink0_n.iUl2K0SPlausiDrehzInt ECU_ADDRESS 0xFFF8F3EC /end MEASUREMENT
/begin MEASUREMENT iUl2K0SPlausiDrehzInt.diff_n_em "Differenz zwischen E-Maschinendrehzahl nachdem der Störzähler über der applizierten Schwelle MAXSTOER_EDSLOGIK_K0 liegt." UWORD UMR_U_MIN_1_1_0_S6_S3 1 100 0 65535 DISPLAY_IDENTIFIER diff_n_em.iUl2K0SPlausiDrehzInt ECU_ADDRESS 0xFFF8F3EE /end MEASUREMENT
/begin MEASUREMENT iUl2K0SPlausiMomInt.cUl2K0SPlausiInt._.n_diff_k0 "Differenz zwischen E-Maschinendrehz. u. Verbrennungsmotoerdrehz." SLONG UMR_U_MIN_1_1_0_S6_S3 1 100 0 65535 DISPLAY_IDENTIFIER n_diff_k0._.cUl2K0SPlausiInt.iUl2K0SPlausiMomInt ECU_ADDRESS 0xFFF8F3F0 /end MEASUREMENT
/begin MEASUREMENT iUl2K0SPlausiMomInt.cUl2K0SPlausiInt._.n_diff_k0_einmalig "Wenn der Wert auf TRUE steht, dann wird die Überwachung gestartet." UBYTE Conv.cUl2K0SPlausiInt._.n_diff_k0_einmalig_S6_S3 1 100 0 1 BIT_MASK 0x1 DISPLAY_IDENTIFIER n_diff_k0_einmalig._.cUl2K0SPlausiInt.iUl2K0SPlausiMomInt ECU_ADDRESS 0xFFF8F3F4 /end MEASUREMENT
/begin MEASUREMENT iUl2K0SPlausiMomInt.cUl2K0SPlausiInt._.st_fehler "Gibt an ob ein Fehler vorhanden ist" UBYTE Conv.cUl2K0SPlausiInt._.st_fehler_S6_S3 1 100 0 2 DISPLAY_IDENTIFIER st_fehler._.cUl2K0SPlausiInt.iUl2K0SPlausiMomInt ECU_ADDRESS 0xFFF8F3F5 /end MEASUREMENT
/begin MEASUREMENT iUl2K0SPlausiMomInt.cUl2K0SPlausiInt._.n_stoeredslogik_k0 "Störzähler, der angibt ob überwacht wird" UWORD UMR___1_1_0_S6_S3 1 100 0 65535 DISPLAY_IDENTIFIER n_stoeredslogik_k0._.cUl2K0SPlausiInt.iUl2K0SPlausiMomInt ECU_ADDRESS 0xFFF8F3F6 /end MEASUREMENT
/begin MEASUREMENT iUl2K0SPlausiMomInt.cUl2K0SPlausiInt._.n_i_eds_k0_bed "Bedingung, nach wieviel Zyklen die Kupplung wieder als offen erkannt wird" UWORD UMR___1_1_0_S6_S3 1 100 0 256 DISPLAY_IDENTIFIER n_i_eds_k0_bed._.cUl2K0SPlausiInt.iUl2K0SPlausiMomInt ECU_ADDRESS 0xFFF8F3F8 /end MEASUREMENT
/begin MEASUREMENT iUl2K0SPlausiMomInt.cUl2K0SPlausiInt._.n_k0ueb "Tasks die der Strom an der K0 unterhalb der Schwelle I_MAXK0 liegt. Bei 0 wird wieder in die Funktion eingestiegen." UBYTE UMR___1_1_0_S6_S3 1 100 0 3 DISPLAY_IDENTIFIER n_k0ueb._.cUl2K0SPlausiInt.iUl2K0SPlausiMomInt ECU_ADDRESS 0xFFF8F3FA /end MEASUREMENT
/begin MEASUREMENT iUl2K0SPlausiMomInt.n_emeink0_m "Differenzdrehzahl zwischen E-Maschine und Verbrennungsmotor" UWORD UMR_U_MIN_1_1_0_S6_S3 1 100 0 65535 DISPLAY_IDENTIFIER n_emeink0_m.iUl2K0SPlausiMomInt ECU_ADDRESS 0xFFF8F400 /end MEASUREMENT
/begin MEASUREMENT iUl2K0SPlausiMomInt.k0_energie_min_reibw_skal "Energie zu Beginn der Überwachung minus dem applizierten Reibwert. und mit 10ms (mal 100) skaliert so. Damit entfällt die Division bei der Berechnung der Summe der Momente." SLONG UMR_NM__1_1_0_S6_S3 1 100 -32768 32767 DISPLAY_IDENTIFIER k0_energie_min_reibw_skal.iUl2K0SPlausiMomInt ECU_ADDRESS 0xFFF8F404 /end MEASUREMENT
/begin MEASUREMENT iUl2K0SPlausiMomInt.summe_momente "Summe der Momente während der Überwachung." SLONG UMR_NM__1_1_0_S6_S3 1 100 0 4194304 DISPLAY_IDENTIFIER summe_momente.iUl2K0SPlausiMomInt ECU_ADDRESS 0xFFF8F408 /end MEASUREMENT
/begin MEASUREMENT iUl2K0SPlausiDrehzFl.cUl2K0SPlausiFl._.n_diff_k0 "Differenz zwischen E-Maschinendrehz. u. Verbrennungsmotoerdrehz." FLOAT32_IEEE UMR_U_MIN_1_1_0_S6_S3 1 100 0 65535 DISPLAY_IDENTIFIER n_diff_k0._.cUl2K0SPlausiFl.iUl2K0SPlausiDrehzFl ECU_ADDRESS 0xFFF8F40C /end MEASUREMENT
/begin MEASUREMENT iUl2K0SPlausiDrehzFl.cUl2K0SPlausiFl._.n_diff_k0_einmalig "Wenn der Wert auf TRUE steht, dann wird die Überwachung gestartet." FLOAT32_IEEE UMR___1_1_0_S6_S3 1 100 0 1 FORMAT "%4.2" DISPLAY_IDENTIFIER n_diff_k0_einmalig._.cUl2K0SPlausiFl.iUl2K0SPlausiDrehzFl ECU_ADDRESS 0xFFF8F410 /end MEASUREMENT
/begin MEASUREMENT iUl2K0SPlausiDrehzFl.cUl2K0SPlausiFl._.st_fehler "Gibt an ob ein Fehler vorhanden ist" FLOAT32_IEEE UMR___1_1_0_S6_S3 1 100 0 2 FORMAT "%4.2" DISPLAY_IDENTIFIER st_fehler._.cUl2K0SPlausiFl.iUl2K0SPlausiDrehzFl ECU_ADDRESS 0xFFF8F414 /end MEASUREMENT
/begin MEASUREMENT iUl2K0SPlausiDrehzFl.cUl2K0SPlausiFl._.n_stoeredslogik_k0 "Störzähler, der angibt ob überwacht wird" FLOAT32_IEEE UMR___1_1_0_S6_S3 1 100 0 65535 FORMAT "%4.2" DISPLAY_IDENTIFIER n_stoeredslogik_k0._.cUl2K0SPlausiFl.iUl2K0SPlausiDrehzFl ECU_ADDRESS 0xFFF8F418 /end MEASUREMENT
/begin MEASUREMENT iUl2K0SPlausiDrehzFl.cUl2K0SPlausiFl._.n_i_eds_k0_bed "Bedingung, nach wieviel Zyklen die Kupplung wieder als offen erkannt wird" FLOAT32_IEEE UMR___1_1_0_S6_S3 1 100 0 256 FORMAT "%4.2" DISPLAY_IDENTIFIER n_i_eds_k0_bed._.cUl2K0SPlausiFl.iUl2K0SPlausiDrehzFl ECU_ADDRESS 0xFFF8F41C /end MEASUREMENT
/begin MEASUREMENT iUl2K0SPlausiDrehzFl.cUl2K0SPlausiFl._.n_k0ueb "Tasks die der Strom an der K0 unterhalb der Schwelle I_MAXK0 liegt. Bei 0 wird wieder in die Funktion eingestiegen." FLOAT32_IEEE UMR___1_1_0_S6_S3 1 100 0 3 FORMAT "%4.2" DISPLAY_IDENTIFIER n_k0ueb._.cUl2K0SPlausiFl.iUl2K0SPlausiDrehzFl ECU_ADDRESS 0xFFF8F420 /end MEASUREMENT
/begin MEASUREMENT iUl2K0SPlausiDrehzFl.n_emeink0_n "Wert der E-Maschinendrehzahl zu Beginn der Überwachung" FLOAT32_IEEE UMR_U_MIN_1_1_0_S6_S3 1 100 0 65535 DISPLAY_IDENTIFIER n_emeink0_n.iUl2K0SPlausiDrehzFl ECU_ADDRESS 0xFFF8F428 /end MEASUREMENT
/begin MEASUREMENT iUl2K0SPlausiDrehzFl.diff_n_em "Differenz zwischen E-Maschinendrehzahl nachdem der Störzähler über der applizierten Schwelle MAXSTOER_EDSLOGIK_K0 liegt." FLOAT32_IEEE UMR_U_MIN_1_1_0_S6_S3 1 100 -32768 32767 DISPLAY_IDENTIFIER diff_n_em.iUl2K0SPlausiDrehzFl ECU_ADDRESS 0xFFF8F42C /end MEASUREMENT
/begin MEASUREMENT iUl2K0SPlausiMomFl.cUl2K0SPlausiFl._.n_diff_k0 "Differenz zwischen E-Maschinendrehz. u. Verbrennungsmotoerdrehz." FLOAT32_IEEE UMR_U_MIN_1_1_0_S6_S3 1 100 0 65535 DISPLAY_IDENTIFIER n_diff_k0._.cUl2K0SPlausiFl.iUl2K0SPlausiMomFl ECU_ADDRESS 0xFFF8F430 /end MEASUREMENT
/begin MEASUREMENT iUl2K0SPlausiMomFl.cUl2K0SPlausiFl._.n_diff_k0_einmalig "Wenn der Wert auf TRUE steht, dann wird die Überwachung gestartet." FLOAT32_IEEE UMR___1_1_0_S6_S3 1 100 0 1 FORMAT "%4.2" DISPLAY_IDENTIFIER n_diff_k0_einmalig._.cUl2K0SPlausiFl.iUl2K0SPlausiMomFl ECU_ADDRESS 0xFFF8F434 /end MEASUREMENT
/begin MEASUREMENT iUl2K0SPlausiMomFl.cUl2K0SPlausiFl._.st_fehler "Gibt an ob ein Fehler vorhanden ist" FLOAT32_IEEE UMR___1_1_0_S6_S3 1 100 0 2 FORMAT "%4.2" DISPLAY_IDENTIFIER st_fehler._.cUl2K0SPlausiFl.iUl2K0SPlausiMomFl ECU_ADDRESS 0xFFF8F438 /end MEASUREMENT
/begin MEASUREMENT iUl2K0SPlausiMomFl.cUl2K0SPlausiFl._.n_stoeredslogik_k0 "Störzähler, der angibt ob überwacht wird" FLOAT32_IEEE UMR___1_1_0_S6_S3 1 100 0 65535 FORMAT "%4.2" DISPLAY_IDENTIFIER n_stoeredslogik_k0._.cUl2K0SPlausiFl.iUl2K0SPlausiMomFl ECU_ADDRESS 0xFFF8F43C /end MEASUREMENT
/begin MEASUREMENT iUl2K0SPlausiMomFl.cUl2K0SPlausiFl._.n_i_eds_k0_bed "Bedingung, nach wieviel Zyklen die Kupplung wieder als offen erkannt wird" FLOAT32_IEEE UMR___1_1_0_S6_S3 1 100 0 256 FORMAT "%4.2" DISPLAY_IDENTIFIER n_i_eds_k0_bed._.cUl2K0SPlausiFl.iUl2K0SPlausiMomFl ECU_ADDRESS 0xFFF8F440 /end MEASUREMENT
/begin MEASUREMENT iUl2K0SPlausiMomFl.cUl2K0SPlausiFl._.n_k0ueb "Tasks die der Strom an der K0 unterhalb der Schwelle I_MAXK0 liegt. Bei 0 wird wieder in die Funktion eingestiegen." FLOAT32_IEEE UMR___1_1_0_S6_S3 1 100 0 3 FORMAT "%4.2" DISPLAY_IDENTIFIER n_k0ueb._.cUl2K0SPlausiFl.iUl2K0SPlausiMomFl ECU_ADDRESS 0xFFF8F444 /end MEASUREMENT
/begin MEASUREMENT iUl2K0SPlausiMomFl.n_emeink0_m "Differenzdrehzahl zwischen E-Maschine und Verbrennungsmotor" FLOAT32_IEEE UMR_U_MIN_1_1_0_S6_S3 1 100 0 65535 DISPLAY_IDENTIFIER n_emeink0_m.iUl2K0SPlausiMomFl ECU_ADDRESS 0xFFF8F44C /end MEASUREMENT
/begin MEASUREMENT iUl2K0SPlausiMomFl.k0_energie_min_reibw_skal "Energie zu Beginn der Überwachung minus dem applizierten Reibwert. und mit 10ms (mal 100) skaliert so. Damit entfällt die Division bei der Berechnung der Summe der Momente." FLOAT32_IEEE UMR_NM__1_1_0_S6_S3 1 100 -32768 32767 DISPLAY_IDENTIFIER k0_energie_min_reibw_skal.iUl2K0SPlausiMomFl ECU_ADDRESS 0xFFF8F450 /end MEASUREMENT
/begin MEASUREMENT iUl2K0SPlausiMomFl.summe_momente "Summe der Momente während der Überwachung." FLOAT32_IEEE UMR_NM__1_1_0_S6_S3 1 100 0 4194304 DISPLAY_IDENTIFIER summe_momente.iUl2K0SPlausiMomFl ECU_ADDRESS 0xFFF8F454 /end MEASUREMENT
/begin MEASUREMENT iUl2K0SStatusInt.f_k0_geschlossen_alt "Das Flag zeigt an ob die Kupplung geschlossen ist" UBYTE UMR___1_1_0_S6_S3 1 100 0 1 DISPLAY_IDENTIFIER f_k0_geschlossen_alt.iUl2K0SStatusInt ECU_ADDRESS 0xFFF8A274 /end MEASUREMENT
/begin MEASUREMENT iUl2K0SStatusInt.status_k0_alt "Level2: K0 Status" UBYTE Conv.cUl2K0SStatusInt._.status_k0_alt_S6_S3 1 100 0 5 DISPLAY_IDENTIFIER status_k0_alt.iUl2K0SStatusInt ECU_ADDRESS 0xFFF8A275 /end MEASUREMENT
/begin MEASUREMENT iUl2K0SStatusInt.fehler_ungewolltes_schliessen "gibt an ob der Fehler ungewolltes schliessen auftritt" UBYTE Conv.cUl2K0SStatusInt._.fehler_ungewolltes_schliessen_S6_S3 1 100 0 1 BIT_MASK 0x1 DISPLAY_IDENTIFIER fehler_ungewolltes_schliessen.iUl2K0SStatusInt ECU_ADDRESS 0xFFF8A276 /end MEASUREMENT
/begin MEASUREMENT iUl2K0SStatusInt.fehler_kein_oeffnen "gibt an ob der Fehler öffnen erfolgt nicht auftritt" UBYTE Conv.cUl2K0SStatusInt._.fehler_kein_oeffnen_S6_S3 1 100 0 1 BIT_MASK 0x1 DISPLAY_IDENTIFIER fehler_kein_oeffnen.iUl2K0SStatusInt ECU_ADDRESS 0xFFF8A277 /end MEASUREMENT
/begin MEASUREMENT iUl2K0SStatusInt.n_stoer1_k0_schliessen_status "Fehlerzaehler für ungewolltes Schließen" UWORD UMR___1_1_0_S6_S3 1 100 0 65535 DISPLAY_IDENTIFIER n_stoer1_k0_schliessen_status.iUl2K0SStatusInt ECU_ADDRESS 0xFFF8A278 /end MEASUREMENT
/begin MEASUREMENT iUl2K0SStatusInt.n_stoer2_k0_schliessen_status "Fehlerzaehler für ungewolltes Schließen" UWORD UMR___1_1_0_S6_S3 1 100 0 65535 DISPLAY_IDENTIFIER n_stoer2_k0_schliessen_status.iUl2K0SStatusInt ECU_ADDRESS 0xFFF8A27A /end MEASUREMENT
/begin MEASUREMENT iUl2K0SStatusInt.n_erfolg_k0_status "Gutzaehler der Überwachungsfunktion" UWORD UMR___1_1_0_S6_S3 1 100 0 65535 DISPLAY_IDENTIFIER n_erfolg_k0_status.iUl2K0SStatusInt ECU_ADDRESS 0xFFF8A27C /end MEASUREMENT
/begin MEASUREMENT iUl2K0SStatusFl.f_k0_geschlossen_alt "Das Flag zeigt an ob die Kupplung geschlossen ist" FLOAT32_IEEE UMR___1_1_0_S6_S3 1 100 0 1 FORMAT "%4.2" DISPLAY_IDENTIFIER f_k0_geschlossen_alt.iUl2K0SStatusFl ECU_ADDRESS 0xFFF8F458 /end MEASUREMENT
/begin MEASUREMENT iUl2K0SStatusFl.status_k0_alt "Level2: K0 Status" FLOAT32_IEEE UMR___1_1_0_S6_S3 1 100 0 5 FORMAT "%4.2" DISPLAY_IDENTIFIER status_k0_alt.iUl2K0SStatusFl ECU_ADDRESS 0xFFF8F45C /end MEASUREMENT
/begin MEASUREMENT iUl2K0SStatusFl.fehler_ungewolltes_schliessen "gibt an ob der Fehler ungewolltes schliessen auftritt" FLOAT32_IEEE UMR___1_1_0_S6_S3 1 100 0 1 FORMAT "%4.2" DISPLAY_IDENTIFIER fehler_ungewolltes_schliessen.iUl2K0SStatusFl ECU_ADDRESS 0xFFF8F460 /end MEASUREMENT
/begin MEASUREMENT iUl2K0SStatusFl.fehler_kein_oeffnen "gibt an ob der Fehler öffnen erfolgt nicht auftritt" FLOAT32_IEEE UMR___1_1_0_S6_S3 1 100 0 1 FORMAT "%4.2" DISPLAY_IDENTIFIER fehler_kein_oeffnen.iUl2K0SStatusFl ECU_ADDRESS 0xFFF8F464 /end MEASUREMENT
/begin MEASUREMENT iUl2K0SStatusFl.n_stoer1_k0_schliessen_status "Fehlerzaehler für ungewolltes Schließen" FLOAT32_IEEE UMR___1_1_0_S6_S3 1 100 0 65535 FORMAT "%4.2" DISPLAY_IDENTIFIER n_stoer1_k0_schliessen_status.iUl2K0SStatusFl ECU_ADDRESS 0xFFF8F468 /end MEASUREMENT
/begin MEASUREMENT iUl2K0SStatusFl.n_stoer2_k0_schliessen_status "Fehlerzaehler für ungewolltes Schließen" FLOAT32_IEEE UMR___1_1_0_S6_S3 1 100 0 65535 FORMAT "%4.2" DISPLAY_IDENTIFIER n_stoer2_k0_schliessen_status.iUl2K0SStatusFl ECU_ADDRESS 0xFFF8F46C /end MEASUREMENT
/begin MEASUREMENT iUl2K0SStatusFl.n_erfolg_k0_status "Gutzaehler der Überwachungsfunktion" FLOAT32_IEEE UMR___1_1_0_S6_S3 1 100 0 65535 FORMAT "%4.2" DISPLAY_IDENTIFIER n_erfolg_k0_status.iUl2K0SStatusFl ECU_ADDRESS 0xFFF8F470 /end MEASUREMENT
/begin MEASUREMENT iUl2PosNPlRbm.flag_rbm_zustand_posn "RBM-Betriebszustand POSN-Plausibilisierung" UBYTE Conv.cUl2PosNPlRbm._.flag_rbm_zustand_posn_S6_S3 1 100 0 1 BIT_MASK 0x1 DISPLAY_IDENTIFIER flag_rbm_zustand_posn.iUl2PosNPlRbm ECU_ADDRESS 0xFFF8A695 /end MEASUREMENT
/begin MEASUREMENT iUl2PosNPlInt.n_stoerposneds_phase_a "Stoerzaehler fuer unerlaubten Kraftfluss in Phase A." UBYTE UMR___1_1_0_S6_S3 1 100 0 255 DISPLAY_IDENTIFIER n_stoerposneds_phase_a.iUl2PosNPlInt ECU_ADDRESS 0xFFF8A25E /end MEASUREMENT
/begin MEASUREMENT iUl2PosNPlInt.n_stoerposneds_phase_b "Stoerzaehler fuer unerlaubten Kraftfluss in Phase B." UBYTE UMR___1_1_0_S6_S3 1 100 0 255 DISPLAY_IDENTIFIER n_stoerposneds_phase_b.iUl2PosNPlInt ECU_ADDRESS 0xFFF8A25F /end MEASUREMENT
/begin MEASUREMENT iUl2PosNPlInt.f_phase_b_aktiv "Phase B der Ueberwachung laeuft (Gang ausgelegt)." UBYTE Conv.cUl2PosNPlInt._.f_phase_b_aktiv_S6_S3 1 100 0 1 DISPLAY_IDENTIFIER f_phase_b_aktiv.iUl2PosNPlInt ECU_ADDRESS 0xFFF8A260 /end MEASUREMENT
/begin MEASUREMENT iUl2PosNPlInt.ctr_posn_ok "Anzahl Gut-gepruefter Durchlaeufe der PosN-Plausi." UBYTE UMR___1_1_0_S6_S3 1 100 0 4 DISPLAY_IDENTIFIER ctr_posn_ok.iUl2PosNPlInt ECU_ADDRESS 0xFFF8A261 /end MEASUREMENT
/begin MEASUREMENT iUl2PosNPlInt.f_fehler_vorhanden "Signalisiert ob die Fehlerfunktion aufgerufen wurde" UBYTE UMR___1_1_0_S6_S3 1 100 0 1 DISPLAY_IDENTIFIER f_fehler_vorhanden.iUl2PosNPlInt ECU_ADDRESS 0xFFF8A262 /end MEASUREMENT
/begin MEASUREMENT iUl2PosNPlInt.n_kupzu_posueb "Zaehler fuer druckangesteuerte Kupplung" UBYTE UMR___1_1_0_S6_S3 1 100 0 5 DISPLAY_IDENTIFIER n_kupzu_posueb.iUl2PosNPlInt ECU_ADDRESS 0xFFF8A263 /end MEASUREMENT
/begin MEASUREMENT iUl2PosNPlFl.n_stoerposneds_phase_a "Stoerzaehler fuer unerlaubten Kraftfluss in Phase A." FLOAT32_IEEE UMR___1_1_0_S6_S3 1 100 0 255 FORMAT "%4.2" DISPLAY_IDENTIFIER n_stoerposneds_phase_a.iUl2PosNPlFl ECU_ADDRESS 0xFFF8F1F4 /end MEASUREMENT
/begin MEASUREMENT iUl2PosNPlFl.n_stoerposneds_phase_b "Stoerzaehler fuer unerlaubten Kraftfluss in Phase B." FLOAT32_IEEE UMR___1_1_0_S6_S3 1 100 0 255 FORMAT "%4.2" DISPLAY_IDENTIFIER n_stoerposneds_phase_b.iUl2PosNPlFl ECU_ADDRESS 0xFFF8F1F8 /end MEASUREMENT
/begin MEASUREMENT iUl2PosNPlFl.f_phase_b_aktiv "Phase B der Ueberwachung laeuft (Gang ausgelegt)." FLOAT32_IEEE Conv.cUl2PosNPlFl._.f_phase_b_aktiv_S6_S3 1 100 0 1 FORMAT "%4.2" DISPLAY_IDENTIFIER f_phase_b_aktiv.iUl2PosNPlFl ECU_ADDRESS 0xFFF8F1FC /end MEASUREMENT
/begin MEASUREMENT iUl2PosNPlFl.ctr_posn_ok "Anzahl Gut-gepruefter Durchlaeufe der PosN-Plausi." FLOAT32_IEEE UMR___1_1_0_S6_S3 1 100 0 4 FORMAT "%4.2" DISPLAY_IDENTIFIER ctr_posn_ok.iUl2PosNPlFl ECU_ADDRESS 0xFFF8F200 /end MEASUREMENT
/begin MEASUREMENT iUl2PosNPlFl.f_fehler_vorhanden "Signalisiert ob die Fehlerfunktion aufgerufen wurde" FLOAT32_IEEE UMR___1_1_0_S6_S3 1 100 0 1 FORMAT "%4.2" DISPLAY_IDENTIFIER f_fehler_vorhanden.iUl2PosNPlFl ECU_ADDRESS 0xFFF8F204 /end MEASUREMENT
/begin MEASUREMENT iUl2PosNPlFl.n_kupzu_posueb "Zaehler fuer druckangesteuerte Kupplung" FLOAT32_IEEE UMR___1_1_0_S6_S3 1 100 0 5 FORMAT "%4.2" DISPLAY_IDENTIFIER n_kupzu_posueb.iUl2PosNPlFl ECU_ADDRESS 0xFFF8F208 /end MEASUREMENT
/begin MEASUREMENT iUl2IGetrPlausiDatenInt.n_kup_offen_ist "Anzahl von Kupplungen die offen angesteuert sind" UBYTE UMR___1_1_0_S6_S3 1 100 0 5 DISPLAY_IDENTIFIER n_kup_offen_ist.iUl2IGetrPlausiDatenInt ECU_ADDRESS 0xFFF8A662 /end MEASUREMENT
/begin MEASUREMENT iUl2IGetrPlausiDatenInt.n_kup_geschlossen_ist "Anzahl von Kupplungen die geschlossen angesteuert sind" UBYTE UMR___1_1_0_S6_S3 1 100 0 5 DISPLAY_IDENTIFIER n_kup_geschlossen_ist.iUl2IGetrPlausiDatenInt ECU_ADDRESS 0xFFF8A663 /end MEASUREMENT
/begin MEASUREMENT iUl2IGetrPlausiDatenInt.n_kup_oeffnend "Anzahl von Kupplungen die schon offen waehrend einer Schaltung sind" UBYTE UMR___1_1_0_S6_S3 1 100 0 5 DISPLAY_IDENTIFIER n_kup_oeffnend.iUl2IGetrPlausiDatenInt ECU_ADDRESS 0xFFF8A664 /end MEASUREMENT
/begin MEASUREMENT iUl2IGetrPlausiDatenInt.n_kup_offen_abgleich "Anzahl von offenen Kupplungen. Der Wert wurde zwischen Ist (Strom) und Soll (Ist/Zielang) plausibilisiert" UBYTE UMR___1_1_0_S6_S3 1 100 0 5 DISPLAY_IDENTIFIER n_kup_offen_abgleich.iUl2IGetrPlausiDatenInt ECU_ADDRESS 0xFFF8A665 /end MEASUREMENT
/begin MEASUREMENT iUl2IGetrPlausiDatenInt.n_kup_geschlossen_abgleich "Anzahl von geschlossenen Kupplungen. Der Wert wurde zwischen Ist (Strom) und Soll (Ist/Zielang) plausibilisiert" UBYTE UMR___1_1_0_S6_S3 1 100 0 5 DISPLAY_IDENTIFIER n_kup_geschlossen_abgleich.iUl2IGetrPlausiDatenInt ECU_ADDRESS 0xFFF8A666 /end MEASUREMENT
/begin MEASUREMENT iUl2IGetrPlausiDatenInt.n_kup_unbestimmt_abgleich "Anzahl von unbestimmten Kupplungen. Der Wert wurde zwischen Ist (Strom) und Soll (Ist/Zielang) plausibilisiert" UBYTE UMR___1_1_0_S6_S3 1 100 0 5 DISPLAY_IDENTIFIER n_kup_unbestimmt_abgleich.iUl2IGetrPlausiDatenInt ECU_ADDRESS 0xFFF8A667 /end MEASUREMENT
/begin MEASUREMENT iUl2IGetrPlausiDatenInt.n_kup_nicht_offen_ist "Anzahl von nicht offene Kupplungen" UBYTE UMR___1_1_0_S6_S3 1 100 0 5 DISPLAY_IDENTIFIER n_kup_nicht_offen_ist.iUl2IGetrPlausiDatenInt ECU_ADDRESS 0xFFF8A668 /end MEASUREMENT
/begin MEASUREMENT iUl2IGetrPlausiDatenInt.n_kup_nicht_offen_abgleich "Anzahl von nicht offene Kupplungen. Der Wert wurde zwischen Ist (Strom) und Soll (Ist/Zielang) plausibilisiert" UBYTE UMR___1_1_0_S6_S3 1 100 0 5 DISPLAY_IDENTIFIER n_kup_nicht_offen_abgleich.iUl2IGetrPlausiDatenInt ECU_ADDRESS 0xFFF8A669 /end MEASUREMENT
/begin MEASUREMENT iUl2IGetrPlausiDatenInt.falsche_schaltung "" UBYTE Conv.cUl2IGetrPlausiDatenInt._.falsche_schaltung_S6_S3 1 100 0 1 BIT_MASK 0x1 DISPLAY_IDENTIFIER falsche_schaltung.iUl2IGetrPlausiDatenInt ECU_ADDRESS 0xFFF8A66A /end MEASUREMENT
/begin MEASUREMENT iUl2IGetrPlausiDatenFl.n_kup_offen_ist "Anzahl von Kupplungen die offen angesteuert sind" FLOAT32_IEEE UMR___1_1_0_S6_S3 1 100 0 5 FORMAT "%4.2" DISPLAY_IDENTIFIER n_kup_offen_ist.iUl2IGetrPlausiDatenFl ECU_ADDRESS 0xFFF8E774 /end MEASUREMENT
/begin MEASUREMENT iUl2IGetrPlausiDatenFl.n_kup_geschlossen_ist "Anzahl von Kupplungen die geschlossen angesteuert sind" FLOAT32_IEEE UMR___1_1_0_S6_S3 1 100 0 5 FORMAT "%4.2" DISPLAY_IDENTIFIER n_kup_geschlossen_ist.iUl2IGetrPlausiDatenFl ECU_ADDRESS 0xFFF8E778 /end MEASUREMENT
/begin MEASUREMENT iUl2IGetrPlausiDatenFl.n_kup_oeffnend "Anzahl von Kupplungen die schon offen waehrend einer Schaltung sind" FLOAT32_IEEE UMR___1_1_0_S6_S3 1 100 0 5 FORMAT "%4.2" DISPLAY_IDENTIFIER n_kup_oeffnend.iUl2IGetrPlausiDatenFl ECU_ADDRESS 0xFFF8E77C /end MEASUREMENT
/begin MEASUREMENT iUl2IGetrPlausiDatenFl.n_kup_offen_abgleich "Anzahl von offenen Kupplungen, Werte wurde zwischen Ist (Strom) und Soll (Ist/Zielang) plausibilisiert" FLOAT32_IEEE UMR___1_1_0_S6_S3 1 100 0 5 FORMAT "%4.2" DISPLAY_IDENTIFIER n_kup_offen_abgleich.iUl2IGetrPlausiDatenFl ECU_ADDRESS 0xFFF8E780 /end MEASUREMENT
/begin MEASUREMENT iUl2IGetrPlausiDatenFl.n_kup_geschlossen_abgleich "Anzahl von geschlossenen Kupplungen, Werte wurde zwischen Ist (Strom) und Soll (Ist/Zielang) plausibilisiert" FLOAT32_IEEE UMR___1_1_0_S6_S3 1 100 0 5 FORMAT "%4.2" DISPLAY_IDENTIFIER n_kup_geschlossen_abgleich.iUl2IGetrPlausiDatenFl ECU_ADDRESS 0xFFF8E784 /end MEASUREMENT
/begin MEASUREMENT iUl2IGetrPlausiDatenFl.n_kup_unbestimmt_abgleich "Anzahl von unbestimmten Kupplungen, Werte wurde zwischen Ist (Strom) und Soll (Ist/Zielang) plausibilisiert" FLOAT32_IEEE UMR___1_1_0_S6_S3 1 100 0 5 FORMAT "%4.2" DISPLAY_IDENTIFIER n_kup_unbestimmt_abgleich.iUl2IGetrPlausiDatenFl ECU_ADDRESS 0xFFF8E788 /end MEASUREMENT
/begin MEASUREMENT iUl2IGetrPlausiDatenFl.n_kup_nicht_offen_ist "Anzahl von nicht offene Kupplungen" FLOAT32_IEEE UMR___1_1_0_S6_S3 1 100 0 5 FORMAT "%4.2" DISPLAY_IDENTIFIER n_kup_nicht_offen_ist.iUl2IGetrPlausiDatenFl ECU_ADDRESS 0xFFF8E78C /end MEASUREMENT
/begin MEASUREMENT iUl2IGetrPlausiDatenFl.n_kup_nicht_offen_abgleich "Anzahl von nicht offene Kupplungen. Der Wert wurde zwischen Ist (Strom) und Soll (Ist/Zielang) plausibilisiert" FLOAT32_IEEE UMR___1_1_0_S6_S3 1 100 0 5 FORMAT "%4.2" DISPLAY_IDENTIFIER n_kup_nicht_offen_abgleich.iUl2IGetrPlausiDatenFl ECU_ADDRESS 0xFFF8E790 /end MEASUREMENT
/begin MEASUREMENT iUl2IGetrPlausiDatenFl.falsche_schaltung "" FLOAT32_IEEE UMR___1_1_0_S6_S3 1 100 0 1 FORMAT "%4.2" DISPLAY_IDENTIFIER falsche_schaltung.iUl2IGetrPlausiDatenFl ECU_ADDRESS 0xFFF8E794 /end MEASUREMENT
/begin MEASUREMENT iUl2IGetrPlausiZustandInt.i_set_plausible "Plausibilisierung des Getriebezustands durch den Strom" UBYTE Conv.cUl2IGetrPlausiZustandInt._.i_set_plausible_S6_S3 1 100 0 255 DISPLAY_IDENTIFIER i_set_plausible.iUl2IGetrPlausiZustandInt ECU_ADDRESS 0xFFF8C3DC /end MEASUREMENT
/begin MEASUREMENT iUl2IGetrPlausiZustandInt.zustand "Plausibilisierter Getriebezustand durch den Strom" UBYTE Conv.cUl2IGetrPlausiZustandInt._.zustand_S6_S3 1 100 0 255 DISPLAY_IDENTIFIER zustand.iUl2IGetrPlausiZustandInt ECU_ADDRESS 0xFFF8C3DD /end MEASUREMENT
/begin MEASUREMENT iUl2IGetrPlausiZustandInt.gang_anst "Der gewuenschte Gang ist angesteuert" UBYTE Conv.cUl2IGetrPlausiZustandInt._.gang_anst_S6_S3 1 100 0 1 BIT_MASK 0x1 DISPLAY_IDENTIFIER gang_anst.iUl2IGetrPlausiZustandInt ECU_ADDRESS 0xFFF8C3DE /end MEASUREMENT
/begin MEASUREMENT iUl2IGetrPlausiZustandInt.gang_anst_plausibel "Der gewuenschte Gang ist angesteuert" UBYTE Conv.cUl2IGetrPlausiZustandInt._.gang_anst_plausibel_S6_S3 1 100 0 1 BIT_MASK 0x1 DISPLAY_IDENTIFIER gang_anst_plausibel.iUl2IGetrPlausiZustandInt ECU_ADDRESS 0xFFF8C3DF /end MEASUREMENT
/begin MEASUREMENT iUl2IGetrPlausiZustandInt.gang_pulsen_anst_plausibel "Ein pulsen des gewuenschten Gangs ist erkannt" UBYTE Conv.cUl2IGetrPlausiZustandInt._.gang_pulsen_anst_plausibel_S6_S3 1 100 0 1 BIT_MASK 0x1 DISPLAY_IDENTIFIER gang_pulsen_anst_plausibel.iUl2IGetrPlausiZustandInt ECU_ADDRESS 0xFFF8C3E0 /end MEASUREMENT
/begin MEASUREMENT iUl2IGetrPlausiZustandInt.ge_ga_anst_plausibel "Gangeinlegen/Gangauslegen/NIC Ansteuerung ist plausibel" UBYTE Conv.cUl2IGetrPlausiZustandInt._.ge_ga_anst_plausibel_S6_S3 1 100 0 1 BIT_MASK 0x1 DISPLAY_IDENTIFIER ge_ga_anst_plausibel.iUl2IGetrPlausiZustandInt ECU_ADDRESS 0xFFF8C3E1 /end MEASUREMENT
/begin MEASUREMENT iUl2IGetrPlausiZustandInt.reversieren_anst "Die Reversieren Ansteuerung ist plausibel" UBYTE Conv.cUl2IGetrPlausiZustandInt._.reversieren_anst_S6_S3 1 100 0 1 BIT_MASK 0x1 DISPLAY_IDENTIFIER reversieren_anst.iUl2IGetrPlausiZustandInt ECU_ADDRESS 0xFFF8C3E2 /end MEASUREMENT
/begin MEASUREMENT iUl2IGetrPlausiZustandInt.schalt_anst_plausibel "Die gewuenschte Schaltung ist angesteuert" UBYTE Conv.cUl2IGetrPlausiZustandInt._.schalt_anst_plausibel_S6_S3 1 100 0 1 BIT_MASK 0x1 DISPLAY_IDENTIFIER schalt_anst_plausibel.iUl2IGetrPlausiZustandInt ECU_ADDRESS 0xFFF8C3E3 /end MEASUREMENT
/begin MEASUREMENT iUl2IGetrPlausiZustandInt.end_schalt_anst_plausibel "Ende der gewuenschte Schaltung ist erkannt" UBYTE Conv.cUl2IGetrPlausiZustandInt._.end_schalt_anst_plausibel_S6_S3 1 100 0 1 BIT_MASK 0x1 DISPLAY_IDENTIFIER end_schalt_anst_plausibel.iUl2IGetrPlausiZustandInt ECU_ADDRESS 0xFFF8C3E4 /end MEASUREMENT
/begin MEASUREMENT iUl2IGetrPlausiZustandInt.versch_4_anst_plausibel "Verchachtelte Schaltung mit 4 Kupplungen beteiligt" UBYTE Conv.cUl2IGetrPlausiZustandInt._.versch_4_anst_plausibel_S6_S3 1 100 0 1 BIT_MASK 0x1 DISPLAY_IDENTIFIER versch_4_anst_plausibel.iUl2IGetrPlausiZustandInt ECU_ADDRESS 0xFFF8C3E5 /end MEASUREMENT
/begin MEASUREMENT iUl2IGetrPlausiZustandInt.schalt_err_anst "Fehler der Schaltungsansteuerung" UBYTE Conv.cUl2IGetrPlausiZustandInt._.schalt_err_anst_S6_S3 1 100 0 1 BIT_MASK 0x1 DISPLAY_IDENTIFIER schalt_err_anst.iUl2IGetrPlausiZustandInt ECU_ADDRESS 0xFFF8C3E6 /end MEASUREMENT
/begin MEASUREMENT iUl2IGetrPlausiZustandInt.schalt_err_anst_3_kup "Fehler der Schaltungsansteuerung mit 3 Kupplungen als nicht offen" UBYTE Conv.cUl2IGetrPlausiZustandInt._.schalt_err_anst_3_kup_S6_S3 1 100 0 1 BIT_MASK 0x1 DISPLAY_IDENTIFIER schalt_err_anst_3_kup.iUl2IGetrPlausiZustandInt ECU_ADDRESS 0xFFF8C3E7 /end MEASUREMENT
/begin MEASUREMENT iUl2IGetrPlausiZustandInt.n_verz_rev_isetplausible "Zaehler Reversierensdauer" UWORD UMR___1_1_0_S6_S3 1 100 0 65535 DISPLAY_IDENTIFIER n_verz_rev_isetplausible.iUl2IGetrPlausiZustandInt ECU_ADDRESS 0xFFF8C3E8 /end MEASUREMENT
/begin MEASUREMENT iUl2IGetrPlausiZustandInt.n_verz_revn_isetplausible "Zaehler Reversierensdauer ueber N P" UWORD UMR___1_1_0_S6_S3 1 100 0 65535 DISPLAY_IDENTIFIER n_verz_revn_isetplausible.iUl2IGetrPlausiZustandInt ECU_ADDRESS 0xFFF8C3EA /end MEASUREMENT
/begin MEASUREMENT iUl2IGetrPlausiZustandInt.n_verz_isetplausible "Maximale Ansteuerungszeit fuer Pulsen" UWORD UMR___1_1_0_S6_S3 1 100 0 65535 DISPLAY_IDENTIFIER n_verz_isetplausible.iUl2IGetrPlausiZustandInt ECU_ADDRESS 0xFFF8C3EC /end MEASUREMENT
/begin MEASUREMENT iUl2IGetrPlausiZustandInt.pos_alt "merkt sich die vorherige Position" UBYTE Conv.cUl2IGetrPlausiZustandInt._.pos_alt_S6_S3 1 100 0 8 DISPLAY_IDENTIFIER pos_alt.iUl2IGetrPlausiZustandInt ECU_ADDRESS 0xFFF8C3EE /end MEASUREMENT
/begin MEASUREMENT iUl2IGetrPlausiZustandInt.pos_revn_start "merkt sich die Position vor N oder P Wechsel" UBYTE Conv.cUl2IGetrPlausiZustandInt._.pos_revn_start_S6_S3 1 100 0 8 DISPLAY_IDENTIFIER pos_revn_start.iUl2IGetrPlausiZustandInt ECU_ADDRESS 0xFFF8C3EF /end MEASUREMENT
/begin MEASUREMENT iUl2IGetrPlausiZustandFl.i_set_plausible "Plausibilisierung des Getriebezustands durch den Strom" FLOAT32_IEEE UMR___1_1_0_S6_S3 1 100 0 255 FORMAT "%4.2" DISPLAY_IDENTIFIER i_set_plausible.iUl2IGetrPlausiZustandFl ECU_ADDRESS 0xFFF8C3F0 /end MEASUREMENT
/begin MEASUREMENT iUl2IGetrPlausiZustandFl.zustand "Plausibilisierung des Getriebezustands durch den Strom" FLOAT32_IEEE UMR___1_1_0_S6_S3 1 100 0 255 FORMAT "%4.2" DISPLAY_IDENTIFIER zustand.iUl2IGetrPlausiZustandFl ECU_ADDRESS 0xFFF8C3F4 /end MEASUREMENT
/begin MEASUREMENT iUl2IGetrPlausiZustandFl.reversieren_anst "" FLOAT32_IEEE UMR___1_1_0_S6_S3 1 100 0 1 FORMAT "%4.2" DISPLAY_IDENTIFIER reversieren_anst.iUl2IGetrPlausiZustandFl ECU_ADDRESS 0xFFF8C3F8 /end MEASUREMENT
/begin MEASUREMENT iUl2IGetrPlausiZustandFl.n_verz_rev_isetplausible "Zaehler Reversierensdauer" FLOAT32_IEEE UMR___1_1_0_S6_S3 1 100 0 65535 FORMAT "%4.2" DISPLAY_IDENTIFIER n_verz_rev_isetplausible.iUl2IGetrPlausiZustandFl ECU_ADDRESS 0xFFF8C3FC /end MEASUREMENT
/begin MEASUREMENT iUl2IGetrPlausiZustandFl.n_verz_revn_isetplausible "Zaehler Reversierensdauer ueber N P" FLOAT32_IEEE UMR___1_1_0_S6_S3 1 100 0 65535 FORMAT "%4.2" DISPLAY_IDENTIFIER n_verz_revn_isetplausible.iUl2IGetrPlausiZustandFl ECU_ADDRESS 0xFFF8C400 /end MEASUREMENT
/begin MEASUREMENT iUl2IGetrPlausiZustandFl.n_verz_isetplausible "Maximale Ansteuerungszeit fuer Pulsen" FLOAT32_IEEE UMR___1_1_0_S6_S3 1 100 0 65535 FORMAT "%4.2" DISPLAY_IDENTIFIER n_verz_isetplausible.iUl2IGetrPlausiZustandFl ECU_ADDRESS 0xFFF8C404 /end MEASUREMENT
/begin MEASUREMENT iUl2IGetrPlausiZustandFl.pos_alt "merkt sich die vorherige Position" FLOAT32_IEEE UMR___1_1_0_S6_S3 1 100 0 8 FORMAT "%4.2" DISPLAY_IDENTIFIER pos_alt.iUl2IGetrPlausiZustandFl ECU_ADDRESS 0xFFF8C408 /end MEASUREMENT
/begin MEASUREMENT iUl2IGetrPlausiZustandFl.pos_revn_start "merkt sich die Position vor N oder P Wechsel" FLOAT32_IEEE UMR___1_1_0_S6_S3 1 100 0 8 FORMAT "%4.2" DISPLAY_IDENTIFIER pos_revn_start.iUl2IGetrPlausiZustandFl ECU_ADDRESS 0xFFF8C40C /end MEASUREMENT
/begin MEASUREMENT iUl2PosMeIntenIGangInt.cBasFehlerErfolgInt._.flag_fehler "Das Flag zeigt an ob die Ueberwachungen einen Fehler entdeckt hat." UBYTE Conv.cBasFehlerErfolgInt._.flag_fehler_S6_S3 1 100 0 1 BIT_MASK 0x1 DISPLAY_IDENTIFIER flag_fehler.iUl2PosMeIntenIGangInt ECU_ADDRESS 0xFFF8ECA0 /end MEASUREMENT
/begin MEASUREMENT iUl2PosMeIntenIGangInt.cBasFehlerErfolgInt._.zaehler_fehler "Fehlerzaehler der Überwachungsfunktion" ULONG UMR___1_1_0_S6_S3 1 100 0 65535 DISPLAY_IDENTIFIER zaehler_fehler.iUl2PosMeIntenIGangInt ECU_ADDRESS 0xFFF8ECA4 /end MEASUREMENT
/begin MEASUREMENT iUl2PosMeIntenIGangInt.cBasFehlerErfolgInt._.zaehler_erfolge "Erfolgszaehler der Überwachungsfunktion" ULONG UMR___1_1_0_S6_S3 1 100 0 65535 DISPLAY_IDENTIFIER zaehler_erfolge.iUl2PosMeIntenIGangInt ECU_ADDRESS 0xFFF8ECA8 /end MEASUREMENT
/begin MEASUREMENT iUl2PosMeIntenIGangInt.err_abs_me_igang "Fehlerflag für absoluter Intensitaet Me-Signalüberwachung im Gang" UBYTE Conv.cUl2PosMeIntenIGangInt._.err_abs_me_igang_S6_S3 1 100 0 1 BIT_MASK 0x1 DISPLAY_IDENTIFIER err_abs_me_igang.iUl2PosMeIntenIGangInt ECU_ADDRESS 0xFFF8ECB0 /end MEASUREMENT
/begin MEASUREMENT iUl2PosMeIntenIGangInt.err_rel_me_igang "Fehlerflag für relative positiver Intensitaet Me-Signalüberwachung im Gang" UBYTE Conv.cUl2PosMeIntenIGangInt._.err_rel_me_igang_S6_S3 1 100 0 1 BIT_MASK 0x1 DISPLAY_IDENTIFIER err_rel_me_igang.iUl2PosMeIntenIGangInt ECU_ADDRESS 0xFFF8ECB1 /end MEASUREMENT
/begin MEASUREMENT iUl2PosMeIntenIGangFl.cBasFehlerErfolgFl._.flag_fehler "Das Flag zeigt an ob die Ueberwachungen einen Fehler entdeckt hat." FLOAT32_IEEE Conv.cBasFehlerErfolgFl._.flag_fehler_S6_S3 1 100 0 1 FORMAT "%4.2" DISPLAY_IDENTIFIER flag_fehler.iUl2PosMeIntenIGangFl ECU_ADDRESS 0xFFF8ECB4 /end MEASUREMENT
/begin MEASUREMENT iUl2PosMeIntenIGangFl.cBasFehlerErfolgFl._.zaehler_fehler "Fehlerzaehler der Überwachungsfunktion" FLOAT32_IEEE UMR___1_1_0_S6_S3 1 100 0 65535 FORMAT "%4.2" DISPLAY_IDENTIFIER zaehler_fehler.iUl2PosMeIntenIGangFl ECU_ADDRESS 0xFFF8ECB8 /end MEASUREMENT
/begin MEASUREMENT iUl2PosMeIntenIGangFl.cBasFehlerErfolgFl._.zaehler_erfolge "Erfolgszaehler der Überwachungsfunktion" FLOAT32_IEEE UMR___1_1_0_S6_S3 1 100 0 65535 FORMAT "%4.2" DISPLAY_IDENTIFIER zaehler_erfolge.iUl2PosMeIntenIGangFl ECU_ADDRESS 0xFFF8ECBC /end MEASUREMENT
/begin MEASUREMENT iUl2PosMeIntenIGangFl.err_abs_me_igang "Fehlerflag für absoluter Intensitaet Me-Signalüberwachung im Gang" FLOAT32_IEEE Conv.cUl2PosMeIntenIGangFl._.err_abs_me_igang_S6_S3 1 100 0 1 FORMAT "%4.2" DISPLAY_IDENTIFIER err_abs_me_igang.iUl2PosMeIntenIGangFl ECU_ADDRESS 0xFFF8ECC4 /end MEASUREMENT
/begin MEASUREMENT iUl2PosMeIntenIGangFl.err_rel_me_igang "Fehlerflag für relative positiver Intensitaet Me-Signalüberwachung im Gang" FLOAT32_IEEE Conv.cUl2PosMeIntenIGangFl._.err_rel_me_igang_S6_S3 1 100 0 1 FORMAT "%4.2" DISPLAY_IDENTIFIER err_rel_me_igang.iUl2PosMeIntenIGangFl ECU_ADDRESS 0xFFF8ECC8 /end MEASUREMENT
/begin MEASUREMENT iUl2PosMeIntenVar1Int.cBasFehlerErfolgInt._.flag_fehler "Das Flag zeigt an ob die Ueberwachungen einen Fehler entdeckt hat." UBYTE Conv.cBasFehlerErfolgInt._.flag_fehler_S6_S3 1 100 0 1 BIT_MASK 0x1 DISPLAY_IDENTIFIER flag_fehler.iUl2PosMeIntenVar1Int ECU_ADDRESS 0xFFF8ECCC /end MEASUREMENT
/begin MEASUREMENT iUl2PosMeIntenVar1Int.cBasFehlerErfolgInt._.zaehler_fehler "Fehlerzaehler der Überwachungsfunktion" ULONG UMR___1_1_0_S6_S3 1 100 0 65535 DISPLAY_IDENTIFIER zaehler_fehler.iUl2PosMeIntenVar1Int ECU_ADDRESS 0xFFF8ECD0 /end MEASUREMENT
/begin MEASUREMENT iUl2PosMeIntenVar1Int.cBasFehlerErfolgInt._.zaehler_erfolge "Erfolgszaehler der Überwachungsfunktion" ULONG UMR___1_1_0_S6_S3 1 100 0 65535 DISPLAY_IDENTIFIER zaehler_erfolge.iUl2PosMeIntenVar1Int ECU_ADDRESS 0xFFF8ECD4 /end MEASUREMENT
/begin MEASUREMENT iUl2PosMeIntenVar1Int.schwellen_variante "Wird beim Instanzieren gesetzt und definiert die Überwachungsvariante, die genutzt wird. Die Varianten unterscheiden sich dabei in den Zahlerschwellen." UBYTE Conv.cUl2PosMeIntenInt._.schwellen_variante_S6_S3 1 100 1 2 DISPLAY_IDENTIFIER schwellen_variante.iUl2PosMeIntenVar1Int ECU_ADDRESS 0xFFF8ECDC /end MEASUREMENT
/begin MEASUREMENT iUl2PosMeIntenVar1Int.stoerung_int_abs_pos_me "FLAG: Fehler in der Ueberwachung negativer Motoreingriff, absolute Berechnung." UBYTE Conv.cUl2PosMeIntenInt._.stoerung_int_abs_pos_me_S6_S3 1 100 0 1 BIT_MASK 0x1 DISPLAY_IDENTIFIER stoerung_int_abs_pos_me.iUl2PosMeIntenVar1Int ECU_ADDRESS 0xFFF8ECDD /end MEASUREMENT
/begin MEASUREMENT iUl2PosMeIntenVar1Int.stoerung_int_rel_pos_me "FLAG: Fehler in der Ueberwachung negativer Motoreingriff, relative Berechnung." UBYTE Conv.cUl2PosMeIntenInt._.stoerung_int_rel_pos_me_S6_S3 1 100 0 1 BIT_MASK 0x1 DISPLAY_IDENTIFIER stoerung_int_rel_pos_me.iUl2PosMeIntenVar1Int ECU_ADDRESS 0xFFF8ECDE /end MEASUREMENT
/begin MEASUREMENT iUl2PosMeIntenVar1Fl.cBasFehlerErfolgFl._.flag_fehler "Das Flag zeigt an ob die Ueberwachungen einen Fehler entdeckt hat." FLOAT32_IEEE Conv.cBasFehlerErfolgFl._.flag_fehler_S6_S3 1 100 0 1 FORMAT "%4.2" DISPLAY_IDENTIFIER flag_fehler.iUl2PosMeIntenVar1Fl ECU_ADDRESS 0xFFF8ECE0 /end MEASUREMENT
/begin MEASUREMENT iUl2PosMeIntenVar1Fl.cBasFehlerErfolgFl._.zaehler_fehler "Fehlerzaehler der Überwachungsfunktion" FLOAT32_IEEE UMR___1_1_0_S6_S3 1 100 0 65535 FORMAT "%4.2" DISPLAY_IDENTIFIER zaehler_fehler.iUl2PosMeIntenVar1Fl ECU_ADDRESS 0xFFF8ECE4 /end MEASUREMENT
/begin MEASUREMENT iUl2PosMeIntenVar1Fl.cBasFehlerErfolgFl._.zaehler_erfolge "Erfolgszaehler der Überwachungsfunktion" FLOAT32_IEEE UMR___1_1_0_S6_S3 1 100 0 65535 FORMAT "%4.2" DISPLAY_IDENTIFIER zaehler_erfolge.iUl2PosMeIntenVar1Fl ECU_ADDRESS 0xFFF8ECE8 /end MEASUREMENT
/begin MEASUREMENT iUl2PosMeIntenVar1Fl.schwellen_variante "Wird beim Instanzieren gesetzt und definiert die Überwachungsvariante, die genutzt wird. Die Varianten unterscheiden sich dabei in den Zahlerschwellen." FLOAT32_IEEE Conv.cUl2PosMeIntenFl._.schwellen_variante_S6_S3 1 100 1 2 FORMAT "%4.2" DISPLAY_IDENTIFIER schwellen_variante.iUl2PosMeIntenVar1Fl ECU_ADDRESS 0xFFF8ECF0 /end MEASUREMENT
/begin MEASUREMENT iUl2PosMeIntenVar1Fl.stoerung_int_abs_pos_me "FLAG: Fehler in der Ueberwachung positiver Motoreingriff, absolute Berechnung." FLOAT32_IEEE Conv.cUl2PosMeIntenFl._.stoerung_int_abs_pos_me_S6_S3 1 100 0 1 FORMAT "%4.2" DISPLAY_IDENTIFIER stoerung_int_abs_pos_me.iUl2PosMeIntenVar1Fl ECU_ADDRESS 0xFFF8ECF4 /end MEASUREMENT
/begin MEASUREMENT iUl2PosMeIntenVar1Fl.stoerung_int_rel_pos_me "FLAG: Fehler in der Ueberwachung positiver Motoreingriff, relative Berechnung." FLOAT32_IEEE Conv.cUl2PosMeIntenFl._.stoerung_int_rel_pos_me_S6_S3 1 100 0 1 FORMAT "%4.2" DISPLAY_IDENTIFIER stoerung_int_rel_pos_me.iUl2PosMeIntenVar1Fl ECU_ADDRESS 0xFFF8ECF8 /end MEASUREMENT
/begin MEASUREMENT iUl2PosMeIntenVar2Int.cBasFehlerErfolgInt._.flag_fehler "Das Flag zeigt an ob die Ueberwachungen einen Fehler entdeckt hat." UBYTE Conv.cBasFehlerErfolgInt._.flag_fehler_S6_S3 1 100 0 1 BIT_MASK 0x1 DISPLAY_IDENTIFIER flag_fehler.iUl2PosMeIntenVar2Int ECU_ADDRESS 0xFFF8ECFC /end MEASUREMENT
/begin MEASUREMENT iUl2PosMeIntenVar2Int.cBasFehlerErfolgInt._.zaehler_fehler "Fehlerzaehler der Überwachungsfunktion" ULONG UMR___1_1_0_S6_S3 1 100 0 65535 DISPLAY_IDENTIFIER zaehler_fehler.iUl2PosMeIntenVar2Int ECU_ADDRESS 0xFFF8ED00 /end MEASUREMENT
/begin MEASUREMENT iUl2PosMeIntenVar2Int.cBasFehlerErfolgInt._.zaehler_erfolge "Erfolgszaehler der Überwachungsfunktion" ULONG UMR___1_1_0_S6_S3 1 100 0 65535 DISPLAY_IDENTIFIER zaehler_erfolge.iUl2PosMeIntenVar2Int ECU_ADDRESS 0xFFF8ED04 /end MEASUREMENT
/begin MEASUREMENT iUl2PosMeIntenVar2Int.schwellen_variante "Wird beim Instanzieren gesetzt und definiert die Überwachungsvariante, die genutzt wird. Die Varianten unterscheiden sich dabei in den Zahlerschwellen." UBYTE Conv.cUl2PosMeIntenInt._.schwellen_variante_S6_S3 1 100 1 2 DISPLAY_IDENTIFIER schwellen_variante.iUl2PosMeIntenVar2Int ECU_ADDRESS 0xFFF8ED0C /end MEASUREMENT
/begin MEASUREMENT iUl2PosMeIntenVar2Int.stoerung_int_abs_pos_me "FLAG: Fehler in der Ueberwachung negativer Motoreingriff, absolute Berechnung." UBYTE Conv.cUl2PosMeIntenInt._.stoerung_int_abs_pos_me_S6_S3 1 100 0 1 BIT_MASK 0x1 DISPLAY_IDENTIFIER stoerung_int_abs_pos_me.iUl2PosMeIntenVar2Int ECU_ADDRESS 0xFFF8ED0D /end MEASUREMENT
/begin MEASUREMENT iUl2PosMeIntenVar2Int.stoerung_int_rel_pos_me "FLAG: Fehler in der Ueberwachung negativer Motoreingriff, relative Berechnung." UBYTE Conv.cUl2PosMeIntenInt._.stoerung_int_rel_pos_me_S6_S3 1 100 0 1 BIT_MASK 0x1 DISPLAY_IDENTIFIER stoerung_int_rel_pos_me.iUl2PosMeIntenVar2Int ECU_ADDRESS 0xFFF8ED0E /end MEASUREMENT
/begin MEASUREMENT iUl2PosMeIntenVar2Fl.cBasFehlerErfolgFl._.flag_fehler "Das Flag zeigt an ob die Ueberwachungen einen Fehler entdeckt hat." FLOAT32_IEEE Conv.cBasFehlerErfolgFl._.flag_fehler_S6_S3 1 100 0 1 FORMAT "%4.2" DISPLAY_IDENTIFIER flag_fehler.iUl2PosMeIntenVar2Fl ECU_ADDRESS 0xFFF8ED10 /end MEASUREMENT
/begin MEASUREMENT iUl2PosMeIntenVar2Fl.cBasFehlerErfolgFl._.zaehler_fehler "Fehlerzaehler der Überwachungsfunktion" FLOAT32_IEEE UMR___1_1_0_S6_S3 1 100 0 65535 FORMAT "%4.2" DISPLAY_IDENTIFIER zaehler_fehler.iUl2PosMeIntenVar2Fl ECU_ADDRESS 0xFFF8ED14 /end MEASUREMENT
/begin MEASUREMENT iUl2PosMeIntenVar2Fl.cBasFehlerErfolgFl._.zaehler_erfolge "Erfolgszaehler der Überwachungsfunktion" FLOAT32_IEEE UMR___1_1_0_S6_S3 1 100 0 65535 FORMAT "%4.2" DISPLAY_IDENTIFIER zaehler_erfolge.iUl2PosMeIntenVar2Fl ECU_ADDRESS 0xFFF8ED18 /end MEASUREMENT
/begin MEASUREMENT iUl2PosMeIntenVar2Fl.schwellen_variante "Wird beim Instanzieren gesetzt und definiert die Überwachungsvariante, die genutzt wird. Die Varianten unterscheiden sich dabei in den Zahlerschwellen." FLOAT32_IEEE Conv.cUl2PosMeIntenFl._.schwellen_variante_S6_S3 1 100 1 2 FORMAT "%4.2" DISPLAY_IDENTIFIER schwellen_variante.iUl2PosMeIntenVar2Fl ECU_ADDRESS 0xFFF8ED20 /end MEASUREMENT
/begin MEASUREMENT iUl2PosMeIntenVar2Fl.stoerung_int_abs_pos_me "FLAG: Fehler in der Ueberwachung positiver Motoreingriff, absolute Berechnung." FLOAT32_IEEE Conv.cUl2PosMeIntenFl._.stoerung_int_abs_pos_me_S6_S3 1 100 0 1 FORMAT "%4.2" DISPLAY_IDENTIFIER stoerung_int_abs_pos_me.iUl2PosMeIntenVar2Fl ECU_ADDRESS 0xFFF8ED24 /end MEASUREMENT
/begin MEASUREMENT iUl2PosMeIntenVar2Fl.stoerung_int_rel_pos_me "FLAG: Fehler in der Ueberwachung positiver Motoreingriff, relative Berechnung." FLOAT32_IEEE Conv.cUl2PosMeIntenFl._.stoerung_int_rel_pos_me_S6_S3 1 100 0 1 FORMAT "%4.2" DISPLAY_IDENTIFIER stoerung_int_rel_pos_me.iUl2PosMeIntenVar2Fl ECU_ADDRESS 0xFFF8ED28 /end MEASUREMENT
/begin MEASUREMENT iUl2MeKoordInt.err_pos_me "FLAG: Fehler in der Ueberwachung positiver Motoreingriff." UBYTE Conv.cUl2MeKoordInt._.err_pos_me_S6_S3 1 100 0 1 BIT_MASK 0x1 DISPLAY_IDENTIFIER err_pos_me.iUl2MeKoordInt ECU_ADDRESS 0xFFF8C410 /end MEASUREMENT
/begin MEASUREMENT iUl2MeKoordInt.err_neg_me "FLAG: Fehler in der Ueberwachung negativer Motoreingriff." UBYTE Conv.cUl2MeKoordInt._.err_neg_me_S6_S3 1 100 0 1 BIT_MASK 0x1 DISPLAY_IDENTIFIER err_neg_me.iUl2MeKoordInt ECU_ADDRESS 0xFFF8C411 /end MEASUREMENT
/begin MEASUREMENT iUl2MeKoordInt.err_abs_me "Fehlerflag für absoluter Me-Signalüberwachung" UBYTE Conv.cUl2MeKoordInt._.err_abs_me_S6_S3 1 100 0 1 BIT_MASK 0x1 DISPLAY_IDENTIFIER err_abs_me.iUl2MeKoordInt ECU_ADDRESS 0xFFF8C412 /end MEASUREMENT
/begin MEASUREMENT iUl2MeKoordInt.err_rel_me "Fehlerflag für relativer Me-Signalüberwachung" UBYTE Conv.cUl2MeKoordInt._.err_rel_me_S6_S3 1 100 0 1 BIT_MASK 0x1 DISPLAY_IDENTIFIER err_rel_me.iUl2MeKoordInt ECU_ADDRESS 0xFFF8C413 /end MEASUREMENT
/begin MEASUREMENT iUl2MeKoordInt.n_maxstoerposmeaus "Störzähler PosMe Signalüberwachung" UWORD UMR___1_1_0_S6_S3 1 100 0 65535 DISPLAY_IDENTIFIER n_maxstoerposmeaus.iUl2MeKoordInt ECU_ADDRESS 0xFFF8C414 /end MEASUREMENT
/begin MEASUREMENT iUl2MeKoordInt.err_sig_pos_me "Fehlerflag für PosMe-Signalüberwachung" UBYTE Conv.cUl2MeKoordInt._.err_sig_pos_me_S6_S3 1 100 0 1 BIT_MASK 0x1 DISPLAY_IDENTIFIER err_sig_pos_me.iUl2MeKoordInt ECU_ADDRESS 0xFFF8C416 /end MEASUREMENT
/begin MEASUREMENT iUl2MeKoordInt.err_me_igang "FLAG: Fehler in der Ueberwachung positiver Motoreingriff im Gang, absoluter oder relativer Berechnung." UBYTE Conv.cUl2MeKoordInt._.err_me_igang_S6_S3 1 100 0 1 BIT_MASK 0x1 DISPLAY_IDENTIFIER err_me_igang.iUl2MeKoordInt ECU_ADDRESS 0xFFF8C417 /end MEASUREMENT
/begin MEASUREMENT iUl2MeKoordInt.n_stoerposmegradient "Störzähler Gradientenüberwachung PosMe" UWORD UMR___1_1_0_S6_S3 1 100 0 65535 DISPLAY_IDENTIFIER n_stoerposmegradient.iUl2MeKoordInt ECU_ADDRESS 0xFFF8C418 /end MEASUREMENT
/begin MEASUREMENT iUl2MeKoordInt.ng_meueb "Drehzahlgradient Überwachung Gradientenüberwachung POSME" SLONG UMR_U_MINTASK_1_100_0_S6_S3 1 100 -21474836.48 21474836.47 DISPLAY_IDENTIFIER ng_meueb.iUl2MeKoordInt ECU_ADDRESS 0xFFF8C41C /end MEASUREMENT
/begin MEASUREMENT iUl2MeKoordInt.err_grad_pos_me "Fehlerflag für PosMe-Gradientenüberwachung" UBYTE Conv.cUl2MeKoordInt._.err_grad_pos_me_S6_S3 1 100 0 1 BIT_MASK 0x1 DISPLAY_IDENTIFIER err_grad_pos_me.iUl2MeKoordInt ECU_ADDRESS 0xFFF8C420 /end MEASUREMENT
/begin MEASUREMENT iUl2MeKoordInt.n_maxstoernegmeaus "Störzähler NegMe Signalüberwachung" UWORD UMR___1_1_0_S6_S3 1 100 0 65535 DISPLAY_IDENTIFIER n_maxstoernegmeaus.iUl2MeKoordInt ECU_ADDRESS 0xFFF8C422 /end MEASUREMENT
/begin MEASUREMENT iUl2MeKoordInt.err_sig_neg_me "Fehlerflag für NegMe-Signalüberwachung" UBYTE Conv.cUl2MeKoordInt._.err_sig_neg_me_S6_S3 1 100 0 1 BIT_MASK 0x1 DISPLAY_IDENTIFIER err_sig_neg_me.iUl2MeKoordInt ECU_ADDRESS 0xFFF8C424 /end MEASUREMENT
/begin MEASUREMENT iUl2MeKoordInt.n_maxstoernegmeint1 "Störzähler NegMe Intensitätsüberwachung" UWORD UMR___1_1_0_S6_S3 1 100 0 65535 DISPLAY_IDENTIFIER n_maxstoernegmeint1.iUl2MeKoordInt ECU_ADDRESS 0xFFF8C426 /end MEASUREMENT
/begin MEASUREMENT iUl2MeKoordInt.err_int_neg_me "Fehlerflag für NegMe-Intensitätsüberwachung" UBYTE Conv.cUl2MeKoordInt._.err_int_neg_me_S6_S3 1 100 0 1 BIT_MASK 0x1 DISPLAY_IDENTIFIER err_int_neg_me.iUl2MeKoordInt ECU_ADDRESS 0xFFF8C428 /end MEASUREMENT
/begin MEASUREMENT iUl2MeKoordFl.err_pos_me "FLAG: Fehler in der Ueberwachung positiver Motoreingriff" FLOAT32_IEEE Conv.cUl2MeKoordFl._.err_pos_me_S6_S3 1 100 0 1 FORMAT "%4.2" DISPLAY_IDENTIFIER err_pos_me.iUl2MeKoordFl ECU_ADDRESS 0xFFF8C42C /end MEASUREMENT
/begin MEASUREMENT iUl2MeKoordFl.err_neg_me "FLAG: Fehler in der Ueberwachung negativer Motoreingriff" FLOAT32_IEEE Conv.cUl2MeKoordFl._.err_neg_me_S6_S3 1 100 0 1 FORMAT "%4.2" DISPLAY_IDENTIFIER err_neg_me.iUl2MeKoordFl ECU_ADDRESS 0xFFF8C430 /end MEASUREMENT
/begin MEASUREMENT iUl2MeKoordFl.err_abs_me "FLAG: Fehler in der Ueberwachung absoluter Motoreingriff" FLOAT32_IEEE Conv.cUl2MeKoordFl._.err_abs_me_S6_S3 1 100 0 1 FORMAT "%4.2" DISPLAY_IDENTIFIER err_abs_me.iUl2MeKoordFl ECU_ADDRESS 0xFFF8C434 /end MEASUREMENT
/begin MEASUREMENT iUl2MeKoordFl.err_rel_me "FLAG: Fehler in der Ueberwachung relativer Motoreingriff" FLOAT32_IEEE Conv.cUl2MeKoordFl._.err_rel_me_S6_S3 1 100 0 1 FORMAT "%4.2" DISPLAY_IDENTIFIER err_rel_me.iUl2MeKoordFl ECU_ADDRESS 0xFFF8C438 /end MEASUREMENT
/begin MEASUREMENT iUl2MeKoordFl.err_me_igang "FLAG: Fehler in der Ueberwachung positiver Motoreingriff im Gang, absoluter oder relativer Berechnung." FLOAT32_IEEE Conv.cUl2MeKoordFl._.err_me_igang_S6_S3 1 100 0 1 FORMAT "%4.2" DISPLAY_IDENTIFIER err_me_igang.iUl2MeKoordFl ECU_ADDRESS 0xFFF8C43C /end MEASUREMENT
/begin MEASUREMENT iUl2MeSignaleInt.me_mot_anford "Momentenabforderung der ATSYS" UWORD UMR_NM__1_1_0_S6_S3 1 100 0 65535 DISPLAY_IDENTIFIER me_mot_anford.iUl2MeSignaleInt ECU_ADDRESS 0xFFF8C440 /end MEASUREMENT
/begin MEASUREMENT iUl2MeSignaleInt.me_mot_rueckm "Rueckgemeldeter Getriebe-Motoreingriff" UWORD UMR_NM__1_1_0_S6_S3 1 100 0 65535 DISPLAY_IDENTIFIER me_mot_rueckm.iUl2MeSignaleInt ECU_ADDRESS 0xFFF8C442 /end MEASUREMENT
/begin MEASUREMENT iUl2MeSignaleFl.me_mot_anford "Momentenabforderung der ATSYS" FLOAT32_IEEE UMR_NM__1_1_0_S6_S3 1 100 0 65535 DISPLAY_IDENTIFIER me_mot_anford.iUl2MeSignaleFl ECU_ADDRESS 0xFFF8C444 /end MEASUREMENT
/begin MEASUREMENT iUl2MeSignaleFl.me_mot_rueckm "Rueckgemeldeter Getriebe-Motoreingriff Floatberechnung" FLOAT32_IEEE UMR_NM__1_1_0_S6_S3 1 100 0 65535 DISPLAY_IDENTIFIER me_mot_rueckm.iUl2MeSignaleFl ECU_ADDRESS 0xFFF8C448 /end MEASUREMENT
/begin MEASUREMENT iUl2PosMeSigInt.cBasFehlerErfolgInt._.flag_fehler "Das Flag zeigt an ob die Ueberwachungen einen Fehler entdeckt hat." UBYTE Conv.cBasFehlerErfolgInt._.flag_fehler_S6_S3 1 100 0 1 BIT_MASK 0x1 DISPLAY_IDENTIFIER flag_fehler.iUl2PosMeSigInt ECU_ADDRESS 0xFFF8C44C /end MEASUREMENT
/begin MEASUREMENT iUl2PosMeSigInt.cBasFehlerErfolgInt._.zaehler_fehler "Fehlerzaehler der Überwachungsfunktion" ULONG UMR___1_1_0_S6_S3 1 100 0 65535 DISPLAY_IDENTIFIER zaehler_fehler.iUl2PosMeSigInt ECU_ADDRESS 0xFFF8C450 /end MEASUREMENT
/begin MEASUREMENT iUl2PosMeSigInt.cBasFehlerErfolgInt._.zaehler_erfolge "Erfolgszaehler der Überwachungsfunktion" ULONG UMR___1_1_0_S6_S3 1 100 0 65535 DISPLAY_IDENTIFIER zaehler_erfolge.iUl2PosMeSigInt ECU_ADDRESS 0xFFF8C454 /end MEASUREMENT
/begin MEASUREMENT iUl2PosMeSigInt.stoerung_sig_abs_pos_me "FLAG: Fehler in der Ueberwachung positiver Motoreingriff, absolute Berechnung." UBYTE Conv.cUl2PosMeSigInt._.stoerung_sig_abs_pos_me_S6_S3 1 100 0 1 BIT_MASK 0x1 DISPLAY_IDENTIFIER stoerung_sig_abs_pos_me.iUl2PosMeSigInt ECU_ADDRESS 0xFFF8C45C /end MEASUREMENT
/begin MEASUREMENT iUl2PosMeSigInt.stoerung_sig_rel_pos_me "FLAG: Fehler in der Ueberwachung positiver Motoreingriff, relative Berechnung." UBYTE Conv.cUl2PosMeSigInt._.stoerung_sig_rel_pos_me_S6_S3 1 100 0 1 BIT_MASK 0x1 DISPLAY_IDENTIFIER stoerung_sig_rel_pos_me.iUl2PosMeSigInt ECU_ADDRESS 0xFFF8C45D /end MEASUREMENT
/begin MEASUREMENT iUl2PosMeSigFl.cBasFehlerErfolgFl._.flag_fehler "Das Flag zeigt an ob die Ueberwachungen einen Fehler entdeckt hat." FLOAT32_IEEE Conv.cBasFehlerErfolgFl._.flag_fehler_S6_S3 1 100 0 1 FORMAT "%4.2" DISPLAY_IDENTIFIER flag_fehler.iUl2PosMeSigFl ECU_ADDRESS 0xFFF8C460 /end MEASUREMENT
/begin MEASUREMENT iUl2PosMeSigFl.cBasFehlerErfolgFl._.zaehler_fehler "Fehlerzaehler der Überwachungsfunktion" FLOAT32_IEEE UMR___1_1_0_S6_S3 1 100 0 65535 FORMAT "%4.2" DISPLAY_IDENTIFIER zaehler_fehler.iUl2PosMeSigFl ECU_ADDRESS 0xFFF8C464 /end MEASUREMENT
/begin MEASUREMENT iUl2PosMeSigFl.cBasFehlerErfolgFl._.zaehler_erfolge "Erfolgszaehler der Überwachungsfunktion" FLOAT32_IEEE UMR___1_1_0_S6_S3 1 100 0 65535 FORMAT "%4.2" DISPLAY_IDENTIFIER zaehler_erfolge.iUl2PosMeSigFl ECU_ADDRESS 0xFFF8C468 /end MEASUREMENT
/begin MEASUREMENT iUl2PosMeSigFl.stoerung_sig_abs_pos_me "FLAG: Fehler in der Ueberwachung positiver Motoreingriff, absolute Berechnung." FLOAT32_IEEE Conv.cUl2PosMeSigFl._.stoerung_sig_abs_pos_me_S6_S3 1 100 0 1 FORMAT "%4.2" DISPLAY_IDENTIFIER stoerung_sig_abs_pos_me.iUl2PosMeSigFl ECU_ADDRESS 0xFFF8C470 /end MEASUREMENT
/begin MEASUREMENT iUl2PosMeSigFl.stoerung_sig_rel_pos_me "FLAG: Fehler in der Ueberwachung positiver Motoreingriff, relative Berechnung." FLOAT32_IEEE Conv.cUl2PosMeSigFl._.stoerung_sig_rel_pos_me_S6_S3 1 100 0 1 FORMAT "%4.2" DISPLAY_IDENTIFIER stoerung_sig_rel_pos_me.iUl2PosMeSigFl ECU_ADDRESS 0xFFF8C474 /end MEASUREMENT
/begin MEASUREMENT iUl2PosMeIntenKoordInt.err_int_pos_me "FLAG: Fehler in der Ueberwachung positiver Motoreingriff." UBYTE Conv.cUl2PosMeIntenKoordInt._.err_int_pos_me_S6_S3 1 100 0 1 BIT_MASK 0x1 DISPLAY_IDENTIFIER err_int_pos_me.iUl2PosMeIntenKoordInt ECU_ADDRESS 0xFFF8A07E /end MEASUREMENT
/begin MEASUREMENT iUl2PosMeIntenKoordInt.err_int_pos_me_abs "Fehlerflag für absolute positive Intensitaet Me-Signalüberwachung" UBYTE Conv.cUl2PosMeIntenKoordInt._.err_int_pos_me_abs_S6_S3 1 100 0 1 BIT_MASK 0x1 DISPLAY_IDENTIFIER err_int_pos_me_abs.iUl2PosMeIntenKoordInt ECU_ADDRESS 0xFFF8A07F /end MEASUREMENT
/begin MEASUREMENT iUl2PosMeIntenKoordInt.err_int_pos_me_rel "Fehlerflag für relative absolute Intensitaet Me-Signalüberwachung" UBYTE Conv.cUl2PosMeIntenKoordInt._.err_int_pos_me_rel_S6_S3 1 100 0 1 BIT_MASK 0x1 DISPLAY_IDENTIFIER err_int_pos_me_rel.iUl2PosMeIntenKoordInt ECU_ADDRESS 0xFFF8A080 /end MEASUREMENT
/begin MEASUREMENT iUl2PosMeIntenKoordInt.n_maxstoerposmeint1 "Störzähler PosMe Intensitätsüberwachung 1. Schwelle" UWORD UMR___1_1_0_S6_S3 1 100 0 65535 DISPLAY_IDENTIFIER n_maxstoerposmeint1.iUl2PosMeIntenKoordInt ECU_ADDRESS 0xFFF8A082 /end MEASUREMENT
/begin MEASUREMENT iUl2PosMeIntenKoordInt.n_maxstoerposmeint2 "Störzähler PosMe Intensitätsüberwachung 2. Schwelle" UWORD UMR___1_1_0_S6_S3 1 100 0 65535 DISPLAY_IDENTIFIER n_maxstoerposmeint2.iUl2PosMeIntenKoordInt ECU_ADDRESS 0xFFF8A084 /end MEASUREMENT
/begin MEASUREMENT iUl2PosMeIntenKoordInt.n_maxstoerposmeintigang "Störzähler PosMe Intensitätsüberwachung 2. Schwelle" UWORD UMR___1_1_0_S6_S3 1 100 0 65535 DISPLAY_IDENTIFIER n_maxstoerposmeintigang.iUl2PosMeIntenKoordInt ECU_ADDRESS 0xFFF8A086 /end MEASUREMENT
/begin MEASUREMENT iUl2PosMeIntenKoordFl.err_int_pos_me "FLAG: Fehler in der Ueberwachung positiver Motoreingriff." FLOAT32_IEEE Conv.cUl2PosMeIntenKoordFl._.err_int_pos_me_S6_S3 1 100 0 1 FORMAT "%4.2" DISPLAY_IDENTIFIER err_int_pos_me.iUl2PosMeIntenKoordFl ECU_ADDRESS 0xFFF8C478 /end MEASUREMENT
/begin MEASUREMENT iUl2PosMeIntenKoordFl.err_int_pos_me_abs "Fehlerflag für absolute positive Intensitaet Me-Signalüberwachung" FLOAT32_IEEE Conv.cUl2PosMeIntenKoordFl._.err_int_pos_me_abs_S6_S3 1 100 0 1 FORMAT "%4.2" DISPLAY_IDENTIFIER err_int_pos_me_abs.iUl2PosMeIntenKoordFl ECU_ADDRESS 0xFFF8C47C /end MEASUREMENT
/begin MEASUREMENT iUl2PosMeIntenKoordFl.err_int_pos_me_rel "Fehlerflag für relative absolute Intensitaet Me-Signalüberwachung" FLOAT32_IEEE Conv.cUl2PosMeIntenKoordFl._.err_int_pos_me_rel_S6_S3 1 100 0 1 FORMAT "%4.2" DISPLAY_IDENTIFIER err_int_pos_me_rel.iUl2PosMeIntenKoordFl ECU_ADDRESS 0xFFF8C480 /end MEASUREMENT
/begin MEASUREMENT iUl2PosMeGradientInt.cBasFehlerErfolgInt._.flag_fehler "Das Flag zeigt an ob die Ueberwachungen einen Fehler entdeckt hat." UBYTE Conv.cBasFehlerErfolgInt._.flag_fehler_S6_S3 1 100 0 1 BIT_MASK 0x1 DISPLAY_IDENTIFIER flag_fehler.iUl2PosMeGradientInt ECU_ADDRESS 0xFFF8C484 /end MEASUREMENT
/begin MEASUREMENT iUl2PosMeGradientInt.cBasFehlerErfolgInt._.zaehler_fehler "Fehlerzaehler der Überwachungsfunktion" ULONG UMR___1_1_0_S6_S3 1 100 0 65535 DISPLAY_IDENTIFIER zaehler_fehler.iUl2PosMeGradientInt ECU_ADDRESS 0xFFF8C488 /end MEASUREMENT
/begin MEASUREMENT iUl2PosMeGradientInt.cBasFehlerErfolgInt._.zaehler_erfolge "Erfolgszaehler der Überwachungsfunktion" ULONG UMR___1_1_0_S6_S3 1 100 0 65535 DISPLAY_IDENTIFIER zaehler_erfolge.iUl2PosMeGradientInt ECU_ADDRESS 0xFFF8C48C /end MEASUREMENT
/begin MEASUREMENT iUl2PosMeGradientInt.ng_t_l2.n_f "Filterparameter" SLONG UMR___1_1_0_S6_S3 1 100 -2147483648 2147483647 DISPLAY_IDENTIFIER n_f.ng_t_l2.iUl2PosMeGradientInt ECU_ADDRESS 0xFFF8C49C /end MEASUREMENT
/begin MEASUREMENT iUl2PosMeGradientInt.ng_ab_l2.n_f "Filterparameter" SLONG UMR___1_1_0_S6_S3 1 100 -2147483648 2147483647 DISPLAY_IDENTIFIER n_f.ng_ab_l2.iUl2PosMeGradientInt ECU_ADDRESS 0xFFF8C4A0 /end MEASUREMENT
/begin MEASUREMENT iUl2PosMeGradientInt.ng_meueb "Drehzahlgradient Überwachung Gradientenüberwachung POSME" SLONG UMR_U_MINTASK_1_100_0_S6_S3 1 100 -21474836.48 21474836.47 DISPLAY_IDENTIFIER ng_meueb.iUl2PosMeGradientInt ECU_ADDRESS 0xFFF8C494 /end MEASUREMENT
/begin MEASUREMENT iUl2PosMeGradientInt.stoerung_grad_abs_me "FLAG: Fehler in der Gradientenueberwachung Motoreingriff, absolute Berechnung." UBYTE Conv.cUl2PosMeGradientInt._.stoerung_grad_abs_me_S6_S3 1 100 0 1 BIT_MASK 0x1 DISPLAY_IDENTIFIER stoerung_grad_abs_me.iUl2PosMeGradientInt ECU_ADDRESS 0xFFF8C498 /end MEASUREMENT
/begin MEASUREMENT iUl2PosMeGradientInt.stoerung_grad_rel_me "FLAG: Fehler in der Gradientenueberwachung Motoreingriff, relative Berechnung." UBYTE Conv.cUl2PosMeGradientInt._.stoerung_grad_rel_me_S6_S3 1 100 0 1 BIT_MASK 0x1 DISPLAY_IDENTIFIER stoerung_grad_rel_me.iUl2PosMeGradientInt ECU_ADDRESS 0xFFF8C499 /end MEASUREMENT
/begin MEASUREMENT iUl2PosMeGradientFl.cBasFehlerErfolgFl._.flag_fehler "Das Flag zeigt an ob die Ueberwachungen einen Fehler entdeckt hat." FLOAT32_IEEE Conv.cBasFehlerErfolgFl._.flag_fehler_S6_S3 1 100 0 1 FORMAT "%4.2" DISPLAY_IDENTIFIER flag_fehler.iUl2PosMeGradientFl ECU_ADDRESS 0xFFF8C4A4 /end MEASUREMENT
/begin MEASUREMENT iUl2PosMeGradientFl.cBasFehlerErfolgFl._.zaehler_fehler "Fehlerzaehler der Überwachungsfunktion" FLOAT32_IEEE UMR___1_1_0_S6_S3 1 100 0 65535 FORMAT "%4.2" DISPLAY_IDENTIFIER zaehler_fehler.iUl2PosMeGradientFl ECU_ADDRESS 0xFFF8C4A8 /end MEASUREMENT
/begin MEASUREMENT iUl2PosMeGradientFl.cBasFehlerErfolgFl._.zaehler_erfolge "Erfolgszaehler der Überwachungsfunktion" FLOAT32_IEEE UMR___1_1_0_S6_S3 1 100 0 65535 FORMAT "%4.2" DISPLAY_IDENTIFIER zaehler_erfolge.iUl2PosMeGradientFl ECU_ADDRESS 0xFFF8C4AC /end MEASUREMENT
/begin MEASUREMENT iUl2PosMeGradientFl.ng_t_fl.n_f "Filterparameter" FLOAT32_IEEE UMR___1_1_0_S6_S3 1 100 -2147483648 2147483647 FORMAT "%4.2" DISPLAY_IDENTIFIER n_f.ng_t_fl.iUl2PosMeGradientFl ECU_ADDRESS 0xFFF8C4C0 /end MEASUREMENT
/begin MEASUREMENT iUl2PosMeGradientFl.ng_ab_fl.n_f "Filterparameter" FLOAT32_IEEE UMR___1_1_0_S6_S3 1 100 -2147483648 2147483647 FORMAT "%4.2" DISPLAY_IDENTIFIER n_f.ng_ab_fl.iUl2PosMeGradientFl ECU_ADDRESS 0xFFF8C4C4 /end MEASUREMENT
/begin MEASUREMENT iUl2PosMeGradientFl.ng_meueb "Drehzahlgradient Überwachung Gradientenüberwachung POSME Floatberechnung" FLOAT32_IEEE UMR_U_MINTASK_1_100_0_S6_S3 1 100 -327.68 327.67 DISPLAY_IDENTIFIER ng_meueb.iUl2PosMeGradientFl ECU_ADDRESS 0xFFF8C4B4 /end MEASUREMENT
/begin MEASUREMENT iUl2PosMeGradientFl.stoerung_grad_abs_me "FLAG: Fehler in der Gradientenueberwachung Motoreingriff, absolute Berechnung." FLOAT32_IEEE Conv.cUl2PosMeGradientFl._.stoerung_grad_abs_me_S6_S3 1 100 0 1 FORMAT "%4.2" DISPLAY_IDENTIFIER stoerung_grad_abs_me.iUl2PosMeGradientFl ECU_ADDRESS 0xFFF8C4B8 /end MEASUREMENT
/begin MEASUREMENT iUl2PosMeGradientFl.stoerung_grad_rel_me "FLAG: Fehler in der Gradientenueberwachung Motoreingriff, relative Berechnung." FLOAT32_IEEE Conv.cUl2PosMeGradientFl._.stoerung_grad_rel_me_S6_S3 1 100 0 1 FORMAT "%4.2" DISPLAY_IDENTIFIER stoerung_grad_rel_me.iUl2PosMeGradientFl ECU_ADDRESS 0xFFF8C4BC /end MEASUREMENT
/begin MEASUREMENT iUl2NegMeSigInt.cBasFehlerErfolgInt._.flag_fehler "Das Flag zeigt an ob die Ueberwachungen einen Fehler entdeckt hat." UBYTE Conv.cBasFehlerErfolgInt._.flag_fehler_S6_S3 1 100 0 1 BIT_MASK 0x1 DISPLAY_IDENTIFIER flag_fehler.iUl2NegMeSigInt ECU_ADDRESS 0xFFF8C4C8 /end MEASUREMENT
/begin MEASUREMENT iUl2NegMeSigInt.cBasFehlerErfolgInt._.zaehler_fehler "Fehlerzaehler der Überwachungsfunktion" ULONG UMR___1_1_0_S6_S3 1 100 0 65535 DISPLAY_IDENTIFIER zaehler_fehler.iUl2NegMeSigInt ECU_ADDRESS 0xFFF8C4CC /end MEASUREMENT
/begin MEASUREMENT iUl2NegMeSigInt.cBasFehlerErfolgInt._.zaehler_erfolge "Erfolgszaehler der Überwachungsfunktion" ULONG UMR___1_1_0_S6_S3 1 100 0 65535 DISPLAY_IDENTIFIER zaehler_erfolge.iUl2NegMeSigInt ECU_ADDRESS 0xFFF8C4D0 /end MEASUREMENT
/begin MEASUREMENT iUl2NegMeSigInt.stoerung_sig_abs_neg_me "FLAG: Fehler in der Ueberwachung negativer Motoreingriff, absolute Berechnung." UBYTE Conv.cUl2NegMeSigInt._.stoerung_sig_abs_neg_me_S6_S3 1 100 0 1 BIT_MASK 0x1 DISPLAY_IDENTIFIER stoerung_sig_abs_neg_me.iUl2NegMeSigInt ECU_ADDRESS 0xFFF8C4D8 /end MEASUREMENT
/begin MEASUREMENT iUl2NegMeSigInt.stoerung_sig_rel_neg_me "FLAG: Fehler in der Ueberwachung negativer Motoreingriff, relative Berechnung." UBYTE Conv.cUl2NegMeSigInt._.stoerung_sig_rel_neg_me_S6_S3 1 100 0 1 BIT_MASK 0x1 DISPLAY_IDENTIFIER stoerung_sig_rel_neg_me.iUl2NegMeSigInt ECU_ADDRESS 0xFFF8C4D9 /end MEASUREMENT
/begin MEASUREMENT iUl2NegMeSigFl.cBasFehlerErfolgFl._.flag_fehler "Das Flag zeigt an ob die Ueberwachungen einen Fehler entdeckt hat." FLOAT32_IEEE Conv.cBasFehlerErfolgFl._.flag_fehler_S6_S3 1 100 0 1 FORMAT "%4.2" DISPLAY_IDENTIFIER flag_fehler.iUl2NegMeSigFl ECU_ADDRESS 0xFFF8C4DC /end MEASUREMENT
/begin MEASUREMENT iUl2NegMeSigFl.cBasFehlerErfolgFl._.zaehler_fehler "Fehlerzaehler der Überwachungsfunktion" FLOAT32_IEEE UMR___1_1_0_S6_S3 1 100 0 65535 FORMAT "%4.2" DISPLAY_IDENTIFIER zaehler_fehler.iUl2NegMeSigFl ECU_ADDRESS 0xFFF8C4E0 /end MEASUREMENT
/begin MEASUREMENT iUl2NegMeSigFl.cBasFehlerErfolgFl._.zaehler_erfolge "Erfolgszaehler der Überwachungsfunktion" FLOAT32_IEEE UMR___1_1_0_S6_S3 1 100 0 65535 FORMAT "%4.2" DISPLAY_IDENTIFIER zaehler_erfolge.iUl2NegMeSigFl ECU_ADDRESS 0xFFF8C4E4 /end MEASUREMENT
/begin MEASUREMENT iUl2NegMeSigFl.stoerung_sig_abs_neg_me "FLAG: Fehler in der Ueberwachung negativer Motoreingriff, absolute Berechnung." FLOAT32_IEEE Conv.cUl2NegMeSigFl._.stoerung_sig_abs_neg_me_S6_S3 1 100 0 1 FORMAT "%4.2" DISPLAY_IDENTIFIER stoerung_sig_abs_neg_me.iUl2NegMeSigFl ECU_ADDRESS 0xFFF8C4EC /end MEASUREMENT
/begin MEASUREMENT iUl2NegMeSigFl.stoerung_sig_rel_neg_me "FLAG: Fehler in der Ueberwachung negativer Motoreingriff, relative Berechnung." FLOAT32_IEEE Conv.cUl2NegMeSigFl._.stoerung_sig_rel_neg_me_S6_S3 1 100 0 1 FORMAT "%4.2" DISPLAY_IDENTIFIER stoerung_sig_rel_neg_me.iUl2NegMeSigFl ECU_ADDRESS 0xFFF8C4F0 /end MEASUREMENT
/begin MEASUREMENT iUl2NegMeIntenInt.cBasFehlerErfolgInt._.flag_fehler "Das Flag zeigt an ob die Ueberwachungen einen Fehler entdeckt hat." UBYTE Conv.cBasFehlerErfolgInt._.flag_fehler_S6_S3 1 100 0 1 BIT_MASK 0x1 DISPLAY_IDENTIFIER flag_fehler.iUl2NegMeIntenInt ECU_ADDRESS 0xFFF8C4F4 /end MEASUREMENT
/begin MEASUREMENT iUl2NegMeIntenInt.cBasFehlerErfolgInt._.zaehler_fehler "Fehlerzaehler der Überwachungsfunktion" ULONG UMR___1_1_0_S6_S3 1 100 0 65535 DISPLAY_IDENTIFIER zaehler_fehler.iUl2NegMeIntenInt ECU_ADDRESS 0xFFF8C4F8 /end MEASUREMENT
/begin MEASUREMENT iUl2NegMeIntenInt.cBasFehlerErfolgInt._.zaehler_erfolge "Erfolgszaehler der Überwachungsfunktion" ULONG UMR___1_1_0_S6_S3 1 100 0 65535 DISPLAY_IDENTIFIER zaehler_erfolge.iUl2NegMeIntenInt ECU_ADDRESS 0xFFF8C4FC /end MEASUREMENT
/begin MEASUREMENT iUl2NegMeIntenInt.stoerung_int_abs_neg_me "FLAG: Fehler in der Ueberwachung negativer Motoreingriff, absolute Berechnung." UBYTE Conv.cUl2NegMeIntenInt._.stoerung_int_abs_neg_me_S6_S3 1 100 0 1 BIT_MASK 0x1 DISPLAY_IDENTIFIER stoerung_int_abs_neg_me.iUl2NegMeIntenInt ECU_ADDRESS 0xFFF8C504 /end MEASUREMENT
/begin MEASUREMENT iUl2NegMeIntenInt.stoerung_int_rel_neg_me "FLAG: Fehler in der Ueberwachung negativer Motoreingriff, relative Berechnung." UBYTE Conv.cUl2NegMeIntenInt._.stoerung_int_rel_neg_me_S6_S3 1 100 0 1 BIT_MASK 0x1 DISPLAY_IDENTIFIER stoerung_int_rel_neg_me.iUl2NegMeIntenInt ECU_ADDRESS 0xFFF8C505 /end MEASUREMENT
/begin MEASUREMENT iUl2NegMeIntenFl.cBasFehlerErfolgFl._.flag_fehler "Das Flag zeigt an ob die Ueberwachungen einen Fehler entdeckt hat." FLOAT32_IEEE Conv.cBasFehlerErfolgFl._.flag_fehler_S6_S3 1 100 0 1 FORMAT "%4.2" DISPLAY_IDENTIFIER flag_fehler.iUl2NegMeIntenFl ECU_ADDRESS 0xFFF8C508 /end MEASUREMENT
/begin MEASUREMENT iUl2NegMeIntenFl.cBasFehlerErfolgFl._.zaehler_fehler "Fehlerzaehler der Überwachungsfunktion" FLOAT32_IEEE UMR___1_1_0_S6_S3 1 100 0 65535 FORMAT "%4.2" DISPLAY_IDENTIFIER zaehler_fehler.iUl2NegMeIntenFl ECU_ADDRESS 0xFFF8C50C /end MEASUREMENT
/begin MEASUREMENT iUl2NegMeIntenFl.cBasFehlerErfolgFl._.zaehler_erfolge "Erfolgszaehler der Überwachungsfunktion" FLOAT32_IEEE UMR___1_1_0_S6_S3 1 100 0 65535 FORMAT "%4.2" DISPLAY_IDENTIFIER zaehler_erfolge.iUl2NegMeIntenFl ECU_ADDRESS 0xFFF8C510 /end MEASUREMENT
/begin MEASUREMENT iUl2NegMeIntenFl.stoerung_int_abs_neg_me "FLAG: Fehler in der Ueberwachung negativer Motoreingriff, absolute Berechnung." FLOAT32_IEEE Conv.cUl2NegMeIntenFl._.stoerung_int_abs_neg_me_S6_S3 1 100 0 1 FORMAT "%4.2" DISPLAY_IDENTIFIER stoerung_int_abs_neg_me.iUl2NegMeIntenFl ECU_ADDRESS 0xFFF8C518 /end MEASUREMENT
/begin MEASUREMENT iUl2NegMeIntenFl.stoerung_int_rel_neg_me "FLAG: Fehler in der Ueberwachung negativer Motoreingriff, relative Berechnung." FLOAT32_IEEE Conv.cUl2NegMeIntenFl._.stoerung_int_rel_neg_me_S6_S3 1 100 0 1 FORMAT "%4.2" DISPLAY_IDENTIFIER stoerung_int_rel_neg_me.iUl2NegMeIntenFl ECU_ADDRESS 0xFFF8C51C /end MEASUREMENT
/begin MEASUREMENT iUl2GetrMAufInt.cBasFehlerErfolgInt._.flag_fehler "Das Flag zeigt an ob die Ueberwachungen einen Fehler entdeckt hat." UBYTE Conv.cBasFehlerErfolgInt._.flag_fehler_S6_S3 1 100 0 1 BIT_MASK 0x1 DISPLAY_IDENTIFIER flag_fehler.iUl2GetrMAufInt ECU_ADDRESS 0xFFF8E5E4 /end MEASUREMENT
/begin MEASUREMENT iUl2GetrMAufInt.cBasFehlerErfolgInt._.zaehler_fehler "Fehlerzaehler der Überwachungsfunktion" ULONG UMR___1_1_0_S6_S3 1 100 0 65535 DISPLAY_IDENTIFIER zaehler_fehler.iUl2GetrMAufInt ECU_ADDRESS 0xFFF8E5E8 /end MEASUREMENT
/begin MEASUREMENT iUl2GetrMAufInt.cBasFehlerErfolgInt._.zaehler_erfolge "Erfolgszaehler der Überwachungsfunktion" ULONG UMR___1_1_0_S6_S3 1 100 0 65535 DISPLAY_IDENTIFIER zaehler_erfolge.iUl2GetrMAufInt ECU_ADDRESS 0xFFF8E5EC /end MEASUREMENT
/begin MEASUREMENT iUl2GetrMAufInt.mmot_auf_zul "Zulässiges Aufnahmemoment" UWORD UMR_NM__1_1_0_S6_S3 1 100 0 2000 DISPLAY_IDENTIFIER mmot_auf_zul.iUl2GetrMAufInt ECU_ADDRESS 0xFFF8E5F4 /end MEASUREMENT
/begin MEASUREMENT iUl2GetrMAufInt.n_maxstoermgetrauf "Störzähler Überwachung Getr Aufnahmemoment" UWORD UMR___1_1_0_S6_S3 1 100 0 65535 DISPLAY_IDENTIFIER n_maxstoermgetrauf.iUl2GetrMAufInt ECU_ADDRESS 0xFFF8E5F6 /end MEASUREMENT
/begin MEASUREMENT iUl2GetrMAufFl.cBasFehlerErfolgFl._.flag_fehler "Das Flag zeigt an ob die Ueberwachungen einen Fehler entdeckt hat." FLOAT32_IEEE Conv.cBasFehlerErfolgFl._.flag_fehler_S6_S3 1 100 0 1 FORMAT "%4.2" DISPLAY_IDENTIFIER flag_fehler.iUl2GetrMAufFl ECU_ADDRESS 0xFFF8E5F8 /end MEASUREMENT
/begin MEASUREMENT iUl2GetrMAufFl.cBasFehlerErfolgFl._.zaehler_fehler "Fehlerzaehler der Überwachungsfunktion" FLOAT32_IEEE UMR___1_1_0_S6_S3 1 100 0 65535 FORMAT "%4.2" DISPLAY_IDENTIFIER zaehler_fehler.iUl2GetrMAufFl ECU_ADDRESS 0xFFF8E5FC /end MEASUREMENT
/begin MEASUREMENT iUl2GetrMAufFl.cBasFehlerErfolgFl._.zaehler_erfolge "Erfolgszaehler der Überwachungsfunktion" FLOAT32_IEEE UMR___1_1_0_S6_S3 1 100 0 65535 FORMAT "%4.2" DISPLAY_IDENTIFIER zaehler_erfolge.iUl2GetrMAufFl ECU_ADDRESS 0xFFF8E600 /end MEASUREMENT
/begin MEASUREMENT iUl2GetrMAufFl.mmot_auf_zul "Zulässiges Aufnahmemoment" FLOAT32_IEEE UMR_NM__1_1_0_S6_S3 1 100 0 2000 DISPLAY_IDENTIFIER mmot_auf_zul.iUl2GetrMAufFl ECU_ADDRESS 0xFFF8E608 /end MEASUREMENT
/begin MEASUREMENT iUl2NmotuInt.pruefbed_nmotueb_l2 "Lev2 FLAG: Pruefbed. der NMOTUEB erfuellt." UBYTE Conv.cUl2NmotuInt._.pruefbed_nmotueb_l2_S6_S3 1 100 0 1 BIT_MASK 0x1 DISPLAY_IDENTIFIER pruefbed_nmotueb_l2.iUl2NmotuInt ECU_ADDRESS 0xFFF8F2B0 /end MEASUREMENT
/begin MEASUREMENT iUl2NmotuInt.n_mot_schwelle "aktuell berechnete maximal zulässige Motordrehzahl für Level2" UWORD UMR_U_MIN_1_1_0_S6_S3 1 100 0 10000 DISPLAY_IDENTIFIER n_mot_schwelle.iUl2NmotuInt ECU_ADDRESS 0xFFF8F2B2 /end MEASUREMENT
/begin MEASUREMENT iUl2NmotuInt.n_t_schwelle "aktuell berechnete maximal (zielgangabhaengig berechnete) Turbinendrehzahl für Level2" UWORD UMR_U_MIN_1_1_0_S6_S3 1 100 0 10000 DISPLAY_IDENTIFIER n_t_schwelle.iUl2NmotuInt ECU_ADDRESS 0xFFF8F2B4 /end MEASUREMENT
/begin MEASUREMENT iUl2NmotuInt.n_stoer_nmotueb "Zaehler Fehlerfilter NMOT-Ueberwachung" UWORD UMR___1_1_0_S6_S3 1 100 0 65535 DISPLAY_IDENTIFIER n_stoer_nmotueb.iUl2NmotuInt ECU_ADDRESS 0xFFF8F2B6 /end MEASUREMENT
/begin MEASUREMENT iUl2NmotuInt.n_stoer_nmotueb_rueckfilter "Zaehler Rueckfilterzeit NMOT-Ueberwachung" UWORD UMR___1_1_0_S6_S3 1 100 0 65535 DISPLAY_IDENTIFIER n_stoer_nmotueb_rueckfilter.iUl2NmotuInt ECU_ADDRESS 0xFFF8F2B8 /end MEASUREMENT
/begin MEASUREMENT iUl2NmotuInt.pos_alt "merkt sich die vorherige Position" UBYTE Conv.cUl2NmotuInt._.pos_alt_S6_S3 1 100 0 8 DISPLAY_IDENTIFIER pos_alt.iUl2NmotuInt ECU_ADDRESS 0xFFF8F2BA /end MEASUREMENT
/begin MEASUREMENT iUl2NmotuInt.z_nmotabreg_l2 "Zustand N_MOTABREGEL-Bestimmung zur Level2 Fkt Motorueberdrehzahlueberwachung" UBYTE Conv.cUl2NmotuInt._.z_nmotabreg_l2_S6_S3 1 100 0 2 DISPLAY_IDENTIFIER z_nmotabreg_l2.iUl2NmotuInt ECU_ADDRESS 0xFFF8F2BB /end MEASUREMENT
/begin MEASUREMENT iUl2NmotuInt.n_mot_schwelle_alt "alte/zuletzt berechnete maximal zulässige Motordrehzahl für Level2" UWORD UMR_U_MIN_1_1_0_S6_S3 1 100 0 10000 DISPLAY_IDENTIFIER n_mot_schwelle_alt.iUl2NmotuInt ECU_ADDRESS 0xFFF8F2BC /end MEASUREMENT
/begin MEASUREMENT iUl2NmotuInt.n_mot_obergrenze "neuer Zielwert aus GET_N_MOTABREGEL x F_NMOTUEB für NMOT-Überwachung (Level2)" UWORD UMR_U_MIN_1_1_0_S6_S3 1 100 0 10000 DISPLAY_IDENTIFIER n_mot_obergrenze.iUl2NmotuInt ECU_ADDRESS 0xFFF8F2BE /end MEASUREMENT
/begin MEASUREMENT iUl2NmotuInt.n_mot_min_l2 "Minimale Motordrehzahl waehrend der Reduzierung der max zul. Motordrehzahlgrenze bie Level2" UWORD UMR_U_MIN_1_1_0_S6_S3 1 100 0 10000 DISPLAY_IDENTIFIER n_mot_min_l2.iUl2NmotuInt ECU_ADDRESS 0xFFF8F2C0 /end MEASUREMENT
/begin MEASUREMENT iUl2NmotuInt.n_stoer_red_nmotabreg "Verzoegerungszaehler bis Reduzierung der N_Mot-Abregeldrehzahl aktiv wird" UWORD UMR___1_1_0_S6_S3 1 100 0 65535 DISPLAY_IDENTIFIER n_stoer_red_nmotabreg.iUl2NmotuInt ECU_ADDRESS 0xFFF8F2C2 /end MEASUREMENT
/begin MEASUREMENT iUl2NmotuInt.z_nt_max_zg_l2 "Zustand N_T_MAX_ZG-Bestimmung zur Level2 Fkt. Motorueberdrehzahlueberwachung/Zielgangplausipruefung" UBYTE Conv.cUl2NmotuInt._.z_nt_max_zg_l2_S6_S3 1 100 0 2 DISPLAY_IDENTIFIER z_nt_max_zg_l2.iUl2NmotuInt ECU_ADDRESS 0xFFF8F2C4 /end MEASUREMENT
/begin MEASUREMENT iUl2NmotuInt.n_t_schwelle_alt "alte/zuletzt berechnete maximal zulässige zielgangabhaengig berechnete) Turbinendrehzahl für Level2" UWORD UMR_U_MIN_1_1_0_S6_S3 1 100 0 10000 DISPLAY_IDENTIFIER n_t_schwelle_alt.iUl2NmotuInt ECU_ADDRESS 0xFFF8F2C6 /end MEASUREMENT
/begin MEASUREMENT iUl2NmotuInt.n_t_zg_obergrenze "neuer Zielwert aus TAB_NMOTUEBDSCOFF oder GET_N_MOTABREGEL x F_NMOTUEB für NMOT-Überwachung (Level2)" UWORD UMR_U_MIN_1_1_0_S6_S3 1 100 0 10000 DISPLAY_IDENTIFIER n_t_zg_obergrenze.iUl2NmotuInt ECU_ADDRESS 0xFFF8F2C8 /end MEASUREMENT
/begin MEASUREMENT iUl2NmotuInt.n_t_zg_obergrenze_alt "alter Zielwert aus TAB_NMOTUEBDSCOFF oder GET_N_MOTABREGEL x F_NMOTUEB für NMOT-Überwachung (Level2)" UWORD UMR_U_MIN_1_1_0_S6_S3 1 100 0 10000 DISPLAY_IDENTIFIER n_t_zg_obergrenze_alt.iUl2NmotuInt ECU_ADDRESS 0xFFF8F2CA /end MEASUREMENT
/begin MEASUREMENT iUl2NmotuInt.n_t_min_zg_l2 "Minimale Motordrehzahl waehrend der Reduzierung der max zul. Turbinendrehzahlgrenze bie Level2" UWORD UMR_U_MIN_1_1_0_S6_S3 1 100 0 10000 DISPLAY_IDENTIFIER n_t_min_zg_l2.iUl2NmotuInt ECU_ADDRESS 0xFFF8F2CC /end MEASUREMENT
/begin MEASUREMENT iUl2NmotuInt.n_stoer_red_ntmaxzg "Verzoegerungszaehler bis Reduzierung der N_T-Grenzdrehzahl aktiv wird" UWORD UMR___1_1_0_S6_S3 1 100 0 65535 DISPLAY_IDENTIFIER n_stoer_red_ntmaxzg.iUl2NmotuInt ECU_ADDRESS 0xFFF8F2CE /end MEASUREMENT
/begin MEASUREMENT iUl2NmotuInt.ntmaxzg_verz_aktiv "Flag: Verzoegerung der Zielgangabhaengige N_T-Grenzdrehzahl bei Reduzierung aktiv" UBYTE Conv.cUl2NmotuInt._.ntmaxzg_verz_aktiv_S6_S3 1 100 0 1 BIT_MASK 0x1 DISPLAY_IDENTIFIER ntmaxzg_verz_aktiv.iUl2NmotuInt ECU_ADDRESS 0xFFF8F2D0 /end MEASUREMENT
/begin MEASUREMENT iUl2NmotuInt.dsc_fehler_alt "Flag: Alter Wert vom vorherigen Programmzyklus von dsc_fehler" UBYTE Conv.cUl2NmotuInt._.dsc_fehler_alt_S6_S3 1 100 0 1 DISPLAY_IDENTIFIER dsc_fehler_alt.iUl2NmotuInt ECU_ADDRESS 0xFFF8F2D1 /end MEASUREMENT
/begin MEASUREMENT iUl2NmotuInt.zielgang_sas_alt_l2 "Level2: alter Wert von zielgang_sas" SBYTE Conv.cUl2NmotuInt._.zielgang_sas_alt_l2_S6_S3 1 100 -1 8 DISPLAY_IDENTIFIER zielgang_sas_alt_l2.iUl2NmotuInt ECU_ADDRESS 0xFFF8F2D2 /end MEASUREMENT
/begin MEASUREMENT iUl2NmotuFl.pruefbed_nmotueb_l2 "Lev2 FLAG: Pruefbed. der NMOTUEB erfuellt." FLOAT32_IEEE Conv.cUl2NmotuFl._.pruefbed_nmotueb_l2_S6_S3 1 100 0 1 FORMAT "%4.2" DISPLAY_IDENTIFIER pruefbed_nmotueb_l2.iUl2NmotuFl ECU_ADDRESS 0xFFF8F2D4 /end MEASUREMENT
/begin MEASUREMENT iUl2NmotuFl.n_mot_schwelle "aktuell berechnete maximal zulässige Motordrehzahl für Level2" FLOAT32_IEEE UMR_U_MIN_1_1_0_S6_S3 1 100 0 10000 DISPLAY_IDENTIFIER n_mot_schwelle.iUl2NmotuFl ECU_ADDRESS 0xFFF8F2D8 /end MEASUREMENT
/begin MEASUREMENT iUl2NmotuFl.n_t_schwelle "aktuell berechnete maximal (zielgangabhaengig berechnete) Turbinendrehzahl für Level2" FLOAT32_IEEE UMR_U_MIN_1_1_0_S6_S3 1 100 0 10000 DISPLAY_IDENTIFIER n_t_schwelle.iUl2NmotuFl ECU_ADDRESS 0xFFF8F2DC /end MEASUREMENT
/begin MEASUREMENT iUl2NmotuFl.n_stoer_nmotueb "Zaehler Fehlerfilter NMOT-Ueberwachung" FLOAT32_IEEE UMR___1_1_0_S6_S3 1 100 0 65535 FORMAT "%4.2" DISPLAY_IDENTIFIER n_stoer_nmotueb.iUl2NmotuFl ECU_ADDRESS 0xFFF8F2E0 /end MEASUREMENT
/begin MEASUREMENT iUl2NmotuFl.n_stoer_nmotueb_rueckfilter "Zaehler Rueckfilterzeit NMOT-Ueberwachung als Komplement" FLOAT32_IEEE UMR___1_1_0_S6_S3 1 100 0 65535 FORMAT "%4.2" DISPLAY_IDENTIFIER n_stoer_nmotueb_rueckfilter.iUl2NmotuFl ECU_ADDRESS 0xFFF8F2E4 /end MEASUREMENT
/begin MEASUREMENT iUl2NmotuFl.pos_alt "merkt sich die vorherige Position" FLOAT32_IEEE UMR___1_1_0_S6_S3 1 100 0 8 FORMAT "%4.2" DISPLAY_IDENTIFIER pos_alt.iUl2NmotuFl ECU_ADDRESS 0xFFF8F2E8 /end MEASUREMENT
/begin MEASUREMENT iUl2NmotuFl.z_nmotabreg_l2 "Zustand N_MOTABREGEL-Bestimmung zur Level2 Fkt Motorueberdrehzahlueberwachung" FLOAT32_IEEE Conv.cUl2NmotuFl._.z_nmotabreg_l2_S6_S3 1 100 0 2 FORMAT "%4.2" DISPLAY_IDENTIFIER z_nmotabreg_l2.iUl2NmotuFl ECU_ADDRESS 0xFFF8F2EC /end MEASUREMENT
/begin MEASUREMENT iUl2NmotuFl.n_mot_schwelle_alt "alte/zuletzt berechnete maximal zulässige Motordrehzahl für Level2" FLOAT32_IEEE UMR_U_MIN_1_1_0_S6_S3 1 100 0 10000 DISPLAY_IDENTIFIER n_mot_schwelle_alt.iUl2NmotuFl ECU_ADDRESS 0xFFF8F2F0 /end MEASUREMENT
/begin MEASUREMENT iUl2NmotuFl.n_mot_obergrenze "neuer Zielwert aus GET_N_MOTABREGEL x F_NMOTUEB für NMOT-Überwachung (Level2)" FLOAT32_IEEE UMR_U_MIN_1_1_0_S6_S3 1 100 0 10000 DISPLAY_IDENTIFIER n_mot_obergrenze.iUl2NmotuFl ECU_ADDRESS 0xFFF8F2F4 /end MEASUREMENT
/begin MEASUREMENT iUl2NmotuFl.n_mot_min_l2 "Minimale Motordrehzahl waehrend der Reduzierung der max zul. Motordrehzahlgrenze bie Level2" FLOAT32_IEEE UMR_U_MIN_1_1_0_S6_S3 1 100 0 10000 DISPLAY_IDENTIFIER n_mot_min_l2.iUl2NmotuFl ECU_ADDRESS 0xFFF8F2F8 /end MEASUREMENT
/begin MEASUREMENT iUl2NmotuFl.n_stoer_red_nmotabreg "Verzoegerungszaehler bis Reduzierung der N_Mot-Abregeldrehzahl aktiv wird" FLOAT32_IEEE UMR___1_1_0_S6_S3 1 100 0 65535 FORMAT "%4.2" DISPLAY_IDENTIFIER n_stoer_red_nmotabreg.iUl2NmotuFl ECU_ADDRESS 0xFFF8F2FC /end MEASUREMENT
/begin MEASUREMENT iUl2NmotuFl.z_nt_max_zg_l2 "Zustand N_T_MAX_ZG-Bestimmung zur Level2 Fkt. Motorueberdrehzahlueberwachung/Zielgangplausipruefung" FLOAT32_IEEE Conv.cUl2NmotuFl._.z_nt_max_zg_l2_S6_S3 1 100 0 2 FORMAT "%4.2" DISPLAY_IDENTIFIER z_nt_max_zg_l2.iUl2NmotuFl ECU_ADDRESS 0xFFF8F300 /end MEASUREMENT
/begin MEASUREMENT iUl2NmotuFl.n_t_schwelle_alt "alte/zuletzt berechnete maximal zulässige zielgangabhaengig berechnete) Turbinendrehzahl für Level2" FLOAT32_IEEE UMR_U_MIN_1_1_0_S6_S3 1 100 0 10000 DISPLAY_IDENTIFIER n_t_schwelle_alt.iUl2NmotuFl ECU_ADDRESS 0xFFF8F304 /end MEASUREMENT
/begin MEASUREMENT iUl2NmotuFl.n_t_zg_obergrenze "neuer Zielwert aus TAB_NMOTUEBDSCOFF oder GET_N_MOTABREGEL x F_NMOTUEB für NMOT-Überwachung (Level2)" FLOAT32_IEEE UMR_U_MIN_1_1_0_S6_S3 1 100 0 10000 DISPLAY_IDENTIFIER n_t_zg_obergrenze.iUl2NmotuFl ECU_ADDRESS 0xFFF8F308 /end MEASUREMENT
/begin MEASUREMENT iUl2NmotuFl.n_t_zg_obergrenze_alt "alter Zielwert aus TAB_NMOTUEBDSCOFF oder GET_N_MOTABREGEL x F_NMOTUEB für NMOT-Überwachung (Level2)" FLOAT32_IEEE UMR_U_MIN_1_1_0_S6_S3 1 100 0 10000 DISPLAY_IDENTIFIER n_t_zg_obergrenze_alt.iUl2NmotuFl ECU_ADDRESS 0xFFF8F30C /end MEASUREMENT
/begin MEASUREMENT iUl2NmotuFl.n_t_min_zg_l2 "Minimale Motordrehzahl waehrend der Reduzierung der max zul. Turbinendrehzahlgrenze bie Level2" FLOAT32_IEEE UMR_U_MIN_1_1_0_S6_S3 1 100 0 10000 DISPLAY_IDENTIFIER n_t_min_zg_l2.iUl2NmotuFl ECU_ADDRESS 0xFFF8F310 /end MEASUREMENT
/begin MEASUREMENT iUl2NmotuFl.n_stoer_red_ntmaxzg "Verzoegerungszaehler bis Reduzierung der N_T-Grenzdrehzahl aktiv wird" FLOAT32_IEEE UMR___1_1_0_S6_S3 1 100 0 65535 FORMAT "%4.2" DISPLAY_IDENTIFIER n_stoer_red_ntmaxzg.iUl2NmotuFl ECU_ADDRESS 0xFFF8F314 /end MEASUREMENT
/begin MEASUREMENT iUl2NmotuFl.ntmaxzg_verz_aktiv "Flag: Verzoegerung der Zielgangabhaengige N_T-Grenzdrehzahl bei Reduzierung aktiv" FLOAT32_IEEE Conv.cUl2NmotuFl._.ntmaxzg_verz_aktiv_S6_S3 1 100 0 1 FORMAT "%4.2" DISPLAY_IDENTIFIER ntmaxzg_verz_aktiv.iUl2NmotuFl ECU_ADDRESS 0xFFF8F318 /end MEASUREMENT
/begin MEASUREMENT iUl2NmotuFl.dsc_fehler_alt "Flag: Alter Wert vom vorherigen Programmzyklus von dsc_fehler" FLOAT32_IEEE Conv.cUl2NmotuFl._.dsc_fehler_alt_S6_S3 1 100 0 1 FORMAT "%4.2" DISPLAY_IDENTIFIER dsc_fehler_alt.iUl2NmotuFl ECU_ADDRESS 0xFFF8F31C /end MEASUREMENT
/begin MEASUREMENT iUl2NmotuFl.zielgang_sas_alt_l2 "Level2: alter Wert von zielgang_sas" FLOAT32_IEEE Conv.cUl2NmotuFl._.zielgang_sas_alt_l2_S6_S3 1 100 -1 8 FORMAT "%4.2" DISPLAY_IDENTIFIER zielgang_sas_alt_l2.iUl2NmotuFl ECU_ADDRESS 0xFFF8F320 /end MEASUREMENT
/begin MEASUREMENT iUl2MaxVerzEinst.einstiegsbed "Einstiegsbedingungen" UBYTE UMR___1_1_0_S6_S3 1 100 0 1 BIT_MASK 0x1 DISPLAY_IDENTIFIER einstiegsbed.iUl2MaxVerzEinst ECU_ADDRESS 0xFFF8EC98 /end MEASUREMENT
/begin MEASUREMENT iUl2MaxVerzEinst.uew_verzmax_aktiv "Ueberwachungs-aktiv Flag - Einstiegsbedingung erfuellt" UBYTE UMR___1_1_0_S6_S3 1 100 0 1 BIT_MASK 0x1 DISPLAY_IDENTIFIER uew_verzmax_aktiv.iUl2MaxVerzEinst ECU_ADDRESS 0xFFF8EC99 /end MEASUREMENT
/begin MEASUREMENT iUl2MaxVerzEinst.n_zaehlerverzmaxaktiv "Zaehler zur Aktivierung der Ueberwachung max. Verzoegerung" UWORD UMR___1_1_0_S6_S3 1 100 0 1000 DISPLAY_IDENTIFIER n_zaehlerverzmaxaktiv.iUl2MaxVerzEinst ECU_ADDRESS 0xFFF8EC9A /end MEASUREMENT
/begin MEASUREMENT iUl2MaxVerzEinst.n_nab_maxverz "Zaehler zur Ausblenden der Ueberwachung max. Verzoegerung" UWORD UMR___1_1_0_S6_S3 1 100 0 1000 DISPLAY_IDENTIFIER n_nab_maxverz.iUl2MaxVerzEinst ECU_ADDRESS 0xFFF8EC9C /end MEASUREMENT
/begin MEASUREMENT iUl2MaxVerzEinst.n_schwelle_zaehlervermax_aktiv "Schwelle für die Aktivierung von Max Verzoegerung" UWORD UMR___1_1_0_S6_S3 1 100 0 65535 DISPLAY_IDENTIFIER n_schwelle_zaehlervermax_aktiv.iUl2MaxVerzEinst ECU_ADDRESS 0xFFF8EC9E /end MEASUREMENT
/begin MEASUREMENT iUl2MaxVerz.flag_verzmax_nab "Signalisiert ob NAB-Fehler aufgetreten ist" UBYTE UMR___1_1_0_S6_S3 1 100 0 1 BIT_MASK 0x1 DISPLAY_IDENTIFIER flag_verzmax_nab.iUl2MaxVerz ECU_ADDRESS 0xFFF8A264 /end MEASUREMENT
/begin MEASUREMENT iUl2MaxVerz.flag_verzmax_nab_pb "Signalisiert ob NAB-Fehler aufgetreten ist, wenn Überwachung Handbremse aktiv ist" UBYTE UMR___1_1_0_S6_S3 1 100 0 1 BIT_MASK 0x1 DISPLAY_IDENTIFIER flag_verzmax_nab_pb.iUl2MaxVerz ECU_ADDRESS 0xFFF8A265 /end MEASUREMENT
/begin MEASUREMENT iUl2MaxVerz.flag_verzmax_nabstatus "Signalisiert ob NAB-Fehler aufgetreten ist, wenn Überwachung Handbremse aktiv ist" UBYTE UMR___1_1_0_S6_S3 1 100 0 1 BIT_MASK 0x1 DISPLAY_IDENTIFIER flag_verzmax_nabstatus.iUl2MaxVerz ECU_ADDRESS 0xFFF8A266 /end MEASUREMENT
/begin MEASUREMENT iUl2MaxVerz.n_ab_dif "Differenzdrehzahl n_ab für Teilfunktion Bewertung über Ringspeicher n_ab-Signal für Ueberwachung max Verzoegerung" SWORD UMR_U_MIN_1_1_0_S6_S3 1 100 -8160 8160 DISPLAY_IDENTIFIER n_ab_dif.iUl2MaxVerz ECU_ADDRESS 0xFFF8A268 /end MEASUREMENT
/begin MEASUREMENT iUl2MaxVerz.n_ab_ref "Referenzdrehzahl n_ab für Teilfunktion Bewertung über Ringspeicher n_ab-Signal für Ueberwachung max Verzoegerung" UWORD UMR_U_MIN_1_1_0_S6_S3 1 100 0 8160 DISPLAY_IDENTIFIER n_ab_ref.iUl2MaxVerz ECU_ADDRESS 0xFFF8A26A /end MEASUREMENT
/begin MEASUREMENT iUl2MaxVerz.n_ab_akt "Aktuelle n_ab für Teilfunktion Bewertung über Ringspeicher n_ab-Signal für Ueberwachung max Verzoegerung" UWORD UMR_U_MIN_1_1_0_S6_S3 1 100 0 8160 DISPLAY_IDENTIFIER n_ab_akt.iUl2MaxVerz ECU_ADDRESS 0xFFF8A26C /end MEASUREMENT
/begin MEASUREMENT iUl2MaxVerz.n_verz_maxverz "Zaehler zur Aktivierung der Ueberwachung Parkbremse" UWORD UMR___1_1_0_S6_S3 1 100 0 2550 DISPLAY_IDENTIFIER n_verz_maxverz.iUl2MaxVerz ECU_ADDRESS 0xFFF8A26E /end MEASUREMENT
/begin MEASUREMENT iUl2MaxVerz.n_verz_maxverz_nabstatus "Zaehler für die Verzoegerung mit Nab Status" UBYTE UMR___1_1_0_S6_S3 1 100 0 255 DISPLAY_IDENTIFIER n_verz_maxverz_nabstatus.iUl2MaxVerz ECU_ADDRESS 0xFFF8A270 /end MEASUREMENT
/begin MEASUREMENT iUl2SigItfInputInt.ers_edsmv_info "Eingangsgroesse EDSMS-ErsatzInfo" UBYTE Conv.cUl2SigItfInputInt._.ers_edsmv_info_S6_S3 1 100 0 7 DISPLAY_IDENTIFIER ers_edsmv_info.iUl2SigItfInputInt ECU_ADDRESS 0xFFF8A24C /end MEASUREMENT
/begin MEASUREMENT iUl2SigItfInputInt.kmn_out10lssoff "zeigt an ob die Massnahme KMN_OUT10LSSOFF aktiv ist" UBYTE Conv.cUl2SigItfInputInt._.kmn_out10lssoff_S6_S3 1 100 0 1 DISPLAY_IDENTIFIER kmn_out10lssoff.iUl2SigItfInputInt ECU_ADDRESS 0xFFF8A24D /end MEASUREMENT
/begin MEASUREMENT iUl2SigItfInputKomp.ers_edsmv_info_komp "Komplement: Eingangsgroesse EDSMS-ErsatzInfo" UBYTE Conv.cUl2SigItfInputKomp._.ers_edsmv_info_komp_S6_S3 1 100 248 255 DISPLAY_IDENTIFIER ers_edsmv_info_komp.iUl2SigItfInputKomp ECU_ADDRESS 0xFFF8A24E /end MEASUREMENT
/begin MEASUREMENT iUl2SigItfInputKomp.kmn_out10lssoff_komp "Komplement: zeigt an ob die Massnahme KMN_OUT10LSSOFF aktiv ist" UBYTE Conv.cUl2SigItfInputKomp._.kmn_out10lssoff_komp_S6_S3 1 100 254 255 DISPLAY_IDENTIFIER kmn_out10lssoff_komp.iUl2SigItfInputKomp ECU_ADDRESS 0xFFF8A24F /end MEASUREMENT
/begin MEASUREMENT iUl2SigItfInputAtsysInt.i_eds_0_l2 "L2: IEds 0 bzgl. GET_ERS_EDSMV_INFO abgesichert" UWORD UMR_MA__1_10_0_S6_S3 1 100 0 1200 DISPLAY_IDENTIFIER i_eds_0_l2.iUl2SigItfInputAtsysInt ECU_ADDRESS 0xFFF8C58C /end MEASUREMENT
/begin MEASUREMENT iUl2SigItfInputAtsysInt.i_eds_1_l2 "L2: IEds 1 bzgl. GET_ERS_EDSMV_INFO abgesichert" UWORD UMR_MA__1_10_0_S6_S3 1 100 0 1200 DISPLAY_IDENTIFIER i_eds_1_l2.iUl2SigItfInputAtsysInt ECU_ADDRESS 0xFFF8C58E /end MEASUREMENT
/begin MEASUREMENT iUl2SigItfInputAtsysInt.i_eds_2_l2 "L2: IEds 2 bzgl. GET_ERS_EDSMV_INFO abgesichert" UWORD UMR_MA__1_10_0_S6_S3 1 100 0 1200 DISPLAY_IDENTIFIER i_eds_2_l2.iUl2SigItfInputAtsysInt ECU_ADDRESS 0xFFF8C590 /end MEASUREMENT
/begin MEASUREMENT iUl2SigItfInputAtsysInt.i_eds_3_l2 "L2: IEds 3 bzgl. GET_ERS_EDSMV_INFO abgesichert" UWORD UMR_MA__1_10_0_S6_S3 1 100 0 1200 DISPLAY_IDENTIFIER i_eds_3_l2.iUl2SigItfInputAtsysInt ECU_ADDRESS 0xFFF8C592 /end MEASUREMENT
/begin MEASUREMENT iUl2SigItfInputAtsysInt.i_eds_4_l2 "L2: IEds 4 bzgl. GET_ERS_EDSMV_INFO abgesichert" UWORD UMR_MA__1_10_0_S6_S3 1 100 0 1200 DISPLAY_IDENTIFIER i_eds_4_l2.iUl2SigItfInputAtsysInt ECU_ADDRESS 0xFFF8C594 /end MEASUREMENT
/begin MEASUREMENT iUl2SigItfInputAtsysInt.i_eds_5_l2 "L2: IEds 5 bzgl. GET_ERS_EDSMV_INFO abgesichert" UWORD UMR_MA__1_10_0_S6_S3 1 100 0 1200 DISPLAY_IDENTIFIER i_eds_5_l2.iUl2SigItfInputAtsysInt ECU_ADDRESS 0xFFF8C596 /end MEASUREMENT
/begin MEASUREMENT iUl2SigItfInputAtsysInt.i_eds_6_l2 "L2: IEds 6 bzgl. GET_ERS_EDSMV_INFO abgesichert" UWORD UMR_MA__1_10_0_S6_S3 1 100 0 1200 DISPLAY_IDENTIFIER i_eds_6_l2.iUl2SigItfInputAtsysInt ECU_ADDRESS 0xFFF8C598 /end MEASUREMENT
/begin MEASUREMENT iUl2SigItfInputAtsysInt.i_eds_7_l2 "L2: IEds 7 bzgl. GET_ERS_EDSMV_INFO abgesichert" UWORD UMR_MA__1_10_0_S6_S3 1 100 0 1200 DISPLAY_IDENTIFIER i_eds_7_l2.iUl2SigItfInputAtsysInt ECU_ADDRESS 0xFFF8C59A /end MEASUREMENT
/begin MEASUREMENT iUl2SigItfInputAtsysInt.i_eds_8_l2 "L2: IEds 8 bzgl. GET_ERS_EDSMV_INFO abgesichert" UWORD UMR_MA__1_10_0_S6_S3 1 100 0 1200 DISPLAY_IDENTIFIER i_eds_8_l2.iUl2SigItfInputAtsysInt ECU_ADDRESS 0xFFF8C59C /end MEASUREMENT
/begin MEASUREMENT iUl2SigItfInputAtsysInt.i_eds_9_l2 "L2: IEds 9 bzgl. GET_ERS_EDSMV_INFO abgesichert" UWORD UMR_MA__1_10_0_S6_S3 1 100 0 1200 DISPLAY_IDENTIFIER i_eds_9_l2.iUl2SigItfInputAtsysInt ECU_ADDRESS 0xFFF8C59E /end MEASUREMENT
/begin MEASUREMENT iUl2SigItfInputAtsysInt.i_eds_10_l2 "L2: IEds 10 bzgl. GET_ERS_EDSMV_INFO abgesichert" UWORD UMR_MA__1_10_0_S6_S3 1 100 0 1200 DISPLAY_IDENTIFIER i_eds_10_l2.iUl2SigItfInputAtsysInt ECU_ADDRESS 0xFFF8C5A0 /end MEASUREMENT
/begin MEASUREMENT iUl2SigItfInputAtsysInt.i_eds_11_l2 "L2: IEds 11 bzgl. GET_ERS_EDSMV_INFO abgesichert" UWORD UMR_MA__1_10_0_S6_S3 1 100 0 1200 DISPLAY_IDENTIFIER i_eds_11_l2.iUl2SigItfInputAtsysInt ECU_ADDRESS 0xFFF8C5A2 /end MEASUREMENT
/begin MEASUREMENT iUl2SigItfInputAtsysKomp.i_eds_0_komp_l2 "L2: IEds 0 bzgl. GET_ERS_EDSMV_INFO abgesichert (Komplement)" UWORD UMR_MA__1_10_0_S6_S3 1 100 0 6553.5 DISPLAY_IDENTIFIER i_eds_0_komp_l2.iUl2SigItfInputAtsysKomp ECU_ADDRESS 0xFFF8C5A4 /end MEASUREMENT
/begin MEASUREMENT iUl2SigItfInputAtsysKomp.i_eds_1_komp_l2 "L2: IEds 1 bzgl. GET_ERS_EDSMV_INFO abgesichert (Komplement)" UWORD UMR_MA__1_10_0_S6_S3 1 100 0 6553.5 DISPLAY_IDENTIFIER i_eds_1_komp_l2.iUl2SigItfInputAtsysKomp ECU_ADDRESS 0xFFF8C5A6 /end MEASUREMENT
/begin MEASUREMENT iUl2SigItfInputAtsysKomp.i_eds_2_komp_l2 "L2: IEds 2 bzgl. GET_ERS_EDSMV_INFO abgesichert (Komplement)" UWORD UMR_MA__1_10_0_S6_S3 1 100 0 6553.5 DISPLAY_IDENTIFIER i_eds_2_komp_l2.iUl2SigItfInputAtsysKomp ECU_ADDRESS 0xFFF8C5A8 /end MEASUREMENT
/begin MEASUREMENT iUl2SigItfInputAtsysKomp.i_eds_3_komp_l2 "L2: IEds 3 bzgl. GET_ERS_EDSMV_INFO abgesichert (Komplement)" UWORD UMR_MA__1_10_0_S6_S3 1 100 0 6553.5 DISPLAY_IDENTIFIER i_eds_3_komp_l2.iUl2SigItfInputAtsysKomp ECU_ADDRESS 0xFFF8C5AA /end MEASUREMENT
/begin MEASUREMENT iUl2SigItfInputAtsysKomp.i_eds_4_komp_l2 "L2: IEds 4 bzgl. GET_ERS_EDSMV_INFO abgesichert (Komplement)" UWORD UMR_MA__1_10_0_S6_S3 1 100 0 6553.5 DISPLAY_IDENTIFIER i_eds_4_komp_l2.iUl2SigItfInputAtsysKomp ECU_ADDRESS 0xFFF8C5AC /end MEASUREMENT
/begin MEASUREMENT iUl2SigItfInputAtsysKomp.i_eds_5_komp_l2 "L2: IEds 5 bzgl. GET_ERS_EDSMV_INFO abgesichert (Komplement)" UWORD UMR_MA__1_10_0_S6_S3 1 100 0 6553.5 DISPLAY_IDENTIFIER i_eds_5_komp_l2.iUl2SigItfInputAtsysKomp ECU_ADDRESS 0xFFF8C5AE /end MEASUREMENT
/begin MEASUREMENT iUl2SigItfInputAtsysKomp.i_eds_6_komp_l2 "L2: IEds 6 bzgl. GET_ERS_EDSMV_INFO abgesichert (Komplement)" UWORD UMR_MA__1_10_0_S6_S3 1 100 0 6553.5 DISPLAY_IDENTIFIER i_eds_6_komp_l2.iUl2SigItfInputAtsysKomp ECU_ADDRESS 0xFFF8C5B0 /end MEASUREMENT
/begin MEASUREMENT iUl2SigItfInputAtsysKomp.i_eds_7_komp_l2 "L2: IEds 7 bzgl. GET_ERS_EDSMV_INFO abgesichert (Komplement)" UWORD UMR_MA__1_10_0_S6_S3 1 100 0 6553.5 DISPLAY_IDENTIFIER i_eds_7_komp_l2.iUl2SigItfInputAtsysKomp ECU_ADDRESS 0xFFF8C5B2 /end MEASUREMENT
/begin MEASUREMENT iUl2SigItfInputAtsysKomp.i_eds_8_komp_l2 "L2: IEds 8 bzgl. GET_ERS_EDSMV_INFO abgesichert (Komplement)" UWORD UMR_MA__1_10_0_S6_S3 1 100 0 6553.5 DISPLAY_IDENTIFIER i_eds_8_komp_l2.iUl2SigItfInputAtsysKomp ECU_ADDRESS 0xFFF8C5B4 /end MEASUREMENT
/begin MEASUREMENT iUl2SigItfInputAtsysKomp.i_eds_9_komp_l2 "L2: IEds 9 bzgl. GET_ERS_EDSMV_INFO abgesichert (Komplement)" UWORD UMR_MA__1_10_0_S6_S3 1 100 0 6553.5 DISPLAY_IDENTIFIER i_eds_9_komp_l2.iUl2SigItfInputAtsysKomp ECU_ADDRESS 0xFFF8C5B6 /end MEASUREMENT
/begin MEASUREMENT iUl2SigItfInputAtsysKomp.i_eds_10_komp_l2 "L2: IEds 10 bzgl. GET_ERS_EDSMV_INFO abgesichert (Komplement)" UWORD UMR_MA__1_10_0_S6_S3 1 100 0 6553.5 DISPLAY_IDENTIFIER i_eds_10_komp_l2.iUl2SigItfInputAtsysKomp ECU_ADDRESS 0xFFF8C5B8 /end MEASUREMENT
/begin MEASUREMENT iUl2SigItfInputAtsysKomp.i_eds_11_komp_l2 "L2: IEds 11 bzgl. GET_ERS_EDSMV_INFO abgesichert (Komplement)" UWORD UMR_MA__1_10_0_S6_S3 1 100 0 6553.5 DISPLAY_IDENTIFIER i_eds_11_komp_l2.iUl2SigItfInputAtsysKomp ECU_ADDRESS 0xFFF8C5BA /end MEASUREMENT
/begin MEASUREMENT iUewPosVTimerZuendung.cUewTimerZuendung._.iTimerVerzNmotMax.timer "Der aktuelle Timerwert" ULONG UMR_MSEC__10_1_0_S6_S3 1 100 0 42949672950 DISPLAY_IDENTIFIER iTimerVerzNmotMax._.cUewTimerZuendung.iUewPosVTimerZuendung ECU_ADDRESS 0xFFF8F1C4 /end MEASUREMENT
/begin MEASUREMENT iUewPosVTimerZuendung.cUewTimerZuendung._.zz_zustand "Zustand der timer_zuendung Initialisierung" UBYTE Conv.cUewTimerZuendung._.zz_zustand_S6_S3 1 100 0 5 DISPLAY_IDENTIFIER zz_zustand._.cUewTimerZuendung.iUewPosVTimerZuendung ECU_ADDRESS 0xFFF8F1C8 /end MEASUREMENT
/begin MEASUREMENT iUewPosVTimerZuendung.cUewTimerZuendung._.timer "Zeit die seid dem letzten Zuendungswechsel auf AUS verstrichen ist" ULONG UMR_MSEC__10_1_0_S6_S3 1 100 0 42949672950 DISPLAY_IDENTIFIER timer._.cUewTimerZuendung.iUewPosVTimerZuendung ECU_ADDRESS 0xFFF8F1CC /end MEASUREMENT
/begin MEASUREMENT iUewPosVTimerZuendung.cUewTimerZuendung._.f_keine_egs_offtime "Die EGS-OFFTIME soll nicht mehr zu dem Zündungstimer addiert werden. Wird erst mit dem Einschlafen der EGS wieder auf FALSE gesetzt" UBYTE Conv.cUewTimerZuendung._.f_keine_egs_offtime_S6_S3 1 100 0 1 BIT_MASK 0x1 DISPLAY_IDENTIFIER f_keine_egs_offtime._.cUewTimerZuendung.iUewPosVTimerZuendung ECU_ADDRESS 0xFFF8F1D0 /end MEASUREMENT
/begin MEASUREMENT iUewPosVTimerZuendung.cUewTimerZuendung._.f_reset "Aufgrund einer gestarteten PosV muss der Timer wieder zurück gesetz werden. Falls das EEPROM gesperrt ist bleibt das Flag so lange auf TRUE bis es wieder frei gegeben wurde und der timer auf 0 gesetzt ist." UBYTE Conv.cUewTimerZuendung._.f_reset_S6_S3 1 100 0 1 BIT_MASK 0x1 DISPLAY_IDENTIFIER f_reset._.cUewTimerZuendung.iUewPosVTimerZuendung ECU_ADDRESS 0xFFF8F1D1 /end MEASUREMENT
/begin MEASUREMENT iUewSgetf.i_edsc_min "FLAG: I_EDS Kupplung C wegen POSV Ueberwachung min bestromen" UBYTE Conv.cUewSgetf._.i_edsc_min_S6_S3 1 100 0 1 BIT_MASK 0x1 DISPLAY_IDENTIFIER i_edsc_min.iUewSgetf ECU_ADDRESS 0xFFF8A1CC /end MEASUREMENT
/begin MEASUREMENT iUewSgetf.ps_sensor_signal_alt "ps_sensor_signal des letzen Zustand" UBYTE Conv.cUewSgetf._.ps_sensor_signal_alt_S6_S3 1 100 0 3 DISPLAY_IDENTIFIER ps_sensor_signal_alt.iUewSgetf ECU_ADDRESS 0xFFF8A1CD /end MEASUREMENT
/begin MEASUREMENT iUewSgetf.ps_sensor_err "FLAG: Fehler durch Wechsel von PS_SENSOR_Z auf PS_SENSOR_ERR" UBYTE Conv.cUewSgetf._.ps_sensor_err_S6_S3 1 100 0 1 BIT_MASK 0x1 DISPLAY_IDENTIFIER ps_sensor_err.iUewSgetf ECU_ADDRESS 0xFFF8A1CE /end MEASUREMENT
/begin MEASUREMENT iUewSgetf.zwangsposition_p "FLAG: Zwangsvorgabe Position P wegen MV12 Uew." UBYTE Conv.cUewSgetf._.zwangsposition_p_S6_S3 1 100 0 1 BIT_MASK 0x1 DISPLAY_IDENTIFIER zwangsposition_p.iUewSgetf ECU_ADDRESS 0xFFF8A1CF /end MEASUREMENT
/begin MEASUREMENT iUewSgetf.posv_diagnose_aktiv "Indikator POSV-Ueberwachung ist im Moment aktiv" UBYTE Conv.cUewSgetf._.posv_diagnose_aktiv_S6_S3 1 100 0 1 BIT_MASK 0x1 DISPLAY_IDENTIFIER posv_diagnose_aktiv.iUewSgetf ECU_ADDRESS 0xFFF8A1D0 /end MEASUREMENT
/begin MEASUREMENT iUewSgetf.timer_verzposvueb "Timer Verzoegerungszeit POSV Ueberwachung nach Neustart" UWORD UMR_MSEC__10_1_0_S6_S3 1 100 0 655350 DISPLAY_IDENTIFIER timer_verzposvueb.iUewSgetf ECU_ADDRESS 0xFFF8A1D2 /end MEASUREMENT
/begin MEASUREMENT iUewSgetf.timer_posvmechdef "Timer POSV Ueberwachung" UWORD UMR_MSEC__10_1_0_S6_S3 1 100 0 655350 DISPLAY_IDENTIFIER timer_posvmechdef.iUewSgetf ECU_ADDRESS 0xFFF8A1D4 /end MEASUREMENT
/begin MEASUREMENT iUewSgetf.n_stoer_posv "Stoerungszaehler POSV-Ueberwachung" UBYTE UMR___1_1_0_S6_S3 1 100 0 255 DISPLAY_IDENTIFIER n_stoer_posv.iUewSgetf ECU_ADDRESS 0xFFF8A1D6 /end MEASUREMENT
/begin MEASUREMENT iUewSgetf.pruefung_posvmechdef_aktiv "Indikator POSV-Ueberwachung laeuft" UBYTE Conv.cUewSgetf._.pruefung_posvmechdef_aktiv_S6_S3 1 100 0 1 BIT_MASK 0x1 DISPLAY_IDENTIFIER pruefung_posvmechdef_aktiv.iUewSgetf ECU_ADDRESS 0xFFF8A1D7 /end MEASUREMENT
/begin MEASUREMENT iUewSgetf.pumpendruck_vorh_posv_uew_alt "pumpendruck_vorh_posv_uew_alt" UBYTE Conv.cUewSgetf._.pumpendruck_vorh_posv_uew_alt_S6_S3 1 100 0 1 BIT_MASK 0x1 DISPLAY_IDENTIFIER pumpendruck_vorh_posv_uew_alt.iUewSgetf ECU_ADDRESS 0xFFF8A1D8 /end MEASUREMENT
/begin MEASUREMENT iUewSgetf.fl_neutral_posvueb "Das Flag gibt an ob die Neutralebene die Minimalbedruckung ansteuern soll" UBYTE Conv.cUewSgetf._.fl_neutral_posvueb_S6_S3 1 100 0 1 BIT_MASK 0x1 DISPLAY_IDENTIFIER fl_neutral_posvueb.iUewSgetf ECU_ADDRESS 0xFFF8A1D9 /end MEASUREMENT
/begin MEASUREMENT iUl2KupplPosNPlAInt.cUl2KupplPosNPlInt._.n_stoerposneds "Stoerzaehler fuer falsch bestromte Kupplung waehrend GA." UBYTE UMR___1_1_0_S6_S3 1 100 0 255 DISPLAY_IDENTIFIER n_stoerposneds._.cUl2KupplPosNPlInt.iUl2KupplPosNPlAInt ECU_ADDRESS 0xFFF8F210 /end MEASUREMENT
/begin MEASUREMENT iUl2KupplPosNPlAFl.cUl2KupplPosNPlFl._.n_stoerposneds "Stoerzaehler fuer falsch bestromte Kupplung waehrend GA." FLOAT32_IEEE UMR___1_1_0_S6_S3 1 100 0 255 FORMAT "%4.2" DISPLAY_IDENTIFIER n_stoerposneds._.cUl2KupplPosNPlFl.iUl2KupplPosNPlAFl ECU_ADDRESS 0xFFF8F220 /end MEASUREMENT
/begin MEASUREMENT iUl2KupplPosNPlBInt.cUl2KupplPosNPlInt._.n_stoerposneds "Stoerzaehler fuer falsch bestromte Kupplung waehrend GA." UBYTE UMR___1_1_0_S6_S3 1 100 0 255 DISPLAY_IDENTIFIER n_stoerposneds._.cUl2KupplPosNPlInt.iUl2KupplPosNPlBInt ECU_ADDRESS 0xFFF8F230 /end MEASUREMENT
/begin MEASUREMENT iUl2KupplPosNPlBFl.cUl2KupplPosNPlFl._.n_stoerposneds "Stoerzaehler fuer falsch bestromte Kupplung waehrend GA." FLOAT32_IEEE UMR___1_1_0_S6_S3 1 100 0 255 FORMAT "%4.2" DISPLAY_IDENTIFIER n_stoerposneds._.cUl2KupplPosNPlFl.iUl2KupplPosNPlBFl ECU_ADDRESS 0xFFF8F240 /end MEASUREMENT
/begin MEASUREMENT iUl2KupplPosNPlCInt.cUl2KupplPosNPlInt._.n_stoerposneds "Stoerzaehler fuer falsch bestromte Kupplung waehrend GA." UBYTE UMR___1_1_0_S6_S3 1 100 0 255 DISPLAY_IDENTIFIER n_stoerposneds._.cUl2KupplPosNPlInt.iUl2KupplPosNPlCInt ECU_ADDRESS 0xFFF8F250 /end MEASUREMENT
/begin MEASUREMENT iUl2KupplPosNPlCFl.cUl2KupplPosNPlFl._.n_stoerposneds "Stoerzaehler fuer falsch bestromte Kupplung waehrend GA." FLOAT32_IEEE UMR___1_1_0_S6_S3 1 100 0 255 FORMAT "%4.2" DISPLAY_IDENTIFIER n_stoerposneds._.cUl2KupplPosNPlFl.iUl2KupplPosNPlCFl ECU_ADDRESS 0xFFF8F260 /end MEASUREMENT
/begin MEASUREMENT iUl2KupplPosNPlDInt.cUl2KupplPosNPlInt._.n_stoerposneds "Stoerzaehler fuer falsch bestromte Kupplung waehrend GA." UBYTE UMR___1_1_0_S6_S3 1 100 0 255 DISPLAY_IDENTIFIER n_stoerposneds._.cUl2KupplPosNPlInt.iUl2KupplPosNPlDInt ECU_ADDRESS 0xFFF8F270 /end MEASUREMENT
/begin MEASUREMENT iUl2KupplPosNPlDFl.cUl2KupplPosNPlFl._.n_stoerposneds "Stoerzaehler fuer falsch bestromte Kupplung waehrend GA." FLOAT32_IEEE UMR___1_1_0_S6_S3 1 100 0 255 FORMAT "%4.2" DISPLAY_IDENTIFIER n_stoerposneds._.cUl2KupplPosNPlFl.iUl2KupplPosNPlDFl ECU_ADDRESS 0xFFF8F280 /end MEASUREMENT
/begin MEASUREMENT iUl2KupplPosNPlEInt.cUl2KupplPosNPlInt._.n_stoerposneds "Stoerzaehler fuer falsch bestromte Kupplung waehrend GA." UBYTE UMR___1_1_0_S6_S3 1 100 0 255 DISPLAY_IDENTIFIER n_stoerposneds._.cUl2KupplPosNPlInt.iUl2KupplPosNPlEInt ECU_ADDRESS 0xFFF8F290 /end MEASUREMENT
/begin MEASUREMENT iUl2KupplPosNPlEFl.cUl2KupplPosNPlFl._.n_stoerposneds "Stoerzaehler fuer falsch bestromte Kupplung waehrend GA." FLOAT32_IEEE UMR___1_1_0_S6_S3 1 100 0 255 FORMAT "%4.2" DISPLAY_IDENTIFIER n_stoerposneds._.cUl2KupplPosNPlFl.iUl2KupplPosNPlEFl ECU_ADDRESS 0xFFF8F2A0 /end MEASUREMENT
/begin MEASUREMENT iUl2KupDruckAnstKAInt.cUl2BasisKupDruckAnstInt._.kup_nr "Kupplungsnummer" UBYTE Conv.cUl2BasisKupDruckAnstInt._.kup_nr_S6_S3 1 100 1 5 DISPLAY_IDENTIFIER kup_nr._.cUl2BasisKupDruckAnstInt.iUl2KupDruckAnstKAInt ECU_ADDRESS 0xFFF8E79C /end MEASUREMENT
/begin MEASUREMENT iUl2KupDruckAnstKAInt.cUl2BasisKupDruckAnstInt._.zustand_soll "Sollzustand der Kupplung" UBYTE Conv.cUl2BasisKupDruckAnstInt._.zustand_soll_S6_S3 1 100 0 2 DISPLAY_IDENTIFIER zustand_soll._.cUl2BasisKupDruckAnstInt.iUl2KupDruckAnstKAInt ECU_ADDRESS 0xFFF8E79D /end MEASUREMENT
/begin MEASUREMENT iUl2KupDruckAnstKAInt.zustand_ist "Istzustand der Kupplung" UBYTE Conv.cUl2KupDruckAnstInt._.zustand_ist_S6_S3 1 100 0 2 DISPLAY_IDENTIFIER zustand_ist.iUl2KupDruckAnstKAInt ECU_ADDRESS 0xFFF8E7A4 /end MEASUREMENT
/begin MEASUREMENT iUl2KupDruckAnstKBInt.cUl2BasisKupDruckAnstInt._.kup_nr "Kupplungsnummer" UBYTE Conv.cUl2BasisKupDruckAnstInt._.kup_nr_S6_S3 1 100 1 5 DISPLAY_IDENTIFIER kup_nr._.cUl2BasisKupDruckAnstInt.iUl2KupDruckAnstKBInt ECU_ADDRESS 0xFFF8E7AC /end MEASUREMENT
/begin MEASUREMENT iUl2KupDruckAnstKBInt.cUl2BasisKupDruckAnstInt._.zustand_soll "Sollzustand der Kupplung" UBYTE Conv.cUl2BasisKupDruckAnstInt._.zustand_soll_S6_S3 1 100 0 2 DISPLAY_IDENTIFIER zustand_soll._.cUl2BasisKupDruckAnstInt.iUl2KupDruckAnstKBInt ECU_ADDRESS 0xFFF8E7AD /end MEASUREMENT
/begin MEASUREMENT iUl2KupDruckAnstKBInt.zustand_ist "Istzustand der Kupplung" UBYTE Conv.cUl2KupIaeDruckAnstInt._.zustand_ist_S6_S3 1 100 0 2 DISPLAY_IDENTIFIER zustand_ist.iUl2KupDruckAnstKBInt ECU_ADDRESS 0xFFF8E7B4 /end MEASUREMENT
/begin MEASUREMENT iUl2KupDruckAnstKCInt.cUl2BasisKupDruckAnstInt._.kup_nr "Kupplungsnummer" UBYTE Conv.cUl2BasisKupDruckAnstInt._.kup_nr_S6_S3 1 100 1 5 DISPLAY_IDENTIFIER kup_nr._.cUl2BasisKupDruckAnstInt.iUl2KupDruckAnstKCInt ECU_ADDRESS 0xFFF8E7BC /end MEASUREMENT
/begin MEASUREMENT iUl2KupDruckAnstKCInt.cUl2BasisKupDruckAnstInt._.zustand_soll "Sollzustand der Kupplung" UBYTE Conv.cUl2BasisKupDruckAnstInt._.zustand_soll_S6_S3 1 100 0 2 DISPLAY_IDENTIFIER zustand_soll._.cUl2BasisKupDruckAnstInt.iUl2KupDruckAnstKCInt ECU_ADDRESS 0xFFF8E7BD /end MEASUREMENT
/begin MEASUREMENT iUl2KupDruckAnstKCInt.zustand_ist "Istzustand der Kupplung" UBYTE Conv.cUl2KupDruckAnstInt._.zustand_ist_S6_S3 1 100 0 2 DISPLAY_IDENTIFIER zustand_ist.iUl2KupDruckAnstKCInt ECU_ADDRESS 0xFFF8E7C4 /end MEASUREMENT
/begin MEASUREMENT iUl2KupDruckAnstKDInt.cUl2BasisKupDruckAnstInt._.kup_nr "Kupplungsnummer" UBYTE Conv.cUl2BasisKupDruckAnstInt._.kup_nr_S6_S3 1 100 1 5 DISPLAY_IDENTIFIER kup_nr._.cUl2BasisKupDruckAnstInt.iUl2KupDruckAnstKDInt ECU_ADDRESS 0xFFF8E7CC /end MEASUREMENT
/begin MEASUREMENT iUl2KupDruckAnstKDInt.cUl2BasisKupDruckAnstInt._.zustand_soll "Sollzustand der Kupplung" UBYTE Conv.cUl2BasisKupDruckAnstInt._.zustand_soll_S6_S3 1 100 0 2 DISPLAY_IDENTIFIER zustand_soll._.cUl2BasisKupDruckAnstInt.iUl2KupDruckAnstKDInt ECU_ADDRESS 0xFFF8E7CD /end MEASUREMENT
/begin MEASUREMENT iUl2KupDruckAnstKDInt.zustand_ist "Istzustand der Kupplung" UBYTE Conv.cUl2KupDruckAnstInt._.zustand_ist_S6_S3 1 100 0 2 DISPLAY_IDENTIFIER zustand_ist.iUl2KupDruckAnstKDInt ECU_ADDRESS 0xFFF8E7D4 /end MEASUREMENT
/begin MEASUREMENT iUl2KupDruckAnstKEInt.cUl2BasisKupDruckAnstInt._.kup_nr "Kupplungsnummer" UBYTE Conv.cUl2BasisKupDruckAnstInt._.kup_nr_S6_S3 1 100 1 5 DISPLAY_IDENTIFIER kup_nr._.cUl2BasisKupDruckAnstInt.iUl2KupDruckAnstKEInt ECU_ADDRESS 0xFFF8E7DC /end MEASUREMENT
/begin MEASUREMENT iUl2KupDruckAnstKEInt.cUl2BasisKupDruckAnstInt._.zustand_soll "Sollzustand der Kupplung" UBYTE Conv.cUl2BasisKupDruckAnstInt._.zustand_soll_S6_S3 1 100 0 2 DISPLAY_IDENTIFIER zustand_soll._.cUl2BasisKupDruckAnstInt.iUl2KupDruckAnstKEInt ECU_ADDRESS 0xFFF8E7DD /end MEASUREMENT
/begin MEASUREMENT iUl2KupDruckAnstKEInt.zustand_ist "Istzustand der Kupplung" UBYTE Conv.cUl2KupDruckAnstInt._.zustand_ist_S6_S3 1 100 0 2 DISPLAY_IDENTIFIER zustand_ist.iUl2KupDruckAnstKEInt ECU_ADDRESS 0xFFF8E7E4 /end MEASUREMENT
/begin MEASUREMENT iUl2KupDruckAnstKAFl.cUl2BasisKupDruckAnstFl._.kup_nr "Kupplungsnummer" FLOAT32_IEEE UMR___1_1_0_S6_S3 1 100 1 5 FORMAT "%4.2" DISPLAY_IDENTIFIER kup_nr._.cUl2BasisKupDruckAnstFl.iUl2KupDruckAnstKAFl ECU_ADDRESS 0xFFF8E7EC /end MEASUREMENT
/begin MEASUREMENT iUl2KupDruckAnstKAFl.cUl2BasisKupDruckAnstFl._.zustand_soll "Sollzustand der Kupplung" FLOAT32_IEEE UMR___1_1_0_S6_S3 1 100 0 2 FORMAT "%4.2" DISPLAY_IDENTIFIER zustand_soll._.cUl2BasisKupDruckAnstFl.iUl2KupDruckAnstKAFl ECU_ADDRESS 0xFFF8E7F0 /end MEASUREMENT
/begin MEASUREMENT iUl2KupDruckAnstKAFl.zustand_ist "Istzustand der Kupplung" FLOAT32_IEEE UMR___1_1_0_S6_S3 1 100 0 2 FORMAT "%4.2" DISPLAY_IDENTIFIER zustand_ist.iUl2KupDruckAnstKAFl ECU_ADDRESS 0xFFF8E7F8 /end MEASUREMENT
/begin MEASUREMENT iUl2KupDruckAnstKBFl.cUl2BasisKupDruckAnstFl._.kup_nr "Kupplungsnummer" FLOAT32_IEEE UMR___1_1_0_S6_S3 1 100 1 5 FORMAT "%4.2" DISPLAY_IDENTIFIER kup_nr._.cUl2BasisKupDruckAnstFl.iUl2KupDruckAnstKBFl ECU_ADDRESS 0xFFF8E800 /end MEASUREMENT
/begin MEASUREMENT iUl2KupDruckAnstKBFl.cUl2BasisKupDruckAnstFl._.zustand_soll "Sollzustand der Kupplung" FLOAT32_IEEE UMR___1_1_0_S6_S3 1 100 0 2 FORMAT "%4.2" DISPLAY_IDENTIFIER zustand_soll._.cUl2BasisKupDruckAnstFl.iUl2KupDruckAnstKBFl ECU_ADDRESS 0xFFF8E804 /end MEASUREMENT
/begin MEASUREMENT iUl2KupDruckAnstKBFl.zustand_ist "Istzustand der Kupplung" FLOAT32_IEEE UMR___1_1_0_S6_S3 1 100 0 2 FORMAT "%4.2" DISPLAY_IDENTIFIER zustand_ist.iUl2KupDruckAnstKBFl ECU_ADDRESS 0xFFF8E80C /end MEASUREMENT
/begin MEASUREMENT iUl2KupDruckAnstKCFl.cUl2BasisKupDruckAnstFl._.kup_nr "Kupplungsnummer" FLOAT32_IEEE UMR___1_1_0_S6_S3 1 100 1 5 FORMAT "%4.2" DISPLAY_IDENTIFIER kup_nr._.cUl2BasisKupDruckAnstFl.iUl2KupDruckAnstKCFl ECU_ADDRESS 0xFFF8E814 /end MEASUREMENT
/begin MEASUREMENT iUl2KupDruckAnstKCFl.cUl2BasisKupDruckAnstFl._.zustand_soll "Sollzustand der Kupplung" FLOAT32_IEEE UMR___1_1_0_S6_S3 1 100 0 2 FORMAT "%4.2" DISPLAY_IDENTIFIER zustand_soll._.cUl2BasisKupDruckAnstFl.iUl2KupDruckAnstKCFl ECU_ADDRESS 0xFFF8E818 /end MEASUREMENT
/begin MEASUREMENT iUl2KupDruckAnstKCFl.zustand_ist "Istzustand der Kupplung" FLOAT32_IEEE UMR___1_1_0_S6_S3 1 100 0 2 FORMAT "%4.2" DISPLAY_IDENTIFIER zustand_ist.iUl2KupDruckAnstKCFl ECU_ADDRESS 0xFFF8E820 /end MEASUREMENT
/begin MEASUREMENT iUl2KupDruckAnstKDFl.cUl2BasisKupDruckAnstFl._.kup_nr "Kupplungsnummer" FLOAT32_IEEE UMR___1_1_0_S6_S3 1 100 1 5 FORMAT "%4.2" DISPLAY_IDENTIFIER kup_nr._.cUl2BasisKupDruckAnstFl.iUl2KupDruckAnstKDFl ECU_ADDRESS 0xFFF8E828 /end MEASUREMENT
/begin MEASUREMENT iUl2KupDruckAnstKDFl.cUl2BasisKupDruckAnstFl._.zustand_soll "Sollzustand der Kupplung" FLOAT32_IEEE UMR___1_1_0_S6_S3 1 100 0 2 FORMAT "%4.2" DISPLAY_IDENTIFIER zustand_soll._.cUl2BasisKupDruckAnstFl.iUl2KupDruckAnstKDFl ECU_ADDRESS 0xFFF8E82C /end MEASUREMENT
/begin MEASUREMENT iUl2KupDruckAnstKDFl.zustand_ist "Istzustand der Kupplung" FLOAT32_IEEE UMR___1_1_0_S6_S3 1 100 0 2 FORMAT "%4.2" DISPLAY_IDENTIFIER zustand_ist.iUl2KupDruckAnstKDFl ECU_ADDRESS 0xFFF8E834 /end MEASUREMENT
/begin MEASUREMENT iUl2KupDruckAnstKEFl.cUl2BasisKupDruckAnstFl._.kup_nr "Kupplungsnummer" FLOAT32_IEEE UMR___1_1_0_S6_S3 1 100 1 5 FORMAT "%4.2" DISPLAY_IDENTIFIER kup_nr._.cUl2BasisKupDruckAnstFl.iUl2KupDruckAnstKEFl ECU_ADDRESS 0xFFF8E83C /end MEASUREMENT
/begin MEASUREMENT iUl2KupDruckAnstKEFl.cUl2BasisKupDruckAnstFl._.zustand_soll "Sollzustand der Kupplung" FLOAT32_IEEE UMR___1_1_0_S6_S3 1 100 0 2 FORMAT "%4.2" DISPLAY_IDENTIFIER zustand_soll._.cUl2BasisKupDruckAnstFl.iUl2KupDruckAnstKEFl ECU_ADDRESS 0xFFF8E840 /end MEASUREMENT
/begin MEASUREMENT iUl2KupDruckAnstKEFl.zustand_ist "Istzustand der Kupplung" FLOAT32_IEEE UMR___1_1_0_S6_S3 1 100 0 2 FORMAT "%4.2" DISPLAY_IDENTIFIER zustand_ist.iUl2KupDruckAnstKEFl ECU_ADDRESS 0xFFF8E848 /end MEASUREMENT
/begin MEASUREMENT zff_atsys._.iSignale._.obj.sig_serapflag "Das Serapflag" UBYTE Conv.zff_atsys._.cSignale._.sig_serapflag_S6_S3 1 100 0 1 BIT_MASK 0x1 DISPLAY_IDENTIFIER sig_serapflag.obj._.iSignale._.zff_atsys ECU_ADDRESS 0xFFF8C2A4 /end MEASUREMENT
/begin MEASUREMENT zff_atsys._.iSignale._.obj.sig_serapflag_komp "Das Serapflag" UBYTE Conv.zff_atsys._.cSignale._.sig_serapflag_komp_S6_S3 1 100 254 255 DISPLAY_IDENTIFIER sig_serapflag_komp.obj._.iSignale._.zff_atsys ECU_ADDRESS 0xFFF8C2A5 /end MEASUREMENT
/begin MEASUREMENT zff_atsys._.iSignale._.obj.sig_e_fahren "Umschaltung Verbrennungs/E-Fahren Datensätze" UBYTE Conv.zff_atsys._.cSignale._.sig_e_fahren_S6_S3 1 100 0 1 DISPLAY_IDENTIFIER sig_e_fahren.obj._.iSignale._.zff_atsys ECU_ADDRESS 0xFFF8C2A6 /end MEASUREMENT
/begin MEASUREMENT zff_atsys._.iSignale._.obj.sig_n_ab "Die Abtriebsdrehzahl" UWORD UMR_U_MIN_1_1_0_S6_S3 1 100 0 8160 DISPLAY_IDENTIFIER sig_n_ab.obj._.iSignale._.zff_atsys ECU_ADDRESS 0xFFF8C2A8 /end MEASUREMENT
/begin MEASUREMENT zff_atsys._.iSignale._.obj.sig_n_ab8 "Die Abtriebsdrehzahl (8Bit)" UBYTE UMR_U_MIN_32_1_0_S6_S3 1 100 0 8160 DISPLAY_IDENTIFIER sig_n_ab8.obj._.iSignale._.zff_atsys ECU_ADDRESS 0xFFF8C2AA /end MEASUREMENT
/begin MEASUREMENT zff_atsys._.iSignale._.obj.sig_n_t "Die Turbinendrehzahl" UWORD UMR_U_MIN_1_1_0_S6_S3 1 100 0 8160 DISPLAY_IDENTIFIER sig_n_t.obj._.iSignale._.zff_atsys ECU_ADDRESS 0xFFF8C2AC /end MEASUREMENT
/begin MEASUREMENT zff_atsys._.iSignale._.obj.sig_n_t8 "Die Turbinendrehzahl (8Bit)" UBYTE UMR_U_MIN_32_1_0_S6_S3 1 100 0 8160 DISPLAY_IDENTIFIER sig_n_t8.obj._.iSignale._.zff_atsys ECU_ADDRESS 0xFFF8C2AE /end MEASUREMENT
/begin MEASUREMENT zff_atsys._.iSignale._.obj.sig_n_mot "Die Motordrehzahl" UWORD UMR_U_MIN_1_1_0_S6_S3 1 100 0 8160 DISPLAY_IDENTIFIER sig_n_mot.obj._.iSignale._.zff_atsys ECU_ADDRESS 0xFFF8C2B0 /end MEASUREMENT
/begin MEASUREMENT zff_atsys._.iSignale._.obj.sig_n_mot8 "Die Motordrehzahl (8Bit)" UBYTE UMR_U_MIN_32_1_0_S6_S3 1 100 0 8160 DISPLAY_IDENTIFIER sig_n_mot8.obj._.iSignale._.zff_atsys ECU_ADDRESS 0xFFF8C2B2 /end MEASUREMENT
/begin MEASUREMENT zff_atsys._.iSignale._.obj.sig_c_getr "Die Getriebetemperatur" UBYTE UMR_GRADC__1_1_M40_S6_S3 1 100 -40 215 DISPLAY_IDENTIFIER sig_c_getr.obj._.iSignale._.zff_atsys ECU_ADDRESS 0xFFF8C2B3 /end MEASUREMENT
/begin MEASUREMENT zff_atsys._.iSignale._.obj.sig_c_getr_fl32 "Die Getriebetemperatur (Float)" FLOAT32_IEEE UMR_GRADC__1_1_0_S6_S3 1 100 -40 215 DISPLAY_IDENTIFIER sig_c_getr_fl32.obj._.iSignale._.zff_atsys ECU_ADDRESS 0xFFF8C2B4 /end MEASUREMENT
/begin MEASUREMENT zff_atsys._.iSignale._.obj.sig_c_mot "Die Motortemperatur" UBYTE UMR_GRADC__1_1_M48_S6_S3 1 100 -48 207 DISPLAY_IDENTIFIER sig_c_mot.obj._.iSignale._.zff_atsys ECU_ADDRESS 0xFFF8C2B8 /end MEASUREMENT
/begin MEASUREMENT zff_atsys._.iSignale._.obj.sig_m_t "Das Motormoment" SWORD UMR_NM__1_1_0_S6_S3 1 100 -400 1640 DISPLAY_IDENTIFIER sig_m_t.obj._.iSignale._.zff_atsys ECU_ADDRESS 0xFFF8C2BA /end MEASUREMENT
/begin MEASUREMENT zff_atsys._.iSignale._.obj.sig_m_t8 "Das Motormoment" UBYTE UMR_NM__8_1_M50_S6_S3 1 100 -400 1640 DISPLAY_IDENTIFIER sig_m_t8.obj._.iSignale._.zff_atsys ECU_ADDRESS 0xFFF8C2BC /end MEASUREMENT
/begin MEASUREMENT zff_atsys._.iSignale._.obj.sig_dki_mmotsoll "dki oder mmotsoll_mod je nach SWI_UMSCHALTDKI" SWORD UMR___1_1_0_S6_S3 1 100 -400 1640 DISPLAY_IDENTIFIER sig_dki_mmotsoll.obj._.iSignale._.zff_atsys ECU_ADDRESS 0xFFF8C2BE /end MEASUREMENT
/begin MEASUREMENT zff_atsys._.iSignale._.obj.sig_dki_mmotsoll_fl32 "dki oder mmotsoll_mod je nach SWI_UMSCHALTDKI" FLOAT32_IEEE UMR___1_1_0_S6_S3 1 100 -400 1640 FORMAT "%4.2" DISPLAY_IDENTIFIER sig_dki_mmotsoll_fl32.obj._.iSignale._.zff_atsys ECU_ADDRESS 0xFFF8C2C0 /end MEASUREMENT
/begin MEASUREMENT zff_atsys._.iSignale._.obj.sig_dki "Die Drosselklappenstellung" UBYTE UMR_PROZENT__20_51_0_S6_S3 1 100 0 100 DISPLAY_IDENTIFIER sig_dki.obj._.iSignale._.zff_atsys ECU_ADDRESS 0xFFF8C2C4 /end MEASUREMENT
/begin MEASUREMENT zff_atsys._.iSignale._.obj.sig_dki_fl32 "Die Drosselklappenstellung (Float)" FLOAT32_IEEE UMR_PROZENT__1_1_0_S6_S3 1 100 0 100 DISPLAY_IDENTIFIER sig_dki_fl32.obj._.iSignale._.zff_atsys ECU_ADDRESS 0xFFF8C2C8 /end MEASUREMENT
/begin MEASUREMENT zff_atsys._.iSignale._.obj.sig_index_sp_sps "Der Spontanitätsindex" UBYTE UMR___1_1_0_S6_S3 1 100 0 99 DISPLAY_IDENTIFIER sig_index_sp_sps.obj._.iSignale._.zff_atsys ECU_ADDRESS 0xFFF8C2CC /end MEASUREMENT
/begin MEASUREMENT zff_atsys._.iSignale._.obj.sig_istgang "Der Istgang" SBYTE Conv.zff_atsys._.cSignale._.sig_istgang_S6_S3 1 100 -1 8 DISPLAY_IDENTIFIER sig_istgang.obj._.iSignale._.zff_atsys ECU_ADDRESS 0xFFF8C2CD /end MEASUREMENT
/begin MEASUREMENT zff_atsys._.iSignale._.obj.sig_istgang_idx "Der Istgang als Index für Tabellen (mit offset)" UBYTE Conv.zff_atsys._.cSignale._.sig_istgang_idx_S6_S3 1 100 0 9 DISPLAY_IDENTIFIER sig_istgang_idx.obj._.iSignale._.zff_atsys ECU_ADDRESS 0xFFF8C2CE /end MEASUREMENT
/begin MEASUREMENT zff_atsys._.iSignale._.obj.sig_istgang_vorw "Der Istagang (nur positive Werte ansonsten 0)" UBYTE Conv.zff_atsys._.cSignale._.sig_istgang_vorw_S6_S3 1 100 0 8 DISPLAY_IDENTIFIER sig_istgang_vorw.obj._.iSignale._.zff_atsys ECU_ADDRESS 0xFFF8C2CF /end MEASUREMENT
/begin MEASUREMENT zff_atsys._.iSignale._.obj.sig_zielgang "Der Zielgang" SBYTE Conv.zff_atsys._.cSignale._.sig_zielgang_S6_S3 1 100 -1 8 DISPLAY_IDENTIFIER sig_zielgang.obj._.iSignale._.zff_atsys ECU_ADDRESS 0xFFF8C2D0 /end MEASUREMENT
/begin MEASUREMENT zff_atsys._.iSignale._.obj.sig_zielgang_idx "Der Zielgang als Index für Tabellen (mit offset)" UBYTE Conv.zff_atsys._.cSignale._.sig_zielgang_idx_S6_S3 1 100 0 9 DISPLAY_IDENTIFIER sig_zielgang_idx.obj._.iSignale._.zff_atsys ECU_ADDRESS 0xFFF8C2D1 /end MEASUREMENT
/begin MEASUREMENT zff_atsys._.iSignale._.obj.sig_zielgang_vorw "Der Istagang (nur positive Werte ansonsten 0)" UBYTE Conv.zff_atsys._.cSignale._.sig_zielgang_vorw_S6_S3 1 100 0 8 DISPLAY_IDENTIFIER sig_zielgang_vorw.obj._.iSignale._.zff_atsys ECU_ADDRESS 0xFFF8C2D2 /end MEASUREMENT
/begin MEASUREMENT zff_atsys._.iSignale._.obj.sig_zielgang_sas "Der Zielgang_sas" SBYTE Conv.zff_atsys._.cSignale._.sig_zielgang_sas_S6_S3 1 100 -1 8 DISPLAY_IDENTIFIER sig_zielgang_sas.obj._.iSignale._.zff_atsys ECU_ADDRESS 0xFFF8C2D3 /end MEASUREMENT
/begin MEASUREMENT zff_atsys._.iSignale._.obj.sig_zielgang_sas_idx "Der Zielgang_sas als Index für Tabellen (mit offset)" UBYTE Conv.zff_atsys._.cSignale._.sig_zielgang_sas_idx_S6_S3 1 100 0 9 DISPLAY_IDENTIFIER sig_zielgang_sas_idx.obj._.iSignale._.zff_atsys ECU_ADDRESS 0xFFF8C2D4 /end MEASUREMENT
/begin MEASUREMENT zff_atsys._.iSignale._.obj.sig_zielgang_sas_vorw "Der Istagang (nur positive Werte ansonsten 0)" UBYTE Conv.zff_atsys._.cSignale._.sig_zielgang_sas_vorw_S6_S3 1 100 0 8 DISPLAY_IDENTIFIER sig_zielgang_sas_vorw.obj._.iSignale._.zff_atsys ECU_ADDRESS 0xFFF8C2D5 /end MEASUREMENT
/begin MEASUREMENT zff_atsys._.iSignale._.obj.sig_zielgang_sas_komp "Zielgang_sas_komp bitinvertiertes Signal zu zielgang_sas Signal" SBYTE Conv.zff_atsys._.cSignale._.sig_zielgang_sas_komp_S6_S3 1 100 -9 0 DISPLAY_IDENTIFIER sig_zielgang_sas_komp.obj._.iSignale._.zff_atsys ECU_ADDRESS 0xFFF8C2D6 /end MEASUREMENT
/begin MEASUREMENT zff_atsys._.iSignale._.obj.sig_istgang_komp "Zielgang_sas_komp bitinvertiertes Signal zu zielgang_sas Signal" SBYTE Conv.zff_atsys._.cSignale._.sig_istgang_komp_S6_S3 1 100 -9 0 DISPLAY_IDENTIFIER sig_istgang_komp.obj._.iSignale._.zff_atsys ECU_ADDRESS 0xFFF8C2D7 /end MEASUREMENT
/begin MEASUREMENT zff_atsys._.iSignale._.obj.sig_kfl_ist "Kraftfluss-Ist" UBYTE Conv.zff_atsys._.cSignale._.sig_kfl_ist_S6_S3 1 100 0 2 DISPLAY_IDENTIFIER sig_kfl_ist.obj._.iSignale._.zff_atsys ECU_ADDRESS 0xFFF8C2D8 /end MEASUREMENT
/begin MEASUREMENT zff_atsys._.iSignale._.obj.sig_kfl_ziel "Kraftfluss-Ziel" UBYTE Conv.zff_atsys._.cSignale._.sig_kfl_ziel_S6_S3 1 100 0 2 DISPLAY_IDENTIFIER sig_kfl_ziel.obj._.iSignale._.zff_atsys ECU_ADDRESS 0xFFF8C2D9 /end MEASUREMENT
/begin MEASUREMENT zff_atsys._.iSignale._.obj.sig_neigung_iae "Neigung in Grad Steigung" SWORD UMR_GRAD__1_3_M128_S6_S3 1 100 -42.6666666667 42 DISPLAY_IDENTIFIER sig_neigung_iae.obj._.iSignale._.zff_atsys ECU_ADDRESS 0xFFF8C2DA /end MEASUREMENT
/begin COMPU_METHOD SAB_2K_S2_S3 "int = ((phys * 1) / 2) - (0) -" RAT_FUNC "%5.3" "-" COEFFS 0 1 -0 0 0 2 /end COMPU_METHOD
/begin COMPU_METHOD SAB_49K2000_S2_S3 "int = ((phys * 2000) / 49) - (0) -" RAT_FUNC "%5.3" "-" COEFFS 0 2000 -0 0 0 49 /end COMPU_METHOD
/begin COMPU_METHOD SAB_249K1000_31623M1000_S2_S3 "int = ((phys * 1000) / 249) - (-127) -" RAT_FUNC "%5.3" "-" COEFFS 0 1000 31623 0 0 249 /end COMPU_METHOD
/begin COMPU_METHOD UMR___1_1_0_S6_S3 "int = ((phys * 1) / 1) - (0) [-]" RAT_FUNC "%2.0" "[-]" COEFFS 0 1 -0 0 0 1 /end COMPU_METHOD
/begin COMPU_METHOD UMR_MA__1_10_0_S6_S3 "int = ((phys * 10) / 1) - (0) [mA]" RAT_FUNC "%3.1" "[mA]" COEFFS 0 10 -0 0 0 1 /end COMPU_METHOD
/begin COMPU_METHOD UMR_NM__1_1_0_S6_S3 "int = ((phys * 1) / 1) - (0) [Nm]" RAT_FUNC "%2.0" "[Nm]" COEFFS 0 1 -0 0 0 1 /end COMPU_METHOD
/begin COMPU_METHOD UMR_NM__8_1_M50_S6_S3 "int = ((phys * 1) / 8) - (-50) [Nm]" RAT_FUNC "%2.0" "[Nm]" COEFFS 0 1 400 0 0 8 /end COMPU_METHOD
/begin COMPU_METHOD UMR_U_MIN_1_1_0_S6_S3 "int = ((phys * 1) / 1) - (0) [U/min]" RAT_FUNC "%2.0" "[U/min]" COEFFS 0 1 -0 0 0 1 /end COMPU_METHOD
/begin COMPU_METHOD UMR_U_MIN_32_1_0_S6_S3 "int = ((phys * 1) / 32) - (0) [U/min]" RAT_FUNC "%2.0" "[U/min]" COEFFS 0 1 -0 0 0 32 /end COMPU_METHOD
/begin COMPU_METHOD UMR_U_MINTASK_1_100_0_S6_S3 "int = ((phys * 100) / 1) - (0) [U/(min*task)]" RAT_FUNC "%4.2" "[U/(min*task)]" COEFFS 0 100 -0 0 0 1 /end COMPU_METHOD
/begin COMPU_METHOD UMR_MSEC__10_1_0_S6_S3 "int = ((phys * 1) / 10) - (0) [ms]" RAT_FUNC "%2.0" "[ms]" COEFFS 0 1 -0 0 0 10 /end COMPU_METHOD
/begin COMPU_METHOD UMR_GRADC__1_1_0_S6_S3 "int = ((phys * 1) / 1) - (0) [°C]" RAT_FUNC "%2.0" "[°C]" COEFFS 0 1 -0 0 0 1 /end COMPU_METHOD
/begin COMPU_METHOD UMR_GRADC__1_1_M40_S6_S3 "int = ((phys * 1) / 1) - (-40) [°C]" RAT_FUNC "%2.0" "[°C]" COEFFS 0 1 40 0 0 1 /end COMPU_METHOD
/begin COMPU_METHOD UMR_GRADC__1_1_M48_S6_S3 "int = ((phys * 1) / 1) - (-48) [°C]" RAT_FUNC "%2.0" "[°C]" COEFFS 0 1 48 0 0 1 /end COMPU_METHOD
/begin COMPU_METHOD UMR_PROZENT__20_51_0_S6_S3 "int = ((phys * 51) / 20) - (0) [%]" RAT_FUNC "%6.4" "[%]" COEFFS 0 51 -0 0 0 20 /end COMPU_METHOD
/begin COMPU_METHOD UMR_PROZENT__1_1_0_S6_S3 "int = ((phys * 1) / 1) - (0) [%]" RAT_FUNC "%2.0" "[%]" COEFFS 0 1 -0 0 0 1 /end COMPU_METHOD
/begin COMPU_METHOD UMR_GRAD__1_3_M128_S6_S3 "int = ((phys * 3) / 1) - (-128) [Grad]" RAT_FUNC "%5.3" "[Grad]" COEFFS 0 3 128 0 0 1 /end COMPU_METHOD
/begin COMPU_METHOD eIepZust_S6_S3 "" TAB_VERB "%2.0" "" COMPU_TAB_REF eIepZust_S6_S3 /end COMPU_METHOD
/begin COMPU_METHOD eIepIst_S6_S3 "" TAB_VERB "%2.0" "" COMPU_TAB_REF eIepIst_S6_S3 /end COMPU_METHOD
/begin COMPU_METHOD eIepSoll_S6_S3 "" TAB_VERB "%2.0" "" COMPU_TAB_REF eIepSoll_S6_S3 /end COMPU_METHOD
/begin COMPU_METHOD UMRM___1_1_0_S6_S3 "Ohne Umskalierung\\nint = ((phys * 1) / 1) - (0) [-]" RAT_FUNC "%2.0" "[-]" COEFFS 0 1 -0 0 0 1 /end COMPU_METHOD
/begin COMPU_METHOD UMRM_U_MIN_1_1_0_S6_S3 "Darstellung in U/min\\nint = ((phys * 1) / 1) - (0) [U/min]" RAT_FUNC "%2.0" "[U/min]" COEFFS 0 1 -0 0 0 1 /end COMPU_METHOD
/begin COMPU_METHOD UMRM_MSEC__10_1_0_S6_S3 "Umrechnung von 10 msec in msec\\nint = ((phys * 1) / 10) - (0) [ms]" RAT_FUNC "%5.3" "[ms]" COEFFS 0 1 -0 0 0 10 /end COMPU_METHOD
/begin COMPU_METHOD UMRM_SEC__1_100_0_S6_S3 "Umrechnung von sec in 1/100sec\\nint = ((phys * 100) / 1) - (0) [s]" RAT_FUNC "%5.3" "[s]" COEFFS 0 100 -0 0 0 1 /end COMPU_METHOD
/begin COMPU_METHOD UMRM_SEC__1_1_0_S6_S3 "Umrechnung Sekunde\\nint = ((phys * 1) / 1) - (0) [s]" RAT_FUNC "%2.0" "[s]" COEFFS 0 1 -0 0 0 1 /end COMPU_METHOD
/begin COMPU_METHOD eBool_true_false_S6_S3 "" TAB_VERB "%2.0" "" COMPU_TAB_REF eBool_true_false_S6_S3 /end COMPU_METHOD
/begin COMPU_METHOD Conv.cBasFehlerErfolgInt._.flag_fehler_S6_S3 "Umrechnung fuer Messgroesse cBasFehlerErfolgInt::flag_fehler" TAB_VERB "%4.0" "" COMPU_TAB_REF Conv.cBasFehlerErfolgInt._.flag_fehler_S6_S3 /end COMPU_METHOD
/begin COMPU_METHOD Conv.cBasFehlerErfolgFl._.flag_fehler_S6_S3 "Umrechnung fuer Messgroesse cBasFehlerErfolgFl::flag_fehler" TAB_VERB "%4.0" "" COMPU_TAB_REF Conv.cBasFehlerErfolgFl._.flag_fehler_S6_S3 /end COMPU_METHOD
/begin COMPU_METHOD Conv.cUl2K0SPlausiInt._.n_diff_k0_einmalig_S6_S3 "Umrechnung fuer Messgroesse cUl2K0SPlausiInt::n_diff_k0_einmalig" TAB_VERB "%4.0" "" COMPU_TAB_REF Conv.cUl2K0SPlausiInt._.n_diff_k0_einmalig_S6_S3 /end COMPU_METHOD
/begin COMPU_METHOD Conv.cUl2K0SPlausiInt._.st_fehler_S6_S3 "Umrechnung fuer Messgroesse cUl2K0SPlausiInt::st_fehler" TAB_VERB "%4.0" "" COMPU_TAB_REF Conv.cUl2K0SPlausiInt._.st_fehler_S6_S3 /end COMPU_METHOD
/begin COMPU_METHOD Conv.cUl2K0SStatusInt._.status_k0_alt_S6_S3 "Umrechnung fuer Messgroesse cUl2K0SStatusInt::status_k0_alt" TAB_VERB "%4.0" "" COMPU_TAB_REF Conv.cUl2K0SStatusInt._.status_k0_alt_S6_S3 /end COMPU_METHOD
/begin COMPU_METHOD Conv.cUl2K0SStatusInt._.fehler_ungewolltes_schliessen_S6_S3 "Umrechnung fuer Messgroesse cUl2K0SStatusInt::fehler_ungewolltes_schliessen" TAB_VERB "%4.0" "" COMPU_TAB_REF Conv.cUl2K0SStatusInt._.fehler_ungewolltes_schliessen_S6_S3 /end COMPU_METHOD
/begin COMPU_METHOD Conv.cUl2K0SStatusInt._.fehler_kein_oeffnen_S6_S3 "Umrechnung fuer Messgroesse cUl2K0SStatusInt::fehler_kein_oeffnen" TAB_VERB "%4.0" "" COMPU_TAB_REF Conv.cUl2K0SStatusInt._.fehler_kein_oeffnen_S6_S3 /end COMPU_METHOD
/begin COMPU_METHOD Conv.cUl2PosNPlRbm._.flag_rbm_zustand_posn_S6_S3 "Umrechnung fuer Messgroesse cUl2PosNPlRbm::flag_rbm_zustand_posn" TAB_VERB "%4.0" "" COMPU_TAB_REF Conv.cUl2PosNPlRbm._.flag_rbm_zustand_posn_S6_S3 /end COMPU_METHOD
/begin COMPU_METHOD Conv.cUl2PosNPlInt._.f_phase_b_aktiv_S6_S3 "Umrechnung fuer Messgroesse cUl2PosNPlInt::f_phase_b_aktiv" TAB_VERB "%4.0" "" COMPU_TAB_REF Conv.cUl2PosNPlInt._.f_phase_b_aktiv_S6_S3 /end COMPU_METHOD
/begin COMPU_METHOD Conv.cUl2PosNPlFl._.f_phase_b_aktiv_S6_S3 "Umrechnung fuer Messgroesse cUl2PosNPlFl::f_phase_b_aktiv" TAB_VERB "%4.0" "" COMPU_TAB_REF Conv.cUl2PosNPlFl._.f_phase_b_aktiv_S6_S3 /end COMPU_METHOD
/begin COMPU_METHOD Conv.cUl2BasisKupDruckAnstInt._.kup_nr_S6_S3 "Umrechnung fuer Messgroesse cUl2BasisKupDruckAnstInt::kup_nr" TAB_VERB "%4.0" "" COMPU_TAB_REF Conv.cUl2BasisKupDruckAnstInt._.kup_nr_S6_S3 /end COMPU_METHOD
/begin COMPU_METHOD Conv.cUl2BasisKupDruckAnstInt._.zustand_soll_S6_S3 "Umrechnung fuer Messgroesse cUl2BasisKupDruckAnstInt::zustand_soll" TAB_VERB "%4.0" "" COMPU_TAB_REF Conv.cUl2BasisKupDruckAnstInt._.zustand_soll_S6_S3 /end COMPU_METHOD
/begin COMPU_METHOD Conv.cUl2KupDruckAnstInt._.zustand_ist_S6_S3 "Umrechnung fuer Messgroesse cUl2KupDruckAnstInt::zustand_ist" TAB_VERB "%4.0" "" COMPU_TAB_REF Conv.cUl2KupDruckAnstInt._.zustand_ist_S6_S3 /end COMPU_METHOD
/begin COMPU_METHOD Conv.cUl2KupIaeDruckAnstInt._.zustand_ist_S6_S3 "Umrechnung fuer Messgroesse cUl2KupIaeDruckAnstInt::zustand_ist" TAB_VERB "%4.0" "" COMPU_TAB_REF Conv.cUl2KupIaeDruckAnstInt._.zustand_ist_S6_S3 /end COMPU_METHOD
/begin COMPU_METHOD Conv.cUl2IGetrPlausiDatenInt._.falsche_schaltung_S6_S3 "Umrechnung fuer Messgroesse cUl2IGetrPlausiDatenInt::falsche_schaltung" TAB_VERB "%4.0" "" COMPU_TAB_REF Conv.cUl2IGetrPlausiDatenInt._.falsche_schaltung_S6_S3 /end COMPU_METHOD
/begin COMPU_METHOD Conv.cUl2IGetrPlausiZustandInt._.i_set_plausible_S6_S3 "Umrechnung fuer Messgroesse cUl2IGetrPlausiZustandInt::i_set_plausible" TAB_VERB "%4.0" "" COMPU_TAB_REF Conv.cUl2IGetrPlausiZustandInt._.i_set_plausible_S6_S3 /end COMPU_METHOD
/begin COMPU_METHOD Conv.cUl2IGetrPlausiZustandInt._.zustand_S6_S3 "Umrechnung fuer Messgroesse cUl2IGetrPlausiZustandInt::zustand" TAB_VERB "%4.0" "" COMPU_TAB_REF Conv.cUl2IGetrPlausiZustandInt._.zustand_S6_S3 /end COMPU_METHOD
/begin COMPU_METHOD Conv.cUl2IGetrPlausiZustandInt._.gang_anst_S6_S3 "Umrechnung fuer Messgroesse cUl2IGetrPlausiZustandInt::gang_anst" TAB_VERB "%4.0" "" COMPU_TAB_REF Conv.cUl2IGetrPlausiZustandInt._.gang_anst_S6_S3 /end COMPU_METHOD
/begin COMPU_METHOD Conv.cUl2IGetrPlausiZustandInt._.gang_anst_plausibel_S6_S3 "Umrechnung fuer Messgroesse cUl2IGetrPlausiZustandInt::gang_anst_plausibel" TAB_VERB "%4.0" "" COMPU_TAB_REF Conv.cUl2IGetrPlausiZustandInt._.gang_anst_plausibel_S6_S3 /end COMPU_METHOD
/begin COMPU_METHOD Conv.cUl2IGetrPlausiZustandInt._.gang_pulsen_anst_plausibel_S6_S3 "Umrechnung fuer Messgroesse cUl2IGetrPlausiZustandInt::gang_pulsen_anst_plausibel" TAB_VERB "%4.0" "" COMPU_TAB_REF Conv.cUl2IGetrPlausiZustandInt._.gang_pulsen_anst_plausibel_S6_S3 /end COMPU_METHOD
/begin COMPU_METHOD Conv.cUl2IGetrPlausiZustandInt._.ge_ga_anst_plausibel_S6_S3 "Umrechnung fuer Messgroesse cUl2IGetrPlausiZustandInt::ge_ga_anst_plausibel" TAB_VERB "%4.0" "" COMPU_TAB_REF Conv.cUl2IGetrPlausiZustandInt._.ge_ga_anst_plausibel_S6_S3 /end COMPU_METHOD
/begin COMPU_METHOD Conv.cUl2IGetrPlausiZustandInt._.reversieren_anst_S6_S3 "Umrechnung fuer Messgroesse cUl2IGetrPlausiZustandInt::reversieren_anst" TAB_VERB "%4.0" "" COMPU_TAB_REF Conv.cUl2IGetrPlausiZustandInt._.reversieren_anst_S6_S3 /end COMPU_METHOD
/begin COMPU_METHOD Conv.cUl2IGetrPlausiZustandInt._.schalt_anst_plausibel_S6_S3 "Umrechnung fuer Messgroesse cUl2IGetrPlausiZustandInt::schalt_anst_plausibel" TAB_VERB "%4.0" "" COMPU_TAB_REF Conv.cUl2IGetrPlausiZustandInt._.schalt_anst_plausibel_S6_S3 /end COMPU_METHOD
/begin COMPU_METHOD Conv.cUl2IGetrPlausiZustandInt._.end_schalt_anst_plausibel_S6_S3 "Umrechnung fuer Messgroesse cUl2IGetrPlausiZustandInt::end_schalt_anst_plausibel" TAB_VERB "%4.0" "" COMPU_TAB_REF Conv.cUl2IGetrPlausiZustandInt._.end_schalt_anst_plausibel_S6_S3 /end COMPU_METHOD
/begin COMPU_METHOD Conv.cUl2IGetrPlausiZustandInt._.versch_4_anst_plausibel_S6_S3 "Umrechnung fuer Messgroesse cUl2IGetrPlausiZustandInt::versch_4_anst_plausibel" TAB_VERB "%4.0" "" COMPU_TAB_REF Conv.cUl2IGetrPlausiZustandInt._.versch_4_anst_plausibel_S6_S3 /end COMPU_METHOD
/begin COMPU_METHOD Conv.cUl2IGetrPlausiZustandInt._.schalt_err_anst_S6_S3 "Umrechnung fuer Messgroesse cUl2IGetrPlausiZustandInt::schalt_err_anst" TAB_VERB "%4.0" "" COMPU_TAB_REF Conv.cUl2IGetrPlausiZustandInt._.schalt_err_anst_S6_S3 /end COMPU_METHOD
/begin COMPU_METHOD Conv.cUl2IGetrPlausiZustandInt._.schalt_err_anst_3_kup_S6_S3 "Umrechnung fuer Messgroesse cUl2IGetrPlausiZustandInt::schalt_err_anst_3_kup" TAB_VERB "%4.0" "" COMPU_TAB_REF Conv.cUl2IGetrPlausiZustandInt._.schalt_err_anst_3_kup_S6_S3 /end COMPU_METHOD
/begin COMPU_METHOD Conv.cUl2IGetrPlausiZustandInt._.pos_alt_S6_S3 "Umrechnung fuer Messgroesse cUl2IGetrPlausiZustandInt::pos_alt" TAB_VERB "%4.0" "" COMPU_TAB_REF Conv.cUl2IGetrPlausiZustandInt._.pos_alt_S6_S3 /end COMPU_METHOD
/begin COMPU_METHOD Conv.cUl2IGetrPlausiZustandInt._.pos_revn_start_S6_S3 "Umrechnung fuer Messgroesse cUl2IGetrPlausiZustandInt::pos_revn_start" TAB_VERB "%4.0" "" COMPU_TAB_REF Conv.cUl2IGetrPlausiZustandInt._.pos_revn_start_S6_S3 /end COMPU_METHOD
/begin COMPU_METHOD Conv.cUl2NegMeSigInt._.stoerung_sig_abs_neg_me_S6_S3 "Umrechnung fuer Messgroesse cUl2NegMeSigInt::stoerung_sig_abs_neg_me" TAB_VERB "%4.0" "" COMPU_TAB_REF Conv.cUl2NegMeSigInt._.stoerung_sig_abs_neg_me_S6_S3 /end COMPU_METHOD
/begin COMPU_METHOD Conv.cUl2NegMeSigInt._.stoerung_sig_rel_neg_me_S6_S3 "Umrechnung fuer Messgroesse cUl2NegMeSigInt::stoerung_sig_rel_neg_me" TAB_VERB "%4.0" "" COMPU_TAB_REF Conv.cUl2NegMeSigInt._.stoerung_sig_rel_neg_me_S6_S3 /end COMPU_METHOD
/begin COMPU_METHOD Conv.cUl2NegMeSigFl._.stoerung_sig_abs_neg_me_S6_S3 "Umrechnung fuer Messgroesse cUl2NegMeSigFl::stoerung_sig_abs_neg_me" TAB_VERB "%4.0" "" COMPU_TAB_REF Conv.cUl2NegMeSigFl._.stoerung_sig_abs_neg_me_S6_S3 /end COMPU_METHOD
/begin COMPU_METHOD Conv.cUl2NegMeSigFl._.stoerung_sig_rel_neg_me_S6_S3 "Umrechnung fuer Messgroesse cUl2NegMeSigFl::stoerung_sig_rel_neg_me" TAB_VERB "%4.0" "" COMPU_TAB_REF Conv.cUl2NegMeSigFl._.stoerung_sig_rel_neg_me_S6_S3 /end COMPU_METHOD
/begin COMPU_METHOD Conv.cUl2NegMeIntenInt._.stoerung_int_abs_neg_me_S6_S3 "Umrechnung fuer Messgroesse cUl2NegMeIntenInt::stoerung_int_abs_neg_me" TAB_VERB "%4.0" "" COMPU_TAB_REF Conv.cUl2NegMeIntenInt._.stoerung_int_abs_neg_me_S6_S3 /end COMPU_METHOD
/begin COMPU_METHOD Conv.cUl2NegMeIntenInt._.stoerung_int_rel_neg_me_S6_S3 "Umrechnung fuer Messgroesse cUl2NegMeIntenInt::stoerung_int_rel_neg_me" TAB_VERB "%4.0" "" COMPU_TAB_REF Conv.cUl2NegMeIntenInt._.stoerung_int_rel_neg_me_S6_S3 /end COMPU_METHOD
/begin COMPU_METHOD Conv.cUl2NegMeIntenFl._.stoerung_int_abs_neg_me_S6_S3 "Umrechnung fuer Messgroesse cUl2NegMeIntenFl::stoerung_int_abs_neg_me" TAB_VERB "%4.0" "" COMPU_TAB_REF Conv.cUl2NegMeIntenFl._.stoerung_int_abs_neg_me_S6_S3 /end COMPU_METHOD
/begin COMPU_METHOD Conv.cUl2NegMeIntenFl._.stoerung_int_rel_neg_me_S6_S3 "Umrechnung fuer Messgroesse cUl2NegMeIntenFl::stoerung_int_rel_neg_me" TAB_VERB "%4.0" "" COMPU_TAB_REF Conv.cUl2NegMeIntenFl._.stoerung_int_rel_neg_me_S6_S3 /end COMPU_METHOD
/begin COMPU_METHOD Conv.cUl2PosMeSigInt._.stoerung_sig_abs_pos_me_S6_S3 "Umrechnung fuer Messgroesse cUl2PosMeSigInt::stoerung_sig_abs_pos_me" TAB_VERB "%4.0" "" COMPU_TAB_REF Conv.cUl2PosMeSigInt._.stoerung_sig_abs_pos_me_S6_S3 /end COMPU_METHOD
/begin COMPU_METHOD Conv.cUl2PosMeSigInt._.stoerung_sig_rel_pos_me_S6_S3 "Umrechnung fuer Messgroesse cUl2PosMeSigInt::stoerung_sig_rel_pos_me" TAB_VERB "%4.0" "" COMPU_TAB_REF Conv.cUl2PosMeSigInt._.stoerung_sig_rel_pos_me_S6_S3 /end COMPU_METHOD
/begin COMPU_METHOD Conv.cUl2PosMeSigFl._.stoerung_sig_abs_pos_me_S6_S3 "Umrechnung fuer Messgroesse cUl2PosMeSigFl::stoerung_sig_abs_pos_me" TAB_VERB "%4.0" "" COMPU_TAB_REF Conv.cUl2PosMeSigFl._.stoerung_sig_abs_pos_me_S6_S3 /end COMPU_METHOD
/begin COMPU_METHOD Conv.cUl2PosMeSigFl._.stoerung_sig_rel_pos_me_S6_S3 "Umrechnung fuer Messgroesse cUl2PosMeSigFl::stoerung_sig_rel_pos_me" TAB_VERB "%4.0" "" COMPU_TAB_REF Conv.cUl2PosMeSigFl._.stoerung_sig_rel_pos_me_S6_S3 /end COMPU_METHOD
/begin COMPU_METHOD Conv.cUl2PosMeGradientInt._.stoerung_grad_abs_me_S6_S3 "Umrechnung fuer Messgroesse cUl2PosMeGradientInt::stoerung_grad_abs_me" TAB_VERB "%4.0" "" COMPU_TAB_REF Conv.cUl2PosMeGradientInt._.stoerung_grad_abs_me_S6_S3 /end COMPU_METHOD
/begin COMPU_METHOD Conv.cUl2PosMeGradientInt._.stoerung_grad_rel_me_S6_S3 "Umrechnung fuer Messgroesse cUl2PosMeGradientInt::stoerung_grad_rel_me" TAB_VERB "%4.0" "" COMPU_TAB_REF Conv.cUl2PosMeGradientInt._.stoerung_grad_rel_me_S6_S3 /end COMPU_METHOD
/begin COMPU_METHOD Conv.cUl2PosMeGradientFl._.stoerung_grad_abs_me_S6_S3 "Umrechnung fuer Messgroesse cUl2PosMeGradientFl::stoerung_grad_abs_me" TAB_VERB "%4.0" "" COMPU_TAB_REF Conv.cUl2PosMeGradientFl._.stoerung_grad_abs_me_S6_S3 /end COMPU_METHOD
/begin COMPU_METHOD Conv.cUl2PosMeGradientFl._.stoerung_grad_rel_me_S6_S3 "Umrechnung fuer Messgroesse cUl2PosMeGradientFl::stoerung_grad_rel_me" TAB_VERB "%4.0" "" COMPU_TAB_REF Conv.cUl2PosMeGradientFl._.stoerung_grad_rel_me_S6_S3 /end COMPU_METHOD
/begin COMPU_METHOD Conv.cUl2PosMeIntenInt._.schwellen_variante_S6_S3 "Umrechnung fuer Messgroesse cUl2PosMeIntenInt::schwellen_variante" TAB_VERB "%4.0" "" COMPU_TAB_REF Conv.cUl2PosMeIntenInt._.schwellen_variante_S6_S3 /end COMPU_METHOD
/begin COMPU_METHOD Conv.cUl2PosMeIntenInt._.stoerung_int_abs_pos_me_S6_S3 "Umrechnung fuer Messgroesse cUl2PosMeIntenInt::stoerung_int_abs_pos_me" TAB_VERB "%4.0" "" COMPU_TAB_REF Conv.cUl2PosMeIntenInt._.stoerung_int_abs_pos_me_S6_S3 /end COMPU_METHOD
/begin COMPU_METHOD Conv.cUl2PosMeIntenInt._.stoerung_int_rel_pos_me_S6_S3 "Umrechnung fuer Messgroesse cUl2PosMeIntenInt::stoerung_int_rel_pos_me" TAB_VERB "%4.0" "" COMPU_TAB_REF Conv.cUl2PosMeIntenInt._.stoerung_int_rel_pos_me_S6_S3 /end COMPU_METHOD
/begin COMPU_METHOD Conv.cUl2PosMeIntenFl._.schwellen_variante_S6_S3 "Umrechnung fuer Messgroesse cUl2PosMeIntenFl::schwellen_variante" TAB_VERB "%4.0" "" COMPU_TAB_REF Conv.cUl2PosMeIntenFl._.schwellen_variante_S6_S3 /end COMPU_METHOD
/begin COMPU_METHOD Conv.cUl2PosMeIntenFl._.stoerung_int_abs_pos_me_S6_S3 "Umrechnung fuer Messgroesse cUl2PosMeIntenFl::stoerung_int_abs_pos_me" TAB_VERB "%4.0" "" COMPU_TAB_REF Conv.cUl2PosMeIntenFl._.stoerung_int_abs_pos_me_S6_S3 /end COMPU_METHOD
/begin COMPU_METHOD Conv.cUl2PosMeIntenFl._.stoerung_int_rel_pos_me_S6_S3 "Umrechnung fuer Messgroesse cUl2PosMeIntenFl::stoerung_int_rel_pos_me" TAB_VERB "%4.0" "" COMPU_TAB_REF Conv.cUl2PosMeIntenFl._.stoerung_int_rel_pos_me_S6_S3 /end COMPU_METHOD
/begin COMPU_METHOD Conv.cUl2PosMeIntenIGangInt._.err_abs_me_igang_S6_S3 "Umrechnung fuer Messgroesse cUl2PosMeIntenIGangInt::err_abs_me_igang" TAB_VERB "%4.0" "" COMPU_TAB_REF Conv.cUl2PosMeIntenIGangInt._.err_abs_me_igang_S6_S3 /end COMPU_METHOD
/begin COMPU_METHOD Conv.cUl2PosMeIntenIGangInt._.err_rel_me_igang_S6_S3 "Umrechnung fuer Messgroesse cUl2PosMeIntenIGangInt::err_rel_me_igang" TAB_VERB "%4.0" "" COMPU_TAB_REF Conv.cUl2PosMeIntenIGangInt._.err_rel_me_igang_S6_S3 /end COMPU_METHOD
/begin COMPU_METHOD Conv.cUl2PosMeIntenIGangFl._.err_abs_me_igang_S6_S3 "Umrechnung fuer Messgroesse cUl2PosMeIntenIGangFl::err_abs_me_igang" TAB_VERB "%4.0" "" COMPU_TAB_REF Conv.cUl2PosMeIntenIGangFl._.err_abs_me_igang_S6_S3 /end COMPU_METHOD
/begin COMPU_METHOD Conv.cUl2PosMeIntenIGangFl._.err_rel_me_igang_S6_S3 "Umrechnung fuer Messgroesse cUl2PosMeIntenIGangFl::err_rel_me_igang" TAB_VERB "%4.0" "" COMPU_TAB_REF Conv.cUl2PosMeIntenIGangFl._.err_rel_me_igang_S6_S3 /end COMPU_METHOD
/begin COMPU_METHOD Conv.cUl2PosMeIntenKoordInt._.err_int_pos_me_S6_S3 "Umrechnung fuer Messgroesse cUl2PosMeIntenKoordInt::err_int_pos_me" TAB_VERB "%4.0" "" COMPU_TAB_REF Conv.cUl2PosMeIntenKoordInt._.err_int_pos_me_S6_S3 /end COMPU_METHOD
/begin COMPU_METHOD Conv.cUl2PosMeIntenKoordInt._.err_int_pos_me_abs_S6_S3 "Umrechnung fuer Messgroesse cUl2PosMeIntenKoordInt::err_int_pos_me_abs" TAB_VERB "%4.0" "" COMPU_TAB_REF Conv.cUl2PosMeIntenKoordInt._.err_int_pos_me_abs_S6_S3 /end COMPU_METHOD
/begin COMPU_METHOD Conv.cUl2PosMeIntenKoordInt._.err_int_pos_me_rel_S6_S3 "Umrechnung fuer Messgroesse cUl2PosMeIntenKoordInt::err_int_pos_me_rel" TAB_VERB "%4.0" "" COMPU_TAB_REF Conv.cUl2PosMeIntenKoordInt._.err_int_pos_me_rel_S6_S3 /end COMPU_METHOD
/begin COMPU_METHOD Conv.cUl2PosMeIntenKoordFl._.err_int_pos_me_S6_S3 "Umrechnung fuer Messgroesse cUl2PosMeIntenKoordFl::err_int_pos_me" TAB_VERB "%4.0" "" COMPU_TAB_REF Conv.cUl2PosMeIntenKoordFl._.err_int_pos_me_S6_S3 /end COMPU_METHOD
/begin COMPU_METHOD Conv.cUl2PosMeIntenKoordFl._.err_int_pos_me_abs_S6_S3 "Umrechnung fuer Messgroesse cUl2PosMeIntenKoordFl::err_int_pos_me_abs" TAB_VERB "%4.0" "" COMPU_TAB_REF Conv.cUl2PosMeIntenKoordFl._.err_int_pos_me_abs_S6_S3 /end COMPU_METHOD
/begin COMPU_METHOD Conv.cUl2PosMeIntenKoordFl._.err_int_pos_me_rel_S6_S3 "Umrechnung fuer Messgroesse cUl2PosMeIntenKoordFl::err_int_pos_me_rel" TAB_VERB "%4.0" "" COMPU_TAB_REF Conv.cUl2PosMeIntenKoordFl._.err_int_pos_me_rel_S6_S3 /end COMPU_METHOD
/begin COMPU_METHOD Conv.cUl2MeKoordInt._.err_pos_me_S6_S3 "Umrechnung fuer Messgroesse cUl2MeKoordInt::err_pos_me" TAB_VERB "%4.0" "" COMPU_TAB_REF Conv.cUl2MeKoordInt._.err_pos_me_S6_S3 /end COMPU_METHOD
/begin COMPU_METHOD Conv.cUl2MeKoordInt._.err_neg_me_S6_S3 "Umrechnung fuer Messgroesse cUl2MeKoordInt::err_neg_me" TAB_VERB "%4.0" "" COMPU_TAB_REF Conv.cUl2MeKoordInt._.err_neg_me_S6_S3 /end COMPU_METHOD
/begin COMPU_METHOD Conv.cUl2MeKoordInt._.err_abs_me_S6_S3 "Umrechnung fuer Messgroesse cUl2MeKoordInt::err_abs_me" TAB_VERB "%4.0" "" COMPU_TAB_REF Conv.cUl2MeKoordInt._.err_abs_me_S6_S3 /end COMPU_METHOD
/begin COMPU_METHOD Conv.cUl2MeKoordInt._.err_rel_me_S6_S3 "Umrechnung fuer Messgroesse cUl2MeKoordInt::err_rel_me" TAB_VERB "%4.0" "" COMPU_TAB_REF Conv.cUl2MeKoordInt._.err_rel_me_S6_S3 /end COMPU_METHOD
/begin COMPU_METHOD Conv.cUl2MeKoordInt._.err_sig_pos_me_S6_S3 "Umrechnung fuer Messgroesse cUl2MeKoordInt::err_sig_pos_me" TAB_VERB "%4.0" "" COMPU_TAB_REF Conv.cUl2MeKoordInt._.err_sig_pos_me_S6_S3 /end COMPU_METHOD
/begin COMPU_METHOD Conv.cUl2MeKoordInt._.err_me_igang_S6_S3 "Umrechnung fuer Messgroesse cUl2MeKoordInt::err_me_igang" TAB_VERB "%4.0" "" COMPU_TAB_REF Conv.cUl2MeKoordInt._.err_me_igang_S6_S3 /end COMPU_METHOD
/begin COMPU_METHOD Conv.cUl2MeKoordInt._.err_grad_pos_me_S6_S3 "Umrechnung fuer Messgroesse cUl2MeKoordInt::err_grad_pos_me" TAB_VERB "%4.0" "" COMPU_TAB_REF Conv.cUl2MeKoordInt._.err_grad_pos_me_S6_S3 /end COMPU_METHOD
/begin COMPU_METHOD Conv.cUl2MeKoordInt._.err_sig_neg_me_S6_S3 "Umrechnung fuer Messgroesse cUl2MeKoordInt::err_sig_neg_me" TAB_VERB "%4.0" "" COMPU_TAB_REF Conv.cUl2MeKoordInt._.err_sig_neg_me_S6_S3 /end COMPU_METHOD
/begin COMPU_METHOD Conv.cUl2MeKoordInt._.err_int_neg_me_S6_S3 "Umrechnung fuer Messgroesse cUl2MeKoordInt::err_int_neg_me" TAB_VERB "%4.0" "" COMPU_TAB_REF Conv.cUl2MeKoordInt._.err_int_neg_me_S6_S3 /end COMPU_METHOD
/begin COMPU_METHOD Conv.cUl2MeKoordFl._.err_pos_me_S6_S3 "Umrechnung fuer Messgroesse cUl2MeKoordFl::err_pos_me" TAB_VERB "%4.0" "" COMPU_TAB_REF Conv.cUl2MeKoordFl._.err_pos_me_S6_S3 /end COMPU_METHOD
/begin COMPU_METHOD Conv.cUl2MeKoordFl._.err_neg_me_S6_S3 "Umrechnung fuer Messgroesse cUl2MeKoordFl::err_neg_me" TAB_VERB "%4.0" "" COMPU_TAB_REF Conv.cUl2MeKoordFl._.err_neg_me_S6_S3 /end COMPU_METHOD
/begin COMPU_METHOD Conv.cUl2MeKoordFl._.err_abs_me_S6_S3 "Umrechnung fuer Messgroesse cUl2MeKoordFl::err_abs_me" TAB_VERB "%4.0" "" COMPU_TAB_REF Conv.cUl2MeKoordFl._.err_abs_me_S6_S3 /end COMPU_METHOD
/begin COMPU_METHOD Conv.cUl2MeKoordFl._.err_rel_me_S6_S3 "Umrechnung fuer Messgroesse cUl2MeKoordFl::err_rel_me" TAB_VERB "%4.0" "" COMPU_TAB_REF Conv.cUl2MeKoordFl._.err_rel_me_S6_S3 /end COMPU_METHOD
/begin COMPU_METHOD Conv.cUl2MeKoordFl._.err_me_igang_S6_S3 "Umrechnung fuer Messgroesse cUl2MeKoordFl::err_me_igang" TAB_VERB "%4.0" "" COMPU_TAB_REF Conv.cUl2MeKoordFl._.err_me_igang_S6_S3 /end COMPU_METHOD
/begin COMPU_METHOD Conv.cUl2NmotuInt._.pruefbed_nmotueb_l2_S6_S3 "Umrechnung fuer Messgroesse cUl2NmotuInt::pruefbed_nmotueb_l2" TAB_VERB "%4.0" "" COMPU_TAB_REF Conv.cUl2NmotuInt._.pruefbed_nmotueb_l2_S6_S3 /end COMPU_METHOD
/begin COMPU_METHOD Conv.cUl2NmotuInt._.pos_alt_S6_S3 "Umrechnung fuer Messgroesse cUl2NmotuInt::pos_alt" TAB_VERB "%4.0" "" COMPU_TAB_REF Conv.cUl2NmotuInt._.pos_alt_S6_S3 /end COMPU_METHOD
/begin COMPU_METHOD Conv.cUl2NmotuInt._.z_nmotabreg_l2_S6_S3 "Umrechnung fuer Messgroesse cUl2NmotuInt::z_nmotabreg_l2" TAB_VERB "%4.0" "" COMPU_TAB_REF Conv.cUl2NmotuInt._.z_nmotabreg_l2_S6_S3 /end COMPU_METHOD
/begin COMPU_METHOD Conv.cUl2NmotuInt._.z_nt_max_zg_l2_S6_S3 "Umrechnung fuer Messgroesse cUl2NmotuInt::z_nt_max_zg_l2" TAB_VERB "%4.0" "" COMPU_TAB_REF Conv.cUl2NmotuInt._.z_nt_max_zg_l2_S6_S3 /end COMPU_METHOD
/begin COMPU_METHOD Conv.cUl2NmotuInt._.ntmaxzg_verz_aktiv_S6_S3 "Umrechnung fuer Messgroesse cUl2NmotuInt::ntmaxzg_verz_aktiv" TAB_VERB "%4.0" "" COMPU_TAB_REF Conv.cUl2NmotuInt._.ntmaxzg_verz_aktiv_S6_S3 /end COMPU_METHOD
/begin COMPU_METHOD Conv.cUl2NmotuInt._.dsc_fehler_alt_S6_S3 "Umrechnung fuer Messgroesse cUl2NmotuInt::dsc_fehler_alt" TAB_VERB "%4.0" "" COMPU_TAB_REF Conv.cUl2NmotuInt._.dsc_fehler_alt_S6_S3 /end COMPU_METHOD
/begin COMPU_METHOD Conv.cUl2NmotuInt._.zielgang_sas_alt_l2_S6_S3 "Umrechnung fuer Messgroesse cUl2NmotuInt::zielgang_sas_alt_l2" TAB_VERB "%4.0" "" COMPU_TAB_REF Conv.cUl2NmotuInt._.zielgang_sas_alt_l2_S6_S3 /end COMPU_METHOD
/begin COMPU_METHOD Conv.cUl2NmotuFl._.pruefbed_nmotueb_l2_S6_S3 "Umrechnung fuer Messgroesse cUl2NmotuFl::pruefbed_nmotueb_l2" TAB_VERB "%4.0" "" COMPU_TAB_REF Conv.cUl2NmotuFl._.pruefbed_nmotueb_l2_S6_S3 /end COMPU_METHOD
/begin COMPU_METHOD Conv.cUl2NmotuFl._.z_nmotabreg_l2_S6_S3 "Umrechnung fuer Messgroesse cUl2NmotuFl::z_nmotabreg_l2" TAB_VERB "%4.0" "" COMPU_TAB_REF Conv.cUl2NmotuFl._.z_nmotabreg_l2_S6_S3 /end COMPU_METHOD
/begin COMPU_METHOD Conv.cUl2NmotuFl._.z_nt_max_zg_l2_S6_S3 "Umrechnung fuer Messgroesse cUl2NmotuFl::z_nt_max_zg_l2" TAB_VERB "%4.0" "" COMPU_TAB_REF Conv.cUl2NmotuFl._.z_nt_max_zg_l2_S6_S3 /end COMPU_METHOD
/begin COMPU_METHOD Conv.cUl2NmotuFl._.ntmaxzg_verz_aktiv_S6_S3 "Umrechnung fuer Messgroesse cUl2NmotuFl::ntmaxzg_verz_aktiv" TAB_VERB "%4.0" "" COMPU_TAB_REF Conv.cUl2NmotuFl._.ntmaxzg_verz_aktiv_S6_S3 /end COMPU_METHOD
/begin COMPU_METHOD Conv.cUl2NmotuFl._.dsc_fehler_alt_S6_S3 "Umrechnung fuer Messgroesse cUl2NmotuFl::dsc_fehler_alt" TAB_VERB "%4.0" "" COMPU_TAB_REF Conv.cUl2NmotuFl._.dsc_fehler_alt_S6_S3 /end COMPU_METHOD
/begin COMPU_METHOD Conv.cUl2NmotuFl._.zielgang_sas_alt_l2_S6_S3 "Umrechnung fuer Messgroesse cUl2NmotuFl::zielgang_sas_alt_l2" TAB_VERB "%4.0" "" COMPU_TAB_REF Conv.cUl2NmotuFl._.zielgang_sas_alt_l2_S6_S3 /end COMPU_METHOD
/begin COMPU_METHOD Conv.cUl2SigItfInputInt._.ers_edsmv_info_S6_S3 "Umrechnung fuer Messgroesse cUl2SigItfInputInt::ers_edsmv_info" TAB_VERB "%4.0" "" COMPU_TAB_REF Conv.cUl2SigItfInputInt._.ers_edsmv_info_S6_S3 /end COMPU_METHOD
/begin COMPU_METHOD Conv.cUl2SigItfInputInt._.kmn_out10lssoff_S6_S3 "Umrechnung fuer Messgroesse cUl2SigItfInputInt::kmn_out10lssoff" TAB_VERB "%4.0" "" COMPU_TAB_REF Conv.cUl2SigItfInputInt._.kmn_out10lssoff_S6_S3 /end COMPU_METHOD
/begin COMPU_METHOD Conv.cUl2SigItfInputKomp._.ers_edsmv_info_komp_S6_S3 "Umrechnung fuer Messgroesse cUl2SigItfInputKomp::ers_edsmv_info_komp" TAB_VERB "%4.0" "" COMPU_TAB_REF Conv.cUl2SigItfInputKomp._.ers_edsmv_info_komp_S6_S3 /end COMPU_METHOD
/begin COMPU_METHOD Conv.cUl2SigItfInputKomp._.kmn_out10lssoff_komp_S6_S3 "Umrechnung fuer Messgroesse cUl2SigItfInputKomp::kmn_out10lssoff_komp" TAB_VERB "%4.0" "" COMPU_TAB_REF Conv.cUl2SigItfInputKomp._.kmn_out10lssoff_komp_S6_S3 /end COMPU_METHOD
/begin COMPU_METHOD Conv.cUewTimerZuendung._.zz_zustand_S6_S3 "Umrechnung fuer Messgroesse cUewTimerZuendung::zz_zustand" TAB_VERB "%4.0" "" COMPU_TAB_REF Conv.cUewTimerZuendung._.zz_zustand_S6_S3 /end COMPU_METHOD
/begin COMPU_METHOD Conv.cUewTimerZuendung._.f_keine_egs_offtime_S6_S3 "Umrechnung fuer Messgroesse cUewTimerZuendung::f_keine_egs_offtime" TAB_VERB "%4.0" "" COMPU_TAB_REF Conv.cUewTimerZuendung._.f_keine_egs_offtime_S6_S3 /end COMPU_METHOD
/begin COMPU_METHOD Conv.cUewTimerZuendung._.f_reset_S6_S3 "Umrechnung fuer Messgroesse cUewTimerZuendung::f_reset" TAB_VERB "%4.0" "" COMPU_TAB_REF Conv.cUewTimerZuendung._.f_reset_S6_S3 /end COMPU_METHOD
/begin COMPU_METHOD Conv.cUewSgetf._.i_edsc_min_S6_S3 "Umrechnung fuer Messgroesse cUewSgetf::i_edsc_min" TAB_VERB "%4.0" "" COMPU_TAB_REF Conv.cUewSgetf._.i_edsc_min_S6_S3 /end COMPU_METHOD
/begin COMPU_METHOD Conv.cUewSgetf._.ps_sensor_signal_alt_S6_S3 "Umrechnung fuer Messgroesse cUewSgetf::ps_sensor_signal_alt" TAB_VERB "%4.0" "" COMPU_TAB_REF Conv.cUewSgetf._.ps_sensor_signal_alt_S6_S3 /end COMPU_METHOD
/begin COMPU_METHOD Conv.cUewSgetf._.ps_sensor_err_S6_S3 "Umrechnung fuer Messgroesse cUewSgetf::ps_sensor_err" TAB_VERB "%4.0" "" COMPU_TAB_REF Conv.cUewSgetf._.ps_sensor_err_S6_S3 /end COMPU_METHOD
/begin COMPU_METHOD Conv.cUewSgetf._.zwangsposition_p_S6_S3 "Umrechnung fuer Messgroesse cUewSgetf::zwangsposition_p" TAB_VERB "%4.0" "" COMPU_TAB_REF Conv.cUewSgetf._.zwangsposition_p_S6_S3 /end COMPU_METHOD
/begin COMPU_METHOD Conv.cUewSgetf._.posv_diagnose_aktiv_S6_S3 "Umrechnung fuer Messgroesse cUewSgetf::posv_diagnose_aktiv" TAB_VERB "%4.0" "" COMPU_TAB_REF Conv.cUewSgetf._.posv_diagnose_aktiv_S6_S3 /end COMPU_METHOD
/begin COMPU_METHOD Conv.cUewSgetf._.pruefung_posvmechdef_aktiv_S6_S3 "Umrechnung fuer Messgroesse cUewSgetf::pruefung_posvmechdef_aktiv" TAB_VERB "%4.0" "" COMPU_TAB_REF Conv.cUewSgetf._.pruefung_posvmechdef_aktiv_S6_S3 /end COMPU_METHOD
/begin COMPU_METHOD Conv.cUewSgetf._.pumpendruck_vorh_posv_uew_alt_S6_S3 "Umrechnung fuer Messgroesse cUewSgetf::pumpendruck_vorh_posv_uew_alt" TAB_VERB "%4.0" "" COMPU_TAB_REF Conv.cUewSgetf._.pumpendruck_vorh_posv_uew_alt_S6_S3 /end COMPU_METHOD
/begin COMPU_METHOD Conv.cUewSgetf._.fl_neutral_posvueb_S6_S3 "Umrechnung fuer Messgroesse cUewSgetf::fl_neutral_posvueb" TAB_VERB "%4.0" "" COMPU_TAB_REF Conv.cUewSgetf._.fl_neutral_posvueb_S6_S3 /end COMPU_METHOD
/begin COMPU_METHOD Conv.zff_atsys._.cSignale._.sig_serapflag_S6_S3 "Umrechnung fuer Messgroesse zff_atsys::cSignale::sig_serapflag" TAB_VERB "%4.0" "" COMPU_TAB_REF Conv.zff_atsys._.cSignale._.sig_serapflag_S6_S3 /end COMPU_METHOD
/begin COMPU_METHOD Conv.zff_atsys._.cSignale._.sig_serapflag_komp_S6_S3 "Umrechnung fuer Messgroesse zff_atsys::cSignale::sig_serapflag_komp" TAB_VERB "%4.0" "" COMPU_TAB_REF Conv.zff_atsys._.cSignale._.sig_serapflag_komp_S6_S3 /end COMPU_METHOD
/begin COMPU_METHOD Conv.zff_atsys._.cSignale._.sig_e_fahren_S6_S3 "Umrechnung fuer Messgroesse zff_atsys::cSignale::sig_e_fahren" TAB_VERB "%4.0" "" COMPU_TAB_REF Conv.zff_atsys._.cSignale._.sig_e_fahren_S6_S3 /end COMPU_METHOD
/begin COMPU_METHOD Conv.zff_atsys._.cSignale._.sig_istgang_S6_S3 "Umrechnung fuer Messgroesse zff_atsys::cSignale::sig_istgang" TAB_VERB "%4.0" "" COMPU_TAB_REF Conv.zff_atsys._.cSignale._.sig_istgang_S6_S3 /end COMPU_METHOD
/begin COMPU_METHOD Conv.zff_atsys._.cSignale._.sig_istgang_idx_S6_S3 "Umrechnung fuer Messgroesse zff_atsys::cSignale::sig_istgang_idx" TAB_VERB "%4.0" "" COMPU_TAB_REF Conv.zff_atsys._.cSignale._.sig_istgang_idx_S6_S3 /end COMPU_METHOD
/begin COMPU_METHOD Conv.zff_atsys._.cSignale._.sig_istgang_vorw_S6_S3 "Umrechnung fuer Messgroesse zff_atsys::cSignale::sig_istgang_vorw" TAB_VERB "%4.0" "" COMPU_TAB_REF Conv.zff_atsys._.cSignale._.sig_istgang_vorw_S6_S3 /end COMPU_METHOD
/begin COMPU_METHOD Conv.zff_atsys._.cSignale._.sig_zielgang_S6_S3 "Umrechnung fuer Messgroesse zff_atsys::cSignale::sig_zielgang" TAB_VERB "%4.0" "" COMPU_TAB_REF Conv.zff_atsys._.cSignale._.sig_zielgang_S6_S3 /end COMPU_METHOD
/begin COMPU_METHOD Conv.zff_atsys._.cSignale._.sig_zielgang_idx_S6_S3 "Umrechnung fuer Messgroesse zff_atsys::cSignale::sig_zielgang_idx" TAB_VERB "%4.0" "" COMPU_TAB_REF Conv.zff_atsys._.cSignale._.sig_zielgang_idx_S6_S3 /end COMPU_METHOD
/begin COMPU_METHOD Conv.zff_atsys._.cSignale._.sig_zielgang_vorw_S6_S3 "Umrechnung fuer Messgroesse zff_atsys::cSignale::sig_zielgang_vorw" TAB_VERB "%4.0" "" COMPU_TAB_REF Conv.zff_atsys._.cSignale._.sig_zielgang_vorw_S6_S3 /end COMPU_METHOD
/begin COMPU_METHOD Conv.zff_atsys._.cSignale._.sig_zielgang_sas_S6_S3 "Umrechnung fuer Messgroesse zff_atsys::cSignale::sig_zielgang_sas" TAB_VERB "%4.0" "" COMPU_TAB_REF Conv.zff_atsys._.cSignale._.sig_zielgang_sas_S6_S3 /end COMPU_METHOD
/begin COMPU_METHOD Conv.zff_atsys._.cSignale._.sig_zielgang_sas_idx_S6_S3 "Umrechnung fuer Messgroesse zff_atsys::cSignale::sig_zielgang_sas_idx" TAB_VERB "%4.0" "" COMPU_TAB_REF Conv.zff_atsys._.cSignale._.sig_zielgang_sas_idx_S6_S3 /end COMPU_METHOD
/begin COMPU_METHOD Conv.zff_atsys._.cSignale._.sig_zielgang_sas_vorw_S6_S3 "Umrechnung fuer Messgroesse zff_atsys::cSignale::sig_zielgang_sas_vorw" TAB_VERB "%4.0" "" COMPU_TAB_REF Conv.zff_atsys._.cSignale._.sig_zielgang_sas_vorw_S6_S3 /end COMPU_METHOD
/begin COMPU_METHOD Conv.zff_atsys._.cSignale._.sig_zielgang_sas_komp_S6_S3 "Umrechnung fuer Messgroesse zff_atsys::cSignale::sig_zielgang_sas_komp" TAB_VERB "%4.0" "" COMPU_TAB_REF Conv.zff_atsys._.cSignale._.sig_zielgang_sas_komp_S6_S3 /end COMPU_METHOD
/begin COMPU_METHOD Conv.zff_atsys._.cSignale._.sig_istgang_komp_S6_S3 "Umrechnung fuer Messgroesse zff_atsys::cSignale::sig_istgang_komp" TAB_VERB "%4.0" "" COMPU_TAB_REF Conv.zff_atsys._.cSignale._.sig_istgang_komp_S6_S3 /end COMPU_METHOD
/begin COMPU_METHOD Conv.zff_atsys._.cSignale._.sig_kfl_ist_S6_S3 "Umrechnung fuer Messgroesse zff_atsys::cSignale::sig_kfl_ist" TAB_VERB "%4.0" "" COMPU_TAB_REF Conv.zff_atsys._.cSignale._.sig_kfl_ist_S6_S3 /end COMPU_METHOD
/begin COMPU_METHOD Conv.zff_atsys._.cSignale._.sig_kfl_ziel_S6_S3 "Umrechnung fuer Messgroesse zff_atsys::cSignale::sig_kfl_ziel" TAB_VERB "%4.0" "" COMPU_TAB_REF Conv.zff_atsys._.cSignale._.sig_kfl_ziel_S6_S3 /end COMPU_METHOD
/begin COMPU_VTAB eIepZust_S6_S3 "" TAB_VERB 7 0 "AUS" 1 "SLEEP" 2 "LP1" 3 "LP2" 4 "LP3" 5 "MANUELL" 6 "FEHLER" /end COMPU_VTAB
/begin COMPU_VTAB eIepIst_S6_S3 "" TAB_VERB 5 0 "AUS" 1 "SLEEP" 2 "LP1" 3 "LP2" 4 "LP3" /end COMPU_VTAB
/begin COMPU_VTAB eIepSoll_S6_S3 "" TAB_VERB 4 0 "AUS" 1 "LP1" 2 "LP2" 3 "LP3" /end COMPU_VTAB
/begin COMPU_VTAB eBool_true_false_S6_S3 "" TAB_VERB 2 0 "FALSE" 1 "TRUE" /end COMPU_VTAB
/begin COMPU_VTAB Conv.cBasFehlerErfolgInt._.flag_fehler_S6_S3 "Umrechnung fuer Messgroesse cBasFehlerErfolgInt::flag_fehler" TAB_VERB 2 0 "keine Fehler vorhanden" 1 "Fehler vorhanden" /end COMPU_VTAB
/begin COMPU_VTAB Conv.cBasFehlerErfolgFl._.flag_fehler_S6_S3 "Umrechnung fuer Messgroesse cBasFehlerErfolgFl::flag_fehler" TAB_VERB 2 0 "keine Fehler vorhanden" 1 "Fehler vorhanden" /end COMPU_VTAB
/begin COMPU_VTAB Conv.cUl2K0SPlausiInt._.n_diff_k0_einmalig_S6_S3 "Umrechnung fuer Messgroesse cUl2K0SPlausiInt::n_diff_k0_einmalig" TAB_VERB 2 0 "Ueberwachen NICHT aktiv" 1 "Ueberwachen aktiv" /end COMPU_VTAB
/begin COMPU_VTAB Conv.cUl2K0SPlausiInt._.st_fehler_S6_S3 "Umrechnung fuer Messgroesse cUl2K0SPlausiInt::st_fehler" TAB_VERB 3 0 "ST_FEHLER_UNDEFINIERT_INT" 1 "ST_FEHLER_NICHT_VORHANDEN_INT" 2 "ST_FEHLER_VORHANDEN_INT" /end COMPU_VTAB
/begin COMPU_VTAB Conv.cUl2K0SStatusInt._.status_k0_alt_S6_S3 "Umrechnung fuer Messgroesse cUl2K0SStatusInt::status_k0_alt" TAB_VERB 6 0 "K0 offen" 1 "K0 Angelegt" 2 "K0 Druckstellung" 3 "K0 Schlupfgeregelt" 4 "K0 Geregelt Geschlossen" 5 "K0 Geschlossen" /end COMPU_VTAB
/begin COMPU_VTAB Conv.cUl2K0SStatusInt._.fehler_ungewolltes_schliessen_S6_S3 "Umrechnung fuer Messgroesse cUl2K0SStatusInt::fehler_ungewolltes_schliessen" TAB_VERB 2 0 "kein Fehler" 1 "Fehler" /end COMPU_VTAB
/begin COMPU_VTAB Conv.cUl2K0SStatusInt._.fehler_kein_oeffnen_S6_S3 "Umrechnung fuer Messgroesse cUl2K0SStatusInt::fehler_kein_oeffnen" TAB_VERB 2 0 "kein Fehler" 1 "Fehler" /end COMPU_VTAB
/begin COMPU_VTAB Conv.cUl2PosNPlRbm._.flag_rbm_zustand_posn_S6_S3 "Umrechnung fuer Messgroesse cUl2PosNPlRbm::flag_rbm_zustand_posn" TAB_VERB 2 0 "Betriebszustand nicht erfuellt" 1 "Betriebszustand erfuellt" /end COMPU_VTAB
/begin COMPU_VTAB Conv.cUl2PosNPlInt._.f_phase_b_aktiv_S6_S3 "Umrechnung fuer Messgroesse cUl2PosNPlInt::f_phase_b_aktiv" TAB_VERB 2 0 "Ueberwachung prueft Phase A" 1 "Ueberwachung prueft Phase B" /end COMPU_VTAB
/begin COMPU_VTAB Conv.cUl2PosNPlFl._.f_phase_b_aktiv_S6_S3 "Umrechnung fuer Messgroesse cUl2PosNPlFl::f_phase_b_aktiv" TAB_VERB 2 0 "Ueberwachung prueft Phase A" 1 "Ueberwachung prueft Phase B" /end COMPU_VTAB
/begin COMPU_VTAB Conv.cUl2BasisKupDruckAnstInt._.kup_nr_S6_S3 "Umrechnung fuer Messgroesse cUl2BasisKupDruckAnstInt::kup_nr" TAB_VERB 5 1 "Kupplung A" 2 "Kupplung B" 3 "Kupplung C" 4 "Kupplung D" 5 "Kupplung E" /end COMPU_VTAB
/begin COMPU_VTAB Conv.cUl2BasisKupDruckAnstInt._.zustand_soll_S6_S3 "Umrechnung fuer Messgroesse cUl2BasisKupDruckAnstInt::zustand_soll" TAB_VERB 3 0 "Kupplung Offen" 1 "Kupplung Unbestimmt" 2 "Kupplung Geschlossen" /end COMPU_VTAB
/begin COMPU_VTAB Conv.cUl2KupDruckAnstInt._.zustand_ist_S6_S3 "Umrechnung fuer Messgroesse cUl2KupDruckAnstInt::zustand_ist" TAB_VERB 3 0 "Kupplung Offen" 1 "Kupplung Unbestimmt" 2 "Kupplung Geschlossen" /end COMPU_VTAB
/begin COMPU_VTAB Conv.cUl2KupIaeDruckAnstInt._.zustand_ist_S6_S3 "Umrechnung fuer Messgroesse cUl2KupIaeDruckAnstInt::zustand_ist" TAB_VERB 3 0 "Kupplung Offen" 1 "Kupplung Unbestimmt" 2 "Kupplung Geschlossen" /end COMPU_VTAB
/begin COMPU_VTAB Conv.cUl2IGetrPlausiDatenInt._.falsche_schaltung_S6_S3 "Umrechnung fuer Messgroesse cUl2IGetrPlausiDatenInt::falsche_schaltung" TAB_VERB 2 0 "keine falsche Schaltung" 1 "Falsche Schaltung" /end COMPU_VTAB
/begin COMPU_VTAB Conv.cUl2IGetrPlausiZustandInt._.i_set_plausible_S6_S3 "Umrechnung fuer Messgroesse cUl2IGetrPlausiZustandInt::i_set_plausible" TAB_VERB 7 0 "Verschachtelte Schaltung(5 Kuppplungen beteiligt) / undefiniert" 1 "Schaltung" 2 "Gang" 3 "GE GA NIC..." 4 "Verschachtelung 4 Kup beteiligt" 5 "Reversieren" 255 "Fehler" /end COMPU_VTAB
/begin COMPU_VTAB Conv.cUl2IGetrPlausiZustandInt._.zustand_S6_S3 "Umrechnung fuer Messgroesse cUl2IGetrPlausiZustandInt::zustand" TAB_VERB 8 0 "Verschachtelte Schaltung(5 Kuppplungen beteiligt) / undefiniert" 1 "Schaltung" 2 "Gang" 3 "GE GA NIC..." 4 "Verschachtelung 4 Kup beteiligt" 5 "Reversieren" 10 "Gang mit Adaption" 255 "Fehler" /end COMPU_VTAB
/begin COMPU_VTAB Conv.cUl2IGetrPlausiZustandInt._.gang_anst_S6_S3 "Umrechnung fuer Messgroesse cUl2IGetrPlausiZustandInt::gang_anst" TAB_VERB 2 0 "Gangansteuerung nicht erkannt" 1 "Gangansteuerung erkannt" /end COMPU_VTAB
/begin COMPU_VTAB Conv.cUl2IGetrPlausiZustandInt._.gang_anst_plausibel_S6_S3 "Umrechnung fuer Messgroesse cUl2IGetrPlausiZustandInt::gang_anst_plausibel" TAB_VERB 2 0 "Gangansteuerung nicht plausibel" 1 "Gangansteuerung plausibel" /end COMPU_VTAB
/begin COMPU_VTAB Conv.cUl2IGetrPlausiZustandInt._.gang_pulsen_anst_plausibel_S6_S3 "Umrechnung fuer Messgroesse cUl2IGetrPlausiZustandInt::gang_pulsen_anst_plausibel" TAB_VERB 2 0 "Gangansteuerung mit Pulsen nicht plausibel" 1 "Gangansteuerung mit Pulsen plausibel" /end COMPU_VTAB
/begin COMPU_VTAB Conv.cUl2IGetrPlausiZustandInt._.ge_ga_anst_plausibel_S6_S3 "Umrechnung fuer Messgroesse cUl2IGetrPlausiZustandInt::ge_ga_anst_plausibel" TAB_VERB 2 0 "GE/GA/NIC Ansteuerung nicht plausibel" 1 "GE/GA/NIC Ansteuerung plausibel" /end COMPU_VTAB
/begin COMPU_VTAB Conv.cUl2IGetrPlausiZustandInt._.reversieren_anst_S6_S3 "Umrechnung fuer Messgroesse cUl2IGetrPlausiZustandInt::reversieren_anst" TAB_VERB 2 0 "Ansteuerung nicht plausibel" 1 "Ansteuerung plausibel" /end COMPU_VTAB
/begin COMPU_VTAB Conv.cUl2IGetrPlausiZustandInt._.schalt_anst_plausibel_S6_S3 "Umrechnung fuer Messgroesse cUl2IGetrPlausiZustandInt::schalt_anst_plausibel" TAB_VERB 2 0 "Schaltungsansteuerung nicht plausibel" 1 "Schaltungsansteuerung plausibel" /end COMPU_VTAB
/begin COMPU_VTAB Conv.cUl2IGetrPlausiZustandInt._.end_schalt_anst_plausibel_S6_S3 "Umrechnung fuer Messgroesse cUl2IGetrPlausiZustandInt::end_schalt_anst_plausibel" TAB_VERB 2 0 "Ende einer Schaltung: Ansteuerung nicht plausibel" 1 "Ende einer Schaltung: Ansteuerung plausibel" /end COMPU_VTAB
/begin COMPU_VTAB Conv.cUl2IGetrPlausiZustandInt._.versch_4_anst_plausibel_S6_S3 "Umrechnung fuer Messgroesse cUl2IGetrPlausiZustandInt::versch_4_anst_plausibel" TAB_VERB 2 0 "4 Kupplung nicht auf Kein Druck: Ansteuerung nicht plausibel" 1 "4 Kupplung nicht auf Kein Druck: Ansteuerung plausibel" /end COMPU_VTAB
/begin COMPU_VTAB Conv.cUl2IGetrPlausiZustandInt._.schalt_err_anst_S6_S3 "Umrechnung fuer Messgroesse cUl2IGetrPlausiZustandInt::schalt_err_anst" TAB_VERB 2 0 "keine falsche Ansteuerung im Schaltung 4 Kup beteiligt" 1 "Falsche Ansteuerung im Schaltung 4 Kup beteiligt" /end COMPU_VTAB
/begin COMPU_VTAB Conv.cUl2IGetrPlausiZustandInt._.schalt_err_anst_3_kup_S6_S3 "Umrechnung fuer Messgroesse cUl2IGetrPlausiZustandInt::schalt_err_anst_3_kup" TAB_VERB 2 0 "keine falsche Ansteuerung im Schaltung 3 Kup beteiligt" 1 "Falsche Ansteuerung im Schaltung 3 Kup beteiligt" /end COMPU_VTAB
/begin COMPU_VTAB Conv.cUl2IGetrPlausiZustandInt._.pos_alt_S6_S3 "Umrechnung fuer Messgroesse cUl2IGetrPlausiZustandInt::pos_alt" TAB_VERB 9 0 "Pos. 1" 1 "Pos. 2" 2 "Pos. 3" 3 "Pos. 4" 4 "Pos. 5" 5 "Pos. D" 6 "Pos. N" 7 "Pos. R" 8 "Pos. P" /end COMPU_VTAB
/begin COMPU_VTAB Conv.cUl2IGetrPlausiZustandInt._.pos_revn_start_S6_S3 "Umrechnung fuer Messgroesse cUl2IGetrPlausiZustandInt::pos_revn_start" TAB_VERB 9 0 "Pos. 1" 1 "Pos. 2" 2 "Pos. 3" 3 "Pos. 4" 4 "Pos. 5" 5 "Pos. D" 6 "Pos. N" 7 "Pos. R" 8 "Pos. P" /end COMPU_VTAB
/begin COMPU_VTAB Conv.cUl2NegMeSigInt._.stoerung_sig_abs_neg_me_S6_S3 "Umrechnung fuer Messgroesse cUl2NegMeSigInt::stoerung_sig_abs_neg_me" TAB_VERB 2 0 "Keine Fehler bei abs. neg. ME Signal" 1 "Fehler in abs. neg. ME Signal" /end COMPU_VTAB
/begin COMPU_VTAB Conv.cUl2NegMeSigInt._.stoerung_sig_rel_neg_me_S6_S3 "Umrechnung fuer Messgroesse cUl2NegMeSigInt::stoerung_sig_rel_neg_me" TAB_VERB 2 0 "Keine Fehler bei rel. neg. ME Signal" 1 "Fehler in rel. neg. ME Signal" /end COMPU_VTAB
/begin COMPU_VTAB Conv.cUl2NegMeSigFl._.stoerung_sig_abs_neg_me_S6_S3 "Umrechnung fuer Messgroesse cUl2NegMeSigFl::stoerung_sig_abs_neg_me" TAB_VERB 2 0 "Keine Fehler bei abs. neg. ME" 1 "Fehler in abs. neg. ME" /end COMPU_VTAB
/begin COMPU_VTAB Conv.cUl2NegMeSigFl._.stoerung_sig_rel_neg_me_S6_S3 "Umrechnung fuer Messgroesse cUl2NegMeSigFl::stoerung_sig_rel_neg_me" TAB_VERB 2 0 "Keine Fehler bei rel. neg. ME" 1 "Fehler in rel. neg. ME" /end COMPU_VTAB
/begin COMPU_VTAB Conv.cUl2NegMeIntenInt._.stoerung_int_abs_neg_me_S6_S3 "Umrechnung fuer Messgroesse cUl2NegMeIntenInt::stoerung_int_abs_neg_me" TAB_VERB 2 0 "Keine Fehler bei abs. neg. ME Intensität" 1 "Fehler in abs. neg. ME Intensität" /end COMPU_VTAB
/begin COMPU_VTAB Conv.cUl2NegMeIntenInt._.stoerung_int_rel_neg_me_S6_S3 "Umrechnung fuer Messgroesse cUl2NegMeIntenInt::stoerung_int_rel_neg_me" TAB_VERB 2 0 "Keine Fehler bei rel. neg. ME Intensität" 1 "Fehler in rel. neg. ME Intensität" /end COMPU_VTAB
/begin COMPU_VTAB Conv.cUl2NegMeIntenFl._.stoerung_int_abs_neg_me_S6_S3 "Umrechnung fuer Messgroesse cUl2NegMeIntenFl::stoerung_int_abs_neg_me" TAB_VERB 2 0 "Keine Fehler bei abs. neg. ME Intensität" 1 "Fehler in abs. neg. ME Intensität" /end COMPU_VTAB
/begin COMPU_VTAB Conv.cUl2NegMeIntenFl._.stoerung_int_rel_neg_me_S6_S3 "Umrechnung fuer Messgroesse cUl2NegMeIntenFl::stoerung_int_rel_neg_me" TAB_VERB 2 0 "Keine Fehler bei rel. neg. ME Intensität" 1 "Fehler in rel. neg. ME Intensität" /end COMPU_VTAB
/begin COMPU_VTAB Conv.cUl2PosMeSigInt._.stoerung_sig_abs_pos_me_S6_S3 "Umrechnung fuer Messgroesse cUl2PosMeSigInt::stoerung_sig_abs_pos_me" TAB_VERB 2 0 "Keine Fehler bei abs. pos. ME Signal" 1 "Fehler in abs. pos. ME Signal" /end COMPU_VTAB
/begin COMPU_VTAB Conv.cUl2PosMeSigInt._.stoerung_sig_rel_pos_me_S6_S3 "Umrechnung fuer Messgroesse cUl2PosMeSigInt::stoerung_sig_rel_pos_me" TAB_VERB 2 0 "Keine Fehler bei rel. pos. ME Signal" 1 "Fehler in rel. pos. ME Signal" /end COMPU_VTAB
/begin COMPU_VTAB Conv.cUl2PosMeSigFl._.stoerung_sig_abs_pos_me_S6_S3 "Umrechnung fuer Messgroesse cUl2PosMeSigFl::stoerung_sig_abs_pos_me" TAB_VERB 2 0 "Keine Fehler bei abs. pos. ME Signal" 1 "Fehler in abs. pos. ME Signal" /end COMPU_VTAB
/begin COMPU_VTAB Conv.cUl2PosMeSigFl._.stoerung_sig_rel_pos_me_S6_S3 "Umrechnung fuer Messgroesse cUl2PosMeSigFl::stoerung_sig_rel_pos_me" TAB_VERB 2 0 "Keine Fehler bei rel. pos. ME Signal" 1 "Fehler in rel. pos. ME Signal" /end COMPU_VTAB
/begin COMPU_VTAB Conv.cUl2PosMeGradientInt._.stoerung_grad_abs_me_S6_S3 "Umrechnung fuer Messgroesse cUl2PosMeGradientInt::stoerung_grad_abs_me" TAB_VERB 2 0 "Keine Fehler bei ME abs. Gradienten" 1 "Fehler in ME abs. Gradienten" /end COMPU_VTAB
/begin COMPU_VTAB Conv.cUl2PosMeGradientInt._.stoerung_grad_rel_me_S6_S3 "Umrechnung fuer Messgroesse cUl2PosMeGradientInt::stoerung_grad_rel_me" TAB_VERB 2 0 "Keine Fehler bei ME rel. Gradienten" 1 "Fehler in ME rel. Gradienten" /end COMPU_VTAB
/begin COMPU_VTAB Conv.cUl2PosMeGradientFl._.stoerung_grad_abs_me_S6_S3 "Umrechnung fuer Messgroesse cUl2PosMeGradientFl::stoerung_grad_abs_me" TAB_VERB 2 0 "Keine Fehler bei ME abs. Gradienten" 1 "Fehler in ME abs. Gradienten" /end COMPU_VTAB
/begin COMPU_VTAB Conv.cUl2PosMeGradientFl._.stoerung_grad_rel_me_S6_S3 "Umrechnung fuer Messgroesse cUl2PosMeGradientFl::stoerung_grad_rel_me" TAB_VERB 2 0 "Keine Fehler bei ME rel. Gradienten" 1 "Fehler in ME rel. Gradienten" /end COMPU_VTAB
/begin COMPU_VTAB Conv.cUl2PosMeIntenInt._.schwellen_variante_S6_S3 "Umrechnung fuer Messgroesse cUl2PosMeIntenInt::schwellen_variante" TAB_VERB 2 1 "Variante 1 mit KL_MMOTUEBPOSME1 und N_MAXSTOERPOSMEINT1" 2 "Variante 2 mit KL_MMOTUEBPOSME2 und N_MAXSTOERPOSMEINT2" /end COMPU_VTAB
/begin COMPU_VTAB Conv.cUl2PosMeIntenInt._.stoerung_int_abs_pos_me_S6_S3 "Umrechnung fuer Messgroesse cUl2PosMeIntenInt::stoerung_int_abs_pos_me" TAB_VERB 2 0 "Keine Fehler bei abs. pos. ME Intensität" 1 "Fehler in abs. pos. ME Intensität" /end COMPU_VTAB
/begin COMPU_VTAB Conv.cUl2PosMeIntenInt._.stoerung_int_rel_pos_me_S6_S3 "Umrechnung fuer Messgroesse cUl2PosMeIntenInt::stoerung_int_rel_pos_me" TAB_VERB 2 0 "Keine Fehler bei rel. pos. ME Intensität" 1 "Fehler in rel. pos. ME Intensität" /end COMPU_VTAB
/begin COMPU_VTAB Conv.cUl2PosMeIntenFl._.schwellen_variante_S6_S3 "Umrechnung fuer Messgroesse cUl2PosMeIntenFl::schwellen_variante" TAB_VERB 2 1 "Variante 1 mit KL_MMOTUEBPOSME1 und N_MAXSTOERPOSMEINT1" 2 "Variante 2 mit KL_MMOTUEBPOSME2 und N_MAXSTOERPOSMEINT2" /end COMPU_VTAB
/begin COMPU_VTAB Conv.cUl2PosMeIntenFl._.stoerung_int_abs_pos_me_S6_S3 "Umrechnung fuer Messgroesse cUl2PosMeIntenFl::stoerung_int_abs_pos_me" TAB_VERB 2 0 "Keine Fehler bei abs. pos. ME Intensitaet" 1 "Fehler in abs. pos. ME Intensität" /end COMPU_VTAB
/begin COMPU_VTAB Conv.cUl2PosMeIntenFl._.stoerung_int_rel_pos_me_S6_S3 "Umrechnung fuer Messgroesse cUl2PosMeIntenFl::stoerung_int_rel_pos_me" TAB_VERB 2 0 "Keine Fehler bei rel. pos. ME Intensitaet" 1 "Fehler in rel. pos. ME Intensität" /end COMPU_VTAB
/begin COMPU_VTAB Conv.cUl2PosMeIntenIGangInt._.err_abs_me_igang_S6_S3 "Umrechnung fuer Messgroesse cUl2PosMeIntenIGangInt::err_abs_me_igang" TAB_VERB 2 0 "FALSE" 1 "TRUE" /end COMPU_VTAB
/begin COMPU_VTAB Conv.cUl2PosMeIntenIGangInt._.err_rel_me_igang_S6_S3 "Umrechnung fuer Messgroesse cUl2PosMeIntenIGangInt::err_rel_me_igang" TAB_VERB 2 0 "FALSE" 1 "TRUE" /end COMPU_VTAB
/begin COMPU_VTAB Conv.cUl2PosMeIntenIGangFl._.err_abs_me_igang_S6_S3 "Umrechnung fuer Messgroesse cUl2PosMeIntenIGangFl::err_abs_me_igang" TAB_VERB 2 0 "0.0f" 1 "1.0f" /end COMPU_VTAB
/begin COMPU_VTAB Conv.cUl2PosMeIntenIGangFl._.err_rel_me_igang_S6_S3 "Umrechnung fuer Messgroesse cUl2PosMeIntenIGangFl::err_rel_me_igang" TAB_VERB 2 0 "0.0f" 1 "1.0f" /end COMPU_VTAB
/begin COMPU_VTAB Conv.cUl2PosMeIntenKoordInt._.err_int_pos_me_S6_S3 "Umrechnung fuer Messgroesse cUl2PosMeIntenKoordInt::err_int_pos_me" TAB_VERB 2 0 "Keine Fehler bei Intensitaet pos. ME" 1 "Fehler in Intensitaet pos. ME" /end COMPU_VTAB
/begin COMPU_VTAB Conv.cUl2PosMeIntenKoordInt._.err_int_pos_me_abs_S6_S3 "Umrechnung fuer Messgroesse cUl2PosMeIntenKoordInt::err_int_pos_me_abs" TAB_VERB 2 0 "FALSE" 1 "TRUE" /end COMPU_VTAB
/begin COMPU_VTAB Conv.cUl2PosMeIntenKoordInt._.err_int_pos_me_rel_S6_S3 "Umrechnung fuer Messgroesse cUl2PosMeIntenKoordInt::err_int_pos_me_rel" TAB_VERB 2 0 "FALSE" 1 "TRUE" /end COMPU_VTAB
/begin COMPU_VTAB Conv.cUl2PosMeIntenKoordFl._.err_int_pos_me_S6_S3 "Umrechnung fuer Messgroesse cUl2PosMeIntenKoordFl::err_int_pos_me" TAB_VERB 2 0 "Keine Fehler bei Intensitaet pos. ME" 1 "Fehler in Intensitaet pos. ME" /end COMPU_VTAB
/begin COMPU_VTAB Conv.cUl2PosMeIntenKoordFl._.err_int_pos_me_abs_S6_S3 "Umrechnung fuer Messgroesse cUl2PosMeIntenKoordFl::err_int_pos_me_abs" TAB_VERB 2 0 "0.0f" 1 "1.0f" /end COMPU_VTAB
/begin COMPU_VTAB Conv.cUl2PosMeIntenKoordFl._.err_int_pos_me_rel_S6_S3 "Umrechnung fuer Messgroesse cUl2PosMeIntenKoordFl::err_int_pos_me_rel" TAB_VERB 2 0 "0.0f" 1 "1.0f" /end COMPU_VTAB
/begin COMPU_VTAB Conv.cUl2MeKoordInt._.err_pos_me_S6_S3 "Umrechnung fuer Messgroesse cUl2MeKoordInt::err_pos_me" TAB_VERB 2 0 "Keine Fehler bei pos. ME" 1 "Fehler in pos. ME" /end COMPU_VTAB
/begin COMPU_VTAB Conv.cUl2MeKoordInt._.err_neg_me_S6_S3 "Umrechnung fuer Messgroesse cUl2MeKoordInt::err_neg_me" TAB_VERB 2 0 "Keine Fehler bei neg. ME" 1 "Fehler in neg. ME" /end COMPU_VTAB
/begin COMPU_VTAB Conv.cUl2MeKoordInt._.err_abs_me_S6_S3 "Umrechnung fuer Messgroesse cUl2MeKoordInt::err_abs_me" TAB_VERB 2 0 "FALSE" 1 "TRUE" /end COMPU_VTAB
/begin COMPU_VTAB Conv.cUl2MeKoordInt._.err_rel_me_S6_S3 "Umrechnung fuer Messgroesse cUl2MeKoordInt::err_rel_me" TAB_VERB 2 0 "FALSE" 1 "TRUE" /end COMPU_VTAB
/begin COMPU_VTAB Conv.cUl2MeKoordInt._.err_sig_pos_me_S6_S3 "Umrechnung fuer Messgroesse cUl2MeKoordInt::err_sig_pos_me" TAB_VERB 2 0 "FALSE" 1 "TRUE" /end COMPU_VTAB
/begin COMPU_VTAB Conv.cUl2MeKoordInt._.err_me_igang_S6_S3 "Umrechnung fuer Messgroesse cUl2MeKoordInt::err_me_igang" TAB_VERB 2 0 "Keine Fehler bei pos. ME Intensität im Gang" 1 "Fehler in pos. ME Intensität im Gang" /end COMPU_VTAB
/begin COMPU_VTAB Conv.cUl2MeKoordInt._.err_grad_pos_me_S6_S3 "Umrechnung fuer Messgroesse cUl2MeKoordInt::err_grad_pos_me" TAB_VERB 2 0 "FALSE" 1 "TRUE" /end COMPU_VTAB
/begin COMPU_VTAB Conv.cUl2MeKoordInt._.err_sig_neg_me_S6_S3 "Umrechnung fuer Messgroesse cUl2MeKoordInt::err_sig_neg_me" TAB_VERB 2 0 "FALSE" 1 "TRUE" /end COMPU_VTAB
/begin COMPU_VTAB Conv.cUl2MeKoordInt._.err_int_neg_me_S6_S3 "Umrechnung fuer Messgroesse cUl2MeKoordInt::err_int_neg_me" TAB_VERB 2 0 "FALSE" 1 "TRUE" /end COMPU_VTAB
/begin COMPU_VTAB Conv.cUl2MeKoordFl._.err_pos_me_S6_S3 "Umrechnung fuer Messgroesse cUl2MeKoordFl::err_pos_me" TAB_VERB 2 0 "Keine Fehler bei pos. ME" 1 "Fehler in pos. ME" /end COMPU_VTAB
/begin COMPU_VTAB Conv.cUl2MeKoordFl._.err_neg_me_S6_S3 "Umrechnung fuer Messgroesse cUl2MeKoordFl::err_neg_me" TAB_VERB 2 0 "Keine Fehler bei neg. ME" 1 "Fehler in neg. ME" /end COMPU_VTAB
/begin COMPU_VTAB Conv.cUl2MeKoordFl._.err_abs_me_S6_S3 "Umrechnung fuer Messgroesse cUl2MeKoordFl::err_abs_me" TAB_VERB 2 0 "Keine Fehler bei abs. ME" 1 "Fehler in abs. ME" /end COMPU_VTAB
/begin COMPU_VTAB Conv.cUl2MeKoordFl._.err_rel_me_S6_S3 "Umrechnung fuer Messgroesse cUl2MeKoordFl::err_rel_me" TAB_VERB 2 0 "Keine Fehler bei rel. ME" 1 "Fehler in rel. ME" /end COMPU_VTAB
/begin COMPU_VTAB Conv.cUl2MeKoordFl._.err_me_igang_S6_S3 "Umrechnung fuer Messgroesse cUl2MeKoordFl::err_me_igang" TAB_VERB 2 0 "Keine Fehler bei pos. ME Intensitaet im Gang" 1 "Fehler in pos. ME Intensitaet im Gang" /end COMPU_VTAB
/begin COMPU_VTAB Conv.cUl2NmotuInt._.pruefbed_nmotueb_l2_S6_S3 "Umrechnung fuer Messgroesse cUl2NmotuInt::pruefbed_nmotueb_l2" TAB_VERB 2 0 "NMOTUEB Puefbed. NICHT erfuellt" 1 "NMOTUEB Puefbed. erfuellt" /end COMPU_VTAB
/begin COMPU_VTAB Conv.cUl2NmotuInt._.pos_alt_S6_S3 "Umrechnung fuer Messgroesse cUl2NmotuInt::pos_alt" TAB_VERB 9 0 "Pos. 1" 1 "Pos. 2" 2 "Pos. 3" 3 "Pos. 4" 4 "Pos. 5" 5 "Pos. D" 6 "Pos. N" 7 "Pos. R" 8 "Pos. P" /end COMPU_VTAB
/begin COMPU_VTAB Conv.cUl2NmotuInt._.z_nmotabreg_l2_S6_S3 "Umrechnung fuer Messgroesse cUl2NmotuInt::z_nmotabreg_l2" TAB_VERB 3 0 "N_Mot-Abregeldrehzahl statisch konstant" 1 "Verzoegerung der Reduzierung der N_Mot-Abregeldrehzahl" 2 "Reduzierung der N_Mot-Abregeldrehzahl durch Minwertnachfuehrung aktiv" /end COMPU_VTAB
/begin COMPU_VTAB Conv.cUl2NmotuInt._.z_nt_max_zg_l2_S6_S3 "Umrechnung fuer Messgroesse cUl2NmotuInt::z_nt_max_zg_l2" TAB_VERB 3 0 "Zielgangabhaengige N_T-Grenzdrehzahl statisch konstant" 1 "Verzoegerung der Reduzierung der N_T-Grenzdrehzahl" 2 "Reduzierung der N_T-Grenzdrehzahl durch Minwertnachfuehrung aktiv" /end COMPU_VTAB
/begin COMPU_VTAB Conv.cUl2NmotuInt._.ntmaxzg_verz_aktiv_S6_S3 "Umrechnung fuer Messgroesse cUl2NmotuInt::ntmaxzg_verz_aktiv" TAB_VERB 2 0 "keine Verzoegerung der Zielgangabhaengige N_T-Grenzdrehzahl bei Reduzierung aktiv" 1 "Verzoegerung der Zielgangabhaengige N_T-Grenzdrehzahl bei Reduzierung aktiv" /end COMPU_VTAB
/begin COMPU_VTAB Conv.cUl2NmotuInt._.dsc_fehler_alt_S6_S3 "Umrechnung fuer Messgroesse cUl2NmotuInt::dsc_fehler_alt" TAB_VERB 2 0 "im vorherigen Programmzyklus lag KEIN DSC-Fehler vor" 1 "im vorherigen Programmzyklus lag ein DSC-Fehler vor" /end COMPU_VTAB
/begin COMPU_VTAB Conv.cUl2NmotuInt._.zielgang_sas_alt_l2_S6_S3 "Umrechnung fuer Messgroesse cUl2NmotuInt::zielgang_sas_alt_l2" TAB_VERB 10 -1 "GR1" 0 "KEIN_GANG" 1 "G1" 2 "G2" 3 "G3" 4 "G4" 5 "G5" 6 "G6" 7 "G7" 8 "G8" /end COMPU_VTAB
/begin COMPU_VTAB Conv.cUl2NmotuFl._.pruefbed_nmotueb_l2_S6_S3 "Umrechnung fuer Messgroesse cUl2NmotuFl::pruefbed_nmotueb_l2" TAB_VERB 2 0 "NMOTUEB Puefbed. NICHT erfuellt" 1 "NMOTUEB Puefbed. erfuellt" /end COMPU_VTAB
/begin COMPU_VTAB Conv.cUl2NmotuFl._.z_nmotabreg_l2_S6_S3 "Umrechnung fuer Messgroesse cUl2NmotuFl::z_nmotabreg_l2" TAB_VERB 3 0 "N_Mot-Abregeldrehzahl statisch konstant" 1 "Verzoegerung der Reduzierung der N_Mot-Abregeldrehzahl" 2 "Reduzierung der N_Mot-Abregeldrehzahl durch Minwertnachfuehrung aktiv" /end COMPU_VTAB
/begin COMPU_VTAB Conv.cUl2NmotuFl._.z_nt_max_zg_l2_S6_S3 "Umrechnung fuer Messgroesse cUl2NmotuFl::z_nt_max_zg_l2" TAB_VERB 3 0 "Zielgangabhaengige N_T-Grenzdrehzahl statisch konstant" 1 "Verzoegerung der Reduzierung der N_T-Grenzdrehzahl" 2 "Reduzierung der N_T-Grenzdrehzahl durch Minwertnachfuehrung aktiv" /end COMPU_VTAB
/begin COMPU_VTAB Conv.cUl2NmotuFl._.ntmaxzg_verz_aktiv_S6_S3 "Umrechnung fuer Messgroesse cUl2NmotuFl::ntmaxzg_verz_aktiv" TAB_VERB 2 0 "keine Verzoegerung der Zielgangabhaengige N_T-Grenzdrehzahl bei Reduzierung aktiv" 1 "Verzoegerung der Zielgangabhaengige N_T-Grenzdrehzahl bei Reduzierung aktiv" /end COMPU_VTAB
/begin COMPU_VTAB Conv.cUl2NmotuFl._.dsc_fehler_alt_S6_S3 "Umrechnung fuer Messgroesse cUl2NmotuFl::dsc_fehler_alt" TAB_VERB 2 0 "im vorherigen Programmzyklus lag KEIN DSC-Fehler vor" 1 "im vorherigen Programmzyklus lag ein DSC-Fehler vor" /end COMPU_VTAB
/begin COMPU_VTAB Conv.cUl2NmotuFl._.zielgang_sas_alt_l2_S6_S3 "Umrechnung fuer Messgroesse cUl2NmotuFl::zielgang_sas_alt_l2" TAB_VERB 10 -1 "GR1" 0 "KEIN_GANG" 1 "G1" 2 "G2" 3 "G3" 4 "G4" 5 "G5" 6 "G6" 7 "G7" 8 "G8" /end COMPU_VTAB
/begin COMPU_VTAB Conv.cUl2SigItfInputInt._.ers_edsmv_info_S6_S3 "Umrechnung fuer Messgroesse cUl2SigItfInputInt::ers_edsmv_info" TAB_VERB 8 0 "keine edsmv_ersatzinfo" 1 "GRAUS -vorbelegt fuer MECH_NOTLAUF- nur HSS1 aus" 2 "LOWSIDE-OFF -vorbelegt fuer LOWSIDEOFF-" 3 "nicht belegt war mal EL_SIM_NL in der 53 Umsschaltphase" 4 "nicht belegt war mal EL_SIM_NL" 5 "nicht belegt war mal Sonderbestromung Notlauf 2" 6 "nicht relevant fuer ATSYS" 7 "HSS1 und HSS2 aus" /end COMPU_VTAB
/begin COMPU_VTAB Conv.cUl2SigItfInputInt._.kmn_out10lssoff_S6_S3 "Umrechnung fuer Messgroesse cUl2SigItfInputInt::kmn_out10lssoff" TAB_VERB 2 0 "Massnahme inaktiv" 1 "Massnahme aktiv" /end COMPU_VTAB
/begin COMPU_VTAB Conv.cUl2SigItfInputKomp._.ers_edsmv_info_komp_S6_S3 "Umrechnung fuer Messgroesse cUl2SigItfInputKomp::ers_edsmv_info_komp" TAB_VERB 8 255 "keine edsmv_ersatzinfo" 254 "GRAUS -vorbelegt fuer MECH_NOTLAUF- nur HSS1 aus" 253 "LOWSIDE-OFF -vorbelegt fuer LOWSIDEOFF-" 252 "nicht belegt war mal EL_SIM_NL in der 53 Umsschaltphase" 251 "nicht belegt war mal EL_SIM_NL" 250 "nicht belegt war mal Sonderbestromung Notlauf 2" 249 "nicht relevant fuer ATSYS" 248 "HSS1 und HSS2 aus" /end COMPU_VTAB
/begin COMPU_VTAB Conv.cUl2SigItfInputKomp._.kmn_out10lssoff_komp_S6_S3 "Umrechnung fuer Messgroesse cUl2SigItfInputKomp::kmn_out10lssoff_komp" TAB_VERB 2 255 "Massnahme inaktiv" 254 "Massnahme aktiv" /end COMPU_VTAB
/begin COMPU_VTAB Conv.cUewTimerZuendung._.zz_zustand_S6_S3 "Umrechnung fuer Messgroesse cUewTimerZuendung::zz_zustand" TAB_VERB 6 0 "Zustand nach dem Hochfahren der EGS" 1 "warten auf Zündungswechsel nach AUS" 2 "warten auf Zündungswechsel nach EIN (kein Timer erhöhen)" 3 "warten auf NMot Bedingung" 4 "wenn EEPROM frei gegeben den Timer nullen" 5 "wenn EEPROM frei gegeben den Timer erhoehen" /end COMPU_VTAB
/begin COMPU_VTAB Conv.cUewTimerZuendung._.f_keine_egs_offtime_S6_S3 "Umrechnung fuer Messgroesse cUewTimerZuendung::f_keine_egs_offtime" TAB_VERB 2 0 "Offset hinzufügen" 1 "kein Offset hinzufügen" /end COMPU_VTAB
/begin COMPU_VTAB Conv.cUewTimerZuendung._.f_reset_S6_S3 "Umrechnung fuer Messgroesse cUewTimerZuendung::f_reset" TAB_VERB 2 0 "nicht zurücksetzen" 1 "zurücksetzen" /end COMPU_VTAB
/begin COMPU_VTAB Conv.cUewSgetf._.i_edsc_min_S6_S3 "Umrechnung fuer Messgroesse cUewSgetf::i_edsc_min" TAB_VERB 2 0 "Kein min. Bestromung I_EDS Kupplung C" 1 "min. Bestromung I_EDS Kupplung C" /end COMPU_VTAB
/begin COMPU_VTAB Conv.cUewSgetf._.ps_sensor_signal_alt_S6_S3 "Umrechnung fuer Messgroesse cUewSgetf::ps_sensor_signal_alt" TAB_VERB 4 0 "PS_SENSOR_KEIN_P" 1 "PS_SENSOR_P" 2 "PS_SENSOR_Z" 3 "PS_SENSOR_ERR" /end COMPU_VTAB
/begin COMPU_VTAB Conv.cUewSgetf._.ps_sensor_err_S6_S3 "Umrechnung fuer Messgroesse cUewSgetf::ps_sensor_err" TAB_VERB 2 0 "kein Fehler" 1 "Fehler" /end COMPU_VTAB
/begin COMPU_VTAB Conv.cUewSgetf._.zwangsposition_p_S6_S3 "Umrechnung fuer Messgroesse cUewSgetf::zwangsposition_p" TAB_VERB 2 0 "Keine Zwangsposition P" 1 "Zwangsposition P einstellen" /end COMPU_VTAB
/begin COMPU_VTAB Conv.cUewSgetf._.posv_diagnose_aktiv_S6_S3 "Umrechnung fuer Messgroesse cUewSgetf::posv_diagnose_aktiv" TAB_VERB 2 0 "POSV-Ueberwachung ist NICHT aktiv" 1 "POSV-Ueberwachung ist aktiv" /end COMPU_VTAB
/begin COMPU_VTAB Conv.cUewSgetf._.pruefung_posvmechdef_aktiv_S6_S3 "Umrechnung fuer Messgroesse cUewSgetf::pruefung_posvmechdef_aktiv" TAB_VERB 2 0 "POSV-Ueberwachung laeuft nicht" 1 "POSV-Ueberwachung laeuft" /end COMPU_VTAB
/begin COMPU_VTAB Conv.cUewSgetf._.pumpendruck_vorh_posv_uew_alt_S6_S3 "Umrechnung fuer Messgroesse cUewSgetf::pumpendruck_vorh_posv_uew_alt" TAB_VERB 2 0 "pumpendruck_vorh_posv_uew_alt nicht gesetzt" 1 "pumpendruck_vorh_posv_uew_alt gesetzt" /end COMPU_VTAB
/begin COMPU_VTAB Conv.cUewSgetf._.fl_neutral_posvueb_S6_S3 "Umrechnung fuer Messgroesse cUewSgetf::fl_neutral_posvueb" TAB_VERB 2 0 "fl_neutral_posvueb nicht gesetzt" 1 "fl_neutral_posvueb gesetzt" /end COMPU_VTAB
/begin COMPU_VTAB Conv.zff_atsys._.cSignale._.sig_serapflag_S6_S3 "Umrechnung fuer Messgroesse zff_atsys::cSignale::sig_serapflag" TAB_VERB 2 0 "Referenzseite aktiv" 1 "Arbeitsseite aktiv" /end COMPU_VTAB
/begin COMPU_VTAB Conv.zff_atsys._.cSignale._.sig_serapflag_komp_S6_S3 "Umrechnung fuer Messgroesse zff_atsys::cSignale::sig_serapflag_komp" TAB_VERB 2 254 "Referenzseite aktiv" 255 "Arbeitsseite aktiv" /end COMPU_VTAB
/begin COMPU_VTAB Conv.zff_atsys._.cSignale._.sig_e_fahren_S6_S3 "Umrechnung fuer Messgroesse zff_atsys::cSignale::sig_e_fahren" TAB_VERB 2 0 "V_FAHREN_AKTIV" 1 "E_FAHREN_AKTIV" /end COMPU_VTAB
/begin COMPU_VTAB Conv.zff_atsys._.cSignale._.sig_istgang_S6_S3 "Umrechnung fuer Messgroesse zff_atsys::cSignale::sig_istgang" TAB_VERB 10 -1 "GR1" 0 "KEIN_GANG" 1 "G1" 2 "G2" 3 "G3" 4 "G4" 5 "G5" 6 "G6" 7 "G7" 8 "G8" /end COMPU_VTAB
/begin COMPU_VTAB Conv.zff_atsys._.cSignale._.sig_istgang_idx_S6_S3 "Umrechnung fuer Messgroesse zff_atsys::cSignale::sig_istgang_idx" TAB_VERB 10 0 "GR1" 1 "KEIN_GANG" 2 "G1" 3 "G2" 4 "G3" 5 "G4" 6 "G5" 7 "G6" 8 "G7" 9 "G8" /end COMPU_VTAB
/begin COMPU_VTAB Conv.zff_atsys._.cSignale._.sig_istgang_vorw_S6_S3 "Umrechnung fuer Messgroesse zff_atsys::cSignale::sig_istgang_vorw" TAB_VERB 9 0 "KEIN_GANG" 1 "G1" 2 "G2" 3 "G3" 4 "G4" 5 "G5" 6 "G6" 7 "G7" 8 "G8" /end COMPU_VTAB
/begin COMPU_VTAB Conv.zff_atsys._.cSignale._.sig_zielgang_S6_S3 "Umrechnung fuer Messgroesse zff_atsys::cSignale::sig_zielgang" TAB_VERB 10 -1 "GR1" 0 "KEIN_GANG" 1 "G1" 2 "G2" 3 "G3" 4 "G4" 5 "G5" 6 "G6" 7 "G7" 8 "G8" /end COMPU_VTAB
/begin COMPU_VTAB Conv.zff_atsys._.cSignale._.sig_zielgang_idx_S6_S3 "Umrechnung fuer Messgroesse zff_atsys::cSignale::sig_zielgang_idx" TAB_VERB 10 0 "GR1" 1 "KEIN_GANG" 2 "G1" 3 "G2" 4 "G3" 5 "G4" 6 "G5" 7 "G6" 8 "G7" 9 "G8" /end COMPU_VTAB
/begin COMPU_VTAB Conv.zff_atsys._.cSignale._.sig_zielgang_vorw_S6_S3 "Umrechnung fuer Messgroesse zff_atsys::cSignale::sig_zielgang_vorw" TAB_VERB 9 0 "KEIN_GANG" 1 "G1" 2 "G2" 3 "G3" 4 "G4" 5 "G5" 6 "G6" 7 "G7" 8 "G8" /end COMPU_VTAB
/begin COMPU_VTAB Conv.zff_atsys._.cSignale._.sig_zielgang_sas_S6_S3 "Umrechnung fuer Messgroesse zff_atsys::cSignale::sig_zielgang_sas" TAB_VERB 10 -1 "GR1" 0 "KEIN_GANG" 1 "G1" 2 "G2" 3 "G3" 4 "G4" 5 "G5" 6 "G6" 7 "G7" 8 "G8" /end COMPU_VTAB
/begin COMPU_VTAB Conv.zff_atsys._.cSignale._.sig_zielgang_sas_idx_S6_S3 "Umrechnung fuer Messgroesse zff_atsys::cSignale::sig_zielgang_sas_idx" TAB_VERB 10 0 "GR1" 1 "KEIN_GANG" 2 "G1" 3 "G2" 4 "G3" 5 "G4" 6 "G5" 7 "G6" 8 "G7" 9 "G8" /end COMPU_VTAB
/begin COMPU_VTAB Conv.zff_atsys._.cSignale._.sig_zielgang_sas_vorw_S6_S3 "Umrechnung fuer Messgroesse zff_atsys::cSignale::sig_zielgang_sas_vorw" TAB_VERB 9 0 "KEIN_GANG" 1 "G1" 2 "G2" 3 "G3" 4 "G4" 5 "G5" 6 "G6" 7 "G7" 8 "G8" /end COMPU_VTAB
/begin COMPU_VTAB Conv.zff_atsys._.cSignale._.sig_zielgang_sas_komp_S6_S3 "Umrechnung fuer Messgroesse zff_atsys::cSignale::sig_zielgang_sas_komp" TAB_VERB 10 0 "R-Gang" -1 "R_Gang" -2 "1. Gang" -3 "2. Gang" -4 "3. Gang" -5 "4. Gang" -6 "5. Gang" -7 "6. Gang" -8 "7. Gang" -9 "8. Gang" /end COMPU_VTAB
/begin COMPU_VTAB Conv.zff_atsys._.cSignale._.sig_istgang_komp_S6_S3 "Umrechnung fuer Messgroesse zff_atsys::cSignale::sig_istgang_komp" TAB_VERB 10 0 "R-Gang" -1 "R_Gang" -2 "1. Gang" -3 "2. Gang" -4 "3. Gang" -5 "4. Gang" -6 "5. Gang" -7 "6. Gang" -8 "7. Gang" -9 "8. Gang" /end COMPU_VTAB
/begin COMPU_VTAB Conv.zff_atsys._.cSignale._.sig_kfl_ist_S6_S3 "Umrechnung fuer Messgroesse zff_atsys::cSignale::sig_kfl_ist" TAB_VERB 3 0 "KEIN_KFL" 1 "KFL_VORWAERTS" 2 "KFL_RUECKWAERTS" /end COMPU_VTAB
/begin COMPU_VTAB Conv.zff_atsys._.cSignale._.sig_kfl_ziel_S6_S3 "Umrechnung fuer Messgroesse zff_atsys::cSignale::sig_kfl_ziel" TAB_VERB 3 0 "KEIN_KFL" 1 "KFL_VORWAERTS" 2 "KFL_RUECKWAERTS" /end COMPU_VTAB
/begin FUNCTION UEW_PLAUSI_K0 "Teilfunktion Plausibilisierung der Ansteuerung der K0"
 /begin LOC_MEASUREMENT iUl2K0SPlausiDrehzFl.cUl2K0SPlausiFl._.n_diff_k0 iUl2K0SPlausiDrehzFl.cUl2K0SPlausiFl._.n_diff_k0_einmalig iUl2K0SPlausiDrehzFl.cUl2K0SPlausiFl._.n_i_eds_k0_bed iUl2K0SPlausiDrehzFl.cUl2K0SPlausiFl._.n_k0ueb iUl2K0SPlausiDrehzFl.cUl2K0SPlausiFl._.n_stoeredslogik_k0 iUl2K0SPlausiDrehzFl.cUl2K0SPlausiFl._.st_fehler iUl2K0SPlausiDrehzFl.diff_n_em iUl2K0SPlausiDrehzFl.n_emeink0_n iUl2K0SPlausiDrehzInt.cUl2K0SPlausiInt._.n_diff_k0 iUl2K0SPlausiDrehzInt.cUl2K0SPlausiInt._.n_diff_k0_einmalig iUl2K0SPlausiDrehzInt.cUl2K0SPlausiInt._.n_i_eds_k0_bed iUl2K0SPlausiDrehzInt.cUl2K0SPlausiInt._.n_k0ueb iUl2K0SPlausiDrehzInt.cUl2K0SPlausiInt._.n_stoeredslogik_k0 iUl2K0SPlausiDrehzInt.cUl2K0SPlausiInt._.st_fehler iUl2K0SPlausiDrehzInt.diff_n_em iUl2K0SPlausiDrehzInt.n_emeink0_n iUl2K0SPlausiMomFl.cUl2K0SPlausiFl._.n_diff_k0 iUl2K0SPlausiMomFl.cUl2K0SPlausiFl._.n_diff_k0_einmalig iUl2K0SPlausiMomFl.cUl2K0SPlausiFl._.n_i_eds_k0_bed iUl2K0SPlausiMomFl.cUl2K0SPlausiFl._.n_k0ueb iUl2K0SPlausiMomFl.cUl2K0SPlausiFl._.n_stoeredslogik_k0 iUl2K0SPlausiMomFl.cUl2K0SPlausiFl._.st_fehler iUl2K0SPlausiMomFl.k0_energie_min_reibw_skal iUl2K0SPlausiMomFl.n_emeink0_m iUl2K0SPlausiMomFl.summe_momente iUl2K0SPlausiMomInt.cUl2K0SPlausiInt._.n_diff_k0 iUl2K0SPlausiMomInt.cUl2K0SPlausiInt._.n_diff_k0_einmalig iUl2K0SPlausiMomInt.cUl2K0SPlausiInt._.n_i_eds_k0_bed iUl2K0SPlausiMomInt.cUl2K0SPlausiInt._.n_k0ueb iUl2K0SPlausiMomInt.cUl2K0SPlausiInt._.n_stoeredslogik_k0 iUl2K0SPlausiMomInt.cUl2K0SPlausiInt._.st_fehler iUl2K0SPlausiMomInt.k0_energie_min_reibw_skal iUl2K0SPlausiMomInt.n_emeink0_m iUl2K0SPlausiMomInt.summe_momente /end LOC_MEASUREMENT
/end FUNCTION
/begin FUNCTION UEW_PLAUSI_K0_STATUS "Teilfunktion Plausibilisierung des K0-Status"
 /begin LOC_MEASUREMENT iUl2K0SStatusFl.f_k0_geschlossen_alt iUl2K0SStatusFl.fehler_kein_oeffnen iUl2K0SStatusFl.fehler_ungewolltes_schliessen iUl2K0SStatusFl.n_erfolg_k0_status iUl2K0SStatusFl.n_stoer1_k0_schliessen_status iUl2K0SStatusFl.n_stoer2_k0_schliessen_status iUl2K0SStatusFl.status_k0_alt iUl2K0SStatusInt.f_k0_geschlossen_alt iUl2K0SStatusInt.fehler_kein_oeffnen iUl2K0SStatusInt.fehler_ungewolltes_schliessen iUl2K0SStatusInt.n_erfolg_k0_status iUl2K0SStatusInt.n_stoer1_k0_schliessen_status iUl2K0SStatusInt.n_stoer2_k0_schliessen_status iUl2K0SStatusInt.status_k0_alt /end LOC_MEASUREMENT
/end FUNCTION
/begin FUNCTION UL2_UEW_KFLPL "PosNPlausi Überwachung"
 /begin LOC_MEASUREMENT iUl2KupplPosNPlAFl.cUl2KupplPosNPlFl._.n_stoerposneds iUl2KupplPosNPlAInt.cUl2KupplPosNPlInt._.n_stoerposneds iUl2KupplPosNPlBFl.cUl2KupplPosNPlFl._.n_stoerposneds iUl2KupplPosNPlBInt.cUl2KupplPosNPlInt._.n_stoerposneds iUl2KupplPosNPlCFl.cUl2KupplPosNPlFl._.n_stoerposneds iUl2KupplPosNPlCInt.cUl2KupplPosNPlInt._.n_stoerposneds iUl2KupplPosNPlDFl.cUl2KupplPosNPlFl._.n_stoerposneds iUl2KupplPosNPlDInt.cUl2KupplPosNPlInt._.n_stoerposneds iUl2KupplPosNPlEFl.cUl2KupplPosNPlFl._.n_stoerposneds iUl2KupplPosNPlEInt.cUl2KupplPosNPlInt._.n_stoerposneds iUl2PosNPlFl.ctr_posn_ok iUl2PosNPlFl.f_fehler_vorhanden iUl2PosNPlFl.f_phase_b_aktiv iUl2PosNPlFl.n_kupzu_posueb iUl2PosNPlFl.n_stoerposneds_phase_a iUl2PosNPlFl.n_stoerposneds_phase_b iUl2PosNPlInt.ctr_posn_ok iUl2PosNPlInt.f_fehler_vorhanden iUl2PosNPlInt.f_phase_b_aktiv iUl2PosNPlInt.n_kupzu_posueb iUl2PosNPlInt.n_stoerposneds_phase_a iUl2PosNPlInt.n_stoerposneds_phase_b iUl2PosNPlRbm.flag_rbm_zustand_posn /end LOC_MEASUREMENT
/end FUNCTION
/begin FUNCTION UL2_I_GETR_PLAUSI "Stromplausibilisierung der Getriebe"
 /begin LOC_MEASUREMENT iUl2IGetrPlausiDatenFl.falsche_schaltung iUl2IGetrPlausiDatenFl.n_kup_geschlossen_abgleich iUl2IGetrPlausiDatenFl.n_kup_geschlossen_ist iUl2IGetrPlausiDatenFl.n_kup_nicht_offen_abgleich iUl2IGetrPlausiDatenFl.n_kup_nicht_offen_ist iUl2IGetrPlausiDatenFl.n_kup_oeffnend iUl2IGetrPlausiDatenFl.n_kup_offen_abgleich iUl2IGetrPlausiDatenFl.n_kup_offen_ist iUl2IGetrPlausiDatenFl.n_kup_unbestimmt_abgleich iUl2IGetrPlausiDatenInt.falsche_schaltung iUl2IGetrPlausiDatenInt.n_kup_geschlossen_abgleich iUl2IGetrPlausiDatenInt.n_kup_geschlossen_ist iUl2IGetrPlausiDatenInt.n_kup_nicht_offen_abgleich iUl2IGetrPlausiDatenInt.n_kup_nicht_offen_ist iUl2IGetrPlausiDatenInt.n_kup_oeffnend iUl2IGetrPlausiDatenInt.n_kup_offen_abgleich iUl2IGetrPlausiDatenInt.n_kup_offen_ist iUl2IGetrPlausiDatenInt.n_kup_unbestimmt_abgleich iUl2IGetrPlausiZustandFl.i_set_plausible iUl2IGetrPlausiZustandFl.n_verz_isetplausible iUl2IGetrPlausiZustandFl.n_verz_rev_isetplausible iUl2IGetrPlausiZustandFl.n_verz_revn_isetplausible iUl2IGetrPlausiZustandFl.pos_alt iUl2IGetrPlausiZustandFl.pos_revn_start iUl2IGetrPlausiZustandFl.reversieren_anst iUl2IGetrPlausiZustandFl.zustand iUl2IGetrPlausiZustandInt.end_schalt_anst_plausibel iUl2IGetrPlausiZustandInt.gang_anst iUl2IGetrPlausiZustandInt.gang_anst_plausibel iUl2IGetrPlausiZustandInt.gang_pulsen_anst_plausibel iUl2IGetrPlausiZustandInt.ge_ga_anst_plausibel iUl2IGetrPlausiZustandInt.i_set_plausible iUl2IGetrPlausiZustandInt.n_verz_isetplausible iUl2IGetrPlausiZustandInt.n_verz_rev_isetplausible iUl2IGetrPlausiZustandInt.n_verz_revn_isetplausible iUl2IGetrPlausiZustandInt.pos_alt iUl2IGetrPlausiZustandInt.pos_revn_start iUl2IGetrPlausiZustandInt.reversieren_anst iUl2IGetrPlausiZustandInt.schalt_anst_plausibel iUl2IGetrPlausiZustandInt.schalt_err_anst iUl2IGetrPlausiZustandInt.schalt_err_anst_3_kup iUl2IGetrPlausiZustandInt.versch_4_anst_plausibel iUl2IGetrPlausiZustandInt.zustand iUl2KupDruckAnstKAFl.cUl2BasisKupDruckAnstFl._.kup_nr iUl2KupDruckAnstKAFl.cUl2BasisKupDruckAnstFl._.zustand_soll iUl2KupDruckAnstKAFl.zustand_ist iUl2KupDruckAnstKAInt.cUl2BasisKupDruckAnstInt._.kup_nr iUl2KupDruckAnstKAInt.cUl2BasisKupDruckAnstInt._.zustand_soll iUl2KupDruckAnstKAInt.zustand_ist iUl2KupDruckAnstKBFl.cUl2BasisKupDruckAnstFl._.kup_nr iUl2KupDruckAnstKBFl.cUl2BasisKupDruckAnstFl._.zustand_soll iUl2KupDruckAnstKBFl.zustand_ist iUl2KupDruckAnstKBInt.cUl2BasisKupDruckAnstInt._.kup_nr iUl2KupDruckAnstKBInt.cUl2BasisKupDruckAnstInt._.zustand_soll iUl2KupDruckAnstKBInt.zustand_ist iUl2KupDruckAnstKCFl.cUl2BasisKupDruckAnstFl._.kup_nr iUl2KupDruckAnstKCFl.cUl2BasisKupDruckAnstFl._.zustand_soll iUl2KupDruckAnstKCFl.zustand_ist iUl2KupDruckAnstKCInt.cUl2BasisKupDruckAnstInt._.kup_nr iUl2KupDruckAnstKCInt.cUl2BasisKupDruckAnstInt._.zustand_soll iUl2KupDruckAnstKCInt.zustand_ist iUl2KupDruckAnstKDFl.cUl2BasisKupDruckAnstFl._.kup_nr iUl2KupDruckAnstKDFl.cUl2BasisKupDruckAnstFl._.zustand_soll iUl2KupDruckAnstKDFl.zustand_ist iUl2KupDruckAnstKDInt.cUl2BasisKupDruckAnstInt._.kup_nr iUl2KupDruckAnstKDInt.cUl2BasisKupDruckAnstInt._.zustand_soll iUl2KupDruckAnstKDInt.zustand_ist iUl2KupDruckAnstKEFl.cUl2BasisKupDruckAnstFl._.kup_nr iUl2KupDruckAnstKEFl.cUl2BasisKupDruckAnstFl._.zustand_soll iUl2KupDruckAnstKEFl.zustand_ist iUl2KupDruckAnstKEInt.cUl2BasisKupDruckAnstInt._.kup_nr iUl2KupDruckAnstKEInt.cUl2BasisKupDruckAnstInt._.zustand_soll iUl2KupDruckAnstKEInt.zustand_ist /end LOC_MEASUREMENT
/end FUNCTION
/begin FUNCTION UL2_UEW_MOTOREINGRIFF "Motoreingriffsüberwachung"
 /begin LOC_MEASUREMENT iUl2MeKoordFl.err_abs_me iUl2MeKoordFl.err_me_igang iUl2MeKoordFl.err_neg_me iUl2MeKoordFl.err_pos_me iUl2MeKoordFl.err_rel_me iUl2MeKoordInt.err_abs_me iUl2MeKoordInt.err_grad_pos_me iUl2MeKoordInt.err_int_neg_me iUl2MeKoordInt.err_me_igang iUl2MeKoordInt.err_neg_me iUl2MeKoordInt.err_pos_me iUl2MeKoordInt.err_rel_me iUl2MeKoordInt.err_sig_neg_me iUl2MeKoordInt.err_sig_pos_me iUl2MeKoordInt.n_maxstoernegmeaus iUl2MeKoordInt.n_maxstoernegmeint1 iUl2MeKoordInt.n_maxstoerposmeaus iUl2MeKoordInt.n_stoerposmegradient iUl2MeKoordInt.ng_meueb iUl2MeSignaleFl.me_mot_anford iUl2MeSignaleFl.me_mot_rueckm iUl2MeSignaleInt.me_mot_anford iUl2MeSignaleInt.me_mot_rueckm iUl2NegMeIntenFl.cBasFehlerErfolgFl._.flag_fehler iUl2NegMeIntenFl.cBasFehlerErfolgFl._.zaehler_erfolge iUl2NegMeIntenFl.cBasFehlerErfolgFl._.zaehler_fehler iUl2NegMeIntenFl.stoerung_int_abs_neg_me iUl2NegMeIntenFl.stoerung_int_rel_neg_me iUl2NegMeIntenInt.cBasFehlerErfolgInt._.flag_fehler iUl2NegMeIntenInt.cBasFehlerErfolgInt._.zaehler_erfolge iUl2NegMeIntenInt.cBasFehlerErfolgInt._.zaehler_fehler iUl2NegMeIntenInt.stoerung_int_abs_neg_me iUl2NegMeIntenInt.stoerung_int_rel_neg_me iUl2NegMeSigFl.cBasFehlerErfolgFl._.flag_fehler iUl2NegMeSigFl.cBasFehlerErfolgFl._.zaehler_erfolge iUl2NegMeSigFl.cBasFehlerErfolgFl._.zaehler_fehler iUl2NegMeSigFl.stoerung_sig_abs_neg_me iUl2NegMeSigFl.stoerung_sig_rel_neg_me iUl2NegMeSigInt.cBasFehlerErfolgInt._.flag_fehler iUl2NegMeSigInt.cBasFehlerErfolgInt._.zaehler_erfolge iUl2NegMeSigInt.cBasFehlerErfolgInt._.zaehler_fehler iUl2NegMeSigInt.stoerung_sig_abs_neg_me iUl2NegMeSigInt.stoerung_sig_rel_neg_me iUl2PosMeGradientFl.cBasFehlerErfolgFl._.flag_fehler iUl2PosMeGradientFl.cBasFehlerErfolgFl._.zaehler_erfolge iUl2PosMeGradientFl.cBasFehlerErfolgFl._.zaehler_fehler iUl2PosMeGradientFl.ng_ab_fl.n_f iUl2PosMeGradientFl.ng_meueb iUl2PosMeGradientFl.ng_t_fl.n_f iUl2PosMeGradientFl.stoerung_grad_abs_me iUl2PosMeGradientFl.stoerung_grad_rel_me iUl2PosMeGradientInt.cBasFehlerErfolgInt._.flag_fehler iUl2PosMeGradientInt.cBasFehlerErfolgInt._.zaehler_erfolge iUl2PosMeGradientInt.cBasFehlerErfolgInt._.zaehler_fehler iUl2PosMeGradientInt.ng_ab_l2.n_f iUl2PosMeGradientInt.ng_meueb iUl2PosMeGradientInt.ng_t_l2.n_f iUl2PosMeGradientInt.stoerung_grad_abs_me iUl2PosMeGradientInt.stoerung_grad_rel_me iUl2PosMeIntenIGangFl.cBasFehlerErfolgFl._.flag_fehler iUl2PosMeIntenIGangFl.cBasFehlerErfolgFl._.zaehler_erfolge iUl2PosMeIntenIGangFl.cBasFehlerErfolgFl._.zaehler_fehler iUl2PosMeIntenIGangFl.err_abs_me_igang iUl2PosMeIntenIGangFl.err_rel_me_igang iUl2PosMeIntenIGangInt.cBasFehlerErfolgInt._.flag_fehler iUl2PosMeIntenIGangInt.cBasFehlerErfolgInt._.zaehler_erfolge iUl2PosMeIntenIGangInt.cBasFehlerErfolgInt._.zaehler_fehler iUl2PosMeIntenIGangInt.err_abs_me_igang iUl2PosMeIntenIGangInt.err_rel_me_igang iUl2PosMeIntenKoordFl.err_int_pos_me iUl2PosMeIntenKoordFl.err_int_pos_me_abs iUl2PosMeIntenKoordFl.err_int_pos_me_rel iUl2PosMeIntenKoordInt.err_int_pos_me iUl2PosMeIntenKoordInt.err_int_pos_me_abs iUl2PosMeIntenKoordInt.err_int_pos_me_rel iUl2PosMeIntenKoordInt.n_maxstoerposmeint1 iUl2PosMeIntenKoordInt.n_maxstoerposmeint2 iUl2PosMeIntenKoordInt.n_maxstoerposmeintigang iUl2PosMeIntenVar1Fl.cBasFehlerErfolgFl._.flag_fehler iUl2PosMeIntenVar1Fl.cBasFehlerErfolgFl._.zaehler_erfolge iUl2PosMeIntenVar1Fl.cBasFehlerErfolgFl._.zaehler_fehler iUl2PosMeIntenVar1Fl.schwellen_variante iUl2PosMeIntenVar1Fl.stoerung_int_abs_pos_me iUl2PosMeIntenVar1Fl.stoerung_int_rel_pos_me iUl2PosMeIntenVar1Int.cBasFehlerErfolgInt._.flag_fehler iUl2PosMeIntenVar1Int.cBasFehlerErfolgInt._.zaehler_erfolge iUl2PosMeIntenVar1Int.cBasFehlerErfolgInt._.zaehler_fehler iUl2PosMeIntenVar1Int.schwellen_variante iUl2PosMeIntenVar1Int.stoerung_int_abs_pos_me iUl2PosMeIntenVar1Int.stoerung_int_rel_pos_me iUl2PosMeIntenVar2Fl.cBasFehlerErfolgFl._.flag_fehler iUl2PosMeIntenVar2Fl.cBasFehlerErfolgFl._.zaehler_erfolge iUl2PosMeIntenVar2Fl.cBasFehlerErfolgFl._.zaehler_fehler iUl2PosMeIntenVar2Fl.schwellen_variante iUl2PosMeIntenVar2Fl.stoerung_int_abs_pos_me iUl2PosMeIntenVar2Fl.stoerung_int_rel_pos_me iUl2PosMeIntenVar2Int.cBasFehlerErfolgInt._.flag_fehler iUl2PosMeIntenVar2Int.cBasFehlerErfolgInt._.zaehler_erfolge iUl2PosMeIntenVar2Int.cBasFehlerErfolgInt._.zaehler_fehler iUl2PosMeIntenVar2Int.schwellen_variante iUl2PosMeIntenVar2Int.stoerung_int_abs_pos_me iUl2PosMeIntenVar2Int.stoerung_int_rel_pos_me iUl2PosMeSigFl.cBasFehlerErfolgFl._.flag_fehler iUl2PosMeSigFl.cBasFehlerErfolgFl._.zaehler_erfolge iUl2PosMeSigFl.cBasFehlerErfolgFl._.zaehler_fehler iUl2PosMeSigFl.stoerung_sig_abs_pos_me iUl2PosMeSigFl.stoerung_sig_rel_pos_me iUl2PosMeSigInt.cBasFehlerErfolgInt._.flag_fehler iUl2PosMeSigInt.cBasFehlerErfolgInt._.zaehler_erfolge iUl2PosMeSigInt.cBasFehlerErfolgInt._.zaehler_fehler iUl2PosMeSigInt.stoerung_sig_abs_pos_me iUl2PosMeSigInt.stoerung_sig_rel_pos_me /end LOC_MEASUREMENT
/end FUNCTION
/begin FUNCTION UL2_UEW_GETR_M_AUF "Überwachung Getriebe- und Pumpenaufnahmemoment"
 /begin LOC_MEASUREMENT iUl2GetrMAufFl.cBasFehlerErfolgFl._.flag_fehler iUl2GetrMAufFl.cBasFehlerErfolgFl._.zaehler_erfolge iUl2GetrMAufFl.cBasFehlerErfolgFl._.zaehler_fehler iUl2GetrMAufFl.mmot_auf_zul iUl2GetrMAufInt.cBasFehlerErfolgInt._.flag_fehler iUl2GetrMAufInt.cBasFehlerErfolgInt._.zaehler_erfolge iUl2GetrMAufInt.cBasFehlerErfolgInt._.zaehler_fehler iUl2GetrMAufInt.mmot_auf_zul iUl2GetrMAufInt.n_maxstoermgetrauf /end LOC_MEASUREMENT
/end FUNCTION
/begin FUNCTION UL2_UEW_NMOT "Alle Module die zur NMot-Überwachungen gehören."
 /begin LOC_MEASUREMENT iUl2NmotuFl.dsc_fehler_alt iUl2NmotuFl.n_mot_min_l2 iUl2NmotuFl.n_mot_obergrenze iUl2NmotuFl.n_mot_schwelle iUl2NmotuFl.n_mot_schwelle_alt iUl2NmotuFl.n_stoer_nmotueb iUl2NmotuFl.n_stoer_nmotueb_rueckfilter iUl2NmotuFl.n_stoer_red_nmotabreg iUl2NmotuFl.n_stoer_red_ntmaxzg iUl2NmotuFl.n_t_min_zg_l2 iUl2NmotuFl.n_t_schwelle iUl2NmotuFl.n_t_schwelle_alt iUl2NmotuFl.n_t_zg_obergrenze iUl2NmotuFl.n_t_zg_obergrenze_alt iUl2NmotuFl.ntmaxzg_verz_aktiv iUl2NmotuFl.pos_alt iUl2NmotuFl.pruefbed_nmotueb_l2 iUl2NmotuFl.z_nmotabreg_l2 iUl2NmotuFl.z_nt_max_zg_l2 iUl2NmotuFl.zielgang_sas_alt_l2 iUl2NmotuInt.dsc_fehler_alt iUl2NmotuInt.n_mot_min_l2 iUl2NmotuInt.n_mot_obergrenze iUl2NmotuInt.n_mot_schwelle iUl2NmotuInt.n_mot_schwelle_alt iUl2NmotuInt.n_stoer_nmotueb iUl2NmotuInt.n_stoer_nmotueb_rueckfilter iUl2NmotuInt.n_stoer_red_nmotabreg iUl2NmotuInt.n_stoer_red_ntmaxzg iUl2NmotuInt.n_t_min_zg_l2 iUl2NmotuInt.n_t_schwelle iUl2NmotuInt.n_t_schwelle_alt iUl2NmotuInt.n_t_zg_obergrenze iUl2NmotuInt.n_t_zg_obergrenze_alt iUl2NmotuInt.ntmaxzg_verz_aktiv iUl2NmotuInt.pos_alt iUl2NmotuInt.pruefbed_nmotueb_l2 iUl2NmotuInt.z_nmotabreg_l2 iUl2NmotuInt.z_nt_max_zg_l2 iUl2NmotuInt.zielgang_sas_alt_l2 /end LOC_MEASUREMENT
/end FUNCTION
/begin FUNCTION UL2_UEW_MAX_VERZ "Überwachung auf maximale Verzögerung"
 /begin LOC_MEASUREMENT iUl2MaxVerz.flag_verzmax_nab iUl2MaxVerz.flag_verzmax_nab_pb iUl2MaxVerz.flag_verzmax_nabstatus iUl2MaxVerz.n_ab_akt iUl2MaxVerz.n_ab_dif iUl2MaxVerz.n_ab_ref iUl2MaxVerz.n_verz_maxverz iUl2MaxVerz.n_verz_maxverz_nabstatus iUl2MaxVerzEinst.einstiegsbed iUl2MaxVerzEinst.n_nab_maxverz iUl2MaxVerzEinst.n_schwelle_zaehlervermax_aktiv iUl2MaxVerzEinst.n_zaehlerverzmaxaktiv iUl2MaxVerzEinst.uew_verzmax_aktiv /end LOC_MEASUREMENT
/end FUNCTION
/begin FUNCTION UL2_SIGNALE "Signalabsicherung der Signale aus der ATSYS zum Beispiel der Ströme gegen die EDSMV-Ersatzinfo" /begin SUB_FUNCTION UL2_ITF_REQ_SIG /end SUB_FUNCTION /end FUNCTION
/begin FUNCTION UL2_ITF_REQ_SIG "Diese Struktur stellt Funktionen für die ATSYS zum Absichern von Pfaden zur Verfügung. (zum Beispiele für die Schnittstelle GET_ERS_EDSMV_INFO)."
 /begin LOC_MEASUREMENT iUl2SigItfInputAtsysInt.i_eds_0_l2 iUl2SigItfInputAtsysInt.i_eds_10_l2 iUl2SigItfInputAtsysInt.i_eds_11_l2 iUl2SigItfInputAtsysInt.i_eds_1_l2 iUl2SigItfInputAtsysInt.i_eds_2_l2 iUl2SigItfInputAtsysInt.i_eds_3_l2 iUl2SigItfInputAtsysInt.i_eds_4_l2 iUl2SigItfInputAtsysInt.i_eds_5_l2 iUl2SigItfInputAtsysInt.i_eds_6_l2 iUl2SigItfInputAtsysInt.i_eds_7_l2 iUl2SigItfInputAtsysInt.i_eds_8_l2 iUl2SigItfInputAtsysInt.i_eds_9_l2 iUl2SigItfInputAtsysKomp.i_eds_0_komp_l2 iUl2SigItfInputAtsysKomp.i_eds_10_komp_l2 iUl2SigItfInputAtsysKomp.i_eds_11_komp_l2 iUl2SigItfInputAtsysKomp.i_eds_1_komp_l2 iUl2SigItfInputAtsysKomp.i_eds_2_komp_l2 iUl2SigItfInputAtsysKomp.i_eds_3_komp_l2 iUl2SigItfInputAtsysKomp.i_eds_4_komp_l2 iUl2SigItfInputAtsysKomp.i_eds_5_komp_l2 iUl2SigItfInputAtsysKomp.i_eds_6_komp_l2 iUl2SigItfInputAtsysKomp.i_eds_7_komp_l2 iUl2SigItfInputAtsysKomp.i_eds_8_komp_l2 iUl2SigItfInputAtsysKomp.i_eds_9_komp_l2 iUl2SigItfInputInt.ers_edsmv_info iUl2SigItfInputInt.kmn_out10lssoff iUl2SigItfInputKomp.ers_edsmv_info_komp iUl2SigItfInputKomp.kmn_out10lssoff_komp /end LOC_MEASUREMENT
/end FUNCTION
/begin FUNCTION PSA "Ablaeufe fuer die Parksperre" /begin SUB_FUNCTION PSA_BIBLIO PSA_UEW_POSV /end SUB_FUNCTION /end FUNCTION
/begin FUNCTION PSA_BIBLIO "verschieden Bibliotheksfunktionen für die Überwachungen"
 /begin LOC_MEASUREMENT iUewPosVTimerZuendung.cUewTimerZuendung._.f_keine_egs_offtime iUewPosVTimerZuendung.cUewTimerZuendung._.f_reset iUewPosVTimerZuendung.cUewTimerZuendung._.iTimerVerzNmotMax.timer iUewPosVTimerZuendung.cUewTimerZuendung._.timer iUewPosVTimerZuendung.cUewTimerZuendung._.zz_zustand /end LOC_MEASUREMENT
/end FUNCTION
/begin FUNCTION PSA_UEW_POSV "Überwachung der Korrekten Funktion des Positionsventils"
 /begin LOC_MEASUREMENT iUewPosVTimerZuendung.cUewTimerZuendung._.f_keine_egs_offtime iUewPosVTimerZuendung.cUewTimerZuendung._.f_reset iUewPosVTimerZuendung.cUewTimerZuendung._.iTimerVerzNmotMax.timer iUewPosVTimerZuendung.cUewTimerZuendung._.timer iUewPosVTimerZuendung.cUewTimerZuendung._.zz_zustand iUewSgetf.fl_neutral_posvueb iUewSgetf.i_edsc_min iUewSgetf.n_stoer_posv iUewSgetf.posv_diagnose_aktiv iUewSgetf.pruefung_posvmechdef_aktiv iUewSgetf.ps_sensor_err iUewSgetf.ps_sensor_signal_alt iUewSgetf.pumpendruck_vorh_posv_uew_alt iUewSgetf.timer_posvmechdef iUewSgetf.timer_verzposvueb iUewSgetf.zwangsposition_p /end LOC_MEASUREMENT
/end FUNCTION
/begin FUNCTION Funktionskomponenten "Funktionskomponenten" /begin SUB_FUNCTION Funktionskomponenten.cSignale /end SUB_FUNCTION /end FUNCTION
/begin FUNCTION Funktionskomponenten.cSignale "cSignale"
 /begin LOC_MEASUREMENT zff_atsys._.iSignale._.obj.sig_c_getr zff_atsys._.iSignale._.obj.sig_c_getr_fl32 zff_atsys._.iSignale._.obj.sig_c_mot zff_atsys._.iSignale._.obj.sig_dki zff_atsys._.iSignale._.obj.sig_dki_fl32 zff_atsys._.iSignale._.obj.sig_dki_mmotsoll zff_atsys._.iSignale._.obj.sig_dki_mmotsoll_fl32 zff_atsys._.iSignale._.obj.sig_e_fahren zff_atsys._.iSignale._.obj.sig_index_sp_sps zff_atsys._.iSignale._.obj.sig_istgang zff_atsys._.iSignale._.obj.sig_istgang_idx zff_atsys._.iSignale._.obj.sig_istgang_komp zff_atsys._.iSignale._.obj.sig_istgang_vorw zff_atsys._.iSignale._.obj.sig_kfl_ist zff_atsys._.iSignale._.obj.sig_kfl_ziel zff_atsys._.iSignale._.obj.sig_m_t zff_atsys._.iSignale._.obj.sig_m_t8 zff_atsys._.iSignale._.obj.sig_n_ab zff_atsys._.iSignale._.obj.sig_n_ab8 zff_atsys._.iSignale._.obj.sig_n_mot zff_atsys._.iSignale._.obj.sig_n_mot8 zff_atsys._.iSignale._.obj.sig_n_t zff_atsys._.iSignale._.obj.sig_n_t8 zff_atsys._.iSignale._.obj.sig_neigung_iae zff_atsys._.iSignale._.obj.sig_serapflag zff_atsys._.iSignale._.obj.sig_serapflag_komp zff_atsys._.iSignale._.obj.sig_zielgang zff_atsys._.iSignale._.obj.sig_zielgang_idx zff_atsys._.iSignale._.obj.sig_zielgang_sas zff_atsys._.iSignale._.obj.sig_zielgang_sas_idx zff_atsys._.iSignale._.obj.sig_zielgang_sas_komp zff_atsys._.iSignale._.obj.sig_zielgang_sas_vorw zff_atsys._.iSignale._.obj.sig_zielgang_vorw /end LOC_MEASUREMENT
/end FUNCTION
/begin FUNCTION zf_ATSYS_Applikationsgroessen "Alle Applikationsgrößen der ATSYS"
 /begin SUB_FUNCTION PAR_IEP_EINSCHALTBED PAR_IEP_KOORDI PAR_IEP_LECKAGE PAR_IEP_SIGAUFB PAR_IEP_SIGNACHBER PAR_IEP_SOLLEXT PAR_IEP_SOLLVORG PAR_IEP_SONDERFKT PAR_K0S_ALTSIGNALE PAR_K0S_DRUCKBER PAR_K0S_MOMENTEN PAR_K0S_SIGNA PAR_K0S_SOLLW PAR_K0S_SOLLZPRIO PAR_K0S_STATUS PAR_K0S_TEMPM PAR_K0S_UEW PAR_K0S_ZUST dBibAglex_Fktn dAzsManko_Fktn dAzsGangb_Fktn dBihMomenHsHss_Fktn dBihMPuauf_Fktn dBihNeigungssignal_Fktn dBihHotmode_Fktn dBihHotmodeG_Fktn dBihDrehz_Fktn dBihMobef_Fktn dBihMobefG_Fktn dBihMomen_Fktn dBihMomenG_Fktn dBihSigna_Fktn dBihSignaRSS_Fktn dBihHydra_Fktn dModAbglKorr_Fktn dModHydlg_Fktn dModHysKo_Fktn dModHysKoK_Fktn dModKuppl_Fktn dModKupplK_Fktn dMvsZentr_Fktn dAdaGlosc_Fktn dAdaIaeuf_Fktn dAdaIaeap_Fktn dAdaGloku_Fktn dAdaGlokuK_Fktn dAdaPfusfEHS_Fktn dAdaPfusf_Fktn dAdaPfusfERS_Fktn dAdaPulbwX_Fktn dAdaPulpf_Fktn dAdaPulzs_Fktn dAdaPulsf_Fktn dAdaPulzsK_Fktn dAdaPulpfK_Fktn dAdaPulsfK_Fktn dAdaPstsf_Fktn dAdaPstpf_Fktn dAdaPstpfK_Fktn dAdaPstbwX_Fktn dAdaPstzsK_Fktn dAdaPstPrepulsK_Fktn dAdaPstzs_Fktn dAdaPstsfK_Fktn dAdaUrlufterkSchaltung_Fktn dAdaUrlufterkPuls_Fktn dAdaUrlufterk_Fktn dAdaGlastS_Fktn dAdaGlast_Fktn dNvrContr_Fktn dKasEkopl_Fktn dKasEkoplX_Fktn dIaeAdauf_Fktn dIaeAnfahEcoX_Fktn dIaeMomen_Fktn dIaeTempm_Fktn dIaeMotmx_Fktn dIaeKordi_Fktn dIaeKuehl_Fktn dIaeDiagn_Fktn dIaeSigna_Fktn dIaeDraus_Fktn dIaeAnfahX_Fktn dIaeParaEcoX_Fktn dSasGloRSP_Fktn dMoeSasHSS_Fktn dMoeSasRSP_Fktn dMoeSasEHS_Fktn dMoeSasRSS_Fktn dMoeSasERS_Fktn dMoeSasAl_Fktn dMoeMekHSP_Fktn dMoeSasGeG_Fktn dMoeSasHSP_Fktn dSasKabRSP_Fktn dSasKabEHS_Fktn dSasKzuHSP_Fktn dSasKzuEHS_Fktn dSasKzuRSP_Fktn dSasKzuERS_Fktn dSasKabRSS_Fktn dSasGloHSS_Fktn dSasGloAl_Fktn dSasGloKuK_Fktn dSasKabAl_Fktn dSasKabERS_Fktn dSasKzuRSS_Fktn dSasKzuAl_Fktn dSasKabHSS_Fktn dSasKabHSP_Fktn dSasKzuHSS_Fktn dSasGloRSS_Fktn dSasKabGeG_Fktn dGeaKzuModeGeG_Fktn dSasGloGeG_Fktn dSasGeaAl_Fktn dSasKzuGeG_Fktn dSasGlsGeG_Fktn dSasGlsHSP_Fktn dSasGlsRSP_Fktn dSasGlsAl_Fktn dSasGlsHSS_Fktn dSasGlsRSS_Fktn dSasKflwe_Fktn dSasKflweW_Fktn dSasStrat_Fktn dSasPsyst_Fktn dSasPsyGeG_Fktn dSasPsyHSS_Fktn dSasPsyRSS_Fktn dMonMvGet_Fktn dUewIgetr_Fktn dUewIgetrG_Fktn dUewIgetrK_Fktn dUewIgetrS_Fktn dUewParksperrenmagnet_Fktn dDiaRbmif_Fktn dUl2Hydraulik_Fktn dUl2EdsGangInfoK_Fktn dUl2EdsGangInfo_Fktn dUl2EdsKfl_Fktn dUl2EdsKupKfl_Fktn dUl2ISetPlausibel_Fktn dUl2MaxVerz_Fktn dUl2EdsLg_Fktn dUl2Kuppl_Fktn dUl2KupplK_Fktn dUl2KupplK0_Fktn dUl2KupplToggle_Fktn dUl2Posme_Fktn dUl2Kflpl_Fktn dUl2KflplK_Fktn dUl2Nmotu_Fktn dUl2GetrMAuf_Fktn dUewSgetf_Fktn /end SUB_FUNCTION
/end FUNCTION
/begin FUNCTION PAR_IEP_EINSCHALTBED ""
 /begin DEF_CHARACTERISTIC sIepEinschaltbed.NS_HYBRID_HYS_IEP sIepEinschaltbed.NS_HYBRID_IEP sIepEinschaltbed.SWI_P_STUE_HYBRID_PSS_IEP sIepEinschaltbed.TAB_T_AN_MIN_LP_IEP /end DEF_CHARACTERISTIC
 /begin LOC_MEASUREMENT sIepEinschaltbed.f_an_aus_iep sIepEinschaltbed.f_ns_iep sIepEinschaltbed.f_ts_lp_iep sIepEinschaltbed.t_an_min_lp_iep sIepEinschaltbed.ts_an_min_lp_iep /end LOC_MEASUREMENT
/end FUNCTION
/begin FUNCTION PAR_IEP_KOORDI ""
 /begin DEF_CHARACTERISTIC sIepKoordi.SWI_IEP sIepKoordi.SWI_VORGABE_MANUELL_IEP sIepKoordi.T_FEHLER_RESET_IEP sIepKoordi.VORGABE_MANUELL_IEP /end DEF_CHARACTERISTIC
 /begin LOC_MEASUREMENT sIepKoordi.ziel_iep sIepKoordi.zustand_iep /end LOC_MEASUREMENT
/end FUNCTION
/begin RECORD_LAYOUT Parameter.ui16_S6_S3 FNC_VALUES 1 UWORD ROW_DIR DIRECT /end RECORD_LAYOUT
/begin RECORD_LAYOUT Parameter.ui8_S6_S3 FNC_VALUES 1 UBYTE ROW_DIR DIRECT /end RECORD_LAYOUT
/begin RECORD_LAYOUT Matrix.ui8_S6_S3 FNC_VALUES 1 UBYTE ROW_DIR DIRECT /end RECORD_LAYOUT
/end MODULE
/end PROJECT
