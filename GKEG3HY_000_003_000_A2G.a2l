ASAP2_VERSION 1 51
/begin PROJECT _929_929 "Gen2_BMW_System_Supplier_Lib"
/begin HEADER "" VERSION "C_03_03" PROJECT_NO _929_929 /end HEADER
/begin MODULE DIM ""
/begin MOD_COMMON "" BYTE_ORDER MSB_FIRST ALIGNMENT_BYTE 1 ALIGNMENT_WORD 2 ALIGNMENT_LONG 4 ALIGNMENT_FLOAT32_IEEE 4 /end MOD_COMMON
/begin MEASUREMENT iSasKorGls.FlankeNeg.old_value "alter Wert des Uebergabeparameters" UBYTE UMR___1_1_0_S6_S3 1 100 0 1 BIT_MASK 0x1 DISPLAY_IDENTIFIER old_value.FlankeNeg.iSasKorGls ECU_ADDRESS 0xFFF8F192 /end MEASUREMENT
/begin MEASUREMENT iSasKorGls.FlankePos.old_value "alter Wert des Uebergabeparameters" UBYTE UMR___1_1_0_S6_S3 1 100 0 1 BIT_MASK 0x1 DISPLAY_IDENTIFIER old_value.FlankePos.iSasKorGls ECU_ADDRESS 0xFFF8F193 /end MEASUREMENT
/begin MEASUREMENT iSasKorGls.reg_gls_gestartet "FLAG: GLS-Regler wurde gestartet" UBYTE Conv.cSasKorGls._.reg_gls_gestartet_S6_S3 1 100 0 1 BIT_MASK 0x1 DISPLAY_IDENTIFIER reg_gls_gestartet.iSasKorGls ECU_ADDRESS 0xFFF8F184 /end MEASUREMENT
/begin MEASUREMENT iSasKorGls.gls_mindruck "FLAG: GLS-Minimaldruck erreicht" UBYTE Conv.cSasKorGls._.gls_mindruck_S6_S3 1 100 0 1 BIT_MASK 0x1 DISPLAY_IDENTIFIER gls_mindruck.iSasKorGls ECU_ADDRESS 0xFFF8F185 /end MEASUREMENT
/begin MEASUREMENT iSasKorGls.z_gls "Zustand geregelte Lastschaltung" UBYTE Conv.cSasKorGls._.z_gls_S6_S3 1 100 0 11 DISPLAY_IDENTIFIER z_gls.iSasKorGls ECU_ADDRESS 0xFFF8F186 /end MEASUREMENT
/begin MEASUREMENT iSasKorGls.gls_aktiv "FLAG: GLS ist Aktiv" UBYTE Conv.cSasKorGls._.gls_aktiv_S6_S3 1 100 0 1 BIT_MASK 0x1 DISPLAY_IDENTIFIER gls_aktiv.iSasKorGls ECU_ADDRESS 0xFFF8F187 /end MEASUREMENT
/begin MEASUREMENT iSasKorGls.schaltung_gls "Flag, das GLS Initialisiert wurde und aktiv werden kann" UBYTE Conv.cSasKorGls._.schaltung_gls_S6_S3 1 100 0 1 BIT_MASK 0x1 DISPLAY_IDENTIFIER schaltung_gls.iSasKorGls ECU_ADDRESS 0xFFF8F188 /end MEASUREMENT
/begin MEASUREMENT iSasKorGls.timer_sgls "Schleifzeittimer der GLS" UBYTE UMR_MSEC__10_1_0_S6_S3 1 100 0 2550 DISPLAY_IDENTIFIER timer_sgls.iSasKorGls ECU_ADDRESS 0xFFF8F189 /end MEASUREMENT
/begin MEASUREMENT iSasKorGls.zaehler_zgls "Zustandszaehler der GLS" UBYTE UMR___1_1_0_S6_S3 1 100 0 255 DISPLAY_IDENTIFIER zaehler_zgls.iSasKorGls ECU_ADDRESS 0xFFF8F18A /end MEASUREMENT
/begin MEASUREMENT iSasKorGls.timer_zgls "Zustandstimer der GLS" UBYTE UMR_MSEC__10_1_0_S6_S3 1 100 0 2550 DISPLAY_IDENTIFIER timer_zgls.iSasKorGls ECU_ADDRESS 0xFFF8F18B /end MEASUREMENT
/begin MEASUREMENT iSasKorGls.timer_vglskzu "Timer Verzoegerungszeit bei Regelung der KZU" UBYTE UMR_MSEC__10_1_0_S6_S3 1 100 0 2550 DISPLAY_IDENTIFIER timer_vglskzu.iSasKorGls ECU_ADDRESS 0xFFF8F18C /end MEASUREMENT
/begin MEASUREMENT iSasKorGls.timer_vglskab "Timer Verzoegerungszeit bei Regelung der KAB" UBYTE UMR_MSEC__10_1_0_S6_S3 1 100 0 2550 DISPLAY_IDENTIFIER timer_vglskab.iSasKorGls ECU_ADDRESS 0xFFF8F18D /end MEASUREMENT
/begin MEASUREMENT iSasKorGls.t_zgls "Zustandszeitdauer geregelte Lastschaltung" SWORD UMR_MSEC__10_1_0_S6_S3 1 100 -327680 327670 DISPLAY_IDENTIFIER t_zgls.iSasKorGls ECU_ADDRESS 0xFFF8F18E /end MEASUREMENT
/begin MEASUREMENT iSasKorGls.wechsel_kzu_kab "Wechsel von kzu auf kab oder kab auf kzu" UBYTE Conv.cSasKorGls._.wechsel_kzu_kab_S6_S3 1 100 0 1 BIT_MASK 0x1 DISPLAY_IDENTIFIER wechsel_kzu_kab.iSasKorGls ECU_ADDRESS 0xFFF8F190 /end MEASUREMENT
/begin MEASUREMENT iSasKorGls.verz_gls_gestartet "FLAG: Verzögerung des GLS-Reglers wurde gestartet" UBYTE Conv.cSasKorGls._.verz_gls_gestartet_S6_S3 1 100 0 1 BIT_MASK 0x1 DISPLAY_IDENTIFIER verz_gls_gestartet.iSasKorGls ECU_ADDRESS 0xFFF8F191 /end MEASUREMENT
/begin MEASUREMENT iSasBerechnungGls.filter_wngtgls.x "letzter Wert" SLONG UMR___1_1_0_S6_S3 1 100 -2147483648 2147483647 DISPLAY_IDENTIFIER x.filter_wngtgls.iSasBerechnungGls ECU_ADDRESS 0xFFF8F170 /end MEASUREMENT
/begin MEASUREMENT iSasBerechnungGls.filter_wngtgls.letzter_ms_timer "letzter BS-Timer" UWORD UMR_MSEC__1_1_0_S6_S3 1 100 0 65535 DISPLAY_IDENTIFIER letzter_ms_timer.filter_wngtgls.iSasBerechnungGls ECU_ADDRESS 0xFFF8F174 /end MEASUREMENT
/begin MEASUREMENT iSasBerechnungGls.FSchubZugSas.old_value "alter Wert des Uebergabeparameters" UBYTE UMR___1_1_0_S6_S3 1 100 0 1 BIT_MASK 0x1 DISPLAY_IDENTIFIER old_value.FSchubZugSas.iSasBerechnungGls ECU_ADDRESS 0xFFF8F178 /end MEASUREMENT
/begin MEASUREMENT iSasBerechnungGls.w_tsgls "Sollwert Schleifzeit GLS" UBYTE UMR_MSEC__10_1_0_S6_S3 1 100 0 2550 DISPLAY_IDENTIFIER w_tsgls.iSasBerechnungGls ECU_ADDRESS 0xFFF8F154 /end MEASUREMENT
/begin MEASUREMENT iSasBerechnungGls.w_ngtgls "Sollwert Turbinen-Drehzahlgradient GLS" SWORD UMR_U_MINSEC_1_1_0_S6_S3 1 100 -32000 32000 DISPLAY_IDENTIFIER w_ngtgls.iSasBerechnungGls ECU_ADDRESS 0xFFF8F156 /end MEASUREMENT
/begin MEASUREMENT iSasBerechnungGls.w_ngtgls_filt "Gefilterter Sollgradient der GLS" SWORD UMR_U_MINSEC_1_1_0_S6_S3 1 100 -32000 32000 DISPLAY_IDENTIFIER w_ngtgls_filt.iSasBerechnungGls ECU_ADDRESS 0xFFF8F158 /end MEASUREMENT
/begin MEASUREMENT iSasBerechnungGls.t_sgls "Schleifzeit geregelte Lastschaltung" UBYTE UMR_MSEC__10_1_0_S6_S3 1 100 0 2550 DISPLAY_IDENTIFIER t_sgls.iSasBerechnungGls ECU_ADDRESS 0xFFF8F15A /end MEASUREMENT
/begin MEASUREMENT iSasBerechnungGls.ng_tgls "Istwert Turbinen-Drehzahlgradient GLS" SWORD UMR_U_MINSEC_1_1_0_S6_S3 1 100 -32000 32000 DISPLAY_IDENTIFIER ng_tgls.iSasBerechnungGls ECU_ADDRESS 0xFFF8F15C /end MEASUREMENT
/begin MEASUREMENT iSasBerechnungGls.n_tmaxge "maximale Turbinendrehzahl zum Zeitpunkt Start Ra 1 kraftschl. Kup" UWORD UMR_U_MIN_1_1_0_S6_S3 1 100 0 8160 DISPLAY_IDENTIFIER n_tmaxge.iSasBerechnungGls ECU_ADDRESS 0xFFF8F15E /end MEASUREMENT
/begin MEASUREMENT iSasBerechnungGls.regeldiff_init "Regeldifferenz bei Initialisierung Regler" SWORD UMR_U_MINSEC_10000_32767_0_S6_S3 1 100 -9765.92303232 9765.92303232 DISPLAY_IDENTIFIER regeldiff_init.iSasBerechnungGls ECU_ADDRESS 0xFFF8F160 /end MEASUREMENT
/begin MEASUREMENT iSasBerechnungGls.flag_umsch_gls_kab "Flag, Umschlatung der GLS auf Kab" UBYTE Conv.cSasBerechnungGls._.flag_umsch_gls_kab_S6_S3 1 100 0 1 BIT_MASK 0x1 DISPLAY_IDENTIFIER flag_umsch_gls_kab.iSasBerechnungGls ECU_ADDRESS 0xFFF8F162 /end MEASUREMENT
/begin MEASUREMENT iSasBerechnungGls.flag_umsch_gls_kzu "Flag, Umschlatung der GLS auf Kzu" UBYTE Conv.cSasBerechnungGls._.flag_umsch_gls_kzu_S6_S3 1 100 0 1 BIT_MASK 0x1 DISPLAY_IDENTIFIER flag_umsch_gls_kzu.iSasBerechnungGls ECU_ADDRESS 0xFFF8F163 /end MEASUREMENT
/begin MEASUREMENT iSasBerechnungGls.schub_zug_wechsel "Schub Zug Wechsel von Zs_Zug" UBYTE Conv.cSasBerechnungGls._.schub_zug_wechsel_S6_S3 1 100 0 1 BIT_MASK 0x1 DISPLAY_IDENTIFIER schub_zug_wechsel.iSasBerechnungGls ECU_ADDRESS 0xFFF8F164 /end MEASUREMENT
/begin MEASUREMENT iSasBerechnungGls.filter_wngtgls_gestartet "Flag, ob Filterfkt w_ngtgls gestartet ist" UBYTE Conv.cSasBerechnungGls._.filter_wngtgls_gestartet_S6_S3 1 100 0 1 BIT_MASK 0x1 DISPLAY_IDENTIFIER filter_wngtgls_gestartet.iSasBerechnungGls ECU_ADDRESS 0xFFF8F165 /end MEASUREMENT
/begin MEASUREMENT iSasBerechnungGls.schalttyp_gls "Schalttyp der GLS" UBYTE Conv.cSasBerechnungGls._.schalttyp_gls_S6_S3 1 100 0 5 DISPLAY_IDENTIFIER schalttyp_gls.iSasBerechnungGls ECU_ADDRESS 0xFFF8F166 /end MEASUREMENT
/begin MEASUREMENT iSasBerechnungGls.wechsel_normal_kurz "Flag, ob Schaltung von normal nach kurz gewechselt hat" UBYTE Conv.cSasBerechnungGls._.wechsel_normal_kurz_S6_S3 1 100 0 1 BIT_MASK 0x1 DISPLAY_IDENTIFIER wechsel_normal_kurz.iSasBerechnungGls ECU_ADDRESS 0xFFF8F167 /end MEASUREMENT
/begin MEASUREMENT iSasBerechnungGls.gls_i_anteil "I-Anteil für den Regler" UWORD UMR___1_1_0_S6_S3 1 100 0 65535 DISPLAY_IDENTIFIER gls_i_anteil.iSasBerechnungGls ECU_ADDRESS 0xFFF8F168 /end MEASUREMENT
/begin MEASUREMENT iSasBerechnungGls.gls_p_anteil "P-Anteil für den Regler" UWORD UMR___1_1_0_S6_S3 1 100 0 65535 DISPLAY_IDENTIFIER gls_p_anteil.iSasBerechnungGls ECU_ADDRESS 0xFFF8F16A /end MEASUREMENT
/begin MEASUREMENT iSasBerechnungGls.w_ngtnomgls "nominaler Wert des Turbinendrehzahlgradienten bei der GLS" SWORD UMR_U_MINSEC_1_1_0_S6_S3 1 100 -32000 32000 DISPLAY_IDENTIFIER w_ngtnomgls.iSasBerechnungGls ECU_ADDRESS 0xFFF8F16C /end MEASUREMENT
/begin MEASUREMENT iSasBerechnungGls.diag_schaltung_ueber_kzu "Diagnose schaltung_ueber_kzu" UBYTE Conv.cSasBerechnungGls._.diag_schaltung_ueber_kzu_S6_S3 1 100 0 12 DISPLAY_IDENTIFIER diag_schaltung_ueber_kzu.iSasBerechnungGls ECU_ADDRESS 0xFFF8F16E /end MEASUREMENT
/begin MEASUREMENT iSasRegelungGls.gls_para.cBibRegle._.stellgr_i_alt "verzoegerte I-Stellgroesse" SWORD UMR___1_1_0_S6_S3 1 100 -32768 32767 DISPLAY_IDENTIFIER stellgr_i_alt._.cBibRegle.gls_para.iSasRegelungGls ECU_ADDRESS 0xFFF8F1A8 /end MEASUREMENT
/begin MEASUREMENT iSasRegelungGls.gls_para.cBibRegle._.stellgr_d_alt "verzoegerte D-Stellgroesse" SWORD UMR___1_1_0_S6_S3 1 100 -32768 32767 DISPLAY_IDENTIFIER stellgr_d_alt._.cBibRegle.gls_para.iSasRegelungGls ECU_ADDRESS 0xFFF8F1AA /end MEASUREMENT
/begin MEASUREMENT iSasRegelungGls.gls_para.cBibRegle._.faktor_p "Param. P-Anteil" UWORD UMR___1_1_0_S6_S3 1 100 0 65535 DISPLAY_IDENTIFIER faktor_p._.cBibRegle.gls_para.iSasRegelungGls ECU_ADDRESS 0xFFF8F1AC /end MEASUREMENT
/begin MEASUREMENT iSasRegelungGls.gls_para.cBibRegle._.faktor_i "Param. I-Anteil" UWORD UMR___1_1_0_S6_S3 1 100 0 65535 DISPLAY_IDENTIFIER faktor_i._.cBibRegle.gls_para.iSasRegelungGls ECU_ADDRESS 0xFFF8F1AE /end MEASUREMENT
/begin MEASUREMENT iSasRegelungGls.gls_para.cBibRegle._.faktor_d "Param. D-Anteil" UWORD UMR___1_1_0_S6_S3 1 100 0 65535 DISPLAY_IDENTIFIER faktor_d._.cBibRegle.gls_para.iSasRegelungGls ECU_ADDRESS 0xFFF8F1B0 /end MEASUREMENT
/begin MEASUREMENT iSasRegelungGls.gls_para.cBibRegle._.faktor_t1 "Param. T1-Anteil" UWORD UMR___1_1_0_S6_S3 1 100 0 65535 DISPLAY_IDENTIFIER faktor_t1._.cBibRegle.gls_para.iSasRegelungGls ECU_ADDRESS 0xFFF8F1B2 /end MEASUREMENT
/begin MEASUREMENT iSasRegelungGls.gls_para.cBibRegle._.stell_max "maximale Stellgroesse" SWORD UMR___1_1_0_S6_S3 1 100 -32768 32767 DISPLAY_IDENTIFIER stell_max._.cBibRegle.gls_para.iSasRegelungGls ECU_ADDRESS 0xFFF8F1B4 /end MEASUREMENT
/begin MEASUREMENT iSasRegelungGls.gls_para.cBibRegle._.stell_min "minimale Stellgroesse" SWORD UMR___1_1_0_S6_S3 1 100 -32768 32767 DISPLAY_IDENTIFIER stell_min._.cBibRegle.gls_para.iSasRegelungGls ECU_ADDRESS 0xFFF8F1B6 /end MEASUREMENT
/begin MEASUREMENT iSasRegelungGls.gls_para.cBibRegle._.regel_diff_alt "verzoeg. Regeldifferenz" SWORD UMR___1_1_0_S6_S3 1 100 -32768 32767 DISPLAY_IDENTIFIER regel_diff_alt._.cBibRegle.gls_para.iSasRegelungGls ECU_ADDRESS 0xFFF8F1B8 /end MEASUREMENT
/begin MEASUREMENT iSasRegelungGls.gls_para.cBibRegle._.stellgr_alt "verzoegerte Stellgroesse" SWORD UMR___1_1_0_S6_S3 1 100 -32768 32767 DISPLAY_IDENTIFIER stellgr_alt._.cBibRegle.gls_para.iSasRegelungGls ECU_ADDRESS 0xFFF8F1BA /end MEASUREMENT
/begin MEASUREMENT iSasRegelungGls.gls_para.cBibRegle._.stellgr_i_modulo "Ganzzahl. Rest d. I-Quotient" SWORD UMR___1_1_0_S6_S3 1 100 -32768 32767 DISPLAY_IDENTIFIER stellgr_i_modulo._.cBibRegle.gls_para.iSasRegelungGls ECU_ADDRESS 0xFFF8F1BC /end MEASUREMENT
/begin MEASUREMENT iSasRegelungGls.i_wngtgls_filter.x "Filterwert" SLONG UMR___1_300_0_S6_S3 1 100 -7158278.82667 7158278.82333 DISPLAY_IDENTIFIER i_wngtgls_filter.iSasRegelungGls ECU_ADDRESS 0xFFF8F1C0 /end MEASUREMENT
/begin MEASUREMENT iSasRegelungGls.p_gls_kzu "Druck GLS bei Regelung der KZU" SWORD UMR_BAR__1_1000_0_S6_S3 1 100 -32 32 DISPLAY_IDENTIFIER p_gls_kzu.iSasRegelungGls ECU_ADDRESS 0xFFF8F194 /end MEASUREMENT
/begin MEASUREMENT iSasRegelungGls.p_gls_kab "Druck GLS bei Regelung der KAB" SWORD UMR_BAR__1_1000_0_S6_S3 1 100 -32 32 DISPLAY_IDENTIFIER p_gls_kab.iSasRegelungGls ECU_ADDRESS 0xFFF8F196 /end MEASUREMENT
/begin MEASUREMENT iSasRegelungGls.zug_schub_gls "Flag: Zug Schub der GLS" UBYTE Conv.cSasRegelungGls._.zug_schub_gls_S6_S3 1 100 0 1 DISPLAY_IDENTIFIER zug_schub_gls.iSasRegelungGls ECU_ADDRESS 0xFFF8F198 /end MEASUREMENT
/begin MEASUREMENT iSasRegelungGls.p_gls "Druck GLS" SWORD UMR_BAR__1_1000_0_S6_S3 1 100 -32 32 DISPLAY_IDENTIFIER p_gls.iSasRegelungGls ECU_ADDRESS 0xFFF8F19A /end MEASUREMENT
/begin MEASUREMENT iSasRegelungGls.p_i_gls "I-Anteil Druck GLS" SWORD UMR_BAR__1_1000_0_S6_S3 1 100 -32 32 DISPLAY_IDENTIFIER p_i_gls.iSasRegelungGls ECU_ADDRESS 0xFFF8F19C /end MEASUREMENT
/begin MEASUREMENT iSasRegelungGls.p_p_gls "P-Anteil Druck GLS" SWORD UMR_BAR__1_1000_0_S6_S3 1 100 -32 32 DISPLAY_IDENTIFIER p_p_gls.iSasRegelungGls ECU_ADDRESS 0xFFF8F19E /end MEASUREMENT
/begin MEASUREMENT iSasRegelungGls.z_gls_regler "Zustand Gls-Regler" UBYTE Conv.cSasRegelungGls._.z_gls_regler_S6_S3 1 100 0 5 DISPLAY_IDENTIFIER z_gls_regler.iSasRegelungGls ECU_ADDRESS 0xFFF8F1A0 /end MEASUREMENT
/begin MEASUREMENT iSasRegelungGls.p_maxgls "Maximale Druckgrenze der Regeldruckdifferenz GLS" SWORD UMR_BAR__1_1000_0_S6_S3 1 100 -32 32 DISPLAY_IDENTIFIER p_maxgls.iSasRegelungGls ECU_ADDRESS 0xFFF8F1A2 /end MEASUREMENT
/begin MEASUREMENT iSasRegelungGls.p_mingls "Minimale Druckgrenze der Regeldruckdifferenz GLS" SWORD UMR_BAR__1_1000_0_S6_S3 1 100 -32 32 DISPLAY_IDENTIFIER p_mingls.iSasRegelungGls ECU_ADDRESS 0xFFF8F1A4 /end MEASUREMENT
/begin MEASUREMENT iSasRegelungGls.regeldiff "Regeldifferenz" SWORD UMR_U_MINSEC_10000_32767_0_S6_S3 1 100 -9765.92303232 9765.92303232 DISPLAY_IDENTIFIER regeldiff.iSasRegelungGls ECU_ADDRESS 0xFFF8F1A6 /end MEASUREMENT
/begin MEASUREMENT iSasZentr.iSchaltend.iKab.pgo_kab_speicher.cBibRampeGradSi16._.letzter_wert "Speichert den letzten Eingangswert" FLOAT32_IEEE UMR___1_1_0_S6_S3 1 100 -1E+037 1E+037 FORMAT "%4.2" DISPLAY_IDENTIFIER letzter_wert._.cBibRampeGradSi16.pgo_kab_speicher.iKab.iSchaltend.iSasZentr ECU_ADDRESS 0xFFF8D6F8 /end MEASUREMENT
/begin MEASUREMENT iSasZentr.iSchaltend.iKab.pgo_kab_speicher.cBibRampeGradSi16._.letzter_ms_timer "Speichert den letzten BS-Timer" UWORD UMR_MSEC__1_1_0_S6_S3 1 100 0 65535 DISPLAY_IDENTIFIER letzter_ms_timer._.cBibRampeGradSi16.pgo_kab_speicher.iKab.iSchaltend.iSasZentr ECU_ADDRESS 0xFFF8D6FC /end MEASUREMENT
/begin MEASUREMENT iSasZentr.iSchaltend.iKab.pgo_kab_speicher.cBibRampeGradSi16._.minimum "Minimum Begrenzung" FLOAT32_IEEE UMR___1_1_0_S6_S3 1 100 -1E+037 1E+037 FORMAT "%4.2" DISPLAY_IDENTIFIER minimum._.cBibRampeGradSi16.pgo_kab_speicher.iKab.iSchaltend.iSasZentr ECU_ADDRESS 0xFFF8D700 /end MEASUREMENT
/begin MEASUREMENT iSasZentr.iSchaltend.iKab.pgo_kab_speicher.cBibRampeGradSi16._.maximum "Maximum Begrenzung" FLOAT32_IEEE UMR___1_1_0_S6_S3 1 100 -1E+037 1E+037 FORMAT "%4.2" DISPLAY_IDENTIFIER maximum._.cBibRampeGradSi16.pgo_kab_speicher.iKab.iSchaltend.iSasZentr ECU_ADDRESS 0xFFF8D704 /end MEASUREMENT
/begin MEASUREMENT iSasZentr.iSchaltend.iKab.raph_kab_speicher.letzter_wert "Speichert den letzten Eingangswert" SLONG UMR___1_1_0_S6_S3 1 100 -2147483648 2147483647 DISPLAY_IDENTIFIER letzter_wert.raph_kab_speicher.iKab.iSchaltend.iSasZentr ECU_ADDRESS 0xFFF8D70C /end MEASUREMENT
/begin MEASUREMENT iSasZentr.iSchaltend.iKab.raph_kab_speicher.letzter_timer "Speichert den letzten BS-Timer" UBYTE UMR_SEC__1_1_0_S6_S3 1 100 0 255 DISPLAY_IDENTIFIER letzter_timer.raph_kab_speicher.iKab.iSchaltend.iSasZentr ECU_ADDRESS 0xFFF8D710 /end MEASUREMENT
/begin MEASUREMENT iSasZentr.iSchaltend.iKab.raps_kab_speicher.letzter_wert "Speichert den letzten Eingangswert" SLONG UMR___1_1_0_S6_S3 1 100 -2147483648 2147483647 DISPLAY_IDENTIFIER letzter_wert.raps_kab_speicher.iKab.iSchaltend.iSasZentr ECU_ADDRESS 0xFFF8D714 /end MEASUREMENT
/begin MEASUREMENT iSasZentr.iSchaltend.iKab.raps_kab_speicher.letzter_timer "Speichert den letzten BS-Timer" UBYTE UMR_SEC__1_1_0_S6_S3 1 100 0 255 DISPLAY_IDENTIFIER letzter_timer.raps_kab_speicher.iKab.iSchaltend.iSasZentr ECU_ADDRESS 0xFFF8D718 /end MEASUREMENT
/begin MEASUREMENT iSasZentr.iSchaltend.iKab.ende_kab_gestartet "Flag: Zustand Ende der abschaltenden Kupplung gestartet" UBYTE Conv.cSasAnKab._.ende_kab_gestartet_S6_S3 1 100 0 1 BIT_MASK 0x1 DISPLAY_IDENTIFIER ende_kab_gestartet.iKab.iSchaltend.iSasZentr ECU_ADDRESS 0xFFF8D6A8 /end MEASUREMENT
/begin MEASUREMENT iSasZentr.iSchaltend.iKab.pkf_rs_kab_gestartet "Flag: Kennfeldzugriff KAB (bei ZR) gestartet bzw. Rampe hat Kennfelddruck erreicht" UBYTE Conv.cSasAnKab._.pkf_rs_kab_gestartet_S6_S3 1 100 0 1 BIT_MASK 0x1 DISPLAY_IDENTIFIER pkf_rs_kab_gestartet.iKab.iSchaltend.iSasZentr ECU_ADDRESS 0xFFF8D6A9 /end MEASUREMENT
/begin MEASUREMENT iSasZentr.iSchaltend.iKab.p_stkab "Gesteuerter Druckanteil KAB" SWORD UMR_BAR__1_1000_0_S6_S3 1 100 0 20 DISPLAY_IDENTIFIER p_stkab.iKab.iSchaltend.iSasZentr ECU_ADDRESS 0xFFF8D6AA /end MEASUREMENT
/begin MEASUREMENT iSasZentr.iSchaltend.iKab.ps_hs_kab_gestartet "Flag: Schaltdruckphase KAB gestartet" UBYTE Conv.cSasAnKab._.ps_hs_kab_gestartet_S6_S3 1 100 0 1 BIT_MASK 0x1 DISPLAY_IDENTIFIER ps_hs_kab_gestartet.iKab.iSchaltend.iSasZentr ECU_ADDRESS 0xFFF8D6AC /end MEASUREMENT
/begin MEASUREMENT iSasZentr.iSchaltend.iKab.ra1_kab_gestartet "Flag: Rampe 1 KAB gestartet" UBYTE Conv.cSasAnKab._.ra1_kab_gestartet_S6_S3 1 100 0 1 BIT_MASK 0x1 DISPLAY_IDENTIFIER ra1_kab_gestartet.iKab.iSchaltend.iSasZentr ECU_ADDRESS 0xFFF8D6AD /end MEASUREMENT
/begin MEASUREMENT iSasZentr.iSchaltend.iKab.statisch_kab "Flag: Anzeige ob KAB eine Druckvorgabe ausgibt oder Minimal/Maximaldruck angesteuert wird" UBYTE Conv.cSasAnKab._.statisch_kab_S6_S3 1 100 0 1 BIT_MASK 0x1 DISPLAY_IDENTIFIER statisch_kab.iKab.iSchaltend.iSasZentr ECU_ADDRESS 0xFFF8D6AE /end MEASUREMENT
/begin MEASUREMENT iSasZentr.iSchaltend.iKab.ueb_rs_kab_gestartet "Flag: Ueberschneidungsphase abschaltende Kupplung (bei ZR-Schaltung) gestartet" UBYTE Conv.cSasAnKab._.ueb_rs_kab_gestartet_S6_S3 1 100 0 1 BIT_MASK 0x1 DISPLAY_IDENTIFIER ueb_rs_kab_gestartet.iKab.iSchaltend.iSasZentr ECU_ADDRESS 0xFFF8D6AF /end MEASUREMENT
/begin MEASUREMENT iSasZentr.iSchaltend.iKab.kup_kab "Kupplungsnummer Abschaltende Kupplung" UBYTE Conv.cSasAnKab._.kup_kab_S6_S3 1 100 0 5 DISPLAY_IDENTIFIER kup_kab.iKab.iSchaltend.iSasZentr ECU_ADDRESS 0xFFF8D6B0 /end MEASUREMENT
/begin MEASUREMENT iSasZentr.iSchaltend.iKab.z_kab "Zustand abschaltende Kupplung" UBYTE Conv.cSasAnKab._.z_kab_S6_S3 1 100 0 19 DISPLAY_IDENTIFIER z_kab.iKab.iSchaltend.iSasZentr ECU_ADDRESS 0xFFF8D6B1 /end MEASUREMENT
/begin MEASUREMENT iSasZentr.iSchaltend.iKab.ra_sd_hs_kab_gestartet "Flag: Rampe auf Schaltdruck KAB bei HS ist gestartet" UBYTE Conv.cSasAnKab._.ra_sd_hs_kab_gestartet_S6_S3 1 100 0 1 BIT_MASK 0x1 DISPLAY_IDENTIFIER ra_sd_hs_kab_gestartet.iKab.iSchaltend.iSasZentr ECU_ADDRESS 0xFFF8D6B2 /end MEASUREMENT
/begin MEASUREMENT iSasZentr.iSchaltend.iKab.ra_sd_rs_kab_gestartet "Flag: Rampe auf Schaltdruck KAB bei RS ist gestartet" UBYTE Conv.cSasAnKab._.ra_sd_rs_kab_gestartet_S6_S3 1 100 0 1 BIT_MASK 0x1 DISPLAY_IDENTIFIER ra_sd_rs_kab_gestartet.iKab.iSchaltend.iSasZentr ECU_ADDRESS 0xFFF8D6B3 /end MEASUREMENT
/begin MEASUREMENT iSasZentr.iSchaltend.iKab.halten_in_syn_kab_gestartet "Flag: Ablauf Halten in Synchron fuer die KAB gestartet" UBYTE Conv.cSasAnKab._.halten_in_syn_kab_gestartet_S6_S3 1 100 0 1 BIT_MASK 0x1 DISPLAY_IDENTIFIER halten_in_syn_kab_gestartet.iKab.iSchaltend.iSasZentr ECU_ADDRESS 0xFFF8D6B4 /end MEASUREMENT
/begin MEASUREMENT iSasZentr.iSchaltend.iKab.p_kab "Druck KAB (inklusive GLS-Druck)" SWORD UMR_BAR__1_1000_0_S6_S3 1 100 0 20 DISPLAY_IDENTIFIER p_kab.iKab.iSchaltend.iSasZentr ECU_ADDRESS 0xFFF8D6B6 /end MEASUREMENT
/begin MEASUREMENT iSasZentr.iSchaltend.iKab.p_adaptkab "Adaptionsdruck abschaltende Kupplung" SWORD UMR_BAR__1_1000_0_S6_S3 1 100 0 20 DISPLAY_IDENTIFIER p_adaptkab.iKab.iSchaltend.iSasZentr ECU_ADDRESS 0xFFF8D6B8 /end MEASUREMENT
/begin MEASUREMENT iSasZentr.iSchaltend.iKab.timer_zkab "Zustandstimer abschaltende Kupplung" UBYTE UMR_MSEC__10_1_0_S6_S3 1 100 0 2550 DISPLAY_IDENTIFIER timer_zkab.iKab.iSchaltend.iSasZentr ECU_ADDRESS 0xFFF8D6BA /end MEASUREMENT
/begin MEASUREMENT iSasZentr.iSchaltend.iKab.gls_hs_kab_gestartet "Flag: GLS der KAB kann starten" UBYTE Conv.cSasAnKab._.gls_hs_kab_gestartet_S6_S3 1 100 0 1 BIT_MASK 0x1 DISPLAY_IDENTIFIER gls_hs_kab_gestartet.iKab.iSchaltend.iSasZentr ECU_ADDRESS 0xFFF8D6BB /end MEASUREMENT
/begin MEASUREMENT iSasZentr.iSchaltend.iKab.pkf_rs_kab_ausgegeben "Flag: Druck aus Kennfeld wird ausgegeben" UBYTE Conv.cSasAnKab._.pkf_rs_kab_ausgegeben_S6_S3 1 100 0 1 BIT_MASK 0x1 DISPLAY_IDENTIFIER pkf_rs_kab_ausgegeben.iKab.iSchaltend.iSasZentr ECU_ADDRESS 0xFFF8D6BC /end MEASUREMENT
/begin MEASUREMENT iSasZentr.iSchaltend.iKab.kab_nicht_befuellt "Flag: Kupplung KAB nicht befuellt" UBYTE Conv.cSasAnKab._.kab_nicht_befuellt_S6_S3 1 100 0 1 BIT_MASK 0x1 DISPLAY_IDENTIFIER kab_nicht_befuellt.iKab.iSchaltend.iSasZentr ECU_ADDRESS 0xFFF8D6BD /end MEASUREMENT
/begin MEASUREMENT iSasZentr.iSchaltend.iKab.f_ende_verz_kab_erlaubt "Flag: Bedingung fuer Ende Verzoegerung KAB erfuellt" UBYTE Conv.cSasAnKab._.f_ende_verz_kab_erlaubt_S6_S3 1 100 0 1 BIT_MASK 0x1 DISPLAY_IDENTIFIER f_ende_verz_kab_erlaubt.iKab.iSchaltend.iSasZentr ECU_ADDRESS 0xFFF8D6BE /end MEASUREMENT
/begin MEASUREMENT iSasZentr.iSchaltend.iKab.f_best_poffkab_in_syn_erfolgt "Flag: Neubestimmung p_offkab in Synchron erfolgt" UBYTE Conv.cSasAnKab._.f_best_poffkab_in_syn_erfolgt_S6_S3 1 100 0 1 BIT_MASK 0x1 DISPLAY_IDENTIFIER f_best_poffkab_in_syn_erfolgt.iKab.iSchaltend.iSasZentr ECU_ADDRESS 0xFFF8D6BF /end MEASUREMENT
/begin MEASUREMENT iSasZentr.iSchaltend.iKab.zaehler_zkab "Zustandszaehler der abschaltenden Kupplung" UBYTE UMR___1_1_0_S6_S3 1 100 0 255 DISPLAY_IDENTIFIER zaehler_zkab.iKab.iSchaltend.iSasZentr ECU_ADDRESS 0xFFF8D6C0 /end MEASUREMENT
/begin MEASUREMENT iSasZentr.iSchaltend.iKab.schalttyp_kab "Schalttyp der absch. Kupplung" UBYTE Conv.cSasAnKab._.schalttyp_kab_S6_S3 1 100 0 4 DISPLAY_IDENTIFIER schalttyp_kab.iKab.iSchaltend.iSasZentr ECU_ADDRESS 0xFFF8D6C1 /end MEASUREMENT
/begin MEASUREMENT iSasZentr.iSchaltend.iKab.p_0stkab "Zustandsanfangsdruck gesteuerter Anteil der absch. Kupplung" SWORD UMR_BAR__1_1000_0_S6_S3 1 100 -32 32 DISPLAY_IDENTIFIER p_0stkab.iKab.iSchaltend.iSasZentr ECU_ADDRESS 0xFFF8D6C2 /end MEASUREMENT
/begin MEASUREMENT iSasZentr.iSchaltend.iKab.p_offkab "Offsetdruck der abschaltenden Kupplung" SWORD UMR_BAR__1_1000_0_S6_S3 1 100 -32 32 DISPLAY_IDENTIFIER p_offkab.iKab.iSchaltend.iSasZentr ECU_ADDRESS 0xFFF8D6C4 /end MEASUREMENT
/begin MEASUREMENT iSasZentr.iSchaltend.iKab.po_mtkab "Momentenabhaengiger Druckoffset der KAB" SWORD UMR_BAR__1_1000_0_S6_S3 1 100 -32 32 DISPLAY_IDENTIFIER po_mtkab.iKab.iSchaltend.iSasZentr ECU_ADDRESS 0xFFF8D6C6 /end MEASUREMENT
/begin MEASUREMENT iSasZentr.iSchaltend.iKab.t_zkab "Zustandszeitdauer der absch. Kupplung" SWORD UMR_MSEC__10_1_0_S6_S3 1 100 -327680 327670 DISPLAY_IDENTIFIER t_zkab.iKab.iSchaltend.iSasZentr ECU_ADDRESS 0xFFF8D6C8 /end MEASUREMENT
/begin MEASUREMENT iSasZentr.iSchaltend.iKab.t_0kab "Zeitdauer des zuletzt durchlaufenen Zustands der absch. Kupplung" SWORD UMR_MSEC__10_1_0_S6_S3 1 100 -327680 327670 DISPLAY_IDENTIFIER t_0kab.iKab.iSchaltend.iSasZentr ECU_ADDRESS 0xFFF8D6CA /end MEASUREMENT
/begin MEASUREMENT iSasZentr.iSchaltend.iKab.t_ph_rs "Berechnete Zeitdauer Haltedruckphase der absch. Kupplung während RS" SLONG UMR_MSEC__10_1_0_S6_S3 1 100 -327680 327670 DISPLAY_IDENTIFIER t_ph_rs.iKab.iSchaltend.iSasZentr ECU_ADDRESS 0xFFF8D6CC /end MEASUREMENT
/begin MEASUREMENT iSasZentr.iSchaltend.iKab.t_verz_ph_rs "Berechnete Zeitdauer Verzögerung der Haltedruckphase der absch. Kupplung während RS" SWORD UMR_MSEC__10_1_0_S6_S3 1 100 -327680 327670 DISPLAY_IDENTIFIER t_verz_ph_rs.iKab.iSchaltend.iSasZentr ECU_ADDRESS 0xFFF8D6D0 /end MEASUREMENT
/begin MEASUREMENT iSasZentr.iSchaltend.iKab.t_ra_kab_vor_ra1_kzu "Anteil Dauer der KAB-Rampe auf Schaltdruck vor Start der KZU-Rampe auf Schaltdruck" SWORD UMR_MSEC__10_1_0_S6_S3 1 100 -327680 327670 DISPLAY_IDENTIFIER t_ra_kab_vor_ra1_kzu.iKab.iSchaltend.iSasZentr ECU_ADDRESS 0xFFF8D6D2 /end MEASUREMENT
/begin MEASUREMENT iSasZentr.iSchaltend.iKab.timer_hinsyn "Zeit seit Start Rampe auf Halten in Synchron" UBYTE UMR_MSEC__10_1_0_S6_S3 1 100 0 2550 DISPLAY_IDENTIFIER timer_hinsyn.iKab.iSchaltend.iSasZentr ECU_ADDRESS 0xFFF8D6D4 /end MEASUREMENT
/begin MEASUREMENT iSasZentr.iSchaltend.iKab.p_kfkab "Kennfelddruck gesteuerter Anteil der absch. Kupplung" SWORD UMR_BAR__1_1000_0_S6_S3 1 100 0 32 DISPLAY_IDENTIFIER p_kfkab.iKab.iSchaltend.iSasZentr ECU_ADDRESS 0xFFF8D6D6 /end MEASUREMENT
/begin MEASUREMENT iSasZentr.iSchaltend.iKab.md_motsoll_sas "Motorsollmomentanstieg fuer KF-Zugriff abschalt. Kupplung" SWORD UMR_NM__1_1_0_S6_S3 1 100 -2000 2000 DISPLAY_IDENTIFIER md_motsoll_sas.iKab.iSchaltend.iSasZentr ECU_ADDRESS 0xFFF8D6D8 /end MEASUREMENT
/begin MEASUREMENT iSasZentr.iSchaltend.iKab.m_motsoll0_sas "Motorsollmoment bei Start Rampe auf Schaltdruck" SWORD UMR_NM__1_1_0_S6_S3 1 100 -2000 2000 DISPLAY_IDENTIFIER m_motsoll0_sas.iKab.iSchaltend.iSasZentr ECU_ADDRESS 0xFFF8D6DA /end MEASUREMENT
/begin MEASUREMENT iSasZentr.iSchaltend.iKzu.pgo_kzu_speicher.cBibRampeGradSi16._.letzter_wert "Speichert den letzten Eingangswert" FLOAT32_IEEE UMR___1_1_0_S6_S3 1 100 -1E+037 1E+037 FORMAT "%4.2" DISPLAY_IDENTIFIER letzter_wert._.cBibRampeGradSi16.pgo_kzu_speicher.iKzu.iSchaltend.iSasZentr ECU_ADDRESS 0xFFF8D780 /end MEASUREMENT
/begin MEASUREMENT iSasZentr.iSchaltend.iKzu.pgo_kzu_speicher.cBibRampeGradSi16._.letzter_ms_timer "Speichert den letzten BS-Timer" UWORD UMR_MSEC__1_1_0_S6_S3 1 100 0 65535 DISPLAY_IDENTIFIER letzter_ms_timer._.cBibRampeGradSi16.pgo_kzu_speicher.iKzu.iSchaltend.iSasZentr ECU_ADDRESS 0xFFF8D784 /end MEASUREMENT
/begin MEASUREMENT iSasZentr.iSchaltend.iKzu.pgo_kzu_speicher.cBibRampeGradSi16._.minimum "Minimum Begrenzung" FLOAT32_IEEE UMR___1_1_0_S6_S3 1 100 -1E+037 1E+037 FORMAT "%4.2" DISPLAY_IDENTIFIER minimum._.cBibRampeGradSi16.pgo_kzu_speicher.iKzu.iSchaltend.iSasZentr ECU_ADDRESS 0xFFF8D788 /end MEASUREMENT
/begin MEASUREMENT iSasZentr.iSchaltend.iKzu.pgo_kzu_speicher.cBibRampeGradSi16._.maximum "Maximum Begrenzung" FLOAT32_IEEE UMR___1_1_0_S6_S3 1 100 -1E+037 1E+037 FORMAT "%4.2" DISPLAY_IDENTIFIER maximum._.cBibRampeGradSi16.pgo_kzu_speicher.iKzu.iSchaltend.iSasZentr ECU_ADDRESS 0xFFF8D78C /end MEASUREMENT
/begin MEASUREMENT iSasZentr.iSchaltend.iKzu.raph_kzu_speicher.letzter_wert "Speichert den letzten Eingangswert" SLONG UMR___1_1_0_S6_S3 1 100 -2147483648 2147483647 DISPLAY_IDENTIFIER letzter_wert.raph_kzu_speicher.iKzu.iSchaltend.iSasZentr ECU_ADDRESS 0xFFF8D794 /end MEASUREMENT
/begin MEASUREMENT iSasZentr.iSchaltend.iKzu.raph_kzu_speicher.letzter_timer "Speichert den letzten BS-Timer" UBYTE UMR_SEC__1_1_0_S6_S3 1 100 0 255 DISPLAY_IDENTIFIER letzter_timer.raph_kzu_speicher.iKzu.iSchaltend.iSasZentr ECU_ADDRESS 0xFFF8D798 /end MEASUREMENT
/begin MEASUREMENT iSasZentr.iSchaltend.iKzu.fa_kzu_gestartet "Flag: Fuellausgleich KZU gestartet" UBYTE Conv.cSasAnKzu._.fa_kzu_gestartet_S6_S3 1 100 0 1 BIT_MASK 0x1 DISPLAY_IDENTIFIER fa_kzu_gestartet.iKzu.iSchaltend.iSasZentr ECU_ADDRESS 0xFFF8D71C /end MEASUREMENT
/begin MEASUREMENT iSasZentr.iSchaltend.iKzu.p_stkzu "Gesteuerter Druckanteil KZU" SWORD UMR_BAR__1_1000_0_S6_S3 1 100 0 20 DISPLAY_IDENTIFIER p_stkzu.iKzu.iSchaltend.iSasZentr ECU_ADDRESS 0xFFF8D71E /end MEASUREMENT
/begin MEASUREMENT iSasZentr.iSchaltend.iKzu.ra1_hsrs_kzu_gestartet "Flag: Rampe 1 KZU gestartet" UBYTE Conv.cSasAnKzu._.ra1_hsrs_kzu_gestartet_S6_S3 1 100 0 1 BIT_MASK 0x1 DISPLAY_IDENTIFIER ra1_hsrs_kzu_gestartet.iKzu.iSchaltend.iSasZentr ECU_ADDRESS 0xFFF8D720 /end MEASUREMENT
/begin MEASUREMENT iSasZentr.iSchaltend.iKzu.ra2_hsrs_kzu_gestartet "Flag: Rampe 2 KZU gestartet" UBYTE Conv.cSasAnKzu._.ra2_hsrs_kzu_gestartet_S6_S3 1 100 0 1 BIT_MASK 0x1 DISPLAY_IDENTIFIER ra2_hsrs_kzu_gestartet.iKzu.iSchaltend.iSasZentr ECU_ADDRESS 0xFFF8D721 /end MEASUREMENT
/begin MEASUREMENT iSasZentr.iSchaltend.iKzu.ra3_hsrs_kzu_gestartet "Flag: Rampe 3 KZU gestartet" UBYTE Conv.cSasAnKzu._.ra3_hsrs_kzu_gestartet_S6_S3 1 100 0 1 BIT_MASK 0x1 DISPLAY_IDENTIFIER ra3_hsrs_kzu_gestartet.iKzu.iSchaltend.iSasZentr ECU_ADDRESS 0xFFF8D722 /end MEASUREMENT
/begin MEASUREMENT iSasZentr.iSchaltend.iKzu.schliessen_kzu "Flag: KZU soll schliessen" UBYTE Conv.cSasAnKzu._.schliessen_kzu_S6_S3 1 100 0 1 BIT_MASK 0x1 DISPLAY_IDENTIFIER schliessen_kzu.iKzu.iSchaltend.iSasZentr ECU_ADDRESS 0xFFF8D723 /end MEASUREMENT
/begin MEASUREMENT iSasZentr.iSchaltend.iKzu.statisch_kzu "Flag: Anzeige ob KAB eine Druckvorgabe ausgibt oder Minimal/Maximaldruck angesteuert wird" UBYTE Conv.cSasAnKzu._.statisch_kzu_S6_S3 1 100 0 1 BIT_MASK 0x1 DISPLAY_IDENTIFIER statisch_kzu.iKzu.iSchaltend.iSasZentr ECU_ADDRESS 0xFFF8D724 /end MEASUREMENT
/begin MEASUREMENT iSasZentr.iSchaltend.iKzu.timer16_ra1_hsrs_kzu "Zeit seit Start Rampe 1 KZU" UWORD UMR_MSEC__10_1_0_S6_S3 1 100 0 655350 DISPLAY_IDENTIFIER timer16_ra1_hsrs_kzu.iKzu.iSchaltend.iSasZentr ECU_ADDRESS 0xFFF8D726 /end MEASUREMENT
/begin MEASUREMENT iSasZentr.iSchaltend.iKzu.t_eff_ra1_hsrs_kzu "Effektive Zeit Rampe 1 KZU" UWORD UMR_MSEC__10_1_0_S6_S3 1 100 0 655350 DISPLAY_IDENTIFIER t_eff_ra1_hsrs_kzu.iKzu.iSchaltend.iSasZentr ECU_ADDRESS 0xFFF8D728 /end MEASUREMENT
/begin MEASUREMENT iSasZentr.iSchaltend.iKzu.timer_start_fa_kzu "Zeit seit Start Fuellausgleichsphase" UBYTE UMR_MSEC__10_1_0_S6_S3 1 100 0 2550 DISPLAY_IDENTIFIER timer_start_fa_kzu.iKzu.iSchaltend.iSasZentr ECU_ADDRESS 0xFFF8D72A /end MEASUREMENT
/begin MEASUREMENT iSasZentr.iSchaltend.iKzu.t_dt_ig_change "Zeit für Momentenübergang" UBYTE UMR_MSEC__10_1_0_S6_S3 1 100 0 2540 DISPLAY_IDENTIFIER t_dt_ig_change.iKzu.iSchaltend.iSasZentr ECU_ADDRESS 0xFFF8D72B /end MEASUREMENT
/begin MEASUREMENT iSasZentr.iSchaltend.iKzu.z_kzu "Zustand zuschaltende Kupplung in einer Schaltung" UBYTE Conv.cSasAnKzu._.z_kzu_S6_S3 1 100 0 19 DISPLAY_IDENTIFIER z_kzu.iKzu.iSchaltend.iSasZentr ECU_ADDRESS 0xFFF8D72C /end MEASUREMENT
/begin MEASUREMENT iSasZentr.iSchaltend.iKzu.kup_kzu "Kupplungsnummer Zuschaltende Kupplung" UBYTE Conv.cSasAnKzu._.kup_kzu_S6_S3 1 100 0 5 DISPLAY_IDENTIFIER kup_kzu.iKzu.iSchaltend.iSasZentr ECU_ADDRESS 0xFFF8D72D /end MEASUREMENT
/begin MEASUREMENT iSasZentr.iSchaltend.iKzu.t_besfhsrskzu "Zeit bis Ende Schnellfuellung" SWORD UMR_MSEC__1_1_0_S6_S3 1 100 -32768 32767 DISPLAY_IDENTIFIER t_besfhsrskzu.iKzu.iSchaltend.iSasZentr ECU_ADDRESS 0xFFF8D72E /end MEASUREMENT
/begin MEASUREMENT iSasZentr.iSchaltend.iKzu.p_kzu "Druck KZU (inklusive GLS-Druck)" SWORD UMR_BAR__1_1000_0_S6_S3 1 100 0 20 DISPLAY_IDENTIFIER p_kzu.iKzu.iSchaltend.iSasZentr ECU_ADDRESS 0xFFF8D730 /end MEASUREMENT
/begin MEASUREMENT iSasZentr.iSchaltend.iKzu.p_adaptkzu "Adaptionsdruck zuschaltende Kupplung" SWORD UMR_BAR__1_1000_0_S6_S3 1 100 0 20 DISPLAY_IDENTIFIER p_adaptkzu.iKzu.iSchaltend.iSasZentr ECU_ADDRESS 0xFFF8D732 /end MEASUREMENT
/begin MEASUREMENT iSasZentr.iSchaltend.iKzu.timer_zkzu "Zustandstimer zuschaltende Kupplung" UBYTE UMR_MSEC__10_1_0_S6_S3 1 100 0 2550 DISPLAY_IDENTIFIER timer_zkzu.iKzu.iSchaltend.iSasZentr ECU_ADDRESS 0xFFF8D734 /end MEASUREMENT
/begin MEASUREMENT iSasZentr.iSchaltend.iKzu.t_schliessrampe "Zeit für Schliessrampe" UBYTE UMR_MSEC__10_1_0_S6_S3 1 100 0 2540 DISPLAY_IDENTIFIER t_schliessrampe.iKzu.iSchaltend.iSasZentr ECU_ADDRESS 0xFFF8D735 /end MEASUREMENT
/begin MEASUREMENT iSasZentr.iSchaltend.iKzu.timer_seit_start_schaltung "Zeit seit Start Schaltung" UBYTE UMR_MSEC__10_1_0_S6_S3 1 100 0 2550 DISPLAY_IDENTIFIER timer_seit_start_schaltung.iKzu.iSchaltend.iSasZentr ECU_ADDRESS 0xFFF8D736 /end MEASUREMENT
/begin MEASUREMENT iSasZentr.iSchaltend.iKzu.t_berechnungszeitpunkt "Zeitpunkt für Berechnungsstart" SWORD UMR_MSEC__10_1_0_S6_S3 1 100 -327680 327670 DISPLAY_IDENTIFIER t_berechnungszeitpunkt.iKzu.iSchaltend.iSasZentr ECU_ADDRESS 0xFFF8D738 /end MEASUREMENT
/begin MEASUREMENT iSasZentr.iSchaltend.iKzu.f_rampenzeitberechnung_fertig "Flag: Die Berechnung der Schliessrampenzeit erfolgt einmalig" UBYTE Conv.cSasAnKzu._.f_rampenzeitberechnung_fertig_S6_S3 1 100 0 1 BIT_MASK 0x1 DISPLAY_IDENTIFIER f_rampenzeitberechnung_fertig.iKzu.iSchaltend.iSasZentr ECU_ADDRESS 0xFFF8D73A /end MEASUREMENT
/begin MEASUREMENT iSasZentr.iSchaltend.iKzu.f_hinsyn_kzu_gestartet "FLAG: HINSYN-Fkt. im KZU-Ablauf gestartet" UBYTE Conv.cSasAnKzu._.f_hinsyn_kzu_gestartet_S6_S3 1 100 0 1 BIT_MASK 0x1 DISPLAY_IDENTIFIER f_hinsyn_kzu_gestartet.iKzu.iSchaltend.iSasZentr ECU_ADDRESS 0xFFF8D73B /end MEASUREMENT
/begin MEASUREMENT iSasZentr.iSchaltend.iKzu.f_schnellfuellung_war_aktiv "FLAG: Schnellfüllung wurde ausgeführt" UBYTE Conv.cSasAnKzu._.f_schnellfuellung_war_aktiv_S6_S3 1 100 0 1 BIT_MASK 0x1 DISPLAY_IDENTIFIER f_schnellfuellung_war_aktiv.iKzu.iSchaltend.iSasZentr ECU_ADDRESS 0xFFF8D73C /end MEASUREMENT
/begin MEASUREMENT iSasZentr.iSchaltend.iKzu.dauer_fa_hsrs_kzu "Merker Dauer Fuellausgleichsphase der KZU" SWORD UMR_MSEC__10_1_0_S6_S3 1 100 -327680 327670 DISPLAY_IDENTIFIER dauer_fa_hsrs_kzu.iKzu.iSchaltend.iSasZentr ECU_ADDRESS 0xFFF8D73E /end MEASUREMENT
/begin MEASUREMENT iSasZentr.iSchaltend.iKzu.dauer_ra1_hsrs_kzu "Merker Dauer Rampe 1 der KZU" SWORD UMR_MSEC__10_1_0_S6_S3 1 100 -327680 327670 DISPLAY_IDENTIFIER dauer_ra1_hsrs_kzu.iKzu.iSchaltend.iSasZentr ECU_ADDRESS 0xFFF8D740 /end MEASUREMENT
/begin MEASUREMENT iSasZentr.iSchaltend.iKzu.zaehler_zkzu "Zustandszaehler der zusch. Kupplung" UBYTE UMR___1_1_0_S6_S3 1 100 0 255 DISPLAY_IDENTIFIER zaehler_zkzu.iKzu.iSchaltend.iSasZentr ECU_ADDRESS 0xFFF8D742 /end MEASUREMENT
/begin MEASUREMENT iSasZentr.iSchaltend.iKzu.schalttyp_kzu "Schalttyp der zusch. Kupplung" UBYTE Conv.cSasAnKzu._.schalttyp_kzu_S6_S3 1 100 0 4 DISPLAY_IDENTIFIER schalttyp_kzu.iKzu.iSchaltend.iSasZentr ECU_ADDRESS 0xFFF8D743 /end MEASUREMENT
/begin MEASUREMENT iSasZentr.iSchaltend.iKzu.p_0stkzu "Zustandsanfangsdruck gesteuerter Anteil KZU" SWORD UMR_BAR__1_1000_0_S6_S3 1 100 0 20 DISPLAY_IDENTIFIER p_0stkzu.iKzu.iSchaltend.iSasZentr ECU_ADDRESS 0xFFF8D744 /end MEASUREMENT
/begin MEASUREMENT iSasZentr.iSchaltend.iKzu.p_fkzu "Fuelldruck" SWORD UMR_BAR__1_1000_0_S6_S3 1 100 0 20 DISPLAY_IDENTIFIER p_fkzu.iKzu.iSchaltend.iSasZentr ECU_ADDRESS 0xFFF8D746 /end MEASUREMENT
/begin MEASUREMENT iSasZentr.iSchaltend.iKzu.p_fkzu_gueltig "Flag: Fuelldruck wurde berechnet und ausgegeben" UBYTE Conv.cSasAnKzu._.p_fkzu_gueltig_S6_S3 1 100 0 1 BIT_MASK 0x1 DISPLAY_IDENTIFIER p_fkzu_gueltig.iKzu.iSchaltend.iSasZentr ECU_ADDRESS 0xFFF8D748 /end MEASUREMENT
/begin MEASUREMENT iSasZentr.iSchaltend.iKzu.flag_pomekzu_erlaubt "Flag: Aufrechnung ME-abhaengiger Druckoffset erlaubt" UBYTE Conv.cSasAnKzu._.flag_pomekzu_erlaubt_S6_S3 1 100 0 1 BIT_MASK 0x1 DISPLAY_IDENTIFIER flag_pomekzu_erlaubt.iKzu.iSchaltend.iSasZentr ECU_ADDRESS 0xFFF8D749 /end MEASUREMENT
/begin MEASUREMENT iSasZentr.iSchaltend.iKzu.po_mekzu "Schaltdruckoffset, der abhaengig von einem ME ist" SWORD UMR_BAR__1_1000_0_S6_S3 1 100 0 12.75 DISPLAY_IDENTIFIER po_mekzu.iKzu.iSchaltend.iSasZentr ECU_ADDRESS 0xFFF8D74A /end MEASUREMENT
/begin MEASUREMENT iSasZentr.iSchaltend.iKzu.t_zkzu "Zustandszeitdauer der KZU" SWORD UMR_MSEC__10_1_0_S6_S3 1 100 -327680 327670 DISPLAY_IDENTIFIER t_zkzu.iKzu.iSchaltend.iSasZentr ECU_ADDRESS 0xFFF8D74C /end MEASUREMENT
/begin MEASUREMENT iSasZentr.iSchaltend.iKzu.t_0kzu "Zeitdauer des zuletzt durchlaufenen Zustands KZU" SWORD UMR_MSEC__10_1_0_S6_S3 1 100 -327680 327670 DISPLAY_IDENTIFIER t_0kzu.iKzu.iSchaltend.iSasZentr ECU_ADDRESS 0xFFF8D74E /end MEASUREMENT
/begin MEASUREMENT iSasZentr.iSchaltend.iKzu.p_offkzu "Offsetdruck der zuschaltenden Kupplung" SWORD UMR_BAR__1_1000_0_S6_S3 1 100 0 20 DISPLAY_IDENTIFIER p_offkzu.iKzu.iSchaltend.iSasZentr ECU_ADDRESS 0xFFF8D750 /end MEASUREMENT
/begin MEASUREMENT iSasZentr.iSchaltend.iKzu.po_mtkzu "momentenabhaengiger Druckoffset" SWORD UMR_BAR__1_1000_0_S6_S3 1 100 0 20 DISPLAY_IDENTIFIER po_mtkzu.iKzu.iSchaltend.iSasZentr ECU_ADDRESS 0xFFF8D752 /end MEASUREMENT
/begin MEASUREMENT iSasZentr.iSchaltend.iKzu.p_offkzu_neg_gls "Offsetdruck bei neg GLS" SWORD UMR_BAR__1_1000_0_S6_S3 1 100 0 20 DISPLAY_IDENTIFIER p_offkzu_neg_gls.iKzu.iSchaltend.iSasZentr ECU_ADDRESS 0xFFF8D754 /end MEASUREMENT
/begin MEASUREMENT iSasZentr.iSchaltend.iKzu.md_motsoll_sas "Motorsollmomentanstieg" SWORD UMR_NM__1_1_0_S6_S3 1 100 -2000 2000 DISPLAY_IDENTIFIER md_motsoll_sas.iKzu.iSchaltend.iSasZentr ECU_ADDRESS 0xFFF8D756 /end MEASUREMENT
/begin MEASUREMENT iSasZentr.iSchaltend.iKzu.timer_ab_ende_sf_kzu "Timer seit SF Ende Kzu" UWORD UMR_MSEC__10_1_0_S6_S3 1 100 0 655350 DISPLAY_IDENTIFIER timer_ab_ende_sf_kzu.iKzu.iSchaltend.iSasZentr ECU_ADDRESS 0xFFF8D758 /end MEASUREMENT
/begin MEASUREMENT iSasZentr.iSchaltend.iKzu.po_kzuflare "Druckoffset auf Schaltdruck bei Flare" SWORD UMR_BAR__1_1000_0_S6_S3 1 100 0 20 DISPLAY_IDENTIFIER po_kzuflare.iKzu.iSchaltend.iSasZentr ECU_ADDRESS 0xFFF8D75A /end MEASUREMENT
/begin MEASUREMENT iSasZentr.iSchaltend.iKzu.f_ngs_abflare_unterschritten "Merker ob Druckoffset auf Schaltdruck bei Flare gesetzt werden soll" UBYTE Conv.cSasAnKzu._.f_ngs_abflare_unterschritten_S6_S3 1 100 0 1 BIT_MASK 0x1 DISPLAY_IDENTIFIER f_ngs_abflare_unterschritten.iKzu.iSchaltend.iSasZentr ECU_ADDRESS 0xFFF8D75C /end MEASUREMENT
/begin MEASUREMENT iSasZentr.iSchaltend.iKzu.f_pokzufol_erlaubt "FLAG: Verwendung von KF_POKZUFOL ist erlaubt" UBYTE Conv.cSasAnKzu._.f_pokzufol_erlaubt_S6_S3 1 100 0 1 BIT_MASK 0x1 DISPLAY_IDENTIFIER f_pokzufol_erlaubt.iKzu.iSchaltend.iSasZentr ECU_ADDRESS 0xFFF8D75D /end MEASUREMENT
/begin MEASUREMENT iSasZentr.iSchaltend.iKzu.t_dt_ig_change_folge "Zeit für Momentenübergang bei Folgeschaltung" UBYTE UMR_MSEC__10_1_0_S6_S3 1 100 0 2540 DISPLAY_IDENTIFIER t_dt_ig_change_folge.iKzu.iSchaltend.iSasZentr ECU_ADDRESS 0xFFF8D75E /end MEASUREMENT
/begin MEASUREMENT iSasZentr.iSchaltend.sp_ngdsynzielgang.n_f "letzter Wert" SLONG UMR___1_1_0_S6_S3 1 100 -2147483648 2147483647 DISPLAY_IDENTIFIER n_f.sp_ngdsynzielgang.iSchaltend.iSasZentr ECU_ADDRESS 0xFFF8D7A8 /end MEASUREMENT
/begin MEASUREMENT iSasZentr.iSchaltend.sp_ngdsynzielgang.letzter_ms_timer "letzter Timerwert" UWORD UMR___1_1_0_S6_S3 1 100 0 65535 DISPLAY_IDENTIFIER letzter_ms_timer.sp_ngdsynzielgang.iSchaltend.iSasZentr ECU_ADDRESS 0xFFF8D7AC /end MEASUREMENT
/begin MEASUREMENT iSasZentr.iSchaltend.synchron "FLAG: Synchronpunkt erreicht" UBYTE Conv.cSasSaKor._.synchron_S6_S3 1 100 0 1 BIT_MASK 0x1 DISPLAY_IDENTIFIER synchron.iSchaltend.iSasZentr ECU_ADDRESS 0xFFF8D678 /end MEASUREMENT
/begin MEASUREMENT iSasZentr.iSchaltend.zielgang_sas "Zielgang SAS" SBYTE Conv.cSasSaKor._.zielgang_sas_S6_S3 1 100 -1 8 DISPLAY_IDENTIFIER zielgang_sas.iSchaltend.iSasZentr ECU_ADDRESS 0xFFF8D679 /end MEASUREMENT
/begin MEASUREMENT iSasZentr.iSchaltend.istgang_sas "Istgang SAS" SBYTE Conv.cSasSaKor._.istgang_sas_S6_S3 1 100 -1 8 DISPLAY_IDENTIFIER istgang_sas.iSchaltend.iSasZentr ECU_ADDRESS 0xFFF8D67A /end MEASUREMENT
/begin MEASUREMENT iSasZentr.iSchaltend.aktuelle_schaltung "FLAG: Aktive Schaltung" UBYTE Conv.cSasSaKor._.aktuelle_schaltung_S6_S3 1 100 0 1 DISPLAY_IDENTIFIER aktuelle_schaltung.iSchaltend.iSasZentr ECU_ADDRESS 0xFFF8D67B /end MEASUREMENT
/begin MEASUREMENT iSasZentr.iSchaltend.timeout "Flag: Schaltung timeout" UBYTE Conv.cSasSaKor._.timeout_S6_S3 1 100 0 1 BIT_MASK 0x1 DISPLAY_IDENTIFIER timeout.iSchaltend.iSasZentr ECU_ADDRESS 0xFFF8D67C /end MEASUREMENT
/begin MEASUREMENT iSasZentr.iSchaltend.schaltinfo_sas "Aktuelle Schaltinfo des Schaltablaufs" UBYTE Conv.cSasSaKor._.schaltinfo_sas_S6_S3 1 100 0 4 DISPLAY_IDENTIFIER schaltinfo_sas.iSchaltend.iSasZentr ECU_ADDRESS 0xFFF8D67D /end MEASUREMENT
/begin MEASUREMENT iSasZentr.iSchaltend.schnellfuellung_beendet "Flag: Schnellfuellung beendet" UBYTE Conv.cSasSaKor._.schnellfuellung_beendet_S6_S3 1 100 0 1 BIT_MASK 0x1 DISPLAY_IDENTIFIER schnellfuellung_beendet.iSchaltend.iSasZentr ECU_ADDRESS 0xFFF8D67E /end MEASUREMENT
/begin MEASUREMENT iSasZentr.iSchaltend.z_kurze_schaltung "Zustandsgroesse kurze Schaltung" UBYTE Conv.cSasSaKor._.z_kurze_schaltung_S6_S3 1 100 0 7 DISPLAY_IDENTIFIER z_kurze_schaltung.iSchaltend.iSasZentr ECU_ADDRESS 0xFFF8D67F /end MEASUREMENT
/begin MEASUREMENT iSasZentr.iSchaltend.index_spsas "Vorgabe Schaltung mit SP/SPORT-Parametern" UBYTE Conv.cSasSaKor._.index_spsas_S6_S3 1 100 0 2 DISPLAY_IDENTIFIER index_spsas.iSchaltend.iSasZentr ECU_ADDRESS 0xFFF8D680 /end MEASUREMENT
/begin MEASUREMENT iSasZentr.iSchaltend.t_syn "vorausberechnete Zeit bis Erreichen Synchron zielgang" SWORD UMR_MSEC__10_1_0_S6_S3 1 100 -327680 327670 DISPLAY_IDENTIFIER t_syn.iSchaltend.iSasZentr ECU_ADDRESS 0xFFF8D682 /end MEASUREMENT
/begin MEASUREMENT iSasZentr.iSchaltend.n_tkf "Turbinendrehzahl f. KF-Zugriff" UBYTE UMR_U_MIN_32_1_0_S6_S3 1 100 0 8160 DISPLAY_IDENTIFIER n_tkf.iSchaltend.iSasZentr ECU_ADDRESS 0xFFF8D684 /end MEASUREMENT
/begin MEASUREMENT iSasZentr.iSchaltend.nd_syn "Differenzdrehzahl zur Synchrondrehzahl neuer Gang (zielgang_sas)" SWORD UMR_U_MIN_1_1_0_S6_S3 1 100 -8000 8000 DISPLAY_IDENTIFIER nd_syn.iSchaltend.iSasZentr ECU_ADDRESS 0xFFF8D686 /end MEASUREMENT
/begin MEASUREMENT iSasZentr.iSchaltend.ng_dsynzielgang "Gradient Differenzdrehzahl n_t zu n_t(synchron zielgang)" SWORD UMR_U_MINSEC_1_1_0_S6_S3 1 100 -32000 32000 DISPLAY_IDENTIFIER ng_dsynzielgang.iSchaltend.iSasZentr ECU_ADDRESS 0xFFF8D688 /end MEASUREMENT
/begin MEASUREMENT iSasZentr.iSchaltend.nd_synistgang "Differenzdrehzahl zu synchron Istgang" SWORD UMR_U_MIN_1_1_0_S6_S3 1 100 -8000 8000 DISPLAY_IDENTIFIER nd_synistgang.iSchaltend.iSasZentr ECU_ADDRESS 0xFFF8D68A /end MEASUREMENT
/begin MEASUREMENT iSasZentr.iSchaltend.m_motsoll0_sas "Motorsollmoment bei Start Schaltung" SWORD UMR_NM__1_1_0_S6_S3 1 100 -2000 2000 DISPLAY_IDENTIFIER m_motsoll0_sas.iSchaltend.iSasZentr ECU_ADDRESS 0xFFF8D68C /end MEASUREMENT
/begin MEASUREMENT iSasZentr.iSchaltend.p_kzu_letzte_schaltung "Druck KZU bei letzter Schaltung" SWORD UMR_BAR__1_1000_0_S6_S3 1 100 0 12.75 DISPLAY_IDENTIFIER p_kzu_letzte_schaltung.iSchaltend.iSasZentr ECU_ADDRESS 0xFFF8D68E /end MEASUREMENT
/begin MEASUREMENT iSasZentr.iSchaltend.p_kab_letzte_schaltung "Druck KAB bei letzter Schaltung" SWORD UMR_BAR__1_1000_0_S6_S3 1 100 0 12.75 DISPLAY_IDENTIFIER p_kab_letzte_schaltung.iSchaltend.iSasZentr ECU_ADDRESS 0xFFF8D690 /end MEASUREMENT
/begin MEASUREMENT iSasZentr.iSchaltend.erste_schaltung "Flag: 1. Befuellung einer Kupplung" UBYTE Conv.cSasSaKor._.erste_schaltung_S6_S3 1 100 0 1 BIT_MASK 0x1 DISPLAY_IDENTIFIER erste_schaltung.iSchaltend.iSasZentr ECU_ADDRESS 0xFFF8D692 /end MEASUREMENT
/begin MEASUREMENT iSasZentr.iSchaltend.f_verb_ada_erste_bef "Flag: 1. Befuellung einer Kupplung verbietet Adaption" UBYTE Conv.cSasSaKor._.f_verb_ada_erste_bef_S6_S3 1 100 0 1 BIT_MASK 0x1 DISPLAY_IDENTIFIER f_verb_ada_erste_bef.iSchaltend.iSasZentr ECU_ADDRESS 0xFFF8D693 /end MEASUREMENT
/begin MEASUREMENT iSasZentr.iSchaltend.schaltinfo_sas_vor_folge "Schaltinfo der vorhergehenden Schaltung waehrend verschachtelten Sch." UBYTE Conv.cSasSaKor._.schaltinfo_sas_vor_folge_S6_S3 1 100 0 12 DISPLAY_IDENTIFIER schaltinfo_sas_vor_folge.iSchaltend.iSasZentr ECU_ADDRESS 0xFFF8D694 /end MEASUREMENT
/begin MEASUREMENT iSasZentr.iSchaltend.schnellfuellung_gestartet "Flag: Schnellfuellung gestartet" UBYTE Conv.cSasSaKor._.schnellfuellung_gestartet_S6_S3 1 100 0 1 BIT_MASK 0x1 DISPLAY_IDENTIFIER schnellfuellung_gestartet.iSchaltend.iSasZentr ECU_ADDRESS 0xFFF8D695 /end MEASUREMENT
/begin MEASUREMENT iSasZentr.iSchaltend.fkt_halten_in_sync_verboten "FLAG: Ausfuehren der Fkt. Halten in Synchron verboten" UBYTE Conv.cSasSaKor._.fkt_halten_in_sync_verboten_S6_S3 1 100 0 1 BIT_MASK 0x1 DISPLAY_IDENTIFIER fkt_halten_in_sync_verboten.iSchaltend.iSasZentr ECU_ADDRESS 0xFFF8D696 /end MEASUREMENT
/begin MEASUREMENT iSasZentr.iSchaltend.timer16_sas "Timer Schaltungsdauer, wird bei Vorhalt schon gestartet" UWORD UMR_MSEC__10_1_0_S6_S3 1 100 0 320000 DISPLAY_IDENTIFIER timer16_sas.iSchaltend.iSasZentr ECU_ADDRESS 0xFFF8D698 /end MEASUREMENT
/begin MEASUREMENT iSasZentr.iSchaltend.t_maxsas "maximale Schaltzeit" UWORD UMR_MSEC__10_1_0_S6_S3 1 100 0 50000 DISPLAY_IDENTIFIER t_maxsas.iSchaltend.iSasZentr ECU_ADDRESS 0xFFF8D69A /end MEASUREMENT
/begin MEASUREMENT iSasZentr.iSchaltend.flag_mtschwelle_verbietet_hinsyn "FLAG: Ausfuehren der Fkt. Halten in Synchron durch Mt_Schwelle verboten" UBYTE Conv.cSasSaKor._.flag_mtschwelle_verbietet_hinsyn_S6_S3 1 100 0 1 BIT_MASK 0x1 DISPLAY_IDENTIFIER flag_mtschwelle_verbietet_hinsyn.iSchaltend.iSasZentr ECU_ADDRESS 0xFFF8D69C /end MEASUREMENT
/begin MEASUREMENT iSasZentr.iSchaltend.zwangssynchron "FLAG: Zwangssynchron wird angefordert" UBYTE Conv.cSasSaKor._.zwangssynchron_S6_S3 1 100 0 1 BIT_MASK 0x1 DISPLAY_IDENTIFIER zwangssynchron.iSchaltend.iSasZentr ECU_ADDRESS 0xFFF8D69D /end MEASUREMENT
/begin MEASUREMENT iSasZentr.iSchaltend.synchron_verboten "FLAG: Synchron verboten" UBYTE Conv.cSasSaKor._.synchron_verboten_S6_S3 1 100 0 1 BIT_MASK 0x1 DISPLAY_IDENTIFIER synchron_verboten.iSchaltend.iSasZentr ECU_ADDRESS 0xFFF8D69E /end MEASUREMENT
/begin MEASUREMENT iSasZentr.iSchaltend.n_tsyn "Turbinensynchrondrehzahl fuer zielgang_sas" UWORD UMR_U_MIN_1_1_0_S6_S3 1 100 0 8160 DISPLAY_IDENTIFIER n_tsyn.iSchaltend.iSasZentr ECU_ADDRESS 0xFFF8D6A0 /end MEASUREMENT
/begin MEASUREMENT iSasZentr.iSchaltend.schaltinfo_syn "Schaltinfo fuer Synchronerkennung" UBYTE Conv.cSasSaKor._.schaltinfo_syn_S6_S3 1 100 0 4 DISPLAY_IDENTIFIER schaltinfo_syn.iSchaltend.iSasZentr ECU_ADDRESS 0xFFF8D6A2 /end MEASUREMENT
/begin MEASUREMENT iSasZentr.iSchaltend.t_timeout "Zeit von Schaltbeginn bis Start Timeoutfunktion" UWORD UMR_MSEC__10_1_0_S6_S3 1 100 0 50000 DISPLAY_IDENTIFIER t_timeout.iSchaltend.iSasZentr ECU_ADDRESS 0xFFF8D6A4 /end MEASUREMENT
/begin MEASUREMENT iSasZentr.iSchaltend.kup_schutz_massnahme_aktiv "FLAG: Schutzfunktion auf Grund eines überhitzten Schaltelements aktiv." UBYTE Conv.cSasSaKor._.kup_schutz_massnahme_aktiv_S6_S3 1 100 0 1 BIT_MASK 0x1 DISPLAY_IDENTIFIER kup_schutz_massnahme_aktiv.iSchaltend.iSasZentr ECU_ADDRESS 0xFFF8D6A6 /end MEASUREMENT
/begin MEASUREMENT iSasZentr.iVorbereitend.iKab.pgo_kab_speicher.cBibRampeGradSi16._.letzter_wert "Speichert den letzten Eingangswert" FLOAT32_IEEE UMR___1_1_0_S6_S3 1 100 -1E+037 1E+037 FORMAT "%4.2" DISPLAY_IDENTIFIER letzter_wert._.cBibRampeGradSi16.pgo_kab_speicher.iKab.iVorbereitend.iSasZentr ECU_ADDRESS 0xFFF8D830 /end MEASUREMENT
/begin MEASUREMENT iSasZentr.iVorbereitend.iKab.pgo_kab_speicher.cBibRampeGradSi16._.letzter_ms_timer "Speichert den letzten BS-Timer" UWORD UMR_MSEC__1_1_0_S6_S3 1 100 0 65535 DISPLAY_IDENTIFIER letzter_ms_timer._.cBibRampeGradSi16.pgo_kab_speicher.iKab.iVorbereitend.iSasZentr ECU_ADDRESS 0xFFF8D834 /end MEASUREMENT
/begin MEASUREMENT iSasZentr.iVorbereitend.iKab.pgo_kab_speicher.cBibRampeGradSi16._.minimum "Minimum Begrenzung" FLOAT32_IEEE UMR___1_1_0_S6_S3 1 100 -1E+037 1E+037 FORMAT "%4.2" DISPLAY_IDENTIFIER minimum._.cBibRampeGradSi16.pgo_kab_speicher.iKab.iVorbereitend.iSasZentr ECU_ADDRESS 0xFFF8D838 /end MEASUREMENT
/begin MEASUREMENT iSasZentr.iVorbereitend.iKab.pgo_kab_speicher.cBibRampeGradSi16._.maximum "Maximum Begrenzung" FLOAT32_IEEE UMR___1_1_0_S6_S3 1 100 -1E+037 1E+037 FORMAT "%4.2" DISPLAY_IDENTIFIER maximum._.cBibRampeGradSi16.pgo_kab_speicher.iKab.iVorbereitend.iSasZentr ECU_ADDRESS 0xFFF8D83C /end MEASUREMENT
/begin MEASUREMENT iSasZentr.iVorbereitend.iKab.raph_kab_speicher.letzter_wert "Speichert den letzten Eingangswert" SLONG UMR___1_1_0_S6_S3 1 100 -2147483648 2147483647 DISPLAY_IDENTIFIER letzter_wert.raph_kab_speicher.iKab.iVorbereitend.iSasZentr ECU_ADDRESS 0xFFF8D844 /end MEASUREMENT
/begin MEASUREMENT iSasZentr.iVorbereitend.iKab.raph_kab_speicher.letzter_timer "Speichert den letzten BS-Timer" UBYTE UMR_SEC__1_1_0_S6_S3 1 100 0 255 DISPLAY_IDENTIFIER letzter_timer.raph_kab_speicher.iKab.iVorbereitend.iSasZentr ECU_ADDRESS 0xFFF8D848 /end MEASUREMENT
/begin MEASUREMENT iSasZentr.iVorbereitend.iKab.raps_kab_speicher.letzter_wert "Speichert den letzten Eingangswert" SLONG UMR___1_1_0_S6_S3 1 100 -2147483648 2147483647 DISPLAY_IDENTIFIER letzter_wert.raps_kab_speicher.iKab.iVorbereitend.iSasZentr ECU_ADDRESS 0xFFF8D84C /end MEASUREMENT
/begin MEASUREMENT iSasZentr.iVorbereitend.iKab.raps_kab_speicher.letzter_timer "Speichert den letzten BS-Timer" UBYTE UMR_SEC__1_1_0_S6_S3 1 100 0 255 DISPLAY_IDENTIFIER letzter_timer.raps_kab_speicher.iKab.iVorbereitend.iSasZentr ECU_ADDRESS 0xFFF8D850 /end MEASUREMENT
/begin MEASUREMENT iSasZentr.iVorbereitend.iKab.ende_kab_gestartet "Flag: Zustand Ende der abschaltenden Kupplung gestartet" UBYTE Conv.cSasAnKab._.ende_kab_gestartet_S6_S3 1 100 0 1 BIT_MASK 0x1 DISPLAY_IDENTIFIER ende_kab_gestartet.iKab.iVorbereitend.iSasZentr ECU_ADDRESS 0xFFF8D7E0 /end MEASUREMENT
/begin MEASUREMENT iSasZentr.iVorbereitend.iKab.pkf_rs_kab_gestartet "Flag: Kennfeldzugriff KAB (bei ZR) gestartet bzw. Rampe hat Kennfelddruck erreicht" UBYTE Conv.cSasAnKab._.pkf_rs_kab_gestartet_S6_S3 1 100 0 1 BIT_MASK 0x1 DISPLAY_IDENTIFIER pkf_rs_kab_gestartet.iKab.iVorbereitend.iSasZentr ECU_ADDRESS 0xFFF8D7E1 /end MEASUREMENT
/begin MEASUREMENT iSasZentr.iVorbereitend.iKab.p_stkab "Gesteuerter Druckanteil KAB" SWORD UMR_BAR__1_1000_0_S6_S3 1 100 0 20 DISPLAY_IDENTIFIER p_stkab.iKab.iVorbereitend.iSasZentr ECU_ADDRESS 0xFFF8D7E2 /end MEASUREMENT
/begin MEASUREMENT iSasZentr.iVorbereitend.iKab.ps_hs_kab_gestartet "Flag: Schaltdruckphase KAB gestartet" UBYTE Conv.cSasAnKab._.ps_hs_kab_gestartet_S6_S3 1 100 0 1 BIT_MASK 0x1 DISPLAY_IDENTIFIER ps_hs_kab_gestartet.iKab.iVorbereitend.iSasZentr ECU_ADDRESS 0xFFF8D7E4 /end MEASUREMENT
/begin MEASUREMENT iSasZentr.iVorbereitend.iKab.ra1_kab_gestartet "Flag: Rampe 1 KAB gestartet" UBYTE Conv.cSasAnKab._.ra1_kab_gestartet_S6_S3 1 100 0 1 BIT_MASK 0x1 DISPLAY_IDENTIFIER ra1_kab_gestartet.iKab.iVorbereitend.iSasZentr ECU_ADDRESS 0xFFF8D7E5 /end MEASUREMENT
/begin MEASUREMENT iSasZentr.iVorbereitend.iKab.statisch_kab "Flag: Anzeige ob KAB eine Druckvorgabe ausgibt oder Minimal/Maximaldruck angesteuert wird" UBYTE Conv.cSasAnKab._.statisch_kab_S6_S3 1 100 0 1 BIT_MASK 0x1 DISPLAY_IDENTIFIER statisch_kab.iKab.iVorbereitend.iSasZentr ECU_ADDRESS 0xFFF8D7E6 /end MEASUREMENT
/begin MEASUREMENT iSasZentr.iVorbereitend.iKab.ueb_rs_kab_gestartet "Flag: Ueberschneidungsphase abschaltende Kupplung (bei ZR-Schaltung) gestartet" UBYTE Conv.cSasAnKab._.ueb_rs_kab_gestartet_S6_S3 1 100 0 1 BIT_MASK 0x1 DISPLAY_IDENTIFIER ueb_rs_kab_gestartet.iKab.iVorbereitend.iSasZentr ECU_ADDRESS 0xFFF8D7E7 /end MEASUREMENT
/begin MEASUREMENT iSasZentr.iVorbereitend.iKab.kup_kab "Kupplungsnummer Abschaltende Kupplung" UBYTE Conv.cSasAnKab._.kup_kab_S6_S3 1 100 0 5 DISPLAY_IDENTIFIER kup_kab.iKab.iVorbereitend.iSasZentr ECU_ADDRESS 0xFFF8D7E8 /end MEASUREMENT
/begin MEASUREMENT iSasZentr.iVorbereitend.iKab.z_kab "Zustand abschaltende Kupplung" UBYTE Conv.cSasAnKab._.z_kab_S6_S3 1 100 0 19 DISPLAY_IDENTIFIER z_kab.iKab.iVorbereitend.iSasZentr ECU_ADDRESS 0xFFF8D7E9 /end MEASUREMENT
/begin MEASUREMENT iSasZentr.iVorbereitend.iKab.ra_sd_hs_kab_gestartet "Flag: Rampe auf Schaltdruck KAB bei HS ist gestartet" UBYTE Conv.cSasAnKab._.ra_sd_hs_kab_gestartet_S6_S3 1 100 0 1 BIT_MASK 0x1 DISPLAY_IDENTIFIER ra_sd_hs_kab_gestartet.iKab.iVorbereitend.iSasZentr ECU_ADDRESS 0xFFF8D7EA /end MEASUREMENT
/begin MEASUREMENT iSasZentr.iVorbereitend.iKab.ra_sd_rs_kab_gestartet "Flag: Rampe auf Schaltdruck KAB bei RS ist gestartet" UBYTE Conv.cSasAnKab._.ra_sd_rs_kab_gestartet_S6_S3 1 100 0 1 BIT_MASK 0x1 DISPLAY_IDENTIFIER ra_sd_rs_kab_gestartet.iKab.iVorbereitend.iSasZentr ECU_ADDRESS 0xFFF8D7EB /end MEASUREMENT
/begin MEASUREMENT iSasZentr.iVorbereitend.iKab.halten_in_syn_kab_gestartet "Flag: Ablauf Halten in Synchron fuer die KAB gestartet" UBYTE Conv.cSasAnKab._.halten_in_syn_kab_gestartet_S6_S3 1 100 0 1 BIT_MASK 0x1 DISPLAY_IDENTIFIER halten_in_syn_kab_gestartet.iKab.iVorbereitend.iSasZentr ECU_ADDRESS 0xFFF8D7EC /end MEASUREMENT
/begin MEASUREMENT iSasZentr.iVorbereitend.iKab.p_kab "Druck KAB (inklusive GLS-Druck)" SWORD UMR_BAR__1_1000_0_S6_S3 1 100 0 20 DISPLAY_IDENTIFIER p_kab.iKab.iVorbereitend.iSasZentr ECU_ADDRESS 0xFFF8D7EE /end MEASUREMENT
/begin MEASUREMENT iSasZentr.iVorbereitend.iKab.p_adaptkab "Adaptionsdruck abschaltende Kupplung" SWORD UMR_BAR__1_1000_0_S6_S3 1 100 0 20 DISPLAY_IDENTIFIER p_adaptkab.iKab.iVorbereitend.iSasZentr ECU_ADDRESS 0xFFF8D7F0 /end MEASUREMENT
/begin MEASUREMENT iSasZentr.iVorbereitend.iKab.timer_zkab "Zustandstimer abschaltende Kupplung" UBYTE UMR_MSEC__10_1_0_S6_S3 1 100 0 2550 DISPLAY_IDENTIFIER timer_zkab.iKab.iVorbereitend.iSasZentr ECU_ADDRESS 0xFFF8D7F2 /end MEASUREMENT
/begin MEASUREMENT iSasZentr.iVorbereitend.iKab.gls_hs_kab_gestartet "Flag: GLS der KAB kann starten" UBYTE Conv.cSasAnKab._.gls_hs_kab_gestartet_S6_S3 1 100 0 1 BIT_MASK 0x1 DISPLAY_IDENTIFIER gls_hs_kab_gestartet.iKab.iVorbereitend.iSasZentr ECU_ADDRESS 0xFFF8D7F3 /end MEASUREMENT
/begin MEASUREMENT iSasZentr.iVorbereitend.iKab.pkf_rs_kab_ausgegeben "Flag: Druck aus Kennfeld wird ausgegeben" UBYTE Conv.cSasAnKab._.pkf_rs_kab_ausgegeben_S6_S3 1 100 0 1 BIT_MASK 0x1 DISPLAY_IDENTIFIER pkf_rs_kab_ausgegeben.iKab.iVorbereitend.iSasZentr ECU_ADDRESS 0xFFF8D7F4 /end MEASUREMENT
/begin MEASUREMENT iSasZentr.iVorbereitend.iKab.kab_nicht_befuellt "Flag: Kupplung KAB nicht befuellt" UBYTE Conv.cSasAnKab._.kab_nicht_befuellt_S6_S3 1 100 0 1 BIT_MASK 0x1 DISPLAY_IDENTIFIER kab_nicht_befuellt.iKab.iVorbereitend.iSasZentr ECU_ADDRESS 0xFFF8D7F5 /end MEASUREMENT
/begin MEASUREMENT iSasZentr.iVorbereitend.iKab.f_ende_verz_kab_erlaubt "Flag: Bedingung fuer Ende Verzoegerung KAB erfuellt" UBYTE Conv.cSasAnKab._.f_ende_verz_kab_erlaubt_S6_S3 1 100 0 1 BIT_MASK 0x1 DISPLAY_IDENTIFIER f_ende_verz_kab_erlaubt.iKab.iVorbereitend.iSasZentr ECU_ADDRESS 0xFFF8D7F6 /end MEASUREMENT
/begin MEASUREMENT iSasZentr.iVorbereitend.iKab.f_best_poffkab_in_syn_erfolgt "Flag: Neubestimmung p_offkab in Synchron erfolgt" UBYTE Conv.cSasAnKab._.f_best_poffkab_in_syn_erfolgt_S6_S3 1 100 0 1 BIT_MASK 0x1 DISPLAY_IDENTIFIER f_best_poffkab_in_syn_erfolgt.iKab.iVorbereitend.iSasZentr ECU_ADDRESS 0xFFF8D7F7 /end MEASUREMENT
/begin MEASUREMENT iSasZentr.iVorbereitend.iKab.zaehler_zkab "Zustandszaehler der abschaltenden Kupplung" UBYTE UMR___1_1_0_S6_S3 1 100 0 255 DISPLAY_IDENTIFIER zaehler_zkab.iKab.iVorbereitend.iSasZentr ECU_ADDRESS 0xFFF8D7F8 /end MEASUREMENT
/begin MEASUREMENT iSasZentr.iVorbereitend.iKab.schalttyp_kab "Schalttyp der absch. Kupplung" UBYTE Conv.cSasAnKab._.schalttyp_kab_S6_S3 1 100 0 4 DISPLAY_IDENTIFIER schalttyp_kab.iKab.iVorbereitend.iSasZentr ECU_ADDRESS 0xFFF8D7F9 /end MEASUREMENT
/begin MEASUREMENT iSasZentr.iVorbereitend.iKab.p_0stkab "Zustandsanfangsdruck gesteuerter Anteil der absch. Kupplung" SWORD UMR_BAR__1_1000_0_S6_S3 1 100 -32 32 DISPLAY_IDENTIFIER p_0stkab.iKab.iVorbereitend.iSasZentr ECU_ADDRESS 0xFFF8D7FA /end MEASUREMENT
/begin MEASUREMENT iSasZentr.iVorbereitend.iKab.p_offkab "Offsetdruck der abschaltenden Kupplung" SWORD UMR_BAR__1_1000_0_S6_S3 1 100 -32 32 DISPLAY_IDENTIFIER p_offkab.iKab.iVorbereitend.iSasZentr ECU_ADDRESS 0xFFF8D7FC /end MEASUREMENT
/begin MEASUREMENT iSasZentr.iVorbereitend.iKab.po_mtkab "Momentenabhaengiger Druckoffset der KAB" SWORD UMR_BAR__1_1000_0_S6_S3 1 100 -32 32 DISPLAY_IDENTIFIER po_mtkab.iKab.iVorbereitend.iSasZentr ECU_ADDRESS 0xFFF8D7FE /end MEASUREMENT
/begin MEASUREMENT iSasZentr.iVorbereitend.iKab.t_zkab "Zustandszeitdauer der absch. Kupplung" SWORD UMR_MSEC__10_1_0_S6_S3 1 100 -327680 327670 DISPLAY_IDENTIFIER t_zkab.iKab.iVorbereitend.iSasZentr ECU_ADDRESS 0xFFF8D800 /end MEASUREMENT
/begin MEASUREMENT iSasZentr.iVorbereitend.iKab.t_0kab "Zeitdauer des zuletzt durchlaufenen Zustands der absch. Kupplung" SWORD UMR_MSEC__10_1_0_S6_S3 1 100 -327680 327670 DISPLAY_IDENTIFIER t_0kab.iKab.iVorbereitend.iSasZentr ECU_ADDRESS 0xFFF8D802 /end MEASUREMENT
/begin MEASUREMENT iSasZentr.iVorbereitend.iKab.t_ph_rs "Berechnete Zeitdauer Haltedruckphase der absch. Kupplung während RS" SLONG UMR_MSEC__10_1_0_S6_S3 1 100 -327680 327670 DISPLAY_IDENTIFIER t_ph_rs.iKab.iVorbereitend.iSasZentr ECU_ADDRESS 0xFFF8D804 /end MEASUREMENT
/begin MEASUREMENT iSasZentr.iVorbereitend.iKab.t_verz_ph_rs "Berechnete Zeitdauer Verzögerung der Haltedruckphase der absch. Kupplung während RS" SWORD UMR_MSEC__10_1_0_S6_S3 1 100 -327680 327670 DISPLAY_IDENTIFIER t_verz_ph_rs.iKab.iVorbereitend.iSasZentr ECU_ADDRESS 0xFFF8D808 /end MEASUREMENT
/begin MEASUREMENT iSasZentr.iVorbereitend.iKab.t_ra_kab_vor_ra1_kzu "Anteil Dauer der KAB-Rampe auf Schaltdruck vor Start der KZU-Rampe auf Schaltdruck" SWORD UMR_MSEC__10_1_0_S6_S3 1 100 -327680 327670 DISPLAY_IDENTIFIER t_ra_kab_vor_ra1_kzu.iKab.iVorbereitend.iSasZentr ECU_ADDRESS 0xFFF8D80A /end MEASUREMENT
/begin MEASUREMENT iSasZentr.iVorbereitend.iKab.timer_hinsyn "Zeit seit Start Rampe auf Halten in Synchron" UBYTE UMR_MSEC__10_1_0_S6_S3 1 100 0 2550 DISPLAY_IDENTIFIER timer_hinsyn.iKab.iVorbereitend.iSasZentr ECU_ADDRESS 0xFFF8D80C /end MEASUREMENT
/begin MEASUREMENT iSasZentr.iVorbereitend.iKab.p_kfkab "Kennfelddruck gesteuerter Anteil der absch. Kupplung" SWORD UMR_BAR__1_1000_0_S6_S3 1 100 0 32 DISPLAY_IDENTIFIER p_kfkab.iKab.iVorbereitend.iSasZentr ECU_ADDRESS 0xFFF8D80E /end MEASUREMENT
/begin MEASUREMENT iSasZentr.iVorbereitend.iKab.md_motsoll_sas "Motorsollmomentanstieg fuer KF-Zugriff abschalt. Kupplung" SWORD UMR_NM__1_1_0_S6_S3 1 100 -2000 2000 DISPLAY_IDENTIFIER md_motsoll_sas.iKab.iVorbereitend.iSasZentr ECU_ADDRESS 0xFFF8D810 /end MEASUREMENT
/begin MEASUREMENT iSasZentr.iVorbereitend.iKab.m_motsoll0_sas "Motorsollmoment bei Start Rampe auf Schaltdruck" SWORD UMR_NM__1_1_0_S6_S3 1 100 -2000 2000 DISPLAY_IDENTIFIER m_motsoll0_sas.iKab.iVorbereitend.iSasZentr ECU_ADDRESS 0xFFF8D812 /end MEASUREMENT
/begin MEASUREMENT iSasZentr.iVorbereitend.iKzu.pgo_kzu_speicher.cBibRampeGradSi16._.letzter_wert "Speichert den letzten Eingangswert" FLOAT32_IEEE UMR___1_1_0_S6_S3 1 100 -1E+037 1E+037 FORMAT "%4.2" DISPLAY_IDENTIFIER letzter_wert._.cBibRampeGradSi16.pgo_kzu_speicher.iKzu.iVorbereitend.iSasZentr ECU_ADDRESS 0xFFF8D8B8 /end MEASUREMENT
/begin MEASUREMENT iSasZentr.iVorbereitend.iKzu.pgo_kzu_speicher.cBibRampeGradSi16._.letzter_ms_timer "Speichert den letzten BS-Timer" UWORD UMR_MSEC__1_1_0_S6_S3 1 100 0 65535 DISPLAY_IDENTIFIER letzter_ms_timer._.cBibRampeGradSi16.pgo_kzu_speicher.iKzu.iVorbereitend.iSasZentr ECU_ADDRESS 0xFFF8D8BC /end MEASUREMENT
/begin MEASUREMENT iSasZentr.iVorbereitend.iKzu.pgo_kzu_speicher.cBibRampeGradSi16._.minimum "Minimum Begrenzung" FLOAT32_IEEE UMR___1_1_0_S6_S3 1 100 -1E+037 1E+037 FORMAT "%4.2" DISPLAY_IDENTIFIER minimum._.cBibRampeGradSi16.pgo_kzu_speicher.iKzu.iVorbereitend.iSasZentr ECU_ADDRESS 0xFFF8D8C0 /end MEASUREMENT
/begin MEASUREMENT iSasZentr.iVorbereitend.iKzu.pgo_kzu_speicher.cBibRampeGradSi16._.maximum "Maximum Begrenzung" FLOAT32_IEEE UMR___1_1_0_S6_S3 1 100 -1E+037 1E+037 FORMAT "%4.2" DISPLAY_IDENTIFIER maximum._.cBibRampeGradSi16.pgo_kzu_speicher.iKzu.iVorbereitend.iSasZentr ECU_ADDRESS 0xFFF8D8C4 /end MEASUREMENT
/begin MEASUREMENT iSasZentr.iVorbereitend.iKzu.raph_kzu_speicher.letzter_wert "Speichert den letzten Eingangswert" SLONG UMR___1_1_0_S6_S3 1 100 -2147483648 2147483647 DISPLAY_IDENTIFIER letzter_wert.raph_kzu_speicher.iKzu.iVorbereitend.iSasZentr ECU_ADDRESS 0xFFF8D8CC /end MEASUREMENT
/begin MEASUREMENT iSasZentr.iVorbereitend.iKzu.raph_kzu_speicher.letzter_timer "Speichert den letzten BS-Timer" UBYTE UMR_SEC__1_1_0_S6_S3 1 100 0 255 DISPLAY_IDENTIFIER letzter_timer.raph_kzu_speicher.iKzu.iVorbereitend.iSasZentr ECU_ADDRESS 0xFFF8D8D0 /end MEASUREMENT
/begin MEASUREMENT iSasZentr.iVorbereitend.iKzu.fa_kzu_gestartet "Flag: Fuellausgleich KZU gestartet" UBYTE Conv.cSasAnKzu._.fa_kzu_gestartet_S6_S3 1 100 0 1 BIT_MASK 0x1 DISPLAY_IDENTIFIER fa_kzu_gestartet.iKzu.iVorbereitend.iSasZentr ECU_ADDRESS 0xFFF8D854 /end MEASUREMENT
/begin MEASUREMENT iSasZentr.iVorbereitend.iKzu.p_stkzu "Gesteuerter Druckanteil KZU" SWORD UMR_BAR__1_1000_0_S6_S3 1 100 0 20 DISPLAY_IDENTIFIER p_stkzu.iKzu.iVorbereitend.iSasZentr ECU_ADDRESS 0xFFF8D856 /end MEASUREMENT
/begin MEASUREMENT iSasZentr.iVorbereitend.iKzu.ra1_hsrs_kzu_gestartet "Flag: Rampe 1 KZU gestartet" UBYTE Conv.cSasAnKzu._.ra1_hsrs_kzu_gestartet_S6_S3 1 100 0 1 BIT_MASK 0x1 DISPLAY_IDENTIFIER ra1_hsrs_kzu_gestartet.iKzu.iVorbereitend.iSasZentr ECU_ADDRESS 0xFFF8D858 /end MEASUREMENT
/begin MEASUREMENT iSasZentr.iVorbereitend.iKzu.ra2_hsrs_kzu_gestartet "Flag: Rampe 2 KZU gestartet" UBYTE Conv.cSasAnKzu._.ra2_hsrs_kzu_gestartet_S6_S3 1 100 0 1 BIT_MASK 0x1 DISPLAY_IDENTIFIER ra2_hsrs_kzu_gestartet.iKzu.iVorbereitend.iSasZentr ECU_ADDRESS 0xFFF8D859 /end MEASUREMENT
/begin MEASUREMENT iSasZentr.iVorbereitend.iKzu.ra3_hsrs_kzu_gestartet "Flag: Rampe 3 KZU gestartet" UBYTE Conv.cSasAnKzu._.ra3_hsrs_kzu_gestartet_S6_S3 1 100 0 1 BIT_MASK 0x1 DISPLAY_IDENTIFIER ra3_hsrs_kzu_gestartet.iKzu.iVorbereitend.iSasZentr ECU_ADDRESS 0xFFF8D85A /end MEASUREMENT
/begin MEASUREMENT iSasZentr.iVorbereitend.iKzu.schliessen_kzu "Flag: KZU soll schliessen" UBYTE Conv.cSasAnKzu._.schliessen_kzu_S6_S3 1 100 0 1 BIT_MASK 0x1 DISPLAY_IDENTIFIER schliessen_kzu.iKzu.iVorbereitend.iSasZentr ECU_ADDRESS 0xFFF8D85B /end MEASUREMENT
/begin MEASUREMENT iSasZentr.iVorbereitend.iKzu.statisch_kzu "Flag: Anzeige ob KAB eine Druckvorgabe ausgibt oder Minimal/Maximaldruck angesteuert wird" UBYTE Conv.cSasAnKzu._.statisch_kzu_S6_S3 1 100 0 1 BIT_MASK 0x1 DISPLAY_IDENTIFIER statisch_kzu.iKzu.iVorbereitend.iSasZentr ECU_ADDRESS 0xFFF8D85C /end MEASUREMENT
/begin MEASUREMENT iSasZentr.iVorbereitend.iKzu.timer16_ra1_hsrs_kzu "Zeit seit Start Rampe 1 KZU" UWORD UMR_MSEC__10_1_0_S6_S3 1 100 0 655350 DISPLAY_IDENTIFIER timer16_ra1_hsrs_kzu.iKzu.iVorbereitend.iSasZentr ECU_ADDRESS 0xFFF8D85E /end MEASUREMENT
/begin MEASUREMENT iSasZentr.iVorbereitend.iKzu.t_eff_ra1_hsrs_kzu "Effektive Zeit Rampe 1 KZU" UWORD UMR_MSEC__10_1_0_S6_S3 1 100 0 655350 DISPLAY_IDENTIFIER t_eff_ra1_hsrs_kzu.iKzu.iVorbereitend.iSasZentr ECU_ADDRESS 0xFFF8D860 /end MEASUREMENT
/begin MEASUREMENT iSasZentr.iVorbereitend.iKzu.timer_start_fa_kzu "Zeit seit Start Fuellausgleichsphase" UBYTE UMR_MSEC__10_1_0_S6_S3 1 100 0 2550 DISPLAY_IDENTIFIER timer_start_fa_kzu.iKzu.iVorbereitend.iSasZentr ECU_ADDRESS 0xFFF8D862 /end MEASUREMENT
/begin MEASUREMENT iSasZentr.iVorbereitend.iKzu.t_dt_ig_change "Zeit für Momentenübergang" UBYTE UMR_MSEC__10_1_0_S6_S3 1 100 0 2540 DISPLAY_IDENTIFIER t_dt_ig_change.iKzu.iVorbereitend.iSasZentr ECU_ADDRESS 0xFFF8D863 /end MEASUREMENT
/begin MEASUREMENT iSasZentr.iVorbereitend.iKzu.z_kzu "Zustand zuschaltende Kupplung in einer Schaltung" UBYTE Conv.cSasAnKzu._.z_kzu_S6_S3 1 100 0 19 DISPLAY_IDENTIFIER z_kzu.iKzu.iVorbereitend.iSasZentr ECU_ADDRESS 0xFFF8D864 /end MEASUREMENT
/begin MEASUREMENT iSasZentr.iVorbereitend.iKzu.kup_kzu "Kupplungsnummer Zuschaltende Kupplung" UBYTE Conv.cSasAnKzu._.kup_kzu_S6_S3 1 100 0 5 DISPLAY_IDENTIFIER kup_kzu.iKzu.iVorbereitend.iSasZentr ECU_ADDRESS 0xFFF8D865 /end MEASUREMENT
/begin MEASUREMENT iSasZentr.iVorbereitend.iKzu.t_besfhsrskzu "Zeit bis Ende Schnellfuellung" SWORD UMR_MSEC__1_1_0_S6_S3 1 100 -32768 32767 DISPLAY_IDENTIFIER t_besfhsrskzu.iKzu.iVorbereitend.iSasZentr ECU_ADDRESS 0xFFF8D866 /end MEASUREMENT
/begin MEASUREMENT iSasZentr.iVorbereitend.iKzu.p_kzu "Druck KZU (inklusive GLS-Druck)" SWORD UMR_BAR__1_1000_0_S6_S3 1 100 0 20 DISPLAY_IDENTIFIER p_kzu.iKzu.iVorbereitend.iSasZentr ECU_ADDRESS 0xFFF8D868 /end MEASUREMENT
/begin MEASUREMENT iSasZentr.iVorbereitend.iKzu.p_adaptkzu "Adaptionsdruck zuschaltende Kupplung" SWORD UMR_BAR__1_1000_0_S6_S3 1 100 0 20 DISPLAY_IDENTIFIER p_adaptkzu.iKzu.iVorbereitend.iSasZentr ECU_ADDRESS 0xFFF8D86A /end MEASUREMENT
/begin MEASUREMENT iSasZentr.iVorbereitend.iKzu.timer_zkzu "Zustandstimer zuschaltende Kupplung" UBYTE UMR_MSEC__10_1_0_S6_S3 1 100 0 2550 DISPLAY_IDENTIFIER timer_zkzu.iKzu.iVorbereitend.iSasZentr ECU_ADDRESS 0xFFF8D86C /end MEASUREMENT
/begin MEASUREMENT iSasZentr.iVorbereitend.iKzu.t_schliessrampe "Zeit für Schliessrampe" UBYTE UMR_MSEC__10_1_0_S6_S3 1 100 0 2540 DISPLAY_IDENTIFIER t_schliessrampe.iKzu.iVorbereitend.iSasZentr ECU_ADDRESS 0xFFF8D86D /end MEASUREMENT
/begin MEASUREMENT iSasZentr.iVorbereitend.iKzu.timer_seit_start_schaltung "Zeit seit Start Schaltung" UBYTE UMR_MSEC__10_1_0_S6_S3 1 100 0 2550 DISPLAY_IDENTIFIER timer_seit_start_schaltung.iKzu.iVorbereitend.iSasZentr ECU_ADDRESS 0xFFF8D86E /end MEASUREMENT
/begin MEASUREMENT iSasZentr.iVorbereitend.iKzu.t_berechnungszeitpunkt "Zeitpunkt für Berechnungsstart" SWORD UMR_MSEC__10_1_0_S6_S3 1 100 -327680 327670 DISPLAY_IDENTIFIER t_berechnungszeitpunkt.iKzu.iVorbereitend.iSasZentr ECU_ADDRESS 0xFFF8D870 /end MEASUREMENT
/begin MEASUREMENT iSasZentr.iVorbereitend.iKzu.f_rampenzeitberechnung_fertig "Flag: Die Berechnung der Schliessrampenzeit erfolgt einmalig" UBYTE Conv.cSasAnKzu._.f_rampenzeitberechnung_fertig_S6_S3 1 100 0 1 BIT_MASK 0x1 DISPLAY_IDENTIFIER f_rampenzeitberechnung_fertig.iKzu.iVorbereitend.iSasZentr ECU_ADDRESS 0xFFF8D872 /end MEASUREMENT
/begin MEASUREMENT iSasZentr.iVorbereitend.iKzu.f_hinsyn_kzu_gestartet "FLAG: HINSYN-Fkt. im KZU-Ablauf gestartet" UBYTE Conv.cSasAnKzu._.f_hinsyn_kzu_gestartet_S6_S3 1 100 0 1 BIT_MASK 0x1 DISPLAY_IDENTIFIER f_hinsyn_kzu_gestartet.iKzu.iVorbereitend.iSasZentr ECU_ADDRESS 0xFFF8D873 /end MEASUREMENT
/begin MEASUREMENT iSasZentr.iVorbereitend.iKzu.f_schnellfuellung_war_aktiv "FLAG: Schnellfüllung wurde ausgeführt" UBYTE Conv.cSasAnKzu._.f_schnellfuellung_war_aktiv_S6_S3 1 100 0 1 BIT_MASK 0x1 DISPLAY_IDENTIFIER f_schnellfuellung_war_aktiv.iKzu.iVorbereitend.iSasZentr ECU_ADDRESS 0xFFF8D874 /end MEASUREMENT
/begin MEASUREMENT iSasZentr.iVorbereitend.iKzu.dauer_fa_hsrs_kzu "Merker Dauer Fuellausgleichsphase der KZU" SWORD UMR_MSEC__10_1_0_S6_S3 1 100 -327680 327670 DISPLAY_IDENTIFIER dauer_fa_hsrs_kzu.iKzu.iVorbereitend.iSasZentr ECU_ADDRESS 0xFFF8D876 /end MEASUREMENT
/begin MEASUREMENT iSasZentr.iVorbereitend.iKzu.dauer_ra1_hsrs_kzu "Merker Dauer Rampe 1 der KZU" SWORD UMR_MSEC__10_1_0_S6_S3 1 100 -327680 327670 DISPLAY_IDENTIFIER dauer_ra1_hsrs_kzu.iKzu.iVorbereitend.iSasZentr ECU_ADDRESS 0xFFF8D878 /end MEASUREMENT
/begin MEASUREMENT iSasZentr.iVorbereitend.iKzu.zaehler_zkzu "Zustandszaehler der zusch. Kupplung" UBYTE UMR___1_1_0_S6_S3 1 100 0 255 DISPLAY_IDENTIFIER zaehler_zkzu.iKzu.iVorbereitend.iSasZentr ECU_ADDRESS 0xFFF8D87A /end MEASUREMENT
/begin MEASUREMENT iSasZentr.iVorbereitend.iKzu.schalttyp_kzu "Schalttyp der zusch. Kupplung" UBYTE Conv.cSasAnKzu._.schalttyp_kzu_S6_S3 1 100 0 4 DISPLAY_IDENTIFIER schalttyp_kzu.iKzu.iVorbereitend.iSasZentr ECU_ADDRESS 0xFFF8D87B /end MEASUREMENT
/begin MEASUREMENT iSasZentr.iVorbereitend.iKzu.p_0stkzu "Zustandsanfangsdruck gesteuerter Anteil KZU" SWORD UMR_BAR__1_1000_0_S6_S3 1 100 0 20 DISPLAY_IDENTIFIER p_0stkzu.iKzu.iVorbereitend.iSasZentr ECU_ADDRESS 0xFFF8D87C /end MEASUREMENT
/begin MEASUREMENT iSasZentr.iVorbereitend.iKzu.p_fkzu "Fuelldruck" SWORD UMR_BAR__1_1000_0_S6_S3 1 100 0 20 DISPLAY_IDENTIFIER p_fkzu.iKzu.iVorbereitend.iSasZentr ECU_ADDRESS 0xFFF8D87E /end MEASUREMENT
/begin MEASUREMENT iSasZentr.iVorbereitend.iKzu.p_fkzu_gueltig "Flag: Fuelldruck wurde berechnet und ausgegeben" UBYTE Conv.cSasAnKzu._.p_fkzu_gueltig_S6_S3 1 100 0 1 BIT_MASK 0x1 DISPLAY_IDENTIFIER p_fkzu_gueltig.iKzu.iVorbereitend.iSasZentr ECU_ADDRESS 0xFFF8D880 /end MEASUREMENT
/begin MEASUREMENT iSasZentr.iVorbereitend.iKzu.flag_pomekzu_erlaubt "Flag: Aufrechnung ME-abhaengiger Druckoffset erlaubt" UBYTE Conv.cSasAnKzu._.flag_pomekzu_erlaubt_S6_S3 1 100 0 1 BIT_MASK 0x1 DISPLAY_IDENTIFIER flag_pomekzu_erlaubt.iKzu.iVorbereitend.iSasZentr ECU_ADDRESS 0xFFF8D881 /end MEASUREMENT
/begin MEASUREMENT iSasZentr.iVorbereitend.iKzu.po_mekzu "Schaltdruckoffset, der abhaengig von einem ME ist" SWORD UMR_BAR__1_1000_0_S6_S3 1 100 0 12.75 DISPLAY_IDENTIFIER po_mekzu.iKzu.iVorbereitend.iSasZentr ECU_ADDRESS 0xFFF8D882 /end MEASUREMENT
/begin MEASUREMENT iSasZentr.iVorbereitend.iKzu.t_zkzu "Zustandszeitdauer der KZU" SWORD UMR_MSEC__10_1_0_S6_S3 1 100 -327680 327670 DISPLAY_IDENTIFIER t_zkzu.iKzu.iVorbereitend.iSasZentr ECU_ADDRESS 0xFFF8D884 /end MEASUREMENT
/begin MEASUREMENT iSasZentr.iVorbereitend.iKzu.t_0kzu "Zeitdauer des zuletzt durchlaufenen Zustands KZU" SWORD UMR_MSEC__10_1_0_S6_S3 1 100 -327680 327670 DISPLAY_IDENTIFIER t_0kzu.iKzu.iVorbereitend.iSasZentr ECU_ADDRESS 0xFFF8D886 /end MEASUREMENT
/begin MEASUREMENT iSasZentr.iVorbereitend.iKzu.p_offkzu "Offsetdruck der zuschaltenden Kupplung" SWORD UMR_BAR__1_1000_0_S6_S3 1 100 0 20 DISPLAY_IDENTIFIER p_offkzu.iKzu.iVorbereitend.iSasZentr ECU_ADDRESS 0xFFF8D888 /end MEASUREMENT
/begin MEASUREMENT iSasZentr.iVorbereitend.iKzu.po_mtkzu "momentenabhaengiger Druckoffset" SWORD UMR_BAR__1_1000_0_S6_S3 1 100 0 20 DISPLAY_IDENTIFIER po_mtkzu.iKzu.iVorbereitend.iSasZentr ECU_ADDRESS 0xFFF8D88A /end MEASUREMENT
/begin MEASUREMENT iSasZentr.iVorbereitend.iKzu.p_offkzu_neg_gls "Offsetdruck bei neg GLS" SWORD UMR_BAR__1_1000_0_S6_S3 1 100 0 20 DISPLAY_IDENTIFIER p_offkzu_neg_gls.iKzu.iVorbereitend.iSasZentr ECU_ADDRESS 0xFFF8D88C /end MEASUREMENT
/begin MEASUREMENT iSasZentr.iVorbereitend.iKzu.md_motsoll_sas "Motorsollmomentanstieg" SWORD UMR_NM__1_1_0_S6_S3 1 100 -2000 2000 DISPLAY_IDENTIFIER md_motsoll_sas.iKzu.iVorbereitend.iSasZentr ECU_ADDRESS 0xFFF8D88E /end MEASUREMENT
/begin MEASUREMENT iSasZentr.iVorbereitend.iKzu.timer_ab_ende_sf_kzu "Timer seit SF Ende Kzu" UWORD UMR_MSEC__10_1_0_S6_S3 1 100 0 655350 DISPLAY_IDENTIFIER timer_ab_ende_sf_kzu.iKzu.iVorbereitend.iSasZentr ECU_ADDRESS 0xFFF8D890 /end MEASUREMENT
/begin MEASUREMENT iSasZentr.iVorbereitend.iKzu.po_kzuflare "Druckoffset auf Schaltdruck bei Flare" SWORD UMR_BAR__1_1000_0_S6_S3 1 100 0 20 DISPLAY_IDENTIFIER po_kzuflare.iKzu.iVorbereitend.iSasZentr ECU_ADDRESS 0xFFF8D892 /end MEASUREMENT
/begin MEASUREMENT iSasZentr.iVorbereitend.iKzu.f_ngs_abflare_unterschritten "Merker ob Druckoffset auf Schaltdruck bei Flare gesetzt werden soll" UBYTE Conv.cSasAnKzu._.f_ngs_abflare_unterschritten_S6_S3 1 100 0 1 BIT_MASK 0x1 DISPLAY_IDENTIFIER f_ngs_abflare_unterschritten.iKzu.iVorbereitend.iSasZentr ECU_ADDRESS 0xFFF8D894 /end MEASUREMENT
/begin MEASUREMENT iSasZentr.iVorbereitend.iKzu.f_pokzufol_erlaubt "FLAG: Verwendung von KF_POKZUFOL ist erlaubt" UBYTE Conv.cSasAnKzu._.f_pokzufol_erlaubt_S6_S3 1 100 0 1 BIT_MASK 0x1 DISPLAY_IDENTIFIER f_pokzufol_erlaubt.iKzu.iVorbereitend.iSasZentr ECU_ADDRESS 0xFFF8D895 /end MEASUREMENT
/begin MEASUREMENT iSasZentr.iVorbereitend.iKzu.t_dt_ig_change_folge "Zeit für Momentenübergang bei Folgeschaltung" UBYTE UMR_MSEC__10_1_0_S6_S3 1 100 0 2540 DISPLAY_IDENTIFIER t_dt_ig_change_folge.iKzu.iVorbereitend.iSasZentr ECU_ADDRESS 0xFFF8D896 /end MEASUREMENT
/begin MEASUREMENT iSasZentr.iVorbereitend.sp_ngdsynzielgang.n_f "letzter Wert" SLONG UMR___1_1_0_S6_S3 1 100 -2147483648 2147483647 DISPLAY_IDENTIFIER n_f.sp_ngdsynzielgang.iVorbereitend.iSasZentr ECU_ADDRESS 0xFFF8D8E0 /end MEASUREMENT
/begin MEASUREMENT iSasZentr.iVorbereitend.sp_ngdsynzielgang.letzter_ms_timer "letzter Timerwert" UWORD UMR___1_1_0_S6_S3 1 100 0 65535 DISPLAY_IDENTIFIER letzter_ms_timer.sp_ngdsynzielgang.iVorbereitend.iSasZentr ECU_ADDRESS 0xFFF8D8E4 /end MEASUREMENT
/begin MEASUREMENT iSasZentr.iVorbereitend.synchron "FLAG: Synchronpunkt erreicht" UBYTE Conv.cSasSaKor._.synchron_S6_S3 1 100 0 1 BIT_MASK 0x1 DISPLAY_IDENTIFIER synchron.iVorbereitend.iSasZentr ECU_ADDRESS 0xFFF8D7B0 /end MEASUREMENT
/begin MEASUREMENT iSasZentr.iVorbereitend.zielgang_sas "Zielgang SAS" SBYTE Conv.cSasSaKor._.zielgang_sas_S6_S3 1 100 -1 8 DISPLAY_IDENTIFIER zielgang_sas.iVorbereitend.iSasZentr ECU_ADDRESS 0xFFF8D7B1 /end MEASUREMENT
/begin MEASUREMENT iSasZentr.iVorbereitend.istgang_sas "Istgang SAS" SBYTE Conv.cSasSaKor._.istgang_sas_S6_S3 1 100 -1 8 DISPLAY_IDENTIFIER istgang_sas.iVorbereitend.iSasZentr ECU_ADDRESS 0xFFF8D7B2 /end MEASUREMENT
/begin MEASUREMENT iSasZentr.iVorbereitend.aktuelle_schaltung "FLAG: Aktive Schaltung" UBYTE Conv.cSasSaKor._.aktuelle_schaltung_S6_S3 1 100 0 1 DISPLAY_IDENTIFIER aktuelle_schaltung.iVorbereitend.iSasZentr ECU_ADDRESS 0xFFF8D7B3 /end MEASUREMENT
/begin MEASUREMENT iSasZentr.iVorbereitend.timeout "Flag: Schaltung timeout" UBYTE Conv.cSasSaKor._.timeout_S6_S3 1 100 0 1 BIT_MASK 0x1 DISPLAY_IDENTIFIER timeout.iVorbereitend.iSasZentr ECU_ADDRESS 0xFFF8D7B4 /end MEASUREMENT
/begin MEASUREMENT iSasZentr.iVorbereitend.schaltinfo_sas "Aktuelle Schaltinfo des Schaltablaufs" UBYTE Conv.cSasSaKor._.schaltinfo_sas_S6_S3 1 100 0 4 DISPLAY_IDENTIFIER schaltinfo_sas.iVorbereitend.iSasZentr ECU_ADDRESS 0xFFF8D7B5 /end MEASUREMENT
/begin MEASUREMENT iSasZentr.iVorbereitend.schnellfuellung_beendet "Flag: Schnellfuellung beendet" UBYTE Conv.cSasSaKor._.schnellfuellung_beendet_S6_S3 1 100 0 1 BIT_MASK 0x1 DISPLAY_IDENTIFIER schnellfuellung_beendet.iVorbereitend.iSasZentr ECU_ADDRESS 0xFFF8D7B6 /end MEASUREMENT
/begin MEASUREMENT iSasZentr.iVorbereitend.z_kurze_schaltung "Zustandsgroesse kurze Schaltung" UBYTE Conv.cSasSaKor._.z_kurze_schaltung_S6_S3 1 100 0 7 DISPLAY_IDENTIFIER z_kurze_schaltung.iVorbereitend.iSasZentr ECU_ADDRESS 0xFFF8D7B7 /end MEASUREMENT
/begin MEASUREMENT iSasZentr.iVorbereitend.index_spsas "Vorgabe Schaltung mit SP/SPORT-Parametern" UBYTE Conv.cSasSaKor._.index_spsas_S6_S3 1 100 0 2 DISPLAY_IDENTIFIER index_spsas.iVorbereitend.iSasZentr ECU_ADDRESS 0xFFF8D7B8 /end MEASUREMENT
/begin MEASUREMENT iSasZentr.iVorbereitend.t_syn "vorausberechnete Zeit bis Erreichen Synchron zielgang" SWORD UMR_MSEC__10_1_0_S6_S3 1 100 -327680 327670 DISPLAY_IDENTIFIER t_syn.iVorbereitend.iSasZentr ECU_ADDRESS 0xFFF8D7BA /end MEASUREMENT
/begin MEASUREMENT iSasZentr.iVorbereitend.n_tkf "Turbinendrehzahl f. KF-Zugriff" UBYTE UMR_U_MIN_32_1_0_S6_S3 1 100 0 8160 DISPLAY_IDENTIFIER n_tkf.iVorbereitend.iSasZentr ECU_ADDRESS 0xFFF8D7BC /end MEASUREMENT
/begin MEASUREMENT iSasZentr.iVorbereitend.nd_syn "Differenzdrehzahl zur Synchrondrehzahl neuer Gang (zielgang_sas)" SWORD UMR_U_MIN_1_1_0_S6_S3 1 100 -8000 8000 DISPLAY_IDENTIFIER nd_syn.iVorbereitend.iSasZentr ECU_ADDRESS 0xFFF8D7BE /end MEASUREMENT
/begin MEASUREMENT iSasZentr.iVorbereitend.ng_dsynzielgang "Gradient Differenzdrehzahl n_t zu n_t(synchron zielgang)" SWORD UMR_U_MINSEC_1_1_0_S6_S3 1 100 -32000 32000 DISPLAY_IDENTIFIER ng_dsynzielgang.iVorbereitend.iSasZentr ECU_ADDRESS 0xFFF8D7C0 /end MEASUREMENT
/begin MEASUREMENT iSasZentr.iVorbereitend.nd_synistgang "Differenzdrehzahl zu synchron Istgang" SWORD UMR_U_MIN_1_1_0_S6_S3 1 100 -8000 8000 DISPLAY_IDENTIFIER nd_synistgang.iVorbereitend.iSasZentr ECU_ADDRESS 0xFFF8D7C2 /end MEASUREMENT
/begin MEASUREMENT iSasZentr.iVorbereitend.m_motsoll0_sas "Motorsollmoment bei Start Schaltung" SWORD UMR_NM__1_1_0_S6_S3 1 100 -2000 2000 DISPLAY_IDENTIFIER m_motsoll0_sas.iVorbereitend.iSasZentr ECU_ADDRESS 0xFFF8D7C4 /end MEASUREMENT
/begin MEASUREMENT iSasZentr.iVorbereitend.p_kzu_letzte_schaltung "Druck KZU bei letzter Schaltung" SWORD UMR_BAR__1_1000_0_S6_S3 1 100 0 12.75 DISPLAY_IDENTIFIER p_kzu_letzte_schaltung.iVorbereitend.iSasZentr ECU_ADDRESS 0xFFF8D7C6 /end MEASUREMENT
/begin MEASUREMENT iSasZentr.iVorbereitend.p_kab_letzte_schaltung "Druck KAB bei letzter Schaltung" SWORD UMR_BAR__1_1000_0_S6_S3 1 100 0 12.75 DISPLAY_IDENTIFIER p_kab_letzte_schaltung.iVorbereitend.iSasZentr ECU_ADDRESS 0xFFF8D7C8 /end MEASUREMENT
/begin MEASUREMENT iSasZentr.iVorbereitend.erste_schaltung "Flag: 1. Befuellung einer Kupplung" UBYTE Conv.cSasSaKor._.erste_schaltung_S6_S3 1 100 0 1 BIT_MASK 0x1 DISPLAY_IDENTIFIER erste_schaltung.iVorbereitend.iSasZentr ECU_ADDRESS 0xFFF8D7CA /end MEASUREMENT
/begin MEASUREMENT iSasZentr.iVorbereitend.f_verb_ada_erste_bef "Flag: 1. Befuellung einer Kupplung verbietet Adaption" UBYTE Conv.cSasSaKor._.f_verb_ada_erste_bef_S6_S3 1 100 0 1 BIT_MASK 0x1 DISPLAY_IDENTIFIER f_verb_ada_erste_bef.iVorbereitend.iSasZentr ECU_ADDRESS 0xFFF8D7CB /end MEASUREMENT
/begin MEASUREMENT iSasZentr.iVorbereitend.schaltinfo_sas_vor_folge "Schaltinfo der vorhergehenden Schaltung waehrend verschachtelten Sch." UBYTE Conv.cSasSaKor._.schaltinfo_sas_vor_folge_S6_S3 1 100 0 12 DISPLAY_IDENTIFIER schaltinfo_sas_vor_folge.iVorbereitend.iSasZentr ECU_ADDRESS 0xFFF8D7CC /end MEASUREMENT
/begin MEASUREMENT iSasZentr.iVorbereitend.schnellfuellung_gestartet "Flag: Schnellfuellung gestartet" UBYTE Conv.cSasSaKor._.schnellfuellung_gestartet_S6_S3 1 100 0 1 BIT_MASK 0x1 DISPLAY_IDENTIFIER schnellfuellung_gestartet.iVorbereitend.iSasZentr ECU_ADDRESS 0xFFF8D7CD /end MEASUREMENT
/begin MEASUREMENT iSasZentr.iVorbereitend.fkt_halten_in_sync_verboten "FLAG: Ausfuehren der Fkt. Halten in Synchron verboten" UBYTE Conv.cSasSaKor._.fkt_halten_in_sync_verboten_S6_S3 1 100 0 1 BIT_MASK 0x1 DISPLAY_IDENTIFIER fkt_halten_in_sync_verboten.iVorbereitend.iSasZentr ECU_ADDRESS 0xFFF8D7CE /end MEASUREMENT
/begin MEASUREMENT iSasZentr.iVorbereitend.timer16_sas "Timer Schaltungsdauer, wird bei Vorhalt schon gestartet" UWORD UMR_MSEC__10_1_0_S6_S3 1 100 0 320000 DISPLAY_IDENTIFIER timer16_sas.iVorbereitend.iSasZentr ECU_ADDRESS 0xFFF8D7D0 /end MEASUREMENT
/begin MEASUREMENT iSasZentr.iVorbereitend.t_maxsas "maximale Schaltzeit" UWORD UMR_MSEC__10_1_0_S6_S3 1 100 0 50000 DISPLAY_IDENTIFIER t_maxsas.iVorbereitend.iSasZentr ECU_ADDRESS 0xFFF8D7D2 /end MEASUREMENT
/begin MEASUREMENT iSasZentr.iVorbereitend.flag_mtschwelle_verbietet_hinsyn "FLAG: Ausfuehren der Fkt. Halten in Synchron durch Mt_Schwelle verboten" UBYTE Conv.cSasSaKor._.flag_mtschwelle_verbietet_hinsyn_S6_S3 1 100 0 1 BIT_MASK 0x1 DISPLAY_IDENTIFIER flag_mtschwelle_verbietet_hinsyn.iVorbereitend.iSasZentr ECU_ADDRESS 0xFFF8D7D4 /end MEASUREMENT
/begin MEASUREMENT iSasZentr.iVorbereitend.zwangssynchron "FLAG: Zwangssynchron wird angefordert" UBYTE Conv.cSasSaKor._.zwangssynchron_S6_S3 1 100 0 1 BIT_MASK 0x1 DISPLAY_IDENTIFIER zwangssynchron.iVorbereitend.iSasZentr ECU_ADDRESS 0xFFF8D7D5 /end MEASUREMENT
/begin MEASUREMENT iSasZentr.iVorbereitend.synchron_verboten "FLAG: Synchron verboten" UBYTE Conv.cSasSaKor._.synchron_verboten_S6_S3 1 100 0 1 BIT_MASK 0x1 DISPLAY_IDENTIFIER synchron_verboten.iVorbereitend.iSasZentr ECU_ADDRESS 0xFFF8D7D6 /end MEASUREMENT
/begin MEASUREMENT iSasZentr.iVorbereitend.n_tsyn "Turbinensynchrondrehzahl fuer zielgang_sas" UWORD UMR_U_MIN_1_1_0_S6_S3 1 100 0 8160 DISPLAY_IDENTIFIER n_tsyn.iVorbereitend.iSasZentr ECU_ADDRESS 0xFFF8D7D8 /end MEASUREMENT
/begin MEASUREMENT iSasZentr.iVorbereitend.schaltinfo_syn "Schaltinfo fuer Synchronerkennung" UBYTE Conv.cSasSaKor._.schaltinfo_syn_S6_S3 1 100 0 4 DISPLAY_IDENTIFIER schaltinfo_syn.iVorbereitend.iSasZentr ECU_ADDRESS 0xFFF8D7DA /end MEASUREMENT
/begin MEASUREMENT iSasZentr.iVorbereitend.t_timeout "Zeit von Schaltbeginn bis Start Timeoutfunktion" UWORD UMR_MSEC__10_1_0_S6_S3 1 100 0 50000 DISPLAY_IDENTIFIER t_timeout.iVorbereitend.iSasZentr ECU_ADDRESS 0xFFF8D7DC /end MEASUREMENT
/begin MEASUREMENT iSasZentr.iVorbereitend.kup_schutz_massnahme_aktiv "FLAG: Schutzfunktion auf Grund eines überhitzten Schaltelements aktiv." UBYTE Conv.cSasSaKor._.kup_schutz_massnahme_aktiv_S6_S3 1 100 0 1 BIT_MASK 0x1 DISPLAY_IDENTIFIER kup_schutz_massnahme_aktiv.iVorbereitend.iSasZentr ECU_ADDRESS 0xFFF8D7DE /end MEASUREMENT
/begin MEASUREMENT iSasZentr.sp_mmotmax_rss.letzter_wert "Speichert den letzten Eingangswert" FLOAT32_IEEE UMR___1_1_0_S6_S3 1 100 -1E+037 1E+037 FORMAT "%4.2" DISPLAY_IDENTIFIER letzter_wert.sp_mmotmax_rss.iSasZentr ECU_ADDRESS 0xFFF8DA58 /end MEASUREMENT
/begin MEASUREMENT iSasZentr.sp_mmotmax_rss.letzter_ms_timer "Speichert den letzten BS-Timer" UWORD UMR_MSEC__1_1_0_S6_S3 1 100 0 65535 DISPLAY_IDENTIFIER letzter_ms_timer.sp_mmotmax_rss.iSasZentr ECU_ADDRESS 0xFFF8DA5C /end MEASUREMENT
/begin MEASUREMENT iSasZentr.sp_mmotmax_rss.minimum "Minimum Begrenzung" FLOAT32_IEEE UMR___1_1_0_S6_S3 1 100 -1E+037 1E+037 FORMAT "%4.2" DISPLAY_IDENTIFIER minimum.sp_mmotmax_rss.iSasZentr ECU_ADDRESS 0xFFF8DA60 /end MEASUREMENT
/begin MEASUREMENT iSasZentr.sp_mmotmax_rss.maximum "Maximum Begrenzung" FLOAT32_IEEE UMR___1_1_0_S6_S3 1 100 -1E+037 1E+037 FORMAT "%4.2" DISPLAY_IDENTIFIER maximum.sp_mmotmax_rss.iSasZentr ECU_ADDRESS 0xFFF8DA64 /end MEASUREMENT
/begin MEASUREMENT iSasZentr.schaltung_sas "Flag: Schaltung aktiv" UBYTE Conv.cSasZentr._.schaltung_sas_S6_S3 1 100 0 1 BIT_MASK 0x1 DISPLAY_IDENTIFIER schaltung_sas.iSasZentr ECU_ADDRESS 0xFFF8D618 /end MEASUREMENT
/begin MEASUREMENT iSasZentr.schaltart_sas "Aktuelle Schaltart des Schaltablaufs" UBYTE Conv.cSasZentr._.schaltart_sas_S6_S3 1 100 0 5 DISPLAY_IDENTIFIER schaltart_sas.iSasZentr ECU_ADDRESS 0xFFF8D619 /end MEASUREMENT
/begin MEASUREMENT iSasZentr.schalttyp_sas "Aktueller Schalttyp des Schaltablaufs" UBYTE Conv.cSasZentr._.schalttyp_sas_S6_S3 1 100 0 4 DISPLAY_IDENTIFIER schalttyp_sas.iSasZentr ECU_ADDRESS 0xFFF8D61A /end MEASUREMENT
/begin MEASUREMENT iSasZentr.folgeschaltung "Flag: Folgeschaltung" UBYTE Conv.cSasZentr._.folgeschaltung_S6_S3 1 100 0 1 BIT_MASK 0x1 DISPLAY_IDENTIFIER folgeschaltung.iSasZentr ECU_ADDRESS 0xFFF8D61B /end MEASUREMENT
/begin MEASUREMENT iSasZentr.schaltung_ueber_kzu "Flag: Schaltung ueber KZU" UBYTE Conv.cSasZentr._.schaltung_ueber_kzu_S6_S3 1 100 0 1 BIT_MASK 0x1 DISPLAY_IDENTIFIER schaltung_ueber_kzu.iSasZentr ECU_ADDRESS 0xFFF8D61C /end MEASUREMENT
/begin MEASUREMENT iSasZentr.abbruchsart_ist "Zustand Abbruch Schaltablaufsteuerung" UBYTE Conv.cSasZentr._.abbruchsart_ist_S6_S3 1 100 0 50 DISPLAY_IDENTIFIER abbruchsart_ist.iSasZentr ECU_ADDRESS 0xFFF8D61D /end MEASUREMENT
/begin MEASUREMENT iSasZentr.schrittschaltung "FLAG: Schrittschaltung aktiv" UBYTE Conv.cSasZentr._.schrittschaltung_S6_S3 1 100 0 1 BIT_MASK 0x1 DISPLAY_IDENTIFIER schrittschaltung.iSasZentr ECU_ADDRESS 0xFFF8D61E /end MEASUREMENT
/begin MEASUREMENT iSasZentr.flag_ge_rnd_aktiv "FLAG: Ein GE N-D findet statt" UBYTE Conv.cSasZentr._.flag_ge_rnd_aktiv_S6_S3 1 100 0 1 BIT_MASK 0x1 DISPLAY_IDENTIFIER flag_ge_rnd_aktiv.iSasZentr ECU_ADDRESS 0xFFF8D61F /end MEASUREMENT
/begin MEASUREMENT iSasZentr.flag_ge_dnr_aktiv "FLAG: Ein GE N-R findet statt" UBYTE Conv.cSasZentr._.flag_ge_dnr_aktiv_S6_S3 1 100 0 1 BIT_MASK 0x1 DISPLAY_IDENTIFIER flag_ge_dnr_aktiv.iSasZentr ECU_ADDRESS 0xFFF8D620 /end MEASUREMENT
/begin MEASUREMENT iSasZentr.zug_schub_sas "FLAG: Zustand Zug oder Schub beim Schaltablauf" UBYTE Conv.cSasZentr._.zug_schub_sas_S6_S3 1 100 0 1 DISPLAY_IDENTIFIER zug_schub_sas.iSasZentr ECU_ADDRESS 0xFFF8D621 /end MEASUREMENT
/begin MEASUREMENT iSasZentr.sync_istgang_verlassen_me "FLAG: Synchrondrehzahl Istgang verlassen (schaltungsabhaengig) fuer ME und GWK" UBYTE Conv.cSasZentr._.sync_istgang_verlassen_me_S6_S3 1 100 0 1 BIT_MASK 0x1 DISPLAY_IDENTIFIER sync_istgang_verlassen_me.iSasZentr ECU_ADDRESS 0xFFF8D622 /end MEASUREMENT
/begin MEASUREMENT iSasZentr.sync_istgang_verlassen "FLAG: Synchrondrehzahl istgang verlassen (SCHWELLE_NDSYSN)" UBYTE Conv.cSasZentr._.sync_istgang_verlassen_S6_S3 1 100 0 1 BIT_MASK 0x1 DISPLAY_IDENTIFIER sync_istgang_verlassen.iSasZentr ECU_ADDRESS 0xFFF8D623 /end MEASUREMENT
/begin MEASUREMENT iSasZentr.flag_sync_verlassen_me "Flag sync istgang verlassen (schaltungsabhaengig) und kein sync zielgang fuer ME und GWK" UBYTE Conv.cSasZentr._.flag_sync_verlassen_me_S6_S3 1 100 0 1 BIT_MASK 0x1 DISPLAY_IDENTIFIER flag_sync_verlassen_me.iSasZentr ECU_ADDRESS 0xFFF8D624 /end MEASUREMENT
/begin MEASUREMENT iSasZentr.c_getr_sas "Getriebetemperatur zu Schaltbeginn" UBYTE UMR_GRADC__1_1_M40_S6_S3 1 100 -40 215 DISPLAY_IDENTIFIER c_getr_sas.iSasZentr ECU_ADDRESS 0xFFF8D625 /end MEASUREMENT
/begin MEASUREMENT iSasZentr.m_tpgrasyn "Turbinenmoment fuer Schliessrampenberechnung" SWORD UMR_NM__1_1_0_S6_S3 1 100 -400 1640 DISPLAY_IDENTIFIER m_tpgrasyn.iSasZentr ECU_ADDRESS 0xFFF8D626 /end MEASUREMENT
/begin MEASUREMENT iSasZentr.md_tpgrasyn "Turbinenmomentanstieg von Minimalwert seit synchron" SWORD UMR_NM__1_1_0_S6_S3 1 100 -400 1640 DISPLAY_IDENTIFIER md_tpgrasyn.iSasZentr ECU_ADDRESS 0xFFF8D628 /end MEASUREMENT
/begin MEASUREMENT iSasZentr.nd_nmot_nt "Differenzdrehzahl (n_mot - n_t)" SWORD UMR_U_MIN_1_1_0_S6_S3 1 100 -16320 16320 DISPLAY_IDENTIFIER nd_nmot_nt.iSasZentr ECU_ADDRESS 0xFFF8D62A /end MEASUREMENT
/begin MEASUREMENT iSasZentr.t_schaltverzug "Schaltungsverzugszeit" UWORD UMR_MSEC__10_1_0_S6_S3 1 100 0 50000 DISPLAY_IDENTIFIER t_schaltverzug.iSasZentr ECU_ADDRESS 0xFFF8D62C /end MEASUREMENT
/begin MEASUREMENT iSasZentr.timer16_nsyn "Startet beim ersten Erkennen von synchron" UWORD UMR_MSEC__10_1_0_S6_S3 1 100 0 655350 DISPLAY_IDENTIFIER timer16_nsyn.iSasZentr ECU_ADDRESS 0xFFF8D62E /end MEASUREMENT
/begin MEASUREMENT iSasZentr.timer_in_synchron "Zeit seit der n_t innerhalb Synchronschwelle" UBYTE UMR_MSEC__10_1_0_S6_S3 1 100 0 2550 DISPLAY_IDENTIFIER timer_in_synchron.iSasZentr ECU_ADDRESS 0xFFF8D630 /end MEASUREMENT
/begin MEASUREMENT iSasZentr.ng_absas "Gradient Abtriebsdrehzahl Schaltablauf" SWORD UMR_U_MINSEC_1_1_0_S6_S3 1 100 -1000 1000 DISPLAY_IDENTIFIER ng_absas.iSasZentr ECU_ADDRESS 0xFFF8D632 /end MEASUREMENT
/begin MEASUREMENT iSasZentr.f_eco_mode "Flag ECO Mode aktiv" UBYTE Conv.cSasZentr._.f_eco_mode_S6_S3 1 100 0 1 BIT_MASK 0x1 DISPLAY_IDENTIFIER f_eco_mode.iSasZentr ECU_ADDRESS 0xFFF8D634 /end MEASUREMENT
/begin MEASUREMENT iSasZentr.schaltung_anfahren "Schalttyp Anfahren" SBYTE Conv.cSasZentr._.schaltung_anfahren_S6_S3 1 100 -2 2 DISPLAY_IDENTIFIER schaltung_anfahren.iSasZentr ECU_ADDRESS 0xFFF8D635 /end MEASUREMENT
/begin MEASUREMENT iSasZentr.schaltung_anfahren_idx "Schalttyp Anfahren als index" UBYTE Conv.cSasZentr._.schaltung_anfahren_idx_S6_S3 1 100 0 4 DISPLAY_IDENTIFIER schaltung_anfahren_idx.iSasZentr ECU_ADDRESS 0xFFF8D636 /end MEASUREMENT
/begin MEASUREMENT iSasZentr.schaltung_anfahren_aktiv "Schaltung Anfahren laeuft (Gleitphase)" SBYTE Conv.cSasZentr._.schaltung_anfahren_aktiv_S6_S3 1 100 -2 2 DISPLAY_IDENTIFIER schaltung_anfahren_aktiv.iSasZentr ECU_ADDRESS 0xFFF8D637 /end MEASUREMENT
/begin MEASUREMENT iSasZentr.schaltung_anfahren_aktiv_idx "Schaltung Anfahren laeuft (Gleitphase) als Index" UBYTE Conv.cSasZentr._.schaltung_anfahren_aktiv_idx_S6_S3 1 100 0 4 DISPLAY_IDENTIFIER schaltung_anfahren_aktiv_idx.iSasZentr ECU_ADDRESS 0xFFF8D638 /end MEASUREMENT
/begin MEASUREMENT iSasZentr.schaltung_phase_anfahren "Schaltungs Phase Anfahren" UBYTE Conv.cSasZentr._.schaltung_phase_anfahren_S6_S3 1 100 0 4 DISPLAY_IDENTIFIER schaltung_phase_anfahren.iSasZentr ECU_ADDRESS 0xFFF8D639 /end MEASUREMENT
/begin MEASUREMENT iSasZentr.istgang_sync "Istgangerkennung Schaltungslogik Anfahren" SBYTE Conv.cSasZentr._.istgang_sync_S6_S3 1 100 -1 8 DISPLAY_IDENTIFIER istgang_sync.iSasZentr ECU_ADDRESS 0xFFF8D63A /end MEASUREMENT
/begin MEASUREMENT iSasZentr.istgang_sync_idx "Istgangerkennung Schaltungslogik Anfahren als Index" UBYTE Conv.cSasZentr._.istgang_sync_idx_S6_S3 1 100 0 10 DISPLAY_IDENTIFIER istgang_sync_idx.iSasZentr ECU_ADDRESS 0xFFF8D63B /end MEASUREMENT
/begin MEASUREMENT iSasZentr.gangwechsel "FLAG: n_t zwischen sync istgang und zielgang" UBYTE Conv.cSasZentr._.gangwechsel_S6_S3 1 100 0 1 BIT_MASK 0x1 DISPLAY_IDENTIFIER gangwechsel.iSasZentr ECU_ADDRESS 0xFFF8D63C /end MEASUREMENT
/begin MEASUREMENT iSasZentr.sync_ziel_erreicht "FLAG: Synchronpunkt erreicht (bleibt fuer Mindestzeit stehen)" UBYTE Conv.cSasZentr._.sync_ziel_erreicht_S6_S3 1 100 0 1 BIT_MASK 0x1 DISPLAY_IDENTIFIER sync_ziel_erreicht.iSasZentr ECU_ADDRESS 0xFFF8D63D /end MEASUREMENT
/begin MEASUREMENT iSasZentr.m_motmax_sas "Maximal zulässiges Motormoment das vom Schaltablauf vorgegeben wird" SWORD UMR_NM__1_1_0_S6_S3 1 100 -400 1640 DISPLAY_IDENTIFIER m_motmax_sas.iSasZentr ECU_ADDRESS 0xFFF8D63E /end MEASUREMENT
/begin MEASUREMENT iSasZentr.z_mmotmax_sas "Anzeigegroeße fuer die aktieve m_motmax_sas-Funktion" UBYTE UMR___1_1_0_S6_S3 1 100 0 18 DISPLAY_IDENTIFIER z_mmotmax_sas.iSasZentr ECU_ADDRESS 0xFFF8D640 /end MEASUREMENT
/begin MEASUREMENT iSasZentr.f_entscheidungspkt_versch_erreicht "Entscheidungspunkt der Verschachtelung wurde erreicht" UBYTE Conv.cSasZentr._.f_entscheidungspkt_versch_erreicht_S6_S3 1 100 0 1 BIT_MASK 0x1 DISPLAY_IDENTIFIER f_entscheidungspkt_versch_erreicht.iSasZentr ECU_ADDRESS 0xFFF8D641 /end MEASUREMENT
/begin MEASUREMENT iSasZentr.z_fes_mode "Zustandsgroesse Fahrmodus (Normal, Eco, Sport, SportPlus, ComfortPlus" UBYTE Conv.cSasZentr._.z_fes_mode_S6_S3 1 100 0 4 DISPLAY_IDENTIFIER z_fes_mode.iSasZentr ECU_ADDRESS 0xFFF8D642 /end MEASUREMENT
/begin MEASUREMENT iSasZentr.schaltung_abgebrochen "Flag: Schaltung wurde abgebrochen" UBYTE Conv.cSasZentr._.schaltung_abgebrochen_S6_S3 1 100 0 1 BIT_MASK 0x1 DISPLAY_IDENTIFIER schaltung_abgebrochen.iSasZentr ECU_ADDRESS 0xFFF8D643 /end MEASUREMENT
/begin MEASUREMENT iSasZentr.zs_wechsel_verboten "FLAG: Zug-Schub Wechsel verboten" UBYTE Conv.cSasZentr._.zs_wechsel_verboten_S6_S3 1 100 0 1 BIT_MASK 0x1 DISPLAY_IDENTIFIER zs_wechsel_verboten.iSasZentr ECU_ADDRESS 0xFFF8D644 /end MEASUREMENT
/begin MEASUREMENT iSasZentr.m_motmax_rss "Maximal zulässiges Motormoment während RSS" SWORD UMR_NM__1_1_0_S6_S3 1 100 -400 1640 DISPLAY_IDENTIFIER m_motmax_rss.iSasZentr ECU_ADDRESS 0xFFF8D646 /end MEASUREMENT
/begin MEASUREMENT iSasZentr.abbruchsart_soll "Vorgegebener Zustand Abbruch, wird in Init-Fkt. initialisiert" UBYTE Conv.cSasZentr._.abbruchsart_soll_S6_S3 1 100 0 50 DISPLAY_IDENTIFIER abbruchsart_soll.iSasZentr ECU_ADDRESS 0xFFF8D648 /end MEASUREMENT
/begin MEASUREMENT iSasZentr.f_verschachtelung_verboten "Flag: Verschachtelung ist durch Verschachtelungsbedingungen einmalig als verboten erkannt worden" UBYTE Conv.cSasZentr._.f_verschachtelung_verboten_S6_S3 1 100 0 1 BIT_MASK 0x1 DISPLAY_IDENTIFIER f_verschachtelung_verboten.iSasZentr ECU_ADDRESS 0xFFF8D649 /end MEASUREMENT
/begin MEASUREMENT iSasZentr.f_schaltung_normal_beendet "Flag: Merker, das die laufende Schaltung ohne Abbrueche od. Maximalzeit beendet wurde" UBYTE Conv.cSasZentr._.f_schaltung_normal_beendet_S6_S3 1 100 0 1 BIT_MASK 0x1 DISPLAY_IDENTIFIER f_schaltung_normal_beendet.iSasZentr ECU_ADDRESS 0xFFF8D64A /end MEASUREMENT
/begin MEASUREMENT iSasZentr.schaltart_sas_sps "Index Tabelle aktuelle Schaltart des Schaltablaufs, abhängig von Spontanität" UBYTE Conv.cSasZentr._.schaltart_sas_sps_S6_S3 1 100 0 3 DISPLAY_IDENTIFIER schaltart_sas_sps.iSasZentr ECU_ADDRESS 0xFFF8D64B /end MEASUREMENT
/begin MEASUREMENT iSasZentr.schalttyp "Aktueller Schalttyp" UBYTE Conv.cSasZentr._.schalttyp_S6_S3 1 100 0 4 DISPLAY_IDENTIFIER schalttyp.iSasZentr ECU_ADDRESS 0xFFF8D64C /end MEASUREMENT
/begin MEASUREMENT iSasZentr.kup_nkraftloesend2_letztes_ga "2. nichtkraftloesende Kupplung des letzten Gangauslegens" UBYTE Conv.cSasZentr._.kup_nkraftloesend2_letztes_ga_S6_S3 1 100 0 5 DISPLAY_IDENTIFIER kup_nkraftloesend2_letztes_ga.iSasZentr ECU_ADDRESS 0xFFF8D64D /end MEASUREMENT
/begin MEASUREMENT iSasZentr.vorbereitung_im_vordergrund "Flag: Vorbereitung steuert Kupplung" UBYTE Conv.cSasZentr._.vorbereitung_im_vordergrund_S6_S3 1 100 0 1 BIT_MASK 0x1 DISPLAY_IDENTIFIER vorbereitung_im_vordergrund.iSasZentr ECU_ADDRESS 0xFFF8D64E /end MEASUREMENT
/begin MEASUREMENT iSasZentr.abbruchsart_hs_gls_erlaubt "Flag: Abbruch einer HS waehrend GLS erlaubt" UBYTE Conv.cSasZentr._.abbruchsart_hs_gls_erlaubt_S6_S3 1 100 0 1 BIT_MASK 0x1 DISPLAY_IDENTIFIER abbruchsart_hs_gls_erlaubt.iSasZentr ECU_ADDRESS 0xFFF8D64F /end MEASUREMENT
/begin MEASUREMENT iSasZentr.wechsel_normal_kurz "Flag: Wechsel von Normalen auf Spontane Schaltungen" UBYTE Conv.cSasZentr._.wechsel_normal_kurz_S6_S3 1 100 0 1 BIT_MASK 0x1 DISPLAY_IDENTIFIER wechsel_normal_kurz.iSasZentr ECU_ADDRESS 0xFFF8D650 /end MEASUREMENT
/begin MEASUREMENT iSasZentr.schaltungsende_durch_ge_ga "Flag: Merker, dass GE/GA die laufende Schaltung beendet hat" UBYTE Conv.cSasZentr._.schaltungsende_durch_ge_ga_S6_S3 1 100 0 1 BIT_MASK 0x1 DISPLAY_IDENTIFIER schaltungsende_durch_ge_ga.iSasZentr ECU_ADDRESS 0xFFF8D651 /end MEASUREMENT
/begin MEASUREMENT iSasZentr.event_sf_erkannt "Flag: Merker, für Event eine SF gestartet genau 1x durchlaufen wurde" UBYTE Conv.cSasZentr._.event_sf_erkannt_S6_S3 1 100 0 1 BIT_MASK 0x1 DISPLAY_IDENTIFIER event_sf_erkannt.iSasZentr ECU_ADDRESS 0xFFF8D652 /end MEASUREMENT
/begin MEASUREMENT iSasZentr.z_sync_ziel "Zustandsgroesse für Zustandsgraph zur Bestimmung von sync_ziel_erreicht" UBYTE Conv.cSasZentr._.z_sync_ziel_S6_S3 1 100 0 3 DISPLAY_IDENTIFIER z_sync_ziel.iSasZentr ECU_ADDRESS 0xFFF8D653 /end MEASUREMENT
/begin MEASUREMENT iSasZentr.timer_hold_sync_ziel "Timer Mindesthaltezeit für sync_ziel_erreicht" UBYTE UMR_MSEC__10_1_0_S6_S3 1 100 0 2550 DISPLAY_IDENTIFIER timer_hold_sync_ziel.iSasZentr ECU_ADDRESS 0xFFF8D654 /end MEASUREMENT
/begin MEASUREMENT iSasZentr.f_init_phase1_m_motmax_rss "Flag Phase1 der Momentenbegrenzung bei RSS wurde neu initialisiert" UBYTE Conv.cSasZentr._.f_init_phase1_m_motmax_rss_S6_S3 1 100 0 1 BIT_MASK 0x1 DISPLAY_IDENTIFIER f_init_phase1_m_motmax_rss.iSasZentr ECU_ADDRESS 0xFFF8D655 /end MEASUREMENT
/begin MEASUREMENT iSasZentr.igang_dki_m_motmax_rss "Istgang bei dem die Dki-Schwelle fuer die m_motmax_rss Momentenbegrenzung unterschritten war" SBYTE Conv.cSasZentr._.igang_dki_m_motmax_rss_S6_S3 1 100 -1 8 DISPLAY_IDENTIFIER igang_dki_m_motmax_rss.iSasZentr ECU_ADDRESS 0xFFF8D656 /end MEASUREMENT
/begin MEASUREMENT iSasZentr.igang_m_motmax_rss "Istgang in dem die m_motmax_rss Momentenbegrenzung gestartet wurde" SBYTE Conv.cSasZentr._.igang_m_motmax_rss_S6_S3 1 100 -1 8 DISPLAY_IDENTIFIER igang_m_motmax_rss.iSasZentr ECU_ADDRESS 0xFFF8D657 /end MEASUREMENT
/begin MEASUREMENT iSasZentr.m_motmax_merk "gemerkter Momentenwert" SWORD UMR_NM__1_1_0_S6_S3 1 100 -1000 1300 DISPLAY_IDENTIFIER m_motmax_merk.iSasZentr ECU_ADDRESS 0xFFF8D658 /end MEASUREMENT
/begin MEASUREMENT iSasZentr.t_rampe_m_motmax_rss "Rampenzeit Ueberführungsrampe m_motmax_rss von Phase1 auf Phase2" UBYTE UMR_MSEC__10_1_0_S6_S3 1 100 0 2550 DISPLAY_IDENTIFIER t_rampe_m_motmax_rss.iSasZentr ECU_ADDRESS 0xFFF8D65A /end MEASUREMENT
/begin MEASUREMENT iSasZentr.timer_z_m_motmax_rss "Timer Überführungsrampe m_motmax_rss von Phase1 auf Phase2" UBYTE UMR_MSEC__10_1_0_S6_S3 1 100 0 2550 DISPLAY_IDENTIFIER timer_z_m_motmax_rss.iSasZentr ECU_ADDRESS 0xFFF8D65B /end MEASUREMENT
/begin MEASUREMENT iSasZentr.z_m_motmax_rss "Zustandsgroesse für Zustandsgraph zur Bestimmung von m_motmax_rss" UBYTE Conv.cSasZentr._.z_m_motmax_rss_S6_S3 1 100 0 7 DISPLAY_IDENTIFIER z_m_motmax_rss.iSasZentr ECU_ADDRESS 0xFFF8D65C /end MEASUREMENT
/begin MEASUREMENT iSasZentr.zgang_m_motmax_rss "Zielgang in dem die m_motmax_rss Momentenbegrenzung gestartet wurde" SBYTE Conv.cSasZentr._.zgang_m_motmax_rss_S6_S3 1 100 -1 8 DISPLAY_IDENTIFIER zgang_m_motmax_rss.iSasZentr ECU_ADDRESS 0xFFF8D65D /end MEASUREMENT
/begin MEASUREMENT iSasZentr.z_m_motmax_sas "Zustandsgroesse für Zustandsgraph zur Bestimmung von m_motmax_sas" UBYTE Conv.cSasZentr._.z_m_motmax_sas_S6_S3 1 100 0 3 DISPLAY_IDENTIFIER z_m_motmax_sas.iSasZentr ECU_ADDRESS 0xFFF8D65E /end MEASUREMENT
/begin MEASUREMENT iSasZentr.f_einstiegsbed_erfuellt "Flag das Einstiegsbed. für Zustandsgraph zur Bestimmung von m_motmax_sas erfüllt sind" UBYTE Conv.cSasZentr._.f_einstiegsbed_erfuellt_S6_S3 1 100 0 1 BIT_MASK 0x1 DISPLAY_IDENTIFIER f_einstiegsbed_erfuellt.iSasZentr ECU_ADDRESS 0xFFF8D65F /end MEASUREMENT
/begin MEASUREMENT iSasZentr.zaehler_z_m_motmax_sas "Zustandszaehler der Zustandsgraph m_motmax_sas" UBYTE UMR___1_1_0_S6_S3 1 100 0 255 DISPLAY_IDENTIFIER zaehler_z_m_motmax_sas.iSasZentr ECU_ADDRESS 0xFFF8D660 /end MEASUREMENT
/begin MEASUREMENT iSasZentr.mg_wert_gesp "Gemerkter Wert des Momentengradienten" SWORD UMR_NM_SEC_1_1_0_S6_S3 1 100 -200 2550 DISPLAY_IDENTIFIER mg_wert_gesp.iSasZentr ECU_ADDRESS 0xFFF8D662 /end MEASUREMENT
/begin MEASUREMENT iSasZentr.m_motmax_vers "Maximal zulässiges Motormoment während einer verschachtelten Schaltung" SWORD UMR_NM__1_1_0_S6_S3 1 100 -400 1640 DISPLAY_IDENTIFIER m_motmax_vers.iSasZentr ECU_ADDRESS 0xFFF8D664 /end MEASUREMENT
/begin MEASUREMENT iSasZentr.z_m_motmax_kupschtz "Zustandsgroesse für Zustandsgraph zur Bestimmung von m_motmax_kupschtz" UBYTE Conv.cSasZentr._.z_m_motmax_kupschtz_S6_S3 1 100 0 4 DISPLAY_IDENTIFIER z_m_motmax_kupschtz.iSasZentr ECU_ADDRESS 0xFFF8D666 /end MEASUREMENT
/begin MEASUREMENT iSasZentr.f_red_mmotmax_angefordert "Flag das Einstiegsbed. für Zustandsgraph zur Bestimmung von m_motmax_kupschtz erfüllt sind" UBYTE Conv.cSasZentr._.f_red_mmotmax_angefordert_S6_S3 1 100 0 1 BIT_MASK 0x1 DISPLAY_IDENTIFIER f_red_mmotmax_angefordert.iSasZentr ECU_ADDRESS 0xFFF8D667 /end MEASUREMENT
/begin MEASUREMENT iSasZentr.zaehler_z_m_motmax_kupschtz "Zustandszaehler der Zustandsgraph m_motmax_kupschtz" UBYTE UMR___1_1_0_S6_S3 1 100 0 255 DISPLAY_IDENTIFIER zaehler_z_m_motmax_kupschtz.iSasZentr ECU_ADDRESS 0xFFF8D668 /end MEASUREMENT
/begin MEASUREMENT iSasZentr.timer_m_motmax_kupschtz "Timer Rückführungsrampe von m_motmax_kupschtz auf m_mot" UBYTE UMR_MSEC__10_1_0_S6_S3 1 100 0 2550 DISPLAY_IDENTIFIER timer_m_motmax_kupschtz.iSasZentr ECU_ADDRESS 0xFFF8D669 /end MEASUREMENT
/begin MEASUREMENT iSasZentr.t_z_m_motmax_kupschtz "Zustandszeit für z_m_motmax_kupschtz" UBYTE UMR_MSEC__10_1_0_S6_S3 1 100 0 2550 DISPLAY_IDENTIFIER t_z_m_motmax_kupschtz.iSasZentr ECU_ADDRESS 0xFFF8D66A /end MEASUREMENT
/begin MEASUREMENT iSasZentr.start_wert_grad "Startwert für Rückfiltergradient." SWORD UMR_NM__1_1_0_S6_S3 1 100 -400 1640 DISPLAY_IDENTIFIER start_wert_grad.iSasZentr ECU_ADDRESS 0xFFF8D66C /end MEASUREMENT
/begin MEASUREMENT iSasZentr.m_motmax_kupschtz "Maximal zulässiges Motormoment bei aktiver Kupplungschutzfkt." SWORD UMR_NM__1_1_0_S6_S3 1 100 -400 1640 DISPLAY_IDENTIFIER m_motmax_kupschtz.iSasZentr ECU_ADDRESS 0xFFF8D66E /end MEASUREMENT
/begin MEASUREMENT iSasZentr.diag_versch_erlaubt "Diagnose wer verbietet Verschachtelung" UBYTE Conv.cSasZentr._.diag_versch_erlaubt_S6_S3 1 100 0 12 DISPLAY_IDENTIFIER diag_versch_erlaubt.iSasZentr ECU_ADDRESS 0xFFF8D670 /end MEASUREMENT
/begin MEASUREMENT iSasZentr.timer_schaltung_sas "Timer der mit Schaltungsstart losläuft" UBYTE UMR_MSEC__10_1_0_S6_S3 1 100 0 2550 DISPLAY_IDENTIFIER timer_schaltung_sas.iSasZentr ECU_ADDRESS 0xFFF8D671 /end MEASUREMENT
/begin MEASUREMENT iSasZentr.z_shlog_anfahren "Zustandsgroesse für Zustandsgraph zur Bestimmung von Schaltgroessen Anfahren" UBYTE Conv.cSasZentr._.z_shlog_anfahren_S6_S3 1 100 0 4 DISPLAY_IDENTIFIER z_shlog_anfahren.iSasZentr ECU_ADDRESS 0xFFF8D672 /end MEASUREMENT
/begin MEASUREMENT iSasZentr.timer_shlog_anfahren_me "Timer Schaltungsende fuer Schaltungslogik Anfahren" UBYTE UMR_MSEC__10_1_0_S6_S3 1 100 0 2550 DISPLAY_IDENTIFIER timer_shlog_anfahren_me.iSasZentr ECU_ADDRESS 0xFFF8D673 /end MEASUREMENT
/begin MEASUREMENT iSasZentr.f_z_shlog_anfahren_aktiv "Flag das einzelne Zustaende des Zustandsgraphes aktiv war" UBYTE Conv.cSasZentr._.f_z_shlog_anfahren_aktiv_S6_S3 1 100 0 1 BIT_MASK 0x1 DISPLAY_IDENTIFIER f_z_shlog_anfahren_aktiv.iSasZentr ECU_ADDRESS 0xFFF8D674 /end MEASUREMENT
/begin MEASUREMENT iSasZentr.z_gangwechsel "Zustandsgroesse zum Setzen des Flags Gangwechsel" UBYTE Conv.cSasZentr._.z_gangwechsel_S6_S3 1 100 0 4 DISPLAY_IDENTIFIER z_gangwechsel.iSasZentr ECU_ADDRESS 0xFFF8D675 /end MEASUREMENT
/begin MEASUREMENT iSasZentr.timer_gangwechsel "Timer fuer die Mindestzeit des Flags Gangwechsel" UBYTE UMR_MSEC__10_1_0_S6_S3 1 100 0 2550 DISPLAY_IDENTIFIER timer_gangwechsel.iSasZentr ECU_ADDRESS 0xFFF8D676 /end MEASUREMENT
/begin MEASUREMENT iSasPsystBedarfgerBestrom.f_i_bedarf_anfordern "Flag ob eine Bedarfsgerechte Bestromung angefordert werden soll" UBYTE Conv.cSasPsystBedarfgerBestrom._.f_i_bedarf_anfordern_S6_S3 1 100 0 1 BIT_MASK 0x1 DISPLAY_IDENTIFIER f_i_bedarf_anfordern.iSasPsystBedarfgerBestrom ECU_ADDRESS 0xFFF8D5BC /end MEASUREMENT
/begin MEASUREMENT iSasPsystBedarfgerBestrom.f_i_bedarf "Flag das eine Bedarfsgerechte Bestromung angefordert wird" UBYTE Conv.cSasPsystBedarfgerBestrom._.f_i_bedarf_S6_S3 1 100 0 1 BIT_MASK 0x1 DISPLAY_IDENTIFIER f_i_bedarf.iSasPsystBedarfgerBestrom ECU_ADDRESS 0xFFF8D5BD /end MEASUREMENT
/begin MEASUREMENT iSasPsyst.speicher_filter_psys.x "letzter Wert" SLONG UMR___1_1_0_S6_S3 1 100 -2147483648 2147483647 DISPLAY_IDENTIFIER x.speicher_filter_psys.iSasPsyst ECU_ADDRESS 0xFFF8D5E8 /end MEASUREMENT
/begin MEASUREMENT iSasPsyst.speicher_filter_psys.letzter_ms_timer "letzter BS-Timer" UWORD UMR_MSEC__1_1_0_S6_S3 1 100 0 65535 DISPLAY_IDENTIFIER letzter_ms_timer.speicher_filter_psys.iSasPsyst ECU_ADDRESS 0xFFF8D5EC /end MEASUREMENT
/begin MEASUREMENT iSasPsyst.filter_p_sysist.x "letzter Wert" SLONG UMR___1_1_0_S6_S3 1 100 -2147483648 2147483647 DISPLAY_IDENTIFIER x.filter_p_sysist.iSasPsyst ECU_ADDRESS 0xFFF8D5F0 /end MEASUREMENT
/begin MEASUREMENT iSasPsyst.filter_p_sysist.letzter_ms_timer "letzter BS-Timer" UWORD UMR_MSEC__1_1_0_S6_S3 1 100 0 65535 DISPLAY_IDENTIFIER letzter_ms_timer.filter_p_sysist.iSasPsyst ECU_ADDRESS 0xFFF8D5F4 /end MEASUREMENT
/begin MEASUREMENT iSasPsyst.rampe_p_sysiae.letzter_wert "Speichert den letzten Eingangswert" FLOAT32_IEEE UMR___1_1_0_S6_S3 1 100 -1E+037 1E+037 FORMAT "%4.2" DISPLAY_IDENTIFIER letzter_wert.rampe_p_sysiae.iSasPsyst ECU_ADDRESS 0xFFF8D5F8 /end MEASUREMENT
/begin MEASUREMENT iSasPsyst.rampe_p_sysiae.letzter_ms_timer "Speichert den letzten BS-Timer" UWORD UMR_MSEC__1_1_0_S6_S3 1 100 0 65535 DISPLAY_IDENTIFIER letzter_ms_timer.rampe_p_sysiae.iSasPsyst ECU_ADDRESS 0xFFF8D5FC /end MEASUREMENT
/begin MEASUREMENT iSasPsyst.rampe_p_sysiae.minimum "Minimum Begrenzung" FLOAT32_IEEE UMR___1_1_0_S6_S3 1 100 -1E+037 1E+037 FORMAT "%4.2" DISPLAY_IDENTIFIER minimum.rampe_p_sysiae.iSasPsyst ECU_ADDRESS 0xFFF8D600 /end MEASUREMENT
/begin MEASUREMENT iSasPsyst.rampe_p_sysiae.maximum "Maximum Begrenzung" FLOAT32_IEEE UMR___1_1_0_S6_S3 1 100 -1E+037 1E+037 FORMAT "%4.2" DISPLAY_IDENTIFIER maximum.rampe_p_sysiae.iSasPsyst ECU_ADDRESS 0xFFF8D604 /end MEASUREMENT
/begin MEASUREMENT iSasPsyst.rampe_p_syspulsada.letzter_wert "Speichert den letzten Eingangswert" FLOAT32_IEEE UMR___1_1_0_S6_S3 1 100 -1E+037 1E+037 FORMAT "%4.2" DISPLAY_IDENTIFIER letzter_wert.rampe_p_syspulsada.iSasPsyst ECU_ADDRESS 0xFFF8D608 /end MEASUREMENT
/begin MEASUREMENT iSasPsyst.rampe_p_syspulsada.letzter_ms_timer "Speichert den letzten BS-Timer" UWORD UMR_MSEC__1_1_0_S6_S3 1 100 0 65535 DISPLAY_IDENTIFIER letzter_ms_timer.rampe_p_syspulsada.iSasPsyst ECU_ADDRESS 0xFFF8D60C /end MEASUREMENT
/begin MEASUREMENT iSasPsyst.rampe_p_syspulsada.minimum "Minimum Begrenzung" FLOAT32_IEEE UMR___1_1_0_S6_S3 1 100 -1E+037 1E+037 FORMAT "%4.2" DISPLAY_IDENTIFIER minimum.rampe_p_syspulsada.iSasPsyst ECU_ADDRESS 0xFFF8D610 /end MEASUREMENT
/begin MEASUREMENT iSasPsyst.rampe_p_syspulsada.maximum "Maximum Begrenzung" FLOAT32_IEEE UMR___1_1_0_S6_S3 1 100 -1E+037 1E+037 FORMAT "%4.2" DISPLAY_IDENTIFIER maximum.rampe_p_syspulsada.iSasPsyst ECU_ADDRESS 0xFFF8D614 /end MEASUREMENT
/begin MEASUREMENT iSasPsyst.p_sys "Systemdruck" UWORD UMR_BAR__1_1000_0_S6_S3 1 100 0 20 DISPLAY_IDENTIFIER p_sys.iSasPsyst ECU_ADDRESS 0xFFF8D5C4 /end MEASUREMENT
/begin MEASUREMENT iSasPsyst.p_sys_cbar "Systemdruck in hundertstel quantisiert" SWORD UMR_BAR__1_100_0_S6_S3 1 100 0 20 DISPLAY_IDENTIFIER p_sys_cbar.iSasPsyst ECU_ADDRESS 0xFFF8D5C6 /end MEASUREMENT
/begin MEASUREMENT iSasPsyst.p_sys_soll "Soll Systemdruck ungefiltert" UWORD UMR_BAR__1_1000_0_S6_S3 1 100 0 20 DISPLAY_IDENTIFIER p_sys_soll.iSasPsyst ECU_ADDRESS 0xFFF8D5C8 /end MEASUREMENT
/begin MEASUREMENT iSasPsyst.p_mod "Modulationsdruck" UWORD UMR_BAR__1_1000_0_S6_S3 1 100 0 20 DISPLAY_IDENTIFIER p_mod.iSasPsyst ECU_ADDRESS 0xFFF8D5CA /end MEASUREMENT
/begin MEASUREMENT iSasPsyst.p_sysist "Ist-Systemdruck" UWORD UMR_BAR__1_1000_0_S6_S3 1 100 0 20 DISPLAY_IDENTIFIER p_sysist.iSasPsyst ECU_ADDRESS 0xFFF8D5CC /end MEASUREMENT
/begin MEASUREMENT iSasPsyst.p_iep_sys "Systemdruck-Begrenzung für IEP" UWORD UMR_BAR__1_1000_0_S6_S3 1 100 0 20 DISPLAY_IDENTIFIER p_iep_sys.iSasPsyst ECU_ADDRESS 0xFFF8D5CE /end MEASUREMENT
/begin MEASUREMENT iSasPsyst.p_pumpe_sys "Systemdruck-Begrenzung aus Pumpe" UWORD UMR_BAR__1_1000_0_S6_S3 1 100 0 20 DISPLAY_IDENTIFIER p_pumpe_sys.iSasPsyst ECU_ADDRESS 0xFFF8D5D0 /end MEASUREMENT
/begin MEASUREMENT iSasPsyst.f_zeit_max_psys_anst_laeuft "FLAG: Zeit für MAX-Ansteuerung Systemdruck läuft" UBYTE Conv.cSasPsyst._.f_zeit_max_psys_anst_laeuft_S6_S3 1 100 0 1 BIT_MASK 0x1 DISPLAY_IDENTIFIER f_zeit_max_psys_anst_laeuft.iSasPsyst ECU_ADDRESS 0xFFF8D5D2 /end MEASUREMENT
/begin MEASUREMENT iSasPsyst.f_psys_kupschutz_anst_laeuft "FLAG: Systemdruckanhebung Kupplungstemperaturschutz aktiv" UBYTE Conv.cSasPsyst._.f_psys_kupschutz_anst_laeuft_S6_S3 1 100 0 1 BIT_MASK 0x1 DISPLAY_IDENTIFIER f_psys_kupschutz_anst_laeuft.iSasPsyst ECU_ADDRESS 0xFFF8D5D3 /end MEASUREMENT
/begin MEASUREMENT iSasPsyst.fkt_druckvorgabe_psys "Info welche Funktion aktiv die Systemdruckansteuerung beeinflusst" UBYTE Conv.cSasPsyst._.fkt_druckvorgabe_psys_S6_S3 1 100 0 255 DISPLAY_IDENTIFIER fkt_druckvorgabe_psys.iSasPsyst ECU_ADDRESS 0xFFF8D5D4 /end MEASUREMENT
/begin MEASUREMENT iSasPsyst.fkt_druckvorgabe_psys_alt "Info welche Funktion im letzen Zyklus die Systemdruckansteuerung beeinflusst hat" UBYTE Conv.cSasPsyst._.fkt_druckvorgabe_psys_alt_S6_S3 1 100 0 255 DISPLAY_IDENTIFIER fkt_druckvorgabe_psys_alt.iSasPsyst ECU_ADDRESS 0xFFF8D5D5 /end MEASUREMENT
/begin MEASUREMENT iSasPsyst.fkt_druckvorgabe_uebfaehig "Info welche Funktion den Druck fuer die Uebertragungsfaehigkeit vorgibt" UBYTE Conv.cSasPsyst._.fkt_druckvorgabe_uebfaehig_S6_S3 1 100 0 255 DISPLAY_IDENTIFIER fkt_druckvorgabe_uebfaehig.iSasPsyst ECU_ADDRESS 0xFFF8D5D6 /end MEASUREMENT
/begin MEASUREMENT iSasPsyst.prio_absolutdruckvorgabe_anz "Prioritaet der Absolutdruckvorgabe" UBYTE Conv.cSasPsyst._.prio_absolutdruckvorgabe_anz_S6_S3 1 100 0 255 DISPLAY_IDENTIFIER prio_absolutdruckvorgabe_anz.iSasPsyst ECU_ADDRESS 0xFFF8D5D7 /end MEASUREMENT
/begin MEASUREMENT iSasPsyst.f_psys_eff_aktiv "FLAG: Effizienzsystemdruckansteuerung aktiv" UBYTE Conv.cSasPsyst._.f_psys_eff_aktiv_S6_S3 1 100 0 1 BIT_MASK 0x1 DISPLAY_IDENTIFIER f_psys_eff_aktiv.iSasPsyst ECU_ADDRESS 0xFFF8D5D8 /end MEASUREMENT
/begin MEASUREMENT iSasPsyst.f_auframpen_mg_psysminpuls_gest "FLAG: Auframpen über Gradient wurde gestartet" UBYTE Conv.cSasPsyst._.f_auframpen_mg_psysminpuls_gest_S6_S3 1 100 0 1 BIT_MASK 0x1 DISPLAY_IDENTIFIER f_auframpen_mg_psysminpuls_gest.iSasPsyst ECU_ADDRESS 0xFFF8D5D9 /end MEASUREMENT
/begin MEASUREMENT iSasPsyst.f_zeit_max_psys_abgelaufen "FLAG: Zeit für MAX-Ansteuerung Systemdruck ist abgelaufen" UBYTE Conv.cSasPsyst._.f_zeit_max_psys_abgelaufen_S6_S3 1 100 0 1 BIT_MASK 0x1 DISPLAY_IDENTIFIER f_zeit_max_psys_abgelaufen.iSasPsyst ECU_ADDRESS 0xFFF8D5DA /end MEASUREMENT
/begin MEASUREMENT iSasPsyst.f_zeit_max_psys_anst_laeuft_alt "FLAG: Im letzen Zyklus lief die Zeit für die MAX-Ansteuerung Systemdruck" UBYTE Conv.cSasPsyst._.f_zeit_max_psys_anst_laeuft_alt_S6_S3 1 100 0 1 BIT_MASK 0x1 DISPLAY_IDENTIFIER f_zeit_max_psys_anst_laeuft_alt.iSasPsyst ECU_ADDRESS 0xFFF8D5DB /end MEASUREMENT
/begin MEASUREMENT iSasPsyst.timer_max_psys_anst "Timer fur MAX-Ansteuerung Systemdruck" UBYTE UMR_MSEC__10_1_0_S6_S3 1 100 0 2550 DISPLAY_IDENTIFIER timer_max_psys_anst.iSasPsyst ECU_ADDRESS 0xFFF8D5DC /end MEASUREMENT
/begin MEASUREMENT iSasPsyst.pos_alt_psys "Positionssignal aus letztem Task" UBYTE Conv.cSasPsyst._.pos_alt_psys_S6_S3 1 100 0 8 DISPLAY_IDENTIFIER pos_alt_psys.iSasPsyst ECU_ADDRESS 0xFFF8D5DD /end MEASUREMENT
/begin MEASUREMENT iSasPsyst.timer_psys_ps "Timer fur PSYS Ansteuerung von Parksperre" UWORD UMR_MSEC__10_1_0_S6_S3 1 100 0 2550 DISPLAY_IDENTIFIER timer_psys_ps.iSasPsyst ECU_ADDRESS 0xFFF8D5DE /end MEASUREMENT
/begin MEASUREMENT iSasPsyst.timer_seit_ausstieg_psys_eff "Timer startet wenn zugriff auf Effizienzkennfelder unterbrochen wird" UWORD UMR_MSEC__10_1_0_S6_S3 1 100 0 650000 DISPLAY_IDENTIFIER timer_seit_ausstieg_psys_eff.iSasPsyst ECU_ADDRESS 0xFFF8D5E0 /end MEASUREMENT
/begin MEASUREMENT iSasPsyst.f_einstiegsbed_p_sysiae_erf "FLAG: Bedingungen für Systemdruckvorgabe IAE Fkt. erfüllt" UBYTE Conv.cSasPsyst._.f_einstiegsbed_p_sysiae_erf_S6_S3 1 100 0 1 BIT_MASK 0x1 DISPLAY_IDENTIFIER f_einstiegsbed_p_sysiae_erf.iSasPsyst ECU_ADDRESS 0xFFF8D5E2 /end MEASUREMENT
/begin MEASUREMENT iSasPsyst.z_anst_eff_psys "Zustandsgroesse fuer Zustand der Effizienzsystemdruckanst" UBYTE Conv.cSasPsyst._.z_anst_eff_psys_S6_S3 1 100 0 4 DISPLAY_IDENTIFIER z_anst_eff_psys.iSasPsyst ECU_ADDRESS 0xFFF8D5E3 /end MEASUREMENT
/begin COMPU_METHOD UMR___1_300_0_S6_S3 "int = ((phys * 300) / 1) - (0) [-]" RAT_FUNC "%7.5" "[-]" COEFFS 0 300 -0 0 0 1 /end COMPU_METHOD
/begin COMPU_METHOD UMR___1_1_0_S6_S3 "int = ((phys * 1) / 1) - (0) [-]" RAT_FUNC "%2.0" "[-]" COEFFS 0 1 -0 0 0 1 /end COMPU_METHOD
/begin COMPU_METHOD UMR_NM__1_1_0_S6_S3 "int = ((phys * 1) / 1) - (0) [Nm]" RAT_FUNC "%2.0" "[Nm]" COEFFS 0 1 -0 0 0 1 /end COMPU_METHOD
/begin COMPU_METHOD UMR_NM_SEC_1_1_0_S6_S3 "int = ((phys * 1) / 1) - (0) [Nm/s]" RAT_FUNC "%2.0" "[Nm/s]" COEFFS 0 1 -0 0 0 1 /end COMPU_METHOD
/begin COMPU_METHOD UMR_BAR__1_1000_0_S6_S3 "int = ((phys * 1000) / 1) - (0) [bar]" RAT_FUNC "%5.3" "[bar]" COEFFS 0 1000 -0 0 0 1 /end COMPU_METHOD
/begin COMPU_METHOD UMR_BAR__1_100_0_S6_S3 "int = ((phys * 100) / 1) - (0) [bar]" RAT_FUNC "%4.2" "[bar]" COEFFS 0 100 -0 0 0 1 /end COMPU_METHOD
/begin COMPU_METHOD UMR_U_MIN_1_1_0_S6_S3 "int = ((phys * 1) / 1) - (0) [U/min]" RAT_FUNC "%2.0" "[U/min]" COEFFS 0 1 -0 0 0 1 /end COMPU_METHOD
/begin COMPU_METHOD UMR_U_MIN_32_1_0_S6_S3 "int = ((phys * 1) / 32) - (0) [U/min]" RAT_FUNC "%2.0" "[U/min]" COEFFS 0 1 -0 0 0 32 /end COMPU_METHOD
/begin COMPU_METHOD UMR_U_MINSEC_1_1_0_S6_S3 "int = ((phys * 1) / 1) - (0) [U/(min*s)]" RAT_FUNC "%2.0" "[U/(min*s)]" COEFFS 0 1 -0 0 0 1 /end COMPU_METHOD
/begin COMPU_METHOD UMR_U_MINSEC_10000_32767_0_S6_S3 "int = ((phys * 32767) / 10000) - (0) [U/(min*s)]" RAT_FUNC "%6.4" "[U/(min*s)]" COEFFS 0 32767 -0 0 0 10000 /end COMPU_METHOD
/begin COMPU_METHOD UMR_MSEC__1_1_0_S6_S3 "int = ((phys * 1) / 1) - (0) [ms]" RAT_FUNC "%2.0" "[ms]" COEFFS 0 1 -0 0 0 1 /end COMPU_METHOD
/begin COMPU_METHOD UMR_MSEC__10_1_0_S6_S3 "int = ((phys * 1) / 10) - (0) [ms]" RAT_FUNC "%2.0" "[ms]" COEFFS 0 1 -0 0 0 10 /end COMPU_METHOD
/begin COMPU_METHOD UMR_SEC__1_1_0_S6_S3 "int = ((phys * 1) / 1) - (0) [s]" RAT_FUNC "%2.0" "[s]" COEFFS 0 1 -0 0 0 1 /end COMPU_METHOD
/begin COMPU_METHOD UMR_GRADC__1_1_M40_S6_S3 "int = ((phys * 1) / 1) - (-40) [°C]" RAT_FUNC "%2.0" "[°C]" COEFFS 0 1 40 0 0 1 /end COMPU_METHOD
/begin COMPU_METHOD Conv.cSasKorGls._.reg_gls_gestartet_S6_S3 "Umrechnung fuer Messgroesse cSasKorGls::reg_gls_gestartet" TAB_VERB "%4.0" "" COMPU_TAB_REF Conv.cSasKorGls._.reg_gls_gestartet_S6_S3 /end COMPU_METHOD
/begin COMPU_METHOD Conv.cSasKorGls._.gls_mindruck_S6_S3 "Umrechnung fuer Messgroesse cSasKorGls::gls_mindruck" TAB_VERB "%4.0" "" COMPU_TAB_REF Conv.cSasKorGls._.gls_mindruck_S6_S3 /end COMPU_METHOD
/begin COMPU_METHOD Conv.cSasKorGls._.z_gls_S6_S3 "Umrechnung fuer Messgroesse cSasKorGls::z_gls" TAB_VERB "%4.0" "" COMPU_TAB_REF Conv.cSasKorGls._.z_gls_S6_S3 /end COMPU_METHOD
/begin COMPU_METHOD Conv.cSasKorGls._.gls_aktiv_S6_S3 "Umrechnung fuer Messgroesse cSasKorGls::gls_aktiv" TAB_VERB "%4.0" "" COMPU_TAB_REF Conv.cSasKorGls._.gls_aktiv_S6_S3 /end COMPU_METHOD
/begin COMPU_METHOD Conv.cSasKorGls._.schaltung_gls_S6_S3 "Umrechnung fuer Messgroesse cSasKorGls::schaltung_gls" TAB_VERB "%4.0" "" COMPU_TAB_REF Conv.cSasKorGls._.schaltung_gls_S6_S3 /end COMPU_METHOD
/begin COMPU_METHOD Conv.cSasKorGls._.wechsel_kzu_kab_S6_S3 "Umrechnung fuer Messgroesse cSasKorGls::wechsel_kzu_kab" TAB_VERB "%4.0" "" COMPU_TAB_REF Conv.cSasKorGls._.wechsel_kzu_kab_S6_S3 /end COMPU_METHOD
/begin COMPU_METHOD Conv.cSasKorGls._.verz_gls_gestartet_S6_S3 "Umrechnung fuer Messgroesse cSasKorGls::verz_gls_gestartet" TAB_VERB "%4.0" "" COMPU_TAB_REF Conv.cSasKorGls._.verz_gls_gestartet_S6_S3 /end COMPU_METHOD
/begin COMPU_METHOD Conv.cSasBerechnungGls._.flag_umsch_gls_kab_S6_S3 "Umrechnung fuer Messgroesse cSasBerechnungGls::flag_umsch_gls_kab" TAB_VERB "%4.0" "" COMPU_TAB_REF Conv.cSasBerechnungGls._.flag_umsch_gls_kab_S6_S3 /end COMPU_METHOD
/begin COMPU_METHOD Conv.cSasBerechnungGls._.flag_umsch_gls_kzu_S6_S3 "Umrechnung fuer Messgroesse cSasBerechnungGls::flag_umsch_gls_kzu" TAB_VERB "%4.0" "" COMPU_TAB_REF Conv.cSasBerechnungGls._.flag_umsch_gls_kzu_S6_S3 /end COMPU_METHOD
/begin COMPU_METHOD Conv.cSasBerechnungGls._.schub_zug_wechsel_S6_S3 "Umrechnung fuer Messgroesse cSasBerechnungGls::schub_zug_wechsel" TAB_VERB "%4.0" "" COMPU_TAB_REF Conv.cSasBerechnungGls._.schub_zug_wechsel_S6_S3 /end COMPU_METHOD
/begin COMPU_METHOD Conv.cSasBerechnungGls._.filter_wngtgls_gestartet_S6_S3 "Umrechnung fuer Messgroesse cSasBerechnungGls::filter_wngtgls_gestartet" TAB_VERB "%4.0" "" COMPU_TAB_REF Conv.cSasBerechnungGls._.filter_wngtgls_gestartet_S6_S3 /end COMPU_METHOD
/begin COMPU_METHOD Conv.cSasBerechnungGls._.schalttyp_gls_S6_S3 "Umrechnung fuer Messgroesse cSasBerechnungGls::schalttyp_gls" TAB_VERB "%4.0" "" COMPU_TAB_REF Conv.cSasBerechnungGls._.schalttyp_gls_S6_S3 /end COMPU_METHOD
/begin COMPU_METHOD Conv.cSasBerechnungGls._.wechsel_normal_kurz_S6_S3 "Umrechnung fuer Messgroesse cSasBerechnungGls::wechsel_normal_kurz" TAB_VERB "%4.0" "" COMPU_TAB_REF Conv.cSasBerechnungGls._.wechsel_normal_kurz_S6_S3 /end COMPU_METHOD
/begin COMPU_METHOD Conv.cSasBerechnungGls._.diag_schaltung_ueber_kzu_S6_S3 "Umrechnung fuer Messgroesse cSasBerechnungGls::diag_schaltung_ueber_kzu" TAB_VERB "%4.0" "" COMPU_TAB_REF Conv.cSasBerechnungGls._.diag_schaltung_ueber_kzu_S6_S3 /end COMPU_METHOD
/begin COMPU_METHOD Conv.cSasRegelungGls._.zug_schub_gls_S6_S3 "Umrechnung fuer Messgroesse cSasRegelungGls::zug_schub_gls" TAB_VERB "%4.0" "" COMPU_TAB_REF Conv.cSasRegelungGls._.zug_schub_gls_S6_S3 /end COMPU_METHOD
/begin COMPU_METHOD Conv.cSasRegelungGls._.z_gls_regler_S6_S3 "Umrechnung fuer Messgroesse cSasRegelungGls::z_gls_regler" TAB_VERB "%4.0" "" COMPU_TAB_REF Conv.cSasRegelungGls._.z_gls_regler_S6_S3 /end COMPU_METHOD
/begin COMPU_METHOD Conv.cSasAnKzu._.fa_kzu_gestartet_S6_S3 "Umrechnung fuer Messgroesse cSasAnKzu::fa_kzu_gestartet" TAB_VERB "%4.0" "" COMPU_TAB_REF Conv.cSasAnKzu._.fa_kzu_gestartet_S6_S3 /end COMPU_METHOD
/begin COMPU_METHOD Conv.cSasAnKzu._.ra1_hsrs_kzu_gestartet_S6_S3 "Umrechnung fuer Messgroesse cSasAnKzu::ra1_hsrs_kzu_gestartet" TAB_VERB "%4.0" "" COMPU_TAB_REF Conv.cSasAnKzu._.ra1_hsrs_kzu_gestartet_S6_S3 /end COMPU_METHOD
/begin COMPU_METHOD Conv.cSasAnKzu._.ra2_hsrs_kzu_gestartet_S6_S3 "Umrechnung fuer Messgroesse cSasAnKzu::ra2_hsrs_kzu_gestartet" TAB_VERB "%4.0" "" COMPU_TAB_REF Conv.cSasAnKzu._.ra2_hsrs_kzu_gestartet_S6_S3 /end COMPU_METHOD
/begin COMPU_METHOD Conv.cSasAnKzu._.ra3_hsrs_kzu_gestartet_S6_S3 "Umrechnung fuer Messgroesse cSasAnKzu::ra3_hsrs_kzu_gestartet" TAB_VERB "%4.0" "" COMPU_TAB_REF Conv.cSasAnKzu._.ra3_hsrs_kzu_gestartet_S6_S3 /end COMPU_METHOD
/begin COMPU_METHOD Conv.cSasAnKzu._.schliessen_kzu_S6_S3 "Umrechnung fuer Messgroesse cSasAnKzu::schliessen_kzu" TAB_VERB "%4.0" "" COMPU_TAB_REF Conv.cSasAnKzu._.schliessen_kzu_S6_S3 /end COMPU_METHOD
/begin COMPU_METHOD Conv.cSasAnKzu._.statisch_kzu_S6_S3 "Umrechnung fuer Messgroesse cSasAnKzu::statisch_kzu" TAB_VERB "%4.0" "" COMPU_TAB_REF Conv.cSasAnKzu._.statisch_kzu_S6_S3 /end COMPU_METHOD
/begin COMPU_METHOD Conv.cSasAnKzu._.z_kzu_S6_S3 "Umrechnung fuer Messgroesse cSasAnKzu::z_kzu" TAB_VERB "%4.0" "" COMPU_TAB_REF Conv.cSasAnKzu._.z_kzu_S6_S3 /end COMPU_METHOD
/begin COMPU_METHOD Conv.cSasAnKzu._.kup_kzu_S6_S3 "Umrechnung fuer Messgroesse cSasAnKzu::kup_kzu" TAB_VERB "%4.0" "" COMPU_TAB_REF Conv.cSasAnKzu._.kup_kzu_S6_S3 /end COMPU_METHOD
/begin COMPU_METHOD Conv.cSasAnKzu._.f_rampenzeitberechnung_fertig_S6_S3 "Umrechnung fuer Messgroesse cSasAnKzu::f_rampenzeitberechnung_fertig" TAB_VERB "%4.0" "" COMPU_TAB_REF Conv.cSasAnKzu._.f_rampenzeitberechnung_fertig_S6_S3 /end COMPU_METHOD
/begin COMPU_METHOD Conv.cSasAnKzu._.f_hinsyn_kzu_gestartet_S6_S3 "Umrechnung fuer Messgroesse cSasAnKzu::f_hinsyn_kzu_gestartet" TAB_VERB "%4.0" "" COMPU_TAB_REF Conv.cSasAnKzu._.f_hinsyn_kzu_gestartet_S6_S3 /end COMPU_METHOD
/begin COMPU_METHOD Conv.cSasAnKzu._.f_schnellfuellung_war_aktiv_S6_S3 "Umrechnung fuer Messgroesse cSasAnKzu::f_schnellfuellung_war_aktiv" TAB_VERB "%4.0" "" COMPU_TAB_REF Conv.cSasAnKzu._.f_schnellfuellung_war_aktiv_S6_S3 /end COMPU_METHOD
/begin COMPU_METHOD Conv.cSasAnKzu._.schalttyp_kzu_S6_S3 "Umrechnung fuer Messgroesse cSasAnKzu::schalttyp_kzu" TAB_VERB "%4.0" "" COMPU_TAB_REF Conv.cSasAnKzu._.schalttyp_kzu_S6_S3 /end COMPU_METHOD
/begin COMPU_METHOD Conv.cSasAnKzu._.p_fkzu_gueltig_S6_S3 "Umrechnung fuer Messgroesse cSasAnKzu::p_fkzu_gueltig" TAB_VERB "%4.0" "" COMPU_TAB_REF Conv.cSasAnKzu._.p_fkzu_gueltig_S6_S3 /end COMPU_METHOD
/begin COMPU_METHOD Conv.cSasAnKzu._.flag_pomekzu_erlaubt_S6_S3 "Umrechnung fuer Messgroesse cSasAnKzu::flag_pomekzu_erlaubt" TAB_VERB "%4.0" "" COMPU_TAB_REF Conv.cSasAnKzu._.flag_pomekzu_erlaubt_S6_S3 /end COMPU_METHOD
/begin COMPU_METHOD Conv.cSasAnKzu._.f_ngs_abflare_unterschritten_S6_S3 "Umrechnung fuer Messgroesse cSasAnKzu::f_ngs_abflare_unterschritten" TAB_VERB "%4.0" "" COMPU_TAB_REF Conv.cSasAnKzu._.f_ngs_abflare_unterschritten_S6_S3 /end COMPU_METHOD
/begin COMPU_METHOD Conv.cSasAnKzu._.f_pokzufol_erlaubt_S6_S3 "Umrechnung fuer Messgroesse cSasAnKzu::f_pokzufol_erlaubt" TAB_VERB "%4.0" "" COMPU_TAB_REF Conv.cSasAnKzu._.f_pokzufol_erlaubt_S6_S3 /end COMPU_METHOD
/begin COMPU_METHOD Conv.cSasAnKab._.ende_kab_gestartet_S6_S3 "Umrechnung fuer Messgroesse cSasAnKab::ende_kab_gestartet" TAB_VERB "%4.0" "" COMPU_TAB_REF Conv.cSasAnKab._.ende_kab_gestartet_S6_S3 /end COMPU_METHOD
/begin COMPU_METHOD Conv.cSasAnKab._.pkf_rs_kab_gestartet_S6_S3 "Umrechnung fuer Messgroesse cSasAnKab::pkf_rs_kab_gestartet" TAB_VERB "%4.0" "" COMPU_TAB_REF Conv.cSasAnKab._.pkf_rs_kab_gestartet_S6_S3 /end COMPU_METHOD
/begin COMPU_METHOD Conv.cSasAnKab._.ps_hs_kab_gestartet_S6_S3 "Umrechnung fuer Messgroesse cSasAnKab::ps_hs_kab_gestartet" TAB_VERB "%4.0" "" COMPU_TAB_REF Conv.cSasAnKab._.ps_hs_kab_gestartet_S6_S3 /end COMPU_METHOD
/begin COMPU_METHOD Conv.cSasAnKab._.ra1_kab_gestartet_S6_S3 "Umrechnung fuer Messgroesse cSasAnKab::ra1_kab_gestartet" TAB_VERB "%4.0" "" COMPU_TAB_REF Conv.cSasAnKab._.ra1_kab_gestartet_S6_S3 /end COMPU_METHOD
/begin COMPU_METHOD Conv.cSasAnKab._.statisch_kab_S6_S3 "Umrechnung fuer Messgroesse cSasAnKab::statisch_kab" TAB_VERB "%4.0" "" COMPU_TAB_REF Conv.cSasAnKab._.statisch_kab_S6_S3 /end COMPU_METHOD
/begin COMPU_METHOD Conv.cSasAnKab._.ueb_rs_kab_gestartet_S6_S3 "Umrechnung fuer Messgroesse cSasAnKab::ueb_rs_kab_gestartet" TAB_VERB "%4.0" "" COMPU_TAB_REF Conv.cSasAnKab._.ueb_rs_kab_gestartet_S6_S3 /end COMPU_METHOD
/begin COMPU_METHOD Conv.cSasAnKab._.kup_kab_S6_S3 "Umrechnung fuer Messgroesse cSasAnKab::kup_kab" TAB_VERB "%4.0" "" COMPU_TAB_REF Conv.cSasAnKab._.kup_kab_S6_S3 /end COMPU_METHOD
/begin COMPU_METHOD Conv.cSasAnKab._.z_kab_S6_S3 "Umrechnung fuer Messgroesse cSasAnKab::z_kab" TAB_VERB "%4.0" "" COMPU_TAB_REF Conv.cSasAnKab._.z_kab_S6_S3 /end COMPU_METHOD
/begin COMPU_METHOD Conv.cSasAnKab._.ra_sd_hs_kab_gestartet_S6_S3 "Umrechnung fuer Messgroesse cSasAnKab::ra_sd_hs_kab_gestartet" TAB_VERB "%4.0" "" COMPU_TAB_REF Conv.cSasAnKab._.ra_sd_hs_kab_gestartet_S6_S3 /end COMPU_METHOD
/begin COMPU_METHOD Conv.cSasAnKab._.ra_sd_rs_kab_gestartet_S6_S3 "Umrechnung fuer Messgroesse cSasAnKab::ra_sd_rs_kab_gestartet" TAB_VERB "%4.0" "" COMPU_TAB_REF Conv.cSasAnKab._.ra_sd_rs_kab_gestartet_S6_S3 /end COMPU_METHOD
/begin COMPU_METHOD Conv.cSasAnKab._.halten_in_syn_kab_gestartet_S6_S3 "Umrechnung fuer Messgroesse cSasAnKab::halten_in_syn_kab_gestartet" TAB_VERB "%4.0" "" COMPU_TAB_REF Conv.cSasAnKab._.halten_in_syn_kab_gestartet_S6_S3 /end COMPU_METHOD
/begin COMPU_METHOD Conv.cSasAnKab._.gls_hs_kab_gestartet_S6_S3 "Umrechnung fuer Messgroesse cSasAnKab::gls_hs_kab_gestartet" TAB_VERB "%4.0" "" COMPU_TAB_REF Conv.cSasAnKab._.gls_hs_kab_gestartet_S6_S3 /end COMPU_METHOD
/begin COMPU_METHOD Conv.cSasAnKab._.pkf_rs_kab_ausgegeben_S6_S3 "Umrechnung fuer Messgroesse cSasAnKab::pkf_rs_kab_ausgegeben" TAB_VERB "%4.0" "" COMPU_TAB_REF Conv.cSasAnKab._.pkf_rs_kab_ausgegeben_S6_S3 /end COMPU_METHOD
/begin COMPU_METHOD Conv.cSasAnKab._.kab_nicht_befuellt_S6_S3 "Umrechnung fuer Messgroesse cSasAnKab::kab_nicht_befuellt" TAB_VERB "%4.0" "" COMPU_TAB_REF Conv.cSasAnKab._.kab_nicht_befuellt_S6_S3 /end COMPU_METHOD
/begin COMPU_METHOD Conv.cSasAnKab._.f_ende_verz_kab_erlaubt_S6_S3 "Umrechnung fuer Messgroesse cSasAnKab::f_ende_verz_kab_erlaubt" TAB_VERB "%4.0" "" COMPU_TAB_REF Conv.cSasAnKab._.f_ende_verz_kab_erlaubt_S6_S3 /end COMPU_METHOD
/begin COMPU_METHOD Conv.cSasAnKab._.f_best_poffkab_in_syn_erfolgt_S6_S3 "Umrechnung fuer Messgroesse cSasAnKab::f_best_poffkab_in_syn_erfolgt" TAB_VERB "%4.0" "" COMPU_TAB_REF Conv.cSasAnKab._.f_best_poffkab_in_syn_erfolgt_S6_S3 /end COMPU_METHOD
/begin COMPU_METHOD Conv.cSasAnKab._.schalttyp_kab_S6_S3 "Umrechnung fuer Messgroesse cSasAnKab::schalttyp_kab" TAB_VERB "%4.0" "" COMPU_TAB_REF Conv.cSasAnKab._.schalttyp_kab_S6_S3 /end COMPU_METHOD
/begin COMPU_METHOD Conv.cSasSaKor._.synchron_S6_S3 "Umrechnung fuer Messgroesse cSasSaKor::synchron" TAB_VERB "%4.0" "" COMPU_TAB_REF Conv.cSasSaKor._.synchron_S6_S3 /end COMPU_METHOD
/begin COMPU_METHOD Conv.cSasSaKor._.zielgang_sas_S6_S3 "Umrechnung fuer Messgroesse cSasSaKor::zielgang_sas" TAB_VERB "%4.0" "" COMPU_TAB_REF Conv.cSasSaKor._.zielgang_sas_S6_S3 /end COMPU_METHOD
/begin COMPU_METHOD Conv.cSasSaKor._.istgang_sas_S6_S3 "Umrechnung fuer Messgroesse cSasSaKor::istgang_sas" TAB_VERB "%4.0" "" COMPU_TAB_REF Conv.cSasSaKor._.istgang_sas_S6_S3 /end COMPU_METHOD
/begin COMPU_METHOD Conv.cSasSaKor._.aktuelle_schaltung_S6_S3 "Umrechnung fuer Messgroesse cSasSaKor::aktuelle_schaltung" TAB_VERB "%4.0" "" COMPU_TAB_REF Conv.cSasSaKor._.aktuelle_schaltung_S6_S3 /end COMPU_METHOD
/begin COMPU_METHOD Conv.cSasSaKor._.timeout_S6_S3 "Umrechnung fuer Messgroesse cSasSaKor::timeout" TAB_VERB "%4.0" "" COMPU_TAB_REF Conv.cSasSaKor._.timeout_S6_S3 /end COMPU_METHOD
/begin COMPU_METHOD Conv.cSasSaKor._.schaltinfo_sas_S6_S3 "Umrechnung fuer Messgroesse cSasSaKor::schaltinfo_sas" TAB_VERB "%4.0" "" COMPU_TAB_REF Conv.cSasSaKor._.schaltinfo_sas_S6_S3 /end COMPU_METHOD
/begin COMPU_METHOD Conv.cSasSaKor._.schnellfuellung_beendet_S6_S3 "Umrechnung fuer Messgroesse cSasSaKor::schnellfuellung_beendet" TAB_VERB "%4.0" "" COMPU_TAB_REF Conv.cSasSaKor._.schnellfuellung_beendet_S6_S3 /end COMPU_METHOD
/begin COMPU_METHOD Conv.cSasSaKor._.z_kurze_schaltung_S6_S3 "Umrechnung fuer Messgroesse cSasSaKor::z_kurze_schaltung" TAB_VERB "%4.0" "" COMPU_TAB_REF Conv.cSasSaKor._.z_kurze_schaltung_S6_S3 /end COMPU_METHOD
/begin COMPU_METHOD Conv.cSasSaKor._.index_spsas_S6_S3 "Umrechnung fuer Messgroesse cSasSaKor::index_spsas" TAB_VERB "%4.0" "" COMPU_TAB_REF Conv.cSasSaKor._.index_spsas_S6_S3 /end COMPU_METHOD
/begin COMPU_METHOD Conv.cSasSaKor._.erste_schaltung_S6_S3 "Umrechnung fuer Messgroesse cSasSaKor::erste_schaltung" TAB_VERB "%4.0" "" COMPU_TAB_REF Conv.cSasSaKor._.erste_schaltung_S6_S3 /end COMPU_METHOD
/begin COMPU_METHOD Conv.cSasSaKor._.f_verb_ada_erste_bef_S6_S3 "Umrechnung fuer Messgroesse cSasSaKor::f_verb_ada_erste_bef" TAB_VERB "%4.0" "" COMPU_TAB_REF Conv.cSasSaKor._.f_verb_ada_erste_bef_S6_S3 /end COMPU_METHOD
/begin COMPU_METHOD Conv.cSasSaKor._.schaltinfo_sas_vor_folge_S6_S3 "Umrechnung fuer Messgroesse cSasSaKor::schaltinfo_sas_vor_folge" TAB_VERB "%4.0" "" COMPU_TAB_REF Conv.cSasSaKor._.schaltinfo_sas_vor_folge_S6_S3 /end COMPU_METHOD
/begin COMPU_METHOD Conv.cSasSaKor._.schnellfuellung_gestartet_S6_S3 "Umrechnung fuer Messgroesse cSasSaKor::schnellfuellung_gestartet" TAB_VERB "%4.0" "" COMPU_TAB_REF Conv.cSasSaKor._.schnellfuellung_gestartet_S6_S3 /end COMPU_METHOD
/begin COMPU_METHOD Conv.cSasSaKor._.fkt_halten_in_sync_verboten_S6_S3 "Umrechnung fuer Messgroesse cSasSaKor::fkt_halten_in_sync_verboten" TAB_VERB "%4.0" "" COMPU_TAB_REF Conv.cSasSaKor._.fkt_halten_in_sync_verboten_S6_S3 /end COMPU_METHOD
/begin COMPU_METHOD Conv.cSasSaKor._.flag_mtschwelle_verbietet_hinsyn_S6_S3 "Umrechnung fuer Messgroesse cSasSaKor::flag_mtschwelle_verbietet_hinsyn" TAB_VERB "%4.0" "" COMPU_TAB_REF Conv.cSasSaKor._.flag_mtschwelle_verbietet_hinsyn_S6_S3 /end COMPU_METHOD
/begin COMPU_METHOD Conv.cSasSaKor._.zwangssynchron_S6_S3 "Umrechnung fuer Messgroesse cSasSaKor::zwangssynchron" TAB_VERB "%4.0" "" COMPU_TAB_REF Conv.cSasSaKor._.zwangssynchron_S6_S3 /end COMPU_METHOD
/begin COMPU_METHOD Conv.cSasSaKor._.synchron_verboten_S6_S3 "Umrechnung fuer Messgroesse cSasSaKor::synchron_verboten" TAB_VERB "%4.0" "" COMPU_TAB_REF Conv.cSasSaKor._.synchron_verboten_S6_S3 /end COMPU_METHOD
/begin COMPU_METHOD Conv.cSasSaKor._.schaltinfo_syn_S6_S3 "Umrechnung fuer Messgroesse cSasSaKor::schaltinfo_syn" TAB_VERB "%4.0" "" COMPU_TAB_REF Conv.cSasSaKor._.schaltinfo_syn_S6_S3 /end COMPU_METHOD
/begin COMPU_METHOD Conv.cSasSaKor._.kup_schutz_massnahme_aktiv_S6_S3 "Umrechnung fuer Messgroesse cSasSaKor::kup_schutz_massnahme_aktiv" TAB_VERB "%4.0" "" COMPU_TAB_REF Conv.cSasSaKor._.kup_schutz_massnahme_aktiv_S6_S3 /end COMPU_METHOD
/begin COMPU_METHOD Conv.cSasZentr._.schaltung_sas_S6_S3 "Umrechnung fuer Messgroesse cSasZentr::schaltung_sas" TAB_VERB "%4.0" "" COMPU_TAB_REF Conv.cSasZentr._.schaltung_sas_S6_S3 /end COMPU_METHOD
/begin COMPU_METHOD Conv.cSasZentr._.schaltart_sas_S6_S3 "Umrechnung fuer Messgroesse cSasZentr::schaltart_sas" TAB_VERB "%4.0" "" COMPU_TAB_REF Conv.cSasZentr._.schaltart_sas_S6_S3 /end COMPU_METHOD
/begin COMPU_METHOD Conv.cSasZentr._.schalttyp_sas_S6_S3 "Umrechnung fuer Messgroesse cSasZentr::schalttyp_sas" TAB_VERB "%4.0" "" COMPU_TAB_REF Conv.cSasZentr._.schalttyp_sas_S6_S3 /end COMPU_METHOD
/begin COMPU_METHOD Conv.cSasZentr._.folgeschaltung_S6_S3 "Umrechnung fuer Messgroesse cSasZentr::folgeschaltung" TAB_VERB "%4.0" "" COMPU_TAB_REF Conv.cSasZentr._.folgeschaltung_S6_S3 /end COMPU_METHOD
/begin COMPU_METHOD Conv.cSasZentr._.schaltung_ueber_kzu_S6_S3 "Umrechnung fuer Messgroesse cSasZentr::schaltung_ueber_kzu" TAB_VERB "%4.0" "" COMPU_TAB_REF Conv.cSasZentr._.schaltung_ueber_kzu_S6_S3 /end COMPU_METHOD
/begin COMPU_METHOD Conv.cSasZentr._.abbruchsart_ist_S6_S3 "Umrechnung fuer Messgroesse cSasZentr::abbruchsart_ist" TAB_VERB "%4.0" "" COMPU_TAB_REF Conv.cSasZentr._.abbruchsart_ist_S6_S3 /end COMPU_METHOD
/begin COMPU_METHOD Conv.cSasZentr._.schrittschaltung_S6_S3 "Umrechnung fuer Messgroesse cSasZentr::schrittschaltung" TAB_VERB "%4.0" "" COMPU_TAB_REF Conv.cSasZentr._.schrittschaltung_S6_S3 /end COMPU_METHOD
/begin COMPU_METHOD Conv.cSasZentr._.flag_ge_rnd_aktiv_S6_S3 "Umrechnung fuer Messgroesse cSasZentr::flag_ge_rnd_aktiv" TAB_VERB "%4.0" "" COMPU_TAB_REF Conv.cSasZentr._.flag_ge_rnd_aktiv_S6_S3 /end COMPU_METHOD
/begin COMPU_METHOD Conv.cSasZentr._.flag_ge_dnr_aktiv_S6_S3 "Umrechnung fuer Messgroesse cSasZentr::flag_ge_dnr_aktiv" TAB_VERB "%4.0" "" COMPU_TAB_REF Conv.cSasZentr._.flag_ge_dnr_aktiv_S6_S3 /end COMPU_METHOD
/begin COMPU_METHOD Conv.cSasZentr._.zug_schub_sas_S6_S3 "Umrechnung fuer Messgroesse cSasZentr::zug_schub_sas" TAB_VERB "%4.0" "" COMPU_TAB_REF Conv.cSasZentr._.zug_schub_sas_S6_S3 /end COMPU_METHOD
/begin COMPU_METHOD Conv.cSasZentr._.sync_istgang_verlassen_me_S6_S3 "Umrechnung fuer Messgroesse cSasZentr::sync_istgang_verlassen_me" TAB_VERB "%4.0" "" COMPU_TAB_REF Conv.cSasZentr._.sync_istgang_verlassen_me_S6_S3 /end COMPU_METHOD
/begin COMPU_METHOD Conv.cSasZentr._.sync_istgang_verlassen_S6_S3 "Umrechnung fuer Messgroesse cSasZentr::sync_istgang_verlassen" TAB_VERB "%4.0" "" COMPU_TAB_REF Conv.cSasZentr._.sync_istgang_verlassen_S6_S3 /end COMPU_METHOD
/begin COMPU_METHOD Conv.cSasZentr._.flag_sync_verlassen_me_S6_S3 "Umrechnung fuer Messgroesse cSasZentr::flag_sync_verlassen_me" TAB_VERB "%4.0" "" COMPU_TAB_REF Conv.cSasZentr._.flag_sync_verlassen_me_S6_S3 /end COMPU_METHOD
/begin COMPU_METHOD Conv.cSasZentr._.f_eco_mode_S6_S3 "Umrechnung fuer Messgroesse cSasZentr::f_eco_mode" TAB_VERB "%4.0" "" COMPU_TAB_REF Conv.cSasZentr._.f_eco_mode_S6_S3 /end COMPU_METHOD
/begin COMPU_METHOD Conv.cSasZentr._.schaltung_anfahren_S6_S3 "Umrechnung fuer Messgroesse cSasZentr::schaltung_anfahren" TAB_VERB "%4.0" "" COMPU_TAB_REF Conv.cSasZentr._.schaltung_anfahren_S6_S3 /end COMPU_METHOD
/begin COMPU_METHOD Conv.cSasZentr._.schaltung_anfahren_idx_S6_S3 "Umrechnung fuer Messgroesse cSasZentr::schaltung_anfahren_idx" TAB_VERB "%4.0" "" COMPU_TAB_REF Conv.cSasZentr._.schaltung_anfahren_idx_S6_S3 /end COMPU_METHOD
/begin COMPU_METHOD Conv.cSasZentr._.schaltung_anfahren_aktiv_S6_S3 "Umrechnung fuer Messgroesse cSasZentr::schaltung_anfahren_aktiv" TAB_VERB "%4.0" "" COMPU_TAB_REF Conv.cSasZentr._.schaltung_anfahren_aktiv_S6_S3 /end COMPU_METHOD
/begin COMPU_METHOD Conv.cSasZentr._.schaltung_anfahren_aktiv_idx_S6_S3 "Umrechnung fuer Messgroesse cSasZentr::schaltung_anfahren_aktiv_idx" TAB_VERB "%4.0" "" COMPU_TAB_REF Conv.cSasZentr._.schaltung_anfahren_aktiv_idx_S6_S3 /end COMPU_METHOD
/begin COMPU_METHOD Conv.cSasZentr._.schaltung_phase_anfahren_S6_S3 "Umrechnung fuer Messgroesse cSasZentr::schaltung_phase_anfahren" TAB_VERB "%4.0" "" COMPU_TAB_REF Conv.cSasZentr._.schaltung_phase_anfahren_S6_S3 /end COMPU_METHOD
/begin COMPU_METHOD Conv.cSasZentr._.istgang_sync_S6_S3 "Umrechnung fuer Messgroesse cSasZentr::istgang_sync" TAB_VERB "%4.0" "" COMPU_TAB_REF Conv.cSasZentr._.istgang_sync_S6_S3 /end COMPU_METHOD
/begin COMPU_METHOD Conv.cSasZentr._.istgang_sync_idx_S6_S3 "Umrechnung fuer Messgroesse cSasZentr::istgang_sync_idx" TAB_VERB "%4.0" "" COMPU_TAB_REF Conv.cSasZentr._.istgang_sync_idx_S6_S3 /end COMPU_METHOD
/begin COMPU_METHOD Conv.cSasZentr._.gangwechsel_S6_S3 "Umrechnung fuer Messgroesse cSasZentr::gangwechsel" TAB_VERB "%4.0" "" COMPU_TAB_REF Conv.cSasZentr._.gangwechsel_S6_S3 /end COMPU_METHOD
/begin COMPU_METHOD Conv.cSasZentr._.sync_ziel_erreicht_S6_S3 "Umrechnung fuer Messgroesse cSasZentr::sync_ziel_erreicht" TAB_VERB "%4.0" "" COMPU_TAB_REF Conv.cSasZentr._.sync_ziel_erreicht_S6_S3 /end COMPU_METHOD
/begin COMPU_METHOD Conv.cSasZentr._.f_entscheidungspkt_versch_erreicht_S6_S3 "Umrechnung fuer Messgroesse cSasZentr::f_entscheidungspkt_versch_erreicht" TAB_VERB "%4.0" "" COMPU_TAB_REF Conv.cSasZentr._.f_entscheidungspkt_versch_erreicht_S6_S3 /end COMPU_METHOD
/begin COMPU_METHOD Conv.cSasZentr._.z_fes_mode_S6_S3 "Umrechnung fuer Messgroesse cSasZentr::z_fes_mode" TAB_VERB "%4.0" "" COMPU_TAB_REF Conv.cSasZentr._.z_fes_mode_S6_S3 /end COMPU_METHOD
/begin COMPU_METHOD Conv.cSasZentr._.schaltung_abgebrochen_S6_S3 "Umrechnung fuer Messgroesse cSasZentr::schaltung_abgebrochen" TAB_VERB "%4.0" "" COMPU_TAB_REF Conv.cSasZentr._.schaltung_abgebrochen_S6_S3 /end COMPU_METHOD
/begin COMPU_METHOD Conv.cSasZentr._.zs_wechsel_verboten_S6_S3 "Umrechnung fuer Messgroesse cSasZentr::zs_wechsel_verboten" TAB_VERB "%4.0" "" COMPU_TAB_REF Conv.cSasZentr._.zs_wechsel_verboten_S6_S3 /end COMPU_METHOD
/begin COMPU_METHOD Conv.cSasZentr._.abbruchsart_soll_S6_S3 "Umrechnung fuer Messgroesse cSasZentr::abbruchsart_soll" TAB_VERB "%4.0" "" COMPU_TAB_REF Conv.cSasZentr._.abbruchsart_soll_S6_S3 /end COMPU_METHOD
/begin COMPU_METHOD Conv.cSasZentr._.f_verschachtelung_verboten_S6_S3 "Umrechnung fuer Messgroesse cSasZentr::f_verschachtelung_verboten" TAB_VERB "%4.0" "" COMPU_TAB_REF Conv.cSasZentr._.f_verschachtelung_verboten_S6_S3 /end COMPU_METHOD
/begin COMPU_METHOD Conv.cSasZentr._.f_schaltung_normal_beendet_S6_S3 "Umrechnung fuer Messgroesse cSasZentr::f_schaltung_normal_beendet" TAB_VERB "%4.0" "" COMPU_TAB_REF Conv.cSasZentr._.f_schaltung_normal_beendet_S6_S3 /end COMPU_METHOD
/begin COMPU_METHOD Conv.cSasZentr._.schaltart_sas_sps_S6_S3 "Umrechnung fuer Messgroesse cSasZentr::schaltart_sas_sps" TAB_VERB "%4.0" "" COMPU_TAB_REF Conv.cSasZentr._.schaltart_sas_sps_S6_S3 /end COMPU_METHOD
/begin COMPU_METHOD Conv.cSasZentr._.schalttyp_S6_S3 "Umrechnung fuer Messgroesse cSasZentr::schalttyp" TAB_VERB "%4.0" "" COMPU_TAB_REF Conv.cSasZentr._.schalttyp_S6_S3 /end COMPU_METHOD
/begin COMPU_METHOD Conv.cSasZentr._.kup_nkraftloesend2_letztes_ga_S6_S3 "Umrechnung fuer Messgroesse cSasZentr::kup_nkraftloesend2_letztes_ga" TAB_VERB "%4.0" "" COMPU_TAB_REF Conv.cSasZentr._.kup_nkraftloesend2_letztes_ga_S6_S3 /end COMPU_METHOD
/begin COMPU_METHOD Conv.cSasZentr._.vorbereitung_im_vordergrund_S6_S3 "Umrechnung fuer Messgroesse cSasZentr::vorbereitung_im_vordergrund" TAB_VERB "%4.0" "" COMPU_TAB_REF Conv.cSasZentr._.vorbereitung_im_vordergrund_S6_S3 /end COMPU_METHOD
/begin COMPU_METHOD Conv.cSasZentr._.abbruchsart_hs_gls_erlaubt_S6_S3 "Umrechnung fuer Messgroesse cSasZentr::abbruchsart_hs_gls_erlaubt" TAB_VERB "%4.0" "" COMPU_TAB_REF Conv.cSasZentr._.abbruchsart_hs_gls_erlaubt_S6_S3 /end COMPU_METHOD
/begin COMPU_METHOD Conv.cSasZentr._.wechsel_normal_kurz_S6_S3 "Umrechnung fuer Messgroesse cSasZentr::wechsel_normal_kurz" TAB_VERB "%4.0" "" COMPU_TAB_REF Conv.cSasZentr._.wechsel_normal_kurz_S6_S3 /end COMPU_METHOD
/begin COMPU_METHOD Conv.cSasZentr._.schaltungsende_durch_ge_ga_S6_S3 "Umrechnung fuer Messgroesse cSasZentr::schaltungsende_durch_ge_ga" TAB_VERB "%4.0" "" COMPU_TAB_REF Conv.cSasZentr._.schaltungsende_durch_ge_ga_S6_S3 /end COMPU_METHOD
/begin COMPU_METHOD Conv.cSasZentr._.event_sf_erkannt_S6_S3 "Umrechnung fuer Messgroesse cSasZentr::event_sf_erkannt" TAB_VERB "%4.0" "" COMPU_TAB_REF Conv.cSasZentr._.event_sf_erkannt_S6_S3 /end COMPU_METHOD
/begin COMPU_METHOD Conv.cSasZentr._.z_sync_ziel_S6_S3 "Umrechnung fuer Messgroesse cSasZentr::z_sync_ziel" TAB_VERB "%4.0" "" COMPU_TAB_REF Conv.cSasZentr._.z_sync_ziel_S6_S3 /end COMPU_METHOD
/begin COMPU_METHOD Conv.cSasZentr._.f_init_phase1_m_motmax_rss_S6_S3 "Umrechnung fuer Messgroesse cSasZentr::f_init_phase1_m_motmax_rss" TAB_VERB "%4.0" "" COMPU_TAB_REF Conv.cSasZentr._.f_init_phase1_m_motmax_rss_S6_S3 /end COMPU_METHOD
/begin COMPU_METHOD Conv.cSasZentr._.igang_dki_m_motmax_rss_S6_S3 "Umrechnung fuer Messgroesse cSasZentr::igang_dki_m_motmax_rss" TAB_VERB "%4.0" "" COMPU_TAB_REF Conv.cSasZentr._.igang_dki_m_motmax_rss_S6_S3 /end COMPU_METHOD
/begin COMPU_METHOD Conv.cSasZentr._.igang_m_motmax_rss_S6_S3 "Umrechnung fuer Messgroesse cSasZentr::igang_m_motmax_rss" TAB_VERB "%4.0" "" COMPU_TAB_REF Conv.cSasZentr._.igang_m_motmax_rss_S6_S3 /end COMPU_METHOD
/begin COMPU_METHOD Conv.cSasZentr._.z_m_motmax_rss_S6_S3 "Umrechnung fuer Messgroesse cSasZentr::z_m_motmax_rss" TAB_VERB "%4.0" "" COMPU_TAB_REF Conv.cSasZentr._.z_m_motmax_rss_S6_S3 /end COMPU_METHOD
/begin COMPU_METHOD Conv.cSasZentr._.zgang_m_motmax_rss_S6_S3 "Umrechnung fuer Messgroesse cSasZentr::zgang_m_motmax_rss" TAB_VERB "%4.0" "" COMPU_TAB_REF Conv.cSasZentr._.zgang_m_motmax_rss_S6_S3 /end COMPU_METHOD
/begin COMPU_METHOD Conv.cSasZentr._.z_m_motmax_sas_S6_S3 "Umrechnung fuer Messgroesse cSasZentr::z_m_motmax_sas" TAB_VERB "%4.0" "" COMPU_TAB_REF Conv.cSasZentr._.z_m_motmax_sas_S6_S3 /end COMPU_METHOD
/begin COMPU_METHOD Conv.cSasZentr._.f_einstiegsbed_erfuellt_S6_S3 "Umrechnung fuer Messgroesse cSasZentr::f_einstiegsbed_erfuellt" TAB_VERB "%4.0" "" COMPU_TAB_REF Conv.cSasZentr._.f_einstiegsbed_erfuellt_S6_S3 /end COMPU_METHOD
/begin COMPU_METHOD Conv.cSasZentr._.z_m_motmax_kupschtz_S6_S3 "Umrechnung fuer Messgroesse cSasZentr::z_m_motmax_kupschtz" TAB_VERB "%4.0" "" COMPU_TAB_REF Conv.cSasZentr._.z_m_motmax_kupschtz_S6_S3 /end COMPU_METHOD
/begin COMPU_METHOD Conv.cSasZentr._.f_red_mmotmax_angefordert_S6_S3 "Umrechnung fuer Messgroesse cSasZentr::f_red_mmotmax_angefordert" TAB_VERB "%4.0" "" COMPU_TAB_REF Conv.cSasZentr._.f_red_mmotmax_angefordert_S6_S3 /end COMPU_METHOD
/begin COMPU_METHOD Conv.cSasZentr._.diag_versch_erlaubt_S6_S3 "Umrechnung fuer Messgroesse cSasZentr::diag_versch_erlaubt" TAB_VERB "%4.0" "" COMPU_TAB_REF Conv.cSasZentr._.diag_versch_erlaubt_S6_S3 /end COMPU_METHOD
/begin COMPU_METHOD Conv.cSasZentr._.z_shlog_anfahren_S6_S3 "Umrechnung fuer Messgroesse cSasZentr::z_shlog_anfahren" TAB_VERB "%4.0" "" COMPU_TAB_REF Conv.cSasZentr._.z_shlog_anfahren_S6_S3 /end COMPU_METHOD
/begin COMPU_METHOD Conv.cSasZentr._.f_z_shlog_anfahren_aktiv_S6_S3 "Umrechnung fuer Messgroesse cSasZentr::f_z_shlog_anfahren_aktiv" TAB_VERB "%4.0" "" COMPU_TAB_REF Conv.cSasZentr._.f_z_shlog_anfahren_aktiv_S6_S3 /end COMPU_METHOD
/begin COMPU_METHOD Conv.cSasZentr._.z_gangwechsel_S6_S3 "Umrechnung fuer Messgroesse cSasZentr::z_gangwechsel" TAB_VERB "%4.0" "" COMPU_TAB_REF Conv.cSasZentr._.z_gangwechsel_S6_S3 /end COMPU_METHOD
/begin COMPU_METHOD Conv.cSasPsystBedarfgerBestrom._.f_i_bedarf_anfordern_S6_S3 "Umrechnung fuer Messgroesse cSasPsystBedarfgerBestrom::f_i_bedarf_anfordern" TAB_VERB "%4.0" "" COMPU_TAB_REF Conv.cSasPsystBedarfgerBestrom._.f_i_bedarf_anfordern_S6_S3 /end COMPU_METHOD
/begin COMPU_METHOD Conv.cSasPsystBedarfgerBestrom._.f_i_bedarf_S6_S3 "Umrechnung fuer Messgroesse cSasPsystBedarfgerBestrom::f_i_bedarf" TAB_VERB "%4.0" "" COMPU_TAB_REF Conv.cSasPsystBedarfgerBestrom._.f_i_bedarf_S6_S3 /end COMPU_METHOD
/begin COMPU_METHOD Conv.cSasPsyst._.f_zeit_max_psys_anst_laeuft_S6_S3 "Umrechnung fuer Messgroesse cSasPsyst::f_zeit_max_psys_anst_laeuft" TAB_VERB "%4.0" "" COMPU_TAB_REF Conv.cSasPsyst._.f_zeit_max_psys_anst_laeuft_S6_S3 /end COMPU_METHOD
/begin COMPU_METHOD Conv.cSasPsyst._.f_psys_kupschutz_anst_laeuft_S6_S3 "Umrechnung fuer Messgroesse cSasPsyst::f_psys_kupschutz_anst_laeuft" TAB_VERB "%4.0" "" COMPU_TAB_REF Conv.cSasPsyst._.f_psys_kupschutz_anst_laeuft_S6_S3 /end COMPU_METHOD
/begin COMPU_METHOD Conv.cSasPsyst._.fkt_druckvorgabe_psys_S6_S3 "Umrechnung fuer Messgroesse cSasPsyst::fkt_druckvorgabe_psys" TAB_VERB "%4.0" "" COMPU_TAB_REF Conv.cSasPsyst._.fkt_druckvorgabe_psys_S6_S3 /end COMPU_METHOD
/begin COMPU_METHOD Conv.cSasPsyst._.fkt_druckvorgabe_psys_alt_S6_S3 "Umrechnung fuer Messgroesse cSasPsyst::fkt_druckvorgabe_psys_alt" TAB_VERB "%4.0" "" COMPU_TAB_REF Conv.cSasPsyst._.fkt_druckvorgabe_psys_alt_S6_S3 /end COMPU_METHOD
/begin COMPU_METHOD Conv.cSasPsyst._.fkt_druckvorgabe_uebfaehig_S6_S3 "Umrechnung fuer Messgroesse cSasPsyst::fkt_druckvorgabe_uebfaehig" TAB_VERB "%4.0" "" COMPU_TAB_REF Conv.cSasPsyst._.fkt_druckvorgabe_uebfaehig_S6_S3 /end COMPU_METHOD
/begin COMPU_METHOD Conv.cSasPsyst._.prio_absolutdruckvorgabe_anz_S6_S3 "Umrechnung fuer Messgroesse cSasPsyst::prio_absolutdruckvorgabe_anz" TAB_VERB "%4.0" "" COMPU_TAB_REF Conv.cSasPsyst._.prio_absolutdruckvorgabe_anz_S6_S3 /end COMPU_METHOD
/begin COMPU_METHOD Conv.cSasPsyst._.f_psys_eff_aktiv_S6_S3 "Umrechnung fuer Messgroesse cSasPsyst::f_psys_eff_aktiv" TAB_VERB "%4.0" "" COMPU_TAB_REF Conv.cSasPsyst._.f_psys_eff_aktiv_S6_S3 /end COMPU_METHOD
/begin COMPU_METHOD Conv.cSasPsyst._.f_auframpen_mg_psysminpuls_gest_S6_S3 "Umrechnung fuer Messgroesse cSasPsyst::f_auframpen_mg_psysminpuls_gest" TAB_VERB "%4.0" "" COMPU_TAB_REF Conv.cSasPsyst._.f_auframpen_mg_psysminpuls_gest_S6_S3 /end COMPU_METHOD
/begin COMPU_METHOD Conv.cSasPsyst._.f_zeit_max_psys_abgelaufen_S6_S3 "Umrechnung fuer Messgroesse cSasPsyst::f_zeit_max_psys_abgelaufen" TAB_VERB "%4.0" "" COMPU_TAB_REF Conv.cSasPsyst._.f_zeit_max_psys_abgelaufen_S6_S3 /end COMPU_METHOD
/begin COMPU_METHOD Conv.cSasPsyst._.f_zeit_max_psys_anst_laeuft_alt_S6_S3 "Umrechnung fuer Messgroesse cSasPsyst::f_zeit_max_psys_anst_laeuft_alt" TAB_VERB "%4.0" "" COMPU_TAB_REF Conv.cSasPsyst._.f_zeit_max_psys_anst_laeuft_alt_S6_S3 /end COMPU_METHOD
/begin COMPU_METHOD Conv.cSasPsyst._.pos_alt_psys_S6_S3 "Umrechnung fuer Messgroesse cSasPsyst::pos_alt_psys" TAB_VERB "%4.0" "" COMPU_TAB_REF Conv.cSasPsyst._.pos_alt_psys_S6_S3 /end COMPU_METHOD
/begin COMPU_METHOD Conv.cSasPsyst._.f_einstiegsbed_p_sysiae_erf_S6_S3 "Umrechnung fuer Messgroesse cSasPsyst::f_einstiegsbed_p_sysiae_erf" TAB_VERB "%4.0" "" COMPU_TAB_REF Conv.cSasPsyst._.f_einstiegsbed_p_sysiae_erf_S6_S3 /end COMPU_METHOD
/begin COMPU_METHOD Conv.cSasPsyst._.z_anst_eff_psys_S6_S3 "Umrechnung fuer Messgroesse cSasPsyst::z_anst_eff_psys" TAB_VERB "%4.0" "" COMPU_TAB_REF Conv.cSasPsyst._.z_anst_eff_psys_S6_S3 /end COMPU_METHOD
/begin COMPU_VTAB Conv.cSasKorGls._.reg_gls_gestartet_S6_S3 "Umrechnung fuer Messgroesse cSasKorGls::reg_gls_gestartet" TAB_VERB 2 0 "FALSE" 1 "TRUE" /end COMPU_VTAB
/begin COMPU_VTAB Conv.cSasKorGls._.gls_mindruck_S6_S3 "Umrechnung fuer Messgroesse cSasKorGls::gls_mindruck" TAB_VERB 2 0 "GLS-Minimaldruck nicht erreicht" 1 "GLS-Minimaldruck erreicht" /end COMPU_VTAB
/begin COMPU_VTAB Conv.cSasKorGls._.z_gls_S6_S3 "Umrechnung fuer Messgroesse cSasKorGls::z_gls" TAB_VERB 12 0 "GLS inaktiv" 1 "Warten GLS Schubhoch" 2 "Warten GLS Zughoch" 3 "Warten GLS Schubrueck" 4 "Warten GLS Zugrueck" 5 "Warten GLS Gangeinlegen" 6 "Verzoegerung GLS" 7 "Verzoegerung GLS Gangeinlegen" 8 "Regelung GLS" 9 "Ende GLS zuschaltende Kupplung" 10 "Ende GLS abschaltende Kupplung" 11 "GLS Passiv (abgeschaltet)" /end COMPU_VTAB
/begin COMPU_VTAB Conv.cSasKorGls._.gls_aktiv_S6_S3 "Umrechnung fuer Messgroesse cSasKorGls::gls_aktiv" TAB_VERB 2 0 "FALSE" 1 "TRUE" /end COMPU_VTAB
/begin COMPU_VTAB Conv.cSasKorGls._.schaltung_gls_S6_S3 "Umrechnung fuer Messgroesse cSasKorGls::schaltung_gls" TAB_VERB 2 0 "FALSE" 1 "TRUE" /end COMPU_VTAB
/begin COMPU_VTAB Conv.cSasKorGls._.wechsel_kzu_kab_S6_S3 "Umrechnung fuer Messgroesse cSasKorGls::wechsel_kzu_kab" TAB_VERB 2 0 "FALSE" 1 "TRUE" /end COMPU_VTAB
/begin COMPU_VTAB Conv.cSasKorGls._.verz_gls_gestartet_S6_S3 "Umrechnung fuer Messgroesse cSasKorGls::verz_gls_gestartet" TAB_VERB 2 0 "FALSE" 1 "TRUE" /end COMPU_VTAB
/begin COMPU_VTAB Conv.cSasBerechnungGls._.flag_umsch_gls_kab_S6_S3 "Umrechnung fuer Messgroesse cSasBerechnungGls::flag_umsch_gls_kab" TAB_VERB 2 0 "FALSE" 1 "TRUE" /end COMPU_VTAB
/begin COMPU_VTAB Conv.cSasBerechnungGls._.flag_umsch_gls_kzu_S6_S3 "Umrechnung fuer Messgroesse cSasBerechnungGls::flag_umsch_gls_kzu" TAB_VERB 2 0 "FALSE" 1 "TRUE" /end COMPU_VTAB
/begin COMPU_VTAB Conv.cSasBerechnungGls._.schub_zug_wechsel_S6_S3 "Umrechnung fuer Messgroesse cSasBerechnungGls::schub_zug_wechsel" TAB_VERB 2 0 "FALSE" 1 "TRUE" /end COMPU_VTAB
/begin COMPU_VTAB Conv.cSasBerechnungGls._.filter_wngtgls_gestartet_S6_S3 "Umrechnung fuer Messgroesse cSasBerechnungGls::filter_wngtgls_gestartet" TAB_VERB 2 0 "FALSE" 1 "TRUE" /end COMPU_VTAB
/begin COMPU_VTAB Conv.cSasBerechnungGls._.schalttyp_gls_S6_S3 "Umrechnung fuer Messgroesse cSasBerechnungGls::schalttyp_gls" TAB_VERB 6 0 "SCHUBHOCH" 1 "ZUGHOCH" 2 "SCHUBRUECK" 3 "ZUGRUECK" 4 "SCHALTTYP_GE_GA" 5 "ZR_ABB_IN_GLS" /end COMPU_VTAB
/begin COMPU_VTAB Conv.cSasBerechnungGls._.wechsel_normal_kurz_S6_S3 "Umrechnung fuer Messgroesse cSasBerechnungGls::wechsel_normal_kurz" TAB_VERB 2 0 "FALSE" 1 "TRUE" /end COMPU_VTAB
/begin COMPU_VTAB Conv.cSasBerechnungGls._.diag_schaltung_ueber_kzu_S6_S3 "Umrechnung fuer Messgroesse cSasBerechnungGls::diag_schaltung_ueber_kzu" TAB_VERB 13 0 "GE_GA" 1 "HS_SCHUBHOCH_KZU" 2 "INIT_NOT_GLS" 3 "AUF_ME_REGLER" 4 "AUF_KAB" 5 "FLAG_UMSCH_GLS_KAB" 6 "FLAG_UMSCH_GLS_KZU" 7 "KEIN_WECHSEL_UNTERHALB_TOLERANZ" 8 "RA3_HSRSGE_KZU_GESTARTET" 9 "UNTERHALB_TOLERANZ_KAB" 10 "OBERHALB_TOLERANZ_KZU" 11 "SAS_ANKAB" 12 "REINIT_GLS_NACH_ESPFKT" /end COMPU_VTAB
/begin COMPU_VTAB Conv.cSasRegelungGls._.zug_schub_gls_S6_S3 "Umrechnung fuer Messgroesse cSasRegelungGls::zug_schub_gls" TAB_VERB 2 0 "SCHUB-Betrieb" 1 "ZUG-Betrieb" /end COMPU_VTAB
/begin COMPU_VTAB Conv.cSasRegelungGls._.z_gls_regler_S6_S3 "Umrechnung fuer Messgroesse cSasRegelungGls::z_gls_regler" TAB_VERB 3 2 "Initialisierung GLS-Regler" 4 "GLS-Regler Regelung" 5 "GLS-Regler Beendet" /end COMPU_VTAB
/begin COMPU_VTAB Conv.cSasAnKzu._.fa_kzu_gestartet_S6_S3 "Umrechnung fuer Messgroesse cSasAnKzu::fa_kzu_gestartet" TAB_VERB 2 0 "FALSE" 1 "TRUE" /end COMPU_VTAB
/begin COMPU_VTAB Conv.cSasAnKzu._.ra1_hsrs_kzu_gestartet_S6_S3 "Umrechnung fuer Messgroesse cSasAnKzu::ra1_hsrs_kzu_gestartet" TAB_VERB 2 0 "FALSE" 1 "TRUE" /end COMPU_VTAB
/begin COMPU_VTAB Conv.cSasAnKzu._.ra2_hsrs_kzu_gestartet_S6_S3 "Umrechnung fuer Messgroesse cSasAnKzu::ra2_hsrs_kzu_gestartet" TAB_VERB 2 0 "FALSE" 1 "TRUE" /end COMPU_VTAB
/begin COMPU_VTAB Conv.cSasAnKzu._.ra3_hsrs_kzu_gestartet_S6_S3 "Umrechnung fuer Messgroesse cSasAnKzu::ra3_hsrs_kzu_gestartet" TAB_VERB 2 0 "FALSE" 1 "TRUE" /end COMPU_VTAB
/begin COMPU_VTAB Conv.cSasAnKzu._.schliessen_kzu_S6_S3 "Umrechnung fuer Messgroesse cSasAnKzu::schliessen_kzu" TAB_VERB 2 0 "FALSE" 1 "TRUE" /end COMPU_VTAB
/begin COMPU_VTAB Conv.cSasAnKzu._.statisch_kzu_S6_S3 "Umrechnung fuer Messgroesse cSasAnKzu::statisch_kzu" TAB_VERB 2 0 "KZU arbeitet" 1 "KZU statisch" /end COMPU_VTAB
/begin COMPU_VTAB Conv.cSasAnKzu._.z_kzu_S6_S3 "Umrechnung fuer Messgroesse cSasAnKzu::z_kzu" TAB_VERB 20 0 "Initialisierungszustand" 1 "Warten" 2 "Schnellfuellung" 3 "Wert 3 wird nicht genutzt" 4 "Fuellausgleich Hochschaltung" 5 "Fuellausgleich Rueckschaltung" 6 "Wert 6 wird nicht genutzt" 7 "Wert 7 wird nicht genutzt" 8 "Wert 8 wird nicht genutzt" 9 "Rampe 1 Hoch- und Rueckschaltung" 10 "Rampe 2 Hoch- und Rueckschaltung" 11 "Rampe auf Haltephase in Synchron" 12 "Haltephase in Synchron" 13 "Rampe 3 Hoch- und Rueckschaltung" 14 "Timeout" 15 "Wert 15 wird nicht genutzt" 16 "Wert 16 wird nicht genutzt" 17 "Wert 17 wird nicht genutzt" 18 "Schliessrampe nach Zeit in synchron bei Rueckschaltung" 19 "Fuellausgleich waehrend Vorbereitung" /end COMPU_VTAB
/begin COMPU_VTAB Conv.cSasAnKzu._.kup_kzu_S6_S3 "Umrechnung fuer Messgroesse cSasAnKzu::kup_kzu" TAB_VERB 6 0 "KEINE" 1 "K_A" 2 "K_B" 3 "K_C" 4 "K_D" 5 "K_E" /end COMPU_VTAB
/begin COMPU_VTAB Conv.cSasAnKzu._.f_rampenzeitberechnung_fertig_S6_S3 "Umrechnung fuer Messgroesse cSasAnKzu::f_rampenzeitberechnung_fertig" TAB_VERB 2 0 "Schliessrampenzeit nicht berechnet" 1 "Schliessrampenzeit berechnet" /end COMPU_VTAB
/begin COMPU_VTAB Conv.cSasAnKzu._.f_hinsyn_kzu_gestartet_S6_S3 "Umrechnung fuer Messgroesse cSasAnKzu::f_hinsyn_kzu_gestartet" TAB_VERB 2 0 "FALSE" 1 "TRUE" /end COMPU_VTAB
/begin COMPU_VTAB Conv.cSasAnKzu._.f_schnellfuellung_war_aktiv_S6_S3 "Umrechnung fuer Messgroesse cSasAnKzu::f_schnellfuellung_war_aktiv" TAB_VERB 2 0 "FALSE" 1 "TRUE" /end COMPU_VTAB
/begin COMPU_VTAB Conv.cSasAnKzu._.schalttyp_kzu_S6_S3 "Umrechnung fuer Messgroesse cSasAnKzu::schalttyp_kzu" TAB_VERB 5 0 "wird nicht verwendet" 1 "Hochschaltung:    ZUGHOCH" 2 "Rueckschaltung:   SCHUBRUECK" 3 "wird nicht verwendet" 4 "Gangein/-auslegen: SCHALTTYP_GE_GA" /end COMPU_VTAB
/begin COMPU_VTAB Conv.cSasAnKzu._.p_fkzu_gueltig_S6_S3 "Umrechnung fuer Messgroesse cSasAnKzu::p_fkzu_gueltig" TAB_VERB 2 0 "Fuelldruckwert nicht gueltig" 1 "Fuelldruckwert gueltig" /end COMPU_VTAB
/begin COMPU_VTAB Conv.cSasAnKzu._.flag_pomekzu_erlaubt_S6_S3 "Umrechnung fuer Messgroesse cSasAnKzu::flag_pomekzu_erlaubt" TAB_VERB 2 0 "ME-abhaengiger Druckoffset nicht erlaubt" 1 "ME-abhaengiger Druckoffset erlaubt" /end COMPU_VTAB
/begin COMPU_VTAB Conv.cSasAnKzu._.f_ngs_abflare_unterschritten_S6_S3 "Umrechnung fuer Messgroesse cSasAnKzu::f_ngs_abflare_unterschritten" TAB_VERB 2 0 "Druckoffset bei Flare nicht gesetzt" 1 "Druckoffset bei Flare gesetzt" /end COMPU_VTAB
/begin COMPU_VTAB Conv.cSasAnKzu._.f_pokzufol_erlaubt_S6_S3 "Umrechnung fuer Messgroesse cSasAnKzu::f_pokzufol_erlaubt" TAB_VERB 2 0 "FALSE" 1 "TRUE" /end COMPU_VTAB
/begin COMPU_VTAB Conv.cSasAnKab._.ende_kab_gestartet_S6_S3 "Umrechnung fuer Messgroesse cSasAnKab::ende_kab_gestartet" TAB_VERB 2 0 "FALSE" 1 "TRUE" /end COMPU_VTAB
/begin COMPU_VTAB Conv.cSasAnKab._.pkf_rs_kab_gestartet_S6_S3 "Umrechnung fuer Messgroesse cSasAnKab::pkf_rs_kab_gestartet" TAB_VERB 2 0 "FALSE" 1 "TRUE" /end COMPU_VTAB
/begin COMPU_VTAB Conv.cSasAnKab._.ps_hs_kab_gestartet_S6_S3 "Umrechnung fuer Messgroesse cSasAnKab::ps_hs_kab_gestartet" TAB_VERB 2 0 "Schaltdruckphase KAB nicht gestartet" 1 "Schaltdruckphase KAB gestartet" /end COMPU_VTAB
/begin COMPU_VTAB Conv.cSasAnKab._.ra1_kab_gestartet_S6_S3 "Umrechnung fuer Messgroesse cSasAnKab::ra1_kab_gestartet" TAB_VERB 2 0 "Rampe 1 KAB nicht gestartet" 1 "Rampe 1 KAB gestartet" /end COMPU_VTAB
/begin COMPU_VTAB Conv.cSasAnKab._.statisch_kab_S6_S3 "Umrechnung fuer Messgroesse cSasAnKab::statisch_kab" TAB_VERB 2 0 "KAB arbeitet" 1 "KAB statisch" /end COMPU_VTAB
/begin COMPU_VTAB Conv.cSasAnKab._.ueb_rs_kab_gestartet_S6_S3 "Umrechnung fuer Messgroesse cSasAnKab::ueb_rs_kab_gestartet" TAB_VERB 2 0 "Ueberschneidung nicht gestartet" 1 "Ueberschneidung KAB gestartet" /end COMPU_VTAB
/begin COMPU_VTAB Conv.cSasAnKab._.kup_kab_S6_S3 "Umrechnung fuer Messgroesse cSasAnKab::kup_kab" TAB_VERB 6 0 "KEINE" 1 "K_A" 2 "K_B" 3 "K_C" 4 "K_D" 5 "K_E" /end COMPU_VTAB
/begin COMPU_VTAB Conv.cSasAnKab._.z_kab_S6_S3 "Umrechnung fuer Messgroesse cSasAnKab::z_kab" TAB_VERB 18 0 "Initialisierungszustand" 1 "Verzoegern der Abschaltenden Kupplung" 2 "Haltephase bei Hochschaltung" 3 "Rampe auf Schaltdruck bei Hochschaltungen" 4 "Schaltdruckphase bei Hochschaltungen" 5 "Wert 5 wird nicht genutzt" 6 "Wert 6 wird nicht genutzt" 7 "Wert 7 wird nicht genutzt" 8 "Wert 8 wird nicht genutzt" 9 "Lastuebernahme GLS bei Hochschaltung" 10 "Haltedruck bei Rueckschaltung" 11 "Rampe auf Schaltdruck bei Rueckschaltung" 12 "Schaltdruckphase bei Rueckschaltung" 13 "Rampe auf Haltephase in Synchron bei Rueckschaltung" 14 "Haltephase in Synchron bei Rueckschaltung" 15 "Ueberschneidungsphase bei Rueckschaltung" 16 "Ende abschaltende Kupplung" 19 "nicht genutzt" /end COMPU_VTAB
/begin COMPU_VTAB Conv.cSasAnKab._.ra_sd_hs_kab_gestartet_S6_S3 "Umrechnung fuer Messgroesse cSasAnKab::ra_sd_hs_kab_gestartet" TAB_VERB 2 0 "FALSE" 1 "TRUE" /end COMPU_VTAB
/begin COMPU_VTAB Conv.cSasAnKab._.ra_sd_rs_kab_gestartet_S6_S3 "Umrechnung fuer Messgroesse cSasAnKab::ra_sd_rs_kab_gestartet" TAB_VERB 2 0 "FALSE" 1 "TRUE" /end COMPU_VTAB
/begin COMPU_VTAB Conv.cSasAnKab._.halten_in_syn_kab_gestartet_S6_S3 "Umrechnung fuer Messgroesse cSasAnKab::halten_in_syn_kab_gestartet" TAB_VERB 2 0 "FALSE" 1 "TRUE" /end COMPU_VTAB
/begin COMPU_VTAB Conv.cSasAnKab._.gls_hs_kab_gestartet_S6_S3 "Umrechnung fuer Messgroesse cSasAnKab::gls_hs_kab_gestartet" TAB_VERB 2 0 "GLS der KAB darf noch nicht gestartet werden" 1 "GLS der KAB kann starten" /end COMPU_VTAB
/begin COMPU_VTAB Conv.cSasAnKab._.pkf_rs_kab_ausgegeben_S6_S3 "Umrechnung fuer Messgroesse cSasAnKab::pkf_rs_kab_ausgegeben" TAB_VERB 2 0 "FALSE" 1 "TRUE" /end COMPU_VTAB
/begin COMPU_VTAB Conv.cSasAnKab._.kab_nicht_befuellt_S6_S3 "Umrechnung fuer Messgroesse cSasAnKab::kab_nicht_befuellt" TAB_VERB 2 0 "KAB ist schon befuellt" 1 "KAB nicht befuellt" /end COMPU_VTAB
/begin COMPU_VTAB Conv.cSasAnKab._.f_ende_verz_kab_erlaubt_S6_S3 "Umrechnung fuer Messgroesse cSasAnKab::f_ende_verz_kab_erlaubt" TAB_VERB 2 0 "FALSE" 1 "TRUE" /end COMPU_VTAB
/begin COMPU_VTAB Conv.cSasAnKab._.f_best_poffkab_in_syn_erfolgt_S6_S3 "Umrechnung fuer Messgroesse cSasAnKab::f_best_poffkab_in_syn_erfolgt" TAB_VERB 2 0 "FALSE" 1 "TRUE" /end COMPU_VTAB
/begin COMPU_VTAB Conv.cSasAnKab._.schalttyp_kab_S6_S3 "Umrechnung fuer Messgroesse cSasAnKab::schalttyp_kab" TAB_VERB 5 0 "RS_ABBR_IN_GLS_KAB" 1 "ZUGHOCH" 2 "SCHUBRUECK" 3 "wird nicht verwendet" 4 "wird nicht verwendet" /end COMPU_VTAB
/begin COMPU_VTAB Conv.cSasSaKor._.synchron_S6_S3 "Umrechnung fuer Messgroesse cSasSaKor::synchron" TAB_VERB 2 0 "Synchronpunkt noch nicht erreicht" 1 "Synchronpunkt erreicht" /end COMPU_VTAB
/begin COMPU_VTAB Conv.cSasSaKor._.zielgang_sas_S6_S3 "Umrechnung fuer Messgroesse cSasSaKor::zielgang_sas" TAB_VERB 10 -1 "GR1" 0 "KEIN_GANG" 1 "G1" 2 "G2" 3 "G3" 4 "G4" 5 "G5" 6 "G6" 7 "G7" 8 "G8" /end COMPU_VTAB
/begin COMPU_VTAB Conv.cSasSaKor._.istgang_sas_S6_S3 "Umrechnung fuer Messgroesse cSasSaKor::istgang_sas" TAB_VERB 10 -1 "GR1" 0 "KEIN_GANG" 1 "G1" 2 "G2" 3 "G3" 4 "G4" 5 "G5" 6 "G6" 7 "G7" 8 "G8" /end COMPU_VTAB
/begin COMPU_VTAB Conv.cSasSaKor._.aktuelle_schaltung_S6_S3 "Umrechnung fuer Messgroesse cSasSaKor::aktuelle_schaltung" TAB_VERB 2 0 "Instanz entspricht Vorbereitende Schaltung" 1 "Instanz entspricht Aktive Schaltung" /end COMPU_VTAB
/begin COMPU_VTAB Conv.cSasSaKor._.timeout_S6_S3 "Umrechnung fuer Messgroesse cSasSaKor::timeout" TAB_VERB 2 0 "kein Timeout" 1 "Timeout erreicht" /end COMPU_VTAB
/begin COMPU_VTAB Conv.cSasSaKor._.schaltinfo_sas_S6_S3 "Umrechnung fuer Messgroesse cSasSaKor::schaltinfo_sas" TAB_VERB 5 0 "Keine Schaltinfo" 1 "Einzelhochschaltung" 2 "Mehrfachhochschaltung" 3 "Einzelrueckschaltung" 4 "Mehrfachrueckschaltung" /end COMPU_VTAB
/begin COMPU_VTAB Conv.cSasSaKor._.schnellfuellung_beendet_S6_S3 "Umrechnung fuer Messgroesse cSasSaKor::schnellfuellung_beendet" TAB_VERB 2 0 "Schnellfuellung nicht beendet" 1 "Schnellfuellung beendet" /end COMPU_VTAB
/begin COMPU_VTAB Conv.cSasSaKor._.z_kurze_schaltung_S6_S3 "Umrechnung fuer Messgroesse cSasSaKor::z_kurze_schaltung" TAB_VERB 8 0 "Initialisierungszustand" 1 "Passiv keine kurzen Parameter vorhanden" 2 "normale Parameter" 3 "nur teilweise SP-Label verwendet" 4 "alle SP-Label verwendet" 5 "nur teilweise SPORT-Label verwendet" 6 "alle SPORT-Label verwendet" 7 "alle SP-Label und teilweise SPORT-Label" /end COMPU_VTAB
/begin COMPU_VTAB Conv.cSasSaKor._.index_spsas_S6_S3 "Umrechnung fuer Messgroesse cSasSaKor::index_spsas" TAB_VERB 3 0 "IND_KURZSAS_NORMAL" 1 "IND_KURZSAS_SP" 2 "IND_KURZSAS_SPORT" /end COMPU_VTAB
/begin COMPU_VTAB Conv.cSasSaKor._.erste_schaltung_S6_S3 "Umrechnung fuer Messgroesse cSasSaKor::erste_schaltung" TAB_VERB 2 0 "Kupplung wurde schon mal befuellt" 1 "Kupplung wurde noch nie befuellt" /end COMPU_VTAB
/begin COMPU_VTAB Conv.cSasSaKor._.f_verb_ada_erste_bef_S6_S3 "Umrechnung fuer Messgroesse cSasSaKor::f_verb_ada_erste_bef" TAB_VERB 2 0 "Adaption erlaubt" 1 "Adaption verboten" /end COMPU_VTAB
/begin COMPU_VTAB Conv.cSasSaKor._.schaltinfo_sas_vor_folge_S6_S3 "Umrechnung fuer Messgroesse cSasSaKor::schaltinfo_sas_vor_folge" TAB_VERB 13 0 "KEINE_SCHALTINFO" 1 "EHS" 2 "MHS" 3 "ERS" 4 "MRS" 5 "MRS84" 6 "MRS64" 7 "Wert 7 wird nicht verwendet" 8 "Wert 8 wird nicht verwendet" 9 "Wert 9 wird nicht verwendet" 10 "Wert 10 wird nicht verwendet" 11 "Wert 11 wird nicht verwendet" 12 "Wert 12 wird nicht verwendet" /end COMPU_VTAB
/begin COMPU_VTAB Conv.cSasSaKor._.schnellfuellung_gestartet_S6_S3 "Umrechnung fuer Messgroesse cSasSaKor::schnellfuellung_gestartet" TAB_VERB 2 0 "Schnellfuellung nicht gestartet" 1 "Schnellfuellung gestartet" /end COMPU_VTAB
/begin COMPU_VTAB Conv.cSasSaKor._.fkt_halten_in_sync_verboten_S6_S3 "Umrechnung fuer Messgroesse cSasSaKor::fkt_halten_in_sync_verboten" TAB_VERB 2 0 "Halten in Synchron nicht verboten" 1 "Halten in Synchron verboten" /end COMPU_VTAB
/begin COMPU_VTAB Conv.cSasSaKor._.flag_mtschwelle_verbietet_hinsyn_S6_S3 "Umrechnung fuer Messgroesse cSasSaKor::flag_mtschwelle_verbietet_hinsyn" TAB_VERB 2 0 "Halten in Synchron nicht verboten" 1 "Halten in Synchron verboten" /end COMPU_VTAB
/begin COMPU_VTAB Conv.cSasSaKor._.zwangssynchron_S6_S3 "Umrechnung fuer Messgroesse cSasSaKor::zwangssynchron" TAB_VERB 2 0 "Kein Zwangssynchron" 1 "Zwangssynchron" /end COMPU_VTAB
/begin COMPU_VTAB Conv.cSasSaKor._.synchron_verboten_S6_S3 "Umrechnung fuer Messgroesse cSasSaKor::synchron_verboten" TAB_VERB 2 0 "Synchron nicht verboten" 1 "Synchron verboten" /end COMPU_VTAB
/begin COMPU_VTAB Conv.cSasSaKor._.schaltinfo_syn_S6_S3 "Umrechnung fuer Messgroesse cSasSaKor::schaltinfo_syn" TAB_VERB 5 0 "KEINE_SCHALTINFO" 1 "EHS" 2 "MHS" 3 "ERS" 4 "MRS" /end COMPU_VTAB
/begin COMPU_VTAB Conv.cSasSaKor._.kup_schutz_massnahme_aktiv_S6_S3 "Umrechnung fuer Messgroesse cSasSaKor::kup_schutz_massnahme_aktiv" TAB_VERB 2 0 "Schutzfunktion inaktiv" 1 "Schutzfunktion aktiv" /end COMPU_VTAB
/begin COMPU_VTAB Conv.cSasZentr._.schaltung_sas_S6_S3 "Umrechnung fuer Messgroesse cSasZentr::schaltung_sas" TAB_VERB 2 0 "Schaltung inaktiv" 1 "Schaltung aktiv" /end COMPU_VTAB
/begin COMPU_VTAB Conv.cSasZentr._.schaltart_sas_S6_S3 "Umrechnung fuer Messgroesse cSasZentr::schaltart_sas" TAB_VERB 6 0 "KEINE_SCHALTUNG" 1 "HS" 2 "RS" 3 "SCHALTART_GE" 4 "SCHALTART_GA" 5 "nicht verwendet" /end COMPU_VTAB
/begin COMPU_VTAB Conv.cSasZentr._.schalttyp_sas_S6_S3 "Umrechnung fuer Messgroesse cSasZentr::schalttyp_sas" TAB_VERB 5 0 "SCHUBHOCH" 1 "ZUGHOCH" 2 "SCHUBRUECK" 3 "ZUGRUECK" 4 "SCHALTTYP_GE_GA" /end COMPU_VTAB
/begin COMPU_VTAB Conv.cSasZentr._.folgeschaltung_S6_S3 "Umrechnung fuer Messgroesse cSasZentr::folgeschaltung" TAB_VERB 2 0 "keine Folgeschaltung" 1 "Folgeschaltung" /end COMPU_VTAB
/begin COMPU_VTAB Conv.cSasZentr._.schaltung_ueber_kzu_S6_S3 "Umrechnung fuer Messgroesse cSasZentr::schaltung_ueber_kzu" TAB_VERB 2 0 "Schaltung nicht ueber KZU" 1 "Schaltung ueber KZU" /end COMPU_VTAB
/begin COMPU_VTAB Conv.cSasZentr._.abbruchsart_ist_S6_S3 "Umrechnung fuer Messgroesse cSasZentr::abbruchsart_ist" TAB_VERB 6 0 "Kein Abbruch" 10 "Abbruch HS in synchron Istgang" 20 "Abbruch HS in GLS" 30 "Abbruch RS" 40 "Abbruch HYD" 50 "Abbruch RS direkt" /end COMPU_VTAB
/begin COMPU_VTAB Conv.cSasZentr._.schrittschaltung_S6_S3 "Umrechnung fuer Messgroesse cSasZentr::schrittschaltung" TAB_VERB 2 0 "Keine Schrittschaltung" 1 "Schrittschaltung" /end COMPU_VTAB
/begin COMPU_VTAB Conv.cSasZentr._.flag_ge_rnd_aktiv_S6_S3 "Umrechnung fuer Messgroesse cSasZentr::flag_ge_rnd_aktiv" TAB_VERB 2 0 "Positionswechsel R-N-D nicht aktiv" 1 "Positionswechsel R-N-D aktiv" /end COMPU_VTAB
/begin COMPU_VTAB Conv.cSasZentr._.flag_ge_dnr_aktiv_S6_S3 "Umrechnung fuer Messgroesse cSasZentr::flag_ge_dnr_aktiv" TAB_VERB 2 0 "Positionswechsel D-N-R nicht aktiv" 1 "Positionswechsel D-N-R aktiv" /end COMPU_VTAB
/begin COMPU_VTAB Conv.cSasZentr._.zug_schub_sas_S6_S3 "Umrechnung fuer Messgroesse cSasZentr::zug_schub_sas" TAB_VERB 2 0 "Schubschaltung" 1 "Zugschaltung" /end COMPU_VTAB
/begin COMPU_VTAB Conv.cSasZentr._.sync_istgang_verlassen_me_S6_S3 "Umrechnung fuer Messgroesse cSasZentr::sync_istgang_verlassen_me" TAB_VERB 2 0 "noch nicht verlassen" 1 "synchron istgang verlassen" /end COMPU_VTAB
/begin COMPU_VTAB Conv.cSasZentr._.sync_istgang_verlassen_S6_S3 "Umrechnung fuer Messgroesse cSasZentr::sync_istgang_verlassen" TAB_VERB 2 0 "noch nicht verlassen" 1 "synchron istgang verlassen" /end COMPU_VTAB
/begin COMPU_VTAB Conv.cSasZentr._.flag_sync_verlassen_me_S6_S3 "Umrechnung fuer Messgroesse cSasZentr::flag_sync_verlassen_me" TAB_VERB 2 0 "sync istgang oder sync zielgang" 1 "kein synchron" /end COMPU_VTAB
/begin COMPU_VTAB Conv.cSasZentr._.f_eco_mode_S6_S3 "Umrechnung fuer Messgroesse cSasZentr::f_eco_mode" TAB_VERB 2 0 "ECO Mode inaktiv" 1 "ECO Mode aktiv" /end COMPU_VTAB
/begin COMPU_VTAB Conv.cSasZentr._.schaltung_anfahren_S6_S3 "Umrechnung fuer Messgroesse cSasZentr::schaltung_anfahren" TAB_VERB 5 -2 "Mehrfachrueckschaltung" -1 "Rueckchaltung" 0 "keine Schaltung" 1 "Hochschaltung" 2 "Mehrfachochschaltung" /end COMPU_VTAB
/begin COMPU_VTAB Conv.cSasZentr._.schaltung_anfahren_idx_S6_S3 "Umrechnung fuer Messgroesse cSasZentr::schaltung_anfahren_idx" TAB_VERB 5 0 "Mehrfachrueckschaltung" 1 "Rueckchaltung" 2 "keine Schaltung" 3 "Hochschaltung" 4 "Mehrfachochschaltung" /end COMPU_VTAB
/begin COMPU_VTAB Conv.cSasZentr._.schaltung_anfahren_aktiv_S6_S3 "Umrechnung fuer Messgroesse cSasZentr::schaltung_anfahren_aktiv" TAB_VERB 5 -2 "Mehrfachrueckschaltung" -1 "Rueckchaltung" 0 "keine Schaltung" 1 "Hochschaltung" 2 "Mehrfachochschaltung" /end COMPU_VTAB
/begin COMPU_VTAB Conv.cSasZentr._.schaltung_anfahren_aktiv_idx_S6_S3 "Umrechnung fuer Messgroesse cSasZentr::schaltung_anfahren_aktiv_idx" TAB_VERB 5 0 "Mehrfachrueckschaltung" 1 "Rueckchaltung" 2 "keine Schaltung" 3 "Hochschaltung" 4 "Mehrfachochschaltung" /end COMPU_VTAB
/begin COMPU_VTAB Conv.cSasZentr._.schaltung_phase_anfahren_S6_S3 "Umrechnung fuer Messgroesse cSasZentr::schaltung_phase_anfahren" TAB_VERB 5 0 "PASSIV" 1 "SCHALTBEFEHL" 2 "SCHALTUNG" 3 "VERSCHACHTELTE_SCHALTUNG" 4 "ENDE_SCHALTUNG" /end COMPU_VTAB
/begin COMPU_VTAB Conv.cSasZentr._.istgang_sync_S6_S3 "Umrechnung fuer Messgroesse cSasZentr::istgang_sync" TAB_VERB 10 -1 "GR1" 0 "KEIN_GANG" 1 "G1" 2 "G2" 3 "G3" 4 "G4" 5 "G5" 6 "G6" 7 "G7" 8 "G8" /end COMPU_VTAB
/begin COMPU_VTAB Conv.cSasZentr._.istgang_sync_idx_S6_S3 "Umrechnung fuer Messgroesse cSasZentr::istgang_sync_idx" TAB_VERB 10 0 "GR1" 1 "KEIN_GANG" 2 "G1" 3 "G2" 4 "G3" 5 "G4" 6 "G5" 7 "G6" 8 "G7" 9 "G8" /end COMPU_VTAB
/begin COMPU_VTAB Conv.cSasZentr._.gangwechsel_S6_S3 "Umrechnung fuer Messgroesse cSasZentr::gangwechsel" TAB_VERB 2 0 "kein Gangwechsel" 1 "Gangwechsel aktiv" /end COMPU_VTAB
/begin COMPU_VTAB Conv.cSasZentr._.sync_ziel_erreicht_S6_S3 "Umrechnung fuer Messgroesse cSasZentr::sync_ziel_erreicht" TAB_VERB 2 0 "Synchronpunkt noch nicht erreicht" 1 "Synchronpunkt erreicht" /end COMPU_VTAB
/begin COMPU_VTAB Conv.cSasZentr._.f_entscheidungspkt_versch_erreicht_S6_S3 "Umrechnung fuer Messgroesse cSasZentr::f_entscheidungspkt_versch_erreicht" TAB_VERB 2 0 "FALSE" 1 "TRUE" /end COMPU_VTAB
/begin COMPU_VTAB Conv.cSasZentr._.z_fes_mode_S6_S3 "Umrechnung fuer Messgroesse cSasZentr::z_fes_mode" TAB_VERB 5 0 "Normal Modus aktiv" 1 "ECO Modus aktiv" 2 "Sport Modus aktiv" 3 "SportPlus Modus aktiv" 4 "ComfortPlus Modus aktiv" /end COMPU_VTAB
/begin COMPU_VTAB Conv.cSasZentr._.schaltung_abgebrochen_S6_S3 "Umrechnung fuer Messgroesse cSasZentr::schaltung_abgebrochen" TAB_VERB 2 0 "kein Abbruch" 1 "laufende Schaltung ist Abbruch der vorhergehenden" /end COMPU_VTAB
/begin COMPU_VTAB Conv.cSasZentr._.zs_wechsel_verboten_S6_S3 "Umrechnung fuer Messgroesse cSasZentr::zs_wechsel_verboten" TAB_VERB 2 0 "ZS Wechsel nicht verboten" 1 "ZS Wechsel verboten" /end COMPU_VTAB
/begin COMPU_VTAB Conv.cSasZentr._.abbruchsart_soll_S6_S3 "Umrechnung fuer Messgroesse cSasZentr::abbruchsart_soll" TAB_VERB 6 0 "Kein Abbruch" 10 "Abbruch HS in synchron Istgang" 20 "Abbruch HS in GLS" 30 "Abbruch RS" 40 "Abbruch HYD" 50 "Abbruch RS direkt" /end COMPU_VTAB
/begin COMPU_VTAB Conv.cSasZentr._.f_verschachtelung_verboten_S6_S3 "Umrechnung fuer Messgroesse cSasZentr::f_verschachtelung_verboten" TAB_VERB 2 0 "Verschachtelung ist nicht verboten" 1 "Verschachtelung wurde verboten" /end COMPU_VTAB
/begin COMPU_VTAB Conv.cSasZentr._.f_schaltung_normal_beendet_S6_S3 "Umrechnung fuer Messgroesse cSasZentr::f_schaltung_normal_beendet" TAB_VERB 2 0 "Schaltung wurde noch nicht oder über einen Abbruch beendet" 1 "Schaltungsende erfolgte über die normale Schaltungsende-Bedingungen" /end COMPU_VTAB
/begin COMPU_VTAB Conv.cSasZentr._.schaltart_sas_sps_S6_S3 "Umrechnung fuer Messgroesse cSasZentr::schaltart_sas_sps" TAB_VERB 4 0 "HS" 1 "RS" 2 "HS SP" 3 "RS SP" /end COMPU_VTAB
/begin COMPU_VTAB Conv.cSasZentr._.schalttyp_S6_S3 "Umrechnung fuer Messgroesse cSasZentr::schalttyp" TAB_VERB 5 0 "SCHUBHOCH" 1 "ZUGHOCH" 2 "SCHUBRUECK" 3 "ZUGRUECK" 4 "SCHALTTYP_GE_GA" /end COMPU_VTAB
/begin COMPU_VTAB Conv.cSasZentr._.kup_nkraftloesend2_letztes_ga_S6_S3 "Umrechnung fuer Messgroesse cSasZentr::kup_nkraftloesend2_letztes_ga" TAB_VERB 6 0 "KEINE" 1 "K_A" 2 "K_B" 3 "K_C" 4 "K_D" 5 "K_E" /end COMPU_VTAB
/begin COMPU_VTAB Conv.cSasZentr._.vorbereitung_im_vordergrund_S6_S3 "Umrechnung fuer Messgroesse cSasZentr::vorbereitung_im_vordergrund" TAB_VERB 2 0 "Vorbereitung nicht auf Kupplung" 1 "Vorbereitender Ablauf hat Kupplung uebernommen" /end COMPU_VTAB
/begin COMPU_VTAB Conv.cSasZentr._.abbruchsart_hs_gls_erlaubt_S6_S3 "Umrechnung fuer Messgroesse cSasZentr::abbruchsart_hs_gls_erlaubt" TAB_VERB 2 0 "FALSE" 1 "TRUE" /end COMPU_VTAB
/begin COMPU_VTAB Conv.cSasZentr._.wechsel_normal_kurz_S6_S3 "Umrechnung fuer Messgroesse cSasZentr::wechsel_normal_kurz" TAB_VERB 2 0 "Kein Wechsel von Normalen auf Spontane Schaltungen" 1 "Wechsel von Normalen auf Spontane Schaltungen hat stattgefunden" /end COMPU_VTAB
/begin COMPU_VTAB Conv.cSasZentr._.schaltungsende_durch_ge_ga_S6_S3 "Umrechnung fuer Messgroesse cSasZentr::schaltungsende_durch_ge_ga" TAB_VERB 2 0 "Kein Beenden der Schaltung durch GE/GA" 1 "GE/GA hat die laufende Schaltung beendet" /end COMPU_VTAB
/begin COMPU_VTAB Conv.cSasZentr._.event_sf_erkannt_S6_S3 "Umrechnung fuer Messgroesse cSasZentr::event_sf_erkannt" TAB_VERB 2 0 "FALSE" 1 "TRUE" /end COMPU_VTAB
/begin COMPU_VTAB Conv.cSasZentr._.z_sync_ziel_S6_S3 "Umrechnung fuer Messgroesse cSasZentr::z_sync_ziel" TAB_VERB 3 1 "Synchronpunkt noch nicht erreicht" 2 "Haltephase mit mindestzeit" 3 "Synchronpunkt ist erreicht" /end COMPU_VTAB
/begin COMPU_VTAB Conv.cSasZentr._.f_init_phase1_m_motmax_rss_S6_S3 "Umrechnung fuer Messgroesse cSasZentr::f_init_phase1_m_motmax_rss" TAB_VERB 2 0 "FALSE" 1 "TRUE" /end COMPU_VTAB
/begin COMPU_VTAB Conv.cSasZentr._.igang_dki_m_motmax_rss_S6_S3 "Umrechnung fuer Messgroesse cSasZentr::igang_dki_m_motmax_rss" TAB_VERB 10 -1 "GR1" 0 "KEIN_GANG" 1 "G1" 2 "G2" 3 "G3" 4 "G4" 5 "G5" 6 "G6" 7 "G7" 8 "G8" /end COMPU_VTAB
/begin COMPU_VTAB Conv.cSasZentr._.igang_m_motmax_rss_S6_S3 "Umrechnung fuer Messgroesse cSasZentr::igang_m_motmax_rss" TAB_VERB 10 -1 "GR1" 0 "KEIN_GANG" 1 "G1" 2 "G2" 3 "G3" 4 "G4" 5 "G5" 6 "G6" 7 "G7" 8 "G8" /end COMPU_VTAB
/begin COMPU_VTAB Conv.cSasZentr._.z_m_motmax_rss_S6_S3 "Umrechnung fuer Messgroesse cSasZentr::z_m_motmax_rss" TAB_VERB 8 0 "Warten StepIn - weitere Rueckfilterung" 1 "Warten StepIn" 2 "Vorgabe Phase1 m_motmax_rss aktiv" 3 "Vorgabe Rampe m_motmax_rss aktiv" 4 "Vorgabe Phase2 m_motmax_rss aktiv" 5 "Rückführungsrampe - kein Wiedereinstig erlaubt" 6 "Rückführungsrampe - Wiedereinstig erlaubt" 7 "Keine Ausgabe von m_motmax_rss" /end COMPU_VTAB
/begin COMPU_VTAB Conv.cSasZentr._.zgang_m_motmax_rss_S6_S3 "Umrechnung fuer Messgroesse cSasZentr::zgang_m_motmax_rss" TAB_VERB 10 -1 "GR1" 0 "KEIN_GANG" 1 "G1" 2 "G2" 3 "G3" 4 "G4" 5 "G5" 6 "G6" 7 "G7" 8 "G8" /end COMPU_VTAB
/begin COMPU_VTAB Conv.cSasZentr._.z_m_motmax_sas_S6_S3 "Umrechnung fuer Messgroesse cSasZentr::z_m_motmax_sas" TAB_VERB 4 0 "Initialisierungszustand" 1 "Vorgabe m_motmax_sas aktiv" 2 "Ausführen Rückführungsrampe auf m_mot" 3 "Keine Ausgabe von m_motmax_sas" /end COMPU_VTAB
/begin COMPU_VTAB Conv.cSasZentr._.f_einstiegsbed_erfuellt_S6_S3 "Umrechnung fuer Messgroesse cSasZentr::f_einstiegsbed_erfuellt" TAB_VERB 2 0 "Einstiegsbed. noch nicht erfüllt" 1 "Einstiegsbed. erfüllt" /end COMPU_VTAB
/begin COMPU_VTAB Conv.cSasZentr._.z_m_motmax_kupschtz_S6_S3 "Umrechnung fuer Messgroesse cSasZentr::z_m_motmax_kupschtz" TAB_VERB 5 0 "Nullzustand" 1 "Ausführen Rampe auf m_motmax_kupschtz" 2 "Vorgabe m_motmax_kupschtz aktiv" 3 "Ausführen Rückführungsrampe auf m_mot" 4 "Keine Ausgabe von m_motmax_kupschtz" /end COMPU_VTAB
/begin COMPU_VTAB Conv.cSasZentr._.f_red_mmotmax_angefordert_S6_S3 "Umrechnung fuer Messgroesse cSasZentr::f_red_mmotmax_angefordert" TAB_VERB 2 0 "Einstiegsbed. noch nicht erfüllt" 1 "Einstiegsbed. erfüllt" /end COMPU_VTAB
/begin COMPU_VTAB Conv.cSasZentr._.diag_versch_erlaubt_S6_S3 "Umrechnung fuer Messgroesse cSasZentr::diag_versch_erlaubt" TAB_VERB 13 0 "Verschachtelung erlaubt" 1 "Verbot Versch durch c_getr" 2 "Verbot Versch durch Lastwechsel ->SWI_VERS_ZYKL" 3 "Verbot Versch durch NT-Drehzahl" 4 "Verbot Versch durch m_t" 5 "Verbot Versch durch Motoreingriff SAS" 6 "Verbot Versch durch HINSYN" 7 "Verbot Versch durch Schleppstartanford. aktiv" 8 "Verbot Versch durch Schleppstartverhind." 9 "Verbot Versch durch IAE" 10 "Verbot Versch durch Kupplungsschutzfkt." 11 "Verbot Versch durch Segelfuntkion" 12 "Verbot Versch durch GLS-TRIMM-Funktion" /end COMPU_VTAB
/begin COMPU_VTAB Conv.cSasZentr._.z_shlog_anfahren_S6_S3 "Umrechnung fuer Messgroesse cSasZentr::z_shlog_anfahren" TAB_VERB 5 0 "Keine Schaltung" 1 "Schaltbefehl" 2 "Schaltung Anfahren" 3 "Verschachtelte Schaltung" 4 "Ende Schaltung" /end COMPU_VTAB
/begin COMPU_VTAB Conv.cSasZentr._.f_z_shlog_anfahren_aktiv_S6_S3 "Umrechnung fuer Messgroesse cSasZentr::f_z_shlog_anfahren_aktiv" TAB_VERB 2 0 "Zustand wurde noch nicht durchlaufen" 1 "Zustand wurde durchlaufen" /end COMPU_VTAB
/begin COMPU_VTAB Conv.cSasZentr._.z_gangwechsel_S6_S3 "Umrechnung fuer Messgroesse cSasZentr::z_gangwechsel" TAB_VERB 5 0 "Inaktiv" 1 "Aktiv" 2 "Ende" 3 "Mindestzeit" 4 "Gangeinlegen" /end COMPU_VTAB
/begin COMPU_VTAB Conv.cSasPsystBedarfgerBestrom._.f_i_bedarf_anfordern_S6_S3 "Umrechnung fuer Messgroesse cSasPsystBedarfgerBestrom::f_i_bedarf_anfordern" TAB_VERB 2 0 "FALSE" 1 "TRUE" /end COMPU_VTAB
/begin COMPU_VTAB Conv.cSasPsystBedarfgerBestrom._.f_i_bedarf_S6_S3 "Umrechnung fuer Messgroesse cSasPsystBedarfgerBestrom::f_i_bedarf" TAB_VERB 2 0 "FALSE" 1 "TRUE" /end COMPU_VTAB
/begin COMPU_VTAB Conv.cSasPsyst._.f_zeit_max_psys_anst_laeuft_S6_S3 "Umrechnung fuer Messgroesse cSasPsyst::f_zeit_max_psys_anst_laeuft" TAB_VERB 2 0 "keine MAX-Ansteuerung Systemdruck" 1 "MAX-Ansteuerung Systemdruck aktiv" /end COMPU_VTAB
/begin COMPU_VTAB Conv.cSasPsyst._.f_psys_kupschutz_anst_laeuft_S6_S3 "Umrechnung fuer Messgroesse cSasPsyst::f_psys_kupschutz_anst_laeuft" TAB_VERB 2 0 "keine Systemdruckanhebung" 1 "Systemdruckanhebung durch erhoehte Kupplungstemperatur" /end COMPU_VTAB
/begin COMPU_VTAB Conv.cSasPsyst._.fkt_druckvorgabe_psys_S6_S3 "Umrechnung fuer Messgroesse cSasPsyst::fkt_druckvorgabe_psys" TAB_VERB 72 0 "Kein Systemdruck vorhanden" 1 "Maximaler Systemdruck anfgefordert" 2 "Pulsadaption" 3 "Schlupfadaption" 4 "CSC" 5 "LCC" 6 "HIS" 7 "HOK" 8 "K0" 9 "opt/red Bef. K0" 10 "Kupplungsschutzfkt" 11 "IEP" 63 "Getriebeschmierung während IEP-Betrieb" 12 "Übertemp. Kühlerzul." 13 "IAE" 14 "Segelfunktion" 15 "POSV Ueberwachung" 16 "Gangeinlegen" 17 "HS/RS" 18 "Notganginfo48" 19 "Parksperre auslegen" 20 "nach Motorstart" 21 "durch GEA Modell" 22 "aktive Klauenschaltung" 23 "Gangnachf. mit Klaue" 24 "Gangabhängig" 25 "bei KFL Neutral" 26 "nach MaxPHaupt MSA" 27 "K0 Gangabhängig" 28 "Wandlertemperatur" 29 "Coding" 30 "Effizienzsystemdruck Gangabhängig" 31 "Effizienzsystemdruck HS/RS" 32 "Effizienzsystemdruck Gangeinlegen" 33 "WK-Fusspunktadaption" 34 "N-Stern Ansteuerung" 35 "Parksperrenventilüberwachung" 36 "Wählschieberüberwachung" 37 "Klauensynchronisierung F" 38 "KlaueA keine Endl GE R" 39 "Plausi A" 40 "KlaueA GNF" 41 "Abbremsen Reibelement" 42 "N-Stern Plausibilisierung" 43 "MAYWHA" 44 "Parksperre einlegen" 45 "GetrTemp" 46 "Transportmode" 47 "MSA-Motorstop" 48 "Klauensensorinit" 49 "Stada" 50 "BCD-Standart GE Synchronisierung" 51 "BCD-Standart GE Klaue einlegen" 52 "Absolutdruck BCD-Ablauf waehrend Eskalation" 53 "BCD-Ablauf waehrend Eskalation" 54 "BCD-Ablauf waehrend Abbremsen 1" 55 "BCD-Ablauf waehrend Abbremsen 2" 56 "BCD-Ablauf waehrend Abbremsen 3" 57 "BCD RND Direct Ablauf - SF-Phase" 58 "BCD RND Direct Ablauf" 59 "EoL-Adaption" 60 "SEGELN_PHASE1" 61 "SEGELN_PHASE2" 62 "SEGELN_PHASE3" 64 "D1R_DIRECT_PHASE1" 65 "D1R_DIRECT_PHASE2" 66 "D1R_DIRECT_PHASE3" 67 "D1R_DIRECT_ESCAL1" 68 "D1R_DIRECT_ESCAL2" 69 "D1R_DIRECT_ASP" 70 "D1R_DIRECT_MAX" 255 "Noch keine Funktion definiert" /end COMPU_VTAB
/begin COMPU_VTAB Conv.cSasPsyst._.fkt_druckvorgabe_psys_alt_S6_S3 "Umrechnung fuer Messgroesse cSasPsyst::fkt_druckvorgabe_psys_alt" TAB_VERB 72 0 "Kein Systemdruck vorhanden" 1 "Maximaler Systemdruck anfgefordert" 2 "Pulsadaption" 3 "Schlupfadaption" 4 "CSC" 5 "LCC" 6 "HIS" 7 "HOK" 8 "K0" 9 "opt/red Bef. K0" 10 "Kupplungsschutzfkt" 11 "IEP" 63 "Getriebeschmierung während IEP-Betrieb" 12 "Übertemp. Kühlerzul." 13 "IAE" 14 "Segelfunktion" 15 "POSV Ueberwachung" 16 "Gangeinlegen" 17 "HS/RS" 18 "Notganginfo48" 19 "Parksperre auslegen" 20 "nach Motorstart" 21 "durch GEA Modell" 22 "aktive Klauenschaltung" 23 "Gangnachf. mit Klaue" 24 "Gangabhängig" 25 "bei KFL Neutral" 26 "nach MaxPHaupt MSA" 27 "K0 Gangabhängig" 28 "Wandlertemperatur" 29 "Coding" 30 "Effizienzsystemdruck Gangabhängig" 31 "Effizienzsystemdruck HS/RS" 32 "Effizienzsystemdruck Gangeinlegen" 33 "WK-Fusspunktadaption" 34 "N-Stern Ansteuerung" 35 "Parksperrenventilüberwachung" 36 "Wählschieberüberwachung" 37 "Klauensynchronisierung F" 38 "KlaueA keine Endl GE R" 39 "Plausi A" 40 "KlaueA GNF" 41 "Abbremsen Reibelement" 42 "N-Stern Plausibilisierung" 43 "MAYWHA" 44 "Parksperre einlegen" 45 "GetrTemp" 46 "Transportmode" 47 "MSA-Motorstop" 48 "Klauensensorinit" 49 "Stada" 50 "BCD-Standart GE Synchronisierung" 51 "BCD-Standart GE Klaue einlegen" 52 "Absolutdruck BCD-Ablauf waehrend Eskalation" 53 "BCD-Ablauf waehrend Eskalation" 54 "BCD-Ablauf waehrend Abbremsen 1" 55 "BCD-Ablauf waehrend Abbremsen 2" 56 "BCD-Ablauf waehrend Abbremsen 3" 57 "BCD RND Direct Ablauf - SF-Phase" 58 "BCD RND Direct Ablauf" 59 "EoL-Adaption" 60 "SEGELN_PHASE1" 61 "SEGELN_PHASE2" 62 "SEGELN_PHASE3" 64 "D1R_DIRECT_PHASE1" 65 "D1R_DIRECT_PHASE2" 66 "D1R_DIRECT_PHASE3" 67 "D1R_DIRECT_ESCAL1" 68 "D1R_DIRECT_ESCAL2" 69 "D1R_DIRECT_ASP" 70 "D1R_DIRECT_MAX" 255 "Noch keine Funktion definiert" /end COMPU_VTAB
/begin COMPU_VTAB Conv.cSasPsyst._.fkt_druckvorgabe_uebfaehig_S6_S3 "Umrechnung fuer Messgroesse cSasPsyst::fkt_druckvorgabe_uebfaehig" TAB_VERB 72 0 "Kein Systemdruck vorhanden" 1 "Maximaler Systemdruck anfgefordert" 2 "Pulsadaption" 3 "Schlupfadaption" 4 "CSC" 5 "LCC" 6 "HIS" 7 "HOK" 8 "K0" 9 "opt/red Bef. K0" 10 "Kupplungsschutzfkt" 11 "IEP" 63 "Getriebeschmierung während IEP-Betrieb" 12 "Übertemp. Kühlerzul." 13 "IAE" 14 "Segelfunktion" 15 "POSV Ueberwachung" 16 "Gangeinlegen" 17 "HS/RS" 18 "Notganginfo48" 19 "Parksperre auslegen" 20 "nach Motorstart" 21 "durch GEA Modell" 22 "aktive Klauenschaltung" 23 "Gangnachf. mit Klaue" 24 "Gangabhängig" 25 "bei KFL Neutral" 26 "nach MaxPHaupt MSA" 27 "K0 Gangabhängig" 28 "Wandlertemperatur" 29 "Coding" 30 "Effizienzsystemdruck Gangabhängig" 31 "Effizienzsystemdruck HS/RS" 32 "Effizienzsystemdruck Gangeinlegen" 33 "WK-Fusspunktadaption" 34 "N-Stern Ansteuerung" 35 "Parksperrenventilüberwachung" 36 "Wählschieberüberwachung" 37 "Klauensynchronisierung F" 38 "KlaueA keine Endl GE R" 39 "Plausi A" 40 "KlaueA GNF" 41 "Abbremsen Reibelement" 42 "N-Stern Plausibilisierung" 43 "MAYWHA" 44 "Parksperre einlegen" 45 "GetrTemp" 46 "Transportmode" 47 "MSA-Motorstop" 48 "Klauensensorinit" 49 "Stada" 50 "BCD-Standart GE Synchronisierung" 51 "BCD-Standart GE Klaue einlegen" 52 "Absolutdruck BCD-Ablauf waehrend Eskalation" 53 "BCD-Ablauf waehrend Eskalation" 54 "BCD-Ablauf waehrend Abbremsen 1" 55 "BCD-Ablauf waehrend Abbremsen 2" 56 "BCD-Ablauf waehrend Abbremsen 3" 57 "BCD RND Direct Ablauf - SF-Phase" 58 "BCD RND Direct Ablauf" 59 "EoL-Adaption" 60 "SEGELN_PHASE1" 61 "SEGELN_PHASE2" 62 "SEGELN_PHASE3" 64 "D1R_DIRECT_PHASE1" 65 "D1R_DIRECT_PHASE2" 66 "D1R_DIRECT_PHASE3" 67 "D1R_DIRECT_ESCAL1" 68 "D1R_DIRECT_ESCAL2" 69 "D1R_DIRECT_ASP" 70 "D1R_DIRECT_MAX" 255 "Noch keine Funktion definiert" /end COMPU_VTAB
/begin COMPU_VTAB Conv.cSasPsyst._.prio_absolutdruckvorgabe_anz_S6_S3 "Umrechnung fuer Messgroesse cSasPsyst::prio_absolutdruckvorgabe_anz" TAB_VERB 10 0 "eKeinePrio" 1 "Systemdruckansteuerung Segeln" 2 "eD1R_DIRECT" 3 "eBCD" 4 "eKlInit" 5 "eMotstopMsa" 6 "eKeinDruck" 7 "eLastfrei" 8 "ePsIn" 9 "eErsatzma48" /end COMPU_VTAB
/begin COMPU_VTAB Conv.cSasPsyst._.f_psys_eff_aktiv_S6_S3 "Umrechnung fuer Messgroesse cSasPsyst::f_psys_eff_aktiv" TAB_VERB 2 0 "FALSE" 1 "TRUE" /end COMPU_VTAB
/begin COMPU_VTAB Conv.cSasPsyst._.f_auframpen_mg_psysminpuls_gest_S6_S3 "Umrechnung fuer Messgroesse cSasPsyst::f_auframpen_mg_psysminpuls_gest" TAB_VERB 2 0 "FALSE" 1 "TRUE" /end COMPU_VTAB
/begin COMPU_VTAB Conv.cSasPsyst._.f_zeit_max_psys_abgelaufen_S6_S3 "Umrechnung fuer Messgroesse cSasPsyst::f_zeit_max_psys_abgelaufen" TAB_VERB 2 0 "Zeit für MAX-Ansteuerung Systemdruck ist noch nicht abgelaufen" 1 "Zeit für MAX-Ansteuerung Systemdruck ist abgelaufen" /end COMPU_VTAB
/begin COMPU_VTAB Conv.cSasPsyst._.f_zeit_max_psys_anst_laeuft_alt_S6_S3 "Umrechnung fuer Messgroesse cSasPsyst::f_zeit_max_psys_anst_laeuft_alt" TAB_VERB 2 0 "MAX-Ansteuerung war aktiv" 1 "MAX-Ansteuerung war nicht aktiv" /end COMPU_VTAB
/begin COMPU_VTAB Conv.cSasPsyst._.pos_alt_psys_S6_S3 "Umrechnung fuer Messgroesse cSasPsyst::pos_alt_psys" TAB_VERB 9 0 "Pos. 1" 1 "Pos. 2" 2 "Pos. 3" 3 "Pos. 4" 4 "Pos. 5" 5 "Pos. D" 6 "Pos. N" 7 "Pos. R" 8 "Pos. P" /end COMPU_VTAB
/begin COMPU_VTAB Conv.cSasPsyst._.f_einstiegsbed_p_sysiae_erf_S6_S3 "Umrechnung fuer Messgroesse cSasPsyst::f_einstiegsbed_p_sysiae_erf" TAB_VERB 2 0 "Bedingungen für Systemdruckvorgabe IAE Fkt. nicht erfüllt" 1 "Bedingungen für Systemdruckvorgabe IAE Fkt. erfüllt" /end COMPU_VTAB
/begin COMPU_VTAB Conv.cSasPsyst._.z_anst_eff_psys_S6_S3 "Umrechnung fuer Messgroesse cSasPsyst::z_anst_eff_psys" TAB_VERB 5 0 "Effizienzsystemdruckanst inaktiv / Initialisierungszustand" 1 "Effizienzsystemdruckanst aktiv" 2 "Effizienzsystemdruckanst inaktiv wegen Getriebetemperaturbed." 3 "Effizienzsystemdruckanst inaktiv wegen Kupplungstemperaturbed." 4 "Effizienzsystemdruckanst inaktiv wegen Ueberwachungsbed." /end COMPU_VTAB
/begin FUNCTION SAS_GLS "Beinhaltet die Funktionalität der GLS"
 /begin LOC_MEASUREMENT iSasBerechnungGls.FSchubZugSas.old_value iSasBerechnungGls.diag_schaltung_ueber_kzu iSasBerechnungGls.filter_wngtgls.letzter_ms_timer iSasBerechnungGls.filter_wngtgls.x iSasBerechnungGls.filter_wngtgls_gestartet iSasBerechnungGls.flag_umsch_gls_kab iSasBerechnungGls.flag_umsch_gls_kzu iSasBerechnungGls.gls_i_anteil iSasBerechnungGls.gls_p_anteil iSasBerechnungGls.n_tmaxge iSasBerechnungGls.ng_tgls iSasBerechnungGls.regeldiff_init iSasBerechnungGls.schalttyp_gls iSasBerechnungGls.schub_zug_wechsel iSasBerechnungGls.t_sgls iSasBerechnungGls.w_ngtgls iSasBerechnungGls.w_ngtgls_filt iSasBerechnungGls.w_ngtnomgls iSasBerechnungGls.w_tsgls iSasBerechnungGls.wechsel_normal_kurz iSasKorGls.FlankeNeg.old_value iSasKorGls.FlankePos.old_value iSasKorGls.gls_aktiv iSasKorGls.gls_mindruck iSasKorGls.reg_gls_gestartet iSasKorGls.schaltung_gls iSasKorGls.t_zgls iSasKorGls.timer_sgls iSasKorGls.timer_vglskab iSasKorGls.timer_vglskzu iSasKorGls.timer_zgls iSasKorGls.verz_gls_gestartet iSasKorGls.wechsel_kzu_kab iSasKorGls.z_gls iSasKorGls.zaehler_zgls iSasRegelungGls.gls_para.cBibRegle._.faktor_d iSasRegelungGls.gls_para.cBibRegle._.faktor_i iSasRegelungGls.gls_para.cBibRegle._.faktor_p iSasRegelungGls.gls_para.cBibRegle._.faktor_t1 iSasRegelungGls.gls_para.cBibRegle._.regel_diff_alt iSasRegelungGls.gls_para.cBibRegle._.stell_max iSasRegelungGls.gls_para.cBibRegle._.stell_min iSasRegelungGls.gls_para.cBibRegle._.stellgr_alt iSasRegelungGls.gls_para.cBibRegle._.stellgr_d_alt iSasRegelungGls.gls_para.cBibRegle._.stellgr_i_alt iSasRegelungGls.gls_para.cBibRegle._.stellgr_i_modulo iSasRegelungGls.i_wngtgls_filter.x iSasRegelungGls.p_gls iSasRegelungGls.p_gls_kab iSasRegelungGls.p_gls_kzu iSasRegelungGls.p_i_gls iSasRegelungGls.p_maxgls iSasRegelungGls.p_mingls iSasRegelungGls.p_p_gls iSasRegelungGls.regeldiff iSasRegelungGls.z_gls_regler iSasRegelungGls.zug_schub_gls /end LOC_MEASUREMENT
/end FUNCTION
/begin FUNCTION SAS_ZENTRAL "In SAS_ZENTRAL sind Klassen zur Steuerung des Schaltablaufs enthalten"
 /begin LOC_MEASUREMENT iSasZentr.abbruchsart_hs_gls_erlaubt iSasZentr.abbruchsart_ist iSasZentr.abbruchsart_soll iSasZentr.c_getr_sas iSasZentr.diag_versch_erlaubt iSasZentr.event_sf_erkannt iSasZentr.f_eco_mode iSasZentr.f_einstiegsbed_erfuellt iSasZentr.f_entscheidungspkt_versch_erreicht iSasZentr.f_init_phase1_m_motmax_rss iSasZentr.f_red_mmotmax_angefordert iSasZentr.f_schaltung_normal_beendet iSasZentr.f_verschachtelung_verboten iSasZentr.f_z_shlog_anfahren_aktiv iSasZentr.flag_ge_dnr_aktiv iSasZentr.flag_ge_rnd_aktiv iSasZentr.flag_sync_verlassen_me iSasZentr.folgeschaltung iSasZentr.gangwechsel iSasZentr.iSchaltend.aktuelle_schaltung iSasZentr.iSchaltend.erste_schaltung iSasZentr.iSchaltend.f_verb_ada_erste_bef iSasZentr.iSchaltend.fkt_halten_in_sync_verboten iSasZentr.iSchaltend.flag_mtschwelle_verbietet_hinsyn iSasZentr.iSchaltend.iKab.ende_kab_gestartet iSasZentr.iSchaltend.iKab.f_best_poffkab_in_syn_erfolgt iSasZentr.iSchaltend.iKab.f_ende_verz_kab_erlaubt iSasZentr.iSchaltend.iKab.gls_hs_kab_gestartet iSasZentr.iSchaltend.iKab.halten_in_syn_kab_gestartet iSasZentr.iSchaltend.iKab.kab_nicht_befuellt iSasZentr.iSchaltend.iKab.kup_kab iSasZentr.iSchaltend.iKab.m_motsoll0_sas iSasZentr.iSchaltend.iKab.md_motsoll_sas iSasZentr.iSchaltend.iKab.p_0stkab iSasZentr.iSchaltend.iKab.p_adaptkab iSasZentr.iSchaltend.iKab.p_kab iSasZentr.iSchaltend.iKab.p_kfkab iSasZentr.iSchaltend.iKab.p_offkab iSasZentr.iSchaltend.iKab.p_stkab iSasZentr.iSchaltend.iKab.pgo_kab_speicher.cBibRampeGradSi16._.letzter_ms_timer iSasZentr.iSchaltend.iKab.pgo_kab_speicher.cBibRampeGradSi16._.letzter_wert iSasZentr.iSchaltend.iKab.pgo_kab_speicher.cBibRampeGradSi16._.maximum iSasZentr.iSchaltend.iKab.pgo_kab_speicher.cBibRampeGradSi16._.minimum iSasZentr.iSchaltend.iKab.pkf_rs_kab_ausgegeben iSasZentr.iSchaltend.iKab.pkf_rs_kab_gestartet iSasZentr.iSchaltend.iKab.po_mtkab iSasZentr.iSchaltend.iKab.ps_hs_kab_gestartet iSasZentr.iSchaltend.iKab.ra1_kab_gestartet iSasZentr.iSchaltend.iKab.ra_sd_hs_kab_gestartet iSasZentr.iSchaltend.iKab.ra_sd_rs_kab_gestartet iSasZentr.iSchaltend.iKab.raph_kab_speicher.letzter_timer iSasZentr.iSchaltend.iKab.raph_kab_speicher.letzter_wert iSasZentr.iSchaltend.iKab.raps_kab_speicher.letzter_timer iSasZentr.iSchaltend.iKab.raps_kab_speicher.letzter_wert iSasZentr.iSchaltend.iKab.schalttyp_kab iSasZentr.iSchaltend.iKab.statisch_kab iSasZentr.iSchaltend.iKab.t_0kab iSasZentr.iSchaltend.iKab.t_ph_rs iSasZentr.iSchaltend.iKab.t_ra_kab_vor_ra1_kzu iSasZentr.iSchaltend.iKab.t_verz_ph_rs iSasZentr.iSchaltend.iKab.t_zkab iSasZentr.iSchaltend.iKab.timer_hinsyn iSasZentr.iSchaltend.iKab.timer_zkab iSasZentr.iSchaltend.iKab.ueb_rs_kab_gestartet iSasZentr.iSchaltend.iKab.z_kab iSasZentr.iSchaltend.iKab.zaehler_zkab iSasZentr.iSchaltend.iKzu.dauer_fa_hsrs_kzu iSasZentr.iSchaltend.iKzu.dauer_ra1_hsrs_kzu iSasZentr.iSchaltend.iKzu.f_hinsyn_kzu_gestartet iSasZentr.iSchaltend.iKzu.f_ngs_abflare_unterschritten iSasZentr.iSchaltend.iKzu.f_pokzufol_erlaubt iSasZentr.iSchaltend.iKzu.f_rampenzeitberechnung_fertig iSasZentr.iSchaltend.iKzu.f_schnellfuellung_war_aktiv iSasZentr.iSchaltend.iKzu.fa_kzu_gestartet iSasZentr.iSchaltend.iKzu.flag_pomekzu_erlaubt iSasZentr.iSchaltend.iKzu.kup_kzu iSasZentr.iSchaltend.iKzu.md_motsoll_sas iSasZentr.iSchaltend.iKzu.p_0stkzu iSasZentr.iSchaltend.iKzu.p_adaptkzu iSasZentr.iSchaltend.iKzu.p_fkzu iSasZentr.iSchaltend.iKzu.p_fkzu_gueltig iSasZentr.iSchaltend.iKzu.p_kzu iSasZentr.iSchaltend.iKzu.p_offkzu iSasZentr.iSchaltend.iKzu.p_offkzu_neg_gls iSasZentr.iSchaltend.iKzu.p_stkzu iSasZentr.iSchaltend.iKzu.pgo_kzu_speicher.cBibRampeGradSi16._.letzter_ms_timer iSasZentr.iSchaltend.iKzu.pgo_kzu_speicher.cBibRampeGradSi16._.letzter_wert iSasZentr.iSchaltend.iKzu.pgo_kzu_speicher.cBibRampeGradSi16._.maximum iSasZentr.iSchaltend.iKzu.pgo_kzu_speicher.cBibRampeGradSi16._.minimum iSasZentr.iSchaltend.iKzu.po_kzuflare iSasZentr.iSchaltend.iKzu.po_mekzu iSasZentr.iSchaltend.iKzu.po_mtkzu iSasZentr.iSchaltend.iKzu.ra1_hsrs_kzu_gestartet iSasZentr.iSchaltend.iKzu.ra2_hsrs_kzu_gestartet iSasZentr.iSchaltend.iKzu.ra3_hsrs_kzu_gestartet iSasZentr.iSchaltend.iKzu.raph_kzu_speicher.letzter_timer iSasZentr.iSchaltend.iKzu.raph_kzu_speicher.letzter_wert iSasZentr.iSchaltend.iKzu.schalttyp_kzu iSasZentr.iSchaltend.iKzu.schliessen_kzu iSasZentr.iSchaltend.iKzu.statisch_kzu iSasZentr.iSchaltend.iKzu.t_0kzu iSasZentr.iSchaltend.iKzu.t_berechnungszeitpunkt iSasZentr.iSchaltend.iKzu.t_besfhsrskzu iSasZentr.iSchaltend.iKzu.t_dt_ig_change iSasZentr.iSchaltend.iKzu.t_dt_ig_change_folge iSasZentr.iSchaltend.iKzu.t_eff_ra1_hsrs_kzu iSasZentr.iSchaltend.iKzu.t_schliessrampe iSasZentr.iSchaltend.iKzu.t_zkzu iSasZentr.iSchaltend.iKzu.timer16_ra1_hsrs_kzu iSasZentr.iSchaltend.iKzu.timer_ab_ende_sf_kzu iSasZentr.iSchaltend.iKzu.timer_seit_start_schaltung iSasZentr.iSchaltend.iKzu.timer_start_fa_kzu iSasZentr.iSchaltend.iKzu.timer_zkzu iSasZentr.iSchaltend.iKzu.z_kzu iSasZentr.iSchaltend.iKzu.zaehler_zkzu iSasZentr.iSchaltend.index_spsas iSasZentr.iSchaltend.istgang_sas iSasZentr.iSchaltend.kup_schutz_massnahme_aktiv iSasZentr.iSchaltend.m_motsoll0_sas iSasZentr.iSchaltend.n_tkf iSasZentr.iSchaltend.n_tsyn iSasZentr.iSchaltend.nd_syn iSasZentr.iSchaltend.nd_synistgang iSasZentr.iSchaltend.ng_dsynzielgang iSasZentr.iSchaltend.p_kab_letzte_schaltung iSasZentr.iSchaltend.p_kzu_letzte_schaltung iSasZentr.iSchaltend.schaltinfo_sas iSasZentr.iSchaltend.schaltinfo_sas_vor_folge iSasZentr.iSchaltend.schaltinfo_syn iSasZentr.iSchaltend.schnellfuellung_beendet iSasZentr.iSchaltend.schnellfuellung_gestartet iSasZentr.iSchaltend.sp_ngdsynzielgang.letzter_ms_timer iSasZentr.iSchaltend.sp_ngdsynzielgang.n_f iSasZentr.iSchaltend.synchron iSasZentr.iSchaltend.synchron_verboten iSasZentr.iSchaltend.t_maxsas iSasZentr.iSchaltend.t_syn iSasZentr.iSchaltend.t_timeout iSasZentr.iSchaltend.timeout iSasZentr.iSchaltend.timer16_sas iSasZentr.iSchaltend.z_kurze_schaltung iSasZentr.iSchaltend.zielgang_sas iSasZentr.iSchaltend.zwangssynchron iSasZentr.iVorbereitend.aktuelle_schaltung iSasZentr.iVorbereitend.erste_schaltung iSasZentr.iVorbereitend.f_verb_ada_erste_bef iSasZentr.iVorbereitend.fkt_halten_in_sync_verboten iSasZentr.iVorbereitend.flag_mtschwelle_verbietet_hinsyn iSasZentr.iVorbereitend.iKab.ende_kab_gestartet iSasZentr.iVorbereitend.iKab.f_best_poffkab_in_syn_erfolgt iSasZentr.iVorbereitend.iKab.f_ende_verz_kab_erlaubt iSasZentr.iVorbereitend.iKab.gls_hs_kab_gestartet iSasZentr.iVorbereitend.iKab.halten_in_syn_kab_gestartet iSasZentr.iVorbereitend.iKab.kab_nicht_befuellt iSasZentr.iVorbereitend.iKab.kup_kab iSasZentr.iVorbereitend.iKab.m_motsoll0_sas iSasZentr.iVorbereitend.iKab.md_motsoll_sas iSasZentr.iVorbereitend.iKab.p_0stkab iSasZentr.iVorbereitend.iKab.p_adaptkab iSasZentr.iVorbereitend.iKab.p_kab iSasZentr.iVorbereitend.iKab.p_kfkab iSasZentr.iVorbereitend.iKab.p_offkab iSasZentr.iVorbereitend.iKab.p_stkab iSasZentr.iVorbereitend.iKab.pgo_kab_speicher.cBibRampeGradSi16._.letzter_ms_timer iSasZentr.iVorbereitend.iKab.pgo_kab_speicher.cBibRampeGradSi16._.letzter_wert iSasZentr.iVorbereitend.iKab.pgo_kab_speicher.cBibRampeGradSi16._.maximum iSasZentr.iVorbereitend.iKab.pgo_kab_speicher.cBibRampeGradSi16._.minimum iSasZentr.iVorbereitend.iKab.pkf_rs_kab_ausgegeben iSasZentr.iVorbereitend.iKab.pkf_rs_kab_gestartet iSasZentr.iVorbereitend.iKab.po_mtkab iSasZentr.iVorbereitend.iKab.ps_hs_kab_gestartet iSasZentr.iVorbereitend.iKab.ra1_kab_gestartet iSasZentr.iVorbereitend.iKab.ra_sd_hs_kab_gestartet iSasZentr.iVorbereitend.iKab.ra_sd_rs_kab_gestartet iSasZentr.iVorbereitend.iKab.raph_kab_speicher.letzter_timer iSasZentr.iVorbereitend.iKab.raph_kab_speicher.letzter_wert iSasZentr.iVorbereitend.iKab.raps_kab_speicher.letzter_timer iSasZentr.iVorbereitend.iKab.raps_kab_speicher.letzter_wert iSasZentr.iVorbereitend.iKab.schalttyp_kab iSasZentr.iVorbereitend.iKab.statisch_kab iSasZentr.iVorbereitend.iKab.t_0kab iSasZentr.iVorbereitend.iKab.t_ph_rs iSasZentr.iVorbereitend.iKab.t_ra_kab_vor_ra1_kzu iSasZentr.iVorbereitend.iKab.t_verz_ph_rs iSasZentr.iVorbereitend.iKab.t_zkab iSasZentr.iVorbereitend.iKab.timer_hinsyn iSasZentr.iVorbereitend.iKab.timer_zkab iSasZentr.iVorbereitend.iKab.ueb_rs_kab_gestartet iSasZentr.iVorbereitend.iKab.z_kab iSasZentr.iVorbereitend.iKab.zaehler_zkab iSasZentr.iVorbereitend.iKzu.dauer_fa_hsrs_kzu iSasZentr.iVorbereitend.iKzu.dauer_ra1_hsrs_kzu iSasZentr.iVorbereitend.iKzu.f_hinsyn_kzu_gestartet iSasZentr.iVorbereitend.iKzu.f_ngs_abflare_unterschritten iSasZentr.iVorbereitend.iKzu.f_pokzufol_erlaubt iSasZentr.iVorbereitend.iKzu.f_rampenzeitberechnung_fertig iSasZentr.iVorbereitend.iKzu.f_schnellfuellung_war_aktiv iSasZentr.iVorbereitend.iKzu.fa_kzu_gestartet iSasZentr.iVorbereitend.iKzu.flag_pomekzu_erlaubt iSasZentr.iVorbereitend.iKzu.kup_kzu iSasZentr.iVorbereitend.iKzu.md_motsoll_sas iSasZentr.iVorbereitend.iKzu.p_0stkzu iSasZentr.iVorbereitend.iKzu.p_adaptkzu iSasZentr.iVorbereitend.iKzu.p_fkzu iSasZentr.iVorbereitend.iKzu.p_fkzu_gueltig iSasZentr.iVorbereitend.iKzu.p_kzu iSasZentr.iVorbereitend.iKzu.p_offkzu iSasZentr.iVorbereitend.iKzu.p_offkzu_neg_gls iSasZentr.iVorbereitend.iKzu.p_stkzu iSasZentr.iVorbereitend.iKzu.pgo_kzu_speicher.cBibRampeGradSi16._.letzter_ms_timer iSasZentr.iVorbereitend.iKzu.pgo_kzu_speicher.cBibRampeGradSi16._.letzter_wert iSasZentr.iVorbereitend.iKzu.pgo_kzu_speicher.cBibRampeGradSi16._.maximum iSasZentr.iVorbereitend.iKzu.pgo_kzu_speicher.cBibRampeGradSi16._.minimum iSasZentr.iVorbereitend.iKzu.po_kzuflare iSasZentr.iVorbereitend.iKzu.po_mekzu iSasZentr.iVorbereitend.iKzu.po_mtkzu iSasZentr.iVorbereitend.iKzu.ra1_hsrs_kzu_gestartet iSasZentr.iVorbereitend.iKzu.ra2_hsrs_kzu_gestartet iSasZentr.iVorbereitend.iKzu.ra3_hsrs_kzu_gestartet iSasZentr.iVorbereitend.iKzu.raph_kzu_speicher.letzter_timer iSasZentr.iVorbereitend.iKzu.raph_kzu_speicher.letzter_wert iSasZentr.iVorbereitend.iKzu.schalttyp_kzu iSasZentr.iVorbereitend.iKzu.schliessen_kzu iSasZentr.iVorbereitend.iKzu.statisch_kzu iSasZentr.iVorbereitend.iKzu.t_0kzu iSasZentr.iVorbereitend.iKzu.t_berechnungszeitpunkt iSasZentr.iVorbereitend.iKzu.t_besfhsrskzu iSasZentr.iVorbereitend.iKzu.t_dt_ig_change iSasZentr.iVorbereitend.iKzu.t_dt_ig_change_folge iSasZentr.iVorbereitend.iKzu.t_eff_ra1_hsrs_kzu iSasZentr.iVorbereitend.iKzu.t_schliessrampe iSasZentr.iVorbereitend.iKzu.t_zkzu iSasZentr.iVorbereitend.iKzu.timer16_ra1_hsrs_kzu iSasZentr.iVorbereitend.iKzu.timer_ab_ende_sf_kzu iSasZentr.iVorbereitend.iKzu.timer_seit_start_schaltung iSasZentr.iVorbereitend.iKzu.timer_start_fa_kzu iSasZentr.iVorbereitend.iKzu.timer_zkzu iSasZentr.iVorbereitend.iKzu.z_kzu iSasZentr.iVorbereitend.iKzu.zaehler_zkzu iSasZentr.iVorbereitend.index_spsas iSasZentr.iVorbereitend.istgang_sas iSasZentr.iVorbereitend.kup_schutz_massnahme_aktiv iSasZentr.iVorbereitend.m_motsoll0_sas iSasZentr.iVorbereitend.n_tkf iSasZentr.iVorbereitend.n_tsyn iSasZentr.iVorbereitend.nd_syn iSasZentr.iVorbereitend.nd_synistgang iSasZentr.iVorbereitend.ng_dsynzielgang iSasZentr.iVorbereitend.p_kab_letzte_schaltung iSasZentr.iVorbereitend.p_kzu_letzte_schaltung iSasZentr.iVorbereitend.schaltinfo_sas iSasZentr.iVorbereitend.schaltinfo_sas_vor_folge iSasZentr.iVorbereitend.schaltinfo_syn iSasZentr.iVorbereitend.schnellfuellung_beendet iSasZentr.iVorbereitend.schnellfuellung_gestartet iSasZentr.iVorbereitend.sp_ngdsynzielgang.letzter_ms_timer iSasZentr.iVorbereitend.sp_ngdsynzielgang.n_f iSasZentr.iVorbereitend.synchron iSasZentr.iVorbereitend.synchron_verboten iSasZentr.iVorbereitend.t_maxsas iSasZentr.iVorbereitend.t_syn iSasZentr.iVorbereitend.t_timeout iSasZentr.iVorbereitend.timeout iSasZentr.iVorbereitend.timer16_sas iSasZentr.iVorbereitend.z_kurze_schaltung iSasZentr.iVorbereitend.zielgang_sas iSasZentr.iVorbereitend.zwangssynchron iSasZentr.igang_dki_m_motmax_rss iSasZentr.igang_m_motmax_rss iSasZentr.istgang_sync iSasZentr.istgang_sync_idx iSasZentr.kup_nkraftloesend2_letztes_ga iSasZentr.m_motmax_kupschtz iSasZentr.m_motmax_merk iSasZentr.m_motmax_rss iSasZentr.m_motmax_sas iSasZentr.m_motmax_vers iSasZentr.m_tpgrasyn iSasZentr.md_tpgrasyn iSasZentr.mg_wert_gesp iSasZentr.nd_nmot_nt iSasZentr.ng_absas iSasZentr.schaltart_sas iSasZentr.schaltart_sas_sps iSasZentr.schalttyp iSasZentr.schalttyp_sas iSasZentr.schaltung_abgebrochen iSasZentr.schaltung_anfahren iSasZentr.schaltung_anfahren_aktiv iSasZentr.schaltung_anfahren_aktiv_idx iSasZentr.schaltung_anfahren_idx iSasZentr.schaltung_phase_anfahren iSasZentr.schaltung_sas iSasZentr.schaltung_ueber_kzu iSasZentr.schaltungsende_durch_ge_ga iSasZentr.schrittschaltung iSasZentr.sp_mmotmax_rss.letzter_ms_timer iSasZentr.sp_mmotmax_rss.letzter_wert iSasZentr.sp_mmotmax_rss.maximum iSasZentr.sp_mmotmax_rss.minimum iSasZentr.start_wert_grad iSasZentr.sync_istgang_verlassen iSasZentr.sync_istgang_verlassen_me iSasZentr.sync_ziel_erreicht iSasZentr.t_rampe_m_motmax_rss iSasZentr.t_schaltverzug iSasZentr.t_z_m_motmax_kupschtz iSasZentr.timer16_nsyn iSasZentr.timer_gangwechsel iSasZentr.timer_hold_sync_ziel iSasZentr.timer_in_synchron iSasZentr.timer_m_motmax_kupschtz iSasZentr.timer_schaltung_sas iSasZentr.timer_shlog_anfahren_me iSasZentr.timer_z_m_motmax_rss iSasZentr.vorbereitung_im_vordergrund iSasZentr.wechsel_normal_kurz iSasZentr.z_fes_mode iSasZentr.z_gangwechsel iSasZentr.z_m_motmax_kupschtz iSasZentr.z_m_motmax_rss iSasZentr.z_m_motmax_sas iSasZentr.z_mmotmax_sas iSasZentr.z_shlog_anfahren iSasZentr.z_sync_ziel iSasZentr.zaehler_z_m_motmax_kupschtz iSasZentr.zaehler_z_m_motmax_sas iSasZentr.zgang_m_motmax_rss iSasZentr.zs_wechsel_verboten iSasZentr.zug_schub_sas /end LOC_MEASUREMENT
/end FUNCTION
/begin FUNCTION SAS_SYSTEMDRUCK "In SAS_SYSTEMDRUCK sind Klassen zur Steuerung des Systemdrucks während des Schaltablaufs enthalten"
 /begin LOC_MEASUREMENT iSasPsyst.f_auframpen_mg_psysminpuls_gest iSasPsyst.f_einstiegsbed_p_sysiae_erf iSasPsyst.f_psys_eff_aktiv iSasPsyst.f_psys_kupschutz_anst_laeuft iSasPsyst.f_zeit_max_psys_abgelaufen iSasPsyst.f_zeit_max_psys_anst_laeuft iSasPsyst.f_zeit_max_psys_anst_laeuft_alt iSasPsyst.filter_p_sysist.letzter_ms_timer iSasPsyst.filter_p_sysist.x iSasPsyst.fkt_druckvorgabe_psys iSasPsyst.fkt_druckvorgabe_psys_alt iSasPsyst.fkt_druckvorgabe_uebfaehig iSasPsyst.p_iep_sys iSasPsyst.p_mod iSasPsyst.p_pumpe_sys iSasPsyst.p_sys iSasPsyst.p_sys_cbar iSasPsyst.p_sys_soll iSasPsyst.p_sysist iSasPsyst.pos_alt_psys iSasPsyst.prio_absolutdruckvorgabe_anz iSasPsyst.rampe_p_sysiae.letzter_ms_timer iSasPsyst.rampe_p_sysiae.letzter_wert iSasPsyst.rampe_p_sysiae.maximum iSasPsyst.rampe_p_sysiae.minimum iSasPsyst.rampe_p_syspulsada.letzter_ms_timer iSasPsyst.rampe_p_syspulsada.letzter_wert iSasPsyst.rampe_p_syspulsada.maximum iSasPsyst.rampe_p_syspulsada.minimum iSasPsyst.speicher_filter_psys.letzter_ms_timer iSasPsyst.speicher_filter_psys.x iSasPsyst.timer_max_psys_anst iSasPsyst.timer_psys_ps iSasPsyst.timer_seit_ausstieg_psys_eff iSasPsyst.z_anst_eff_psys iSasPsystBedarfgerBestrom.f_i_bedarf iSasPsystBedarfgerBestrom.f_i_bedarf_anfordern /end LOC_MEASUREMENT
/end FUNCTION
/end MODULE
/end PROJECT
