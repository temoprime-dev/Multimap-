ASAP2_VERSION 1 51
/begin PROJECT _929_929 "Gen2_BMW_System_Supplier_Lib"
/begin HEADER "" VERSION "C_03_03" PROJECT_NO _929_929 /end HEADER
/begin MODULE DIM ""
/begin MOD_COMMON "" BYTE_ORDER MSB_FIRST ALIGNMENT_BYTE 1 ALIGNMENT_WORD 2 ALIGNMENT_LONG 4 ALIGNMENT_FLOAT32_IEEE 4 /end MOD_COMMON
/begin MEASUREMENT iBibAglex.z_agl "Zustand der AGL-Berechnung" UBYTE Conv.cBibAglex._.z_agl_S6_S3 1 100 0 4 DISPLAY_IDENTIFIER z_agl.iBibAglex ECU_ADDRESS 0xFFF8C1B0 /end MEASUREMENT
/begin MEASUREMENT iBibAglex.z_ringspeicher "Zustand der AGL-Berechnung" UBYTE Conv.cBibAglex._.z_ringspeicher_S6_S3 1 100 0 2 DISPLAY_IDENTIFIER z_ringspeicher.iBibAglex ECU_ADDRESS 0xFFF8C1B1 /end MEASUREMENT
/begin MEASUREMENT iBibAglex.n_aktuell "Eingangsdrehzahl fuer AGL der Pulsadaption (n_t bzw. n_ab)" SWORD UMR_U_MIN_1_1_0_S6_S3 1 100 0 8200 DISPLAY_IDENTIFIER n_aktuell.iBibAglex ECU_ADDRESS 0xFFF8C1B2 /end MEASUREMENT
/begin MEASUREMENT iBibAglex.extrapolierter_wert "mit Ausgleichsgerade extrapolierter y-Wert" SWORD UMR___1_1_0_S6_S3 1 100 -32768 32767 DISPLAY_IDENTIFIER extrapolierter_wert.iBibAglex ECU_ADDRESS 0xFFF8C1B4 /end MEASUREMENT
/begin MEASUREMENT iBibAglex.n_guete "Drehzahlsignalguete (n_aktuell - extrapolierter_wert)" SWORD UMR_U_MIN_1_1_0_S6_S3 1 100 -200 200 DISPLAY_IDENTIFIER n_guete.iBibAglex ECU_ADDRESS 0xFFF8C1B6 /end MEASUREMENT
/begin MEASUREMENT iBibAglex.func_agl "Funktion die AGL besitzt" UBYTE Conv.cBibAglex._.func_agl_S6_S3 1 100 0 4 DISPLAY_IDENTIFIER func_agl.iBibAglex ECU_ADDRESS 0xFFF8C1B8 /end MEASUREMENT
/begin MEASUREMENT iBibAglex.signal_agl "Aktives Eingangssignal" UBYTE Conv.cBibAglex._.signal_agl_S6_S3 1 100 0 5 DISPLAY_IDENTIFIER signal_agl.iBibAglex ECU_ADDRESS 0xFFF8C1B9 /end MEASUREMENT
/begin MEASUREMENT iBibAglex.f_nicht_berechnen "Aktives Eingangssignal" UBYTE Conv.cBibAglex._.f_nicht_berechnen_S6_S3 1 100 0 1 BIT_MASK 0x1 DISPLAY_IDENTIFIER f_nicht_berechnen.iBibAglex ECU_ADDRESS 0xFFF8C1BA /end MEASUREMENT
/begin MEASUREMENT iBibAglex.anzahl_werte "Anzahl der Werte der Ausgleichsgeraden (laenge + extrapolationsschritte)" UBYTE UMR___1_1_0_S6_S3 1 100 0 255 DISPLAY_IDENTIFIER anzahl_werte.iBibAglex ECU_ADDRESS 0xFFF8C1BB /end MEASUREMENT
/begin MEASUREMENT iBibAglex.laenge "Laenge der Ausgleichsgeraden" UBYTE UMR___1_1_0_S6_S3 1 100 0 255 DISPLAY_IDENTIFIER laenge.iBibAglex ECU_ADDRESS 0xFFF8C1BC /end MEASUREMENT
/begin MEASUREMENT iBibAglex.extrapolationsschritte "Anzahl der Extrapolationsschritte" UBYTE UMR___1_1_0_S6_S3 1 100 0 255 DISPLAY_IDENTIFIER extrapolationsschritte.iBibAglex ECU_ADDRESS 0xFFF8C1BD /end MEASUREMENT
/begin MEASUREMENT iBibAglex.noch_benoetigte_werte "Laenge der Ausgleichsgeraden" UBYTE UMR___1_1_0_S6_S3 1 100 0 255 DISPLAY_IDENTIFIER noch_benoetigte_werte.iBibAglex ECU_ADDRESS 0xFFF8C1BE /end MEASUREMENT
/begin MEASUREMENT iBibAglex.index_erster_wert "Index des aeltesten Wertes" UBYTE UMR___1_1_0_S6_S3 1 100 0 255 DISPLAY_IDENTIFIER index_erster_wert.iBibAglex ECU_ADDRESS 0xFFF8C1BF /end MEASUREMENT
/begin MEASUREMENT iBibAglex.index_aeltester_wert "Index des aeltesten Wertes" UBYTE UMR___1_1_0_S6_S3 1 100 0 255 DISPLAY_IDENTIFIER index_aeltester_wert.iBibAglex ECU_ADDRESS 0xFFF8C1C0 /end MEASUREMENT
/begin MEASUREMENT iBibAglex.x_0 "neuer Koordinatenursprung in x-Richtung" SLONG UMR___1_1_0_S6_S3 1 100 -2147483648 2147483647 DISPLAY_IDENTIFIER x_0.iBibAglex ECU_ADDRESS 0xFFF8C1C4 /end MEASUREMENT
/begin MEASUREMENT iBibAglex.y_0 "neuer Koordinatenursprung in y-Richtung" SLONG UMR___1_1_0_S6_S3 1 100 -2147483648 2147483647 DISPLAY_IDENTIFIER y_0.iBibAglex ECU_ADDRESS 0xFFF8C1C8 /end MEASUREMENT
/begin MEASUREMENT iBibAglex.x_expol "Abstand v.Schwerpkt zum extrapol.Wert in x-Richtg." SWORD UMR___1_1_0_S6_S3 1 100 -32768 32767 DISPLAY_IDENTIFIER x_expol.iBibAglex ECU_ADDRESS 0xFFF8C1CC /end MEASUREMENT
/begin MEASUREMENT iBibAglex.sum_xi_q "Summe aller (xi*xi) entspricht Nenner der Steigung a'" SLONG UMR___1_1_0_S6_S3 1 100 -2147483648 2147483647 DISPLAY_IDENTIFIER sum_xi_q.iBibAglex ECU_ADDRESS 0xFFF8C1D0 /end MEASUREMENT
/begin MEASUREMENT iBibAglex.sum_yi "Summe aller y-Werte" SLONG UMR___1_1_0_S6_S3 1 100 -2147483648 2147483647 DISPLAY_IDENTIFIER sum_yi.iBibAglex ECU_ADDRESS 0xFFF8C1D4 /end MEASUREMENT
/begin MEASUREMENT iBibAglex.steigung "Steigung der Ausgleichsgeraden" SLONG UMR___1_1_0_S6_S3 1 100 -2147483648 2147483647 DISPLAY_IDENTIFIER steigung.iBibAglex ECU_ADDRESS 0xFFF8C1D8 /end MEASUREMENT
/begin MEASUREMENT iBihTimer.timer_reset.timer "Der aktuelle Timerwert" UBYTE UMR_MSEC__10_1_0_S6_S3 1 100 0 2550 DISPLAY_IDENTIFIER timer_reset.iBihTimer ECU_ADDRESS 0xFFF8A070 /end MEASUREMENT
/begin MEASUREMENT iBihTimer.timer_difference "tatsächliche Timer Wert: (BS Timer - timer_old_value)" UWORD UMR_MSEC__1_1_0_S6_S3 1 100 0 65535 DISPLAY_IDENTIFIER timer_difference.iBihTimer ECU_ADDRESS 0xFFF8A068 /end MEASUREMENT
/begin MEASUREMENT iBihTimer.timer_difference_10ms_skal "Timerschritt für 10ms Quantisierung" UWORD UMR_MSEC__10_1_0_S6_S3 1 100 0 655350 DISPLAY_IDENTIFIER timer_difference_10ms_skal.iBihTimer ECU_ADDRESS 0xFFF8A06A /end MEASUREMENT
/begin MEASUREMENT iBihTimer.timer_difference_1ms_skal "Timerschritt für 10ms Quantisierung" UWORD UMR_MSEC__1_1_0_S6_S3 1 100 0 65535 DISPLAY_IDENTIFIER timer_difference_1ms_skal.iBihTimer ECU_ADDRESS 0xFFF8A06C /end MEASUREMENT
/begin MEASUREMENT iBihTimer.timer_old_value "letzte Timer Wert" UWORD UMR_MSEC__1_1_0_S6_S3 1 100 0 65535 DISPLAY_IDENTIFIER timer_old_value.iBihTimer ECU_ADDRESS 0xFFF8A06E /end MEASUREMENT
/begin MEASUREMENT iAzsSZPulsAda.TimerSZPulsAda.time "Zeit des Timers" UWORD UMR_SEC__1_100_0_S6_S3 1 100 0 655.35 DISPLAY_IDENTIFIER TimerSZPulsAda.iAzsSZPulsAda ECU_ADDRESS 0xFFF8A0A8 /end MEASUREMENT
/begin MEASUREMENT iAzsSZPulsAda.TimerMaxTime.time "Zeit des Timers" UWORD UMR_SEC__1_100_0_S6_S3 1 100 0 655.35 DISPLAY_IDENTIFIER TimerMaxTime.iAzsSZPulsAda ECU_ADDRESS 0xFFF8A0AA /end MEASUREMENT
/begin MEASUREMENT iAzsNeutralEbene.TimerNE.time "Zeit des Timers" UWORD UMR_SEC__1_100_0_S6_S3 1 100 0 655.35 DISPLAY_IDENTIFIER TimerNE.iAzsNeutralEbene ECU_ADDRESS 0xFFF8C896 /end MEASUREMENT
/begin MEASUREMENT iAzsKupMassnahmenKoord.iSchaltungVerz.iVerzZeit.time "Zeit des Timers" UWORD UMR_SEC__1_100_0_S6_S3 1 100 0 655.35 DISPLAY_IDENTIFIER iVerzZeit.iSchaltungVerz.iAzsKupMassnahmenKoord ECU_ADDRESS 0xFFF8C876 /end MEASUREMENT
/begin MEASUREMENT iBihMomenHsHss.iTimerGesamtHssStartRampe3.timer "Der aktuelle Timerwert" UWORD UMR_MSEC__10_1_0_S6_S3 1 100 0 655350 DISPLAY_IDENTIFIER iTimerGesamtHssStartRampe3.iBihMomenHsHss ECU_ADDRESS 0xFFF8C930 /end MEASUREMENT
/begin MEASUREMENT iBihMomenHsHss.iTimerGesamtHssPhase.timer "Der aktuelle Timerwert" UWORD UMR_MSEC__10_1_0_S6_S3 1 100 0 655350 DISPLAY_IDENTIFIER iTimerGesamtHssPhase.iBihMomenHsHss ECU_ADDRESS 0xFFF8C932 /end MEASUREMENT
/begin MEASUREMENT iBihMomen.TimerK0Verlust.time "Zeit des Timers" UWORD UMR_SEC__1_100_0_S6_S3 1 100 0 655.35 DISPLAY_IDENTIFIER TimerK0Verlust.iBihMomen ECU_ADDRESS 0xFFF8A0C0 /end MEASUREMENT
/begin MEASUREMENT iBihSigna.timer_zielgang_aenderung.timer "Der aktuelle Timerwert" UBYTE UMR_MSEC__10_1_0_S6_S3 1 100 0 2550 DISPLAY_IDENTIFIER timer_zielgang_aenderung.iBihSigna ECU_ADDRESS 0xFFF8C952 /end MEASUREMENT
/begin MEASUREMENT iBihSigna.timer_sbc_aktiv.timer "Der aktuelle Timerwert" UBYTE UMR_MSEC__10_1_0_S6_S3 1 100 0 2550 DISPLAY_IDENTIFIER timer_sbc_aktiv.iBihSigna ECU_ADDRESS 0xFFF8C953 /end MEASUREMENT
/begin MEASUREMENT iBihMPuauf.Pt1MPuAuf.x "Filterwert" SLONG UMR___1_300_0_S6_S3 1 100 -7158278.82667 7158278.82333 DISPLAY_IDENTIFIER Pt1MPuAuf.iBihMPuauf ECU_ADDRESS 0xFFF8C938 /end MEASUREMENT
/begin MEASUREMENT iMvsZentr.iTimerParksp.timer "Der aktuelle Timerwert" UBYTE UMR_MSEC__10_1_0_S6_S3 1 100 0 2550 DISPLAY_IDENTIFIER iTimerParksp.iMvsZentr ECU_ADDRESS 0xFFF8D57C /end MEASUREMENT
/begin MEASUREMENT iMvsZentr.iTimerKeinKfl.timer "Der aktuelle Timerwert" UBYTE UMR_MSEC__10_1_0_S6_S3 1 100 0 2550 DISPLAY_IDENTIFIER iTimerKeinKfl.iMvsZentr ECU_ADDRESS 0xFFF8D57D /end MEASUREMENT
/begin MEASUREMENT iMvsZentr.iTimerMagnet.timer "Der aktuelle Timerwert" UWORD UMR_MSEC__10_1_0_S6_S3 1 100 0 655350 DISPLAY_IDENTIFIER iTimerMagnet.iMvsZentr ECU_ADDRESS 0xFFF8D57E /end MEASUREMENT
/begin MEASUREMENT iKupHysA.iDt1PAbssoll.Pt1Fl32.x "Filterwert" FLOAT32_IEEE UMR___1_1_0_S6_S3 1 100 -1000000000 1000000000 FORMAT "%4.2" DISPLAY_IDENTIFIER Pt1Fl32.iDt1PAbssoll.iKupHysA ECU_ADDRESS 0xFFF8EDEC /end MEASUREMENT
/begin MEASUREMENT iKupHysA.iDt1PAbssoll.xp "Ableitung vom Eingangswert" FLOAT32_IEEE UMR___1_1_0_S6_S3 1 100 -32768 32767 FORMAT "%4.2" DISPLAY_IDENTIFIER iDt1PAbssoll.iKupHysA ECU_ADDRESS 0xFFF8EDE8 /end MEASUREMENT
/begin MEASUREMENT iKupHysA.iPt2MoKomp.x "Filterwert" FLOAT32_IEEE UMR___1_1_0_S6_S3 1 100 -2147483648 2147483647 FORMAT "%4.2" DISPLAY_IDENTIFIER x.iPt2MoKomp.iKupHysA ECU_ADDRESS 0xFFF8EDF0 /end MEASUREMENT
/begin MEASUREMENT iKupHysA.iPt2MoKomp.xp "Ableitung vom Eingangswert" FLOAT32_IEEE UMR__SEC_1_1_0_S6_S3 1 100 -2147483648 2147483647 FORMAT "%4.2" DISPLAY_IDENTIFIER xp.iPt2MoKomp.iKupHysA ECU_ADDRESS 0xFFF8EDF4 /end MEASUREMENT
/begin MEASUREMENT iKupHysA.iDt1IEds.Pt1Si16.x "Filterwert" SLONG UMR___1_300_0_S6_S3 1 100 -7158278.82667 7158278.82333 DISPLAY_IDENTIFIER Pt1Si16.iDt1IEds.iKupHysA ECU_ADDRESS 0xFFF8EDFC /end MEASUREMENT
/begin MEASUREMENT iKupHysA.iDt1IEds.xp "Ableitung vom Eingangswert" SWORD UMR___1_1_0_S6_S3 1 100 -32768 32767 DISPLAY_IDENTIFIER iDt1IEds.iKupHysA ECU_ADDRESS 0xFFF8EDF8 /end MEASUREMENT
/begin MEASUREMENT iKupHysA.iPt2IoKomp.x "Filterwert" FLOAT32_IEEE UMR___1_1_0_S6_S3 1 100 -2147483648 2147483647 FORMAT "%4.2" DISPLAY_IDENTIFIER x.iPt2IoKomp.iKupHysA ECU_ADDRESS 0xFFF8EE00 /end MEASUREMENT
/begin MEASUREMENT iKupHysA.iPt2IoKomp.xp "Ableitung vom Eingangswert" FLOAT32_IEEE UMR__SEC_1_1_0_S6_S3 1 100 -2147483648 2147483647 FORMAT "%4.2" DISPLAY_IDENTIFIER xp.iPt2IoKomp.iKupHysA ECU_ADDRESS 0xFFF8EE04 /end MEASUREMENT
/begin MEASUREMENT iKupHysA.iDt1Verz.Pt1Fl32.x "Filterwert" FLOAT32_IEEE UMR___1_1_0_S6_S3 1 100 -1000000000 1000000000 FORMAT "%4.2" DISPLAY_IDENTIFIER Pt1Fl32.iDt1Verz.iKupHysA ECU_ADDRESS 0xFFF8EE0C /end MEASUREMENT
/begin MEASUREMENT iKupHysA.iDt1Verz.xp "Ableitung vom Eingangswert" FLOAT32_IEEE UMR___1_1_0_S6_S3 1 100 -32768 32767 FORMAT "%4.2" DISPLAY_IDENTIFIER iDt1Verz.iKupHysA ECU_ADDRESS 0xFFF8EE08 /end MEASUREMENT
/begin MEASUREMENT iKupHysB.iDt1PAbssoll.Pt1Fl32.x "Filterwert" FLOAT32_IEEE UMR___1_1_0_S6_S3 1 100 -1000000000 1000000000 FORMAT "%4.2" DISPLAY_IDENTIFIER Pt1Fl32.iDt1PAbssoll.iKupHysB ECU_ADDRESS 0xFFF8EE50 /end MEASUREMENT
/begin MEASUREMENT iKupHysB.iDt1PAbssoll.xp "Ableitung vom Eingangswert" FLOAT32_IEEE UMR___1_1_0_S6_S3 1 100 -32768 32767 FORMAT "%4.2" DISPLAY_IDENTIFIER iDt1PAbssoll.iKupHysB ECU_ADDRESS 0xFFF8EE4C /end MEASUREMENT
/begin MEASUREMENT iKupHysB.iPt2MoKomp.x "Filterwert" FLOAT32_IEEE UMR___1_1_0_S6_S3 1 100 -2147483648 2147483647 FORMAT "%4.2" DISPLAY_IDENTIFIER x.iPt2MoKomp.iKupHysB ECU_ADDRESS 0xFFF8EE54 /end MEASUREMENT
/begin MEASUREMENT iKupHysB.iPt2MoKomp.xp "Ableitung vom Eingangswert" FLOAT32_IEEE UMR__SEC_1_1_0_S6_S3 1 100 -2147483648 2147483647 FORMAT "%4.2" DISPLAY_IDENTIFIER xp.iPt2MoKomp.iKupHysB ECU_ADDRESS 0xFFF8EE58 /end MEASUREMENT
/begin MEASUREMENT iKupHysB.iDt1IEds.Pt1Si16.x "Filterwert" SLONG UMR___1_300_0_S6_S3 1 100 -7158278.82667 7158278.82333 DISPLAY_IDENTIFIER Pt1Si16.iDt1IEds.iKupHysB ECU_ADDRESS 0xFFF8EE60 /end MEASUREMENT
/begin MEASUREMENT iKupHysB.iDt1IEds.xp "Ableitung vom Eingangswert" SWORD UMR___1_1_0_S6_S3 1 100 -32768 32767 DISPLAY_IDENTIFIER iDt1IEds.iKupHysB ECU_ADDRESS 0xFFF8EE5C /end MEASUREMENT
/begin MEASUREMENT iKupHysB.iPt2IoKomp.x "Filterwert" FLOAT32_IEEE UMR___1_1_0_S6_S3 1 100 -2147483648 2147483647 FORMAT "%4.2" DISPLAY_IDENTIFIER x.iPt2IoKomp.iKupHysB ECU_ADDRESS 0xFFF8EE64 /end MEASUREMENT
/begin MEASUREMENT iKupHysB.iPt2IoKomp.xp "Ableitung vom Eingangswert" FLOAT32_IEEE UMR__SEC_1_1_0_S6_S3 1 100 -2147483648 2147483647 FORMAT "%4.2" DISPLAY_IDENTIFIER xp.iPt2IoKomp.iKupHysB ECU_ADDRESS 0xFFF8EE68 /end MEASUREMENT
/begin MEASUREMENT iKupHysB.iDt1Verz.Pt1Fl32.x "Filterwert" FLOAT32_IEEE UMR___1_1_0_S6_S3 1 100 -1000000000 1000000000 FORMAT "%4.2" DISPLAY_IDENTIFIER Pt1Fl32.iDt1Verz.iKupHysB ECU_ADDRESS 0xFFF8EE70 /end MEASUREMENT
/begin MEASUREMENT iKupHysB.iDt1Verz.xp "Ableitung vom Eingangswert" FLOAT32_IEEE UMR___1_1_0_S6_S3 1 100 -32768 32767 FORMAT "%4.2" DISPLAY_IDENTIFIER iDt1Verz.iKupHysB ECU_ADDRESS 0xFFF8EE6C /end MEASUREMENT
/begin MEASUREMENT iKupHysC.iDt1PAbssoll.Pt1Fl32.x "Filterwert" FLOAT32_IEEE UMR___1_1_0_S6_S3 1 100 -1000000000 1000000000 FORMAT "%4.2" DISPLAY_IDENTIFIER Pt1Fl32.iDt1PAbssoll.iKupHysC ECU_ADDRESS 0xFFF8EEB4 /end MEASUREMENT
/begin MEASUREMENT iKupHysC.iDt1PAbssoll.xp "Ableitung vom Eingangswert" FLOAT32_IEEE UMR___1_1_0_S6_S3 1 100 -32768 32767 FORMAT "%4.2" DISPLAY_IDENTIFIER iDt1PAbssoll.iKupHysC ECU_ADDRESS 0xFFF8EEB0 /end MEASUREMENT
/begin MEASUREMENT iKupHysC.iPt2MoKomp.x "Filterwert" FLOAT32_IEEE UMR___1_1_0_S6_S3 1 100 -2147483648 2147483647 FORMAT "%4.2" DISPLAY_IDENTIFIER x.iPt2MoKomp.iKupHysC ECU_ADDRESS 0xFFF8EEB8 /end MEASUREMENT
/begin MEASUREMENT iKupHysC.iPt2MoKomp.xp "Ableitung vom Eingangswert" FLOAT32_IEEE UMR__SEC_1_1_0_S6_S3 1 100 -2147483648 2147483647 FORMAT "%4.2" DISPLAY_IDENTIFIER xp.iPt2MoKomp.iKupHysC ECU_ADDRESS 0xFFF8EEBC /end MEASUREMENT
/begin MEASUREMENT iKupHysC.iDt1IEds.Pt1Si16.x "Filterwert" SLONG UMR___1_300_0_S6_S3 1 100 -7158278.82667 7158278.82333 DISPLAY_IDENTIFIER Pt1Si16.iDt1IEds.iKupHysC ECU_ADDRESS 0xFFF8EEC4 /end MEASUREMENT
/begin MEASUREMENT iKupHysC.iDt1IEds.xp "Ableitung vom Eingangswert" SWORD UMR___1_1_0_S6_S3 1 100 -32768 32767 DISPLAY_IDENTIFIER iDt1IEds.iKupHysC ECU_ADDRESS 0xFFF8EEC0 /end MEASUREMENT
/begin MEASUREMENT iKupHysC.iPt2IoKomp.x "Filterwert" FLOAT32_IEEE UMR___1_1_0_S6_S3 1 100 -2147483648 2147483647 FORMAT "%4.2" DISPLAY_IDENTIFIER x.iPt2IoKomp.iKupHysC ECU_ADDRESS 0xFFF8EEC8 /end MEASUREMENT
/begin MEASUREMENT iKupHysC.iPt2IoKomp.xp "Ableitung vom Eingangswert" FLOAT32_IEEE UMR__SEC_1_1_0_S6_S3 1 100 -2147483648 2147483647 FORMAT "%4.2" DISPLAY_IDENTIFIER xp.iPt2IoKomp.iKupHysC ECU_ADDRESS 0xFFF8EECC /end MEASUREMENT
/begin MEASUREMENT iKupHysC.iDt1Verz.Pt1Fl32.x "Filterwert" FLOAT32_IEEE UMR___1_1_0_S6_S3 1 100 -1000000000 1000000000 FORMAT "%4.2" DISPLAY_IDENTIFIER Pt1Fl32.iDt1Verz.iKupHysC ECU_ADDRESS 0xFFF8EED4 /end MEASUREMENT
/begin MEASUREMENT iKupHysC.iDt1Verz.xp "Ableitung vom Eingangswert" FLOAT32_IEEE UMR___1_1_0_S6_S3 1 100 -32768 32767 FORMAT "%4.2" DISPLAY_IDENTIFIER iDt1Verz.iKupHysC ECU_ADDRESS 0xFFF8EED0 /end MEASUREMENT
/begin MEASUREMENT iKupHysD.iDt1PAbssoll.Pt1Fl32.x "Filterwert" FLOAT32_IEEE UMR___1_1_0_S6_S3 1 100 -1000000000 1000000000 FORMAT "%4.2" DISPLAY_IDENTIFIER Pt1Fl32.iDt1PAbssoll.iKupHysD ECU_ADDRESS 0xFFF8EF18 /end MEASUREMENT
/begin MEASUREMENT iKupHysD.iDt1PAbssoll.xp "Ableitung vom Eingangswert" FLOAT32_IEEE UMR___1_1_0_S6_S3 1 100 -32768 32767 FORMAT "%4.2" DISPLAY_IDENTIFIER iDt1PAbssoll.iKupHysD ECU_ADDRESS 0xFFF8EF14 /end MEASUREMENT
/begin MEASUREMENT iKupHysD.iPt2MoKomp.x "Filterwert" FLOAT32_IEEE UMR___1_1_0_S6_S3 1 100 -2147483648 2147483647 FORMAT "%4.2" DISPLAY_IDENTIFIER x.iPt2MoKomp.iKupHysD ECU_ADDRESS 0xFFF8EF1C /end MEASUREMENT
/begin MEASUREMENT iKupHysD.iPt2MoKomp.xp "Ableitung vom Eingangswert" FLOAT32_IEEE UMR__SEC_1_1_0_S6_S3 1 100 -2147483648 2147483647 FORMAT "%4.2" DISPLAY_IDENTIFIER xp.iPt2MoKomp.iKupHysD ECU_ADDRESS 0xFFF8EF20 /end MEASUREMENT
/begin MEASUREMENT iKupHysD.iDt1IEds.Pt1Si16.x "Filterwert" SLONG UMR___1_300_0_S6_S3 1 100 -7158278.82667 7158278.82333 DISPLAY_IDENTIFIER Pt1Si16.iDt1IEds.iKupHysD ECU_ADDRESS 0xFFF8EF28 /end MEASUREMENT
/begin MEASUREMENT iKupHysD.iDt1IEds.xp "Ableitung vom Eingangswert" SWORD UMR___1_1_0_S6_S3 1 100 -32768 32767 DISPLAY_IDENTIFIER iDt1IEds.iKupHysD ECU_ADDRESS 0xFFF8EF24 /end MEASUREMENT
/begin MEASUREMENT iKupHysD.iPt2IoKomp.x "Filterwert" FLOAT32_IEEE UMR___1_1_0_S6_S3 1 100 -2147483648 2147483647 FORMAT "%4.2" DISPLAY_IDENTIFIER x.iPt2IoKomp.iKupHysD ECU_ADDRESS 0xFFF8EF2C /end MEASUREMENT
/begin MEASUREMENT iKupHysD.iPt2IoKomp.xp "Ableitung vom Eingangswert" FLOAT32_IEEE UMR__SEC_1_1_0_S6_S3 1 100 -2147483648 2147483647 FORMAT "%4.2" DISPLAY_IDENTIFIER xp.iPt2IoKomp.iKupHysD ECU_ADDRESS 0xFFF8EF30 /end MEASUREMENT
/begin MEASUREMENT iKupHysD.iDt1Verz.Pt1Fl32.x "Filterwert" FLOAT32_IEEE UMR___1_1_0_S6_S3 1 100 -1000000000 1000000000 FORMAT "%4.2" DISPLAY_IDENTIFIER Pt1Fl32.iDt1Verz.iKupHysD ECU_ADDRESS 0xFFF8EF38 /end MEASUREMENT
/begin MEASUREMENT iKupHysD.iDt1Verz.xp "Ableitung vom Eingangswert" FLOAT32_IEEE UMR___1_1_0_S6_S3 1 100 -32768 32767 FORMAT "%4.2" DISPLAY_IDENTIFIER iDt1Verz.iKupHysD ECU_ADDRESS 0xFFF8EF34 /end MEASUREMENT
/begin MEASUREMENT iKupHysE.iDt1PAbssoll.Pt1Fl32.x "Filterwert" FLOAT32_IEEE UMR___1_1_0_S6_S3 1 100 -1000000000 1000000000 FORMAT "%4.2" DISPLAY_IDENTIFIER Pt1Fl32.iDt1PAbssoll.iKupHysE ECU_ADDRESS 0xFFF8EF7C /end MEASUREMENT
/begin MEASUREMENT iKupHysE.iDt1PAbssoll.xp "Ableitung vom Eingangswert" FLOAT32_IEEE UMR___1_1_0_S6_S3 1 100 -32768 32767 FORMAT "%4.2" DISPLAY_IDENTIFIER iDt1PAbssoll.iKupHysE ECU_ADDRESS 0xFFF8EF78 /end MEASUREMENT
/begin MEASUREMENT iKupHysE.iPt2MoKomp.x "Filterwert" FLOAT32_IEEE UMR___1_1_0_S6_S3 1 100 -2147483648 2147483647 FORMAT "%4.2" DISPLAY_IDENTIFIER x.iPt2MoKomp.iKupHysE ECU_ADDRESS 0xFFF8EF80 /end MEASUREMENT
/begin MEASUREMENT iKupHysE.iPt2MoKomp.xp "Ableitung vom Eingangswert" FLOAT32_IEEE UMR__SEC_1_1_0_S6_S3 1 100 -2147483648 2147483647 FORMAT "%4.2" DISPLAY_IDENTIFIER xp.iPt2MoKomp.iKupHysE ECU_ADDRESS 0xFFF8EF84 /end MEASUREMENT
/begin MEASUREMENT iKupHysE.iDt1IEds.Pt1Si16.x "Filterwert" SLONG UMR___1_300_0_S6_S3 1 100 -7158278.82667 7158278.82333 DISPLAY_IDENTIFIER Pt1Si16.iDt1IEds.iKupHysE ECU_ADDRESS 0xFFF8EF8C /end MEASUREMENT
/begin MEASUREMENT iKupHysE.iDt1IEds.xp "Ableitung vom Eingangswert" SWORD UMR___1_1_0_S6_S3 1 100 -32768 32767 DISPLAY_IDENTIFIER iDt1IEds.iKupHysE ECU_ADDRESS 0xFFF8EF88 /end MEASUREMENT
/begin MEASUREMENT iKupHysE.iPt2IoKomp.x "Filterwert" FLOAT32_IEEE UMR___1_1_0_S6_S3 1 100 -2147483648 2147483647 FORMAT "%4.2" DISPLAY_IDENTIFIER x.iPt2IoKomp.iKupHysE ECU_ADDRESS 0xFFF8EF90 /end MEASUREMENT
/begin MEASUREMENT iKupHysE.iPt2IoKomp.xp "Ableitung vom Eingangswert" FLOAT32_IEEE UMR__SEC_1_1_0_S6_S3 1 100 -2147483648 2147483647 FORMAT "%4.2" DISPLAY_IDENTIFIER xp.iPt2IoKomp.iKupHysE ECU_ADDRESS 0xFFF8EF94 /end MEASUREMENT
/begin MEASUREMENT iKupHysE.iDt1Verz.Pt1Fl32.x "Filterwert" FLOAT32_IEEE UMR___1_1_0_S6_S3 1 100 -1000000000 1000000000 FORMAT "%4.2" DISPLAY_IDENTIFIER Pt1Fl32.iDt1Verz.iKupHysE ECU_ADDRESS 0xFFF8EF9C /end MEASUREMENT
/begin MEASUREMENT iKupHysE.iDt1Verz.xp "Ableitung vom Eingangswert" FLOAT32_IEEE UMR___1_1_0_S6_S3 1 100 -32768 32767 FORMAT "%4.2" DISPLAY_IDENTIFIER iDt1Verz.iKupHysE ECU_ADDRESS 0xFFF8EF98 /end MEASUREMENT
/begin MEASUREMENT iKupHysK0.iDt1PAbssoll.Pt1Fl32.x "Filterwert" FLOAT32_IEEE UMR___1_1_0_S6_S3 1 100 -1000000000 1000000000 FORMAT "%4.2" DISPLAY_IDENTIFIER Pt1Fl32.iDt1PAbssoll.iKupHysK0 ECU_ADDRESS 0xFFF8EFE0 /end MEASUREMENT
/begin MEASUREMENT iKupHysK0.iDt1PAbssoll.xp "Ableitung vom Eingangswert" FLOAT32_IEEE UMR___1_1_0_S6_S3 1 100 -32768 32767 FORMAT "%4.2" DISPLAY_IDENTIFIER iDt1PAbssoll.iKupHysK0 ECU_ADDRESS 0xFFF8EFDC /end MEASUREMENT
/begin MEASUREMENT iKupHysK0.iPt2MoKomp.x "Filterwert" FLOAT32_IEEE UMR___1_1_0_S6_S3 1 100 -2147483648 2147483647 FORMAT "%4.2" DISPLAY_IDENTIFIER x.iPt2MoKomp.iKupHysK0 ECU_ADDRESS 0xFFF8EFE4 /end MEASUREMENT
/begin MEASUREMENT iKupHysK0.iPt2MoKomp.xp "Ableitung vom Eingangswert" FLOAT32_IEEE UMR__SEC_1_1_0_S6_S3 1 100 -2147483648 2147483647 FORMAT "%4.2" DISPLAY_IDENTIFIER xp.iPt2MoKomp.iKupHysK0 ECU_ADDRESS 0xFFF8EFE8 /end MEASUREMENT
/begin MEASUREMENT iKupHysK0.iDt1IEds.Pt1Si16.x "Filterwert" SLONG UMR___1_300_0_S6_S3 1 100 -7158278.82667 7158278.82333 DISPLAY_IDENTIFIER Pt1Si16.iDt1IEds.iKupHysK0 ECU_ADDRESS 0xFFF8EFF0 /end MEASUREMENT
/begin MEASUREMENT iKupHysK0.iDt1IEds.xp "Ableitung vom Eingangswert" SWORD UMR___1_1_0_S6_S3 1 100 -32768 32767 DISPLAY_IDENTIFIER iDt1IEds.iKupHysK0 ECU_ADDRESS 0xFFF8EFEC /end MEASUREMENT
/begin MEASUREMENT iKupHysK0.iPt2IoKomp.x "Filterwert" FLOAT32_IEEE UMR___1_1_0_S6_S3 1 100 -2147483648 2147483647 FORMAT "%4.2" DISPLAY_IDENTIFIER x.iPt2IoKomp.iKupHysK0 ECU_ADDRESS 0xFFF8EFF4 /end MEASUREMENT
/begin MEASUREMENT iKupHysK0.iPt2IoKomp.xp "Ableitung vom Eingangswert" FLOAT32_IEEE UMR__SEC_1_1_0_S6_S3 1 100 -2147483648 2147483647 FORMAT "%4.2" DISPLAY_IDENTIFIER xp.iPt2IoKomp.iKupHysK0 ECU_ADDRESS 0xFFF8EFF8 /end MEASUREMENT
/begin MEASUREMENT iKupHysK0.iDt1Verz.Pt1Fl32.x "Filterwert" FLOAT32_IEEE UMR___1_1_0_S6_S3 1 100 -1000000000 1000000000 FORMAT "%4.2" DISPLAY_IDENTIFIER Pt1Fl32.iDt1Verz.iKupHysK0 ECU_ADDRESS 0xFFF8F000 /end MEASUREMENT
/begin MEASUREMENT iKupHysK0.iDt1Verz.xp "Ableitung vom Eingangswert" FLOAT32_IEEE UMR___1_1_0_S6_S3 1 100 -32768 32767 FORMAT "%4.2" DISPLAY_IDENTIFIER iDt1Verz.iKupHysK0 ECU_ADDRESS 0xFFF8EFFC /end MEASUREMENT
/begin MEASUREMENT iKupA.t_kpl_aktiv.timer "Der aktuelle Timerwert" ULONG UMR_MSEC__10_1_0_S6_S3 1 100 0 42949672950 DISPLAY_IDENTIFIER t_kpl_aktiv.iKupA ECU_ADDRESS 0xFFF8D294 /end MEASUREMENT
/begin MEASUREMENT iKupA.t_kpl_inaktiv.timer "Der aktuelle Timerwert" ULONG UMR_MSEC__10_1_0_S6_S3 1 100 0 42949672950 DISPLAY_IDENTIFIER t_kpl_inaktiv.iKupA ECU_ADDRESS 0xFFF8D298 /end MEASUREMENT
/begin MEASUREMENT iKupA.p_filter.fl_filter.x "Filterwert" FLOAT32_IEEE UMR___1_1_0_S6_S3 1 100 -1000000000 1000000000 FORMAT "%4.2" DISPLAY_IDENTIFIER fl_filter.p_filter.iKupA ECU_ADDRESS 0xFFF8D2A8 /end MEASUREMENT
/begin MEASUREMENT iKupA.p_filter.letzter_ms_timer "letzter BS-Timer" UWORD UMR_MSEC__1_1_0_S6_S3 1 100 0 65535 DISPLAY_IDENTIFIER letzter_ms_timer.p_filter.iKupA ECU_ADDRESS 0xFFF8D2A4 /end MEASUREMENT
/begin MEASUREMENT iKupA.zustandstimer.timer "Der aktuelle Timerwert" UWORD UMR_MSEC__1_1_0_S6_S3 1 100 0 65535 DISPLAY_IDENTIFIER zustandstimer.iKupA ECU_ADDRESS 0xFFF8D2AC /end MEASUREMENT
/begin MEASUREMENT iKupA.totzeit_abgelaufen.timer "Der aktuelle Timerwert" UWORD UMR_MSEC__1_1_0_S6_S3 1 100 0 65535 DISPLAY_IDENTIFIER totzeit_abgelaufen.iKupA ECU_ADDRESS 0xFFF8D2AE /end MEASUREMENT
/begin MEASUREMENT iKupA.timer_sas_ende_mit_pmax.timer "Der aktuelle Timerwert" UBYTE UMR_MSEC__10_1_0_S6_S3 1 100 0 2550 DISPLAY_IDENTIFIER timer_sas_ende_mit_pmax.iKupA ECU_ADDRESS 0xFFF8D2B0 /end MEASUREMENT
/begin MEASUREMENT iKupB.t_kpl_aktiv.timer "Der aktuelle Timerwert" ULONG UMR_MSEC__10_1_0_S6_S3 1 100 0 42949672950 DISPLAY_IDENTIFIER t_kpl_aktiv.iKupB ECU_ADDRESS 0xFFF8D2F8 /end MEASUREMENT
/begin MEASUREMENT iKupB.t_kpl_inaktiv.timer "Der aktuelle Timerwert" ULONG UMR_MSEC__10_1_0_S6_S3 1 100 0 42949672950 DISPLAY_IDENTIFIER t_kpl_inaktiv.iKupB ECU_ADDRESS 0xFFF8D2FC /end MEASUREMENT
/begin MEASUREMENT iKupB.p_filter.fl_filter.x "Filterwert" FLOAT32_IEEE UMR___1_1_0_S6_S3 1 100 -1000000000 1000000000 FORMAT "%4.2" DISPLAY_IDENTIFIER fl_filter.p_filter.iKupB ECU_ADDRESS 0xFFF8D30C /end MEASUREMENT
/begin MEASUREMENT iKupB.p_filter.letzter_ms_timer "letzter BS-Timer" UWORD UMR_MSEC__1_1_0_S6_S3 1 100 0 65535 DISPLAY_IDENTIFIER letzter_ms_timer.p_filter.iKupB ECU_ADDRESS 0xFFF8D308 /end MEASUREMENT
/begin MEASUREMENT iKupB.zustandstimer.timer "Der aktuelle Timerwert" UWORD UMR_MSEC__1_1_0_S6_S3 1 100 0 65535 DISPLAY_IDENTIFIER zustandstimer.iKupB ECU_ADDRESS 0xFFF8D310 /end MEASUREMENT
/begin MEASUREMENT iKupB.totzeit_abgelaufen.timer "Der aktuelle Timerwert" UWORD UMR_MSEC__1_1_0_S6_S3 1 100 0 65535 DISPLAY_IDENTIFIER totzeit_abgelaufen.iKupB ECU_ADDRESS 0xFFF8D312 /end MEASUREMENT
/begin MEASUREMENT iKupB.timer_sas_ende_mit_pmax.timer "Der aktuelle Timerwert" UBYTE UMR_MSEC__10_1_0_S6_S3 1 100 0 2550 DISPLAY_IDENTIFIER timer_sas_ende_mit_pmax.iKupB ECU_ADDRESS 0xFFF8D314 /end MEASUREMENT
/begin MEASUREMENT iKupC.t_kpl_aktiv.timer "Der aktuelle Timerwert" ULONG UMR_MSEC__10_1_0_S6_S3 1 100 0 42949672950 DISPLAY_IDENTIFIER t_kpl_aktiv.iKupC ECU_ADDRESS 0xFFF8D35C /end MEASUREMENT
/begin MEASUREMENT iKupC.t_kpl_inaktiv.timer "Der aktuelle Timerwert" ULONG UMR_MSEC__10_1_0_S6_S3 1 100 0 42949672950 DISPLAY_IDENTIFIER t_kpl_inaktiv.iKupC ECU_ADDRESS 0xFFF8D360 /end MEASUREMENT
/begin MEASUREMENT iKupC.p_filter.fl_filter.x "Filterwert" FLOAT32_IEEE UMR___1_1_0_S6_S3 1 100 -1000000000 1000000000 FORMAT "%4.2" DISPLAY_IDENTIFIER fl_filter.p_filter.iKupC ECU_ADDRESS 0xFFF8D370 /end MEASUREMENT
/begin MEASUREMENT iKupC.p_filter.letzter_ms_timer "letzter BS-Timer" UWORD UMR_MSEC__1_1_0_S6_S3 1 100 0 65535 DISPLAY_IDENTIFIER letzter_ms_timer.p_filter.iKupC ECU_ADDRESS 0xFFF8D36C /end MEASUREMENT
/begin MEASUREMENT iKupC.zustandstimer.timer "Der aktuelle Timerwert" UWORD UMR_MSEC__1_1_0_S6_S3 1 100 0 65535 DISPLAY_IDENTIFIER zustandstimer.iKupC ECU_ADDRESS 0xFFF8D374 /end MEASUREMENT
/begin MEASUREMENT iKupC.totzeit_abgelaufen.timer "Der aktuelle Timerwert" UWORD UMR_MSEC__1_1_0_S6_S3 1 100 0 65535 DISPLAY_IDENTIFIER totzeit_abgelaufen.iKupC ECU_ADDRESS 0xFFF8D376 /end MEASUREMENT
/begin MEASUREMENT iKupC.timer_sas_ende_mit_pmax.timer "Der aktuelle Timerwert" UBYTE UMR_MSEC__10_1_0_S6_S3 1 100 0 2550 DISPLAY_IDENTIFIER timer_sas_ende_mit_pmax.iKupC ECU_ADDRESS 0xFFF8D378 /end MEASUREMENT
/begin MEASUREMENT iKupD.t_kpl_aktiv.timer "Der aktuelle Timerwert" ULONG UMR_MSEC__10_1_0_S6_S3 1 100 0 42949672950 DISPLAY_IDENTIFIER t_kpl_aktiv.iKupD ECU_ADDRESS 0xFFF8D3C0 /end MEASUREMENT
/begin MEASUREMENT iKupD.t_kpl_inaktiv.timer "Der aktuelle Timerwert" ULONG UMR_MSEC__10_1_0_S6_S3 1 100 0 42949672950 DISPLAY_IDENTIFIER t_kpl_inaktiv.iKupD ECU_ADDRESS 0xFFF8D3C4 /end MEASUREMENT
/begin MEASUREMENT iKupD.p_filter.fl_filter.x "Filterwert" FLOAT32_IEEE UMR___1_1_0_S6_S3 1 100 -1000000000 1000000000 FORMAT "%4.2" DISPLAY_IDENTIFIER fl_filter.p_filter.iKupD ECU_ADDRESS 0xFFF8D3D4 /end MEASUREMENT
/begin MEASUREMENT iKupD.p_filter.letzter_ms_timer "letzter BS-Timer" UWORD UMR_MSEC__1_1_0_S6_S3 1 100 0 65535 DISPLAY_IDENTIFIER letzter_ms_timer.p_filter.iKupD ECU_ADDRESS 0xFFF8D3D0 /end MEASUREMENT
/begin MEASUREMENT iKupD.zustandstimer.timer "Der aktuelle Timerwert" UWORD UMR_MSEC__1_1_0_S6_S3 1 100 0 65535 DISPLAY_IDENTIFIER zustandstimer.iKupD ECU_ADDRESS 0xFFF8D3D8 /end MEASUREMENT
/begin MEASUREMENT iKupD.totzeit_abgelaufen.timer "Der aktuelle Timerwert" UWORD UMR_MSEC__1_1_0_S6_S3 1 100 0 65535 DISPLAY_IDENTIFIER totzeit_abgelaufen.iKupD ECU_ADDRESS 0xFFF8D3DA /end MEASUREMENT
/begin MEASUREMENT iKupD.timer_sas_ende_mit_pmax.timer "Der aktuelle Timerwert" UBYTE UMR_MSEC__10_1_0_S6_S3 1 100 0 2550 DISPLAY_IDENTIFIER timer_sas_ende_mit_pmax.iKupD ECU_ADDRESS 0xFFF8D3DC /end MEASUREMENT
/begin MEASUREMENT iKupE.t_kpl_aktiv.timer "Der aktuelle Timerwert" ULONG UMR_MSEC__10_1_0_S6_S3 1 100 0 42949672950 DISPLAY_IDENTIFIER t_kpl_aktiv.iKupE ECU_ADDRESS 0xFFF8D424 /end MEASUREMENT
/begin MEASUREMENT iKupE.t_kpl_inaktiv.timer "Der aktuelle Timerwert" ULONG UMR_MSEC__10_1_0_S6_S3 1 100 0 42949672950 DISPLAY_IDENTIFIER t_kpl_inaktiv.iKupE ECU_ADDRESS 0xFFF8D428 /end MEASUREMENT
/begin MEASUREMENT iKupE.p_filter.fl_filter.x "Filterwert" FLOAT32_IEEE UMR___1_1_0_S6_S3 1 100 -1000000000 1000000000 FORMAT "%4.2" DISPLAY_IDENTIFIER fl_filter.p_filter.iKupE ECU_ADDRESS 0xFFF8D438 /end MEASUREMENT
/begin MEASUREMENT iKupE.p_filter.letzter_ms_timer "letzter BS-Timer" UWORD UMR_MSEC__1_1_0_S6_S3 1 100 0 65535 DISPLAY_IDENTIFIER letzter_ms_timer.p_filter.iKupE ECU_ADDRESS 0xFFF8D434 /end MEASUREMENT
/begin MEASUREMENT iKupE.zustandstimer.timer "Der aktuelle Timerwert" UWORD UMR_MSEC__1_1_0_S6_S3 1 100 0 65535 DISPLAY_IDENTIFIER zustandstimer.iKupE ECU_ADDRESS 0xFFF8D43C /end MEASUREMENT
/begin MEASUREMENT iKupE.totzeit_abgelaufen.timer "Der aktuelle Timerwert" UWORD UMR_MSEC__1_1_0_S6_S3 1 100 0 65535 DISPLAY_IDENTIFIER totzeit_abgelaufen.iKupE ECU_ADDRESS 0xFFF8D43E /end MEASUREMENT
/begin MEASUREMENT iKupE.timer_sas_ende_mit_pmax.timer "Der aktuelle Timerwert" UBYTE UMR_MSEC__10_1_0_S6_S3 1 100 0 2550 DISPLAY_IDENTIFIER timer_sas_ende_mit_pmax.iKupE ECU_ADDRESS 0xFFF8D440 /end MEASUREMENT
/begin MEASUREMENT iKupK0.t_kpl_aktiv.timer "Der aktuelle Timerwert" ULONG UMR_MSEC__10_1_0_S6_S3 1 100 0 42949672950 DISPLAY_IDENTIFIER t_kpl_aktiv.iKupK0 ECU_ADDRESS 0xFFF8D488 /end MEASUREMENT
/begin MEASUREMENT iKupK0.t_kpl_inaktiv.timer "Der aktuelle Timerwert" ULONG UMR_MSEC__10_1_0_S6_S3 1 100 0 42949672950 DISPLAY_IDENTIFIER t_kpl_inaktiv.iKupK0 ECU_ADDRESS 0xFFF8D48C /end MEASUREMENT
/begin MEASUREMENT iKupK0.p_filter.fl_filter.x "Filterwert" FLOAT32_IEEE UMR___1_1_0_S6_S3 1 100 -1000000000 1000000000 FORMAT "%4.2" DISPLAY_IDENTIFIER fl_filter.p_filter.iKupK0 ECU_ADDRESS 0xFFF8D49C /end MEASUREMENT
/begin MEASUREMENT iKupK0.p_filter.letzter_ms_timer "letzter BS-Timer" UWORD UMR_MSEC__1_1_0_S6_S3 1 100 0 65535 DISPLAY_IDENTIFIER letzter_ms_timer.p_filter.iKupK0 ECU_ADDRESS 0xFFF8D498 /end MEASUREMENT
/begin MEASUREMENT iKupK0.zustandstimer.timer "Der aktuelle Timerwert" UWORD UMR_MSEC__1_1_0_S6_S3 1 100 0 65535 DISPLAY_IDENTIFIER zustandstimer.iKupK0 ECU_ADDRESS 0xFFF8D4A0 /end MEASUREMENT
/begin MEASUREMENT iKupK0.totzeit_abgelaufen.timer "Der aktuelle Timerwert" UWORD UMR_MSEC__1_1_0_S6_S3 1 100 0 65535 DISPLAY_IDENTIFIER totzeit_abgelaufen.iKupK0 ECU_ADDRESS 0xFFF8D4A2 /end MEASUREMENT
/begin MEASUREMENT iKupK0.timer_sas_ende_mit_pmax.timer "Der aktuelle Timerwert" UBYTE UMR_MSEC__10_1_0_S6_S3 1 100 0 2550 DISPLAY_IDENTIFIER timer_sas_ende_mit_pmax.iKupK0 ECU_ADDRESS 0xFFF8D4A4 /end MEASUREMENT
/begin MEASUREMENT iModKupSfktK0.pgo_sf_rampe.cBibRampeGradSi16._.letzter_wert "Speichert den letzten Eingangswert" FLOAT32_IEEE UMR___1_1_0_S6_S3 1 100 -1E+037 1E+037 FORMAT "%4.2" DISPLAY_IDENTIFIER letzter_wert._.cBibRampeGradSi16.pgo_sf_rampe.iModKupSfktK0 ECU_ADDRESS 0xFFF8F008 /end MEASUREMENT
/begin MEASUREMENT iModKupSfktK0.pgo_sf_rampe.cBibRampeGradSi16._.letzter_ms_timer "Speichert den letzten BS-Timer" UWORD UMR_MSEC__1_1_0_S6_S3 1 100 0 65535 DISPLAY_IDENTIFIER letzter_ms_timer._.cBibRampeGradSi16.pgo_sf_rampe.iModKupSfktK0 ECU_ADDRESS 0xFFF8F00C /end MEASUREMENT
/begin MEASUREMENT iModKupSfktK0.pgo_sf_rampe.cBibRampeGradSi16._.minimum "Minimum Begrenzung" FLOAT32_IEEE UMR___1_1_0_S6_S3 1 100 -1E+037 1E+037 FORMAT "%4.2" DISPLAY_IDENTIFIER minimum._.cBibRampeGradSi16.pgo_sf_rampe.iModKupSfktK0 ECU_ADDRESS 0xFFF8F010 /end MEASUREMENT
/begin MEASUREMENT iModKupSfktK0.pgo_sf_rampe.cBibRampeGradSi16._.maximum "Maximum Begrenzung" FLOAT32_IEEE UMR___1_1_0_S6_S3 1 100 -1E+037 1E+037 FORMAT "%4.2" DISPLAY_IDENTIFIER maximum._.cBibRampeGradSi16.pgo_sf_rampe.iModKupSfktK0 ECU_ADDRESS 0xFFF8F014 /end MEASUREMENT
/begin MEASUREMENT iAdaPulzs.iHsv.iAbbruch.timer "Der aktuelle Timerwert" UWORD UMR_MSEC__10_1_0_S6_S3 1 100 0 655350 DISPLAY_IDENTIFIER iAbbruch.iHsv.iAdaPulzs ECU_ADDRESS 0xFFF8C128 /end MEASUREMENT
/begin MEASUREMENT iAdaPulzs.iBew.iFensterNeg.iTimerStarten.timer "Der aktuelle Timerwert" UBYTE UMR_MSEC__10_1_0_S6_S3 1 100 0 2550 DISPLAY_IDENTIFIER iTimerStarten.iFensterNeg.iBew.iAdaPulzs ECU_ADDRESS 0xFFF8C134 /end MEASUREMENT
/begin MEASUREMENT iAdaPulzs.iBew.iFensterNeg.iTimerBeenden.timer "Der aktuelle Timerwert" UBYTE UMR_MSEC__10_1_0_S6_S3 1 100 0 2550 DISPLAY_IDENTIFIER iTimerBeenden.iFensterNeg.iBew.iAdaPulzs ECU_ADDRESS 0xFFF8C135 /end MEASUREMENT
/begin MEASUREMENT iAdaPulzs.iBew.iFensterPos.iTimerStarten.timer "Der aktuelle Timerwert" UBYTE UMR_MSEC__10_1_0_S6_S3 1 100 0 2550 DISPLAY_IDENTIFIER iTimerStarten.iFensterPos.iBew.iAdaPulzs ECU_ADDRESS 0xFFF8C139 /end MEASUREMENT
/begin MEASUREMENT iAdaPulzs.iBew.iFensterPos.iTimerBeenden.timer "Der aktuelle Timerwert" UBYTE UMR_MSEC__10_1_0_S6_S3 1 100 0 2550 DISPLAY_IDENTIFIER iTimerBeenden.iFensterPos.iBew.iAdaPulzs ECU_ADDRESS 0xFFF8C13A /end MEASUREMENT
/begin MEASUREMENT iAdaPulzs.iBew.iTimerAmp.timer "Der aktuelle Timerwert" UBYTE UMR_MSEC__10_1_0_S6_S3 1 100 0 2550 DISPLAY_IDENTIFIER iTimerAmp.iBew.iAdaPulzs ECU_ADDRESS 0xFFF8C13E /end MEASUREMENT
/begin MEASUREMENT iAdaPulzs.iPf.iZustandstimer.timer "Der aktuelle Timerwert" UWORD UMR_MSEC__10_1_0_S6_S3 1 100 0 655350 DISPLAY_IDENTIFIER iZustandstimer.iPf.iAdaPulzs ECU_ADDRESS 0xFFF8C168 /end MEASUREMENT
/begin MEASUREMENT iAdaPulzs.iZustandstimer.timer "Der aktuelle Timerwert" UWORD UMR_MSEC__10_1_0_S6_S3 1 100 0 655350 DISPLAY_IDENTIFIER iZustandstimer.iAdaPulzs ECU_ADDRESS 0xFFF8C170 /end MEASUREMENT
/begin MEASUREMENT iAdaPulzs.iTimerSpzNRea.timer "Der aktuelle Timerwert" UWORD UMR_MSEC__10_1_0_S6_S3 1 100 0 655350 DISPLAY_IDENTIFIER iTimerSpzNRea.iAdaPulzs ECU_ADDRESS 0xFFF8C172 /end MEASUREMENT
/begin MEASUREMENT iAdaPulzs.iTimerDeakDaempfer.timer "Der aktuelle Timerwert" UWORD UMR_MSEC__10_1_0_S6_S3 1 100 0 655350 DISPLAY_IDENTIFIER iTimerDeakDaempfer.iAdaPulzs ECU_ADDRESS 0xFFF8C174 /end MEASUREMENT
/begin MEASUREMENT iAdaPfusf.n_f_alt.n_f "letzter Wert" SLONG UMR___1_1_0_S6_S3 1 100 -2147483648 2147483647 DISPLAY_IDENTIFIER n_f.n_f_alt.iAdaPfusf ECU_ADDRESS 0xFFF8C014 /end MEASUREMENT
/begin MEASUREMENT iAdaPfusf.n_f_alt.letzter_ms_timer "letzter Timerwert" UWORD UMR___1_1_0_S6_S3 1 100 0 65535 DISPLAY_IDENTIFIER letzter_ms_timer.n_f_alt.iAdaPfusf ECU_ADDRESS 0xFFF8C018 /end MEASUREMENT
/begin MEASUREMENT iAdaPstSysNmot.timer_nmotleersoll_aktiv_stada.timer "Der aktuelle Timerwert" UWORD UMR_MSEC__10_1_0_S6_S3 1 100 0 655350 DISPLAY_IDENTIFIER timer_nmotleersoll_aktiv_stada.iAdaPstSysNmot ECU_ADDRESS 0xFFF8A066 /end MEASUREMENT
/begin MEASUREMENT iAdaPstzs.iBew.iFensterNeg.iTimerStarten.timer "Der aktuelle Timerwert" UBYTE UMR_MSEC__10_1_0_S6_S3 1 100 0 2550 DISPLAY_IDENTIFIER iTimerStarten.iFensterNeg.iBew.iAdaPstzs ECU_ADDRESS 0xFFF8C020 /end MEASUREMENT
/begin MEASUREMENT iAdaPstzs.iBew.iFensterNeg.iTimerBeenden.timer "Der aktuelle Timerwert" UBYTE UMR_MSEC__10_1_0_S6_S3 1 100 0 2550 DISPLAY_IDENTIFIER iTimerBeenden.iFensterNeg.iBew.iAdaPstzs ECU_ADDRESS 0xFFF8C021 /end MEASUREMENT
/begin MEASUREMENT iAdaPstzs.iBew.iFensterPos.iTimerStarten.timer "Der aktuelle Timerwert" UBYTE UMR_MSEC__10_1_0_S6_S3 1 100 0 2550 DISPLAY_IDENTIFIER iTimerStarten.iFensterPos.iBew.iAdaPstzs ECU_ADDRESS 0xFFF8C025 /end MEASUREMENT
/begin MEASUREMENT iAdaPstzs.iBew.iFensterPos.iTimerBeenden.timer "Der aktuelle Timerwert" UBYTE UMR_MSEC__10_1_0_S6_S3 1 100 0 2550 DISPLAY_IDENTIFIER iTimerBeenden.iFensterPos.iBew.iAdaPstzs ECU_ADDRESS 0xFFF8C026 /end MEASUREMENT
/begin MEASUREMENT iAdaPstzs.iBew.iTimerAmp.timer "Der aktuelle Timerwert" UBYTE UMR_MSEC__10_1_0_S6_S3 1 100 0 2550 DISPLAY_IDENTIFIER iTimerAmp.iBew.iAdaPstzs ECU_ADDRESS 0xFFF8C02A /end MEASUREMENT
/begin MEASUREMENT iAdaPstzs.iPf.iZustandstimerStada.timer "Der aktuelle Timerwert" UWORD UMR_MSEC__10_1_0_S6_S3 1 100 0 655350 DISPLAY_IDENTIFIER iZustandstimerStada.iPf.iAdaPstzs ECU_ADDRESS 0xFFF8C05C /end MEASUREMENT
/begin MEASUREMENT iAdaPstzs.iPre.iZustandstimerStada.timer "Der aktuelle Timerwert" UWORD UMR_MSEC__10_1_0_S6_S3 1 100 0 655350 DISPLAY_IDENTIFIER iZustandstimerStada.iPre.iAdaPstzs ECU_ADDRESS 0xFFF8C074 /end MEASUREMENT
/begin MEASUREMENT iAdaPstzs.iPre.iRampeAb.letzter_wert "Speichert den letzten Eingangswert" SLONG UMR___1_1_0_S6_S3 1 100 -2147483648 2147483647 DISPLAY_IDENTIFIER letzter_wert.iRampeAb.iPre.iAdaPstzs ECU_ADDRESS 0xFFF8C078 /end MEASUREMENT
/begin MEASUREMENT iAdaPstzs.iPre.iRampeAb.letzter_timer "Speichert den letzten BS-Timer" UWORD UMR_SEC__1_1_0_S6_S3 1 100 0 255 DISPLAY_IDENTIFIER letzter_timer.iRampeAb.iPre.iAdaPstzs ECU_ADDRESS 0xFFF8C07C /end MEASUREMENT
/begin MEASUREMENT iAdaPstzs.iPre.iRampeAuf.letzter_wert "Speichert den letzten Eingangswert" FLOAT32_IEEE UMR___1_1_0_S6_S3 1 100 -1E+037 1E+037 FORMAT "%4.2" DISPLAY_IDENTIFIER letzter_wert.iRampeAuf.iPre.iAdaPstzs ECU_ADDRESS 0xFFF8C080 /end MEASUREMENT
/begin MEASUREMENT iAdaPstzs.iPre.iRampeAuf.letzter_ms_timer "Speichert den letzten BS-Timer" UWORD UMR_MSEC__1_1_0_S6_S3 1 100 0 65535 DISPLAY_IDENTIFIER letzter_ms_timer.iRampeAuf.iPre.iAdaPstzs ECU_ADDRESS 0xFFF8C084 /end MEASUREMENT
/begin MEASUREMENT iAdaPstzs.iPre.iRampeAuf.minimum "Minimum Begrenzung" FLOAT32_IEEE UMR___1_1_0_S6_S3 1 100 -1E+037 1E+037 FORMAT "%4.2" DISPLAY_IDENTIFIER minimum.iRampeAuf.iPre.iAdaPstzs ECU_ADDRESS 0xFFF8C088 /end MEASUREMENT
/begin MEASUREMENT iAdaPstzs.iPre.iRampeAuf.maximum "Maximum Begrenzung" FLOAT32_IEEE UMR___1_1_0_S6_S3 1 100 -1E+037 1E+037 FORMAT "%4.2" DISPLAY_IDENTIFIER maximum.iRampeAuf.iPre.iAdaPstzs ECU_ADDRESS 0xFFF8C08C /end MEASUREMENT
/begin MEASUREMENT iAdaPstzs.iZustandstimerStada.timer "Der aktuelle Timerwert" UWORD UMR_MSEC__10_1_0_S6_S3 1 100 0 655350 DISPLAY_IDENTIFIER iZustandstimerStada.iAdaPstzs ECU_ADDRESS 0xFFF8C0A8 /end MEASUREMENT
/begin MEASUREMENT iAdaPstzs.iTMaxInitStada.timer "Der aktuelle Timerwert" ULONG UMR_MSEC__10_1_0_S6_S3 1 100 0 42949672950 DISPLAY_IDENTIFIER iTMaxInitStada.iAdaPstzs ECU_ADDRESS 0xFFF8C0AC /end MEASUREMENT
/begin MEASUREMENT iAdaUrlufterkSchaltung.iSignal.iPt1.x "Filterwert" SLONG UMR___1_300_0_S6_S3 1 100 -7158278.82667 7158278.82333 DISPLAY_IDENTIFIER iPt1.iSignal.iAdaUrlufterkSchaltung ECU_ADDRESS 0xFFF8C840 /end MEASUREMENT
/begin MEASUREMENT iAdaUrlufterkSchaltung.iZeitfenster.timer "Der aktuelle Timerwert" UBYTE UMR_MSEC__10_1_0_S6_S3 1 100 0 2550 DISPLAY_IDENTIFIER iZeitfenster.iAdaUrlufterkSchaltung ECU_ADDRESS 0xFFF8C844 /end MEASUREMENT
/begin MEASUREMENT iAdaUrlufterkPuls.iZeitfenster.timer "Der aktuelle Timerwert" UBYTE UMR_MSEC__10_1_0_S6_S3 1 100 0 2550 DISPLAY_IDENTIFIER iZeitfenster.iAdaUrlufterkPuls ECU_ADDRESS 0xFFF8A097 /end MEASUREMENT
/begin MEASUREMENT iAdaGlosc.FiAxRefAdaOff.x "Filterwert" SLONG UMR___1_300_0_S6_S3 1 100 -7158278.82667 7158278.82333 DISPLAY_IDENTIFIER FiAxRefAdaOff.iAdaGlosc ECU_ADDRESS 0xFFF8BF98 /end MEASUREMENT
/begin MEASUREMENT iAdaIaeApKorr.TimerAdaIaeApKorr.time "Zeit des Timers" UWORD UMR_SEC__1_100_0_S6_S3 1 100 0 655.35 DISPLAY_IDENTIFIER TimerAdaIaeApKorr.iAdaIaeApKorr ECU_ADDRESS 0xFFF8C7D2 /end MEASUREMENT
/begin MEASUREMENT iAdaIaeApKorr.TimerMaxWartenAdaIaeApKorr.time "Zeit des Timers" UWORD UMR_SEC__1_100_0_S6_S3 1 100 0 655.35 DISPLAY_IDENTIFIER TimerMaxWartenAdaIaeApKorr.iAdaIaeApKorr ECU_ADDRESS 0xFFF8C7D4 /end MEASUREMENT
/begin MEASUREMENT iAdaIaeApKorr.FiNMotAdaIae.x "Filterwert" SLONG UMR___1_300_0_S6_S3 1 100 -7158278.82667 7158278.82333 DISPLAY_IDENTIFIER FiNMotAdaIae.iAdaIaeApKorr ECU_ADDRESS 0xFFF8C7D8 /end MEASUREMENT
/begin MEASUREMENT iAdaIaeApKorr.FiMMotIstAdaIae.x "Filterwert" SLONG UMR___1_300_0_S6_S3 1 100 -7158278.82667 7158278.82333 DISPLAY_IDENTIFIER FiMMotIstAdaIae.iAdaIaeApKorr ECU_ADDRESS 0xFFF8C7DC /end MEASUREMENT
/begin MEASUREMENT iAdaIaeApKorr.FiNMotAdaIaeFloat.x "Filterwert" FLOAT32_IEEE UMR___1_1_0_S6_S3 1 100 -1000000000 1000000000 FORMAT "%4.2" DISPLAY_IDENTIFIER FiNMotAdaIaeFloat.iAdaIaeApKorr ECU_ADDRESS 0xFFF8C7E0 /end MEASUREMENT
/begin MEASUREMENT iAdaIaeApKorr.FiMMotIstAdaIaeFloat.x "Filterwert" FLOAT32_IEEE UMR___1_1_0_S6_S3 1 100 -1000000000 1000000000 FORMAT "%4.2" DISPLAY_IDENTIFIER FiMMotIstAdaIaeFloat.iAdaIaeApKorr ECU_ADDRESS 0xFFF8C7E4 /end MEASUREMENT
/begin MEASUREMENT iAdaIaeApKorr.FiNGMotAdaIae.x "Filterwert" FLOAT32_IEEE UMR___1_1_0_S6_S3 1 100 -2147483648 2147483647 FORMAT "%4.2" DISPLAY_IDENTIFIER x.FiNGMotAdaIae.iAdaIaeApKorr ECU_ADDRESS 0xFFF8C7E8 /end MEASUREMENT
/begin MEASUREMENT iAdaIaeApKorr.FiNGMotAdaIae.xp "Ableitung vom Eingangswert" FLOAT32_IEEE UMR__SEC_1_1_0_S6_S3 1 100 -2147483648 2147483647 FORMAT "%4.2" DISPLAY_IDENTIFIER xp.FiNGMotAdaIae.iAdaIaeApKorr ECU_ADDRESS 0xFFF8C7EC /end MEASUREMENT
/begin MEASUREMENT iAdaIaeApKorr.FiMGMotIstAdaIae.x "Filterwert" FLOAT32_IEEE UMR___1_1_0_S6_S3 1 100 -2147483648 2147483647 FORMAT "%4.2" DISPLAY_IDENTIFIER x.FiMGMotIstAdaIae.iAdaIaeApKorr ECU_ADDRESS 0xFFF8C7F0 /end MEASUREMENT
/begin MEASUREMENT iAdaIaeApKorr.FiMGMotIstAdaIae.xp "Ableitung vom Eingangswert" FLOAT32_IEEE UMR__SEC_1_1_0_S6_S3 1 100 -2147483648 2147483647 FORMAT "%4.2" DISPLAY_IDENTIFIER xp.FiMGMotIstAdaIae.iAdaIaeApKorr ECU_ADDRESS 0xFFF8C7F4 /end MEASUREMENT
/begin MEASUREMENT iAdaIaeApIae.TimerMaxWartenAdaIae.time "Zeit des Timers" UWORD UMR_SEC__1_100_0_S6_S3 1 100 0 655.35 DISPLAY_IDENTIFIER TimerMaxWartenAdaIae.iAdaIaeApIae ECU_ADDRESS 0xFFF8BFC6 /end MEASUREMENT
/begin MEASUREMENT iAdaIaeApIae.TimerAdaIae.time "Zeit des Timers" UWORD UMR_SEC__1_100_0_S6_S3 1 100 0 655.35 DISPLAY_IDENTIFIER TimerAdaIae.iAdaIaeApIae ECU_ADDRESS 0xFFF8BFC8 /end MEASUREMENT
/begin MEASUREMENT iAdaIaeApIae.TimerKriterienAdaIae.time "Zeit des Timers" UWORD UMR_SEC__1_100_0_S6_S3 1 100 0 655.35 DISPLAY_IDENTIFIER TimerKriterienAdaIae.iAdaIaeApIae ECU_ADDRESS 0xFFF8BFCA /end MEASUREMENT
/begin MEASUREMENT iAdaIaeApIae.RampeAdaIae.letzter_wert "Speichert den letzten Eingangswert" FLOAT32_IEEE UMR___1_1_0_S6_S3 1 100 -1E+037 1E+037 FORMAT "%4.2" DISPLAY_IDENTIFIER letzter_wert.RampeAdaIae.iAdaIaeApIae ECU_ADDRESS 0xFFF8BFCC /end MEASUREMENT
/begin MEASUREMENT iAdaIaeApIae.RampeAdaIae.letzter_ms_timer "Speichert den letzten BS-Timer" UWORD UMR_MSEC__1_1_0_S6_S3 1 100 0 65535 DISPLAY_IDENTIFIER letzter_ms_timer.RampeAdaIae.iAdaIaeApIae ECU_ADDRESS 0xFFF8BFD0 /end MEASUREMENT
/begin MEASUREMENT iAdaIaeApIae.RampeAdaIae.minimum "Minimum Begrenzung" FLOAT32_IEEE UMR___1_1_0_S6_S3 1 100 -1E+037 1E+037 FORMAT "%4.2" DISPLAY_IDENTIFIER minimum.RampeAdaIae.iAdaIaeApIae ECU_ADDRESS 0xFFF8BFD4 /end MEASUREMENT
/begin MEASUREMENT iAdaIaeApIae.RampeAdaIae.maximum "Maximum Begrenzung" FLOAT32_IEEE UMR___1_1_0_S6_S3 1 100 -1E+037 1E+037 FORMAT "%4.2" DISPLAY_IDENTIFIER maximum.RampeAdaIae.iAdaIaeApIae ECU_ADDRESS 0xFFF8BFD8 /end MEASUREMENT
/begin MEASUREMENT iAdaIaeApIep.TimerAdaIaeApIep.time "Zeit des Timers" UWORD UMR_SEC__1_100_0_S6_S3 1 100 0 655.35 DISPLAY_IDENTIFIER TimerAdaIaeApIep.iAdaIaeApIep ECU_ADDRESS 0xFFF8C79A /end MEASUREMENT
/begin MEASUREMENT iAdaIaeApIep.TimerAdaIaeApIepMaxAbsenken.time "Zeit des Timers" UWORD UMR_SEC__1_100_0_S6_S3 1 100 0 655.35 DISPLAY_IDENTIFIER TimerAdaIaeApIepMaxAbsenken.iAdaIaeApIep ECU_ADDRESS 0xFFF8C79C /end MEASUREMENT
/begin MEASUREMENT iKasEkopl.TimerZEkopl.time "Zeit des Timers" UWORD UMR_SEC__1_100_0_S6_S3 1 100 0 655.35 DISPLAY_IDENTIFIER time.TimerZEkopl.iKasEkopl ECU_ADDRESS 0xFFF8ED9E /end MEASUREMENT
/begin MEASUREMENT iKasEkopl.TimerZEkopl.maxtime "Endzeit" UWORD UMR_SEC__1_100_0_S6_S3 1 100 0 655.35 DISPLAY_IDENTIFIER maxtime.TimerZEkopl.iKasEkopl ECU_ADDRESS 0xFFF8EDA0 /end MEASUREMENT
/begin MEASUREMENT iKasEkopl.TimerSchlEkop.time "Zeit des Timers" UWORD UMR_SEC__1_100_0_S6_S3 1 100 0 655.35 DISPLAY_IDENTIFIER time.TimerSchlEkop.iKasEkopl ECU_ADDRESS 0xFFF8EDA2 /end MEASUREMENT
/begin MEASUREMENT iKasEkopl.TimerSchlEkop.maxtime "Endzeit" UWORD UMR_SEC__1_100_0_S6_S3 1 100 0 655.35 DISPLAY_IDENTIFIER maxtime.TimerSchlEkop.iKasEkopl ECU_ADDRESS 0xFFF8EDA4 /end MEASUREMENT
/begin MEASUREMENT iKasEkopl.Pt1MoEntkoppl.x "Filterwert" SLONG UMR___1_300_0_S6_S3 1 100 -7158278.82667 7158278.82333 DISPLAY_IDENTIFIER Pt1MoEntkoppl.iKasEkopl ECU_ADDRESS 0xFFF8EDA8 /end MEASUREMENT
/begin MEASUREMENT iIaeKordi.TimerZIae.time "Zeit des Timers" UWORD UMR_SEC__1_100_0_S6_S3 1 100 0 655.35 DISPLAY_IDENTIFIER time.TimerZIae.iIaeKordi ECU_ADDRESS 0xFFF8A0FA /end MEASUREMENT
/begin MEASUREMENT iIaeKordi.TimerZIae.maxtime "Endzeit" UWORD UMR_SEC__1_100_0_S6_S3 1 100 0 655.35 DISPLAY_IDENTIFIER maxtime.TimerZIae.iIaeKordi ECU_ADDRESS 0xFFF8A0FC /end MEASUREMENT
/begin MEASUREMENT iIaeAdauf.iTLaufUefiae.timer "Der aktuelle Timerwert" UBYTE UMR_MSEC__10_1_0_S6_S3 1 100 0 2550 DISPLAY_IDENTIFIER iTLaufUefiae.iIaeAdauf ECU_ADDRESS 0xFFF8A0EF /end MEASUREMENT
/begin MEASUREMENT iIaeDraus.TimerHysSchl.time "Zeit des Timers" UWORD UMR_SEC__1_100_0_S6_S3 1 100 0 655.35 DISPLAY_IDENTIFIER time.TimerHysSchl.iIaeDraus ECU_ADDRESS 0xFFF8CF2E /end MEASUREMENT
/begin MEASUREMENT iIaeDraus.TimerHysSchl.maxtime "Endzeit" UWORD UMR_SEC__1_100_0_S6_S3 1 100 0 655.35 DISPLAY_IDENTIFIER maxtime.TimerHysSchl.iIaeDraus ECU_ADDRESS 0xFFF8CF30 /end MEASUREMENT
/begin MEASUREMENT iIaeDraus.TimerHyskompan.time "Zeit des Timers" UWORD UMR_SEC__1_100_0_S6_S3 1 100 0 655.35 DISPLAY_IDENTIFIER time.TimerHyskompan.iIaeDraus ECU_ADDRESS 0xFFF8CF32 /end MEASUREMENT
/begin MEASUREMENT iIaeDraus.TimerHyskompan.maxtime "Endzeit" UWORD UMR_SEC__1_100_0_S6_S3 1 100 0 655.35 DISPLAY_IDENTIFIER maxtime.TimerHyskompan.iIaeDraus ECU_ADDRESS 0xFFF8CF34 /end MEASUREMENT
/begin MEASUREMENT iIaeDraus.TimerPoDyn.time "Zeit des Timers" UWORD UMR_SEC__1_100_0_S6_S3 1 100 0 655.35 DISPLAY_IDENTIFIER time.TimerPoDyn.iIaeDraus ECU_ADDRESS 0xFFF8CF36 /end MEASUREMENT
/begin MEASUREMENT iIaeDraus.TimerPoDyn.maxtime "Endzeit" UWORD UMR_SEC__1_100_0_S6_S3 1 100 0 655.35 DISPLAY_IDENTIFIER maxtime.TimerPoDyn.iIaeDraus ECU_ADDRESS 0xFFF8CF38 /end MEASUREMENT
/begin MEASUREMENT iIaeDraus.Dt1PGStell.Pt1Si16.x "Filterwert" SLONG UMR___1_300_0_S6_S3 1 100 -7158278.82667 7158278.82333 DISPLAY_IDENTIFIER Pt1Si16.Dt1PGStell.iIaeDraus ECU_ADDRESS 0xFFF8CF40 /end MEASUREMENT
/begin MEASUREMENT iIaeDraus.Dt1PGStell.xp "Ableitung vom Eingangswert" SWORD UMR___1_1_0_S6_S3 1 100 -32768 32767 DISPLAY_IDENTIFIER Dt1PGStell.iIaeDraus ECU_ADDRESS 0xFFF8CF3C /end MEASUREMENT
/begin MEASUREMENT iIaeDraus.Pt1PDStellHysS.x "Filterwert" SLONG UMR___1_300_0_S6_S3 1 100 -7158278.82667 7158278.82333 DISPLAY_IDENTIFIER Pt1PDStellHysS.iIaeDraus ECU_ADDRESS 0xFFF8CF44 /end MEASUREMENT
/begin MEASUREMENT iIaeDraus.Pt1PoHysKo.x "Filterwert" SLONG UMR___1_300_0_S6_S3 1 100 -7158278.82667 7158278.82333 DISPLAY_IDENTIFIER Pt1PoHysKo.iIaeDraus ECU_ADDRESS 0xFFF8CF48 /end MEASUREMENT
/begin MEASUREMENT iIaeDraus.Pt1PoDyn.x "Filterwert" SLONG UMR___1_300_0_S6_S3 1 100 -7158278.82667 7158278.82333 DISPLAY_IDENTIFIER Pt1PoDyn.iIaeDraus ECU_ADDRESS 0xFFF8CF4C /end MEASUREMENT
/begin MEASUREMENT iIaeDraus.Pt1Mue.x "Filterwert" SLONG UMR___1_300_0_S6_S3 1 100 -7158278.82667 7158278.82333 DISPLAY_IDENTIFIER Pt1Mue.iIaeDraus ECU_ADDRESS 0xFFF8CF50 /end MEASUREMENT
/begin MEASUREMENT iIaeDraus.Pt1PStellbasis.x "Filterwert" SLONG UMR___1_300_0_S6_S3 1 100 -7158278.82667 7158278.82333 DISPLAY_IDENTIFIER Pt1PStellbasis.iIaeDraus ECU_ADDRESS 0xFFF8CF54 /end MEASUREMENT
/begin MEASUREMENT iIaeDraus.Pt2PIst.x "Filterwert" FLOAT32_IEEE UMR___1_1_0_S6_S3 1 100 -2147483648 2147483647 FORMAT "%4.2" DISPLAY_IDENTIFIER x.Pt2PIst.iIaeDraus ECU_ADDRESS 0xFFF8CF58 /end MEASUREMENT
/begin MEASUREMENT iIaeDraus.Pt2PIst.xp "Ableitung vom Eingangswert" FLOAT32_IEEE UMR__SEC_1_1_0_S6_S3 1 100 -2147483648 2147483647 FORMAT "%4.2" DISPLAY_IDENTIFIER xp.Pt2PIst.iIaeDraus ECU_ADDRESS 0xFFF8CF5C /end MEASUREMENT
/begin MEASUREMENT iIaeSigna.Pt1JAnfahrtIae.x "Filterwert" SLONG UMR___1_300_0_S6_S3 1 100 -7158278.82667 7158278.82333 DISPLAY_IDENTIFIER Pt1JAnfahrtIae.iIaeSigna ECU_ADDRESS 0xFFF8D13C /end MEASUREMENT
/begin MEASUREMENT iIaeSigna.Dt1Pbremsg.Pt1Si16.x "Filterwert" SLONG UMR___1_300_0_S6_S3 1 100 -7158278.82667 7158278.82333 DISPLAY_IDENTIFIER Pt1Si16.Dt1Pbremsg.iIaeSigna ECU_ADDRESS 0xFFF8D144 /end MEASUREMENT
/begin MEASUREMENT iIaeSigna.Dt1Pbremsg.xp "Ableitung vom Eingangswert" SWORD UMR___1_1_0_S6_S3 1 100 -32768 32767 DISPLAY_IDENTIFIER Dt1Pbremsg.iIaeSigna ECU_ADDRESS 0xFFF8D140 /end MEASUREMENT
/begin MEASUREMENT iIaeSigna.Dt1Dkig.Pt1Si16.x "Filterwert" SLONG UMR___1_300_0_S6_S3 1 100 -7158278.82667 7158278.82333 DISPLAY_IDENTIFIER Pt1Si16.Dt1Dkig.iIaeSigna ECU_ADDRESS 0xFFF8D14C /end MEASUREMENT
/begin MEASUREMENT iIaeSigna.Dt1Dkig.xp "Ableitung vom Eingangswert" SWORD UMR___1_1_0_S6_S3 1 100 -32768 32767 DISPLAY_IDENTIFIER Dt1Dkig.iIaeSigna ECU_ADDRESS 0xFFF8D148 /end MEASUREMENT
/begin MEASUREMENT iIaeSigna.Dt1NgAb.Pt1Si16.x "Filterwert" SLONG UMR___1_300_0_S6_S3 1 100 -7158278.82667 7158278.82333 DISPLAY_IDENTIFIER Pt1Si16.Dt1NgAb.iIaeSigna ECU_ADDRESS 0xFFF8D154 /end MEASUREMENT
/begin MEASUREMENT iIaeSigna.Dt1NgAb.xp "Ableitung vom Eingangswert" SWORD UMR___1_1_0_S6_S3 1 100 -32768 32767 DISPLAY_IDENTIFIER Dt1NgAb.iIaeSigna ECU_ADDRESS 0xFFF8D150 /end MEASUREMENT
/begin MEASUREMENT iIaeSigna.Dt1NgMot.Pt1Si16.x "Filterwert" SLONG UMR___1_300_0_S6_S3 1 100 -7158278.82667 7158278.82333 DISPLAY_IDENTIFIER Pt1Si16.Dt1NgMot.iIaeSigna ECU_ADDRESS 0xFFF8D15C /end MEASUREMENT
/begin MEASUREMENT iIaeSigna.Dt1NgMot.xp "Ableitung vom Eingangswert" SWORD UMR___1_1_0_S6_S3 1 100 -32768 32767 DISPLAY_IDENTIFIER Dt1NgMot.iIaeSigna ECU_ADDRESS 0xFFF8D158 /end MEASUREMENT
/begin MEASUREMENT iIaeSigna.Dt1NgGetrein.Pt1Si16.x "Filterwert" SLONG UMR___1_300_0_S6_S3 1 100 -7158278.82667 7158278.82333 DISPLAY_IDENTIFIER Pt1Si16.Dt1NgGetrein.iIaeSigna ECU_ADDRESS 0xFFF8D164 /end MEASUREMENT
/begin MEASUREMENT iIaeSigna.Dt1NgGetrein.xp "Ableitung vom Eingangswert" SWORD UMR___1_1_0_S6_S3 1 100 -32768 32767 DISPLAY_IDENTIFIER Dt1NgGetrein.iIaeSigna ECU_ADDRESS 0xFFF8D160 /end MEASUREMENT
/begin MEASUREMENT iIaeSigna.Dt1MgMotist.Pt1Si16.x "Filterwert" SLONG UMR___1_300_0_S6_S3 1 100 -7158278.82667 7158278.82333 DISPLAY_IDENTIFIER Pt1Si16.Dt1MgMotist.iIaeSigna ECU_ADDRESS 0xFFF8D16C /end MEASUREMENT
/begin MEASUREMENT iIaeSigna.Dt1MgMotist.xp "Ableitung vom Eingangswert" SWORD UMR___1_1_0_S6_S3 1 100 -32768 32767 DISPLAY_IDENTIFIER Dt1MgMotist.iIaeSigna ECU_ADDRESS 0xFFF8D168 /end MEASUREMENT
/begin MEASUREMENT iIaeSigna.Pt1Nue.x "Filterwert" SLONG UMR___1_300_0_S6_S3 1 100 -7158278.82667 7158278.82333 DISPLAY_IDENTIFIER Pt1Nue.iIaeSigna ECU_ADDRESS 0xFFF8D170 /end MEASUREMENT
/begin MEASUREMENT iIaeSigna.Pt1NdMot.x "Filterwert" SLONG UMR___1_300_0_S6_S3 1 100 -7158278.82667 7158278.82333 DISPLAY_IDENTIFIER Pt1NdMot.iIaeSigna ECU_ADDRESS 0xFFF8D174 /end MEASUREMENT
/begin MEASUREMENT iIaeSigna.Pt1NdGetrein.x "Filterwert" SLONG UMR___1_300_0_S6_S3 1 100 -7158278.82667 7158278.82333 DISPLAY_IDENTIFIER Pt1NdGetrein.iIaeSigna ECU_ADDRESS 0xFFF8D178 /end MEASUREMENT
/begin MEASUREMENT iIaeSigna.Pt1Dki.x "Filterwert" SLONG UMR___1_300_0_S6_S3 1 100 -7158278.82667 7158278.82333 DISPLAY_IDENTIFIER Pt1Dki.iIaeSigna ECU_ADDRESS 0xFFF8D17C /end MEASUREMENT
/begin MEASUREMENT iIaeSigna.Pt1PBrems.x "Filterwert" SLONG UMR___1_300_0_S6_S3 1 100 -7158278.82667 7158278.82333 DISPLAY_IDENTIFIER Pt1PBrems.iIaeSigna ECU_ADDRESS 0xFFF8D180 /end MEASUREMENT
/begin MEASUREMENT iIaeSigna.Pt1MMotist.x "Filterwert" SLONG UMR___1_300_0_S6_S3 1 100 -7158278.82667 7158278.82333 DISPLAY_IDENTIFIER Pt1MMotist.iIaeSigna ECU_ADDRESS 0xFFF8D184 /end MEASUREMENT
/begin MEASUREMENT iIaeSigna.Pt1MMotistoe.x "Filterwert" SLONG UMR___1_300_0_S6_S3 1 100 -7158278.82667 7158278.82333 DISPLAY_IDENTIFIER Pt1MMotistoe.iIaeSigna ECU_ADDRESS 0xFFF8D188 /end MEASUREMENT
/begin MEASUREMENT iIaeSigna.Pt1MMotsolloe.x "Filterwert" SLONG UMR___1_300_0_S6_S3 1 100 -7158278.82667 7158278.82333 DISPLAY_IDENTIFIER Pt1MMotsolloe.iIaeSigna ECU_ADDRESS 0xFFF8D18C /end MEASUREMENT
/begin MEASUREMENT iIaeSigna.Pt1MMotgem.x "Filterwert" SLONG UMR___1_300_0_S6_S3 1 100 -7158278.82667 7158278.82333 DISPLAY_IDENTIFIER Pt1MMotgem.iIaeSigna ECU_ADDRESS 0xFFF8D190 /end MEASUREMENT
/begin MEASUREMENT iIaeSigna.Pt1NAb.x "Filterwert" SLONG UMR___1_300_0_S6_S3 1 100 -7158278.82667 7158278.82333 DISPLAY_IDENTIFIER Pt1NAb.iIaeSigna ECU_ADDRESS 0xFFF8D194 /end MEASUREMENT
/begin MEASUREMENT iIaeSigna.Pt1NT.x "Filterwert" SLONG UMR___1_300_0_S6_S3 1 100 -7158278.82667 7158278.82333 DISPLAY_IDENTIFIER Pt1NT.iIaeSigna ECU_ADDRESS 0xFFF8D198 /end MEASUREMENT
/begin MEASUREMENT iIaeSigna.Pt1NMot.x "Filterwert" SLONG UMR___1_300_0_S6_S3 1 100 -7158278.82667 7158278.82333 DISPLAY_IDENTIFIER Pt1NMot.iIaeSigna ECU_ADDRESS 0xFFF8D19C /end MEASUREMENT
/begin MEASUREMENT iIaeSigna.Pt1NdIae.x "Filterwert" SLONG UMR___1_300_0_S6_S3 1 100 -7158278.82667 7158278.82333 DISPLAY_IDENTIFIER Pt1NdIae.iIaeSigna ECU_ADDRESS 0xFFF8D1A0 /end MEASUREMENT
/begin MEASUREMENT iIaeSigna.Pt1AxrefIae.x "Filterwert" SLONG UMR___1_300_0_S6_S3 1 100 -7158278.82667 7158278.82333 DISPLAY_IDENTIFIER Pt1AxrefIae.iIaeSigna ECU_ADDRESS 0xFFF8D1A4 /end MEASUREMENT
/begin MEASUREMENT iIaeSigna.Pt2NeigungIae.x "Filterwert" FLOAT32_IEEE UMR___1_1_0_S6_S3 1 100 -2147483648 2147483647 FORMAT "%4.2" DISPLAY_IDENTIFIER x.Pt2NeigungIae.iIaeSigna ECU_ADDRESS 0xFFF8D1A8 /end MEASUREMENT
/begin MEASUREMENT iIaeSigna.Pt2NeigungIae.xp "Ableitung vom Eingangswert" FLOAT32_IEEE UMR__SEC_1_1_0_S6_S3 1 100 -2147483648 2147483647 FORMAT "%4.2" DISPLAY_IDENTIFIER xp.Pt2NeigungIae.iIaeSigna ECU_ADDRESS 0xFFF8D1AC /end MEASUREMENT
/begin MEASUREMENT iIaeSigna.Dt1NdgIae.Pt1Si16.x "Filterwert" SLONG UMR___1_300_0_S6_S3 1 100 -7158278.82667 7158278.82333 DISPLAY_IDENTIFIER Pt1Si16.Dt1NdgIae.iIaeSigna ECU_ADDRESS 0xFFF8D1B4 /end MEASUREMENT
/begin MEASUREMENT iIaeSigna.Dt1NdgIae.xp "Ableitung vom Eingangswert" SWORD UMR___1_1_0_S6_S3 1 100 -32768 32767 DISPLAY_IDENTIFIER Dt1NdgIae.iIaeSigna ECU_ADDRESS 0xFFF8D1B0 /end MEASUREMENT
/begin MEASUREMENT iIaeSigna.DelayMMotgem.write_index "Index der aktuellen Bufferposition" SBYTE UMR___1_1_0_S6_S3 1 100 0 10 DISPLAY_IDENTIFIER DelayMMotgem.iIaeSigna ECU_ADDRESS 0xFFF8D1B8 /end MEASUREMENT
/begin MEASUREMENT iIaeSigna.DelayMMotist.write_index "Index der aktuellen Bufferposition" SBYTE UMR___1_1_0_S6_S3 1 100 0 10 DISPLAY_IDENTIFIER DelayMMotist.iIaeSigna ECU_ADDRESS 0xFFF8D1CE /end MEASUREMENT
/begin MEASUREMENT iIaeSigna.DelayMMotistoe.write_index "Index der aktuellen Bufferposition" SBYTE UMR___1_1_0_S6_S3 1 100 0 10 DISPLAY_IDENTIFIER DelayMMotistoe.iIaeSigna ECU_ADDRESS 0xFFF8D1E4 /end MEASUREMENT
/begin MEASUREMENT iIaeSigna.DelayMMotsolloe.write_index "Index der aktuellen Bufferposition" SBYTE UMR___1_1_0_S6_S3 1 100 0 10 DISPLAY_IDENTIFIER DelayMMotsolloe.iIaeSigna ECU_ADDRESS 0xFFF8D1FA /end MEASUREMENT
/begin MEASUREMENT iIaeSigna.DelayNab.write_index "Index der aktuellen Bufferposition" SBYTE UMR___1_1_0_S6_S3 1 100 0 10 DISPLAY_IDENTIFIER DelayNab.iIaeSigna ECU_ADDRESS 0xFFF8D210 /end MEASUREMENT
/begin MEASUREMENT iIaeSigna.DelayNt.write_index "Index der aktuellen Bufferposition" SBYTE UMR___1_1_0_S6_S3 1 100 0 10 DISPLAY_IDENTIFIER DelayNt.iIaeSigna ECU_ADDRESS 0xFFF8D226 /end MEASUREMENT
/begin MEASUREMENT iIaeMomen.BibPIDIae.stellgr_i_alt "verzoegerte I-Stellgroesse" FLOAT32_IEEE UMR___1_1_0_S6_S3 1 100 -1E+037 1E+037 FORMAT "%4.2" DISPLAY_IDENTIFIER stellgr_i_alt.BibPIDIae.iIaeMomen ECU_ADDRESS 0xFFF8D070 /end MEASUREMENT
/begin MEASUREMENT iIaeMomen.BibPIDIae.stellgr_d_alt "verzoegerte D-Stellgroesse" FLOAT32_IEEE UMR___1_1_0_S6_S3 1 100 -1E+037 1E+037 FORMAT "%4.2" DISPLAY_IDENTIFIER stellgr_d_alt.BibPIDIae.iIaeMomen ECU_ADDRESS 0xFFF8D074 /end MEASUREMENT
/begin MEASUREMENT iIaeMomen.BibPIDIae.faktor_p "Param. P-Anteil" FLOAT32_IEEE UMR___1_1_0_S6_S3 1 100 -1E+037 1E+037 FORMAT "%4.2" DISPLAY_IDENTIFIER faktor_p.BibPIDIae.iIaeMomen ECU_ADDRESS 0xFFF8D078 /end MEASUREMENT
/begin MEASUREMENT iIaeMomen.BibPIDIae.faktor_i "Param. I-Anteil" FLOAT32_IEEE UMR___1_1_0_S6_S3 1 100 -1E+037 1E+037 FORMAT "%4.2" DISPLAY_IDENTIFIER faktor_i.BibPIDIae.iIaeMomen ECU_ADDRESS 0xFFF8D07C /end MEASUREMENT
/begin MEASUREMENT iIaeMomen.BibPIDIae.faktor_d "Param. D-Anteil" FLOAT32_IEEE UMR___1_1_0_S6_S3 1 100 -1E+037 1E+037 FORMAT "%4.2" DISPLAY_IDENTIFIER faktor_d.BibPIDIae.iIaeMomen ECU_ADDRESS 0xFFF8D080 /end MEASUREMENT
/begin MEASUREMENT iIaeMomen.BibPIDIae.faktor_t1 "Param. T1-Anteil" FLOAT32_IEEE UMR___1_1_0_S6_S3 1 100 -1E+037 1E+037 FORMAT "%4.2" DISPLAY_IDENTIFIER faktor_t1.BibPIDIae.iIaeMomen ECU_ADDRESS 0xFFF8D084 /end MEASUREMENT
/begin MEASUREMENT iIaeMomen.BibPIDIae.stell_max "maximale Stellgroesse" FLOAT32_IEEE UMR___1_1_0_S6_S3 1 100 -1E+037 1E+037 FORMAT "%4.2" DISPLAY_IDENTIFIER stell_max.BibPIDIae.iIaeMomen ECU_ADDRESS 0xFFF8D088 /end MEASUREMENT
/begin MEASUREMENT iIaeMomen.BibPIDIae.stell_min "minimale Stellgroesse" FLOAT32_IEEE UMR___1_1_0_S6_S3 1 100 -1E+037 1E+037 FORMAT "%4.2" DISPLAY_IDENTIFIER stell_min.BibPIDIae.iIaeMomen ECU_ADDRESS 0xFFF8D08C /end MEASUREMENT
/begin MEASUREMENT iIaeMomen.BibPIDIae.regel_diff_alt "verzoeg. Regeldifferenz" FLOAT32_IEEE UMR___1_1_0_S6_S3 1 100 -1E+037 1E+037 FORMAT "%4.2" DISPLAY_IDENTIFIER regel_diff_alt.BibPIDIae.iIaeMomen ECU_ADDRESS 0xFFF8D090 /end MEASUREMENT
/begin MEASUREMENT iIaeMomen.BibPIDIae.stellgr_alt "verzoegerte Stellgroesse" FLOAT32_IEEE UMR___1_1_0_S6_S3 1 100 -1E+037 1E+037 FORMAT "%4.2" DISPLAY_IDENTIFIER stellgr_alt.BibPIDIae.iIaeMomen ECU_ADDRESS 0xFFF8D094 /end MEASUREMENT
/begin MEASUREMENT iIaeMomen.BibPIDIae.stellgr_i_modulo "Ganzzahl. Rest d. I-Quotient" FLOAT32_IEEE UMR___1_1_0_S6_S3 1 100 -1E+037 1E+037 FORMAT "%4.2" DISPLAY_IDENTIFIER stellgr_i_modulo.BibPIDIae.iIaeMomen ECU_ADDRESS 0xFFF8D098 /end MEASUREMENT
/begin MEASUREMENT iIaeMomen.Pt2NMotAnfahrt.x "Filterwert" FLOAT32_IEEE UMR___1_1_0_S6_S3 1 100 -2147483648 2147483647 FORMAT "%4.2" DISPLAY_IDENTIFIER x.Pt2NMotAnfahrt.iIaeMomen ECU_ADDRESS 0xFFF8D0A0 /end MEASUREMENT
/begin MEASUREMENT iIaeMomen.Pt2NMotAnfahrt.xp "Ableitung vom Eingangswert" FLOAT32_IEEE UMR__SEC_1_1_0_S6_S3 1 100 -2147483648 2147483647 FORMAT "%4.2" DISPLAY_IDENTIFIER xp.Pt2NMotAnfahrt.iIaeMomen ECU_ADDRESS 0xFFF8D0A4 /end MEASUREMENT
/begin MEASUREMENT iIaeMomen.Pt1NMotAnfah.x "Filterwert" SLONG UMR___1_300_0_S6_S3 1 100 -7158278.82667 7158278.82333 DISPLAY_IDENTIFIER Pt1NMotAnfah.iIaeMomen ECU_ADDRESS 0xFFF8D0A8 /end MEASUREMENT
/begin MEASUREMENT iIaeMomen.Pt1IStuetz.x "Filterwert" SLONG UMR___1_300_0_S6_S3 1 100 -7158278.82667 7158278.82333 DISPLAY_IDENTIFIER Pt1IStuetz.iIaeMomen ECU_ADDRESS 0xFFF8D0AC /end MEASUREMENT
/begin MEASUREMENT iIaeMomen.Pt1FMBasisAnfahrtIae.x "Filterwert" FLOAT32_IEEE UMR___1_1_0_S6_S3 1 100 -1000000000 1000000000 FORMAT "%4.2" DISPLAY_IDENTIFIER Pt1FMBasisAnfahrtIae.iIaeMomen ECU_ADDRESS 0xFFF8D0B0 /end MEASUREMENT
/begin MEASUREMENT iIaeMomen.Pt2MIstVorstIae.x "Filterwert" FLOAT32_IEEE UMR___1_1_0_S6_S3 1 100 -2147483648 2147483647 FORMAT "%4.2" DISPLAY_IDENTIFIER x.Pt2MIstVorstIae.iIaeMomen ECU_ADDRESS 0xFFF8D0B4 /end MEASUREMENT
/begin MEASUREMENT iIaeMomen.Pt2MIstVorstIae.xp "Ableitung vom Eingangswert" FLOAT32_IEEE UMR__SEC_1_1_0_S6_S3 1 100 -2147483648 2147483647 FORMAT "%4.2" DISPLAY_IDENTIFIER xp.Pt2MIstVorstIae.iIaeMomen ECU_ADDRESS 0xFFF8D0B8 /end MEASUREMENT
/begin MEASUREMENT iIaeMomen.TimerKflMiaeauf.time "Zeit des Timers" UWORD UMR_SEC__1_100_0_S6_S3 1 100 0 655.35 DISPLAY_IDENTIFIER time.TimerKflMiaeauf.iIaeMomen ECU_ADDRESS 0xFFF8D0BC /end MEASUREMENT
/begin MEASUREMENT iIaeMomen.TimerKflMiaeauf.maxtime "Endzeit" UWORD UMR_SEC__1_100_0_S6_S3 1 100 0 655.35 DISPLAY_IDENTIFIER maxtime.TimerKflMiaeauf.iIaeMomen ECU_ADDRESS 0xFFF8D0BE /end MEASUREMENT
/begin MEASUREMENT iIaeMomen.TimerMiaeaufAnfahr.time "Zeit des Timers" UWORD UMR_SEC__1_100_0_S6_S3 1 100 0 655.35 DISPLAY_IDENTIFIER time.TimerMiaeaufAnfahr.iIaeMomen ECU_ADDRESS 0xFFF8D0C0 /end MEASUREMENT
/begin MEASUREMENT iIaeMomen.TimerMiaeaufAnfahr.maxtime "Endzeit" UWORD UMR_SEC__1_100_0_S6_S3 1 100 0 655.35 DISPLAY_IDENTIFIER maxtime.TimerMiaeaufAnfahr.iIaeMomen ECU_ADDRESS 0xFFF8D0C2 /end MEASUREMENT
/begin MEASUREMENT iIaeMomen.TimerNachMmaxHas.time "Zeit des Timers" UWORD UMR_SEC__1_100_0_S6_S3 1 100 0 655.35 DISPLAY_IDENTIFIER time.TimerNachMmaxHas.iIaeMomen ECU_ADDRESS 0xFFF8D0C4 /end MEASUREMENT
/begin MEASUREMENT iIaeMomen.TimerNachMmaxHas.maxtime "Endzeit" UWORD UMR_SEC__1_100_0_S6_S3 1 100 0 655.35 DISPLAY_IDENTIFIER maxtime.TimerNachMmaxHas.iIaeMomen ECU_ADDRESS 0xFFF8D0C6 /end MEASUREMENT
/begin MEASUREMENT iIaeMomen.TimerUefIstuetz.time "Zeit des Timers" UWORD UMR_SEC__1_100_0_S6_S3 1 100 0 655.35 DISPLAY_IDENTIFIER time.TimerUefIstuetz.iIaeMomen ECU_ADDRESS 0xFFF8D0C8 /end MEASUREMENT
/begin MEASUREMENT iIaeMomen.TimerUefIstuetz.maxtime "Endzeit" UWORD UMR_SEC__1_100_0_S6_S3 1 100 0 655.35 DISPLAY_IDENTIFIER maxtime.TimerUefIstuetz.iIaeMomen ECU_ADDRESS 0xFFF8D0CA /end MEASUREMENT
/begin MEASUREMENT iIaeMomen.TimerUefKriechen.time "Zeit des Timers" UWORD UMR_SEC__1_100_0_S6_S3 1 100 0 655.35 DISPLAY_IDENTIFIER time.TimerUefKriechen.iIaeMomen ECU_ADDRESS 0xFFF8D0CC /end MEASUREMENT
/begin MEASUREMENT iIaeMomen.TimerUefKriechen.maxtime "Endzeit" UWORD UMR_SEC__1_100_0_S6_S3 1 100 0 655.35 DISPLAY_IDENTIFIER maxtime.TimerUefKriechen.iIaeMomen ECU_ADDRESS 0xFFF8D0CE /end MEASUREMENT
/begin MEASUREMENT iIaeMomen.TimerUefMVorKriechen.time "Zeit des Timers" UWORD UMR_SEC__1_100_0_S6_S3 1 100 0 655.35 DISPLAY_IDENTIFIER time.TimerUefMVorKriechen.iIaeMomen ECU_ADDRESS 0xFFF8D0D0 /end MEASUREMENT
/begin MEASUREMENT iIaeMomen.TimerUefMVorKriechen.maxtime "Endzeit" UWORD UMR_SEC__1_100_0_S6_S3 1 100 0 655.35 DISPLAY_IDENTIFIER maxtime.TimerUefMVorKriechen.iIaeMomen ECU_ADDRESS 0xFFF8D0D2 /end MEASUREMENT
/begin MEASUREMENT iIaeMomen.TimerPulsCue.time "Zeit des Timers" UWORD UMR_SEC__1_100_0_S6_S3 1 100 0 655.35 DISPLAY_IDENTIFIER time.TimerPulsCue.iIaeMomen ECU_ADDRESS 0xFFF8D0D4 /end MEASUREMENT
/begin MEASUREMENT iIaeMomen.TimerPulsCue.maxtime "Endzeit" UWORD UMR_SEC__1_100_0_S6_S3 1 100 0 655.35 DISPLAY_IDENTIFIER maxtime.TimerPulsCue.iIaeMomen ECU_ADDRESS 0xFFF8D0D6 /end MEASUREMENT
/begin MEASUREMENT iIaeMomen.TimerPulsCueAktiv.time "Zeit des Timers" UWORD UMR_SEC__1_100_0_S6_S3 1 100 0 655.35 DISPLAY_IDENTIFIER time.TimerPulsCueAktiv.iIaeMomen ECU_ADDRESS 0xFFF8D0D8 /end MEASUREMENT
/begin MEASUREMENT iIaeMomen.TimerPulsCueAktiv.maxtime "Endzeit" UWORD UMR_SEC__1_100_0_S6_S3 1 100 0 655.35 DISPLAY_IDENTIFIER maxtime.TimerPulsCueAktiv.iIaeMomen ECU_ADDRESS 0xFFF8D0DA /end MEASUREMENT
/begin MEASUREMENT iIaeDiagn.Pt1Mdidiagiae.x "Filterwert" SLONG UMR___1_300_0_S6_S3 1 100 -7158278.82667 7158278.82333 DISPLAY_IDENTIFIER Pt1Mdidiagiae.iIaeDiagn ECU_ADDRESS 0xFFF8CEE0 /end MEASUREMENT
/begin MEASUREMENT iIaeDiagn.Pt1Axrefiae.x "Filterwert" SLONG UMR___1_300_0_S6_S3 1 100 -7158278.82667 7158278.82333 DISPLAY_IDENTIFIER Pt1Axrefiae.iIaeDiagn ECU_ADDRESS 0xFFF8CEE4 /end MEASUREMENT
/begin MEASUREMENT iIaeDiagn.TimerNoOpenDiagiae.time "Zeit des Timers" UWORD UMR_SEC__1_100_0_S6_S3 1 100 0 655.35 DISPLAY_IDENTIFIER time.TimerNoOpenDiagiae.iIaeDiagn ECU_ADDRESS 0xFFF8CEE8 /end MEASUREMENT
/begin MEASUREMENT iIaeDiagn.TimerNoOpenDiagiae.maxtime "Endzeit" UWORD UMR_SEC__1_100_0_S6_S3 1 100 0 655.35 DISPLAY_IDENTIFIER maxtime.TimerNoOpenDiagiae.iIaeDiagn ECU_ADDRESS 0xFFF8CEEA /end MEASUREMENT
/begin MEASUREMENT iIaeDiagn.TimerNoCloseDiagiae.time "Zeit des Timers" UWORD UMR_SEC__1_100_0_S6_S3 1 100 0 655.35 DISPLAY_IDENTIFIER time.TimerNoCloseDiagiae.iIaeDiagn ECU_ADDRESS 0xFFF8CEEC /end MEASUREMENT
/begin MEASUREMENT iIaeDiagn.TimerNoCloseDiagiae.maxtime "Endzeit" UWORD UMR_SEC__1_100_0_S6_S3 1 100 0 655.35 DISPLAY_IDENTIFIER maxtime.TimerNoCloseDiagiae.iIaeDiagn ECU_ADDRESS 0xFFF8CEEE /end MEASUREMENT
/begin MEASUREMENT iIaeDiagn.TimerCloseNgab.time "Zeit des Timers" UWORD UMR_SEC__1_100_0_S6_S3 1 100 0 655.35 DISPLAY_IDENTIFIER time.TimerCloseNgab.iIaeDiagn ECU_ADDRESS 0xFFF8CEF0 /end MEASUREMENT
/begin MEASUREMENT iIaeDiagn.TimerCloseNgab.maxtime "Endzeit" UWORD UMR_SEC__1_100_0_S6_S3 1 100 0 655.35 DISPLAY_IDENTIFIER maxtime.TimerCloseNgab.iIaeDiagn ECU_ADDRESS 0xFFF8CEF2 /end MEASUREMENT
/begin MEASUREMENT iIaeDiagn.TimerCloseRueckF.time "Zeit des Timers" UWORD UMR_SEC__1_100_0_S6_S3 1 100 0 655.35 DISPLAY_IDENTIFIER time.TimerCloseRueckF.iIaeDiagn ECU_ADDRESS 0xFFF8CEF4 /end MEASUREMENT
/begin MEASUREMENT iIaeDiagn.TimerCloseRueckF.maxtime "Endzeit" UWORD UMR_SEC__1_100_0_S6_S3 1 100 0 655.35 DISPLAY_IDENTIFIER maxtime.TimerCloseRueckF.iIaeDiagn ECU_ADDRESS 0xFFF8CEF6 /end MEASUREMENT
/begin MEASUREMENT iIaeDiagn.TimerNoopenRueckF.time "Zeit des Timers" UWORD UMR_SEC__1_100_0_S6_S3 1 100 0 655.35 DISPLAY_IDENTIFIER time.TimerNoopenRueckF.iIaeDiagn ECU_ADDRESS 0xFFF8CEF8 /end MEASUREMENT
/begin MEASUREMENT iIaeDiagn.TimerNoopenRueckF.maxtime "Endzeit" UWORD UMR_SEC__1_100_0_S6_S3 1 100 0 655.35 DISPLAY_IDENTIFIER maxtime.TimerNoopenRueckF.iIaeDiagn ECU_ADDRESS 0xFFF8CEFA /end MEASUREMENT
/begin MEASUREMENT iIaeDiagn.TimerCloseBewAktiv.time "Zeit des Timers" UWORD UMR_SEC__1_100_0_S6_S3 1 100 0 655.35 DISPLAY_IDENTIFIER time.TimerCloseBewAktiv.iIaeDiagn ECU_ADDRESS 0xFFF8CEFC /end MEASUREMENT
/begin MEASUREMENT iIaeDiagn.TimerCloseBewAktiv.maxtime "Endzeit" UWORD UMR_SEC__1_100_0_S6_S3 1 100 0 655.35 DISPLAY_IDENTIFIER maxtime.TimerCloseBewAktiv.iIaeDiagn ECU_ADDRESS 0xFFF8CEFE /end MEASUREMENT
/begin MEASUREMENT iIaeDiagn.TimerNocloseBewAktiv.time "Zeit des Timers" UWORD UMR_SEC__1_100_0_S6_S3 1 100 0 655.35 DISPLAY_IDENTIFIER time.TimerNocloseBewAktiv.iIaeDiagn ECU_ADDRESS 0xFFF8CF00 /end MEASUREMENT
/begin MEASUREMENT iIaeDiagn.TimerNocloseBewAktiv.maxtime "Endzeit" UWORD UMR_SEC__1_100_0_S6_S3 1 100 0 655.35 DISPLAY_IDENTIFIER maxtime.TimerNocloseBewAktiv.iIaeDiagn ECU_ADDRESS 0xFFF8CF02 /end MEASUREMENT
/begin MEASUREMENT iIaeDiagn.TimerNoopenBewAktiv.time "Zeit des Timers" UWORD UMR_SEC__1_100_0_S6_S3 1 100 0 655.35 DISPLAY_IDENTIFIER time.TimerNoopenBewAktiv.iIaeDiagn ECU_ADDRESS 0xFFF8CF04 /end MEASUREMENT
/begin MEASUREMENT iIaeDiagn.TimerNoopenBewAktiv.maxtime "Endzeit" UWORD UMR_SEC__1_100_0_S6_S3 1 100 0 655.35 DISPLAY_IDENTIFIER maxtime.TimerNoopenBewAktiv.iIaeDiagn ECU_ADDRESS 0xFFF8CF06 /end MEASUREMENT
/begin MEASUREMENT iIaeTempm.TimerVzInit.time "Zeit des Timers" UWORD UMR_SEC__1_100_0_S6_S3 1 100 0 655.35 DISPLAY_IDENTIFIER time.TimerVzInit.iIaeTempm ECU_ADDRESS 0xFFF8D252 /end MEASUREMENT
/begin MEASUREMENT iIaeTempm.TimerVzInit.maxtime "Endzeit" UWORD UMR_SEC__1_100_0_S6_S3 1 100 0 655.35 DISPLAY_IDENTIFIER maxtime.TimerVzInit.iIaeTempm ECU_ADDRESS 0xFFF8D254 /end MEASUREMENT
/begin MEASUREMENT iIaeKuehl.Pt1Vpsoll.x "Filterwert" SLONG UMR___1_300_0_S6_S3 1 100 -7158278.82667 7158278.82333 DISPLAY_IDENTIFIER Pt1Vpsoll.iIaeKuehl ECU_ADDRESS 0xFFF8CF70 /end MEASUREMENT
/begin MEASUREMENT iIaeKuehl.Pt1VpKuehlKorr.x "Filterwert" SLONG UMR___1_300_0_S6_S3 1 100 -7158278.82667 7158278.82333 DISPLAY_IDENTIFIER Pt1VpKuehlKorr.iIaeKuehl ECU_ADDRESS 0xFFF8CF74 /end MEASUREMENT
/begin MEASUREMENT iIaeKuehl.TimerZModusIae.time "Zeit des Timers" UWORD UMR_SEC__1_100_0_S6_S3 1 100 0 655.35 DISPLAY_IDENTIFIER time.TimerZModusIae.iIaeKuehl ECU_ADDRESS 0xFFF8CF78 /end MEASUREMENT
/begin MEASUREMENT iIaeKuehl.TimerZModusIae.maxtime "Endzeit" UWORD UMR_SEC__1_100_0_S6_S3 1 100 0 655.35 DISPLAY_IDENTIFIER maxtime.TimerZModusIae.iIaeKuehl ECU_ADDRESS 0xFFF8CF7A /end MEASUREMENT
/begin MEASUREMENT iIaeMotmx.TimerStallIae.time "Zeit des Timers" UWORD UMR_SEC__1_100_0_S6_S3 1 100 0 655.35 DISPLAY_IDENTIFIER time.TimerStallIae.iIaeMotmx ECU_ADDRESS 0xFFF8ED6A /end MEASUREMENT
/begin MEASUREMENT iIaeMotmx.TimerStallIae.maxtime "Endzeit" UWORD UMR_SEC__1_100_0_S6_S3 1 100 0 655.35 DISPLAY_IDENTIFIER maxtime.TimerStallIae.iIaeMotmx ECU_ADDRESS 0xFFF8ED6C /end MEASUREMENT
/begin MEASUREMENT iIaeMotmx.Pt1MMotmax.x "Filterwert" SLONG UMR___1_300_0_S6_S3 1 100 -7158278.82667 7158278.82333 DISPLAY_IDENTIFIER Pt1MMotmax.iIaeMotmx ECU_ADDRESS 0xFFF8ED70 /end MEASUREMENT
/begin MEASUREMENT iIaeMotmx.TimerMotMaxTempIae.time "Zeit des Timers" UWORD UMR_SEC__1_100_0_S6_S3 1 100 0 655.35 DISPLAY_IDENTIFIER time.TimerMotMaxTempIae.iIaeMotmx ECU_ADDRESS 0xFFF8ED74 /end MEASUREMENT
/begin MEASUREMENT iIaeMotmx.TimerMotMaxTempIae.maxtime "Endzeit" UWORD UMR_SEC__1_100_0_S6_S3 1 100 0 655.35 DISPLAY_IDENTIFIER maxtime.TimerMotMaxTempIae.iIaeMotmx ECU_ADDRESS 0xFFF8ED76 /end MEASUREMENT
/begin MEASUREMENT iSasKorGls.FlankeNeg.old_value "alter Wert des Uebergabeparameters" UBYTE UMR___1_1_0_S6_S3 1 100 0 1 BIT_MASK 0x1 DISPLAY_IDENTIFIER old_value.FlankeNeg.iSasKorGls ECU_ADDRESS 0xFFF8F192 /end MEASUREMENT
/begin MEASUREMENT iSasKorGls.FlankePos.old_value "alter Wert des Uebergabeparameters" UBYTE UMR___1_1_0_S6_S3 1 100 0 1 BIT_MASK 0x1 DISPLAY_IDENTIFIER old_value.FlankePos.iSasKorGls ECU_ADDRESS 0xFFF8F193 /end MEASUREMENT
/begin MEASUREMENT iSasBerechnungGls.filter_wngtgls.x "letzter Wert" SLONG UMR___1_1_0_S6_S3 1 100 -2147483648 2147483647 DISPLAY_IDENTIFIER x.filter_wngtgls.iSasBerechnungGls ECU_ADDRESS 0xFFF8F170 /end MEASUREMENT
/begin MEASUREMENT iSasBerechnungGls.filter_wngtgls.letzter_ms_timer "letzter BS-Timer" UWORD UMR_MSEC__1_1_0_S6_S3 1 100 0 65535 DISPLAY_IDENTIFIER letzter_ms_timer.filter_wngtgls.iSasBerechnungGls ECU_ADDRESS 0xFFF8F174 /end MEASUREMENT
/begin MEASUREMENT iSasBerechnungGls.FSchubZugSas.old_value "alter Wert des Uebergabeparameters" UBYTE UMR___1_1_0_S6_S3 1 100 0 1 BIT_MASK 0x1 DISPLAY_IDENTIFIER old_value.FSchubZugSas.iSasBerechnungGls ECU_ADDRESS 0xFFF8F178 /end MEASUREMENT
/begin MEASUREMENT iSasRegelungGls.gls_para.cBibRegle._.stellgr_i_alt "verzoegerte I-Stellgroesse" SWORD UMR___1_1_0_S6_S3 1 100 -32768 32767 DISPLAY_IDENTIFIER stellgr_i_alt._.cBibRegle.gls_para.iSasRegelungGls ECU_ADDRESS 0xFFF8F1A8 /end MEASUREMENT
/begin MEASUREMENT iSasRegelungGls.gls_para.cBibRegle._.stellgr_d_alt "verzoegerte D-Stellgroesse" SWORD UMR___1_1_0_S6_S3 1 100 -32768 32767 DISPLAY_IDENTIFIER stellgr_d_alt._.cBibRegle.gls_para.iSasRegelungGls ECU_ADDRESS 0xFFF8F1AA /end MEASUREMENT
/begin MEASUREMENT iSasRegelungGls.gls_para.cBibRegle._.faktor_p "Param. P-Anteil" UWORD UMR___1_1_0_S6_S3 1 100 0 65535 DISPLAY_IDENTIFIER faktor_p._.cBibRegle.gls_para.iSasRegelungGls ECU_ADDRESS 0xFFF8F1AC /end MEASUREMENT
/begin MEASUREMENT iSasRegelungGls.gls_para.cBibRegle._.faktor_i "Param. I-Anteil" UWORD UMR___1_1_0_S6_S3 1 100 0 65535 DISPLAY_IDENTIFIER faktor_i._.cBibRegle.gls_para.iSasRegelungGls ECU_ADDRESS 0xFFF8F1AE /end MEASUREMENT
/begin MEASUREMENT iSasRegelungGls.gls_para.cBibRegle._.faktor_d "Param. D-Anteil" UWORD UMR___1_1_0_S6_S3 1 100 0 65535 DISPLAY_IDENTIFIER faktor_d._.cBibRegle.gls_para.iSasRegelungGls ECU_ADDRESS 0xFFF8F1B0 /end MEASUREMENT
/begin MEASUREMENT iSasRegelungGls.gls_para.cBibRegle._.faktor_t1 "Param. T1-Anteil" UWORD UMR___1_1_0_S6_S3 1 100 0 65535 DISPLAY_IDENTIFIER faktor_t1._.cBibRegle.gls_para.iSasRegelungGls ECU_ADDRESS 0xFFF8F1B2 /end MEASUREMENT
/begin MEASUREMENT iSasRegelungGls.gls_para.cBibRegle._.stell_max "maximale Stellgroesse" SWORD UMR___1_1_0_S6_S3 1 100 -32768 32767 DISPLAY_IDENTIFIER stell_max._.cBibRegle.gls_para.iSasRegelungGls ECU_ADDRESS 0xFFF8F1B4 /end MEASUREMENT
/begin MEASUREMENT iSasRegelungGls.gls_para.cBibRegle._.stell_min "minimale Stellgroesse" SWORD UMR___1_1_0_S6_S3 1 100 -32768 32767 DISPLAY_IDENTIFIER stell_min._.cBibRegle.gls_para.iSasRegelungGls ECU_ADDRESS 0xFFF8F1B6 /end MEASUREMENT
/begin MEASUREMENT iSasRegelungGls.gls_para.cBibRegle._.regel_diff_alt "verzoeg. Regeldifferenz" SWORD UMR___1_1_0_S6_S3 1 100 -32768 32767 DISPLAY_IDENTIFIER regel_diff_alt._.cBibRegle.gls_para.iSasRegelungGls ECU_ADDRESS 0xFFF8F1B8 /end MEASUREMENT
/begin MEASUREMENT iSasRegelungGls.gls_para.cBibRegle._.stellgr_alt "verzoegerte Stellgroesse" SWORD UMR___1_1_0_S6_S3 1 100 -32768 32767 DISPLAY_IDENTIFIER stellgr_alt._.cBibRegle.gls_para.iSasRegelungGls ECU_ADDRESS 0xFFF8F1BA /end MEASUREMENT
/begin MEASUREMENT iSasRegelungGls.gls_para.cBibRegle._.stellgr_i_modulo "Ganzzahl. Rest d. I-Quotient" SWORD UMR___1_1_0_S6_S3 1 100 -32768 32767 DISPLAY_IDENTIFIER stellgr_i_modulo._.cBibRegle.gls_para.iSasRegelungGls ECU_ADDRESS 0xFFF8F1BC /end MEASUREMENT
/begin MEASUREMENT iSasRegelungGls.i_wngtgls_filter.x "Filterwert" SLONG UMR___1_300_0_S6_S3 1 100 -7158278.82667 7158278.82333 DISPLAY_IDENTIFIER i_wngtgls_filter.iSasRegelungGls ECU_ADDRESS 0xFFF8F1C0 /end MEASUREMENT
/begin MEASUREMENT iSasZentr.iSchaltend.iKab.pgo_kab_speicher.cBibRampeGradSi16._.letzter_wert "Speichert den letzten Eingangswert" FLOAT32_IEEE UMR___1_1_0_S6_S3 1 100 -1E+037 1E+037 FORMAT "%4.2" DISPLAY_IDENTIFIER letzter_wert._.cBibRampeGradSi16.pgo_kab_speicher.iKab.iSchaltend.iSasZentr ECU_ADDRESS 0xFFF8D6F8 /end MEASUREMENT
/begin MEASUREMENT iSasZentr.iSchaltend.iKab.pgo_kab_speicher.cBibRampeGradSi16._.letzter_ms_timer "Speichert den letzten BS-Timer" UWORD UMR_MSEC__1_1_0_S6_S3 1 100 0 65535 DISPLAY_IDENTIFIER letzter_ms_timer._.cBibRampeGradSi16.pgo_kab_speicher.iKab.iSchaltend.iSasZentr ECU_ADDRESS 0xFFF8D6FC /end MEASUREMENT
/begin MEASUREMENT iSasZentr.iSchaltend.iKab.pgo_kab_speicher.cBibRampeGradSi16._.minimum "Minimum Begrenzung" FLOAT32_IEEE UMR___1_1_0_S6_S3 1 100 -1E+037 1E+037 FORMAT "%4.2" DISPLAY_IDENTIFIER minimum._.cBibRampeGradSi16.pgo_kab_speicher.iKab.iSchaltend.iSasZentr ECU_ADDRESS 0xFFF8D700 /end MEASUREMENT
/begin MEASUREMENT iSasZentr.iSchaltend.iKab.pgo_kab_speicher.cBibRampeGradSi16._.maximum "Maximum Begrenzung" FLOAT32_IEEE UMR___1_1_0_S6_S3 1 100 -1E+037 1E+037 FORMAT "%4.2" DISPLAY_IDENTIFIER maximum._.cBibRampeGradSi16.pgo_kab_speicher.iKab.iSchaltend.iSasZentr ECU_ADDRESS 0xFFF8D704 /end MEASUREMENT
/begin MEASUREMENT iSasZentr.iSchaltend.iKab.raph_kab_speicher.letzter_wert "Speichert den letzten Eingangswert" SLONG UMR___1_1_0_S6_S3 1 100 -2147483648 2147483647 DISPLAY_IDENTIFIER letzter_wert.raph_kab_speicher.iKab.iSchaltend.iSasZentr ECU_ADDRESS 0xFFF8D70C /end MEASUREMENT
/begin MEASUREMENT iSasZentr.iSchaltend.iKab.raph_kab_speicher.letzter_timer "Speichert den letzten BS-Timer" UBYTE UMR_SEC__1_1_0_S6_S3 1 100 0 255 DISPLAY_IDENTIFIER letzter_timer.raph_kab_speicher.iKab.iSchaltend.iSasZentr ECU_ADDRESS 0xFFF8D710 /end MEASUREMENT
/begin MEASUREMENT iSasZentr.iSchaltend.iKab.raps_kab_speicher.letzter_wert "Speichert den letzten Eingangswert" SLONG UMR___1_1_0_S6_S3 1 100 -2147483648 2147483647 DISPLAY_IDENTIFIER letzter_wert.raps_kab_speicher.iKab.iSchaltend.iSasZentr ECU_ADDRESS 0xFFF8D714 /end MEASUREMENT
/begin MEASUREMENT iSasZentr.iSchaltend.iKab.raps_kab_speicher.letzter_timer "Speichert den letzten BS-Timer" UBYTE UMR_SEC__1_1_0_S6_S3 1 100 0 255 DISPLAY_IDENTIFIER letzter_timer.raps_kab_speicher.iKab.iSchaltend.iSasZentr ECU_ADDRESS 0xFFF8D718 /end MEASUREMENT
/begin MEASUREMENT iSasZentr.iSchaltend.iKzu.pgo_kzu_speicher.cBibRampeGradSi16._.letzter_wert "Speichert den letzten Eingangswert" FLOAT32_IEEE UMR___1_1_0_S6_S3 1 100 -1E+037 1E+037 FORMAT "%4.2" DISPLAY_IDENTIFIER letzter_wert._.cBibRampeGradSi16.pgo_kzu_speicher.iKzu.iSchaltend.iSasZentr ECU_ADDRESS 0xFFF8D780 /end MEASUREMENT
/begin MEASUREMENT iSasZentr.iSchaltend.iKzu.pgo_kzu_speicher.cBibRampeGradSi16._.letzter_ms_timer "Speichert den letzten BS-Timer" UWORD UMR_MSEC__1_1_0_S6_S3 1 100 0 65535 DISPLAY_IDENTIFIER letzter_ms_timer._.cBibRampeGradSi16.pgo_kzu_speicher.iKzu.iSchaltend.iSasZentr ECU_ADDRESS 0xFFF8D784 /end MEASUREMENT
/begin MEASUREMENT iSasZentr.iSchaltend.iKzu.pgo_kzu_speicher.cBibRampeGradSi16._.minimum "Minimum Begrenzung" FLOAT32_IEEE UMR___1_1_0_S6_S3 1 100 -1E+037 1E+037 FORMAT "%4.2" DISPLAY_IDENTIFIER minimum._.cBibRampeGradSi16.pgo_kzu_speicher.iKzu.iSchaltend.iSasZentr ECU_ADDRESS 0xFFF8D788 /end MEASUREMENT
/begin MEASUREMENT iSasZentr.iSchaltend.iKzu.pgo_kzu_speicher.cBibRampeGradSi16._.maximum "Maximum Begrenzung" FLOAT32_IEEE UMR___1_1_0_S6_S3 1 100 -1E+037 1E+037 FORMAT "%4.2" DISPLAY_IDENTIFIER maximum._.cBibRampeGradSi16.pgo_kzu_speicher.iKzu.iSchaltend.iSasZentr ECU_ADDRESS 0xFFF8D78C /end MEASUREMENT
/begin MEASUREMENT iSasZentr.iSchaltend.iKzu.raph_kzu_speicher.letzter_wert "Speichert den letzten Eingangswert" SLONG UMR___1_1_0_S6_S3 1 100 -2147483648 2147483647 DISPLAY_IDENTIFIER letzter_wert.raph_kzu_speicher.iKzu.iSchaltend.iSasZentr ECU_ADDRESS 0xFFF8D794 /end MEASUREMENT
/begin MEASUREMENT iSasZentr.iSchaltend.iKzu.raph_kzu_speicher.letzter_timer "Speichert den letzten BS-Timer" UBYTE UMR_SEC__1_1_0_S6_S3 1 100 0 255 DISPLAY_IDENTIFIER letzter_timer.raph_kzu_speicher.iKzu.iSchaltend.iSasZentr ECU_ADDRESS 0xFFF8D798 /end MEASUREMENT
/begin MEASUREMENT iSasZentr.iSchaltend.sp_ngdsynzielgang.n_f "letzter Wert" SLONG UMR___1_1_0_S6_S3 1 100 -2147483648 2147483647 DISPLAY_IDENTIFIER n_f.sp_ngdsynzielgang.iSchaltend.iSasZentr ECU_ADDRESS 0xFFF8D7A8 /end MEASUREMENT
/begin MEASUREMENT iSasZentr.iSchaltend.sp_ngdsynzielgang.letzter_ms_timer "letzter Timerwert" UWORD UMR___1_1_0_S6_S3 1 100 0 65535 DISPLAY_IDENTIFIER letzter_ms_timer.sp_ngdsynzielgang.iSchaltend.iSasZentr ECU_ADDRESS 0xFFF8D7AC /end MEASUREMENT
/begin MEASUREMENT iSasZentr.iVorbereitend.iKab.pgo_kab_speicher.cBibRampeGradSi16._.letzter_wert "Speichert den letzten Eingangswert" FLOAT32_IEEE UMR___1_1_0_S6_S3 1 100 -1E+037 1E+037 FORMAT "%4.2" DISPLAY_IDENTIFIER letzter_wert._.cBibRampeGradSi16.pgo_kab_speicher.iKab.iVorbereitend.iSasZentr ECU_ADDRESS 0xFFF8D830 /end MEASUREMENT
/begin MEASUREMENT iSasZentr.iVorbereitend.iKab.pgo_kab_speicher.cBibRampeGradSi16._.letzter_ms_timer "Speichert den letzten BS-Timer" UWORD UMR_MSEC__1_1_0_S6_S3 1 100 0 65535 DISPLAY_IDENTIFIER letzter_ms_timer._.cBibRampeGradSi16.pgo_kab_speicher.iKab.iVorbereitend.iSasZentr ECU_ADDRESS 0xFFF8D834 /end MEASUREMENT
/begin MEASUREMENT iSasZentr.iVorbereitend.iKab.pgo_kab_speicher.cBibRampeGradSi16._.minimum "Minimum Begrenzung" FLOAT32_IEEE UMR___1_1_0_S6_S3 1 100 -1E+037 1E+037 FORMAT "%4.2" DISPLAY_IDENTIFIER minimum._.cBibRampeGradSi16.pgo_kab_speicher.iKab.iVorbereitend.iSasZentr ECU_ADDRESS 0xFFF8D838 /end MEASUREMENT
/begin MEASUREMENT iSasZentr.iVorbereitend.iKab.pgo_kab_speicher.cBibRampeGradSi16._.maximum "Maximum Begrenzung" FLOAT32_IEEE UMR___1_1_0_S6_S3 1 100 -1E+037 1E+037 FORMAT "%4.2" DISPLAY_IDENTIFIER maximum._.cBibRampeGradSi16.pgo_kab_speicher.iKab.iVorbereitend.iSasZentr ECU_ADDRESS 0xFFF8D83C /end MEASUREMENT
/begin MEASUREMENT iSasZentr.iVorbereitend.iKab.raph_kab_speicher.letzter_wert "Speichert den letzten Eingangswert" SLONG UMR___1_1_0_S6_S3 1 100 -2147483648 2147483647 DISPLAY_IDENTIFIER letzter_wert.raph_kab_speicher.iKab.iVorbereitend.iSasZentr ECU_ADDRESS 0xFFF8D844 /end MEASUREMENT
/begin MEASUREMENT iSasZentr.iVorbereitend.iKab.raph_kab_speicher.letzter_timer "Speichert den letzten BS-Timer" UBYTE UMR_SEC__1_1_0_S6_S3 1 100 0 255 DISPLAY_IDENTIFIER letzter_timer.raph_kab_speicher.iKab.iVorbereitend.iSasZentr ECU_ADDRESS 0xFFF8D848 /end MEASUREMENT
/begin MEASUREMENT iSasZentr.iVorbereitend.iKab.raps_kab_speicher.letzter_wert "Speichert den letzten Eingangswert" SLONG UMR___1_1_0_S6_S3 1 100 -2147483648 2147483647 DISPLAY_IDENTIFIER letzter_wert.raps_kab_speicher.iKab.iVorbereitend.iSasZentr ECU_ADDRESS 0xFFF8D84C /end MEASUREMENT
/begin MEASUREMENT iSasZentr.iVorbereitend.iKab.raps_kab_speicher.letzter_timer "Speichert den letzten BS-Timer" UBYTE UMR_SEC__1_1_0_S6_S3 1 100 0 255 DISPLAY_IDENTIFIER letzter_timer.raps_kab_speicher.iKab.iVorbereitend.iSasZentr ECU_ADDRESS 0xFFF8D850 /end MEASUREMENT
/begin MEASUREMENT iSasZentr.iVorbereitend.iKzu.pgo_kzu_speicher.cBibRampeGradSi16._.letzter_wert "Speichert den letzten Eingangswert" FLOAT32_IEEE UMR___1_1_0_S6_S3 1 100 -1E+037 1E+037 FORMAT "%4.2" DISPLAY_IDENTIFIER letzter_wert._.cBibRampeGradSi16.pgo_kzu_speicher.iKzu.iVorbereitend.iSasZentr ECU_ADDRESS 0xFFF8D8B8 /end MEASUREMENT
/begin MEASUREMENT iSasZentr.iVorbereitend.iKzu.pgo_kzu_speicher.cBibRampeGradSi16._.letzter_ms_timer "Speichert den letzten BS-Timer" UWORD UMR_MSEC__1_1_0_S6_S3 1 100 0 65535 DISPLAY_IDENTIFIER letzter_ms_timer._.cBibRampeGradSi16.pgo_kzu_speicher.iKzu.iVorbereitend.iSasZentr ECU_ADDRESS 0xFFF8D8BC /end MEASUREMENT
/begin MEASUREMENT iSasZentr.iVorbereitend.iKzu.pgo_kzu_speicher.cBibRampeGradSi16._.minimum "Minimum Begrenzung" FLOAT32_IEEE UMR___1_1_0_S6_S3 1 100 -1E+037 1E+037 FORMAT "%4.2" DISPLAY_IDENTIFIER minimum._.cBibRampeGradSi16.pgo_kzu_speicher.iKzu.iVorbereitend.iSasZentr ECU_ADDRESS 0xFFF8D8C0 /end MEASUREMENT
/begin MEASUREMENT iSasZentr.iVorbereitend.iKzu.pgo_kzu_speicher.cBibRampeGradSi16._.maximum "Maximum Begrenzung" FLOAT32_IEEE UMR___1_1_0_S6_S3 1 100 -1E+037 1E+037 FORMAT "%4.2" DISPLAY_IDENTIFIER maximum._.cBibRampeGradSi16.pgo_kzu_speicher.iKzu.iVorbereitend.iSasZentr ECU_ADDRESS 0xFFF8D8C4 /end MEASUREMENT
/begin MEASUREMENT iSasZentr.iVorbereitend.iKzu.raph_kzu_speicher.letzter_wert "Speichert den letzten Eingangswert" SLONG UMR___1_1_0_S6_S3 1 100 -2147483648 2147483647 DISPLAY_IDENTIFIER letzter_wert.raph_kzu_speicher.iKzu.iVorbereitend.iSasZentr ECU_ADDRESS 0xFFF8D8CC /end MEASUREMENT
/begin MEASUREMENT iSasZentr.iVorbereitend.iKzu.raph_kzu_speicher.letzter_timer "Speichert den letzten BS-Timer" UBYTE UMR_SEC__1_1_0_S6_S3 1 100 0 255 DISPLAY_IDENTIFIER letzter_timer.raph_kzu_speicher.iKzu.iVorbereitend.iSasZentr ECU_ADDRESS 0xFFF8D8D0 /end MEASUREMENT
/begin MEASUREMENT iSasZentr.iVorbereitend.sp_ngdsynzielgang.n_f "letzter Wert" SLONG UMR___1_1_0_S6_S3 1 100 -2147483648 2147483647 DISPLAY_IDENTIFIER n_f.sp_ngdsynzielgang.iVorbereitend.iSasZentr ECU_ADDRESS 0xFFF8D8E0 /end MEASUREMENT
/begin MEASUREMENT iSasZentr.iVorbereitend.sp_ngdsynzielgang.letzter_ms_timer "letzter Timerwert" UWORD UMR___1_1_0_S6_S3 1 100 0 65535 DISPLAY_IDENTIFIER letzter_ms_timer.sp_ngdsynzielgang.iVorbereitend.iSasZentr ECU_ADDRESS 0xFFF8D8E4 /end MEASUREMENT
/begin MEASUREMENT iSasZentr.sp_mmotmax_rss.letzter_wert "Speichert den letzten Eingangswert" FLOAT32_IEEE UMR___1_1_0_S6_S3 1 100 -1E+037 1E+037 FORMAT "%4.2" DISPLAY_IDENTIFIER letzter_wert.sp_mmotmax_rss.iSasZentr ECU_ADDRESS 0xFFF8DA58 /end MEASUREMENT
/begin MEASUREMENT iSasZentr.sp_mmotmax_rss.letzter_ms_timer "Speichert den letzten BS-Timer" UWORD UMR_MSEC__1_1_0_S6_S3 1 100 0 65535 DISPLAY_IDENTIFIER letzter_ms_timer.sp_mmotmax_rss.iSasZentr ECU_ADDRESS 0xFFF8DA5C /end MEASUREMENT
/begin MEASUREMENT iSasZentr.sp_mmotmax_rss.minimum "Minimum Begrenzung" FLOAT32_IEEE UMR___1_1_0_S6_S3 1 100 -1E+037 1E+037 FORMAT "%4.2" DISPLAY_IDENTIFIER minimum.sp_mmotmax_rss.iSasZentr ECU_ADDRESS 0xFFF8DA60 /end MEASUREMENT
/begin MEASUREMENT iSasZentr.sp_mmotmax_rss.maximum "Maximum Begrenzung" FLOAT32_IEEE UMR___1_1_0_S6_S3 1 100 -1E+037 1E+037 FORMAT "%4.2" DISPLAY_IDENTIFIER maximum.sp_mmotmax_rss.iSasZentr ECU_ADDRESS 0xFFF8DA64 /end MEASUREMENT
/begin MEASUREMENT iSasPsyst.speicher_filter_psys.x "letzter Wert" SLONG UMR___1_1_0_S6_S3 1 100 -2147483648 2147483647 DISPLAY_IDENTIFIER x.speicher_filter_psys.iSasPsyst ECU_ADDRESS 0xFFF8D5E8 /end MEASUREMENT
/begin MEASUREMENT iSasPsyst.speicher_filter_psys.letzter_ms_timer "letzter BS-Timer" UWORD UMR_MSEC__1_1_0_S6_S3 1 100 0 65535 DISPLAY_IDENTIFIER letzter_ms_timer.speicher_filter_psys.iSasPsyst ECU_ADDRESS 0xFFF8D5EC /end MEASUREMENT
/begin MEASUREMENT iSasPsyst.filter_p_sysist.x "letzter Wert" SLONG UMR___1_1_0_S6_S3 1 100 -2147483648 2147483647 DISPLAY_IDENTIFIER x.filter_p_sysist.iSasPsyst ECU_ADDRESS 0xFFF8D5F0 /end MEASUREMENT
/begin MEASUREMENT iSasPsyst.filter_p_sysist.letzter_ms_timer "letzter BS-Timer" UWORD UMR_MSEC__1_1_0_S6_S3 1 100 0 65535 DISPLAY_IDENTIFIER letzter_ms_timer.filter_p_sysist.iSasPsyst ECU_ADDRESS 0xFFF8D5F4 /end MEASUREMENT
/begin MEASUREMENT iSasPsyst.rampe_p_sysiae.letzter_wert "Speichert den letzten Eingangswert" FLOAT32_IEEE UMR___1_1_0_S6_S3 1 100 -1E+037 1E+037 FORMAT "%4.2" DISPLAY_IDENTIFIER letzter_wert.rampe_p_sysiae.iSasPsyst ECU_ADDRESS 0xFFF8D5F8 /end MEASUREMENT
/begin MEASUREMENT iSasPsyst.rampe_p_sysiae.letzter_ms_timer "Speichert den letzten BS-Timer" UWORD UMR_MSEC__1_1_0_S6_S3 1 100 0 65535 DISPLAY_IDENTIFIER letzter_ms_timer.rampe_p_sysiae.iSasPsyst ECU_ADDRESS 0xFFF8D5FC /end MEASUREMENT
/begin MEASUREMENT iSasPsyst.rampe_p_sysiae.minimum "Minimum Begrenzung" FLOAT32_IEEE UMR___1_1_0_S6_S3 1 100 -1E+037 1E+037 FORMAT "%4.2" DISPLAY_IDENTIFIER minimum.rampe_p_sysiae.iSasPsyst ECU_ADDRESS 0xFFF8D600 /end MEASUREMENT
/begin MEASUREMENT iSasPsyst.rampe_p_sysiae.maximum "Maximum Begrenzung" FLOAT32_IEEE UMR___1_1_0_S6_S3 1 100 -1E+037 1E+037 FORMAT "%4.2" DISPLAY_IDENTIFIER maximum.rampe_p_sysiae.iSasPsyst ECU_ADDRESS 0xFFF8D604 /end MEASUREMENT
/begin MEASUREMENT iSasPsyst.rampe_p_syspulsada.letzter_wert "Speichert den letzten Eingangswert" FLOAT32_IEEE UMR___1_1_0_S6_S3 1 100 -1E+037 1E+037 FORMAT "%4.2" DISPLAY_IDENTIFIER letzter_wert.rampe_p_syspulsada.iSasPsyst ECU_ADDRESS 0xFFF8D608 /end MEASUREMENT
/begin MEASUREMENT iSasPsyst.rampe_p_syspulsada.letzter_ms_timer "Speichert den letzten BS-Timer" UWORD UMR_MSEC__1_1_0_S6_S3 1 100 0 65535 DISPLAY_IDENTIFIER letzter_ms_timer.rampe_p_syspulsada.iSasPsyst ECU_ADDRESS 0xFFF8D60C /end MEASUREMENT
/begin MEASUREMENT iSasPsyst.rampe_p_syspulsada.minimum "Minimum Begrenzung" FLOAT32_IEEE UMR___1_1_0_S6_S3 1 100 -1E+037 1E+037 FORMAT "%4.2" DISPLAY_IDENTIFIER minimum.rampe_p_syspulsada.iSasPsyst ECU_ADDRESS 0xFFF8D610 /end MEASUREMENT
/begin MEASUREMENT iSasPsyst.rampe_p_syspulsada.maximum "Maximum Begrenzung" FLOAT32_IEEE UMR___1_1_0_S6_S3 1 100 -1E+037 1E+037 FORMAT "%4.2" DISPLAY_IDENTIFIER maximum.rampe_p_syspulsada.iSasPsyst ECU_ADDRESS 0xFFF8D614 /end MEASUREMENT
/begin MEASUREMENT iTciCompu.iPKZuFilter.x "letzter Wert" SLONG UMR___1_1_0_S6_S3 1 100 -2147483648 2147483647 DISPLAY_IDENTIFIER x.iPKZuFilter.iTciCompu ECU_ADDRESS 0xFFF8DAF0 /end MEASUREMENT
/begin MEASUREMENT iTciCompu.iPKZuFilter.letzter_ms_timer "letzter BS-Timer" UWORD UMR_MSEC__1_1_0_S6_S3 1 100 0 65535 DISPLAY_IDENTIFIER letzter_ms_timer.iPKZuFilter.iTciCompu ECU_ADDRESS 0xFFF8DAF4 /end MEASUREMENT
/begin MEASUREMENT iTciCompu.iPKAbFilter.x "letzter Wert" SLONG UMR___1_1_0_S6_S3 1 100 -2147483648 2147483647 DISPLAY_IDENTIFIER x.iPKAbFilter.iTciCompu ECU_ADDRESS 0xFFF8DAF8 /end MEASUREMENT
/begin MEASUREMENT iTciCompu.iPKAbFilter.letzter_ms_timer "letzter BS-Timer" UWORD UMR_MSEC__1_1_0_S6_S3 1 100 0 65535 DISPLAY_IDENTIFIER letzter_ms_timer.iPKAbFilter.iTciCompu ECU_ADDRESS 0xFFF8DAFC /end MEASUREMENT
/begin MEASUREMENT iTempMKupA.PT2CKupplung.x "Filterwert" FLOAT32_IEEE UMR___1_1_0_S6_S3 1 100 -2147483648 2147483647 FORMAT "%4.2" DISPLAY_IDENTIFIER x.PT2CKupplung.iTempMKupA ECU_ADDRESS 0xFFF8DB18 /end MEASUREMENT
/begin MEASUREMENT iTempMKupA.PT2CKupplung.xp "Ableitung vom Eingangswert" FLOAT32_IEEE UMR__SEC_1_1_0_S6_S3 1 100 -2147483648 2147483647 FORMAT "%4.2" DISPLAY_IDENTIFIER xp.PT2CKupplung.iTempMKupA ECU_ADDRESS 0xFFF8DB1C /end MEASUREMENT
/begin MEASUREMENT iTempMKupC.PT2CKupplung.x "Filterwert" FLOAT32_IEEE UMR___1_1_0_S6_S3 1 100 -2147483648 2147483647 FORMAT "%4.2" DISPLAY_IDENTIFIER x.PT2CKupplung.iTempMKupC ECU_ADDRESS 0xFFF8DB34 /end MEASUREMENT
/begin MEASUREMENT iTempMKupC.PT2CKupplung.xp "Ableitung vom Eingangswert" FLOAT32_IEEE UMR__SEC_1_1_0_S6_S3 1 100 -2147483648 2147483647 FORMAT "%4.2" DISPLAY_IDENTIFIER xp.PT2CKupplung.iTempMKupC ECU_ADDRESS 0xFFF8DB38 /end MEASUREMENT
/begin MEASUREMENT iTempMKupD.PT2CKupplung.x "Filterwert" FLOAT32_IEEE UMR___1_1_0_S6_S3 1 100 -2147483648 2147483647 FORMAT "%4.2" DISPLAY_IDENTIFIER x.PT2CKupplung.iTempMKupD ECU_ADDRESS 0xFFF8DB50 /end MEASUREMENT
/begin MEASUREMENT iTempMKupD.PT2CKupplung.xp "Ableitung vom Eingangswert" FLOAT32_IEEE UMR__SEC_1_1_0_S6_S3 1 100 -2147483648 2147483647 FORMAT "%4.2" DISPLAY_IDENTIFIER xp.PT2CKupplung.iTempMKupD ECU_ADDRESS 0xFFF8DB54 /end MEASUREMENT
/begin MEASUREMENT iTempMKupE.PT2CKupplung.x "Filterwert" FLOAT32_IEEE UMR___1_1_0_S6_S3 1 100 -2147483648 2147483647 FORMAT "%4.2" DISPLAY_IDENTIFIER x.PT2CKupplung.iTempMKupE ECU_ADDRESS 0xFFF8DB6C /end MEASUREMENT
/begin MEASUREMENT iTempMKupE.PT2CKupplung.xp "Ableitung vom Eingangswert" FLOAT32_IEEE UMR__SEC_1_1_0_S6_S3 1 100 -2147483648 2147483647 FORMAT "%4.2" DISPLAY_IDENTIFIER xp.PT2CKupplung.iTempMKupE ECU_ADDRESS 0xFFF8DB70 /end MEASUREMENT
/begin MEASUREMENT iSasKflwe.p_kab_kflw_speicher.letzter_wert "Speichert den letzten Eingangswert" FLOAT32_IEEE UMR___1_1_0_S6_S3 1 100 -1E+037 1E+037 FORMAT "%4.2" DISPLAY_IDENTIFIER letzter_wert.p_kab_kflw_speicher.iSasKflwe ECU_ADDRESS 0xFFF8D590 /end MEASUREMENT
/begin MEASUREMENT iSasKflwe.p_kab_kflw_speicher.letzter_ms_timer "Speichert den letzten BS-Timer" UWORD UMR_MSEC__1_1_0_S6_S3 1 100 0 65535 DISPLAY_IDENTIFIER letzter_ms_timer.p_kab_kflw_speicher.iSasKflwe ECU_ADDRESS 0xFFF8D594 /end MEASUREMENT
/begin MEASUREMENT iSasKflwe.p_kab_kflw_speicher.minimum "Minimum Begrenzung" FLOAT32_IEEE UMR___1_1_0_S6_S3 1 100 -1E+037 1E+037 FORMAT "%4.2" DISPLAY_IDENTIFIER minimum.p_kab_kflw_speicher.iSasKflwe ECU_ADDRESS 0xFFF8D598 /end MEASUREMENT
/begin MEASUREMENT iSasKflwe.p_kab_kflw_speicher.maximum "Maximum Begrenzung" FLOAT32_IEEE UMR___1_1_0_S6_S3 1 100 -1E+037 1E+037 FORMAT "%4.2" DISPLAY_IDENTIFIER maximum.p_kab_kflw_speicher.iSasKflwe ECU_ADDRESS 0xFFF8D59C /end MEASUREMENT
/begin MEASUREMENT iSasKflwe.p_kab_kflw2_speicher.letzter_wert "Speichert den letzten Eingangswert" FLOAT32_IEEE UMR___1_1_0_S6_S3 1 100 -1E+037 1E+037 FORMAT "%4.2" DISPLAY_IDENTIFIER letzter_wert.p_kab_kflw2_speicher.iSasKflwe ECU_ADDRESS 0xFFF8D5A8 /end MEASUREMENT
/begin MEASUREMENT iSasKflwe.p_kab_kflw2_speicher.letzter_ms_timer "Speichert den letzten BS-Timer" UWORD UMR_MSEC__1_1_0_S6_S3 1 100 0 65535 DISPLAY_IDENTIFIER letzter_ms_timer.p_kab_kflw2_speicher.iSasKflwe ECU_ADDRESS 0xFFF8D5AC /end MEASUREMENT
/begin MEASUREMENT iSasKflwe.p_kab_kflw2_speicher.minimum "Minimum Begrenzung" FLOAT32_IEEE UMR___1_1_0_S6_S3 1 100 -1E+037 1E+037 FORMAT "%4.2" DISPLAY_IDENTIFIER minimum.p_kab_kflw2_speicher.iSasKflwe ECU_ADDRESS 0xFFF8D5B0 /end MEASUREMENT
/begin MEASUREMENT iSasKflwe.p_kab_kflw2_speicher.maximum "Maximum Begrenzung" FLOAT32_IEEE UMR___1_1_0_S6_S3 1 100 -1E+037 1E+037 FORMAT "%4.2" DISPLAY_IDENTIFIER maximum.p_kab_kflw2_speicher.iSasKflwe ECU_ADDRESS 0xFFF8D5B4 /end MEASUREMENT
/begin MEASUREMENT iMoeMesaf.filter_spez_me.start_wert "Startwert" SWORD UMR___1_1_0_S6_S3 1 100 -32768 32767 DISPLAY_IDENTIFIER start_wert.filter_spez_me.iMoeMesaf ECU_ADDRESS 0xFFF8D55C /end MEASUREMENT
/begin MEASUREMENT iMoeMesaf.filter_spez_me.x "normierter letzter Wert (0 bis 1)" SLONG UMR___1_1_0_S6_S3 1 100 -2147483648 2147483647 DISPLAY_IDENTIFIER x.filter_spez_me.iMoeMesaf ECU_ADDRESS 0xFFF8D560 /end MEASUREMENT
/begin MEASUREMENT iMoeMesaf.filter_spez_me.letzter_ms_timer "letzter Timerwert" UWORD UMR___1_1_0_S6_S3 1 100 0 65535 DISPLAY_IDENTIFIER letzter_ms_timer.filter_spez_me.iMoeMesaf ECU_ADDRESS 0xFFF8D564 /end MEASUREMENT
/begin MEASUREMENT iSasAnGeaKraftschl.pgo_gea_rampe.cBibRampeGradSi16._.letzter_wert "Speichert den letzten Eingangswert" FLOAT32_IEEE UMR___1_1_0_S6_S3 1 100 -1E+037 1E+037 FORMAT "%4.2" DISPLAY_IDENTIFIER letzter_wert._.cBibRampeGradSi16.pgo_gea_rampe.iSasAnGeaKraftschl ECU_ADDRESS 0xFFF8F058 /end MEASUREMENT
/begin MEASUREMENT iSasAnGeaKraftschl.pgo_gea_rampe.cBibRampeGradSi16._.letzter_ms_timer "Speichert den letzten BS-Timer" UWORD UMR_MSEC__1_1_0_S6_S3 1 100 0 65535 DISPLAY_IDENTIFIER letzter_ms_timer._.cBibRampeGradSi16.pgo_gea_rampe.iSasAnGeaKraftschl ECU_ADDRESS 0xFFF8F05C /end MEASUREMENT
/begin MEASUREMENT iSasAnGeaKraftschl.pgo_gea_rampe.cBibRampeGradSi16._.minimum "Minimum Begrenzung" FLOAT32_IEEE UMR___1_1_0_S6_S3 1 100 -1E+037 1E+037 FORMAT "%4.2" DISPLAY_IDENTIFIER minimum._.cBibRampeGradSi16.pgo_gea_rampe.iSasAnGeaKraftschl ECU_ADDRESS 0xFFF8F060 /end MEASUREMENT
/begin MEASUREMENT iSasAnGeaKraftschl.pgo_gea_rampe.cBibRampeGradSi16._.maximum "Maximum Begrenzung" FLOAT32_IEEE UMR___1_1_0_S6_S3 1 100 -1E+037 1E+037 FORMAT "%4.2" DISPLAY_IDENTIFIER maximum._.cBibRampeGradSi16.pgo_gea_rampe.iSasAnGeaKraftschl ECU_ADDRESS 0xFFF8F064 /end MEASUREMENT
/begin MEASUREMENT iSasAnGeaNichtKraftschl1.pgo_gea_rampe.cBibRampeGradSi16._.letzter_wert "Speichert den letzten Eingangswert" FLOAT32_IEEE UMR___1_1_0_S6_S3 1 100 -1E+037 1E+037 FORMAT "%4.2" DISPLAY_IDENTIFIER letzter_wert._.cBibRampeGradSi16.pgo_gea_rampe.iSasAnGeaNichtKraftschl1 ECU_ADDRESS 0xFFF8F0C0 /end MEASUREMENT
/begin MEASUREMENT iSasAnGeaNichtKraftschl1.pgo_gea_rampe.cBibRampeGradSi16._.letzter_ms_timer "Speichert den letzten BS-Timer" UWORD UMR_MSEC__1_1_0_S6_S3 1 100 0 65535 DISPLAY_IDENTIFIER letzter_ms_timer._.cBibRampeGradSi16.pgo_gea_rampe.iSasAnGeaNichtKraftschl1 ECU_ADDRESS 0xFFF8F0C4 /end MEASUREMENT
/begin MEASUREMENT iSasAnGeaNichtKraftschl1.pgo_gea_rampe.cBibRampeGradSi16._.minimum "Minimum Begrenzung" FLOAT32_IEEE UMR___1_1_0_S6_S3 1 100 -1E+037 1E+037 FORMAT "%4.2" DISPLAY_IDENTIFIER minimum._.cBibRampeGradSi16.pgo_gea_rampe.iSasAnGeaNichtKraftschl1 ECU_ADDRESS 0xFFF8F0C8 /end MEASUREMENT
/begin MEASUREMENT iSasAnGeaNichtKraftschl1.pgo_gea_rampe.cBibRampeGradSi16._.maximum "Maximum Begrenzung" FLOAT32_IEEE UMR___1_1_0_S6_S3 1 100 -1E+037 1E+037 FORMAT "%4.2" DISPLAY_IDENTIFIER maximum._.cBibRampeGradSi16.pgo_gea_rampe.iSasAnGeaNichtKraftschl1 ECU_ADDRESS 0xFFF8F0CC /end MEASUREMENT
/begin MEASUREMENT iSasAnGeaNichtKraftschl2.pgo_gea_rampe.cBibRampeGradSi16._.letzter_wert "Speichert den letzten Eingangswert" FLOAT32_IEEE UMR___1_1_0_S6_S3 1 100 -1E+037 1E+037 FORMAT "%4.2" DISPLAY_IDENTIFIER letzter_wert._.cBibRampeGradSi16.pgo_gea_rampe.iSasAnGeaNichtKraftschl2 ECU_ADDRESS 0xFFF8F128 /end MEASUREMENT
/begin MEASUREMENT iSasAnGeaNichtKraftschl2.pgo_gea_rampe.cBibRampeGradSi16._.letzter_ms_timer "Speichert den letzten BS-Timer" UWORD UMR_MSEC__1_1_0_S6_S3 1 100 0 65535 DISPLAY_IDENTIFIER letzter_ms_timer._.cBibRampeGradSi16.pgo_gea_rampe.iSasAnGeaNichtKraftschl2 ECU_ADDRESS 0xFFF8F12C /end MEASUREMENT
/begin MEASUREMENT iSasAnGeaNichtKraftschl2.pgo_gea_rampe.cBibRampeGradSi16._.minimum "Minimum Begrenzung" FLOAT32_IEEE UMR___1_1_0_S6_S3 1 100 -1E+037 1E+037 FORMAT "%4.2" DISPLAY_IDENTIFIER minimum._.cBibRampeGradSi16.pgo_gea_rampe.iSasAnGeaNichtKraftschl2 ECU_ADDRESS 0xFFF8F130 /end MEASUREMENT
/begin MEASUREMENT iSasAnGeaNichtKraftschl2.pgo_gea_rampe.cBibRampeGradSi16._.maximum "Maximum Begrenzung" FLOAT32_IEEE UMR___1_1_0_S6_S3 1 100 -1E+037 1E+037 FORMAT "%4.2" DISPLAY_IDENTIFIER maximum._.cBibRampeGradSi16.pgo_gea_rampe.iSasAnGeaNichtKraftschl2 ECU_ADDRESS 0xFFF8F134 /end MEASUREMENT
/begin MEASUREMENT iUewIgBerechnung.iMGSollmoment.n_f "letzter Wert" SLONG UMR___1_1_0_S6_S3 1 100 -2147483648 2147483647 DISPLAY_IDENTIFIER n_f.iMGSollmoment.iUewIgBerechnung ECU_ADDRESS 0xFFF8DC1C /end MEASUREMENT
/begin MEASUREMENT iUewIgBerechnung.iMGSollmoment.letzter_ms_timer "letzter Timerwert" UWORD UMR___1_1_0_S6_S3 1 100 0 65535 DISPLAY_IDENTIFIER letzter_ms_timer.iMGSollmoment.iUewIgBerechnung ECU_ADDRESS 0xFFF8DC20 /end MEASUREMENT
/begin MEASUREMENT iUewParksperrenmagnet.iTimerVerzpmueb.timer "Der aktuelle Timerwert" UWORD UMR_MSEC__10_1_0_S6_S3 1 100 0 655350 DISPLAY_IDENTIFIER iTimerVerzpmueb.iUewParksperrenmagnet ECU_ADDRESS 0xFFF8DC2E /end MEASUREMENT
/begin MEASUREMENT iUewParksperrenmagnet.iTimerPmdef.timer "Der aktuelle Timerwert" UBYTE UMR_MSEC__10_1_0_S6_S3 1 100 0 2550 DISPLAY_IDENTIFIER iTimerPmdef.iUewParksperrenmagnet ECU_ADDRESS 0xFFF8DC30 /end MEASUREMENT
/begin MEASUREMENT iUewParksperrenmagnet.iTimerPmueb.timer "Der aktuelle Timerwert" ULONG UMR_MSEC__10_1_0_S6_S3 1 100 0 42949672950 DISPLAY_IDENTIFIER iTimerPmueb.iUewParksperrenmagnet ECU_ADDRESS 0xFFF8DC34 /end MEASUREMENT
/begin MEASUREMENT iUewPosVTimerZuendung.cUewTimerZuendung._.iTimerVerzNmotMax.timer "Der aktuelle Timerwert" ULONG UMR_MSEC__10_1_0_S6_S3 1 100 0 42949672950 DISPLAY_IDENTIFIER iTimerVerzNmotMax._.cUewTimerZuendung.iUewPosVTimerZuendung ECU_ADDRESS 0xFFF8F1C4 /end MEASUREMENT
/begin MEASUREMENT iEdsKupA.iTimerZRampe.timer "Der aktuelle Timerwert" UWORD UMR_MSEC__10_1_0_S6_S3 1 100 0 655350 DISPLAY_IDENTIFIER iTimerZRampe.iEdsKupA ECU_ADDRESS 0xFFF8CDC4 /end MEASUREMENT
/begin MEASUREMENT iEdsKupB.iTimerZRampe.timer "Der aktuelle Timerwert" UWORD UMR_MSEC__10_1_0_S6_S3 1 100 0 655350 DISPLAY_IDENTIFIER iTimerZRampe.iEdsKupB ECU_ADDRESS 0xFFF8CDEC /end MEASUREMENT
/begin MEASUREMENT iEdsKupC.iTimerZRampe.timer "Der aktuelle Timerwert" UWORD UMR_MSEC__10_1_0_S6_S3 1 100 0 655350 DISPLAY_IDENTIFIER iTimerZRampe.iEdsKupC ECU_ADDRESS 0xFFF8CE14 /end MEASUREMENT
/begin MEASUREMENT iEdsKupD.iTimerZRampe.timer "Der aktuelle Timerwert" UWORD UMR_MSEC__10_1_0_S6_S3 1 100 0 655350 DISPLAY_IDENTIFIER iTimerZRampe.iEdsKupD ECU_ADDRESS 0xFFF8CE3C /end MEASUREMENT
/begin MEASUREMENT iEdsKupE.iTimerZRampe.timer "Der aktuelle Timerwert" UWORD UMR_MSEC__10_1_0_S6_S3 1 100 0 655350 DISPLAY_IDENTIFIER iTimerZRampe.iEdsKupE ECU_ADDRESS 0xFFF8CE64 /end MEASUREMENT
/begin MEASUREMENT iEdsK0.iTimerZRampe.timer "Der aktuelle Timerwert" UWORD UMR_MSEC__10_1_0_S6_S3 1 100 0 655350 DISPLAY_IDENTIFIER iTimerZRampe.iEdsK0 ECU_ADDRESS 0xFFF8CE8C /end MEASUREMENT
/begin MEASUREMENT iEdsPos.timer_iedsofpsv.timer "Der aktuelle Timerwert" UBYTE UMR_MSEC__10_1_0_S6_S3 1 100 0 2550 DISPLAY_IDENTIFIER timer_iedsofpsv.iEdsPos ECU_ADDRESS 0xFFF8CEAE /end MEASUREMENT
/begin COMPU_METHOD UMR___1_300_0_S6_S3 "int = ((phys * 300) / 1) - (0) [-]" RAT_FUNC "%7.5" "[-]" COEFFS 0 300 -0 0 0 1 /end COMPU_METHOD
/begin COMPU_METHOD UMR___1_1_0_S6_S3 "int = ((phys * 1) / 1) - (0) [-]" RAT_FUNC "%2.0" "[-]" COEFFS 0 1 -0 0 0 1 /end COMPU_METHOD
/begin COMPU_METHOD UMR_U_MIN_1_1_0_S6_S3 "int = ((phys * 1) / 1) - (0) [U/min]" RAT_FUNC "%2.0" "[U/min]" COEFFS 0 1 -0 0 0 1 /end COMPU_METHOD
/begin COMPU_METHOD UMR_MSEC__1_1_0_S6_S3 "int = ((phys * 1) / 1) - (0) [ms]" RAT_FUNC "%2.0" "[ms]" COEFFS 0 1 -0 0 0 1 /end COMPU_METHOD
/begin COMPU_METHOD UMR_MSEC__10_1_0_S6_S3 "int = ((phys * 1) / 10) - (0) [ms]" RAT_FUNC "%2.0" "[ms]" COEFFS 0 1 -0 0 0 10 /end COMPU_METHOD
/begin COMPU_METHOD UMR_SEC__1_100_0_S6_S3 "int = ((phys * 100) / 1) - (0) [s]" RAT_FUNC "%4.2" "[s]" COEFFS 0 100 -0 0 0 1 /end COMPU_METHOD
/begin COMPU_METHOD UMR_SEC__1_1_0_S6_S3 "int = ((phys * 1) / 1) - (0) [s]" RAT_FUNC "%2.0" "[s]" COEFFS 0 1 -0 0 0 1 /end COMPU_METHOD
/begin COMPU_METHOD UMR__SEC_1_1_0_S6_S3 "int = ((phys * 1) / 1) - (0) [1/s]" RAT_FUNC "%2.0" "[1/s]" COEFFS 0 1 -0 0 0 1 /end COMPU_METHOD
/begin COMPU_METHOD Conv.cBibAglex._.z_agl_S6_S3 "Umrechnung fuer Messgroesse cBibAglex::z_agl" TAB_VERB "%4.0" "" COMPU_TAB_REF Conv.cBibAglex._.z_agl_S6_S3 /end COMPU_METHOD
/begin COMPU_METHOD Conv.cBibAglex._.z_ringspeicher_S6_S3 "Umrechnung fuer Messgroesse cBibAglex::z_ringspeicher" TAB_VERB "%4.0" "" COMPU_TAB_REF Conv.cBibAglex._.z_ringspeicher_S6_S3 /end COMPU_METHOD
/begin COMPU_METHOD Conv.cBibAglex._.func_agl_S6_S3 "Umrechnung fuer Messgroesse cBibAglex::func_agl" TAB_VERB "%4.0" "" COMPU_TAB_REF Conv.cBibAglex._.func_agl_S6_S3 /end COMPU_METHOD
/begin COMPU_METHOD Conv.cBibAglex._.signal_agl_S6_S3 "Umrechnung fuer Messgroesse cBibAglex::signal_agl" TAB_VERB "%4.0" "" COMPU_TAB_REF Conv.cBibAglex._.signal_agl_S6_S3 /end COMPU_METHOD
/begin COMPU_METHOD Conv.cBibAglex._.f_nicht_berechnen_S6_S3 "Umrechnung fuer Messgroesse cBibAglex::f_nicht_berechnen" TAB_VERB "%4.0" "" COMPU_TAB_REF Conv.cBibAglex._.f_nicht_berechnen_S6_S3 /end COMPU_METHOD
/begin COMPU_VTAB Conv.cBibAglex._.z_agl_S6_S3 "Umrechnung fuer Messgroesse cBibAglex::z_agl" TAB_VERB 5 0 "Z_AGL_PASSIV" 1 "Z_AGL_INIT" 2 "Z_AGL_AKTIV" 3 "Z_AGL_NICHT_BERECHNEN" 4 "Z_AGL_FEHLER_UEBERLAUF" /end COMPU_VTAB
/begin COMPU_VTAB Conv.cBibAglex._.z_ringspeicher_S6_S3 "Umrechnung fuer Messgroesse cBibAglex::z_ringspeicher" TAB_VERB 3 0 "RINGSPEICHER_PASSIV" 1 "RINGSPEICHER_INIT" 2 "RINGSPEICHER_AKTIV" /end COMPU_VTAB
/begin COMPU_VTAB Conv.cBibAglex._.func_agl_S6_S3 "Umrechnung fuer Messgroesse cBibAglex::func_agl" TAB_VERB 5 0 "ADA_FUNC_AGL_KEINE" 1 "ADA_KUP" 2 "ADA_SF_WK" 3 "ADA_PRE_SCHALTKUP" 4 "ADA_PRE_K0" /end COMPU_VTAB
/begin COMPU_VTAB Conv.cBibAglex._.signal_agl_S6_S3 "Umrechnung fuer Messgroesse cBibAglex::signal_agl" TAB_VERB 6 0 "AGL_MIT_NAB" 1 "AGL_MIT_NT" 2 "AGL_MIT_MITTELWERT" 3 "AGL_MIT_NMOT" 4 "AGL_MIT_N6" 5 "AGL_MIT_VMOT" /end COMPU_VTAB
/begin COMPU_VTAB Conv.cBibAglex._.f_nicht_berechnen_S6_S3 "Umrechnung fuer Messgroesse cBibAglex::f_nicht_berechnen" TAB_VERB 2 0 "FALSE" 1 "TRUE" /end COMPU_VTAB
/begin FUNCTION BIB_FUNKTION "In BIB_FUNKTION sind alle Funktionsbibliotheken enthalten"
 /begin LOC_MEASUREMENT iAdaGlosc.FiAxRefAdaOff.x iAdaIaeApIae.RampeAdaIae.letzter_ms_timer iAdaIaeApIae.RampeAdaIae.letzter_wert iAdaIaeApIae.RampeAdaIae.maximum iAdaIaeApIae.RampeAdaIae.minimum iAdaIaeApIae.TimerAdaIae.time iAdaIaeApIae.TimerKriterienAdaIae.time iAdaIaeApIae.TimerMaxWartenAdaIae.time iAdaIaeApIep.TimerAdaIaeApIep.time iAdaIaeApIep.TimerAdaIaeApIepMaxAbsenken.time iAdaIaeApKorr.FiMGMotIstAdaIae.x iAdaIaeApKorr.FiMGMotIstAdaIae.xp iAdaIaeApKorr.FiMMotIstAdaIae.x iAdaIaeApKorr.FiMMotIstAdaIaeFloat.x iAdaIaeApKorr.FiNGMotAdaIae.x iAdaIaeApKorr.FiNGMotAdaIae.xp iAdaIaeApKorr.FiNMotAdaIae.x iAdaIaeApKorr.FiNMotAdaIaeFloat.x iAdaIaeApKorr.TimerAdaIaeApKorr.time iAdaIaeApKorr.TimerMaxWartenAdaIaeApKorr.time iAdaPfusf.n_f_alt.letzter_ms_timer iAdaPfusf.n_f_alt.n_f iAdaPstSysNmot.timer_nmotleersoll_aktiv_stada.timer iAdaPstzs.iBew.iFensterNeg.iTimerBeenden.timer iAdaPstzs.iBew.iFensterNeg.iTimerStarten.timer iAdaPstzs.iBew.iFensterPos.iTimerBeenden.timer iAdaPstzs.iBew.iFensterPos.iTimerStarten.timer iAdaPstzs.iBew.iTimerAmp.timer iAdaPstzs.iPf.iZustandstimerStada.timer iAdaPstzs.iPre.iRampeAb.letzter_timer iAdaPstzs.iPre.iRampeAb.letzter_wert iAdaPstzs.iPre.iRampeAuf.letzter_ms_timer iAdaPstzs.iPre.iRampeAuf.letzter_wert iAdaPstzs.iPre.iRampeAuf.maximum iAdaPstzs.iPre.iRampeAuf.minimum iAdaPstzs.iPre.iZustandstimerStada.timer iAdaPstzs.iTMaxInitStada.timer iAdaPstzs.iZustandstimerStada.timer iAdaPulzs.iBew.iFensterNeg.iTimerBeenden.timer iAdaPulzs.iBew.iFensterNeg.iTimerStarten.timer iAdaPulzs.iBew.iFensterPos.iTimerBeenden.timer iAdaPulzs.iBew.iFensterPos.iTimerStarten.timer iAdaPulzs.iBew.iTimerAmp.timer iAdaPulzs.iHsv.iAbbruch.timer iAdaPulzs.iPf.iZustandstimer.timer iAdaPulzs.iTimerDeakDaempfer.timer iAdaPulzs.iTimerSpzNRea.timer iAdaPulzs.iZustandstimer.timer iAdaUrlufterkPuls.iZeitfenster.timer iAdaUrlufterkSchaltung.iSignal.iPt1.x iAdaUrlufterkSchaltung.iZeitfenster.timer iAzsKupMassnahmenKoord.iSchaltungVerz.iVerzZeit.time iAzsNeutralEbene.TimerNE.time iAzsSZPulsAda.TimerMaxTime.time iAzsSZPulsAda.TimerSZPulsAda.time iBibAglex.anzahl_werte iBibAglex.extrapolationsschritte iBibAglex.extrapolierter_wert iBibAglex.f_nicht_berechnen iBibAglex.func_agl iBibAglex.index_aeltester_wert iBibAglex.index_erster_wert iBibAglex.laenge iBibAglex.n_aktuell iBibAglex.n_guete iBibAglex.noch_benoetigte_werte iBibAglex.signal_agl iBibAglex.steigung iBibAglex.sum_xi_q iBibAglex.sum_yi iBibAglex.x_0 iBibAglex.x_expol iBibAglex.y_0 iBibAglex.z_agl iBibAglex.z_ringspeicher iBihMPuauf.Pt1MPuAuf.x iBihMomen.TimerK0Verlust.time iBihMomenHsHss.iTimerGesamtHssPhase.timer iBihMomenHsHss.iTimerGesamtHssStartRampe3.timer iBihSigna.timer_sbc_aktiv.timer iBihSigna.timer_zielgang_aenderung.timer iBihTimer.timer_difference iBihTimer.timer_difference_10ms_skal iBihTimer.timer_difference_1ms_skal iBihTimer.timer_old_value iBihTimer.timer_reset.timer iEdsK0.iTimerZRampe.timer iEdsKupA.iTimerZRampe.timer iEdsKupB.iTimerZRampe.timer iEdsKupC.iTimerZRampe.timer iEdsKupD.iTimerZRampe.timer iEdsKupE.iTimerZRampe.timer iEdsPos.timer_iedsofpsv.timer iIaeAdauf.iTLaufUefiae.timer iIaeDiagn.Pt1Axrefiae.x iIaeDiagn.Pt1Mdidiagiae.x iIaeDiagn.TimerCloseBewAktiv.maxtime iIaeDiagn.TimerCloseBewAktiv.time iIaeDiagn.TimerCloseNgab.maxtime iIaeDiagn.TimerCloseNgab.time iIaeDiagn.TimerCloseRueckF.maxtime iIaeDiagn.TimerCloseRueckF.time iIaeDiagn.TimerNoCloseDiagiae.maxtime iIaeDiagn.TimerNoCloseDiagiae.time iIaeDiagn.TimerNoOpenDiagiae.maxtime iIaeDiagn.TimerNoOpenDiagiae.time iIaeDiagn.TimerNocloseBewAktiv.maxtime iIaeDiagn.TimerNocloseBewAktiv.time iIaeDiagn.TimerNoopenBewAktiv.maxtime iIaeDiagn.TimerNoopenBewAktiv.time iIaeDiagn.TimerNoopenRueckF.maxtime iIaeDiagn.TimerNoopenRueckF.time iIaeDraus.Dt1PGStell.Pt1Si16.x iIaeDraus.Dt1PGStell.xp iIaeDraus.Pt1Mue.x iIaeDraus.Pt1PDStellHysS.x iIaeDraus.Pt1PStellbasis.x iIaeDraus.Pt1PoDyn.x iIaeDraus.Pt1PoHysKo.x iIaeDraus.Pt2PIst.x iIaeDraus.Pt2PIst.xp iIaeDraus.TimerHysSchl.maxtime iIaeDraus.TimerHysSchl.time iIaeDraus.TimerHyskompan.maxtime iIaeDraus.TimerHyskompan.time iIaeDraus.TimerPoDyn.maxtime iIaeDraus.TimerPoDyn.time iIaeKordi.TimerZIae.maxtime iIaeKordi.TimerZIae.time iIaeKuehl.Pt1VpKuehlKorr.x iIaeKuehl.Pt1Vpsoll.x iIaeKuehl.TimerZModusIae.maxtime iIaeKuehl.TimerZModusIae.time iIaeMomen.BibPIDIae.faktor_d iIaeMomen.BibPIDIae.faktor_i iIaeMomen.BibPIDIae.faktor_p iIaeMomen.BibPIDIae.faktor_t1 iIaeMomen.BibPIDIae.regel_diff_alt iIaeMomen.BibPIDIae.stell_max iIaeMomen.BibPIDIae.stell_min iIaeMomen.BibPIDIae.stellgr_alt iIaeMomen.BibPIDIae.stellgr_d_alt iIaeMomen.BibPIDIae.stellgr_i_alt iIaeMomen.BibPIDIae.stellgr_i_modulo iIaeMomen.Pt1FMBasisAnfahrtIae.x iIaeMomen.Pt1IStuetz.x iIaeMomen.Pt1NMotAnfah.x iIaeMomen.Pt2MIstVorstIae.x iIaeMomen.Pt2MIstVorstIae.xp iIaeMomen.Pt2NMotAnfahrt.x iIaeMomen.Pt2NMotAnfahrt.xp iIaeMomen.TimerKflMiaeauf.maxtime iIaeMomen.TimerKflMiaeauf.time iIaeMomen.TimerMiaeaufAnfahr.maxtime iIaeMomen.TimerMiaeaufAnfahr.time iIaeMomen.TimerNachMmaxHas.maxtime iIaeMomen.TimerNachMmaxHas.time iIaeMomen.TimerPulsCue.maxtime iIaeMomen.TimerPulsCue.time iIaeMomen.TimerPulsCueAktiv.maxtime iIaeMomen.TimerPulsCueAktiv.time iIaeMomen.TimerUefIstuetz.maxtime iIaeMomen.TimerUefIstuetz.time iIaeMomen.TimerUefKriechen.maxtime iIaeMomen.TimerUefKriechen.time iIaeMomen.TimerUefMVorKriechen.maxtime iIaeMomen.TimerUefMVorKriechen.time iIaeMotmx.Pt1MMotmax.x iIaeMotmx.TimerMotMaxTempIae.maxtime iIaeMotmx.TimerMotMaxTempIae.time iIaeMotmx.TimerStallIae.maxtime iIaeMotmx.TimerStallIae.time iIaeSigna.DelayMMotgem.write_index iIaeSigna.DelayMMotist.write_index iIaeSigna.DelayMMotistoe.write_index iIaeSigna.DelayMMotsolloe.write_index iIaeSigna.DelayNab.write_index iIaeSigna.DelayNt.write_index iIaeSigna.Dt1Dkig.Pt1Si16.x iIaeSigna.Dt1Dkig.xp iIaeSigna.Dt1MgMotist.Pt1Si16.x iIaeSigna.Dt1MgMotist.xp iIaeSigna.Dt1NdgIae.Pt1Si16.x iIaeSigna.Dt1NdgIae.xp iIaeSigna.Dt1NgAb.Pt1Si16.x iIaeSigna.Dt1NgAb.xp iIaeSigna.Dt1NgGetrein.Pt1Si16.x iIaeSigna.Dt1NgGetrein.xp iIaeSigna.Dt1NgMot.Pt1Si16.x iIaeSigna.Dt1NgMot.xp iIaeSigna.Dt1Pbremsg.Pt1Si16.x iIaeSigna.Dt1Pbremsg.xp iIaeSigna.Pt1AxrefIae.x iIaeSigna.Pt1Dki.x iIaeSigna.Pt1JAnfahrtIae.x iIaeSigna.Pt1MMotgem.x iIaeSigna.Pt1MMotist.x iIaeSigna.Pt1MMotistoe.x iIaeSigna.Pt1MMotsolloe.x iIaeSigna.Pt1NAb.x iIaeSigna.Pt1NMot.x iIaeSigna.Pt1NT.x iIaeSigna.Pt1NdGetrein.x iIaeSigna.Pt1NdIae.x iIaeSigna.Pt1NdMot.x iIaeSigna.Pt1Nue.x iIaeSigna.Pt1PBrems.x iIaeSigna.Pt2NeigungIae.x iIaeSigna.Pt2NeigungIae.xp iIaeTempm.TimerVzInit.maxtime iIaeTempm.TimerVzInit.time iKasEkopl.Pt1MoEntkoppl.x iKasEkopl.TimerSchlEkop.maxtime iKasEkopl.TimerSchlEkop.time iKasEkopl.TimerZEkopl.maxtime iKasEkopl.TimerZEkopl.time iKupA.p_filter.fl_filter.x iKupA.p_filter.letzter_ms_timer iKupA.t_kpl_aktiv.timer iKupA.t_kpl_inaktiv.timer iKupA.timer_sas_ende_mit_pmax.timer iKupA.totzeit_abgelaufen.timer iKupA.zustandstimer.timer iKupB.p_filter.fl_filter.x iKupB.p_filter.letzter_ms_timer iKupB.t_kpl_aktiv.timer iKupB.t_kpl_inaktiv.timer iKupB.timer_sas_ende_mit_pmax.timer iKupB.totzeit_abgelaufen.timer iKupB.zustandstimer.timer iKupC.p_filter.fl_filter.x iKupC.p_filter.letzter_ms_timer iKupC.t_kpl_aktiv.timer iKupC.t_kpl_inaktiv.timer iKupC.timer_sas_ende_mit_pmax.timer iKupC.totzeit_abgelaufen.timer iKupC.zustandstimer.timer iKupD.p_filter.fl_filter.x iKupD.p_filter.letzter_ms_timer iKupD.t_kpl_aktiv.timer iKupD.t_kpl_inaktiv.timer iKupD.timer_sas_ende_mit_pmax.timer iKupD.totzeit_abgelaufen.timer iKupD.zustandstimer.timer iKupE.p_filter.fl_filter.x iKupE.p_filter.letzter_ms_timer iKupE.t_kpl_aktiv.timer iKupE.t_kpl_inaktiv.timer iKupE.timer_sas_ende_mit_pmax.timer iKupE.totzeit_abgelaufen.timer iKupE.zustandstimer.timer iKupHysA.iDt1IEds.Pt1Si16.x iKupHysA.iDt1IEds.xp iKupHysA.iDt1PAbssoll.Pt1Fl32.x iKupHysA.iDt1PAbssoll.xp iKupHysA.iDt1Verz.Pt1Fl32.x iKupHysA.iDt1Verz.xp iKupHysA.iPt2IoKomp.x iKupHysA.iPt2IoKomp.xp iKupHysA.iPt2MoKomp.x iKupHysA.iPt2MoKomp.xp iKupHysB.iDt1IEds.Pt1Si16.x iKupHysB.iDt1IEds.xp iKupHysB.iDt1PAbssoll.Pt1Fl32.x iKupHysB.iDt1PAbssoll.xp iKupHysB.iDt1Verz.Pt1Fl32.x iKupHysB.iDt1Verz.xp iKupHysB.iPt2IoKomp.x iKupHysB.iPt2IoKomp.xp iKupHysB.iPt2MoKomp.x iKupHysB.iPt2MoKomp.xp iKupHysC.iDt1IEds.Pt1Si16.x iKupHysC.iDt1IEds.xp iKupHysC.iDt1PAbssoll.Pt1Fl32.x iKupHysC.iDt1PAbssoll.xp iKupHysC.iDt1Verz.Pt1Fl32.x iKupHysC.iDt1Verz.xp iKupHysC.iPt2IoKomp.x iKupHysC.iPt2IoKomp.xp iKupHysC.iPt2MoKomp.x iKupHysC.iPt2MoKomp.xp iKupHysD.iDt1IEds.Pt1Si16.x iKupHysD.iDt1IEds.xp iKupHysD.iDt1PAbssoll.Pt1Fl32.x iKupHysD.iDt1PAbssoll.xp iKupHysD.iDt1Verz.Pt1Fl32.x iKupHysD.iDt1Verz.xp iKupHysD.iPt2IoKomp.x iKupHysD.iPt2IoKomp.xp iKupHysD.iPt2MoKomp.x iKupHysD.iPt2MoKomp.xp iKupHysE.iDt1IEds.Pt1Si16.x iKupHysE.iDt1IEds.xp iKupHysE.iDt1PAbssoll.Pt1Fl32.x iKupHysE.iDt1PAbssoll.xp iKupHysE.iDt1Verz.Pt1Fl32.x iKupHysE.iDt1Verz.xp iKupHysE.iPt2IoKomp.x iKupHysE.iPt2IoKomp.xp iKupHysE.iPt2MoKomp.x iKupHysE.iPt2MoKomp.xp iKupHysK0.iDt1IEds.Pt1Si16.x iKupHysK0.iDt1IEds.xp iKupHysK0.iDt1PAbssoll.Pt1Fl32.x iKupHysK0.iDt1PAbssoll.xp iKupHysK0.iDt1Verz.Pt1Fl32.x iKupHysK0.iDt1Verz.xp iKupHysK0.iPt2IoKomp.x iKupHysK0.iPt2IoKomp.xp iKupHysK0.iPt2MoKomp.x iKupHysK0.iPt2MoKomp.xp iKupK0.p_filter.fl_filter.x iKupK0.p_filter.letzter_ms_timer iKupK0.t_kpl_aktiv.timer iKupK0.t_kpl_inaktiv.timer iKupK0.timer_sas_ende_mit_pmax.timer iKupK0.totzeit_abgelaufen.timer iKupK0.zustandstimer.timer iModKupSfktK0.pgo_sf_rampe.cBibRampeGradSi16._.letzter_ms_timer iModKupSfktK0.pgo_sf_rampe.cBibRampeGradSi16._.letzter_wert iModKupSfktK0.pgo_sf_rampe.cBibRampeGradSi16._.maximum iModKupSfktK0.pgo_sf_rampe.cBibRampeGradSi16._.minimum iMoeMesaf.filter_spez_me.letzter_ms_timer iMoeMesaf.filter_spez_me.start_wert iMoeMesaf.filter_spez_me.x iMvsZentr.iTimerKeinKfl.timer iMvsZentr.iTimerMagnet.timer iMvsZentr.iTimerParksp.timer iSasAnGeaKraftschl.pgo_gea_rampe.cBibRampeGradSi16._.letzter_ms_timer iSasAnGeaKraftschl.pgo_gea_rampe.cBibRampeGradSi16._.letzter_wert iSasAnGeaKraftschl.pgo_gea_rampe.cBibRampeGradSi16._.maximum iSasAnGeaKraftschl.pgo_gea_rampe.cBibRampeGradSi16._.minimum iSasAnGeaNichtKraftschl1.pgo_gea_rampe.cBibRampeGradSi16._.letzter_ms_timer iSasAnGeaNichtKraftschl1.pgo_gea_rampe.cBibRampeGradSi16._.letzter_wert iSasAnGeaNichtKraftschl1.pgo_gea_rampe.cBibRampeGradSi16._.maximum iSasAnGeaNichtKraftschl1.pgo_gea_rampe.cBibRampeGradSi16._.minimum iSasAnGeaNichtKraftschl2.pgo_gea_rampe.cBibRampeGradSi16._.letzter_ms_timer iSasAnGeaNichtKraftschl2.pgo_gea_rampe.cBibRampeGradSi16._.letzter_wert iSasAnGeaNichtKraftschl2.pgo_gea_rampe.cBibRampeGradSi16._.maximum iSasAnGeaNichtKraftschl2.pgo_gea_rampe.cBibRampeGradSi16._.minimum iSasBerechnungGls.FSchubZugSas.old_value iSasBerechnungGls.filter_wngtgls.letzter_ms_timer iSasBerechnungGls.filter_wngtgls.x iSasKflwe.p_kab_kflw2_speicher.letzter_ms_timer iSasKflwe.p_kab_kflw2_speicher.letzter_wert iSasKflwe.p_kab_kflw2_speicher.maximum iSasKflwe.p_kab_kflw2_speicher.minimum iSasKflwe.p_kab_kflw_speicher.letzter_ms_timer iSasKflwe.p_kab_kflw_speicher.letzter_wert iSasKflwe.p_kab_kflw_speicher.maximum iSasKflwe.p_kab_kflw_speicher.minimum iSasKorGls.FlankeNeg.old_value iSasKorGls.FlankePos.old_value iSasPsyst.filter_p_sysist.letzter_ms_timer iSasPsyst.filter_p_sysist.x iSasPsyst.rampe_p_sysiae.letzter_ms_timer iSasPsyst.rampe_p_sysiae.letzter_wert iSasPsyst.rampe_p_sysiae.maximum iSasPsyst.rampe_p_sysiae.minimum iSasPsyst.rampe_p_syspulsada.letzter_ms_timer iSasPsyst.rampe_p_syspulsada.letzter_wert iSasPsyst.rampe_p_syspulsada.maximum iSasPsyst.rampe_p_syspulsada.minimum iSasPsyst.speicher_filter_psys.letzter_ms_timer iSasPsyst.speicher_filter_psys.x iSasRegelungGls.gls_para.cBibRegle._.faktor_d iSasRegelungGls.gls_para.cBibRegle._.faktor_i iSasRegelungGls.gls_para.cBibRegle._.faktor_p iSasRegelungGls.gls_para.cBibRegle._.faktor_t1 iSasRegelungGls.gls_para.cBibRegle._.regel_diff_alt iSasRegelungGls.gls_para.cBibRegle._.stell_max iSasRegelungGls.gls_para.cBibRegle._.stell_min iSasRegelungGls.gls_para.cBibRegle._.stellgr_alt iSasRegelungGls.gls_para.cBibRegle._.stellgr_d_alt iSasRegelungGls.gls_para.cBibRegle._.stellgr_i_alt iSasRegelungGls.gls_para.cBibRegle._.stellgr_i_modulo iSasRegelungGls.i_wngtgls_filter.x iSasZentr.iSchaltend.iKab.pgo_kab_speicher.cBibRampeGradSi16._.letzter_ms_timer iSasZentr.iSchaltend.iKab.pgo_kab_speicher.cBibRampeGradSi16._.letzter_wert iSasZentr.iSchaltend.iKab.pgo_kab_speicher.cBibRampeGradSi16._.maximum iSasZentr.iSchaltend.iKab.pgo_kab_speicher.cBibRampeGradSi16._.minimum iSasZentr.iSchaltend.iKab.raph_kab_speicher.letzter_timer iSasZentr.iSchaltend.iKab.raph_kab_speicher.letzter_wert iSasZentr.iSchaltend.iKab.raps_kab_speicher.letzter_timer iSasZentr.iSchaltend.iKab.raps_kab_speicher.letzter_wert iSasZentr.iSchaltend.iKzu.pgo_kzu_speicher.cBibRampeGradSi16._.letzter_ms_timer iSasZentr.iSchaltend.iKzu.pgo_kzu_speicher.cBibRampeGradSi16._.letzter_wert iSasZentr.iSchaltend.iKzu.pgo_kzu_speicher.cBibRampeGradSi16._.maximum iSasZentr.iSchaltend.iKzu.pgo_kzu_speicher.cBibRampeGradSi16._.minimum iSasZentr.iSchaltend.iKzu.raph_kzu_speicher.letzter_timer iSasZentr.iSchaltend.iKzu.raph_kzu_speicher.letzter_wert iSasZentr.iSchaltend.sp_ngdsynzielgang.letzter_ms_timer iSasZentr.iSchaltend.sp_ngdsynzielgang.n_f iSasZentr.iVorbereitend.iKab.pgo_kab_speicher.cBibRampeGradSi16._.letzter_ms_timer iSasZentr.iVorbereitend.iKab.pgo_kab_speicher.cBibRampeGradSi16._.letzter_wert iSasZentr.iVorbereitend.iKab.pgo_kab_speicher.cBibRampeGradSi16._.maximum iSasZentr.iVorbereitend.iKab.pgo_kab_speicher.cBibRampeGradSi16._.minimum iSasZentr.iVorbereitend.iKab.raph_kab_speicher.letzter_timer iSasZentr.iVorbereitend.iKab.raph_kab_speicher.letzter_wert iSasZentr.iVorbereitend.iKab.raps_kab_speicher.letzter_timer iSasZentr.iVorbereitend.iKab.raps_kab_speicher.letzter_wert iSasZentr.iVorbereitend.iKzu.pgo_kzu_speicher.cBibRampeGradSi16._.letzter_ms_timer iSasZentr.iVorbereitend.iKzu.pgo_kzu_speicher.cBibRampeGradSi16._.letzter_wert iSasZentr.iVorbereitend.iKzu.pgo_kzu_speicher.cBibRampeGradSi16._.maximum iSasZentr.iVorbereitend.iKzu.pgo_kzu_speicher.cBibRampeGradSi16._.minimum iSasZentr.iVorbereitend.iKzu.raph_kzu_speicher.letzter_timer iSasZentr.iVorbereitend.iKzu.raph_kzu_speicher.letzter_wert iSasZentr.iVorbereitend.sp_ngdsynzielgang.letzter_ms_timer iSasZentr.iVorbereitend.sp_ngdsynzielgang.n_f iSasZentr.sp_mmotmax_rss.letzter_ms_timer iSasZentr.sp_mmotmax_rss.letzter_wert iSasZentr.sp_mmotmax_rss.maximum iSasZentr.sp_mmotmax_rss.minimum iTciCompu.iPKAbFilter.letzter_ms_timer iTciCompu.iPKAbFilter.x iTciCompu.iPKZuFilter.letzter_ms_timer iTciCompu.iPKZuFilter.x iTempMKupA.PT2CKupplung.x iTempMKupA.PT2CKupplung.xp iTempMKupC.PT2CKupplung.x iTempMKupC.PT2CKupplung.xp iTempMKupD.PT2CKupplung.x iTempMKupD.PT2CKupplung.xp iTempMKupE.PT2CKupplung.x iTempMKupE.PT2CKupplung.xp iUewIgBerechnung.iMGSollmoment.letzter_ms_timer iUewIgBerechnung.iMGSollmoment.n_f iUewParksperrenmagnet.iTimerPmdef.timer iUewParksperrenmagnet.iTimerPmueb.timer iUewParksperrenmagnet.iTimerVerzpmueb.timer iUewPosVTimerZuendung.cUewTimerZuendung._.iTimerVerzNmotMax.timer /end LOC_MEASUREMENT
/end FUNCTION
/end MODULE
/end PROJECT
