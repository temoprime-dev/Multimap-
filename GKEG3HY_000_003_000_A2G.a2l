ASAP2_VERSION 1 51
/begin PROJECT _929_929 "Gen2_BMW_System_Supplier_Lib"
/begin HEADER "" VERSION "C_03_03" PROJECT_NO _929_929 /end HEADER
/begin MODULE DIM ""
/begin MOD_COMMON "" BYTE_ORDER MSB_FIRST ALIGNMENT_BYTE 1 ALIGNMENT_WORD 2 ALIGNMENT_LONG 4 ALIGNMENT_FLOAT32_IEEE 4 /end MOD_COMMON
/begin CHARACTERISTIC ND_MEHAUPTAGE_2 "Drehzahlkriterium Start Haupt-ME Gangeinlegen" VALUE 0x26D7F2 kw_si16_S6_S3 1000 UMR_U_MIN_1_1_0_S6_S3 0 1000 /end CHARACTERISTIC
/begin CHARACTERISTIC T_RAMEE_2 "Dauer Rampe ME bei Ende Gangeinlegen" VALUE 0x26E578 kw_ui8_S6_S3 2540 UMR_MSEC__10_1_0_S6_S3 0 2540 /end CHARACTERISTIC
/begin CHARACTERISTIC T_FMEHAUPTA_2 "Filterzeit Start Hauptmotoreingriff" VALUE 0x26D7F4 kw_si16_S6_S3 508 UMR_MSEC__1_1_0_S6_S3 -254 254 /end CHARACTERISTIC
/begin CHARACTERISTIC K_FMEHAUPTA_2 "Filterkonstante (aehnl INPT) Start Hauptmotoreingriff" VALUE 0x26D7F6 kw_si16_S6_S3 65.535 UMR___1_1000_0_S6_S3 -32.768 32.767 /end CHARACTERISTIC
/begin CHARACTERISTIC KF_FMEHAUPTGEDKINMOT_2 "Faktor auf Haupt-ME f(dki) Gangeinlegen D1 bis D6" MAP 0x22BC84 kf_ui8_S6_S3 100 UMR_PROZENT__20_51_0_S6_S3 0 100
 /begin AXIS_DESCR STD_AXIS zff_atsys._.iSignale._.obj.sig_dki UMR_PROZENT__20_51_0_S6_S3 4 0 100 DEPOSIT ABSOLUTE MONOTONY MON_INCREASE /end AXIS_DESCR
 /begin AXIS_DESCR STD_AXIS zff_atsys._.iSignale._.obj.sig_n_mot8 UMR_U_MIN_32_1_0_S6_S3 4 0 8160 DEPOSIT ABSOLUTE MONOTONY MON_INCREASE /end AXIS_DESCR
/end CHARACTERISTIC
/begin CHARACTERISTIC KF_MEHAUPT_2 "Hauptmotoreingriff Schaltablauf" MAP 0x22BCA4 kf_ui8_S6_S3 870 UMR_NM__6_1_M145_S6_S3 -870 0
 /begin AXIS_DESCR STD_AXIS NO_INPUT_QUANTITY UMR_U_MIN_32_1_0_S6_S3 6 0 8160 DEPOSIT ABSOLUTE MONOTONY MON_INCREASE /end AXIS_DESCR
 /begin AXIS_DESCR STD_AXIS zff_atsys._.iSignale._.obj.sig_m_t8 UMR_NM__8_1_M50_S6_S3 6 -400 1640 DEPOSIT ABSOLUTE MONOTONY MON_INCREASE /end AXIS_DESCR
/end CHARACTERISTIC
/begin CHARACTERISTIC KF_FTSYNNTMEHAUPTE_2 "Faktor auf Haupt-ME fuer Nach-ME" MAP 0x22BCDC kf_si16_S6_S3 1 UMR___1_100_0_S6_S3 0 1
 /begin AXIS_DESCR STD_AXIS iSasZentr.iSchaltend.t_syn UMR_MSEC__10_1_0_S6_S3 4 -5000 5000 DEPOSIT ABSOLUTE MONOTONY MON_INCREASE /end AXIS_DESCR
 /begin AXIS_DESCR STD_AXIS zff_atsys._.iSignale._.obj.sig_n_t UMR_U_MIN_1_1_0_S6_S3 4 0 8160 DEPOSIT ABSOLUTE MONOTONY MON_INCREASE /end AXIS_DESCR
/end CHARACTERISTIC
/begin CHARACTERISTIC KL_TSYNMTMEHAUPTE_2 "Zeit vor Erkennen synchron fuer Ende Haupt-ME" CURVE 0x22BD14 kl_ui8_S6_S3 1280 UMR_MSEC__10_1_M128_S6_S3 -1280 0
 /begin AXIS_DESCR STD_AXIS zff_atsys._.iSignale._.obj.sig_m_t8 UMR_NM__8_1_M50_S6_S3 6 -400 1640 DEPOSIT ABSOLUTE MONOTONY MON_INCREASE /end AXIS_DESCR
/end CHARACTERISTIC
/begin CHARACTERISTIC KL_TVMEA_2 "Verzoegerungszeit fuer Beginn Haupt-ME" CURVE 0x22BD24 kl_si16_S6_S3 2000 UMR_MSEC__10_1_0_S6_S3 -1000 1000
 /begin AXIS_DESCR STD_AXIS zff_atsys._.iSignale._.obj.sig_n_t8 UMR_U_MIN_32_1_0_S6_S3 8 0 8160 DEPOSIT ABSOLUTE MONOTONY MON_INCREASE /end AXIS_DESCR
/end CHARACTERISTIC
/begin CHARACTERISTIC T_SPERRSYN_2 "Sperrzeit ende Haupt-ME GE" VALUE 0x26E579 kw_ui8_S6_S3 2540 UMR_MSEC__10_1_0_S6_S3 0 2540 /end CHARACTERISTIC
/begin CHARACTERISTIC ND_MEHAUPTAGE_3 "Drehzahlkriterium Start Haupt-ME Gangeinlegen" VALUE 0x26D7F8 kw_si16_S6_S3 1000 UMR_U_MIN_1_1_0_S6_S3 0 1000 /end CHARACTERISTIC
/begin CHARACTERISTIC T_RAMEE_3 "Dauer Rampe ME bei Ende Gangeinlegen" VALUE 0x26E57A kw_ui8_S6_S3 2540 UMR_MSEC__10_1_0_S6_S3 0 2540 /end CHARACTERISTIC
/begin CHARACTERISTIC T_FMEHAUPTA_3 "Filterzeit Start Hauptmotoreingriff" VALUE 0x26D7FA kw_si16_S6_S3 508 UMR_MSEC__1_1_0_S6_S3 -254 254 /end CHARACTERISTIC
/begin CHARACTERISTIC K_FMEHAUPTA_3 "Filterkonstante (aehnl INPT) Start Hauptmotoreingriff" VALUE 0x26D7FC kw_si16_S6_S3 65.535 UMR___1_1000_0_S6_S3 -32.768 32.767 /end CHARACTERISTIC
/begin CHARACTERISTIC KF_FMEHAUPTGEDKINMOT_3 "Faktor auf Haupt-ME f(dki) Gangeinlegen D1 bis D6" MAP 0x22BD48 kf_ui8_S6_S3 100 UMR_PROZENT__20_51_0_S6_S3 0 100
 /begin AXIS_DESCR STD_AXIS zff_atsys._.iSignale._.obj.sig_dki UMR_PROZENT__20_51_0_S6_S3 4 0 100 DEPOSIT ABSOLUTE MONOTONY MON_INCREASE /end AXIS_DESCR
 /begin AXIS_DESCR STD_AXIS zff_atsys._.iSignale._.obj.sig_n_mot8 UMR_U_MIN_32_1_0_S6_S3 4 0 8160 DEPOSIT ABSOLUTE MONOTONY MON_INCREASE /end AXIS_DESCR
/end CHARACTERISTIC
/begin CHARACTERISTIC KF_MEHAUPT_3 "Hauptmotoreingriff Schaltablauf" MAP 0x22BD68 kf_ui8_S6_S3 870 UMR_NM__6_1_M145_S6_S3 -870 0
 /begin AXIS_DESCR STD_AXIS NO_INPUT_QUANTITY UMR_U_MIN_32_1_0_S6_S3 6 0 8160 DEPOSIT ABSOLUTE MONOTONY MON_INCREASE /end AXIS_DESCR
 /begin AXIS_DESCR STD_AXIS zff_atsys._.iSignale._.obj.sig_m_t8 UMR_NM__8_1_M50_S6_S3 6 -400 1640 DEPOSIT ABSOLUTE MONOTONY MON_INCREASE /end AXIS_DESCR
/end CHARACTERISTIC
/begin CHARACTERISTIC KF_FTSYNNTMEHAUPTE_3 "Faktor auf Haupt-ME fuer Nach-ME" MAP 0x22BDA0 kf_si16_S6_S3 1 UMR___1_100_0_S6_S3 0 1
 /begin AXIS_DESCR STD_AXIS iSasZentr.iSchaltend.t_syn UMR_MSEC__10_1_0_S6_S3 4 -5000 5000 DEPOSIT ABSOLUTE MONOTONY MON_INCREASE /end AXIS_DESCR
 /begin AXIS_DESCR STD_AXIS zff_atsys._.iSignale._.obj.sig_n_t UMR_U_MIN_1_1_0_S6_S3 4 0 8160 DEPOSIT ABSOLUTE MONOTONY MON_INCREASE /end AXIS_DESCR
/end CHARACTERISTIC
/begin CHARACTERISTIC KL_TSYNMTMEHAUPTE_3 "Zeit vor Erkennen synchron fuer Ende Haupt-ME" CURVE 0x22BDD8 kl_ui8_S6_S3 1280 UMR_MSEC__10_1_M128_S6_S3 -1280 0
 /begin AXIS_DESCR STD_AXIS zff_atsys._.iSignale._.obj.sig_m_t8 UMR_NM__8_1_M50_S6_S3 6 -400 1640 DEPOSIT ABSOLUTE MONOTONY MON_INCREASE /end AXIS_DESCR
/end CHARACTERISTIC
/begin CHARACTERISTIC KL_TVMEA_3 "Verzoegerungszeit fuer Beginn Haupt-ME" CURVE 0x22BDE8 kl_si16_S6_S3 2000 UMR_MSEC__10_1_0_S6_S3 -1000 1000
 /begin AXIS_DESCR STD_AXIS zff_atsys._.iSignale._.obj.sig_n_t8 UMR_U_MIN_32_1_0_S6_S3 8 0 8160 DEPOSIT ABSOLUTE MONOTONY MON_INCREASE /end AXIS_DESCR
/end CHARACTERISTIC
/begin CHARACTERISTIC T_SPERRSYN_3 "Sperrzeit ende Haupt-ME GE" VALUE 0x26E57B kw_ui8_S6_S3 2540 UMR_MSEC__10_1_0_S6_S3 0 2540 /end CHARACTERISTIC
/begin CHARACTERISTIC ND_MEHAUPTAGE_4 "Drehzahlkriterium Start Haupt-ME Gangeinlegen" VALUE 0x26D7FE kw_si16_S6_S3 1000 UMR_U_MIN_1_1_0_S6_S3 0 1000 /end CHARACTERISTIC
/begin CHARACTERISTIC T_RAMEE_4 "Dauer Rampe ME bei Ende Gangeinlegen" VALUE 0x26E57C kw_ui8_S6_S3 2540 UMR_MSEC__10_1_0_S6_S3 0 2540 /end CHARACTERISTIC
/begin CHARACTERISTIC T_FMEHAUPTA_4 "Filterzeit Start Hauptmotoreingriff" VALUE 0x26D800 kw_si16_S6_S3 508 UMR_MSEC__1_1_0_S6_S3 -254 254 /end CHARACTERISTIC
/begin CHARACTERISTIC K_FMEHAUPTA_4 "Filterkonstante (aehnl INPT) Start Hauptmotoreingriff" VALUE 0x26D802 kw_si16_S6_S3 65.535 UMR___1_1000_0_S6_S3 -32.768 32.767 /end CHARACTERISTIC
/begin CHARACTERISTIC KF_FMEHAUPTGEDKINMOT_4 "Faktor auf Haupt-ME f(dki) Gangeinlegen D1 bis D6" MAP 0x22BE0C kf_ui8_S6_S3 100 UMR_PROZENT__20_51_0_S6_S3 0 100
 /begin AXIS_DESCR STD_AXIS zff_atsys._.iSignale._.obj.sig_dki UMR_PROZENT__20_51_0_S6_S3 4 0 100 DEPOSIT ABSOLUTE MONOTONY MON_INCREASE /end AXIS_DESCR
 /begin AXIS_DESCR STD_AXIS zff_atsys._.iSignale._.obj.sig_n_mot8 UMR_U_MIN_32_1_0_S6_S3 4 0 8160 DEPOSIT ABSOLUTE MONOTONY MON_INCREASE /end AXIS_DESCR
/end CHARACTERISTIC
/begin CHARACTERISTIC KF_MEHAUPT_4 "Hauptmotoreingriff Schaltablauf" MAP 0x22BE2C kf_ui8_S6_S3 870 UMR_NM__6_1_M145_S6_S3 -870 0
 /begin AXIS_DESCR STD_AXIS NO_INPUT_QUANTITY UMR_U_MIN_32_1_0_S6_S3 6 0 8160 DEPOSIT ABSOLUTE MONOTONY MON_INCREASE /end AXIS_DESCR
 /begin AXIS_DESCR STD_AXIS zff_atsys._.iSignale._.obj.sig_m_t8 UMR_NM__8_1_M50_S6_S3 6 -400 1640 DEPOSIT ABSOLUTE MONOTONY MON_INCREASE /end AXIS_DESCR
/end CHARACTERISTIC
/begin CHARACTERISTIC KF_FTSYNNTMEHAUPTE_4 "Faktor auf Haupt-ME fuer Nach-ME" MAP 0x22BE64 kf_si16_S6_S3 1 UMR___1_100_0_S6_S3 0 1
 /begin AXIS_DESCR STD_AXIS iSasZentr.iSchaltend.t_syn UMR_MSEC__10_1_0_S6_S3 4 -5000 5000 DEPOSIT ABSOLUTE MONOTONY MON_INCREASE /end AXIS_DESCR
 /begin AXIS_DESCR STD_AXIS zff_atsys._.iSignale._.obj.sig_n_t UMR_U_MIN_1_1_0_S6_S3 4 0 8160 DEPOSIT ABSOLUTE MONOTONY MON_INCREASE /end AXIS_DESCR
/end CHARACTERISTIC
/begin CHARACTERISTIC KL_TSYNMTMEHAUPTE_4 "Zeit vor Erkennen synchron fuer Ende Haupt-ME" CURVE 0x22BE9C kl_ui8_S6_S3 1280 UMR_MSEC__10_1_M128_S6_S3 -1280 0
 /begin AXIS_DESCR STD_AXIS zff_atsys._.iSignale._.obj.sig_m_t8 UMR_NM__8_1_M50_S6_S3 6 -400 1640 DEPOSIT ABSOLUTE MONOTONY MON_INCREASE /end AXIS_DESCR
/end CHARACTERISTIC
/begin CHARACTERISTIC KL_TVMEA_4 "Verzoegerungszeit fuer Beginn Haupt-ME" CURVE 0x22BEAC kl_si16_S6_S3 2000 UMR_MSEC__10_1_0_S6_S3 -1000 1000
 /begin AXIS_DESCR STD_AXIS zff_atsys._.iSignale._.obj.sig_n_t8 UMR_U_MIN_32_1_0_S6_S3 8 0 8160 DEPOSIT ABSOLUTE MONOTONY MON_INCREASE /end AXIS_DESCR
/end CHARACTERISTIC
/begin CHARACTERISTIC T_SPERRSYN_4 "Sperrzeit ende Haupt-ME GE" VALUE 0x26E57D kw_ui8_S6_S3 2540 UMR_MSEC__10_1_0_S6_S3 0 2540 /end CHARACTERISTIC
/begin CHARACTERISTIC ND_MEHAUPTAGE_5 "Drehzahlkriterium Start Haupt-ME Gangeinlegen" VALUE 0x26D804 kw_si16_S6_S3 1000 UMR_U_MIN_1_1_0_S6_S3 0 1000 /end CHARACTERISTIC
/begin CHARACTERISTIC T_RAMEE_5 "Dauer Rampe ME bei Ende Gangeinlegen" VALUE 0x26E57E kw_ui8_S6_S3 2540 UMR_MSEC__10_1_0_S6_S3 0 2540 /end CHARACTERISTIC
/begin CHARACTERISTIC T_FMEHAUPTA_5 "Filterzeit Start Hauptmotoreingriff" VALUE 0x26D806 kw_si16_S6_S3 508 UMR_MSEC__1_1_0_S6_S3 -254 254 /end CHARACTERISTIC
/begin CHARACTERISTIC K_FMEHAUPTA_5 "Filterkonstante (aehnl INPT) Start Hauptmotoreingriff" VALUE 0x26D808 kw_si16_S6_S3 65.535 UMR___1_1000_0_S6_S3 -32.768 32.767 /end CHARACTERISTIC
/begin CHARACTERISTIC KF_FMEHAUPTGEDKINMOT_5 "Faktor auf Haupt-ME f(dki) Gangeinlegen D1 bis D6" MAP 0x22BED0 kf_ui8_S6_S3 100 UMR_PROZENT__20_51_0_S6_S3 0 100
 /begin AXIS_DESCR STD_AXIS zff_atsys._.iSignale._.obj.sig_dki UMR_PROZENT__20_51_0_S6_S3 4 0 100 DEPOSIT ABSOLUTE MONOTONY MON_INCREASE /end AXIS_DESCR
 /begin AXIS_DESCR STD_AXIS zff_atsys._.iSignale._.obj.sig_n_mot8 UMR_U_MIN_32_1_0_S6_S3 4 0 8160 DEPOSIT ABSOLUTE MONOTONY MON_INCREASE /end AXIS_DESCR
/end CHARACTERISTIC
/begin CHARACTERISTIC KF_MEHAUPT_5 "Hauptmotoreingriff Schaltablauf" MAP 0x22BEF0 kf_ui8_S6_S3 870 UMR_NM__6_1_M145_S6_S3 -870 0
 /begin AXIS_DESCR STD_AXIS NO_INPUT_QUANTITY UMR_U_MIN_32_1_0_S6_S3 6 0 8160 DEPOSIT ABSOLUTE MONOTONY MON_INCREASE /end AXIS_DESCR
 /begin AXIS_DESCR STD_AXIS zff_atsys._.iSignale._.obj.sig_m_t8 UMR_NM__8_1_M50_S6_S3 6 -400 1640 DEPOSIT ABSOLUTE MONOTONY MON_INCREASE /end AXIS_DESCR
/end CHARACTERISTIC
/begin CHARACTERISTIC KF_FTSYNNTMEHAUPTE_5 "Faktor auf Haupt-ME fuer Nach-ME" MAP 0x22BF28 kf_si16_S6_S3 1 UMR___1_100_0_S6_S3 0 1
 /begin AXIS_DESCR STD_AXIS iSasZentr.iSchaltend.t_syn UMR_MSEC__10_1_0_S6_S3 4 -5000 5000 DEPOSIT ABSOLUTE MONOTONY MON_INCREASE /end AXIS_DESCR
 /begin AXIS_DESCR STD_AXIS zff_atsys._.iSignale._.obj.sig_n_t UMR_U_MIN_1_1_0_S6_S3 4 0 8160 DEPOSIT ABSOLUTE MONOTONY MON_INCREASE /end AXIS_DESCR
/end CHARACTERISTIC
/begin CHARACTERISTIC KL_TSYNMTMEHAUPTE_5 "Zeit vor Erkennen synchron fuer Ende Haupt-ME" CURVE 0x22BF60 kl_ui8_S6_S3 1280 UMR_MSEC__10_1_M128_S6_S3 -1280 0
 /begin AXIS_DESCR STD_AXIS zff_atsys._.iSignale._.obj.sig_m_t8 UMR_NM__8_1_M50_S6_S3 6 -400 1640 DEPOSIT ABSOLUTE MONOTONY MON_INCREASE /end AXIS_DESCR
/end CHARACTERISTIC
/begin CHARACTERISTIC KL_TVMEA_5 "Verzoegerungszeit fuer Beginn Haupt-ME" CURVE 0x22BF70 kl_si16_S6_S3 2000 UMR_MSEC__10_1_0_S6_S3 -1000 1000
 /begin AXIS_DESCR STD_AXIS zff_atsys._.iSignale._.obj.sig_n_t8 UMR_U_MIN_32_1_0_S6_S3 8 0 8160 DEPOSIT ABSOLUTE MONOTONY MON_INCREASE /end AXIS_DESCR
/end CHARACTERISTIC
/begin CHARACTERISTIC T_SPERRSYN_5 "Sperrzeit ende Haupt-ME GE" VALUE 0x26E57F kw_ui8_S6_S3 2540 UMR_MSEC__10_1_0_S6_S3 0 2540 /end CHARACTERISTIC
/begin CHARACTERISTIC ND_MEHAUPTAGE_6 "Drehzahlkriterium Start Haupt-ME Gangeinlegen" VALUE 0x26D80A kw_si16_S6_S3 1000 UMR_U_MIN_1_1_0_S6_S3 0 1000 /end CHARACTERISTIC
/begin CHARACTERISTIC T_RAMEE_6 "Dauer Rampe ME bei Ende Gangeinlegen" VALUE 0x26E580 kw_ui8_S6_S3 2540 UMR_MSEC__10_1_0_S6_S3 0 2540 /end CHARACTERISTIC
/begin CHARACTERISTIC T_FMEHAUPTA_6 "Filterzeit Start Hauptmotoreingriff" VALUE 0x26D80C kw_si16_S6_S3 508 UMR_MSEC__1_1_0_S6_S3 -254 254 /end CHARACTERISTIC
/begin CHARACTERISTIC K_FMEHAUPTA_6 "Filterkonstante (aehnl INPT) Start Hauptmotoreingriff" VALUE 0x26D80E kw_si16_S6_S3 65.535 UMR___1_1000_0_S6_S3 -32.768 32.767 /end CHARACTERISTIC
/begin CHARACTERISTIC KF_FMEHAUPTGEDKINMOT_6 "Faktor auf Haupt-ME f(dki) Gangeinlegen D1 bis D6" MAP 0x22BF94 kf_ui8_S6_S3 100 UMR_PROZENT__20_51_0_S6_S3 0 100
 /begin AXIS_DESCR STD_AXIS zff_atsys._.iSignale._.obj.sig_dki UMR_PROZENT__20_51_0_S6_S3 4 0 100 DEPOSIT ABSOLUTE MONOTONY MON_INCREASE /end AXIS_DESCR
 /begin AXIS_DESCR STD_AXIS zff_atsys._.iSignale._.obj.sig_n_mot8 UMR_U_MIN_32_1_0_S6_S3 4 0 8160 DEPOSIT ABSOLUTE MONOTONY MON_INCREASE /end AXIS_DESCR
/end CHARACTERISTIC
/begin CHARACTERISTIC KF_MEHAUPT_6 "Hauptmotoreingriff Schaltablauf" MAP 0x22BFB4 kf_ui8_S6_S3 870 UMR_NM__6_1_M145_S6_S3 -870 0
 /begin AXIS_DESCR STD_AXIS NO_INPUT_QUANTITY UMR_U_MIN_32_1_0_S6_S3 6 0 8160 DEPOSIT ABSOLUTE MONOTONY MON_INCREASE /end AXIS_DESCR
 /begin AXIS_DESCR STD_AXIS zff_atsys._.iSignale._.obj.sig_m_t8 UMR_NM__8_1_M50_S6_S3 6 -400 1640 DEPOSIT ABSOLUTE MONOTONY MON_INCREASE /end AXIS_DESCR
/end CHARACTERISTIC
/begin CHARACTERISTIC KF_FTSYNNTMEHAUPTE_6 "Faktor auf Haupt-ME fuer Nach-ME" MAP 0x22BFEC kf_si16_S6_S3 1 UMR___1_100_0_S6_S3 0 1
 /begin AXIS_DESCR STD_AXIS iSasZentr.iSchaltend.t_syn UMR_MSEC__10_1_0_S6_S3 4 -5000 5000 DEPOSIT ABSOLUTE MONOTONY MON_INCREASE /end AXIS_DESCR
 /begin AXIS_DESCR STD_AXIS zff_atsys._.iSignale._.obj.sig_n_t UMR_U_MIN_1_1_0_S6_S3 4 0 8160 DEPOSIT ABSOLUTE MONOTONY MON_INCREASE /end AXIS_DESCR
/end CHARACTERISTIC
/begin CHARACTERISTIC KL_TSYNMTMEHAUPTE_6 "Zeit vor Erkennen synchron fuer Ende Haupt-ME" CURVE 0x22C024 kl_ui8_S6_S3 1280 UMR_MSEC__10_1_M128_S6_S3 -1280 0
 /begin AXIS_DESCR STD_AXIS zff_atsys._.iSignale._.obj.sig_m_t8 UMR_NM__8_1_M50_S6_S3 6 -400 1640 DEPOSIT ABSOLUTE MONOTONY MON_INCREASE /end AXIS_DESCR
/end CHARACTERISTIC
/begin CHARACTERISTIC KL_TVMEA_6 "Verzoegerungszeit fuer Beginn Haupt-ME" CURVE 0x22C034 kl_si16_S6_S3 2000 UMR_MSEC__10_1_0_S6_S3 -1000 1000
 /begin AXIS_DESCR STD_AXIS zff_atsys._.iSignale._.obj.sig_n_t8 UMR_U_MIN_32_1_0_S6_S3 8 0 8160 DEPOSIT ABSOLUTE MONOTONY MON_INCREASE /end AXIS_DESCR
/end CHARACTERISTIC
/begin CHARACTERISTIC T_SPERRSYN_6 "Sperrzeit ende Haupt-ME GE" VALUE 0x26E581 kw_ui8_S6_S3 2540 UMR_MSEC__10_1_0_S6_S3 0 2540 /end CHARACTERISTIC
/begin CHARACTERISTIC ND_MEHAUPTAGE_7 "Drehzahlkriterium Start Haupt-ME Gangeinlegen" VALUE 0x26D810 kw_si16_S6_S3 1000 UMR_U_MIN_1_1_0_S6_S3 0 1000 /end CHARACTERISTIC
/begin CHARACTERISTIC T_RAMEE_7 "Dauer Rampe ME bei Ende Gangeinlegen" VALUE 0x26E582 kw_ui8_S6_S3 2540 UMR_MSEC__10_1_0_S6_S3 0 2540 /end CHARACTERISTIC
/begin CHARACTERISTIC T_FMEHAUPTA_7 "Filterzeit Start Hauptmotoreingriff" VALUE 0x26D812 kw_si16_S6_S3 508 UMR_MSEC__1_1_0_S6_S3 -254 254 /end CHARACTERISTIC
/begin CHARACTERISTIC K_FMEHAUPTA_7 "Filterkonstante (aehnl INPT) Start Hauptmotoreingriff" VALUE 0x26D814 kw_si16_S6_S3 65.535 UMR___1_1000_0_S6_S3 -32.768 32.767 /end CHARACTERISTIC
/begin CHARACTERISTIC KF_FMEHAUPTGEDKINMOT_7 "Faktor auf Haupt-ME f(dki) Gangeinlegen D1 bis D6" MAP 0x22C058 kf_ui8_S6_S3 100 UMR_PROZENT__20_51_0_S6_S3 0 100
 /begin AXIS_DESCR STD_AXIS zff_atsys._.iSignale._.obj.sig_dki UMR_PROZENT__20_51_0_S6_S3 4 0 100 DEPOSIT ABSOLUTE MONOTONY MON_INCREASE /end AXIS_DESCR
 /begin AXIS_DESCR STD_AXIS zff_atsys._.iSignale._.obj.sig_n_mot8 UMR_U_MIN_32_1_0_S6_S3 4 0 8160 DEPOSIT ABSOLUTE MONOTONY MON_INCREASE /end AXIS_DESCR
/end CHARACTERISTIC
/begin CHARACTERISTIC KF_MEHAUPT_7 "Hauptmotoreingriff Schaltablauf" MAP 0x22C078 kf_ui8_S6_S3 870 UMR_NM__6_1_M145_S6_S3 -870 0
 /begin AXIS_DESCR STD_AXIS NO_INPUT_QUANTITY UMR_U_MIN_32_1_0_S6_S3 6 0 8160 DEPOSIT ABSOLUTE MONOTONY MON_INCREASE /end AXIS_DESCR
 /begin AXIS_DESCR STD_AXIS zff_atsys._.iSignale._.obj.sig_m_t8 UMR_NM__8_1_M50_S6_S3 6 -400 1640 DEPOSIT ABSOLUTE MONOTONY MON_INCREASE /end AXIS_DESCR
/end CHARACTERISTIC
/begin CHARACTERISTIC KF_FTSYNNTMEHAUPTE_7 "Faktor auf Haupt-ME fuer Nach-ME" MAP 0x22C0B0 kf_si16_S6_S3 1 UMR___1_100_0_S6_S3 0 1
 /begin AXIS_DESCR STD_AXIS iSasZentr.iSchaltend.t_syn UMR_MSEC__10_1_0_S6_S3 4 -5000 5000 DEPOSIT ABSOLUTE MONOTONY MON_INCREASE /end AXIS_DESCR
 /begin AXIS_DESCR STD_AXIS zff_atsys._.iSignale._.obj.sig_n_t UMR_U_MIN_1_1_0_S6_S3 4 0 8160 DEPOSIT ABSOLUTE MONOTONY MON_INCREASE /end AXIS_DESCR
/end CHARACTERISTIC
/begin CHARACTERISTIC KL_TSYNMTMEHAUPTE_7 "Zeit vor Erkennen synchron fuer Ende Haupt-ME" CURVE 0x22C0E8 kl_ui8_S6_S3 1280 UMR_MSEC__10_1_M128_S6_S3 -1280 0
 /begin AXIS_DESCR STD_AXIS zff_atsys._.iSignale._.obj.sig_m_t8 UMR_NM__8_1_M50_S6_S3 6 -400 1640 DEPOSIT ABSOLUTE MONOTONY MON_INCREASE /end AXIS_DESCR
/end CHARACTERISTIC
/begin CHARACTERISTIC KL_TVMEA_7 "Verzoegerungszeit fuer Beginn Haupt-ME" CURVE 0x22C0F8 kl_si16_S6_S3 2000 UMR_MSEC__10_1_0_S6_S3 -1000 1000
 /begin AXIS_DESCR STD_AXIS zff_atsys._.iSignale._.obj.sig_n_t8 UMR_U_MIN_32_1_0_S6_S3 8 0 8160 DEPOSIT ABSOLUTE MONOTONY MON_INCREASE /end AXIS_DESCR
/end CHARACTERISTIC
/begin CHARACTERISTIC T_SPERRSYN_7 "Sperrzeit ende Haupt-ME GE" VALUE 0x26E583 kw_ui8_S6_S3 2540 UMR_MSEC__10_1_0_S6_S3 0 2540 /end CHARACTERISTIC
/begin CHARACTERISTIC ND_MEHAUPTAGE_8 "Drehzahlkriterium Start Haupt-ME Gangeinlegen" VALUE 0x26D816 kw_si16_S6_S3 1000 UMR_U_MIN_1_1_0_S6_S3 0 1000 /end CHARACTERISTIC
/begin CHARACTERISTIC T_RAMEE_8 "Dauer Rampe ME bei Ende Gangeinlegen" VALUE 0x26E584 kw_ui8_S6_S3 2540 UMR_MSEC__10_1_0_S6_S3 0 2540 /end CHARACTERISTIC
/begin CHARACTERISTIC T_FMEHAUPTA_8 "Filterzeit Start Hauptmotoreingriff" VALUE 0x26D818 kw_si16_S6_S3 508 UMR_MSEC__1_1_0_S6_S3 -254 254 /end CHARACTERISTIC
/begin CHARACTERISTIC K_FMEHAUPTA_8 "Filterkonstante (aehnl INPT) Start Hauptmotoreingriff" VALUE 0x26D81A kw_si16_S6_S3 65.535 UMR___1_1000_0_S6_S3 -32.768 32.767 /end CHARACTERISTIC
/begin CHARACTERISTIC KF_FMEHAUPTGEDKINMOT_8 "Faktor auf Haupt-ME f(dki) Gangeinlegen D1 bis D6" MAP 0x22C11C kf_ui8_S6_S3 100 UMR_PROZENT__20_51_0_S6_S3 0 100
 /begin AXIS_DESCR STD_AXIS zff_atsys._.iSignale._.obj.sig_dki UMR_PROZENT__20_51_0_S6_S3 4 0 100 DEPOSIT ABSOLUTE MONOTONY MON_INCREASE /end AXIS_DESCR
 /begin AXIS_DESCR STD_AXIS zff_atsys._.iSignale._.obj.sig_n_mot8 UMR_U_MIN_32_1_0_S6_S3 4 0 8160 DEPOSIT ABSOLUTE MONOTONY MON_INCREASE /end AXIS_DESCR
/end CHARACTERISTIC
/begin CHARACTERISTIC KF_MEHAUPT_8 "Hauptmotoreingriff Schaltablauf" MAP 0x22C13C kf_ui8_S6_S3 870 UMR_NM__6_1_M145_S6_S3 -870 0
 /begin AXIS_DESCR STD_AXIS NO_INPUT_QUANTITY UMR_U_MIN_32_1_0_S6_S3 6 0 8160 DEPOSIT ABSOLUTE MONOTONY MON_INCREASE /end AXIS_DESCR
 /begin AXIS_DESCR STD_AXIS zff_atsys._.iSignale._.obj.sig_m_t8 UMR_NM__8_1_M50_S6_S3 6 -400 1640 DEPOSIT ABSOLUTE MONOTONY MON_INCREASE /end AXIS_DESCR
/end CHARACTERISTIC
/begin CHARACTERISTIC KF_FTSYNNTMEHAUPTE_8 "Faktor auf Haupt-ME fuer Nach-ME" MAP 0x22C174 kf_si16_S6_S3 1 UMR___1_100_0_S6_S3 0 1
 /begin AXIS_DESCR STD_AXIS iSasZentr.iSchaltend.t_syn UMR_MSEC__10_1_0_S6_S3 4 -5000 5000 DEPOSIT ABSOLUTE MONOTONY MON_INCREASE /end AXIS_DESCR
 /begin AXIS_DESCR STD_AXIS zff_atsys._.iSignale._.obj.sig_n_t UMR_U_MIN_1_1_0_S6_S3 4 0 8160 DEPOSIT ABSOLUTE MONOTONY MON_INCREASE /end AXIS_DESCR
/end CHARACTERISTIC
/begin CHARACTERISTIC KL_TSYNMTMEHAUPTE_8 "Zeit vor Erkennen synchron fuer Ende Haupt-ME" CURVE 0x22C1AC kl_ui8_S6_S3 1280 UMR_MSEC__10_1_M128_S6_S3 -1280 0
 /begin AXIS_DESCR STD_AXIS zff_atsys._.iSignale._.obj.sig_m_t8 UMR_NM__8_1_M50_S6_S3 6 -400 1640 DEPOSIT ABSOLUTE MONOTONY MON_INCREASE /end AXIS_DESCR
/end CHARACTERISTIC
/begin CHARACTERISTIC KL_TVMEA_8 "Verzoegerungszeit fuer Beginn Haupt-ME" CURVE 0x22C1BC kl_si16_S6_S3 2000 UMR_MSEC__10_1_0_S6_S3 -1000 1000
 /begin AXIS_DESCR STD_AXIS zff_atsys._.iSignale._.obj.sig_n_t8 UMR_U_MIN_32_1_0_S6_S3 8 0 8160 DEPOSIT ABSOLUTE MONOTONY MON_INCREASE /end AXIS_DESCR
/end CHARACTERISTIC
/begin CHARACTERISTIC T_SPERRSYN_8 "Sperrzeit ende Haupt-ME GE" VALUE 0x26E585 kw_ui8_S6_S3 2540 UMR_MSEC__10_1_0_S6_S3 0 2540 /end CHARACTERISTIC
/begin CHARACTERISTIC KF_MEHAUPT12 "Hauptmotoreingriff Schaltablauf" MAP 0x22C1E0 kf_ui8_S6_S3 1530 UMR_NM__6_1_M145_S6_S3 -870 660
 /begin AXIS_DESCR STD_AXIS iSasZentr.iSchaltend.n_tkf UMR_U_MIN_32_1_0_S6_S3 6 0 8160 DEPOSIT ABSOLUTE MONOTONY MON_INCREASE /end AXIS_DESCR
 /begin AXIS_DESCR STD_AXIS zff_atsys._.iSignale._.obj.sig_m_t8 UMR_NM__8_1_M50_S6_S3 10 -400 1640 DEPOSIT ABSOLUTE MONOTONY MON_INCREASE /end AXIS_DESCR
/end CHARACTERISTIC
/begin CHARACTERISTIC KF_MEHAUPT12_EL "Hauptmotoreingriff Schaltablauf" MAP 0x22C234 kf_ui8_S6_S3 1530 UMR_NM__6_1_M145_S6_S3 -870 660
 /begin AXIS_DESCR STD_AXIS iSasZentr.iSchaltend.n_tkf UMR_U_MIN_32_1_0_S6_S3 6 0 8160 DEPOSIT ABSOLUTE MONOTONY MON_INCREASE /end AXIS_DESCR
 /begin AXIS_DESCR STD_AXIS zff_atsys._.iSignale._.obj.sig_m_t8 UMR_NM__8_1_M50_S6_S3 10 -400 1640 DEPOSIT ABSOLUTE MONOTONY MON_INCREASE /end AXIS_DESCR
/end CHARACTERISTIC
/begin CHARACTERISTIC KF_MEHAUPT_LRHS12 "Motoreingriffsoffset" MAP 0x22C288 kf_ui8_S6_S3 1530 UMR_NM__6_1_M145_S6_S3 -870 660
 /begin AXIS_DESCR STD_AXIS iSasZentr.iSchaltend.n_tkf UMR_U_MIN_32_1_0_S6_S3 3 0 8160 DEPOSIT ABSOLUTE MONOTONY MON_INCREASE /end AXIS_DESCR
 /begin AXIS_DESCR STD_AXIS zff_atsys._.iSignale._.obj.sig_m_t8 UMR_NM__8_1_M50_S6_S3 6 -400 1640 DEPOSIT ABSOLUTE MONOTONY MON_INCREASE /end AXIS_DESCR
/end CHARACTERISTIC
/begin CHARACTERISTIC KF_MEHAUPT_LRHS12_EL "Motoreingriffsoffset" MAP 0x22C2AC kf_ui8_S6_S3 1530 UMR_NM__6_1_M145_S6_S3 -870 660
 /begin AXIS_DESCR STD_AXIS iSasZentr.iSchaltend.n_tkf UMR_U_MIN_32_1_0_S6_S3 3 0 8160 DEPOSIT ABSOLUTE MONOTONY MON_INCREASE /end AXIS_DESCR
 /begin AXIS_DESCR STD_AXIS zff_atsys._.iSignale._.obj.sig_m_t8 UMR_NM__8_1_M50_S6_S3 6 -400 1640 DEPOSIT ABSOLUTE MONOTONY MON_INCREASE /end AXIS_DESCR
/end CHARACTERISTIC
/begin CHARACTERISTIC KF_MEHYSKLASS12 "Hysterese zur ME Klassifizierung" MAP 0x22C2D0 kf_si16_S6_S3 1200 UMR_NM__1_1_0_S6_S3 -800 400
 /begin AXIS_DESCR STD_AXIS iItfInput.m_mot UMR_NM__1_1_0_S6_S3 4 -400 1640 DEPOSIT ABSOLUTE MONOTONY MON_INCREASE /end AXIS_DESCR
 /begin AXIS_DESCR STD_AXIS zff_atsys._.iSignale._.obj.sig_n_mot UMR_U_MIN_1_1_0_S6_S3 4 0 8160 DEPOSIT ABSOLUTE MONOTONY MON_INCREASE /end AXIS_DESCR
/end CHARACTERISTIC
/begin CHARACTERISTIC KF_FMENACHPOSE12 "Faktor fuer Reduzierung pos ME bei RS" MAP 0x22C308 kf_si16_S6_S3 1 UMR___1_100_0_S6_S3 0 1
 /begin AXIS_DESCR STD_AXIS iMoeMesaf.timer_rampe_pos UMR_MSEC__10_1_0_S6_S3 4 0 2550 DEPOSIT ABSOLUTE MONOTONY MON_INCREASE /end AXIS_DESCR
 /begin AXIS_DESCR STD_AXIS iMoeMesaf.me_sas_gesp UMR_NM__1_1_0_S6_S3 4 0 2000 DEPOSIT ABSOLUTE MONOTONY MON_INCREASE /end AXIS_DESCR
/end CHARACTERISTIC
/begin CHARACTERISTIC KF_MEHAUPT23 "Hauptmotoreingriff Schaltablauf" MAP 0x22C340 kf_ui8_S6_S3 1530 UMR_NM__6_1_M145_S6_S3 -870 660
 /begin AXIS_DESCR STD_AXIS iSasZentr.iSchaltend.n_tkf UMR_U_MIN_32_1_0_S6_S3 6 0 8160 DEPOSIT ABSOLUTE MONOTONY MON_INCREASE /end AXIS_DESCR
 /begin AXIS_DESCR STD_AXIS zff_atsys._.iSignale._.obj.sig_m_t8 UMR_NM__8_1_M50_S6_S3 10 -400 1640 DEPOSIT ABSOLUTE MONOTONY MON_INCREASE /end AXIS_DESCR
/end CHARACTERISTIC
/begin CHARACTERISTIC KF_MEHAUPT23_EL "Hauptmotoreingriff Schaltablauf" MAP 0x22C394 kf_ui8_S6_S3 1530 UMR_NM__6_1_M145_S6_S3 -870 660
 /begin AXIS_DESCR STD_AXIS iSasZentr.iSchaltend.n_tkf UMR_U_MIN_32_1_0_S6_S3 6 0 8160 DEPOSIT ABSOLUTE MONOTONY MON_INCREASE /end AXIS_DESCR
 /begin AXIS_DESCR STD_AXIS zff_atsys._.iSignale._.obj.sig_m_t8 UMR_NM__8_1_M50_S6_S3 10 -400 1640 DEPOSIT ABSOLUTE MONOTONY MON_INCREASE /end AXIS_DESCR
/end CHARACTERISTIC
/begin CHARACTERISTIC KF_MEHAUPT_LRHS23 "Motoreingriffsoffset" MAP 0x22C3E8 kf_ui8_S6_S3 1530 UMR_NM__6_1_M145_S6_S3 -870 660
 /begin AXIS_DESCR STD_AXIS iSasZentr.iSchaltend.n_tkf UMR_U_MIN_32_1_0_S6_S3 3 0 8160 DEPOSIT ABSOLUTE MONOTONY MON_INCREASE /end AXIS_DESCR
 /begin AXIS_DESCR STD_AXIS zff_atsys._.iSignale._.obj.sig_m_t8 UMR_NM__8_1_M50_S6_S3 6 -400 1640 DEPOSIT ABSOLUTE MONOTONY MON_INCREASE /end AXIS_DESCR
/end CHARACTERISTIC
/begin CHARACTERISTIC KF_MEHAUPT_LRHS23_EL "Motoreingriffsoffset" MAP 0x22C40C kf_ui8_S6_S3 1530 UMR_NM__6_1_M145_S6_S3 -870 660
 /begin AXIS_DESCR STD_AXIS iSasZentr.iSchaltend.n_tkf UMR_U_MIN_32_1_0_S6_S3 3 0 8160 DEPOSIT ABSOLUTE MONOTONY MON_INCREASE /end AXIS_DESCR
 /begin AXIS_DESCR STD_AXIS zff_atsys._.iSignale._.obj.sig_m_t8 UMR_NM__8_1_M50_S6_S3 6 -400 1640 DEPOSIT ABSOLUTE MONOTONY MON_INCREASE /end AXIS_DESCR
/end CHARACTERISTIC
/begin CHARACTERISTIC KF_MEHYSKLASS23 "Hysterese zur ME Klassifizierung" MAP 0x22C430 kf_si16_S6_S3 1200 UMR_NM__1_1_0_S6_S3 -800 400
 /begin AXIS_DESCR STD_AXIS iItfInput.m_mot UMR_NM__1_1_0_S6_S3 4 -400 1640 DEPOSIT ABSOLUTE MONOTONY MON_INCREASE /end AXIS_DESCR
 /begin AXIS_DESCR STD_AXIS zff_atsys._.iSignale._.obj.sig_n_mot UMR_U_MIN_1_1_0_S6_S3 4 0 8160 DEPOSIT ABSOLUTE MONOTONY MON_INCREASE /end AXIS_DESCR
/end CHARACTERISTIC
/begin CHARACTERISTIC KF_FMENACHPOSE23 "Faktor fuer Reduzierung pos ME bei RS" MAP 0x22C468 kf_si16_S6_S3 1 UMR___1_100_0_S6_S3 0 1
 /begin AXIS_DESCR STD_AXIS iMoeMesaf.timer_rampe_pos UMR_MSEC__10_1_0_S6_S3 4 0 2550 DEPOSIT ABSOLUTE MONOTONY MON_INCREASE /end AXIS_DESCR
 /begin AXIS_DESCR STD_AXIS iMoeMesaf.me_sas_gesp UMR_NM__1_1_0_S6_S3 4 0 2000 DEPOSIT ABSOLUTE MONOTONY MON_INCREASE /end AXIS_DESCR
/end CHARACTERISTIC
/begin CHARACTERISTIC KF_MEHAUPT34 "Hauptmotoreingriff Schaltablauf" MAP 0x22C4A0 kf_ui8_S6_S3 1530 UMR_NM__6_1_M145_S6_S3 -870 660
 /begin AXIS_DESCR STD_AXIS iSasZentr.iSchaltend.n_tkf UMR_U_MIN_32_1_0_S6_S3 6 0 8160 DEPOSIT ABSOLUTE MONOTONY MON_INCREASE /end AXIS_DESCR
 /begin AXIS_DESCR STD_AXIS zff_atsys._.iSignale._.obj.sig_m_t8 UMR_NM__8_1_M50_S6_S3 10 -400 1640 DEPOSIT ABSOLUTE MONOTONY MON_INCREASE /end AXIS_DESCR
/end CHARACTERISTIC
/begin CHARACTERISTIC KF_MEHAUPT34_EL "Hauptmotoreingriff Schaltablauf" MAP 0x22C4F4 kf_ui8_S6_S3 1530 UMR_NM__6_1_M145_S6_S3 -870 660
 /begin AXIS_DESCR STD_AXIS iSasZentr.iSchaltend.n_tkf UMR_U_MIN_32_1_0_S6_S3 6 0 8160 DEPOSIT ABSOLUTE MONOTONY MON_INCREASE /end AXIS_DESCR
 /begin AXIS_DESCR STD_AXIS zff_atsys._.iSignale._.obj.sig_m_t8 UMR_NM__8_1_M50_S6_S3 10 -400 1640 DEPOSIT ABSOLUTE MONOTONY MON_INCREASE /end AXIS_DESCR
/end CHARACTERISTIC
/begin CHARACTERISTIC KF_MEHAUPT_LRHS34 "Motoreingriffsoffset" MAP 0x22C548 kf_ui8_S6_S3 1530 UMR_NM__6_1_M145_S6_S3 -870 660
 /begin AXIS_DESCR STD_AXIS iSasZentr.iSchaltend.n_tkf UMR_U_MIN_32_1_0_S6_S3 3 0 8160 DEPOSIT ABSOLUTE MONOTONY MON_INCREASE /end AXIS_DESCR
 /begin AXIS_DESCR STD_AXIS zff_atsys._.iSignale._.obj.sig_m_t8 UMR_NM__8_1_M50_S6_S3 6 -400 1640 DEPOSIT ABSOLUTE MONOTONY MON_INCREASE /end AXIS_DESCR
/end CHARACTERISTIC
/begin CHARACTERISTIC KF_MEHAUPT_LRHS34_EL "Motoreingriffsoffset" MAP 0x22C56C kf_ui8_S6_S3 1530 UMR_NM__6_1_M145_S6_S3 -870 660
 /begin AXIS_DESCR STD_AXIS iSasZentr.iSchaltend.n_tkf UMR_U_MIN_32_1_0_S6_S3 3 0 8160 DEPOSIT ABSOLUTE MONOTONY MON_INCREASE /end AXIS_DESCR
 /begin AXIS_DESCR STD_AXIS zff_atsys._.iSignale._.obj.sig_m_t8 UMR_NM__8_1_M50_S6_S3 6 -400 1640 DEPOSIT ABSOLUTE MONOTONY MON_INCREASE /end AXIS_DESCR
/end CHARACTERISTIC
/begin CHARACTERISTIC KF_MEHYSKLASS34 "Hysterese zur ME Klassifizierung" MAP 0x22C590 kf_si16_S6_S3 1200 UMR_NM__1_1_0_S6_S3 -800 400
 /begin AXIS_DESCR STD_AXIS iItfInput.m_mot UMR_NM__1_1_0_S6_S3 4 -400 1640 DEPOSIT ABSOLUTE MONOTONY MON_INCREASE /end AXIS_DESCR
 /begin AXIS_DESCR STD_AXIS zff_atsys._.iSignale._.obj.sig_n_mot UMR_U_MIN_1_1_0_S6_S3 4 0 8160 DEPOSIT ABSOLUTE MONOTONY MON_INCREASE /end AXIS_DESCR
/end CHARACTERISTIC
/begin CHARACTERISTIC KF_FMENACHPOSE34 "Faktor fuer Reduzierung pos ME bei RS" MAP 0x22C5C8 kf_si16_S6_S3 1 UMR___1_100_0_S6_S3 0 1
 /begin AXIS_DESCR STD_AXIS iMoeMesaf.timer_rampe_pos UMR_MSEC__10_1_0_S6_S3 4 0 2550 DEPOSIT ABSOLUTE MONOTONY MON_INCREASE /end AXIS_DESCR
 /begin AXIS_DESCR STD_AXIS iMoeMesaf.me_sas_gesp UMR_NM__1_1_0_S6_S3 4 0 2000 DEPOSIT ABSOLUTE MONOTONY MON_INCREASE /end AXIS_DESCR
/end CHARACTERISTIC
/begin CHARACTERISTIC KF_MEHAUPT45 "Hauptmotoreingriff Schaltablauf" MAP 0x22C600 kf_ui8_S6_S3 1530 UMR_NM__6_1_M145_S6_S3 -870 660
 /begin AXIS_DESCR STD_AXIS iSasZentr.iSchaltend.n_tkf UMR_U_MIN_32_1_0_S6_S3 6 0 8160 DEPOSIT ABSOLUTE MONOTONY MON_INCREASE /end AXIS_DESCR
 /begin AXIS_DESCR STD_AXIS zff_atsys._.iSignale._.obj.sig_m_t8 UMR_NM__8_1_M50_S6_S3 10 -400 1640 DEPOSIT ABSOLUTE MONOTONY MON_INCREASE /end AXIS_DESCR
/end CHARACTERISTIC
/begin CHARACTERISTIC KF_MEHAUPT45_EL "Hauptmotoreingriff Schaltablauf" MAP 0x22C654 kf_ui8_S6_S3 1530 UMR_NM__6_1_M145_S6_S3 -870 660
 /begin AXIS_DESCR STD_AXIS iSasZentr.iSchaltend.n_tkf UMR_U_MIN_32_1_0_S6_S3 6 0 8160 DEPOSIT ABSOLUTE MONOTONY MON_INCREASE /end AXIS_DESCR
 /begin AXIS_DESCR STD_AXIS zff_atsys._.iSignale._.obj.sig_m_t8 UMR_NM__8_1_M50_S6_S3 10 -400 1640 DEPOSIT ABSOLUTE MONOTONY MON_INCREASE /end AXIS_DESCR
/end CHARACTERISTIC
/begin CHARACTERISTIC KF_MEHAUPT_LRHS45 "Motoreingriffsoffset" MAP 0x22C6A8 kf_ui8_S6_S3 1530 UMR_NM__6_1_M145_S6_S3 -870 660
 /begin AXIS_DESCR STD_AXIS iSasZentr.iSchaltend.n_tkf UMR_U_MIN_32_1_0_S6_S3 3 0 8160 DEPOSIT ABSOLUTE MONOTONY MON_INCREASE /end AXIS_DESCR
 /begin AXIS_DESCR STD_AXIS zff_atsys._.iSignale._.obj.sig_m_t8 UMR_NM__8_1_M50_S6_S3 6 -400 1640 DEPOSIT ABSOLUTE MONOTONY MON_INCREASE /end AXIS_DESCR
/end CHARACTERISTIC
/begin CHARACTERISTIC KF_MEHAUPT_LRHS45_EL "Motoreingriffsoffset" MAP 0x22C6CC kf_ui8_S6_S3 1530 UMR_NM__6_1_M145_S6_S3 -870 660
 /begin AXIS_DESCR STD_AXIS iSasZentr.iSchaltend.n_tkf UMR_U_MIN_32_1_0_S6_S3 3 0 8160 DEPOSIT ABSOLUTE MONOTONY MON_INCREASE /end AXIS_DESCR
 /begin AXIS_DESCR STD_AXIS zff_atsys._.iSignale._.obj.sig_m_t8 UMR_NM__8_1_M50_S6_S3 6 -400 1640 DEPOSIT ABSOLUTE MONOTONY MON_INCREASE /end AXIS_DESCR
/end CHARACTERISTIC
/begin CHARACTERISTIC KF_MEHYSKLASS45 "Hysterese zur ME Klassifizierung" MAP 0x22C6F0 kf_si16_S6_S3 1200 UMR_NM__1_1_0_S6_S3 -800 400
 /begin AXIS_DESCR STD_AXIS iItfInput.m_mot UMR_NM__1_1_0_S6_S3 4 -400 1640 DEPOSIT ABSOLUTE MONOTONY MON_INCREASE /end AXIS_DESCR
 /begin AXIS_DESCR STD_AXIS zff_atsys._.iSignale._.obj.sig_n_mot UMR_U_MIN_1_1_0_S6_S3 4 0 8160 DEPOSIT ABSOLUTE MONOTONY MON_INCREASE /end AXIS_DESCR
/end CHARACTERISTIC
/begin CHARACTERISTIC KF_FMENACHPOSE45 "Faktor fuer Reduzierung pos ME bei RS" MAP 0x22C728 kf_si16_S6_S3 1 UMR___1_100_0_S6_S3 0 1
 /begin AXIS_DESCR STD_AXIS iMoeMesaf.timer_rampe_pos UMR_MSEC__10_1_0_S6_S3 4 0 2550 DEPOSIT ABSOLUTE MONOTONY MON_INCREASE /end AXIS_DESCR
 /begin AXIS_DESCR STD_AXIS iMoeMesaf.me_sas_gesp UMR_NM__1_1_0_S6_S3 4 0 2000 DEPOSIT ABSOLUTE MONOTONY MON_INCREASE /end AXIS_DESCR
/end CHARACTERISTIC
/begin CHARACTERISTIC KF_MEHAUPT56 "Hauptmotoreingriff Schaltablauf" MAP 0x22C760 kf_ui8_S6_S3 1530 UMR_NM__6_1_M145_S6_S3 -870 660
 /begin AXIS_DESCR STD_AXIS iSasZentr.iSchaltend.n_tkf UMR_U_MIN_32_1_0_S6_S3 6 0 8160 DEPOSIT ABSOLUTE MONOTONY MON_INCREASE /end AXIS_DESCR
 /begin AXIS_DESCR STD_AXIS zff_atsys._.iSignale._.obj.sig_m_t8 UMR_NM__8_1_M50_S6_S3 10 -400 1640 DEPOSIT ABSOLUTE MONOTONY MON_INCREASE /end AXIS_DESCR
/end CHARACTERISTIC
/begin CHARACTERISTIC KF_MEHAUPT56_EL "Hauptmotoreingriff Schaltablauf" MAP 0x22C7B4 kf_ui8_S6_S3 1530 UMR_NM__6_1_M145_S6_S3 -870 660
 /begin AXIS_DESCR STD_AXIS iSasZentr.iSchaltend.n_tkf UMR_U_MIN_32_1_0_S6_S3 6 0 8160 DEPOSIT ABSOLUTE MONOTONY MON_INCREASE /end AXIS_DESCR
 /begin AXIS_DESCR STD_AXIS zff_atsys._.iSignale._.obj.sig_m_t8 UMR_NM__8_1_M50_S6_S3 10 -400 1640 DEPOSIT ABSOLUTE MONOTONY MON_INCREASE /end AXIS_DESCR
/end CHARACTERISTIC
/begin CHARACTERISTIC KF_MEHAUPT_LRHS56 "Motoreingriffsoffset" MAP 0x22C808 kf_ui8_S6_S3 1530 UMR_NM__6_1_M145_S6_S3 -870 660
 /begin AXIS_DESCR STD_AXIS iSasZentr.iSchaltend.n_tkf UMR_U_MIN_32_1_0_S6_S3 3 0 8160 DEPOSIT ABSOLUTE MONOTONY MON_INCREASE /end AXIS_DESCR
 /begin AXIS_DESCR STD_AXIS zff_atsys._.iSignale._.obj.sig_m_t8 UMR_NM__8_1_M50_S6_S3 6 -400 1640 DEPOSIT ABSOLUTE MONOTONY MON_INCREASE /end AXIS_DESCR
/end CHARACTERISTIC
/begin CHARACTERISTIC KF_MEHAUPT_LRHS56_EL "Motoreingriffsoffset" MAP 0x22C82C kf_ui8_S6_S3 1530 UMR_NM__6_1_M145_S6_S3 -870 660
 /begin AXIS_DESCR STD_AXIS iSasZentr.iSchaltend.n_tkf UMR_U_MIN_32_1_0_S6_S3 3 0 8160 DEPOSIT ABSOLUTE MONOTONY MON_INCREASE /end AXIS_DESCR
 /begin AXIS_DESCR STD_AXIS zff_atsys._.iSignale._.obj.sig_m_t8 UMR_NM__8_1_M50_S6_S3 6 -400 1640 DEPOSIT ABSOLUTE MONOTONY MON_INCREASE /end AXIS_DESCR
/end CHARACTERISTIC
/begin CHARACTERISTIC KF_MEHYSKLASS56 "Hysterese zur ME Klassifizierung" MAP 0x22C850 kf_si16_S6_S3 1200 UMR_NM__1_1_0_S6_S3 -800 400
 /begin AXIS_DESCR STD_AXIS iItfInput.m_mot UMR_NM__1_1_0_S6_S3 4 -400 1640 DEPOSIT ABSOLUTE MONOTONY MON_INCREASE /end AXIS_DESCR
 /begin AXIS_DESCR STD_AXIS zff_atsys._.iSignale._.obj.sig_n_mot UMR_U_MIN_1_1_0_S6_S3 4 0 8160 DEPOSIT ABSOLUTE MONOTONY MON_INCREASE /end AXIS_DESCR
/end CHARACTERISTIC
/begin CHARACTERISTIC KF_FMENACHPOSE56 "Faktor fuer Reduzierung pos ME bei RS" MAP 0x22C888 kf_si16_S6_S3 1 UMR___1_100_0_S6_S3 0 1
 /begin AXIS_DESCR STD_AXIS iMoeMesaf.timer_rampe_pos UMR_MSEC__10_1_0_S6_S3 4 0 2550 DEPOSIT ABSOLUTE MONOTONY MON_INCREASE /end AXIS_DESCR
 /begin AXIS_DESCR STD_AXIS iMoeMesaf.me_sas_gesp UMR_NM__1_1_0_S6_S3 4 0 2000 DEPOSIT ABSOLUTE MONOTONY MON_INCREASE /end AXIS_DESCR
/end CHARACTERISTIC
/begin CHARACTERISTIC KF_MEHAUPT67 "Hauptmotoreingriff Schaltablauf" MAP 0x22C8C0 kf_ui8_S6_S3 1530 UMR_NM__6_1_M145_S6_S3 -870 660
 /begin AXIS_DESCR STD_AXIS iSasZentr.iSchaltend.n_tkf UMR_U_MIN_32_1_0_S6_S3 6 0 8160 DEPOSIT ABSOLUTE MONOTONY MON_INCREASE /end AXIS_DESCR
 /begin AXIS_DESCR STD_AXIS zff_atsys._.iSignale._.obj.sig_m_t8 UMR_NM__8_1_M50_S6_S3 10 -400 1640 DEPOSIT ABSOLUTE MONOTONY MON_INCREASE /end AXIS_DESCR
/end CHARACTERISTIC
/begin CHARACTERISTIC KF_MEHAUPT67_EL "Hauptmotoreingriff Schaltablauf" MAP 0x22C914 kf_ui8_S6_S3 1530 UMR_NM__6_1_M145_S6_S3 -870 660
 /begin AXIS_DESCR STD_AXIS iSasZentr.iSchaltend.n_tkf UMR_U_MIN_32_1_0_S6_S3 6 0 8160 DEPOSIT ABSOLUTE MONOTONY MON_INCREASE /end AXIS_DESCR
 /begin AXIS_DESCR STD_AXIS zff_atsys._.iSignale._.obj.sig_m_t8 UMR_NM__8_1_M50_S6_S3 10 -400 1640 DEPOSIT ABSOLUTE MONOTONY MON_INCREASE /end AXIS_DESCR
/end CHARACTERISTIC
/begin CHARACTERISTIC KF_MEHAUPT_LRHS67 "Motoreingriffsoffset" MAP 0x22C968 kf_ui8_S6_S3 1530 UMR_NM__6_1_M145_S6_S3 -870 660
 /begin AXIS_DESCR STD_AXIS iSasZentr.iSchaltend.n_tkf UMR_U_MIN_32_1_0_S6_S3 3 0 8160 DEPOSIT ABSOLUTE MONOTONY MON_INCREASE /end AXIS_DESCR
 /begin AXIS_DESCR STD_AXIS zff_atsys._.iSignale._.obj.sig_m_t8 UMR_NM__8_1_M50_S6_S3 6 -400 1640 DEPOSIT ABSOLUTE MONOTONY MON_INCREASE /end AXIS_DESCR
/end CHARACTERISTIC
/begin CHARACTERISTIC KF_MEHAUPT_LRHS67_EL "Motoreingriffsoffset" MAP 0x22C98C kf_ui8_S6_S3 1530 UMR_NM__6_1_M145_S6_S3 -870 660
 /begin AXIS_DESCR STD_AXIS iSasZentr.iSchaltend.n_tkf UMR_U_MIN_32_1_0_S6_S3 3 0 8160 DEPOSIT ABSOLUTE MONOTONY MON_INCREASE /end AXIS_DESCR
 /begin AXIS_DESCR STD_AXIS zff_atsys._.iSignale._.obj.sig_m_t8 UMR_NM__8_1_M50_S6_S3 6 -400 1640 DEPOSIT ABSOLUTE MONOTONY MON_INCREASE /end AXIS_DESCR
/end CHARACTERISTIC
/begin CHARACTERISTIC KF_MEHYSKLASS67 "Hysterese zur ME Klassifizierung" MAP 0x22C9B0 kf_si16_S6_S3 1200 UMR_NM__1_1_0_S6_S3 -800 400
 /begin AXIS_DESCR STD_AXIS iItfInput.m_mot UMR_NM__1_1_0_S6_S3 4 -400 1640 DEPOSIT ABSOLUTE MONOTONY MON_INCREASE /end AXIS_DESCR
 /begin AXIS_DESCR STD_AXIS zff_atsys._.iSignale._.obj.sig_n_mot UMR_U_MIN_1_1_0_S6_S3 4 0 8160 DEPOSIT ABSOLUTE MONOTONY MON_INCREASE /end AXIS_DESCR
/end CHARACTERISTIC
/begin CHARACTERISTIC KF_FMENACHPOSE67 "Faktor fuer Reduzierung pos ME bei RS" MAP 0x22C9E8 kf_si16_S6_S3 1 UMR___1_100_0_S6_S3 0 1
 /begin AXIS_DESCR STD_AXIS iMoeMesaf.timer_rampe_pos UMR_MSEC__10_1_0_S6_S3 4 0 2550 DEPOSIT ABSOLUTE MONOTONY MON_INCREASE /end AXIS_DESCR
 /begin AXIS_DESCR STD_AXIS iMoeMesaf.me_sas_gesp UMR_NM__1_1_0_S6_S3 4 0 2000 DEPOSIT ABSOLUTE MONOTONY MON_INCREASE /end AXIS_DESCR
/end CHARACTERISTIC
/begin CHARACTERISTIC KF_MEHAUPT78 "Hauptmotoreingriff Schaltablauf" MAP 0x22CA20 kf_ui8_S6_S3 1530 UMR_NM__6_1_M145_S6_S3 -870 660
 /begin AXIS_DESCR STD_AXIS iSasZentr.iSchaltend.n_tkf UMR_U_MIN_32_1_0_S6_S3 6 0 8160 DEPOSIT ABSOLUTE MONOTONY MON_INCREASE /end AXIS_DESCR
 /begin AXIS_DESCR STD_AXIS zff_atsys._.iSignale._.obj.sig_m_t8 UMR_NM__8_1_M50_S6_S3 10 -400 1640 DEPOSIT ABSOLUTE MONOTONY MON_INCREASE /end AXIS_DESCR
/end CHARACTERISTIC
/begin CHARACTERISTIC KF_MEHAUPT78_EL "Hauptmotoreingriff Schaltablauf" MAP 0x22CA74 kf_ui8_S6_S3 1530 UMR_NM__6_1_M145_S6_S3 -870 660
 /begin AXIS_DESCR STD_AXIS iSasZentr.iSchaltend.n_tkf UMR_U_MIN_32_1_0_S6_S3 6 0 8160 DEPOSIT ABSOLUTE MONOTONY MON_INCREASE /end AXIS_DESCR
 /begin AXIS_DESCR STD_AXIS zff_atsys._.iSignale._.obj.sig_m_t8 UMR_NM__8_1_M50_S6_S3 10 -400 1640 DEPOSIT ABSOLUTE MONOTONY MON_INCREASE /end AXIS_DESCR
/end CHARACTERISTIC
/begin CHARACTERISTIC KF_MEHAUPT_LRHS78 "Motoreingriffsoffset" MAP 0x22CAC8 kf_ui8_S6_S3 1530 UMR_NM__6_1_M145_S6_S3 -870 660
 /begin AXIS_DESCR STD_AXIS iSasZentr.iSchaltend.n_tkf UMR_U_MIN_32_1_0_S6_S3 3 0 8160 DEPOSIT ABSOLUTE MONOTONY MON_INCREASE /end AXIS_DESCR
 /begin AXIS_DESCR STD_AXIS zff_atsys._.iSignale._.obj.sig_m_t8 UMR_NM__8_1_M50_S6_S3 6 -400 1640 DEPOSIT ABSOLUTE MONOTONY MON_INCREASE /end AXIS_DESCR
/end CHARACTERISTIC
/begin CHARACTERISTIC KF_MEHAUPT_LRHS78_EL "Motoreingriffsoffset" MAP 0x22CAEC kf_ui8_S6_S3 1530 UMR_NM__6_1_M145_S6_S3 -870 660
 /begin AXIS_DESCR STD_AXIS iSasZentr.iSchaltend.n_tkf UMR_U_MIN_32_1_0_S6_S3 3 0 8160 DEPOSIT ABSOLUTE MONOTONY MON_INCREASE /end AXIS_DESCR
 /begin AXIS_DESCR STD_AXIS zff_atsys._.iSignale._.obj.sig_m_t8 UMR_NM__8_1_M50_S6_S3 6 -400 1640 DEPOSIT ABSOLUTE MONOTONY MON_INCREASE /end AXIS_DESCR
/end CHARACTERISTIC
/begin CHARACTERISTIC KF_MEHYSKLASS78 "Hysterese zur ME Klassifizierung" MAP 0x22CB10 kf_si16_S6_S3 1200 UMR_NM__1_1_0_S6_S3 -800 400
 /begin AXIS_DESCR STD_AXIS iItfInput.m_mot UMR_NM__1_1_0_S6_S3 4 -400 1640 DEPOSIT ABSOLUTE MONOTONY MON_INCREASE /end AXIS_DESCR
 /begin AXIS_DESCR STD_AXIS zff_atsys._.iSignale._.obj.sig_n_mot UMR_U_MIN_1_1_0_S6_S3 4 0 8160 DEPOSIT ABSOLUTE MONOTONY MON_INCREASE /end AXIS_DESCR
/end CHARACTERISTIC
/begin CHARACTERISTIC KF_FMENACHPOSE78 "Faktor fuer Reduzierung pos ME bei RS" MAP 0x22CB48 kf_si16_S6_S3 1 UMR___1_100_0_S6_S3 0 1
 /begin AXIS_DESCR STD_AXIS iMoeMesaf.timer_rampe_pos UMR_MSEC__10_1_0_S6_S3 4 0 2550 DEPOSIT ABSOLUTE MONOTONY MON_INCREASE /end AXIS_DESCR
 /begin AXIS_DESCR STD_AXIS iMoeMesaf.me_sas_gesp UMR_NM__1_1_0_S6_S3 4 0 2000 DEPOSIT ABSOLUTE MONOTONY MON_INCREASE /end AXIS_DESCR
/end CHARACTERISTIC
/begin CHARACTERISTIC KF_MEHAUPT13 "Hauptmotoreingriff Schaltablauf" MAP 0x22CB80 kf_ui8_S6_S3 1530 UMR_NM__6_1_M145_S6_S3 -870 660
 /begin AXIS_DESCR STD_AXIS iSasZentr.iSchaltend.n_tkf UMR_U_MIN_32_1_0_S6_S3 6 0 8160 DEPOSIT ABSOLUTE MONOTONY MON_INCREASE /end AXIS_DESCR
 /begin AXIS_DESCR STD_AXIS zff_atsys._.iSignale._.obj.sig_m_t8 UMR_NM__8_1_M50_S6_S3 10 -400 1640 DEPOSIT ABSOLUTE MONOTONY MON_INCREASE /end AXIS_DESCR
/end CHARACTERISTIC
/begin CHARACTERISTIC KF_MEHAUPT_LRHS13 "Motoreingriffsoffset" MAP 0x22CBD4 kf_ui8_S6_S3 1530 UMR_NM__6_1_M145_S6_S3 -870 660
 /begin AXIS_DESCR STD_AXIS iSasZentr.iSchaltend.n_tkf UMR_U_MIN_32_1_0_S6_S3 3 0 8160 DEPOSIT ABSOLUTE MONOTONY MON_INCREASE /end AXIS_DESCR
 /begin AXIS_DESCR STD_AXIS zff_atsys._.iSignale._.obj.sig_m_t8 UMR_NM__8_1_M50_S6_S3 6 -400 1640 DEPOSIT ABSOLUTE MONOTONY MON_INCREASE /end AXIS_DESCR
/end CHARACTERISTIC
/begin CHARACTERISTIC KF_FMENACHPOSE13 "Faktor fuer Reduzierung pos ME bei RS" MAP 0x22CBF8 kf_si16_S6_S3 1 UMR___1_100_0_S6_S3 0 1
 /begin AXIS_DESCR STD_AXIS iMoeMesaf.timer_rampe_pos UMR_MSEC__10_1_0_S6_S3 4 0 2550 DEPOSIT ABSOLUTE MONOTONY MON_INCREASE /end AXIS_DESCR
 /begin AXIS_DESCR STD_AXIS iMoeMesaf.me_sas_gesp UMR_NM__1_1_0_S6_S3 4 0 2000 DEPOSIT ABSOLUTE MONOTONY MON_INCREASE /end AXIS_DESCR
/end CHARACTERISTIC
/begin CHARACTERISTIC KF_MEHAUPT24 "Hauptmotoreingriff Schaltablauf" MAP 0x22CC30 kf_ui8_S6_S3 1530 UMR_NM__6_1_M145_S6_S3 -870 660
 /begin AXIS_DESCR STD_AXIS iSasZentr.iSchaltend.n_tkf UMR_U_MIN_32_1_0_S6_S3 6 0 8160 DEPOSIT ABSOLUTE MONOTONY MON_INCREASE /end AXIS_DESCR
 /begin AXIS_DESCR STD_AXIS zff_atsys._.iSignale._.obj.sig_m_t8 UMR_NM__8_1_M50_S6_S3 10 -400 1640 DEPOSIT ABSOLUTE MONOTONY MON_INCREASE /end AXIS_DESCR
/end CHARACTERISTIC
/begin CHARACTERISTIC KF_MEHAUPT_LRHS24 "Motoreingriffsoffset" MAP 0x22CC84 kf_ui8_S6_S3 1530 UMR_NM__6_1_M145_S6_S3 -870 660
 /begin AXIS_DESCR STD_AXIS iSasZentr.iSchaltend.n_tkf UMR_U_MIN_32_1_0_S6_S3 3 0 8160 DEPOSIT ABSOLUTE MONOTONY MON_INCREASE /end AXIS_DESCR
 /begin AXIS_DESCR STD_AXIS zff_atsys._.iSignale._.obj.sig_m_t8 UMR_NM__8_1_M50_S6_S3 6 -400 1640 DEPOSIT ABSOLUTE MONOTONY MON_INCREASE /end AXIS_DESCR
/end CHARACTERISTIC
/begin CHARACTERISTIC KF_FMENACHPOSE24 "Faktor fuer Reduzierung pos ME bei RS" MAP 0x22CCA8 kf_si16_S6_S3 1 UMR___1_100_0_S6_S3 0 1
 /begin AXIS_DESCR STD_AXIS iMoeMesaf.timer_rampe_pos UMR_MSEC__10_1_0_S6_S3 4 0 2550 DEPOSIT ABSOLUTE MONOTONY MON_INCREASE /end AXIS_DESCR
 /begin AXIS_DESCR STD_AXIS iMoeMesaf.me_sas_gesp UMR_NM__1_1_0_S6_S3 4 0 2000 DEPOSIT ABSOLUTE MONOTONY MON_INCREASE /end AXIS_DESCR
/end CHARACTERISTIC
/begin CHARACTERISTIC KF_MEHAUPT35 "Hauptmotoreingriff Schaltablauf" MAP 0x22CCE0 kf_ui8_S6_S3 1530 UMR_NM__6_1_M145_S6_S3 -870 660
 /begin AXIS_DESCR STD_AXIS iSasZentr.iSchaltend.n_tkf UMR_U_MIN_32_1_0_S6_S3 6 0 8160 DEPOSIT ABSOLUTE MONOTONY MON_INCREASE /end AXIS_DESCR
 /begin AXIS_DESCR STD_AXIS zff_atsys._.iSignale._.obj.sig_m_t8 UMR_NM__8_1_M50_S6_S3 10 -400 1640 DEPOSIT ABSOLUTE MONOTONY MON_INCREASE /end AXIS_DESCR
/end CHARACTERISTIC
/begin CHARACTERISTIC KF_MEHAUPT_LRHS35 "Motoreingriffsoffset" MAP 0x22CD34 kf_ui8_S6_S3 1530 UMR_NM__6_1_M145_S6_S3 -870 660
 /begin AXIS_DESCR STD_AXIS iSasZentr.iSchaltend.n_tkf UMR_U_MIN_32_1_0_S6_S3 3 0 8160 DEPOSIT ABSOLUTE MONOTONY MON_INCREASE /end AXIS_DESCR
 /begin AXIS_DESCR STD_AXIS zff_atsys._.iSignale._.obj.sig_m_t8 UMR_NM__8_1_M50_S6_S3 6 -400 1640 DEPOSIT ABSOLUTE MONOTONY MON_INCREASE /end AXIS_DESCR
/end CHARACTERISTIC
/begin CHARACTERISTIC KF_FMENACHPOSE35 "Faktor fuer Reduzierung pos ME bei RS" MAP 0x22CD58 kf_si16_S6_S3 1 UMR___1_100_0_S6_S3 0 1
 /begin AXIS_DESCR STD_AXIS iMoeMesaf.timer_rampe_pos UMR_MSEC__10_1_0_S6_S3 4 0 2550 DEPOSIT ABSOLUTE MONOTONY MON_INCREASE /end AXIS_DESCR
 /begin AXIS_DESCR STD_AXIS iMoeMesaf.me_sas_gesp UMR_NM__1_1_0_S6_S3 4 0 2000 DEPOSIT ABSOLUTE MONOTONY MON_INCREASE /end AXIS_DESCR
/end CHARACTERISTIC
/begin CHARACTERISTIC KF_MEHAUPT46 "Hauptmotoreingriff Schaltablauf" MAP 0x22CD90 kf_ui8_S6_S3 1530 UMR_NM__6_1_M145_S6_S3 -870 660
 /begin AXIS_DESCR STD_AXIS iSasZentr.iSchaltend.n_tkf UMR_U_MIN_32_1_0_S6_S3 6 0 8160 DEPOSIT ABSOLUTE MONOTONY MON_INCREASE /end AXIS_DESCR
 /begin AXIS_DESCR STD_AXIS zff_atsys._.iSignale._.obj.sig_m_t8 UMR_NM__8_1_M50_S6_S3 10 -400 1640 DEPOSIT ABSOLUTE MONOTONY MON_INCREASE /end AXIS_DESCR
/end CHARACTERISTIC
/begin CHARACTERISTIC KF_MEHAUPT_LRHS46 "Motoreingriffsoffset" MAP 0x22CDE4 kf_ui8_S6_S3 1530 UMR_NM__6_1_M145_S6_S3 -870 660
 /begin AXIS_DESCR STD_AXIS iSasZentr.iSchaltend.n_tkf UMR_U_MIN_32_1_0_S6_S3 3 0 8160 DEPOSIT ABSOLUTE MONOTONY MON_INCREASE /end AXIS_DESCR
 /begin AXIS_DESCR STD_AXIS zff_atsys._.iSignale._.obj.sig_m_t8 UMR_NM__8_1_M50_S6_S3 6 -400 1640 DEPOSIT ABSOLUTE MONOTONY MON_INCREASE /end AXIS_DESCR
/end CHARACTERISTIC
/begin CHARACTERISTIC KF_FMENACHPOSE46 "Faktor fuer Reduzierung pos ME bei RS" MAP 0x22CE08 kf_si16_S6_S3 1 UMR___1_100_0_S6_S3 0 1
 /begin AXIS_DESCR STD_AXIS iMoeMesaf.timer_rampe_pos UMR_MSEC__10_1_0_S6_S3 4 0 2550 DEPOSIT ABSOLUTE MONOTONY MON_INCREASE /end AXIS_DESCR
 /begin AXIS_DESCR STD_AXIS iMoeMesaf.me_sas_gesp UMR_NM__1_1_0_S6_S3 4 0 2000 DEPOSIT ABSOLUTE MONOTONY MON_INCREASE /end AXIS_DESCR
/end CHARACTERISTIC
/begin CHARACTERISTIC KF_MEHAUPT57 "Hauptmotoreingriff Schaltablauf" MAP 0x22CE40 kf_ui8_S6_S3 1530 UMR_NM__6_1_M145_S6_S3 -870 660
 /begin AXIS_DESCR STD_AXIS iSasZentr.iSchaltend.n_tkf UMR_U_MIN_32_1_0_S6_S3 6 0 8160 DEPOSIT ABSOLUTE MONOTONY MON_INCREASE /end AXIS_DESCR
 /begin AXIS_DESCR STD_AXIS zff_atsys._.iSignale._.obj.sig_m_t8 UMR_NM__8_1_M50_S6_S3 10 -400 1640 DEPOSIT ABSOLUTE MONOTONY MON_INCREASE /end AXIS_DESCR
/end CHARACTERISTIC
/begin CHARACTERISTIC KF_MEHAUPT_LRHS57 "Motoreingriffsoffset" MAP 0x22CE94 kf_ui8_S6_S3 1530 UMR_NM__6_1_M145_S6_S3 -870 660
 /begin AXIS_DESCR STD_AXIS iSasZentr.iSchaltend.n_tkf UMR_U_MIN_32_1_0_S6_S3 3 0 8160 DEPOSIT ABSOLUTE MONOTONY MON_INCREASE /end AXIS_DESCR
 /begin AXIS_DESCR STD_AXIS zff_atsys._.iSignale._.obj.sig_m_t8 UMR_NM__8_1_M50_S6_S3 6 -400 1640 DEPOSIT ABSOLUTE MONOTONY MON_INCREASE /end AXIS_DESCR
/end CHARACTERISTIC
/begin CHARACTERISTIC KF_FMENACHPOSE57 "Faktor fuer Reduzierung pos ME bei RS" MAP 0x22CEB8 kf_si16_S6_S3 1 UMR___1_100_0_S6_S3 0 1
 /begin AXIS_DESCR STD_AXIS iMoeMesaf.timer_rampe_pos UMR_MSEC__10_1_0_S6_S3 4 0 2550 DEPOSIT ABSOLUTE MONOTONY MON_INCREASE /end AXIS_DESCR
 /begin AXIS_DESCR STD_AXIS iMoeMesaf.me_sas_gesp UMR_NM__1_1_0_S6_S3 4 0 2000 DEPOSIT ABSOLUTE MONOTONY MON_INCREASE /end AXIS_DESCR
/end CHARACTERISTIC
/begin CHARACTERISTIC KF_MEHAUPT68 "Hauptmotoreingriff Schaltablauf" MAP 0x22CEF0 kf_ui8_S6_S3 1530 UMR_NM__6_1_M145_S6_S3 -870 660
 /begin AXIS_DESCR STD_AXIS iSasZentr.iSchaltend.n_tkf UMR_U_MIN_32_1_0_S6_S3 6 0 8160 DEPOSIT ABSOLUTE MONOTONY MON_INCREASE /end AXIS_DESCR
 /begin AXIS_DESCR STD_AXIS zff_atsys._.iSignale._.obj.sig_m_t8 UMR_NM__8_1_M50_S6_S3 10 -400 1640 DEPOSIT ABSOLUTE MONOTONY MON_INCREASE /end AXIS_DESCR
/end CHARACTERISTIC
/begin CHARACTERISTIC KF_MEHAUPT_LRHS68 "Motoreingriffsoffset" MAP 0x22CF44 kf_ui8_S6_S3 1530 UMR_NM__6_1_M145_S6_S3 -870 660
 /begin AXIS_DESCR STD_AXIS iSasZentr.iSchaltend.n_tkf UMR_U_MIN_32_1_0_S6_S3 3 0 8160 DEPOSIT ABSOLUTE MONOTONY MON_INCREASE /end AXIS_DESCR
 /begin AXIS_DESCR STD_AXIS zff_atsys._.iSignale._.obj.sig_m_t8 UMR_NM__8_1_M50_S6_S3 6 -400 1640 DEPOSIT ABSOLUTE MONOTONY MON_INCREASE /end AXIS_DESCR
/end CHARACTERISTIC
/begin CHARACTERISTIC KF_FMENACHPOSE68 "Faktor fuer Reduzierung pos ME bei RS" MAP 0x22CF68 kf_si16_S6_S3 1 UMR___1_100_0_S6_S3 0 1
 /begin AXIS_DESCR STD_AXIS iMoeMesaf.timer_rampe_pos UMR_MSEC__10_1_0_S6_S3 4 0 2550 DEPOSIT ABSOLUTE MONOTONY MON_INCREASE /end AXIS_DESCR
 /begin AXIS_DESCR STD_AXIS iMoeMesaf.me_sas_gesp UMR_NM__1_1_0_S6_S3 4 0 2000 DEPOSIT ABSOLUTE MONOTONY MON_INCREASE /end AXIS_DESCR
/end CHARACTERISTIC
/begin CHARACTERISTIC KF_MEHAUPTSP12 "Hauptmotoreingriff Schaltablauf" MAP 0x22CFA0 kf_ui8_S6_S3 1530 UMR_NM__6_1_M145_S6_S3 -870 660
 /begin AXIS_DESCR STD_AXIS iSasZentr.iSchaltend.n_tkf UMR_U_MIN_32_1_0_S6_S3 6 0 8160 DEPOSIT ABSOLUTE MONOTONY MON_INCREASE /end AXIS_DESCR
 /begin AXIS_DESCR STD_AXIS zff_atsys._.iSignale._.obj.sig_m_t8 UMR_NM__8_1_M50_S6_S3 10 -400 1640 DEPOSIT ABSOLUTE MONOTONY MON_INCREASE /end AXIS_DESCR
/end CHARACTERISTIC
/begin CHARACTERISTIC KF_MEHAUPT_LRHSSP12 "Motoreingriffsoffset" MAP 0x22CFF4 kf_ui8_S6_S3 1530 UMR_NM__6_1_M145_S6_S3 -870 660
 /begin AXIS_DESCR STD_AXIS iSasZentr.iSchaltend.n_tkf UMR_U_MIN_32_1_0_S6_S3 3 0 8160 DEPOSIT ABSOLUTE MONOTONY MON_INCREASE /end AXIS_DESCR
 /begin AXIS_DESCR STD_AXIS zff_atsys._.iSignale._.obj.sig_m_t8 UMR_NM__8_1_M50_S6_S3 6 -400 1640 DEPOSIT ABSOLUTE MONOTONY MON_INCREASE /end AXIS_DESCR
/end CHARACTERISTIC
/begin CHARACTERISTIC KF_MEHYSKLASSSP12 "Hysterese zur ME Klassifizierung" MAP 0x22D018 kf_si16_S6_S3 1200 UMR_NM__1_1_0_S6_S3 -800 400
 /begin AXIS_DESCR STD_AXIS iItfInput.m_mot UMR_NM__1_1_0_S6_S3 4 -400 1640 DEPOSIT ABSOLUTE MONOTONY MON_INCREASE /end AXIS_DESCR
 /begin AXIS_DESCR STD_AXIS zff_atsys._.iSignale._.obj.sig_n_mot UMR_U_MIN_1_1_0_S6_S3 4 0 8160 DEPOSIT ABSOLUTE MONOTONY MON_INCREASE /end AXIS_DESCR
/end CHARACTERISTIC
/begin CHARACTERISTIC KF_FMENACHPOSESP12 "Faktor fuer Reduzierung pos ME bei RS" MAP 0x22D050 kf_si16_S6_S3 1 UMR___1_100_0_S6_S3 0 1
 /begin AXIS_DESCR STD_AXIS iMoeMesaf.timer_rampe_pos UMR_MSEC__10_1_0_S6_S3 4 0 2550 DEPOSIT ABSOLUTE MONOTONY MON_INCREASE /end AXIS_DESCR
 /begin AXIS_DESCR STD_AXIS iMoeMesaf.me_sas_gesp UMR_NM__1_1_0_S6_S3 4 0 2000 DEPOSIT ABSOLUTE MONOTONY MON_INCREASE /end AXIS_DESCR
/end CHARACTERISTIC
/begin CHARACTERISTIC KF_MEHAUPTSP23 "Hauptmotoreingriff Schaltablauf" MAP 0x22D088 kf_ui8_S6_S3 1530 UMR_NM__6_1_M145_S6_S3 -870 660
 /begin AXIS_DESCR STD_AXIS iSasZentr.iSchaltend.n_tkf UMR_U_MIN_32_1_0_S6_S3 6 0 8160 DEPOSIT ABSOLUTE MONOTONY MON_INCREASE /end AXIS_DESCR
 /begin AXIS_DESCR STD_AXIS zff_atsys._.iSignale._.obj.sig_m_t8 UMR_NM__8_1_M50_S6_S3 10 -400 1640 DEPOSIT ABSOLUTE MONOTONY MON_INCREASE /end AXIS_DESCR
/end CHARACTERISTIC
/begin CHARACTERISTIC KF_MEHAUPT_LRHSSP23 "Motoreingriffsoffset" MAP 0x22D0DC kf_ui8_S6_S3 1530 UMR_NM__6_1_M145_S6_S3 -870 660
 /begin AXIS_DESCR STD_AXIS iSasZentr.iSchaltend.n_tkf UMR_U_MIN_32_1_0_S6_S3 3 0 8160 DEPOSIT ABSOLUTE MONOTONY MON_INCREASE /end AXIS_DESCR
 /begin AXIS_DESCR STD_AXIS zff_atsys._.iSignale._.obj.sig_m_t8 UMR_NM__8_1_M50_S6_S3 6 -400 1640 DEPOSIT ABSOLUTE MONOTONY MON_INCREASE /end AXIS_DESCR
/end CHARACTERISTIC
/begin CHARACTERISTIC KF_MEHYSKLASSSP23 "Hysterese zur ME Klassifizierung" MAP 0x22D100 kf_si16_S6_S3 1200 UMR_NM__1_1_0_S6_S3 -800 400
 /begin AXIS_DESCR STD_AXIS iItfInput.m_mot UMR_NM__1_1_0_S6_S3 4 -400 1640 DEPOSIT ABSOLUTE MONOTONY MON_INCREASE /end AXIS_DESCR
 /begin AXIS_DESCR STD_AXIS zff_atsys._.iSignale._.obj.sig_n_mot UMR_U_MIN_1_1_0_S6_S3 4 0 8160 DEPOSIT ABSOLUTE MONOTONY MON_INCREASE /end AXIS_DESCR
/end CHARACTERISTIC
/begin CHARACTERISTIC KF_FMENACHPOSESP23 "Faktor fuer Reduzierung pos ME bei RS" MAP 0x22D138 kf_si16_S6_S3 1 UMR___1_100_0_S6_S3 0 1
 /begin AXIS_DESCR STD_AXIS iMoeMesaf.timer_rampe_pos UMR_MSEC__10_1_0_S6_S3 4 0 2550 DEPOSIT ABSOLUTE MONOTONY MON_INCREASE /end AXIS_DESCR
 /begin AXIS_DESCR STD_AXIS iMoeMesaf.me_sas_gesp UMR_NM__1_1_0_S6_S3 4 0 2000 DEPOSIT ABSOLUTE MONOTONY MON_INCREASE /end AXIS_DESCR
/end CHARACTERISTIC
/begin CHARACTERISTIC KF_MEHAUPTSP34 "Hauptmotoreingriff Schaltablauf" MAP 0x22D170 kf_ui8_S6_S3 1530 UMR_NM__6_1_M145_S6_S3 -870 660
 /begin AXIS_DESCR STD_AXIS iSasZentr.iSchaltend.n_tkf UMR_U_MIN_32_1_0_S6_S3 6 0 8160 DEPOSIT ABSOLUTE MONOTONY MON_INCREASE /end AXIS_DESCR
 /begin AXIS_DESCR STD_AXIS zff_atsys._.iSignale._.obj.sig_m_t8 UMR_NM__8_1_M50_S6_S3 10 -400 1640 DEPOSIT ABSOLUTE MONOTONY MON_INCREASE /end AXIS_DESCR
/end CHARACTERISTIC
/begin CHARACTERISTIC KF_MEHAUPT_LRHSSP34 "Motoreingriffsoffset" MAP 0x22D1C4 kf_ui8_S6_S3 1530 UMR_NM__6_1_M145_S6_S3 -870 660
 /begin AXIS_DESCR STD_AXIS iSasZentr.iSchaltend.n_tkf UMR_U_MIN_32_1_0_S6_S3 3 0 8160 DEPOSIT ABSOLUTE MONOTONY MON_INCREASE /end AXIS_DESCR
 /begin AXIS_DESCR STD_AXIS zff_atsys._.iSignale._.obj.sig_m_t8 UMR_NM__8_1_M50_S6_S3 6 -400 1640 DEPOSIT ABSOLUTE MONOTONY MON_INCREASE /end AXIS_DESCR
/end CHARACTERISTIC
/begin CHARACTERISTIC KF_MEHYSKLASSSP34 "Hysterese zur ME Klassifizierung" MAP 0x22D1E8 kf_si16_S6_S3 1200 UMR_NM__1_1_0_S6_S3 -800 400
 /begin AXIS_DESCR STD_AXIS iItfInput.m_mot UMR_NM__1_1_0_S6_S3 4 -400 1640 DEPOSIT ABSOLUTE MONOTONY MON_INCREASE /end AXIS_DESCR
 /begin AXIS_DESCR STD_AXIS zff_atsys._.iSignale._.obj.sig_n_mot UMR_U_MIN_1_1_0_S6_S3 4 0 8160 DEPOSIT ABSOLUTE MONOTONY MON_INCREASE /end AXIS_DESCR
/end CHARACTERISTIC
/begin CHARACTERISTIC KF_FMENACHPOSESP34 "Faktor fuer Reduzierung pos ME bei RS" MAP 0x22D220 kf_si16_S6_S3 1 UMR___1_100_0_S6_S3 0 1
 /begin AXIS_DESCR STD_AXIS iMoeMesaf.timer_rampe_pos UMR_MSEC__10_1_0_S6_S3 4 0 2550 DEPOSIT ABSOLUTE MONOTONY MON_INCREASE /end AXIS_DESCR
 /begin AXIS_DESCR STD_AXIS iMoeMesaf.me_sas_gesp UMR_NM__1_1_0_S6_S3 4 0 2000 DEPOSIT ABSOLUTE MONOTONY MON_INCREASE /end AXIS_DESCR
/end CHARACTERISTIC
/begin CHARACTERISTIC KF_MEHAUPTSP45 "Hauptmotoreingriff Schaltablauf" MAP 0x22D258 kf_ui8_S6_S3 1530 UMR_NM__6_1_M145_S6_S3 -870 660
 /begin AXIS_DESCR STD_AXIS iSasZentr.iSchaltend.n_tkf UMR_U_MIN_32_1_0_S6_S3 6 0 8160 DEPOSIT ABSOLUTE MONOTONY MON_INCREASE /end AXIS_DESCR
 /begin AXIS_DESCR STD_AXIS zff_atsys._.iSignale._.obj.sig_m_t8 UMR_NM__8_1_M50_S6_S3 10 -400 1640 DEPOSIT ABSOLUTE MONOTONY MON_INCREASE /end AXIS_DESCR
/end CHARACTERISTIC
/begin CHARACTERISTIC KF_MEHAUPT_LRHSSP45 "Motoreingriffsoffset" MAP 0x22D2AC kf_ui8_S6_S3 1530 UMR_NM__6_1_M145_S6_S3 -870 660
 /begin AXIS_DESCR STD_AXIS iSasZentr.iSchaltend.n_tkf UMR_U_MIN_32_1_0_S6_S3 3 0 8160 DEPOSIT ABSOLUTE MONOTONY MON_INCREASE /end AXIS_DESCR
 /begin AXIS_DESCR STD_AXIS zff_atsys._.iSignale._.obj.sig_m_t8 UMR_NM__8_1_M50_S6_S3 6 -400 1640 DEPOSIT ABSOLUTE MONOTONY MON_INCREASE /end AXIS_DESCR
/end CHARACTERISTIC
/begin CHARACTERISTIC KF_MEHYSKLASSSP45 "Hysterese zur ME Klassifizierung" MAP 0x22D2D0 kf_si16_S6_S3 1200 UMR_NM__1_1_0_S6_S3 -800 400
 /begin AXIS_DESCR STD_AXIS iItfInput.m_mot UMR_NM__1_1_0_S6_S3 4 -400 1640 DEPOSIT ABSOLUTE MONOTONY MON_INCREASE /end AXIS_DESCR
 /begin AXIS_DESCR STD_AXIS zff_atsys._.iSignale._.obj.sig_n_mot UMR_U_MIN_1_1_0_S6_S3 4 0 8160 DEPOSIT ABSOLUTE MONOTONY MON_INCREASE /end AXIS_DESCR
/end CHARACTERISTIC
/begin CHARACTERISTIC KF_FMENACHPOSESP45 "Faktor fuer Reduzierung pos ME bei RS" MAP 0x22D308 kf_si16_S6_S3 1 UMR___1_100_0_S6_S3 0 1
 /begin AXIS_DESCR STD_AXIS iMoeMesaf.timer_rampe_pos UMR_MSEC__10_1_0_S6_S3 4 0 2550 DEPOSIT ABSOLUTE MONOTONY MON_INCREASE /end AXIS_DESCR
 /begin AXIS_DESCR STD_AXIS iMoeMesaf.me_sas_gesp UMR_NM__1_1_0_S6_S3 4 0 2000 DEPOSIT ABSOLUTE MONOTONY MON_INCREASE /end AXIS_DESCR
/end CHARACTERISTIC
/begin CHARACTERISTIC KF_MEHAUPTSP56 "Hauptmotoreingriff Schaltablauf" MAP 0x22D340 kf_ui8_S6_S3 1530 UMR_NM__6_1_M145_S6_S3 -870 660
 /begin AXIS_DESCR STD_AXIS iSasZentr.iSchaltend.n_tkf UMR_U_MIN_32_1_0_S6_S3 6 0 8160 DEPOSIT ABSOLUTE MONOTONY MON_INCREASE /end AXIS_DESCR
 /begin AXIS_DESCR STD_AXIS zff_atsys._.iSignale._.obj.sig_m_t8 UMR_NM__8_1_M50_S6_S3 10 -400 1640 DEPOSIT ABSOLUTE MONOTONY MON_INCREASE /end AXIS_DESCR
/end CHARACTERISTIC
/begin CHARACTERISTIC KF_MEHAUPT_LRHSSP56 "Motoreingriffsoffset" MAP 0x22D394 kf_ui8_S6_S3 1530 UMR_NM__6_1_M145_S6_S3 -870 660
 /begin AXIS_DESCR STD_AXIS iSasZentr.iSchaltend.n_tkf UMR_U_MIN_32_1_0_S6_S3 3 0 8160 DEPOSIT ABSOLUTE MONOTONY MON_INCREASE /end AXIS_DESCR
 /begin AXIS_DESCR STD_AXIS zff_atsys._.iSignale._.obj.sig_m_t8 UMR_NM__8_1_M50_S6_S3 6 -400 1640 DEPOSIT ABSOLUTE MONOTONY MON_INCREASE /end AXIS_DESCR
/end CHARACTERISTIC
/begin CHARACTERISTIC KF_MEHYSKLASSSP56 "Hysterese zur ME Klassifizierung" MAP 0x22D3B8 kf_si16_S6_S3 1200 UMR_NM__1_1_0_S6_S3 -800 400
 /begin AXIS_DESCR STD_AXIS iItfInput.m_mot UMR_NM__1_1_0_S6_S3 4 -400 1640 DEPOSIT ABSOLUTE MONOTONY MON_INCREASE /end AXIS_DESCR
 /begin AXIS_DESCR STD_AXIS zff_atsys._.iSignale._.obj.sig_n_mot UMR_U_MIN_1_1_0_S6_S3 4 0 8160 DEPOSIT ABSOLUTE MONOTONY MON_INCREASE /end AXIS_DESCR
/end CHARACTERISTIC
/begin CHARACTERISTIC KF_FMENACHPOSESP56 "Faktor fuer Reduzierung pos ME bei RS" MAP 0x22D3F0 kf_si16_S6_S3 1 UMR___1_100_0_S6_S3 0 1
 /begin AXIS_DESCR STD_AXIS iMoeMesaf.timer_rampe_pos UMR_MSEC__10_1_0_S6_S3 4 0 2550 DEPOSIT ABSOLUTE MONOTONY MON_INCREASE /end AXIS_DESCR
 /begin AXIS_DESCR STD_AXIS iMoeMesaf.me_sas_gesp UMR_NM__1_1_0_S6_S3 4 0 2000 DEPOSIT ABSOLUTE MONOTONY MON_INCREASE /end AXIS_DESCR
/end CHARACTERISTIC
/begin CHARACTERISTIC KF_MEHAUPTSP67 "Hauptmotoreingriff Schaltablauf" MAP 0x22D428 kf_ui8_S6_S3 1530 UMR_NM__6_1_M145_S6_S3 -870 660
 /begin AXIS_DESCR STD_AXIS iSasZentr.iSchaltend.n_tkf UMR_U_MIN_32_1_0_S6_S3 6 0 8160 DEPOSIT ABSOLUTE MONOTONY MON_INCREASE /end AXIS_DESCR
 /begin AXIS_DESCR STD_AXIS zff_atsys._.iSignale._.obj.sig_m_t8 UMR_NM__8_1_M50_S6_S3 10 -400 1640 DEPOSIT ABSOLUTE MONOTONY MON_INCREASE /end AXIS_DESCR
/end CHARACTERISTIC
/begin CHARACTERISTIC KF_MEHAUPT_LRHSSP67 "Motoreingriffsoffset" MAP 0x22D47C kf_ui8_S6_S3 1530 UMR_NM__6_1_M145_S6_S3 -870 660
 /begin AXIS_DESCR STD_AXIS iSasZentr.iSchaltend.n_tkf UMR_U_MIN_32_1_0_S6_S3 3 0 8160 DEPOSIT ABSOLUTE MONOTONY MON_INCREASE /end AXIS_DESCR
 /begin AXIS_DESCR STD_AXIS zff_atsys._.iSignale._.obj.sig_m_t8 UMR_NM__8_1_M50_S6_S3 6 -400 1640 DEPOSIT ABSOLUTE MONOTONY MON_INCREASE /end AXIS_DESCR
/end CHARACTERISTIC
/begin CHARACTERISTIC KF_MEHYSKLASSSP67 "Hysterese zur ME Klassifizierung" MAP 0x22D4A0 kf_si16_S6_S3 1200 UMR_NM__1_1_0_S6_S3 -800 400
 /begin AXIS_DESCR STD_AXIS iItfInput.m_mot UMR_NM__1_1_0_S6_S3 4 -400 1640 DEPOSIT ABSOLUTE MONOTONY MON_INCREASE /end AXIS_DESCR
 /begin AXIS_DESCR STD_AXIS zff_atsys._.iSignale._.obj.sig_n_mot UMR_U_MIN_1_1_0_S6_S3 4 0 8160 DEPOSIT ABSOLUTE MONOTONY MON_INCREASE /end AXIS_DESCR
/end CHARACTERISTIC
/begin CHARACTERISTIC KF_FMENACHPOSESP67 "Faktor fuer Reduzierung pos ME bei RS" MAP 0x22D4D8 kf_si16_S6_S3 1 UMR___1_100_0_S6_S3 0 1
 /begin AXIS_DESCR STD_AXIS iMoeMesaf.timer_rampe_pos UMR_MSEC__10_1_0_S6_S3 4 0 2550 DEPOSIT ABSOLUTE MONOTONY MON_INCREASE /end AXIS_DESCR
 /begin AXIS_DESCR STD_AXIS iMoeMesaf.me_sas_gesp UMR_NM__1_1_0_S6_S3 4 0 2000 DEPOSIT ABSOLUTE MONOTONY MON_INCREASE /end AXIS_DESCR
/end CHARACTERISTIC
/begin CHARACTERISTIC KF_MEHAUPTSP78 "Hauptmotoreingriff Schaltablauf" MAP 0x22D510 kf_ui8_S6_S3 1530 UMR_NM__6_1_M145_S6_S3 -870 660
 /begin AXIS_DESCR STD_AXIS iSasZentr.iSchaltend.n_tkf UMR_U_MIN_32_1_0_S6_S3 6 0 8160 DEPOSIT ABSOLUTE MONOTONY MON_INCREASE /end AXIS_DESCR
 /begin AXIS_DESCR STD_AXIS zff_atsys._.iSignale._.obj.sig_m_t8 UMR_NM__8_1_M50_S6_S3 10 -400 1640 DEPOSIT ABSOLUTE MONOTONY MON_INCREASE /end AXIS_DESCR
/end CHARACTERISTIC
/begin CHARACTERISTIC KF_MEHAUPT_LRHSSP78 "Motoreingriffsoffset" MAP 0x22D564 kf_ui8_S6_S3 1530 UMR_NM__6_1_M145_S6_S3 -870 660
 /begin AXIS_DESCR STD_AXIS iSasZentr.iSchaltend.n_tkf UMR_U_MIN_32_1_0_S6_S3 3 0 8160 DEPOSIT ABSOLUTE MONOTONY MON_INCREASE /end AXIS_DESCR
 /begin AXIS_DESCR STD_AXIS zff_atsys._.iSignale._.obj.sig_m_t8 UMR_NM__8_1_M50_S6_S3 6 -400 1640 DEPOSIT ABSOLUTE MONOTONY MON_INCREASE /end AXIS_DESCR
/end CHARACTERISTIC
/begin CHARACTERISTIC KF_MEHYSKLASSSP78 "Hysterese zur ME Klassifizierung" MAP 0x22D588 kf_si16_S6_S3 1200 UMR_NM__1_1_0_S6_S3 -800 400
 /begin AXIS_DESCR STD_AXIS iItfInput.m_mot UMR_NM__1_1_0_S6_S3 4 -400 1640 DEPOSIT ABSOLUTE MONOTONY MON_INCREASE /end AXIS_DESCR
 /begin AXIS_DESCR STD_AXIS zff_atsys._.iSignale._.obj.sig_n_mot UMR_U_MIN_1_1_0_S6_S3 4 0 8160 DEPOSIT ABSOLUTE MONOTONY MON_INCREASE /end AXIS_DESCR
/end CHARACTERISTIC
/begin CHARACTERISTIC KF_FMENACHPOSESP78 "Faktor fuer Reduzierung pos ME bei RS" MAP 0x22D5C0 kf_si16_S6_S3 1 UMR___1_100_0_S6_S3 0 1
 /begin AXIS_DESCR STD_AXIS iMoeMesaf.timer_rampe_pos UMR_MSEC__10_1_0_S6_S3 4 0 2550 DEPOSIT ABSOLUTE MONOTONY MON_INCREASE /end AXIS_DESCR
 /begin AXIS_DESCR STD_AXIS iMoeMesaf.me_sas_gesp UMR_NM__1_1_0_S6_S3 4 0 2000 DEPOSIT ABSOLUTE MONOTONY MON_INCREASE /end AXIS_DESCR
/end CHARACTERISTIC
/begin CHARACTERISTIC KF_MEHAUPTSP13 "Hauptmotoreingriff Schaltablauf" MAP 0x22D5F8 kf_ui8_S6_S3 1530 UMR_NM__6_1_M145_S6_S3 -870 660
 /begin AXIS_DESCR STD_AXIS iSasZentr.iSchaltend.n_tkf UMR_U_MIN_32_1_0_S6_S3 6 0 8160 DEPOSIT ABSOLUTE MONOTONY MON_INCREASE /end AXIS_DESCR
 /begin AXIS_DESCR STD_AXIS zff_atsys._.iSignale._.obj.sig_m_t8 UMR_NM__8_1_M50_S6_S3 10 -400 1640 DEPOSIT ABSOLUTE MONOTONY MON_INCREASE /end AXIS_DESCR
/end CHARACTERISTIC
/begin CHARACTERISTIC KF_MEHAUPT_LRHSSP13 "Motoreingriffsoffset" MAP 0x22D64C kf_ui8_S6_S3 1530 UMR_NM__6_1_M145_S6_S3 -870 660
 /begin AXIS_DESCR STD_AXIS iSasZentr.iSchaltend.n_tkf UMR_U_MIN_32_1_0_S6_S3 3 0 8160 DEPOSIT ABSOLUTE MONOTONY MON_INCREASE /end AXIS_DESCR
 /begin AXIS_DESCR STD_AXIS zff_atsys._.iSignale._.obj.sig_m_t8 UMR_NM__8_1_M50_S6_S3 6 -400 1640 DEPOSIT ABSOLUTE MONOTONY MON_INCREASE /end AXIS_DESCR
/end CHARACTERISTIC
/begin CHARACTERISTIC KF_FMENACHPOSESP13 "Faktor fuer Reduzierung pos ME bei RS" MAP 0x22D670 kf_si16_S6_S3 1 UMR___1_100_0_S6_S3 0 1
 /begin AXIS_DESCR STD_AXIS iMoeMesaf.timer_rampe_pos UMR_MSEC__10_1_0_S6_S3 4 0 2550 DEPOSIT ABSOLUTE MONOTONY MON_INCREASE /end AXIS_DESCR
 /begin AXIS_DESCR STD_AXIS iMoeMesaf.me_sas_gesp UMR_NM__1_1_0_S6_S3 4 0 2000 DEPOSIT ABSOLUTE MONOTONY MON_INCREASE /end AXIS_DESCR
/end CHARACTERISTIC
/begin CHARACTERISTIC KF_MEHAUPTSP24 "Hauptmotoreingriff Schaltablauf" MAP 0x22D6A8 kf_ui8_S6_S3 1530 UMR_NM__6_1_M145_S6_S3 -870 660
 /begin AXIS_DESCR STD_AXIS iSasZentr.iSchaltend.n_tkf UMR_U_MIN_32_1_0_S6_S3 6 0 8160 DEPOSIT ABSOLUTE MONOTONY MON_INCREASE /end AXIS_DESCR
 /begin AXIS_DESCR STD_AXIS zff_atsys._.iSignale._.obj.sig_m_t8 UMR_NM__8_1_M50_S6_S3 10 -400 1640 DEPOSIT ABSOLUTE MONOTONY MON_INCREASE /end AXIS_DESCR
/end CHARACTERISTIC
/begin CHARACTERISTIC KF_MEHAUPT_LRHSSP24 "Motoreingriffsoffset" MAP 0x22D6FC kf_ui8_S6_S3 1530 UMR_NM__6_1_M145_S6_S3 -870 660
 /begin AXIS_DESCR STD_AXIS iSasZentr.iSchaltend.n_tkf UMR_U_MIN_32_1_0_S6_S3 3 0 8160 DEPOSIT ABSOLUTE MONOTONY MON_INCREASE /end AXIS_DESCR
 /begin AXIS_DESCR STD_AXIS zff_atsys._.iSignale._.obj.sig_m_t8 UMR_NM__8_1_M50_S6_S3 6 -400 1640 DEPOSIT ABSOLUTE MONOTONY MON_INCREASE /end AXIS_DESCR
/end CHARACTERISTIC
/begin CHARACTERISTIC KF_FMENACHPOSESP24 "Faktor fuer Reduzierung pos ME bei RS" MAP 0x22D720 kf_si16_S6_S3 1 UMR___1_100_0_S6_S3 0 1
 /begin AXIS_DESCR STD_AXIS iMoeMesaf.timer_rampe_pos UMR_MSEC__10_1_0_S6_S3 4 0 2550 DEPOSIT ABSOLUTE MONOTONY MON_INCREASE /end AXIS_DESCR
 /begin AXIS_DESCR STD_AXIS iMoeMesaf.me_sas_gesp UMR_NM__1_1_0_S6_S3 4 0 2000 DEPOSIT ABSOLUTE MONOTONY MON_INCREASE /end AXIS_DESCR
/end CHARACTERISTIC
/begin CHARACTERISTIC KF_MEHAUPTSP35 "Hauptmotoreingriff Schaltablauf" MAP 0x22D758 kf_ui8_S6_S3 1530 UMR_NM__6_1_M145_S6_S3 -870 660
 /begin AXIS_DESCR STD_AXIS iSasZentr.iSchaltend.n_tkf UMR_U_MIN_32_1_0_S6_S3 6 0 8160 DEPOSIT ABSOLUTE MONOTONY MON_INCREASE /end AXIS_DESCR
 /begin AXIS_DESCR STD_AXIS zff_atsys._.iSignale._.obj.sig_m_t8 UMR_NM__8_1_M50_S6_S3 10 -400 1640 DEPOSIT ABSOLUTE MONOTONY MON_INCREASE /end AXIS_DESCR
/end CHARACTERISTIC
/begin CHARACTERISTIC KF_MEHAUPT_LRHSSP35 "Motoreingriffsoffset" MAP 0x22D7AC kf_ui8_S6_S3 1530 UMR_NM__6_1_M145_S6_S3 -870 660
 /begin AXIS_DESCR STD_AXIS iSasZentr.iSchaltend.n_tkf UMR_U_MIN_32_1_0_S6_S3 3 0 8160 DEPOSIT ABSOLUTE MONOTONY MON_INCREASE /end AXIS_DESCR
 /begin AXIS_DESCR STD_AXIS zff_atsys._.iSignale._.obj.sig_m_t8 UMR_NM__8_1_M50_S6_S3 6 -400 1640 DEPOSIT ABSOLUTE MONOTONY MON_INCREASE /end AXIS_DESCR
/end CHARACTERISTIC
/begin CHARACTERISTIC KF_FMENACHPOSESP35 "Faktor fuer Reduzierung pos ME bei RS" MAP 0x22D7D0 kf_si16_S6_S3 1 UMR___1_100_0_S6_S3 0 1
 /begin AXIS_DESCR STD_AXIS iMoeMesaf.timer_rampe_pos UMR_MSEC__10_1_0_S6_S3 4 0 2550 DEPOSIT ABSOLUTE MONOTONY MON_INCREASE /end AXIS_DESCR
 /begin AXIS_DESCR STD_AXIS iMoeMesaf.me_sas_gesp UMR_NM__1_1_0_S6_S3 4 0 2000 DEPOSIT ABSOLUTE MONOTONY MON_INCREASE /end AXIS_DESCR
/end CHARACTERISTIC
/begin CHARACTERISTIC KF_MEHAUPTSP46 "Hauptmotoreingriff Schaltablauf" MAP 0x22D808 kf_ui8_S6_S3 1530 UMR_NM__6_1_M145_S6_S3 -870 660
 /begin AXIS_DESCR STD_AXIS iSasZentr.iSchaltend.n_tkf UMR_U_MIN_32_1_0_S6_S3 6 0 8160 DEPOSIT ABSOLUTE MONOTONY MON_INCREASE /end AXIS_DESCR
 /begin AXIS_DESCR STD_AXIS zff_atsys._.iSignale._.obj.sig_m_t8 UMR_NM__8_1_M50_S6_S3 10 -400 1640 DEPOSIT ABSOLUTE MONOTONY MON_INCREASE /end AXIS_DESCR
/end CHARACTERISTIC
/begin CHARACTERISTIC KF_MEHAUPT_LRHSSP46 "Motoreingriffsoffset" MAP 0x22D85C kf_ui8_S6_S3 1530 UMR_NM__6_1_M145_S6_S3 -870 660
 /begin AXIS_DESCR STD_AXIS iSasZentr.iSchaltend.n_tkf UMR_U_MIN_32_1_0_S6_S3 3 0 8160 DEPOSIT ABSOLUTE MONOTONY MON_INCREASE /end AXIS_DESCR
 /begin AXIS_DESCR STD_AXIS zff_atsys._.iSignale._.obj.sig_m_t8 UMR_NM__8_1_M50_S6_S3 6 -400 1640 DEPOSIT ABSOLUTE MONOTONY MON_INCREASE /end AXIS_DESCR
/end CHARACTERISTIC
/begin CHARACTERISTIC KF_FMENACHPOSESP46 "Faktor fuer Reduzierung pos ME bei RS" MAP 0x22D880 kf_si16_S6_S3 1 UMR___1_100_0_S6_S3 0 1
 /begin AXIS_DESCR STD_AXIS iMoeMesaf.timer_rampe_pos UMR_MSEC__10_1_0_S6_S3 4 0 2550 DEPOSIT ABSOLUTE MONOTONY MON_INCREASE /end AXIS_DESCR
 /begin AXIS_DESCR STD_AXIS iMoeMesaf.me_sas_gesp UMR_NM__1_1_0_S6_S3 4 0 2000 DEPOSIT ABSOLUTE MONOTONY MON_INCREASE /end AXIS_DESCR
/end CHARACTERISTIC
/begin CHARACTERISTIC KF_MEHAUPTSP57 "Hauptmotoreingriff Schaltablauf" MAP 0x22D8B8 kf_ui8_S6_S3 1530 UMR_NM__6_1_M145_S6_S3 -870 660
 /begin AXIS_DESCR STD_AXIS iSasZentr.iSchaltend.n_tkf UMR_U_MIN_32_1_0_S6_S3 6 0 8160 DEPOSIT ABSOLUTE MONOTONY MON_INCREASE /end AXIS_DESCR
 /begin AXIS_DESCR STD_AXIS zff_atsys._.iSignale._.obj.sig_m_t8 UMR_NM__8_1_M50_S6_S3 10 -400 1640 DEPOSIT ABSOLUTE MONOTONY MON_INCREASE /end AXIS_DESCR
/end CHARACTERISTIC
/begin CHARACTERISTIC KF_MEHAUPT_LRHSSP57 "Motoreingriffsoffset" MAP 0x22D90C kf_ui8_S6_S3 1530 UMR_NM__6_1_M145_S6_S3 -870 660
 /begin AXIS_DESCR STD_AXIS iSasZentr.iSchaltend.n_tkf UMR_U_MIN_32_1_0_S6_S3 3 0 8160 DEPOSIT ABSOLUTE MONOTONY MON_INCREASE /end AXIS_DESCR
 /begin AXIS_DESCR STD_AXIS zff_atsys._.iSignale._.obj.sig_m_t8 UMR_NM__8_1_M50_S6_S3 6 -400 1640 DEPOSIT ABSOLUTE MONOTONY MON_INCREASE /end AXIS_DESCR
/end CHARACTERISTIC
/begin CHARACTERISTIC KF_FMENACHPOSESP57 "Faktor fuer Reduzierung pos ME bei RS" MAP 0x22D930 kf_si16_S6_S3 1 UMR___1_100_0_S6_S3 0 1
 /begin AXIS_DESCR STD_AXIS iMoeMesaf.timer_rampe_pos UMR_MSEC__10_1_0_S6_S3 4 0 2550 DEPOSIT ABSOLUTE MONOTONY MON_INCREASE /end AXIS_DESCR
 /begin AXIS_DESCR STD_AXIS iMoeMesaf.me_sas_gesp UMR_NM__1_1_0_S6_S3 4 0 2000 DEPOSIT ABSOLUTE MONOTONY MON_INCREASE /end AXIS_DESCR
/end CHARACTERISTIC
/begin CHARACTERISTIC KF_MEHAUPTSP68 "Hauptmotoreingriff Schaltablauf" MAP 0x22D968 kf_ui8_S6_S3 1530 UMR_NM__6_1_M145_S6_S3 -870 660
 /begin AXIS_DESCR STD_AXIS iSasZentr.iSchaltend.n_tkf UMR_U_MIN_32_1_0_S6_S3 6 0 8160 DEPOSIT ABSOLUTE MONOTONY MON_INCREASE /end AXIS_DESCR
 /begin AXIS_DESCR STD_AXIS zff_atsys._.iSignale._.obj.sig_m_t8 UMR_NM__8_1_M50_S6_S3 10 -400 1640 DEPOSIT ABSOLUTE MONOTONY MON_INCREASE /end AXIS_DESCR
/end CHARACTERISTIC
/begin CHARACTERISTIC KF_MEHAUPT_LRHSSP68 "Motoreingriffsoffset" MAP 0x22D9BC kf_ui8_S6_S3 1530 UMR_NM__6_1_M145_S6_S3 -870 660
 /begin AXIS_DESCR STD_AXIS iSasZentr.iSchaltend.n_tkf UMR_U_MIN_32_1_0_S6_S3 3 0 8160 DEPOSIT ABSOLUTE MONOTONY MON_INCREASE /end AXIS_DESCR
 /begin AXIS_DESCR STD_AXIS zff_atsys._.iSignale._.obj.sig_m_t8 UMR_NM__8_1_M50_S6_S3 6 -400 1640 DEPOSIT ABSOLUTE MONOTONY MON_INCREASE /end AXIS_DESCR
/end CHARACTERISTIC
/begin CHARACTERISTIC KF_FMENACHPOSESP68 "Faktor fuer Reduzierung pos ME bei RS" MAP 0x22D9E0 kf_si16_S6_S3 1 UMR___1_100_0_S6_S3 0 1
 /begin AXIS_DESCR STD_AXIS iMoeMesaf.timer_rampe_pos UMR_MSEC__10_1_0_S6_S3 4 0 2550 DEPOSIT ABSOLUTE MONOTONY MON_INCREASE /end AXIS_DESCR
 /begin AXIS_DESCR STD_AXIS iMoeMesaf.me_sas_gesp UMR_NM__1_1_0_S6_S3 4 0 2000 DEPOSIT ABSOLUTE MONOTONY MON_INCREASE /end AXIS_DESCR
/end CHARACTERISTIC
/begin CHARACTERISTIC KF_MEHAUPTSPORT12 "Hauptmotoreingriff Schaltablauf" MAP 0x22DA18 kf_ui8_S6_S3 1530 UMR_NM__6_1_M145_S6_S3 -870 660
 /begin AXIS_DESCR STD_AXIS iSasZentr.iSchaltend.n_tkf UMR_U_MIN_32_1_0_S6_S3 6 0 8160 DEPOSIT ABSOLUTE MONOTONY MON_INCREASE /end AXIS_DESCR
 /begin AXIS_DESCR STD_AXIS zff_atsys._.iSignale._.obj.sig_m_t8 UMR_NM__8_1_M50_S6_S3 10 -400 1640 DEPOSIT ABSOLUTE MONOTONY MON_INCREASE /end AXIS_DESCR
/end CHARACTERISTIC
/begin CHARACTERISTIC KF_MEHAUPT_LRHSSPORT12 "Motoreingriffsoffset" MAP 0x22DA6C kf_ui8_S6_S3 1530 UMR_NM__6_1_M145_S6_S3 -870 660
 /begin AXIS_DESCR STD_AXIS iSasZentr.iSchaltend.n_tkf UMR_U_MIN_32_1_0_S6_S3 3 0 8160 DEPOSIT ABSOLUTE MONOTONY MON_INCREASE /end AXIS_DESCR
 /begin AXIS_DESCR STD_AXIS zff_atsys._.iSignale._.obj.sig_m_t8 UMR_NM__8_1_M50_S6_S3 6 -400 1640 DEPOSIT ABSOLUTE MONOTONY MON_INCREASE /end AXIS_DESCR
/end CHARACTERISTIC
/begin CHARACTERISTIC KF_MEHYSKLASSSPORT12 "Hysterese zur ME Klassifizierung" MAP 0x22DA90 kf_si16_S6_S3 1200 UMR_NM__1_1_0_S6_S3 -800 400
 /begin AXIS_DESCR STD_AXIS iItfInput.m_mot UMR_NM__1_1_0_S6_S3 4 -400 1640 DEPOSIT ABSOLUTE MONOTONY MON_INCREASE /end AXIS_DESCR
 /begin AXIS_DESCR STD_AXIS zff_atsys._.iSignale._.obj.sig_n_mot UMR_U_MIN_1_1_0_S6_S3 4 0 8160 DEPOSIT ABSOLUTE MONOTONY MON_INCREASE /end AXIS_DESCR
/end CHARACTERISTIC
/begin CHARACTERISTIC KF_FMENACHPOSESPORT12 "Faktor fuer Reduzierung pos ME bei RS" MAP 0x22DAC8 kf_si16_S6_S3 1 UMR___1_100_0_S6_S3 0 1
 /begin AXIS_DESCR STD_AXIS iMoeMesaf.timer_rampe_pos UMR_MSEC__10_1_0_S6_S3 4 0 2550 DEPOSIT ABSOLUTE MONOTONY MON_INCREASE /end AXIS_DESCR
 /begin AXIS_DESCR STD_AXIS iMoeMesaf.me_sas_gesp UMR_NM__1_1_0_S6_S3 4 0 2000 DEPOSIT ABSOLUTE MONOTONY MON_INCREASE /end AXIS_DESCR
/end CHARACTERISTIC
/begin CHARACTERISTIC KF_MEHAUPTSPORT23 "Hauptmotoreingriff Schaltablauf" MAP 0x22DB00 kf_ui8_S6_S3 1530 UMR_NM__6_1_M145_S6_S3 -870 660
 /begin AXIS_DESCR STD_AXIS iSasZentr.iSchaltend.n_tkf UMR_U_MIN_32_1_0_S6_S3 6 0 8160 DEPOSIT ABSOLUTE MONOTONY MON_INCREASE /end AXIS_DESCR
 /begin AXIS_DESCR STD_AXIS zff_atsys._.iSignale._.obj.sig_m_t8 UMR_NM__8_1_M50_S6_S3 10 -400 1640 DEPOSIT ABSOLUTE MONOTONY MON_INCREASE /end AXIS_DESCR
/end CHARACTERISTIC
/begin CHARACTERISTIC KF_MEHAUPT_LRHSSPORT23 "Motoreingriffsoffset" MAP 0x22DB54 kf_ui8_S6_S3 1530 UMR_NM__6_1_M145_S6_S3 -870 660
 /begin AXIS_DESCR STD_AXIS iSasZentr.iSchaltend.n_tkf UMR_U_MIN_32_1_0_S6_S3 3 0 8160 DEPOSIT ABSOLUTE MONOTONY MON_INCREASE /end AXIS_DESCR
 /begin AXIS_DESCR STD_AXIS zff_atsys._.iSignale._.obj.sig_m_t8 UMR_NM__8_1_M50_S6_S3 6 -400 1640 DEPOSIT ABSOLUTE MONOTONY MON_INCREASE /end AXIS_DESCR
/end CHARACTERISTIC
/begin CHARACTERISTIC KF_MEHYSKLASSSPORT23 "Hysterese zur ME Klassifizierung" MAP 0x22DB78 kf_si16_S6_S3 1200 UMR_NM__1_1_0_S6_S3 -800 400
 /begin AXIS_DESCR STD_AXIS iItfInput.m_mot UMR_NM__1_1_0_S6_S3 4 -400 1640 DEPOSIT ABSOLUTE MONOTONY MON_INCREASE /end AXIS_DESCR
 /begin AXIS_DESCR STD_AXIS zff_atsys._.iSignale._.obj.sig_n_mot UMR_U_MIN_1_1_0_S6_S3 4 0 8160 DEPOSIT ABSOLUTE MONOTONY MON_INCREASE /end AXIS_DESCR
/end CHARACTERISTIC
/begin CHARACTERISTIC KF_FMENACHPOSESPORT23 "Faktor fuer Reduzierung pos ME bei RS" MAP 0x22DBB0 kf_si16_S6_S3 1 UMR___1_100_0_S6_S3 0 1
 /begin AXIS_DESCR STD_AXIS iMoeMesaf.timer_rampe_pos UMR_MSEC__10_1_0_S6_S3 4 0 2550 DEPOSIT ABSOLUTE MONOTONY MON_INCREASE /end AXIS_DESCR
 /begin AXIS_DESCR STD_AXIS iMoeMesaf.me_sas_gesp UMR_NM__1_1_0_S6_S3 4 0 2000 DEPOSIT ABSOLUTE MONOTONY MON_INCREASE /end AXIS_DESCR
/end CHARACTERISTIC
/begin CHARACTERISTIC KF_MEHAUPTSPORT34 "Hauptmotoreingriff Schaltablauf" MAP 0x22DBE8 kf_ui8_S6_S3 1530 UMR_NM__6_1_M145_S6_S3 -870 660
 /begin AXIS_DESCR STD_AXIS iSasZentr.iSchaltend.n_tkf UMR_U_MIN_32_1_0_S6_S3 6 0 8160 DEPOSIT ABSOLUTE MONOTONY MON_INCREASE /end AXIS_DESCR
 /begin AXIS_DESCR STD_AXIS zff_atsys._.iSignale._.obj.sig_m_t8 UMR_NM__8_1_M50_S6_S3 10 -400 1640 DEPOSIT ABSOLUTE MONOTONY MON_INCREASE /end AXIS_DESCR
/end CHARACTERISTIC
/begin CHARACTERISTIC KF_MEHAUPT_LRHSSPORT34 "Motoreingriffsoffset" MAP 0x22DC3C kf_ui8_S6_S3 1530 UMR_NM__6_1_M145_S6_S3 -870 660
 /begin AXIS_DESCR STD_AXIS iSasZentr.iSchaltend.n_tkf UMR_U_MIN_32_1_0_S6_S3 3 0 8160 DEPOSIT ABSOLUTE MONOTONY MON_INCREASE /end AXIS_DESCR
 /begin AXIS_DESCR STD_AXIS zff_atsys._.iSignale._.obj.sig_m_t8 UMR_NM__8_1_M50_S6_S3 6 -400 1640 DEPOSIT ABSOLUTE MONOTONY MON_INCREASE /end AXIS_DESCR
/end CHARACTERISTIC
/begin CHARACTERISTIC KF_MEHYSKLASSSPORT34 "Hysterese zur ME Klassifizierung" MAP 0x22DC60 kf_si16_S6_S3 1200 UMR_NM__1_1_0_S6_S3 -800 400
 /begin AXIS_DESCR STD_AXIS iItfInput.m_mot UMR_NM__1_1_0_S6_S3 4 -400 1640 DEPOSIT ABSOLUTE MONOTONY MON_INCREASE /end AXIS_DESCR
 /begin AXIS_DESCR STD_AXIS zff_atsys._.iSignale._.obj.sig_n_mot UMR_U_MIN_1_1_0_S6_S3 4 0 8160 DEPOSIT ABSOLUTE MONOTONY MON_INCREASE /end AXIS_DESCR
/end CHARACTERISTIC
/begin CHARACTERISTIC KF_FMENACHPOSESPORT34 "Faktor fuer Reduzierung pos ME bei RS" MAP 0x22DC98 kf_si16_S6_S3 1 UMR___1_100_0_S6_S3 0 1
 /begin AXIS_DESCR STD_AXIS iMoeMesaf.timer_rampe_pos UMR_MSEC__10_1_0_S6_S3 4 0 2550 DEPOSIT ABSOLUTE MONOTONY MON_INCREASE /end AXIS_DESCR
 /begin AXIS_DESCR STD_AXIS iMoeMesaf.me_sas_gesp UMR_NM__1_1_0_S6_S3 4 0 2000 DEPOSIT ABSOLUTE MONOTONY MON_INCREASE /end AXIS_DESCR
/end CHARACTERISTIC
/begin CHARACTERISTIC KF_MEHAUPTSPORT45 "Hauptmotoreingriff Schaltablauf" MAP 0x22DCD0 kf_ui8_S6_S3 1530 UMR_NM__6_1_M145_S6_S3 -870 660
 /begin AXIS_DESCR STD_AXIS iSasZentr.iSchaltend.n_tkf UMR_U_MIN_32_1_0_S6_S3 6 0 8160 DEPOSIT ABSOLUTE MONOTONY MON_INCREASE /end AXIS_DESCR
 /begin AXIS_DESCR STD_AXIS zff_atsys._.iSignale._.obj.sig_m_t8 UMR_NM__8_1_M50_S6_S3 10 -400 1640 DEPOSIT ABSOLUTE MONOTONY MON_INCREASE /end AXIS_DESCR
/end CHARACTERISTIC
/begin CHARACTERISTIC KF_MEHAUPT_LRHSSPORT45 "Motoreingriffsoffset" MAP 0x22DD24 kf_ui8_S6_S3 1530 UMR_NM__6_1_M145_S6_S3 -870 660
 /begin AXIS_DESCR STD_AXIS iSasZentr.iSchaltend.n_tkf UMR_U_MIN_32_1_0_S6_S3 3 0 8160 DEPOSIT ABSOLUTE MONOTONY MON_INCREASE /end AXIS_DESCR
 /begin AXIS_DESCR STD_AXIS zff_atsys._.iSignale._.obj.sig_m_t8 UMR_NM__8_1_M50_S6_S3 6 -400 1640 DEPOSIT ABSOLUTE MONOTONY MON_INCREASE /end AXIS_DESCR
/end CHARACTERISTIC
/begin CHARACTERISTIC KF_MEHYSKLASSSPORT45 "Hysterese zur ME Klassifizierung" MAP 0x22DD48 kf_si16_S6_S3 1200 UMR_NM__1_1_0_S6_S3 -800 400
 /begin AXIS_DESCR STD_AXIS iItfInput.m_mot UMR_NM__1_1_0_S6_S3 4 -400 1640 DEPOSIT ABSOLUTE MONOTONY MON_INCREASE /end AXIS_DESCR
 /begin AXIS_DESCR STD_AXIS zff_atsys._.iSignale._.obj.sig_n_mot UMR_U_MIN_1_1_0_S6_S3 4 0 8160 DEPOSIT ABSOLUTE MONOTONY MON_INCREASE /end AXIS_DESCR
/end CHARACTERISTIC
/begin CHARACTERISTIC KF_FMENACHPOSESPORT45 "Faktor fuer Reduzierung pos ME bei RS" MAP 0x22DD80 kf_si16_S6_S3 1 UMR___1_100_0_S6_S3 0 1
 /begin AXIS_DESCR STD_AXIS iMoeMesaf.timer_rampe_pos UMR_MSEC__10_1_0_S6_S3 4 0 2550 DEPOSIT ABSOLUTE MONOTONY MON_INCREASE /end AXIS_DESCR
 /begin AXIS_DESCR STD_AXIS iMoeMesaf.me_sas_gesp UMR_NM__1_1_0_S6_S3 4 0 2000 DEPOSIT ABSOLUTE MONOTONY MON_INCREASE /end AXIS_DESCR
/end CHARACTERISTIC
/begin CHARACTERISTIC KF_MEHAUPTSPORT56 "Hauptmotoreingriff Schaltablauf" MAP 0x22DDB8 kf_ui8_S6_S3 1530 UMR_NM__6_1_M145_S6_S3 -870 660
 /begin AXIS_DESCR STD_AXIS iSasZentr.iSchaltend.n_tkf UMR_U_MIN_32_1_0_S6_S3 6 0 8160 DEPOSIT ABSOLUTE MONOTONY MON_INCREASE /end AXIS_DESCR
 /begin AXIS_DESCR STD_AXIS zff_atsys._.iSignale._.obj.sig_m_t8 UMR_NM__8_1_M50_S6_S3 10 -400 1640 DEPOSIT ABSOLUTE MONOTONY MON_INCREASE /end AXIS_DESCR
/end CHARACTERISTIC
/begin CHARACTERISTIC KF_MEHAUPT_LRHSSPORT56 "Motoreingriffsoffset" MAP 0x22DE0C kf_ui8_S6_S3 1530 UMR_NM__6_1_M145_S6_S3 -870 660
 /begin AXIS_DESCR STD_AXIS iSasZentr.iSchaltend.n_tkf UMR_U_MIN_32_1_0_S6_S3 3 0 8160 DEPOSIT ABSOLUTE MONOTONY MON_INCREASE /end AXIS_DESCR
 /begin AXIS_DESCR STD_AXIS zff_atsys._.iSignale._.obj.sig_m_t8 UMR_NM__8_1_M50_S6_S3 6 -400 1640 DEPOSIT ABSOLUTE MONOTONY MON_INCREASE /end AXIS_DESCR
/end CHARACTERISTIC
/begin CHARACTERISTIC KF_MEHYSKLASSSPORT56 "Hysterese zur ME Klassifizierung" MAP 0x22DE30 kf_si16_S6_S3 1200 UMR_NM__1_1_0_S6_S3 -800 400
 /begin AXIS_DESCR STD_AXIS iItfInput.m_mot UMR_NM__1_1_0_S6_S3 4 -400 1640 DEPOSIT ABSOLUTE MONOTONY MON_INCREASE /end AXIS_DESCR
 /begin AXIS_DESCR STD_AXIS zff_atsys._.iSignale._.obj.sig_n_mot UMR_U_MIN_1_1_0_S6_S3 4 0 8160 DEPOSIT ABSOLUTE MONOTONY MON_INCREASE /end AXIS_DESCR
/end CHARACTERISTIC
/begin CHARACTERISTIC KF_FMENACHPOSESPORT56 "Faktor fuer Reduzierung pos ME bei RS" MAP 0x22DE68 kf_si16_S6_S3 1 UMR___1_100_0_S6_S3 0 1
 /begin AXIS_DESCR STD_AXIS iMoeMesaf.timer_rampe_pos UMR_MSEC__10_1_0_S6_S3 4 0 2550 DEPOSIT ABSOLUTE MONOTONY MON_INCREASE /end AXIS_DESCR
 /begin AXIS_DESCR STD_AXIS iMoeMesaf.me_sas_gesp UMR_NM__1_1_0_S6_S3 4 0 2000 DEPOSIT ABSOLUTE MONOTONY MON_INCREASE /end AXIS_DESCR
/end CHARACTERISTIC
/begin CHARACTERISTIC KF_MEHAUPTSPORT67 "Hauptmotoreingriff Schaltablauf" MAP 0x22DEA0 kf_ui8_S6_S3 1530 UMR_NM__6_1_M145_S6_S3 -870 660
 /begin AXIS_DESCR STD_AXIS iSasZentr.iSchaltend.n_tkf UMR_U_MIN_32_1_0_S6_S3 6 0 8160 DEPOSIT ABSOLUTE MONOTONY MON_INCREASE /end AXIS_DESCR
 /begin AXIS_DESCR STD_AXIS zff_atsys._.iSignale._.obj.sig_m_t8 UMR_NM__8_1_M50_S6_S3 10 -400 1640 DEPOSIT ABSOLUTE MONOTONY MON_INCREASE /end AXIS_DESCR
/end CHARACTERISTIC
/begin CHARACTERISTIC KF_MEHAUPT_LRHSSPORT67 "Motoreingriffsoffset" MAP 0x22DEF4 kf_ui8_S6_S3 1530 UMR_NM__6_1_M145_S6_S3 -870 660
 /begin AXIS_DESCR STD_AXIS iSasZentr.iSchaltend.n_tkf UMR_U_MIN_32_1_0_S6_S3 3 0 8160 DEPOSIT ABSOLUTE MONOTONY MON_INCREASE /end AXIS_DESCR
 /begin AXIS_DESCR STD_AXIS zff_atsys._.iSignale._.obj.sig_m_t8 UMR_NM__8_1_M50_S6_S3 6 -400 1640 DEPOSIT ABSOLUTE MONOTONY MON_INCREASE /end AXIS_DESCR
/end CHARACTERISTIC
/begin CHARACTERISTIC KF_MEHYSKLASSSPORT67 "Hysterese zur ME Klassifizierung" MAP 0x22DF18 kf_si16_S6_S3 1200 UMR_NM__1_1_0_S6_S3 -800 400
 /begin AXIS_DESCR STD_AXIS iItfInput.m_mot UMR_NM__1_1_0_S6_S3 4 -400 1640 DEPOSIT ABSOLUTE MONOTONY MON_INCREASE /end AXIS_DESCR
 /begin AXIS_DESCR STD_AXIS zff_atsys._.iSignale._.obj.sig_n_mot UMR_U_MIN_1_1_0_S6_S3 4 0 8160 DEPOSIT ABSOLUTE MONOTONY MON_INCREASE /end AXIS_DESCR
/end CHARACTERISTIC
/begin CHARACTERISTIC KF_FMENACHPOSESPORT67 "Faktor fuer Reduzierung pos ME bei RS" MAP 0x22DF50 kf_si16_S6_S3 1 UMR___1_100_0_S6_S3 0 1
 /begin AXIS_DESCR STD_AXIS iMoeMesaf.timer_rampe_pos UMR_MSEC__10_1_0_S6_S3 4 0 2550 DEPOSIT ABSOLUTE MONOTONY MON_INCREASE /end AXIS_DESCR
 /begin AXIS_DESCR STD_AXIS iMoeMesaf.me_sas_gesp UMR_NM__1_1_0_S6_S3 4 0 2000 DEPOSIT ABSOLUTE MONOTONY MON_INCREASE /end AXIS_DESCR
/end CHARACTERISTIC
/begin CHARACTERISTIC KF_MEHAUPTSPORT78 "Hauptmotoreingriff Schaltablauf" MAP 0x22DF88 kf_ui8_S6_S3 1530 UMR_NM__6_1_M145_S6_S3 -870 660
 /begin AXIS_DESCR STD_AXIS iSasZentr.iSchaltend.n_tkf UMR_U_MIN_32_1_0_S6_S3 6 0 8160 DEPOSIT ABSOLUTE MONOTONY MON_INCREASE /end AXIS_DESCR
 /begin AXIS_DESCR STD_AXIS zff_atsys._.iSignale._.obj.sig_m_t8 UMR_NM__8_1_M50_S6_S3 10 -400 1640 DEPOSIT ABSOLUTE MONOTONY MON_INCREASE /end AXIS_DESCR
/end CHARACTERISTIC
/begin CHARACTERISTIC KF_MEHAUPT_LRHSSPORT78 "Motoreingriffsoffset" MAP 0x22DFDC kf_ui8_S6_S3 1530 UMR_NM__6_1_M145_S6_S3 -870 660
 /begin AXIS_DESCR STD_AXIS iSasZentr.iSchaltend.n_tkf UMR_U_MIN_32_1_0_S6_S3 3 0 8160 DEPOSIT ABSOLUTE MONOTONY MON_INCREASE /end AXIS_DESCR
 /begin AXIS_DESCR STD_AXIS zff_atsys._.iSignale._.obj.sig_m_t8 UMR_NM__8_1_M50_S6_S3 6 -400 1640 DEPOSIT ABSOLUTE MONOTONY MON_INCREASE /end AXIS_DESCR
/end CHARACTERISTIC
/begin CHARACTERISTIC KF_MEHYSKLASSSPORT78 "Hysterese zur ME Klassifizierung" MAP 0x22E000 kf_si16_S6_S3 1200 UMR_NM__1_1_0_S6_S3 -800 400
 /begin AXIS_DESCR STD_AXIS iItfInput.m_mot UMR_NM__1_1_0_S6_S3 4 -400 1640 DEPOSIT ABSOLUTE MONOTONY MON_INCREASE /end AXIS_DESCR
 /begin AXIS_DESCR STD_AXIS zff_atsys._.iSignale._.obj.sig_n_mot UMR_U_MIN_1_1_0_S6_S3 4 0 8160 DEPOSIT ABSOLUTE MONOTONY MON_INCREASE /end AXIS_DESCR
/end CHARACTERISTIC
/begin CHARACTERISTIC KF_FMENACHPOSESPORT78 "Faktor fuer Reduzierung pos ME bei RS" MAP 0x22E038 kf_si16_S6_S3 1 UMR___1_100_0_S6_S3 0 1
 /begin AXIS_DESCR STD_AXIS iMoeMesaf.timer_rampe_pos UMR_MSEC__10_1_0_S6_S3 4 0 2550 DEPOSIT ABSOLUTE MONOTONY MON_INCREASE /end AXIS_DESCR
 /begin AXIS_DESCR STD_AXIS iMoeMesaf.me_sas_gesp UMR_NM__1_1_0_S6_S3 4 0 2000 DEPOSIT ABSOLUTE MONOTONY MON_INCREASE /end AXIS_DESCR
/end CHARACTERISTIC
/begin CHARACTERISTIC KF_MEHAUPTSPORT13 "Hauptmotoreingriff Schaltablauf" MAP 0x22E070 kf_ui8_S6_S3 1530 UMR_NM__6_1_M145_S6_S3 -870 660
 /begin AXIS_DESCR STD_AXIS iSasZentr.iSchaltend.n_tkf UMR_U_MIN_32_1_0_S6_S3 6 0 8160 DEPOSIT ABSOLUTE MONOTONY MON_INCREASE /end AXIS_DESCR
 /begin AXIS_DESCR STD_AXIS zff_atsys._.iSignale._.obj.sig_m_t8 UMR_NM__8_1_M50_S6_S3 10 -400 1640 DEPOSIT ABSOLUTE MONOTONY MON_INCREASE /end AXIS_DESCR
/end CHARACTERISTIC
/begin CHARACTERISTIC KF_MEHAUPT_LRHSSPORT13 "Motoreingriffsoffset" MAP 0x22E0C4 kf_ui8_S6_S3 1530 UMR_NM__6_1_M145_S6_S3 -870 660
 /begin AXIS_DESCR STD_AXIS iSasZentr.iSchaltend.n_tkf UMR_U_MIN_32_1_0_S6_S3 3 0 8160 DEPOSIT ABSOLUTE MONOTONY MON_INCREASE /end AXIS_DESCR
 /begin AXIS_DESCR STD_AXIS zff_atsys._.iSignale._.obj.sig_m_t8 UMR_NM__8_1_M50_S6_S3 6 -400 1640 DEPOSIT ABSOLUTE MONOTONY MON_INCREASE /end AXIS_DESCR
/end CHARACTERISTIC
/begin CHARACTERISTIC KF_FMENACHPOSESPORT13 "Faktor fuer Reduzierung pos ME bei RS" MAP 0x22E0E8 kf_si16_S6_S3 1 UMR___1_100_0_S6_S3 0 1
 /begin AXIS_DESCR STD_AXIS iMoeMesaf.timer_rampe_pos UMR_MSEC__10_1_0_S6_S3 4 0 2550 DEPOSIT ABSOLUTE MONOTONY MON_INCREASE /end AXIS_DESCR
 /begin AXIS_DESCR STD_AXIS iMoeMesaf.me_sas_gesp UMR_NM__1_1_0_S6_S3 4 0 2000 DEPOSIT ABSOLUTE MONOTONY MON_INCREASE /end AXIS_DESCR
/end CHARACTERISTIC
/begin CHARACTERISTIC KF_MEHAUPTSPORT24 "Hauptmotoreingriff Schaltablauf" MAP 0x22E120 kf_ui8_S6_S3 1530 UMR_NM__6_1_M145_S6_S3 -870 660
 /begin AXIS_DESCR STD_AXIS iSasZentr.iSchaltend.n_tkf UMR_U_MIN_32_1_0_S6_S3 6 0 8160 DEPOSIT ABSOLUTE MONOTONY MON_INCREASE /end AXIS_DESCR
 /begin AXIS_DESCR STD_AXIS zff_atsys._.iSignale._.obj.sig_m_t8 UMR_NM__8_1_M50_S6_S3 10 -400 1640 DEPOSIT ABSOLUTE MONOTONY MON_INCREASE /end AXIS_DESCR
/end CHARACTERISTIC
/begin CHARACTERISTIC KF_MEHAUPT_LRHSSPORT24 "Motoreingriffsoffset" MAP 0x22E174 kf_ui8_S6_S3 1530 UMR_NM__6_1_M145_S6_S3 -870 660
 /begin AXIS_DESCR STD_AXIS iSasZentr.iSchaltend.n_tkf UMR_U_MIN_32_1_0_S6_S3 3 0 8160 DEPOSIT ABSOLUTE MONOTONY MON_INCREASE /end AXIS_DESCR
 /begin AXIS_DESCR STD_AXIS zff_atsys._.iSignale._.obj.sig_m_t8 UMR_NM__8_1_M50_S6_S3 6 -400 1640 DEPOSIT ABSOLUTE MONOTONY MON_INCREASE /end AXIS_DESCR
/end CHARACTERISTIC
/begin CHARACTERISTIC KF_FMENACHPOSESPORT24 "Faktor fuer Reduzierung pos ME bei RS" MAP 0x22E198 kf_si16_S6_S3 1 UMR___1_100_0_S6_S3 0 1
 /begin AXIS_DESCR STD_AXIS iMoeMesaf.timer_rampe_pos UMR_MSEC__10_1_0_S6_S3 4 0 2550 DEPOSIT ABSOLUTE MONOTONY MON_INCREASE /end AXIS_DESCR
 /begin AXIS_DESCR STD_AXIS iMoeMesaf.me_sas_gesp UMR_NM__1_1_0_S6_S3 4 0 2000 DEPOSIT ABSOLUTE MONOTONY MON_INCREASE /end AXIS_DESCR
/end CHARACTERISTIC
/begin CHARACTERISTIC KF_MEHAUPTSPORT35 "Hauptmotoreingriff Schaltablauf" MAP 0x22E1D0 kf_ui8_S6_S3 1530 UMR_NM__6_1_M145_S6_S3 -870 660
 /begin AXIS_DESCR STD_AXIS iSasZentr.iSchaltend.n_tkf UMR_U_MIN_32_1_0_S6_S3 6 0 8160 DEPOSIT ABSOLUTE MONOTONY MON_INCREASE /end AXIS_DESCR
 /begin AXIS_DESCR STD_AXIS zff_atsys._.iSignale._.obj.sig_m_t8 UMR_NM__8_1_M50_S6_S3 10 -400 1640 DEPOSIT ABSOLUTE MONOTONY MON_INCREASE /end AXIS_DESCR
/end CHARACTERISTIC
/begin CHARACTERISTIC KF_MEHAUPT_LRHSSPORT35 "Motoreingriffsoffset" MAP 0x22E224 kf_ui8_S6_S3 1530 UMR_NM__6_1_M145_S6_S3 -870 660
 /begin AXIS_DESCR STD_AXIS iSasZentr.iSchaltend.n_tkf UMR_U_MIN_32_1_0_S6_S3 3 0 8160 DEPOSIT ABSOLUTE MONOTONY MON_INCREASE /end AXIS_DESCR
 /begin AXIS_DESCR STD_AXIS zff_atsys._.iSignale._.obj.sig_m_t8 UMR_NM__8_1_M50_S6_S3 6 -400 1640 DEPOSIT ABSOLUTE MONOTONY MON_INCREASE /end AXIS_DESCR
/end CHARACTERISTIC
/begin CHARACTERISTIC KF_FMENACHPOSESPORT35 "Faktor fuer Reduzierung pos ME bei RS" MAP 0x22E248 kf_si16_S6_S3 1 UMR___1_100_0_S6_S3 0 1
 /begin AXIS_DESCR STD_AXIS iMoeMesaf.timer_rampe_pos UMR_MSEC__10_1_0_S6_S3 4 0 2550 DEPOSIT ABSOLUTE MONOTONY MON_INCREASE /end AXIS_DESCR
 /begin AXIS_DESCR STD_AXIS iMoeMesaf.me_sas_gesp UMR_NM__1_1_0_S6_S3 4 0 2000 DEPOSIT ABSOLUTE MONOTONY MON_INCREASE /end AXIS_DESCR
/end CHARACTERISTIC
/begin CHARACTERISTIC KF_MEHAUPTSPORT46 "Hauptmotoreingriff Schaltablauf" MAP 0x22E280 kf_ui8_S6_S3 1530 UMR_NM__6_1_M145_S6_S3 -870 660
 /begin AXIS_DESCR STD_AXIS iSasZentr.iSchaltend.n_tkf UMR_U_MIN_32_1_0_S6_S3 6 0 8160 DEPOSIT ABSOLUTE MONOTONY MON_INCREASE /end AXIS_DESCR
 /begin AXIS_DESCR STD_AXIS zff_atsys._.iSignale._.obj.sig_m_t8 UMR_NM__8_1_M50_S6_S3 10 -400 1640 DEPOSIT ABSOLUTE MONOTONY MON_INCREASE /end AXIS_DESCR
/end CHARACTERISTIC
/begin CHARACTERISTIC KF_MEHAUPT_LRHSSPORT46 "Motoreingriffsoffset" MAP 0x22E2D4 kf_ui8_S6_S3 1530 UMR_NM__6_1_M145_S6_S3 -870 660
 /begin AXIS_DESCR STD_AXIS iSasZentr.iSchaltend.n_tkf UMR_U_MIN_32_1_0_S6_S3 3 0 8160 DEPOSIT ABSOLUTE MONOTONY MON_INCREASE /end AXIS_DESCR
 /begin AXIS_DESCR STD_AXIS zff_atsys._.iSignale._.obj.sig_m_t8 UMR_NM__8_1_M50_S6_S3 6 -400 1640 DEPOSIT ABSOLUTE MONOTONY MON_INCREASE /end AXIS_DESCR
/end CHARACTERISTIC
/begin CHARACTERISTIC KF_FMENACHPOSESPORT46 "Faktor fuer Reduzierung pos ME bei RS" MAP 0x22E2F8 kf_si16_S6_S3 1 UMR___1_100_0_S6_S3 0 1
 /begin AXIS_DESCR STD_AXIS iMoeMesaf.timer_rampe_pos UMR_MSEC__10_1_0_S6_S3 4 0 2550 DEPOSIT ABSOLUTE MONOTONY MON_INCREASE /end AXIS_DESCR
 /begin AXIS_DESCR STD_AXIS iMoeMesaf.me_sas_gesp UMR_NM__1_1_0_S6_S3 4 0 2000 DEPOSIT ABSOLUTE MONOTONY MON_INCREASE /end AXIS_DESCR
/end CHARACTERISTIC
/begin CHARACTERISTIC KF_MEHAUPTSPORT57 "Hauptmotoreingriff Schaltablauf" MAP 0x22E330 kf_ui8_S6_S3 1530 UMR_NM__6_1_M145_S6_S3 -870 660
 /begin AXIS_DESCR STD_AXIS iSasZentr.iSchaltend.n_tkf UMR_U_MIN_32_1_0_S6_S3 6 0 8160 DEPOSIT ABSOLUTE MONOTONY MON_INCREASE /end AXIS_DESCR
 /begin AXIS_DESCR STD_AXIS zff_atsys._.iSignale._.obj.sig_m_t8 UMR_NM__8_1_M50_S6_S3 10 -400 1640 DEPOSIT ABSOLUTE MONOTONY MON_INCREASE /end AXIS_DESCR
/end CHARACTERISTIC
/begin CHARACTERISTIC KF_MEHAUPT_LRHSSPORT57 "Motoreingriffsoffset" MAP 0x22E384 kf_ui8_S6_S3 1530 UMR_NM__6_1_M145_S6_S3 -870 660
 /begin AXIS_DESCR STD_AXIS iSasZentr.iSchaltend.n_tkf UMR_U_MIN_32_1_0_S6_S3 3 0 8160 DEPOSIT ABSOLUTE MONOTONY MON_INCREASE /end AXIS_DESCR
 /begin AXIS_DESCR STD_AXIS zff_atsys._.iSignale._.obj.sig_m_t8 UMR_NM__8_1_M50_S6_S3 6 -400 1640 DEPOSIT ABSOLUTE MONOTONY MON_INCREASE /end AXIS_DESCR
/end CHARACTERISTIC
/begin CHARACTERISTIC KF_FMENACHPOSESPORT57 "Faktor fuer Reduzierung pos ME bei RS" MAP 0x22E3A8 kf_si16_S6_S3 1 UMR___1_100_0_S6_S3 0 1
 /begin AXIS_DESCR STD_AXIS iMoeMesaf.timer_rampe_pos UMR_MSEC__10_1_0_S6_S3 4 0 2550 DEPOSIT ABSOLUTE MONOTONY MON_INCREASE /end AXIS_DESCR
 /begin AXIS_DESCR STD_AXIS iMoeMesaf.me_sas_gesp UMR_NM__1_1_0_S6_S3 4 0 2000 DEPOSIT ABSOLUTE MONOTONY MON_INCREASE /end AXIS_DESCR
/end CHARACTERISTIC
/begin CHARACTERISTIC KF_MEHAUPTSPORT68 "Hauptmotoreingriff Schaltablauf" MAP 0x22E3E0 kf_ui8_S6_S3 1530 UMR_NM__6_1_M145_S6_S3 -870 660
 /begin AXIS_DESCR STD_AXIS iSasZentr.iSchaltend.n_tkf UMR_U_MIN_32_1_0_S6_S3 6 0 8160 DEPOSIT ABSOLUTE MONOTONY MON_INCREASE /end AXIS_DESCR
 /begin AXIS_DESCR STD_AXIS zff_atsys._.iSignale._.obj.sig_m_t8 UMR_NM__8_1_M50_S6_S3 10 -400 1640 DEPOSIT ABSOLUTE MONOTONY MON_INCREASE /end AXIS_DESCR
/end CHARACTERISTIC
/begin CHARACTERISTIC KF_MEHAUPT_LRHSSPORT68 "Motoreingriffsoffset" MAP 0x22E434 kf_ui8_S6_S3 1530 UMR_NM__6_1_M145_S6_S3 -870 660
 /begin AXIS_DESCR STD_AXIS iSasZentr.iSchaltend.n_tkf UMR_U_MIN_32_1_0_S6_S3 3 0 8160 DEPOSIT ABSOLUTE MONOTONY MON_INCREASE /end AXIS_DESCR
 /begin AXIS_DESCR STD_AXIS zff_atsys._.iSignale._.obj.sig_m_t8 UMR_NM__8_1_M50_S6_S3 6 -400 1640 DEPOSIT ABSOLUTE MONOTONY MON_INCREASE /end AXIS_DESCR
/end CHARACTERISTIC
/begin CHARACTERISTIC KF_FMENACHPOSESPORT68 "Faktor fuer Reduzierung pos ME bei RS" MAP 0x22E458 kf_si16_S6_S3 1 UMR___1_100_0_S6_S3 0 1
 /begin AXIS_DESCR STD_AXIS iMoeMesaf.timer_rampe_pos UMR_MSEC__10_1_0_S6_S3 4 0 2550 DEPOSIT ABSOLUTE MONOTONY MON_INCREASE /end AXIS_DESCR
 /begin AXIS_DESCR STD_AXIS iMoeMesaf.me_sas_gesp UMR_NM__1_1_0_S6_S3 4 0 2000 DEPOSIT ABSOLUTE MONOTONY MON_INCREASE /end AXIS_DESCR
/end CHARACTERISTIC
/begin CHARACTERISTIC KL_POHKAB21 "Druckoffset waehrend Haltedruckphase" CURVE 0x243528 kl_si16_S6_S3 12.75 UMR_BAR__1_1000_0_S6_S3 -6.4 6.35
 /begin AXIS_DESCR STD_AXIS zff_atsys._.iSignale._.obj.sig_m_t8 UMR_NM__8_1_M50_S6_S3 4 -400 1640 DEPOSIT ABSOLUTE MONOTONY MON_INCREASE /end AXIS_DESCR
/end CHARACTERISTIC
/begin CHARACTERISTIC KL_POHKAB21_EL "Druckoffset waehrend Haltedruckphase" CURVE 0x24353C kl_si16_S6_S3 12.75 UMR_BAR__1_1000_0_S6_S3 -6.4 6.35
 /begin AXIS_DESCR STD_AXIS zff_atsys._.iSignale._.obj.sig_m_t8 UMR_NM__8_1_M50_S6_S3 4 -400 1640 DEPOSIT ABSOLUTE MONOTONY MON_INCREASE /end AXIS_DESCR
/end CHARACTERISTIC
/begin CHARACTERISTIC F_PRAHKAB21 "Druckfaktor waehrend Rampe auf Schaltdruck" VALUE 0x26E741 kw_ui8_S6_S3 1 UMR___1_100_0_S6_S3 0 1 /end CHARACTERISTIC
/begin CHARACTERISTIC F_PRAHKAB21_EL "Druckfaktor waehrend Rampe auf Schaltdruck" VALUE 0x26E742 kw_ui8_S6_S3 1 UMR___1_100_0_S6_S3 0 1 /end CHARACTERISTIC
/begin CHARACTERISTIC F_TRAHKAB21 "Zeitfaktor waehrend Rampe auf Schaltdruck" VALUE 0x26E743 kw_ui8_S6_S3 1 UMR___1_100_0_S6_S3 0 1 /end CHARACTERISTIC
/begin CHARACTERISTIC F_TRAHKAB21_EL "Zeitfaktor waehrend Rampe auf Schaltdruck" VALUE 0x26E744 kw_ui8_S6_S3 1 UMR___1_100_0_S6_S3 0 1 /end CHARACTERISTIC
/begin CHARACTERISTIC KL_TRAHKAB21 "Zeit fuer Rampe auf Schaltdruck" CURVE 0x243550 kl_ui8_S6_S3 2540 UMR_MSEC__10_1_0_S6_S3 0 2540
 /begin AXIS_DESCR STD_AXIS zff_atsys._.iSignale._.obj.sig_m_t8 UMR_NM__8_1_M50_S6_S3 4 -400 1640 DEPOSIT ABSOLUTE MONOTONY MON_INCREASE /end AXIS_DESCR
/end CHARACTERISTIC
/begin CHARACTERISTIC KL_TRAHKAB21_EL "Zeit fuer Rampe auf Schaltdruck" CURVE 0x24355C kl_ui8_S6_S3 2540 UMR_MSEC__10_1_0_S6_S3 0 2540
 /begin AXIS_DESCR STD_AXIS zff_atsys._.iSignale._.obj.sig_m_t8 UMR_NM__8_1_M50_S6_S3 4 -400 1640 DEPOSIT ABSOLUTE MONOTONY MON_INCREASE /end AXIS_DESCR
/end CHARACTERISTIC
/begin CHARACTERISTIC KL_PGOKAB21 "Druckgradient in Abhaengigkeit von m_t" CURVE 0x243568 kl_si16_S6_S3 200 UMR_BAR_SEC_1_10_0_S6_S3 -100 100
 /begin AXIS_DESCR STD_AXIS zff_atsys._.iSignale._.obj.sig_m_t UMR_NM__1_1_0_S6_S3 6 -400 1640 DEPOSIT ABSOLUTE MONOTONY MON_INCREASE /end AXIS_DESCR
/end CHARACTERISTIC
/begin CHARACTERISTIC KF_TOHKABMTNT21 "Zeitoffset auf Ende SF fuer Haltephase" MAP 0x243584 kf_ui8_S6_S3 2000 UMR_MSEC__10_1_M128_S6_S3 -1000 1000
 /begin AXIS_DESCR STD_AXIS zff_atsys._.iSignale._.obj.sig_n_t8 UMR_U_MIN_32_1_0_S6_S3 4 0 8160 DEPOSIT ABSOLUTE MONOTONY MON_INCREASE /end AXIS_DESCR
 /begin AXIS_DESCR STD_AXIS zff_atsys._.iSignale._.obj.sig_m_t8 UMR_NM__8_1_M50_S6_S3 6 -400 1640 DEPOSIT ABSOLUTE MONOTONY MON_INCREASE /end AXIS_DESCR
/end CHARACTERISTIC
/begin CHARACTERISTIC KF_TOHKABMTNT21_EL "Zeitoffset auf Ende SF fuer Haltephase" MAP 0x2435B0 kf_ui8_S6_S3 2000 UMR_MSEC__10_1_M128_S6_S3 -1000 1000
 /begin AXIS_DESCR STD_AXIS zff_atsys._.iSignale._.obj.sig_n_t8 UMR_U_MIN_32_1_0_S6_S3 4 0 8160 DEPOSIT ABSOLUTE MONOTONY MON_INCREASE /end AXIS_DESCR
 /begin AXIS_DESCR STD_AXIS zff_atsys._.iSignale._.obj.sig_m_t8 UMR_NM__8_1_M50_S6_S3 6 -400 1640 DEPOSIT ABSOLUTE MONOTONY MON_INCREASE /end AXIS_DESCR
/end CHARACTERISTIC
/begin CHARACTERISTIC KL_TSYNMTKAB21 "Zeit vor sync. Ende Schaltdruck KAB" CURVE 0x2435DC kl_ui8_S6_S3 1280 UMR_MSEC__10_1_M128_S6_S3 -1280 0
 /begin AXIS_DESCR STD_AXIS zff_atsys._.iSignale._.obj.sig_m_t8 UMR_NM__8_1_M50_S6_S3 4 -400 1640 DEPOSIT ABSOLUTE MONOTONY MON_INCREASE /end AXIS_DESCR
/end CHARACTERISTIC
/begin CHARACTERISTIC KL_TSYNMTKAB21_EL "Zeit vor sync. Ende Schaltdruck KAB" CURVE 0x2435E8 kl_ui8_S6_S3 1280 UMR_MSEC__10_1_M128_S6_S3 -1280 0
 /begin AXIS_DESCR STD_AXIS zff_atsys._.iSignale._.obj.sig_m_t8 UMR_NM__8_1_M50_S6_S3 4 -400 1640 DEPOSIT ABSOLUTE MONOTONY MON_INCREASE /end AXIS_DESCR
/end CHARACTERISTIC
/begin CHARACTERISTIC KF_PKAB21 "Schaltdruck abschaltende Kupplung" MAP 0x2435F4 kf_si16_S6_S3 12.75 UMR_BAR__1_1000_0_S6_S3 0 12.75
 /begin AXIS_DESCR STD_AXIS iSasZentr.iSchaltend.n_tkf UMR_U_MIN_32_1_0_S6_S3 8 0 8160 DEPOSIT ABSOLUTE MONOTONY MON_INCREASE /end AXIS_DESCR
 /begin AXIS_DESCR STD_AXIS zff_atsys._.iSignale._.obj.sig_m_t UMR_NM__1_1_0_S6_S3 10 -400 1640 DEPOSIT ABSOLUTE MONOTONY MON_INCREASE /end AXIS_DESCR
/end CHARACTERISTIC
/begin CHARACTERISTIC KF_PKAB21_EL "Schaltdruck abschaltende Kupplung" MAP 0x2436C0 kf_si16_S6_S3 12.75 UMR_BAR__1_1000_0_S6_S3 0 12.75
 /begin AXIS_DESCR STD_AXIS iSasZentr.iSchaltend.n_tkf UMR_U_MIN_32_1_0_S6_S3 8 0 8160 DEPOSIT ABSOLUTE MONOTONY MON_INCREASE /end AXIS_DESCR
 /begin AXIS_DESCR STD_AXIS zff_atsys._.iSignale._.obj.sig_m_t UMR_NM__1_1_0_S6_S3 10 -400 1640 DEPOSIT ABSOLUTE MONOTONY MON_INCREASE /end AXIS_DESCR
/end CHARACTERISTIC
/begin CHARACTERISTIC KF_TSYNMTNTKABV21 "Zeit vor sync. Ende Haltephase vorb. KAB" MAP 0x24378C kf_si16_S6_S3 5000 UMR_MSEC__10_1_0_S6_S3 -5000 0
 /begin AXIS_DESCR STD_AXIS zff_atsys._.iSignale._.obj.sig_m_t UMR_NM__1_1_0_S6_S3 4 -400 1640 DEPOSIT ABSOLUTE MONOTONY MON_INCREASE /end AXIS_DESCR
 /begin AXIS_DESCR STD_AXIS zff_atsys._.iSignale._.obj.sig_n_t UMR_U_MIN_1_1_0_S6_S3 6 0 8160 DEPOSIT ABSOLUTE MONOTONY MON_INCREASE /end AXIS_DESCR
/end CHARACTERISTIC
/begin CHARACTERISTIC KL_TRAMTHINSYNKAB21 "Zeit fuer Abschalten KAB nach Haltephase in Synchron" CURVE 0x2437D8 kl_ui8_S6_S3 2550 UMR_MSEC__10_1_0_S6_S3 0 2550
 /begin AXIS_DESCR STD_AXIS zff_atsys._.iSignale._.obj.sig_m_t8 UMR_NM__8_1_M50_S6_S3 4 -400 1640 DEPOSIT ABSOLUTE MONOTONY MON_INCREASE /end AXIS_DESCR
/end CHARACTERISTIC
/begin CHARACTERISTIC KF_POHINSYNKAB21 "Kennfeld Haltedruckoffset(n_tkf, m_t) bei Haltephase in Synchron" MAP 0x2437E4 kf_si16_S6_S3 12.75 UMR_BAR__1_1000_0_S6_S3 -6.4 6.35
 /begin AXIS_DESCR STD_AXIS iSasZentr.iSchaltend.n_tkf UMR_U_MIN_32_1_0_S6_S3 6 0 8160 DEPOSIT ABSOLUTE MONOTONY MON_INCREASE /end AXIS_DESCR
 /begin AXIS_DESCR STD_AXIS zff_atsys._.iSignale._.obj.sig_m_t UMR_NM__1_1_0_S6_S3 6 -400 1640 DEPOSIT ABSOLUTE MONOTONY MON_INCREASE /end AXIS_DESCR
/end CHARACTERISTIC
/begin CHARACTERISTIC T_HINSYN21 "Zeit fuer Ende Haltephase in Synchron KZU/KAB" VALUE 0x26E745 kw_ui8_S6_S3 2540 UMR_MSEC__10_1_0_S6_S3 0 2540 /end CHARACTERISTIC
/begin CHARACTERISTIC KL_POHKAB32 "Druckoffset waehrend Haltedruckphase" CURVE 0x24384C kl_si16_S6_S3 12.75 UMR_BAR__1_1000_0_S6_S3 -6.4 6.35
 /begin AXIS_DESCR STD_AXIS zff_atsys._.iSignale._.obj.sig_m_t8 UMR_NM__8_1_M50_S6_S3 4 -400 1640 DEPOSIT ABSOLUTE MONOTONY MON_INCREASE /end AXIS_DESCR
/end CHARACTERISTIC
/begin CHARACTERISTIC KL_POHKAB32_EL "Druckoffset waehrend Haltedruckphase" CURVE 0x243860 kl_si16_S6_S3 12.75 UMR_BAR__1_1000_0_S6_S3 -6.4 6.35
 /begin AXIS_DESCR STD_AXIS zff_atsys._.iSignale._.obj.sig_m_t8 UMR_NM__8_1_M50_S6_S3 4 -400 1640 DEPOSIT ABSOLUTE MONOTONY MON_INCREASE /end AXIS_DESCR
/end CHARACTERISTIC
/begin CHARACTERISTIC F_PRAHKAB32 "Druckfaktor waehrend Rampe auf Schaltdruck" VALUE 0x26E746 kw_ui8_S6_S3 1 UMR___1_100_0_S6_S3 0 1 /end CHARACTERISTIC
/begin CHARACTERISTIC F_PRAHKAB32_EL "Druckfaktor waehrend Rampe auf Schaltdruck" VALUE 0x26E747 kw_ui8_S6_S3 1 UMR___1_100_0_S6_S3 0 1 /end CHARACTERISTIC
/begin CHARACTERISTIC F_TRAHKAB32 "Zeitfaktor waehrend Rampe auf Schaltdruck" VALUE 0x26E748 kw_ui8_S6_S3 1 UMR___1_100_0_S6_S3 0 1 /end CHARACTERISTIC
/begin CHARACTERISTIC F_TRAHKAB32_EL "Zeitfaktor waehrend Rampe auf Schaltdruck" VALUE 0x26E749 kw_ui8_S6_S3 1 UMR___1_100_0_S6_S3 0 1 /end CHARACTERISTIC
/begin CHARACTERISTIC KL_TRAHKAB32 "Zeit fuer Rampe auf Schaltdruck" CURVE 0x243874 kl_ui8_S6_S3 2540 UMR_MSEC__10_1_0_S6_S3 0 2540
 /begin AXIS_DESCR STD_AXIS zff_atsys._.iSignale._.obj.sig_m_t8 UMR_NM__8_1_M50_S6_S3 4 -400 1640 DEPOSIT ABSOLUTE MONOTONY MON_INCREASE /end AXIS_DESCR
/end CHARACTERISTIC
/begin CHARACTERISTIC KL_TRAHKAB32_EL "Zeit fuer Rampe auf Schaltdruck" CURVE 0x243880 kl_ui8_S6_S3 2540 UMR_MSEC__10_1_0_S6_S3 0 2540
 /begin AXIS_DESCR STD_AXIS zff_atsys._.iSignale._.obj.sig_m_t8 UMR_NM__8_1_M50_S6_S3 4 -400 1640 DEPOSIT ABSOLUTE MONOTONY MON_INCREASE /end AXIS_DESCR
/end CHARACTERISTIC
/begin CHARACTERISTIC KL_PGOKAB32 "Druckgradient in Abhaengigkeit von m_t" CURVE 0x24388C kl_si16_S6_S3 200 UMR_BAR_SEC_1_10_0_S6_S3 -100 100
 /begin AXIS_DESCR STD_AXIS zff_atsys._.iSignale._.obj.sig_m_t UMR_NM__1_1_0_S6_S3 6 -400 1640 DEPOSIT ABSOLUTE MONOTONY MON_INCREASE /end AXIS_DESCR
/end CHARACTERISTIC
/begin CHARACTERISTIC KF_TOHKABMTNT32 "Zeitoffset auf Ende SF fuer Haltephase" MAP 0x2438A8 kf_ui8_S6_S3 2000 UMR_MSEC__10_1_M128_S6_S3 -1000 1000
 /begin AXIS_DESCR STD_AXIS zff_atsys._.iSignale._.obj.sig_n_t8 UMR_U_MIN_32_1_0_S6_S3 4 0 8160 DEPOSIT ABSOLUTE MONOTONY MON_INCREASE /end AXIS_DESCR
 /begin AXIS_DESCR STD_AXIS zff_atsys._.iSignale._.obj.sig_m_t8 UMR_NM__8_1_M50_S6_S3 6 -400 1640 DEPOSIT ABSOLUTE MONOTONY MON_INCREASE /end AXIS_DESCR
/end CHARACTERISTIC
/begin CHARACTERISTIC KF_TOHKABMTNT32_EL "Zeitoffset auf Ende SF fuer Haltephase" MAP 0x2438D4 kf_ui8_S6_S3 2000 UMR_MSEC__10_1_M128_S6_S3 -1000 1000
 /begin AXIS_DESCR STD_AXIS zff_atsys._.iSignale._.obj.sig_n_t8 UMR_U_MIN_32_1_0_S6_S3 4 0 8160 DEPOSIT ABSOLUTE MONOTONY MON_INCREASE /end AXIS_DESCR
 /begin AXIS_DESCR STD_AXIS zff_atsys._.iSignale._.obj.sig_m_t8 UMR_NM__8_1_M50_S6_S3 6 -400 1640 DEPOSIT ABSOLUTE MONOTONY MON_INCREASE /end AXIS_DESCR
/end CHARACTERISTIC
/begin CHARACTERISTIC KL_TSYNMTKAB32 "Zeit vor sync. Ende Schaltdruck KAB" CURVE 0x243900 kl_ui8_S6_S3 1280 UMR_MSEC__10_1_M128_S6_S3 -1280 0
 /begin AXIS_DESCR STD_AXIS zff_atsys._.iSignale._.obj.sig_m_t8 UMR_NM__8_1_M50_S6_S3 4 -400 1640 DEPOSIT ABSOLUTE MONOTONY MON_INCREASE /end AXIS_DESCR
/end CHARACTERISTIC
/begin CHARACTERISTIC KL_TSYNMTKAB32_EL "Zeit vor sync. Ende Schaltdruck KAB" CURVE 0x24390C kl_ui8_S6_S3 1280 UMR_MSEC__10_1_M128_S6_S3 -1280 0
 /begin AXIS_DESCR STD_AXIS zff_atsys._.iSignale._.obj.sig_m_t8 UMR_NM__8_1_M50_S6_S3 4 -400 1640 DEPOSIT ABSOLUTE MONOTONY MON_INCREASE /end AXIS_DESCR
/end CHARACTERISTIC
/begin CHARACTERISTIC KF_PKAB32 "Schaltdruck abschaltende Kupplung" MAP 0x243918 kf_si16_S6_S3 12.75 UMR_BAR__1_1000_0_S6_S3 0 12.75
 /begin AXIS_DESCR STD_AXIS iSasZentr.iSchaltend.n_tkf UMR_U_MIN_32_1_0_S6_S3 8 0 8160 DEPOSIT ABSOLUTE MONOTONY MON_INCREASE /end AXIS_DESCR
 /begin AXIS_DESCR STD_AXIS zff_atsys._.iSignale._.obj.sig_m_t UMR_NM__1_1_0_S6_S3 10 -400 1640 DEPOSIT ABSOLUTE MONOTONY MON_INCREASE /end AXIS_DESCR
/end CHARACTERISTIC
/begin CHARACTERISTIC KF_PKAB32_EL "Schaltdruck abschaltende Kupplung" MAP 0x2439E4 kf_si16_S6_S3 12.75 UMR_BAR__1_1000_0_S6_S3 0 12.75
 /begin AXIS_DESCR STD_AXIS iSasZentr.iSchaltend.n_tkf UMR_U_MIN_32_1_0_S6_S3 8 0 8160 DEPOSIT ABSOLUTE MONOTONY MON_INCREASE /end AXIS_DESCR
 /begin AXIS_DESCR STD_AXIS zff_atsys._.iSignale._.obj.sig_m_t UMR_NM__1_1_0_S6_S3 10 -400 1640 DEPOSIT ABSOLUTE MONOTONY MON_INCREASE /end AXIS_DESCR
/end CHARACTERISTIC
/begin CHARACTERISTIC KF_TSYNMTNTKABV32 "Zeit vor sync. Ende Haltephase vorb. KAB" MAP 0x243AB0 kf_si16_S6_S3 5000 UMR_MSEC__10_1_0_S6_S3 -5000 0
 /begin AXIS_DESCR STD_AXIS zff_atsys._.iSignale._.obj.sig_m_t UMR_NM__1_1_0_S6_S3 4 -400 1640 DEPOSIT ABSOLUTE MONOTONY MON_INCREASE /end AXIS_DESCR
 /begin AXIS_DESCR STD_AXIS zff_atsys._.iSignale._.obj.sig_n_t UMR_U_MIN_1_1_0_S6_S3 6 0 8160 DEPOSIT ABSOLUTE MONOTONY MON_INCREASE /end AXIS_DESCR
/end CHARACTERISTIC
/begin CHARACTERISTIC KL_TRAMTHINSYNKAB32 "Zeit fuer Abschalten KAB nach Haltephase in Synchron" CURVE 0x243AFC kl_ui8_S6_S3 2550 UMR_MSEC__10_1_0_S6_S3 0 2550
 /begin AXIS_DESCR STD_AXIS zff_atsys._.iSignale._.obj.sig_m_t8 UMR_NM__8_1_M50_S6_S3 4 -400 1640 DEPOSIT ABSOLUTE MONOTONY MON_INCREASE /end AXIS_DESCR
/end CHARACTERISTIC
/begin CHARACTERISTIC KF_POHINSYNKAB32 "Kennfeld Haltedruckoffset(n_tkf, m_t) bei Haltephase in Synchron" MAP 0x243B08 kf_si16_S6_S3 12.75 UMR_BAR__1_1000_0_S6_S3 -6.4 6.35
 /begin AXIS_DESCR STD_AXIS iSasZentr.iSchaltend.n_tkf UMR_U_MIN_32_1_0_S6_S3 6 0 8160 DEPOSIT ABSOLUTE MONOTONY MON_INCREASE /end AXIS_DESCR
 /begin AXIS_DESCR STD_AXIS zff_atsys._.iSignale._.obj.sig_m_t UMR_NM__1_1_0_S6_S3 6 -400 1640 DEPOSIT ABSOLUTE MONOTONY MON_INCREASE /end AXIS_DESCR
/end CHARACTERISTIC
/begin CHARACTERISTIC T_HINSYN32 "Zeit fuer Ende Haltephase in Synchron KZU/KAB" VALUE 0x26E74A kw_ui8_S6_S3 2540 UMR_MSEC__10_1_0_S6_S3 0 2540 /end CHARACTERISTIC
/begin CHARACTERISTIC KL_POHKAB43 "Druckoffset waehrend Haltedruckphase" CURVE 0x243B70 kl_si16_S6_S3 12.75 UMR_BAR__1_1000_0_S6_S3 -6.4 6.35
 /begin AXIS_DESCR STD_AXIS zff_atsys._.iSignale._.obj.sig_m_t8 UMR_NM__8_1_M50_S6_S3 4 -400 1640 DEPOSIT ABSOLUTE MONOTONY MON_INCREASE /end AXIS_DESCR
/end CHARACTERISTIC
/begin CHARACTERISTIC KL_POHKAB43_EL "Druckoffset waehrend Haltedruckphase" CURVE 0x243B84 kl_si16_S6_S3 12.75 UMR_BAR__1_1000_0_S6_S3 -6.4 6.35
 /begin AXIS_DESCR STD_AXIS zff_atsys._.iSignale._.obj.sig_m_t8 UMR_NM__8_1_M50_S6_S3 4 -400 1640 DEPOSIT ABSOLUTE MONOTONY MON_INCREASE /end AXIS_DESCR
/end CHARACTERISTIC
/begin CHARACTERISTIC F_PRAHKAB43 "Druckfaktor waehrend Rampe auf Schaltdruck" VALUE 0x26E74B kw_ui8_S6_S3 1 UMR___1_100_0_S6_S3 0 1 /end CHARACTERISTIC
/begin CHARACTERISTIC F_PRAHKAB43_EL "Druckfaktor waehrend Rampe auf Schaltdruck" VALUE 0x26E74C kw_ui8_S6_S3 1 UMR___1_100_0_S6_S3 0 1 /end CHARACTERISTIC
/begin CHARACTERISTIC F_TRAHKAB43 "Zeitfaktor waehrend Rampe auf Schaltdruck" VALUE 0x26E74D kw_ui8_S6_S3 1 UMR___1_100_0_S6_S3 0 1 /end CHARACTERISTIC
/begin CHARACTERISTIC F_TRAHKAB43_EL "Zeitfaktor waehrend Rampe auf Schaltdruck" VALUE 0x26E74E kw_ui8_S6_S3 1 UMR___1_100_0_S6_S3 0 1 /end CHARACTERISTIC
/begin CHARACTERISTIC KL_TRAHKAB43 "Zeit fuer Rampe auf Schaltdruck" CURVE 0x243B98 kl_ui8_S6_S3 2540 UMR_MSEC__10_1_0_S6_S3 0 2540
 /begin AXIS_DESCR STD_AXIS zff_atsys._.iSignale._.obj.sig_m_t8 UMR_NM__8_1_M50_S6_S3 4 -400 1640 DEPOSIT ABSOLUTE MONOTONY MON_INCREASE /end AXIS_DESCR
/end CHARACTERISTIC
/begin CHARACTERISTIC KL_TRAHKAB43_EL "Zeit fuer Rampe auf Schaltdruck" CURVE 0x243BA4 kl_ui8_S6_S3 2540 UMR_MSEC__10_1_0_S6_S3 0 2540
 /begin AXIS_DESCR STD_AXIS zff_atsys._.iSignale._.obj.sig_m_t8 UMR_NM__8_1_M50_S6_S3 4 -400 1640 DEPOSIT ABSOLUTE MONOTONY MON_INCREASE /end AXIS_DESCR
/end CHARACTERISTIC
/begin CHARACTERISTIC KL_PGOKAB43 "Druckgradient in Abhaengigkeit von m_t" CURVE 0x243BB0 kl_si16_S6_S3 200 UMR_BAR_SEC_1_10_0_S6_S3 -100 100
 /begin AXIS_DESCR STD_AXIS zff_atsys._.iSignale._.obj.sig_m_t UMR_NM__1_1_0_S6_S3 6 -400 1640 DEPOSIT ABSOLUTE MONOTONY MON_INCREASE /end AXIS_DESCR
/end CHARACTERISTIC
/begin CHARACTERISTIC KF_TOHKABMTNT43 "Zeitoffset auf Ende SF fuer Haltephase" MAP 0x243BCC kf_ui8_S6_S3 2000 UMR_MSEC__10_1_M128_S6_S3 -1000 1000
 /begin AXIS_DESCR STD_AXIS zff_atsys._.iSignale._.obj.sig_n_t8 UMR_U_MIN_32_1_0_S6_S3 4 0 8160 DEPOSIT ABSOLUTE MONOTONY MON_INCREASE /end AXIS_DESCR
 /begin AXIS_DESCR STD_AXIS zff_atsys._.iSignale._.obj.sig_m_t8 UMR_NM__8_1_M50_S6_S3 6 -400 1640 DEPOSIT ABSOLUTE MONOTONY MON_INCREASE /end AXIS_DESCR
/end CHARACTERISTIC
/begin CHARACTERISTIC KF_TOHKABMTNT43_EL "Zeitoffset auf Ende SF fuer Haltephase" MAP 0x243BF8 kf_ui8_S6_S3 2000 UMR_MSEC__10_1_M128_S6_S3 -1000 1000
 /begin AXIS_DESCR STD_AXIS zff_atsys._.iSignale._.obj.sig_n_t8 UMR_U_MIN_32_1_0_S6_S3 4 0 8160 DEPOSIT ABSOLUTE MONOTONY MON_INCREASE /end AXIS_DESCR
 /begin AXIS_DESCR STD_AXIS zff_atsys._.iSignale._.obj.sig_m_t8 UMR_NM__8_1_M50_S6_S3 6 -400 1640 DEPOSIT ABSOLUTE MONOTONY MON_INCREASE /end AXIS_DESCR
/end CHARACTERISTIC
/begin CHARACTERISTIC KL_TSYNMTKAB43 "Zeit vor sync. Ende Schaltdruck KAB" CURVE 0x243C24 kl_ui8_S6_S3 1280 UMR_MSEC__10_1_M128_S6_S3 -1280 0
 /begin AXIS_DESCR STD_AXIS zff_atsys._.iSignale._.obj.sig_m_t8 UMR_NM__8_1_M50_S6_S3 4 -400 1640 DEPOSIT ABSOLUTE MONOTONY MON_INCREASE /end AXIS_DESCR
/end CHARACTERISTIC
/begin CHARACTERISTIC KL_TSYNMTKAB43_EL "Zeit vor sync. Ende Schaltdruck KAB" CURVE 0x243C30 kl_ui8_S6_S3 1280 UMR_MSEC__10_1_M128_S6_S3 -1280 0
 /begin AXIS_DESCR STD_AXIS zff_atsys._.iSignale._.obj.sig_m_t8 UMR_NM__8_1_M50_S6_S3 4 -400 1640 DEPOSIT ABSOLUTE MONOTONY MON_INCREASE /end AXIS_DESCR
/end CHARACTERISTIC
/begin CHARACTERISTIC KF_PKAB43 "Schaltdruck abschaltende Kupplung" MAP 0x243C3C kf_si16_S6_S3 12.75 UMR_BAR__1_1000_0_S6_S3 0 12.75
 /begin AXIS_DESCR STD_AXIS iSasZentr.iSchaltend.n_tkf UMR_U_MIN_32_1_0_S6_S3 8 0 8160 DEPOSIT ABSOLUTE MONOTONY MON_INCREASE /end AXIS_DESCR
 /begin AXIS_DESCR STD_AXIS zff_atsys._.iSignale._.obj.sig_m_t UMR_NM__1_1_0_S6_S3 10 -400 1640 DEPOSIT ABSOLUTE MONOTONY MON_INCREASE /end AXIS_DESCR
/end CHARACTERISTIC
/begin CHARACTERISTIC KF_PKAB43_EL "Schaltdruck abschaltende Kupplung" MAP 0x243D08 kf_si16_S6_S3 12.75 UMR_BAR__1_1000_0_S6_S3 0 12.75
 /begin AXIS_DESCR STD_AXIS iSasZentr.iSchaltend.n_tkf UMR_U_MIN_32_1_0_S6_S3 8 0 8160 DEPOSIT ABSOLUTE MONOTONY MON_INCREASE /end AXIS_DESCR
 /begin AXIS_DESCR STD_AXIS zff_atsys._.iSignale._.obj.sig_m_t UMR_NM__1_1_0_S6_S3 10 -400 1640 DEPOSIT ABSOLUTE MONOTONY MON_INCREASE /end AXIS_DESCR
/end CHARACTERISTIC
/begin CHARACTERISTIC KF_TSYNMTNTKABV43 "Zeit vor sync. Ende Haltephase vorb. KAB" MAP 0x243DD4 kf_si16_S6_S3 5000 UMR_MSEC__10_1_0_S6_S3 -5000 0
 /begin AXIS_DESCR STD_AXIS zff_atsys._.iSignale._.obj.sig_m_t UMR_NM__1_1_0_S6_S3 4 -400 1640 DEPOSIT ABSOLUTE MONOTONY MON_INCREASE /end AXIS_DESCR
 /begin AXIS_DESCR STD_AXIS zff_atsys._.iSignale._.obj.sig_n_t UMR_U_MIN_1_1_0_S6_S3 6 0 8160 DEPOSIT ABSOLUTE MONOTONY MON_INCREASE /end AXIS_DESCR
/end CHARACTERISTIC
/begin CHARACTERISTIC KL_TRAMTHINSYNKAB43 "Zeit fuer Abschalten KAB nach Haltephase in Synchron" CURVE 0x243E20 kl_ui8_S6_S3 2550 UMR_MSEC__10_1_0_S6_S3 0 2550
 /begin AXIS_DESCR STD_AXIS zff_atsys._.iSignale._.obj.sig_m_t8 UMR_NM__8_1_M50_S6_S3 4 -400 1640 DEPOSIT ABSOLUTE MONOTONY MON_INCREASE /end AXIS_DESCR
/end CHARACTERISTIC
/begin CHARACTERISTIC KF_POHINSYNKAB43 "Kennfeld Haltedruckoffset(n_tkf, m_t) bei Haltephase in Synchron" MAP 0x243E2C kf_si16_S6_S3 12.75 UMR_BAR__1_1000_0_S6_S3 -6.4 6.35
 /begin AXIS_DESCR STD_AXIS iSasZentr.iSchaltend.n_tkf UMR_U_MIN_32_1_0_S6_S3 6 0 8160 DEPOSIT ABSOLUTE MONOTONY MON_INCREASE /end AXIS_DESCR
 /begin AXIS_DESCR STD_AXIS zff_atsys._.iSignale._.obj.sig_m_t UMR_NM__1_1_0_S6_S3 6 -400 1640 DEPOSIT ABSOLUTE MONOTONY MON_INCREASE /end AXIS_DESCR
/end CHARACTERISTIC
/begin CHARACTERISTIC T_HINSYN43 "Zeit fuer Ende Haltephase in Synchron KZU/KAB" VALUE 0x26E74F kw_ui8_S6_S3 2540 UMR_MSEC__10_1_0_S6_S3 0 2540 /end CHARACTERISTIC
/begin CHARACTERISTIC KL_POHKAB54 "Druckoffset waehrend Haltedruckphase" CURVE 0x243E94 kl_si16_S6_S3 12.75 UMR_BAR__1_1000_0_S6_S3 -6.4 6.35
 /begin AXIS_DESCR STD_AXIS zff_atsys._.iSignale._.obj.sig_m_t8 UMR_NM__8_1_M50_S6_S3 4 -400 1640 DEPOSIT ABSOLUTE MONOTONY MON_INCREASE /end AXIS_DESCR
/end CHARACTERISTIC
/begin CHARACTERISTIC KL_POHKAB54_EL "Druckoffset waehrend Haltedruckphase" CURVE 0x243EA8 kl_si16_S6_S3 12.75 UMR_BAR__1_1000_0_S6_S3 -6.4 6.35
 /begin AXIS_DESCR STD_AXIS zff_atsys._.iSignale._.obj.sig_m_t8 UMR_NM__8_1_M50_S6_S3 4 -400 1640 DEPOSIT ABSOLUTE MONOTONY MON_INCREASE /end AXIS_DESCR
/end CHARACTERISTIC
/begin CHARACTERISTIC F_PRAHKAB54 "Druckfaktor waehrend Rampe auf Schaltdruck" VALUE 0x26E750 kw_ui8_S6_S3 1 UMR___1_100_0_S6_S3 0 1 /end CHARACTERISTIC
/begin CHARACTERISTIC F_PRAHKAB54_EL "Druckfaktor waehrend Rampe auf Schaltdruck" VALUE 0x26E751 kw_ui8_S6_S3 1 UMR___1_100_0_S6_S3 0 1 /end CHARACTERISTIC
/begin CHARACTERISTIC F_TRAHKAB54 "Zeitfaktor waehrend Rampe auf Schaltdruck" VALUE 0x26E752 kw_ui8_S6_S3 1 UMR___1_100_0_S6_S3 0 1 /end CHARACTERISTIC
/begin CHARACTERISTIC F_TRAHKAB54_EL "Zeitfaktor waehrend Rampe auf Schaltdruck" VALUE 0x26E753 kw_ui8_S6_S3 1 UMR___1_100_0_S6_S3 0 1 /end CHARACTERISTIC
/begin CHARACTERISTIC KL_TRAHKAB54 "Zeit fuer Rampe auf Schaltdruck" CURVE 0x243EBC kl_ui8_S6_S3 2540 UMR_MSEC__10_1_0_S6_S3 0 2540
 /begin AXIS_DESCR STD_AXIS zff_atsys._.iSignale._.obj.sig_m_t8 UMR_NM__8_1_M50_S6_S3 4 -400 1640 DEPOSIT ABSOLUTE MONOTONY MON_INCREASE /end AXIS_DESCR
/end CHARACTERISTIC
/begin CHARACTERISTIC KL_TRAHKAB54_EL "Zeit fuer Rampe auf Schaltdruck" CURVE 0x243EC8 kl_ui8_S6_S3 2540 UMR_MSEC__10_1_0_S6_S3 0 2540
 /begin AXIS_DESCR STD_AXIS zff_atsys._.iSignale._.obj.sig_m_t8 UMR_NM__8_1_M50_S6_S3 4 -400 1640 DEPOSIT ABSOLUTE MONOTONY MON_INCREASE /end AXIS_DESCR
/end CHARACTERISTIC
/begin CHARACTERISTIC KL_PGOKAB54 "Druckgradient in Abhaengigkeit von m_t" CURVE 0x243ED4 kl_si16_S6_S3 200 UMR_BAR_SEC_1_10_0_S6_S3 -100 100
 /begin AXIS_DESCR STD_AXIS zff_atsys._.iSignale._.obj.sig_m_t UMR_NM__1_1_0_S6_S3 6 -400 1640 DEPOSIT ABSOLUTE MONOTONY MON_INCREASE /end AXIS_DESCR
/end CHARACTERISTIC
/begin CHARACTERISTIC KF_TOHKABMTNT54 "Zeitoffset auf Ende SF fuer Haltephase" MAP 0x243EF0 kf_ui8_S6_S3 2000 UMR_MSEC__10_1_M128_S6_S3 -1000 1000
 /begin AXIS_DESCR STD_AXIS zff_atsys._.iSignale._.obj.sig_n_t8 UMR_U_MIN_32_1_0_S6_S3 4 0 8160 DEPOSIT ABSOLUTE MONOTONY MON_INCREASE /end AXIS_DESCR
 /begin AXIS_DESCR STD_AXIS zff_atsys._.iSignale._.obj.sig_m_t8 UMR_NM__8_1_M50_S6_S3 6 -400 1640 DEPOSIT ABSOLUTE MONOTONY MON_INCREASE /end AXIS_DESCR
/end CHARACTERISTIC
/begin CHARACTERISTIC KF_TOHKABMTNT54_EL "Zeitoffset auf Ende SF fuer Haltephase" MAP 0x243F1C kf_ui8_S6_S3 2000 UMR_MSEC__10_1_M128_S6_S3 -1000 1000
 /begin AXIS_DESCR STD_AXIS zff_atsys._.iSignale._.obj.sig_n_t8 UMR_U_MIN_32_1_0_S6_S3 4 0 8160 DEPOSIT ABSOLUTE MONOTONY MON_INCREASE /end AXIS_DESCR
 /begin AXIS_DESCR STD_AXIS zff_atsys._.iSignale._.obj.sig_m_t8 UMR_NM__8_1_M50_S6_S3 6 -400 1640 DEPOSIT ABSOLUTE MONOTONY MON_INCREASE /end AXIS_DESCR
/end CHARACTERISTIC
/begin CHARACTERISTIC KL_TSYNMTKAB54 "Zeit vor sync. Ende Schaltdruck KAB" CURVE 0x243F48 kl_ui8_S6_S3 1280 UMR_MSEC__10_1_M128_S6_S3 -1280 0
 /begin AXIS_DESCR STD_AXIS zff_atsys._.iSignale._.obj.sig_m_t8 UMR_NM__8_1_M50_S6_S3 4 -400 1640 DEPOSIT ABSOLUTE MONOTONY MON_INCREASE /end AXIS_DESCR
/end CHARACTERISTIC
/begin CHARACTERISTIC KL_TSYNMTKAB54_EL "Zeit vor sync. Ende Schaltdruck KAB" CURVE 0x243F54 kl_ui8_S6_S3 1280 UMR_MSEC__10_1_M128_S6_S3 -1280 0
 /begin AXIS_DESCR STD_AXIS zff_atsys._.iSignale._.obj.sig_m_t8 UMR_NM__8_1_M50_S6_S3 4 -400 1640 DEPOSIT ABSOLUTE MONOTONY MON_INCREASE /end AXIS_DESCR
/end CHARACTERISTIC
/begin CHARACTERISTIC KF_PKAB54 "Schaltdruck abschaltende Kupplung" MAP 0x243F60 kf_si16_S6_S3 12.75 UMR_BAR__1_1000_0_S6_S3 0 12.75
 /begin AXIS_DESCR STD_AXIS iSasZentr.iSchaltend.n_tkf UMR_U_MIN_32_1_0_S6_S3 8 0 8160 DEPOSIT ABSOLUTE MONOTONY MON_INCREASE /end AXIS_DESCR
 /begin AXIS_DESCR STD_AXIS zff_atsys._.iSignale._.obj.sig_m_t UMR_NM__1_1_0_S6_S3 10 -400 1640 DEPOSIT ABSOLUTE MONOTONY MON_INCREASE /end AXIS_DESCR
/end CHARACTERISTIC
/begin CHARACTERISTIC KF_PKAB54_EL "Schaltdruck abschaltende Kupplung" MAP 0x24402C kf_si16_S6_S3 12.75 UMR_BAR__1_1000_0_S6_S3 0 12.75
 /begin AXIS_DESCR STD_AXIS iSasZentr.iSchaltend.n_tkf UMR_U_MIN_32_1_0_S6_S3 8 0 8160 DEPOSIT ABSOLUTE MONOTONY MON_INCREASE /end AXIS_DESCR
 /begin AXIS_DESCR STD_AXIS zff_atsys._.iSignale._.obj.sig_m_t UMR_NM__1_1_0_S6_S3 10 -400 1640 DEPOSIT ABSOLUTE MONOTONY MON_INCREASE /end AXIS_DESCR
/end CHARACTERISTIC
/begin CHARACTERISTIC KF_TSYNMTNTKABV54 "Zeit vor sync. Ende Haltephase vorb. KAB" MAP 0x2440F8 kf_si16_S6_S3 5000 UMR_MSEC__10_1_0_S6_S3 -5000 0
 /begin AXIS_DESCR STD_AXIS zff_atsys._.iSignale._.obj.sig_m_t UMR_NM__1_1_0_S6_S3 4 -400 1640 DEPOSIT ABSOLUTE MONOTONY MON_INCREASE /end AXIS_DESCR
 /begin AXIS_DESCR STD_AXIS zff_atsys._.iSignale._.obj.sig_n_t UMR_U_MIN_1_1_0_S6_S3 6 0 8160 DEPOSIT ABSOLUTE MONOTONY MON_INCREASE /end AXIS_DESCR
/end CHARACTERISTIC
/begin CHARACTERISTIC KL_TRAMTHINSYNKAB54 "Zeit fuer Abschalten KAB nach Haltephase in Synchron" CURVE 0x244144 kl_ui8_S6_S3 2550 UMR_MSEC__10_1_0_S6_S3 0 2550
 /begin AXIS_DESCR STD_AXIS zff_atsys._.iSignale._.obj.sig_m_t8 UMR_NM__8_1_M50_S6_S3 4 -400 1640 DEPOSIT ABSOLUTE MONOTONY MON_INCREASE /end AXIS_DESCR
/end CHARACTERISTIC
/begin CHARACTERISTIC KF_POHINSYNKAB54 "Kennfeld Haltedruckoffset(n_tkf, m_t) bei Haltephase in Synchron" MAP 0x244150 kf_si16_S6_S3 12.75 UMR_BAR__1_1000_0_S6_S3 -6.4 6.35
 /begin AXIS_DESCR STD_AXIS iSasZentr.iSchaltend.n_tkf UMR_U_MIN_32_1_0_S6_S3 6 0 8160 DEPOSIT ABSOLUTE MONOTONY MON_INCREASE /end AXIS_DESCR
 /begin AXIS_DESCR STD_AXIS zff_atsys._.iSignale._.obj.sig_m_t UMR_NM__1_1_0_S6_S3 6 -400 1640 DEPOSIT ABSOLUTE MONOTONY MON_INCREASE /end AXIS_DESCR
/end CHARACTERISTIC
/begin CHARACTERISTIC T_HINSYN54 "Zeit fuer Ende Haltephase in Synchron KZU/KAB" VALUE 0x26E754 kw_ui8_S6_S3 2540 UMR_MSEC__10_1_0_S6_S3 0 2540 /end CHARACTERISTIC
/begin CHARACTERISTIC KL_POHKAB65 "Druckoffset waehrend Haltedruckphase" CURVE 0x2441B8 kl_si16_S6_S3 12.75 UMR_BAR__1_1000_0_S6_S3 -6.4 6.35
 /begin AXIS_DESCR STD_AXIS zff_atsys._.iSignale._.obj.sig_m_t8 UMR_NM__8_1_M50_S6_S3 4 -400 1640 DEPOSIT ABSOLUTE MONOTONY MON_INCREASE /end AXIS_DESCR
/end CHARACTERISTIC
/begin CHARACTERISTIC KL_POHKAB65_EL "Druckoffset waehrend Haltedruckphase" CURVE 0x2441CC kl_si16_S6_S3 12.75 UMR_BAR__1_1000_0_S6_S3 -6.4 6.35
 /begin AXIS_DESCR STD_AXIS zff_atsys._.iSignale._.obj.sig_m_t8 UMR_NM__8_1_M50_S6_S3 4 -400 1640 DEPOSIT ABSOLUTE MONOTONY MON_INCREASE /end AXIS_DESCR
/end CHARACTERISTIC
/begin CHARACTERISTIC F_PRAHKAB65 "Druckfaktor waehrend Rampe auf Schaltdruck" VALUE 0x26E755 kw_ui8_S6_S3 1 UMR___1_100_0_S6_S3 0 1 /end CHARACTERISTIC
/begin CHARACTERISTIC F_PRAHKAB65_EL "Druckfaktor waehrend Rampe auf Schaltdruck" VALUE 0x26E756 kw_ui8_S6_S3 1 UMR___1_100_0_S6_S3 0 1 /end CHARACTERISTIC
/begin CHARACTERISTIC F_TRAHKAB65 "Zeitfaktor waehrend Rampe auf Schaltdruck" VALUE 0x26E757 kw_ui8_S6_S3 1 UMR___1_100_0_S6_S3 0 1 /end CHARACTERISTIC
/begin CHARACTERISTIC F_TRAHKAB65_EL "Zeitfaktor waehrend Rampe auf Schaltdruck" VALUE 0x26E758 kw_ui8_S6_S3 1 UMR___1_100_0_S6_S3 0 1 /end CHARACTERISTIC
/begin CHARACTERISTIC KL_TRAHKAB65 "Zeit fuer Rampe auf Schaltdruck" CURVE 0x2441E0 kl_ui8_S6_S3 2540 UMR_MSEC__10_1_0_S6_S3 0 2540
 /begin AXIS_DESCR STD_AXIS zff_atsys._.iSignale._.obj.sig_m_t8 UMR_NM__8_1_M50_S6_S3 4 -400 1640 DEPOSIT ABSOLUTE MONOTONY MON_INCREASE /end AXIS_DESCR
/end CHARACTERISTIC
/begin CHARACTERISTIC KL_TRAHKAB65_EL "Zeit fuer Rampe auf Schaltdruck" CURVE 0x2441EC kl_ui8_S6_S3 2540 UMR_MSEC__10_1_0_S6_S3 0 2540
 /begin AXIS_DESCR STD_AXIS zff_atsys._.iSignale._.obj.sig_m_t8 UMR_NM__8_1_M50_S6_S3 4 -400 1640 DEPOSIT ABSOLUTE MONOTONY MON_INCREASE /end AXIS_DESCR
/end CHARACTERISTIC
/begin CHARACTERISTIC KL_PGOKAB65 "Druckgradient in Abhaengigkeit von m_t" CURVE 0x2441F8 kl_si16_S6_S3 200 UMR_BAR_SEC_1_10_0_S6_S3 -100 100
 /begin AXIS_DESCR STD_AXIS zff_atsys._.iSignale._.obj.sig_m_t UMR_NM__1_1_0_S6_S3 6 -400 1640 DEPOSIT ABSOLUTE MONOTONY MON_INCREASE /end AXIS_DESCR
/end CHARACTERISTIC
/begin CHARACTERISTIC KF_TOHKABMTNT65 "Zeitoffset auf Ende SF fuer Haltephase" MAP 0x244214 kf_ui8_S6_S3 2000 UMR_MSEC__10_1_M128_S6_S3 -1000 1000
 /begin AXIS_DESCR STD_AXIS zff_atsys._.iSignale._.obj.sig_n_t8 UMR_U_MIN_32_1_0_S6_S3 4 0 8160 DEPOSIT ABSOLUTE MONOTONY MON_INCREASE /end AXIS_DESCR
 /begin AXIS_DESCR STD_AXIS zff_atsys._.iSignale._.obj.sig_m_t8 UMR_NM__8_1_M50_S6_S3 6 -400 1640 DEPOSIT ABSOLUTE MONOTONY MON_INCREASE /end AXIS_DESCR
/end CHARACTERISTIC
/begin CHARACTERISTIC KF_TOHKABMTNT65_EL "Zeitoffset auf Ende SF fuer Haltephase" MAP 0x244240 kf_ui8_S6_S3 2000 UMR_MSEC__10_1_M128_S6_S3 -1000 1000
 /begin AXIS_DESCR STD_AXIS zff_atsys._.iSignale._.obj.sig_n_t8 UMR_U_MIN_32_1_0_S6_S3 4 0 8160 DEPOSIT ABSOLUTE MONOTONY MON_INCREASE /end AXIS_DESCR
 /begin AXIS_DESCR STD_AXIS zff_atsys._.iSignale._.obj.sig_m_t8 UMR_NM__8_1_M50_S6_S3 6 -400 1640 DEPOSIT ABSOLUTE MONOTONY MON_INCREASE /end AXIS_DESCR
/end CHARACTERISTIC
/begin CHARACTERISTIC KL_TSYNMTKAB65 "Zeit vor sync. Ende Schaltdruck KAB" CURVE 0x24426C kl_ui8_S6_S3 1280 UMR_MSEC__10_1_M128_S6_S3 -1280 0
 /begin AXIS_DESCR STD_AXIS zff_atsys._.iSignale._.obj.sig_m_t8 UMR_NM__8_1_M50_S6_S3 4 -400 1640 DEPOSIT ABSOLUTE MONOTONY MON_INCREASE /end AXIS_DESCR
/end CHARACTERISTIC
/begin CHARACTERISTIC KL_TSYNMTKAB65_EL "Zeit vor sync. Ende Schaltdruck KAB" CURVE 0x244278 kl_ui8_S6_S3 1280 UMR_MSEC__10_1_M128_S6_S3 -1280 0
 /begin AXIS_DESCR STD_AXIS zff_atsys._.iSignale._.obj.sig_m_t8 UMR_NM__8_1_M50_S6_S3 4 -400 1640 DEPOSIT ABSOLUTE MONOTONY MON_INCREASE /end AXIS_DESCR
/end CHARACTERISTIC
/begin CHARACTERISTIC KF_PKAB65 "Schaltdruck abschaltende Kupplung" MAP 0x244284 kf_si16_S6_S3 12.75 UMR_BAR__1_1000_0_S6_S3 0 12.75
 /begin AXIS_DESCR STD_AXIS iSasZentr.iSchaltend.n_tkf UMR_U_MIN_32_1_0_S6_S3 8 0 8160 DEPOSIT ABSOLUTE MONOTONY MON_INCREASE /end AXIS_DESCR
 /begin AXIS_DESCR STD_AXIS zff_atsys._.iSignale._.obj.sig_m_t UMR_NM__1_1_0_S6_S3 10 -400 1640 DEPOSIT ABSOLUTE MONOTONY MON_INCREASE /end AXIS_DESCR
/end CHARACTERISTIC
/begin CHARACTERISTIC KF_PKAB65_EL "Schaltdruck abschaltende Kupplung" MAP 0x244350 kf_si16_S6_S3 12.75 UMR_BAR__1_1000_0_S6_S3 0 12.75
 /begin AXIS_DESCR STD_AXIS iSasZentr.iSchaltend.n_tkf UMR_U_MIN_32_1_0_S6_S3 8 0 8160 DEPOSIT ABSOLUTE MONOTONY MON_INCREASE /end AXIS_DESCR
 /begin AXIS_DESCR STD_AXIS zff_atsys._.iSignale._.obj.sig_m_t UMR_NM__1_1_0_S6_S3 10 -400 1640 DEPOSIT ABSOLUTE MONOTONY MON_INCREASE /end AXIS_DESCR
/end CHARACTERISTIC
/begin CHARACTERISTIC KF_TSYNMTNTKABV65 "Zeit vor sync. Ende Haltephase vorb. KAB" MAP 0x24441C kf_si16_S6_S3 5000 UMR_MSEC__10_1_0_S6_S3 -5000 0
 /begin AXIS_DESCR STD_AXIS zff_atsys._.iSignale._.obj.sig_m_t UMR_NM__1_1_0_S6_S3 4 -400 1640 DEPOSIT ABSOLUTE MONOTONY MON_INCREASE /end AXIS_DESCR
 /begin AXIS_DESCR STD_AXIS zff_atsys._.iSignale._.obj.sig_n_t UMR_U_MIN_1_1_0_S6_S3 6 0 8160 DEPOSIT ABSOLUTE MONOTONY MON_INCREASE /end AXIS_DESCR
/end CHARACTERISTIC
/begin CHARACTERISTIC KL_TRAMTHINSYNKAB65 "Zeit fuer Abschalten KAB nach Haltephase in Synchron" CURVE 0x244468 kl_ui8_S6_S3 2550 UMR_MSEC__10_1_0_S6_S3 0 2550
 /begin AXIS_DESCR STD_AXIS zff_atsys._.iSignale._.obj.sig_m_t8 UMR_NM__8_1_M50_S6_S3 4 -400 1640 DEPOSIT ABSOLUTE MONOTONY MON_INCREASE /end AXIS_DESCR
/end CHARACTERISTIC
/begin CHARACTERISTIC KF_POHINSYNKAB65 "Kennfeld Haltedruckoffset(n_tkf, m_t) bei Haltephase in Synchron" MAP 0x244474 kf_si16_S6_S3 12.75 UMR_BAR__1_1000_0_S6_S3 -6.4 6.35
 /begin AXIS_DESCR STD_AXIS iSasZentr.iSchaltend.n_tkf UMR_U_MIN_32_1_0_S6_S3 6 0 8160 DEPOSIT ABSOLUTE MONOTONY MON_INCREASE /end AXIS_DESCR
 /begin AXIS_DESCR STD_AXIS zff_atsys._.iSignale._.obj.sig_m_t UMR_NM__1_1_0_S6_S3 6 -400 1640 DEPOSIT ABSOLUTE MONOTONY MON_INCREASE /end AXIS_DESCR
/end CHARACTERISTIC
/begin CHARACTERISTIC T_HINSYN65 "Zeit fuer Ende Haltephase in Synchron KZU/KAB" VALUE 0x26E759 kw_ui8_S6_S3 2540 UMR_MSEC__10_1_0_S6_S3 0 2540 /end CHARACTERISTIC
/begin CHARACTERISTIC KL_POHKAB76 "Druckoffset waehrend Haltedruckphase" CURVE 0x2444DC kl_si16_S6_S3 12.75 UMR_BAR__1_1000_0_S6_S3 -6.4 6.35
 /begin AXIS_DESCR STD_AXIS zff_atsys._.iSignale._.obj.sig_m_t8 UMR_NM__8_1_M50_S6_S3 4 -400 1640 DEPOSIT ABSOLUTE MONOTONY MON_INCREASE /end AXIS_DESCR
/end CHARACTERISTIC
/begin CHARACTERISTIC KL_POHKAB76_EL "Druckoffset waehrend Haltedruckphase" CURVE 0x2444F0 kl_si16_S6_S3 12.75 UMR_BAR__1_1000_0_S6_S3 -6.4 6.35
 /begin AXIS_DESCR STD_AXIS zff_atsys._.iSignale._.obj.sig_m_t8 UMR_NM__8_1_M50_S6_S3 4 -400 1640 DEPOSIT ABSOLUTE MONOTONY MON_INCREASE /end AXIS_DESCR
/end CHARACTERISTIC
/begin CHARACTERISTIC F_PRAHKAB76 "Druckfaktor waehrend Rampe auf Schaltdruck" VALUE 0x26E75A kw_ui8_S6_S3 1 UMR___1_100_0_S6_S3 0 1 /end CHARACTERISTIC
/begin CHARACTERISTIC F_PRAHKAB76_EL "Druckfaktor waehrend Rampe auf Schaltdruck" VALUE 0x26E75B kw_ui8_S6_S3 1 UMR___1_100_0_S6_S3 0 1 /end CHARACTERISTIC
/begin CHARACTERISTIC F_TRAHKAB76 "Zeitfaktor waehrend Rampe auf Schaltdruck" VALUE 0x26E75C kw_ui8_S6_S3 1 UMR___1_100_0_S6_S3 0 1 /end CHARACTERISTIC
/begin CHARACTERISTIC F_TRAHKAB76_EL "Zeitfaktor waehrend Rampe auf Schaltdruck" VALUE 0x26E75D kw_ui8_S6_S3 1 UMR___1_100_0_S6_S3 0 1 /end CHARACTERISTIC
/begin CHARACTERISTIC KL_TRAHKAB76 "Zeit fuer Rampe auf Schaltdruck" CURVE 0x244504 kl_ui8_S6_S3 2540 UMR_MSEC__10_1_0_S6_S3 0 2540
 /begin AXIS_DESCR STD_AXIS zff_atsys._.iSignale._.obj.sig_m_t8 UMR_NM__8_1_M50_S6_S3 4 -400 1640 DEPOSIT ABSOLUTE MONOTONY MON_INCREASE /end AXIS_DESCR
/end CHARACTERISTIC
/begin CHARACTERISTIC KL_TRAHKAB76_EL "Zeit fuer Rampe auf Schaltdruck" CURVE 0x244510 kl_ui8_S6_S3 2540 UMR_MSEC__10_1_0_S6_S3 0 2540
 /begin AXIS_DESCR STD_AXIS zff_atsys._.iSignale._.obj.sig_m_t8 UMR_NM__8_1_M50_S6_S3 4 -400 1640 DEPOSIT ABSOLUTE MONOTONY MON_INCREASE /end AXIS_DESCR
/end CHARACTERISTIC
/begin CHARACTERISTIC KL_PGOKAB76 "Druckgradient in Abhaengigkeit von m_t" CURVE 0x24451C kl_si16_S6_S3 200 UMR_BAR_SEC_1_10_0_S6_S3 -100 100
 /begin AXIS_DESCR STD_AXIS zff_atsys._.iSignale._.obj.sig_m_t UMR_NM__1_1_0_S6_S3 6 -400 1640 DEPOSIT ABSOLUTE MONOTONY MON_INCREASE /end AXIS_DESCR
/end CHARACTERISTIC
/begin CHARACTERISTIC KF_TOHKABMTNT76 "Zeitoffset auf Ende SF fuer Haltephase" MAP 0x244538 kf_ui8_S6_S3 2000 UMR_MSEC__10_1_M128_S6_S3 -1000 1000
 /begin AXIS_DESCR STD_AXIS zff_atsys._.iSignale._.obj.sig_n_t8 UMR_U_MIN_32_1_0_S6_S3 4 0 8160 DEPOSIT ABSOLUTE MONOTONY MON_INCREASE /end AXIS_DESCR
 /begin AXIS_DESCR STD_AXIS zff_atsys._.iSignale._.obj.sig_m_t8 UMR_NM__8_1_M50_S6_S3 6 -400 1640 DEPOSIT ABSOLUTE MONOTONY MON_INCREASE /end AXIS_DESCR
/end CHARACTERISTIC
/begin CHARACTERISTIC KF_TOHKABMTNT76_EL "Zeitoffset auf Ende SF fuer Haltephase" MAP 0x244564 kf_ui8_S6_S3 2000 UMR_MSEC__10_1_M128_S6_S3 -1000 1000
 /begin AXIS_DESCR STD_AXIS zff_atsys._.iSignale._.obj.sig_n_t8 UMR_U_MIN_32_1_0_S6_S3 4 0 8160 DEPOSIT ABSOLUTE MONOTONY MON_INCREASE /end AXIS_DESCR
 /begin AXIS_DESCR STD_AXIS zff_atsys._.iSignale._.obj.sig_m_t8 UMR_NM__8_1_M50_S6_S3 6 -400 1640 DEPOSIT ABSOLUTE MONOTONY MON_INCREASE /end AXIS_DESCR
/end CHARACTERISTIC
/begin CHARACTERISTIC KL_TSYNMTKAB76 "Zeit vor sync. Ende Schaltdruck KAB" CURVE 0x244590 kl_ui8_S6_S3 1280 UMR_MSEC__10_1_M128_S6_S3 -1280 0
 /begin AXIS_DESCR STD_AXIS zff_atsys._.iSignale._.obj.sig_m_t8 UMR_NM__8_1_M50_S6_S3 4 -400 1640 DEPOSIT ABSOLUTE MONOTONY MON_INCREASE /end AXIS_DESCR
/end CHARACTERISTIC
/begin CHARACTERISTIC KL_TSYNMTKAB76_EL "Zeit vor sync. Ende Schaltdruck KAB" CURVE 0x24459C kl_ui8_S6_S3 1280 UMR_MSEC__10_1_M128_S6_S3 -1280 0
 /begin AXIS_DESCR STD_AXIS zff_atsys._.iSignale._.obj.sig_m_t8 UMR_NM__8_1_M50_S6_S3 4 -400 1640 DEPOSIT ABSOLUTE MONOTONY MON_INCREASE /end AXIS_DESCR
/end CHARACTERISTIC
/begin CHARACTERISTIC KF_PKAB76 "Schaltdruck abschaltende Kupplung" MAP 0x2445A8 kf_si16_S6_S3 12.75 UMR_BAR__1_1000_0_S6_S3 0 12.75
 /begin AXIS_DESCR STD_AXIS iSasZentr.iSchaltend.n_tkf UMR_U_MIN_32_1_0_S6_S3 8 0 8160 DEPOSIT ABSOLUTE MONOTONY MON_INCREASE /end AXIS_DESCR
 /begin AXIS_DESCR STD_AXIS zff_atsys._.iSignale._.obj.sig_m_t UMR_NM__1_1_0_S6_S3 10 -400 1640 DEPOSIT ABSOLUTE MONOTONY MON_INCREASE /end AXIS_DESCR
/end CHARACTERISTIC
/begin CHARACTERISTIC KF_PKAB76_EL "Schaltdruck abschaltende Kupplung" MAP 0x244674 kf_si16_S6_S3 12.75 UMR_BAR__1_1000_0_S6_S3 0 12.75
 /begin AXIS_DESCR STD_AXIS iSasZentr.iSchaltend.n_tkf UMR_U_MIN_32_1_0_S6_S3 8 0 8160 DEPOSIT ABSOLUTE MONOTONY MON_INCREASE /end AXIS_DESCR
 /begin AXIS_DESCR STD_AXIS zff_atsys._.iSignale._.obj.sig_m_t UMR_NM__1_1_0_S6_S3 10 -400 1640 DEPOSIT ABSOLUTE MONOTONY MON_INCREASE /end AXIS_DESCR
/end CHARACTERISTIC
/begin CHARACTERISTIC KF_TSYNMTNTKABV76 "Zeit vor sync. Ende Haltephase vorb. KAB" MAP 0x244740 kf_si16_S6_S3 5000 UMR_MSEC__10_1_0_S6_S3 -5000 0
 /begin AXIS_DESCR STD_AXIS zff_atsys._.iSignale._.obj.sig_m_t UMR_NM__1_1_0_S6_S3 4 -400 1640 DEPOSIT ABSOLUTE MONOTONY MON_INCREASE /end AXIS_DESCR
 /begin AXIS_DESCR STD_AXIS zff_atsys._.iSignale._.obj.sig_n_t UMR_U_MIN_1_1_0_S6_S3 6 0 8160 DEPOSIT ABSOLUTE MONOTONY MON_INCREASE /end AXIS_DESCR
/end CHARACTERISTIC
/begin CHARACTERISTIC KL_TRAMTHINSYNKAB76 "Zeit fuer Abschalten KAB nach Haltephase in Synchron" CURVE 0x24478C kl_ui8_S6_S3 2550 UMR_MSEC__10_1_0_S6_S3 0 2550
 /begin AXIS_DESCR STD_AXIS zff_atsys._.iSignale._.obj.sig_m_t8 UMR_NM__8_1_M50_S6_S3 4 -400 1640 DEPOSIT ABSOLUTE MONOTONY MON_INCREASE /end AXIS_DESCR
/end CHARACTERISTIC
/begin CHARACTERISTIC KF_POHINSYNKAB76 "Kennfeld Haltedruckoffset(n_tkf, m_t) bei Haltephase in Synchron" MAP 0x244798 kf_si16_S6_S3 12.75 UMR_BAR__1_1000_0_S6_S3 -6.4 6.35
 /begin AXIS_DESCR STD_AXIS iSasZentr.iSchaltend.n_tkf UMR_U_MIN_32_1_0_S6_S3 6 0 8160 DEPOSIT ABSOLUTE MONOTONY MON_INCREASE /end AXIS_DESCR
 /begin AXIS_DESCR STD_AXIS zff_atsys._.iSignale._.obj.sig_m_t UMR_NM__1_1_0_S6_S3 6 -400 1640 DEPOSIT ABSOLUTE MONOTONY MON_INCREASE /end AXIS_DESCR
/end CHARACTERISTIC
/begin CHARACTERISTIC T_HINSYN76 "Zeit fuer Ende Haltephase in Synchron KZU/KAB" VALUE 0x26E75E kw_ui8_S6_S3 2540 UMR_MSEC__10_1_0_S6_S3 0 2540 /end CHARACTERISTIC
/begin CHARACTERISTIC KL_POHKAB87 "Druckoffset waehrend Haltedruckphase" CURVE 0x244800 kl_si16_S6_S3 12.75 UMR_BAR__1_1000_0_S6_S3 -6.4 6.35
 /begin AXIS_DESCR STD_AXIS zff_atsys._.iSignale._.obj.sig_m_t8 UMR_NM__8_1_M50_S6_S3 4 -400 1640 DEPOSIT ABSOLUTE MONOTONY MON_INCREASE /end AXIS_DESCR
/end CHARACTERISTIC
/begin CHARACTERISTIC KL_POHKAB87_EL "Druckoffset waehrend Haltedruckphase" CURVE 0x244814 kl_si16_S6_S3 12.75 UMR_BAR__1_1000_0_S6_S3 -6.4 6.35
 /begin AXIS_DESCR STD_AXIS zff_atsys._.iSignale._.obj.sig_m_t8 UMR_NM__8_1_M50_S6_S3 4 -400 1640 DEPOSIT ABSOLUTE MONOTONY MON_INCREASE /end AXIS_DESCR
/end CHARACTERISTIC
/begin CHARACTERISTIC F_PRAHKAB87 "Druckfaktor waehrend Rampe auf Schaltdruck" VALUE 0x26E75F kw_ui8_S6_S3 1 UMR___1_100_0_S6_S3 0 1 /end CHARACTERISTIC
/begin CHARACTERISTIC F_PRAHKAB87_EL "Druckfaktor waehrend Rampe auf Schaltdruck" VALUE 0x26E760 kw_ui8_S6_S3 1 UMR___1_100_0_S6_S3 0 1 /end CHARACTERISTIC
/begin CHARACTERISTIC F_TRAHKAB87 "Zeitfaktor waehrend Rampe auf Schaltdruck" VALUE 0x26E761 kw_ui8_S6_S3 1 UMR___1_100_0_S6_S3 0 1 /end CHARACTERISTIC
/begin CHARACTERISTIC F_TRAHKAB87_EL "Zeitfaktor waehrend Rampe auf Schaltdruck" VALUE 0x26E762 kw_ui8_S6_S3 1 UMR___1_100_0_S6_S3 0 1 /end CHARACTERISTIC
/begin CHARACTERISTIC KL_TRAHKAB87 "Zeit fuer Rampe auf Schaltdruck" CURVE 0x244828 kl_ui8_S6_S3 2540 UMR_MSEC__10_1_0_S6_S3 0 2540
 /begin AXIS_DESCR STD_AXIS zff_atsys._.iSignale._.obj.sig_m_t8 UMR_NM__8_1_M50_S6_S3 4 -400 1640 DEPOSIT ABSOLUTE MONOTONY MON_INCREASE /end AXIS_DESCR
/end CHARACTERISTIC
/begin CHARACTERISTIC KL_TRAHKAB87_EL "Zeit fuer Rampe auf Schaltdruck" CURVE 0x244834 kl_ui8_S6_S3 2540 UMR_MSEC__10_1_0_S6_S3 0 2540
 /begin AXIS_DESCR STD_AXIS zff_atsys._.iSignale._.obj.sig_m_t8 UMR_NM__8_1_M50_S6_S3 4 -400 1640 DEPOSIT ABSOLUTE MONOTONY MON_INCREASE /end AXIS_DESCR
/end CHARACTERISTIC
/begin CHARACTERISTIC KL_PGOKAB87 "Druckgradient in Abhaengigkeit von m_t" CURVE 0x244840 kl_si16_S6_S3 200 UMR_BAR_SEC_1_10_0_S6_S3 -100 100
 /begin AXIS_DESCR STD_AXIS zff_atsys._.iSignale._.obj.sig_m_t UMR_NM__1_1_0_S6_S3 6 -400 1640 DEPOSIT ABSOLUTE MONOTONY MON_INCREASE /end AXIS_DESCR
/end CHARACTERISTIC
/begin CHARACTERISTIC KF_TOHKABMTNT87 "Zeitoffset auf Ende SF fuer Haltephase" MAP 0x24485C kf_ui8_S6_S3 2000 UMR_MSEC__10_1_M128_S6_S3 -1000 1000
 /begin AXIS_DESCR STD_AXIS zff_atsys._.iSignale._.obj.sig_n_t8 UMR_U_MIN_32_1_0_S6_S3 4 0 8160 DEPOSIT ABSOLUTE MONOTONY MON_INCREASE /end AXIS_DESCR
 /begin AXIS_DESCR STD_AXIS zff_atsys._.iSignale._.obj.sig_m_t8 UMR_NM__8_1_M50_S6_S3 6 -400 1640 DEPOSIT ABSOLUTE MONOTONY MON_INCREASE /end AXIS_DESCR
/end CHARACTERISTIC
/begin CHARACTERISTIC KF_TOHKABMTNT87_EL "Zeitoffset auf Ende SF fuer Haltephase" MAP 0x244888 kf_ui8_S6_S3 2000 UMR_MSEC__10_1_M128_S6_S3 -1000 1000
 /begin AXIS_DESCR STD_AXIS zff_atsys._.iSignale._.obj.sig_n_t8 UMR_U_MIN_32_1_0_S6_S3 4 0 8160 DEPOSIT ABSOLUTE MONOTONY MON_INCREASE /end AXIS_DESCR
 /begin AXIS_DESCR STD_AXIS zff_atsys._.iSignale._.obj.sig_m_t8 UMR_NM__8_1_M50_S6_S3 6 -400 1640 DEPOSIT ABSOLUTE MONOTONY MON_INCREASE /end AXIS_DESCR
/end CHARACTERISTIC
/begin CHARACTERISTIC KL_TSYNMTKAB87 "Zeit vor sync. Ende Schaltdruck KAB" CURVE 0x2448B4 kl_ui8_S6_S3 1280 UMR_MSEC__10_1_M128_S6_S3 -1280 0
 /begin AXIS_DESCR STD_AXIS zff_atsys._.iSignale._.obj.sig_m_t8 UMR_NM__8_1_M50_S6_S3 4 -400 1640 DEPOSIT ABSOLUTE MONOTONY MON_INCREASE /end AXIS_DESCR
/end CHARACTERISTIC
/begin CHARACTERISTIC KL_TSYNMTKAB87_EL "Zeit vor sync. Ende Schaltdruck KAB" CURVE 0x2448C0 kl_ui8_S6_S3 1280 UMR_MSEC__10_1_M128_S6_S3 -1280 0
 /begin AXIS_DESCR STD_AXIS zff_atsys._.iSignale._.obj.sig_m_t8 UMR_NM__8_1_M50_S6_S3 4 -400 1640 DEPOSIT ABSOLUTE MONOTONY MON_INCREASE /end AXIS_DESCR
/end CHARACTERISTIC
/begin CHARACTERISTIC KF_PKAB87 "Schaltdruck abschaltende Kupplung" MAP 0x2448CC kf_si16_S6_S3 12.75 UMR_BAR__1_1000_0_S6_S3 0 12.75
 /begin AXIS_DESCR STD_AXIS iSasZentr.iSchaltend.n_tkf UMR_U_MIN_32_1_0_S6_S3 8 0 8160 DEPOSIT ABSOLUTE MONOTONY MON_INCREASE /end AXIS_DESCR
 /begin AXIS_DESCR STD_AXIS zff_atsys._.iSignale._.obj.sig_m_t UMR_NM__1_1_0_S6_S3 10 -400 1640 DEPOSIT ABSOLUTE MONOTONY MON_INCREASE /end AXIS_DESCR
/end CHARACTERISTIC
/begin CHARACTERISTIC KF_PKAB87_EL "Schaltdruck abschaltende Kupplung" MAP 0x244998 kf_si16_S6_S3 12.75 UMR_BAR__1_1000_0_S6_S3 0 12.75
 /begin AXIS_DESCR STD_AXIS iSasZentr.iSchaltend.n_tkf UMR_U_MIN_32_1_0_S6_S3 8 0 8160 DEPOSIT ABSOLUTE MONOTONY MON_INCREASE /end AXIS_DESCR
 /begin AXIS_DESCR STD_AXIS zff_atsys._.iSignale._.obj.sig_m_t UMR_NM__1_1_0_S6_S3 10 -400 1640 DEPOSIT ABSOLUTE MONOTONY MON_INCREASE /end AXIS_DESCR
/end CHARACTERISTIC
/begin CHARACTERISTIC KF_TSYNMTNTKABV87 "Zeit vor sync. Ende Haltephase vorb. KAB" MAP 0x244A64 kf_si16_S6_S3 5000 UMR_MSEC__10_1_0_S6_S3 -5000 0
 /begin AXIS_DESCR STD_AXIS zff_atsys._.iSignale._.obj.sig_m_t UMR_NM__1_1_0_S6_S3 4 -400 1640 DEPOSIT ABSOLUTE MONOTONY MON_INCREASE /end AXIS_DESCR
 /begin AXIS_DESCR STD_AXIS zff_atsys._.iSignale._.obj.sig_n_t UMR_U_MIN_1_1_0_S6_S3 6 0 8160 DEPOSIT ABSOLUTE MONOTONY MON_INCREASE /end AXIS_DESCR
/end CHARACTERISTIC
/begin CHARACTERISTIC KL_TRAMTHINSYNKAB87 "Zeit fuer Abschalten KAB nach Haltephase in Synchron" CURVE 0x244AB0 kl_ui8_S6_S3 2550 UMR_MSEC__10_1_0_S6_S3 0 2550
 /begin AXIS_DESCR STD_AXIS zff_atsys._.iSignale._.obj.sig_m_t8 UMR_NM__8_1_M50_S6_S3 4 -400 1640 DEPOSIT ABSOLUTE MONOTONY MON_INCREASE /end AXIS_DESCR
/end CHARACTERISTIC
/begin CHARACTERISTIC KF_POHINSYNKAB87 "Kennfeld Haltedruckoffset(n_tkf, m_t) bei Haltephase in Synchron" MAP 0x244ABC kf_si16_S6_S3 12.75 UMR_BAR__1_1000_0_S6_S3 -6.4 6.35
 /begin AXIS_DESCR STD_AXIS iSasZentr.iSchaltend.n_tkf UMR_U_MIN_32_1_0_S6_S3 6 0 8160 DEPOSIT ABSOLUTE MONOTONY MON_INCREASE /end AXIS_DESCR
 /begin AXIS_DESCR STD_AXIS zff_atsys._.iSignale._.obj.sig_m_t UMR_NM__1_1_0_S6_S3 6 -400 1640 DEPOSIT ABSOLUTE MONOTONY MON_INCREASE /end AXIS_DESCR
/end CHARACTERISTIC
/begin CHARACTERISTIC T_HINSYN87 "Zeit fuer Ende Haltephase in Synchron KZU/KAB" VALUE 0x26E763 kw_ui8_S6_S3 2540 UMR_MSEC__10_1_0_S6_S3 0 2540 /end CHARACTERISTIC
/begin CHARACTERISTIC KL_POHKABSP21 "Druckoffset waehrend Haltedruckphase" CURVE 0x244B24 kl_si16_S6_S3 12.75 UMR_BAR__1_1000_0_S6_S3 -6.4 6.35
 /begin AXIS_DESCR STD_AXIS zff_atsys._.iSignale._.obj.sig_m_t8 UMR_NM__8_1_M50_S6_S3 4 -400 1640 DEPOSIT ABSOLUTE MONOTONY MON_INCREASE /end AXIS_DESCR
/end CHARACTERISTIC
/begin CHARACTERISTIC F_PRAHKABSP21 "Druckfaktor waehrend Rampe auf Schaltdruck" VALUE 0x26E764 kw_ui8_S6_S3 1 UMR___1_100_0_S6_S3 0 1 /end CHARACTERISTIC
/begin CHARACTERISTIC F_TRAHKABSP21 "Zeitfaktor waehrend Rampe auf Schaltdruck" VALUE 0x26E765 kw_ui8_S6_S3 1 UMR___1_100_0_S6_S3 0 1 /end CHARACTERISTIC
/begin CHARACTERISTIC KL_TRAHKABSP21 "Zeit fuer Rampe auf Schaltdruck" CURVE 0x244B38 kl_ui8_S6_S3 2540 UMR_MSEC__10_1_0_S6_S3 0 2540
 /begin AXIS_DESCR STD_AXIS zff_atsys._.iSignale._.obj.sig_m_t8 UMR_NM__8_1_M50_S6_S3 4 -400 1640 DEPOSIT ABSOLUTE MONOTONY MON_INCREASE /end AXIS_DESCR
/end CHARACTERISTIC
/begin CHARACTERISTIC KL_PGOKABSP21 "Druckgradient in Abhaengigkeit von m_t" CURVE 0x244B44 kl_si16_S6_S3 200 UMR_BAR_SEC_1_10_0_S6_S3 -100 100
 /begin AXIS_DESCR STD_AXIS zff_atsys._.iSignale._.obj.sig_m_t UMR_NM__1_1_0_S6_S3 6 -400 1640 DEPOSIT ABSOLUTE MONOTONY MON_INCREASE /end AXIS_DESCR
/end CHARACTERISTIC
/begin CHARACTERISTIC KF_TOHKABMTNTSP21 "Zeitoffset auf Ende SF fuer Haltephase" MAP 0x244B60 kf_ui8_S6_S3 2000 UMR_MSEC__10_1_M128_S6_S3 -1000 1000
 /begin AXIS_DESCR STD_AXIS zff_atsys._.iSignale._.obj.sig_n_t8 UMR_U_MIN_32_1_0_S6_S3 4 0 8160 DEPOSIT ABSOLUTE MONOTONY MON_INCREASE /end AXIS_DESCR
 /begin AXIS_DESCR STD_AXIS zff_atsys._.iSignale._.obj.sig_m_t8 UMR_NM__8_1_M50_S6_S3 6 -400 1640 DEPOSIT ABSOLUTE MONOTONY MON_INCREASE /end AXIS_DESCR
/end CHARACTERISTIC
/begin CHARACTERISTIC KL_TSYNMTKABSP21 "Zeit vor sync. Ende Schaltdruck KAB" CURVE 0x244B8C kl_ui8_S6_S3 1280 UMR_MSEC__10_1_M128_S6_S3 -1280 0
 /begin AXIS_DESCR STD_AXIS zff_atsys._.iSignale._.obj.sig_m_t8 UMR_NM__8_1_M50_S6_S3 4 -400 1640 DEPOSIT ABSOLUTE MONOTONY MON_INCREASE /end AXIS_DESCR
/end CHARACTERISTIC
/begin CHARACTERISTIC KF_PKABSP21 "Schaltdruck abschaltende Kupplung" MAP 0x244B98 kf_si16_S6_S3 12.75 UMR_BAR__1_1000_0_S6_S3 0 12.75
 /begin AXIS_DESCR STD_AXIS iSasZentr.iSchaltend.n_tkf UMR_U_MIN_32_1_0_S6_S3 8 0 8160 DEPOSIT ABSOLUTE MONOTONY MON_INCREASE /end AXIS_DESCR
 /begin AXIS_DESCR STD_AXIS zff_atsys._.iSignale._.obj.sig_m_t UMR_NM__1_1_0_S6_S3 10 -400 1640 DEPOSIT ABSOLUTE MONOTONY MON_INCREASE /end AXIS_DESCR
/end CHARACTERISTIC
/begin CHARACTERISTIC KF_TSYNMTNTKABVSP21 "Zeit vor sync. Ende Haltephase vorb. KAB" MAP 0x244C64 kf_si16_S6_S3 5000 UMR_MSEC__10_1_0_S6_S3 -5000 0
 /begin AXIS_DESCR STD_AXIS zff_atsys._.iSignale._.obj.sig_m_t UMR_NM__1_1_0_S6_S3 4 -400 1640 DEPOSIT ABSOLUTE MONOTONY MON_INCREASE /end AXIS_DESCR
 /begin AXIS_DESCR STD_AXIS zff_atsys._.iSignale._.obj.sig_n_t UMR_U_MIN_1_1_0_S6_S3 6 0 8160 DEPOSIT ABSOLUTE MONOTONY MON_INCREASE /end AXIS_DESCR
/end CHARACTERISTIC
/begin CHARACTERISTIC KL_TRAMTHINSYNKABSP21 "Zeit fuer Abschalten KAB nach Haltephase in Synchron" CURVE 0x244CB0 kl_ui8_S6_S3 2550 UMR_MSEC__10_1_0_S6_S3 0 2550
 /begin AXIS_DESCR STD_AXIS zff_atsys._.iSignale._.obj.sig_m_t8 UMR_NM__8_1_M50_S6_S3 4 -400 1640 DEPOSIT ABSOLUTE MONOTONY MON_INCREASE /end AXIS_DESCR
/end CHARACTERISTIC
/begin CHARACTERISTIC KF_POHINSYNKABSP21 "Kennfeld Haltedruckoffset(n_tkf, m_t) bei Haltephase in Synchron" MAP 0x244CBC kf_si16_S6_S3 12.75 UMR_BAR__1_1000_0_S6_S3 -6.4 6.35
 /begin AXIS_DESCR STD_AXIS iSasZentr.iSchaltend.n_tkf UMR_U_MIN_32_1_0_S6_S3 6 0 8160 DEPOSIT ABSOLUTE MONOTONY MON_INCREASE /end AXIS_DESCR
 /begin AXIS_DESCR STD_AXIS zff_atsys._.iSignale._.obj.sig_m_t UMR_NM__1_1_0_S6_S3 6 -400 1640 DEPOSIT ABSOLUTE MONOTONY MON_INCREASE /end AXIS_DESCR
/end CHARACTERISTIC
/begin CHARACTERISTIC T_HINSYNSP21 "Zeit fuer Ende Haltephase in Synchron KZU/KAB" VALUE 0x26E766 kw_ui8_S6_S3 2540 UMR_MSEC__10_1_0_S6_S3 0 2540 /end CHARACTERISTIC
/begin CHARACTERISTIC KL_POHKABSP32 "Druckoffset waehrend Haltedruckphase" CURVE 0x244D24 kl_si16_S6_S3 12.75 UMR_BAR__1_1000_0_S6_S3 -6.4 6.35
 /begin AXIS_DESCR STD_AXIS zff_atsys._.iSignale._.obj.sig_m_t8 UMR_NM__8_1_M50_S6_S3 4 -400 1640 DEPOSIT ABSOLUTE MONOTONY MON_INCREASE /end AXIS_DESCR
/end CHARACTERISTIC
/begin CHARACTERISTIC F_PRAHKABSP32 "Druckfaktor waehrend Rampe auf Schaltdruck" VALUE 0x26E767 kw_ui8_S6_S3 1 UMR___1_100_0_S6_S3 0 1 /end CHARACTERISTIC
/begin CHARACTERISTIC F_TRAHKABSP32 "Zeitfaktor waehrend Rampe auf Schaltdruck" VALUE 0x26E768 kw_ui8_S6_S3 1 UMR___1_100_0_S6_S3 0 1 /end CHARACTERISTIC
/begin CHARACTERISTIC KL_TRAHKABSP32 "Zeit fuer Rampe auf Schaltdruck" CURVE 0x244D38 kl_ui8_S6_S3 2540 UMR_MSEC__10_1_0_S6_S3 0 2540
 /begin AXIS_DESCR STD_AXIS zff_atsys._.iSignale._.obj.sig_m_t8 UMR_NM__8_1_M50_S6_S3 4 -400 1640 DEPOSIT ABSOLUTE MONOTONY MON_INCREASE /end AXIS_DESCR
/end CHARACTERISTIC
/begin CHARACTERISTIC KL_PGOKABSP32 "Druckgradient in Abhaengigkeit von m_t" CURVE 0x244D44 kl_si16_S6_S3 200 UMR_BAR_SEC_1_10_0_S6_S3 -100 100
 /begin AXIS_DESCR STD_AXIS zff_atsys._.iSignale._.obj.sig_m_t UMR_NM__1_1_0_S6_S3 6 -400 1640 DEPOSIT ABSOLUTE MONOTONY MON_INCREASE /end AXIS_DESCR
/end CHARACTERISTIC
/begin CHARACTERISTIC KF_TOHKABMTNTSP32 "Zeitoffset auf Ende SF fuer Haltephase" MAP 0x244D60 kf_ui8_S6_S3 2000 UMR_MSEC__10_1_M128_S6_S3 -1000 1000
 /begin AXIS_DESCR STD_AXIS zff_atsys._.iSignale._.obj.sig_n_t8 UMR_U_MIN_32_1_0_S6_S3 4 0 8160 DEPOSIT ABSOLUTE MONOTONY MON_INCREASE /end AXIS_DESCR
 /begin AXIS_DESCR STD_AXIS zff_atsys._.iSignale._.obj.sig_m_t8 UMR_NM__8_1_M50_S6_S3 6 -400 1640 DEPOSIT ABSOLUTE MONOTONY MON_INCREASE /end AXIS_DESCR
/end CHARACTERISTIC
/begin CHARACTERISTIC KL_TSYNMTKABSP32 "Zeit vor sync. Ende Schaltdruck KAB" CURVE 0x244D8C kl_ui8_S6_S3 1280 UMR_MSEC__10_1_M128_S6_S3 -1280 0
 /begin AXIS_DESCR STD_AXIS zff_atsys._.iSignale._.obj.sig_m_t8 UMR_NM__8_1_M50_S6_S3 4 -400 1640 DEPOSIT ABSOLUTE MONOTONY MON_INCREASE /end AXIS_DESCR
/end CHARACTERISTIC
/begin CHARACTERISTIC KF_PKABSP32 "Schaltdruck abschaltende Kupplung" MAP 0x244D98 kf_si16_S6_S3 12.75 UMR_BAR__1_1000_0_S6_S3 0 12.75
 /begin AXIS_DESCR STD_AXIS iSasZentr.iSchaltend.n_tkf UMR_U_MIN_32_1_0_S6_S3 8 0 8160 DEPOSIT ABSOLUTE MONOTONY MON_INCREASE /end AXIS_DESCR
 /begin AXIS_DESCR STD_AXIS zff_atsys._.iSignale._.obj.sig_m_t UMR_NM__1_1_0_S6_S3 10 -400 1640 DEPOSIT ABSOLUTE MONOTONY MON_INCREASE /end AXIS_DESCR
/end CHARACTERISTIC
/begin CHARACTERISTIC KF_TSYNMTNTKABVSP32 "Zeit vor sync. Ende Haltephase vorb. KAB" MAP 0x244E64 kf_si16_S6_S3 5000 UMR_MSEC__10_1_0_S6_S3 -5000 0
 /begin AXIS_DESCR STD_AXIS zff_atsys._.iSignale._.obj.sig_m_t UMR_NM__1_1_0_S6_S3 4 -400 1640 DEPOSIT ABSOLUTE MONOTONY MON_INCREASE /end AXIS_DESCR
 /begin AXIS_DESCR STD_AXIS zff_atsys._.iSignale._.obj.sig_n_t UMR_U_MIN_1_1_0_S6_S3 6 0 8160 DEPOSIT ABSOLUTE MONOTONY MON_INCREASE /end AXIS_DESCR
/end CHARACTERISTIC
/begin CHARACTERISTIC KL_TRAMTHINSYNKABSP32 "Zeit fuer Abschalten KAB nach Haltephase in Synchron" CURVE 0x244EB0 kl_ui8_S6_S3 2550 UMR_MSEC__10_1_0_S6_S3 0 2550
 /begin AXIS_DESCR STD_AXIS zff_atsys._.iSignale._.obj.sig_m_t8 UMR_NM__8_1_M50_S6_S3 4 -400 1640 DEPOSIT ABSOLUTE MONOTONY MON_INCREASE /end AXIS_DESCR
/end CHARACTERISTIC
/begin CHARACTERISTIC KF_POHINSYNKABSP32 "Kennfeld Haltedruckoffset(n_tkf, m_t) bei Haltephase in Synchron" MAP 0x244EBC kf_si16_S6_S3 12.75 UMR_BAR__1_1000_0_S6_S3 -6.4 6.35
 /begin AXIS_DESCR STD_AXIS iSasZentr.iSchaltend.n_tkf UMR_U_MIN_32_1_0_S6_S3 6 0 8160 DEPOSIT ABSOLUTE MONOTONY MON_INCREASE /end AXIS_DESCR
 /begin AXIS_DESCR STD_AXIS zff_atsys._.iSignale._.obj.sig_m_t UMR_NM__1_1_0_S6_S3 6 -400 1640 DEPOSIT ABSOLUTE MONOTONY MON_INCREASE /end AXIS_DESCR
/end CHARACTERISTIC
/begin CHARACTERISTIC T_HINSYNSP32 "Zeit fuer Ende Haltephase in Synchron KZU/KAB" VALUE 0x26E769 kw_ui8_S6_S3 2540 UMR_MSEC__10_1_0_S6_S3 0 2540 /end CHARACTERISTIC
/begin CHARACTERISTIC KL_POHKABSP43 "Druckoffset waehrend Haltedruckphase" CURVE 0x244F24 kl_si16_S6_S3 12.75 UMR_BAR__1_1000_0_S6_S3 -6.4 6.35
 /begin AXIS_DESCR STD_AXIS zff_atsys._.iSignale._.obj.sig_m_t8 UMR_NM__8_1_M50_S6_S3 4 -400 1640 DEPOSIT ABSOLUTE MONOTONY MON_INCREASE /end AXIS_DESCR
/end CHARACTERISTIC
/begin CHARACTERISTIC F_PRAHKABSP43 "Druckfaktor waehrend Rampe auf Schaltdruck" VALUE 0x26E76A kw_ui8_S6_S3 1 UMR___1_100_0_S6_S3 0 1 /end CHARACTERISTIC
/begin CHARACTERISTIC F_TRAHKABSP43 "Zeitfaktor waehrend Rampe auf Schaltdruck" VALUE 0x26E76B kw_ui8_S6_S3 1 UMR___1_100_0_S6_S3 0 1 /end CHARACTERISTIC
/begin CHARACTERISTIC KL_TRAHKABSP43 "Zeit fuer Rampe auf Schaltdruck" CURVE 0x244F38 kl_ui8_S6_S3 2540 UMR_MSEC__10_1_0_S6_S3 0 2540
 /begin AXIS_DESCR STD_AXIS zff_atsys._.iSignale._.obj.sig_m_t8 UMR_NM__8_1_M50_S6_S3 4 -400 1640 DEPOSIT ABSOLUTE MONOTONY MON_INCREASE /end AXIS_DESCR
/end CHARACTERISTIC
/begin CHARACTERISTIC KL_PGOKABSP43 "Druckgradient in Abhaengigkeit von m_t" CURVE 0x244F44 kl_si16_S6_S3 200 UMR_BAR_SEC_1_10_0_S6_S3 -100 100
 /begin AXIS_DESCR STD_AXIS zff_atsys._.iSignale._.obj.sig_m_t UMR_NM__1_1_0_S6_S3 6 -400 1640 DEPOSIT ABSOLUTE MONOTONY MON_INCREASE /end AXIS_DESCR
/end CHARACTERISTIC
/begin CHARACTERISTIC KF_TOHKABMTNTSP43 "Zeitoffset auf Ende SF fuer Haltephase" MAP 0x244F60 kf_ui8_S6_S3 2000 UMR_MSEC__10_1_M128_S6_S3 -1000 1000
 /begin AXIS_DESCR STD_AXIS zff_atsys._.iSignale._.obj.sig_n_t8 UMR_U_MIN_32_1_0_S6_S3 4 0 8160 DEPOSIT ABSOLUTE MONOTONY MON_INCREASE /end AXIS_DESCR
 /begin AXIS_DESCR STD_AXIS zff_atsys._.iSignale._.obj.sig_m_t8 UMR_NM__8_1_M50_S6_S3 6 -400 1640 DEPOSIT ABSOLUTE MONOTONY MON_INCREASE /end AXIS_DESCR
/end CHARACTERISTIC
/begin CHARACTERISTIC KL_TSYNMTKABSP43 "Zeit vor sync. Ende Schaltdruck KAB" CURVE 0x244F8C kl_ui8_S6_S3 1280 UMR_MSEC__10_1_M128_S6_S3 -1280 0
 /begin AXIS_DESCR STD_AXIS zff_atsys._.iSignale._.obj.sig_m_t8 UMR_NM__8_1_M50_S6_S3 4 -400 1640 DEPOSIT ABSOLUTE MONOTONY MON_INCREASE /end AXIS_DESCR
/end CHARACTERISTIC
/begin CHARACTERISTIC KF_PKABSP43 "Schaltdruck abschaltende Kupplung" MAP 0x244F98 kf_si16_S6_S3 12.75 UMR_BAR__1_1000_0_S6_S3 0 12.75
 /begin AXIS_DESCR STD_AXIS iSasZentr.iSchaltend.n_tkf UMR_U_MIN_32_1_0_S6_S3 8 0 8160 DEPOSIT ABSOLUTE MONOTONY MON_INCREASE /end AXIS_DESCR
 /begin AXIS_DESCR STD_AXIS zff_atsys._.iSignale._.obj.sig_m_t UMR_NM__1_1_0_S6_S3 10 -400 1640 DEPOSIT ABSOLUTE MONOTONY MON_INCREASE /end AXIS_DESCR
/end CHARACTERISTIC
/begin CHARACTERISTIC KF_TSYNMTNTKABVSP43 "Zeit vor sync. Ende Haltephase vorb. KAB" MAP 0x245064 kf_si16_S6_S3 5000 UMR_MSEC__10_1_0_S6_S3 -5000 0
 /begin AXIS_DESCR STD_AXIS zff_atsys._.iSignale._.obj.sig_m_t UMR_NM__1_1_0_S6_S3 4 -400 1640 DEPOSIT ABSOLUTE MONOTONY MON_INCREASE /end AXIS_DESCR
 /begin AXIS_DESCR STD_AXIS zff_atsys._.iSignale._.obj.sig_n_t UMR_U_MIN_1_1_0_S6_S3 6 0 8160 DEPOSIT ABSOLUTE MONOTONY MON_INCREASE /end AXIS_DESCR
/end CHARACTERISTIC
/begin CHARACTERISTIC KL_TRAMTHINSYNKABSP43 "Zeit fuer Abschalten KAB nach Haltephase in Synchron" CURVE 0x2450B0 kl_ui8_S6_S3 2550 UMR_MSEC__10_1_0_S6_S3 0 2550
 /begin AXIS_DESCR STD_AXIS zff_atsys._.iSignale._.obj.sig_m_t8 UMR_NM__8_1_M50_S6_S3 4 -400 1640 DEPOSIT ABSOLUTE MONOTONY MON_INCREASE /end AXIS_DESCR
/end CHARACTERISTIC
/begin CHARACTERISTIC KF_POHINSYNKABSP43 "Kennfeld Haltedruckoffset(n_tkf, m_t) bei Haltephase in Synchron" MAP 0x2450BC kf_si16_S6_S3 12.75 UMR_BAR__1_1000_0_S6_S3 -6.4 6.35
 /begin AXIS_DESCR STD_AXIS iSasZentr.iSchaltend.n_tkf UMR_U_MIN_32_1_0_S6_S3 6 0 8160 DEPOSIT ABSOLUTE MONOTONY MON_INCREASE /end AXIS_DESCR
 /begin AXIS_DESCR STD_AXIS zff_atsys._.iSignale._.obj.sig_m_t UMR_NM__1_1_0_S6_S3 6 -400 1640 DEPOSIT ABSOLUTE MONOTONY MON_INCREASE /end AXIS_DESCR
/end CHARACTERISTIC
/begin CHARACTERISTIC T_HINSYNSP43 "Zeit fuer Ende Haltephase in Synchron KZU/KAB" VALUE 0x26E76C kw_ui8_S6_S3 2540 UMR_MSEC__10_1_0_S6_S3 0 2540 /end CHARACTERISTIC
/begin CHARACTERISTIC KL_POHKABSP54 "Druckoffset waehrend Haltedruckphase" CURVE 0x245124 kl_si16_S6_S3 12.75 UMR_BAR__1_1000_0_S6_S3 -6.4 6.35
 /begin AXIS_DESCR STD_AXIS zff_atsys._.iSignale._.obj.sig_m_t8 UMR_NM__8_1_M50_S6_S3 4 -400 1640 DEPOSIT ABSOLUTE MONOTONY MON_INCREASE /end AXIS_DESCR
/end CHARACTERISTIC
/begin CHARACTERISTIC F_PRAHKABSP54 "Druckfaktor waehrend Rampe auf Schaltdruck" VALUE 0x26E76D kw_ui8_S6_S3 1 UMR___1_100_0_S6_S3 0 1 /end CHARACTERISTIC
/begin CHARACTERISTIC F_TRAHKABSP54 "Zeitfaktor waehrend Rampe auf Schaltdruck" VALUE 0x26E76E kw_ui8_S6_S3 1 UMR___1_100_0_S6_S3 0 1 /end CHARACTERISTIC
/begin CHARACTERISTIC KL_TRAHKABSP54 "Zeit fuer Rampe auf Schaltdruck" CURVE 0x245138 kl_ui8_S6_S3 2540 UMR_MSEC__10_1_0_S6_S3 0 2540
 /begin AXIS_DESCR STD_AXIS zff_atsys._.iSignale._.obj.sig_m_t8 UMR_NM__8_1_M50_S6_S3 4 -400 1640 DEPOSIT ABSOLUTE MONOTONY MON_INCREASE /end AXIS_DESCR
/end CHARACTERISTIC
/begin CHARACTERISTIC KL_PGOKABSP54 "Druckgradient in Abhaengigkeit von m_t" CURVE 0x245144 kl_si16_S6_S3 200 UMR_BAR_SEC_1_10_0_S6_S3 -100 100
 /begin AXIS_DESCR STD_AXIS zff_atsys._.iSignale._.obj.sig_m_t UMR_NM__1_1_0_S6_S3 6 -400 1640 DEPOSIT ABSOLUTE MONOTONY MON_INCREASE /end AXIS_DESCR
/end CHARACTERISTIC
/begin CHARACTERISTIC KF_TOHKABMTNTSP54 "Zeitoffset auf Ende SF fuer Haltephase" MAP 0x245160 kf_ui8_S6_S3 2000 UMR_MSEC__10_1_M128_S6_S3 -1000 1000
 /begin AXIS_DESCR STD_AXIS zff_atsys._.iSignale._.obj.sig_n_t8 UMR_U_MIN_32_1_0_S6_S3 4 0 8160 DEPOSIT ABSOLUTE MONOTONY MON_INCREASE /end AXIS_DESCR
 /begin AXIS_DESCR STD_AXIS zff_atsys._.iSignale._.obj.sig_m_t8 UMR_NM__8_1_M50_S6_S3 6 -400 1640 DEPOSIT ABSOLUTE MONOTONY MON_INCREASE /end AXIS_DESCR
/end CHARACTERISTIC
/begin CHARACTERISTIC KL_TSYNMTKABSP54 "Zeit vor sync. Ende Schaltdruck KAB" CURVE 0x24518C kl_ui8_S6_S3 1280 UMR_MSEC__10_1_M128_S6_S3 -1280 0
 /begin AXIS_DESCR STD_AXIS zff_atsys._.iSignale._.obj.sig_m_t8 UMR_NM__8_1_M50_S6_S3 4 -400 1640 DEPOSIT ABSOLUTE MONOTONY MON_INCREASE /end AXIS_DESCR
/end CHARACTERISTIC
/begin CHARACTERISTIC KF_PKABSP54 "Schaltdruck abschaltende Kupplung" MAP 0x245198 kf_si16_S6_S3 12.75 UMR_BAR__1_1000_0_S6_S3 0 12.75
 /begin AXIS_DESCR STD_AXIS iSasZentr.iSchaltend.n_tkf UMR_U_MIN_32_1_0_S6_S3 8 0 8160 DEPOSIT ABSOLUTE MONOTONY MON_INCREASE /end AXIS_DESCR
 /begin AXIS_DESCR STD_AXIS zff_atsys._.iSignale._.obj.sig_m_t UMR_NM__1_1_0_S6_S3 10 -400 1640 DEPOSIT ABSOLUTE MONOTONY MON_INCREASE /end AXIS_DESCR
/end CHARACTERISTIC
/begin CHARACTERISTIC KF_TSYNMTNTKABVSP54 "Zeit vor sync. Ende Haltephase vorb. KAB" MAP 0x245264 kf_si16_S6_S3 5000 UMR_MSEC__10_1_0_S6_S3 -5000 0
 /begin AXIS_DESCR STD_AXIS zff_atsys._.iSignale._.obj.sig_m_t UMR_NM__1_1_0_S6_S3 4 -400 1640 DEPOSIT ABSOLUTE MONOTONY MON_INCREASE /end AXIS_DESCR
 /begin AXIS_DESCR STD_AXIS zff_atsys._.iSignale._.obj.sig_n_t UMR_U_MIN_1_1_0_S6_S3 6 0 8160 DEPOSIT ABSOLUTE MONOTONY MON_INCREASE /end AXIS_DESCR
/end CHARACTERISTIC
/begin CHARACTERISTIC KL_TRAMTHINSYNKABSP54 "Zeit fuer Abschalten KAB nach Haltephase in Synchron" CURVE 0x2452B0 kl_ui8_S6_S3 2550 UMR_MSEC__10_1_0_S6_S3 0 2550
 /begin AXIS_DESCR STD_AXIS zff_atsys._.iSignale._.obj.sig_m_t8 UMR_NM__8_1_M50_S6_S3 4 -400 1640 DEPOSIT ABSOLUTE MONOTONY MON_INCREASE /end AXIS_DESCR
/end CHARACTERISTIC
/begin CHARACTERISTIC KF_POHINSYNKABSP54 "Kennfeld Haltedruckoffset(n_tkf, m_t) bei Haltephase in Synchron" MAP 0x2452BC kf_si16_S6_S3 12.75 UMR_BAR__1_1000_0_S6_S3 -6.4 6.35
 /begin AXIS_DESCR STD_AXIS iSasZentr.iSchaltend.n_tkf UMR_U_MIN_32_1_0_S6_S3 6 0 8160 DEPOSIT ABSOLUTE MONOTONY MON_INCREASE /end AXIS_DESCR
 /begin AXIS_DESCR STD_AXIS zff_atsys._.iSignale._.obj.sig_m_t UMR_NM__1_1_0_S6_S3 6 -400 1640 DEPOSIT ABSOLUTE MONOTONY MON_INCREASE /end AXIS_DESCR
/end CHARACTERISTIC
/begin CHARACTERISTIC T_HINSYNSP54 "Zeit fuer Ende Haltephase in Synchron KZU/KAB" VALUE 0x26E76F kw_ui8_S6_S3 2540 UMR_MSEC__10_1_0_S6_S3 0 2540 /end CHARACTERISTIC
/begin CHARACTERISTIC KL_POHKABSP65 "Druckoffset waehrend Haltedruckphase" CURVE 0x245324 kl_si16_S6_S3 12.75 UMR_BAR__1_1000_0_S6_S3 -6.4 6.35
 /begin AXIS_DESCR STD_AXIS zff_atsys._.iSignale._.obj.sig_m_t8 UMR_NM__8_1_M50_S6_S3 4 -400 1640 DEPOSIT ABSOLUTE MONOTONY MON_INCREASE /end AXIS_DESCR
/end CHARACTERISTIC
/begin CHARACTERISTIC F_PRAHKABSP65 "Druckfaktor waehrend Rampe auf Schaltdruck" VALUE 0x26E770 kw_ui8_S6_S3 1 UMR___1_100_0_S6_S3 0 1 /end CHARACTERISTIC
/begin CHARACTERISTIC F_TRAHKABSP65 "Zeitfaktor waehrend Rampe auf Schaltdruck" VALUE 0x26E771 kw_ui8_S6_S3 1 UMR___1_100_0_S6_S3 0 1 /end CHARACTERISTIC
/begin CHARACTERISTIC KL_TRAHKABSP65 "Zeit fuer Rampe auf Schaltdruck" CURVE 0x245338 kl_ui8_S6_S3 2540 UMR_MSEC__10_1_0_S6_S3 0 2540
 /begin AXIS_DESCR STD_AXIS zff_atsys._.iSignale._.obj.sig_m_t8 UMR_NM__8_1_M50_S6_S3 4 -400 1640 DEPOSIT ABSOLUTE MONOTONY MON_INCREASE /end AXIS_DESCR
/end CHARACTERISTIC
/begin CHARACTERISTIC KL_PGOKABSP65 "Druckgradient in Abhaengigkeit von m_t" CURVE 0x245344 kl_si16_S6_S3 200 UMR_BAR_SEC_1_10_0_S6_S3 -100 100
 /begin AXIS_DESCR STD_AXIS zff_atsys._.iSignale._.obj.sig_m_t UMR_NM__1_1_0_S6_S3 6 -400 1640 DEPOSIT ABSOLUTE MONOTONY MON_INCREASE /end AXIS_DESCR
/end CHARACTERISTIC
/begin CHARACTERISTIC KF_TOHKABMTNTSP65 "Zeitoffset auf Ende SF fuer Haltephase" MAP 0x245360 kf_ui8_S6_S3 2000 UMR_MSEC__10_1_M128_S6_S3 -1000 1000
 /begin AXIS_DESCR STD_AXIS zff_atsys._.iSignale._.obj.sig_n_t8 UMR_U_MIN_32_1_0_S6_S3 4 0 8160 DEPOSIT ABSOLUTE MONOTONY MON_INCREASE /end AXIS_DESCR
 /begin AXIS_DESCR STD_AXIS zff_atsys._.iSignale._.obj.sig_m_t8 UMR_NM__8_1_M50_S6_S3 6 -400 1640 DEPOSIT ABSOLUTE MONOTONY MON_INCREASE /end AXIS_DESCR
/end CHARACTERISTIC
/begin CHARACTERISTIC KL_TSYNMTKABSP65 "Zeit vor sync. Ende Schaltdruck KAB" CURVE 0x24538C kl_ui8_S6_S3 1280 UMR_MSEC__10_1_M128_S6_S3 -1280 0
 /begin AXIS_DESCR STD_AXIS zff_atsys._.iSignale._.obj.sig_m_t8 UMR_NM__8_1_M50_S6_S3 4 -400 1640 DEPOSIT ABSOLUTE MONOTONY MON_INCREASE /end AXIS_DESCR
/end CHARACTERISTIC
/begin CHARACTERISTIC KF_PKABSP65 "Schaltdruck abschaltende Kupplung" MAP 0x245398 kf_si16_S6_S3 12.75 UMR_BAR__1_1000_0_S6_S3 0 12.75
 /begin AXIS_DESCR STD_AXIS iSasZentr.iSchaltend.n_tkf UMR_U_MIN_32_1_0_S6_S3 8 0 8160 DEPOSIT ABSOLUTE MONOTONY MON_INCREASE /end AXIS_DESCR
 /begin AXIS_DESCR STD_AXIS zff_atsys._.iSignale._.obj.sig_m_t UMR_NM__1_1_0_S6_S3 10 -400 1640 DEPOSIT ABSOLUTE MONOTONY MON_INCREASE /end AXIS_DESCR
/end CHARACTERISTIC
/begin CHARACTERISTIC KF_TSYNMTNTKABVSP65 "Zeit vor sync. Ende Haltephase vorb. KAB" MAP 0x245464 kf_si16_S6_S3 5000 UMR_MSEC__10_1_0_S6_S3 -5000 0
 /begin AXIS_DESCR STD_AXIS zff_atsys._.iSignale._.obj.sig_m_t UMR_NM__1_1_0_S6_S3 4 -400 1640 DEPOSIT ABSOLUTE MONOTONY MON_INCREASE /end AXIS_DESCR
 /begin AXIS_DESCR STD_AXIS zff_atsys._.iSignale._.obj.sig_n_t UMR_U_MIN_1_1_0_S6_S3 6 0 8160 DEPOSIT ABSOLUTE MONOTONY MON_INCREASE /end AXIS_DESCR
/end CHARACTERISTIC
/begin CHARACTERISTIC KL_TRAMTHINSYNKABSP65 "Zeit fuer Abschalten KAB nach Haltephase in Synchron" CURVE 0x2454B0 kl_ui8_S6_S3 2550 UMR_MSEC__10_1_0_S6_S3 0 2550
 /begin AXIS_DESCR STD_AXIS zff_atsys._.iSignale._.obj.sig_m_t8 UMR_NM__8_1_M50_S6_S3 4 -400 1640 DEPOSIT ABSOLUTE MONOTONY MON_INCREASE /end AXIS_DESCR
/end CHARACTERISTIC
/begin CHARACTERISTIC KF_POHINSYNKABSP65 "Kennfeld Haltedruckoffset(n_tkf, m_t) bei Haltephase in Synchron" MAP 0x2454BC kf_si16_S6_S3 12.75 UMR_BAR__1_1000_0_S6_S3 -6.4 6.35
 /begin AXIS_DESCR STD_AXIS iSasZentr.iSchaltend.n_tkf UMR_U_MIN_32_1_0_S6_S3 6 0 8160 DEPOSIT ABSOLUTE MONOTONY MON_INCREASE /end AXIS_DESCR
 /begin AXIS_DESCR STD_AXIS zff_atsys._.iSignale._.obj.sig_m_t UMR_NM__1_1_0_S6_S3 6 -400 1640 DEPOSIT ABSOLUTE MONOTONY MON_INCREASE /end AXIS_DESCR
/end CHARACTERISTIC
/begin CHARACTERISTIC T_HINSYNSP65 "Zeit fuer Ende Haltephase in Synchron KZU/KAB" VALUE 0x26E772 kw_ui8_S6_S3 2540 UMR_MSEC__10_1_0_S6_S3 0 2540 /end CHARACTERISTIC
/begin CHARACTERISTIC KL_POHKABSP76 "Druckoffset waehrend Haltedruckphase" CURVE 0x245524 kl_si16_S6_S3 12.75 UMR_BAR__1_1000_0_S6_S3 -6.4 6.35
 /begin AXIS_DESCR STD_AXIS zff_atsys._.iSignale._.obj.sig_m_t8 UMR_NM__8_1_M50_S6_S3 4 -400 1640 DEPOSIT ABSOLUTE MONOTONY MON_INCREASE /end AXIS_DESCR
/end CHARACTERISTIC
/begin CHARACTERISTIC F_PRAHKABSP76 "Druckfaktor waehrend Rampe auf Schaltdruck" VALUE 0x26E773 kw_ui8_S6_S3 1 UMR___1_100_0_S6_S3 0 1 /end CHARACTERISTIC
/begin CHARACTERISTIC F_TRAHKABSP76 "Zeitfaktor waehrend Rampe auf Schaltdruck" VALUE 0x26E774 kw_ui8_S6_S3 1 UMR___1_100_0_S6_S3 0 1 /end CHARACTERISTIC
/begin CHARACTERISTIC KL_TRAHKABSP76 "Zeit fuer Rampe auf Schaltdruck" CURVE 0x245538 kl_ui8_S6_S3 2540 UMR_MSEC__10_1_0_S6_S3 0 2540
 /begin AXIS_DESCR STD_AXIS zff_atsys._.iSignale._.obj.sig_m_t8 UMR_NM__8_1_M50_S6_S3 4 -400 1640 DEPOSIT ABSOLUTE MONOTONY MON_INCREASE /end AXIS_DESCR
/end CHARACTERISTIC
/begin CHARACTERISTIC KL_PGOKABSP76 "Druckgradient in Abhaengigkeit von m_t" CURVE 0x245544 kl_si16_S6_S3 200 UMR_BAR_SEC_1_10_0_S6_S3 -100 100
 /begin AXIS_DESCR STD_AXIS zff_atsys._.iSignale._.obj.sig_m_t UMR_NM__1_1_0_S6_S3 6 -400 1640 DEPOSIT ABSOLUTE MONOTONY MON_INCREASE /end AXIS_DESCR
/end CHARACTERISTIC
/begin CHARACTERISTIC KF_TOHKABMTNTSP76 "Zeitoffset auf Ende SF fuer Haltephase" MAP 0x245560 kf_ui8_S6_S3 2000 UMR_MSEC__10_1_M128_S6_S3 -1000 1000
 /begin AXIS_DESCR STD_AXIS zff_atsys._.iSignale._.obj.sig_n_t8 UMR_U_MIN_32_1_0_S6_S3 4 0 8160 DEPOSIT ABSOLUTE MONOTONY MON_INCREASE /end AXIS_DESCR
 /begin AXIS_DESCR STD_AXIS zff_atsys._.iSignale._.obj.sig_m_t8 UMR_NM__8_1_M50_S6_S3 6 -400 1640 DEPOSIT ABSOLUTE MONOTONY MON_INCREASE /end AXIS_DESCR
/end CHARACTERISTIC
/begin CHARACTERISTIC KL_TSYNMTKABSP76 "Zeit vor sync. Ende Schaltdruck KAB" CURVE 0x24558C kl_ui8_S6_S3 1280 UMR_MSEC__10_1_M128_S6_S3 -1280 0
 /begin AXIS_DESCR STD_AXIS zff_atsys._.iSignale._.obj.sig_m_t8 UMR_NM__8_1_M50_S6_S3 4 -400 1640 DEPOSIT ABSOLUTE MONOTONY MON_INCREASE /end AXIS_DESCR
/end CHARACTERISTIC
/begin CHARACTERISTIC KF_PKABSP76 "Schaltdruck abschaltende Kupplung" MAP 0x245598 kf_si16_S6_S3 12.75 UMR_BAR__1_1000_0_S6_S3 0 12.75
 /begin AXIS_DESCR STD_AXIS iSasZentr.iSchaltend.n_tkf UMR_U_MIN_32_1_0_S6_S3 8 0 8160 DEPOSIT ABSOLUTE MONOTONY MON_INCREASE /end AXIS_DESCR
 /begin AXIS_DESCR STD_AXIS zff_atsys._.iSignale._.obj.sig_m_t UMR_NM__1_1_0_S6_S3 10 -400 1640 DEPOSIT ABSOLUTE MONOTONY MON_INCREASE /end AXIS_DESCR
/end CHARACTERISTIC
/begin CHARACTERISTIC KF_TSYNMTNTKABVSP76 "Zeit vor sync. Ende Haltephase vorb. KAB" MAP 0x245664 kf_si16_S6_S3 5000 UMR_MSEC__10_1_0_S6_S3 -5000 0
 /begin AXIS_DESCR STD_AXIS zff_atsys._.iSignale._.obj.sig_m_t UMR_NM__1_1_0_S6_S3 4 -400 1640 DEPOSIT ABSOLUTE MONOTONY MON_INCREASE /end AXIS_DESCR
 /begin AXIS_DESCR STD_AXIS zff_atsys._.iSignale._.obj.sig_n_t UMR_U_MIN_1_1_0_S6_S3 6 0 8160 DEPOSIT ABSOLUTE MONOTONY MON_INCREASE /end AXIS_DESCR
/end CHARACTERISTIC
/begin CHARACTERISTIC KL_TRAMTHINSYNKABSP76 "Zeit fuer Abschalten KAB nach Haltephase in Synchron" CURVE 0x2456B0 kl_ui8_S6_S3 2550 UMR_MSEC__10_1_0_S6_S3 0 2550
 /begin AXIS_DESCR STD_AXIS zff_atsys._.iSignale._.obj.sig_m_t8 UMR_NM__8_1_M50_S6_S3 4 -400 1640 DEPOSIT ABSOLUTE MONOTONY MON_INCREASE /end AXIS_DESCR
/end CHARACTERISTIC
/begin CHARACTERISTIC KF_POHINSYNKABSP76 "Kennfeld Haltedruckoffset(n_tkf, m_t) bei Haltephase in Synchron" MAP 0x2456BC kf_si16_S6_S3 12.75 UMR_BAR__1_1000_0_S6_S3 -6.4 6.35
 /begin AXIS_DESCR STD_AXIS iSasZentr.iSchaltend.n_tkf UMR_U_MIN_32_1_0_S6_S3 6 0 8160 DEPOSIT ABSOLUTE MONOTONY MON_INCREASE /end AXIS_DESCR
 /begin AXIS_DESCR STD_AXIS zff_atsys._.iSignale._.obj.sig_m_t UMR_NM__1_1_0_S6_S3 6 -400 1640 DEPOSIT ABSOLUTE MONOTONY MON_INCREASE /end AXIS_DESCR
/end CHARACTERISTIC
/begin CHARACTERISTIC T_HINSYNSP76 "Zeit fuer Ende Haltephase in Synchron KZU/KAB" VALUE 0x26E775 kw_ui8_S6_S3 2540 UMR_MSEC__10_1_0_S6_S3 0 2540 /end CHARACTERISTIC
/begin CHARACTERISTIC KL_POHKABSP87 "Druckoffset waehrend Haltedruckphase" CURVE 0x245724 kl_si16_S6_S3 12.75 UMR_BAR__1_1000_0_S6_S3 -6.4 6.35
 /begin AXIS_DESCR STD_AXIS zff_atsys._.iSignale._.obj.sig_m_t8 UMR_NM__8_1_M50_S6_S3 4 -400 1640 DEPOSIT ABSOLUTE MONOTONY MON_INCREASE /end AXIS_DESCR
/end CHARACTERISTIC
/begin CHARACTERISTIC F_PRAHKABSP87 "Druckfaktor waehrend Rampe auf Schaltdruck" VALUE 0x26E776 kw_ui8_S6_S3 1 UMR___1_100_0_S6_S3 0 1 /end CHARACTERISTIC
/begin CHARACTERISTIC F_TRAHKABSP87 "Zeitfaktor waehrend Rampe auf Schaltdruck" VALUE 0x26E777 kw_ui8_S6_S3 1 UMR___1_100_0_S6_S3 0 1 /end CHARACTERISTIC
/begin CHARACTERISTIC KL_TRAHKABSP87 "Zeit fuer Rampe auf Schaltdruck" CURVE 0x245738 kl_ui8_S6_S3 2540 UMR_MSEC__10_1_0_S6_S3 0 2540
 /begin AXIS_DESCR STD_AXIS zff_atsys._.iSignale._.obj.sig_m_t8 UMR_NM__8_1_M50_S6_S3 4 -400 1640 DEPOSIT ABSOLUTE MONOTONY MON_INCREASE /end AXIS_DESCR
/end CHARACTERISTIC
/begin CHARACTERISTIC KL_PGOKABSP87 "Druckgradient in Abhaengigkeit von m_t" CURVE 0x245744 kl_si16_S6_S3 200 UMR_BAR_SEC_1_10_0_S6_S3 -100 100
 /begin AXIS_DESCR STD_AXIS zff_atsys._.iSignale._.obj.sig_m_t UMR_NM__1_1_0_S6_S3 6 -400 1640 DEPOSIT ABSOLUTE MONOTONY MON_INCREASE /end AXIS_DESCR
/end CHARACTERISTIC
/begin CHARACTERISTIC KF_TOHKABMTNTSP87 "Zeitoffset auf Ende SF fuer Haltephase" MAP 0x245760 kf_ui8_S6_S3 2000 UMR_MSEC__10_1_M128_S6_S3 -1000 1000
 /begin AXIS_DESCR STD_AXIS zff_atsys._.iSignale._.obj.sig_n_t8 UMR_U_MIN_32_1_0_S6_S3 4 0 8160 DEPOSIT ABSOLUTE MONOTONY MON_INCREASE /end AXIS_DESCR
 /begin AXIS_DESCR STD_AXIS zff_atsys._.iSignale._.obj.sig_m_t8 UMR_NM__8_1_M50_S6_S3 6 -400 1640 DEPOSIT ABSOLUTE MONOTONY MON_INCREASE /end AXIS_DESCR
/end CHARACTERISTIC
/begin CHARACTERISTIC KL_TSYNMTKABSP87 "Zeit vor sync. Ende Schaltdruck KAB" CURVE 0x24578C kl_ui8_S6_S3 1280 UMR_MSEC__10_1_M128_S6_S3 -1280 0
 /begin AXIS_DESCR STD_AXIS zff_atsys._.iSignale._.obj.sig_m_t8 UMR_NM__8_1_M50_S6_S3 4 -400 1640 DEPOSIT ABSOLUTE MONOTONY MON_INCREASE /end AXIS_DESCR
/end CHARACTERISTIC
/begin CHARACTERISTIC KF_PKABSP87 "Schaltdruck abschaltende Kupplung" MAP 0x245798 kf_si16_S6_S3 12.75 UMR_BAR__1_1000_0_S6_S3 0 12.75
 /begin AXIS_DESCR STD_AXIS iSasZentr.iSchaltend.n_tkf UMR_U_MIN_32_1_0_S6_S3 8 0 8160 DEPOSIT ABSOLUTE MONOTONY MON_INCREASE /end AXIS_DESCR
 /begin AXIS_DESCR STD_AXIS zff_atsys._.iSignale._.obj.sig_m_t UMR_NM__1_1_0_S6_S3 10 -400 1640 DEPOSIT ABSOLUTE MONOTONY MON_INCREASE /end AXIS_DESCR
/end CHARACTERISTIC
/begin CHARACTERISTIC KF_TSYNMTNTKABVSP87 "Zeit vor sync. Ende Haltephase vorb. KAB" MAP 0x245864 kf_si16_S6_S3 5000 UMR_MSEC__10_1_0_S6_S3 -5000 0
 /begin AXIS_DESCR STD_AXIS zff_atsys._.iSignale._.obj.sig_m_t UMR_NM__1_1_0_S6_S3 4 -400 1640 DEPOSIT ABSOLUTE MONOTONY MON_INCREASE /end AXIS_DESCR
 /begin AXIS_DESCR STD_AXIS zff_atsys._.iSignale._.obj.sig_n_t UMR_U_MIN_1_1_0_S6_S3 6 0 8160 DEPOSIT ABSOLUTE MONOTONY MON_INCREASE /end AXIS_DESCR
/end CHARACTERISTIC
/begin CHARACTERISTIC KL_TRAMTHINSYNKABSP87 "Zeit fuer Abschalten KAB nach Haltephase in Synchron" CURVE 0x2458B0 kl_ui8_S6_S3 2550 UMR_MSEC__10_1_0_S6_S3 0 2550
 /begin AXIS_DESCR STD_AXIS zff_atsys._.iSignale._.obj.sig_m_t8 UMR_NM__8_1_M50_S6_S3 4 -400 1640 DEPOSIT ABSOLUTE MONOTONY MON_INCREASE /end AXIS_DESCR
/end CHARACTERISTIC
/begin CHARACTERISTIC KF_POHINSYNKABSP87 "Kennfeld Haltedruckoffset(n_tkf, m_t) bei Haltephase in Synchron" MAP 0x2458BC kf_si16_S6_S3 12.75 UMR_BAR__1_1000_0_S6_S3 -6.4 6.35
 /begin AXIS_DESCR STD_AXIS iSasZentr.iSchaltend.n_tkf UMR_U_MIN_32_1_0_S6_S3 6 0 8160 DEPOSIT ABSOLUTE MONOTONY MON_INCREASE /end AXIS_DESCR
 /begin AXIS_DESCR STD_AXIS zff_atsys._.iSignale._.obj.sig_m_t UMR_NM__1_1_0_S6_S3 6 -400 1640 DEPOSIT ABSOLUTE MONOTONY MON_INCREASE /end AXIS_DESCR
/end CHARACTERISTIC
/begin CHARACTERISTIC T_HINSYNSP87 "Zeit fuer Ende Haltephase in Synchron KZU/KAB" VALUE 0x26E778 kw_ui8_S6_S3 2540 UMR_MSEC__10_1_0_S6_S3 0 2540 /end CHARACTERISTIC
/begin CHARACTERISTIC KL_POHKABSP31 "Druckoffset waehrend Haltedruckphase" CURVE 0x245924 kl_si16_S6_S3 12.75 UMR_BAR__1_1000_0_S6_S3 -6.4 6.35
 /begin AXIS_DESCR STD_AXIS zff_atsys._.iSignale._.obj.sig_m_t8 UMR_NM__8_1_M50_S6_S3 4 -400 1640 DEPOSIT ABSOLUTE MONOTONY MON_INCREASE /end AXIS_DESCR
/end CHARACTERISTIC
/begin CHARACTERISTIC F_PRAHKABSP31 "Druckfaktor waehrend Rampe auf Schaltdruck" VALUE 0x26E779 kw_ui8_S6_S3 1 UMR___1_100_0_S6_S3 0 1 /end CHARACTERISTIC
/begin CHARACTERISTIC F_TRAHKABSP31 "Zeitfaktor waehrend Rampe auf Schaltdruck" VALUE 0x26E77A kw_ui8_S6_S3 1 UMR___1_100_0_S6_S3 0 1 /end CHARACTERISTIC
/begin CHARACTERISTIC KL_TRAHKABSP31 "Zeit fuer Rampe auf Schaltdruck" CURVE 0x245938 kl_ui8_S6_S3 2540 UMR_MSEC__10_1_0_S6_S3 0 2540
 /begin AXIS_DESCR STD_AXIS zff_atsys._.iSignale._.obj.sig_m_t8 UMR_NM__8_1_M50_S6_S3 4 -400 1640 DEPOSIT ABSOLUTE MONOTONY MON_INCREASE /end AXIS_DESCR
/end CHARACTERISTIC
/begin CHARACTERISTIC KL_PGOKABSP31 "Druckgradient in Abhaengigkeit von m_t" CURVE 0x245944 kl_si16_S6_S3 200 UMR_BAR_SEC_1_10_0_S6_S3 -100 100
 /begin AXIS_DESCR STD_AXIS zff_atsys._.iSignale._.obj.sig_m_t UMR_NM__1_1_0_S6_S3 6 -400 1640 DEPOSIT ABSOLUTE MONOTONY MON_INCREASE /end AXIS_DESCR
/end CHARACTERISTIC
/begin CHARACTERISTIC KF_TOHKABMTNTSP31 "Zeitoffset auf Ende SF fuer Haltephase" MAP 0x245960 kf_ui8_S6_S3 2000 UMR_MSEC__10_1_M128_S6_S3 -1000 1000
 /begin AXIS_DESCR STD_AXIS zff_atsys._.iSignale._.obj.sig_n_t8 UMR_U_MIN_32_1_0_S6_S3 4 0 8160 DEPOSIT ABSOLUTE MONOTONY MON_INCREASE /end AXIS_DESCR
 /begin AXIS_DESCR STD_AXIS zff_atsys._.iSignale._.obj.sig_m_t8 UMR_NM__8_1_M50_S6_S3 6 -400 1640 DEPOSIT ABSOLUTE MONOTONY MON_INCREASE /end AXIS_DESCR
/end CHARACTERISTIC
/begin CHARACTERISTIC KL_TSYNMTKABSP31 "Zeit vor sync. Ende Schaltdruck KAB" CURVE 0x24598C kl_ui8_S6_S3 1280 UMR_MSEC__10_1_M128_S6_S3 -1280 0
 /begin AXIS_DESCR STD_AXIS zff_atsys._.iSignale._.obj.sig_m_t8 UMR_NM__8_1_M50_S6_S3 4 -400 1640 DEPOSIT ABSOLUTE MONOTONY MON_INCREASE /end AXIS_DESCR
/end CHARACTERISTIC
/begin CHARACTERISTIC KF_PKABSP31 "Schaltdruck abschaltende Kupplung" MAP 0x245998 kf_si16_S6_S3 12.75 UMR_BAR__1_1000_0_S6_S3 0 12.75
 /begin AXIS_DESCR STD_AXIS iSasZentr.iSchaltend.n_tkf UMR_U_MIN_32_1_0_S6_S3 8 0 8160 DEPOSIT ABSOLUTE MONOTONY MON_INCREASE /end AXIS_DESCR
 /begin AXIS_DESCR STD_AXIS zff_atsys._.iSignale._.obj.sig_m_t UMR_NM__1_1_0_S6_S3 10 -400 1640 DEPOSIT ABSOLUTE MONOTONY MON_INCREASE /end AXIS_DESCR
/end CHARACTERISTIC
/begin CHARACTERISTIC KF_TSYNMTNTKABVSP31 "Zeit vor sync. Ende Haltephase vorb. KAB" MAP 0x245A64 kf_si16_S6_S3 5000 UMR_MSEC__10_1_0_S6_S3 -5000 0
 /begin AXIS_DESCR STD_AXIS zff_atsys._.iSignale._.obj.sig_m_t UMR_NM__1_1_0_S6_S3 4 -400 1640 DEPOSIT ABSOLUTE MONOTONY MON_INCREASE /end AXIS_DESCR
 /begin AXIS_DESCR STD_AXIS zff_atsys._.iSignale._.obj.sig_n_t UMR_U_MIN_1_1_0_S6_S3 6 0 8160 DEPOSIT ABSOLUTE MONOTONY MON_INCREASE /end AXIS_DESCR
/end CHARACTERISTIC
/begin CHARACTERISTIC KL_TRAMTHINSYNKABSP31 "Zeit fuer Abschalten KAB nach Haltephase in Synchron" CURVE 0x245AB0 kl_ui8_S6_S3 2550 UMR_MSEC__10_1_0_S6_S3 0 2550
 /begin AXIS_DESCR STD_AXIS zff_atsys._.iSignale._.obj.sig_m_t8 UMR_NM__8_1_M50_S6_S3 4 -400 1640 DEPOSIT ABSOLUTE MONOTONY MON_INCREASE /end AXIS_DESCR
/end CHARACTERISTIC
/begin CHARACTERISTIC KF_POHINSYNKABSP31 "Kennfeld Haltedruckoffset(n_tkf, m_t) bei Haltephase in Synchron" MAP 0x245ABC kf_si16_S6_S3 12.75 UMR_BAR__1_1000_0_S6_S3 -6.4 6.35
 /begin AXIS_DESCR STD_AXIS iSasZentr.iSchaltend.n_tkf UMR_U_MIN_32_1_0_S6_S3 6 0 8160 DEPOSIT ABSOLUTE MONOTONY MON_INCREASE /end AXIS_DESCR
 /begin AXIS_DESCR STD_AXIS zff_atsys._.iSignale._.obj.sig_m_t UMR_NM__1_1_0_S6_S3 6 -400 1640 DEPOSIT ABSOLUTE MONOTONY MON_INCREASE /end AXIS_DESCR
/end CHARACTERISTIC
/begin CHARACTERISTIC T_HINSYNSP31 "Zeit fuer Ende Haltephase in Synchron KZU/KAB" VALUE 0x26E77B kw_ui8_S6_S3 2540 UMR_MSEC__10_1_0_S6_S3 0 2540 /end CHARACTERISTIC
/begin CHARACTERISTIC KL_POHKABSP42 "Druckoffset waehrend Haltedruckphase" CURVE 0x245B24 kl_si16_S6_S3 12.75 UMR_BAR__1_1000_0_S6_S3 -6.4 6.35
 /begin AXIS_DESCR STD_AXIS zff_atsys._.iSignale._.obj.sig_m_t8 UMR_NM__8_1_M50_S6_S3 4 -400 1640 DEPOSIT ABSOLUTE MONOTONY MON_INCREASE /end AXIS_DESCR
/end CHARACTERISTIC
/begin CHARACTERISTIC F_PRAHKABSP42 "Druckfaktor waehrend Rampe auf Schaltdruck" VALUE 0x26E77C kw_ui8_S6_S3 1 UMR___1_100_0_S6_S3 0 1 /end CHARACTERISTIC
/begin CHARACTERISTIC F_TRAHKABSP42 "Zeitfaktor waehrend Rampe auf Schaltdruck" VALUE 0x26E77D kw_ui8_S6_S3 1 UMR___1_100_0_S6_S3 0 1 /end CHARACTERISTIC
/begin CHARACTERISTIC KL_TRAHKABSP42 "Zeit fuer Rampe auf Schaltdruck" CURVE 0x245B38 kl_ui8_S6_S3 2540 UMR_MSEC__10_1_0_S6_S3 0 2540
 /begin AXIS_DESCR STD_AXIS zff_atsys._.iSignale._.obj.sig_m_t8 UMR_NM__8_1_M50_S6_S3 4 -400 1640 DEPOSIT ABSOLUTE MONOTONY MON_INCREASE /end AXIS_DESCR
/end CHARACTERISTIC
/begin CHARACTERISTIC KL_TRAHKABSP42_EL "Zeit fuer Rampe auf Schaltdruck" CURVE 0x245B44 kl_ui8_S6_S3 2540 UMR_MSEC__10_1_0_S6_S3 0 2540
 /begin AXIS_DESCR STD_AXIS zff_atsys._.iSignale._.obj.sig_m_t8 UMR_NM__8_1_M50_S6_S3 4 -400 1640 DEPOSIT ABSOLUTE MONOTONY MON_INCREASE /end AXIS_DESCR
/end CHARACTERISTIC
/begin CHARACTERISTIC KL_PGOKABSP42 "Druckgradient in Abhaengigkeit von m_t" CURVE 0x245B50 kl_si16_S6_S3 200 UMR_BAR_SEC_1_10_0_S6_S3 -100 100
 /begin AXIS_DESCR STD_AXIS zff_atsys._.iSignale._.obj.sig_m_t UMR_NM__1_1_0_S6_S3 6 -400 1640 DEPOSIT ABSOLUTE MONOTONY MON_INCREASE /end AXIS_DESCR
/end CHARACTERISTIC
/begin CHARACTERISTIC KF_TOHKABMTNTSP42 "Zeitoffset auf Ende SF fuer Haltephase" MAP 0x245B6C kf_ui8_S6_S3 2000 UMR_MSEC__10_1_M128_S6_S3 -1000 1000
 /begin AXIS_DESCR STD_AXIS zff_atsys._.iSignale._.obj.sig_n_t8 UMR_U_MIN_32_1_0_S6_S3 4 0 8160 DEPOSIT ABSOLUTE MONOTONY MON_INCREASE /end AXIS_DESCR
 /begin AXIS_DESCR STD_AXIS zff_atsys._.iSignale._.obj.sig_m_t8 UMR_NM__8_1_M50_S6_S3 6 -400 1640 DEPOSIT ABSOLUTE MONOTONY MON_INCREASE /end AXIS_DESCR
/end CHARACTERISTIC
/begin CHARACTERISTIC KL_TSYNMTKABSP42 "Zeit vor sync. Ende Schaltdruck KAB" CURVE 0x245B98 kl_ui8_S6_S3 1280 UMR_MSEC__10_1_M128_S6_S3 -1280 0
 /begin AXIS_DESCR STD_AXIS zff_atsys._.iSignale._.obj.sig_m_t8 UMR_NM__8_1_M50_S6_S3 4 -400 1640 DEPOSIT ABSOLUTE MONOTONY MON_INCREASE /end AXIS_DESCR
/end CHARACTERISTIC
/begin CHARACTERISTIC KF_PKABSP42 "Schaltdruck abschaltende Kupplung" MAP 0x245BA4 kf_si16_S6_S3 12.75 UMR_BAR__1_1000_0_S6_S3 0 12.75
 /begin AXIS_DESCR STD_AXIS iSasZentr.iSchaltend.n_tkf UMR_U_MIN_32_1_0_S6_S3 8 0 8160 DEPOSIT ABSOLUTE MONOTONY MON_INCREASE /end AXIS_DESCR
 /begin AXIS_DESCR STD_AXIS zff_atsys._.iSignale._.obj.sig_m_t UMR_NM__1_1_0_S6_S3 10 -400 1640 DEPOSIT ABSOLUTE MONOTONY MON_INCREASE /end AXIS_DESCR
/end CHARACTERISTIC
/begin CHARACTERISTIC KF_PKABSP42_EL "Schaltdruck abschaltende Kupplung" MAP 0x245C70 kf_si16_S6_S3 12.75 UMR_BAR__1_1000_0_S6_S3 0 12.75
 /begin AXIS_DESCR STD_AXIS iSasZentr.iSchaltend.n_tkf UMR_U_MIN_32_1_0_S6_S3 8 0 8160 DEPOSIT ABSOLUTE MONOTONY MON_INCREASE /end AXIS_DESCR
 /begin AXIS_DESCR STD_AXIS zff_atsys._.iSignale._.obj.sig_m_t UMR_NM__1_1_0_S6_S3 10 -400 1640 DEPOSIT ABSOLUTE MONOTONY MON_INCREASE /end AXIS_DESCR
/end CHARACTERISTIC
/begin CHARACTERISTIC KF_TSYNMTNTKABVSP42 "Zeit vor sync. Ende Haltephase vorb. KAB" MAP 0x245D3C kf_si16_S6_S3 5000 UMR_MSEC__10_1_0_S6_S3 -5000 0
 /begin AXIS_DESCR STD_AXIS zff_atsys._.iSignale._.obj.sig_m_t UMR_NM__1_1_0_S6_S3 4 -400 1640 DEPOSIT ABSOLUTE MONOTONY MON_INCREASE /end AXIS_DESCR
 /begin AXIS_DESCR STD_AXIS zff_atsys._.iSignale._.obj.sig_n_t UMR_U_MIN_1_1_0_S6_S3 6 0 8160 DEPOSIT ABSOLUTE MONOTONY MON_INCREASE /end AXIS_DESCR
/end CHARACTERISTIC
/begin CHARACTERISTIC KL_TRAMTHINSYNKABSP42 "Zeit fuer Abschalten KAB nach Haltephase in Synchron" CURVE 0x245D88 kl_ui8_S6_S3 2550 UMR_MSEC__10_1_0_S6_S3 0 2550
 /begin AXIS_DESCR STD_AXIS zff_atsys._.iSignale._.obj.sig_m_t8 UMR_NM__8_1_M50_S6_S3 4 -400 1640 DEPOSIT ABSOLUTE MONOTONY MON_INCREASE /end AXIS_DESCR
/end CHARACTERISTIC
/begin CHARACTERISTIC KF_POHINSYNKABSP42 "Kennfeld Haltedruckoffset(n_tkf, m_t) bei Haltephase in Synchron" MAP 0x245D94 kf_si16_S6_S3 12.75 UMR_BAR__1_1000_0_S6_S3 -6.4 6.35
 /begin AXIS_DESCR STD_AXIS iSasZentr.iSchaltend.n_tkf UMR_U_MIN_32_1_0_S6_S3 6 0 8160 DEPOSIT ABSOLUTE MONOTONY MON_INCREASE /end AXIS_DESCR
 /begin AXIS_DESCR STD_AXIS zff_atsys._.iSignale._.obj.sig_m_t UMR_NM__1_1_0_S6_S3 6 -400 1640 DEPOSIT ABSOLUTE MONOTONY MON_INCREASE /end AXIS_DESCR
/end CHARACTERISTIC
/begin CHARACTERISTIC T_HINSYNSP42 "Zeit fuer Ende Haltephase in Synchron KZU/KAB" VALUE 0x26E77E kw_ui8_S6_S3 2540 UMR_MSEC__10_1_0_S6_S3 0 2540 /end CHARACTERISTIC
/begin CHARACTERISTIC KL_POHKABSP51 "Druckoffset waehrend Haltedruckphase" CURVE 0x245DFC kl_si16_S6_S3 12.75 UMR_BAR__1_1000_0_S6_S3 -6.4 6.35
 /begin AXIS_DESCR STD_AXIS zff_atsys._.iSignale._.obj.sig_m_t8 UMR_NM__8_1_M50_S6_S3 4 -400 1640 DEPOSIT ABSOLUTE MONOTONY MON_INCREASE /end AXIS_DESCR
/end CHARACTERISTIC
/begin CHARACTERISTIC F_PRAHKABSP51 "Druckfaktor waehrend Rampe auf Schaltdruck" VALUE 0x26E77F kw_ui8_S6_S3 1 UMR___1_100_0_S6_S3 0 1 /end CHARACTERISTIC
/begin CHARACTERISTIC F_TRAHKABSP51 "Zeitfaktor waehrend Rampe auf Schaltdruck" VALUE 0x26E780 kw_ui8_S6_S3 1 UMR___1_100_0_S6_S3 0 1 /end CHARACTERISTIC
/begin CHARACTERISTIC KL_TRAHKABSP51 "Zeit fuer Rampe auf Schaltdruck" CURVE 0x245E10 kl_ui8_S6_S3 2540 UMR_MSEC__10_1_0_S6_S3 0 2540
 /begin AXIS_DESCR STD_AXIS zff_atsys._.iSignale._.obj.sig_m_t8 UMR_NM__8_1_M50_S6_S3 4 -400 1640 DEPOSIT ABSOLUTE MONOTONY MON_INCREASE /end AXIS_DESCR
/end CHARACTERISTIC
/begin CHARACTERISTIC KL_PGOKABSP51 "Druckgradient in Abhaengigkeit von m_t" CURVE 0x245E1C kl_si16_S6_S3 200 UMR_BAR_SEC_1_10_0_S6_S3 -100 100
 /begin AXIS_DESCR STD_AXIS zff_atsys._.iSignale._.obj.sig_m_t UMR_NM__1_1_0_S6_S3 6 -400 1640 DEPOSIT ABSOLUTE MONOTONY MON_INCREASE /end AXIS_DESCR
/end CHARACTERISTIC
/begin CHARACTERISTIC KF_TOHKABMTNTSP51 "Zeitoffset auf Ende SF fuer Haltephase" MAP 0x245E38 kf_ui8_S6_S3 2000 UMR_MSEC__10_1_M128_S6_S3 -1000 1000
 /begin AXIS_DESCR STD_AXIS zff_atsys._.iSignale._.obj.sig_n_t8 UMR_U_MIN_32_1_0_S6_S3 4 0 8160 DEPOSIT ABSOLUTE MONOTONY MON_INCREASE /end AXIS_DESCR
 /begin AXIS_DESCR STD_AXIS zff_atsys._.iSignale._.obj.sig_m_t8 UMR_NM__8_1_M50_S6_S3 6 -400 1640 DEPOSIT ABSOLUTE MONOTONY MON_INCREASE /end AXIS_DESCR
/end CHARACTERISTIC
/begin CHARACTERISTIC KL_TSYNMTKABSP51 "Zeit vor sync. Ende Schaltdruck KAB" CURVE 0x245E64 kl_ui8_S6_S3 1280 UMR_MSEC__10_1_M128_S6_S3 -1280 0
 /begin AXIS_DESCR STD_AXIS zff_atsys._.iSignale._.obj.sig_m_t8 UMR_NM__8_1_M50_S6_S3 4 -400 1640 DEPOSIT ABSOLUTE MONOTONY MON_INCREASE /end AXIS_DESCR
/end CHARACTERISTIC
/begin CHARACTERISTIC KF_PKABSP51 "Schaltdruck abschaltende Kupplung" MAP 0x245E70 kf_si16_S6_S3 12.75 UMR_BAR__1_1000_0_S6_S3 0 12.75
 /begin AXIS_DESCR STD_AXIS iSasZentr.iSchaltend.n_tkf UMR_U_MIN_32_1_0_S6_S3 8 0 8160 DEPOSIT ABSOLUTE MONOTONY MON_INCREASE /end AXIS_DESCR
 /begin AXIS_DESCR STD_AXIS zff_atsys._.iSignale._.obj.sig_m_t UMR_NM__1_1_0_S6_S3 10 -400 1640 DEPOSIT ABSOLUTE MONOTONY MON_INCREASE /end AXIS_DESCR
/end CHARACTERISTIC
/begin CHARACTERISTIC KF_TSYNMTNTKABVSP51 "Zeit vor sync. Ende Haltephase vorb. KAB" MAP 0x245F3C kf_si16_S6_S3 5000 UMR_MSEC__10_1_0_S6_S3 -5000 0
 /begin AXIS_DESCR STD_AXIS zff_atsys._.iSignale._.obj.sig_m_t UMR_NM__1_1_0_S6_S3 4 -400 1640 DEPOSIT ABSOLUTE MONOTONY MON_INCREASE /end AXIS_DESCR
 /begin AXIS_DESCR STD_AXIS zff_atsys._.iSignale._.obj.sig_n_t UMR_U_MIN_1_1_0_S6_S3 6 0 8160 DEPOSIT ABSOLUTE MONOTONY MON_INCREASE /end AXIS_DESCR
/end CHARACTERISTIC
/begin CHARACTERISTIC KL_TRAMTHINSYNKABSP51 "Zeit fuer Abschalten KAB nach Haltephase in Synchron" CURVE 0x245F88 kl_ui8_S6_S3 2550 UMR_MSEC__10_1_0_S6_S3 0 2550
 /begin AXIS_DESCR STD_AXIS zff_atsys._.iSignale._.obj.sig_m_t8 UMR_NM__8_1_M50_S6_S3 4 -400 1640 DEPOSIT ABSOLUTE MONOTONY MON_INCREASE /end AXIS_DESCR
/end CHARACTERISTIC
/begin CHARACTERISTIC KF_POHINSYNKABSP51 "Kennfeld Haltedruckoffset(n_tkf, m_t) bei Haltephase in Synchron" MAP 0x245F94 kf_si16_S6_S3 12.75 UMR_BAR__1_1000_0_S6_S3 -6.4 6.35
 /begin AXIS_DESCR STD_AXIS iSasZentr.iSchaltend.n_tkf UMR_U_MIN_32_1_0_S6_S3 6 0 8160 DEPOSIT ABSOLUTE MONOTONY MON_INCREASE /end AXIS_DESCR
 /begin AXIS_DESCR STD_AXIS zff_atsys._.iSignale._.obj.sig_m_t UMR_NM__1_1_0_S6_S3 6 -400 1640 DEPOSIT ABSOLUTE MONOTONY MON_INCREASE /end AXIS_DESCR
/end CHARACTERISTIC
/begin CHARACTERISTIC T_HINSYNSP51 "Zeit fuer Ende Haltephase in Synchron KZU/KAB" VALUE 0x26E781 kw_ui8_S6_S3 2540 UMR_MSEC__10_1_0_S6_S3 0 2540 /end CHARACTERISTIC
/begin COMPU_METHOD SAB_A_MPSS10_M11_S2_S3 "int = ((phys * 10) / 1) - (-110) m/s^2" RAT_FUNC "%5.3" "m/s^2" COEFFS 0 10 110 0 0 1 /end COMPU_METHOD
/begin COMPU_METHOD SAB_A_204G100000_M2049_S2_S3 "int = ((phys * 100000) / 204) - (-2049) g" RAT_FUNC "%5.3" "g" COEFFS 0 100000 417996 0 0 204 /end COMPU_METHOD
/begin COMPU_METHOD SAB_A_15G1000_M120_S2_S3 "int = ((phys * 1000) / 15) - (-120) g" RAT_FUNC "%5.3" "g" COEFFS 0 1000 1800 0 0 15 /end COMPU_METHOD
/begin COMPU_METHOD SAB_A_10G1000_M180_S2_S3 "int = ((phys * 1000) / 10) - (-180) g" RAT_FUNC "%5.3" "g" COEFFS 0 1000 1800 0 0 10 /end COMPU_METHOD
/begin COMPU_METHOD SAB_A_G100_M23_S2_S3 "int = ((phys * 100) / 1) - (-23) g" RAT_FUNC "%5.3" "g" COEFFS 0 100 23 0 0 1 /end COMPU_METHOD
/begin COMPU_METHOD SAB_A_G100_M30_S2_S3 "int = ((phys * 100) / 1) - (-30) g" RAT_FUNC "%5.3" "g" COEFFS 0 100 30 0 0 1 /end COMPU_METHOD
/begin COMPU_METHOD SAB_1G100_M127_S2_S3 "int = ((phys * 100) / 1) - (-127) g" RAT_FUNC "%5.3" "g" COEFFS 0 100 127 0 0 1 /end COMPU_METHOD
/begin COMPU_METHOD SAB_A_G100_127M100_S2_S3 "int = ((phys * 100) / 1) - (-127) g" RAT_FUNC "%5.3" "g" COEFFS 0 100 127 0 0 1 /end COMPU_METHOD
/begin COMPU_METHOD UMR___1_1000_0_S6_S3 "int = ((phys * 1000) / 1) - (0) [-]" RAT_FUNC "%5.3" "[-]" COEFFS 0 1000 -0 0 0 1 /end COMPU_METHOD
/begin COMPU_METHOD UMR___1_100_0_S6_S3 "int = ((phys * 100) / 1) - (0) [-]" RAT_FUNC "%4.2" "[-]" COEFFS 0 100 -0 0 0 1 /end COMPU_METHOD
/begin COMPU_METHOD UMR_NM__1_1_0_S6_S3 "int = ((phys * 1) / 1) - (0) [Nm]" RAT_FUNC "%2.0" "[Nm]" COEFFS 0 1 -0 0 0 1 /end COMPU_METHOD
/begin COMPU_METHOD UMR_NM__6_1_M145_S6_S3 "int = ((phys * 1) / 6) - (-145) [Nm]" RAT_FUNC "%2.0" "[Nm]" COEFFS 0 1 870 0 0 6 /end COMPU_METHOD
/begin COMPU_METHOD UMR_NM__8_1_M50_S6_S3 "int = ((phys * 1) / 8) - (-50) [Nm]" RAT_FUNC "%2.0" "[Nm]" COEFFS 0 1 400 0 0 8 /end COMPU_METHOD
/begin COMPU_METHOD UMR_BAR__1_1000_0_S6_S3 "int = ((phys * 1000) / 1) - (0) [bar]" RAT_FUNC "%5.3" "[bar]" COEFFS 0 1000 -0 0 0 1 /end COMPU_METHOD
/begin COMPU_METHOD UMR_BAR_SEC_1_10_0_S6_S3 "int = ((phys * 10) / 1) - (0) [bar/s]" RAT_FUNC "%3.1" "[bar/s]" COEFFS 0 10 -0 0 0 1 /end COMPU_METHOD
/begin COMPU_METHOD UMR_U_MIN_1_1_0_S6_S3 "int = ((phys * 1) / 1) - (0) [U/min]" RAT_FUNC "%2.0" "[U/min]" COEFFS 0 1 -0 0 0 1 /end COMPU_METHOD
/begin COMPU_METHOD UMR_U_MIN_32_1_0_S6_S3 "int = ((phys * 1) / 32) - (0) [U/min]" RAT_FUNC "%2.0" "[U/min]" COEFFS 0 1 -0 0 0 32 /end COMPU_METHOD
/begin COMPU_METHOD UMR_MSEC__1_1_0_S6_S3 "int = ((phys * 1) / 1) - (0) [ms]" RAT_FUNC "%2.0" "[ms]" COEFFS 0 1 -0 0 0 1 /end COMPU_METHOD
/begin COMPU_METHOD UMR_MSEC__10_1_0_S6_S3 "int = ((phys * 1) / 10) - (0) [ms]" RAT_FUNC "%2.0" "[ms]" COEFFS 0 1 -0 0 0 10 /end COMPU_METHOD
/begin COMPU_METHOD UMR_MSEC__10_1_M128_S6_S3 "int = ((phys * 1) / 10) - (-128) [ms]" RAT_FUNC "%2.0" "[ms]" COEFFS 0 1 1280 0 0 10 /end COMPU_METHOD
/begin COMPU_METHOD UMR_PROZENT__20_51_0_S6_S3 "int = ((phys * 51) / 20) - (0) [%]" RAT_FUNC "%6.4" "[%]" COEFFS 0 51 -0 0 0 20 /end COMPU_METHOD
/begin FUNCTION jMoeSasGeG2_Fktn "Applikationesgroessen Instanz jMoeSasGeG2"
 /begin DEF_CHARACTERISTIC KF_FMEHAUPTGEDKINMOT_2 KF_FTSYNNTMEHAUPTE_2 KF_MEHAUPT_2 KL_TSYNMTMEHAUPTE_2 KL_TVMEA_2 K_FMEHAUPTA_2 ND_MEHAUPTAGE_2 T_FMEHAUPTA_2 T_RAMEE_2 T_SPERRSYN_2 /end DEF_CHARACTERISTIC
/end FUNCTION
/begin FUNCTION jMoeSasGeG3_Fktn "Applikationesgroessen Instanz jMoeSasGeG3"
 /begin DEF_CHARACTERISTIC KF_FMEHAUPTGEDKINMOT_3 KF_FTSYNNTMEHAUPTE_3 KF_MEHAUPT_3 KL_TSYNMTMEHAUPTE_3 KL_TVMEA_3 K_FMEHAUPTA_3 ND_MEHAUPTAGE_3 T_FMEHAUPTA_3 T_RAMEE_3 T_SPERRSYN_3 /end DEF_CHARACTERISTIC
/end FUNCTION
/begin FUNCTION jMoeSasGeG4_Fktn "Applikationesgroessen Instanz jMoeSasGeG4"
 /begin DEF_CHARACTERISTIC KF_FMEHAUPTGEDKINMOT_4 KF_FTSYNNTMEHAUPTE_4 KF_MEHAUPT_4 KL_TSYNMTMEHAUPTE_4 KL_TVMEA_4 K_FMEHAUPTA_4 ND_MEHAUPTAGE_4 T_FMEHAUPTA_4 T_RAMEE_4 T_SPERRSYN_4 /end DEF_CHARACTERISTIC
/end FUNCTION
/begin FUNCTION jMoeSasGeG5_Fktn "Applikationesgroessen Instanz jMoeSasGeG5"
 /begin DEF_CHARACTERISTIC KF_FMEHAUPTGEDKINMOT_5 KF_FTSYNNTMEHAUPTE_5 KF_MEHAUPT_5 KL_TSYNMTMEHAUPTE_5 KL_TVMEA_5 K_FMEHAUPTA_5 ND_MEHAUPTAGE_5 T_FMEHAUPTA_5 T_RAMEE_5 T_SPERRSYN_5 /end DEF_CHARACTERISTIC
/end FUNCTION
/begin FUNCTION jMoeSasGeG6_Fktn "Applikationesgroessen Instanz jMoeSasGeG6"
 /begin DEF_CHARACTERISTIC KF_FMEHAUPTGEDKINMOT_6 KF_FTSYNNTMEHAUPTE_6 KF_MEHAUPT_6 KL_TSYNMTMEHAUPTE_6 KL_TVMEA_6 K_FMEHAUPTA_6 ND_MEHAUPTAGE_6 T_FMEHAUPTA_6 T_RAMEE_6 T_SPERRSYN_6 /end DEF_CHARACTERISTIC
/end FUNCTION
/begin FUNCTION jMoeSasGeG7_Fktn "Applikationesgroessen Instanz jMoeSasGeG7"
 /begin DEF_CHARACTERISTIC KF_FMEHAUPTGEDKINMOT_7 KF_FTSYNNTMEHAUPTE_7 KF_MEHAUPT_7 KL_TSYNMTMEHAUPTE_7 KL_TVMEA_7 K_FMEHAUPTA_7 ND_MEHAUPTAGE_7 T_FMEHAUPTA_7 T_RAMEE_7 T_SPERRSYN_7 /end DEF_CHARACTERISTIC
/end FUNCTION
/begin FUNCTION jMoeSasGeG8_Fktn "Applikationesgroessen Instanz jMoeSasGeG8"
 /begin DEF_CHARACTERISTIC KF_FMEHAUPTGEDKINMOT_8 KF_FTSYNNTMEHAUPTE_8 KF_MEHAUPT_8 KL_TSYNMTMEHAUPTE_8 KL_TVMEA_8 K_FMEHAUPTA_8 ND_MEHAUPTAGE_8 T_FMEHAUPTA_8 T_RAMEE_8 T_SPERRSYN_8 /end DEF_CHARACTERISTIC
/end FUNCTION
/begin FUNCTION dMoeSasHSP_Fktn "Applikationesgroessen der Komponente dMoeSasHSP"
 /begin SUB_FUNCTION jMoeSasHSP112_Fktn jMoeSasHSP123_Fktn jMoeSasHSP134_Fktn jMoeSasHSP145_Fktn jMoeSasHSP156_Fktn jMoeSasHSP167_Fktn jMoeSasHSP178_Fktn jMoeSasHSP113_Fktn jMoeSasHSP124_Fktn jMoeSasHSP135_Fktn jMoeSasHSP146_Fktn jMoeSasHSP157_Fktn jMoeSasHSP168_Fktn jMoeSasHSP212_Fktn jMoeSasHSP223_Fktn jMoeSasHSP234_Fktn jMoeSasHSP245_Fktn jMoeSasHSP256_Fktn jMoeSasHSP267_Fktn jMoeSasHSP278_Fktn jMoeSasHSP213_Fktn jMoeSasHSP224_Fktn jMoeSasHSP235_Fktn jMoeSasHSP246_Fktn jMoeSasHSP257_Fktn jMoeSasHSP268_Fktn jMoeSasHSP312_Fktn jMoeSasHSP323_Fktn jMoeSasHSP334_Fktn jMoeSasHSP345_Fktn jMoeSasHSP356_Fktn jMoeSasHSP367_Fktn jMoeSasHSP378_Fktn jMoeSasHSP313_Fktn jMoeSasHSP324_Fktn jMoeSasHSP335_Fktn jMoeSasHSP346_Fktn jMoeSasHSP357_Fktn jMoeSasHSP368_Fktn /end SUB_FUNCTION
/end FUNCTION
/begin FUNCTION jMoeSasHSP112_Fktn "Applikationesgroessen Instanz jMoeSasHSP112"
 /begin DEF_CHARACTERISTIC KF_FMENACHPOSE12 KF_MEHAUPT12 KF_MEHAUPT12_EL KF_MEHAUPT_LRHS12 KF_MEHAUPT_LRHS12_EL KF_MEHYSKLASS12 /end DEF_CHARACTERISTIC
/end FUNCTION
/begin FUNCTION jMoeSasHSP123_Fktn "Applikationesgroessen Instanz jMoeSasHSP123"
 /begin DEF_CHARACTERISTIC KF_FMENACHPOSE23 KF_MEHAUPT23 KF_MEHAUPT23_EL KF_MEHAUPT_LRHS23 KF_MEHAUPT_LRHS23_EL KF_MEHYSKLASS23 /end DEF_CHARACTERISTIC
/end FUNCTION
/begin FUNCTION jMoeSasHSP134_Fktn "Applikationesgroessen Instanz jMoeSasHSP134"
 /begin DEF_CHARACTERISTIC KF_FMENACHPOSE34 KF_MEHAUPT34 KF_MEHAUPT34_EL KF_MEHAUPT_LRHS34 KF_MEHAUPT_LRHS34_EL KF_MEHYSKLASS34 /end DEF_CHARACTERISTIC
/end FUNCTION
/begin FUNCTION jMoeSasHSP145_Fktn "Applikationesgroessen Instanz jMoeSasHSP145"
 /begin DEF_CHARACTERISTIC KF_FMENACHPOSE45 KF_MEHAUPT45 KF_MEHAUPT45_EL KF_MEHAUPT_LRHS45 KF_MEHAUPT_LRHS45_EL KF_MEHYSKLASS45 /end DEF_CHARACTERISTIC
/end FUNCTION
/begin FUNCTION jMoeSasHSP156_Fktn "Applikationesgroessen Instanz jMoeSasHSP156"
 /begin DEF_CHARACTERISTIC KF_FMENACHPOSE56 KF_MEHAUPT56 KF_MEHAUPT56_EL KF_MEHAUPT_LRHS56 KF_MEHAUPT_LRHS56_EL KF_MEHYSKLASS56 /end DEF_CHARACTERISTIC
/end FUNCTION
/begin FUNCTION jMoeSasHSP167_Fktn "Applikationesgroessen Instanz jMoeSasHSP167"
 /begin DEF_CHARACTERISTIC KF_FMENACHPOSE67 KF_MEHAUPT67 KF_MEHAUPT67_EL KF_MEHAUPT_LRHS67 KF_MEHAUPT_LRHS67_EL KF_MEHYSKLASS67 /end DEF_CHARACTERISTIC
/end FUNCTION
/begin FUNCTION jMoeSasHSP178_Fktn "Applikationesgroessen Instanz jMoeSasHSP178"
 /begin DEF_CHARACTERISTIC KF_FMENACHPOSE78 KF_MEHAUPT78 KF_MEHAUPT78_EL KF_MEHAUPT_LRHS78 KF_MEHAUPT_LRHS78_EL KF_MEHYSKLASS78 /end DEF_CHARACTERISTIC
/end FUNCTION
/begin FUNCTION jMoeSasHSP113_Fktn "Applikationesgroessen Instanz jMoeSasHSP113" /begin DEF_CHARACTERISTIC KF_FMENACHPOSE13 KF_MEHAUPT13 KF_MEHAUPT_LRHS13 /end DEF_CHARACTERISTIC /end FUNCTION
/begin FUNCTION jMoeSasHSP124_Fktn "Applikationesgroessen Instanz jMoeSasHSP124" /begin DEF_CHARACTERISTIC KF_FMENACHPOSE24 KF_MEHAUPT24 KF_MEHAUPT_LRHS24 /end DEF_CHARACTERISTIC /end FUNCTION
/begin FUNCTION jMoeSasHSP135_Fktn "Applikationesgroessen Instanz jMoeSasHSP135" /begin DEF_CHARACTERISTIC KF_FMENACHPOSE35 KF_MEHAUPT35 KF_MEHAUPT_LRHS35 /end DEF_CHARACTERISTIC /end FUNCTION
/begin FUNCTION jMoeSasHSP146_Fktn "Applikationesgroessen Instanz jMoeSasHSP146" /begin DEF_CHARACTERISTIC KF_FMENACHPOSE46 KF_MEHAUPT46 KF_MEHAUPT_LRHS46 /end DEF_CHARACTERISTIC /end FUNCTION
/begin FUNCTION jMoeSasHSP157_Fktn "Applikationesgroessen Instanz jMoeSasHSP157" /begin DEF_CHARACTERISTIC KF_FMENACHPOSE57 KF_MEHAUPT57 KF_MEHAUPT_LRHS57 /end DEF_CHARACTERISTIC /end FUNCTION
/begin FUNCTION jMoeSasHSP168_Fktn "Applikationesgroessen Instanz jMoeSasHSP168" /begin DEF_CHARACTERISTIC KF_FMENACHPOSE68 KF_MEHAUPT68 KF_MEHAUPT_LRHS68 /end DEF_CHARACTERISTIC /end FUNCTION
/begin FUNCTION jMoeSasHSP212_Fktn "Applikationesgroessen Instanz jMoeSasHSP212"
 /begin DEF_CHARACTERISTIC KF_FMENACHPOSESP12 KF_MEHAUPTSP12 KF_MEHAUPT_LRHSSP12 KF_MEHYSKLASSSP12 /end DEF_CHARACTERISTIC
/end FUNCTION
/begin FUNCTION jMoeSasHSP223_Fktn "Applikationesgroessen Instanz jMoeSasHSP223"
 /begin DEF_CHARACTERISTIC KF_FMENACHPOSESP23 KF_MEHAUPTSP23 KF_MEHAUPT_LRHSSP23 KF_MEHYSKLASSSP23 /end DEF_CHARACTERISTIC
/end FUNCTION
/begin FUNCTION jMoeSasHSP234_Fktn "Applikationesgroessen Instanz jMoeSasHSP234"
 /begin DEF_CHARACTERISTIC KF_FMENACHPOSESP34 KF_MEHAUPTSP34 KF_MEHAUPT_LRHSSP34 KF_MEHYSKLASSSP34 /end DEF_CHARACTERISTIC
/end FUNCTION
/begin FUNCTION jMoeSasHSP245_Fktn "Applikationesgroessen Instanz jMoeSasHSP245"
 /begin DEF_CHARACTERISTIC KF_FMENACHPOSESP45 KF_MEHAUPTSP45 KF_MEHAUPT_LRHSSP45 KF_MEHYSKLASSSP45 /end DEF_CHARACTERISTIC
/end FUNCTION
/begin FUNCTION jMoeSasHSP256_Fktn "Applikationesgroessen Instanz jMoeSasHSP256"
 /begin DEF_CHARACTERISTIC KF_FMENACHPOSESP56 KF_MEHAUPTSP56 KF_MEHAUPT_LRHSSP56 KF_MEHYSKLASSSP56 /end DEF_CHARACTERISTIC
/end FUNCTION
/begin FUNCTION jMoeSasHSP267_Fktn "Applikationesgroessen Instanz jMoeSasHSP267"
 /begin DEF_CHARACTERISTIC KF_FMENACHPOSESP67 KF_MEHAUPTSP67 KF_MEHAUPT_LRHSSP67 KF_MEHYSKLASSSP67 /end DEF_CHARACTERISTIC
/end FUNCTION
/begin FUNCTION jMoeSasHSP278_Fktn "Applikationesgroessen Instanz jMoeSasHSP278"
 /begin DEF_CHARACTERISTIC KF_FMENACHPOSESP78 KF_MEHAUPTSP78 KF_MEHAUPT_LRHSSP78 KF_MEHYSKLASSSP78 /end DEF_CHARACTERISTIC
/end FUNCTION
/begin FUNCTION jMoeSasHSP213_Fktn "Applikationesgroessen Instanz jMoeSasHSP213" /begin DEF_CHARACTERISTIC KF_FMENACHPOSESP13 KF_MEHAUPTSP13 KF_MEHAUPT_LRHSSP13 /end DEF_CHARACTERISTIC /end FUNCTION
/begin FUNCTION jMoeSasHSP224_Fktn "Applikationesgroessen Instanz jMoeSasHSP224" /begin DEF_CHARACTERISTIC KF_FMENACHPOSESP24 KF_MEHAUPTSP24 KF_MEHAUPT_LRHSSP24 /end DEF_CHARACTERISTIC /end FUNCTION
/begin FUNCTION jMoeSasHSP235_Fktn "Applikationesgroessen Instanz jMoeSasHSP235" /begin DEF_CHARACTERISTIC KF_FMENACHPOSESP35 KF_MEHAUPTSP35 KF_MEHAUPT_LRHSSP35 /end DEF_CHARACTERISTIC /end FUNCTION
/begin FUNCTION jMoeSasHSP246_Fktn "Applikationesgroessen Instanz jMoeSasHSP246" /begin DEF_CHARACTERISTIC KF_FMENACHPOSESP46 KF_MEHAUPTSP46 KF_MEHAUPT_LRHSSP46 /end DEF_CHARACTERISTIC /end FUNCTION
/begin FUNCTION jMoeSasHSP257_Fktn "Applikationesgroessen Instanz jMoeSasHSP257" /begin DEF_CHARACTERISTIC KF_FMENACHPOSESP57 KF_MEHAUPTSP57 KF_MEHAUPT_LRHSSP57 /end DEF_CHARACTERISTIC /end FUNCTION
/begin FUNCTION jMoeSasHSP268_Fktn "Applikationesgroessen Instanz jMoeSasHSP268" /begin DEF_CHARACTERISTIC KF_FMENACHPOSESP68 KF_MEHAUPTSP68 KF_MEHAUPT_LRHSSP68 /end DEF_CHARACTERISTIC /end FUNCTION
/begin FUNCTION jMoeSasHSP312_Fktn "Applikationesgroessen Instanz jMoeSasHSP312"
 /begin DEF_CHARACTERISTIC KF_FMENACHPOSESPORT12 KF_MEHAUPTSPORT12 KF_MEHAUPT_LRHSSPORT12 KF_MEHYSKLASSSPORT12 /end DEF_CHARACTERISTIC
/end FUNCTION
/begin FUNCTION jMoeSasHSP323_Fktn "Applikationesgroessen Instanz jMoeSasHSP323"
 /begin DEF_CHARACTERISTIC KF_FMENACHPOSESPORT23 KF_MEHAUPTSPORT23 KF_MEHAUPT_LRHSSPORT23 KF_MEHYSKLASSSPORT23 /end DEF_CHARACTERISTIC
/end FUNCTION
/begin FUNCTION jMoeSasHSP334_Fktn "Applikationesgroessen Instanz jMoeSasHSP334"
 /begin DEF_CHARACTERISTIC KF_FMENACHPOSESPORT34 KF_MEHAUPTSPORT34 KF_MEHAUPT_LRHSSPORT34 KF_MEHYSKLASSSPORT34 /end DEF_CHARACTERISTIC
/end FUNCTION
/begin FUNCTION jMoeSasHSP345_Fktn "Applikationesgroessen Instanz jMoeSasHSP345"
 /begin DEF_CHARACTERISTIC KF_FMENACHPOSESPORT45 KF_MEHAUPTSPORT45 KF_MEHAUPT_LRHSSPORT45 KF_MEHYSKLASSSPORT45 /end DEF_CHARACTERISTIC
/end FUNCTION
/begin FUNCTION jMoeSasHSP356_Fktn "Applikationesgroessen Instanz jMoeSasHSP356"
 /begin DEF_CHARACTERISTIC KF_FMENACHPOSESPORT56 KF_MEHAUPTSPORT56 KF_MEHAUPT_LRHSSPORT56 KF_MEHYSKLASSSPORT56 /end DEF_CHARACTERISTIC
/end FUNCTION
/begin FUNCTION jMoeSasHSP367_Fktn "Applikationesgroessen Instanz jMoeSasHSP367"
 /begin DEF_CHARACTERISTIC KF_FMENACHPOSESPORT67 KF_MEHAUPTSPORT67 KF_MEHAUPT_LRHSSPORT67 KF_MEHYSKLASSSPORT67 /end DEF_CHARACTERISTIC
/end FUNCTION
/begin FUNCTION jMoeSasHSP378_Fktn "Applikationesgroessen Instanz jMoeSasHSP378"
 /begin DEF_CHARACTERISTIC KF_FMENACHPOSESPORT78 KF_MEHAUPTSPORT78 KF_MEHAUPT_LRHSSPORT78 KF_MEHYSKLASSSPORT78 /end DEF_CHARACTERISTIC
/end FUNCTION
/begin FUNCTION jMoeSasHSP313_Fktn "Applikationesgroessen Instanz jMoeSasHSP313"
 /begin DEF_CHARACTERISTIC KF_FMENACHPOSESPORT13 KF_MEHAUPTSPORT13 KF_MEHAUPT_LRHSSPORT13 /end DEF_CHARACTERISTIC
/end FUNCTION
/begin FUNCTION jMoeSasHSP324_Fktn "Applikationesgroessen Instanz jMoeSasHSP324"
 /begin DEF_CHARACTERISTIC KF_FMENACHPOSESPORT24 KF_MEHAUPTSPORT24 KF_MEHAUPT_LRHSSPORT24 /end DEF_CHARACTERISTIC
/end FUNCTION
/begin FUNCTION jMoeSasHSP335_Fktn "Applikationesgroessen Instanz jMoeSasHSP335"
 /begin DEF_CHARACTERISTIC KF_FMENACHPOSESPORT35 KF_MEHAUPTSPORT35 KF_MEHAUPT_LRHSSPORT35 /end DEF_CHARACTERISTIC
/end FUNCTION
/begin FUNCTION jMoeSasHSP346_Fktn "Applikationesgroessen Instanz jMoeSasHSP346"
 /begin DEF_CHARACTERISTIC KF_FMENACHPOSESPORT46 KF_MEHAUPTSPORT46 KF_MEHAUPT_LRHSSPORT46 /end DEF_CHARACTERISTIC
/end FUNCTION
/begin FUNCTION jMoeSasHSP357_Fktn "Applikationesgroessen Instanz jMoeSasHSP357"
 /begin DEF_CHARACTERISTIC KF_FMENACHPOSESPORT57 KF_MEHAUPTSPORT57 KF_MEHAUPT_LRHSSPORT57 /end DEF_CHARACTERISTIC
/end FUNCTION
/begin FUNCTION jMoeSasHSP368_Fktn "Applikationesgroessen Instanz jMoeSasHSP368"
 /begin DEF_CHARACTERISTIC KF_FMENACHPOSESPORT68 KF_MEHAUPTSPORT68 KF_MEHAUPT_LRHSSPORT68 /end DEF_CHARACTERISTIC
/end FUNCTION
/begin FUNCTION dSasKabRSP_Fktn "Applikationesgroessen der Komponente dSasKabRSP"
 /begin SUB_FUNCTION jSasKabRSP121_Fktn jSasKabRSP132_Fktn jSasKabRSP143_Fktn jSasKabRSP154_Fktn jSasKabRSP165_Fktn jSasKabRSP176_Fktn jSasKabRSP187_Fktn jSasKabRSP221_Fktn jSasKabRSP232_Fktn jSasKabRSP243_Fktn jSasKabRSP254_Fktn jSasKabRSP265_Fktn jSasKabRSP276_Fktn jSasKabRSP287_Fktn jSasKabRSP231_Fktn jSasKabRSP242_Fktn jSasKabRSP251_Fktn jSasKabRSP253_Fktn jSasKabRSP263_Fktn jSasKabRSP264_Fktn jSasKabRSP271_Fktn jSasKabRSP275_Fktn jSasKabRSP282_Fktn jSasKabRSP284_Fktn jSasKabRSP286_Fktn jSasKabRSP321_Fktn jSasKabRSP332_Fktn jSasKabRSP343_Fktn jSasKabRSP354_Fktn jSasKabRSP365_Fktn jSasKabRSP376_Fktn jSasKabRSP387_Fktn jSasKabRSP331_Fktn jSasKabRSP342_Fktn jSasKabRSP351_Fktn jSasKabRSP353_Fktn jSasKabRSP363_Fktn jSasKabRSP364_Fktn jSasKabRSP371_Fktn jSasKabRSP375_Fktn jSasKabRSP382_Fktn jSasKabRSP384_Fktn jSasKabRSP386_Fktn /end SUB_FUNCTION
/end FUNCTION
/begin FUNCTION jSasKabRSP121_Fktn "Applikationesgroessen Instanz jSasKabRSP121"
 /begin DEF_CHARACTERISTIC F_PRAHKAB21 F_PRAHKAB21_EL F_TRAHKAB21 F_TRAHKAB21_EL KF_PKAB21 KF_PKAB21_EL KF_POHINSYNKAB21 KF_TOHKABMTNT21 KF_TOHKABMTNT21_EL KF_TSYNMTNTKABV21 KL_PGOKAB21 KL_POHKAB21 KL_POHKAB21_EL KL_TRAHKAB21 KL_TRAHKAB21_EL KL_TRAMTHINSYNKAB21 KL_TSYNMTKAB21 KL_TSYNMTKAB21_EL T_HINSYN21 /end DEF_CHARACTERISTIC
/end FUNCTION
/begin FUNCTION jSasKabRSP132_Fktn "Applikationesgroessen Instanz jSasKabRSP132"
 /begin DEF_CHARACTERISTIC F_PRAHKAB32 F_PRAHKAB32_EL F_TRAHKAB32 F_TRAHKAB32_EL KF_PKAB32 KF_PKAB32_EL KF_POHINSYNKAB32 KF_TOHKABMTNT32 KF_TOHKABMTNT32_EL KF_TSYNMTNTKABV32 KL_PGOKAB32 KL_POHKAB32 KL_POHKAB32_EL KL_TRAHKAB32 KL_TRAHKAB32_EL KL_TRAMTHINSYNKAB32 KL_TSYNMTKAB32 KL_TSYNMTKAB32_EL T_HINSYN32 /end DEF_CHARACTERISTIC
/end FUNCTION
/begin FUNCTION jSasKabRSP143_Fktn "Applikationesgroessen Instanz jSasKabRSP143"
 /begin DEF_CHARACTERISTIC F_PRAHKAB43 F_PRAHKAB43_EL F_TRAHKAB43 F_TRAHKAB43_EL KF_PKAB43 KF_PKAB43_EL KF_POHINSYNKAB43 KF_TOHKABMTNT43 KF_TOHKABMTNT43_EL KF_TSYNMTNTKABV43 KL_PGOKAB43 KL_POHKAB43 KL_POHKAB43_EL KL_TRAHKAB43 KL_TRAHKAB43_EL KL_TRAMTHINSYNKAB43 KL_TSYNMTKAB43 KL_TSYNMTKAB43_EL T_HINSYN43 /end DEF_CHARACTERISTIC
/end FUNCTION
/begin FUNCTION jSasKabRSP154_Fktn "Applikationesgroessen Instanz jSasKabRSP154"
 /begin DEF_CHARACTERISTIC F_PRAHKAB54 F_PRAHKAB54_EL F_TRAHKAB54 F_TRAHKAB54_EL KF_PKAB54 KF_PKAB54_EL KF_POHINSYNKAB54 KF_TOHKABMTNT54 KF_TOHKABMTNT54_EL KF_TSYNMTNTKABV54 KL_PGOKAB54 KL_POHKAB54 KL_POHKAB54_EL KL_TRAHKAB54 KL_TRAHKAB54_EL KL_TRAMTHINSYNKAB54 KL_TSYNMTKAB54 KL_TSYNMTKAB54_EL T_HINSYN54 /end DEF_CHARACTERISTIC
/end FUNCTION
/begin FUNCTION jSasKabRSP165_Fktn "Applikationesgroessen Instanz jSasKabRSP165"
 /begin DEF_CHARACTERISTIC F_PRAHKAB65 F_PRAHKAB65_EL F_TRAHKAB65 F_TRAHKAB65_EL KF_PKAB65 KF_PKAB65_EL KF_POHINSYNKAB65 KF_TOHKABMTNT65 KF_TOHKABMTNT65_EL KF_TSYNMTNTKABV65 KL_PGOKAB65 KL_POHKAB65 KL_POHKAB65_EL KL_TRAHKAB65 KL_TRAHKAB65_EL KL_TRAMTHINSYNKAB65 KL_TSYNMTKAB65 KL_TSYNMTKAB65_EL T_HINSYN65 /end DEF_CHARACTERISTIC
/end FUNCTION
/begin FUNCTION jSasKabRSP176_Fktn "Applikationesgroessen Instanz jSasKabRSP176"
 /begin DEF_CHARACTERISTIC F_PRAHKAB76 F_PRAHKAB76_EL F_TRAHKAB76 F_TRAHKAB76_EL KF_PKAB76 KF_PKAB76_EL KF_POHINSYNKAB76 KF_TOHKABMTNT76 KF_TOHKABMTNT76_EL KF_TSYNMTNTKABV76 KL_PGOKAB76 KL_POHKAB76 KL_POHKAB76_EL KL_TRAHKAB76 KL_TRAHKAB76_EL KL_TRAMTHINSYNKAB76 KL_TSYNMTKAB76 KL_TSYNMTKAB76_EL T_HINSYN76 /end DEF_CHARACTERISTIC
/end FUNCTION
/begin FUNCTION jSasKabRSP187_Fktn "Applikationesgroessen Instanz jSasKabRSP187"
 /begin DEF_CHARACTERISTIC F_PRAHKAB87 F_PRAHKAB87_EL F_TRAHKAB87 F_TRAHKAB87_EL KF_PKAB87 KF_PKAB87_EL KF_POHINSYNKAB87 KF_TOHKABMTNT87 KF_TOHKABMTNT87_EL KF_TSYNMTNTKABV87 KL_PGOKAB87 KL_POHKAB87 KL_POHKAB87_EL KL_TRAHKAB87 KL_TRAHKAB87_EL KL_TRAMTHINSYNKAB87 KL_TSYNMTKAB87 KL_TSYNMTKAB87_EL T_HINSYN87 /end DEF_CHARACTERISTIC
/end FUNCTION
/begin FUNCTION jSasKabRSP221_Fktn "Applikationesgroessen Instanz jSasKabRSP221"
 /begin DEF_CHARACTERISTIC F_PRAHKABSP21 F_TRAHKABSP21 KF_PKABSP21 KF_POHINSYNKABSP21 KF_TOHKABMTNTSP21 KF_TSYNMTNTKABVSP21 KL_PGOKABSP21 KL_POHKABSP21 KL_TRAHKABSP21 KL_TRAMTHINSYNKABSP21 KL_TSYNMTKABSP21 T_HINSYNSP21 /end DEF_CHARACTERISTIC
/end FUNCTION
/begin FUNCTION jSasKabRSP232_Fktn "Applikationesgroessen Instanz jSasKabRSP232"
 /begin DEF_CHARACTERISTIC F_PRAHKABSP32 F_TRAHKABSP32 KF_PKABSP32 KF_POHINSYNKABSP32 KF_TOHKABMTNTSP32 KF_TSYNMTNTKABVSP32 KL_PGOKABSP32 KL_POHKABSP32 KL_TRAHKABSP32 KL_TRAMTHINSYNKABSP32 KL_TSYNMTKABSP32 T_HINSYNSP32 /end DEF_CHARACTERISTIC
/end FUNCTION
/begin FUNCTION jSasKabRSP243_Fktn "Applikationesgroessen Instanz jSasKabRSP243"
 /begin DEF_CHARACTERISTIC F_PRAHKABSP43 F_TRAHKABSP43 KF_PKABSP43 KF_POHINSYNKABSP43 KF_TOHKABMTNTSP43 KF_TSYNMTNTKABVSP43 KL_PGOKABSP43 KL_POHKABSP43 KL_TRAHKABSP43 KL_TRAMTHINSYNKABSP43 KL_TSYNMTKABSP43 T_HINSYNSP43 /end DEF_CHARACTERISTIC
/end FUNCTION
/begin FUNCTION jSasKabRSP254_Fktn "Applikationesgroessen Instanz jSasKabRSP254"
 /begin DEF_CHARACTERISTIC F_PRAHKABSP54 F_TRAHKABSP54 KF_PKABSP54 KF_POHINSYNKABSP54 KF_TOHKABMTNTSP54 KF_TSYNMTNTKABVSP54 KL_PGOKABSP54 KL_POHKABSP54 KL_TRAHKABSP54 KL_TRAMTHINSYNKABSP54 KL_TSYNMTKABSP54 T_HINSYNSP54 /end DEF_CHARACTERISTIC
/end FUNCTION
/begin FUNCTION jSasKabRSP265_Fktn "Applikationesgroessen Instanz jSasKabRSP265"
 /begin DEF_CHARACTERISTIC F_PRAHKABSP65 F_TRAHKABSP65 KF_PKABSP65 KF_POHINSYNKABSP65 KF_TOHKABMTNTSP65 KF_TSYNMTNTKABVSP65 KL_PGOKABSP65 KL_POHKABSP65 KL_TRAHKABSP65 KL_TRAMTHINSYNKABSP65 KL_TSYNMTKABSP65 T_HINSYNSP65 /end DEF_CHARACTERISTIC
/end FUNCTION
/begin FUNCTION jSasKabRSP276_Fktn "Applikationesgroessen Instanz jSasKabRSP276"
 /begin DEF_CHARACTERISTIC F_PRAHKABSP76 F_TRAHKABSP76 KF_PKABSP76 KF_POHINSYNKABSP76 KF_TOHKABMTNTSP76 KF_TSYNMTNTKABVSP76 KL_PGOKABSP76 KL_POHKABSP76 KL_TRAHKABSP76 KL_TRAMTHINSYNKABSP76 KL_TSYNMTKABSP76 T_HINSYNSP76 /end DEF_CHARACTERISTIC
/end FUNCTION
/begin FUNCTION jSasKabRSP287_Fktn "Applikationesgroessen Instanz jSasKabRSP287"
 /begin DEF_CHARACTERISTIC F_PRAHKABSP87 F_TRAHKABSP87 KF_PKABSP87 KF_POHINSYNKABSP87 KF_TOHKABMTNTSP87 KF_TSYNMTNTKABVSP87 KL_PGOKABSP87 KL_POHKABSP87 KL_TRAHKABSP87 KL_TRAMTHINSYNKABSP87 KL_TSYNMTKABSP87 T_HINSYNSP87 /end DEF_CHARACTERISTIC
/end FUNCTION
/begin FUNCTION jSasKabRSP231_Fktn "Applikationesgroessen Instanz jSasKabRSP231"
 /begin DEF_CHARACTERISTIC F_PRAHKABSP31 F_TRAHKABSP31 KF_PKABSP31 KF_POHINSYNKABSP31 KF_TOHKABMTNTSP31 KF_TSYNMTNTKABVSP31 KL_PGOKABSP31 KL_POHKABSP31 KL_TRAHKABSP31 KL_TRAMTHINSYNKABSP31 KL_TSYNMTKABSP31 T_HINSYNSP31 /end DEF_CHARACTERISTIC
/end FUNCTION
/begin FUNCTION jSasKabRSP242_Fktn "Applikationesgroessen Instanz jSasKabRSP242"
 /begin DEF_CHARACTERISTIC F_PRAHKABSP42 F_TRAHKABSP42 KF_PKABSP42 KF_PKABSP42_EL KF_POHINSYNKABSP42 KF_TOHKABMTNTSP42 KF_TSYNMTNTKABVSP42 KL_PGOKABSP42 KL_POHKABSP42 KL_TRAHKABSP42 KL_TRAHKABSP42_EL KL_TRAMTHINSYNKABSP42 KL_TSYNMTKABSP42 T_HINSYNSP42 /end DEF_CHARACTERISTIC
/end FUNCTION
/begin FUNCTION jSasKabRSP251_Fktn "Applikationesgroessen Instanz jSasKabRSP251"
 /begin DEF_CHARACTERISTIC F_PRAHKABSP51 F_TRAHKABSP51 KF_PKABSP51 KF_POHINSYNKABSP51 KF_TOHKABMTNTSP51 KF_TSYNMTNTKABVSP51 KL_PGOKABSP51 KL_POHKABSP51 KL_TRAHKABSP51 KL_TRAMTHINSYNKABSP51 KL_TSYNMTKABSP51 T_HINSYNSP51 /end DEF_CHARACTERISTIC
/end FUNCTION
/begin RECORD_LAYOUT kw_ui8_S6_S3 FNC_VALUES 1 UBYTE COLUMN_DIR DIRECT /end RECORD_LAYOUT
/begin RECORD_LAYOUT kw_si16_S6_S3 FNC_VALUES 1 SWORD COLUMN_DIR DIRECT /end RECORD_LAYOUT
/begin RECORD_LAYOUT kl_ui8_S6_S3 FNC_VALUES 3 UBYTE COLUMN_DIR DIRECT AXIS_PTS_X 2 UBYTE INDEX_INCR DIRECT NO_AXIS_PTS_X 1 ULONG /end RECORD_LAYOUT
/begin RECORD_LAYOUT kl_si16_S6_S3 FNC_VALUES 3 SWORD COLUMN_DIR DIRECT AXIS_PTS_X 2 SWORD INDEX_INCR DIRECT NO_AXIS_PTS_X 1 ULONG /end RECORD_LAYOUT
/begin RECORD_LAYOUT kf_ui8_S6_S3 FNC_VALUES 5 UBYTE ROW_DIR DIRECT AXIS_PTS_X 3 UBYTE INDEX_INCR DIRECT AXIS_PTS_Y 4 UBYTE INDEX_INCR DIRECT NO_AXIS_PTS_X 1 ULONG NO_AXIS_PTS_Y 2 ULONG /end RECORD_LAYOUT
/begin RECORD_LAYOUT kf_si16_S6_S3 FNC_VALUES 5 SWORD ROW_DIR DIRECT AXIS_PTS_X 3 SWORD INDEX_INCR DIRECT AXIS_PTS_Y 4 SWORD INDEX_INCR DIRECT NO_AXIS_PTS_X 1 ULONG NO_AXIS_PTS_Y 2 ULONG /end RECORD_LAYOUT
/end MODULE
/end PROJECT
