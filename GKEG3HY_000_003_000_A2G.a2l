ASAP2_VERSION 1 51
/begin PROJECT _929_929 "Gen2_BMW_System_Supplier_Lib"
/begin HEADER "" VERSION "C_03_03" PROJECT_NO _929_929 /end HEADER
/begin MODULE DIM ""
/begin MOD_COMMON "" BYTE_ORDER MSB_FIRST ALIGNMENT_BYTE 1 ALIGNMENT_WORD 2 ALIGNMENT_LONG 4 ALIGNMENT_FLOAT32_IEEE 4 /end MOD_COMMON
/begin CHARACTERISTIC BM_ERSFKT_DEAKTIV_ABO_FRK_HAS "Bitmaske zur Festlegung der Diagnose Ersatzfunktionen die zum Austritt aus der ABO Fkt. fuehren" VALUE 0x263368 ULONG_COL_DIRECT_M_S7_S3 0 b_int_M_S7_S3 0 4294967295 /end CHARACTERISTIC
/begin CHARACTERISTIC BM_ERSFKT_HI_96_DEAKTIV_ABO_FRK_HAS "Bitmaske zur Festlegung der Diagnose Ersatzfunktionen (HI-96) die zum Austritt aus der ABO Fkt. fuehren" VALUE 0x263370 ULONG_COL_DIRECT_M_S7_S3 0 b_int_M_S7_S3 0 4294967295 /end CHARACTERISTIC
/begin CHARACTERISTIC BM_ERSFKT_HI_96_VMSTARTVERBOT_FRK_HAS "Bitmaske zur Festlegung der Diagnose Ersatzfunktionen (HI-96) die zur zweiten Anforderung der Beeinflussung der MSA-Funktionalitaet bei aktiver Diagnose-Ersatzfunktion" VALUE 0x263374 ULONG_COL_DIRECT_M_S7_S3 0 b_int_M_S7_S3 0 4294967295 /end CHARACTERISTIC
/begin CHARACTERISTIC BM_ERSFKT_HI_96_ZUST_INIT_FRK_HAS "Bitmaske zur Festlegung der Diagnose Ersatzfunktionen (HI-96) die zum Ruecksprung des Soll-Betriebszustands der Hybrid-Zustandssteuerung
in den Initialisierungszustand fuehren" VALUE 0x263378 ULONG_COL_DIRECT_M_S7_S3 0 b_int_M_S7_S3 0 4294967295 /end CHARACTERISTIC
/begin CHARACTERISTIC BM_ERSFKT_HI_DEAKTIV_ABO_FRK_HAS "Bitmaske zur Festlegung der Diagnose Ersatzfunktionen (HI-Byte) die zum Austritt aus der ABO Fkt. fuehren" VALUE 0x263380 ULONG_COL_DIRECT_M_S7_S3 0 b_int_M_S7_S3 0 4294967295 /end CHARACTERISTIC
/begin CHARACTERISTIC BM_ERSFKT_HI_VMSTARTVERBOT_FRK_HAS "Bitmaske zur Festlegung der Diagnose Ersatzfunktionen (HI-Byte) die zur zweiten Anforderung der Beeinflussung der MSA-FunktionalitDit bei aktiver Diagnose-Ersatzfunktion" VALUE 0x263384 ULONG_COL_DIRECT_M_S7_S3 0 b_int_M_S7_S3 0 4294967295 /end CHARACTERISTIC
/begin CHARACTERISTIC BM_ERSFKT_HI_ZUST_INIT_FRK_HAS "Bitmaske zur Festlegung der Diagnose Ersatzfunktionen (HI-Byte) die zum Ruecksprung des Soll-Betriebszustands der Hybrid-Zustandssteuerung in den Initialisierungszustand fuehren" VALUE 0x263388 ULONG_COL_DIRECT_M_S7_S3 0 b_int_M_S7_S3 0 4294967295 /end CHARACTERISTIC
/begin CHARACTERISTIC BM_ERSFKT_VMSTARTVERBOT_FRK_HAS "Bitmaske zur Festlegung der Diagnose Ersatzfunktionen die zur zweiten Anforderung der Beeinflussung der MSA-Funktionalitaet bei aktiv
er Diagnose-Ersatzfunktion" VALUE 0x26338C ULONG_COL_DIRECT_M_S7_S3 0 b_int_M_S7_S3 0 4294967295 /end CHARACTERISTIC
/begin CHARACTERISTIC BM_ERSFKT_ZUST_INIT_FRK_HAS "Bitmaske zur Festlegung der Diagnose Ersatzfunktionen die zum Ruecksprung des Soll-Betriebszustands der Hybrid-Zustandssteuerung in den Initialisierungszustand fuehren" VALUE 0x263390 ULONG_COL_DIRECT_M_S7_S3 0 b_int_M_S7_S3 0 4294967295 /end CHARACTERISTIC
/begin CHARACTERISTIC FK_NGEM_ANS "Filterkonstante zur Berechnung des EM-Drehzahlgradienten beim Schleppstart" VALUE 0x26AA80 FLOAT32_IEEE_COL_DIRECT_M_S7_S3 0 void_fl_M_S7_S3 0 1 /end CHARACTERISTIC
/begin CHARACTERISTIC FK_NGVM_AST_ABST "Zusaetzliche PT1-Filterung von ng_vm_in zum Vergleich mit der VM-Drehzahlgradientenschwelle zur Vorgabe K0 OEFFNENSW im Zustand VM-Abstellen beim VM Abstellen" VALUE 0x264A3C FLOAT32_IEEE_COL_DIRECT_M_S7_S3 0 ng_fl_M_S7_S3 0 5 /end CHARACTERISTIC
/begin CHARACTERISTIC FK_NSOLLVM_KON_ANS "Filterung der VM-Solldrehzahl im Zustand Konditionieren beim Schleppstart" VALUE 0x26AA84 FLOAT32_IEEE_COL_DIRECT_M_S7_S3 0 t_fl_M_S7_S3 0 1 /end CHARACTERISTIC
/begin CHARACTERISTIC FK_NSOLLVM_SAK_ANS "Filterung der VM-Solldrehzahl im Zustand Schaltung aktiv beim Schleppstart" VALUE 0x26AA88 FLOAT32_IEEE_COL_DIRECT_M_S7_S3 0 t_fl_M_S7_S3 0 1 /end CHARACTERISTIC
/begin CHARACTERISTIC FK_NSOLLVM_SST_ANS "Filterung der VM-Solldrehzahl im Zustand Anschleppen beim Schleppstart" VALUE 0x26AA8C FLOAT32_IEEE_COL_DIRECT_M_S7_S3 0 t_fl_M_S7_S3 0 1 /end CHARACTERISTIC
/begin CHARACTERISTIC FK_NSOLLVM_SYN_ANS "Filterung der VM-Solldrehzahl im Zustand K0 Synchronissieren beim Schleppstart" VALUE 0x26AA90 FLOAT32_IEEE_COL_DIRECT_M_S7_S3 0 t_fl_M_S7_S3 0 1 /end CHARACTERISTIC
/begin CHARACTERISTIC KL_MK0SCHLNICHTMVM_DIHO_Y "Minimales K0-Moment in Abhaengigkeit der VM-Oel-Temperatur zur Erkennung, dass die K0 nicht schliesst." CURVE 0x2633B4 FLOAT32_IEEE_COL_DIRECT_M_S7_S3 0 trq_fl_a_M_S7_S3 -1000 1000
 /begin AXIS_DESCR COM_AXIS c_vm_in trq_fl_a_M_S7_S3 8 -1000 1000 AXIS_PTS_REF KL_MK0SCHLNICHTMVM_DIHO_X /end AXIS_DESCR
/end CHARACTERISTIC
/begin CHARACTERISTIC KL_NDSK0ZUGROSS_ERK_AUW_HAS_Y "Schwelle, oberhalb der erkannt wird, dass der Betrag der K0-Differenzdrehzahl zu hoch ist, in Abhaengigkeit der K0-Solldifferenzdrehzahl" CURVE 0x263404 FLOAT32_IEEE_COL_DIRECT_M_S7_S3 0 n_fl_M_S7_S3 0 10000
 /begin AXIS_DESCR COM_AXIS NO_INPUT_QUANTITY n_fl_M_S7_S3 4 -10000 10000 AXIS_PTS_REF KL_NDSK0ZUGROSS_ERK_AUW_HAS_X /end AXIS_DESCR
/end CHARACTERISTIC
/begin CHARACTERISTIC KL_NDSK0ZUGROSSDDA_ERK_AUW_HAS_Y "Schwelle, oberhalb der bei durchdrehenden Antriebsraedern erkannt wird, dass der Betrag der K0-Differenzdrehzahl zu hoch ist, in Abhaengigkeit der K0-Solldifferenzdrehzahl" CURVE 0x2633E4 FLOAT32_IEEE_COL_DIRECT_M_S7_S3 0 n_fl_M_S7_S3 0 10000
 /begin AXIS_DESCR COM_AXIS NO_INPUT_QUANTITY n_fl_M_S7_S3 4 -10000 10000 AXIS_PTS_REF KL_NDSK0ZUGROSSDDA_ERK_AUW_HAS_X /end AXIS_DESCR
/end CHARACTERISTIC
/begin CHARACTERISTIC KL_NSEMASYNSCL_ERK_AUW_HAS_Y "Schwelle, unterhalb der erkannt wird, dass die EM-Istdrehzahl zu gering ist, in Abhaengigkeit der VM-Leerlauf-Solldrehzahl" CURVE 0x263464 FLOAT32_IEEE_COL_DIRECT_M_S7_S3 0 n_fl_M_S7_S3 0 10000
 /begin AXIS_DESCR COM_AXIS n_soll_ll_vm_in n_fl_M_S7_S3 4 0 10000 AXIS_PTS_REF KL_NSEMASYNSCL_ERK_AUW_HAS_X /end AXIS_DESCR
/end CHARACTERISTIC
/begin CHARACTERISTIC KL_NSEMZUKLEIN_ERK_AUW_HAS_Y "Schwelle, unterhalb der erkannt wird, dass die EM-Istdrehzahl zu gering ist, in Abhaengigkeit des Maximalwerts aus der EMSolldrehzahl der HST und der Leerlauf-Solldrehzahl des VM" CURVE 0x263484 FLOAT32_IEEE_COL_DIRECT_M_S7_S3 0 n_fl_M_S7_S3 0 10000
 /begin AXIS_DESCR COM_AXIS NO_INPUT_QUANTITY n_fl_M_S7_S3 4 0 10000 AXIS_PTS_REF KL_NSEMZUKLEIN_ERK_AUW_HAS_X /end AXIS_DESCR
/end CHARACTERISTIC
/begin CHARACTERISTIC KL_TVNVMZUKLEIN_FILT_AUW_DIHO_Y "Entprellzeit, zur Filterung des Fehlerereignisses, dass die VM-Istdrehzahl zu gering ist in Abhaengigkeit der EM-Istdrehzahl" CURVE 0x2634A4 UWORD_COL_DIRECT_M_S7_S3 0 t_int_n_M_S7_S3 0 300
 /begin AXIS_DESCR COM_AXIS n_em_in n_fl_M_S7_S3 4 0 10000 AXIS_PTS_REF KL_TVNVMZUKLEIN_FILT_AUW_DIHO_X /end AXIS_DESCR
/end CHARACTERISTIC
/begin CHARACTERISTIC MG_SOLLK0_ABB_ANS "Momentgradient fuer m_soll_k0_has" VALUE 0x26AAE8 FLOAT32_IEEE_COL_DIRECT_M_S7_S3 0 trqg_fl_k_M_S7_S3 0 10000 /end CHARACTERISTIC
/begin CHARACTERISTIC MG_SOLLK0_ABB_NOS "Gradienten fuer das K0-Sollmoments der HAS im Zustand Abbruch Nostart beim Notstart" VALUE 0x26AC38 FLOAT32_IEEE_COL_DIRECT_M_S7_S3 0 trqg_fl_k_M_S7_S3 0 50000 /end CHARACTERISTIC
/begin CHARACTERISTIC MG_SOLLK0NEG_GAB_ABST "Gradient zum Abbau des K0 Sollmoments im Zustand 'VM gefuehrt Abstellen' beim VM Abstellen" VALUE 0x264A50 FLOAT32_IEEE_COL_DIRECT_M_S7_S3 0 trqg_fl_k_M_S7_S3 -10000 0 /end CHARACTERISTIC
/begin CHARACTERISTIC MG_SOLLK0POS_GAB_ABST "Gradient zum Anheben des K0 Sollmo-ments im Zustand 'VM gefuehrt Abstellen' beim VM Abstellen" VALUE 0x264A54 FLOAT32_IEEE_COL_DIRECT_M_S7_S3 0 trqg_fl_k_M_S7_S3 0 10000 /end CHARACTERISTIC
/begin CHARACTERISTIC MS_K0NDSK0ZUGROSS_ERK_AUW_HAS "K0-Sollmomentenschwelle bei deren Ueberschreiten von einer nicht erfolgreichen VM-Zwangsankopplung ausgegangen wird." VALUE 0x2634B0 FLOAT32_IEEE_COL_DIRECT_M_S7_S3 0 trq_fl_a_M_S7_S3 -1000 1000 /end CHARACTERISTIC
/begin CHARACTERISTIC MS_K0OEFFNICHT_DIHO "Maximales K0-Moment zur Erkennung K0 oeffnet nicht" VALUE 0x2634B4 FLOAT32_IEEE_COL_DIRECT_M_S7_S3 0 trq_fl_a_M_S7_S3 -1000 1000 /end CHARACTERISTIC
/begin CHARACTERISTIC MS_VMK0OEFFNICHT_DIHO "Maximales VM-Moment zur Erkennung K0 oeffnet nicht" VALUE 0x2634B8 FLOAT32_IEEE_COL_DIRECT_M_S7_S3 0 trq_fl_a_M_S7_S3 -1000 1000 /end CHARACTERISTIC
/begin CHARACTERISTIC NDS_K0K0OEFFNICHT_DIHO "K0-Differenzdrehzahlschwelle als Bedingung zur Anfilterung Fehler K0 oeffnet nicht (nd_k0 = Schwelle)" VALUE 0x2634BC FLOAT32_IEEE_COL_DIRECT_M_S7_S3 0 n_fl_M_S7_S3 0 10000 /end CHARACTERISTIC
/begin CHARACTERISTIC NDS_SOLLVMNVMNVMZUKLEIN_AUW_DIHO "Differenzdrehzahlschwelle zur Erkennung VM-Istdrehzahl zu gering in Relation zur VM-Solldrehzahl der HAS - Abgleich mit Abstimmung Start-Ablauf erforderlich" VALUE 0x2634C0 FLOAT32_IEEE_COL_DIRECT_M_S7_S3 0 n_fl_M_S7_S3 0 10000 /end CHARACTERISTIC
/begin CHARACTERISTIC NDS_VMNEMNVMZUKLEIN_AUW_DIHO "Differenzdrehzahlschwelle zur Erkennung VM-Istdrehzahl zu gering in Relation zur EM-Drehzahl - Abgleich mit Abstimmung Start-Ablauf erforderlich" VALUE 0x2634C4 FLOAT32_IEEE_COL_DIRECT_M_S7_S3 0 n_fl_M_S7_S3 -10000 0 /end CHARACTERISTIC
/begin CHARACTERISTIC NG_EMMODRSMIN_SYN_ANS "Minimaler Gradient der modifizierten EM-Drehzahl als Basisdrehzahl zur Bestimmung der VM Solldrehzahl bei RS beim K0 Synchronisieren beim Schleppstart" VALUE 0x26ABA0 FLOAT32_IEEE_COL_DIRECT_M_S7_S3 0 n_fl_M_S7_S3 -50000 0 /end CHARACTERISTIC
/begin CHARACTERISTIC NGS_VMK0OEFFNICHT_DIHO "Minimaler VM-Gradient zur Erkennung K0 oeffnet nicht" VALUE 0x2634C8 FLOAT32_IEEE_COL_DIRECT_M_S7_S3 0 ng_fl_M_S7_S3 -10000 10000 /end CHARACTERISTIC
/begin CHARACTERISTIC NO_EMK0OEFFNICHT_DIHO "" VALUE 0x2634CC FLOAT32_IEEE_COL_DIRECT_M_S7_S3 0 n_fl_M_S7_S3 -10000 10000 /end CHARACTERISTIC
/begin CHARACTERISTIC NS_EM_MINRDE_HAS "Minimale EM Drehzahl ab der die EM Rueckwaertsdreherkennung die Winkelberechnung beginnt" VALUE 0x26EB0B UBYTE_COL_DIRECT_M_S7_S3 0 n_int_26_M_S7_S3 0 254 /end CHARACTERISTIC
/begin CHARACTERISTIC NS_EMABLWE_ERK_AUW_HAS "Schwelle, unterhalb der erkannt wird, dass die EM-Istdrehzahl zu gering ist." VALUE 0x2634D0 FLOAT32_IEEE_COL_DIRECT_M_S7_S3 0 n_fl_M_S7_S3 0 10000 /end CHARACTERISTIC
/begin CHARACTERISTIC NS_EMK0SCHLNICHT_DIHO "Minimale EM-Drehzahl zur Erkennung, dass die K0 nicht schliesst" VALUE 0x2634D4 FLOAT32_IEEE_COL_DIRECT_M_S7_S3 0 n_fl_M_S7_S3 -10000 10000 /end CHARACTERISTIC
/begin CHARACTERISTIC NS_EMKALTNEMASYNSCL_ERK_AUW_HAS "Schwelle, unterhalb der in der Ablaufvariante 'Kaltstart mit abgesenkter EM Drehzahl' erkannt wird, dass die EM-Istdrehzahl zu gering ist." VALUE 0x2634D8 FLOAT32_IEEE_COL_DIRECT_M_S7_S3 0 n_fl_M_S7_S3 0 10000 /end CHARACTERISTIC
/begin CHARACTERISTIC NS_VMAUS_ERK_AUW_HAS "VM_istdrehzahlschwelle, unterhalb der der VM als ausgeschaltet betrachtet wird" VALUE 0x2634E0 FLOAT32_IEEE_COL_DIRECT_M_S7_S3 0 n_fl_M_S7_S3 0 10000 /end CHARACTERISTIC
/begin CHARACTERISTIC NS_VMK0OEFFNICHT_DIHO "Minimale VM-Drehzahl zur Erkennung K0 oeffnet nicht" VALUE 0x2634E4 FLOAT32_IEEE_COL_DIRECT_M_S7_S3 0 n_fl_M_S7_S3 -10000 10000 /end CHARACTERISTIC
/begin CHARACTERISTIC NS_VMK0SCHLNICHT_DIHO "Maximale VM-Drehzahl zur Erkennung, dass die K0 nicht schliesst" VALUE 0x2634E8 FLOAT32_IEEE_COL_DIRECT_M_S7_S3 0 n_fl_M_S7_S3 -10000 10000 /end CHARACTERISTIC
/begin CHARACTERISTIC PHIS_EMMAXRDE_HAS "Winkelschwelle ab der ein Fehle-reintrag zu EM Rueckwaertsdreherken-nung erfolgt" VALUE 0x26E086 UWORD_COL_DIRECT_M_S7_S3 0 void_int_c_M_S7_S3 0 3600 /end CHARACTERISTIC
/begin CHARACTERISTIC SWI_NSOLLVMNULLAKTIV_FRK_HAS "Schalter zur Aktivierung der VM-Solldrehzahl Vorgabe" VALUE 0x26EB05 UBYTE_COL_DIRECT_M_S7_S3 0 swi_int_M_S7_S3 0 1 /end CHARACTERISTIC
/begin CHARACTERISTIC SWI_STATUSNEMERSATZLLS_FRK_DIHI "Schalter zur Beruecksichtigung der Anzeige eines ersetzten EM-Drehzahlsignals bei der Unterdrueckung der Ausgabe der minimalen EM-Drehzahl" VALUE 0x26EB06 UBYTE_COL_DIRECT_M_S7_S3 0 swi_int_M_S7_S3 0 1 /end CHARACTERISTIC
/begin CHARACTERISTIC SWI_VMSTARTANF_IN_SCHALTUNG_FRK_HAS "Schalter zur Aktivierung Erkennung Aufheben gebruecktes E-Fahren" VALUE 0x26EB07 UBYTE_COL_DIRECT_M_S7_S3 0 swi_int_M_S7_S3 0 1 /end CHARACTERISTIC
/begin CHARACTERISTIC SWI_Z_FEHLER15_ERSATZ_HAS "Ersatzwertumschaltung, 0 Funktionswert kommt durch, 1 Ersatzwert kommt durch" VALUE 0x26EB10 UBYTE_COL_DIRECT_M_S7_S3 0 swi_int_M_S7_S3 0 1 /end CHARACTERISTIC
/begin CHARACTERISTIC SWI_Z_K0NDK0ZUGROSSPB_ERSATZ_HAS "Ersatzwertumschaltung, 0 Funktionswert kommt durch, 1 Ersatzwert kommt durch" VALUE 0x26EB11 UBYTE_COL_DIRECT_M_S7_S3 0 swi_int_M_S7_S3 0 1 /end CHARACTERISTIC
/begin CHARACTERISTIC SWI_Z_K0OEFFNICHTPB_ERSATZ_HAS "Ersatzwertumschaltung, 0 Funktionswert kommt durch, 1 Ersatzwert kommt durch" VALUE 0x26EB12 UBYTE_COL_DIRECT_M_S7_S3 0 swi_int_M_S7_S3 0 1 /end CHARACTERISTIC
/begin CHARACTERISTIC SWI_Z_K0SCHLNICHT_ERSATZ_HAS "Ersatzwertumschaltung 0 Funktionswert kommt durch, 1 Ersatzwert kommt durch" VALUE 0x26EB15 UBYTE_COL_DIRECT_M_S7_S3 0 swi_int_M_S7_S3 0 1 /end CHARACTERISTIC
/begin CHARACTERISTIC SWI_Z_K0SCHLNICHTPB_ERSATZ_HAS "Ersatzwertumschaltung, 0 Funktionswert kommt durch, 1 Ersatzwert kommt durch" VALUE 0x26EB14 UBYTE_COL_DIRECT_M_S7_S3 0 swi_int_M_S7_S3 0 1 /end CHARACTERISTIC
/begin CHARACTERISTIC SWI_Z_K0SCHLNICHTPBZUS_ERSATZ_HAS "Ersatzwertumschaltung, 0 Funktionswert kommt durch, 1 Ersatzwert kommt durch" VALUE 0x26EB13 UBYTE_COL_DIRECT_M_S7_S3 0 swi_int_M_S7_S3 0 1 /end CHARACTERISTIC
/begin CHARACTERISTIC SWI_Z_NEMRDE_ERSATZ_HAS "Ersatzwertumschaltung 0 Funktionswert kommt durch 1 Ersatzwert kommt durch" VALUE 0x26EB16 UBYTE_COL_DIRECT_M_S7_S3 0 swi_int_M_S7_S3 0 1 /end CHARACTERISTIC
/begin CHARACTERISTIC SWI_ZGEBRUEFAHRENAUS_FRK_DIHI "Schalter zur Aktivierung Gebruecktes EFahren AUS durch die HAS Diagnose" VALUE 0x26EB08 UBYTE_COL_DIRECT_M_S7_S3 0 swi_int_M_S7_S3 0 1 /end CHARACTERISTIC
/begin CHARACTERISTIC SWI_ZIEPEIN_FRK_DIHI "Schalter zur Aktivierung der IEP durch die HAS Diagnose" VALUE 0x26EB09 UBYTE_COL_DIRECT_M_S7_S3 0 swi_int_M_S7_S3 0 1 /end CHARACTERISTIC
/begin CHARACTERISTIC SWI_ZNEMASYNSCLAKTIV_DIHO "Schalter zur Aktivierung des Fehlereintrags aufgrund EM-Fehlfunktion waehrend Zustart, was zum asnychronen Schliessen fuehrt." VALUE 0x26EB0D UBYTE_COL_DIRECT_M_S7_S3 0 swi_int_M_S7_S3 0 1 /end CHARACTERISTIC
/begin CHARACTERISTIC SWI_ZSTATUSNEMABLWEAKTIV_DIHO "Schalter zur Aktivierung des Fehlereintrags aufgrund ungueltigem EM-Drehzahlsignal waehrend Schleppstart, was zum Ablaufwechsel fuehrt." VALUE 0x26EB0E UBYTE_COL_DIRECT_M_S7_S3 0 swi_int_M_S7_S3 0 1 /end CHARACTERISTIC
/begin CHARACTERISTIC SWI_ZSTATUSNEMASYNSCLAKTIV_DIHO "Schalter zur Aktivierung des Fehlereintrags aufgrund EM-Fehlfunktion waehrend Zustart, was zum asnychronen Schliessen fuehrt." VALUE 0x26EB0F UBYTE_COL_DIRECT_M_S7_S3 0 swi_int_M_S7_S3 0 1 /end CHARACTERISTIC
/begin CHARACTERISTIC SWI_ZSVHAKTIV_FRK_DIHI "Schalter zur Aktivierung der SVH durch die HAS Diagnose" VALUE 0x26EB0A UBYTE_COL_DIRECT_M_S7_S3 0 swi_int_M_S7_S3 0 1 /end CHARACTERISTIC
/begin CHARACTERISTIC T_VK0NDK0ZUGROSS_FILT_AUW_HAS "Entprellzeit, zur Filterung des Fehlerereignisses, dass die VM-Zwangsankopplung nicht erfolgreich war." VALUE 0x26E088 UWORD_COL_DIRECT_M_S7_S3 0 t_int_n_M_S7_S3 0 300 /end CHARACTERISTIC
/begin CHARACTERISTIC T_VK0OEFFNICHT_ERK_DIHO "Anfilterzeit zur Erkennung eines Fehlers bei K0 oeffnet nicht." VALUE 0x26E08A UWORD_COL_DIRECT_M_S7_S3 0 t_int_n_M_S7_S3 0 10 /end CHARACTERISTIC
/begin CHARACTERISTIC T_VK0SCHLNICHT_ERK_AUW_HAS "Zeit, in der das Schliessen der K0 erkannt werden soll" VALUE 0x26E08C UWORD_COL_DIRECT_M_S7_S3 0 t_int_n_M_S7_S3 0 300 /end CHARACTERISTIC
/begin CHARACTERISTIC T_VK0SCHLNICHT_ERK_DIHO "Anfilterzeit zur Erkennung eines Fehlers bei K0 schliesst nicht" VALUE 0x26E08E UWORD_COL_DIRECT_M_S7_S3 0 t_int_n_M_S7_S3 0 10 /end CHARACTERISTIC
/begin CHARACTERISTIC T_VK0SCHLNICHT_FILT_AUW_HAS "Entprellzeit, zur Filterung des Fehlerereignisses, dass die K0 nicht schliesst." VALUE 0x26E090 UWORD_COL_DIRECT_M_S7_S3 0 t_int_n_M_S7_S3 0 300 /end CHARACTERISTIC
/begin CHARACTERISTIC T_VNDK0ZUGROSS_FILT_AUW_HAS "Entprellzeit, zur Filterung des Fehlerereignisses, dass die K0-Differenzdrehzahl zu hoch ist." VALUE 0x26E094 UWORD_COL_DIRECT_M_S7_S3 0 t_int_n_M_S7_S3 0 300 /end CHARACTERISTIC
/begin CHARACTERISTIC T_VNDK0ZUGROSSDDA_FILT_AUW_HAS "Entprellzeit, zur Filterung des Fehlerereignisses, dass die K0-Differenzdrehzahl bei durchdrehenden Antriebsraedern zu hoch ist" VALUE 0x26E092 UWORD_COL_DIRECT_M_S7_S3 0 t_int_n_M_S7_S3 0 300 /end CHARACTERISTIC
/begin CHARACTERISTIC T_VNEMABLWE_FILT_AUW_HAS "Entprellzeit, zur Filterung des Fehlerereignisses, dass die EM-Istdrehzahl zu gering ist." VALUE 0x26E096 UWORD_COL_DIRECT_M_S7_S3 0 t_int_n_M_S7_S3 0 300 /end CHARACTERISTIC
/begin CHARACTERISTIC T_VNEMASYNSCL_FILT_AUW_HAS "Entprellzeit, zur Filterung des Fehlerereignisses, dass die EM-Istdrehzahl zu gering ist." VALUE 0x26E098 UWORD_COL_DIRECT_M_S7_S3 0 t_int_n_M_S7_S3 0 300 /end CHARACTERISTIC
/begin CHARACTERISTIC T_VNEMZUKLEIN_FILT_AUW_HAS "Entprellzeit, zur Filterung des Fehlerereignisses, dass die EM-Istdrehzahl zu gering ist." VALUE 0x26E09A UWORD_COL_DIRECT_M_S7_S3 0 t_int_n_M_S7_S3 0 300 /end CHARACTERISTIC
/begin CHARACTERISTIC T_VOELVERSFEHLER_FILT_HAS "Entprellzeit zur Filterung des Fehlerereignisses, dass ein Oelversorgungsfehler vorliegt" VALUE 0x26E09E UWORD_COL_DIRECT_M_S7_S3 0 t_int_n_M_S7_S3 0 60 /end CHARACTERISTIC
/begin CHARACTERISTIC T_VOELVERSFEHLERKALT_FILT_HAS "Entprellzeit zur Filterung des Fehlerereignisses, dass ein Oelversorgungsfehler vorliegt" VALUE 0x26E09C UWORD_COL_DIRECT_M_S7_S3 0 t_int_n_M_S7_S3 0 300 /end CHARACTERISTIC
/begin CHARACTERISTIC T_VSTATUSNEM_FILT_AUW_HAS "Entprellzeit, zur Filterung des Fehlerereignisses, dass die EM-Istdrehzahl gestoert ist." VALUE 0x26E0A4 UWORD_COL_DIRECT_M_S7_S3 0 t_int_n_M_S7_S3 0 300 /end CHARACTERISTIC
/begin CHARACTERISTIC T_VSTATUSNEMABLWE_FILT_AUW_HAS "Entprellzeit, zur Filterung des Fehlerereignisses, dass das EM-Drehzahlsignal ungueltig ist." VALUE 0x26E0A0 UWORD_COL_DIRECT_M_S7_S3 0 t_int_n_M_S7_S3 0 300 /end CHARACTERISTIC
/begin CHARACTERISTIC T_VSTATUSNEMASYNSCL_FILT_AUW_HAS "Entprellzeit, zur Filterung des Fehlerereignisses, dass die EM-Istdrehzahl gestoert ist." VALUE 0x26E0A2 UWORD_COL_DIRECT_M_S7_S3 0 t_int_n_M_S7_S3 0 300 /end CHARACTERISTIC
/begin CHARACTERISTIC T_VVMAUS_FILT_AUW_HAS "Entprellzeit, zur Filterung des Fehlerereignisses, dass der VM aus ist." VALUE 0x26E0A6 UWORD_COL_DIRECT_M_S7_S3 0 t_int_n_M_S7_S3 0 300 /end CHARACTERISTIC
/begin CHARACTERISTIC TAB_ZDIAGNOTGANGFUW_FRK_HAS "Tabelle zur Festlegung der Zahlenwerte der Notgang-Information der Diagnose die zu einer Unterbindung der FUW-Aktivierung fuehren - Wert 0: keine Unterbindung aktiv" VAL_BLK 0x26EAE7 UBYTE_COL_DIRECT_M_S7_S3 0 b_int_b_M_S7_S3 0 255 NUMBER 15 /end CHARACTERISTIC
/begin CHARACTERISTIC TAB_ZDIAGNOTGANGLLS_FRK_HAS "Tabelle zur Festlegung der Zahlenwerte der Notgang-Information der Diagnose die zu einer Unterdrueckung der Ausgabe der minimalen EM-Drehzahl fuehren - Wert 0: keine Unterdrueckung aktiv" VAL_BLK 0x26EAF6 UBYTE_COL_DIRECT_M_S7_S3 0 b_int_b_M_S7_S3 0 255 NUMBER 15 /end CHARACTERISTIC
/begin CHARACTERISTIC Z_FEHLER15_ERSATZ_HAS "Ersatzwert zur Uebergabe an den Errorhandler" VALUE 0x26EB17 UBYTE_COL_DIRECT_M_S7_S3 0 sts_int_e_M_S7_S3 0 1 /end CHARACTERISTIC
/begin CHARACTERISTIC Z_K0NDK0ZUGROSSPB_ERSATZ_HAS "Ersatzwert der Pruefbedingung fuer das Ruecksetzen des Fehlers K0-Differenzdrehzahl zu gross der Fehlererkennung der HAS Diagnosefunktionen" VALUE 0x26EB18 UBYTE_COL_DIRECT_M_S7_S3 0 sts_int_e_M_S7_S3 0 1 /end CHARACTERISTIC
/begin CHARACTERISTIC Z_K0OEFFNICHTPB_ERSATZ_HAS "Ersatzwert der Pruefbedingung fuer das Ruecksetzen des Fehles K0 oeffnet nicht der Fehlererkennung der HAS Diagnosefunktionen" VALUE 0x26EB19 UBYTE_COL_DIRECT_M_S7_S3 0 sts_int_e_M_S7_S3 0 1 /end CHARACTERISTIC
/begin CHARACTERISTIC Z_K0SCHLNICHT_ERSATZ_HAS "Ersatzwert der Uebergabe an den Erroshandler zur Ueberwachung der maximalen Dauer der K0-Anstuerung in Druckstellung beim schliessen der K0 im Schleppstart" VALUE 0x26EB1C UBYTE_COL_DIRECT_M_S7_S3 0 sts_int_e_M_S7_S3 0 1 /end CHARACTERISTIC
/begin CHARACTERISTIC Z_K0SCHLNICHTPB_ERSATZ_HAS "Ersatzwert der Pruefbedingung fuer das Ruecksetzen des Fehlers K0 schliesst nicht im Schleppstart der Fehlererkennung der HAS Diagnosefunktionen" VALUE 0x26EB1B UBYTE_COL_DIRECT_M_S7_S3 0 sts_int_e_M_S7_S3 0 1 /end CHARACTERISTIC
/begin CHARACTERISTIC Z_K0SCHLNICHTPBZUS_ERSATZ_HAS "Ersatzwert der Pruefbedingung fuer das Ruecksetzen des Fehlers K0 schliesst nicht im Zustart der Fehlererkennung der HAS Diagnosefunktionen" VALUE 0x26EB1A UBYTE_COL_DIRECT_M_S7_S3 0 sts_int_e_M_S7_S3 0 1 /end CHARACTERISTIC
/begin CHARACTERISTIC Z_KFCC0NOCLOSEMAX_EHO_DIHO "Maximale Anzahl der Fehlerereignisse innerhalb eines Fahrzyklus zur Eintragung des Fehles KFC_C0NOCLOSE der EH-Einbindung der HAS Diagnosefunktionen" VALUE 0x26EB1D UBYTE_COL_DIRECT_M_S7_S3 0 cnt_int_M_S7_S3 0 100 /end CHARACTERISTIC
/begin CHARACTERISTIC Z_KFCC0NOOPENMAX_EHO_DIHO "Maximale Anzahl der Fehlerereignisse innerhalb eines Fahrzyklus zur Eintragung des Fehles KFC_C0NOOPEN der EH-Einbindung der HAS Diagnosefunktionen" VALUE 0x26EB1E UBYTE_COL_DIRECT_M_S7_S3 0 cnt_int_M_S7_S3 0 100 /end CHARACTERISTIC
/begin CHARACTERISTIC Z_NEMRDE_ERSATZ_HAS "Ersatzwert zur Uebergabe an den Errorhandler zur Ueberwachung der EM Rueckdreherkennung" VALUE 0x26EB1F UBYTE_COL_DIRECT_M_S7_S3 0 sts_int_e_M_S7_S3 0 1 /end CHARACTERISTIC
/begin AXIS_PTS KL_MK0SCHLNICHTMVM_DIHO_X "Minimales K0-Moment in Abhaengigkeit der VM-Oel-Temperatur zur Erkennung, dass die K0 nicht schliesst." 0x263394 c_vm_in FLOAT32_IEEE_X_INCR_DIRECT_M_S7_S3 0 trq_fl_a_M_S7_S3 8 -1000 1000 /end AXIS_PTS
/begin AXIS_PTS KL_NDSK0ZUGROSS_ERK_AUW_HAS_X "Schwelle, oberhalb der erkannt wird, dass der Betrag der K0-Differenzdrehzahl zu hoch ist, in Abhaengigkeit der K0-Solldifferenzdrehzahl" 0x2633F4 NO_INPUT_QUANTITY FLOAT32_IEEE_X_INCR_DIRECT_M_S7_S3 0 n_fl_M_S7_S3 4 -10000 10000 /end AXIS_PTS
/begin AXIS_PTS KL_NDSK0ZUGROSSDDA_ERK_AUW_HAS_X "Schwelle, oberhalb der bei durchdrehenden Antriebsraedern erkannt wird, dass der Betrag der K0-Differenzdrehzahl zu hoch ist, in Abhaengigkeit der K0-Solldifferenzdrehzahl" 0x2633D4 NO_INPUT_QUANTITY FLOAT32_IEEE_X_INCR_DIRECT_M_S7_S3 0 n_fl_M_S7_S3 4 -10000 10000 /end AXIS_PTS
/begin AXIS_PTS KL_NSEMASYNSCL_ERK_AUW_HAS_X "Schwelle, unterhalb der erkannt wird, dass die EM-Istdrehzahl zu gering ist, in Abhaengigkeit der VM-Leerlauf-Solldrehzahl" 0x263454 n_soll_ll_vm_in FLOAT32_IEEE_X_INCR_DIRECT_M_S7_S3 0 n_fl_M_S7_S3 4 0 10000 /end AXIS_PTS
/begin AXIS_PTS KL_NSEMZUKLEIN_ERK_AUW_HAS_X "Schwelle, unterhalb der erkannt wird, dass die EM-Istdrehzahl zu gering ist, in Abhaengigkeit des Maximalwerts aus der EMSolldrehzahl der HST und der Leerlauf-Solldrehzahl des VM" 0x263474 NO_INPUT_QUANTITY FLOAT32_IEEE_X_INCR_DIRECT_M_S7_S3 0 n_fl_M_S7_S3 4 0 10000 /end AXIS_PTS
/begin AXIS_PTS KL_TVNVMZUKLEIN_FILT_AUW_DIHO_X "Entprellzeit, zur Filterung des Fehlerereignisses, dass die VM-Istdrehzahl zu gering ist in Abhaengigkeit der EM-Istdrehzahl" 0x263494 n_em_in FLOAT32_IEEE_X_INCR_DIRECT_M_S7_S3 0 n_fl_M_S7_S3 4 0 10000 /end AXIS_PTS
/begin MEASUREMENT abstellpos_vm_in "Abstellposition VM vor naechstem ZOT" UWORD void_int_c_M_S7_S3 1 100 0 360 ECU_ADDRESS 0xFFF86784 /end MEASUREMENT
/begin MEASUREMENT abstellpos_vm_portin "Abstellposition VM vor naechstem ZOT" UBYTE void_int_M_S7_S3 1 100 0 180 ECU_ADDRESS 0xFFF86C86 /end MEASUREMENT
/begin MEASUREMENT abstellpos_vm_status_in "Status Abstellposition VM" UBYTE void_int_M_S7_S3 1 100 0 2 ECU_ADDRESS 0xFFF86CC5 /end MEASUREMENT
/begin MEASUREMENT abstellpos_vm_status_portin "Status Abstellposition VM" UBYTE void_int_M_S7_S3 1 100 0 2 ECU_ADDRESS 0xFFF86C87 /end MEASUREMENT
/begin MEASUREMENT analyse_has_byp "" UBYTE void_int_M_S7_S3 1 100 0 255 ECU_ADDRESS 0xFFF86C12 /end MEASUREMENT
/begin MEASUREMENT ANALYSE_HAS_BYP_VECTOR "Vector fuer Bypass-Groesse analyse_has_byp" UBYTE void_int_M_S7_S3 1 100 0 255 ECU_ADDRESS 0xFFF86BD4 /end MEASUREMENT
/begin MEASUREMENT analyse_has_portout "" UBYTE sts_int_M_S7_S3 1 100 0 8 ECU_ADDRESS 0xFFF8694A /end MEASUREMENT
/begin MEASUREMENT analyse_has_sbe "Bestimmung der Monitoring-Variante fuer die MVG VM-Start " UBYTE void_int_M_S7_S3 1 100 0 8 ECU_ADDRESS 0xFFF86C73 /end MEASUREMENT
/begin MEASUREMENT bErrorHybrid "Anforderung der Strategieanpassung, die Zustandssteuerung (OML) im Error-Modus zu betreiben" UBYTE sts_int_M_S7_S3 1 100 0 1 ECU_ADDRESS 0xFFF86C80 /end MEASUREMENT
/begin MEASUREMENT bExceptionHybrid "Anforderung der Strategieanpassung, die Zustandssteuerung (OML) im Exception-Modus zu betreiben" UBYTE sts_int_M_S7_S3 1 100 0 1 ECU_ADDRESS 0xFFF86C81 /end MEASUREMENT
/begin MEASUREMENT bremspedal_in "Signal Bremsschalter" UBYTE E_BREMSPED_M_S7_S3 1 100 0 1 ECU_ADDRESS 0xFFF86C9B /end MEASUREMENT
/begin MEASUREMENT bremspedal_portin "Signal Bremsschalter" UBYTE E_BREMSPED_M_S7_S3 1 100 0 1 ECU_ADDRESS 0xFFF8691B /end MEASUREMENT
/begin MEASUREMENT byp_vnr_has_byp "" UBYTE void_int_M_S7_S3 1 100 0 255 ECU_ADDRESS 0xFFF86C13 /end MEASUREMENT
/begin MEASUREMENT BYP_VNR_HAS_BYP_VECTOR "Vector fuer Bypass-Groesse byp_vnr_has_byp" UBYTE void_int_M_S7_S3 1 100 0 255 ECU_ADDRESS 0xFFF86BD5 /end MEASUREMENT
/begin MEASUREMENT bypass_has_aktiv "" UBYTE void_int_M_S7_S3 1 100 0 255 ECU_ADDRESS 0xFFF86C14 /end MEASUREMENT
/begin MEASUREMENT c_getriebe_egs_in "" FLOAT32_IEEE c_int_M_S7_S3 1 100 -40 215 ECU_ADDRESS 0xFFF86214 /end MEASUREMENT
/begin MEASUREMENT c_getriebe_egs_portin "" UBYTE void_int_M_S7_S3 1 100 0 255 ECU_ADDRESS 0xFFF8691C /end MEASUREMENT
/begin MEASUREMENT c_umgebung_in "Aussentemperatur gefiltert" FLOAT32_IEEE c_fl_M_S7_S3 1 100 -40 85 ECU_ADDRESS 0xFFF86284 /end MEASUREMENT
/begin MEASUREMENT c_umgebung_portin "Aussentemperatur gefiltert" UBYTE void_int_M_S7_S3 1 100 0 250 ECU_ADDRESS 0xFFF86C88 /end MEASUREMENT
/begin MEASUREMENT c_vm_in "" FLOAT32_IEEE c_fl_M_S7_S3 1 100 -3.40282E+038 3.40282E+038 ECU_ADDRESS 0xFFF86288 /end MEASUREMENT
/begin MEASUREMENT c_vm_portin "" UBYTE void_int_M_S7_S3 1 100 0 255 ECU_ADDRESS 0xFFF86C89 /end MEASUREMENT
/begin MEASUREMENT cnt_kfc_c0noclose_eho_diho "Anzahl der Fehlerereignisse innerhalb eines Fahrzyklus zur Eintragung des Fehles KFC_C0NOCLOSE der EH-Einbindung Out der HAS Diagnosefunktionen Out" UBYTE cnt_int_M_S7_S3 1 100 0 100 ECU_ADDRESS 0xFFF86880 /end MEASUREMENT
/begin MEASUREMENT cnt_kfc_c0noopen_eho_diho "Anzahl der Fehlerereignisse innerhalb eines Fahrzyklus zur Eintragung des Fehles KFC_C0NOOPEN der EH-Einbindung Out der HAS Diagnosefunktionen Out" UBYTE cnt_int_M_S7_S3 1 100 0 100 ECU_ADDRESS 0xFFF86881 /end MEASUREMENT
/begin MEASUREMENT drehrichtung_nab_in "Drehrichtung Abtriebsdrehzahl" UBYTE E_DREHRICH_M_S7_S3 1 100 0 2 ECU_ADDRESS 0xFFF86C9C /end MEASUREMENT
/begin MEASUREMENT drehrichtung_nab_portin "Drehrichtung Abtriebsdrehzahl" UBYTE E_DREHRICH_M_S7_S3 1 100 0 2 ECU_ADDRESS 0xFFF8691D /end MEASUREMENT
/begin MEASUREMENT drehrichtung_nem_in "Drehrichtung der E-Maschine" UBYTE E_DREHRICH_M_S7_S3 1 100 0 2 ECU_ADDRESS 0xFFF86C9D /end MEASUREMENT
/begin MEASUREMENT drehrichtung_nem_portin "Drehrichtung der E-Maschine" UBYTE E_DREHRICH_M_S7_S3 1 100 0 2 ECU_ADDRESS 0xFFF8691E /end MEASUREMENT
/begin MEASUREMENT err_n_soll_em_has_komp_portout "" UBYTE void_int_M_S7_S3 1 100 0 255 ECU_ADDRESS 0xFFF8694B /end MEASUREMENT
/begin MEASUREMENT err_n_soll_em_has_portout "" UBYTE void_int_M_S7_S3 1 100 0 1 ECU_ADDRESS 0xFFF8694C /end MEASUREMENT
/begin MEASUREMENT err_n_soll_vm_has_komp_portout "" UBYTE void_int_M_S7_S3 1 100 0 255 ECU_ADDRESS 0xFFF8694D /end MEASUREMENT
/begin MEASUREMENT err_n_soll_vm_has_portout "" UBYTE void_int_M_S7_S3 1 100 0 1 ECU_ADDRESS 0xFFF8694E /end MEASUREMENT
/begin MEASUREMENT fpw_in "Prozent Fahrpedalstellung" UBYTE rel_int_M_S7_S3 1 100 0 255 ECU_ADDRESS 0xFFF86C9E /end MEASUREMENT
/begin MEASUREMENT fpw_portin "Prozent Fahrpedalstellung" UBYTE void_int_M_S7_S3 1 100 0 100 ECU_ADDRESS 0xFFF8691F /end MEASUREMENT
/begin MEASUREMENT gangwechsel_egs_in "Flag waehrend laufender Schaltung, bei synchron verlassen bis synchron erreicht" UBYTE void_int_M_S7_S3 1 100 0 1 ECU_ADDRESS 0xFFF86C9F /end MEASUREMENT
/begin MEASUREMENT gangwechsel_egs_portin "Flag waehrend laufender Schaltung, bei synchron verlassen bis synchron erreicht" UBYTE void_int_M_S7_S3 1 100 0 1 ECU_ADDRESS 0xFFF86920 /end MEASUREMENT
/begin MEASUREMENT i_gang_lev2_egs_in "Uebergabe der aktuellen Ganguebersetzung i_gang nach ASILB ermittelt aus den Kupplungsstroemen" FLOAT32_IEEE void_fl_M_S7_S3 1 100 -3.40282E+038 3.40282E+038 ECU_ADDRESS 0xFFF86218 /end MEASUREMENT
/begin MEASUREMENT i_gang_lev2_egs_portin "Uebergabe der aktuellen Ganguebersetzung i_gang nach ASILB ermittelt aus den Kupplungsstroemen" SWORD void_int_c_M_S7_S3 1 100 -32768 32767 ECU_ADDRESS 0xFFF86566 /end MEASUREMENT
/begin MEASUREMENT i_istgang_egs "Uebersetzung des aktuellen Gangs" FLOAT32_IEEE ratio_fl_M_S7_S3 1 100 0 8 ECU_ADDRESS 0xFFF861B4 /end MEASUREMENT
/begin MEASUREMENT i_zielgang_egs "Uebersetzung des Zielgangs" FLOAT32_IEEE ratio_fl_M_S7_S3 1 100 0 8 ECU_ADDRESS 0xFFF861B8 /end MEASUREMENT
/begin MEASUREMENT iep_soll_has_byp "" UBYTE st_int_M_S7_S3 1 100 0 255 ECU_ADDRESS 0xFFF86C15 /end MEASUREMENT
/begin MEASUREMENT IEP_SOLL_HAS_BYP_VECTOR "Vector fuer Bypass-Groesse z_modus_iep_has_byp" UBYTE void_int_M_S7_S3 1 100 0 255 ECU_ADDRESS 0xFFF86BD6 /end MEASUREMENT
/begin MEASUREMENT iep_soll_has_portout "" UBYTE E_ZMODUSIEP_M_S7_S3 1 100 0 4 ECU_ADDRESS 0xFFF8694F /end MEASUREMENT
/begin MEASUREMENT init_anfiae_aktiv_ans "Trigger zur Aktivierung des Gradientenbegrenzer" UBYTE void_int_d_M_S7_S3 1 100 0 1 ECU_ADDRESS 0xFFF86A7F /end MEASUREMENT
/begin MEASUREMENT init_n_em_mod_syn_ans "Flag zeigt an, ob n_em_mod_basis_syn_ans neu initialisiert wird" UBYTE sts_int_e_M_S7_S3 1 100 0 1 ECU_ADDRESS 0xFFF86A80 /end MEASUREMENT
/begin MEASUREMENT init_nsollem_grad_ans "Initflag zur Initi. des Gradientenbegrenzer fuer die Ber. n_soll_em" UBYTE void_fl_u_M_S7_S3 1 100 0 1 ECU_ADDRESS 0xFFF86A81 /end MEASUREMENT
/begin MEASUREMENT istgang_egs "" SBYTE sts_int_M_S7_S3 1 100 0 15 ECU_ADDRESS 0xFFF86C9A /end MEASUREMENT
/begin MEASUREMENT istgang_egs_in "" SBYTE void_int_M_S7_S3 1 100 -128 127 ECU_ADDRESS 0xFFF86CA0 /end MEASUREMENT
/begin MEASUREMENT istgang_egs_portin "" SBYTE void_int_M_S7_S3 1 100 -128 127 ECU_ADDRESS 0xFFF86921 /end MEASUREMENT
/begin MEASUREMENT kolbenpos_k0_in "" FLOAT32_IEEE sts_fl_M_S7_S3 1 100 -3.40282E+038 3.40282E+038 ECU_ADDRESS 0xFFF8621C /end MEASUREMENT
/begin MEASUREMENT kolbenpos_k0_portin "" UWORD void_int_c_M_S7_S3 1 100 0 65535 ECU_ADDRESS 0xFFF86568 /end MEASUREMENT
/begin MEASUREMENT m_em_in "" FLOAT32_IEEE trq_fl_a_M_S7_S3 1 100 -1024 1024 ECU_ADDRESS 0xFFF86220 /end MEASUREMENT
/begin MEASUREMENT m_em_portin "" SWORD trq_int_M_S7_S3 1 100 -32768 32767 ECU_ADDRESS 0xFFF8656A /end MEASUREMENT
/begin MEASUREMENT m_iae_in "" FLOAT32_IEEE trq_fl_a_M_S7_S3 1 100 -32768 32767 ECU_ADDRESS 0xFFF86224 /end MEASUREMENT
/begin MEASUREMENT m_iae_portin "" SWORD trq_int_M_S7_S3 1 100 -32768 32767 ECU_ADDRESS 0xFFF8656C /end MEASUREMENT
/begin MEASUREMENT m_k0_has_byp "" SWORD trq_fl_M_S7_S3 1 100 -32768 32767 ECU_ADDRESS 0xFFF86752 /end MEASUREMENT
/begin MEASUREMENT M_K0_HAS_BYP_VECTOR "Vector fuer Bypass-Groesse m_k0_has_byp" UBYTE void_int_M_S7_S3 1 100 0 255 ECU_ADDRESS 0xFFF86BDA /end MEASUREMENT
/begin MEASUREMENT m_k0_has_portout "" SWORD trq_int_M_S7_S3 1 100 0 1000 ECU_ADDRESS 0xFFF86596 /end MEASUREMENT
/begin MEASUREMENT m_k0_has_sbe "K0 Istmoment der Funktion Bestimmung des K0 Istmoments der HAS" FLOAT32_IEEE trq_fl_a_M_S7_S3 1 100 -1000 1000 ECU_ADDRESS 0xFFF861EC /end MEASUREMENT
/begin MEASUREMENT m_k0_in "" FLOAT32_IEEE trq_fl_a_M_S7_S3 1 100 -32768 32767 ECU_ADDRESS 0xFFF86228 /end MEASUREMENT
/begin MEASUREMENT m_k0_mber_has_byp "" SWORD trq_fl_M_S7_S3 1 100 -32768 32767 ECU_ADDRESS 0xFFF86754 /end MEASUREMENT
/begin MEASUREMENT M_K0_MBER_HAS_BYP_VECTOR "Vector fuer Bypass-Groesse m_k0_mber_has_byp" UBYTE void_int_M_S7_S3 1 100 0 255 ECU_ADDRESS 0xFFF86BDB /end MEASUREMENT
/begin MEASUREMENT m_k0_mber_has_portout "" SWORD trq_int_M_S7_S3 1 100 -32768 32767 ECU_ADDRESS 0xFFF865B8 /end MEASUREMENT
/begin MEASUREMENT m_k0_mber_has_sbe "K0-Moment der HAS zur Motormomentbegrenzung in der SAB" FLOAT32_IEEE trq_fl_a_M_S7_S3 1 100 -3.40282E+038 3.40282E+038 ECU_ADDRESS 0xFFF861F0 /end MEASUREMENT
/begin MEASUREMENT m_k0_mod_has_fkt "" FLOAT32_IEEE trq_fl_a_M_S7_S3 1 100 -1200 1200 ECU_ADDRESS 0xFFF86184 /end MEASUREMENT
/begin MEASUREMENT m_k0_portin "" SWORD trq_int_M_S7_S3 1 100 -32768 32767 ECU_ADDRESS 0xFFF8656E /end MEASUREMENT
/begin MEASUREMENT m_max_dyn_em_in "" FLOAT32_IEEE trq_fl_a_M_S7_S3 1 100 -3.40282E+038 3.40282E+038 ECU_ADDRESS 0xFFF8622C /end MEASUREMENT
/begin MEASUREMENT m_max_dyn_em_portin "" SWORD trq_int_M_S7_S3 1 100 -32768 32767 ECU_ADDRESS 0xFFF86570 /end MEASUREMENT
/begin MEASUREMENT m_max_em_has_byp "" SWORD trq_fl_M_S7_S3 1 100 -32768 32767 ECU_ADDRESS 0xFFF86756 /end MEASUREMENT
/begin MEASUREMENT M_MAX_EM_HAS_BYP_VECTOR "Vector fuer Bypass-Groesse m_max_em_has_byp" UBYTE void_int_M_S7_S3 1 100 0 255 ECU_ADDRESS 0xFFF86BDC /end MEASUREMENT
/begin MEASUREMENT m_max_em_has_fkt "" FLOAT32_IEEE trq_fl_a_M_S7_S3 1 100 -1200 1200 ECU_ADDRESS 0xFFF86188 /end MEASUREMENT
/begin MEASUREMENT m_max_em_has_portout "" SWORD trq_int_M_S7_S3 1 100 -32768 32767 ECU_ADDRESS 0xFFF865BA /end MEASUREMENT
/begin MEASUREMENT m_max_iae_has_byp "" SWORD trq_fl_M_S7_S3 1 100 -32768 32767 ECU_ADDRESS 0xFFF86758 /end MEASUREMENT
/begin MEASUREMENT M_MAX_IAE_HAS_BYP_VECTOR "Vector fuer Bypass-Groesse m_max_iae_has_byp" UBYTE void_int_M_S7_S3 1 100 0 255 ECU_ADDRESS 0xFFF86BDD /end MEASUREMENT
/begin MEASUREMENT m_max_iae_has_fkt "" FLOAT32_IEEE trq_fl_a_M_S7_S3 1 100 -1200 1200 ECU_ADDRESS 0xFFF8618C /end MEASUREMENT
/begin MEASUREMENT m_max_iae_has_portout "" SWORD trq_int_M_S7_S3 1 100 -200 1300 ECU_ADDRESS 0xFFF86598 /end MEASUREMENT
/begin MEASUREMENT m_min_dyn_em_in "" FLOAT32_IEEE trq_fl_a_M_S7_S3 1 100 -3.40282E+038 3.40282E+038 ECU_ADDRESS 0xFFF86230 /end MEASUREMENT
/begin MEASUREMENT m_min_dyn_em_portin "" SWORD trq_int_M_S7_S3 1 100 -32768 32767 ECU_ADDRESS 0xFFF86572 /end MEASUREMENT
/begin MEASUREMENT m_min_em_has_byp "" SWORD trq_fl_M_S7_S3 1 100 -32768 32767 ECU_ADDRESS 0xFFF8675A /end MEASUREMENT
/begin MEASUREMENT M_MIN_EM_HAS_BYP_VECTOR "Vector fuer Bypass-Groesse m_min_em_has_byp" UBYTE void_int_M_S7_S3 1 100 0 255 ECU_ADDRESS 0xFFF86BDE /end MEASUREMENT
/begin MEASUREMENT m_min_em_has_fkt "" FLOAT32_IEEE trq_fl_a_M_S7_S3 1 100 -1200 1200 ECU_ADDRESS 0xFFF86190 /end MEASUREMENT
/begin MEASUREMENT m_min_em_has_portout "" SWORD trq_int_M_S7_S3 1 100 -32768 32767 ECU_ADDRESS 0xFFF865BC /end MEASUREMENT
/begin MEASUREMENT m_min_vm_in "" FLOAT32_IEEE trq_fl_a_M_S7_S3 1 100 -3.40282E+038 3.40282E+038 ECU_ADDRESS 0xFFF8628C /end MEASUREMENT
/begin MEASUREMENT m_min_vm_portin "" UWORD trq_int_M_S7_S3 1 100 0 65535 ECU_ADDRESS 0xFFF86776 /end MEASUREMENT
/begin MEASUREMENT m_mot_in "" FLOAT32_IEEE trq_fl_a_M_S7_S3 1 100 -1024 1024 ECU_ADDRESS 0xFFF86234 /end MEASUREMENT
/begin MEASUREMENT m_mot_portin "" SWORD trq_int_M_S7_S3 1 100 -1024 1024 ECU_ADDRESS 0xFFF86574 /end MEASUREMENT
/begin MEASUREMENT m_motmax_has_byp "" SWORD trq_fl_M_S7_S3 1 100 -32768 32767 ECU_ADDRESS 0xFFF8675C /end MEASUREMENT
/begin MEASUREMENT M_MOTMAX_HAS_BYP_VECTOR "Vector fuer Bypass-Groesse z_svh_has_byp" UBYTE void_int_M_S7_S3 1 100 0 255 ECU_ADDRESS 0xFFF86BDF /end MEASUREMENT
/begin MEASUREMENT m_motmax_has_komp_portout "Komplement zu gefuehrtem Getriebeschutz " SWORD trq_int_M_S7_S3 1 100 -32768 32767 ECU_ADDRESS 0xFFF8659A /end MEASUREMENT
/begin MEASUREMENT m_motmax_has_portout "" SWORD trq_int_M_S7_S3 1 100 -32768 32767 ECU_ADDRESS 0xFFF8659C /end MEASUREMENT
/begin MEASUREMENT m_motmax_has_sbe "Maximal zulaessiges Motormoment des Gefuehrten Getriebeschutz der HAS" FLOAT32_IEEE trq_fl_a_M_S7_S3 1 100 -5000 5000 ECU_ADDRESS 0xFFF861F4 /end MEASUREMENT
/begin MEASUREMENT m_soll_em_has_byp "" SWORD trq_fl_M_S7_S3 1 100 -32768 32767 ECU_ADDRESS 0xFFF8675E /end MEASUREMENT
/begin MEASUREMENT M_SOLL_EM_HAS_BYP_VECTOR "Vector fuer Bypass-Groesse m_soll_em_has_byp" UBYTE void_int_M_S7_S3 1 100 0 255 ECU_ADDRESS 0xFFF86BE0 /end MEASUREMENT
/begin MEASUREMENT m_soll_em_has_fkt "" FLOAT32_IEEE trq_fl_a_M_S7_S3 1 100 -1200 1200 ECU_ADDRESS 0xFFF86194 /end MEASUREMENT
/begin MEASUREMENT m_soll_em_has_komp_portout "" SWORD trq_int_M_S7_S3 1 100 -32768 32767 ECU_ADDRESS 0xFFF8659E /end MEASUREMENT
/begin MEASUREMENT m_soll_em_has_portout "" SWORD trq_int_M_S7_S3 1 100 -32768 32767 ECU_ADDRESS 0xFFF865A0 /end MEASUREMENT
/begin MEASUREMENT m_soll_em_hst_in "" FLOAT32_IEEE trq_fl_a_M_S7_S3 1 100 -32768 32767 ECU_ADDRESS 0xFFF86238 /end MEASUREMENT
/begin MEASUREMENT m_soll_em_hst_portin "" SWORD trq_int_M_S7_S3 1 100 -32768 32767 ECU_ADDRESS 0xFFF86576 /end MEASUREMENT
/begin MEASUREMENT m_soll_k0_has_byp "" SWORD trq_fl_M_S7_S3 1 100 -32768 32767 ECU_ADDRESS 0xFFF86760 /end MEASUREMENT
/begin MEASUREMENT M_SOLL_K0_HAS_BYP_VECTOR "Vector fuer Bypass-Groesse m_soll_k0_has_byp" UBYTE void_int_M_S7_S3 1 100 0 255 ECU_ADDRESS 0xFFF86BE1 /end MEASUREMENT
/begin MEASUREMENT m_soll_k0_has_fkt "" FLOAT32_IEEE trq_fl_a_M_S7_S3 1 100 -1200 1200 ECU_ADDRESS 0xFFF86198 /end MEASUREMENT
/begin MEASUREMENT m_soll_k0_has_portout "" SWORD trq_int_M_S7_S3 1 100 -32768 32767 ECU_ADDRESS 0xFFF865A2 /end MEASUREMENT
/begin MEASUREMENT m_soll_k0_has_sbe "K0 Sollmoment der Bestimmung des K0 Sollmoments der HAS" FLOAT32_IEEE trq_fl_a_M_S7_S3 1 100 -1000 1000 ECU_ADDRESS 0xFFF861F8 /end MEASUREMENT
/begin MEASUREMENT m_soll_res_em_bas_sbe "Basis-Reservemoment fuer den VM-Start" FLOAT32_IEEE trq_fl_a_M_S7_S3 1 100 -3.40282E+038 3.40282E+038 ECU_ADDRESS 0xFFF861FC /end MEASUREMENT
/begin MEASUREMENT m_soll_res_em_has_byp "" SWORD trq_fl_M_S7_S3 1 100 -32768 32767 ECU_ADDRESS 0xFFF86762 /end MEASUREMENT
/begin MEASUREMENT M_SOLL_RES_EM_HAS_BYP_VECTOR "Vector fuer Bypass-Groesse m_soll_res_em_has_byp" UBYTE void_int_M_S7_S3 1 100 0 255 ECU_ADDRESS 0xFFF86BE2 /end MEASUREMENT
/begin MEASUREMENT m_soll_res_em_has_fkt "" FLOAT32_IEEE trq_fl_a_M_S7_S3 1 100 -1200 1200 ECU_ADDRESS 0xFFF8619C /end MEASUREMENT
/begin MEASUREMENT m_soll_res_em_has_portout "" SWORD trq_int_M_S7_S3 1 100 0 1000 ECU_ADDRESS 0xFFF865A4 /end MEASUREMENT
/begin MEASUREMENT m_soll_res_em_has_sbe "Reservemoment fuer den VM-Start" FLOAT32_IEEE trq_fl_a_M_S7_S3 1 100 -3.40282E+038 3.40282E+038 ECU_ADDRESS 0xFFF86200 /end MEASUREMENT
/begin MEASUREMENT m_soll_vm_hst_in "" FLOAT32_IEEE trq_fl_a_M_S7_S3 1 100 -32768 32767 ECU_ADDRESS 0xFFF8623C /end MEASUREMENT
/begin MEASUREMENT m_soll_vm_hst_portin "" SWORD trq_int_M_S7_S3 1 100 -32768 32767 ECU_ADDRESS 0xFFF86578 /end MEASUREMENT
/begin MEASUREMENT m_soll_vm_l_hst_in "" FLOAT32_IEEE trq_fl_a_M_S7_S3 1 100 -3.40282E+038 3.40282E+038 ECU_ADDRESS 0xFFF86290 /end MEASUREMENT
/begin MEASUREMENT m_soll_vm_l_hst_portin "Sollfuellungsmoment V-Motor (Luftpfad) der Hybridstrategie" SWORD trq_int_M_S7_S3 1 100 -32767 32767 ECU_ADDRESS 0xFFF86778 /end MEASUREMENT
/begin MEASUREMENT m_stoer_k0_em "Gem. in Output_alt" FLOAT32_IEEE trq_fl_a_M_S7_S3 1 100 -1000 1000 ECU_ADDRESS 0xFFF85E3C /end MEASUREMENT
/begin MEASUREMENT m_vm "" FLOAT32_IEEE trq_fl_a_M_S7_S3 1 100 -3.40282E+038 3.40282E+038 ECU_ADDRESS 0xFFF86210 /end MEASUREMENT
/begin MEASUREMENT m_vm_in "" FLOAT32_IEEE trq_fl_a_M_S7_S3 1 100 -1024 1023.5 ECU_ADDRESS 0xFFF86240 /end MEASUREMENT
/begin MEASUREMENT m_vm_portin "" SWORD trq_int_M_S7_S3 1 100 -32768 32767 ECU_ADDRESS 0xFFF8657A /end MEASUREMENT
/begin MEASUREMENT m_vm_start_in "" FLOAT32_IEEE trq_fl_a_M_S7_S3 1 100 -1024 1023.5 ECU_ADDRESS 0xFFF86244 /end MEASUREMENT
/begin MEASUREMENT m_vm_start_portin "" SWORD trq_int_M_S7_S3 1 100 -32768 32767 ECU_ADDRESS 0xFFF8657C /end MEASUREMENT
/begin MEASUREMENT m_wunsch_fpw_hst_fil "Gefiltertes Wunschmoment" FLOAT32_IEEE trqg_fl_k_M_S7_S3 1 100 -2000 2000 ECU_ADDRESS 0xFFF861BC /end MEASUREMENT
/begin MEASUREMENT m_wunsch_fpw_hst_in "" FLOAT32_IEEE trq_fl_a_M_S7_S3 1 100 -3.40282E+038 3.40282E+038 ECU_ADDRESS 0xFFF86294 /end MEASUREMENT
/begin MEASUREMENT m_wunsch_fpw_hst_portin "gefiltertes Motorsollmoment inklusive aller Momenteneingriffe exkl. Getriebe-Me" SWORD trq_int_M_S7_S3 1 100 -32768 32767 ECU_ADDRESS 0xFFF8677A /end MEASUREMENT
/begin MEASUREMENT m_wunsch_fpw_in "" FLOAT32_IEEE trq_fl_a_M_S7_S3 1 100 -32768 32767 ECU_ADDRESS 0xFFF86248 /end MEASUREMENT
/begin MEASUREMENT m_wunsch_fpw_portin "" SWORD trq_int_M_S7_S3 1 100 -32768 32767 ECU_ADDRESS 0xFFF8657E /end MEASUREMENT
/begin MEASUREMENT m_ziel_k0_hst_in "Target torque of K0 sent by ECU" FLOAT32_IEEE trq_fl_a_M_S7_S3 1 100 -1000 2000 ECU_ADDRESS 0xFFF8624C /end MEASUREMENT
/begin MEASUREMENT m_ziel_k0_hst_portin "Target torque of K0 sent by ECU" SWORD trq_int_M_S7_S3 1 100 -1000 2000 ECU_ADDRESS 0xFFF8677C /end MEASUREMENT
/begin MEASUREMENT mg_mot_in "Gradient des Getriebeeingangsmoment" FLOAT32_IEEE trqg_fl_k_M_S7_S3 1 100 -2000 2000 ECU_ADDRESS 0xFFF861C0 /end MEASUREMENT
/begin MEASUREMENT mg_soll_k0_has_fkt "" FLOAT32_IEEE trqg_fl_k_M_S7_S3 1 100 -3000 3000 ECU_ADDRESS 0xFFF861A0 /end MEASUREMENT
/begin MEASUREMENT mg_soll_k0_neg_has_byp "" SWORD trqg_fl_M_S7_S3 1 100 -32768 32767 ECU_ADDRESS 0xFFF86764 /end MEASUREMENT
/begin MEASUREMENT MG_SOLL_K0_NEG_HAS_BYP_VECTOR "Vector fuer Bypass-Groesse mg_soll_k0_neg_has_byp" UBYTE void_int_M_S7_S3 1 100 0 255 ECU_ADDRESS 0xFFF86BD7 /end MEASUREMENT
/begin MEASUREMENT mg_soll_k0_neg_has_portout "" SWORD trqg_int_M_S7_S3 1 100 -10000 0 ECU_ADDRESS 0xFFF865A6 /end MEASUREMENT
/begin MEASUREMENT mg_soll_k0_pos_has_byp "" SWORD trqg_fl_M_S7_S3 1 100 -32768 32767 ECU_ADDRESS 0xFFF86766 /end MEASUREMENT
/begin MEASUREMENT MG_SOLL_K0_POS_HAS_BYP_VECTOR "Vector fuer Bypass-Groesse mg_soll_k0_pos_has_byp" UBYTE void_int_M_S7_S3 1 100 0 255 ECU_ADDRESS 0xFFF86BD8 /end MEASUREMENT
/begin MEASUREMENT mg_soll_k0_pos_has_portout "" SWORD trqg_int_M_S7_S3 1 100 0 10000 ECU_ADDRESS 0xFFF865A8 /end MEASUREMENT
/begin MEASUREMENT mg_wunsch_fpw_hst_in "Gradient des gefilterten oder koordinierten Fahrerwunschmoments aus Fahrpedalinterpretation" FLOAT32_IEEE trqg_fl_k_M_S7_S3 1 100 -2000 2000 ECU_ADDRESS 0xFFF861C4 /end MEASUREMENT
/begin MEASUREMENT mg_wunsch_fpw_in "Gradient des Fahrerwunschmoments aus Fahrpedalinterpretation" FLOAT32_IEEE trqg_fl_k_M_S7_S3 1 100 -2000 2000 ECU_ADDRESS 0xFFF861C8 /end MEASUREMENT
/begin MEASUREMENT mo_mod_em_hst_has_byp "" SWORD trq_fl_M_S7_S3 1 100 -32768 32767 ECU_ADDRESS 0xFFF86768 /end MEASUREMENT
/begin MEASUREMENT MO_MOD_EM_HST_HAS_BYP_VECTOR "Vector fuer Bypass-Groesse mo_mod_em_hst_has_byp" UBYTE void_int_M_S7_S3 1 100 0 255 ECU_ADDRESS 0xFFF86BD9 /end MEASUREMENT
/begin MEASUREMENT mo_mod_em_hst_has_portout "" SWORD trq_int_M_S7_S3 1 100 -32768 32767 ECU_ADDRESS 0xFFF865BE /end MEASUREMENT
/begin MEASUREMENT modus_e_fahren_hst_in "Electric driving mode concerning state of charging mode of high voltage battery" UBYTE E_MODUSEFAH_M_S7_S3 1 100 0 1 ECU_ADDRESS 0xFFF86CC6 /end MEASUREMENT
/begin MEASUREMENT modus_e_fahren_hst_portin "Electric driving mode concerning state of charging mode of high voltage battery" UBYTE E_MODUSEFAH_M_S7_S3 1 100 0 1 ECU_ADDRESS 0xFFF86C8A /end MEASUREMENT
/begin MEASUREMENT n_ab_egs_in "" FLOAT32_IEEE n_fl_M_S7_S3 1 100 0 65535 ECU_ADDRESS 0xFFF86250 /end MEASUREMENT
/begin MEASUREMENT n_ab_egs_portin "" UWORD n_int_M_S7_S3 1 100 0 65535 ECU_ADDRESS 0xFFF86580 /end MEASUREMENT
/begin MEASUREMENT n_em_in "" FLOAT32_IEEE n_fl_M_S7_S3 1 100 -3.40282E+038 3.40282E+038 ECU_ADDRESS 0xFFF86254 /end MEASUREMENT
/begin MEASUREMENT n_em_portin "" UWORD n_int_M_S7_S3 1 100 0 65535 ECU_ADDRESS 0xFFF86582 /end MEASUREMENT
/begin MEASUREMENT n_min_em_has_sbe "Minimale EM Drehzahl der Leerlaufsimulation der HAS (LLS)" FLOAT32_IEEE n_fl_M_S7_S3 1 100 -32767 32767 ECU_ADDRESS 0xFFF86204 /end MEASUREMENT
/begin MEASUREMENT n_min_em_has_sbe_has_byp "" SWORD n_int_M_S7_S3 1 100 -32768 32767 ECU_ADDRESS 0xFFF8676A /end MEASUREMENT
/begin MEASUREMENT N_MIN_EM_HAS_SBE_HAS_BYP_VECTOR "Vector fuer Bypass-Groesse n_min_em_has_sbe_has_byp" UBYTE void_int_M_S7_S3 1 100 0 255 ECU_ADDRESS 0xFFF86BE4 /end MEASUREMENT
/begin MEASUREMENT n_min_em_psys_lp3_has_sbe "Mindestdrehzahl der EM zur Sicherstellung des Leistungspunkt 3 der Bestimmung des Status Systemdruck der HAS" FLOAT32_IEEE n_fl_M_S7_S3 1 100 0 10000 ECU_ADDRESS 0xFFF861CC /end MEASUREMENT
/begin MEASUREMENT n_mot_idle_tar_has_komp_portout "" UWORD n_int_M_S7_S3 1 100 0 65535 ECU_ADDRESS 0xFFF865AA /end MEASUREMENT
/begin MEASUREMENT n_mot_idle_tar_has_portout "" UWORD n_int_M_S7_S3 1 100 0 2000 ECU_ADDRESS 0xFFF865AC /end MEASUREMENT
/begin MEASUREMENT n_mot_llsoll_has_komp_portout "" UBYTE n_int_26_M_S7_S3 1 100 0 255 ECU_ADDRESS 0xFFF86950 /end MEASUREMENT
/begin MEASUREMENT n_mot_llsoll_has_portout "" UBYTE n_int_26_M_S7_S3 1 100 0 255 ECU_ADDRESS 0xFFF86951 /end MEASUREMENT
/begin MEASUREMENT n_mot_soll_iae_in "" FLOAT32_IEEE n_fl_M_S7_S3 1 100 -3.40282E+038 3.40282E+038 ECU_ADDRESS 0xFFF86258 /end MEASUREMENT
/begin MEASUREMENT n_mot_soll_iae_portin "Soll-Anfahrdrehzahl der IAE" UWORD n_int_M_S7_S3 1 100 0 65535 ECU_ADDRESS 0xFFF86584 /end MEASUREMENT
/begin MEASUREMENT n_sec_iae "Sekundaere IAE-Drehzahl" FLOAT32_IEEE n_fl_M_S7_S3 1 100 -10000 10000 ECU_ADDRESS 0xFFF861D0 /end MEASUREMENT
/begin MEASUREMENT n_soll_em_has_byp "" SWORD n_int_M_S7_S3 1 100 -32768 32767 ECU_ADDRESS 0xFFF8676C /end MEASUREMENT
/begin MEASUREMENT N_SOLL_EM_HAS_BYP_VECTOR "Vector fuer Bypass-Groesse n_soll_em_has_byp" UBYTE void_int_M_S7_S3 1 100 0 255 ECU_ADDRESS 0xFFF86BE5 /end MEASUREMENT
/begin MEASUREMENT n_soll_em_has_fkt "" FLOAT32_IEEE n_fl_M_S7_S3 1 100 0 8000 ECU_ADDRESS 0xFFF861A4 /end MEASUREMENT
/begin MEASUREMENT n_soll_em_has_komp_portout "" UWORD n_int_M_S7_S3 1 100 0 65535 ECU_ADDRESS 0xFFF865AE /end MEASUREMENT
/begin MEASUREMENT n_soll_em_has_portout "" UWORD n_int_M_S7_S3 1 100 0 8000 ECU_ADDRESS 0xFFF865B0 /end MEASUREMENT
/begin MEASUREMENT n_soll_em_hst_in "" FLOAT32_IEEE n_fl_M_S7_S3 1 100 -3.40282E+038 3.40282E+038 ECU_ADDRESS 0xFFF86298 /end MEASUREMENT
/begin MEASUREMENT n_soll_em_hst_portin "" UWORD n_int_M_S7_S3 1 100 0 65535 ECU_ADDRESS 0xFFF8677E /end MEASUREMENT
/begin MEASUREMENT n_soll_ll_vm_in "" FLOAT32_IEEE n_fl_M_S7_S3 1 100 0 2540 ECU_ADDRESS 0xFFF8625C /end MEASUREMENT
/begin MEASUREMENT n_soll_ll_vm_portin "" UWORD n_int_M_S7_S3 1 100 0 65535 ECU_ADDRESS 0xFFF86586 /end MEASUREMENT
/begin MEASUREMENT n_soll_vm_has_byp "" SWORD n_int_M_S7_S3 1 100 -32768 32767 ECU_ADDRESS 0xFFF8676E /end MEASUREMENT
/begin MEASUREMENT N_SOLL_VM_HAS_BYP_VECTOR "Vector fuer Bypass-Groesse n_soll_vm_has_byp" UBYTE void_int_M_S7_S3 1 100 0 255 ECU_ADDRESS 0xFFF86BE6 /end MEASUREMENT
/begin MEASUREMENT n_soll_vm_has_fkt "" FLOAT32_IEEE n_fl_M_S7_S3 1 100 0 8000 ECU_ADDRESS 0xFFF861A8 /end MEASUREMENT
/begin MEASUREMENT n_soll_vm_has_komp_portout "" UWORD n_int_M_S7_S3 1 100 0 65535 ECU_ADDRESS 0xFFF865B2 /end MEASUREMENT
/begin MEASUREMENT n_soll_vm_has_portout "" UWORD n_int_M_S7_S3 1 100 0 8000 ECU_ADDRESS 0xFFF865B4 /end MEASUREMENT
/begin MEASUREMENT n_t_egs_in "" FLOAT32_IEEE n_fl_M_S7_S3 1 100 0 65535 ECU_ADDRESS 0xFFF86260 /end MEASUREMENT
/begin MEASUREMENT n_t_egs_portin "" UWORD n_int_M_S7_S3 1 100 0 65535 ECU_ADDRESS 0xFFF86588 /end MEASUREMENT
/begin MEASUREMENT n_vm_in "" FLOAT32_IEEE n_fl_M_S7_S3 1 100 0 65535 ECU_ADDRESS 0xFFF86264 /end MEASUREMENT
/begin MEASUREMENT n_vm_portin "" UWORD n_int_M_S7_S3 1 100 0 65535 ECU_ADDRESS 0xFFF8658A /end MEASUREMENT
/begin MEASUREMENT n_ziel_em_mod_syn_ans "Initialisierungs/ Ziel-Drehzahl zur Bestimmung der n_em_ref_syn_ans" FLOAT32_IEEE n_fl_M_S7_S3 1 100 -10000 10000 ECU_ADDRESS 0xFFF85E80 /end MEASUREMENT
/begin MEASUREMENT nd_emnsollvm_ans "Differenzdrehzahl zum Abbau des Drehzahloffset auf die Basis-Drehzahl zur Berechnung des Zielwerts der VM Solldrehzahl ab dem Zustand Zuenden beim Schleppstart" FLOAT32_IEEE n_fl_M_S7_S3 1 100 -10000 10000 ECU_ADDRESS 0xFFF85E88 /end MEASUREMENT
/begin MEASUREMENT nd_iae_ans "Differenzdrehzahl der IAE bezogen auf den Getriebeeingang  (n_em_in - n_sec_iae_fil)" FLOAT32_IEEE n_fl_M_S7_S3 1 100 -10000 10000 ECU_ADDRESS 0xFFF85E8C /end MEASUREMENT
/begin MEASUREMENT nd_k0_in "Differenzdrehzahl der Trennkupplung" FLOAT32_IEEE n_fl_M_S7_S3 1 100 -10000 10000 ECU_ADDRESS 0xFFF861D4 /end MEASUREMENT
/begin MEASUREMENT nd_min_saf_has_byp "" UWORD n_int_M_S7_S3 1 100 0 65535 ECU_ADDRESS 0xFFF86770 /end MEASUREMENT
/begin MEASUREMENT ND_MIN_SAF_HAS_BYP_VECTOR "Vector fuer Bypass-Groesse dn_min_saf_has_byp" UBYTE void_int_M_S7_S3 1 100 0 255 ECU_ADDRESS 0xFFF86BE3 /end MEASUREMENT
/begin MEASUREMENT nd_min_saf_has_fkt "Anforderung min. Drehzahlsprung an ASIS" FLOAT32_IEEE n_fl_M_S7_S3 1 100 0 8000 ECU_ADDRESS 0xFFF861AC /end MEASUREMENT
/begin MEASUREMENT nd_min_saf_has_portout "" UWORD n_int_M_S7_S3 1 100 0 1000 ECU_ADDRESS 0xFFF865B6 /end MEASUREMENT
/begin MEASUREMENT nd_soll_iae_fkt "Differenzdrehzahl der Anfahrkupplung" FLOAT32_IEEE ng_fl_M_S7_S3 1 100 -8000 8000 ECU_ADDRESS 0xFFF861B0 /end MEASUREMENT
/begin MEASUREMENT ndg_k0_in "Gradienten der Differenzdrehzahl der Trennkupplung" FLOAT32_IEEE ng_fl_M_S7_S3 1 100 -10000 10000 ECU_ADDRESS 0xFFF861D8 /end MEASUREMENT
/begin MEASUREMENT ng_em_ans "Drehzahlgradient der EM-Ist-Drehzahl" FLOAT32_IEEE ng_fl_M_S7_S3 1 100 -10000 10000 ECU_ADDRESS 0xFFF85EAC /end MEASUREMENT
/begin MEASUREMENT ng_emmodrsmax_syn_ans "Maximaler Gradient der modifizierten EM-Drehzahl als Basisdrehzahl zur Bestimmung der VM Solldrehzahl bei RS beim K0 Synchronisieren beim Schleppstart" FLOAT32_IEEE ng_fl_M_S7_S3 1 100 -10000 10000 ECU_ADDRESS 0xFFF85EB0 /end MEASUREMENT
/begin MEASUREMENT ng_sollem_ans "Drehzahlgradient (Betrag) fuer die Bestimmung der EM-Solldrehzahl" FLOAT32_IEEE ng_fl_M_S7_S3 1 100 -10000 10000 ECU_ADDRESS 0xFFF85EB4 /end MEASUREMENT
/begin MEASUREMENT ng_vm_gef_ast_abst "Gefilterter VM Drehzahlgradient im Zustand \"VM-Abstellen\" beim VM Abstellen" FLOAT32_IEEE ng_fl_M_S7_S3 1 100 -30000 30000 ECU_ADDRESS 0xFFF85DE4 /end MEASUREMENT
/begin MEASUREMENT ng_vm_in "Gradient der VM Drehzahl" FLOAT32_IEEE ng_fl_M_S7_S3 1 100 -10000 10000 ECU_ADDRESS 0xFFF861DC /end MEASUREMENT
/begin MEASUREMENT no_emnsollvm_ans "Drehzahloffset auf die Basis-Drehzahl zur Berechnung des Zielwerts der VM Solldrehzahl ab dem Zustand Konditionieren und in dem Zustand Schaltung aktiv beim Schleppstart" FLOAT32_IEEE n_fl_M_S7_S3 1 100 -10000 10000 ECU_ADDRESS 0xFFF85EB8 /end MEASUREMENT
/begin MEASUREMENT osmode_next_in "" UBYTE sts_int_M_S7_S3 1 100 0 255 ECU_ADDRESS 0xFFF86CA1 /end MEASUREMENT
/begin MEASUREMENT osmode_next_portin "" UBYTE sts_int_M_S7_S3 1 100 0 255 ECU_ADDRESS 0xFFF86922 /end MEASUREMENT
/begin MEASUREMENT p_bremse_fzg_in "" FLOAT32_IEEE p_fl_M_S7_S3 1 100 0 127 ECU_ADDRESS 0xFFF86268 /end MEASUREMENT
/begin MEASUREMENT p_bremse_fzg_portin "" UWORD void_int_c_M_S7_S3 1 100 0 65535 ECU_ADDRESS 0xFFF8658C /end MEASUREMENT
/begin MEASUREMENT pc_ok_has_byp "" UBYTE void_int_M_S7_S3 1 100 0 255 ECU_ADDRESS 0xFFF86C16 /end MEASUREMENT
/begin MEASUREMENT PC_OK_HAS_BYP_VECTOR "Vector fuer Bypass-Groesse pc_ok_has_byp" UBYTE void_int_M_S7_S3 1 100 0 255 ECU_ADDRESS 0xFFF86BE7 /end MEASUREMENT
/begin MEASUREMENT phi_em_rde_has "Berechneter Winkel in Grad, um die sich der EM rueckwaerts gedreht hat." UWORD void_int_c_M_S7_S3 1 100 0 3600 ECU_ADDRESS 0xFFF86538 /end MEASUREMENT
/begin MEASUREMENT phi_neigung_in "" FLOAT32_IEEE phigrad_fl_M_S7_S3 1 100 -3.40282E+038 3.40282E+038 ECU_ADDRESS 0xFFF8626C /end MEASUREMENT
/begin MEASUREMENT phi_neigung_portin "" UBYTE void_int_M_S7_S3 1 100 0 255 ECU_ADDRESS 0xFFF86923 /end MEASUREMENT
/begin MEASUREMENT pos_egs_in "Waehlhebelposition" UBYTE E_POS_M_S7_S3 1 100 0 8 ECU_ADDRESS 0xFFF86CA2 /end MEASUREMENT
/begin MEASUREMENT pos_egs_portin "Waehlhebelposition" UBYTE E_POS_M_S7_S3 1 100 0 8 ECU_ADDRESS 0xFFF86924 /end MEASUREMENT
/begin MEASUREMENT posv_timer_portin "Flag ob Timerbedingungen fuer PosV Diagnose erfuellt sind" UBYTE sts_int_M_S7_S3 1 100 0 255 ECU_ADDRESS 0xFFF86C8B /end MEASUREMENT
/begin MEASUREMENT posvueb_aktiv_portin "Anforderung der  PosV Diagnose einer Drehzahlanhebung und der Deaktivierung der IEP " UBYTE sts_int_M_S7_S3 1 100 0 255 ECU_ADDRESS 0xFFF86C8C /end MEASUREMENT
/begin MEASUREMENT SAoEEP1 "" FLOAT32_IEEE void_fl_M_S7_S3 1 100 -3.40282E+038 3.40282E+038 ECU_ADDRESS 0xFFF8629C /end MEASUREMENT
/begin MEASUREMENT SAoEEP2 "" FLOAT32_IEEE void_fl_M_S7_S3 1 100 -3.40282E+038 3.40282E+038 ECU_ADDRESS 0xFFF862A0 /end MEASUREMENT
/begin MEASUREMENT schalt_mode_egs_in "" UWORD void_int_c_M_S7_S3 1 100 0 65535 ECU_ADDRESS 0xFFF86780 /end MEASUREMENT
/begin MEASUREMENT schalt_mode_egs_portin "" UWORD void_int_c_M_S7_S3 1 100 0 65535 ECU_ADDRESS 0xFFF8658E /end MEASUREMENT
/begin MEASUREMENT soc_in "Interface provides state of charge of high-voltage battery" UBYTE rel_int_M_S7_S3 1 100 0 100 ECU_ADDRESS 0xFFF86CC7 /end MEASUREMENT
/begin MEASUREMENT soc_portin "Interface provides state of charge of high-voltage battery" UBYTE void_int_M_S7_S3 1 100 0 100 ECU_ADDRESS 0xFFF86C8D /end MEASUREMENT
/begin MEASUREMENT sollgang_egs_in "" SBYTE void_int_M_S7_S3 1 100 -128 127 ECU_ADDRESS 0xFFF86CA3 /end MEASUREMENT
/begin MEASUREMENT sollgang_egs_portin "" SBYTE void_int_M_S7_S3 1 100 -128 127 ECU_ADDRESS 0xFFF86925 /end MEASUREMENT
/begin MEASUREMENT st_ablauf_fkt "Phase des Ablauf" UWORD st_int_g_M_S7_S3 1 100 0 65535 ECU_ADDRESS 0xFFF86774 /end MEASUREMENT
/begin MEASUREMENT st_ist_bz_has_byp "" UBYTE st_int_M_S7_S3 1 100 0 255 ECU_ADDRESS 0xFFF86C17 /end MEASUREMENT
/begin MEASUREMENT ST_IST_BZ_HAS_BYP_VECTOR "Vector fuer Bypass-Groesse st_ist_bz_has_byp" UBYTE void_int_M_S7_S3 1 100 0 255 ECU_ADDRESS 0xFFF86BEB /end MEASUREMENT
/begin MEASUREMENT st_ist_bz_has_portout "Ist-Betriebszustand der HAS" UBYTE sts_int_M_S7_S3 1 100 0 255 ECU_ADDRESS 0xFFF86952 /end MEASUREMENT
/begin MEASUREMENT st_ist_bz_has_stg "Istzustand OML" UBYTE E_STBZHAS_M_S7_S3 1 100 0 15 ECU_ADDRESS 0xFFF86C55 /end MEASUREMENT
/begin MEASUREMENT st_ist_bz_hst_sta "Ist-Betriebszustand aus der Startegieanpassung als Eingangsgroesse der Hybridzustandssteuerung (OML)" UBYTE E_STBZHAS_M_S7_S3 1 100 0 15 ECU_ADDRESS 0xFFF86C82 /end MEASUREMENT
/begin MEASUREMENT st_ist_hcomd_has_stg "Innere Zustaende der OML" UWORD st_int_g_M_S7_S3 1 100 0 4999 ECU_ADDRESS 0xFFF86772 /end MEASUREMENT
/begin MEASUREMENT st_soll_bz_has_hst "interner HST Soll-Betriebszustand der Strategieanpassung (variantenunabhaengig)" UBYTE sts_int_M_S7_S3 1 100 0 15 ECU_ADDRESS 0xFFF86C83 /end MEASUREMENT
/begin MEASUREMENT st_soll_bz_hst_sta "Soll-Betriebszustand aus der Strategieanpassung als Eingangsgroesse der Hybrid-Zustandssteuerung (OML)" UBYTE E_STBZHAS_M_S7_S3 1 100 0 15 ECU_ADDRESS 0xFFF86C84 /end MEASUREMENT
/begin MEASUREMENT st_ziel_bz_has_byp "" UBYTE st_int_M_S7_S3 1 100 0 255 ECU_ADDRESS 0xFFF86C18 /end MEASUREMENT
/begin MEASUREMENT ST_ZIEL_BZ_HAS_BYP_VECTOR "Vector fuer Bypass-Groesse st_ziel_bz_has_byp" UBYTE void_int_M_S7_S3 1 100 0 255 ECU_ADDRESS 0xFFF86BEC /end MEASUREMENT
/begin MEASUREMENT st_ziel_bz_has_portout "Ziel-Betriebszustand der HAS" UBYTE sts_int_M_S7_S3 1 100 0 255 ECU_ADDRESS 0xFFF86953 /end MEASUREMENT
/begin MEASUREMENT st_ziel_bz_has_stg "Zielzustand OML" UBYTE E_STBZHAS_M_S7_S3 1 100 0 15 ECU_ADDRESS 0xFFF86C56 /end MEASUREMENT
/begin MEASUREMENT status_ablauf_has_byp "" UBYTE sts_int_M_S7_S3 1 100 0 255 ECU_ADDRESS 0xFFF86C19 /end MEASUREMENT
/begin MEASUREMENT STATUS_ABLAUF_HAS_BYP_VECTOR "Vector fuer Bypass-Groesse status_ablauf_has_fkt_byp" UBYTE void_int_M_S7_S3 1 100 0 255 ECU_ADDRESS 0xFFF86BE9 /end MEASUREMENT
/begin MEASUREMENT status_ablauf_has_fkt "" UBYTE sts_int_M_S7_S3 1 100 0 50 ECU_ADDRESS 0xFFF86C5A /end MEASUREMENT
/begin MEASUREMENT status_ablauf_has_portout "" UBYTE sts_int_M_S7_S3 1 100 0 15 ECU_ADDRESS 0xFFF86954 /end MEASUREMENT
/begin MEASUREMENT status_ablaufaktiv_has_byp "" UBYTE sts_int_M_S7_S3 1 100 0 255 ECU_ADDRESS 0xFFF86C1A /end MEASUREMENT
/begin MEASUREMENT STATUS_ABLAUFAKTIV_HAS_BYP_VECTOR "Vector fuer Bypass-Groesse ablauf_aktiv_has_byp" UBYTE void_int_M_S7_S3 1 100 0 255 ECU_ADDRESS 0xFFF86BE8 /end MEASUREMENT
/begin MEASUREMENT status_ablaufaktiv_has_portout "" UBYTE sts_int_M_S7_S3 1 100 0 255 ECU_ADDRESS 0xFFF86955 /end MEASUREMENT
/begin MEASUREMENT status_abs_in "Information, ob aktuell ein Eingriff durch das ABS System vorgenommen wird" UBYTE E_STATUSABS_M_S7_S3 1 100 0 2 ECU_ADDRESS 0xFFF86CC8 /end MEASUREMENT
/begin MEASUREMENT status_abs_portin "Information ob aktuell ein Eingriff durch das ABS System vorgenommen wird" UBYTE E_STATUSABS_M_S7_S3 1 100 0 2 ECU_ADDRESS 0xFFF86C8E /end MEASUREMENT
/begin MEASUREMENT status_alaengs_adaoff_in "Information, ob die Adaptionen aufgrund erkannter Laengsbeschleunigung deaktiviert wird. 0 = Adaption aktiv aufgrund erkannter Laengsbeschleunigung
1 = Adaption inaktiv aufgrund nicht erkannter Laengsbeschleunigung" UBYTE sts_int_M_S7_S3 1 100 0 1 ECU_ADDRESS 0xFFF86CA4 /end MEASUREMENT
/begin MEASUREMENT status_alaengs_adaoff_portin "Information, ob die Adaptionen aufgrund erkannter Laengsbeschleunigung deaktiviert wird. 0 = Adaption aktiv aufgrund erkannter Laengsbeschleunigung
1 = Adaption inaktiv aufgrund nicht erkannter Laengsbeschleunigung" UBYTE sts_int_M_S7_S3 1 100 0 1 ECU_ADDRESS 0xFFF86926 /end MEASUREMENT
/begin MEASUREMENT status_asr_in "Information, ob ein Regeleingriff durch ein Assistenzsystem (ESP, ASR) vorliegt" UBYTE E_STATUSASR_M_S7_S3 1 100 0 1 ECU_ADDRESS 0xFFF86CC9 /end MEASUREMENT
/begin MEASUREMENT status_asr_portin "Information ob aktuell ein Eingriff durch das ABS System vorgenommen wird" UBYTE E_STATUSASR_M_S7_S3 1 100 0 1 ECU_ADDRESS 0xFFF86C8F /end MEASUREMENT
/begin MEASUREMENT status_autohold_in "Status der Systeme zur Fahrzeug- Rollverhinderung" UBYTE E_STATUSNAA_M_S7_S3 1 100 0 1 ECU_ADDRESS 0xFFF86CA5 /end MEASUREMENT
/begin MEASUREMENT status_betriebsber_hst_portin "Status Fahrbereitschaft (Hybridsystem)" UBYTE sts_int_M_S7_S3 1 100 0 15 ECU_ADDRESS 0xFFF86C90 /end MEASUREMENT
/begin MEASUREMENT status_betriebsbereit_hst_in "" UBYTE sts_int_M_S7_S3 1 100 0 1 ECU_ADDRESS 0xFFF86CCA /end MEASUREMENT
/begin MEASUREMENT status_c_k0_in "Interface returns information concerning energy balance of clutch 0" UBYTE E_STATUSCK0_M_S7_S3 1 100 0 2 ECU_ADDRESS 0xFFF86CA6 /end MEASUREMENT
/begin MEASUREMENT status_c_k0_portin "Interface returns information concerning energy balance of clutch 0" UBYTE sts_int_M_S7_S3 1 100 0 3 ECU_ADDRESS 0xFFF86927 /end MEASUREMENT
/begin MEASUREMENT status_cumgebung_in "Statusinformation in GET_CKB_TOUT" UBYTE E_SIGSTATUS_M_S7_S3 1 100 0 2 ECU_ADDRESS 0xFFF86CCB /end MEASUREMENT
/begin MEASUREMENT status_cumgebung_portin "Statusinformation in GET_CKB_TOUT" UBYTE E_SIGSTATUS_M_S7_S3 1 100 0 2 ECU_ADDRESS 0xFFF86C91 /end MEASUREMENT
/begin MEASUREMENT status_ee_busy_portin "" UBYTE sts_int_M_S7_S3 1 100 0 1 ECU_ADDRESS 0xFFF86928 /end MEASUREMENT
/begin MEASUREMENT status_efahren_has_byp "" UBYTE sts_int_M_S7_S3 1 100 0 255 ECU_ADDRESS 0xFFF86C1B /end MEASUREMENT
/begin MEASUREMENT STATUS_EFAHREN_HAS_BYP_VECTOR "Vector fuer Bypass-Groesse status_efahren_has_byp" UBYTE void_int_M_S7_S3 1 100 0 255 ECU_ADDRESS 0xFFF86BEA /end MEASUREMENT
/begin MEASUREMENT status_efahren_has_portout "" UBYTE sts_int_M_S7_S3 1 100 0 1 ECU_ADDRESS 0xFFF86956 /end MEASUREMENT
/begin MEASUREMENT status_efahren_has_sbe "Status E-Fahren der HAS zur Festlegung der entsprechenden Portout-Groesse in der HAS Signalaufbereitung_Out" UBYTE sts_int_M_S7_S3 1 100 0 1 ECU_ADDRESS 0xFFF86C74 /end MEASUREMENT
/begin MEASUREMENT status_fahranf_hst_portin "Interface returns request to drive detailed of transmission environment" ULONG sts_int_m_M_S7_S3 1 100 0 4294967295 ECU_ADDRESS 0xFFF8620C /end MEASUREMENT
/begin MEASUREMENT status_fehler_iep_in "" UBYTE E_FEHLERIEP_M_S7_S3 1 100 0 1 ECU_ADDRESS 0xFFF86CA7 /end MEASUREMENT
/begin MEASUREMENT status_fehler_iep_portin "" UBYTE E_FEHLERIEP_M_S7_S3 1 100 0 1 ECU_ADDRESS 0xFFF86929 /end MEASUREMENT
/begin MEASUREMENT status_fehlererk_diho "Bitcodierte Sammelgroesse, welche Informationen ueber alle gesetzte Flags liefert." ULONG void_int_f_M_S7_S3 1 100 0 4294967295 ECU_ADDRESS 0xFFF85B6C /end MEASUREMENT
/begin MEASUREMENT status_fzg_rollverhinderung_portin "Status der Systeme zur Fahrzeug- Rollverhinderung" UBYTE sts_int_M_S7_S3 1 100 0 3 ECU_ADDRESS 0xFFF8692A /end MEASUREMENT
/begin MEASUREMENT status_gangwechsel_znd_ans "Zeigt in Verbindung mit Parallelisierung SLST + Schaltung, ob die Schaltung in der Phase VM zuenden zu Ende ist." UBYTE sts_int_e_M_S7_S3 1 100 0 1 ECU_ADDRESS 0xFFF86A82 /end MEASUREMENT
/begin MEASUREMENT status_getrbereit_in "Status des hydraulischen Drucks des Getriebes" UBYTE sts_int_M_S7_S3 1 100 0 255 ECU_ADDRESS 0xFFF86CCC /end MEASUREMENT
/begin MEASUREMENT status_getrbereit_portin "Status des hydraulischen Drucks des Getriebes" UBYTE sts_int_M_S7_S3 1 100 0 255 ECU_ADDRESS 0xFFF86C92 /end MEASUREMENT
/begin MEASUREMENT status_hillhold_in "Status der Systeme zur Fahrzeug- Rollverhinderung" UBYTE E_STATUSNAA_M_S7_S3 1 100 0 1 ECU_ADDRESS 0xFFF86CA8 /end MEASUREMENT
/begin MEASUREMENT status_iae_adap_in "Status der Adaption des Integrierten Anfahrelements IAE" UBYTE E_STATUSADA_M_S7_S3 1 100 0 2 ECU_ADDRESS 0xFFF86CA9 /end MEASUREMENT
/begin MEASUREMENT status_iae_adap_portin "Status der Adaption des Integrierten Anfahrelements IAE" UBYTE E_STATUSADA_M_S7_S3 1 100 0 2 ECU_ADDRESS 0xFFF8692B /end MEASUREMENT
/begin MEASUREMENT status_iae_in "" UBYTE E_STATUSIAE_M_S7_S3 1 100 0 8 ECU_ADDRESS 0xFFF86CAA /end MEASUREMENT
/begin MEASUREMENT status_iae_portin "" UBYTE E_STATUSIAE_M_S7_S3 1 100 0 8 ECU_ADDRESS 0xFFF8692C /end MEASUREMENT
/begin MEASUREMENT status_iep_in "" UBYTE E_STATUSIEP_M_S7_S3 1 100 0 4 ECU_ADDRESS 0xFFF86CAB /end MEASUREMENT
/begin MEASUREMENT status_iep_portin "" UBYTE E_STATUSIEP_M_S7_S3 1 100 0 4 ECU_ADDRESS 0xFFF8692D /end MEASUREMENT
/begin MEASUREMENT status_k0_adap_in "" UBYTE E_STATUSADA_M_S7_S3 1 100 0 2 ECU_ADDRESS 0xFFF86CAC /end MEASUREMENT
/begin MEASUREMENT status_k0_adap_portin "Status der Adaption der Trennkupplung K0" UBYTE E_STATUSADA_M_S7_S3 1 100 0 2 ECU_ADDRESS 0xFFF8692E /end MEASUREMENT
/begin MEASUREMENT status_k0_adap_zaehler_in "Zaehler k0 adaption" UBYTE void_int_M_S7_S3 1 100 0 255 ECU_ADDRESS 0xFFF86CAD /end MEASUREMENT
/begin MEASUREMENT status_k0_adapf_zaehler_portin "Zaehlerstand der Fuelldruckadaption der uebergebenen Kupplung" UBYTE void_int_M_S7_S3 1 100 0 255 ECU_ADDRESS 0xFFF8692F /end MEASUREMENT
/begin MEASUREMENT status_k0_adatsf_zaehler_portin "Zaehlerstand der Schnellfuellzeitadaption der uebergebenen Kupplung" UBYTE void_int_M_S7_S3 1 100 0 255 ECU_ADDRESS 0xFFF86930 /end MEASUREMENT
/begin MEASUREMENT status_k0_befuellung_in "Interface provides the current filling mode of clutch 0" UBYTE E_STAK0BEF_M_S7_S3 1 100 0 3 ECU_ADDRESS 0xFFF86CAE /end MEASUREMENT
/begin MEASUREMENT status_k0_befuellung_portin "Interface provides the current filling mode of clutch 0" UBYTE E_STAK0BEF_M_S7_S3 1 100 0 3 ECU_ADDRESS 0xFFF86931 /end MEASUREMENT
/begin MEASUREMENT status_k0_in "" UBYTE E_STATUSK0_M_S7_S3 1 100 0 5 ECU_ADDRESS 0xFFF86CAF /end MEASUREMENT
/begin MEASUREMENT status_k0_portin "" UBYTE E_STATUSK0_M_S7_S3 1 100 0 5 ECU_ADDRESS 0xFFF86932 /end MEASUREMENT
/begin MEASUREMENT status_kl15_in "" UBYTE sts_int_M_S7_S3 1 100 0 1 ECU_ADDRESS 0xFFF86CCD /end MEASUREMENT
/begin MEASUREMENT status_kraftfluss_egs_in "" UBYTE E_STATUSKSL_M_S7_S3 1 100 0 6 ECU_ADDRESS 0xFFF86CB0 /end MEASUREMENT
/begin MEASUREMENT status_kraftfluss_lev2_egs_in "Power flow (controled) information concerning ASIL B" UBYTE sts_int_M_S7_S3 1 100 0 2 ECU_ADDRESS 0xFFF86CB1 /end MEASUREMENT
/begin MEASUREMENT status_kraftfluss_lev2_egs_portin "Power flow (controled) information concerning ASIL B." UBYTE void_int_M_S7_S3 1 100 0 2 ECU_ADDRESS 0xFFF86933 /end MEASUREMENT
/begin MEASUREMENT status_kraftschl_atsys_portin "" UBYTE E_STATUSKSL_M_S7_S3 1 100 0 6 ECU_ADDRESS 0xFFF86934 /end MEASUREMENT
/begin MEASUREMENT status_lastwechsel_srt_ans "Zeigt an wenn der Lastwechsel in der Phase Start abgeschlossen ist" UBYTE sts_int_e_M_S7_S3 1 100 0 1 ECU_ADDRESS 0xFFF86A85 /end MEASUREMENT
/begin MEASUREMENT status_ll_vm_in "" UBYTE sts_int_M_S7_S3 1 100 0 255 ECU_ADDRESS 0xFFF86CB2 /end MEASUREMENT
/begin MEASUREMENT status_nem_in "Status zur Drehzahl E-Motor" UBYTE E_SIGSTATUS_M_S7_S3 1 100 0 2 ECU_ADDRESS 0xFFF86CB3 /end MEASUREMENT
/begin MEASUREMENT status_nem_portin "Status zur Drehzahl E-Motor" UBYTE E_SIGSTATUS_M_S7_S3 1 100 0 2 ECU_ADDRESS 0xFFF86935 /end MEASUREMENT
/begin MEASUREMENT status_nreg_em_hst_in "" UBYTE sts_int_M_S7_S3 1 100 0 255 ECU_ADDRESS 0xFFF86CCE /end MEASUREMENT
/begin MEASUREMENT status_nreg_em_hst_portin "Status E-Motor Drehzahlregelung der HST" UBYTE sts_int_M_S7_S3 1 100 0 255 ECU_ADDRESS 0xFFF86C93 /end MEASUREMENT
/begin MEASUREMENT status_nvm_in "Status zur Drehzahl VM-Motor" UBYTE E_SIGSTATUS_M_S7_S3 1 100 0 2 ECU_ADDRESS 0xFFF86CB4 /end MEASUREMENT
/begin MEASUREMENT status_nvm_portin "Status zur Drehzahl VM-Motor" UBYTE E_SIGSTATUS_M_S7_S3 1 100 0 2 ECU_ADDRESS 0xFFF86936 /end MEASUREMENT
/begin MEASUREMENT status_phineigung_portin "" UBYTE sts_int_M_S7_S3 1 100 0 255 ECU_ADDRESS 0xFFF86937 /end MEASUREMENT
/begin MEASUREMENT status_posvueb_in "Erkennung PosV Diagnose" UBYTE sts_int_M_S7_S3 1 100 0 255 ECU_ADDRESS 0xFFF86CCF /end MEASUREMENT
/begin MEASUREMENT status_psys_has_sbe "Anzeige des Status Pumpendruck der HAS" UBYTE E_STATUSPSY_M_S7_S3 1 100 0 4 ECU_ADDRESS 0xFFF86C6C /end MEASUREMENT
/begin MEASUREMENT status_radschlupf_rse_has_sbe "Anzeige des Status der Radschlupferkennung (RSE) der HAS" UBYTE E_STATUSRSE_M_S7_S3 1 100 0 1 ECU_ADDRESS 0xFFF86C6D /end MEASUREMENT
/begin MEASUREMENT status_sa_vm_in "00 Keine Beeinflussung; 01 Schubabschaltung aktiv; 10 Nicht stellbarer Bereich; 11 Signal ungueltig" UBYTE sts_int_e_M_S7_S3 1 100 0 1 ECU_ADDRESS 0xFFF86CD0 /end MEASUREMENT
/begin MEASUREMENT status_sa_vm_portin "00 Keine Beeinflussung; 01 Schubabschaltung aktiv; 10 Nicht stellbarer Bereich; 11 Signal ungueltig" UBYTE sts_int_M_S7_S3 1 100 0 3 ECU_ADDRESS 0xFFF86C94 /end MEASUREMENT
/begin MEASUREMENT status_schaltart_svh_has_sbe "Schaltart der angeforderten Schaltung der Schaltverhinderung der HAS (0 = keine Schaltung angefordert) - Bit-Codierung (m/oL = mit/ohne Lastanh.) =  bit0=ZRSmL, 1=ZHSmL, 2=SRSmL, 3=SHSmL, 4=ZRSoL, 5=ZHSoL, 6=SRSoL, 7=SHSoL" UBYTE sts_int_M_S7_S3 1 100 0 255 ECU_ADDRESS 0xFFF86C6E /end MEASUREMENT
/begin MEASUREMENT status_schaltung_egs_in "Anzeige ob Schaltung des Getriebes aktiv ist" SBYTE sts_int_M_S7_S3 1 100 -9 9 ECU_ADDRESS 0xFFF86C6F /end MEASUREMENT
/begin MEASUREMENT status_soc_in "Interface provides status information of soc_in" UBYTE E_SIGSTATUS_M_S7_S3 1 100 0 2 ECU_ADDRESS 0xFFF86CD1 /end MEASUREMENT
/begin MEASUREMENT status_soc_portin "Interface provides status information of soc_portin" UBYTE E_SIGSTATUS_M_S7_S3 1 100 0 2 ECU_ADDRESS 0xFFF86C95 /end MEASUREMENT
/begin MEASUREMENT status_sync_schaltung_sbe "Anzeige der Synchronerkennung der aktuellen Schaltung innerhalb der HAS" UBYTE sts_int_M_S7_S3 1 100 0 1 ECU_ADDRESS 0xFFF86C70 /end MEASUREMENT
/begin MEASUREMENT status_vf_in "Signalstatus fuer die Fahrzeugistgeschwindigkeit  gebildet aus der Getriebe-Abtriebsdrehzahl" UBYTE E_SIGSTATUS_M_S7_S3 1 100 0 2 ECU_ADDRESS 0xFFF86CB5 /end MEASUREMENT
/begin MEASUREMENT status_vf_portin "Signalstatus fuer die Fahrzeugistgeschwindigkeit  gebildet aus der Getriebe-Abtriebsdrehzahl" UBYTE E_SIGSTATUS_M_S7_S3 1 100 0 2 ECU_ADDRESS 0xFFF86938 /end MEASUREMENT
/begin MEASUREMENT status_vfref_in "Signalstatus fuer die Fahrzeuggeschwindigkeit ueber Grund" UBYTE E_SIGSTATUS_M_S7_S3 1 100 0 2 ECU_ADDRESS 0xFFF86CB6 /end MEASUREMENT
/begin MEASUREMENT status_vfref_portin "Signalstatus fuer die Fahrzeuggeschwindigkeit ueber Grund" UBYTE E_SIGSTATUS_M_S7_S3 1 100 0 2 ECU_ADDRESS 0xFFF86939 /end MEASUREMENT
/begin MEASUREMENT status_waschstr_in "" UBYTE sts_int_M_S7_S3 1 100 0 255 ECU_ADDRESS 0xFFF86CB7 /end MEASUREMENT
/begin MEASUREMENT status_waschstr_portin "Zustand der N-Halte-Phase" UBYTE sts_int_M_S7_S3 1 100 0 255 ECU_ADDRESS 0xFFF8693A /end MEASUREMENT
/begin MEASUREMENT t_betrieb_pvu_has_byp "" ULONG t_int_M_S7_S3 1 100 0 42949672.95 ECU_ADDRESS 0xFFF86180 /end MEASUREMENT
/begin MEASUREMENT T_BETRIEB_PVU_HAS_BYP_VECTOR "Vector fuer Bypass-Groesse t_betrieb_pvu_has_byp" UBYTE void_int_M_S7_S3 1 100 0 255 ECU_ADDRESS 0xFFF86BED /end MEASUREMENT
/begin MEASUREMENT t_betrieb_pvu_has_ee_in "" ULONG t_int_M_S7_S3 1 100 0 10000 ECU_ADDRESS 0xFFF86270 /end MEASUREMENT
/begin MEASUREMENT t_betrieb_pvu_has_ee_portin "" ULONG t_int_M_S7_S3 1 100 0 42949672.95 ECU_ADDRESS 0xFFF85B90 /end MEASUREMENT
/begin MEASUREMENT t_betrieb_pvu_has_portout "Timer fuer Diagnose Positionsventil" ULONG t_int_M_S7_S3 1 100 0 42949672.95 ECU_ADDRESS 0xFFF85C20 /end MEASUREMENT
/begin MEASUREMENT t_betrieb_pvu_has_sbe "Betriebsdauer seit dem letzten Ablauf der Diagnosefunktion \"Positionsventil-Ueberwachung\" der Funktion zur Unterstuet-zung der Positionsventil-Ueberwachung der HAS" ULONG t_int_M_S7_S3 1 100 0 1000000 ECU_ADDRESS 0xFFF861E0 /end MEASUREMENT
/begin MEASUREMENT t_k0_ndk0zugross_filt_auw_has "Timer zur Filterung des Fehlerereignisses, dass eine VM-Zwangsankopplung bei zu grosser K0-Differenzdrehzahl keine Verbesserung erzielte" UWORD t_int_n_M_S7_S3 1 100 0 300 ECU_ADDRESS 0xFFF8653A /end MEASUREMENT
/begin MEASUREMENT t_k0oeffnicht_has "Timer zur Filterung des Fehlers K0 oeffnet nicht der Fehlererkennung der HAS Diagnosefunktionen" UWORD t_int_n_M_S7_S3 1 100 0 10 ECU_ADDRESS 0xFFF8653C /end MEASUREMENT
/begin MEASUREMENT t_k0schlnicht_ans_filt_auw_has "HAS-Diagnose: Timer zur Ueberwachung der maximalen Dauer der K0-Ansteuerung in Drickstellung schliessen der K0 im Schleppstart." UWORD t_int_n_M_S7_S3 1 100 0 10 ECU_ADDRESS 0xFFF8653E /end MEASUREMENT
/begin MEASUREMENT t_k0schlnicht_zus_erk_auw_has "Timer zur Erkennung, dass die K0 nicht schliesst" UWORD t_int_n_M_S7_S3 1 100 0 300 ECU_ADDRESS 0xFFF86540 /end MEASUREMENT
/begin MEASUREMENT t_k0schlnicht_zus_filt_auw_has "Timer zur Filterung des Fehlerereignisses, dass die K0 nicht schliesst" UWORD t_int_n_M_S7_S3 1 100 0 300 ECU_ADDRESS 0xFFF86542 /end MEASUREMENT
/begin MEASUREMENT t_ndk0zugross_filt_auw_has "Timer zur Filterung des Fehlerereignisses, dass die K0- Differenzdrehzahl zu gross ist" UWORD t_int_n_M_S7_S3 1 100 0 300 ECU_ADDRESS 0xFFF86544 /end MEASUREMENT
/begin MEASUREMENT t_nemablwe_filt_auw_has "Timer zur Filterung des Fehlerereignisses, dass die EM-Drehzahl zu gering ist" UWORD t_int_n_M_S7_S3 1 100 0 300 ECU_ADDRESS 0xFFF86546 /end MEASUREMENT
/begin MEASUREMENT t_nemasynscl_filt_auw_has "Timer zur Filterung des Fehlerereignisses, dass die EM-Drehzahl zu gering ist" UWORD t_int_n_M_S7_S3 1 100 0 300 ECU_ADDRESS 0xFFF86548 /end MEASUREMENT
/begin MEASUREMENT t_nemzuklein_filt_auw_has "Timer zur Filterung des Fehlererignisses, dass die EM-Drehzahl zu gering ist" UWORD t_int_n_M_S7_S3 1 100 0 300 ECU_ADDRESS 0xFFF8654A /end MEASUREMENT
/begin MEASUREMENT t_nvmzuklein_filt_auw_has "Timer zur Filterung des Fehlerereignisses, dass die VM-Drehzahl zu gering ist" UWORD t_int_n_M_S7_S3 1 100 0 300 ECU_ADDRESS 0xFFF8654C /end MEASUREMENT
/begin MEASUREMENT t_oelversfehler_filt_has "Timer zur Filterung des Fehlerereignisses, dass ein Oelversorgungsfehler vorlag." UWORD t_int_n_M_S7_S3 1 100 0 1 ECU_ADDRESS 0xFFF8654E /end MEASUREMENT
/begin MEASUREMENT t_oelversfehlerkalt_filt_has "Timer zur Filterung des Fehlerereignisses, dass ein Oelversorgungsfehler vorlag." UWORD t_int_n_M_S7_S3 1 100 0 1 ECU_ADDRESS 0xFFF86550 /end MEASUREMENT
/begin MEASUREMENT t_statusnem_filt_auw_has "Timer zur Filterung des Fehlerereignisses, dass die EM-Drehzahl gestoert ist" UWORD t_int_n_M_S7_S3 1 100 0 300 ECU_ADDRESS 0xFFF86552 /end MEASUREMENT
/begin MEASUREMENT t_statusnemablwe_filt_auw_has "Timer zur Filterung des Fehlerereignisses, dass das EM-Drehzahlsignal gestoert ist (relevant fuer Ablaufwechsel)" UWORD t_int_n_M_S7_S3 1 100 0 300 ECU_ADDRESS 0xFFF86554 /end MEASUREMENT
/begin MEASUREMENT t_statusnemasynscl_filt_auw_has "Timer zur Filterung des Fehlerereignisses, dass die EM-Drehzahl gestoert ist" UWORD t_int_n_M_S7_S3 1 100 0 300 ECU_ADDRESS 0xFFF86556 /end MEASUREMENT
/begin MEASUREMENT t_vmaus_filt_auw_has "Timer zur Filterung des Fehlerereignisses, dass der VM aus ist" UWORD t_int_n_M_S7_S3 1 100 0 300 ECU_ADDRESS 0xFFF86558 /end MEASUREMENT
/begin MEASUREMENT v_f_in "" FLOAT32_IEEE v_fl_M_S7_S3 1 100 0 500 ECU_ADDRESS 0xFFF86274 /end MEASUREMENT
/begin MEASUREMENT v_f_portin "" UWORD v_int_M_S7_S3 1 100 0 65535 ECU_ADDRESS 0xFFF86590 /end MEASUREMENT
/begin MEASUREMENT v_f_ref_in "Fahrzeuggeschwindigkeit ueber Grund" UWORD v_int_M_S7_S3 1 100 0 511 ECU_ADDRESS 0xFFF86782 /end MEASUREMENT
/begin MEASUREMENT v_f_ref_portin "Fahrzeuggeschwindigkeit ueber Grund" UWORD void_int_c_M_S7_S3 1 100 0 51100 ECU_ADDRESS 0xFFF86592 /end MEASUREMENT
/begin MEASUREMENT v_f_sbe "Fahrzeuggeschwindigkeit auf Basis der Getriebeabtriebsdrehzahl in der  Hybridablaufsteuerung" FLOAT32_IEEE v_fl_M_S7_S3 1 100 0 500 ECU_ADDRESS 0xFFF861E4 /end MEASUREMENT
/begin MEASUREMENT vg_f_sbe "Fahrzeuggeschwindigkeitsgradient auf Basis der Getriebeabtriebsdrehzahl in der  Hybridablaufsteuerung" FLOAT32_IEEE vg_fl_M_S7_S3 1 100 -100 100 ECU_ADDRESS 0xFFF861E8 /end MEASUREMENT
/begin MEASUREMENT z_ablauf_has_hst_in "" UBYTE sts_int_M_S7_S3 1 100 0 15 ECU_ADDRESS 0xFFF86CB8 /end MEASUREMENT
/begin MEASUREMENT z_ablauf_has_hst_portin "" UBYTE sts_int_M_S7_S3 1 100 0 255 ECU_ADDRESS 0xFFF8693B /end MEASUREMENT
/begin MEASUREMENT z_ablauf_has_stg "Zusaetzliche Steuergroesse zur Ablaufsteuerung" UBYTE ctrl_int_M_S7_S3 1 100 0 15 ECU_ADDRESS 0xFFF86C57 /end MEASUREMENT
/begin MEASUREMENT z_ablauf_svh_reset_has_fkt "" UBYTE sts_int_M_S7_S3 1 100 0 255 ECU_ADDRESS 0xFFF86C5B /end MEASUREMENT
/begin MEASUREMENT z_ablaufreinit_frk_dihi "Zeigt an, dass der aktuelle HAS-Ablauf erneut begonnen werden soll" UBYTE sts_int_e_M_S7_S3 1 100 0 1 ECU_ADDRESS 0xFFF86C40 /end MEASUREMENT
/begin MEASUREMENT z_ablaufvariante_has_hst_in "" UBYTE sts_int_M_S7_S3 1 100 0 99 ECU_ADDRESS 0xFFF86CB9 /end MEASUREMENT
/begin MEASUREMENT z_ablaufvariante_has_hst_portin "" UBYTE sts_int_M_S7_S3 1 100 0 255 ECU_ADDRESS 0xFFF8693C /end MEASUREMENT
/begin MEASUREMENT z_ablaufvariante_has_stg "Ablaufvariante, die  die OML ausgibt" UBYTE sts_int_M_S7_S3 1 100 0 99 ECU_ADDRESS 0xFFF86C58 /end MEASUREMENT
/begin MEASUREMENT z_ablaufvariante_kalt_zus "Anzeige der aktiven Ablaufvariante Kaltstart beim Zustart - 0 = kein Kaltstart, 1 = Kaltstart mit abgesenkter EM-Drehzahl" UBYTE st_int_M_S7_S3 1 100 0 255 ECU_ADDRESS 0xFFF86C5C /end MEASUREMENT
/begin MEASUREMENT z_ala_frk_dihi "Zeigt an, dass die Anlasserstartanforderung der HAS aktiviert werden soll" UBYTE sts_int_e_M_S7_S3 1 100 0 1 ECU_ADDRESS 0xFFF86C41 /end MEASUREMENT
/begin MEASUREMENT z_ba_has_k0_hst_in "" UBYTE st_int_M_S7_S3 1 100 0 1 ECU_ADDRESS 0xFFF86CD2 /end MEASUREMENT
/begin MEASUREMENT z_ba_has_k0_hst_portin "Anforderung K0 Betriebsart der HAS durch die HST" UBYTE sts_int_M_S7_S3 1 100 0 15 ECU_ADDRESS 0xFFF86C96 /end MEASUREMENT
/begin MEASUREMENT z_ba_has_vm_hst_in "" UBYTE st_int_M_S7_S3 1 100 0 1 ECU_ADDRESS 0xFFF86CD3 /end MEASUREMENT
/begin MEASUREMENT z_ba_has_vm_hst_portin "Anforderung VM Betriebsart der HAS durch die HST" UBYTE sts_int_M_S7_S3 1 100 0 15 ECU_ADDRESS 0xFFF86C97 /end MEASUREMENT
/begin MEASUREMENT z_captargetnvm_ehi_has "Zeigt an, ob die Ersatzmassnahme KMN_CAPTARGETNVM aktiv ist" UBYTE sts_int_e_M_S7_S3 1 100 0 1 ECU_ADDRESS 0xFFF86869 /end MEASUREMENT
/begin MEASUREMENT z_deaktiv_abo_frk_dihi "Zeigt an, dass die ABO Funktion verlassen werden soll." UBYTE sts_int_e_M_S7_S3 1 100 0 1 ECU_ADDRESS 0xFFF86C42 /end MEASUREMENT
/begin MEASUREMENT z_diag_ersfkt_has_in "Funktionsschnittstelle zur Ermittlung ob irgendeine Ersatzmassnahme in der Diagnoseverwaltung aktiv ist" ULONG b_int_M_S7_S3 1 100 0 4294967295 ECU_ADDRESS 0xFFF86278 /end MEASUREMENT
/begin MEASUREMENT z_diag_ersfkt_has_portin "Funktionsschnittstelle zur Ermittlung ob irgendeine Ersatzmassnahme in der Diagnoseverwaltung aktiv ist" ULONG b_int_M_S7_S3 1 100 0 4294967295 ECU_ADDRESS 0xFFF85B94 /end MEASUREMENT
/begin MEASUREMENT z_diag_ersfkt_hi_96_has_in "Anzeige ob Ersatzmassnahme in der Diagnoseverwaltung aktiv ist bit 64...95" ULONG b_int_M_S7_S3 1 100 0 4294967295 ECU_ADDRESS 0xFFF8627C /end MEASUREMENT
/begin MEASUREMENT z_diag_ersfkt_hi_96_has_portin "Anzeige ob Ersatzmassnahme in der Diagnoseverwaltung aktiv ist bit 64...95" ULONG b_int_M_S7_S3 1 100 0 4294967295 ECU_ADDRESS 0xFFF85B98 /end MEASUREMENT
/begin MEASUREMENT z_diag_ersfkt_hi_has_in "Funktionsschnittstelle zur Ermittlung ob irgendeine Ersatzmassnahme in der Diagnoseverwaltung aktiv ist" ULONG b_int_M_S7_S3 1 100 0 4294967295 ECU_ADDRESS 0xFFF86280 /end MEASUREMENT
/begin MEASUREMENT z_diag_ersfkt_hi_has_portin "Funktionsschnittstelle zur Ermittlung ob irgendeine Ersatzmassnahme in der Diagnoseverwaltung aktiv ist" ULONG b_int_M_S7_S3 1 100 0 4294967295 ECU_ADDRESS 0xFFF85B9C /end MEASUREMENT
/begin MEASUREMENT z_diag_notgang_has_in "Notganginformation" UBYTE b_int_b_M_S7_S3 1 100 0 255 ECU_ADDRESS 0xFFF86CBA /end MEASUREMENT
/begin MEASUREMENT z_diag_notgang_has_portin "Notganginformation" UBYTE b_int_b_M_S7_S3 1 100 0 255 ECU_ADDRESS 0xFFF8693D /end MEASUREMENT
/begin MEASUREMENT z_emaktiv_fuw_zus_fkt "Anzeige der EM Fehlfuntion der Funktionsueberwachung der EM beim Zustart" UBYTE b_int_h_M_S7_S3 1 100 0 1 ECU_ADDRESS 0xFFF86C5D /end MEASUREMENT
/begin MEASUREMENT z_emfehler_frk_dihi "Zeigt an, dass eine EM Fehlfunktion erkannt wurde, die in der HAS ausgewertet werden soll" UBYTE sts_int_e_M_S7_S3 1 100 0 1 ECU_ADDRESS 0xFFF86C43 /end MEASUREMENT
/begin MEASUREMENT z_enginestart_ehi_has "Zeigt an, ob die Ersatzmassnahme KMN_ENGINESTART aktiv ist" UBYTE sts_int_e_M_S7_S3 1 100 0 1 ECU_ADDRESS 0xFFF8686A /end MEASUREMENT
/begin MEASUREMENT z_enpg1_ehi_has "Zeigt an, ob die Ersatzmassnahme KMN_ENPG1 aktiv ist" UBYTE sts_int_e_M_S7_S3 1 100 0 1 ECU_ADDRESS 0xFFF8686B /end MEASUREMENT
/begin MEASUREMENT z_enpg1fix_ehi_has "Zeigt an, ob die Ersatzmassnahme KMN_ENPG1FIX aktiv ist" UBYTE sts_int_e_M_S7_S3 1 100 0 1 ECU_ADDRESS 0xFFF8686C /end MEASUREMENT
/begin MEASUREMENT z_enpg2_ehi_has "Zeigt an, ob die Ersatzmassnahme KMN_ENPG2 aktiv ist" UBYTE sts_int_e_M_S7_S3 1 100 0 1 ECU_ADDRESS 0xFFF8686D /end MEASUREMENT
/begin MEASUREMENT z_enpg3_ehi_has "Zeigt an, ob die Ersatzmassnahme KMN_ENPG3 aktiv ist" UBYTE sts_int_e_M_S7_S3 1 100 0 1 ECU_ADDRESS 0xFFF8686E /end MEASUREMENT
/begin MEASUREMENT z_enpg3fix_ehi_has "Zeigt an, ob die Ersatzmassnahme KMN_ENPG3FIX aktiv ist" UBYTE sts_int_e_M_S7_S3 1 100 0 1 ECU_ADDRESS 0xFFF8686F /end MEASUREMENT
/begin MEASUREMENT z_enpg4_ehi_has "Zeigt an, ob die Ersatzmassnahme KMN_ENPG4 aktiv ist" UBYTE sts_int_e_M_S7_S3 1 100 0 1 ECU_ADDRESS 0xFFF86870 /end MEASUREMENT
/begin MEASUREMENT z_enpg5_ehi_has "Zeigt an, ob die Ersatzmassnahme KMN_ENPG5 aktiv ist" UBYTE sts_int_e_M_S7_S3 1 100 0 1 ECU_ADDRESS 0xFFF86871 /end MEASUREMENT
/begin MEASUREMENT z_enpg6_ehi_has "Zeigt an, ob die Ersatzmassnahme KMN_ENPG6 aktiv ist" UBYTE sts_int_e_M_S7_S3 1 100 0 1 ECU_ADDRESS 0xFFF86872 /end MEASUREMENT
/begin MEASUREMENT z_enpg7_ehi_has "Zeigt an, ob die Ersatzmassnahme KMN_ENPG7 aktiv ist" UBYTE sts_int_e_M_S7_S3 1 100 0 1 ECU_ADDRESS 0xFFF86873 /end MEASUREMENT
/begin MEASUREMENT z_enpg8_ehi_has "Zeigt an, ob die Ersatzmassnahme KMN_ENPG8 aktiv ist" UBYTE sts_int_e_M_S7_S3 1 100 0 1 ECU_ADDRESS 0xFFF86874 /end MEASUREMENT
/begin MEASUREMENT z_fehler15_diho "Fehlerflag: Zeigt an, ob ein Fehlerereignis vor liegt" UBYTE sts_int_e_M_S7_S3 1 100 0 1 ECU_ADDRESS 0xFFF86882 /end MEASUREMENT
/begin MEASUREMENT z_fehler15_diho_has_byp "" UBYTE st_int_M_S7_S3 1 100 0 255 ECU_ADDRESS 0xFFF86C1C /end MEASUREMENT
/begin MEASUREMENT Z_FEHLER15_DIHO_HAS_BYP_VECTOR "Vector fuer Bypass-Groesse z_fehler15_eh_fkt_has_byp" UBYTE void_int_M_S7_S3 1 100 0 255 ECU_ADDRESS 0xFFF86BEE /end MEASUREMENT
/begin MEASUREMENT z_fehler15_eh_fkt "" UBYTE st_int_M_S7_S3 1 100 0 1 ECU_ADDRESS 0xFFF86C5E /end MEASUREMENT
/begin MEASUREMENT z_freigabe_pvu_has_byp "" UBYTE st_int_M_S7_S3 1 100 0 255 ECU_ADDRESS 0xFFF86C1D /end MEASUREMENT
/begin MEASUREMENT Z_FREIGABE_PVU_HAS_BYP_VECTOR "Vector fuer Bypass-Groesse z_freigabe_pvu_has_byp" UBYTE void_int_M_S7_S3 1 100 0 255 ECU_ADDRESS 0xFFF86BEF /end MEASUREMENT
/begin MEASUREMENT z_freigabe_pvu_has_portout "Freigabe fuer die Diagnose Positionsventil" UBYTE sts_int_M_S7_S3 1 100 0 1 ECU_ADDRESS 0xFFF86957 /end MEASUREMENT
/begin MEASUREMENT z_freigabe_pvu_has_sbe "Freigabe zur Aktivierung der Diagnosefunktion \"Positionsventil-Ueberwachung\" der Funktion zur Unterstuetzung der Positi-onsventil-Ueberwachung der HAS" UBYTE st_int_M_S7_S3 1 100 0 1 ECU_ADDRESS 0xFFF86C71 /end MEASUREMENT
/begin MEASUREMENT z_fuwdeakt_frk_dihi "Zeigt an, dass die FUW-Funktion nicht aktiviert werden darf" UBYTE sts_int_e_M_S7_S3 1 100 0 1 ECU_ADDRESS 0xFFF86C44 /end MEASUREMENT
/begin MEASUREMENT z_gbxready_ehi_has "Zeigt an, ob die Ersatzmassnahme KMN_GBXREADY aktiv ist" UBYTE sts_int_e_M_S7_S3 1 100 0 1 ECU_ADDRESS 0xFFF86875 /end MEASUREMENT
/begin MEASUREMENT z_gebruefahrenaus_frk_dihi "Erkennung Aufheben gebruecktes E Fahren" UBYTE sts_int_e_M_S7_S3 1 100 0 1 ECU_ADDRESS 0xFFF86C45 /end MEASUREMENT
/begin MEASUREMENT z_glsbe_has_byp "" UBYTE st_int_M_S7_S3 1 100 0 255 ECU_ADDRESS 0xFFF86C1E /end MEASUREMENT
/begin MEASUREMENT Z_GLSBE_HAS_BYP_VECTOR "Vector fuer Bypass-Groesse z_glsbe_has_byp" UBYTE void_int_M_S7_S3 1 100 0 255 ECU_ADDRESS 0xFFF86BF0 /end MEASUREMENT
/begin MEASUREMENT z_glsbe_has_portout "" UBYTE sts_int_M_S7_S3 1 100 0 1 ECU_ADDRESS 0xFFF86958 /end MEASUREMENT
/begin MEASUREMENT z_hascycreinit_ehi_has "Zeigt an, ob die Ersatzmassnahme KMN_HASCYCREINIT aktiv ist" UBYTE sts_int_e_M_S7_S3 1 100 0 1 ECU_ADDRESS 0xFFF86876 /end MEASUREMENT
/begin MEASUREMENT z_hasforcesync0_ehi_has "Zeigt an, ob die Ersatzmassnahme KMN_HASFORCESYNC0 aktiv ist" UBYTE sts_int_e_M_S7_S3 1 100 0 1 ECU_ADDRESS 0xFFF86877 /end MEASUREMENT
/begin MEASUREMENT z_hasstatefix_ehi_has "Zeigt an, ob die Ersatzmassnahme KMN_HASCYCREINIT aktiv ist" UBYTE sts_int_e_M_S7_S3 1 100 0 1 ECU_ADDRESS 0xFFF86878 /end MEASUREMENT
/begin MEASUREMENT z_hss1off_ehi_has "Zeigt an, ob die Ersmassnahme KMN_CAPTARGETNVM aktiv ist" UBYTE sts_int_e_M_S7_S3 1 100 0 1 ECU_ADDRESS 0xFFF86879 /end MEASUREMENT
/begin MEASUREMENT z_hybfkt_stg "Anforderung der Aktivierung einer Hybridfunktion durch die Hyrid-Zustandssteuerung" UBYTE E_HYBFKT_M_S7_S3 1 100 0 15 ECU_ADDRESS 0xFFF86C59 /end MEASUREMENT
/begin MEASUREMENT z_idlenem_ehi_has "Zeigt an, ob die Ersatzmassnahme KMN_IDLENEM aktiv ist" UBYTE sts_int_e_M_S7_S3 1 100 0 1 ECU_ADDRESS 0xFFF8687A /end MEASUREMENT
/begin MEASUREMENT z_iep_anf_portin "" UWORD void_int_c_M_S7_S3 1 100 0 65535 ECU_ADDRESS 0xFFF86594 /end MEASUREMENT
/begin MEASUREMENT z_iep_in "" UBYTE E_ZIEP_M_S7_S3 1 100 0 4 ECU_ADDRESS 0xFFF86CBB /end MEASUREMENT
/begin MEASUREMENT z_iepein_frk_dihi "Zeigt an, dass die IEP aktiviert werden soll, wenn ein EM-Drehzahl Signalfehler vorliegt, um die Oelversorgung weiterhin sicher zu stellen." UBYTE sts_int_e_M_S7_S3 1 100 0 1 ECU_ADDRESS 0xFFF86C46 /end MEASUREMENT
/begin MEASUREMENT z_inctargetnvm_ehi_has "Zeigt an, ob die Ersatzmassnahme KMN_INCTARGETNVM aktiv ist" UBYTE sts_int_e_M_S7_S3 1 100 0 1 ECU_ADDRESS 0xFFF8687B /end MEASUREMENT
/begin MEASUREMENT z_init_sta "Anforderung der Initialisierung der Zustandssteuerung (OML) durch die Strategieanpassung" UBYTE sts_int_M_S7_S3 1 100 0 1 ECU_ADDRESS 0xFFF86C85 /end MEASUREMENT
/begin MEASUREMENT z_k0_befuellopt_has "Gemessen in Zustart/Output" UBYTE void_int_M_S7_S3 1 100 0 255 ECU_ADDRESS 0xFFF98424 /end MEASUREMENT
/begin MEASUREMENT z_k0_befuellopt_has_byp "" UBYTE st_int_M_S7_S3 1 100 0 255 ECU_ADDRESS 0xFFF86C1F /end MEASUREMENT
/begin MEASUREMENT Z_K0_BEFUELLOPT_HAS_BYP_VECTOR "Vector fuer Bypass-Groesse z_k0_befuellopt_has_byp" UBYTE void_int_M_S7_S3 1 100 0 255 ECU_ADDRESS 0xFFF86BF2 /end MEASUREMENT
/begin MEASUREMENT z_k0_befuellopt_has_fkt "" UBYTE st_int_M_S7_S3 1 100 0 1 ECU_ADDRESS 0xFFF86C5F /end MEASUREMENT
/begin MEASUREMENT z_k0_befuellopt_has_portout "" UBYTE sts_int_M_S7_S3 1 100 0 2 ECU_ADDRESS 0xFFF86959 /end MEASUREMENT
/begin MEASUREMENT z_k0_fst_in "" UBYTE E_ZK0FSTIN_M_S7_S3 1 100 0 3 ECU_ADDRESS 0xFFF86CBC /end MEASUREMENT
/begin MEASUREMENT z_k0_fst_portin "" UBYTE E_ZK0FSTIN_M_S7_S3 1 100 0 3 ECU_ADDRESS 0xFFF8693E /end MEASUREMENT
/begin MEASUREMENT z_k0_has_byp "" UBYTE st_int_M_S7_S3 1 100 0 255 ECU_ADDRESS 0xFFF86C20 /end MEASUREMENT
/begin MEASUREMENT Z_K0_HAS_BYP_VECTOR "Vector fuer Bypass-Groesse z_k0_has_byp" UBYTE void_int_M_S7_S3 1 100 0 255 ECU_ADDRESS 0xFFF86BF3 /end MEASUREMENT
/begin MEASUREMENT z_k0_has_fkt "" UBYTE E_ZK0_M_S7_S3 1 100 0 5 ECU_ADDRESS 0xFFF86C60 /end MEASUREMENT
/begin MEASUREMENT z_k0_has_portout "" UBYTE E_ZK0_M_S7_S3 1 100 0 5 ECU_ADDRESS 0xFFF8695A /end MEASUREMENT
/begin MEASUREMENT z_k0_has_sbe "K0 Sollzustand der Priorisierung der K0-Ansteuerung der HAS" UBYTE E_ZK0_M_S7_S3 1 100 0 5 ECU_ADDRESS 0xFFF86C75 /end MEASUREMENT
/begin MEASUREMENT z_k0_ndk0zugross_auw_diho "Fehlerflag: Zeigt an, ob das Fehlerereignis, dass die VM-Zwangsankopplung bei zu grosser K0-Differenzdrehzahl nicht erfolgreich war, mindestens fuer die Filterzeit vorlag." UBYTE sts_int_e_M_S7_S3 1 100 0 1 ECU_ADDRESS 0xFFF86883 /end MEASUREMENT
/begin MEASUREMENT z_k0_ndk0zugross_erk_auw_has "Fehlerereignisflag: Zeigt an, die VM-Zwangsankopplung bei zu grosser K0-Differenzdrehzahl nicht erfolgreich ist" UBYTE sts_int_e_M_S7_S3 1 100 0 1 ECU_ADDRESS 0xFFF86884 /end MEASUREMENT
/begin MEASUREMENT z_k0_ndk0zugrosspb_auw_diho "Pruefbedingung fuer das Ruecksetzen des Fehlers K0-Differenzdrehzahl zu gross der Fehlererkennung der HAS Diagnosefunktionen" UBYTE sts_int_e_M_S7_S3 1 100 0 1 ECU_ADDRESS 0xFFF86885 /end MEASUREMENT
/begin MEASUREMENT z_k0oeffnicht_diho "Anzeige des Fehlers K0 oeffnet nicht der Fehlererkennung der HAS Diagnosefunktionen" UBYTE sts_int_e_M_S7_S3 1 100 0 1 ECU_ADDRESS 0xFFF86886 /end MEASUREMENT
/begin MEASUREMENT z_k0oeffnicht_diho_has_byp "" UBYTE st_int_M_S7_S3 1 100 0 255 ECU_ADDRESS 0xFFF86C21 /end MEASUREMENT
/begin MEASUREMENT Z_K0OEFFNICHT_DIHO_HAS_BYP_VECTOR "Vector fuer Bypass-Groesse z_k0oeffnicht_diho_has_byp" UBYTE void_int_M_S7_S3 1 100 0 255 ECU_ADDRESS 0xFFF86BF1 /end MEASUREMENT
/begin MEASUREMENT z_k0oeffnichtfehler_has "Anzeige des Fehlers K0 oeffnet nicht der Fehlererkennung der HAS Diagnosefunktionen" UBYTE sts_int_e_M_S7_S3 1 100 0 1 ECU_ADDRESS 0xFFF86887 /end MEASUREMENT
/begin MEASUREMENT z_k0oeffnichtpb_diho "Pruefbedingung fuer das Ruecksetzen des Fehles K0 oeffnet nicht der Fehlererkennung der HAS Diagnosefunktionen" UBYTE sts_int_e_M_S7_S3 1 100 0 1 ECU_ADDRESS 0xFFF86888 /end MEASUREMENT
/begin MEASUREMENT z_k0schlnicht_ans_aktiv_auw_has "Aktivierungsflag: Zeigt an, ob k0 schliesst nicht Ueberwachung aktiv ist." UBYTE sts_int_e_M_S7_S3 1 100 0 1 ECU_ADDRESS 0xFFF86889 /end MEASUREMENT
/begin MEASUREMENT z_k0schlnicht_ans_auw_diho "HAS-Diagnose: Flag zur Ueberwachung der maximalen Dauer der K0-Ansteuerung in Druckstellung beim schliessen der K0 im Schleppstart." UBYTE sts_int_e_M_S7_S3 1 100 0 1 ECU_ADDRESS 0xFFF8688A /end MEASUREMENT
/begin MEASUREMENT z_k0schlnicht_ans_erk_auw_has "HAS-Diagnose: Fehlerflag zur Aktivierung der Diagnose K0-Ansteuerung in Druckstellung beim schliessen der K0 im Schleppstart." UBYTE sts_int_e_M_S7_S3 1 100 0 1 ECU_ADDRESS 0xFFF8688B /end MEASUREMENT
/begin MEASUREMENT z_k0schlnicht_zus_aktiv_auw_has "Aktivierungsflag: Zeigt an, ob die Ueberwachung bei aktiver FUW oder bei Kaltstart aktiv ist." UBYTE sts_int_e_M_S7_S3 1 100 0 1 ECU_ADDRESS 0xFFF8688C /end MEASUREMENT
/begin MEASUREMENT z_k0schlnicht_zus_auw_diho "Fehlerflag: Zeigt an, ob das Fehlerereignis, dass die K0 nicht schliesst, mindestens fuer die Filterzeit vorlag." UBYTE sts_int_e_M_S7_S3 1 100 0 1 ECU_ADDRESS 0xFFF8688D /end MEASUREMENT
/begin MEASUREMENT z_k0schlnicht_zus_erk_auw_has "Fehlerereignisflag: Zeigt an, ob erkannt wurde, dass die K0 nicht schliesst" UBYTE sts_int_e_M_S7_S3 1 100 0 1 ECU_ADDRESS 0xFFF8688E /end MEASUREMENT
/begin MEASUREMENT z_k0schlnichtpb_ans_auw_diho "Pruefbedingung fuer das Ruecksetzen des Fehlers K0 schliesst nicht im Schleppstart der HAS Diagnosefunktionen" UBYTE sts_int_e_M_S7_S3 1 100 0 1 ECU_ADDRESS 0xFFF8688F /end MEASUREMENT
/begin MEASUREMENT z_k0schlnichtpb_zus_auw_diho "Pruefbedingung fuer das Ruecksetzen des Fehlers K0 schliesst nicht im Zustart der HAS Diagnosefunktionen" UBYTE sts_int_e_M_S7_S3 1 100 0 1 ECU_ADDRESS 0xFFF86890 /end MEASUREMENT
/begin MEASUREMENT z_k0sregaktiv_ans "Anforderung der Aktivierung der K0 Schlupfregelung beim Schleppstart" UBYTE sts_int_e_M_S7_S3 1 100 0 1 ECU_ADDRESS 0xFFF86A92 /end MEASUREMENT
/begin MEASUREMENT z_k0sregbasis_ans "Anzeige der Basisbedingung fuer die Anforderung der Aktivierung der K0 Schlupfregelung beim Schleppstart" UBYTE sts_int_e_M_S7_S3 1 100 0 1 ECU_ADDRESS 0xFFF86A93 /end MEASUREMENT
/begin MEASUREMENT z_k0syncmk0erh_frk_dihi "Zeigt an, dass eine K0-Zwangsynchronisation mittels Erhoehung des K0-Moments erfolgen soll" UBYTE sts_int_e_M_S7_S3 1 100 0 1 ECU_ADDRESS 0xFFF86C47 /end MEASUREMENT
/begin MEASUREMENT z_kfc_c0noclose_eho_diho "Flag: Maximale Anzahl der Fehlerereignisse innerhalb eines Fahrzyklus zur Eintragung des Fehles KFC_C0NOCLOSE der EH-Einbindung Out der HAS Diagnosefunktionen Out erreicht" UBYTE cnt_int_M_S7_S3 1 100 0 100 ECU_ADDRESS 0xFFF86891 /end MEASUREMENT
/begin MEASUREMENT z_kfc_c0noclose_eho_diho_has_byp "" UBYTE st_int_M_S7_S3 1 100 0 255 ECU_ADDRESS 0xFFF86C22 /end MEASUREMENT
/begin MEASUREMENT Z_KFC_C0NOCLOSE_EHO_DIHO_HAS_BYP_VECTOR "Vector fuer Bypass-Groesse z_kfc_c0noclose_eho_diho_has_byp" UBYTE void_int_M_S7_S3 1 100 0 255 ECU_ADDRESS 0xFFF86BF5 /end MEASUREMENT
/begin MEASUREMENT z_kfc_c0noclose_has "Fehlerereignisflag: Bedingung zur Ausgabe Fehler K0 schliesst nicht - KFC_C0NOCLOSE" UBYTE sts_int_M_S7_S3 1 100 0 1 ECU_ADDRESS 0xFFF86892 /end MEASUREMENT
/begin MEASUREMENT z_kfc_c0noclose_has_byp "" UBYTE st_int_M_S7_S3 1 100 0 255 ECU_ADDRESS 0xFFF86C23 /end MEASUREMENT
/begin MEASUREMENT Z_KFC_C0NOCLOSE_HAS_BYP_VECTOR "Vector fuer Bypass-Groesse z_kfc_c0noclose_has_byp" UBYTE void_int_M_S7_S3 1 100 0 255 ECU_ADDRESS 0xFFF86BF6 /end MEASUREMENT
/begin MEASUREMENT z_kfc_c0noclosepb_has "Pruefbedingungsflag: Bedingung fuer eine Gutpruefung Fehler K0 schliesst nicht - KFC_C0NOCLOSE" UBYTE sts_int_M_S7_S3 1 100 0 1 ECU_ADDRESS 0xFFF86893 /end MEASUREMENT
/begin MEASUREMENT z_kfc_c0noclosepb_has_byp "" UBYTE st_int_M_S7_S3 1 100 0 255 ECU_ADDRESS 0xFFF86C24 /end MEASUREMENT
/begin MEASUREMENT Z_KFC_C0NOCLOSEPB_HAS_BYP_VECTOR "Vector fuer Bypass-Groesse z_kfc_c0noclosepb_has_byp" UBYTE void_int_M_S7_S3 1 100 0 255 ECU_ADDRESS 0xFFF86BF4 /end MEASUREMENT
/begin MEASUREMENT z_kfc_c0noopen_eho_diho "Flag: Maximale Anzahl der Fehlerereignisse innerhalb eines Fahrzyklus zur Eintragung des Fehles KFC_C0NOOPEN der EH-Einbindung Out der HAS Diagnosefunktionen Out erreicht" UBYTE cnt_int_M_S7_S3 1 100 0 100 ECU_ADDRESS 0xFFF86894 /end MEASUREMENT
/begin MEASUREMENT z_kfc_c0noopen_eho_diho_has_byp "" UBYTE st_int_M_S7_S3 1 100 0 255 ECU_ADDRESS 0xFFF86C25 /end MEASUREMENT
/begin MEASUREMENT Z_KFC_C0NOOPEN_EHO_DIHO_HAS_BYP_VECTOR "Vector fuer Bypass-Groesse z_kfc_c0noopen_eho_diho_has_byp" UBYTE void_int_M_S7_S3 1 100 0 255 ECU_ADDRESS 0xFFF86BF8 /end MEASUREMENT
/begin MEASUREMENT z_kfc_c0noopenpb_has "Pruefbedingungsflag: Bedingung fuer eine Gutpruefung Fehler K0 oeffnet nicht - KFC_C0NOOPEN" UBYTE sts_int_M_S7_S3 1 100 0 1 ECU_ADDRESS 0xFFF86895 /end MEASUREMENT
/begin MEASUREMENT z_kfc_c0noopenpb_has_byp "" UBYTE st_int_M_S7_S3 1 100 0 255 ECU_ADDRESS 0xFFF86C26 /end MEASUREMENT
/begin MEASUREMENT Z_KFC_C0NOOPENPB_HAS_BYP_VECTOR "Vector fuer Bypass-Groesse z_kfc_c0noopenpb_has_byp" UBYTE void_int_M_S7_S3 1 100 0 255 ECU_ADDRESS 0xFFF86BF7 /end MEASUREMENT
/begin MEASUREMENT z_kps_stada_in "Sollvorgabe fuer die Trennkupplung K0 durch die Stillstandsadaption" UBYTE sts_int_M_S7_S3 1 100 0 255 ECU_ADDRESS 0xFFF86CBD /end MEASUREMENT
/begin MEASUREMENT z_kps_stada_portin "Sollvorgabe fuer die Trennkupplung K0 durch die Stillstandsadaption" UBYTE sts_int_M_S7_S3 1 100 0 255 ECU_ADDRESS 0xFFF8693F /end MEASUREMENT
/begin MEASUREMENT z_lls_fktaktiv_has_sbe "Aktive LLS-Funktion - Codierung bit0=STAT,1=IEP,2=CGETR,3=BEFFZP,4=GE,5=KFL,6=PAUS,7=PARKSP,8=RANG,9=MANH,10=IAE,11=SAS,12=KRI,13=DAT,14=IAEADA,15=K0ADA,16=STADA,17-18=frei,19=FKT,20=BZ,21-22=frei,23=VGF,24=ALAE,25-26=frei,27=PVU,28-30=frei,31=DIAG" ULONG sts_int_m_M_S7_S3 1 100 0 4294967295 ECU_ADDRESS 0xFFF86208 /end MEASUREMENT
/begin MEASUREMENT z_m_max_iae_has_byp "" UBYTE st_int_M_S7_S3 1 100 0 255 ECU_ADDRESS 0xFFF86C27 /end MEASUREMENT
/begin MEASUREMENT Z_M_MAX_IAE_HAS_BYP_VECTOR "Vector fuer Bypass-Groesse z_m_max_iae_has_byp" UBYTE void_int_M_S7_S3 1 100 0 255 ECU_ADDRESS 0xFFF86BFB /end MEASUREMENT
/begin MEASUREMENT z_m_max_iae_has_fkt "" UBYTE st_int_M_S7_S3 1 100 0 50 ECU_ADDRESS 0xFFF86C61 /end MEASUREMENT
/begin MEASUREMENT z_m_max_iae_has_portout "" UBYTE sts_int_M_S7_S3 1 100 0 1 ECU_ADDRESS 0xFFF8695B /end MEASUREMENT
/begin MEASUREMENT z_m_soll_em_has_byp "" UBYTE st_int_M_S7_S3 1 100 0 255 ECU_ADDRESS 0xFFF86C28 /end MEASUREMENT
/begin MEASUREMENT Z_M_SOLL_EM_HAS_BYP_VECTOR "Vector fuer Bypass-Groesse" UBYTE void_int_M_S7_S3 1 100 0 255 ECU_ADDRESS 0xFFF86BFC /end MEASUREMENT
/begin MEASUREMENT z_m_soll_em_has_fkt "" UBYTE st_int_l_M_S7_S3 1 100 0 1 ECU_ADDRESS 0xFFF86C62 /end MEASUREMENT
/begin MEASUREMENT z_m_soll_em_has_komp_portout "" UBYTE sts_int_M_S7_S3 1 100 0 255 ECU_ADDRESS 0xFFF8695C /end MEASUREMENT
/begin MEASUREMENT z_m_soll_em_has_portout "" UBYTE sts_int_M_S7_S3 1 100 0 3 ECU_ADDRESS 0xFFF8695D /end MEASUREMENT
/begin MEASUREMENT z_mechnotlauf_ehi_has "Zustand mechanischer Notlauf" UBYTE sts_int_e_M_S7_S3 1 100 0 1 ECU_ADDRESS 0xFFF8687C /end MEASUREMENT
/begin MEASUREMENT z_modus_em_hst_in "" UBYTE sts_int_M_S7_S3 1 100 0 255 ECU_ADDRESS 0xFFF86CBE /end MEASUREMENT
/begin MEASUREMENT z_modus_iae_has_byp "" UBYTE st_int_M_S7_S3 1 100 0 255 ECU_ADDRESS 0xFFF86C29 /end MEASUREMENT
/begin MEASUREMENT Z_MODUS_IAE_HAS_BYP_VECTOR "Vector fuer Bypass-Groesse z_modus_iae_has_byp" UBYTE void_int_M_S7_S3 1 100 0 255 ECU_ADDRESS 0xFFF86BF9 /end MEASUREMENT
/begin MEASUREMENT z_modus_iae_has_portout "" UBYTE E_ZMODUSIAE_M_S7_S3 1 100 0 2 ECU_ADDRESS 0xFFF8695E /end MEASUREMENT
/begin MEASUREMENT z_modus_iae_has_sbe "" UBYTE E_ZMODUSIAE_M_S7_S3 1 100 0 2 ECU_ADDRESS 0xFFF86C76 /end MEASUREMENT
/begin MEASUREMENT z_modus_iep_has_sbe "Vorgabe des Betriebsmodus der IEP durch die HAS" UBYTE E_ZMODUSIEP_M_S7_S3 1 100 0 4 ECU_ADDRESS 0xFFF86C77 /end MEASUREMENT
/begin MEASUREMENT z_msa_avh_moni_has_sbe "Anforderung einer Schaltverhinderung der HAS" UBYTE st_int_M_S7_S3 1 100 0 255 ECU_ADDRESS 0xFFF86C78 /end MEASUREMENT
/begin MEASUREMENT z_msa_eaf_moni_has_sbe "Anforderung einer Schaltverhinderung der HAS" UBYTE st_int_M_S7_S3 1 100 0 255 ECU_ADDRESS 0xFFF86C79 /end MEASUREMENT
/begin MEASUREMENT z_msa_fst_avh_portin "Anforderung einer Abschaltverhinderung durch die Fahrstrategie" UBYTE sts_int_M_S7_S3 1 100 0 255 ECU_ADDRESS 0xFFF86940 /end MEASUREMENT
/begin MEASUREMENT z_msa_fst_eaf_portin "Anforderung einer Einschaltaufforderung durch die Fahrstrategie" UBYTE sts_int_M_S7_S3 1 100 0 255 ECU_ADDRESS 0xFFF86941 /end MEASUREMENT
/begin MEASUREMENT z_msa_fst_in "Anforderung einer Abschaltverhinderung durch die Fahrstrategie ASIS" UBYTE sts_int_M_S7_S3 1 100 0 255 ECU_ADDRESS 0xFFF86CBF /end MEASUREMENT
/begin MEASUREMENT z_msa_has_byp "" UBYTE st_int_M_S7_S3 1 100 0 255 ECU_ADDRESS 0xFFF86C2A /end MEASUREMENT
/begin MEASUREMENT Z_MSA_HAS_BYP_VECTOR "Vector fuer Bypass-Groesse z_msa_deaktivierer_has_byp" UBYTE void_int_M_S7_S3 1 100 0 255 ECU_ADDRESS 0xFFF86BFA /end MEASUREMENT
/begin MEASUREMENT z_msa_has_portout "" UBYTE sts_int_M_S7_S3 1 100 0 255 ECU_ADDRESS 0xFFF8695F /end MEASUREMENT
/begin MEASUREMENT z_msa_has_sbe "Anforderung der Beeinflussung der MSA-Funktionalitaet durch die Hybridablaufsteuerung - Codierung: bit0 = AVZ, bit1 = AVH, bit2 = EAF, bit3 = EVH, bit4 = Deaktivierung, bit7 = Stoerungsbedingt" UBYTE sts_int_M_S7_S3 1 100 0 255 ECU_ADDRESS 0xFFF86C7A /end MEASUREMENT
/begin MEASUREMENT z_msa_stada_avh_portin "Anforderung einer Abschaltverhinderung durch die Stillstandadaption" UBYTE sts_int_M_S7_S3 1 100 0 1 ECU_ADDRESS 0xFFF86C98 /end MEASUREMENT
/begin MEASUREMENT z_msa_stada_eaf_portin "Anforderung einer Einschaltaufforderung durch die Stillstandadaption" UBYTE sts_int_M_S7_S3 1 100 0 1 ECU_ADDRESS 0xFFF86C99 /end MEASUREMENT
/begin MEASUREMENT z_msa_stada_in "Anforderung einer Abschaltverhinderung durch die Stillstandadaption" UBYTE sts_int_M_S7_S3 1 100 0 6 ECU_ADDRESS 0xFFF86CD4 /end MEASUREMENT
/begin MEASUREMENT z_n_min_em_parksp_has_in "Anforderung einer EM-Drehzahlanhebung beim Auslegen der Parksperre infolge unzureichender Oelversorgung" UBYTE b_int_b_M_S7_S3 1 100 0 1 ECU_ADDRESS 0xFFF86CC0 /end MEASUREMENT
/begin MEASUREMENT z_n_min_em_parksp_has_portin "Anforderung einer EM-Drehzahlanhebung beim Auslegen der Parksperre infolge unzureichender Oelversorgung" UBYTE b_int_b_M_S7_S3 1 100 0 1 ECU_ADDRESS 0xFFF86942 /end MEASUREMENT
/begin MEASUREMENT z_n_soll_em_has_byp "" UBYTE st_int_M_S7_S3 1 100 0 255 ECU_ADDRESS 0xFFF86C2B /end MEASUREMENT
/begin MEASUREMENT Z_N_SOLL_EM_HAS_BYP_VECTOR "Vector fuer Bypass-Groesse z_n_soll_em_has_byp" UBYTE void_int_M_S7_S3 1 100 0 255 ECU_ADDRESS 0xFFF86C04 /end MEASUREMENT
/begin MEASUREMENT z_n_soll_em_has_fkt "" UBYTE st_int_M_S7_S3 1 100 0 50 ECU_ADDRESS 0xFFF86C63 /end MEASUREMENT
/begin MEASUREMENT z_n_soll_em_has_komp_portout "" UBYTE sts_int_M_S7_S3 1 100 0 255 ECU_ADDRESS 0xFFF86960 /end MEASUREMENT
/begin MEASUREMENT z_n_soll_em_has_portout "" UBYTE sts_int_M_S7_S3 1 100 0 1 ECU_ADDRESS 0xFFF86961 /end MEASUREMENT
/begin MEASUREMENT z_n_soll_vm_has_byp "" UBYTE st_int_M_S7_S3 1 100 0 255 ECU_ADDRESS 0xFFF86C2C /end MEASUREMENT
/begin MEASUREMENT Z_N_SOLL_VM_HAS_BYP_VECTOR "Vector fuer Bypass-Groesse z_n_soll_vm_has_byp" UBYTE void_int_M_S7_S3 1 100 0 255 ECU_ADDRESS 0xFFF86C05 /end MEASUREMENT
/begin MEASUREMENT z_n_soll_vm_has_fkt "" UBYTE st_int_M_S7_S3 1 100 0 50 ECU_ADDRESS 0xFFF86C64 /end MEASUREMENT
/begin MEASUREMENT z_n_soll_vm_has_komp_portout "" UBYTE sts_int_M_S7_S3 1 100 0 255 ECU_ADDRESS 0xFFF86962 /end MEASUREMENT
/begin MEASUREMENT z_n_soll_vm_has_portout "" UBYTE sts_int_M_S7_S3 1 100 0 1 ECU_ADDRESS 0xFFF86963 /end MEASUREMENT
/begin MEASUREMENT z_ndk0_aktiv_auw_has "Aktivierungsflag: Zeigt an, ob die Ueberwachung der K0-Differenzdrehzahl aktiv ist" UBYTE sts_int_e_M_S7_S3 1 100 0 1 ECU_ADDRESS 0xFFF86896 /end MEASUREMENT
/begin MEASUREMENT z_ndk0zugross_auw_diho "Fehlerflag: Zeigt an, ob das Fehlerereignis, dass die K0-Differenzdrehzahl zu gross ist, mindestens fuer die Filterzeit vorlag." UBYTE sts_int_e_M_S7_S3 1 100 0 1 ECU_ADDRESS 0xFFF86897 /end MEASUREMENT
/begin MEASUREMENT z_ndk0zugross_auw_diho_has_byp "" UBYTE st_int_M_S7_S3 1 100 0 255 ECU_ADDRESS 0xFFF86C2D /end MEASUREMENT
/begin MEASUREMENT Z_NDK0ZUGROSS_AUW_DIHO_HAS_BYP_VECTOR "Vector fuer Bypass-Groesse z_ndk0zugross_auw_diho_has_byp" UBYTE void_int_M_S7_S3 1 100 0 255 ECU_ADDRESS 0xFFF86BFD /end MEASUREMENT
/begin MEASUREMENT z_ndk0zugross_erk_auw_has "Fehlerereignisflag: Zeigt an, ob erkannt wurde, dass die K0-Differenzdrehzahl zu gross ist" UBYTE sts_int_e_M_S7_S3 1 100 0 1 ECU_ADDRESS 0xFFF86898 /end MEASUREMENT
/begin MEASUREMENT z_nem_aktiv_auw_has "Aktivierungsflag: Zeigt an, ob die Ueberwachung der EM-Drehzahl aktiv ist" UBYTE sts_int_e_M_S7_S3 1 100 0 1 ECU_ADDRESS 0xFFF86899 /end MEASUREMENT
/begin MEASUREMENT z_nemablwe_aktiv_auw_has "Aktivierungsflag: Zeigt an, ob die Ueberwachung der EM-Drehzahl zum Ablaufwechsel aktiv ist." UBYTE sts_int_e_M_S7_S3 1 100 0 1 ECU_ADDRESS 0xFFF8689A /end MEASUREMENT
/begin MEASUREMENT z_nemablwe_auw_diho "Fehlerflag: Zeigt an, ob das Fehlerereignis, dass dieEM-Istdrehzahl zu gering ist, mindestens fuer die Filterzeit vorlag." UBYTE sts_int_e_M_S7_S3 1 100 0 1 ECU_ADDRESS 0xFFF8689B /end MEASUREMENT
/begin MEASUREMENT z_nemablwe_auw_diho_has_byp "" UBYTE st_int_M_S7_S3 1 100 0 255 ECU_ADDRESS 0xFFF86C2E /end MEASUREMENT
/begin MEASUREMENT Z_NEMABLWE_AUW_DIHO_HAS_BYP_VECTOR "Vector fuer Bypass-Groesse z_nemablwe_auw_diho" UBYTE void_int_M_S7_S3 1 100 0 255 ECU_ADDRESS 0xFFF86BFE /end MEASUREMENT
/begin MEASUREMENT z_nemablwe_erk_auw_has "Fehlerereignisflag: Zeigt an, ob erkannt wurde, dass die EM-Istdrehzahl zu gering ist." UBYTE sts_int_e_M_S7_S3 1 100 0 1 ECU_ADDRESS 0xFFF8689C /end MEASUREMENT
/begin MEASUREMENT z_nemasynscl_aktiv_auw_has "Aktivierungsflag: Zeigt an, ob die Ueberwachung der EM-Istdrehzahl zum asynchronen K0 Schliessen aktiv ist." UBYTE sts_int_e_M_S7_S3 1 100 0 1 ECU_ADDRESS 0xFFF8689D /end MEASUREMENT
/begin MEASUREMENT z_nemasynscl_auw_diho "Fehlerflag: Zeigt an, dass aufgrund einer EM-Fehlfunktion das asynchrone K0 Schliessen eingeleitet werden muss." UBYTE sts_int_e_M_S7_S3 1 100 0 1 ECU_ADDRESS 0xFFF8689E /end MEASUREMENT
/begin MEASUREMENT z_nemasynscl_auw_diho_has_byp "" UBYTE st_int_M_S7_S3 1 100 0 255 ECU_ADDRESS 0xFFF86C2F /end MEASUREMENT
/begin MEASUREMENT Z_NEMASYNSCL_AUW_DIHO_HAS_BYP_VECTOR "Vector fuer Bypass-Groesse z_nemasynscl_auw_diho" UBYTE void_int_M_S7_S3 1 100 0 255 ECU_ADDRESS 0xFFF86BFF /end MEASUREMENT
/begin MEASUREMENT z_nemasynscl_erk_auw_has "Fehlerereignisflag: Zeigt an, ob erkannt wurde, dass die EM-Istdrehzahl zu gering ist." UBYTE sts_int_e_M_S7_S3 1 100 0 1 ECU_ADDRESS 0xFFF8689F /end MEASUREMENT
/begin MEASUREMENT z_nemmin_frk_dihi "Zeigt an, dass die EM Leerlauf angehoben werden soll." UBYTE sts_int_e_M_S7_S3 1 100 0 1 ECU_ADDRESS 0xFFF86C48 /end MEASUREMENT
/begin MEASUREMENT z_nemrde_diho "HAS-Diagnose: Fehlerflag zur Uebergabe an den Errorhandler  EM Rueckwaertsdreherkennung." UBYTE sts_int_e_M_S7_S3 1 100 0 1 ECU_ADDRESS 0xFFF868A0 /end MEASUREMENT
/begin MEASUREMENT z_nemrde_diho_has_byp "" UBYTE st_int_M_S7_S3 1 100 0 255 ECU_ADDRESS 0xFFF86C30 /end MEASUREMENT
/begin MEASUREMENT Z_NEMRDE_DIHO_HAS_BYP_VECTOR "Vector fuer Bypass-Groesse z_nemrde_diho_has_byp" UBYTE void_int_M_S7_S3 1 100 0 255 ECU_ADDRESS 0xFFF86C00 /end MEASUREMENT
/begin MEASUREMENT z_nemrdefehler_has "HAS-Diagnose: Fehlerflag zur Aktivierung der Diagnose  EM Rueckwaertsdreherkennung." UBYTE sts_int_e_M_S7_S3 1 100 0 1 ECU_ADDRESS 0xFFF868A1 /end MEASUREMENT
/begin MEASUREMENT z_nemrdeinit_has "HAS-Diagnose: Flag zur Initialisierung der Diagnose  EM Rueckwaertsdreherkennung." UBYTE sts_int_e_M_S7_S3 1 100 0 1 ECU_ADDRESS 0xFFF868A2 /end MEASUREMENT
/begin MEASUREMENT z_nemzuklein_auw_diho "Fehlerflag: Zeigt an, ob das Fehlerereignis, dass die EM-Istdrehzahl zu gering ist, mindestens fuer die Filterzeit vorlag." UBYTE sts_int_e_M_S7_S3 1 100 0 1 ECU_ADDRESS 0xFFF868A3 /end MEASUREMENT
/begin MEASUREMENT z_nemzuklein_auw_diho_has_byp "" UBYTE st_int_M_S7_S3 1 100 0 255 ECU_ADDRESS 0xFFF86C31 /end MEASUREMENT
/begin MEASUREMENT Z_NEMZUKLEIN_AUW_DIHO_HAS_BYP_VECTOR "Vector fuer Bypass-Groesse z_nemzuklein_auw_diho_has_byp" UBYTE void_int_M_S7_S3 1 100 0 255 ECU_ADDRESS 0xFFF86C01 /end MEASUREMENT
/begin MEASUREMENT z_nemzuklein_erk_auw_has "Fehlerereignisflag: Zeigt an, ob erkannt wurde, dass die EM-Istdrehzahl zu gering ist" UBYTE sts_int_e_M_S7_S3 1 100 0 1 ECU_ADDRESS 0xFFF868A4 /end MEASUREMENT
/begin MEASUREMENT z_nllsoll_iae_in "Anforderung der IAE, dass eine definierte LL-Drehzahl durch den Motor eingestellt werden soll" UBYTE E_ZNLLSOLL_M_S7_S3 1 100 0 3 ECU_ADDRESS 0xFFF86CC1 /end MEASUREMENT
/begin MEASUREMENT z_nllsoll_iae_portin "Anforderung der IAE, dass eine definierte LL-Drehzahl durch den Motor eingestellt werden soll" UBYTE E_ZNLLSOLL_M_S7_S3 1 100 0 3 ECU_ADDRESS 0xFFF86943 /end MEASUREMENT
/begin MEASUREMENT z_nllsoll_iep_in "" UBYTE void_int_d_M_S7_S3 1 100 0 1 ECU_ADDRESS 0xFFF86CC2 /end MEASUREMENT
/begin MEASUREMENT z_nllsoll_modus_has_byp "" UBYTE st_int_M_S7_S3 1 100 0 255 ECU_ADDRESS 0xFFF86C32 /end MEASUREMENT
/begin MEASUREMENT Z_NLLSOLL_MODUS_HAS_BYP_VECTOR "Vector fuer Bypass-Groesse z_nllsoll_modus_has_byp" UBYTE void_int_M_S7_S3 1 100 0 255 ECU_ADDRESS 0xFFF86C02 /end MEASUREMENT
/begin MEASUREMENT z_nllsoll_modus_has_portout "Modus zur Vorgabe der Dynamik des Drehzahlaufbaus" UBYTE E_ZNMODUS_M_S7_S3 1 100 0 4 ECU_ADDRESS 0xFFF86964 /end MEASUREMENT
/begin MEASUREMENT z_nminemmodus_has_sbe "Modus der Vorgabe der minimalen EM-Drehzahl der HAS" UBYTE E_ZNMODUS_M_S7_S3 1 100 0 4 ECU_ADDRESS 0xFFF86C7B /end MEASUREMENT
/begin MEASUREMENT z_nminemnull_frk_dihi "Zeigt an, dass die Ausgabe der minimalen EM Drehzahl der HAS unterdrueckt werden soll." UBYTE sts_int_e_M_S7_S3 1 100 0 1 ECU_ADDRESS 0xFFF86C49 /end MEASUREMENT
/begin MEASUREMENT z_noenginestop_ehi_has "Zeigt an, ob die Ersatzmassnahme KMN_NOENGINESTOP aktiv ist" UBYTE sts_int_e_M_S7_S3 1 100 0 1 ECU_ADDRESS 0xFFF8687D /end MEASUREMENT
/begin MEASUREMENT z_noilaunch_ehi_has "Zeigt an, ob die Ersatzmassnahme KMN_NOILANCH aktiv ist" UBYTE sts_int_e_M_S7_S3 1 100 0 1 ECU_ADDRESS 0xFFF8687E /end MEASUREMENT
/begin MEASUREMENT z_nsollvmanh_frk_dihi "Zeigt an, dass die VM-Solldrehzahl waehrend eines Start-Ablaufs angehoben werden soll" UBYTE sts_int_e_M_S7_S3 1 100 0 1 ECU_ADDRESS 0xFFF86C4A /end MEASUREMENT
/begin MEASUREMENT z_nsollvmnull_frk_dihi "Zeigt an, dass die VM-Solldrehzahl Vorgabe unterbunden werden soll" UBYTE sts_int_e_M_S7_S3 1 100 0 1 ECU_ADDRESS 0xFFF86C4B /end MEASUREMENT
/begin MEASUREMENT z_nvm_aktiv_auw_has "Aktivierungsflag: Zeigt an, ob die Ueberwachung der VM-Drehzahl aktiv ist." UBYTE sts_int_e_M_S7_S3 1 100 0 1 ECU_ADDRESS 0xFFF868A5 /end MEASUREMENT
/begin MEASUREMENT z_nvmsollbegr_frk_dihi "Zeigt an, dass die VM-Solldrehzahl auf die EM-Istdrehzahl be-grenzt werden soll" UBYTE sts_int_e_M_S7_S3 1 100 0 1 ECU_ADDRESS 0xFFF86C4C /end MEASUREMENT
/begin MEASUREMENT z_nvmzuklein_auw_diho "Fehlerflag: Zeigt an, ob das Fehlerereignis, dass die VM-Istdrehzahl zu gering ist, mindestens fuer die Filterzeit vorlag." UBYTE sts_int_e_M_S7_S3 1 100 0 1 ECU_ADDRESS 0xFFF868A6 /end MEASUREMENT
/begin MEASUREMENT z_nvmzuklein_auw_diho_has_byp "" UBYTE st_int_M_S7_S3 1 100 0 255 ECU_ADDRESS 0xFFF86C33 /end MEASUREMENT
/begin MEASUREMENT Z_NVMZUKLEIN_AUW_DIHO_HAS_BYP_VECTOR "Vector fuer Bypass-Groesse z_nvmzuklein_auw_diho_has_byp" UBYTE void_int_M_S7_S3 1 100 0 255 ECU_ADDRESS 0xFFF86C03 /end MEASUREMENT
/begin MEASUREMENT z_nvmzuklein_erk_auw_has "Fehlerereignisflag: Zeigt an, ob erkannt wurde, dass die VM-Istdrehzahl zu gering ist." UBYTE sts_int_e_M_S7_S3 1 100 0 1 ECU_ADDRESS 0xFFF868A7 /end MEASUREMENT
/begin MEASUREMENT z_oea_hst_in "Anforderung fuer das gebrueckte E-Anfahren der HST" UBYTE sts_int_M_S7_S3 1 100 0 1 ECU_ADDRESS 0xFFF86CC3 /end MEASUREMENT
/begin MEASUREMENT z_oea_hst_portin "Anforderung fuer das gebrueckte E-Anfahren der HST" UBYTE sts_int_M_S7_S3 1 100 0 1 ECU_ADDRESS 0xFFF86944 /end MEASUREMENT
/begin MEASUREMENT z_oelversfehler_diho "Fehlerflag: Zeigt an, ob ein Oelversorgungsfehler mindestens fuer die Filterzeit vorlag." UBYTE sts_int_e_M_S7_S3 1 100 0 1 ECU_ADDRESS 0xFFF868A8 /end MEASUREMENT
/begin MEASUREMENT z_oelversfehler_diho_has_byp "" UBYTE st_int_M_S7_S3 1 100 0 255 ECU_ADDRESS 0xFFF86C34 /end MEASUREMENT
/begin MEASUREMENT Z_OELVERSFEHLER_DIHO_HAS_BYP_VECTOR "Vector fuer Bypass-Groesse z_oelversfehler_diho_has_byp" UBYTE void_int_M_S7_S3 1 100 0 255 ECU_ADDRESS 0xFFF86C06 /end MEASUREMENT
/begin MEASUREMENT z_oelversfehler_erk_has "Fehlerereignisflag: Zeigt an, ob erkannt wurde, dass ein Oelversorgungsfehler vorliegt" UBYTE sts_int_e_M_S7_S3 1 100 0 1 ECU_ADDRESS 0xFFF868A9 /end MEASUREMENT
/begin MEASUREMENT z_oelversfehlerkalt_erk_has "Fehlerereignisflag: Zeigt an, ob erkannt wurde, dass ein Oelversorgungsfehler vorliegt" UBYTE sts_int_e_M_S7_S3 1 100 0 1 ECU_ADDRESS 0xFFF868AA /end MEASUREMENT
/begin MEASUREMENT z_p_hys_k0_has_byp "" UBYTE st_int_M_S7_S3 1 100 0 255 ECU_ADDRESS 0xFFF86C35 /end MEASUREMENT
/begin MEASUREMENT Z_P_HYS_K0_HAS_BYP_VECTOR "Vector fuer Bypass-Groesse z_p_hys_k0_has_byp" UBYTE void_int_M_S7_S3 1 100 0 255 ECU_ADDRESS 0xFFF86C07 /end MEASUREMENT
/begin MEASUREMENT z_p_hys_k0_has_fkt "Hysteresekompensation" UBYTE st_int_M_S7_S3 1 100 0 1 ECU_ADDRESS 0xFFF86C65 /end MEASUREMENT
/begin MEASUREMENT z_p_hys_k0_has_portout "" UBYTE sts_int_M_S7_S3 1 100 0 1 ECU_ADDRESS 0xFFF86965 /end MEASUREMENT
/begin MEASUREMENT z_ponr_fkt "point of no return" UBYTE st_int_M_S7_S3 1 100 0 1 ECU_ADDRESS 0xFFF86C66 /end MEASUREMENT
/begin MEASUREMENT z_pvu_has_sbe "Beeinflussung des Hybridsystems zur Unterstuetzung der Positionsventil- Ueberwachung der HAS-Codierung: 0 = keine Beeinflussung, 1 = Beeinflussung Stufe 1, 2 = Beeinflussung Stufe 2" UBYTE st_int_M_S7_S3 1 100 0 2 ECU_ADDRESS 0xFFF86C72 /end MEASUREMENT
/begin MEASUREMENT z_reqk0asynscl_ehi_has "Zeigt an, ob die Ersatzmassnahme KMN_REQK0ASYNC fuer asynchrones K0-Schliessen aktiv ist." UBYTE sts_int_e_M_S7_S3 1 100 0 1 ECU_ADDRESS 0xFFF8687F /end MEASUREMENT
/begin MEASUREMENT z_respschlepp_sas_fkt "" UBYTE st_int_M_S7_S3 1 100 0 1 ECU_ADDRESS 0xFFF86C67 /end MEASUREMENT
/begin MEASUREMENT z_respschleschaltaktiv_ans "Zeigt an, welche Schaltart bei einem Schleppstart mit Schaltung aktiv ist." UBYTE void_int_M_S7_S3 1 100 0 3 ECU_ADDRESS 0xFFF86A9F /end MEASUREMENT
/begin MEASUREMENT z_saf_has "Gemessen in Zustart Out" UBYTE void_int_M_S7_S3 1 100 0 1 ECU_ADDRESS 0xFFF86AA0 /end MEASUREMENT
/begin MEASUREMENT z_saf_has_byp "" UBYTE st_int_M_S7_S3 1 100 0 255 ECU_ADDRESS 0xFFF86C36 /end MEASUREMENT
/begin MEASUREMENT Z_SAF_HAS_BYP_VECTOR "Vector fuer Bypass-Groesse z_saf_has_byp" UBYTE void_int_M_S7_S3 1 100 0 255 ECU_ADDRESS 0xFFF86C08 /end MEASUREMENT
/begin MEASUREMENT z_saf_has_fkt "Schaltanforderung 1...aktiv" UBYTE st_int_M_S7_S3 1 100 0 1 ECU_ADDRESS 0xFFF86C68 /end MEASUREMENT
/begin MEASUREMENT z_saf_has_portout "Schaltanforderung HAS" UBYTE b_int_b_M_S7_S3 1 100 0 1 ECU_ADDRESS 0xFFF86966 /end MEASUREMENT
/begin MEASUREMENT z_sas_has_byp "" UBYTE st_int_M_S7_S3 1 100 0 255 ECU_ADDRESS 0xFFF86C37 /end MEASUREMENT
/begin MEASUREMENT Z_SAS_HAS_BYP_VECTOR "Vector fuer Bypass-Groesse z_sas_has_byp" UBYTE void_int_M_S7_S3 1 100 0 255 ECU_ADDRESS 0xFFF86C09 /end MEASUREMENT
/begin MEASUREMENT z_sas_has_portout "" UBYTE sts_int_M_S7_S3 1 100 0 1 ECU_ADDRESS 0xFFF86967 /end MEASUREMENT
/begin MEASUREMENT z_sas_has_sbe "Aendert im Wahrheitsfall die KupplungsBefuellreihenfolge" UBYTE st_int_M_S7_S3 1 100 0 1 ECU_ADDRESS 0xFFF86C7C /end MEASUREMENT
/begin MEASUREMENT z_sbe_has "Gemessen in Zustart Out" UBYTE void_int_M_S7_S3 1 100 0 1 ECU_ADDRESS 0xFFF86AA1 /end MEASUREMENT
/begin MEASUREMENT z_sbe_has_byp "" UBYTE st_int_M_S7_S3 1 100 0 255 ECU_ADDRESS 0xFFF86C38 /end MEASUREMENT
/begin MEASUREMENT Z_SBE_HAS_BYP_VECTOR "Vector fuer Bypass-Groesse flag_verbot_schalt_aktiv_has_byp" UBYTE void_int_M_S7_S3 1 100 0 255 ECU_ADDRESS 0xFFF86C0A /end MEASUREMENT
/begin MEASUREMENT z_sbe_has_fkt "Schaltbeeinflussung  1...aktiv" UBYTE st_int_M_S7_S3 1 100 0 1 ECU_ADDRESS 0xFFF86C69 /end MEASUREMENT
/begin MEASUREMENT z_sbe_has_portout "" UBYTE b_int_b_M_S7_S3 1 100 0 1 ECU_ADDRESS 0xFFF86968 /end MEASUREMENT
/begin MEASUREMENT z_schaltprioverh_frk_dihi "Zeigt an, dass die Schaltungspriorisierung bei einem Zustart-Ablauf  uterbunden werden soll" UBYTE sts_int_e_M_S7_S3 1 100 0 1 ECU_ADDRESS 0xFFF86C4D /end MEASUREMENT
/begin MEASUREMENT z_start_modus_has_byp "" UBYTE st_int_M_S7_S3 1 100 0 255 ECU_ADDRESS 0xFFF86C39 /end MEASUREMENT
/begin MEASUREMENT Z_START_MODUS_HAS_BYP_VECTOR "Vector fuer Bypass-Groesse z_start_modus_has_byp" UBYTE void_int_M_S7_S3 1 100 0 255 ECU_ADDRESS 0xFFF86C0B /end MEASUREMENT
/begin MEASUREMENT z_start_modus_has_portout "Flag fuer Anforderung Anlasserstart" UBYTE sts_int_M_S7_S3 1 100 0 3 ECU_ADDRESS 0xFFF86969 /end MEASUREMENT
/begin MEASUREMENT z_start_modus_has_sbe "Anforderung eines Anlasserstarts" UBYTE st_int_M_S7_S3 1 100 0 3 ECU_ADDRESS 0xFFF86C7D /end MEASUREMENT
/begin MEASUREMENT z_status_psys_mps_has_byp "" UBYTE st_int_M_S7_S3 1 100 0 255 ECU_ADDRESS 0xFFF86C3A /end MEASUREMENT
/begin MEASUREMENT Z_STATUS_PSYS_MPS_HAS_BYP_VECTOR "Vector fuer Bypass-Groesse z_status_psys_mps_has_byp" UBYTE void_int_M_S7_S3 1 100 0 255 ECU_ADDRESS 0xFFF86C0F /end MEASUREMENT
/begin MEASUREMENT z_status_psys_mps_portout "Anforderung Kupplungsbefuellung zu starten, obwohl lt. Modellierung kein Pumpendruck vorhanden ist" UBYTE sts_int_M_S7_S3 1 100 0 1 ECU_ADDRESS 0xFFF8696A /end MEASUREMENT
/begin MEASUREMENT z_status_psys_mps_sbe "Anforderung der Modifikation des Pumpendruckstatus durch die Hybrid Ablaufsteuerung (MPS)" UBYTE sts_int_M_S7_S3 1 100 0 1 ECU_ADDRESS 0xFFF86C7E /end MEASUREMENT
/begin MEASUREMENT z_statusnem_aktiv_auw_has "Aktivierungsflag: Zeigt an, ob die Ueberwachung der Signalgueltigkeit der EM-Drehzahl aktiv ist." UBYTE sts_int_e_M_S7_S3 1 100 0 1 ECU_ADDRESS 0xFFF868AB /end MEASUREMENT
/begin MEASUREMENT z_statusnem_auw_diho "Fehlerflag: Zeigt an, ob das Fehlerereignis, dass die EM-Istdrehzahl gestoert ist, mindestens fuer die Filterzeit vorlag." UBYTE sts_int_e_M_S7_S3 1 100 0 1 ECU_ADDRESS 0xFFF868AC /end MEASUREMENT
/begin MEASUREMENT z_statusnem_auw_diho_has_byp "" UBYTE st_int_M_S7_S3 1 100 0 255 ECU_ADDRESS 0xFFF86C3B /end MEASUREMENT
/begin MEASUREMENT Z_STATUSNEM_AUW_DIHO_HAS_BYP_VECTOR "Vector fuer Bypass-Groesse z_statusnem_auw_diho" UBYTE void_int_M_S7_S3 1 100 0 255 ECU_ADDRESS 0xFFF86C0E /end MEASUREMENT
/begin MEASUREMENT z_statusnem_erk_auw_has "Fehlerereignisflag: Zeigt an, ob erkannt wurde, dass die EM-Istdrehzahl zu gering ist." UBYTE sts_int_e_M_S7_S3 1 100 0 1 ECU_ADDRESS 0xFFF868AD /end MEASUREMENT
/begin MEASUREMENT z_statusnemablwe_aktiv_auw_has "Aktivierungsflag: Zeigt an, ob die Ueberwachung der EM-Drehzahlsignalgueltigkeit zum Ablaufwechsel aktiv ist." UBYTE sts_int_e_M_S7_S3 1 100 0 1 ECU_ADDRESS 0xFFF868AE /end MEASUREMENT
/begin MEASUREMENT z_statusnemablwe_auw_diho "Fehlerflag: Zeigt an, ob das Fehlerereignis, dass das EM-Drehzahlsignal gestoert ist, mindestens fuer die Filterzeit vorlag." UBYTE sts_int_e_M_S7_S3 1 100 0 1 ECU_ADDRESS 0xFFF868AF /end MEASUREMENT
/begin MEASUREMENT z_statusnemablwe_auw_diho_has_byp "" UBYTE st_int_M_S7_S3 1 100 0 255 ECU_ADDRESS 0xFFF86C3C /end MEASUREMENT
/begin MEASUREMENT Z_STATUSNEMABLWE_AUW_DIHO_HAS_BYP_VECTOR "Vector fuer Bypass-Groesse z_statusnemablwe_auw_diho" UBYTE void_int_M_S7_S3 1 100 0 255 ECU_ADDRESS 0xFFF86C0C /end MEASUREMENT
/begin MEASUREMENT z_statusnemablwe_erk_auw_has "Fehlerereignisflag: Zeigt an, ob erkannt wurde, dass das EM-Drehzahlsignal ungueltig ist." UBYTE sts_int_e_M_S7_S3 1 100 0 1 ECU_ADDRESS 0xFFF868B0 /end MEASUREMENT
/begin MEASUREMENT z_statusnemasynscl_aktiv_auw_has "Aktivierungsflag: Zeigt an, ob die Ueberwachung der Signalgueltigkeit der EM-Drehzahl aktiv ist." UBYTE sts_int_e_M_S7_S3 1 100 0 1 ECU_ADDRESS 0xFFF868B1 /end MEASUREMENT
/begin MEASUREMENT z_statusnemasynscl_auw_diho "Fehlerflag: Zeigt an, ob das Fehlerereignis, dass die EM-Istdrehzahl gestoert ist, mindestens fuer die Filterzeit vorlag." UBYTE sts_int_e_M_S7_S3 1 100 0 1 ECU_ADDRESS 0xFFF868B2 /end MEASUREMENT
/begin MEASUREMENT z_statusnemasynscl_auw_diho_has_byp "" UBYTE st_int_M_S7_S3 1 100 0 255 ECU_ADDRESS 0xFFF86C3D /end MEASUREMENT
/begin MEASUREMENT Z_STATUSNEMASYNSCL_AUW_DIHO_HAS_BYP_VECTOR "Vector fuer Bypass-Groesse z_statusnemasynscl_auw_diho" UBYTE void_int_M_S7_S3 1 100 0 255 ECU_ADDRESS 0xFFF86C0D /end MEASUREMENT
/begin MEASUREMENT z_statusnemasynscl_erk_auw_has "Fehlerereignisflag: Zeigt an, ob erkannt wurde, dass die EM-Istdrehzahl zu gering ist." UBYTE sts_int_e_M_S7_S3 1 100 0 1 ECU_ADDRESS 0xFFF868B3 /end MEASUREMENT
/begin MEASUREMENT z_statuspsysmps_frk_dihi "Zeigt an, dass der Pumpendruck-Status der ATSYS modifiziert werden soll" UBYTE sts_int_e_M_S7_S3 1 100 0 1 ECU_ADDRESS 0xFFF86C4E /end MEASUREMENT
/begin MEASUREMENT z_svh_frk_dihi "Zeigt an, dass die Schaltverhinderung (SVH) aktiviert werden soll" UBYTE sts_int_e_M_S7_S3 1 100 0 1 ECU_ADDRESS 0xFFF86C4F /end MEASUREMENT
/begin MEASUREMENT z_svh_has_byp "" UBYTE st_int_M_S7_S3 1 100 0 255 ECU_ADDRESS 0xFFF86C3E /end MEASUREMENT
/begin MEASUREMENT Z_SVH_HAS_BYP_VECTOR "Vector fuer Bypass-Groesse z_svh_has_byp" UBYTE void_int_M_S7_S3 1 100 0 255 ECU_ADDRESS 0xFFF86C10 /end MEASUREMENT
/begin MEASUREMENT z_svh_has_portout "Schaltanforderung HAS" UBYTE sts_int_M_S7_S3 1 100 0 1 ECU_ADDRESS 0xFFF8696B /end MEASUREMENT
/begin MEASUREMENT z_svh_has_sbe "Anforderung einer Schaltverhinderung der HAS" UBYTE st_int_M_S7_S3 1 100 0 1 ECU_ADDRESS 0xFFF86C7F /end MEASUREMENT
/begin MEASUREMENT z_t_asistask_ans "Bedingung fuer den Uebergang von Phase Start nach Phase Konditionieren" UBYTE void_int_d_M_S7_S3 1 100 0 1 ECU_ADDRESS 0xFFF86AA3 /end MEASUREMENT
/begin MEASUREMENT z_vmaus_aktiv_auw_has "Aktivierungsflag: Zeigt an, ob die Ueberwachung der VM-Drehzahl aktiv ist." UBYTE sts_int_e_M_S7_S3 1 100 0 1 ECU_ADDRESS 0xFFF868B4 /end MEASUREMENT
/begin MEASUREMENT z_vmaus_auw_diho "Fehlerflag: Zeigt an, ob das Fehlerereignis, dass der VM aus ist, mindestens fuer die Filterzeit vorlag." UBYTE sts_int_e_M_S7_S3 1 100 0 1 ECU_ADDRESS 0xFFF868B5 /end MEASUREMENT
/begin MEASUREMENT z_vmaus_auw_diho_has_byp "" UBYTE st_int_M_S7_S3 1 100 0 255 ECU_ADDRESS 0xFFF86C3F /end MEASUREMENT
/begin MEASUREMENT Z_VMAUS_AUW_DIHO_HAS_BYP_VECTOR "Vector fuer Bypass-Groesse z_vmaus_auw_diho_has_byp" UBYTE void_int_M_S7_S3 1 100 0 255 ECU_ADDRESS 0xFFF86C11 /end MEASUREMENT
/begin MEASUREMENT z_vmaus_erk_auw_has "Fehlerereignisflag: Zeigt an, ob erkannt wurde, dass der VM aus ist." UBYTE sts_int_e_M_S7_S3 1 100 0 1 ECU_ADDRESS 0xFFF868B6 /end MEASUREMENT
/begin MEASUREMENT z_vmstartanf_frk_dihi "Zeigt an, dass der VM gestartet werden soll." UBYTE sts_int_e_M_S7_S3 1 100 0 1 ECU_ADDRESS 0xFFF86C50 /end MEASUREMENT
/begin MEASUREMENT z_vmstartverbot_frk_dihi "Zeigt an, dass der VM nicht gestartet werden darf." UBYTE sts_int_e_M_S7_S3 1 100 0 1 ECU_ADDRESS 0xFFF86C51 /end MEASUREMENT
/begin MEASUREMENT z_vmstopverbot_frk_dihi "Zeigt an, dass der VM nicht gestoppt werden darf." UBYTE sts_int_e_M_S7_S3 1 100 0 1 ECU_ADDRESS 0xFFF86C52 /end MEASUREMENT
/begin MEASUREMENT z_zuendfreigabe_vm_fkt "" UBYTE st_int_M_S7_S3 1 100 0 1 ECU_ADDRESS 0xFFF86C6A /end MEASUREMENT
/begin MEASUREMENT z_zuendfreigabe_vm_has_fkt "" UBYTE st_int_M_S7_S3 1 100 0 1 ECU_ADDRESS 0xFFF86C6B /end MEASUREMENT
/begin MEASUREMENT z_zust_halten_frk_dihi "Zeigt an, ob der Betriebszustand \"HAS Zustand halten\" aktiv sein soll." UBYTE sts_int_e_M_S7_S3 1 100 0 1 ECU_ADDRESS 0xFFF86C53 /end MEASUREMENT
/begin MEASUREMENT z_zust_init_frk_dihi "Zeigt an, ob der Betriebszustand \"HAS Zustand Init\" aktiv sein soll." UBYTE sts_int_e_M_S7_S3 1 100 0 1 ECU_ADDRESS 0xFFF86C54 /end MEASUREMENT
/begin MEASUREMENT zielgang_egs_in "" SBYTE sts_int_M_S7_S3 1 100 -128 127 ECU_ADDRESS 0xFFF86CC4 /end MEASUREMENT
/begin MEASUREMENT zielgang_egs_portin "" SBYTE void_int_M_S7_S3 1 100 -128 127 ECU_ADDRESS 0xFFF86945 /end MEASUREMENT
/begin COMPU_METHOD SAB_P_KPA_S2_S3 "int = ((phys * 1) / 1) - (0) kPa" RAT_FUNC "%2.0" "kPa" COEFFS 0 1 -0 0 0 1 /end COMPU_METHOD
/begin COMPU_METHOD SAB_P_MBAR_S2_S3 "int = ((phys * 1) / 1) - (0) mbar" RAT_FUNC "%2.0" "mbar" COEFFS 0 1 -0 0 0 1 /end COMPU_METHOD
/begin COMPU_METHOD SAB_P_BAR_100KPA2396_P102_S2_S3 "int = ((phys * 100) / 2396) - (-102) kPa" RAT_FUNC "%5.3" "kPa" COEFFS 0 100 244392 0 0 2396 /end COMPU_METHOD
/begin COMPU_METHOD SAB_P_1BAR_S2_S3 "int = ((phys * 1) / 1) - (0) bar" RAT_FUNC "%2.0" "bar" COEFFS 0 1 -0 0 0 1 /end COMPU_METHOD
/begin COMPU_METHOD SAB_P_BAR128_S2_S3 "int = ((phys * 128) / 1) - (0) bar" RAT_FUNC "%8.6" "bar" COEFFS 0 128 -0 0 0 1 /end COMPU_METHOD
/begin COMPU_METHOD b_int_M_S7_S3 "Bit Feld" RAT_FUNC "%10.0" "-" COEFFS 0 1 0 0 0 1 /end COMPU_METHOD
/begin COMPU_METHOD b_int_b_M_S7_S3 "Bit Feld" RAT_FUNC "%3.0" "-" COEFFS 0 1 0 0 0 1 /end COMPU_METHOD
/begin COMPU_METHOD b_int_h_M_S7_S3 "Bit Feld" RAT_FUNC "%1.0" "-" COEFFS 0 1 0 0 0 1 /end COMPU_METHOD
/begin COMPU_METHOD c_fl_M_S7_S3 "Temperatur" RAT_FUNC "%12.6" "°C" COEFFS 0 1 0 0 0 1 /end COMPU_METHOD
/begin COMPU_METHOD c_int_M_S7_S3 "Temperatur" RAT_FUNC "%12.6" "°C" COEFFS 0 1 0 0 0 1 /end COMPU_METHOD
/begin COMPU_METHOD cnt_int_M_S7_S3 "Zaehler" RAT_FUNC "%3.0" "-" COEFFS 0 1 0 0 0 1 /end COMPU_METHOD
/begin COMPU_METHOD ctrl_int_M_S7_S3 "Steuerwort" RAT_FUNC "%3.0" "-" COEFFS 0 1 0 0 0 1 /end COMPU_METHOD
/begin COMPU_METHOD E_BREMSPED_M_S7_S3 "" TAB_VERB "%12.6" "" COMPU_TAB_REF CONV_TAB_E_BREMSPED_M_S7_S3 /end COMPU_METHOD
/begin COMPU_METHOD E_DREHRICH_M_S7_S3 "" TAB_VERB "%12.6" "" COMPU_TAB_REF CONV_TAB_E_DREHRICH_M_S7_S3 /end COMPU_METHOD
/begin COMPU_METHOD E_FEHLERIEP_M_S7_S3 "" TAB_VERB "%12.6" "" COMPU_TAB_REF CONV_TAB_E_FEHLERIEP_M_S7_S3 /end COMPU_METHOD
/begin COMPU_METHOD E_HYBFKT_M_S7_S3 "" TAB_VERB "%12.6" "" COMPU_TAB_REF CONV_TAB_E_HYBFKT_M_S7_S3 /end COMPU_METHOD
/begin COMPU_METHOD E_MODUSEFAH_M_S7_S3 "" TAB_VERB "%12.6" "" COMPU_TAB_REF CONV_TAB_E_MODUSEFAH_M_S7_S3 /end COMPU_METHOD
/begin COMPU_METHOD E_POS_M_S7_S3 "" TAB_VERB "%12.6" "" COMPU_TAB_REF CONV_TAB_E_POS_M_S7_S3 /end COMPU_METHOD
/begin COMPU_METHOD E_SIGSTATUS_M_S7_S3 "" TAB_VERB "%12.6" "" COMPU_TAB_REF CONV_TAB_E_SIGSTATUS_M_S7_S3 /end COMPU_METHOD
/begin COMPU_METHOD E_STAK0BEF_M_S7_S3 "" TAB_VERB "%12.6" "" COMPU_TAB_REF CONV_TAB_E_STAK0BEF_M_S7_S3 /end COMPU_METHOD
/begin COMPU_METHOD E_STATUSABS_M_S7_S3 "" TAB_VERB "%12.6" "" COMPU_TAB_REF CONV_TAB_E_STATUSABS_M_S7_S3 /end COMPU_METHOD
/begin COMPU_METHOD E_STATUSADA_M_S7_S3 "" TAB_VERB "%12.6" "" COMPU_TAB_REF CONV_TAB_E_STATUSADA_M_S7_S3 /end COMPU_METHOD
/begin COMPU_METHOD E_STATUSASR_M_S7_S3 "" TAB_VERB "%12.6" "" COMPU_TAB_REF CONV_TAB_E_STATUSASR_M_S7_S3 /end COMPU_METHOD
/begin COMPU_METHOD E_STATUSCK0_M_S7_S3 "" TAB_VERB "%12.6" "" COMPU_TAB_REF CONV_TAB_E_STATUSCK0_M_S7_S3 /end COMPU_METHOD
/begin COMPU_METHOD E_STATUSIAE_M_S7_S3 "" TAB_VERB "%12.6" "" COMPU_TAB_REF CONV_TAB_E_STATUSIAE_M_S7_S3 /end COMPU_METHOD
/begin COMPU_METHOD E_STATUSIEP_M_S7_S3 "" TAB_VERB "%12.6" "" COMPU_TAB_REF CONV_TAB_E_STATUSIEP_M_S7_S3 /end COMPU_METHOD
/begin COMPU_METHOD E_STATUSK0_M_S7_S3 "" TAB_VERB "%12.6" "" COMPU_TAB_REF CONV_TAB_E_STATUSK0_M_S7_S3 /end COMPU_METHOD
/begin COMPU_METHOD E_STATUSKSL_M_S7_S3 "" TAB_VERB "%12.6" "" COMPU_TAB_REF CONV_TAB_E_STATUSKSL_M_S7_S3 /end COMPU_METHOD
/begin COMPU_METHOD E_STATUSNAA_M_S7_S3 "" TAB_VERB "%12.6" "" COMPU_TAB_REF CONV_TAB_E_STATUSNAA_M_S7_S3 /end COMPU_METHOD
/begin COMPU_METHOD E_STATUSPSY_M_S7_S3 "" TAB_VERB "%12.6" "" COMPU_TAB_REF CONV_TAB_E_STATUSPSY_M_S7_S3 /end COMPU_METHOD
/begin COMPU_METHOD E_STATUSRSE_M_S7_S3 "" TAB_VERB "%12.6" "" COMPU_TAB_REF CONV_TAB_E_STATUSRSE_M_S7_S3 /end COMPU_METHOD
/begin COMPU_METHOD E_STBZHAS_M_S7_S3 "" TAB_VERB "%12.6" "" COMPU_TAB_REF CONV_TAB_E_STBZHAS_M_S7_S3 /end COMPU_METHOD
/begin COMPU_METHOD E_ZIEP_M_S7_S3 "" TAB_VERB "%12.6" "" COMPU_TAB_REF CONV_TAB_E_ZIEP_M_S7_S3 /end COMPU_METHOD
/begin COMPU_METHOD E_ZK0_M_S7_S3 "" TAB_VERB "%12.6" "" COMPU_TAB_REF CONV_TAB_E_ZK0_M_S7_S3 /end COMPU_METHOD
/begin COMPU_METHOD E_ZK0FSTIN_M_S7_S3 "" TAB_VERB "%12.6" "" COMPU_TAB_REF CONV_TAB_E_ZK0FSTIN_M_S7_S3 /end COMPU_METHOD
/begin COMPU_METHOD E_ZMODUSIAE_M_S7_S3 "" TAB_VERB "%12.6" "" COMPU_TAB_REF CONV_TAB_E_ZMODUSIAE_M_S7_S3 /end COMPU_METHOD
/begin COMPU_METHOD E_ZMODUSIEP_M_S7_S3 "" TAB_VERB "%12.6" "" COMPU_TAB_REF CONV_TAB_E_ZMODUSIEP_M_S7_S3 /end COMPU_METHOD
/begin COMPU_METHOD E_ZNLLSOLL_M_S7_S3 "" TAB_VERB "%12.6" "" COMPU_TAB_REF CONV_TAB_E_ZNLLSOLL_M_S7_S3 /end COMPU_METHOD
/begin COMPU_METHOD E_ZNMODUS_M_S7_S3 "" TAB_VERB "%12.6" "" COMPU_TAB_REF CONV_TAB_E_ZNMODUS_M_S7_S3 /end COMPU_METHOD
/begin COMPU_METHOD n_fl_M_S7_S3 "Drehzahl" RAT_FUNC "%12.6" "1/min" COEFFS 0 1 0 0 0 1 /end COMPU_METHOD
/begin COMPU_METHOD n_int_M_S7_S3 "Drehzahl" RAT_FUNC "%5.0" "1/min" COEFFS 0 1 0 0 0 1 /end COMPU_METHOD
/begin COMPU_METHOD n_int_26_M_S7_S3 "Drehzahl" RAT_FUNC "%3.0" "1/min" COEFFS 0 1 0 0 0 1 /end COMPU_METHOD
/begin COMPU_METHOD ng_fl_M_S7_S3 "Drehzahlgradient" RAT_FUNC "%12.6" "1/min/s" COEFFS 0 1 0 0 0 1 /end COMPU_METHOD
/begin COMPU_METHOD p_fl_M_S7_S3 "Druck" RAT_FUNC "%12.6" "bar" COEFFS 0 1 0 0 0 1 /end COMPU_METHOD
/begin COMPU_METHOD phigrad_fl_M_S7_S3 "Winkel in grad" RAT_FUNC "%12.6" "grad" COEFFS 0 1 0 0 0 1 /end COMPU_METHOD
/begin COMPU_METHOD ratio_fl_M_S7_S3 "Uebersetzungsverhaeltnis" RAT_FUNC "%12.6" "-" COEFFS 0 1 0 0 0 1 /end COMPU_METHOD
/begin COMPU_METHOD rel_int_M_S7_S3 "Relative Groesse" RAT_FUNC "%3.0" "%" COEFFS 0 1 0 0 0 1 /end COMPU_METHOD
/begin COMPU_METHOD st_int_M_S7_S3 "Zustandsgroesse" RAT_FUNC "%3.0" "-" COEFFS 0 1 0 0 0 1 /end COMPU_METHOD
/begin COMPU_METHOD st_int_g_M_S7_S3 "Zustandsgroesse" RAT_FUNC "%5.0" "-" COEFFS 0 1 0 0 0 1 /end COMPU_METHOD
/begin COMPU_METHOD st_int_l_M_S7_S3 "Zustandsgroesse" RAT_FUNC "%1.0" "-" COEFFS 0 1 0 0 0 1 /end COMPU_METHOD
/begin COMPU_METHOD sts_fl_M_S7_S3 "Status" RAT_FUNC "%12.6" "-" COEFFS 0 1 0 0 0 1 /end COMPU_METHOD
/begin COMPU_METHOD sts_int_M_S7_S3 "Status" RAT_FUNC "%3.0" "-" COEFFS 0 1 0 0 0 1 /end COMPU_METHOD
/begin COMPU_METHOD sts_int_e_M_S7_S3 "Status" RAT_FUNC "%1.0" "-" COEFFS 0 1 0 0 0 1 /end COMPU_METHOD
/begin COMPU_METHOD sts_int_m_M_S7_S3 "Status" RAT_FUNC "%10.0" "-" COEFFS 0 1 0 0 0 1 /end COMPU_METHOD
/begin COMPU_METHOD swi_int_M_S7_S3 "Schalter" RAT_FUNC "%1.0" "-" COEFFS 0 1 0 0 0 1 /end COMPU_METHOD
/begin COMPU_METHOD t_fl_M_S7_S3 "Zeit" RAT_FUNC "%12.6" "s" COEFFS 0 1 0 0 0 1 /end COMPU_METHOD
/begin COMPU_METHOD t_int_M_S7_S3 "Zeit" RAT_FUNC "%11.2" "s" COEFFS 0 1 0 0 0 0.01 /end COMPU_METHOD
/begin COMPU_METHOD t_int_n_M_S7_S3 "Zeit" RAT_FUNC "%6.2" "s" COEFFS 0 1 0 0 0 0.01 /end COMPU_METHOD
/begin COMPU_METHOD trq_fl_M_S7_S3 "Moment" RAT_FUNC "%5.0" "Nm" COEFFS 0 1 0 0 0 1 /end COMPU_METHOD
/begin COMPU_METHOD trq_fl_a_M_S7_S3 "Moment" RAT_FUNC "%12.6" "Nm" COEFFS 0 1 0 0 0 1 /end COMPU_METHOD
/begin COMPU_METHOD trq_int_M_S7_S3 "Moment" RAT_FUNC "%5.0" "Nm" COEFFS 0 1 0 0 0 1 /end COMPU_METHOD
/begin COMPU_METHOD trqg_fl_M_S7_S3 "Momentengradient" RAT_FUNC "%5.0" "Nm/s" COEFFS 0 1 0 0 0 1 /end COMPU_METHOD
/begin COMPU_METHOD trqg_fl_k_M_S7_S3 "Momentengradient" RAT_FUNC "%12.6" "Nm/s" COEFFS 0 1 0 0 0 1 /end COMPU_METHOD
/begin COMPU_METHOD trqg_int_M_S7_S3 "Momentengradient" RAT_FUNC "%5.0" "Nm/s" COEFFS 0 1 0 0 0 1 /end COMPU_METHOD
/begin COMPU_METHOD v_fl_M_S7_S3 "Geschwindigkeit" RAT_FUNC "%12.6" "km/h" COEFFS 0 1 0 0 0 1 /end COMPU_METHOD
/begin COMPU_METHOD v_int_M_S7_S3 "Geschwindigkeit" RAT_FUNC "%5.0" "km/h" COEFFS 0 1 0 0 0 1 /end COMPU_METHOD
/begin COMPU_METHOD vg_fl_M_S7_S3 "Geschwindigkeitsgradient" RAT_FUNC "%12.6" "km/h/s" COEFFS 0 1 0 0 0 1 /end COMPU_METHOD
/begin COMPU_METHOD void_fl_M_S7_S3 "ohne Umrechnung" RAT_FUNC "%12.6" "-" COEFFS 0 1 0 0 0 1 /end COMPU_METHOD
/begin COMPU_METHOD void_fl_u_M_S7_S3 "ohne Umrechnung" RAT_FUNC "%1.0" "-" COEFFS 0 1 0 0 0 1 /end COMPU_METHOD
/begin COMPU_METHOD void_int_M_S7_S3 "ohne Umrechnung" RAT_FUNC "%3.0" "-" COEFFS 0 1 0 0 0 1 /end COMPU_METHOD
/begin COMPU_METHOD void_int_c_M_S7_S3 "ohne Umrechnung" RAT_FUNC "%5.0" "-" COEFFS 0 1 0 0 0 1 /end COMPU_METHOD
/begin COMPU_METHOD void_int_d_M_S7_S3 "ohne Umrechnung" RAT_FUNC "%1.0" "-" COEFFS 0 1 0 0 0 1 /end COMPU_METHOD
/begin COMPU_METHOD void_int_f_M_S7_S3 "ohne Umrechnung" RAT_FUNC "%10.0" "-" COEFFS 0 1 0 0 0 1 /end COMPU_METHOD
/begin COMPU_VTAB CONV_TAB_E_BREMSPED_M_S7_S3 "Conversion table" TAB_VERB 2 0 "NICHT_GETRETEN" 1 "GETRETEN" /end COMPU_VTAB
/begin COMPU_VTAB CONV_TAB_E_DREHRICH_M_S7_S3 "Conversion table" TAB_VERB 3 0 "UNBESTIMMT" 1 "VORWAERTS" 2 "RUECKWAERTS" /end COMPU_VTAB
/begin COMPU_VTAB CONV_TAB_E_FEHLERIEP_M_S7_S3 "Conversion table" TAB_VERB 2 0 "NORMALBETRIEB" 1 "FEHLER" /end COMPU_VTAB
/begin COMPU_VTAB CONV_TAB_E_HYBFKT_M_S7_S3 "Conversion table" TAB_VERB 14 0 "PASSIV" 1 "ANKOPPELN_VM" 3 "GANGEINLEGEN" 4 "GANGAUSLEGEN" 5 "OHNABLAUFFKT" 7 "VM_ZUSTART" 8 "ABSTELLEN_VM" 9 "NICHTDEFINIERT_4" 10 "VM_SCHLEPPSTART" 11 "VM_NOTSTART" 12 "VM_EIN" 13 "VM_AUS" 14 "ABSTELLPOSOPT_VM" 15 "FEHLER" /end COMPU_VTAB
/begin COMPU_VTAB CONV_TAB_E_MODUSEFAH_M_S7_S3 "Conversion table" TAB_VERB 2 0 "LADUNG_ABBAUEN" 1 "LADUNG_ERHALTEN" /end COMPU_VTAB
/begin COMPU_VTAB CONV_TAB_E_POS_M_S7_S3 "Conversion table" TAB_VERB 9 0 "D1" 1 "D2" 2 "D3" 3 "D4" 4 "D5" 5 "D" 6 "N" 7 "R" 8 "P" /end COMPU_VTAB
/begin COMPU_VTAB CONV_TAB_E_SIGSTATUS_M_S7_S3 "Conversion table" TAB_VERB 3 0 "SIGNAL_OK" 1 "ERSATZWERT" 2 "SIGNAL_FEHLER" /end COMPU_VTAB
/begin COMPU_VTAB CONV_TAB_E_STAK0BEF_M_S7_S3 "Conversion table" TAB_VERB 4 0 "NICHT_AKTIV" 1 "STANDARD_BEF" 2 "OPTIMIERTBEF" 3 "REDUZIERTBEF" /end COMPU_VTAB
/begin COMPU_VTAB CONV_TAB_E_STATUSABS_M_S7_S3 "Conversion table" TAB_VERB 3 1 "AKTIV" 0 "NICHT_AKTIV" 2 "FEHLER" /end COMPU_VTAB
/begin COMPU_VTAB CONV_TAB_E_STATUSADA_M_S7_S3 "Conversion table" TAB_VERB 3 0 "KEINADAPTION" 1 "TOUCHPOINT_ADAPTION" 2 "REIBWERT_ADAPTION" /end COMPU_VTAB
/begin COMPU_VTAB CONV_TAB_E_STATUSASR_M_S7_S3 "Conversion table" TAB_VERB 2 0 "NICHT_AKTIV" 1 "AKTIV" /end COMPU_VTAB
/begin COMPU_VTAB CONV_TAB_E_STATUSCK0_M_S7_S3 "Conversion table" TAB_VERB 3 0 "NORMAL" 1 "ZU_HEISS" 2 "UEBERHITZT" /end COMPU_VTAB
/begin COMPU_VTAB CONV_TAB_E_STATUSIAE_M_S7_S3 "Conversion table" TAB_VERB 9 0 "NICHTDEFINIERT" 1 "OFFEN" 2 "ANGELEGT" 3 "ANFAHREN" 4 "ENTKOPPELT" 5 "ENTKOPPELT_ANFAHREN" 6 "SYNCHRONISIEREN" 7 "GESCHLOSSEN" 8 "OEFFNEN" /end COMPU_VTAB
/begin COMPU_VTAB CONV_TAB_E_STATUSIEP_M_S7_S3 "Conversion table" TAB_VERB 5 0 "AUS" 1 "SLEEP" 2 "LP1" 3 "LP2" 4 "LP3" /end COMPU_VTAB
/begin COMPU_VTAB CONV_TAB_E_STATUSK0_M_S7_S3 "Conversion table" TAB_VERB 6 0 "OFFEN" 1 "ANGELEGT" 2 "DRUCKSTELLUNG" 3 "SCHLUPFGEREGELT" 4 "GEREGELTGESCHL" 5 "GESCHLOSSEN" /end COMPU_VTAB
/begin COMPU_VTAB CONV_TAB_E_STATUSKSL_M_S7_S3 "Conversion table" TAB_VERB 7 0 "KEIN_KRAFTSCHLUSS" 1 "VORW_AUF_ABBAUEND" 2 "VORWAERTS" 3 "RUECKW_AUF_ABBAUEND" 4 "RUECKWAERTS" 5 "VORWAERTS_SCHLUPF" 6 "RUECKWAERTS_SCHLUPF" /end COMPU_VTAB
/begin COMPU_VTAB CONV_TAB_E_STATUSNAA_M_S7_S3 "Conversion table" TAB_VERB 2 0 "NICHT_AKTIV" 1 "AKTIV" /end COMPU_VTAB
/begin COMPU_VTAB CONV_TAB_E_STATUSPSY_M_S7_S3 "Conversion table" TAB_VERB 5 0 "AUS" 1 "NICHTDEFINIERT" 2 "LP1" 3 "LP2" 4 "LP3" /end COMPU_VTAB
/begin COMPU_VTAB CONV_TAB_E_STATUSRSE_M_S7_S3 "Conversion table" TAB_VERB 2 0 "KEIN_RADSCHLUPF" 1 "DURCHDREHEN_ERKANNT" /end COMPU_VTAB
/begin COMPU_VTAB CONV_TAB_E_STBZHAS_M_S7_S3 "Conversion table" TAB_VERB 16 0 "INIT_INAKTIV" 1 "ANGEKOPPELT" 2 "ENTKOPPELT" 3 "EFAHREN" 4 "STOP" 5 "LADEN" 6 "ENTK_VMEIN" 7 "EFAHREN_VMEIN" 8 "HYBRID" 9 "NICHTDEFINIERT_1" 10 "NICHTDEFINIERT_2" 11 "NICHTDEFINIERT_3" 12 "NICHTDEFINIERT_4" 13 "NICHTDEFINIERT_5" 14 "INIT_KL15" 15 "FEHLER" /end COMPU_VTAB
/begin COMPU_VTAB CONV_TAB_E_ZIEP_M_S7_S3 "Conversion table" TAB_VERB 5 0 "AUS" 1 "SLEEP" 2 "LP1" 3 "LP2" 4 "LP3" /end COMPU_VTAB
/begin COMPU_VTAB CONV_TAB_E_ZK0_M_S7_S3 "Conversion table" TAB_VERB 6 0 "OEFFNENSW" 1 "BEFUELLEN" 2 "DRUCKSTELLUNG" 3 "SCHLUPFREGELUNG" 4 "GEREGELTGESCHL" 5 "GESCHLOSSEN" /end COMPU_VTAB
/begin COMPU_VTAB CONV_TAB_E_ZK0FSTIN_M_S7_S3 "Conversion table" TAB_VERB 4 0 "OFFEN" 1 "SCHLUPFGEREGELT" 2 "GEREGELTGESCHL" 3 "GESCHLOSSEN" /end COMPU_VTAB
/begin COMPU_VTAB CONV_TAB_E_ZMODUSIAE_M_S7_S3 "Conversion table" TAB_VERB 3 0 "EFAHREN_SCHLUPF" 1 "EFAHREN_KRAFTSCHL" 2 "HYBRIDFAHREN" /end COMPU_VTAB
/begin COMPU_VTAB CONV_TAB_E_ZMODUSIEP_M_S7_S3 "Conversion table" TAB_VERB 5 0 "KEINVORGABE" 1 "AUS" 2 "LP1" 3 "LP2" 4 "LP3" /end COMPU_VTAB
/begin COMPU_VTAB CONV_TAB_E_ZNLLSOLL_M_S7_S3 "Conversion table" TAB_VERB 4 0 "KEINANF" 1 "ANF_ADAP" 2 "ANF_ALLG" 3 "ANF_ADAP_IEP" /end COMPU_VTAB
/begin COMPU_VTAB CONV_TAB_E_ZNMODUS_M_S7_S3 "Conversion table" TAB_VERB 5 0 "KEIN_AUFBAU" 1 "SCHNELL" 2 "ZUEGIG" 3 "KOMFORTABEL" 4 "UNTERDRUECKT" /end COMPU_VTAB
/begin FUNCTION Action_FOp_ABST ""
 /begin LOC_MEASUREMENT m_max_em_has_fkt m_min_em_has_fkt m_k0_mod_has_fkt m_soll_em_has_fkt m_soll_k0_has_fkt n_soll_em_has_fkt st_ablauf_fkt status_ablauf_has_fkt z_k0_has_fkt z_m_soll_em_has_fkt z_n_soll_em_has_fkt z_n_soll_vm_has_fkt z_zuendfreigabe_vm_has_fkt z_p_hys_k0_has_fkt z_ponr_fkt z_ablauf_svh_reset_has_fkt m_max_iae_has_fkt m_soll_res_em_has_fkt mg_soll_k0_has_fkt n_soll_vm_has_fkt nd_min_saf_has_fkt nd_soll_iae_fkt z_ablaufvariante_kalt_zus z_emaktiv_fuw_zus_fkt z_fehler15_eh_fkt z_k0_befuellopt_has_fkt z_m_max_iae_has_fkt z_respschlepp_sas_fkt z_saf_has_fkt z_sbe_has_fkt z_zuendfreigabe_vm_fkt z_hybfkt_stg st_ziel_bz_has_stg st_ist_bz_has_stg st_ist_hcomd_has_stg z_ablauf_has_stg z_ablaufvariante_has_stg n_em_in status_k0_in m_k0_in n_vm_in m_vm_in z_ablauf_has_hst_in m_soll_vm_hst_in status_kraftfluss_egs_in m_mot_in c_getriebe_egs_in m_em_in istgang_egs_in sollgang_egs_in z_modus_em_hst_in m_iae_in m_max_dyn_em_in m_soll_em_hst_in m_vm_start_in m_wunsch_fpw_in n_ab_egs_in n_soll_ll_vm_in n_t_egs_in osmode_next_in p_bremse_fzg_in status_fehler_iep_in status_iae_in status_iep_in pos_egs_in z_ablaufvariante_has_hst_in zielgang_egs_in z_k0_fst_in status_iae_adap_in z_diag_ersfkt_has_in z_diag_ersfkt_hi_has_in z_diag_notgang_has_in status_k0_adap_in status_waschstr_in z_n_min_em_parksp_has_in n_mot_soll_iae_in status_alaengs_adaoff_in gangwechsel_egs_in z_nllsoll_iae_in status_nem_in status_nvm_in kolbenpos_k0_in z_kps_stada_in t_betrieb_pvu_has_ee_in status_ll_vm_in z_msa_fst_in m_min_dyn_em_in phi_neigung_in v_f_in drehrichtung_nem_in fpw_in drehrichtung_nab_in schalt_mode_egs_in m_ziel_k0_hst_in status_kraftfluss_lev2_egs_in i_gang_lev2_egs_in status_c_k0_in bremspedal_in status_autohold_in status_hillhold_in status_vf_in v_f_ref_in status_vfref_in z_diag_ersfkt_hi_96_has_in status_k0_adap_zaehler_in status_k0_befuellung_in z_oea_hst_in z_iep_in z_nllsoll_iep_in nd_k0_in status_schaltung_egs_in ng_vm_in status_schaltart_svh_has_sbe i_istgang_egs i_zielgang_egs m_wunsch_fpw_hst_fil mg_wunsch_fpw_in mg_wunsch_fpw_hst_in n_sec_iae ndg_k0_in n_min_em_psys_lp3_has_sbe status_psys_has_sbe vg_f_sbe v_f_sbe status_sync_schaltung_sbe z_pvu_has_sbe z_freigabe_pvu_has_sbe t_betrieb_pvu_has_sbe mg_mot_in status_radschlupf_rse_has_sbe m_soll_vm_l_hst_in status_sa_vm_in m_min_vm_in c_vm_in n_soll_em_hst_in abstellpos_vm_in abstellpos_vm_status_in status_nreg_em_hst_in z_msa_stada_in m_wunsch_fpw_hst_in status_getrbereit_in status_betriebsbereit_hst_in z_ba_has_vm_hst_in z_ba_has_k0_hst_in status_abs_in status_asr_in modus_e_fahren_hst_in status_kl15_in status_posvueb_in soc_in status_soc_in c_umgebung_in status_cumgebung_in n_min_em_has_sbe z_lls_fktaktiv_has_sbe z_svh_has_sbe m_motmax_has_sbe z_k0_has_sbe m_soll_res_em_has_sbe m_soll_res_em_bas_sbe z_modus_iae_has_sbe z_sas_has_sbe z_modus_iep_has_sbe z_msa_has_sbe status_efahren_has_sbe z_msa_avh_moni_has_sbe z_msa_eaf_moni_has_sbe z_start_modus_has_sbe m_k0_mber_has_sbe z_status_psys_mps_sbe m_k0_has_sbe m_soll_k0_has_sbe analyse_has_sbe z_nminemmodus_has_sbe /end LOC_MEASUREMENT
 /begin SUB_FUNCTION SFOp_ABST2_FOp_Abstellen /end SUB_FUNCTION
/end FUNCTION
/begin FUNCTION Action_FOp_ANS ""
 /begin LOC_MEASUREMENT z_k0_befuellopt_has m_stoer_k0_em nd_emnsollvm_ans no_emnsollvm_ans status_gangwechsel_znd_ans status_lastwechsel_srt_ans z_k0sregaktiv_ans z_k0sregbasis_ans z_respschleschaltaktiv_ans z_saf_has z_sbe_has z_t_asistask_ans m_max_em_has_fkt m_max_iae_has_fkt m_min_em_has_fkt m_k0_mod_has_fkt m_soll_em_has_fkt m_soll_k0_has_fkt mg_soll_k0_has_fkt n_soll_em_has_fkt n_soll_vm_has_fkt st_ablauf_fkt status_ablauf_has_fkt z_ablauf_svh_reset_has_fkt z_k0_has_fkt z_m_max_iae_has_fkt z_m_soll_em_has_fkt z_n_soll_em_has_fkt z_n_soll_vm_has_fkt z_p_hys_k0_has_fkt m_soll_res_em_has_fkt z_saf_has_fkt z_k0_befuellopt_has_fkt nd_min_saf_has_fkt z_respschlepp_sas_fkt z_nvmsollbegr_frk_dihi z_statuspsysmps_frk_dihi z_nminemnull_frk_dihi z_emfehler_frk_dihi z_ablaufreinit_frk_dihi z_k0syncmk0erh_frk_dihi z_fuwdeakt_frk_dihi z_nemmin_frk_dihi z_vmstopverbot_frk_dihi z_vmstartverbot_frk_dihi z_zust_halten_frk_dihi z_zust_init_frk_dihi z_deaktiv_abo_frk_dihi z_vmstartanf_frk_dihi z_svh_frk_dihi z_iepein_frk_dihi z_nsollvmnull_frk_dihi z_ala_frk_dihi z_schaltprioverh_frk_dihi z_nsollvmanh_frk_dihi z_gebruefahrenaus_frk_dihi z_hybfkt_stg st_ziel_bz_has_stg st_ist_bz_has_stg st_ist_hcomd_has_stg z_ablauf_has_stg z_ablaufvariante_has_stg i_istgang_egs i_zielgang_egs m_wunsch_fpw_hst_fil mg_wunsch_fpw_in mg_wunsch_fpw_hst_in n_sec_iae nd_k0_in ndg_k0_in ng_vm_in status_schaltung_egs_in n_min_em_psys_lp3_has_sbe status_psys_has_sbe vg_f_sbe v_f_sbe status_sync_schaltung_sbe z_pvu_has_sbe z_freigabe_pvu_has_sbe t_betrieb_pvu_has_sbe mg_mot_in status_radschlupf_rse_has_sbe status_schaltart_svh_has_sbe m_motmax_has_sbe z_k0_has_sbe z_svh_has_sbe m_soll_res_em_has_sbe m_soll_res_em_bas_sbe z_modus_iae_has_sbe z_sas_has_sbe z_modus_iep_has_sbe z_msa_has_sbe status_efahren_has_sbe n_min_em_has_sbe z_msa_avh_moni_has_sbe z_msa_eaf_moni_has_sbe z_start_modus_has_sbe m_k0_mber_has_sbe z_lls_fktaktiv_has_sbe z_status_psys_mps_sbe m_k0_has_sbe m_soll_k0_has_sbe analyse_has_sbe z_nminemmodus_has_sbe st_soll_bz_has_hst z_init_sta st_soll_bz_hst_sta st_ist_bz_hst_sta bExceptionHybrid bErrorHybrid z_modus_em_hst_in c_getriebe_egs_in istgang_egs_in m_em_in m_iae_in m_k0_in m_max_dyn_em_in m_soll_em_hst_in m_soll_vm_hst_in m_vm_in m_vm_start_in m_wunsch_fpw_in n_ab_egs_in n_em_in n_soll_ll_vm_in n_t_egs_in n_vm_in osmode_next_in p_bremse_fzg_in sollgang_egs_in status_fehler_iep_in status_iae_in status_iep_in status_k0_in pos_egs_in z_ablauf_has_hst_in z_ablaufvariante_has_hst_in zielgang_egs_in z_k0_fst_in m_mot_in status_iae_adap_in z_diag_ersfkt_has_in z_diag_ersfkt_hi_has_in z_diag_notgang_has_in status_k0_adap_in status_waschstr_in status_kraftfluss_egs_in z_n_min_em_parksp_has_in n_mot_soll_iae_in status_alaengs_adaoff_in gangwechsel_egs_in z_nllsoll_iae_in status_nem_in status_nvm_in kolbenpos_k0_in z_kps_stada_in t_betrieb_pvu_has_ee_in status_ll_vm_in z_msa_fst_in m_min_dyn_em_in phi_neigung_in v_f_in drehrichtung_nem_in fpw_in drehrichtung_nab_in schalt_mode_egs_in m_ziel_k0_hst_in status_kraftfluss_lev2_egs_in i_gang_lev2_egs_in status_c_k0_in bremspedal_in status_autohold_in status_hillhold_in status_vf_in v_f_ref_in status_vfref_in z_diag_ersfkt_hi_96_has_in status_k0_adap_zaehler_in status_k0_befuellung_in z_oea_hst_in z_iep_in z_nllsoll_iep_in c_vm_in n_soll_em_hst_in abstellpos_vm_in abstellpos_vm_status_in status_nreg_em_hst_in m_min_vm_in m_soll_vm_l_hst_in z_msa_stada_in m_wunsch_fpw_hst_in status_getrbereit_in status_betriebsbereit_hst_in status_sa_vm_in z_ba_has_vm_hst_in z_ba_has_k0_hst_in status_abs_in status_asr_in modus_e_fahren_hst_in status_kl15_in status_posvueb_in soc_in status_soc_in c_umgebung_in status_cumgebung_in /end LOC_MEASUREMENT
 /begin SUB_FUNCTION SFOp_SLST9_St_Ablauf SFOp_SLST7_Output SFOp_SLST6_Input SFOp_SLST4_Conditions /end SUB_FUNCTION
/end FUNCTION
/begin FUNCTION Action_FOp_NOS ""
 /begin LOC_MEASUREMENT st_ablauf_fkt status_ablauf_has_fkt z_p_hys_k0_has_fkt z_zuendfreigabe_vm_fkt z_k0_has_fkt m_soll_k0_has_fkt m_k0_mod_has_fkt z_hybfkt_stg st_ziel_bz_has_stg st_ist_bz_has_stg st_ist_hcomd_has_stg z_ablauf_has_stg z_ablaufvariante_has_stg status_k0_in m_k0_in n_vm_in n_em_in z_modus_em_hst_in c_getriebe_egs_in istgang_egs_in m_em_in m_iae_in m_max_dyn_em_in m_soll_em_hst_in m_soll_vm_hst_in m_vm_in m_vm_start_in m_wunsch_fpw_in n_ab_egs_in n_soll_ll_vm_in n_t_egs_in osmode_next_in p_bremse_fzg_in sollgang_egs_in status_fehler_iep_in status_iae_in status_iep_in pos_egs_in z_ablauf_has_hst_in z_ablaufvariante_has_hst_in zielgang_egs_in z_k0_fst_in m_mot_in status_iae_adap_in z_diag_ersfkt_has_in z_diag_ersfkt_hi_has_in z_diag_notgang_has_in status_k0_adap_in status_waschstr_in status_kraftfluss_egs_in z_n_min_em_parksp_has_in n_mot_soll_iae_in status_alaengs_adaoff_in gangwechsel_egs_in z_nllsoll_iae_in status_nem_in status_nvm_in kolbenpos_k0_in z_kps_stada_in t_betrieb_pvu_has_ee_in status_ll_vm_in z_msa_fst_in m_min_dyn_em_in phi_neigung_in v_f_in drehrichtung_nem_in fpw_in drehrichtung_nab_in schalt_mode_egs_in m_ziel_k0_hst_in status_kraftfluss_lev2_egs_in i_gang_lev2_egs_in status_c_k0_in bremspedal_in status_autohold_in status_hillhold_in status_vf_in v_f_ref_in status_vfref_in z_diag_ersfkt_hi_96_has_in status_k0_adap_zaehler_in status_k0_befuellung_in z_oea_hst_in z_iep_in z_nllsoll_iep_in status_psys_has_sbe nd_k0_in i_istgang_egs i_zielgang_egs m_wunsch_fpw_hst_fil mg_wunsch_fpw_in mg_wunsch_fpw_hst_in n_sec_iae ndg_k0_in ng_vm_in status_schaltung_egs_in n_min_em_psys_lp3_has_sbe vg_f_sbe v_f_sbe status_sync_schaltung_sbe z_pvu_has_sbe z_freigabe_pvu_has_sbe t_betrieb_pvu_has_sbe mg_mot_in status_radschlupf_rse_has_sbe status_schaltart_svh_has_sbe c_vm_in n_soll_em_hst_in abstellpos_vm_in abstellpos_vm_status_in status_nreg_em_hst_in m_min_vm_in m_soll_vm_l_hst_in z_msa_stada_in m_wunsch_fpw_hst_in status_getrbereit_in /end LOC_MEASUREMENT
 /begin SUB_FUNCTION SFOp_NOS4_CalcFcn SFOp_NOS6_Input SFOp_NOS7_Output SFOp_NOS8_PhaseControl /end SUB_FUNCTION
/end FUNCTION
/begin FUNCTION Action_FOp_OAB ""
 /begin LOC_MEASUREMENT status_ablauf_has_fkt z_modus_em_hst_in c_getriebe_egs_in istgang_egs_in m_em_in m_iae_in m_k0_in m_max_dyn_em_in m_soll_em_hst_in m_soll_vm_hst_in m_vm_in m_vm_start_in m_wunsch_fpw_in n_ab_egs_in n_em_in n_soll_ll_vm_in n_t_egs_in n_vm_in osmode_next_in p_bremse_fzg_in sollgang_egs_in status_fehler_iep_in status_iae_in status_iep_in status_k0_in pos_egs_in z_ablauf_has_hst_in z_ablaufvariante_has_hst_in zielgang_egs_in z_k0_fst_in m_mot_in status_iae_adap_in z_diag_ersfkt_has_in z_diag_ersfkt_hi_has_in z_diag_notgang_has_in status_k0_adap_in status_waschstr_in status_kraftfluss_egs_in z_n_min_em_parksp_has_in n_mot_soll_iae_in status_alaengs_adaoff_in gangwechsel_egs_in z_nllsoll_iae_in status_nem_in status_nvm_in kolbenpos_k0_in z_kps_stada_in t_betrieb_pvu_has_ee_in status_ll_vm_in z_msa_fst_in m_min_dyn_em_in phi_neigung_in v_f_in drehrichtung_nem_in fpw_in drehrichtung_nab_in schalt_mode_egs_in m_ziel_k0_hst_in status_kraftfluss_lev2_egs_in i_gang_lev2_egs_in status_c_k0_in bremspedal_in status_autohold_in status_hillhold_in status_vf_in v_f_ref_in status_vfref_in z_diag_ersfkt_hi_96_has_in status_k0_adap_zaehler_in status_k0_befuellung_in z_oea_hst_in z_iep_in z_nllsoll_iep_in c_vm_in n_soll_em_hst_in abstellpos_vm_in abstellpos_vm_status_in status_nreg_em_hst_in m_min_vm_in m_soll_vm_l_hst_in z_msa_stada_in m_wunsch_fpw_hst_in status_getrbereit_in /end LOC_MEASUREMENT
 /begin SUB_FUNCTION SFOp_OhneAb3_CalcFcn SFOp_OhneAb6_Output SFOp_OhneAb5_Input /end SUB_FUNCTION
/end FUNCTION
/begin FUNCTION Action_FOp_PAS ""
 /begin LOC_MEASUREMENT m_soll_em_has_fkt n_soll_em_has_fkt m_max_em_has_fkt m_min_em_has_fkt z_m_soll_em_has_fkt z_n_soll_em_has_fkt n_soll_vm_has_fkt z_n_soll_vm_has_fkt z_zuendfreigabe_vm_has_fkt m_soll_k0_has_fkt mg_soll_k0_has_fkt z_k0_has_fkt z_p_hys_k0_has_fkt z_m_max_iae_has_fkt m_max_iae_has_fkt st_ablauf_fkt status_ablauf_has_fkt m_k0_mod_has_fkt z_ablauf_svh_reset_has_fkt z_fehler15_eh_fkt z_ponr_fkt z_emaktiv_fuw_zus_fkt m_soll_res_em_has_fkt nd_min_saf_has_fkt nd_soll_iae_fkt z_ablaufvariante_kalt_zus z_k0_befuellopt_has_fkt z_respschlepp_sas_fkt z_saf_has_fkt z_sbe_has_fkt z_zuendfreigabe_vm_fkt z_hybfkt_stg st_ziel_bz_has_stg st_ist_bz_has_stg st_ist_hcomd_has_stg z_ablauf_has_stg z_ablaufvariante_has_stg z_modus_em_hst_in c_getriebe_egs_in istgang_egs_in m_em_in m_iae_in m_k0_in m_max_dyn_em_in m_soll_em_hst_in m_soll_vm_hst_in m_vm_in m_vm_start_in m_wunsch_fpw_in n_ab_egs_in n_em_in n_soll_ll_vm_in n_t_egs_in n_vm_in osmode_next_in p_bremse_fzg_in sollgang_egs_in status_fehler_iep_in status_iae_in status_iep_in status_k0_in pos_egs_in z_ablauf_has_hst_in z_ablaufvariante_has_hst_in zielgang_egs_in z_k0_fst_in m_mot_in status_iae_adap_in z_diag_ersfkt_has_in z_diag_ersfkt_hi_has_in z_diag_notgang_has_in status_k0_adap_in status_waschstr_in status_kraftfluss_egs_in z_n_min_em_parksp_has_in n_mot_soll_iae_in status_alaengs_adaoff_in gangwechsel_egs_in z_nllsoll_iae_in status_nem_in status_nvm_in kolbenpos_k0_in z_kps_stada_in t_betrieb_pvu_has_ee_in status_ll_vm_in z_msa_fst_in m_min_dyn_em_in phi_neigung_in v_f_in drehrichtung_nem_in fpw_in drehrichtung_nab_in schalt_mode_egs_in m_ziel_k0_hst_in status_kraftfluss_lev2_egs_in i_gang_lev2_egs_in status_c_k0_in bremspedal_in status_autohold_in status_hillhold_in status_vf_in v_f_ref_in status_vfref_in z_diag_ersfkt_hi_96_has_in status_k0_adap_zaehler_in status_k0_befuellung_in z_oea_hst_in z_iep_in z_nllsoll_iep_in c_vm_in n_soll_em_hst_in abstellpos_vm_in abstellpos_vm_status_in status_nreg_em_hst_in m_min_vm_in m_soll_vm_l_hst_in z_msa_stada_in m_wunsch_fpw_hst_in status_getrbereit_in /end LOC_MEASUREMENT
 /begin SUB_FUNCTION SFOp_Passiv2_FOp_Passiv /end SUB_FUNCTION
/end FUNCTION
/begin FUNCTION Action_FOp_VMA ""
 /begin LOC_MEASUREMENT st_ablauf_fkt status_ablauf_has_fkt z_ablauf_svh_reset_has_fkt z_zuendfreigabe_vm_has_fkt z_k0_has_fkt m_soll_k0_has_fkt z_p_hys_k0_has_fkt m_k0_mod_has_fkt z_ablauf_has_hst_in n_vm_in m_k0_in z_modus_em_hst_in c_getriebe_egs_in istgang_egs_in m_em_in m_iae_in m_max_dyn_em_in m_soll_em_hst_in m_soll_vm_hst_in m_vm_in m_vm_start_in m_wunsch_fpw_in n_ab_egs_in n_em_in n_soll_ll_vm_in n_t_egs_in osmode_next_in p_bremse_fzg_in sollgang_egs_in status_fehler_iep_in status_iae_in status_iep_in status_k0_in pos_egs_in z_ablaufvariante_has_hst_in zielgang_egs_in z_k0_fst_in m_mot_in status_iae_adap_in z_diag_ersfkt_has_in z_diag_ersfkt_hi_has_in z_diag_notgang_has_in status_k0_adap_in status_waschstr_in status_kraftfluss_egs_in z_n_min_em_parksp_has_in n_mot_soll_iae_in status_alaengs_adaoff_in gangwechsel_egs_in z_nllsoll_iae_in status_nem_in status_nvm_in kolbenpos_k0_in z_kps_stada_in t_betrieb_pvu_has_ee_in status_ll_vm_in z_msa_fst_in m_min_dyn_em_in phi_neigung_in v_f_in drehrichtung_nem_in fpw_in drehrichtung_nab_in schalt_mode_egs_in m_ziel_k0_hst_in status_kraftfluss_lev2_egs_in i_gang_lev2_egs_in status_c_k0_in bremspedal_in status_autohold_in status_hillhold_in status_vf_in v_f_ref_in status_vfref_in z_diag_ersfkt_hi_96_has_in status_k0_adap_zaehler_in status_k0_befuellung_in z_oea_hst_in z_iep_in z_nllsoll_iep_in c_vm_in n_soll_em_hst_in abstellpos_vm_in abstellpos_vm_status_in status_nreg_em_hst_in m_min_vm_in m_soll_vm_l_hst_in z_msa_stada_in m_wunsch_fpw_hst_in status_getrbereit_in /end LOC_MEASUREMENT
 /begin SUB_FUNCTION SFOp_VMA2_FOp_VMaus /end SUB_FUNCTION
/end FUNCTION
/begin FUNCTION Action_FOp_VME ""
 /begin LOC_MEASUREMENT st_ablauf_fkt status_ablauf_has_fkt z_ablauf_svh_reset_has_fkt z_zuendfreigabe_vm_has_fkt z_k0_has_fkt m_soll_k0_has_fkt z_p_hys_k0_has_fkt m_k0_mod_has_fkt z_ablauf_has_hst_in n_vm_in m_k0_in z_modus_em_hst_in c_getriebe_egs_in istgang_egs_in m_em_in m_iae_in m_max_dyn_em_in m_soll_em_hst_in m_soll_vm_hst_in m_vm_in m_vm_start_in m_wunsch_fpw_in n_ab_egs_in n_em_in n_soll_ll_vm_in n_t_egs_in osmode_next_in p_bremse_fzg_in sollgang_egs_in status_fehler_iep_in status_iae_in status_iep_in status_k0_in pos_egs_in z_ablaufvariante_has_hst_in zielgang_egs_in z_k0_fst_in m_mot_in status_iae_adap_in z_diag_ersfkt_has_in z_diag_ersfkt_hi_has_in z_diag_notgang_has_in status_k0_adap_in status_waschstr_in status_kraftfluss_egs_in z_n_min_em_parksp_has_in n_mot_soll_iae_in status_alaengs_adaoff_in gangwechsel_egs_in z_nllsoll_iae_in status_nem_in status_nvm_in kolbenpos_k0_in z_kps_stada_in t_betrieb_pvu_has_ee_in status_ll_vm_in z_msa_fst_in m_min_dyn_em_in phi_neigung_in v_f_in drehrichtung_nem_in fpw_in drehrichtung_nab_in schalt_mode_egs_in m_ziel_k0_hst_in status_kraftfluss_lev2_egs_in i_gang_lev2_egs_in status_c_k0_in bremspedal_in status_autohold_in status_hillhold_in status_vf_in v_f_ref_in status_vfref_in z_diag_ersfkt_hi_96_has_in status_k0_adap_zaehler_in status_k0_befuellung_in z_oea_hst_in z_iep_in z_nllsoll_iep_in c_vm_in n_soll_em_hst_in abstellpos_vm_in abstellpos_vm_status_in status_nreg_em_hst_in m_min_vm_in m_soll_vm_l_hst_in z_msa_stada_in m_wunsch_fpw_hst_in status_getrbereit_in /end LOC_MEASUREMENT
 /begin SUB_FUNCTION SFOp_VME2_FOp_VMein /end SUB_FUNCTION
/end FUNCTION
/begin FUNCTION Action_FOp_ZUS ""
 /begin LOC_MEASUREMENT m_k0_mod_has_fkt m_soll_em_has_fkt m_soll_k0_has_fkt n_soll_em_has_fkt n_soll_vm_has_fkt st_ablauf_fkt status_ablauf_has_fkt z_k0_has_fkt z_m_soll_em_has_fkt z_n_soll_em_has_fkt z_n_soll_vm_has_fkt z_zuendfreigabe_vm_has_fkt z_p_hys_k0_has_fkt m_soll_res_em_has_fkt z_emaktiv_fuw_zus_fkt z_saf_has_fkt z_m_max_iae_has_fkt m_max_iae_has_fkt z_ablauf_svh_reset_has_fkt z_ablaufvariante_kalt_zus z_ponr_fkt m_max_em_has_fkt m_min_em_has_fkt mg_soll_k0_has_fkt nd_min_saf_has_fkt nd_soll_iae_fkt z_fehler15_eh_fkt z_k0_befuellopt_has_fkt z_respschlepp_sas_fkt z_sbe_has_fkt z_zuendfreigabe_vm_fkt z_nvmsollbegr_frk_dihi z_statuspsysmps_frk_dihi z_nminemnull_frk_dihi z_emfehler_frk_dihi z_ablaufreinit_frk_dihi z_k0syncmk0erh_frk_dihi z_fuwdeakt_frk_dihi z_nemmin_frk_dihi z_vmstopverbot_frk_dihi z_vmstartverbot_frk_dihi z_zust_halten_frk_dihi z_zust_init_frk_dihi z_deaktiv_abo_frk_dihi z_vmstartanf_frk_dihi z_svh_frk_dihi z_iepein_frk_dihi z_nsollvmnull_frk_dihi z_ala_frk_dihi z_schaltprioverh_frk_dihi z_nsollvmanh_frk_dihi z_gebruefahrenaus_frk_dihi z_hybfkt_stg st_ziel_bz_has_stg st_ist_bz_has_stg st_ist_hcomd_has_stg z_ablauf_has_stg z_ablaufvariante_has_stg c_getriebe_egs_in m_em_in m_k0_in m_max_dyn_em_in m_soll_vm_hst_in m_vm_in m_wunsch_fpw_in n_ab_egs_in n_em_in n_vm_in status_k0_in n_soll_ll_vm_in m_vm_start_in status_iae_in z_k0_fst_in istgang_egs_in status_kraftfluss_egs_in gangwechsel_egs_in sollgang_egs_in status_nem_in pos_egs_in z_ablauf_has_hst_in m_min_dyn_em_in m_ziel_k0_hst_in zielgang_egs_in kolbenpos_k0_in status_k0_befuellung_in z_modus_em_hst_in m_iae_in m_soll_em_hst_in n_t_egs_in osmode_next_in p_bremse_fzg_in status_fehler_iep_in status_iep_in z_ablaufvariante_has_hst_in m_mot_in status_iae_adap_in z_diag_ersfkt_has_in z_diag_ersfkt_hi_has_in z_diag_notgang_has_in status_k0_adap_in status_waschstr_in z_n_min_em_parksp_has_in n_mot_soll_iae_in status_alaengs_adaoff_in z_nllsoll_iae_in status_nvm_in z_kps_stada_in t_betrieb_pvu_has_ee_in status_ll_vm_in z_msa_fst_in phi_neigung_in v_f_in drehrichtung_nem_in fpw_in drehrichtung_nab_in schalt_mode_egs_in status_kraftfluss_lev2_egs_in i_gang_lev2_egs_in status_c_k0_in bremspedal_in status_autohold_in status_hillhold_in status_vf_in v_f_ref_in status_vfref_in z_diag_ersfkt_hi_96_has_in status_k0_adap_zaehler_in z_oea_hst_in z_iep_in z_nllsoll_iep_in m_soll_vm_l_hst_in status_nreg_em_hst_in m_min_vm_in m_wunsch_fpw_hst_in n_soll_em_hst_in abstellpos_vm_in c_vm_in abstellpos_vm_status_in z_msa_stada_in status_getrbereit_in status_betriebsbereit_hst_in status_sa_vm_in z_ba_has_vm_hst_in z_ba_has_k0_hst_in status_abs_in status_asr_in modus_e_fahren_hst_in status_kl15_in status_posvueb_in soc_in status_soc_in c_umgebung_in status_cumgebung_in nd_k0_in ndg_k0_in ng_vm_in status_schaltung_egs_in status_psys_has_sbe mg_wunsch_fpw_hst_in i_zielgang_egs status_schaltart_svh_has_sbe status_sync_schaltung_sbe z_pvu_has_sbe status_radschlupf_rse_has_sbe i_istgang_egs m_wunsch_fpw_hst_fil mg_wunsch_fpw_in n_sec_iae n_min_em_psys_lp3_has_sbe vg_f_sbe v_f_sbe z_freigabe_pvu_has_sbe t_betrieb_pvu_has_sbe mg_mot_in z_svh_has_sbe m_motmax_has_sbe z_k0_has_sbe m_soll_res_em_has_sbe m_soll_res_em_bas_sbe z_modus_iae_has_sbe z_sas_has_sbe z_modus_iep_has_sbe z_msa_has_sbe status_efahren_has_sbe n_min_em_has_sbe z_msa_avh_moni_has_sbe z_msa_eaf_moni_has_sbe z_start_modus_has_sbe m_k0_mber_has_sbe z_lls_fktaktiv_has_sbe z_status_psys_mps_sbe m_k0_has_sbe m_soll_k0_has_sbe analyse_has_sbe z_nminemmodus_has_sbe /end LOC_MEASUREMENT
 /begin SUB_FUNCTION SFOp_Zus2_FOp_ZUStart /end SUB_FUNCTION
/end FUNCTION
/begin FUNCTION Run_BSB_BypassSignalBerechnung ""
 /begin LOC_MEASUREMENT ANALYSE_HAS_BYP_VECTOR BYP_VNR_HAS_BYP_VECTOR IEP_SOLL_HAS_BYP_VECTOR MG_SOLL_K0_NEG_HAS_BYP_VECTOR MG_SOLL_K0_POS_HAS_BYP_VECTOR MO_MOD_EM_HST_HAS_BYP_VECTOR M_K0_HAS_BYP_VECTOR M_K0_MBER_HAS_BYP_VECTOR M_MAX_EM_HAS_BYP_VECTOR M_MAX_IAE_HAS_BYP_VECTOR M_MIN_EM_HAS_BYP_VECTOR M_MOTMAX_HAS_BYP_VECTOR M_SOLL_EM_HAS_BYP_VECTOR M_SOLL_K0_HAS_BYP_VECTOR M_SOLL_RES_EM_HAS_BYP_VECTOR ND_MIN_SAF_HAS_BYP_VECTOR N_MIN_EM_HAS_SBE_HAS_BYP_VECTOR N_SOLL_EM_HAS_BYP_VECTOR N_SOLL_VM_HAS_BYP_VECTOR PC_OK_HAS_BYP_VECTOR STATUS_ABLAUFAKTIV_HAS_BYP_VECTOR STATUS_ABLAUF_HAS_BYP_VECTOR STATUS_EFAHREN_HAS_BYP_VECTOR ST_IST_BZ_HAS_BYP_VECTOR ST_ZIEL_BZ_HAS_BYP_VECTOR T_BETRIEB_PVU_HAS_BYP_VECTOR Z_FEHLER15_DIHO_HAS_BYP_VECTOR Z_FREIGABE_PVU_HAS_BYP_VECTOR Z_GLSBE_HAS_BYP_VECTOR Z_K0OEFFNICHT_DIHO_HAS_BYP_VECTOR Z_K0_BEFUELLOPT_HAS_BYP_VECTOR Z_K0_HAS_BYP_VECTOR Z_KFC_C0NOCLOSEPB_HAS_BYP_VECTOR Z_KFC_C0NOCLOSE_EHO_DIHO_HAS_BYP_VECTOR Z_KFC_C0NOCLOSE_HAS_BYP_VECTOR Z_KFC_C0NOOPENPB_HAS_BYP_VECTOR Z_KFC_C0NOOPEN_EHO_DIHO_HAS_BYP_VECTOR Z_MODUS_IAE_HAS_BYP_VECTOR Z_MSA_HAS_BYP_VECTOR Z_M_MAX_IAE_HAS_BYP_VECTOR Z_M_SOLL_EM_HAS_BYP_VECTOR Z_NDK0ZUGROSS_AUW_DIHO_HAS_BYP_VECTOR Z_NEMABLWE_AUW_DIHO_HAS_BYP_VECTOR Z_NEMASYNSCL_AUW_DIHO_HAS_BYP_VECTOR Z_NEMRDE_DIHO_HAS_BYP_VECTOR Z_NEMZUKLEIN_AUW_DIHO_HAS_BYP_VECTOR Z_NLLSOLL_MODUS_HAS_BYP_VECTOR Z_NVMZUKLEIN_AUW_DIHO_HAS_BYP_VECTOR Z_N_SOLL_EM_HAS_BYP_VECTOR Z_N_SOLL_VM_HAS_BYP_VECTOR Z_OELVERSFEHLER_DIHO_HAS_BYP_VECTOR Z_P_HYS_K0_HAS_BYP_VECTOR Z_SAF_HAS_BYP_VECTOR Z_SAS_HAS_BYP_VECTOR Z_SBE_HAS_BYP_VECTOR Z_START_MODUS_HAS_BYP_VECTOR Z_STATUSNEMABLWE_AUW_DIHO_HAS_BYP_VECTOR Z_STATUSNEMASYNSCL_AUW_DIHO_HAS_BYP_VECTOR Z_STATUSNEM_AUW_DIHO_HAS_BYP_VECTOR Z_STATUS_PSYS_MPS_HAS_BYP_VECTOR Z_SVH_HAS_BYP_VECTOR Z_VMAUS_AUW_DIHO_HAS_BYP_VECTOR byp_vnr_has_byp pc_ok_has_byp status_ablauf_has_byp m_k0_has_byp n_soll_em_has_byp n_soll_vm_has_byp z_k0_has_byp m_soll_k0_has_byp z_n_soll_vm_has_byp z_n_soll_em_has_byp status_efahren_has_byp m_soll_res_em_has_byp m_soll_em_has_byp m_max_iae_has_byp z_sbe_has_byp z_modus_iae_has_byp z_m_max_iae_has_byp m_max_em_has_byp m_min_em_has_byp mo_mod_em_hst_has_byp n_min_em_has_sbe_has_byp z_m_soll_em_has_byp iep_soll_has_byp mg_soll_k0_neg_has_byp mg_soll_k0_pos_has_byp z_msa_has_byp bypass_has_aktiv z_p_hys_k0_has_byp z_saf_has_byp z_sas_has_byp nd_min_saf_has_byp z_glsbe_has_byp z_svh_has_byp m_motmax_has_byp status_ablaufaktiv_has_byp st_ist_bz_has_byp st_ziel_bz_has_byp analyse_has_byp z_k0_befuellopt_has_byp z_status_psys_mps_has_byp z_start_modus_has_byp m_k0_mber_has_byp z_fehler15_diho_has_byp z_k0oeffnicht_diho_has_byp z_kfc_c0noclose_has_byp z_oelversfehler_diho_has_byp z_vmaus_auw_diho_has_byp z_nemzuklein_auw_diho_has_byp z_ndk0zugross_auw_diho_has_byp z_kfc_c0noclosepb_has_byp z_kfc_c0noopenpb_has_byp z_nemrde_diho_has_byp z_nemablwe_auw_diho_has_byp z_statusnem_auw_diho_has_byp z_nemasynscl_auw_diho_has_byp z_statusnemasynscl_auw_diho_has_byp z_statusnemablwe_auw_diho_has_byp z_freigabe_pvu_has_byp t_betrieb_pvu_has_byp z_nllsoll_modus_has_byp z_kfc_c0noopen_eho_diho_has_byp z_kfc_c0noclose_eho_diho_has_byp z_nvmzuklein_auw_diho_has_byp z_modus_em_hst_in c_getriebe_egs_in istgang_egs_in m_em_in m_iae_in m_k0_in m_max_dyn_em_in m_soll_em_hst_in m_soll_vm_hst_in m_vm_in m_vm_start_in m_wunsch_fpw_in n_ab_egs_in n_em_in n_soll_ll_vm_in n_t_egs_in n_vm_in osmode_next_in p_bremse_fzg_in sollgang_egs_in status_fehler_iep_in status_iae_in status_iep_in status_k0_in pos_egs_in z_ablauf_has_hst_in z_ablaufvariante_has_hst_in zielgang_egs_in z_k0_fst_in m_mot_in status_iae_adap_in z_diag_ersfkt_has_in z_diag_ersfkt_hi_has_in z_diag_notgang_has_in status_k0_adap_in status_waschstr_in status_kraftfluss_egs_in z_n_min_em_parksp_has_in n_mot_soll_iae_in status_alaengs_adaoff_in gangwechsel_egs_in z_nllsoll_iae_in status_nem_in status_nvm_in kolbenpos_k0_in z_kps_stada_in t_betrieb_pvu_has_ee_in status_ll_vm_in z_msa_fst_in m_min_dyn_em_in phi_neigung_in v_f_in drehrichtung_nem_in fpw_in drehrichtung_nab_in schalt_mode_egs_in m_ziel_k0_hst_in status_kraftfluss_lev2_egs_in i_gang_lev2_egs_in status_c_k0_in bremspedal_in status_autohold_in status_hillhold_in status_vf_in v_f_ref_in status_vfref_in z_diag_ersfkt_hi_96_has_in status_k0_adap_zaehler_in status_k0_befuellung_in z_oea_hst_in z_iep_in z_nllsoll_iep_in c_vm_in n_soll_em_hst_in abstellpos_vm_in abstellpos_vm_status_in status_nreg_em_hst_in m_min_vm_in m_soll_vm_l_hst_in z_msa_stada_in m_wunsch_fpw_hst_in status_getrbereit_in /end LOC_MEASUREMENT
/end FUNCTION
/begin FUNCTION Run_DIAGi_Diagnose_in ""
 /begin DEF_CHARACTERISTIC BM_ERSFKT_DEAKTIV_ABO_FRK_HAS BM_ERSFKT_HI_96_DEAKTIV_ABO_FRK_HAS BM_ERSFKT_HI_DEAKTIV_ABO_FRK_HAS SWI_ZGEBRUEFAHRENAUS_FRK_DIHI BM_ERSFKT_HI_96_ZUST_INIT_FRK_HAS BM_ERSFKT_HI_ZUST_INIT_FRK_HAS BM_ERSFKT_ZUST_INIT_FRK_HAS SWI_ZIEPEIN_FRK_DIHI SWI_ZSVHAKTIV_FRK_DIHI SWI_NSOLLVMNULLAKTIV_FRK_HAS SWI_STATUSNEMERSATZLLS_FRK_DIHI BM_ERSFKT_HI_96_VMSTARTVERBOT_FRK_HAS BM_ERSFKT_HI_VMSTARTVERBOT_FRK_HAS BM_ERSFKT_VMSTARTVERBOT_FRK_HAS SWI_VMSTARTANF_IN_SCHALTUNG_FRK_HAS TAB_ZDIAGNOTGANGFUW_FRK_HAS TAB_ZDIAGNOTGANGLLS_FRK_HAS /end DEF_CHARACTERISTIC
 /begin LOC_MEASUREMENT z_captargetnvm_ehi_has z_hss1off_ehi_has z_hascycreinit_ehi_has z_hasforcesync0_ehi_has z_idlenem_ehi_has z_noenginestop_ehi_has z_hasstatefix_ehi_has z_enginestart_ehi_has z_reqk0asynscl_ehi_has z_gbxready_ehi_has z_enpg1fix_ehi_has z_enpg3fix_ehi_has z_enpg1_ehi_has z_enpg2_ehi_has z_enpg3_ehi_has z_enpg4_ehi_has z_enpg5_ehi_has z_enpg6_ehi_has z_enpg7_ehi_has z_enpg8_ehi_has z_inctargetnvm_ehi_has z_noilaunch_ehi_has z_mechnotlauf_ehi_has z_nvmsollbegr_frk_dihi z_statuspsysmps_frk_dihi z_nminemnull_frk_dihi z_emfehler_frk_dihi z_ablaufreinit_frk_dihi z_k0syncmk0erh_frk_dihi z_fuwdeakt_frk_dihi z_nemmin_frk_dihi z_vmstopverbot_frk_dihi z_vmstartverbot_frk_dihi z_zust_halten_frk_dihi z_zust_init_frk_dihi z_deaktiv_abo_frk_dihi z_vmstartanf_frk_dihi z_svh_frk_dihi z_iepein_frk_dihi z_nsollvmnull_frk_dihi z_ala_frk_dihi z_schaltprioverh_frk_dihi z_nsollvmanh_frk_dihi z_gebruefahrenaus_frk_dihi z_modus_em_hst_in c_getriebe_egs_in istgang_egs_in m_em_in m_iae_in m_k0_in m_max_dyn_em_in m_soll_em_hst_in m_soll_vm_hst_in m_vm_in m_vm_start_in m_wunsch_fpw_in n_ab_egs_in n_em_in n_soll_ll_vm_in n_t_egs_in n_vm_in osmode_next_in p_bremse_fzg_in sollgang_egs_in status_fehler_iep_in status_iae_in status_iep_in status_k0_in pos_egs_in z_ablauf_has_hst_in z_ablaufvariante_has_hst_in zielgang_egs_in z_k0_fst_in m_mot_in status_iae_adap_in z_diag_ersfkt_has_in z_diag_ersfkt_hi_has_in z_diag_notgang_has_in status_k0_adap_in status_waschstr_in status_kraftfluss_egs_in z_n_min_em_parksp_has_in n_mot_soll_iae_in status_alaengs_adaoff_in gangwechsel_egs_in z_nllsoll_iae_in status_nem_in status_nvm_in kolbenpos_k0_in z_kps_stada_in t_betrieb_pvu_has_ee_in status_ll_vm_in z_msa_fst_in m_min_dyn_em_in phi_neigung_in v_f_in drehrichtung_nem_in fpw_in drehrichtung_nab_in schalt_mode_egs_in m_ziel_k0_hst_in status_kraftfluss_lev2_egs_in i_gang_lev2_egs_in status_c_k0_in bremspedal_in status_autohold_in status_hillhold_in status_vf_in v_f_ref_in status_vfref_in z_diag_ersfkt_hi_96_has_in status_k0_adap_zaehler_in status_k0_befuellung_in z_oea_hst_in z_iep_in z_nllsoll_iep_in c_vm_in n_soll_em_hst_in abstellpos_vm_in abstellpos_vm_status_in status_nreg_em_hst_in m_min_vm_in m_soll_vm_l_hst_in z_msa_stada_in m_wunsch_fpw_hst_in status_getrbereit_in /end LOC_MEASUREMENT
 /begin SUB_FUNCTION SDIAGi52_IfActionSubsystem2 SDIAGi32_IfActionSubsystem2 SDIAGi41_Bitwise_AND_ui32 SDIAGi43_Bitwise_AND_ui32 SDIAGi56_Bitwise_AND_ui32 SDIAGi40_Bitwise_AND_ui16_1 SDIAGi44_Bitwise_AND_ui32_1 SDIAGi57_Bitwise_AND_ui32_1 SDIAGi42_Bitwise_AND_ui32_2 SDIAGi45_Bitwise_AND_ui32_2 SDIAGi58_Bitwise_AND_ui32_2 /end SUB_FUNCTION
/end FUNCTION
/begin FUNCTION Run_DIAGo_Diagnose_out ""
 /begin DEF_CHARACTERISTIC KL_TVNVMZUKLEIN_FILT_AUW_DIHO_Y KL_TVNVMZUKLEIN_FILT_AUW_DIHO_X KL_NSEMASYNSCL_ERK_AUW_HAS_Y KL_NSEMASYNSCL_ERK_AUW_HAS_X KL_NSEMZUKLEIN_ERK_AUW_HAS_Y KL_NSEMZUKLEIN_ERK_AUW_HAS_X KL_NDSK0ZUGROSSDDA_ERK_AUW_HAS_Y KL_NDSK0ZUGROSSDDA_ERK_AUW_HAS_X KL_NDSK0ZUGROSS_ERK_AUW_HAS_Y KL_NDSK0ZUGROSS_ERK_AUW_HAS_X KL_MK0SCHLNICHTMVM_DIHO_Y KL_MK0SCHLNICHTMVM_DIHO_X Z_KFCC0NOCLOSEMAX_EHO_DIHO NS_EMK0SCHLNICHT_DIHO NS_VMK0SCHLNICHT_DIHO SWI_Z_K0SCHLNICHT_ERSATZ_HAS T_VK0SCHLNICHT_ERK_DIHO Z_K0SCHLNICHT_ERSATZ_HAS T_VK0SCHLNICHT_ERK_AUW_HAS T_VK0SCHLNICHT_FILT_AUW_HAS MS_K0NDSK0ZUGROSS_ERK_AUW_HAS T_VK0NDK0ZUGROSS_FILT_AUW_HAS T_VNDK0ZUGROSSDDA_FILT_AUW_HAS T_VNDK0ZUGROSS_FILT_AUW_HAS T_VNEMZUKLEIN_FILT_AUW_HAS NS_EMABLWE_ERK_AUW_HAS T_VNEMABLWE_FILT_AUW_HAS NS_EMKALTNEMASYNSCL_ERK_AUW_HAS SWI_ZNEMASYNSCLAKTIV_DIHO T_VNEMASYNSCL_FILT_AUW_HAS NDS_SOLLVMNVMNVMZUKLEIN_AUW_DIHO NDS_VMNEMNVMZUKLEIN_AUW_DIHO T_VSTATUSNEM_FILT_AUW_HAS SWI_ZSTATUSNEMABLWEAKTIV_DIHO T_VSTATUSNEMABLWE_FILT_AUW_HAS SWI_ZSTATUSNEMASYNSCLAKTIV_DIHO T_VSTATUSNEMASYNSCL_FILT_AUW_HAS NS_VMAUS_ERK_AUW_HAS T_VVMAUS_FILT_AUW_HAS SWI_Z_K0NDK0ZUGROSSPB_ERSATZ_HAS Z_K0NDK0ZUGROSSPB_ERSATZ_HAS SWI_Z_K0SCHLNICHTPB_ERSATZ_HAS Z_K0SCHLNICHTPB_ERSATZ_HAS SWI_Z_K0SCHLNICHTPBZUS_ERSATZ_HAS Z_K0SCHLNICHTPBZUS_ERSATZ_HAS NS_EM_MINRDE_HAS PHIS_EMMAXRDE_HAS SWI_Z_NEMRDE_ERSATZ_HAS Z_NEMRDE_ERSATZ_HAS SWI_Z_FEHLER15_ERSATZ_HAS Z_FEHLER15_ERSATZ_HAS T_VK0OEFFNICHT_ERK_DIHO MS_K0OEFFNICHT_DIHO MS_VMK0OEFFNICHT_DIHO NDS_K0K0OEFFNICHT_DIHO NGS_VMK0OEFFNICHT_DIHO NO_EMK0OEFFNICHT_DIHO NS_VMK0OEFFNICHT_DIHO SWI_Z_K0OEFFNICHTPB_ERSATZ_HAS Z_K0OEFFNICHTPB_ERSATZ_HAS Z_KFCC0NOOPENMAX_EHO_DIHO T_VOELVERSFEHLER_FILT_HAS T_VOELVERSFEHLERKALT_FILT_HAS /end DEF_CHARACTERISTIC
 /begin LOC_MEASUREMENT cnt_kfc_c0noclose_eho_diho z_kfc_c0noclose_eho_diho z_kfc_c0noclose_has t_k0schlnicht_ans_filt_auw_has t_k0schlnicht_zus_erk_auw_has t_k0schlnicht_zus_filt_auw_has t_k0_ndk0zugross_filt_auw_has t_ndk0zugross_filt_auw_has t_nemzuklein_filt_auw_has t_nemablwe_filt_auw_has t_nemasynscl_filt_auw_has t_nvmzuklein_filt_auw_has t_statusnem_filt_auw_has t_statusnemablwe_filt_auw_has t_statusnemasynscl_filt_auw_has t_vmaus_filt_auw_has z_k0_ndk0zugross_auw_diho z_k0_ndk0zugross_erk_auw_has z_k0schlnicht_ans_auw_diho z_k0schlnicht_ans_erk_auw_has z_k0schlnicht_zus_auw_diho z_k0schlnicht_zus_erk_auw_has z_ndk0zugross_auw_diho z_ndk0zugross_erk_auw_has z_nemablwe_auw_diho z_nemablwe_erk_auw_has z_nemasynscl_auw_diho z_nemasynscl_erk_auw_has z_nemzuklein_auw_diho z_nemzuklein_erk_auw_has z_nvmzuklein_auw_diho z_nvmzuklein_erk_auw_has z_statusnem_auw_diho z_statusnem_erk_auw_has z_statusnemablwe_auw_diho z_statusnemablwe_erk_auw_has z_statusnemasynscl_auw_diho z_statusnemasynscl_erk_auw_has z_vmaus_auw_diho z_vmaus_erk_auw_has z_k0_ndk0zugrosspb_auw_diho z_k0schlnichtpb_ans_auw_diho z_k0schlnichtpb_zus_auw_diho z_kfc_c0noclosepb_has z_k0schlnicht_ans_aktiv_auw_has z_k0schlnicht_zus_aktiv_auw_has z_ndk0_aktiv_auw_has z_nem_aktiv_auw_has z_nemablwe_aktiv_auw_has z_nemasynscl_aktiv_auw_has z_nvm_aktiv_auw_has z_statusnem_aktiv_auw_has z_statusnemablwe_aktiv_auw_has z_statusnemasynscl_aktiv_auw_has z_vmaus_aktiv_auw_has status_fehlererk_diho phi_em_rde_has z_nemrde_diho z_nemrdefehler_has z_nemrdeinit_has z_fehler15_diho t_k0oeffnicht_has z_k0oeffnicht_diho z_k0oeffnichtfehler_has z_k0oeffnichtpb_diho z_kfc_c0noopenpb_has cnt_kfc_c0noopen_eho_diho z_kfc_c0noopen_eho_diho t_oelversfehler_filt_has z_oelversfehler_erk_has t_oelversfehlerkalt_filt_has z_oelversfehlerkalt_erk_has z_oelversfehler_diho byp_vnr_has_byp pc_ok_has_byp status_ablauf_has_byp m_k0_has_byp n_soll_em_has_byp n_soll_vm_has_byp z_k0_has_byp m_soll_k0_has_byp z_n_soll_vm_has_byp z_n_soll_em_has_byp status_efahren_has_byp m_soll_res_em_has_byp m_soll_em_has_byp m_max_iae_has_byp z_sbe_has_byp z_modus_iae_has_byp z_m_max_iae_has_byp m_max_em_has_byp m_min_em_has_byp mo_mod_em_hst_has_byp n_min_em_has_sbe_has_byp z_m_soll_em_has_byp iep_soll_has_byp mg_soll_k0_neg_has_byp mg_soll_k0_pos_has_byp z_msa_has_byp bypass_has_aktiv z_p_hys_k0_has_byp z_saf_has_byp z_sas_has_byp nd_min_saf_has_byp z_glsbe_has_byp z_svh_has_byp m_motmax_has_byp status_ablaufaktiv_has_byp st_ist_bz_has_byp st_ziel_bz_has_byp analyse_has_byp z_k0_befuellopt_has_byp z_status_psys_mps_has_byp z_start_modus_has_byp m_k0_mber_has_byp z_fehler15_diho_has_byp z_k0oeffnicht_diho_has_byp z_kfc_c0noclose_has_byp z_oelversfehler_diho_has_byp z_vmaus_auw_diho_has_byp z_nemzuklein_auw_diho_has_byp z_ndk0zugross_auw_diho_has_byp z_kfc_c0noclosepb_has_byp z_kfc_c0noopenpb_has_byp z_nemrde_diho_has_byp z_nemablwe_auw_diho_has_byp z_statusnem_auw_diho_has_byp z_nemasynscl_auw_diho_has_byp z_statusnemasynscl_auw_diho_has_byp z_statusnemablwe_auw_diho_has_byp z_freigabe_pvu_has_byp t_betrieb_pvu_has_byp z_nllsoll_modus_has_byp z_kfc_c0noopen_eho_diho_has_byp z_kfc_c0noclose_eho_diho_has_byp z_nvmzuklein_auw_diho_has_byp z_nvmsollbegr_frk_dihi z_statuspsysmps_frk_dihi z_nminemnull_frk_dihi z_emfehler_frk_dihi z_ablaufreinit_frk_dihi z_k0syncmk0erh_frk_dihi z_fuwdeakt_frk_dihi z_nemmin_frk_dihi z_vmstopverbot_frk_dihi z_vmstartverbot_frk_dihi z_zust_halten_frk_dihi z_zust_init_frk_dihi z_deaktiv_abo_frk_dihi z_vmstartanf_frk_dihi z_svh_frk_dihi z_iepein_frk_dihi z_nsollvmnull_frk_dihi z_ala_frk_dihi z_schaltprioverh_frk_dihi z_nsollvmanh_frk_dihi z_gebruefahrenaus_frk_dihi z_hybfkt_stg st_ziel_bz_has_stg st_ist_bz_has_stg st_ist_hcomd_has_stg z_ablauf_has_stg z_ablaufvariante_has_stg m_k0_mod_has_fkt m_max_em_has_fkt m_max_iae_has_fkt m_min_em_has_fkt m_soll_em_has_fkt m_soll_k0_has_fkt m_soll_res_em_has_fkt mg_soll_k0_has_fkt n_soll_em_has_fkt n_soll_vm_has_fkt nd_min_saf_has_fkt nd_soll_iae_fkt st_ablauf_fkt status_ablauf_has_fkt z_ablauf_svh_reset_has_fkt z_ablaufvariante_kalt_zus z_emaktiv_fuw_zus_fkt z_fehler15_eh_fkt z_k0_befuellopt_has_fkt z_k0_has_fkt z_m_max_iae_has_fkt z_m_soll_em_has_fkt z_n_soll_em_has_fkt z_n_soll_vm_has_fkt z_p_hys_k0_has_fkt z_ponr_fkt z_respschlepp_sas_fkt z_saf_has_fkt z_sbe_has_fkt z_zuendfreigabe_vm_fkt z_zuendfreigabe_vm_has_fkt i_istgang_egs i_zielgang_egs m_wunsch_fpw_hst_fil mg_wunsch_fpw_in mg_wunsch_fpw_hst_in n_sec_iae nd_k0_in ndg_k0_in ng_vm_in status_schaltung_egs_in n_min_em_psys_lp3_has_sbe status_psys_has_sbe vg_f_sbe v_f_sbe status_sync_schaltung_sbe z_pvu_has_sbe z_freigabe_pvu_has_sbe t_betrieb_pvu_has_sbe mg_mot_in status_radschlupf_rse_has_sbe status_schaltart_svh_has_sbe m_motmax_has_sbe z_k0_has_sbe z_svh_has_sbe m_soll_res_em_has_sbe m_soll_res_em_bas_sbe z_modus_iae_has_sbe z_sas_has_sbe z_modus_iep_has_sbe z_msa_has_sbe status_efahren_has_sbe n_min_em_has_sbe z_msa_avh_moni_has_sbe z_msa_eaf_moni_has_sbe z_start_modus_has_sbe m_k0_mber_has_sbe z_lls_fktaktiv_has_sbe z_status_psys_mps_sbe m_k0_has_sbe m_soll_k0_has_sbe analyse_has_sbe z_nminemmodus_has_sbe z_modus_em_hst_in c_getriebe_egs_in istgang_egs_in m_em_in m_iae_in m_k0_in m_max_dyn_em_in m_soll_em_hst_in m_soll_vm_hst_in m_vm_in m_vm_start_in m_wunsch_fpw_in n_ab_egs_in n_em_in n_soll_ll_vm_in n_t_egs_in n_vm_in osmode_next_in p_bremse_fzg_in sollgang_egs_in status_fehler_iep_in status_iae_in status_iep_in status_k0_in pos_egs_in z_ablauf_has_hst_in z_ablaufvariante_has_hst_in zielgang_egs_in z_k0_fst_in m_mot_in status_iae_adap_in z_diag_ersfkt_has_in z_diag_ersfkt_hi_has_in z_diag_notgang_has_in status_k0_adap_in status_waschstr_in status_kraftfluss_egs_in z_n_min_em_parksp_has_in n_mot_soll_iae_in status_alaengs_adaoff_in gangwechsel_egs_in z_nllsoll_iae_in status_nem_in status_nvm_in kolbenpos_k0_in z_kps_stada_in t_betrieb_pvu_has_ee_in status_ll_vm_in z_msa_fst_in m_min_dyn_em_in phi_neigung_in v_f_in drehrichtung_nem_in fpw_in drehrichtung_nab_in schalt_mode_egs_in m_ziel_k0_hst_in status_kraftfluss_lev2_egs_in i_gang_lev2_egs_in status_c_k0_in bremspedal_in status_autohold_in status_hillhold_in status_vf_in v_f_ref_in status_vfref_in z_diag_ersfkt_hi_96_has_in status_k0_adap_zaehler_in status_k0_befuellung_in z_oea_hst_in z_iep_in z_nllsoll_iep_in c_vm_in n_soll_em_hst_in abstellpos_vm_in abstellpos_vm_status_in status_nreg_em_hst_in m_min_vm_in m_soll_vm_l_hst_in z_msa_stada_in m_wunsch_fpw_hst_in status_getrbereit_in status_betriebsbereit_hst_in status_sa_vm_in z_ba_has_vm_hst_in z_ba_has_k0_hst_in status_abs_in status_asr_in modus_e_fahren_hst_in status_kl15_in status_posvueb_in soc_in status_soc_in c_umgebung_in status_cumgebung_in /end LOC_MEASUREMENT
 /begin SUB_FUNCTION SDIAGo106_Fehler_liegt_nicht_vor_Kaltstart SDIAGo93_Encoder_ui32 SDIAGo89_VM_Schleppstart SDIAGo90_VM_Zustart Run_SDIAGo52_abs_fl32 Run_SDIAGo101_abs_fl32 SDIAGo105_Fehler_liegt_nicht_vor /end SUB_FUNCTION
/end FUNCTION
/begin FUNCTION Run_FHC_HybridControl ""
 /begin LOC_MEASUREMENT z_hybfkt_stg st_ziel_bz_has_stg st_ist_bz_has_stg st_ist_hcomd_has_stg z_ablauf_has_stg z_ablaufvariante_has_stg m_k0_mod_has_fkt m_max_em_has_fkt m_max_iae_has_fkt m_min_em_has_fkt m_soll_em_has_fkt m_soll_k0_has_fkt m_soll_res_em_has_fkt mg_soll_k0_has_fkt n_soll_em_has_fkt n_soll_vm_has_fkt nd_min_saf_has_fkt nd_soll_iae_fkt st_ablauf_fkt status_ablauf_has_fkt z_ablauf_svh_reset_has_fkt z_ablaufvariante_kalt_zus z_emaktiv_fuw_zus_fkt z_fehler15_eh_fkt z_k0_befuellopt_has_fkt z_k0_has_fkt z_m_max_iae_has_fkt z_m_soll_em_has_fkt z_n_soll_em_has_fkt z_n_soll_vm_has_fkt z_p_hys_k0_has_fkt z_ponr_fkt z_respschlepp_sas_fkt z_saf_has_fkt z_sbe_has_fkt z_zuendfreigabe_vm_fkt z_zuendfreigabe_vm_has_fkt st_soll_bz_has_hst z_init_sta st_soll_bz_hst_sta st_ist_bz_hst_sta bExceptionHybrid bErrorHybrid z_modus_em_hst_in c_getriebe_egs_in istgang_egs_in m_em_in m_iae_in m_k0_in m_max_dyn_em_in m_soll_em_hst_in m_soll_vm_hst_in m_vm_in m_vm_start_in m_wunsch_fpw_in n_ab_egs_in n_em_in n_soll_ll_vm_in n_t_egs_in n_vm_in osmode_next_in p_bremse_fzg_in sollgang_egs_in status_fehler_iep_in status_iae_in status_iep_in status_k0_in pos_egs_in z_ablauf_has_hst_in z_ablaufvariante_has_hst_in zielgang_egs_in z_k0_fst_in m_mot_in status_iae_adap_in z_diag_ersfkt_has_in z_diag_ersfkt_hi_has_in z_diag_notgang_has_in status_k0_adap_in status_waschstr_in status_kraftfluss_egs_in z_n_min_em_parksp_has_in n_mot_soll_iae_in status_alaengs_adaoff_in gangwechsel_egs_in z_nllsoll_iae_in status_nem_in status_nvm_in kolbenpos_k0_in z_kps_stada_in t_betrieb_pvu_has_ee_in status_ll_vm_in z_msa_fst_in m_min_dyn_em_in phi_neigung_in v_f_in drehrichtung_nem_in fpw_in drehrichtung_nab_in schalt_mode_egs_in m_ziel_k0_hst_in status_kraftfluss_lev2_egs_in i_gang_lev2_egs_in status_c_k0_in bremspedal_in status_autohold_in status_hillhold_in status_vf_in v_f_ref_in status_vfref_in z_diag_ersfkt_hi_96_has_in status_k0_adap_zaehler_in status_k0_befuellung_in z_oea_hst_in z_iep_in z_nllsoll_iep_in c_vm_in n_soll_em_hst_in abstellpos_vm_in abstellpos_vm_status_in status_nreg_em_hst_in m_min_vm_in m_soll_vm_l_hst_in z_msa_stada_in m_wunsch_fpw_hst_in status_getrbereit_in status_betriebsbereit_hst_in status_sa_vm_in z_ba_has_vm_hst_in z_ba_has_k0_hst_in status_abs_in status_asr_in modus_e_fahren_hst_in status_kl15_in status_posvueb_in soc_in status_soc_in c_umgebung_in status_cumgebung_in /end LOC_MEASUREMENT
 /begin SUB_FUNCTION SFHC6_HCSiProc_Signalprocessing_fcn SFHC5_HCOMD_OpreatingModeDetermination_fcn SFHC7_HCSoProc_Signalprocessing_fcn /end SUB_FUNCTION
/end FUNCTION
/begin FUNCTION Run_FOp_OperativeFunktionen ""
 /begin LOC_MEASUREMENT z_nvmsollbegr_frk_dihi z_statuspsysmps_frk_dihi z_nminemnull_frk_dihi z_emfehler_frk_dihi z_ablaufreinit_frk_dihi z_k0syncmk0erh_frk_dihi z_fuwdeakt_frk_dihi z_nemmin_frk_dihi z_vmstopverbot_frk_dihi z_vmstartverbot_frk_dihi z_zust_halten_frk_dihi z_zust_init_frk_dihi z_deaktiv_abo_frk_dihi z_vmstartanf_frk_dihi z_svh_frk_dihi z_iepein_frk_dihi z_nsollvmnull_frk_dihi z_ala_frk_dihi z_schaltprioverh_frk_dihi z_nsollvmanh_frk_dihi z_gebruefahrenaus_frk_dihi z_hybfkt_stg st_ziel_bz_has_stg st_ist_bz_has_stg st_ist_hcomd_has_stg z_ablauf_has_stg z_ablaufvariante_has_stg m_k0_mod_has_fkt m_max_em_has_fkt m_max_iae_has_fkt m_min_em_has_fkt m_soll_em_has_fkt m_soll_k0_has_fkt m_soll_res_em_has_fkt mg_soll_k0_has_fkt n_soll_em_has_fkt n_soll_vm_has_fkt nd_min_saf_has_fkt nd_soll_iae_fkt st_ablauf_fkt status_ablauf_has_fkt z_ablauf_svh_reset_has_fkt z_ablaufvariante_kalt_zus z_emaktiv_fuw_zus_fkt z_fehler15_eh_fkt z_k0_befuellopt_has_fkt z_k0_has_fkt z_m_max_iae_has_fkt z_m_soll_em_has_fkt z_n_soll_em_has_fkt z_n_soll_vm_has_fkt z_p_hys_k0_has_fkt z_ponr_fkt z_respschlepp_sas_fkt z_saf_has_fkt z_sbe_has_fkt z_zuendfreigabe_vm_fkt z_zuendfreigabe_vm_has_fkt i_istgang_egs i_zielgang_egs m_wunsch_fpw_hst_fil mg_wunsch_fpw_in mg_wunsch_fpw_hst_in n_sec_iae nd_k0_in ndg_k0_in ng_vm_in status_schaltung_egs_in n_min_em_psys_lp3_has_sbe status_psys_has_sbe vg_f_sbe v_f_sbe status_sync_schaltung_sbe z_pvu_has_sbe z_freigabe_pvu_has_sbe t_betrieb_pvu_has_sbe mg_mot_in status_radschlupf_rse_has_sbe status_schaltart_svh_has_sbe m_motmax_has_sbe z_k0_has_sbe z_svh_has_sbe m_soll_res_em_has_sbe m_soll_res_em_bas_sbe z_modus_iae_has_sbe z_sas_has_sbe z_modus_iep_has_sbe z_msa_has_sbe status_efahren_has_sbe n_min_em_has_sbe z_msa_avh_moni_has_sbe z_msa_eaf_moni_has_sbe z_start_modus_has_sbe m_k0_mber_has_sbe z_lls_fktaktiv_has_sbe z_status_psys_mps_sbe m_k0_has_sbe m_soll_k0_has_sbe analyse_has_sbe z_nminemmodus_has_sbe st_soll_bz_has_hst z_init_sta st_soll_bz_hst_sta st_ist_bz_hst_sta bExceptionHybrid bErrorHybrid z_modus_em_hst_in c_getriebe_egs_in istgang_egs_in m_em_in m_iae_in m_k0_in m_max_dyn_em_in m_soll_em_hst_in m_soll_vm_hst_in m_vm_in m_vm_start_in m_wunsch_fpw_in n_ab_egs_in n_em_in n_soll_ll_vm_in n_t_egs_in n_vm_in osmode_next_in p_bremse_fzg_in sollgang_egs_in status_fehler_iep_in status_iae_in status_iep_in status_k0_in pos_egs_in z_ablauf_has_hst_in z_ablaufvariante_has_hst_in zielgang_egs_in z_k0_fst_in m_mot_in status_iae_adap_in z_diag_ersfkt_has_in z_diag_ersfkt_hi_has_in z_diag_notgang_has_in status_k0_adap_in status_waschstr_in status_kraftfluss_egs_in z_n_min_em_parksp_has_in n_mot_soll_iae_in status_alaengs_adaoff_in gangwechsel_egs_in z_nllsoll_iae_in status_nem_in status_nvm_in kolbenpos_k0_in z_kps_stada_in t_betrieb_pvu_has_ee_in status_ll_vm_in z_msa_fst_in m_min_dyn_em_in phi_neigung_in v_f_in drehrichtung_nem_in fpw_in drehrichtung_nab_in schalt_mode_egs_in m_ziel_k0_hst_in status_kraftfluss_lev2_egs_in i_gang_lev2_egs_in status_c_k0_in bremspedal_in status_autohold_in status_hillhold_in status_vf_in v_f_ref_in status_vfref_in z_diag_ersfkt_hi_96_has_in status_k0_adap_zaehler_in status_k0_befuellung_in z_oea_hst_in z_iep_in z_nllsoll_iep_in c_vm_in n_soll_em_hst_in abstellpos_vm_in abstellpos_vm_status_in status_nreg_em_hst_in m_min_vm_in m_soll_vm_l_hst_in z_msa_stada_in m_wunsch_fpw_hst_in status_getrbereit_in status_betriebsbereit_hst_in status_sa_vm_in z_ba_has_vm_hst_in z_ba_has_k0_hst_in status_abs_in status_asr_in modus_e_fahren_hst_in status_kl15_in status_posvueb_in soc_in status_soc_in c_umgebung_in status_cumgebung_in /end LOC_MEASUREMENT
 /begin SUB_FUNCTION SFOp3_FOpFcn SFOp4_FOp_MergeOut /end SUB_FUNCTION
/end FUNCTION
/begin FUNCTION Run_FSTA_Strategie ""
 /begin LOC_MEASUREMENT z_nvmsollbegr_frk_dihi z_statuspsysmps_frk_dihi z_nminemnull_frk_dihi z_emfehler_frk_dihi z_ablaufreinit_frk_dihi z_k0syncmk0erh_frk_dihi z_fuwdeakt_frk_dihi z_nemmin_frk_dihi z_vmstopverbot_frk_dihi z_vmstartverbot_frk_dihi z_zust_halten_frk_dihi z_zust_init_frk_dihi z_deaktiv_abo_frk_dihi z_vmstartanf_frk_dihi z_svh_frk_dihi z_iepein_frk_dihi z_nsollvmnull_frk_dihi z_ala_frk_dihi z_schaltprioverh_frk_dihi z_nsollvmanh_frk_dihi z_gebruefahrenaus_frk_dihi z_hybfkt_stg st_ziel_bz_has_stg st_ist_bz_has_stg st_ist_hcomd_has_stg z_ablauf_has_stg z_ablaufvariante_has_stg m_k0_mod_has_fkt m_max_em_has_fkt m_max_iae_has_fkt m_min_em_has_fkt m_soll_em_has_fkt m_soll_k0_has_fkt m_soll_res_em_has_fkt mg_soll_k0_has_fkt n_soll_em_has_fkt n_soll_vm_has_fkt nd_min_saf_has_fkt nd_soll_iae_fkt st_ablauf_fkt status_ablauf_has_fkt z_ablauf_svh_reset_has_fkt z_ablaufvariante_kalt_zus z_emaktiv_fuw_zus_fkt z_fehler15_eh_fkt z_k0_befuellopt_has_fkt z_k0_has_fkt z_m_max_iae_has_fkt z_m_soll_em_has_fkt z_n_soll_em_has_fkt z_n_soll_vm_has_fkt z_p_hys_k0_has_fkt z_ponr_fkt z_respschlepp_sas_fkt z_saf_has_fkt z_sbe_has_fkt z_zuendfreigabe_vm_fkt z_zuendfreigabe_vm_has_fkt i_istgang_egs i_zielgang_egs m_wunsch_fpw_hst_fil mg_wunsch_fpw_in mg_wunsch_fpw_hst_in n_sec_iae nd_k0_in ndg_k0_in ng_vm_in status_schaltung_egs_in n_min_em_psys_lp3_has_sbe status_psys_has_sbe vg_f_sbe v_f_sbe status_sync_schaltung_sbe z_pvu_has_sbe z_freigabe_pvu_has_sbe t_betrieb_pvu_has_sbe mg_mot_in status_radschlupf_rse_has_sbe status_schaltart_svh_has_sbe st_soll_bz_has_hst z_init_sta st_soll_bz_hst_sta st_ist_bz_hst_sta bExceptionHybrid bErrorHybrid z_modus_em_hst_in c_getriebe_egs_in istgang_egs_in m_em_in m_iae_in m_k0_in m_max_dyn_em_in m_soll_em_hst_in m_soll_vm_hst_in m_vm_in m_vm_start_in m_wunsch_fpw_in n_ab_egs_in n_em_in n_soll_ll_vm_in n_t_egs_in n_vm_in osmode_next_in p_bremse_fzg_in sollgang_egs_in status_fehler_iep_in status_iae_in status_iep_in status_k0_in pos_egs_in z_ablauf_has_hst_in z_ablaufvariante_has_hst_in zielgang_egs_in z_k0_fst_in m_mot_in status_iae_adap_in z_diag_ersfkt_has_in z_diag_ersfkt_hi_has_in z_diag_notgang_has_in status_k0_adap_in status_waschstr_in status_kraftfluss_egs_in z_n_min_em_parksp_has_in n_mot_soll_iae_in status_alaengs_adaoff_in gangwechsel_egs_in z_nllsoll_iae_in status_nem_in status_nvm_in kolbenpos_k0_in z_kps_stada_in t_betrieb_pvu_has_ee_in status_ll_vm_in z_msa_fst_in m_min_dyn_em_in phi_neigung_in v_f_in drehrichtung_nem_in fpw_in drehrichtung_nab_in schalt_mode_egs_in m_ziel_k0_hst_in status_kraftfluss_lev2_egs_in i_gang_lev2_egs_in status_c_k0_in bremspedal_in status_autohold_in status_hillhold_in status_vf_in v_f_ref_in status_vfref_in z_diag_ersfkt_hi_96_has_in status_k0_adap_zaehler_in status_k0_befuellung_in z_oea_hst_in z_iep_in z_nllsoll_iep_in c_vm_in n_soll_em_hst_in abstellpos_vm_in abstellpos_vm_status_in status_nreg_em_hst_in m_min_vm_in m_soll_vm_l_hst_in z_msa_stada_in m_wunsch_fpw_hst_in status_getrbereit_in status_betriebsbereit_hst_in status_sa_vm_in z_ba_has_vm_hst_in z_ba_has_k0_hst_in status_abs_in status_asr_in modus_e_fahren_hst_in status_kl15_in status_posvueb_in soc_in status_soc_in c_umgebung_in status_cumgebung_in /end LOC_MEASUREMENT
 /begin SUB_FUNCTION SFSTA13_Driveline_req_Generator SFSTA2_FSTAPA_ProjektAllgemein SFSTA12_Driveline_act_Generator SFSTA15_Init_Detection /end SUB_FUNCTION
/end FUNCTION
/begin FUNCTION Run_SAi_SignalAufbereitung_in ""
 /begin LOC_MEASUREMENT c_getriebe_egs_portin istgang_egs_portin m_em_portin m_iae_portin m_k0_portin m_max_dyn_em_portin m_soll_em_hst_portin m_soll_vm_hst_portin m_vm_portin m_vm_start_portin m_wunsch_fpw_portin n_ab_egs_portin n_em_portin n_soll_ll_vm_portin n_t_egs_portin n_vm_portin osmode_next_portin p_bremse_fzg_portin sollgang_egs_portin status_fehler_iep_portin status_iae_portin status_iep_portin status_k0_portin status_kraftschl_atsys_portin z_ablauf_has_hst_portin z_ablaufvariante_has_hst_portin zielgang_egs_portin z_k0_fst_portin z_iep_anf_portin m_mot_portin status_iae_adap_portin z_diag_ersfkt_has_portin z_diag_ersfkt_hi_has_portin z_diag_notgang_has_portin status_k0_adap_portin status_waschstr_portin z_n_min_em_parksp_has_portin n_mot_soll_iae_portin status_alaengs_adaoff_portin gangwechsel_egs_portin z_nllsoll_iae_portin status_nem_portin pos_egs_portin status_nvm_portin kolbenpos_k0_portin z_kps_stada_portin t_betrieb_pvu_has_ee_portin status_ee_busy_portin z_msa_fst_avh_portin z_msa_fst_eaf_portin m_min_dyn_em_portin status_phineigung_portin phi_neigung_portin v_f_portin drehrichtung_nem_portin fpw_portin drehrichtung_nab_portin schalt_mode_egs_portin status_kraftfluss_lev2_egs_portin i_gang_lev2_egs_portin status_c_k0_portin bremspedal_portin status_fzg_rollverhinderung_portin status_vf_portin v_f_ref_portin status_vfref_portin z_diag_ersfkt_hi_96_has_portin status_k0_adapf_zaehler_portin status_k0_adatsf_zaehler_portin status_k0_befuellung_portin z_oea_hst_portin m_soll_vm_l_hst_portin m_wunsch_fpw_hst_portin status_nreg_em_hst_portin c_vm_portin m_min_vm_portin n_soll_em_hst_portin abstellpos_vm_portin abstellpos_vm_status_portin z_msa_stada_avh_portin z_msa_stada_eaf_portin status_getrbereit_portin m_ziel_k0_hst_portin status_sa_vm_portin z_ba_has_k0_hst_portin z_ba_has_vm_hst_portin status_betriebsber_hst_portin status_abs_portin status_asr_portin modus_e_fahren_hst_portin status_fahranf_hst_portin posv_timer_portin posvueb_aktiv_portin soc_portin status_soc_portin c_umgebung_portin status_cumgebung_portin istgang_egs m_vm z_modus_em_hst_in c_getriebe_egs_in istgang_egs_in m_em_in m_iae_in m_k0_in m_max_dyn_em_in m_soll_em_hst_in m_soll_vm_hst_in m_vm_in m_vm_start_in m_wunsch_fpw_in n_ab_egs_in n_em_in n_soll_ll_vm_in n_t_egs_in n_vm_in osmode_next_in p_bremse_fzg_in sollgang_egs_in status_fehler_iep_in status_iae_in status_iep_in status_k0_in pos_egs_in z_ablauf_has_hst_in z_ablaufvariante_has_hst_in zielgang_egs_in z_k0_fst_in m_mot_in status_iae_adap_in z_diag_ersfkt_has_in z_diag_ersfkt_hi_has_in z_diag_notgang_has_in status_k0_adap_in status_waschstr_in status_kraftfluss_egs_in z_n_min_em_parksp_has_in n_mot_soll_iae_in status_alaengs_adaoff_in gangwechsel_egs_in z_nllsoll_iae_in status_nem_in status_nvm_in kolbenpos_k0_in z_kps_stada_in t_betrieb_pvu_has_ee_in status_ll_vm_in z_msa_fst_in m_min_dyn_em_in phi_neigung_in v_f_in drehrichtung_nem_in fpw_in drehrichtung_nab_in schalt_mode_egs_in m_ziel_k0_hst_in status_kraftfluss_lev2_egs_in i_gang_lev2_egs_in status_c_k0_in bremspedal_in status_autohold_in status_hillhold_in status_vf_in v_f_ref_in status_vfref_in z_diag_ersfkt_hi_96_has_in status_k0_adap_zaehler_in status_k0_befuellung_in z_oea_hst_in z_iep_in z_nllsoll_iep_in c_vm_in n_soll_em_hst_in abstellpos_vm_in abstellpos_vm_status_in status_nreg_em_hst_in m_min_vm_in m_soll_vm_l_hst_in z_msa_stada_in m_wunsch_fpw_hst_in status_getrbereit_in status_betriebsbereit_hst_in status_sa_vm_in z_ba_has_vm_hst_in z_ba_has_k0_hst_in status_abs_in status_asr_in modus_e_fahren_hst_in status_kl15_in status_posvueb_in soc_in status_soc_in c_umgebung_in status_cumgebung_in /end LOC_MEASUREMENT
 /begin SUB_FUNCTION SSAi3_SAiPA_ProjektAllgemein SSAi2_SAiEEP_EEProm SSAi4_SAiPS_ProjektSpezifisch /end SUB_FUNCTION
/end FUNCTION
/begin FUNCTION Run_SAo_SignalAufbereitung_out ""
 /begin LOC_MEASUREMENT byp_vnr_has_byp pc_ok_has_byp status_ablauf_has_byp m_k0_has_byp n_soll_em_has_byp n_soll_vm_has_byp z_k0_has_byp m_soll_k0_has_byp z_n_soll_vm_has_byp z_n_soll_em_has_byp status_efahren_has_byp m_soll_res_em_has_byp m_soll_em_has_byp m_max_iae_has_byp z_sbe_has_byp z_modus_iae_has_byp z_m_max_iae_has_byp m_max_em_has_byp m_min_em_has_byp mo_mod_em_hst_has_byp n_min_em_has_sbe_has_byp z_m_soll_em_has_byp iep_soll_has_byp mg_soll_k0_neg_has_byp mg_soll_k0_pos_has_byp z_msa_has_byp bypass_has_aktiv z_p_hys_k0_has_byp z_saf_has_byp z_sas_has_byp nd_min_saf_has_byp z_glsbe_has_byp z_svh_has_byp m_motmax_has_byp status_ablaufaktiv_has_byp st_ist_bz_has_byp st_ziel_bz_has_byp analyse_has_byp z_k0_befuellopt_has_byp z_status_psys_mps_has_byp z_start_modus_has_byp m_k0_mber_has_byp z_fehler15_diho_has_byp z_k0oeffnicht_diho_has_byp z_kfc_c0noclose_has_byp z_oelversfehler_diho_has_byp z_vmaus_auw_diho_has_byp z_nemzuklein_auw_diho_has_byp z_ndk0zugross_auw_diho_has_byp z_kfc_c0noclosepb_has_byp z_kfc_c0noopenpb_has_byp z_nemrde_diho_has_byp z_nemablwe_auw_diho_has_byp z_statusnem_auw_diho_has_byp z_nemasynscl_auw_diho_has_byp z_statusnemasynscl_auw_diho_has_byp z_statusnemablwe_auw_diho_has_byp z_freigabe_pvu_has_byp t_betrieb_pvu_has_byp z_nllsoll_modus_has_byp z_kfc_c0noopen_eho_diho_has_byp z_kfc_c0noclose_eho_diho_has_byp z_nvmzuklein_auw_diho_has_byp z_nvmsollbegr_frk_dihi z_statuspsysmps_frk_dihi z_nminemnull_frk_dihi z_emfehler_frk_dihi z_ablaufreinit_frk_dihi z_k0syncmk0erh_frk_dihi z_fuwdeakt_frk_dihi z_nemmin_frk_dihi z_vmstopverbot_frk_dihi z_vmstartverbot_frk_dihi z_zust_halten_frk_dihi z_zust_init_frk_dihi z_deaktiv_abo_frk_dihi z_vmstartanf_frk_dihi z_svh_frk_dihi z_iepein_frk_dihi z_nsollvmnull_frk_dihi z_ala_frk_dihi z_schaltprioverh_frk_dihi z_nsollvmanh_frk_dihi z_gebruefahrenaus_frk_dihi z_hybfkt_stg st_ziel_bz_has_stg st_ist_bz_has_stg st_ist_hcomd_has_stg z_ablauf_has_stg z_ablaufvariante_has_stg m_k0_mod_has_fkt m_max_em_has_fkt m_max_iae_has_fkt m_min_em_has_fkt m_soll_em_has_fkt m_soll_k0_has_fkt m_soll_res_em_has_fkt mg_soll_k0_has_fkt n_soll_em_has_fkt n_soll_vm_has_fkt nd_min_saf_has_fkt nd_soll_iae_fkt st_ablauf_fkt status_ablauf_has_fkt z_ablauf_svh_reset_has_fkt z_ablaufvariante_kalt_zus z_emaktiv_fuw_zus_fkt z_fehler15_eh_fkt z_k0_befuellopt_has_fkt z_k0_has_fkt z_m_max_iae_has_fkt z_m_soll_em_has_fkt z_n_soll_em_has_fkt z_n_soll_vm_has_fkt z_p_hys_k0_has_fkt z_ponr_fkt z_respschlepp_sas_fkt z_saf_has_fkt z_sbe_has_fkt z_zuendfreigabe_vm_fkt z_zuendfreigabe_vm_has_fkt i_istgang_egs i_zielgang_egs m_wunsch_fpw_hst_fil mg_wunsch_fpw_in mg_wunsch_fpw_hst_in n_sec_iae nd_k0_in ndg_k0_in ng_vm_in status_schaltung_egs_in n_min_em_psys_lp3_has_sbe status_psys_has_sbe vg_f_sbe v_f_sbe status_sync_schaltung_sbe z_pvu_has_sbe z_freigabe_pvu_has_sbe t_betrieb_pvu_has_sbe mg_mot_in status_radschlupf_rse_has_sbe status_schaltart_svh_has_sbe m_motmax_has_sbe z_k0_has_sbe z_svh_has_sbe m_soll_res_em_has_sbe m_soll_res_em_bas_sbe z_modus_iae_has_sbe z_sas_has_sbe z_modus_iep_has_sbe z_msa_has_sbe status_efahren_has_sbe n_min_em_has_sbe z_msa_avh_moni_has_sbe z_msa_eaf_moni_has_sbe z_start_modus_has_sbe m_k0_mber_has_sbe z_lls_fktaktiv_has_sbe z_status_psys_mps_sbe m_k0_has_sbe m_soll_k0_has_sbe analyse_has_sbe z_nminemmodus_has_sbe st_soll_bz_has_hst z_init_sta st_soll_bz_hst_sta st_ist_bz_hst_sta bExceptionHybrid bErrorHybrid z_modus_em_hst_in c_getriebe_egs_in istgang_egs_in m_em_in m_iae_in m_k0_in m_max_dyn_em_in m_soll_em_hst_in m_soll_vm_hst_in m_vm_in m_vm_start_in m_wunsch_fpw_in n_ab_egs_in n_em_in n_soll_ll_vm_in n_t_egs_in n_vm_in osmode_next_in p_bremse_fzg_in sollgang_egs_in status_fehler_iep_in status_iae_in status_iep_in status_k0_in pos_egs_in z_ablauf_has_hst_in z_ablaufvariante_has_hst_in zielgang_egs_in z_k0_fst_in m_mot_in status_iae_adap_in z_diag_ersfkt_has_in z_diag_ersfkt_hi_has_in z_diag_notgang_has_in status_k0_adap_in status_waschstr_in status_kraftfluss_egs_in z_n_min_em_parksp_has_in n_mot_soll_iae_in status_alaengs_adaoff_in gangwechsel_egs_in z_nllsoll_iae_in status_nem_in status_nvm_in kolbenpos_k0_in z_kps_stada_in t_betrieb_pvu_has_ee_in status_ll_vm_in z_msa_fst_in m_min_dyn_em_in phi_neigung_in v_f_in drehrichtung_nem_in fpw_in drehrichtung_nab_in schalt_mode_egs_in m_ziel_k0_hst_in status_kraftfluss_lev2_egs_in i_gang_lev2_egs_in status_c_k0_in bremspedal_in status_autohold_in status_hillhold_in status_vf_in v_f_ref_in status_vfref_in z_diag_ersfkt_hi_96_has_in status_k0_adap_zaehler_in status_k0_befuellung_in z_oea_hst_in z_iep_in z_nllsoll_iep_in c_vm_in n_soll_em_hst_in abstellpos_vm_in abstellpos_vm_status_in status_nreg_em_hst_in m_min_vm_in m_soll_vm_l_hst_in z_msa_stada_in m_wunsch_fpw_hst_in status_getrbereit_in status_betriebsbereit_hst_in status_sa_vm_in z_ba_has_vm_hst_in z_ba_has_k0_hst_in status_abs_in status_asr_in modus_e_fahren_hst_in status_kl15_in status_posvueb_in soc_in status_soc_in c_umgebung_in status_cumgebung_in SAoEEP1 SAoEEP2 m_max_iae_has_portout m_soll_res_em_has_portout m_soll_em_has_portout m_soll_em_has_komp_portout n_mot_llsoll_has_portout n_mot_llsoll_has_komp_portout n_mot_idle_tar_has_portout n_mot_idle_tar_has_komp_portout n_soll_em_has_portout n_soll_em_has_komp_portout n_soll_vm_has_portout n_soll_vm_has_komp_portout status_ablauf_has_portout z_modus_iae_has_portout z_m_max_iae_has_portout z_m_soll_em_has_portout z_m_soll_em_has_komp_portout z_n_soll_vm_has_portout z_n_soll_vm_has_komp_portout z_n_soll_em_has_portout z_n_soll_em_has_komp_portout m_soll_k0_has_portout z_k0_has_portout m_k0_has_portout z_saf_has_portout status_efahren_has_portout m_motmax_has_portout mg_soll_k0_pos_has_portout mg_soll_k0_neg_has_portout z_sbe_has_portout iep_soll_has_portout z_p_hys_k0_has_portout z_msa_has_portout err_n_soll_em_has_portout err_n_soll_em_has_komp_portout err_n_soll_vm_has_portout err_n_soll_vm_has_komp_portout z_sas_has_portout nd_min_saf_has_portout z_glsbe_has_portout z_svh_has_portout analyse_has_portout z_k0_befuellopt_has_portout z_status_psys_mps_portout m_motmax_has_komp_portout z_start_modus_has_portout status_ablaufaktiv_has_portout st_ist_bz_has_portout st_ziel_bz_has_portout z_freigabe_pvu_has_portout t_betrieb_pvu_has_portout z_nllsoll_modus_has_portout m_max_em_has_portout m_min_em_has_portout mo_mod_em_hst_has_portout m_k0_mber_has_portout /end LOC_MEASUREMENT
 /begin SUB_FUNCTION SSAo3_SAoPA_ProjektAllgemein SSAo4_SAoPS_ProjektSpezifisch SSAo2_SAoEEP_EEProm /end SUB_FUNCTION
/end FUNCTION
/begin FUNCTION Run_SBEo_Signalberechnung_out ""
 /begin LOC_MEASUREMENT z_nvmsollbegr_frk_dihi z_statuspsysmps_frk_dihi z_nminemnull_frk_dihi z_emfehler_frk_dihi z_ablaufreinit_frk_dihi z_k0syncmk0erh_frk_dihi z_fuwdeakt_frk_dihi z_nemmin_frk_dihi z_vmstopverbot_frk_dihi z_vmstartverbot_frk_dihi z_zust_halten_frk_dihi z_zust_init_frk_dihi z_deaktiv_abo_frk_dihi z_vmstartanf_frk_dihi z_svh_frk_dihi z_iepein_frk_dihi z_nsollvmnull_frk_dihi z_ala_frk_dihi z_schaltprioverh_frk_dihi z_nsollvmanh_frk_dihi z_gebruefahrenaus_frk_dihi z_hybfkt_stg st_ziel_bz_has_stg st_ist_bz_has_stg st_ist_hcomd_has_stg z_ablauf_has_stg z_ablaufvariante_has_stg m_k0_mod_has_fkt m_max_em_has_fkt m_max_iae_has_fkt m_min_em_has_fkt m_soll_em_has_fkt m_soll_k0_has_fkt m_soll_res_em_has_fkt mg_soll_k0_has_fkt n_soll_em_has_fkt n_soll_vm_has_fkt nd_min_saf_has_fkt nd_soll_iae_fkt st_ablauf_fkt status_ablauf_has_fkt z_ablauf_svh_reset_has_fkt z_ablaufvariante_kalt_zus z_emaktiv_fuw_zus_fkt z_fehler15_eh_fkt z_k0_befuellopt_has_fkt z_k0_has_fkt z_m_max_iae_has_fkt z_m_soll_em_has_fkt z_n_soll_em_has_fkt z_n_soll_vm_has_fkt z_p_hys_k0_has_fkt z_ponr_fkt z_respschlepp_sas_fkt z_saf_has_fkt z_sbe_has_fkt z_zuendfreigabe_vm_fkt z_zuendfreigabe_vm_has_fkt i_istgang_egs i_zielgang_egs m_wunsch_fpw_hst_fil mg_wunsch_fpw_in mg_wunsch_fpw_hst_in n_sec_iae nd_k0_in ndg_k0_in ng_vm_in status_schaltung_egs_in n_min_em_psys_lp3_has_sbe status_psys_has_sbe vg_f_sbe v_f_sbe status_sync_schaltung_sbe z_pvu_has_sbe z_freigabe_pvu_has_sbe t_betrieb_pvu_has_sbe mg_mot_in status_radschlupf_rse_has_sbe status_schaltart_svh_has_sbe m_motmax_has_sbe z_k0_has_sbe z_svh_has_sbe m_soll_res_em_has_sbe m_soll_res_em_bas_sbe z_modus_iae_has_sbe z_sas_has_sbe z_modus_iep_has_sbe z_msa_has_sbe status_efahren_has_sbe n_min_em_has_sbe z_msa_avh_moni_has_sbe z_msa_eaf_moni_has_sbe z_start_modus_has_sbe m_k0_mber_has_sbe z_lls_fktaktiv_has_sbe z_status_psys_mps_sbe m_k0_has_sbe m_soll_k0_has_sbe analyse_has_sbe z_nminemmodus_has_sbe z_modus_em_hst_in c_getriebe_egs_in istgang_egs_in m_em_in m_iae_in m_k0_in m_max_dyn_em_in m_soll_em_hst_in m_soll_vm_hst_in m_vm_in m_vm_start_in m_wunsch_fpw_in n_ab_egs_in n_em_in n_soll_ll_vm_in n_t_egs_in n_vm_in osmode_next_in p_bremse_fzg_in sollgang_egs_in status_fehler_iep_in status_iae_in status_iep_in status_k0_in pos_egs_in z_ablauf_has_hst_in z_ablaufvariante_has_hst_in zielgang_egs_in z_k0_fst_in m_mot_in status_iae_adap_in z_diag_ersfkt_has_in z_diag_ersfkt_hi_has_in z_diag_notgang_has_in status_k0_adap_in status_waschstr_in status_kraftfluss_egs_in z_n_min_em_parksp_has_in n_mot_soll_iae_in status_alaengs_adaoff_in gangwechsel_egs_in z_nllsoll_iae_in status_nem_in status_nvm_in kolbenpos_k0_in z_kps_stada_in t_betrieb_pvu_has_ee_in status_ll_vm_in z_msa_fst_in m_min_dyn_em_in phi_neigung_in v_f_in drehrichtung_nem_in fpw_in drehrichtung_nab_in schalt_mode_egs_in m_ziel_k0_hst_in status_kraftfluss_lev2_egs_in i_gang_lev2_egs_in status_c_k0_in bremspedal_in status_autohold_in status_hillhold_in status_vf_in v_f_ref_in status_vfref_in z_diag_ersfkt_hi_96_has_in status_k0_adap_zaehler_in status_k0_befuellung_in z_oea_hst_in z_iep_in z_nllsoll_iep_in c_vm_in n_soll_em_hst_in abstellpos_vm_in abstellpos_vm_status_in status_nreg_em_hst_in m_min_vm_in m_soll_vm_l_hst_in z_msa_stada_in m_wunsch_fpw_hst_in status_getrbereit_in status_betriebsbereit_hst_in status_sa_vm_in z_ba_has_vm_hst_in z_ba_has_k0_hst_in status_abs_in status_asr_in modus_e_fahren_hst_in status_kl15_in status_posvueb_in soc_in status_soc_in c_umgebung_in status_cumgebung_in /end LOC_MEASUREMENT
 /begin SUB_FUNCTION SFSBo2_SBEo /end SUB_FUNCTION
/end FUNCTION
/begin FUNCTION Run_SDIAGo101_abs_fl32 "" /begin LOC_MEASUREMENT nd_k0_in /end LOC_MEASUREMENT /end FUNCTION
/begin FUNCTION Run_SDIAGo52_abs_fl32 "" /begin LOC_MEASUREMENT nd_k0_in /end LOC_MEASUREMENT /end FUNCTION
/begin FUNCTION Run_SFOp_ABST113_abs_fl32 "" /begin LOC_MEASUREMENT m_vm_in /end LOC_MEASUREMENT /end FUNCTION
/begin FUNCTION Run_SFOp_ABST114_cLimiter_Gradient_MK0modhas "" /begin LOC_MEASUREMENT m_k0_mod_has_fkt /end LOC_MEASUREMENT /end FUNCTION
/begin FUNCTION Run_SFOp_ABST199_abs_fl32 "" /begin LOC_MEASUREMENT nd_k0_in /end LOC_MEASUREMENT /end FUNCTION
/begin FUNCTION Run_SFOp_ABST35_CL_PT1_ "" /begin DEF_CHARACTERISTIC FK_NGVM_AST_ABST /end DEF_CHARACTERISTIC /begin LOC_MEASUREMENT ng_vm_gef_ast_abst ng_vm_in /end LOC_MEASUREMENT /end FUNCTION
/begin FUNCTION Run_SFOp_ABST57_abs_fl32 "" /begin LOC_MEASUREMENT m_em_in /end LOC_MEASUREMENT /end FUNCTION
/begin FUNCTION Run_SFOp_ABST58_cLimiter_Gradient_MSollK0 "" /begin DEF_CHARACTERISTIC MG_SOLLK0NEG_GAB_ABST MG_SOLLK0POS_GAB_ABST /end DEF_CHARACTERISTIC /begin LOC_MEASUREMENT m_soll_k0_has_fkt /end LOC_MEASUREMENT /end FUNCTION
/begin FUNCTION Run_SFOp_ABST67_abs_fl32 "" /begin LOC_MEASUREMENT m_em_in /end LOC_MEASUREMENT /end FUNCTION
/begin FUNCTION Run_SFOp_ABST79_cLimiter_Gradient_MSollK0 "" /begin LOC_MEASUREMENT m_soll_k0_has_fkt /end LOC_MEASUREMENT /end FUNCTION
/begin FUNCTION Run_SFOp_NOS50_cLimiter_Gradient_MSollK0 "" /begin DEF_CHARACTERISTIC MG_SOLLK0_ABB_NOS /end DEF_CHARACTERISTIC /end FUNCTION
/begin FUNCTION Run_SFOp_NOS66_abs_fl32 "" /begin LOC_MEASUREMENT nd_k0_in /end LOC_MEASUREMENT /end FUNCTION
/begin FUNCTION Run_SFOp_NOS67_cLimiter_m_soll_k0_has "" /begin LOC_MEASUREMENT m_soll_k0_has_fkt /end LOC_MEASUREMENT /end FUNCTION
/begin FUNCTION Run_SFOp_SLST124_cDT1_ngem "" /begin DEF_CHARACTERISTIC FK_NGEM_ANS /end DEF_CHARACTERISTIC /begin LOC_MEASUREMENT ng_em_ans n_em_in /end LOC_MEASUREMENT /end FUNCTION
/begin FUNCTION Run_SFOp_SLST198_cLimiter_Gradient_ndiae1 "" /begin LOC_MEASUREMENT init_nsollem_grad_ans ng_sollem_ans /end LOC_MEASUREMENT /end FUNCTION
/begin FUNCTION Run_SFOp_SLST203_cLimiter_nsollemiae "" /begin LOC_MEASUREMENT init_anfiae_aktiv_ans /end LOC_MEASUREMENT /end FUNCTION
/begin FUNCTION Run_SFOp_SLST23_abs_fl32 "" /begin LOC_MEASUREMENT nd_iae_ans /end LOC_MEASUREMENT /end FUNCTION
/begin FUNCTION Run_SFOp_SLST296_CL_PT1_14nsollvm "" /begin DEF_CHARACTERISTIC FK_NSOLLVM_SST_ANS /end DEF_CHARACTERISTIC /end FUNCTION
/begin FUNCTION Run_SFOp_SLST436_CL_PT1_14nsollvm "" /begin DEF_CHARACTERISTIC FK_NSOLLVM_SYN_ANS /end DEF_CHARACTERISTIC /end FUNCTION
/begin FUNCTION Run_SFOp_SLST449_cLimiter_Gradient_NEMmod "" /begin DEF_CHARACTERISTIC NG_EMMODRSMIN_SYN_ANS /end DEF_CHARACTERISTIC
 /begin LOC_MEASUREMENT init_n_em_mod_syn_ans n_ziel_em_mod_syn_ans ng_emmodrsmax_syn_ans /end LOC_MEASUREMENT
/end FUNCTION
/begin FUNCTION Run_SFOp_SLST487_abs_fl32 "" /begin LOC_MEASUREMENT nd_iae_ans /end LOC_MEASUREMENT /end FUNCTION
/begin FUNCTION Run_SFOp_SLST558_CL_PT1_14nsollvm "" /begin DEF_CHARACTERISTIC FK_NSOLLVM_KON_ANS /end DEF_CHARACTERISTIC /end FUNCTION
/begin FUNCTION Run_SFOp_SLST582_cLimiter_Gradient_MSollK0 "" /begin DEF_CHARACTERISTIC MG_SOLLK0_ABB_ANS /end DEF_CHARACTERISTIC /end FUNCTION
/begin FUNCTION Run_SFOp_SLST625_CL_PT1_14nsollvm "" /begin DEF_CHARACTERISTIC FK_NSOLLVM_SAK_ANS /end DEF_CHARACTERISTIC /end FUNCTION
/begin RECORD_LAYOUT FLOAT32_IEEE_COL_DIRECT_M_S7_S3 FNC_VALUES 1 FLOAT32_IEEE COLUMN_DIR DIRECT /end RECORD_LAYOUT
/begin RECORD_LAYOUT FLOAT32_IEEE_X_INCR_DIRECT_M_S7_S3 AXIS_PTS_X 1 FLOAT32_IEEE INDEX_INCR DIRECT /end RECORD_LAYOUT
/begin RECORD_LAYOUT UBYTE_COL_DIRECT_M_S7_S3 FNC_VALUES 1 UBYTE COLUMN_DIR DIRECT /end RECORD_LAYOUT
/begin RECORD_LAYOUT ULONG_COL_DIRECT_M_S7_S3 FNC_VALUES 1 ULONG COLUMN_DIR DIRECT /end RECORD_LAYOUT
/begin RECORD_LAYOUT UWORD_COL_DIRECT_M_S7_S3 FNC_VALUES 1 UWORD COLUMN_DIR DIRECT /end RECORD_LAYOUT
/end MODULE
/end PROJECT
