ASAP2_VERSION 1 51
/begin PROJECT _929_929 "Gen2_BMW_System_Supplier_Lib"
/begin HEADER "" VERSION "C_03_03" PROJECT_NO _929_929 /end HEADER
/begin MODULE DIM ""
/begin MOD_COMMON "" BYTE_ORDER MSB_FIRST ALIGNMENT_BYTE 1 ALIGNMENT_WORD 2 ALIGNMENT_LONG 4 ALIGNMENT_FLOAT32_IEEE 4 /end MOD_COMMON
/begin CHARACTERISTIC SWI_StarterReleaseDelayOn "switch for Starter Release Delay" VALUE 0x21832C ZF_Parameter.ui8_S1_S3 1 UMR___1_1_0_S1_S3 0 1 /end CHARACTERISTIC
/begin CHARACTERISTIC D_t_StarterInhibitor_Default "Timer reload value for Starter Release" CURVE 0x2182EC ZF_Curve.ui16.ui16_S1_S3 655350 UMR_MBSE_MSEC__10_1_0_S1_S3 0 655350
 /begin AXIS_DESCR STD_AXIS NO_INPUT_QUANTITY UMR_CGT40__1_1_M40_S1_S3 8 -40 215 DEPOSIT ABSOLUTE MONOTONY STRICT_INCREASE /end AXIS_DESCR
/end CHARACTERISTIC
/begin CHARACTERISTIC D_t_StarterInhibitor_Limphome "Timer reload value for Starter Release" CURVE 0x21830C ZF_Curve.ui16.ui16_S1_S3 655350 UMR_MBSE_MSEC__10_1_0_S1_S3 0 655350
 /begin AXIS_DESCR STD_AXIS NO_INPUT_QUANTITY UMR_CGT40__1_1_M40_S1_S3 8 -40 215 DEPOSIT ABSOLUTE MONOTONY STRICT_INCREASE /end AXIS_DESCR
/end CHARACTERISTIC
/begin CHARACTERISTIC D_t_StoreR "Storage Time for driver request R" VALUE 0x207B04 ZF_Parameter.ui16_S1_S3 655350 UMR_MBSE_MSEC__10_1_0_S1_S3 0 655350 /end CHARACTERISTIC
/begin CHARACTERISTIC D_t_StoreD "Storage Time for driver request D" VALUE 0x207AFC ZF_Parameter.ui16_S1_S3 655350 UMR_MBSE_MSEC__10_1_0_S1_S3 0 655350 /end CHARACTERISTIC
/begin CHARACTERISTIC SWI_StoreRD_AlthoughRejectedBySpeed "Start storing RD at engine on if speed is above upper threshold" VALUE 0x207B0E ZF_Parameter.ui8_S1_S3 1 UMR___1_1_0_S1_S3 0 1 /end CHARACTERISTIC
/begin CHARACTERISTIC SWI_StoreP_AlthoughRejectedBySpeed "Start storing P at engine on if speed is above upper threshold" VALUE 0x207B0C ZF_Parameter.ui8_S1_S3 1 UMR___1_1_0_S1_S3 0 1 /end CHARACTERISTIC
/begin CHARACTERISTIC SWI_StoreRD_N2RD "Start storing R/D at engine on if gearbox position is N" VALUE 0x207B0F ZF_Parameter.ui8_S1_S3 1 UMR___1_1_0_S1_S3 0 1 /end CHARACTERISTIC
/begin CHARACTERISTIC SWI_StoreRD_N2RD_UseUndefinedDirBuf "Start storing N to R/D at engine on even if driver direction cannot be detected" VALUE 0x207B11 ZF_Parameter.ui8_S1_S3 1 UMR___1_1_0_S1_S3 0 1 /end CHARACTERISTIC
/begin CHARACTERISTIC SWI_StoreRD_N2RD_RestartTimer "Re-Start storing R/D at engine on if stored driver request is detected again" VALUE 0x207B10 ZF_Parameter.ui8_S1_S3 1 UMR___1_1_0_S1_S3 0 1 /end CHARACTERISTIC
/begin CHARACTERISTIC SWI_StoreRD_RestartTimerWhileShifterInRD "restart storage of RD while lever is hold in stored position" VALUE 0x207B12 ZF_Parameter.ui8_S1_S3 1 UMR___1_1_0_S1_S3 0 1 /end CHARACTERISTIC
/begin CHARACTERISTIC D_t_StoreRD_EngStart "Storage Time for driver request RD at engine start" VALUE 0x207B06 ZF_Parameter.ui16_S1_S3 3000 UMR_MBSE_MSEC__10_1_0_S1_S3 0 3000 /end CHARACTERISTIC
/begin CHARACTERISTIC D_t_StoreP "Storage Time for driver request P" VALUE 0x207B02 ZF_Parameter.ui16_S1_S3 655350 UMR_MBSE_MSEC__10_1_0_S1_S3 0 655350 /end CHARACTERISTIC
/begin CHARACTERISTIC SWI_StoreP_RestartTimerWhileShifterInP "restart storage of P while lever is hold in stored position" VALUE 0x207B0D ZF_Parameter.ui8_S1_S3 1 UMR___1_1_0_S1_S3 0 1 /end CHARACTERISTIC
/begin CHARACTERISTIC D_t_StoreN "Storage Time for driver request N" VALUE 0x207AFE ZF_Parameter.ui16_S1_S3 655350 UMR_MBSE_MSEC__10_1_0_S1_S3 0 655350 /end CHARACTERISTIC
/begin CHARACTERISTIC D_v_N_Uth "POS N upper speed threshold" VALUE 0x207B08 ZF_Parameter.ui16_S1_S3 4095 UMR_VKMH__1_16_0_S1_S3 0 4095 /end CHARACTERISTIC
/begin CHARACTERISTIC D_t_StoreN_EGNER "Storage Time for driver request N by e-GNER" VALUE 0x207B00 ZF_Parameter.ui16_S1_S3 655350 UMR_MBSE_MSEC__10_1_0_S1_S3 0 655350 /end CHARACTERISTIC
/begin CHARACTERISTIC D_ResetStoreTimeEngOnToOff "b0=engine gets off / b1=engine gets on / b2=engine gets standby / b3=engine gets starter" VALUE 0x207B0A ZF_Parameter.ui8_S1_S3 15 UMR___1_1_0_S1_S3 0 15 /end CHARACTERISTIC
/begin CHARACTERISTIC D_t_Lev2PosError "additional timer for L2_Max_D_t_StoreN" VALUE 0x207B0B ZF_Parameter.ui8_S1_S3 100 UMR_MBSE_MSEC__10_1_0_S1_S3 0 100 /end CHARACTERISTIC
/begin CHARACTERISTIC SWI_CC "Enable CC Msgs" VALUE 0x207D47 ZF_Parameter.ui8_S1_S3 1 UMR___1_1_0_S1_S3 0 1 /end CHARACTERISTIC
/begin CHARACTERISTIC D_v_CC_Parklock_Lth "lower spd threshold for ID565" VALUE 0x207C54 ZF_Parameter.ui16_S1_S3 4095 UMR_VKMH__1_16_0_S1_S3 0 4095 /end CHARACTERISTIC
/begin CHARACTERISTIC D_c_TOilCCML_Th "temperature threshold for ID_MechLimpInD and ID_ParkLockFault_InMechLimp" VALUE 0x207D46 ZF_Parameter.ui8_S1_S3 255 UMR_CGT40__1_1_M40_S1_S3 -40 215 /end CHARACTERISTIC
/begin CHARACTERISTIC SWI_CC_Individual "Enable CC Msgs individually (be shure to differ btw. SBW and SBL" CURVE 0x207DE8 ZF_Table.ui8_S1_S3 255 UMR___1_1_0_S1_S3 0 255
 /begin AXIS_DESCR FIX_AXIS NO_INPUT_QUANTITY UMR___1_1_0_S1_S3 40 0 39 FIX_AXIS_PAR_DIST 0 1 40 /end AXIS_DESCR
/end CHARACTERISTIC
/begin CHARACTERISTIC D_type_CC "type of CC-Msg (event triggerd = 0 / cyclic = 1)" CURVE 0x207DC0 ZF_Table.ui8_S1_S3 1 UMR___1_1_0_S1_S3 0 1
 /begin AXIS_DESCR FIX_AXIS NO_INPUT_QUANTITY UMR___1_1_0_S1_S3 40 0 39 FIX_AXIS_PAR_DIST 0 1 40 /end AXIS_DESCR
/end CHARACTERISTIC
/begin CHARACTERISTIC D_t_CC_delay "Delay displaying message" CURVE 0x207CA6 ZF_Table.ui16_S1_S3 655350 UMR_MBSE_MSEC__10_1_0_S1_S3 0 655350
 /begin AXIS_DESCR FIX_AXIS NO_INPUT_QUANTITY UMR___1_1_0_S1_S3 40 0 39 FIX_AXIS_PAR_DIST 0 1 40 /end AXIS_DESCR
/end CHARACTERISTIC
/begin CHARACTERISTIC D_v_CC "Threshold to v_VehSpdMin" CURVE 0x207CF6 ZF_Table.ui16_S1_S3 4095 UMR_VKMH__1_16_0_S1_S3 0 4095
 /begin AXIS_DESCR FIX_AXIS NO_INPUT_QUANTITY UMR___1_1_0_S1_S3 40 0 39 FIX_AXIS_PAR_DIST 0 1 40 /end AXIS_DESCR
/end CHARACTERISTIC
/begin CHARACTERISTIC D_t_CC_CycleTime "Cycle time of Message [s]" CURVE 0x207D70 ZF_Table.ui8_S1_S3 255 UMR_SEC_1_1_0_S1_S3 0 255
 /begin AXIS_DESCR FIX_AXIS NO_INPUT_QUANTITY UMR___1_1_0_S1_S3 40 0 39 FIX_AXIS_PAR_DIST 0 1 40 /end AXIS_DESCR
/end CHARACTERISTIC
/begin CHARACTERISTIC D_t_CC_MinTime "Cycle time of Message [s]" CURVE 0x207D98 ZF_Table.ui8_S1_S3 255 UMR_SEC_1_1_0_S1_S3 0 255
 /begin AXIS_DESCR FIX_AXIS NO_INPUT_QUANTITY UMR___1_1_0_S1_S3 40 0 39 FIX_AXIS_PAR_DIST 0 1 40 /end AXIS_DESCR
/end CHARACTERISTIC
/begin CHARACTERISTIC D_CC_ID "CCM-ID that is sent via CAN if function ID is active" CURVE 0x207C56 ZF_Table.ui16_S1_S3 65535 UMR___1_1_0_S1_S3 0 65535
 /begin AXIS_DESCR FIX_AXIS NO_INPUT_QUANTITY UMR___1_1_0_S1_S3 40 0 39 FIX_AXIS_PAR_DIST 0 1 40 /end AXIS_DESCR
/end CHARACTERISTIC
/begin CHARACTERISTIC D_CC_Prio "Priorization of function IDs. Lowest number = highest prio" CURVE 0x207D48 ZF_Table.ui8_S1_S3 39 UMR___1_1_0_S1_S3 0 39
 /begin AXIS_DESCR FIX_AXIS NO_INPUT_QUANTITY UMR___1_1_0_S1_S3 40 0 39 FIX_AXIS_PAR_DIST 0 1 40 /end AXIS_DESCR
/end CHARACTERISTIC
/begin CHARACTERISTIC D_Tab_LockCond "Table of locking condition for cc msgs" MAP 0x207B14 ZF_Matrix.ui32_S1_S3 4.29497E+009 UMR___1_1_0_S1_S3 0 4294967295
 /begin AXIS_DESCR FIX_AXIS NO_INPUT_QUANTITY eTabLockCondX_S1_S3 2 0 1 FIX_AXIS_PAR_DIST 0 1 2 /end AXIS_DESCR
 /begin AXIS_DESCR FIX_AXIS NO_INPUT_QUANTITY eTabLockCondY_S1_S3 40 0 39 FIX_AXIS_PAR_DIST 0 1 40 /end AXIS_DESCR
/end CHARACTERISTIC
/begin CHARACTERISTIC SWI_DiagPos "Enable Diag Position" VALUE 0x218336 ZF_Parameter.ui8_S1_S3 1 UMR___1_1_0_S1_S3 0 1 /end CHARACTERISTIC
/begin CHARACTERISTIC D_SetPreAdpvFaild "state of preadaptation: 0:not started yet 1:Initialising 2:working 3:complete 4: failed" VALUE 0x218333 ZF_Parameter.ui8_S1_S3 7 UMR___1_1_0_S1_S3 0 7 /end CHARACTERISTIC
/begin CHARACTERISTIC D_SetPreAdpvEnd "state of preadaptation: 0:not started yet 1:Initialising 2:working 3:complete 4: failed" VALUE 0x218332 ZF_Parameter.ui8_S1_S3 7 UMR___1_1_0_S1_S3 0 7 /end CHARACTERISTIC
/begin CHARACTERISTIC SWI_DiagPosUWIG "Enable Diag Position by UWIG Symptom" VALUE 0x21833A ZF_Parameter.ui8_S1_S3 7 UMR___1_1_0_S1_S3 0 7 /end CHARACTERISTIC
/begin CHARACTERISTIC SWI_DiagPosDrvAssist "switch used to deactivate effect of FAS-error flag f_DrvAssistPosModeErr on diagpos P or N" VALUE 0x218338 ZF_Parameter.ui8_S1_S3 1 UMR___1_1_0_S1_S3 0 1 /end CHARACTERISTIC
/begin CHARACTERISTIC D_v_WrongDrvDir "Speed threshold for diagnosis position N due to position D and driving direction bw and vice vesra" VALUE 0x218330 ZF_Parameter.ui16_S1_S3 4095 UMR_VKMH__1_16_0_S1_S3 0 4095 /end CHARACTERISTIC
/begin CHARACTERISTIC SWI_DiagPosInWrongDrvDir "Switch for diagnosis position N due to wrong driving direction" VALUE 0x218339 ZF_Parameter.ui8_S1_S3 1 UMR___1_1_0_S1_S3 0 1 /end CHARACTERISTIC
/begin CHARACTERISTIC D_t_FlashDiagPosInWrongDrvDir "Flash duration for pos N if diagnosis position N due to wrong driving direction" VALUE 0x21832E ZF_Parameter.ui16_S1_S3 655350 UMR_MBSE_MSEC__10_1_0_S1_S3 0 655350 /end CHARACTERISTIC
/begin CHARACTERISTIC D_t_DebounceWrongDrvDir "Timer reload value for timer tmr_DebounceWrongDrvDir" VALUE 0x218334 ZF_Parameter.ui8_S1_S3 2550 UMR_MBSE_MSEC__10_1_0_S1_S3 0 2550 /end CHARACTERISTIC
/begin CHARACTERISTIC D_t_DebounceWrongDrvDirMinTime "Minimum time to exeed the vehicle speed before triggering the diagnosis position neutral" VALUE 0x218335 ZF_Parameter.ui8_S1_S3 2550 UMR_MBSE_MSEC__10_1_0_S1_S3 0 2550 /end CHARACTERISTIC
/begin CHARACTERISTIC SWI_DiagPosByVimplausible "Switch to activate Diag-N due to implausible veh spd: 0 - OFF, 1 - in R, 2 - in R/D" VALUE 0x218337 ZF_Parameter.ui8_S1_S3 2 UMR___1_1_0_S1_S3 0 2 /end CHARACTERISTIC
/begin CHARACTERISTIC SWI_Ews4_E_Label "switch to avoid locking EWS4-secret key in TCU" VALUE 0x21826C ZF_Parameter.ui8_S1_S3 1 UMR___1_1_0_S1_S3 0 1 /end CHARACTERISTIC
/begin CHARACTERISTIC D_Rsp_ErrCnt_SK_avail_Max_A "upper threshold for ews4 rsp_err_cnt_A: non-authentic responses received [when SK available/locked]" VALUE 0x218263 ZF_Parameter.ui8_S1_S3 10 UMR___1_1_0_S1_S3 0 10 /end CHARACTERISTIC
/begin CHARACTERISTIC D_Rsp_ErrCnt_SK_unavail_Max_C "upper threshold for ews4 rsp_err_cnt_C: responses received [without SK available/locked]" VALUE 0x218264 ZF_Parameter.ui8_S1_S3 3 UMR___1_1_0_S1_S3 0 3 /end CHARACTERISTIC
/begin CHARACTERISTIC D_Rsp_ErrCnt_FctCRafterCalcSK_Max_B "upper threshold for ews4 error-counter Err_B for wrong or no responses [in fct. Challenge-Resp.after calc. SK]" VALUE 0x218262 ZF_Parameter.ui8_S1_S3 10 UMR___1_1_0_S1_S3 0 10 /end CHARACTERISTIC
/begin CHARACTERISTIC D_Rsp_OkCnt_FctCRafterCalcSK_Min_Ok "upper threshold for ews4 ok-counter Ok_Count for correct responses [in fct. Challenge-Resp.after calc. SK]" VALUE 0x218265 ZF_Parameter.ui8_S1_S3 3 UMR___1_1_0_S1_S3 0 3 /end CHARACTERISTIC
/begin CHARACTERISTIC D_t_TO_RxRspAfterTxChal_Id_1 "timeout ews4 for receiving DME-response after tx TCU-challenge" VALUE 0x21825E ZF_Parameter.ui16_S1_S3 655320 UMR_MBSE_MSEC__10_1_0_S1_S3 30 655350 /end CHARACTERISTIC
/begin CHARACTERISTIC D_t_TO_RxKFAfterTxKF_Id_2 "timeout ews4 for receiving DME-KF after tx TCU-KF" VALUE 0x21825C ZF_Parameter.ui16_S1_S3 655320 UMR_MBSE_MSEC__10_1_0_S1_S3 30 655350 /end CHARACTERISTIC
/begin CHARACTERISTIC D_t_Min_RxRspUntilTxChal "minimal time in ews4 between receiving DME-response and tx new TCU-challenge" VALUE 0x218254 ZF_Parameter.ui16_S1_S3 655320 UMR_MBSE_MSEC__10_1_0_S1_S3 30 655350 /end CHARACTERISTIC
/begin CHARACTERISTIC D_t_Min_TxChalUntilTxChal_NoRsp "minimal time in ews4 between tx new TCU-challenge after tx TCU-Chal. with missing DME-response" VALUE 0x218256 ZF_Parameter.ui16_S1_S3 655320 UMR_MBSE_MSEC__10_1_0_S1_S3 30 655350 /end CHARACTERISTIC
/begin CHARACTERISTIC D_t_Delay_AfterSleepInd_BeforeLockEGS "time-delay in ews4 after sleep-/powerdown readiness [before EGS may be locked]" VALUE 0x218252 ZF_Parameter.ui16_S1_S3 655320 UMR_MBSE_MSEC__10_1_0_S1_S3 30 655350 /end CHARACTERISTIC
/begin CHARACTERISTIC D_t_Delay_KeyAuthWhileFACanFailure "time-delay in ews4 after 1st cyclic-call before redundancy-authentication is supposed while damaged FA-CAN" VALUE 0x218268 ZF_Parameter.ui8_S1_S3 2520 UMR_MBSE_MSEC__10_1_0_S1_S3 30 2550 /end CHARACTERISTIC
/begin CHARACTERISTIC D_t_TO_EEprom_StoreImmediate "timeout in ews4 EEprom storage-process: check timeout from store-immediate-cmd and not getting store-in-progress-ready" VALUE 0x21825A ZF_Parameter.ui16_S1_S3 655320 UMR_MBSE_MSEC__10_1_0_S1_S3 30 655350 /end CHARACTERISTIC
/begin CHARACTERISTIC D_t_Delay_WaitTasCasRequest "time-delay in ews4 after tx TAS-CAS-request" VALUE 0x218269 ZF_Parameter.ui8_S1_S3 2520 UMR_MBSE_MSEC__10_1_0_S1_S3 30 2550 /end CHARACTERISTIC
/begin CHARACTERISTIC D_n_Uth_MissingRspSwitchCANpath "counter upper threshold for missing responses after tx challenges" VALUE 0x218266 ZF_Parameter.ui8_S1_S3 255 UMR___1_1_0_S1_S3 0 255 /end CHARACTERISTIC
/begin CHARACTERISTIC D_t_Min_TASCASReq "minimal time in ews4 between init-fctn. and triggering TAS-CAS-request transmission" VALUE 0x21826A ZF_Parameter.ui8_S1_S3 2520 UMR_MBSE_MSEC__10_1_0_S1_S3 30 2550 /end CHARACTERISTIC
/begin CHARACTERISTIC D_n_Uth_cnt_TASCASReq "counter upper threshold for TAS-CAS-request-attempts" VALUE 0x218267 ZF_Parameter.ui8_S1_S3 255 UMR___1_1_0_S1_S3 0 255 /end CHARACTERISTIC
/begin CHARACTERISTIC D_t_Prevent_KFC_EWSDRVRQ "timer start-value to prevent err.entry KFC_EWSDRVRQ while timer active" VALUE 0x218258 ZF_Parameter.ui16_S1_S3 10000 UMR_MBSE_MSEC__10_1_0_S1_S3 0 10000 /end CHARACTERISTIC
/begin CHARACTERISTIC SWI_Auth_IgnOnWUPTo_AddCheck_KeyValidSts "switch to activate influence of KeyValidSts to elapsed tmr_Delay_KeyAuthWhileFACanFailure in authentication-condition" VALUE 0x21826B ZF_Parameter.ui8_S1_S3 1 UMR___1_1_0_S1_S3 0 1 /end CHARACTERISTIC
/begin CHARACTERISTIC D_t_TO_StoreCheckFSC "timer to check timeout from storing FSC to checkFSC-cmd" VALUE 0x218260 ZF_Parameter.ui16_S1_S3 655320 UMR_MBSE_MSEC__10_1_0_S1_S3 30 655350 /end CHARACTERISTIC
/begin CHARACTERISTIC D_n_Ab_AllowFSC_Uth "threshold drive/output rev.s for allowing FSC-operations" VALUE 0x218250 ZF_Parameter.ui16_S1_S3 65535 UMR___1_1_0_S1_S3 0 65535 /end CHARACTERISTIC
/begin CHARACTERISTIC D_t_P12BadOpDisp "flash time of park button bad operation" VALUE 0x207E10 ZF_Parameter.ui16_S1_S3 655350 UMR_MBSE_MSEC__10_1_0_S1_S3 0 655350 /end CHARACTERISTIC
/begin CHARACTERISTIC D_t_IgnOnNeverDetected "filter-time to distinguish wake-up impulse - ignition on" VALUE 0x207E12 ZF_Parameter.ui8_S1_S3 2550 UMR_MBSE_MSEC__10_1_0_S1_S3 0 2550 /end CHARACTERISTIC
/begin CHARACTERISTIC D_t_ModeReturnTip1 "Reload Time for ModeReturnTimer via Tip 1" VALUE 0x207E14 ZF_Parameter.ui16_S1_S3 655350 UMR_MBSE_MSEC__10_1_0_S1_S3 0 655350 /end CHARACTERISTIC
/begin CHARACTERISTIC D_t_ModeReturnTip2 "Reload Time for ModeReturnTimer via Tip 2" VALUE 0x207E16 ZF_Parameter.ui16_S1_S3 655350 UMR_MBSE_MSEC__10_1_0_S1_S3 0 655350 /end CHARACTERISTIC
/begin CHARACTERISTIC D_t_TipOn "pending time of tip signals (0=active as long as tip is pressed" VALUE 0x207E18 ZF_Parameter.ui8_S1_S3 2550 UMR_MBSE_MSEC__10_1_0_S1_S3 0 2550 /end CHARACTERISTIC
/begin CHARACTERISTIC SWI_ModeEnabledAFIX "Enable ModeRequest bit if AFIX (bit0 ... bit7)" VALUE 0x207E19 ZF_Parameter.ui8_S1_S3 255 UMR___1_1_0_S1_S3 0 255 /end CHARACTERISTIC
/begin CHARACTERISTIC SWI_StoreMode "Pos D Init Mode is last Mode if enabled (bit0=Sport bit1=Manual Normal bit2=Manual Sport) otherwise adaptive" VALUE 0x207E1A ZF_Parameter.ui8_S1_S3 7 UMR___1_1_0_S1_S3 0 7 /end CHARACTERISTIC
/begin CHARACTERISTIC D_t_PowDownDispP "time to display pos P for 30secs in EGS overshoot state Nachlauf" VALUE 0x207E20 ZF_Parameter.ui16_S1_S3 600000 UMR_MBSE_MSEC__10_1_0_S1_S3 0 600000 /end CHARACTERISTIC
/begin CHARACTERISTIC D_t_PowDownDispN "time to display pos N for 1min in EGS overshoot state Nachlauf if pos P not confirmed" VALUE 0x207E1E ZF_Parameter.ui16_S1_S3 600000 UMR_MBSE_MSEC__10_1_0_S1_S3 0 600000 /end CHARACTERISTIC
/begin CHARACTERISTIC D_t_PowDownDispRD "time to display pos RD in EGS overshoot state Nachlauf" VALUE 0x207E22 ZF_Parameter.ui16_S1_S3 600000 UMR_MBSE_MSEC__10_1_0_S1_S3 0 600000 /end CHARACTERISTIC
/begin CHARACTERISTIC D_t_PowDownDefault "time to power down in err.case when no valid display pos is displayed - EGS overshoot state Nachlauf" VALUE 0x207E1C ZF_Parameter.ui16_S1_S3 600000 UMR_MBSE_MSEC__10_1_0_S1_S3 0 600000 /end CHARACTERISTIC
/begin CHARACTERISTIC D_v_Shiftlock_Uth "speed threshold for deactivation shiftlock [PN-lock]" VALUE 0x207E2C ZF_Parameter.ui16_S1_S3 4095 UMR_VKMH__1_16_0_S1_S3 0 4095 /end CHARACTERISTIC
/begin CHARACTERISTIC D_n_EngShiftlockLth "threshold of engine rev.s for activation shiftlock" VALUE 0x207E2A ZF_Parameter.ui16_S1_S3 65535 UMR_RPM_1_1_0_S1_S3 0 65535 /end CHARACTERISTIC
/begin CHARACTERISTIC D_n_EngDiaShiftlock_Lth "engine rev.s threshold for shiftlock activation if request via CAN" VALUE 0x207E28 ZF_Parameter.ui16_S1_S3 10000 UMR_RPM_1_1_0_S1_S3 0 10000 /end CHARACTERISTIC
/begin CHARACTERISTIC SWI_Shiftlock_Disable "Bitmask to disable shiftlock" VALUE 0x207E24 ZF_Parameter.ui32_S1_S3 4.29497E+009 UMR___1_1_0_S1_S3 0 4294967295 /end CHARACTERISTIC
/begin CHARACTERISTIC D_v_AutoN_Uth "speed threshold of autom. engagement of N in case of error n_Eng" VALUE 0x21827C ZF_Parameter.ui16_S1_S3 4095 UMR_VKMH__1_16_0_S1_S3 0 4095 /end CHARACTERISTIC
/begin CHARACTERISTIC D_t_P12BadOp "debounce time of park button bad operation" VALUE 0x218297 ZF_Parameter.ui8_S1_S3 2550 UMR_MBSE_MSEC__10_1_0_S1_S3 0 2550 /end CHARACTERISTIC
/begin CHARACTERISTIC D_v_P12BadOpDisp "speed threshold of bad operation flashing" VALUE 0x218284 ZF_Parameter.ui16_S1_S3 4095 UMR_VKMH__1_16_0_S1_S3 0 4095 /end CHARACTERISTIC
/begin CHARACTERISTIC D_AcceleratorPedalAngleTh "Angle threshold for Accelerator Pedal" VALUE 0x21828E ZF_Parameter.ui8_S1_S3 100.4 UMR_HDK_M_1004_2550_S1_S3 0 100.4 /end CHARACTERISTIC
/begin CHARACTERISTIC D_c_TOilCCHot1_Th "Threshhold for oil temperature for 1st Hotmode CC-Msg" VALUE 0x218293 ZF_Parameter.ui8_S1_S3 215 UMR_CGT40__1_1_M40_S1_S3 -40 175 /end CHARACTERISTIC
/begin CHARACTERISTIC D_c_TOilCCHot2_Th "Threshhold for oil temperature for 2nd Hotmode CC-Msg" VALUE 0x218294 ZF_Parameter.ui8_S1_S3 215 UMR_CGT40__1_1_M40_S1_S3 -40 175 /end CHARACTERISTIC
/begin CHARACTERISTIC D_c_TOilCCHot3_Th "Threshhold for oil temperature for 3rd Hotmode CC-Msg" VALUE 0x218295 ZF_Parameter.ui8_S1_S3 215 UMR_CGT40__1_1_M40_S1_S3 -40 175 /end CHARACTERISTIC
/begin CHARACTERISTIC D_c_TChipCCHot1_Th "Threshhold for chip temperature for 1st Hotmode CC-Msg" VALUE 0x218290 ZF_Parameter.ui8_S1_S3 215 UMR_CGT40__1_1_M40_S1_S3 -40 175 /end CHARACTERISTIC
/begin CHARACTERISTIC D_c_TChipCCHot2_Th "Threshhold for chip temperature for 2nd Hotmode CC-Msg" VALUE 0x218291 ZF_Parameter.ui8_S1_S3 215 UMR_CGT40__1_1_M40_S1_S3 -40 175 /end CHARACTERISTIC
/begin CHARACTERISTIC D_c_TChipCCHot3_Th "Threshhold for chip temperature for 3rd Hotmode CC-Msg" VALUE 0x218292 ZF_Parameter.ui8_S1_S3 215 UMR_CGT40__1_1_M40_S1_S3 -40 175 /end CHARACTERISTIC
/begin CHARACTERISTIC D_c_CCHotHysOilChip_Th "Hysteresis value for oil and chip temperature Hotmode CC-Msg" VALUE 0x21828F ZF_Parameter.ui8_S1_S3 255 UMR___1_1_0_S1_S3 0 255 /end CHARACTERISTIC
/begin CHARACTERISTIC SWI_HotmodeOilChipStsActivation "switch for activating of Hotmode Levels if state of oil- and Chiptemperature is niO" VALUE 0x218299 ZF_Parameter.ui8_S1_S3 3 UMR___1_1_0_S1_S3 0 3 /end CHARACTERISTIC
/begin CHARACTERISTIC D_t_DebounceOilChipTransErr "Delay value for timer delaying Signal c_oilTransSts when niO" VALUE 0x218270 ZF_Parameter.ui16_S1_S3 655350 UMR_MBSE_MSEC__10_1_0_S1_S3 0 655350 /end CHARACTERISTIC
/begin CHARACTERISTIC D_v_P_Lth "Position P speed threshold" VALUE 0x218286 ZF_Parameter.ui16_S1_S3 4095 UMR_VKMH__1_16_0_S1_S3 0 4095 /end CHARACTERISTIC
/begin CHARACTERISTIC D_v_P_Uth "Upper speed threshold for driver request P" VALUE 0x218288 ZF_Parameter.ui16_S1_S3 4095 UMR_VKMH__1_16_0_S1_S3 0 4095 /end CHARACTERISTIC
/begin CHARACTERISTIC D_v_R_Lth "Lower speed threshold for driver request R" VALUE 0x21828A ZF_Parameter.ui16_S1_S3 4095 UMR_VKMH__1_16_0_S1_S3 0 4095 /end CHARACTERISTIC
/begin CHARACTERISTIC D_v_D_Lth "Lower speed threshold for driver request D" VALUE 0x21827E ZF_Parameter.ui16_S1_S3 4095 UMR_VKMH__1_16_0_S1_S3 0 4095 /end CHARACTERISTIC
/begin CHARACTERISTIC D_v_R_Uth "Position R upper speed threshold" VALUE 0x21828C ZF_Parameter.ui16_S1_S3 4095 UMR_VKMH__1_16_0_S1_S3 0 4095 /end CHARACTERISTIC
/begin CHARACTERISTIC D_v_D_Uth "Position D upper speed threshold" VALUE 0x218280 ZF_Parameter.ui16_S1_S3 4095 UMR_VKMH__1_16_0_S1_S3 0 4095 /end CHARACTERISTIC
/begin CHARACTERISTIC D_t_FlashN "Timer reload value for flash pos N if park lock not inserted in P" VALUE 0x218296 ZF_Parameter.ui8_S1_S3 2550 UMR_MBSE_MSEC__10_1_0_S1_S3 0 2550 /end CHARACTERISTIC
/begin CHARACTERISTIC SWI_E_GNER_Active "Switch for activation of the E-GNER Mode" VALUE 0x218298 ZF_Parameter.ui8_S1_S3 1 UMR___1_1_0_S1_S3 0 1 /end CHARACTERISTIC
/begin CHARACTERISTIC D_t_E_GNER_Precond "Max entry time for E-GNER Mode within the preconditions have to be true" VALUE 0x21827A ZF_Parameter.ui16_S1_S3 655350 UMR_MBSE_MSEC__10_1_0_S1_S3 0 655350 /end CHARACTERISTIC
/begin CHARACTERISTIC D_t_E_GNER_DebounceTime "Debounce time for E-GNER mode within the activation conditions have to be true" VALUE 0x218274 ZF_Parameter.ui16_S1_S3 655350 UMR_MBSE_MSEC__10_1_0_S1_S3 0 655350 /end CHARACTERISTIC
/begin CHARACTERISTIC D_t_E_GNER_ActiveTime "Active time for E-EGNER mode within the active flag for ATSYS is set" VALUE 0x218272 ZF_Parameter.ui16_S1_S3 655350 UMR_MBSE_MSEC__10_1_0_S1_S3 0 655350 /end CHARACTERISTIC
/begin CHARACTERISTIC D_t_E_GNER_Misuse "maximum time for E-GNER misuse" VALUE 0x218276 ZF_Parameter.ui16_S1_S3 655350 UMR_MBSE_MSEC__10_1_0_S1_S3 0 655350 /end CHARACTERISTIC
/begin CHARACTERISTIC D_t_E_GNER_PosRequestStoreTime "maximum time for E-GNER misuse" VALUE 0x218278 ZF_Parameter.ui16_S1_S3 655350 UMR_MBSE_MSEC__10_1_0_S1_S3 0 655350 /end CHARACTERISTIC
/begin CHARACTERISTIC D_v_E_GNER_Misuse "speed threshold for E-GNER Misuse" VALUE 0x218282 ZF_Parameter.ui16_S1_S3 4095 UMR_VKMH__1_16_0_S1_S3 0 4095 /end CHARACTERISTIC
/begin CHARACTERISTIC D_n_EngEGNER_Off "Maximum engine rpm to terminate the e-GNER function if engine starts" VALUE 0x21826E ZF_Parameter.ui16_S1_S3 65535 UMR_RPM_1_1_0_S1_S3 0 65535 /end CHARACTERISTIC
/begin CHARACTERISTIC SWI_KL15_PinPlausiOn "Switch for ignition on substitute signal because of SAB plausibilisation" VALUE 0x21829B ZF_Parameter.ui8_S1_S3 1 UMR___1_1_0_S1_S3 0 1 /end CHARACTERISTIC
/begin CHARACTERISTIC SWI_IgnoreLeverActionAfterPPressed "ignore R/N/D lever actions while P button is pressed until button is released" VALUE 0x21829A ZF_Parameter.ui8_S1_S3 1 UMR___1_1_0_S1_S3 0 1 /end CHARACTERISTIC
/begin MEASUREMENT ZFFSAB._.CDD_IEP_Control.tmr_DiagDelayAfterClearErr.time "Description for this variable only in SW documentation possible not in asap2" UBYTE SAB_T_TIMER_10MS_S2_S3 1 100 0 2550 DISPLAY_IDENTIFIER time.tmr_DiagDelayAfterClearErr.CDD_IEP_Control._.ZFFSAB ECU_ADDRESS 0xFFF8F4F4 /end MEASUREMENT
/begin MEASUREMENT ZFFSAB._.CDD_IEP_Control.tmr_DelayAfterIepWarmUpErr.time "Description for this variable only in SW documentation possible not in asap2" ULONG SAB_T_TIMER_10MS_S2_S3 1 100 0 42949672950 DISPLAY_IDENTIFIER time.tmr_DelayAfterIepWarmUpErr.CDD_IEP_Control._.ZFFSAB ECU_ADDRESS 0xFFF8F4F8 /end MEASUREMENT
/begin MEASUREMENT ZFFSAB._.CDD_IEP_Control.tmr_DelayKfcIepBus.time "Description for this variable only in SW documentation possible not in asap2" UBYTE SAB_T_TIMER_10MS_S2_S3 1 100 0 2550 DISPLAY_IDENTIFIER time.tmr_DelayKfcIepBus.CDD_IEP_Control._.ZFFSAB ECU_ADDRESS 0xFFF8F4FC /end MEASUREMENT
/begin MEASUREMENT ZFFSAB._.CDD_GearboxState.tmr_HssOff.time "Description for this variable only in SW documentation possible not in asap2" ULONG SAB_T_TIMER_10MS_S2_S3 1 100 0 42949672950 DISPLAY_IDENTIFIER time.tmr_HssOff.CDD_GearboxState._.ZFFSAB ECU_ADDRESS 0xFFF8F5B4 /end MEASUREMENT
/begin MEASUREMENT ZFFSAB._.CDD_GearboxState.tmr_HssOff.time_ "Description for this variable only in SW documentation possible not in asap2" ULONG SAB_T_TIMER_10MS_S2_S3 1 100 0 42949672950 DISPLAY_IDENTIFIER time_.tmr_HssOff.CDD_GearboxState._.ZFFSAB ECU_ADDRESS 0xFFF8F5B8 /end MEASUREMENT
/begin MEASUREMENT ZFFSAB._.CDD_GearboxState.tmr_GetFet0Undervoltage.time "Description for this variable only in SW documentation possible not in asap2" ULONG SAB_T_TIMER_10MS_S2_S3 1 100 0 42949672950 DISPLAY_IDENTIFIER time.tmr_GetFet0Undervoltage.CDD_GearboxState._.ZFFSAB ECU_ADDRESS 0xFFF8F5BC /end MEASUREMENT
/begin MEASUREMENT ZFFSAB._.CDD_GearboxState.tmr_GetFet0Undervoltage.time_ "Description for this variable only in SW documentation possible not in asap2" ULONG SAB_T_TIMER_10MS_S2_S3 1 100 0 42949672950 DISPLAY_IDENTIFIER time_.tmr_GetFet0Undervoltage.CDD_GearboxState._.ZFFSAB ECU_ADDRESS 0xFFF8F5C0 /end MEASUREMENT
/begin MEASUREMENT ZFFSAB._.CDD_GearboxState.tmr_ZeroCurrentFeed.time "Description for this variable only in SW documentation possible not in asap2" ULONG SAB_T_TIMER_10MS_S2_S3 1 100 0 42949672950 DISPLAY_IDENTIFIER time.tmr_ZeroCurrentFeed.CDD_GearboxState._.ZFFSAB ECU_ADDRESS 0xFFF8F5C4 /end MEASUREMENT
/begin MEASUREMENT ZFFSAB._.CDD_GearboxState.tmr_ZeroCurrentFeed.time_ "Description for this variable only in SW documentation possible not in asap2" ULONG SAB_T_TIMER_10MS_S2_S3 1 100 0 42949672950 DISPLAY_IDENTIFIER time_.tmr_ZeroCurrentFeed.CDD_GearboxState._.ZFFSAB ECU_ADDRESS 0xFFF8F5C8 /end MEASUREMENT
/begin MEASUREMENT ZFFSAB._.RPM_SensingIn.Ab.t_n_Offset.time "Description for this variable only in SW documentation possible not in asap2" ULONG SAB_T_TIMER_10MS_S2_S3 1 100 0 42949672950 DISPLAY_IDENTIFIER time.t_n_Offset.Ab.RPM_SensingIn._.ZFFSAB ECU_ADDRESS 0xFFF8F634 /end MEASUREMENT
/begin MEASUREMENT ZFFSAB._.RPM_SensingIn.Ab.t_n_Offset.time_ "Description for this variable only in SW documentation possible not in asap2" ULONG SAB_T_TIMER_10MS_S2_S3 1 100 0 42949672950 DISPLAY_IDENTIFIER time_.t_n_Offset.Ab.RPM_SensingIn._.ZFFSAB ECU_ADDRESS 0xFFF8F638 /end MEASUREMENT
/begin MEASUREMENT ZFFSAB._.RPM_SensingIn.Ab.St_RPMSensing "current state of tooth sensing.St_RESET_OR_RUNUP = 0 St_STANDSTILL = 1 St_ONE_TOOTH_RISING_RPM = 2 St_ONE_TOOTH_FALLING_RPM = 3 St_NORMAL_DRIVE 4" UBYTE SAB_STANDARD_S2_S3 1 100 0 255 DISPLAY_IDENTIFIER St_RPMSensing.Ab.RPM_SensingIn._.ZFFSAB ECU_ADDRESS 0xFFF8F60C /end MEASUREMENT
/begin MEASUREMENT ZFFSAB._.RPM_SensingIn.Ab.cnt_total_teeth "Number of the trigger-wheels teeth" UBYTE SAB_STANDARD_S2_S3 1 100 0 255 DISPLAY_IDENTIFIER cnt_total_teeth.Ab.RPM_SensingIn._.ZFFSAB ECU_ADDRESS 0xFFF8F60D /end MEASUREMENT
/begin MEASUREMENT ZFFSAB._.RPM_SensingIn.Ab.k_nenner "Part of potential factor e.g. for a fix transmission" UWORD SAB_STANDARD_S2_S3 1 100 0 65535 DISPLAY_IDENTIFIER k_nenner.Ab.RPM_SensingIn._.ZFFSAB ECU_ADDRESS 0xFFF8F60E /end MEASUREMENT
/begin MEASUREMENT ZFFSAB._.RPM_SensingIn.Ab.k_zaehler "Part of potential factor e.g. for a fix transmission" UWORD SAB_STANDARD_S2_S3 1 100 0 65535 DISPLAY_IDENTIFIER k_zaehler.Ab.RPM_SensingIn._.ZFFSAB ECU_ADDRESS 0xFFF8F610 /end MEASUREMENT
/begin MEASUREMENT ZFFSAB._.RPM_SensingIn.Ab.n_RPM_min "Minimum detectable RPM (under this value a zero will be provided)" UWORD SAB_N_1RPM_S2_S3 1 100 0 65535 DISPLAY_IDENTIFIER n_RPM_min.Ab.RPM_SensingIn._.ZFFSAB ECU_ADDRESS 0xFFF8F612 /end MEASUREMENT
/begin MEASUREMENT ZFFSAB._.RPM_SensingIn.Ab.iv_t_Pulses "Input variable for exact time needed for counting iv_n_Pulses" ULONG SAB_T_TIMER_1US_S2_S3 1 100 0 4294967295 DISPLAY_IDENTIFIER iv_t_Pulses.Ab.RPM_SensingIn._.ZFFSAB ECU_ADDRESS 0xFFF8F614 /end MEASUREMENT
/begin MEASUREMENT ZFFSAB._.RPM_SensingIn.Ab.iv_n_Pulses "Input variable for number of pulses detected during iv_t_Pulses" UBYTE SAB_STANDARD_S2_S3 1 100 0 255 DISPLAY_IDENTIFIER iv_n_Pulses.Ab.RPM_SensingIn._.ZFFSAB ECU_ADDRESS 0xFFF8F618 /end MEASUREMENT
/begin MEASUREMENT ZFFSAB._.RPM_SensingIn.Ab.iv_t_Pulses_old "Input variable for last valid iv_t_Pulses needed for virtual RPMs" ULONG SAB_STANDARD_S2_S3 1 100 0 4294967295 DISPLAY_IDENTIFIER iv_t_Pulses_old.Ab.RPM_SensingIn._.ZFFSAB ECU_ADDRESS 0xFFF8F61C /end MEASUREMENT
/begin MEASUREMENT ZFFSAB._.RPM_SensingIn.Ab.iv_f_Diag "Input flag shows if a diagnosis is possible or not" UBYTE SAB_STANDARD_S2_S3 1 100 0 1 DISPLAY_IDENTIFIER iv_f_Diag.Ab.RPM_SensingIn._.ZFFSAB ECU_ADDRESS 0xFFF8F620 /end MEASUREMENT
/begin MEASUREMENT ZFFSAB._.RPM_SensingIn.Ab.iv_ESts "Input variable for RPM-sensor electrical status" UBYTE SAB_STANDARD_S2_S3 1 100 0 255 DISPLAY_IDENTIFIER iv_ESts.Ab.RPM_SensingIn._.ZFFSAB ECU_ADDRESS 0xFFF8F621 /end MEASUREMENT
/begin MEASUREMENT ZFFSAB._.RPM_SensingIn.Ab.iv_PulseWidth "Input variable for direction detection pulsewidth" UBYTE SAB_T_TIMER_1US_S2_S3 1 100 0 255 DISPLAY_IDENTIFIER iv_PulseWidth.Ab.RPM_SensingIn._.ZFFSAB ECU_ADDRESS 0xFFF8F622 /end MEASUREMENT
/begin MEASUREMENT ZFFSAB._.RPM_SensingIn.Ab.n_RPM "Intermediate RPM (not yet usable for reliable RPM Sensing!)" UWORD SAB_N_1RPM_S2_S3 1 100 0 65535 DISPLAY_IDENTIFIER n_RPM.Ab.RPM_SensingIn._.ZFFSAB ECU_ADDRESS 0xFFF8F624 /end MEASUREMENT
/begin MEASUREMENT ZFFSAB._.RPM_SensingIn.Ab.n_RPM_Old "Old RPM from last task" UWORD SAB_N_1RPM_S2_S3 1 100 0 65535 DISPLAY_IDENTIFIER n_RPM_Old.Ab.RPM_SensingIn._.ZFFSAB ECU_ADDRESS 0xFFF8F626 /end MEASUREMENT
/begin MEASUREMENT ZFFSAB._.RPM_SensingIn.Ab.n_Sts "Electrical status of RPM sensor" UBYTE SAB_STANDARD_S2_S3 1 100 0 255 DISPLAY_IDENTIFIER n_Sts.Ab.RPM_SensingIn._.ZFFSAB ECU_ADDRESS 0xFFF8F628 /end MEASUREMENT
/begin MEASUREMENT ZFFSAB._.RPM_SensingIn.Ab.n_Offset "Fix RPM-offset (not appliable in car)" UBYTE SAB_N_1RPM_S2_S3 1 100 0 255 DISPLAY_IDENTIFIER n_Offset.Ab.RPM_SensingIn._.ZFFSAB ECU_ADDRESS 0xFFF8F629 /end MEASUREMENT
/begin MEASUREMENT ZFFSAB._.RPM_SensingIn.Ab.f_FirstVirtualCalc "Internal flag to detect first virtual calculation" UBYTE SAB_STANDARD_S2_S3 1 100 0 1 DISPLAY_IDENTIFIER f_FirstVirtualCalc.Ab.RPM_SensingIn._.ZFFSAB ECU_ADDRESS 0xFFF8F62A /end MEASUREMENT
/begin MEASUREMENT ZFFSAB._.RPM_SensingIn.Ab.f_NeverOnePulse "Internal flag to detect if no pulse was detected during last task and until now" UBYTE SAB_STANDARD_S2_S3 1 100 0 1 DISPLAY_IDENTIFIER f_NeverOnePulse.Ab.RPM_SensingIn._.ZFFSAB ECU_ADDRESS 0xFFF8F62B /end MEASUREMENT
/begin MEASUREMENT ZFFSAB._.RPM_SensingIn.Ab.sts_Direction "Intermediate value of direction" UBYTE SAB_STANDARD_S2_S3 1 100 0 255 DISPLAY_IDENTIFIER sts_Direction.Ab.RPM_SensingIn._.ZFFSAB ECU_ADDRESS 0xFFF8F62C /end MEASUREMENT
/begin MEASUREMENT ZFFSAB._.RPM_SensingIn.Ab.sts_DirectionDiag "diag-information of the direction-detection" UBYTE SAB_STANDARD_S2_S3 1 100 0 5 DISPLAY_IDENTIFIER sts_DirectionDiag.Ab.RPM_SensingIn._.ZFFSAB ECU_ADDRESS 0xFFF8F62D /end MEASUREMENT
/begin MEASUREMENT ZFFSAB._.RPM_SensingIn.Ab.frq_SpeedSensor "Frequency of the speed-sensor" UWORD SAB_FRQ_1HZ_S2_S3 1 100 0 65535 DISPLAY_IDENTIFIER frq_SpeedSensor.Ab.RPM_SensingIn._.ZFFSAB ECU_ADDRESS 0xFFF8F62E /end MEASUREMENT
/begin MEASUREMENT ZFFSAB._.RPM_SensingIn.Ab.sv_n_RPM "Output RPM" UWORD SAB_N_1RPM_S2_S3 1 100 0 65535 DISPLAY_IDENTIFIER sv_n_RPM.Ab.RPM_SensingIn._.ZFFSAB ECU_ADDRESS 0xFFF8F630 /end MEASUREMENT
/begin MEASUREMENT ZFFSAB._.RPM_SensingIn.Ab.sv_n_Sts "Electrical status of the RPM sensor" UBYTE SAB_STANDARD_S2_S3 1 100 0 255 DISPLAY_IDENTIFIER sv_n_Sts.Ab.RPM_SensingIn._.ZFFSAB ECU_ADDRESS 0xFFF8F632 /end MEASUREMENT
/begin MEASUREMENT ZFFSAB._.RPM_SensingIn.Ab.sv_sts_Direction "Direction (FORWARD=forward BACKWARD=backward)" UBYTE SAB_STANDARD_S2_S3 1 100 0 255 DISPLAY_IDENTIFIER sv_sts_Direction.Ab.RPM_SensingIn._.ZFFSAB ECU_ADDRESS 0xFFF8F633 /end MEASUREMENT
/begin MEASUREMENT ZFFSAB._.RPM_SensingIn.Tu.t_n_Offset.time "Description for this variable only in SW documentation possible not in asap2" ULONG SAB_T_TIMER_10MS_S2_S3 1 100 0 42949672950 DISPLAY_IDENTIFIER time.t_n_Offset.Tu.RPM_SensingIn._.ZFFSAB ECU_ADDRESS 0xFFF8F664 /end MEASUREMENT
/begin MEASUREMENT ZFFSAB._.RPM_SensingIn.Tu.t_n_Offset.time_ "Description for this variable only in SW documentation possible not in asap2" ULONG SAB_T_TIMER_10MS_S2_S3 1 100 0 42949672950 DISPLAY_IDENTIFIER time_.t_n_Offset.Tu.RPM_SensingIn._.ZFFSAB ECU_ADDRESS 0xFFF8F668 /end MEASUREMENT
/begin MEASUREMENT ZFFSAB._.RPM_SensingIn.Tu.St_RPMSensing "current state of tooth sensing.St_RESET_OR_RUNUP = 0 St_STANDSTILL = 1 St_ONE_TOOTH_RISING_RPM = 2 St_ONE_TOOTH_FALLING_RPM = 3 St_NORMAL_DRIVE 4" UBYTE SAB_STANDARD_S2_S3 1 100 0 255 DISPLAY_IDENTIFIER St_RPMSensing.Tu.RPM_SensingIn._.ZFFSAB ECU_ADDRESS 0xFFF8F63C /end MEASUREMENT
/begin MEASUREMENT ZFFSAB._.RPM_SensingIn.Tu.cnt_total_teeth "Number of the trigger-wheels teeth" UBYTE SAB_STANDARD_S2_S3 1 100 0 255 DISPLAY_IDENTIFIER cnt_total_teeth.Tu.RPM_SensingIn._.ZFFSAB ECU_ADDRESS 0xFFF8F63D /end MEASUREMENT
/begin MEASUREMENT ZFFSAB._.RPM_SensingIn.Tu.k_nenner "Part of potential factor e.g. for a fix transmission" UWORD SAB_STANDARD_S2_S3 1 100 0 65535 DISPLAY_IDENTIFIER k_nenner.Tu.RPM_SensingIn._.ZFFSAB ECU_ADDRESS 0xFFF8F63E /end MEASUREMENT
/begin MEASUREMENT ZFFSAB._.RPM_SensingIn.Tu.k_zaehler "Part of potential factor e.g. for a fix transmission" UWORD SAB_STANDARD_S2_S3 1 100 0 65535 DISPLAY_IDENTIFIER k_zaehler.Tu.RPM_SensingIn._.ZFFSAB ECU_ADDRESS 0xFFF8F640 /end MEASUREMENT
/begin MEASUREMENT ZFFSAB._.RPM_SensingIn.Tu.n_RPM_min "Minimum detectable RPM (under this value a zero will be provided)" UWORD SAB_N_1RPM_S2_S3 1 100 0 65535 DISPLAY_IDENTIFIER n_RPM_min.Tu.RPM_SensingIn._.ZFFSAB ECU_ADDRESS 0xFFF8F642 /end MEASUREMENT
/begin MEASUREMENT ZFFSAB._.RPM_SensingIn.Tu.iv_t_Pulses "Input variable for exact time needed for counting iv_n_Pulses" ULONG SAB_T_TIMER_1US_S2_S3 1 100 0 4294967295 DISPLAY_IDENTIFIER iv_t_Pulses.Tu.RPM_SensingIn._.ZFFSAB ECU_ADDRESS 0xFFF8F644 /end MEASUREMENT
/begin MEASUREMENT ZFFSAB._.RPM_SensingIn.Tu.iv_n_Pulses "Input variable for number of pulses detected during iv_t_Pulses" UBYTE SAB_STANDARD_S2_S3 1 100 0 255 DISPLAY_IDENTIFIER iv_n_Pulses.Tu.RPM_SensingIn._.ZFFSAB ECU_ADDRESS 0xFFF8F648 /end MEASUREMENT
/begin MEASUREMENT ZFFSAB._.RPM_SensingIn.Tu.iv_t_Pulses_old "Input variable for last valid iv_t_Pulses needed for virtual RPMs" ULONG SAB_STANDARD_S2_S3 1 100 0 4294967295 DISPLAY_IDENTIFIER iv_t_Pulses_old.Tu.RPM_SensingIn._.ZFFSAB ECU_ADDRESS 0xFFF8F64C /end MEASUREMENT
/begin MEASUREMENT ZFFSAB._.RPM_SensingIn.Tu.iv_f_Diag "Input flag shows if a diagnosis is possible or not" UBYTE SAB_STANDARD_S2_S3 1 100 0 1 DISPLAY_IDENTIFIER iv_f_Diag.Tu.RPM_SensingIn._.ZFFSAB ECU_ADDRESS 0xFFF8F650 /end MEASUREMENT
/begin MEASUREMENT ZFFSAB._.RPM_SensingIn.Tu.iv_ESts "Input variable for RPM-sensor electrical status" UBYTE SAB_STANDARD_S2_S3 1 100 0 255 DISPLAY_IDENTIFIER iv_ESts.Tu.RPM_SensingIn._.ZFFSAB ECU_ADDRESS 0xFFF8F651 /end MEASUREMENT
/begin MEASUREMENT ZFFSAB._.RPM_SensingIn.Tu.iv_PulseWidth "Input variable for direction detection pulsewidth" UBYTE SAB_T_TIMER_1US_S2_S3 1 100 0 255 DISPLAY_IDENTIFIER iv_PulseWidth.Tu.RPM_SensingIn._.ZFFSAB ECU_ADDRESS 0xFFF8F652 /end MEASUREMENT
/begin MEASUREMENT ZFFSAB._.RPM_SensingIn.Tu.n_RPM "Intermediate RPM (not yet usable for reliable RPM Sensing!)" UWORD SAB_N_1RPM_S2_S3 1 100 0 65535 DISPLAY_IDENTIFIER n_RPM.Tu.RPM_SensingIn._.ZFFSAB ECU_ADDRESS 0xFFF8F654 /end MEASUREMENT
/begin MEASUREMENT ZFFSAB._.RPM_SensingIn.Tu.n_RPM_Old "Old RPM from last task" UWORD SAB_N_1RPM_S2_S3 1 100 0 65535 DISPLAY_IDENTIFIER n_RPM_Old.Tu.RPM_SensingIn._.ZFFSAB ECU_ADDRESS 0xFFF8F656 /end MEASUREMENT
/begin MEASUREMENT ZFFSAB._.RPM_SensingIn.Tu.n_Sts "Electrical status of RPM sensor" UBYTE SAB_STANDARD_S2_S3 1 100 0 255 DISPLAY_IDENTIFIER n_Sts.Tu.RPM_SensingIn._.ZFFSAB ECU_ADDRESS 0xFFF8F658 /end MEASUREMENT
/begin MEASUREMENT ZFFSAB._.RPM_SensingIn.Tu.n_Offset "Fix RPM-offset (not appliable in car)" UBYTE SAB_N_1RPM_S2_S3 1 100 0 255 DISPLAY_IDENTIFIER n_Offset.Tu.RPM_SensingIn._.ZFFSAB ECU_ADDRESS 0xFFF8F659 /end MEASUREMENT
/begin MEASUREMENT ZFFSAB._.RPM_SensingIn.Tu.f_FirstVirtualCalc "Internal flag to detect first virtual calculation" UBYTE SAB_STANDARD_S2_S3 1 100 0 1 DISPLAY_IDENTIFIER f_FirstVirtualCalc.Tu.RPM_SensingIn._.ZFFSAB ECU_ADDRESS 0xFFF8F65A /end MEASUREMENT
/begin MEASUREMENT ZFFSAB._.RPM_SensingIn.Tu.f_NeverOnePulse "Internal flag to detect if no pulse was detected during last task and until now" UBYTE SAB_STANDARD_S2_S3 1 100 0 1 DISPLAY_IDENTIFIER f_NeverOnePulse.Tu.RPM_SensingIn._.ZFFSAB ECU_ADDRESS 0xFFF8F65B /end MEASUREMENT
/begin MEASUREMENT ZFFSAB._.RPM_SensingIn.Tu.sts_Direction "Intermediate value of direction" UBYTE SAB_STANDARD_S2_S3 1 100 0 255 DISPLAY_IDENTIFIER sts_Direction.Tu.RPM_SensingIn._.ZFFSAB ECU_ADDRESS 0xFFF8F65C /end MEASUREMENT
/begin MEASUREMENT ZFFSAB._.RPM_SensingIn.Tu.sts_DirectionDiag "diag-information of the direction-detection" UBYTE SAB_STANDARD_S2_S3 1 100 0 5 DISPLAY_IDENTIFIER sts_DirectionDiag.Tu.RPM_SensingIn._.ZFFSAB ECU_ADDRESS 0xFFF8F65D /end MEASUREMENT
/begin MEASUREMENT ZFFSAB._.RPM_SensingIn.Tu.frq_SpeedSensor "Frequency of the speed-sensor" UWORD SAB_FRQ_1HZ_S2_S3 1 100 0 65535 DISPLAY_IDENTIFIER frq_SpeedSensor.Tu.RPM_SensingIn._.ZFFSAB ECU_ADDRESS 0xFFF8F65E /end MEASUREMENT
/begin MEASUREMENT ZFFSAB._.RPM_SensingIn.Tu.sv_n_RPM "Output RPM" UWORD SAB_N_1RPM_S2_S3 1 100 0 65535 DISPLAY_IDENTIFIER sv_n_RPM.Tu.RPM_SensingIn._.ZFFSAB ECU_ADDRESS 0xFFF8F660 /end MEASUREMENT
/begin MEASUREMENT ZFFSAB._.RPM_SensingIn.Tu.sv_n_Sts "Electrical status of the RPM sensor" UBYTE SAB_STANDARD_S2_S3 1 100 0 255 DISPLAY_IDENTIFIER sv_n_Sts.Tu.RPM_SensingIn._.ZFFSAB ECU_ADDRESS 0xFFF8F662 /end MEASUREMENT
/begin MEASUREMENT ZFFSAB._.RPM_SensingIn.Tu.sv_sts_Direction "Direction (FORWARD=forward BACKWARD=backward)" UBYTE SAB_STANDARD_S2_S3 1 100 0 255 DISPLAY_IDENTIFIER sv_sts_Direction.Tu.RPM_SensingIn._.ZFFSAB ECU_ADDRESS 0xFFF8F663 /end MEASUREMENT
/begin MEASUREMENT ZFFSAB._.RPM_SensingIn.iv_Pos "position" UBYTE SAB_STANDARD_S2_S3 1 100 0 4 DISPLAY_IDENTIFIER iv_Pos.RPM_SensingIn._.ZFFSAB ECU_ADDRESS 0xFFF8F608 /end MEASUREMENT
/begin MEASUREMENT ZFFSAB._.RPM_SensingIn.iv_PosSts "status of POS" UBYTE SAB_STANDARD_S2_S3 1 100 0 1 DISPLAY_IDENTIFIER iv_PosSts.RPM_SensingIn._.ZFFSAB ECU_ADDRESS 0xFFF8F609 /end MEASUREMENT
/begin MEASUREMENT ZFFSAB._.RPM_SensingIn.sv_n6Direction "Direction (FORWARD=forward BACKWARD=backward)" UBYTE SAB_STANDARD_S2_S3 1 100 0 2 DISPLAY_IDENTIFIER sv_n6Direction.RPM_SensingIn._.ZFFSAB ECU_ADDRESS 0xFFF8F60A /end MEASUREMENT
/begin MEASUREMENT ZFFSAB._.RPM_SensingIn.f_first_init "flag to determine if the Init-method has already been called 0 = first call 1 = second or later call" UBYTE SAB_STANDARD_S2_S3 1 100 0 1 DISPLAY_IDENTIFIER f_first_init.RPM_SensingIn._.ZFFSAB ECU_ADDRESS 0xFFF8F60B /end MEASUREMENT
/begin MEASUREMENT ZFFSAB._.TurbineSpeedVirtualIn.tmr_VerschachtelungAktiv_ntOpt.time "Description for this variable only in SW documentation possible not in asap2" ULONG SAB_T_TIMER_10MS_S2_S3 1 100 0 42949672950 DISPLAY_IDENTIFIER time.tmr_VerschachtelungAktiv_ntOpt.TurbineSpeedVirtualIn._.ZFFSAB ECU_ADDRESS 0xFFF8F680 /end MEASUREMENT
/begin MEASUREMENT ZFFSAB._.TurbineSpeedVirtualIn.tmr_VerschachtelungAktiv_ntOpt.time_ "Description for this variable only in SW documentation possible not in asap2" ULONG SAB_T_TIMER_10MS_S2_S3 1 100 0 42949672950 DISPLAY_IDENTIFIER time_.tmr_VerschachtelungAktiv_ntOpt.TurbineSpeedVirtualIn._.ZFFSAB ECU_ADDRESS 0xFFF8F684 /end MEASUREMENT
/begin MEASUREMENT ZFFSAB._.HybridVehicleReadyToDriveIn.tmr_holdStateVehicleReadyToDrive.time "Description for this variable only in SW documentation possible not in asap2" UWORD SAB_T_TIMER_10MS_S2_S3 1 100 0 655350 DISPLAY_IDENTIFIER time.tmr_holdStateVehicleReadyToDrive.HybridVehicleReadyToDriveIn._.ZFFSAB ECU_ADDRESS 0xFFF8F784 /end MEASUREMENT
/begin MEASUREMENT ZFFSAB._.HybridVehicleReadyToDriveIn.tmr_ToStartVM.time "Description for this variable only in SW documentation possible not in asap2" UBYTE SAB_T_TIMER_10MS_S2_S3 1 100 0 2550 DISPLAY_IDENTIFIER time.tmr_ToStartVM.HybridVehicleReadyToDriveIn._.ZFFSAB ECU_ADDRESS 0xFFF8F786 /end MEASUREMENT
/begin MEASUREMENT ZFFSAB._.Interfo.f_erase_infomemory "if set the internal info memory will be erased" UBYTE SAB_STANDARD_S2_S3 1 100 0 1 DISPLAY_IDENTIFIER f_erase_infomemory.Interfo._.ZFFSAB ECU_ADDRESS 0xFFF90092 /end MEASUREMENT
/begin MEASUREMENT ZFFSAB._.Interfo.arg_idx "0x00 means reference page and 0x01 means working page" UBYTE SAB_STANDARD_S2_S3 1 100 0 1 DISPLAY_IDENTIFIER arg_idx.Interfo._.ZFFSAB ECU_ADDRESS 0xFFF90093 /end MEASUREMENT
/begin MEASUREMENT ZFFSAB._.Interfo.arg_idx_komp "0xFF means reference page and 0xFE means working page" UBYTE SAB_STANDARD_S2_S3 1 100 0 255 DISPLAY_IDENTIFIER arg_idx_komp.Interfo._.ZFFSAB ECU_ADDRESS 0xFFF90094 /end MEASUREMENT
/begin MEASUREMENT ZFFSAB._.CDD_GearboxStateFl.tmr_HssOff.time "Description for this variable only in SW documentation possible not in asap2" ULONG SAB_T_TIMER_10MS_S2_S3 1 100 0 42949672950 DISPLAY_IDENTIFIER time.tmr_HssOff.CDD_GearboxStateFl._.ZFFSAB ECU_ADDRESS 0xFFF8F79C /end MEASUREMENT
/begin MEASUREMENT ZFFSAB._.CDD_GearboxStateFl.tmr_HssOff.time_ "Description for this variable only in SW documentation possible not in asap2" ULONG SAB_T_TIMER_10MS_S2_S3 1 100 0 42949672950 DISPLAY_IDENTIFIER time_.tmr_HssOff.CDD_GearboxStateFl._.ZFFSAB ECU_ADDRESS 0xFFF8F7A0 /end MEASUREMENT
/begin MEASUREMENT ZFFSAB._.CDD_GearboxStateFl.tmr_GetFet0Undervoltage.time "Description for this variable only in SW documentation possible not in asap2" ULONG SAB_T_TIMER_10MS_S2_S3 1 100 0 42949672950 DISPLAY_IDENTIFIER time.tmr_GetFet0Undervoltage.CDD_GearboxStateFl._.ZFFSAB ECU_ADDRESS 0xFFF8F7A4 /end MEASUREMENT
/begin MEASUREMENT ZFFSAB._.CDD_GearboxStateFl.tmr_GetFet0Undervoltage.time_ "Description for this variable only in SW documentation possible not in asap2" ULONG SAB_T_TIMER_10MS_S2_S3 1 100 0 42949672950 DISPLAY_IDENTIFIER time_.tmr_GetFet0Undervoltage.CDD_GearboxStateFl._.ZFFSAB ECU_ADDRESS 0xFFF8F7A8 /end MEASUREMENT
/begin MEASUREMENT ZFFSAB._.CDD_GearboxStateFl.tmr_ZeroCurrentFeed.time "Description for this variable only in SW documentation possible not in asap2" ULONG SAB_T_TIMER_10MS_S2_S3 1 100 0 42949672950 DISPLAY_IDENTIFIER time.tmr_ZeroCurrentFeed.CDD_GearboxStateFl._.ZFFSAB ECU_ADDRESS 0xFFF8F7AC /end MEASUREMENT
/begin MEASUREMENT ZFFSAB._.CDD_GearboxStateFl.tmr_ZeroCurrentFeed.time_ "Description for this variable only in SW documentation possible not in asap2" ULONG SAB_T_TIMER_10MS_S2_S3 1 100 0 42949672950 DISPLAY_IDENTIFIER time_.tmr_ZeroCurrentFeed.CDD_GearboxStateFl._.ZFFSAB ECU_ADDRESS 0xFFF8F7B0 /end MEASUREMENT
/begin MEASUREMENT ZFFSAB._.ASCPasIn.iv_ASCPas "Input value ASC passive indication from CAN" UWORD SAB_STANDARD_S2_S3 1 100 0 4095 DISPLAY_IDENTIFIER iv_ASCPas.ASCPasIn._.ZFFSAB ECU_ADDRESS 0xFFF8F84C /end MEASUREMENT
/begin MEASUREMENT ZFFSAB._.ASCPasIn.iv_ASCPas_ "Input value of complementary ASC passive indication from CAN" UWORD SAB_STANDARD_S2_S3 1 100 0 65535 DISPLAY_IDENTIFIER iv_ASCPas_.ASCPasIn._.ZFFSAB ECU_ADDRESS 0xFFF8F84E /end MEASUREMENT
/begin MEASUREMENT ZFFSAB._.ASCPasIn.iv_ASCPasSts "Input value message status of PAS control state" UBYTE SAB_STANDARD_S2_S3 1 100 0 255 DISPLAY_IDENTIFIER iv_ASCPasSts.ASCPasIn._.ZFFSAB ECU_ADDRESS 0xFFF8F850 /end MEASUREMENT
/begin MEASUREMENT ZFFSAB._.ASCPasIn.iv_ASCPasSts_ "Input value message status of PAS control state" UBYTE SAB_STANDARD_S2_S3 1 100 0 255 DISPLAY_IDENTIFIER iv_ASCPasSts_.ASCPasIn._.ZFFSAB ECU_ADDRESS 0xFFF8F851 /end MEASUREMENT
/begin MEASUREMENT ZFFSAB._.ASCPasIn.sv_ASCPasSts "Output value signal status of ASC passive indication" UBYTE SAB_STANDARD_S2_S3 1 100 0 2 DISPLAY_IDENTIFIER sv_ASCPasSts.ASCPasIn._.ZFFSAB ECU_ADDRESS 0xFFF8F852 /end MEASUREMENT
/begin MEASUREMENT ZFFSAB._.ASCPasIn.sv_ASCPas "Output value ASC passive indication" UBYTE SAB_STANDARD_S2_S3 1 100 0 1 DISPLAY_IDENTIFIER sv_ASCPas.ASCPasIn._.ZFFSAB ECU_ADDRESS 0xFFF8F853 /end MEASUREMENT
/begin MEASUREMENT ZFFSAB._.ASCPasIn.sv_f_DSCErr "Output value of DSCErr" UBYTE SAB_STANDARD_S2_S3 1 100 0 1 DISPLAY_IDENTIFIER sv_f_DSCErr.ASCPasIn._.ZFFSAB ECU_ADDRESS 0xFFF8F854 /end MEASUREMENT
/begin MEASUREMENT ZFFSAB._.ASCPasIn.sv_f_DSCErr_ "Output value of DSCErr" UBYTE SAB_STANDARD_S2_S3 1 100 0 255 DISPLAY_IDENTIFIER sv_f_DSCErr_.ASCPasIn._.ZFFSAB ECU_ADDRESS 0xFFF8F855 /end MEASUREMENT
/begin MEASUREMENT ZFFSAB._.ASCPasIn.f_ASCPasErr "Error flag of ASCPas-signal" UBYTE SAB_STANDARD_S2_S3 1 100 0 1 DISPLAY_IDENTIFIER f_ASCPasErr.ASCPasIn._.ZFFSAB ECU_ADDRESS 0xFFF8F856 /end MEASUREMENT
/begin MEASUREMENT ZFFSAB._.EngineSpeedIn.iv_n_EngVM "Input value combustion engine rpm from CAN" UWORD SAB_N_RPM4_S2_S3 1 100 0 16383.75 DISPLAY_IDENTIFIER iv_n_EngVM.EngineSpeedIn._.ZFFSAB ECU_ADDRESS 0xFFF8F93C /end MEASUREMENT
/begin MEASUREMENT ZFFSAB._.EngineSpeedIn.iv_n_EngVM_ "Input value combustion engine rpm from CAN complement" UWORD SAB_STANDARD_S2_S3 1 100 0 65535 DISPLAY_IDENTIFIER iv_n_EngVM_.EngineSpeedIn._.ZFFSAB ECU_ADDRESS 0xFFF8F93E /end MEASUREMENT
/begin MEASUREMENT ZFFSAB._.EngineSpeedIn.iv_n_EngVMErr "Input error value of combustion engine rpm from CAN" UBYTE SAB_STANDARD_S2_S3 1 100 0 255 DISPLAY_IDENTIFIER iv_n_EngVMErr.EngineSpeedIn._.ZFFSAB ECU_ADDRESS 0xFFF8F940 /end MEASUREMENT
/begin MEASUREMENT ZFFSAB._.EngineSpeedIn.iv_n_EngVMSts "Input value of message status of combustion engine rpm" UBYTE SAB_STANDARD_S2_S3 1 100 0 255 DISPLAY_IDENTIFIER iv_n_EngVMSts.EngineSpeedIn._.ZFFSAB ECU_ADDRESS 0xFFF8F941 /end MEASUREMENT
/begin MEASUREMENT ZFFSAB._.EngineSpeedIn.iv_n_EngVMSts_ "Complement of message status of combustion engine rpm" UBYTE SAB_STANDARD_S2_S3 1 100 0 255 DISPLAY_IDENTIFIER iv_n_EngVMSts_.EngineSpeedIn._.ZFFSAB ECU_ADDRESS 0xFFF8F942 /end MEASUREMENT
/begin MEASUREMENT ZFFSAB._.EngineSpeedIn.iv_StatusK0 "Statuf of K0" UBYTE SAB_STANDARD_S2_S3 1 100 0 255 DISPLAY_IDENTIFIER iv_StatusK0.EngineSpeedIn._.ZFFSAB ECU_ADDRESS 0xFFF8F943 /end MEASUREMENT
/begin MEASUREMENT ZFFSAB._.EngineSpeedIn.iv_kraftschluss "signalizes if gearbox is kraftschluessig" UBYTE SAB_STANDARD_S2_S3 1 100 0 6 DISPLAY_IDENTIFIER iv_kraftschluss.EngineSpeedIn._.ZFFSAB ECU_ADDRESS 0xFFF8F944 /end MEASUREMENT
/begin MEASUREMENT ZFFSAB._.EngineSpeedIn.iv_st_IAE "IAE Kupplungsstatus" UBYTE SAB_STANDARD_S2_S3 1 100 0 8 DISPLAY_IDENTIFIER iv_st_IAE.EngineSpeedIn._.ZFFSAB ECU_ADDRESS 0xFFF8F945 /end MEASUREMENT
/begin MEASUREMENT ZFFSAB._.EngineSpeedIn.iv_ActualGear "Istgang" SBYTE SAB_STANDARD_S2_S3 1 100 -1 8 DISPLAY_IDENTIFIER iv_ActualGear.EngineSpeedIn._.ZFFSAB ECU_ADDRESS 0xFFF8F946 /end MEASUREMENT
/begin MEASUREMENT ZFFSAB._.EngineSpeedIn.iv_TargetGear "Zielgang" SBYTE SAB_STANDARD_S2_S3 1 100 -1 8 DISPLAY_IDENTIFIER iv_TargetGear.EngineSpeedIn._.ZFFSAB ECU_ADDRESS 0xFFF8F947 /end MEASUREMENT
/begin MEASUREMENT ZFFSAB._.EngineSpeedIn.iv_i_C0 "Input value: Measured current at output OUT5" UWORD SAB_I_MA10_S2_S3 1 100 0 6553.5 DISPLAY_IDENTIFIER iv_i_C0.EngineSpeedIn._.ZFFSAB ECU_ADDRESS 0xFFF8F948 /end MEASUREMENT
/begin MEASUREMENT ZFFSAB._.EngineSpeedIn.iv_i_C0_ "Complement Input value: Measured current at output OUT5" UWORD SAB_STANDARD_S2_S3 1 100 0 65535 DISPLAY_IDENTIFIER iv_i_C0_.EngineSpeedIn._.ZFFSAB ECU_ADDRESS 0xFFF8F94A /end MEASUREMENT
/begin MEASUREMENT ZFFSAB._.EngineSpeedIn.iv_in_GearLev2 "Current gear ratio calculated by electric currents of actuators IEDS0..IEDS4" SWORD SAB_K1000_S2_S3 1 100 -32.768 32.767 DISPLAY_IDENTIFIER iv_in_GearLev2.EngineSpeedIn._.ZFFSAB ECU_ADDRESS 0xFFF8F94C /end MEASUREMENT
/begin MEASUREMENT ZFFSAB._.EngineSpeedIn.iv_in_GearLev2_ "Complement of Current gear ratio calculated by electric currents of actuators IEDS0..IEDS4" SWORD SAB_STANDARD_S2_S3 1 100 -32768 32767 DISPLAY_IDENTIFIER iv_in_GearLev2_.EngineSpeedIn._.ZFFSAB ECU_ADDRESS 0xFFF8F94E /end MEASUREMENT
/begin MEASUREMENT ZFFSAB._.EngineSpeedIn.iv_n_Eng "Input value of electrical engine rpm from CAN" UWORD SAB_N_RPM2_M5000_S2_S3 1 100 -5000 27767.5 DISPLAY_IDENTIFIER iv_n_Eng.EngineSpeedIn._.ZFFSAB ECU_ADDRESS 0xFFF8F950 /end MEASUREMENT
/begin MEASUREMENT ZFFSAB._.EngineSpeedIn.iv_n_Eng_ "Complement of input value of electrical engine rpm from CAN" UWORD SAB_STANDARD_S2_S3 1 100 0 65535 DISPLAY_IDENTIFIER iv_n_Eng_.EngineSpeedIn._.ZFFSAB ECU_ADDRESS 0xFFF8F952 /end MEASUREMENT
/begin MEASUREMENT ZFFSAB._.EngineSpeedIn.iv_n_EngErr "Input error value of electrical engine rpm from CAN" UBYTE SAB_STANDARD_S2_S3 1 100 0 255 DISPLAY_IDENTIFIER iv_n_EngErr.EngineSpeedIn._.ZFFSAB ECU_ADDRESS 0xFFF8F954 /end MEASUREMENT
/begin MEASUREMENT ZFFSAB._.EngineSpeedIn.iv_n_EngErr_ "Complement of input error value of electrical engine rpm from CAN" UBYTE SAB_STANDARD_S2_S3 1 100 0 255 DISPLAY_IDENTIFIER iv_n_EngErr_.EngineSpeedIn._.ZFFSAB ECU_ADDRESS 0xFFF8F955 /end MEASUREMENT
/begin MEASUREMENT ZFFSAB._.EngineSpeedIn.iv_n_EngSts "Input value of message status of electrical engine rpm" UBYTE SAB_STANDARD_S2_S3 1 100 0 255 DISPLAY_IDENTIFIER iv_n_EngSts.EngineSpeedIn._.ZFFSAB ECU_ADDRESS 0xFFF8F956 /end MEASUREMENT
/begin MEASUREMENT ZFFSAB._.EngineSpeedIn.iv_n_EngSts_ "Complement of message status of electrical engine rpm" UBYTE SAB_STANDARD_S2_S3 1 100 0 255 DISPLAY_IDENTIFIER iv_n_EngSts_.EngineSpeedIn._.ZFFSAB ECU_ADDRESS 0xFFF8F957 /end MEASUREMENT
/begin MEASUREMENT ZFFSAB._.EngineSpeedIn.sv_n_Eng "Output value engine rpm" UWORD SAB_N_1RPM_S2_S3 1 100 0 65535 DISPLAY_IDENTIFIER sv_n_Eng.EngineSpeedIn._.ZFFSAB ECU_ADDRESS 0xFFF8F958 /end MEASUREMENT
/begin MEASUREMENT ZFFSAB._.EngineSpeedIn.sv_n_EngSts "Staus of output value of engine rpm" UBYTE SAB_STANDARD_S2_S3 1 100 0 2 DISPLAY_IDENTIFIER sv_n_EngSts.EngineSpeedIn._.ZFFSAB ECU_ADDRESS 0xFFF8F95A /end MEASUREMENT
/begin MEASUREMENT ZFFSAB._.EngineSpeedIn.sv_AGS_NEm "speed electrical machine" UWORD SAB_N_RPM2_M5000_S2_S3 1 100 -5000 27767 DISPLAY_IDENTIFIER sv_AGS_NEm.EngineSpeedIn._.ZFFSAB ECU_ADDRESS 0xFFF8F95C /end MEASUREMENT
/begin MEASUREMENT ZFFSAB._.EngineSpeedIn.sv_n_EngDirection "rotation direction of electrical engine 0=undefined 1=forward 2=backwards" UBYTE SAB_STANDARD_S2_S3 1 100 0 2 DISPLAY_IDENTIFIER sv_n_EngDirection.EngineSpeedIn._.ZFFSAB ECU_ADDRESS 0xFFF8F95E /end MEASUREMENT
/begin MEASUREMENT ZFFSAB._.EngineSpeedIn.sv_n_EngVM "Output value engine rpm" UWORD SAB_N_1RPM_S2_S3 1 100 0 65535 DISPLAY_IDENTIFIER sv_n_EngVM.EngineSpeedIn._.ZFFSAB ECU_ADDRESS 0xFFF8F960 /end MEASUREMENT
/begin MEASUREMENT ZFFSAB._.EngineSpeedIn.sv_n_EngVMSts "Output value of signal status of engine rpm" UBYTE SAB_STANDARD_S2_S3 1 100 0 2 DISPLAY_IDENTIFIER sv_n_EngVMSts.EngineSpeedIn._.ZFFSAB ECU_ADDRESS 0xFFF8F962 /end MEASUREMENT
/begin MEASUREMENT ZFFSAB._.EngineSpeedIn.sv_n_EngLev2 "Level 2 output value engine rpm" UWORD SAB_N_1RPM_S2_S3 1 100 0 65535 DISPLAY_IDENTIFIER sv_n_EngLev2.EngineSpeedIn._.ZFFSAB ECU_ADDRESS 0xFFF8F964 /end MEASUREMENT
/begin MEASUREMENT ZFFSAB._.EngineSpeedIn.sv_n_EngLev2_ "Level 2 output value engine rpm complement" UWORD SAB_STANDARD_S2_S3 1 100 0 65535 DISPLAY_IDENTIFIER sv_n_EngLev2_.EngineSpeedIn._.ZFFSAB ECU_ADDRESS 0xFFF8F966 /end MEASUREMENT
/begin MEASUREMENT ZFFSAB._.EngineSpeedIn.sv_n_EngLev2Sts "Level 2 output value signal status of engine rpm" UBYTE SAB_STANDARD_S2_S3 1 100 0 2 DISPLAY_IDENTIFIER sv_n_EngLev2Sts.EngineSpeedIn._.ZFFSAB ECU_ADDRESS 0xFFF8F968 /end MEASUREMENT
/begin MEASUREMENT ZFFSAB._.EngineSpeedIn.sv_n_EngLev2Sts_ "Level 2 output value signal status complement of engine rpm" UBYTE SAB_STANDARD_S2_S3 1 100 0 255 DISPLAY_IDENTIFIER sv_n_EngLev2Sts_.EngineSpeedIn._.ZFFSAB ECU_ADDRESS 0xFFF8F969 /end MEASUREMENT
/begin MEASUREMENT ZFFSAB._.EngineSpeedIn.sv_n_EngVMLev2 "Level 2 output value engine rpm" UWORD SAB_N_1RPM_S2_S3 1 100 0 65535 DISPLAY_IDENTIFIER sv_n_EngVMLev2.EngineSpeedIn._.ZFFSAB ECU_ADDRESS 0xFFF8F96A /end MEASUREMENT
/begin MEASUREMENT ZFFSAB._.EngineSpeedIn.sv_n_EngVMLev2_ "Level 2 output value engine rpm complement" UWORD SAB_STANDARD_S2_S3 1 100 0 65535 DISPLAY_IDENTIFIER sv_n_EngVMLev2_.EngineSpeedIn._.ZFFSAB ECU_ADDRESS 0xFFF8F96C /end MEASUREMENT
/begin MEASUREMENT ZFFSAB._.EngineSpeedIn.sv_n_EngVMLev2Sts "Level 2 output value signal status of engine rpm" UBYTE SAB_STANDARD_S2_S3 1 100 0 2 DISPLAY_IDENTIFIER sv_n_EngVMLev2Sts.EngineSpeedIn._.ZFFSAB ECU_ADDRESS 0xFFF8F96E /end MEASUREMENT
/begin MEASUREMENT ZFFSAB._.EngineSpeedIn.sv_n_EngVMLev2Sts_ "Level 2 output value signal status complement of engine rpm" UBYTE SAB_STANDARD_S2_S3 1 100 0 255 DISPLAY_IDENTIFIER sv_n_EngVMLev2Sts_.EngineSpeedIn._.ZFFSAB ECU_ADDRESS 0xFFF8F96F /end MEASUREMENT
/begin MEASUREMENT ZFFSAB._.EngineSpeedIn.f_n_EngErr "Error flag of n_Eng-signal" UBYTE SAB_STANDARD_S2_S3 1 100 0 1 DISPLAY_IDENTIFIER f_n_EngErr.EngineSpeedIn._.ZFFSAB ECU_ADDRESS 0xFFF8F970 /end MEASUREMENT
/begin MEASUREMENT ZFFSAB._.EngineSpeedIn.f_n_EngLev2Err "Error flag of level 2 n_Eng signal" UBYTE SAB_STANDARD_S2_S3 1 100 0 1 DISPLAY_IDENTIFIER f_n_EngLev2Err.EngineSpeedIn._.ZFFSAB ECU_ADDRESS 0xFFF8F971 /end MEASUREMENT
/begin MEASUREMENT ZFFSAB._.EngineSpeedIn.f_n_EngLev2Err_ "complement of corresponding signal" UBYTE SAB_STANDARD_S2_S3 1 100 0 1 DISPLAY_IDENTIFIER f_n_EngLev2Err_.EngineSpeedIn._.ZFFSAB ECU_ADDRESS 0xFFF8F972 /end MEASUREMENT
/begin MEASUREMENT ZFFSAB._.EngineSpeedIn.f_n_EngVMLev2Err "Error flag of level 2 n_EngVM signal" UBYTE SAB_STANDARD_S2_S3 1 100 0 1 DISPLAY_IDENTIFIER f_n_EngVMLev2Err.EngineSpeedIn._.ZFFSAB ECU_ADDRESS 0xFFF8F973 /end MEASUREMENT
/begin MEASUREMENT ZFFSAB._.EngineSpeedIn.f_n_EngVMLev2Err_ "complement of corresponding signal" UBYTE SAB_STANDARD_S2_S3 1 100 0 1 DISPLAY_IDENTIFIER f_n_EngVMLev2Err_.EngineSpeedIn._.ZFFSAB ECU_ADDRESS 0xFFF8F974 /end MEASUREMENT
/begin MEASUREMENT ZFFSAB._.EngineSpeedIn.f_n_EngVMErr "Error flag of n_Eng-signal" UBYTE SAB_STANDARD_S2_S3 1 100 0 1 DISPLAY_IDENTIFIER f_n_EngVMErr.EngineSpeedIn._.ZFFSAB ECU_ADDRESS 0xFFF8F975 /end MEASUREMENT
/begin MEASUREMENT ZFFSAB._.EngineSpeedIn.iv_in_Gear "Input value for gearRatio of actual gear" UWORD SAB_K1000_S2_S3 1 100 0 65.535 DISPLAY_IDENTIFIER iv_in_Gear.EngineSpeedIn._.ZFFSAB ECU_ADDRESS 0xFFF8F976 /end MEASUREMENT
/begin MEASUREMENT ZFFSAB._.GearboxTempIn.tmr_CGTPausi_CGTLEV2.time "Description for this variable only in SW documentation possible not in asap2" ULONG SAB_T_TIMER_S10_S2_S3 1 100 0 429496729.5 DISPLAY_IDENTIFIER time.tmr_CGTPausi_CGTLEV2.GearboxTempIn._.ZFFSAB ECU_ADDRESS 0xFFF8FA00 /end MEASUREMENT
/begin MEASUREMENT ZFFSAB._.GearboxTempIn.tmr_CGTPausi_CGTLEV2.time_ "Description for this variable only in SW documentation possible not in asap2" ULONG SAB_T_TIMER_S10_S2_S3 1 100 0 429496729.5 DISPLAY_IDENTIFIER time_.tmr_CGTPausi_CGTLEV2.GearboxTempIn._.ZFFSAB ECU_ADDRESS 0xFFF8FA04 /end MEASUREMENT
/begin MEASUREMENT ZFFSAB._.IgnitionStatusIn.t_IgnTimer.time "Description for this variable only in SW documentation possible not in asap2" ULONG SAB_T_TIMER_10MS_S2_S3 1 100 0 42949672950 DISPLAY_IDENTIFIER time.t_IgnTimer.IgnitionStatusIn._.ZFFSAB ECU_ADDRESS 0xFFF8FA20 /end MEASUREMENT
/begin MEASUREMENT ZFFSAB._.IgnitionStatusIn.t_IgnTimer.time_ "Description for this variable only in SW documentation possible not in asap2" ULONG SAB_T_TIMER_10MS_S2_S3 1 100 0 42949672950 DISPLAY_IDENTIFIER time_.t_IgnTimer.IgnitionStatusIn._.ZFFSAB ECU_ADDRESS 0xFFF8FA24 /end MEASUREMENT
/begin MEASUREMENT ZFFSAB._.IgnitionStatusIn.tmr_IgnPlausiTol.time "Description for this variable only in SW documentation possible not in asap2" ULONG SAB_T_TIMER_10MS_S2_S3 1 100 0 42949672950 DISPLAY_IDENTIFIER time.tmr_IgnPlausiTol.IgnitionStatusIn._.ZFFSAB ECU_ADDRESS 0xFFF8FA28 /end MEASUREMENT
/begin MEASUREMENT ZFFSAB._.IgnitionStatusIn.tmr_IgnPlausiTol.time_ "Description for this variable only in SW documentation possible not in asap2" ULONG SAB_T_TIMER_10MS_S2_S3 1 100 0 42949672950 DISPLAY_IDENTIFIER time_.tmr_IgnPlausiTol.IgnitionStatusIn._.ZFFSAB ECU_ADDRESS 0xFFF8FA2C /end MEASUREMENT
/begin MEASUREMENT ZFFSAB._.IgnitionStatusIn.tmr_IgnPlausiDelay.time "Description for this variable only in SW documentation possible not in asap2" ULONG SAB_T_TIMER_10MS_S2_S3 1 100 0 42949672950 DISPLAY_IDENTIFIER time.tmr_IgnPlausiDelay.IgnitionStatusIn._.ZFFSAB ECU_ADDRESS 0xFFF8FA30 /end MEASUREMENT
/begin MEASUREMENT ZFFSAB._.IgnitionStatusIn.tmr_IgnPlausiDelay.time_ "Description for this variable only in SW documentation possible not in asap2" ULONG SAB_T_TIMER_10MS_S2_S3 1 100 0 42949672950 DISPLAY_IDENTIFIER time_.tmr_IgnPlausiDelay.IgnitionStatusIn._.ZFFSAB ECU_ADDRESS 0xFFF8FA34 /end MEASUREMENT
/begin MEASUREMENT ZFFSAB._.IgnitionStatusIn.f_Kl15_Pin "internal result of pin signal 1 = pin signal is on 0 = pin signal is off" UBYTE SAB_STANDARD_S2_S3 1 100 0 1 DISPLAY_IDENTIFIER f_Kl15_Pin.IgnitionStatusIn._.ZFFSAB ECU_ADDRESS 0xFFF8FA3C /end MEASUREMENT
/begin MEASUREMENT ZFFSAB._.IgnitionStatusIn.f_KL15 "internal result of can signal 1 = can terminal 15 signal is on 0 = can terminal 15 signal is off" UBYTE SAB_STANDARD_S2_S3 1 100 0 1 DISPLAY_IDENTIFIER f_KL15.IgnitionStatusIn._.ZFFSAB ECU_ADDRESS 0xFFF8FA3D /end MEASUREMENT
/begin MEASUREMENT ZFFSAB._.IgnitionStatusIn.f_KL15Err "error flag of can signal timeout alivecounter- checksum- dlcerror or invalig can signal" UBYTE SAB_STANDARD_S2_S3 1 100 0 1 DISPLAY_IDENTIFIER f_KL15Err.IgnitionStatusIn._.ZFFSAB ECU_ADDRESS 0xFFF8FA3E /end MEASUREMENT
/begin MEASUREMENT ZFFSAB._.IgnitionStatusIn.IgnPlausiErr "state of the plausibility check result CAN signal against hardware signal KL15" UBYTE SAB_STANDARD_S2_S3 1 100 0 2 DISPLAY_IDENTIFIER IgnPlausiErr.IgnitionStatusIn._.ZFFSAB ECU_ADDRESS 0xFFF8FA3F /end MEASUREMENT
/begin MEASUREMENT ZFFSAB._.IgnitionStatusIn.st_IgnPlausiState "actual state of the state machine of the plausibility check CAN/hardware signal KL15" UBYTE SAB_STANDARD_S2_S3 1 100 0 4 DISPLAY_IDENTIFIER st_IgnPlausiState.IgnitionStatusIn._.ZFFSAB ECU_ADDRESS 0xFFF8FA40 /end MEASUREMENT
/begin MEASUREMENT ZFFSAB._.IgnitionStatusIn.st_IgnPlausiState_ "complement of actual state of the state machine of the plausibility check CAN/hardware signal KL15" UBYTE SAB_STANDARD_S2_S3 1 100 0 4 DISPLAY_IDENTIFIER st_IgnPlausiState_.IgnitionStatusIn._.ZFFSAB ECU_ADDRESS 0xFFF8FA41 /end MEASUREMENT
/begin MEASUREMENT ZFFSAB._.IgnitionStatusIn.iv_u_Kl15_Pin "Input of the voltage terminal 15 value" UWORD SAB_U_1VOLT1000_S2_S3 1 100 0 25 DISPLAY_IDENTIFIER iv_u_Kl15_Pin.IgnitionStatusIn._.ZFFSAB ECU_ADDRESS 0xFFF8FA42 /end MEASUREMENT
/begin MEASUREMENT ZFFSAB._.IgnitionStatusIn.iv_t_System "input System 1ms Counter (overspills to 0 with 2^32-1)" ULONG SAB_T_TIMER_1MS_S2_S3 1 100 0 4294967295 DISPLAY_IDENTIFIER iv_t_System.IgnitionStatusIn._.ZFFSAB ECU_ADDRESS 0xFFF8FA44 /end MEASUREMENT
/begin MEASUREMENT ZFFSAB._.IgnitionStatusIn.iv_KL15 "Input value of terminal 15 CAN signal" UBYTE SAB_STANDARD_S2_S3 1 100 0 15 DISPLAY_IDENTIFIER iv_KL15.IgnitionStatusIn._.ZFFSAB ECU_ADDRESS 0xFFF8FA48 /end MEASUREMENT
/begin MEASUREMENT ZFFSAB._.IgnitionStatusIn.iv_KL15_ "Complement of input value of terminal 15 CAN signal" UBYTE SAB_STANDARD_S2_S3 1 100 0 255 DISPLAY_IDENTIFIER iv_KL15_.IgnitionStatusIn._.ZFFSAB ECU_ADDRESS 0xFFF8FA49 /end MEASUREMENT
/begin MEASUREMENT ZFFSAB._.IgnitionStatusIn.iv_KL15Sts "Input value of the status of terminal 15 CAN signal" UBYTE SAB_STANDARD_S2_S3 1 100 0 255 DISPLAY_IDENTIFIER iv_KL15Sts.IgnitionStatusIn._.ZFFSAB ECU_ADDRESS 0xFFF8FA4A /end MEASUREMENT
/begin MEASUREMENT ZFFSAB._.IgnitionStatusIn.iv_KL15Sts_ "complement of the status of the input signal received via CAN" UBYTE SAB_STANDARD_S2_S3 1 100 0 255 DISPLAY_IDENTIFIER iv_KL15Sts_.IgnitionStatusIn._.ZFFSAB ECU_ADDRESS 0xFFF8FA4B /end MEASUREMENT
/begin MEASUREMENT ZFFSAB._.IgnitionStatusIn.iv_KLDiv "Diversity input signal of the can signal" UBYTE SAB_STANDARD_S2_S3 1 100 0 255 DISPLAY_IDENTIFIER iv_KLDiv.IgnitionStatusIn._.ZFFSAB ECU_ADDRESS 0xFFF8FA4C /end MEASUREMENT
/begin MEASUREMENT ZFFSAB._.IgnitionStatusIn.iv_KLDiv_ "Complement of diversity input signal of the can signal" UBYTE SAB_STANDARD_S2_S3 1 100 0 255 DISPLAY_IDENTIFIER iv_KLDiv_.IgnitionStatusIn._.ZFFSAB ECU_ADDRESS 0xFFF8FA4D /end MEASUREMENT
/begin MEASUREMENT ZFFSAB._.IgnitionStatusIn.sv_f_IgnOn "Output flag 1=Ignition on 0=Ignition off" UBYTE SAB_STANDARD_S2_S3 1 100 0 1 DISPLAY_IDENTIFIER sv_f_IgnOn.IgnitionStatusIn._.ZFFSAB ECU_ADDRESS 0xFFF8FA4E /end MEASUREMENT
/begin MEASUREMENT ZFFSAB._.IgnitionStatusIn.sv_KL15 "Output value of ignition 0=init 1=switching on 2=on 3=switching off 4=off" UBYTE SAB_STANDARD_S2_S3 1 100 0 4 DISPLAY_IDENTIFIER sv_KL15.IgnitionStatusIn._.ZFFSAB ECU_ADDRESS 0xFFF8FA4F /end MEASUREMENT
/begin MEASUREMENT ZFFSAB._.IgnitionStatusIn.sv_KL15_ "Complement of output value" UBYTE SAB_STANDARD_S2_S3 1 100 0 255 DISPLAY_IDENTIFIER sv_KL15_.IgnitionStatusIn._.ZFFSAB ECU_ADDRESS 0xFFF8FA50 /end MEASUREMENT
/begin MEASUREMENT ZFFSAB._.IgnitionStatusIn.sv_KL15Sts "Error state of output value 0=no error 1=substitute value 2=error" UBYTE SAB_STANDARD_S2_S3 1 100 0 2 DISPLAY_IDENTIFIER sv_KL15Sts.IgnitionStatusIn._.ZFFSAB ECU_ADDRESS 0xFFF8FA51 /end MEASUREMENT
/begin MEASUREMENT ZFFSAB._.IgnitionStatusIn.sv_KL15Sts_ "Complement of error state of output value" UBYTE SAB_STANDARD_S2_S3 1 100 0 255 DISPLAY_IDENTIFIER sv_KL15Sts_.IgnitionStatusIn._.ZFFSAB ECU_ADDRESS 0xFFF8FA52 /end MEASUREMENT
/begin MEASUREMENT ZFFSAB._.ParklockSensorIn.tmr_PosZ.time "Description for this variable only in SW documentation possible not in asap2" ULONG SAB_T_TIMER_10MS_S2_S3 1 100 0 42949672950 DISPLAY_IDENTIFIER time.tmr_PosZ.ParklockSensorIn._.ZFFSAB ECU_ADDRESS 0xFFF8FA64 /end MEASUREMENT
/begin MEASUREMENT ZFFSAB._.ParklockSensorIn.tmr_PosZ.time_ "Description for this variable only in SW documentation possible not in asap2" ULONG SAB_T_TIMER_10MS_S2_S3 1 100 0 42949672950 DISPLAY_IDENTIFIER time_.tmr_PosZ.ParklockSensorIn._.ZFFSAB ECU_ADDRESS 0xFFF8FA68 /end MEASUREMENT
/begin MEASUREMENT ZFFSAB._.SpeedPlausibilityIn.tmr_VUNPLAUSILEV2_pred.time "Description for this variable only in SW documentation possible not in asap2" ULONG SAB_T_TIMER_10MS_S2_S3 1 100 0 42949672950 DISPLAY_IDENTIFIER time.tmr_VUNPLAUSILEV2_pred.SpeedPlausibilityIn._.ZFFSAB ECU_ADDRESS 0xFFF8FAAC /end MEASUREMENT
/begin MEASUREMENT ZFFSAB._.SpeedPlausibilityIn.tmr_VUNPLAUSILEV2_pred.time_ "Description for this variable only in SW documentation possible not in asap2" ULONG SAB_T_TIMER_10MS_S2_S3 1 100 0 42949672950 DISPLAY_IDENTIFIER time_.tmr_VUNPLAUSILEV2_pred.SpeedPlausibilityIn._.ZFFSAB ECU_ADDRESS 0xFFF8FAB0 /end MEASUREMENT
/begin MEASUREMENT ZFFSAB._.SpeedPlausibilityIn.tmr_DelayGra_VUNPLAUSILEV2_pred.time "Description for this variable only in SW documentation possible not in asap2" ULONG SAB_T_TIMER_10MS_S2_S3 1 100 0 42949672950 DISPLAY_IDENTIFIER time.tmr_DelayGra_VUNPLAUSILEV2_pred.SpeedPlausibilityIn._.ZFFSAB ECU_ADDRESS 0xFFF8FAB4 /end MEASUREMENT
/begin MEASUREMENT ZFFSAB._.SpeedPlausibilityIn.tmr_DelayGra_VUNPLAUSILEV2_pred.time_ "Description for this variable only in SW documentation possible not in asap2" ULONG SAB_T_TIMER_10MS_S2_S3 1 100 0 42949672950 DISPLAY_IDENTIFIER time_.tmr_DelayGra_VUNPLAUSILEV2_pred.SpeedPlausibilityIn._.ZFFSAB ECU_ADDRESS 0xFFF8FAB8 /end MEASUREMENT
/begin MEASUREMENT ZFFSAB._.SpeedPlausibilityIn.tmr_DelayGra_VUNPLAUSILEV2.time "Description for this variable only in SW documentation possible not in asap2" ULONG SAB_T_TIMER_10MS_S2_S3 1 100 0 42949672950 DISPLAY_IDENTIFIER time.tmr_DelayGra_VUNPLAUSILEV2.SpeedPlausibilityIn._.ZFFSAB ECU_ADDRESS 0xFFF8FABC /end MEASUREMENT
/begin MEASUREMENT ZFFSAB._.SpeedPlausibilityIn.tmr_DelayGra_VUNPLAUSILEV2.time_ "Description for this variable only in SW documentation possible not in asap2" ULONG SAB_T_TIMER_10MS_S2_S3 1 100 0 42949672950 DISPLAY_IDENTIFIER time_.tmr_DelayGra_VUNPLAUSILEV2.SpeedPlausibilityIn._.ZFFSAB ECU_ADDRESS 0xFFF8FAC0 /end MEASUREMENT
/begin MEASUREMENT ZFFSAB._.SpeedPlausibilityIn.tmr_DelayBrake_VUNPLAUSILEV2.time "Description for this variable only in SW documentation possible not in asap2" ULONG SAB_T_TIMER_10MS_S2_S3 1 100 0 42949672950 DISPLAY_IDENTIFIER time.tmr_DelayBrake_VUNPLAUSILEV2.SpeedPlausibilityIn._.ZFFSAB ECU_ADDRESS 0xFFF8FAC4 /end MEASUREMENT
/begin MEASUREMENT ZFFSAB._.SpeedPlausibilityIn.tmr_DelayBrake_VUNPLAUSILEV2.time_ "Description for this variable only in SW documentation possible not in asap2" ULONG SAB_T_TIMER_10MS_S2_S3 1 100 0 42949672950 DISPLAY_IDENTIFIER time_.tmr_DelayBrake_VUNPLAUSILEV2.SpeedPlausibilityIn._.ZFFSAB ECU_ADDRESS 0xFFF8FAC8 /end MEASUREMENT
/begin MEASUREMENT ZFFSAB._.SpeedPlausibilityIn.tmr_DelayTo_VUNPLAUSILEV2.time "Description for this variable only in SW documentation possible not in asap2" ULONG SAB_T_TIMER_10MS_S2_S3 1 100 0 42949672950 DISPLAY_IDENTIFIER time.tmr_DelayTo_VUNPLAUSILEV2.SpeedPlausibilityIn._.ZFFSAB ECU_ADDRESS 0xFFF8FACC /end MEASUREMENT
/begin MEASUREMENT ZFFSAB._.SpeedPlausibilityIn.tmr_DelayTo_VUNPLAUSILEV2.time_ "Description for this variable only in SW documentation possible not in asap2" ULONG SAB_T_TIMER_10MS_S2_S3 1 100 0 42949672950 DISPLAY_IDENTIFIER time_.tmr_DelayTo_VUNPLAUSILEV2.SpeedPlausibilityIn._.ZFFSAB ECU_ADDRESS 0xFFF8FAD0 /end MEASUREMENT
/begin MEASUREMENT ZFFSAB._.SpeedPlausibilityIn.tmr_DelayDeactGra_VUNPLAUSILEV2.time "Description for this variable only in SW documentation possible not in asap2" ULONG SAB_T_TIMER_10MS_S2_S3 1 100 0 42949672950 DISPLAY_IDENTIFIER time.tmr_DelayDeactGra_VUNPLAUSILEV2.SpeedPlausibilityIn._.ZFFSAB ECU_ADDRESS 0xFFF8FAD4 /end MEASUREMENT
/begin MEASUREMENT ZFFSAB._.SpeedPlausibilityIn.tmr_DelayDeactGra_VUNPLAUSILEV2.time_ "Description for this variable only in SW documentation possible not in asap2" ULONG SAB_T_TIMER_10MS_S2_S3 1 100 0 42949672950 DISPLAY_IDENTIFIER time_.tmr_DelayDeactGra_VUNPLAUSILEV2.SpeedPlausibilityIn._.ZFFSAB ECU_ADDRESS 0xFFF8FAD8 /end MEASUREMENT
/begin MEASUREMENT ZFFSAB._.SpeedPlausibilityIn.sv_v_unplausi "flag to determine whether the vehicle speed is unplausi" UBYTE SAB_STANDARD_S2_S3 1 100 0 1 DISPLAY_IDENTIFIER sv_v_unplausi.SpeedPlausibilityIn._.ZFFSAB ECU_ADDRESS 0xFFF8FADC /end MEASUREMENT
/begin MEASUREMENT ZFFSAB._.SpeedPlausibilityIn.sv_v_unplausi_ "flag to determine whether the vehicle speed is unplausi" UBYTE SAB_STANDARD_S2_S3 1 100 0 255 DISPLAY_IDENTIFIER sv_v_unplausi_.SpeedPlausibilityIn._.ZFFSAB ECU_ADDRESS 0xFFF8FADD /end MEASUREMENT
/begin MEASUREMENT ZFFSAB._.SpeedPlausibilityIn.f_vunplausi_pred "flag to determine whether the vehicle speed supposed to be unplausible" UBYTE SAB_STANDARD_S2_S3 1 100 0 1 DISPLAY_IDENTIFIER f_vunplausi_pred.SpeedPlausibilityIn._.ZFFSAB ECU_ADDRESS 0xFFF8FADE /end MEASUREMENT
/begin MEASUREMENT ZFFSAB._.SpeedPlausibilityIn.sv_n_Ab_plausibel "Last valid output value signal of vehicle speed" UWORD SAB_N_1RPM_S2_S3 1 100 0 65535 DISPLAY_IDENTIFIER sv_n_Ab_plausibel.SpeedPlausibilityIn._.ZFFSAB ECU_ADDRESS 0xFFF8FAE0 /end MEASUREMENT
/begin MEASUREMENT ZFFSAB._.SpeedPlausibilityIn.sv_n_AbOld "output value signal of vehicle speed of the cycle before" UWORD SAB_N_1RPM_S2_S3 1 100 0 65535 DISPLAY_IDENTIFIER sv_n_AbOld.SpeedPlausibilityIn._.ZFFSAB ECU_ADDRESS 0xFFF8FAE2 /end MEASUREMENT
/begin MEASUREMENT ZFFSAB._.SpeedPlausibilityIn.v_unplausiOld "value of v_unplausi in the cycle before" UBYTE SAB_STANDARD_S2_S3 1 100 0 1 DISPLAY_IDENTIFIER v_unplausiOld.SpeedPlausibilityIn._.ZFFSAB ECU_ADDRESS 0xFFF8FAE4 /end MEASUREMENT
/begin MEASUREMENT ZFFSAB._.SpeedPlausibilityIn.f_n_AbGra_VUNPLAUSILEV2 "forbidden negative gradient" UBYTE SAB_STANDARD_S2_S3 1 100 0 1 DISPLAY_IDENTIFIER f_n_AbGra_VUNPLAUSILEV2.SpeedPlausibilityIn._.ZFFSAB ECU_ADDRESS 0xFFF8FAE5 /end MEASUREMENT
/begin MEASUREMENT ZFFSAB._.VehicleSpeedIn.VehicleSpeedInFL.tmr_DelayVIstMaxCalc.time "Description for this variable only in SW documentation possible not in asap2" ULONG SAB_T_TIMER_10MS_S2_S3 1 100 0 42949672950 DISPLAY_IDENTIFIER time.tmr_DelayVIstMaxCalc.VehicleSpeedInFL.VehicleSpeedIn._.ZFFSAB ECU_ADDRESS 0xFFF8FAF0 /end MEASUREMENT
/begin MEASUREMENT ZFFSAB._.VehicleSpeedIn.VehicleSpeedInFL.tmr_DelayVIstMaxCalc.time_ "Description for this variable only in SW documentation possible not in asap2" ULONG SAB_T_TIMER_10MS_S2_S3 1 100 0 42949672950 DISPLAY_IDENTIFIER time_.tmr_DelayVIstMaxCalc.VehicleSpeedInFL.VehicleSpeedIn._.ZFFSAB ECU_ADDRESS 0xFFF8FAF4 /end MEASUREMENT
/begin MEASUREMENT ZFFSAB._.VehicleSpeedIn.tmr_DelayVIstMaxCalc.time "Description for this variable only in SW documentation possible not in asap2" ULONG SAB_T_TIMER_10MS_S2_S3 1 100 0 42949672950 DISPLAY_IDENTIFIER time.tmr_DelayVIstMaxCalc.VehicleSpeedIn._.ZFFSAB ECU_ADDRESS 0xFFF8FB30 /end MEASUREMENT
/begin MEASUREMENT ZFFSAB._.VehicleSpeedIn.tmr_DelayVIstMaxCalc.time_ "Description for this variable only in SW documentation possible not in asap2" ULONG SAB_T_TIMER_10MS_S2_S3 1 100 0 42949672950 DISPLAY_IDENTIFIER time_.tmr_DelayVIstMaxCalc.VehicleSpeedIn._.ZFFSAB ECU_ADDRESS 0xFFF8FB34 /end MEASUREMENT
/begin MEASUREMENT ZFFSAB._.EngineSpeedRedIn.f_n_EngMaxRedErr "Error flag of reduction engine rpm" UBYTE SAB_STANDARD_S2_S3 1 100 0 1 DISPLAY_IDENTIFIER f_n_EngMaxRedErr.EngineSpeedRedIn._.ZFFSAB ECU_ADDRESS 0xFFF8FB84 /end MEASUREMENT
/begin MEASUREMENT ZFFSAB._.SensorSupplyMonitoring.tmr_t_delay_USENS.time "Description for this variable only in SW documentation possible not in asap2" ULONG SAB_T_TIMER_10MS_S2_S3 1 100 0 42949672950 DISPLAY_IDENTIFIER time.tmr_t_delay_USENS.SensorSupplyMonitoring._.ZFFSAB ECU_ADDRESS 0xFFF8FB8C /end MEASUREMENT
/begin MEASUREMENT ZFFSAB._.SensorSupplyMonitoring.tmr_t_delay_USENS.time_ "Description for this variable only in SW documentation possible not in asap2" ULONG SAB_T_TIMER_10MS_S2_S3 1 100 0 42949672950 DISPLAY_IDENTIFIER time_.tmr_t_delay_USENS.SensorSupplyMonitoring._.ZFFSAB ECU_ADDRESS 0xFFF8FB90 /end MEASUREMENT
/begin MEASUREMENT ZFFSAB._.RearAxleRatioIn.tmr_IG_HA_LearnDif.time "Description for this variable only in SW documentation possible not in asap2" ULONG SAB_T_TIMER_10MS_S2_S3 1 100 0 42949672950 DISPLAY_IDENTIFIER time.tmr_IG_HA_LearnDif.RearAxleRatioIn._.ZFFSAB ECU_ADDRESS 0xFFF8FBA0 /end MEASUREMENT
/begin MEASUREMENT ZFFSAB._.RearAxleRatioIn.tmr_IG_HA_LearnDif.time_ "Description for this variable only in SW documentation possible not in asap2" ULONG SAB_T_TIMER_10MS_S2_S3 1 100 0 42949672950 DISPLAY_IDENTIFIER time_.tmr_IG_HA_LearnDif.RearAxleRatioIn._.ZFFSAB ECU_ADDRESS 0xFFF8FBA4 /end MEASUREMENT
/begin MEASUREMENT ZFFSAB._.RearAxleRatioIn.tmr_ForceLearnRearAxleRatio.time "Description for this variable only in SW documentation possible not in asap2" ULONG SAB_T_TIMER_10MS_S2_S3 1 100 0 42949672950 DISPLAY_IDENTIFIER time.tmr_ForceLearnRearAxleRatio.RearAxleRatioIn._.ZFFSAB ECU_ADDRESS 0xFFF8FBA8 /end MEASUREMENT
/begin MEASUREMENT ZFFSAB._.RearAxleRatioIn.tmr_ForceLearnRearAxleRatio.time_ "Description for this variable only in SW documentation possible not in asap2" ULONG SAB_T_TIMER_10MS_S2_S3 1 100 0 42949672950 DISPLAY_IDENTIFIER time_.tmr_ForceLearnRearAxleRatio.RearAxleRatioIn._.ZFFSAB ECU_ADDRESS 0xFFF8FBAC /end MEASUREMENT
/begin MEASUREMENT ZFFSAB._.BackToNormalFunctionViaReset.tmr_delay_Limphome.time "Description for this variable only in SW documentation possible not in asap2" ULONG SAB_T_TIMER_10MS_S2_S3 1 100 0 42949672950 DISPLAY_IDENTIFIER time.tmr_delay_Limphome.BackToNormalFunctionViaReset._.ZFFSAB ECU_ADDRESS 0xFFF8FC18 /end MEASUREMENT
/begin MEASUREMENT ZFFSAB._.BackToNormalFunctionViaReset.tmr_delay_Limphome.time_ "Description for this variable only in SW documentation possible not in asap2" ULONG SAB_T_TIMER_10MS_S2_S3 1 100 0 42949672950 DISPLAY_IDENTIFIER time_.tmr_delay_Limphome.BackToNormalFunctionViaReset._.ZFFSAB ECU_ADDRESS 0xFFF8FC1C /end MEASUREMENT
/begin MEASUREMENT ZFFSAB._.BackToNormalFunctionViaReset.tmr_delay_LimphomeCnt.time "Description for this variable only in SW documentation possible not in asap2" ULONG SAB_T_TIMER_10MS_S2_S3 1 100 0 42949672950 DISPLAY_IDENTIFIER time.tmr_delay_LimphomeCnt.BackToNormalFunctionViaReset._.ZFFSAB ECU_ADDRESS 0xFFF8FC20 /end MEASUREMENT
/begin MEASUREMENT ZFFSAB._.BackToNormalFunctionViaReset.tmr_delay_LimphomeCnt.time_ "Description for this variable only in SW documentation possible not in asap2" ULONG SAB_T_TIMER_10MS_S2_S3 1 100 0 42949672950 DISPLAY_IDENTIFIER time_.tmr_delay_LimphomeCnt.BackToNormalFunctionViaReset._.ZFFSAB ECU_ADDRESS 0xFFF8FC24 /end MEASUREMENT
/begin MEASUREMENT ZFFSAB._.BackToNormalFunctionViaReset.iv_f_EEPROMStoreInProgress "1=EEPROM Storage is activ 0=EEPROM Storage is not activ" UBYTE SAB_STANDARD_S2_S3 1 100 0 1 DISPLAY_IDENTIFIER iv_f_EEPROMStoreInProgress.BackToNormalFunctionViaReset._.ZFFSAB ECU_ADDRESS 0xFFF8FC28 /end MEASUREMENT
/begin MEASUREMENT ZFFSAB._.BackToNormalFunctionViaReset.iv_EEPROMBusy "Input signal of _GET_EE_BUSY macro from HW" UBYTE SAB_STANDARD_S2_S3 1 100 0 1 DISPLAY_IDENTIFIER iv_EEPROMBusy.BackToNormalFunctionViaReset._.ZFFSAB ECU_ADDRESS 0xFFF8FC29 /end MEASUREMENT
/begin MEASUREMENT ZFFSAB._.BackToNormalFunctionViaReset.f_LimphomeD "Error flag used to inform ABK that a RzN-SW-Reset is about to come" UBYTE SAB_STANDARD_S2_S3 1 100 0 1 DISPLAY_IDENTIFIER f_LimphomeD.BackToNormalFunctionViaReset._.ZFFSAB ECU_ADDRESS 0xFFF8FC2A /end MEASUREMENT
/begin MEASUREMENT ZFFSAB._.BackToNormalFunctionViaReset.f_LimphomeD_ "Complement of the error flag used to inform ABK that a RzN-SW-Reset is about to come" UBYTE SAB_STANDARD_S2_S3 1 100 0 1 DISPLAY_IDENTIFIER f_LimphomeD_.BackToNormalFunctionViaReset._.ZFFSAB ECU_ADDRESS 0xFFF8FC2B /end MEASUREMENT
/begin MEASUREMENT ZFFSAB._.BackToNormalFunctionViaReset.f_Reset_DetectedTimer "Flag set to one after a RzN reset as long as the timer tmr_delay_LimphomeCnt has not elapsed" UBYTE SAB_STANDARD_S2_S3 1 100 0 1 DISPLAY_IDENTIFIER f_Reset_DetectedTimer.BackToNormalFunctionViaReset._.ZFFSAB ECU_ADDRESS 0xFFF8FC2C /end MEASUREMENT
/begin MEASUREMENT ZFFSAB._.BackToNormalFunctionViaReset.f_Reset_DetectedTimer_ "Complement of the flag set to one after a RzN reset as long as the timer tmr_delay_LimphomeCnt has not elapsed" UBYTE SAB_STANDARD_S2_S3 1 100 0 1 DISPLAY_IDENTIFIER f_Reset_DetectedTimer_.BackToNormalFunctionViaReset._.ZFFSAB ECU_ADDRESS 0xFFF8FC2D /end MEASUREMENT
/begin MEASUREMENT ZFFSAB._.BackToNormalFunctionViaResetBPRAM.Reset_cnt "Variable which counts the number of resets done in this module" UBYTE SAB_STANDARD_S2_S3 1 100 0 1 DISPLAY_IDENTIFIER Reset_cnt.BackToNormalFunctionViaResetBPRAM._.ZFFSAB ECU_ADDRESS 0xFFF83B5A /end MEASUREMENT
/begin MEASUREMENT ZFFSAB._.BackToNormalFunctionViaResetBPRAM.Reset_cnt_ "Complement of variable which counts the number of resets done in this module" UBYTE SAB_STANDARD_S2_S3 1 100 0 1 DISPLAY_IDENTIFIER Reset_cnt_.BackToNormalFunctionViaResetBPRAM._.ZFFSAB ECU_ADDRESS 0xFFF83B5B /end MEASUREMENT
/begin MEASUREMENT ZFFSAB._.BackToNormalFunctionViaResetBPRAM.f_Reset_Detected "Flag which stores in the BPRAM the information whether there has been a RzN-SW-Reset or not" UBYTE SAB_STANDARD_S2_S3 1 100 0 1 DISPLAY_IDENTIFIER f_Reset_Detected.BackToNormalFunctionViaResetBPRAM._.ZFFSAB ECU_ADDRESS 0xFFF83B5C /end MEASUREMENT
/begin MEASUREMENT ZFFSAB._.BackToNormalFunctionViaResetBPRAM.f_Reset_Detected_ "Complement of the flag which stores in the BPRAM the information whether there has been a RzN-SW-Reset or not" UBYTE SAB_STANDARD_S2_S3 1 100 0 1 DISPLAY_IDENTIFIER f_Reset_Detected_.BackToNormalFunctionViaResetBPRAM._.ZFFSAB ECU_ADDRESS 0xFFF83B5D /end MEASUREMENT
/begin MEASUREMENT ZFFSAB._.BackToNormalFunctionViaResetBPRAM.f_Relevant_KFC_Active "Flag set to one if no relevant KFC from D_TabRzNinCruiseCnt_KFC is active" UBYTE SAB_STANDARD_S2_S3 1 100 0 1 DISPLAY_IDENTIFIER f_Relevant_KFC_Active.BackToNormalFunctionViaResetBPRAM._.ZFFSAB ECU_ADDRESS 0xFFF83B5E /end MEASUREMENT
/begin MEASUREMENT ZFFSAB._.BackToNormalFunctionViaResetBPRAM.f_Relevant_KFC_Active_ "Complement of the flag set to one if no relevant KFC from D_TabRzNinCruiseCnt_KFC is active" UBYTE SAB_STANDARD_S2_S3 1 100 0 1 DISPLAY_IDENTIFIER f_Relevant_KFC_Active_.BackToNormalFunctionViaResetBPRAM._.ZFFSAB ECU_ADDRESS 0xFFF83B5F /end MEASUREMENT
/begin MEASUREMENT ZFFSAB._.GearRatioByCurrents.tmr_iGangDiagDelay_LEV2.time "Description for this variable only in SW documentation possible not in asap2" ULONG SAB_T_TIMER_10MS_S2_S3 1 100 0 42949672950 DISPLAY_IDENTIFIER time.tmr_iGangDiagDelay_LEV2.GearRatioByCurrents._.ZFFSAB ECU_ADDRESS 0xFFF8FC84 /end MEASUREMENT
/begin MEASUREMENT ZFFSAB._.GearRatioByCurrents.tmr_iGangDiagDelay_LEV2.time_ "Description for this variable only in SW documentation possible not in asap2" ULONG SAB_T_TIMER_10MS_S2_S3 1 100 0 42949672950 DISPLAY_IDENTIFIER time_.tmr_iGangDiagDelay_LEV2.GearRatioByCurrents._.ZFFSAB ECU_ADDRESS 0xFFF8FC88 /end MEASUREMENT
/begin MEASUREMENT ZFFSAB._.GearRatioByCurrents.tmr_t_nDiagDelay_LEV2.time "Description for this variable only in SW documentation possible not in asap2" ULONG SAB_T_TIMER_10MS_S2_S3 1 100 0 42949672950 DISPLAY_IDENTIFIER time.tmr_t_nDiagDelay_LEV2.GearRatioByCurrents._.ZFFSAB ECU_ADDRESS 0xFFF8FC8C /end MEASUREMENT
/begin MEASUREMENT ZFFSAB._.GearRatioByCurrents.tmr_t_nDiagDelay_LEV2.time_ "Description for this variable only in SW documentation possible not in asap2" ULONG SAB_T_TIMER_10MS_S2_S3 1 100 0 42949672950 DISPLAY_IDENTIFIER time_.tmr_t_nDiagDelay_LEV2.GearRatioByCurrents._.ZFFSAB ECU_ADDRESS 0xFFF8FC90 /end MEASUREMENT
/begin MEASUREMENT ZFFSAB._.GearRatioByCurrents.tmr_IAEClose_LEV2.time "Description for this variable only in SW documentation possible not in asap2" ULONG SAB_T_TIMER_10MS_S2_S3 1 100 0 42949672950 DISPLAY_IDENTIFIER time.tmr_IAEClose_LEV2.GearRatioByCurrents._.ZFFSAB ECU_ADDRESS 0xFFF8FC94 /end MEASUREMENT
/begin MEASUREMENT ZFFSAB._.GearRatioByCurrents.tmr_IAEClose_LEV2.time_ "Description for this variable only in SW documentation possible not in asap2" ULONG SAB_T_TIMER_10MS_S2_S3 1 100 0 42949672950 DISPLAY_IDENTIFIER time_.tmr_IAEClose_LEV2.GearRatioByCurrents._.ZFFSAB ECU_ADDRESS 0xFFF8FC98 /end MEASUREMENT
/begin MEASUREMENT ZFFSAB._.GearRatioByCurrents.tmr_IAECloseDelay_LEV2.time "Description for this variable only in SW documentation possible not in asap2" ULONG SAB_T_TIMER_10MS_S2_S3 1 100 0 42949672950 DISPLAY_IDENTIFIER time.tmr_IAECloseDelay_LEV2.GearRatioByCurrents._.ZFFSAB ECU_ADDRESS 0xFFF8FC9C /end MEASUREMENT
/begin MEASUREMENT ZFFSAB._.GearRatioByCurrents.tmr_IAECloseDelay_LEV2.time_ "Description for this variable only in SW documentation possible not in asap2" ULONG SAB_T_TIMER_10MS_S2_S3 1 100 0 42949672950 DISPLAY_IDENTIFIER time_.tmr_IAECloseDelay_LEV2.GearRatioByCurrents._.ZFFSAB ECU_ADDRESS 0xFFF8FCA0 /end MEASUREMENT
/begin MEASUREMENT ZFFSAB._.GearRatioByCurrents.tmr_nTuVirtLev2Delay_LEV2.time "Description for this variable only in SW documentation possible not in asap2" ULONG SAB_T_TIMER_10MS_S2_S3 1 100 0 42949672950 DISPLAY_IDENTIFIER time.tmr_nTuVirtLev2Delay_LEV2.GearRatioByCurrents._.ZFFSAB ECU_ADDRESS 0xFFF8FCA4 /end MEASUREMENT
/begin MEASUREMENT ZFFSAB._.GearRatioByCurrents.tmr_nTuVirtLev2Delay_LEV2.time_ "Description for this variable only in SW documentation possible not in asap2" ULONG SAB_T_TIMER_10MS_S2_S3 1 100 0 42949672950 DISPLAY_IDENTIFIER time_.tmr_nTuVirtLev2Delay_LEV2.GearRatioByCurrents._.ZFFSAB ECU_ADDRESS 0xFFF8FCA8 /end MEASUREMENT
/begin MEASUREMENT ZFFSAB._.GearRatioByCurrents.tmr_nTuVirtPlausiErrDelay_LEV2.time "Description for this variable only in SW documentation possible not in asap2" ULONG SAB_T_TIMER_10MS_S2_S3 1 100 0 42949672950 DISPLAY_IDENTIFIER time.tmr_nTuVirtPlausiErrDelay_LEV2.GearRatioByCurrents._.ZFFSAB ECU_ADDRESS 0xFFF8FCAC /end MEASUREMENT
/begin MEASUREMENT ZFFSAB._.GearRatioByCurrents.tmr_nTuVirtPlausiErrDelay_LEV2.time_ "Description for this variable only in SW documentation possible not in asap2" ULONG SAB_T_TIMER_10MS_S2_S3 1 100 0 42949672950 DISPLAY_IDENTIFIER time_.tmr_nTuVirtPlausiErrDelay_LEV2.GearRatioByCurrents._.ZFFSAB ECU_ADDRESS 0xFFF8FCB0 /end MEASUREMENT
/begin MEASUREMENT ZFFSAB._.GearRatioByCurrents.GearRatioByCurrents_fl.tmr_iGangDiagDelay_LEV2.time "Description for this variable only in SW documentation possible not in asap2" ULONG SAB_T_TIMER_10MS_S2_S3 1 100 0 42949672950 DISPLAY_IDENTIFIER time.tmr_iGangDiagDelay_LEV2.GearRatioByCurrents_fl.GearRatioByCurrents._.ZFFSAB ECU_ADDRESS 0xFFF8FCB8 /end MEASUREMENT
/begin MEASUREMENT ZFFSAB._.GearRatioByCurrents.GearRatioByCurrents_fl.tmr_iGangDiagDelay_LEV2.time_ "Description for this variable only in SW documentation possible not in asap2" ULONG SAB_T_TIMER_10MS_S2_S3 1 100 0 42949672950 DISPLAY_IDENTIFIER time_.tmr_iGangDiagDelay_LEV2.GearRatioByCurrents_fl.GearRatioByCurrents._.ZFFSAB ECU_ADDRESS 0xFFF8FCBC /end MEASUREMENT
/begin MEASUREMENT ZFFSAB._.GearRatioByCurrents.GearRatioByCurrents_fl.tmr_t_nDiagDelay_LEV2.time "Description for this variable only in SW documentation possible not in asap2" ULONG SAB_T_TIMER_10MS_S2_S3 1 100 0 42949672950 DISPLAY_IDENTIFIER time.tmr_t_nDiagDelay_LEV2.GearRatioByCurrents_fl.GearRatioByCurrents._.ZFFSAB ECU_ADDRESS 0xFFF8FCC0 /end MEASUREMENT
/begin MEASUREMENT ZFFSAB._.GearRatioByCurrents.GearRatioByCurrents_fl.tmr_t_nDiagDelay_LEV2.time_ "Description for this variable only in SW documentation possible not in asap2" ULONG SAB_T_TIMER_10MS_S2_S3 1 100 0 42949672950 DISPLAY_IDENTIFIER time_.tmr_t_nDiagDelay_LEV2.GearRatioByCurrents_fl.GearRatioByCurrents._.ZFFSAB ECU_ADDRESS 0xFFF8FCC4 /end MEASUREMENT
/begin MEASUREMENT ZFFSAB._.GearRatioByCurrents.GearRatioByCurrents_fl.tmr_IAEClose_LEV2.time "Description for this variable only in SW documentation possible not in asap2" ULONG SAB_T_TIMER_10MS_S2_S3 1 100 0 42949672950 DISPLAY_IDENTIFIER time.tmr_IAEClose_LEV2.GearRatioByCurrents_fl.GearRatioByCurrents._.ZFFSAB ECU_ADDRESS 0xFFF8FCC8 /end MEASUREMENT
/begin MEASUREMENT ZFFSAB._.GearRatioByCurrents.GearRatioByCurrents_fl.tmr_IAEClose_LEV2.time_ "Description for this variable only in SW documentation possible not in asap2" ULONG SAB_T_TIMER_10MS_S2_S3 1 100 0 42949672950 DISPLAY_IDENTIFIER time_.tmr_IAEClose_LEV2.GearRatioByCurrents_fl.GearRatioByCurrents._.ZFFSAB ECU_ADDRESS 0xFFF8FCCC /end MEASUREMENT
/begin MEASUREMENT ZFFSAB._.GearRatioByCurrents.GearRatioByCurrents_fl.tmr_IAECloseDelay_LEV2.time "Description for this variable only in SW documentation possible not in asap2" ULONG SAB_T_TIMER_10MS_S2_S3 1 100 0 42949672950 DISPLAY_IDENTIFIER time.tmr_IAECloseDelay_LEV2.GearRatioByCurrents_fl.GearRatioByCurrents._.ZFFSAB ECU_ADDRESS 0xFFF8FCD0 /end MEASUREMENT
/begin MEASUREMENT ZFFSAB._.GearRatioByCurrents.GearRatioByCurrents_fl.tmr_IAECloseDelay_LEV2.time_ "Description for this variable only in SW documentation possible not in asap2" ULONG SAB_T_TIMER_10MS_S2_S3 1 100 0 42949672950 DISPLAY_IDENTIFIER time_.tmr_IAECloseDelay_LEV2.GearRatioByCurrents_fl.GearRatioByCurrents._.ZFFSAB ECU_ADDRESS 0xFFF8FCD4 /end MEASUREMENT
/begin MEASUREMENT ZFFSAB._.GearRatioByCurrents.GearRatioByCurrents_fl.tmr_nTuVirtLev2Delay_LEV2.time "Description for this variable only in SW documentation possible not in asap2" ULONG SAB_T_TIMER_10MS_S2_S3 1 100 0 42949672950 DISPLAY_IDENTIFIER time.tmr_nTuVirtLev2Delay_LEV2.GearRatioByCurrents_fl.GearRatioByCurrents._.ZFFSAB ECU_ADDRESS 0xFFF8FCD8 /end MEASUREMENT
/begin MEASUREMENT ZFFSAB._.GearRatioByCurrents.GearRatioByCurrents_fl.tmr_nTuVirtLev2Delay_LEV2.time_ "Description for this variable only in SW documentation possible not in asap2" ULONG SAB_T_TIMER_10MS_S2_S3 1 100 0 42949672950 DISPLAY_IDENTIFIER time_.tmr_nTuVirtLev2Delay_LEV2.GearRatioByCurrents_fl.GearRatioByCurrents._.ZFFSAB ECU_ADDRESS 0xFFF8FCDC /end MEASUREMENT
/begin MEASUREMENT ZFFSAB._.GearRatioByCurrents.GearRatioByCurrents_fl.tmr_nTuVirtPlausiErrDelay_LEV2.time "Description for this variable only in SW documentation possible not in asap2" ULONG SAB_T_TIMER_10MS_S2_S3 1 100 0 42949672950 DISPLAY_IDENTIFIER time.tmr_nTuVirtPlausiErrDelay_LEV2.GearRatioByCurrents_fl.GearRatioByCurrents._.ZFFSAB ECU_ADDRESS 0xFFF8FCE0 /end MEASUREMENT
/begin MEASUREMENT ZFFSAB._.GearRatioByCurrents.GearRatioByCurrents_fl.tmr_nTuVirtPlausiErrDelay_LEV2.time_ "Description for this variable only in SW documentation possible not in asap2" ULONG SAB_T_TIMER_10MS_S2_S3 1 100 0 42949672950 DISPLAY_IDENTIFIER time_.tmr_nTuVirtPlausiErrDelay_LEV2.GearRatioByCurrents_fl.GearRatioByCurrents._.ZFFSAB ECU_ADDRESS 0xFFF8FCE4 /end MEASUREMENT
/begin MEASUREMENT ZFFSAB._.GearRatioByCurrents.GearRatioByCurrents_fl.iv_iGang "Current gear ratio calculated by electric currents of actuators IEDS0..IEDS4" FLOAT32_IEEE SAB_K1000_S2_S3 1 100 -32.768 32.767 DISPLAY_IDENTIFIER iv_iGang.GearRatioByCurrents_fl.GearRatioByCurrents._.ZFFSAB ECU_ADDRESS 0xFFF8FCE8 /end MEASUREMENT
/begin MEASUREMENT ZFFSAB._.GearRatioByCurrents.GearRatioByCurrents_fl.iv_iGang_ "Complement value of GET_IGANG_LEV2" FLOAT32_IEEE SAB_STANDARD_S2_S3 1 100 -32768 32767 FORMAT "%5.3" DISPLAY_IDENTIFIER iv_iGang_.GearRatioByCurrents_fl.GearRatioByCurrents._.ZFFSAB ECU_ADDRESS 0xFFF8FCEC /end MEASUREMENT
/begin MEASUREMENT ZFFSAB._.GearRatioByCurrents.GearRatioByCurrents_fl.iv_IstGang "Current selected gear calculated by electric currents of actuators IEDS0..IEDS4" FLOAT32_IEEE SAB_STANDARD_S2_S3 1 100 -1 8 FORMAT "%5.3" DISPLAY_IDENTIFIER iv_IstGang.GearRatioByCurrents_fl.GearRatioByCurrents._.ZFFSAB ECU_ADDRESS 0xFFF8FCF0 /end MEASUREMENT
/begin MEASUREMENT ZFFSAB._.GearRatioByCurrents.GearRatioByCurrents_fl.iv_IstGang_ "Complement value of GET_ISTGANG_LEV2" FLOAT32_IEEE SAB_STANDARD_S2_S3 1 100 -128 127 FORMAT "%5.3" DISPLAY_IDENTIFIER iv_IstGang_.GearRatioByCurrents_fl.GearRatioByCurrents._.ZFFSAB ECU_ADDRESS 0xFFF8FCF4 /end MEASUREMENT
/begin MEASUREMENT ZFFSAB._.GearRatioByCurrents.GearRatioByCurrents_fl.iGang "Calculated gear ratio" FLOAT32_IEEE SAB_K1000_S2_S3 1 100 0 65.535 DISPLAY_IDENTIFIER iGang.GearRatioByCurrents_fl.GearRatioByCurrents._.ZFFSAB ECU_ADDRESS 0xFFF8FCF8 /end MEASUREMENT
/begin MEASUREMENT ZFFSAB._.GearRatioByCurrents.GearRatioByCurrents_fl.IstGang "Calculated gear with different definition: 255=not defined 0=backward 1..8 forward" FLOAT32_IEEE SAB_STANDARD_S2_S3 1 100 0 255 FORMAT "%5.3" DISPLAY_IDENTIFIER IstGang.GearRatioByCurrents_fl.GearRatioByCurrents._.ZFFSAB ECU_ADDRESS 0xFFF8FCFC /end MEASUREMENT
/begin MEASUREMENT ZFFSAB._.GearRatioByCurrents.GearRatioByCurrents_fl.IstGangOld "Old value of calculated gear" FLOAT32_IEEE SAB_STANDARD_S2_S3 1 100 0 255 FORMAT "%5.3" DISPLAY_IDENTIFIER IstGangOld.GearRatioByCurrents_fl.GearRatioByCurrents._.ZFFSAB ECU_ADDRESS 0xFFF8FD00 /end MEASUREMENT
/begin MEASUREMENT ZFFSAB._.GearRatioByCurrents.GearRatioByCurrents_fl.iv_n_Tu "Is the n_TuVirt of Lev1 calculation" FLOAT32_IEEE SAB_N_1RPM_S2_S3 1 100 0 65535 FORMAT "%5.3" DISPLAY_IDENTIFIER iv_n_Tu.GearRatioByCurrents_fl.GearRatioByCurrents._.ZFFSAB ECU_ADDRESS 0xFFF8FD04 /end MEASUREMENT
/begin MEASUREMENT ZFFSAB._.GearRatioByCurrents.GearRatioByCurrents_fl.iv_n_Tu_ "Complement of iv_n_Tu" FLOAT32_IEEE SAB_STANDARD_S2_S3 1 100 0 65535 FORMAT "%5.3" DISPLAY_IDENTIFIER iv_n_Tu_.GearRatioByCurrents_fl.GearRatioByCurrents._.ZFFSAB ECU_ADDRESS 0xFFF8FD08 /end MEASUREMENT
/begin MEASUREMENT ZFFSAB._.GearRatioByCurrents.GearRatioByCurrents_fl.iv_n6 "Raw value of shaft 6 rotational speed" FLOAT32_IEEE SAB_N_1RPM_S2_S3 1 100 0 65535 FORMAT "%5.3" DISPLAY_IDENTIFIER iv_n6.GearRatioByCurrents_fl.GearRatioByCurrents._.ZFFSAB ECU_ADDRESS 0xFFF8FD0C /end MEASUREMENT
/begin MEASUREMENT ZFFSAB._.GearRatioByCurrents.GearRatioByCurrents_fl.iv_n6_ "Complement of iv_n6" FLOAT32_IEEE SAB_STANDARD_S2_S3 1 100 0 65535 FORMAT "%5.3" DISPLAY_IDENTIFIER iv_n6_.GearRatioByCurrents_fl.GearRatioByCurrents._.ZFFSAB ECU_ADDRESS 0xFFF8FD10 /end MEASUREMENT
/begin MEASUREMENT ZFFSAB._.GearRatioByCurrents.GearRatioByCurrents_fl.iv_sts_n6_DirectionDiag "Direction flag of n6 rotation" FLOAT32_IEEE SAB_STANDARD_S2_S3 1 100 0 255 FORMAT "%5.3" DISPLAY_IDENTIFIER iv_sts_n6_DirectionDiag.GearRatioByCurrents_fl.GearRatioByCurrents._.ZFFSAB ECU_ADDRESS 0xFFF8FD14 /end MEASUREMENT
/begin MEASUREMENT ZFFSAB._.GearRatioByCurrents.GearRatioByCurrents_fl.iv_sts_n6_DirectionDiag_ "Complement of iv_sts_n6_DirectionDiag" FLOAT32_IEEE SAB_STANDARD_S2_S3 1 100 0 255 FORMAT "%5.3" DISPLAY_IDENTIFIER iv_sts_n6_DirectionDiag_.GearRatioByCurrents_fl.GearRatioByCurrents._.ZFFSAB ECU_ADDRESS 0xFFF8FD18 /end MEASUREMENT
/begin MEASUREMENT ZFFSAB._.GearRatioByCurrents.GearRatioByCurrents_fl.sts_n6_Dir "Direction sign of n6 rotation 1=positive -1=negative 0=not defined" FLOAT32_IEEE SAB_STANDARD_S2_S3 1 100 0 255 FORMAT "%5.3" DISPLAY_IDENTIFIER sts_n6_Dir.GearRatioByCurrents_fl.GearRatioByCurrents._.ZFFSAB ECU_ADDRESS 0xFFF8FD1C /end MEASUREMENT
/begin MEASUREMENT ZFFSAB._.GearRatioByCurrents.GearRatioByCurrents_fl.f_n6nEngErr "Flag indicating that n6 and nEM are not plausible to each other" FLOAT32_IEEE SAB_STANDARD_S2_S3 1 100 0 1 FORMAT "%5.3" DISPLAY_IDENTIFIER f_n6nEngErr.GearRatioByCurrents_fl.GearRatioByCurrents._.ZFFSAB ECU_ADDRESS 0xFFF8FD20 /end MEASUREMENT
/begin MEASUREMENT ZFFSAB._.GearRatioByCurrents.GearRatioByCurrents_fl.sv_f_IAE_ReqSubst "Flag indicating a request to IAE to go to state over pressure" FLOAT32_IEEE SAB_STANDARD_S2_S3 1 100 0 1 FORMAT "%5.3" DISPLAY_IDENTIFIER sv_f_IAE_ReqSubst.GearRatioByCurrents_fl.GearRatioByCurrents._.ZFFSAB ECU_ADDRESS 0xFFF8FD24 /end MEASUREMENT
/begin MEASUREMENT ZFFSAB._.GearRatioByCurrents.GearRatioByCurrents_fl.iv_sts_ClutchIAE "Status signal of IAE" FLOAT32_IEEE SAB_STANDARD_S2_S3 1 100 0 255 FORMAT "%5.3" DISPLAY_IDENTIFIER iv_sts_ClutchIAE.GearRatioByCurrents_fl.GearRatioByCurrents._.ZFFSAB ECU_ADDRESS 0xFFF8FD28 /end MEASUREMENT
/begin MEASUREMENT ZFFSAB._.GearRatioByCurrents.GearRatioByCurrents_fl.f_n_TuVirtPlausiErr "Flag indicating that iv_n_Tu = n_TuVirt Lev1 and n_TuVirtLev2 are not plausible to each other" FLOAT32_IEEE SAB_STANDARD_S2_S3 1 100 0 1 FORMAT "%5.3" DISPLAY_IDENTIFIER f_n_TuVirtPlausiErr.GearRatioByCurrents_fl.GearRatioByCurrents._.ZFFSAB ECU_ADDRESS 0xFFF8FD2C /end MEASUREMENT
/begin MEASUREMENT ZFFSAB._.GearRatioByCurrents.GearRatioByCurrents_fl.n_TuVirtLev2Sts "Status of n_TuVirtLev2 0=OK 2=Calculation not possible" FLOAT32_IEEE SAB_STANDARD_S2_S3 1 100 0 2 FORMAT "%5.3" DISPLAY_IDENTIFIER n_TuVirtLev2Sts.GearRatioByCurrents_fl.GearRatioByCurrents._.ZFFSAB ECU_ADDRESS 0xFFF8FD30 /end MEASUREMENT
/begin MEASUREMENT ZFFSAB._.GearRatioByCurrents.GearRatioByCurrents_fl.n_AbByWheelAvg "Calculated n_Ab using n_WheelAvg from CAN" FLOAT32_IEEE SAB_N_1RPM_S2_S3 1 100 0 65535 FORMAT "%5.3" DISPLAY_IDENTIFIER n_AbByWheelAvg.GearRatioByCurrents_fl.GearRatioByCurrents._.ZFFSAB ECU_ADDRESS 0xFFF8FD34 /end MEASUREMENT
/begin MEASUREMENT ZFFSAB._.GearRatioByCurrents.GearRatioByCurrents_fl.n_WheelAvgSts "Status of n_WheelAvg signal from CAN" FLOAT32_IEEE SAB_STANDARD_S2_S3 1 100 0 2 FORMAT "%5.3" DISPLAY_IDENTIFIER n_WheelAvgSts.GearRatioByCurrents_fl.GearRatioByCurrents._.ZFFSAB ECU_ADDRESS 0xFFF8FD38 /end MEASUREMENT
/begin MEASUREMENT ZFFSAB._.GearRatioByCurrents.GearRatioByCurrents_fl.n_TuVirtLev2 "Raw value of turbine rotational speed" FLOAT32_IEEE SAB_N_1RPM_S2_S3 1 100 0 65535 FORMAT "%5.3" DISPLAY_IDENTIFIER n_TuVirtLev2.GearRatioByCurrents_fl.GearRatioByCurrents._.ZFFSAB ECU_ADDRESS 0xFFF8FD3C /end MEASUREMENT
/begin MEASUREMENT ZFFSAB._.GearRatioByCurrents.GearRatioByCurrents_fl.iv_n6_ESts "Electrical status of turbine rotational speed" FLOAT32_IEEE SAB_STANDARD_S2_S3 1 100 0 2 FORMAT "%5.3" DISPLAY_IDENTIFIER iv_n6_ESts.GearRatioByCurrents_fl.GearRatioByCurrents._.ZFFSAB ECU_ADDRESS 0xFFF8FD40 /end MEASUREMENT
/begin MEASUREMENT ZFFSAB._.GearRatioByCurrents.GearRatioByCurrents_fl.iv_n_Ab "Raw value of Transmission output rotational speed" FLOAT32_IEEE SAB_N_1RPM_S2_S3 1 100 0 65535 FORMAT "%5.3" DISPLAY_IDENTIFIER iv_n_Ab.GearRatioByCurrents_fl.GearRatioByCurrents._.ZFFSAB ECU_ADDRESS 0xFFF8FD44 /end MEASUREMENT
/begin MEASUREMENT ZFFSAB._.GearRatioByCurrents.GearRatioByCurrents_fl.iv_n_AbESts "Electrical status of transmission output rotational speed" FLOAT32_IEEE SAB_STANDARD_S2_S3 1 100 0 2 FORMAT "%5.3" DISPLAY_IDENTIFIER iv_n_AbESts.GearRatioByCurrents_fl.GearRatioByCurrents._.ZFFSAB ECU_ADDRESS 0xFFF8FD48 /end MEASUREMENT
/begin MEASUREMENT ZFFSAB._.GearRatioByCurrents.GearRatioByCurrents_fl.sv_n_EngLev2 "Engine speed" FLOAT32_IEEE SAB_N_1RPM_S2_S3 1 100 0 65535 FORMAT "%5.3" DISPLAY_IDENTIFIER sv_n_EngLev2.GearRatioByCurrents_fl.GearRatioByCurrents._.ZFFSAB ECU_ADDRESS 0xFFF8FD4C /end MEASUREMENT
/begin MEASUREMENT ZFFSAB._.GearRatioByCurrents.GearRatioByCurrents_fl.sv_n_EngLev2Sts "Status of Engine speed" FLOAT32_IEEE SAB_STANDARD_S2_S3 1 100 0 2 FORMAT "%5.3" DISPLAY_IDENTIFIER sv_n_EngLev2Sts.GearRatioByCurrents_fl.GearRatioByCurrents._.ZFFSAB ECU_ADDRESS 0xFFF8FD50 /end MEASUREMENT
/begin MEASUREMENT ZFFSAB._.GearRatioByCurrents.GearRatioByCurrents_fl.f_RearAxleRatioLearned "Flag indicating that rear axle ratio is learned or learn function is disabled" FLOAT32_IEEE SAB_STANDARD_S2_S3 1 100 0 1 FORMAT "%5.3" DISPLAY_IDENTIFIER f_RearAxleRatioLearned.GearRatioByCurrents_fl.GearRatioByCurrents._.ZFFSAB ECU_ADDRESS 0xFFF8FD54 /end MEASUREMENT
/begin MEASUREMENT ZFFSAB._.GearRatioByCurrents.GearRatioByCurrents_fl.f_RearAxleRatioLearned_ "Complement of f_RearAxleRatioLearned" FLOAT32_IEEE SAB_STANDARD_S2_S3 1 100 0 255 FORMAT "%5.3" DISPLAY_IDENTIFIER f_RearAxleRatioLearned_.GearRatioByCurrents_fl.GearRatioByCurrents._.ZFFSAB ECU_ADDRESS 0xFFF8FD58 /end MEASUREMENT
/begin MEASUREMENT ZFFSAB._.GearRatioByCurrents.GearRatioByCurrents_fl.n_AbByWheelAvg_ "Complement of n_AbByWheelAvg" FLOAT32_IEEE SAB_STANDARD_S2_S3 1 100 0 65535 FORMAT "%5.3" DISPLAY_IDENTIFIER n_AbByWheelAvg_.GearRatioByCurrents_fl.GearRatioByCurrents._.ZFFSAB ECU_ADDRESS 0xFFF8FD5C /end MEASUREMENT
/begin MEASUREMENT ZFFSAB._.GearRatioByCurrents.GearRatioByCurrents_fl.n_WheelAvgSts_ "Complement of n_WheelAvgSts" FLOAT32_IEEE SAB_STANDARD_S2_S3 1 100 0 255 FORMAT "%5.3" DISPLAY_IDENTIFIER n_WheelAvgSts_.GearRatioByCurrents_fl.GearRatioByCurrents._.ZFFSAB ECU_ADDRESS 0xFFF8FD60 /end MEASUREMENT
/begin MEASUREMENT ZFFSAB._.GearRatioByCurrents.GearRatioByCurrents_fl.n_TuVirtLev2_ "Complement of iv_n_Tu" FLOAT32_IEEE SAB_STANDARD_S2_S3 1 100 0 65535 FORMAT "%5.3" DISPLAY_IDENTIFIER n_TuVirtLev2_.GearRatioByCurrents_fl.GearRatioByCurrents._.ZFFSAB ECU_ADDRESS 0xFFF8FD64 /end MEASUREMENT
/begin MEASUREMENT ZFFSAB._.GearRatioByCurrents.GearRatioByCurrents_fl.iv_n6_ESts_ "Complement of iv_n_TuESts" FLOAT32_IEEE SAB_STANDARD_S2_S3 1 100 0 255 FORMAT "%5.3" DISPLAY_IDENTIFIER iv_n6_ESts_.GearRatioByCurrents_fl.GearRatioByCurrents._.ZFFSAB ECU_ADDRESS 0xFFF8FD68 /end MEASUREMENT
/begin MEASUREMENT ZFFSAB._.GearRatioByCurrents.GearRatioByCurrents_fl.iv_n_Ab_ "Complement of iv_n_Ab" FLOAT32_IEEE SAB_STANDARD_S2_S3 1 100 0 65535 FORMAT "%5.3" DISPLAY_IDENTIFIER iv_n_Ab_.GearRatioByCurrents_fl.GearRatioByCurrents._.ZFFSAB ECU_ADDRESS 0xFFF8FD6C /end MEASUREMENT
/begin MEASUREMENT ZFFSAB._.GearRatioByCurrents.GearRatioByCurrents_fl.iv_n_AbESts_ "Complement of iv_n_AbESts" FLOAT32_IEEE SAB_STANDARD_S2_S3 1 100 0 255 FORMAT "%5.3" DISPLAY_IDENTIFIER iv_n_AbESts_.GearRatioByCurrents_fl.GearRatioByCurrents._.ZFFSAB ECU_ADDRESS 0xFFF8FD70 /end MEASUREMENT
/begin MEASUREMENT ZFFSAB._.GearRatioByCurrents.GearRatioByCurrents_fl.sv_n_EngLev2_ "Complement of sv_n_EngLev2" FLOAT32_IEEE SAB_STANDARD_S2_S3 1 100 0 65535 FORMAT "%5.3" DISPLAY_IDENTIFIER sv_n_EngLev2_.GearRatioByCurrents_fl.GearRatioByCurrents._.ZFFSAB ECU_ADDRESS 0xFFF8FD74 /end MEASUREMENT
/begin MEASUREMENT ZFFSAB._.GearRatioByCurrents.GearRatioByCurrents_fl.sv_n_EngLev2Sts_ "Complement of sv_n_EngLev2Sts" FLOAT32_IEEE SAB_STANDARD_S2_S3 1 100 0 255 FORMAT "%5.3" DISPLAY_IDENTIFIER sv_n_EngLev2Sts_.GearRatioByCurrents_fl.GearRatioByCurrents._.ZFFSAB ECU_ADDRESS 0xFFF8FD78 /end MEASUREMENT
/begin MEASUREMENT ZFFSAB._.GearRatioByCurrents.GearRatioByCurrents_fl.f_n_AbWheelErr "Flag indicating that n_Ab and CAN n_Wheel are not plausible to each other" FLOAT32_IEEE SAB_STANDARD_S2_S3 1 100 0 1 FORMAT "%5.3" DISPLAY_IDENTIFIER f_n_AbWheelErr.GearRatioByCurrents_fl.GearRatioByCurrents._.ZFFSAB ECU_ADDRESS 0xFFF8FD7C /end MEASUREMENT
/begin MEASUREMENT ZFFSAB._.GearRatioByCurrents.GearRatioByCurrents_fl.f_n_Abn6Err "Flag indicating that n_Ab and n_Tu are not plausible to each other" FLOAT32_IEEE SAB_STANDARD_S2_S3 1 100 0 1 FORMAT "%5.3" DISPLAY_IDENTIFIER f_n_Abn6Err.GearRatioByCurrents_fl.GearRatioByCurrents._.ZFFSAB ECU_ADDRESS 0xFFF8FD80 /end MEASUREMENT
/begin MEASUREMENT ZFFSAB._.GearRatioByCurrents.GearRatioByCurrents_fl.f_n6WheelErr "Flag indicating that n_Tu and CAN n_Wheel are not plausible to each other" FLOAT32_IEEE SAB_STANDARD_S2_S3 1 100 0 1 FORMAT "%5.3" DISPLAY_IDENTIFIER f_n6WheelErr.GearRatioByCurrents_fl.GearRatioByCurrents._.ZFFSAB ECU_ADDRESS 0xFFF8FD84 /end MEASUREMENT
/begin MEASUREMENT ZFFSAB._.GearRatioByCurrents.GearRatioByCurrents_fl.f_xErrChanged "Flag indicating that one of the f_n_*Err flags has changed from 0 to 1" FLOAT32_IEEE SAB_STANDARD_S2_S3 1 100 0 1 FORMAT "%5.3" DISPLAY_IDENTIFIER f_xErrChanged.GearRatioByCurrents_fl.GearRatioByCurrents._.ZFFSAB ECU_ADDRESS 0xFFF8FD88 /end MEASUREMENT
/begin MEASUREMENT ZFFSAB._.GearRatioByCurrents.GearRatioByCurrents_fl.err_flags_old "Packed error flags to be stored in EEPROM Bits: 2: f_n_AbWheelErr 1: f_n_AbTuErr 0: f_n_TuWheelErr" FLOAT32_IEEE SAB_STANDARD_S2_S3 1 100 0 255 FORMAT "%5.3" DISPLAY_IDENTIFIER err_flags_old.GearRatioByCurrents_fl.GearRatioByCurrents._.ZFFSAB ECU_ADDRESS 0xFFF8FD8C /end MEASUREMENT
/begin MEASUREMENT ZFFSAB._.GearRatioByCurrents.GearRatioByCurrents_fl.err_flags_old_ "Complement of err_flags_old" FLOAT32_IEEE SAB_STANDARD_S2_S3 1 100 0 255 FORMAT "%5.3" DISPLAY_IDENTIFIER err_flags_old_.GearRatioByCurrents_fl.GearRatioByCurrents._.ZFFSAB ECU_ADDRESS 0xFFF8FD90 /end MEASUREMENT
/begin MEASUREMENT ZFFSAB._.GearRatioByCurrents.GearRatioByCurrents_fl.sv_st_KL15 "Ignition state" FLOAT32_IEEE SAB_STANDARD_S2_S3 1 100 0 255 FORMAT "%5.3" DISPLAY_IDENTIFIER sv_st_KL15.GearRatioByCurrents_fl.GearRatioByCurrents._.ZFFSAB ECU_ADDRESS 0xFFF8FD94 /end MEASUREMENT
/begin MEASUREMENT ZFFSAB._.GearRatioByCurrents.GearRatioByCurrents_fl.sv_st_KL15_ "Complement of sv_st_KL15" FLOAT32_IEEE SAB_STANDARD_S2_S3 1 100 0 255 FORMAT "%5.3" DISPLAY_IDENTIFIER sv_st_KL15_.GearRatioByCurrents_fl.GearRatioByCurrents._.ZFFSAB ECU_ADDRESS 0xFFF8FD98 /end MEASUREMENT
/begin MEASUREMENT ZFFSAB._.GearRatioByCurrents.GearRatioByCurrents_fl.f_n_AbPlausiErr "Flag indicating that n_Ab is not plausible to CAN n_Wheel and n_Tu" FLOAT32_IEEE SAB_STANDARD_S2_S3 1 100 0 1 FORMAT "%5.3" DISPLAY_IDENTIFIER f_n_AbPlausiErr.GearRatioByCurrents_fl.GearRatioByCurrents._.ZFFSAB ECU_ADDRESS 0xFFF8FD9C /end MEASUREMENT
/begin MEASUREMENT ZFFSAB._.GearRatioByCurrents.GearRatioByCurrents_fl.f_n_WheelPlausiErr "Flag indicating that CAN n_Wheel is not plausible to n_Ab and n_Tu" FLOAT32_IEEE SAB_STANDARD_S2_S3 1 100 0 1 FORMAT "%5.3" DISPLAY_IDENTIFIER f_n_WheelPlausiErr.GearRatioByCurrents_fl.GearRatioByCurrents._.ZFFSAB ECU_ADDRESS 0xFFF8FDA0 /end MEASUREMENT
/begin MEASUREMENT ZFFSAB._.GearRatioByCurrents.GearRatioByCurrents_fl.f_n6PlausiErr "Flag indicating that n_Tu is not plausible to CAN n_Wheel and n_Ab" FLOAT32_IEEE SAB_STANDARD_S2_S3 1 100 0 1 FORMAT "%5.3" DISPLAY_IDENTIFIER f_n6PlausiErr.GearRatioByCurrents_fl.GearRatioByCurrents._.ZFFSAB ECU_ADDRESS 0xFFF8FDA4 /end MEASUREMENT
/begin MEASUREMENT ZFFSAB._.GearRatioByCurrents.GearRatioByCurrents_fl.f_n_PlausiErr "Flag indicating that there are more than two signals of n_Ab n_Tu and n_Wheel have failed" FLOAT32_IEEE SAB_STANDARD_S2_S3 1 100 0 1 FORMAT "%5.3" DISPLAY_IDENTIFIER f_n_PlausiErr.GearRatioByCurrents_fl.GearRatioByCurrents._.ZFFSAB ECU_ADDRESS 0xFFF8FDA8 /end MEASUREMENT
/begin MEASUREMENT ZFFSAB._.RPM_Diagnosis.tmr_t_delay_SENSORLEV2.time "Description for this variable only in SW documentation possible not in asap2" ULONG SAB_T_TIMER_10MS_S2_S3 1 100 0 42949672950 DISPLAY_IDENTIFIER time.tmr_t_delay_SENSORLEV2.RPM_Diagnosis._.ZFFSAB ECU_ADDRESS 0xFFF8FE04 /end MEASUREMENT
/begin MEASUREMENT ZFFSAB._.RPM_Diagnosis.tmr_t_delay_SENSORLEV2.time_ "Description for this variable only in SW documentation possible not in asap2" ULONG SAB_T_TIMER_10MS_S2_S3 1 100 0 42949672950 DISPLAY_IDENTIFIER time_.tmr_t_delay_SENSORLEV2.RPM_Diagnosis._.ZFFSAB ECU_ADDRESS 0xFFF8FE08 /end MEASUREMENT
/begin MEASUREMENT ZFFSAB._.RPM_Diagnosis.tmr_t_delay_1SENSORLEV2.time "Description for this variable only in SW documentation possible not in asap2" ULONG SAB_T_TIMER_10MS_S2_S3 1 100 0 42949672950 DISPLAY_IDENTIFIER time.tmr_t_delay_1SENSORLEV2.RPM_Diagnosis._.ZFFSAB ECU_ADDRESS 0xFFF8FE0C /end MEASUREMENT
/begin MEASUREMENT ZFFSAB._.RPM_Diagnosis.tmr_t_delay_1SENSORLEV2.time_ "Description for this variable only in SW documentation possible not in asap2" ULONG SAB_T_TIMER_10MS_S2_S3 1 100 0 42949672950 DISPLAY_IDENTIFIER time_.tmr_t_delay_1SENSORLEV2.RPM_Diagnosis._.ZFFSAB ECU_ADDRESS 0xFFF8FE10 /end MEASUREMENT
/begin MEASUREMENT ZFFSAB._.RPM_Diagnosis.tmr_t_delay_N6LEV2.time "Description for this variable only in SW documentation possible not in asap2" ULONG SAB_T_TIMER_10MS_S2_S3 1 100 0 42949672950 DISPLAY_IDENTIFIER time.tmr_t_delay_N6LEV2.RPM_Diagnosis._.ZFFSAB ECU_ADDRESS 0xFFF8FE14 /end MEASUREMENT
/begin MEASUREMENT ZFFSAB._.RPM_Diagnosis.tmr_t_delay_N6LEV2.time_ "Description for this variable only in SW documentation possible not in asap2" ULONG SAB_T_TIMER_10MS_S2_S3 1 100 0 42949672950 DISPLAY_IDENTIFIER time_.tmr_t_delay_N6LEV2.RPM_Diagnosis._.ZFFSAB ECU_ADDRESS 0xFFF8FE18 /end MEASUREMENT
/begin MEASUREMENT ZFFSAB._.RPM_Diagnosis.tmr_t_delay_N6PLAUSILEV2.time "Description for this variable only in SW documentation possible not in asap2" ULONG SAB_T_TIMER_10MS_S2_S3 1 100 0 42949672950 DISPLAY_IDENTIFIER time.tmr_t_delay_N6PLAUSILEV2.RPM_Diagnosis._.ZFFSAB ECU_ADDRESS 0xFFF8FE1C /end MEASUREMENT
/begin MEASUREMENT ZFFSAB._.RPM_Diagnosis.tmr_t_delay_N6PLAUSILEV2.time_ "Description for this variable only in SW documentation possible not in asap2" ULONG SAB_T_TIMER_10MS_S2_S3 1 100 0 42949672950 DISPLAY_IDENTIFIER time_.tmr_t_delay_N6PLAUSILEV2.RPM_Diagnosis._.ZFFSAB ECU_ADDRESS 0xFFF8FE20 /end MEASUREMENT
/begin MEASUREMENT ZFFSAB._.RPM_Diagnosis.tmr_t_delay_NTUVIRTLEV2.time "Description for this variable only in SW documentation possible not in asap2" ULONG SAB_T_TIMER_10MS_S2_S3 1 100 0 42949672950 DISPLAY_IDENTIFIER time.tmr_t_delay_NTUVIRTLEV2.RPM_Diagnosis._.ZFFSAB ECU_ADDRESS 0xFFF8FE24 /end MEASUREMENT
/begin MEASUREMENT ZFFSAB._.RPM_Diagnosis.tmr_t_delay_NTUVIRTLEV2.time_ "Description for this variable only in SW documentation possible not in asap2" ULONG SAB_T_TIMER_10MS_S2_S3 1 100 0 42949672950 DISPLAY_IDENTIFIER time_.tmr_t_delay_NTUVIRTLEV2.RPM_Diagnosis._.ZFFSAB ECU_ADDRESS 0xFFF8FE28 /end MEASUREMENT
/begin MEASUREMENT ZFFSAB._.TempDiagnosis_AT.TempDiagnosis_AT_Fl.tmr_TolCheck_CGTLEV2.time "Description for this variable only in SW documentation possible not in asap2" ULONG SAB_T_TIMER_S10_S2_S3 1 100 0 429496729.5 DISPLAY_IDENTIFIER time.tmr_TolCheck_CGTLEV2.TempDiagnosis_AT_Fl.TempDiagnosis_AT._.ZFFSAB ECU_ADDRESS 0xFFF8FE3C /end MEASUREMENT
/begin MEASUREMENT ZFFSAB._.TempDiagnosis_AT.TempDiagnosis_AT_Fl.tmr_TolCheck_CGTLEV2.time_ "Description for this variable only in SW documentation possible not in asap2" ULONG SAB_T_TIMER_S10_S2_S3 1 100 0 429496729.5 DISPLAY_IDENTIFIER time_.tmr_TolCheck_CGTLEV2.TempDiagnosis_AT_Fl.TempDiagnosis_AT._.ZFFSAB ECU_ADDRESS 0xFFF8FE40 /end MEASUREMENT
/begin MEASUREMENT ZFFSAB._.TempDiagnosis_AT.TempDiagnosis_AT_Fl.cnt_ToleranceErr1.time "Description for this variable only in SW documentation possible not in asap2" ULONG SAB_T_TIMER_S10_S2_S3 1 100 0 429496729.5 DISPLAY_IDENTIFIER time.cnt_ToleranceErr1.TempDiagnosis_AT_Fl.TempDiagnosis_AT._.ZFFSAB ECU_ADDRESS 0xFFF8FE44 /end MEASUREMENT
/begin MEASUREMENT ZFFSAB._.TempDiagnosis_AT.TempDiagnosis_AT_Fl.cnt_ToleranceErr1.time_ "Description for this variable only in SW documentation possible not in asap2" ULONG SAB_T_TIMER_S10_S2_S3 1 100 0 429496729.5 DISPLAY_IDENTIFIER time_.cnt_ToleranceErr1.TempDiagnosis_AT_Fl.TempDiagnosis_AT._.ZFFSAB ECU_ADDRESS 0xFFF8FE48 /end MEASUREMENT
/begin MEASUREMENT ZFFSAB._.TempDiagnosis_AT.TempDiagnosis_AT_Fl.cnt_ToleranceErr2.time "Description for this variable only in SW documentation possible not in asap2" ULONG SAB_T_TIMER_S10_S2_S3 1 100 0 429496729.5 DISPLAY_IDENTIFIER time.cnt_ToleranceErr2.TempDiagnosis_AT_Fl.TempDiagnosis_AT._.ZFFSAB ECU_ADDRESS 0xFFF8FE4C /end MEASUREMENT
/begin MEASUREMENT ZFFSAB._.TempDiagnosis_AT.TempDiagnosis_AT_Fl.cnt_ToleranceErr2.time_ "Description for this variable only in SW documentation possible not in asap2" ULONG SAB_T_TIMER_S10_S2_S3 1 100 0 429496729.5 DISPLAY_IDENTIFIER time_.cnt_ToleranceErr2.TempDiagnosis_AT_Fl.TempDiagnosis_AT._.ZFFSAB ECU_ADDRESS 0xFFF8FE50 /end MEASUREMENT
/begin MEASUREMENT ZFFSAB._.TempDiagnosis_AT.TempDiagnosis_AT_Fl.tmr_DiagDelay.time "Description for this variable only in SW documentation possible not in asap2" ULONG SAB_T_TIMER_S10_S2_S3 1 100 0 429496729.5 DISPLAY_IDENTIFIER time.tmr_DiagDelay.TempDiagnosis_AT_Fl.TempDiagnosis_AT._.ZFFSAB ECU_ADDRESS 0xFFF8FE54 /end MEASUREMENT
/begin MEASUREMENT ZFFSAB._.TempDiagnosis_AT.TempDiagnosis_AT_Fl.tmr_DiagDelay.time_ "Description for this variable only in SW documentation possible not in asap2" ULONG SAB_T_TIMER_S10_S2_S3 1 100 0 429496729.5 DISPLAY_IDENTIFIER time_.tmr_DiagDelay.TempDiagnosis_AT_Fl.TempDiagnosis_AT._.ZFFSAB ECU_ADDRESS 0xFFF8FE58 /end MEASUREMENT
/begin MEASUREMENT ZFFSAB._.TempDiagnosis_AT.tmr_TolCheck_CGTLEV2.time "Description for this variable only in SW documentation possible not in asap2" ULONG SAB_T_TIMER_S10_S2_S3 1 100 0 429496729.5 DISPLAY_IDENTIFIER time.tmr_TolCheck_CGTLEV2.TempDiagnosis_AT._.ZFFSAB ECU_ADDRESS 0xFFF8FED0 /end MEASUREMENT
/begin MEASUREMENT ZFFSAB._.TempDiagnosis_AT.tmr_TolCheck_CGTLEV2.time_ "Description for this variable only in SW documentation possible not in asap2" ULONG SAB_T_TIMER_S10_S2_S3 1 100 0 429496729.5 DISPLAY_IDENTIFIER time_.tmr_TolCheck_CGTLEV2.TempDiagnosis_AT._.ZFFSAB ECU_ADDRESS 0xFFF8FED4 /end MEASUREMENT
/begin MEASUREMENT ZFFSAB._.TempDiagnosis_AT.cnt_ToleranceErr1.time "Description for this variable only in SW documentation possible not in asap2" ULONG SAB_T_TIMER_S10_S2_S3 1 100 0 429496729.5 DISPLAY_IDENTIFIER time.cnt_ToleranceErr1.TempDiagnosis_AT._.ZFFSAB ECU_ADDRESS 0xFFF8FED8 /end MEASUREMENT
/begin MEASUREMENT ZFFSAB._.TempDiagnosis_AT.cnt_ToleranceErr1.time_ "Description for this variable only in SW documentation possible not in asap2" ULONG SAB_T_TIMER_S10_S2_S3 1 100 0 429496729.5 DISPLAY_IDENTIFIER time_.cnt_ToleranceErr1.TempDiagnosis_AT._.ZFFSAB ECU_ADDRESS 0xFFF8FEDC /end MEASUREMENT
/begin MEASUREMENT ZFFSAB._.TempDiagnosis_AT.cnt_ToleranceErr2.time "Description for this variable only in SW documentation possible not in asap2" ULONG SAB_T_TIMER_S10_S2_S3 1 100 0 429496729.5 DISPLAY_IDENTIFIER time.cnt_ToleranceErr2.TempDiagnosis_AT._.ZFFSAB ECU_ADDRESS 0xFFF8FEE0 /end MEASUREMENT
/begin MEASUREMENT ZFFSAB._.TempDiagnosis_AT.cnt_ToleranceErr2.time_ "Description for this variable only in SW documentation possible not in asap2" ULONG SAB_T_TIMER_S10_S2_S3 1 100 0 429496729.5 DISPLAY_IDENTIFIER time_.cnt_ToleranceErr2.TempDiagnosis_AT._.ZFFSAB ECU_ADDRESS 0xFFF8FEE4 /end MEASUREMENT
/begin MEASUREMENT ZFFSAB._.TempDiagnosis_AT.tmr_DiagDelay.time "Description for this variable only in SW documentation possible not in asap2" ULONG SAB_T_TIMER_S10_S2_S3 1 100 0 429496729.5 DISPLAY_IDENTIFIER time.tmr_DiagDelay.TempDiagnosis_AT._.ZFFSAB ECU_ADDRESS 0xFFF8FEE8 /end MEASUREMENT
/begin MEASUREMENT ZFFSAB._.TempDiagnosis_AT.tmr_DiagDelay.time_ "Description for this variable only in SW documentation possible not in asap2" ULONG SAB_T_TIMER_S10_S2_S3 1 100 0 429496729.5 DISPLAY_IDENTIFIER time_.tmr_DiagDelay.TempDiagnosis_AT._.ZFFSAB ECU_ADDRESS 0xFFF8FEEC /end MEASUREMENT
/begin MEASUREMENT ZFFSAB._.TransmissionOutputSpeedIn.TransmissionOutputSpeedIn_Fl.tmr_DelayNAbMaxCalc.time "Description for this variable only in SW documentation possible not in asap2" ULONG SAB_T_TIMER_5MS_S2_S3 1 100 0 21474836475 DISPLAY_IDENTIFIER time.tmr_DelayNAbMaxCalc.TransmissionOutputSpeedIn_Fl.TransmissionOutputSpeedIn._.ZFFSAB ECU_ADDRESS 0xFFF8FF1C /end MEASUREMENT
/begin MEASUREMENT ZFFSAB._.TransmissionOutputSpeedIn.TransmissionOutputSpeedIn_Fl.tmr_DelayNAbMaxCalc.time_ "Description for this variable only in SW documentation possible not in asap2" ULONG SAB_T_TIMER_5MS_S2_S3 1 100 0 21474836475 DISPLAY_IDENTIFIER time_.tmr_DelayNAbMaxCalc.TransmissionOutputSpeedIn_Fl.TransmissionOutputSpeedIn._.ZFFSAB ECU_ADDRESS 0xFFF8FF20 /end MEASUREMENT
/begin MEASUREMENT ZFFSAB._.TransmissionOutputSpeedIn.tmr_nAbFiltAktiv.time "Description for this variable only in SW documentation possible not in asap2" ULONG SAB_T_TIMER_10MS_S2_S3 1 100 0 42949672950 DISPLAY_IDENTIFIER time.tmr_nAbFiltAktiv.TransmissionOutputSpeedIn._.ZFFSAB ECU_ADDRESS 0xFFF8FF74 /end MEASUREMENT
/begin MEASUREMENT ZFFSAB._.TransmissionOutputSpeedIn.tmr_nAbFiltAktiv.time_ "Description for this variable only in SW documentation possible not in asap2" ULONG SAB_T_TIMER_10MS_S2_S3 1 100 0 42949672950 DISPLAY_IDENTIFIER time_.tmr_nAbFiltAktiv.TransmissionOutputSpeedIn._.ZFFSAB ECU_ADDRESS 0xFFF8FF78 /end MEASUREMENT
/begin MEASUREMENT ZFFSAB._.TransmissionOutputSpeedIn.tmr_DelayNAbMaxCalc.time "Description for this variable only in SW documentation possible not in asap2" ULONG SAB_T_TIMER_5MS_S2_S3 1 100 0 21474836475 DISPLAY_IDENTIFIER time.tmr_DelayNAbMaxCalc.TransmissionOutputSpeedIn._.ZFFSAB ECU_ADDRESS 0xFFF8FF7C /end MEASUREMENT
/begin MEASUREMENT ZFFSAB._.TransmissionOutputSpeedIn.tmr_DelayNAbMaxCalc.time_ "Description for this variable only in SW documentation possible not in asap2" ULONG SAB_T_TIMER_5MS_S2_S3 1 100 0 21474836475 DISPLAY_IDENTIFIER time_.tmr_DelayNAbMaxCalc.TransmissionOutputSpeedIn._.ZFFSAB ECU_ADDRESS 0xFFF8FF80 /end MEASUREMENT
/begin MEASUREMENT ZFFSAB._.TurbineSpeedIn.tmr_nTuFiltAktiv.time "Description for this variable only in SW documentation possible not in asap2" ULONG SAB_T_TIMER_10MS_S2_S3 1 100 0 42949672950 DISPLAY_IDENTIFIER time.tmr_nTuFiltAktiv.TurbineSpeedIn._.ZFFSAB ECU_ADDRESS 0xFFF9000C /end MEASUREMENT
/begin MEASUREMENT ZFFSAB._.TurbineSpeedIn.tmr_nTuFiltAktiv.time_ "Description for this variable only in SW documentation possible not in asap2" ULONG SAB_T_TIMER_10MS_S2_S3 1 100 0 42949672950 DISPLAY_IDENTIFIER time_.tmr_nTuFiltAktiv.TurbineSpeedIn._.ZFFSAB ECU_ADDRESS 0xFFF90010 /end MEASUREMENT
/begin MEASUREMENT ZFFSAB._.TurbineSpeedIn.tmr_nTuFiltAktiv2ndPath.time "Description for this variable only in SW documentation possible not in asap2" ULONG SAB_T_TIMER_10MS_S2_S3 1 100 0 42949672950 DISPLAY_IDENTIFIER time.tmr_nTuFiltAktiv2ndPath.TurbineSpeedIn._.ZFFSAB ECU_ADDRESS 0xFFF90014 /end MEASUREMENT
/begin MEASUREMENT ZFFSAB._.TurbineSpeedIn.tmr_nTuFiltAktiv2ndPath.time_ "Description for this variable only in SW documentation possible not in asap2" ULONG SAB_T_TIMER_10MS_S2_S3 1 100 0 42949672950 DISPLAY_IDENTIFIER time_.tmr_nTuFiltAktiv2ndPath.TurbineSpeedIn._.ZFFSAB ECU_ADDRESS 0xFFF90018 /end MEASUREMENT
/begin MEASUREMENT ZFFSAB._.TurbineSpeedIn.tmr_Delay_TurbineSpeedTx.time "Description for this variable only in SW documentation possible not in asap2" ULONG SAB_T_TIMER_10MS_S2_S3 1 100 0 42949672950 DISPLAY_IDENTIFIER time.tmr_Delay_TurbineSpeedTx.TurbineSpeedIn._.ZFFSAB ECU_ADDRESS 0xFFF9001C /end MEASUREMENT
/begin MEASUREMENT ZFFSAB._.TurbineSpeedIn.tmr_Delay_TurbineSpeedTx.time_ "Description for this variable only in SW documentation possible not in asap2" ULONG SAB_T_TIMER_10MS_S2_S3 1 100 0 42949672950 DISPLAY_IDENTIFIER time_.tmr_Delay_TurbineSpeedTx.TurbineSpeedIn._.ZFFSAB ECU_ADDRESS 0xFFF90020 /end MEASUREMENT
/begin MEASUREMENT ZFFSAB._.CDD_PermanentFaultCodes.tmr_DeactivatePfcTh.time "Description for this variable only in SW documentation possible not in asap2" UBYTE SAB_T_TIMER_10MS_S2_S3 1 100 0 2550 DISPLAY_IDENTIFIER time.tmr_DeactivatePfcTh.CDD_PermanentFaultCodes._.ZFFSAB ECU_ADDRESS 0xFFF973F0 /end MEASUREMENT
/begin MEASUREMENT ZFFSAB._.CDD_LINBusStartStop.tmr_KMN_LINBUSOFF.time "Description for this variable only in SW documentation possible not in asap2" UWORD SAB_T_TIMER_10MS_S2_S3 1 100 0 655350 DISPLAY_IDENTIFIER time.tmr_KMN_LINBUSOFF.CDD_LINBusStartStop._.ZFFSAB ECU_ADDRESS 0xFFF97418 /end MEASUREMENT
/begin MEASUREMENT ZFFSAB._.CDD_LINBusStartStop.tmr_IEPSleepDelay.time "Description for this variable only in SW documentation possible not in asap2" UWORD SAB_T_TIMER_10MS_S2_S3 1 100 0 655350 DISPLAY_IDENTIFIER time.tmr_IEPSleepDelay.CDD_LINBusStartStop._.ZFFSAB ECU_ADDRESS 0xFFF9741A /end MEASUREMENT
/begin MEASUREMENT ZFFSAB._.GLI_ErrorHandling.tmr_DiagAfterFirstKL15.time "Description for this variable only in SW documentation possible not in asap2" UWORD SAB_T_TIMER_10MS_S2_S3 1 100 0 655350 DISPLAY_IDENTIFIER time.tmr_DiagAfterFirstKL15.GLI_ErrorHandling._.ZFFSAB ECU_ADDRESS 0xFFF97428 /end MEASUREMENT
/begin MEASUREMENT ZFFSAB._.RoutineControlUDS.tmr_PreadaptionSOC0x80.time "Description for this variable only in SW documentation possible not in asap2" UWORD SAB_T_TIMER_10MS_S2_S3 1 100 0 655350 DISPLAY_IDENTIFIER time.tmr_PreadaptionSOC0x80.RoutineControlUDS._.ZFFSAB ECU_ADDRESS 0xFFF97478 /end MEASUREMENT
/begin MEASUREMENT ZFFSAB._.RoutineControlUDS.tmr_IEP_Test.time "Description for this variable only in SW documentation possible not in asap2" UWORD SAB_T_TIMER_10MS_S2_S3 1 100 0 655350 DISPLAY_IDENTIFIER time.tmr_IEP_Test.RoutineControlUDS._.ZFFSAB ECU_ADDRESS 0xFFF9747A /end MEASUREMENT
/begin MEASUREMENT ZFFSAB._.RoutineControlUDS.iv_PreadaptionState "Input variable for Preadaption State" UBYTE SAB_STANDARD_S2_S3 1 100 0 255 DISPLAY_IDENTIFIER iv_PreadaptionState.RoutineControlUDS._.ZFFSAB ECU_ADDRESS 0xFFF9747C /end MEASUREMENT
/begin MEASUREMENT ZFFSAB._.RoutineControlUDS.iv_PreadaptionCondition "Input variable for Preadaption Condition" UBYTE SAB_STANDARD_S2_S3 1 100 0 255 DISPLAY_IDENTIFIER iv_PreadaptionCondition.RoutineControlUDS._.ZFFSAB ECU_ADDRESS 0xFFF9747D /end MEASUREMENT
/begin MEASUREMENT ZFFSAB._.RoutineControlUDS.iv_PreConditions "Input variable of Com PreConditions" UWORD SAB_STANDARD_S2_S3 1 100 0 65535 DISPLAY_IDENTIFIER iv_PreConditions.RoutineControlUDS._.ZFFSAB ECU_ADDRESS 0xFFF9747E /end MEASUREMENT
/begin MEASUREMENT ZFFSAB._.RoutineControlUDS.iv_f_ObdPfcActivation "Input variable of activation of permanent fault codes: 0=inactive 1=active" UBYTE SAB_STANDARD_S2_S3 1 100 0 1 DISPLAY_IDENTIFIER iv_f_ObdPfcActivation.RoutineControlUDS._.ZFFSAB ECU_ADDRESS 0xFFF97480 /end MEASUREMENT
/begin MEASUREMENT ZFFSAB._.RoutineControlUDS.sv_PreadaptionRequest "Output signal for pradaption request:" UBYTE SAB_STANDARD_S2_S3 1 100 0 255 DISPLAY_IDENTIFIER sv_PreadaptionRequest.RoutineControlUDS._.ZFFSAB ECU_ADDRESS 0xFFF97481 /end MEASUREMENT
/begin MEASUREMENT ZFFSAB._.RoutineControlUDS.sv_EPumpCtrlByTester "value for setting the electrical pump 0= no request 1=working point 1 2= working point 2 3= working point 3" UBYTE SAB_STANDARD_S2_S3 1 100 0 3 DISPLAY_IDENTIFIER sv_EPumpCtrlByTester.RoutineControlUDS._.ZFFSAB ECU_ADDRESS 0xFFF97482 /end MEASUREMENT
/begin MEASUREMENT ZFFSAB._.RoutineControlUDS.f_ReadyToBSS_NOT_RUNNING "flag indicate Preadaption routine ready to go to state BSS_NOT_RUNNING" UBYTE SAB_STANDARD_S2_S3 1 100 0 1 DISPLAY_IDENTIFIER f_ReadyToBSS_NOT_RUNNING.RoutineControlUDS._.ZFFSAB ECU_ADDRESS 0xFFF97483 /end MEASUREMENT
/begin MEASUREMENT ZFFSAB._.RoutineControlUDS.st_basicsettings_preadap "state routine Control service preadaption" UBYTE SAB_STANDARD_S2_S3 1 100 0 255 DISPLAY_IDENTIFIER st_basicsettings_preadap.RoutineControlUDS._.ZFFSAB ECU_ADDRESS 0xFFF97484 /end MEASUREMENT
/begin MEASUREMENT ZFFSAB._.RoutineControlUDS.AbortCustomerReason "abort reason" UBYTE SAB_STANDARD_S2_S3 1 100 0 255 DISPLAY_IDENTIFIER AbortCustomerReason.RoutineControlUDS._.ZFFSAB ECU_ADDRESS 0xFFF97485 /end MEASUREMENT
/begin MEASUREMENT ZFFSAB._.RoutineControlUDS.st_IEP_test "state IEP test routine" UBYTE SAB_STANDARD_S2_S3 1 100 0 255 DISPLAY_IDENTIFIER st_IEP_test.RoutineControlUDS._.ZFFSAB ECU_ADDRESS 0xFFF97486 /end MEASUREMENT
/begin MEASUREMENT ZFFSAB._.RoutineControlUDS.st_basicsettings "state routine Control service" UBYTE SAB_STANDARD_S2_S3 1 100 0 255 DISPLAY_IDENTIFIER st_basicsettings.RoutineControlUDS._.ZFFSAB ECU_ADDRESS 0xFFF97487 /end MEASUREMENT
/begin MEASUREMENT ZFFSAB._.ASCIn.sv_f_ASCSbe "REPRESENT_INTERMEDIATE value of shifting influence" UBYTE SAB_STANDARD_S2_S3 1 100 0 1 DISPLAY_IDENTIFIER sv_f_ASCSbe.ASCIn._.ZFFSAB ECU_ADDRESS 0xFFF983B7 /end MEASUREMENT
/begin MEASUREMENT ZFFSAB._.ASCIn.f_ASCSbeErr "Error flag of f_ASCSbe" UBYTE SAB_STANDARD_S2_S3 1 100 0 1 DISPLAY_IDENTIFIER f_ASCSbeErr.ASCIn._.ZFFSAB ECU_ADDRESS 0xFFF983B8 /end MEASUREMENT
/begin MEASUREMENT ZFFSAB._.ASCIn.f_ASCErr "Error flag of ESP" UBYTE SAB_STANDARD_S2_S3 1 100 0 1 DISPLAY_IDENTIFIER f_ASCErr.ASCIn._.ZFFSAB ECU_ADDRESS 0xFFF983B9 /end MEASUREMENT
/begin MEASUREMENT ZFFSAB._.ASCIn.sv_ASCSbeSts "REPRESENT_INTERMEDIATE value signal status of shifting influence" UBYTE SAB_STANDARD_S2_S3 1 100 0 2 DISPLAY_IDENTIFIER sv_ASCSbeSts.ASCIn._.ZFFSAB ECU_ADDRESS 0xFFF983BA /end MEASUREMENT
/begin MEASUREMENT ZFFSAB._.ASCIn.iv_ASCSbe "Input value shifting influence from CAN" UBYTE SAB_STANDARD_S2_S3 1 100 0 7 DISPLAY_IDENTIFIER iv_ASCSbe.ASCIn._.ZFFSAB ECU_ADDRESS 0xFFF983BB /end MEASUREMENT
/begin MEASUREMENT ZFFSAB._.ASCIn.iv_ASCRegSts "Input value message status of REG control state" UBYTE SAB_STANDARD_S2_S3 1 100 0 255 DISPLAY_IDENTIFIER iv_ASCRegSts.ASCIn._.ZFFSAB ECU_ADDRESS 0xFFF983BC /end MEASUREMENT
/begin MEASUREMENT ZFFSAB._.ASCIn.iv_ASCSts "Input value message status of control state" UBYTE SAB_STANDARD_S2_S3 1 100 0 255 DISPLAY_IDENTIFIER iv_ASCSts.ASCIn._.ZFFSAB ECU_ADDRESS 0xFFF983BD /end MEASUREMENT
/begin MEASUREMENT ZFFSAB._.OBD_CyclesIn.iv_OBD_CyclesInfo "Input raw signal of OBD cycles information" UBYTE SAB_STANDARD_S2_S3 1 100 0 255 DISPLAY_IDENTIFIER iv_OBD_CyclesInfo.OBD_CyclesIn._.ZFFSAB ECU_ADDRESS 0xFFF9749C /end MEASUREMENT
/begin MEASUREMENT ZFFSAB._.OBD_CyclesIn.iv_OBD_CyclesInfoFA "Input raw signal FA CAN of OBD cycles information" UBYTE SAB_STANDARD_S2_S3 1 100 0 255 DISPLAY_IDENTIFIER iv_OBD_CyclesInfoFA.OBD_CyclesIn._.ZFFSAB ECU_ADDRESS 0xFFF9749D /end MEASUREMENT
/begin MEASUREMENT ZFFSAB._.OBD_CyclesIn.iv_OBD_CyclesInfoSts "Input signal message status of OBD cycles information" UBYTE SAB_STANDARD_S2_S3 1 100 0 255 DISPLAY_IDENTIFIER iv_OBD_CyclesInfoSts.OBD_CyclesIn._.ZFFSAB ECU_ADDRESS 0xFFF9749E /end MEASUREMENT
/begin MEASUREMENT ZFFSAB._.OBD_CyclesIn.iv_OBD_CyclesInfoFASts "Input signal message status FA CAN of OBD cycles information" UBYTE SAB_STANDARD_S2_S3 1 100 0 255 DISPLAY_IDENTIFIER iv_OBD_CyclesInfoFASts.OBD_CyclesIn._.ZFFSAB ECU_ADDRESS 0xFFF9749F /end MEASUREMENT
/begin MEASUREMENT ZFFSAB._.OBD_CyclesIn.iv_OBD_ThrottlePosition "The throttle position will be displayed" UBYTE SAB_100PROZENT254_S2_S3 1 100 0 100.393700787 DISPLAY_IDENTIFIER iv_OBD_ThrottlePosition.OBD_CyclesIn._.ZFFSAB ECU_ADDRESS 0xFFF974A0 /end MEASUREMENT
/begin MEASUREMENT ZFFSAB._.OBD_CyclesIn.iv_OBD_ThrottlePositionSts "Signal message status of the throttle position" UBYTE SAB_STANDARD_S2_S3 1 100 0 255 DISPLAY_IDENTIFIER iv_OBD_ThrottlePositionSts.OBD_CyclesIn._.ZFFSAB ECU_ADDRESS 0xFFF974A1 /end MEASUREMENT
/begin MEASUREMENT ZFFSAB._.OBD_CyclesIn.iv_OBD_ThrottlePositionFA "The throttle position will be displayed" UBYTE SAB_100PROZENT254_S2_S3 1 100 0 100.393700787 DISPLAY_IDENTIFIER iv_OBD_ThrottlePositionFA.OBD_CyclesIn._.ZFFSAB ECU_ADDRESS 0xFFF974A2 /end MEASUREMENT
/begin MEASUREMENT ZFFSAB._.OBD_CyclesIn.iv_OBD_ThrottlePositionFASts "Signal message status of the throttle position" UBYTE SAB_STANDARD_S2_S3 1 100 0 255 DISPLAY_IDENTIFIER iv_OBD_ThrottlePositionFASts.OBD_CyclesIn._.ZFFSAB ECU_ADDRESS 0xFFF974A3 /end MEASUREMENT
/begin MEASUREMENT ZFFSAB._.OBD_CyclesIn.iv_OBD_LoadEngine "The motor load value will be displayed" UBYTE SAB_100PROZENT254_S2_S3 1 100 0 100.393700787 DISPLAY_IDENTIFIER iv_OBD_LoadEngine.OBD_CyclesIn._.ZFFSAB ECU_ADDRESS 0xFFF974A4 /end MEASUREMENT
/begin MEASUREMENT ZFFSAB._.OBD_CyclesIn.iv_OBD_LoadEngineSts "Signal message status of the motor load value" UBYTE SAB_STANDARD_S2_S3 1 100 0 255 DISPLAY_IDENTIFIER iv_OBD_LoadEngineSts.OBD_CyclesIn._.ZFFSAB ECU_ADDRESS 0xFFF974A5 /end MEASUREMENT
/begin MEASUREMENT ZFFSAB._.OBD_CyclesIn.iv_OBD_LoadEngineFA "The motor load value will be displayed" UBYTE SAB_100PROZENT254_S2_S3 1 100 0 100.393700787 DISPLAY_IDENTIFIER iv_OBD_LoadEngineFA.OBD_CyclesIn._.ZFFSAB ECU_ADDRESS 0xFFF974A6 /end MEASUREMENT
/begin MEASUREMENT ZFFSAB._.OBD_CyclesIn.iv_OBD_LoadEngineFASts "Signal message status of the motor load value" UBYTE SAB_STANDARD_S2_S3 1 100 0 255 DISPLAY_IDENTIFIER iv_OBD_LoadEngineFASts.OBD_CyclesIn._.ZFFSAB ECU_ADDRESS 0xFFF974A7 /end MEASUREMENT
/begin MEASUREMENT ZFFSAB._.OBD_CyclesIn.iv_u_Batt_Diag "actual battery voltage" UWORD SAB_U_1VOLT1000_S2_S3 1 100 0 65.535 DISPLAY_IDENTIFIER iv_u_Batt_Diag.OBD_CyclesIn._.ZFFSAB ECU_ADDRESS 0xFFF974A8 /end MEASUREMENT
/begin MEASUREMENT ZFFSAB._.OBD_CyclesIn.sv_OBD_CyclesInfoSts "Output status signal of OBD_CyclesIn" UBYTE SAB_STANDARD_S2_S3 1 100 0 2 DISPLAY_IDENTIFIER sv_OBD_CyclesInfoSts.OBD_CyclesIn._.ZFFSAB ECU_ADDRESS 0xFFF974AA /end MEASUREMENT
/begin MEASUREMENT ZFFSAB._.OBD_CyclesIn.sv_OBD_DrivingCycle "Output status signal of OBD_CyclesIn 0=inactive 1=active 255=signal faulty" UBYTE SAB_STANDARD_S2_S3 1 100 0 2 DISPLAY_IDENTIFIER sv_OBD_DrivingCycle.OBD_CyclesIn._.ZFFSAB ECU_ADDRESS 0xFFF974AB /end MEASUREMENT
/begin MEASUREMENT ZFFSAB._.OBD_CyclesIn.sv_OBD_NormedTrip "Output signal of OBD_CyclesIn 0=inactive 1=active 255=signal faulty" UBYTE SAB_STANDARD_S2_S3 1 100 0 255 DISPLAY_IDENTIFIER sv_OBD_NormedTrip.OBD_CyclesIn._.ZFFSAB ECU_ADDRESS 0xFFF974AC /end MEASUREMENT
/begin MEASUREMENT ZFFSAB._.OBD_CyclesIn.sv_OBD_NormedTripB "Output signal of OBD_CyclesInB 0=inactive 1=active 255=signal faulty" UBYTE SAB_STANDARD_S2_S3 1 100 0 255 DISPLAY_IDENTIFIER sv_OBD_NormedTripB.OBD_CyclesIn._.ZFFSAB ECU_ADDRESS 0xFFF974AD /end MEASUREMENT
/begin MEASUREMENT ZFFSAB._.OBD_CyclesIn.sv_OBD_WarmUpCycle "Output signal of OBD_CyclesIn 0=inactive 1=active 255=signal faulty" UBYTE SAB_STANDARD_S2_S3 1 100 0 255 DISPLAY_IDENTIFIER sv_OBD_WarmUpCycle.OBD_CyclesIn._.ZFFSAB ECU_ADDRESS 0xFFF974AE /end MEASUREMENT
/begin MEASUREMENT ZFFSAB._.OBD_CyclesIn.f_OBD_CyclesInfoErr "Error flag of CyclesInfo-signal" UBYTE SAB_STANDARD_S2_S3 1 100 0 1 DISPLAY_IDENTIFIER f_OBD_CyclesInfoErr.OBD_CyclesIn._.ZFFSAB ECU_ADDRESS 0xFFF974AF /end MEASUREMENT
/begin MEASUREMENT ZFFSAB._.OBD_CyclesIn.f_OBD_ThrottlePositionErr "Error flag of ThrottlePosition" UBYTE SAB_STANDARD_S2_S3 1 100 0 1 DISPLAY_IDENTIFIER f_OBD_ThrottlePositionErr.OBD_CyclesIn._.ZFFSAB ECU_ADDRESS 0xFFF974B0 /end MEASUREMENT
/begin MEASUREMENT ZFFSAB._.OBD_CyclesIn.f_OBD_LoadEngineErr "Error flag of engine load" UBYTE SAB_STANDARD_S2_S3 1 100 0 1 DISPLAY_IDENTIFIER f_OBD_LoadEngineErr.OBD_CyclesIn._.ZFFSAB ECU_ADDRESS 0xFFF974B1 /end MEASUREMENT
/begin MEASUREMENT ZFFSAB._.LowModeDriveIn.iv_LowMode "Input signal Low Mode" UBYTE SAB_STANDARD_S2_S3 1 100 0 255 DISPLAY_IDENTIFIER iv_LowMode.LowModeDriveIn._.ZFFSAB ECU_ADDRESS 0xFFF98460 /end MEASUREMENT
/begin MEASUREMENT ZFFSAB._.LowModeDriveIn.iv_LowModeFA "Input signal Low Mode (FACAN)" UBYTE SAB_STANDARD_S2_S3 1 100 0 255 DISPLAY_IDENTIFIER iv_LowModeFA.LowModeDriveIn._.ZFFSAB ECU_ADDRESS 0xFFF98461 /end MEASUREMENT
/begin MEASUREMENT ZFFSAB._.LowModeDriveIn.iv_LowModeSts "Input message status Low Mode" UBYTE SAB_STANDARD_S2_S3 1 100 0 255 DISPLAY_IDENTIFIER iv_LowModeSts.LowModeDriveIn._.ZFFSAB ECU_ADDRESS 0xFFF98462 /end MEASUREMENT
/begin MEASUREMENT ZFFSAB._.LowModeDriveIn.iv_LowModeFASts "Input message status Low Mode (FACAN)" UBYTE SAB_STANDARD_S2_S3 1 100 0 255 DISPLAY_IDENTIFIER iv_LowModeFASts.LowModeDriveIn._.ZFFSAB ECU_ADDRESS 0xFFF98463 /end MEASUREMENT
/begin MEASUREMENT ZFFSAB._.LowModeDriveIn.sv_LowMode "Output signal of GET_LOW_MODE" UBYTE SAB_STANDARD_S2_S3 1 100 0 255 DISPLAY_IDENTIFIER sv_LowMode.LowModeDriveIn._.ZFFSAB ECU_ADDRESS 0xFFF98464 /end MEASUREMENT
/begin MEASUREMENT ZFFSAB._.LowModeDriveIn.sv_LowModeSts "Output status signal of GET_LOW_MODE_STATUS" UBYTE SAB_STANDARD_S2_S3 1 100 0 2 DISPLAY_IDENTIFIER sv_LowModeSts.LowModeDriveIn._.ZFFSAB ECU_ADDRESS 0xFFF98465 /end MEASUREMENT
/begin MEASUREMENT ZFFSAB._.FullThrottleTorqueIn.iv_m_MKWMax "Input value of stationary full trottle torque from CAN" UWORD SAB_M_NM2_M2047_S2_S3 1 100 -1023.5 31744 DISPLAY_IDENTIFIER iv_m_MKWMax.FullThrottleTorqueIn._.ZFFSAB ECU_ADDRESS 0xFFF974B4 /end MEASUREMENT
/begin MEASUREMENT ZFFSAB._.FullThrottleTorqueIn.iv_m_MKWMaxSts "Input status value of stationary full trottle torque from CAN" UBYTE SAB_STANDARD_S2_S3 1 100 0 255 DISPLAY_IDENTIFIER iv_m_MKWMaxSts.FullThrottleTorqueIn._.ZFFSAB ECU_ADDRESS 0xFFF974B6 /end MEASUREMENT
/begin MEASUREMENT ZFFSAB._.FullThrottleTorqueIn.sv_m_MKWMax "Output value of stationary full trottle torque" SWORD SAB_M_1NM_S2_S3 1 100 -32768 32767 DISPLAY_IDENTIFIER sv_m_MKWMax.FullThrottleTorqueIn._.ZFFSAB ECU_ADDRESS 0xFFF974B8 /end MEASUREMENT
/begin MEASUREMENT ZFFSAB._.FullThrottleTorqueIn.sv_m_MKWMaxSts "Output value signal status of stationary full trottle torque" UBYTE SAB_STANDARD_S2_S3 1 100 0 2 DISPLAY_IDENTIFIER sv_m_MKWMaxSts.FullThrottleTorqueIn._.ZFFSAB ECU_ADDRESS 0xFFF974BA /end MEASUREMENT
/begin MEASUREMENT ZFFSAB._.FullThrottleTorqueIn.f_m_MKWMaxErr "Errorflag of full throttle torque" UBYTE SAB_STANDARD_S2_S3 1 100 0 1 DISPLAY_IDENTIFIER f_m_MKWMaxErr.FullThrottleTorqueIn._.ZFFSAB ECU_ADDRESS 0xFFF974BB /end MEASUREMENT
/begin MEASUREMENT ZFFSAB._.CAN_SwitchingIn.tmr_CAN_HYS.time "Description for this variable only in SW documentation possible not in asap2" UBYTE SAB_T_TIMER_10MS_S2_S3 1 100 0 2550 DISPLAY_IDENTIFIER time.tmr_CAN_HYS.CAN_SwitchingIn._.ZFFSAB ECU_ADDRESS 0xFFF974C0 /end MEASUREMENT
/begin MEASUREMENT ZFFSAB._.AmbConditionsIn.iv_st_EepromValid "EEPROM valid channel 6 (index = 23)" UBYTE SAB_STANDARD_S2_S3 1 100 0 255 DISPLAY_IDENTIFIER iv_st_EepromValid.AmbConditionsIn._.ZFFSAB ECU_ADDRESS 0xFFF975FE /end MEASUREMENT
/begin MEASUREMENT ZFFSAB._.AmbConditionsIn.sv_st_EepromValid "EEPROM valid channel 6 (index = 23)" UBYTE SAB_STANDARD_S2_S3 1 100 0 255 DISPLAY_IDENTIFIER sv_st_EepromValid.AmbConditionsIn._.ZFFSAB ECU_ADDRESS 0xFFF975FF /end MEASUREMENT
/begin MEASUREMENT ZFFSAB._.AmbConditionsIn.iv_f_IgnOn "Output flag 1=Ignition on 0=Ignition off" UBYTE SAB_STANDARD_S2_S3 1 100 0 1 DISPLAY_IDENTIFIER iv_f_IgnOn.AmbConditionsIn._.ZFFSAB ECU_ADDRESS 0xFFF97626 /end MEASUREMENT
/begin MEASUREMENT ZFFSAB._.RollPreventIn.tmr_hillholdDelay.time "Description for this variable only in SW documentation possible not in asap2" UBYTE SAB_T_TIMER_10MS_S2_S3 1 100 0 2550 DISPLAY_IDENTIFIER time.tmr_hillholdDelay.RollPreventIn._.ZFFSAB ECU_ADDRESS 0xFFF97818 /end MEASUREMENT
/begin MEASUREMENT ZFFSAB._.ParkingBrakeIn.f_ParkingBrakeErr "Error flag of ParkingBrake-signal" UBYTE SAB_STANDARD_S2_S3 1 100 0 1 DISPLAY_IDENTIFIER f_ParkingBrakeErr.ParkingBrakeIn._.ZFFSAB ECU_ADDRESS 0xFFF983D7 /end MEASUREMENT
/begin MEASUREMENT ZFFSAB._.DrivingDirectionIn.tmr_HoldDirection.time "Description for this variable only in SW documentation possible not in asap2" UBYTE SAB_T_TIMER_10MS_S2_S3 1 100 0 2550 DISPLAY_IDENTIFIER time.tmr_HoldDirection.DrivingDirectionIn._.ZFFSAB ECU_ADDRESS 0xFFF9783C /end MEASUREMENT
/begin MEASUREMENT ZFFSAB._.TipTasterIn.tmr_AnalogPaddleLearnFunction.time "Description for this variable only in SW documentation possible not in asap2" UBYTE SAB_T_TIMER_10MS_S2_S3 1 100 0 2550 DISPLAY_IDENTIFIER time.tmr_AnalogPaddleLearnFunction.TipTasterIn._.ZFFSAB ECU_ADDRESS 0xFFF97898 /end MEASUREMENT
/begin MEASUREMENT ZFFSAB._.TipTasterIn.tmr_AnalogPaddleDebounceFunction.time "Description for this variable only in SW documentation possible not in asap2" UBYTE SAB_T_TIMER_10MS_S2_S3 1 100 0 2550 DISPLAY_IDENTIFIER time.tmr_AnalogPaddleDebounceFunction.TipTasterIn._.ZFFSAB ECU_ADDRESS 0xFFF97899 /end MEASUREMENT
/begin MEASUREMENT ZFFSAB._.TipTasterIn.tmr_CANPaddleAllowableReceived.time "Description for this variable only in SW documentation possible not in asap2" UWORD SAB_T_TIMER_10MS_S2_S3 1 100 0 655350 DISPLAY_IDENTIFIER time.tmr_CANPaddleAllowableReceived.TipTasterIn._.ZFFSAB ECU_ADDRESS 0xFFF9789A /end MEASUREMENT
/begin MEASUREMENT ZFFSAB._.CAN_Handling.tmr_DiagAfterKL15.time "Description for this variable only in SW documentation possible not in asap2" UWORD SAB_T_TIMER_10MS_S2_S3 1 100 0 655350 DISPLAY_IDENTIFIER time.tmr_DiagAfterKL15.CAN_Handling._.ZFFSAB ECU_ADDRESS 0xFFF9790E /end MEASUREMENT
/begin MEASUREMENT ZFFSAB._.CAN_Handling.tmr_CAN1BusDiagDelay.time "Description for this variable only in SW documentation possible not in asap2" UWORD SAB_T_TIMER_10MS_S2_S3 1 100 0 655350 DISPLAY_IDENTIFIER time.tmr_CAN1BusDiagDelay.CAN_Handling._.ZFFSAB ECU_ADDRESS 0xFFF97910 /end MEASUREMENT
/begin MEASUREMENT ZFFSAB._.CAN_Handling.tmr_CAN2BusDiagDelay.time "Description for this variable only in SW documentation possible not in asap2" UWORD SAB_T_TIMER_10MS_S2_S3 1 100 0 655350 DISPLAY_IDENTIFIER time.tmr_CAN2BusDiagDelay.CAN_Handling._.ZFFSAB ECU_ADDRESS 0xFFF97912 /end MEASUREMENT
/begin MEASUREMENT ZFFSAB._.AzgDriver.addr_fsp "start address error memory. For further information about the error memory and the error handling see the dokumentation from the component 'error handler' (ZFEH.zip)" ULONG SAB_STANDARD_S2_S3 1 100 0 4294967295 DISPLAY_IDENTIFIER addr_fsp.AzgDriver._.ZFFSAB ECU_ADDRESS 0xFFF97968 /end MEASUREMENT
/begin MEASUREMENT ZFFSAB._.PowerdownIn.tmr_PowerDown.time "Description for this variable only in SW documentation possible not in asap2" UWORD SAB_T_TIMER_10MS_S2_S3 1 100 0 655350 DISPLAY_IDENTIFIER time.tmr_PowerDown.PowerdownIn._.ZFFSAB ECU_ADDRESS 0xFFF97970 /end MEASUREMENT
/begin MEASUREMENT ZFFSAB._.PowerdownIn.tmr_ResetByTester.time "Description for this variable only in SW documentation possible not in asap2" UBYTE SAB_T_TIMER_10MS_S2_S3 1 100 0 2550 DISPLAY_IDENTIFIER time.tmr_ResetByTester.PowerdownIn._.ZFFSAB ECU_ADDRESS 0xFFF97972 /end MEASUREMENT
/begin MEASUREMENT ZFFSAB._.VoltageMonitoringOut.tmr_Jumpstart.time "Description for this variable only in SW documentation possible not in asap2" UWORD SAB_T_TIMER_10MS_S2_S3 1 100 0 655350 DISPLAY_IDENTIFIER time.tmr_Jumpstart.VoltageMonitoringOut._.ZFFSAB ECU_ADDRESS 0xFFF97988 /end MEASUREMENT
/begin MEASUREMENT ZFFSAB._.VoltageMonitoringOut.tmr_u_BattU.time "Description for this variable only in SW documentation possible not in asap2" UWORD SAB_T_TIMER_10MS_S2_S3 1 100 0 655350 DISPLAY_IDENTIFIER time.tmr_u_BattU.VoltageMonitoringOut._.ZFFSAB ECU_ADDRESS 0xFFF9798A /end MEASUREMENT
/begin MEASUREMENT ZFFSAB._.VoltageMonitoringOut.tmr_GearSubstLSSOFF.time "Description for this variable only in SW documentation possible not in asap2" UWORD SAB_T_TIMER_10MS_S2_S3 1 100 0 655350 DISPLAY_IDENTIFIER time.tmr_GearSubstLSSOFF.VoltageMonitoringOut._.ZFFSAB ECU_ADDRESS 0xFFF9798C /end MEASUREMENT
/begin MEASUREMENT ZFFSAB._.VoltageMonitoringOut.tmr_DiagActive_UBATTU.time "Description for this variable only in SW documentation possible not in asap2" UBYTE SAB_T_TIMER_10MS_S2_S3 1 100 0 2550 DISPLAY_IDENTIFIER time.tmr_DiagActive_UBATTU.VoltageMonitoringOut._.ZFFSAB ECU_ADDRESS 0xFFF9798E /end MEASUREMENT
/begin MEASUREMENT ZFFSAB._.VoltageMonitoringOut.tmr_DiagActive_UBATTL.time "Description for this variable only in SW documentation possible not in asap2" UBYTE SAB_T_TIMER_10MS_S2_S3 1 100 0 2550 DISPLAY_IDENTIFIER time.tmr_DiagActive_UBATTL.VoltageMonitoringOut._.ZFFSAB ECU_ADDRESS 0xFFF9798F /end MEASUREMENT
/begin MEASUREMENT ZFFSAB._.EmergencyGearInfo.tmr_GearSubst.time "Description for this variable only in SW documentation possible not in asap2" UWORD SAB_T_TIMER_10MS_S2_S3 1 100 0 655350 DISPLAY_IDENTIFIER time.tmr_GearSubst.EmergencyGearInfo._.ZFFSAB ECU_ADDRESS 0xFFF979B8 /end MEASUREMENT
/begin MEASUREMENT ZFFSAB._.EmergencyGearInfo.tmr_3th_stepENPGx.time "Description for this variable only in SW documentation possible not in asap2" UWORD SAB_T_TIMER_10MS_S2_S3 1 100 0 655350 DISPLAY_IDENTIFIER time.tmr_3th_stepENPGx.EmergencyGearInfo._.ZFFSAB ECU_ADDRESS 0xFFF979BA /end MEASUREMENT
/begin MEASUREMENT ZFFSAB._.EmergencyGearInfo.tmr_ENPG1.time "Description for this variable only in SW documentation possible not in asap2" UWORD SAB_T_TIMER_10MS_S2_S3 1 100 0 655350 DISPLAY_IDENTIFIER time.tmr_ENPG1.EmergencyGearInfo._.ZFFSAB ECU_ADDRESS 0xFFF979BC /end MEASUREMENT
/begin MEASUREMENT ZFFSAB._.EmergencyGearInfo.tmr_ENPG3.time "Description for this variable only in SW documentation possible not in asap2" UWORD SAB_T_TIMER_10MS_S2_S3 1 100 0 655350 DISPLAY_IDENTIFIER time.tmr_ENPG3.EmergencyGearInfo._.ZFFSAB ECU_ADDRESS 0xFFF979BE /end MEASUREMENT
/begin MEASUREMENT ZFFSAB._.Interfi.iv_u_Batt_Diag "Input value for voltage of battery for local diagnostics" UWORD SAB_U_1VOLT1000_S2_S3 1 100 0 65.535 DISPLAY_IDENTIFIER iv_u_Batt_Diag.Interfi._.ZFFSAB ECU_ADDRESS 0xFFF97A6A /end MEASUREMENT
/begin MEASUREMENT ZFFSAB._.Interfi.iv_EepromBusy "Input signal of _GET_EE_BUSY macro from Siemens" UBYTE SAB_STANDARD_S2_S3 1 100 0 1 DISPLAY_IDENTIFIER iv_EepromBusy.Interfi._.ZFFSAB ECU_ADDRESS 0xFFF97A6C /end MEASUREMENT
/begin MEASUREMENT ZFFSAB._.Interfi.iv_Pos "Input value for position of Gear Lever" UBYTE SAB_STANDARD_S2_S3 1 100 0 255 DISPLAY_IDENTIFIER iv_Pos.Interfi._.ZFFSAB ECU_ADDRESS 0xFFF97A6D /end MEASUREMENT
/begin MEASUREMENT ZFFSAB._.Interfi.iv_PosSts "Input CAN message status for position of Gear Lever signal" UBYTE SAB_STANDARD_S2_S3 1 100 0 255 DISPLAY_IDENTIFIER iv_PosSts.Interfi._.ZFFSAB ECU_ADDRESS 0xFFF97A6E /end MEASUREMENT
/begin MEASUREMENT ZFFSAB._.Interfi.iv_Kraftschluss "Input value for power transmission" UBYTE SAB_STANDARD_S2_S3 1 100 0 6 DISPLAY_IDENTIFIER iv_Kraftschluss.Interfi._.ZFFSAB ECU_ADDRESS 0xFFF97A6F /end MEASUREMENT
/begin MEASUREMENT ZFFSAB._.BootJump.tmr_IEP_ShutdownDelay.time "Description for this variable only in SW documentation possible not in asap2" UBYTE SAB_T_TIMER_10MS_S2_S3 1 100 0 2550 DISPLAY_IDENTIFIER time.tmr_IEP_ShutdownDelay.BootJump._.ZFFSAB ECU_ADDRESS 0xFFF97B24 /end MEASUREMENT
/begin MEASUREMENT ZFFSAB._.SABEepromBPRAM.f_ForceEEPROM_Update "Force EEPROM Update if set" UBYTE SAB_STANDARD_S2_S3 1 100 0 255 DISPLAY_IDENTIFIER f_ForceEEPROM_Update.SABEepromBPRAM._.ZFFSAB ECU_ADDRESS 0xFFF83B4E /end MEASUREMENT
/begin MEASUREMENT ZFFSAB._.SABEepromBPRAM.f_ForceEEPROM_Update_ "Complement of Force EEPROM Update" UBYTE SAB_STANDARD_S2_S3 1 100 0 255 DISPLAY_IDENTIFIER f_ForceEEPROM_Update_.SABEepromBPRAM._.ZFFSAB ECU_ADDRESS 0xFFF83B4F /end MEASUREMENT
/begin MEASUREMENT ZFFSAB._.SABEeprom.EepromData.info_memory[0].moduleID "ID of the calling module" UBYTE SAB_STANDARD_S2_S3 1 100 0 255 DISPLAY_IDENTIFIER moduleID.info_memory[0].EepromData.SABEeprom._.ZFFSAB ECU_ADDRESS 0xFFF824F0 /end MEASUREMENT
/begin MEASUREMENT ZFFSAB._.SABEeprom.EepromData.info_memory[0].errorID "Error code - specified in calling module" UBYTE SAB_STANDARD_S2_S3 1 100 0 255 DISPLAY_IDENTIFIER errorID.info_memory[0].EepromData.SABEeprom._.ZFFSAB ECU_ADDRESS 0xFFF824F1 /end MEASUREMENT
/begin MEASUREMENT ZFFSAB._.SABEeprom.EepromData.info_memory[1].moduleID "ID of the calling module" UBYTE SAB_STANDARD_S2_S3 1 100 0 255 DISPLAY_IDENTIFIER moduleID.info_memory[1].EepromData.SABEeprom._.ZFFSAB ECU_ADDRESS 0xFFF824F2 /end MEASUREMENT
/begin MEASUREMENT ZFFSAB._.SABEeprom.EepromData.info_memory[1].errorID "Error code - specified in calling module" UBYTE SAB_STANDARD_S2_S3 1 100 0 255 DISPLAY_IDENTIFIER errorID.info_memory[1].EepromData.SABEeprom._.ZFFSAB ECU_ADDRESS 0xFFF824F3 /end MEASUREMENT
/begin MEASUREMENT ZFFSAB._.SABEeprom.EepromData.info_memory[2].moduleID "ID of the calling module" UBYTE SAB_STANDARD_S2_S3 1 100 0 255 DISPLAY_IDENTIFIER moduleID.info_memory[2].EepromData.SABEeprom._.ZFFSAB ECU_ADDRESS 0xFFF824F4 /end MEASUREMENT
/begin MEASUREMENT ZFFSAB._.SABEeprom.EepromData.info_memory[2].errorID "Error code - specified in calling module" UBYTE SAB_STANDARD_S2_S3 1 100 0 255 DISPLAY_IDENTIFIER errorID.info_memory[2].EepromData.SABEeprom._.ZFFSAB ECU_ADDRESS 0xFFF824F5 /end MEASUREMENT
/begin MEASUREMENT ZFFSAB._.SABEeprom.EepromData.info_memory[3].moduleID "ID of the calling module" UBYTE SAB_STANDARD_S2_S3 1 100 0 255 DISPLAY_IDENTIFIER moduleID.info_memory[3].EepromData.SABEeprom._.ZFFSAB ECU_ADDRESS 0xFFF824F6 /end MEASUREMENT
/begin MEASUREMENT ZFFSAB._.SABEeprom.EepromData.info_memory[3].errorID "Error code - specified in calling module" UBYTE SAB_STANDARD_S2_S3 1 100 0 255 DISPLAY_IDENTIFIER errorID.info_memory[3].EepromData.SABEeprom._.ZFFSAB ECU_ADDRESS 0xFFF824F7 /end MEASUREMENT
/begin MEASUREMENT ZFFSAB._.SABEeprom.EepromData.info_memory[4].moduleID "ID of the calling module" UBYTE SAB_STANDARD_S2_S3 1 100 0 255 DISPLAY_IDENTIFIER moduleID.info_memory[4].EepromData.SABEeprom._.ZFFSAB ECU_ADDRESS 0xFFF824F8 /end MEASUREMENT
/begin MEASUREMENT ZFFSAB._.SABEeprom.EepromData.info_memory[4].errorID "Error code - specified in calling module" UBYTE SAB_STANDARD_S2_S3 1 100 0 255 DISPLAY_IDENTIFIER errorID.info_memory[4].EepromData.SABEeprom._.ZFFSAB ECU_ADDRESS 0xFFF824F9 /end MEASUREMENT
/begin MEASUREMENT ZFFSAB._.SABEeprom.EepromData.info_memory[5].moduleID "ID of the calling module" UBYTE SAB_STANDARD_S2_S3 1 100 0 255 DISPLAY_IDENTIFIER moduleID.info_memory[5].EepromData.SABEeprom._.ZFFSAB ECU_ADDRESS 0xFFF824FA /end MEASUREMENT
/begin MEASUREMENT ZFFSAB._.SABEeprom.EepromData.info_memory[5].errorID "Error code - specified in calling module" UBYTE SAB_STANDARD_S2_S3 1 100 0 255 DISPLAY_IDENTIFIER errorID.info_memory[5].EepromData.SABEeprom._.ZFFSAB ECU_ADDRESS 0xFFF824FB /end MEASUREMENT
/begin MEASUREMENT ZFFSAB._.SABEeprom.EepromData.info_memory[6].moduleID "ID of the calling module" UBYTE SAB_STANDARD_S2_S3 1 100 0 255 DISPLAY_IDENTIFIER moduleID.info_memory[6].EepromData.SABEeprom._.ZFFSAB ECU_ADDRESS 0xFFF824FC /end MEASUREMENT
/begin MEASUREMENT ZFFSAB._.SABEeprom.EepromData.info_memory[6].errorID "Error code - specified in calling module" UBYTE SAB_STANDARD_S2_S3 1 100 0 255 DISPLAY_IDENTIFIER errorID.info_memory[6].EepromData.SABEeprom._.ZFFSAB ECU_ADDRESS 0xFFF824FD /end MEASUREMENT
/begin MEASUREMENT ZFFSAB._.SABEeprom.EepromData.info_memory[7].moduleID "ID of the calling module" UBYTE SAB_STANDARD_S2_S3 1 100 0 255 DISPLAY_IDENTIFIER moduleID.info_memory[7].EepromData.SABEeprom._.ZFFSAB ECU_ADDRESS 0xFFF824FE /end MEASUREMENT
/begin MEASUREMENT ZFFSAB._.SABEeprom.EepromData.info_memory[7].errorID "Error code - specified in calling module" UBYTE SAB_STANDARD_S2_S3 1 100 0 255 DISPLAY_IDENTIFIER errorID.info_memory[7].EepromData.SABEeprom._.ZFFSAB ECU_ADDRESS 0xFFF824FF /end MEASUREMENT
/begin MEASUREMENT ZFFSAB._.SABEeprom.EepromData.actual_IEP_CVN_ChkSum "CheckSum of datafield for actual IEP CVN" UWORD SAB_STANDARD_S2_S3 1 100 0 65535 DISPLAY_IDENTIFIER actual_IEP_CVN_ChkSum.EepromData.SABEeprom._.ZFFSAB ECU_ADDRESS 0xFFF823F0 /end MEASUREMENT
/begin MEASUREMENT ZFFSAB._.SABEeprom.EepromData.actual_IEP_CALID_ChkSum "CheckSum of datafield for actual IEP CALID" UWORD SAB_STANDARD_S2_S3 1 100 0 65535 DISPLAY_IDENTIFIER actual_IEP_CALID_ChkSum.EepromData.SABEeprom._.ZFFSAB ECU_ADDRESS 0xFFF82402 /end MEASUREMENT
/begin MEASUREMENT ZFFSAB._.SABEeprom.EepromData.MileageFromNabBuf "MileageFromNab eeprom buffer" ULONG SAB_L_1KM_S2_S3 1 100 0 65535 DISPLAY_IDENTIFIER MileageFromNabBuf.EepromData.SABEeprom._.ZFFSAB ECU_ADDRESS 0xFFF82404 /end MEASUREMENT
/begin MEASUREMENT ZFFSAB._.SABEeprom.EepromData.MileageFromNabBuf_ "Bit complement of MileageFromNab" ULONG SAB_STANDARD_S2_S3 1 100 0 65535 DISPLAY_IDENTIFIER MileageFromNabBuf_.EepromData.SABEeprom._.ZFFSAB ECU_ADDRESS 0xFFF82408 /end MEASUREMENT
/begin MEASUREMENT ZFFSAB._.SABEeprom.EepromData.f_n_xErrFlags "Bitfield with rpm error flags" UBYTE SAB_STANDARD_S2_S3 1 100 0 255 DISPLAY_IDENTIFIER f_n_xErrFlags.EepromData.SABEeprom._.ZFFSAB ECU_ADDRESS 0xFFF8240C /end MEASUREMENT
/begin MEASUREMENT ZFFSAB._.SABEeprom.EepromData.f_n_xErrFlags_ "bit complement f_n_xErrFlags" UBYTE SAB_STANDARD_S2_S3 1 100 0 255 DISPLAY_IDENTIFIER f_n_xErrFlags_.EepromData.SABEeprom._.ZFFSAB ECU_ADDRESS 0xFFF8240D /end MEASUREMENT
/begin MEASUREMENT ZFFSAB._.SABEeprom.EepromData.Mileage1kmBuf "Mileage eeprom buffer" ULONG SAB_L_1KM_S2_S3 1 100 0 4294967295 DISPLAY_IDENTIFIER Mileage1kmBuf.EepromData.SABEeprom._.ZFFSAB ECU_ADDRESS 0xFFF82410 /end MEASUREMENT
/begin MEASUREMENT ZFFSAB._.SABEeprom.EepromData.Mileage1kmBuf_ "Bit complement of mileage eeprom buffer" ULONG SAB_STANDARD_S2_S3 1 100 0 4294967295 DISPLAY_IDENTIFIER Mileage1kmBuf_.EepromData.SABEeprom._.ZFFSAB ECU_ADDRESS 0xFFF82414 /end MEASUREMENT
/begin MEASUREMENT ZFFSAB._.SABEeprom.EepromData.f_OBD_PFC_Activation "Flag OBD_PFC_Activation installed" UBYTE SAB_STANDARD_S2_S3 1 100 0 255 DISPLAY_IDENTIFIER f_OBD_PFC_Activation.EepromData.SABEeprom._.ZFFSAB ECU_ADDRESS 0xFFF82418 /end MEASUREMENT
/begin MEASUREMENT ZFFSAB._.SABEeprom.EepromData.f_OBD_PFC_Activation_ "Complemented Flag OBD_PFC_Activation installed" UBYTE SAB_STANDARD_S2_S3 1 100 0 255 DISPLAY_IDENTIFIER f_OBD_PFC_Activation_.EepromData.SABEeprom._.ZFFSAB ECU_ADDRESS 0xFFF82419 /end MEASUREMENT
/begin MEASUREMENT ZFFSAB._.SABEeprom.EepromData.f_AnalogPaddleLearned "Flag analog paddle learned" UBYTE SAB_STANDARD_S2_S3 1 100 0 255 DISPLAY_IDENTIFIER f_AnalogPaddleLearned.EepromData.SABEeprom._.ZFFSAB ECU_ADDRESS 0xFFF8241A /end MEASUREMENT
/begin MEASUREMENT ZFFSAB._.SABEeprom.EepromData.f_AnalogPaddleLearned_ "Flag analog paddle learned" UBYTE SAB_STANDARD_S2_S3 1 100 0 255 DISPLAY_IDENTIFIER f_AnalogPaddleLearned_.EepromData.SABEeprom._.ZFFSAB ECU_ADDRESS 0xFFF8241B /end MEASUREMENT
/begin MEASUREMENT ZFFSAB._.SABEeprom.EepromData.f_CANPaddleLearned "Flag can paddle learned" UBYTE SAB_STANDARD_S2_S3 1 100 0 255 DISPLAY_IDENTIFIER f_CANPaddleLearned.EepromData.SABEeprom._.ZFFSAB ECU_ADDRESS 0xFFF8241C /end MEASUREMENT
/begin MEASUREMENT ZFFSAB._.SABEeprom.EepromData.f_CANPaddleLearned_ "Flag can paddle learned" UBYTE SAB_STANDARD_S2_S3 1 100 0 255 DISPLAY_IDENTIFIER f_CANPaddleLearned_.EepromData.SABEeprom._.ZFFSAB ECU_ADDRESS 0xFFF8241D /end MEASUREMENT
/begin MEASUREMENT ZFFSAB._.SABEeprom.EepromData.RearAxleRatioBuf "RearAxleRatio eeprom buffer" UWORD SAB_STANDARD_S2_S3 1 100 0 65535 DISPLAY_IDENTIFIER RearAxleRatioBuf.EepromData.SABEeprom._.ZFFSAB ECU_ADDRESS 0xFFF8241E /end MEASUREMENT
/begin MEASUREMENT ZFFSAB._.SABEeprom.EepromData.RearAxleRatioBuf_ "Bit complement of RearAxleRatio eeprom buffer" UWORD SAB_STANDARD_S2_S3 1 100 0 65535 DISPLAY_IDENTIFIER RearAxleRatioBuf_.EepromData.SABEeprom._.ZFFSAB ECU_ADDRESS 0xFFF82420 /end MEASUREMENT
/begin MEASUREMENT ZFFSAB._.SABEeprom.EepromData.sv_RearAxleRatio_Value "Calculated value for rear axle ratio" UWORD SAB_STANDARD_S2_S3 1 100 0 65535 DISPLAY_IDENTIFIER sv_RearAxleRatio_Value.EepromData.SABEeprom._.ZFFSAB ECU_ADDRESS 0xFFF8249E /end MEASUREMENT
/begin MEASUREMENT ZFFSAB._.SABEeprom.EepromData.RearAxleRatio_Value_ "Calculated value for rear axle ratio" UWORD SAB_STANDARD_S2_S3 1 100 0 65535 DISPLAY_IDENTIFIER RearAxleRatio_Value_.EepromData.SABEeprom._.ZFFSAB ECU_ADDRESS 0xFFF824A0 /end MEASUREMENT
/begin MEASUREMENT ZFFSAB._.SABEeprom.EepromData.sv_RearAxleRatio_ValueNumact "Number of already performed learning cycles" UBYTE SAB_STANDARD_S2_S3 1 100 0 255 DISPLAY_IDENTIFIER sv_RearAxleRatio_ValueNumact.EepromData.SABEeprom._.ZFFSAB ECU_ADDRESS 0xFFF824A2 /end MEASUREMENT
/begin MEASUREMENT ZFFSAB._.SABEeprom.EepromData.RearAxleRatio_ValueNumact_ "Number of already performed learning cycles" UBYTE SAB_STANDARD_S2_S3 1 100 0 255 DISPLAY_IDENTIFIER RearAxleRatio_ValueNumact_.EepromData.SABEeprom._.ZFFSAB ECU_ADDRESS 0xFFF824A3 /end MEASUREMENT
/begin MEASUREMENT ZFFSAB._.SABEeprom.EepromData.sv_RearAxleRatio_ValueLearnedFlag "If this flag is set to 1 all required learning cycles have been performed" UBYTE SAB_STANDARD_S2_S3 1 100 0 255 DISPLAY_IDENTIFIER sv_RearAxleRatio_ValueLearnedFlag.EepromData.SABEeprom._.ZFFSAB ECU_ADDRESS 0xFFF824A4 /end MEASUREMENT
/begin MEASUREMENT ZFFSAB._.SABEeprom.EepromData.sv_RearAxleRatio_ValueLearnedFlag_ "If this flag is set to 254 all required learning cycles have been performed" UBYTE SAB_STANDARD_S2_S3 1 100 0 255 DISPLAY_IDENTIFIER sv_RearAxleRatio_ValueLearnedFlag_.EepromData.SABEeprom._.ZFFSAB ECU_ADDRESS 0xFFF824A5 /end MEASUREMENT
/begin MEASUREMENT ZFFSAB._.SABEeprom.EepromData.st_ReceiveBitmaskCANMsg2 "Bit mask for receiving CAN messages [bit x = 1 -> CAN message received]" ULONG SAB_STANDARD_S2_S3 1 100 0 4294967295 DISPLAY_IDENTIFIER st_ReceiveBitmaskCANMsg2.EepromData.SABEeprom._.ZFFSAB ECU_ADDRESS 0xFFF824A8 /end MEASUREMENT
/begin MEASUREMENT ZFFSAB._.SABEeprom.EepromData.st_ReceiveBitmaskCANMsg2_ "Bit-complement of bit mask for receiving CAN messages" ULONG SAB_STANDARD_S2_S3 1 100 0 4294967295 DISPLAY_IDENTIFIER st_ReceiveBitmaskCANMsg2_.EepromData.SABEeprom._.ZFFSAB ECU_ADDRESS 0xFFF824AC /end MEASUREMENT
/begin MEASUREMENT ZFFSAB._.SABEeprom.EepromData.st_ReceiveBitmaskCANMsg1 "Bit mask for receiving CAN messages [bit x = 1 -> CAN message received]" ULONG SAB_STANDARD_S2_S3 1 100 0 4294967295 DISPLAY_IDENTIFIER st_ReceiveBitmaskCANMsg1.EepromData.SABEeprom._.ZFFSAB ECU_ADDRESS 0xFFF824B0 /end MEASUREMENT
/begin MEASUREMENT ZFFSAB._.SABEeprom.EepromData.st_ReceiveBitmaskCANMsg1_ "Bit-complement of bit mask for receiving CAN messages" ULONG SAB_STANDARD_S2_S3 1 100 0 4294967295 DISPLAY_IDENTIFIER st_ReceiveBitmaskCANMsg1_.EepromData.SABEeprom._.ZFFSAB ECU_ADDRESS 0xFFF824B4 /end MEASUREMENT
/begin MEASUREMENT ZFFSAB._.SABEeprom.EepromData.cnt_ForcedShiftups "Byte counter for forced shiftups by the DME" UBYTE SAB_STANDARD_S2_S3 1 100 0 255 DISPLAY_IDENTIFIER cnt_ForcedShiftups.EepromData.SABEeprom._.ZFFSAB ECU_ADDRESS 0xFFF824B8 /end MEASUREMENT
/begin MEASUREMENT ZFFSAB._.SABEeprom.EepromData.cnt_ForcedShiftups_ "Complemented byte counter for forced shiftups by the DME" UBYTE SAB_STANDARD_S2_S3 1 100 0 255 DISPLAY_IDENTIFIER cnt_ForcedShiftups_.EepromData.SABEeprom._.ZFFSAB ECU_ADDRESS 0xFFF824B9 /end MEASUREMENT
/begin MEASUREMENT ZFFSAB._.SABEeprom.EepromData.f_c_Chip1CGT "error flag of Sensor plausibility check between Chip1 and CGT temperature" UBYTE SAB_STANDARD_S2_S3 1 100 0 255 DISPLAY_IDENTIFIER f_c_Chip1CGT.EepromData.SABEeprom._.ZFFSAB ECU_ADDRESS 0xFFF824BA /end MEASUREMENT
/begin MEASUREMENT ZFFSAB._.SABEeprom.EepromData.f_c_Chip1CGT_ "complement of corresponding variable" UBYTE SAB_STANDARD_S2_S3 1 100 0 255 DISPLAY_IDENTIFIER f_c_Chip1CGT_.EepromData.SABEeprom._.ZFFSAB ECU_ADDRESS 0xFFF824BB /end MEASUREMENT
/begin MEASUREMENT ZFFSAB._.SABEeprom.EepromData.f_c_Chip2CGT "error flag of Sensor plausibility check between Chip2 and CGT temperature" UBYTE SAB_STANDARD_S2_S3 1 100 0 255 DISPLAY_IDENTIFIER f_c_Chip2CGT.EepromData.SABEeprom._.ZFFSAB ECU_ADDRESS 0xFFF824BC /end MEASUREMENT
/begin MEASUREMENT ZFFSAB._.SABEeprom.EepromData.f_c_Chip2CGT_ "complement of corresponding variable" UBYTE SAB_STANDARD_S2_S3 1 100 0 255 DISPLAY_IDENTIFIER f_c_Chip2CGT_.EepromData.SABEeprom._.ZFFSAB ECU_ADDRESS 0xFFF824BD /end MEASUREMENT
/begin MEASUREMENT ZFFSAB._.SABEeprom.EepromData.f_c_Chip1Chip2 "error flag of Sensor plausibility check between Chip1 and Chip2 temperature" UBYTE SAB_STANDARD_S2_S3 1 100 0 255 DISPLAY_IDENTIFIER f_c_Chip1Chip2.EepromData.SABEeprom._.ZFFSAB ECU_ADDRESS 0xFFF824BE /end MEASUREMENT
/begin MEASUREMENT ZFFSAB._.SABEeprom.EepromData.f_c_Chip1Chip2_ "complement of corresponding variable" UBYTE SAB_STANDARD_S2_S3 1 100 0 255 DISPLAY_IDENTIFIER f_c_Chip1Chip2_.EepromData.SABEeprom._.ZFFSAB ECU_ADDRESS 0xFFF824BF /end MEASUREMENT
/begin MEASUREMENT ZFFSAB._.SABEeprom.EepromData.f_c_Chip1PlausiErr "Error flag of Sensor Chip1" UBYTE SAB_STANDARD_S2_S3 1 100 0 255 DISPLAY_IDENTIFIER f_c_Chip1PlausiErr.EepromData.SABEeprom._.ZFFSAB ECU_ADDRESS 0xFFF824C0 /end MEASUREMENT
/begin MEASUREMENT ZFFSAB._.SABEeprom.EepromData.f_c_Chip1PlausiErr_ "complement of corresponding variable" UBYTE SAB_STANDARD_S2_S3 1 100 0 255 DISPLAY_IDENTIFIER f_c_Chip1PlausiErr_.EepromData.SABEeprom._.ZFFSAB ECU_ADDRESS 0xFFF824C1 /end MEASUREMENT
/begin MEASUREMENT ZFFSAB._.SABEeprom.EepromData.f_c_Chip2PlausiErr "Error flag of Sensor Chip2" UBYTE SAB_STANDARD_S2_S3 1 100 0 255 DISPLAY_IDENTIFIER f_c_Chip2PlausiErr.EepromData.SABEeprom._.ZFFSAB ECU_ADDRESS 0xFFF824C2 /end MEASUREMENT
/begin MEASUREMENT ZFFSAB._.SABEeprom.EepromData.f_c_Chip2PlausiErr_ "complement of corresponding variable" UBYTE SAB_STANDARD_S2_S3 1 100 0 255 DISPLAY_IDENTIFIER f_c_Chip2PlausiErr_.EepromData.SABEeprom._.ZFFSAB ECU_ADDRESS 0xFFF824C3 /end MEASUREMENT
/begin MEASUREMENT ZFFSAB._.SABEeprom.EepromData.f_c_CgtPlausiErr "Error flag of Sensor CGT" UBYTE SAB_STANDARD_S2_S3 1 100 0 255 DISPLAY_IDENTIFIER f_c_CgtPlausiErr.EepromData.SABEeprom._.ZFFSAB ECU_ADDRESS 0xFFF824C4 /end MEASUREMENT
/begin MEASUREMENT ZFFSAB._.SABEeprom.EepromData.f_c_CgtPlausiErr_ "complement of corresponding variable" UBYTE SAB_STANDARD_S2_S3 1 100 0 255 DISPLAY_IDENTIFIER f_c_CgtPlausiErr_.EepromData.SABEeprom._.ZFFSAB ECU_ADDRESS 0xFFF824C5 /end MEASUREMENT
/begin MEASUREMENT ZFFSAB._.SABEeprom.EepromData.f_c_PlausiErr "Error flag double Sensor Error" UBYTE SAB_STANDARD_S2_S3 1 100 0 255 DISPLAY_IDENTIFIER f_c_PlausiErr.EepromData.SABEeprom._.ZFFSAB ECU_ADDRESS 0xFFF824C6 /end MEASUREMENT
/begin MEASUREMENT ZFFSAB._.SABEeprom.EepromData.f_c_PlausiErr_ "complement of corresponding variable" UBYTE SAB_STANDARD_S2_S3 1 100 0 255 DISPLAY_IDENTIFIER f_c_PlausiErr_.EepromData.SABEeprom._.ZFFSAB ECU_ADDRESS 0xFFF824C7 /end MEASUREMENT
/begin MEASUREMENT ZFFSAB._.SABEeprom.EepromData.t_SystimeCurBuf "Last valid system time" ULONG SAB_STANDARD_S2_S3 1 100 0 4294967295 DISPLAY_IDENTIFIER t_SystimeCurBuf.EepromData.SABEeprom._.ZFFSAB ECU_ADDRESS 0xFFF824C8 /end MEASUREMENT
/begin MEASUREMENT ZFFSAB._.SABEeprom.EepromData.t_SystimeCurBuf_ "Complement of last valid system time" ULONG SAB_STANDARD_S2_S3 1 100 0 4294967295 DISPLAY_IDENTIFIER t_SystimeCurBuf_.EepromData.SABEeprom._.ZFFSAB ECU_ADDRESS 0xFFF824CC /end MEASUREMENT
/begin MEASUREMENT ZFFSAB._.SABEeprom.EepromData.f_PMAModeLearned "Learned flag of PMA mode" UBYTE SAB_STANDARD_S2_S3 1 100 0 255 DISPLAY_IDENTIFIER f_PMAModeLearned.EepromData.SABEeprom._.ZFFSAB ECU_ADDRESS 0xFFF824D0 /end MEASUREMENT
/begin MEASUREMENT ZFFSAB._.SABEeprom.EepromData.f_PMAModeLearned_ "Complement of learned flag of PMA mode" UBYTE SAB_STANDARD_S2_S3 1 100 0 255 DISPLAY_IDENTIFIER f_PMAModeLearned_.EepromData.SABEeprom._.ZFFSAB ECU_ADDRESS 0xFFF824D1 /end MEASUREMENT
/begin MEASUREMENT ZFFSAB._.SABEeprom.EepromData.IgnPlausiErr "actual state of plausibility check for KL15 CAN against hardware signal" UBYTE SAB_STANDARD_S2_S3 1 100 0 2 DISPLAY_IDENTIFIER IgnPlausiErr.EepromData.SABEeprom._.ZFFSAB ECU_ADDRESS 0xFFF824D2 /end MEASUREMENT
/begin MEASUREMENT ZFFSAB._.SABEeprom.EepromData.IgnPlausiErr_ "Complement of active OBD variant" UBYTE SAB_STANDARD_S2_S3 1 100 0 255 DISPLAY_IDENTIFIER IgnPlausiErr_.EepromData.SABEeprom._.ZFFSAB ECU_ADDRESS 0xFFF824D3 /end MEASUREMENT
/begin MEASUREMENT ZFFSAB._.SABEeprom.EepromData.cnt_RstSuccessSumBuf "Sum of successful RzN resets over the whole car life" UWORD SAB_STANDARD_S2_S3 1 100 0 65535 DISPLAY_IDENTIFIER cnt_RstSuccessSumBuf.EepromData.SABEeprom._.ZFFSAB ECU_ADDRESS 0xFFF824D4 /end MEASUREMENT
/begin MEASUREMENT ZFFSAB._.SABEeprom.EepromData.cnt_RstSuccessSumBuf_ "Complement of sum of successful RzN resets over the whole car life" UWORD SAB_STANDARD_S2_S3 1 100 0 65535 DISPLAY_IDENTIFIER cnt_RstSuccessSumBuf_.EepromData.SABEeprom._.ZFFSAB ECU_ADDRESS 0xFFF824D6 /end MEASUREMENT
/begin MEASUREMENT ZFFSAB._.SABEeprom.EepromData.cnt_RstFailSumBuf "Sum of failed RzN resets over the whole car life" UWORD SAB_STANDARD_S2_S3 1 100 0 65535 DISPLAY_IDENTIFIER cnt_RstFailSumBuf.EepromData.SABEeprom._.ZFFSAB ECU_ADDRESS 0xFFF824D8 /end MEASUREMENT
/begin MEASUREMENT ZFFSAB._.SABEeprom.EepromData.cnt_RstFailSumBuf_ "Complement of sum of failed RzN resets over the whole car life" UWORD SAB_STANDARD_S2_S3 1 100 0 65535 DISPLAY_IDENTIFIER cnt_RstFailSumBuf_.EepromData.SABEeprom._.ZFFSAB ECU_ADDRESS 0xFFF824DA /end MEASUREMENT
/begin MEASUREMENT ZFFSAB._.SABEeprom.EepromData.actSlaveSparePartNumber_ChkSum "CheckSum of datafield for Actual IEP SparePartNumber entries" UWORD SAB_STANDARD_S2_S3 1 100 0 65535 DISPLAY_IDENTIFIER actSlaveSparePartNumber_ChkSum.EepromData.SABEeprom._.ZFFSAB ECU_ADDRESS 0xFFF824E8 /end MEASUREMENT
/begin MEASUREMENT ZFFSAB._.SABEeprom.EepromData.actSlaveAppSWVersionNum_ChkSum "CheckSum of datafield for Actual IEP SparePartNumber entries" UWORD SAB_STANDARD_S2_S3 1 100 0 65535 DISPLAY_IDENTIFIER actSlaveAppSWVersionNum_ChkSum.EepromData.SABEeprom._.ZFFSAB ECU_ADDRESS 0xFFF824EE /end MEASUREMENT
/begin MEASUREMENT ZFFSAB._.SABEeprom.EepromData.cnt_info_memory_entries "Counter for internal information memory entries" UWORD SAB_STANDARD_S2_S3 1 100 0 255 DISPLAY_IDENTIFIER cnt_info_memory_entries.EepromData.SABEeprom._.ZFFSAB ECU_ADDRESS 0xFFF82500 /end MEASUREMENT
/begin MEASUREMENT ZFFSAB._.SABEeprom.EepromData.info_memory_checksum "Checksum for internal information memory" UWORD SAB_STANDARD_S2_S3 1 100 0 65535 DISPLAY_IDENTIFIER info_memory_checksum.EepromData.SABEeprom._.ZFFSAB ECU_ADDRESS 0xFFF82502 /end MEASUREMENT
/begin COMPU_METHOD _CNV_S_2_Enum_ENICS_237_CM_S2 "" TAB_VERB "%6.3" "" COMPU_TAB_REF _CNV_S_2_Enum_ENICS_237_S2 /end COMPU_METHOD
/begin COMPU_METHOD _CNV_S_2_Enum_EENBL_250_CM_S2 "" TAB_VERB "%6.3" "" COMPU_TAB_REF _CNV_S_2_Enum_EENBL_250_S2 /end COMPU_METHOD
/begin COMPU_METHOD _CNV_S_2_Enum_EMINM_322_CM_S2 "" TAB_VERB "%6.3" "" COMPU_TAB_REF _CNV_S_2_Enum_EMINM_322_S2 /end COMPU_METHOD
/begin COMPU_METHOD _CNV_S_2_Enum_EFLAN_342_CM_S2 "" TAB_VERB "%6.3" "" COMPU_TAB_REF _CNV_S_2_Enum_EFLAN_342_S2 /end COMPU_METHOD
/begin COMPU_METHOD UMR_HDK_M_1004_2550_S1_S3 "int = ((phys * 2550) / 1004) - (0) %" RAT_FUNC "%5.3" "%" COEFFS 0 2550 -0 0 0 1004 /end COMPU_METHOD
/begin COMPU_METHOD UMR_MBSE_MSEC__10_1_0_S1_S3 "Umrechnung von 10 msec in msec\\nint = ((phys * 1) / 10) - (0) msec" RAT_FUNC "%5.3" "msec" COEFFS 0 1 -0 0 0 10 /end COMPU_METHOD
/begin COMPU_METHOD UMR_SEC_1_1_0_S1_S3 "int = ((phys * 1) / 1) - (0) [s]" RAT_FUNC "%2.0" "[s]" COEFFS 0 1 -0 0 0 1 /end COMPU_METHOD
/begin COMPU_METHOD UMR_CGT40__1_1_M40_S1_S3 "int = ((phys * 1) / 1) - (-40) Grad Celsius" RAT_FUNC "%2.0" "Grad Celsius" COEFFS 0 1 40 0 0 1 /end COMPU_METHOD
/begin COMPU_METHOD UMR_VKMH__1_16_0_S1_S3 "Umrechnung von 1/16 km/h in km/h\\nint = ((phys * 16) / 1) - (0) km/h" RAT_FUNC "%5.3" "km/h" COEFFS 0 16 -0 0 0 1 /end COMPU_METHOD
/begin COMPU_METHOD UMR_RPM_1_1_0_S1_S3 "Umdrehung pro Minute\\nint = ((phys * 1) / 1) - (0) rpm" RAT_FUNC "%2.0" "rpm" COEFFS 0 1 -0 0 0 1 /end COMPU_METHOD
/begin COMPU_METHOD UMR___1_1_0_S1_S3 "Ohne Umskalierung\\nint = ((phys * 1) / 1) - (0) " RAT_FUNC "%2.0" "" COEFFS 0 1 -0 0 0 1 /end COMPU_METHOD
/begin COMPU_METHOD eTabLockCondX_S1_S3 "" TAB_VERB "%2.0" "" COMPU_TAB_REF eTabLockCondX_S1_S3 /end COMPU_METHOD
/begin COMPU_METHOD eTabLockCondY_S1_S3 "" TAB_VERB "%2.0" "" COMPU_TAB_REF eTabLockCondY_S1_S3 /end COMPU_METHOD
/begin COMPU_METHOD SAB_STANDARD_S2_S3 "int = ((phys * 1) / 1) - (0) -" RAT_FUNC "%2.0" "-" COEFFS 0 1 -0 0 0 1 /end COMPU_METHOD
/begin COMPU_METHOD SAB_N_RPM2_M5000_S2_S3 "int = ((phys * 2) / 1) - (-10000) 1/min" RAT_FUNC "%5.3" "1/min" COEFFS 0 2 10000 0 0 1 /end COMPU_METHOD
/begin COMPU_METHOD SAB_N_RPM4_S2_S3 "int = ((phys * 4) / 1) - (0) 1/min" RAT_FUNC "%5.3" "1/min" COEFFS 0 4 -0 0 0 1 /end COMPU_METHOD
/begin COMPU_METHOD SAB_T_TIMER_1US_S2_S3 "int = ((phys * 1) / 1) - (0) us" RAT_FUNC "%2.0" "us" COEFFS 0 1 -0 0 0 1 /end COMPU_METHOD
/begin COMPU_METHOD SAB_T_TIMER_1MS_S2_S3 "int = ((phys * 1) / 1) - (0) ms" RAT_FUNC "%2.0" "ms" COEFFS 0 1 -0 0 0 1 /end COMPU_METHOD
/begin COMPU_METHOD SAB_T_TIMER_5MS_S2_S3 "int = ((phys * 1) / 5) - (0) ms" RAT_FUNC "%5.3" "ms" COEFFS 0 1 -0 0 0 5 /end COMPU_METHOD
/begin COMPU_METHOD SAB_T_TIMER_10MS_S2_S3 "int = ((phys * 1) / 10) - (0) ms" RAT_FUNC "%5.3" "ms" COEFFS 0 1 -0 0 0 10 /end COMPU_METHOD
/begin COMPU_METHOD SAB_T_TIMER_S10_S2_S3 "int = ((phys * 10) / 1) - (0) s" RAT_FUNC "%5.3" "s" COEFFS 0 10 -0 0 0 1 /end COMPU_METHOD
/begin COMPU_METHOD SAB_N_1RPM_S2_S3 "int = ((phys * 1) / 1) - (0) 1/min" RAT_FUNC "%2.0" "1/min" COEFFS 0 1 -0 0 0 1 /end COMPU_METHOD
/begin COMPU_METHOD SAB_M_1NM_S2_S3 "int = ((phys * 1) / 1) - (0) Nm" RAT_FUNC "%2.0" "Nm" COEFFS 0 1 -0 0 0 1 /end COMPU_METHOD
/begin COMPU_METHOD SAB_L_1KM_S2_S3 "int = ((phys * 1) / 1) - (0) km" RAT_FUNC "%2.0" "km" COEFFS 0 1 -0 0 0 1 /end COMPU_METHOD
/begin COMPU_METHOD SAB_K1000_S2_S3 "int = ((phys * 1000) / 1) - (0) -" RAT_FUNC "%5.3" "-" COEFFS 0 1000 -0 0 0 1 /end COMPU_METHOD
/begin COMPU_METHOD SAB_U_1VOLT1000_S2_S3 "int = ((phys * 1000) / 1) - (0) Volt" RAT_FUNC "%5.3" "Volt" COEFFS 0 1000 -0 0 0 1 /end COMPU_METHOD
/begin COMPU_METHOD SAB_M_NM2_M2047_S2_S3 "int = ((phys * 2) / 1) - (-2047) Nm" RAT_FUNC "%5.3" "Nm" COEFFS 0 2 2047 0 0 1 /end COMPU_METHOD
/begin COMPU_METHOD SAB_100PROZENT254_S2_S3 "int = ((phys * 254) / 100) - (0) %" RAT_FUNC "%5.3" "%" COEFFS 0 254 -0 0 0 100 /end COMPU_METHOD
/begin COMPU_METHOD SAB_I_MA10_S2_S3 "int = ((phys * 10) / 1) - (0) mA" RAT_FUNC "%5.3" "mA" COEFFS 0 10 -0 0 0 1 /end COMPU_METHOD
/begin COMPU_METHOD SAB_FRQ_1HZ_S2_S3 "int = ((phys * 1) / 1) - (0) Hz" RAT_FUNC "%2.0" "Hz" COEFFS 0 1 -0 0 0 1 /end COMPU_METHOD
/begin COMPU_VTAB _CNV_S_2_Enum_ENICS_237_S2 "" TAB_VERB 2 0 "POS_D" 1 "POS_R" /end COMPU_VTAB
/begin COMPU_VTAB _CNV_S_2_Enum_EENBL_250_S2 "" TAB_VERB 2 0 "SKL" 1 "WK" /end COMPU_VTAB
/begin COMPU_VTAB _CNV_S_2_Enum_EMINM_322_S2 "" TAB_VERB 2 0 "MIN_NAB" 1 "MAX_NAB" /end COMPU_VTAB
/begin COMPU_VTAB _CNV_S_2_Enum_EFLAN_342_S2 "" TAB_VERB 2 0 "Steigend_oder_Gleich" 1 "Fallend" /end COMPU_VTAB
/begin COMPU_VTAB eTabLockCondX_S1_S3 "" TAB_VERB 2 0 "E_LOW" 1 "E_HIGH" /end COMPU_VTAB
/begin COMPU_VTAB eTabLockCondY_S1_S3 "" TAB_VERB 40 0 "E_CCID1" 1 "E_CCID2" 2 "E_CCID3" 3 "E_CCID4" 4 "E_CCID5" 5 "E_CCID6" 6 "E_CCID7" 7 "E_CCID8" 8 "E_CCID9" 9 "E_CCID10" 10 "E_CCID11" 11 "E_CCID12" 12 "E_CCID13" 13 "E_CCID14" 14 "E_CCID15" 15 "E_CCID16" 16 "E_CCID17" 17 "E_CCID18" 18 "E_CCID19" 19 "E_CCID20" 20 "E_CCID21" 21 "E_CCID22" 22 "E_CCID23" 23 "E_CCID24" 24 "E_CCID25" 25 "E_CCID26" 26 "E_CCID27" 27 "E_CCID28" 28 "E_CCID29" 29 "E_CCID30" 30 "E_CCID31" 31 "E_CCID32" 32 "E_CCID33" 33 "E_CCID34" 34 "E_CCID35" 35 "E_CCID36" 36 "E_CCID37" 37 "E_CCID38" 38 "E_CCID39" 39 "E_CCID40" /end COMPU_VTAB
/begin FUNCTION StarterReleaseDelay ""
 /begin DEF_CHARACTERISTIC D_t_StarterInhibitor_Default D_t_StarterInhibitor_Limphome SWI_StarterReleaseDelayOn /end DEF_CHARACTERISTIC
/end FUNCTION
/begin FUNCTION StoreDrvReq ""
 /begin DEF_CHARACTERISTIC D_ResetStoreTimeEngOnToOff D_t_Lev2PosError D_t_StoreD D_t_StoreN D_t_StoreN_EGNER D_t_StoreP D_t_StoreR D_t_StoreRD_EngStart D_v_N_Uth SWI_StoreP_AlthoughRejectedBySpeed SWI_StoreP_RestartTimerWhileShifterInP SWI_StoreRD_AlthoughRejectedBySpeed SWI_StoreRD_N2RD SWI_StoreRD_N2RD_RestartTimer SWI_StoreRD_N2RD_UseUndefinedDirBuf SWI_StoreRD_RestartTimerWhileShifterInRD /end DEF_CHARACTERISTIC
/end FUNCTION
/begin FUNCTION cc_msg ""
 /begin DEF_CHARACTERISTIC D_CC_ID D_CC_Prio D_Tab_LockCond D_c_TOilCCML_Th D_t_CC_CycleTime D_t_CC_MinTime D_t_CC_delay D_type_CC D_v_CC D_v_CC_Parklock_Lth SWI_CC SWI_CC_Individual /end DEF_CHARACTERISTIC
/end FUNCTION
/begin FUNCTION diagpos ""
 /begin DEF_CHARACTERISTIC D_SetPreAdpvEnd D_SetPreAdpvFaild D_t_DebounceWrongDrvDir D_t_DebounceWrongDrvDirMinTime D_t_FlashDiagPosInWrongDrvDir D_v_WrongDrvDir SWI_DiagPos SWI_DiagPosByVimplausible SWI_DiagPosDrvAssist SWI_DiagPosInWrongDrvDir SWI_DiagPosUWIG /end DEF_CHARACTERISTIC
/end FUNCTION
/begin FUNCTION ews4 ""
 /begin DEF_CHARACTERISTIC D_Rsp_ErrCnt_FctCRafterCalcSK_Max_B D_Rsp_ErrCnt_SK_avail_Max_A D_Rsp_ErrCnt_SK_unavail_Max_C D_Rsp_OkCnt_FctCRafterCalcSK_Min_Ok D_n_Ab_AllowFSC_Uth D_n_Uth_MissingRspSwitchCANpath D_n_Uth_cnt_TASCASReq D_t_Delay_AfterSleepInd_BeforeLockEGS D_t_Delay_KeyAuthWhileFACanFailure D_t_Delay_WaitTasCasRequest D_t_Min_RxRspUntilTxChal D_t_Min_TASCASReq D_t_Min_TxChalUntilTxChal_NoRsp D_t_Prevent_KFC_EWSDRVRQ D_t_TO_EEprom_StoreImmediate D_t_TO_RxKFAfterTxKF_Id_2 D_t_TO_RxRspAfterTxChal_Id_1 D_t_TO_StoreCheckFSC SWI_Auth_IgnOnWUPTo_AddCheck_KeyValidSts SWI_Ews4_E_Label /end DEF_CHARACTERISTIC
/end FUNCTION
/begin FUNCTION kombi_msg "" /begin DEF_CHARACTERISTIC D_t_IgnOnNeverDetected D_t_P12BadOpDisp /end DEF_CHARACTERISTIC /end FUNCTION
/begin FUNCTION mode ""
 /begin DEF_CHARACTERISTIC D_t_ModeReturnTip1 D_t_ModeReturnTip2 D_t_TipOn SWI_ModeEnabledAFIX SWI_StoreMode /end DEF_CHARACTERISTIC
/end FUNCTION
/begin FUNCTION powerdown ""
 /begin DEF_CHARACTERISTIC D_t_PowDownDefault D_t_PowDownDispN D_t_PowDownDispP D_t_PowDownDispRD /end DEF_CHARACTERISTIC
/end FUNCTION
/begin FUNCTION shiftlock ""
 /begin DEF_CHARACTERISTIC D_n_EngDiaShiftlock_Lth D_n_EngShiftlockLth D_v_Shiftlock_Uth SWI_Shiftlock_Disable /end DEF_CHARACTERISTIC
/end FUNCTION
/begin FUNCTION signals ""
 /begin DEF_CHARACTERISTIC D_AcceleratorPedalAngleTh D_c_CCHotHysOilChip_Th D_c_TChipCCHot1_Th D_c_TChipCCHot2_Th D_c_TChipCCHot3_Th D_c_TOilCCHot1_Th D_c_TOilCCHot2_Th D_c_TOilCCHot3_Th D_n_EngEGNER_Off D_t_DebounceOilChipTransErr D_t_E_GNER_ActiveTime D_t_E_GNER_DebounceTime D_t_E_GNER_Misuse D_t_E_GNER_PosRequestStoreTime D_t_E_GNER_Precond D_t_FlashN D_t_P12BadOp D_v_AutoN_Uth D_v_D_Lth D_v_D_Uth D_v_E_GNER_Misuse D_v_P12BadOpDisp D_v_P_Lth D_v_P_Uth D_v_R_Lth D_v_R_Uth SWI_E_GNER_Active SWI_HotmodeOilChipStsActivation SWI_IgnoreLeverActionAfterPPressed SWI_KL15_PinPlausiOn /end DEF_CHARACTERISTIC
/end FUNCTION
/begin FUNCTION zff_SABIN "data of signal processing" /begin SUB_FUNCTION zff_SABIN_Messgroessen zff_SABIN_Applikationsgroessen /end SUB_FUNCTION /end FUNCTION
/begin FUNCTION zff_SABIN_Messgroessen "all measurements of signal processing"
 /begin SUB_FUNCTION zf_SABin_Timer zf_SAB_AzgDriver zf_SAB_Interfo zf_SAB_Timer zf_SAB_RPM_SensingIn zf_SABin_Interfi zf_SAB_Eeprom zf_SAB_EngineSpeedIn zf_SAB_IgnitionStatusIn zf_SAB_RoutineControlUDS zf_SAB_ASCIn zf_SAB_ASCPasIn zf_SAB_BackToNormalFunctionViaReset zf_SAB_OBD_CyclesIn zf_SAB_SpeedPlausibilityIn zf_SAB_LowModeDriveIn zf_SAB_FullThrottleTorqueIn zf_SAB_GearRatioByCurrents_fl zf_SAB_GearRatioByCurrents zf_SAB_BrakePedalIn zf_SAB_CAN_SwitchingIn zf_SAB_Coding zf_SAB_OSModeSwitchingOut zf_SAB_EngineCoolantTempIn zf_SAB_GearboxTempInFl zf_SAB_GearboxTempIn zf_SAB_TempDiagnosis_AT zf_SAB_FpDkVpIn zf_SAB_FlagTrailerInfoIn zf_SAB_DrivingStateIn zf_SAB_DrivingSpeedControlIn zf_SAB_HybridControlIn zf_SAB_HybridVehicleReadyToDriveIn zf_SAB_YawIn zf_SAB_LDMDesiredTorqueIn zf_SAB_HDCIn zf_SAB_FlagKickDownIn zf_SAB_AccelerationLongIn zf_SAB_AmbConditionsIn zf_SAB_DistanceIn zf_SAB_CDD_IEP_Control zf_SAB_FrictionIn zf_SAB_CrankShaftCurTorqueIn zf_SAB_EngineTorqueInFl zf_SAB_EngineTorqueIn zf_SAB_TorqueReserveIn zf_SAB_DesiredTorqueIn zf_SAB_FuelCutoffActiveIn zf_SAB_EngineIdleSpeedReqIn zf_SAB_BaroPressureIn zf_SAB_HybridSignalsIn zf_SAB_ExtBrakeInterventionIn zf_SAB_BrakeTorqueIn zf_SAB_AccelerationAcrossIn zf_SAB_AfuReqIn zf_SAB_RearAxleRatioIn zf_SAB_DynRunRadiusIn zf_SAB_WarmUpIn zf_SAB_VehicleSpeedIn zf_SAB_MaxTorquePredictionEMIn zf_SAB_SteeringWheelAngleIn zf_SAB_SubstTempIn zf_SAB_TransmissionOutputSpeedIn zf_SAB_WheelIn zf_SAB_RollPreventIn zf_SAB_ParkingBrakeIn zf_SAB_ParkManeuverAssistant zf_SAB_RegPartFilterIn zf_SAB_DrivingDirectionIn zf_SAB_TempDiagnosis_Fl zf_SAB_TempDiagnosis zf_SAB_TempExternIn zf_SAB_IgnitionKeyStatusIn zf_SAB_DriverSeatStatusIn zf_SAB_ShiftlockRequestExternalIn zf_SAB_EngineInterventionLimitIn zf_SAB_TurbineSpeedVirtualIn zf_SAB_TurbineSpeedIn zf_SAB_ParklockStatusIn zf_SAB_ParklockSensorIn zf_SAB_TractionControlIn zf_SAB_DoorStatusIn zf_SAB_SpeedometerSpeedIn zf_SAB_InclinationIn zf_SAB_GearLeverIn zf_SAB_SportButtonIn zf_SAB_VoltageMonitoringOut zf_SAB_CAN_Handling zf_SAB_MSAIn zf_SAB_MSAOut zf_SAB_PowerdownIn zf_SAB_TipTasterIn zf_SAB_GearLimitation zf_SAB_EmergencyGearInfo zf_SAB_RPM_Diagnosis zf_SAB_EstVehicleWeightIn zf_SAB_CurWheelTrqIn zf_SAB_TurbineTorqueIn zf_SAB_TimeEGSOffIn zf_SAB_EEpromZentralHandler zf_SAB_ComConditionsIn zf_SAB_LayerAGS zf_SAB_EngineSignalDiagnosis zf_SAB_EngineSpeedRedIn zf_SAB_SensorSupplyMonitoring zf_SAB_AGS_LayerMessages zf_SAB_BootJump zf_SAB_ModeEDriveStatusIn zf_SAB_HandBrakeIn zf_SAB_EngineIdleIn zf_SAB_EngineStartStopButtonIn zf_SAB_DrivingStabilitySystemError zf_SAB_ASCRegIn zf_SAB_HybridChargingPlugIn zf_SAB_TransportModeIn zf_SAB_CDD_ActuatorOut zf_SAB_CDD_RoutineControlFlashProgLIN_IEP zf_SAB_CDD_GearboxState zf_SAB_CDD_GearboxStateFl zf_SAB_CDD_PermanentFaultCodes zf_SAB_PMA_ErrorHandling zf_SAB_ABSIn zf_SAB_TargetTorqueK0_In zf_SAB_CrankShaftMaxTorqueEMIn zf_SAB_CrankRequestOut zf_SAB_DesiredIdleSpeedModeOut zf_SAB_DesiredBrakeTorqueIn zf_SAB_CDD_LINBusStartStop zf_SAB_CDD_ZfData zf_SAB_ChargeConditionIn zf_SAB_HybridOpModeEMIn /end SUB_FUNCTION
/end FUNCTION
/begin FUNCTION zf_SABin_Timer "desc_en"
 /begin LOC_MEASUREMENT ZFFSAB._.BootJump.tmr_IEP_ShutdownDelay.time ZFFSAB._.CAN_Handling.tmr_CAN1BusDiagDelay.time ZFFSAB._.CAN_Handling.tmr_CAN2BusDiagDelay.time ZFFSAB._.CAN_Handling.tmr_DiagAfterKL15.time ZFFSAB._.CAN_SwitchingIn.tmr_CAN_HYS.time ZFFSAB._.CDD_IEP_Control.tmr_DelayAfterIepWarmUpErr.time ZFFSAB._.CDD_IEP_Control.tmr_DelayKfcIepBus.time ZFFSAB._.CDD_IEP_Control.tmr_DiagDelayAfterClearErr.time ZFFSAB._.CDD_LINBusStartStop.tmr_IEPSleepDelay.time ZFFSAB._.CDD_LINBusStartStop.tmr_KMN_LINBUSOFF.time ZFFSAB._.CDD_PermanentFaultCodes.tmr_DeactivatePfcTh.time ZFFSAB._.DrivingDirectionIn.tmr_HoldDirection.time ZFFSAB._.EmergencyGearInfo.tmr_3th_stepENPGx.time ZFFSAB._.EmergencyGearInfo.tmr_ENPG1.time ZFFSAB._.EmergencyGearInfo.tmr_ENPG3.time ZFFSAB._.EmergencyGearInfo.tmr_GearSubst.time ZFFSAB._.GLI_ErrorHandling.tmr_DiagAfterFirstKL15.time ZFFSAB._.HybridVehicleReadyToDriveIn.tmr_ToStartVM.time ZFFSAB._.HybridVehicleReadyToDriveIn.tmr_holdStateVehicleReadyToDrive.time ZFFSAB._.PowerdownIn.tmr_PowerDown.time ZFFSAB._.PowerdownIn.tmr_ResetByTester.time ZFFSAB._.RollPreventIn.tmr_hillholdDelay.time ZFFSAB._.RoutineControlUDS.tmr_IEP_Test.time ZFFSAB._.RoutineControlUDS.tmr_PreadaptionSOC0x80.time ZFFSAB._.TipTasterIn.tmr_AnalogPaddleDebounceFunction.time ZFFSAB._.TipTasterIn.tmr_AnalogPaddleLearnFunction.time ZFFSAB._.TipTasterIn.tmr_CANPaddleAllowableReceived.time ZFFSAB._.VoltageMonitoringOut.tmr_DiagActive_UBATTL.time ZFFSAB._.VoltageMonitoringOut.tmr_DiagActive_UBATTU.time ZFFSAB._.VoltageMonitoringOut.tmr_GearSubstLSSOFF.time ZFFSAB._.VoltageMonitoringOut.tmr_Jumpstart.time ZFFSAB._.VoltageMonitoringOut.tmr_u_BattU.time /end LOC_MEASUREMENT
/end FUNCTION
/begin FUNCTION zf_SAB_AzgDriver "desc_en" /begin LOC_MEASUREMENT ZFFSAB._.AzgDriver.addr_fsp /end LOC_MEASUREMENT /end FUNCTION
/begin FUNCTION zf_SAB_Interfo "desc_en"
 /begin LOC_MEASUREMENT ZFFSAB._.Interfo.arg_idx ZFFSAB._.Interfo.arg_idx_komp ZFFSAB._.Interfo.f_erase_infomemory /end LOC_MEASUREMENT
/end FUNCTION
/begin FUNCTION zf_SAB_Timer "desc_en"
 /begin LOC_MEASUREMENT ZFFSAB._.BackToNormalFunctionViaReset.tmr_delay_Limphome.time ZFFSAB._.BackToNormalFunctionViaReset.tmr_delay_Limphome.time_ ZFFSAB._.BackToNormalFunctionViaReset.tmr_delay_LimphomeCnt.time ZFFSAB._.BackToNormalFunctionViaReset.tmr_delay_LimphomeCnt.time_ ZFFSAB._.CDD_GearboxState.tmr_GetFet0Undervoltage.time ZFFSAB._.CDD_GearboxState.tmr_GetFet0Undervoltage.time_ ZFFSAB._.CDD_GearboxState.tmr_HssOff.time ZFFSAB._.CDD_GearboxState.tmr_HssOff.time_ ZFFSAB._.CDD_GearboxState.tmr_ZeroCurrentFeed.time ZFFSAB._.CDD_GearboxState.tmr_ZeroCurrentFeed.time_ ZFFSAB._.CDD_GearboxStateFl.tmr_GetFet0Undervoltage.time ZFFSAB._.CDD_GearboxStateFl.tmr_GetFet0Undervoltage.time_ ZFFSAB._.CDD_GearboxStateFl.tmr_HssOff.time ZFFSAB._.CDD_GearboxStateFl.tmr_HssOff.time_ ZFFSAB._.CDD_GearboxStateFl.tmr_ZeroCurrentFeed.time ZFFSAB._.CDD_GearboxStateFl.tmr_ZeroCurrentFeed.time_ ZFFSAB._.GearRatioByCurrents.GearRatioByCurrents_fl.tmr_IAECloseDelay_LEV2.time ZFFSAB._.GearRatioByCurrents.GearRatioByCurrents_fl.tmr_IAECloseDelay_LEV2.time_ ZFFSAB._.GearRatioByCurrents.GearRatioByCurrents_fl.tmr_IAEClose_LEV2.time ZFFSAB._.GearRatioByCurrents.GearRatioByCurrents_fl.tmr_IAEClose_LEV2.time_ ZFFSAB._.GearRatioByCurrents.GearRatioByCurrents_fl.tmr_iGangDiagDelay_LEV2.time ZFFSAB._.GearRatioByCurrents.GearRatioByCurrents_fl.tmr_iGangDiagDelay_LEV2.time_ ZFFSAB._.GearRatioByCurrents.GearRatioByCurrents_fl.tmr_nTuVirtLev2Delay_LEV2.time ZFFSAB._.GearRatioByCurrents.GearRatioByCurrents_fl.tmr_nTuVirtLev2Delay_LEV2.time_ ZFFSAB._.GearRatioByCurrents.GearRatioByCurrents_fl.tmr_nTuVirtPlausiErrDelay_LEV2.time ZFFSAB._.GearRatioByCurrents.GearRatioByCurrents_fl.tmr_nTuVirtPlausiErrDelay_LEV2.time_ ZFFSAB._.GearRatioByCurrents.GearRatioByCurrents_fl.tmr_t_nDiagDelay_LEV2.time ZFFSAB._.GearRatioByCurrents.GearRatioByCurrents_fl.tmr_t_nDiagDelay_LEV2.time_ ZFFSAB._.GearRatioByCurrents.tmr_IAECloseDelay_LEV2.time ZFFSAB._.GearRatioByCurrents.tmr_IAECloseDelay_LEV2.time_ ZFFSAB._.GearRatioByCurrents.tmr_IAEClose_LEV2.time ZFFSAB._.GearRatioByCurrents.tmr_IAEClose_LEV2.time_ ZFFSAB._.GearRatioByCurrents.tmr_iGangDiagDelay_LEV2.time ZFFSAB._.GearRatioByCurrents.tmr_iGangDiagDelay_LEV2.time_ ZFFSAB._.GearRatioByCurrents.tmr_nTuVirtLev2Delay_LEV2.time ZFFSAB._.GearRatioByCurrents.tmr_nTuVirtLev2Delay_LEV2.time_ ZFFSAB._.GearRatioByCurrents.tmr_nTuVirtPlausiErrDelay_LEV2.time ZFFSAB._.GearRatioByCurrents.tmr_nTuVirtPlausiErrDelay_LEV2.time_ ZFFSAB._.GearRatioByCurrents.tmr_t_nDiagDelay_LEV2.time ZFFSAB._.GearRatioByCurrents.tmr_t_nDiagDelay_LEV2.time_ ZFFSAB._.GearboxTempIn.tmr_CGTPausi_CGTLEV2.time ZFFSAB._.GearboxTempIn.tmr_CGTPausi_CGTLEV2.time_ ZFFSAB._.IgnitionStatusIn.t_IgnTimer.time ZFFSAB._.IgnitionStatusIn.t_IgnTimer.time_ ZFFSAB._.IgnitionStatusIn.tmr_IgnPlausiDelay.time ZFFSAB._.IgnitionStatusIn.tmr_IgnPlausiDelay.time_ ZFFSAB._.IgnitionStatusIn.tmr_IgnPlausiTol.time ZFFSAB._.IgnitionStatusIn.tmr_IgnPlausiTol.time_ ZFFSAB._.ParklockSensorIn.tmr_PosZ.time ZFFSAB._.ParklockSensorIn.tmr_PosZ.time_ ZFFSAB._.RPM_Diagnosis.tmr_t_delay_1SENSORLEV2.time ZFFSAB._.RPM_Diagnosis.tmr_t_delay_1SENSORLEV2.time_ ZFFSAB._.RPM_Diagnosis.tmr_t_delay_N6LEV2.time ZFFSAB._.RPM_Diagnosis.tmr_t_delay_N6LEV2.time_ ZFFSAB._.RPM_Diagnosis.tmr_t_delay_N6PLAUSILEV2.time ZFFSAB._.RPM_Diagnosis.tmr_t_delay_N6PLAUSILEV2.time_ ZFFSAB._.RPM_Diagnosis.tmr_t_delay_NTUVIRTLEV2.time ZFFSAB._.RPM_Diagnosis.tmr_t_delay_NTUVIRTLEV2.time_ ZFFSAB._.RPM_Diagnosis.tmr_t_delay_SENSORLEV2.time ZFFSAB._.RPM_Diagnosis.tmr_t_delay_SENSORLEV2.time_ ZFFSAB._.RPM_SensingIn.Ab.t_n_Offset.time ZFFSAB._.RPM_SensingIn.Ab.t_n_Offset.time_ ZFFSAB._.RPM_SensingIn.Tu.t_n_Offset.time ZFFSAB._.RPM_SensingIn.Tu.t_n_Offset.time_ ZFFSAB._.RearAxleRatioIn.tmr_ForceLearnRearAxleRatio.time ZFFSAB._.RearAxleRatioIn.tmr_ForceLearnRearAxleRatio.time_ ZFFSAB._.RearAxleRatioIn.tmr_IG_HA_LearnDif.time ZFFSAB._.RearAxleRatioIn.tmr_IG_HA_LearnDif.time_ ZFFSAB._.SensorSupplyMonitoring.tmr_t_delay_USENS.time ZFFSAB._.SensorSupplyMonitoring.tmr_t_delay_USENS.time_ ZFFSAB._.SpeedPlausibilityIn.tmr_DelayBrake_VUNPLAUSILEV2.time ZFFSAB._.SpeedPlausibilityIn.tmr_DelayBrake_VUNPLAUSILEV2.time_ ZFFSAB._.SpeedPlausibilityIn.tmr_DelayDeactGra_VUNPLAUSILEV2.time ZFFSAB._.SpeedPlausibilityIn.tmr_DelayDeactGra_VUNPLAUSILEV2.time_ ZFFSAB._.SpeedPlausibilityIn.tmr_DelayGra_VUNPLAUSILEV2.time ZFFSAB._.SpeedPlausibilityIn.tmr_DelayGra_VUNPLAUSILEV2.time_ ZFFSAB._.SpeedPlausibilityIn.tmr_DelayGra_VUNPLAUSILEV2_pred.time ZFFSAB._.SpeedPlausibilityIn.tmr_DelayGra_VUNPLAUSILEV2_pred.time_ ZFFSAB._.SpeedPlausibilityIn.tmr_DelayTo_VUNPLAUSILEV2.time ZFFSAB._.SpeedPlausibilityIn.tmr_DelayTo_VUNPLAUSILEV2.time_ ZFFSAB._.SpeedPlausibilityIn.tmr_VUNPLAUSILEV2_pred.time ZFFSAB._.SpeedPlausibilityIn.tmr_VUNPLAUSILEV2_pred.time_ ZFFSAB._.TempDiagnosis_AT.TempDiagnosis_AT_Fl.cnt_ToleranceErr1.time ZFFSAB._.TempDiagnosis_AT.TempDiagnosis_AT_Fl.cnt_ToleranceErr1.time_ ZFFSAB._.TempDiagnosis_AT.TempDiagnosis_AT_Fl.cnt_ToleranceErr2.time ZFFSAB._.TempDiagnosis_AT.TempDiagnosis_AT_Fl.cnt_ToleranceErr2.time_ ZFFSAB._.TempDiagnosis_AT.TempDiagnosis_AT_Fl.tmr_DiagDelay.time ZFFSAB._.TempDiagnosis_AT.TempDiagnosis_AT_Fl.tmr_DiagDelay.time_ ZFFSAB._.TempDiagnosis_AT.TempDiagnosis_AT_Fl.tmr_TolCheck_CGTLEV2.time ZFFSAB._.TempDiagnosis_AT.TempDiagnosis_AT_Fl.tmr_TolCheck_CGTLEV2.time_ ZFFSAB._.TempDiagnosis_AT.cnt_ToleranceErr1.time ZFFSAB._.TempDiagnosis_AT.cnt_ToleranceErr1.time_ ZFFSAB._.TempDiagnosis_AT.cnt_ToleranceErr2.time ZFFSAB._.TempDiagnosis_AT.cnt_ToleranceErr2.time_ ZFFSAB._.TempDiagnosis_AT.tmr_DiagDelay.time ZFFSAB._.TempDiagnosis_AT.tmr_DiagDelay.time_ ZFFSAB._.TempDiagnosis_AT.tmr_TolCheck_CGTLEV2.time ZFFSAB._.TempDiagnosis_AT.tmr_TolCheck_CGTLEV2.time_ ZFFSAB._.TransmissionOutputSpeedIn.TransmissionOutputSpeedIn_Fl.tmr_DelayNAbMaxCalc.time ZFFSAB._.TransmissionOutputSpeedIn.TransmissionOutputSpeedIn_Fl.tmr_DelayNAbMaxCalc.time_ ZFFSAB._.TransmissionOutputSpeedIn.tmr_DelayNAbMaxCalc.time ZFFSAB._.TransmissionOutputSpeedIn.tmr_DelayNAbMaxCalc.time_ ZFFSAB._.TransmissionOutputSpeedIn.tmr_nAbFiltAktiv.time ZFFSAB._.TransmissionOutputSpeedIn.tmr_nAbFiltAktiv.time_ ZFFSAB._.TurbineSpeedIn.tmr_Delay_TurbineSpeedTx.time ZFFSAB._.TurbineSpeedIn.tmr_Delay_TurbineSpeedTx.time_ ZFFSAB._.TurbineSpeedIn.tmr_nTuFiltAktiv.time ZFFSAB._.TurbineSpeedIn.tmr_nTuFiltAktiv.time_ ZFFSAB._.TurbineSpeedIn.tmr_nTuFiltAktiv2ndPath.time ZFFSAB._.TurbineSpeedIn.tmr_nTuFiltAktiv2ndPath.time_ ZFFSAB._.TurbineSpeedVirtualIn.tmr_VerschachtelungAktiv_ntOpt.time ZFFSAB._.TurbineSpeedVirtualIn.tmr_VerschachtelungAktiv_ntOpt.time_ ZFFSAB._.VehicleSpeedIn.VehicleSpeedInFL.tmr_DelayVIstMaxCalc.time ZFFSAB._.VehicleSpeedIn.VehicleSpeedInFL.tmr_DelayVIstMaxCalc.time_ ZFFSAB._.VehicleSpeedIn.tmr_DelayVIstMaxCalc.time ZFFSAB._.VehicleSpeedIn.tmr_DelayVIstMaxCalc.time_ /end LOC_MEASUREMENT
/end FUNCTION
/begin FUNCTION zf_SAB_RPM_SensingIn "desc_en"
 /begin LOC_MEASUREMENT ZFFSAB._.RPM_SensingIn.Ab.St_RPMSensing ZFFSAB._.RPM_SensingIn.Ab.cnt_total_teeth ZFFSAB._.RPM_SensingIn.Ab.f_FirstVirtualCalc ZFFSAB._.RPM_SensingIn.Ab.f_NeverOnePulse ZFFSAB._.RPM_SensingIn.Ab.frq_SpeedSensor ZFFSAB._.RPM_SensingIn.Ab.iv_ESts ZFFSAB._.RPM_SensingIn.Ab.iv_PulseWidth ZFFSAB._.RPM_SensingIn.Ab.iv_f_Diag ZFFSAB._.RPM_SensingIn.Ab.iv_n_Pulses ZFFSAB._.RPM_SensingIn.Ab.iv_t_Pulses ZFFSAB._.RPM_SensingIn.Ab.iv_t_Pulses_old ZFFSAB._.RPM_SensingIn.Ab.k_nenner ZFFSAB._.RPM_SensingIn.Ab.k_zaehler ZFFSAB._.RPM_SensingIn.Ab.n_Offset ZFFSAB._.RPM_SensingIn.Ab.n_RPM ZFFSAB._.RPM_SensingIn.Ab.n_RPM_Old ZFFSAB._.RPM_SensingIn.Ab.n_RPM_min ZFFSAB._.RPM_SensingIn.Ab.n_Sts ZFFSAB._.RPM_SensingIn.Ab.sts_Direction ZFFSAB._.RPM_SensingIn.Ab.sts_DirectionDiag ZFFSAB._.RPM_SensingIn.Ab.sv_n_RPM ZFFSAB._.RPM_SensingIn.Ab.sv_n_Sts ZFFSAB._.RPM_SensingIn.Ab.sv_sts_Direction ZFFSAB._.RPM_SensingIn.Tu.St_RPMSensing ZFFSAB._.RPM_SensingIn.Tu.cnt_total_teeth ZFFSAB._.RPM_SensingIn.Tu.f_FirstVirtualCalc ZFFSAB._.RPM_SensingIn.Tu.f_NeverOnePulse ZFFSAB._.RPM_SensingIn.Tu.frq_SpeedSensor ZFFSAB._.RPM_SensingIn.Tu.iv_ESts ZFFSAB._.RPM_SensingIn.Tu.iv_PulseWidth ZFFSAB._.RPM_SensingIn.Tu.iv_f_Diag ZFFSAB._.RPM_SensingIn.Tu.iv_n_Pulses ZFFSAB._.RPM_SensingIn.Tu.iv_t_Pulses ZFFSAB._.RPM_SensingIn.Tu.iv_t_Pulses_old ZFFSAB._.RPM_SensingIn.Tu.k_nenner ZFFSAB._.RPM_SensingIn.Tu.k_zaehler ZFFSAB._.RPM_SensingIn.Tu.n_Offset ZFFSAB._.RPM_SensingIn.Tu.n_RPM ZFFSAB._.RPM_SensingIn.Tu.n_RPM_Old ZFFSAB._.RPM_SensingIn.Tu.n_RPM_min ZFFSAB._.RPM_SensingIn.Tu.n_Sts ZFFSAB._.RPM_SensingIn.Tu.sts_Direction ZFFSAB._.RPM_SensingIn.Tu.sts_DirectionDiag ZFFSAB._.RPM_SensingIn.Tu.sv_n_RPM ZFFSAB._.RPM_SensingIn.Tu.sv_n_Sts ZFFSAB._.RPM_SensingIn.Tu.sv_sts_Direction ZFFSAB._.RPM_SensingIn.f_first_init ZFFSAB._.RPM_SensingIn.iv_Pos ZFFSAB._.RPM_SensingIn.iv_PosSts ZFFSAB._.RPM_SensingIn.sv_n6Direction /end LOC_MEASUREMENT
/end FUNCTION
/begin FUNCTION zf_SABin_Interfi "desc_en"
 /begin LOC_MEASUREMENT ZFFSAB._.Interfi.iv_Kraftschluss ZFFSAB._.Interfi.iv_Pos ZFFSAB._.Interfi.iv_PosSts ZFFSAB._.Interfi.iv_u_Batt_Diag /end LOC_MEASUREMENT
/end FUNCTION
/begin FUNCTION zf_SAB_Eeprom "desc_en"
 /begin LOC_MEASUREMENT ZFFSAB._.AmbConditionsIn.iv_st_EepromValid ZFFSAB._.AmbConditionsIn.sv_st_EepromValid ZFFSAB._.Interfi.iv_EepromBusy ZFFSAB._.SABEeprom.EepromData.IgnPlausiErr ZFFSAB._.SABEeprom.EepromData.IgnPlausiErr_ ZFFSAB._.SABEeprom.EepromData.Mileage1kmBuf ZFFSAB._.SABEeprom.EepromData.Mileage1kmBuf_ ZFFSAB._.SABEeprom.EepromData.MileageFromNabBuf ZFFSAB._.SABEeprom.EepromData.MileageFromNabBuf_ ZFFSAB._.SABEeprom.EepromData.RearAxleRatioBuf ZFFSAB._.SABEeprom.EepromData.RearAxleRatioBuf_ ZFFSAB._.SABEeprom.EepromData.RearAxleRatio_ValueNumact_ ZFFSAB._.SABEeprom.EepromData.RearAxleRatio_Value_ ZFFSAB._.SABEeprom.EepromData.actSlaveAppSWVersionNum_ChkSum ZFFSAB._.SABEeprom.EepromData.actSlaveSparePartNumber_ChkSum ZFFSAB._.SABEeprom.EepromData.actual_IEP_CALID_ChkSum ZFFSAB._.SABEeprom.EepromData.actual_IEP_CVN_ChkSum ZFFSAB._.SABEeprom.EepromData.cnt_ForcedShiftups ZFFSAB._.SABEeprom.EepromData.cnt_ForcedShiftups_ ZFFSAB._.SABEeprom.EepromData.cnt_RstFailSumBuf ZFFSAB._.SABEeprom.EepromData.cnt_RstFailSumBuf_ ZFFSAB._.SABEeprom.EepromData.cnt_RstSuccessSumBuf ZFFSAB._.SABEeprom.EepromData.cnt_RstSuccessSumBuf_ ZFFSAB._.SABEeprom.EepromData.cnt_info_memory_entries ZFFSAB._.SABEeprom.EepromData.f_AnalogPaddleLearned ZFFSAB._.SABEeprom.EepromData.f_AnalogPaddleLearned_ ZFFSAB._.SABEeprom.EepromData.f_CANPaddleLearned ZFFSAB._.SABEeprom.EepromData.f_CANPaddleLearned_ ZFFSAB._.SABEeprom.EepromData.f_OBD_PFC_Activation ZFFSAB._.SABEeprom.EepromData.f_OBD_PFC_Activation_ ZFFSAB._.SABEeprom.EepromData.f_PMAModeLearned ZFFSAB._.SABEeprom.EepromData.f_PMAModeLearned_ ZFFSAB._.SABEeprom.EepromData.f_c_CgtPlausiErr ZFFSAB._.SABEeprom.EepromData.f_c_CgtPlausiErr_ ZFFSAB._.SABEeprom.EepromData.f_c_Chip1CGT ZFFSAB._.SABEeprom.EepromData.f_c_Chip1CGT_ ZFFSAB._.SABEeprom.EepromData.f_c_Chip1Chip2 ZFFSAB._.SABEeprom.EepromData.f_c_Chip1Chip2_ ZFFSAB._.SABEeprom.EepromData.f_c_Chip1PlausiErr ZFFSAB._.SABEeprom.EepromData.f_c_Chip1PlausiErr_ ZFFSAB._.SABEeprom.EepromData.f_c_Chip2CGT ZFFSAB._.SABEeprom.EepromData.f_c_Chip2CGT_ ZFFSAB._.SABEeprom.EepromData.f_c_Chip2PlausiErr ZFFSAB._.SABEeprom.EepromData.f_c_Chip2PlausiErr_ ZFFSAB._.SABEeprom.EepromData.f_c_PlausiErr ZFFSAB._.SABEeprom.EepromData.f_c_PlausiErr_ ZFFSAB._.SABEeprom.EepromData.f_n_xErrFlags ZFFSAB._.SABEeprom.EepromData.f_n_xErrFlags_ ZFFSAB._.SABEeprom.EepromData.info_memory[0].errorID ZFFSAB._.SABEeprom.EepromData.info_memory[0].moduleID ZFFSAB._.SABEeprom.EepromData.info_memory[1].errorID ZFFSAB._.SABEeprom.EepromData.info_memory[1].moduleID ZFFSAB._.SABEeprom.EepromData.info_memory[2].errorID ZFFSAB._.SABEeprom.EepromData.info_memory[2].moduleID ZFFSAB._.SABEeprom.EepromData.info_memory[3].errorID ZFFSAB._.SABEeprom.EepromData.info_memory[3].moduleID ZFFSAB._.SABEeprom.EepromData.info_memory[4].errorID ZFFSAB._.SABEeprom.EepromData.info_memory[4].moduleID ZFFSAB._.SABEeprom.EepromData.info_memory[5].errorID ZFFSAB._.SABEeprom.EepromData.info_memory[5].moduleID ZFFSAB._.SABEeprom.EepromData.info_memory[6].errorID ZFFSAB._.SABEeprom.EepromData.info_memory[6].moduleID ZFFSAB._.SABEeprom.EepromData.info_memory[7].errorID ZFFSAB._.SABEeprom.EepromData.info_memory[7].moduleID ZFFSAB._.SABEeprom.EepromData.info_memory_checksum ZFFSAB._.SABEeprom.EepromData.st_ReceiveBitmaskCANMsg1 ZFFSAB._.SABEeprom.EepromData.st_ReceiveBitmaskCANMsg1_ ZFFSAB._.SABEeprom.EepromData.st_ReceiveBitmaskCANMsg2 ZFFSAB._.SABEeprom.EepromData.st_ReceiveBitmaskCANMsg2_ ZFFSAB._.SABEeprom.EepromData.sv_RearAxleRatio_Value ZFFSAB._.SABEeprom.EepromData.sv_RearAxleRatio_ValueLearnedFlag ZFFSAB._.SABEeprom.EepromData.sv_RearAxleRatio_ValueLearnedFlag_ ZFFSAB._.SABEeprom.EepromData.sv_RearAxleRatio_ValueNumact ZFFSAB._.SABEeprom.EepromData.t_SystimeCurBuf ZFFSAB._.SABEeprom.EepromData.t_SystimeCurBuf_ ZFFSAB._.SABEepromBPRAM.f_ForceEEPROM_Update ZFFSAB._.SABEepromBPRAM.f_ForceEEPROM_Update_ /end LOC_MEASUREMENT
/end FUNCTION
/begin FUNCTION zf_SAB_EngineSpeedIn "desc_en"
 /begin LOC_MEASUREMENT ZFFSAB._.EngineSpeedIn.f_n_EngErr ZFFSAB._.EngineSpeedIn.f_n_EngLev2Err ZFFSAB._.EngineSpeedIn.f_n_EngLev2Err_ ZFFSAB._.EngineSpeedIn.f_n_EngVMErr ZFFSAB._.EngineSpeedIn.f_n_EngVMLev2Err ZFFSAB._.EngineSpeedIn.f_n_EngVMLev2Err_ ZFFSAB._.EngineSpeedIn.iv_ActualGear ZFFSAB._.EngineSpeedIn.iv_StatusK0 ZFFSAB._.EngineSpeedIn.iv_TargetGear ZFFSAB._.EngineSpeedIn.iv_i_C0 ZFFSAB._.EngineSpeedIn.iv_i_C0_ ZFFSAB._.EngineSpeedIn.iv_in_Gear ZFFSAB._.EngineSpeedIn.iv_in_GearLev2 ZFFSAB._.EngineSpeedIn.iv_in_GearLev2_ ZFFSAB._.EngineSpeedIn.iv_kraftschluss ZFFSAB._.EngineSpeedIn.iv_n_Eng ZFFSAB._.EngineSpeedIn.iv_n_EngErr ZFFSAB._.EngineSpeedIn.iv_n_EngErr_ ZFFSAB._.EngineSpeedIn.iv_n_EngSts ZFFSAB._.EngineSpeedIn.iv_n_EngSts_ ZFFSAB._.EngineSpeedIn.iv_n_EngVM ZFFSAB._.EngineSpeedIn.iv_n_EngVMErr ZFFSAB._.EngineSpeedIn.iv_n_EngVMSts ZFFSAB._.EngineSpeedIn.iv_n_EngVMSts_ ZFFSAB._.EngineSpeedIn.iv_n_EngVM_ ZFFSAB._.EngineSpeedIn.iv_n_Eng_ ZFFSAB._.EngineSpeedIn.iv_st_IAE ZFFSAB._.EngineSpeedIn.sv_AGS_NEm ZFFSAB._.EngineSpeedIn.sv_n_Eng ZFFSAB._.EngineSpeedIn.sv_n_EngDirection ZFFSAB._.EngineSpeedIn.sv_n_EngLev2 ZFFSAB._.EngineSpeedIn.sv_n_EngLev2Sts ZFFSAB._.EngineSpeedIn.sv_n_EngLev2Sts_ ZFFSAB._.EngineSpeedIn.sv_n_EngLev2_ ZFFSAB._.EngineSpeedIn.sv_n_EngSts ZFFSAB._.EngineSpeedIn.sv_n_EngVM ZFFSAB._.EngineSpeedIn.sv_n_EngVMLev2 ZFFSAB._.EngineSpeedIn.sv_n_EngVMLev2Sts ZFFSAB._.EngineSpeedIn.sv_n_EngVMLev2Sts_ ZFFSAB._.EngineSpeedIn.sv_n_EngVMLev2_ ZFFSAB._.EngineSpeedIn.sv_n_EngVMSts ZFFSAB._.EngineSpeedRedIn.f_n_EngMaxRedErr ZFFSAB._.ParkingBrakeIn.f_ParkingBrakeErr /end LOC_MEASUREMENT
/end FUNCTION
/begin FUNCTION zf_SAB_IgnitionStatusIn "desc_en"
 /begin LOC_MEASUREMENT ZFFSAB._.AmbConditionsIn.iv_f_IgnOn ZFFSAB._.IgnitionStatusIn.IgnPlausiErr ZFFSAB._.IgnitionStatusIn.f_KL15 ZFFSAB._.IgnitionStatusIn.f_KL15Err ZFFSAB._.IgnitionStatusIn.f_Kl15_Pin ZFFSAB._.IgnitionStatusIn.iv_KL15 ZFFSAB._.IgnitionStatusIn.iv_KL15Sts ZFFSAB._.IgnitionStatusIn.iv_KL15Sts_ ZFFSAB._.IgnitionStatusIn.iv_KL15_ ZFFSAB._.IgnitionStatusIn.iv_KLDiv ZFFSAB._.IgnitionStatusIn.iv_KLDiv_ ZFFSAB._.IgnitionStatusIn.iv_t_System ZFFSAB._.IgnitionStatusIn.iv_u_Kl15_Pin ZFFSAB._.IgnitionStatusIn.st_IgnPlausiState ZFFSAB._.IgnitionStatusIn.st_IgnPlausiState_ ZFFSAB._.IgnitionStatusIn.sv_KL15 ZFFSAB._.IgnitionStatusIn.sv_KL15Sts ZFFSAB._.IgnitionStatusIn.sv_KL15Sts_ ZFFSAB._.IgnitionStatusIn.sv_KL15_ ZFFSAB._.IgnitionStatusIn.sv_f_IgnOn /end LOC_MEASUREMENT
/end FUNCTION
/begin FUNCTION zf_SAB_RoutineControlUDS "desc_en"
 /begin LOC_MEASUREMENT ZFFSAB._.RoutineControlUDS.AbortCustomerReason ZFFSAB._.RoutineControlUDS.f_ReadyToBSS_NOT_RUNNING ZFFSAB._.RoutineControlUDS.iv_PreConditions ZFFSAB._.RoutineControlUDS.iv_PreadaptionCondition ZFFSAB._.RoutineControlUDS.iv_PreadaptionState ZFFSAB._.RoutineControlUDS.iv_f_ObdPfcActivation ZFFSAB._.RoutineControlUDS.st_IEP_test ZFFSAB._.RoutineControlUDS.st_basicsettings ZFFSAB._.RoutineControlUDS.st_basicsettings_preadap ZFFSAB._.RoutineControlUDS.sv_EPumpCtrlByTester ZFFSAB._.RoutineControlUDS.sv_PreadaptionRequest /end LOC_MEASUREMENT
/end FUNCTION
/begin FUNCTION zf_SAB_ASCIn "desc_en"
 /begin LOC_MEASUREMENT ZFFSAB._.ASCIn.f_ASCErr ZFFSAB._.ASCIn.f_ASCSbeErr ZFFSAB._.ASCIn.iv_ASCRegSts ZFFSAB._.ASCIn.iv_ASCSbe ZFFSAB._.ASCIn.iv_ASCSts ZFFSAB._.ASCIn.sv_ASCSbeSts ZFFSAB._.ASCIn.sv_f_ASCSbe /end LOC_MEASUREMENT
/end FUNCTION
/begin FUNCTION zf_SAB_ASCPasIn "desc_en"
 /begin LOC_MEASUREMENT ZFFSAB._.ASCPasIn.f_ASCPasErr ZFFSAB._.ASCPasIn.iv_ASCPas ZFFSAB._.ASCPasIn.iv_ASCPasSts ZFFSAB._.ASCPasIn.iv_ASCPasSts_ ZFFSAB._.ASCPasIn.iv_ASCPas_ ZFFSAB._.ASCPasIn.sv_ASCPas ZFFSAB._.ASCPasIn.sv_ASCPasSts ZFFSAB._.ASCPasIn.sv_f_DSCErr ZFFSAB._.ASCPasIn.sv_f_DSCErr_ /end LOC_MEASUREMENT
/end FUNCTION
/begin FUNCTION zf_SAB_BackToNormalFunctionViaReset "desc_en"
 /begin LOC_MEASUREMENT ZFFSAB._.BackToNormalFunctionViaReset.f_LimphomeD ZFFSAB._.BackToNormalFunctionViaReset.f_LimphomeD_ ZFFSAB._.BackToNormalFunctionViaReset.f_Reset_DetectedTimer ZFFSAB._.BackToNormalFunctionViaReset.f_Reset_DetectedTimer_ ZFFSAB._.BackToNormalFunctionViaReset.iv_EEPROMBusy ZFFSAB._.BackToNormalFunctionViaReset.iv_f_EEPROMStoreInProgress ZFFSAB._.BackToNormalFunctionViaResetBPRAM.Reset_cnt ZFFSAB._.BackToNormalFunctionViaResetBPRAM.Reset_cnt_ ZFFSAB._.BackToNormalFunctionViaResetBPRAM.f_Relevant_KFC_Active ZFFSAB._.BackToNormalFunctionViaResetBPRAM.f_Relevant_KFC_Active_ ZFFSAB._.BackToNormalFunctionViaResetBPRAM.f_Reset_Detected ZFFSAB._.BackToNormalFunctionViaResetBPRAM.f_Reset_Detected_ /end LOC_MEASUREMENT
/end FUNCTION
/begin FUNCTION zf_SAB_OBD_CyclesIn "desc_en"
 /begin LOC_MEASUREMENT ZFFSAB._.OBD_CyclesIn.f_OBD_CyclesInfoErr ZFFSAB._.OBD_CyclesIn.f_OBD_LoadEngineErr ZFFSAB._.OBD_CyclesIn.f_OBD_ThrottlePositionErr ZFFSAB._.OBD_CyclesIn.iv_OBD_CyclesInfo ZFFSAB._.OBD_CyclesIn.iv_OBD_CyclesInfoFA ZFFSAB._.OBD_CyclesIn.iv_OBD_CyclesInfoFASts ZFFSAB._.OBD_CyclesIn.iv_OBD_CyclesInfoSts ZFFSAB._.OBD_CyclesIn.iv_OBD_LoadEngine ZFFSAB._.OBD_CyclesIn.iv_OBD_LoadEngineFA ZFFSAB._.OBD_CyclesIn.iv_OBD_LoadEngineFASts ZFFSAB._.OBD_CyclesIn.iv_OBD_LoadEngineSts ZFFSAB._.OBD_CyclesIn.iv_OBD_ThrottlePosition ZFFSAB._.OBD_CyclesIn.iv_OBD_ThrottlePositionFA ZFFSAB._.OBD_CyclesIn.iv_OBD_ThrottlePositionFASts ZFFSAB._.OBD_CyclesIn.iv_OBD_ThrottlePositionSts ZFFSAB._.OBD_CyclesIn.iv_u_Batt_Diag ZFFSAB._.OBD_CyclesIn.sv_OBD_CyclesInfoSts ZFFSAB._.OBD_CyclesIn.sv_OBD_DrivingCycle ZFFSAB._.OBD_CyclesIn.sv_OBD_NormedTrip ZFFSAB._.OBD_CyclesIn.sv_OBD_NormedTripB ZFFSAB._.OBD_CyclesIn.sv_OBD_WarmUpCycle /end LOC_MEASUREMENT
/end FUNCTION
/begin FUNCTION zf_SAB_SpeedPlausibilityIn "desc_en"
 /begin LOC_MEASUREMENT ZFFSAB._.SpeedPlausibilityIn.f_n_AbGra_VUNPLAUSILEV2 ZFFSAB._.SpeedPlausibilityIn.f_vunplausi_pred ZFFSAB._.SpeedPlausibilityIn.sv_n_AbOld ZFFSAB._.SpeedPlausibilityIn.sv_n_Ab_plausibel ZFFSAB._.SpeedPlausibilityIn.sv_v_unplausi ZFFSAB._.SpeedPlausibilityIn.sv_v_unplausi_ ZFFSAB._.SpeedPlausibilityIn.v_unplausiOld /end LOC_MEASUREMENT
/end FUNCTION
/begin FUNCTION zf_SAB_LowModeDriveIn "desc_en"
 /begin LOC_MEASUREMENT ZFFSAB._.LowModeDriveIn.iv_LowMode ZFFSAB._.LowModeDriveIn.iv_LowModeFA ZFFSAB._.LowModeDriveIn.iv_LowModeFASts ZFFSAB._.LowModeDriveIn.iv_LowModeSts ZFFSAB._.LowModeDriveIn.sv_LowMode ZFFSAB._.LowModeDriveIn.sv_LowModeSts /end LOC_MEASUREMENT
/end FUNCTION
/begin FUNCTION zf_SAB_FullThrottleTorqueIn "desc_en"
 /begin LOC_MEASUREMENT ZFFSAB._.FullThrottleTorqueIn.f_m_MKWMaxErr ZFFSAB._.FullThrottleTorqueIn.iv_m_MKWMax ZFFSAB._.FullThrottleTorqueIn.iv_m_MKWMaxSts ZFFSAB._.FullThrottleTorqueIn.sv_m_MKWMax ZFFSAB._.FullThrottleTorqueIn.sv_m_MKWMaxSts /end LOC_MEASUREMENT
/end FUNCTION
/begin FUNCTION zf_SAB_GearRatioByCurrents_fl "desc_en"
 /begin LOC_MEASUREMENT ZFFSAB._.GearRatioByCurrents.GearRatioByCurrents_fl.IstGang ZFFSAB._.GearRatioByCurrents.GearRatioByCurrents_fl.IstGangOld ZFFSAB._.GearRatioByCurrents.GearRatioByCurrents_fl.err_flags_old ZFFSAB._.GearRatioByCurrents.GearRatioByCurrents_fl.err_flags_old_ ZFFSAB._.GearRatioByCurrents.GearRatioByCurrents_fl.f_RearAxleRatioLearned ZFFSAB._.GearRatioByCurrents.GearRatioByCurrents_fl.f_RearAxleRatioLearned_ ZFFSAB._.GearRatioByCurrents.GearRatioByCurrents_fl.f_n6PlausiErr ZFFSAB._.GearRatioByCurrents.GearRatioByCurrents_fl.f_n6WheelErr ZFFSAB._.GearRatioByCurrents.GearRatioByCurrents_fl.f_n6nEngErr ZFFSAB._.GearRatioByCurrents.GearRatioByCurrents_fl.f_n_AbPlausiErr ZFFSAB._.GearRatioByCurrents.GearRatioByCurrents_fl.f_n_AbWheelErr ZFFSAB._.GearRatioByCurrents.GearRatioByCurrents_fl.f_n_Abn6Err ZFFSAB._.GearRatioByCurrents.GearRatioByCurrents_fl.f_n_PlausiErr ZFFSAB._.GearRatioByCurrents.GearRatioByCurrents_fl.f_n_TuVirtPlausiErr ZFFSAB._.GearRatioByCurrents.GearRatioByCurrents_fl.f_n_WheelPlausiErr ZFFSAB._.GearRatioByCurrents.GearRatioByCurrents_fl.f_xErrChanged ZFFSAB._.GearRatioByCurrents.GearRatioByCurrents_fl.iGang ZFFSAB._.GearRatioByCurrents.GearRatioByCurrents_fl.iv_IstGang ZFFSAB._.GearRatioByCurrents.GearRatioByCurrents_fl.iv_IstGang_ ZFFSAB._.GearRatioByCurrents.GearRatioByCurrents_fl.iv_iGang ZFFSAB._.GearRatioByCurrents.GearRatioByCurrents_fl.iv_iGang_ ZFFSAB._.GearRatioByCurrents.GearRatioByCurrents_fl.iv_n6 ZFFSAB._.GearRatioByCurrents.GearRatioByCurrents_fl.iv_n6_ ZFFSAB._.GearRatioByCurrents.GearRatioByCurrents_fl.iv_n6_ESts ZFFSAB._.GearRatioByCurrents.GearRatioByCurrents_fl.iv_n6_ESts_ ZFFSAB._.GearRatioByCurrents.GearRatioByCurrents_fl.iv_n_Ab ZFFSAB._.GearRatioByCurrents.GearRatioByCurrents_fl.iv_n_AbESts ZFFSAB._.GearRatioByCurrents.GearRatioByCurrents_fl.iv_n_AbESts_ ZFFSAB._.GearRatioByCurrents.GearRatioByCurrents_fl.iv_n_Ab_ ZFFSAB._.GearRatioByCurrents.GearRatioByCurrents_fl.iv_n_Tu ZFFSAB._.GearRatioByCurrents.GearRatioByCurrents_fl.iv_n_Tu_ ZFFSAB._.GearRatioByCurrents.GearRatioByCurrents_fl.iv_sts_ClutchIAE ZFFSAB._.GearRatioByCurrents.GearRatioByCurrents_fl.iv_sts_n6_DirectionDiag ZFFSAB._.GearRatioByCurrents.GearRatioByCurrents_fl.iv_sts_n6_DirectionDiag_ ZFFSAB._.GearRatioByCurrents.GearRatioByCurrents_fl.n_AbByWheelAvg ZFFSAB._.GearRatioByCurrents.GearRatioByCurrents_fl.n_AbByWheelAvg_ ZFFSAB._.GearRatioByCurrents.GearRatioByCurrents_fl.n_TuVirtLev2 ZFFSAB._.GearRatioByCurrents.GearRatioByCurrents_fl.n_TuVirtLev2Sts ZFFSAB._.GearRatioByCurrents.GearRatioByCurrents_fl.n_TuVirtLev2_ ZFFSAB._.GearRatioByCurrents.GearRatioByCurrents_fl.n_WheelAvgSts ZFFSAB._.GearRatioByCurrents.GearRatioByCurrents_fl.n_WheelAvgSts_ ZFFSAB._.GearRatioByCurrents.GearRatioByCurrents_fl.sts_n6_Dir ZFFSAB._.GearRatioByCurrents.GearRatioByCurrents_fl.sv_f_IAE_ReqSubst ZFFSAB._.GearRatioByCurrents.GearRatioByCurrents_fl.sv_n_EngLev2 ZFFSAB._.GearRatioByCurrents.GearRatioByCurrents_fl.sv_n_EngLev2Sts ZFFSAB._.GearRatioByCurrents.GearRatioByCurrents_fl.sv_n_EngLev2Sts_ ZFFSAB._.GearRatioByCurrents.GearRatioByCurrents_fl.sv_n_EngLev2_ ZFFSAB._.GearRatioByCurrents.GearRatioByCurrents_fl.sv_st_KL15 ZFFSAB._.GearRatioByCurrents.GearRatioByCurrents_fl.sv_st_KL15_ /end LOC_MEASUREMENT
/end FUNCTION
/begin RECORD_LAYOUT ZF_Parameter.ui8_S1_S3 FNC_VALUES 1 UBYTE ROW_DIR DIRECT /end RECORD_LAYOUT
/begin RECORD_LAYOUT ZF_Parameter.ui16_S1_S3 FNC_VALUES 1 UWORD ROW_DIR DIRECT /end RECORD_LAYOUT
/begin RECORD_LAYOUT ZF_Parameter.ui32_S1_S3 FNC_VALUES 1 ULONG ROW_DIR DIRECT /end RECORD_LAYOUT
/begin RECORD_LAYOUT ZF_Table.ui8_S1_S3 FNC_VALUES 1 UBYTE ROW_DIR DIRECT /end RECORD_LAYOUT
/begin RECORD_LAYOUT ZF_Curve.ui16.ui16_S1_S3 FNC_VALUES 2 UWORD ROW_DIR DIRECT AXIS_PTS_X 1 UWORD INDEX_INCR DIRECT /end RECORD_LAYOUT
/begin RECORD_LAYOUT ZF_Table.ui16_S1_S3 FNC_VALUES 1 UWORD ROW_DIR DIRECT /end RECORD_LAYOUT
/begin RECORD_LAYOUT ZF_Matrix.ui32_S1_S3 FNC_VALUES 1 ULONG ROW_DIR DIRECT /end RECORD_LAYOUT
/end MODULE
/end PROJECT
